ASAP2_VERSION 1 60
/begin PROJECT MG1CA020 "MG1CA020"
/begin HEADER "" VERSION "MG1CA020_6SAY_V011_TPROT" PROJECT_NO MG1CA020 /end HEADER
/begin MODULE DIM ""
/begin MOD_COMMON "" BYTE_ORDER MSB_LAST ALIGNMENT_BYTE 1 ALIGNMENT_WORD 2 ALIGNMENT_LONG 4 ALIGNMENT_INT64 4 ALIGNMENT_FLOAT32_IEEE 4 ALIGNMENT_FLOAT64_IEEE 4 DATA_SIZE 32 /end MOD_COMMON
/begin CHARACTERISTIC DFES_DTCO.DFC_MisfDetdVWhlFrntRiPlaus_C "OBD specific trouble code / OBD specific diagnostic trouble code for check DFC_MisfDetdVWhlFrntRiPlaus" VALUE 0x804F94A0 Val_Wu16 65535.00 DFES_OneToOne 0.00 65535.00 FORMAT "%8.2" /end CHARACTERISTIC
/begin CHARACTERISTIC DFES_DTCO.DFC_MisfDetdVWhlReLePlaus_C "OBD specific trouble code / OBD specific diagnostic trouble code for check DFC_MisfDetdVWhlReLePlaus" VALUE 0x804F94A2 Val_Wu16 65535.00 DFES_OneToOne 0.00 65535.00 FORMAT "%8.2" /end CHARACTERISTIC
/begin CHARACTERISTIC DFES_DTCO.DFC_MisfDetdVWhlReRiPlaus_C "OBD specific trouble code / OBD specific diagnostic trouble code for check DFC_MisfDetdVWhlReRiPlaus" VALUE 0x804F94A4 Val_Wu16 65535.00 DFES_OneToOne 0.00 65535.00 FORMAT "%8.2" /end CHARACTERISTIC
/begin CHARACTERISTIC DFES_DTCO.DFC_PEnvSigRngMax_C "OBD specific trouble code / OBD specific diagnostic trouble code for check DFC_PEnvSigRngMax" VALUE 0x804F94A6 Val_Wu16 65535.00 DFES_OneToOne 0.00 65535.00 FORMAT "%8.2" /end CHARACTERISTIC
/begin CHARACTERISTIC DFES_DTCO.DFC_PEnvSigRngMin_C "OBD specific trouble code / OBD specific diagnostic trouble code for check DFC_PEnvSigRngMin" VALUE 0x804F94A8 Val_Wu16 65535.00 DFES_OneToOne 0.00 65535.00 FORMAT "%8.2" /end CHARACTERISTIC
/begin CHARACTERISTIC DFES_DTCO.DFC_StmFault_C "OBD specific trouble code / OBD specific diagnostic trouble code for check DFC_StmFault" VALUE 0x804F94AA Val_Wu16 65535.00 DFES_OneToOne 0.00 65535.00 FORMAT "%8.2" /end CHARACTERISTIC
/begin CHARACTERISTIC DFES_DTCO.DFC_StrtCtOffPth_C "OBD specific trouble code / OBD specific diagnostic trouble code for check DFC_StrtCtOffPth" VALUE 0x804F94AC Val_Wu16 65535.00 DFES_OneToOne 0.00 65535.00 FORMAT "%8.2" /end CHARACTERISTIC
/begin CHARACTERISTIC DFES_DTCO.DFC_StrtCtlErr_C "OBD specific trouble code / OBD specific diagnostic trouble code for check DFC_StrtCtlErr" VALUE 0x804F94AE Val_Wu16 65535.00 DFES_OneToOne 0.00 65535.00 FORMAT "%8.2" /end CHARACTERISTIC
/begin CHARACTERISTIC DFES_DTCO.DFC_StrtFault_C "OBD specific trouble code / OBD specific diagnostic trouble code for check DFC_StrtFault" VALUE 0x804F94B0 Val_Wu16 65535.00 DFES_OneToOne 0.00 65535.00 FORMAT "%8.2" /end CHARACTERISTIC
/begin CHARACTERISTIC DFES_DTCO.DFC_StrtLckJudg1_C "OBD specific trouble code / OBD specific diagnostic trouble code for check DFC_StrtLckJudg1" VALUE 0x804F94B2 Val_Wu16 65535.00 DFES_OneToOne 0.00 65535.00 FORMAT "%8.2" /end CHARACTERISTIC
/begin CHARACTERISTIC DFES_DTCO.DFC_StrtLckJudg2_C "OBD specific trouble code / OBD specific diagnostic trouble code for check DFC_StrtLckJudg2" VALUE 0x804F94B4 Val_Wu16 65535.00 DFES_OneToOne 0.00 65535.00 FORMAT "%8.2" /end CHARACTERISTIC
/begin CHARACTERISTIC DFES_DTCO.DFC_StrtOL_C "OBD specific trouble code / OBD specific diagnostic trouble code for check DFC_StrtOL" VALUE 0x804F94B6 Val_Wu16 65535.00 DFES_OneToOne 0.00 65535.00 FORMAT "%8.2" /end CHARACTERISTIC
/begin CHARACTERISTIC DFES_DTCO.DFC_StrtOL2_C "OBD specific trouble code / OBD specific diagnostic trouble code for check DFC_StrtOL2" VALUE 0x804F94B8 Val_Wu16 65535.00 DFES_OneToOne 0.00 65535.00 FORMAT "%8.2" /end CHARACTERISTIC
/begin CHARACTERISTIC DFES_DTCO.DFC_StrtSCB_C "OBD specific trouble code / OBD specific diagnostic trouble code for check DFC_StrtSCB" VALUE 0x804F94BA Val_Wu16 65535.00 DFES_OneToOne 0.00 65535.00 FORMAT "%8.2" /end CHARACTERISTIC
/begin CHARACTERISTIC DFES_DTCO.DFC_StrtSCB2_C "OBD specific trouble code / OBD specific diagnostic trouble code for check DFC_StrtSCB2" VALUE 0x804F94BC Val_Wu16 65535.00 DFES_OneToOne 0.00 65535.00 FORMAT "%8.2" /end CHARACTERISTIC
/begin CHARACTERISTIC DFES_DTCO.DFC_StrtSCG_C "OBD specific trouble code / OBD specific diagnostic trouble code for check DFC_StrtSCG" VALUE 0x804F94BE Val_Wu16 65535.00 DFES_OneToOne 0.00 65535.00 FORMAT "%8.2" /end CHARACTERISTIC
/begin CHARACTERISTIC DFES_DTCO.DFC_StrtSCG2_C "OBD specific trouble code / OBD specific diagnostic trouble code for check DFC_StrtSCG2" VALUE 0x804F94C0 Val_Wu16 65535.00 DFES_OneToOne 0.00 65535.00 FORMAT "%8.2" /end CHARACTERISTIC
/begin CHARACTERISTIC DFES_DTCO.DFC_StrtStkRly1_C "OBD specific trouble code / OBD specific diagnostic trouble code for check DFC_StrtStkRly1" VALUE 0x804F94C2 Val_Wu16 65535.00 DFES_OneToOne 0.00 65535.00 FORMAT "%8.2" /end CHARACTERISTIC
/begin CHARACTERISTIC DFES_DTCO.DFC_StrtStkRly2_C "OBD specific trouble code / OBD specific diagnostic trouble code for check DFC_StrtStkRly2" VALUE 0x804F94C4 Val_Wu16 65535.00 DFES_OneToOne 0.00 65535.00 FORMAT "%8.2" /end CHARACTERISTIC
/begin CHARACTERISTIC DFES_DTCO.DFC_TEVEmax_C "OBD specific trouble code / OBD specific diagnostic trouble code for check DFC_TEVEmax" VALUE 0x804F94C6 Val_Wu16 65535.00 DFES_OneToOne 0.00 65535.00 FORMAT "%8.2" /end CHARACTERISTIC
/begin CHARACTERISTIC DFES_DTCO.DFC_TEVEmin_C "OBD specific trouble code / OBD specific diagnostic trouble code for check DFC_TEVEmin" VALUE 0x804F94C8 Val_Wu16 65535.00 DFES_OneToOne 0.00 65535.00 FORMAT "%8.2" /end CHARACTERISTIC
/begin CHARACTERISTIC DFES_DTCO.DFC_TEVEsig_C "OBD specific trouble code / OBD specific diagnostic trouble code for check DFC_TEVEsig" VALUE 0x804F94CA Val_Wu16 65535.00 DFES_OneToOne 0.00 65535.00 FORMAT "%8.2" /end CHARACTERISTIC
/begin CHARACTERISTIC DFES_DTCO.DFC_VehVAllPlaus_C "OBD specific trouble code / OBD specific diagnostic trouble code for check DFC_VehVAllPlaus" VALUE 0x804F94CC Val_Wu16 65535.00 DFES_OneToOne 0.00 65535.00 FORMAT "%8.2" /end CHARACTERISTIC
/begin CHARACTERISTIC DFES_DTCO.DFC_VehVNCSnsrElecFailr_C "OBD specific trouble code / OBD specific diagnostic trouble code for check DFC_VehVNCSnsrElecFailr" VALUE 0x804F94CE Val_Wu16 65535.00 DFES_OneToOne 0.00 65535.00 FORMAT "%8.2" /end CHARACTERISTIC
/begin CHARACTERISTIC DFES_DTCO.DFC_VehVPlausCan_C "OBD specific trouble code / OBD specific diagnostic trouble code for check DFC_VehVPlausCan" VALUE 0x804F94D0 Val_Wu16 65535.00 DFES_OneToOne 0.00 65535.00 FORMAT "%8.2" /end CHARACTERISTIC
/begin CHARACTERISTIC DFES_DTCO.DFC_VehVPlausFco_C "OBD specific trouble code / OBD specific diagnostic trouble code for check DFC_VehVPlausFco" VALUE 0x804F94D2 Val_Wu16 65535.00 DFES_OneToOne 0.00 65535.00 FORMAT "%8.2" /end CHARACTERISTIC
/begin CHARACTERISTIC DFES_DTCO.DFC_VehVPlausPwr_C "OBD specific trouble code / OBD specific diagnostic trouble code for check DFC_VehVPlausPwr" VALUE 0x804F94D4 Val_Wu16 65535.00 DFES_OneToOne 0.00 65535.00 FORMAT "%8.2" /end CHARACTERISTIC
/begin CHARACTERISTIC DFES_DTCO.DFC_VehVPlausV2N_C "OBD specific trouble code / OBD specific diagnostic trouble code for check DFC_VehVPlausV2N" VALUE 0x804F94D6 Val_Wu16 65535.00 DFES_OneToOne 0.00 65535.00 FORMAT "%8.2" /end CHARACTERISTIC
/begin CHARACTERISTIC DFES_DTCO.DFC_VehVSpdSnsrAElecFailr_C "OBD specific trouble code / OBD specific diagnostic trouble code for check DFC_VehVSpdSnsrAElecFailr" VALUE 0x804F94D8 Val_Wu16 65535.00 DFES_OneToOne 0.00 65535.00 FORMAT "%8.2" /end CHARACTERISTIC
/begin CHARACTERISTIC DFES_DTCO.DFC_VehVSpdSnsrBElecFailr_C "OBD specific trouble code / OBD specific diagnostic trouble code for check DFC_VehVSpdSnsrBElecFailr" VALUE 0x804F94DA Val_Wu16 65535.00 DFES_OneToOne 0.00 65535.00 FORMAT "%8.2" /end CHARACTERISTIC
/begin CHARACTERISTIC DFES_DTCO.DFC_ClthMax_C "OBD specific trouble code / OBD specific diagnostic trouble code for check DFC_ClthMax" VALUE 0x804F94DC Val_Wu16 65535.00 DFES_OneToOne 0.00 65535.00 FORMAT "%8.2" /end CHARACTERISTIC
/begin CHARACTERISTIC DFES_DTCO.DFC_IgnClPs_DevComErr_C "OBD specific trouble code / OBD specific diagnostic trouble code for check DFC_IgnClPs_DevComErr" VALUE 0x804F94DE Val_Wu16 65535.00 DFES_OneToOne 0.00 65535.00 FORMAT "%8.2" /end CHARACTERISTIC
/begin CHARACTERISTIC DFES_DTCO.DFC_IgnClPs_LineOl_0_C "OBD specific trouble code / OBD specific diagnostic trouble code for check DFC_IgnClPs_LineOl_0" VALUE 0x804F94E0 Val_Wu16 65535.00 DFES_OneToOne 0.00 65535.00 FORMAT "%8.2" /end CHARACTERISTIC
/begin CHARACTERISTIC DFES_DTCO.DFC_IgnClPs_LineOl_1_C "OBD specific trouble code / OBD specific diagnostic trouble code for check DFC_IgnClPs_LineOl_1" VALUE 0x804F94E2 Val_Wu16 65535.00 DFES_OneToOne 0.00 65535.00 FORMAT "%8.2" /end CHARACTERISTIC
/begin CHARACTERISTIC DFES_DTCO.DFC_IgnClPs_LineOl_2_C "OBD specific trouble code / OBD specific diagnostic trouble code for check DFC_IgnClPs_LineOl_2" VALUE 0x804F94E4 Val_Wu16 65535.00 DFES_OneToOne 0.00 65535.00 FORMAT "%8.2" /end CHARACTERISTIC
/begin CHARACTERISTIC DFES_DTCO.DFC_IgnClPs_LineOl_3_C "OBD specific trouble code / OBD specific diagnostic trouble code for check DFC_IgnClPs_LineOl_3" VALUE 0x804F94E6 Val_Wu16 65535.00 DFES_OneToOne 0.00 65535.00 FORMAT "%8.2" /end CHARACTERISTIC
/begin CHARACTERISTIC DFES_DTCO.DFC_IgnClPs_LineScb_0_C "OBD specific trouble code / OBD specific diagnostic trouble code for check DFC_IgnClPs_LineScb_0" VALUE 0x804F94E8 Val_Wu16 65535.00 DFES_OneToOne 0.00 65535.00 FORMAT "%8.2" /end CHARACTERISTIC
/begin CHARACTERISTIC DFES_DTCO.DFC_IgnClPs_LineScb_1_C "OBD specific trouble code / OBD specific diagnostic trouble code for check DFC_IgnClPs_LineScb_1" VALUE 0x804F94EA Val_Wu16 65535.00 DFES_OneToOne 0.00 65535.00 FORMAT "%8.2" /end CHARACTERISTIC
/begin CHARACTERISTIC DFES_DTCO.DFC_IgnClPs_LineScb_2_C "OBD specific trouble code / OBD specific diagnostic trouble code for check DFC_IgnClPs_LineScb_2" VALUE 0x804F94EC Val_Wu16 65535.00 DFES_OneToOne 0.00 65535.00 FORMAT "%8.2" /end CHARACTERISTIC
/begin CHARACTERISTIC DFES_DTCO.DFC_IgnClPs_LineScb_3_C "OBD specific trouble code / OBD specific diagnostic trouble code for check DFC_IgnClPs_LineScb_3" VALUE 0x804F94EE Val_Wu16 65535.00 DFES_OneToOne 0.00 65535.00 FORMAT "%8.2" /end CHARACTERISTIC
/begin CHARACTERISTIC DFES_DTCO.DFC_IgnClPs_LineScg_0_C "OBD specific trouble code / OBD specific diagnostic trouble code for check DFC_IgnClPs_LineScg_0" VALUE 0x804F94F0 Val_Wu16 65535.00 DFES_OneToOne 0.00 65535.00 FORMAT "%8.2" /end CHARACTERISTIC
/begin CHARACTERISTIC DFES_DTCO.DFC_IgnClPs_LineScg_1_C "OBD specific trouble code / OBD specific diagnostic trouble code for check DFC_IgnClPs_LineScg_1" VALUE 0x804F94F2 Val_Wu16 65535.00 DFES_OneToOne 0.00 65535.00 FORMAT "%8.2" /end CHARACTERISTIC
/begin CHARACTERISTIC DFES_DTCO.DFC_IgnClPs_LineScg_2_C "OBD specific trouble code / OBD specific diagnostic trouble code for check DFC_IgnClPs_LineScg_2" VALUE 0x804F94F4 Val_Wu16 65535.00 DFES_OneToOne 0.00 65535.00 FORMAT "%8.2" /end CHARACTERISTIC
/begin CHARACTERISTIC DFES_DTCO.DFC_IgnClPs_LineScg_3_C "OBD specific trouble code / OBD specific diagnostic trouble code for check DFC_IgnClPs_LineScg_3" VALUE 0x804F94F6 Val_Wu16 65535.00 DFES_OneToOne 0.00 65535.00 FORMAT "%8.2" /end CHARACTERISTIC
/begin CHARACTERISTIC DFES_DTCO.DFC_UEGOASICS1B1_C "OBD specific trouble code / OBD specific diagnostic trouble code for check DFC_UEGOASICS1B1" VALUE 0x804F94F8 Val_Wu16 65535.00 DFES_OneToOne 0.00 65535.00 FORMAT "%8.2" /end CHARACTERISTIC
/begin CHARACTERISTIC DFES_DTCO.DFC_UEGOOLIPES1B1_C "OBD specific trouble code / OBD specific diagnostic trouble code for check DFC_UEGOOLIPES1B1" VALUE 0x804F94FA Val_Wu16 65535.00 DFES_OneToOne 0.00 65535.00 FORMAT "%8.2" /end CHARACTERISTIC
/begin CHARACTERISTIC DFES_DTCO.DFC_UEGOOLRES1B1_C "OBD specific trouble code / OBD specific diagnostic trouble code for check DFC_UEGOOLRES1B1" VALUE 0x804F94FC Val_Wu16 65535.00 DFES_OneToOne 0.00 65535.00 FORMAT "%8.2" /end CHARACTERISTIC
/begin CHARACTERISTIC DFES_DTCO.DFC_UEGOSCBS1B1_C "OBD specific trouble code / OBD specific diagnostic trouble code for check DFC_UEGOSCBS1B1" VALUE 0x804F94FE Val_Wu16 65535.00 DFES_OneToOne 0.00 65535.00 FORMAT "%8.2" /end CHARACTERISTIC
/begin CHARACTERISTIC DFES_DTCO.DFC_UEGOSCGS1B1_C "OBD specific trouble code / OBD specific diagnostic trouble code for check DFC_UEGOSCGS1B1" VALUE 0x804F9500 Val_Wu16 65535.00 DFES_OneToOne 0.00 65535.00 FORMAT "%8.2" /end CHARACTERISTIC
/begin CHARACTERISTIC DFES_DTCO.DFC_UEGOSPIS1B1_C "OBD specific trouble code / OBD specific diagnostic trouble code for check DFC_UEGOSPIS1B1" VALUE 0x804F9502 Val_Wu16 65535.00 DFES_OneToOne 0.00 65535.00 FORMAT "%8.2" /end CHARACTERISTIC
/begin CHARACTERISTIC DFES_DTCO.DFC_UEGOSnsrS1B1_C "OBD specific trouble code / OBD specific diagnostic trouble code for check DFC_UEGOSnsrS1B1" VALUE 0x804F9504 Val_Wu16 65535.00 DFES_OneToOne 0.00 65535.00 FORMAT "%8.2" /end CHARACTERISTIC
/begin CHARACTERISTIC DFES_DTCO.DFC_UegoOlApesS1B1_C "OBD specific trouble code / OBD specific diagnostic trouble code for check DFC_UegoOlApesS1B1" VALUE 0x804F9506 Val_Wu16 65535.00 DFES_OneToOne 0.00 65535.00 FORMAT "%8.2" /end CHARACTERISTIC
/begin CHARACTERISTIC DFES_DTCO.DFC_UegoOlRCmpS1B1_C "OBD specific trouble code / OBD specific diagnostic trouble code for check DFC_UegoOlRCmpS1B1" VALUE 0x804F9508 Val_Wu16 65535.00 DFES_OneToOne 0.00 65535.00 FORMAT "%8.2" /end CHARACTERISTIC
/begin CHARACTERISTIC DFES_DTCO.DFC_AirCCmprOL_C "OBD specific trouble code / OBD specific diagnostic trouble code for check DFC_AirCCmprOL" VALUE 0x804F950A Val_Wu16 65535.00 DFES_OneToOne 0.00 65535.00 FORMAT "%8.2" /end CHARACTERISTIC
/begin CHARACTERISTIC DFES_DTCO.DFC_AirCCmprOvrTemp_C "OBD specific trouble code / OBD specific diagnostic trouble code for check DFC_AirCCmprOvrTemp" VALUE 0x804F950C Val_Wu16 65535.00 DFES_OneToOne 0.00 65535.00 FORMAT "%8.2" /end CHARACTERISTIC
/begin CHARACTERISTIC DFES_DTCO.DFC_AirCCmprSCB_C "OBD specific trouble code / OBD specific diagnostic trouble code for check DFC_AirCCmprSCB" VALUE 0x804F950E Val_Wu16 65535.00 DFES_OneToOne 0.00 65535.00 FORMAT "%8.2" /end CHARACTERISTIC
/begin CHARACTERISTIC DFES_DTCO.DFC_AirCCmprSCG_C "OBD specific trouble code / OBD specific diagnostic trouble code for check DFC_AirCCmprSCG" VALUE 0x804F9510 Val_Wu16 65535.00 DFES_OneToOne 0.00 65535.00 FORMAT "%8.2" /end CHARACTERISTIC
/begin CHARACTERISTIC DFES_DTCO.DFC_AltErr_C "OBD specific trouble code / OBD specific diagnostic trouble code for check DFC_AltErr" VALUE 0x804F9512 Val_Wu16 65535.00 DFES_OneToOne 0.00 65535.00 FORMAT "%8.2" /end CHARACTERISTIC
/begin CHARACTERISTIC DFES_DTCO.DFC_BattUSRCMax_C "OBD specific trouble code / OBD specific diagnostic trouble code for check DFC_BattUSRCMax" VALUE 0x804F9514 Val_Wu16 65535.00 DFES_OneToOne 0.00 65535.00 FORMAT "%8.2" /end CHARACTERISTIC
/begin CHARACTERISTIC DFES_DTCO.DFC_BattUSRCMin_C "OBD specific trouble code / OBD specific diagnostic trouble code for check DFC_BattUSRCMin" VALUE 0x804F9516 Val_Wu16 65535.00 DFES_OneToOne 0.00 65535.00 FORMAT "%8.2" /end CHARACTERISTIC
/begin CHARACTERISTIC DFES_DTCO.DFC_ComChksTCU1_C "OBD specific trouble code / OBD specific diagnostic trouble code for check DFC_ComChksTCU1" VALUE 0x804F9518 Val_Wu16 65535.00 DFES_OneToOne 0.00 65535.00 FORMAT "%8.2" /end CHARACTERISTIC
/begin CHARACTERISTIC DFES_DTCO.DFC_ComChksTCU11_C "OBD specific trouble code / OBD specific diagnostic trouble code for check DFC_ComChksTCU11" VALUE 0x804F951A Val_Wu16 65535.00 DFES_OneToOne 0.00 65535.00 FORMAT "%8.2" /end CHARACTERISTIC
/begin CHARACTERISTIC DFES_DTCO.DFC_ComChksTCU12_C "OBD specific trouble code / OBD specific diagnostic trouble code for check DFC_ComChksTCU12" VALUE 0x804F951C Val_Wu16 65535.00 DFES_OneToOne 0.00 65535.00 FORMAT "%8.2" /end CHARACTERISTIC
/begin CHARACTERISTIC DFES_DTCO.DFC_ComChksTCU13_C "OBD specific trouble code / OBD specific diagnostic trouble code for check DFC_ComChksTCU13" VALUE 0x804F951E Val_Wu16 65535.00 DFES_OneToOne 0.00 65535.00 FORMAT "%8.2" /end CHARACTERISTIC
/begin CHARACTERISTIC DFES_DTCO.DFC_ComChksTCU2_C "OBD specific trouble code / OBD specific diagnostic trouble code for check DFC_ComChksTCU2" VALUE 0x804F9520 Val_Wu16 65535.00 DFES_OneToOne 0.00 65535.00 FORMAT "%8.2" /end CHARACTERISTIC
/begin CHARACTERISTIC DFES_DTCO.DFC_ComChksTCU3_C "OBD specific trouble code / OBD specific diagnostic trouble code for check DFC_ComChksTCU3" VALUE 0x804F9522 Val_Wu16 65535.00 DFES_OneToOne 0.00 65535.00 FORMAT "%8.2" /end CHARACTERISTIC
/begin CHARACTERISTIC DFES_DTCO.DFC_ComChksTCU4_C "OBD specific trouble code / OBD specific diagnostic trouble code for check DFC_ComChksTCU4" VALUE 0x804F9524 Val_Wu16 65535.00 DFES_OneToOne 0.00 65535.00 FORMAT "%8.2" /end CHARACTERISTIC
/begin CHARACTERISTIC DFES_DTCO.DFC_ComCntTCU1_C "OBD specific trouble code / OBD specific diagnostic trouble code for check DFC_ComCntTCU1" VALUE 0x804F9526 Val_Wu16 65535.00 DFES_OneToOne 0.00 65535.00 FORMAT "%8.2" /end CHARACTERISTIC
/begin CHARACTERISTIC DFES_DTCO.DFC_ComCntTCU11_C "OBD specific trouble code / OBD specific diagnostic trouble code for check DFC_ComCntTCU11" VALUE 0x804F9528 Val_Wu16 65535.00 DFES_OneToOne 0.00 65535.00 FORMAT "%8.2" /end CHARACTERISTIC
/begin CHARACTERISTIC DFES_DTCO.DFC_ComCntTCU12_C "OBD specific trouble code / OBD specific diagnostic trouble code for check DFC_ComCntTCU12" VALUE 0x804F952A Val_Wu16 65535.00 DFES_OneToOne 0.00 65535.00 FORMAT "%8.2" /end CHARACTERISTIC
/begin CHARACTERISTIC DFES_DTCO.DFC_ComCntTCU13_C "OBD specific trouble code / OBD specific diagnostic trouble code for check DFC_ComCntTCU13" VALUE 0x804F952C Val_Wu16 65535.00 DFES_OneToOne 0.00 65535.00 FORMAT "%8.2" /end CHARACTERISTIC
/begin CHARACTERISTIC DFES_DTCO.DFC_ComCntTCU2_C "OBD specific trouble code / OBD specific diagnostic trouble code for check DFC_ComCntTCU2" VALUE 0x804F952E Val_Wu16 65535.00 DFES_OneToOne 0.00 65535.00 FORMAT "%8.2" /end CHARACTERISTIC
/begin CHARACTERISTIC DFES_DTCO.DFC_ComCntTCU3_C "OBD specific trouble code / OBD specific diagnostic trouble code for check DFC_ComCntTCU3" VALUE 0x804F9530 Val_Wu16 65535.00 DFES_OneToOne 0.00 65535.00 FORMAT "%8.2" /end CHARACTERISTIC
/begin CHARACTERISTIC DFES_DTCO.DFC_ComCntTCU4_C "OBD specific trouble code / OBD specific diagnostic trouble code for check DFC_ComCntTCU4" VALUE 0x804F9532 Val_Wu16 65535.00 DFES_OneToOne 0.00 65535.00 FORMAT "%8.2" /end CHARACTERISTIC
/begin CHARACTERISTIC DFES_DTCO.DFC_ComTOutTCU01_C "OBD specific trouble code / OBD specific diagnostic trouble code for check DFC_ComTOutTCU01" VALUE 0x804F9534 Val_Wu16 65535.00 DFES_OneToOne 0.00 65535.00 FORMAT "%8.2" /end CHARACTERISTIC
/begin CHARACTERISTIC DFES_DTCO.DFC_ComTOutTCU02_C "OBD specific trouble code / OBD specific diagnostic trouble code for check DFC_ComTOutTCU02" VALUE 0x804F9536 Val_Wu16 65535.00 DFES_OneToOne 0.00 65535.00 FORMAT "%8.2" /end CHARACTERISTIC
/begin CHARACTERISTIC DFES_DTCO.DFC_ComTOutTCU1_C "OBD specific trouble code / OBD specific diagnostic trouble code for check DFC_ComTOutTCU1" VALUE 0x804F9538 Val_Wu16 65535.00 DFES_OneToOne 0.00 65535.00 FORMAT "%8.2" /end CHARACTERISTIC
/begin CHARACTERISTIC DFES_DTCO.DFC_ComTOutTCU11_C "OBD specific trouble code / OBD specific diagnostic trouble code for check DFC_ComTOutTCU11" VALUE 0x804F953A Val_Wu16 65535.00 DFES_OneToOne 0.00 65535.00 FORMAT "%8.2" /end CHARACTERISTIC
/begin CHARACTERISTIC DFES_DTCO.DFC_ComTOutTCU12_C "OBD specific trouble code / OBD specific diagnostic trouble code for check DFC_ComTOutTCU12" VALUE 0x804F953C Val_Wu16 65535.00 DFES_OneToOne 0.00 65535.00 FORMAT "%8.2" /end CHARACTERISTIC
/begin CHARACTERISTIC DFES_DTCO.DFC_ComTOutTCU13_C "OBD specific trouble code / OBD specific diagnostic trouble code for check DFC_ComTOutTCU13" VALUE 0x804F953E Val_Wu16 65535.00 DFES_OneToOne 0.00 65535.00 FORMAT "%8.2" /end CHARACTERISTIC
/begin CHARACTERISTIC DFES_DTCO.DFC_ComTOutTCU14_C "OBD specific trouble code / OBD specific diagnostic trouble code for check DFC_ComTOutTCU14" VALUE 0x804F9540 Val_Wu16 65535.00 DFES_OneToOne 0.00 65535.00 FORMAT "%8.2" /end CHARACTERISTIC
/begin CHARACTERISTIC DFES_DTCO.DFC_ComTOutTCU2_C "OBD specific trouble code / OBD specific diagnostic trouble code for check DFC_ComTOutTCU2" VALUE 0x804F9542 Val_Wu16 65535.00 DFES_OneToOne 0.00 65535.00 FORMAT "%8.2" /end CHARACTERISTIC
/begin CHARACTERISTIC DFES_DTCO.DFC_ComTOutTCU3_C "OBD specific trouble code / OBD specific diagnostic trouble code for check DFC_ComTOutTCU3" VALUE 0x804F9544 Val_Wu16 65535.00 DFES_OneToOne 0.00 65535.00 FORMAT "%8.2" /end CHARACTERISTIC
/begin CHARACTERISTIC DFES_DTCO.DFC_ComTOutTCU4_C "OBD specific trouble code / OBD specific diagnostic trouble code for check DFC_ComTOutTCU4" VALUE 0x804F9546 Val_Wu16 65535.00 DFES_OneToOne 0.00 65535.00 FORMAT "%8.2" /end CHARACTERISTIC
/begin CHARACTERISTIC DFES_DTCO.DFC_DevLibBattUHi_C "OBD specific trouble code / OBD specific diagnostic trouble code for check DFC_DevLibBattUHi" VALUE 0x804F9548 Val_Wu16 65535.00 DFES_OneToOne 0.00 65535.00 FORMAT "%8.2" /end CHARACTERISTIC
/begin CHARACTERISTIC DFES_DTCO.DFC_DevLibBattULo_C "OBD specific trouble code / OBD specific diagnostic trouble code for check DFC_DevLibBattULo" VALUE 0x804F954A Val_Wu16 65535.00 DFES_OneToOne 0.00 65535.00 FORMAT "%8.2" /end CHARACTERISTIC
/begin CHARACTERISTIC DFES_DTCO.DFC_FanDIOOL_0_C "OBD specific trouble code / OBD specific diagnostic trouble code for check DFC_FanDIOOL_0" VALUE 0x804F954C Val_Wu16 65535.00 DFES_OneToOne 0.00 65535.00 FORMAT "%8.2" /end CHARACTERISTIC
/begin CHARACTERISTIC DFES_DTCO.DFC_FanDIOOL_1_C "OBD specific trouble code / OBD specific diagnostic trouble code for check DFC_FanDIOOL_1" VALUE 0x804F954E Val_Wu16 65535.00 DFES_OneToOne 0.00 65535.00 FORMAT "%8.2" /end CHARACTERISTIC
/begin CHARACTERISTIC DFES_DTCO.DFC_FanDIOOvrTemp_0_C "OBD specific trouble code / OBD specific diagnostic trouble code for check DFC_FanDIOOvrTemp_0" VALUE 0x804F9550 Val_Wu16 65535.00 DFES_OneToOne 0.00 65535.00 FORMAT "%8.2" /end CHARACTERISTIC
/begin CHARACTERISTIC DFES_DTCO.DFC_FanDIOOvrTemp_1_C "OBD specific trouble code / OBD specific diagnostic trouble code for check DFC_FanDIOOvrTemp_1" VALUE 0x804F9552 Val_Wu16 65535.00 DFES_OneToOne 0.00 65535.00 FORMAT "%8.2" /end CHARACTERISTIC
/begin CHARACTERISTIC DFES_DTCO.DFC_FanDIOSCB_0_C "OBD specific trouble code / OBD specific diagnostic trouble code for check DFC_FanDIOSCB_0" VALUE 0x804F9554 Val_Wu16 65535.00 DFES_OneToOne 0.00 65535.00 FORMAT "%8.2" /end CHARACTERISTIC
/begin CHARACTERISTIC DFES_DTCO.DFC_FanDIOSCB_1_C "OBD specific trouble code / OBD specific diagnostic trouble code for check DFC_FanDIOSCB_1" VALUE 0x804F9556 Val_Wu16 65535.00 DFES_OneToOne 0.00 65535.00 FORMAT "%8.2" /end CHARACTERISTIC
/begin CHARACTERISTIC DFES_DTCO.DFC_FanDIOSCG_0_C "OBD specific trouble code / OBD specific diagnostic trouble code for check DFC_FanDIOSCG_0" VALUE 0x804F9558 Val_Wu16 65535.00 DFES_OneToOne 0.00 65535.00 FORMAT "%8.2" /end CHARACTERISTIC
/begin CHARACTERISTIC DFES_DTCO.DFC_FanDIOSCG_1_C "OBD specific trouble code / OBD specific diagnostic trouble code for check DFC_FanDIOSCG_1" VALUE 0x804F955A Val_Wu16 65535.00 DFES_OneToOne 0.00 65535.00 FORMAT "%8.2" /end CHARACTERISTIC
/begin CHARACTERISTIC DFES_DTCO.DFC_MRlyDcOL_C "OBD specific trouble code / OBD specific diagnostic trouble code for check DFC_MRlyDcOL" VALUE 0x804F955C Val_Wu16 65535.00 DFES_OneToOne 0.00 65535.00 FORMAT "%8.2" /end CHARACTERISTIC
/begin CHARACTERISTIC DFES_DTCO.DFC_MRlyDcSCB_C "OBD specific trouble code / OBD specific diagnostic trouble code for check DFC_MRlyDcSCB" VALUE 0x804F955E Val_Wu16 65535.00 DFES_OneToOne 0.00 65535.00 FORMAT "%8.2" /end CHARACTERISTIC
/begin CHARACTERISTIC DFES_DTCO.DFC_MRlyDcSCG_C "OBD specific trouble code / OBD specific diagnostic trouble code for check DFC_MRlyDcSCG" VALUE 0x804F9560 Val_Wu16 65535.00 DFES_OneToOne 0.00 65535.00 FORMAT "%8.2" /end CHARACTERISTIC
/begin CHARACTERISTIC DFES_DTCO.DFC_PSPOL_C "OBD specific trouble code / OBD specific diagnostic trouble code for check DFC_PSPOL" VALUE 0x804F9562 Val_Wu16 65535.00 DFES_OneToOne 0.00 65535.00 FORMAT "%8.2" /end CHARACTERISTIC
/begin CHARACTERISTIC DFES_DTCO.DFC_PSPOvrTemp_C "OBD specific trouble code / OBD specific diagnostic trouble code for check DFC_PSPOvrTemp" VALUE 0x804F9564 Val_Wu16 65535.00 DFES_OneToOne 0.00 65535.00 FORMAT "%8.2" /end CHARACTERISTIC
/begin CHARACTERISTIC DFES_DTCO.DFC_PSPSCB_C "OBD specific trouble code / OBD specific diagnostic trouble code for check DFC_PSPSCB" VALUE 0x804F9566 Val_Wu16 65535.00 DFES_OneToOne 0.00 65535.00 FORMAT "%8.2" /end CHARACTERISTIC
/begin CHARACTERISTIC DFES_DTCO.DFC_PSPSCG_C "OBD specific trouble code / OBD specific diagnostic trouble code for check DFC_PSPSCG" VALUE 0x804F9568 Val_Wu16 65535.00 DFES_OneToOne 0.00 65535.00 FORMAT "%8.2" /end CHARACTERISTIC
/begin CHARACTERISTIC DFES_DTCO.DFC_T50Err_C "OBD specific trouble code / OBD specific diagnostic trouble code for check DFC_T50Err" VALUE 0x804F956A Val_Wu16 65535.00 DFES_OneToOne 0.00 65535.00 FORMAT "%8.2" /end CHARACTERISTIC
/begin CHARACTERISTIC DFES_DTCO.DFC_ThrVlvLoBattB1_C "OBD specific trouble code / OBD specific diagnostic trouble code for check DFC_ThrVlvLoBattB1" VALUE 0x804F956C Val_Wu16 65535.00 DFES_OneToOne 0.00 65535.00 FORMAT "%8.2" /end CHARACTERISTIC
/begin CHARACTERISTIC DFES_DTCO.DFC_VehVPhysRngHi_C "OBD specific trouble code / OBD specific diagnostic trouble code for check DFC_VehVPhysRngHi" VALUE 0x804F956E Val_Wu16 65535.00 DFES_OneToOne 0.00 65535.00 FORMAT "%8.2" /end CHARACTERISTIC
/begin CHARACTERISTIC DFES_DTCO.DFC_VehVSclOutOL_C "OBD specific trouble code / OBD specific diagnostic trouble code for check DFC_VehVSclOutOL" VALUE 0x804F9570 Val_Wu16 65535.00 DFES_OneToOne 0.00 65535.00 FORMAT "%8.2" /end CHARACTERISTIC
/begin CHARACTERISTIC DFES_DTCO.DFC_VehVSclOutOT_C "OBD specific trouble code / OBD specific diagnostic trouble code for check DFC_VehVSclOutOT" VALUE 0x804F9572 Val_Wu16 65535.00 DFES_OneToOne 0.00 65535.00 FORMAT "%8.2" /end CHARACTERISTIC
/begin CHARACTERISTIC DFES_DTCO.DFC_VehVSclOutSCB_C "OBD specific trouble code / OBD specific diagnostic trouble code for check DFC_VehVSclOutSCB" VALUE 0x804F9574 Val_Wu16 65535.00 DFES_OneToOne 0.00 65535.00 FORMAT "%8.2" /end CHARACTERISTIC
/begin CHARACTERISTIC DFES_DTCO.DFC_VehVSclOutSCG_C "OBD specific trouble code / OBD specific diagnostic trouble code for check DFC_VehVSclOutSCG" VALUE 0x804F9576 Val_Wu16 65535.00 DFES_OneToOne 0.00 65535.00 FORMAT "%8.2" /end CHARACTERISTIC
/begin CHARACTERISTIC DFES_DTCO.DFC_VehVSnsrARngHi_C "OBD specific trouble code / OBD specific diagnostic trouble code for check DFC_VehVSnsrARngHi" VALUE 0x804F9578 Val_Wu16 65535.00 DFES_OneToOne 0.00 65535.00 FORMAT "%8.2" /end CHARACTERISTIC
/begin CHARACTERISTIC DFES_DTCO.DFC_VehVSnsrBRngHi_C "OBD specific trouble code / OBD specific diagnostic trouble code for check DFC_VehVSnsrBRngHi" VALUE 0x804F957A Val_Wu16 65535.00 DFES_OneToOne 0.00 65535.00 FORMAT "%8.2" /end CHARACTERISTIC
/begin CHARACTERISTIC DFES_DTCO.DFC_VehVSpdRtyDiag_C "OBD specific trouble code / OBD specific diagnostic trouble code for check DFC_VehVSpdRtyDiag" VALUE 0x804F957C Val_Wu16 65535.00 DFES_OneToOne 0.00 65535.00 FORMAT "%8.2" /end CHARACTERISTIC
/begin CHARACTERISTIC DFES_DTCO.DFC_VehVWhlErr_C "OBD specific trouble code / OBD specific diagnostic trouble code for check DFC_VehVWhlErr" VALUE 0x804F957E Val_Wu16 65535.00 DFES_OneToOne 0.00 65535.00 FORMAT "%8.2" /end CHARACTERISTIC
/begin CHARACTERISTIC DFES_DTCO.DFC_ACEvpTSRCMax_C "OBD specific trouble code / OBD specific diagnostic trouble code for check DFC_ACEvpTSRCMax" VALUE 0x804F9580 Val_Wu16 65535.00 DFES_OneToOne 0.00 65535.00 FORMAT "%8.2" /end CHARACTERISTIC
/begin CHARACTERISTIC DFES_DTCO.DFC_ACEvpTSRCMin_C "OBD specific trouble code / OBD specific diagnostic trouble code for check DFC_ACEvpTSRCMin" VALUE 0x804F9582 Val_Wu16 65535.00 DFES_OneToOne 0.00 65535.00 FORMAT "%8.2" /end CHARACTERISTIC
/begin CHARACTERISTIC DFES_DTCO.DFC_AirCClntPAnaSRCMax_C "OBD specific trouble code / OBD specific diagnostic trouble code for check DFC_AirCClntPAnaSRCMax" VALUE 0x804F9584 Val_Wu16 65535.00 DFES_OneToOne 0.00 65535.00 FORMAT "%8.2" /end CHARACTERISTIC
/begin CHARACTERISTIC DFES_DTCO.DFC_AirCClntPAnaSRCMin_C "OBD specific trouble code / OBD specific diagnostic trouble code for check DFC_AirCClntPAnaSRCMin" VALUE 0x804F9586 Val_Wu16 65535.00 DFES_OneToOne 0.00 65535.00 FORMAT "%8.2" /end CHARACTERISTIC
/begin CHARACTERISTIC DFES_DTCO.DFC_AirCSwtNpl_C "OBD specific trouble code / OBD specific diagnostic trouble code for check DFC_AirCSwtNpl" VALUE 0x804F9588 Val_Wu16 65535.00 DFES_OneToOne 0.00 65535.00 FORMAT "%8.2" /end CHARACTERISTIC
/begin CHARACTERISTIC DFES_DTCO.DFC_AirCSwtSig_C "OBD specific trouble code / OBD specific diagnostic trouble code for check DFC_AirCSwtSig" VALUE 0x804F958A Val_Wu16 65535.00 DFES_OneToOne 0.00 65535.00 FORMAT "%8.2" /end CHARACTERISTIC
/begin CHARACTERISTIC DFES_DTCO.DFC_Brk_C "OBD specific trouble code / OBD specific diagnostic trouble code for check DFC_Brk" VALUE 0x804F958C Val_Wu16 65535.00 DFES_OneToOne 0.00 65535.00 FORMAT "%8.2" /end CHARACTERISTIC
/begin CHARACTERISTIC DFES_DTCO.DFC_BrkSig_C "OBD specific trouble code / OBD specific diagnostic trouble code for check DFC_BrkSig" VALUE 0x804F958E Val_Wu16 65535.00 DFES_OneToOne 0.00 65535.00 FORMAT "%8.2" /end CHARACTERISTIC
/begin CHARACTERISTIC DFES_DTCO.DFC_ClthSig_C "OBD specific trouble code / OBD specific diagnostic trouble code for check DFC_ClthSig" VALUE 0x804F9590 Val_Wu16 65535.00 DFES_OneToOne 0.00 65535.00 FORMAT "%8.2" /end CHARACTERISTIC
/begin CHARACTERISTIC DFES_DTCO.DFC_HLSDemOvhtEngLim_C "OBD specific trouble code / OBD specific diagnostic trouble code for check DFC_HLSDemOvhtEngLim" VALUE 0x804F9592 Val_Wu16 65535.00 DFES_OneToOne 0.00 65535.00 FORMAT "%8.2" /end CHARACTERISTIC
/begin CHARACTERISTIC DFES_DTCO.DFC_OilPNpl_C "OBD specific trouble code / OBD specific diagnostic trouble code for check DFC_OilPNpl" VALUE 0x804F9594 Val_Wu16 65535.00 DFES_OneToOne 0.00 65535.00 FORMAT "%8.2" /end CHARACTERISTIC
/begin CHARACTERISTIC DFES_DTCO.DFC_PIntkVUsLineHiB1_C "OBD specific trouble code / OBD specific diagnostic trouble code for check DFC_PIntkVUsLineHiB1" VALUE 0x804F9596 Val_Wu16 65535.00 DFES_OneToOne 0.00 65535.00 FORMAT "%8.2" /end CHARACTERISTIC
/begin CHARACTERISTIC DFES_DTCO.DFC_PIntkVUsLineLoB1_C "OBD specific trouble code / OBD specific diagnostic trouble code for check DFC_PIntkVUsLineLoB1" VALUE 0x804F9598 Val_Wu16 65535.00 DFES_OneToOne 0.00 65535.00 FORMAT "%8.2" /end CHARACTERISTIC
/begin CHARACTERISTIC DFES_DTCO.DFC_VehVPhysRngLo_C "OBD specific trouble code / OBD specific diagnostic trouble code for check DFC_VehVPhysRngLo" VALUE 0x804F959A Val_Wu16 65535.00 DFES_OneToOne 0.00 65535.00 FORMAT "%8.2" /end CHARACTERISTIC
/begin CHARACTERISTIC DFES_DTCO.DFC_VehVSigCan_C "OBD specific trouble code / OBD specific diagnostic trouble code for check DFC_VehVSigCan" VALUE 0x804F959C Val_Wu16 65535.00 DFES_OneToOne 0.00 65535.00 FORMAT "%8.2" /end CHARACTERISTIC
/begin CHARACTERISTIC DFES_DTCO.DFC_VehVSigCanSafe_C "OBD specific trouble code / OBD specific diagnostic trouble code for check DFC_VehVSigCanSafe" VALUE 0x804F959E Val_Wu16 65535.00 DFES_OneToOne 0.00 65535.00 FORMAT "%8.2" /end CHARACTERISTIC
/begin CHARACTERISTIC DFES_DTCO.DFC_VlvLftFbOilPSnsrIntk11SRCMax_C "OBD specific trouble code / OBD specific diagnostic trouble code for check DFC_VlvLftFbOilPSnsrIntk11SRCMax" VALUE 0x804F95A0 Val_Wu16 65535.00 DFES_OneToOne 0.00 65535.00 FORMAT "%8.2" /end CHARACTERISTIC
/begin CHARACTERISTIC DFES_DTCO.DFC_VlvLftFbOilPSnsrIntk11SRCMin_C "OBD specific trouble code / OBD specific diagnostic trouble code for check DFC_VlvLftFbOilPSnsrIntk11SRCMin" VALUE 0x804F95A2 Val_Wu16 65535.00 DFES_OneToOne 0.00 65535.00 FORMAT "%8.2" /end CHARACTERISTIC
/begin CHARACTERISTIC DFES_DTCO.DFC_ClthNpl_C "OBD specific trouble code / OBD specific diagnostic trouble code for check DFC_ClthNpl" VALUE 0x804F95A4 Val_Wu16 65535.00 DFES_OneToOne 0.00 65535.00 FORMAT "%8.2" /end CHARACTERISTIC
/begin CHARACTERISTIC DFES_DTCO.DFC_EV1max_C "OBD specific trouble code / OBD specific diagnostic trouble code for check DFC_EV1max" VALUE 0x804F95A6 Val_Wu16 65535.00 DFES_OneToOne 0.00 65535.00 FORMAT "%8.2" /end CHARACTERISTIC
/begin CHARACTERISTIC DFES_DTCO.DFC_EV1min_C "OBD specific trouble code / OBD specific diagnostic trouble code for check DFC_EV1min" VALUE 0x804F95A8 Val_Wu16 65535.00 DFES_OneToOne 0.00 65535.00 FORMAT "%8.2" /end CHARACTERISTIC
/begin CHARACTERISTIC DFES_DTCO.DFC_EV1sig_C "OBD specific trouble code / OBD specific diagnostic trouble code for check DFC_EV1sig" VALUE 0x804F95AA Val_Wu16 65535.00 DFES_OneToOne 0.00 65535.00 FORMAT "%8.2" /end CHARACTERISTIC
/begin CHARACTERISTIC DFES_DTCO.DFC_EV2max_C "OBD specific trouble code / OBD specific diagnostic trouble code for check DFC_EV2max" VALUE 0x804F95AC Val_Wu16 65535.00 DFES_OneToOne 0.00 65535.00 FORMAT "%8.2" /end CHARACTERISTIC
/begin CHARACTERISTIC DFES_DTCO.DFC_EV2min_C "OBD specific trouble code / OBD specific diagnostic trouble code for check DFC_EV2min" VALUE 0x804F95AE Val_Wu16 65535.00 DFES_OneToOne 0.00 65535.00 FORMAT "%8.2" /end CHARACTERISTIC
/begin CHARACTERISTIC DFES_DTCO.DFC_EV2sig_C "OBD specific trouble code / OBD specific diagnostic trouble code for check DFC_EV2sig" VALUE 0x804F95B0 Val_Wu16 65535.00 DFES_OneToOne 0.00 65535.00 FORMAT "%8.2" /end CHARACTERISTIC
/begin CHARACTERISTIC DFES_DTCO.DFC_EV3max_C "OBD specific trouble code / OBD specific diagnostic trouble code for check DFC_EV3max" VALUE 0x804F95B2 Val_Wu16 65535.00 DFES_OneToOne 0.00 65535.00 FORMAT "%8.2" /end CHARACTERISTIC
/begin CHARACTERISTIC DFES_DTCO.DFC_EV3min_C "OBD specific trouble code / OBD specific diagnostic trouble code for check DFC_EV3min" VALUE 0x804F95B4 Val_Wu16 65535.00 DFES_OneToOne 0.00 65535.00 FORMAT "%8.2" /end CHARACTERISTIC
/begin CHARACTERISTIC DFES_DTCO.DFC_EV3sig_C "OBD specific trouble code / OBD specific diagnostic trouble code for check DFC_EV3sig" VALUE 0x804F95B6 Val_Wu16 65535.00 DFES_OneToOne 0.00 65535.00 FORMAT "%8.2" /end CHARACTERISTIC
/begin CHARACTERISTIC DFES_DTCO.DFC_EV4max_C "OBD specific trouble code / OBD specific diagnostic trouble code for check DFC_EV4max" VALUE 0x804F95B8 Val_Wu16 65535.00 DFES_OneToOne 0.00 65535.00 FORMAT "%8.2" /end CHARACTERISTIC
/begin CHARACTERISTIC DFES_DTCO.DFC_EV4min_C "OBD specific trouble code / OBD specific diagnostic trouble code for check DFC_EV4min" VALUE 0x804F95BA Val_Wu16 65535.00 DFES_OneToOne 0.00 65535.00 FORMAT "%8.2" /end CHARACTERISTIC
/begin CHARACTERISTIC DFES_DTCO.DFC_EV4sig_C "OBD specific trouble code / OBD specific diagnostic trouble code for check DFC_EV4sig" VALUE 0x804F95BC Val_Wu16 65535.00 DFES_OneToOne 0.00 65535.00 FORMAT "%8.2" /end CHARACTERISTIC
/begin CHARACTERISTIC DFES_DTCO.DFC_GbxPNPosnDrvCdn_C "OBD specific trouble code / OBD specific diagnostic trouble code for check DFC_GbxPNPosnDrvCdn" VALUE 0x804F95BE Val_Wu16 65535.00 DFES_OneToOne 0.00 65535.00 FORMAT "%8.2" /end CHARACTERISTIC
/begin CHARACTERISTIC DFES_DTCO.DFC_GbxPNPosnPlausy_C "OBD specific trouble code / OBD specific diagnostic trouble code for check DFC_GbxPNPosnPlausy" VALUE 0x804F95C0 Val_Wu16 65535.00 DFES_OneToOne 0.00 65535.00 FORMAT "%8.2" /end CHARACTERISTIC
/begin CHARACTERISTIC DFES_DTCO.DFC_PEnvCcMax_C "OBD specific trouble code / OBD specific diagnostic trouble code for check DFC_PEnvCcMax" VALUE 0x804F95C2 Val_Wu16 65535.00 DFES_OneToOne 0.00 65535.00 FORMAT "%8.2" /end CHARACTERISTIC
/begin CHARACTERISTIC DFES_DTCO.DFC_PEnvCcMin_C "OBD specific trouble code / OBD specific diagnostic trouble code for check DFC_PEnvCcMin" VALUE 0x804F95C4 Val_Wu16 65535.00 DFES_OneToOne 0.00 65535.00 FORMAT "%8.2" /end CHARACTERISTIC
/begin CHARACTERISTIC DFES_DTCO.DFC_PEnvRngChkMax_C "OBD specific trouble code / OBD specific diagnostic trouble code for check DFC_PEnvRngChkMax" VALUE 0x804F95C6 Val_Wu16 65535.00 DFES_OneToOne 0.00 65535.00 FORMAT "%8.2" /end CHARACTERISTIC
/begin CHARACTERISTIC DFES_DTCO.DFC_PEnvRngChkMin_C "OBD specific trouble code / OBD specific diagnostic trouble code for check DFC_PEnvRngChkMin" VALUE 0x804F95C8 Val_Wu16 65535.00 DFES_OneToOne 0.00 65535.00 FORMAT "%8.2" /end CHARACTERISTIC
/begin CHARACTERISTIC DFES_DTCO.DFC_PEnvSnsrPlaus_C "OBD specific trouble code / OBD specific diagnostic trouble code for check DFC_PEnvSnsrPlaus" VALUE 0x804F95CA Val_Wu16 65535.00 DFES_OneToOne 0.00 65535.00 FORMAT "%8.2" /end CHARACTERISTIC
/begin CHARACTERISTIC DFES_DTCO.DFC_UEGOHeatrPsS1B1Max_C "OBD specific trouble code / OBD specific diagnostic trouble code for check DFC_UEGOHeatrPsS1B1Max" VALUE 0x804F95CC Val_Wu16 65535.00 DFES_OneToOne 0.00 65535.00 FORMAT "%8.2" /end CHARACTERISTIC
/begin CHARACTERISTIC DFES_DTCO.DFC_UEGOHeatrPsS1B1Min_C "OBD specific trouble code / OBD specific diagnostic trouble code for check DFC_UEGOHeatrPsS1B1Min" VALUE 0x804F95CE Val_Wu16 65535.00 DFES_OneToOne 0.00 65535.00 FORMAT "%8.2" /end CHARACTERISTIC
/begin CHARACTERISTIC DFES_DTCO.DFC_UEGOHeatrPsS1B1Sig_C "OBD specific trouble code / OBD specific diagnostic trouble code for check DFC_UEGOHeatrPsS1B1Sig" VALUE 0x804F95D0 Val_Wu16 65535.00 DFES_OneToOne 0.00 65535.00 FORMAT "%8.2" /end CHARACTERISTIC
/begin CHARACTERISTIC DFES_DTCO.DFC_UEGOHeatrRlyPsOLS1B1_C "OBD specific trouble code / OBD specific diagnostic trouble code for check DFC_UEGOHeatrRlyPsOLS1B1" VALUE 0x804F95D2 Val_Wu16 65535.00 DFES_OneToOne 0.00 65535.00 FORMAT "%8.2" /end CHARACTERISTIC
/begin CHARACTERISTIC DFES_DTCO.DFC_UEGOHeatrRlyPsSCBS1B1_C "OBD specific trouble code / OBD specific diagnostic trouble code for check DFC_UEGOHeatrRlyPsSCBS1B1" VALUE 0x804F95D4 Val_Wu16 65535.00 DFES_OneToOne 0.00 65535.00 FORMAT "%8.2" /end CHARACTERISTIC
/begin CHARACTERISTIC DFES_DTCO.DFC_UEGOHeatrRlyPsSCGS1B1_C "OBD specific trouble code / OBD specific diagnostic trouble code for check DFC_UEGOHeatrRlyPsSCGS1B1" VALUE 0x804F95D6 Val_Wu16 65535.00 DFES_OneToOne 0.00 65535.00 FORMAT "%8.2" /end CHARACTERISTIC
/begin CHARACTERISTIC DFES_DTCO.DFC_KnDetSens1PortAMax_C "OBD specific trouble code / OBD specific diagnostic trouble code for check DFC_KnDetSens1PortAMax" VALUE 0x804F95D8 Val_Wu16 65535.00 DFES_OneToOne 0.00 65535.00 FORMAT "%8.2" /end CHARACTERISTIC
/begin CHARACTERISTIC DFES_DTCO.DFC_KnDetSens1PortAMin_C "OBD specific trouble code / OBD specific diagnostic trouble code for check DFC_KnDetSens1PortAMin" VALUE 0x804F95DA Val_Wu16 65535.00 DFES_OneToOne 0.00 65535.00 FORMAT "%8.2" /end CHARACTERISTIC
/begin CHARACTERISTIC DFES_DTCO.DFC_KnDetSens1PortBMax_C "OBD specific trouble code / OBD specific diagnostic trouble code for check DFC_KnDetSens1PortBMax" VALUE 0x804F95DC Val_Wu16 65535.00 DFES_OneToOne 0.00 65535.00 FORMAT "%8.2" /end CHARACTERISTIC
/begin CHARACTERISTIC DFES_DTCO.DFC_KnDetSens1PortBMin_C "OBD specific trouble code / OBD specific diagnostic trouble code for check DFC_KnDetSens1PortBMin" VALUE 0x804F95DE Val_Wu16 65535.00 DFES_OneToOne 0.00 65535.00 FORMAT "%8.2" /end CHARACTERISTIC
/begin CHARACTERISTIC DFES_DTCO.DFC_Clth2ONStuck_C "OBD specific trouble code / OBD specific diagnostic trouble code for check DFC_Clth2ONStuck" VALUE 0x804F95E0 Val_Wu16 65535.00 DFES_OneToOne 0.00 65535.00 FORMAT "%8.2" /end CHARACTERISTIC
/begin CHARACTERISTIC DFES_DTCO.DFC_Clth2ONStuckLdc_C "OBD specific trouble code / OBD specific diagnostic trouble code for check DFC_Clth2ONStuckLdc" VALUE 0x804F95E2 Val_Wu16 65535.00 DFES_OneToOne 0.00 65535.00 FORMAT "%8.2" /end CHARACTERISTIC
/begin CHARACTERISTIC DFES_DTCO.DFC_Clth3ONStuckLdc_C "OBD specific trouble code / OBD specific diagnostic trouble code for check DFC_Clth3ONStuckLdc" VALUE 0x804F95E4 Val_Wu16 65535.00 DFES_OneToOne 0.00 65535.00 FORMAT "%8.2" /end CHARACTERISTIC
/begin CHARACTERISTIC DFES_DTCO.DFC_Clth3ONStuckPostDrv_C "OBD specific trouble code / OBD specific diagnostic trouble code for check DFC_Clth3ONStuckPostDrv" VALUE 0x804F95E6 Val_Wu16 65535.00 DFES_OneToOne 0.00 65535.00 FORMAT "%8.2" /end CHARACTERISTIC
/begin CHARACTERISTIC DFES_DTCO.DFC_Clth4ONStuck_C "OBD specific trouble code / OBD specific diagnostic trouble code for check DFC_Clth4ONStuck" VALUE 0x804F95E8 Val_Wu16 65535.00 DFES_OneToOne 0.00 65535.00 FORMAT "%8.2" /end CHARACTERISTIC
/begin CHARACTERISTIC DFES_DTCO.DFC_Clth4ONStuckLdc_C "OBD specific trouble code / OBD specific diagnostic trouble code for check DFC_Clth4ONStuckLdc" VALUE 0x804F95EA Val_Wu16 65535.00 DFES_OneToOne 0.00 65535.00 FORMAT "%8.2" /end CHARACTERISTIC
/begin CHARACTERISTIC DFES_DTCO.DFC_ComDLCTCU01_C "OBD specific trouble code / OBD specific diagnostic trouble code for check DFC_ComDLCTCU01" VALUE 0x804F95EC Val_Wu16 65535.00 DFES_OneToOne 0.00 65535.00 FORMAT "%8.2" /end CHARACTERISTIC
/begin CHARACTERISTIC DFES_DTCO.DFC_ComDLCTCU02_C "OBD specific trouble code / OBD specific diagnostic trouble code for check DFC_ComDLCTCU02" VALUE 0x804F95EE Val_Wu16 65535.00 DFES_OneToOne 0.00 65535.00 FORMAT "%8.2" /end CHARACTERISTIC
/begin CHARACTERISTIC DFES_DTCO.DFC_ComDLCTCU1_C "OBD specific trouble code / OBD specific diagnostic trouble code for check DFC_ComDLCTCU1" VALUE 0x804F95F0 Val_Wu16 65535.00 DFES_OneToOne 0.00 65535.00 FORMAT "%8.2" /end CHARACTERISTIC
/begin CHARACTERISTIC DFES_DTCO.DFC_ComDLCTCU11_C "OBD specific trouble code / OBD specific diagnostic trouble code for check DFC_ComDLCTCU11" VALUE 0x804F95F2 Val_Wu16 65535.00 DFES_OneToOne 0.00 65535.00 FORMAT "%8.2" /end CHARACTERISTIC
/begin CHARACTERISTIC DFES_DTCO.DFC_ComDLCTCU12_C "OBD specific trouble code / OBD specific diagnostic trouble code for check DFC_ComDLCTCU12" VALUE 0x804F95F4 Val_Wu16 65535.00 DFES_OneToOne 0.00 65535.00 FORMAT "%8.2" /end CHARACTERISTIC
/begin CHARACTERISTIC DFES_DTCO.DFC_ComDLCTCU13_C "OBD specific trouble code / OBD specific diagnostic trouble code for check DFC_ComDLCTCU13" VALUE 0x804F95F6 Val_Wu16 65535.00 DFES_OneToOne 0.00 65535.00 FORMAT "%8.2" /end CHARACTERISTIC
/begin CHARACTERISTIC DFES_DTCO.DFC_ComDLCTCU14_C "OBD specific trouble code / OBD specific diagnostic trouble code for check DFC_ComDLCTCU14" VALUE 0x804F95F8 Val_Wu16 65535.00 DFES_OneToOne 0.00 65535.00 FORMAT "%8.2" /end CHARACTERISTIC
/begin CHARACTERISTIC DFES_DTCO.DFC_ComDLCTCU2_C "OBD specific trouble code / OBD specific diagnostic trouble code for check DFC_ComDLCTCU2" VALUE 0x804F95FA Val_Wu16 65535.00 DFES_OneToOne 0.00 65535.00 FORMAT "%8.2" /end CHARACTERISTIC
/begin CHARACTERISTIC DFES_DTCO.DFC_ComDLCTCU3_C "OBD specific trouble code / OBD specific diagnostic trouble code for check DFC_ComDLCTCU3" VALUE 0x804F95FC Val_Wu16 65535.00 DFES_OneToOne 0.00 65535.00 FORMAT "%8.2" /end CHARACTERISTIC
/begin CHARACTERISTIC DFES_DTCO.DFC_ComDLCTCU4_C "OBD specific trouble code / OBD specific diagnostic trouble code for check DFC_ComDLCTCU4" VALUE 0x804F95FE Val_Wu16 65535.00 DFES_OneToOne 0.00 65535.00 FORMAT "%8.2" /end CHARACTERISTIC
/begin CHARACTERISTIC DFES_DTCO.DFC_EVX_C "OBD specific trouble code / OBD specific diagnostic trouble code for check DFC_EVX" VALUE 0x804F9600 Val_Wu16 65535.00 DFES_OneToOne 0.00 65535.00 FORMAT "%8.2" /end CHARACTERISTIC
/begin CHARACTERISTIC DFES_DTCO.DFC_EbsSocFlt_C "OBD specific trouble code / OBD specific diagnostic trouble code for check DFC_EbsSocFlt" VALUE 0x804F9602 Val_Wu16 65535.00 DFES_OneToOne 0.00 65535.00 FORMAT "%8.2" /end CHARACTERISTIC
/begin CHARACTERISTIC DFES_DTCO.DFC_I14229VINErr_C "OBD specific trouble code / OBD specific diagnostic trouble code for check DFC_I14229VINErr" VALUE 0x804F9604 Val_Wu16 65535.00 DFES_OneToOne 0.00 65535.00 FORMAT "%8.2" /end CHARACTERISTIC
/begin CHARACTERISTIC DFES_DTCO.DFC_LLRKHmax_C "OBD specific trouble code / OBD specific diagnostic trouble code for check DFC_LLRKHmax" VALUE 0x804F9606 Val_Wu16 65535.00 DFES_OneToOne 0.00 65535.00 FORMAT "%8.2" /end CHARACTERISTIC
/begin CHARACTERISTIC DFES_DTCO.DFC_LLRKHmin_C "OBD specific trouble code / OBD specific diagnostic trouble code for check DFC_LLRKHmin" VALUE 0x804F9608 Val_Wu16 65535.00 DFES_OneToOne 0.00 65535.00 FORMAT "%8.2" /end CHARACTERISTIC
/begin CHARACTERISTIC DFES_DTCO.DFC_LLRmax_C "OBD specific trouble code / OBD specific diagnostic trouble code for check DFC_LLRmax" VALUE 0x804F960A Val_Wu16 65535.00 DFES_OneToOne 0.00 65535.00 FORMAT "%8.2" /end CHARACTERISTIC
/begin CHARACTERISTIC DFES_DTCO.DFC_LLRmin_C "OBD specific trouble code / OBD specific diagnostic trouble code for check DFC_LLRmin" VALUE 0x804F960C Val_Wu16 65535.00 DFES_OneToOne 0.00 65535.00 FORMAT "%8.2" /end CHARACTERISTIC
/begin CHARACTERISTIC DFES_DTCO.DFC_RoughRoad_C "OBD specific trouble code / OBD specific diagnostic trouble code for check DFC_RoughRoad" VALUE 0x804F960E Val_Wu16 65535.00 DFES_OneToOne 0.00 65535.00 FORMAT "%8.2" /end CHARACTERISTIC
/begin CHARACTERISTIC DFES_DTCO.DFC_SiaEEPRdErr_C "OBD specific trouble code / OBD specific diagnostic trouble code for check DFC_SiaEEPRdErr" VALUE 0x804F9610 Val_Wu16 65535.00 DFES_OneToOne 0.00 65535.00 FORMAT "%8.2" /end CHARACTERISTIC
/begin CHARACTERISTIC DFES_DTCO.DFC_SiaEEPWrngCod_C "OBD specific trouble code / OBD specific diagnostic trouble code for check DFC_SiaEEPWrngCod" VALUE 0x804F9612 Val_Wu16 65535.00 DFES_OneToOne 0.00 65535.00 FORMAT "%8.2" /end CHARACTERISTIC
/begin CHARACTERISTIC DFES_DTCO.DFC_UegoDummy_C "OBD specific trouble code / OBD specific diagnostic trouble code for check DFC_UegoDummy" VALUE 0x804F9614 Val_Wu16 65535.00 DFES_OneToOne 0.00 65535.00 FORMAT "%8.2" /end CHARACTERISTIC
/begin CHARACTERISTIC DFES_DTCO.DFC_BusDiagCANAPPLBusOff_C "OBD specific trouble code / OBD specific diagnostic trouble code for check DFC_BusDiagCANAPPLBusOff" VALUE 0x804F9616 Val_Wu16 65535.00 DFES_OneToOne 0.00 65535.00 FORMAT "%8.2" /end CHARACTERISTIC
/begin CHARACTERISTIC DFES_DTCO.DFC_BusDiagCANCANCBusOff_C "OBD specific trouble code / OBD specific diagnostic trouble code for check DFC_BusDiagCANCANCBusOff" VALUE 0x804F9618 Val_Wu16 65535.00 DFES_OneToOne 0.00 65535.00 FORMAT "%8.2" /end CHARACTERISTIC
/begin CHARACTERISTIC DFES_DTCO.DFC_BusDiagCANVEHICLEBusOff_C "OBD specific trouble code / OBD specific diagnostic trouble code for check DFC_BusDiagCANVEHICLEBusOff" VALUE 0x804F961A Val_Wu16 65535.00 DFES_OneToOne 0.00 65535.00 FORMAT "%8.2" /end CHARACTERISTIC
/begin CHARACTERISTIC DFES_DTCO.DFC_RBA_IODIAGPWR_rba_IoExtCy329_SignalVltSply_0_C "OBD specific trouble code / OBD specific diagnostic trouble code for check DFC_RBA_IODIAGPWR_rba_IoExtCy329_SignalVltSply_0" VALUE 0x804F961C Val_Wu16 65535.00 DFES_OneToOne 0.00 65535.00 FORMAT "%8.2" /end CHARACTERISTIC
/begin CHARACTERISTIC DFES_DTCO.DFC_RBA_IODIAGPWR_rba_IoExtCy329_SignalVltSply_0OT_C "OBD specific trouble code / OBD specific diagnostic trouble code for check DFC_RBA_IODIAGPWR_rba_IoExtCy329_SignalVltSply_0OT" VALUE 0x804F961E Val_Wu16 65535.00 DFES_OneToOne 0.00 65535.00 FORMAT "%8.2" /end CHARACTERISTIC
/begin CHARACTERISTIC DFES_DTCO.DFC_RBA_IODIAGPWR_rba_IoExtCy329_SignalVltSply_0OV_C "OBD specific trouble code / OBD specific diagnostic trouble code for check DFC_RBA_IODIAGPWR_rba_IoExtCy329_SignalVltSply_0OV" VALUE 0x804F9620 Val_Wu16 65535.00 DFES_OneToOne 0.00 65535.00 FORMAT "%8.2" /end CHARACTERISTIC
/begin CHARACTERISTIC DFES_DTCO.DFC_RBA_IODIAGPWR_rba_IoExtCy329_SignalVltSply_0SCG_C "OBD specific trouble code / OBD specific diagnostic trouble code for check DFC_RBA_IODIAGPWR_rba_IoExtCy329_SignalVltSply_0SCG" VALUE 0x804F9622 Val_Wu16 65535.00 DFES_OneToOne 0.00 65535.00 FORMAT "%8.2" /end CHARACTERISTIC
/begin CHARACTERISTIC DFES_DTCO.DFC_RBA_IODIAGPWR_rba_IoExtCy329_SignalVltSply_0UV_C "OBD specific trouble code / OBD specific diagnostic trouble code for check DFC_RBA_IODIAGPWR_rba_IoExtCy329_SignalVltSply_0UV" VALUE 0x804F9624 Val_Wu16 65535.00 DFES_OneToOne 0.00 65535.00 FORMAT "%8.2" /end CHARACTERISTIC
/begin CHARACTERISTIC DFES_DTCO.DFC_RBA_IODIAGPWR_rba_IoExtCy329_SignalVltSply_1_C "OBD specific trouble code / OBD specific diagnostic trouble code for check DFC_RBA_IODIAGPWR_rba_IoExtCy329_SignalVltSply_1" VALUE 0x804F9626 Val_Wu16 65535.00 DFES_OneToOne 0.00 65535.00 FORMAT "%8.2" /end CHARACTERISTIC
/begin CHARACTERISTIC DFES_DTCO.DFC_RBA_IODIAGPWR_rba_IoExtCy329_SignalVltSply_1OT_C "OBD specific trouble code / OBD specific diagnostic trouble code for check DFC_RBA_IODIAGPWR_rba_IoExtCy329_SignalVltSply_1OT" VALUE 0x804F9628 Val_Wu16 65535.00 DFES_OneToOne 0.00 65535.00 FORMAT "%8.2" /end CHARACTERISTIC
/begin CHARACTERISTIC DFES_DTCO.DFC_RBA_IODIAGPWR_rba_IoExtCy329_SignalVltSply_1OV_C "OBD specific trouble code / OBD specific diagnostic trouble code for check DFC_RBA_IODIAGPWR_rba_IoExtCy329_SignalVltSply_1OV" VALUE 0x804F962A Val_Wu16 65535.00 DFES_OneToOne 0.00 65535.00 FORMAT "%8.2" /end CHARACTERISTIC
/begin CHARACTERISTIC DFES_DTCO.DFC_RBA_IODIAGPWR_rba_IoExtCy329_SignalVltSply_1SCG_C "OBD specific trouble code / OBD specific diagnostic trouble code for check DFC_RBA_IODIAGPWR_rba_IoExtCy329_SignalVltSply_1SCG" VALUE 0x804F962C Val_Wu16 65535.00 DFES_OneToOne 0.00 65535.00 FORMAT "%8.2" /end CHARACTERISTIC
/begin CHARACTERISTIC DFES_DTCO.DFC_RBA_IODIAGPWR_rba_IoExtCy329_SignalVltSply_1UV_C "OBD specific trouble code / OBD specific diagnostic trouble code for check DFC_RBA_IODIAGPWR_rba_IoExtCy329_SignalVltSply_1UV" VALUE 0x804F962E Val_Wu16 65535.00 DFES_OneToOne 0.00 65535.00 FORMAT "%8.2" /end CHARACTERISTIC
/begin CHARACTERISTIC DFES_DTCO.DFC_RBA_IODIAGPWR_rba_IoExtCy329_SignalVltSply_2_C "OBD specific trouble code / OBD specific diagnostic trouble code for check DFC_RBA_IODIAGPWR_rba_IoExtCy329_SignalVltSply_2" VALUE 0x804F9630 Val_Wu16 65535.00 DFES_OneToOne 0.00 65535.00 FORMAT "%8.2" /end CHARACTERISTIC
/begin CHARACTERISTIC DFES_DTCO.DFC_RBA_IODIAGPWR_rba_IoExtCy329_SignalVltSply_2OT_C "OBD specific trouble code / OBD specific diagnostic trouble code for check DFC_RBA_IODIAGPWR_rba_IoExtCy329_SignalVltSply_2OT" VALUE 0x804F9632 Val_Wu16 65535.00 DFES_OneToOne 0.00 65535.00 FORMAT "%8.2" /end CHARACTERISTIC
/begin CHARACTERISTIC DFES_DTCO.DFC_RBA_IODIAGPWR_rba_IoExtCy329_SignalVltSply_2OV_C "OBD specific trouble code / OBD specific diagnostic trouble code for check DFC_RBA_IODIAGPWR_rba_IoExtCy329_SignalVltSply_2OV" VALUE 0x804F9634 Val_Wu16 65535.00 DFES_OneToOne 0.00 65535.00 FORMAT "%8.2" /end CHARACTERISTIC
/begin CHARACTERISTIC DFES_DTCO.DFC_RBA_IODIAGPWR_rba_IoExtCy329_SignalVltSply_2SCG_C "OBD specific trouble code / OBD specific diagnostic trouble code for check DFC_RBA_IODIAGPWR_rba_IoExtCy329_SignalVltSply_2SCG" VALUE 0x804F9636 Val_Wu16 65535.00 DFES_OneToOne 0.00 65535.00 FORMAT "%8.2" /end CHARACTERISTIC
/begin CHARACTERISTIC DFES_DTCO.DFC_RBA_IODIAGPWR_rba_IoExtCy329_SignalVltSply_2UV_C "OBD specific trouble code / OBD specific diagnostic trouble code for check DFC_RBA_IODIAGPWR_rba_IoExtCy329_SignalVltSply_2UV" VALUE 0x804F9638 Val_Wu16 65535.00 DFES_OneToOne 0.00 65535.00 FORMAT "%8.2" /end CHARACTERISTIC
/begin CHARACTERISTIC DFES_DTCO.DFC_CAN_E_TIMEOUT_C "OBD specific trouble code / OBD specific diagnostic trouble code for check DFC_CAN_E_TIMEOUT" VALUE 0x804F963A Val_Wu16 65535.00 DFES_OneToOne 0.00 65535.00 FORMAT "%8.2" /end CHARACTERISTIC
/begin CHARACTERISTIC DFES_DTCO.DFC_LIN_E_TIMEOUT_C "OBD specific trouble code / OBD specific diagnostic trouble code for check DFC_LIN_E_TIMEOUT" VALUE 0x804F963C Val_Wu16 65535.00 DFES_OneToOne 0.00 65535.00 FORMAT "%8.2" /end CHARACTERISTIC
/begin CHARACTERISTIC DFES_DTCO.DFC_MRlyOL_C "OBD specific trouble code / OBD specific diagnostic trouble code for check DFC_MRlyOL" VALUE 0x804F963E Val_Wu16 65535.00 DFES_OneToOne 0.00 65535.00 FORMAT "%8.2" /end CHARACTERISTIC
/begin CHARACTERISTIC DFES_DTCO.DFC_MRlySCB_C "OBD specific trouble code / OBD specific diagnostic trouble code for check DFC_MRlySCB" VALUE 0x804F9640 Val_Wu16 65535.00 DFES_OneToOne 0.00 65535.00 FORMAT "%8.2" /end CHARACTERISTIC
/begin CHARACTERISTIC DFES_DTCO.DFC_MRlySCG_C "OBD specific trouble code / OBD specific diagnostic trouble code for check DFC_MRlySCG" VALUE 0x804F9642 Val_Wu16 65535.00 DFES_OneToOne 0.00 65535.00 FORMAT "%8.2" /end CHARACTERISTIC
/begin CHARACTERISTIC DFES_DTCO.DFC_rba_MultiStackTrace_Threshold_C "OBD specific trouble code / OBD specific diagnostic trouble code for check DFC_rba_MultiStackTrace_Threshold" VALUE 0x804F9644 Val_Wu16 65535.00 DFES_OneToOne 0.00 65535.00 FORMAT "%8.2" /end CHARACTERISTIC
/begin CHARACTERISTIC DFES_DTCO.DFC_BSWM_E_ACTION_FAILED_C "OBD specific trouble code / OBD specific diagnostic trouble code for check DFC_BSWM_E_ACTION_FAILED" VALUE 0x804F9646 Val_Wu16 65535.00 DFES_OneToOne 0.00 65535.00 FORMAT "%8.2" /end CHARACTERISTIC
/begin CHARACTERISTIC DFES_DTCO.DFC_BSWM_E_INTRPTQUEUE_FULL_C "OBD specific trouble code / OBD specific diagnostic trouble code for check DFC_BSWM_E_INTRPTQUEUE_FULL" VALUE 0x804F9648 Val_Wu16 65535.00 DFES_OneToOne 0.00 65535.00 FORMAT "%8.2" /end CHARACTERISTIC
/begin CHARACTERISTIC DFES_DTCO.DFC_RBA_IOEXTLIB_KEEPALIVE_DRV_C "OBD specific trouble code / OBD specific diagnostic trouble code for check DFC_RBA_IOEXTLIB_KEEPALIVE_DRV" VALUE 0x804F964A Val_Wu16 65535.00 DFES_OneToOne 0.00 65535.00 FORMAT "%8.2" /end CHARACTERISTIC
/begin CHARACTERISTIC DFES_DTCO.DFC_RBA_IOEXTLIB_KEEPALIVE_INI_C "OBD specific trouble code / OBD specific diagnostic trouble code for check DFC_RBA_IOEXTLIB_KEEPALIVE_INI" VALUE 0x804F964C Val_Wu16 65535.00 DFES_OneToOne 0.00 65535.00 FORMAT "%8.2" /end CHARACTERISTIC
/begin CHARACTERISTIC DFES_DTCO.DFC_rba_IoSigRtc_StopCounter_C "OBD specific trouble code / OBD specific diagnostic trouble code for check DFC_rba_IoSigRtc_StopCounter" VALUE 0x804F964E Val_Wu16 65535.00 DFES_OneToOne 0.00 65535.00 FORMAT "%8.2" /end CHARACTERISTIC
/begin CHARACTERISTIC DFES_DTCO.DFC_rba_MRly_Diag_Stk_Event_C "OBD specific trouble code / OBD specific diagnostic trouble code for check DFC_rba_MRly_Diag_Stk_Event" VALUE 0x804F9650 Val_Wu16 65535.00 DFES_OneToOne 0.00 65535.00 FORMAT "%8.2" /end CHARACTERISTIC
/begin CHARACTERISTIC DFES_DTCO.DFC_rba_MemDiag_MemReadErr_C "OBD specific trouble code / OBD specific diagnostic trouble code for check DFC_rba_MemDiag_MemReadErr" VALUE 0x804F9652 Val_Wu16 65535.00 DFES_OneToOne 0.00 65535.00 FORMAT "%8.2" /end CHARACTERISTIC
/begin CHARACTERISTIC DFES_DTCO.DFC_rba_MemDiag_MemWrErr_C "OBD specific trouble code / OBD specific diagnostic trouble code for check DFC_rba_MemDiag_MemWrErr" VALUE 0x804F9654 Val_Wu16 65535.00 DFES_OneToOne 0.00 65535.00 FORMAT "%8.2" /end CHARACTERISTIC
/begin CHARACTERISTIC DFES_DTCO.DFC_rba_SyC_IrrSwOffTrigEngRun_Event_C "OBD specific trouble code / OBD specific diagnostic trouble code for check DFC_rba_SyC_IrrSwOffTrigEngRun_Event" VALUE 0x804F9656 Val_Wu16 65535.00 DFES_OneToOne 0.00 65535.00 FORMAT "%8.2" /end CHARACTERISTIC
/begin CHARACTERISTIC DFES_DTCO.DFC_rba_T15_Diag_ComInVld_Event_C "OBD specific trouble code / OBD specific diagnostic trouble code for check DFC_rba_T15_Diag_ComInVld_Event" VALUE 0x804F9658 Val_Wu16 65535.00 DFES_OneToOne 0.00 65535.00 FORMAT "%8.2" /end CHARACTERISTIC
/begin CHARACTERISTIC DFES_DTCO.DFC_rba_T15_Diag_ComOff_HwOn_Event_C "OBD specific trouble code / OBD specific diagnostic trouble code for check DFC_rba_T15_Diag_ComOff_HwOn_Event" VALUE 0x804F965A Val_Wu16 65535.00 DFES_OneToOne 0.00 65535.00 FORMAT "%8.2" /end CHARACTERISTIC
/begin CHARACTERISTIC DFES_DTCO.DFC_rba_T15_Diag_ComOn_HwOff_Event_C "OBD specific trouble code / OBD specific diagnostic trouble code for check DFC_rba_T15_Diag_ComOn_HwOff_Event" VALUE 0x804F965C Val_Wu16 65535.00 DFES_OneToOne 0.00 65535.00 FORMAT "%8.2" /end CHARACTERISTIC
/begin CHARACTERISTIC DFES_DTCO.DFC_AppAllSnsrDfct_C "OBD specific trouble code / OBD specific diagnostic trouble code for check DFC_AppAllSnsrDfct" VALUE 0x804F965E Val_Wu16 65535.00 DFES_OneToOne 0.00 65535.00 FORMAT "%8.2" /end CHARACTERISTIC
/begin CHARACTERISTIC DFES_DTCO.DFC_BattUStdbyDiaOL_C "OBD specific trouble code / OBD specific diagnostic trouble code for check DFC_BattUStdbyDiaOL" VALUE 0x804F9660 Val_Wu16 65535.00 DFES_OneToOne 0.00 65535.00 FORMAT "%8.2" /end CHARACTERISTIC
/begin CHARACTERISTIC DFES_DTCO.DFC_BigLeakIntkMnfldEmiInfl_C "OBD specific trouble code / OBD specific diagnostic trouble code for check DFC_BigLeakIntkMnfldEmiInfl" VALUE 0x804F9662 Val_Wu16 65535.00 DFES_OneToOne 0.00 65535.00 FORMAT "%8.2" /end CHARACTERISTIC
/begin CHARACTERISTIC DFES_DTCO.DFC_BrkMnSwtContOnWarnLmp_C "OBD specific trouble code / OBD specific diagnostic trouble code for check DFC_BrkMnSwtContOnWarnLmp" VALUE 0x804F9664 Val_Wu16 65535.00 DFES_OneToOne 0.00 65535.00 FORMAT "%8.2" /end CHARACTERISTIC
/begin CHARACTERISTIC DFES_DTCO.DFC_BrkMnSwtNotStpWarnLmp_C "OBD specific trouble code / OBD specific diagnostic trouble code for check DFC_BrkMnSwtNotStpWarnLmp" VALUE 0x804F9666 Val_Wu16 65535.00 DFES_OneToOne 0.00 65535.00 FORMAT "%8.2" /end CHARACTERISTIC
/begin CHARACTERISTIC DFES_DTCO.DFC_BrkRdntSwtContOnWarnLmp_C "OBD specific trouble code / OBD specific diagnostic trouble code for check DFC_BrkRdntSwtContOnWarnLmp" VALUE 0x804F9668 Val_Wu16 65535.00 DFES_OneToOne 0.00 65535.00 FORMAT "%8.2" /end CHARACTERISTIC
/begin CHARACTERISTIC DFES_DTCO.DFC_BrkRdntSwtNotStpWarnLmp_C "OBD specific trouble code / OBD specific diagnostic trouble code for check DFC_BrkRdntSwtNotStpWarnLmp" VALUE 0x804F966A Val_Wu16 65535.00 DFES_OneToOne 0.00 65535.00 FORMAT "%8.2" /end CHARACTERISTIC
/begin CHARACTERISTIC DFES_DTCO.DFC_CEngDsTColdStrtMax_C "OBD specific trouble code / OBD specific diagnostic trouble code for check DFC_CEngDsTColdStrtMax" VALUE 0x804F966C Val_Wu16 65535.00 DFES_OneToOne 0.00 65535.00 FORMAT "%8.2" /end CHARACTERISTIC
/begin CHARACTERISTIC DFES_DTCO.DFC_CEngDsTColdStrtMin_C "OBD specific trouble code / OBD specific diagnostic trouble code for check DFC_CEngDsTColdStrtMin" VALUE 0x804F966E Val_Wu16 65535.00 DFES_OneToOne 0.00 65535.00 FORMAT "%8.2" /end CHARACTERISTIC
/begin CHARACTERISTIC DFES_DTCO.DFC_CEngDsTImps_C "OBD specific trouble code / OBD specific diagnostic trouble code for check DFC_CEngDsTImps" VALUE 0x804F9670 Val_Wu16 65535.00 DFES_OneToOne 0.00 65535.00 FORMAT "%8.2" /end CHARACTERISTIC
/begin CHARACTERISTIC DFES_DTCO.DFC_CEngDsTPlausLSC_C "OBD specific trouble code / OBD specific diagnostic trouble code for check DFC_CEngDsTPlausLSC" VALUE 0x804F9672 Val_Wu16 65535.00 DFES_OneToOne 0.00 65535.00 FORMAT "%8.2" /end CHARACTERISTIC
/begin CHARACTERISTIC DFES_DTCO.DFC_CEngDsTPlausSTC_C "OBD specific trouble code / OBD specific diagnostic trouble code for check DFC_CEngDsTPlausSTC" VALUE 0x804F9674 Val_Wu16 65535.00 DFES_OneToOne 0.00 65535.00 FORMAT "%8.2" /end CHARACTERISTIC
/begin CHARACTERISTIC DFES_DTCO.DFC_CEngDsTSRCMax_C "OBD specific trouble code / OBD specific diagnostic trouble code for check DFC_CEngDsTSRCMax" VALUE 0x804F9676 Val_Wu16 65535.00 DFES_OneToOne 0.00 65535.00 FORMAT "%8.2" /end CHARACTERISTIC
/begin CHARACTERISTIC DFES_DTCO.DFC_CEngDsTSRCMin_C "OBD specific trouble code / OBD specific diagnostic trouble code for check DFC_CEngDsTSRCMin" VALUE 0x804F9678 Val_Wu16 65535.00 DFES_OneToOne 0.00 65535.00 FORMAT "%8.2" /end CHARACTERISTIC
/begin CHARACTERISTIC DFES_DTCO.DFC_CEngDsTSig_C "OBD specific trouble code / OBD specific diagnostic trouble code for check DFC_CEngDsTSig" VALUE 0x804F967A Val_Wu16 65535.00 DFES_OneToOne 0.00 65535.00 FORMAT "%8.2" /end CHARACTERISTIC
/begin CHARACTERISTIC DFES_DTCO.DFC_CEngUsTSRCMax_C "OBD specific trouble code / OBD specific diagnostic trouble code for check DFC_CEngUsTSRCMax" VALUE 0x804F967C Val_Wu16 65535.00 DFES_OneToOne 0.00 65535.00 FORMAT "%8.2" /end CHARACTERISTIC
/begin CHARACTERISTIC DFES_DTCO.DFC_CEngUsTSRCMin_C "OBD specific trouble code / OBD specific diagnostic trouble code for check DFC_CEngUsTSRCMin" VALUE 0x804F967E Val_Wu16 65535.00 DFES_OneToOne 0.00 65535.00 FORMAT "%8.2" /end CHARACTERISTIC
/begin CHARACTERISTIC DFES_DTCO.DFC_DCDCFltDet_C "OBD specific trouble code / OBD specific diagnostic trouble code for check DFC_DCDCFltDet" VALUE 0x804F9680 Val_Wu16 65535.00 DFES_OneToOne 0.00 65535.00 FORMAT "%8.2" /end CHARACTERISTIC
/begin CHARACTERISTIC DFES_DTCO.DFC_DKRSA_C "OBD specific trouble code / OBD specific diagnostic trouble code for check DFC_DKRSA" VALUE 0x804F9682 Val_Wu16 65535.00 DFES_OneToOne 0.00 65535.00 FORMAT "%8.2" /end CHARACTERISTIC
/begin CHARACTERISTIC DFES_DTCO.DFC_DKVSmax_C "OBD specific trouble code / OBD specific diagnostic trouble code for check DFC_DKVSmax" VALUE 0x804F9684 Val_Wu16 65535.00 DFES_OneToOne 0.00 65535.00 FORMAT "%8.2" /end CHARACTERISTIC
/begin CHARACTERISTIC DFES_DTCO.DFC_DKnpl_C "OBD specific trouble code / OBD specific diagnostic trouble code for check DFC_DKnpl" VALUE 0x804F9686 Val_Wu16 65535.00 DFES_OneToOne 0.00 65535.00 FORMAT "%8.2" /end CHARACTERISTIC
/begin CHARACTERISTIC DFES_DTCO.DFC_DSSmax_C "OBD specific trouble code / OBD specific diagnostic trouble code for check DFC_DSSmax" VALUE 0x804F9688 Val_Wu16 65535.00 DFES_OneToOne 0.00 65535.00 FORMAT "%8.2" /end CHARACTERISTIC
/begin CHARACTERISTIC DFES_DTCO.DFC_DSTTI_C "OBD specific trouble code / OBD specific diagnostic trouble code for check DFC_DSTTI" VALUE 0x804F968A Val_Wu16 65535.00 DFES_OneToOne 0.00 65535.00 FORMAT "%8.2" /end CHARACTERISTIC
/begin CHARACTERISTIC DFES_DTCO.DFC_DSUmax_C "OBD specific trouble code / OBD specific diagnostic trouble code for check DFC_DSUmax" VALUE 0x804F968C Val_Wu16 65535.00 DFES_OneToOne 0.00 65535.00 FORMAT "%8.2" /end CHARACTERISTIC
/begin CHARACTERISTIC DFES_DTCO.DFC_EGRVlvOL_C "OBD specific trouble code / OBD specific diagnostic trouble code for check DFC_EGRVlvOL" VALUE 0x804F968E Val_Wu16 65535.00 DFES_OneToOne 0.00 65535.00 FORMAT "%8.2" /end CHARACTERISTIC
/begin CHARACTERISTIC DFES_DTCO.DFC_EGRVlvSCB_C "OBD specific trouble code / OBD specific diagnostic trouble code for check DFC_EGRVlvSCB" VALUE 0x804F9690 Val_Wu16 65535.00 DFES_OneToOne 0.00 65535.00 FORMAT "%8.2" /end CHARACTERISTIC
/begin CHARACTERISTIC DFES_DTCO.DFC_EGRVlvSCG_C "OBD specific trouble code / OBD specific diagnostic trouble code for check DFC_EGRVlvSCG" VALUE 0x804F9692 Val_Wu16 65535.00 DFES_OneToOne 0.00 65535.00 FORMAT "%8.2" /end CHARACTERISTIC
/begin CHARACTERISTIC DFES_DTCO.DFC_EGSDUS2B1LtrDly_C "OBD specific trouble code / OBD specific diagnostic trouble code for check DFC_EGSDUS2B1LtrDly" VALUE 0x804F9694 Val_Wu16 65535.00 DFES_OneToOne 0.00 65535.00 FORMAT "%8.2" /end CHARACTERISTIC
/begin CHARACTERISTIC DFES_DTCO.DFC_EGSDUS2B1LtrPT1_C "OBD specific trouble code / OBD specific diagnostic trouble code for check DFC_EGSDUS2B1LtrPT1" VALUE 0x804F9696 Val_Wu16 65535.00 DFES_OneToOne 0.00 65535.00 FORMAT "%8.2" /end CHARACTERISTIC
/begin CHARACTERISTIC DFES_DTCO.DFC_EGSDUS2B1RtlDly_C "OBD specific trouble code / OBD specific diagnostic trouble code for check DFC_EGSDUS2B1RtlDly" VALUE 0x804F9698 Val_Wu16 65535.00 DFES_OneToOne 0.00 65535.00 FORMAT "%8.2" /end CHARACTERISTIC
/begin CHARACTERISTIC DFES_DTCO.DFC_EGSDUS2B1RtlPT1_C "OBD specific trouble code / OBD specific diagnostic trouble code for check DFC_EGSDUS2B1RtlPT1" VALUE 0x804F969A Val_Wu16 65535.00 DFES_OneToOne 0.00 65535.00 FORMAT "%8.2" /end CHARACTERISTIC
/begin CHARACTERISTIC DFES_DTCO.DFC_EGSDUS2B1TarLean_C "OBD specific trouble code / OBD specific diagnostic trouble code for check DFC_EGSDUS2B1TarLean" VALUE 0x804F969C Val_Wu16 65535.00 DFES_OneToOne 0.00 65535.00 FORMAT "%8.2" /end CHARACTERISTIC
/begin CHARACTERISTIC DFES_DTCO.DFC_EGSDUS2B1TarRich_C "OBD specific trouble code / OBD specific diagnostic trouble code for check DFC_EGSDUS2B1TarRich" VALUE 0x804F969E Val_Wu16 65535.00 DFES_OneToOne 0.00 65535.00 FORMAT "%8.2" /end CHARACTERISTIC
/begin CHARACTERISTIC DFES_DTCO.DFC_ETAKHLmax_C "OBD specific trouble code / OBD specific diagnostic trouble code for check DFC_ETAKHLmax" VALUE 0x804F96A0 Val_Wu16 65535.00 DFES_OneToOne 0.00 65535.00 FORMAT "%8.2" /end CHARACTERISTIC
/begin CHARACTERISTIC DFES_DTCO.DFC_ETAKHTmax_C "OBD specific trouble code / OBD specific diagnostic trouble code for check DFC_ETAKHTmax" VALUE 0x804F96A2 Val_Wu16 65535.00 DFES_OneToOne 0.00 65535.00 FORMAT "%8.2" /end CHARACTERISTIC
/begin CHARACTERISTIC DFES_DTCO.DFC_EngICO_C "OBD specific trouble code / OBD specific diagnostic trouble code for check DFC_EngICO" VALUE 0x804F96A4 Val_Wu16 65535.00 DFES_OneToOne 0.00 65535.00 FORMAT "%8.2" /end CHARACTERISTIC
/begin CHARACTERISTIC DFES_DTCO.DFC_EngPrtOvrSpdMon_C "OBD specific trouble code / OBD specific diagnostic trouble code for check DFC_EngPrtOvrSpdMon" VALUE 0x804F96A6 Val_Wu16 65535.00 DFES_OneToOne 0.00 65535.00 FORMAT "%8.2" /end CHARACTERISTIC
/begin CHARACTERISTIC DFES_DTCO.DFC_EpmCaSI1ErrSig_C "OBD specific trouble code / OBD specific diagnostic trouble code for check DFC_EpmCaSI1ErrSig" VALUE 0x804F96A8 Val_Wu16 65535.00 DFES_OneToOne 0.00 65535.00 FORMAT "%8.2" /end CHARACTERISTIC
/begin CHARACTERISTIC DFES_DTCO.DFC_EpmCaSI1NoSig_C "OBD specific trouble code / OBD specific diagnostic trouble code for check DFC_EpmCaSI1NoSig" VALUE 0x804F96AA Val_Wu16 65535.00 DFES_OneToOne 0.00 65535.00 FORMAT "%8.2" /end CHARACTERISTIC
/begin CHARACTERISTIC DFES_DTCO.DFC_EpmCaSI1OfsErr_C "OBD specific trouble code / OBD specific diagnostic trouble code for check DFC_EpmCaSI1OfsErr" VALUE 0x804F96AC Val_Wu16 65535.00 DFES_OneToOne 0.00 65535.00 FORMAT "%8.2" /end CHARACTERISTIC
/begin CHARACTERISTIC DFES_DTCO.DFC_EpmCrSErrSig_C "OBD specific trouble code / OBD specific diagnostic trouble code for check DFC_EpmCrSErrSig" VALUE 0x804F96AE Val_Wu16 65535.00 DFES_OneToOne 0.00 65535.00 FORMAT "%8.2" /end CHARACTERISTIC
/begin CHARACTERISTIC DFES_DTCO.DFC_EpmCrSNoSig_C "OBD specific trouble code / OBD specific diagnostic trouble code for check DFC_EpmCrSNoSig" VALUE 0x804F96B0 Val_Wu16 65535.00 DFES_OneToOne 0.00 65535.00 FORMAT "%8.2" /end CHARACTERISTIC
/begin CHARACTERISTIC DFES_DTCO.DFC_EtaEngIdleNonCsers_C "OBD specific trouble code / OBD specific diagnostic trouble code for check DFC_EtaEngIdleNonCsers" VALUE 0x804F96B2 Val_Wu16 65535.00 DFES_OneToOne 0.00 65535.00 FORMAT "%8.2" /end CHARACTERISTIC
/begin CHARACTERISTIC DFES_DTCO.DFC_EtaEngPtlNonCsers_C "OBD specific trouble code / OBD specific diagnostic trouble code for check DFC_EtaEngPtlNonCsers" VALUE 0x804F96B4 Val_Wu16 65535.00 DFES_OneToOne 0.00 65535.00 FORMAT "%8.2" /end CHARACTERISTIC
/begin CHARACTERISTIC DFES_DTCO.DFC_FRAmax_C "OBD specific trouble code / OBD specific diagnostic trouble code for check DFC_FRAmax" VALUE 0x804F96B6 Val_Wu16 65535.00 DFES_OneToOne 0.00 65535.00 FORMAT "%8.2" /end CHARACTERISTIC
/begin CHARACTERISTIC DFES_DTCO.DFC_FRAmin_C "OBD specific trouble code / OBD specific diagnostic trouble code for check DFC_FRAmin" VALUE 0x804F96B8 Val_Wu16 65535.00 DFES_OneToOne 0.00 65535.00 FORMAT "%8.2" /end CHARACTERISTIC
/begin CHARACTERISTIC DFES_DTCO.DFC_GbxRvsSwtStk_C "OBD specific trouble code / OBD specific diagnostic trouble code for check DFC_GbxRvsSwtStk" VALUE 0x804F96BA Val_Wu16 65535.00 DFES_OneToOne 0.00 65535.00 FORMAT "%8.2" /end CHARACTERISTIC
/begin CHARACTERISTIC DFES_DTCO.DFC_HDRmax_C "OBD specific trouble code / OBD specific diagnostic trouble code for check DFC_HDRmax" VALUE 0x804F96BC Val_Wu16 65535.00 DFES_OneToOne 0.00 65535.00 FORMAT "%8.2" /end CHARACTERISTIC
/begin CHARACTERISTIC DFES_DTCO.DFC_HEGOS2B1ElecMax_C "OBD specific trouble code / OBD specific diagnostic trouble code for check DFC_HEGOS2B1ElecMax" VALUE 0x804F96BE Val_Wu16 65535.00 DFES_OneToOne 0.00 65535.00 FORMAT "%8.2" /end CHARACTERISTIC
/begin CHARACTERISTIC DFES_DTCO.DFC_HEGOS2B1ElecMin_C "OBD specific trouble code / OBD specific diagnostic trouble code for check DFC_HEGOS2B1ElecMin" VALUE 0x804F96C0 Val_Wu16 65535.00 DFES_OneToOne 0.00 65535.00 FORMAT "%8.2" /end CHARACTERISTIC
/begin CHARACTERISTIC DFES_DTCO.DFC_HEGOS2B1ElecSig_C "OBD specific trouble code / OBD specific diagnostic trouble code for check DFC_HEGOS2B1ElecSig" VALUE 0x804F96C2 Val_Wu16 65535.00 DFES_OneToOne 0.00 65535.00 FORMAT "%8.2" /end CHARACTERISTIC
/begin CHARACTERISTIC DFES_DTCO.DFC_HEGOS2B1HtgNpl_C "OBD specific trouble code / OBD specific diagnostic trouble code for check DFC_HEGOS2B1HtgNpl" VALUE 0x804F96C4 Val_Wu16 65535.00 DFES_OneToOne 0.00 65535.00 FORMAT "%8.2" /end CHARACTERISTIC
/begin CHARACTERISTIC DFES_DTCO.DFC_IntkAirTIntkMnfldCrssMax_C "OBD specific trouble code / OBD specific diagnostic trouble code for check DFC_IntkAirTIntkMnfldCrssMax" VALUE 0x804F96C6 Val_Wu16 65535.00 DFES_OneToOne 0.00 65535.00 FORMAT "%8.2" /end CHARACTERISTIC
/begin CHARACTERISTIC DFES_DTCO.DFC_IntkAirTIntkMnfldCrssMin_C "OBD specific trouble code / OBD specific diagnostic trouble code for check DFC_IntkAirTIntkMnfldCrssMin" VALUE 0x804F96C8 Val_Wu16 65535.00 DFES_OneToOne 0.00 65535.00 FORMAT "%8.2" /end CHARACTERISTIC
/begin CHARACTERISTIC DFES_DTCO.DFC_IntkAirTIntkMnfldHSCMax_C "OBD specific trouble code / OBD specific diagnostic trouble code for check DFC_IntkAirTIntkMnfldHSCMax" VALUE 0x804F96CA Val_Wu16 65535.00 DFES_OneToOne 0.00 65535.00 FORMAT "%8.2" /end CHARACTERISTIC
/begin CHARACTERISTIC DFES_DTCO.DFC_IntkAirTIntkMnfldImps_C "OBD specific trouble code / OBD specific diagnostic trouble code for check DFC_IntkAirTIntkMnfldImps" VALUE 0x804F96CC Val_Wu16 65535.00 DFES_OneToOne 0.00 65535.00 FORMAT "%8.2" /end CHARACTERISTIC
/begin CHARACTERISTIC DFES_DTCO.DFC_IntkAirTIntkMnfldPRCMax_C "OBD specific trouble code / OBD specific diagnostic trouble code for check DFC_IntkAirTIntkMnfldPRCMax" VALUE 0x804F96CE Val_Wu16 65535.00 DFES_OneToOne 0.00 65535.00 FORMAT "%8.2" /end CHARACTERISTIC
/begin CHARACTERISTIC DFES_DTCO.DFC_IntkAirTIntkMnfldPRCMin_C "OBD specific trouble code / OBD specific diagnostic trouble code for check DFC_IntkAirTIntkMnfldPRCMin" VALUE 0x804F96D0 Val_Wu16 65535.00 DFES_OneToOne 0.00 65535.00 FORMAT "%8.2" /end CHARACTERISTIC
/begin CHARACTERISTIC DFES_DTCO.DFC_IntkAirTIntkMnfldSRCMax_C "OBD specific trouble code / OBD specific diagnostic trouble code for check DFC_IntkAirTIntkMnfldSRCMax" VALUE 0x804F96D2 Val_Wu16 65535.00 DFES_OneToOne 0.00 65535.00 FORMAT "%8.2" /end CHARACTERISTIC
/begin CHARACTERISTIC DFES_DTCO.DFC_IntkAirTIntkMnfldSRCMin_C "OBD specific trouble code / OBD specific diagnostic trouble code for check DFC_IntkAirTIntkMnfldSRCMin" VALUE 0x804F96D4 Val_Wu16 65535.00 DFES_OneToOne 0.00 65535.00 FORMAT "%8.2" /end CHARACTERISTIC
/begin CHARACTERISTIC DFES_DTCO.DFC_IntkAirTIntkMnfldSTC_C "OBD specific trouble code / OBD specific diagnostic trouble code for check DFC_IntkAirTIntkMnfldSTC" VALUE 0x804F96D6 Val_Wu16 65535.00 DFES_OneToOne 0.00 65535.00 FORMAT "%8.2" /end CHARACTERISTIC
/begin CHARACTERISTIC DFES_DTCO.DFC_KS1max_C "OBD specific trouble code / OBD specific diagnostic trouble code for check DFC_KS1max" VALUE 0x804F96D8 Val_Wu16 65535.00 DFES_OneToOne 0.00 65535.00 FORMAT "%8.2" /end CHARACTERISTIC
/begin CHARACTERISTIC DFES_DTCO.DFC_KS1min_C "OBD specific trouble code / OBD specific diagnostic trouble code for check DFC_KS1min" VALUE 0x804F96DA Val_Wu16 65535.00 DFES_OneToOne 0.00 65535.00 FORMAT "%8.2" /end CHARACTERISTIC
/begin CHARACTERISTIC DFES_DTCO.DFC_LMmax_C "OBD specific trouble code / OBD specific diagnostic trouble code for check DFC_LMmax" VALUE 0x804F96DC Val_Wu16 65535.00 DFES_OneToOne 0.00 65535.00 FORMAT "%8.2" /end CHARACTERISTIC
/begin CHARACTERISTIC DFES_DTCO.DFC_LZSRnpl_C "OBD specific trouble code / OBD specific diagnostic trouble code for check DFC_LZSRnpl" VALUE 0x804F96DE Val_Wu16 65535.00 DFES_OneToOne 0.00 65535.00 FORMAT "%8.2" /end CHARACTERISTIC
/begin CHARACTERISTIC DFES_DTCO.DFC_LamDynDiagS1B1_C "OBD specific trouble code / OBD specific diagnostic trouble code for check DFC_LamDynDiagS1B1" VALUE 0x804F96E0 Val_Wu16 65535.00 DFES_OneToOne 0.00 65535.00 FORMAT "%8.2" /end CHARACTERISTIC
/begin CHARACTERISTIC DFES_DTCO.DFC_LeakIntkMnfldEmiInfl_C "OBD specific trouble code / OBD specific diagnostic trouble code for check DFC_LeakIntkMnfldEmiInfl" VALUE 0x804F96E2 Val_Wu16 65535.00 DFES_OneToOne 0.00 65535.00 FORMAT "%8.2" /end CHARACTERISTIC
/begin CHARACTERISTIC DFES_DTCO.DFC_MD00max_C "OBD specific trouble code / OBD specific diagnostic trouble code for check DFC_MD00max" VALUE 0x804F96E4 Val_Wu16 65535.00 DFES_OneToOne 0.00 65535.00 FORMAT "%8.2" /end CHARACTERISTIC
/begin CHARACTERISTIC DFES_DTCO.DFC_MDBmax_C "OBD specific trouble code / OBD specific diagnostic trouble code for check DFC_MDBmax" VALUE 0x804F96E6 Val_Wu16 65535.00 DFES_OneToOne 0.00 65535.00 FORMAT "%8.2" /end CHARACTERISTIC
/begin CHARACTERISTIC DFES_DTCO.DFC_MDCat_C "OBD specific trouble code / OBD specific diagnostic trouble code for check DFC_MDCat" VALUE 0x804F96E8 Val_Wu16 65535.00 DFES_OneToOne 0.00 65535.00 FORMAT "%8.2" /end CHARACTERISTIC
/begin CHARACTERISTIC DFES_DTCO.DFC_MDCatCrit_C "OBD specific trouble code / OBD specific diagnostic trouble code for check DFC_MDCatCrit" VALUE 0x804F96EA Val_Wu16 65535.00 DFES_OneToOne 0.00 65535.00 FORMAT "%8.2" /end CHARACTERISTIC
/begin CHARACTERISTIC DFES_DTCO.DFC_MDCatCurr_C "OBD specific trouble code / OBD specific diagnostic trouble code for check DFC_MDCatCurr" VALUE 0x804F96EC Val_Wu16 65535.00 DFES_OneToOne 0.00 65535.00 FORMAT "%8.2" /end CHARACTERISTIC
/begin CHARACTERISTIC DFES_DTCO.DFC_MDCyl_0_C "OBD specific trouble code / OBD specific diagnostic trouble code for check DFC_MDCyl_0" VALUE 0x804F96EE Val_Wu16 65535.00 DFES_OneToOne 0.00 65535.00 FORMAT "%8.2" /end CHARACTERISTIC
/begin CHARACTERISTIC DFES_DTCO.DFC_MDCyl_1_C "OBD specific trouble code / OBD specific diagnostic trouble code for check DFC_MDCyl_1" VALUE 0x804F96F0 Val_Wu16 65535.00 DFES_OneToOne 0.00 65535.00 FORMAT "%8.2" /end CHARACTERISTIC
/begin CHARACTERISTIC DFES_DTCO.DFC_MDCyl_2_C "OBD specific trouble code / OBD specific diagnostic trouble code for check DFC_MDCyl_2" VALUE 0x804F96F2 Val_Wu16 65535.00 DFES_OneToOne 0.00 65535.00 FORMAT "%8.2" /end CHARACTERISTIC
/begin CHARACTERISTIC DFES_DTCO.DFC_MDCyl_3_C "OBD specific trouble code / OBD specific diagnostic trouble code for check DFC_MDCyl_3" VALUE 0x804F96F4 Val_Wu16 65535.00 DFES_OneToOne 0.00 65535.00 FORMAT "%8.2" /end CHARACTERISTIC
/begin CHARACTERISTIC DFES_DTCO.DFC_MDEmi_C "OBD specific trouble code / OBD specific diagnostic trouble code for check DFC_MDEmi" VALUE 0x804F96F6 Val_Wu16 65535.00 DFES_OneToOne 0.00 65535.00 FORMAT "%8.2" /end CHARACTERISTIC
/begin CHARACTERISTIC DFES_DTCO.DFC_MDEmiStrt_C "OBD specific trouble code / OBD specific diagnostic trouble code for check DFC_MDEmiStrt" VALUE 0x804F96F8 Val_Wu16 65535.00 DFES_OneToOne 0.00 65535.00 FORMAT "%8.2" /end CHARACTERISTIC
/begin CHARACTERISTIC DFES_DTCO.DFC_MDFco_C "OBD specific trouble code / OBD specific diagnostic trouble code for check DFC_MDFco" VALUE 0x804F96FA Val_Wu16 65535.00 DFES_OneToOne 0.00 65535.00 FORMAT "%8.2" /end CHARACTERISTIC
/begin CHARACTERISTIC DFES_DTCO.DFC_MDMpl_C "OBD specific trouble code / OBD specific diagnostic trouble code for check DFC_MDMpl" VALUE 0x804F96FC Val_Wu16 65535.00 DFES_OneToOne 0.00 65535.00 FORMAT "%8.2" /end CHARACTERISTIC
/begin CHARACTERISTIC DFES_DTCO.DFC_MDSegTiAdpn_C "OBD specific trouble code / OBD specific diagnostic trouble code for check DFC_MDSegTiAdpn" VALUE 0x804F96FE Val_Wu16 65535.00 DFES_OneToOne 0.00 65535.00 FORMAT "%8.2" /end CHARACTERISTIC
/begin CHARACTERISTIC DFES_DTCO.DFC_MDmax_C "OBD specific trouble code / OBD specific diagnostic trouble code for check DFC_MDmax" VALUE 0x804F9700 Val_Wu16 65535.00 DFES_OneToOne 0.00 65535.00 FORMAT "%8.2" /end CHARACTERISTIC
/begin CHARACTERISTIC DFES_DTCO.DFC_MOXEMM_SMU_ALM0_0_C "OBD specific trouble code / OBD specific diagnostic trouble code for check DFC_MOXEMM_SMU_ALM0_0" VALUE 0x804F9702 Val_Wu16 65535.00 DFES_OneToOne 0.00 65535.00 FORMAT "%8.2" /end CHARACTERISTIC
/begin CHARACTERISTIC DFES_DTCO.DFC_MOXEMM_SMU_ALM0_1_C "OBD specific trouble code / OBD specific diagnostic trouble code for check DFC_MOXEMM_SMU_ALM0_1" VALUE 0x804F9704 Val_Wu16 65535.00 DFES_OneToOne 0.00 65535.00 FORMAT "%8.2" /end CHARACTERISTIC
/begin CHARACTERISTIC DFES_DTCO.DFC_MOXEMM_SMU_ALM0_10_C "OBD specific trouble code / OBD specific diagnostic trouble code for check DFC_MOXEMM_SMU_ALM0_10" VALUE 0x804F9706 Val_Wu16 65535.00 DFES_OneToOne 0.00 65535.00 FORMAT "%8.2" /end CHARACTERISTIC
/begin CHARACTERISTIC DFES_DTCO.DFC_MOXEMM_SMU_ALM0_11_C "OBD specific trouble code / OBD specific diagnostic trouble code for check DFC_MOXEMM_SMU_ALM0_11" VALUE 0x804F9708 Val_Wu16 65535.00 DFES_OneToOne 0.00 65535.00 FORMAT "%8.2" /end CHARACTERISTIC
/begin CHARACTERISTIC DFES_DTCO.DFC_MOXEMM_SMU_ALM0_13_C "OBD specific trouble code / OBD specific diagnostic trouble code for check DFC_MOXEMM_SMU_ALM0_13" VALUE 0x804F970A Val_Wu16 65535.00 DFES_OneToOne 0.00 65535.00 FORMAT "%8.2" /end CHARACTERISTIC
/begin CHARACTERISTIC DFES_DTCO.DFC_MOXEMM_SMU_ALM0_14_C "OBD specific trouble code / OBD specific diagnostic trouble code for check DFC_MOXEMM_SMU_ALM0_14" VALUE 0x804F970C Val_Wu16 65535.00 DFES_OneToOne 0.00 65535.00 FORMAT "%8.2" /end CHARACTERISTIC
/begin CHARACTERISTIC DFES_DTCO.DFC_MOXEMM_SMU_ALM0_2_C "OBD specific trouble code / OBD specific diagnostic trouble code for check DFC_MOXEMM_SMU_ALM0_2" VALUE 0x804F970E Val_Wu16 65535.00 DFES_OneToOne 0.00 65535.00 FORMAT "%8.2" /end CHARACTERISTIC
/begin CHARACTERISTIC DFES_DTCO.DFC_MOXEMM_SMU_ALM0_22_C "OBD specific trouble code / OBD specific diagnostic trouble code for check DFC_MOXEMM_SMU_ALM0_22" VALUE 0x804F9710 Val_Wu16 65535.00 DFES_OneToOne 0.00 65535.00 FORMAT "%8.2" /end CHARACTERISTIC
/begin CHARACTERISTIC DFES_DTCO.DFC_MOXEMM_SMU_ALM0_23_C "OBD specific trouble code / OBD specific diagnostic trouble code for check DFC_MOXEMM_SMU_ALM0_23" VALUE 0x804F9712 Val_Wu16 65535.00 DFES_OneToOne 0.00 65535.00 FORMAT "%8.2" /end CHARACTERISTIC
/begin CHARACTERISTIC DFES_DTCO.DFC_MOXEMM_SMU_ALM0_4_C "OBD specific trouble code / OBD specific diagnostic trouble code for check DFC_MOXEMM_SMU_ALM0_4" VALUE 0x804F9714 Val_Wu16 65535.00 DFES_OneToOne 0.00 65535.00 FORMAT "%8.2" /end CHARACTERISTIC
/begin CHARACTERISTIC DFES_DTCO.DFC_MOXEMM_SMU_ALM0_5_C "OBD specific trouble code / OBD specific diagnostic trouble code for check DFC_MOXEMM_SMU_ALM0_5" VALUE 0x804F9716 Val_Wu16 65535.00 DFES_OneToOne 0.00 65535.00 FORMAT "%8.2" /end CHARACTERISTIC
/begin CHARACTERISTIC DFES_DTCO.DFC_MOXEMM_SMU_ALM0_7_C "OBD specific trouble code / OBD specific diagnostic trouble code for check DFC_MOXEMM_SMU_ALM0_7" VALUE 0x804F9718 Val_Wu16 65535.00 DFES_OneToOne 0.00 65535.00 FORMAT "%8.2" /end CHARACTERISTIC
/begin CHARACTERISTIC DFES_DTCO.DFC_MOXEMM_SMU_ALM0_8_C "OBD specific trouble code / OBD specific diagnostic trouble code for check DFC_MOXEMM_SMU_ALM0_8" VALUE 0x804F971A Val_Wu16 65535.00 DFES_OneToOne 0.00 65535.00 FORMAT "%8.2" /end CHARACTERISTIC
/begin CHARACTERISTIC DFES_DTCO.DFC_MOXEMM_SMU_ALM10_16_C "OBD specific trouble code / OBD specific diagnostic trouble code for check DFC_MOXEMM_SMU_ALM10_16" VALUE 0x804F971C Val_Wu16 65535.00 DFES_OneToOne 0.00 65535.00 FORMAT "%8.2" /end CHARACTERISTIC
/begin CHARACTERISTIC DFES_DTCO.DFC_MOXEMM_SMU_ALM10_17_C "OBD specific trouble code / OBD specific diagnostic trouble code for check DFC_MOXEMM_SMU_ALM10_17" VALUE 0x804F971E Val_Wu16 65535.00 DFES_OneToOne 0.00 65535.00 FORMAT "%8.2" /end CHARACTERISTIC
/begin CHARACTERISTIC DFES_DTCO.DFC_MOXEMM_SMU_ALM10_21_C "OBD specific trouble code / OBD specific diagnostic trouble code for check DFC_MOXEMM_SMU_ALM10_21" VALUE 0x804F9720 Val_Wu16 65535.00 DFES_OneToOne 0.00 65535.00 FORMAT "%8.2" /end CHARACTERISTIC
/begin CHARACTERISTIC DFES_DTCO.DFC_MOXEMM_SMU_ALM11_0_C "OBD specific trouble code / OBD specific diagnostic trouble code for check DFC_MOXEMM_SMU_ALM11_0" VALUE 0x804F9722 Val_Wu16 65535.00 DFES_OneToOne 0.00 65535.00 FORMAT "%8.2" /end CHARACTERISTIC
/begin CHARACTERISTIC DFES_DTCO.DFC_MOXEMM_SMU_ALM11_1_C "OBD specific trouble code / OBD specific diagnostic trouble code for check DFC_MOXEMM_SMU_ALM11_1" VALUE 0x804F9724 Val_Wu16 65535.00 DFES_OneToOne 0.00 65535.00 FORMAT "%8.2" /end CHARACTERISTIC
/begin CHARACTERISTIC DFES_DTCO.DFC_MOXEMM_SMU_ALM11_2_C "OBD specific trouble code / OBD specific diagnostic trouble code for check DFC_MOXEMM_SMU_ALM11_2" VALUE 0x804F9726 Val_Wu16 65535.00 DFES_OneToOne 0.00 65535.00 FORMAT "%8.2" /end CHARACTERISTIC
/begin CHARACTERISTIC DFES_DTCO.DFC_MOXEMM_SMU_ALM11_3_C "OBD specific trouble code / OBD specific diagnostic trouble code for check DFC_MOXEMM_SMU_ALM11_3" VALUE 0x804F9728 Val_Wu16 65535.00 DFES_OneToOne 0.00 65535.00 FORMAT "%8.2" /end CHARACTERISTIC
/begin CHARACTERISTIC DFES_DTCO.DFC_MOXEMM_SMU_ALM11_4_C "OBD specific trouble code / OBD specific diagnostic trouble code for check DFC_MOXEMM_SMU_ALM11_4" VALUE 0x804F972A Val_Wu16 65535.00 DFES_OneToOne 0.00 65535.00 FORMAT "%8.2" /end CHARACTERISTIC
/begin CHARACTERISTIC DFES_DTCO.DFC_MOXEMM_SMU_ALM11_5_C "OBD specific trouble code / OBD specific diagnostic trouble code for check DFC_MOXEMM_SMU_ALM11_5" VALUE 0x804F972C Val_Wu16 65535.00 DFES_OneToOne 0.00 65535.00 FORMAT "%8.2" /end CHARACTERISTIC
/begin CHARACTERISTIC DFES_DTCO.DFC_MOXEMM_SMU_ALM11_8_C "OBD specific trouble code / OBD specific diagnostic trouble code for check DFC_MOXEMM_SMU_ALM11_8" VALUE 0x804F972E Val_Wu16 65535.00 DFES_OneToOne 0.00 65535.00 FORMAT "%8.2" /end CHARACTERISTIC
/begin CHARACTERISTIC DFES_DTCO.DFC_MOXEMM_SMU_ALM11_9_C "OBD specific trouble code / OBD specific diagnostic trouble code for check DFC_MOXEMM_SMU_ALM11_9" VALUE 0x804F9730 Val_Wu16 65535.00 DFES_OneToOne 0.00 65535.00 FORMAT "%8.2" /end CHARACTERISTIC
/begin CHARACTERISTIC DFES_DTCO.DFC_MOXEMM_SMU_ALM1_0_C "OBD specific trouble code / OBD specific diagnostic trouble code for check DFC_MOXEMM_SMU_ALM1_0" VALUE 0x804F9732 Val_Wu16 65535.00 DFES_OneToOne 0.00 65535.00 FORMAT "%8.2" /end CHARACTERISTIC
/begin CHARACTERISTIC DFES_DTCO.DFC_MOXEMM_SMU_ALM1_1_C "OBD specific trouble code / OBD specific diagnostic trouble code for check DFC_MOXEMM_SMU_ALM1_1" VALUE 0x804F9734 Val_Wu16 65535.00 DFES_OneToOne 0.00 65535.00 FORMAT "%8.2" /end CHARACTERISTIC
/begin CHARACTERISTIC DFES_DTCO.DFC_MOXEMM_SMU_ALM1_10_C "OBD specific trouble code / OBD specific diagnostic trouble code for check DFC_MOXEMM_SMU_ALM1_10" VALUE 0x804F9736 Val_Wu16 65535.00 DFES_OneToOne 0.00 65535.00 FORMAT "%8.2" /end CHARACTERISTIC
/begin CHARACTERISTIC DFES_DTCO.DFC_MOXEMM_SMU_ALM1_11_C "OBD specific trouble code / OBD specific diagnostic trouble code for check DFC_MOXEMM_SMU_ALM1_11" VALUE 0x804F9738 Val_Wu16 65535.00 DFES_OneToOne 0.00 65535.00 FORMAT "%8.2" /end CHARACTERISTIC
/begin CHARACTERISTIC DFES_DTCO.DFC_MOXEMM_SMU_ALM1_13_C "OBD specific trouble code / OBD specific diagnostic trouble code for check DFC_MOXEMM_SMU_ALM1_13" VALUE 0x804F973A Val_Wu16 65535.00 DFES_OneToOne 0.00 65535.00 FORMAT "%8.2" /end CHARACTERISTIC
/begin CHARACTERISTIC DFES_DTCO.DFC_MOXEMM_SMU_ALM1_14_C "OBD specific trouble code / OBD specific diagnostic trouble code for check DFC_MOXEMM_SMU_ALM1_14" VALUE 0x804F973C Val_Wu16 65535.00 DFES_OneToOne 0.00 65535.00 FORMAT "%8.2" /end CHARACTERISTIC
/begin CHARACTERISTIC DFES_DTCO.DFC_MOXEMM_SMU_ALM1_2_C "OBD specific trouble code / OBD specific diagnostic trouble code for check DFC_MOXEMM_SMU_ALM1_2" VALUE 0x804F973E Val_Wu16 65535.00 DFES_OneToOne 0.00 65535.00 FORMAT "%8.2" /end CHARACTERISTIC
/begin CHARACTERISTIC DFES_DTCO.DFC_MOXEMM_SMU_ALM1_22_C "OBD specific trouble code / OBD specific diagnostic trouble code for check DFC_MOXEMM_SMU_ALM1_22" VALUE 0x804F9740 Val_Wu16 65535.00 DFES_OneToOne 0.00 65535.00 FORMAT "%8.2" /end CHARACTERISTIC
/begin CHARACTERISTIC DFES_DTCO.DFC_MOXEMM_SMU_ALM1_23_C "OBD specific trouble code / OBD specific diagnostic trouble code for check DFC_MOXEMM_SMU_ALM1_23" VALUE 0x804F9742 Val_Wu16 65535.00 DFES_OneToOne 0.00 65535.00 FORMAT "%8.2" /end CHARACTERISTIC
/begin CHARACTERISTIC DFES_DTCO.DFC_MOXEMM_SMU_ALM1_4_C "OBD specific trouble code / OBD specific diagnostic trouble code for check DFC_MOXEMM_SMU_ALM1_4" VALUE 0x804F9744 Val_Wu16 65535.00 DFES_OneToOne 0.00 65535.00 FORMAT "%8.2" /end CHARACTERISTIC
/begin CHARACTERISTIC DFES_DTCO.DFC_MOXEMM_SMU_ALM1_5_C "OBD specific trouble code / OBD specific diagnostic trouble code for check DFC_MOXEMM_SMU_ALM1_5" VALUE 0x804F9746 Val_Wu16 65535.00 DFES_OneToOne 0.00 65535.00 FORMAT "%8.2" /end CHARACTERISTIC
/begin CHARACTERISTIC DFES_DTCO.DFC_MOXEMM_SMU_ALM1_7_C "OBD specific trouble code / OBD specific diagnostic trouble code for check DFC_MOXEMM_SMU_ALM1_7" VALUE 0x804F9748 Val_Wu16 65535.00 DFES_OneToOne 0.00 65535.00 FORMAT "%8.2" /end CHARACTERISTIC
/begin CHARACTERISTIC DFES_DTCO.DFC_MOXEMM_SMU_ALM1_8_C "OBD specific trouble code / OBD specific diagnostic trouble code for check DFC_MOXEMM_SMU_ALM1_8" VALUE 0x804F974A Val_Wu16 65535.00 DFES_OneToOne 0.00 65535.00 FORMAT "%8.2" /end CHARACTERISTIC
/begin CHARACTERISTIC DFES_DTCO.DFC_MOXEMM_SMU_ALM21_0_C "OBD specific trouble code / OBD specific diagnostic trouble code for check DFC_MOXEMM_SMU_ALM21_0" VALUE 0x804F974C Val_Wu16 65535.00 DFES_OneToOne 0.00 65535.00 FORMAT "%8.2" /end CHARACTERISTIC
/begin CHARACTERISTIC DFES_DTCO.DFC_MOXEMM_SMU_ALM21_16_C "OBD specific trouble code / OBD specific diagnostic trouble code for check DFC_MOXEMM_SMU_ALM21_16" VALUE 0x804F974E Val_Wu16 65535.00 DFES_OneToOne 0.00 65535.00 FORMAT "%8.2" /end CHARACTERISTIC
/begin CHARACTERISTIC DFES_DTCO.DFC_MOXEMM_SMU_ALM21_3_C "OBD specific trouble code / OBD specific diagnostic trouble code for check DFC_MOXEMM_SMU_ALM21_3" VALUE 0x804F9750 Val_Wu16 65535.00 DFES_OneToOne 0.00 65535.00 FORMAT "%8.2" /end CHARACTERISTIC
/begin CHARACTERISTIC DFES_DTCO.DFC_MOXEMM_SMU_ALM2_1_C "OBD specific trouble code / OBD specific diagnostic trouble code for check DFC_MOXEMM_SMU_ALM2_1" VALUE 0x804F9752 Val_Wu16 65535.00 DFES_OneToOne 0.00 65535.00 FORMAT "%8.2" /end CHARACTERISTIC
/begin CHARACTERISTIC DFES_DTCO.DFC_MOXEMM_SMU_ALM2_10_C "OBD specific trouble code / OBD specific diagnostic trouble code for check DFC_MOXEMM_SMU_ALM2_10" VALUE 0x804F9754 Val_Wu16 65535.00 DFES_OneToOne 0.00 65535.00 FORMAT "%8.2" /end CHARACTERISTIC
/begin CHARACTERISTIC DFES_DTCO.DFC_MOXEMM_SMU_ALM2_11_C "OBD specific trouble code / OBD specific diagnostic trouble code for check DFC_MOXEMM_SMU_ALM2_11" VALUE 0x804F9756 Val_Wu16 65535.00 DFES_OneToOne 0.00 65535.00 FORMAT "%8.2" /end CHARACTERISTIC
/begin CHARACTERISTIC DFES_DTCO.DFC_MOXEMM_SMU_ALM2_13_C "OBD specific trouble code / OBD specific diagnostic trouble code for check DFC_MOXEMM_SMU_ALM2_13" VALUE 0x804F9758 Val_Wu16 65535.00 DFES_OneToOne 0.00 65535.00 FORMAT "%8.2" /end CHARACTERISTIC
/begin CHARACTERISTIC DFES_DTCO.DFC_MOXEMM_SMU_ALM2_14_C "OBD specific trouble code / OBD specific diagnostic trouble code for check DFC_MOXEMM_SMU_ALM2_14" VALUE 0x804F975A Val_Wu16 65535.00 DFES_OneToOne 0.00 65535.00 FORMAT "%8.2" /end CHARACTERISTIC
/begin CHARACTERISTIC DFES_DTCO.DFC_MOXEMM_SMU_ALM2_22_C "OBD specific trouble code / OBD specific diagnostic trouble code for check DFC_MOXEMM_SMU_ALM2_22" VALUE 0x804F975C Val_Wu16 65535.00 DFES_OneToOne 0.00 65535.00 FORMAT "%8.2" /end CHARACTERISTIC
/begin CHARACTERISTIC DFES_DTCO.DFC_MOXEMM_SMU_ALM2_23_C "OBD specific trouble code / OBD specific diagnostic trouble code for check DFC_MOXEMM_SMU_ALM2_23" VALUE 0x804F975E Val_Wu16 65535.00 DFES_OneToOne 0.00 65535.00 FORMAT "%8.2" /end CHARACTERISTIC
/begin CHARACTERISTIC DFES_DTCO.DFC_MOXEMM_SMU_ALM2_4_C "OBD specific trouble code / OBD specific diagnostic trouble code for check DFC_MOXEMM_SMU_ALM2_4" VALUE 0x804F9760 Val_Wu16 65535.00 DFES_OneToOne 0.00 65535.00 FORMAT "%8.2" /end CHARACTERISTIC
/begin CHARACTERISTIC DFES_DTCO.DFC_MOXEMM_SMU_ALM2_5_C "OBD specific trouble code / OBD specific diagnostic trouble code for check DFC_MOXEMM_SMU_ALM2_5" VALUE 0x804F9762 Val_Wu16 65535.00 DFES_OneToOne 0.00 65535.00 FORMAT "%8.2" /end CHARACTERISTIC
/begin CHARACTERISTIC DFES_DTCO.DFC_MOXEMM_SMU_ALM2_7_C "OBD specific trouble code / OBD specific diagnostic trouble code for check DFC_MOXEMM_SMU_ALM2_7" VALUE 0x804F9764 Val_Wu16 65535.00 DFES_OneToOne 0.00 65535.00 FORMAT "%8.2" /end CHARACTERISTIC
/begin CHARACTERISTIC DFES_DTCO.DFC_MOXEMM_SMU_ALM2_8_C "OBD specific trouble code / OBD specific diagnostic trouble code for check DFC_MOXEMM_SMU_ALM2_8" VALUE 0x804F9766 Val_Wu16 65535.00 DFES_OneToOne 0.00 65535.00 FORMAT "%8.2" /end CHARACTERISTIC
/begin CHARACTERISTIC DFES_DTCO.DFC_MOXEMM_SMU_ALM6_0_C "OBD specific trouble code / OBD specific diagnostic trouble code for check DFC_MOXEMM_SMU_ALM6_0" VALUE 0x804F9768 Val_Wu16 65535.00 DFES_OneToOne 0.00 65535.00 FORMAT "%8.2" /end CHARACTERISTIC
/begin CHARACTERISTIC DFES_DTCO.DFC_MOXEMM_SMU_ALM6_11_C "OBD specific trouble code / OBD specific diagnostic trouble code for check DFC_MOXEMM_SMU_ALM6_11" VALUE 0x804F976A Val_Wu16 65535.00 DFES_OneToOne 0.00 65535.00 FORMAT "%8.2" /end CHARACTERISTIC
/begin CHARACTERISTIC DFES_DTCO.DFC_MOXEMM_SMU_ALM6_12_C "OBD specific trouble code / OBD specific diagnostic trouble code for check DFC_MOXEMM_SMU_ALM6_12" VALUE 0x804F976C Val_Wu16 65535.00 DFES_OneToOne 0.00 65535.00 FORMAT "%8.2" /end CHARACTERISTIC
/begin CHARACTERISTIC DFES_DTCO.DFC_MOXEMM_SMU_ALM6_14_C "OBD specific trouble code / OBD specific diagnostic trouble code for check DFC_MOXEMM_SMU_ALM6_14" VALUE 0x804F976E Val_Wu16 65535.00 DFES_OneToOne 0.00 65535.00 FORMAT "%8.2" /end CHARACTERISTIC
/begin CHARACTERISTIC DFES_DTCO.DFC_MOXEMM_SMU_ALM6_15_C "OBD specific trouble code / OBD specific diagnostic trouble code for check DFC_MOXEMM_SMU_ALM6_15" VALUE 0x804F9770 Val_Wu16 65535.00 DFES_OneToOne 0.00 65535.00 FORMAT "%8.2" /end CHARACTERISTIC
/begin CHARACTERISTIC DFES_DTCO.DFC_MOXEMM_SMU_ALM6_17_C "OBD specific trouble code / OBD specific diagnostic trouble code for check DFC_MOXEMM_SMU_ALM6_17" VALUE 0x804F9772 Val_Wu16 65535.00 DFES_OneToOne 0.00 65535.00 FORMAT "%8.2" /end CHARACTERISTIC
/begin CHARACTERISTIC DFES_DTCO.DFC_MOXEMM_SMU_ALM6_18_C "OBD specific trouble code / OBD specific diagnostic trouble code for check DFC_MOXEMM_SMU_ALM6_18" VALUE 0x804F9774 Val_Wu16 65535.00 DFES_OneToOne 0.00 65535.00 FORMAT "%8.2" /end CHARACTERISTIC
/begin CHARACTERISTIC DFES_DTCO.DFC_MOXEMM_SMU_ALM6_20_C "OBD specific trouble code / OBD specific diagnostic trouble code for check DFC_MOXEMM_SMU_ALM6_20" VALUE 0x804F9776 Val_Wu16 65535.00 DFES_OneToOne 0.00 65535.00 FORMAT "%8.2" /end CHARACTERISTIC
/begin CHARACTERISTIC DFES_DTCO.DFC_MOXEMM_SMU_ALM6_21_C "OBD specific trouble code / OBD specific diagnostic trouble code for check DFC_MOXEMM_SMU_ALM6_21" VALUE 0x804F9778 Val_Wu16 65535.00 DFES_OneToOne 0.00 65535.00 FORMAT "%8.2" /end CHARACTERISTIC
/begin CHARACTERISTIC DFES_DTCO.DFC_MOXEMM_SMU_ALM6_25_C "OBD specific trouble code / OBD specific diagnostic trouble code for check DFC_MOXEMM_SMU_ALM6_25" VALUE 0x804F977A Val_Wu16 65535.00 DFES_OneToOne 0.00 65535.00 FORMAT "%8.2" /end CHARACTERISTIC
/begin CHARACTERISTIC DFES_DTCO.DFC_MOXEMM_SMU_ALM6_4_C "OBD specific trouble code / OBD specific diagnostic trouble code for check DFC_MOXEMM_SMU_ALM6_4" VALUE 0x804F977C Val_Wu16 65535.00 DFES_OneToOne 0.00 65535.00 FORMAT "%8.2" /end CHARACTERISTIC
/begin CHARACTERISTIC DFES_DTCO.DFC_MOXEMM_SMU_ALM6_5_C "OBD specific trouble code / OBD specific diagnostic trouble code for check DFC_MOXEMM_SMU_ALM6_5" VALUE 0x804F977E Val_Wu16 65535.00 DFES_OneToOne 0.00 65535.00 FORMAT "%8.2" /end CHARACTERISTIC
/begin CHARACTERISTIC DFES_DTCO.DFC_MOXEMM_SMU_ALM6_7_C "OBD specific trouble code / OBD specific diagnostic trouble code for check DFC_MOXEMM_SMU_ALM6_7" VALUE 0x804F9780 Val_Wu16 65535.00 DFES_OneToOne 0.00 65535.00 FORMAT "%8.2" /end CHARACTERISTIC
/begin CHARACTERISTIC DFES_DTCO.DFC_MOXEMM_SMU_ALM6_8_C "OBD specific trouble code / OBD specific diagnostic trouble code for check DFC_MOXEMM_SMU_ALM6_8" VALUE 0x804F9782 Val_Wu16 65535.00 DFES_OneToOne 0.00 65535.00 FORMAT "%8.2" /end CHARACTERISTIC
/begin CHARACTERISTIC DFES_DTCO.DFC_MOXEMM_SMU_ALM7_1_C "OBD specific trouble code / OBD specific diagnostic trouble code for check DFC_MOXEMM_SMU_ALM7_1" VALUE 0x804F9784 Val_Wu16 65535.00 DFES_OneToOne 0.00 65535.00 FORMAT "%8.2" /end CHARACTERISTIC
/begin CHARACTERISTIC DFES_DTCO.DFC_MOXEMM_SMU_ALM7_12_C "OBD specific trouble code / OBD specific diagnostic trouble code for check DFC_MOXEMM_SMU_ALM7_12" VALUE 0x804F9786 Val_Wu16 65535.00 DFES_OneToOne 0.00 65535.00 FORMAT "%8.2" /end CHARACTERISTIC
/begin CHARACTERISTIC DFES_DTCO.DFC_MOXEMM_SMU_ALM7_13_C "OBD specific trouble code / OBD specific diagnostic trouble code for check DFC_MOXEMM_SMU_ALM7_13" VALUE 0x804F9788 Val_Wu16 65535.00 DFES_OneToOne 0.00 65535.00 FORMAT "%8.2" /end CHARACTERISTIC
/begin CHARACTERISTIC DFES_DTCO.DFC_MOXEMM_SMU_ALM7_14_C "OBD specific trouble code / OBD specific diagnostic trouble code for check DFC_MOXEMM_SMU_ALM7_14" VALUE 0x804F978A Val_Wu16 65535.00 DFES_OneToOne 0.00 65535.00 FORMAT "%8.2" /end CHARACTERISTIC
/begin CHARACTERISTIC DFES_DTCO.DFC_MOXEMM_SMU_ALM7_15_C "OBD specific trouble code / OBD specific diagnostic trouble code for check DFC_MOXEMM_SMU_ALM7_15" VALUE 0x804F978C Val_Wu16 65535.00 DFES_OneToOne 0.00 65535.00 FORMAT "%8.2" /end CHARACTERISTIC
/begin CHARACTERISTIC DFES_DTCO.DFC_MOXEMM_SMU_ALM7_16_C "OBD specific trouble code / OBD specific diagnostic trouble code for check DFC_MOXEMM_SMU_ALM7_16" VALUE 0x804F978E Val_Wu16 65535.00 DFES_OneToOne 0.00 65535.00 FORMAT "%8.2" /end CHARACTERISTIC
/begin CHARACTERISTIC DFES_DTCO.DFC_MOXEMM_SMU_ALM7_17_C "OBD specific trouble code / OBD specific diagnostic trouble code for check DFC_MOXEMM_SMU_ALM7_17" VALUE 0x804F9790 Val_Wu16 65535.00 DFES_OneToOne 0.00 65535.00 FORMAT "%8.2" /end CHARACTERISTIC
/begin CHARACTERISTIC DFES_DTCO.DFC_MOXEMM_SMU_ALM7_2_C "OBD specific trouble code / OBD specific diagnostic trouble code for check DFC_MOXEMM_SMU_ALM7_2" VALUE 0x804F9792 Val_Wu16 65535.00 DFES_OneToOne 0.00 65535.00 FORMAT "%8.2" /end CHARACTERISTIC
/begin CHARACTERISTIC DFES_DTCO.DFC_MOXEMM_SMU_ALM7_20_C "OBD specific trouble code / OBD specific diagnostic trouble code for check DFC_MOXEMM_SMU_ALM7_20" VALUE 0x804F9794 Val_Wu16 65535.00 DFES_OneToOne 0.00 65535.00 FORMAT "%8.2" /end CHARACTERISTIC
/begin CHARACTERISTIC DFES_DTCO.DFC_MOXEMM_SMU_ALM7_25_C "OBD specific trouble code / OBD specific diagnostic trouble code for check DFC_MOXEMM_SMU_ALM7_25" VALUE 0x804F9796 Val_Wu16 65535.00 DFES_OneToOne 0.00 65535.00 FORMAT "%8.2" /end CHARACTERISTIC
/begin CHARACTERISTIC DFES_DTCO.DFC_MOXEMM_SMU_ALM7_26_C "OBD specific trouble code / OBD specific diagnostic trouble code for check DFC_MOXEMM_SMU_ALM7_26" VALUE 0x804F9798 Val_Wu16 65535.00 DFES_OneToOne 0.00 65535.00 FORMAT "%8.2" /end CHARACTERISTIC
/begin CHARACTERISTIC DFES_DTCO.DFC_MOXEMM_SMU_ALM7_28_C "OBD specific trouble code / OBD specific diagnostic trouble code for check DFC_MOXEMM_SMU_ALM7_28" VALUE 0x804F979A Val_Wu16 65535.00 DFES_OneToOne 0.00 65535.00 FORMAT "%8.2" /end CHARACTERISTIC
/begin CHARACTERISTIC DFES_DTCO.DFC_MOXEMM_SMU_ALM7_29_C "OBD specific trouble code / OBD specific diagnostic trouble code for check DFC_MOXEMM_SMU_ALM7_29" VALUE 0x804F979C Val_Wu16 65535.00 DFES_OneToOne 0.00 65535.00 FORMAT "%8.2" /end CHARACTERISTIC
/begin CHARACTERISTIC DFES_DTCO.DFC_MOXEMM_SMU_ALM7_30_C "OBD specific trouble code / OBD specific diagnostic trouble code for check DFC_MOXEMM_SMU_ALM7_30" VALUE 0x804F979E Val_Wu16 65535.00 DFES_OneToOne 0.00 65535.00 FORMAT "%8.2" /end CHARACTERISTIC
/begin CHARACTERISTIC DFES_DTCO.DFC_MOXEMM_SMU_ALM7_31_C "OBD specific trouble code / OBD specific diagnostic trouble code for check DFC_MOXEMM_SMU_ALM7_31" VALUE 0x804F97A0 Val_Wu16 65535.00 DFES_OneToOne 0.00 65535.00 FORMAT "%8.2" /end CHARACTERISTIC
/begin CHARACTERISTIC DFES_DTCO.DFC_MOXEMM_SMU_ALM8_0_C "OBD specific trouble code / OBD specific diagnostic trouble code for check DFC_MOXEMM_SMU_ALM8_0" VALUE 0x804F97A2 Val_Wu16 65535.00 DFES_OneToOne 0.00 65535.00 FORMAT "%8.2" /end CHARACTERISTIC
/begin CHARACTERISTIC DFES_DTCO.DFC_MOXEMM_SMU_ALM8_1_C "OBD specific trouble code / OBD specific diagnostic trouble code for check DFC_MOXEMM_SMU_ALM8_1" VALUE 0x804F97A4 Val_Wu16 65535.00 DFES_OneToOne 0.00 65535.00 FORMAT "%8.2" /end CHARACTERISTIC
/begin CHARACTERISTIC DFES_DTCO.DFC_MOXEMM_SMU_ALM8_10_C "OBD specific trouble code / OBD specific diagnostic trouble code for check DFC_MOXEMM_SMU_ALM8_10" VALUE 0x804F97A6 Val_Wu16 65535.00 DFES_OneToOne 0.00 65535.00 FORMAT "%8.2" /end CHARACTERISTIC
/begin CHARACTERISTIC DFES_DTCO.DFC_MOXEMM_SMU_ALM8_11_C "OBD specific trouble code / OBD specific diagnostic trouble code for check DFC_MOXEMM_SMU_ALM8_11" VALUE 0x804F97A8 Val_Wu16 65535.00 DFES_OneToOne 0.00 65535.00 FORMAT "%8.2" /end CHARACTERISTIC
/begin CHARACTERISTIC DFES_DTCO.DFC_MOXEMM_SMU_ALM8_12_C "OBD specific trouble code / OBD specific diagnostic trouble code for check DFC_MOXEMM_SMU_ALM8_12" VALUE 0x804F97AA Val_Wu16 65535.00 DFES_OneToOne 0.00 65535.00 FORMAT "%8.2" /end CHARACTERISTIC
/begin CHARACTERISTIC DFES_DTCO.DFC_MOXEMM_SMU_ALM8_16_C "OBD specific trouble code / OBD specific diagnostic trouble code for check DFC_MOXEMM_SMU_ALM8_16" VALUE 0x804F97AC Val_Wu16 65535.00 DFES_OneToOne 0.00 65535.00 FORMAT "%8.2" /end CHARACTERISTIC
/begin CHARACTERISTIC DFES_DTCO.DFC_MOXEMM_SMU_ALM8_18_C "OBD specific trouble code / OBD specific diagnostic trouble code for check DFC_MOXEMM_SMU_ALM8_18" VALUE 0x804F97AE Val_Wu16 65535.00 DFES_OneToOne 0.00 65535.00 FORMAT "%8.2" /end CHARACTERISTIC
/begin CHARACTERISTIC DFES_DTCO.DFC_MOXEMM_SMU_ALM8_2_C "OBD specific trouble code / OBD specific diagnostic trouble code for check DFC_MOXEMM_SMU_ALM8_2" VALUE 0x804F97B0 Val_Wu16 65535.00 DFES_OneToOne 0.00 65535.00 FORMAT "%8.2" /end CHARACTERISTIC
/begin CHARACTERISTIC DFES_DTCO.DFC_MOXEMM_SMU_ALM8_3_C "OBD specific trouble code / OBD specific diagnostic trouble code for check DFC_MOXEMM_SMU_ALM8_3" VALUE 0x804F97B2 Val_Wu16 65535.00 DFES_OneToOne 0.00 65535.00 FORMAT "%8.2" /end CHARACTERISTIC
/begin CHARACTERISTIC DFES_DTCO.DFC_MOXEMM_SMU_ALM8_31_C "OBD specific trouble code / OBD specific diagnostic trouble code for check DFC_MOXEMM_SMU_ALM8_31" VALUE 0x804F97B4 Val_Wu16 65535.00 DFES_OneToOne 0.00 65535.00 FORMAT "%8.2" /end CHARACTERISTIC
/begin CHARACTERISTIC DFES_DTCO.DFC_MOXEMM_SMU_ALM8_4_C "OBD specific trouble code / OBD specific diagnostic trouble code for check DFC_MOXEMM_SMU_ALM8_4" VALUE 0x804F97B6 Val_Wu16 65535.00 DFES_OneToOne 0.00 65535.00 FORMAT "%8.2" /end CHARACTERISTIC
/begin CHARACTERISTIC DFES_DTCO.DFC_MOXEMM_SMU_ALM9_0_C "OBD specific trouble code / OBD specific diagnostic trouble code for check DFC_MOXEMM_SMU_ALM9_0" VALUE 0x804F97B8 Val_Wu16 65535.00 DFES_OneToOne 0.00 65535.00 FORMAT "%8.2" /end CHARACTERISTIC
/begin CHARACTERISTIC DFES_DTCO.DFC_MOXEMM_SMU_ALM9_15_C "OBD specific trouble code / OBD specific diagnostic trouble code for check DFC_MOXEMM_SMU_ALM9_15" VALUE 0x804F97BA Val_Wu16 65535.00 DFES_OneToOne 0.00 65535.00 FORMAT "%8.2" /end CHARACTERISTIC
/begin CHARACTERISTIC DFES_DTCO.DFC_MOXEMM_SMU_ALM9_3_C "OBD specific trouble code / OBD specific diagnostic trouble code for check DFC_MOXEMM_SMU_ALM9_3" VALUE 0x804F97BC Val_Wu16 65535.00 DFES_OneToOne 0.00 65535.00 FORMAT "%8.2" /end CHARACTERISTIC
/begin CHARACTERISTIC DFES_DTCO.DFC_MoCADCNTP_C "OBD specific trouble code / OBD specific diagnostic trouble code for check DFC_MoCADCNTP" VALUE 0x804F97BE Val_Wu16 65535.00 DFES_OneToOne 0.00 65535.00 FORMAT "%8.2" /end CHARACTERISTIC
/begin CHARACTERISTIC DFES_DTCO.DFC_MoCADCTst_C "OBD specific trouble code / OBD specific diagnostic trouble code for check DFC_MoCADCTst" VALUE 0x804F97C0 Val_Wu16 65535.00 DFES_OneToOne 0.00 65535.00 FORMAT "%8.2" /end CHARACTERISTIC
/begin CHARACTERISTIC DFES_DTCO.DFC_MoCSOPICO_C "OBD specific trouble code / OBD specific diagnostic trouble code for check DFC_MoCSOPICO" VALUE 0x804F97C2 Val_Wu16 65535.00 DFES_OneToOne 0.00 65535.00 FORMAT "%8.2" /end CHARACTERISTIC
/begin CHARACTERISTIC DFES_DTCO.DFC_MoFAPP_C "OBD specific trouble code / OBD specific diagnostic trouble code for check DFC_MoFAPP" VALUE 0x804F97C4 Val_Wu16 65535.00 DFES_OneToOne 0.00 65535.00 FORMAT "%8.2" /end CHARACTERISTIC
/begin CHARACTERISTIC DFES_DTCO.DFC_MoFAirFilgPrdc_C "OBD specific trouble code / OBD specific diagnostic trouble code for check DFC_MoFAirFilgPrdc" VALUE 0x804F97C6 Val_Wu16 65535.00 DFES_OneToOne 0.00 65535.00 FORMAT "%8.2" /end CHARACTERISTIC
/begin CHARACTERISTIC DFES_DTCO.DFC_MoFAirFlCtOffPfi_C "OBD specific trouble code / OBD specific diagnostic trouble code for check DFC_MoFAirFlCtOffPfi" VALUE 0x804F97C8 Val_Wu16 65535.00 DFES_OneToOne 0.00 65535.00 FORMAT "%8.2" /end CHARACTERISTIC
/begin CHARACTERISTIC DFES_DTCO.DFC_MoFAirFlCylPfi_C "OBD specific trouble code / OBD specific diagnostic trouble code for check DFC_MoFAirFlCylPfi" VALUE 0x804F97CA Val_Wu16 65535.00 DFES_OneToOne 0.00 65535.00 FORMAT "%8.2" /end CHARACTERISTIC
/begin CHARACTERISTIC DFES_DTCO.DFC_MoFAirFlIn_C "OBD specific trouble code / OBD specific diagnostic trouble code for check DFC_MoFAirFlIn" VALUE 0x804F97CC Val_Wu16 65535.00 DFES_OneToOne 0.00 65535.00 FORMAT "%8.2" /end CHARACTERISTIC
/begin CHARACTERISTIC DFES_DTCO.DFC_MoFAirFlMixCtlPfiChkAirFl_C "OBD specific trouble code / OBD specific diagnostic trouble code for check DFC_MoFAirFlMixCtlPfiChkAirFl" VALUE 0x804F97CE Val_Wu16 65535.00 DFES_OneToOne 0.00 65535.00 FORMAT "%8.2" /end CHARACTERISTIC
/begin CHARACTERISTIC DFES_DTCO.DFC_MoFAirFlMixCtlPfiChkCtrl_C "OBD specific trouble code / OBD specific diagnostic trouble code for check DFC_MoFAirFlMixCtlPfiChkCtrl" VALUE 0x804F97D0 Val_Wu16 65535.00 DFES_OneToOne 0.00 65535.00 FORMAT "%8.2" /end CHARACTERISTIC
/begin CHARACTERISTIC DFES_DTCO.DFC_MoFAirFlMode_C "OBD specific trouble code / OBD specific diagnostic trouble code for check DFC_MoFAirFlMode" VALUE 0x804F97D2 Val_Wu16 65535.00 DFES_OneToOne 0.00 65535.00 FORMAT "%8.2" /end CHARACTERISTIC
/begin CHARACTERISTIC DFES_DTCO.DFC_MoFESpd_C "OBD specific trouble code / OBD specific diagnostic trouble code for check DFC_MoFESpd" VALUE 0x804F97D4 Val_Wu16 65535.00 DFES_OneToOne 0.00 65535.00 FORMAT "%8.2" /end CHARACTERISTIC
/begin CHARACTERISTIC DFES_DTCO.DFC_MoFIACo_C "OBD specific trouble code / OBD specific diagnostic trouble code for check DFC_MoFIACo" VALUE 0x804F97D6 Val_Wu16 65535.00 DFES_OneToOne 0.00 65535.00 FORMAT "%8.2" /end CHARACTERISTIC
/begin CHARACTERISTIC DFES_DTCO.DFC_MoFICOL1_C "OBD specific trouble code / OBD specific diagnostic trouble code for check DFC_MoFICOL1" VALUE 0x804F97D8 Val_Wu16 65535.00 DFES_OneToOne 0.00 65535.00 FORMAT "%8.2" /end CHARACTERISTIC
/begin CHARACTERISTIC DFES_DTCO.DFC_MoFICOL2_C "OBD specific trouble code / OBD specific diagnostic trouble code for check DFC_MoFICOL2" VALUE 0x804F97DA Val_Wu16 65535.00 DFES_OneToOne 0.00 65535.00 FORMAT "%8.2" /end CHARACTERISTIC
/begin CHARACTERISTIC DFES_DTCO.DFC_MoFStrt_C "OBD specific trouble code / OBD specific diagnostic trouble code for check DFC_MoFStrt" VALUE 0x804F97DC Val_Wu16 65535.00 DFES_OneToOne 0.00 65535.00 FORMAT "%8.2" /end CHARACTERISTIC
/begin CHARACTERISTIC DFES_DTCO.DFC_MoFTrqCmp_C "OBD specific trouble code / OBD specific diagnostic trouble code for check DFC_MoFTrqCmp" VALUE 0x804F97DE Val_Wu16 65535.00 DFES_OneToOne 0.00 65535.00 FORMAT "%8.2" /end CHARACTERISTIC
/begin CHARACTERISTIC DFES_DTCO.DFC_MoFTrqCmpMax_C "OBD specific trouble code / OBD specific diagnostic trouble code for check DFC_MoFTrqCmpMax" VALUE 0x804F97E0 Val_Wu16 65535.00 DFES_OneToOne 0.00 65535.00 FORMAT "%8.2" /end CHARACTERISTIC
/begin CHARACTERISTIC DFES_DTCO.DFC_MoFTrqCmpMin_C "OBD specific trouble code / OBD specific diagnostic trouble code for check DFC_MoFTrqCmpMin" VALUE 0x804F97E2 Val_Wu16 65535.00 DFES_OneToOne 0.00 65535.00 FORMAT "%8.2" /end CHARACTERISTIC
/begin CHARACTERISTIC DFES_DTCO.DFC_MoFVarPostBldSel_C "OBD specific trouble code / OBD specific diagnostic trouble code for check DFC_MoFVarPostBldSel" VALUE 0x804F97E4 Val_Wu16 65535.00 DFES_OneToOne 0.00 65535.00 FORMAT "%8.2" /end CHARACTERISTIC
/begin CHARACTERISTIC DFES_DTCO.DFC_MoXEMMHwLTMCUFW_C "OBD specific trouble code / OBD specific diagnostic trouble code for check DFC_MoXEMMHwLTMCUFW" VALUE 0x804F97E6 Val_Wu16 65535.00 DFES_OneToOne 0.00 65535.00 FORMAT "%8.2" /end CHARACTERISTIC
/begin CHARACTERISTIC DFES_DTCO.DFC_MoXEMMHwLTMonBIST_C "OBD specific trouble code / OBD specific diagnostic trouble code for check DFC_MoXEMMHwLTMonBIST" VALUE 0x804F97E8 Val_Wu16 65535.00 DFES_OneToOne 0.00 65535.00 FORMAT "%8.2" /end CHARACTERISTIC
/begin CHARACTERISTIC DFES_DTCO.DFC_MoXEMMHwLTRegMonTest_C "OBD specific trouble code / OBD specific diagnostic trouble code for check DFC_MoXEMMHwLTRegMonTest" VALUE 0x804F97EA Val_Wu16 65535.00 DFES_OneToOne 0.00 65535.00 FORMAT "%8.2" /end CHARACTERISTIC
/begin CHARACTERISTIC DFES_DTCO.DFC_MoXEMMHwLTStbySMUAlvTest_C "OBD specific trouble code / OBD specific diagnostic trouble code for check DFC_MoXEMMHwLTStbySMUAlvTest" VALUE 0x804F97EC Val_Wu16 65535.00 DFES_OneToOne 0.00 65535.00 FORMAT "%8.2" /end CHARACTERISTIC
/begin CHARACTERISTIC DFES_DTCO.DFC_MoXEMMHwLTTempSens_C "OBD specific trouble code / OBD specific diagnostic trouble code for check DFC_MoXEMMHwLTTempSens" VALUE 0x804F97EE Val_Wu16 65535.00 DFES_OneToOne 0.00 65535.00 FORMAT "%8.2" /end CHARACTERISTIC
/begin CHARACTERISTIC DFES_DTCO.DFC_MoXEMMHwLTUCBCfg_C "OBD specific trouble code / OBD specific diagnostic trouble code for check DFC_MoXEMMHwLTUCBCfg" VALUE 0x804F97F0 Val_Wu16 65535.00 DFES_OneToOne 0.00 65535.00 FORMAT "%8.2" /end CHARACTERISTIC
/begin CHARACTERISTIC DFES_DTCO.DFC_OCWDAABEActv_C "OBD specific trouble code / OBD specific diagnostic trouble code for check DFC_OCWDAABEActv" VALUE 0x804F97F2 Val_Wu16 65535.00 DFES_OneToOne 0.00 65535.00 FORMAT "%8.2" /end CHARACTERISTIC
/begin CHARACTERISTIC DFES_DTCO.DFC_OCWDACom_C "OBD specific trouble code / OBD specific diagnostic trouble code for check DFC_OCWDACom" VALUE 0x804F97F4 Val_Wu16 65535.00 DFES_OneToOne 0.00 65535.00 FORMAT "%8.2" /end CHARACTERISTIC
/begin CHARACTERISTIC DFES_DTCO.DFC_OCWDAErrPin_C "OBD specific trouble code / OBD specific diagnostic trouble code for check DFC_OCWDAErrPin" VALUE 0x804F97F6 Val_Wu16 65535.00 DFES_OneToOne 0.00 65535.00 FORMAT "%8.2" /end CHARACTERISTIC
/begin CHARACTERISTIC DFES_DTCO.DFC_OCWDAOvrVltg_C "OBD specific trouble code / OBD specific diagnostic trouble code for check DFC_OCWDAOvrVltg" VALUE 0x804F97F8 Val_Wu16 65535.00 DFES_OneToOne 0.00 65535.00 FORMAT "%8.2" /end CHARACTERISTIC
/begin CHARACTERISTIC DFES_DTCO.DFC_ORAmax_C "OBD specific trouble code / OBD specific diagnostic trouble code for check DFC_ORAmax" VALUE 0x804F97FA Val_Wu16 65535.00 DFES_OneToOne 0.00 65535.00 FORMAT "%8.2" /end CHARACTERISTIC
/begin CHARACTERISTIC DFES_DTCO.DFC_ORAmin_C "OBD specific trouble code / OBD specific diagnostic trouble code for check DFC_ORAmin" VALUE 0x804F97FC Val_Wu16 65535.00 DFES_OneToOne 0.00 65535.00 FORMAT "%8.2" /end CHARACTERISTIC
/begin CHARACTERISTIC DFES_DTCO.DFC_PLLSUmax_C "OBD specific trouble code / OBD specific diagnostic trouble code for check DFC_PLLSUmax" VALUE 0x804F97FE Val_Wu16 65535.00 DFES_OneToOne 0.00 65535.00 FORMAT "%8.2" /end CHARACTERISTIC
/begin CHARACTERISTIC DFES_DTCO.DFC_PLLSUmin_C "OBD specific trouble code / OBD specific diagnostic trouble code for check DFC_PLLSUmin" VALUE 0x804F9800 Val_Wu16 65535.00 DFES_OneToOne 0.00 65535.00 FORMAT "%8.2" /end CHARACTERISTIC
/begin CHARACTERISTIC DFES_DTCO.DFC_PSR1max_C "OBD specific trouble code / OBD specific diagnostic trouble code for check DFC_PSR1max" VALUE 0x804F9802 Val_Wu16 65535.00 DFES_OneToOne 0.00 65535.00 FORMAT "%8.2" /end CHARACTERISTIC
/begin CHARACTERISTIC DFES_DTCO.DFC_PSRBmax_C "OBD specific trouble code / OBD specific diagnostic trouble code for check DFC_PSRBmax" VALUE 0x804F9804 Val_Wu16 65535.00 DFES_OneToOne 0.00 65535.00 FORMAT "%8.2" /end CHARACTERISTIC
/begin CHARACTERISTIC DFES_DTCO.DFC_PSRBmin_C "OBD specific trouble code / OBD specific diagnostic trouble code for check DFC_PSRBmin" VALUE 0x804F9806 Val_Wu16 65535.00 DFES_OneToOne 0.00 65535.00 FORMAT "%8.2" /end CHARACTERISTIC
/begin CHARACTERISTIC DFES_DTCO.DFC_PSRPmax_C "OBD specific trouble code / OBD specific diagnostic trouble code for check DFC_PSRPmax" VALUE 0x804F9808 Val_Wu16 65535.00 DFES_OneToOne 0.00 65535.00 FORMAT "%8.2" /end CHARACTERISTIC
/begin CHARACTERISTIC DFES_DTCO.DFC_PSRPmin_C "OBD specific trouble code / OBD specific diagnostic trouble code for check DFC_PSRPmin" VALUE 0x804F980A Val_Wu16 65535.00 DFES_OneToOne 0.00 65535.00 FORMAT "%8.2" /end CHARACTERISTIC
/begin CHARACTERISTIC DFES_DTCO.DFC_PSRPsig_C "OBD specific trouble code / OBD specific diagnostic trouble code for check DFC_PSRPsig" VALUE 0x804F980C Val_Wu16 65535.00 DFES_OneToOne 0.00 65535.00 FORMAT "%8.2" /end CHARACTERISTIC
/begin CHARACTERISTIC DFES_DTCO.DFC_PSRmax_C "OBD specific trouble code / OBD specific diagnostic trouble code for check DFC_PSRmax" VALUE 0x804F980E Val_Wu16 65535.00 DFES_OneToOne 0.00 65535.00 FORMAT "%8.2" /end CHARACTERISTIC
/begin CHARACTERISTIC DFES_DTCO.DFC_PUmax_C "OBD specific trouble code / OBD specific diagnostic trouble code for check DFC_PUmax" VALUE 0x804F9810 Val_Wu16 65535.00 DFES_OneToOne 0.00 65535.00 FORMAT "%8.2" /end CHARACTERISTIC
/begin CHARACTERISTIC DFES_DTCO.DFC_P_VSE11_OL_C "OBD specific trouble code / OBD specific diagnostic trouble code for check DFC_P_VSE11_OL" VALUE 0x804F9812 Val_Wu16 65535.00 DFES_OneToOne 0.00 65535.00 FORMAT "%8.2" /end CHARACTERISTIC
/begin CHARACTERISTIC DFES_DTCO.DFC_P_VSE11_SCB_C "OBD specific trouble code / OBD specific diagnostic trouble code for check DFC_P_VSE11_SCB" VALUE 0x804F9814 Val_Wu16 65535.00 DFES_OneToOne 0.00 65535.00 FORMAT "%8.2" /end CHARACTERISTIC
/begin CHARACTERISTIC DFES_DTCO.DFC_P_VSE11_SCG_C "OBD specific trouble code / OBD specific diagnostic trouble code for check DFC_P_VSE11_SCG" VALUE 0x804F9816 Val_Wu16 65535.00 DFES_OneToOne 0.00 65535.00 FORMAT "%8.2" /end CHARACTERISTIC
/begin CHARACTERISTIC DFES_DTCO.DFC_PhyHighAPP1_C "OBD specific trouble code / OBD specific diagnostic trouble code for check DFC_PhyHighAPP1" VALUE 0x804F9818 Val_Wu16 65535.00 DFES_OneToOne 0.00 65535.00 FORMAT "%8.2" /end CHARACTERISTIC
/begin CHARACTERISTIC DFES_DTCO.DFC_PhyHighAPP2_C "OBD specific trouble code / OBD specific diagnostic trouble code for check DFC_PhyHighAPP2" VALUE 0x804F981A Val_Wu16 65535.00 DFES_OneToOne 0.00 65535.00 FORMAT "%8.2" /end CHARACTERISTIC
/begin CHARACTERISTIC DFES_DTCO.DFC_PhyLowAPP1_C "OBD specific trouble code / OBD specific diagnostic trouble code for check DFC_PhyLowAPP1" VALUE 0x804F981C Val_Wu16 65535.00 DFES_OneToOne 0.00 65535.00 FORMAT "%8.2" /end CHARACTERISTIC
/begin CHARACTERISTIC DFES_DTCO.DFC_PhyLowAPP2_C "OBD specific trouble code / OBD specific diagnostic trouble code for check DFC_PhyLowAPP2" VALUE 0x804F981E Val_Wu16 65535.00 DFES_OneToOne 0.00 65535.00 FORMAT "%8.2" /end CHARACTERISTIC
/begin CHARACTERISTIC DFES_DTCO.DFC_SRCHighAPP1_C "OBD specific trouble code / OBD specific diagnostic trouble code for check DFC_SRCHighAPP1" VALUE 0x804F9820 Val_Wu16 65535.00 DFES_OneToOne 0.00 65535.00 FORMAT "%8.2" /end CHARACTERISTIC
/begin CHARACTERISTIC DFES_DTCO.DFC_SRCHighAPP2_C "OBD specific trouble code / OBD specific diagnostic trouble code for check DFC_SRCHighAPP2" VALUE 0x804F9822 Val_Wu16 65535.00 DFES_OneToOne 0.00 65535.00 FORMAT "%8.2" /end CHARACTERISTIC
/begin CHARACTERISTIC DFES_DTCO.DFC_SRCLowAPP1_C "OBD specific trouble code / OBD specific diagnostic trouble code for check DFC_SRCLowAPP1" VALUE 0x804F9824 Val_Wu16 65535.00 DFES_OneToOne 0.00 65535.00 FORMAT "%8.2" /end CHARACTERISTIC
/begin CHARACTERISTIC DFES_DTCO.DFC_SRCLowAPP2_C "OBD specific trouble code / OBD specific diagnostic trouble code for check DFC_SRCLowAPP2" VALUE 0x804F9826 Val_Wu16 65535.00 DFES_OneToOne 0.00 65535.00 FORMAT "%8.2" /end CHARACTERISTIC
/begin CHARACTERISTIC DFES_DTCO.DFC_SSpMon2_C "OBD specific trouble code / OBD specific diagnostic trouble code for check DFC_SSpMon2" VALUE 0x804F9828 Val_Wu16 65535.00 DFES_OneToOne 0.00 65535.00 FORMAT "%8.2" /end CHARACTERISTIC
/begin CHARACTERISTIC DFES_DTCO.DFC_SWReset_0_C "OBD specific trouble code / OBD specific diagnostic trouble code for check DFC_SWReset_0" VALUE 0x804F982A Val_Wu16 65535.00 DFES_OneToOne 0.00 65535.00 FORMAT "%8.2" /end CHARACTERISTIC
/begin CHARACTERISTIC DFES_DTCO.DFC_SWReset_1_C "OBD specific trouble code / OBD specific diagnostic trouble code for check DFC_SWReset_1" VALUE 0x804F982C Val_Wu16 65535.00 DFES_OneToOne 0.00 65535.00 FORMAT "%8.2" /end CHARACTERISTIC
/begin CHARACTERISTIC DFES_DTCO.DFC_SWReset_2_C "OBD specific trouble code / OBD specific diagnostic trouble code for check DFC_SWReset_2" VALUE 0x804F982E Val_Wu16 65535.00 DFES_OneToOne 0.00 65535.00 FORMAT "%8.2" /end CHARACTERISTIC
/begin CHARACTERISTIC DFES_DTCO.DFC_SyncAPP_C "OBD specific trouble code / OBD specific diagnostic trouble code for check DFC_SyncAPP" VALUE 0x804F9830 Val_Wu16 65535.00 DFES_OneToOne 0.00 65535.00 FORMAT "%8.2" /end CHARACTERISTIC
/begin CHARACTERISTIC DFES_DTCO.DFC_TAmax_Dummy_C "OBD specific trouble code / OBD specific diagnostic trouble code for check DFC_TAmax_Dummy" VALUE 0x804F9832 Val_Wu16 65535.00 DFES_OneToOne 0.00 65535.00 FORMAT "%8.2" /end CHARACTERISTIC
/begin CHARACTERISTIC DFES_DTCO.DFC_TKAEmax_C "OBD specific trouble code / OBD specific diagnostic trouble code for check DFC_TKAEmax" VALUE 0x804F9834 Val_Wu16 65535.00 DFES_OneToOne 0.00 65535.00 FORMAT "%8.2" /end CHARACTERISTIC
/begin CHARACTERISTIC DFES_DTCO.DFC_TKAEmin_C "OBD specific trouble code / OBD specific diagnostic trouble code for check DFC_TKAEmin" VALUE 0x804F9836 Val_Wu16 65535.00 DFES_OneToOne 0.00 65535.00 FORMAT "%8.2" /end CHARACTERISTIC
/begin CHARACTERISTIC DFES_DTCO.DFC_TKARmax_C "OBD specific trouble code / OBD specific diagnostic trouble code for check DFC_TKARmax" VALUE 0x804F9838 Val_Wu16 65535.00 DFES_OneToOne 0.00 65535.00 FORMAT "%8.2" /end CHARACTERISTIC
/begin CHARACTERISTIC DFES_DTCO.DFC_TKARnpl_C "OBD specific trouble code / OBD specific diagnostic trouble code for check DFC_TKARnpl" VALUE 0x804F983A Val_Wu16 65535.00 DFES_OneToOne 0.00 65535.00 FORMAT "%8.2" /end CHARACTERISTIC
/begin CHARACTERISTIC DFES_DTCO.DFC_TMmax_Dummy_C "OBD specific trouble code / OBD specific diagnostic trouble code for check DFC_TMmax_Dummy" VALUE 0x804F983C Val_Wu16 65535.00 DFES_OneToOne 0.00 65535.00 FORMAT "%8.2" /end CHARACTERISTIC
/begin CHARACTERISTIC DFES_DTCO.DFC_TUMmax_Dummy_C "OBD specific trouble code / OBD specific diagnostic trouble code for check DFC_TUMmax_Dummy" VALUE 0x804F983E Val_Wu16 65535.00 DFES_OneToOne 0.00 65535.00 FORMAT "%8.2" /end CHARACTERISTIC
/begin CHARACTERISTIC DFES_DTCO.DFC_TWCDPriCatB1_C "OBD specific trouble code / OBD specific diagnostic trouble code for check DFC_TWCDPriCatB1" VALUE 0x804F9840 Val_Wu16 65535.00 DFES_OneToOne 0.00 65535.00 FORMAT "%8.2" /end CHARACTERISTIC
/begin CHARACTERISTIC DFES_DTCO.DFC_ThrVlvClsdPosnFirstOffsLrnImpoB1_C "OBD specific trouble code / OBD specific diagnostic trouble code for check DFC_ThrVlvClsdPosnFirstOffsLrnImpoB1" VALUE 0x804F9842 Val_Wu16 65535.00 DFES_OneToOne 0.00 65535.00 FORMAT "%8.2" /end CHARACTERISTIC
/begin CHARACTERISTIC DFES_DTCO.DFC_ThrVlvClsdPosnOffsLrnImpoB1_C "OBD specific trouble code / OBD specific diagnostic trouble code for check DFC_ThrVlvClsdPosnOffsLrnImpoB1" VALUE 0x804F9844 Val_Wu16 65535.00 DFES_OneToOne 0.00 65535.00 FORMAT "%8.2" /end CHARACTERISTIC
/begin CHARACTERISTIC DFES_DTCO.DFC_ThrVlvClsdPosnOffsLrnMaxB1_C "OBD specific trouble code / OBD specific diagnostic trouble code for check DFC_ThrVlvClsdPosnOffsLrnMaxB1" VALUE 0x804F9846 Val_Wu16 65535.00 DFES_OneToOne 0.00 65535.00 FORMAT "%8.2" /end CHARACTERISTIC
/begin CHARACTERISTIC DFES_DTCO.DFC_ThrVlvClsdPosnOffsLrnMinB1_C "OBD specific trouble code / OBD specific diagnostic trouble code for check DFC_ThrVlvClsdPosnOffsLrnMinB1" VALUE 0x804F9848 Val_Wu16 65535.00 DFES_OneToOne 0.00 65535.00 FORMAT "%8.2" /end CHARACTERISTIC
/begin CHARACTERISTIC DFES_DTCO.DFC_ThrVlvCtrlDeB1_C "OBD specific trouble code / OBD specific diagnostic trouble code for check DFC_ThrVlvCtrlDeB1" VALUE 0x804F984A Val_Wu16 65535.00 DFES_OneToOne 0.00 65535.00 FORMAT "%8.2" /end CHARACTERISTIC
/begin CHARACTERISTIC DFES_DTCO.DFC_ThrVlvDycB1_C "OBD specific trouble code / OBD specific diagnostic trouble code for check DFC_ThrVlvDycB1" VALUE 0x804F984C Val_Wu16 65535.00 DFES_OneToOne 0.00 65535.00 FORMAT "%8.2" /end CHARACTERISTIC
/begin CHARACTERISTIC DFES_DTCO.DFC_ThrVlvLimpAirPosnMaxAbsltDriftB1_C "OBD specific trouble code / OBD specific diagnostic trouble code for check DFC_ThrVlvLimpAirPosnMaxAbsltDriftB1" VALUE 0x804F984E Val_Wu16 65535.00 DFES_OneToOne 0.00 65535.00 FORMAT "%8.2" /end CHARACTERISTIC
/begin CHARACTERISTIC DFES_DTCO.DFC_ThrVlvLimpAirPosnMaxB1_C "OBD specific trouble code / OBD specific diagnostic trouble code for check DFC_ThrVlvLimpAirPosnMaxB1" VALUE 0x804F9850 Val_Wu16 65535.00 DFES_OneToOne 0.00 65535.00 FORMAT "%8.2" /end CHARACTERISTIC
/begin CHARACTERISTIC DFES_DTCO.DFC_ThrVlvLimpAirPosnMaxRelDriftB1_C "OBD specific trouble code / OBD specific diagnostic trouble code for check DFC_ThrVlvLimpAirPosnMaxRelDriftB1" VALUE 0x804F9852 Val_Wu16 65535.00 DFES_OneToOne 0.00 65535.00 FORMAT "%8.2" /end CHARACTERISTIC
/begin CHARACTERISTIC DFES_DTCO.DFC_ThrVlvLimpAirPosnMinB1_C "OBD specific trouble code / OBD specific diagnostic trouble code for check DFC_ThrVlvLimpAirPosnMinB1" VALUE 0x804F9854 Val_Wu16 65535.00 DFES_OneToOne 0.00 65535.00 FORMAT "%8.2" /end CHARACTERISTIC
/begin CHARACTERISTIC DFES_DTCO.DFC_ThrVlvOpenLoadB1_C "OBD specific trouble code / OBD specific diagnostic trouble code for check DFC_ThrVlvOpenLoadB1" VALUE 0x804F9856 Val_Wu16 65535.00 DFES_OneToOne 0.00 65535.00 FORMAT "%8.2" /end CHARACTERISTIC
/begin CHARACTERISTIC DFES_DTCO.DFC_ThrVlvOpenSprgB1_C "OBD specific trouble code / OBD specific diagnostic trouble code for check DFC_ThrVlvOpenSprgB1" VALUE 0x804F9858 Val_Wu16 65535.00 DFES_OneToOne 0.00 65535.00 FORMAT "%8.2" /end CHARACTERISTIC
/begin CHARACTERISTIC DFES_DTCO.DFC_ThrVlvOpenSprgSprdB1_C "OBD specific trouble code / OBD specific diagnostic trouble code for check DFC_ThrVlvOpenSprgSprdB1" VALUE 0x804F985A Val_Wu16 65535.00 DFES_OneToOne 0.00 65535.00 FORMAT "%8.2" /end CHARACTERISTIC
/begin CHARACTERISTIC DFES_DTCO.DFC_ThrVlvOpenSprgTwnB1_C "OBD specific trouble code / OBD specific diagnostic trouble code for check DFC_ThrVlvOpenSprgTwnB1" VALUE 0x804F985C Val_Wu16 65535.00 DFES_OneToOne 0.00 65535.00 FORMAT "%8.2" /end CHARACTERISTIC
/begin CHARACTERISTIC DFES_DTCO.DFC_ThrVlvOverTB1_C "OBD specific trouble code / OBD specific diagnostic trouble code for check DFC_ThrVlvOverTB1" VALUE 0x804F985E Val_Wu16 65535.00 DFES_OneToOne 0.00 65535.00 FORMAT "%8.2" /end CHARACTERISTIC
/begin CHARACTERISTIC DFES_DTCO.DFC_ThrVlvRetSprgB1_C "OBD specific trouble code / OBD specific diagnostic trouble code for check DFC_ThrVlvRetSprgB1" VALUE 0x804F9860 Val_Wu16 65535.00 DFES_OneToOne 0.00 65535.00 FORMAT "%8.2" /end CHARACTERISTIC
/begin CHARACTERISTIC DFES_DTCO.DFC_ThrVlvRetSprgSprdB1_C "OBD specific trouble code / OBD specific diagnostic trouble code for check DFC_ThrVlvRetSprgSprdB1" VALUE 0x804F9862 Val_Wu16 65535.00 DFES_OneToOne 0.00 65535.00 FORMAT "%8.2" /end CHARACTERISTIC
/begin CHARACTERISTIC DFES_DTCO.DFC_ThrVlvRetSprgTwnB1_C "OBD specific trouble code / OBD specific diagnostic trouble code for check DFC_ThrVlvRetSprgTwnB1" VALUE 0x804F9864 Val_Wu16 65535.00 DFES_OneToOne 0.00 65535.00 FORMAT "%8.2" /end CHARACTERISTIC
/begin CHARACTERISTIC DFES_DTCO.DFC_ThrVlvSens1MaxB1_C "OBD specific trouble code / OBD specific diagnostic trouble code for check DFC_ThrVlvSens1MaxB1" VALUE 0x804F9866 Val_Wu16 65535.00 DFES_OneToOne 0.00 65535.00 FORMAT "%8.2" /end CHARACTERISTIC
/begin CHARACTERISTIC DFES_DTCO.DFC_ThrVlvSens1NplB1_C "OBD specific trouble code / OBD specific diagnostic trouble code for check DFC_ThrVlvSens1NplB1" VALUE 0x804F9868 Val_Wu16 65535.00 DFES_OneToOne 0.00 65535.00 FORMAT "%8.2" /end CHARACTERISTIC
/begin CHARACTERISTIC DFES_DTCO.DFC_ThrVlvSens2MaxB1_C "OBD specific trouble code / OBD specific diagnostic trouble code for check DFC_ThrVlvSens2MaxB1" VALUE 0x804F986A Val_Wu16 65535.00 DFES_OneToOne 0.00 65535.00 FORMAT "%8.2" /end CHARACTERISTIC
/begin CHARACTERISTIC DFES_DTCO.DFC_ThrVlvSens2MinB1_C "OBD specific trouble code / OBD specific diagnostic trouble code for check DFC_ThrVlvSens2MinB1" VALUE 0x804F986C Val_Wu16 65535.00 DFES_OneToOne 0.00 65535.00 FORMAT "%8.2" /end CHARACTERISTIC
/begin CHARACTERISTIC DFES_DTCO.DFC_ThrVlvSens2NplB1_C "OBD specific trouble code / OBD specific diagnostic trouble code for check DFC_ThrVlvSens2NplB1" VALUE 0x804F986E Val_Wu16 65535.00 DFES_OneToOne 0.00 65535.00 FORMAT "%8.2" /end CHARACTERISTIC
/begin CHARACTERISTIC DFES_DTCO.DFC_ThrVlvShoCircB1_C "OBD specific trouble code / OBD specific diagnostic trouble code for check DFC_ThrVlvShoCircB1" VALUE 0x804F9870 Val_Wu16 65535.00 DFES_OneToOne 0.00 65535.00 FORMAT "%8.2" /end CHARACTERISTIC
/begin CHARACTERISTIC DFES_DTCO.DFC_ThrVlvSpiErrB1_C "OBD specific trouble code / OBD specific diagnostic trouble code for check DFC_ThrVlvSpiErrB1" VALUE 0x804F9872 Val_Wu16 65535.00 DFES_OneToOne 0.00 65535.00 FORMAT "%8.2" /end CHARACTERISTIC
/begin CHARACTERISTIC DFES_DTCO.DFC_ThrvlvSens1MinB1_C "OBD specific trouble code / OBD specific diagnostic trouble code for check DFC_ThrvlvSens1MinB1" VALUE 0x804F9874 Val_Wu16 65535.00 DFES_OneToOne 0.00 65535.00 FORMAT "%8.2" /end CHARACTERISTIC
/begin CHARACTERISTIC DFES_DTCO.DFC_TiOffTBasdChkFast_C "OBD specific trouble code / OBD specific diagnostic trouble code for check DFC_TiOffTBasdChkFast" VALUE 0x804F9876 Val_Wu16 65535.00 DFES_OneToOne 0.00 65535.00 FORMAT "%8.2" /end CHARACTERISTIC
/begin CHARACTERISTIC DFES_DTCO.DFC_TiOffTBasdChkSlow_C "OBD specific trouble code / OBD specific diagnostic trouble code for check DFC_TiOffTBasdChkSlow" VALUE 0x804F9878 Val_Wu16 65535.00 DFES_OneToOne 0.00 65535.00 FORMAT "%8.2" /end CHARACTERISTIC
/begin CHARACTERISTIC DFES_DTCO.DFC_UEGOHeatrCtlS1B1_C "OBD specific trouble code / OBD specific diagnostic trouble code for check DFC_UEGOHeatrCtlS1B1" VALUE 0x804F987A Val_Wu16 65535.00 DFES_OneToOne 0.00 65535.00 FORMAT "%8.2" /end CHARACTERISTIC
/begin CHARACTERISTIC DFES_DTCO.DFC_UEGOSnsrMntdS1B1_C "OBD specific trouble code / OBD specific diagnostic trouble code for check DFC_UEGOSnsrMntdS1B1" VALUE 0x804F987C Val_Wu16 65535.00 DFES_OneToOne 0.00 65535.00 FORMAT "%8.2" /end CHARACTERISTIC
/begin CHARACTERISTIC DFES_DTCO.DFC_VehVSig_C "OBD specific trouble code / OBD specific diagnostic trouble code for check DFC_VehVSig" VALUE 0x804F987E Val_Wu16 65535.00 DFES_OneToOne 0.00 65535.00 FORMAT "%8.2" /end CHARACTERISTIC
/begin CHARACTERISTIC DFES_DTCO.DFC_VlvLftFbSwtIntk11SpclFail_C "OBD specific trouble code / OBD specific diagnostic trouble code for check DFC_VlvLftFbSwtIntk11SpclFail" VALUE 0x804F9880 Val_Wu16 65535.00 DFES_OneToOne 0.00 65535.00 FORMAT "%8.2" /end CHARACTERISTIC
/begin CHARACTERISTIC DFES_DTCO.DFC_VlvLftFbSwtIntk11StdFail_C "OBD specific trouble code / OBD specific diagnostic trouble code for check DFC_VlvLftFbSwtIntk11StdFail" VALUE 0x804F9882 Val_Wu16 65535.00 DFES_OneToOne 0.00 65535.00 FORMAT "%8.2" /end CHARACTERISTIC
/begin CHARACTERISTIC DFES_Env.xSet1_CA "set of signals per environment data / Signal selection for environment dataset 1" VAL_BLK 0x804F9E08 ValA_Wu16 782.000000000 Signals_IntSigNumVerb 0.00 782.000000000 FORMAT "%13.9" NUMBER 1 /end CHARACTERISTIC
/begin CHARACTERISTIC DFES_Env.xSet2_CA "set of signals per environment data / Signal selection for environment dataset 2" VAL_BLK 0x804F9E0A ValA_Wu16 782.000000000 Signals_IntSigNumVerb 0.00 782.000000000 FORMAT "%13.9" NUMBER 1 /end CHARACTERISTIC
/begin CHARACTERISTIC DFES_EnvRef.DFC_Unused_C "used environment signals / " VALUE 0x804F9888 Val_Wu8 1.00000000000 DFES_EnvTabVerb 0.00 1.00000000000 FORMAT "%13.11" READ_ONLY /end CHARACTERISTIC
/begin CHARACTERISTIC DFES_EnvRef.DFC_AltIOACGFailr_C "used environment signals / Reference to used environment condition set for check DFC_AltIOACGFailr" VALUE 0x804F9889 Val_Wu8 1.00000000000 DFES_EnvTabVerb 0.00 1.00000000000 FORMAT "%13.11" /end CHARACTERISTIC
/begin CHARACTERISTIC DFES_EnvRef.DFC_AltIOACGHiVltg_C "used environment signals / Reference to used environment condition set for check DFC_AltIOACGHiVltg" VALUE 0x804F988A Val_Wu8 1.00000000000 DFES_EnvTabVerb 0.00 1.00000000000 FORMAT "%13.11" /end CHARACTERISTIC
/begin CHARACTERISTIC DFES_EnvRef.DFC_AltIOACGLoVltg_C "used environment signals / Reference to used environment condition set for check DFC_AltIOACGLoVltg" VALUE 0x804F988B Val_Wu8 1.00000000000 DFES_EnvTabVerb 0.00 1.00000000000 FORMAT "%13.11" /end CHARACTERISTIC
/begin CHARACTERISTIC DFES_EnvRef.DFC_AltIOACGTHi_C "used environment signals / Reference to used environment condition set for check DFC_AltIOACGTHi" VALUE 0x804F988C Val_Wu8 1.00000000000 DFES_EnvTabVerb 0.00 1.00000000000 FORMAT "%13.11" /end CHARACTERISTIC
/begin CHARACTERISTIC DFES_EnvRef.DFC_AltIODConnACG_C "used environment signals / Reference to used environment condition set for check DFC_AltIODConnACG" VALUE 0x804F988D Val_Wu8 1.00000000000 DFES_EnvTabVerb 0.00 1.00000000000 FORMAT "%13.11" /end CHARACTERISTIC
/begin CHARACTERISTIC DFES_EnvRef.DFC_BattUHiFailr_C "used environment signals / Reference to used environment condition set for check DFC_BattUHiFailr" VALUE 0x804F988E Val_Wu8 1.00000000000 DFES_EnvTabVerb 0.00 1.00000000000 FORMAT "%13.11" /end CHARACTERISTIC
/begin CHARACTERISTIC DFES_EnvRef.DFC_BattULoFailr_C "used environment signals / Reference to used environment condition set for check DFC_BattULoFailr" VALUE 0x804F988F Val_Wu8 1.00000000000 DFES_EnvTabVerb 0.00 1.00000000000 FORMAT "%13.11" /end CHARACTERISTIC
/begin CHARACTERISTIC DFES_EnvRef.DFC_BrkBstPDriftHiErr_C "used environment signals / Reference to used environment condition set for check DFC_BrkBstPDriftHiErr" VALUE 0x804F9890 Val_Wu8 1.00000000000 DFES_EnvTabVerb 0.00 1.00000000000 FORMAT "%13.11" /end CHARACTERISTIC
/begin CHARACTERISTIC DFES_EnvRef.DFC_BrkBstPDriftLoErr_C "used environment signals / Reference to used environment condition set for check DFC_BrkBstPDriftLoErr" VALUE 0x804F9891 Val_Wu8 1.00000000000 DFES_EnvTabVerb 0.00 1.00000000000 FORMAT "%13.11" /end CHARACTERISTIC
/begin CHARACTERISTIC DFES_EnvRef.DFC_BrkBstPSnsrStuck_C "used environment signals / Reference to used environment condition set for check DFC_BrkBstPSnsrStuck" VALUE 0x804F9892 Val_Wu8 1.00000000000 DFES_EnvTabVerb 0.00 1.00000000000 FORMAT "%13.11" /end CHARACTERISTIC
/begin CHARACTERISTIC DFES_EnvRef.DFC_BrkMnSwtContOn_C "used environment signals / Reference to used environment condition set for check DFC_BrkMnSwtContOn" VALUE 0x804F9893 Val_Wu8 1.00000000000 DFES_EnvTabVerb 0.00 1.00000000000 FORMAT "%13.11" /end CHARACTERISTIC
/begin CHARACTERISTIC DFES_EnvRef.DFC_BrkMnSwtNotStp_C "used environment signals / Reference to used environment condition set for check DFC_BrkMnSwtNotStp" VALUE 0x804F9894 Val_Wu8 1.00000000000 DFES_EnvTabVerb 0.00 1.00000000000 FORMAT "%13.11" /end CHARACTERISTIC
/begin CHARACTERISTIC DFES_EnvRef.DFC_BrkNpl_C "used environment signals / Reference to used environment condition set for check DFC_BrkNpl" VALUE 0x804F9895 Val_Wu8 1.00000000000 DFES_EnvTabVerb 0.00 1.00000000000 FORMAT "%13.11" /end CHARACTERISTIC
/begin CHARACTERISTIC DFES_EnvRef.DFC_BrkRdntSwtContOn_C "used environment signals / Reference to used environment condition set for check DFC_BrkRdntSwtContOn" VALUE 0x804F9896 Val_Wu8 1.00000000000 DFES_EnvTabVerb 0.00 1.00000000000 FORMAT "%13.11" /end CHARACTERISTIC
/begin CHARACTERISTIC DFES_EnvRef.DFC_BrkRdntSwtNotStp_C "used environment signals / Reference to used environment condition set for check DFC_BrkRdntSwtNotStp" VALUE 0x804F9897 Val_Wu8 1.00000000000 DFES_EnvTabVerb 0.00 1.00000000000 FORMAT "%13.11" /end CHARACTERISTIC
/begin CHARACTERISTIC DFES_EnvRef.DFC_Clth3ONStuck_C "used environment signals / Reference to used environment condition set for check DFC_Clth3ONStuck" VALUE 0x804F9898 Val_Wu8 1.00000000000 DFES_EnvTabVerb 0.00 1.00000000000 FORMAT "%13.11" /end CHARACTERISTIC
/begin CHARACTERISTIC DFES_EnvRef.DFC_Clth4OFFStuck_C "used environment signals / Reference to used environment condition set for check DFC_Clth4OFFStuck" VALUE 0x804F9899 Val_Wu8 1.00000000000 DFES_EnvTabVerb 0.00 1.00000000000 FORMAT "%13.11" /end CHARACTERISTIC
/begin CHARACTERISTIC DFES_EnvRef.DFC_ClthOFFStuck_C "used environment signals / Reference to used environment condition set for check DFC_ClthOFFStuck" VALUE 0x804F989A Val_Wu8 1.00000000000 DFES_EnvTabVerb 0.00 1.00000000000 FORMAT "%13.11" /end CHARACTERISTIC
/begin CHARACTERISTIC DFES_EnvRef.DFC_ClthONStuck_C "used environment signals / Reference to used environment condition set for check DFC_ClthONStuck" VALUE 0x804F989B Val_Wu8 1.00000000000 DFES_EnvTabVerb 0.00 1.00000000000 FORMAT "%13.11" /end CHARACTERISTIC
/begin CHARACTERISTIC DFES_EnvRef.DFC_ClthStkFailInfo_C "used environment signals / Reference to used environment condition set for check DFC_ClthStkFailInfo" VALUE 0x804F989C Val_Wu8 1.00000000000 DFES_EnvTabVerb 0.00 1.00000000000 FORMAT "%13.11" /end CHARACTERISTIC
/begin CHARACTERISTIC DFES_EnvRef.DFC_ComACFailInfo_C "used environment signals / Reference to used environment condition set for check DFC_ComACFailInfo" VALUE 0x804F989D Val_Wu8 1.00000000000 DFES_EnvTabVerb 0.00 1.00000000000 FORMAT "%13.11" /end CHARACTERISTIC
/begin CHARACTERISTIC DFES_EnvRef.DFC_ComATFTValErr_C "used environment signals / Reference to used environment condition set for check DFC_ComATFTValErr" VALUE 0x804F989E Val_Wu8 1.00000000000 DFES_EnvTabVerb 0.00 1.00000000000 FORMAT "%13.11" /end CHARACTERISTIC
/begin CHARACTERISTIC DFES_EnvRef.DFC_ComATMILReq_C "used environment signals / Reference to used environment condition set for check DFC_ComATMILReq" VALUE 0x804F989F Val_Wu8 1.00000000000 DFES_EnvTabVerb 0.00 1.00000000000 FORMAT "%13.11" /end CHARACTERISTIC
/begin CHARACTERISTIC DFES_EnvRef.DFC_ComAYCAChksum_C "used environment signals / Reference to used environment condition set for check DFC_ComAYCAChksum" VALUE 0x804F98A0 Val_Wu8 1.00000000000 DFES_EnvTabVerb 0.00 1.00000000000 FORMAT "%13.11" /end CHARACTERISTIC
/begin CHARACTERISTIC DFES_EnvRef.DFC_ComAYCARingCnt_C "used environment signals / Reference to used environment condition set for check DFC_ComAYCARingCnt" VALUE 0x804F98A1 Val_Wu8 1.00000000000 DFES_EnvTabVerb 0.00 1.00000000000 FORMAT "%13.11" /end CHARACTERISTIC
/begin CHARACTERISTIC DFES_EnvRef.DFC_ComAYCATOut_C "used environment signals / Reference to used environment condition set for check DFC_ComAYCATOut" VALUE 0x804F98A2 Val_Wu8 1.00000000000 DFES_EnvTabVerb 0.00 1.00000000000 FORMAT "%13.11" /end CHARACTERISTIC
/begin CHARACTERISTIC DFES_EnvRef.DFC_ComAYCDChkSum_C "used environment signals / Reference to used environment condition set for check DFC_ComAYCDChkSum" VALUE 0x804F98A3 Val_Wu8 1.00000000000 DFES_EnvTabVerb 0.00 1.00000000000 FORMAT "%13.11" /end CHARACTERISTIC
/begin CHARACTERISTIC DFES_EnvRef.DFC_ComAYCDTOut_C "used environment signals / Reference to used environment condition set for check DFC_ComAYCDTOut" VALUE 0x804F98A4 Val_Wu8 1.00000000000 DFES_EnvTabVerb 0.00 1.00000000000 FORMAT "%13.11" /end CHARACTERISTIC
/begin CHARACTERISTIC DFES_EnvRef.DFC_ComAYCFChksum_C "used environment signals / Reference to used environment condition set for check DFC_ComAYCFChksum" VALUE 0x804F98A5 Val_Wu8 1.00000000000 DFES_EnvTabVerb 0.00 1.00000000000 FORMAT "%13.11" /end CHARACTERISTIC
/begin CHARACTERISTIC DFES_EnvRef.DFC_ComAYCFRingCnt_C "used environment signals / Reference to used environment condition set for check DFC_ComAYCFRingCnt" VALUE 0x804F98A6 Val_Wu8 1.00000000000 DFES_EnvTabVerb 0.00 1.00000000000 FORMAT "%13.11" /end CHARACTERISTIC
/begin CHARACTERISTIC DFES_EnvRef.DFC_ComAYCFTOut_C "used environment signals / Reference to used environment condition set for check DFC_ComAYCFTOut" VALUE 0x804F98A7 Val_Wu8 1.00000000000 DFES_EnvTabVerb 0.00 1.00000000000 FORMAT "%13.11" /end CHARACTERISTIC
/begin CHARACTERISTIC DFES_EnvRef.DFC_ComAYCGChksum_C "used environment signals / Reference to used environment condition set for check DFC_ComAYCGChksum" VALUE 0x804F98A8 Val_Wu8 1.00000000000 DFES_EnvTabVerb 0.00 1.00000000000 FORMAT "%13.11" /end CHARACTERISTIC
/begin CHARACTERISTIC DFES_EnvRef.DFC_ComAYCGRingCnt_C "used environment signals / Reference to used environment condition set for check DFC_ComAYCGRingCnt" VALUE 0x804F98A9 Val_Wu8 1.00000000000 DFES_EnvTabVerb 0.00 1.00000000000 FORMAT "%13.11" /end CHARACTERISTIC
/begin CHARACTERISTIC DFES_EnvRef.DFC_ComAYCGTOut_C "used environment signals / Reference to used environment condition set for check DFC_ComAYCGTOut" VALUE 0x804F98AA Val_Wu8 1.00000000000 DFES_EnvTabVerb 0.00 1.00000000000 FORMAT "%13.11" /end CHARACTERISTIC
/begin CHARACTERISTIC DFES_EnvRef.DFC_ComAYCIChkSum_C "used environment signals / Reference to used environment condition set for check DFC_ComAYCIChkSum" VALUE 0x804F98AB Val_Wu8 1.00000000000 DFES_EnvTabVerb 0.00 1.00000000000 FORMAT "%13.11" /end CHARACTERISTIC
/begin CHARACTERISTIC DFES_EnvRef.DFC_ComAYCIRingCnt_C "used environment signals / Reference to used environment condition set for check DFC_ComAYCIRingCnt" VALUE 0x804F98AC Val_Wu8 1.00000000000 DFES_EnvTabVerb 0.00 1.00000000000 FORMAT "%13.11" /end CHARACTERISTIC
/begin CHARACTERISTIC DFES_EnvRef.DFC_ComAYCITOut_C "used environment signals / Reference to used environment condition set for check DFC_ComAYCITOut" VALUE 0x804F98AD Val_Wu8 1.00000000000 DFES_EnvTabVerb 0.00 1.00000000000 FORMAT "%13.11" /end CHARACTERISTIC
/begin CHARACTERISTIC DFES_EnvRef.DFC_ComBCM1ChkSum_C "used environment signals / Reference to used environment condition set for check DFC_ComBCM1ChkSum" VALUE 0x804F98AE Val_Wu8 1.00000000000 DFES_EnvTabVerb 0.00 1.00000000000 FORMAT "%13.11" /end CHARACTERISTIC
/begin CHARACTERISTIC DFES_EnvRef.DFC_ComBCM1RingCnt_C "used environment signals / Reference to used environment condition set for check DFC_ComBCM1RingCnt" VALUE 0x804F98AF Val_Wu8 1.00000000000 DFES_EnvTabVerb 0.00 1.00000000000 FORMAT "%13.11" /end CHARACTERISTIC
/begin CHARACTERISTIC DFES_EnvRef.DFC_ComBCM1TOut_C "used environment signals / Reference to used environment condition set for check DFC_ComBCM1TOut" VALUE 0x804F98B0 Val_Wu8 1.00000000000 DFES_EnvTabVerb 0.00 1.00000000000 FORMAT "%13.11" /end CHARACTERISTIC
/begin CHARACTERISTIC DFES_EnvRef.DFC_ComCANABusOffErr_C "used environment signals / Reference to used environment condition set for check DFC_ComCANABusOffErr" VALUE 0x804F98B1 Val_Wu8 1.00000000000 DFES_EnvTabVerb 0.00 1.00000000000 FORMAT "%13.11" /end CHARACTERISTIC
/begin CHARACTERISTIC DFES_EnvRef.DFC_ComCANBBusOffErr_C "used environment signals / Reference to used environment condition set for check DFC_ComCANBBusOffErr" VALUE 0x804F98B2 Val_Wu8 1.00000000000 DFES_EnvTabVerb 0.00 1.00000000000 FORMAT "%13.11" /end CHARACTERISTIC
/begin CHARACTERISTIC DFES_EnvRef.DFC_ComCANCBusOffErr_C "used environment signals / Reference to used environment condition set for check DFC_ComCANCBusOffErr" VALUE 0x804F98B3 Val_Wu8 1.00000000000 DFES_EnvTabVerb 0.00 1.00000000000 FORMAT "%13.11" /end CHARACTERISTIC
/begin CHARACTERISTIC DFES_EnvRef.DFC_ComCGW1ChkSum_C "used environment signals / Reference to used environment condition set for check DFC_ComCGW1ChkSum" VALUE 0x804F98B4 Val_Wu8 1.00000000000 DFES_EnvTabVerb 0.00 1.00000000000 FORMAT "%13.11" /end CHARACTERISTIC
/begin CHARACTERISTIC DFES_EnvRef.DFC_ComCGW1RingCnt_C "used environment signals / Reference to used environment condition set for check DFC_ComCGW1RingCnt" VALUE 0x804F98B5 Val_Wu8 1.00000000000 DFES_EnvTabVerb 0.00 1.00000000000 FORMAT "%13.11" /end CHARACTERISTIC
/begin CHARACTERISTIC DFES_EnvRef.DFC_ComCGW1TOut_C "used environment signals / Reference to used environment condition set for check DFC_ComCGW1TOut" VALUE 0x804F98B6 Val_Wu8 1.00000000000 DFES_EnvTabVerb 0.00 1.00000000000 FORMAT "%13.11" /end CHARACTERISTIC
/begin CHARACTERISTIC DFES_EnvRef.DFC_ComConvBoostErr_C "used environment signals / Reference to used environment condition set for check DFC_ComConvBoostErr" VALUE 0x804F98B7 Val_Wu8 1.00000000000 DFES_EnvTabVerb 0.00 1.00000000000 FORMAT "%13.11" /end CHARACTERISTIC
/begin CHARACTERISTIC DFES_EnvRef.DFC_ComConvSlipErr_C "used environment signals / Reference to used environment condition set for check DFC_ComConvSlipErr" VALUE 0x804F98B8 Val_Wu8 1.00000000000 DFES_EnvTabVerb 0.00 1.00000000000 FORMAT "%13.11" /end CHARACTERISTIC
/begin CHARACTERISTIC DFES_EnvRef.DFC_ComEAT10Chksum_C "used environment signals / Reference to used environment condition set for check DFC_ComEAT10Chksum" VALUE 0x804F98B9 Val_Wu8 1.00000000000 DFES_EnvTabVerb 0.00 1.00000000000 FORMAT "%13.11" /end CHARACTERISTIC
/begin CHARACTERISTIC DFES_EnvRef.DFC_ComEAT10RingCnt_C "used environment signals / Reference to used environment condition set for check DFC_ComEAT10RingCnt" VALUE 0x804F98BA Val_Wu8 1.00000000000 DFES_EnvTabVerb 0.00 1.00000000000 FORMAT "%13.11" /end CHARACTERISTIC
/begin CHARACTERISTIC DFES_EnvRef.DFC_ComEAT10TOut_C "used environment signals / Reference to used environment condition set for check DFC_ComEAT10TOut" VALUE 0x804F98BB Val_Wu8 1.00000000000 DFES_EnvTabVerb 0.00 1.00000000000 FORMAT "%13.11" /end CHARACTERISTIC
/begin CHARACTERISTIC DFES_EnvRef.DFC_ComEAT11ChkSum_C "used environment signals / Reference to used environment condition set for check DFC_ComEAT11ChkSum" VALUE 0x804F98BC Val_Wu8 1.00000000000 DFES_EnvTabVerb 0.00 1.00000000000 FORMAT "%13.11" /end CHARACTERISTIC
/begin CHARACTERISTIC DFES_EnvRef.DFC_ComEAT11RingCnt_C "used environment signals / Reference to used environment condition set for check DFC_ComEAT11RingCnt" VALUE 0x804F98BD Val_Wu8 1.00000000000 DFES_EnvTabVerb 0.00 1.00000000000 FORMAT "%13.11" /end CHARACTERISTIC
/begin CHARACTERISTIC DFES_EnvRef.DFC_ComEAT11TOut_C "used environment signals / Reference to used environment condition set for check DFC_ComEAT11TOut" VALUE 0x804F98BE Val_Wu8 1.00000000000 DFES_EnvTabVerb 0.00 1.00000000000 FORMAT "%13.11" /end CHARACTERISTIC
/begin CHARACTERISTIC DFES_EnvRef.DFC_ComEAT12ChkSum_C "used environment signals / Reference to used environment condition set for check DFC_ComEAT12ChkSum" VALUE 0x804F98BF Val_Wu8 1.00000000000 DFES_EnvTabVerb 0.00 1.00000000000 FORMAT "%13.11" /end CHARACTERISTIC
/begin CHARACTERISTIC DFES_EnvRef.DFC_ComEAT12RingCnt_C "used environment signals / Reference to used environment condition set for check DFC_ComEAT12RingCnt" VALUE 0x804F98C0 Val_Wu8 1.00000000000 DFES_EnvTabVerb 0.00 1.00000000000 FORMAT "%13.11" /end CHARACTERISTIC
/begin CHARACTERISTIC DFES_EnvRef.DFC_ComEAT12TOut_C "used environment signals / Reference to used environment condition set for check DFC_ComEAT12TOut" VALUE 0x804F98C1 Val_Wu8 1.00000000000 DFES_EnvTabVerb 0.00 1.00000000000 FORMAT "%13.11" /end CHARACTERISTIC
/begin CHARACTERISTIC DFES_EnvRef.DFC_ComEAT13ChkSum_C "used environment signals / Reference to used environment condition set for check DFC_ComEAT13ChkSum" VALUE 0x804F98C2 Val_Wu8 1.00000000000 DFES_EnvTabVerb 0.00 1.00000000000 FORMAT "%13.11" /end CHARACTERISTIC
/begin CHARACTERISTIC DFES_EnvRef.DFC_ComEAT13RingCnt_C "used environment signals / Reference to used environment condition set for check DFC_ComEAT13RingCnt" VALUE 0x804F98C3 Val_Wu8 1.00000000000 DFES_EnvTabVerb 0.00 1.00000000000 FORMAT "%13.11" /end CHARACTERISTIC
/begin CHARACTERISTIC DFES_EnvRef.DFC_ComEAT13TOut_C "used environment signals / Reference to used environment condition set for check DFC_ComEAT13TOut" VALUE 0x804F98C4 Val_Wu8 1.00000000000 DFES_EnvTabVerb 0.00 1.00000000000 FORMAT "%13.11" /end CHARACTERISTIC
/begin CHARACTERISTIC DFES_EnvRef.DFC_ComEAT1Chksum_C "used environment signals / Reference to used environment condition set for check DFC_ComEAT1Chksum" VALUE 0x804F98C5 Val_Wu8 1.00000000000 DFES_EnvTabVerb 0.00 1.00000000000 FORMAT "%13.11" /end CHARACTERISTIC
/begin CHARACTERISTIC DFES_EnvRef.DFC_ComEAT1RingCnt_C "used environment signals / Reference to used environment condition set for check DFC_ComEAT1RingCnt" VALUE 0x804F98C6 Val_Wu8 1.00000000000 DFES_EnvTabVerb 0.00 1.00000000000 FORMAT "%13.11" /end CHARACTERISTIC
/begin CHARACTERISTIC DFES_EnvRef.DFC_ComEAT1TOut_C "used environment signals / Reference to used environment condition set for check DFC_ComEAT1TOut" VALUE 0x804F98C7 Val_Wu8 1.00000000000 DFES_EnvTabVerb 0.00 1.00000000000 FORMAT "%13.11" /end CHARACTERISTIC
/begin CHARACTERISTIC DFES_EnvRef.DFC_ComEAT2ChkSum_C "used environment signals / Reference to used environment condition set for check DFC_ComEAT2ChkSum" VALUE 0x804F98C8 Val_Wu8 1.00000000000 DFES_EnvTabVerb 0.00 1.00000000000 FORMAT "%13.11" /end CHARACTERISTIC
/begin CHARACTERISTIC DFES_EnvRef.DFC_ComEAT2RingCnt_C "used environment signals / Reference to used environment condition set for check DFC_ComEAT2RingCnt" VALUE 0x804F98C9 Val_Wu8 1.00000000000 DFES_EnvTabVerb 0.00 1.00000000000 FORMAT "%13.11" /end CHARACTERISTIC
/begin CHARACTERISTIC DFES_EnvRef.DFC_ComEAT2TOut_C "used environment signals / Reference to used environment condition set for check DFC_ComEAT2TOut" VALUE 0x804F98CA Val_Wu8 1.00000000000 DFES_EnvTabVerb 0.00 1.00000000000 FORMAT "%13.11" /end CHARACTERISTIC
/begin CHARACTERISTIC DFES_EnvRef.DFC_ComEAT4ChkSum_C "used environment signals / Reference to used environment condition set for check DFC_ComEAT4ChkSum" VALUE 0x804F98CB Val_Wu8 1.00000000000 DFES_EnvTabVerb 0.00 1.00000000000 FORMAT "%13.11" /end CHARACTERISTIC
/begin CHARACTERISTIC DFES_EnvRef.DFC_ComEAT4RingCnt_C "used environment signals / Reference to used environment condition set for check DFC_ComEAT4RingCnt" VALUE 0x804F98CC Val_Wu8 1.00000000000 DFES_EnvTabVerb 0.00 1.00000000000 FORMAT "%13.11" /end CHARACTERISTIC
/begin CHARACTERISTIC DFES_EnvRef.DFC_ComEAT4TOut_C "used environment signals / Reference to used environment condition set for check DFC_ComEAT4TOut" VALUE 0x804F98CD Val_Wu8 1.00000000000 DFES_EnvTabVerb 0.00 1.00000000000 FORMAT "%13.11" /end CHARACTERISTIC
/begin CHARACTERISTIC DFES_EnvRef.DFC_ComEAT6Chksum_C "used environment signals / Reference to used environment condition set for check DFC_ComEAT6Chksum" VALUE 0x804F98CE Val_Wu8 1.00000000000 DFES_EnvTabVerb 0.00 1.00000000000 FORMAT "%13.11" /end CHARACTERISTIC
/begin CHARACTERISTIC DFES_EnvRef.DFC_ComEAT6RingCnt_C "used environment signals / Reference to used environment condition set for check DFC_ComEAT6RingCnt" VALUE 0x804F98CF Val_Wu8 1.00000000000 DFES_EnvTabVerb 0.00 1.00000000000 FORMAT "%13.11" /end CHARACTERISTIC
/begin CHARACTERISTIC DFES_EnvRef.DFC_ComEAT6TOut_C "used environment signals / Reference to used environment condition set for check DFC_ComEAT6TOut" VALUE 0x804F98D0 Val_Wu8 1.00000000000 DFES_EnvTabVerb 0.00 1.00000000000 FORMAT "%13.11" /end CHARACTERISTIC
/begin CHARACTERISTIC DFES_EnvRef.DFC_ComEAT7Chksum_C "used environment signals / Reference to used environment condition set for check DFC_ComEAT7Chksum" VALUE 0x804F98D1 Val_Wu8 1.00000000000 DFES_EnvTabVerb 0.00 1.00000000000 FORMAT "%13.11" /end CHARACTERISTIC
/begin CHARACTERISTIC DFES_EnvRef.DFC_ComEAT7RingCnt_C "used environment signals / Reference to used environment condition set for check DFC_ComEAT7RingCnt" VALUE 0x804F98D2 Val_Wu8 1.00000000000 DFES_EnvTabVerb 0.00 1.00000000000 FORMAT "%13.11" /end CHARACTERISTIC
/begin CHARACTERISTIC DFES_EnvRef.DFC_ComEAT7TOut_C "used environment signals / Reference to used environment condition set for check DFC_ComEAT7TOut" VALUE 0x804F98D3 Val_Wu8 1.00000000000 DFES_EnvTabVerb 0.00 1.00000000000 FORMAT "%13.11" /end CHARACTERISTIC
/begin CHARACTERISTIC DFES_EnvRef.DFC_ComEAT8Chksum_C "used environment signals / Reference to used environment condition set for check DFC_ComEAT8Chksum" VALUE 0x804F98D4 Val_Wu8 1.00000000000 DFES_EnvTabVerb 0.00 1.00000000000 FORMAT "%13.11" /end CHARACTERISTIC
/begin CHARACTERISTIC DFES_EnvRef.DFC_ComEAT8RingCnt_C "used environment signals / Reference to used environment condition set for check DFC_ComEAT8RingCnt" VALUE 0x804F98D5 Val_Wu8 1.00000000000 DFES_EnvTabVerb 0.00 1.00000000000 FORMAT "%13.11" /end CHARACTERISTIC
/begin FUNCTION DFES "30000.73.0_2.0.0Diagnostic Fault Event Storage"
 /begin DEF_CHARACTERISTIC DFES_DTCO.DFC_MisfDetdVWhlFrntRiPlaus_C DFES_DTCO.DFC_MisfDetdVWhlReLePlaus_C DFES_DTCO.DFC_MisfDetdVWhlReRiPlaus_C DFES_DTCO.DFC_PEnvSigRngMax_C DFES_DTCO.DFC_PEnvSigRngMin_C DFES_DTCO.DFC_StmFault_C DFES_DTCO.DFC_StrtCtOffPth_C DFES_DTCO.DFC_StrtCtlErr_C DFES_DTCO.DFC_StrtFault_C DFES_DTCO.DFC_StrtLckJudg1_C DFES_DTCO.DFC_StrtLckJudg2_C DFES_DTCO.DFC_StrtOL_C DFES_DTCO.DFC_StrtOL2_C DFES_DTCO.DFC_StrtSCB_C DFES_DTCO.DFC_StrtSCB2_C DFES_DTCO.DFC_StrtSCG_C DFES_DTCO.DFC_StrtSCG2_C DFES_DTCO.DFC_StrtStkRly1_C DFES_DTCO.DFC_StrtStkRly2_C DFES_DTCO.DFC_TEVEmax_C DFES_DTCO.DFC_TEVEmin_C DFES_DTCO.DFC_TEVEsig_C DFES_DTCO.DFC_VehVAllPlaus_C DFES_DTCO.DFC_VehVNCSnsrElecFailr_C DFES_DTCO.DFC_VehVPlausCan_C DFES_DTCO.DFC_VehVPlausFco_C DFES_DTCO.DFC_VehVPlausPwr_C DFES_DTCO.DFC_VehVPlausV2N_C DFES_DTCO.DFC_VehVSpdSnsrAElecFailr_C DFES_DTCO.DFC_VehVSpdSnsrBElecFailr_C DFES_DTCO.DFC_ClthMax_C DFES_DTCO.DFC_IgnClPs_DevComErr_C DFES_DTCO.DFC_IgnClPs_LineOl_0_C DFES_DTCO.DFC_IgnClPs_LineOl_1_C DFES_DTCO.DFC_IgnClPs_LineOl_2_C DFES_DTCO.DFC_IgnClPs_LineOl_3_C DFES_DTCO.DFC_IgnClPs_LineScb_0_C DFES_DTCO.DFC_IgnClPs_LineScb_1_C DFES_DTCO.DFC_IgnClPs_LineScb_2_C DFES_DTCO.DFC_IgnClPs_LineScb_3_C DFES_DTCO.DFC_IgnClPs_LineScg_0_C DFES_DTCO.DFC_IgnClPs_LineScg_1_C DFES_DTCO.DFC_IgnClPs_LineScg_2_C DFES_DTCO.DFC_IgnClPs_LineScg_3_C DFES_DTCO.DFC_UEGOASICS1B1_C DFES_DTCO.DFC_UEGOOLIPES1B1_C DFES_DTCO.DFC_UEGOOLRES1B1_C DFES_DTCO.DFC_UEGOSCBS1B1_C DFES_DTCO.DFC_UEGOSCGS1B1_C DFES_DTCO.DFC_UEGOSPIS1B1_C DFES_DTCO.DFC_UEGOSnsrS1B1_C DFES_DTCO.DFC_UegoOlApesS1B1_C DFES_DTCO.DFC_UegoOlRCmpS1B1_C DFES_DTCO.DFC_AirCCmprOL_C DFES_DTCO.DFC_AirCCmprOvrTemp_C DFES_DTCO.DFC_AirCCmprSCB_C DFES_DTCO.DFC_AirCCmprSCG_C DFES_DTCO.DFC_AltErr_C DFES_DTCO.DFC_BattUSRCMax_C DFES_DTCO.DFC_BattUSRCMin_C DFES_DTCO.DFC_ComChksTCU1_C DFES_DTCO.DFC_ComChksTCU11_C DFES_DTCO.DFC_ComChksTCU12_C DFES_DTCO.DFC_ComChksTCU13_C DFES_DTCO.DFC_ComChksTCU2_C DFES_DTCO.DFC_ComChksTCU3_C DFES_DTCO.DFC_ComChksTCU4_C DFES_DTCO.DFC_ComCntTCU1_C DFES_DTCO.DFC_ComCntTCU11_C DFES_DTCO.DFC_ComCntTCU12_C DFES_DTCO.DFC_ComCntTCU13_C DFES_DTCO.DFC_ComCntTCU2_C DFES_DTCO.DFC_ComCntTCU3_C DFES_DTCO.DFC_ComCntTCU4_C DFES_DTCO.DFC_ComTOutTCU01_C DFES_DTCO.DFC_ComTOutTCU02_C DFES_DTCO.DFC_ComTOutTCU1_C DFES_DTCO.DFC_ComTOutTCU11_C DFES_DTCO.DFC_ComTOutTCU12_C DFES_DTCO.DFC_ComTOutTCU13_C DFES_DTCO.DFC_ComTOutTCU14_C DFES_DTCO.DFC_ComTOutTCU2_C DFES_DTCO.DFC_ComTOutTCU3_C DFES_DTCO.DFC_ComTOutTCU4_C DFES_DTCO.DFC_DevLibBattUHi_C DFES_DTCO.DFC_DevLibBattULo_C DFES_DTCO.DFC_FanDIOOL_0_C DFES_DTCO.DFC_FanDIOOL_1_C DFES_DTCO.DFC_FanDIOOvrTemp_0_C DFES_DTCO.DFC_FanDIOOvrTemp_1_C DFES_DTCO.DFC_FanDIOSCB_0_C DFES_DTCO.DFC_FanDIOSCB_1_C DFES_DTCO.DFC_FanDIOSCG_0_C DFES_DTCO.DFC_FanDIOSCG_1_C DFES_DTCO.DFC_MRlyDcOL_C DFES_DTCO.DFC_MRlyDcSCB_C DFES_DTCO.DFC_MRlyDcSCG_C DFES_DTCO.DFC_PSPOL_C DFES_DTCO.DFC_PSPOvrTemp_C DFES_DTCO.DFC_PSPSCB_C DFES_DTCO.DFC_PSPSCG_C DFES_DTCO.DFC_T50Err_C DFES_DTCO.DFC_ThrVlvLoBattB1_C DFES_DTCO.DFC_VehVPhysRngHi_C DFES_DTCO.DFC_VehVSclOutOL_C DFES_DTCO.DFC_VehVSclOutOT_C DFES_DTCO.DFC_VehVSclOutSCB_C DFES_DTCO.DFC_VehVSclOutSCG_C DFES_DTCO.DFC_VehVSnsrARngHi_C DFES_DTCO.DFC_VehVSnsrBRngHi_C DFES_DTCO.DFC_VehVSpdRtyDiag_C DFES_DTCO.DFC_VehVWhlErr_C DFES_DTCO.DFC_ACEvpTSRCMax_C DFES_DTCO.DFC_ACEvpTSRCMin_C DFES_DTCO.DFC_AirCClntPAnaSRCMax_C DFES_DTCO.DFC_AirCClntPAnaSRCMin_C DFES_DTCO.DFC_AirCSwtNpl_C DFES_DTCO.DFC_AirCSwtSig_C DFES_DTCO.DFC_Brk_C DFES_DTCO.DFC_BrkSig_C DFES_DTCO.DFC_ClthSig_C DFES_DTCO.DFC_HLSDemOvhtEngLim_C DFES_DTCO.DFC_OilPNpl_C DFES_DTCO.DFC_PIntkVUsLineHiB1_C DFES_DTCO.DFC_PIntkVUsLineLoB1_C DFES_DTCO.DFC_VehVPhysRngLo_C DFES_DTCO.DFC_VehVSigCan_C DFES_DTCO.DFC_VehVSigCanSafe_C DFES_DTCO.DFC_VlvLftFbOilPSnsrIntk11SRCMax_C DFES_DTCO.DFC_VlvLftFbOilPSnsrIntk11SRCMin_C DFES_DTCO.DFC_ClthNpl_C DFES_DTCO.DFC_EV1max_C DFES_DTCO.DFC_EV1min_C DFES_DTCO.DFC_EV1sig_C DFES_DTCO.DFC_EV2max_C DFES_DTCO.DFC_EV2min_C DFES_DTCO.DFC_EV2sig_C DFES_DTCO.DFC_EV3max_C DFES_DTCO.DFC_EV3min_C DFES_DTCO.DFC_EV3sig_C DFES_DTCO.DFC_EV4max_C DFES_DTCO.DFC_EV4min_C DFES_DTCO.DFC_EV4sig_C DFES_DTCO.DFC_GbxPNPosnDrvCdn_C DFES_DTCO.DFC_GbxPNPosnPlausy_C DFES_DTCO.DFC_PEnvCcMax_C DFES_DTCO.DFC_PEnvCcMin_C DFES_DTCO.DFC_PEnvRngChkMax_C DFES_DTCO.DFC_PEnvRngChkMin_C DFES_DTCO.DFC_PEnvSnsrPlaus_C DFES_DTCO.DFC_UEGOHeatrPsS1B1Max_C DFES_DTCO.DFC_UEGOHeatrPsS1B1Min_C DFES_DTCO.DFC_UEGOHeatrPsS1B1Sig_C DFES_DTCO.DFC_UEGOHeatrRlyPsOLS1B1_C DFES_DTCO.DFC_UEGOHeatrRlyPsSCBS1B1_C DFES_DTCO.DFC_UEGOHeatrRlyPsSCGS1B1_C DFES_DTCO.DFC_KnDetSens1PortAMax_C DFES_DTCO.DFC_KnDetSens1PortAMin_C DFES_DTCO.DFC_KnDetSens1PortBMax_C DFES_DTCO.DFC_KnDetSens1PortBMin_C DFES_DTCO.DFC_Clth2ONStuck_C DFES_DTCO.DFC_Clth2ONStuckLdc_C DFES_DTCO.DFC_Clth3ONStuckLdc_C DFES_DTCO.DFC_Clth3ONStuckPostDrv_C DFES_DTCO.DFC_Clth4ONStuck_C DFES_DTCO.DFC_Clth4ONStuckLdc_C DFES_DTCO.DFC_ComDLCTCU01_C DFES_DTCO.DFC_ComDLCTCU02_C DFES_DTCO.DFC_ComDLCTCU1_C DFES_DTCO.DFC_ComDLCTCU11_C DFES_DTCO.DFC_ComDLCTCU12_C DFES_DTCO.DFC_ComDLCTCU13_C DFES_DTCO.DFC_ComDLCTCU14_C DFES_DTCO.DFC_ComDLCTCU2_C DFES_DTCO.DFC_ComDLCTCU3_C DFES_DTCO.DFC_ComDLCTCU4_C DFES_DTCO.DFC_EVX_C DFES_DTCO.DFC_EbsSocFlt_C DFES_DTCO.DFC_I14229VINErr_C DFES_DTCO.DFC_LLRKHmax_C DFES_DTCO.DFC_LLRKHmin_C DFES_DTCO.DFC_LLRmax_C DFES_DTCO.DFC_LLRmin_C DFES_DTCO.DFC_RoughRoad_C DFES_DTCO.DFC_SiaEEPRdErr_C DFES_DTCO.DFC_SiaEEPWrngCod_C DFES_DTCO.DFC_UegoDummy_C DFES_DTCO.DFC_BusDiagCANAPPLBusOff_C DFES_DTCO.DFC_BusDiagCANCANCBusOff_C DFES_DTCO.DFC_BusDiagCANVEHICLEBusOff_C DFES_DTCO.DFC_RBA_IODIAGPWR_rba_IoExtCy329_SignalVltSply_0_C DFES_DTCO.DFC_RBA_IODIAGPWR_rba_IoExtCy329_SignalVltSply_0OT_C DFES_DTCO.DFC_RBA_IODIAGPWR_rba_IoExtCy329_SignalVltSply_0OV_C DFES_DTCO.DFC_RBA_IODIAGPWR_rba_IoExtCy329_SignalVltSply_0SCG_C DFES_DTCO.DFC_RBA_IODIAGPWR_rba_IoExtCy329_SignalVltSply_0UV_C DFES_DTCO.DFC_RBA_IODIAGPWR_rba_IoExtCy329_SignalVltSply_1_C DFES_DTCO.DFC_RBA_IODIAGPWR_rba_IoExtCy329_SignalVltSply_1OT_C DFES_DTCO.DFC_RBA_IODIAGPWR_rba_IoExtCy329_SignalVltSply_1OV_C DFES_DTCO.DFC_RBA_IODIAGPWR_rba_IoExtCy329_SignalVltSply_1SCG_C DFES_DTCO.DFC_RBA_IODIAGPWR_rba_IoExtCy329_SignalVltSply_1UV_C DFES_DTCO.DFC_RBA_IODIAGPWR_rba_IoExtCy329_SignalVltSply_2_C DFES_DTCO.DFC_RBA_IODIAGPWR_rba_IoExtCy329_SignalVltSply_2OT_C DFES_DTCO.DFC_RBA_IODIAGPWR_rba_IoExtCy329_SignalVltSply_2OV_C DFES_DTCO.DFC_RBA_IODIAGPWR_rba_IoExtCy329_SignalVltSply_2SCG_C DFES_DTCO.DFC_RBA_IODIAGPWR_rba_IoExtCy329_SignalVltSply_2UV_C DFES_DTCO.DFC_CAN_E_TIMEOUT_C DFES_DTCO.DFC_LIN_E_TIMEOUT_C DFES_DTCO.DFC_MRlyOL_C DFES_DTCO.DFC_MRlySCB_C DFES_DTCO.DFC_MRlySCG_C DFES_DTCO.DFC_rba_MultiStackTrace_Threshold_C DFES_DTCO.DFC_BSWM_E_ACTION_FAILED_C DFES_DTCO.DFC_BSWM_E_INTRPTQUEUE_FULL_C DFES_DTCO.DFC_RBA_IOEXTLIB_KEEPALIVE_DRV_C DFES_DTCO.DFC_RBA_IOEXTLIB_KEEPALIVE_INI_C DFES_DTCO.DFC_rba_IoSigRtc_StopCounter_C DFES_DTCO.DFC_rba_MRly_Diag_Stk_Event_C DFES_DTCO.DFC_rba_MemDiag_MemReadErr_C DFES_DTCO.DFC_rba_MemDiag_MemWrErr_C DFES_DTCO.DFC_rba_SyC_IrrSwOffTrigEngRun_Event_C DFES_DTCO.DFC_rba_T15_Diag_ComInVld_Event_C DFES_DTCO.DFC_rba_T15_Diag_ComOff_HwOn_Event_C DFES_DTCO.DFC_rba_T15_Diag_ComOn_HwOff_Event_C DFES_DTCO.DFC_AppAllSnsrDfct_C DFES_DTCO.DFC_BattUStdbyDiaOL_C DFES_DTCO.DFC_BigLeakIntkMnfldEmiInfl_C DFES_DTCO.DFC_BrkMnSwtContOnWarnLmp_C DFES_DTCO.DFC_BrkMnSwtNotStpWarnLmp_C DFES_DTCO.DFC_BrkRdntSwtContOnWarnLmp_C DFES_DTCO.DFC_BrkRdntSwtNotStpWarnLmp_C DFES_DTCO.DFC_CEngDsTColdStrtMax_C DFES_DTCO.DFC_CEngDsTColdStrtMin_C DFES_DTCO.DFC_CEngDsTImps_C DFES_DTCO.DFC_CEngDsTPlausLSC_C DFES_DTCO.DFC_CEngDsTPlausSTC_C DFES_DTCO.DFC_CEngDsTSRCMax_C DFES_DTCO.DFC_CEngDsTSRCMin_C DFES_DTCO.DFC_CEngDsTSig_C DFES_DTCO.DFC_CEngUsTSRCMax_C DFES_DTCO.DFC_CEngUsTSRCMin_C DFES_DTCO.DFC_DCDCFltDet_C DFES_DTCO.DFC_DKRSA_C DFES_DTCO.DFC_DKVSmax_C DFES_DTCO.DFC_DKnpl_C DFES_DTCO.DFC_DSSmax_C DFES_DTCO.DFC_DSTTI_C DFES_DTCO.DFC_DSUmax_C DFES_DTCO.DFC_EGRVlvOL_C DFES_DTCO.DFC_EGRVlvSCB_C DFES_DTCO.DFC_EGRVlvSCG_C DFES_DTCO.DFC_EGSDUS2B1LtrDly_C DFES_DTCO.DFC_EGSDUS2B1LtrPT1_C DFES_DTCO.DFC_EGSDUS2B1RtlDly_C DFES_DTCO.DFC_EGSDUS2B1RtlPT1_C DFES_DTCO.DFC_EGSDUS2B1TarLean_C DFES_DTCO.DFC_EGSDUS2B1TarRich_C DFES_DTCO.DFC_ETAKHLmax_C DFES_DTCO.DFC_ETAKHTmax_C DFES_DTCO.DFC_EngICO_C DFES_DTCO.DFC_EngPrtOvrSpdMon_C DFES_DTCO.DFC_EpmCaSI1ErrSig_C DFES_DTCO.DFC_EpmCaSI1NoSig_C DFES_DTCO.DFC_EpmCaSI1OfsErr_C DFES_DTCO.DFC_EpmCrSErrSig_C DFES_DTCO.DFC_EpmCrSNoSig_C DFES_DTCO.DFC_EtaEngIdleNonCsers_C DFES_DTCO.DFC_EtaEngPtlNonCsers_C DFES_DTCO.DFC_FRAmax_C DFES_DTCO.DFC_FRAmin_C DFES_DTCO.DFC_GbxRvsSwtStk_C DFES_DTCO.DFC_HDRmax_C DFES_DTCO.DFC_HEGOS2B1ElecMax_C DFES_DTCO.DFC_HEGOS2B1ElecMin_C DFES_DTCO.DFC_HEGOS2B1ElecSig_C DFES_DTCO.DFC_HEGOS2B1HtgNpl_C DFES_DTCO.DFC_IntkAirTIntkMnfldCrssMax_C DFES_DTCO.DFC_IntkAirTIntkMnfldCrssMin_C DFES_DTCO.DFC_IntkAirTIntkMnfldHSCMax_C DFES_DTCO.DFC_IntkAirTIntkMnfldImps_C DFES_DTCO.DFC_IntkAirTIntkMnfldPRCMax_C DFES_DTCO.DFC_IntkAirTIntkMnfldPRCMin_C DFES_DTCO.DFC_IntkAirTIntkMnfldSRCMax_C DFES_DTCO.DFC_IntkAirTIntkMnfldSRCMin_C DFES_DTCO.DFC_IntkAirTIntkMnfldSTC_C DFES_DTCO.DFC_KS1max_C DFES_DTCO.DFC_KS1min_C DFES_DTCO.DFC_LMmax_C DFES_DTCO.DFC_LZSRnpl_C DFES_DTCO.DFC_LamDynDiagS1B1_C DFES_DTCO.DFC_LeakIntkMnfldEmiInfl_C DFES_DTCO.DFC_MD00max_C DFES_DTCO.DFC_MDBmax_C DFES_DTCO.DFC_MDCat_C DFES_DTCO.DFC_MDCatCrit_C DFES_DTCO.DFC_MDCatCurr_C DFES_DTCO.DFC_MDCyl_0_C DFES_DTCO.DFC_MDCyl_1_C DFES_DTCO.DFC_MDCyl_2_C DFES_DTCO.DFC_MDCyl_3_C DFES_DTCO.DFC_MDEmi_C DFES_DTCO.DFC_MDEmiStrt_C DFES_DTCO.DFC_MDFco_C DFES_DTCO.DFC_MDMpl_C DFES_DTCO.DFC_MDSegTiAdpn_C DFES_DTCO.DFC_MDmax_C DFES_DTCO.DFC_MOXEMM_SMU_ALM0_0_C DFES_DTCO.DFC_MOXEMM_SMU_ALM0_1_C DFES_DTCO.DFC_MOXEMM_SMU_ALM0_10_C DFES_DTCO.DFC_MOXEMM_SMU_ALM0_11_C DFES_DTCO.DFC_MOXEMM_SMU_ALM0_13_C DFES_DTCO.DFC_MOXEMM_SMU_ALM0_14_C DFES_DTCO.DFC_MOXEMM_SMU_ALM0_2_C DFES_DTCO.DFC_MOXEMM_SMU_ALM0_22_C DFES_DTCO.DFC_MOXEMM_SMU_ALM0_23_C DFES_DTCO.DFC_MOXEMM_SMU_ALM0_4_C DFES_DTCO.DFC_MOXEMM_SMU_ALM0_5_C DFES_DTCO.DFC_MOXEMM_SMU_ALM0_7_C DFES_DTCO.DFC_MOXEMM_SMU_ALM0_8_C DFES_DTCO.DFC_MOXEMM_SMU_ALM10_16_C DFES_DTCO.DFC_MOXEMM_SMU_ALM10_17_C DFES_DTCO.DFC_MOXEMM_SMU_ALM10_21_C DFES_DTCO.DFC_MOXEMM_SMU_ALM11_0_C DFES_DTCO.DFC_MOXEMM_SMU_ALM11_1_C DFES_DTCO.DFC_MOXEMM_SMU_ALM11_2_C DFES_DTCO.DFC_MOXEMM_SMU_ALM11_3_C DFES_DTCO.DFC_MOXEMM_SMU_ALM11_4_C DFES_DTCO.DFC_MOXEMM_SMU_ALM11_5_C DFES_DTCO.DFC_MOXEMM_SMU_ALM11_8_C DFES_DTCO.DFC_MOXEMM_SMU_ALM11_9_C DFES_DTCO.DFC_MOXEMM_SMU_ALM1_0_C DFES_DTCO.DFC_MOXEMM_SMU_ALM1_1_C DFES_DTCO.DFC_MOXEMM_SMU_ALM1_10_C DFES_DTCO.DFC_MOXEMM_SMU_ALM1_11_C DFES_DTCO.DFC_MOXEMM_SMU_ALM1_13_C DFES_DTCO.DFC_MOXEMM_SMU_ALM1_14_C DFES_DTCO.DFC_MOXEMM_SMU_ALM1_2_C DFES_DTCO.DFC_MOXEMM_SMU_ALM1_22_C DFES_DTCO.DFC_MOXEMM_SMU_ALM1_23_C DFES_DTCO.DFC_MOXEMM_SMU_ALM1_4_C DFES_DTCO.DFC_MOXEMM_SMU_ALM1_5_C DFES_DTCO.DFC_MOXEMM_SMU_ALM1_7_C DFES_DTCO.DFC_MOXEMM_SMU_ALM1_8_C DFES_DTCO.DFC_MOXEMM_SMU_ALM21_0_C DFES_DTCO.DFC_MOXEMM_SMU_ALM21_16_C DFES_DTCO.DFC_MOXEMM_SMU_ALM21_3_C DFES_DTCO.DFC_MOXEMM_SMU_ALM2_1_C DFES_DTCO.DFC_MOXEMM_SMU_ALM2_10_C DFES_DTCO.DFC_MOXEMM_SMU_ALM2_11_C DFES_DTCO.DFC_MOXEMM_SMU_ALM2_13_C DFES_DTCO.DFC_MOXEMM_SMU_ALM2_14_C DFES_DTCO.DFC_MOXEMM_SMU_ALM2_22_C DFES_DTCO.DFC_MOXEMM_SMU_ALM2_23_C DFES_DTCO.DFC_MOXEMM_SMU_ALM2_4_C DFES_DTCO.DFC_MOXEMM_SMU_ALM2_5_C DFES_DTCO.DFC_MOXEMM_SMU_ALM2_7_C DFES_DTCO.DFC_MOXEMM_SMU_ALM2_8_C DFES_DTCO.DFC_MOXEMM_SMU_ALM6_0_C DFES_DTCO.DFC_MOXEMM_SMU_ALM6_11_C DFES_DTCO.DFC_MOXEMM_SMU_ALM6_12_C DFES_DTCO.DFC_MOXEMM_SMU_ALM6_14_C DFES_DTCO.DFC_MOXEMM_SMU_ALM6_15_C DFES_DTCO.DFC_MOXEMM_SMU_ALM6_17_C DFES_DTCO.DFC_MOXEMM_SMU_ALM6_18_C DFES_DTCO.DFC_MOXEMM_SMU_ALM6_20_C DFES_DTCO.DFC_MOXEMM_SMU_ALM6_21_C DFES_DTCO.DFC_MOXEMM_SMU_ALM6_25_C DFES_DTCO.DFC_MOXEMM_SMU_ALM6_4_C DFES_DTCO.DFC_MOXEMM_SMU_ALM6_5_C DFES_DTCO.DFC_MOXEMM_SMU_ALM6_7_C DFES_DTCO.DFC_MOXEMM_SMU_ALM6_8_C DFES_DTCO.DFC_MOXEMM_SMU_ALM7_1_C DFES_DTCO.DFC_MOXEMM_SMU_ALM7_12_C DFES_DTCO.DFC_MOXEMM_SMU_ALM7_13_C DFES_DTCO.DFC_MOXEMM_SMU_ALM7_14_C DFES_DTCO.DFC_MOXEMM_SMU_ALM7_15_C DFES_DTCO.DFC_MOXEMM_SMU_ALM7_16_C DFES_DTCO.DFC_MOXEMM_SMU_ALM7_17_C DFES_DTCO.DFC_MOXEMM_SMU_ALM7_2_C DFES_DTCO.DFC_MOXEMM_SMU_ALM7_20_C DFES_DTCO.DFC_MOXEMM_SMU_ALM7_25_C DFES_DTCO.DFC_MOXEMM_SMU_ALM7_26_C DFES_DTCO.DFC_MOXEMM_SMU_ALM7_28_C DFES_DTCO.DFC_MOXEMM_SMU_ALM7_29_C DFES_DTCO.DFC_MOXEMM_SMU_ALM7_30_C DFES_DTCO.DFC_MOXEMM_SMU_ALM7_31_C DFES_DTCO.DFC_MOXEMM_SMU_ALM8_0_C DFES_DTCO.DFC_MOXEMM_SMU_ALM8_1_C DFES_DTCO.DFC_MOXEMM_SMU_ALM8_10_C DFES_DTCO.DFC_MOXEMM_SMU_ALM8_11_C DFES_DTCO.DFC_MOXEMM_SMU_ALM8_12_C DFES_DTCO.DFC_MOXEMM_SMU_ALM8_16_C DFES_DTCO.DFC_MOXEMM_SMU_ALM8_18_C DFES_DTCO.DFC_MOXEMM_SMU_ALM8_2_C DFES_DTCO.DFC_MOXEMM_SMU_ALM8_3_C DFES_DTCO.DFC_MOXEMM_SMU_ALM8_31_C DFES_DTCO.DFC_MOXEMM_SMU_ALM8_4_C DFES_DTCO.DFC_MOXEMM_SMU_ALM9_0_C DFES_DTCO.DFC_MOXEMM_SMU_ALM9_15_C DFES_DTCO.DFC_MOXEMM_SMU_ALM9_3_C DFES_DTCO.DFC_MoCADCNTP_C DFES_DTCO.DFC_MoCADCTst_C DFES_DTCO.DFC_MoCSOPICO_C DFES_DTCO.DFC_MoFAPP_C DFES_DTCO.DFC_MoFAirFilgPrdc_C DFES_DTCO.DFC_MoFAirFlCtOffPfi_C DFES_DTCO.DFC_MoFAirFlCylPfi_C DFES_DTCO.DFC_MoFAirFlIn_C DFES_DTCO.DFC_MoFAirFlMixCtlPfiChkAirFl_C DFES_DTCO.DFC_MoFAirFlMixCtlPfiChkCtrl_C DFES_DTCO.DFC_MoFAirFlMode_C DFES_DTCO.DFC_MoFESpd_C DFES_DTCO.DFC_MoFIACo_C DFES_DTCO.DFC_MoFICOL1_C DFES_DTCO.DFC_MoFICOL2_C DFES_DTCO.DFC_MoFStrt_C DFES_DTCO.DFC_MoFTrqCmp_C DFES_DTCO.DFC_MoFTrqCmpMax_C DFES_DTCO.DFC_MoFTrqCmpMin_C DFES_DTCO.DFC_MoFVarPostBldSel_C DFES_DTCO.DFC_MoXEMMHwLTMCUFW_C DFES_DTCO.DFC_MoXEMMHwLTMonBIST_C DFES_DTCO.DFC_MoXEMMHwLTRegMonTest_C DFES_DTCO.DFC_MoXEMMHwLTStbySMUAlvTest_C DFES_DTCO.DFC_MoXEMMHwLTTempSens_C DFES_DTCO.DFC_MoXEMMHwLTUCBCfg_C DFES_DTCO.DFC_OCWDAABEActv_C DFES_DTCO.DFC_OCWDACom_C DFES_DTCO.DFC_OCWDAErrPin_C DFES_DTCO.DFC_OCWDAOvrVltg_C DFES_DTCO.DFC_ORAmax_C DFES_DTCO.DFC_ORAmin_C DFES_DTCO.DFC_PLLSUmax_C DFES_DTCO.DFC_PLLSUmin_C DFES_DTCO.DFC_PSR1max_C DFES_DTCO.DFC_PSRBmax_C DFES_DTCO.DFC_PSRBmin_C DFES_DTCO.DFC_PSRPmax_C DFES_DTCO.DFC_PSRPmin_C DFES_DTCO.DFC_PSRPsig_C DFES_DTCO.DFC_PSRmax_C DFES_DTCO.DFC_PUmax_C DFES_DTCO.DFC_P_VSE11_OL_C DFES_DTCO.DFC_P_VSE11_SCB_C DFES_DTCO.DFC_P_VSE11_SCG_C DFES_DTCO.DFC_PhyHighAPP1_C DFES_DTCO.DFC_PhyHighAPP2_C DFES_DTCO.DFC_PhyLowAPP1_C DFES_DTCO.DFC_PhyLowAPP2_C DFES_DTCO.DFC_SRCHighAPP1_C DFES_DTCO.DFC_SRCHighAPP2_C DFES_DTCO.DFC_SRCLowAPP1_C DFES_DTCO.DFC_SRCLowAPP2_C DFES_DTCO.DFC_SSpMon2_C DFES_DTCO.DFC_SWReset_0_C DFES_DTCO.DFC_SWReset_1_C DFES_DTCO.DFC_SWReset_2_C DFES_DTCO.DFC_SyncAPP_C DFES_DTCO.DFC_TAmax_Dummy_C DFES_DTCO.DFC_TKAEmax_C DFES_DTCO.DFC_TKAEmin_C DFES_DTCO.DFC_TKARmax_C DFES_DTCO.DFC_TKARnpl_C DFES_DTCO.DFC_TMmax_Dummy_C DFES_DTCO.DFC_TUMmax_Dummy_C DFES_DTCO.DFC_TWCDPriCatB1_C DFES_DTCO.DFC_ThrVlvClsdPosnFirstOffsLrnImpoB1_C DFES_DTCO.DFC_ThrVlvClsdPosnOffsLrnImpoB1_C DFES_DTCO.DFC_ThrVlvClsdPosnOffsLrnMaxB1_C DFES_DTCO.DFC_ThrVlvClsdPosnOffsLrnMinB1_C DFES_DTCO.DFC_ThrVlvCtrlDeB1_C DFES_DTCO.DFC_ThrVlvDycB1_C DFES_DTCO.DFC_ThrVlvLimpAirPosnMaxAbsltDriftB1_C DFES_DTCO.DFC_ThrVlvLimpAirPosnMaxB1_C DFES_DTCO.DFC_ThrVlvLimpAirPosnMaxRelDriftB1_C DFES_DTCO.DFC_ThrVlvLimpAirPosnMinB1_C DFES_DTCO.DFC_ThrVlvOpenLoadB1_C DFES_DTCO.DFC_ThrVlvOpenSprgB1_C DFES_DTCO.DFC_ThrVlvOpenSprgSprdB1_C DFES_DTCO.DFC_ThrVlvOpenSprgTwnB1_C DFES_DTCO.DFC_ThrVlvOverTB1_C DFES_DTCO.DFC_ThrVlvRetSprgB1_C DFES_DTCO.DFC_ThrVlvRetSprgSprdB1_C DFES_DTCO.DFC_ThrVlvRetSprgTwnB1_C DFES_DTCO.DFC_ThrVlvSens1MaxB1_C DFES_DTCO.DFC_ThrVlvSens1NplB1_C DFES_DTCO.DFC_ThrVlvSens2MaxB1_C DFES_DTCO.DFC_ThrVlvSens2MinB1_C DFES_DTCO.DFC_ThrVlvSens2NplB1_C DFES_DTCO.DFC_ThrVlvShoCircB1_C DFES_DTCO.DFC_ThrVlvSpiErrB1_C DFES_DTCO.DFC_ThrvlvSens1MinB1_C DFES_DTCO.DFC_TiOffTBasdChkFast_C DFES_DTCO.DFC_TiOffTBasdChkSlow_C DFES_DTCO.DFC_UEGOHeatrCtlS1B1_C DFES_DTCO.DFC_UEGOSnsrMntdS1B1_C DFES_DTCO.DFC_VehVSig_C DFES_DTCO.DFC_VlvLftFbSwtIntk11SpclFail_C DFES_DTCO.DFC_VlvLftFbSwtIntk11StdFail_C DFES_Env.xSet1_CA DFES_Env.xSet2_CA DFES_EnvRef.DFC_Unused_C DFES_EnvRef.DFC_AltIOACGFailr_C DFES_EnvRef.DFC_AltIOACGHiVltg_C DFES_EnvRef.DFC_AltIOACGLoVltg_C DFES_EnvRef.DFC_AltIOACGTHi_C DFES_EnvRef.DFC_AltIODConnACG_C DFES_EnvRef.DFC_BattUHiFailr_C DFES_EnvRef.DFC_BattULoFailr_C DFES_EnvRef.DFC_BrkBstPDriftHiErr_C DFES_EnvRef.DFC_BrkBstPDriftLoErr_C DFES_EnvRef.DFC_BrkBstPSnsrStuck_C DFES_EnvRef.DFC_BrkMnSwtContOn_C DFES_EnvRef.DFC_BrkMnSwtNotStp_C DFES_EnvRef.DFC_BrkNpl_C DFES_EnvRef.DFC_BrkRdntSwtContOn_C DFES_EnvRef.DFC_BrkRdntSwtNotStp_C DFES_EnvRef.DFC_Clth3ONStuck_C DFES_EnvRef.DFC_Clth4OFFStuck_C DFES_EnvRef.DFC_ClthOFFStuck_C DFES_EnvRef.DFC_ClthONStuck_C DFES_EnvRef.DFC_ClthStkFailInfo_C DFES_EnvRef.DFC_ComACFailInfo_C DFES_EnvRef.DFC_ComATFTValErr_C DFES_EnvRef.DFC_ComATMILReq_C DFES_EnvRef.DFC_ComAYCAChksum_C DFES_EnvRef.DFC_ComAYCARingCnt_C DFES_EnvRef.DFC_ComAYCATOut_C DFES_EnvRef.DFC_ComAYCDChkSum_C DFES_EnvRef.DFC_ComAYCDTOut_C DFES_EnvRef.DFC_ComAYCFChksum_C DFES_EnvRef.DFC_ComAYCFRingCnt_C DFES_EnvRef.DFC_ComAYCFTOut_C DFES_EnvRef.DFC_ComAYCGChksum_C DFES_EnvRef.DFC_ComAYCGRingCnt_C DFES_EnvRef.DFC_ComAYCGTOut_C DFES_EnvRef.DFC_ComAYCIChkSum_C DFES_EnvRef.DFC_ComAYCIRingCnt_C DFES_EnvRef.DFC_ComAYCITOut_C DFES_EnvRef.DFC_ComBCM1ChkSum_C DFES_EnvRef.DFC_ComBCM1RingCnt_C DFES_EnvRef.DFC_ComBCM1TOut_C DFES_EnvRef.DFC_ComCANABusOffErr_C DFES_EnvRef.DFC_ComCANBBusOffErr_C DFES_EnvRef.DFC_ComCANCBusOffErr_C DFES_EnvRef.DFC_ComCGW1ChkSum_C DFES_EnvRef.DFC_ComCGW1RingCnt_C DFES_EnvRef.DFC_ComCGW1TOut_C DFES_EnvRef.DFC_ComConvBoostErr_C DFES_EnvRef.DFC_ComConvSlipErr_C DFES_EnvRef.DFC_ComEAT10Chksum_C DFES_EnvRef.DFC_ComEAT10RingCnt_C DFES_EnvRef.DFC_ComEAT10TOut_C DFES_EnvRef.DFC_ComEAT11ChkSum_C DFES_EnvRef.DFC_ComEAT11RingCnt_C DFES_EnvRef.DFC_ComEAT11TOut_C DFES_EnvRef.DFC_ComEAT12ChkSum_C DFES_EnvRef.DFC_ComEAT12RingCnt_C DFES_EnvRef.DFC_ComEAT12TOut_C DFES_EnvRef.DFC_ComEAT13ChkSum_C DFES_EnvRef.DFC_ComEAT13RingCnt_C DFES_EnvRef.DFC_ComEAT13TOut_C DFES_EnvRef.DFC_ComEAT1Chksum_C DFES_EnvRef.DFC_ComEAT1RingCnt_C DFES_EnvRef.DFC_ComEAT1TOut_C DFES_EnvRef.DFC_ComEAT2ChkSum_C DFES_EnvRef.DFC_ComEAT2RingCnt_C DFES_EnvRef.DFC_ComEAT2TOut_C DFES_EnvRef.DFC_ComEAT4ChkSum_C DFES_EnvRef.DFC_ComEAT4RingCnt_C DFES_EnvRef.DFC_ComEAT4TOut_C DFES_EnvRef.DFC_ComEAT6Chksum_C DFES_EnvRef.DFC_ComEAT6RingCnt_C DFES_EnvRef.DFC_ComEAT6TOut_C DFES_EnvRef.DFC_ComEAT7Chksum_C DFES_EnvRef.DFC_ComEAT7RingCnt_C DFES_EnvRef.DFC_ComEAT7TOut_C DFES_EnvRef.DFC_ComEAT8Chksum_C DFES_EnvRef.DFC_ComEAT8RingCnt_C /end DEF_CHARACTERISTIC
 FUNCTION_VERSION "30000.73.0_2.0.0" /end FUNCTION
/begin COMPU_METHOD DFES_EnvTabVerb "" TAB_VERB "%6.3" "-" COMPU_TAB_REF DFES_EnvTabVerb /end COMPU_METHOD
/begin COMPU_VTAB DFES_EnvTabVerb "" TAB_VERB 2 0 "xSet1" 1 "xSet2" DEFAULT_VALUE "---" /end COMPU_VTAB
/begin COMPU_METHOD DFES_OneToOne "" RAT_FUNC "%6.2" "-" COEFFS 0 1 0 0 0 1 /end COMPU_METHOD
/begin COMPU_METHOD Signals_IntSigNumVerb "" TAB_VERB "%6.3" "" COMPU_TAB_REF Signals_IntSigNumVerb /end COMPU_METHOD
/begin COMPU_VTAB Signals_IntSigNumVerb "" TAB_VERB 783 0 "SIGNALS_Signals_Default" 1 "SIGNALS_APP_rUnFlt" 2 "SIGNALS_APP_r_sig" 3 "SIGNALS_APP_r_signal" 4 "SIGNALS_APP_uRaw1_signal" 5 "SIGNALS_APP_uRaw2_signal" 6 "SIGNALS_AbsLdCom8Bit_PID43h" 7 "SIGNALS_AccPed_tqMapBasd_BENG_signal" 8 "SIGNALS_AccPed_tqMapBasd_TRQB_signal" 9 "SIGNALS_ActMod_trqInr_signal" 10 "SIGNALS_AirC_uAnaRawClnt_signal" 11 "SIGNALS_Alt_iExctLim_signal" 12 "SIGNALS_Alt_rAltExct_signal" 13 "SIGNALS_Alt_uFinalDes_signal" 14 "SIGNALS_BattU_u" 15 "SIGNALS_BattU_uSens1_signal" 16 "SIGNALS_BattU_uSens2_s" 17 "SIGNALS_BattU_uSens_signal" 18 "SIGNALS_Batt_lMaxCnsChk_signal" 19 "SIGNALS_Batt_lMinCnsChk_signal" 20 "SIGNALS_Batt_qCnsChkAH_signal" 21 "SIGNALS_Brk_st" 22 "SIGNALS_Brk_stRed" 23 "SIGNALS_CEngDsT_uRaw_s" 24 "SIGNALS_CoEng_tiCranking_signal" 25 "SIGNALS_CoEng_tiScneEngStrtPrmIdH1F_signal" 26 "SIGNALS_CoVeh_trqAcs_s" 27 "SIGNALS_ComEBS_BattID_signal" 28 "SIGNALS_ComEBS_rBattSensCh_signal" 29 "SIGNALS_ComEBS_uBattSens_signal" 30 "SIGNALS_ComEBS_uBattUCO_signal" 31 "SIGNALS_Com_iBattEBS_signal" 32 "SIGNALS_Com_lDst_signal" 33 "SIGNALS_Com_rMeasdBattREbs_signal" 34 "SIGNALS_Com_tBattEBS_signal" 35 "SIGNALS_Com_trqAYCFDes_signal" 36 "SIGNALS_Com_uPeak_signal" 37 "SIGNALS_CrCtl_stShutOffCode0_signal" 38 "SIGNALS_CrCtl_stShutOffCode1_signal" 39 "SIGNALS_CrCtl_stShutOffCode2_signal" 40 "SIGNALS_CrCtl_stShutOffCode3_signal" 41 "SIGNALS_CrCtl_stShutOffCode4_signal" 42 "SIGNALS_CrCtl_stShutOffCode5_signal" 43 "SIGNALS_CrCtl_stShutOffCode6_signal" 44 "SIGNALS_CrCtl_stShutOffCode7_signal" 45 "SIGNALS_CrCtl_stShutOffCode8_signal" 46 "SIGNALS_CrCtl_stShutOffCode9_signal" 47 "SIGNALS_DIUMPR_ctGenDenom_signal" 48 "SIGNALS_DIUMPR_ctIgn_signal" 49 "SIGNALS_DRIVE_numDTCFrz_s" 50 "SIGNALS_DRIVE_stCurTrgMode_signal" 51 "SIGNALS_DRIVE_stHardToStrt_s" 52 "SIGNALS_DSMDur_ctPID21h_signal" 53 "SIGNALS_DSMDur_ctPID31h_signal" 54 "SIGNALS_DcmDspUDS_rdbi_2612Byte10_signal" 55 "SIGNALS_DcmDspUDS_rdbi_2612Byte11_signal" 56 "SIGNALS_DcmDspUDS_rdbi_fixed_signal" 57 "SIGNALS_DcmDspUDS_rdbi_reserved0_signal_s" 58 "SIGNALS_DcmDspUDS_rdbi_reserved0_signal_w_s" 59 "SIGNALS_DcmDspUDS_rdbi_reserved1_signal" 60 "SIGNALS_Dspl_stCrsSwtInfo_signal" 61 "SIGNALS_Ebs_qBliChrg_signal" 62 "SIGNALS_Ebs_qBliDchaTotDcyc_0_signal" 63 "SIGNALS_Ebs_qBliDchaTotDcyc_1_signal" 64 "SIGNALS_Ebs_qBliDchaTotDcyc_2_signal" 65 "SIGNALS_Ebs_qBliDchaTotDcyc_3_signal" 66 "SIGNALS_Ebs_qBliDchaTotDcyc_4_signal" 67 "SIGNALS_Ebs_qBliDcha_signal" 68 "SIGNALS_Ebs_stStbIEBSByt0_0_signal" 69 "SIGNALS_Ebs_stStbIEBSByt0_1_signal" 70 "SIGNALS_Ebs_stStbIEBSByt0_2_signal" 71 "SIGNALS_Ebs_stStbIEBSByt0_3_signal" 72 "SIGNALS_Ebs_stStbIEBSByt0_4_signal" 73 "SIGNALS_Ebs_stStbIEBSByt1_0_signal" 74 "SIGNALS_Ebs_stStbIEBSByt1_1_signal" 75 "SIGNALS_Ebs_stStbIEBSByt1_2_signal" 76 "SIGNALS_Ebs_stStbIEBSByt1_3_signal" 77 "SIGNALS_Ebs_stStbIEBSByt1_4_signal" 78 "SIGNALS_Ebs_stStbIEBSByt2_0_signal" 79 "SIGNALS_Ebs_stStbIEBSByt2_1_signal" 80 "SIGNALS_Ebs_stStbIEBSByt2_2_signal" 81 "SIGNALS_Ebs_stStbIEBSByt2_3_signal" 82 "SIGNALS_Ebs_stStbIEBSByt2_4_signal" 83 "SIGNALS_Ebs_stStbIEBSByt3_0_signal" 84 "SIGNALS_Ebs_stStbIEBSByt3_1_signal" 85 "SIGNALS_Ebs_stStbIEBSByt3_2_signal" 86 "SIGNALS_Ebs_stStbIEBSByt3_3_signal" 87 "SIGNALS_Ebs_stStbIEBSByt3_4_signal" 88 "SIGNALS_Ebs_stStbIEBSByt4_0_signal" 89 "SIGNALS_Ebs_stStbIEBSByt4_1_signal" 90 "SIGNALS_Ebs_stStbIEBSByt4_2_signal" 91 "SIGNALS_Ebs_stStbIEBSByt4_3_signal" 92 "SIGNALS_Ebs_stStbIEBSByt4_4_signal" 93 "SIGNALS_EngTrqPtd_trqLead_s" 94 "SIGNALS_EngTrqPtd_trqLead_signal" 95 "SIGNALS_EngTrqPtd_trqSet_s" 96 "SIGNALS_EngTrqPtd_trqSet_signal" 97 "SIGNALS_EpmCaS_ctErrSig_signal" 98 "SIGNALS_EpmCaS_ctNoSig_signal" 99 "SIGNALS_EpmCaS_phiDiffCal2AdapEqAvg_0" 100 "SIGNALS_EpmCaS_phiOfsCorr" 101 "SIGNALS_EpmCrS_ctCaSRev_mp_signal" 102 "SIGNALS_EpmCrS_ctErrSig_signal" 103 "SIGNALS_Epm_nEngAct" 104 "SIGNALS_Epm_nEngRaw_s" 105 "SIGNALS_Epm_nEngRaw_signal" 106 "SIGNALS_Epm_stOpMode" 107 "SIGNALS_Epm_stSync" 108 "SIGNALS_ExhMod_tCat1B1_signal" 109 "SIGNALS_GlbDa_lenTotDstDcycHiResl_signal" 110 "SIGNALS_HEGO_uS2B1Extd_s" 111 "SIGNALS_HEGO_uS2B1HiRes_signal" 112 "SIGNALS_I14229CoEng_tiNormalOBDPrevDcyc_s" 113 "SIGNALS_I14229GlbDa_lTotDstDCHiReslPrevDcyc_s" 114 "SIGNALS_I14229IntkAirT_tSnsrTstrMax_s" 115 "SIGNALS_I14229IntkAirT_tSnsrTstrMin_s" 116 "SIGNALS_I14229RDBI_nOvrSpd_signal" 117 "SIGNALS_I14229RDBI_tiOvrSpd_signal" 118 "SIGNALS_I14229_ElecLd_iEPSLoadOnly_signal" 119 "SIGNALS_I14229_EpmCrS_ctErrSig_signal" 120 "SIGNALS_I14229_ivzabg_w_signal" 121 "SIGNALS_I14229_lDst_signal" 122 "SIGNALS_I14229_ml_w_msg_signal" 123 "SIGNALS_I14229_nstat_signal" 124 "SIGNALS_I14229_numDTCFrzFrmHi_signal" 125 "SIGNALS_I14229_numDTCFrzFrmLo_signal" 126 "SIGNALS_I14229_numDTCFrzFrmMid_signal" 127 "SIGNALS_I14229_ps_w_signal" 128 "SIGNALS_I14229_rTrqPT_signal" 129 "SIGNALS_I14229_tSnsrFild1_signal" 130 "SIGNALS_I14229_tiInj1On_signal" 131 "SIGNALS_I14229_tiOilFlowCompl_signal" 132 "SIGNALS_I14229_tiSia_signal" 133 "SIGNALS_I14229_tkaMax_s" 134 "SIGNALS_I14229_tkaMin_s" 135 "SIGNALS_I14229_tka_signal" 136 "SIGNALS_I14229_tmotMaxCurrDcyc_s" 137 "SIGNALS_I14229_tmotMaxPrevDcyc_s" 138 "SIGNALS_I14229_tmotMinCurrDcyc_s" 139 "SIGNALS_I14229_tmotMinPrevDcyc_s" 140 "SIGNALS_I14229_ubsq_signal" 141 "SIGNALS_I14229_umsrln_w_signal" 142 "SIGNALS_I14229_wdks_w_signal" 143 "SIGNALS_I14229_wped1_signal" 144 "SIGNALS_I14229_wped2_signal" 145 "SIGNALS_I14229_zwist_signal" 146 "SIGNALS_I14229iocpMDA_numACGC_signal" 147 "SIGNALS_I14229iocpMDA_numAPS_signal" 148 "SIGNALS_I14229iocpMDA_numPSC_signal" 149 "SIGNALS_I14229iocpMDA_numRFAN_signal" 150 "SIGNALS_I14229iocpMDA_numVTEC_signal" 151 "SIGNALS_I14229iocp_numCtlSt_s" 152 "SIGNALS_I14229iocp_numEXE_signal" 153 "SIGNALS_I14229iocp_numREQ_s" 154 "SIGNALS_I14229iocp_stSFTRJC_s" 155 "SIGNALS_I15031_PID1Dh" 156 "SIGNALS_I15031_PID65Ah" 157 "SIGNALS_I15031_PID66Ah" 158 "SIGNALS_I15031_PID68Ah" 159 "SIGNALS_I15031_PID69Ah" 160 "SIGNALS_I15031_PID6AAh" 161 "SIGNALS_I15031_PID6BAh" 162 "SIGNALS_I15031_PID6CAh" 163 "SIGNALS_I15031_PID6DAh" 164 "SIGNALS_I15031_PID6EAh" 165 "SIGNALS_I15031_PID6FAh" 166 "SIGNALS_I15031_PID70Ah" 167 "SIGNALS_I15031_PID71Ah" 168 "SIGNALS_I15031_PID72Ah" 169 "SIGNALS_I15031_PID73Ah" 170 "SIGNALS_I15031_PID74Ah" 171 "SIGNALS_I15031_PID75Ah" 172 "SIGNALS_I15031_PID76Ah" 173 "SIGNALS_I15031_PID77Ah" 174 "SIGNALS_I15031_PID78Ah" 175 "SIGNALS_I15031_PID79Ah" 176 "SIGNALS_I15031_PID7AAh" 177 "SIGNALS_I15031_PID7BAh" 178 "SIGNALS_I15031_PID7CAh" 179 "SIGNALS_I15031_PID7FAh" 180 "SIGNALS_I15031_PID81Ah" 181 "SIGNALS_I15031_PID82Ah" 182 "SIGNALS_I15031_PID85Ah" 183 "SIGNALS_I15031_PID86Ah" 184 "SIGNALS_I15031_PID87Ah" 185 "SIGNALS_I15031_PID89Ah" 186 "SIGNALS_I15031_PID8AAh" 187 "SIGNALS_I15031_PID8FAh" 188 "SIGNALS_I15031_PID92Ah" 189 "SIGNALS_I15031_PID93Ah" 190 "SIGNALS_I15031_PID94Ah" 191 "SIGNALS_I15031_PID98Ah" 192 "SIGNALS_I15031_PID99Ah" 193 "SIGNALS_I15031_PID9CAh" 194 "SIGNALS_I15031_PIDA3Ah" 195 "SIGNALS_I15031_PIDA4Ah" 196 "SIGNALS_I15031_PIDA5Ah" 197 "SIGNALS_I15031_PIDA9Ah" 198 "SIGNALS_I15031_PIDACAh" 199 "SIGNALS_IKCtl_agAdpnCurr_s16_signal" 200 "SIGNALS_IKCtl_agKnkAvrg_s8_signal" 201 "SIGNALS_InjSys_volFuConsDrvCycCAN_s" 202 "SIGNALS_IntkAirT_uSnsr1Exprt_signal" 203 "SIGNALS_IntkAirT_uSnsr3CrssSwtLoc_s" 204 "SIGNALS_MoF_rTrqInrAct_s" 205 "SIGNALS_MoF_rTrqPtdFlt_s" 206 "SIGNALS_OilLfT_degOilDetern_signal" 207 "SIGNALS_OilSwmpT_uSnsrRaw_s" 208 "SIGNALS_PID01h" 209 "SIGNALS_PID03h_0" 210 "SIGNALS_PID03h_1" 211 "SIGNALS_PID04h" 212 "SIGNALS_PID05h" 213 "SIGNALS_PID06h_0" 214 "SIGNALS_PID07h_0" 215 "SIGNALS_PID0Ch_Epm_nEng" 216 "SIGNALS_PID0D_VehV_vSens" 217 "SIGNALS_PID0Eh" 218 "SIGNALS_PID0Fh" 219 "SIGNALS_PID0Fh_s" 220 "SIGNALS_PID0bh" 221 "SIGNALS_PID0bh_PIntkVUs_pRawObd" 222 "SIGNALS_PID11h_ThrVlv_ratActSens1AbsltB1_u8" 223 "SIGNALS_PID13h" 224 "SIGNALS_PID15h_0" 225 "SIGNALS_PID15h_1" 226 "SIGNALS_PID1Ch" 227 "SIGNALS_PID1Fh_TiScneEngStrt" 228 "SIGNALS_PID21h" 229 "SIGNALS_PID2Eh" 230 "SIGNALS_PID30h" 231 "SIGNALS_PID31h" 232 "SIGNALS_PID33h_PEnv_pRaw" 233 "SIGNALS_PID34h_0" 234 "SIGNALS_PID34h_1" 235 "SIGNALS_PID3Ch" 236 "SIGNALS_PID42_BattU_uSens" 237 "SIGNALS_PID43h" 238 "SIGNALS_PID44h" 239 "SIGNALS_PID45h_ThrVlv_ratActSens1RelB1_u8" 240 "SIGNALS_PID46h" 241 "SIGNALS_PID47h_ThrVlv_ratActSens2AbsltB1_u8" 242 "SIGNALS_PID49_APP_uRaw1unLim" 243 "SIGNALS_PID4A_APP_uRaw2unLim" 244 "SIGNALS_PID4Ch_wdks_msg" 245 "SIGNALS_PID4FAh" 246 "SIGNALS_PID4FBh" 247 "SIGNALS_PID4FCh" 248 "SIGNALS_PID4FDh" 249 "SIGNALS_PID50Ah" 250 "SIGNALS_PID50Bh" 251 "SIGNALS_PID50Ch" 252 "SIGNALS_PID50Dh" 253 "SIGNALS_PID51h_PID51_stFuTyp" 254 "SIGNALS_PID56h_0" 255 "SIGNALS_PID5A_APP_rOBDPID5A" 256 "SIGNALS_PID5Fh" 257 "SIGNALS_PID62h_TME_ratActEngPercTqPrmIdH62" 258 "SIGNALS_IntFloat_PID63h_TqEngRef" 259 "SIGNALS_PID67h_ects2sva_msg" 260 "SIGNALS_PID67h_ects2svb_msg" 261 "SIGNALS_PID67h_ects2svc_msg" 262 "SIGNALS_PID68h_iats2svb" 263 "SIGNALS_PID68h_iats2svc" 264 "SIGNALS_PID68h_iats2svd" 265 "SIGNALS_PID68h_iats2sve" 266 "SIGNALS_PID68h_iats2svf" 267 "SIGNALS_PID68h_iats2svg" 268 "SIGNALS_PID7Fh_RTId_TotRt" 269 "SIGNALS_PID7Fh_RtId_TotIdleRt" 270 "SIGNALS_PID7Fh_RtId_TotPtoRt" 271 "SIGNALS_PID87h_PIntkVUs_pRawObd" 272 "SIGNALS_PID8BAh" 273 "SIGNALS_PID8CAh" 274 "SIGNALS_PID8Eh_TME_ratEngFricPercTqPrmIdH8E" 275 "SIGNALS_PID9AAh" 276 "SIGNALS_PID9Dh_InjSys_mfEngFuRate" 277 "SIGNALS_PID9Dh_InjSys_mfVehFuRate" 278 "SIGNALS_PID9FAh" 279 "SIGNALS_PIDA6h_lTotDst" 280 "SIGNALS_PID_FILLSIG_1BIT" 281 "SIGNALS_PID_FILLSIG_1BITNZ" 282 "SIGNALS_PID_FILLSIG_1BYTE" 283 "SIGNALS_PID_FILLSIG_1BYTENZ" 284 "SIGNALS_PID_FILLSIG_2BIT" 285 "SIGNALS_PID_FILLSIG_2BITNZ" 286 "SIGNALS_PID_FILLSIG_2BYTE" 287 "SIGNALS_PID_FILLSIG_2BYTENZ" 288 "SIGNALS_PID_FILLSIG_3BIT" 289 "SIGNALS_PID_FILLSIG_3BITNZ" 290 "SIGNALS_PID_FILLSIG_4BIT" 291 "SIGNALS_PID_FILLSIG_4BITNZ" 292 "SIGNALS_PID_FILLSIG_4BYTE" 293 "SIGNALS_PID_FILLSIG_4BYTENZ" 294 "SIGNALS_PID_FILLSIG_5BIT" 295 "SIGNALS_PID_FILLSIG_5BITNZ" 296 "SIGNALS_PID_FILLSIG_6BIT" 297 "SIGNALS_PID_FILLSIG_6BITNZ" 298 "SIGNALS_PID_FILLSIG_7BIT" 299 "SIGNALS_PID_FILLSIG_7BITNZ" 300 "SIGNALS_PIntkVUs_uRawUnFlt_signal" 301 "SIGNALS_PT_rGrip_signal" 302 "SIGNALS_PT_trqLos_signal" 303 "SIGNALS_PtCoornDyn_tqCluDes_signal" 304 "SIGNALS_PtCoornDyn_tqCluLeadTrsmIntv_signal" 305 "SIGNALS_PthLead_trqInrNoMon_s" 306 "SIGNALS_PthLead_trqInrNoMon_signal" 307 "SIGNALS_PthSet_trqInrIABef_s" 308 "SIGNALS_PthSet_trqInrLtd_s" 309 "SIGNALS_RngMod_trqDiffAdap_signal" 310 "SIGNALS_RngMod_trqInrBs_s" 311 "SIGNALS_TWCD_numMeasB1_s" 312 "SIGNALS_TWCD_rOSCAvrgPriB1_s" 313 "SIGNALS_ThrVlv_uRawSens1B1_signal" 314 "SIGNALS_ThrVlv_uRawSens2B1_signal" 315 "SIGNALS_TiEngOff_ti_signal" 316 "SIGNALS_UEGO_ratLamSrv1S1B1_signal" 317 "SIGNALS_VehStc_numFuDiagRecA_0_s" 318 "SIGNALS_VehStc_numFuDiagRecA_10_s" 319 "SIGNALS_VehStc_numFuDiagRecA_11_s" 320 "SIGNALS_VehStc_numFuDiagRecA_12_s" 321 "SIGNALS_VehStc_numFuDiagRecA_13_s" 322 "SIGNALS_VehStc_numFuDiagRecA_14_s" 323 "SIGNALS_VehStc_numFuDiagRecA_15_s" 324 "SIGNALS_VehStc_numFuDiagRecA_16_s" 325 "SIGNALS_VehStc_numFuDiagRecA_17_s" 326 "SIGNALS_VehStc_numFuDiagRecA_18_s" 327 "SIGNALS_VehStc_numFuDiagRecA_19_s" 328 "SIGNALS_VehStc_numFuDiagRecA_1_s" 329 "SIGNALS_VehStc_numFuDiagRecA_20_s" 330 "SIGNALS_VehStc_numFuDiagRecA_2_s" 331 "SIGNALS_VehStc_numFuDiagRecA_3_s" 332 "SIGNALS_VehStc_numFuDiagRecA_4_s" 333 "SIGNALS_VehStc_numFuDiagRecA_5_s" 334 "SIGNALS_VehStc_numFuDiagRecA_6_s" 335 "SIGNALS_VehStc_numFuDiagRecA_7_s" 336 "SIGNALS_VehStc_numFuDiagRecA_8_s" 337 "SIGNALS_VehStc_numFuDiagRecA_9_s" 338 "SIGNALS_VehStc_numMisfDetnHiEctA_0_s" 339 "SIGNALS_VehStc_numMisfDetnHiEctA_10_s" 340 "SIGNALS_VehStc_numMisfDetnHiEctA_11_s" 341 "SIGNALS_VehStc_numMisfDetnHiEctA_12_s" 342 "SIGNALS_VehStc_numMisfDetnHiEctA_13_s" 343 "SIGNALS_VehStc_numMisfDetnHiEctA_14_s" 344 "SIGNALS_VehStc_numMisfDetnHiEctA_15_s" 345 "SIGNALS_VehStc_numMisfDetnHiEctA_16_s" 346 "SIGNALS_VehStc_numMisfDetnHiEctA_17_s" 347 "SIGNALS_VehStc_numMisfDetnHiEctA_18_s" 348 "SIGNALS_VehStc_numMisfDetnHiEctA_19_s" 349 "SIGNALS_VehStc_numMisfDetnHiEctA_1_s" 350 "SIGNALS_VehStc_numMisfDetnHiEctA_20_s" 351 "SIGNALS_VehStc_numMisfDetnHiEctA_2_s" 352 "SIGNALS_VehStc_numMisfDetnHiEctA_3_s" 353 "SIGNALS_VehStc_numMisfDetnHiEctA_4_s" 354 "SIGNALS_VehStc_numMisfDetnHiEctA_5_s" 355 "SIGNALS_VehStc_numMisfDetnHiEctA_6_s" 356 "SIGNALS_VehStc_numMisfDetnHiEctA_7_s" 357 "SIGNALS_VehStc_numMisfDetnHiEctA_8_s" 358 "SIGNALS_VehStc_numMisfDetnHiEctA_9_s" 359 "SIGNALS_VehStc_numMisfDetnLoEctA_0_s" 360 "SIGNALS_VehStc_numMisfDetnLoEctA_10_s" 361 "SIGNALS_VehStc_numMisfDetnLoEctA_11_s" 362 "SIGNALS_VehStc_numMisfDetnLoEctA_12_s" 363 "SIGNALS_VehStc_numMisfDetnLoEctA_13_s" 364 "SIGNALS_VehStc_numMisfDetnLoEctA_14_s" 365 "SIGNALS_VehStc_numMisfDetnLoEctA_15_s" 366 "SIGNALS_VehStc_numMisfDetnLoEctA_16_s" 367 "SIGNALS_VehStc_numMisfDetnLoEctA_17_s" 368 "SIGNALS_VehStc_numMisfDetnLoEctA_18_s" 369 "SIGNALS_VehStc_numMisfDetnLoEctA_19_s" 370 "SIGNALS_VehStc_numMisfDetnLoEctA_1_s" 371 "SIGNALS_VehStc_numMisfDetnLoEctA_20_s" 372 "SIGNALS_VehStc_numMisfDetnLoEctA_2_s" 373 "SIGNALS_VehStc_numMisfDetnLoEctA_3_s" 374 "SIGNALS_VehStc_numMisfDetnLoEctA_4_s" 375 "SIGNALS_VehStc_numMisfDetnLoEctA_5_s" 376 "SIGNALS_VehStc_numMisfDetnLoEctA_6_s" 377 "SIGNALS_VehStc_numMisfDetnLoEctA_7_s" 378 "SIGNALS_VehStc_numMisfDetnLoEctA_8_s" 379 "SIGNALS_VehStc_numMisfDetnLoEctA_9_s" 380 "SIGNALS_VehStc_numMisfDetnNormA_0_s" 381 "SIGNALS_VehStc_numMisfDetnNormA_10_s" 382 "SIGNALS_VehStc_numMisfDetnNormA_11_s" 383 "SIGNALS_VehStc_numMisfDetnNormA_12_s" 384 "SIGNALS_VehStc_numMisfDetnNormA_13_s" 385 "SIGNALS_VehStc_numMisfDetnNormA_14_s" 386 "SIGNALS_VehStc_numMisfDetnNormA_15_s" 387 "SIGNALS_VehStc_numMisfDetnNormA_16_s" 388 "SIGNALS_VehStc_numMisfDetnNormA_17_s" 389 "SIGNALS_VehStc_numMisfDetnNormA_18_s" 390 "SIGNALS_VehStc_numMisfDetnNormA_19_s" 391 "SIGNALS_VehStc_numMisfDetnNormA_1_s" 392 "SIGNALS_VehStc_numMisfDetnNormA_20_s" 393 "SIGNALS_VehStc_numMisfDetnNormA_2_s" 394 "SIGNALS_VehStc_numMisfDetnNormA_3_s" 395 "SIGNALS_VehStc_numMisfDetnNormA_4_s" 396 "SIGNALS_VehStc_numMisfDetnNormA_5_s" 397 "SIGNALS_VehStc_numMisfDetnNormA_6_s" 398 "SIGNALS_VehStc_numMisfDetnNormA_7_s" 399 "SIGNALS_VehStc_numMisfDetnNormA_8_s" 400 "SIGNALS_VehStc_numMisfDetnNormA_9_s" 401 "SIGNALS_VehStc_rDiagRsltB1A_0_s" 402 "SIGNALS_VehStc_rDiagRsltB1A_1_s" 403 "SIGNALS_VehStc_rDiagRsltB1A_2_s" 404 "SIGNALS_VehStc_rDiagRsltB1A_3_s" 405 "SIGNALS_VehStc_rDiagRsltB1A_4_s" 406 "SIGNALS_VehV_a" 407 "SIGNALS_VehV_v" 408 "SIGNALS_VehV_vSens_signal" 409 "SIGNALS_flglrs_msg_s" 410 "SIGNALS_fra_w_msg_signal" 411 "SIGNALS_fra_w_s" 412 "SIGNALS_ftead_w_msg_s" 413 "SIGNALS_ftead_w_si" 414 "SIGNALS_ftead_w_signal" 415 "SIGNALS_lamsobd_w_msg_s" 416 "SIGNALS_lutskzyl_w_0_signal" 417 "SIGNALS_lutskzyl_w_1_signal" 418 "SIGNALS_lutskzyl_w_2_signal" 419 "SIGNALS_lutskzyl_w_3_signal" 420 "SIGNALS_lutskzyl_w_msg_0_signal" 421 "SIGNALS_lutskzyl_w_msg_1_signal" 422 "SIGNALS_lutskzyl_w_msg_2_signal" 423 "SIGNALS_lutskzyl_w_msg_3_signal" 424 "SIGNALS_ofmsndkh1_w_msg_signal" 425 "SIGNALS_ofmsndkh2_w_msg_signal" 426 "SIGNALS_ora_w_msg_signal" 427 "SIGNALS_tateout_w_msg_signal" 428 "SIGNALS_tateout_w_signal" 429 "SIGNALS_tatesoll_w_msg_signal" 430 "SIGNALS_tmst_signal" 431 "SIGNALS_wkratst_signal" 432 "SIGNALS_PID83h_A_BitCombineSignal" 433 "SIGNALS_PID9Bh_A_BitCombineSignal" 434 "SIGNALS_PIDA1h_A_BitCombineSignal" 435 "SIGNALS_PIDA7h_A_BitCombineSignal" 436 "SIGNALS_PIDA8h_A_BitCombineSignal" 437 "SIGNALS_Virtual_CEngDsT_uRaw_signal" 438 "SIGNALS_Virtual_DcmDspUDS_2600Byte06_signal" 439 "SIGNALS_Virtual_DcmDspUDS_2610Byte00_signal" 440 "SIGNALS_Virtual_DcmDspUDS_2610Byte01_signal" 441 "SIGNALS_Virtual_DcmDspUDS_2610Byte02_signal" 442 "SIGNALS_Virtual_DcmDspUDS_2610Byte03_signal" 443 "SIGNALS_Virtual_DcmDspUDS_2610Byte04_signal" 444 "SIGNALS_Virtual_DcmDspUDS_2610Byte05_signal" 445 "SIGNALS_Virtual_DcmDspUDS_2610Byte10_signal" 446 "SIGNALS_Virtual_DcmDspUDS_2610Byte1F_signal" 447 "SIGNALS_Virtual_DcmDspUDS_2610Byte20_signal" 448 "SIGNALS_Virtual_DcmDspUDS_2610Byte25_signal" 449 "SIGNALS_Virtual_DcmDspUDS_2610Byte26_signal" 450 "SIGNALS_Virtual_DcmDspUDS_2611Byte00_signal" 451 "SIGNALS_Virtual_DcmDspUDS_2611Byte01_signal" 452 "SIGNALS_Virtual_DcmDspUDS_2611Byte02_signal" 453 "SIGNALS_Virtual_DcmDspUDS_2611Byte03_signal" 454 "SIGNALS_Virtual_DcmDspUDS_2611Byte04_signal" 455 "SIGNALS_Virtual_DcmDspUDS_2611Byte05_signal" 456 "SIGNALS_Virtual_DcmDspUDS_2611Byte06_07_signal" 457 "SIGNALS_Virtual_DcmDspUDS_2611Byte2A_signal" 458 "SIGNALS_Virtual_DcmDspUDS_2611Byte2B_signal" 459 "SIGNALS_Virtual_DcmDspUDS_2612Byte00_signal" 460 "SIGNALS_Virtual_DcmDspUDS_2612Byte01_signal" 461 "SIGNALS_Virtual_DcmDspUDS_2612Byte02_signal" 462 "SIGNALS_Virtual_DcmDspUDS_2612Byte03_signal" 463 "SIGNALS_Virtual_DcmDspUDS_2612Byte04_signal" 464 "SIGNALS_Virtual_DcmDspUDS_2612Byte05_signal" 465 "SIGNALS_Virtual_DcmDspUDS_2612Byte14_signal" 466 "SIGNALS_Virtual_DcmDspUDS_2612Byte15_signal" 467 "SIGNALS_Virtual_DcmDspUDS_2612Byte16_signal" 468 "SIGNALS_Virtual_DcmDspUDS_2612Byte17_signal" 469 "SIGNALS_Virtual_DcmDspUDS_2612Byte29_signal" 470 "SIGNALS_Virtual_DcmDspUDS_2612Byte2A_signal" 471 "SIGNALS_Virtual_DcmDspUDS_2612Byte2B_signal" 472 "SIGNALS_Virtual_DcmDspUDS_2613Byte00_signal" 473 "SIGNALS_Virtual_DcmDspUDS_2613Byte01_signal" 474 "SIGNALS_Virtual_DcmDspUDS_2613Byte02_signal" 475 "SIGNALS_Virtual_DcmDspUDS_2613Byte03_signal" 476 "SIGNALS_Virtual_DcmDspUDS_2613Byte04_signal" 477 "SIGNALS_Virtual_DcmDspUDS_2613Byte05_signal" 478 "SIGNALS_Virtual_DcmDspUDS_2620Byte00_signal" 479 "SIGNALS_Virtual_DcmDspUDS_2620Byte01_signal" 480 "SIGNALS_Virtual_DcmDspUDS_2620Byte02_signal" 481 "SIGNALS_Virtual_DcmDspUDS_2620Byte03_signal" 482 "SIGNALS_Virtual_DcmDspUDS_2620Byte04_signal" 483 "SIGNALS_Virtual_DcmDspUDS_2620Byte05_signal" 484 "SIGNALS_Virtual_DcmDspUDS_2621Byte00_signal" 485 "SIGNALS_Virtual_DcmDspUDS_2621Byte01_signal" 486 "SIGNALS_Virtual_DcmDspUDS_2621Byte02_signal" 487 "SIGNALS_Virtual_DcmDspUDS_2621Byte03_signal" 488 "SIGNALS_Virtual_DcmDspUDS_2621Byte04_signal" 489 "SIGNALS_Virtual_DcmDspUDS_2621Byte05_signal" 490 "SIGNALS_Virtual_DcmDspUDS_2622Byte00_signal" 491 "SIGNALS_Virtual_DcmDspUDS_2622Byte01_signal" 492 "SIGNALS_Virtual_DcmDspUDS_2622Byte02_signal" 493 "SIGNALS_Virtual_DcmDspUDS_2622Byte03_signal" 494 "SIGNALS_Virtual_DcmDspUDS_2622Byte04_signal" 495 "SIGNALS_Virtual_DcmDspUDS_2622Byte05_signal" 496 "SIGNALS_Virtual_DcmDspUDS_2623Byte00_signal" 497 "SIGNALS_Virtual_DcmDspUDS_2623Byte01_signal" 498 "SIGNALS_Virtual_DcmDspUDS_2623Byte02_signal" 499 "SIGNALS_Virtual_DcmDspUDS_2623Byte03_signal" 500 "SIGNALS_Virtual_DcmDspUDS_2623Byte04_signal" 501 "SIGNALS_Virtual_DcmDspUDS_2623Byte05_signal" 502 "SIGNALS_Virtual_DcmDspUDS_2660Byte0_signal" 503 "SIGNALS_Virtual_DcmDspUDS_2660Byte15_signal" 504 "SIGNALS_Virtual_DcmDspUDS_2660Byte16_signal" 505 "SIGNALS_Virtual_DcmDspUDS_2660Byte17_signal" 506 "SIGNALS_Virtual_DcmDspUDS_2660Byte18_signal" 507 "SIGNALS_Virtual_DcmDspUDS_2660Byte19_signal" 508 "SIGNALS_Virtual_DcmDspUDS_2660Byte1A_signal" 509 "SIGNALS_Virtual_DcmDspUDS_2660Byte1B_signal" 510 "SIGNALS_Virtual_DcmDspUDS_2660Byte1C_signal" 511 "SIGNALS_Virtual_DcmDspUDS_2660Byte1D_signal" 512 "SIGNALS_Virtual_DcmDspUDS_2660Byte1E_signal" 513 "SIGNALS_Virtual_DcmDspUDS_2660Byte1_signal" 514 "SIGNALS_Virtual_DcmDspUDS_2660Byte2_signal" 515 "SIGNALS_Virtual_DcmDspUDS_2660Byte3_signal" 516 "SIGNALS_Virtual_DcmDspUDS_2660Byte4_signal" 517 "SIGNALS_Virtual_DcmDspUDS_2660Byte5_signal" 518 "SIGNALS_Virtual_DcmDspUDS_2660Byte6_signal" 519 "SIGNALS_Virtual_DcmDspUDS_2661Byte0A_signal" 520 "SIGNALS_Virtual_DcmDspUDS_2661Byte0B_signal" 521 "SIGNALS_Virtual_DcmDspUDS_2661Byte0C_signal" 522 "SIGNALS_Virtual_DcmDspUDS_2661Byte0D_signal" 523 "SIGNALS_Virtual_DcmDspUDS_2661Byte0E_signal" 524 "SIGNALS_Virtual_DcmDspUDS_2661Byte0F_signal" 525 "SIGNALS_Virtual_DcmDspUDS_2661Byte0_signal" 526 "SIGNALS_Virtual_DcmDspUDS_2661Byte1_signal" 527 "SIGNALS_Virtual_DcmDspUDS_2661Byte27_signal" 528 "SIGNALS_Virtual_DcmDspUDS_2661Byte2A_signal" 529 "SIGNALS_Virtual_DcmDspUDS_2661Byte2D_signal" 530 "SIGNALS_Virtual_DcmDspUDS_2661Byte2E_signal" 531 "SIGNALS_Virtual_DcmDspUDS_2661Byte2F_signal" 532 "SIGNALS_Virtual_DcmDspUDS_2661Byte2_signal" 533 "SIGNALS_Virtual_DcmDspUDS_2661Byte30_signal" 534 "SIGNALS_Virtual_DcmDspUDS_2661Byte31_signal" 535 "SIGNALS_Virtual_DcmDspUDS_2661Byte32_signal" 536 "SIGNALS_Virtual_DcmDspUDS_2661Byte35_signal" 537 "SIGNALS_Virtual_DcmDspUDS_2661Byte3_signal" 538 "SIGNALS_Virtual_DcmDspUDS_2661Byte4_signal" 539 "SIGNALS_Virtual_DcmDspUDS_2661Byte5_signal" 540 "SIGNALS_Virtual_DcmDspUDS_2661Byte6_signal" 541 "SIGNALS_Virtual_DcmDspUDS_2661Byte7_signal" 542 "SIGNALS_Virtual_DcmDspUDS_2661Byte8_signal" 543 "SIGNALS_Virtual_DcmDspUDS_2661Byte9_signal" 544 "SIGNALS_Virtual_DcmDspUDS_2662Byte0_signal" 545 "SIGNALS_Virtual_DcmDspUDS_2662Byte18_signal" 546 "SIGNALS_Virtual_DcmDspUDS_2662Byte19_signal" 547 "SIGNALS_Virtual_DcmDspUDS_2662Byte1_signal" 548 "SIGNALS_Virtual_DcmDspUDS_2662Byte2_signal" 549 "SIGNALS_Virtual_DcmDspUDS_2662Byte3_signal" 550 "SIGNALS_Virtual_DcmDspUDS_2662Byte4_signal" 551 "SIGNALS_Virtual_DcmDspUDS_2662Byte5_signal" 552 "SIGNALS_Virtual_DcmDspUDS_2663Byte0_signal" 553 "SIGNALS_Virtual_DcmDspUDS_2663Byte1_signal" 554 "SIGNALS_Virtual_DcmDspUDS_2663Byte2_signal" 555 "SIGNALS_Virtual_DcmDspUDS_2663Byte3_signal" 556 "SIGNALS_Virtual_DcmDspUDS_2663Byte4_signal" 557 "SIGNALS_Virtual_DcmDspUDS_2663Byte5_signal" 558 "SIGNALS_Virtual_DcmDspUDS_2664Byte0_signal" 559 "SIGNALS_Virtual_DcmDspUDS_2664Byte1_signal" 560 "SIGNALS_Virtual_DcmDspUDS_2664Byte25_signal" 561 "SIGNALS_Virtual_DcmDspUDS_2664Byte26_signal" 562 "SIGNALS_Virtual_DcmDspUDS_2664Byte2_signal" 563 "SIGNALS_Virtual_DcmDspUDS_2664Byte3_signal" 564 "SIGNALS_Virtual_DcmDspUDS_2664Byte4_signal" 565 "SIGNALS_Virtual_DcmDspUDS_2664Byte5_signal" 566 "SIGNALS_Virtual_DcmDspUDS_2664Byte6_signal" 567 "SIGNALS_Virtual_DcmDspUDS_2664Byte7_signal" 568 "SIGNALS_Virtual_DcmDspUDS_2665Byte0_signal" 569 "SIGNALS_Virtual_DcmDspUDS_2665Byte1_signal" 570 "SIGNALS_Virtual_DcmDspUDS_2665Byte2_signal" 571 "SIGNALS_Virtual_DcmDspUDS_2665Byte3_signal" 572 "SIGNALS_Virtual_DcmDspUDS_2665Byte4_signal" 573 "SIGNALS_Virtual_DcmDspUDS_2665Byte5_signal" 574 "SIGNALS_Virtual_DcmDspUDS_2668Byte0_signal" 575 "SIGNALS_Virtual_DcmDspUDS_2668Byte1B_signal" 576 "SIGNALS_Virtual_DcmDspUDS_2668Byte1_signal" 577 "SIGNALS_Virtual_DcmDspUDS_2668Byte2_signal" 578 "SIGNALS_Virtual_DcmDspUDS_2668Byte3_signal" 579 "SIGNALS_Virtual_DcmDspUDS_2668Byte4_signal" 580 "SIGNALS_Virtual_DcmDspUDS_2668Byte5_signal" 581 "SIGNALS_Virtual_DcmDspUDS_266CByte0_signal" 582 "SIGNALS_Virtual_DcmDspUDS_266CByte1_signal" 583 "SIGNALS_Virtual_DcmDspUDS_266CByte26_signal" 584 "SIGNALS_Virtual_DcmDspUDS_266CByte27_signal" 585 "SIGNALS_Virtual_DcmDspUDS_266CByte2_signal" 586 "SIGNALS_Virtual_DcmDspUDS_266CByte3_signal" 587 "SIGNALS_Virtual_DcmDspUDS_266CByte4_signal" 588 "SIGNALS_Virtual_DcmDspUDS_266CByte5_signal" 589 "SIGNALS_Virtual_DcmDspUDS_266DByte0_signal" 590 "SIGNALS_Virtual_DcmDspUDS_266DByte1_signal" 591 "SIGNALS_Virtual_DcmDspUDS_266DByte2_signal" 592 "SIGNALS_Virtual_DcmDspUDS_266DByte3_signal" 593 "SIGNALS_Virtual_DcmDspUDS_266DByte4_signal" 594 "SIGNALS_Virtual_DcmDspUDS_266DByte5_signal" 595 "SIGNALS_Virtual_DcmDspUDS_266FByte0_signal" 596 "SIGNALS_Virtual_DcmDspUDS_266FByte1_signal" 597 "SIGNALS_Virtual_DcmDspUDS_266FByte2_signal" 598 "SIGNALS_Virtual_DcmDspUDS_266FByte3_signal" 599 "SIGNALS_Virtual_DcmDspUDS_2673Byte0A_signal" 600 "SIGNALS_Virtual_DcmDspUDS_2673Byte0B_signal" 601 "SIGNALS_Virtual_DcmDspUDS_2673Byte0_signal" 602 "SIGNALS_Virtual_DcmDspUDS_2673Byte12_signal" 603 "SIGNALS_Virtual_DcmDspUDS_2673Byte13_signal" 604 "SIGNALS_Virtual_DcmDspUDS_2673Byte16_signal" 605 "SIGNALS_Virtual_DcmDspUDS_2673Byte17_signal" 606 "SIGNALS_Virtual_DcmDspUDS_2673Byte1E_signal" 607 "SIGNALS_Virtual_DcmDspUDS_2673Byte1F_signal" 608 "SIGNALS_Virtual_DcmDspUDS_2673Byte1_signal" 609 "SIGNALS_Virtual_DcmDspUDS_2673Byte2_signal" 610 "SIGNALS_Virtual_DcmDspUDS_2673Byte3_signal" 611 "SIGNALS_Virtual_DcmDspUDS_2673Byte4_signal" 612 "SIGNALS_Virtual_DcmDspUDS_2673Byte5_signal" 613 "SIGNALS_Virtual_DcmDspUDS_2673Byte6_signal" 614 "SIGNALS_Virtual_DcmDspUDS_2673Byte7_signal" 615 "SIGNALS_Virtual_DcmDspUDS_2676Byte0_signal" 616 "SIGNALS_Virtual_DcmDspUDS_2676Byte1_signal" 617 "SIGNALS_Virtual_DcmDspUDS_2676Byte2E_signal" 618 "SIGNALS_Virtual_DcmDspUDS_2676Byte2F_signal" 619 "SIGNALS_Virtual_DcmDspUDS_2676Byte2_signal" 620 "SIGNALS_Virtual_DcmDspUDS_2676Byte3_signal" 621 "SIGNALS_Virtual_DcmDspUDS_2676Byte4_signal" 622 "SIGNALS_Virtual_DcmDspUDS_2676Byte5_signal" 623 "SIGNALS_Virtual_DcmDspUDS_2676Byte6_signal" 624 "SIGNALS_Virtual_DcmDspUDS_2676Byte7_signal" 625 "SIGNALS_Virtual_DcmDspUDS_2676Byte8_signal" 626 "SIGNALS_Virtual_DcmDspUDS_2676Byte9_signal" 627 "SIGNALS_Virtual_DcmDspUDS_267BByte0_signal" 628 "SIGNALS_Virtual_DcmDspUDS_267BByte1_signal" 629 "SIGNALS_Virtual_DcmDspUDS_267BByte2_signal" 630 "SIGNALS_Virtual_DcmDspUDS_267BByte3_signal" 631 "SIGNALS_Virtual_DcmDspUDS_267BByte4_signal" 632 "SIGNALS_Virtual_DcmDspUDS_267BByte5_signal" 633 "SIGNALS_Virtual_DcmDspUDS_267EByte0_signal" 634 "SIGNALS_Virtual_DcmDspUDS_267EByte1_signal" 635 "SIGNALS_Virtual_DcmDspUDS_267EByte22_signal" 636 "SIGNALS_Virtual_DcmDspUDS_2680Byte00_signal" 637 "SIGNALS_Virtual_DcmDspUDS_2680Byte01_signal" 638 "SIGNALS_Virtual_DcmDspUDS_2680Byte02_signal" 639 "SIGNALS_Virtual_DcmDspUDS_2680Byte03_signal" 640 "SIGNALS_Virtual_DcmDspUDS_2680Byte04_signal" 641 "SIGNALS_Virtual_DcmDspUDS_2680Byte05_signal" 642 "SIGNALS_Virtual_DcmDspUDS_2680Byte08_signal" 643 "SIGNALS_Virtual_DcmDspUDS_2680Byte09_signal" 644 "SIGNALS_Virtual_DcmDspUDS_2680Byte0E_signal" 645 "SIGNALS_Virtual_DcmDspUDS_2680Byte0F_signal" 646 "SIGNALS_Virtual_DcmDspUDS_2681Byte00_signal" 647 "SIGNALS_Virtual_DcmDspUDS_2681Byte01_signal" 648 "SIGNALS_Virtual_DcmDspUDS_2681Byte02_signal" 649 "SIGNALS_Virtual_DcmDspUDS_2681Byte03_signal" 650 "SIGNALS_Virtual_DcmDspUDS_2681Byte04_signal" 651 "SIGNALS_Virtual_DcmDspUDS_2681Byte05_signal" 652 "SIGNALS_Virtual_DcmDspUDS_2681Byte0F_signal" 653 "SIGNALS_Virtual_DcmDspUDS_2681Byte10_signal" 654 "SIGNALS_Virtual_DcmDspUDS_2681Byte13_signal" 655 "SIGNALS_Virtual_DcmDspUDS_2681Byte14_signal" 656 "SIGNALS_Virtual_DcmDspUDS_2681Byte1D_signal" 657 "SIGNALS_Virtual_DcmDspUDS_2681Byte1E_signal" 658 "SIGNALS_Virtual_DcmDspUDS_2682Byte00_signal" 659 "SIGNALS_Virtual_DcmDspUDS_2682Byte01_signal" 660 "SIGNALS_Virtual_DcmDspUDS_2682Byte02_signal" 661 "SIGNALS_Virtual_DcmDspUDS_2682Byte03_signal" 662 "SIGNALS_Virtual_DcmDspUDS_2682Byte04_signal" 663 "SIGNALS_Virtual_DcmDspUDS_2682Byte05_signal" 664 "SIGNALS_Virtual_DcmDspUDS_2682Byte06_07_signal" 665 "SIGNALS_Virtual_DcmDspUDS_2682Byte08_09_signal" 666 "SIGNALS_Virtual_DcmDspUDS_2682Byte0E_signal" 667 "SIGNALS_Virtual_DcmDspUDS_2682Byte11_12_signal" 668 "SIGNALS_Virtual_DcmDspUDS_2682Byte13_14_signal" 669 "SIGNALS_Virtual_DcmDspUDS_2682Byte15_16_signal" 670 "SIGNALS_Virtual_DcmDspUDS_2682Byte18_19_signal" 671 "SIGNALS_Virtual_DcmDspUDS_2682Byte1B_signal" 672 "SIGNALS_Virtual_DcmDspUDS_2682Byte1C_signal" 673 "SIGNALS_Virtual_DcmDspUDS_268FByte00_signal" 674 "SIGNALS_Virtual_DcmDspUDS_268FByte01_signal" 675 "SIGNALS_Virtual_DcmDspUDS_268FByte02_signal" 676 "SIGNALS_Virtual_DcmDspUDS_268FByte03_signal" 677 "SIGNALS_Virtual_DcmDspUDS_268FByte04_signal" 678 "SIGNALS_Virtual_DcmDspUDS_268FByte05_signal" 679 "SIGNALS_Virtual_DcmDspUDS_268FByte0A_signal" 680 "SIGNALS_Virtual_DcmDspUDS_268FByte0B_signal" 681 "SIGNALS_Virtual_DcmDspUDS_268FByte0C_signal" 682 "SIGNALS_Virtual_DcmDspUDS_269AByte00_signal" 683 "SIGNALS_Virtual_DcmDspUDS_269AByte01_signal" 684 "SIGNALS_Virtual_DcmDspUDS_269AByte02_signal" 685 "SIGNALS_Virtual_DcmDspUDS_269AByte03_signal" 686 "SIGNALS_Virtual_DcmDspUDS_269AByte04_signal" 687 "SIGNALS_Virtual_DcmDspUDS_269AByte05_signal" 688 "SIGNALS_Virtual_DcmDspUDS_26A2Byte00_signal" 689 "SIGNALS_Virtual_DcmDspUDS_26A2Byte01_signal" 690 "SIGNALS_Virtual_DcmDspUDS_26A2Byte02_signal" 691 "SIGNALS_Virtual_DcmDspUDS_26A2Byte03_signal" 692 "SIGNALS_Virtual_DcmDspUDS_26A2Byte04_signal" 693 "SIGNALS_Virtual_DcmDspUDS_26A2Byte05_signal" 694 "SIGNALS_Virtual_DcmDspUDS_26A2Byte12_13_signal" 695 "SIGNALS_Virtual_DcmDspUDS_Acm_fzabgs_w_signal" 696 "SIGNALS_Virtual_DcmDspUDS_Acm_fzabgzyl_w_0_signal" 697 "SIGNALS_Virtual_DcmDspUDS_Acm_fzabgzyl_w_1_signal" 698 "SIGNALS_Virtual_DcmDspUDS_Acm_fzabgzyl_w_2_signal" 699 "SIGNALS_Virtual_DcmDspUDS_Acm_fzabgzyl_w_3_signal" 700 "SIGNALS_Virtual_DcmDspUDS_DID_E402Byte00_signal" 701 "SIGNALS_Virtual_DcmDspUDS_DID_E402Byte01_signal" 702 "SIGNALS_Virtual_DcmDspUDS_DID_E402Byte07to08_signal" 703 "SIGNALS_Virtual_DcmDspUDS_DID_E402Byte10to11_signal" 704 "SIGNALS_Virtual_DcmDspUDS_DID_E402Byte19to1A_signal" 705 "SIGNALS_Virtual_DcmDspUDS_DID_E402Byte22to23_signal" 706 "SIGNALS_Virtual_DcmDspUDS_DID_E402Byte2Bto2C_signal" 707 "SIGNALS_Virtual_DcmDspUDS_DID_F110Byte0_3_signal" 708 "SIGNALS_Virtual_DcmDspUDS_DID_F110Byte12_15_signal" 709 "SIGNALS_Virtual_DcmDspUDS_DID_F110Byte16_signal" 710 "SIGNALS_Virtual_DcmDspUDS_DID_F110Byte4_7_signal" 711 "SIGNALS_Virtual_DcmDspUDS_DID_F110Byte8_11_signal" 712 "SIGNALS_Virtual_DcmDspUDS_DID_F112Byte0_3_signal" 713 "SIGNALS_Virtual_DcmDspUDS_DID_F112Byte12_15_signal" 714 "SIGNALS_Virtual_DcmDspUDS_DID_F112Byte16_19_signal" 715 "SIGNALS_Virtual_DcmDspUDS_DID_F112Byte20_23_signal" 716 "SIGNALS_Virtual_DcmDspUDS_DID_F112Byte24_27_signal" 717 "SIGNALS_Virtual_DcmDspUDS_DID_F112Byte28_29_signal" 718 "SIGNALS_Virtual_DcmDspUDS_DID_F112Byte30_signal" 719 "SIGNALS_Virtual_DcmDspUDS_DID_F112Byte4_7_signal" 720 "SIGNALS_Virtual_DcmDspUDS_DID_F112Byte8_11_signal" 721 "SIGNALS_Virtual_DcmDspUDS_E602Byte2_signal" 722 "SIGNALS_Virtual_DcmDspUDS_F181Byte0_3_signal" 723 "SIGNALS_Virtual_DcmDspUDS_F181Byte12_15_signal" 724 "SIGNALS_Virtual_DcmDspUDS_F181Byte4_7_signal" 725 "SIGNALS_Virtual_DcmDspUDS_F181Byte8_11_signal" 726 "SIGNALS_Virtual_DcmDspUDS_fzabgs_w_signal" 727 "SIGNALS_Virtual_DcmDspUDS_fzabgzyl_w_0_signal" 728 "SIGNALS_Virtual_DcmDspUDS_fzabgzyl_w_1_signal" 729 "SIGNALS_Virtual_DcmDspUDS_fzabgzyl_w_2_signal" 730 "SIGNALS_Virtual_DcmDspUDS_fzabgzyl_w_3_signal" 731 "SIGNALS_Virtual_DcmDspUDS_numReWrECUID1_signal" 732 "SIGNALS_Virtual_DcmDspUDS_numReWrECUID2_signal" 733 "SIGNALS_Virtual_I14229B9_0490_FrNo09_signal" 734 "SIGNALS_Virtual_I14229B9_0490_FrNo10_signal" 735 "SIGNALS_Virtual_I14229B9_04B1_FrNo16_signal" 736 "SIGNALS_Virtual_I14229B9_04B1_FrNo17_signal" 737 "SIGNALS_Virtual_I14229B9_04B1_FrNo20_signal" 738 "SIGNALS_Virtual_I14229B9_04B1_FrNo21_signal" 739 "SIGNALS_Virtual_I14229B9_04B1_FrNo22_signal" 740 "SIGNALS_Virtual_I14229B9_04B1_FrNo23_signal" 741 "SIGNALS_Virtual_I14229B9_04C2_FrNo2021_signal" 742 "SIGNALS_Virtual_I14229B9_04D2_FrNo24_signal" 743 "SIGNALS_Virtual_I14229B9_04D2_FrNo25_signal" 744 "SIGNALS_Virtual_I14229B9_0520_FrNo15_signal" 745 "SIGNALS_Virtual_I14229B9_0520_FrNo16_signal" 746 "SIGNALS_Virtual_I14229B9_0523_FrNo42_signal" 747 "SIGNALS_Virtual_I14229B9_0523_FrNo43_signal" 748 "SIGNALS_Virtual_I14229B9_0524_FrNo09_signal" 749 "SIGNALS_Virtual_I14229B9_0524_FrNo10_signal" 750 "SIGNALS_Virtual_I14229B9_0550_FrNo09_signal" 751 "SIGNALS_Virtual_I14229B9_0550_FrNo10_signal" 752 "SIGNALS_Virtual_I14229B9_0553_FrNo13_signal" 753 "SIGNALS_Virtual_I14229B9_0553_FrNo14_signal" 754 "SIGNALS_Virtual_I14229B9_056A_FrNo8_signal" 755 "SIGNALS_Virtual_I14229B9_056A_FrNo9_signal" 756 "SIGNALS_Virtual_I14229B9_0588_FrNo15_signal" 757 "SIGNALS_Virtual_I14229B9_0588_FrNo16_signal" 758 "SIGNALS_Virtual_I14229B9_05A0_FrNo40_signal" 759 "SIGNALS_Virtual_I14229B9_05A0_FrNo41_signal" 760 "SIGNALS_Virtual_I14229B9_05B0_FrNo13_signal" 761 "SIGNALS_Virtual_I14229B9_05B0_FrNo14_signal" 762 "SIGNALS_Virtual_I14229B9_05C0_FrNo12_signal" 763 "SIGNALS_Virtual_I14229B9_05C0_FrNo13_signal" 764 "SIGNALS_Virtual_I14229B9_05E0_FrNo19_signal" 765 "SIGNALS_Virtual_I14229B9_05E0_FrNo20_signal" 766 "SIGNALS_Virtual_I14229B9_05E0_FrNo21_signal" 767 "SIGNALS_Virtual_I14229B9_05E0_FrNo22_signal" 768 "SIGNALS_Virtual_I14229B9_05E0_FrNo23_signal" 769 "SIGNALS_Virtual_I14229B9_05E0_FrNo24_signal" 770 "SIGNALS_Virtual_I14229B9_1208_FrNo34_signal" 771 "SIGNALS_Virtual_I14229B9_1208_FrNo35_signal" 772 "SIGNALS_Virtual_I14229B9_1208_FrNo36_signal" 773 "SIGNALS_Virtual_I14229B9_1208_FrNo37_signal" 774 "SIGNALS_Virtual_I14229B9_120A_FrNo09_signal" 775 "SIGNALS_Virtual_I14229B9_120A_FrNo10_signal" 776 "SIGNALS_Virtual_I14229B9_120B_FrNo09_signal" 777 "SIGNALS_Virtual_I14229B9_120B_FrNo10_signal" 778 "SIGNALS_Virtual_I14229_AirC_pAnaClnt_signal" 779 "SIGNALS_Virtual_I14229_EpmCaS_ctErrSig2_signal" 780 "SIGNALS_Virtual_I14229_pEngSrtMin_signal" 781 "SIGNALS_Virtual_I14229_wdkba_w_signal" 782 "SIGNALS_Virtual_Tra_numGear_signal" /end COMPU_VTAB
/begin RECORD_LAYOUT ValA_Wu16 FNC_VALUES 1 UWORD COLUMN_DIR DIRECT /end RECORD_LAYOUT
/begin RECORD_LAYOUT Val_Wu16 FNC_VALUES 1 UWORD COLUMN_DIR DIRECT /end RECORD_LAYOUT
/begin RECORD_LAYOUT Val_Wu8 FNC_VALUES 1 UBYTE COLUMN_DIR DIRECT /end RECORD_LAYOUT
/end MODULE
/end PROJECT
