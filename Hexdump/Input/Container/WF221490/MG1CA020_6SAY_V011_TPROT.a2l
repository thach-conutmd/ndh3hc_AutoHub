ASAP2_VERSION 1 60
/begin PROJECT MG1CA020 "MG1CA020"
/begin HEADER "" VERSION "MG1CA020_6SAY_V011_TPROT" PROJECT_NO MG1CA020 /end HEADER
/begin MODULE DIM ""
/begin MOD_COMMON "" BYTE_ORDER MSB_LAST ALIGNMENT_BYTE 1 ALIGNMENT_WORD 2 ALIGNMENT_LONG 4 ALIGNMENT_INT64 4 ALIGNMENT_FLOAT32_IEEE 4 ALIGNMENT_FLOAT64_IEEE 4 DATA_SIZE 32 /end MOD_COMMON
/begin CHARACTERISTIC MoFDrDem_dfacRampDwn_M "Rate of change of torque during ramp down in function monitoring" MAP 0x8053BE8C Map_Xs16Ys16Ws16 1.000000 Fact1000 0.00 1.000000 FORMAT "%8.6" EXTENDED_LIMITS -32.76800 32.76700
 /begin AXIS_DESCR STD_AXIS MoFESpd_nEng nmot_q40 8 0.00 10200.00 FORMAT "%8.2" EXTENDED_LIMITS -1310720. 1310680. DEPOSIT ABSOLUTE /end AXIS_DESCR
 /begin AXIS_DESCR STD_AXIS MoF_rAPP rel_q0p39 8 0.00 99.60938 FORMAT "%8.5" EXTENDED_LIMITS -12800.00 12799.61 DEPOSIT ABSOLUTE /end AXIS_DESCR
/end CHARACTERISTIC
/begin CHARACTERISTIC MoFDrDem_dfacRampUp_M "Rate of change of torque during ramp up in function monitoring" MAP 0x8053BF30 Map_Xs16Ys16Ws16 1.000000 Fact1000 0.00 1.000000 FORMAT "%8.6" EXTENDED_LIMITS -32.76800 32.76700
 /begin AXIS_DESCR STD_AXIS MoFESpd_nEng nmot_q40 8 0.00 10200.00 FORMAT "%8.2" EXTENDED_LIMITS -1310720. 1310680. DEPOSIT ABSOLUTE /end AXIS_DESCR
 /begin AXIS_DESCR STD_AXIS MoF_rAPP rel_q0p39 8 0.00 99.60938 FORMAT "%8.5" EXTENDED_LIMITS -12800.00 12799.61 DEPOSIT ABSOLUTE /end AXIS_DESCR
/end CHARACTERISTIC
/begin CHARACTERISTIC MoFDrDem_dfacSptOff_M "Delta multiplication factor for turning off sports mode" MAP 0x8053BFD4 Map_Xs16Ys16Ws16 2.000000 Fact1000 -1.000000 1.000000 FORMAT "%8.6" EXTENDED_LIMITS -32.76800 32.76700
 /begin AXIS_DESCR STD_AXIS MoFESpd_nEng nmot_q40 8 0.00 10200.00 FORMAT "%8.2" EXTENDED_LIMITS -1310720. 1310680. DEPOSIT ABSOLUTE /end AXIS_DESCR
 /begin AXIS_DESCR STD_AXIS MoF_rAPP rel_q0p39 8 0.00 99.60938 FORMAT "%8.5" EXTENDED_LIMITS -12800.00 12799.61 DEPOSIT ABSOLUTE /end AXIS_DESCR
/end CHARACTERISTIC
/begin CHARACTERISTIC MoFDrDem_dfacSptOn_M "Delta multiplication factor for turning on sports mode" MAP 0x8053C078 Map_Xs16Ys16Ws16 2.000000 Fact1000 -1.000000 1.000000 FORMAT "%8.6" EXTENDED_LIMITS -32.76800 32.76700
 /begin AXIS_DESCR STD_AXIS MoFESpd_nEng nmot_q40 8 0.00 10200.00 FORMAT "%8.2" EXTENDED_LIMITS -1310720. 1310680. DEPOSIT ABSOLUTE /end AXIS_DESCR
 /begin AXIS_DESCR STD_AXIS MoF_rAPP rel_q0p39 8 0.00 99.60938 FORMAT "%8.5" EXTENDED_LIMITS -12800.00 12799.61 DEPOSIT ABSOLUTE /end AXIS_DESCR
/end CHARACTERISTIC
/begin CHARACTERISTIC MoFDrDem_stDrvModPrevSwt_C "Default Previous drive mode in function monitoring" VALUE 0x8053B7C2 Val_Wu8 1.000 OneToOne 0.00 1.000 FORMAT "%5.3" EXTENDED_LIMITS 0.00 255.0 /end CHARACTERISTIC
/begin CHARACTERISTIC MoFDrDem_stDrvModSwt_C "Default drive mode in function monitoring" VALUE 0x8053B7C3 Val_Wu8 1.000 OneToOne 0.00 1.000 FORMAT "%5.3" EXTENDED_LIMITS 0.00 255.0 /end CHARACTERISTIC
/begin CHARACTERISTIC MoFDrDem_swtDrvModSeln_C "Drive mode selection switch in function monitoring" VALUE 0x8053B7C4 Val_Wu8 1.000 OneToOne 0.00 1.000 FORMAT "%5.3" EXTENDED_LIMITS 0.00 255.0 /end CHARACTERISTIC
/begin CHARACTERISTIC MoFDrDem_tqEngEcoOrCmft_M "Accelerator pedal map in case of Eco or Comfort mode in function monitoring" MAP 0x8053C11C Map_Xs16Ys16Ws16 6553.500 md_q0p1 -3276.800 3276.700 FORMAT "%8.3"
 /begin AXIS_DESCR STD_AXIS MoFESpd_nEng nmot_q40 8 0.00 10200.00 FORMAT "%8.2" EXTENDED_LIMITS -1310720. 1310680. DEPOSIT ABSOLUTE /end AXIS_DESCR
 /begin AXIS_DESCR STD_AXIS MoF_rAPP rel_q0p39 8 0.00 99.60938 FORMAT "%8.5" EXTENDED_LIMITS -12800.00 12799.61 DEPOSIT ABSOLUTE /end AXIS_DESCR
/end CHARACTERISTIC
/begin CHARACTERISTIC MoFDrDem_tqEngSnow_M "Accelerator pedal map in case of snow mode in function monitoring" MAP 0x8053C1C0 Map_Xs16Ys16Ws16 6553.500 md_q0p1 -3276.800 3276.700 FORMAT "%8.3"
 /begin AXIS_DESCR STD_AXIS MoFESpd_nEng nmot_q40 8 0.00 10200.00 FORMAT "%8.2" EXTENDED_LIMITS -1310720. 1310680. DEPOSIT ABSOLUTE /end AXIS_DESCR
 /begin AXIS_DESCR STD_AXIS MoF_rAPP rel_q0p39 8 0.00 99.60938 FORMAT "%8.5" EXTENDED_LIMITS -12800.00 12799.61 DEPOSIT ABSOLUTE /end AXIS_DESCR
/end CHARACTERISTIC
/begin CHARACTERISTIC MoFDrDem_tqEngSpt_M "Accelerator pedal map in case of sports mode" MAP 0x8053C264 Map_Xs16Ys16Ws16 6553.500 md_q0p1 -3276.800 3276.700 FORMAT "%8.3"
 /begin AXIS_DESCR STD_AXIS MoFESpd_nEng nmot_q40 8 0.00 10200.00 FORMAT "%8.2" EXTENDED_LIMITS -1310720. 1310680. DEPOSIT ABSOLUTE /end AXIS_DESCR
 /begin AXIS_DESCR STD_AXIS MoF_rAPP rel_q0p39 8 0.00 99.60938 FORMAT "%8.5" EXTENDED_LIMITS -12800.00 12799.61 DEPOSIT ABSOLUTE /end AXIS_DESCR
/end CHARACTERISTIC
/begin CHARACTERISTIC MoFDrDem_tqMinWoRamp_C "Minimum torque difference for ramping of torque during drive mode change to be activated in function monitoring" VALUE 0x8053C308 Val_Wu16 3276.700 md_q0p1 0.00 3276.700 FORMAT "%8.3" EXTENDED_LIMITS 0.00 6553.500 /end CHARACTERISTIC
/begin CHARACTERISTIC MoFDrvPrgSwt_stDrvModSel_CA "Selection drive mode for IDS" VAL_BLK 0x8053B7CC ValA_Wu8 255.0 OneToOne 0.00 255.0 FORMAT "%5.1" NUMBER 16 /end CHARACTERISTIC
/begin CHARACTERISTIC MoFDrvPrgSwt_swtDrvModSeln_C "switch to select between two drive and five drive mode" VALUE 0x8053B7DC Val_Wu8 255.0 OneToOne 0.00 255.0 FORMAT "%5.1" /end CHARACTERISTIC
/begin CHARACTERISTIC MoFDrvPrgSwt_swtEcoModMaskL1_C "Mask to compare with Level 1 drive mode status" VALUE 0x8053B7DD Val_Wu8 255.0 OneToOne 0.00 255.0 FORMAT "%5.1" /end CHARACTERISTIC
/begin CHARACTERISTIC MoFESpd_cntrDebMaxSeln_C "Limit for activation engine speed max selection in function monitoring" VALUE 0x8053B7DE Val_Wu8 255.0 OneToOne 0.00 255.0 FORMAT "%5.1" /end CHARACTERISTIC
/begin CHARACTERISTIC MoFESpd_cntrNoSyncDeb_C "maximum debounce time for synchro loss in function monitoring" VALUE 0x8053B7DF Val_Wu8 255.0 OneToOne 0.00 255.0 FORMAT "%5.1" /end CHARACTERISTIC
/begin CHARACTERISTIC MoFESpd_cntrTstDeb_C "counter limit for setting testflag in diagnosis MoFESpd in function monitoring" VALUE 0x8053CD15 Val_Wu8 255.0 OneToOne 0.00 255.0 FORMAT "%5.1" /end CHARACTERISTIC
/begin CHARACTERISTIC MoFESpd_ctDeb_C "Error counter value for engine speed comparison during function monitoring" VALUE 0x8053B7E0 Val_Wu8 255.0 OneToOne 0.00 255.0 FORMAT "%5.1" /end CHARACTERISTIC
/begin CHARACTERISTIC MoFESpd_ctRst_C "Number of permissible resets in case of error in engine speed comparison" VALUE 0x8053B7E1 Val_Wu8 255.0 OneToOne 0.00 255.0 FORMAT "%5.1" /end CHARACTERISTIC
/begin CHARACTERISTIC MoFESpd_nDiffMaxHiResl_C "Permitted difference between calculated engine speeds in level 1 and level 2" VALUE 0x8053C64A Val_Ws16 16383.50 nmot_q0p5 0.00 16383.50 FORMAT "%8.2" EXTENDED_LIMITS -16384.00 16383.50 /end CHARACTERISTIC
/begin AXIS_PTS MoFESpd_nEng_Ax "Data point distribution for engine speed in engine speed monitoring" 0x8053B7E2 MoFESpd_nEng Axis_Xu8 10200. nmot_q40 8 0.00 10200. FORMAT "%5.0" DEPOSIT ABSOLUTE /end AXIS_PTS
/begin CHARACTERISTIC MoFESpd_nMinHiResl_C "Minimum engine speed during engine speed monitoring" VALUE 0x8053C64C Val_Ws16 16383.50 nmot_q0p5 0.00 16383.50 FORMAT "%8.2" EXTENDED_LIMITS -16384.00 16383.50 /end CHARACTERISTIC
/begin CHARACTERISTIC MoFESpd_tiGradNEngErrDeb_C "Maximum debounce time for recognized engine speed slope error in engine speed monitoring" VALUE 0x8053B7EB Val_Wu8 2.540 t_q0p01 0.010 2.550 FORMAT "%5.3" EXTENDED_LIMITS 0.00 2.550 /end CHARACTERISTIC
/begin CHARACTERISTIC MoFETC_cntrCurRunTestReq_C "Debounce threshold of test request from level 1 for engine test" VALUE 0x8053B7F6 Val_Wu8 255.0 OneToOne 0.00 255.0 FORMAT "%5.1" /end CHARACTERISTIC
/begin CHARACTERISTIC MoFETC_cntrTestIdleUpTOffDly_C "High Idle engine speed tester request turn off delay threshold" VALUE 0x8053B7F7 Val_Wu8 255.0 OneToOne 0.00 255.0 FORMAT "%5.1" /end CHARACTERISTIC
/begin CHARACTERISTIC MoFETC_cntrTestIdleUp_C "Maximum permissible duration of High Idle engine speed tester request threshold" VALUE 0x8053BD78 Val_Wu32 4294967295.00 OneToOne 0.00 4294967295.00 FORMAT "%13.2" /end CHARACTERISTIC
/begin CHARACTERISTIC MoFETC_cntrTestTOffDly_C "Debounce threshold for reset of the diagnosis state for engine test" VALUE 0x8053B7F8 Val_Wu8 255.0 OneToOne 0.00 255.0 FORMAT "%5.1" /end CHARACTERISTIC
/begin CHARACTERISTIC MoFETC_cntrTest_C "Maximum threshold to determine if the engine test active has elapsed for a Time Out" VALUE 0x8053BD7C Val_Wu32 4294967295.00 OneToOne 0.00 4294967295.00 FORMAT "%13.2" /end CHARACTERISTIC
/begin CHARACTERISTIC MoFETC_flgMonDiagDisblLck_C "Deactivationlabel for permission lock" VALUE 0x8053B7F9 Val_Wu8 1.00000000000 B_TRUE 0.00 1.00000000000 FORMAT "%13.11" /end CHARACTERISTIC
/begin CHARACTERISTIC MoFETC_rAppLETThd_C "instruction test label for monitoring" VALUE 0x8053C64E Val_Ws16 799.9878 Prc -400.0000 399.9878 FORMAT "%8.4" /end CHARACTERISTIC
/begin CHARACTERISTIC MoFETC_rAppThd_C "High Idle engine speed tester request is permitted below this accelerator pedal ratio" VALUE 0x8053B7FA Val_Wu8 99.61 rel_q0p39 0.00 99.61 FORMAT "%5.2" /end CHARACTERISTIC
/begin CHARACTERISTIC MoFETC_swtInactvTO_C "Deactivationlabel for timeout check" VALUE 0x8053B7FB Val_Wu8 255.0 OneToOne 0.00 255.0 FORMAT "%5.1" /end CHARACTERISTIC
/begin CHARACTERISTIC MoFETC_vVehThd_C "velocity limit in additional external Intervention in function monitoring" VALUE 0x8053C650 Val_Ws16 655.3500 Mo_v_kmh_q0p01 -327.6800 327.6700 FORMAT "%8.4" /end CHARACTERISTIC
/begin CHARACTERISTIC MoFExtInt_ctDebDCSMax_C "Maximum value of Debouncing counter for extention of MSR intervention, until the intervention of level 1 is ramped" VALUE 0x8053B7FC Val_Wu8 255.0 OneToOne 0.00 255.0 FORMAT "%5.1" /end CHARACTERISTIC
/begin CHARACTERISTIC MoFExtInt_ctDebTSCMax_C "Maximum value of debouncing counter for extension of gearbox intervention, until the intervention of level 1 is ramped" VALUE 0x8053B7FD Val_Wu8 255.0 OneToOne 0.00 255.0 FORMAT "%5.1" /end CHARACTERISTIC
/begin CHARACTERISTIC MoFExtInt_flgSwtIncTSCIntvActvTq_C "Select L2 TSC intervention release condition" VALUE 0x8053B7FE Val_Wu8 1.00000000000 B_TRUE 0.00 1.00000000000 FORMAT "%13.11" /end CHARACTERISTIC
/begin CHARACTERISTIC MoFExtInt_tqIncTSCIntvDesMin_C "Lower torque release threshold for TSC intervention in L2" VALUE 0x8053B7FF Val_Wu8 408.0 md_q1p6 0.00 408.0 FORMAT "%5.1" /end CHARACTERISTIC
/begin CHARACTERISTIC MoFFrmCoorrCust_Rx_swtEnaEATPlaus_C "Switch to select EAT12 or EAT13 frame" VALUE 0x8053B800 Val_Wu8 1.00000000000 B_TRUE 0.00 1.00000000000 FORMAT "%13.11" /end CHARACTERISTIC
/begin CHARACTERISTIC MoFFrm_Lib_CRC16H1021Tab_CA "Calibration array used for checksum calculation with H1021 as first element" VAL_BLK 0x8053C652 ValA_Wu16 65535.00 OneToOne 0.00 65535.00 FORMAT "%8.2" READ_ONLY NUMBER 256 /end CHARACTERISTIC
/begin CHARACTERISTIC MoFFrm_Lib_CRC82FHTab_CA "Calibration array used for checksum calculation with 2F as first element" VAL_BLK 0x8053B802 ValA_Wu8 255.0 OneToOne 0.00 255.0 FORMAT "%5.1" READ_ONLY NUMBER 256 /end CHARACTERISTIC
/begin CHARACTERISTIC MoFFrm_Lib_CRC8H1DTab_CA "Calibration array used for checksum calculation with 1D as first element" VAL_BLK 0x8053B902 ValA_Wu8 255.0 OneToOne 0.00 255.0 FORMAT "%5.1" READ_ONLY NUMBER 256 /end CHARACTERISTIC
/begin CHARACTERISTIC MoFFrm_Lib_DataApplSigInstance.divFac_C "Structure variable of data application signal / Signal divisor." VALUE 0x8053CAE0 Val_Wu32 4294967295.00 OneToOne 0.00 4294967295.00 FORMAT "%13.2" READ_ONLY /end CHARACTERISTIC
/begin CHARACTERISTIC MoFFrm_Lib_DataApplSigInstance.mulFac_C "Structure variable of data application signal / Signal multiplier" VALUE 0x8053CAE4 Val_Wu32 4294967295.00 OneToOne 0.00 4294967295.00 FORMAT "%13.2" READ_ONLY /end CHARACTERISTIC
/begin CHARACTERISTIC MoFFrm_Lib_DataApplSigInstance.offsFac_C "Structure variable of data application signal / Signal offset" VALUE 0x8053CAE8 Val_Ws32 4294967295.00 OneToOne -2147483648.00 2147483647.00 FORMAT "%13.2" READ_ONLY /end CHARACTERISTIC
/begin CHARACTERISTIC MoFFrm_Lib_DataPduRxInstance.bufLen_C "Structure variable for Rx PDU / parameter to indicate the buffer length of the receiving PDU" VALUE 0x8053CAFC Val_Wu8 255.0 OneToOne 0.00 255.0 FORMAT "%5.1" READ_ONLY /end CHARACTERISTIC
/begin CHARACTERISTIC MoFFrm_Lib_DataPduRxInstance.bytOrderAlvCntr_C "Structure variable for Rx PDU / Alive counter calibration of RX Data Pdu" VALUE 0x8053CAFD Val_Wu8 1.000 OneToOne 0.00 1.000 FORMAT "%5.3" EXTENDED_LIMITS 0.00 255.0 READ_ONLY /end CHARACTERISTIC
/begin CHARACTERISTIC MoFFrm_Lib_DataPduRxInstance.bytOrderCrc_C "Structure variable for Rx PDU / CRC calibration of RX Data Pdu" VALUE 0x8053CAFE Val_Wu8 1.000 OneToOne 0.00 1.000 FORMAT "%5.3" EXTENDED_LIMITS 0.00 255.0 READ_ONLY /end CHARACTERISTIC
/begin CHARACTERISTIC MoFFrm_Lib_DataPduRxInstance.cntrAlvErrDeb_C "Structure variable for Rx PDU / Alive counter debounce error calibration of RX Data Pdu" VALUE 0x8053CB00 Val_Wu16 65535.00 OneToOne 0.00 65535.00 FORMAT "%8.2" /end CHARACTERISTIC
/begin CHARACTERISTIC MoFFrm_Lib_DataPduRxInstance.cntrCrcErrDeb_C "Structure variable for Rx PDU / Alive counter debounce error calibration of RX Data Pdu" VALUE 0x8053CB02 Val_Wu16 65535.00 OneToOne 0.00 65535.00 FORMAT "%8.2" /end CHARACTERISTIC
/begin CHARACTERISTIC MoFFrm_Lib_DataPduRxInstance.cntrMaxAlvDif_C "Structure variable for Rx PDU / Complement of Counter cyclic calibration of RX Data Pdu" VALUE 0x8053CB04 Val_Wu8 255.0 OneToOne 0.00 255.0 FORMAT "%5.1" /end CHARACTERISTIC
/begin CHARACTERISTIC MoFFrm_Lib_DataPduRxInstance.cntrTiOutDeb_C "Structure variable for Rx PDU / Counter time out debounce calibration of Rx data PDU" VALUE 0x8053CB06 Val_Wu16 65535.00 OneToOne 0.00 65535.00 FORMAT "%8.2" /end CHARACTERISTIC
/begin CHARACTERISTIC MoFFrm_Lib_DataPduRxInstance.crcId_C "Structure variable for Rx PDU / CRC ID of Rx data PDU" VALUE 0x8053CB08 Val_Wu32 4294967295.00 OneToOne 0.00 4294967295.00 FORMAT "%13.2" /end CHARACTERISTIC
/begin CHARACTERISTIC MoFFrm_Lib_DataPduRxInstance.cycTi_C "Structure variable for Rx PDU / cycle time from bus matrix" VALUE 0x8053CB0C Val_Wu16 65535.00 OneToOne 0.00 65535.00 FORMAT "%8.2" READ_ONLY /end CHARACTERISTIC
/begin CHARACTERISTIC MoFFrm_Lib_DataPduRxInstance.diChks_C "Structure variable for Rx PDU / parameter to enable or disable manipulation of various checks" VALUE 0x8053CB0E Val_Wu8 255.0 OneToOne 0.00 255.0 FORMAT "%5.1" /end CHARACTERISTIC
/begin CHARACTERISTIC MoFFrm_Lib_DataPduRxInstance.evalType_C "Structure variable for Rx PDU / evaluation type" VALUE 0x8053CB0F Val_Wu8 255.0 OneToOne 0.00 255.0 FORMAT "%5.1" READ_ONLY /end CHARACTERISTIC
/begin CHARACTERISTIC MoFFrm_Lib_DataPduRxInstance.maskAlvCntr_C "Structure variable for Rx PDU / Alive counter start bit position of Rx data PDU" VALUE 0x8053CB10 Val_Wu8 255.0 OneToOne 0.00 255.0 FORMAT "%5.1" /end CHARACTERISTIC
/begin CHARACTERISTIC MoFFrm_Lib_DataPduRxInstance.posnAlvCntrStrtBit_C "Structure variable for Rx PDU / Alive counter start bit calibration of of Data PDU Rx" VALUE 0x8053CB12 Val_Wu16 65535.00 OneToOne 0.00 65535.00 FORMAT "%8.2" READ_ONLY /end CHARACTERISTIC
/begin CHARACTERISTIC MoFFrm_Lib_DataPduRxInstance.posnCrcCalcEndByte_C "Structure variable for Rx PDU / End byte of CRC calculation position of Data PDU Rx" VALUE 0x8053CB14 Val_Wu8 255.0 OneToOne 0.00 255.0 FORMAT "%5.1" /end CHARACTERISTIC
/begin CHARACTERISTIC MoFFrm_Lib_DataPduRxInstance.posnCrcCalcStrtByte_C "Structure variable for Rx PDU / Start byte of CRC calculation position of Data PDU Rx" VALUE 0x8053CB15 Val_Wu8 255.0 OneToOne 0.00 255.0 FORMAT "%5.1" /end CHARACTERISTIC
/begin CHARACTERISTIC MoFFrm_Lib_DataPduRxInstance.posnCrcStrtBit_C "Structure variable for Rx PDU / CRC start bit position of Rx data PDU" VALUE 0x8053CB16 Val_Wu16 65535.00 OneToOne 0.00 65535.00 FORMAT "%8.2" READ_ONLY /end CHARACTERISTIC
/begin CHARACTERISTIC MoFFrm_Lib_DataPduRxInstance.sigLenAlvCntr_C "Structure variable for Rx PDU / Alive counter signal length of Rx data PDU" VALUE 0x8053CB18 Val_Wu8 31.00 OneToOne 1.00 32.00 FORMAT "%5.2" EXTENDED_LIMITS 0.00 255.0 READ_ONLY /end CHARACTERISTIC
/begin CHARACTERISTIC MoFFrm_Lib_DataPduRxInstance.sigLenCrc_C "Structure variable for Rx PDU / CRC calibration signal length of Rx data PDU" VALUE 0x8053CB19 Val_Wu8 31.00 OneToOne 1.00 32.00 FORMAT "%5.2" EXTENDED_LIMITS 0.00 255.0 READ_ONLY /end CHARACTERISTIC
/begin CHARACTERISTIC MoFFrm_Lib_DataPduTxInstance.bufLen_C "Structure variable for Tx PDU / Buffer length of the transmission PDU" VALUE 0x8053CB24 Val_Wu8 255.0 OneToOne 0.00 255.0 FORMAT "%5.1" READ_ONLY /end CHARACTERISTIC
/begin CHARACTERISTIC MoFFrm_Lib_DataPduTxInstance.bytOrderAlvCntr_C "Structure variable for Tx PDU / Alive counter byte order" VALUE 0x8053CB25 Val_Wu8 1.000 OneToOne 0.00 1.000 FORMAT "%5.3" EXTENDED_LIMITS 0.00 255.0 READ_ONLY /end CHARACTERISTIC
/begin CHARACTERISTIC MoFFrm_Lib_DataPduTxInstance.bytOrderCrc_C "Structure variable for Tx PDU / CRC byte order" VALUE 0x8053CB26 Val_Wu8 1.000 OneToOne 0.00 1.000 FORMAT "%5.3" EXTENDED_LIMITS 0.00 255.0 READ_ONLY /end CHARACTERISTIC
/begin CHARACTERISTIC MoFFrm_Lib_DataPduTxInstance.crcId_C "Structure variable for Tx PDU / CRC iD calibration of Tx data PDU" VALUE 0x8053CB28 Val_Wu32 4294967295.00 OneToOne 0.00 4294967295.00 FORMAT "%13.2" /end CHARACTERISTIC
/begin CHARACTERISTIC MoFFrm_Lib_DataPduTxInstance.evalType_C "Structure variable for Tx PDU / evaluation type of the Tx message" VALUE 0x8053CB2C Val_Wu8 255.0 OneToOne 0.00 255.0 FORMAT "%5.1" READ_ONLY /end CHARACTERISTIC
/begin CHARACTERISTIC MoFFrm_Lib_DataPduTxInstance.posnAlvCntrStrtBit_C "Structure variable for Tx PDU / alive counter start bit position" VALUE 0x8053CB2E Val_Wu16 65535.00 OneToOne 0.00 65535.00 FORMAT "%8.2" READ_ONLY /end CHARACTERISTIC
/begin CHARACTERISTIC MoFFrm_Lib_DataPduTxInstance.posnCrcCalcEndByte_C "Structure variable for Tx PDU / Start byte of CRC calculation position of Data PDU Tx" VALUE 0x8053CB30 Val_Wu8 255.0 OneToOne 0.00 255.0 FORMAT "%5.1" /end CHARACTERISTIC
/begin CHARACTERISTIC MoFFrm_Lib_DataPduTxInstance.posnCrcCalcStrtByte_C "Structure variable for Tx PDU / Start byte of CRC calculation position of Data PDU Tx" VALUE 0x8053CB31 Val_Wu8 255.0 OneToOne 0.00 255.0 FORMAT "%5.1" /end CHARACTERISTIC
/begin CHARACTERISTIC MoFFrm_Lib_DataPduTxInstance.posnCrcStrtBit_C "Structure variable for Tx PDU / CRC start bit position" VALUE 0x8053CB32 Val_Wu16 65535.00 OneToOne 0.00 65535.00 FORMAT "%8.2" READ_ONLY /end CHARACTERISTIC
/begin CHARACTERISTIC MoFFrm_Lib_DataPduTxInstance.sigLenAlvCntr_C "Structure variable for Tx PDU / alive counter signal length" VALUE 0x8053CB34 Val_Wu8 31.00 OneToOne 1.00 32.00 FORMAT "%5.2" EXTENDED_LIMITS 0.00 255.0 READ_ONLY /end CHARACTERISTIC
/begin CHARACTERISTIC MoFFrm_Lib_DataPduTxInstance.sigLenCrc_C "Structure variable for Tx PDU / CRC signal length" VALUE 0x8053CB35 Val_Wu8 31.00 OneToOne 1.00 32.00 FORMAT "%5.2" EXTENDED_LIMITS 0.00 255.0 READ_ONLY /end CHARACTERISTIC
/begin CHARACTERISTIC MoFFrm_Rx_DataPdu_AYCF.bufLen_C "Structure instance of PDU AYCF / parameter to indicate the buffer length of the receiving PDU" VALUE 0x8053CB90 Val_Wu8 255.0 OneToOne 0.00 255.0 FORMAT "%5.1" READ_ONLY /end CHARACTERISTIC
/begin CHARACTERISTIC MoFFrm_Rx_DataPdu_AYCF.bytOrderAlvCntr_C "Structure instance of PDU AYCF / Alive counter calibration of RX Data Pdu" VALUE 0x8053CB91 Val_Wu8 1.000 OneToOne 0.00 1.000 FORMAT "%5.3" EXTENDED_LIMITS 0.00 255.0 READ_ONLY /end CHARACTERISTIC
/begin CHARACTERISTIC MoFFrm_Rx_DataPdu_AYCF.bytOrderCrc_C "Structure instance of PDU AYCF / CRC calibration of RX Data Pdu" VALUE 0x8053CB92 Val_Wu8 1.000 OneToOne 0.00 1.000 FORMAT "%5.3" EXTENDED_LIMITS 0.00 255.0 READ_ONLY /end CHARACTERISTIC
/begin CHARACTERISTIC MoFFrm_Rx_DataPdu_AYCF.cntrAlvErrDeb_C "Structure instance of PDU AYCF / Alive counter debounce error calibration of RX Data Pdu" VALUE 0x8053CB94 Val_Wu16 65535.00 OneToOne 0.00 65535.00 FORMAT "%8.2" /end CHARACTERISTIC
/begin CHARACTERISTIC MoFFrm_Rx_DataPdu_AYCF.cntrCrcErrDeb_C "Structure instance of PDU AYCF / Alive counter debounce error calibration of RX Data Pdu" VALUE 0x8053CB96 Val_Wu16 65535.00 OneToOne 0.00 65535.00 FORMAT "%8.2" /end CHARACTERISTIC
/begin CHARACTERISTIC MoFFrm_Rx_DataPdu_AYCF.cntrMaxAlvDif_C "Structure instance of PDU AYCF / Complement of Counter cyclic calibration of RX Data Pdu" VALUE 0x8053CB98 Val_Wu8 255.0 OneToOne 0.00 255.0 FORMAT "%5.1" /end CHARACTERISTIC
/begin CHARACTERISTIC MoFFrm_Rx_DataPdu_AYCF.cntrTiOutDeb_C "Structure instance of PDU AYCF / Counter time out debounce calibration of Rx data PDU" VALUE 0x8053CB9A Val_Wu16 65535.00 OneToOne 0.00 65535.00 FORMAT "%8.2" /end CHARACTERISTIC
/begin CHARACTERISTIC MoFFrm_Rx_DataPdu_AYCF.crcId_C "Structure instance of PDU AYCF / CRC ID of Rx data PDU" VALUE 0x8053CB9C Val_Wu32 4294967295.00 OneToOne 0.00 4294967295.00 FORMAT "%13.2" /end CHARACTERISTIC
/begin CHARACTERISTIC MoFFrm_Rx_DataPdu_AYCF.cycTi_C "Structure instance of PDU AYCF / cycle time from bus matrix" VALUE 0x8053CBA0 Val_Wu16 65535.00 OneToOne 0.00 65535.00 FORMAT "%8.2" READ_ONLY /end CHARACTERISTIC
/begin CHARACTERISTIC MoFFrm_Rx_DataPdu_AYCF.diChks_C "Structure instance of PDU AYCF / parameter to enable or disable manipulation of various checks" VALUE 0x8053CBA2 Val_Wu8 255.0 OneToOne 0.00 255.0 FORMAT "%5.1" /end CHARACTERISTIC
/begin CHARACTERISTIC MoFFrm_Rx_DataPdu_AYCF.evalType_C "Structure instance of PDU AYCF / evaluation type" VALUE 0x8053CBA3 Val_Wu8 255.0 OneToOne 0.00 255.0 FORMAT "%5.1" READ_ONLY /end CHARACTERISTIC
/begin CHARACTERISTIC MoFFrm_Rx_DataPdu_AYCF.maskAlvCntr_C "Structure instance of PDU AYCF / Alive counter start bit position of Rx data PDU" VALUE 0x8053CBA4 Val_Wu8 255.0 OneToOne 0.00 255.0 FORMAT "%5.1" /end CHARACTERISTIC
/begin CHARACTERISTIC MoFFrm_Rx_DataPdu_AYCF.posnAlvCntrStrtBit_C "Structure instance of PDU AYCF / Alive counter start bit calibration of of Data PDU Rx" VALUE 0x8053CBA6 Val_Wu16 65535.00 OneToOne 0.00 65535.00 FORMAT "%8.2" READ_ONLY /end CHARACTERISTIC
/begin CHARACTERISTIC MoFFrm_Rx_DataPdu_AYCF.posnCrcCalcEndByte_C "Structure instance of PDU AYCF / End byte of CRC calculation position of Data PDU Rx" VALUE 0x8053CBA8 Val_Wu8 255.0 OneToOne 0.00 255.0 FORMAT "%5.1" /end CHARACTERISTIC
/begin CHARACTERISTIC MoFFrm_Rx_DataPdu_AYCF.posnCrcCalcStrtByte_C "Structure instance of PDU AYCF / Start byte of CRC calculation position of Data PDU Rx" VALUE 0x8053CBA9 Val_Wu8 255.0 OneToOne 0.00 255.0 FORMAT "%5.1" /end CHARACTERISTIC
/begin CHARACTERISTIC MoFFrm_Rx_DataPdu_AYCF.posnCrcStrtBit_C "Structure instance of PDU AYCF / CRC start bit position of Rx data PDU" VALUE 0x8053CBAA Val_Wu16 65535.00 OneToOne 0.00 65535.00 FORMAT "%8.2" READ_ONLY /end CHARACTERISTIC
/begin CHARACTERISTIC MoFFrm_Rx_DataPdu_AYCF.sigLenAlvCntr_C "Structure instance of PDU AYCF / Alive counter signal length of Rx data PDU" VALUE 0x8053CBAC Val_Wu8 31.00 OneToOne 1.00 32.00 FORMAT "%5.2" EXTENDED_LIMITS 0.00 255.0 READ_ONLY /end CHARACTERISTIC
/begin CHARACTERISTIC MoFFrm_Rx_DataPdu_AYCF.sigLenCrc_C "Structure instance of PDU AYCF / CRC calibration signal length of Rx data PDU" VALUE 0x8053CBAD Val_Wu8 31.00 OneToOne 1.00 32.00 FORMAT "%5.2" EXTENDED_LIMITS 0.00 255.0 READ_ONLY /end CHARACTERISTIC
/begin CHARACTERISTIC MoFFrm_Rx_DataPdu_EAT1.bufLen_C "Structure instance of PDU EAT1 / parameter to indicate the buffer length of the receiving PDU" VALUE 0x8053CBB8 Val_Wu8 255.0 OneToOne 0.00 255.0 FORMAT "%5.1" READ_ONLY /end CHARACTERISTIC
/begin CHARACTERISTIC MoFFrm_Rx_DataPdu_EAT1.bytOrderAlvCntr_C "Structure instance of PDU EAT1 / Alive counter calibration of RX Data Pdu" VALUE 0x8053CBB9 Val_Wu8 1.000 OneToOne 0.00 1.000 FORMAT "%5.3" EXTENDED_LIMITS 0.00 255.0 READ_ONLY /end CHARACTERISTIC
/begin CHARACTERISTIC MoFFrm_Rx_DataPdu_EAT1.bytOrderCrc_C "Structure instance of PDU EAT1 / CRC calibration of RX Data Pdu" VALUE 0x8053CBBA Val_Wu8 1.000 OneToOne 0.00 1.000 FORMAT "%5.3" EXTENDED_LIMITS 0.00 255.0 READ_ONLY /end CHARACTERISTIC
/begin CHARACTERISTIC MoFFrm_Rx_DataPdu_EAT1.cntrAlvErrDeb_C "Structure instance of PDU EAT1 / Alive counter debounce error calibration of RX Data Pdu" VALUE 0x8053CBBC Val_Wu16 65535.00 OneToOne 0.00 65535.00 FORMAT "%8.2" /end CHARACTERISTIC
/begin CHARACTERISTIC MoFFrm_Rx_DataPdu_EAT1.cntrCrcErrDeb_C "Structure instance of PDU EAT1 / Alive counter debounce error calibration of RX Data Pdu" VALUE 0x8053CBBE Val_Wu16 65535.00 OneToOne 0.00 65535.00 FORMAT "%8.2" /end CHARACTERISTIC
/begin CHARACTERISTIC MoFFrm_Rx_DataPdu_EAT1.cntrMaxAlvDif_C "Structure instance of PDU EAT1 / Complement of Counter cyclic calibration of RX Data Pdu" VALUE 0x8053CBC0 Val_Wu8 255.0 OneToOne 0.00 255.0 FORMAT "%5.1" /end CHARACTERISTIC
/begin CHARACTERISTIC MoFFrm_Rx_DataPdu_EAT1.cntrTiOutDeb_C "Structure instance of PDU EAT1 / Counter time out debounce calibration of Rx data PDU" VALUE 0x8053CBC2 Val_Wu16 65535.00 OneToOne 0.00 65535.00 FORMAT "%8.2" /end CHARACTERISTIC
/begin CHARACTERISTIC MoFFrm_Rx_DataPdu_EAT1.crcId_C "Structure instance of PDU EAT1 / CRC ID of Rx data PDU" VALUE 0x8053CBC4 Val_Wu32 4294967295.00 OneToOne 0.00 4294967295.00 FORMAT "%13.2" /end CHARACTERISTIC
/begin CHARACTERISTIC MoFFrm_Rx_DataPdu_EAT1.cycTi_C "Structure instance of PDU EAT1 / cycle time from bus matrix" VALUE 0x8053CBC8 Val_Wu16 65535.00 OneToOne 0.00 65535.00 FORMAT "%8.2" READ_ONLY /end CHARACTERISTIC
/begin CHARACTERISTIC MoFFrm_Rx_DataPdu_EAT1.diChks_C "Structure instance of PDU EAT1 / parameter to enable or disable manipulation of various checks" VALUE 0x8053CBCA Val_Wu8 255.0 OneToOne 0.00 255.0 FORMAT "%5.1" /end CHARACTERISTIC
/begin CHARACTERISTIC MoFFrm_Rx_DataPdu_EAT1.evalType_C "Structure instance of PDU EAT1 / evaluation type" VALUE 0x8053CBCB Val_Wu8 255.0 OneToOne 0.00 255.0 FORMAT "%5.1" READ_ONLY /end CHARACTERISTIC
/begin CHARACTERISTIC MoFFrm_Rx_DataPdu_EAT1.maskAlvCntr_C "Structure instance of PDU EAT1 / Alive counter start bit position of Rx data PDU" VALUE 0x8053CBCC Val_Wu8 255.0 OneToOne 0.00 255.0 FORMAT "%5.1" /end CHARACTERISTIC
/begin CHARACTERISTIC MoFFrm_Rx_DataPdu_EAT1.posnAlvCntrStrtBit_C "Structure instance of PDU EAT1 / Alive counter start bit calibration of of Data PDU Rx" VALUE 0x8053CBCE Val_Wu16 65535.00 OneToOne 0.00 65535.00 FORMAT "%8.2" READ_ONLY /end CHARACTERISTIC
/begin CHARACTERISTIC MoFFrm_Rx_DataPdu_EAT1.posnCrcCalcEndByte_C "Structure instance of PDU EAT1 / End byte of CRC calculation position of Data PDU Rx" VALUE 0x8053CBD0 Val_Wu8 255.0 OneToOne 0.00 255.0 FORMAT "%5.1" /end CHARACTERISTIC
/begin CHARACTERISTIC MoFFrm_Rx_DataPdu_EAT1.posnCrcCalcStrtByte_C "Structure instance of PDU EAT1 / Start byte of CRC calculation position of Data PDU Rx" VALUE 0x8053CBD1 Val_Wu8 255.0 OneToOne 0.00 255.0 FORMAT "%5.1" /end CHARACTERISTIC
/begin CHARACTERISTIC MoFFrm_Rx_DataPdu_EAT1.posnCrcStrtBit_C "Structure instance of PDU EAT1 / CRC start bit position of Rx data PDU" VALUE 0x8053CBD2 Val_Wu16 65535.00 OneToOne 0.00 65535.00 FORMAT "%8.2" READ_ONLY /end CHARACTERISTIC
/begin CHARACTERISTIC MoFFrm_Rx_DataPdu_EAT1.sigLenAlvCntr_C "Structure instance of PDU EAT1 / Alive counter signal length of Rx data PDU" VALUE 0x8053CBD4 Val_Wu8 31.00 OneToOne 1.00 32.00 FORMAT "%5.2" EXTENDED_LIMITS 0.00 255.0 READ_ONLY /end CHARACTERISTIC
/begin CHARACTERISTIC MoFFrm_Rx_DataPdu_EAT1.sigLenCrc_C "Structure instance of PDU EAT1 / CRC calibration signal length of Rx data PDU" VALUE 0x8053CBD5 Val_Wu8 31.00 OneToOne 1.00 32.00 FORMAT "%5.2" EXTENDED_LIMITS 0.00 255.0 READ_ONLY /end CHARACTERISTIC
/begin CHARACTERISTIC MoFFrm_Rx_DataPdu_EAT12.bufLen_C "Data PDU of EAT12 / parameter to indicate the buffer length of the receiving PDU" VALUE 0x8053CBE0 Val_Wu8 255.0 OneToOne 0.00 255.0 FORMAT "%5.1" READ_ONLY /end CHARACTERISTIC
/begin CHARACTERISTIC MoFFrm_Rx_DataPdu_EAT12.bytOrderAlvCntr_C "Data PDU of EAT12 / Alive counter calibration of RX Data Pdu" VALUE 0x8053CBE1 Val_Wu8 1.000 OneToOne 0.00 1.000 FORMAT "%5.3" EXTENDED_LIMITS 0.00 255.0 READ_ONLY /end CHARACTERISTIC
/begin CHARACTERISTIC MoFFrm_Rx_DataPdu_EAT12.bytOrderCrc_C "Data PDU of EAT12 / CRC calibration of RX Data Pdu" VALUE 0x8053CBE2 Val_Wu8 1.000 OneToOne 0.00 1.000 FORMAT "%5.3" EXTENDED_LIMITS 0.00 255.0 READ_ONLY /end CHARACTERISTIC
/begin CHARACTERISTIC MoFFrm_Rx_DataPdu_EAT12.cntrAlvErrDeb_C "Data PDU of EAT12 / Alive counter debounce error calibration of RX Data Pdu" VALUE 0x8053CBE4 Val_Wu16 65535.00 OneToOne 0.00 65535.00 FORMAT "%8.2" /end CHARACTERISTIC
/begin CHARACTERISTIC MoFFrm_Rx_DataPdu_EAT12.cntrCrcErrDeb_C "Data PDU of EAT12 / Alive counter debounce error calibration of RX Data Pdu" VALUE 0x8053CBE6 Val_Wu16 65535.00 OneToOne 0.00 65535.00 FORMAT "%8.2" /end CHARACTERISTIC
/begin CHARACTERISTIC MoFFrm_Rx_DataPdu_EAT12.cntrMaxAlvDif_C "Data PDU of EAT12 / Complement of Counter cyclic calibration of RX Data Pdu" VALUE 0x8053CBE8 Val_Wu8 255.0 OneToOne 0.00 255.0 FORMAT "%5.1" /end CHARACTERISTIC
/begin CHARACTERISTIC MoFFrm_Rx_DataPdu_EAT12.cntrTiOutDeb_C "Data PDU of EAT12 / Counter time out debounce calibration of Rx data PDU" VALUE 0x8053CBEA Val_Wu16 65535.00 OneToOne 0.00 65535.00 FORMAT "%8.2" /end CHARACTERISTIC
/begin CHARACTERISTIC MoFFrm_Rx_DataPdu_EAT12.crcId_C "Data PDU of EAT12 / CRC ID of Rx data PDU" VALUE 0x8053CBEC Val_Wu32 4294967295.00 OneToOne 0.00 4294967295.00 FORMAT "%13.2" /end CHARACTERISTIC
/begin CHARACTERISTIC MoFFrm_Rx_DataPdu_EAT12.cycTi_C "Data PDU of EAT12 / cycle time from bus matrix" VALUE 0x8053CBF0 Val_Wu16 65535.00 OneToOne 0.00 65535.00 FORMAT "%8.2" READ_ONLY /end CHARACTERISTIC
/begin CHARACTERISTIC MoFFrm_Rx_DataPdu_EAT12.diChks_C "Data PDU of EAT12 / parameter to enable or disable manipulation of various checks" VALUE 0x8053CBF2 Val_Wu8 255.0 OneToOne 0.00 255.0 FORMAT "%5.1" /end CHARACTERISTIC
/begin CHARACTERISTIC MoFFrm_Rx_DataPdu_EAT12.evalType_C "Data PDU of EAT12 / evaluation type" VALUE 0x8053CBF3 Val_Wu8 255.0 OneToOne 0.00 255.0 FORMAT "%5.1" READ_ONLY /end CHARACTERISTIC
/begin CHARACTERISTIC MoFFrm_Rx_DataPdu_EAT12.maskAlvCntr_C "Data PDU of EAT12 / Alive counter start bit position of Rx data PDU" VALUE 0x8053CBF4 Val_Wu8 255.0 OneToOne 0.00 255.0 FORMAT "%5.1" /end CHARACTERISTIC
/begin CHARACTERISTIC MoFFrm_Rx_DataPdu_EAT12.posnAlvCntrStrtBit_C "Data PDU of EAT12 / Alive counter start bit calibration of of Data PDU Rx" VALUE 0x8053CBF6 Val_Wu16 65535.00 OneToOne 0.00 65535.00 FORMAT "%8.2" READ_ONLY /end CHARACTERISTIC
/begin CHARACTERISTIC MoFFrm_Rx_DataPdu_EAT12.posnCrcCalcEndByte_C "Data PDU of EAT12 / End byte of CRC calculation position of Data PDU Rx" VALUE 0x8053CBF8 Val_Wu8 255.0 OneToOne 0.00 255.0 FORMAT "%5.1" /end CHARACTERISTIC
/begin CHARACTERISTIC MoFFrm_Rx_DataPdu_EAT12.posnCrcCalcStrtByte_C "Data PDU of EAT12 / Start byte of CRC calculation position of Data PDU Rx" VALUE 0x8053CBF9 Val_Wu8 255.0 OneToOne 0.00 255.0 FORMAT "%5.1" /end CHARACTERISTIC
/begin CHARACTERISTIC MoFFrm_Rx_DataPdu_EAT12.posnCrcStrtBit_C "Data PDU of EAT12 / CRC start bit position of Rx data PDU" VALUE 0x8053CBFA Val_Wu16 65535.00 OneToOne 0.00 65535.00 FORMAT "%8.2" READ_ONLY /end CHARACTERISTIC
/begin CHARACTERISTIC MoFFrm_Rx_DataPdu_EAT12.sigLenAlvCntr_C "Data PDU of EAT12 / Alive counter signal length of Rx data PDU" VALUE 0x8053CBFC Val_Wu8 31.00 OneToOne 1.00 32.00 FORMAT "%5.2" EXTENDED_LIMITS 0.00 255.0 READ_ONLY /end CHARACTERISTIC
/begin CHARACTERISTIC MoFFrm_Rx_DataPdu_EAT12.sigLenCrc_C "Data PDU of EAT12 / CRC calibration signal length of Rx data PDU" VALUE 0x8053CBFD Val_Wu8 31.00 OneToOne 1.00 32.00 FORMAT "%5.2" EXTENDED_LIMITS 0.00 255.0 READ_ONLY /end CHARACTERISTIC
/begin CHARACTERISTIC MoFFrm_Rx_DataPdu_EAT13.bufLen_C "Data PDU of EAT13 / parameter to indicate the buffer length of the receiving PDU" VALUE 0x8053CC08 Val_Wu8 255.0 OneToOne 0.00 255.0 FORMAT "%5.1" READ_ONLY /end CHARACTERISTIC
/begin CHARACTERISTIC MoFFrm_Rx_DataPdu_EAT13.bytOrderAlvCntr_C "Data PDU of EAT13 / Alive counter calibration of RX Data Pdu" VALUE 0x8053CC09 Val_Wu8 1.000 OneToOne 0.00 1.000 FORMAT "%5.3" EXTENDED_LIMITS 0.00 255.0 READ_ONLY /end CHARACTERISTIC
/begin CHARACTERISTIC MoFFrm_Rx_DataPdu_EAT13.bytOrderCrc_C "Data PDU of EAT13 / CRC calibration of RX Data Pdu" VALUE 0x8053CC0A Val_Wu8 1.000 OneToOne 0.00 1.000 FORMAT "%5.3" EXTENDED_LIMITS 0.00 255.0 READ_ONLY /end CHARACTERISTIC
/begin CHARACTERISTIC MoFFrm_Rx_DataPdu_EAT13.cntrAlvErrDeb_C "Data PDU of EAT13 / Alive counter debounce error calibration of RX Data Pdu" VALUE 0x8053CC0C Val_Wu16 65535.00 OneToOne 0.00 65535.00 FORMAT "%8.2" /end CHARACTERISTIC
/begin CHARACTERISTIC MoFFrm_Rx_DataPdu_EAT13.cntrCrcErrDeb_C "Data PDU of EAT13 / Alive counter debounce error calibration of RX Data Pdu" VALUE 0x8053CC0E Val_Wu16 65535.00 OneToOne 0.00 65535.00 FORMAT "%8.2" /end CHARACTERISTIC
/begin CHARACTERISTIC MoFFrm_Rx_DataPdu_EAT13.cntrMaxAlvDif_C "Data PDU of EAT13 / Complement of Counter cyclic calibration of RX Data Pdu" VALUE 0x8053CC10 Val_Wu8 255.0 OneToOne 0.00 255.0 FORMAT "%5.1" /end CHARACTERISTIC
/begin CHARACTERISTIC MoFFrm_Rx_DataPdu_EAT13.cntrTiOutDeb_C "Data PDU of EAT13 / Counter time out debounce calibration of Rx data PDU" VALUE 0x8053CC12 Val_Wu16 65535.00 OneToOne 0.00 65535.00 FORMAT "%8.2" /end CHARACTERISTIC
/begin CHARACTERISTIC MoFFrm_Rx_DataPdu_EAT13.crcId_C "Data PDU of EAT13 / CRC ID of Rx data PDU" VALUE 0x8053CC14 Val_Wu32 4294967295.00 OneToOne 0.00 4294967295.00 FORMAT "%13.2" /end CHARACTERISTIC
/begin CHARACTERISTIC MoFFrm_Rx_DataPdu_EAT13.cycTi_C "Data PDU of EAT13 / cycle time from bus matrix" VALUE 0x8053CC18 Val_Wu16 65535.00 OneToOne 0.00 65535.00 FORMAT "%8.2" READ_ONLY /end CHARACTERISTIC
/begin CHARACTERISTIC MoFFrm_Rx_DataPdu_EAT13.diChks_C "Data PDU of EAT13 / parameter to enable or disable manipulation of various checks" VALUE 0x8053CC1A Val_Wu8 255.0 OneToOne 0.00 255.0 FORMAT "%5.1" /end CHARACTERISTIC
/begin CHARACTERISTIC MoFFrm_Rx_DataPdu_EAT13.evalType_C "Data PDU of EAT13 / evaluation type" VALUE 0x8053CC1B Val_Wu8 255.0 OneToOne 0.00 255.0 FORMAT "%5.1" READ_ONLY /end CHARACTERISTIC
/begin CHARACTERISTIC MoFFrm_Rx_DataPdu_EAT13.maskAlvCntr_C "Data PDU of EAT13 / Alive counter start bit position of Rx data PDU" VALUE 0x8053CC1C Val_Wu8 255.0 OneToOne 0.00 255.0 FORMAT "%5.1" /end CHARACTERISTIC
/begin CHARACTERISTIC MoFFrm_Rx_DataPdu_EAT13.posnAlvCntrStrtBit_C "Data PDU of EAT13 / Alive counter start bit calibration of of Data PDU Rx" VALUE 0x8053CC1E Val_Wu16 65535.00 OneToOne 0.00 65535.00 FORMAT "%8.2" READ_ONLY /end CHARACTERISTIC
/begin CHARACTERISTIC MoFFrm_Rx_DataPdu_EAT13.posnCrcCalcEndByte_C "Data PDU of EAT13 / End byte of CRC calculation position of Data PDU Rx" VALUE 0x8053CC20 Val_Wu8 255.0 OneToOne 0.00 255.0 FORMAT "%5.1" /end CHARACTERISTIC
/begin CHARACTERISTIC MoFFrm_Rx_DataPdu_EAT13.posnCrcCalcStrtByte_C "Data PDU of EAT13 / Start byte of CRC calculation position of Data PDU Rx" VALUE 0x8053CC21 Val_Wu8 255.0 OneToOne 0.00 255.0 FORMAT "%5.1" /end CHARACTERISTIC
/begin CHARACTERISTIC MoFFrm_Rx_DataPdu_EAT13.posnCrcStrtBit_C "Data PDU of EAT13 / CRC start bit position of Rx data PDU" VALUE 0x8053CC22 Val_Wu16 65535.00 OneToOne 0.00 65535.00 FORMAT "%8.2" READ_ONLY /end CHARACTERISTIC
/begin CHARACTERISTIC MoFFrm_Rx_DataPdu_EAT13.sigLenAlvCntr_C "Data PDU of EAT13 / Alive counter signal length of Rx data PDU" VALUE 0x8053CC24 Val_Wu8 31.00 OneToOne 1.00 32.00 FORMAT "%5.2" EXTENDED_LIMITS 0.00 255.0 READ_ONLY /end CHARACTERISTIC
/begin CHARACTERISTIC MoFFrm_Rx_DataPdu_EAT13.sigLenCrc_C "Data PDU of EAT13 / CRC calibration signal length of Rx data PDU" VALUE 0x8053CC25 Val_Wu8 31.00 OneToOne 1.00 32.00 FORMAT "%5.2" EXTENDED_LIMITS 0.00 255.0 READ_ONLY /end CHARACTERISTIC
/begin CHARACTERISTIC MoFFrm_Rx_DataPdu_EAT4.bufLen_C "Structure instance of PDU EAT4 / parameter to indicate the buffer length of the receiving PDU" VALUE 0x8053CC30 Val_Wu8 255.0 OneToOne 0.00 255.0 FORMAT "%5.1" READ_ONLY /end CHARACTERISTIC
/begin CHARACTERISTIC MoFFrm_Rx_DataPdu_EAT4.bytOrderAlvCntr_C "Structure instance of PDU EAT4 / Alive counter calibration of RX Data Pdu" VALUE 0x8053CC31 Val_Wu8 1.000 OneToOne 0.00 1.000 FORMAT "%5.3" EXTENDED_LIMITS 0.00 255.0 READ_ONLY /end CHARACTERISTIC
/begin CHARACTERISTIC MoFFrm_Rx_DataPdu_EAT4.bytOrderCrc_C "Structure instance of PDU EAT4 / CRC calibration of RX Data Pdu" VALUE 0x8053CC32 Val_Wu8 1.000 OneToOne 0.00 1.000 FORMAT "%5.3" EXTENDED_LIMITS 0.00 255.0 READ_ONLY /end CHARACTERISTIC
/begin CHARACTERISTIC MoFFrm_Rx_DataPdu_EAT4.cntrAlvErrDeb_C "Structure instance of PDU EAT4 / Alive counter debounce error calibration of RX Data Pdu" VALUE 0x8053CC34 Val_Wu16 65535.00 OneToOne 0.00 65535.00 FORMAT "%8.2" /end CHARACTERISTIC
/begin CHARACTERISTIC MoFFrm_Rx_DataPdu_EAT4.cntrCrcErrDeb_C "Structure instance of PDU EAT4 / Alive counter debounce error calibration of RX Data Pdu" VALUE 0x8053CC36 Val_Wu16 65535.00 OneToOne 0.00 65535.00 FORMAT "%8.2" /end CHARACTERISTIC
/begin CHARACTERISTIC MoFFrm_Rx_DataPdu_EAT4.cntrMaxAlvDif_C "Structure instance of PDU EAT4 / Complement of Counter cyclic calibration of RX Data Pdu" VALUE 0x8053CC38 Val_Wu8 255.0 OneToOne 0.00 255.0 FORMAT "%5.1" /end CHARACTERISTIC
/begin CHARACTERISTIC MoFFrm_Rx_DataPdu_EAT4.cntrTiOutDeb_C "Structure instance of PDU EAT4 / Counter time out debounce calibration of Rx data PDU" VALUE 0x8053CC3A Val_Wu16 65535.00 OneToOne 0.00 65535.00 FORMAT "%8.2" /end CHARACTERISTIC
/begin CHARACTERISTIC MoFFrm_Rx_DataPdu_EAT4.crcId_C "Structure instance of PDU EAT4 / CRC ID of Rx data PDU" VALUE 0x8053CC3C Val_Wu32 4294967295.00 OneToOne 0.00 4294967295.00 FORMAT "%13.2" /end CHARACTERISTIC
/begin CHARACTERISTIC MoFFrm_Rx_DataPdu_EAT4.cycTi_C "Structure instance of PDU EAT4 / cycle time from bus matrix" VALUE 0x8053CC40 Val_Wu16 65535.00 OneToOne 0.00 65535.00 FORMAT "%8.2" READ_ONLY /end CHARACTERISTIC
/begin CHARACTERISTIC MoFFrm_Rx_DataPdu_EAT4.diChks_C "Structure instance of PDU EAT4 / parameter to enable or disable manipulation of various checks" VALUE 0x8053CC42 Val_Wu8 255.0 OneToOne 0.00 255.0 FORMAT "%5.1" /end CHARACTERISTIC
/begin CHARACTERISTIC MoFFrm_Rx_DataPdu_EAT4.evalType_C "Structure instance of PDU EAT4 / evaluation type" VALUE 0x8053CC43 Val_Wu8 255.0 OneToOne 0.00 255.0 FORMAT "%5.1" READ_ONLY /end CHARACTERISTIC
/begin CHARACTERISTIC MoFFrm_Rx_DataPdu_EAT4.maskAlvCntr_C "Structure instance of PDU EAT4 / Alive counter start bit position of Rx data PDU" VALUE 0x8053CC44 Val_Wu8 255.0 OneToOne 0.00 255.0 FORMAT "%5.1" /end CHARACTERISTIC
/begin CHARACTERISTIC MoFFrm_Rx_DataPdu_EAT4.posnAlvCntrStrtBit_C "Structure instance of PDU EAT4 / Alive counter start bit calibration of of Data PDU Rx" VALUE 0x8053CC46 Val_Wu16 65535.00 OneToOne 0.00 65535.00 FORMAT "%8.2" READ_ONLY /end CHARACTERISTIC
/begin CHARACTERISTIC MoFFrm_Rx_DataPdu_EAT4.posnCrcCalcEndByte_C "Structure instance of PDU EAT4 / End byte of CRC calculation position of Data PDU Rx" VALUE 0x8053CC48 Val_Wu8 255.0 OneToOne 0.00 255.0 FORMAT "%5.1" /end CHARACTERISTIC
/begin CHARACTERISTIC MoFFrm_Rx_DataPdu_EAT4.posnCrcCalcStrtByte_C "Structure instance of PDU EAT4 / Start byte of CRC calculation position of Data PDU Rx" VALUE 0x8053CC49 Val_Wu8 255.0 OneToOne 0.00 255.0 FORMAT "%5.1" /end CHARACTERISTIC
/begin CHARACTERISTIC MoFFrm_Rx_DataPdu_EAT4.posnCrcStrtBit_C "Structure instance of PDU EAT4 / CRC start bit position of Rx data PDU" VALUE 0x8053CC4A Val_Wu16 65535.00 OneToOne 0.00 65535.00 FORMAT "%8.2" READ_ONLY /end CHARACTERISTIC
/begin CHARACTERISTIC MoFFrm_Rx_DataPdu_EAT4.sigLenAlvCntr_C "Structure instance of PDU EAT4 / Alive counter signal length of Rx data PDU" VALUE 0x8053CC4C Val_Wu8 31.00 OneToOne 1.00 32.00 FORMAT "%5.2" EXTENDED_LIMITS 0.00 255.0 READ_ONLY /end CHARACTERISTIC
/begin CHARACTERISTIC MoFFrm_Rx_DataPdu_EAT4.sigLenCrc_C "Structure instance of PDU EAT4 / CRC calibration signal length of Rx data PDU" VALUE 0x8053CC4D Val_Wu8 31.00 OneToOne 1.00 32.00 FORMAT "%5.2" EXTENDED_LIMITS 0.00 255.0 READ_ONLY /end CHARACTERISTIC
/begin CHARACTERISTIC MoFFrm_Rx_DataPdu_EATB.bufLen_C "Data PDU of EATB / parameter to indicate the buffer length of the receiving PDU" VALUE 0x8053CC58 Val_Wu8 255.0 OneToOne 0.00 255.0 FORMAT "%5.1" READ_ONLY /end CHARACTERISTIC
/begin CHARACTERISTIC MoFFrm_Rx_DataPdu_EATB.bytOrderAlvCntr_C "Data PDU of EATB / Alive counter calibration of RX Data Pdu" VALUE 0x8053CC59 Val_Wu8 1.000 OneToOne 0.00 1.000 FORMAT "%5.3" EXTENDED_LIMITS 0.00 255.0 READ_ONLY /end CHARACTERISTIC
/begin CHARACTERISTIC MoFFrm_Rx_DataPdu_EATB.bytOrderCrc_C "Data PDU of EATB / CRC calibration of RX Data Pdu" VALUE 0x8053CC5A Val_Wu8 1.000 OneToOne 0.00 1.000 FORMAT "%5.3" EXTENDED_LIMITS 0.00 255.0 READ_ONLY /end CHARACTERISTIC
/begin CHARACTERISTIC MoFFrm_Rx_DataPdu_EATB.cntrAlvErrDeb_C "Data PDU of EATB / Alive counter debounce error calibration of RX Data Pdu" VALUE 0x8053CC5C Val_Wu16 65535.00 OneToOne 0.00 65535.00 FORMAT "%8.2" /end CHARACTERISTIC
/begin CHARACTERISTIC MoFFrm_Rx_DataPdu_EATB.cntrCrcErrDeb_C "Data PDU of EATB / Alive counter debounce error calibration of RX Data Pdu" VALUE 0x8053CC5E Val_Wu16 65535.00 OneToOne 0.00 65535.00 FORMAT "%8.2" /end CHARACTERISTIC
/begin CHARACTERISTIC MoFFrm_Rx_DataPdu_EATB.cntrMaxAlvDif_C "Data PDU of EATB / Complement of Counter cyclic calibration of RX Data Pdu" VALUE 0x8053CC60 Val_Wu8 255.0 OneToOne 0.00 255.0 FORMAT "%5.1" /end CHARACTERISTIC
/begin CHARACTERISTIC MoFFrm_Rx_DataPdu_EATB.cntrTiOutDeb_C "Data PDU of EATB / Counter time out debounce calibration of Rx data PDU" VALUE 0x8053CC62 Val_Wu16 65535.00 OneToOne 0.00 65535.00 FORMAT "%8.2" /end CHARACTERISTIC
/begin CHARACTERISTIC MoFFrm_Rx_DataPdu_EATB.crcId_C "Data PDU of EATB / CRC ID of Rx data PDU" VALUE 0x8053CC64 Val_Wu32 4294967295.00 OneToOne 0.00 4294967295.00 FORMAT "%13.2" /end CHARACTERISTIC
/begin CHARACTERISTIC MoFFrm_Rx_DataPdu_EATB.cycTi_C "Data PDU of EATB / cycle time from bus matrix" VALUE 0x8053CC68 Val_Wu16 65535.00 OneToOne 0.00 65535.00 FORMAT "%8.2" READ_ONLY /end CHARACTERISTIC
/begin CHARACTERISTIC MoFFrm_Rx_DataPdu_EATB.diChks_C "Data PDU of EATB / parameter to enable or disable manipulation of various checks" VALUE 0x8053CC6A Val_Wu8 255.0 OneToOne 0.00 255.0 FORMAT "%5.1" /end CHARACTERISTIC
/begin CHARACTERISTIC MoFFrm_Rx_DataPdu_EATB.evalType_C "Data PDU of EATB / evaluation type" VALUE 0x8053CC6B Val_Wu8 255.0 OneToOne 0.00 255.0 FORMAT "%5.1" READ_ONLY /end CHARACTERISTIC
/begin CHARACTERISTIC MoFFrm_Rx_DataPdu_EATB.maskAlvCntr_C "Data PDU of EATB / Alive counter start bit position of Rx data PDU" VALUE 0x8053CC6C Val_Wu8 255.0 OneToOne 0.00 255.0 FORMAT "%5.1" /end CHARACTERISTIC
/begin CHARACTERISTIC MoFFrm_Rx_DataPdu_EATB.posnAlvCntrStrtBit_C "Data PDU of EATB / Alive counter start bit calibration of of Data PDU Rx" VALUE 0x8053CC6E Val_Wu16 65535.00 OneToOne 0.00 65535.00 FORMAT "%8.2" READ_ONLY /end CHARACTERISTIC
/begin CHARACTERISTIC MoFFrm_Rx_DataPdu_EATB.posnCrcCalcEndByte_C "Data PDU of EATB / End byte of CRC calculation position of Data PDU Rx" VALUE 0x8053CC70 Val_Wu8 255.0 OneToOne 0.00 255.0 FORMAT "%5.1" /end CHARACTERISTIC
/begin CHARACTERISTIC MoFFrm_Rx_DataPdu_EATB.posnCrcCalcStrtByte_C "Data PDU of EATB / Start byte of CRC calculation position of Data PDU Rx" VALUE 0x8053CC71 Val_Wu8 255.0 OneToOne 0.00 255.0 FORMAT "%5.1" /end CHARACTERISTIC
/begin CHARACTERISTIC MoFFrm_Rx_DataPdu_EATB.posnCrcStrtBit_C "Data PDU of EATB / CRC start bit position of Rx data PDU" VALUE 0x8053CC72 Val_Wu16 65535.00 OneToOne 0.00 65535.00 FORMAT "%8.2" READ_ONLY /end CHARACTERISTIC
/begin CHARACTERISTIC MoFFrm_Rx_DataPdu_EATB.sigLenAlvCntr_C "Data PDU of EATB / Alive counter signal length of Rx data PDU" VALUE 0x8053CC74 Val_Wu8 31.00 OneToOne 1.00 32.00 FORMAT "%5.2" EXTENDED_LIMITS 0.00 255.0 READ_ONLY /end CHARACTERISTIC
/begin CHARACTERISTIC MoFFrm_Rx_DataPdu_EATB.sigLenCrc_C "Data PDU of EATB / CRC calibration signal length of Rx data PDU" VALUE 0x8053CC75 Val_Wu8 31.00 OneToOne 1.00 32.00 FORMAT "%5.2" EXTENDED_LIMITS 0.00 255.0 READ_ONLY /end CHARACTERISTIC
/begin CHARACTERISTIC MoFFrm_Rx_DataPdu_GWIMG3.bufLen_C "Data PDU of GWIMG3 / parameter to indicate the buffer length of the receiving PDU" VALUE 0x8053CC80 Val_Wu8 255.0 OneToOne 0.00 255.0 FORMAT "%5.1" READ_ONLY /end CHARACTERISTIC
/begin CHARACTERISTIC MoFFrm_Rx_DataPdu_GWIMG3.bytOrderAlvCntr_C "Data PDU of GWIMG3 / Alive counter calibration of RX Data Pdu" VALUE 0x8053CC81 Val_Wu8 1.000 OneToOne 0.00 1.000 FORMAT "%5.3" EXTENDED_LIMITS 0.00 255.0 READ_ONLY /end CHARACTERISTIC
/begin CHARACTERISTIC MoFFrm_Rx_DataPdu_GWIMG3.bytOrderCrc_C "Data PDU of GWIMG3 / CRC calibration of RX Data Pdu" VALUE 0x8053CC82 Val_Wu8 1.000 OneToOne 0.00 1.000 FORMAT "%5.3" EXTENDED_LIMITS 0.00 255.0 READ_ONLY /end CHARACTERISTIC
/begin CHARACTERISTIC MoFFrm_Rx_DataPdu_GWIMG3.cntrAlvErrDeb_C "Data PDU of GWIMG3 / Alive counter debounce error calibration of RX Data Pdu" VALUE 0x8053CC84 Val_Wu16 65535.00 OneToOne 0.00 65535.00 FORMAT "%8.2" /end CHARACTERISTIC
/begin CHARACTERISTIC MoFFrm_Rx_DataPdu_GWIMG3.cntrCrcErrDeb_C "Data PDU of GWIMG3 / Alive counter debounce error calibration of RX Data Pdu" VALUE 0x8053CC86 Val_Wu16 65535.00 OneToOne 0.00 65535.00 FORMAT "%8.2" /end CHARACTERISTIC
/begin CHARACTERISTIC MoFFrm_Rx_DataPdu_GWIMG3.cntrMaxAlvDif_C "Data PDU of GWIMG3 / Complement of Counter cyclic calibration of RX Data Pdu" VALUE 0x8053CC88 Val_Wu8 255.0 OneToOne 0.00 255.0 FORMAT "%5.1" /end CHARACTERISTIC
/begin CHARACTERISTIC MoFFrm_Rx_DataPdu_GWIMG3.cntrTiOutDeb_C "Data PDU of GWIMG3 / Counter time out debounce calibration of Rx data PDU" VALUE 0x8053CC8A Val_Wu16 65535.00 OneToOne 0.00 65535.00 FORMAT "%8.2" /end CHARACTERISTIC
/begin CHARACTERISTIC MoFFrm_Rx_DataPdu_GWIMG3.crcId_C "Data PDU of GWIMG3 / CRC ID of Rx data PDU" VALUE 0x8053CC8C Val_Wu32 4294967295.00 OneToOne 0.00 4294967295.00 FORMAT "%13.2" /end CHARACTERISTIC
/begin CHARACTERISTIC MoFFrm_Rx_DataPdu_GWIMG3.cycTi_C "Data PDU of GWIMG3 / cycle time from bus matrix" VALUE 0x8053CC90 Val_Wu16 65535.00 OneToOne 0.00 65535.00 FORMAT "%8.2" READ_ONLY /end CHARACTERISTIC
/begin CHARACTERISTIC MoFFrm_Rx_DataPdu_GWIMG3.diChks_C "Data PDU of GWIMG3 / parameter to enable or disable manipulation of various checks" VALUE 0x8053CC92 Val_Wu8 255.0 OneToOne 0.00 255.0 FORMAT "%5.1" /end CHARACTERISTIC
/begin CHARACTERISTIC MoFFrm_Rx_DataPdu_GWIMG3.evalType_C "Data PDU of GWIMG3 / evaluation type" VALUE 0x8053CC93 Val_Wu8 255.0 OneToOne 0.00 255.0 FORMAT "%5.1" READ_ONLY /end CHARACTERISTIC
/begin CHARACTERISTIC MoFFrm_Rx_DataPdu_GWIMG3.maskAlvCntr_C "Data PDU of GWIMG3 / Alive counter start bit position of Rx data PDU" VALUE 0x8053CC94 Val_Wu8 255.0 OneToOne 0.00 255.0 FORMAT "%5.1" /end CHARACTERISTIC
/begin CHARACTERISTIC MoFFrm_Rx_DataPdu_GWIMG3.posnAlvCntrStrtBit_C "Data PDU of GWIMG3 / Alive counter start bit calibration of of Data PDU Rx" VALUE 0x8053CC96 Val_Wu16 65535.00 OneToOne 0.00 65535.00 FORMAT "%8.2" READ_ONLY /end CHARACTERISTIC
/begin CHARACTERISTIC MoFFrm_Rx_DataPdu_GWIMG3.posnCrcCalcEndByte_C "Data PDU of GWIMG3 / End byte of CRC calculation position of Data PDU Rx" VALUE 0x8053CC98 Val_Wu8 255.0 OneToOne 0.00 255.0 FORMAT "%5.1" /end CHARACTERISTIC
/begin CHARACTERISTIC MoFFrm_Rx_DataPdu_GWIMG3.posnCrcCalcStrtByte_C "Data PDU of GWIMG3 / Start byte of CRC calculation position of Data PDU Rx" VALUE 0x8053CC99 Val_Wu8 255.0 OneToOne 0.00 255.0 FORMAT "%5.1" /end CHARACTERISTIC
/begin CHARACTERISTIC MoFFrm_Rx_DataPdu_GWIMG3.posnCrcStrtBit_C "Data PDU of GWIMG3 / CRC start bit position of Rx data PDU" VALUE 0x8053CC9A Val_Wu16 65535.00 OneToOne 0.00 65535.00 FORMAT "%8.2" READ_ONLY /end CHARACTERISTIC
/begin CHARACTERISTIC MoFFrm_Rx_DataPdu_GWIMG3.sigLenAlvCntr_C "Data PDU of GWIMG3 / Alive counter signal length of Rx data PDU" VALUE 0x8053CC9C Val_Wu8 31.00 OneToOne 1.00 32.00 FORMAT "%5.2" EXTENDED_LIMITS 0.00 255.0 READ_ONLY /end CHARACTERISTIC
/begin CHARACTERISTIC MoFFrm_Rx_DataPdu_GWIMG3.sigLenCrc_C "Data PDU of GWIMG3 / CRC calibration signal length of Rx data PDU" VALUE 0x8053CC9D Val_Wu8 31.00 OneToOne 1.00 32.00 FORMAT "%5.2" EXTENDED_LIMITS 0.00 255.0 READ_ONLY /end CHARACTERISTIC
/begin CHARACTERISTIC MoFFrm_Rx_DataPdu_META.bufLen_C "Structure instance of PDU META / parameter to indicate the buffer length of the receiving PDU" VALUE 0x8053CCA8 Val_Wu8 255.0 OneToOne 0.00 255.0 FORMAT "%5.1" READ_ONLY /end CHARACTERISTIC
/begin CHARACTERISTIC MoFFrm_Rx_DataPdu_META.bytOrderAlvCntr_C "Structure instance of PDU META / Alive counter calibration of RX Data Pdu" VALUE 0x8053CCA9 Val_Wu8 1.000 OneToOne 0.00 1.000 FORMAT "%5.3" EXTENDED_LIMITS 0.00 255.0 READ_ONLY /end CHARACTERISTIC
/begin CHARACTERISTIC MoFFrm_Rx_DataPdu_META.bytOrderCrc_C "Structure instance of PDU META / CRC calibration of RX Data Pdu" VALUE 0x8053CCAA Val_Wu8 1.000 OneToOne 0.00 1.000 FORMAT "%5.3" EXTENDED_LIMITS 0.00 255.0 READ_ONLY /end CHARACTERISTIC
/begin CHARACTERISTIC MoFFrm_Rx_DataPdu_META.cntrAlvErrDeb_C "Structure instance of PDU META / Alive counter debounce error calibration of RX Data Pdu" VALUE 0x8053CCAC Val_Wu16 65535.00 OneToOne 0.00 65535.00 FORMAT "%8.2" /end CHARACTERISTIC
/begin CHARACTERISTIC MoFFrm_Rx_DataPdu_META.cntrCrcErrDeb_C "Structure instance of PDU META / Alive counter debounce error calibration of RX Data Pdu" VALUE 0x8053CCAE Val_Wu16 65535.00 OneToOne 0.00 65535.00 FORMAT "%8.2" /end CHARACTERISTIC
/begin CHARACTERISTIC MoFFrm_Rx_DataPdu_META.cntrMaxAlvDif_C "Structure instance of PDU META / Complement of Counter cyclic calibration of RX Data Pdu" VALUE 0x8053CCB0 Val_Wu8 255.0 OneToOne 0.00 255.0 FORMAT "%5.1" /end CHARACTERISTIC
/begin CHARACTERISTIC MoFFrm_Rx_DataPdu_META.cntrTiOutDeb_C "Structure instance of PDU META / Counter time out debounce calibration of Rx data PDU" VALUE 0x8053CCB2 Val_Wu16 65535.00 OneToOne 0.00 65535.00 FORMAT "%8.2" /end CHARACTERISTIC
/begin CHARACTERISTIC MoFFrm_Rx_DataPdu_META.crcId_C "Structure instance of PDU META / CRC ID of Rx data PDU" VALUE 0x8053CCB4 Val_Wu32 4294967295.00 OneToOne 0.00 4294967295.00 FORMAT "%13.2" /end CHARACTERISTIC
/begin CHARACTERISTIC MoFFrm_Rx_DataPdu_META.cycTi_C "Structure instance of PDU META / cycle time from bus matrix" VALUE 0x8053CCB8 Val_Wu16 65535.00 OneToOne 0.00 65535.00 FORMAT "%8.2" READ_ONLY /end CHARACTERISTIC
/begin CHARACTERISTIC MoFFrm_Rx_DataPdu_META.diChks_C "Structure instance of PDU META / parameter to enable or disable manipulation of various checks" VALUE 0x8053CCBA Val_Wu8 255.0 OneToOne 0.00 255.0 FORMAT "%5.1" /end CHARACTERISTIC
/begin CHARACTERISTIC MoFFrm_Rx_DataPdu_META.evalType_C "Structure instance of PDU META / evaluation type" VALUE 0x8053CCBB Val_Wu8 255.0 OneToOne 0.00 255.0 FORMAT "%5.1" READ_ONLY /end CHARACTERISTIC
/begin CHARACTERISTIC MoFFrm_Rx_DataPdu_META.maskAlvCntr_C "Structure instance of PDU META / Alive counter start bit position of Rx data PDU" VALUE 0x8053CCBC Val_Wu8 255.0 OneToOne 0.00 255.0 FORMAT "%5.1" /end CHARACTERISTIC
/begin CHARACTERISTIC MoFFrm_Rx_DataPdu_META.posnAlvCntrStrtBit_C "Structure instance of PDU META / Alive counter start bit calibration of of Data PDU Rx" VALUE 0x8053CCBE Val_Wu16 65535.00 OneToOne 0.00 65535.00 FORMAT "%8.2" READ_ONLY /end CHARACTERISTIC
/begin CHARACTERISTIC MoFFrm_Rx_DataPdu_META.posnCrcCalcEndByte_C "Structure instance of PDU META / End byte of CRC calculation position of Data PDU Rx" VALUE 0x8053CCC0 Val_Wu8 255.0 OneToOne 0.00 255.0 FORMAT "%5.1" /end CHARACTERISTIC
/begin CHARACTERISTIC MoFFrm_Rx_DataPdu_META.posnCrcCalcStrtByte_C "Structure instance of PDU META / Start byte of CRC calculation position of Data PDU Rx" VALUE 0x8053CCC1 Val_Wu8 255.0 OneToOne 0.00 255.0 FORMAT "%5.1" /end CHARACTERISTIC
/begin CHARACTERISTIC MoFFrm_Rx_DataPdu_META.posnCrcStrtBit_C "Structure instance of PDU META / CRC start bit position of Rx data PDU" VALUE 0x8053CCC2 Val_Wu16 65535.00 OneToOne 0.00 65535.00 FORMAT "%8.2" READ_ONLY /end CHARACTERISTIC
/begin CHARACTERISTIC MoFFrm_Rx_DataPdu_META.sigLenAlvCntr_C "Structure instance of PDU META / Alive counter signal length of Rx data PDU" VALUE 0x8053CCC4 Val_Wu8 31.00 OneToOne 1.00 32.00 FORMAT "%5.2" EXTENDED_LIMITS 0.00 255.0 READ_ONLY /end CHARACTERISTIC
/begin CHARACTERISTIC MoFFrm_Rx_DataPdu_META.sigLenCrc_C "Structure instance of PDU META / CRC calibration signal length of Rx data PDU" VALUE 0x8053CCC5 Val_Wu8 31.00 OneToOne 1.00 32.00 FORMAT "%5.2" EXTENDED_LIMITS 0.00 255.0 READ_ONLY /end CHARACTERISTIC
/begin CHARACTERISTIC MoFFrm_Rx_DataPdu_METL.bufLen_C "Structure instance of PDU METL / parameter to indicate the buffer length of the receiving PDU" VALUE 0x8053CCD0 Val_Wu8 255.0 OneToOne 0.00 255.0 FORMAT "%5.1" READ_ONLY /end CHARACTERISTIC
/begin CHARACTERISTIC MoFFrm_Rx_DataPdu_METL.bytOrderAlvCntr_C "Structure instance of PDU METL / Alive counter calibration of RX Data Pdu" VALUE 0x8053CCD1 Val_Wu8 1.000 OneToOne 0.00 1.000 FORMAT "%5.3" EXTENDED_LIMITS 0.00 255.0 READ_ONLY /end CHARACTERISTIC
/begin CHARACTERISTIC MoFFrm_Rx_DataPdu_METL.bytOrderCrc_C "Structure instance of PDU METL / CRC calibration of RX Data Pdu" VALUE 0x8053CCD2 Val_Wu8 1.000 OneToOne 0.00 1.000 FORMAT "%5.3" EXTENDED_LIMITS 0.00 255.0 READ_ONLY /end CHARACTERISTIC
/begin CHARACTERISTIC MoFFrm_Rx_DataPdu_METL.cntrAlvErrDeb_C "Structure instance of PDU METL / Alive counter debounce error calibration of RX Data Pdu" VALUE 0x8053CCD4 Val_Wu16 65535.00 OneToOne 0.00 65535.00 FORMAT "%8.2" /end CHARACTERISTIC
/begin CHARACTERISTIC MoFFrm_Rx_DataPdu_METL.cntrCrcErrDeb_C "Structure instance of PDU METL / Alive counter debounce error calibration of RX Data Pdu" VALUE 0x8053CCD6 Val_Wu16 65535.00 OneToOne 0.00 65535.00 FORMAT "%8.2" /end CHARACTERISTIC
/begin CHARACTERISTIC MoFFrm_Rx_DataPdu_METL.cntrMaxAlvDif_C "Structure instance of PDU METL / Complement of Counter cyclic calibration of RX Data Pdu" VALUE 0x8053CCD8 Val_Wu8 255.0 OneToOne 0.00 255.0 FORMAT "%5.1" /end CHARACTERISTIC
/begin CHARACTERISTIC MoFFrm_Rx_DataPdu_METL.cntrTiOutDeb_C "Structure instance of PDU METL / Counter time out debounce calibration of Rx data PDU" VALUE 0x8053CCDA Val_Wu16 65535.00 OneToOne 0.00 65535.00 FORMAT "%8.2" /end CHARACTERISTIC
/begin CHARACTERISTIC MoFFrm_Rx_DataPdu_METL.crcId_C "Structure instance of PDU METL / CRC ID of Rx data PDU" VALUE 0x8053CCDC Val_Wu32 4294967295.00 OneToOne 0.00 4294967295.00 FORMAT "%13.2" /end CHARACTERISTIC
/begin CHARACTERISTIC MoFFrm_Rx_DataPdu_METL.cycTi_C "Structure instance of PDU METL / cycle time from bus matrix" VALUE 0x8053CCE0 Val_Wu16 65535.00 OneToOne 0.00 65535.00 FORMAT "%8.2" READ_ONLY /end CHARACTERISTIC
/begin CHARACTERISTIC MoFFrm_Rx_DataPdu_METL.diChks_C "Structure instance of PDU METL / parameter to enable or disable manipulation of various checks" VALUE 0x8053CCE2 Val_Wu8 255.0 OneToOne 0.00 255.0 FORMAT "%5.1" /end CHARACTERISTIC
/begin CHARACTERISTIC MoFFrm_Rx_DataPdu_METL.evalType_C "Structure instance of PDU METL / evaluation type" VALUE 0x8053CCE3 Val_Wu8 255.0 OneToOne 0.00 255.0 FORMAT "%5.1" READ_ONLY /end CHARACTERISTIC
/begin CHARACTERISTIC MoFFrm_Rx_DataPdu_METL.maskAlvCntr_C "Structure instance of PDU METL / Alive counter start bit position of Rx data PDU" VALUE 0x8053CCE4 Val_Wu8 255.0 OneToOne 0.00 255.0 FORMAT "%5.1" /end CHARACTERISTIC
/begin CHARACTERISTIC MoFFrm_Rx_DataPdu_METL.posnAlvCntrStrtBit_C "Structure instance of PDU METL / Alive counter start bit calibration of of Data PDU Rx" VALUE 0x8053CCE6 Val_Wu16 65535.00 OneToOne 0.00 65535.00 FORMAT "%8.2" READ_ONLY /end CHARACTERISTIC
/begin CHARACTERISTIC MoFFrm_Rx_DataPdu_METL.posnCrcCalcEndByte_C "Structure instance of PDU METL / End byte of CRC calculation position of Data PDU Rx" VALUE 0x8053CCE8 Val_Wu8 255.0 OneToOne 0.00 255.0 FORMAT "%5.1" /end CHARACTERISTIC
/begin CHARACTERISTIC MoFFrm_Rx_DataPdu_METL.posnCrcCalcStrtByte_C "Structure instance of PDU METL / Start byte of CRC calculation position of Data PDU Rx" VALUE 0x8053CCE9 Val_Wu8 255.0 OneToOne 0.00 255.0 FORMAT "%5.1" /end CHARACTERISTIC
/begin CHARACTERISTIC MoFFrm_Rx_DataPdu_METL.posnCrcStrtBit_C "Structure instance of PDU METL / CRC start bit position of Rx data PDU" VALUE 0x8053CCEA Val_Wu16 65535.00 OneToOne 0.00 65535.00 FORMAT "%8.2" READ_ONLY /end CHARACTERISTIC
/begin CHARACTERISTIC MoFFrm_Rx_DataPdu_METL.sigLenAlvCntr_C "Structure instance of PDU METL / Alive counter signal length of Rx data PDU" VALUE 0x8053CCEC Val_Wu8 31.00 OneToOne 1.00 32.00 FORMAT "%5.2" EXTENDED_LIMITS 0.00 255.0 READ_ONLY /end CHARACTERISTIC
/begin CHARACTERISTIC MoFFrm_Rx_DataPdu_METL.sigLenCrc_C "Structure instance of PDU METL / CRC calibration signal length of Rx data PDU" VALUE 0x8053CCED Val_Wu8 31.00 OneToOne 1.00 32.00 FORMAT "%5.2" EXTENDED_LIMITS 0.00 255.0 READ_ONLY /end CHARACTERISTIC
/begin CHARACTERISTIC MoFHybRx_flgComErrElDrv_C "Calibration for dummy interfaces of MoFHybRx_flgComErrElDrv" VALUE 0x8053BA02 Val_Wu8 1.00000000000 B_TRUE 0.00 1.00000000000 FORMAT "%13.11" /end CHARACTERISTIC
/begin CHARACTERISTIC MoFHybRx_flgIrvErrDelDrv_C "Calibration for dummy interfaces of MoFHybRx_flgIrvErrDelDrv" VALUE 0x8053BA03 Val_Wu8 1.00000000000 B_TRUE 0.00 1.00000000000 FORMAT "%13.11" /end CHARACTERISTIC
/begin CHARACTERISTIC MoFIA_cntrErrDebMaxIACo_C "Maximum tolerated error debounce counter value in function MoFIA_Co" VALUE 0x8053BA04 Val_Wu8 255.0 OneToOne 0.00 255.0 FORMAT "%5.1" /end CHARACTERISTIC
/begin CHARACTERISTIC MoFIA_cntrRstMaxIACo_C "Maximum number of Pre-ICO resets in function MoFIA_Co" VALUE 0x8053BA05 Val_Wu8 255.0 OneToOne 0.00 255.0 FORMAT "%5.1" /end CHARACTERISTIC
/begin CHARACTERISTIC MoFIA_nErrHndlgActvnIACo_C "Engine speed threshold for activation of error handling in function MoFIA_Co" VALUE 0x8053BA06 Val_Wu8 10200. nmot_q40 0.00 10200. FORMAT "%5.0" /end CHARACTERISTIC
/begin CHARACTERISTIC MoFICO_nEngThdESM_T "acceleration pedal depandant engine speed curve for the speed threshold during ESM with open throttle valve" CURVE 0x8053C852 Mo_DataCurveSstS16WS16 2621400. nmot_q40 -1310720. 1310680. FORMAT "%8.0"
 /begin AXIS_DESCR STD_AXIS MoFAPP_ratHiResl relPED_q0p02441 6 -800.0000 799.9756 FORMAT "%8.4" DEPOSIT ABSOLUTE /end AXIS_DESCR
/end CHARACTERISTIC
/begin CHARACTERISTIC MoFICO_nMaxVDpd_Cur "Velocity dependend engine speed curve for enghine speed trheshold" CURVE 0x8053C86C Mo_DataCurveSstS16WS16 2621400. nmot_q40 -1310720. 1310680. FORMAT "%8.0"
 /begin AXIS_DESCR STD_AXIS MoFVSS_v vel_q0p01 6 -327.6800 327.6700 FORMAT "%8.4" DEPOSIT ABSOLUTE /end AXIS_DESCR
/end CHARACTERISTIC
/begin CHARACTERISTIC MoFIn_ctInjPCPTst_CW "codeword for manipulation of injection counter feedback in function monitoring" VALUE 0x8053CD16 Val_Wu8 255.0 dez 0.00 255.0 FORMAT "%5.1" /end CHARACTERISTIC
/begin CHARACTERISTIC MoFIn_ignCtOffTst_CW "codeword for manipulation of ignition cut off mask in function monitoring" VALUE 0x8053CD17 Val_Wu8 255.0 dez 0.00 255.0 FORMAT "%5.1" /end CHARACTERISTIC
/begin CHARACTERISTIC MoFIn_stPPDrvTst_CW "codeword for manipulation of state Pre/PostDrv in function monitoring" VALUE 0x8053CD18 Val_Wu8 255.0 dez 0.00 255.0 FORMAT "%5.1" /end CHARACTERISTIC
/begin CHARACTERISTIC MoFSpdG_facTqLtd_CUR "factor-curve Speedgov-torque" CURVE 0x8053BA0E Mo_DataCurveSstU8WU8 2.550 fak_q0p01 0.00 2.550 FORMAT "%5.3"
 /begin AXIS_DESCR STD_AXIS MoFESpd_nEng nmot_q40 8 0.00 10200. FORMAT "%5.0" DEPOSIT ABSOLUTE /end AXIS_DESCR
/end CHARACTERISTIC
/begin CHARACTERISTIC MoFStrt_swtISSDisbl_C "Disable Calibration for ISS Monitoring" VALUE 0x8053BA22 Val_Wu8 255.0 OneToOne 0.00 255.0 FORMAT "%5.1" /end CHARACTERISTIC
/begin CHARACTERISTIC MoFTrqPtd_flgNotSwilLossCmp_C "Switch to enable the compensation of not switchable losses using the accelerator pedal position" VALUE 0x8053B7C5 Val_Wu8 1.00000000000 B_TRUE 0.00 1.00000000000 FORMAT "%13.11" /end CHARACTERISTIC
/begin CHARACTERISTIC MoFTrqPtd_nSpdGovMax_C "Maximun Speed governer speed allowed." VALUE 0x8053BA1F Val_Wu8 10200. nmot_q40 0.00 10200. FORMAT "%5.0" /end CHARACTERISTIC
/begin CHARACTERISTIC MoFTrqPtd_nSpdGovTrckMax_C "threshold for maximum speedgovernor tracking speed offset" VALUE 0x8053BA20 Val_Wu8 10200. nmot_q40 0.00 10200. FORMAT "%5.0" /end CHARACTERISTIC
/begin CHARACTERISTIC MoFTrqPtd_ratThdMaxCmp_C "Upper threshold for full loss torque compensation based on accelerator pedal position" VALUE 0x8053B7C6 Val_Wu8 99.61 rel_q0p39 0.00 99.61 FORMAT "%5.2" /end CHARACTERISTIC
/begin CHARACTERISTIC MoFTrqPtd_ratThdNoCmp_C "Lower threshold to turn off the loss torque compensation based on accelerator pedal position" VALUE 0x8053B7C7 Val_Wu8 99.61 rel_q0p39 0.00 99.61 FORMAT "%5.2" /end CHARACTERISTIC
/begin CHARACTERISTIC MoFTrqPtd_ratWoCutOff_C "Accelerator Pedal threshold ratio above which minimal inner torque MoF_trqInrMinWoCtOff is to be considered along with driver demand torque" VALUE 0x8053B7C8 Val_Wu8 99.61 rel_q0p39 0.00 99.61 FORMAT "%5.2" /end CHARACTERISTIC
/begin CHARACTERISTIC MoFTrqPtd_tiOffDlyBrkRels_C "Turn off delay timer threshold for Brake release condition" VALUE 0x8053B7CA Val_Wu8 2.550 t_q0p01 0.00 2.550 FORMAT "%5.3" /end CHARACTERISTIC
/begin CHARACTERISTIC MoFTrqPtd_tqEngApp_M "permitted driver demand (inner torque) based on engine speed and accelerator pedal position" MAP 0x8053C30A Map_Xs16Ys16Ws16 6553.500 md_q0p1 -3276.800 3276.700 FORMAT "%8.3"
 /begin AXIS_DESCR STD_AXIS MoFESpd_nEng nmot_q40 8 0.00 10200.00 FORMAT "%8.2" EXTENDED_LIMITS -1310720. 1310680. DEPOSIT ABSOLUTE /end AXIS_DESCR
 /begin AXIS_DESCR STD_AXIS MoF_rAPP rel_q0p39 8 0.00 99.60938 FORMAT "%8.5" EXTENDED_LIMITS -12800.00 12799.61 DEPOSIT ABSOLUTE /end AXIS_DESCR
/end CHARACTERISTIC
/begin CHARACTERISTIC MoFTrqPtd_tqEngSptApp_M "Accelerator-pedal map for sport mode" MAP 0x8053C3AE Map_Xs16Ys16Ws16 6553.500 md_q0p1 -3276.800 3276.700 FORMAT "%8.3"
 /begin AXIS_DESCR STD_AXIS MoFESpd_nEng nmot_q40 8 0.00 10200.00 FORMAT "%8.2" EXTENDED_LIMITS -1310720. 1310680. DEPOSIT ABSOLUTE /end AXIS_DESCR
 /begin AXIS_DESCR STD_AXIS MoF_rAPP rel_q0p39 8 0.00 99.60938 FORMAT "%8.5" EXTENDED_LIMITS -12800.00 12799.61 DEPOSIT ABSOLUTE /end AXIS_DESCR
/end CHARACTERISTIC
/begin CHARACTERISTIC MoFTrqPtd_tqSpdGovPtdOfs_T "offset characteristic curve for start up controler" CURVE 0x8053C886 Mo_DataCurveSstS16WS16 408.0000 md_q1p6 0.00 408.0000 FORMAT "%8.4" EXTENDED_LIMITS -52428.80 52427.20
 /begin AXIS_DESCR STD_AXIS NO_INPUT_QUANTITY nmot_q0p5 8 -16384.00 16383.50 FORMAT "%8.2" DEPOSIT ABSOLUTE /end AXIS_DESCR
/end CHARACTERISTIC
/begin CHARACTERISTIC MoFTrqPtd_tqWhlBrkMin_M "Map to obtain the minimum allowed Brake torque at wheel level" MAP 0x8053C4F6 Map_Xs16Ys16Ws16 104856.0 md_q1p6 -52428.80 52427.20 FORMAT "%8.2"
 /begin AXIS_DESCR STD_AXIS MoFTrqRat_rTrqPT fak_q0p01 6 0.00 327.6700 FORMAT "%8.4" EXTENDED_LIMITS -327.6800 327.6700 DEPOSIT ABSOLUTE /end AXIS_DESCR
 /begin AXIS_DESCR STD_AXIS MoFVSS_v vel_q0p01 11 -327.6800 327.6700 FORMAT "%8.4" DEPOSIT ABSOLUTE /end AXIS_DESCR
/end CHARACTERISTIC
/begin CHARACTERISTIC MoFTrqPtd_tqWhlMin_M "Min. allowed torque in wheel level in case of no brake demand from driver" MAP 0x8053C5A0 Map_Xs16Ys16Ws16 104856.0 md_q1p6 -52428.80 52427.20 FORMAT "%8.2"
 /begin AXIS_DESCR STD_AXIS MoFTrqRat_rTrqPT fak_q0p01 6 0.00 327.6700 FORMAT "%8.4" EXTENDED_LIMITS -327.6800 327.6700 DEPOSIT ABSOLUTE /end AXIS_DESCR
 /begin AXIS_DESCR STD_AXIS MoFVSS_v vel_q0p01 11 -327.6800 327.6700 FORMAT "%8.4" DEPOSIT ABSOLUTE /end AXIS_DESCR
/end CHARACTERISTIC
/begin CHARACTERISTIC MoF_ctICOIgn_C "error counter for checking ignition cut off in the fault reaction monitoring" VALUE 0x8053BA08 Val_Wu8 255.0 OneToOne 0.00 255.0 FORMAT "%5.1" /end CHARACTERISTIC
/begin CHARACTERISTIC MoF_ctICOInj_C "error counter for checking injection cut off in the fault reaction monitoring" VALUE 0x8053BA09 Val_Wu8 255.0 OneToOne 0.00 255.0 FORMAT "%5.1" /end CHARACTERISTIC
/begin CHARACTERISTIC MoF_ctIgnDel_C "Final Value for Delay Counter for Ignition Cut Off in Function Monitoring" VALUE 0x8053BA0A Val_Wu8 255.0 OneToOne 0.00 255.0 FORMAT "%5.1" /end CHARACTERISTIC
/begin CHARACTERISTIC MoF_ctPCPDel_C "Final Value for Delay Counter for PCP-feedback in Function Monitoring" VALUE 0x8053BA0B Val_Wu8 255.0 OneToOne 0.00 255.0 FORMAT "%5.1" /end CHARACTERISTIC
/begin AXIS_PTS MoF_nEng_DST "interpolation node distribution for engine speed in the function monitoring" 0x8053B7EC MoF_nEng Axis_Xu8 10200. nmot_q40 8 0.00 10200. FORMAT "%5.0" DEPOSIT ABSOLUTE /end AXIS_PTS
/begin CHARACTERISTIC MoF_nMaxAppDfct_C "Max engine speed in case of defect App" VALUE 0x8053BA0C Val_Wu8 10200. nmot_q40 0.00 10200. FORMAT "%5.0" /end CHARACTERISTIC
/begin CHARACTERISTIC MoF_nMax_C "Engine Speed limitation in MoFICO" VALUE 0x8053BA0D Val_Wu8 10200. nmot_q40 0.00 10200. FORMAT "%5.0" /end CHARACTERISTIC
/begin CHARACTERISTIC MoF_trqEngAPP_M "accelerator pedal map(engine speed, accelerator pedal position) in function monitoring" MAP 0x8053C452 Map_Xs16Ys16Ws16 6553.500 md_q0p1 -3276.800 3276.700 FORMAT "%8.3"
 /begin AXIS_DESCR STD_AXIS MoFESpd_nEng nmot_q40 8 0.00 10200.00 FORMAT "%8.2" EXTENDED_LIMITS -1310720. 1310680. DEPOSIT ABSOLUTE /end AXIS_DESCR
 /begin AXIS_DESCR STD_AXIS MoF_rAPP rel_q0p39 8 0.00 99.60938 FORMAT "%8.5" EXTENDED_LIMITS -12800.00 12799.61 DEPOSIT ABSOLUTE /end AXIS_DESCR
/end CHARACTERISTIC
/begin MEASUREMENT dummyRx "Dummy variable in Reception side" UBYTE OneToOne 1 100 0.00 255.0 FORMAT "%5.1" ECU_ADDRESS 0x600120C3 /end MEASUREMENT
/begin MEASUREMENT dummyTx "Dummy variable in Transmission side" UBYTE OneToOne 1 100 0.00 255.0 FORMAT "%5.1" ECU_ADDRESS 0x600120C2 /end MEASUREMENT
/begin MEASUREMENT MoFDrDemCo_bbLoc1Cpl "Ram data redundancy for MoFDrDemCo_bbLoc1" UBYTE OneToOne 1 100 0.00 255.0 FORMAT "%5.1" ECU_ADDRESS 0x60011A45 /end MEASUREMENT
/begin MEASUREMENT MoFDrDemMin_bbOut1Cpl "Complement variable of MoFDrDemMin_bbOut1" UBYTE OneToOne 1 100 0.00 255.0 FORMAT "%5.1" ECU_ADDRESS 0x60011A2B /end MEASUREMENT
/begin MEASUREMENT MoFDrDem_dfacFiveMod "Delta multiplication factor for different torque mode" UWORD Fact1000 1 100 0.00 1.000000 FORMAT "%8.6" ECU_ADDRESS 0x6001211C /end MEASUREMENT
/begin MEASUREMENT MoFDrDem_dfacFiveModCpl "Ram data redundancy for MoFDrDem_dfacFiveMod" UWORD OneToOne 1 100 0.00 65535.00 FORMAT "%8.2" ECU_ADDRESS 0x60011A3C /end MEASUREMENT
/begin MEASUREMENT MoFDrDem_dfacSpt "Delta multiplication factor for sports mode torque" UWORD Fact1000 1 100 0.00 1.000000 FORMAT "%8.6" ECU_ADDRESS 0x6001211A /end MEASUREMENT
/begin MEASUREMENT MoFDrDem_dfacSptCpl "Complement of MoFDrDem_dfacSpt" UWORD OneToOne 1 100 0.00 65535.00 FORMAT "%8.2" ECU_ADDRESS 0x60011A3A /end MEASUREMENT
/begin MEASUREMENT MoFDrDem_flgDrvModChg "Flag indicating driver mode change in fuction monitoring" UBYTE B_TRUE 1 100 0.00 1.00000000000 BIT_MASK 0x1 FORMAT "%13.11" ECU_ADDRESS 0x60012125 /end MEASUREMENT
/begin MEASUREMENT MoFDrDem_swtDrvMod "Drive mode selection switch in fucntion monitoring" UBYTE OneToOne 1 100 0.00 255.0 FORMAT "%5.1" ECU_ADDRESS 0x60012124 /end MEASUREMENT
/begin MEASUREMENT MoFDrDem_swtDrvModCpl "Ram data redundancy for MoFDrDem_swtDrvMod" UBYTE OneToOne 1 100 0.00 255.0 FORMAT "%5.1" ECU_ADDRESS 0x60011A44 /end MEASUREMENT
/begin MEASUREMENT MoFDrDem_swtDrvModPrev "Previous drive mode information used as reference to calculate old torque and to ramp to new torque based on new driving mode in fucntion monitoring" UBYTE OneToOne 1 100 0.00 255.0 FORMAT "%5.1" ECU_ADDRESS 0x60012123 /end MEASUREMENT
/begin MEASUREMENT MoFDrDem_swtDrvModPrevCpl "Ram data redundancy for MoFDrDem_swtDrvModPrev" UBYTE OneToOne 1 100 0.00 255.0 FORMAT "%5.1" ECU_ADDRESS 0x60011A43 /end MEASUREMENT
/begin MEASUREMENT MoFDrDem_tqCmpLoss "Torque comp loss" SWORD md_q1p6 1 100 -52428.80 52427.20 FORMAT "%8.2" ECU_ADDRESS 0x60012118 /end MEASUREMENT
/begin MEASUREMENT MoFDrDem_tqCmpLossCpl "Torque comp loss Complement" UWORD OneToOne 1 100 0.00 65535.00 FORMAT "%8.2" ECU_ADDRESS 0x60011A38 /end MEASUREMENT
/begin MEASUREMENT MoFDrDem_tqCmpNotSwilLoss "Torque comp not swi loss" UBYTE md_q1p6 1 100 0.00 408.0 FORMAT "%5.1" ECU_ADDRESS 0x60012122 /end MEASUREMENT
/begin MEASUREMENT MoFDrDem_tqCmpNotSwilLossCpl "Torque comp not swi loss complement" UBYTE OneToOne 1 100 0.00 255.0 FORMAT "%5.1" ECU_ADDRESS 0x60011A42 /end MEASUREMENT
/begin MEASUREMENT MoFDrDem_tqCmpSwilLoss "Torque comp swi loss" UBYTE md_q1p6 1 100 0.00 408.0 FORMAT "%5.1" ECU_ADDRESS 0x60012121 /end MEASUREMENT
/begin MEASUREMENT MoFDrDem_tqCmpSwilLossCpl "Torque comp swi loss complement" UBYTE OneToOne 1 100 0.00 255.0 FORMAT "%5.1" ECU_ADDRESS 0x60011A41 /end MEASUREMENT
/begin MEASUREMENT MoFDrDem_tqEng "Permitted driver demanded torque without overrun behaviour at engine torque level in function monitoring" SWORD Trq 1 100 -3276.800 3276.700 FORMAT "%8.3" ECU_ADDRESS 0x60012116 /end MEASUREMENT
/begin MEASUREMENT MoFDrDem_tqEngApp "Driver demand torque for the chosen drive mode" SWORD md_q0p1 1 100 -3276.800 3276.700 FORMAT "%8.3" ECU_ADDRESS 0x60012114 /end MEASUREMENT
/begin MEASUREMENT MoFDrDem_tqEngAppCpl "Double storage for MoFDrDem_tqEngApp" UWORD OneToOne 1 100 0.00 65535.00 FORMAT "%8.2" ECU_ADDRESS 0x60011A36 /end MEASUREMENT
/begin MEASUREMENT MoFDrDem_tqEngCpl "Complement of sum of driver demanded torque for all driver modes in function monitoring" UWORD OneToOne 1 100 0.00 65535.00 FORMAT "%8.2" ECU_ADDRESS 0x60011A34 /end MEASUREMENT
/begin MEASUREMENT MoFDrDem_tqInrMinWoCtOff "Minimal inner torque without cutoff for calculation of limitation torque in MoFDrDem" UBYTE md_q1p6 1 100 0.00 408.0 FORMAT "%5.1" ECU_ADDRESS 0x60012120 /end MEASUREMENT
/begin MEASUREMENT MoFDrDem_tqInrMinWoCtOffCpl "Complement of Minimal inner torque without cutoff for calculation of limitation torque in MoFDrDem" UBYTE OneToOne 1 100 0.00 255.0 FORMAT "%5.1" ECU_ADDRESS 0x60011A40 /end MEASUREMENT
/begin MEASUREMENT MoFDrDem_tqModNew "Driver demanded pull torque based on current drive mode in function monitoring" SWORD md_q0p1 1 100 -3276.800 3276.700 FORMAT "%8.3" ECU_ADDRESS 0x60012112 /end MEASUREMENT
/begin MEASUREMENT MoFDrDem_tqModNewCpl "Ram data redundancy for MoFDrDem_tqModNew" UWORD OneToOne 1 100 0.00 65535.00 FORMAT "%8.2" ECU_ADDRESS 0x60011A32 /end MEASUREMENT
/begin MEASUREMENT MoFDrDem_tqModOld "Driver demanded pull torque based on previous drive mode in function monitoring" SWORD md_q0p1 1 100 -3276.800 3276.700 FORMAT "%8.3" ECU_ADDRESS 0x60012110 /end MEASUREMENT
/begin MEASUREMENT MoFDrDem_tqModOldCpl "Ram data redundancy for MoFDrDem_tqModOld" UWORD OneToOne 1 100 0.00 65535.00 FORMAT "%8.2" ECU_ADDRESS 0x60011A30 /end MEASUREMENT
/begin MEASUREMENT MoFDrDem_tqWhlDrvDem "Final driver demanded torque with compensation torque in function monitoring" SWORD md_q1p6 1 100 -52428.80 52427.20 FORMAT "%8.2" ECU_ADDRESS 0x6001210E /end MEASUREMENT
/begin MEASUREMENT MoFDrDem_tqWhlDrvDemCpl "Complement of Final driver demanded torque with compensation torque in function monitoring" UWORD OneToOne 1 100 0.00 65535.00 FORMAT "%8.2" ECU_ADDRESS 0x60011A2E /end MEASUREMENT
/begin MEASUREMENT MoFDrvPrgSwt_stDrvModSwt "Status for five drive modes" UBYTE OneToOne 1 100 0.00 255.0 FORMAT "%5.1" ECU_ADDRESS 0x60012105 /end MEASUREMENT
/begin MEASUREMENT MoFDrvPrgSwt_stDrvModSwtCpl "Complement for Status for different drive modes" UBYTE OneToOne 1 100 0.00 255.0 FORMAT "%5.1" ECU_ADDRESS 0x60011A27 /end MEASUREMENT
/begin MEASUREMENT MoFDrvPrgSwt_stDrvModSwtL1 "Status for IDS drive modes. Status corresponds to lvl1." UBYTE OneToOne 1 100 0.00 15.00 FORMAT "%5.2" ECU_ADDRESS 0x60012107 /end MEASUREMENT
/begin MEASUREMENT MoFDrvPrgSwt_stDrvModSwtL1Cpl "Status complement for IDS drive modes." UBYTE OneToOne 1 100 0.00 255.0 FORMAT "%5.1" ECU_ADDRESS 0x60011A26 /end MEASUREMENT
/begin MEASUREMENT MoFDrvPrgSwt_stDrvModSwtL1Old "Status last cycle of IDS drive modes." UBYTE OneToOne 1 100 0.00 255.0 FORMAT "%5.1" ECU_ADDRESS 0x60012106 /end MEASUREMENT
/begin MEASUREMENT MoFDrvPrgSwt_stDrvModSwtL1OldCpl "Status complement last cycle of IDS drive modes." UBYTE OneToOne 1 100 0.00 255.0 FORMAT "%5.1" ECU_ADDRESS 0x60011A25 /end MEASUREMENT
/begin MEASUREMENT MoFESpdCo_bbLoc1Cpl "RAM data redundancy of MoFESpdCo_bbLoc1" UBYTE OneToOne 1 100 0.00 255.0 FORMAT "%5.1" ECU_ADDRESS 0x60011A24 /end MEASUREMENT
/begin MEASUREMENT MoFESpdCo_bbOutCpl "RAM data redundancy of MoFESpdCo_bbOut" UBYTE OneToOne 1 100 0.00 255.0 FORMAT "%5.1" ECU_ADDRESS 0x60011A23 /end MEASUREMENT
/begin MEASUREMENT MoFESpd_cntrNoSyncDeb "counter for synchro loss in function monitoring" UBYTE OneToOne 1 100 0.00 255.0 FORMAT "%5.1" ECU_ADDRESS 0x60012103 /end MEASUREMENT
/begin MEASUREMENT MoFESpd_cntrNoSyncDebCpl "RAM data redundancy for MoFESpd_cntrNoSyncDeb" UBYTE OneToOne 1 100 0.00 255.0 FORMAT "%5.1" ECU_ADDRESS 0x60011A22 /end MEASUREMENT
/begin MEASUREMENT MoFESpd_cntrSyncLvl1Old "synchro task counter level 1 (last value) in function monitoring" UBYTE OneToOne 1 100 0.00 255.0 FORMAT "%5.1" ECU_ADDRESS 0x60012102 /end MEASUREMENT
/begin MEASUREMENT MoFESpd_cntrSyncLvl1OldCpl "RAM data redundancy for MoFESpd_cntrSyncLvl1Old" UBYTE OneToOne 1 100 0.00 255.0 FORMAT "%5.1" ECU_ADDRESS 0x60011A21 /end MEASUREMENT
/begin MEASUREMENT MoFESpd_ctDeb "Error counter for engine speed comparison during function monitoring" UBYTE OneToOne 1 100 0.00 255.0 FORMAT "%5.1" ECU_ADDRESS 0x60012101 /end MEASUREMENT
/begin MEASUREMENT MoFESpd_ctDebCpl "Double storage of error counter for engine speed comparison during function monitoring" UBYTE OneToOne 1 100 0.00 255.0 FORMAT "%5.1" ECU_ADDRESS 0x60011A20 /end MEASUREMENT
/begin MEASUREMENT MoFESpd_deltaGT1Signd_MP "signed angle counter difference in engine speed monitoring" SLONG OneToOne 1 100 -2147483648.00 2147483647.00 FORMAT "%13.2" ECU_ADDRESS 0x70008C10 /end MEASUREMENT
/begin MEASUREMENT MoFESpd_flgClr "condition DSM clearing in function monitoring" UBYTE B_TRUE 1 100 0.00 1.00000000000 BIT_MASK 0x1 FORMAT "%13.11" ECU_ADDRESS 0x70000181 /end MEASUREMENT
/begin MEASUREMENT MoFESpd_flgErrESpd "error engine speed in function monitoring" UBYTE B_TRUE 1 100 0.00 1.00000000000 BIT_MASK 0x2 FORMAT "%13.11" ECU_ADDRESS 0x600120FF /end MEASUREMENT
/begin MEASUREMENT MoFESpd_flgGrdtNEngErr "Debounced engine speed gradient error flag in engine speed monitoring" UBYTE B_TRUE 1 100 0.00 1.00000000000 BIT_MASK 0x1 FORMAT "%13.11" ECU_ADDRESS 0x60012104 /end MEASUREMENT
/begin MEASUREMENT MoFESpd_flgICOESpd "Fault reaction demand from function monitoring irrev. SKA (fuel cut-off)" UBYTE B_TRUE 1 100 0.00 1.00000000000 BIT_MASK 0x1 FORMAT "%13.11" ECU_ADDRESS 0x600120FF /end MEASUREMENT
/begin MEASUREMENT MoFESpd_flgIrrvErrMsg "Irreversibles Fehler-Bit" UBYTE B_TRUE 1 100 0.00 1.00000000000 BIT_MASK 0x1 FORMAT "%13.11" ECU_ADDRESS 0x700006CB /end MEASUREMENT
/begin MEASUREMENT MoFESpd_flgNoSyncActv "Condition synchro not active in engine speed monitoring" UBYTE B_TRUE 1 100 0.00 1.00000000000 BIT_MASK 0x2 FORMAT "%13.11" ECU_ADDRESS 0x60012104 /end MEASUREMENT
/begin MEASUREMENT MoFESpd_flgSigVld "condition engine speed signal plausible in function monitoring" UBYTE B_TRUE 1 100 0.00 1.00000000000 BIT_MASK 0x4 FORMAT "%13.11" ECU_ADDRESS 0x600120FF /end MEASUREMENT
/begin MEASUREMENT MoFESpd_flgTestMsg "Pruefbedingung fuer Diagnose Fehlerpfad" UBYTE B_TRUE 1 100 0.00 1.00000000000 BIT_MASK 0x1 FORMAT "%13.11" ECU_ADDRESS 0x700006CA /end MEASUREMENT
/begin MEASUREMENT MoFESpd_frqTsk_MP "task frequency in engine speed monitoring" ULONG freq_q0p001 1 100 0.00 4294967.29500 FORMAT "%13.5" ECU_ADDRESS 0x70008C0C /end MEASUREMENT
/begin MEASUREMENT MoFESpd_GT1Diff_MP "angle counter difference in engine speed monitoring" ULONG OneToOne 1 100 0.00 4294967295.00 FORMAT "%13.2" ECU_ADDRESS 0x70008C08 /end MEASUREMENT
/begin MEASUREMENT MoFESpd_GT1_MP "Angle counter (ticks) in engine speed monitoring" ULONG OneToOne 1 100 0.00 4294967295.00 FORMAT "%13.2" ECU_ADDRESS 0x70008C04 /end MEASUREMENT
/begin MEASUREMENT MoFESpd_nDiffHiResl_MP "difference between calculated engine speeds in level 1 and level 2" SWORD nmot_q0p5 1 100 -16384.00 16383.50 FORMAT "%8.2" ECU_ADDRESS 0x70008C00 /end MEASUREMENT
/begin MEASUREMENT MoFESpd_nEng "Engine speed in function monitoring" UBYTE nmot_q40 1 100 0.00 10200. FORMAT "%5.0" ECU_ADDRESS 0x600120FE /end MEASUREMENT
/begin MEASUREMENT MoFESpd_nEngCpl "Double storage of engine speed during function monitoring" UBYTE OneToOne 1 100 0.00 255.0 FORMAT "%5.1" ECU_ADDRESS 0x60011A1F /end MEASUREMENT
/begin MEASUREMENT MoFESpd_nEngCurr_MP "engine speed in function monitoring" UWORD nmot_q0p5 1 100 0.00 32767.50 FORMAT "%8.2" ECU_ADDRESS 0x70008BFE /end MEASUREMENT
/begin MEASUREMENT MoFESpd_nEngHiRes "High resolution part of engine speed in function monitoring" SWORD nmot_q0p5 1 100 -16384.00 16383.50 FORMAT "%8.2" ECU_ADDRESS 0x600120E8 /end MEASUREMENT
/begin MEASUREMENT MoFESpd_nEngHiResCpl "Double storage of the high resolution part of engine speed in the function monitoring" UWORD OneToOne 1 100 0.00 65535.00 FORMAT "%8.2" ECU_ADDRESS 0x60011A08 /end MEASUREMENT
/begin MEASUREMENT MoFESpd_nEngHiReslL2_MP "calculated high resolution engine speed in function monitoring" SWORD nmot_q0p5 1 100 -16384.00 16383.50 FORMAT "%8.2" ECU_ADDRESS 0x70008BFC /end MEASUREMENT
/begin MEASUREMENT MoFESpd_nEng_Ax_result "Supporting coordinate for engine speed during function monitoring" SLONG dez 1 100 -2147483648.00 2147483647.00 FORMAT "%13.2" ECU_ADDRESS 0x600120F0 /end MEASUREMENT
/begin MEASUREMENT MoFESpd_nEng_Ax_result_Cpl "Double storage of supporting coordinate for engine speed during function monitoring" ULONG OneToOne 1 100 0.00 4294967295.00 FORMAT "%13.2" ECU_ADDRESS 0x60011A18 /end MEASUREMENT
/begin MEASUREMENT MoFESpd_stSync "Synchronisation status of engine speed monitoring" UBYTE OneToOne 1 100 0.00 255.0 FORMAT "%5.1" ECU_ADDRESS 0x600120FD /end MEASUREMENT
/begin MEASUREMENT MoFESpd_stSyncCpl "Double Storage of Synchronisation status of engine speed monitoring" UBYTE OneToOne 1 100 0.00 255.0 FORMAT "%5.1" ECU_ADDRESS 0x60011A1E /end MEASUREMENT
/begin MEASUREMENT MoFESpd_tiCurr_MP "System time (ticks) in engine speed monitoring" ULONG OneToOne 1 100 0.00 4294967295.00 FORMAT "%13.2" ECU_ADDRESS 0x70008BF8 /end MEASUREMENT
/begin MEASUREMENT MoFETCCo_bbLocCpl "Complement for MoFETCCo_bbLoc" UBYTE OneToOne 1 100 0.00 255.0 FORMAT "%5.1" ECU_ADDRESS 0x60011A07 /end MEASUREMENT
/begin MEASUREMENT MoFETCCo_bbOutCpl "Complement variable for MoFETCCo_bbOut" UBYTE OneToOne 1 100 0.00 255.0 FORMAT "%5.1" ECU_ADDRESS 0x60011A06 /end MEASUREMENT
/begin MEASUREMENT MoFETC_cntrCurRunTestReq "Debounce counter of test request from level 1 for engine test" UBYTE OneToOne 1 100 0.00 255.0 FORMAT "%5.1" ECU_ADDRESS 0x600120E6 /end MEASUREMENT
/begin MEASUREMENT MoFETC_cntrCurRunTestReqCpl "Complement for MoFETC_cntrCurRunTestReq" UBYTE OneToOne 1 100 0.00 255.0 FORMAT "%5.1" ECU_ADDRESS 0x60011A05 /end MEASUREMENT
/begin MEASUREMENT MoFETC_cntrTest "Counter to determine if the engine test active has elapsed for a Time Out" ULONG OneToOne 1 100 0.00 4294967295.00 FORMAT "%13.2" ECU_ADDRESS 0x600120DC /end MEASUREMENT
/begin MEASUREMENT MoFETC_cntrTestCpl "Complement for MoFETC_cntrTest" ULONG OneToOne 1 100 0.00 4294967295.00 FORMAT "%13.2" ECU_ADDRESS 0x600119FC /end MEASUREMENT
/begin MEASUREMENT MoFETC_cntrTestIdleUp "Maximum permissible duration of High Idle engine speed tester request" ULONG OneToOne 1 100 0.00 4294967295.00 FORMAT "%13.2" ECU_ADDRESS 0x600120D8 /end MEASUREMENT
/begin MEASUREMENT MoFETC_cntrTestIdleUpCpl "Complement for MoFETC_cntrTestIdleUp" ULONG OneToOne 1 100 0.00 4294967295.00 FORMAT "%13.2" ECU_ADDRESS 0x600119F8 /end MEASUREMENT
/begin MEASUREMENT MoFETC_cntrTestIdleUpTOffDly "High Idle engine speed tester request turn off delay" UBYTE OneToOne 1 100 0.00 255.0 FORMAT "%5.1" ECU_ADDRESS 0x600120E5 /end MEASUREMENT
/begin MEASUREMENT MoFETC_cntrTestIdleUpTOffDlyCpl "Complement for MoFETC_cntrTestIdleUpTOffDly" UBYTE OneToOne 1 100 0.00 255.0 FORMAT "%5.1" ECU_ADDRESS 0x60011A04 /end MEASUREMENT
/begin MEASUREMENT MoFETC_cntrTestTOffDly "debounce counter for reset of the diagnosis state for engine test" UBYTE OneToOne 1 100 0.00 255.0 FORMAT "%5.1" ECU_ADDRESS 0x600120E4 /end MEASUREMENT
/begin MEASUREMENT MoFETC_cntrTestTOffDlyCpl "Complement for MoFETC_cntrTestTOffDly" UBYTE OneToOne 1 100 0.00 255.0 FORMAT "%5.1" ECU_ADDRESS 0x60011A03 /end MEASUREMENT
/begin MEASUREMENT MoFETC_flgIdleUpstatus "Status of IdleUp for LET check" UBYTE B_TRUE 1 100 0.00 1.00000000000 BIT_MASK 0x2 FORMAT "%13.11" ECU_ADDRESS 0x600120E7 /end MEASUREMENT
/begin MEASUREMENT MoFETC_flgMonDiagEnaPlausMsg "Flag to indicate Level 2 does not allow the LET request" UBYTE B_TRUE 1 100 0.00 1.00000000000 BIT_MASK 0x1 FORMAT "%13.11" ECU_ADDRESS 0x6000A173 /end MEASUREMENT
/begin MEASUREMENT MoFETC_flgPosEdg "Line End Tester Positive Edge" UBYTE B_TRUE 1 100 0.00 1.00000000000 BIT_MASK 0x1 FORMAT "%13.11" ECU_ADDRESS 0x600120E7 /end MEASUREMENT
/begin MEASUREMENT MoFETC_stDiagTO "Status of Diagnostic Time Out provided by DiagCom" UBYTE dez 1 100 0.00 255.0 FORMAT "%5.1" ECU_ADDRESS 0x6000A330 /end MEASUREMENT
/begin MEASUREMENT MoFETC_stTest "Engine test status for function monitoring" UBYTE dez 1 100 0.00 255.0 FORMAT "%5.1" ECU_ADDRESS 0x600120E0 /end MEASUREMENT
/begin MEASUREMENT MoFETC_stTestActv "Idle up test active status" UBYTE OneToOne 1 100 0.00 255.0 FORMAT "%5.1" ECU_ADDRESS 0x600120E3 /end MEASUREMENT
/begin MEASUREMENT MoFETC_stTestActvCpl "Complement for MoFETC_stTestActv" UBYTE OneToOne 1 100 0.00 255.0 FORMAT "%5.1" ECU_ADDRESS 0x60011A02 /end MEASUREMENT
/begin MEASUREMENT MoFETC_stTestCpl "Complement for MoFETC_stTest" UBYTE OneToOne 1 100 0.00 255.0 FORMAT "%5.1" ECU_ADDRESS 0x60011A01 /end MEASUREMENT
/begin MEASUREMENT MoFETC_stTestPtd "Idle up permission status for current driving cycle" UBYTE OneToOne 1 100 0.00 255.0 FORMAT "%5.1" ECU_ADDRESS 0x600120E2 /end MEASUREMENT
/begin MEASUREMENT MoFETC_stTestPtdCpl "Complement for MoFETC_stTestPtd" UBYTE OneToOne 1 100 0.00 255.0 FORMAT "%5.1" ECU_ADDRESS 0x60011A00 /end MEASUREMENT
/begin MEASUREMENT MoFETC_stTstMsg "Engine test status from level 2 to level 1" UBYTE dez 1 100 0.00 255.0 FORMAT "%5.1" ECU_ADDRESS 0x6000A32F /end MEASUREMENT
/begin MEASUREMENT MoFExtInt_ctDebDCS "Debouncing counter for extention of MSR intervention, until the intervention of level 1 is ramped" UBYTE OneToOne 1 100 0.00 255.0 FORMAT "%5.1" ECU_ADDRESS 0x600120D5 /end MEASUREMENT
/begin MEASUREMENT MoFExtInt_ctDebDCSCpl "Double storage of debouncing counter for extension of MSR intervention" UBYTE OneToOne 1 100 0.00 255.0 FORMAT "%5.1" ECU_ADDRESS 0x600119F5 /end MEASUREMENT
/begin MEASUREMENT MoFExtInt_ctDebTSC "Debouncing counter for extension of gearbox intervention, until the intervention of level 1 is ramped" UBYTE OneToOne 1 100 0.00 255.0 FORMAT "%5.1" ECU_ADDRESS 0x600120D4 /end MEASUREMENT
/begin MEASUREMENT MoFExtInt_ctDebTSCCpl "Double storage of debouncing counter for extension of gearbox intervention" UBYTE OneToOne 1 100 0.00 255.0 FORMAT "%5.1" ECU_ADDRESS 0x600119F4 /end MEASUREMENT
/begin MEASUREMENT MoFExtInt_stDCSPtdMsg "Status of permissibility of MSR intervention from the level 2 to level 1" UBYTE OneToOne 1 100 0.00 255.0 FORMAT "%5.1" ECU_ADDRESS 0x6000A32E /end MEASUREMENT
/begin MEASUREMENT MoFExtInt_stTSCPtdMsg "Status of permissibility of gearbox intervention from the level 2 to level 1" UBYTE OneToOne 1 100 0.00 255.0 FORMAT "%5.1" ECU_ADDRESS 0x6000A32D /end MEASUREMENT
/begin MEASUREMENT MoFExtInt_tqCluPtdCoord "Permitted External intervention torque at clutch level" SWORD md_q0p1 1 100 -3276.800 3276.700 FORMAT "%8.3" ECU_ADDRESS 0x600120D2 /end MEASUREMENT
/begin MEASUREMENT MoFExtInt_tqCluPtdCoordCpl "RAM data redundancy of MoFExtInt_tqCluPtdCoord" UWORD OneToOne 1 100 0.00 65535.00 FORMAT "%8.2" ECU_ADDRESS 0x600119F2 /end MEASUREMENT
/begin MEASUREMENT MoFExtInt_tqCluPtdDCS "Permitted DCS torque intervention at clutch level" SWORD md_q0p1 1 100 -3276.800 3276.700 FORMAT "%8.3" ECU_ADDRESS 0x600120D0 /end MEASUREMENT
/begin MEASUREMENT MoFExtInt_tqCluPtdDCSCpl "RAM data redundancy of MoFExtInt_tqCluPtdDCS" UWORD OneToOne 1 100 0.00 65535.00 FORMAT "%8.2" ECU_ADDRESS 0x600119F0 /end MEASUREMENT
/begin MEASUREMENT MoFExtInt_tqCluPtdTSC "Permitted TSC torque intervention at clutch level" SWORD md_q0p1 1 100 -3276.800 3276.700 FORMAT "%8.3" ECU_ADDRESS 0x600120CE /end MEASUREMENT
/begin MEASUREMENT MoFExtInt_tqCluPtdTSCCpl "RAM data redundancy of MoFExtInt_tqCluPtdTSC" UWORD OneToOne 1 100 0.00 65535.00 FORMAT "%8.2" ECU_ADDRESS 0x600119EE /end MEASUREMENT
/begin MEASUREMENT MoFFrmCoorrCust_Rx_bbOut1Cpl "Complement of export bit basis for moffrmcoorrcust_rx" UBYTE OneToOne 1 100 0.00 255.0 FORMAT "%5.1" ECU_ADDRESS 0x600119ED /end MEASUREMENT
/begin MEASUREMENT MoFFrmCoorrCust_Rx_bbOutCpl "Complement for MoFFrmCoorrCust_Rx_bbOut" UBYTE OneToOne 1 100 0.00 255.0 FORMAT "%5.1" ECU_ADDRESS 0x600119EC /end MEASUREMENT
/begin MEASUREMENT MoFFrmRx_bbMoFFrm_Rx_flgATCVTShiftN_EATBCpl "Bit Base for MoFFrm_Rx_flgATCVTShiftN_EATBCpl" UBYTE OneToOne 1 100 0.00 255.0 FORMAT "%5.1" ECU_ADDRESS 0x600119CF /end MEASUREMENT
/begin MEASUREMENT MoFFrmRx_bbMoFFrm_Rx_flgATCVTShiftP_EATBCpl "Bit Base for MoFFrm_Rx_flgATCVTShiftP_EATBCpl" UBYTE OneToOne 1 100 0.00 255.0 FORMAT "%5.1" ECU_ADDRESS 0x600119CE /end MEASUREMENT
/begin MEASUREMENT MoFFrmRx_bbMoFFrm_Rx_flgBrkHldActv_GWIMG4Cpl "Bit Base for MoFFrm_Rx_flgBrkHldActv_GWIMG4Cpl" UBYTE OneToOne 1 100 0.00 255.0 FORMAT "%5.1" ECU_ADDRESS 0x600119CD /end MEASUREMENT
/begin MEASUREMENT MoFFrmRx_bbMoFFrm_Rx_flgCVTShiftSure_EATBCpl "Bit Base for MoFFrm_Rx_flgCVTShiftSure_EATBCpl" UBYTE OneToOne 1 100 0.00 255.0 FORMAT "%5.1" ECU_ADDRESS 0x600119CC /end MEASUREMENT
/begin MEASUREMENT MoFFrmRx_bbMoFFrm_Rx_flgDCSPlus_AYCFCpl "Bit Base for MoFFrm_Rx_flgDCSPlus_AYCFCpl" UBYTE OneToOne 1 100 0.00 255.0 FORMAT "%5.1" ECU_ADDRESS 0x600119CB /end MEASUREMENT
/begin MEASUREMENT MoFFrmRx_bbMoFFrm_Rx_flgEBBBrkPedlOn_EBBACpl "Bit Base for MoFFrm_Rx_flgEBBBrkPedlOn_EBBACpl" UBYTE OneToOne 1 100 0.00 255.0 FORMAT "%5.1" ECU_ADDRESS 0x600119CA /end MEASUREMENT
/begin MEASUREMENT MoFFrmRx_bbMoFFrm_Rx_flgMaiSwt_METACpl "Bit Base for MoFFrm_Rx_flgMaiSwt_METACpl" UBYTE OneToOne 1 100 0.00 255.0 FORMAT "%5.1" ECU_ADDRESS 0x600119C9 /end MEASUREMENT
/begin MEASUREMENT MoFFrmRx_bbMoFFrm_Rx_flgTMStrtEna_EAT12Cpl "Bit Base for MoFFrm_Rx_flgTMStrtEna_EAT12Cpl" UBYTE OneToOne 1 100 0.00 255.0 FORMAT "%5.1" ECU_ADDRESS 0x600119C8 /end MEASUREMENT
/begin MEASUREMENT MoFFrmRx_bbMoFFrm_Rx_flgTMStrtEna_EAT13Cpl "Bit Base for MoFFrm_Rx_flgTMStrtEna_EAT13Cpl" UBYTE OneToOne 1 100 0.00 255.0 FORMAT "%5.1" ECU_ADDRESS 0x600119C7 /end MEASUREMENT
/begin MEASUREMENT MoFFrm_flgATCVTShiftN "Flag indicating N position" UBYTE B_TRUE 1 100 0.00 1.00000000000 BIT_MASK 0x1 FORMAT "%13.11" ECU_ADDRESS 0x600120CD /end MEASUREMENT
/begin MEASUREMENT MoFFrm_flgATCVTShiftP "Flag indicating P position" UBYTE B_TRUE 1 100 0.00 1.00000000000 BIT_MASK 0x2 FORMAT "%13.11" ECU_ADDRESS 0x600120CD /end MEASUREMENT
/begin MEASUREMENT MoFFrm_flgBrkHldActv "Flag Brake Hold active" UBYTE B_TRUE 1 100 0.00 1.00000000000 BIT_MASK 0x4 FORMAT "%13.11" ECU_ADDRESS 0x600120CD /end MEASUREMENT
/begin MEASUREMENT MoFFrm_flgComErrACC "CAN communication error from ACC control" UBYTE B_TRUE 1 100 0.00 1.00000000000 BIT_MASK 0x1 FORMAT "%13.11" ECU_ADDRESS 0x600120A7 /end MEASUREMENT
/begin MEASUREMENT MoFFrm_flgComErrDCS "Info, of CAN communication error with DCS" UBYTE B_TRUE 1 100 0.00 1.00000000000 BIT_MASK 0x1 FORMAT "%13.11" ECU_ADDRESS 0x600120CC /end MEASUREMENT
/begin MEASUREMENT MoFFrm_flgCrsCtrlMaiSwt "Cruise Control Main switch status" UBYTE B_TRUE 1 100 0.00 1.00000000000 BIT_MASK 0x8 FORMAT "%13.11" ECU_ADDRESS 0x600120CD /end MEASUREMENT
/begin MEASUREMENT MoFFrm_flgCVTShiftSure "ndicates that shift position signal is confirmed" UBYTE B_TRUE 1 100 0.00 1.00000000000 BIT_MASK 0x10 FORMAT "%13.11" ECU_ADDRESS 0x600120CD /end MEASUREMENT
/begin MEASUREMENT MoFFrm_flgDCSPlus "Flag indicating DCS Plus is active" UBYTE B_TRUE 1 100 0.00 1.00000000000 BIT_MASK 0x20 FORMAT "%13.11" ECU_ADDRESS 0x600120CD /end MEASUREMENT
/begin MEASUREMENT MoFFrm_flgDecIntvActvDCS "on CAN received info of decreasing torque intervention" UBYTE B_TRUE 1 100 0.00 1.00000000000 BIT_MASK 0x2 FORMAT "%13.11" ECU_ADDRESS 0x600120A7 /end MEASUREMENT
/begin MEASUREMENT MoFFrm_flgDecIntvActvTra "Decreasing transmission intervention request flag" UBYTE B_TRUE 1 100 0.00 1.00000000000 BIT_MASK 0x4 FORMAT "%13.11" ECU_ADDRESS 0x600120A7 /end MEASUREMENT
/begin MEASUREMENT MoFFrm_flgEBBBrkPedlOn "Brake Pedal On Flag. Indicates that driver pressing brake pedal" UBYTE B_TRUE 1 100 0.00 1.00000000000 BIT_MASK 0x40 FORMAT "%13.11" ECU_ADDRESS 0x600120CD /end MEASUREMENT
/begin MEASUREMENT MoFFrm_flgStbErr "Stabilisation Unit Error status" UBYTE B_TRUE 1 100 0.00 1.00000000000 BIT_MASK 0x8 FORMAT "%13.11" ECU_ADDRESS 0x600120CC /end MEASUREMENT
/begin MEASUREMENT MoFFrm_flgTMStrtEna "Flag indicating that disen- gaged gear information is transmitted" UBYTE B_TRUE 1 100 0.00 1.00000000000 BIT_MASK 0x80 FORMAT "%13.11" ECU_ADDRESS 0x600120CD /end MEASUREMENT
/begin MEASUREMENT MoFFrm_flgTqUpReqACC "torque up request from ACC control" UBYTE B_TRUE 1 100 0.00 1.00000000000 BIT_MASK 0x8 FORMAT "%13.11" ECU_ADDRESS 0x600120A7 /end MEASUREMENT
/begin MEASUREMENT MoFFrm_flgTqUpReqDCS "on CAN received info of increasing torque intervention" UBYTE B_TRUE 1 100 0.00 1.00000000000 BIT_MASK 0x2 FORMAT "%13.11" ECU_ADDRESS 0x600120CC /end MEASUREMENT
/begin MEASUREMENT MoFFrm_flgTqUpReqTra "From CAN received information of increasing torque request" UBYTE B_TRUE 1 100 0.00 1.00000000000 BIT_MASK 0x4 FORMAT "%13.11" ECU_ADDRESS 0x600120CC /end MEASUREMENT
/begin MEASUREMENT MoFFrm_Lib_DataPduRxInstance.cntrAlvErrDeb "Structure variable for Rx PDU / Alive counter debounce error calibration of RX Data Pdu" UWORD OneToOne 1 100 0.00 65535.00 FORMAT "%8.2" ECU_ADDRESS 0x600120AE /end MEASUREMENT
/begin MEASUREMENT MoFFrm_Lib_DataPduRxInstance.cntrAlvErrDebCpl "Structure variable for Rx PDU / complement of alive counter debounce error calibration of RX Data Pdu" UWORD OneToOne 1 100 0.00 65535.00 FORMAT "%8.2" ECU_ADDRESS 0x600119D6 /end MEASUREMENT
/begin MEASUREMENT MoFFrm_Lib_DataPduRxInstance.cntrAlvOld "Structure variable for Rx PDU / old alive counter calibration of RX Data Pdu" UBYTE OneToOne 1 100 0.00 255.0 FORMAT "%5.1" ECU_ADDRESS 0x600120B0 /end MEASUREMENT
/begin MEASUREMENT MoFFrm_Lib_DataPduRxInstance.cntrAlvOldCpl "Structure variable for Rx PDU / Complement of old Alive counter calibration of RX Data Pdu" UBYTE OneToOne 1 100 0.00 255.0 FORMAT "%5.1" ECU_ADDRESS 0x600119D8 /end MEASUREMENT
/begin MEASUREMENT MoFFrm_Lib_DataPduRxInstance.cntrCrcErrDeb "Structure variable for Rx PDU / Alive counter error debounce calibration of RX Data Pdu" UWORD OneToOne 1 100 0.00 65535.00 FORMAT "%8.2" ECU_ADDRESS 0x600120B2 /end MEASUREMENT
/begin MEASUREMENT MoFFrm_Lib_DataPduRxInstance.cntrCrcErrDebCpl "Structure variable for Rx PDU / Complement of old Alive counter calibration of RX Data Pdu" UWORD OneToOne 1 100 0.00 65535.00 FORMAT "%8.2" ECU_ADDRESS 0x600119DA /end MEASUREMENT
/begin MEASUREMENT MoFFrm_Lib_DataPduRxInstance.cntrCycTi "Structure variable for Rx PDU / Alive counter debounce error calibration of RX Data Pdu" UWORD OneToOne 1 100 0.00 65535.00 FORMAT "%8.2" ECU_ADDRESS 0x600120B4 /end MEASUREMENT
/begin MEASUREMENT MoFFrm_Lib_DataPduRxInstance.cntrCycTiCpl "Structure variable for Rx PDU / Counter cyclic calibration of RX Data Pdu" UWORD OneToOne 1 100 0.00 65535.00 FORMAT "%8.2" ECU_ADDRESS 0x600119DC /end MEASUREMENT
/begin MEASUREMENT MoFFrm_Lib_DataPduRxInstance.cntrTiOutDeb "Structure variable for Rx PDU / Counter time out debounce of Rx data PDU" UWORD OneToOne 1 100 0.00 65535.00 FORMAT "%8.2" ECU_ADDRESS 0x600120B6 /end MEASUREMENT
/begin MEASUREMENT MoFFrm_Lib_DataPduRxInstance.cntrTiOutDebCpl "Structure variable for Rx PDU / Complement of Counter time out debounce of Rx data PDU" UWORD OneToOne 1 100 0.00 65535.00 FORMAT "%8.2" ECU_ADDRESS 0x600119DE /end MEASUREMENT
/begin MEASUREMENT MoFFrm_Lib_DataPduRxInstance.crcData "Structure variable for Rx PDU / CRC data of Rx data PDU" UWORD OneToOne 1 100 0.00 65535.00 FORMAT "%8.2" ECU_ADDRESS 0x600120B8 /end MEASUREMENT
/begin MEASUREMENT MoFFrm_Lib_DataPduRxInstance.crcDataCpl "Structure variable for Rx PDU / Comlement of CRC data of Rx data PDU" UWORD OneToOne 1 100 0.00 65535.00 FORMAT "%8.2" ECU_ADDRESS 0x600119E0 /end MEASUREMENT
/begin MEASUREMENT MoFFrm_Lib_DataPduRxInstance.flgPduUpd "Structure variable for Rx PDU / PDU update flag" UBYTE B_TRUE 1 100 0.00 1.00000000000 BIT_MASK 0x1 FORMAT "%13.11" ECU_ADDRESS 0x600120BA /end MEASUREMENT
/begin MEASUREMENT MoFFrm_Lib_DataPduRxInstance.flgPduUpdCpl "Structure variable for Rx PDU / complement of PDU update flag" UBYTE B_TRUE 1 100 0.00 1.00000000000 BIT_MASK 0x1 FORMAT "%13.11" ECU_ADDRESS 0x600119E2 /end MEASUREMENT
/begin MEASUREMENT MoFFrm_Lib_DataPduTxInstance.cntrAlvOld "Structure variable for Tx PDU / old alive counter" UBYTE OneToOne 1 100 0.00 255.0 FORMAT "%5.1" ECU_ADDRESS 0x600120A8 /end MEASUREMENT
/begin MEASUREMENT MoFFrm_Lib_DataPduTxInstance.cntrAlvOldCpl "Structure variable for Tx PDU / complement of oold alive counter" UBYTE OneToOne 1 100 0.00 255.0 FORMAT "%5.1" ECU_ADDRESS 0x600119D0 /end MEASUREMENT
/begin MEASUREMENT MoFFrm_Lib_DataPduTxInstance.crcData "Structure variable for Tx PDU / crc data" UWORD OneToOne 1 100 0.00 65535.00 FORMAT "%8.2" ECU_ADDRESS 0x600120AA /end MEASUREMENT
/begin MEASUREMENT MoFFrm_Lib_DataPduTxInstance.crcDataCpl "Structure variable for Tx PDU / complement of crc data" UWORD OneToOne 1 100 0.00 65535.00 FORMAT "%8.2" ECU_ADDRESS 0x600119D2 /end MEASUREMENT
/begin MEASUREMENT MoFFrm_Lib_DataPduTxInstance.flgAswTrigTx "Structure variable for Tx PDU / ASW Tx trigger flag" UBYTE B_TRUE 1 100 0.00 1.00000000000 BIT_MASK 0x1 FORMAT "%13.11" ECU_ADDRESS 0x600120AC /end MEASUREMENT
/begin MEASUREMENT MoFFrm_Lib_DataPduTxInstance.flgAswTrigTxCpl "Structure variable for Tx PDU / complement of ASW Tx trigger flag" UBYTE B_TRUE 1 100 0.00 1.00000000000 BIT_MASK 0x1 FORMAT "%13.11" ECU_ADDRESS 0x600119D4 /end MEASUREMENT
/begin MEASUREMENT MoFFrm_rTqCnvrBoost "Torque Converter Boost Ratio from CAN" UWORD TransR 1 100 0.00 655.3500 FORMAT "%8.4" ECU_ADDRESS 0x600120C8 /end MEASUREMENT
/begin MEASUREMENT MoFFrm_rTqCnvrBoostCpl "RAM data redundancy of MoFFrm_rTqCnvrBoost" UWORD OneToOne 1 100 0.00 65535.00 FORMAT "%8.2" ECU_ADDRESS 0x600119E8 /end MEASUREMENT
/begin MEASUREMENT MoFFrm_Rx_bbOut1Cpl "Double storage variable of MoFFrm_Rx_bbOut1" UBYTE OneToOne 1 100 0.00 255.0 FORMAT "%5.1" ECU_ADDRESS 0x600119C6 /end MEASUREMENT
/begin MEASUREMENT MoFFrm_Rx_DataPdu_AYCF.cntrAlvErrDeb "Structure instance of PDU AYCF / Alive counter debounce error calibration of RX Data Pdu" UWORD OneToOne 1 100 0.00 65535.00 FORMAT "%8.2" ECU_ADDRESS 0x60012060 /end MEASUREMENT
/begin MEASUREMENT MoFFrm_Rx_DataPdu_AYCF.cntrAlvErrDebCpl "Structure instance of PDU AYCF / complement of alive counter debounce error calibration of RX Data Pdu" UWORD OneToOne 1 100 0.00 65535.00 FORMAT "%8.2" ECU_ADDRESS 0x600119A0 /end MEASUREMENT
/begin MEASUREMENT MoFFrm_Rx_DataPdu_AYCF.cntrAlvOld "Structure instance of PDU AYCF / old alive counter calibration of RX Data Pdu" UBYTE OneToOne 1 100 0.00 255.0 FORMAT "%5.1" ECU_ADDRESS 0x60012062 /end MEASUREMENT
/begin MEASUREMENT MoFFrm_Rx_DataPdu_AYCF.cntrAlvOldCpl "Structure instance of PDU AYCF / Complement of old Alive counter calibration of RX Data Pdu" UBYTE OneToOne 1 100 0.00 255.0 FORMAT "%5.1" ECU_ADDRESS 0x600119A2 /end MEASUREMENT
/begin MEASUREMENT MoFFrm_Rx_DataPdu_AYCF.cntrCrcErrDeb "Structure instance of PDU AYCF / Alive counter error debounce calibration of RX Data Pdu" UWORD OneToOne 1 100 0.00 65535.00 FORMAT "%8.2" ECU_ADDRESS 0x60012064 /end MEASUREMENT
/begin MEASUREMENT MoFFrm_Rx_DataPdu_AYCF.cntrCrcErrDebCpl "Structure instance of PDU AYCF / Complement of old Alive counter calibration of RX Data Pdu" UWORD OneToOne 1 100 0.00 65535.00 FORMAT "%8.2" ECU_ADDRESS 0x600119A4 /end MEASUREMENT
/begin MEASUREMENT MoFFrm_Rx_DataPdu_AYCF.cntrCycTi "Structure instance of PDU AYCF / Alive counter debounce error calibration of RX Data Pdu" UWORD OneToOne 1 100 0.00 65535.00 FORMAT "%8.2" ECU_ADDRESS 0x60012066 /end MEASUREMENT
/begin MEASUREMENT MoFFrm_Rx_DataPdu_AYCF.cntrCycTiCpl "Structure instance of PDU AYCF / Counter cyclic calibration of RX Data Pdu" UWORD OneToOne 1 100 0.00 65535.00 FORMAT "%8.2" ECU_ADDRESS 0x600119A6 /end MEASUREMENT
/begin MEASUREMENT MoFFrm_Rx_DataPdu_AYCF.cntrTiOutDeb "Structure instance of PDU AYCF / Counter time out debounce of Rx data PDU" UWORD OneToOne 1 100 0.00 65535.00 FORMAT "%8.2" ECU_ADDRESS 0x60012068 /end MEASUREMENT
/begin MEASUREMENT MoFFrm_Rx_DataPdu_AYCF.cntrTiOutDebCpl "Structure instance of PDU AYCF / Complement of Counter time out debounce of Rx data PDU" UWORD OneToOne 1 100 0.00 65535.00 FORMAT "%8.2" ECU_ADDRESS 0x600119A8 /end MEASUREMENT
/begin MEASUREMENT MoFFrm_Rx_DataPdu_AYCF.crcData "Structure instance of PDU AYCF / CRC data of Rx data PDU" UWORD OneToOne 1 100 0.00 65535.00 FORMAT "%8.2" ECU_ADDRESS 0x6001206A /end MEASUREMENT
/begin MEASUREMENT MoFFrm_Rx_DataPdu_AYCF.crcDataCpl "Structure instance of PDU AYCF / Comlement of CRC data of Rx data PDU" UWORD OneToOne 1 100 0.00 65535.00 FORMAT "%8.2" ECU_ADDRESS 0x600119AA /end MEASUREMENT
/begin MEASUREMENT MoFFrm_Rx_DataPdu_AYCF.flgPduUpd "Structure instance of PDU AYCF / PDU update flag" UBYTE B_TRUE 1 100 0.00 1.00000000000 BIT_MASK 0x1 FORMAT "%13.11" ECU_ADDRESS 0x6001206C /end MEASUREMENT
/begin MEASUREMENT MoFFrm_Rx_DataPdu_AYCF.flgPduUpdCpl "Structure instance of PDU AYCF / complement of PDU update flag" UBYTE B_TRUE 1 100 0.00 1.00000000000 BIT_MASK 0x1 FORMAT "%13.11" ECU_ADDRESS 0x600119AC /end MEASUREMENT
/begin MEASUREMENT MoFFrm_Rx_DataPdu_EAT1.cntrAlvErrDeb "Structure instance of PDU EAT1 / Alive counter debounce error calibration of RX Data Pdu" UWORD OneToOne 1 100 0.00 65535.00 FORMAT "%8.2" ECU_ADDRESS 0x60012052 /end MEASUREMENT
/begin MEASUREMENT MoFFrm_Rx_DataPdu_EAT1.cntrAlvErrDebCpl "Structure instance of PDU EAT1 / complement of alive counter debounce error calibration of RX Data Pdu" UWORD OneToOne 1 100 0.00 65535.00 FORMAT "%8.2" ECU_ADDRESS 0x60011992 /end MEASUREMENT
/begin MEASUREMENT MoFFrm_Rx_DataPdu_EAT1.cntrAlvOld "Structure instance of PDU EAT1 / old alive counter calibration of RX Data Pdu" UBYTE OneToOne 1 100 0.00 255.0 FORMAT "%5.1" ECU_ADDRESS 0x60012054 /end MEASUREMENT
/begin MEASUREMENT MoFFrm_Rx_DataPdu_EAT1.cntrAlvOldCpl "Structure instance of PDU EAT1 / Complement of old Alive counter calibration of RX Data Pdu" UBYTE OneToOne 1 100 0.00 255.0 FORMAT "%5.1" ECU_ADDRESS 0x60011994 /end MEASUREMENT
/begin MEASUREMENT MoFFrm_Rx_DataPdu_EAT1.cntrCrcErrDeb "Structure instance of PDU EAT1 / Alive counter error debounce calibration of RX Data Pdu" UWORD OneToOne 1 100 0.00 65535.00 FORMAT "%8.2" ECU_ADDRESS 0x60012056 /end MEASUREMENT
/begin MEASUREMENT MoFFrm_Rx_DataPdu_EAT1.cntrCrcErrDebCpl "Structure instance of PDU EAT1 / Complement of old Alive counter calibration of RX Data Pdu" UWORD OneToOne 1 100 0.00 65535.00 FORMAT "%8.2" ECU_ADDRESS 0x60011996 /end MEASUREMENT
/begin MEASUREMENT MoFFrm_Rx_DataPdu_EAT1.cntrCycTi "Structure instance of PDU EAT1 / Alive counter debounce error calibration of RX Data Pdu" UWORD OneToOne 1 100 0.00 65535.00 FORMAT "%8.2" ECU_ADDRESS 0x60012058 /end MEASUREMENT
/begin MEASUREMENT MoFFrm_Rx_DataPdu_EAT1.cntrCycTiCpl "Structure instance of PDU EAT1 / Counter cyclic calibration of RX Data Pdu" UWORD OneToOne 1 100 0.00 65535.00 FORMAT "%8.2" ECU_ADDRESS 0x60011998 /end MEASUREMENT
/begin MEASUREMENT MoFFrm_Rx_DataPdu_EAT1.cntrTiOutDeb "Structure instance of PDU EAT1 / Counter time out debounce of Rx data PDU" UWORD OneToOne 1 100 0.00 65535.00 FORMAT "%8.2" ECU_ADDRESS 0x6001205A /end MEASUREMENT
/begin MEASUREMENT MoFFrm_Rx_DataPdu_EAT1.cntrTiOutDebCpl "Structure instance of PDU EAT1 / Complement of Counter time out debounce of Rx data PDU" UWORD OneToOne 1 100 0.00 65535.00 FORMAT "%8.2" ECU_ADDRESS 0x6001199A /end MEASUREMENT
/begin MEASUREMENT MoFFrm_Rx_DataPdu_EAT1.crcData "Structure instance of PDU EAT1 / CRC data of Rx data PDU" UWORD OneToOne 1 100 0.00 65535.00 FORMAT "%8.2" ECU_ADDRESS 0x6001205C /end MEASUREMENT
/begin MEASUREMENT MoFFrm_Rx_DataPdu_EAT1.crcDataCpl "Structure instance of PDU EAT1 / Comlement of CRC data of Rx data PDU" UWORD OneToOne 1 100 0.00 65535.00 FORMAT "%8.2" ECU_ADDRESS 0x6001199C /end MEASUREMENT
/begin MEASUREMENT MoFFrm_Rx_DataPdu_EAT1.flgPduUpd "Structure instance of PDU EAT1 / PDU update flag" UBYTE B_TRUE 1 100 0.00 1.00000000000 BIT_MASK 0x1 FORMAT "%13.11" ECU_ADDRESS 0x6001205E /end MEASUREMENT
/begin MEASUREMENT MoFFrm_Rx_DataPdu_EAT1.flgPduUpdCpl "Structure instance of PDU EAT1 / complement of PDU update flag" UBYTE B_TRUE 1 100 0.00 1.00000000000 BIT_MASK 0x1 FORMAT "%13.11" ECU_ADDRESS 0x6001199E /end MEASUREMENT
/begin MEASUREMENT MoFFrm_Rx_DataPdu_EAT12.cntrAlvErrDeb "Data PDU of EAT12 / Alive counter debounce error calibration of RX Data Pdu" UWORD OneToOne 1 100 0.00 65535.00 FORMAT "%8.2" ECU_ADDRESS 0x60012044 /end MEASUREMENT
/begin MEASUREMENT MoFFrm_Rx_DataPdu_EAT12.cntrAlvErrDebCpl "Data PDU of EAT12 / complement of alive counter debounce error calibration of RX Data Pdu" UWORD OneToOne 1 100 0.00 65535.00 FORMAT "%8.2" ECU_ADDRESS 0x60011984 /end MEASUREMENT
/begin MEASUREMENT MoFFrm_Rx_DataPdu_EAT12.cntrAlvOld "Data PDU of EAT12 / old alive counter calibration of RX Data Pdu" UBYTE OneToOne 1 100 0.00 255.0 FORMAT "%5.1" ECU_ADDRESS 0x60012046 /end MEASUREMENT
/begin MEASUREMENT MoFFrm_Rx_DataPdu_EAT12.cntrAlvOldCpl "Data PDU of EAT12 / Complement of old Alive counter calibration of RX Data Pdu" UBYTE OneToOne 1 100 0.00 255.0 FORMAT "%5.1" ECU_ADDRESS 0x60011986 /end MEASUREMENT
/begin MEASUREMENT MoFFrm_Rx_DataPdu_EAT12.cntrCrcErrDeb "Data PDU of EAT12 / Alive counter error debounce calibration of RX Data Pdu" UWORD OneToOne 1 100 0.00 65535.00 FORMAT "%8.2" ECU_ADDRESS 0x60012048 /end MEASUREMENT
/begin MEASUREMENT MoFFrm_Rx_DataPdu_EAT12.cntrCrcErrDebCpl "Data PDU of EAT12 / Complement of old Alive counter calibration of RX Data Pdu" UWORD OneToOne 1 100 0.00 65535.00 FORMAT "%8.2" ECU_ADDRESS 0x60011988 /end MEASUREMENT
/begin MEASUREMENT MoFFrm_Rx_DataPdu_EAT12.cntrCycTi "Data PDU of EAT12 / Alive counter debounce error calibration of RX Data Pdu" UWORD OneToOne 1 100 0.00 65535.00 FORMAT "%8.2" ECU_ADDRESS 0x6001204A /end MEASUREMENT
/begin MEASUREMENT MoFFrm_Rx_DataPdu_EAT12.cntrCycTiCpl "Data PDU of EAT12 / Counter cyclic calibration of RX Data Pdu" UWORD OneToOne 1 100 0.00 65535.00 FORMAT "%8.2" ECU_ADDRESS 0x6001198A /end MEASUREMENT
/begin MEASUREMENT MoFFrm_Rx_DataPdu_EAT12.cntrTiOutDeb "Data PDU of EAT12 / Counter time out debounce of Rx data PDU" UWORD OneToOne 1 100 0.00 65535.00 FORMAT "%8.2" ECU_ADDRESS 0x6001204C /end MEASUREMENT
/begin MEASUREMENT MoFFrm_Rx_DataPdu_EAT12.cntrTiOutDebCpl "Data PDU of EAT12 / Complement of Counter time out debounce of Rx data PDU" UWORD OneToOne 1 100 0.00 65535.00 FORMAT "%8.2" ECU_ADDRESS 0x6001198C /end MEASUREMENT
/begin MEASUREMENT MoFFrm_Rx_DataPdu_EAT12.crcData "Data PDU of EAT12 / CRC data of Rx data PDU" UWORD OneToOne 1 100 0.00 65535.00 FORMAT "%8.2" ECU_ADDRESS 0x6001204E /end MEASUREMENT
/begin MEASUREMENT MoFFrm_Rx_DataPdu_EAT12.crcDataCpl "Data PDU of EAT12 / Comlement of CRC data of Rx data PDU" UWORD OneToOne 1 100 0.00 65535.00 FORMAT "%8.2" ECU_ADDRESS 0x6001198E /end MEASUREMENT
/begin MEASUREMENT MoFFrm_Rx_DataPdu_EAT12.flgPduUpd "Data PDU of EAT12 / PDU update flag" UBYTE B_TRUE 1 100 0.00 1.00000000000 BIT_MASK 0x1 FORMAT "%13.11" ECU_ADDRESS 0x60012050 /end MEASUREMENT
/begin MEASUREMENT MoFFrm_Rx_DataPdu_EAT12.flgPduUpdCpl "Data PDU of EAT12 / complement of PDU update flag" UBYTE B_TRUE 1 100 0.00 1.00000000000 BIT_MASK 0x1 FORMAT "%13.11" ECU_ADDRESS 0x60011990 /end MEASUREMENT
/begin MEASUREMENT MoFFrm_Rx_DataPdu_EAT13.cntrAlvErrDeb "Data PDU of EAT13 / Alive counter debounce error calibration of RX Data Pdu" UWORD OneToOne 1 100 0.00 65535.00 FORMAT "%8.2" ECU_ADDRESS 0x60012036 /end MEASUREMENT
/begin MEASUREMENT MoFFrm_Rx_DataPdu_EAT13.cntrAlvErrDebCpl "Data PDU of EAT13 / complement of alive counter debounce error calibration of RX Data Pdu" UWORD OneToOne 1 100 0.00 65535.00 FORMAT "%8.2" ECU_ADDRESS 0x60011976 /end MEASUREMENT
/begin MEASUREMENT MoFFrm_Rx_DataPdu_EAT13.cntrAlvOld "Data PDU of EAT13 / old alive counter calibration of RX Data Pdu" UBYTE OneToOne 1 100 0.00 255.0 FORMAT "%5.1" ECU_ADDRESS 0x60012038 /end MEASUREMENT
/begin MEASUREMENT MoFFrm_Rx_DataPdu_EAT13.cntrAlvOldCpl "Data PDU of EAT13 / Complement of old Alive counter calibration of RX Data Pdu" UBYTE OneToOne 1 100 0.00 255.0 FORMAT "%5.1" ECU_ADDRESS 0x60011978 /end MEASUREMENT
/begin MEASUREMENT MoFFrm_Rx_DataPdu_EAT13.cntrCrcErrDeb "Data PDU of EAT13 / Alive counter error debounce calibration of RX Data Pdu" UWORD OneToOne 1 100 0.00 65535.00 FORMAT "%8.2" ECU_ADDRESS 0x6001203A /end MEASUREMENT
/begin MEASUREMENT MoFFrm_Rx_DataPdu_EAT13.cntrCrcErrDebCpl "Data PDU of EAT13 / Complement of old Alive counter calibration of RX Data Pdu" UWORD OneToOne 1 100 0.00 65535.00 FORMAT "%8.2" ECU_ADDRESS 0x6001197A /end MEASUREMENT
/begin MEASUREMENT MoFFrm_Rx_DataPdu_EAT13.cntrCycTi "Data PDU of EAT13 / Alive counter debounce error calibration of RX Data Pdu" UWORD OneToOne 1 100 0.00 65535.00 FORMAT "%8.2" ECU_ADDRESS 0x6001203C /end MEASUREMENT
/begin MEASUREMENT MoFFrm_Rx_DataPdu_EAT13.cntrCycTiCpl "Data PDU of EAT13 / Counter cyclic calibration of RX Data Pdu" UWORD OneToOne 1 100 0.00 65535.00 FORMAT "%8.2" ECU_ADDRESS 0x6001197C /end MEASUREMENT
/begin MEASUREMENT MoFFrm_Rx_DataPdu_EAT13.cntrTiOutDeb "Data PDU of EAT13 / Counter time out debounce of Rx data PDU" UWORD OneToOne 1 100 0.00 65535.00 FORMAT "%8.2" ECU_ADDRESS 0x6001203E /end MEASUREMENT
/begin MEASUREMENT MoFFrm_Rx_DataPdu_EAT13.cntrTiOutDebCpl "Data PDU of EAT13 / Complement of Counter time out debounce of Rx data PDU" UWORD OneToOne 1 100 0.00 65535.00 FORMAT "%8.2" ECU_ADDRESS 0x6001197E /end MEASUREMENT
/begin MEASUREMENT MoFFrm_Rx_DataPdu_EAT13.crcData "Data PDU of EAT13 / CRC data of Rx data PDU" UWORD OneToOne 1 100 0.00 65535.00 FORMAT "%8.2" ECU_ADDRESS 0x60012040 /end MEASUREMENT
/begin MEASUREMENT MoFFrm_Rx_DataPdu_EAT13.crcDataCpl "Data PDU of EAT13 / Comlement of CRC data of Rx data PDU" UWORD OneToOne 1 100 0.00 65535.00 FORMAT "%8.2" ECU_ADDRESS 0x60011980 /end MEASUREMENT
/begin MEASUREMENT MoFFrm_Rx_DataPdu_EAT13.flgPduUpd "Data PDU of EAT13 / PDU update flag" UBYTE B_TRUE 1 100 0.00 1.00000000000 BIT_MASK 0x1 FORMAT "%13.11" ECU_ADDRESS 0x60012042 /end MEASUREMENT
/begin MEASUREMENT MoFFrm_Rx_DataPdu_EAT13.flgPduUpdCpl "Data PDU of EAT13 / complement of PDU update flag" UBYTE B_TRUE 1 100 0.00 1.00000000000 BIT_MASK 0x1 FORMAT "%13.11" ECU_ADDRESS 0x60011982 /end MEASUREMENT
/begin MEASUREMENT MoFFrm_Rx_DataPdu_EAT4.cntrAlvErrDeb "Structure instance of PDU EAT4 / Alive counter debounce error calibration of RX Data Pdu" UWORD OneToOne 1 100 0.00 65535.00 FORMAT "%8.2" ECU_ADDRESS 0x60012028 /end MEASUREMENT
/begin MEASUREMENT MoFFrm_Rx_DataPdu_EAT4.cntrAlvErrDebCpl "Structure instance of PDU EAT4 / complement of alive counter debounce error calibration of RX Data Pdu" UWORD OneToOne 1 100 0.00 65535.00 FORMAT "%8.2" ECU_ADDRESS 0x60011968 /end MEASUREMENT
/begin MEASUREMENT MoFFrm_Rx_DataPdu_EAT4.cntrAlvOld "Structure instance of PDU EAT4 / old alive counter calibration of RX Data Pdu" UBYTE OneToOne 1 100 0.00 255.0 FORMAT "%5.1" ECU_ADDRESS 0x6001202A /end MEASUREMENT
/begin MEASUREMENT MoFFrm_Rx_DataPdu_EAT4.cntrAlvOldCpl "Structure instance of PDU EAT4 / Complement of old Alive counter calibration of RX Data Pdu" UBYTE OneToOne 1 100 0.00 255.0 FORMAT "%5.1" ECU_ADDRESS 0x6001196A /end MEASUREMENT
/begin MEASUREMENT MoFFrm_Rx_DataPdu_EAT4.cntrCrcErrDeb "Structure instance of PDU EAT4 / Alive counter error debounce calibration of RX Data Pdu" UWORD OneToOne 1 100 0.00 65535.00 FORMAT "%8.2" ECU_ADDRESS 0x6001202C /end MEASUREMENT
/begin MEASUREMENT MoFFrm_Rx_DataPdu_EAT4.cntrCrcErrDebCpl "Structure instance of PDU EAT4 / Complement of old Alive counter calibration of RX Data Pdu" UWORD OneToOne 1 100 0.00 65535.00 FORMAT "%8.2" ECU_ADDRESS 0x6001196C /end MEASUREMENT
/begin MEASUREMENT MoFFrm_Rx_DataPdu_EAT4.cntrCycTi "Structure instance of PDU EAT4 / Alive counter debounce error calibration of RX Data Pdu" UWORD OneToOne 1 100 0.00 65535.00 FORMAT "%8.2" ECU_ADDRESS 0x6001202E /end MEASUREMENT
/begin MEASUREMENT MoFFrm_Rx_DataPdu_EAT4.cntrCycTiCpl "Structure instance of PDU EAT4 / Counter cyclic calibration of RX Data Pdu" UWORD OneToOne 1 100 0.00 65535.00 FORMAT "%8.2" ECU_ADDRESS 0x6001196E /end MEASUREMENT
/begin MEASUREMENT MoFFrm_Rx_DataPdu_EAT4.cntrTiOutDeb "Structure instance of PDU EAT4 / Counter time out debounce of Rx data PDU" UWORD OneToOne 1 100 0.00 65535.00 FORMAT "%8.2" ECU_ADDRESS 0x60012030 /end MEASUREMENT
/begin MEASUREMENT MoFFrm_Rx_DataPdu_EAT4.cntrTiOutDebCpl "Structure instance of PDU EAT4 / Complement of Counter time out debounce of Rx data PDU" UWORD OneToOne 1 100 0.00 65535.00 FORMAT "%8.2" ECU_ADDRESS 0x60011970 /end MEASUREMENT
/begin MEASUREMENT MoFFrm_Rx_DataPdu_EAT4.crcData "Structure instance of PDU EAT4 / CRC data of Rx data PDU" UWORD OneToOne 1 100 0.00 65535.00 FORMAT "%8.2" ECU_ADDRESS 0x60012032 /end MEASUREMENT
/begin MEASUREMENT MoFFrm_Rx_DataPdu_EAT4.crcDataCpl "Structure instance of PDU EAT4 / Comlement of CRC data of Rx data PDU" UWORD OneToOne 1 100 0.00 65535.00 FORMAT "%8.2" ECU_ADDRESS 0x60011972 /end MEASUREMENT
/begin MEASUREMENT MoFFrm_Rx_DataPdu_EAT4.flgPduUpd "Structure instance of PDU EAT4 / PDU update flag" UBYTE B_TRUE 1 100 0.00 1.00000000000 BIT_MASK 0x1 FORMAT "%13.11" ECU_ADDRESS 0x60012034 /end MEASUREMENT
/begin MEASUREMENT MoFFrm_Rx_DataPdu_EAT4.flgPduUpdCpl "Structure instance of PDU EAT4 / complement of PDU update flag" UBYTE B_TRUE 1 100 0.00 1.00000000000 BIT_MASK 0x1 FORMAT "%13.11" ECU_ADDRESS 0x60011974 /end MEASUREMENT
/begin MEASUREMENT MoFFrm_Rx_DataPdu_EATB.cntrAlvErrDeb "Data PDU of EATB / Alive counter debounce error calibration of RX Data Pdu" UWORD OneToOne 1 100 0.00 65535.00 FORMAT "%8.2" ECU_ADDRESS 0x6001201A /end MEASUREMENT
/begin MEASUREMENT MoFFrm_Rx_DataPdu_EATB.cntrAlvErrDebCpl "Data PDU of EATB / complement of alive counter debounce error calibration of RX Data Pdu" UWORD OneToOne 1 100 0.00 65535.00 FORMAT "%8.2" ECU_ADDRESS 0x6001195A /end MEASUREMENT
/begin MEASUREMENT MoFFrm_Rx_DataPdu_EATB.cntrAlvOld "Data PDU of EATB / old alive counter calibration of RX Data Pdu" UBYTE OneToOne 1 100 0.00 255.0 FORMAT "%5.1" ECU_ADDRESS 0x6001201C /end MEASUREMENT
/begin MEASUREMENT MoFFrm_Rx_DataPdu_EATB.cntrAlvOldCpl "Data PDU of EATB / Complement of old Alive counter calibration of RX Data Pdu" UBYTE OneToOne 1 100 0.00 255.0 FORMAT "%5.1" ECU_ADDRESS 0x6001195C /end MEASUREMENT
/begin MEASUREMENT MoFFrm_Rx_DataPdu_EATB.cntrCrcErrDeb "Data PDU of EATB / Alive counter error debounce calibration of RX Data Pdu" UWORD OneToOne 1 100 0.00 65535.00 FORMAT "%8.2" ECU_ADDRESS 0x6001201E /end MEASUREMENT
/begin MEASUREMENT MoFFrm_Rx_DataPdu_EATB.cntrCrcErrDebCpl "Data PDU of EATB / Complement of old Alive counter calibration of RX Data Pdu" UWORD OneToOne 1 100 0.00 65535.00 FORMAT "%8.2" ECU_ADDRESS 0x6001195E /end MEASUREMENT
/begin MEASUREMENT MoFFrm_Rx_DataPdu_EATB.cntrCycTi "Data PDU of EATB / Alive counter debounce error calibration of RX Data Pdu" UWORD OneToOne 1 100 0.00 65535.00 FORMAT "%8.2" ECU_ADDRESS 0x60012020 /end MEASUREMENT
/begin MEASUREMENT MoFFrm_Rx_DataPdu_EATB.cntrCycTiCpl "Data PDU of EATB / Counter cyclic calibration of RX Data Pdu" UWORD OneToOne 1 100 0.00 65535.00 FORMAT "%8.2" ECU_ADDRESS 0x60011960 /end MEASUREMENT
/begin MEASUREMENT MoFFrm_Rx_DataPdu_EATB.cntrTiOutDeb "Data PDU of EATB / Counter time out debounce of Rx data PDU" UWORD OneToOne 1 100 0.00 65535.00 FORMAT "%8.2" ECU_ADDRESS 0x60012022 /end MEASUREMENT
/begin MEASUREMENT MoFFrm_Rx_DataPdu_EATB.cntrTiOutDebCpl "Data PDU of EATB / Complement of Counter time out debounce of Rx data PDU" UWORD OneToOne 1 100 0.00 65535.00 FORMAT "%8.2" ECU_ADDRESS 0x60011962 /end MEASUREMENT
/begin MEASUREMENT MoFFrm_Rx_DataPdu_EATB.crcData "Data PDU of EATB / CRC data of Rx data PDU" UWORD OneToOne 1 100 0.00 65535.00 FORMAT "%8.2" ECU_ADDRESS 0x60012024 /end MEASUREMENT
/begin MEASUREMENT MoFFrm_Rx_DataPdu_EATB.crcDataCpl "Data PDU of EATB / Comlement of CRC data of Rx data PDU" UWORD OneToOne 1 100 0.00 65535.00 FORMAT "%8.2" ECU_ADDRESS 0x60011964 /end MEASUREMENT
/begin MEASUREMENT MoFFrm_Rx_DataPdu_EATB.flgPduUpd "Data PDU of EATB / PDU update flag" UBYTE B_TRUE 1 100 0.00 1.00000000000 BIT_MASK 0x1 FORMAT "%13.11" ECU_ADDRESS 0x60012026 /end MEASUREMENT
/begin MEASUREMENT MoFFrm_Rx_DataPdu_EATB.flgPduUpdCpl "Data PDU of EATB / complement of PDU update flag" UBYTE B_TRUE 1 100 0.00 1.00000000000 BIT_MASK 0x1 FORMAT "%13.11" ECU_ADDRESS 0x60011966 /end MEASUREMENT
/begin MEASUREMENT MoFFrm_Rx_DataPdu_GWIMG3.cntrAlvErrDeb "Data PDU of GWIMG3 / Alive counter debounce error calibration of RX Data Pdu" UWORD OneToOne 1 100 0.00 65535.00 FORMAT "%8.2" ECU_ADDRESS 0x6001200C /end MEASUREMENT
/begin MEASUREMENT MoFFrm_Rx_DataPdu_GWIMG3.cntrAlvErrDebCpl "Data PDU of GWIMG3 / complement of alive counter debounce error calibration of RX Data Pdu" UWORD OneToOne 1 100 0.00 65535.00 FORMAT "%8.2" ECU_ADDRESS 0x6001194C /end MEASUREMENT
/begin MEASUREMENT MoFFrm_Rx_DataPdu_GWIMG3.cntrAlvOld "Data PDU of GWIMG3 / old alive counter calibration of RX Data Pdu" UBYTE OneToOne 1 100 0.00 255.0 FORMAT "%5.1" ECU_ADDRESS 0x6001200E /end MEASUREMENT
/begin MEASUREMENT MoFFrm_Rx_DataPdu_GWIMG3.cntrAlvOldCpl "Data PDU of GWIMG3 / Complement of old Alive counter calibration of RX Data Pdu" UBYTE OneToOne 1 100 0.00 255.0 FORMAT "%5.1" ECU_ADDRESS 0x6001194E /end MEASUREMENT
/begin MEASUREMENT MoFFrm_Rx_DataPdu_GWIMG3.cntrCrcErrDeb "Data PDU of GWIMG3 / Alive counter error debounce calibration of RX Data Pdu" UWORD OneToOne 1 100 0.00 65535.00 FORMAT "%8.2" ECU_ADDRESS 0x60012010 /end MEASUREMENT
/begin MEASUREMENT MoFFrm_Rx_DataPdu_GWIMG3.cntrCrcErrDebCpl "Data PDU of GWIMG3 / Complement of old Alive counter calibration of RX Data Pdu" UWORD OneToOne 1 100 0.00 65535.00 FORMAT "%8.2" ECU_ADDRESS 0x60011950 /end MEASUREMENT
/begin MEASUREMENT MoFFrm_Rx_DataPdu_GWIMG3.cntrCycTi "Data PDU of GWIMG3 / Alive counter debounce error calibration of RX Data Pdu" UWORD OneToOne 1 100 0.00 65535.00 FORMAT "%8.2" ECU_ADDRESS 0x60012012 /end MEASUREMENT
/begin MEASUREMENT MoFFrm_Rx_DataPdu_GWIMG3.cntrCycTiCpl "Data PDU of GWIMG3 / Counter cyclic calibration of RX Data Pdu" UWORD OneToOne 1 100 0.00 65535.00 FORMAT "%8.2" ECU_ADDRESS 0x60011952 /end MEASUREMENT
/begin MEASUREMENT MoFFrm_Rx_DataPdu_GWIMG3.cntrTiOutDeb "Data PDU of GWIMG3 / Counter time out debounce of Rx data PDU" UWORD OneToOne 1 100 0.00 65535.00 FORMAT "%8.2" ECU_ADDRESS 0x60012014 /end MEASUREMENT
/begin MEASUREMENT MoFFrm_Rx_DataPdu_GWIMG3.cntrTiOutDebCpl "Data PDU of GWIMG3 / Complement of Counter time out debounce of Rx data PDU" UWORD OneToOne 1 100 0.00 65535.00 FORMAT "%8.2" ECU_ADDRESS 0x60011954 /end MEASUREMENT
/begin MEASUREMENT MoFFrm_Rx_DataPdu_GWIMG3.crcData "Data PDU of GWIMG3 / CRC data of Rx data PDU" UWORD OneToOne 1 100 0.00 65535.00 FORMAT "%8.2" ECU_ADDRESS 0x60012016 /end MEASUREMENT
/begin MEASUREMENT MoFFrm_Rx_DataPdu_GWIMG3.crcDataCpl "Data PDU of GWIMG3 / Comlement of CRC data of Rx data PDU" UWORD OneToOne 1 100 0.00 65535.00 FORMAT "%8.2" ECU_ADDRESS 0x60011956 /end MEASUREMENT
/begin MEASUREMENT MoFFrm_Rx_DataPdu_GWIMG3.flgPduUpd "Data PDU of GWIMG3 / PDU update flag" UBYTE B_TRUE 1 100 0.00 1.00000000000 BIT_MASK 0x1 FORMAT "%13.11" ECU_ADDRESS 0x60012018 /end MEASUREMENT
/begin MEASUREMENT MoFFrm_Rx_DataPdu_GWIMG3.flgPduUpdCpl "Data PDU of GWIMG3 / complement of PDU update flag" UBYTE B_TRUE 1 100 0.00 1.00000000000 BIT_MASK 0x1 FORMAT "%13.11" ECU_ADDRESS 0x60011958 /end MEASUREMENT
/begin MEASUREMENT MoFFrm_Rx_DataPdu_META.cntrAlvErrDeb "Structure instance of PDU META / Alive counter debounce error calibration of RX Data Pdu" UWORD OneToOne 1 100 0.00 65535.00 FORMAT "%8.2" ECU_ADDRESS 0x60011FFE /end MEASUREMENT
/begin MEASUREMENT MoFFrm_Rx_DataPdu_META.cntrAlvErrDebCpl "Structure instance of PDU META / complement of alive counter debounce error calibration of RX Data Pdu" UWORD OneToOne 1 100 0.00 65535.00 FORMAT "%8.2" ECU_ADDRESS 0x6001193E /end MEASUREMENT
/begin MEASUREMENT MoFFrm_Rx_DataPdu_META.cntrAlvOld "Structure instance of PDU META / old alive counter calibration of RX Data Pdu" UBYTE OneToOne 1 100 0.00 255.0 FORMAT "%5.1" ECU_ADDRESS 0x60012000 /end MEASUREMENT
/begin MEASUREMENT MoFFrm_Rx_DataPdu_META.cntrAlvOldCpl "Structure instance of PDU META / Complement of old Alive counter calibration of RX Data Pdu" UBYTE OneToOne 1 100 0.00 255.0 FORMAT "%5.1" ECU_ADDRESS 0x60011940 /end MEASUREMENT
/begin MEASUREMENT MoFFrm_Rx_DataPdu_META.cntrCrcErrDeb "Structure instance of PDU META / Alive counter error debounce calibration of RX Data Pdu" UWORD OneToOne 1 100 0.00 65535.00 FORMAT "%8.2" ECU_ADDRESS 0x60012002 /end MEASUREMENT
/begin MEASUREMENT MoFFrm_Rx_DataPdu_META.cntrCrcErrDebCpl "Structure instance of PDU META / Complement of old Alive counter calibration of RX Data Pdu" UWORD OneToOne 1 100 0.00 65535.00 FORMAT "%8.2" ECU_ADDRESS 0x60011942 /end MEASUREMENT
/begin MEASUREMENT MoFFrm_Rx_DataPdu_META.cntrCycTi "Structure instance of PDU META / Alive counter debounce error calibration of RX Data Pdu" UWORD OneToOne 1 100 0.00 65535.00 FORMAT "%8.2" ECU_ADDRESS 0x60012004 /end MEASUREMENT
/begin MEASUREMENT MoFFrm_Rx_DataPdu_META.cntrCycTiCpl "Structure instance of PDU META / Counter cyclic calibration of RX Data Pdu" UWORD OneToOne 1 100 0.00 65535.00 FORMAT "%8.2" ECU_ADDRESS 0x60011944 /end MEASUREMENT
/begin MEASUREMENT MoFFrm_Rx_DataPdu_META.cntrTiOutDeb "Structure instance of PDU META / Counter time out debounce of Rx data PDU" UWORD OneToOne 1 100 0.00 65535.00 FORMAT "%8.2" ECU_ADDRESS 0x60012006 /end MEASUREMENT
/begin MEASUREMENT MoFFrm_Rx_DataPdu_META.cntrTiOutDebCpl "Structure instance of PDU META / Complement of Counter time out debounce of Rx data PDU" UWORD OneToOne 1 100 0.00 65535.00 FORMAT "%8.2" ECU_ADDRESS 0x60011946 /end MEASUREMENT
/begin MEASUREMENT MoFFrm_Rx_DataPdu_META.crcData "Structure instance of PDU META / CRC data of Rx data PDU" UWORD OneToOne 1 100 0.00 65535.00 FORMAT "%8.2" ECU_ADDRESS 0x60012008 /end MEASUREMENT
/begin MEASUREMENT MoFFrm_Rx_DataPdu_META.crcDataCpl "Structure instance of PDU META / Comlement of CRC data of Rx data PDU" UWORD OneToOne 1 100 0.00 65535.00 FORMAT "%8.2" ECU_ADDRESS 0x60011948 /end MEASUREMENT
/begin MEASUREMENT MoFFrm_Rx_DataPdu_META.flgPduUpd "Structure instance of PDU META / PDU update flag" UBYTE B_TRUE 1 100 0.00 1.00000000000 BIT_MASK 0x1 FORMAT "%13.11" ECU_ADDRESS 0x6001200A /end MEASUREMENT
/begin MEASUREMENT MoFFrm_Rx_DataPdu_META.flgPduUpdCpl "Structure instance of PDU META / complement of PDU update flag" UBYTE B_TRUE 1 100 0.00 1.00000000000 BIT_MASK 0x1 FORMAT "%13.11" ECU_ADDRESS 0x6001194A /end MEASUREMENT
/begin MEASUREMENT MoFFrm_Rx_DataPdu_METL.cntrAlvErrDeb "Structure instance of PDU METL / Alive counter debounce error calibration of RX Data Pdu" UWORD OneToOne 1 100 0.00 65535.00 FORMAT "%8.2" ECU_ADDRESS 0x60011FF0 /end MEASUREMENT
/begin MEASUREMENT MoFFrm_Rx_DataPdu_METL.cntrAlvErrDebCpl "Structure instance of PDU METL / complement of alive counter debounce error calibration of RX Data Pdu" UWORD OneToOne 1 100 0.00 65535.00 FORMAT "%8.2" ECU_ADDRESS 0x60011930 /end MEASUREMENT
/begin MEASUREMENT MoFFrm_Rx_DataPdu_METL.cntrAlvOld "Structure instance of PDU METL / old alive counter calibration of RX Data Pdu" UBYTE OneToOne 1 100 0.00 255.0 FORMAT "%5.1" ECU_ADDRESS 0x60011FF2 /end MEASUREMENT
/begin MEASUREMENT MoFFrm_Rx_DataPdu_METL.cntrAlvOldCpl "Structure instance of PDU METL / Complement of old Alive counter calibration of RX Data Pdu" UBYTE OneToOne 1 100 0.00 255.0 FORMAT "%5.1" ECU_ADDRESS 0x60011932 /end MEASUREMENT
/begin MEASUREMENT MoFFrm_Rx_DataPdu_METL.cntrCrcErrDeb "Structure instance of PDU METL / Alive counter error debounce calibration of RX Data Pdu" UWORD OneToOne 1 100 0.00 65535.00 FORMAT "%8.2" ECU_ADDRESS 0x60011FF4 /end MEASUREMENT
/begin MEASUREMENT MoFFrm_Rx_DataPdu_METL.cntrCrcErrDebCpl "Structure instance of PDU METL / Complement of old Alive counter calibration of RX Data Pdu" UWORD OneToOne 1 100 0.00 65535.00 FORMAT "%8.2" ECU_ADDRESS 0x60011934 /end MEASUREMENT
/begin MEASUREMENT MoFFrm_Rx_DataPdu_METL.cntrCycTi "Structure instance of PDU METL / Alive counter debounce error calibration of RX Data Pdu" UWORD OneToOne 1 100 0.00 65535.00 FORMAT "%8.2" ECU_ADDRESS 0x60011FF6 /end MEASUREMENT
/begin MEASUREMENT MoFFrm_Rx_DataPdu_METL.cntrCycTiCpl "Structure instance of PDU METL / Counter cyclic calibration of RX Data Pdu" UWORD OneToOne 1 100 0.00 65535.00 FORMAT "%8.2" ECU_ADDRESS 0x60011936 /end MEASUREMENT
/begin MEASUREMENT MoFFrm_Rx_DataPdu_METL.cntrTiOutDeb "Structure instance of PDU METL / Counter time out debounce of Rx data PDU" UWORD OneToOne 1 100 0.00 65535.00 FORMAT "%8.2" ECU_ADDRESS 0x60011FF8 /end MEASUREMENT
/begin MEASUREMENT MoFFrm_Rx_DataPdu_METL.cntrTiOutDebCpl "Structure instance of PDU METL / Complement of Counter time out debounce of Rx data PDU" UWORD OneToOne 1 100 0.00 65535.00 FORMAT "%8.2" ECU_ADDRESS 0x60011938 /end MEASUREMENT
/begin MEASUREMENT MoFFrm_Rx_DataPdu_METL.crcData "Structure instance of PDU METL / CRC data of Rx data PDU" UWORD OneToOne 1 100 0.00 65535.00 FORMAT "%8.2" ECU_ADDRESS 0x60011FFA /end MEASUREMENT
/begin MEASUREMENT MoFFrm_Rx_DataPdu_METL.crcDataCpl "Structure instance of PDU METL / Comlement of CRC data of Rx data PDU" UWORD OneToOne 1 100 0.00 65535.00 FORMAT "%8.2" ECU_ADDRESS 0x6001193A /end MEASUREMENT
/begin MEASUREMENT MoFFrm_Rx_DataPdu_METL.flgPduUpd "Structure instance of PDU METL / PDU update flag" UBYTE B_TRUE 1 100 0.00 1.00000000000 BIT_MASK 0x1 FORMAT "%13.11" ECU_ADDRESS 0x60011FFC /end MEASUREMENT
/begin MEASUREMENT MoFFrm_Rx_DataPdu_METL.flgPduUpdCpl "Structure instance of PDU METL / complement of PDU update flag" UBYTE B_TRUE 1 100 0.00 1.00000000000 BIT_MASK 0x1 FORMAT "%13.11" ECU_ADDRESS 0x6001193C /end MEASUREMENT
/begin MEASUREMENT MoFFrm_Rx_flgACCActv "ACC active status" UBYTE B_TRUE 1 100 0.00 1.00000000000 BIT_MASK 0x10 FORMAT "%13.11" ECU_ADDRESS 0x600120CC /end MEASUREMENT
/begin MEASUREMENT MoFFrm_Rx_flgATCVTShiftN_EATB "Flag for Neutral gear position" UBYTE B_TRUE 1 100 0.00 1.00000000000 BIT_MASK 0x1 FORMAT "%13.11" ECU_ADDRESS 0x60012094 /end MEASUREMENT
/begin MEASUREMENT MoFFrm_Rx_flgATCVTShiftP_EATB "Flag for Parking gear position" UBYTE B_TRUE 1 100 0.00 1.00000000000 BIT_MASK 0x1 FORMAT "%13.11" ECU_ADDRESS 0x60012093 /end MEASUREMENT
/begin MEASUREMENT MoFFrm_Rx_flgBrkHldActv_GWIMG4 "Flag for Brake hold Active" UBYTE B_TRUE 1 100 0.00 1.00000000000 BIT_MASK 0x1 FORMAT "%13.11" ECU_ADDRESS 0x60012092 /end MEASUREMENT
/begin MEASUREMENT MoFFrm_Rx_flgCVTShiftSure_EATB "indicates that shift position signal is confirmed" UBYTE B_TRUE 1 100 0.00 1.00000000000 BIT_MASK 0x1 FORMAT "%13.11" ECU_ADDRESS 0x60012091 /end MEASUREMENT
/begin MEASUREMENT MoFFrm_Rx_flgDCSPlus_AYCF "DCS Plus activ" UBYTE B_TRUE 1 100 0.00 1.00000000000 BIT_MASK 0x1 FORMAT "%13.11" ECU_ADDRESS 0x60012090 /end MEASUREMENT
/begin MEASUREMENT MoFFrm_Rx_flgEBBBrkPedlOn_EBBA "Brake pressed signal from EBBA" UBYTE B_TRUE 1 100 0.00 1.00000000000 BIT_MASK 0x1 FORMAT "%13.11" ECU_ADDRESS 0x6001208F /end MEASUREMENT
/begin MEASUREMENT MoFFrm_Rx_flgMaiSwt_META "Main Brake switch signal" UBYTE B_TRUE 1 100 0.00 1.00000000000 BIT_MASK 0x1 FORMAT "%13.11" ECU_ADDRESS 0x6001208E /end MEASUREMENT
/begin MEASUREMENT MoFFrm_Rx_flgTMStrtEna_EAT12 "Flag indicating that disen- gaged gear information is transmitted" UBYTE B_TRUE 1 100 0.00 1.00000000000 BIT_MASK 0x1 FORMAT "%13.11" ECU_ADDRESS 0x6001208D /end MEASUREMENT
/begin MEASUREMENT MoFFrm_Rx_flgTMStrtEna_EAT13 "Flag indicating that disen- gaged gear information is transmitted" UBYTE B_TRUE 1 100 0.00 1.00000000000 BIT_MASK 0x1 FORMAT "%13.11" ECU_ADDRESS 0x6001208C /end MEASUREMENT
/begin MEASUREMENT MoFFrm_Rx_mirrBuf "Mirror buffer for CAN for RX internal caculation" UBYTE OneToOne 1 100 0.00 255.0 FORMAT "%5.1" ARRAY_SIZE 8 ECU_ADDRESS 0x6001209F /end MEASUREMENT
/begin MEASUREMENT MoFFrm_Rx_rawCVT_SHFT_IN_NEUTRAL "Neutral gear info" UBYTE OneToOne 1 100 0.00 255.0 FORMAT "%5.1" ECU_ADDRESS 0x6001209E /end MEASUREMENT
/begin MEASUREMENT MoFFrm_Rx_rawCVT_SHFT_IN_PARKING "Parking gear info" UBYTE OneToOne 1 100 0.00 255.0 FORMAT "%5.1" ECU_ADDRESS 0x6001209D /end MEASUREMENT
/begin MEASUREMENT MoFFrm_Rx_rawCVT_SHIFT_SURE "indicates that shift position signal is confirmed" UBYTE OneToOne 1 100 0.00 255.0 FORMAT "%5.1" ECU_ADDRESS 0x6001209C /end MEASUREMENT
/begin MEASUREMENT MoFFrm_Rx_rawIMG_DRVTRQ_STATUS "Raw value of signal IMG_DRVTRQ_STATUS" UBYTE OneToOne 1 100 0.00 255.0 FORMAT "%5.1" ECU_ADDRESS 0x6001209B /end MEASUREMENT
/begin MEASUREMENT MoFFrm_Rx_rawMETER_CC_MAIN_STATUS "Raw value of signal MoFFrm_Rx_rawMETER_CC_MAIN_STATUS" UBYTE OneToOne 1 100 0.00 255.0 FORMAT "%5.1" ECU_ADDRESS 0x6001209A /end MEASUREMENT
/begin MEASUREMENT MoFFrm_Rx_rawMETER_SW_STATUS_CC_STANDARD "Raw value of signal METER_SW_STATUS_CC_STANDAR" UBYTE OneToOne 1 100 0.00 255.0 FORMAT "%5.1" ECU_ADDRESS 0x60012099 /end MEASUREMENT
/begin MEASUREMENT MoFFrm_Rx_rawTM_REQ_ENG_TORQUE_FAST "Raw value of signal TM_REQ_ENG_TORQUE_FAST" SWORD OneToOne 1 100 -32768.00 32767.00 FORMAT "%8.2" ECU_ADDRESS 0x6001207A /end MEASUREMENT
/begin MEASUREMENT MoFFrm_Rx_rawTM_START_ENABLE "Raw value of signal TM_START_ENABLE" UBYTE OneToOne 1 100 0.00 255.0 FORMAT "%5.1" ECU_ADDRESS 0x60012098 /end MEASUREMENT
/begin MEASUREMENT MoFFrm_Rx_rawTM_START_ENABLESUB "Raw value of signal TM_START_ENABLESUB" UBYTE OneToOne 1 100 0.00 255.0 FORMAT "%5.1" ECU_ADDRESS 0x60012097 /end MEASUREMENT
/begin MEASUREMENT MoFFrm_Rx_rawTM_TORQUE_CONV_TORQUE_RATIO "Raw value of signal TM_TORQUE_CONV_TORQUE_RATIO" UWORD OneToOne 1 100 0.00 65535.00 FORMAT "%8.2" ECU_ADDRESS 0x60012078 /end MEASUREMENT
/begin MEASUREMENT MoFFrm_Rx_rawVSA_REQ_MSR_PLUS_TRQ "Raw value of signal VSA_REQ_MSR_PLUS_TRQ" UBYTE OneToOne 1 100 0.00 255.0 FORMAT "%5.1" ECU_ADDRESS 0x60012096 /end MEASUREMENT
/begin MEASUREMENT MoFFrm_Rx_rawVSA_REQ_TRQ_1AC "Raw value of signal VSA_REQ_TRQ_1AC" SWORD OneToOne 1 100 -32768.00 32767.00 FORMAT "%8.2" ECU_ADDRESS 0x60012076 /end MEASUREMENT
/begin MEASUREMENT MoFFrm_Rx_rawVSA_TRQ_CONTROL_MODE "Raw value of signal VSA_TRQ_CONTROL_MODE" UBYTE OneToOne 1 100 0.00 255.0 FORMAT "%5.1" ECU_ADDRESS 0x60012095 /end MEASUREMENT
/begin MEASUREMENT MoFFrm_Rx_rTrqCnvBoost_EAT1 "Booster Torque Converter ratio" UWORD fak_q6p1035Em5_AFm16 1 100 0.00 3.999938964843750 FORMAT "%17.15" ECU_ADDRESS 0x60012074 /end MEASUREMENT
/begin MEASUREMENT MoFFrm_Rx_rTrqCnvBoost_EAT1Cpl "Complement of Booster Torque Converter ratio" UWORD OneToOne 1 100 0.00 65535.00 FORMAT "%8.2" ECU_ADDRESS 0x600119B4 /end MEASUREMENT
/begin MEASUREMENT MoFFrm_Rx_stACCActv_GWIMG3 "ACC active status" UBYTE OneToOne 1 100 0.00 3.000 FORMAT "%5.3" ECU_ADDRESS 0x6001208B /end MEASUREMENT
/begin MEASUREMENT MoFFrm_Rx_stACCActv_GWIMG3Cpl "Complement of ACC active status" UBYTE OneToOne 1 100 0.00 255.0 FORMAT "%5.1" ECU_ADDRESS 0x600119C5 /end MEASUREMENT
/begin MEASUREMENT MoFFrm_Rx_stButtonRaw_METL "Status of button" UBYTE OneToOne 1 100 0.00 7.000 FORMAT "%5.3" ECU_ADDRESS 0x6001208A /end MEASUREMENT
/begin MEASUREMENT MoFFrm_Rx_stButtonRaw_METLCpl "Complement of Status of button" UBYTE OneToOne 1 100 0.00 255.0 FORMAT "%5.1" ECU_ADDRESS 0x600119C4 /end MEASUREMENT
/begin MEASUREMENT MoFFrm_Rx_stEcoModOn "ECo Mode" UBYTE OneToOne 1 100 0.00 1.000 FORMAT "%5.3" ECU_ADDRESS 0x600120CB /end MEASUREMENT
/begin MEASUREMENT MoFFrm_Rx_stEcoModOnCpl "Cpl for MoFFrm_Rx_stEcoModOn" UBYTE OneToOne 1 100 0.00 255.0 FORMAT "%5.1" ECU_ADDRESS 0x600119EB /end MEASUREMENT
/begin MEASUREMENT MoFFrm_Rx_stEcoModOn_METD "ECO mode status" UBYTE OneToOne 1 100 0.00 255.0 FORMAT "%5.1" ECU_ADDRESS 0x60012089 /end MEASUREMENT
/begin MEASUREMENT MoFFrm_Rx_stEcoModOn_METDCpl "Complement of MoFFrm_Rx_stEcoModOn_METD" UBYTE OneToOne 1 100 0.00 255.0 FORMAT "%5.1" ECU_ADDRESS 0x600119C3 /end MEASUREMENT
/begin MEASUREMENT MoFFrm_Rx_stPdu_AYCF "AYCF CAN frame Pdu Qualifier" UBYTE OneToOne 1 100 0.00 255.0 FORMAT "%5.1" ECU_ADDRESS 0x60012088 /end MEASUREMENT
/begin MEASUREMENT MoFFrm_Rx_stPdu_AYCFCpl "RAM redundancy of MoFFrm_Rx_stPdu_AYCF" UBYTE OneToOne 1 100 0.00 255.0 FORMAT "%5.1" ECU_ADDRESS 0x600119C2 /end MEASUREMENT
/begin MEASUREMENT MoFFrm_Rx_stPdu_EAT1 "EAT1 CAN frame Pdu Qualifier" UBYTE OneToOne 1 100 0.00 255.0 FORMAT "%5.1" ECU_ADDRESS 0x60012087 /end MEASUREMENT
/begin MEASUREMENT MoFFrm_Rx_stPdu_EAT12 "Status of PDU EAT12" UBYTE OneToOne 1 100 0.00 255.0 FORMAT "%5.1" ECU_ADDRESS 0x60012086 /end MEASUREMENT
/begin MEASUREMENT MoFFrm_Rx_stPdu_EAT12Cpl "Status of PDU EAT12 - Complement" UBYTE OneToOne 1 100 0.00 255.0 FORMAT "%5.1" ECU_ADDRESS 0x600119C1 /end MEASUREMENT
/begin MEASUREMENT MoFFrm_Rx_stPdu_EAT13 "Status of PDU EAT13" UBYTE OneToOne 1 100 0.00 255.0 FORMAT "%5.1" ECU_ADDRESS 0x60012085 /end MEASUREMENT
/begin MEASUREMENT MoFFrm_Rx_stPdu_EAT13Cpl "Status of PDU EAT13 - Complement" UBYTE OneToOne 1 100 0.00 255.0 FORMAT "%5.1" ECU_ADDRESS 0x600119C0 /end MEASUREMENT
/begin MEASUREMENT MoFFrm_Rx_stPdu_EAT1Cpl "RAM redundancy of MoFFrm_Rx_stPdu_EAT1" UBYTE OneToOne 1 100 0.00 255.0 FORMAT "%5.1" ECU_ADDRESS 0x600119BF /end MEASUREMENT
/begin MEASUREMENT MoFFrm_Rx_stPdu_EAT4 "EAT4 CAN frame Pdu Qualifier" UBYTE OneToOne 1 100 0.00 255.0 FORMAT "%5.1" ECU_ADDRESS 0x60012084 /end MEASUREMENT
/begin MEASUREMENT MoFFrm_Rx_stPdu_EAT4Cpl "RAM redundancy of MoFFrm_Rx_stPdu_EAT4" UBYTE OneToOne 1 100 0.00 255.0 FORMAT "%5.1" ECU_ADDRESS 0x600119BE /end MEASUREMENT
/begin MEASUREMENT MoFFrm_Rx_stPdu_EATB "Status of PDU EATB" UBYTE OneToOne 1 100 0.00 255.0 FORMAT "%5.1" ECU_ADDRESS 0x60012083 /end MEASUREMENT
/begin MEASUREMENT MoFFrm_Rx_stPdu_EATBCpl "Status of PDU EATB - Complement" UBYTE OneToOne 1 100 0.00 255.0 FORMAT "%5.1" ECU_ADDRESS 0x600119BD /end MEASUREMENT
/begin MEASUREMENT MoFFrm_Rx_stPdu_EBBA "Status of PDU EBBA" UBYTE OneToOne 1 100 0.00 255.0 FORMAT "%5.1" ECU_ADDRESS 0x60012082 /end MEASUREMENT
/begin MEASUREMENT MoFFrm_Rx_stPdu_EBBACpl "Status of PDU EBBA - Complement" UBYTE OneToOne 1 100 0.00 255.0 FORMAT "%5.1" ECU_ADDRESS 0x600119BC /end MEASUREMENT
/begin MEASUREMENT MoFFrm_Rx_stPdu_GWIMG3 "Status of PDU GWIMG3" UBYTE OneToOne 1 100 0.00 255.0 FORMAT "%5.1" ECU_ADDRESS 0x60012081 /end MEASUREMENT
/begin MEASUREMENT MoFFrm_Rx_stPdu_GWIMG3Cpl "Status of PDU GWIMG3 - Complement" UBYTE OneToOne 1 100 0.00 255.0 FORMAT "%5.1" ECU_ADDRESS 0x600119BB /end MEASUREMENT
/begin MEASUREMENT MoFFrm_Rx_stPdu_GWIMG4 "Status of PDU GWIMG4" UBYTE OneToOne 1 100 0.00 255.0 FORMAT "%5.1" ECU_ADDRESS 0x60012080 /end MEASUREMENT
/begin MEASUREMENT MoFFrm_Rx_stPdu_GWIMG4Cpl "Status of PDU GWIMG4 - Complement" UBYTE OneToOne 1 100 0.00 255.0 FORMAT "%5.1" ECU_ADDRESS 0x600119BA /end MEASUREMENT
/begin MEASUREMENT MoFFrm_Rx_stPdu_META "META CAN frame Pdu Qualifier" UBYTE OneToOne 1 100 0.00 255.0 FORMAT "%5.1" ECU_ADDRESS 0x6001207F /end MEASUREMENT
/begin MEASUREMENT MoFFrm_Rx_stPdu_METACpl "RAM data redundancy of META" UBYTE OneToOne 1 100 0.00 255.0 FORMAT "%5.1" ECU_ADDRESS 0x600119B9 /end MEASUREMENT
/begin MEASUREMENT MoFFrm_Rx_stPdu_METD "Status of PDU METD" UBYTE OneToOne 1 100 0.00 255.0 FORMAT "%5.1" ECU_ADDRESS 0x6001207E /end MEASUREMENT
/begin MEASUREMENT MoFFrm_Rx_stPdu_METDCpl "Complement of MoFFrm_Rx_stPdu_METD" UBYTE OneToOne 1 100 0.00 255.0 FORMAT "%5.1" ECU_ADDRESS 0x600119B8 /end MEASUREMENT
/begin MEASUREMENT MoFFrm_Rx_stPdu_METL "METL CAN frame Pdu Qualifier" UBYTE OneToOne 1 100 0.00 255.0 FORMAT "%5.1" ECU_ADDRESS 0x6001207D /end MEASUREMENT
/begin MEASUREMENT MoFFrm_Rx_stPdu_METLCpl "RAM data redundancy of MoFFrm_Rx_stPdu_METL" UBYTE OneToOne 1 100 0.00 255.0 FORMAT "%5.1" ECU_ADDRESS 0x600119B7 /end MEASUREMENT
/begin MEASUREMENT MoFFrm_Rx_stTqUpReqDCS_AYCF "Torque Up request status" UBYTE OneToOne 1 100 0.00 3.000 FORMAT "%5.3" ECU_ADDRESS 0x6001207C /end MEASUREMENT
/begin MEASUREMENT MoFFrm_Rx_stTqUpReqDCS_AYCFCpl "Complement of Torque Up request status" UBYTE OneToOne 1 100 0.00 255.0 FORMAT "%5.1" ECU_ADDRESS 0x600119B6 /end MEASUREMENT
/begin MEASUREMENT MoFFrm_Rx_tqCluTra_EAT4 "Clutch Torque" SWORD md_q0p1 1 100 -3276.800 3276.700 FORMAT "%8.3" ECU_ADDRESS 0x60012072 /end MEASUREMENT
/begin MEASUREMENT MoFFrm_Rx_tqCluTra_EAT4Cpl "Complement of Clutch Torque" UWORD OneToOne 1 100 0.00 65535.00 FORMAT "%8.2" ECU_ADDRESS 0x600119B2 /end MEASUREMENT
/begin MEASUREMENT MoFFrm_Rx_tqWhlDCS_AYCF "DCS wheel Torque" SWORD md_q0p1 1 100 -3276.800 3276.700 FORMAT "%8.3" ECU_ADDRESS 0x60012070 /end MEASUREMENT
/begin MEASUREMENT MoFFrm_Rx_tqWhlDCS_AYCFCpl "Complement of DCS wheel Torque" UWORD OneToOne 1 100 0.00 65535.00 FORMAT "%8.2" ECU_ADDRESS 0x600119B0 /end MEASUREMENT
/begin MEASUREMENT MoFFrm_stCrsCtrlSwt "Cruise Control Switch states" UBYTE OneToOne 1 100 0.00 7.000 FORMAT "%5.3" ECU_ADDRESS 0x600120CA /end MEASUREMENT
/begin MEASUREMENT MoFFrm_stCrsCtrlSwtCpl "RAM data redundancy of MoFFrm_stCrsCtrlSwt" UBYTE OneToOne 1 100 0.00 255.0 FORMAT "%5.1" ECU_ADDRESS 0x600119EA /end MEASUREMENT
/begin MEASUREMENT MoFFrm_tqCluTra "From CAN received transmission intervention torque on Clutch level" SWORD md_q0p1 1 100 -3276.800 3276.700 FORMAT "%8.3" ECU_ADDRESS 0x600120C6 /end MEASUREMENT
/begin MEASUREMENT MoFFrm_tqCluTraCpl "RAM data redundancy of MoFFrm_tqCluTra" UWORD OneToOne 1 100 0.00 65535.00 FORMAT "%8.2" ECU_ADDRESS 0x600119E6 /end MEASUREMENT
/begin MEASUREMENT MoFFrm_tqWhlACC "requested ACC torque from ACC-control" SWORD md_q0p1 1 100 -3276.800 3276.700 FORMAT "%8.3" ECU_ADDRESS 0x6001206E /end MEASUREMENT
/begin MEASUREMENT MoFFrm_tqWhlACCCpl "RAM data redundancy of MoFFrm_tqWhlACC" UWORD OneToOne 1 100 0.00 65535.00 FORMAT "%8.2" ECU_ADDRESS 0x600119AE /end MEASUREMENT
/begin MEASUREMENT MoFFrm_tqWhlDCS "On CAN received DCS torque at wheel level" SWORD md_q0p1 1 100 -3276.800 3276.700 FORMAT "%8.3" ECU_ADDRESS 0x600120C4 /end MEASUREMENT
/begin MEASUREMENT MoFFrm_tqWhlDCSCpl "RAM data redundancy of MoFFrm_tqWhlDCS" UWORD OneToOne 1 100 0.00 65535.00 FORMAT "%8.2" ECU_ADDRESS 0x600119E4 /end MEASUREMENT
/begin MEASUREMENT MoFHybRxCo_bbOut1Cpl "duplicate storage of MoFHybRxCo_bbOut1" UBYTE OneToOne 1 100 0.00 255.0 FORMAT "%5.1" ECU_ADDRESS 0x6001192E /end MEASUREMENT
/begin MEASUREMENT MoFHybRx_flgComErrElDrv "flag communication with the electrical drive error detected" UBYTE B_TRUE 1 100 0.00 1.00000000000 BIT_MASK 0x4 FORMAT "%13.11" ECU_ADDRESS 0x60011FEE /end MEASUREMENT
/begin MEASUREMENT MoFHybRx_flgIrvErrElDrv "E-Drive in error mode" UBYTE B_TRUE 1 100 0.00 1.00000000000 BIT_MASK 0x8 FORMAT "%13.11" ECU_ADDRESS 0x60011FEE /end MEASUREMENT
/begin MEASUREMENT MoFHybRx_tqActEm "Actual generated torque from the E-machine" SWORD md_q0p1 1 100 -3276.800 3276.700 FORMAT "%8.3" ECU_ADDRESS 0x60011FEC /end MEASUREMENT
/begin MEASUREMENT MoFHybRx_tqActEmCpl "Ram data redundancy of MoFHybRx_tqActEm" UWORD OneToOne 1 100 0.00 65535.00 FORMAT "%8.2" ECU_ADDRESS 0x6001192C /end MEASUREMENT
/begin MEASUREMENT MoFIA_cntrDiagDebIACo "Diagnosis counter in function MoFIA_Co" UBYTE OneToOne 1 100 0.00 255.0 FORMAT "%5.1" ECU_ADDRESS 0x60006386 /end MEASUREMENT
/begin MEASUREMENT MoFIA_cntrErrDebIACo "Error debounce counter in function MoFIA_Co" UBYTE OneToOne 1 100 0.00 255.0 FORMAT "%5.1" ECU_ADDRESS 0x60011FEB /end MEASUREMENT
/begin MEASUREMENT MoFIA_cntrErrDebIACoCpl "Ram data redundancy for MoFIA_cntrErrDebIACo" UBYTE OneToOne 1 100 0.00 255.0 FORMAT "%5.1" ECU_ADDRESS 0x6001192B /end MEASUREMENT
/begin MEASUREMENT MoFIA_flgClr "Condition clear FCM in function MoFIA_Co" UBYTE B_TRUE 1 100 0.00 1.00000000000 BIT_MASK 0x1 FORMAT "%13.11" ECU_ADDRESS 0x60006385 /end MEASUREMENT
/begin MEASUREMENT MoFIA_flgIrrvErrMsg "Condition error reaction active in function MoFIA_Co" UBYTE B_TRUE 1 100 0.00 1.00000000000 BIT_MASK 0x1 FORMAT "%13.11" ECU_ADDRESS 0x6000A172 /end MEASUREMENT
/begin MEASUREMENT MoFIA_flgTestIACoMsg "Condition error checking active in function MoFIA_Co" UBYTE B_TRUE 1 100 0.00 1.00000000000 BIT_MASK 0x1 FORMAT "%13.11" ECU_ADDRESS 0x6000A171 /end MEASUREMENT
/begin MEASUREMENT MoFIA_iaOutp "Ignition output angle in function monitoring" SBYTE zw_sb_q0p75 1 100 -96.00 95.25 FORMAT "%5.2" ECU_ADDRESS 0x60011FEA /end MEASUREMENT
/begin MEASUREMENT MoFIA_iaOutpCpl "Ram data redundancy for MoFIA_iaOutp" UBYTE OneToOne 1 100 0.00 255.0 FORMAT "%5.1" ECU_ADDRESS 0x6001192A /end MEASUREMENT
/begin MEASUREMENT MoFIA_iaOutpHiResl "Ignition output angle (high resolution) in function monitoring" SWORD zw_q0p1 1 100 -3276.800 3276.700 FORMAT "%8.3" ECU_ADDRESS 0x60011FE8 /end MEASUREMENT
/begin MEASUREMENT MoFIA_iaOutpHiReslCpl "Ram data redundancy for MoFIA_iaOutpHiResl" UWORD OneToOne 1 100 0.00 65535.00 FORMAT "%8.2" ECU_ADDRESS 0x60011928 /end MEASUREMENT
/begin MEASUREMENT MoFICO_cntrTestICOL1 "Counter for test ICO L1" UBYTE OneToOne 1 100 0.00 255.0 FORMAT "%5.1" ECU_ADDRESS 0x60006384 /end MEASUREMENT
/begin MEASUREMENT MoFICO_cntrTestICOL2 "counter for setting the testflag in diagnosis for the injection cut-off check in function monitoring" UBYTE OneToOne 1 100 0.00 255.0 FORMAT "%5.1" ECU_ADDRESS 0x60006383 /end MEASUREMENT
/begin MEASUREMENT MoFICO_flgClrICOL1 "FCM clrear flag for ICOL1" UBYTE B_TRUE 1 100 0.00 1.00000000000 BIT_MASK 0x1 FORMAT "%13.11" ECU_ADDRESS 0x70000180 /end MEASUREMENT
/begin MEASUREMENT MoFICO_flgClrICOL2 "condition DSM clearing for ICOL2 in function monitoring" UBYTE B_TRUE 1 100 0.00 1.00000000000 BIT_MASK 0x1 FORMAT "%13.11" ECU_ADDRESS 0x7000017F /end MEASUREMENT
/begin MEASUREMENT MoFICO_flgIrrvErrICOL1Msg "Flag message for irreversible error ICO L1" UBYTE B_TRUE 1 100 0.00 1.00000000000 BIT_MASK 0x1 FORMAT "%13.11" ECU_ADDRESS 0x700006C9 /end MEASUREMENT
/begin MEASUREMENT MoFICO_flgIrrvErrICOL2Msg "Flag message for irreversible error ICO L2" UBYTE B_TRUE 1 100 0.00 1.00000000000 BIT_MASK 0x1 FORMAT "%13.11" ECU_ADDRESS 0x700006C8 /end MEASUREMENT
/begin MEASUREMENT MoFICO_flgTestICOL1Msg "Test flag message ICO L1" UBYTE B_TRUE 1 100 0.00 1.00000000000 BIT_MASK 0x1 FORMAT "%13.11" ECU_ADDRESS 0x700006C7 /end MEASUREMENT
/begin MEASUREMENT MoFICO_flgTestICOL2Msg "bit check condition for diagnosis of error path DFC_MoFICOL2" UBYTE B_TRUE 1 100 0.00 1.00000000000 BIT_MASK 0x1 FORMAT "%13.11" ECU_ADDRESS 0x700006C6 /end MEASUREMENT
/begin MEASUREMENT MoFSpdGCo_bbOutCpl "double storage of MoFSpdGCo_bbOut" UBYTE OneToOne 1 100 0.00 255.0 FORMAT "%5.1" ECU_ADDRESS 0x60011913 /end MEASUREMENT
/begin MEASUREMENT MoFSpdG_flgWesDem "overrun monitoring release" UBYTE B_TRUE 1 100 0.00 1.00000000000 BIT_MASK 0x1 FORMAT "%13.11" ECU_ADDRESS 0x60011FD3 /end MEASUREMENT
/begin MEASUREMENT MoFSpdG_tqPtd "Permitted inner torque of Speed-Governor" SWORD md_q0p1 1 100 -3276.800 3276.700 FORMAT "%8.3" ECU_ADDRESS 0x60011FCE /end MEASUREMENT
/begin MEASUREMENT MoFSpdG_tqPtdCpl "double storage of MoFSpdG_tqPtd" UWORD OneToOne 1 100 0.00 65535.00 FORMAT "%8.2" ECU_ADDRESS 0x60011910 /end MEASUREMENT
/begin MEASUREMENT MoFSpdG_tqSpdGovPtd_MP "Measurement point: permitted speedgovernor torque" SWORD md_q0p1 1 100 -3276.800 3276.700 FORMAT "%8.3" ECU_ADDRESS 0x70008BE4 /end MEASUREMENT
/begin MEASUREMENT MoFStrtCo_bbOutCpl "RAM data redundancy for MoFStrtCo_bbOut" UBYTE OneToOne 1 100 0.00 255.0 FORMAT "%5.1" ECU_ADDRESS 0x6001190D /end MEASUREMENT
/begin MEASUREMENT MoFStrt_flgPs1Actv "status which tells the Starter powerstage is active" UBYTE B_TRUE 1 100 0.00 1.00000000000 BIT_MASK 0x4 FORMAT "%13.11" ECU_ADDRESS 0x60011FCD /end MEASUREMENT
/begin MEASUREMENT MoFStrt_flgPs2Actv "status which tells the Starter powerstage is active" UBYTE B_TRUE 1 100 0.00 1.00000000000 BIT_MASK 0x8 FORMAT "%13.11" ECU_ADDRESS 0x60011FCD /end MEASUREMENT
/begin MEASUREMENT MoFStrt_flgStrtPtd "condition starter activation permitted from function monitoring" UBYTE B_TRUE 1 100 0.00 1.00000000000 BIT_MASK 0x1 FORMAT "%13.11" ECU_ADDRESS 0x60011FCD /end MEASUREMENT
/begin MEASUREMENT MoFStrt_flgStrtRly "status of powertrain active in the function monitoring" UBYTE B_TRUE 1 100 0.00 1.00000000000 BIT_MASK 0x2 FORMAT "%13.11" ECU_ADDRESS 0x60011FCD /end MEASUREMENT
/begin MEASUREMENT MoFStrt_stStrtActv "Status of starter power stage" UBYTE OneToOne 1 100 0.00 255.0 FORMAT "%5.1" ECU_ADDRESS 0x60011FCC /end MEASUREMENT
/begin MEASUREMENT MoFStrt_stStrtActvCpl "RAM data redundancy for MoFStrt_stStrtActv" UBYTE OneToOne 1 100 0.00 255.0 FORMAT "%5.1" ECU_ADDRESS 0x6001190C /end MEASUREMENT
/begin MEASUREMENT MoFTrqPtd_facCmpAcs "Weighting factor for loss compensation of switchable losses" UBYTE fak_q0p01 1 100 0.00 2.550 FORMAT "%5.3" ECU_ADDRESS 0x6001211F /end MEASUREMENT
/begin MEASUREMENT MoFTrqPtd_facCmpAcsCpl "Complement of MoFTrqPtd_facCmpAcs" UBYTE OneToOne 1 100 0.00 255.0 FORMAT "%5.1" ECU_ADDRESS 0x60011A3F /end MEASUREMENT
/begin MEASUREMENT MoFTrqPtd_facCmpSpdGovr "Weighting factor for torque loss compensation in level 2 function monitoring" UBYTE fak_q0p01 1 100 0.00 2.550 FORMAT "%5.3" ECU_ADDRESS 0x60011FD2 /end MEASUREMENT
/begin MEASUREMENT MoFTrqPtd_facCmpSpdGovrCpl "double storage of MoFTrqPtd_facCmpSpdGovr" UBYTE OneToOne 1 100 0.00 255.0 FORMAT "%5.1" ECU_ADDRESS 0x60011912 /end MEASUREMENT
/begin MEASUREMENT MoFTrqPtd_facMaxCmp "Weighting factor for loss compensation of not switchable losses" UBYTE fak_q0p01 1 100 0.00 2.550 FORMAT "%5.3" ECU_ADDRESS 0x6001211E /end MEASUREMENT
/begin MEASUREMENT MoFTrqPtd_facMaxCmpCpl "Complement of MoFTrqPtd_facMaxCmp" UBYTE OneToOne 1 100 0.00 255.0 FORMAT "%5.1" ECU_ADDRESS 0x60011A3E /end MEASUREMENT
/begin MEASUREMENT MoFTrqPtd_flgSelBrkMin "Flag to select permitted minimum torque depending on driver brake demand" UBYTE B_TRUE 1 100 0.00 1.00000000000 BIT_MASK 0x1 FORMAT "%13.11" ECU_ADDRESS 0x6001210A /end MEASUREMENT
/begin MEASUREMENT MoFTrqPtd_nDifSpdGovr "Difference of engine speed demanded by speedgovernor" SWORD nmot_q0p5 1 100 -16384.00 16383.50 FORMAT "%8.2" ECU_ADDRESS 0x60011FD0 /end MEASUREMENT
/begin MEASUREMENT MoFTrqPtd_nDifSpdGovrCpl "double storage of MoFTrqPtd_nDifSpdGovr" UWORD OneToOne 1 100 0.00 65535.00 FORMAT "%8.2" ECU_ADDRESS 0x6001190E /end MEASUREMENT
/begin MEASUREMENT MoFTrqPtd_tiOffDlyBrkRels "Turn off delay timer for Brake release condition" UBYTE t_q0p01 1 100 0.00 2.550 FORMAT "%5.3" ECU_ADDRESS 0x6001210B /end MEASUREMENT
/begin MEASUREMENT MoFTrqPtd_tiOffDlyBrkRelsCpl "Complement variable of MoFTrqPtd_tiOffDlyBrkRels" UBYTE OneToOne 1 100 0.00 255.0 FORMAT "%5.1" ECU_ADDRESS 0x60011A2A /end MEASUREMENT
/begin MEASUREMENT MoFTrqPtd_tqWhlBrkMin_MP "Minimum wheel torque in function monitoring with brake demand by driver" SWORD md_q1p6 1 100 -52428.80 52427.20 FORMAT "%8.2" ECU_ADDRESS 0x70008C16 /end MEASUREMENT
/begin MEASUREMENT MoFTrqPtd_tqWhlDrvDem "requested torque from driver in the function monitoring" SWORD md_q1p6 1 100 -52428.80 52427.20 FORMAT "%8.2" ECU_ADDRESS 0x6001210C /end MEASUREMENT
/begin MEASUREMENT MoFTrqPtd_tqWhlDrvDemCpl "duplicate storage for MoFTrqPtd_tqWhlDrvDem" UWORD OneToOne 1 100 0.00 65535.00 FORMAT "%8.2" ECU_ADDRESS 0x60011A2C /end MEASUREMENT
/begin MEASUREMENT MoFTrqPtd_tqWhlMin "Minimum total wheel torque in function monitoring" SWORD md_q1p6 1 100 -52428.80 52427.20 FORMAT "%8.2" ECU_ADDRESS 0x60012108 /end MEASUREMENT
/begin MEASUREMENT MoFTrqPtd_tqWhlMinCpl "RAM-data redundancy for MoFTrqPtd_tqWhlMin" UWORD OneToOne 1 100 0.00 65535.00 FORMAT "%8.2" ECU_ADDRESS 0x60011A28 /end MEASUREMENT
/begin MEASUREMENT MoFTrqPtd_tqWhlMin_MP "Minimum wheel torque in function monitoring without driver brake demand" SWORD md_q1p6 1 100 -52428.80 52427.20 FORMAT "%8.2" ECU_ADDRESS 0x70008C14 /end MEASUREMENT
/begin MEASUREMENT MoF_bAirFlChkDisbl "State air-fuel-check disabled in function monitoring" UBYTE B_TRUE 1 100 0.00 1.00000000000 BIT_MASK 0x4 FORMAT "%13.11" ECU_ADDRESS 0x600120E1 /end MEASUREMENT
/begin MEASUREMENT MoF_ctICOIgn "error counter (ignition) for fault reaction monitoring in function monitoring" UBYTE OneToOne 1 100 0.00 255.0 FORMAT "%5.1" ECU_ADDRESS 0x60011FE7 /end MEASUREMENT
/begin MEASUREMENT MoF_ctICOIgnCpl "RAM data redundancy for MoF_ctICOIgn" UBYTE OneToOne 1 100 0.00 255.0 FORMAT "%5.1" ECU_ADDRESS 0x60011927 /end MEASUREMENT
/begin MEASUREMENT MoF_ctICOInj "error counter (injection) for fault reaction monitoring in function monitoring" UBYTE OneToOne 1 100 0.00 255.0 FORMAT "%5.1" ECU_ADDRESS 0x60011FE6 /end MEASUREMENT
/begin MEASUREMENT MoF_ctICOInjCpl "RAM data redundancy for MoF_ctICOInj" UBYTE OneToOne 1 100 0.00 255.0 FORMAT "%5.1" ECU_ADDRESS 0x60011926 /end MEASUREMENT
/begin MEASUREMENT MoF_ctIgnDel "Delay Counter for Ignition Cut Off in Function Monitoring" UBYTE OneToOne 1 100 0.00 255.0 FORMAT "%5.1" ECU_ADDRESS 0x60011FE5 /end MEASUREMENT
/begin MEASUREMENT MoF_ctIgnDelCpl "RAM data redundancy for MoF_ctIgnDel" UBYTE OneToOne 1 100 0.00 255.0 FORMAT "%5.1" ECU_ADDRESS 0x60011925 /end MEASUREMENT
/begin MEASUREMENT MoF_ctInjPCPCurr "current injection counter in function monitoring" ULONG OneToOne 1 100 0.00 4294967295.00 FORMAT "%13.2" ECU_ADDRESS 0x60011FD8 /end MEASUREMENT
/begin MEASUREMENT MoF_ctInjPCPCurrCpl "RAM data redundancy for MoF_ctInjPcpCurr" ULONG OneToOne 1 100 0.00 4294967295.00 FORMAT "%13.2" ECU_ADDRESS 0x60011918 /end MEASUREMENT
/begin MEASUREMENT MoF_ctInjPCPOld "injection counter (one time slot delayed) in function monitoring" ULONG OneToOne 1 100 0.00 4294967295.00 FORMAT "%13.2" ECU_ADDRESS 0x60011FE0 /end MEASUREMENT
/begin MEASUREMENT MoF_ctInjPCPOldCpl "RAM data redundancy for MoF_ctInjPcpOld" ULONG OneToOne 1 100 0.00 4294967295.00 FORMAT "%13.2" ECU_ADDRESS 0x60011920 /end MEASUREMENT
/begin MEASUREMENT MoF_ctPCPDel "Delay Counter for PCP-feedback in Function Monitoring" UBYTE OneToOne 1 100 0.00 255.0 FORMAT "%5.1" ECU_ADDRESS 0x60011FE4 /end MEASUREMENT
/begin MEASUREMENT MoF_ctPCPDelCpl "RAM data redundancy for MoF_ctPCPDel" UBYTE OneToOne 1 100 0.00 255.0 FORMAT "%5.1" ECU_ADDRESS 0x60011924 /end MEASUREMENT
/begin MEASUREMENT MoF_ctTstESpd "counter for putting of the test flag in diagnosis of engine speed plausibility check" UBYTE OneToOne 1 100 0.00 255.0 FORMAT "%5.1" ECU_ADDRESS 0x60006387 /end MEASUREMENT
/begin MEASUREMENT MoF_ignCtOffMsk "fade out mask ignition output in function monitoring" UWORD OneToOne 1 100 0.00 65535.00 FORMAT "%8.2" ECU_ADDRESS 0x60011FD4 /end MEASUREMENT
/begin MEASUREMENT MoF_ignCtOffMskCpl "RAM data redundancy for MoF_IgnCtOffMsk" UWORD OneToOne 1 100 0.00 65535.00 FORMAT "%8.2" ECU_ADDRESS 0x60011914 /end MEASUREMENT
/begin MEASUREMENT MoF_nEng "engine speed in the function monitoring" UBYTE nmot_q40 1 100 0.00 10200. FORMAT "%5.0" ECU_ADDRESS 0x600120FC /end MEASUREMENT
/begin MEASUREMENT MoF_nEngCpl "RAM data redundancy for MoF_nEng" UBYTE OneToOne 1 100 0.00 255.0 FORMAT "%5.1" ECU_ADDRESS 0x60011A1D /end MEASUREMENT
/begin MEASUREMENT MoF_nEng_DST_result "result of distribution search in MoF_nEng_DST" SLONG dez 1 100 -2147483648.00 2147483647.00 FORMAT "%13.2" ECU_ADDRESS 0x600120EC /end MEASUREMENT
/begin MEASUREMENT MoF_nEng_DST_result_Cpl "RAM data redundancy for MoF_nEng_DST_result" ULONG OneToOne 1 100 0.00 4294967295.00 FORMAT "%13.2" ECU_ADDRESS 0x60011A14 /end MEASUREMENT
/begin MEASUREMENT MoF_nMax_MP "Engine Speed Treshold" ULONG nmot_q0p5 1 100 0.00 2147483647.50 FORMAT "%13.2" ECU_ADDRESS 0x70008BE8 /end MEASUREMENT
/begin MEASUREMENT MoF_phiGT1Diff_mp "angle counter difference in engine speed monitoring" ULONG kw_sw_q0p0219 1 100 0.00 94371839.9780 FORMAT "%13.4" ECU_ADDRESS 0x70008BF4 /end MEASUREMENT
/begin MEASUREMENT MoF_phiGT1Last "angle watch-state from the previous call of the engine speed monitoring" ULONG OneToOne 1 100 0.00 4294967295.00 FORMAT "%13.2" ECU_ADDRESS 0x600120F8 /end MEASUREMENT
/begin MEASUREMENT MoF_phiGT1LastCpl "RAM data redundancy for MoF_phiGT1Last" ULONG OneToOne 1 100 0.00 4294967295.00 FORMAT "%13.2" ECU_ADDRESS 0x60011A10 /end MEASUREMENT
/begin MEASUREMENT MoF_tiCurrDiff_mp "system time difference in engine speed monitoring" ULONG OneToOne 1 100 0.00 4294967295.00 FORMAT "%13.2" ECU_ADDRESS 0x70008BF0 /end MEASUREMENT
/begin MEASUREMENT MoF_tiDiff_mp "time difference in engine speed monitoring" ULONG t_q1p0_us 1 100 0.00 4294967295.00 FORMAT "%13.2" ECU_ADDRESS 0x70008BEC /end MEASUREMENT
/begin MEASUREMENT MoF_tiGradNEngErrDeb "Debounce time for engine speed gradient in functione monitoring" UBYTE t_q0p01 1 100 0.00 2.550 FORMAT "%5.3" ECU_ADDRESS 0x60012100 /end MEASUREMENT
/begin MEASUREMENT MoF_tiGradNEngErrDebCpl "RAM data redundancy for MoF_tiGradNEngErrDeb" UBYTE OneToOne 1 100 0.00 255.0 FORMAT "%5.1" ECU_ADDRESS 0x60011A1C /end MEASUREMENT
/begin MEASUREMENT MoF_tiLast "system time from the previous call of the engine speed monitoring" ULONG OneToOne 1 100 0.00 4294967295.00 FORMAT "%13.2" ECU_ADDRESS 0x600120F4 /end MEASUREMENT
/begin MEASUREMENT MoF_tiLastCpl "RAM data redundancy for MoF_tiLast" ULONG OneToOne 1 100 0.00 4294967295.00 FORMAT "%13.2" ECU_ADDRESS 0x60011A0C /end MEASUREMENT
/begin MEASUREMENT Mo_bIrvICOL1 "State irreversible SKA from Level1 in function monitoring" UBYTE B_TRUE 1 100 0.00 1.00000000000 BIT_MASK 0x1 FORMAT "%13.11" ECU_ADDRESS 0x60011FDC /end MEASUREMENT
/begin MEASUREMENT Mo_bPostDrv "State PostDrive in function monitoring" UBYTE B_TRUE 1 100 0.00 1.00000000000 BIT_MASK 0x2 FORMAT "%13.11" ECU_ADDRESS 0x60011FDC /end MEASUREMENT
/begin MEASUREMENT Mo_bPreDrv "State PreDrive in function monitoring" UBYTE B_TRUE 1 100 0.00 1.00000000000 BIT_MASK 0x4 FORMAT "%13.11" ECU_ADDRESS 0x60011FDC /end MEASUREMENT
/begin MEASUREMENT Mo_bRvICOL1 "State reversible SKA from Level1 in function monitoring" UBYTE B_TRUE 1 100 0.00 1.00000000000 BIT_MASK 0x8 FORMAT "%13.11" ECU_ADDRESS 0x60011FDC /end MEASUREMENT
/begin MEASUREMENT Mo_stSysCpl "RAM data redundancy of Mo_stSys" UBYTE OneToOne 1 100 0.00 255.0 FORMAT "%5.1" ECU_ADDRESS 0x6001191C /end MEASUREMENT
/begin FUNCTION MoFDrDem_Co "173.1.0   Function Monitoring: Driver torque demand"
 /begin DEF_CHARACTERISTIC MoFDrDem_dfacRampDwn_M MoFDrDem_dfacRampUp_M MoFDrDem_dfacSptOff_M MoFDrDem_dfacSptOn_M MoFDrDem_stDrvModPrevSwt_C MoFDrDem_stDrvModSwt_C MoFDrDem_swtDrvModSeln_C MoFDrDem_tqEngEcoOrCmft_M MoFDrDem_tqEngSnow_M MoFDrDem_tqEngSpt_M MoFDrDem_tqMinWoRamp_C MoFTrqPtd_flgNotSwilLossCmp_C MoFTrqPtd_ratThdMaxCmp_C MoFTrqPtd_ratThdNoCmp_C MoFTrqPtd_ratWoCutOff_C MoFTrqPtd_tqEngApp_M MoFTrqPtd_tqEngSptApp_M MoF_trqEngAPP_M /end DEF_CHARACTERISTIC
 /begin IN_MEASUREMENT AccPed_trqDes MoFDrvPrgSwt_stDrvModSwt MoFESpd_nEng MoFTrqPtd_facCmpSpdGovr MoFTrqPtd_tqCmpNotSwilLoss MoFTrqPtd_tqCmpSwilLoss MoFTrqRat_rTrqPT MoF_rAPP MoF_trqInrMinWoCtOff MoF_trqLosTot Mo_stCplChk Mo_stMoC Mo_stMoCCpl /end IN_MEASUREMENT
 /begin OUT_MEASUREMENT MoFTrqPtd_tqWhlDrvDem /end OUT_MEASUREMENT
 /begin LOC_MEASUREMENT MoFDrDemCo_bbLoc1Cpl MoFDrDem_dfacFiveMod MoFDrDem_dfacFiveModCpl MoFDrDem_dfacSpt MoFDrDem_dfacSptCpl MoFDrDem_flgDrvModChg MoFDrDem_swtDrvMod MoFDrDem_swtDrvModCpl MoFDrDem_swtDrvModPrev MoFDrDem_swtDrvModPrevCpl MoFDrDem_tqCmpLoss MoFDrDem_tqCmpLossCpl MoFDrDem_tqCmpNotSwilLoss MoFDrDem_tqCmpNotSwilLossCpl MoFDrDem_tqCmpSwilLoss MoFDrDem_tqCmpSwilLossCpl MoFDrDem_tqEng MoFDrDem_tqEngApp MoFDrDem_tqEngAppCpl MoFDrDem_tqEngCpl MoFDrDem_tqInrMinWoCtOff MoFDrDem_tqInrMinWoCtOffCpl MoFDrDem_tqModNew MoFDrDem_tqModNewCpl MoFDrDem_tqModOld MoFDrDem_tqModOldCpl MoFDrDem_tqWhlDrvDem MoFDrDem_tqWhlDrvDemCpl MoFTrqPtd_facCmpAcs MoFTrqPtd_facCmpAcsCpl MoFTrqPtd_facMaxCmp MoFTrqPtd_facMaxCmpCpl MoFTrqPtd_tqWhlDrvDemCpl /end LOC_MEASUREMENT
 FUNCTION_VERSION "173.1.0" /end FUNCTION
/begin FUNCTION MoFDrDem_Min "2.1.0     Function Monitoring: Minimum driver torque demand"
 /begin DEF_CHARACTERISTIC MoFTrqPtd_tiOffDlyBrkRels_C MoFTrqPtd_tqWhlBrkMin_M MoFTrqPtd_tqWhlMin_M /end DEF_CHARACTERISTIC
 /begin IN_MEASUREMENT MoFBrk_flgMaiBrk MoFBrk_flgRdntBrk MoFTrqRat_rTrqPT MoFVSS_v Mo_stCplChk Mo_stMoC Mo_stMoCCpl /end IN_MEASUREMENT
 /begin OUT_MEASUREMENT MoFTrqPtd_flgSelBrkMin MoFTrqPtd_tqWhlMin /end OUT_MEASUREMENT
 /begin LOC_MEASUREMENT MoFDrDemMin_bbOut1Cpl MoFTrqPtd_tiOffDlyBrkRels MoFTrqPtd_tiOffDlyBrkRelsCpl MoFTrqPtd_tqWhlBrkMin_MP MoFTrqPtd_tqWhlMinCpl MoFTrqPtd_tqWhlMin_MP /end LOC_MEASUREMENT
 FUNCTION_VERSION "2.1.0" /end FUNCTION
/begin FUNCTION MoFDrvPrgSwt_Co "28.1.0    Function Monitoring: Desired driver program"
 /begin DEF_CHARACTERISTIC MoFDrvPrgSwt_stDrvModSel_CA MoFDrvPrgSwt_swtDrvModSeln_C MoFDrvPrgSwt_swtEcoModMaskL1_C /end DEF_CHARACTERISTIC
 /begin IN_MEASUREMENT AccPed_swtDrvMod AccPed_swtDrvModCpl MoFFrm_Rx_stEcoModOn Mo_stCplChk Mo_stMoC Mo_stMoCCpl /end IN_MEASUREMENT
 /begin OUT_MEASUREMENT MoFDrvPrgSwt_stDrvModSwt /end OUT_MEASUREMENT
 /begin LOC_MEASUREMENT MoFDrvPrgSwt_stDrvModSwtCpl MoFDrvPrgSwt_stDrvModSwtL1 MoFDrvPrgSwt_stDrvModSwtL1Cpl MoFDrvPrgSwt_stDrvModSwtL1Old MoFDrvPrgSwt_stDrvModSwtL1OldCpl /end LOC_MEASUREMENT
 FUNCTION_VERSION "28.1.0" /end FUNCTION
/begin FUNCTION MoFESpd_Co "37.10.0   Function Monitoring: Engine speed"
 /begin DEF_CHARACTERISTIC MoFESpd_cntrDebMaxSeln_C MoFESpd_cntrNoSyncDeb_C MoFESpd_cntrTstDeb_C MoFESpd_ctDeb_C MoFESpd_ctRst_C MoFESpd_nDiffMaxHiResl_C MoFESpd_nEng_Ax MoFESpd_nMinHiResl_C MoFESpd_tiGradNEngErrDeb_C MoF_nEng_DST /end DEF_CHARACTERISTIC
 /begin IN_MEASUREMENT MoXSyncLos_cntrSyncCplMsg MoXSyncLos_cntrSyncMsg MoXSyncLos_nEng10msMsg MoX_bSyncLos_msg Mo_ctRst Mo_ctRstCpl Mo_stCplChk Mo_stMoC Mo_stMoCCpl Mo_stMoF Mo_stMoFCpl /end IN_MEASUREMENT
 /begin OUT_MEASUREMENT MoFESpd_flgErrESpd MoFESpd_flgICOESpd MoFESpd_flgIrrvErrMsg MoFESpd_flgSigVld MoFESpd_nEng MoFESpd_nEngHiRes MoFESpd_nEng_Ax_result MoFESpd_stSync MoF_nEng MoF_nEng_DST_result /end OUT_MEASUREMENT
 /begin LOC_MEASUREMENT MoFESpdCo_bbLoc1Cpl MoFESpdCo_bbOutCpl MoFESpd_cntrNoSyncDeb MoFESpd_cntrNoSyncDebCpl MoFESpd_cntrSyncLvl1Old MoFESpd_cntrSyncLvl1OldCpl MoFESpd_ctDeb MoFESpd_ctDebCpl MoFESpd_deltaGT1Signd_MP MoFESpd_flgClr MoFESpd_flgGrdtNEngErr MoFESpd_flgNoSyncActv MoFESpd_flgTestMsg MoFESpd_frqTsk_MP MoFESpd_GT1Diff_MP MoFESpd_GT1_MP MoFESpd_nDiffHiResl_MP MoFESpd_nEngCpl MoFESpd_nEngCurr_MP MoFESpd_nEngHiResCpl MoFESpd_nEngHiReslL2_MP MoFESpd_nEng_Ax_result_Cpl MoFESpd_stSyncCpl MoFESpd_tiCurr_MP MoF_ctTstESpd MoF_nEngCpl MoF_nEng_DST_result_Cpl MoF_phiGT1Diff_mp MoF_phiGT1Last MoF_phiGT1LastCpl MoF_tiCurrDiff_mp MoF_tiDiff_mp MoF_tiGradNEngErrDeb MoF_tiGradNEngErrDebCpl MoF_tiLast MoF_tiLastCpl /end LOC_MEASUREMENT
 FUNCTION_VERSION "37.10.0" /end FUNCTION
/begin FUNCTION MoFETC_Co "109.1.0   Function Monitoring: Engine Test Coordinator"
 /begin DEF_CHARACTERISTIC MoFETC_cntrCurRunTestReq_C MoFETC_cntrTestIdleUpTOffDly_C MoFETC_cntrTestIdleUp_C MoFETC_cntrTestTOffDly_C MoFETC_cntrTest_C MoFETC_flgMonDiagDisblLck_C MoFETC_rAppLETThd_C MoFETC_rAppThd_C MoFETC_swtInactvTO_C MoFETC_vVehThd_C /end DEF_CHARACTERISTIC
 /begin IN_MEASUREMENT APP_flgATSActv APP_rLET APP_stLETAbort Etc_ctCurRunTst MoFBrk_flgBrk MoFVSS_v MoF_rAPP Mo_stCplChk Mo_stMoC Mo_stMoCCpl /end IN_MEASUREMENT
 /begin OUT_MEASUREMENT MoFETC_flgMonDiagEnaPlausMsg MoFETC_stTest MoFETC_stTstMsg MoF_bAirFlChkDisbl /end OUT_MEASUREMENT
 /begin LOC_MEASUREMENT MoFETCCo_bbLocCpl MoFETCCo_bbOutCpl MoFETC_cntrCurRunTestReq MoFETC_cntrCurRunTestReqCpl MoFETC_cntrTest MoFETC_cntrTestCpl MoFETC_cntrTestIdleUp MoFETC_cntrTestIdleUpCpl MoFETC_cntrTestIdleUpTOffDly MoFETC_cntrTestIdleUpTOffDlyCpl MoFETC_cntrTestTOffDly MoFETC_cntrTestTOffDlyCpl MoFETC_flgIdleUpstatus MoFETC_flgPosEdg MoFETC_stDiagTO MoFETC_stTestActv MoFETC_stTestActvCpl MoFETC_stTestCpl MoFETC_stTestPtd MoFETC_stTestPtdCpl /end LOC_MEASUREMENT
 FUNCTION_VERSION "109.1.0" /end FUNCTION
/begin FUNCTION MoFExtInt_Co "70.0.0    Function Monitoring: Coordination of ESP and transmission interventions"
 /begin DEF_CHARACTERISTIC MoFExtInt_ctDebDCSMax_C MoFExtInt_ctDebTSCMax_C MoFExtInt_flgSwtIncTSCIntvActvTq_C MoFExtInt_tqIncTSCIntvDesMin_C /end DEF_CHARACTERISTIC
 /begin IN_MEASUREMENT MoFDCS_flgPtd MoFDCS_tqCluPtd MoFTra_flgTSCPtd MoFTra_tqClthPtd Mo_stCplChk Mo_stMoC Mo_stMoCCpl Tra_stTSCPtd Tra_trqDesMin VMSI_stDCSPtd VMSI_tqCluMin /end IN_MEASUREMENT
 /begin OUT_MEASUREMENT MoFExtInt_stDCSPtdMsg MoFExtInt_stTSCPtdMsg MoFExtInt_tqCluPtdCoord MoFExtInt_tqCluPtdDCS MoFExtInt_tqCluPtdTSC /end OUT_MEASUREMENT
 /begin LOC_MEASUREMENT MoFExtInt_ctDebDCS MoFExtInt_ctDebDCSCpl MoFExtInt_ctDebTSC MoFExtInt_ctDebTSCCpl MoFExtInt_tqCluPtdCoordCpl MoFExtInt_tqCluPtdDCSCpl MoFExtInt_tqCluPtdTSCCpl /end LOC_MEASUREMENT
 FUNCTION_VERSION "70.0.0" /end FUNCTION
/begin FUNCTION MoFFrmCoorrCust_Rx "76.0.0    Function Monitoring: Frame Manager Customer Specific Coordinator Read Messages" /begin DEF_CHARACTERISTIC MoFFrmCoorrCust_Rx_swtEnaEATPlaus_C /end DEF_CHARACTERISTIC
 /begin IN_MEASUREMENT MoFFrm_Rx_flgATCVTShiftN_EATB MoFFrm_Rx_flgATCVTShiftP_EATB MoFFrm_Rx_flgCVTShiftSure_EATB MoFFrm_Rx_flgDCSPlus_AYCF MoFFrm_Rx_flgMaiSwt_META MoFFrm_Rx_flgTMStrtEna_EAT12 MoFFrm_Rx_flgTMStrtEna_EAT13 MoFFrm_Rx_rTrqCnvBoost_EAT1 MoFFrm_Rx_stACCActv_GWIMG3 MoFFrm_Rx_stButtonRaw_METL MoFFrm_Rx_stTqUpReqDCS_AYCF MoFFrm_Rx_tqCluTra_EAT4 MoFFrm_Rx_tqWhlDCS_AYCF Mo_stCplChk Mo_stMoC Mo_stMoCCpl /end IN_MEASUREMENT
 /begin OUT_MEASUREMENT MoFFrm_flgATCVTShiftN MoFFrm_flgATCVTShiftP MoFFrm_flgBrkHldActv MoFFrm_flgComErrDCS MoFFrm_flgCrsCtrlMaiSwt MoFFrm_flgCVTShiftSure MoFFrm_flgDCSPlus MoFFrm_flgEBBBrkPedlOn MoFFrm_flgStbErr MoFFrm_flgTMStrtEna MoFFrm_flgTqUpReqDCS MoFFrm_flgTqUpReqTra MoFFrm_rTqCnvrBoost MoFFrm_Rx_flgACCActv MoFFrm_Rx_stEcoModOn MoFFrm_stCrsCtrlSwt MoFFrm_tqCluTra MoFFrm_tqWhlDCS /end OUT_MEASUREMENT
 /begin LOC_MEASUREMENT MoFFrmCoorrCust_Rx_bbOut1Cpl MoFFrmCoorrCust_Rx_bbOutCpl MoFFrm_rTqCnvrBoostCpl MoFFrm_Rx_stEcoModOnCpl MoFFrm_stCrsCtrlSwtCpl MoFFrm_tqCluTraCpl MoFFrm_tqWhlDCSCpl /end LOC_MEASUREMENT
 FUNCTION_VERSION "76.0.0" /end FUNCTION
/begin FUNCTION MoFFrm_Lib "8.12.0    Function Monitoring: Library for Flexray sending and receiving"
 /begin DEF_CHARACTERISTIC MoFFrm_Lib_CRC16H1021Tab_CA MoFFrm_Lib_CRC82FHTab_CA MoFFrm_Lib_CRC8H1DTab_CA MoFFrm_Lib_DataApplSigInstance.divFac_C MoFFrm_Lib_DataApplSigInstance.mulFac_C MoFFrm_Lib_DataApplSigInstance.offsFac_C MoFFrm_Lib_DataPduRxInstance.bufLen_C MoFFrm_Lib_DataPduRxInstance.bytOrderAlvCntr_C MoFFrm_Lib_DataPduRxInstance.bytOrderCrc_C MoFFrm_Lib_DataPduRxInstance.cntrAlvErrDeb_C MoFFrm_Lib_DataPduRxInstance.cntrCrcErrDeb_C MoFFrm_Lib_DataPduRxInstance.cntrMaxAlvDif_C MoFFrm_Lib_DataPduRxInstance.cntrTiOutDeb_C MoFFrm_Lib_DataPduRxInstance.crcId_C MoFFrm_Lib_DataPduRxInstance.cycTi_C MoFFrm_Lib_DataPduRxInstance.diChks_C MoFFrm_Lib_DataPduRxInstance.evalType_C MoFFrm_Lib_DataPduRxInstance.maskAlvCntr_C MoFFrm_Lib_DataPduRxInstance.posnAlvCntrStrtBit_C MoFFrm_Lib_DataPduRxInstance.posnCrcCalcEndByte_C MoFFrm_Lib_DataPduRxInstance.posnCrcCalcStrtByte_C MoFFrm_Lib_DataPduRxInstance.posnCrcStrtBit_C MoFFrm_Lib_DataPduRxInstance.sigLenAlvCntr_C MoFFrm_Lib_DataPduRxInstance.sigLenCrc_C MoFFrm_Lib_DataPduTxInstance.bufLen_C MoFFrm_Lib_DataPduTxInstance.bytOrderAlvCntr_C MoFFrm_Lib_DataPduTxInstance.bytOrderCrc_C MoFFrm_Lib_DataPduTxInstance.crcId_C MoFFrm_Lib_DataPduTxInstance.evalType_C MoFFrm_Lib_DataPduTxInstance.posnAlvCntrStrtBit_C MoFFrm_Lib_DataPduTxInstance.posnCrcCalcEndByte_C MoFFrm_Lib_DataPduTxInstance.posnCrcCalcStrtByte_C MoFFrm_Lib_DataPduTxInstance.posnCrcStrtBit_C MoFFrm_Lib_DataPduTxInstance.sigLenAlvCntr_C MoFFrm_Lib_DataPduTxInstance.sigLenCrc_C /end DEF_CHARACTERISTIC
 /begin IN_MEASUREMENT Mo_stCplChk Mo_stMoC Mo_stMoCCpl /end IN_MEASUREMENT
 /begin OUT_MEASUREMENT dummyRx dummyTx MoFFrm_Lib_DataPduRxInstance.cntrAlvErrDeb MoFFrm_Lib_DataPduRxInstance.cntrAlvErrDebCpl MoFFrm_Lib_DataPduRxInstance.cntrAlvOld MoFFrm_Lib_DataPduRxInstance.cntrAlvOldCpl MoFFrm_Lib_DataPduRxInstance.cntrCrcErrDeb MoFFrm_Lib_DataPduRxInstance.cntrCrcErrDebCpl MoFFrm_Lib_DataPduRxInstance.cntrCycTi MoFFrm_Lib_DataPduRxInstance.cntrCycTiCpl MoFFrm_Lib_DataPduRxInstance.cntrTiOutDeb MoFFrm_Lib_DataPduRxInstance.cntrTiOutDebCpl MoFFrm_Lib_DataPduRxInstance.crcData MoFFrm_Lib_DataPduRxInstance.crcDataCpl MoFFrm_Lib_DataPduRxInstance.flgPduUpd MoFFrm_Lib_DataPduRxInstance.flgPduUpdCpl MoFFrm_Lib_DataPduTxInstance.cntrAlvOld MoFFrm_Lib_DataPduTxInstance.cntrAlvOldCpl MoFFrm_Lib_DataPduTxInstance.crcData MoFFrm_Lib_DataPduTxInstance.crcDataCpl MoFFrm_Lib_DataPduTxInstance.flgAswTrigTx MoFFrm_Lib_DataPduTxInstance.flgAswTrigTxCpl /end OUT_MEASUREMENT
 FUNCTION_VERSION "8.12.0" /end FUNCTION
/begin FUNCTION MoFFrm_Rx "187.0.0   Function Monitoring: Frame Manager - Received Messages"
 /begin DEF_CHARACTERISTIC MoFFrm_Rx_DataPdu_AYCF.bufLen_C MoFFrm_Rx_DataPdu_AYCF.bytOrderAlvCntr_C MoFFrm_Rx_DataPdu_AYCF.bytOrderCrc_C MoFFrm_Rx_DataPdu_AYCF.cntrAlvErrDeb_C MoFFrm_Rx_DataPdu_AYCF.cntrCrcErrDeb_C MoFFrm_Rx_DataPdu_AYCF.cntrMaxAlvDif_C MoFFrm_Rx_DataPdu_AYCF.cntrTiOutDeb_C MoFFrm_Rx_DataPdu_AYCF.crcId_C MoFFrm_Rx_DataPdu_AYCF.cycTi_C MoFFrm_Rx_DataPdu_AYCF.diChks_C MoFFrm_Rx_DataPdu_AYCF.evalType_C MoFFrm_Rx_DataPdu_AYCF.maskAlvCntr_C MoFFrm_Rx_DataPdu_AYCF.posnAlvCntrStrtBit_C MoFFrm_Rx_DataPdu_AYCF.posnCrcCalcEndByte_C MoFFrm_Rx_DataPdu_AYCF.posnCrcCalcStrtByte_C MoFFrm_Rx_DataPdu_AYCF.posnCrcStrtBit_C MoFFrm_Rx_DataPdu_AYCF.sigLenAlvCntr_C MoFFrm_Rx_DataPdu_AYCF.sigLenCrc_C MoFFrm_Rx_DataPdu_EAT1.bufLen_C MoFFrm_Rx_DataPdu_EAT1.bytOrderAlvCntr_C MoFFrm_Rx_DataPdu_EAT1.bytOrderCrc_C MoFFrm_Rx_DataPdu_EAT1.cntrAlvErrDeb_C MoFFrm_Rx_DataPdu_EAT1.cntrCrcErrDeb_C MoFFrm_Rx_DataPdu_EAT1.cntrMaxAlvDif_C MoFFrm_Rx_DataPdu_EAT1.cntrTiOutDeb_C MoFFrm_Rx_DataPdu_EAT1.crcId_C MoFFrm_Rx_DataPdu_EAT1.cycTi_C MoFFrm_Rx_DataPdu_EAT1.diChks_C MoFFrm_Rx_DataPdu_EAT1.evalType_C MoFFrm_Rx_DataPdu_EAT1.maskAlvCntr_C MoFFrm_Rx_DataPdu_EAT1.posnAlvCntrStrtBit_C MoFFrm_Rx_DataPdu_EAT1.posnCrcCalcEndByte_C MoFFrm_Rx_DataPdu_EAT1.posnCrcCalcStrtByte_C MoFFrm_Rx_DataPdu_EAT1.posnCrcStrtBit_C MoFFrm_Rx_DataPdu_EAT1.sigLenAlvCntr_C MoFFrm_Rx_DataPdu_EAT1.sigLenCrc_C MoFFrm_Rx_DataPdu_EAT12.bufLen_C MoFFrm_Rx_DataPdu_EAT12.bytOrderAlvCntr_C MoFFrm_Rx_DataPdu_EAT12.bytOrderCrc_C MoFFrm_Rx_DataPdu_EAT12.cntrAlvErrDeb_C MoFFrm_Rx_DataPdu_EAT12.cntrCrcErrDeb_C MoFFrm_Rx_DataPdu_EAT12.cntrMaxAlvDif_C MoFFrm_Rx_DataPdu_EAT12.cntrTiOutDeb_C MoFFrm_Rx_DataPdu_EAT12.crcId_C MoFFrm_Rx_DataPdu_EAT12.cycTi_C MoFFrm_Rx_DataPdu_EAT12.diChks_C MoFFrm_Rx_DataPdu_EAT12.evalType_C MoFFrm_Rx_DataPdu_EAT12.maskAlvCntr_C MoFFrm_Rx_DataPdu_EAT12.posnAlvCntrStrtBit_C MoFFrm_Rx_DataPdu_EAT12.posnCrcCalcEndByte_C MoFFrm_Rx_DataPdu_EAT12.posnCrcCalcStrtByte_C MoFFrm_Rx_DataPdu_EAT12.posnCrcStrtBit_C MoFFrm_Rx_DataPdu_EAT12.sigLenAlvCntr_C MoFFrm_Rx_DataPdu_EAT12.sigLenCrc_C MoFFrm_Rx_DataPdu_EAT13.bufLen_C MoFFrm_Rx_DataPdu_EAT13.bytOrderAlvCntr_C MoFFrm_Rx_DataPdu_EAT13.bytOrderCrc_C MoFFrm_Rx_DataPdu_EAT13.cntrAlvErrDeb_C MoFFrm_Rx_DataPdu_EAT13.cntrCrcErrDeb_C MoFFrm_Rx_DataPdu_EAT13.cntrMaxAlvDif_C MoFFrm_Rx_DataPdu_EAT13.cntrTiOutDeb_C MoFFrm_Rx_DataPdu_EAT13.crcId_C MoFFrm_Rx_DataPdu_EAT13.cycTi_C MoFFrm_Rx_DataPdu_EAT13.diChks_C MoFFrm_Rx_DataPdu_EAT13.evalType_C MoFFrm_Rx_DataPdu_EAT13.maskAlvCntr_C MoFFrm_Rx_DataPdu_EAT13.posnAlvCntrStrtBit_C MoFFrm_Rx_DataPdu_EAT13.posnCrcCalcEndByte_C MoFFrm_Rx_DataPdu_EAT13.posnCrcCalcStrtByte_C MoFFrm_Rx_DataPdu_EAT13.posnCrcStrtBit_C MoFFrm_Rx_DataPdu_EAT13.sigLenAlvCntr_C MoFFrm_Rx_DataPdu_EAT13.sigLenCrc_C MoFFrm_Rx_DataPdu_EAT4.bufLen_C MoFFrm_Rx_DataPdu_EAT4.bytOrderAlvCntr_C MoFFrm_Rx_DataPdu_EAT4.bytOrderCrc_C MoFFrm_Rx_DataPdu_EAT4.cntrAlvErrDeb_C MoFFrm_Rx_DataPdu_EAT4.cntrCrcErrDeb_C MoFFrm_Rx_DataPdu_EAT4.cntrMaxAlvDif_C MoFFrm_Rx_DataPdu_EAT4.cntrTiOutDeb_C MoFFrm_Rx_DataPdu_EAT4.crcId_C MoFFrm_Rx_DataPdu_EAT4.cycTi_C MoFFrm_Rx_DataPdu_EAT4.diChks_C MoFFrm_Rx_DataPdu_EAT4.evalType_C MoFFrm_Rx_DataPdu_EAT4.maskAlvCntr_C MoFFrm_Rx_DataPdu_EAT4.posnAlvCntrStrtBit_C MoFFrm_Rx_DataPdu_EAT4.posnCrcCalcEndByte_C MoFFrm_Rx_DataPdu_EAT4.posnCrcCalcStrtByte_C MoFFrm_Rx_DataPdu_EAT4.posnCrcStrtBit_C MoFFrm_Rx_DataPdu_EAT4.sigLenAlvCntr_C MoFFrm_Rx_DataPdu_EAT4.sigLenCrc_C MoFFrm_Rx_DataPdu_EATB.bufLen_C MoFFrm_Rx_DataPdu_EATB.bytOrderAlvCntr_C MoFFrm_Rx_DataPdu_EATB.bytOrderCrc_C MoFFrm_Rx_DataPdu_EATB.cntrAlvErrDeb_C MoFFrm_Rx_DataPdu_EATB.cntrCrcErrDeb_C MoFFrm_Rx_DataPdu_EATB.cntrMaxAlvDif_C MoFFrm_Rx_DataPdu_EATB.cntrTiOutDeb_C MoFFrm_Rx_DataPdu_EATB.crcId_C MoFFrm_Rx_DataPdu_EATB.cycTi_C MoFFrm_Rx_DataPdu_EATB.diChks_C MoFFrm_Rx_DataPdu_EATB.evalType_C MoFFrm_Rx_DataPdu_EATB.maskAlvCntr_C MoFFrm_Rx_DataPdu_EATB.posnAlvCntrStrtBit_C MoFFrm_Rx_DataPdu_EATB.posnCrcCalcEndByte_C MoFFrm_Rx_DataPdu_EATB.posnCrcCalcStrtByte_C MoFFrm_Rx_DataPdu_EATB.posnCrcStrtBit_C MoFFrm_Rx_DataPdu_EATB.sigLenAlvCntr_C MoFFrm_Rx_DataPdu_EATB.sigLenCrc_C MoFFrm_Rx_DataPdu_GWIMG3.bufLen_C MoFFrm_Rx_DataPdu_GWIMG3.bytOrderAlvCntr_C MoFFrm_Rx_DataPdu_GWIMG3.bytOrderCrc_C MoFFrm_Rx_DataPdu_GWIMG3.cntrAlvErrDeb_C MoFFrm_Rx_DataPdu_GWIMG3.cntrCrcErrDeb_C MoFFrm_Rx_DataPdu_GWIMG3.cntrMaxAlvDif_C MoFFrm_Rx_DataPdu_GWIMG3.cntrTiOutDeb_C MoFFrm_Rx_DataPdu_GWIMG3.crcId_C MoFFrm_Rx_DataPdu_GWIMG3.cycTi_C MoFFrm_Rx_DataPdu_GWIMG3.diChks_C MoFFrm_Rx_DataPdu_GWIMG3.evalType_C MoFFrm_Rx_DataPdu_GWIMG3.maskAlvCntr_C MoFFrm_Rx_DataPdu_GWIMG3.posnAlvCntrStrtBit_C MoFFrm_Rx_DataPdu_GWIMG3.posnCrcCalcEndByte_C MoFFrm_Rx_DataPdu_GWIMG3.posnCrcCalcStrtByte_C MoFFrm_Rx_DataPdu_GWIMG3.posnCrcStrtBit_C MoFFrm_Rx_DataPdu_GWIMG3.sigLenAlvCntr_C MoFFrm_Rx_DataPdu_GWIMG3.sigLenCrc_C MoFFrm_Rx_DataPdu_META.bufLen_C MoFFrm_Rx_DataPdu_META.bytOrderAlvCntr_C MoFFrm_Rx_DataPdu_META.bytOrderCrc_C MoFFrm_Rx_DataPdu_META.cntrAlvErrDeb_C MoFFrm_Rx_DataPdu_META.cntrCrcErrDeb_C MoFFrm_Rx_DataPdu_META.cntrMaxAlvDif_C MoFFrm_Rx_DataPdu_META.cntrTiOutDeb_C MoFFrm_Rx_DataPdu_META.crcId_C MoFFrm_Rx_DataPdu_META.cycTi_C MoFFrm_Rx_DataPdu_META.diChks_C MoFFrm_Rx_DataPdu_META.evalType_C MoFFrm_Rx_DataPdu_META.maskAlvCntr_C MoFFrm_Rx_DataPdu_META.posnAlvCntrStrtBit_C MoFFrm_Rx_DataPdu_META.posnCrcCalcEndByte_C MoFFrm_Rx_DataPdu_META.posnCrcCalcStrtByte_C MoFFrm_Rx_DataPdu_META.posnCrcStrtBit_C MoFFrm_Rx_DataPdu_META.sigLenAlvCntr_C MoFFrm_Rx_DataPdu_META.sigLenCrc_C MoFFrm_Rx_DataPdu_METL.bufLen_C MoFFrm_Rx_DataPdu_METL.bytOrderAlvCntr_C MoFFrm_Rx_DataPdu_METL.bytOrderCrc_C MoFFrm_Rx_DataPdu_METL.cntrAlvErrDeb_C MoFFrm_Rx_DataPdu_METL.cntrCrcErrDeb_C MoFFrm_Rx_DataPdu_METL.cntrMaxAlvDif_C MoFFrm_Rx_DataPdu_METL.cntrTiOutDeb_C MoFFrm_Rx_DataPdu_METL.crcId_C MoFFrm_Rx_DataPdu_METL.cycTi_C MoFFrm_Rx_DataPdu_METL.diChks_C MoFFrm_Rx_DataPdu_METL.evalType_C MoFFrm_Rx_DataPdu_METL.maskAlvCntr_C MoFFrm_Rx_DataPdu_METL.posnAlvCntrStrtBit_C MoFFrm_Rx_DataPdu_METL.posnCrcCalcEndByte_C MoFFrm_Rx_DataPdu_METL.posnCrcCalcStrtByte_C MoFFrm_Rx_DataPdu_METL.posnCrcStrtBit_C MoFFrm_Rx_DataPdu_METL.sigLenAlvCntr_C MoFFrm_Rx_DataPdu_METL.sigLenCrc_C /end DEF_CHARACTERISTIC
 /begin IN_MEASUREMENT MoXFrm_Buf_AYCF MoXFrm_Buf_EAT1 MoXFrm_Buf_EAT12 MoXFrm_Buf_EAT13 MoXFrm_Buf_EAT4 MoXFrm_Buf_EATB MoXFrm_Buf_GWIMG3 MoXFrm_Buf_META MoXFrm_Buf_METL MoXFrm_flgUpdAYCF MoXFrm_flgUpdEAT1 MoXFrm_flgUpdEAT12 MoXFrm_flgUpdEAT13 MoXFrm_flgUpdEAT4 MoXFrm_flgUpdEATB MoXFrm_flgUpdGWIMG3 MoXFrm_flgUpdMETA MoXFrm_flgUpdMETL Mo_stCplChk Mo_stMoC Mo_stMoCCpl /end IN_MEASUREMENT
 /begin OUT_MEASUREMENT MoFFrm_flgComErrACC MoFFrm_flgDecIntvActvDCS MoFFrm_flgDecIntvActvTra MoFFrm_flgTqUpReqACC MoFFrm_Rx_flgATCVTShiftN_EATB MoFFrm_Rx_flgATCVTShiftP_EATB MoFFrm_Rx_flgBrkHldActv_GWIMG4 MoFFrm_Rx_flgCVTShiftSure_EATB MoFFrm_Rx_flgDCSPlus_AYCF MoFFrm_Rx_flgEBBBrkPedlOn_EBBA MoFFrm_Rx_flgMaiSwt_META MoFFrm_Rx_flgTMStrtEna_EAT12 MoFFrm_Rx_flgTMStrtEna_EAT13 MoFFrm_Rx_rTrqCnvBoost_EAT1 MoFFrm_Rx_stACCActv_GWIMG3 MoFFrm_Rx_stButtonRaw_METL MoFFrm_Rx_stEcoModOn_METD MoFFrm_Rx_stPdu_AYCF MoFFrm_Rx_stPdu_EAT1 MoFFrm_Rx_stPdu_EAT12 MoFFrm_Rx_stPdu_EAT13 MoFFrm_Rx_stPdu_EAT4 MoFFrm_Rx_stPdu_EATB MoFFrm_Rx_stPdu_EBBA MoFFrm_Rx_stPdu_GWIMG3 MoFFrm_Rx_stPdu_GWIMG4 MoFFrm_Rx_stPdu_META MoFFrm_Rx_stPdu_METD MoFFrm_Rx_stPdu_METL MoFFrm_Rx_stTqUpReqDCS_AYCF MoFFrm_Rx_tqCluTra_EAT4 MoFFrm_Rx_tqWhlDCS_AYCF MoFFrm_tqWhlACC /end OUT_MEASUREMENT
 /begin LOC_MEASUREMENT MoFFrmRx_bbMoFFrm_Rx_flgATCVTShiftN_EATBCpl MoFFrmRx_bbMoFFrm_Rx_flgATCVTShiftP_EATBCpl MoFFrmRx_bbMoFFrm_Rx_flgBrkHldActv_GWIMG4Cpl MoFFrmRx_bbMoFFrm_Rx_flgCVTShiftSure_EATBCpl MoFFrmRx_bbMoFFrm_Rx_flgDCSPlus_AYCFCpl MoFFrmRx_bbMoFFrm_Rx_flgEBBBrkPedlOn_EBBACpl MoFFrmRx_bbMoFFrm_Rx_flgMaiSwt_METACpl MoFFrmRx_bbMoFFrm_Rx_flgTMStrtEna_EAT12Cpl MoFFrmRx_bbMoFFrm_Rx_flgTMStrtEna_EAT13Cpl MoFFrm_Rx_bbOut1Cpl MoFFrm_Rx_DataPdu_AYCF.cntrAlvErrDeb MoFFrm_Rx_DataPdu_AYCF.cntrAlvErrDebCpl MoFFrm_Rx_DataPdu_AYCF.cntrAlvOld MoFFrm_Rx_DataPdu_AYCF.cntrAlvOldCpl MoFFrm_Rx_DataPdu_AYCF.cntrCrcErrDeb MoFFrm_Rx_DataPdu_AYCF.cntrCrcErrDebCpl MoFFrm_Rx_DataPdu_AYCF.cntrCycTi MoFFrm_Rx_DataPdu_AYCF.cntrCycTiCpl MoFFrm_Rx_DataPdu_AYCF.cntrTiOutDeb MoFFrm_Rx_DataPdu_AYCF.cntrTiOutDebCpl MoFFrm_Rx_DataPdu_AYCF.crcData MoFFrm_Rx_DataPdu_AYCF.crcDataCpl MoFFrm_Rx_DataPdu_AYCF.flgPduUpd MoFFrm_Rx_DataPdu_AYCF.flgPduUpdCpl MoFFrm_Rx_DataPdu_EAT1.cntrAlvErrDeb MoFFrm_Rx_DataPdu_EAT1.cntrAlvErrDebCpl MoFFrm_Rx_DataPdu_EAT1.cntrAlvOld MoFFrm_Rx_DataPdu_EAT1.cntrAlvOldCpl MoFFrm_Rx_DataPdu_EAT1.cntrCrcErrDeb MoFFrm_Rx_DataPdu_EAT1.cntrCrcErrDebCpl MoFFrm_Rx_DataPdu_EAT1.cntrCycTi MoFFrm_Rx_DataPdu_EAT1.cntrCycTiCpl MoFFrm_Rx_DataPdu_EAT1.cntrTiOutDeb MoFFrm_Rx_DataPdu_EAT1.cntrTiOutDebCpl MoFFrm_Rx_DataPdu_EAT1.crcData MoFFrm_Rx_DataPdu_EAT1.crcDataCpl MoFFrm_Rx_DataPdu_EAT1.flgPduUpd MoFFrm_Rx_DataPdu_EAT1.flgPduUpdCpl MoFFrm_Rx_DataPdu_EAT12.cntrAlvErrDeb MoFFrm_Rx_DataPdu_EAT12.cntrAlvErrDebCpl MoFFrm_Rx_DataPdu_EAT12.cntrAlvOld MoFFrm_Rx_DataPdu_EAT12.cntrAlvOldCpl MoFFrm_Rx_DataPdu_EAT12.cntrCrcErrDeb MoFFrm_Rx_DataPdu_EAT12.cntrCrcErrDebCpl MoFFrm_Rx_DataPdu_EAT12.cntrCycTi MoFFrm_Rx_DataPdu_EAT12.cntrCycTiCpl MoFFrm_Rx_DataPdu_EAT12.cntrTiOutDeb MoFFrm_Rx_DataPdu_EAT12.cntrTiOutDebCpl MoFFrm_Rx_DataPdu_EAT12.crcData MoFFrm_Rx_DataPdu_EAT12.crcDataCpl MoFFrm_Rx_DataPdu_EAT12.flgPduUpd MoFFrm_Rx_DataPdu_EAT12.flgPduUpdCpl MoFFrm_Rx_DataPdu_EAT13.cntrAlvErrDeb MoFFrm_Rx_DataPdu_EAT13.cntrAlvErrDebCpl MoFFrm_Rx_DataPdu_EAT13.cntrAlvOld MoFFrm_Rx_DataPdu_EAT13.cntrAlvOldCpl MoFFrm_Rx_DataPdu_EAT13.cntrCrcErrDeb MoFFrm_Rx_DataPdu_EAT13.cntrCrcErrDebCpl MoFFrm_Rx_DataPdu_EAT13.cntrCycTi MoFFrm_Rx_DataPdu_EAT13.cntrCycTiCpl MoFFrm_Rx_DataPdu_EAT13.cntrTiOutDeb MoFFrm_Rx_DataPdu_EAT13.cntrTiOutDebCpl MoFFrm_Rx_DataPdu_EAT13.crcData MoFFrm_Rx_DataPdu_EAT13.crcDataCpl MoFFrm_Rx_DataPdu_EAT13.flgPduUpd MoFFrm_Rx_DataPdu_EAT13.flgPduUpdCpl MoFFrm_Rx_DataPdu_EAT4.cntrAlvErrDeb MoFFrm_Rx_DataPdu_EAT4.cntrAlvErrDebCpl MoFFrm_Rx_DataPdu_EAT4.cntrAlvOld MoFFrm_Rx_DataPdu_EAT4.cntrAlvOldCpl MoFFrm_Rx_DataPdu_EAT4.cntrCrcErrDeb MoFFrm_Rx_DataPdu_EAT4.cntrCrcErrDebCpl MoFFrm_Rx_DataPdu_EAT4.cntrCycTi MoFFrm_Rx_DataPdu_EAT4.cntrCycTiCpl MoFFrm_Rx_DataPdu_EAT4.cntrTiOutDeb MoFFrm_Rx_DataPdu_EAT4.cntrTiOutDebCpl MoFFrm_Rx_DataPdu_EAT4.crcData MoFFrm_Rx_DataPdu_EAT4.crcDataCpl MoFFrm_Rx_DataPdu_EAT4.flgPduUpd MoFFrm_Rx_DataPdu_EAT4.flgPduUpdCpl MoFFrm_Rx_DataPdu_EATB.cntrAlvErrDeb MoFFrm_Rx_DataPdu_EATB.cntrAlvErrDebCpl MoFFrm_Rx_DataPdu_EATB.cntrAlvOld MoFFrm_Rx_DataPdu_EATB.cntrAlvOldCpl MoFFrm_Rx_DataPdu_EATB.cntrCrcErrDeb MoFFrm_Rx_DataPdu_EATB.cntrCrcErrDebCpl MoFFrm_Rx_DataPdu_EATB.cntrCycTi MoFFrm_Rx_DataPdu_EATB.cntrCycTiCpl MoFFrm_Rx_DataPdu_EATB.cntrTiOutDeb MoFFrm_Rx_DataPdu_EATB.cntrTiOutDebCpl MoFFrm_Rx_DataPdu_EATB.crcData MoFFrm_Rx_DataPdu_EATB.crcDataCpl MoFFrm_Rx_DataPdu_EATB.flgPduUpd MoFFrm_Rx_DataPdu_EATB.flgPduUpdCpl MoFFrm_Rx_DataPdu_GWIMG3.cntrAlvErrDeb MoFFrm_Rx_DataPdu_GWIMG3.cntrAlvErrDebCpl MoFFrm_Rx_DataPdu_GWIMG3.cntrAlvOld MoFFrm_Rx_DataPdu_GWIMG3.cntrAlvOldCpl MoFFrm_Rx_DataPdu_GWIMG3.cntrCrcErrDeb MoFFrm_Rx_DataPdu_GWIMG3.cntrCrcErrDebCpl MoFFrm_Rx_DataPdu_GWIMG3.cntrCycTi MoFFrm_Rx_DataPdu_GWIMG3.cntrCycTiCpl MoFFrm_Rx_DataPdu_GWIMG3.cntrTiOutDeb MoFFrm_Rx_DataPdu_GWIMG3.cntrTiOutDebCpl MoFFrm_Rx_DataPdu_GWIMG3.crcData MoFFrm_Rx_DataPdu_GWIMG3.crcDataCpl MoFFrm_Rx_DataPdu_GWIMG3.flgPduUpd MoFFrm_Rx_DataPdu_GWIMG3.flgPduUpdCpl MoFFrm_Rx_DataPdu_META.cntrAlvErrDeb MoFFrm_Rx_DataPdu_META.cntrAlvErrDebCpl MoFFrm_Rx_DataPdu_META.cntrAlvOld MoFFrm_Rx_DataPdu_META.cntrAlvOldCpl MoFFrm_Rx_DataPdu_META.cntrCrcErrDeb MoFFrm_Rx_DataPdu_META.cntrCrcErrDebCpl MoFFrm_Rx_DataPdu_META.cntrCycTi MoFFrm_Rx_DataPdu_META.cntrCycTiCpl MoFFrm_Rx_DataPdu_META.cntrTiOutDeb MoFFrm_Rx_DataPdu_META.cntrTiOutDebCpl MoFFrm_Rx_DataPdu_META.crcData MoFFrm_Rx_DataPdu_META.crcDataCpl MoFFrm_Rx_DataPdu_META.flgPduUpd MoFFrm_Rx_DataPdu_META.flgPduUpdCpl MoFFrm_Rx_DataPdu_METL.cntrAlvErrDeb MoFFrm_Rx_DataPdu_METL.cntrAlvErrDebCpl MoFFrm_Rx_DataPdu_METL.cntrAlvOld MoFFrm_Rx_DataPdu_METL.cntrAlvOldCpl MoFFrm_Rx_DataPdu_METL.cntrCrcErrDeb MoFFrm_Rx_DataPdu_METL.cntrCrcErrDebCpl MoFFrm_Rx_DataPdu_METL.cntrCycTi MoFFrm_Rx_DataPdu_METL.cntrCycTiCpl MoFFrm_Rx_DataPdu_METL.cntrTiOutDeb MoFFrm_Rx_DataPdu_METL.cntrTiOutDebCpl MoFFrm_Rx_DataPdu_METL.crcData MoFFrm_Rx_DataPdu_METL.crcDataCpl MoFFrm_Rx_DataPdu_METL.flgPduUpd MoFFrm_Rx_DataPdu_METL.flgPduUpdCpl MoFFrm_Rx_mirrBuf MoFFrm_Rx_rawCVT_SHFT_IN_NEUTRAL MoFFrm_Rx_rawCVT_SHFT_IN_PARKING MoFFrm_Rx_rawCVT_SHIFT_SURE MoFFrm_Rx_rawIMG_DRVTRQ_STATUS MoFFrm_Rx_rawMETER_CC_MAIN_STATUS MoFFrm_Rx_rawMETER_SW_STATUS_CC_STANDARD MoFFrm_Rx_rawTM_REQ_ENG_TORQUE_FAST MoFFrm_Rx_rawTM_START_ENABLE MoFFrm_Rx_rawTM_START_ENABLESUB MoFFrm_Rx_rawTM_TORQUE_CONV_TORQUE_RATIO MoFFrm_Rx_rawVSA_REQ_MSR_PLUS_TRQ MoFFrm_Rx_rawVSA_REQ_TRQ_1AC MoFFrm_Rx_rawVSA_TRQ_CONTROL_MODE MoFFrm_Rx_rTrqCnvBoost_EAT1Cpl MoFFrm_Rx_stACCActv_GWIMG3Cpl MoFFrm_Rx_stButtonRaw_METLCpl MoFFrm_Rx_stEcoModOn_METDCpl MoFFrm_Rx_stPdu_AYCFCpl MoFFrm_Rx_stPdu_EAT12Cpl MoFFrm_Rx_stPdu_EAT13Cpl MoFFrm_Rx_stPdu_EAT1Cpl MoFFrm_Rx_stPdu_EAT4Cpl MoFFrm_Rx_stPdu_EATBCpl MoFFrm_Rx_stPdu_EBBACpl MoFFrm_Rx_stPdu_GWIMG3Cpl MoFFrm_Rx_stPdu_GWIMG4Cpl MoFFrm_Rx_stPdu_METACpl MoFFrm_Rx_stPdu_METDCpl MoFFrm_Rx_stPdu_METLCpl MoFFrm_Rx_stTqUpReqDCS_AYCFCpl MoFFrm_Rx_tqCluTra_EAT4Cpl MoFFrm_Rx_tqWhlDCS_AYCFCpl MoFFrm_tqWhlACCCpl /end LOC_MEASUREMENT
 FUNCTION_VERSION "187.0.0" /end FUNCTION
/begin FUNCTION MoFHybRx_Co "30.1.0    Function Monitoring: Input signals from hybrid system" /begin DEF_CHARACTERISTIC MoFHybRx_flgComErrElDrv_C MoFHybRx_flgIrvErrDelDrv_C /end DEF_CHARACTERISTIC /begin IN_MEASUREMENT Mo_stCplChk Mo_stMoC Mo_stMoCCpl /end IN_MEASUREMENT
 /begin OUT_MEASUREMENT MoFHybRx_flgComErrElDrv MoFHybRx_flgIrvErrElDrv MoFHybRx_tqActEm /end OUT_MEASUREMENT
 /begin LOC_MEASUREMENT MoFHybRxCo_bbOut1Cpl MoFHybRx_tqActEmCpl /end LOC_MEASUREMENT
 FUNCTION_VERSION "30.1.0" /end FUNCTION
/begin FUNCTION MoFIA_Co "33.1.0    Function Monitoring: Ignition angle"
 /begin DEF_CHARACTERISTIC MoFIA_cntrErrDebMaxIACo_C MoFIA_cntrRstMaxIACo_C MoFIA_nErrHndlgActvnIACo_C /end DEF_CHARACTERISTIC
 /begin REF_CHARACTERISTIC MoFAirFl_nrCylTot_C /end REF_CHARACTERISTIC
 /begin IN_MEASUREMENT MoFAirFl_TrqActIfClass_V13I.agIntkClsd MoFAirFl_TrqActIfClass_V13I.dzworri MoFAirFl_TrqActIfClass_V13I.etaaufte MoFAirFl_TrqActIfClass_V13I.etazwist MoFAirFl_TrqActIfClass_V13I.ratInertCyl MoFAirFl_TrqActIfClass_V13I.ratInertEgrExtCyl MoFAirFl_TrqActIfClass_V13I.ratInertEgrIntCyl MoFAirFl_TrqActIfClass_V13I.zwcalcar_zzylzue MoFAirFl_TrqActIfClass_V13I.zwopt MoFAirFl_TrqActIfClass_V13I.zwout MoFAirFl_TrqActIfClass_V13I.zwoutcpl MoFAirFl_TrqActIfClass_V13I.zwouthiresl MoFAirFl_TrqActIfClass_V13I.zwouthireslAry_zzylzue MoFAirFl_TrqActIfClass_V13I.zwouthireslRdnt MoFESpd_nEng MoF_bAirFlChkDisbl Mo_bPostDrv Mo_bPreDrv Mo_ctRst Mo_ctRstCpl Mo_stCplChk Mo_stMoC Mo_stMoCCpl Mo_stMoF Mo_stMoFCpl /end IN_MEASUREMENT
 /begin OUT_MEASUREMENT MoFIA_flgIrrvErrMsg MoFIA_flgTestIACoMsg MoFIA_iaOutp MoFIA_iaOutpHiResl /end OUT_MEASUREMENT
 /begin LOC_MEASUREMENT MoFIA_cntrDiagDebIACo MoFIA_cntrErrDebIACo MoFIA_cntrErrDebIACoCpl MoFIA_flgClr MoFIA_iaOutpCpl MoFIA_iaOutpHiReslCpl /end LOC_MEASUREMENT
 FUNCTION_VERSION "33.1.0" /end FUNCTION
/begin FUNCTION MoFICO_Co "57.2.0    Function Monitoring: Injection Cut Off"
 /begin DEF_CHARACTERISTIC MoFICO_nEngThdESM_T MoFICO_nMaxVDpd_Cur MoF_ctICOIgn_C MoF_ctICOInj_C MoF_ctIgnDel_C MoF_ctPCPDel_C MoF_nMaxAppDfct_C MoF_nMax_C /end DEF_CHARACTERISTIC
 /begin IN_MEASUREMENT MoFAirFl_stCtOffMask MoFAPP_flgPlausErrDeb MoFAPP_ratHiResl MoFESpd_nEngHiRes MoFVSS_v MoF_ctInjPCPCurr MoF_ignCtOffMsk Mo_bPostDrv Mo_bPreDrv Mo_stCplChk Mo_stMoC Mo_stMoCCpl Mo_stMoF Mo_stMoFCpl /end IN_MEASUREMENT
 /begin LOC_MEASUREMENT MoFICO_cntrTestICOL1 MoFICO_cntrTestICOL2 MoFICO_flgClrICOL1 MoFICO_flgClrICOL2 MoFICO_flgIrrvErrICOL1Msg MoFICO_flgIrrvErrICOL2Msg MoFICO_flgTestICOL1Msg MoFICO_flgTestICOL2Msg MoF_ctICOIgn MoF_ctICOIgnCpl MoF_ctICOInj MoF_ctICOInjCpl MoF_ctIgnDel MoF_ctIgnDelCpl MoF_ctInjPCPOld MoF_ctInjPCPOldCpl MoF_ctPCPDel MoF_ctPCPDelCpl MoF_nMax_MP /end LOC_MEASUREMENT
 FUNCTION_VERSION "57.2.0" /end FUNCTION
/begin FUNCTION MoFIn_Co "90.0.0    Function Monitoring: Input signals"
 /begin DEF_CHARACTERISTIC MoFIn_ctInjPCPTst_CW MoFIn_ignCtOffTst_CW MoFIn_stPPDrvTst_CW /end DEF_CHARACTERISTIC
 /begin IN_MEASUREMENT azoffmsk_w_msg Mo_stCplChk Mo_stMoC Mo_stMoCCpl Mo_stMoF Mo_stMoFCpl SyC_stSub ThrVlv_flgIrrvFuCutOffB1 ThrVlv_flgLimpModeB1 ThrVlv_flgRvsbFuCutOffB1 ThrVlv_flgUBattSuffB1 /end IN_MEASUREMENT
 /begin OUT_MEASUREMENT MoF_ctInjPCPCurr MoF_ignCtOffMsk Mo_bIrvICOL1 Mo_bPostDrv Mo_bPreDrv Mo_bRvICOL1 /end OUT_MEASUREMENT
 /begin LOC_MEASUREMENT MoF_ctInjPCPCurrCpl MoF_ignCtOffMskCpl Mo_stSysCpl /end LOC_MEASUREMENT
 FUNCTION_VERSION "90.0.0" /end FUNCTION
/begin FUNCTION MoFSpdG_Co "64.4.0    Function Monitoring: Speed governor torque"
 /begin DEF_CHARACTERISTIC MoFSpdG_facTqLtd_CUR MoFTrqPtd_nSpdGovMax_C MoFTrqPtd_nSpdGovTrckMax_C MoFTrqPtd_tqSpdGovPtdOfs_T /end DEF_CHARACTERISTIC
 /begin IN_MEASUREMENT HLSDem_nSetPLo HLSDem_nSetPTrck LIGov_nDiff MoFESpd_nEng MoFTrqPtd_tqCmpSwilLoss MoF_trqLosTot Mo_stCplChk Mo_stMoC Mo_stMoCCpl SpdGov_facComp SpdGov_trqClth /end IN_MEASUREMENT
 /begin OUT_MEASUREMENT MoFSpdG_flgWesDem MoFSpdG_tqPtd MoFTrqPtd_facCmpSpdGovr /end OUT_MEASUREMENT
 /begin LOC_MEASUREMENT MoFSpdGCo_bbOutCpl MoFSpdG_tqPtdCpl MoFSpdG_tqSpdGovPtd_MP MoFTrqPtd_facCmpSpdGovrCpl MoFTrqPtd_nDifSpdGovr MoFTrqPtd_nDifSpdGovrCpl /end LOC_MEASUREMENT
 FUNCTION_VERSION "64.4.0" /end FUNCTION
/begin FUNCTION MoFSrv_Lib "24.9.0    Function Monitoring: Service library" /begin IN_MEASUREMENT Mo_stCplChk Mo_stMoC Mo_stMoCCpl /end IN_MEASUREMENT FUNCTION_VERSION "24.9.0" /end FUNCTION
/begin FUNCTION MoFStrt_Co "126.0.0   Function Monitoring: Start" /begin DEF_CHARACTERISTIC MoFStrt_swtISSDisbl_C /end DEF_CHARACTERISTIC /begin IN_MEASUREMENT MoFStrt_stT50 Mo_stCplChk Mo_stMoC Mo_stMoCCpl /end IN_MEASUREMENT /begin OUT_MEASUREMENT MoFStrt_flgStrtPtd MoFStrt_flgStrtRly MoFStrt_stStrtActv /end OUT_MEASUREMENT
 /begin LOC_MEASUREMENT MoFStrtCo_bbOutCpl MoFStrt_flgPs1Actv MoFStrt_flgPs2Actv MoFStrt_stStrtActvCpl /end LOC_MEASUREMENT
 FUNCTION_VERSION "126.0.0" /end FUNCTION
/begin COMPU_METHOD B_TRUE "" TAB_VERB "%6.3" "" COMPU_TAB_REF B_TRUE /end COMPU_METHOD
/begin COMPU_VTAB B_TRUE "" TAB_VERB 2 0 "FALSE" 1 "TRUE" /end COMPU_VTAB
/begin COMPU_METHOD dez "" RAT_FUNC "%6.2" "" COEFFS 0 1 0 0 0 1 /end COMPU_METHOD
/begin COMPU_METHOD Fact1000 "" RAT_FUNC "%6.5" "-" COEFFS 0 1000 0 0 0 1 /end COMPU_METHOD
/begin COMPU_METHOD fak_q0p01 "" RAT_FUNC "%6.4" "" COEFFS 0 100 0 0 0 1 /end COMPU_METHOD
/begin COMPU_METHOD fak_q6p1035Em5_AFm16 "" RAT_FUNC "%17.12" "-" COEFFS 0 16384 0 0 0 1 /end COMPU_METHOD
/begin COMPU_METHOD freq_q0p001 "" RAT_FUNC "%6.5" "Hz" COEFFS 0 1000 0 0 0 1 /end COMPU_METHOD
/begin COMPU_METHOD kw_sw_q0p0219 "" RAT_FUNC "%6.4" "Grad KW" COEFFS 0 32768 0 0 0 720 /end COMPU_METHOD
/begin COMPU_METHOD md_q0p1 "" RAT_FUNC "%6.3" "Nm" COEFFS 0 10 0 0 0 1 /end COMPU_METHOD
/begin COMPU_METHOD md_q1p6 "" RAT_FUNC "%6.2" "Nm" COEFFS 0 10 0 0 0 16 /end COMPU_METHOD
/begin COMPU_METHOD Mo_v_kmh_q0p01 "" RAT_FUNC "%6.4" "km/h" COEFFS 0 100 0 0 0 1 /end COMPU_METHOD
/begin COMPU_METHOD nmot_q0p5 "" RAT_FUNC "%6.3" "1/min" COEFFS 0 2 0 0 0 1 /end COMPU_METHOD
/begin COMPU_METHOD nmot_q40 "" RAT_FUNC "%6.1" "1/min" COEFFS 0 1 0 0 0 40 /end COMPU_METHOD
/begin COMPU_METHOD OneToOne "" RAT_FUNC "%6.2" "-" COEFFS 0 1 0 0 0 1 /end COMPU_METHOD
/begin COMPU_METHOD Prc "" RAT_FUNC "%6.4" "%" COEFFS 0 81.92 0 0 0 1 /end COMPU_METHOD
/begin COMPU_METHOD relPED_q0p02441 "" RAT_FUNC "%6.4" "% PED" COEFFS 0 4096 0 0 0 100 /end COMPU_METHOD
/begin COMPU_METHOD rel_q0p39 "" RAT_FUNC "%6.3" "%" COEFFS 0 256 0 0 0 100 /end COMPU_METHOD
/begin COMPU_METHOD SY_ESUKA_Compu "" TAB_VERB "%6.3" "" COMPU_TAB_REF SY_ESUKA_Compu /end COMPU_METHOD
/begin COMPU_VTAB SY_ESUKA_Compu "" TAB_VERB 2 0 "False" 1 "True" /end COMPU_VTAB
/begin COMPU_METHOD SY_ESUKNGN_Compu "" TAB_VERB "%6.3" "" COMPU_TAB_REF SY_ESUKNGN_Compu /end COMPU_METHOD
/begin COMPU_VTAB SY_ESUKNGN_Compu "" TAB_VERB 2 0 "%ESUKNGN nicht vorhanden" 1 "%ESUKNGN vorhanden" /end COMPU_VTAB
/begin COMPU_METHOD SY_ETADZWF_Compu "" TAB_VERB "%6.3" "" COMPU_TAB_REF SY_ETADZWF_Compu /end COMPU_METHOD
/begin COMPU_VTAB SY_ETADZWF_Compu "" TAB_VERB 2 0 "False" 1 "True" /end COMPU_VTAB
/begin COMPU_METHOD SY_ETAKHSV_Compu "" TAB_VERB "%6.3" "" COMPU_TAB_REF SY_ETAKHSV_Compu /end COMPU_METHOD
/begin COMPU_VTAB SY_ETAKHSV_Compu "" TAB_VERB 3 0 "SY_ETAKHSV_ZERO" 1 "SY_ETAKHSV_ONE" 2 "SY_ETAKHSV_TWO" /end COMPU_VTAB
/begin COMPU_METHOD SY_ETAKHZW_Compu "" TAB_VERB "%6.3" "" COMPU_TAB_REF SY_ETAKHZW_Compu /end COMPU_METHOD
/begin COMPU_VTAB SY_ETAKHZW_Compu "" TAB_VERB 2 0 "SY_ETAKHZW=0" 1 "SY_ETAKHZW=1" /end COMPU_VTAB
/begin COMPU_METHOD SY_ETHSENS_Compu "" TAB_VERB "%6.3" "" COMPU_TAB_REF SY_ETHSENS_Compu /end COMPU_METHOD
/begin COMPU_VTAB SY_ETHSENS_Compu "" TAB_VERB 2 0 "false" 1 "true" /end COMPU_VTAB
/begin COMPU_METHOD SY_EWS_Compu "" TAB_VERB "%6.3" "" COMPU_TAB_REF SY_EWS_Compu /end COMPU_METHOD
/begin COMPU_VTAB SY_EWS_Compu "" TAB_VERB 2 0 "EWS_inactive" 1 "EWS_active" /end COMPU_VTAB
/begin COMPU_METHOD SY_FABE_Compu "" TAB_VERB "%6.3" "" COMPU_TAB_REF SY_FABE_Compu /end COMPU_METHOD
/begin COMPU_VTAB SY_FABE_Compu "" TAB_VERB 2 0 "shortened EOL-test unavailable" 1 "shortened EOL-test available" /end COMPU_VTAB
/begin COMPU_METHOD SY_FAEVZUE_Compu "" TAB_VERB "%6.3" "" COMPU_TAB_REF SY_FAEVZUE_Compu /end COMPU_METHOD
/begin COMPU_VTAB SY_FAEVZUE_Compu "" TAB_VERB 2 0 "False" 1 "True" /end COMPU_VTAB
/begin COMPU_METHOD SY_FAFSTKH_Compu "" TAB_VERB "%6.3" "" COMPU_TAB_REF SY_FAFSTKH_Compu /end COMPU_METHOD
/begin COMPU_VTAB SY_FAFSTKH_Compu "" TAB_VERB 2 0 "FAFSTKH_NO" 1 "FAFSTKH_ONE" /end COMPU_VTAB
/begin COMPU_METHOD SY_FAGALS_Compu "" TAB_VERB "%6.3" "" COMPU_TAB_REF SY_FAGALS_Compu /end COMPU_METHOD
/begin COMPU_VTAB SY_FAGALS_Compu "" TAB_VERB 2 0 "False" 1 "True" /end COMPU_VTAB
/begin COMPU_METHOD SY_FANT_Compu "" TAB_VERB "%6.3" "" COMPU_TAB_REF SY_FANT_Compu /end COMPU_METHOD
/begin COMPU_VTAB SY_FANT_Compu "" TAB_VERB 2 0 "keine Anhebung Schubabschaltedrehzahl über Testere" 1 "Anhebung Schubabschaltedrehzahl über Testereingrif" /end COMPU_VTAB
/begin COMPU_METHOD SY_FAPAFG_Compu "" TAB_VERB "%6.3" "" COMPU_TAB_REF SY_FAPAFG_Compu /end COMPU_METHOD
/begin COMPU_VTAB SY_FAPAFG_Compu "" TAB_VERB 2 0 "FALSE" 1 "TRUE" /end COMPU_VTAB
/begin COMPU_METHOD SY_FAWULA_Compu "" TAB_VERB "%6.3" "" COMPU_TAB_REF SY_FAWULA_Compu /end COMPU_METHOD
/begin COMPU_VTAB SY_FAWULA_Compu "" TAB_VERB 3 0 "Anfettung Fahrerwunsch nicht möglich" 1 "Anfettung über mrfa/nmot möglich" 2 "Enchmt_rl" /end COMPU_VTAB
/begin COMPU_METHOD SY_FCOTSTR_Compu "" TAB_VERB "%6.3" "" COMPU_TAB_REF SY_FCOTSTR_Compu /end COMPU_METHOD
/begin COMPU_VTAB SY_FCOTSTR_Compu "" TAB_VERB 2 0 "False" 1 "True" /end COMPU_VTAB
/begin COMPU_METHOD SY_FELMR_Compu "" TAB_VERB "%6.3" "" COMPU_TAB_REF SY_FELMR_Compu /end COMPU_METHOD
/begin COMPU_VTAB SY_FELMR_Compu "" TAB_VERB 2 0 "False" 1 "True" /end COMPU_VTAB
/begin COMPU_METHOD SY_FEPBAL_Compu "" TAB_VERB "%6.3" "" COMPU_TAB_REF SY_FEPBAL_Compu /end COMPU_METHOD
/begin COMPU_VTAB SY_FEPBAL_Compu "" TAB_VERB 3 0 "SY_FEPBAL_0" 1 "SY_FEPBAL_1" 2 "SY_FEPBAL_2" /end COMPU_VTAB
/begin COMPU_METHOD SY_FEPB_Compu "" TAB_VERB "%6.3" "" COMPU_TAB_REF SY_FEPB_Compu /end COMPU_METHOD
/begin COMPU_VTAB SY_FEPB_Compu "" TAB_VERB 3 0 "NOPCHDET" 1 "PINLETCAM" 2 "PINLETEGR" /end COMPU_VTAB
/begin COMPU_METHOD SY_FFV_Compu "" TAB_VERB "%6.3" "" COMPU_TAB_REF SY_FFV_Compu /end COMPU_METHOD
/begin COMPU_VTAB SY_FFV_Compu "" TAB_VERB 2 0 "kein flexible fuel Fahrzeug" 1 "flexible fuel Fahrzeug" /end COMPU_VTAB
/begin COMPU_METHOD SY_FFZ_Compu "" TAB_VERB "%6.3" "" COMPU_TAB_REF SY_FFZ_Compu /end COMPU_METHOD
/begin COMPU_VTAB SY_FFZ_Compu "" TAB_VERB 2 0 "keine Funkenbandzündung" 1 "Funkenbandzündung vorhanden" /end COMPU_VTAB
/begin COMPU_METHOD SY_FKAT2_Compu "" TAB_VERB "%6.3" "" COMPU_TAB_REF SY_FKAT2_Compu /end COMPU_METHOD
/begin COMPU_VTAB SY_FKAT2_Compu "" TAB_VERB 2 0 "kein Frontkat Bank 2" 1 "Frontkat Bank 2 vorhanden" /end COMPU_VTAB
/begin COMPU_METHOD SY_FKAT_Compu "" TAB_VERB "%6.3" "" COMPU_TAB_REF SY_FKAT_Compu /end COMPU_METHOD
/begin COMPU_VTAB SY_FKAT_Compu "" TAB_VERB 2 0 "kein Frontkat Bank 1" 1 "Frontkat Bank 1 vorhanden" /end COMPU_VTAB
/begin COMPU_METHOD SY_FLAFH_Compu "" TAB_VERB "%6.3" "" COMPU_TAB_REF SY_FLAFH_Compu /end COMPU_METHOD
/begin COMPU_VTAB SY_FLAFH_Compu "" TAB_VERB 2 0 "SY_FLAFH=0" 1 "SY_FLAFH=1" /end COMPU_VTAB
/begin COMPU_METHOD SY_FLASHON_Compu "" TAB_VERB "%6.3" "" COMPU_TAB_REF SY_FLASHON_Compu /end COMPU_METHOD
/begin COMPU_VTAB SY_FLASHON_Compu "" TAB_VERB 2 0 "FALSE" 1 "TRUE" /end COMPU_VTAB
/begin COMPU_METHOD SY_FLOAKT_Compu "" TAB_VERB "%6.3" "" COMPU_TAB_REF SY_FLOAKT_Compu /end COMPU_METHOD
/begin COMPU_VTAB SY_FLOAKT_Compu "" TAB_VERB 2 0 "False" 1 "True" /end COMPU_VTAB
/begin COMPU_METHOD SY_FLUQ_Compu "" RAT_FUNC "%6.2" "" COEFFS 0 1 0 0 0 1 /end COMPU_METHOD
/begin COMPU_METHOD SY_FNSK_Compu "" TAB_VERB "%6.3" "" COMPU_TAB_REF SY_FNSK_Compu /end COMPU_METHOD
/begin COMPU_VTAB SY_FNSK_Compu "" TAB_VERB 5 0 "Aus" 1 "Ein1" 2 "Ein2" 3 "Ein3" 4 "Ein4" /end COMPU_VTAB
/begin COMPU_METHOD SY_FNSWLK_Compu "" TAB_VERB "%6.3" "" COMPU_TAB_REF SY_FNSWLK_Compu /end COMPU_METHOD
/begin COMPU_VTAB SY_FNSWLK_Compu "" TAB_VERB 2 0 "Aus" 1 "Ein" /end COMPU_VTAB
/begin COMPU_METHOD SY_FOFHEV_Compu "" TAB_VERB "%6.3" "" COMPU_TAB_REF SY_FOFHEV_Compu /end COMPU_METHOD
/begin COMPU_VTAB SY_FOFHEV_Compu "" TAB_VERB 2 0 "not used" 1 "used" /end COMPU_VTAB
/begin COMPU_METHOD SY_FOFSMPN_Compu "" RAT_FUNC "%6.2" "" COEFFS 0 1 0 0 0 1 /end COMPU_METHOD
/begin COMPU_METHOD SY_FPCCPV_Compu "" TAB_VERB "%6.3" "" COMPU_TAB_REF SY_FPCCPV_Compu /end COMPU_METHOD
/begin COMPU_VTAB SY_FPCCPV_Compu "" TAB_VERB 4 0 "00_NO_CPV" 1 "01_PWM_CPV" 2 "02_Linear_CPV" 3 "03_Selectable_Lineal_or_PWM" /end COMPU_VTAB
/begin COMPU_METHOD SY_FPCELPV_Compu "" TAB_VERB "%6.3" "" COMPU_TAB_REF SY_FPCELPV_Compu /end COMPU_METHOD
/begin COMPU_VTAB SY_FPCELPV_Compu "" TAB_VERB 2 0 "False" 1 "True" /end COMPU_VTAB
/begin COMPU_METHOD SY_FPCES_Compu "" TAB_VERB "%6.3" "" COMPU_TAB_REF SY_FPCES_Compu /end COMPU_METHOD
/begin COMPU_VTAB SY_FPCES_Compu "" TAB_VERB 3 0 "Keine Gemisch-Fehlerverdachtserkennung" 1 "Gemisch-Fehlerverdachtserkennung möglich" 2 "Erw. Gemisch-Fehlerverdachtserkennung möglich" /end COMPU_VTAB
/begin COMPU_METHOD SY_FPCGWRK_Compu "" TAB_VERB "%6.3" "" COMPU_TAB_REF SY_FPCGWRK_Compu /end COMPU_METHOD
/begin COMPU_VTAB SY_FPCGWRK_Compu "" TAB_VERB 2 0 "FALSE" 1 "TRUE" /end COMPU_VTAB
/begin COMPU_METHOD SY_FPCIMV_Compu "" TAB_VERB "%6.3" "" COMPU_TAB_REF SY_FPCIMV_Compu /end COMPU_METHOD
/begin COMPU_VTAB SY_FPCIMV_Compu "" TAB_VERB 2 0 "False" 1 "True" /end COMPU_VTAB
/begin COMPU_METHOD SY_FPCLRBN_Compu "" TAB_VERB "%6.3" "" COMPU_TAB_REF SY_FPCLRBN_Compu /end COMPU_METHOD
/begin COMPU_VTAB SY_FPCLRBN_Compu "" TAB_VERB 2 0 "kein langsamer Reset der Beladung bei Notlauf" 1 "Langsamer Reset der Beladung bei Notlauf" /end COMPU_VTAB
/begin COMPU_METHOD SY_FPCMW_Compu "" TAB_VERB "%6.3" "" COMPU_TAB_REF SY_FPCMW_Compu /end COMPU_METHOD
/begin COMPU_VTAB SY_FPCMW_Compu "" TAB_VERB 2 0 "keine Berücksichtigung der Absteuerung" 1 "Berücksichtigung der Absteuerung" /end COMPU_VTAB
/begin COMPU_METHOD SY_FPCPIN_Compu "" TAB_VERB "%6.3" "" COMPU_TAB_REF SY_FPCPIN_Compu /end COMPU_METHOD
/begin COMPU_VTAB SY_FPCPIN_Compu "" TAB_VERB 3 0 "Keine zusätzliche Einleitstelle" 1 "Zusätzliche Einleitstelle vor Verdichter" 2 "Zusätzliche Einleitstelle vor zweitem Verdichter" /end COMPU_VTAB
/begin COMPU_METHOD SY_FPCPR_Compu "" TAB_VERB "%6.3" "" COMPU_TAB_REF SY_FPCPR_Compu /end COMPU_METHOD
/begin COMPU_VTAB SY_FPCPR_Compu "" TAB_VERB 2 0 "Keine Anforderung Saugrohrdruck von Tankentlüftung" 1 "Anforderung des Saugrohrdrucks von Tankentlüftung" /end COMPU_VTAB
/begin COMPU_METHOD SY_FPCSSP_Compu "" TAB_VERB "%6.3" "" COMPU_TAB_REF SY_FPCSSP_Compu /end COMPU_METHOD
/begin COMPU_VTAB SY_FPCSSP_Compu "" TAB_VERB 2 0 "False" 1 "True" /end COMPU_VTAB
/begin COMPU_METHOD SY_FPCSTRQ_Compu "" TAB_VERB "%6.3" "" COMPU_TAB_REF SY_FPCSTRQ_Compu /end COMPU_METHOD
/begin COMPU_VTAB SY_FPCSTRQ_Compu "" TAB_VERB 2 0 "False" 1 "True" /end COMPU_VTAB
/begin COMPU_METHOD SY_FPCTKTM_Compu "" TAB_VERB "%6.3" "" COMPU_TAB_REF SY_FPCTKTM_Compu /end COMPU_METHOD
/begin COMPU_VTAB SY_FPCTKTM_Compu "" TAB_VERB 2 0 "FALSE" 1 "TRUE" /end COMPU_VTAB
/begin COMPU_METHOD SY_FPCTR_Compu "" TAB_VERB "%6.3" "" COMPU_TAB_REF SY_FPCTR_Compu /end COMPU_METHOD
/begin COMPU_VTAB SY_FPCTR_Compu "" TAB_VERB 2 0 "Keine Momentenreserve von Tankentlüftung möglich" 1 "Momentenreserve von Tankentlüftung möglich" /end COMPU_VTAB
/begin COMPU_METHOD SY_FSGFS_Compu "" TAB_VERB "%6.3" "" COMPU_TAB_REF SY_FSGFS_Compu /end COMPU_METHOD
/begin COMPU_VTAB SY_FSGFS_Compu "" TAB_VERB 2 0 "False" 1 "True" /end COMPU_VTAB
/begin COMPU_METHOD SY_FSGM_Compu "" TAB_VERB "%6.3" "" COMPU_TAB_REF SY_FSGM_Compu /end COMPU_METHOD
/begin COMPU_VTAB SY_FSGM_Compu "" TAB_VERB 3 0 "Kennfelder" 1 "Modelle" 2 "Modelle_HFM_über_DSS" /end COMPU_VTAB
/begin COMPU_METHOD SY_FSSTPRS_Compu "" TAB_VERB "%6.3" "" COMPU_TAB_REF SY_FSSTPRS_Compu /end COMPU_METHOD
/begin COMPU_VTAB SY_FSSTPRS_Compu "" TAB_VERB 2 0 "False" 1 "True" /end COMPU_VTAB
/begin COMPU_METHOD SY_FSTK_Compu "" TAB_VERB "%6.3" "" COMPU_TAB_REF SY_FSTK_Compu /end COMPU_METHOD
/begin COMPU_VTAB SY_FSTK_Compu "" TAB_VERB 3 0 "no-correction-interface" 1 "uint8-Interface" 2 "unit16-Interface" /end COMPU_VTAB
/begin COMPU_METHOD SY_FTIVDM_Compu "" TAB_VERB "%6.3" "" COMPU_TAB_REF SY_FTIVDM_Compu /end COMPU_METHOD
/begin COMPU_VTAB SY_FTIVDM_Compu "" TAB_VERB 3 0 "00_NO_FTIV_Available" 1 "01_Closed_when_PoweredOff" 2 "02_Open_when_PoweredOff" /end COMPU_VTAB
/begin COMPU_METHOD SY_FTOFSLS_Compu "" TAB_VERB "%6.3" "" COMPU_TAB_REF SY_FTOFSLS_Compu /end COMPU_METHOD
/begin COMPU_VTAB SY_FTOFSLS_Compu "" TAB_VERB 3 0 "SY_FTOFSLS_0" 1 "SY_FTOFSLS_1" 2 "SY_FTOFSLS_2" /end COMPU_VTAB
/begin COMPU_METHOD SY_FUELVAP_Compu "" TAB_VERB "%6.3" "" COMPU_TAB_REF SY_FUELVAP_Compu /end COMPU_METHOD
/begin COMPU_VTAB SY_FUELVAP_Compu "" TAB_VERB 3 0 "no central bad fuel detection value" 1 "central bad fuel detection value" 2 "central bad fuel value with reset at fuel fill" /end COMPU_VTAB
/begin COMPU_METHOD SY_FWLK_Compu "" TAB_VERB "%6.3" "" COMPU_TAB_REF SY_FWLK_Compu /end COMPU_METHOD
/begin COMPU_VTAB SY_FWLK_Compu "" TAB_VERB 4 0 "Aus0" 1 "Ein1" 2 "Ein2" 3 "Ein3" /end COMPU_VTAB
/begin COMPU_METHOD TransR "" RAT_FUNC "%6.4" "-" COEFFS 0 100 0 0 0 1 /end COMPU_METHOD
/begin COMPU_METHOD Trq "" RAT_FUNC "%6.3" "Nm" COEFFS 0 10 0 0 0 1 /end COMPU_METHOD
/begin COMPU_METHOD t_q0p01 "" RAT_FUNC "%6.4" "s" COEFFS 0 100 0 0 0 1 /end COMPU_METHOD
/begin COMPU_METHOD t_q1p0_us "" RAT_FUNC "%6.2" "us" COEFFS 0 1 0 0 0 1 /end COMPU_METHOD
/begin COMPU_METHOD vel_q0p01 "" RAT_FUNC "%6.4" "km/h" COEFFS 0 100 0 0 0 1 /end COMPU_METHOD
/begin COMPU_METHOD zw_q0p1 "" RAT_FUNC "%6.3" "Grad KW" COEFFS 0 10 0 0 0 1 /end COMPU_METHOD
/begin COMPU_METHOD zw_sb_q0p75 "" RAT_FUNC "%6.3" "Grad KW" COEFFS 0 255 0 0 0 191.25 /end COMPU_METHOD
/begin RECORD_LAYOUT Axis_Xu8 NO_AXIS_PTS_X 1 UBYTE AXIS_PTS_X 2 UBYTE INDEX_INCR DIRECT /end RECORD_LAYOUT
/begin RECORD_LAYOUT Map_Xs16Ys16Ws16 NO_AXIS_PTS_X 1 SWORD NO_AXIS_PTS_Y 2 SWORD AXIS_PTS_X 3 SWORD INDEX_INCR DIRECT AXIS_PTS_Y 4 SWORD INDEX_INCR DIRECT FNC_VALUES 5 SWORD COLUMN_DIR DIRECT /end RECORD_LAYOUT
/begin RECORD_LAYOUT Mo_DataCurveSstS16WS16 NO_AXIS_PTS_X 1 SWORD AXIS_PTS_X 2 SWORD INDEX_INCR DIRECT FNC_VALUES 3 SWORD COLUMN_DIR DIRECT /end RECORD_LAYOUT
/begin RECORD_LAYOUT Mo_DataCurveSstU8WU8 NO_AXIS_PTS_X 1 UBYTE AXIS_PTS_X 2 UBYTE INDEX_INCR DIRECT FNC_VALUES 3 UBYTE COLUMN_DIR DIRECT /end RECORD_LAYOUT
/begin RECORD_LAYOUT ValA_Wu16 FNC_VALUES 1 UWORD COLUMN_DIR DIRECT /end RECORD_LAYOUT
/begin RECORD_LAYOUT ValA_Wu8 FNC_VALUES 1 UBYTE COLUMN_DIR DIRECT /end RECORD_LAYOUT
/begin RECORD_LAYOUT Val_Ws16 FNC_VALUES 1 SWORD COLUMN_DIR DIRECT /end RECORD_LAYOUT
/begin RECORD_LAYOUT Val_Ws32 FNC_VALUES 1 SLONG COLUMN_DIR DIRECT /end RECORD_LAYOUT
/begin RECORD_LAYOUT Val_Wu16 FNC_VALUES 1 UWORD COLUMN_DIR DIRECT /end RECORD_LAYOUT
/begin RECORD_LAYOUT Val_Wu32 FNC_VALUES 1 ULONG COLUMN_DIR DIRECT /end RECORD_LAYOUT
/begin RECORD_LAYOUT Val_Wu8 FNC_VALUES 1 UBYTE COLUMN_DIR DIRECT /end RECORD_LAYOUT
/end MODULE
/end PROJECT
