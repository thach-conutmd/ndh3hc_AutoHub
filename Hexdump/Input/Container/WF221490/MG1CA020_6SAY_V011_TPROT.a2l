ASAP2_VERSION 1 60
/begin PROJECT MG1CA020 "MG1CA020"
/begin HEADER "" VERSION "MG1CA020_6SAY_V011_TPROT" PROJECT_NO MG1CA020 /end HEADER
/begin MODULE DIM ""
/begin MOD_COMMON "" BYTE_ORDER MSB_LAST ALIGNMENT_BYTE 1 ALIGNMENT_WORD 2 ALIGNMENT_LONG 4 ALIGNMENT_INT64 4 ALIGNMENT_FLOAT32_IEEE 4 ALIGNMENT_FLOAT64_IEEE 4 DATA_SIZE 32 /end MOD_COMMON
/begin CHARACTERISTIC EGSDCmn_dmEnaNegParl_C "Release threshold for negative gradient of exhaust gas mass flow of parallelized exhaust sensor diagnosis" VALUE 0x8051C31C RB_Val_Ws16 6553.500 m_sw_b3276p8 -3276.800 3276.700 FORMAT "%8.3" /end CHARACTERISTIC
/begin CHARACTERISTIC EGSDCmn_dmEnaPosParl_C "Release threshold for positive gradient of exhaust gas mass flow of parallelized exhaust sensor diagnosis" VALUE 0x8051C31E RB_Val_Ws16 6553.500 m_sw_b3276p8 -3276.800 3276.700 FORMAT "%8.3" /end CHARACTERISTIC
/begin CHARACTERISTIC EGSDCmn_dmfRngHiMaxActvParl_C "offset for the upper limit of the mass flow of the release condition of the mass flow high range for parallelization" VALUE 0x8051C320 RB_Val_Wu16 6553.500 m_uw_b6553p5 0.00 6553.500 FORMAT "%8.3" /end CHARACTERISTIC
/begin CHARACTERISTIC EGSDCmn_dmfRngHiMinActvParl_C "offset for the lower limit of the mass flow of the release condition of the mass flow high range for parallelization" VALUE 0x8051C322 RB_Val_Wu16 6553.500 m_uw_b6553p5 0.00 6553.500 FORMAT "%8.3" /end CHARACTERISTIC
/begin CHARACTERISTIC EGSDCmn_dmfRngLoMaxActvParl_C "offset for the upper limit of the mass flow of the release condition of the mass flow low range for parallelization" VALUE 0x8051C324 RB_Val_Wu16 6553.500 m_uw_b6553p5 0.00 6553.500 FORMAT "%8.3" /end CHARACTERISTIC
/begin CHARACTERISTIC EGSDCmn_dmfRngLoMinActvParl_C "offset for the lower limit of the mass flow of the release condition of the mass flow low range for parallelization" VALUE 0x8051C326 RB_Val_Wu16 6553.500 m_uw_b6553p5 0.00 6553.500 FORMAT "%8.3" /end CHARACTERISTIC
/begin CHARACTERISTIC EGSDCmn_dmfRngLoUnderMinParl_C "offset for the lower limit of the mass flow of the release condition of the mass flow low range for parallelization when Diagnosis is Active" VALUE 0x8051C328 RB_Val_Wu16 6553.500 m_uw_b6553p5 0.00 6553.500 FORMAT "%8.3" /end CHARACTERISTIC
/begin CHARACTERISTIC EGSDCmn_dnEngMaxParl_C "Delta to lower maximum engine speed boundary" VALUE 0x8051C32A RB_Val_Wu8 10200. nmot_ub_q40 0.00 10200. FORMAT "%5.0" /end CHARACTERISTIC
/begin CHARACTERISTIC EGSDCmn_dnEngMinParl_C "Delta to raise minimum engine speed boundary" VALUE 0x8051C32B RB_Val_Wu8 10200. nmot_ub_q40 0.00 10200. FORMAT "%5.0" /end CHARACTERISTIC
/begin CHARACTERISTIC EGSDCmn_dtCat1RngHiMaxParl_C "offset for the upper limit of the catalyst temperature of the release condition of the temperature high range for parallelization ( for Gasoline Fuel)" VALUE 0x8051C32C RB_Val_Wu16 1535.977 temp_q0p0234 0.00 1535.977 FORMAT "%8.3" /end CHARACTERISTIC
/begin CHARACTERISTIC EGSDCmn_dtCat1RngHiMinParl_C "offset for the lower limit of the catalyst temperature of the release condition of the temperature high range for parallelization ( for Gasoline Fuel)" VALUE 0x8051C32E RB_Val_Wu16 1535.977 temp_q0p0234 0.00 1535.977 FORMAT "%8.3" /end CHARACTERISTIC
/begin CHARACTERISTIC EGSDCmn_dtCat1RngLoMaxParl_C "offset for the upper limit of the catalyst temperature of the release condition of the temperature low range for parallelization( for Gasoline Fuel)" VALUE 0x8051C330 RB_Val_Wu16 1535.977 temp_q0p0234 0.00 1535.977 FORMAT "%8.3" /end CHARACTERISTIC
/begin CHARACTERISTIC EGSDCmn_dtCat1RngLoMinParl_C "offset for the lower limit of the catalyst temperature of the release condition for parallelization" VALUE 0x8051C332 RB_Val_Wu16 1535.977 temp_q0p0234 0.00 1535.977 FORMAT "%8.3" /end CHARACTERISTIC
/begin CHARACTERISTIC EGSDCmn_dtCatHomParl_C "Difference temperature for catalyst heated up" VALUE 0x8051C334 RB_Val_Ws16 6553.500 temp_q0p1 -3276.800 3276.700 FORMAT "%8.3" /end CHARACTERISTIC
/begin CHARACTERISTIC EGSDCmn_facFpcAdpnMaxParl_C "maximal fuel purge adaptation for enable condition" VALUE 0x8051C336 RB_Val_Ws16 127.9980 fak_sw_b64 -64.00000 63.99805 FORMAT "%8.5" /end CHARACTERISTIC
/begin CHARACTERISTIC EGSDCmn_facFuByFpcParl_C "maximal relative fuel portion from canister purge for parallelization" VALUE 0x8051C338 RB_Val_Wu16 3.999939 fak_uw_b4 0.00 3.999939 FORMAT "%8.6" /end CHARACTERISTIC
/begin CHARACTERISTIC EGSDCmn_facLamCtrlVLamDynParl_C "Controller factor for active dynamic diagnose" VALUE 0x8051C2BC RB_Val_Wu8 1.992188 fak_ub_b2 0.00 1.992188 FORMAT "%8.6" /end CHARACTERISTIC
/begin CHARACTERISTIC EGSDCmn_facLamCtrlVParl_C "Factor for lambda controller velocity during parallelization" VALUE 0x8051C2BD RB_Val_Wu8 1.992188 fak_ub_b2 0.00 1.992188 FORMAT "%8.6" /end CHARACTERISTIC
/begin CHARACTERISTIC EGSDCmn_facTiTqResvParl_C "time constant of the torque reserve for parallelization" VALUE 0x8051C2BE RB_Val_Wu16 655.34999985 zk10msxs_uw_b655p36 0.01000015 655.36000000 FORMAT "%12.8" EXTENDED_LIMITS 0.010000152590 655.36000000 /end CHARACTERISTIC
/begin CHARACTERISTIC EGSDCmn_flgActvtAbortCntr_C "Counter of aborts since clearing of error memory activated" VALUE 0x8051C33A RB_Val_Wu8 1.00000000000 B_TRUE 0.00 1.00000000000 FORMAT "%13.11" /end CHARACTERISTIC
/begin CHARACTERISTIC EGSDCmn_flgBypLamMonOkParl_C "Code word to bypass lambda monitoring criterion as enable condition of parallelization" VALUE 0x8051C33B RB_Val_Wu8 1.00000000000 B_TRUE 0.00 1.00000000000 FORMAT "%13.11" /end CHARACTERISTIC
/begin CHARACTERISTIC EGSDCmn_flgEnaAftIdleIni_C "Activate initializing of idle feature with TRUE" VALUE 0x8051C33C RB_Val_Wu8 1.00000000000 B_TRUE 0.00 1.00000000000 FORMAT "%13.11" /end CHARACTERISTIC
/begin CHARACTERISTIC EGSDCmn_flgEnaEomParl_C "Enable to use the operation mode request" VALUE 0x8051C2C0 RB_Val_Wu8 1.00000000000 B_TRUE 0.00 1.00000000000 FORMAT "%13.11" /end CHARACTERISTIC
/begin CHARACTERISTIC EGSDCmn_flgFcoDiDiag_C "Codeword to consider fuel cut off in feature catalyst to cold due to low engine speed." VALUE 0x8051C33D RB_Val_Wu8 1.00000000000 B_TRUE 0.00 1.00000000000 FORMAT "%13.11" /end CHARACTERISTIC
/begin CHARACTERISTIC EGSDCmn_flgGearShiftEnaParl_CW "Activation inhibiting parallelization by gear-shift" VALUE 0x8051C33E RB_Val_Wu8 1.00000000000 B_TRUE 0.00 1.00000000000 FORMAT "%13.11" /end CHARACTERISTIC
/begin CHARACTERISTIC EGSDCmn_flgInjVlvDisblActvParl_C "Injection valve deactivation criteria active" VALUE 0x8051C33F RB_Val_Wu8 1.00000000000 B_TRUE 0.00 1.00000000000 FORMAT "%13.11" /end CHARACTERISTIC
/begin CHARACTERISTIC EGSDCmn_flgLamDynSlowCtrlParl_C "Activation of separate controller factor for dynamic diagnosis" VALUE 0x8051C2C1 RB_Val_Wu8 1.00000000000 B_TRUE 0.00 1.00000000000 FORMAT "%13.11" /end CHARACTERISTIC
/begin CHARACTERISTIC EGSDCmn_flgLamMonCntrParl_C "Lambda stability criterion is bound to the lambda shifting of the parallelized catalyst diagnosis" VALUE 0x8051C340 RB_Val_Wu8 1.00000000000 B_TRUE 0.00 1.00000000000 FORMAT "%13.11" /end CHARACTERISTIC
/begin CHARACTERISTIC EGSDCmn_flgLamMonSuppParl_CW "Codebit: Suppressing of abortions by Lambda-Monitoring possible" VALUE 0x8051C341 RB_Val_Wu8 1.00000000000 B_TRUE 0.00 1.00000000000 FORMAT "%13.11" /end CHARACTERISTIC
/begin CHARACTERISTIC EGSDCmn_flgPurgCtrlParl_C "The purge flow of the fuel purge control is monitored for the release of the parallelization" VALUE 0x8051C342 RB_Val_Wu8 1.00000000000 B_TRUE 0.00 1.00000000000 FORMAT "%13.11" /end CHARACTERISTIC
/begin CHARACTERISTIC EGSDCmn_flgShtrpTstOnlyParl_CW "Shorttrip will be local requested for the purpose of calibration" VALUE 0x8051C49A RB_Val_Wu8 1.00000000000 B_TRUE 0.00 1.00000000000 FORMAT "%13.11" /end CHARACTERISTIC
/begin CHARACTERISTIC EGSDCmn_flgVlVLftActvParl_CW "valve lift ienabling criterion s active" VALUE 0x8051C343 RB_Val_Wu8 1.00000000000 B_TRUE 0.00 1.00000000000 FORMAT "%13.11" /end CHARACTERISTIC
/begin CHARACTERISTIC EGSDCmn_mEgCatWarmAftIdleFco_M "Threshold Map for the Debouncing time for Warm Catalyst ( after fuel cut off and idling Condition) based on Vehicle Speed Environment Temperature" MAP 0x8051C344 RB_Map_S16S16_U16 65.53500 m_q0p001_kg 0.00 65.53500 FORMAT "%8.5"
 /begin AXIS_DESCR STD_AXIS VehV_v Vel 4 -327.6800 327.6700 FORMAT "%8.4" DEPOSIT ABSOLUTE /end AXIS_DESCR
 /begin AXIS_DESCR STD_AXIS EnvT_t Temp_Cels 4 -3549.940 3003.560 FORMAT "%8.3" DEPOSIT ABSOLUTE /end AXIS_DESCR
/end CHARACTERISTIC
/begin CHARACTERISTIC EGSDCmn_mEgFpcDynDebParl_C "Exhaust gas massflow to debounce the fuel purge dynamic" VALUE 0x8051C378 RB_Val_Wu16 65.53500 m_q0p001_kg 0.00 65.53500 FORMAT "%8.5" /end CHARACTERISTIC
/begin CHARACTERISTIC EGSDCmn_mEgFpcEnaParl_C "minimum integrated air mass flow from canister purge for parallelization" VALUE 0x8051C37A RB_Val_Wu8 11.32 m_ub_q0p0444 0.00 11.32 FORMAT "%5.2" /end CHARACTERISTIC
/begin CHARACTERISTIC EGSDCmn_mEnaDsbcParlB1_C "amount of air mass flow as debouncing condition since fuel mixture for release conditon of parallelization, bank 1" VALUE 0x8051C37C RB_Val_Wu16 65.53500 m_q0p001_kg 0.00 65.53500 FORMAT "%8.5" /end CHARACTERISTIC
/begin CHARACTERISTIC EGSDCmn_mEnaLam1Parl_C "exhaust gas mass for release of lambda = 1 preconditioning phase" VALUE 0x8051C37E RB_Val_Wu16 65.53500 m_q0p001_kg 0.00 65.53500 FORMAT "%8.5" /end CHARACTERISTIC
/begin CHARACTERISTIC EGSDCmn_mEnaSensVldParl_C "Integrated Exhaust mass to debounce sensor readiness for release of parallelization" VALUE 0x8051C380 RB_Val_Wu16 65.53500 m_q0p001_kg 0.00 65.53500 FORMAT "%8.5" /end CHARACTERISTIC
/begin CHARACTERISTIC EGSDCmn_mfEnaRampMaxParl_C "upper limit of the mass flow of the release condition of lambda ramp" VALUE 0x8051C382 RB_Val_Wu16 6553.500 m_q0p1 0.00 6553.500 FORMAT "%8.3" /end CHARACTERISTIC
/begin CHARACTERISTIC EGSDCmn_mfEnaRampMaxTstParl_C "upper limit of the mass flow of the release condition of lambda ramp during short trip" VALUE 0x8051C384 RB_Val_Wu16 6553.500 m_q0p1 0.00 6553.500 FORMAT "%8.3" /end CHARACTERISTIC
/begin CHARACTERISTIC EGSDCmn_mfEnaRampMinParl_C "lower limit of the mass flow of the release condition of lambda ramp" VALUE 0x8051C386 RB_Val_Wu16 6553.500 m_q0p1 0.00 6553.500 FORMAT "%8.3" /end CHARACTERISTIC
/begin CHARACTERISTIC EGSDCmn_mfEnaRampMinTstParl_C "lower limit of the mass flow of the release condition of lambda ramp during short trip" VALUE 0x8051C388 RB_Val_Wu16 6553.500 m_q0p1 0.00 6553.500 FORMAT "%8.3" /end CHARACTERISTIC
/begin CHARACTERISTIC EGSDCmn_mfPurgCtrlThdParl_C "allowed mass flow of the fuel purge for the release of the parallelization" VALUE 0x8051C38A RB_Val_Wu16 25.59961 m_uw_b25p6 0.00 25.59961 FORMAT "%8.5" /end CHARACTERISTIC
/begin CHARACTERISTIC EGSDCmn_mfRngHiMaxParl_T "the upper limit of the mass flow dependent on the engine speed for the release condition of the mass flow high range for parallelization" CURVE 0x8051C38C RB_Curve_S16_U16_Static 6553.500 m_uw_b6553p5 0.00 6553.500 FORMAT "%8.3"
 /begin AXIS_DESCR STD_AXIS Epm_nEng EngN 6 -16384.00 16383.50 FORMAT "%8.2" DEPOSIT ABSOLUTE /end AXIS_DESCR
/end CHARACTERISTIC
/begin CHARACTERISTIC EGSDCmn_mfRngHiMaxTstParl_C "the upper limit of the mass flow of the release condition of the mass flow high range for parallelization" VALUE 0x8051C3A6 RB_Val_Wu16 6553.500 m_uw_b6553p5 0.00 6553.500 FORMAT "%8.3" /end CHARACTERISTIC
/begin CHARACTERISTIC EGSDCmn_mfRngHiMinParl_C "the lower limit of the mass flow of the release condition of the mass flow high range for parallelization" VALUE 0x8051C3A8 RB_Val_Wu16 6553.500 m_uw_b6553p5 0.00 6553.500 FORMAT "%8.3" /end CHARACTERISTIC
/begin CHARACTERISTIC EGSDCmn_mfRngHiMinTstParl_C "the lower limit of the mass flow of the release condition of the mass flow high range for parallelization" VALUE 0x8051C3AA RB_Val_Wu16 6553.500 m_uw_b6553p5 0.00 6553.500 FORMAT "%8.3" /end CHARACTERISTIC
/begin CHARACTERISTIC EGSDCmn_mfRngLoMaxParl_T "the upper limit of the mass flow dependent on the engine speed for the release condition of the mass flow high range for parallelization" CURVE 0x8051C3AC RB_Curve_S16_U16_Static 6553.500 m_uw_b6553p5 0.00 6553.500 FORMAT "%8.3"
 /begin AXIS_DESCR STD_AXIS Epm_nEng EngN 6 -16384.00 16383.50 FORMAT "%8.2" DEPOSIT ABSOLUTE /end AXIS_DESCR
/end CHARACTERISTIC
/begin CHARACTERISTIC EGSDCmn_mfRngLoMaxTstParl_C "the upper limit of the mass flow of the release condition of the mass flow low range for parallelization in short trip" VALUE 0x8051C3C6 RB_Val_Wu16 6553.500 m_uw_b6553p5 0.00 6553.500 FORMAT "%8.3" /end CHARACTERISTIC
/begin CHARACTERISTIC EGSDCmn_mfRngLoMinParl_C "the lower limit of the mass flow of the release condition of the mass flow high range for parallelization" VALUE 0x8051C3C8 RB_Val_Wu16 6553.500 m_uw_b6553p5 0.00 6553.500 FORMAT "%8.3" /end CHARACTERISTIC
/begin CHARACTERISTIC EGSDCmn_mfRngLoMinTstParl_C "the lower limit of the mass flow of the release condition of the mass flow high range for parallelization in short trip" VALUE 0x8051C3CA RB_Val_Wu16 6553.500 m_uw_b6553p5 0.00 6553.500 FORMAT "%8.3" /end CHARACTERISTIC
/begin CHARACTERISTIC EGSDCmn_mSeg1EnaEgParl_T "exhaust gas mass for release of diagnosis since engine start" CURVE 0x8051C3CC RB_Curve_S16_U16_Static 65.53500 m_q0p001_kg 0.00 65.53500 FORMAT "%8.5"
 /begin AXIS_DESCR STD_AXIS CEngDsT_tStrtFrst Temp_Cels 7 -3549.940 3003.560 FORMAT "%8.3" DEPOSIT ABSOLUTE /end AXIS_DESCR
/end CHARACTERISTIC
/begin CHARACTERISTIC EGSDCmn_nEngIdle_C "Engine speed, below which feature catalyst to cold due to low engine speed is activated." VALUE 0x8051C3EA RB_Val_Ws16 32767.50 EngN -16384.00 16383.50 FORMAT "%8.2" /end CHARACTERISTIC
/begin CHARACTERISTIC EGSDCmn_nEngMaxParl_C "upper limit of engine speed for parallelization" VALUE 0x8051C3EC RB_Val_Wu8 10200. nmot_ub_q40 0.00 10200. FORMAT "%5.0" /end CHARACTERISTIC
/begin CHARACTERISTIC EGSDCmn_nEngMaxTstParl_C "maximal set value of engine speed for operation point for parallelization in shorttrip" VALUE 0x8051C3ED RB_Val_Wu8 10200. nmot_ub_q40 0.00 10200. FORMAT "%5.0" /end CHARACTERISTIC
/begin CHARACTERISTIC EGSDCmn_nEngMinParl_C "lower limit of engine speed for parallelization" VALUE 0x8051C3EE RB_Val_Wu8 10200. nmot_ub_q40 0.00 10200. FORMAT "%5.0" /end CHARACTERISTIC
/begin CHARACTERISTIC EGSDCmn_nEngMinTstParl_C "minimal engine speed for operation point for parallelization in shorttrip" VALUE 0x8051C3EF RB_Val_Wu8 10200. nmot_ub_q40 0.00 10200. FORMAT "%5.0" /end CHARACTERISTIC
/begin CHARACTERISTIC EGSDCmn_nrLamMonOKEFParl_C "Threshold number of abortions to suppress Lambda-Monitoring" VALUE 0x8051C3F0 RB_Val_Wu8 255.0 dez 0.00 255.0 FORMAT "%5.1" /end CHARACTERISTIC
/begin CHARACTERISTIC EGSDCmn_nrUGrdt_C "number of time rasters (step size) for gradient creation" VALUE 0x8051C49C RB_Val_Wu8 9.000 OneToOne 1.00 10.00 FORMAT "%5.2" EXTENDED_LIMITS 0.00 255.0 /end CHARACTERISTIC
/begin CHARACTERISTIC EGSDCmn_PEnvMinParl_C "Minimal Environmental pressure to enable Parallelization" VALUE 0x8051C3F2 RB_Val_Ws16 65535.00 p_q1 -32768.00 32767.00 FORMAT "%8.2" /end CHARACTERISTIC
/begin CHARACTERISTIC EGSDCmn_ratLamEnaMaxParl_C "maximum lambda prior to parallelization" VALUE 0x8051C3F4 RB_Val_Wu16 15.99976 fak_uw_b16 0.00 15.99976 FORMAT "%8.5" /end CHARACTERISTIC
/begin CHARACTERISTIC EGSDCmn_ratLamEnaMinParl_C "minimum lambda prior to parallelization" VALUE 0x8051C3F6 RB_Val_Wu16 15.99976 fak_uw_b16 0.00 15.99976 FORMAT "%8.5" /end CHARACTERISTIC
/begin CHARACTERISTIC EGSDCmn_ratLamLeanEgInflParl_C "Threshold for detection of a lean lambda request with exhaust gas influence." VALUE 0x8051C3F8 RB_Val_Wu16 15.99976 fak_uw_b16 0.00 15.99976 FORMAT "%8.5" /end CHARACTERISTIC
/begin CHARACTERISTIC EGSDCmn_ratLamRichEgInflParl_C "Threshold for detection of a rich lambda request with exhaust gas influence." VALUE 0x8051C3FA RB_Val_Wu16 15.99976 fak_uw_b16 0.00 15.99976 FORMAT "%8.5" /end CHARACTERISTIC
/begin CHARACTERISTIC EGSDCmn_ratLoadMinParl_Crv "min. threshold of relative load as enable condition" CURVE 0x8051C3FC RB_Curve_U8_U16_Static 1535.977 rel_q0p0234 0.00 1535.977 FORMAT "%8.3"
 /begin AXIS_DESCR STD_AXIS Epm_nEngLRes EngN_LRes 6 0.00 10200. FORMAT "%5.0" DEPOSIT ABSOLUTE /end AXIS_DESCR
/end CHARACTERISTIC
/begin CHARACTERISTIC EGSDCmn_ratLoadMinTstParl_T "min. threshold of relative load as enable condition during Short Trip" CURVE 0x8051C410 RB_Curve_U8_U16_Static 1535.977 rel_q0p0234 0.00 1535.977 FORMAT "%8.3"
 /begin AXIS_DESCR STD_AXIS Epm_nEngLRes EngN_LRes 6 0.00 10200. FORMAT "%5.0" DEPOSIT ABSOLUTE /end AXIS_DESCR
/end CHARACTERISTIC
/begin CHARACTERISTIC EGSDCmn_ratS1OffsLeanParl_C "maximum assumable mixture deviation in a fault free system" VALUE 0x8051C49E RB_Val_Ws16 15.99976 fak_uw_b16 -8.000000 7.999756 FORMAT "%8.6" /end CHARACTERISTIC
/begin CHARACTERISTIC EGSDCmn_ratS1OffsRichParl_C "maximum assumable mixture deviation in a fault free system (negative)" VALUE 0x8051C4A0 RB_Val_Ws16 15.99976 fak_uw_b16 -8.000000 7.999756 FORMAT "%8.6" /end CHARACTERISTIC
/begin CHARACTERISTIC EGSDCmn_rLamMaxDiffParl_C "Mixture difference to bypass actual mixture check after mixture steps" VALUE 0x8051C424 RB_Val_Wu16 15.99976 fak_uw_b16 0.00 15.99976 FORMAT "%8.5" /end CHARACTERISTIC
/begin CHARACTERISTIC EGSDCmn_stEomParl_C "Requested engine operation mode of the active exhaust gas sensor and catalyst diagnosis (parallelization)" VALUE 0x8051C2C4 RB_Val_Wu32 4294967295.00 OneToOne 0.00 4294967295.00 FORMAT "%13.2" /end CHARACTERISTIC
/begin CHARACTERISTIC EGSDCmn_stEomPrioParl_C "Requested engine operation mode priority of the active exhaust gas sensor and catalyst diagnosis (parallelization)" VALUE 0x8051C2C8 RB_Val_Wu8 255.0 OneToOne 0.00 255.0 FORMAT "%5.1" /end CHARACTERISTIC
/begin CHARACTERISTIC EGSDCmn_stEomPrioShtrpParl_C "Operation mode priority for parallelization in shorttrip" VALUE 0x8051C2C9 RB_Val_Wu8 255.0 OneToOne 0.00 255.0 FORMAT "%5.1" /end CHARACTERISTIC
/begin CHARACTERISTIC EGSDCmn_stEomShtrpParl_C "Operation mode for parallelization in shorttrip" VALUE 0x8051C2CC RB_Val_Wu32 4294967295.00 OneToOne 0.00 4294967295.00 FORMAT "%13.2" /end CHARACTERISTIC
/begin CHARACTERISTIC EGSDCmn_stEomStgParl_C "Requested engine operation mode stage of the active exhaust gas sensor and catalyst diagnosis (parallelization)" VALUE 0x8051C2D0 RB_Val_Wu16 65535.00 OneToOne 0.00 65535.00 FORMAT "%8.2" /end CHARACTERISTIC
/begin CHARACTERISTIC EGSDCmn_stEomStgShtrpParl_C "Operation mode stage for parallelization in shorttrip" VALUE 0x8051C2D2 RB_Val_Wu16 65535.00 OneToOne 0.00 65535.00 FORMAT "%8.2" /end CHARACTERISTIC
/begin CHARACTERISTIC EGSDCmn_StOperModRelsShtrp_I.OperMod2Idx_M "Operation mode selection for parallelization in shorttrip / Mapping-Table for the conversion of the operation-mode-information in an other format" MAP 0x8051C2DA RB_Map_U8U8_U8 255.0 OneToOne 0.00 255.0 FORMAT "%5.1"
 /begin AXIS_DESCR STD_AXIS NO_INPUT_QUANTITY CoEOM_idxOperModCfgd_VERB 4 0.00 3.00000000000 FORMAT "%13.11" DEPOSIT ABSOLUTE /end AXIS_DESCR
 /begin AXIS_DESCR STD_AXIS NO_INPUT_QUANTITY CoEOM_idxOperModStgTot_VERB 5 0.00 15.0000000000 FORMAT "%13.10" DEPOSIT ABSOLUTE /end AXIS_DESCR
/end CHARACTERISTIC
/begin CHARACTERISTIC EGSDCmn_StOperModRels_I.OperMod2Idx_M "Query of the operation mode / Mapping-Table for the conversion of the operation-mode-information in an other format" MAP 0x8051C2FA RB_Map_U8U8_U8 255.0 OneToOne 0.00 255.0 FORMAT "%5.1"
 /begin AXIS_DESCR STD_AXIS NO_INPUT_QUANTITY CoEOM_idxOperModCfgd_VERB 4 0.00 3.00000000000 FORMAT "%13.11" DEPOSIT ABSOLUTE /end AXIS_DESCR
 /begin AXIS_DESCR STD_AXIS NO_INPUT_QUANTITY CoEOM_idxOperModStgTot_VERB 5 0.00 15.0000000000 FORMAT "%13.10" DEPOSIT ABSOLUTE /end AXIS_DESCR
/end CHARACTERISTIC
/begin CHARACTERISTIC EGSDCmn_tAmbMinParl_C "Minimum ambient temperature for activation of parallelization" VALUE 0x8051C426 RB_Val_Wu8 191.3 temp_ub_q0p75_o48 -48.0 143.3 FORMAT "%5.1" /end CHARACTERISTIC
/begin CHARACTERISTIC EGSDCmn_tCat1RngHiMaxParl_C "the upper limit of the catalyst temperature of the release condition of the temperature high range for parallelization" VALUE 0x8051C428 RB_Val_Wu16 1535.977 temp_q0p0234_o273 -273.150 1262.827 FORMAT "%8.3" /end CHARACTERISTIC
/begin CHARACTERISTIC EGSDCmn_tCat1RngHiMaxTstParl_C "the upper limit of the catalyst temperature of the release condition of the temperature high range for parallelization in short trip" VALUE 0x8051C42A RB_Val_Wu16 1535.977 temp_q0p0234_o273 -273.150 1262.827 FORMAT "%8.3" /end CHARACTERISTIC
/begin CHARACTERISTIC EGSDCmn_tCat1RngHiMinParl_C "the lower limit of the catalyst temperature of the release condition of the temperature high range for parallelization" VALUE 0x8051C42C RB_Val_Wu16 1535.977 temp_q0p0234_o273 -273.150 1262.827 FORMAT "%8.3" /end CHARACTERISTIC
/begin CHARACTERISTIC EGSDCmn_tCat1RngHiMinTstParl_C "the lower limit of the catalyst temperature of the release condition of the temperature high range for parallelization in short trip" VALUE 0x8051C42E RB_Val_Wu16 1535.977 temp_q0p0234_o273 -273.150 1262.827 FORMAT "%8.3" /end CHARACTERISTIC
/begin CHARACTERISTIC EGSDCmn_tCat1RngLoMaxParl_C "the upper limit of the catalyst temperature of the release condition of the temperature low range for parallelization" VALUE 0x8051C430 RB_Val_Wu16 1535.977 temp_q0p0234_o273 -273.150 1262.827 FORMAT "%8.3" /end CHARACTERISTIC
/begin CHARACTERISTIC EGSDCmn_tCat1RngLoMaxTstParl_C "the upper limit of the catalyst temperature of the release condition of the temperature low range for parallelization in shorttrip" VALUE 0x8051C432 RB_Val_Wu16 1535.977 temp_q0p0234_o273 -273.150 1262.827 FORMAT "%8.3" /end CHARACTERISTIC
/begin CHARACTERISTIC EGSDCmn_tCat1RngLoMinParl_C "the lower limit of the catalyst temperature of the release condition of the temperature low range for parallelization" VALUE 0x8051C434 RB_Val_Wu16 1535.977 temp_q0p0234_o273 -273.150 1262.827 FORMAT "%8.3" /end CHARACTERISTIC
/begin CHARACTERISTIC EGSDCmn_tCat1RngLoMinTstParl_C "the lower limit of the catalyst temperature of the release condition of the temperature low range for parallelization in short trip" VALUE 0x8051C436 RB_Val_Wu16 1535.977 temp_q0p0234_o273 -273.150 1262.827 FORMAT "%8.3" /end CHARACTERISTIC
/begin CHARACTERISTIC EGSDCmn_tCatMaxGrdtParl_C "Maximum of temperature change at parallelization" VALUE 0x8051C438 RB_Val_Ws16 1535.977 temp_q0p0234 -768.0000 767.9766 FORMAT "%8.4" /end CHARACTERISTIC
/begin CHARACTERISTIC EGSDCmn_tCatMaxGrdtTstParl_C "Maximum of temperature change at parallelization in short trip" VALUE 0x8051C43A RB_Val_Ws16 1535.977 temp_q0p0234 -768.0000 767.9766 FORMAT "%8.4" /end CHARACTERISTIC
/begin CHARACTERISTIC EGSDCmn_tCatMinGrdtParl_C "min. tolerable temperature dynamic (gradient) to release parallel diagnosis" VALUE 0x8051C43C RB_Val_Ws16 1535.977 temp_q0p0234 -768.0000 767.9766 FORMAT "%8.4" /end CHARACTERISTIC
/begin CHARACTERISTIC EGSDCmn_tCatMinGrdtTstParl_C "min. tolerable temperature dynamic (gradient) to release parallel diagnosis, during short trip" VALUE 0x8051C43E RB_Val_Ws16 1535.977 temp_q0p0234 -768.0000 767.9766 FORMAT "%8.4" /end CHARACTERISTIC
/begin CHARACTERISTIC EGSDCmn_tCatMinParl_C "min-temperature for catalyst cooling down detection" VALUE 0x8051C440 RB_Val_Ws16 6553.500 Temp_Cels -3549.940 3003.560 FORMAT "%8.3" /end CHARACTERISTIC
/begin CHARACTERISTIC EGSDCmn_tEngMinParl_C "minimum coolant temperature at engine output for enable condition" VALUE 0x8051C442 RB_Val_Ws16 6553.500 Temp_Cels -3549.940 3003.560 FORMAT "%8.3" /end CHARACTERISTIC
/begin CHARACTERISTIC EGSDCmn_tiCatMinOffParl_C "inhibit time for catalyst cooling down detection" VALUE 0x8051C444 RB_Val_Wu16 6553.500 t_q0p1 0.00 6553.500 FORMAT "%8.3" /end CHARACTERISTIC
/begin CHARACTERISTIC EGSDCmn_tiCatMinOnParl_C "duration of heating up for catalyst cooling down detection" VALUE 0x8051C446 RB_Val_Wu16 6553.500 t_q0p1 0.00 6553.500 FORMAT "%8.3" /end CHARACTERISTIC
/begin CHARACTERISTIC EGSDCmn_tiDebInjVlvDisblParl_C "Debouncing time for the inhibit of the physical enable conditions of the parallelization because of the injection valve deactivation" VALUE 0x8051C448 RB_Val_Wu8 25.50 t_q0p1 0.00 25.50 FORMAT "%5.2" /end CHARACTERISTIC
/begin CHARACTERISTIC EGSDCmn_tiDebInjVlvEnaParl_C "Debouncing time for the inhibit of the physical enable conditions of the parallelization because of the injection valve deactivation" VALUE 0x8051C44A RB_Val_Wu16 180.0000 t_q0p1 0.00 180.0000 FORMAT "%8.4" EXTENDED_LIMITS 0.00 6553.500 /end CHARACTERISTIC
/begin CHARACTERISTIC EGSDCmn_tiDebSigndLamMonParl_CUR "Debounce for deviation of current value" CURVE 0x8051C44C RB_Curve_S16_U16_Static 99.99847 k10ms_uw_b100 0.00 99.99847 FORMAT "%8.5"
 /begin AXIS_DESCR STD_AXIS NO_INPUT_QUANTITY fak_q0p000244 6 -8.000000 7.999756 FORMAT "%8.6" DEPOSIT ABSOLUTE /end AXIS_DESCR
/end CHARACTERISTIC
/begin CHARACTERISTIC EGSDCmn_tiEnaCatTGrdtParl_C "low pass filter time constant for main catalyst temperature of parallelization" VALUE 0x8051C466 RB_Val_Wu16 6553.4999985 zk100msxs_uw_b6553p6 0.1000015 6553.6000000 FORMAT "%12.7" EXTENDED_LIMITS 0.10000152590 6553.6000000 /end CHARACTERISTIC
/begin CHARACTERISTIC EGSDCmn_tiEnaMflowParl_C "time constant of the filtering of the mass flow for release condition of parallelization" VALUE 0x8051C468 RB_Val_Wu8 25.50 t_q0p1 0.00 25.50 FORMAT "%5.2" /end CHARACTERISTIC
/begin CHARACTERISTIC EGSDCmn_tiFilLamCtrlVParl_C "Filter time constant for controller factor" VALUE 0x8051C2D4 RB_Val_Wu8 25.4996 zk100msxs_ub_b25p6 0.1004 25.6000 FORMAT "%7.4" EXTENDED_LIMITS 0.100392 25.6000 /end CHARACTERISTIC
/begin CHARACTERISTIC EGSDCmn_tiFltMflowParl_C "low pass filter time constant for air mass flow for building of mass flow gradient" VALUE 0x8051C46A RB_Val_Wu16 655.34999985 zk10msxs_uw_b655 0.01000015 655.36000000 FORMAT "%12.8" EXTENDED_LIMITS 0.010000152590 655.36000000 /end CHARACTERISTIC
/begin CHARACTERISTIC EGSDCmn_tiGearShiftParl_C "Debouncing time for condition gear shift disabled" VALUE 0x8051C46C RB_Val_Wu8 25.50 t_q0p1 0.00 25.50 FORMAT "%5.2" /end CHARACTERISTIC
/begin CHARACTERISTIC EGSDCmn_tiIdleMax_C "Acceptable time with low engine speed (idle, StartStop, sailing etc.), until parallelization is disabled." VALUE 0x8051C46E RB_Val_Wu16 6553.500 t_q0p1 0.00 6553.500 FORMAT "%8.3" /end CHARACTERISTIC
/begin CHARACTERISTIC EGSDCmn_tiNEngOvrIdle_C "Debounce time: engine speed may exceed EGSDCmn_nEngIdle_C" VALUE 0x8051C470 RB_Val_Wu16 6553.500 t_q0p1 0.00 6553.500 FORMAT "%8.3" /end CHARACTERISTIC
/begin CHARACTERISTIC EGSDCmn_tiRngLoUnderMinParl_C "time duration for EGSDCmn_dmfRngLoUnderMinParl_C consideration when the Mass flow is in Low range for parallelization (when Diagnosis is Active )" VALUE 0x8051C472 RB_Val_Wu8 25.50 t_q0p1 0.00 25.50 FORMAT "%5.2" /end CHARACTERISTIC
/begin CHARACTERISTIC EGSDCmn_tiSeg1EnaTripParl_T "waiting time for release condition of diagnosis since engine start" CURVE 0x8051C474 RB_Curve_S16_U16_Static 6553.500 t_q0p1 0.00 6553.500 FORMAT "%8.3"
 /begin AXIS_DESCR STD_AXIS CEngDsT_tStrtFrst Temp_Cels 7 -3549.940 3003.560 FORMAT "%8.3" DEPOSIT ABSOLUTE /end AXIS_DESCR
/end CHARACTERISTIC
/begin CHARACTERISTIC EGSDCmn_tiUInpFltParl_C "low pass filter time constant of binary sensor voltage for parallelization" VALUE 0x8051C4A2 RB_Val_Wu16 655.3500 t_q0p01 0.00 655.3500 FORMAT "%8.4" /end CHARACTERISTIC
/begin CHARACTERISTIC EGSDCmn_tiUInpFltTWCD_C "Filter Time Constant for low pass filter of Sensor voltage for TWC Operations" VALUE 0x8051C4A4 RB_Val_Wu16 655.3500 t_q0p01 0.00 655.3500 FORMAT "%8.4" /end CHARACTERISTIC
/begin CHARACTERISTIC EGSDCmn_tMinCatRelsParl_C "Minimum temperature catalyst 1 must exceed during heat up process in order to release diagnosis" VALUE 0x8051C492 RB_Val_Wu16 1535.977 temp_q0p0234_o273 -273.150 1262.827 FORMAT "%8.3" /end CHARACTERISTIC
/begin CHARACTERISTIC EGSDCmn_tqResvParl_C "requested torque reserve for parallelization" VALUE 0x8051C2D6 RB_Val_Ws16 6553.400 trq_q0p1 -3276.700 3276.700 FORMAT "%8.3" EXTENDED_LIMITS -3276.800 3276.700 /end CHARACTERISTIC
/begin CHARACTERISTIC EGSDCmn_tqResvTstParl_C "requested torque reserve for parallelization in short trip" VALUE 0x8051C2D8 RB_Val_Ws16 6553.400 trq_q0p1 -3276.700 3276.700 FORMAT "%8.3" EXTENDED_LIMITS -3276.800 3276.700 /end CHARACTERISTIC
/begin CHARACTERISTIC EGSDCmn_tS2EnaSensParl_C "minimum exhaust gas temperature at sensor 2 for parallelization" VALUE 0x8051C494 RB_Val_Wu16 1535.977 temp_q0p0234_o273 -273.150 1262.827 FORMAT "%8.3" /end CHARACTERISTIC
/begin CHARACTERISTIC EGSDCmn_tS2EnaSensTstParl_C "minimum exhaust gas temperature at sensor 2 for parallelization in short trip" VALUE 0x8051C496 RB_Val_Wu16 1535.977 temp_q0p0234_o273 -273.150 1262.827 FORMAT "%8.3" /end CHARACTERISTIC
/begin CHARACTERISTIC EGSDCmn_vVehSpdMinParl_C "minimal vehicle speed for parallelization" VALUE 0x8051C498 RB_Val_Ws16 655.3500 Vel -327.6800 327.6700 FORMAT "%8.4" /end CHARACTERISTIC
/begin CHARACTERISTIC EGSDO2_dmExhEnaIdn_C "Maximal allowed exhaust mass flow to enable identification" VALUE 0x8051C4BA RB_Val_Wu16 6553.500 m_uw_b6553p5 0.00 6553.500 FORMAT "%8.3" /end CHARACTERISTIC
/begin CHARACTERISTIC EGSDO2_dmfExhIdnMax_C "Maximal gradient of the exhaust mass flow to enable identification" VALUE 0x8051C4BC RB_Val_Ws16 6553.500 m_sw_b3276p8 -3276.800 3276.700 FORMAT "%8.3" /end CHARACTERISTIC
/begin CHARACTERISTIC EGSDO2_dmfExhIdnMin_C "Minimal gradient of the exhaust mass flow to enable identification" VALUE 0x8051C4BE RB_Val_Ws16 6553.500 m_sw_b3276p8 -3276.800 3276.700 FORMAT "%8.3" /end CHARACTERISTIC
/begin CHARACTERISTIC EGSDO2_dmFpcDynEnaMax_C "Maximal allowed purge mass flow to enable identification" VALUE 0x8051C4C0 RB_Val_Wu16 25.59961 m_uw_b25p6 0.00 25.59961 FORMAT "%8.5" /end CHARACTERISTIC
/begin CHARACTERISTIC EGSDO2_dratFillgThd_C "Maximal allowed change of filling" VALUE 0x8051C4C2 RB_Val_Wu16 1535.977 rel_uw_q0p0234 0.00 1535.977 FORMAT "%8.3" /end CHARACTERISTIC
/begin CHARACTERISTIC EGSDO2_flgIdnDurgCatPurg_C "online identification during catpurge allow" VALUE 0x8051C4C4 RB_Val_Wu8 1.00000000000 B_TRUE 0.00 1.00000000000 FORMAT "%13.11" /end CHARACTERISTIC
/begin CHARACTERISTIC EGSDO2_flgIdnDurgParl_CW "Codebit: identification only runs in case of active parallelization" VALUE 0x8051C4C5 RB_Val_Wu8 1.00000000000 B_TRUE 0.00 1.00000000000 FORMAT "%13.11" /end CHARACTERISTIC
/begin CHARACTERISTIC EGSDO2_flgSeqDyn_C "Activation of the sequential sequence" VALUE 0x8051C4C6 RB_Val_Wu8 1.00000000000 B_TRUE 0.00 1.00000000000 FORMAT "%13.11" /end CHARACTERISTIC
/begin CHARACTERISTIC EGSDO2_mFpcDynEnaMin_C "Minimal integrated purge mass of fuel purge control to enable identification" VALUE 0x8051C4C7 RB_Val_Wu8 11.32 m_ub_q0p0444 0.00 11.32 FORMAT "%5.2" /end CHARACTERISTIC
/begin CHARACTERISTIC EGSDO2_nrMeasShtrp_C "Number of step response measurements for short trip" VALUE 0x8051C4A6 RB_Val_Wu8 255.0 dez 0.00 255.0 FORMAT "%5.1" /end CHARACTERISTIC
/begin CHARACTERISTIC EGSDO2_nrMeasTrip_C "Number of step response measurements per driving cycle" VALUE 0x8051C4A7 RB_Val_Wu8 255.0 dez 0.00 255.0 FORMAT "%5.1" /end CHARACTERISTIC
/begin CHARACTERISTIC EGSDO2_ratFillgMinIdnEna_T "Minimal relative filling to enable identification" CURVE 0x8051C4C8 RB_Curve_S16_U16_Static 1535.977 rel_uw_q0p0234 0.00 1535.977 FORMAT "%8.3"
 /begin AXIS_DESCR STD_AXIS Epm_nEng EngN 4 -16384.00 16383.50 FORMAT "%8.2" DEPOSIT ABSOLUTE /end AXIS_DESCR
/end CHARACTERISTIC
/begin CHARACTERISTIC EGSDO2_ratLamEnaThd_C "Minimal change in modelled lambda necessary to enable identification" VALUE 0x8051C4DA RB_Val_Wu16 1.999969 fak_q3p0518Em5 0.00 1.999969 FORMAT "%8.6" /end CHARACTERISTIC
/begin CHARACTERISTIC EGSDO2_tiDlyBpu_C "Delay time of best part unacceptable" VALUE 0x8051C4A8 RB_Val_Wu16 655.3500 t_q0p01 0.00 655.3500 FORMAT "%8.4" /end CHARACTERISTIC
/begin CHARACTERISTIC EGSDO2_tiDlyIdnFltThd_C "Threshold for detection of delay time fault by identification" VALUE 0x8051C4AA RB_Val_Wu16 655.3500 t_q0p01 0.00 655.3500 FORMAT "%8.4" /end CHARACTERISTIC
/begin CHARACTERISTIC EGSDO2_tiDlyLtrStepFltThdShtrp_C "Fault threshold of delay time (step response, lean to rich) during short trip" VALUE 0x8051C4AC RB_Val_Wu16 655.3500 t_q0p01 0.00 655.3500 FORMAT "%8.4" /end CHARACTERISTIC
/begin CHARACTERISTIC EGSDO2_tiDlyRtlStepFltThdShtrp_C "Fault threshold of delay time (step response, rich to lean) during short trip" VALUE 0x8051C4AE RB_Val_Wu16 655.3500 t_q0p01 0.00 655.3500 FORMAT "%8.4" /end CHARACTERISTIC
/begin CHARACTERISTIC EGSDO2_tiEnaIdnMFlow_C "Turn-on delay for identification after instationary exhaust mass flow" VALUE 0x8051C4DC RB_Val_Wu16 655.3400 t_q0p01 0.0100 655.3500 FORMAT "%8.4" EXTENDED_LIMITS 0.00 655.3500 /end CHARACTERISTIC
/begin CHARACTERISTIC EGSDO2_tiFilExhMFlowIdn_C "Filter time constant for gradient calculation of exhaust mass flow for enabling of identification" VALUE 0x8051C4DE RB_Val_Wu16 655.34999985 zk10msxs_uw_b655p36 0.01000015 655.36000000 FORMAT "%12.8" EXTENDED_LIMITS 0.010000152590 655.36000000 /end CHARACTERISTIC
/begin CHARACTERISTIC EGSDO2_tiGearShift_C "debounce time param for Gear Shift." VALUE 0x8051C4E0 RB_Val_Wu8 2.550 t_q0p01 0.00 2.550 FORMAT "%5.3" /end CHARACTERISTIC
/begin CHARACTERISTIC EGSDO2_tiPt1RatFillgEna_C "Differential time constant for relative filling to enable identification" VALUE 0x8051C4E2 RB_Val_Wu16 655.34999985 zk10msxs_uw_b655p36 0.01000015 655.36000000 FORMAT "%12.8" EXTENDED_LIMITS 0.010000152590 655.36000000 /end CHARACTERISTIC
/begin CHARACTERISTIC EGSDO2_tiSumIdnFltThd_C "Fault threshold for sum time from identification" VALUE 0x8051C4B0 RB_Val_Wu16 655.3500 t_q0p01 0.00 655.3500 FORMAT "%8.4" /end CHARACTERISTIC
/begin CHARACTERISTIC EGSDO2_tiTiConNomEnaIdnShtrp_C "Maximal nominal plant time constant to enable identification during short trip" VALUE 0x8051C4E4 RB_Val_Wu16 655.3400 t_q0p01 0.0100 655.3500 FORMAT "%8.4" EXTENDED_LIMITS 0.00 655.3500 /end CHARACTERISTIC
/begin CHARACTERISTIC EGSDO2_tiTiConNomEnaIdn_C "Maximal nominal plant time constant to enable identification" VALUE 0x8051C4E6 RB_Val_Wu16 655.3400 t_q0p01 0.0100 655.3500 FORMAT "%8.4" EXTENDED_LIMITS 0.00 655.3500 /end CHARACTERISTIC
/begin CHARACTERISTIC EGSDO2_tiTranBpu_C "Transition time of best part unacceptable" VALUE 0x8051C4B2 RB_Val_Wu16 655.3500 t_q0p01 0.00 655.3500 FORMAT "%8.4" /end CHARACTERISTIC
/begin CHARACTERISTIC EGSDO2_tiTranIdnFltThd_C "Threshold for detection of transition time fault by identification" VALUE 0x8051C4B4 RB_Val_Wu16 655.3500 t_q0p01 0.00 655.3500 FORMAT "%8.4" /end CHARACTERISTIC
/begin CHARACTERISTIC EGSDO2_tiTranLtrStepFltThdShtrp_C "Fault threshold of transition time (step response, lean to rich) during short trip" VALUE 0x8051C4B6 RB_Val_Wu16 655.3500 t_q0p01 0.00 655.3500 FORMAT "%8.4" /end CHARACTERISTIC
/begin CHARACTERISTIC EGSDO2_tiTranRtlStepFltThdShtrp_C "Fault threshold of transition time (step response, rich to lean) during short trip" VALUE 0x8051C4B8 RB_Val_Wu16 655.3500 t_q0p01 0.00 655.3500 FORMAT "%8.4" /end CHARACTERISTIC
/begin CHARACTERISTIC EGSDO2_tiTurnOffExct_C "Turn off delay at unsufficient dynamic excitation" VALUE 0x8051C4E8 RB_Val_Wu16 655.3500 t_q0p01 0.00 655.3500 FORMAT "%8.4" /end CHARACTERISTIC
/begin CHARACTERISTIC EGSDO2_tiTurnOffIdnLamMon_C "Turn off delay when lambda stability criterion is not fulfilled" VALUE 0x8051C4EA RB_Val_Wu16 655.3500 t_q0p01 0.00 655.3500 FORMAT "%8.4" /end CHARACTERISTIC
/begin CHARACTERISTIC EGSDO2_tiTurnOffVlvLft_C "Turn-on delay after change in valve lift" VALUE 0x8051C4EC RB_Val_Wu16 655.3400 t_q0p01 0.0100 655.3500 FORMAT "%8.4" EXTENDED_LIMITS 0.00 655.3500 /end CHARACTERISTIC
/begin CHARACTERISTIC EGSDO2_tiTurnOnBpChg_C "Turn-on delay after switching bandpass" VALUE 0x8051C4EE RB_Val_Wu16 655.3500 t_q0p01 0.00 655.3500 FORMAT "%8.4" /end CHARACTERISTIC
/begin CHARACTERISTIC EGSDO2_tiTurnOnEna_C "Turn on delay of identification after release of controller" VALUE 0x8051C4F0 RB_Val_Wu16 655.3500 t_q0p01 0.00 655.3500 FORMAT "%8.4" /end CHARACTERISTIC
/begin CHARACTERISTIC EGSDO2_tiTurnOnFcoFltSuspc_C "Turn-on delay after fuel cut-off at fault suspicion" VALUE 0x8051C4F2 RB_Val_Wu16 655.3500 t_q0p01 0.00 655.3500 FORMAT "%8.4" /end CHARACTERISTIC
/begin CHARACTERISTIC EGSDO2_tiTurnOnFco_C "Turn-on delay after fuel cut-off" VALUE 0x8051C4F4 RB_Val_Wu16 655.3500 t_q0p01 0.00 655.3500 FORMAT "%8.4" /end CHARACTERISTIC
/begin CHARACTERISTIC EGSDO2_tiTurnOnFillgGrdtFltSuspc_C "Turn-on delay after large filling gradient at fault suspicion" VALUE 0x8051C4F6 RB_Val_Wu16 655.3500 t_q0p01 0.00 655.3500 FORMAT "%8.4" /end CHARACTERISTIC
/begin CHARACTERISTIC EGSDO2_tiTurnOnFillgGrdt_C "Turn-on delay after large filling gradient" VALUE 0x8051C4F8 RB_Val_Wu16 655.3500 t_q0p01 0.00 655.3500 FORMAT "%8.4" /end CHARACTERISTIC
/begin CHARACTERISTIC EGSDO2_tiTurnOnFillg_C "Turn-on delay after sufficiently large filling" VALUE 0x8051C4FA RB_Val_Wu16 655.3500 t_q0p01 0.00 655.3500 FORMAT "%8.4" /end CHARACTERISTIC
/begin CHARACTERISTIC EGSDO2_tiTurnOnSnsrRdn_C "Turn on delay of identification after sensor readiness" VALUE 0x8051C4FC RB_Val_Wu16 655.3500 t_q0p01 0.00 655.3500 FORMAT "%8.4" /end CHARACTERISTIC
/begin CHARACTERISTIC EGSDO2_tiTurnOnStrt_C "Turn-on delay after end of start" VALUE 0x8051C4FE RB_Val_Wu16 655.3500 t_q0p01 0.00 655.3500 FORMAT "%8.4" /end CHARACTERISTIC
/begin MEASUREMENT EGSDCmn_CatCoolOffParlB1TONV_I.outbit "TurnOnDelay: catalyst is cooling down / return value" UBYTE B_TRUE 1 100 0.00 1.00000000000 BIT_MASK 0x1 FORMAT "%13.11" ECU_ADDRESS 0x60003BA2 /end MEASUREMENT
/begin MEASUREMENT EGSDCmn_CatCoolOffParlB1TONV_I.time "TurnOnDelay: catalyst is cooling down / expired delay time" UWORD t_q0p1 1 100 0.00 6553.500 FORMAT "%8.3" ECU_ADDRESS 0x60003BA4 /end MEASUREMENT
/begin MEASUREMENT EGSDCmn_CatWrmUpParlB1TONV_I.outbit "TurnOnDelay: catalyst is warming up / return value" UBYTE B_TRUE 1 100 0.00 1.00000000000 BIT_MASK 0x1 FORMAT "%13.11" ECU_ADDRESS 0x60003B9E /end MEASUREMENT
/begin MEASUREMENT EGSDCmn_CatWrmUpParlB1TONV_I.time "TurnOnDelay: catalyst is warming up / expired delay time" UWORD t_q0p1 1 100 0.00 6553.500 FORMAT "%8.3" ECU_ADDRESS 0x60003BA0 /end MEASUREMENT
/begin MEASUREMENT EGSDCmn_cntrB1AbortParlLamMon "Abort counter of parallelization due to Lambda monitoring condition (since clearing of error memory)" UWORD dez 1 100 0.00 65535.00 FORMAT "%8.2" ECU_ADDRESS 0x60004D1C /end MEASUREMENT
/begin MEASUREMENT EGSDCmn_cntrB1AbortParlLamMonNV "Abort counter of parallelization due to Lambda monitoring condition (since clearing of error memory)" UWORD dez 1 100 0.00 65535.00 FORMAT "%8.2" ECU_ADDRESS 0x60036656 /end MEASUREMENT
/begin MEASUREMENT EGSDCmn_cntrB1AbortParlNEng "Abort counter of parallelization due to engine speed (since clearing of error memory)" UWORD dez 1 100 0.00 65535.00 FORMAT "%8.2" ECU_ADDRESS 0x60004D1A /end MEASUREMENT
/begin MEASUREMENT EGSDCmn_cntrB1AbortParlNEngNV "Abort counter of parallelization due to engine speed (since clearing of error memory)" UWORD dez 1 100 0.00 65535.00 FORMAT "%8.2" ECU_ADDRESS 0x60036654 /end MEASUREMENT
/begin MEASUREMENT EGSDCmn_cntrB1AbortParlNV "Abort counter of parallelization with exhaust gas relevant lambda shift (since clearing of error memory)" UWORD dez 1 100 0.00 65535.00 FORMAT "%8.2" ECU_ADDRESS 0x60036652 /end MEASUREMENT
/begin MEASUREMENT EGSDCmn_cntrB1AbortParlRelLd "Abort counter of parallelization due to relative load (since clearing of error memory)" UWORD dez 1 100 0.00 65535.00 FORMAT "%8.2" ECU_ADDRESS 0x60004D18 /end MEASUREMENT
/begin MEASUREMENT EGSDCmn_cntrB1AbortParlRelLdNV "Abort counter of parallelization due to relative load (since clearing of error memory)" UWORD dez 1 100 0.00 65535.00 FORMAT "%8.2" ECU_ADDRESS 0x60036650 /end MEASUREMENT
/begin MEASUREMENT EGSDCmn_cntrB1AbortParlV "Abort counter of parallelization due to vehicle speed (since clearing of error memory)" UWORD dez 1 100 0.00 65535.00 FORMAT "%8.2" ECU_ADDRESS 0x60004D16 /end MEASUREMENT
/begin MEASUREMENT EGSDCmn_cntrB1AbortParlVNV "Abort counter of parallelization due to vehicle speed (since clearing of error memory)" UWORD dez 1 100 0.00 65535.00 FORMAT "%8.2" ECU_ADDRESS 0x6003664E /end MEASUREMENT
/begin MEASUREMENT EGSDCmn_cntrB1AbortSumParl "Abort counter of parallelization with exhaust gas relevant lambda shift (since clearing of error memory)" UWORD dez 1 100 0.00 65535.00 FORMAT "%8.2" ECU_ADDRESS 0x60004D14 /end MEASUREMENT
/begin MEASUREMENT EGSDCmn_cntrB1StrtParlNV "Counter for starts of parallelization with influence on emissions (since clearing of error memory)" UWORD dez 1 100 0.00 65535.00 FORMAT "%8.2" ECU_ADDRESS 0x6003664C /end MEASUREMENT
/begin MEASUREMENT EGSDCmn_cntrB1StrtSumParl "Counter for starts of parallelization with influence on emissions (since clearing of error memory)" UWORD dez 1 100 0.00 65535.00 FORMAT "%8.2" ECU_ADDRESS 0x60004D12 /end MEASUREMENT
/begin MEASUREMENT EGSDCmn_cntrSeg1B1AbortParlHiRng "Abort counter of parallelization due to Exhaust gas mass flow or catalyst Temperature outside of High Range (since clearing of error memory)" UWORD dez 1 100 0.00 65535.00 FORMAT "%8.2" ECU_ADDRESS 0x60004D10 /end MEASUREMENT
/begin MEASUREMENT EGSDCmn_cntrSeg1B1AbortParlHiRngNV "Abort counter of parallelization due to Exhaust gas mass flow or catalyst Temperature outside of High Range (since clearing of error memory)" UWORD dez 1 100 0.00 65535.00 FORMAT "%8.2" ECU_ADDRESS 0x6003664A /end MEASUREMENT
/begin MEASUREMENT EGSDCmn_cntrSeg1B1AbortParlLoRng "Abort counter of parallelization due to Exhaust gas mass flow or catalyst Temperature outside of Low Range (since clearing of error memory)" UWORD dez 1 100 0.00 65535.00 FORMAT "%8.2" ECU_ADDRESS 0x60004D0E /end MEASUREMENT
/begin MEASUREMENT EGSDCmn_cntrSeg1B1AbortParlLoRngNV "Abort counter of parallelization due to Exhaust gas mass flow or catalyst Temperature outside of Low Range (since clearing of error memory)" UWORD dez 1 100 0.00 65535.00 FORMAT "%8.2" ECU_ADDRESS 0x60036648 /end MEASUREMENT
/begin MEASUREMENT EGSDCmn_cntrSeg1B1AbortParlMFlowGrdt "Abort counter of parallelization due to Exhaust gas mass flow gradient (since clearing of error memory)" UWORD dez 1 100 0.00 65535.00 FORMAT "%8.2" ECU_ADDRESS 0x60004D0C /end MEASUREMENT
/begin MEASUREMENT EGSDCmn_cntrSeg1B1AbortParlMFlowGrdtNV "Abort counter of parallelization due to Exhaust gas mass flow gradient (since clearing of error memory)" UWORD dez 1 100 0.00 65535.00 FORMAT "%8.2" ECU_ADDRESS 0x60036646 /end MEASUREMENT
/begin MEASUREMENT EGSDCmn_cntrSeg1B1AbortParlTGrdt "Abort counter of parallelization due to Catalyst temperature gradient (since clearing of error memory)" UWORD dez 1 100 0.00 65535.00 FORMAT "%8.2" ECU_ADDRESS 0x60004D0A /end MEASUREMENT
/begin MEASUREMENT EGSDCmn_cntrSeg1B1AbortParlTGrdtNV "Abort counter of parallelization due to Catalyst temperature gradient (since clearing of error memory)" UWORD dez 1 100 0.00 65535.00 FORMAT "%8.2" ECU_ADDRESS 0x60036644 /end MEASUREMENT
/begin MEASUREMENT EGSDCmn_CpvEB_I.buffer "Rising or falling edge of canister purge / EdgeBi.buffer" UBYTE B_TRUE 1 100 0.00 1.00000000000 BIT_MASK 0x1 FORMAT "%13.11" ECU_ADDRESS 0x60003B9C /end MEASUREMENT
/begin MEASUREMENT EGSDCmn_CpvEB_I.oldSignal "Rising or falling edge of canister purge / EdgeBi.odlSignal" UBYTE B_TRUE 1 100 0.00 1.00000000000 BIT_MASK 0x1 FORMAT "%13.11" ECU_ADDRESS 0x60003B9D /end MEASUREMENT
/begin MEASUREMENT EGSDCmn_ctReIni100msCoorrParlEna "ReIni counter" UBYTE OneToOne 1 100 0.00 255.0 FORMAT "%5.1" ECU_ADDRESS 0x6000658B /end MEASUREMENT
/begin MEASUREMENT EGSDCmn_ctReIni10msCoorrParlEna "ReIni counter" UBYTE OneToOne 1 100 0.00 255.0 FORMAT "%5.1" ECU_ADDRESS 0x6000658C /end MEASUREMENT
/begin MEASUREMENT EGSDCmn_ctReIniShoTrip "ReIni counter" UBYTE OneToOne 1 100 0.00 255.0 FORMAT "%5.1" ECU_ADDRESS 0x6000E399 /end MEASUREMENT
/begin MEASUREMENT EGSDCmn_dmfEgCat1InpParlB1 "Change rate of exhaust gas mass flow input into catalyst 1, bank 1" SWORD m_sw_b3276p8 1 100 -3276.800 3276.700 FORMAT "%8.3" ECU_ADDRESS 0x6000E1A8 /end MEASUREMENT
/begin MEASUREMENT EGSDCmn_dmO2Cat1B1Parl "Oxygen Gas Mass flow into catalyst 1 , Bank 1" SWORD m_q0p1_mgs 1 100 -3276.800 3276.700 FORMAT "%8.3" ECU_ADDRESS 0x6000E19E /end MEASUREMENT
/begin MEASUREMENT EGSDCmn_dmSeg1B1O2Parl "Oxygen mass flow in catalyst 1 (considers maximum possible mixture deviation in a fault free system)" UWORD m_q0p1_mgs 1 100 0.00 6553.500 FORMAT "%8.3" ECU_ADDRESS 0x6000E1A0 /end MEASUREMENT
/begin MEASUREMENT EGSDCmn_dmSeg1B1RichParl "Rich gas mass flow in catalyst 1 (considers maximum possible mixture deviation in a fault free system)" UWORD m_q0p1_mgs 1 100 0.00 6553.500 FORMAT "%8.3" ECU_ADDRESS 0x6000E1A2 /end MEASUREMENT
/begin MEASUREMENT EGSDCmn_dmSeg1B1VirtO2Parl "Virtual Oxygen mass flow in catalyst 1 (considers maximum possible mixture deviation in a fault free system)" UWORD m_q0p1_mgs 1 100 0.00 6553.500 FORMAT "%8.3" ECU_ADDRESS 0x6000E1A4 /end MEASUREMENT
/begin MEASUREMENT EGSDCmn_dmSeg1B1VirtRichParl "Virtual Rich gas mass flow in catalyst 1 (considers maximum possible mixture deviation in a fault free system)" UWORD m_q0p1_mgs 1 100 0.00 6553.500 FORMAT "%8.3" ECU_ADDRESS 0x6000E1A6 /end MEASUREMENT
/begin MEASUREMENT EGSDCmn_duS2B1Parl "gradient of filtered sensor voltage of sensor 2, bank 1, used in diagnosis" SWORD RBPtCel_du_7p62939em4_1 1 100 -25.00000 24.99924 FORMAT "%8.5" ECU_ADDRESS 0x60005100 /end MEASUREMENT
/begin MEASUREMENT EGSDCmn_EnaAftIdleFcoFF_I.status "Flip FLop Instance indicating the Status of Engine in Idling and Fuel Cut off Condition for Parallelization / current value of RS-FF" UBYTE B_TRUE 1 100 0.00 1.00000000000 BIT_MASK 0x1 FORMAT "%13.11" ECU_ADDRESS 0x6000658A /end MEASUREMENT
/begin MEASUREMENT EGSDCmn_EnaCatTGrdtParlB1LT_I.memory "filtered catalyst temperature for calculation of the temperature gradient, bank 1 / current lowpass value" ULONG temp_q3p57Em7_om273 1 100 -273.15000000 1262.84999964 FORMAT "%13.8" ECU_ADDRESS 0x600015D8 /end MEASUREMENT
/begin MEASUREMENT EGSDCmn_EomDmd_I.stOperMod "Engine operation mode request of the active exhaust gas sensor and catalyst diagnosis (parallelization) / Priority-element of the operation mode structure" ULONG OneToOne 1 100 0.00 4294967295.00 FORMAT "%13.2" ECU_ADDRESS 0x70001A24 /end MEASUREMENT
/begin MEASUREMENT EGSDCmn_EomDmd_I.stOperModPrio "Engine operation mode request of the active exhaust gas sensor and catalyst diagnosis (parallelization) / Stage-element of the operation mode structure" UBYTE OneToOne 1 100 0.00 255.0 FORMAT "%5.1" ECU_ADDRESS 0x70001A28 /end MEASUREMENT
/begin MEASUREMENT EGSDCmn_EomDmd_I.stOperModStg "Engine operation mode request of the active exhaust gas sensor and catalyst diagnosis (parallelization) / Operation-mode element of the operation mode structure" UWORD OneToOne 1 100 0.00 65535.00 FORMAT "%8.2" ECU_ADDRESS 0x70001A2A /end MEASUREMENT
/begin MEASUREMENT EGSDCmn_facLamActMonParlB1IK_I.memory "Debouncing for actual mixture deviations, bank 1 / current integrator value" ULONG fak_q2p3283Em10 1 100 0.00 0.999999999767 FORMAT "%14.12" ECU_ADDRESS 0x6000CCF8 /end MEASUREMENT
/begin MEASUREMENT EGSDCmn_facLamCtrlVParlB1 "Controller factor during active parallelization" UBYTE fak_ub_b2 1 100 0.00 1.992188 FORMAT "%8.6" ECU_ADDRESS 0x6000A07B /end MEASUREMENT
/begin MEASUREMENT EGSDCmn_facLamCtrlVParlB1LT_I.memory "factor filtering / current lowpass value" UWORD fak_uw_b2 1 100 0.00 1.999969 FORMAT "%8.6" ECU_ADDRESS 0x60003BA8 /end MEASUREMENT
/begin MEASUREMENT EGSDCmn_flgActvHiRngSeg1B1 "Exhaust gas mass flow and catalyst temperature have been in high enabling range once" UBYTE B_TRUE 1 100 0.00 1.00000000000 BIT_MASK 0x1 FORMAT "%13.11" ECU_ADDRESS 0x700008A7 /end MEASUREMENT
/begin MEASUREMENT EGSDCmn_flgActvLoRngSeg1B1 "Exhaust gas mass flow and catalyst temperature have been in low enabling range once" UBYTE B_TRUE 1 100 0.00 1.00000000000 BIT_MASK 0x1 FORMAT "%13.11" ECU_ADDRESS 0x700008A6 /end MEASUREMENT
/begin MEASUREMENT EGSDCmn_flgB1AbortParlEF_I.buffer "- / memory to detect falling edge" UBYTE B_TRUE 1 100 0.00 1.00000000000 BIT_MASK 0x1 FORMAT "%13.11" ECU_ADDRESS 0x60003B90 /end MEASUREMENT
/begin MEASUREMENT EGSDCmn_flgB1AbortParlEF_I.oldSignal "- / memory to detect falling edge" UBYTE B_TRUE 1 100 0.00 1.00000000000 BIT_MASK 0x1 FORMAT "%13.11" ECU_ADDRESS 0x60003B91 /end MEASUREMENT
/begin MEASUREMENT EGSDCmn_flgB1EgInflParlFF_I.status "- / current value of RS-FF" UBYTE B_TRUE 1 100 0.00 1.00000000000 BIT_MASK 0x1 FORMAT "%13.11" ECU_ADDRESS 0x60006583 /end MEASUREMENT
/begin MEASUREMENT EGSDCmn_flgB1StartParlER_I.buffer "- / rising edge detected" UBYTE B_TRUE 1 100 0.00 1.00000000000 BIT_MASK 0x1 FORMAT "%13.11" ECU_ADDRESS 0x60003B8E /end MEASUREMENT
/begin MEASUREMENT EGSDCmn_flgB1StartParlER_I.oldSignal "- / flag rising edge" UBYTE B_TRUE 1 100 0.00 1.00000000000 BIT_MASK 0x1 FORMAT "%13.11" ECU_ADDRESS 0x60003B8F /end MEASUREMENT
/begin MEASUREMENT EGSDCmn_flgCat1B1EnaTHomParl "Catalyst is homogeneously heated for execution of parallel exhaust gas components diagnosis" UBYTE B_TRUE 1 100 0.00 1.00000000000 BIT_MASK 0x1 FORMAT "%13.11" ECU_ADDRESS 0x700002BF /end MEASUREMENT
/begin MEASUREMENT EGSDCmn_flgCat1B1EnaTMinParl "catalyst is not cooled off" UBYTE B_TRUE 1 100 0.00 1.00000000000 BIT_MASK 0x1 FORMAT "%13.11" ECU_ADDRESS 0x700002BE /end MEASUREMENT
/begin MEASUREMENT EGSDCmn_flgCat1B1EnaTParl "temperature gradient of cataylst is stable, bank 1" UBYTE B_TRUE 1 100 0.00 1.00000000000 BIT_MASK 0x1 FORMAT "%13.11" ECU_ADDRESS 0x700008A0 /end MEASUREMENT
/begin MEASUREMENT EGSDCmn_flgCat1B1EnaTRngHiParl "catalyst temperature is within the high range release zone, catalyst 1, bank 1" UBYTE B_TRUE 1 100 0.00 1.00000000000 BIT_MASK 0x1 FORMAT "%13.11" ECU_ADDRESS 0x7000089F /end MEASUREMENT
/begin MEASUREMENT EGSDCmn_flgCat1B1EnaTRngLoParl "catalyst temperature is within the low range release zone, catalyst 1, bank 1" UBYTE B_TRUE 1 100 0.00 1.00000000000 BIT_MASK 0x1 FORMAT "%13.11" ECU_ADDRESS 0x7000089E /end MEASUREMENT
/begin MEASUREMENT EGSDCmn_flgCatWarmAftIdleER_I.buffer "Trigger for keep catalyst warm / rising edge detected" UBYTE B_TRUE 1 100 0.00 1.00000000000 BIT_MASK 0x1 FORMAT "%13.11" ECU_ADDRESS 0x60003B8C /end MEASUREMENT
/begin MEASUREMENT EGSDCmn_flgCatWarmAftIdleER_I.oldSignal "Trigger for keep catalyst warm / flag rising edge" UBYTE B_TRUE 1 100 0.00 1.00000000000 BIT_MASK 0x1 FORMAT "%13.11" ECU_ADDRESS 0x60003B8D /end MEASUREMENT
/begin MEASUREMENT EGSDCmn_flgCatWarmAftIdleFco "Flag Indicating the Warm Catalyst Behaviour after the idling or Fuel Cut off condition." UBYTE B_TRUE 1 100 0.00 1.00000000000 BIT_MASK 0x1 FORMAT "%13.11" ECU_ADDRESS 0x700002BD /end MEASUREMENT
/begin MEASUREMENT EGSDCmn_flgCOEOMPsblParlB1 "customer specific operation mode request is possible, bank 1" UBYTE B_TRUE 1 100 0.00 1.00000000000 BIT_MASK 0x1 FORMAT "%13.11" ECU_ADDRESS 0x700008A2 /end MEASUREMENT
/begin MEASUREMENT EGSDCmn_flgCOEOMRelsParlB1 "customer specific operation mode request is released, bank 1" UBYTE B_TRUE 1 100 0.00 1.00000000000 BIT_MASK 0x1 FORMAT "%13.11" ECU_ADDRESS 0x700008A1 /end MEASUREMENT
/begin MEASUREMENT EGSDCmn_flgDSMClrParlEnaB1 "DSMClear is requested, bank 1" UBYTE B_TRUE 1 100 0.00 1.00000000000 BIT_MASK 0x1 FORMAT "%13.11" ECU_ADDRESS 0x7000089A /end MEASUREMENT
/begin MEASUREMENT EGSDCmn_flgEnaEnvCndParl "The enviroment conditions (air pressure, temperature) for the parallelized diagnoses" UBYTE B_TRUE 1 100 0.00 1.00000000000 BIT_MASK 0x1 FORMAT "%13.11" ECU_ADDRESS 0x700002BC /end MEASUREMENT
/begin MEASUREMENT EGSDCmn_flgEnaFuMixAdpnParl "fuel mixture criteria satisfied" UBYTE B_TRUE 1 100 0.00 1.00000000000 BIT_MASK 0x1 FORMAT "%13.11" ECU_ADDRESS 0x700002BB /end MEASUREMENT
/begin MEASUREMENT EGSDCmn_flgEnaGearShiftParl "gear criteria satisfied" UBYTE B_TRUE 1 100 0.00 1.00000000000 BIT_MASK 0x1 FORMAT "%13.11" ECU_ADDRESS 0x700002BA /end MEASUREMENT
/begin MEASUREMENT EGSDCmn_flgEnaGlbParl "Condition: Global enable conditions for parallielzation fulfilled" UBYTE B_TRUE 1 100 0.00 1.00000000000 BIT_MASK 0x1 FORMAT "%13.11" ECU_ADDRESS 0x700002B9 /end MEASUREMENT
/begin MEASUREMENT EGSDCmn_flgEnaGlbPrtlParl "Project independent general enable conditions for the parallelized diagnoses" UBYTE B_TRUE 1 100 0.00 1.00000000000 BIT_MASK 0x1 FORMAT "%13.11" ECU_ADDRESS 0x700002B8 /end MEASUREMENT
/begin MEASUREMENT EGSDCmn_flgEnaHiRngSeg1B1 "Enabling condition Exhaust gas mass flow and Catalyst temperature in high range" UBYTE B_TRUE 1 100 0.00 1.00000000000 BIT_MASK 0x1 FORMAT "%13.11" ECU_ADDRESS 0x70000899 /end MEASUREMENT
/begin MEASUREMENT EGSDCmn_flgEnaLoRngSeg1B1 "Enabling condition Exhaust gas mass flow and Catalyst temperature in low range" UBYTE B_TRUE 1 100 0.00 1.00000000000 BIT_MASK 0x1 FORMAT "%13.11" ECU_ADDRESS 0x70000898 /end MEASUREMENT
/begin MEASUREMENT EGSDCmn_flgEnaMsTParlB1 "Bank 1 indication flag represents the desired Mass flow and Temperature conditions for Physical release for parallisation." UBYTE B_TRUE 1 100 0.00 1.00000000000 BIT_MASK 0x1 FORMAT "%13.11" ECU_ADDRESS 0x700002B7 /end MEASUREMENT
/begin MEASUREMENT EGSDCmn_flgEnaRelLoadParl "Enable condition of the relative air mass for parallelized diagnoses" UBYTE B_TRUE 1 100 0.00 1.00000000000 BIT_MASK 0x1 FORMAT "%13.11" ECU_ADDRESS 0x70000897 /end MEASUREMENT
/begin MEASUREMENT EGSDCmn_flgEnaVehVParl "Condition: vehicle speed criiterion fulfilled" UBYTE B_TRUE 1 100 0.00 1.00000000000 BIT_MASK 0x1 FORMAT "%13.11" ECU_ADDRESS 0x70000896 /end MEASUREMENT
/begin MEASUREMENT EGSDCmn_flgEnvtlDiPID41Parl "Condition: Parallelization inhibited by environmental conditions. PID41 Disabled" UBYTE B_TRUE 1 100 0.00 1.00000000000 BIT_MASK 0x1 FORMAT "%13.11" ECU_ADDRESS 0x70000895 /end MEASUREMENT
/begin MEASUREMENT EGSDCmn_flgFpcAdpdParl "Fuel purge adaption is sufficient for parallelization" UBYTE B_TRUE 1 100 0.00 1.00000000000 BIT_MASK 0x1 FORMAT "%13.11" ECU_ADDRESS 0x700002B6 /end MEASUREMENT
/begin MEASUREMENT EGSDCmn_flgFpcDynDebParl "The activation or deactivation of the fuel purge control is debounced for the release of the parallelization" UBYTE B_TRUE 1 100 0.00 1.00000000000 BIT_MASK 0x1 FORMAT "%13.11" ECU_ADDRESS 0x700002B5 /end MEASUREMENT
/begin MEASUREMENT EGSDCmn_flgFpcOKParl "relative fuel portion from canister purge for parallelization is within the high range of release zone" UBYTE B_TRUE 1 100 0.00 1.00000000000 BIT_MASK 0x1 FORMAT "%13.11" ECU_ADDRESS 0x700002B4 /end MEASUREMENT
/begin MEASUREMENT EGSDCmn_flgGearShiftParlTONV_I.outbit "TurnOnDelay: Activation inhibiting parallelization by gear-shift / return value" UBYTE B_TRUE 1 100 0.00 1.00000000000 BIT_MASK 0x1 FORMAT "%13.11" ECU_ADDRESS 0x60003B8A /end MEASUREMENT
/begin MEASUREMENT EGSDCmn_flgGearShiftParlTONV_I.time "TurnOnDelay: Activation inhibiting parallelization by gear-shift / expired delay time" UBYTE t_q0p1 1 100 0.00 25.50 FORMAT "%5.2" ECU_ADDRESS 0x60003B8B /end MEASUREMENT
/begin MEASUREMENT EGSDCmn_flgInhbProdModParl "Flag to inhibit Parallelization when the vehicle is in Production mode." UBYTE B_TRUE 1 100 0.00 1.00000000000 BIT_MASK 0x1 FORMAT "%13.11" ECU_ADDRESS 0x70000892 /end MEASUREMENT
/begin MEASUREMENT EGSDCmn_flgInhbRdyParlB1 "Inhibition of the parallelized diagnoses" UBYTE B_TRUE 1 100 0.00 1.00000000000 BIT_MASK 0x1 FORMAT "%13.11" ECU_ADDRESS 0x700002B3 /end MEASUREMENT
/begin MEASUREMENT EGSDCmn_flgInjVlvEnaParlB1 "Release condition for the parallelization with injection valve deactivation" UBYTE B_TRUE 1 100 0.00 1.00000000000 BIT_MASK 0x1 FORMAT "%13.11" ECU_ADDRESS 0x700002B2 /end MEASUREMENT
/begin MEASUREMENT EGSDCmn_flgLamActvParlB1ER_I.buffer "Lambda request is active / rising edge detected" UBYTE B_TRUE 1 100 0.00 1.00000000000 BIT_MASK 0x1 FORMAT "%13.11" ECU_ADDRESS 0x60003B88 /end MEASUREMENT
/begin MEASUREMENT EGSDCmn_flgLamActvParlB1ER_I.oldSignal "Lambda request is active / flag rising edge" UBYTE B_TRUE 1 100 0.00 1.00000000000 BIT_MASK 0x1 FORMAT "%13.11" ECU_ADDRESS 0x60003B89 /end MEASUREMENT
/begin MEASUREMENT EGSDCmn_flgLamMonOkParlB1 "lambda monitoring criterion, if lamba actual value follows the lambda set value, is fulfilled, bank 1" UBYTE B_TRUE 1 100 0.00 1.00000000000 BIT_MASK 0x1 FORMAT "%13.11" ECU_ADDRESS 0x70000891 /end MEASUREMENT
/begin MEASUREMENT EGSDCmn_flgLamMonSuppParlB1 "Condition: Suppress abortions by Lambda-Monitoring bank 1" UBYTE B_TRUE 1 100 0.00 1.00000000000 BIT_MASK 0x1 FORMAT "%13.11" ECU_ADDRESS 0x70000890 /end MEASUREMENT
/begin MEASUREMENT EGSDCmn_flgLamPriEnaParlB1 "Lambda set point before starting the parallelization stable for enough time" UBYTE B_TRUE 1 100 0.00 1.00000000000 BIT_MASK 0x1 FORMAT "%13.11" ECU_ADDRESS 0x700002B1 /end MEASUREMENT
/begin MEASUREMENT EGSDCmn_flgLamReldParlB1 "Lambda condition released" UBYTE B_TRUE 1 100 0.00 1.00000000000 BIT_MASK 0x1 FORMAT "%13.11" ECU_ADDRESS 0x7000088F /end MEASUREMENT
/begin MEASUREMENT EGSDCmn_flgMfEgEnaRampParl "Release mass flow criterion for lambda ramp" UBYTE B_TRUE 1 100 0.00 1.00000000000 BIT_MASK 0x1 FORMAT "%13.11" ECU_ADDRESS 0x700002B0 /end MEASUREMENT
/begin MEASUREMENT EGSDCmn_flgmPurgCtrlOkParl "Mass of purge control fuel portion is below threshold" UBYTE B_TRUE 1 100 0.00 1.00000000000 BIT_MASK 0x1 FORMAT "%13.11" ECU_ADDRESS 0x700002AF /end MEASUREMENT
/begin MEASUREMENT EGSDCmn_flgNarrowRngSeg1B1 "Apply narrowed release range (e.g. for engine speed, exhaust gas mass flow,...)" UBYTE B_TRUE 1 100 0.00 1.00000000000 BIT_MASK 0x1 FORMAT "%13.11" ECU_ADDRESS 0x700002AE /end MEASUREMENT
/begin MEASUREMENT EGSDCmn_flgNEngInRngParl "Engine speed is in allowed range for parallelization" UBYTE B_TRUE 1 100 0.00 1.00000000000 BIT_MASK 0x1 FORMAT "%13.11" ECU_ADDRESS 0x7000088D /end MEASUREMENT
/begin MEASUREMENT EGSDCmn_flgOperModDmdActv "Requested operation mode active" UBYTE B_TRUE 1 100 0.00 1.00000000000 BIT_MASK 0x1 FORMAT "%13.11" ECU_ADDRESS 0x700002C0 /end MEASUREMENT
/begin MEASUREMENT EGSDCmn_flgOperPntActvParl "parallelization is by current operation point active" UBYTE B_TRUE 1 100 0.00 1.00000000000 BIT_MASK 0x1 FORMAT "%13.11" ECU_ADDRESS 0x7000088C /end MEASUREMENT
/begin MEASUREMENT EGSDCmn_flgProdModParl "Flag: Production Mode to be considered for Exhaust gas sensor diagnosis" UBYTE B_TRUE 1 100 0.00 1.00000000000 BIT_MASK 0x1 FORMAT "%13.11" ECU_ADDRESS 0x7000088B /end MEASUREMENT
/begin MEASUREMENT EGSDCmn_flgRdyB1Parl "parallelization is ready to run, request for permissions from Diagnostic System Manager (DSM)" UBYTE B_TRUE 1 100 0.00 1.00000000000 BIT_MASK 0x1 FORMAT "%13.11" ECU_ADDRESS 0x7000088A /end MEASUREMENT
/begin MEASUREMENT EGSDCmn_flgReqEomParl "engine operation mode request active" UBYTE B_TRUE 1 100 0.00 1.00000000000 BIT_MASK 0x1 FORMAT "%13.11" ECU_ADDRESS 0x70000889 /end MEASUREMENT
/begin MEASUREMENT EGSDCmn_flgRmnProdModParl "flag which indicates the production residue presence for exhaust system diagnoses" UBYTE B_TRUE 1 100 0.00 1.00000000000 BIT_MASK 0x1 FORMAT "%13.11" ECU_ADDRESS 0x70000888 /end MEASUREMENT
/begin MEASUREMENT EGSDCmn_flgS1B1OffsDneParl "Offset checked for Parallelization release" UBYTE B_TRUE 1 100 0.00 1.00000000000 BIT_MASK 0x1 FORMAT "%13.11" ECU_ADDRESS 0x700002AD /end MEASUREMENT
/begin MEASUREMENT EGSDCmn_flgS1B1VldParl "Sensor on position 1 is valid" UBYTE B_TRUE 1 100 0.00 1.00000000000 BIT_MASK 0x1 FORMAT "%13.11" ECU_ADDRESS 0x70000886 /end MEASUREMENT
/begin MEASUREMENT EGSDCmn_flgS2B1VldParl "sensor 2 is ready for operation, bank 1" UBYTE B_TRUE 1 100 0.00 1.00000000000 BIT_MASK 0x1 FORMAT "%13.11" ECU_ADDRESS 0x7000087B /end MEASUREMENT
/begin MEASUREMENT EGSDCmn_flgSeg1B1ActvRqrdParl "Status, if measurements for parallelized exhaust gas components diagnosis are required" UBYTE B_TRUE 1 100 0.00 1.00000000000 BIT_MASK 0x1 FORMAT "%13.11" ECU_ADDRESS 0x7000087A /end MEASUREMENT
/begin MEASUREMENT EGSDCmn_flgSeg1B1EnaEgParl "the integrated exhaust gas mass flow or heating quantity since engine start is over a threshold" UBYTE B_TRUE 1 100 0.00 1.00000000000 BIT_MASK 0x1 FORMAT "%13.11" ECU_ADDRESS 0x70000879 /end MEASUREMENT
/begin MEASUREMENT EGSDCmn_flgSeg1B1EnaHeatUp "Lambda sensors for parallization are heated up" UBYTE B_TRUE 1 100 0.00 1.00000000000 BIT_MASK 0x1 FORMAT "%13.11" ECU_ADDRESS 0x700002AC /end MEASUREMENT
/begin MEASUREMENT EGSDCmn_flgSeg1B1EnaMfGrdtTONV_I.outbit "Enable condition of parallelized diagnosises: exhaust gas mass flow gradient / return value" UBYTE B_TRUE 1 100 0.00 1.00000000000 BIT_MASK 0x1 FORMAT "%13.11" ECU_ADDRESS 0x60003B86 /end MEASUREMENT
/begin MEASUREMENT EGSDCmn_flgSeg1B1EnaMfGrdtTONV_I.time "Enable condition of parallelized diagnosises: exhaust gas mass flow gradient / expired delay time" UBYTE t_q0p1 1 100 0.00 25.50 FORMAT "%5.2" ECU_ADDRESS 0x60003B87 /end MEASUREMENT
/begin MEASUREMENT EGSDCmn_flgSeg1B1EnaMfRngHiParl "Exhaust gas mass flow is within the high range release zone, catalyst 1, bank 1" UBYTE B_TRUE 1 100 0.00 1.00000000000 BIT_MASK 0x1 FORMAT "%13.11" ECU_ADDRESS 0x700002AB /end MEASUREMENT
/begin MEASUREMENT EGSDCmn_flgSeg1B1EnaMfRngLoParl "Exhaust gas mass flow is within the low range zone, catalyst 1, bank 1" UBYTE B_TRUE 1 100 0.00 1.00000000000 BIT_MASK 0x1 FORMAT "%13.11" ECU_ADDRESS 0x700002AA /end MEASUREMENT
/begin MEASUREMENT EGSDCmn_flgSeg1B1EnaParl "Enabling conditions for parallelization are fulfilled" UBYTE B_TRUE 1 100 0.00 1.00000000000 BIT_MASK 0x1 FORMAT "%13.11" ECU_ADDRESS 0x70000878 /end MEASUREMENT
/begin MEASUREMENT EGSDCmn_flgSeg1B1EnaVldParl "Sensor is ready to operate, mass flow debounced, segment 1, bank 1" UBYTE B_TRUE 1 100 0.00 1.00000000000 BIT_MASK 0x1 FORMAT "%13.11" ECU_ADDRESS 0x700002A9 /end MEASUREMENT
/begin MEASUREMENT EGSDCmn_flgSeg1B1MeasRqrdParl "Status of required measurements for parallelization, segment 1, bank 1" UBYTE B_TRUE 1 100 0.00 1.00000000000 BIT_MASK 0x1 FORMAT "%13.11" ECU_ADDRESS 0x70000877 /end MEASUREMENT
/begin MEASUREMENT EGSDCmn_flgSeg1B1PhyEnaParl "physical release condition for parallelization are fulfilled" UBYTE B_TRUE 1 100 0.00 1.00000000000 BIT_MASK 0x1 FORMAT "%13.11" ECU_ADDRESS 0x70000876 /end MEASUREMENT
/begin MEASUREMENT EGSDCmn_flgSeg1B1QPFaildParl "Quickpass is failed based on current measurements in parallelization, segment 1, bank 1" UBYTE B_TRUE 1 100 0.00 1.00000000000 BIT_MASK 0x1 FORMAT "%13.11" ECU_ADDRESS 0x70000875 /end MEASUREMENT
/begin MEASUREMENT EGSDCmn_flgSeg1B1RampEnaParl "physical release condition for lambda ramp are fulfilled" UBYTE B_TRUE 1 100 0.00 1.00000000000 BIT_MASK 0x1 FORMAT "%13.11" ECU_ADDRESS 0x70000874 /end MEASUREMENT
/begin MEASUREMENT EGSDCmn_flgSeg1B1RdyParl "parallelization is ready to run, request for permissions from Diagnostic System Manager (DSM), segment 1, bank 1" UBYTE B_TRUE 1 100 0.00 1.00000000000 BIT_MASK 0x1 FORMAT "%13.11" ECU_ADDRESS 0x70000873 /end MEASUREMENT
/begin MEASUREMENT EGSDCmn_flgSeg1B1ReldFinalParl "flag indicating the diagnosis activeness, sensor 1, bank1." UBYTE B_TRUE 1 100 0.00 1.00000000000 BIT_MASK 0x1 FORMAT "%13.11" ECU_ADDRESS 0x70000872 /end MEASUREMENT
/begin MEASUREMENT EGSDCmn_flgSeg1B1ReldParl "parallelization is released by Diagnostic System Manager (DSM), segment 1, bank 1" UBYTE B_TRUE 1 100 0.00 1.00000000000 BIT_MASK 0x1 FORMAT "%13.11" ECU_ADDRESS 0x70000871 /end MEASUREMENT
/begin MEASUREMENT EGSDCmn_flgSeg1B1VirtActvRqrdParl "Status, if measurements for virtual parallelized exhaust gas components diagnosis are required" UBYTE B_TRUE 1 100 0.00 1.00000000000 BIT_MASK 0x1 FORMAT "%13.11" ECU_ADDRESS 0x700002A8 /end MEASUREMENT
/begin MEASUREMENT EGSDCmn_flgSeg1B1VirtEnaParl "Enabling conditions for virtual diagnosis" UBYTE B_TRUE 1 100 0.00 1.00000000000 BIT_MASK 0x1 FORMAT "%13.11" ECU_ADDRESS 0x700002A7 /end MEASUREMENT
/begin MEASUREMENT EGSDCmn_flgSeg1B1VirtMeasRqrdParl "Status of required virtual measurements for parallelization, segment 1, bank 1" UBYTE B_TRUE 1 100 0.00 1.00000000000 BIT_MASK 0x1 FORMAT "%13.11" ECU_ADDRESS 0x70000870 /end MEASUREMENT
/begin MEASUREMENT EGSDCmn_flgSeg1B1VirtReldFinalParl "parallelization is released for virtual simulation including release from Diagnostic System Manager (DSM), segment 1, bank 1" UBYTE B_TRUE 1 100 0.00 1.00000000000 BIT_MASK 0x1 FORMAT "%13.11" ECU_ADDRESS 0x7000086F /end MEASUREMENT
/begin MEASUREMENT EGSDCmn_flgSeg1B1VirtReldParl "parallelization is released for IUMPR simulation, segment 1, bank 1" UBYTE B_TRUE 1 100 0.00 1.00000000000 BIT_MASK 0x1 FORMAT "%13.11" ECU_ADDRESS 0x7000086E /end MEASUREMENT
/begin MEASUREMENT EGSDCmn_flgShtrpParl "short trip request for parallelization" UBYTE B_TRUE 1 100 0.00 1.00000000000 BIT_MASK 0x1 FORMAT "%13.11" ECU_ADDRESS 0x7000086D /end MEASUREMENT
/begin MEASUREMENT EGSDCmn_flgStrtEndParlB1 "engine start is ended for catalyst cooling down detection" UBYTE B_TRUE 1 100 0.00 1.00000000000 BIT_MASK 0x1 FORMAT "%13.11" ECU_ADDRESS 0x700002A6 /end MEASUREMENT
/begin MEASUREMENT EGSDCmn_flgTarLeanSuspcParlB1 "Target Lean error suspicion, request lean ramp, bank 1" UBYTE B_TRUE 1 100 0.00 1.00000000000 BIT_MASK 0x1 FORMAT "%13.11" ECU_ADDRESS 0x7000086C /end MEASUREMENT
/begin MEASUREMENT EGSDCmn_flgTarRichSuspcParlB1 "Target Rich error suspicion, request rich ramp, bank 1" UBYTE B_TRUE 1 100 0.00 1.00000000000 BIT_MASK 0x1 FORMAT "%13.11" ECU_ADDRESS 0x7000086B /end MEASUREMENT
/begin MEASUREMENT EGSDCmn_flgTarSuspcB1 "Target error suspicion" UBYTE B_TRUE 1 100 0.00 1.00000000000 BIT_MASK 0x1 FORMAT "%13.11" ECU_ADDRESS 0x7000086A /end MEASUREMENT
/begin MEASUREMENT EGSDCmn_flgTarSuspcVirtParlB1 "Virtual Target error suspicion" UBYTE B_TRUE 1 100 0.00 1.00000000000 BIT_MASK 0x1 FORMAT "%13.11" ECU_ADDRESS 0x70000869 /end MEASUREMENT
/begin MEASUREMENT EGSDCmn_flgTiIdleExcdd "Allowed time of engine in idle or fuel cut off reached" UBYTE B_TRUE 1 100 0.00 1.00000000000 BIT_MASK 0x1 FORMAT "%13.11" ECU_ADDRESS 0x700002A5 /end MEASUREMENT
/begin MEASUREMENT EGSDCmn_flgVirtCOEOMRelsParlB1 "Virtual customer specific operation mode request is released, bank 1" UBYTE B_TRUE 1 100 0.00 1.00000000000 BIT_MASK 0x1 FORMAT "%13.11" ECU_ADDRESS 0x70000868 /end MEASUREMENT
/begin MEASUREMENT EGSDCmn_flgVirtRdyB1Parl "Virtual enable conditions ready" UBYTE B_TRUE 1 100 0.00 1.00000000000 BIT_MASK 0x1 FORMAT "%13.11" ECU_ADDRESS 0x700002A4 /end MEASUREMENT
/begin MEASUREMENT EGSDCmn_flgVirtReqEomParl "Request of the virtual engine operation mode" UBYTE B_TRUE 1 100 0.00 1.00000000000 BIT_MASK 0x1 FORMAT "%13.11" ECU_ADDRESS 0x70000867 /end MEASUREMENT
/begin MEASUREMENT EGSDCmn_flgVlvLftActvParlB1 "Flag which indicates the actual and requested valve lift status are same for Bank 1." UBYTE B_TRUE 1 100 0.00 1.00000000000 BIT_MASK 0x1 FORMAT "%13.11" ECU_ADDRESS 0x70000866 /end MEASUREMENT
/begin MEASUREMENT EGSDCmn_idxGrdtAryInp "input index of array for gradient creation" UBYTE OneToOne 1 100 0.00 10.00 FORMAT "%5.2" ECU_ADDRESS 0x60006580 /end MEASUREMENT
/begin MEASUREMENT EGSDCmn_idxGrdtAryOutp "output index of array for gradient creation" UBYTE OneToOne 1 100 0.00 255.0 FORMAT "%5.1" ECU_ADDRESS 0x6000657F /end MEASUREMENT
/begin MEASUREMENT EGSDCmn_InjVlvDisblParlB1TONV_I.outbit "Injection valve deactivation condition active / return value" UBYTE B_TRUE 1 100 0.00 1.00000000000 BIT_MASK 0x1 FORMAT "%13.11" ECU_ADDRESS 0x60003B9A /end MEASUREMENT
/begin MEASUREMENT EGSDCmn_InjVlvDisblParlB1TONV_I.time "Injection valve deactivation condition active / expired delay time" UBYTE t_q0p1 1 100 0.00 25.50 FORMAT "%5.2" ECU_ADDRESS 0x60003B9B /end MEASUREMENT
/begin MEASUREMENT EGSDCmn_InjVlvEnaParlB1TOFFV_I.outbit "Injection valve deactivation condition inactive / Output Bit" UBYTE B_TRUE 1 100 0.00 1.00000000000 BIT_MASK 0x1 FORMAT "%13.11" ECU_ADDRESS 0x60003B96 /end MEASUREMENT
/begin MEASUREMENT EGSDCmn_InjVlvEnaParlB1TOFFV_I.time "Injection valve deactivation condition inactive / Occured Time" UWORD t_q0p1 1 100 0.00 6553.500 FORMAT "%8.3" ECU_ADDRESS 0x60003B98 /end MEASUREMENT
/begin MEASUREMENT EGSDCmn_InjVlvParlB1FF_I.status "Injection valve deactivation condition released / current value of RS-FF" UBYTE B_TRUE 1 100 0.00 1.00000000000 BIT_MASK 0x1 FORMAT "%13.11" ECU_ADDRESS 0x6000E397 /end MEASUREMENT
/begin MEASUREMENT EGSDCmn_LamDynActvParlB1ER_I.buffer "Dynamic diagnoses active / rising edge detected" UBYTE B_TRUE 1 100 0.00 1.00000000000 BIT_MASK 0x1 FORMAT "%13.11" ECU_ADDRESS 0x60003BAA /end MEASUREMENT
/begin MEASUREMENT EGSDCmn_LamDynActvParlB1ER_I.oldSignal "Dynamic diagnoses active / flag rising edge" UBYTE B_TRUE 1 100 0.00 1.00000000000 BIT_MASK 0x1 FORMAT "%13.11" ECU_ADDRESS 0x60003BAB /end MEASUREMENT
/begin MEASUREMENT EGSDCmn_LamDynActvParlB1FF_I.status "Dynamic diagnoses active / current value of RS-FF" UBYTE B_TRUE 1 100 0.00 1.00000000000 BIT_MASK 0x1 FORMAT "%13.11" ECU_ADDRESS 0x6000658D /end MEASUREMENT
/begin MEASUREMENT EGSDCmn_LamMonOKB1EF_I.buffer "Edge Falling: Lambda monitoring fulfilled bank 1 / memory to detect falling edge" UBYTE B_TRUE 1 100 0.00 1.00000000000 BIT_MASK 0x1 FORMAT "%13.11" ECU_ADDRESS 0x60003B94 /end MEASUREMENT
/begin MEASUREMENT EGSDCmn_LamMonOKB1EF_I.oldSignal "Edge Falling: Lambda monitoring fulfilled bank 1 / memory to detect falling edge" UBYTE B_TRUE 1 100 0.00 1.00000000000 BIT_MASK 0x1 FORMAT "%13.11" ECU_ADDRESS 0x60003B95 /end MEASUREMENT
/begin MEASUREMENT EGSDCmn_LamMonOKEFParlB1CTR_I.counter "Counter abortions by Lambda-Monitoring bank 1 / current counter value" UBYTE dez 1 100 0.00 255.0 FORMAT "%5.1" ECU_ADDRESS 0x60006589 /end MEASUREMENT
/begin MEASUREMENT EGSDCmn_LamReqOKB1TONV_I.outbit "Turn on Delay, lambda request is in lambda released, bank 1 / return value" UBYTE B_TRUE 1 100 0.00 1.00000000000 BIT_MASK 0x1 FORMAT "%13.11" ECU_ADDRESS 0x60003B92 /end MEASUREMENT
/begin MEASUREMENT EGSDCmn_LamReqOKB1TONV_I.time "Turn on Delay, lambda request is in lambda released, bank 1 / expired delay time" UBYTE t_q0p01 1 100 0.00 2.550 FORMAT "%5.3" ECU_ADDRESS 0x60003B93 /end MEASUREMENT
/begin MEASUREMENT EGSDCmn_mEgCatWarmAftIdleFcoIK_I.memory "Mass Flow Integrator Instance indicating the Debouncing time for Warm Catalyst ( after fuel cut off and idling Condition) based on Vehicle Speed Environment Temperature / current integrator value" ULONG m_q1p5259Em8_kg 1 100 0.00 65.5359999847 FORMAT "%13.10" ECU_ADDRESS 0x600015D4 /end MEASUREMENT
/begin MEASUREMENT EGSDCmn_mEgEnaFpcParlIK_I.memory "Exhaust gas mass to debounce after opening or closing canister purge valve / current integrator value" ULONG m_q1p5259Em8_kg 1 100 0.00 65.5359999847 FORMAT "%13.10" ECU_ADDRESS 0x600015D0 /end MEASUREMENT
/begin MEASUREMENT EGSDCmn_mEgEnaOpDecelParlB1IK_I.memory "amount of exhaust gas mass flow since the operation point and catalyst temperature are in the release window, bank 1 / current integrator value" ULONG m_q1p5259Em8_kg 1 100 0.00 65.5359999847 FORMAT "%13.10" ECU_ADDRESS 0x600015CC /end MEASUREMENT
/begin MEASUREMENT EGSDCmn_mEgSeg1EnaParlB1IK_I.memory "integrated exhaust gas mass flow to release of parallelization of segment 1, bank 1 / current integrator value" ULONG m_q1p5259Em8_kg 1 100 0.00 65.5359999847 FORMAT "%13.10" ECU_ADDRESS 0x600015C8 /end MEASUREMENT
/begin MEASUREMENT EGSDCmn_mfEgCat1B1Parl "Exhaust gas mass flow into catalyst 1, bank 1" UWORD m_q0p1 1 100 0.00 6553.500 FORMAT "%8.3" ECU_ADDRESS 0x60004D08 /end MEASUREMENT
/begin MEASUREMENT EGSDCmn_mfEgCat1B1WoFu "Mass flow exhaust gas minus fuel part upstream of catalyst 1" UWORD m_q0p1 1 100 0.00 6553.500 FORMAT "%8.3" ECU_ADDRESS 0x6000E1AC /end MEASUREMENT
/begin MEASUREMENT EGSDCmn_mfEgCat1B1WoFuParl "Exhaust gas mass flow minus fuel part into catalyst 1, bank 1" UWORD m_q0p1 1 100 0.00 6553.500 FORMAT "%8.3" ECU_ADDRESS 0x6000D86A /end MEASUREMENT
/begin MEASUREMENT EGSDCmn_mfEgFilCat1ParlB1LT_I.memory "Low Pass filter for exhaust gas mass flow, used for gradient calculation / current lowpass value" ULONG m_q1p526Em6_g 1 100 0.00 6553.59999847 FORMAT "%13.8" ECU_ADDRESS 0x500013BC /end MEASUREMENT
/begin MEASUREMENT EGSDCmn_mfO2Cat1B1Parl "Oxygen mass flow, input of catalyst 1, bank 1" FLOAT32_IEEE mgrad_q1_mgdivs 1 100 -50000.0000 50000.0000 FORMAT "%10.4" ECU_ADDRESS 0x6000D708 /end MEASUREMENT
/begin MEASUREMENT EGSDCmn_mfSeg1B1O2Parl "Oxygen mass flow in catalyst 1 (considers maximum possible mixture deviation in a fault free system)" FLOAT32_IEEE mgrad_q1_mgdivs 1 100 0.00 50000.0000 FORMAT "%10.4" ECU_ADDRESS 0x60001DA8 /end MEASUREMENT
/begin MEASUREMENT EGSDCmn_mfSeg1B1RichParl "Rich gas mass flow in catalyst 1 (considers maximum possible mixture deviation in a fault free system)" FLOAT32_IEEE mgrad_q1_mgdivs 1 100 0.00 50000.0000 FORMAT "%10.4" ECU_ADDRESS 0x60001DA4 /end MEASUREMENT
/begin MEASUREMENT EGSDCmn_mfSeg1B1VirtO2Parl "Virtual Oxygen mass flow in catalyst 1 (considers maximum possible mixture deviation in a fault free system)" FLOAT32_IEEE mgrad_q1_mgdivs 1 100 0.00 50000.0000 FORMAT "%10.4" ECU_ADDRESS 0x60001C48 /end MEASUREMENT
/begin MEASUREMENT EGSDCmn_mfSeg1B1VirtRichParl "Virtual Rich gas mass flow in catalyst 1 (considers maximum possible mixture deviation in a fault free system)" FLOAT32_IEEE mgrad_q1_mgdivs 1 100 0.00 50000.0000 FORMAT "%10.4" ECU_ADDRESS 0x50004C3C /end MEASUREMENT
/begin MEASUREMENT EGSDCmn_mfUnderRngLoMinParlDetB1SW_I.timeCounter "Time for EGSDCmn_dmfRngLoUnderMinParl_C consideration, bank 1 / expired time since start" UBYTE t_q0p1 1 100 0.00 25.50 FORMAT "%5.2" ECU_ADDRESS 0x60006582 /end MEASUREMENT
/begin MEASUREMENT EGSDCmn_mLamEnaParlB1IK_I.memory "Exhaust gasm ass integrator to ensure Lambda set point before starting the parallelization stable for enough time / current integrator value" ULONG m_q1p5259Em8_kg 1 100 0.00 65.5359999847 FORMAT "%13.10" ECU_ADDRESS 0x500013B8 /end MEASUREMENT
/begin MEASUREMENT EGSDCmn_mSeg1B1SensVldParlIK_I.memory "mass flow debouncing since sensors are ready to operate / current integrator value" ULONG m_q1p5259Em8_kg 1 100 0.00 65.5359999847 FORMAT "%13.10" ECU_ADDRESS 0x600015C4 /end MEASUREMENT
/begin MEASUREMENT EGSDCmn_nEngOvrIdleTOFFV_I.outbit "Debouncing of the engine speed condition for reset of the stop watch / Output Bit" UBYTE B_TRUE 1 100 0.00 1.00000000000 BIT_MASK 0x1 FORMAT "%13.11" ECU_ADDRESS 0x500052CA /end MEASUREMENT
/begin MEASUREMENT EGSDCmn_nEngOvrIdleTOFFV_I.time "Debouncing of the engine speed condition for reset of the stop watch / Occured Time" UWORD t_q0p1 1 100 0.00 6553.500 FORMAT "%8.3" ECU_ADDRESS 0x500052CC /end MEASUREMENT
/begin MEASUREMENT EGSDCmn_ratLamActS1B1 "Lambda actual value for parallelization, bank 1" UWORD fak_uw_b16 1 100 0.00 15.99976 FORMAT "%8.5" ECU_ADDRESS 0x60004D06 /end MEASUREMENT
/begin MEASUREMENT EGSDCmn_rLamDeltaMonParlB1 "Lambda deviation vs. setpoint bank 1" SWORD fak_q0p000244 1 100 -8.000000 7.999756 FORMAT "%8.6" ECU_ADDRESS 0x6000D86C /end MEASUREMENT
/begin MEASUREMENT EGSDCmn_S2B1UInpParlLT_I.memory "Low pass filter of binary sensor voltage for parallelization, sensor 2, bank 1 / current lowpass value" ULONG spg_q1p8626Em8_V 1 100 0.00 4.99999998137 FORMAT "%13.11" ECU_ADDRESS 0x600015C0 /end MEASUREMENT
/begin MEASUREMENT EGSDCmn_S2B1UInpTWCDLT_I.memory "Filter Class Instance for HEGOS2B1 Signal for TWC Operations / current lowpass value" ULONG spg_q1p8626Em8_V 1 100 0.00 4.99999998137 FORMAT "%13.11" ECU_ADDRESS 0x600015BC /end MEASUREMENT
/begin MEASUREMENT EGSDCmn_Seg1B1EnaLamCdnFF_I.status "Flipflop: lambda is in range in advance of parallelization, segment 1, bank 1 / current value of RS-FF" UBYTE B_TRUE 1 100 0.00 1.00000000000 BIT_MASK 0x1 FORMAT "%13.11" ECU_ADDRESS 0x60006588 /end MEASUREMENT
/begin MEASUREMENT EGSDCmn_Seg1B1EnaRngMfHiParl_I.flgEnaRng "Massflow range check / Range check successfull" UBYTE B_TRUE 1 100 0.00 1.00000000000 BIT_MASK 0x1 FORMAT "%13.11" ECU_ADDRESS 0x60006587 /end MEASUREMENT
/begin MEASUREMENT EGSDCmn_Seg1B1EnaRngMfLoParl_I.flgEnaRng "Massflow range check / Range check successfull" UBYTE B_TRUE 1 100 0.00 1.00000000000 BIT_MASK 0x1 FORMAT "%13.11" ECU_ADDRESS 0x60006586 /end MEASUREMENT
/begin MEASUREMENT EGSDCmn_Seg1B1EnaRngTHiParl_I.flgEnaRng "Temperature range check / Range check successfull" UBYTE B_TRUE 1 100 0.00 1.00000000000 BIT_MASK 0x1 FORMAT "%13.11" ECU_ADDRESS 0x60006585 /end MEASUREMENT
/begin MEASUREMENT EGSDCmn_Seg1B1EnaRngTLoParl_I.flgEnaRng "Temperature range check / Range check successfull" UBYTE B_TRUE 1 100 0.00 1.00000000000 BIT_MASK 0x1 FORMAT "%13.11" ECU_ADDRESS 0x60006584 /end MEASUREMENT
/begin MEASUREMENT EGSDCmn_Seg1B1mfParl_I.mfO2 "caculation of oxygen mass flow, corrected by maximum possible mixture deviation in a fault free system / oxygen mass flow" UWORD m_q0p1_mgs 1 100 0.00 6553.500 FORMAT "%8.3" ECU_ADDRESS 0x6000D866 /end MEASUREMENT
/begin MEASUREMENT EGSDCmn_Seg1B1mfParl_I.mfRich "caculation of oxygen mass flow, corrected by maximum possible mixture deviation in a fault free system / rich gas mass flow" UWORD m_q0p1_mgs 1 100 0.00 6553.500 FORMAT "%8.3" ECU_ADDRESS 0x6000D868 /end MEASUREMENT
/begin MEASUREMENT EGSDCmn_Seg1B1mfVirtParl_I.mfO2 "caculation of virtual oxygen mass flow, corrected by maximum possible mixture deviation in a fault free system / oxygen mass flow" UWORD m_q0p1_mgs 1 100 0.00 6553.500 FORMAT "%8.3" ECU_ADDRESS 0x60003B7C /end MEASUREMENT
/begin MEASUREMENT EGSDCmn_Seg1B1mfVirtParl_I.mfRich "caculation of virtual oxygen mass flow, corrected by maximum possible mixture deviation in a fault free system / rich gas mass flow" UWORD m_q0p1_mgs 1 100 0.00 6553.500 FORMAT "%8.3" ECU_ADDRESS 0x60003B7E /end MEASUREMENT
/begin MEASUREMENT EGSDCmn_stEnaGlbPrtlParl "Statusbitword of all project unspecific enable conditions" UWORD OneToOne 1 100 0.00 65535.00 FORMAT "%8.2" ECU_ADDRESS 0x60003BA6 /end MEASUREMENT
/begin MEASUREMENT EGSDCmn_tCat1B1MaxParl "maximum temperature catalyst 1" SWORD Temp_Cels 1 100 -3549.940 3003.560 FORMAT "%8.3" ECU_ADDRESS 0x60004B16 /end MEASUREMENT
/begin MEASUREMENT EGSDCmn_tCat1B1MinParl "minimum temperature catalyst 1" SWORD Temp_Cels 1 100 -3549.940 3003.560 FORMAT "%8.3" ECU_ADDRESS 0x60004B14 /end MEASUREMENT
/begin MEASUREMENT EGSDCmn_tCat1B1Parl "Bed temperature of main catalyst 1, modelled, bank 1" UWORD temp_q0p0234_o273 1 100 -273.150 1262.827 FORMAT "%8.3" ECU_ADDRESS 0x60004916 /end MEASUREMENT
/begin MEASUREMENT EGSDCmn_tCat1B1VirtParl "Virtual modelled catalyst temperature (only for EGSDia)" UWORD temp_q0p0234_o273 1 100 -273.150 1262.827 FORMAT "%8.3" ECU_ADDRESS 0x60004914 /end MEASUREMENT
/begin MEASUREMENT EGSDCmn_tGrdtParlB1 "Temperature gradient of catalyst 1, bank 1" SWORD temp_q0p0234 1 100 -768.0000 767.9766 FORMAT "%8.4" ECU_ADDRESS 0x6000D86E /end MEASUREMENT
/begin MEASUREMENT EGSDCmn_tiEngIdleSW_I.timeCounter "Stop watch to detect time of engine in idle or fuel cut off / expired time since start" UWORD t_q0p1 1 100 0.00 6553.500 FORMAT "%8.3" ECU_ADDRESS 0x60003B84 /end MEASUREMENT
/begin MEASUREMENT EGSDCmn_tiSeg1EnaTripParlTONV_I.outbit "TurnOnDelay: wait time for release condition of diagnosis since engine start / return value" UBYTE B_TRUE 1 100 0.00 1.00000000000 BIT_MASK 0x1 FORMAT "%13.11" ECU_ADDRESS 0x60003B80 /end MEASUREMENT
/begin MEASUREMENT EGSDCmn_tiSeg1EnaTripParlTONV_I.time "TurnOnDelay: wait time for release condition of diagnosis since engine start / expired delay time" UWORD t_q0p1 1 100 0.00 6553.500 FORMAT "%8.3" ECU_ADDRESS 0x60003B82 /end MEASUREMENT
/begin MEASUREMENT EGSDCmn_tiUInpFltParl "Low pass filter time for downstream sensor voltage for parallelization" UWORD zk10msxs_uw_b655 1 100 0.01000015 655.36000000 FORMAT "%12.8" ECU_ADDRESS 0x6000D870 /end MEASUREMENT
/begin MEASUREMENT EGSDCmn_tMinCatRelsParlB1FF_I.status "Part of heat up condition: temperature of catalyst has reached min threashold. / current value of RS-FF" UBYTE B_TRUE 1 100 0.00 1.00000000000 BIT_MASK 0x1 FORMAT "%13.11" ECU_ADDRESS 0x60006581 /end MEASUREMENT
/begin MEASUREMENT EGSDCmn_tqResvParl "torque reserve during parallelization" SWORD trq_q0p1 1 100 -3276.800 3276.700 FORMAT "%8.3" ECU_ADDRESS 0x6000E1B2 /end MEASUREMENT
/begin MEASUREMENT EGSDCmn_TqResvParlITL_I.memory "Integrator of torque reserve during parallelization / current integrator value" SLONG md_q1p526Em6 1 100 -3276.80000000 3276.79999847 FORMAT "%13.8" ECU_ADDRESS 0x500013B4 /end MEASUREMENT
/begin MEASUREMENT EGSDCmn_tS2B1SensParl "exhaust gas temperature at oxygen sensor 2, bank 1" UWORD temp_q0p0234_o273 1 100 -273.150 1262.827 FORMAT "%8.3" ECU_ADDRESS 0x60004912 /end MEASUREMENT
/begin MEASUREMENT EGSDCmn_uS2B1FildParl "filtered sensor voltage of sensor 2, bank 1" UWORD spg_q1p221Em3_V 1 100 0.00 4.998779 FORMAT "%8.6" ECU_ADDRESS 0x60004D02 /end MEASUREMENT
/begin MEASUREMENT EGSDCmn_uS2B1FildTWCD "filtered sensor voltage of sensor 2, bank 1, to be used in TWC Operations" UWORD spg_q1p221Em3_V 1 100 0.00 4.998779 FORMAT "%8.6" ECU_ADDRESS 0x60004D00 /end MEASUREMENT
/begin MEASUREMENT EGSDCmn_uS2B1Old_a "array of old sensor voltage values of gradient creation of sensor 2, bank 1" UWORD spg_q1p221Em3_V 1 100 0.00 4.998779 FORMAT "%8.6" ARRAY_SIZE 11 ECU_ADDRESS 0x6000D872 /end MEASUREMENT
/begin MEASUREMENT EGSDCmn_VirtEomDmd_I.stOperMod "Virtual Engine operation mode request of the active exhaust gas sensor and catalyst diagnosis (parallelization) / Priority-element of the operation mode structure" ULONG OneToOne 1 100 0.00 4294967295.00 FORMAT "%13.2" ECU_ADDRESS 0x70001A1C /end MEASUREMENT
/begin MEASUREMENT EGSDCmn_VirtEomDmd_I.stOperModPrio "Virtual Engine operation mode request of the active exhaust gas sensor and catalyst diagnosis (parallelization) / Stage-element of the operation mode structure" UBYTE OneToOne 1 100 0.00 255.0 FORMAT "%5.1" ECU_ADDRESS 0x70001A20 /end MEASUREMENT
/begin MEASUREMENT EGSDCmn_VirtEomDmd_I.stOperModStg "Virtual Engine operation mode request of the active exhaust gas sensor and catalyst diagnosis (parallelization) / Operation-mode element of the operation mode structure" UWORD OneToOne 1 100 0.00 65535.00 FORMAT "%8.2" ECU_ADDRESS 0x70001A22 /end MEASUREMENT
/begin MEASUREMENT EGSDO2_BpChgB1EBNM_I.oldSignal "edge-bi hysteresis bandpass change (bank 1) / EdgeBiNoMem.oldsignal" UBYTE B_TRUE 1 100 0.00 1.00000000000 BIT_MASK 0x1 FORMAT "%13.11" ECU_ADDRESS 0x6000657B /end MEASUREMENT
/begin MEASUREMENT EGSDO2_BpChgB1TONV_I.outbit "Turn-on delay after bandpass change (bank 1) / return value" UBYTE B_TRUE 1 100 0.00 1.00000000000 BIT_MASK 0x1 FORMAT "%13.11" ECU_ADDRESS 0x60003B78 /end MEASUREMENT
/begin MEASUREMENT EGSDO2_BpChgB1TONV_I.time "Turn-on delay after bandpass change (bank 1) / expired delay time" UWORD t_q0p01 1 100 0.00 655.3500 FORMAT "%8.4" ECU_ADDRESS 0x60003B7A /end MEASUREMENT
/begin MEASUREMENT EGSDO2_ctReini100msEvln "counter reini" UBYTE dez 1 100 0.00 255.0 FORMAT "%5.1" ECU_ADDRESS 0x6000657E /end MEASUREMENT
/begin MEASUREMENT EGSDO2_DerExhMFlowB1TONV_I.outbit "Turn-on delay for derivative of exhaust mass flow (bank 1) / return value" UBYTE B_TRUE 1 100 0.00 1.00000000000 BIT_MASK 0x1 FORMAT "%13.11" ECU_ADDRESS 0x60003B74 /end MEASUREMENT
/begin MEASUREMENT EGSDO2_DerExhMFlowB1TONV_I.time "Turn-on delay for derivative of exhaust mass flow (bank 1) / expired delay time" UWORD t_q0p01 1 100 0.00 655.3500 FORMAT "%8.4" ECU_ADDRESS 0x60003B76 /end MEASUREMENT
/begin MEASUREMENT EGSDO2_dmfExhDynB1 "Time derivation of mass flow" SWORD m_sw_b3276p8 1 100 -3276.800 3276.700 FORMAT "%8.3" ECU_ADDRESS 0x6000D898 /end MEASUREMENT
/begin MEASUREMENT EGSDO2_dratFillgAbslt "Absolute value of filling gradient" UWORD rel_uw_q0p0234 1 100 0.00 1535.977 FORMAT "%8.3" ECU_ADDRESS 0x6000D89A /end MEASUREMENT
/begin MEASUREMENT EGSDO2_DynFltEvlnB1ERNM_I.oldSignal "Dynamic error for wideband sensor detected / value of input signal last calculation" UBYTE B_TRUE 1 100 0.00 1.00000000000 BIT_MASK 0x1 FORMAT "%13.11" ECU_ADDRESS 0x6000657D /end MEASUREMENT
/begin MEASUREMENT EGSDO2_EnaB1TONV_I.outbit "Turn-on delay after controller enable (bank 1) / return value" UBYTE B_TRUE 1 100 0.00 1.00000000000 BIT_MASK 0x1 FORMAT "%13.11" ECU_ADDRESS 0x500052EA /end MEASUREMENT
/begin MEASUREMENT EGSDO2_EnaB1TONV_I.time "Turn-on delay after controller enable (bank 1) / expired delay time" UWORD t_q0p01 1 100 0.00 655.3500 FORMAT "%8.4" ECU_ADDRESS 0x500052EC /end MEASUREMENT
/begin MEASUREMENT EGSDO2_EnaIdnLamMonB1TOFFV_I.outbit "Turn-off delay of identification at unsufficient dynamic excitation (bank 1) / Output Bit" UBYTE B_TRUE 1 100 0.00 1.00000000000 BIT_MASK 0x1 FORMAT "%13.11" ECU_ADDRESS 0x60003B70 /end MEASUREMENT
/begin MEASUREMENT EGSDO2_EnaIdnLamMonB1TOFFV_I.time "Turn-off delay of identification at unsufficient dynamic excitation (bank 1) / Occured Time" UWORD t_q0p01 1 100 0.00 655.3500 FORMAT "%8.4" ECU_ADDRESS 0x60003B72 /end MEASUREMENT
/begin MEASUREMENT EGSDO2_EnaIdnVlvLftTOFFV_I.outbit "Turn-on delay after change in valve lift / Output Bit" UBYTE B_TRUE 1 100 0.00 1.00000000000 BIT_MASK 0x1 FORMAT "%13.11" ECU_ADDRESS 0x60003B6C /end MEASUREMENT
/begin MEASUREMENT EGSDO2_EnaIdnVlvLftTOFFV_I.time "Turn-on delay after change in valve lift / Occured Time" UWORD t_q0p01 1 100 0.00 655.3500 FORMAT "%8.4" ECU_ADDRESS 0x60003B6E /end MEASUREMENT
/begin MEASUREMENT EGSDO2_EnaSnsrRdnB1TONV_I.outbit "Turn-on delay after sensor readiness (bank 1) / return value" UBYTE B_TRUE 1 100 0.00 1.00000000000 BIT_MASK 0x1 FORMAT "%13.11" ECU_ADDRESS 0x60003B68 /end MEASUREMENT
/begin MEASUREMENT EGSDO2_EnaSnsrRdnB1TONV_I.time "Turn-on delay after sensor readiness (bank 1) / expired delay time" UWORD t_q0p01 1 100 0.00 655.3500 FORMAT "%8.4" ECU_ADDRESS 0x60003B6A /end MEASUREMENT
/begin MEASUREMENT EGSDO2_EvlnNoInhb100msS1B1EFNM_I.oldSignal "LamDyn inhibited / memory to detect falling edge" UBYTE B_TRUE 1 100 0.00 1.00000000000 BIT_MASK 0x1 FORMAT "%13.11" ECU_ADDRESS 0x6000657C /end MEASUREMENT
/begin MEASUREMENT EGSDO2_ExctLtrB1TOFFV_I.outbit "Turn-off delay after dynamic excitation in lean-rich direction (bank 1) / Output Bit" UBYTE B_TRUE 1 100 0.00 1.00000000000 BIT_MASK 0x1 FORMAT "%13.11" ECU_ADDRESS 0x60003B64 /end MEASUREMENT
/begin MEASUREMENT EGSDO2_ExctLtrB1TOFFV_I.time "Turn-off delay after dynamic excitation in lean-rich direction (bank 1) / Occured Time" UWORD t_q0p01 1 100 0.00 655.3500 FORMAT "%8.4" ECU_ADDRESS 0x60003B66 /end MEASUREMENT
/begin MEASUREMENT EGSDO2_ExctRtlB1TOFFV_I.outbit "Turn-off delay after dynamic excitation in rich-lean direction (bank 1) / Output Bit" UBYTE B_TRUE 1 100 0.00 1.00000000000 BIT_MASK 0x1 FORMAT "%13.11" ECU_ADDRESS 0x500052EE /end MEASUREMENT
/begin MEASUREMENT EGSDO2_ExctRtlB1TOFFV_I.time "Turn-off delay after dynamic excitation in rich-lean direction (bank 1) / Occured Time" UWORD t_q0p01 1 100 0.00 655.3500 FORMAT "%8.4" ECU_ADDRESS 0x500052F0 /end MEASUREMENT
/begin MEASUREMENT EGSDO2_facMdlDeEvlnDiffMaxB1 "Maximum of difference between nominal model and fault model deviation, bank1" SWORD fak_uw_b128 1 100 -64.00000 63.99805 FORMAT "%8.5" ECU_ADDRESS 0x60036642 /end MEASUREMENT
/begin MEASUREMENT EGSDO2_facMdlDeEvlnDiffMinB1 "Minimum of difference between nominal model and fault model deviation, bank1" SWORD fak_uw_b128 1 100 -64.00000 63.99805 FORMAT "%8.5" ECU_ADDRESS 0x60036640 /end MEASUREMENT
/begin MEASUREMENT EGSDO2_facMdlFltDeEvlnMaxB1 "Maximum Fault model deviation, bank1" UWORD fak_uw_b128 1 100 0.00 127.9980 FORMAT "%8.4" ECU_ADDRESS 0x6003663E /end MEASUREMENT
/begin MEASUREMENT EGSDO2_facMdlNomDeEvlnMaxB1 "Maximum nominal model deviation, bank1" UWORD fak_uw_b128 1 100 0.00 127.9980 FORMAT "%8.4" ECU_ADDRESS 0x6003663C /end MEASUREMENT
/begin MEASUREMENT EGSDO2_FcoB1TONV_I.outbit "Turn-on delay after Inj. valve cut off on Bank1 / return value" UBYTE B_TRUE 1 100 0.00 1.00000000000 BIT_MASK 0x1 FORMAT "%13.11" ECU_ADDRESS 0x60003B60 /end MEASUREMENT
/begin MEASUREMENT EGSDO2_FcoB1TONV_I.time "Turn-on delay after Inj. valve cut off on Bank1 / expired delay time" UWORD t_q0p01 1 100 0.00 655.3500 FORMAT "%8.4" ECU_ADDRESS 0x60003B62 /end MEASUREMENT
/begin MEASUREMENT EGSDO2_FillgGrdtTONV_I.outbit "Turn-on delay after too large gradient in filling / return value" UBYTE B_TRUE 1 100 0.00 1.00000000000 BIT_MASK 0x1 FORMAT "%13.11" ECU_ADDRESS 0x60003B5C /end MEASUREMENT
/begin MEASUREMENT EGSDO2_FillgGrdtTONV_I.time "Turn-on delay after too large gradient in filling / expired delay time" UWORD t_q0p01 1 100 0.00 655.3500 FORMAT "%8.4" ECU_ADDRESS 0x60003B5E /end MEASUREMENT
/begin MEASUREMENT EGSDO2_FillgTONV_I.outbit "Turn-on delay after sufficiently large filling / return value" UBYTE B_TRUE 1 100 0.00 1.00000000000 BIT_MASK 0x1 FORMAT "%13.11" ECU_ADDRESS 0x500052F2 /end MEASUREMENT
/begin MEASUREMENT EGSDO2_FillgTONV_I.time "Turn-on delay after sufficiently large filling / expired delay time" UWORD t_q0p01 1 100 0.00 655.3500 FORMAT "%8.4" ECU_ADDRESS 0x500052F4 /end MEASUREMENT
/begin MEASUREMENT EGSDO2_flgDlyStepFltLtrB1 "Dynamic error delay lean to rich is detected" UBYTE B_TRUE 1 100 0.00 1.00000000000 BIT_MASK 0x1 FORMAT "%13.11" ECU_ADDRESS 0x700002A3 /end MEASUREMENT
/begin MEASUREMENT EGSDO2_flgDlyStepFltRtlB1 "Dynamic error delay rich to lean is detected" UBYTE B_TRUE 1 100 0.00 1.00000000000 BIT_MASK 0x1 FORMAT "%13.11" ECU_ADDRESS 0x700002A2 /end MEASUREMENT
/begin MEASUREMENT EGSDO2_flgDSMClrEvlnB1 "Indication of clearing of error memory of the EGSDO2_Evln" UBYTE B_TRUE 1 100 0.00 1.00000000000 BIT_MASK 0x1 FORMAT "%13.11" ECU_ADDRESS 0x70000863 /end MEASUREMENT
/begin MEASUREMENT EGSDO2_flgDynErrSuspcS1B1 "Error suspicion from dynamic diagnosis (sensor 1, bank 1)" UBYTE B_TRUE 1 100 0.00 1.00000000000 BIT_MASK 0x1 FORMAT "%13.11" ECU_ADDRESS 0x7000085D /end MEASUREMENT
/begin MEASUREMENT EGSDO2_flgDynLtrTripDneS1B1 "Number of step response measurements in lean-rich direction for driving cycle reached (sensor 1, bank 1)" UBYTE B_TRUE 1 100 0.00 1.00000000000 BIT_MASK 0x1 FORMAT "%13.11" ECU_ADDRESS 0x7000085C /end MEASUREMENT
/begin MEASUREMENT EGSDO2_flgDynLtrTripDneVirtS1B1 "Number of virtual step response measurements in lean-rich direction for driving cycle reached (sensor 1, bank 1)" UBYTE B_TRUE 1 100 0.00 1.00000000000 BIT_MASK 0x1 FORMAT "%13.11" ECU_ADDRESS 0x7000085B /end MEASUREMENT
/begin MEASUREMENT EGSDO2_flgDynRtlTripDneS1B1 "Number of step response measurements in rich-lean direction for driving cycle reached (sensor 1, bank 1)" UBYTE B_TRUE 1 100 0.00 1.00000000000 BIT_MASK 0x1 FORMAT "%13.11" ECU_ADDRESS 0x7000085A /end MEASUREMENT
/begin MEASUREMENT EGSDO2_flgDynRtlTripDneVirtS1B1 "Number of virtual step response measurements in rich-lean direction for driving cycle reached (sensor 1, bank 1)" UBYTE B_TRUE 1 100 0.00 1.00000000000 BIT_MASK 0x1 FORMAT "%13.11" ECU_ADDRESS 0x70000859 /end MEASUREMENT
/begin MEASUREMENT EGSDO2_flgEnaCmnIdn "Common enabling condition of identification" UBYTE B_TRUE 1 100 0.00 1.00000000000 BIT_MASK 0x1 FORMAT "%13.11" ECU_ADDRESS 0x7000029A /end MEASUREMENT
/begin MEASUREMENT EGSDO2_flgEnaCmnPrjUnSpcIdn "Common Non Project specific Engine operating Condition for online identification Diagnosis." UBYTE B_TRUE 1 100 0.00 1.00000000000 BIT_MASK 0x1 FORMAT "%13.11" ECU_ADDRESS 0x70000299 /end MEASUREMENT
/begin MEASUREMENT EGSDO2_flgEnaIdnB1 "Enabling condition of identification (bank 1)" UBYTE B_TRUE 1 100 0.00 1.00000000000 BIT_MASK 0x1 FORMAT "%13.11" ECU_ADDRESS 0x70000855 /end MEASUREMENT
/begin MEASUREMENT EGSDO2_flgEnaIdnLtrB1 "Enabling condition of identification in lean-rich direction (bank 1)" UBYTE B_TRUE 1 100 0.00 1.00000000000 BIT_MASK 0x1 FORMAT "%13.11" ECU_ADDRESS 0x70000854 /end MEASUREMENT
/begin MEASUREMENT EGSDO2_flgEnaIdnRtlB1 "Enabling condition of identification in rich-lean direction (bank 1)" UBYTE B_TRUE 1 100 0.00 1.00000000000 BIT_MASK 0x1 FORMAT "%13.11" ECU_ADDRESS 0x70000853 /end MEASUREMENT
/begin MEASUREMENT EGSDO2_flgEnaLossB1 "Enable conditions of the loss function" UBYTE B_TRUE 1 100 0.00 1.00000000000 BIT_MASK 0x1 FORMAT "%13.11" ECU_ADDRESS 0x70000852 /end MEASUREMENT
/begin MEASUREMENT EGSDO2_flgEnaPrjUnSpcIdnB1 "Common Non Project specific Exhaust Condition for online identification Diagnosis, Bank1" UBYTE B_TRUE 1 100 0.00 1.00000000000 BIT_MASK 0x1 FORMAT "%13.11" ECU_ADDRESS 0x70000298 /end MEASUREMENT
/begin MEASUREMENT EGSDO2_flgFltEvlnB1 "Dynamic error is detected" UBYTE B_TRUE 1 100 0.00 1.00000000000 BIT_MASK 0x1 FORMAT "%13.11" ECU_ADDRESS 0x700002A1 /end MEASUREMENT
/begin MEASUREMENT EGSDO2_flgIdnFltS1B1 "Failure in the dynamics of the UEGO O2 signal, detected by online identification" UBYTE B_TRUE 1 100 0.00 1.00000000000 BIT_MASK 0x1 FORMAT "%13.11" ECU_ADDRESS 0x70000850 /end MEASUREMENT
/begin MEASUREMENT EGSDO2_flgLamDynDFCErrB1 "Lambda dynamic error path tested with error" UBYTE B_TRUE 1 100 0.00 1.00000000000 BIT_MASK 0x1 FORMAT "%13.11" ECU_ADDRESS 0x7000084B /end MEASUREMENT
/begin MEASUREMENT EGSDO2_flgLamDynDFCTstdB1 "Lambda dynamic error pathes tested" UBYTE B_TRUE 1 100 0.00 1.00000000000 BIT_MASK 0x1 FORMAT "%13.11" ECU_ADDRESS 0x7000084A /end MEASUREMENT
/begin MEASUREMENT EGSDO2_flgSrv06OutpFltEvlnB1 "Service 6 trigger for fault" UBYTE B_TRUE 1 100 0.00 1.00000000000 BIT_MASK 0x1 FORMAT "%13.11" ECU_ADDRESS 0x700002A0 /end MEASUREMENT
/begin MEASUREMENT EGSDO2_flgSrv06OutpHealEvlnB1 "Service 6 trigger for healing" UBYTE B_TRUE 1 100 0.00 1.00000000000 BIT_MASK 0x1 FORMAT "%13.11" ECU_ADDRESS 0x7000029F /end MEASUREMENT
/begin MEASUREMENT EGSDO2_flgStepFltB1 "Dynamic error from stepmeasurement is detected" UBYTE B_TRUE 1 100 0.00 1.00000000000 BIT_MASK 0x1 FORMAT "%13.11" ECU_ADDRESS 0x7000029E /end MEASUREMENT
/begin MEASUREMENT EGSDO2_flgTranStepFltLtrB1 "Dynamic error from stepmeasurement transition lean to rich is detected" UBYTE B_TRUE 1 100 0.00 1.00000000000 BIT_MASK 0x1 FORMAT "%13.11" ECU_ADDRESS 0x7000029D /end MEASUREMENT
/begin MEASUREMENT EGSDO2_flgTranStepFltRtlB1 "Dynamic error from stepmeasurement transition rich to lean is detected" UBYTE B_TRUE 1 100 0.00 1.00000000000 BIT_MASK 0x1 FORMAT "%13.11" ECU_ADDRESS 0x7000029C /end MEASUREMENT
/begin MEASUREMENT EGSDO2_flgVldEvlnB1 "Validation for the dynamic fault evaluation is done" UBYTE B_TRUE 1 100 0.00 1.00000000000 BIT_MASK 0x1 FORMAT "%13.11" ECU_ADDRESS 0x7000029B /end MEASUREMENT
/begin MEASUREMENT EGSDO2_flgVlvLftEB_I.buffer "High valve lift / EdgeBi.buffer" UBYTE B_TRUE 1 100 0.00 1.00000000000 BIT_MASK 0x1 FORMAT "%13.11" ECU_ADDRESS 0x60003B58 /end MEASUREMENT
/begin MEASUREMENT EGSDO2_flgVlvLftEB_I.oldSignal "High valve lift / EdgeBi.odlSignal" UBYTE B_TRUE 1 100 0.00 1.00000000000 BIT_MASK 0x1 FORMAT "%13.11" ECU_ADDRESS 0x60003B59 /end MEASUREMENT
/begin MEASUREMENT EGSDO2_FltDetnB1_I.cntrStepLtrVirt "Class instance for the evaluation of the dynamic faults of the UEGO sensor / Result counter" UBYTE dez 1 100 0.00 255.0 FORMAT "%5.1" ECU_ADDRESS 0x6003663A /end MEASUREMENT
/begin MEASUREMENT EGSDO2_FltDetnB1_I.cntrStepRtlVirt "Class instance for the evaluation of the dynamic faults of the UEGO sensor / Result counter" UBYTE dez 1 100 0.00 255.0 FORMAT "%5.1" ECU_ADDRESS 0x6003663B /end MEASUREMENT
/begin MEASUREMENT EGSDO2_FltDetnB1_I.flgDlyIdnFltLtr "Class instance for the evaluation of the dynamic faults of the UEGO sensor / Delay time error lean to rich, detected by online identification" UBYTE B_TRUE 1 100 0.00 1.00000000000 BIT_MASK 0x1 FORMAT "%13.11" ECU_ADDRESS 0x500052F6 /end MEASUREMENT
/begin MEASUREMENT EGSDO2_FltDetnB1_I.flgDlyIdnFltRtl "Class instance for the evaluation of the dynamic faults of the UEGO sensor / Delay time error rich to lean, detected by online identification" UBYTE B_TRUE 1 100 0.00 1.00000000000 BIT_MASK 0x1 FORMAT "%13.11" ECU_ADDRESS 0x500052F7 /end MEASUREMENT
/begin MEASUREMENT EGSDO2_FltDetnB1_I.flgDynLtrDne "Class instance for the evaluation of the dynamic faults of the UEGO sensor / Dynamic diagnosis in lean-rich direction done" UBYTE B_TRUE 1 100 0.00 1.00000000000 BIT_MASK 0x1 FORMAT "%13.11" ECU_ADDRESS 0x500052F8 /end MEASUREMENT
/begin MEASUREMENT EGSDO2_FltDetnB1_I.flgDynLtrDneVirt "Class instance for the evaluation of the dynamic faults of the UEGO sensor / Evaluation of the virtual dynamic fault done" UBYTE B_TRUE 1 100 0.00 1.00000000000 BIT_MASK 0x1 FORMAT "%13.11" ECU_ADDRESS 0x500052F9 /end MEASUREMENT
/begin MEASUREMENT EGSDO2_FltDetnB1_I.flgDynLtrTripDne "Class instance for the evaluation of the dynamic faults of the UEGO sensor / Dynamic diagnosis in lean-rich direction in current trip done" UBYTE B_TRUE 1 100 0.00 1.00000000000 BIT_MASK 0x1 FORMAT "%13.11" ECU_ADDRESS 0x500052FA /end MEASUREMENT
/begin MEASUREMENT EGSDO2_FltDetnB1_I.flgDynLtrTripDneVirt "Class instance for the evaluation of the dynamic faults of the UEGO sensor / Evaluation of the virtual dynamic fault during trip done" UBYTE B_TRUE 1 100 0.00 1.00000000000 BIT_MASK 0x1 FORMAT "%13.11" ECU_ADDRESS 0x500052FB /end MEASUREMENT
/begin MEASUREMENT EGSDO2_FltDetnB1_I.flgDynRtlDne "Class instance for the evaluation of the dynamic faults of the UEGO sensor / Dynamic diagnosis in rich-lean direction done" UBYTE B_TRUE 1 100 0.00 1.00000000000 BIT_MASK 0x1 FORMAT "%13.11" ECU_ADDRESS 0x500052FC /end MEASUREMENT
/begin MEASUREMENT EGSDO2_FltDetnB1_I.flgDynRtlDneVirt "Class instance for the evaluation of the dynamic faults of the UEGO sensor / Evaluation of the virtual dynamic fault done" UBYTE B_TRUE 1 100 0.00 1.00000000000 BIT_MASK 0x1 FORMAT "%13.11" ECU_ADDRESS 0x500052FD /end MEASUREMENT
/begin MEASUREMENT EGSDO2_FltDetnB1_I.flgDynRtlTripDne "Class instance for the evaluation of the dynamic faults of the UEGO sensor / Dynamic diagnosis in rich-lean direction in current trip done" UBYTE B_TRUE 1 100 0.00 1.00000000000 BIT_MASK 0x1 FORMAT "%13.11" ECU_ADDRESS 0x500052FE /end MEASUREMENT
/begin MEASUREMENT EGSDO2_FltDetnB1_I.flgDynRtlTripDneVirt "Class instance for the evaluation of the dynamic faults of the UEGO sensor / Evaluation of the virtual dynamic fault during trip done" UBYTE B_TRUE 1 100 0.00 1.00000000000 BIT_MASK 0x1 FORMAT "%13.11" ECU_ADDRESS 0x500052FF /end MEASUREMENT
/begin MEASUREMENT EGSDO2_FltDetnB1_I.flgIdnFlt "Class instance for the evaluation of the dynamic faults of the UEGO sensor / Fault detected from identification" UBYTE B_TRUE 1 100 0.00 1.00000000000 BIT_MASK 0x1 FORMAT "%13.11" ECU_ADDRESS 0x50005300 /end MEASUREMENT
/begin MEASUREMENT EGSDO2_FltDetnB1_I.flgQckPassdFaildLtr "Class instance for the evaluation of the dynamic faults of the UEGO sensor / Quick pass check failed in lean-rich direction" UBYTE B_TRUE 1 100 0.00 1.00000000000 BIT_MASK 0x1 FORMAT "%13.11" ECU_ADDRESS 0x50005301 /end MEASUREMENT
/begin MEASUREMENT EGSDO2_FltDetnB1_I.flgQckPassdFaildRtl "Class instance for the evaluation of the dynamic faults of the UEGO sensor / Quick pass check failed in rich-lean direction" UBYTE B_TRUE 1 100 0.00 1.00000000000 BIT_MASK 0x1 FORMAT "%13.11" ECU_ADDRESS 0x50005302 /end MEASUREMENT
/begin MEASUREMENT EGSDO2_FltDetnB1_I.flgQckPassdLtr "Class instance for the evaluation of the dynamic faults of the UEGO sensor / ." UBYTE B_TRUE 1 100 0.00 1.00000000000 BIT_MASK 0x1 FORMAT "%13.11" ECU_ADDRESS 0x50005303 /end MEASUREMENT
/begin MEASUREMENT EGSDO2_FltDetnB1_I.flgQckPassdRtl "Class instance for the evaluation of the dynamic faults of the UEGO sensor / ." UBYTE B_TRUE 1 100 0.00 1.00000000000 BIT_MASK 0x1 FORMAT "%13.11" ECU_ADDRESS 0x50005304 /end MEASUREMENT
/begin MEASUREMENT EGSDO2_FltDetnB1_I.flgTranIdnFltLtr "Class instance for the evaluation of the dynamic faults of the UEGO sensor / Time constant error lean to rich, detected by online identification" UBYTE B_TRUE 1 100 0.00 1.00000000000 BIT_MASK 0x1 FORMAT "%13.11" ECU_ADDRESS 0x50005305 /end MEASUREMENT
/begin MEASUREMENT EGSDO2_FltDetnB1_I.flgTranIdnFltRtl "Class instance for the evaluation of the dynamic faults of the UEGO sensor / Time constant error rich to lean, detected by online identification" UBYTE B_TRUE 1 100 0.00 1.00000000000 BIT_MASK 0x1 FORMAT "%13.11" ECU_ADDRESS 0x50005306 /end MEASUREMENT
/begin MEASUREMENT EGSDO2_FltDetnB1_I.tiDlyIdnLtrFlt "Class instance for the evaluation of the dynamic faults of the UEGO sensor / Delay time from identifikation lean to rich" UWORD t_q0p01 1 100 0.00 655.3500 FORMAT "%8.4" ECU_ADDRESS 0x50005308 /end MEASUREMENT
/begin MEASUREMENT EGSDO2_FltDetnB1_I.tiDlyIdnRtlFlt "Class instance for the evaluation of the dynamic faults of the UEGO sensor / Delay time from identifikation rich to lean" UWORD t_q0p01 1 100 0.00 655.3500 FORMAT "%8.4" ECU_ADDRESS 0x5000530A /end MEASUREMENT
/begin MEASUREMENT EGSDO2_FltDetnB1_I.tiSumIdnLtr "Class instance for the evaluation of the dynamic faults of the UEGO sensor / Summed time of identification in lean-rich direction" UWORD t_q0p01 1 100 0.00 655.3500 FORMAT "%8.4" ECU_ADDRESS 0x5000530C /end MEASUREMENT
/begin MEASUREMENT EGSDO2_FltDetnB1_I.tiSumIdnRtl "Class instance for the evaluation of the dynamic faults of the UEGO sensor / Summed time of identification in rich-lean direction" UWORD t_q0p01 1 100 0.00 655.3500 FORMAT "%8.4" ECU_ADDRESS 0x5000530E /end MEASUREMENT
/begin MEASUREMENT EGSDO2_FltDetnB1_I.tiTranIdnLtrFlt "Class instance for the evaluation of the dynamic faults of the UEGO sensor / Transition time from identifikation lean to rich" UWORD t_q0p01 1 100 0.00 655.3500 FORMAT "%8.4" ECU_ADDRESS 0x50005310 /end MEASUREMENT
/begin MEASUREMENT EGSDO2_FltDetnB1_I.tiTranIdnRtlFlt "Class instance for the evaluation of the dynamic faults of the UEGO sensor / Transition time from identifikation rich to lean" UWORD t_q0p01 1 100 0.00 655.3500 FORMAT "%8.4" ECU_ADDRESS 0x50005312 /end MEASUREMENT
/begin MEASUREMENT EGSDO2_FltDetnB1_I.LamDynQckPassdDlyLtr_I.flgQckPassdFaild "Class instance for the evaluation of the dynamic faults of the UEGO sensor / Class for quick-pass for lambda-based dynamics diagnosis of a wideband-sensor, delay error in lean-rich direction / Quick pass failed" UBYTE B_TRUE 1 100 0.00 1.00000000000 BIT_MASK 0x1 FORMAT "%13.11" ECU_ADDRESS 0x50005314 /end MEASUREMENT
/begin MEASUREMENT EGSDO2_FltDetnB1_I.LamDynQckPassdDlyRtl_I.flgQckPassdFaild "Class instance for the evaluation of the dynamic faults of the UEGO sensor / Class for quick-pass for lambda-based dynamics diagnosis of a wideband-sensor, delay error in rich-lean direction / Quick pass failed" UBYTE B_TRUE 1 100 0.00 1.00000000000 BIT_MASK 0x1 FORMAT "%13.11" ECU_ADDRESS 0x50005315 /end MEASUREMENT
/begin MEASUREMENT EGSDO2_FltDetnB1_I.LamDynQckPassdTranLtr_I.flgQckPassdFaild "Class instance for the evaluation of the dynamic faults of the UEGO sensor / Class for quick-pass for lambda-based dynamics diagnosis of a wideband-sensor, transition error in lean-rich direction / Quick pass failed" UBYTE B_TRUE 1 100 0.00 1.00000000000 BIT_MASK 0x1 FORMAT "%13.11" ECU_ADDRESS 0x50005316 /end MEASUREMENT
/begin MEASUREMENT EGSDO2_FltDetnB1_I.LamDynQckPassdTranRtl_I.flgQckPassdFaild "Class instance for the evaluation of the dynamic faults of the UEGO sensor / Class for quick-pass for lambda-based dynamics diagnosis of a wideband-sensor, transition error in rich-lean direction / Quick pass failed" UBYTE B_TRUE 1 100 0.00 1.00000000000 BIT_MASK 0x1 FORMAT "%13.11" ECU_ADDRESS 0x50005317 /end MEASUREMENT
/begin MEASUREMENT EGSDO2_FltDetnB1_I.LtrStepChgERNM_I.oldSignal "Class instance for the evaluation of the dynamic faults of the UEGO sensor / StepChange triggered / value of input signal last calculation" UBYTE B_TRUE 1 100 0.00 1.00000000000 BIT_MASK 0x1 FORMAT "%13.11" ECU_ADDRESS 0x50005318 /end MEASUREMENT
/begin MEASUREMENT EGSDO2_FltDetnB1_I.RtlStepChgERNM_I.oldSignal "Class instance for the evaluation of the dynamic faults of the UEGO sensor / StepChange triggered / value of input signal last calculation" UBYTE B_TRUE 1 100 0.00 1.00000000000 BIT_MASK 0x1 FORMAT "%13.11" ECU_ADDRESS 0x50005319 /end MEASUREMENT
/begin MEASUREMENT EGSDO2_FltDetnB1_I.ShrtrpERNM_I.oldSignal "Class instance for the evaluation of the dynamic faults of the UEGO sensor / edge rising short trip / value of input signal last calculation" UBYTE B_TRUE 1 100 0.00 1.00000000000 BIT_MASK 0x1 FORMAT "%13.11" ECU_ADDRESS 0x5000531A /end MEASUREMENT
/begin MEASUREMENT EGSDO2_FltDetnB1_I.cntrStepLtrTripVirtDOS_I.buffer "Class instance for the evaluation of the dynamic faults of the UEGO sensor / Resultcounter counts / Buffer element for deltaonestep" SWORD OneToOne 1 100 -32768.00 32767.00 FORMAT "%8.2" ECU_ADDRESS 0x5000531C /end MEASUREMENT
/begin MEASUREMENT EGSDO2_FltDetnB1_I.cntrStepLtrTripVirtDOS_I.oldValue "Class instance for the evaluation of the dynamic faults of the UEGO sensor / Resultcounter counts / Describes the input value one time step ahead of the current time" SWORD OneToOne 1 100 -32768.00 32767.00 FORMAT "%8.2" ECU_ADDRESS 0x5000531E /end MEASUREMENT
/begin MEASUREMENT EGSDO2_FltDetnB1_I.cntrStepRtlTripVirtDOS_I.buffer "Class instance for the evaluation of the dynamic faults of the UEGO sensor / Resultcounter counts / Buffer element for deltaonestep" SWORD OneToOne 1 100 -32768.00 32767.00 FORMAT "%8.2" ECU_ADDRESS 0x50005320 /end MEASUREMENT
/begin MEASUREMENT EGSDO2_FltDetnB1_I.cntrStepRtlTripVirtDOS_I.oldValue "Class instance for the evaluation of the dynamic faults of the UEGO sensor / Resultcounter counts / Describes the input value one time step ahead of the current time" SWORD OneToOne 1 100 -32768.00 32767.00 FORMAT "%8.2" ECU_ADDRESS 0x50005322 /end MEASUREMENT
/begin MEASUREMENT EGSDO2_mfExhFilB1LT_I.memory "Filter for calculation of exhaust mass flow derivative (bank 1) / current lowpass value" ULONG m_q1p526Em6_g 1 100 0.00 6553.59999847 FORMAT "%13.8" ECU_ADDRESS 0x600015B8 /end MEASUREMENT
/begin MEASUREMENT EGSDO2_ratFillgPredDt1LT_I.memory "Filter for relative filling to calculate gradient (DT1) / current lowpass value" ULONG rel_q3p5763Em7 1 100 0.00 1535.99999964 FORMAT "%13.8" ECU_ADDRESS 0x600015B4 /end MEASUREMENT
/begin MEASUREMENT EGSDO2_ShiftTONV_I.outbit "Turn-on delay after gear shift / return value" UBYTE B_TRUE 1 100 0.00 1.00000000000 BIT_MASK 0x1 FORMAT "%13.11" ECU_ADDRESS 0x60003B5A /end MEASUREMENT
/begin MEASUREMENT EGSDO2_ShiftTONV_I.time "Turn-on delay after gear shift / expired delay time" UBYTE t_q0p01 1 100 0.00 2.550 FORMAT "%5.3" ECU_ADDRESS 0x60003B5B /end MEASUREMENT
/begin MEASUREMENT EGSDO2_StrtTONV_I.outbit "Turn-on delay after end of engine start / return value" UBYTE B_TRUE 1 100 0.00 1.00000000000 BIT_MASK 0x1 FORMAT "%13.11" ECU_ADDRESS 0x50005324 /end MEASUREMENT
/begin MEASUREMENT EGSDO2_StrtTONV_I.time "Turn-on delay after end of engine start / expired delay time" UWORD t_q0p01 1 100 0.00 655.3500 FORMAT "%8.4" ECU_ADDRESS 0x50005326 /end MEASUREMENT
/begin MEASUREMENT EGSDO2_tiSumIdnLtrS1B1 "Sum time of identification in lean-rich direction (sensor 1, bank 1)" UWORD t_q0p01 1 100 0.00 655.3500 FORMAT "%8.4" ECU_ADDRESS 0x6000490E /end MEASUREMENT
/begin MEASUREMENT EGSDO2_tiSumIdnRtlS1B1 "Sum time of identification in rich-lean direction (sensor 1, bank 1)" UWORD t_q0p01 1 100 0.00 655.3500 FORMAT "%8.4" ECU_ADDRESS 0x6000490C /end MEASUREMENT
/begin FUNCTION EGSDCmn_CoorrParlAssc "1.6.1     assistance measures for coordinator of parallelization of sensor dynamic diagnosis and catalyst diagnosis"
 /begin DEF_CHARACTERISTIC EGSDCmn_facLamCtrlVLamDynParl_C EGSDCmn_facLamCtrlVParl_C EGSDCmn_facTiTqResvParl_C EGSDCmn_flgEnaEomParl_C EGSDCmn_flgLamDynSlowCtrlParl_C EGSDCmn_stEomParl_C EGSDCmn_stEomPrioParl_C EGSDCmn_stEomPrioShtrpParl_C EGSDCmn_stEomShtrpParl_C EGSDCmn_stEomStgParl_C EGSDCmn_stEomStgShtrpParl_C EGSDCmn_StOperModRelsShtrp_I.OperMod2Idx_M EGSDCmn_StOperModRels_I.OperMod2Idx_M EGSDCmn_tiFilLamCtrlVParl_C EGSDCmn_tqResvParl_C EGSDCmn_tqResvTstParl_C /end DEF_CHARACTERISTIC
 /begin IN_MEASUREMENT CoEOM_flgEGSDCmnVirtDmdActv CoEOM_stEomActvTmng EGSDCmn_flgLamReqParlB1 EGSDCmn_flgSeg1B1ReldParl EGSDCmn_flgSeg1B1VirtReldParl EGSDCmn_flgShtrpParl EGSDCmn_stLamGenrParlB1 EGSDO2_flgDynErrSuspcS1B1 EGSDO2_flgDynStepLtrB1 EGSDO2_flgDynStepRtlB1 EGSDO2_flgStepLtrEvlnS1B1 EGSDO2_flgStepRtlEvlnS1B1 EGSDU_flgS2B1QPFaildDynEvln EngStrt_bStrtEnd TWCD_flgOSCQPFaildPriB1 /end IN_MEASUREMENT
 /begin OUT_MEASUREMENT EGSDCmn_EomDmd_I.stOperMod EGSDCmn_EomDmd_I.stOperModPrio EGSDCmn_EomDmd_I.stOperModStg EGSDCmn_facLamCtrlVParlB1 EGSDCmn_flgCOEOMPsblParlB1 EGSDCmn_flgCOEOMRelsParlB1 EGSDCmn_flgOperPntActvParl EGSDCmn_flgReqEomParl EGSDCmn_flgSeg1B1QPFaildParl EGSDCmn_flgVirtCOEOMRelsParlB1 EGSDCmn_flgVirtReqEomParl EGSDCmn_tqResvParl EGSDCmn_VirtEomDmd_I.stOperMod EGSDCmn_VirtEomDmd_I.stOperModPrio EGSDCmn_VirtEomDmd_I.stOperModStg /end OUT_MEASUREMENT
 /begin LOC_MEASUREMENT EGSDCmn_facLamCtrlVParlB1LT_I.memory EGSDCmn_flgOperModDmdActv EGSDCmn_LamDynActvParlB1ER_I.buffer EGSDCmn_LamDynActvParlB1ER_I.oldSignal EGSDCmn_LamDynActvParlB1FF_I.status EGSDCmn_TqResvParlITL_I.memory /end LOC_MEASUREMENT
 FUNCTION_VERSION "1.6.1" /end FUNCTION
/begin FUNCTION EGSDCmn_CoorrParlEna "1.22.0    Enable condition for coordinator of parallelization of active exhaust gas sensor dynamic diagnosis and catalyst diagnosis"
 /begin DEF_CHARACTERISTIC EGSDCmn_dmEnaNegParl_C EGSDCmn_dmEnaPosParl_C EGSDCmn_dmfRngHiMaxActvParl_C EGSDCmn_dmfRngHiMinActvParl_C EGSDCmn_dmfRngLoMaxActvParl_C EGSDCmn_dmfRngLoMinActvParl_C EGSDCmn_dmfRngLoUnderMinParl_C EGSDCmn_dnEngMaxParl_C EGSDCmn_dnEngMinParl_C EGSDCmn_dtCat1RngHiMaxParl_C EGSDCmn_dtCat1RngHiMinParl_C EGSDCmn_dtCat1RngLoMaxParl_C EGSDCmn_dtCat1RngLoMinParl_C EGSDCmn_dtCatHomParl_C EGSDCmn_facFpcAdpnMaxParl_C EGSDCmn_facFuByFpcParl_C EGSDCmn_flgActvtAbortCntr_C EGSDCmn_flgBypLamMonOkParl_C EGSDCmn_flgEnaAftIdleIni_C EGSDCmn_flgFcoDiDiag_C EGSDCmn_flgGearShiftEnaParl_CW EGSDCmn_flgInjVlvDisblActvParl_C EGSDCmn_flgLamMonCntrParl_C EGSDCmn_flgLamMonSuppParl_CW EGSDCmn_flgPurgCtrlParl_C EGSDCmn_flgVlVLftActvParl_CW EGSDCmn_mEgCatWarmAftIdleFco_M EGSDCmn_mEgFpcDynDebParl_C EGSDCmn_mEgFpcEnaParl_C EGSDCmn_mEnaDsbcParlB1_C EGSDCmn_mEnaLam1Parl_C EGSDCmn_mEnaSensVldParl_C EGSDCmn_mfEnaRampMaxParl_C EGSDCmn_mfEnaRampMaxTstParl_C EGSDCmn_mfEnaRampMinParl_C EGSDCmn_mfEnaRampMinTstParl_C EGSDCmn_mfPurgCtrlThdParl_C EGSDCmn_mfRngHiMaxParl_T EGSDCmn_mfRngHiMaxTstParl_C EGSDCmn_mfRngHiMinParl_C EGSDCmn_mfRngHiMinTstParl_C EGSDCmn_mfRngLoMaxParl_T EGSDCmn_mfRngLoMaxTstParl_C EGSDCmn_mfRngLoMinParl_C EGSDCmn_mfRngLoMinTstParl_C EGSDCmn_mSeg1EnaEgParl_T EGSDCmn_nEngIdle_C EGSDCmn_nEngMaxParl_C EGSDCmn_nEngMaxTstParl_C EGSDCmn_nEngMinParl_C EGSDCmn_nEngMinTstParl_C EGSDCmn_nrLamMonOKEFParl_C EGSDCmn_PEnvMinParl_C EGSDCmn_ratLamEnaMaxParl_C EGSDCmn_ratLamEnaMinParl_C EGSDCmn_ratLamLeanEgInflParl_C EGSDCmn_ratLamRichEgInflParl_C EGSDCmn_ratLoadMinParl_Crv EGSDCmn_ratLoadMinTstParl_T EGSDCmn_rLamMaxDiffParl_C EGSDCmn_tAmbMinParl_C EGSDCmn_tCat1RngHiMaxParl_C EGSDCmn_tCat1RngHiMaxTstParl_C EGSDCmn_tCat1RngHiMinParl_C EGSDCmn_tCat1RngHiMinTstParl_C EGSDCmn_tCat1RngLoMaxParl_C EGSDCmn_tCat1RngLoMaxTstParl_C EGSDCmn_tCat1RngLoMinParl_C EGSDCmn_tCat1RngLoMinTstParl_C EGSDCmn_tCatMaxGrdtParl_C EGSDCmn_tCatMaxGrdtTstParl_C EGSDCmn_tCatMinGrdtParl_C EGSDCmn_tCatMinGrdtTstParl_C EGSDCmn_tCatMinParl_C EGSDCmn_tEngMinParl_C EGSDCmn_tiCatMinOffParl_C EGSDCmn_tiCatMinOnParl_C EGSDCmn_tiDebInjVlvDisblParl_C EGSDCmn_tiDebInjVlvEnaParl_C EGSDCmn_tiDebSigndLamMonParl_CUR EGSDCmn_tiEnaCatTGrdtParl_C EGSDCmn_tiEnaMflowParl_C EGSDCmn_tiFltMflowParl_C EGSDCmn_tiGearShiftParl_C EGSDCmn_tiIdleMax_C EGSDCmn_tiNEngOvrIdle_C EGSDCmn_tiRngLoUnderMinParl_C EGSDCmn_tiSeg1EnaTripParl_T EGSDCmn_tMinCatRelsParl_C EGSDCmn_tS2EnaSensParl_C EGSDCmn_tS2EnaSensTstParl_C EGSDCmn_vVehSpdMinParl_C /end DEF_CHARACTERISTIC
 /begin REF_CHARACTERISTIC EGSDO2_flgIdnDurgParl_CW EGSDO2_flgLamOffsFastPreParl_CW EGSDO2_flgSeqDyn_C /end REF_CHARACTERISTIC
 /begin IN_MEASUREMENT B_bevab_msg B_frmax_msg B_frmin_msg B_gsch_msg B_ten_msg B_te_msg B_vhegs_msg B_vheg_msg CEngDsT_t CEngDsT_tStrtFrst Eep_EnvRamInvld EGSDCmn_flgB1LamNotStabParl EGSDCmn_flgCOEOMPsblParlB1 EGSDCmn_flgCOEOMRelsParlB1 EGSDCmn_flgInhbProdModParl EGSDCmn_flgLamReqParlB1 EGSDCmn_flgProdModParl EGSDCmn_flgS1B1O2PlausResVirtParl EGSDCmn_flgS1B1VldParl EGSDCmn_flgS2B1TarLeanErrParl EGSDCmn_flgS2B1TarLeanResVirtOffsParl EGSDCmn_flgS2B1TarRichErrParl EGSDCmn_flgS2B1TarRichResVirtOffsParl EGSDCmn_flgS2B1VldParl EGSDCmn_flgShtrpParl EGSDCmn_flgVirtCOEOMRelsParlB1 EGSDCmn_mfEgCat1B1Parl EGSDCmn_tCat1B1MaxParl EGSDCmn_tCat1B1MinParl EGSDCmn_tCat1B1Parl EGSDCmn_tS2B1SensParl EGSDO2_flgDebHealOffsFastS1B1 EGSDO2_flgDynLtrTripDneS1B1 EGSDO2_flgDynLtrTripDneVirtS1B1 EGSDO2_flgDynRtlTripDneS1B1 EGSDO2_flgDynRtlTripDneVirtS1B1 EGSDO2_flgLamPlausFltMaxS1B1 EGSDO2_flgLamPlausFltMinS1B1 EGSDO2_flgLamPlausFltVirtS1B1 EGSDO2_flgLamPlausInhbParlS1B1 EGSDO2_flgQlyDeFltSuspcB1 EGSDU_flgS2B1TarLeanResEvln EGSDU_flgS2B1TarLeanResVirtEvln EGSDU_flgS2B1TarRichResEvln EGSDU_flgS2B1TarRichResVirtEvln EGSDU_flgS2B1TripLtrDlyEvln EGSDU_flgS2B1TripLtrTranEvln EGSDU_flgS2B1TripRtlDlyEvln EGSDU_flgS2B1TripRtlTranEvln EGSDU_flgS2B1TripVirtLtrDlyEvln EGSDU_flgS2B1TripVirtLtrTranEvln EGSDU_flgS2B1TripVirtRtlDlyEvln EGSDU_flgS2B1TripVirtRtlTranEvln EngStrt_bFrstStrtEnd EngStrt_bStrtEnd EnvT_t Epm_nEng Epm_nEngLRes ftead_w_msg imsteini_msg InjSys_ratFuM LamCtrl_ratLamSpS1B1 lamsbg_w_msg lamsons_w_msg lamssok_w_msg lamzak_w_msg mste_w_msg PEnv_p PthSet_bOvrRun rkte_w_msg rl_w_msg SyC_ctPostDrvLeave SyC_stSub TWCD_flgMeasFinshdTripB1 TWCD_flgMeasFinshdVirtTripB1 VehV_v zlamko_msg /end IN_MEASUREMENT
 /begin OUT_MEASUREMENT EGSDCmn_cntrB1AbortParlLamMon EGSDCmn_cntrB1AbortParlNEng EGSDCmn_cntrB1AbortParlRelLd EGSDCmn_cntrB1AbortParlV EGSDCmn_cntrB1AbortSumParl EGSDCmn_cntrB1StrtSumParl EGSDCmn_cntrSeg1B1AbortParlHiRng EGSDCmn_cntrSeg1B1AbortParlLoRng EGSDCmn_cntrSeg1B1AbortParlMFlowGrdt EGSDCmn_cntrSeg1B1AbortParlTGrdt EGSDCmn_flgCat1B1EnaTRngHiParl EGSDCmn_flgCat1B1EnaTRngLoParl EGSDCmn_flgEnvtlDiPID41Parl EGSDCmn_flgLamMonOkParlB1 EGSDCmn_flgSeg1B1ActvRqrdParl EGSDCmn_flgSeg1B1EnaEgParl EGSDCmn_flgSeg1B1EnaParl EGSDCmn_flgSeg1B1MeasRqrdParl EGSDCmn_flgSeg1B1PhyEnaParl EGSDCmn_flgSeg1B1RampEnaParl EGSDCmn_flgSeg1B1RdyParl EGSDCmn_flgSeg1B1ReldFinalParl EGSDCmn_flgSeg1B1ReldParl EGSDCmn_flgSeg1B1VirtMeasRqrdParl EGSDCmn_flgSeg1B1VirtReldFinalParl EGSDCmn_flgSeg1B1VirtReldParl EGSDCmn_flgTarLeanSuspcParlB1 EGSDCmn_flgTarRichSuspcParlB1 EGSDCmn_flgTarSuspcB1 EGSDCmn_flgTarSuspcVirtParlB1 /end OUT_MEASUREMENT
 /begin LOC_MEASUREMENT EGSDCmn_CatCoolOffParlB1TONV_I.outbit EGSDCmn_CatCoolOffParlB1TONV_I.time EGSDCmn_CatWrmUpParlB1TONV_I.outbit EGSDCmn_CatWrmUpParlB1TONV_I.time EGSDCmn_cntrB1AbortParlLamMonNV EGSDCmn_cntrB1AbortParlNEngNV EGSDCmn_cntrB1AbortParlNV EGSDCmn_cntrB1AbortParlRelLdNV EGSDCmn_cntrB1AbortParlVNV EGSDCmn_cntrB1StrtParlNV EGSDCmn_cntrSeg1B1AbortParlHiRngNV EGSDCmn_cntrSeg1B1AbortParlLoRngNV EGSDCmn_cntrSeg1B1AbortParlMFlowGrdtNV EGSDCmn_cntrSeg1B1AbortParlTGrdtNV EGSDCmn_CpvEB_I.buffer EGSDCmn_CpvEB_I.oldSignal EGSDCmn_ctReIni100msCoorrParlEna EGSDCmn_ctReIni10msCoorrParlEna EGSDCmn_dmfEgCat1InpParlB1 EGSDCmn_EnaAftIdleFcoFF_I.status EGSDCmn_EnaCatTGrdtParlB1LT_I.memory EGSDCmn_facLamActMonParlB1IK_I.memory EGSDCmn_flgActvHiRngSeg1B1 EGSDCmn_flgActvLoRngSeg1B1 EGSDCmn_flgB1AbortParlEF_I.buffer EGSDCmn_flgB1AbortParlEF_I.oldSignal EGSDCmn_flgB1EgInflParlFF_I.status EGSDCmn_flgB1StartParlER_I.buffer EGSDCmn_flgB1StartParlER_I.oldSignal EGSDCmn_flgCat1B1EnaTHomParl EGSDCmn_flgCat1B1EnaTMinParl EGSDCmn_flgCat1B1EnaTParl EGSDCmn_flgCatWarmAftIdleER_I.buffer EGSDCmn_flgCatWarmAftIdleER_I.oldSignal EGSDCmn_flgCatWarmAftIdleFco EGSDCmn_flgDSMClrParlEnaB1 EGSDCmn_flgEnaEnvCndParl EGSDCmn_flgEnaFuMixAdpnParl EGSDCmn_flgEnaGearShiftParl EGSDCmn_flgEnaGlbParl EGSDCmn_flgEnaGlbPrtlParl EGSDCmn_flgEnaHiRngSeg1B1 EGSDCmn_flgEnaLoRngSeg1B1 EGSDCmn_flgEnaMsTParlB1 EGSDCmn_flgEnaRelLoadParl EGSDCmn_flgEnaVehVParl EGSDCmn_flgFpcAdpdParl EGSDCmn_flgFpcDynDebParl EGSDCmn_flgFpcOKParl EGSDCmn_flgGearShiftParlTONV_I.outbit EGSDCmn_flgGearShiftParlTONV_I.time EGSDCmn_flgInhbRdyParlB1 EGSDCmn_flgInjVlvEnaParlB1 EGSDCmn_flgLamActvParlB1ER_I.buffer EGSDCmn_flgLamActvParlB1ER_I.oldSignal EGSDCmn_flgLamMonSuppParlB1 EGSDCmn_flgLamPriEnaParlB1 EGSDCmn_flgLamReldParlB1 EGSDCmn_flgMfEgEnaRampParl EGSDCmn_flgmPurgCtrlOkParl EGSDCmn_flgNarrowRngSeg1B1 EGSDCmn_flgNEngInRngParl EGSDCmn_flgRdyB1Parl EGSDCmn_flgS1B1OffsDneParl EGSDCmn_flgSeg1B1EnaHeatUp EGSDCmn_flgSeg1B1EnaMfGrdtTONV_I.outbit EGSDCmn_flgSeg1B1EnaMfGrdtTONV_I.time EGSDCmn_flgSeg1B1EnaMfRngHiParl EGSDCmn_flgSeg1B1EnaMfRngLoParl EGSDCmn_flgSeg1B1EnaVldParl EGSDCmn_flgSeg1B1VirtActvRqrdParl EGSDCmn_flgSeg1B1VirtEnaParl EGSDCmn_flgStrtEndParlB1 EGSDCmn_flgTiIdleExcdd EGSDCmn_flgVirtRdyB1Parl EGSDCmn_flgVlvLftActvParlB1 EGSDCmn_InjVlvDisblParlB1TONV_I.outbit EGSDCmn_InjVlvDisblParlB1TONV_I.time EGSDCmn_InjVlvEnaParlB1TOFFV_I.outbit EGSDCmn_InjVlvEnaParlB1TOFFV_I.time EGSDCmn_InjVlvParlB1FF_I.status EGSDCmn_LamMonOKB1EF_I.buffer EGSDCmn_LamMonOKB1EF_I.oldSignal EGSDCmn_LamMonOKEFParlB1CTR_I.counter EGSDCmn_LamReqOKB1TONV_I.outbit EGSDCmn_LamReqOKB1TONV_I.time EGSDCmn_mEgCatWarmAftIdleFcoIK_I.memory EGSDCmn_mEgEnaFpcParlIK_I.memory EGSDCmn_mEgEnaOpDecelParlB1IK_I.memory EGSDCmn_mEgSeg1EnaParlB1IK_I.memory EGSDCmn_mfEgFilCat1ParlB1LT_I.memory EGSDCmn_mfUnderRngLoMinParlDetB1SW_I.timeCounter EGSDCmn_mLamEnaParlB1IK_I.memory EGSDCmn_mSeg1B1SensVldParlIK_I.memory EGSDCmn_nEngOvrIdleTOFFV_I.outbit EGSDCmn_nEngOvrIdleTOFFV_I.time EGSDCmn_rLamDeltaMonParlB1 EGSDCmn_Seg1B1EnaLamCdnFF_I.status EGSDCmn_Seg1B1EnaRngMfHiParl_I.flgEnaRng EGSDCmn_Seg1B1EnaRngMfLoParl_I.flgEnaRng EGSDCmn_Seg1B1EnaRngTHiParl_I.flgEnaRng EGSDCmn_Seg1B1EnaRngTLoParl_I.flgEnaRng EGSDCmn_stEnaGlbPrtlParl EGSDCmn_tGrdtParlB1 EGSDCmn_tiEngIdleSW_I.timeCounter EGSDCmn_tiSeg1EnaTripParlTONV_I.outbit EGSDCmn_tiSeg1EnaTripParlTONV_I.time EGSDCmn_tMinCatRelsParlB1FF_I.status /end LOC_MEASUREMENT
 FUNCTION_VERSION "1.22.0" /end FUNCTION
/begin FUNCTION EGSDCmn_CoorrParlShoTrip "1.5.0     Coordinator of short trip requests for parallelization of active exhaust gas sensor and catalyst diagnosis" /begin DEF_CHARACTERISTIC EGSDCmn_flgShtrpTstOnlyParl_CW /end DEF_CHARACTERISTIC /begin IN_MEASUREMENT SyC_ctPostDrvLeave /end IN_MEASUREMENT
 /begin OUT_MEASUREMENT EGSDCmn_flgInhbProdModParl EGSDCmn_flgProdModParl EGSDCmn_flgRmnProdModParl EGSDCmn_flgShtrpParl /end OUT_MEASUREMENT
 /begin LOC_MEASUREMENT EGSDCmn_ctReIniShoTrip /end LOC_MEASUREMENT
 FUNCTION_VERSION "1.5.0" /end FUNCTION
/begin FUNCTION EGSDCmn_ObdStc "1.13.0    Output statistic data for OBD sensor diagnosis of EGSDia" /begin IN_MEASUREMENT EGSDO2_facMdlFltDeEvlnB1 EGSDO2_facMdlNomDeEvlnB1 /end IN_MEASUREMENT
 /begin OUT_MEASUREMENT EGSDO2_facMdlDeEvlnDiffMaxB1 EGSDO2_facMdlDeEvlnDiffMinB1 EGSDO2_facMdlFltDeEvlnMaxB1 EGSDO2_facMdlNomDeEvlnMaxB1 /end OUT_MEASUREMENT
 FUNCTION_VERSION "1.13.0" /end FUNCTION
/begin FUNCTION EGSDCmn_SigPrepn "1.7.0     Signal preparation of parallelization of active exhaust gas sensor dynamic diagnosis and catalyst diagnosis"
 /begin DEF_CHARACTERISTIC EGSDCmn_nrUGrdt_C EGSDCmn_ratS1OffsLeanParl_C EGSDCmn_ratS1OffsRichParl_C EGSDCmn_tiUInpFltParl_C EGSDCmn_tiUInpFltTWCD_C /end DEF_CHARACTERISTIC
 /begin REF_CHARACTERISTIC EGSDCmn_ratLamLeanParl_C EGSDCmn_ratLamRichParl_C /end REF_CHARACTERISTIC
 /begin IN_MEASUREMENT B_sbblsu_msg ExhMod_dmExhCat1B1 ExhMod_dmExhWoFuUsCat1B1 ExhMod_dmO2Cat1B1 ExhMod_mfO2Cat1B1 ExhMod_tCat1B1 ExhMod_tCat1MaxB1 ExhMod_tCat1MinB1 ExhMod_tExhS2B1 HEGO_bS2B1Vld HEGO_uS2B1WiH2HiRes SyC_stSub UEGO_rLamS1B1 /end IN_MEASUREMENT
 /begin OUT_MEASUREMENT EGSDCmn_dmO2Cat1B1Parl EGSDCmn_dmSeg1B1O2Parl EGSDCmn_dmSeg1B1RichParl EGSDCmn_dmSeg1B1VirtO2Parl EGSDCmn_dmSeg1B1VirtRichParl EGSDCmn_duS2B1Parl EGSDCmn_flgS1B1VldParl EGSDCmn_flgS2B1VldParl EGSDCmn_mfEgCat1B1Parl EGSDCmn_mfO2Cat1B1Parl EGSDCmn_mfSeg1B1O2Parl EGSDCmn_mfSeg1B1RichParl EGSDCmn_mfSeg1B1VirtO2Parl EGSDCmn_mfSeg1B1VirtRichParl EGSDCmn_ratLamActS1B1 EGSDCmn_tCat1B1MaxParl EGSDCmn_tCat1B1MinParl EGSDCmn_tCat1B1Parl EGSDCmn_tCat1B1VirtParl EGSDCmn_tS2B1SensParl EGSDCmn_uS2B1FildParl EGSDCmn_uS2B1FildTWCD /end OUT_MEASUREMENT
 /begin LOC_MEASUREMENT EGSDCmn_idxGrdtAryInp EGSDCmn_idxGrdtAryOutp EGSDCmn_mfEgCat1B1WoFu EGSDCmn_mfEgCat1B1WoFuParl EGSDCmn_S2B1UInpParlLT_I.memory EGSDCmn_S2B1UInpTWCDLT_I.memory EGSDCmn_Seg1B1mfParl_I.mfO2 EGSDCmn_Seg1B1mfParl_I.mfRich EGSDCmn_Seg1B1mfVirtParl_I.mfO2 EGSDCmn_Seg1B1mfVirtParl_I.mfRich EGSDCmn_tiUInpFltParl EGSDCmn_uS2B1Old_a /end LOC_MEASUREMENT
 FUNCTION_VERSION "1.7.0" /end FUNCTION
/begin FUNCTION EGSDO2_Evln "1.5.2     Evaluation of dynamic diagnostics of UEGO sensor based on O2 signal"
 /begin DEF_CHARACTERISTIC EGSDO2_nrMeasShtrp_C EGSDO2_nrMeasTrip_C EGSDO2_tiDlyBpu_C EGSDO2_tiDlyIdnFltThd_C EGSDO2_tiDlyLtrStepFltThdShtrp_C EGSDO2_tiDlyRtlStepFltThdShtrp_C EGSDO2_tiSumIdnFltThd_C EGSDO2_tiTranBpu_C EGSDO2_tiTranIdnFltThd_C EGSDO2_tiTranLtrStepFltThdShtrp_C EGSDO2_tiTranRtlStepFltThdShtrp_C /end DEF_CHARACTERISTIC
 /begin REF_CHARACTERISTIC EGSDO2_nrMeasFltCfm_C EGSDO2_tiDlyLtrStepFltThd_C EGSDO2_tiDlyRtlStepFltThd_C EGSDO2_tiTranLtrStepFltThd_C EGSDO2_tiTranRtlStepFltThd_C /end REF_CHARACTERISTIC
 /begin IN_MEASUREMENT EGSDCmn_flgEnvtlDiPID41Parl EGSDCmn_flgProdModParl EGSDCmn_flgShtrpParl EGSDO2_cntrStepLtrS1B1 EGSDO2_cntrStepLtrTripVirtS1B1 EGSDO2_cntrStepRtlS1B1 EGSDO2_cntrStepRtlTripVirtS1B1 EGSDO2_flgArithFiltg EGSDO2_flgIdnFinshdS1B1 EGSDO2_flgIdnFltSuspcS1B1 EGSDO2_flgLossEvlnDneB1 EGSDO2_flgLtrStepChgS1B1 EGSDO2_flgQlyDeFltSuspcB1 EGSDO2_flgRtlStepChgS1B1 EGSDO2_flgStepLtrEvlnS1B1 EGSDO2_flgStepRtlEvlnS1B1 EGSDO2_flgSymTranOnly EGSDO2_nrMeasLtrTrpS1B1 EGSDO2_nrMeasRtlTrpS1B1 EGSDO2_stStepB1 EGSDO2_tiDlyIdnLtrB1 EGSDO2_tiDlyIdnRtlB1 EGSDO2_tiDlyLtrS1B1 EGSDO2_tiDlyRtlS1B1 EGSDO2_tiTranIdnLtrB1 EGSDO2_tiTranIdnRtlB1 EGSDO2_tiTranLtrS1B1 EGSDO2_tiTranRtlS1B1 SyC_ctPostDrvLeave /end IN_MEASUREMENT
 /begin OUT_MEASUREMENT EGSDO2_flgDSMClrEvlnB1 EGSDO2_flgDynErrSuspcS1B1 EGSDO2_flgDynLtrTripDneS1B1 EGSDO2_flgDynLtrTripDneVirtS1B1 EGSDO2_flgDynRtlTripDneS1B1 EGSDO2_flgDynRtlTripDneVirtS1B1 EGSDO2_flgIdnFltS1B1 EGSDO2_flgLamDynDFCErrB1 EGSDO2_flgLamDynDFCTstdB1 EGSDO2_tiSumIdnLtrS1B1 EGSDO2_tiSumIdnRtlS1B1 /end OUT_MEASUREMENT
 /begin LOC_MEASUREMENT EGSDO2_ctReini100msEvln EGSDO2_DynFltEvlnB1ERNM_I.oldSignal EGSDO2_EvlnNoInhb100msS1B1EFNM_I.oldSignal EGSDO2_flgDlyStepFltLtrB1 EGSDO2_flgDlyStepFltRtlB1 EGSDO2_flgFltEvlnB1 EGSDO2_flgSrv06OutpFltEvlnB1 EGSDO2_flgSrv06OutpHealEvlnB1 EGSDO2_flgStepFltB1 EGSDO2_flgTranStepFltLtrB1 EGSDO2_flgTranStepFltRtlB1 EGSDO2_flgVldEvlnB1 EGSDO2_FltDetnB1_I.cntrStepLtrVirt EGSDO2_FltDetnB1_I.cntrStepRtlVirt EGSDO2_FltDetnB1_I.flgDlyIdnFltLtr EGSDO2_FltDetnB1_I.flgDlyIdnFltRtl EGSDO2_FltDetnB1_I.flgDynLtrDne EGSDO2_FltDetnB1_I.flgDynLtrDneVirt EGSDO2_FltDetnB1_I.flgDynLtrTripDne EGSDO2_FltDetnB1_I.flgDynLtrTripDneVirt EGSDO2_FltDetnB1_I.flgDynRtlDne EGSDO2_FltDetnB1_I.flgDynRtlDneVirt EGSDO2_FltDetnB1_I.flgDynRtlTripDne EGSDO2_FltDetnB1_I.flgDynRtlTripDneVirt EGSDO2_FltDetnB1_I.flgIdnFlt EGSDO2_FltDetnB1_I.flgQckPassdFaildLtr EGSDO2_FltDetnB1_I.flgQckPassdFaildRtl EGSDO2_FltDetnB1_I.flgQckPassdLtr EGSDO2_FltDetnB1_I.flgQckPassdRtl EGSDO2_FltDetnB1_I.flgTranIdnFltLtr EGSDO2_FltDetnB1_I.flgTranIdnFltRtl EGSDO2_FltDetnB1_I.tiDlyIdnLtrFlt EGSDO2_FltDetnB1_I.tiDlyIdnRtlFlt EGSDO2_FltDetnB1_I.tiSumIdnLtr EGSDO2_FltDetnB1_I.tiSumIdnRtl EGSDO2_FltDetnB1_I.tiTranIdnLtrFlt EGSDO2_FltDetnB1_I.tiTranIdnRtlFlt EGSDO2_FltDetnB1_I.LamDynQckPassdDlyLtr_I.flgQckPassdFaild EGSDO2_FltDetnB1_I.LamDynQckPassdDlyRtl_I.flgQckPassdFaild EGSDO2_FltDetnB1_I.LamDynQckPassdTranLtr_I.flgQckPassdFaild EGSDO2_FltDetnB1_I.LamDynQckPassdTranRtl_I.flgQckPassdFaild EGSDO2_FltDetnB1_I.LtrStepChgERNM_I.oldSignal EGSDO2_FltDetnB1_I.RtlStepChgERNM_I.oldSignal EGSDO2_FltDetnB1_I.ShrtrpERNM_I.oldSignal EGSDO2_FltDetnB1_I.cntrStepLtrTripVirtDOS_I.buffer EGSDO2_FltDetnB1_I.cntrStepLtrTripVirtDOS_I.oldValue EGSDO2_FltDetnB1_I.cntrStepRtlTripVirtDOS_I.buffer EGSDO2_FltDetnB1_I.cntrStepRtlTripVirtDOS_I.oldValue /end LOC_MEASUREMENT
 FUNCTION_VERSION "1.5.2" /end FUNCTION
/begin FUNCTION EGSDO2_IdnEna "1.4.0     Enable conditions for the continuous UEGO sensor dynamics identification"
 /begin DEF_CHARACTERISTIC EGSDO2_dmExhEnaIdn_C EGSDO2_dmfExhIdnMax_C EGSDO2_dmfExhIdnMin_C EGSDO2_dmFpcDynEnaMax_C EGSDO2_dratFillgThd_C EGSDO2_flgIdnDurgCatPurg_C EGSDO2_flgIdnDurgParl_CW EGSDO2_flgSeqDyn_C EGSDO2_mFpcDynEnaMin_C EGSDO2_ratFillgMinIdnEna_T EGSDO2_ratLamEnaThd_C EGSDO2_tiEnaIdnMFlow_C EGSDO2_tiFilExhMFlowIdn_C EGSDO2_tiGearShift_C EGSDO2_tiPt1RatFillgEna_C EGSDO2_tiTiConNomEnaIdnShtrp_C EGSDO2_tiTiConNomEnaIdn_C EGSDO2_tiTurnOffExct_C EGSDO2_tiTurnOffIdnLamMon_C EGSDO2_tiTurnOffVlvLft_C EGSDO2_tiTurnOnBpChg_C EGSDO2_tiTurnOnEna_C EGSDO2_tiTurnOnFcoFltSuspc_C EGSDO2_tiTurnOnFco_C EGSDO2_tiTurnOnFillgGrdtFltSuspc_C EGSDO2_tiTurnOnFillgGrdt_C EGSDO2_tiTurnOnFillg_C EGSDO2_tiTurnOnSnsrRdn_C EGSDO2_tiTurnOnStrt_C /end DEF_CHARACTERISTIC
 /begin REF_CHARACTERISTIC EGSDCmn_facFpcAdpnMaxParl_C /end REF_CHARACTERISTIC
 /begin IN_MEASUREMENT B_bevab_msg B_gsch_msg B_lambts_msg B_lrs_msg B_vhegfe_msg EGSDCmn_flgLamMonOkParlB1 EGSDCmn_flgS1B1VldParl EGSDCmn_flgSeg1B1PhyEnaParl EGSDCmn_flgSeg1B1ReldFinalParl EGSDCmn_flgShtrpParl EGSDCmn_mfEgCat1B1Parl EGSDO2_flgBpWideS1B1 EGSDO2_flgIdnFltS1B1 EGSDO2_flgIdnFltSuspcS1B1 EGSDO2_ratLamRecprMdlBpLtrS1B1 EGSDO2_ratLamRecprMdlBpRtlS1B1 EGSDO2_tiDlyIdnLtrB1 EGSDO2_tiDlyIdnRtlB1 EngStrt_bStrtEnd Epm_nEng ftead_w_msg imsteini_msg mstedte_w_msg rl_w_msg TWCC_bEnaRichPurgB1 zlamko_msg zlrslb_w_msg /end IN_MEASUREMENT
 /begin OUT_MEASUREMENT EGSDO2_flgEnaIdnB1 EGSDO2_flgEnaIdnLtrB1 EGSDO2_flgEnaIdnRtlB1 EGSDO2_flgEnaLossB1 /end OUT_MEASUREMENT
 /begin LOC_MEASUREMENT EGSDO2_BpChgB1EBNM_I.oldSignal EGSDO2_BpChgB1TONV_I.outbit EGSDO2_BpChgB1TONV_I.time EGSDO2_DerExhMFlowB1TONV_I.outbit EGSDO2_DerExhMFlowB1TONV_I.time EGSDO2_dmfExhDynB1 EGSDO2_dratFillgAbslt EGSDO2_EnaB1TONV_I.outbit EGSDO2_EnaB1TONV_I.time EGSDO2_EnaIdnLamMonB1TOFFV_I.outbit EGSDO2_EnaIdnLamMonB1TOFFV_I.time EGSDO2_EnaIdnVlvLftTOFFV_I.outbit EGSDO2_EnaIdnVlvLftTOFFV_I.time EGSDO2_EnaSnsrRdnB1TONV_I.outbit EGSDO2_EnaSnsrRdnB1TONV_I.time EGSDO2_ExctLtrB1TOFFV_I.outbit EGSDO2_ExctLtrB1TOFFV_I.time EGSDO2_ExctRtlB1TOFFV_I.outbit EGSDO2_ExctRtlB1TOFFV_I.time EGSDO2_FcoB1TONV_I.outbit EGSDO2_FcoB1TONV_I.time EGSDO2_FillgGrdtTONV_I.outbit EGSDO2_FillgGrdtTONV_I.time EGSDO2_FillgTONV_I.outbit EGSDO2_FillgTONV_I.time EGSDO2_flgEnaCmnIdn EGSDO2_flgEnaCmnPrjUnSpcIdn EGSDO2_flgEnaPrjUnSpcIdnB1 EGSDO2_flgVlvLftEB_I.buffer EGSDO2_flgVlvLftEB_I.oldSignal EGSDO2_mfExhFilB1LT_I.memory EGSDO2_ratFillgPredDt1LT_I.memory EGSDO2_ShiftTONV_I.outbit EGSDO2_ShiftTONV_I.time EGSDO2_StrtTONV_I.outbit EGSDO2_StrtTONV_I.time /end LOC_MEASUREMENT
 FUNCTION_VERSION "1.4.0" /end FUNCTION
/begin COMPU_METHOD B_TRUE "" TAB_VERB "%6.3" "" COMPU_TAB_REF B_TRUE /end COMPU_METHOD
/begin COMPU_VTAB B_TRUE "" TAB_VERB 2 0 "FALSE" 1 "TRUE" /end COMPU_VTAB
/begin COMPU_METHOD CoEOM_idxOperModCfgd_VERB "" TAB_VERB "%6.3" "-" COMPU_TAB_REF CoEOM_idxOperModCfgd_VERB /end COMPU_METHOD
/begin COMPU_VTAB CoEOM_idxOperModCfgd_VERB "" TAB_VERB 4 0 "Base" 1 "WarmUp" 2 "CatHtg" 3 "Start" /end COMPU_VTAB
/begin COMPU_METHOD CoEOM_idxOperModStgTot_VERB "" TAB_VERB "%6.3" "-" COMPU_TAB_REF CoEOM_idxOperModStgTot_VERB /end COMPU_METHOD
/begin COMPU_VTAB CoEOM_idxOperModStgTot_VERB "" TAB_VERB 16 0 "HOM_FullLft" 1 "Stage 1" 2 "Stage 2" 3 "Stage 3" 4 "HOM_EIVC" 5 "Stage 5" 6 "Stage 6" 7 "Stage 7" 8 "Stage 8" 9 "Stage 9" 10 "Stage 10" 11 "Stage 11" 12 "Stage 12" 13 "Stage 13" 14 "Stage 14" 15 "Stage 15" /end COMPU_VTAB
/begin COMPU_METHOD dez "" RAT_FUNC "%6.2" "" COEFFS 0 1 0 0 0 1 /end COMPU_METHOD
/begin COMPU_METHOD EngN "" RAT_FUNC "%6.3" "rpm" COEFFS 0 2 0 0 0 1 /end COMPU_METHOD
/begin COMPU_METHOD EngN_LRes "" RAT_FUNC "%6.1" "rpm" COEFFS 0 0.025 0 0 0 1 /end COMPU_METHOD
/begin COMPU_METHOD EXHMOD_CATPURG_SC_Compu "" TAB_VERB "%6.3" "" COMPU_TAB_REF EXHMOD_CATPURG_SC_Compu /end COMPU_METHOD
/begin COMPU_VTAB EXHMOD_CATPURG_SC_Compu "" TAB_VERB 2 0 "False" 1 "True" /end COMPU_VTAB
/begin COMPU_METHOD EXHMOD_DSQACTVT_SC_Compu "" TAB_VERB "%6.3" "" COMPU_TAB_REF EXHMOD_DSQACTVT_SC_Compu /end COMPU_METHOD
/begin COMPU_VTAB EXHMOD_DSQACTVT_SC_Compu "" TAB_VERB 2 0 "Inactive" 1 "Active" /end COMPU_VTAB
/begin COMPU_METHOD EXHMOD_EGPLSSTRTDEW_SC_Compu "" TAB_VERB "%6.3" "" COMPU_TAB_REF EXHMOD_EGPLSSTRTDEW_SC_Compu /end COMPU_METHOD
/begin COMPU_VTAB EXHMOD_EGPLSSTRTDEW_SC_Compu "" TAB_VERB 2 0 "False" 1 "True" /end COMPU_VTAB
/begin COMPU_METHOD EXHMOD_EGYRELSLSDIAG_SC_Compu "" TAB_VERB "%6.3" "" COMPU_TAB_REF EXHMOD_EGYRELSLSDIAG_SC_Compu /end COMPU_METHOD
/begin COMPU_VTAB EXHMOD_EGYRELSLSDIAG_SC_Compu "" TAB_VERB 2 0 "False" 1 "True" /end COMPU_VTAB
/begin COMPU_METHOD EXHMOD_ENGSTOPPHDO2STR_SC_Compu "" TAB_VERB "%6.3" "" COMPU_TAB_REF EXHMOD_ENGSTOPPHDO2STR_SC_Compu /end COMPU_METHOD
/begin COMPU_VTAB EXHMOD_ENGSTOPPHDO2STR_SC_Compu "" TAB_VERB 2 0 "0" 1 "1" /end COMPU_VTAB
/begin COMPU_METHOD EXHMOD_EXHFLAPCALCN_SC_Compu "" TAB_VERB "%6.3" "" COMPU_TAB_REF EXHMOD_EXHFLAPCALCN_SC_Compu /end COMPU_METHOD
/begin COMPU_VTAB EXHMOD_EXHFLAPCALCN_SC_Compu "" TAB_VERB 2 0 "offset_solution" 1 "factor_solution" /end COMPU_VTAB
/begin COMPU_METHOD EXHMOD_EXO_SC_Compu "" TAB_VERB "%6.3" "" COMPU_TAB_REF EXHMOD_EXO_SC_Compu /end COMPU_METHOD
/begin COMPU_VTAB EXHMOD_EXO_SC_Compu "" TAB_VERB 3 0 "no_state_emission" 1 "state_emission" 2 "only_state_emission" /end COMPU_VTAB
/begin COMPU_METHOD EXHMOD_MFCORRNCATHEATG_SC_Compu "" TAB_VERB "%6.3" "" COMPU_TAB_REF EXHMOD_MFCORRNCATHEATG_SC_Compu /end COMPU_METHOD
/begin COMPU_VTAB EXHMOD_MFCORRNCATHEATG_SC_Compu "" TAB_VERB 2 0 "False" 1 "True" /end COMPU_VTAB
/begin COMPU_METHOD EXHMOD_NRCATB1_SC_Compu "" RAT_FUNC "%6.2" "" COEFFS 0 1 0 0 0 1 /end COMPU_METHOD
/begin COMPU_METHOD EXHMOD_NRCATB2_SC_Compu "" RAT_FUNC "%6.2" "" COEFFS 0 1 0 0 0 1 /end COMPU_METHOD
/begin COMPU_METHOD EXHMOD_NRCATBYP_SC_Compu "" RAT_FUNC "%6.2" "" COEFFS 0 1 0 0 0 1 /end COMPU_METHOD
/begin COMPU_METHOD EXHMOD_NRCATUSS2B1_SC_Compu "" RAT_FUNC "%6.2" "" COEFFS 0 1 0 0 0 1 /end COMPU_METHOD
/begin COMPU_METHOD EXHMOD_NRCATUSS2B2_SC_Compu "" RAT_FUNC "%6.2" "" COEFFS 0 1 0 0 0 1 /end COMPU_METHOD
/begin COMPU_METHOD EXHMOD_NRCATUSS3B1_SC_Compu "" RAT_FUNC "%6.2" "" COEFFS 0 1 0 0 0 1 /end COMPU_METHOD
/begin COMPU_METHOD EXHMOD_NRCATUSS3B2_SC_Compu "" RAT_FUNC "%6.2" "" COEFFS 0 1 0 0 0 1 /end COMPU_METHOD
/begin COMPU_METHOD EXHMOD_NRCATUSS4B1_SC_Compu "" RAT_FUNC "%6.2" "" COEFFS 0 1 0 0 0 1 /end COMPU_METHOD
/begin COMPU_METHOD EXHMOD_NRCATUSS4B2_SC_Compu "" RAT_FUNC "%6.2" "" COEFFS 0 1 0 0 0 1 /end COMPU_METHOD
/begin COMPU_METHOD EXHMOD_NRCATUSYSPLIT_SC_Compu "" RAT_FUNC "%6.2" "" COEFFS 0 1 0 0 0 1 /end COMPU_METHOD
/begin COMPU_METHOD EXHMOD_NREXHFLAP_SC_Compu "" RAT_FUNC "%6.2" "" COEFFS 0 1 0 0 0 1 /end COMPU_METHOD
/begin COMPU_METHOD EXHMOD_NRININSCTN_SC_Compu "" RAT_FUNC "%6.2" "" COEFFS 0 1 0 0 0 1 /end COMPU_METHOD
/begin COMPU_METHOD EXHMOD_NRMAXBRICKB1_SC_Compu "" RAT_FUNC "%6.2" "" COEFFS 0 1 0 0 0 1 /end COMPU_METHOD
/begin COMPU_METHOD EXHMOD_NRMAXBRICKB2_SC_Compu "" RAT_FUNC "%6.2" "" COEFFS 0 1 0 0 0 1 /end COMPU_METHOD
/begin COMPU_METHOD EXHMOD_NRMAXPIPB1_SC_Compu "" RAT_FUNC "%6.2" "" COEFFS 0 1 0 0 0 1 /end COMPU_METHOD
/begin COMPU_METHOD fak_q0p000244 "" RAT_FUNC "%6.5" "-" COEFFS 0 65536 0 0 0 16 /end COMPU_METHOD
/begin COMPU_METHOD fak_q2p3283Em10 "" RAT_FUNC "%12.11" "-" COEFFS 0 4294967296 0 0 0 1 /end COMPU_METHOD
/begin COMPU_METHOD fak_q3p0518Em5 "" RAT_FUNC "%7.6" "" COEFFS 0 32768 0 0 0 1 /end COMPU_METHOD
/begin COMPU_METHOD fak_sw_b64 "" RAT_FUNC "%6.4" "-" COEFFS 0 65536 0 0 0 128 /end COMPU_METHOD
/begin COMPU_METHOD fak_ub_b2 "" RAT_FUNC "%8.5" "-" COEFFS 0 256 0 0 0 2 /end COMPU_METHOD
/begin COMPU_METHOD fak_uw_b128 "" RAT_FUNC "%6.4" "-" COEFFS 0 65536 0 0 0 128 /end COMPU_METHOD
/begin COMPU_METHOD fak_uw_b16 "" RAT_FUNC "%6.5" "-" COEFFS 0 65536 0 0 0 16 /end COMPU_METHOD
/begin COMPU_METHOD fak_uw_b2 "" RAT_FUNC "%7.6" "-" COEFFS 0 65536 0 0 0 2 /end COMPU_METHOD
/begin COMPU_METHOD fak_uw_b4 "" RAT_FUNC "%7.6" "-" COEFFS 0 65536 0 0 0 4 /end COMPU_METHOD
/begin COMPU_METHOD k10ms_uw_b100 "" RAT_FUNC "%6.4" "1/s" COEFFS 0 65536 0 0 0 100 /end COMPU_METHOD
/begin COMPU_METHOD md_q1p526Em6 "" RAT_FUNC "%8.7" "Nm" COEFFS 0 65536 0 0 0 0.1 /end COMPU_METHOD
/begin COMPU_METHOD mgrad_q1_mgdivs "" RAT_FUNC "%6.2" "mg/s" COEFFS 0 1 0 0 0 1 /end COMPU_METHOD
/begin COMPU_METHOD m_q0p001_kg "" RAT_FUNC "%6.5" "kg" COEFFS 0 1000 0 0 0 1 /end COMPU_METHOD
/begin COMPU_METHOD m_q0p1 "" RAT_FUNC "%6.3" "kg/h" COEFFS 0 10 0 0 0 1 /end COMPU_METHOD
/begin COMPU_METHOD m_q0p1_mgs "" RAT_FUNC "%6.3" "mg/s" COEFFS 0 1 0 0 0 0.1 /end COMPU_METHOD
/begin COMPU_METHOD m_q1p5259Em8_kg "" RAT_FUNC "%10.9" "kg" COEFFS 0 65536000 0 0 0 1 /end COMPU_METHOD
/begin COMPU_METHOD m_q1p526Em6_g "" RAT_FUNC "%8.7" "g" COEFFS 0 655360 0 0 0 1 /end COMPU_METHOD
/begin COMPU_METHOD m_sw_b3276p8 "" RAT_FUNC "%6.3" "kg/h" COEFFS 0 1 0 0 0 0.1 /end COMPU_METHOD
/begin COMPU_METHOD m_ub_q0p0444 "" RAT_FUNC "%6.4" "g" COEFFS 0 1 0 0 0 0.0444 /end COMPU_METHOD
/begin COMPU_METHOD m_uw_b25p6 "" RAT_FUNC "%6.5" "kg/h" COEFFS 0 65536 0 0 0 25.6 /end COMPU_METHOD
/begin COMPU_METHOD m_uw_b6553p5 "" RAT_FUNC "%6.3" "kg/h" COEFFS 0 1 0 0 0 0.1 /end COMPU_METHOD
/begin COMPU_METHOD nmot_ub_q40 "" RAT_FUNC "%6.1" "1/min" COEFFS 0 1 0 0 0 40 /end COMPU_METHOD
/begin COMPU_METHOD OneToOne "" RAT_FUNC "%6.2" "-" COEFFS 0 1 0 0 0 1 /end COMPU_METHOD
/begin COMPU_METHOD p_q1 "" RAT_FUNC "%6.2" "hPa" COEFFS 0 1 0 0 0 1 /end COMPU_METHOD
/begin COMPU_METHOD RBPtCel_du_7p62939em4_1 "" RAT_FUNC "%6.5" "V/s" COEFFS 0 65536 0 0 0 50 /end COMPU_METHOD
/begin COMPU_METHOD rel_q0p0234 "" RAT_FUNC "%6.4" "%" COEFFS 0 128 0 0 0 3 /end COMPU_METHOD
/begin COMPU_METHOD rel_q3p5763Em7 "" RAT_FUNC "%9.8" "%" COEFFS 0 2097152 0 0 0 0.75 /end COMPU_METHOD
/begin COMPU_METHOD rel_uw_q0p0234 "" RAT_FUNC "%6.4" "%" COEFFS 0 32 0 0 0 0.75 /end COMPU_METHOD
/begin COMPU_METHOD spg_q1p221Em3_V "" RAT_FUNC "%6.4" "V" COEFFS 0 65536 0 0 0 80 /end COMPU_METHOD
/begin COMPU_METHOD spg_q1p8626Em8_V "" RAT_FUNC "%10.9" "V" COEFFS 0 268435456 0 0 0 5 /end COMPU_METHOD
/begin COMPU_METHOD Temp_Cels "" RAT_FUNC "%6.1" "deg C" COEFFS 0 10 2731.4 0 0 1 /end COMPU_METHOD
/begin COMPU_METHOD temp_q0p0234 "" RAT_FUNC "%6.4" "K" COEFFS 0 256 0 0 0 6 /end COMPU_METHOD
/begin COMPU_METHOD temp_q0p0234_o273 "" RAT_FUNC "%6.1" "Grad C" COEFFS 0 1 273.15 0 0 0.0234375 /end COMPU_METHOD
/begin COMPU_METHOD temp_q0p1 "" RAT_FUNC "%6.3" "Grad C" COEFFS 0 10 0 0 0 1 /end COMPU_METHOD
/begin COMPU_METHOD temp_q3p57Em7_om273 "" RAT_FUNC "%6.1" "Grad C" COEFFS 0 8388608 2291348275.2 0 0 3 /end COMPU_METHOD
/begin COMPU_METHOD temp_ub_q0p75_o48 "" RAT_FUNC "%6.2" "Grad C" COEFFS 0 1 48 0 0 0.75 /end COMPU_METHOD
/begin COMPU_METHOD trq_q0p1 "" RAT_FUNC "%6.3" "Nm" COEFFS 0 10 0 0 0 1 /end COMPU_METHOD
/begin COMPU_METHOD t_q0p01 "" RAT_FUNC "%6.4" "s" COEFFS 0 100 0 0 0 1 /end COMPU_METHOD
/begin COMPU_METHOD t_q0p1 "" RAT_FUNC "%6.3" "s" COEFFS 0 10 0 0 0 1 /end COMPU_METHOD
/begin COMPU_METHOD Vel "" RAT_FUNC "%6.4" "km/h" COEFFS 0 100 0 0 0 1 /end COMPU_METHOD
/begin COMPU_METHOD zk100msxs_ub_b25p6 "" RAT_FUNC "%6.3" "s" COEFFS 0 0 256 0 10 0 /end COMPU_METHOD
/begin COMPU_METHOD zk100msxs_uw_b6553p6 "" RAT_FUNC "%6.1" "s" COEFFS 0 0 65536 0 10 0 /end COMPU_METHOD
/begin COMPU_METHOD zk10msxs_uw_b655 "" RAT_FUNC "%6.2" "s" COEFFS 0 0 65536 0 100 0 /end COMPU_METHOD
/begin COMPU_METHOD zk10msxs_uw_b655p36 "" RAT_FUNC "%6.2" "s" COEFFS 0 0 65536 0 100 0 /end COMPU_METHOD
/begin RECORD_LAYOUT RB_Curve_S16_U16_Static NO_AXIS_PTS_X 1 SWORD AXIS_PTS_X 2 SWORD INDEX_INCR DIRECT FNC_VALUES 3 UWORD COLUMN_DIR DIRECT STATIC_RECORD_LAYOUT /end RECORD_LAYOUT
/begin RECORD_LAYOUT RB_Curve_U8_U16_Static NO_AXIS_PTS_X 1 UBYTE AXIS_PTS_X 2 UBYTE INDEX_INCR DIRECT FNC_VALUES 3 UWORD COLUMN_DIR DIRECT STATIC_RECORD_LAYOUT /end RECORD_LAYOUT
/begin RECORD_LAYOUT RB_Map_S16S16_U16 NO_AXIS_PTS_X 1 SWORD NO_AXIS_PTS_Y 2 SWORD AXIS_PTS_X 3 SWORD INDEX_INCR DIRECT AXIS_PTS_Y 4 SWORD INDEX_INCR DIRECT FNC_VALUES 5 UWORD COLUMN_DIR DIRECT /end RECORD_LAYOUT
/begin RECORD_LAYOUT RB_Map_U8U8_U8 NO_AXIS_PTS_X 1 UBYTE NO_AXIS_PTS_Y 2 UBYTE AXIS_PTS_X 3 UBYTE INDEX_INCR DIRECT AXIS_PTS_Y 4 UBYTE INDEX_INCR DIRECT FNC_VALUES 5 UBYTE COLUMN_DIR DIRECT /end RECORD_LAYOUT
/begin RECORD_LAYOUT RB_Val_Ws16 FNC_VALUES 1 SWORD COLUMN_DIR DIRECT /end RECORD_LAYOUT
/begin RECORD_LAYOUT RB_Val_Wu16 FNC_VALUES 1 UWORD COLUMN_DIR DIRECT /end RECORD_LAYOUT
/begin RECORD_LAYOUT RB_Val_Wu32 FNC_VALUES 1 ULONG COLUMN_DIR DIRECT /end RECORD_LAYOUT
/begin RECORD_LAYOUT RB_Val_Wu8 FNC_VALUES 1 UBYTE COLUMN_DIR DIRECT /end RECORD_LAYOUT
/end MODULE
/end PROJECT
