ASAP2_VERSION 1 60
/begin PROJECT MG1CA020 "MG1CA020"
/begin HEADER "" VERSION "MG1CA020_6SAY_V011_TPROT" PROJECT_NO MG1CA020 /end HEADER
/begin MODULE DIM ""
/begin MOD_COMMON "" BYTE_ORDER MSB_LAST ALIGNMENT_BYTE 1 ALIGNMENT_WORD 2 ALIGNMENT_LONG 4 ALIGNMENT_INT64 4 ALIGNMENT_FLOAT32_IEEE 4 ALIGNMENT_FLOAT64_IEEE 4 DATA_SIZE 32 /end MOD_COMMON
/begin CHARACTERISTIC ATISLATX "threshold number of injection to switch from lambda afterstart to lambda warm-up" CURVE 0x80527656 RB_Curve_U8_U16_Static 65535.00 dez 0.00 65535.00 FORMAT "%8.2"
 /begin AXIS_DESCR STD_AXIS tmstlanswl temp_ub_q0p75_o48 12 -48.0 143.3 FORMAT "%5.1" DEPOSIT ABSOLUTE /end AXIS_DESCR
/end CHARACTERISTIC
/begin CHARACTERISTIC ATIWKSTX "threshold number of injection to switch from lambda afterstart to lambda warm-up at cold restart" CURVE 0x8052767C RB_Curve_U8_U16_Static 65535.00 dez 0.00 65535.00 FORMAT "%8.2"
 /begin AXIS_DESCR STD_AXIS tmstlanswl temp_ub_q0p75_o48 12 -48.0 143.3 FORMAT "%5.1" DEPOSIT ABSOLUTE /end AXIS_DESCR
/end CHARACTERISTIC
/begin CHARACTERISTIC Com_tiLINShtDwnDlyReq_C "calibration for LIN node0 and node 1 shut down delay" VALUE 0x8052F6B6 RB_Val_Ws16 327670.0 Time_ms 0.00 327670.0 FORMAT "%8.1" EXTENDED_LIMITS -327680.0 327670.0 /end CHARACTERISTIC
/begin CHARACTERISTIC CWKRLZFK "code word: knock detection is not disabled for guided cylinders" VALUE 0x80526D3E RB_Val_Wu8 1.000 dez 0.00 1.000 FORMAT "%5.3" EXTENDED_LIMITS 0.00 255.0 /end CHARACTERISTIC
/begin CHARACTERISTIC CWKRLZOFV "Code word :activate ignition angle and offset of guiding cylinder in steeps" VALUE 0x80526D3F RB_Val_Wu8 255.0 dez 0.00 255.0 FORMAT "%5.1" /end CHARACTERISTIC
/begin CHARACTERISTIC CWKROFFGZ "Code word for offset of guided cylinders" VALUE 0x80526D40 RB_Val_Wu8 255.0 dez 0.00 255.0 FORMAT "%5.1" /end CHARACTERISTIC
/begin CHARACTERISTIC CWKRREF "code word: characteristic of rkr follow-up at speed dynamics" VALUE 0x805269C0 RB_Val_Wu8 255.0 dez 0.00 255.0 FORMAT "%5.1" /end CHARACTERISTIC
/begin CHARACTERISTIC CWLAMKO "Codeword Lambda Co-ordination" VALUE 0x805275AA RB_Val_Wu8 255.0 dez 0.00 255.0 FORMAT "%5.1" /end CHARACTERISTIC
/begin CHARACTERISTIC CWLAMKOAP "Codeword for options for calibration purposes in the function LAMKO (LAMKO: lambda setpoint coordination)" VALUE 0x805275AB RB_Val_Wu8 255.0 dez 0.00 255.0 FORMAT "%5.1" /end CHARACTERISTIC
/begin CHARACTERISTIC CWREFI "code word: reinitialize of rkr with REFINI at dynamics conditions" VALUE 0x805269C1 RB_Val_Wu8 255.0 dez 0.00 255.0 FORMAT "%5.1" /end CHARACTERISTIC
/begin CHARACTERISTIC CWVFN "Codeword for the variable step width of advancing of the ignition angle" VALUE 0x80526D41 RB_Val_Wu8 1.000 dez 0.00 1.000 FORMAT "%5.3" EXTENDED_LIMITS 0.00 255.0 /end CHARACTERISTIC
/begin CHARACTERISTIC CWWL "code word for warm-up control" VALUE 0x805276A2 RB_Val_Wu8 255.0 dez 0.00 255.0 FORMAT "%5.1" /end CHARACTERISTIC
/begin CHARACTERISTIC DLAMNSWL "max. deviation for lambda afterstart-warmup to switch on Lambda warmup" VALUE 0x805276A3 RB_Val_Wu8 0.9961 fak_ub_b1 0.00 0.9961 /end CHARACTERISTIC
/begin CHARACTERISTIC EngStrt_facLamAftStrtLoP_M "Factor for lambda during after start" MAP 0x805276A4 RB_Map_U8U16_U16 15.99976 fak_uw_b16 0.00 15.99976 FORMAT "%8.5"
 /begin AXIS_DESCR STD_AXIS tmstlanswl temp_ub_q0p75_o48 12 -48.0 143.3 FORMAT "%5.1" DEPOSIT ABSOLUTE /end AXIS_DESCR
 /begin AXIS_DESCR STD_AXIS anztib1_w_Loc dez 12 0.00 65535.00 FORMAT "%8.2" DEPOSIT ABSOLUTE /end AXIS_DESCR
/end CHARACTERISTIC
/begin CHARACTERISTIC ExhMgT_ratLamCatHeatgIdleMod_M "Performance characteristics lambda engine nominal at catalyst heating when vehicle is idling" MAP 0x805272DE RB_Map_S16U16_U16 8.000000 fak_q0p000244 0.00 8.000000 FORMAT "%8.6" EXTENDED_LIMITS 0.00 15.99976
 /begin AXIS_DESCR STD_AXIS Epm_nEng EngN 8 -16384.00 16383.50 FORMAT "%8.2" DEPOSIT ABSOLUTE /end AXIS_DESCR
 /begin AXIS_DESCR STD_AXIS AirMod_ratChrgAirCyl rel_uw_q0p0234 8 0.00 1535.977 FORMAT "%8.3" DEPOSIT ABSOLUTE /end AXIS_DESCR
/end CHARACTERISTIC
/begin CHARACTERISTIC ExhMgT_ratLamCatHeatgStrt_M "map lambda engine request at catalyst heating during afterstart (gasoline)" MAP 0x80527382 RB_Map_S16U16_U16 8.000000 fak_q0p000244 0.00 8.000000 FORMAT "%8.6" EXTENDED_LIMITS 0.00 15.99976
 /begin AXIS_DESCR STD_AXIS tmstcyla_w Temp_Cels 12 -3549.940 3003.560 FORMAT "%8.3" DEPOSIT ABSOLUTE /end AXIS_DESCR
 /begin AXIS_DESCR STD_AXIS anztib_w_msg dez 12 0.00 65535.00 FORMAT "%8.2" DEPOSIT ABSOLUTE /end AXIS_DESCR
/end CHARACTERISTIC
/begin CHARACTERISTIC ExhMgT_stCatHeatgLam2_C "second Codeword for the lambda for catalyst heating function" VALUE 0x805274D6 RB_Val_Wu16 65535.00 dez 0.00 65535.00 FORMAT "%8.2" /end CHARACTERISTIC
/begin CHARACTERISTIC ExhMgT_stCatHeatgLam3_C "third Codeword for the lambda for catalyst heating function" VALUE 0x805274D8 RB_Val_Wu16 65535.00 dez 0.00 65535.00 FORMAT "%8.2" /end CHARACTERISTIC
/begin CHARACTERISTIC ExhMgT_stCatHeatgLam_C "Codeword for the lambda for catalyst heating function" VALUE 0x805274DA RB_Val_Wu8 255.0 dez 0.00 255.0 FORMAT "%5.1" /end CHARACTERISTIC
/begin CHARACTERISTIC ExhMgT_stLamCoornExhMngt_C "Code word for the function lambda co-ordinator for exhaust temperature management" VALUE 0x805275A8 RB_Val_Wu8 255.0 dez 0.00 255.0 FORMAT "%5.1" /end CHARACTERISTIC
/begin CHARACTERISTIC ExhMgt_tiCatHeatgLamIdle_C "time constant for the calculation of Idle lambda during catalyst heating" VALUE 0x805274DB RB_Val_Wu8 25.4996 zk100msxs_ub_b25p5 0.1004 25.6000 FORMAT "%7.4" EXTENDED_LIMITS 0.100392 25.6000 /end CHARACTERISTIC
/begin CHARACTERISTIC ExhMgt_tiCatHeatgLamPartLoad_C "time constant for the transition factor of idle part load of the nominal engine lambda" VALUE 0x805274DC RB_Val_Wu8 25.4996 zk100msxs_ub_b25p5 0.1004 25.6000 FORMAT "%7.4" EXTENDED_LIMITS 0.100392 25.6000 /end CHARACTERISTIC
/begin CHARACTERISTIC ExhMgT_tiLamCatHeatgStrt_C "filter time constant for engine lambda request at catalyst heating during afterstart" VALUE 0x805274DE RB_Val_Wu16 655.3400 t_q0p01 0.0100 655.3500 FORMAT "%8.4" EXTENDED_LIMITS 0.00 655.3500 /end CHARACTERISTIC
/begin CHARACTERISTIC FKEFMC "correction factor for knock detection thresh. in case of change of filter frequ." VALUE 0x805269C2 RB_Val_Wu8 1.938 fak_ub_b16 0.063 2.000 FORMAT "%5.3" EXTENDED_LIMITS 0.00 15.94 /end CHARACTERISTIC
/begin CHARACTERISTIC IKCtl_agKnkRtdt_M "retard step knock occurrence(fine resolution)" MAP 0x80526D42 RB_Map_S16U8_S16 6.000000 zw_q0p1 -6.000000 0.00 FORMAT "%8.6" EXTENDED_LIMITS -3276.800 3276.700
 /begin AXIS_DESCR STD_AXIS Epm_nEng EngN 8 -16384.00 16383.50 FORMAT "%8.2" DEPOSIT ABSOLUTE /end AXIS_DESCR
 /begin AXIS_DESCR STD_AXIS IKCtl_facKnkInten_u8 fak_ub_b16 4 0.00 15.94 FORMAT "%5.2" DEPOSIT ABSOLUTE /end AXIS_DESCR
/end CHARACTERISTIC
/begin CHARACTERISTIC IKCtl_agLimnAdpnLoadDyn_M "map for limitation by adaption read dependent on load dynamics" MAP 0x80526D9A RB_Map_U16S8_S16 3276.800 zw_q0p1 -3276.800 0.00 FORMAT "%8.3" EXTENDED_LIMITS -3276.800 3276.700
 /begin AXIS_DESCR STD_AXIS AirMod_ratChrgAirCyl rel_uw_q0p0234 4 0.00 1535.977 FORMAT "%8.3" DEPOSIT ABSOLUTE /end AXIS_DESCR
 /begin AXIS_DESCR STD_AXIS IKCtl_pPfiSp p_q10 4 -1280. 1270. FORMAT "%5.0" DEPOSIT ABSOLUTE /end AXIS_DESCR
/end CHARACTERISTIC
/begin CHARACTERISTIC IKCtl_agLimnAdpnPosDeLoadDyn_M "Map for the limitation of adaption values in case of positive change and load dynamic" MAP 0x80526DCA RB_Map_U16S8_S16 3276.700 zw_q0p1 0.00 3276.700 FORMAT "%8.3" EXTENDED_LIMITS -3276.800 3276.700
 /begin AXIS_DESCR STD_AXIS AirMod_ratChrgAirCyl rel_uw_q0p0234 4 0.00 1535.977 FORMAT "%8.3" DEPOSIT ABSOLUTE /end AXIS_DESCR
 /begin AXIS_DESCR STD_AXIS IKCtl_pPfiSp p_q10 4 -1280. 1270. FORMAT "%5.0" DEPOSIT ABSOLUTE /end AXIS_DESCR
/end CHARACTERISTIC
/begin CHARACTERISTIC IKCtl_agLimnAdpnPosDeSpdDyn_M "map for limitation of adaption values in case of positive change and speed dynamic" MAP 0x80526DFA RB_Map_S16S8_S16 3276.700 zw_q0p1 0.00 3276.700 FORMAT "%8.3" EXTENDED_LIMITS -3276.800 3276.700
 /begin AXIS_DESCR STD_AXIS Epm_nEng EngN 4 -16384.00 16383.50 FORMAT "%8.2" DEPOSIT ABSOLUTE /end AXIS_DESCR
 /begin AXIS_DESCR STD_AXIS IKCtl_nFildGrad_s8 nmotg_sb_q100 6 -12800. 12700. FORMAT "%5.0" DEPOSIT ABSOLUTE /end AXIS_DESCR
/end CHARACTERISTIC
/begin CHARACTERISTIC IKCtl_agLimnAdpnSpdDyn_M "Map for limitation reading of adaption depending on engine speed dynamics" MAP 0x80526E3C RB_Map_S16S8_S16 3276.800 zw_q0p1 -3276.800 0.00 FORMAT "%8.3" EXTENDED_LIMITS -3276.800 3276.700
 /begin AXIS_DESCR STD_AXIS Epm_nEng EngN 4 -16384.00 16383.50 FORMAT "%8.2" DEPOSIT ABSOLUTE /end AXIS_DESCR
 /begin AXIS_DESCR STD_AXIS IKCtl_nFildGrad_s8 nmotg_sb_q100 6 -12800. 12700. FORMAT "%5.0" DEPOSIT ABSOLUTE /end AXIS_DESCR
/end CHARACTERISTIC
/begin CHARACTERISTIC IKCtl_agLowrDistRtdt_GT "knock control: low delta ignition angle distance from mean retarding(fine resolution)" CURVE 0x80526E7E RB_CurveGroup_S16 20.50000 zw_q0p1 -20.50000 0.00 FORMAT "%8.5" EXTENDED_LIMITS -3276.800 3276.700
 /begin AXIS_DESCR COM_AXIS Epm_nEng EngN 8 -16384.00 16383.50 FORMAT "%8.2" AXIS_PTS_REF IKCtl_nEng08_X_AX /end AXIS_DESCR
/end CHARACTERISTIC
/begin CHARACTERISTIC IKCtl_agMaxRtdtCurr_M "Maximum retardation(fine resolution)" MAP 0x80526E8E RB_Map_S16S16_S16 20.50000 zw_q0p1 -20.50000 0.00 FORMAT "%8.5" EXTENDED_LIMITS -3276.800 3276.700
 /begin AXIS_DESCR STD_AXIS Epm_nEng EngN 8 -16384.00 16383.50 FORMAT "%8.2" DEPOSIT ABSOLUTE /end AXIS_DESCR
 /begin AXIS_DESCR STD_AXIS IKCtl_tEngLoc_s16 Temp_Cels 8 -3549.940 3003.560 FORMAT "%8.3" DEPOSIT ABSOLUTE /end AXIS_DESCR
/end CHARACTERISTIC
/begin CHARACTERISTIC IKCtl_agUpprDistRtdt_GT "high delta ignition angle distance from mean retarding(fine resolution)" CURVE 0x80526F32 RB_CurveGroup_S16 20.50000 zw_q0p1 0.00 20.50000 FORMAT "%8.5" EXTENDED_LIMITS -3276.800 3276.700
 /begin AXIS_DESCR COM_AXIS Epm_nEng EngN 8 -16384.00 16383.50 FORMAT "%8.2" AXIS_PTS_REF IKCtl_nEng08_X_AX /end AXIS_DESCR
/end CHARACTERISTIC
/begin CHARACTERISTIC IKCtl_facCorrnLoadDyn_GT "correction factor for knock detection threshold during load dynamics" CURVE 0x805269C3 RB_CurveGroup_U8 1.938 fak_ub_b16 0.063 2.000 FORMAT "%5.3" EXTENDED_LIMITS 0.00 15.94
 /begin AXIS_DESCR COM_AXIS Epm_nEng EngN 13 -16384.00 16383.50 FORMAT "%8.2" AXIS_PTS_REF IKCtl_nEngVar13_X_AX /end AXIS_DESCR
/end CHARACTERISTIC
/begin CHARACTERISTIC IKCtl_facCorrnNDyn_GT "correction factor for knock detection threshold with engine-speed dynamics" CURVE 0x805269D0 RB_CurveGroup_U8 1.938 fak_ub_b16 0.063 2.000 FORMAT "%5.3" EXTENDED_LIMITS 0.00 15.94
 /begin AXIS_DESCR COM_AXIS Epm_nEng EngN 13 -16384.00 16383.50 FORMAT "%8.2" AXIS_PTS_REF IKCtl_nEngVar13_X_AX /end AXIS_DESCR
/end CHARACTERISTIC
/begin CHARACTERISTIC IKCtl_FacKnockDetThd0_GM "Knock-detection factor characteristic map cylinder counter 0" MAP 0x805269DD RB_MapGroup_U8 4.438 fak_ub_b16 0.063 4.500 FORMAT "%5.3" EXTENDED_LIMITS 0.00 15.94
 /begin AXIS_DESCR COM_AXIS Epm_nEng EngN 13 -16384.00 16383.50 FORMAT "%8.2" AXIS_PTS_REF IKCtl_nEngVar13_X_AX /end AXIS_DESCR
 /begin AXIS_DESCR COM_AXIS AirMod_ratChrgAirCyl rel_uw_q0p0234 4 0.00 1535.977 FORMAT "%8.3" AXIS_PTS_REF IKCtl_ratLoad04_X_AX /end AXIS_DESCR
/end CHARACTERISTIC
/begin CHARACTERISTIC IKCtl_FacKnockDetThd1_GM "Knock-detection factor characteristic map cylinder counter 1" MAP 0x80526A11 RB_MapGroup_U8 4.438 fak_ub_b16 0.063 4.500 FORMAT "%5.3" EXTENDED_LIMITS 0.00 15.94
 /begin AXIS_DESCR COM_AXIS Epm_nEng EngN 13 -16384.00 16383.50 FORMAT "%8.2" AXIS_PTS_REF IKCtl_nEngVar13_X_AX /end AXIS_DESCR
 /begin AXIS_DESCR COM_AXIS AirMod_ratChrgAirCyl rel_uw_q0p0234 4 0.00 1535.977 FORMAT "%8.3" AXIS_PTS_REF IKCtl_ratLoad04_X_AX /end AXIS_DESCR
/end CHARACTERISTIC
/begin CHARACTERISTIC IKCtl_FacKnockDetThd2_GM "Knock-detection factor characteristic map cylinder counter 2" MAP 0x80526A45 RB_MapGroup_U8 4.438 fak_ub_b16 0.063 4.500 FORMAT "%5.3" EXTENDED_LIMITS 0.00 15.94
 /begin AXIS_DESCR COM_AXIS Epm_nEng EngN 13 -16384.00 16383.50 FORMAT "%8.2" AXIS_PTS_REF IKCtl_nEngVar13_X_AX /end AXIS_DESCR
 /begin AXIS_DESCR COM_AXIS AirMod_ratChrgAirCyl rel_uw_q0p0234 4 0.00 1535.977 FORMAT "%8.3" AXIS_PTS_REF IKCtl_ratLoad04_X_AX /end AXIS_DESCR
/end CHARACTERISTIC
/begin CHARACTERISTIC IKCtl_FacKnockDetThd3_GM "Knock-detection factor characteristic map cylinder counter 3" MAP 0x80526A79 RB_MapGroup_U8 4.438 fak_ub_b16 0.063 4.500 FORMAT "%5.3" EXTENDED_LIMITS 0.00 15.94
 /begin AXIS_DESCR COM_AXIS Epm_nEng EngN 13 -16384.00 16383.50 FORMAT "%8.2" AXIS_PTS_REF IKCtl_nEngVar13_X_AX /end AXIS_DESCR
 /begin AXIS_DESCR COM_AXIS AirMod_ratChrgAirCyl rel_uw_q0p0234 4 0.00 1535.977 FORMAT "%8.3" AXIS_PTS_REF IKCtl_ratLoad04_X_AX /end AXIS_DESCR
/end CHARACTERISTIC
/begin CHARACTERISTIC IKCtl_FacKnockTrck_AX "Lowpass follow-up factor for stationary operation" MAP 0x80526AAE RB_Map_S8U8_U8 28.00 dez 4.00 32.00 FORMAT "%5.2" EXTENDED_LIMITS 0.00 255.0
 /begin AXIS_DESCR STD_AXIS IKCtl_nFildGrad_s8 nmotg_sb_q100 6 -12800. 12700. FORMAT "%5.0" DEPOSIT ABSOLUTE /end AXIS_DESCR
 /begin AXIS_DESCR STD_AXIS Epm_nEngLRes nmot_ub_q40 4 0.00 10200. FORMAT "%5.0" DEPOSIT ABSOLUTE /end AXIS_DESCR
/end CHARACTERISTIC
/begin CHARACTERISTIC IKCtl_facMaxLpFilKnkDetn_T "curve for limitation of pressure value for reference calculation in case of knocking" CURVE 0x80526AD2 RB_Curve_S16_U8_Static 14.94 fak_ub_b16 1.00 15.94 FORMAT "%5.2" EXTENDED_LIMITS 0.00 15.94
 /begin AXIS_DESCR STD_AXIS Epm_nEng EngN 13 -16384.00 16383.50 FORMAT "%8.2" DEPOSIT ABSOLUTE /end AXIS_DESCR
/end CHARACTERISTIC
/begin CHARACTERISTIC IKCtl_facMaxRtdtHiVlvLft_M "Correction factor for maximum retardation during high valve timing" MAP 0x80526F42 RB_Map_S16U16_U8 1.000 fak_ub_b16 0.00 1.000 FORMAT "%5.3" EXTENDED_LIMITS 0.00 15.94
 /begin AXIS_DESCR STD_AXIS Epm_nEng EngN 8 -16384.00 16383.50 FORMAT "%8.2" DEPOSIT ABSOLUTE /end AXIS_DESCR
 /begin AXIS_DESCR STD_AXIS AirMod_ratChrgAirCyl rel_uw_q0p0234 8 0.00 1535.977 FORMAT "%8.3" DEPOSIT ABSOLUTE /end AXIS_DESCR
/end CHARACTERISTIC
/begin CHARACTERISTIC IKCtl_facMaxRtdtLoVlvLft_M "Correction factor for maximum retardation during low valve timing" MAP 0x80526FA6 RB_Map_S16U16_U8 1.000 fak_ub_b16 0.00 1.000 FORMAT "%5.3" EXTENDED_LIMITS 0.00 15.94
 /begin AXIS_DESCR STD_AXIS Epm_nEng EngN 8 -16384.00 16383.50 FORMAT "%8.2" DEPOSIT ABSOLUTE /end AXIS_DESCR
 /begin AXIS_DESCR STD_AXIS AirMod_ratChrgAirCyl rel_uw_q0p0234 8 0.00 1535.977 FORMAT "%8.3" DEPOSIT ABSOLUTE /end AXIS_DESCR
/end CHARACTERISTIC
/begin CHARACTERISTIC IKCtl_facOffsGdCyl_M "Correction factor for offset map" MAP 0x80526B74 RB_Map_S16U16_U8 1.992 fak_ub_q7p8125Em3 0.00 1.992 FORMAT "%5.3"
 /begin AXIS_DESCR STD_AXIS Epm_nEng EngN 12 -16384.00 16383.50 FORMAT "%8.2" DEPOSIT ABSOLUTE /end AXIS_DESCR
 /begin AXIS_DESCR STD_AXIS AirMod_ratChrgAirCyl rel_uw_q0p0234 12 0.00 1535.977 FORMAT "%8.3" DEPOSIT ABSOLUTE /end AXIS_DESCR
/end CHARACTERISTIC
/begin CHARACTERISTIC IKCtl_facRefLvlReIni_C "factor to reinitialize the reference level." VALUE 0x80526AFC RB_Val_Wu32 3276.79999924 spg_q7p629Em7_V_ms 0.00 3276.79999924 FORMAT "%13.8" /end CHARACTERISTIC
/begin CHARACTERISTIC IKCtl_facSftyRtdtHiVlvLft_M "Correction factor for safety retardation during high valve timing" MAP 0x8052700A RB_Map_S16U16_U8 1.000 fak_ub_b16 0.00 1.000 FORMAT "%5.3" EXTENDED_LIMITS 0.00 15.94
 /begin AXIS_DESCR STD_AXIS Epm_nEng EngN 8 -16384.00 16383.50 FORMAT "%8.2" DEPOSIT ABSOLUTE /end AXIS_DESCR
 /begin AXIS_DESCR STD_AXIS AirMod_ratChrgAirCyl rel_uw_q0p0234 8 0.00 1535.977 FORMAT "%8.3" DEPOSIT ABSOLUTE /end AXIS_DESCR
/end CHARACTERISTIC
/begin CHARACTERISTIC IKCtl_facSftyRtdtLoVlvLft_M "Correction factor for safety retardation during low valve timing" MAP 0x8052706E RB_Map_S16U16_U8 1.000 fak_ub_b16 0.00 1.000 FORMAT "%5.3" EXTENDED_LIMITS 0.00 15.94
 /begin AXIS_DESCR STD_AXIS Epm_nEng EngN 8 -16384.00 16383.50 FORMAT "%8.2" DEPOSIT ABSOLUTE /end AXIS_DESCR
 /begin AXIS_DESCR STD_AXIS AirMod_ratChrgAirCyl rel_uw_q0p0234 8 0.00 1535.977 FORMAT "%8.3" DEPOSIT ABSOLUTE /end AXIS_DESCR
/end CHARACTERISTIC
/begin CHARACTERISTIC IKCtl_facThdMaxGdCly "cylinder individual rpm limit, below which leading cylinder functionality is active" VAL_BLK 0x80526C38 RB_ValA_Ws16 32767.50 EngN -16384.00 16383.50 FORMAT "%8.2" NUMBER 4 /end CHARACTERISTIC
/begin CHARACTERISTIC IKCtl_facThdMinGdCly "cylinder individual rpm limit for lead by leading cylinder" VAL_BLK 0x80526C40 RB_ValA_Ws16 32767.50 EngN -16384.00 16383.50 FORMAT "%8.2" NUMBER 4 /end CHARACTERISTIC
/begin CHARACTERISTIC IKCtl_facTiFastKnkPrem_GT "Delay time during fast ignition advancing" CURVE 0x805270D2 RB_CurveGroup_U8 25.50 t_q0p1 0.00 25.50 FORMAT "%5.2"
 /begin AXIS_DESCR COM_AXIS Epm_nEng EngN 8 -16384.00 16383.50 FORMAT "%8.2" AXIS_PTS_REF IKCtl_nEng08_X_AX /end AXIS_DESCR
/end CHARACTERISTIC
/begin CHARACTERISTIC IKCtl_iaOffsGdCyl_M "ignition retard offset for guided cylinder(nmot, cylinder)" MAP 0x80526C48 RB_Map_S16U8_S16 3276.800 zw_q0p1 -3276.800 0.00 FORMAT "%8.3" EXTENDED_LIMITS -3276.800 3276.700
 /begin AXIS_DESCR STD_AXIS Epm_nEng EngN 12 -16384.00 16383.50 FORMAT "%8.2" DEPOSIT ABSOLUTE /end AXIS_DESCR
 /begin AXIS_DESCR STD_AXIS IKCtl_nrCylFineResl_u8 OneToOne 8 0.00 255.0 FORMAT "%5.1" DEPOSIT ABSOLUTE /end AXIS_DESCR
/end CHARACTERISTIC
/begin CHARACTERISTIC IKCtl_iaOffsKnkSnsrErr_C "ignition retard offset for guided cylinders in case of knock sensor error" VALUE 0x80526D2C RB_Val_Ws16 12.00000 zw_q0p1 -12.00000 0.00 FORMAT "%8.5" EXTENDED_LIMITS -3276.800 3276.700 /end CHARACTERISTIC
/begin CHARACTERISTIC IKCtl_iaSftyRtdt_M "Safety retardation" MAP 0x805270DA RB_Map_S16S16_S8 20.25 kw_q0p75 -20.25 0.00 FORMAT "%5.2" EXTENDED_LIMITS -96.00 95.25
 /begin AXIS_DESCR STD_AXIS Epm_nEng EngN 8 -16384.00 16383.50 FORMAT "%8.2" DEPOSIT ABSOLUTE /end AXIS_DESCR
 /begin AXIS_DESCR STD_AXIS IKCtl_tEngLoc_s16 Temp_Cels 8 -3549.940 3003.560 FORMAT "%8.3" DEPOSIT ABSOLUTE /end AXIS_DESCR
/end CHARACTERISTIC
/begin AXIS_PTS IKCtl_nEng08_X_AX "KC: Datapoint distribution engine speed of group B" 0x8052515E Epm_nEng RB_Axis_S16 32767.50 EngN 8 -16384.00 16383.50 FORMAT "%8.2" DEPOSIT ABSOLUTE /end AXIS_PTS
/begin AXIS_PTS IKCtl_nEngVar13_X_AX "KC: Datapoint distribution engine speed of group A" 0x8052518C Epm_nEng RB_Axis_S16 32767.50 EngN 13 -16384.00 16383.50 FORMAT "%8.2" DEPOSIT ABSOLUTE /end AXIS_PTS
/begin AXIS_PTS IKCtl_ratLoad04_X_AX "basepoint distribution of air charge , 4 basepoints" 0x805251C4 AirMod_ratChrgAirCyl RB_Axis_U16 1535.977 rel_uw_q0p0234 4 0.00 1535.977 FORMAT "%8.3" DEPOSIT ABSOLUTE /end AXIS_PTS
/begin CHARACTERISTIC IKCtl_ratLoadThdGdCyl_CA "cylinder individual load limit, above which leading cylinder functionality is active" VAL_BLK 0x80526D2E RB_ValA_Wu16 1535.977 rel_uw_q0p0234 0.00 1535.977 FORMAT "%8.3" NUMBER 4 /end CHARACTERISTIC
/begin CHARACTERISTIC IKCtl_stCorrFil_C "knock control: correction of low pass characteristic at switch of filter mean frequency (50%)" VALUE 0x80526B00 RB_Val_Wu8 255.0 dez 0.00 255.0 FORMAT "%5.1" /end CHARACTERISTIC
/begin CHARACTERISTIC IKCtl_stFacRefLvlReIniSeln_C "code word for factor to reinitialize the reference level" VALUE 0x80526B01 RB_Val_Wu8 1.00000000000 B_TRUE 0.00 1.00000000000 FORMAT "%13.11" /end CHARACTERISTIC
/begin CHARACTERISTIC IKCtl_stKnkSeln_C "code word for k factor and reference level calculation" VALUE 0x80526B02 RB_Val_Wu8 255.0 dez 0.00 255.0 FORMAT "%5.1" /end CHARACTERISTIC
/begin CHARACTERISTIC IKCtl_stLimp_C "code word for limp home in case of one knock sensors fails" VALUE 0x80526D36 RB_Val_Wu8 255.0 dez 0.00 255.0 FORMAT "%5.1" /end CHARACTERISTIC
/begin CHARACTERISTIC IKCtl_stRefLvlReIni_C "codeword for reinitialization of reference level" VALUE 0x80526B03 RB_Val_Wu8 255.0 dez 0.00 255.0 FORMAT "%5.1" /end CHARACTERISTIC
/begin CHARACTERISTIC IKCtl_stVlvlftdynSeln_C "code word to select valve lift dynamics" VALUE 0x80526B04 RB_Val_Wu8 1.00000000000 B_TRUE 0.00 1.00000000000 FORMAT "%13.11" /end CHARACTERISTIC
/begin CHARACTERISTIC IKCtl_tiTmrAdv_M "time for ignition-advancing knock ingnition (fine resolution)" MAP 0x8052713E RB_Map_S16S16_S16 25.50000 t_q0p1 0.00 25.50000 FORMAT "%8.5" EXTENDED_LIMITS -3276.800 3276.700
 /begin AXIS_DESCR STD_AXIS Epm_nEng EngN 8 -16384.00 16383.50 FORMAT "%8.2" DEPOSIT ABSOLUTE /end AXIS_DESCR
 /begin AXIS_DESCR STD_AXIS IKCtl_agRtdtCurrOutp_s16 zw_q0p1 4 -3276.800 3276.700 FORMAT "%8.3" DEPOSIT ABSOLUTE /end AXIS_DESCR
/end CHARACTERISTIC
/begin CHARACTERISTIC IKCtl_wStrtRef_C "initialization value for reference level" VALUE 0x80526B08 RB_Val_Wu32 3276.79999924 spg_q7p629Em7_V_ms 0.00 3276.79999924 FORMAT "%13.8" /end CHARACTERISTIC
/begin CHARACTERISTIC KFLASWLRTX "map lambda engine nominal at warming up with active lambda control" MAP 0x805277EA RB_Map_U8U8_U8 1.992188 fak_ub_b2 0.00 1.992188 FORMAT "%8.6"
 /begin AXIS_DESCR STD_AXIS tmotlanswl temp_ub_q0p75_o48 12 -48.0 143.3 FORMAT "%5.1" DEPOSIT ABSOLUTE /end AXIS_DESCR
 /begin AXIS_DESCR STD_AXIS tmstlanswl temp_ub_q0p75_o48 12 -48.0 143.3 FORMAT "%5.1" DEPOSIT ABSOLUTE /end AXIS_DESCR
/end CHARACTERISTIC
/begin CHARACTERISTIC KFLMSKH "Performance characteristics lambda engine nominal at catalyst heating" MAP 0x805274E0 RB_Map_S16U16_U16 8.000000 fak_q0p000244 0.00 8.000000 FORMAT "%8.6" EXTENDED_LIMITS 0.00 15.99976
 /begin AXIS_DESCR STD_AXIS Epm_nEng EngN 8 -16384.00 16383.50 FORMAT "%8.2" DEPOSIT ABSOLUTE /end AXIS_DESCR
 /begin AXIS_DESCR STD_AXIS AirMod_ratChrgAirCyl rel_uw_q0p0234 8 0.00 1535.977 FORMAT "%8.3" DEPOSIT ABSOLUTE /end AXIS_DESCR
/end CHARACTERISTIC
/begin CHARACTERISTIC KLFRKRINI "curve of multiplcativ factor to reinitialize the reference level" CURVE 0x80526B0C RB_CurveGroup_U8 15.88 fak_ub_b16 0.06 15.94 FORMAT "%5.2" EXTENDED_LIMITS 0.00 15.94
 /begin AXIS_DESCR COM_AXIS Epm_nEng EngN 13 -16384.00 16383.50 FORMAT "%8.2" AXIS_PTS_REF IKCtl_nEngVar13_X_AX /end AXIS_DESCR
/end CHARACTERISTIC
/begin CHARACTERISTIC KLLAKHFH "ambient pressure correction lambda catalyst heating" CURVE 0x80527584 RB_Curve_U16_U16 1.999969 fak_uw_b2 0.00 1.999969 FORMAT "%8.6"
 /begin AXIS_DESCR STD_AXIS PEnv_facCorrAlti fak_uw_b4 4 0.00 3.999939 FORMAT "%8.6" DEPOSIT ABSOLUTE /end AXIS_DESCR
/end CHARACTERISTIC
/begin CHARACTERISTIC KLRKRMN "minimal reference level during idle or quiet operation mode" CURVE 0x80526B1A RB_CurveGroup_U16 25.59922 spg_q3p906Em4_V_ms 0.00039 25.59961 FORMAT "%8.5" EXTENDED_LIMITS 0.00 25.59961
 /begin AXIS_DESCR COM_AXIS Epm_nEng EngN 13 -16384.00 16383.50 FORMAT "%8.2" AXIS_PTS_REF IKCtl_nEngVar13_X_AX /end AXIS_DESCR
/end CHARACTERISTIC
/begin CHARACTERISTIC KRFTP2 "low pass characteristic at engine speed dynamics" VALUE 0x80526B34 RB_Val_Wu8 14.00 dez 2.00 16.00 FORMAT "%5.2" EXTENDED_LIMITS 0.00 255.0 /end CHARACTERISTIC
/begin CHARACTERISTIC KRFTP3 "low pass characteristic at load dynamic" VALUE 0x80526B35 RB_Val_Wu8 14.00 dez 2.00 16.00 FORMAT "%5.2" EXTENDED_LIMITS 0.00 255.0 /end CHARACTERISTIC
/begin CHARACTERISTIC KRKFKS "selected knock detection threshold, if missing cylinder one detection" VALUE 0x80526B36 RB_Val_Wu8 7.000 dez 0.00 7.000 FORMAT "%5.3" EXTENDED_LIMITS 0.00 255.0 /end CHARACTERISTIC
/begin CHARACTERISTIC KRNGFILO "No foozen values upper KRNGFILO" VALUE 0x80526B37 RB_Val_Ws8 25500. nmotg_sb_q100 -12800. 12700. FORMAT "%5.0" /end CHARACTERISTIC
/begin CHARACTERISTIC KRNGFILU "No foozen values lower KRNGFILO" VALUE 0x80526B38 RB_Val_Ws8 25500. nmotg_sb_q100 -12800. 12700. FORMAT "%5.0" /end CHARACTERISTIC
/begin CHARACTERISTIC LamCtrl_ratLamSpCdaGbx_Crv "Target lambda for fuel cut off during gear box intervention" CURVE 0x805275AC RB_Curve_U16_U8_Static 1.992188 fak_ub_b2 0.00 1.992188 FORMAT "%8.6"
 /begin AXIS_DESCR STD_AXIS NO_INPUT_QUANTITY fak_uw_b16 4 0.00 15.99976 FORMAT "%8.5" DEPOSIT ABSOLUTE /end AXIS_DESCR
/end CHARACTERISTIC
/begin CHARACTERISTIC LamCtrl_ratLamSpFcoB1_M "Lambda setpoint during fuel cut-off or cylinder deactivation, bank 1" MAP 0x805275BA RB_Map_U16U16_U8 1.992188 fak_ub_b2 0.00 1.992188 FORMAT "%8.6"
 /begin AXIS_DESCR STD_AXIS NO_INPUT_QUANTITY temp_q0p0234_o273 8 -273.150 1262.827 FORMAT "%8.3" DEPOSIT ABSOLUTE /end AXIS_DESCR
 /begin AXIS_DESCR STD_AXIS LamCtrl_mfExhCat1B1 m_uw_b6553p5 8 0.00 6553.500 FORMAT "%8.3" DEPOSIT ABSOLUTE /end AXIS_DESCR
/end CHARACTERISTIC
/begin AXIS_PTS LamCtrl_tEngLamLimn_Ax "Group axis points engine temperature for lambda limitation" 0x8052761E CEngDsT_t RB_Axis_S16 6553.500 Temp_Cels 12 -3549.940 3003.560 FORMAT "%8.3" DEPOSIT ABSOLUTE /end AXIS_PTS
/begin CHARACTERISTIC LAMHAP "desired lambda for application homogeneous mode" VALUE 0x80527638 RB_Val_Wu16 15.99976 fak_uw_b16 0.00 15.99976 FORMAT "%8.5" /end CHARACTERISTIC
/begin CHARACTERISTIC LAMLGFKT "Rich running limit during short test" VALUE 0x8052763A RB_Val_Wu8 1.992188 fak_ub_b2 0.00 1.992188 FORMAT "%8.6" /end CHARACTERISTIC
/begin CHARACTERISTIC LAMLGFTM "lambda enriched engine-running limit" CURVE 0x8052763B RB_CurveGroup_U8 1.992188 fak_ub_b2 0.00 1.992188 FORMAT "%8.6"
 /begin AXIS_DESCR COM_AXIS CEngDsT_t Temp_Cels 12 -3549.940 3003.560 FORMAT "%8.3" AXIS_PTS_REF LamCtrl_tEngLamLimn_Ax /end AXIS_DESCR
/end CHARACTERISTIC
/begin CHARACTERISTIC LAMLGMKT "Lean running limit during short test" VALUE 0x80527647 RB_Val_Wu8 1.992188 fak_ub_b2 0.00 1.992188 FORMAT "%8.6" /end CHARACTERISTIC
/begin CHARACTERISTIC LAMLGMTM "lambda limit ""lean""" CURVE 0x80527648 RB_CurveGroup_U8 1.992188 fak_ub_b2 0.00 1.992188 FORMAT "%8.6"
 /begin AXIS_DESCR COM_AXIS CEngDsT_t Temp_Cels 12 -3549.940 3003.560 FORMAT "%8.3" AXIS_PTS_REF LamCtrl_tEngLamLimn_Ax /end AXIS_DESCR
/end CHARACTERISTIC
/begin CHARACTERISTIC LASOABDMD "lambda setpoint in combustion chamber during catalyst damaging misfire" VALUE 0x80527654 RB_Val_Wu8 1.992188 fak_ub_b2 0.00 1.992188 FORMAT "%8.6" /end CHARACTERISTIC
/begin CHARACTERISTIC LASWLTX "offset lambda engine nominal with inactive lambda control" CURVE 0x80527894 RB_Curve_U8_S8_Static 1.992 fak_sb_b1 -1.000 0.992 FORMAT "%5.3" EXTENDED_LIMITS -1.000 0.9922
 /begin AXIS_DESCR STD_AXIS tmotlanswl temp_ub_q0p75_o48 12 -48.0 143.3 FORMAT "%5.1" DEPOSIT ABSOLUTE /end AXIS_DESCR
/end CHARACTERISTIC
/begin CHARACTERISTIC LIGov_ExtTrqDemMskSeln_CW "selection alternative bit mask for external torque demands" VALUE 0x80527BC4 RB_Val_Wu16 65535.00 OneToOne 0.00 65535.00 FORMAT "%8.2" /end CHARACTERISTIC
/begin CHARACTERISTIC LIGov_facCatHeatgAlti_C "Factor parameter selection cat heating in altitude" VALUE 0x80527BC6 RB_Val_Wu8 3.984 fak_ub_b4 0.00 3.984 FORMAT "%5.3" /end CHARACTERISTIC
/begin CHARACTERISTIC LIGov_facDeadZoneEngLoad_T "Factor dead zone on engine load level for modification of pre-control-torque dependend on set- and actual-speed" CURVE 0x805278D0 RB_Curve_U16_U16 4.999924 fak_uw_b5 0.00 4.999924 FORMAT "%8.6"
 /begin AXIS_DESCR STD_AXIS LIGov_nDiffNSetNEng fak_uw_b2 6 0.00 1.999969 FORMAT "%8.6" DEPOSIT ABSOLUTE /end AXIS_DESCR
/end CHARACTERISTIC
/begin CHARACTERISTIC LIGov_facEngLoadLvl_M "Engine load level factor for modification of pre-control-torque during engine start" MAP 0x805278EA RB_Map_U8U16_U16 0.9960938 fak_ub_b1 0.00 0.9960938 FORMAT "%9.7" EXTENDED_LIMITS 0.00 255.9961
 /begin AXIS_DESCR STD_AXIS LIGov_tStrtloc temp_ub_q0p75_o48 6 -48.0 143.3 FORMAT "%5.1" DEPOSIT ABSOLUTE /end AXIS_DESCR
 /begin AXIS_DESCR STD_AXIS tnst_w_msg t_q0p01 6 0.00 655.3500 FORMAT "%8.4" DEPOSIT ABSOLUTE /end AXIS_DESCR
/end CHARACTERISTIC
/begin CHARACTERISTIC LIGov_facPreCtlRmpDwn_C "Step width of the ramp for precontrol of the drag torque of the engine when ramping downwards" VALUE 0x80527946 RB_Val_Wu16 0.9999695 fak_q3p0518Em5 0.000031 1.000000 FORMAT "%8.6" EXTENDED_LIMITS 0.00 1.999969 /end CHARACTERISTIC
/begin CHARACTERISTIC LIGov_facPreCtlRmpGrip_C "Step width of the ramp for precontrol of the drag torque of the engine with closed powertrain" VALUE 0x80527948 RB_Val_Wu16 0.9999695 fak_uw_b2 0.000031 1.000000 FORMAT "%8.6" EXTENDED_LIMITS 0.00 1.999969 /end CHARACTERISTIC
/begin CHARACTERISTIC LIGov_facPreCtlRmpNoGrip_C "Step width of the ramp for precontrol of the drag torque of the engine with open powertrain" VALUE 0x8052794A RB_Val_Wu16 0.9999695 fak_uw_b2 0.000031 1.000000 FORMAT "%8.6" EXTENDED_LIMITS 0.00 1.999969 /end CHARACTERISTIC
/begin CHARACTERISTIC LIGov_facTrqMax_CUR "engine speed dependent factor for limitation of maximum idle speed governor torque" CURVE 0x8052794C RB_Curve_S16_U16_Static 1.000000 fak_uw_b2 0.00 1.000000 FORMAT "%8.6" EXTENDED_LIMITS 0.00 1.999969
 /begin AXIS_DESCR STD_AXIS Epm_nEng EngN 6 -16384.00 16383.50 FORMAT "%8.2" DEPOSIT ABSOLUTE /end AXIS_DESCR
/end CHARACTERISTIC
/begin CHARACTERISTIC LIGov_flgMskLLimIfFcoReqd_C "Flag to mask active bit position of LLim in GlbDa_stTrqDem when fuel cut-off is requested." VALUE 0x80527BC7 RB_Val_Wu8 1.00000000000 B_TRUE 0.00 1.00000000000 FORMAT "%13.11" /end CHARACTERISTIC
/begin CHARACTERISTIC LIGov_flgSrvCouplrSwtCdnDi_C "Service coupler disable calibration" VALUE 0x80527966 RB_Val_Wboolean 1.00000000000 B_TRUE 0.00 1.00000000000 FORMAT "%13.11" /end CHARACTERISTIC
/begin CHARACTERISTIC LIGov_Gov_CW "Codeword Governor Module" VALUE 0x80527967 RB_Val_Wu8 255.0 dez 0.00 255.0 FORMAT "%5.1" /end CHARACTERISTIC
/begin CHARACTERISTIC LIGov_nExtTrqDemSelnSpOffs_C "offset speed difference alternative bit mask for external torque demands" VALUE 0x80527BC8 RB_Val_Ws16 32767.50 nmot_sw_q0p5 -16384.00 16383.50 FORMAT "%8.2" /end CHARACTERISTIC
/begin CHARACTERISTIC LIGov_nExtTrqDemSelnThd_C "threshold engine speed alternative bit mask for external torque demands" VALUE 0x80527BCA RB_Val_Ws16 32767.50 nmot_sw_q0p5 -16384.00 16383.50 FORMAT "%8.2" /end CHARACTERISTIC
/begin CHARACTERISTIC LIGov_nLimHi_C "Upper speed limit for controller activity" VALUE 0x80527BCC RB_Val_Ws16 32767.50 nmot_q0p5 -16384.00 16383.50 FORMAT "%8.2" /end CHARACTERISTIC
/begin CHARACTERISTIC LIGov_nOffs_C "Engine speed setpoint Offset" VALUE 0x80527BCE RB_Val_Ws16 32767.50 nmot_sw_q0p5 -16384.00 16383.50 FORMAT "%8.2" /end CHARACTERISTIC
/begin CHARACTERISTIC LIGov_nOfsPreCtlRstrt_C "speed offset for re-ignition" VALUE 0x80527BD0 RB_Val_Ws16 32767.50 nmot_q0p5 -16384.00 16383.50 FORMAT "%8.2" /end CHARACTERISTIC
/begin CHARACTERISTIC LIGov_nOfsPreCtlTrqDem_C "speed offset for external torque demand" VALUE 0x80527BD2 RB_Val_Ws16 32767.50 nmot_q0p5 -16384.00 16383.50 FORMAT "%8.2" /end CHARACTERISTIC
/begin CHARACTERISTIC LIGov_nOfsPreCtl_C "speed offset for precontrol" VALUE 0x80527BD4 RB_Val_Ws16 32767.50 nmot_q0p5 -16384.00 16383.50 FORMAT "%8.2" /end CHARACTERISTIC
/begin CHARACTERISTIC LIGov_nOfsPredef_C "speed offset for predefined torque" VALUE 0x80527BD6 RB_Val_Ws16 32767.50 nmot_q0p5 -16384.00 16383.50 FORMAT "%8.2" /end CHARACTERISTIC
/begin CHARACTERISTIC LIGov_nOfsUbr_C "speed offset for underbraking" VALUE 0x80527BD8 RB_Val_Ws16 32767.50 nmot_q0p5 -16384.00 16383.50 FORMAT "%8.2" /end CHARACTERISTIC
/begin CHARACTERISTIC LIGov_nThresPreCtlLo_T "Speed deviation threshold for activation D-part due to underspeed" CURVE 0x80527BDA RB_Curve_S16_S16 32767.50 nmot_sw_q0p5 -16384.00 16383.50 FORMAT "%8.2"
 /begin AXIS_DESCR STD_AXIS HLSDem_nSetPLo nmot_sw_q0p5 4 -16384.00 16383.50 FORMAT "%8.2" DEPOSIT ABSOLUTE /end AXIS_DESCR
/end CHARACTERISTIC
/begin CHARACTERISTIC LIGov_numParCnv_CUR "Curve for the conversion of LIGov_numPar in a P- and an I-part" CURVE 0x805278B0 RB_Curve_U8_U8 255.0 dez 0.00 255.0 FORMAT "%5.1"
 /begin AXIS_DESCR STD_AXIS LIGov_numPar dez 14 0.00 255.0 FORMAT "%5.1" DEPOSIT ABSOLUTE /end AXIS_DESCR
/end CHARACTERISTIC
/begin CHARACTERISTIC LIGov_pwrMax_C "maximum engine power for limitation of the torque of the idle speed controller depending on engine speed" VALUE 0x80527968 RB_Val_Ws32 214748364.750 mdgrad_q0p05 -107374182.400 107374182.350 FORMAT "%13.3" /end CHARACTERISTIC
/begin CHARACTERISTIC LIGov_rExtTrqDemMskSelnAppThd_C "threshold accelerator pedal angle alternative bit mask for external torque demands" VALUE 0x80527BEC RB_Val_Ws16 799.9878 Prc -400.0000 399.9878 FORMAT "%8.4" /end CHARACTERISTIC
/begin CHARACTERISTIC LIGov_rGripThres_C "Threshold for grip detection within low idle speed controller" VALUE 0x80527BEE RB_Val_Ws16 655.3500 Fact100 -327.6800 327.6700 FORMAT "%8.4" /end CHARACTERISTIC
/begin CHARACTERISTIC LIGov_SelPar2_CW "Codeword 2 for LIGov parameter selection" VALUE 0x80527BF0 RB_Val_Wu8 255.0 dez 0.00 255.0 FORMAT "%5.1" /end CHARACTERISTIC
/begin CHARACTERISTIC LIGov_SelPar_CW "Codeword for LIGov parameter selection" VALUE 0x80527BF2 RB_Val_Wu16 65535.00 dez 0.00 65535.00 FORMAT "%8.2" /end CHARACTERISTIC
/begin CHARACTERISTIC LIGov_stBrkThres_C "status threshold for underbraking detection" VALUE 0x80527BF4 RB_Val_Wu8 255.0 dez 0.00 255.0 FORMAT "%5.1" /end CHARACTERISTIC
/begin CHARACTERISTIC LIGov_stExtTrqDemMskAltv_C "alternative bitmask for external torque demands to be considered in idle speed governor" VALUE 0x80527BF6 RB_Val_Wu16 65535.00 OneToOne 0.00 65535.00 FORMAT "%8.2" /end CHARACTERISTIC
/begin CHARACTERISTIC LIGov_stExtTrqDemMskSelnBrk_C "break switch state alternative bit mask for external torque demands" VALUE 0x80527BF8 RB_Val_Wu8 255.0 OneToOne 0.00 255.0 FORMAT "%5.1" /end CHARACTERISTIC
/begin CHARACTERISTIC LIGov_stExtTrqDemMsk_C "bitmask for external torque demands to be considered in idle speed governor" VALUE 0x80527BFA RB_Val_Wu16 65535.00 OneToOne 0.00 65535.00 FORMAT "%8.2" /end CHARACTERISTIC
/begin CHARACTERISTIC LIGov_swtBll_C "Idle speed dependency selection switch" VALUE 0x80527BFC RB_Val_Wu8 1.00000000000 B_TRUE 0.00 1.00000000000 FORMAT "%13.11" /end CHARACTERISTIC
/begin CHARACTERISTIC LIGov_swtNoGrip_C "Open Powertrain selection switch" VALUE 0x80527BFD RB_Val_Wu8 1.00000000000 B_TRUE 0.00 1.00000000000 FORMAT "%13.11" /end CHARACTERISTIC
/begin CHARACTERISTIC LIGov_tEngXHi_C "upper engine temperature threshold" VALUE 0x80527BFE RB_Val_Ws16 6553.500 temp_q0p1_o273 -3549.940 3003.560 FORMAT "%8.3" /end CHARACTERISTIC
/begin CHARACTERISTIC LIGov_tEngXLo_C "lower engine temperature threshold" VALUE 0x80527C00 RB_Val_Ws16 6553.500 temp_q0p1_o273 -3549.940 3003.560 FORMAT "%8.3" /end CHARACTERISTIC
/begin CHARACTERISTIC LIGov_tiDlyPreCtl_C "time delay D-part calculation" VALUE 0x80527C02 RB_Val_Wu16 31.99951 t_tev0p0005 0.00 31.99951 FORMAT "%8.5" /end CHARACTERISTIC
/begin CHARACTERISTIC LIGov_tiEnblI_CUR "time delay for I-part release after start" CURVE 0x80527C04 RB_Curve_S16_U16_Static 31.99951 t_tev0p0005 0.00 31.99951 FORMAT "%8.5"
 /begin AXIS_DESCR STD_AXIS EngDa_tEng temp_q0p1_o273 6 -3549.940 3003.560 FORMAT "%8.3" DEPOSIT ABSOLUTE /end AXIS_DESCR
/end CHARACTERISTIC
/begin CHARACTERISTIC LIGov_tiFrzIDly_C "time delay I-part calculation" VALUE 0x80527C1E RB_Val_Wu16 31.99951 t_tev0p0005 0.00 31.99951 FORMAT "%8.5" /end CHARACTERISTIC
/begin CHARACTERISTIC LIGov_tiGrip_C "time delay clutch opens" VALUE 0x80527C20 RB_Val_Wu16 31.99951 t_tev0p0005 0.00 31.99951 FORMAT "%8.5" /end CHARACTERISTIC
/begin CHARACTERISTIC LIGov_tiPLeadOfs_C "time constant for P-part air path offset filter" VALUE 0x8052796C RB_Val_Wu16 2047.969 t_q3p125em2 0.00 2047.969 FORMAT "%8.3" /end CHARACTERISTIC
/begin CHARACTERISTIC LIGov_tiStrtPar_C "time delay for shutting down the parameter set for start with underspeed" VALUE 0x80527C22 RB_Val_Ws16 10485.60 TimeRed -5242.880 5242.720 FORMAT "%8.3" /end CHARACTERISTIC
/begin CHARACTERISTIC LIGov_tqIntglSrvCouplrSwtActv_M "Integral torque when SCS is active" MAP 0x8052796E RB_Map_S16U8_S16 6553.500 md_q0p1 -3276.800 3276.700 FORMAT "%8.3"
 /begin AXIS_DESCR STD_AXIS LIGov_nDiff nmot_q0p5 8 -16384.00 16383.50 FORMAT "%8.2" DEPOSIT ABSOLUTE /end AXIS_DESCR
 /begin AXIS_DESCR STD_AXIS LIGov_numParTrqI dez 6 0.00 255.0 FORMAT "%5.1" DEPOSIT ABSOLUTE /end AXIS_DESCR
/end CHARACTERISTIC
/begin CHARACTERISTIC LIGov_tqMin_C "Minimum torque LIGov_trqMin of the idle-speed governor." VALUE 0x805279E8 RB_Val_Ws16 6553.500 md_q0p1 -3276.800 3276.700 FORMAT "%8.3" /end CHARACTERISTIC
/begin CHARACTERISTIC LIGov_trqDeltaWndUpMax_C "delta torque for freeze of integrator at maximal torque" VALUE 0x80527C24 RB_Val_Ws16 6553.500 md_q0p1 -3276.800 3276.700 FORMAT "%8.3" /end CHARACTERISTIC
/begin CHARACTERISTIC LIGov_trqDeltaWndUpMin_C "delta torque for freeze of integrator at minimal torque" VALUE 0x80527C26 RB_Val_Ws16 6553.500 md_q0p1 -3276.800 3276.700 FORMAT "%8.3" /end CHARACTERISTIC
/begin CHARACTERISTIC LIGov_trqDiffMaxParChng_C "Maximal difference between Set and Lead torque for I-Part offset during parameter change" VALUE 0x805279EA RB_Val_Ws16 6553.500 md_q0p1 -3276.800 3276.700 FORMAT "%8.3" /end CHARACTERISTIC
/begin CHARACTERISTIC LIGov_trqI_MAP "Map for I-part of low idle governor (number of parameter sets = LIGOV_NUMIPAR_SY )" MAP 0x805279EC RB_Map_S16U8_S16 6553.500 md_q0p1 -3276.800 3276.700 FORMAT "%8.3"
 /begin AXIS_DESCR STD_AXIS LIGov_nDiff nmot_q0p5 8 -16384.00 16383.50 FORMAT "%8.2" DEPOSIT ABSOLUTE /end AXIS_DESCR
 /begin AXIS_DESCR STD_AXIS LIGov_numParTrqI dez 6 0.00 255.0 FORMAT "%5.1" DEPOSIT ABSOLUTE /end AXIS_DESCR
/end CHARACTERISTIC
/begin CHARACTERISTIC LIGov_trqMaxI_CUR "curve for maximum torque limitation for I-part" CURVE 0x80527A66 RB_Curve_S16_S16 6553.500 md_q0p1 -3276.800 3276.700 FORMAT "%8.3"
 /begin AXIS_DESCR STD_AXIS HLSDem_nSetPLoDiff nmot_sw_q0p5 8 -16384.00 16383.50 FORMAT "%8.2" DEPOSIT ABSOLUTE /end AXIS_DESCR
/end CHARACTERISTIC
/begin CHARACTERISTIC LIGov_trqMax_C "maximal idle speed torque" VALUE 0x80527A88 RB_Val_Ws16 6553.500 md_q0p1 -3276.800 3276.700 FORMAT "%8.3" /end CHARACTERISTIC
/begin CHARACTERISTIC LIGov_trqOfsHi_C "offset for speed dependent limitation" VALUE 0x80527A8A RB_Val_Ws16 6553.500 md_q0p1 -3276.800 3276.700 FORMAT "%8.3" /end CHARACTERISTIC
/begin CHARACTERISTIC LIGov_trqOfsPtd_CUR "torque offset for permitted torque" CURVE 0x80527A8C RB_Curve_S16_S16 6553.500 md_q0p1 -3276.800 3276.700 FORMAT "%8.3"
 /begin AXIS_DESCR STD_AXIS LIGov_nDiff nmot_q0p5 6 -16384.00 16383.50 FORMAT "%8.2" DEPOSIT ABSOLUTE /end AXIS_DESCR
/end CHARACTERISTIC
/begin CHARACTERISTIC LIGov_trqPLead_MAP "Map for P-part of low idle governor air path (number of parameter sets = LIGOV_NUMPPAR_SY)" MAP 0x80527AA6 RB_Map_S16U8_S16 6553.500 md_q0p1 -3276.800 3276.700 FORMAT "%8.3"
 /begin AXIS_DESCR STD_AXIS LIGov_nDiff nmot_q0p5 8 -16384.00 16383.50 FORMAT "%8.2" DEPOSIT ABSOLUTE /end AXIS_DESCR
 /begin AXIS_DESCR STD_AXIS LIGov_numParTrqP dez 7 0.00 255.0 FORMAT "%5.1" DEPOSIT ABSOLUTE /end AXIS_DESCR
/end CHARACTERISTIC
/begin CHARACTERISTIC LIGov_trqPRmp_C "ramp slope for filtering of P-part at parameter set change" VALUE 0x80527B32 RB_Val_Ws16 3276.600 md_q0p1 0.100 3276.700 FORMAT "%8.3" EXTENDED_LIMITS -3276.800 3276.700 /end CHARACTERISTIC
/begin CHARACTERISTIC LIGov_trqP_MAP "Map for P-part of low idle governor ignition path (number of parameter sets = LIGOV_NUMPPAR_SY)" MAP 0x80527B34 RB_Map_S16U8_S16 6553.500 md_q0p1 -3276.800 3276.700 FORMAT "%8.3"
 /begin AXIS_DESCR STD_AXIS LIGov_nDiff nmot_q0p5 8 -16384.00 16383.50 FORMAT "%8.2" DEPOSIT ABSOLUTE /end AXIS_DESCR
 /begin AXIS_DESCR STD_AXIS LIGov_numParTrqP dez 7 0.00 255.0 FORMAT "%5.1" DEPOSIT ABSOLUTE /end AXIS_DESCR
/end CHARACTERISTIC
/begin CHARACTERISTIC LIGov_trqRstIntrv_C "permitted interval for reset torque" VALUE 0x80527BC0 RB_Val_Ws16 3276.700 md_q0p1 0.00 3276.700 FORMAT "%8.3" EXTENDED_LIMITS -3276.800 3276.700 /end CHARACTERISTIC
/begin CHARACTERISTIC LIGov_trqThresDfrstI_C "torque threshold for I-part release during pre-control" VALUE 0x80527C28 RB_Val_Ws16 6553.500 md_q0p1 -3276.800 3276.700 FORMAT "%8.3" /end CHARACTERISTIC
/begin CHARACTERISTIC LIGov_vGrip_C "velocity threshold for rolling vehicle" VALUE 0x80527C2A RB_Val_Ws16 327.6700 vfzg_uw_q0p01 0.00 327.6700 FORMAT "%8.4" EXTENDED_LIMITS -327.6800 327.6700 /end CHARACTERISTIC
/begin CHARACTERISTIC LIGov_vMinRstI_C "minimum vehicle speed for release of I-part-reset" VALUE 0x80527C2C RB_Val_Ws16 327.6700 vfzg_uw_q0p01 0.00 327.6700 FORMAT "%8.4" EXTENDED_LIMITS -327.6800 327.6700 /end CHARACTERISTIC
/begin CHARACTERISTIC LiGov_vThresFrzI_C "Vehicle speed threshold for detection of rolling vehicle" VALUE 0x80527C2E RB_Val_Ws16 655.3500 vel_q0p01 -327.6800 327.6700 FORMAT "%8.4" /end CHARACTERISTIC
/begin CHARACTERISTIC LIGov_vThresUbr_C "vehicle speed threshold for underbraking" VALUE 0x80527C30 RB_Val_Ws16 327.6700 vfzg_uw_q0p01 0.00 327.6700 FORMAT "%8.4" EXTENDED_LIMITS -327.6800 327.6700 /end CHARACTERISTIC
/begin CHARACTERISTIC Linappl_stUseLstErr_C "Use last value of LIN error flag if transmission or reception is not occurred in this period" VALUE 0x8052F6B8 RB_Val_Wu8 1.00000000000 B_TRUE 0.00 1.00000000000 FORMAT "%13.11" /end CHARACTERISTIC
/begin CHARACTERISTIC LinDiag_C "Switch for enabling LIN diagnosis" VALUE 0x8052F6B9 RB_Val_Wu8 1.00000000000 B_TRUE 0.00 1.00000000000 FORMAT "%13.11" /end CHARACTERISTIC
/begin CHARACTERISTIC LLim_aDifNeg_C "Maximum negative change of Acceleration Request per cycle" VALUE 0x8052F2E8 Val_Ws16 65.53500 Acc -32.76800 32.76700 FORMAT "%8.5" /end CHARACTERISTIC
/begin CHARACTERISTIC LLim_aDifPos_C "Maximum Positive change of Acceleration Request per cycle" VALUE 0x8052F2EA Val_Ws16 65.53500 Acc -32.76800 32.76700 FORMAT "%8.5" /end CHARACTERISTIC
/begin CHARACTERISTIC LLim_aMSL_CUR "Curve for Speed limiter acceleration limit" CURVE 0x8052F2EC Cur_Xs16Ws16 65.53500 Acc -32.76800 32.76700 FORMAT "%8.5"
 /begin AXIS_DESCR STD_AXIS LLim_dvMSL_mp Vel 9 -327.6800 327.6700 FORMAT "%8.4" DEPOSIT ABSOLUTE /end AXIS_DESCR
/end CHARACTERISTIC
/begin CHARACTERISTIC LLim_axMax_C "Upper Bound for acceleration request" VALUE 0x8052F312 Val_Ws16 65.53500 Acc -32.76800 32.76700 FORMAT "%8.5" /end CHARACTERISTIC
/begin CHARACTERISTIC LLim_tqFcoDesHi_C "Upper hysteresis threshold for desired fuel cutoff" VALUE 0x8052F314 Val_Ws32 429496729.500 TrqPrpHigh -214748364.800 214748364.700 FORMAT "%13.3" /end CHARACTERISTIC
/begin CHARACTERISTIC LLim_tqFcoDesLo_C "Lower hysteresis threshold for desired fuel cutoff" VALUE 0x8052F318 Val_Ws32 429496729.500 TrqPrpHigh -214748364.800 214748364.700 FORMAT "%13.3" /end CHARACTERISTIC
/begin CHARACTERISTIC LLim_vMaxFixdFailr_C "The limitation of vehicle speed when failure happened" VALUE 0x8052F31C Val_Ws16 655.3500 Vel -327.6800 327.6700 FORMAT "%8.4" /end CHARACTERISTIC
/begin CHARACTERISTIC LLim_vMaxFix_C "Maximum Speed Limit" VALUE 0x8052F31E Val_Ws16 655.3500 Vel -327.6800 327.6700 FORMAT "%8.4" /end CHARACTERISTIC
/begin CHARACTERISTIC LLim_vMaxSlopFailr_C "The ramp slope to make vehicle speed slow down gra-dually till reached the limitation" VALUE 0x8052F320 Val_Ws16 9.999847 q6553p6_RmpVel_low -5.000000 4.999847 FORMAT "%8.6" /end CHARACTERISTIC
/begin CHARACTERISTIC LLim_vThres_C "Velocity Threshold for activating Speed Limiter" VALUE 0x8052F322 Val_Ws16 655.3500 Vel -327.6800 327.6700 FORMAT "%8.4" /end CHARACTERISTIC
/begin CHARACTERISTIC LMSTMOT "correction based on engine temperature for the calculation of nominal engine lambda" CURVE 0x80527596 RB_Curve_S16_U16_Static 1.992188 fak_ub_b2 0.00 1.992188 FORMAT "%8.6" EXTENDED_LIMITS 0.00 511.9922
 /begin AXIS_DESCR STD_AXIS tmcyla_w Temp_Cels 4 -3549.940 3003.560 FORMAT "%8.3" DEPOSIT ABSOLUTE /end AXIS_DESCR
/end CHARACTERISTIC
/begin CHARACTERISTIC LZFUERV "guide cylinder assignment" VAL_BLK 0x80526D37 RB_ValA_Wu8 255.0 dez 0.00 255.0 FORMAT "%5.1" NUMBER 4 /end CHARACTERISTIC
/begin CHARACTERISTIC MINAKRLZ "minimum number of possible KC guide cylinders" VALUE 0x80526D3B RB_Val_Wu8 7.000 dez 1.000 8.000 FORMAT "%5.3" EXTENDED_LIMITS 0.00 255.0 /end CHARACTERISTIC
/begin CHARACTERISTIC RKRMX1N "Maximum of reference level for knock detection threshold cylinder group 1" CURVE 0x80526B3A RB_CurveGroup_U16 25.59961 spg_q3p906Em4_V_ms 0.00 25.59961 FORMAT "%8.5"
 /begin AXIS_DESCR COM_AXIS Epm_nEng EngN 13 -16384.00 16383.50 FORMAT "%8.2" AXIS_PTS_REF IKCtl_nEngVar13_X_AX /end AXIS_DESCR
/end CHARACTERISTIC
/begin CHARACTERISTIC RKRMX2N "maximum of reference level for knock detection threshold cylinder group 2" CURVE 0x80526B54 RB_CurveGroup_U16 25.59961 spg_q3p906Em4_V_ms 0.00 25.59961 FORMAT "%8.5"
 /begin AXIS_DESCR COM_AXIS Epm_nEng EngN 13 -16384.00 16383.50 FORMAT "%8.2" AXIS_PTS_REF IKCtl_nEngVar13_X_AX /end AXIS_DESCR
/end CHARACTERISTIC
/begin CHARACTERISTIC SpdCtl_flgSynIninReqDrv_C "Calibration flag to request for initialization during transition to Drive state for Synchro-task in Spdctl package." VALUE 0x80527C32 RB_Val_Wu8 1.00000000000 B_TRUE 0.00 1.00000000000 FORMAT "%13.11" /end CHARACTERISTIC
/begin CHARACTERISTIC SpdCtl_flgSynPstDrvBreak_C "Calibration flag to prevent execution of Synchro-processes of Spdctl during Post-Drive state" VALUE 0x80527C33 RB_Val_Wu8 1.00000000000 B_TRUE 0.00 1.00000000000 FORMAT "%13.11" /end CHARACTERISTIC
/begin CHARACTERISTIC TKRLZAMN "Knock control: delay for condition ""min nr. of guiding cylinders underschootten""" VALUE 0x80526D3C RB_Val_Wu8 25.50 t_q0p1 0.00 25.50 FORMAT "%5.2" /end CHARACTERISTIC
/begin CHARACTERISTIC TKRVHEU "time for detected valve strock switch" VALUE 0x80526B6E RB_Val_Wu8 2.550 t_q0p01 0.00 2.550 FORMAT "%5.3" /end CHARACTERISTIC
/begin CHARACTERISTIC TLANSWL "time constant filter lamda afterstart-warmup" VALUE 0x805278AE RB_Val_Wu16 655.3500 t10msxs_uw_b655p35 0.00 655.3500 FORMAT "%8.4" /end CHARACTERISTIC
/begin CHARACTERISTIC TLASOABDQ "Activation time for lambda request in case of gearbox intervention" VALUE 0x80527655 RB_Val_Wu8 2.550 t_q0p01 0.00 2.550 FORMAT "%5.3" /end CHARACTERISTIC
/begin CHARACTERISTIC TWKRLZOFV "Steps per 0.75 degree for angle and offset guided cylinder" VALUE 0x8052719A RB_Val_Wu8 255.0 dez 0.00 255.0 FORMAT "%5.1" /end CHARACTERISTIC
/begin CHARACTERISTIC VZWKR "Ignition angle adjustment by calibration tool, e.g. VS100, INCA" VAL_BLK 0x8052719B RB_ValA_Ws8 40.50 kw_q0p75 -20.25 20.25 FORMAT "%5.2" EXTENDED_LIMITS -96.00 95.25 NUMBER 4 /end CHARACTERISTIC
/begin CHARACTERISTIC ZKRNGFIL "Knock control: time constant for the filtered engine-speed gradient" VALUE 0x80526B6F RB_Val_Wu8 0.9922 fak_ub_b1 0.0039 0.9961 EXTENDED_LIMITS 0.00 0.9961 /end CHARACTERISTIC
/begin CHARACTERISTIC ZYRKR "cylinder selective reference level limitation" VALUE 0x80526B70 RB_Val_Wu8 255.0 dez 0.00 255.0 FORMAT "%5.1" /end CHARACTERISTIC
/begin MEASUREMENT akrgz "number of guided cylinders" UBYTE dez 1 100 0.00 254.0 FORMAT "%5.1" ECU_ADDRESS 0x600063F9 /end MEASUREMENT
/begin MEASUREMENT akrlz "number of possible guide cylinders" UBYTE dez 1 100 0.00 254.0 FORMAT "%5.1" ECU_ADDRESS 0x600063F8 /end MEASUREMENT
/begin MEASUREMENT anztib0_w "Counter for number of injection before start end of injection is reached" UWORD dez 1 100 0.00 65535.00 FORMAT "%8.2" ECU_ADDRESS 0x60003722 /end MEASUREMENT
/begin MEASUREMENT anztib1_w_Loc "injection counter from end of start injection" UWORD dez 1 100 0.00 65535.00 FORMAT "%8.2" ECU_ADDRESS 0x60003720 /end MEASUREMENT
/begin MEASUREMENT anztib1_w_msg "injection counter from end of start injection" UWORD dez 1 100 0.00 65535.00 FORMAT "%8.2" ECU_ADDRESS 0x6000E2F0 /end MEASUREMENT
/begin MEASUREMENT B_elzmn "number of possible KC guide cylinders below minimum" UBYTE B_TRUE 1 100 0.00 1.00000000000 BIT_MASK 0x1 FORMAT "%13.11" ECU_ADDRESS 0x700001C3 /end MEASUREMENT
/begin MEASUREMENT B_krlz "condition for knock control guide-cylinder function active" UBYTE B_TRUE 1 100 0.00 1.00000000000 BIT_MASK 0x1 FORMAT "%13.11" ECU_ADDRESS 0x700001C2 /end MEASUREMENT
/begin MEASUREMENT B_krnlzdws "Condition: knock control safety retard adjustment due to KR-limp-home" UBYTE B_TRUE 1 100 0.00 1.00000000000 BIT_MASK 0x1 FORMAT "%13.11" ECU_ADDRESS 0x700001C1 /end MEASUREMENT
/begin MEASUREMENT B_lalgf_msg "Condition: lambda limit rich active" UBYTE B_TRUE 1 100 0.00 1.00000000000 BIT_MASK 0x1 FORMAT "%13.11" ECU_ADDRESS 0x70000A18 /end MEASUREMENT
/begin MEASUREMENT B_lamdiag_msg "Lambda nominal value called by diagnosis function" UBYTE B_TRUE 1 100 0.00 1.00000000000 BIT_MASK 0x1 FORMAT "%13.11" ECU_ADDRESS 0x70000A16 /end MEASUREMENT
/begin MEASUREMENT B_lamkhe_msg "no air-fuel-ratio request by the function Lambda calculation for catalyst heating" UBYTE B_TRUE 1 100 0.00 1.00000000000 BIT_MASK 0x1 FORMAT "%13.11" ECU_ADDRESS 0x70000A12 /end MEASUREMENT
/begin MEASUREMENT B_lamkh_msg "condition desired lambda for catalyst heating activated" UBYTE B_TRUE 1 100 0.00 1.00000000000 BIT_MASK 0x1 FORMAT "%13.11" ECU_ADDRESS 0x70000A13 /end MEASUREMENT
/begin MEASUREMENT B_lamnswl_msg "lambda engine nominal at post start and warming up active" UBYTE B_TRUE 1 100 0.00 1.00000000000 BIT_MASK 0x1 FORMAT "%13.11" ECU_ADDRESS 0x70000A11 /end MEASUREMENT
/begin MEASUREMENT B_lamsdef_msg "Condition: defined desired airfuel ratio value" UBYTE B_TRUE 1 100 0.00 1.00000000000 BIT_MASK 0x1 FORMAT "%13.11" ECU_ADDRESS 0x70000A0F /end MEASUREMENT
/begin MEASUREMENT B_lawlon "lambda engine nominal at warming up is active" UBYTE B_TRUE 1 100 0.00 1.00000000000 BIT_MASK 0x1 FORMAT "%13.11" ECU_ADDRESS 0x700001BE /end MEASUREMENT
/begin MEASUREMENT B_ldef "Condition: defined desired value of the lambda (bank1)" UBYTE B_TRUE 1 100 0.00 1.00000000000 BIT_MASK 0x1 FORMAT "%13.11" ECU_ADDRESS 0x600000DA /end MEASUREMENT
/begin MEASUREMENT B_lzup "update of lzist" UBYTE B_TRUE 1 100 0.00 1.00000000000 BIT_MASK 0x1 FORMAT "%13.11" ECU_ADDRESS 0x700001C0 /end MEASUREMENT
/begin MEASUREMENT Com_flgLINShtDwnTiDlyExp "LIN Node Shut down delay indicate Flag" UBYTE B_TRUE 1 100 0.00 1.00000000000 BIT_MASK 0x1 FORMAT "%13.11" ECU_ADDRESS 0x600063E2 /end MEASUREMENT
/begin MEASUREMENT Com_stLinFullComMod "Lin COM mode status" UBYTE OneToOne 1 100 0.00 1.000 FORMAT "%5.3" ECU_ADDRESS 0x600063E4 /end MEASUREMENT
/begin MEASUREMENT Com_stSchTable1 "Control switch for the Main schedule table" UBYTE OneToOne 1 100 0.00 1.000 FORMAT "%5.3" ECU_ADDRESS 0x600063E3 /end MEASUREMENT
/begin MEASUREMENT Com_swtLinDiagEna "Message switch for enable LIN diagnosic" UBYTE B_TRUE 1 100 0.00 1.00000000000 BIT_MASK 0x1 FORMAT "%13.11" ECU_ADDRESS 0x600063E1 /end MEASUREMENT
/begin MEASUREMENT EngStrt_ctReIniLANSWL10ms "Local variable to store the global post-drive leave counter(SyC_ctPostDrvLeave)" UBYTE OneToOne 1 100 0.00 255.0 FORMAT "%5.1" ECU_ADDRESS 0x600063E8 /end MEASUREMENT
/begin MEASUREMENT EngStrt_ctReIniLANSWL200ms "Local variable to store the global post-drive leave counter(SyC_ctPostDrvLeave)" UBYTE OneToOne 1 100 0.00 255.0 FORMAT "%5.1" ECU_ADDRESS 0x600063E7 /end MEASUREMENT
/begin MEASUREMENT EngStrt_facLamWrmUpAftStrt_MP "Measuring point : lambda engine nominal at afterstart and warming up" UWORD fak_uw_b16 1 100 0.00 15.99976 FORMAT "%8.5" ECU_ADDRESS 0x70008D22 /end MEASUREMENT
/begin MEASUREMENT ExhMgT_cntrReIniCoornLamCatHeatg100ms "Counter for Re-Initialization request for LAKH, 100ms" UBYTE OneToOne 1 100 0.00 255.0 FORMAT "%5.1" ECU_ADDRESS 0x600063E9 /end MEASUREMENT
/begin MEASUREMENT ExhMgT_cntrReIniCoornLamCatHeatg10ms "Counter for Re-Initialization request for LAKH, 10ms" UBYTE OneToOne 1 100 0.00 255.0 FORMAT "%5.1" ECU_ADDRESS 0x600063EA /end MEASUREMENT
/begin MEASUREMENT ExhMgt_facIntrpnCatHeatg "weighting factor for the calculation of the engine efficiency degradation during Idle and part load" UBYTE fak_ub_b1 1 100 0.00 0.9961 ECU_ADDRESS 0x6000A3AE /end MEASUREMENT
/begin MEASUREMENT ExhMgT_flgCdnCatHeat "Condition of the request catalyst heating." UBYTE B_TRUE 1 100 0.00 1.00000000000 BIT_MASK 0x1 FORMAT "%13.11" ECU_ADDRESS 0x700001BF /end MEASUREMENT
/begin MEASUREMENT ExhMgT_ratLamCatHeatg "Ratio of lambda of catlysit heating" UWORD fak_q0p000244 1 100 0.00 8.000000 FORMAT "%8.6" ECU_ADDRESS 0x6000372A /end MEASUREMENT
/begin MEASUREMENT ExhMgT_ratLamExhB1 "desired lambda for engine combustion of package ExhMgT (bench1)" UWORD fak_q0p000244 1 100 0.00 15.99976 FORMAT "%8.5" ECU_ADDRESS 0x60004CE4 /end MEASUREMENT
/begin MEASUREMENT ExhMgT_stLamExhB1 "status engine lambda request of package ExhMgT (bank1)" UBYTE OneToOne 1 100 0.00 255.0 FORMAT "%5.1" ECU_ADDRESS 0x6000A3AF /end MEASUREMENT
/begin MEASUREMENT flamsl_w_msg "Factor lambda change by secondary air" UWORD fak_uw_b16 1 100 0.00 15.99976 FORMAT "%8.5" ECU_ADDRESS 0x60004830 /end MEASUREMENT
/begin MEASUREMENT flglrs2_msg "CARB FREEZE FRAME byte, bank 2, for lambda control" UBYTE dez 1 100 0.00 255.0 FORMAT "%5.1" ECU_ADDRESS 0x60009FF6 /end MEASUREMENT
/begin MEASUREMENT flglrs_msg "CARB FREEZE FRAME byte, bank 1, for lambda control" UBYTE dez 1 100 0.00 255.0 FORMAT "%5.1" ECU_ADDRESS 0x6000E44E /end MEASUREMENT
/begin MEASUREMENT frkrini "factor to reinitialize the reference level" UBYTE fak_ub_b16 1 100 0.00 15.94 FORMAT "%5.2" ECU_ADDRESS 0x6000E3BF /end MEASUREMENT
/begin MEASUREMENT HdLi_flgActv "Headlight active" UBYTE B_TRUE 1 100 0.00 1.00000000000 BIT_MASK 0x1 FORMAT "%13.11" ECU_ADDRESS 0x6000A17E /end MEASUREMENT
/begin MEASUREMENT IKCtl_agKnkAvrgGen_s16 "Average value of ignition retardation by knock control, generally (limp-home with safety, fine resolution)" SWORD zw_q0p1 1 100 -3276.800 3276.700 FORMAT "%8.3" ECU_ADDRESS 0x70001D96 /end MEASUREMENT
/begin MEASUREMENT IKCtl_agKnkAvrgGen_s8 "Average value of ignition retardation by knock control, generally (limp-home with safety)" SBYTE kw_q0p75 1 100 -96.00 95.25 FORMAT "%5.2" ECU_ADDRESS 0x70001C4B /end MEASUREMENT
/begin MEASUREMENT IKCtl_agKnkAvrg_s16 "average value of individual ignition retarting by knock control (fine resolution)" SWORD zw_q0p1 1 100 -3276.800 3276.700 FORMAT "%8.3" ECU_ADDRESS 0x60000522 /end MEASUREMENT
/begin MEASUREMENT IKCtl_agKnkAvrg_s8 "average value of cylinder individual ignition retardation by knock control" SBYTE kw_q0p75 1 100 -96.00 95.25 FORMAT "%5.2" ECU_ADDRESS 0x60000788 /end MEASUREMENT
/begin MEASUREMENT IKCtl_agKnkIntCurr_s16 "cylinder-individual ignition angle retarding, druming(fine resolution)" SWORD zw_q0p1 1 100 -3276.800 3276.700 FORMAT "%8.3" ECU_ADDRESS 0x70001942 /end MEASUREMENT
/begin MEASUREMENT IKCtl_agKnkInt_as16 "cylinder individual ignition retarding value of knock control (fine resolution)" SWORD zw_q0p1 1 100 -3276.800 3276.700 FORMAT "%8.3" ARRAY_SIZE 4 ECU_ADDRESS 0x50000518 /end MEASUREMENT
/begin MEASUREMENT IKCtl_agKnkInt_as8 "cylinder individual ignition retarding value of knock control" SBYTE kw_q0p75 1 100 -96.00 95.25 FORMAT "%5.2" ARRAY_SIZE 4 ECU_ADDRESS 0x50000520 /end MEASUREMENT
/begin MEASUREMENT IKCtl_agKnkLimrAvrg_s16 "Average Ignition retard during knocking event(fine resolution)" SWORD zw_q0p1 1 100 -3276.800 3276.700 FORMAT "%8.3" ECU_ADDRESS 0x70001D94 /end MEASUREMENT
/begin MEASUREMENT IKCtl_agKnkMaxLim "upper limit for retardation range around average" SWORD zw_q0p1 1 100 -3276.800 3276.700 FORMAT "%8.3" ECU_ADDRESS 0x70001940 /end MEASUREMENT
/begin MEASUREMENT IKCtl_agKnkRtdtAry_s16 "cylinder individual ignition retardation including dynamics" SWORD zw_q0p1 1 100 -3276.800 3276.700 FORMAT "%8.3" ARRAY_SIZE 4 ECU_ADDRESS 0x50000524 /end MEASUREMENT
/begin MEASUREMENT IKCtl_agKnkRtdt_as8 "cylinder specific ignition-timing retardation with retardation for dynamics" SBYTE kw_q0p75 1 100 -96.00 95.25 FORMAT "%5.2" ARRAY_SIZE 4 ECU_ADDRESS 0x60000350 /end MEASUREMENT
/begin MEASUREMENT IKCtl_agKnkRtdt_s16 "cylinder-specific ignition-timing retardation(fine resolution)" SWORD zw_q0p1 1 100 -3276.800 3276.700 FORMAT "%8.3" ECU_ADDRESS 0x70001D92 /end MEASUREMENT
/begin MEASUREMENT IKCtl_agKnkRtdt_s8 "cylinder-specific ignition-timing retardation" SBYTE kw_q0p75 1 100 -96.00 95.25 FORMAT "%5.2" ECU_ADDRESS 0x70001C4A /end MEASUREMENT
/begin MEASUREMENT IKCtl_agMaxRtdtCurrLoc_s16 "Local variable to select between CEngDsT_t and CHdT_t" SWORD zw_q0p1 1 100 -3276.800 3276.700 FORMAT "%8.3" ECU_ADDRESS 0x6000373A /end MEASUREMENT
/begin MEASUREMENT IKCtl_agMaxRtdtCurr_s16 "current value for retard limitation of the retarding(fine resolution)" SWORD zw_q0p1 1 100 -3276.800 3276.700 FORMAT "%8.3" ECU_ADDRESS 0x50005ACC /end MEASUREMENT
/begin MEASUREMENT IKCtl_agMaxRtdtCurr_s8 "current value for retard limitation of the retarding" SBYTE kw_q0p75 1 100 -96.00 95.25 FORMAT "%5.2" ECU_ADDRESS 0x6000A10A /end MEASUREMENT
/begin MEASUREMENT IKCtl_agRtdtCurrOutp_s16 "current ignition retardation after knock event" SWORD zw_q0p1 1 100 -3276.800 3276.700 FORMAT "%8.3" ECU_ADDRESS 0x60003738 /end MEASUREMENT
/begin MEASUREMENT IKCtl_agRtdtCurr_as16 "current ignition retardation after knock event, cylinder individual" SWORD zw_q0p1 1 100 -3276.800 3276.700 FORMAT "%8.3" ARRAY_SIZE 4 ECU_ADDRESS 0x60000264 /end MEASUREMENT
/begin MEASUREMENT IKCtl_agRtdtLowrCurr_s16 "current min value of range around average" SWORD zw_q0p1 1 100 -3276.800 3276.700 FORMAT "%8.3" ECU_ADDRESS 0x7000193E /end MEASUREMENT
/begin MEASUREMENT IKCtl_agRtdtLowr_s16 "current value for under mean value limitation of the retarding(fine resolution)" SWORD zw_q0p1 1 100 -3276.800 3276.700 FORMAT "%8.3" ECU_ADDRESS 0x60003736 /end MEASUREMENT
/begin MEASUREMENT IKCtl_agRtdtUpprCurr_s16 "current Max-value for band" SWORD zw_q0p1 1 100 -3276.800 3276.700 FORMAT "%8.3" ECU_ADDRESS 0x7000193C /end MEASUREMENT
/begin MEASUREMENT IKCtl_agRtdtUppr_s16 "current value for upper mean value limitation of the retarding(fine resolution)" SWORD zw_q0p1 1 100 -3276.800 3276.700 FORMAT "%8.3" ECU_ADDRESS 0x60003734 /end MEASUREMENT
/begin MEASUREMENT IKCtl_cntrGdCyl_au8 "Cylinder assignment for guided cylinders" UBYTE dez 1 100 0.00 255.0 FORMAT "%5.1" ARRAY_SIZE 4 ECU_ADDRESS 0x6000A03D /end MEASUREMENT
/begin MEASUREMENT IKCtl_cntrReIni100msKRREG "counter reinitializations in 100 ms Task" UBYTE dez 1 100 0.00 255.0 FORMAT "%5.1" ECU_ADDRESS 0x50000850 /end MEASUREMENT
/begin MEASUREMENT IKCtl_cntrReIniSyncKRREG "counter number of reinitialzations in synchronous task" UBYTE dez 1 100 0.00 255.0 FORMAT "%5.1" ECU_ADDRESS 0x50000851 /end MEASUREMENT
/begin MEASUREMENT IKCtl_ctReIniKRKE "Local counter in KRKE for number of driving cycles (leave postdrive) to enable reinitialization" UBYTE OneToOne 1 100 0.00 255.0 FORMAT "%5.1" ECU_ADDRESS 0x600006F7 /end MEASUREMENT
/begin MEASUREMENT IKCtl_facCorrnLoadDyn "correction factor for knock detection threshold during load dynamics" UBYTE fak_ub_b16 1 100 0.063 2.000 FORMAT "%5.3" ECU_ADDRESS 0x600063FF /end MEASUREMENT
/begin MEASUREMENT IKCtl_facCorrnSpdDyn "correction factor for knock detection threshold with engine-speed dynamics" UBYTE fak_ub_b16 1 100 0.063 2.000 FORMAT "%5.3" ECU_ADDRESS 0x600063FE /end MEASUREMENT
/begin MEASUREMENT IKCtl_facFillgRed_u16 "Factor to limit the max. air charge dependent on ignition retardation" UWORD fak_uw_b2 1 100 0.00 1.000000 FORMAT "%8.6" ECU_ADDRESS 0x600048A2 /end MEASUREMENT
/begin MEASUREMENT IKCtl_facKnkInten_au8 "Interface: Ratio integrator, reference level knock control, cylinder selective" UBYTE fak_ub_b16 1 100 0.00 15.94 FORMAT "%5.2" ARRAY_SIZE 4 ECU_ADDRESS 0x500001CC /end MEASUREMENT
/begin MEASUREMENT IKCtl_facKnkInten_u8 "Ratio: integrator / reference level knock control" UBYTE fak_ub_b16 1 100 0.00 15.94 FORMAT "%5.2" ECU_ADDRESS 0x5000088C /end MEASUREMENT
/begin MEASUREMENT IKCtl_flgAdpnWrEnaCopy "knock control: Copy of IKCtl_flgAdpnWrEna (flag read adaption map)" UBYTE B_TRUE 1 100 0.00 1.00000000000 BIT_MASK 0x1 FORMAT "%13.11" ECU_ADDRESS 0x7000074C /end MEASUREMENT
/begin MEASUREMENT IKCtl_flgAdvIa "condition for adjustment of knock control ignition timing to a less retarded value" UBYTE B_TRUE 1 100 0.00 1.00000000000 BIT_MASK 0x1 FORMAT "%13.11" ECU_ADDRESS 0x7000074B /end MEASUREMENT
/begin MEASUREMENT IKCtl_flgKnkDetn "condition for knocking" UBYTE B_TRUE 1 100 0.00 1.00000000000 BIT_MASK 0x1 FORMAT "%13.11" ECU_ADDRESS 0x70000742 /end MEASUREMENT
/begin MEASUREMENT IKCtl_flgSftyRtdtGdCyl "Condition: knock control safety retard adjustment of LZF requested" UBYTE B_TRUE 1 100 0.00 1.00000000000 BIT_MASK 0x1 FORMAT "%13.11" ECU_ADDRESS 0x70000739 /end MEASUREMENT
/begin MEASUREMENT IKCtl_flgTranActv "Transition of injection mode activ" UBYTE B_TRUE 1 100 0.00 1.00000000000 BIT_MASK 0x1 FORMAT "%13.11" ECU_ADDRESS 0x700001C5 /end MEASUREMENT
/begin MEASUREMENT IKCtl_flgTranRefIniTmp "reinitialization in case of switch of injection mode requested" UBYTE B_TRUE 1 100 0.00 1.00000000000 BIT_MASK 0x1 FORMAT "%13.11" ECU_ADDRESS 0x700001C4 /end MEASUREMENT
/begin MEASUREMENT IKCtl_iaOffsfildGdCyl_as16 "filtered Ignition angle offset for guided cylinder(fine resolution)" SWORD zw_q0p1 1 100 -3276.800 3276.700 FORMAT "%8.3" ARRAY_SIZE 4 ECU_ADDRESS 0x70001934 /end MEASUREMENT
/begin MEASUREMENT IKCtl_iaOffsGdCyl_as16 "Ignition angle offset for guided cylinder" SWORD zw_q0p1 1 100 -3276.800 3276.700 FORMAT "%8.3" ARRAY_SIZE 4 ECU_ADDRESS 0x600049CE /end MEASUREMENT
/begin MEASUREMENT IKCtl_nFildGrad_s8 "knock control: engine speed gradient during one working cycle (filtered value)" SBYTE nmotg_sb_q100 1 100 -12800. 12700. FORMAT "%5.0" ECU_ADDRESS 0x5000088D /end MEASUREMENT
/begin MEASUREMENT IKCtl_nrCylFineResl_u8 "Current cylinder number(0.1 res)" UBYTE OneToOne 1 100 0.00 255.0 FORMAT "%5.1" ECU_ADDRESS 0x600063F7 /end MEASUREMENT
/begin MEASUREMENT IKCtl_stCylRefIniEna "Status of the actual transition for refini release" UBYTE dez 1 100 0.00 255.0 FORMAT "%5.1" ECU_ADDRESS 0x600006F8 /end MEASUREMENT
/begin MEASUREMENT IKCtl_stFilSwt "filter center frequency changed" UBYTE dez 1 100 0.00 255.0 FORMAT "%5.1" ECU_ADDRESS 0x5000088F /end MEASUREMENT
/begin MEASUREMENT IKCtl_stMaskGdCly_b8 "mask: guided cylinders" UBYTE dez 1 100 0.00 255.0 FORMAT "%5.1" ECU_ADDRESS 0x6000A03A /end MEASUREMENT
/begin MEASUREMENT IKCtl_stReIniKRLZ "Status ReIni Task for KRLZ" UBYTE dez 1 100 0.00 255.0 FORMAT "%5.1" ECU_ADDRESS 0x70001944 /end MEASUREMENT
/begin MEASUREMENT IKCtl_tEngLoc_s16 "selected temperature input" SWORD Temp_Cels 1 100 -3549.940 3003.560 FORMAT "%8.3" ECU_ADDRESS 0x60003732 /end MEASUREMENT
/begin MEASUREMENT IKCtl_wDetnThdCorr_au8 "knock detection threshold corrected" UBYTE fak_ub_b16 1 100 0.06 15.94 FORMAT "%5.2" ARRAY_SIZE 4 ECU_ADDRESS 0x60000354 /end MEASUREMENT
/begin MEASUREMENT IKCtl_wIntglResLoc_u32 "integral result knock control updated by cylinder counter" ULONG spg_q7p629Em7_V_ms 1 100 0.00 3276.79999924 FORMAT "%13.8" ECU_ADDRESS 0x5000054C /end MEASUREMENT
/begin MEASUREMENT IKCtl_wIntglRes_au32 "integral result kncok control 32Bit" ULONG spg_q7p629Em7_V_ms 1 100 0.00 3276.79999924 FORMAT "%13.8" ARRAY_SIZE 4 ECU_ADDRESS 0x70001DB8 /end MEASUREMENT
/begin MEASUREMENT IKCtl_wIntgRef_au32 "reference level knock control 32bit" ULONG spg_q7p629Em7_V_ms 1 100 0.00 3276.79999924 FORMAT "%13.8" ARRAY_SIZE 4 ECU_ADDRESS 0x60000358 /end MEASUREMENT
/begin MEASUREMENT IKCtl_wMaxLpFilKnk_u32 "maximum allowed value for reference level calculation in case of knocking" ULONG spg_q7p629Em7_V_ms 1 100 0.00000076 3276.79999924 FORMAT "%13.8" ECU_ADDRESS 0x7000194C /end MEASUREMENT
/begin MEASUREMENT IKCtl_wRefMax_u32 "reference level limited upwards, 32bit" ULONG spg_q7p629Em7_V_ms 1 100 0.00000076 3276.79999924 FORMAT "%13.8" ECU_ADDRESS 0x50000550 /end MEASUREMENT
/begin MEASUREMENT ke "knock detection threshold from characteristic map" UBYTE fak_ub_b16 1 100 0.00 15.94 FORMAT "%5.2" ARRAY_SIZE 4 ECU_ADDRESS 0x600063FA /end MEASUREMENT
/begin MEASUREMENT kek_tst "knock detection threshold corrected, updated with cyl.counter" UBYTE fak_ub_b16 1 100 0.06 15.94 FORMAT "%5.2" ECU_ADDRESS 0x6000073F /end MEASUREMENT
/begin MEASUREMENT klopfakt "bit mask for cylinder individual knock events" UBYTE dez 1 100 0.00 255.0 FORMAT "%5.1" ECU_ADDRESS 0x60000740 /end MEASUREMENT
/begin MEASUREMENT krdwsw "current value based on calibration parameter for safety retard" SBYTE kw_q0p75 1 100 -96.00 95.25 FORMAT "%5.2" ECU_ADDRESS 0x6000E3C0 /end MEASUREMENT
/begin MEASUREMENT krftpakt "actual low pass characteristic" UBYTE dez 1 100 1.00 32.00 FORMAT "%5.2" ECU_ADDRESS 0x50000877 /end MEASUREMENT
/begin MEASUREMENT krftpst "Lowpass follow-up factor in stationary operation from characteristic map" UBYTE dez 1 100 4.00 32.00 FORMAT "%5.2" ECU_ADDRESS 0x50005D2D /end MEASUREMENT
/begin MEASUREMENT krlzn "cylinder individuel rpm threshold of guide cylinder function exceeded" UBYTE dez 1 100 0.00 255.0 FORMAT "%5.1" ECU_ADDRESS 0x600063F6 /end MEASUREMENT
/begin MEASUREMENT krlzsfytm "Knock control: delay-counter for safety retard ignition by guide cylinder funct." UBYTE t_q0p1 1 100 0.00 25.50 FORMAT "%5.2" ECU_ADDRESS 0x600063F5 /end MEASUREMENT
/begin MEASUREMENT krvfswz "initialization value for quick advancing, cylinder individual" UBYTE t_q0p1 1 100 0.00 25.50 FORMAT "%5.2" ARRAY_SIZE 4 ECU_ADDRESS 0x600063EF /end MEASUREMENT
/begin MEASUREMENT krvfwz "initialization value for normal advancing, cylinder individual" UBYTE t_q0p1 1 100 0.00 25.50 FORMAT "%5.2" ARRAY_SIZE 4 ECU_ADDRESS 0x600063EB /end MEASUREMENT
/begin MEASUREMENT lambas_msg "basic Lambda" UBYTE fak_ub_b2 1 100 0.00 1.992188 FORMAT "%8.6" ECU_ADDRESS 0x600007B8 /end MEASUREMENT
/begin MEASUREMENT lambas_w_msg "lambda base value" UWORD fak_uw_b16 1 100 0.00 15.99976 FORMAT "%8.5" ECU_ADDRESS 0x60000616 /end MEASUREMENT
/begin MEASUREMENT LamCtrl_flgClsdLoopB1 "Lambda control in closed loop (bank 1)" UBYTE B_TRUE 1 100 0.00 1.00000000000 BIT_MASK 0x1 FORMAT "%13.11" ECU_ADDRESS 0x600000E1 /end MEASUREMENT
/begin MEASUREMENT LamCtrl_flgClsdLoopFltB1 "Lambda control in closed loop but fault with a least one lambda sensor (bank 1)" UBYTE B_TRUE 1 100 0.00 1.00000000000 BIT_MASK 0x1 FORMAT "%13.11" ECU_ADDRESS 0x600000E0 /end MEASUREMENT
/begin MEASUREMENT LamCtrl_flgEngWrmUpB1 "Engine warm-up active (bank 1)" UBYTE B_TRUE 1 100 0.00 1.00000000000 BIT_MASK 0x1 FORMAT "%13.11" ECU_ADDRESS 0x600000DF /end MEASUREMENT
/begin MEASUREMENT LamCtrl_flgFltRdnS1B1 "Lambda sensor fault resetting operational readiness (sensor 1, bank 1)" UBYTE B_TRUE 1 100 0.00 1.00000000000 BIT_MASK 0x1 FORMAT "%13.11" ECU_ADDRESS 0x600000DE /end MEASUREMENT
/begin MEASUREMENT LamCtrl_flgFltS1B1 "Lambda sensor fault (sensor 1, bank 1)" UBYTE B_TRUE 1 100 0.00 1.00000000000 BIT_MASK 0x1 FORMAT "%13.11" ECU_ADDRESS 0x600000DD /end MEASUREMENT
/begin MEASUREMENT LamCtrl_flgOpenLoopB1 "Lambda control in open loop (bank 1)" UBYTE B_TRUE 1 100 0.00 1.00000000000 BIT_MASK 0x1 FORMAT "%13.11" ECU_ADDRESS 0x600000DC /end MEASUREMENT
/begin MEASUREMENT LamCtrl_flgOpenLoopFltB1 "Lambda control in open loop due to fault (bank 1)" UBYTE B_TRUE 1 100 0.00 1.00000000000 BIT_MASK 0x1 FORMAT "%13.11" ECU_ADDRESS 0x600000DB /end MEASUREMENT
/begin MEASUREMENT LamCtrl_mfExhCat1B1 "Mass flow exhaust gas catalyst 1" UWORD m_uw_b6553p5 1 100 0.00 6553.500 FORMAT "%8.3" ECU_ADDRESS 0x60000C24 /end MEASUREMENT
/begin MEASUREMENT LamCtrl_ratLamSpCdaGbxB1 "Target lambda for fuel cut off during gear box intervention" UBYTE fak_ub_b2 1 100 0.00 1.992188 FORMAT "%8.6" ECU_ADDRESS 0x60000C22 /end MEASUREMENT
/begin MEASUREMENT LamCtrl_stBytA "Status of lambda control (PID 03hex, byte A)" UBYTE OneToOne 1 100 0.00 255.0 FORMAT "%5.1" ECU_ADDRESS 0x6000E427 /end MEASUREMENT
/begin MEASUREMENT LamCtrl_stBytAInter "Status of lambda control (PID 03hex, byte A) (intermediate variable)" UBYTE OneToOne 1 100 0.00 255.0 FORMAT "%5.1" ECU_ADDRESS 0x6000E428 /end MEASUREMENT
/begin MEASUREMENT LamCtrl_stBytAInterDeb "Status of lambda control (PID 03hex, byte A) (debounced intermediate variable)" UBYTE OneToOne 1 100 0.00 255.0 FORMAT "%5.1" ECU_ADDRESS 0x6000A032 /end MEASUREMENT
/begin MEASUREMENT LamCtrl_stBytAOld "Status of lambda control (PID 03hex, byte A) (old value)" UBYTE OneToOne 1 100 0.00 255.0 FORMAT "%5.1" ECU_ADDRESS 0x6000A031 /end MEASUREMENT
/begin MEASUREMENT LamCtrl_stBytB "Status of lambda control (PID 03hex, byte B)" UBYTE OneToOne 1 100 0.00 255.0 FORMAT "%5.1" ECU_ADDRESS 0x6000A030 /end MEASUREMENT
/begin MEASUREMENT LamCtrl_tCat1B1 "Temperature in catalyst 1" UWORD temp_q0p0234_o273 1 100 -273.150 1262.827 FORMAT "%8.3" ECU_ADDRESS 0x60000C20 /end MEASUREMENT
/begin MEASUREMENT lamdiag_w_msg "Lambda nominal value from diagnosis functions" UWORD fak_uw_b16 1 100 0.00 15.99976 FORMAT "%8.5" ECU_ADDRESS 0x6000E316 /end MEASUREMENT
/begin MEASUREMENT lamexht_w_msg "desired lambda for engine combustion of package Exhaust temperature management bank 1" UWORD fak_q0p000244 1 100 0.00 15.99976 FORMAT "%8.5" ECU_ADDRESS 0x70002CF8 /end MEASUREMENT
/begin MEASUREMENT lamkhg_w "Lambda engine nominal at catalyst heating (word) weighted by flakh" UWORD fak_q0p000244 1 100 0.00 15.99976 FORMAT "%8.5" ECU_ADDRESS 0x60003730 /end MEASUREMENT
/begin MEASUREMENT lamkhr_w "Lambda engine result at catalyst heating (word)" UWORD fak_q0p000244 1 100 0.00 15.99976 FORMAT "%8.5" ECU_ADDRESS 0x60003728 /end MEASUREMENT
/begin MEASUREMENT lamkh_w_msg "Lambda engine nominal at catalyst heating (word)" UWORD fak_q0p000244 1 100 0.00 15.99976 FORMAT "%8.5" ECU_ADDRESS 0x70002CFA /end MEASUREMENT
/begin MEASUREMENT lamlgfmn_w_msg "lambda limit rich (word)" UWORD fak_uw_b16 1 100 0.00 15.99976 FORMAT "%8.5" ECU_ADDRESS 0x60004820 /end MEASUREMENT
/begin MEASUREMENT lamlgm_w_msg "lambda limit lean" UWORD fak_uw_b16 1 100 0.00 15.99976 FORMAT "%8.5" ECU_ADDRESS 0x60000618 /end MEASUREMENT
/begin MEASUREMENT lamnswl_w_msg "lambda engine nominal at afterstart and warming up" UWORD fak_uw_b16 1 100 0.00 15.99976 FORMAT "%8.5" ECU_ADDRESS 0x60004BF8 /end MEASUREMENT
/begin MEASUREMENT lamns_w_msg "lambda engine nominal during afterstart" UWORD fak_uw_b16 1 100 0.00 15.99976 FORMAT "%8.5" ECU_ADDRESS 0x60004BFA /end MEASUREMENT
/begin MEASUREMENT lamsbg_w_msg "Lambda setpoint in combustion chamber, limited" UWORD fak_uw_b16 1 100 0.00 15.99976 FORMAT "%8.5" ECU_ADDRESS 0x6000061C /end MEASUREMENT
/begin MEASUREMENT lamsubg_w "Lambda nominal unlimited (word)" UWORD fak_uw_b16 1 100 0.00 15.99976 FORMAT "%8.5" ECU_ADDRESS 0x60000C1E /end MEASUREMENT
/begin MEASUREMENT lams_w_msg "nominal Lambda value" UWORD fak_uw_b16 1 100 0.00 15.99976 FORMAT "%8.5" ECU_ADDRESS 0x6000E318 /end MEASUREMENT
/begin MEASUREMENT lamwbr_w "Desired in-cylinder lambda selected from the lambda requests sent to LAMKO" UWORD fak_uw_b16 1 100 0.00 15.99976 FORMAT "%8.5" ECU_ADDRESS 0x60000C1C /end MEASUREMENT
/begin MEASUREMENT lamwl_w "lambda engine nominal at warming up" UWORD fak_uw_b16 1 100 0.00 15.99976 FORMAT "%8.5" ECU_ADDRESS 0x6000481C /end MEASUREMENT
/begin MEASUREMENT lanskh_w "lambda engine nominal during afterstart at catalyst heating" UWORD fak_q0p000244 1 100 0.00 15.99976 FORMAT "%8.5" ECU_ADDRESS 0x6000372E /end MEASUREMENT
/begin MEASUREMENT LIGov_bCalcPreCtl "Condition calculate pre control" UBYTE B_TRUE 1 100 0.00 1.00000000000 BIT_MASK 0x1 FORMAT "%13.11" ECU_ADDRESS 0x70000713 /end MEASUREMENT
/begin MEASUREMENT LIGov_bEnblI "Condition activated integrator" UBYTE B_TRUE 1 100 0.00 1.00000000000 BIT_MASK 0x1 FORMAT "%13.11" ECU_ADDRESS 0x70000712 /end MEASUREMENT
/begin MEASUREMENT LIGov_bExtTrqDem "Condition external torque demand" UBYTE B_TRUE 1 100 0.00 1.00000000000 BIT_MASK 0x1 FORMAT "%13.11" ECU_ADDRESS 0x70000711 /end MEASUREMENT
/begin MEASUREMENT LIGov_bFrzI "Condition freeze integrator" UBYTE B_TRUE 1 100 0.00 1.00000000000 BIT_MASK 0x1 FORMAT "%13.11" ECU_ADDRESS 0x70000710 /end MEASUREMENT
/begin MEASUREMENT LIGov_bFrzIDiag "Condition freeze integrator because of reaching the lower physical operation limit" UBYTE B_TRUE 1 100 0.00 1.00000000000 BIT_MASK 0x1 FORMAT "%13.11" ECU_ADDRESS 0x7000070F /end MEASUREMENT
/begin MEASUREMENT LIGov_bGear1 "Condition parameter set for first gear" UBYTE B_TRUE 1 100 0.00 1.00000000000 BIT_MASK 0x1 FORMAT "%13.11" ECU_ADDRESS 0x7000070E /end MEASUREMENT
/begin MEASUREMENT LIGov_bInactv "Condition idle speed controller inactive" UBYTE B_TRUE 1 100 0.00 1.00000000000 BIT_MASK 0x1 FORMAT "%13.11" ECU_ADDRESS 0x7000070D /end MEASUREMENT
/begin MEASUREMENT LIGov_bIniPredefTrq "Condition initialize with predefined torque" UBYTE B_TRUE 1 100 0.00 1.00000000000 BIT_MASK 0x1 FORMAT "%13.11" ECU_ADDRESS 0x7000070C /end MEASUREMENT
/begin MEASUREMENT LIGov_bLoSpdExs "Condition overspeed after start" UBYTE B_TRUE 1 100 0.00 1.00000000000 BIT_MASK 0x1 FORMAT "%13.11" ECU_ADDRESS 0x700001BD /end MEASUREMENT
/begin MEASUREMENT LIGov_bNoGrip "Condition no grip, open powertrain" UBYTE B_TRUE 1 100 0.00 1.00000000000 BIT_MASK 0x1 FORMAT "%13.11" ECU_ADDRESS 0x7000070B /end MEASUREMENT
/begin MEASUREMENT LIGov_bNPreCtl "Condition dependent on engine speed for usage of pre control (D-part)" UBYTE B_TRUE 1 100 0.00 1.00000000000 BIT_MASK 0x1 FORMAT "%13.11" ECU_ADDRESS 0x700001BC /end MEASUREMENT
/begin MEASUREMENT LIGov_bOvrRunEF_I.buffer "Turn Off Delay fuel cut off / memory to detect falling edge" UBYTE B_TRUE 1 100 0.00 1.00000000000 BIT_MASK 0x1 FORMAT "%13.11" ECU_ADDRESS 0x70001918 /end MEASUREMENT
/begin MEASUREMENT LIGov_bOvrRunEF_I.oldSignal "Turn Off Delay fuel cut off / memory to detect falling edge" UBYTE B_TRUE 1 100 0.00 1.00000000000 BIT_MASK 0x1 FORMAT "%13.11" ECU_ADDRESS 0x70001919 /end MEASUREMENT
/begin MEASUREMENT LIGov_bParChng "Condition change of parameter set" UBYTE B_TRUE 1 100 0.00 1.00000000000 BIT_MASK 0x1 FORMAT "%13.11" ECU_ADDRESS 0x7000070A /end MEASUREMENT
/begin MEASUREMENT LIGov_bParChngTrqP "Condition change of P-parameter set" UBYTE B_TRUE 1 100 0.00 1.00000000000 BIT_MASK 0x1 FORMAT "%13.11" ECU_ADDRESS 0x70000709 /end MEASUREMENT
/begin MEASUREMENT LIGov_bPreCtlUndrSpd "Activation and calculation D-part because of underspeed" UBYTE B_TRUE 1 100 0.00 1.00000000000 BIT_MASK 0x1 FORMAT "%13.11" ECU_ADDRESS 0x70000708 /end MEASUREMENT
/begin MEASUREMENT LIGov_bRlsPreCtl "Release of pre-control" UBYTE B_TRUE 1 100 0.00 1.00000000000 BIT_MASK 0x1 FORMAT "%13.11" ECU_ADDRESS 0x70000707 /end MEASUREMENT
/begin MEASUREMENT LIGov_bRlsPredef "Release of predefined torque" UBYTE B_TRUE 1 100 0.00 1.00000000000 BIT_MASK 0x1 FORMAT "%13.11" ECU_ADDRESS 0x70000706 /end MEASUREMENT
/begin MEASUREMENT LIGov_bRmpDwn "Condition 'ramping down the output torques of the idle speed controller' for preparing fuel cutoff" UBYTE B_TRUE 1 100 0.00 1.00000000000 BIT_MASK 0x1 FORMAT "%13.11" ECU_ADDRESS 0x70001BEC /end MEASUREMENT
/begin MEASUREMENT LIGov_bRstI "Condition reset integrator" UBYTE B_TRUE 1 100 0.00 1.00000000000 BIT_MASK 0x1 FORMAT "%13.11" ECU_ADDRESS 0x70000705 /end MEASUREMENT
/begin MEASUREMENT LIGov_bStrtPar "Condition use start parameters" UBYTE B_TRUE 1 100 0.00 1.00000000000 BIT_MASK 0x1 FORMAT "%13.11" ECU_ADDRESS 0x700001BB /end MEASUREMENT
/begin MEASUREMENT LIGov_bUbr "Condition Underbraking" UBYTE B_TRUE 1 100 0.00 1.00000000000 BIT_MASK 0x1 FORMAT "%13.11" ECU_ADDRESS 0x70000704 /end MEASUREMENT
/begin MEASUREMENT LIGov_bWrm "Condition warm engine" UBYTE B_TRUE 1 100 0.00 1.00000000000 BIT_MASK 0x1 FORMAT "%13.11" ECU_ADDRESS 0x70000703 /end MEASUREMENT
/begin MEASUREMENT LIGov_facPreCtlRmp "Ramp factor for precontrol of the drag torque of the engine" UWORD fak_uw_b2 1 100 0.00 1.000000 FORMAT "%8.6" ECU_ADDRESS 0x7000192A /end MEASUREMENT
/begin MEASUREMENT LIGov_facPreCtlRmpMax "maximum ramp factor for precontrol of the drag torque of the engine" UWORD fak_q3p0518Em5 1 100 0.00 1.000000 FORMAT "%8.6" ECU_ADDRESS 0x70001CE6 /end MEASUREMENT
/begin MEASUREMENT LIGov_facThrStabAc "unlimited stabilization factor" UWORD fak_uw_b2 1 100 0.00 1.999969 FORMAT "%8.6" ECU_ADDRESS 0x70001CE4 /end MEASUREMENT
/begin MEASUREMENT LIGov_flgExtTrqDemMskSeln "alternative bit mask for external torque demands" UBYTE B_TRUE 1 100 0.00 1.00000000000 BIT_MASK 0x1 FORMAT "%13.11" ECU_ADDRESS 0x70000702 /end MEASUREMENT
/begin MEASUREMENT LIGov_flgSrvCouplrSwtSt "Service coupler disable switch" UBYTE B_TRUE 1 100 0.00 1.00000000000 BIT_MASK 0x1 FORMAT "%13.11" ECU_ADDRESS 0x70001928 /end MEASUREMENT
/begin MEASUREMENT LIGov_nDiff "current setpoint deviation" SWORD nmot_q0p5 1 100 -16384.00 16383.50 FORMAT "%8.2" ECU_ADDRESS 0x50000704 /end MEASUREMENT
/begin MEASUREMENT LIGov_nDiffNSetNEng "Ratio of set- and actual-speed" UWORD fak_uw_b2 1 100 0.00 1.999969 FORMAT "%8.6" ECU_ADDRESS 0x70001926 /end MEASUREMENT
/begin MEASUREMENT LIGov_nDiffOld "previous setpoint deviation" SWORD nmot_q0p5 1 100 -16384.00 16383.50 FORMAT "%8.2" ECU_ADDRESS 0x70001D6C /end MEASUREMENT
/begin MEASUREMENT LIGov_nPreCtl "speed limit for precontrol" SWORD nmot_sw_q0p5 1 100 -16384.00 16383.50 FORMAT "%8.2" ECU_ADDRESS 0x7000191C /end MEASUREMENT
/begin MEASUREMENT LIGov_numPar "current parameter set" UBYTE dez 1 100 0.00 255.0 FORMAT "%5.1" ECU_ADDRESS 0x70001C1F /end MEASUREMENT
/begin MEASUREMENT LIGov_numParTrqI "current parameter set I-part" UBYTE dez 1 100 0.00 255.0 FORMAT "%5.1" ECU_ADDRESS 0x70001C1E /end MEASUREMENT
/begin MEASUREMENT LIGov_numParTrqP "current parameter set P-part" UBYTE dez 1 100 0.00 255.0 FORMAT "%5.1" ECU_ADDRESS 0x70001C1D /end MEASUREMENT
/begin MEASUREMENT LIGov_stExtTrqDemMskSeln "state alternative bit mask for external torque demands" UWORD OneToOne 1 100 0.00 65535.00 FORMAT "%8.2" ECU_ADDRESS 0x70001CE2 /end MEASUREMENT
/begin MEASUREMENT LIGov_stIdleSpdDrvr "Idle speed status from drivers sight" UBYTE B_TRUE 1 100 0.00 1.00000000000 BIT_MASK 0x1 FORMAT "%13.11" ECU_ADDRESS 0x7000191A /end MEASUREMENT
/begin MEASUREMENT LIGov_stOvrRun "Condition overrun fuel cut-off for idle speed controller" UBYTE B_TRUE 1 100 0.00 1.00000000000 BIT_MASK 0x1 FORMAT "%13.11" ECU_ADDRESS 0x70001BEB /end MEASUREMENT
/begin MEASUREMENT LIGov_tiSync "segment time of idle speed control" UWORD t_q1p5259Em5_s 1 100 0.00 0.9999847 FORMAT "%9.7" ECU_ADDRESS 0x70001CE0 /end MEASUREMENT
/begin MEASUREMENT LIGov_tqThrStabAc "Torque for Pre-Control dependend on engine speed-stabilization factor" SWORD md_q0p1 1 100 -3276.800 3276.700 FORMAT "%8.3" ECU_ADDRESS 0x70001924 /end MEASUREMENT
/begin MEASUREMENT LIGov_trq "demanded torque of LIGov" SWORD md_q0p1 1 100 -3276.800 3276.700 FORMAT "%8.3" ECU_ADDRESS 0x70001D6A /end MEASUREMENT
/begin MEASUREMENT LIGov_trqI "value for I-part of torque" SWORD md_q0p1 1 100 -3276.800 3276.700 FORMAT "%8.3" ECU_ADDRESS 0x70001D68 /end MEASUREMENT
/begin MEASUREMENT LIGov_trqIDiff_MP "Amplification factor I-part Low-Idle-Governor (measurement point)" SWORD md_q0p1 1 100 -3276.800 3276.700 FORMAT "%8.3" ECU_ADDRESS 0x70008D20 /end MEASUREMENT
/begin MEASUREMENT LIGov_trqIgnFixPreCtl "Precontrol torque of ISC while ignition angle is fixed by tester" SWORD md_q0p1 1 100 -3276.800 3276.700 FORMAT "%8.3" ECU_ADDRESS 0x70001922 /end MEASUREMENT
/begin MEASUREMENT LIGov_trqIntegIPrmChg_MP "Offset-correction of I-part Idle-Speed-Governor by Parameter_Change (measurement point)" SLONG md_q1p526Em6 1 100 -3276.80000000 3276.79999847 FORMAT "%13.8" ECU_ADDRESS 0x70008D1C /end MEASUREMENT
/begin MEASUREMENT LIGov_trqIntegIRst_MP "Resetting of I-part Idle-Speed-Governor (measurement point)" SLONG md_q1p526Em6 1 100 -3276.80000000 3276.79999847 FORMAT "%13.8" ECU_ADDRESS 0x70008D18 /end MEASUREMENT
/begin MEASUREMENT LIGov_trqIntegI_MP "Value of I-part Low-Idle-Governor (measurement point)" SLONG md_q1p526Em6 1 100 -3276.80000000 3276.79999847 FORMAT "%13.8" ECU_ADDRESS 0x70008D14 /end MEASUREMENT
/begin MEASUREMENT LIGov_trqI_mp "temporary torque offset for I-par" SWORD md_q0p1 1 100 -3276.800 3276.700 FORMAT "%8.3" ECU_ADDRESS 0x70008D10 /end MEASUREMENT
/begin MEASUREMENT LIGov_trqLead "idle speed controller torque air path" SWORD md_q0p1 1 100 -3276.800 3276.700 FORMAT "%8.3" ECU_ADDRESS 0x70001D66 /end MEASUREMENT
/begin MEASUREMENT LIGov_trqMax "maximal idle speed torque" SWORD md_q0p1 1 100 -3276.800 3276.700 FORMAT "%8.3" ECU_ADDRESS 0x70001D64 /end MEASUREMENT
/begin MEASUREMENT LIGov_trqMin "minimum inner torque idle speed control" SWORD md_q0p1 1 100 -3276.800 3276.700 FORMAT "%8.3" ECU_ADDRESS 0x70001D62 /end MEASUREMENT
/begin MEASUREMENT LIGov_trqP "value for P-part of torque" SWORD md_q0p1 1 100 -3276.800 3276.700 FORMAT "%8.3" ECU_ADDRESS 0x70001D60 /end MEASUREMENT
/begin MEASUREMENT LIGov_trqPLead "P-part idle speed torque for air path" SWORD md_q0p1 1 100 -3276.800 3276.700 FORMAT "%8.3" ECU_ADDRESS 0x70001D5E /end MEASUREMENT
/begin MEASUREMENT LIGov_trqPreCtl "Precontrol of the drag torque" SWORD md_q0p1 1 100 -3276.800 3276.700 FORMAT "%8.3" ECU_ADDRESS 0x70001D5C /end MEASUREMENT
/begin MEASUREMENT LIGov_trqPRmp "torque ramp for the p-part of the idle speed controller" SWORD md_q0p1 1 100 0.00 3276.700 FORMAT "%8.3" ECU_ADDRESS 0x70001920 /end MEASUREMENT
/begin MEASUREMENT LIGov_tStrtloc "engine temperature at start" UBYTE temp_ub_q0p75_o48 1 100 -48.0 143.3 FORMAT "%5.1" ECU_ADDRESS 0x7000191E /end MEASUREMENT
/begin MEASUREMENT Linappl_stFrmErr "Status of LIN error for every frame" UBYTE OneToOne 1 100 0.00 255.0 FORMAT "%5.1" ARRAY_SIZE 19 ECU_ADDRESS 0x600063CE /end MEASUREMENT
/begin MEASUREMENT Linappl_stFrmErrOld "Old value for status of LIN error for every frame" UBYTE OneToOne 1 100 0.00 255.0 FORMAT "%5.1" ARRAY_SIZE 19 ECU_ADDRESS 0x600063BB /end MEASUREMENT
/begin MEASUREMENT Linappl_stFrmTxdRxd "Status of that frame is transmitted or received" ULONG OneToOne 1 100 0.00 4294967295.00 FORMAT "%13.2" ECU_ADDRESS 0x5000174C /end MEASUREMENT
/begin MEASUREMENT Linappl_stFrstFrmRxd "Flag for first reception is done after IG-On for each frame" ULONG OneToOne 1 100 0.00 4294967295.00 FORMAT "%13.2" ECU_ADDRESS 0x60001384 /end MEASUREMENT
/begin MEASUREMENT Linappl_stNodErr "LIN Node Error Status" UBYTE OneToOne 1 100 0.00 255.0 FORMAT "%5.1" ARRAY_SIZE 4 ECU_ADDRESS 0x600063B7 /end MEASUREMENT
/begin MEASUREMENT LLim_aMSL_mp "Acceleration limit from Maximum SL" SWORD Acc 1 100 -32.76800 32.76700 FORMAT "%8.5" ECU_ADDRESS 0x70008D0E /end MEASUREMENT
/begin MEASUREMENT LLim_aReq "Requested acceleration of Speed Limiter" SWORD Acc 1 100 -32.76800 32.76700 FORMAT "%8.5" ECU_ADDRESS 0x6000500E /end MEASUREMENT
/begin MEASUREMENT LLim_axReq "Ramped acceleration request of Speed Limiter" SWORD Acc 1 100 -32.76800 32.76700 FORMAT "%8.5" ECU_ADDRESS 0x6000500C /end MEASUREMENT
/begin MEASUREMENT LLim_bFcoDes "Desired fuel cutoff" UBYTE B_TRUE 1 100 0.00 1.00000000000 BIT_MASK 0x1 FORMAT "%13.11" ECU_ADDRESS 0x70000701 /end MEASUREMENT
/begin MEASUREMENT LLim_dvMSL_mp "Difference of current velocity to maximum vehicle velocity" SWORD Vel 1 100 -327.6800 327.6700 FORMAT "%8.4" ECU_ADDRESS 0x70008D0C /end MEASUREMENT
/begin MEASUREMENT LLim_flgRmpFailr "Flag active ramp of speed limitation when chassis failure" UBYTE B_TRUE 1 100 0.00 1.00000000000 BIT_MASK 0x1 FORMAT "%13.11" ECU_ADDRESS 0x6000A179 /end MEASUREMENT
/begin MEASUREMENT LLim_stMSLActv "Condition Maximum Speed limiter is active" UBYTE OneToOne 1 100 0.00 255.0 FORMAT "%5.1" ECU_ADDRESS 0x6000A36E /end MEASUREMENT
/begin MEASUREMENT LLim_stReq "Status of acceleration request of Speed limiter" UBYTE B_TRUE 1 100 0.00 1.00000000000 BIT_MASK 0x1 FORMAT "%13.11" ECU_ADDRESS 0x6000A178 /end MEASUREMENT
/begin MEASUREMENT LLim_vMaxMSLFailr "Vehicle velocity limited when chassis failure" SWORD Vel 1 100 -327.6800 327.6700 FORMAT "%8.4" ECU_ADDRESS 0x60005004 /end MEASUREMENT
/begin MEASUREMENT LLim_vMaxMSL_mp "Maximum Limit Speed" SWORD Vel 1 100 -327.6800 327.6700 FORMAT "%8.4" ECU_ADDRESS 0x70008D0A /end MEASUREMENT
/begin MEASUREMENT lmskh_w "Lambda engine nominal at catalyst heating (word)" UWORD fak_q0p000244 1 100 0.00 15.99976 FORMAT "%8.5" ECU_ADDRESS 0x60003726 /end MEASUREMENT
/begin MEASUREMENT maskeks "mask: knock sensor defect" UBYTE dez 1 100 0.00 255.0 FORMAT "%5.1" ECU_ADDRESS 0x600063F4 /end MEASUREMENT
/begin MEASUREMENT maskgz_old "mask: last guided cylinders" UBYTE dez 1 100 0.00 255.0 FORMAT "%5.1" ECU_ADDRESS 0x70001932 /end MEASUREMENT
/begin MEASUREMENT masklz "mask: guiding cylinders" UBYTE dez 1 100 0.00 255.0 FORMAT "%5.1" ECU_ADDRESS 0x600063F3 /end MEASUREMENT
/begin MEASUREMENT mkrzwsp "Knock control: bit mask ignition retard of guiding cylinder >0" UBYTE dez 1 100 0.00 255.0 FORMAT "%5.1" ECU_ADDRESS 0x70001931 /end MEASUREMENT
/begin MEASUREMENT rkrmn_w "current value of curve KLRKRMN" UWORD spg_q3p906Em4_V_ms 1 100 0.00 25.59961 FORMAT "%8.5" ECU_ADDRESS 0x6000D9C0 /end MEASUREMENT
/begin MEASUREMENT rkrmx1n_w "instantaneous value of the characteristic line RKRMX1N" UWORD spg_q3p906Em4_V_ms 1 100 0.00 25.59961 FORMAT "%8.5" ECU_ADDRESS 0x6000D9C2 /end MEASUREMENT
/begin MEASUREMENT rkrmx2n_w "instantaneous value of the characteristic line RKRMX2N" UWORD spg_q3p906Em4_V_ms 1 100 0.00 25.59961 FORMAT "%8.5" ECU_ADDRESS 0x6000D9C4 /end MEASUREMENT
/begin MEASUREMENT rkr_tst_l "reference level knock control updated with cyl.counter, 32bit" ULONG spg_q7p629Em7_V_ms 1 100 0.00 3276.79999924 FORMAT "%13.8" ECU_ADDRESS 0x70001948 /end MEASUREMENT
/begin MEASUREMENT SpdCtl_flgSynIninReqDrv "Initialization request during transition to Drive state for Synchro-task in Spdctl package." UBYTE B_TRUE 1 100 0.00 1.00000000000 BIT_MASK 0x1 FORMAT "%13.11" ECU_ADDRESS 0x70000684 /end MEASUREMENT
/begin MEASUREMENT SpdCtl_flgSynPstDrvBreak "Flag to prevent execution of Synchro-processes of Spdctl during Post-Drive state." UBYTE B_TRUE 1 100 0.00 1.00000000000 BIT_MASK 0x1 FORMAT "%13.11" ECU_ADDRESS 0x70000683 /end MEASUREMENT
/begin MEASUREMENT SpdCtl_flgSynStrtInitReq "Flag to indicate the start of Init of all the Synchro-tasks in Spdctl package." UBYTE B_TRUE 1 100 0.00 1.00000000000 BIT_MASK 0x1 FORMAT "%13.11" ECU_ADDRESS 0x70000682 /end MEASUREMENT
/begin MEASUREMENT stlamexhtm_msg "status of the lambda co-ordination of the exhaust temperature management" UBYTE dez 1 100 0.00 255.0 FORMAT "%5.1" ECU_ADDRESS 0x6000A289 /end MEASUREMENT
/begin MEASUREMENT tmcyla_w "engine temperature (eng. coolant or cyl. head), local copy" SWORD Temp_Cels 1 100 -3549.940 3003.560 FORMAT "%8.3" ECU_ADDRESS 0x60003724 /end MEASUREMENT
/begin MEASUREMENT tmotlanswl "local copy engine temperature (engine coolant or cylinder head)" UBYTE temp_ub_q0p75_o48 1 100 -48.0 143.3 FORMAT "%5.1" ECU_ADDRESS 0x70002D6E /end MEASUREMENT
/begin MEASUREMENT tmstcyla_w "engine temperature at start (eng. coolant or cyl. head), local copy" SWORD Temp_Cels 1 100 -3549.940 3003.560 FORMAT "%8.3" ECU_ADDRESS 0x6000372C /end MEASUREMENT
/begin MEASUREMENT tmstlanswl "local copy engine start temperature (engine coolant or cylinder head)" UBYTE temp_ub_q0p75_o48 1 100 -48.0 143.3 FORMAT "%5.1" ECU_ADDRESS 0x600063E5 /end MEASUREMENT
/begin MEASUREMENT vszwm "mean value of adjustment ignition angle with calibration tool (e.g. VS2x)" SBYTE kw_q0p75 1 100 -96.00 95.25 FORMAT "%5.2" ECU_ADDRESS 0x60000748 /end MEASUREMENT
/begin MEASUREMENT wkrlzofv_bits "Filtering from Offset of guided cylinder is running" UBYTE dez 1 100 0.00 255.0 FORMAT "%5.1" ECU_ADDRESS 0x70001930 /end MEASUREMENT
/begin MEASUREMENT zkrfmu "Counter of filter frequency changes, KC" UBYTE dez 1 100 0.00 255.0 FORMAT "%5.1" ARRAY_SIZE 4 ECU_ADDRESS 0x5000049C /end MEASUREMENT
/begin MEASUREMENT zkrvf "counter, determines the frequency of the cylinder-individual ignition angle advancing" UBYTE t_q0p1 1 100 0.00 25.50 FORMAT "%5.2" ARRAY_SIZE 4 ECU_ADDRESS 0x60000330 /end MEASUREMENT
/begin MEASUREMENT zlamkod "Number of the highest-prioritized lambda request from diagnosis functions" UBYTE dez 1 100 0.00 255.0 FORMAT "%5.1" ECU_ADDRESS 0x60000B0B /end MEASUREMENT
/begin MEASUREMENT zlamkoz "Number of the lambda request determining the lambda setpoint (intermediate value)" UBYTE dez 1 100 0.00 255.0 FORMAT "%5.1" ECU_ADDRESS 0x60000C1B /end MEASUREMENT
/begin MEASUREMENT zlamko_msg "Number of the lambda request determining the lambda setpoint" UBYTE dez 1 100 0.00 255.0 FORMAT "%5.1" ECU_ADDRESS 0x600007C2 /end MEASUREMENT
/begin MEASUREMENT zoffset "counter for ignition angle offset of guiding cylinder" UBYTE dez 1 100 0.00 255.0 FORMAT "%5.1" ARRAY_SIZE 4 ECU_ADDRESS 0x7000192C /end MEASUREMENT
/begin FUNCTION KRKE "50.0.0    Knocking detection"
 /begin DEF_CHARACTERISTIC CWKRREF CWREFI FKEFMC IKCtl_facCorrnLoadDyn_GT IKCtl_facCorrnNDyn_GT IKCtl_FacKnockDetThd0_GM IKCtl_FacKnockDetThd1_GM IKCtl_FacKnockDetThd2_GM IKCtl_FacKnockDetThd3_GM IKCtl_FacKnockTrck_AX IKCtl_facMaxLpFilKnkDetn_T IKCtl_facRefLvlReIni_C IKCtl_stCorrFil_C IKCtl_stFacRefLvlReIniSeln_C IKCtl_stKnkSeln_C IKCtl_stRefLvlReIni_C IKCtl_stVlvlftdynSeln_C IKCtl_wStrtRef_C KLFRKRINI KLRKRMN KRFTP2 KRFTP3 KRKFKS KRNGFILO KRNGFILU RKRMX1N RKRMX2N TKRVHEU ZKRNGFIL ZYRKR /end DEF_CHARACTERISTIC
 /begin REF_CHARACTERISTIC IKCtl_nEngVar13_X_AX IKCtl_ratLoad04_X_AX /end REF_CHARACTERISTIC
 /begin IN_MEASUREMENT AirMod_ratChrgAirCyl B_krvhdy_msg EngStrt_bStrtEnd Epm_dnEngAvg Epm_nEng Epm_nEngLRes Epm_numCyl Ign_bVlvLInNxtCmbs IKCtl_cntrCyl IKCtl_flgFilSwt IKCtl_flgKnkEna IKCtl_flgKnkLimp IKCtl_flgLoadDynDetn IKCtl_flgSpdDynDetn IKCtl_IntglCh1_au32 IKCtl_stVldnSnsrSig SyC_ctPostDrvLeave SyC_stSub /end IN_MEASUREMENT
 /begin OUT_MEASUREMENT IKCtl_facKnkInten_au8 IKCtl_facKnkInten_u8 IKCtl_flgKnkDetn IKCtl_nFildGrad_s8 IKCtl_stFilSwt IKCtl_wDetnThdCorr_au8 IKCtl_wIntglResLoc_u32 IKCtl_wIntglRes_au32 IKCtl_wIntgRef_au32 IKCtl_wRefMax_u32 /end OUT_MEASUREMENT
 /begin LOC_MEASUREMENT frkrini IKCtl_ctReIniKRKE IKCtl_facCorrnLoadDyn IKCtl_facCorrnSpdDyn IKCtl_flgTranActv IKCtl_flgTranRefIniTmp IKCtl_stCylRefIniEna IKCtl_wMaxLpFilKnk_u32 ke kek_tst krftpakt krftpst rkrmn_w rkrmx1n_w rkrmx2n_w rkr_tst_l zkrfmu /end LOC_MEASUREMENT
 FUNCTION_VERSION "50.0.0" /end FUNCTION
/begin FUNCTION KRLZ "3.5.0     Knock control: guide cylinder function"
 /begin DEF_CHARACTERISTIC IKCtl_facOffsGdCyl_M IKCtl_facThdMaxGdCly IKCtl_facThdMinGdCly IKCtl_iaOffsGdCyl_M IKCtl_iaOffsKnkSnsrErr_C IKCtl_ratLoadThdGdCyl_CA IKCtl_stLimp_C LZFUERV MINAKRLZ TKRLZAMN /end DEF_CHARACTERISTIC
 /begin REF_CHARACTERISTIC IKCtl_idxAsgnSnsr_CA /end REF_CHARACTERISTIC
 /begin IN_MEASUREMENT AirMod_ratChrgAirCyl Epm_nEng Epm_numCyl IKCtl_agKnkInt_as16 IKCtl_flgKnkEna IKCtl_flgKnkLimp IKCtl_stInjDTot_b8 IKCtl_stSnsrErr_u8 SyC_stSub /end IN_MEASUREMENT
 /begin OUT_MEASUREMENT IKCtl_cntrGdCyl_au8 IKCtl_flgSftyRtdtGdCyl IKCtl_iaOffsGdCyl_as16 IKCtl_stMaskGdCly_b8 /end OUT_MEASUREMENT
 /begin LOC_MEASUREMENT akrgz akrlz B_elzmn B_krlz B_krnlzdws B_lzup IKCtl_nrCylFineResl_u8 IKCtl_stReIniKRLZ krlzn krlzsfytm maskeks masklz /end LOC_MEASUREMENT
 FUNCTION_VERSION "3.5.0" /end FUNCTION
/begin FUNCTION KRREG "32.8.0    Knock control: stationary control"
 /begin DEF_CHARACTERISTIC CWKRLZFK CWKRLZOFV CWKROFFGZ CWVFN IKCtl_agKnkRtdt_M IKCtl_agLimnAdpnLoadDyn_M IKCtl_agLimnAdpnPosDeLoadDyn_M IKCtl_agLimnAdpnPosDeSpdDyn_M IKCtl_agLimnAdpnSpdDyn_M IKCtl_agLowrDistRtdt_GT IKCtl_agMaxRtdtCurr_M IKCtl_agUpprDistRtdt_GT IKCtl_facMaxRtdtHiVlvLft_M IKCtl_facMaxRtdtLoVlvLft_M IKCtl_facSftyRtdtHiVlvLft_M IKCtl_facSftyRtdtLoVlvLft_M IKCtl_facTiFastKnkPrem_GT IKCtl_iaSftyRtdt_M IKCtl_tiTmrAdv_M TWKRLZOFV VZWKR /end DEF_CHARACTERISTIC
 /begin REF_CHARACTERISTIC IKCtl_nEng08_X_AX /end REF_CHARACTERISTIC
 /begin IN_MEASUREMENT AirMod_ratChrgAirCyl B_llri_msg CEngDsT_t DSM_TripChgFinshd Eep_EnvRamHist Eep_EnvRamInvld Epm_nEng Epm_numCyl evz_austot_msg Ign_bVlvLInNxtIAs Ign_flgIAmapsyn Ign_stiaBasKnk IKCtl_agAdpn_as16 IKCtl_cntrCyl IKCtl_cntrGdCyl_au8 IKCtl_facKnkInten_u8 IKCtl_flgAdpnWrEna IKCtl_flgFastAdvIa IKCtl_flgGdCyl IKCtl_flgInjD IKCtl_flgKnkDetn IKCtl_flgKnkEna IKCtl_flgSftyRtdt IKCtl_iaOffsGdCyl_as16 IKCtl_idxAdpn_u16 IKCtl_nFildGrad_s8 IKCtl_pPfiSp IKCtl_stInjDTot_b8 IKCtl_stMaskGdCly_b8 IKCtl_stVldnSnsrSig SyC_ctPostDrvLeave SyC_stSub /end IN_MEASUREMENT
 /begin OUT_MEASUREMENT IKCtl_agKnkAvrgGen_s16 IKCtl_agKnkAvrgGen_s8 IKCtl_agKnkAvrg_s16 IKCtl_agKnkAvrg_s8 IKCtl_agKnkInt_as16 IKCtl_agKnkInt_as8 IKCtl_agKnkLimrAvrg_s16 IKCtl_agKnkRtdtAry_s16 IKCtl_agKnkRtdt_as8 IKCtl_agKnkRtdt_s16 IKCtl_agKnkRtdt_s8 IKCtl_agMaxRtdtCurr_s16 IKCtl_agMaxRtdtCurr_s8 IKCtl_facFillgRed_u16 IKCtl_flgAdpnWrEnaCopy IKCtl_flgAdvIa /end OUT_MEASUREMENT
 /begin LOC_MEASUREMENT IKCtl_agKnkIntCurr_s16 IKCtl_agKnkMaxLim IKCtl_agMaxRtdtCurrLoc_s16 IKCtl_agRtdtCurrOutp_s16 IKCtl_agRtdtCurr_as16 IKCtl_agRtdtLowrCurr_s16 IKCtl_agRtdtLowr_s16 IKCtl_agRtdtUpprCurr_s16 IKCtl_agRtdtUppr_s16 IKCtl_cntrReIni100msKRREG IKCtl_cntrReIniSyncKRREG IKCtl_iaOffsfildGdCyl_as16 IKCtl_tEngLoc_s16 klopfakt krdwsw krvfswz krvfwz maskgz_old mkrzwsp vszwm wkrlzofv_bits zkrvf zoffset /end LOC_MEASUREMENT
 FUNCTION_VERSION "32.8.0" /end FUNCTION
/begin FUNCTION LAKH "10.29.0   Lambda coordination for catalyst heating"
 /begin DEF_CHARACTERISTIC ExhMgT_ratLamCatHeatgIdleMod_M ExhMgT_ratLamCatHeatgStrt_M ExhMgT_stCatHeatgLam2_C ExhMgT_stCatHeatgLam3_C ExhMgT_stCatHeatgLam_C ExhMgt_tiCatHeatgLamIdle_C ExhMgt_tiCatHeatgLamPartLoad_C ExhMgT_tiLamCatHeatgStrt_C KFLMSKH KLLAKHFH LMSTMOT /end DEF_CHARACTERISTIC
 /begin IN_MEASUREMENT AirMod_ratChrgAirCyl anztib_w_msg B_kha_msg B_kh_msg B_ll_msg CEngDsT_t CEngDsT_tStrt Epm_nEng flakh_msg PEnv_facCorrAlti SyC_ctPostDrvLeave SyC_stSub /end IN_MEASUREMENT
 /begin OUT_MEASUREMENT B_lamkhe_msg B_lamkh_msg ExhMgt_facIntrpnCatHeatg flamsl_w_msg lamkh_w_msg /end OUT_MEASUREMENT
 /begin LOC_MEASUREMENT ExhMgT_cntrReIniCoornLamCatHeatg100ms ExhMgT_cntrReIniCoornLamCatHeatg10ms ExhMgT_flgCdnCatHeat ExhMgT_ratLamCatHeatg lamkhg_w lamkhr_w lanskh_w lmskh_w tmcyla_w tmstcyla_w /end LOC_MEASUREMENT
 FUNCTION_VERSION "10.29.0" /end FUNCTION
/begin FUNCTION LAMCOREXMT "3.6.0     lambda coordination for exhaust temperature management" /begin DEF_CHARACTERISTIC ExhMgT_stLamCoornExhMngt_C /end DEF_CHARACTERISTIC
 /begin IN_MEASUREMENT B_khakt_msg B_kh_msg B_lambts_msg B_lamkh_msg ExhMgT_flgLamFuFco ExhMgT_ratLamFuFco lambts_w_msg lamkh_w_msg SyC_stSub /end IN_MEASUREMENT
 /begin OUT_MEASUREMENT ExhMgT_ratLamExhB1 ExhMgT_stLamExhB1 lamexht_w_msg stlamexhtm_msg /end OUT_MEASUREMENT
 FUNCTION_VERSION "3.6.0" /end FUNCTION
/begin FUNCTION LamCtrl_PrmId03 "3.0.0     Tester output of lambda control status (PID 03hex)" /begin REF_CHARACTERISTIC LALIUSMN /end REF_CHARACTERISTIC
 /begin IN_MEASUREMENT B_elsxbb_msg B_eobdlr_msg B_lrmstr_msg B_lrs_msg B_pspwl_msg B_sbblsu_msg Epm_nEng LamCtrl_flgEnlnmtProtActvB1 lamsons_w_msg SyC_stSub /end IN_MEASUREMENT
 /begin OUT_MEASUREMENT flglrs2_msg flglrs_msg LamCtrl_stBytA LamCtrl_stBytAInter LamCtrl_stBytAInterDeb LamCtrl_stBytAOld LamCtrl_stBytB /end OUT_MEASUREMENT
 /begin LOC_MEASUREMENT LamCtrl_flgClsdLoopB1 LamCtrl_flgClsdLoopFltB1 LamCtrl_flgEngWrmUpB1 LamCtrl_flgFltRdnS1B1 LamCtrl_flgFltS1B1 LamCtrl_flgOpenLoopB1 LamCtrl_flgOpenLoopFltB1 /end LOC_MEASUREMENT
 FUNCTION_VERSION "3.0.0" /end FUNCTION
/begin FUNCTION LAMKO "5.36.1_1.3.0Lambda coordination"
 /begin DEF_CHARACTERISTIC CWLAMKO CWLAMKOAP LamCtrl_ratLamSpCdaGbx_Crv LamCtrl_ratLamSpFcoB1_M LamCtrl_tEngLamLimn_Ax LAMHAP LAMLGFKT LAMLGFTM LAMLGMKT LAMLGMTM LASOABDMD TLASOABDQ /end DEF_CHARACTERISTIC
 /begin IN_MEASUREMENT B_bevab_msg B_lamfa_msg B_lamnswl_msg B_zwget_msg CEngDsT_t EGSDCmn_flgLamReqParlB1 EGSDCmn_ratLamReqParlB1 ExhMod_mfExhCat1B1 ExhMod_tCat1B1 lamexht_w_msg lamfa_w_msg lamnswl_w_msg MisfDet_stCatDmgFcoCyl stlamexhtm_msg SyC_stSub TWCC_bEnaRichPurgB1 TWCC_rLamSetPPurgB1 /end IN_MEASUREMENT
 /begin OUT_MEASUREMENT B_lalgf_msg B_lamdiag_msg B_lamsdef_msg lambas_msg lambas_w_msg lamdiag_w_msg lamlgfmn_w_msg lamlgm_w_msg lamsbg_w_msg lams_w_msg zlamko_msg /end OUT_MEASUREMENT
 /begin LOC_MEASUREMENT B_ldef LamCtrl_mfExhCat1B1 LamCtrl_ratLamSpCdaGbxB1 LamCtrl_tCat1B1 lamsubg_w lamwbr_w zlamkod zlamkoz /end LOC_MEASUREMENT
 FUNCTION_VERSION "5.36.1_1.3.0" /end FUNCTION
/begin FUNCTION LANSWL "10.13.0   Lambda during afterstart and warm-up"
 /begin DEF_CHARACTERISTIC ATISLATX ATIWKSTX CWWL DLAMNSWL EngStrt_facLamAftStrtLoP_M KFLASWLRTX LASWLTX TLANSWL /end DEF_CHARACTERISTIC
 /begin IN_MEASUREMENT anztib_w_msg B_lrnda_msg B_stendes_msg B_wks_msg CEngDsT_t CEngDsT_tStrt EngStrt_bStrtEnd SyC_ctPostDrvLeave /end IN_MEASUREMENT
 /begin OUT_MEASUREMENT anztib1_w_msg B_lamnswl_msg lamnswl_w_msg lamns_w_msg /end OUT_MEASUREMENT
 /begin LOC_MEASUREMENT anztib0_w anztib1_w_Loc B_lawlon EngStrt_ctReIniLANSWL10ms EngStrt_ctReIniLANSWL200ms EngStrt_facLamWrmUpAftStrt_MP lamwl_w tmotlanswl tmstlanswl /end LOC_MEASUREMENT
 FUNCTION_VERSION "10.13.0" /end FUNCTION
/begin FUNCTION LCSwt_DD "4.0.0     Device driver for light control switch" /begin IN_MEASUREMENT Com_stLiSwtInfo T15_st /end IN_MEASUREMENT /begin OUT_MEASUREMENT HdLi_flgActv /end OUT_MEASUREMENT FUNCTION_VERSION "4.0.0" /end FUNCTION
/begin FUNCTION LIGov_Adap "2.12.0    Adapter for Function Group LIGov" /begin DEF_CHARACTERISTIC LIGov_numParCnv_CUR /end DEF_CHARACTERISTIC /begin IN_MEASUREMENT LIGov_numPar /end IN_MEASUREMENT /begin OUT_MEASUREMENT LIGov_bParChngTrqP LIGov_numParTrqI LIGov_numParTrqP /end OUT_MEASUREMENT FUNCTION_VERSION "2.12.0" /end FUNCTION
/begin FUNCTION LIGov_Governor "2.32.0    idle speed controller"
 /begin DEF_CHARACTERISTIC LIGov_facDeadZoneEngLoad_T LIGov_facEngLoadLvl_M LIGov_facPreCtlRmpDwn_C LIGov_facPreCtlRmpGrip_C LIGov_facPreCtlRmpNoGrip_C LIGov_facTrqMax_CUR LIGov_flgSrvCouplrSwtCdnDi_C LIGov_Gov_CW LIGov_pwrMax_C LIGov_tiPLeadOfs_C LIGov_tqIntglSrvCouplrSwtActv_M LIGov_tqMin_C LIGov_trqDiffMaxParChng_C LIGov_trqI_MAP LIGov_trqMaxI_CUR LIGov_trqMax_C LIGov_trqOfsHi_C LIGov_trqOfsPtd_CUR LIGov_trqPLead_MAP LIGov_trqPRmp_C LIGov_trqP_MAP LIGov_trqRstIntrv_C /end DEF_CHARACTERISTIC
 /begin IN_MEASUREMENT ActMod_trqInrWoDstC CEngDsT_tStrt CoEng_bStrtEndTrqStruct CoEng_flgRelsFco CoVeh_trqDesComp EpmCrS_tiSeg Epm_nEng HLSDem_nSetPLo HLSDem_nSetPLoDiff LIGov_bExtTrqDem LIGov_bFrzI LIGov_bInactv LIGov_bNoGrip LIGov_bParChngTrqP LIGov_bRstI LIGov_nDiff LIGov_nDiffOld LIGov_numParTrqI LIGov_numParTrqP PthSet_bOvrRun PthSet_stOvrRunPhActv RngMod_trqComp RngMod_trqDiffAdap RngMod_trqInrMinWoCtOff RngMod_trqLosEng RngMod_trqLosTot SpdCtl_flgSynPstDrvBreak SpdCtl_flgSynStrtInitReq SrvCSwt_st tnst_w_msg /end IN_MEASUREMENT
 /begin OUT_MEASUREMENT LIGov_bRmpDwn LIGov_facPreCtlRmpMax LIGov_facThrStabAc LIGov_stOvrRun LIGov_tiSync LIGov_trq LIGov_trqI LIGov_trqLead LIGov_trqMax LIGov_trqMin LIGov_trqP LIGov_trqPLead LIGov_trqPreCtl /end OUT_MEASUREMENT
 /begin LOC_MEASUREMENT LIGov_facPreCtlRmp LIGov_flgSrvCouplrSwtSt LIGov_nDiffNSetNEng LIGov_tqThrStabAc LIGov_trqIDiff_MP LIGov_trqIgnFixPreCtl LIGov_trqIntegIPrmChg_MP LIGov_trqIntegIRst_MP LIGov_trqIntegI_MP LIGov_trqI_mp LIGov_trqPRmp LIGov_tStrtloc /end LOC_MEASUREMENT
 FUNCTION_VERSION "2.32.0" /end FUNCTION
/begin FUNCTION LIGov_SelPar "2.45.0    Operating conditions / parameter selection low idle governor"
 /begin DEF_CHARACTERISTIC LIGov_ExtTrqDemMskSeln_CW LIGov_facCatHeatgAlti_C LIGov_flgMskLLimIfFcoReqd_C LIGov_nExtTrqDemSelnSpOffs_C LIGov_nExtTrqDemSelnThd_C LIGov_nLimHi_C LIGov_nOffs_C LIGov_nOfsPreCtlRstrt_C LIGov_nOfsPreCtlTrqDem_C LIGov_nOfsPreCtl_C LIGov_nOfsPredef_C LIGov_nOfsUbr_C LIGov_nThresPreCtlLo_T LIGov_rExtTrqDemMskSelnAppThd_C LIGov_rGripThres_C LIGov_SelPar2_CW LIGov_SelPar_CW LIGov_stBrkThres_C LIGov_stExtTrqDemMskAltv_C LIGov_stExtTrqDemMskSelnBrk_C LIGov_stExtTrqDemMsk_C LIGov_swtBll_C LIGov_swtNoGrip_C LIGov_tEngXHi_C LIGov_tEngXLo_C LIGov_tiDlyPreCtl_C LIGov_tiEnblI_CUR LIGov_tiFrzIDly_C LIGov_tiGrip_C LIGov_tiStrtPar_C LIGov_trqDeltaWndUpMax_C LIGov_trqDeltaWndUpMin_C LIGov_trqThresDfrstI_C LIGov_vGrip_C LIGov_vMinRstI_C LiGov_vThresFrzI_C LIGov_vThresUbr_C SpdCtl_flgSynIninReqDrv_C SpdCtl_flgSynPstDrvBreak_C /end DEF_CHARACTERISTIC
 /begin IN_MEASUREMENT ACC_bBrkReq ACC_bExsMinDstBrkReq AirSys_bMinPsblIdcTrqRea APP_r Brk_st B_ll_msg CoEng_bStrtEndSpdGov CoEng_nRstrt CoEng_st CoEng_tiNormalRed CoETS_trqInrLimLead CrCtl_numACCType DOGov_bActv EGSys_bCH EngDa_tEng Epm_nEng GlbDa_stTrqDem HLSDem_nSetPLo HLSDem_nSetPTrck InjSys_bMinPtdInjDurActv InjSys_stActRedStg LIGov_tiSync LIGov_trq LIGov_trqI LIGov_trqLead LIGov_trqMax LIGov_trqMin LIGov_trqP LLim_bFcoDes PEnv_facCorrAlti PthSet_bOvrRun PthSet_trqInrIA PT_rGrip PT_stTraType RngMod_trqInrBsMin SyC_stSub Tra_numGear VehV_v /end IN_MEASUREMENT
 /begin OUT_MEASUREMENT LIGov_bCalcPreCtl LIGov_bEnblI LIGov_bExtTrqDem LIGov_bFrzI LIGov_bFrzIDiag LIGov_bGear1 LIGov_bInactv LIGov_bIniPredefTrq LIGov_bNoGrip LIGov_bParChng LIGov_bPreCtlUndrSpd LIGov_bRlsPreCtl LIGov_bRlsPredef LIGov_bRstI LIGov_bUbr LIGov_bWrm LIGov_flgExtTrqDemMskSeln LIGov_nDiff LIGov_nDiffOld LIGov_numPar LIGov_stExtTrqDemMskSeln SpdCtl_flgSynIninReqDrv SpdCtl_flgSynPstDrvBreak SpdCtl_flgSynStrtInitReq /end OUT_MEASUREMENT
 /begin LOC_MEASUREMENT LIGov_bLoSpdExs LIGov_bNPreCtl LIGov_bOvrRunEF_I.buffer LIGov_bOvrRunEF_I.oldSignal LIGov_bStrtPar LIGov_nPreCtl LIGov_stIdleSpdDrvr /end LOC_MEASUREMENT
 FUNCTION_VERSION "2.45.0" /end FUNCTION
/begin FUNCTION LinAppl_Std "73.6.0_6SAALin Application Standard" /begin DEF_CHARACTERISTIC Com_tiLINShtDwnDlyReq_C Linappl_stUseLstErr_C LinDiag_C /end DEF_CHARACTERISTIC /begin IN_MEASUREMENT Linappl_stFrmErr Com_stMon T15_st /end IN_MEASUREMENT
 /begin OUT_MEASUREMENT Com_flgLINShtDwnTiDlyExp Com_swtLinDiagEna Linappl_stFrmErr Linappl_stFrmErrOld Linappl_stFrmTxdRxd Linappl_stFrstFrmRxd Linappl_stNodErr /end OUT_MEASUREMENT
 /begin LOC_MEASUREMENT Com_stLinFullComMod Com_stSchTable1 /end LOC_MEASUREMENT
 FUNCTION_VERSION "73.6.0_6SAA" /end FUNCTION
/begin FUNCTION LLim_calcLim "106.0.0   Acceleration request from Speed Limiter"
 /begin DEF_CHARACTERISTIC LLim_aDifNeg_C LLim_aDifPos_C LLim_aMSL_CUR LLim_axMax_C LLim_tqFcoDesHi_C LLim_tqFcoDesLo_C LLim_vMaxFixdFailr_C LLim_vMaxFix_C LLim_vMaxSlopFailr_C LLim_vThres_C /end DEF_CHARACTERISTIC
 /begin IN_MEASUREMENT Com_stADSSpdLim CoVMD_trqLLim GlbDa_vXFlt LLim_stActive PT_trqWhlMinWoCtOff T15_st VehMot_aPrpCurr /end IN_MEASUREMENT
 /begin OUT_MEASUREMENT LLim_aReq LLim_axReq LLim_bFcoDes LLim_stMSLActv LLim_stReq /end OUT_MEASUREMENT
 /begin LOC_MEASUREMENT LLim_aMSL_mp LLim_dvMSL_mp LLim_flgRmpFailr LLim_vMaxMSLFailr LLim_vMaxMSL_mp /end LOC_MEASUREMENT
 FUNCTION_VERSION "106.0.0" /end FUNCTION
/begin COMPU_METHOD Acc "" RAT_FUNC "%6.5" "m/s^2" COEFFS 0 1000 0 0 0 1 /end COMPU_METHOD
/begin COMPU_METHOD B_TRUE "" TAB_VERB "%6.3" "" COMPU_TAB_REF B_TRUE /end COMPU_METHOD
/begin COMPU_VTAB B_TRUE "" TAB_VERB 2 0 "FALSE" 1 "TRUE" /end COMPU_VTAB
/begin COMPU_METHOD dez "" RAT_FUNC "%6.2" "" COEFFS 0 1 0 0 0 1 /end COMPU_METHOD
/begin COMPU_METHOD EngN "" RAT_FUNC "%6.3" "rpm" COEFFS 0 2 0 0 0 1 /end COMPU_METHOD
/begin COMPU_METHOD Fact100 "" RAT_FUNC "%6.4" "-" COEFFS 0 100 0 0 0 1 /end COMPU_METHOD
/begin COMPU_METHOD fak_q0p000244 "" RAT_FUNC "%6.5" "-" COEFFS 0 65536 0 0 0 16 /end COMPU_METHOD
/begin COMPU_METHOD fak_q3p0518Em5 "" RAT_FUNC "%7.6" "" COEFFS 0 32768 0 0 0 1 /end COMPU_METHOD
/begin COMPU_METHOD fak_sb_b1 "" RAT_FUNC "%6.4" "-" COEFFS 0 256 0 0 0 2 /end COMPU_METHOD
/begin COMPU_METHOD fak_ub_b1 "" RAT_FUNC "%6.4" "-" COEFFS 0 256 0 0 0 1 /end COMPU_METHOD
/begin COMPU_METHOD fak_ub_b16 "" RAT_FUNC "%6.4" "-" COEFFS 0 256 0 0 0 16 /end COMPU_METHOD
/begin COMPU_METHOD fak_ub_b2 "" RAT_FUNC "%8.5" "-" COEFFS 0 256 0 0 0 2 /end COMPU_METHOD
/begin COMPU_METHOD fak_ub_b4 "" RAT_FUNC "%6.4" "-" COEFFS 0 256 0 0 0 4 /end COMPU_METHOD
/begin COMPU_METHOD fak_ub_q7p8125Em3 "" RAT_FUNC "%6.4" "" COEFFS 0 128 0 0 0 1 /end COMPU_METHOD
/begin COMPU_METHOD fak_uw_b16 "" RAT_FUNC "%6.5" "-" COEFFS 0 65536 0 0 0 16 /end COMPU_METHOD
/begin COMPU_METHOD fak_uw_b2 "" RAT_FUNC "%7.6" "-" COEFFS 0 65536 0 0 0 2 /end COMPU_METHOD
/begin COMPU_METHOD fak_uw_b4 "" RAT_FUNC "%7.6" "-" COEFFS 0 65536 0 0 0 4 /end COMPU_METHOD
/begin COMPU_METHOD fak_uw_b5 "" RAT_FUNC "%7.6" "-" COEFFS 0 65536 0 0 0 5 /end COMPU_METHOD
/begin COMPU_METHOD kw_q0p75 "" RAT_FUNC "%6.3" "Grad KW" COEFFS 0 4 0 0 0 3 /end COMPU_METHOD
/begin COMPU_METHOD mdgrad_q0p05 "" RAT_FUNC "%6.4" "Nm/s" COEFFS 0 20 0 0 0 1 /end COMPU_METHOD
/begin COMPU_METHOD md_q0p1 "" RAT_FUNC "%6.3" "Nm" COEFFS 0 10 0 0 0 1 /end COMPU_METHOD
/begin COMPU_METHOD md_q1p526Em6 "" RAT_FUNC "%8.7" "Nm" COEFFS 0 65536 0 0 0 0.1 /end COMPU_METHOD
/begin COMPU_METHOD m_uw_b6553p5 "" RAT_FUNC "%6.3" "kg/h" COEFFS 0 1 0 0 0 0.1 /end COMPU_METHOD
/begin COMPU_METHOD nmotg_sb_q100 "" RAT_FUNC "%6.0" "1/min/s" COEFFS 0 1 0 0 0 100 /end COMPU_METHOD
/begin COMPU_METHOD nmot_q0p5 "" RAT_FUNC "%6.3" "1/min" COEFFS 0 2 0 0 0 1 /end COMPU_METHOD
/begin COMPU_METHOD nmot_sw_q0p5 "" RAT_FUNC "%6.3" "1/min" COEFFS 0 2 0 0 0 1 /end COMPU_METHOD
/begin COMPU_METHOD nmot_ub_q40 "" RAT_FUNC "%6.1" "1/min" COEFFS 0 1 0 0 0 40 /end COMPU_METHOD
/begin COMPU_METHOD OneToOne "" RAT_FUNC "%6.2" "-" COEFFS 0 1 0 0 0 1 /end COMPU_METHOD
/begin COMPU_METHOD Prc "" RAT_FUNC "%6.4" "%" COEFFS 0 81.92 0 0 0 1 /end COMPU_METHOD
/begin COMPU_METHOD p_q10 "" RAT_FUNC "%6.1" "hPa" COEFFS 0 1 0 0 0 10 /end COMPU_METHOD
/begin COMPU_METHOD q6553p6_RmpVel_low "" RAT_FUNC "%6.5" "(km/h)/s" COEFFS 0 65536 0 0 0 10 /end COMPU_METHOD
/begin COMPU_METHOD RatCOMass "" RAT_FUNC "%9.8" "-" COEFFS 0 1000000 0 0 0 1 /end COMPU_METHOD
/begin COMPU_METHOD RatFuelMass "" RAT_FUNC "%6.4" "-" COEFFS 0 100 0 0 0 1 /end COMPU_METHOD
/begin COMPU_METHOD RatFuelMassHi "" RAT_FUNC "%8.7" "-" COEFFS 0 100000 0 0 0 1 /end COMPU_METHOD
/begin COMPU_METHOD RatHiRes_CPP_COMPU "" RAT_FUNC "%7.6" "-" COEFFS 0 10000 0 0 0 1 /end COMPU_METHOD
/begin COMPU_METHOD RatNOxMass "" RAT_FUNC "%10.9" "-" COEFFS 0 10000000 0 0 0 1 /end COMPU_METHOD
/begin COMPU_METHOD RatSotMass "" RAT_FUNC "%8.7" "-" COEFFS 0 100000 0 0 0 1 /end COMPU_METHOD
/begin COMPU_METHOD RatSotSot "" RAT_FUNC "%6.5" "-" COEFFS 0 4000 0 0 0 1 /end COMPU_METHOD
/begin COMPU_METHOD RatSOxMass "" RAT_FUNC "%11.10" "-" COEFFS 0 100000000 0 0 0 1 /end COMPU_METHOD
/begin COMPU_METHOD RBANDSTYPE_SC_Compu "" TAB_VERB "%6.3" "" COMPU_TAB_REF RBANDSTYPE_SC_Compu /end COMPU_METHOD
/begin COMPU_VTAB RBANDSTYPE_SC_Compu "" TAB_VERB 4 0 "NO_RBANDS" 1 "ONLY_RBANDS" 2 "MIXED_RBANDS" 3 "MSR_RBANDS" /end COMPU_VTAB
/begin COMPU_METHOD RBA_SWTRACEENA_SC_Compu "" TAB_VERB "%6.3" "" COMPU_TAB_REF RBA_SWTRACEENA_SC_Compu /end COMPU_METHOD
/begin COMPU_VTAB RBA_SWTRACEENA_SC_Compu "" TAB_VERB 2 0 "False" 1 "True" /end COMPU_VTAB
/begin COMPU_METHOD RBPtCel_a_1p0_1 "" RAT_FUNC "%6.2" "m/s^2" COEFFS 0 1 0 0 0 1 /end COMPU_METHOD
/begin COMPU_METHOD RBPtCel_dst_1p0_4 "" RAT_FUNC "%6.2" "km" COEFFS 0 1 0 0 0 1 /end COMPU_METHOD
/begin COMPU_METHOD RBPtCel_fac_1p0_8 "" RAT_FUNC "%6.2" "%/s" COEFFS 0 1 0 0 0 1 /end COMPU_METHOD
/begin COMPU_METHOD RBPtCel_fPerp_1p0_1 "" RAT_FUNC "%6.2" "N/Bar" COEFFS 0 1 0 0 0 1 /end COMPU_METHOD
/begin COMPU_METHOD RBPtCel_frq_1p0_1 "" RAT_FUNC "%6.2" "1/s" COEFFS 0 1 0 0 0 1 /end COMPU_METHOD
/begin COMPU_METHOD RBPtCel_fti_1p0_1 "" RAT_FUNC "%6.2" "Ns" COEFFS 0 1 0 0 0 1 /end COMPU_METHOD
/begin COMPU_METHOD RBPtCel_f_1p0_1 "" RAT_FUNC "%6.2" "N" COEFFS 0 1 0 0 0 1 /end COMPU_METHOD
/begin COMPU_METHOD RBPtCel_i_1p0_1 "" RAT_FUNC "%6.2" "mA" COEFFS 0 1 0 0 0 1 /end COMPU_METHOD
/begin COMPU_METHOD RBPtCel_i_1p0_2 "" RAT_FUNC "%6.2" "A" COEFFS 0 1 0 0 0 1 /end COMPU_METHOD
/begin COMPU_METHOD RBPtCel_nGrdt_1p0_1 "" RAT_FUNC "%6.2" "rpm/s" COEFFS 0 1 0 0 0 1 /end COMPU_METHOD
/begin COMPU_METHOD RBPtCel_n_1p0_1 "" RAT_FUNC "%6.2" "rpm" COEFFS 0 1 0 0 0 1 /end COMPU_METHOD
/begin COMPU_METHOD RBPtCel_Perc_1p0_1 "" RAT_FUNC "%6.2" "%" COEFFS 0 1 0 0 0 1 /end COMPU_METHOD
/begin COMPU_METHOD RBPtCel_p_1p0_2 "" RAT_FUNC "%6.2" "Bar" COEFFS 0 1 0 0 0 1 /end COMPU_METHOD
/begin COMPU_METHOD RBPtCel_ti_1p0_2 "" RAT_FUNC "%6.2" "s" COEFFS 0 1 0 0 0 1 /end COMPU_METHOD
/begin COMPU_METHOD RBPtCel_t_1p0_3 "" RAT_FUNC "%6.2" "Deg C" COEFFS 0 1 0 0 0 1 /end COMPU_METHOD
/begin COMPU_METHOD RBPtCel_u_1p0_1 "" RAT_FUNC "%6.2" "V" COEFFS 0 1 0 0 0 1 /end COMPU_METHOD
/begin COMPU_METHOD RBPtCel_vf_1p0_2 "" RAT_FUNC "%6.2" "l/min" COEFFS 0 1 0 0 0 1 /end COMPU_METHOD
/begin COMPU_METHOD RCEMODACTVT_SC_Compu "" TAB_VERB "%6.3" "" COMPU_TAB_REF RCEMODACTVT_SC_Compu /end COMPU_METHOD
/begin COMPU_VTAB RCEMODACTVT_SC_Compu "" TAB_VERB 2 0 "Disable" 1 "Enable" /end COMPU_VTAB
/begin COMPU_METHOD RCSSTRT_SY_Compu "" TAB_VERB "%6.3" "" COMPU_TAB_REF RCSSTRT_SY_Compu /end COMPU_METHOD
/begin COMPU_VTAB RCSSTRT_SY_Compu "" TAB_VERB 2 0 "False" 1 "True" /end COMPU_VTAB
/begin COMPU_METHOD REDEFOGAVL_SC_Compu "" TAB_VERB "%6.3" "" COMPU_TAB_REF REDEFOGAVL_SC_Compu /end COMPU_METHOD
/begin COMPU_VTAB REDEFOGAVL_SC_Compu "" TAB_VERB 2 0 "False" 1 "True" /end COMPU_VTAB
/begin COMPU_METHOD REFUEL_SC_Compu "" TAB_VERB "%6.3" "" COMPU_TAB_REF REFUEL_SC_Compu /end COMPU_METHOD
/begin COMPU_VTAB REFUEL_SC_Compu "" TAB_VERB 4 0 "0" 1 "1" 2 "2" 3 "3" /end COMPU_VTAB
/begin COMPU_METHOD rel_uw_q0p0234 "" RAT_FUNC "%6.4" "%" COEFFS 0 32 0 0 0 0.75 /end COMPU_METHOD
/begin COMPU_METHOD REMPRKG_SC_Compu "" TAB_VERB "%6.3" "" COMPU_TAB_REF REMPRKG_SC_Compu /end COMPU_METHOD
/begin COMPU_VTAB REMPRKG_SC_Compu "" TAB_VERB 2 0 "False" 1 "True" /end COMPU_VTAB
/begin COMPU_METHOD REMSTRTVRNT_SC_Compu "" TAB_VERB "%6.3" "" COMPU_TAB_REF REMSTRTVRNT_SC_Compu /end COMPU_METHOD
/begin COMPU_VTAB REMSTRTVRNT_SC_Compu "" TAB_VERB 3 0 "REMSTRTVRNT_NOREMSTRT" 1 "REMSTRTVRNT_FULLACTVN" 2 "REMSTRTVRNT_PTLACTVN" /end COMPU_VTAB
/begin COMPU_METHOD Resist "" RAT_FUNC "%6.3" "Ohm" COEFFS 0 10 0 0 0 1 /end COMPU_METHOD
/begin COMPU_METHOD ResPerMass_hPaHrPerCM "" RAT_FUNC "%7.6" "(hPa(m^3/h))/g" COEFFS 0 10000 0 0 0 1 /end COMPU_METHOD
/begin COMPU_METHOD Res_hPaHrPerCM "" RAT_FUNC "%7.6" "hPa/(m^3/h)" COEFFS 0 10000 0 0 0 1 /end COMPU_METHOD
/begin COMPU_METHOD Res_hPaSPerCM "" RAT_FUNC "%6.5" "hPa/(m^3*s/h)" COEFFS 0 1000 0 0 0 1 /end COMPU_METHOD
/begin COMPU_METHOD ReynoldsNum "" RAT_FUNC "%6.0" "-" COEFFS 0 0.01 0 0 0 1 /end COMPU_METHOD
/begin COMPU_METHOD ReynoldsNum1 "" RAT_FUNC "%7.0" "-" COEFFS 0 0.001 0 0 0 1 /end COMPU_METHOD
/begin COMPU_METHOD RhoFuel "" RAT_FUNC "%6.3" "kg/m^3" COEFFS 0 10 0 0 0 1 /end COMPU_METHOD
/begin COMPU_METHOD rhoOilAsh_g_p_l "" RAT_FUNC "%6.3" "g/l" COEFFS 0 10 0 0 0 1 /end COMPU_METHOD
/begin COMPU_METHOD Rho_q0p001_COMPU "" RAT_FUNC "%6.5" "Kg/m^3" COEFFS 0 1000 0 0 0 1 /end COMPU_METHOD
/begin COMPU_METHOD RHUSTGYPRS_SY_Compu "" TAB_VERB "%6.3" "" COMPU_TAB_REF RHUSTGYPRS_SY_Compu /end COMPU_METHOD
/begin COMPU_VTAB RHUSTGYPRS_SY_Compu "" TAB_VERB 2 0 "False" 1 "True" /end COMPU_VTAB
/begin COMPU_METHOD RLXBF_SC_Compu "" TAB_VERB "%6.3" "" COMPU_TAB_REF RLXBF_SC_Compu /end COMPU_METHOD
/begin COMPU_VTAB RLXBF_SC_Compu "" TAB_VERB 2 0 "False" 1 "True" /end COMPU_VTAB
/begin COMPU_METHOD Rmp "" RAT_FUNC "%6.4" "1/s" COEFFS 0 65.536 0 0 0 1 /end COMPU_METHOD
/begin COMPU_METHOD spg_q3p906Em4_V_ms "" RAT_FUNC "%6.5" "V*ms" COEFFS 0 65536 0 0 0 25.6 /end COMPU_METHOD
/begin COMPU_METHOD spg_q7p629Em7_V_ms "" RAT_FUNC "%9.8" "V*ms" COEFFS 0 65536 0 0 0 0.05 /end COMPU_METHOD
/begin COMPU_METHOD t10msxs_uw_b655p35 "" RAT_FUNC "%6.4" "s" COEFFS 0 1 0 0 0 0.01 /end COMPU_METHOD
/begin COMPU_METHOD Temp_Cels "" RAT_FUNC "%6.1" "deg C" COEFFS 0 10 2731.4 0 0 1 /end COMPU_METHOD
/begin COMPU_METHOD temp_q0p0234_o273 "" RAT_FUNC "%6.1" "Grad C" COEFFS 0 1 273.15 0 0 0.0234375 /end COMPU_METHOD
/begin COMPU_METHOD temp_q0p1_o273 "" RAT_FUNC "%6.1" "Grad C" COEFFS 0 10 2731.4 0 0 1 /end COMPU_METHOD
/begin COMPU_METHOD temp_ub_q0p75_o48 "" RAT_FUNC "%6.2" "Grad C" COEFFS 0 1 48 0 0 0.75 /end COMPU_METHOD
/begin COMPU_METHOD TimeRed "" RAT_FUNC "%6.3" "s" COEFFS 0 6.25 0 0 0 1 /end COMPU_METHOD
/begin COMPU_METHOD Time_ms "" RAT_FUNC "%6.1" "ms" COEFFS 0 0.1 0 0 0 1 /end COMPU_METHOD
/begin COMPU_METHOD TrqPrpHigh "" RAT_FUNC "%6.3" "Nm" COEFFS 0 10 0 0 0 1 /end COMPU_METHOD
/begin COMPU_METHOD t_q0p01 "" RAT_FUNC "%6.4" "s" COEFFS 0 100 0 0 0 1 /end COMPU_METHOD
/begin COMPU_METHOD t_q0p1 "" RAT_FUNC "%6.3" "s" COEFFS 0 10 0 0 0 1 /end COMPU_METHOD
/begin COMPU_METHOD t_q1p5259Em5_s "" RAT_FUNC "%7.6" "s" COEFFS 0 65536 0 0 0 1 /end COMPU_METHOD
/begin COMPU_METHOD t_q3p125em2 "" RAT_FUNC "%6.4" "s" COEFFS 0 32 0 0 0 1 /end COMPU_METHOD
/begin COMPU_METHOD t_tev0p0005 "" RAT_FUNC "%6.5" "s" COEFFS 0 2048 0 0 0 1 /end COMPU_METHOD
/begin COMPU_METHOD Vel "" RAT_FUNC "%6.4" "km/h" COEFFS 0 100 0 0 0 1 /end COMPU_METHOD
/begin COMPU_METHOD vel_q0p01 "" RAT_FUNC "%6.4" "km/h" COEFFS 0 100 0 0 0 1 /end COMPU_METHOD
/begin COMPU_METHOD vfzg_uw_q0p01 "" RAT_FUNC "%6.4" "km/h" COEFFS 0 100 0 0 0 1 /end COMPU_METHOD
/begin COMPU_METHOD zk100msxs_ub_b25p5 "" RAT_FUNC "%6.3" "s" COEFFS 0 0 256 0 10 0 /end COMPU_METHOD
/begin COMPU_METHOD zw_q0p1 "" RAT_FUNC "%6.3" "Grad KW" COEFFS 0 10 0 0 0 1 /end COMPU_METHOD
/begin RECORD_LAYOUT Cur_Xs16Ws16 NO_AXIS_PTS_X 1 SWORD AXIS_PTS_X 2 SWORD INDEX_INCR DIRECT FNC_VALUES 3 SWORD COLUMN_DIR DIRECT /end RECORD_LAYOUT
/begin RECORD_LAYOUT RB_Axis_S16 NO_AXIS_PTS_X 1 SWORD AXIS_PTS_X 2 SWORD INDEX_INCR DIRECT /end RECORD_LAYOUT
/begin RECORD_LAYOUT RB_Axis_U16 NO_AXIS_PTS_X 1 UWORD AXIS_PTS_X 2 UWORD INDEX_INCR DIRECT /end RECORD_LAYOUT
/begin RECORD_LAYOUT RB_CurveGroup_S16 FNC_VALUES 1 SWORD COLUMN_DIR DIRECT /end RECORD_LAYOUT
/begin RECORD_LAYOUT RB_CurveGroup_U16 FNC_VALUES 1 UWORD COLUMN_DIR DIRECT /end RECORD_LAYOUT
/begin RECORD_LAYOUT RB_CurveGroup_U8 FNC_VALUES 1 UBYTE COLUMN_DIR DIRECT /end RECORD_LAYOUT
/begin RECORD_LAYOUT RB_Curve_S16_S16 NO_AXIS_PTS_X 1 SWORD AXIS_PTS_X 2 SWORD INDEX_INCR DIRECT FNC_VALUES 3 SWORD COLUMN_DIR DIRECT /end RECORD_LAYOUT
/begin RECORD_LAYOUT RB_Curve_S16_U16_Static NO_AXIS_PTS_X 1 SWORD AXIS_PTS_X 2 SWORD INDEX_INCR DIRECT FNC_VALUES 3 UWORD COLUMN_DIR DIRECT STATIC_RECORD_LAYOUT /end RECORD_LAYOUT
/begin RECORD_LAYOUT RB_Curve_S16_U8_Static NO_AXIS_PTS_X 1 SWORD AXIS_PTS_X 2 SWORD INDEX_INCR DIRECT FNC_VALUES 3 UBYTE COLUMN_DIR DIRECT STATIC_RECORD_LAYOUT /end RECORD_LAYOUT
/begin RECORD_LAYOUT RB_Curve_U16_U16 NO_AXIS_PTS_X 1 UWORD AXIS_PTS_X 2 UWORD INDEX_INCR DIRECT FNC_VALUES 3 UWORD COLUMN_DIR DIRECT /end RECORD_LAYOUT
/begin RECORD_LAYOUT RB_Curve_U16_U8_Static NO_AXIS_PTS_X 1 UWORD AXIS_PTS_X 2 UWORD INDEX_INCR DIRECT FNC_VALUES 3 UBYTE COLUMN_DIR DIRECT STATIC_RECORD_LAYOUT /end RECORD_LAYOUT
/begin RECORD_LAYOUT RB_Curve_U8_S8_Static NO_AXIS_PTS_X 1 UBYTE AXIS_PTS_X 2 UBYTE INDEX_INCR DIRECT FNC_VALUES 3 SBYTE COLUMN_DIR DIRECT STATIC_RECORD_LAYOUT /end RECORD_LAYOUT
/begin RECORD_LAYOUT RB_Curve_U8_U16_Static NO_AXIS_PTS_X 1 UBYTE AXIS_PTS_X 2 UBYTE INDEX_INCR DIRECT FNC_VALUES 3 UWORD COLUMN_DIR DIRECT STATIC_RECORD_LAYOUT /end RECORD_LAYOUT
/begin RECORD_LAYOUT RB_Curve_U8_U8 NO_AXIS_PTS_X 1 UBYTE AXIS_PTS_X 2 UBYTE INDEX_INCR DIRECT FNC_VALUES 3 UBYTE COLUMN_DIR DIRECT /end RECORD_LAYOUT
/begin RECORD_LAYOUT RB_MapGroup_U8 FNC_VALUES 1 UBYTE COLUMN_DIR DIRECT /end RECORD_LAYOUT
/begin RECORD_LAYOUT RB_Map_S16S16_S16 NO_AXIS_PTS_X 1 SWORD NO_AXIS_PTS_Y 2 SWORD AXIS_PTS_X 3 SWORD INDEX_INCR DIRECT AXIS_PTS_Y 4 SWORD INDEX_INCR DIRECT FNC_VALUES 5 SWORD COLUMN_DIR DIRECT /end RECORD_LAYOUT
/begin RECORD_LAYOUT RB_Map_S16S16_S8 NO_AXIS_PTS_X 1 SWORD NO_AXIS_PTS_Y 2 SWORD AXIS_PTS_X 3 SWORD INDEX_INCR DIRECT AXIS_PTS_Y 4 SWORD INDEX_INCR DIRECT FNC_VALUES 5 SBYTE COLUMN_DIR DIRECT /end RECORD_LAYOUT
/begin RECORD_LAYOUT RB_Map_S16S8_S16 NO_AXIS_PTS_X 1 SWORD NO_AXIS_PTS_Y 2 SWORD AXIS_PTS_X 3 SWORD INDEX_INCR DIRECT AXIS_PTS_Y 4 SBYTE INDEX_INCR DIRECT FNC_VALUES 5 SWORD COLUMN_DIR DIRECT /end RECORD_LAYOUT
/begin RECORD_LAYOUT RB_Map_S16U16_U16 NO_AXIS_PTS_X 1 SWORD NO_AXIS_PTS_Y 2 SWORD AXIS_PTS_X 3 SWORD INDEX_INCR DIRECT AXIS_PTS_Y 4 UWORD INDEX_INCR DIRECT FNC_VALUES 5 UWORD ROW_DIR DIRECT /end RECORD_LAYOUT
/begin RECORD_LAYOUT RB_Map_S16U16_U8 NO_AXIS_PTS_X 1 SWORD NO_AXIS_PTS_Y 2 SWORD AXIS_PTS_X 3 SWORD INDEX_INCR DIRECT AXIS_PTS_Y 4 UWORD INDEX_INCR DIRECT FNC_VALUES 5 UBYTE ROW_DIR DIRECT /end RECORD_LAYOUT
/begin RECORD_LAYOUT RB_Map_S16U8_S16 NO_AXIS_PTS_X 1 SWORD NO_AXIS_PTS_Y 2 SWORD AXIS_PTS_X 3 SWORD INDEX_INCR DIRECT AXIS_PTS_Y 4 UBYTE INDEX_INCR DIRECT FNC_VALUES 5 SWORD COLUMN_DIR DIRECT /end RECORD_LAYOUT
/begin RECORD_LAYOUT RB_Map_S8U8_U8 NO_AXIS_PTS_X 1 SBYTE NO_AXIS_PTS_Y 2 SBYTE AXIS_PTS_X 3 SBYTE INDEX_INCR DIRECT AXIS_PTS_Y 4 UBYTE INDEX_INCR DIRECT FNC_VALUES 5 UBYTE ROW_DIR DIRECT /end RECORD_LAYOUT
/begin RECORD_LAYOUT RB_Map_U16S8_S16 NO_AXIS_PTS_X 1 UWORD NO_AXIS_PTS_Y 2 UWORD AXIS_PTS_X 3 UWORD INDEX_INCR DIRECT AXIS_PTS_Y 4 SBYTE INDEX_INCR DIRECT FNC_VALUES 5 SWORD COLUMN_DIR DIRECT /end RECORD_LAYOUT
/begin RECORD_LAYOUT RB_Map_U16U16_U8 NO_AXIS_PTS_X 1 UWORD NO_AXIS_PTS_Y 2 UWORD AXIS_PTS_X 3 UWORD INDEX_INCR DIRECT AXIS_PTS_Y 4 UWORD INDEX_INCR DIRECT FNC_VALUES 5 UBYTE COLUMN_DIR DIRECT /end RECORD_LAYOUT
/begin RECORD_LAYOUT RB_Map_U8U16_U16 NO_AXIS_PTS_X 1 UBYTE NO_AXIS_PTS_Y 2 UBYTE AXIS_PTS_X 3 UBYTE INDEX_INCR DIRECT AXIS_PTS_Y 4 UWORD INDEX_INCR DIRECT FNC_VALUES 5 UWORD ROW_DIR DIRECT /end RECORD_LAYOUT
/begin RECORD_LAYOUT RB_Map_U8U8_U8 NO_AXIS_PTS_X 1 UBYTE NO_AXIS_PTS_Y 2 UBYTE AXIS_PTS_X 3 UBYTE INDEX_INCR DIRECT AXIS_PTS_Y 4 UBYTE INDEX_INCR DIRECT FNC_VALUES 5 UBYTE COLUMN_DIR DIRECT /end RECORD_LAYOUT
/begin RECORD_LAYOUT RB_ValA_Ws16 FNC_VALUES 1 SWORD COLUMN_DIR DIRECT /end RECORD_LAYOUT
/begin RECORD_LAYOUT RB_ValA_Ws8 FNC_VALUES 1 SBYTE COLUMN_DIR DIRECT /end RECORD_LAYOUT
/begin RECORD_LAYOUT RB_ValA_Wu16 FNC_VALUES 1 UWORD COLUMN_DIR DIRECT /end RECORD_LAYOUT
/begin RECORD_LAYOUT RB_ValA_Wu8 FNC_VALUES 1 UBYTE COLUMN_DIR DIRECT /end RECORD_LAYOUT
/begin RECORD_LAYOUT RB_Val_Wboolean FNC_VALUES 1 UBYTE COLUMN_DIR DIRECT /end RECORD_LAYOUT
/begin RECORD_LAYOUT RB_Val_Ws16 FNC_VALUES 1 SWORD COLUMN_DIR DIRECT /end RECORD_LAYOUT
/begin RECORD_LAYOUT RB_Val_Ws32 FNC_VALUES 1 SLONG COLUMN_DIR DIRECT /end RECORD_LAYOUT
/begin RECORD_LAYOUT RB_Val_Ws8 FNC_VALUES 1 SBYTE COLUMN_DIR DIRECT /end RECORD_LAYOUT
/begin RECORD_LAYOUT RB_Val_Wu16 FNC_VALUES 1 UWORD COLUMN_DIR DIRECT /end RECORD_LAYOUT
/begin RECORD_LAYOUT RB_Val_Wu32 FNC_VALUES 1 ULONG COLUMN_DIR DIRECT /end RECORD_LAYOUT
/begin RECORD_LAYOUT RB_Val_Wu8 FNC_VALUES 1 UBYTE COLUMN_DIR DIRECT /end RECORD_LAYOUT
/begin RECORD_LAYOUT Val_Ws16 FNC_VALUES 1 SWORD COLUMN_DIR DIRECT /end RECORD_LAYOUT
/begin RECORD_LAYOUT Val_Ws32 FNC_VALUES 1 SLONG COLUMN_DIR DIRECT /end RECORD_LAYOUT
/end MODULE
/end PROJECT
