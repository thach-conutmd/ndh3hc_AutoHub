ASAP2_VERSION 1 60
/begin PROJECT MG1CA020 "MG1CA020"
/begin HEADER "" VERSION "MG1CA020_6SAY_V011_TPROT" PROJECT_NO MG1CA020 /end HEADER
/begin MODULE DIM ""
/begin MOD_COMMON "" BYTE_ORDER MSB_LAST ALIGNMENT_BYTE 1 ALIGNMENT_WORD 2 ALIGNMENT_LONG 4 ALIGNMENT_INT64 4 ALIGNMENT_FLOAT32_IEEE 4 ALIGNMENT_FLOAT64_IEEE 4 DATA_SIZE 32 /end MOD_COMMON
/begin CHARACTERISTIC DSCHED_Excl.AFRA_AORA_C "exclusion relation / Exclusive FIds to FID_AFRA and FID_AORA" VALUE 0x804EE22E Val_Wu8 255.0 DFC_OneToOne 0.00 255.0 FORMAT "%5.1" /end CHARACTERISTIC
/begin CHARACTERISTIC DSCHED_Excl.AFRA_ATEH_C "exclusion relation / Exclusive FIds to FID_AFRA and FID_ATEH" VALUE 0x804EE22F Val_Wu8 255.0 DFC_OneToOne 0.00 255.0 FORMAT "%5.1" /end CHARACTERISTIC
/begin CHARACTERISTIC DSCHED_Excl.AFRA_ATEL_C "exclusion relation / Exclusive FIds to FID_AFRA and FID_ATEL" VALUE 0x804EE230 Val_Wu8 255.0 DFC_OneToOne 0.00 255.0 FORMAT "%5.1" /end CHARACTERISTIC
/begin CHARACTERISTIC DSCHED_Excl.AFRA_ATEN_C "exclusion relation / Exclusive FIds to FID_AFRA and FID_ATEN" VALUE 0x804EE231 Val_Wu8 255.0 DFC_OneToOne 0.00 255.0 FORMAT "%5.1" /end CHARACTERISTIC
/begin CHARACTERISTIC DSCHED_Excl.AFRA_EGSDCmnSeg1B1Parl_C "exclusion relation / Exclusive FIds to FID_AFRA and FId_EGSDCmnSeg1B1Parl" VALUE 0x804EE232 Val_Wu8 255.0 DFC_OneToOne 0.00 255.0 FORMAT "%5.1" /end CHARACTERISTIC
/begin CHARACTERISTIC DSCHED_Excl.AFRA_BLLRH_C "exclusion relation / Exclusive FIds to FID_AFRA and FID_BLLRH" VALUE 0x804EE233 Val_Wu8 255.0 DFC_OneToOne 0.00 255.0 FORMAT "%5.1" /end CHARACTERISTIC
/begin CHARACTERISTIC DSCHED_Excl.AFRA_BLLRKH_C "exclusion relation / Exclusive FIds to FID_AFRA and FID_BLLRKH" VALUE 0x804EE234 Val_Wu8 255.0 DFC_OneToOne 0.00 255.0 FORMAT "%5.1" /end CHARACTERISTIC
/begin CHARACTERISTIC DSCHED_Excl.AFRA_BPLSU_C "exclusion relation / Exclusive FIds to FID_AFRA and FID_BPLSU" VALUE 0x804EE235 Val_Wu8 255.0 DFC_OneToOne 0.00 255.0 FORMAT "%5.1" /end CHARACTERISTIC
/begin CHARACTERISTIC DSCHED_Excl.AFRA_CJ135RvsChrgMeasS1B1_C "exclusion relation / Exclusive FIds to FID_AFRA and FId_CJ135RvsChrgMeasS1B1" VALUE 0x804EE236 Val_Wu8 255.0 DFC_OneToOne 0.00 255.0 FORMAT "%5.1" /end CHARACTERISTIC
/begin CHARACTERISTIC DSCHED_Excl.AFRA_CatHeatgColdStrtReq_C "exclusion relation / Exclusive FIds to FID_AFRA and FId_CatHeatgColdStrtReq" VALUE 0x804EE237 Val_Wu8 255.0 DFC_OneToOne 0.00 255.0 FORMAT "%5.1" /end CHARACTERISTIC
/begin CHARACTERISTIC DSCHED_Excl.AFRA_CatHeatgWrmReq_C "exclusion relation / Exclusive FIds to FID_AFRA and FId_CatHeatgWrmReq" VALUE 0x804EE238 Val_Wu8 255.0 DFC_OneToOne 0.00 255.0 FORMAT "%5.1" /end CHARACTERISTIC
/begin CHARACTERISTIC DSCHED_Excl.AFRA_EGSDO2SnsrMntdRelsS1B1_C "exclusion relation / Exclusive FIds to FID_AFRA and FId_EGSDO2SnsrMntdRelsS1B1" VALUE 0x804EE239 Val_Wu8 255.0 DFC_OneToOne 0.00 255.0 FORMAT "%5.1" /end CHARACTERISTIC
/begin CHARACTERISTIC DSCHED_Excl.AFRA_EGSDO2_LamOffsFastS1B1_C "exclusion relation / Exclusive FIds to FID_AFRA and FId_EGSDO2_LamOffsFastS1B1" VALUE 0x804EE23A Val_Wu8 255.0 DFC_OneToOne 0.00 255.0 FORMAT "%5.1" /end CHARACTERISTIC
/begin CHARACTERISTIC DSCHED_Excl.AFRA_MisfDetDnAdpnNv_C "exclusion relation / Exclusive FIds to FID_AFRA and FId_MisfDetDnAdpnNv" VALUE 0x804EE23B Val_Wu8 255.0 DFC_OneToOne 0.00 255.0 FORMAT "%5.1" /end CHARACTERISTIC
/begin CHARACTERISTIC DSCHED_Excl.AORA_ATEH_C "exclusion relation / Exclusive FIds to FID_AORA and FID_ATEH" VALUE 0x804EE23C Val_Wu8 255.0 DFC_OneToOne 0.00 255.0 FORMAT "%5.1" /end CHARACTERISTIC
/begin CHARACTERISTIC DSCHED_Excl.AORA_ATEL_C "exclusion relation / Exclusive FIds to FID_AORA and FID_ATEL" VALUE 0x804EE23D Val_Wu8 255.0 DFC_OneToOne 0.00 255.0 FORMAT "%5.1" /end CHARACTERISTIC
/begin CHARACTERISTIC DSCHED_Excl.AORA_ATEN_C "exclusion relation / Exclusive FIds to FID_AORA and FID_ATEN" VALUE 0x804EE23E Val_Wu8 255.0 DFC_OneToOne 0.00 255.0 FORMAT "%5.1" /end CHARACTERISTIC
/begin CHARACTERISTIC DSCHED_Excl.AORA_EGSDCmnSeg1B1Parl_C "exclusion relation / Exclusive FIds to FID_AORA and FId_EGSDCmnSeg1B1Parl" VALUE 0x804EE23F Val_Wu8 255.0 DFC_OneToOne 0.00 255.0 FORMAT "%5.1" /end CHARACTERISTIC
/begin CHARACTERISTIC DSCHED_Excl.AORA_BLLRH_C "exclusion relation / Exclusive FIds to FID_AORA and FID_BLLRH" VALUE 0x804EE240 Val_Wu8 255.0 DFC_OneToOne 0.00 255.0 FORMAT "%5.1" /end CHARACTERISTIC
/begin CHARACTERISTIC DSCHED_Excl.AORA_BLLRKH_C "exclusion relation / Exclusive FIds to FID_AORA and FID_BLLRKH" VALUE 0x804EE241 Val_Wu8 255.0 DFC_OneToOne 0.00 255.0 FORMAT "%5.1" /end CHARACTERISTIC
/begin CHARACTERISTIC DSCHED_Excl.AORA_BPLSU_C "exclusion relation / Exclusive FIds to FID_AORA and FID_BPLSU" VALUE 0x804EE242 Val_Wu8 255.0 DFC_OneToOne 0.00 255.0 FORMAT "%5.1" /end CHARACTERISTIC
/begin CHARACTERISTIC DSCHED_Excl.AORA_CJ135RvsChrgMeasS1B1_C "exclusion relation / Exclusive FIds to FID_AORA and FId_CJ135RvsChrgMeasS1B1" VALUE 0x804EE243 Val_Wu8 255.0 DFC_OneToOne 0.00 255.0 FORMAT "%5.1" /end CHARACTERISTIC
/begin CHARACTERISTIC DSCHED_Excl.AORA_CatHeatgColdStrtReq_C "exclusion relation / Exclusive FIds to FID_AORA and FId_CatHeatgColdStrtReq" VALUE 0x804EE244 Val_Wu8 255.0 DFC_OneToOne 0.00 255.0 FORMAT "%5.1" /end CHARACTERISTIC
/begin CHARACTERISTIC DSCHED_Excl.AORA_CatHeatgWrmReq_C "exclusion relation / Exclusive FIds to FID_AORA and FId_CatHeatgWrmReq" VALUE 0x804EE245 Val_Wu8 255.0 DFC_OneToOne 0.00 255.0 FORMAT "%5.1" /end CHARACTERISTIC
/begin CHARACTERISTIC DSCHED_Excl.AORA_EGSDO2SnsrMntdRelsS1B1_C "exclusion relation / Exclusive FIds to FID_AORA and FId_EGSDO2SnsrMntdRelsS1B1" VALUE 0x804EE246 Val_Wu8 255.0 DFC_OneToOne 0.00 255.0 FORMAT "%5.1" /end CHARACTERISTIC
/begin CHARACTERISTIC DSCHED_Excl.AORA_EGSDO2_LamOffsFastS1B1_C "exclusion relation / Exclusive FIds to FID_AORA and FId_EGSDO2_LamOffsFastS1B1" VALUE 0x804EE247 Val_Wu8 255.0 DFC_OneToOne 0.00 255.0 FORMAT "%5.1" /end CHARACTERISTIC
/begin CHARACTERISTIC DSCHED_Excl.AORA_MisfDetDnAdpnNv_C "exclusion relation / Exclusive FIds to FID_AORA and FId_MisfDetDnAdpnNv" VALUE 0x804EE248 Val_Wu8 255.0 DFC_OneToOne 0.00 255.0 FORMAT "%5.1" /end CHARACTERISTIC
/begin CHARACTERISTIC DSCHED_Excl.ATEH_ATEL_C "exclusion relation / Exclusive FIds to FID_ATEH and FID_ATEL" VALUE 0x804EE249 Val_Wu8 255.0 DFC_OneToOne 0.00 255.0 FORMAT "%5.1" /end CHARACTERISTIC
/begin CHARACTERISTIC DSCHED_Excl.ATEH_ATEN_C "exclusion relation / Exclusive FIds to FID_ATEH and FID_ATEN" VALUE 0x804EE24A Val_Wu8 255.0 DFC_OneToOne 0.00 255.0 FORMAT "%5.1" /end CHARACTERISTIC
/begin CHARACTERISTIC DSCHED_Excl.ATEH_EGSDCmnSeg1B1Parl_C "exclusion relation / Exclusive FIds to FID_ATEH and FId_EGSDCmnSeg1B1Parl" VALUE 0x804EE24B Val_Wu8 255.0 DFC_OneToOne 0.00 255.0 FORMAT "%5.1" /end CHARACTERISTIC
/begin CHARACTERISTIC DSCHED_Excl.ATEH_BLLRH_C "exclusion relation / Exclusive FIds to FID_ATEH and FID_BLLRH" VALUE 0x804EE24C Val_Wu8 255.0 DFC_OneToOne 0.00 255.0 FORMAT "%5.1" /end CHARACTERISTIC
/begin CHARACTERISTIC DSCHED_Excl.ATEH_BLLRKH_C "exclusion relation / Exclusive FIds to FID_ATEH and FID_BLLRKH" VALUE 0x804EE24D Val_Wu8 255.0 DFC_OneToOne 0.00 255.0 FORMAT "%5.1" /end CHARACTERISTIC
/begin CHARACTERISTIC DSCHED_Excl.ATEH_BPLSU_C "exclusion relation / Exclusive FIds to FID_ATEH and FID_BPLSU" VALUE 0x804EE24E Val_Wu8 255.0 DFC_OneToOne 0.00 255.0 FORMAT "%5.1" /end CHARACTERISTIC
/begin CHARACTERISTIC DSCHED_Excl.ATEH_CJ135RvsChrgMeasS1B1_C "exclusion relation / Exclusive FIds to FID_ATEH and FId_CJ135RvsChrgMeasS1B1" VALUE 0x804EE24F Val_Wu8 255.0 DFC_OneToOne 0.00 255.0 FORMAT "%5.1" /end CHARACTERISTIC
/begin CHARACTERISTIC DSCHED_Excl.ATEH_CatHeatgColdStrtReq_C "exclusion relation / Exclusive FIds to FID_ATEH and FId_CatHeatgColdStrtReq" VALUE 0x804EE250 Val_Wu8 255.0 DFC_OneToOne 0.00 255.0 FORMAT "%5.1" /end CHARACTERISTIC
/begin CHARACTERISTIC DSCHED_Excl.ATEH_CatHeatgWrmReq_C "exclusion relation / Exclusive FIds to FID_ATEH and FId_CatHeatgWrmReq" VALUE 0x804EE251 Val_Wu8 255.0 DFC_OneToOne 0.00 255.0 FORMAT "%5.1" /end CHARACTERISTIC
/begin CHARACTERISTIC DSCHED_Excl.ATEH_EGSDO2SnsrMntdRelsS1B1_C "exclusion relation / Exclusive FIds to FID_ATEH and FId_EGSDO2SnsrMntdRelsS1B1" VALUE 0x804EE252 Val_Wu8 255.0 DFC_OneToOne 0.00 255.0 FORMAT "%5.1" /end CHARACTERISTIC
/begin CHARACTERISTIC DSCHED_Excl.ATEH_EGSDO2_LamOffsFastS1B1_C "exclusion relation / Exclusive FIds to FID_ATEH and FId_EGSDO2_LamOffsFastS1B1" VALUE 0x804EE253 Val_Wu8 255.0 DFC_OneToOne 0.00 255.0 FORMAT "%5.1" /end CHARACTERISTIC
/begin CHARACTERISTIC DSCHED_Excl.ATEH_MisfDetDnAdpnNv_C "exclusion relation / Exclusive FIds to FID_ATEH and FId_MisfDetDnAdpnNv" VALUE 0x804EE254 Val_Wu8 255.0 DFC_OneToOne 0.00 255.0 FORMAT "%5.1" /end CHARACTERISTIC
/begin CHARACTERISTIC DSCHED_Excl.ATEL_ATEN_C "exclusion relation / Exclusive FIds to FID_ATEL and FID_ATEN" VALUE 0x804EE255 Val_Wu8 255.0 DFC_OneToOne 0.00 255.0 FORMAT "%5.1" /end CHARACTERISTIC
/begin CHARACTERISTIC DSCHED_Excl.ATEL_EGSDCmnSeg1B1Parl_C "exclusion relation / Exclusive FIds to FID_ATEL and FId_EGSDCmnSeg1B1Parl" VALUE 0x804EE256 Val_Wu8 255.0 DFC_OneToOne 0.00 255.0 FORMAT "%5.1" /end CHARACTERISTIC
/begin CHARACTERISTIC DSCHED_Excl.ATEL_BLLRH_C "exclusion relation / Exclusive FIds to FID_ATEL and FID_BLLRH" VALUE 0x804EE257 Val_Wu8 255.0 DFC_OneToOne 0.00 255.0 FORMAT "%5.1" /end CHARACTERISTIC
/begin CHARACTERISTIC DSCHED_Excl.ATEL_BLLRKH_C "exclusion relation / Exclusive FIds to FID_ATEL and FID_BLLRKH" VALUE 0x804EE258 Val_Wu8 255.0 DFC_OneToOne 0.00 255.0 FORMAT "%5.1" /end CHARACTERISTIC
/begin CHARACTERISTIC DSCHED_Excl.ATEL_BPLSU_C "exclusion relation / Exclusive FIds to FID_ATEL and FID_BPLSU" VALUE 0x804EE259 Val_Wu8 255.0 DFC_OneToOne 0.00 255.0 FORMAT "%5.1" /end CHARACTERISTIC
/begin CHARACTERISTIC DSCHED_Excl.ATEL_CJ135RvsChrgMeasS1B1_C "exclusion relation / Exclusive FIds to FID_ATEL and FId_CJ135RvsChrgMeasS1B1" VALUE 0x804EE25A Val_Wu8 255.0 DFC_OneToOne 0.00 255.0 FORMAT "%5.1" /end CHARACTERISTIC
/begin CHARACTERISTIC DSCHED_Excl.ATEL_CatHeatgColdStrtReq_C "exclusion relation / Exclusive FIds to FID_ATEL and FId_CatHeatgColdStrtReq" VALUE 0x804EE25B Val_Wu8 255.0 DFC_OneToOne 0.00 255.0 FORMAT "%5.1" /end CHARACTERISTIC
/begin CHARACTERISTIC DSCHED_Excl.ATEL_CatHeatgWrmReq_C "exclusion relation / Exclusive FIds to FID_ATEL and FId_CatHeatgWrmReq" VALUE 0x804EE25C Val_Wu8 255.0 DFC_OneToOne 0.00 255.0 FORMAT "%5.1" /end CHARACTERISTIC
/begin CHARACTERISTIC DSCHED_Excl.ATEL_EGSDO2SnsrMntdRelsS1B1_C "exclusion relation / Exclusive FIds to FID_ATEL and FId_EGSDO2SnsrMntdRelsS1B1" VALUE 0x804EE25D Val_Wu8 255.0 DFC_OneToOne 0.00 255.0 FORMAT "%5.1" /end CHARACTERISTIC
/begin CHARACTERISTIC DSCHED_Excl.ATEL_EGSDO2_LamOffsFastS1B1_C "exclusion relation / Exclusive FIds to FID_ATEL and FId_EGSDO2_LamOffsFastS1B1" VALUE 0x804EE25E Val_Wu8 255.0 DFC_OneToOne 0.00 255.0 FORMAT "%5.1" /end CHARACTERISTIC
/begin CHARACTERISTIC DSCHED_Excl.ATEL_MisfDetDnAdpnNv_C "exclusion relation / Exclusive FIds to FID_ATEL and FId_MisfDetDnAdpnNv" VALUE 0x804EE25F Val_Wu8 255.0 DFC_OneToOne 0.00 255.0 FORMAT "%5.1" /end CHARACTERISTIC
/begin CHARACTERISTIC DSCHED_Excl.ATEN_EGSDCmnSeg1B1Parl_C "exclusion relation / Exclusive FIds to FID_ATEN and FId_EGSDCmnSeg1B1Parl" VALUE 0x804EE260 Val_Wu8 255.0 DFC_OneToOne 0.00 255.0 FORMAT "%5.1" /end CHARACTERISTIC
/begin CHARACTERISTIC DSCHED_Excl.ATEN_BLLRH_C "exclusion relation / Exclusive FIds to FID_ATEN and FID_BLLRH" VALUE 0x804EE261 Val_Wu8 255.0 DFC_OneToOne 0.00 255.0 FORMAT "%5.1" /end CHARACTERISTIC
/begin CHARACTERISTIC DSCHED_Excl.ATEN_BLLRKH_C "exclusion relation / Exclusive FIds to FID_ATEN and FID_BLLRKH" VALUE 0x804EE262 Val_Wu8 255.0 DFC_OneToOne 0.00 255.0 FORMAT "%5.1" /end CHARACTERISTIC
/begin CHARACTERISTIC DSCHED_Excl.ATEN_BPLSU_C "exclusion relation / Exclusive FIds to FID_ATEN and FID_BPLSU" VALUE 0x804EE263 Val_Wu8 255.0 DFC_OneToOne 0.00 255.0 FORMAT "%5.1" /end CHARACTERISTIC
/begin CHARACTERISTIC DSCHED_Excl.ATEN_CJ135RvsChrgMeasS1B1_C "exclusion relation / Exclusive FIds to FID_ATEN and FId_CJ135RvsChrgMeasS1B1" VALUE 0x804EE264 Val_Wu8 255.0 DFC_OneToOne 0.00 255.0 FORMAT "%5.1" /end CHARACTERISTIC
/begin CHARACTERISTIC DSCHED_Excl.ATEN_CatHeatgColdStrtReq_C "exclusion relation / Exclusive FIds to FID_ATEN and FId_CatHeatgColdStrtReq" VALUE 0x804EE265 Val_Wu8 255.0 DFC_OneToOne 0.00 255.0 FORMAT "%5.1" /end CHARACTERISTIC
/begin CHARACTERISTIC DSCHED_Excl.ATEN_CatHeatgWrmReq_C "exclusion relation / Exclusive FIds to FID_ATEN and FId_CatHeatgWrmReq" VALUE 0x804EE266 Val_Wu8 255.0 DFC_OneToOne 0.00 255.0 FORMAT "%5.1" /end CHARACTERISTIC
/begin CHARACTERISTIC DSCHED_Excl.ATEN_EGSDO2SnsrMntdRelsS1B1_C "exclusion relation / Exclusive FIds to FID_ATEN and FId_EGSDO2SnsrMntdRelsS1B1" VALUE 0x804EE267 Val_Wu8 255.0 DFC_OneToOne 0.00 255.0 FORMAT "%5.1" /end CHARACTERISTIC
/begin CHARACTERISTIC DSCHED_Excl.ATEN_EGSDO2_LamOffsFastS1B1_C "exclusion relation / Exclusive FIds to FID_ATEN and FId_EGSDO2_LamOffsFastS1B1" VALUE 0x804EE268 Val_Wu8 255.0 DFC_OneToOne 0.00 255.0 FORMAT "%5.1" /end CHARACTERISTIC
/begin CHARACTERISTIC DSCHED_Excl.ATEN_MisfDetDnAdpnNv_C "exclusion relation / Exclusive FIds to FID_ATEN and FId_MisfDetDnAdpnNv" VALUE 0x804EE269 Val_Wu8 255.0 DFC_OneToOne 0.00 255.0 FORMAT "%5.1" /end CHARACTERISTIC
/begin CHARACTERISTIC DSCHED_Excl.EGSDCmnSeg1B1Parl_BLLRH_C "exclusion relation / Exclusive FIds to FId_EGSDCmnSeg1B1Parl and FID_BLLRH" VALUE 0x804EE26A Val_Wu8 255.0 DFC_OneToOne 0.00 255.0 FORMAT "%5.1" /end CHARACTERISTIC
/begin CHARACTERISTIC DSCHED_Excl.EGSDCmnSeg1B1Parl_BLLRKH_C "exclusion relation / Exclusive FIds to FId_EGSDCmnSeg1B1Parl and FID_BLLRKH" VALUE 0x804EE26B Val_Wu8 255.0 DFC_OneToOne 0.00 255.0 FORMAT "%5.1" /end CHARACTERISTIC
/begin CHARACTERISTIC DSCHED_Excl.EGSDCmnSeg1B1Parl_BPLSU_C "exclusion relation / Exclusive FIds to FId_EGSDCmnSeg1B1Parl and FID_BPLSU" VALUE 0x804EE26C Val_Wu8 255.0 DFC_OneToOne 0.00 255.0 FORMAT "%5.1" /end CHARACTERISTIC
/begin CHARACTERISTIC DSCHED_Excl.EGSDCmnSeg1B1Parl_CJ135RvsChrgMeasS1B1_C "exclusion relation / Exclusive FIds to FId_EGSDCmnSeg1B1Parl and FId_CJ135RvsChrgMeasS1B1" VALUE 0x804EE26D Val_Wu8 255.0 DFC_OneToOne 0.00 255.0 FORMAT "%5.1" /end CHARACTERISTIC
/begin CHARACTERISTIC DSCHED_Excl.EGSDCmnSeg1B1Parl_CatHeatgColdStrtReq_C "exclusion relation / Exclusive FIds to FId_EGSDCmnSeg1B1Parl and FId_CatHeatgColdStrtReq" VALUE 0x804EE26E Val_Wu8 255.0 DFC_OneToOne 0.00 255.0 FORMAT "%5.1" /end CHARACTERISTIC
/begin CHARACTERISTIC DSCHED_Excl.EGSDCmnSeg1B1Parl_CatHeatgWrmReq_C "exclusion relation / Exclusive FIds to FId_EGSDCmnSeg1B1Parl and FId_CatHeatgWrmReq" VALUE 0x804EE26F Val_Wu8 255.0 DFC_OneToOne 0.00 255.0 FORMAT "%5.1" /end CHARACTERISTIC
/begin CHARACTERISTIC DSCHED_Excl.EGSDCmnSeg1B1Parl_EGSDO2SnsrMntdRelsS1B1_C "exclusion relation / Exclusive FIds to FId_EGSDCmnSeg1B1Parl and FId_EGSDO2SnsrMntdRelsS1B1" VALUE 0x804EE270 Val_Wu8 255.0 DFC_OneToOne 0.00 255.0 FORMAT "%5.1" /end CHARACTERISTIC
/begin CHARACTERISTIC DSCHED_Excl.EGSDCmnSeg1B1Parl_EGSDO2_LamOffsFastS1B1_C "exclusion relation / Exclusive FIds to FId_EGSDCmnSeg1B1Parl and FId_EGSDO2_LamOffsFastS1B1" VALUE 0x804EE271 Val_Wu8 255.0 DFC_OneToOne 0.00 255.0 FORMAT "%5.1" /end CHARACTERISTIC
/begin CHARACTERISTIC DSCHED_Excl.EGSDCmnSeg1B1Parl_MisfDetDnAdpnNv_C "exclusion relation / Exclusive FIds to FId_EGSDCmnSeg1B1Parl and FId_MisfDetDnAdpnNv" VALUE 0x804EE272 Val_Wu8 255.0 DFC_OneToOne 0.00 255.0 FORMAT "%5.1" /end CHARACTERISTIC
/begin CHARACTERISTIC DSCHED_Excl.BLLRH_BLLRKH_C "exclusion relation / Exclusive FIds to FID_BLLRH and FID_BLLRKH" VALUE 0x804EE273 Val_Wu8 255.0 DFC_OneToOne 0.00 255.0 FORMAT "%5.1" /end CHARACTERISTIC
/begin CHARACTERISTIC DSCHED_Excl.BLLRH_BPLSU_C "exclusion relation / Exclusive FIds to FID_BLLRH and FID_BPLSU" VALUE 0x804EE274 Val_Wu8 255.0 DFC_OneToOne 0.00 255.0 FORMAT "%5.1" /end CHARACTERISTIC
/begin CHARACTERISTIC DSCHED_Excl.BLLRH_CJ135RvsChrgMeasS1B1_C "exclusion relation / Exclusive FIds to FID_BLLRH and FId_CJ135RvsChrgMeasS1B1" VALUE 0x804EE275 Val_Wu8 255.0 DFC_OneToOne 0.00 255.0 FORMAT "%5.1" /end CHARACTERISTIC
/begin CHARACTERISTIC DSCHED_Excl.BLLRH_CatHeatgColdStrtReq_C "exclusion relation / Exclusive FIds to FID_BLLRH and FId_CatHeatgColdStrtReq" VALUE 0x804EE276 Val_Wu8 255.0 DFC_OneToOne 0.00 255.0 FORMAT "%5.1" /end CHARACTERISTIC
/begin CHARACTERISTIC DSCHED_Excl.BLLRH_CatHeatgWrmReq_C "exclusion relation / Exclusive FIds to FID_BLLRH and FId_CatHeatgWrmReq" VALUE 0x804EE277 Val_Wu8 255.0 DFC_OneToOne 0.00 255.0 FORMAT "%5.1" /end CHARACTERISTIC
/begin CHARACTERISTIC DSCHED_Excl.BLLRH_EGSDO2SnsrMntdRelsS1B1_C "exclusion relation / Exclusive FIds to FID_BLLRH and FId_EGSDO2SnsrMntdRelsS1B1" VALUE 0x804EE278 Val_Wu8 255.0 DFC_OneToOne 0.00 255.0 FORMAT "%5.1" /end CHARACTERISTIC
/begin CHARACTERISTIC DSCHED_Excl.BLLRH_EGSDO2_LamOffsFastS1B1_C "exclusion relation / Exclusive FIds to FID_BLLRH and FId_EGSDO2_LamOffsFastS1B1" VALUE 0x804EE279 Val_Wu8 255.0 DFC_OneToOne 0.00 255.0 FORMAT "%5.1" /end CHARACTERISTIC
/begin CHARACTERISTIC DSCHED_Excl.BLLRH_MisfDetDnAdpnNv_C "exclusion relation / Exclusive FIds to FID_BLLRH and FId_MisfDetDnAdpnNv" VALUE 0x804EE27A Val_Wu8 255.0 DFC_OneToOne 0.00 255.0 FORMAT "%5.1" /end CHARACTERISTIC
/begin CHARACTERISTIC DSCHED_Excl.BLLRKH_BPLSU_C "exclusion relation / Exclusive FIds to FID_BLLRKH and FID_BPLSU" VALUE 0x804EE27B Val_Wu8 255.0 DFC_OneToOne 0.00 255.0 FORMAT "%5.1" /end CHARACTERISTIC
/begin CHARACTERISTIC DSCHED_Excl.BLLRKH_CJ135RvsChrgMeasS1B1_C "exclusion relation / Exclusive FIds to FID_BLLRKH and FId_CJ135RvsChrgMeasS1B1" VALUE 0x804EE27C Val_Wu8 255.0 DFC_OneToOne 0.00 255.0 FORMAT "%5.1" /end CHARACTERISTIC
/begin CHARACTERISTIC DSCHED_Excl.BLLRKH_CatHeatgColdStrtReq_C "exclusion relation / Exclusive FIds to FID_BLLRKH and FId_CatHeatgColdStrtReq" VALUE 0x804EE27D Val_Wu8 255.0 DFC_OneToOne 0.00 255.0 FORMAT "%5.1" /end CHARACTERISTIC
/begin CHARACTERISTIC DSCHED_Excl.BLLRKH_CatHeatgWrmReq_C "exclusion relation / Exclusive FIds to FID_BLLRKH and FId_CatHeatgWrmReq" VALUE 0x804EE27E Val_Wu8 255.0 DFC_OneToOne 0.00 255.0 FORMAT "%5.1" /end CHARACTERISTIC
/begin CHARACTERISTIC DSCHED_Excl.BLLRKH_EGSDO2SnsrMntdRelsS1B1_C "exclusion relation / Exclusive FIds to FID_BLLRKH and FId_EGSDO2SnsrMntdRelsS1B1" VALUE 0x804EE27F Val_Wu8 255.0 DFC_OneToOne 0.00 255.0 FORMAT "%5.1" /end CHARACTERISTIC
/begin CHARACTERISTIC DSCHED_Excl.BLLRKH_EGSDO2_LamOffsFastS1B1_C "exclusion relation / Exclusive FIds to FID_BLLRKH and FId_EGSDO2_LamOffsFastS1B1" VALUE 0x804EE280 Val_Wu8 255.0 DFC_OneToOne 0.00 255.0 FORMAT "%5.1" /end CHARACTERISTIC
/begin CHARACTERISTIC DSCHED_Excl.BLLRKH_MisfDetDnAdpnNv_C "exclusion relation / Exclusive FIds to FID_BLLRKH and FId_MisfDetDnAdpnNv" VALUE 0x804EE281 Val_Wu8 255.0 DFC_OneToOne 0.00 255.0 FORMAT "%5.1" /end CHARACTERISTIC
/begin CHARACTERISTIC DSCHED_Excl.BPLSU_CJ135RvsChrgMeasS1B1_C "exclusion relation / Exclusive FIds to FID_BPLSU and FId_CJ135RvsChrgMeasS1B1" VALUE 0x804EE282 Val_Wu8 255.0 DFC_OneToOne 0.00 255.0 FORMAT "%5.1" /end CHARACTERISTIC
/begin CHARACTERISTIC DSCHED_Excl.BPLSU_CatHeatgColdStrtReq_C "exclusion relation / Exclusive FIds to FID_BPLSU and FId_CatHeatgColdStrtReq" VALUE 0x804EE283 Val_Wu8 255.0 DFC_OneToOne 0.00 255.0 FORMAT "%5.1" /end CHARACTERISTIC
/begin CHARACTERISTIC DSCHED_Excl.BPLSU_CatHeatgWrmReq_C "exclusion relation / Exclusive FIds to FID_BPLSU and FId_CatHeatgWrmReq" VALUE 0x804EE284 Val_Wu8 255.0 DFC_OneToOne 0.00 255.0 FORMAT "%5.1" /end CHARACTERISTIC
/begin CHARACTERISTIC DSCHED_Excl.BPLSU_EGSDO2SnsrMntdRelsS1B1_C "exclusion relation / Exclusive FIds to FID_BPLSU and FId_EGSDO2SnsrMntdRelsS1B1" VALUE 0x804EE285 Val_Wu8 255.0 DFC_OneToOne 0.00 255.0 FORMAT "%5.1" /end CHARACTERISTIC
/begin CHARACTERISTIC DSCHED_Excl.BPLSU_EGSDO2_LamOffsFastS1B1_C "exclusion relation / Exclusive FIds to FID_BPLSU and FId_EGSDO2_LamOffsFastS1B1" VALUE 0x804EE286 Val_Wu8 255.0 DFC_OneToOne 0.00 255.0 FORMAT "%5.1" /end CHARACTERISTIC
/begin CHARACTERISTIC DSCHED_Excl.BPLSU_MisfDetDnAdpnNv_C "exclusion relation / Exclusive FIds to FID_BPLSU and FId_MisfDetDnAdpnNv" VALUE 0x804EE287 Val_Wu8 255.0 DFC_OneToOne 0.00 255.0 FORMAT "%5.1" /end CHARACTERISTIC
/begin CHARACTERISTIC DSCHED_Excl.CJ135RvsChrgMeasS1B1_CatHeatgColdStrtReq_C "exclusion relation / Exclusive FIds to FId_CJ135RvsChrgMeasS1B1 and FId_CatHeatgColdStrtReq" VALUE 0x804EE288 Val_Wu8 255.0 DFC_OneToOne 0.00 255.0 FORMAT "%5.1" /end CHARACTERISTIC
/begin CHARACTERISTIC DSCHED_Excl.CJ135RvsChrgMeasS1B1_CatHeatgWrmReq_C "exclusion relation / Exclusive FIds to FId_CJ135RvsChrgMeasS1B1 and FId_CatHeatgWrmReq" VALUE 0x804EE289 Val_Wu8 255.0 DFC_OneToOne 0.00 255.0 FORMAT "%5.1" /end CHARACTERISTIC
/begin CHARACTERISTIC DSCHED_Excl.CJ135RvsChrgMeasS1B1_EGSDO2SnsrMntdRelsS1B1_C "exclusion relation / Exclusive FIds to FId_CJ135RvsChrgMeasS1B1 and FId_EGSDO2SnsrMntdRelsS1B1" VALUE 0x804EE28A Val_Wu8 255.0 DFC_OneToOne 0.00 255.0 FORMAT "%5.1" /end CHARACTERISTIC
/begin CHARACTERISTIC DSCHED_Excl.CJ135RvsChrgMeasS1B1_EGSDO2_LamOffsFastS1B1_C "exclusion relation / Exclusive FIds to FId_CJ135RvsChrgMeasS1B1 and FId_EGSDO2_LamOffsFastS1B1" VALUE 0x804EE28B Val_Wu8 255.0 DFC_OneToOne 0.00 255.0 FORMAT "%5.1" /end CHARACTERISTIC
/begin CHARACTERISTIC DSCHED_Excl.CJ135RvsChrgMeasS1B1_MisfDetDnAdpnNv_C "exclusion relation / Exclusive FIds to FId_CJ135RvsChrgMeasS1B1 and FId_MisfDetDnAdpnNv" VALUE 0x804EE28C Val_Wu8 255.0 DFC_OneToOne 0.00 255.0 FORMAT "%5.1" /end CHARACTERISTIC
/begin CHARACTERISTIC DSCHED_Excl.CatHeatgColdStrtReq_CatHeatgWrmReq_C "exclusion relation / Exclusive FIds to FId_CatHeatgColdStrtReq and FId_CatHeatgWrmReq" VALUE 0x804EE28D Val_Wu8 255.0 DFC_OneToOne 0.00 255.0 FORMAT "%5.1" /end CHARACTERISTIC
/begin CHARACTERISTIC DSCHED_Excl.CatHeatgColdStrtReq_EGSDO2SnsrMntdRelsS1B1_C "exclusion relation / Exclusive FIds to FId_CatHeatgColdStrtReq and FId_EGSDO2SnsrMntdRelsS1B1" VALUE 0x804EE28E Val_Wu8 255.0 DFC_OneToOne 0.00 255.0 FORMAT "%5.1" /end CHARACTERISTIC
/begin CHARACTERISTIC DSCHED_Excl.CatHeatgColdStrtReq_EGSDO2_LamOffsFastS1B1_C "exclusion relation / Exclusive FIds to FId_CatHeatgColdStrtReq and FId_EGSDO2_LamOffsFastS1B1" VALUE 0x804EE28F Val_Wu8 255.0 DFC_OneToOne 0.00 255.0 FORMAT "%5.1" /end CHARACTERISTIC
/begin CHARACTERISTIC DSCHED_Excl.CatHeatgColdStrtReq_MisfDetDnAdpnNv_C "exclusion relation / Exclusive FIds to FId_CatHeatgColdStrtReq and FId_MisfDetDnAdpnNv" VALUE 0x804EE290 Val_Wu8 255.0 DFC_OneToOne 0.00 255.0 FORMAT "%5.1" /end CHARACTERISTIC
/begin CHARACTERISTIC DSCHED_Excl.CatHeatgWrmReq_EGSDO2SnsrMntdRelsS1B1_C "exclusion relation / Exclusive FIds to FId_CatHeatgWrmReq and FId_EGSDO2SnsrMntdRelsS1B1" VALUE 0x804EE291 Val_Wu8 255.0 DFC_OneToOne 0.00 255.0 FORMAT "%5.1" /end CHARACTERISTIC
/begin CHARACTERISTIC DSCHED_Excl.CatHeatgWrmReq_EGSDO2_LamOffsFastS1B1_C "exclusion relation / Exclusive FIds to FId_CatHeatgWrmReq and FId_EGSDO2_LamOffsFastS1B1" VALUE 0x804EE292 Val_Wu8 255.0 DFC_OneToOne 0.00 255.0 FORMAT "%5.1" /end CHARACTERISTIC
/begin CHARACTERISTIC DSCHED_Excl.CatHeatgWrmReq_MisfDetDnAdpnNv_C "exclusion relation / Exclusive FIds to FId_CatHeatgWrmReq and FId_MisfDetDnAdpnNv" VALUE 0x804EE293 Val_Wu8 255.0 DFC_OneToOne 0.00 255.0 FORMAT "%5.1" /end CHARACTERISTIC
/begin CHARACTERISTIC DSCHED_Excl.EGSDO2SnsrMntdRelsS1B1_EGSDO2_LamOffsFastS1B1_C "exclusion relation / Exclusive FIds to FId_EGSDO2SnsrMntdRelsS1B1 and FId_EGSDO2_LamOffsFastS1B1" VALUE 0x804EE294 Val_Wu8 255.0 DFC_OneToOne 0.00 255.0 FORMAT "%5.1" /end CHARACTERISTIC
/begin CHARACTERISTIC DSCHED_Excl.EGSDO2SnsrMntdRelsS1B1_MisfDetDnAdpnNv_C "exclusion relation / Exclusive FIds to FId_EGSDO2SnsrMntdRelsS1B1 and FId_MisfDetDnAdpnNv" VALUE 0x804EE295 Val_Wu8 255.0 DFC_OneToOne 0.00 255.0 FORMAT "%5.1" /end CHARACTERISTIC
/begin CHARACTERISTIC DSCHED_Excl.EGSDO2_LamOffsFastS1B1_MisfDetDnAdpnNv_C "exclusion relation / Exclusive FIds to FId_EGSDO2_LamOffsFastS1B1 and FId_MisfDetDnAdpnNv" VALUE 0x804EE296 Val_Wu8 255.0 DFC_OneToOne 0.00 255.0 FORMAT "%5.1" /end CHARACTERISTIC
/begin CHARACTERISTIC DSCHED_stMode_C "Central disable switch for all scheduled FIDs (disabled if set to 0)" VALUE 0x804F920A Val_Wu8 255.0 DINH_OneToOne 0.00 255.0 FORMAT "%5.1" /end CHARACTERISTIC
/begin CHARACTERISTIC DSCHED_StSimnSeln_C "Simulation approaches selection" VALUE 0x804F920B Val_Wu8 1.00000000000 DSCHED_StSimnSeln_C_Verb 0.00 1.00000000000 FORMAT "%13.11" /end CHARACTERISTIC
/begin CHARACTERISTIC DSCHED_valDflOpMode_C "Default request value for operation mode coordinator during disable state (DSCHED_stMode_C = 0)" VALUE 0x804F920C Val_Wu16 65535.00 DINH_OneToOne 0.00 65535.00 FORMAT "%8.2" /end CHARACTERISTIC
/begin CHARACTERISTIC DSMAUX_dtWUCMin_C "minimum temperature raise for warm up cycle detection" VALUE 0x804EE298 Val_Ws16 6553.500 TempDiff_Kelv -3276.800 3276.700 FORMAT "%8.3" /end CHARACTERISTIC
/begin CHARACTERISTIC DSMAUX_tWUCMin_C "minimum temperature for warm up cycle detection" VALUE 0x804EE29A Val_Ws16 6553.500 Temp_Cels -3549.940 3003.560 FORMAT "%8.3" /end CHARACTERISTIC
/begin CHARACTERISTIC DSMAUX_xClearMode_C "clear mode for clear trigger" VALUE 0x804EE29C Val_Wu16 703.000000000 DFC_Verb 0.00 703.000000000 FORMAT "%13.9" /end CHARACTERISTIC
/begin CHARACTERISTIC DSMAUX_xClearTrg_C "clear trigger to delete diagnostic information" VALUE 0x804EE29E Val_Wu8 255.0 DFC_OneToOne 0.00 255.0 FORMAT "%5.1" /end CHARACTERISTIC
/begin CHARACTERISTIC DSMDur_valEvntQntDist_C "increment quantization for travelled distance counter" VALUE 0x804EE2A0 Val_Wu16 65535.00 DFES_OneToOne 0.00 65535.00 FORMAT "%8.2" /end CHARACTERISTIC
/begin CHARACTERISTIC DSMDur_valEvntQntTi_C "increment quantization for operation time counter" VALUE 0x804EE2A2 Val_Wu16 65535.00 DFES_OneToOne 0.00 65535.00 FORMAT "%8.2" /end CHARACTERISTIC
/begin CHARACTERISTIC DSMDur_xEnaGlb_CA "Enable conditions for global duration counters" VAL_BLK 0x804EE2A4 ValA_Wu16 65535.00 DFES_OneToOne 0.00 65535.00 FORMAT "%8.2" NUMBER 1 /end CHARACTERISTIC
/begin CHARACTERISTIC DSMDur_xRstGlb_CA "Reset conditions for global duration counters" VAL_BLK 0x804EE2A6 ValA_Wu8 255.0 DFES_OneToOne 0.00 255.0 FORMAT "%5.1" NUMBER 1 /end CHARACTERISTIC
/begin CHARACTERISTIC DSMDur_xSelEvntGlb_CA "Counting event selection for global duration counters" VAL_BLK 0x804EE2A7 ValA_Wu8 8.00000000000 DSMDur_EvntSel_Verb 0.00 8.00000000000 FORMAT "%13.11" NUMBER 1 /end CHARACTERISTIC
/begin CHARACTERISTIC DSMRdy_Grp.FlSys_CA "Fault checks for readiness calculation / Checks for group FlSys" VAL_BLK 0x804F9210 ValA_Wu16 703.000000000 DFC_Verb 0.00 703.000000000 FORMAT "%13.9" NUMBER 15 /end CHARACTERISTIC
/begin CHARACTERISTIC DSMRdy_Grp.Cat_CA "Fault checks for readiness calculation / Checks for group Cat" VAL_BLK 0x804F9230 ValA_Wu16 703.000000000 DFC_Verb 0.00 703.000000000 FORMAT "%13.9" NUMBER 15 /end CHARACTERISTIC
/begin CHARACTERISTIC DSMRdy_Grp.HtCat_CA "Fault checks for readiness calculation / Checks for group HtCat" VAL_BLK 0x804F924E ValA_Wu16 703.000000000 DFC_Verb 0.00 703.000000000 FORMAT "%13.9" NUMBER 15 /end CHARACTERISTIC
/begin CHARACTERISTIC DSMRdy_Grp.EvpSys_CA "Fault checks for readiness calculation / Checks for group EvpSys" VAL_BLK 0x804F926C ValA_Wu16 703.000000000 DFC_Verb 0.00 703.000000000 FORMAT "%13.9" NUMBER 15 /end CHARACTERISTIC
/begin CHARACTERISTIC DSMRdy_Grp.SecAirSys_CA "Fault checks for readiness calculation / Checks for group SecAirSys" VAL_BLK 0x804F928A ValA_Wu16 703.000000000 DFC_Verb 0.00 703.000000000 FORMAT "%13.9" NUMBER 15 /end CHARACTERISTIC
/begin CHARACTERISTIC DSMRdy_Grp.O2Sens_CA "Fault checks for readiness calculation / Checks for group O2Sens" VAL_BLK 0x804F92AA ValA_Wu16 703.000000000 DFC_Verb 0.00 703.000000000 FORMAT "%13.9" NUMBER 15 /end CHARACTERISTIC
/begin CHARACTERISTIC DSMRdy_Grp.O2SensHt_CA "Fault checks for readiness calculation / Checks for group O2SensHt" VAL_BLK 0x804F92C8 ValA_Wu16 703.000000000 DFC_Verb 0.00 703.000000000 FORMAT "%13.9" NUMBER 15 /end CHARACTERISTIC
/begin CHARACTERISTIC DSMRdy_Grp.EGR_CA "Fault checks for readiness calculation / Checks for group EGR" VAL_BLK 0x804F92E6 ValA_Wu16 703.000000000 DFC_Verb 0.00 703.000000000 FORMAT "%13.9" NUMBER 15 /end CHARACTERISTIC
/begin CHARACTERISTIC DSMRdy_X.PID1ForceLowMsk_C "DSMRdy calibration masks / Enforced zero bits of PID$01 output" VALUE 0x804EE2A8 Val_Wu32 4294967295.00 DSMRdy_OneToOne 0.00 4294967295.00 FORMAT "%13.2" /end CHARACTERISTIC
/begin CHARACTERISTIC DSMRdy_X.PID1ForceHighMsk_C "DSMRdy calibration masks / Enforced one bits of PID$01 output" VALUE 0x804EE2AC Val_Wu32 4294967295.00 DSMRdy_OneToOne 0.00 4294967295.00 FORMAT "%13.2" /end CHARACTERISTIC
/begin CHARACTERISTIC DSMRdy_X.PID41ForceLowMsk_C "DSMRdy calibration masks / Enforced zero bits of PID$41 output" VALUE 0x804EE2B0 Val_Wu32 4294967295.00 DSMRdy_OneToOne 0.00 4294967295.00 FORMAT "%13.2" /end CHARACTERISTIC
/begin CHARACTERISTIC DSMRdy_X.PID41ForceHighMsk_C "DSMRdy calibration masks / Enforced one bits of PID$41 output" VALUE 0x804EE2B4 Val_Wu32 4294967295.00 DSMRdy_OneToOne 0.00 4294967295.00 FORMAT "%13.2" /end CHARACTERISTIC
/begin CHARACTERISTIC SF_LM "Inputs for sum of Loas sensor faults DFP_LM" VAL_BLK 0x8051C11C RB_ValA_Wu16 58.0000000000 dfp_verbal 0.00 58.0000000000 FORMAT "%13.10" READ_ONLY NUMBER 3 /end CHARACTERISTIC
/begin MEASUREMENT B_ehfs_msg "Condition substitute value main charge sensor" UBYTE B_TRUE 1 100 0.00 1.00000000000 BIT_MASK 0x1 FORMAT "%13.11" ECU_ADDRESS 0x60000160 /end MEASUREMENT
/begin MEASUREMENT B_fhfs_msg "condition: error of main filling sensor" UBYTE B_TRUE 1 100 0.00 1.00000000000 BIT_MASK 0x1 FORMAT "%13.11" ECU_ADDRESS 0x60000151 /end MEASUREMENT
/begin MEASUREMENT B_statas_msg "status cylinder charge estimation for CAN" UBYTE B_TRUE 1 100 0.00 1.00000000000 BIT_MASK 0x1 FORMAT "%13.11" ECU_ADDRESS 0x6000012D /end MEASUREMENT
/begin MEASUREMENT Dem_BswErrorBufferWriteCounter "Write access counter" UWORD OneToOne 1 100 0.00 65535.00 FORMAT "%8.2" ECU_ADDRESS 0x70004730 /end MEASUREMENT
/begin MEASUREMENT Dem_BswErrorBufferWriteIndex "Write index for pre init buffer" UWORD OneToOne 1 100 0.00 65535.00 FORMAT "%8.2" ECU_ADDRESS 0x70004732 /end MEASUREMENT
/begin MEASUREMENT Dem_PTOSt "Current PTO active status reported to Dem" UBYTE OneToOne 1 100 0.00 255.0 BIT_MASK 0x1 FORMAT "%5.1" ECU_ADDRESS 0x70005858 /end MEASUREMENT
/begin MEASUREMENT Dem_stInit "Initialization state of Dem" UBYTE OneToOne 1 100 0.00 255.0 FORMAT "%5.1" ECU_ADDRESS 0x70005877 /end MEASUREMENT
/begin MEASUREMENT DFC_idxDfcTrans "Index of Dfc that is last processed during transition" UWORD OneToOne 1 100 0.00 65535.00 FORMAT "%8.2" ARRAY_SIZE 1 ECU_ADDRESS 0x600054EA /end MEASUREMENT
/begin MEASUREMENT DSCHED_St.FId_Unused "Scheduler Status / " UBYTE DSCHED_StVerb 1 100 0.00 238.000000000 FORMAT "%13.9" ECU_ADDRESS 0x6000AA3E /end MEASUREMENT
/begin MEASUREMENT DSCHED_St.FID_AFRA "Scheduler Status / Scheduler status of function identifier FID_AFRA" UBYTE DSCHED_StVerb 1 100 0.00 238.000000000 FORMAT "%13.9" ECU_ADDRESS 0x6000AA3F /end MEASUREMENT
/begin MEASUREMENT DSCHED_St.FID_AORA "Scheduler Status / Scheduler status of function identifier FID_AORA" UBYTE DSCHED_StVerb 1 100 0.00 238.000000000 FORMAT "%13.9" ECU_ADDRESS 0x6000AA40 /end MEASUREMENT
/begin MEASUREMENT DSCHED_St.FID_ATEH "Scheduler Status / Scheduler status of function identifier FID_ATEH" UBYTE DSCHED_StVerb 1 100 0.00 238.000000000 FORMAT "%13.9" ECU_ADDRESS 0x6000AA41 /end MEASUREMENT
/begin MEASUREMENT DSCHED_St.FID_ATEL "Scheduler Status / Scheduler status of function identifier FID_ATEL" UBYTE DSCHED_StVerb 1 100 0.00 238.000000000 FORMAT "%13.9" ECU_ADDRESS 0x6000AA42 /end MEASUREMENT
/begin MEASUREMENT DSCHED_St.FID_ATEN "Scheduler Status / Scheduler status of function identifier FID_ATEN" UBYTE DSCHED_StVerb 1 100 0.00 238.000000000 FORMAT "%13.9" ECU_ADDRESS 0x6000AA43 /end MEASUREMENT
/begin MEASUREMENT DSCHED_St.FId_EGSDCmnSeg1B1Parl "Scheduler Status / Scheduler status of function identifier FId_EGSDCmnSeg1B1Parl" UBYTE DSCHED_StVerb 1 100 0.00 238.000000000 FORMAT "%13.9" ECU_ADDRESS 0x6000AA44 /end MEASUREMENT
/begin MEASUREMENT DSCHED_St.FID_BLLRH "Scheduler Status / Scheduler status of function identifier FID_BLLRH" UBYTE DSCHED_StVerb 1 100 0.00 238.000000000 FORMAT "%13.9" ECU_ADDRESS 0x6000AA45 /end MEASUREMENT
/begin MEASUREMENT DSCHED_St.FID_BLLRKH "Scheduler Status / Scheduler status of function identifier FID_BLLRKH" UBYTE DSCHED_StVerb 1 100 0.00 238.000000000 FORMAT "%13.9" ECU_ADDRESS 0x6000AA46 /end MEASUREMENT
/begin MEASUREMENT DSCHED_St.FID_BPLSU "Scheduler Status / Scheduler status of function identifier FID_BPLSU" UBYTE DSCHED_StVerb 1 100 0.00 238.000000000 FORMAT "%13.9" ECU_ADDRESS 0x6000AA47 /end MEASUREMENT
/begin MEASUREMENT DSCHED_St.FId_CJ135RvsChrgMeasS1B1 "Scheduler Status / Scheduler status of function identifier FId_CJ135RvsChrgMeasS1B1" UBYTE DSCHED_StVerb 1 100 0.00 238.000000000 FORMAT "%13.9" ECU_ADDRESS 0x6000AA48 /end MEASUREMENT
/begin MEASUREMENT DSCHED_St.FId_CatHeatgColdStrtReq "Scheduler Status / Scheduler status of function identifier FId_CatHeatgColdStrtReq" UBYTE DSCHED_StVerb 1 100 0.00 238.000000000 FORMAT "%13.9" ECU_ADDRESS 0x6000AA49 /end MEASUREMENT
/begin MEASUREMENT DSCHED_St.FId_CatHeatgWrmReq "Scheduler Status / Scheduler status of function identifier FId_CatHeatgWrmReq" UBYTE DSCHED_StVerb 1 100 0.00 238.000000000 FORMAT "%13.9" ECU_ADDRESS 0x6000AA4A /end MEASUREMENT
/begin MEASUREMENT DSCHED_St.FId_EGSDO2SnsrMntdRelsS1B1 "Scheduler Status / Scheduler status of function identifier FId_EGSDO2SnsrMntdRelsS1B1" UBYTE DSCHED_StVerb 1 100 0.00 238.000000000 FORMAT "%13.9" ECU_ADDRESS 0x6000AA4B /end MEASUREMENT
/begin MEASUREMENT DSCHED_St.FId_EGSDO2_LamOffsFastS1B1 "Scheduler Status / Scheduler status of function identifier FId_EGSDO2_LamOffsFastS1B1" UBYTE DSCHED_StVerb 1 100 0.00 238.000000000 FORMAT "%13.9" ECU_ADDRESS 0x6000AA4C /end MEASUREMENT
/begin MEASUREMENT DSCHED_St.FId_MisfDetDnAdpnNv "Scheduler Status / Scheduler status of function identifier FId_MisfDetDnAdpnNv" UBYTE DSCHED_StVerb 1 100 0.00 238.000000000 FORMAT "%13.9" ECU_ADDRESS 0x6000AA4D /end MEASUREMENT
/begin MEASUREMENT DSCHED_VirtSt.FId_Unused "Scheduler Virtual Status / " UBYTE DSCHED_VirtStVerb 1 100 0.00 200.000000000 FORMAT "%13.9" ECU_ADDRESS 0x6000AA2E /end MEASUREMENT
/begin MEASUREMENT DSCHED_VirtSt.FID_AFRA "Scheduler Virtual Status / Scheduler virtual status of function identifier FID_AFRA" UBYTE DSCHED_VirtStVerb 1 100 0.00 200.000000000 FORMAT "%13.9" ECU_ADDRESS 0x6000AA2F /end MEASUREMENT
/begin MEASUREMENT DSCHED_VirtSt.FID_AORA "Scheduler Virtual Status / Scheduler virtual status of function identifier FID_AORA" UBYTE DSCHED_VirtStVerb 1 100 0.00 200.000000000 FORMAT "%13.9" ECU_ADDRESS 0x6000AA30 /end MEASUREMENT
/begin MEASUREMENT DSCHED_VirtSt.FID_ATEH "Scheduler Virtual Status / Scheduler virtual status of function identifier FID_ATEH" UBYTE DSCHED_VirtStVerb 1 100 0.00 200.000000000 FORMAT "%13.9" ECU_ADDRESS 0x6000AA31 /end MEASUREMENT
/begin MEASUREMENT DSCHED_VirtSt.FID_ATEL "Scheduler Virtual Status / Scheduler virtual status of function identifier FID_ATEL" UBYTE DSCHED_VirtStVerb 1 100 0.00 200.000000000 FORMAT "%13.9" ECU_ADDRESS 0x6000AA32 /end MEASUREMENT
/begin MEASUREMENT DSCHED_VirtSt.FID_ATEN "Scheduler Virtual Status / Scheduler virtual status of function identifier FID_ATEN" UBYTE DSCHED_VirtStVerb 1 100 0.00 200.000000000 FORMAT "%13.9" ECU_ADDRESS 0x6000AA33 /end MEASUREMENT
/begin MEASUREMENT DSCHED_VirtSt.FId_EGSDCmnSeg1B1Parl "Scheduler Virtual Status / Scheduler virtual status of function identifier FId_EGSDCmnSeg1B1Parl" UBYTE DSCHED_VirtStVerb 1 100 0.00 200.000000000 FORMAT "%13.9" ECU_ADDRESS 0x6000AA34 /end MEASUREMENT
/begin MEASUREMENT DSCHED_VirtSt.FID_BLLRH "Scheduler Virtual Status / Scheduler virtual status of function identifier FID_BLLRH" UBYTE DSCHED_VirtStVerb 1 100 0.00 200.000000000 FORMAT "%13.9" ECU_ADDRESS 0x6000AA35 /end MEASUREMENT
/begin MEASUREMENT DSCHED_VirtSt.FID_BLLRKH "Scheduler Virtual Status / Scheduler virtual status of function identifier FID_BLLRKH" UBYTE DSCHED_VirtStVerb 1 100 0.00 200.000000000 FORMAT "%13.9" ECU_ADDRESS 0x6000AA36 /end MEASUREMENT
/begin MEASUREMENT DSCHED_VirtSt.FID_BPLSU "Scheduler Virtual Status / Scheduler virtual status of function identifier FID_BPLSU" UBYTE DSCHED_VirtStVerb 1 100 0.00 200.000000000 FORMAT "%13.9" ECU_ADDRESS 0x6000AA37 /end MEASUREMENT
/begin MEASUREMENT DSCHED_VirtSt.FId_CJ135RvsChrgMeasS1B1 "Scheduler Virtual Status / Scheduler virtual status of function identifier FId_CJ135RvsChrgMeasS1B1" UBYTE DSCHED_VirtStVerb 1 100 0.00 200.000000000 FORMAT "%13.9" ECU_ADDRESS 0x6000AA38 /end MEASUREMENT
/begin MEASUREMENT DSCHED_VirtSt.FId_CatHeatgColdStrtReq "Scheduler Virtual Status / Scheduler virtual status of function identifier FId_CatHeatgColdStrtReq" UBYTE DSCHED_VirtStVerb 1 100 0.00 200.000000000 FORMAT "%13.9" ECU_ADDRESS 0x6000AA39 /end MEASUREMENT
/begin MEASUREMENT DSCHED_VirtSt.FId_CatHeatgWrmReq "Scheduler Virtual Status / Scheduler virtual status of function identifier FId_CatHeatgWrmReq" UBYTE DSCHED_VirtStVerb 1 100 0.00 200.000000000 FORMAT "%13.9" ECU_ADDRESS 0x6000AA3A /end MEASUREMENT
/begin MEASUREMENT DSCHED_VirtSt.FId_EGSDO2SnsrMntdRelsS1B1 "Scheduler Virtual Status / Scheduler virtual status of function identifier FId_EGSDO2SnsrMntdRelsS1B1" UBYTE DSCHED_VirtStVerb 1 100 0.00 200.000000000 FORMAT "%13.9" ECU_ADDRESS 0x6000AA3B /end MEASUREMENT
/begin MEASUREMENT DSCHED_VirtSt.FId_EGSDO2_LamOffsFastS1B1 "Scheduler Virtual Status / Scheduler virtual status of function identifier FId_EGSDO2_LamOffsFastS1B1" UBYTE DSCHED_VirtStVerb 1 100 0.00 200.000000000 FORMAT "%13.9" ECU_ADDRESS 0x6000AA3C /end MEASUREMENT
/begin MEASUREMENT DSCHED_VirtSt.FId_MisfDetDnAdpnNv "Scheduler Virtual Status / Scheduler virtual status of function identifier FId_MisfDetDnAdpnNv" UBYTE DSCHED_VirtStVerb 1 100 0.00 200.000000000 FORMAT "%13.9" ECU_ADDRESS 0x6000AA3D /end MEASUREMENT
/begin MEASUREMENT DSCHED_WhyExcl.FId_Unused "exclusion reason / " UWORD DSCHED_FIdExcCauseVerb 1 100 0.00 255.000000000 FORMAT "%13.9" ECU_ADDRESS 0x50005888 /end MEASUREMENT
/begin MEASUREMENT DSCHED_WhyExcl.FID_AFRA "exclusion reason / Exclusion cause of scheduled function identifier FID_AFRA" UWORD DSCHED_FIdExcCauseVerb 1 100 0.00 255.000000000 FORMAT "%13.9" ECU_ADDRESS 0x5000588A /end MEASUREMENT
/begin MEASUREMENT DSCHED_WhyExcl.FID_AORA "exclusion reason / Exclusion cause of scheduled function identifier FID_AORA" UWORD DSCHED_FIdExcCauseVerb 1 100 0.00 255.000000000 FORMAT "%13.9" ECU_ADDRESS 0x5000588C /end MEASUREMENT
/begin MEASUREMENT DSCHED_WhyExcl.FID_ATEH "exclusion reason / Exclusion cause of scheduled function identifier FID_ATEH" UWORD DSCHED_FIdExcCauseVerb 1 100 0.00 255.000000000 FORMAT "%13.9" ECU_ADDRESS 0x5000588E /end MEASUREMENT
/begin MEASUREMENT DSCHED_WhyExcl.FID_ATEL "exclusion reason / Exclusion cause of scheduled function identifier FID_ATEL" UWORD DSCHED_FIdExcCauseVerb 1 100 0.00 255.000000000 FORMAT "%13.9" ECU_ADDRESS 0x50005890 /end MEASUREMENT
/begin MEASUREMENT DSCHED_WhyExcl.FID_ATEN "exclusion reason / Exclusion cause of scheduled function identifier FID_ATEN" UWORD DSCHED_FIdExcCauseVerb 1 100 0.00 255.000000000 FORMAT "%13.9" ECU_ADDRESS 0x50005892 /end MEASUREMENT
/begin MEASUREMENT DSCHED_WhyExcl.FId_EGSDCmnSeg1B1Parl "exclusion reason / Exclusion cause of scheduled function identifier FId_EGSDCmnSeg1B1Parl" UWORD DSCHED_FIdExcCauseVerb 1 100 0.00 255.000000000 FORMAT "%13.9" ECU_ADDRESS 0x50005894 /end MEASUREMENT
/begin MEASUREMENT DSCHED_WhyExcl.FID_BLLRH "exclusion reason / Exclusion cause of scheduled function identifier FID_BLLRH" UWORD DSCHED_FIdExcCauseVerb 1 100 0.00 255.000000000 FORMAT "%13.9" ECU_ADDRESS 0x50005896 /end MEASUREMENT
/begin MEASUREMENT DSCHED_WhyExcl.FID_BLLRKH "exclusion reason / Exclusion cause of scheduled function identifier FID_BLLRKH" UWORD DSCHED_FIdExcCauseVerb 1 100 0.00 255.000000000 FORMAT "%13.9" ECU_ADDRESS 0x50005898 /end MEASUREMENT
/begin MEASUREMENT DSCHED_WhyExcl.FID_BPLSU "exclusion reason / Exclusion cause of scheduled function identifier FID_BPLSU" UWORD DSCHED_FIdExcCauseVerb 1 100 0.00 255.000000000 FORMAT "%13.9" ECU_ADDRESS 0x5000589A /end MEASUREMENT
/begin MEASUREMENT DSCHED_WhyExcl.FId_CJ135RvsChrgMeasS1B1 "exclusion reason / Exclusion cause of scheduled function identifier FId_CJ135RvsChrgMeasS1B1" UWORD DSCHED_FIdExcCauseVerb 1 100 0.00 255.000000000 FORMAT "%13.9" ECU_ADDRESS 0x5000589C /end MEASUREMENT
/begin MEASUREMENT DSCHED_WhyExcl.FId_CatHeatgColdStrtReq "exclusion reason / Exclusion cause of scheduled function identifier FId_CatHeatgColdStrtReq" UWORD DSCHED_FIdExcCauseVerb 1 100 0.00 255.000000000 FORMAT "%13.9" ECU_ADDRESS 0x5000589E /end MEASUREMENT
/begin MEASUREMENT DSCHED_WhyExcl.FId_CatHeatgWrmReq "exclusion reason / Exclusion cause of scheduled function identifier FId_CatHeatgWrmReq" UWORD DSCHED_FIdExcCauseVerb 1 100 0.00 255.000000000 FORMAT "%13.9" ECU_ADDRESS 0x500058A0 /end MEASUREMENT
/begin MEASUREMENT DSCHED_WhyExcl.FId_EGSDO2SnsrMntdRelsS1B1 "exclusion reason / Exclusion cause of scheduled function identifier FId_EGSDO2SnsrMntdRelsS1B1" UWORD DSCHED_FIdExcCauseVerb 1 100 0.00 255.000000000 FORMAT "%13.9" ECU_ADDRESS 0x500058A2 /end MEASUREMENT
/begin MEASUREMENT DSCHED_WhyExcl.FId_EGSDO2_LamOffsFastS1B1 "exclusion reason / Exclusion cause of scheduled function identifier FId_EGSDO2_LamOffsFastS1B1" UWORD DSCHED_FIdExcCauseVerb 1 100 0.00 255.000000000 FORMAT "%13.9" ECU_ADDRESS 0x500058A4 /end MEASUREMENT
/begin MEASUREMENT DSCHED_WhyExcl.FId_MisfDetDnAdpnNv "exclusion reason / Exclusion cause of scheduled function identifier FId_MisfDetDnAdpnNv" UWORD DSCHED_FIdExcCauseVerb 1 100 0.00 255.000000000 FORMAT "%13.9" ECU_ADDRESS 0x500058A6 /end MEASUREMENT
/begin MEASUREMENT DSCHED_WhyVirtExcl.FId_Unused "exclusion reason regarding virtual scheduling / " UWORD DSCHED_FIdExcCauseVerb 1 100 0.00 255.000000000 FORMAT "%13.9" ECU_ADDRESS 0x600054A8 /end MEASUREMENT
/begin MEASUREMENT DSCHED_WhyVirtExcl.FID_AFRA "exclusion reason regarding virtual scheduling / exclusion cause of scheduled function identifier regarding virtual scheduling FID_AFRA" UWORD DSCHED_FIdExcCauseVerb 1 100 0.00 255.000000000 FORMAT "%13.9" ECU_ADDRESS 0x600054AA /end MEASUREMENT
/begin MEASUREMENT DSCHED_WhyVirtExcl.FID_AORA "exclusion reason regarding virtual scheduling / exclusion cause of scheduled function identifier regarding virtual scheduling FID_AORA" UWORD DSCHED_FIdExcCauseVerb 1 100 0.00 255.000000000 FORMAT "%13.9" ECU_ADDRESS 0x600054AC /end MEASUREMENT
/begin MEASUREMENT DSCHED_WhyVirtExcl.FID_ATEH "exclusion reason regarding virtual scheduling / exclusion cause of scheduled function identifier regarding virtual scheduling FID_ATEH" UWORD DSCHED_FIdExcCauseVerb 1 100 0.00 255.000000000 FORMAT "%13.9" ECU_ADDRESS 0x600054AE /end MEASUREMENT
/begin MEASUREMENT DSCHED_WhyVirtExcl.FID_ATEL "exclusion reason regarding virtual scheduling / exclusion cause of scheduled function identifier regarding virtual scheduling FID_ATEL" UWORD DSCHED_FIdExcCauseVerb 1 100 0.00 255.000000000 FORMAT "%13.9" ECU_ADDRESS 0x600054B0 /end MEASUREMENT
/begin MEASUREMENT DSCHED_WhyVirtExcl.FID_ATEN "exclusion reason regarding virtual scheduling / exclusion cause of scheduled function identifier regarding virtual scheduling FID_ATEN" UWORD DSCHED_FIdExcCauseVerb 1 100 0.00 255.000000000 FORMAT "%13.9" ECU_ADDRESS 0x600054B2 /end MEASUREMENT
/begin MEASUREMENT DSCHED_WhyVirtExcl.FId_EGSDCmnSeg1B1Parl "exclusion reason regarding virtual scheduling / exclusion cause of scheduled function identifier regarding virtual scheduling FId_EGSDCmnSeg1B1Parl" UWORD DSCHED_FIdExcCauseVerb 1 100 0.00 255.000000000 FORMAT "%13.9" ECU_ADDRESS 0x600054B4 /end MEASUREMENT
/begin MEASUREMENT DSCHED_WhyVirtExcl.FID_BLLRH "exclusion reason regarding virtual scheduling / exclusion cause of scheduled function identifier regarding virtual scheduling FID_BLLRH" UWORD DSCHED_FIdExcCauseVerb 1 100 0.00 255.000000000 FORMAT "%13.9" ECU_ADDRESS 0x600054B6 /end MEASUREMENT
/begin MEASUREMENT DSCHED_WhyVirtExcl.FID_BLLRKH "exclusion reason regarding virtual scheduling / exclusion cause of scheduled function identifier regarding virtual scheduling FID_BLLRKH" UWORD DSCHED_FIdExcCauseVerb 1 100 0.00 255.000000000 FORMAT "%13.9" ECU_ADDRESS 0x600054B8 /end MEASUREMENT
/begin MEASUREMENT DSCHED_WhyVirtExcl.FID_BPLSU "exclusion reason regarding virtual scheduling / exclusion cause of scheduled function identifier regarding virtual scheduling FID_BPLSU" UWORD DSCHED_FIdExcCauseVerb 1 100 0.00 255.000000000 FORMAT "%13.9" ECU_ADDRESS 0x600054BA /end MEASUREMENT
/begin MEASUREMENT DSCHED_WhyVirtExcl.FId_CJ135RvsChrgMeasS1B1 "exclusion reason regarding virtual scheduling / exclusion cause of scheduled function identifier regarding virtual scheduling FId_CJ135RvsChrgMeasS1B1" UWORD DSCHED_FIdExcCauseVerb 1 100 0.00 255.000000000 FORMAT "%13.9" ECU_ADDRESS 0x600054BC /end MEASUREMENT
/begin MEASUREMENT DSCHED_WhyVirtExcl.FId_CatHeatgColdStrtReq "exclusion reason regarding virtual scheduling / exclusion cause of scheduled function identifier regarding virtual scheduling FId_CatHeatgColdStrtReq" UWORD DSCHED_FIdExcCauseVerb 1 100 0.00 255.000000000 FORMAT "%13.9" ECU_ADDRESS 0x600054BE /end MEASUREMENT
/begin MEASUREMENT DSCHED_WhyVirtExcl.FId_CatHeatgWrmReq "exclusion reason regarding virtual scheduling / exclusion cause of scheduled function identifier regarding virtual scheduling FId_CatHeatgWrmReq" UWORD DSCHED_FIdExcCauseVerb 1 100 0.00 255.000000000 FORMAT "%13.9" ECU_ADDRESS 0x600054C0 /end MEASUREMENT
/begin MEASUREMENT DSCHED_WhyVirtExcl.FId_EGSDO2SnsrMntdRelsS1B1 "exclusion reason regarding virtual scheduling / exclusion cause of scheduled function identifier regarding virtual scheduling FId_EGSDO2SnsrMntdRelsS1B1" UWORD DSCHED_FIdExcCauseVerb 1 100 0.00 255.000000000 FORMAT "%13.9" ECU_ADDRESS 0x600054C2 /end MEASUREMENT
/begin MEASUREMENT DSCHED_WhyVirtExcl.FId_EGSDO2_LamOffsFastS1B1 "exclusion reason regarding virtual scheduling / exclusion cause of scheduled function identifier regarding virtual scheduling FId_EGSDO2_LamOffsFastS1B1" UWORD DSCHED_FIdExcCauseVerb 1 100 0.00 255.000000000 FORMAT "%13.9" ECU_ADDRESS 0x600054C4 /end MEASUREMENT
/begin MEASUREMENT DSCHED_WhyVirtExcl.FId_MisfDetDnAdpnNv "exclusion reason regarding virtual scheduling / exclusion cause of scheduled function identifier regarding virtual scheduling FId_MisfDetDnAdpnNv" UWORD DSCHED_FIdExcCauseVerb 1 100 0.00 255.000000000 FORMAT "%13.9" ECU_ADDRESS 0x600054C6 /end MEASUREMENT
/begin MEASUREMENT DSMAUX_ctObdDCy "Number of OBD driving cycle since diagnostic trouble codes cleared" UWORD OneToOne 1 100 0.00 65535.00 FORMAT "%8.2" ECU_ADDRESS 0x600360DA /end MEASUREMENT
/begin MEASUREMENT DSMAUX_ctObdDCy_msg "Number of OBD driving cycle since diagnostic trouble codes cleared" UWORD OneToOne 1 100 0.00 65535.00 FORMAT "%8.2" ECU_ADDRESS 0x70002C32 /end MEASUREMENT
/begin MEASUREMENT DSMAUX_ctWUC "Number of warm-ups since diagnostic trouble codes cleared" UBYTE OneToOne 1 100 0.00 255.0 FORMAT "%5.1" ECU_ADDRESS 0x6003498E /end MEASUREMENT
/begin MEASUREMENT DSMAUX_ctWUC_msg "Number of warm-ups since diagnostic trouble codes cleared" UBYTE OneToOne 1 100 0.00 255.0 FORMAT "%5.1" ECU_ADDRESS 0x70002D81 /end MEASUREMENT
/begin MEASUREMENT DSMAUX_DTRG.DTRG_Time200ms "Trigger state / Trigger DTRG_Time200ms" UBYTE DFC_OneToOne 1 100 0.00 255.0 FORMAT "%5.1" ECU_ADDRESS 0x60035F30 /end MEASUREMENT
/begin MEASUREMENT DSMAUX_DTRG.DTRG_AlwaysTrue "Trigger state / Trigger DTRG_AlwaysTrue" UBYTE DFC_OneToOne 1 100 0.00 255.0 FORMAT "%5.1" ECU_ADDRESS 0x60035F31 /end MEASUREMENT
/begin MEASUREMENT DSMAUX_DTRG.DTRG_DrivingCycleFLC "Trigger state / Trigger DTRG_DrivingCycleFLC" UBYTE DFC_OneToOne 1 100 0.00 255.0 FORMAT "%5.1" ECU_ADDRESS 0x60035F32 /end MEASUREMENT
/begin MEASUREMENT DSMAUX_DTRG.DTRG_DrivingCycleHLC "Trigger state / Trigger DTRG_DrivingCycleHLC" UBYTE DFC_OneToOne 1 100 0.00 255.0 FORMAT "%5.1" ECU_ADDRESS 0x60035F33 /end MEASUREMENT
/begin MEASUREMENT DSMAUX_DTRG.DTRG_MDCatHLC "Trigger state / Trigger DTRG_MDCatHLC" UBYTE DFC_OneToOne 1 100 0.00 255.0 FORMAT "%5.1" ECU_ADDRESS 0x60035F34 /end MEASUREMENT
/begin MEASUREMENT DSMAUX_DTRG.DTRG_MDEmiHLC "Trigger state / Trigger DTRG_MDEmiHLC" UBYTE DFC_OneToOne 1 100 0.00 255.0 FORMAT "%5.1" ECU_ADDRESS 0x60035F35 /end MEASUREMENT
/begin MEASUREMENT DSMAUX_DTRG.DTRG_MDEmiStrtHLC "Trigger state / Trigger DTRG_MDEmiStrtHLC" UBYTE DFC_OneToOne 1 100 0.00 255.0 FORMAT "%5.1" ECU_ADDRESS 0x60035F36 /end MEASUREMENT
/begin MEASUREMENT DSMAUX_DTRG.DTRG_MDFLC2 "Trigger state / Trigger DTRG_MDFLC2" UBYTE DFC_OneToOne 1 100 0.00 255.0 FORMAT "%5.1" ECU_ADDRESS 0x60035F37 /end MEASUREMENT
/begin MEASUREMENT DSMAUX_DTRG.DTRG_MDHLC2 "Trigger state / Trigger DTRG_MDHLC2" UBYTE DFC_OneToOne 1 100 0.00 255.0 FORMAT "%5.1" ECU_ADDRESS 0x60035F38 /end MEASUREMENT
/begin MEASUREMENT DSMAUX_DTRG.DTRG_NoTrigger "Trigger state / Trigger DTRG_NoTrigger" UBYTE DFC_OneToOne 1 100 0.00 255.0 FORMAT "%5.1" ECU_ADDRESS 0x60035F39 /end MEASUREMENT
/begin MEASUREMENT DSMAUX_DTRG.DTRG_SimilarCondHLC "Trigger state / Trigger DTRG_SimilarCondHLC" UBYTE DFC_OneToOne 1 100 0.00 255.0 FORMAT "%5.1" ECU_ADDRESS 0x60035F3A /end MEASUREMENT
/begin MEASUREMENT DSMAUX_DTRG.DTRG_WarmUpCycle "Trigger state / Trigger DTRG_WarmUpCycle" UBYTE DFC_OneToOne 1 100 0.00 255.0 FORMAT "%5.1" ECU_ADDRESS 0x60035F3B /end MEASUREMENT
/begin MEASUREMENT DSMAUX_stClrTaskFin "End flag for OS_DSM_Clear_Task run" UBYTE OneToOne 1 100 0.00 255.0 FORMAT "%5.1" ECU_ADDRESS 0x6000AA54 /end MEASUREMENT
/begin MEASUREMENT DSMAUX_stDCy "Status OBD driving cycle" UBYTE DSMAUX_stDCyVerb 1 100 0.00 3.00000000000 FORMAT "%13.11" ECU_ADDRESS 0x600360D8 /end MEASUREMENT
/begin MEASUREMENT DSMAUX_stDCy_msg "Status OBD driving cycle" UBYTE DSMAUX_stDCyVerb 1 100 0.00 3.00000000000 FORMAT "%13.11" ECU_ADDRESS 0x70002D82 /end MEASUREMENT
/begin MEASUREMENT DSMAUX_stDsmClrActv "Indicator of a running DSM clear procedure" UBYTE B_TRUE 1 100 0.00 1.00000000000 BIT_MASK 0x1 FORMAT "%13.11" ECU_ADDRESS 0x6000E409 /end MEASUREMENT
/begin MEASUREMENT DSMAUX_stObdDcycCmpl "Status of complete conditions for the OBD Driving Cycle reached." UBYTE B_TRUE 1 100 0.00 1.00000000000 BIT_MASK 0x1 FORMAT "%13.11" ECU_ADDRESS 0x6000A803 /end MEASUREMENT
/begin MEASUREMENT DSMAUX_stStrtEnd "Condition normal engine operation was attained" UBYTE OneToOne 1 100 0.00 255.0 BIT_MASK 0x1 FORMAT "%5.1" ECU_ADDRESS 0x6000B1AB /end MEASUREMENT
/begin MEASUREMENT DSMAUX_stTranGlbJob "Current transition job" UBYTE OneToOne 1 100 0.00 255.0 FORMAT "%5.1" ECU_ADDRESS 0x6000AA55 /end MEASUREMENT
/begin MEASUREMENT DSMAUX_stTranReq "Queue of transition request" UBYTE OneToOne 1 100 0.00 255.0 FORMAT "%5.1" ARRAY_SIZE 3 ECU_ADDRESS 0x60034088 /end MEASUREMENT
/begin MEASUREMENT DSMAUX_stWrmUpCycCmpl "Status of complete conditions for the Warm Up Cycle reached." UBYTE B_TRUE 1 100 0.00 1.00000000000 BIT_MASK 0x1 FORMAT "%13.11" ECU_ADDRESS 0x6000A802 /end MEASUREMENT
/begin MEASUREMENT DSMAUX_tClntStrt "coolant temperature at start" SWORD Temp_Cels 1 100 -3549.940 3003.560 FORMAT "%8.3" ECU_ADDRESS 0x60005698 /end MEASUREMENT
/begin MEASUREMENT DSMDur_ctGlb "Global duration counters (32 bit values)" ULONG DFES_OneToOne 1 100 0.00 4294967295.00 FORMAT "%13.2" ARRAY_SIZE 1 ECU_ADDRESS 0x600360E0 /end MEASUREMENT
/begin MEASUREMENT DSMDur_ctPID21h "counter for distance travelled while MIL is activated" ULONG DSMDUR_10m_Counter 1 100 0.00 42949672.9500 FORMAT "%13.4" ECU_ADDRESS 0x60034978 /end MEASUREMENT
/begin MEASUREMENT DSMDur_ctPID31h "counter for distance since diagnostic trouble codes cleared" ULONG DSMDUR_10m_Counter 1 100 0.00 42949672.9500 FORMAT "%13.4" ECU_ADDRESS 0x60034974 /end MEASUREMENT
/begin MEASUREMENT DSMDur_lRef "distance when the next DSMDur increment will be counted" SLONG OneToOne 1 100 -2147483648.00 2147483647.00 FORMAT "%13.2" ECU_ADDRESS 0x60002A18 /end MEASUREMENT
/begin MEASUREMENT DSMDur_lRef10m "distance where next 10m increment will be counted" SLONG OneToOne 1 100 -2147483648.00 2147483647.00 FORMAT "%13.2" ECU_ADDRESS 0x50002844 /end MEASUREMENT
/begin MEASUREMENT DSMDur_stGlb "Global duration counter states" UBYTE DSMDur_StDispl_Verb 1 100 0.00 2.00000000000 FORMAT "%13.11" ARRAY_SIZE 1 ECU_ADDRESS 0x600360DD /end MEASUREMENT
/begin MEASUREMENT DSMDur_stPID21h "state of the counter for distance travelled while MIL is activated" UBYTE DSMDur_StDispl_Verb 1 100 0.00 2.00000000000 FORMAT "%13.11" ECU_ADDRESS 0x600360DC /end MEASUREMENT
/begin MEASUREMENT DSMDur_stWUCLst "warm up cycle reached" UBYTE OneToOne 1 100 0.00 255.0 FORMAT "%5.1" ECU_ADDRESS 0x6003408B /end MEASUREMENT
/begin MEASUREMENT DSMDur_tiRef "time when next DSMDur increment will be counted" SLONG OneToOne 1 100 -2147483648.00 2147483647.00 FORMAT "%13.2" ECU_ADDRESS 0x50002848 /end MEASUREMENT
/begin MEASUREMENT DSMRdy_stGrpRdy "Readiness calculation, ready status" UWORD DSMRdy_OneToOne 1 100 0.00 65535.00 FORMAT "%8.2" ECU_ADDRESS 0x600360EC /end MEASUREMENT
/begin MEASUREMENT DSMRdy_stGrpRdyDFES "Readiness calculation, ready status from DFES status" UWORD DSMRdy_OneToOne 1 100 0.00 65535.00 FORMAT "%8.2" ECU_ADDRESS 0x600054EE /end MEASUREMENT
/begin MEASUREMENT DSMRdy_stGrpRdyScan "Readiness calculation, ready status from check scanning" UWORD DSMRdy_OneToOne 1 100 0.00 65535.00 FORMAT "%8.2" ECU_ADDRESS 0x600054F0 /end MEASUREMENT
/begin MEASUREMENT DSMRdy_stGrpSup "Readiness calculation, supported status" UWORD DSMRdy_OneToOne 1 100 0.00 65535.00 FORMAT "%8.2" ECU_ADDRESS 0x600054EC /end MEASUREMENT
/begin MEASUREMENT DSMRdy_xPId1 "Readiness calculation, result for PID01" ULONG DSMRdy_OneToOne 1 100 0.00 4294967295.00 FORMAT "%13.2" ECU_ADDRESS 0x600017C4 /end MEASUREMENT
/begin MEASUREMENT DSM_stPostDrive "Status of DSM postdrive control" UBYTE OneToOne 1 100 0.00 255.0 FORMAT "%5.1" ECU_ADDRESS 0x6000AA53 /end MEASUREMENT
/begin MEASUREMENT DSM_stReInit "Status of reinitialization in DSM after cancelled postdrive" UBYTE OneToOne 1 100 0.00 255.0 FORMAT "%5.1" ECU_ADDRESS 0x6000B1AF /end MEASUREMENT
/begin MEASUREMENT DSM_TripChgAndClrFinshd "Message to indicate completion of clear triggered by DSM after initialization" UBYTE OneToOne 1 100 0.00 255.0 BIT_MASK 0x1 FORMAT "%5.1" ECU_ADDRESS 0x6000A7FF /end MEASUREMENT
/begin MEASUREMENT DSM_TripChgFinshd "Trip change of DSM (Diagnostic System Management) finished" UBYTE OneToOne 1 100 0.00 255.0 BIT_MASK 0x1 FORMAT "%5.1" ECU_ADDRESS 0x50005D77 /end MEASUREMENT
/begin FUNCTION DSCHED_Eval "30000.13.0Diagnostic Scheduler Evaluation"
 /begin DEF_CHARACTERISTIC DSCHED_Excl.AFRA_AORA_C DSCHED_Excl.AFRA_ATEH_C DSCHED_Excl.AFRA_ATEL_C DSCHED_Excl.AFRA_ATEN_C DSCHED_Excl.AFRA_EGSDCmnSeg1B1Parl_C DSCHED_Excl.AFRA_BLLRH_C DSCHED_Excl.AFRA_BLLRKH_C DSCHED_Excl.AFRA_BPLSU_C DSCHED_Excl.AFRA_CJ135RvsChrgMeasS1B1_C DSCHED_Excl.AFRA_CatHeatgColdStrtReq_C DSCHED_Excl.AFRA_CatHeatgWrmReq_C DSCHED_Excl.AFRA_EGSDO2SnsrMntdRelsS1B1_C DSCHED_Excl.AFRA_EGSDO2_LamOffsFastS1B1_C DSCHED_Excl.AFRA_MisfDetDnAdpnNv_C DSCHED_Excl.AORA_ATEH_C DSCHED_Excl.AORA_ATEL_C DSCHED_Excl.AORA_ATEN_C DSCHED_Excl.AORA_EGSDCmnSeg1B1Parl_C DSCHED_Excl.AORA_BLLRH_C DSCHED_Excl.AORA_BLLRKH_C DSCHED_Excl.AORA_BPLSU_C DSCHED_Excl.AORA_CJ135RvsChrgMeasS1B1_C DSCHED_Excl.AORA_CatHeatgColdStrtReq_C DSCHED_Excl.AORA_CatHeatgWrmReq_C DSCHED_Excl.AORA_EGSDO2SnsrMntdRelsS1B1_C DSCHED_Excl.AORA_EGSDO2_LamOffsFastS1B1_C DSCHED_Excl.AORA_MisfDetDnAdpnNv_C DSCHED_Excl.ATEH_ATEL_C DSCHED_Excl.ATEH_ATEN_C DSCHED_Excl.ATEH_EGSDCmnSeg1B1Parl_C DSCHED_Excl.ATEH_BLLRH_C DSCHED_Excl.ATEH_BLLRKH_C DSCHED_Excl.ATEH_BPLSU_C DSCHED_Excl.ATEH_CJ135RvsChrgMeasS1B1_C DSCHED_Excl.ATEH_CatHeatgColdStrtReq_C DSCHED_Excl.ATEH_CatHeatgWrmReq_C DSCHED_Excl.ATEH_EGSDO2SnsrMntdRelsS1B1_C DSCHED_Excl.ATEH_EGSDO2_LamOffsFastS1B1_C DSCHED_Excl.ATEH_MisfDetDnAdpnNv_C DSCHED_Excl.ATEL_ATEN_C DSCHED_Excl.ATEL_EGSDCmnSeg1B1Parl_C DSCHED_Excl.ATEL_BLLRH_C DSCHED_Excl.ATEL_BLLRKH_C DSCHED_Excl.ATEL_BPLSU_C DSCHED_Excl.ATEL_CJ135RvsChrgMeasS1B1_C DSCHED_Excl.ATEL_CatHeatgColdStrtReq_C DSCHED_Excl.ATEL_CatHeatgWrmReq_C DSCHED_Excl.ATEL_EGSDO2SnsrMntdRelsS1B1_C DSCHED_Excl.ATEL_EGSDO2_LamOffsFastS1B1_C DSCHED_Excl.ATEL_MisfDetDnAdpnNv_C DSCHED_Excl.ATEN_EGSDCmnSeg1B1Parl_C DSCHED_Excl.ATEN_BLLRH_C DSCHED_Excl.ATEN_BLLRKH_C DSCHED_Excl.ATEN_BPLSU_C DSCHED_Excl.ATEN_CJ135RvsChrgMeasS1B1_C DSCHED_Excl.ATEN_CatHeatgColdStrtReq_C DSCHED_Excl.ATEN_CatHeatgWrmReq_C DSCHED_Excl.ATEN_EGSDO2SnsrMntdRelsS1B1_C DSCHED_Excl.ATEN_EGSDO2_LamOffsFastS1B1_C DSCHED_Excl.ATEN_MisfDetDnAdpnNv_C DSCHED_Excl.EGSDCmnSeg1B1Parl_BLLRH_C DSCHED_Excl.EGSDCmnSeg1B1Parl_BLLRKH_C DSCHED_Excl.EGSDCmnSeg1B1Parl_BPLSU_C DSCHED_Excl.EGSDCmnSeg1B1Parl_CJ135RvsChrgMeasS1B1_C DSCHED_Excl.EGSDCmnSeg1B1Parl_CatHeatgColdStrtReq_C DSCHED_Excl.EGSDCmnSeg1B1Parl_CatHeatgWrmReq_C DSCHED_Excl.EGSDCmnSeg1B1Parl_EGSDO2SnsrMntdRelsS1B1_C DSCHED_Excl.EGSDCmnSeg1B1Parl_EGSDO2_LamOffsFastS1B1_C DSCHED_Excl.EGSDCmnSeg1B1Parl_MisfDetDnAdpnNv_C DSCHED_Excl.BLLRH_BLLRKH_C DSCHED_Excl.BLLRH_BPLSU_C DSCHED_Excl.BLLRH_CJ135RvsChrgMeasS1B1_C DSCHED_Excl.BLLRH_CatHeatgColdStrtReq_C DSCHED_Excl.BLLRH_CatHeatgWrmReq_C DSCHED_Excl.BLLRH_EGSDO2SnsrMntdRelsS1B1_C DSCHED_Excl.BLLRH_EGSDO2_LamOffsFastS1B1_C DSCHED_Excl.BLLRH_MisfDetDnAdpnNv_C DSCHED_Excl.BLLRKH_BPLSU_C DSCHED_Excl.BLLRKH_CJ135RvsChrgMeasS1B1_C DSCHED_Excl.BLLRKH_CatHeatgColdStrtReq_C DSCHED_Excl.BLLRKH_CatHeatgWrmReq_C DSCHED_Excl.BLLRKH_EGSDO2SnsrMntdRelsS1B1_C DSCHED_Excl.BLLRKH_EGSDO2_LamOffsFastS1B1_C DSCHED_Excl.BLLRKH_MisfDetDnAdpnNv_C DSCHED_Excl.BPLSU_CJ135RvsChrgMeasS1B1_C DSCHED_Excl.BPLSU_CatHeatgColdStrtReq_C DSCHED_Excl.BPLSU_CatHeatgWrmReq_C DSCHED_Excl.BPLSU_EGSDO2SnsrMntdRelsS1B1_C DSCHED_Excl.BPLSU_EGSDO2_LamOffsFastS1B1_C DSCHED_Excl.BPLSU_MisfDetDnAdpnNv_C DSCHED_Excl.CJ135RvsChrgMeasS1B1_CatHeatgColdStrtReq_C DSCHED_Excl.CJ135RvsChrgMeasS1B1_CatHeatgWrmReq_C DSCHED_Excl.CJ135RvsChrgMeasS1B1_EGSDO2SnsrMntdRelsS1B1_C DSCHED_Excl.CJ135RvsChrgMeasS1B1_EGSDO2_LamOffsFastS1B1_C DSCHED_Excl.CJ135RvsChrgMeasS1B1_MisfDetDnAdpnNv_C DSCHED_Excl.CatHeatgColdStrtReq_CatHeatgWrmReq_C DSCHED_Excl.CatHeatgColdStrtReq_EGSDO2SnsrMntdRelsS1B1_C DSCHED_Excl.CatHeatgColdStrtReq_EGSDO2_LamOffsFastS1B1_C DSCHED_Excl.CatHeatgColdStrtReq_MisfDetDnAdpnNv_C DSCHED_Excl.CatHeatgWrmReq_EGSDO2SnsrMntdRelsS1B1_C DSCHED_Excl.CatHeatgWrmReq_EGSDO2_LamOffsFastS1B1_C DSCHED_Excl.CatHeatgWrmReq_MisfDetDnAdpnNv_C DSCHED_Excl.EGSDO2SnsrMntdRelsS1B1_EGSDO2_LamOffsFastS1B1_C DSCHED_Excl.EGSDO2SnsrMntdRelsS1B1_MisfDetDnAdpnNv_C DSCHED_Excl.EGSDO2_LamOffsFastS1B1_MisfDetDnAdpnNv_C DSCHED_stMode_C DSCHED_StSimnSeln_C DSCHED_valDflOpMode_C /end DEF_CHARACTERISTIC
 /begin OUT_MEASUREMENT DSCHED_St.FId_Unused DSCHED_St.FID_AFRA DSCHED_St.FID_AORA DSCHED_St.FID_ATEH DSCHED_St.FID_ATEL DSCHED_St.FID_ATEN DSCHED_St.FId_EGSDCmnSeg1B1Parl DSCHED_St.FID_BLLRH DSCHED_St.FID_BLLRKH DSCHED_St.FID_BPLSU DSCHED_St.FId_CJ135RvsChrgMeasS1B1 DSCHED_St.FId_CatHeatgColdStrtReq DSCHED_St.FId_CatHeatgWrmReq DSCHED_St.FId_EGSDO2SnsrMntdRelsS1B1 DSCHED_St.FId_EGSDO2_LamOffsFastS1B1 DSCHED_St.FId_MisfDetDnAdpnNv DSCHED_VirtSt.FId_Unused DSCHED_VirtSt.FID_AFRA DSCHED_VirtSt.FID_AORA DSCHED_VirtSt.FID_ATEH DSCHED_VirtSt.FID_ATEL DSCHED_VirtSt.FID_ATEN DSCHED_VirtSt.FId_EGSDCmnSeg1B1Parl DSCHED_VirtSt.FID_BLLRH DSCHED_VirtSt.FID_BLLRKH DSCHED_VirtSt.FID_BPLSU DSCHED_VirtSt.FId_CJ135RvsChrgMeasS1B1 DSCHED_VirtSt.FId_CatHeatgColdStrtReq DSCHED_VirtSt.FId_CatHeatgWrmReq DSCHED_VirtSt.FId_EGSDO2SnsrMntdRelsS1B1 DSCHED_VirtSt.FId_EGSDO2_LamOffsFastS1B1 DSCHED_VirtSt.FId_MisfDetDnAdpnNv DSCHED_WhyExcl.FId_Unused DSCHED_WhyExcl.FID_AFRA DSCHED_WhyExcl.FID_AORA DSCHED_WhyExcl.FID_ATEH DSCHED_WhyExcl.FID_ATEL DSCHED_WhyExcl.FID_ATEN DSCHED_WhyExcl.FId_EGSDCmnSeg1B1Parl DSCHED_WhyExcl.FID_BLLRH DSCHED_WhyExcl.FID_BLLRKH DSCHED_WhyExcl.FID_BPLSU DSCHED_WhyExcl.FId_CJ135RvsChrgMeasS1B1 DSCHED_WhyExcl.FId_CatHeatgColdStrtReq DSCHED_WhyExcl.FId_CatHeatgWrmReq DSCHED_WhyExcl.FId_EGSDO2SnsrMntdRelsS1B1 DSCHED_WhyExcl.FId_EGSDO2_LamOffsFastS1B1 DSCHED_WhyExcl.FId_MisfDetDnAdpnNv DSCHED_WhyVirtExcl.FId_Unused DSCHED_WhyVirtExcl.FID_AFRA DSCHED_WhyVirtExcl.FID_AORA DSCHED_WhyVirtExcl.FID_ATEH DSCHED_WhyVirtExcl.FID_ATEL DSCHED_WhyVirtExcl.FID_ATEN DSCHED_WhyVirtExcl.FId_EGSDCmnSeg1B1Parl DSCHED_WhyVirtExcl.FID_BLLRH DSCHED_WhyVirtExcl.FID_BLLRKH DSCHED_WhyVirtExcl.FID_BPLSU DSCHED_WhyVirtExcl.FId_CJ135RvsChrgMeasS1B1 DSCHED_WhyVirtExcl.FId_CatHeatgColdStrtReq DSCHED_WhyVirtExcl.FId_CatHeatgWrmReq DSCHED_WhyVirtExcl.FId_EGSDO2SnsrMntdRelsS1B1 DSCHED_WhyVirtExcl.FId_EGSDO2_LamOffsFastS1B1 DSCHED_WhyVirtExcl.FId_MisfDetDnAdpnNv /end OUT_MEASUREMENT
 FUNCTION_VERSION "30000.13.0" /end FUNCTION
/begin FUNCTION DSELHFS "3.1.3     selection: diagnosis of main load sensor" /begin DEF_CHARACTERISTIC SF_LM /end DEF_CHARACTERISTIC
 /begin IN_MEASUREMENT B_psrgg_msg SyC_stSub ThrVlv_flgIrrvFuCutOffB1 ThrVlv_flgLimpModeB1 /end IN_MEASUREMENT
 /begin OUT_MEASUREMENT B_ehfs_msg B_fhfs_msg B_statas_msg /end OUT_MEASUREMENT
 FUNCTION_VERSION "3.1.3" /end FUNCTION
/begin FUNCTION DSM2AUTOSAR "30000.70.0AUTOSAR Layer to DSM"
 /begin IN_MEASUREMENT Dem_disableEventStatusUpdateGroup DFES_stErrLamp DFES_stOutstate DSMRdy_xPId1 /end IN_MEASUREMENT
 /begin LOC_MEASUREMENT Dem_BswErrorBufferWriteCounter Dem_BswErrorBufferWriteIndex Dem_PTOSt Dem_stInit /end LOC_MEASUREMENT
 FUNCTION_VERSION "30000.70.0" /end FUNCTION
/begin FUNCTION DSMAux "30000.53.0DSM Auxiliary"
 /begin DEF_CHARACTERISTIC DSMAUX_dtWUCMin_C DSMAUX_tWUCMin_C DSMAUX_xClearMode_C DSMAUX_xClearTrg_C /end DEF_CHARACTERISTIC
 /begin IN_MEASUREMENT SyC_stSub /end IN_MEASUREMENT
 /begin OUT_MEASUREMENT DSMAUX_ctObdDCy_msg DSMAUX_ctWUC DSMAUX_ctWUC_msg DSMAUX_DTRG.DTRG_Time200ms DSMAUX_DTRG.DTRG_AlwaysTrue DSMAUX_DTRG.DTRG_DrivingCycleFLC DSMAUX_DTRG.DTRG_DrivingCycleHLC DSMAUX_DTRG.DTRG_MDCatHLC DSMAUX_DTRG.DTRG_MDEmiHLC DSMAUX_DTRG.DTRG_MDEmiStrtHLC DSMAUX_DTRG.DTRG_MDFLC2 DSMAUX_DTRG.DTRG_MDHLC2 DSMAUX_DTRG.DTRG_NoTrigger DSMAUX_DTRG.DTRG_SimilarCondHLC DSMAUX_DTRG.DTRG_WarmUpCycle DSMAUX_stDCy DSMAUX_stDCy_msg DSMAUX_stDsmClrActv DSMAUX_stObdDcycCmpl DSMAUX_stWrmUpCycCmpl DSM_TripChgAndClrFinshd DSM_TripChgFinshd /end OUT_MEASUREMENT
 /begin LOC_MEASUREMENT DFC_idxDfcTrans DSMAUX_ctObdDCy DSMAUX_stClrTaskFin DSMAUX_stStrtEnd DSMAUX_stTranGlbJob DSMAUX_stTranReq DSMAUX_tClntStrt DSM_stPostDrive DSM_stReInit /end LOC_MEASUREMENT
 FUNCTION_VERSION "30000.53.0" /end FUNCTION
/begin FUNCTION DSMDur "30000.15.2DSM Duration Counters"
 /begin DEF_CHARACTERISTIC DSMDur_valEvntQntDist_C DSMDur_valEvntQntTi_C DSMDur_xEnaGlb_CA DSMDur_xRstGlb_CA DSMDur_xSelEvntGlb_CA /end DEF_CHARACTERISTIC
 /begin OUT_MEASUREMENT DSMDur_ctGlb DSMDur_ctPID21h DSMDur_ctPID31h DSMDur_stGlb /end OUT_MEASUREMENT
 /begin LOC_MEASUREMENT DSMDur_lRef DSMDur_lRef10m DSMDur_stPID21h DSMDur_stWUCLst DSMDur_tiRef /end LOC_MEASUREMENT
 FUNCTION_VERSION "30000.15.2" /end FUNCTION
/begin FUNCTION DSMRdy "30000.22.1DSM Readiness"
 /begin DEF_CHARACTERISTIC DSMRdy_Grp.FlSys_CA DSMRdy_Grp.Cat_CA DSMRdy_Grp.HtCat_CA DSMRdy_Grp.EvpSys_CA DSMRdy_Grp.SecAirSys_CA DSMRdy_Grp.O2Sens_CA DSMRdy_Grp.O2SensHt_CA DSMRdy_Grp.EGR_CA DSMRdy_X.PID1ForceLowMsk_C DSMRdy_X.PID1ForceHighMsk_C DSMRdy_X.PID41ForceLowMsk_C DSMRdy_X.PID41ForceHighMsk_C /end DEF_CHARACTERISTIC
 /begin OUT_MEASUREMENT DSMRdy_xPId1 /end OUT_MEASUREMENT
 /begin LOC_MEASUREMENT DSMRdy_stGrpRdy DSMRdy_stGrpRdyDFES DSMRdy_stGrpRdyScan DSMRdy_stGrpSup /end LOC_MEASUREMENT
 FUNCTION_VERSION "30000.22.1" /end FUNCTION
/begin COMPU_METHOD B_TRUE "" TAB_VERB "%6.3" "" COMPU_TAB_REF B_TRUE /end COMPU_METHOD
/begin COMPU_VTAB B_TRUE "" TAB_VERB 2 0 "FALSE" 1 "TRUE" /end COMPU_VTAB
/begin COMPU_METHOD DFC_OneToOne "" RAT_FUNC "%6.2" "-" COEFFS 0 1 0 0 0 1 /end COMPU_METHOD
/begin COMPU_METHOD DFC_Verb "" TAB_VERB "%6.3" "-" COMPU_TAB_REF DFC_Verb /end COMPU_METHOD
/begin COMPU_VTAB DFC_Verb "" TAB_VERB 704 0 "DFC_Unused" 318 "DFC_ACEvpTSRCMax" 319 "DFC_ACEvpTSRCMin" 320 "DFC_AirCClntPAnaSRCMax" 321 "DFC_AirCClntPAnaSRCMin" 259 "DFC_AirCCmprOL" 260 "DFC_AirCCmprOvrTemp" 261 "DFC_AirCCmprSCB" 262 "DFC_AirCCmprSCG" 322 "DFC_AirCSwtNpl" 323 "DFC_AirCSwtSig" 263 "DFC_AltErr" 1 "DFC_AltIOACGFailr" 2 "DFC_AltIOACGHiVltg" 3 "DFC_AltIOACGLoVltg" 4 "DFC_AltIOACGTHi" 5 "DFC_AltIODConnACG" 429 "DFC_AppAllSnsrDfct" 6 "DFC_BattUHiFailr" 7 "DFC_BattULoFailr" 264 "DFC_BattUSRCMax" 265 "DFC_BattUSRCMin" 430 "DFC_BattUStdbyDiaOL" 431 "DFC_BigLeakIntkMnfldEmiInfl" 324 "DFC_Brk" 8 "DFC_BrkBstPDriftHiErr" 9 "DFC_BrkBstPDriftLoErr" 10 "DFC_BrkBstPSnsrStuck" 11 "DFC_BrkMnSwtContOn" 432 "DFC_BrkMnSwtContOnWarnLmp" 12 "DFC_BrkMnSwtNotStp" 433 "DFC_BrkMnSwtNotStpWarnLmp" 13 "DFC_BrkNpl" 14 "DFC_BrkRdntSwtContOn" 434 "DFC_BrkRdntSwtContOnWarnLmp" 15 "DFC_BrkRdntSwtNotStp" 435 "DFC_BrkRdntSwtNotStpWarnLmp" 325 "DFC_BrkSig" 417 "DFC_BSWM_E_ACTION_FAILED" 418 "DFC_BSWM_E_INTRPTQUEUE_FULL" 393 "DFC_BusDiagCANAPPLBusOff" 394 "DFC_BusDiagCANCANCBusOff" 395 "DFC_BusDiagCANVEHICLEBusOff" 411 "DFC_CAN_E_TIMEOUT" 436 "DFC_CEngDsTColdStrtMax" 437 "DFC_CEngDsTColdStrtMin" 438 "DFC_CEngDsTImps" 439 "DFC_CEngDsTPlausLSC" 440 "DFC_CEngDsTPlausSTC" 443 "DFC_CEngDsTSig" 441 "DFC_CEngDsTSRCMax" 442 "DFC_CEngDsTSRCMin" 444 "DFC_CEngUsTSRCMax" 445 "DFC_CEngUsTSRCMin" 366 "DFC_Clth2ONStuck" 367 "DFC_Clth2ONStuckLdc" 16 "DFC_Clth3ONStuck" 368 "DFC_Clth3ONStuckLdc" 369 "DFC_Clth3ONStuckPostDrv" 17 "DFC_Clth4OFFStuck" 370 "DFC_Clth4ONStuck" 371 "DFC_Clth4ONStuckLdc" 236 "DFC_ClthMax" 336 "DFC_ClthNpl" 18 "DFC_ClthOFFStuck" 19 "DFC_ClthONStuck" 326 "DFC_ClthSig" 20 "DFC_ClthStkFailInfo" 21 "DFC_ComACFailInfo" 22 "DFC_ComATFTValErr" 23 "DFC_ComATMILReq" 24 "DFC_ComAYCAChksum" 25 "DFC_ComAYCARingCnt" 26 "DFC_ComAYCATOut" 27 "DFC_ComAYCDChkSum" 28 "DFC_ComAYCDTOut" 29 "DFC_ComAYCFChksum" 30 "DFC_ComAYCFRingCnt" 31 "DFC_ComAYCFTOut" 32 "DFC_ComAYCGChksum" 33 "DFC_ComAYCGRingCnt" 34 "DFC_ComAYCGTOut" 35 "DFC_ComAYCIChkSum" 36 "DFC_ComAYCIRingCnt" 37 "DFC_ComAYCITOut" 38 "DFC_ComBCM1ChkSum" 39 "DFC_ComBCM1RingCnt" 40 "DFC_ComBCM1TOut" 41 "DFC_ComCANABusOffErr" 42 "DFC_ComCANBBusOffErr" 43 "DFC_ComCANCBusOffErr" 44 "DFC_ComCGW1ChkSum" 45 "DFC_ComCGW1RingCnt" 46 "DFC_ComCGW1TOut" 266 "DFC_ComChksTCU1" 267 "DFC_ComChksTCU11" 268 "DFC_ComChksTCU12" 269 "DFC_ComChksTCU13" 270 "DFC_ComChksTCU2" 271 "DFC_ComChksTCU3" 272 "DFC_ComChksTCU4" 273 "DFC_ComCntTCU1" 274 "DFC_ComCntTCU11" 275 "DFC_ComCntTCU12" 276 "DFC_ComCntTCU13" 277 "DFC_ComCntTCU2" 278 "DFC_ComCntTCU3" 279 "DFC_ComCntTCU4" 47 "DFC_ComConvBoostErr" 48 "DFC_ComConvSlipErr" 372 "DFC_ComDLCTCU01" 373 "DFC_ComDLCTCU02" 374 "DFC_ComDLCTCU1" 375 "DFC_ComDLCTCU11" 376 "DFC_ComDLCTCU12" 377 "DFC_ComDLCTCU13" 378 "DFC_ComDLCTCU14" 379 "DFC_ComDLCTCU2" 380 "DFC_ComDLCTCU3" 381 "DFC_ComDLCTCU4" 49 "DFC_ComEAT10Chksum" 50 "DFC_ComEAT10RingCnt" 51 "DFC_ComEAT10TOut" 52 "DFC_ComEAT11ChkSum" 53 "DFC_ComEAT11RingCnt" 54 "DFC_ComEAT11TOut" 55 "DFC_ComEAT12ChkSum" 56 "DFC_ComEAT12RingCnt" 57 "DFC_ComEAT12TOut" 58 "DFC_ComEAT13ChkSum" 59 "DFC_ComEAT13RingCnt" 60 "DFC_ComEAT13TOut" 61 "DFC_ComEAT1Chksum" 62 "DFC_ComEAT1RingCnt" 63 "DFC_ComEAT1TOut" 64 "DFC_ComEAT2ChkSum" 65 "DFC_ComEAT2RingCnt" 66 "DFC_ComEAT2TOut" 67 "DFC_ComEAT4ChkSum" 68 "DFC_ComEAT4RingCnt" 69 "DFC_ComEAT4TOut" 70 "DFC_ComEAT6Chksum" 71 "DFC_ComEAT6RingCnt" 72 "DFC_ComEAT6TOut" 73 "DFC_ComEAT7Chksum" 74 "DFC_ComEAT7RingCnt" 75 "DFC_ComEAT7TOut" 76 "DFC_ComEAT8Chksum" 77 "DFC_ComEAT8RingCnt" 78 "DFC_ComEAT8TOut" 79 "DFC_ComEATAChksum" 80 "DFC_ComEATARingCnt" 81 "DFC_ComEATATOut" 82 "DFC_ComEATBChkSum" 83 "DFC_ComEATBRingCnt" 84 "DFC_ComEATBTOut" 85 "DFC_ComEATCChksum" 86 "DFC_ComEATCRingCnt" 87 "DFC_ComEATCTOut" 88 "DFC_ComEBBAChksum" 89 "DFC_ComEBBARingCnt" 90 "DFC_ComEBBATOut" 94 "DFC_ComEngCanRxErr" 91 "DFC_ComEPS1Chksum" 92 "DFC_ComEPS1RingCnt" 93 "DFC_ComEPS1TOut" 95 "DFC_ComGrvySnsrErr" 96 "DFC_ComGwIMG1ChkSum" 97 "DFC_ComGwIMG1RingCnt" 98 "DFC_ComGwIMG1TOut" 99 "DFC_ComGwIMG3ChkSum" 100 "DFC_ComGwIMG3RingCnt" 101 "DFC_ComGwIMG3TOut" 102 "DFC_ComGwIMG4ChkSum" 103 "DFC_ComGwIMG4RingCnt" 104 "DFC_ComGwIMG4TOut" 105 "DFC_ComGwIMG5ChkSum" 106 "DFC_ComGwIMG5RingCnt" 107 "DFC_ComGwIMG5TOut" 108 "DFC_ComGwIMG6ChkSum" 109 "DFC_ComGwIMG6RingCnt" 110 "DFC_ComGwIMG6TOut" 111 "DFC_ComIDASBChksum" 112 "DFC_ComIDASBRingCnt" 113 "DFC_ComIDASBTOut" 114 "DFC_ComIMGMILReq" 115 "DFC_ComISSPrms" 116 "DFC_ComMETAChksum" 117 "DFC_ComMETARingCnt" 118 "DFC_ComMETATOut" 119 "DFC_ComMETCChksum" 120 "DFC_ComMETCRingCnt" 121 "DFC_ComMETCTOut" 122 "DFC_ComMETDChksum" 123 "DFC_ComMETDRingCnt" 124 "DFC_ComMETDTOut" 125 "DFC_ComMETE2Chksum" 126 "DFC_ComMETE2RingCnt" 127 "DFC_ComMETE2TOut" 128 "DFC_ComMETFChksum" 129 "DFC_ComMETFRingCnt" 130 "DFC_ComMETFTOut" 131 "DFC_ComMETGChksum" 132 "DFC_ComMETGRingCnt" 133 "DFC_ComMETGTOut" 134 "DFC_ComMETH2Chksum" 135 "DFC_ComMETH2RingCnt" 136 "DFC_ComMETH2TOut" 137 "DFC_ComMETHChksum" 138 "DFC_ComMETHRingCnt" 139 "DFC_ComMETHTOut" 140 "DFC_ComMETIChksum" 141 "DFC_ComMETIRingCnt" 142 "DFC_ComMETITOut" 143 "DFC_ComMETKChksum" 144 "DFC_ComMETKRingCnt" 145 "DFC_ComMETKTOut" 146 "DFC_ComMETLChksum" 147 "DFC_ComMETLRingCnt" 148 "DFC_ComMETLTOut" 149 "DFC_ComMETMChksum" 150 "DFC_ComMETMRingCnt" 151 "DFC_ComMETMTOut" 152 "DFC_ComMETNChksum" 153 "DFC_ComMETNRingCnt" 154 "DFC_ComMETNTOut" 155 "DFC_ComMtrCom" 156 "DFC_ComPCUChkSum" 157 "DFC_ComPCURingCnt" 158 "DFC_ComPCUTOut" 159 "DFC_ComSRSAChksum" 160 "DFC_ComSRSARingCnt" 161 "DFC_ComSRSATOut" 162 "DFC_ComSRSBChksum" 163 "DFC_ComSRSBRingCnt" 164 "DFC_ComSRSBTOut" 165 "DFC_ComSRSChksum" 166 "DFC_ComSRSErr" 167 "DFC_ComSRSRingCnt" 168 "DFC_ComSRSTOut" 280 "DFC_ComTOutTCU01" 281 "DFC_ComTOutTCU02" 282 "DFC_ComTOutTCU1" 283 "DFC_ComTOutTCU11" 284 "DFC_ComTOutTCU12" 285 "DFC_ComTOutTCU13" 286 "DFC_ComTOutTCU14" 287 "DFC_ComTOutTCU2" 288 "DFC_ComTOutTCU3" 289 "DFC_ComTOutTCU4" 169 "DFC_ComVehSpdPndFltTCU" 446 "DFC_DCDCFltDet" 290 "DFC_DevLibBattUHi" 291 "DFC_DevLibBattULo" 449 "DFC_DKnpl" 447 "DFC_DKRSA" 448 "DFC_DKVSmax" 450 "DFC_DSSmax" 451 "DFC_DSTTI" 452 "DFC_DSUmax" 170 "DFC_EbsChartcCurrErr" 171 "DFC_EbsSelfDiagErr" 383 "DFC_EbsSocFlt" 453 "DFC_EGRVlvOL" 454 "DFC_EGRVlvSCB" 455 "DFC_EGRVlvSCG" 456 "DFC_EGSDUS2B1LtrDly" 457 "DFC_EGSDUS2B1LtrPT1" 458 "DFC_EGSDUS2B1RtlDly" 459 "DFC_EGSDUS2B1RtlPT1" 460 "DFC_EGSDUS2B1TarLean" 461 "DFC_EGSDUS2B1TarRich" 464 "DFC_EngICO" 465 "DFC_EngPrtOvrSpdMon" 466 "DFC_EpmCaSI1ErrSig" 467 "DFC_EpmCaSI1NoSig" 468 "DFC_EpmCaSI1OfsErr" 469 "DFC_EpmCrSErrSig" 470 "DFC_EpmCrSNoSig" 471 "DFC_EtaEngIdleNonCsers" 472 "DFC_EtaEngPtlNonCsers" 462 "DFC_ETAKHLmax" 463 "DFC_ETAKHTmax" 337 "DFC_EV1max" 338 "DFC_EV1min" 339 "DFC_EV1sig" 340 "DFC_EV2max" 341 "DFC_EV2min" 342 "DFC_EV2sig" 343 "DFC_EV3max" 344 "DFC_EV3min" 345 "DFC_EV3sig" 346 "DFC_EV4max" 347 "DFC_EV4min" 348 "DFC_EV4sig" 382 "DFC_EVX" 292 "DFC_FanDIOOL_0" 293 "DFC_FanDIOOL_1" 294 "DFC_FanDIOOvrTemp_0" 295 "DFC_FanDIOOvrTemp_1" 296 "DFC_FanDIOSCB_0" 297 "DFC_FanDIOSCB_1" 298 "DFC_FanDIOSCG_0" 299 "DFC_FanDIOSCG_1" 473 "DFC_FRAmax" 474 "DFC_FRAmin" 172 "DFC_GbxCANDigPlausErr" 173 "DFC_GbxNPos1SRCMax" 174 "DFC_GbxNPos1SRCMin" 175 "DFC_GbxNPos2SRCMax" 176 "DFC_GbxNPos2SRCMin" 177 "DFC_GbxNPosAlvChk" 178 "DFC_GbxNPosSyncErr" 349 "DFC_GbxPNPosnDrvCdn" 350 "DFC_GbxPNPosnPlausy" 475 "DFC_GbxRvsSwtStk" 476 "DFC_HDRmax" 477 "DFC_HEGOS2B1ElecMax" 478 "DFC_HEGOS2B1ElecMin" 479 "DFC_HEGOS2B1ElecSig" 480 "DFC_HEGOS2B1HtgNpl" 179 "DFC_HEGOS2B1HtrPsMax" 180 "DFC_HEGOS2B1HtrPsMin" 181 "DFC_HEGOS2B1HtrPsSig" 327 "DFC_HLSDemOvhtEngLim" 384 "DFC_I14229VINErr" 237 "DFC_IgnClPs_DevComErr" 238 "DFC_IgnClPs_LineOl_0" 239 "DFC_IgnClPs_LineOl_1" 240 "DFC_IgnClPs_LineOl_2" 241 "DFC_IgnClPs_LineOl_3" 242 "DFC_IgnClPs_LineScb_0" 243 "DFC_IgnClPs_LineScb_1" 244 "DFC_IgnClPs_LineScb_2" 245 "DFC_IgnClPs_LineScb_3" 246 "DFC_IgnClPs_LineScg_0" 247 "DFC_IgnClPs_LineScg_1" 248 "DFC_IgnClPs_LineScg_2" 249 "DFC_IgnClPs_LineScg_3" 481 "DFC_IntkAirTIntkMnfldCrssMax" 482 "DFC_IntkAirTIntkMnfldCrssMin" 483 "DFC_IntkAirTIntkMnfldHSCMax" 484 "DFC_IntkAirTIntkMnfldImps" 485 "DFC_IntkAirTIntkMnfldPRCMax" 486 "DFC_IntkAirTIntkMnfldPRCMin" 487 "DFC_IntkAirTIntkMnfldSRCMax" 488 "DFC_IntkAirTIntkMnfldSRCMin" 489 "DFC_IntkAirTIntkMnfldSTC" 362 "DFC_KnDetSens1PortAMax" 363 "DFC_KnDetSens1PortAMin" 364 "DFC_KnDetSens1PortBMax" 365 "DFC_KnDetSens1PortBMin" 490 "DFC_KS1max" 491 "DFC_KS1min" 494 "DFC_LamDynDiagS1B1" 495 "DFC_LeakIntkMnfldEmiInfl" 412 "DFC_LIN_E_TIMEOUT" 182 "DFC_LinCSErrACG" 183 "DFC_LinCSErrEBS" 184 "DFC_LinHdrTimeoutErrACG" 185 "DFC_LinHdrTimeoutErrEBS" 186 "DFC_LinMsgTimeoutErrACG" 187 "DFC_LinMsgTimeoutErrEBS" 188 "DFC_LinNoStrtComErr" 385 "DFC_LLRKHmax" 386 "DFC_LLRKHmin" 387 "DFC_LLRmax" 388 "DFC_LLRmin" 492 "DFC_LMmax" 493 "DFC_LZSRnpl" 496 "DFC_MD00max" 497 "DFC_MDBmax" 498 "DFC_MDCat" 499 "DFC_MDCatCrit" 500 "DFC_MDCatCurr" 501 "DFC_MDCyl_0" 502 "DFC_MDCyl_1" 503 "DFC_MDCyl_2" 504 "DFC_MDCyl_3" 505 "DFC_MDEmi" 506 "DFC_MDEmiStrt" 507 "DFC_MDFco" 510 "DFC_MDmax" 508 "DFC_MDMpl" 509 "DFC_MDSegTiAdpn" 205 "DFC_MisfDetdVWhlFrntLePlaus" 206 "DFC_MisfDetdVWhlFrntRiPlaus" 207 "DFC_MisfDetdVWhlReLePlaus" 208 "DFC_MisfDetdVWhlReRiPlaus" 189 "DFC_MisfDetVWhlFrntLeOORHi" 190 "DFC_MisfDetVWhlFrntLeRatyHi" 191 "DFC_MisfDetVWhlFrntLeRatyLo" 192 "DFC_MisfDetVWhlFrntLeStuck" 193 "DFC_MisfDetVWhlFrntRiOORHi" 194 "DFC_MisfDetVWhlFrntRiRatyHi" 195 "DFC_MisfDetVWhlFrntRiRatyLo" 196 "DFC_MisfDetVWhlFrntRiStuck" 197 "DFC_MisfDetVWhlReLeOORHi" 198 "DFC_MisfDetVWhlReLeRatyHi" 199 "DFC_MisfDetVWhlReLeRatyLo" 200 "DFC_MisfDetVWhlReLeStuck" 201 "DFC_MisfDetVWhlReRiOORHi" 202 "DFC_MisfDetVWhlReRiRatyHi" 203 "DFC_MisfDetVWhlReRiRatyLo" 204 "DFC_MisfDetVWhlReRiStuck" 605 "DFC_MoCADCNTP" 606 "DFC_MoCADCTst" 607 "DFC_MoCSOPICO" 609 "DFC_MoFAirFilgPrdc" 610 "DFC_MoFAirFlCtOffPfi" 611 "DFC_MoFAirFlCylPfi" 612 "DFC_MoFAirFlIn" 613 "DFC_MoFAirFlMixCtlPfiChkAirFl" 614 "DFC_MoFAirFlMixCtlPfiChkCtrl" 615 "DFC_MoFAirFlMode" 608 "DFC_MoFAPP" 616 "DFC_MoFESpd" 617 "DFC_MoFIACo" 618 "DFC_MoFICOL1" 619 "DFC_MoFICOL2" 620 "DFC_MoFStrt" 621 "DFC_MoFTrqCmp" 622 "DFC_MoFTrqCmpMax" 623 "DFC_MoFTrqCmpMin" 624 "DFC_MoFVarPostBldSel" 511 "DFC_MOXEMM_SMU_ALM0_0" 512 "DFC_MOXEMM_SMU_ALM0_1" 513 "DFC_MOXEMM_SMU_ALM0_10" 514 "DFC_MOXEMM_SMU_ALM0_11" 515 "DFC_MOXEMM_SMU_ALM0_13" 516 "DFC_MOXEMM_SMU_ALM0_14" 517 "DFC_MOXEMM_SMU_ALM0_2" 518 "DFC_MOXEMM_SMU_ALM0_22" 519 "DFC_MOXEMM_SMU_ALM0_23" 520 "DFC_MOXEMM_SMU_ALM0_4" 521 "DFC_MOXEMM_SMU_ALM0_5" 522 "DFC_MOXEMM_SMU_ALM0_7" 523 "DFC_MOXEMM_SMU_ALM0_8" 524 "DFC_MOXEMM_SMU_ALM10_16" 525 "DFC_MOXEMM_SMU_ALM10_17" 526 "DFC_MOXEMM_SMU_ALM10_21" 527 "DFC_MOXEMM_SMU_ALM11_0" 528 "DFC_MOXEMM_SMU_ALM11_1" 529 "DFC_MOXEMM_SMU_ALM11_2" 530 "DFC_MOXEMM_SMU_ALM11_3" 531 "DFC_MOXEMM_SMU_ALM11_4" 532 "DFC_MOXEMM_SMU_ALM11_5" 533 "DFC_MOXEMM_SMU_ALM11_8" 534 "DFC_MOXEMM_SMU_ALM11_9" 535 "DFC_MOXEMM_SMU_ALM1_0" 536 "DFC_MOXEMM_SMU_ALM1_1" 537 "DFC_MOXEMM_SMU_ALM1_10" 538 "DFC_MOXEMM_SMU_ALM1_11" 539 "DFC_MOXEMM_SMU_ALM1_13" 540 "DFC_MOXEMM_SMU_ALM1_14" 541 "DFC_MOXEMM_SMU_ALM1_2" 542 "DFC_MOXEMM_SMU_ALM1_22" 543 "DFC_MOXEMM_SMU_ALM1_23" 544 "DFC_MOXEMM_SMU_ALM1_4" 545 "DFC_MOXEMM_SMU_ALM1_5" 546 "DFC_MOXEMM_SMU_ALM1_7" 547 "DFC_MOXEMM_SMU_ALM1_8" 548 "DFC_MOXEMM_SMU_ALM21_0" 549 "DFC_MOXEMM_SMU_ALM21_16" 550 "DFC_MOXEMM_SMU_ALM21_3" 551 "DFC_MOXEMM_SMU_ALM2_1" 552 "DFC_MOXEMM_SMU_ALM2_10" 553 "DFC_MOXEMM_SMU_ALM2_11" 554 "DFC_MOXEMM_SMU_ALM2_13" 555 "DFC_MOXEMM_SMU_ALM2_14" 556 "DFC_MOXEMM_SMU_ALM2_22" 557 "DFC_MOXEMM_SMU_ALM2_23" 558 "DFC_MOXEMM_SMU_ALM2_4" 559 "DFC_MOXEMM_SMU_ALM2_5" 560 "DFC_MOXEMM_SMU_ALM2_7" 561 "DFC_MOXEMM_SMU_ALM2_8" 562 "DFC_MOXEMM_SMU_ALM6_0" 563 "DFC_MOXEMM_SMU_ALM6_11" 564 "DFC_MOXEMM_SMU_ALM6_12" 565 "DFC_MOXEMM_SMU_ALM6_14" 566 "DFC_MOXEMM_SMU_ALM6_15" 567 "DFC_MOXEMM_SMU_ALM6_17" 568 "DFC_MOXEMM_SMU_ALM6_18" 569 "DFC_MOXEMM_SMU_ALM6_20" 570 "DFC_MOXEMM_SMU_ALM6_21" 571 "DFC_MOXEMM_SMU_ALM6_25" 572 "DFC_MOXEMM_SMU_ALM6_4" 573 "DFC_MOXEMM_SMU_ALM6_5" 574 "DFC_MOXEMM_SMU_ALM6_7" 575 "DFC_MOXEMM_SMU_ALM6_8" 576 "DFC_MOXEMM_SMU_ALM7_1" 577 "DFC_MOXEMM_SMU_ALM7_12" 578 "DFC_MOXEMM_SMU_ALM7_13" 579 "DFC_MOXEMM_SMU_ALM7_14" 580 "DFC_MOXEMM_SMU_ALM7_15" 581 "DFC_MOXEMM_SMU_ALM7_16" 582 "DFC_MOXEMM_SMU_ALM7_17" 583 "DFC_MOXEMM_SMU_ALM7_2" 584 "DFC_MOXEMM_SMU_ALM7_20" 585 "DFC_MOXEMM_SMU_ALM7_25" 586 "DFC_MOXEMM_SMU_ALM7_26" 587 "DFC_MOXEMM_SMU_ALM7_28" 588 "DFC_MOXEMM_SMU_ALM7_29" 589 "DFC_MOXEMM_SMU_ALM7_30" 590 "DFC_MOXEMM_SMU_ALM7_31" 591 "DFC_MOXEMM_SMU_ALM8_0" 592 "DFC_MOXEMM_SMU_ALM8_1" 593 "DFC_MOXEMM_SMU_ALM8_10" 594 "DFC_MOXEMM_SMU_ALM8_11" 595 "DFC_MOXEMM_SMU_ALM8_12" 596 "DFC_MOXEMM_SMU_ALM8_16" 597 "DFC_MOXEMM_SMU_ALM8_18" 598 "DFC_MOXEMM_SMU_ALM8_2" 599 "DFC_MOXEMM_SMU_ALM8_3" 600 "DFC_MOXEMM_SMU_ALM8_31" 601 "DFC_MOXEMM_SMU_ALM8_4" 602 "DFC_MOXEMM_SMU_ALM9_0" 603 "DFC_MOXEMM_SMU_ALM9_15" 604 "DFC_MOXEMM_SMU_ALM9_3" 625 "DFC_MoXEMMHwLTMCUFW" 626 "DFC_MoXEMMHwLTMonBIST" 627 "DFC_MoXEMMHwLTRegMonTest" 628 "DFC_MoXEMMHwLTStbySMUAlvTest" 629 "DFC_MoXEMMHwLTTempSens" 630 "DFC_MoXEMMHwLTUCBCfg" 300 "DFC_MRlyDcOL" 301 "DFC_MRlyDcSCB" 302 "DFC_MRlyDcSCG" 413 "DFC_MRlyOL" 414 "DFC_MRlySCB" 415 "DFC_MRlySCG" 631 "DFC_OCWDAABEActv" 632 "DFC_OCWDACom" 633 "DFC_OCWDAErrPin" 634 "DFC_OCWDAOvrVltg" 328 "DFC_OilPNpl" 635 "DFC_ORAmax" 636 "DFC_ORAmin" 647 "DFC_P_VSE11_OL" 648 "DFC_P_VSE11_SCB" 649 "DFC_P_VSE11_SCG" 351 "DFC_PEnvCcMax" 352 "DFC_PEnvCcMin" 353 "DFC_PEnvRngChkMax" 354 "DFC_PEnvRngChkMin" 209 "DFC_PEnvSigRngMax" 210 "DFC_PEnvSigRngMin" 355 "DFC_PEnvSnsrPlaus" 650 "DFC_PhyHighAPP1" 651 "DFC_PhyHighAPP2" 652 "DFC_PhyLowAPP1" 653 "DFC_PhyLowAPP2" 329 "DFC_PIntkVUsLineHiB1" 330 "DFC_PIntkVUsLineLoB1" 637 "DFC_PLLSUmax" 638 "DFC_PLLSUmin" 303 "DFC_PSPOL" 304 "DFC_PSPOvrTemp" 305 "DFC_PSPSCB" 306 "DFC_PSPSCG" 639 "DFC_PSR1max" 640 "DFC_PSRBmax" 641 "DFC_PSRBmin" 645 "DFC_PSRmax" 642 "DFC_PSRPmax" 643 "DFC_PSRPmin" 644 "DFC_PSRPsig" 646 "DFC_PUmax" 396 "DFC_RBA_IODIAGPWR_rba_IoExtCy329_SignalVltSply_0" 397 "DFC_RBA_IODIAGPWR_rba_IoExtCy329_SignalVltSply_0OT" 398 "DFC_RBA_IODIAGPWR_rba_IoExtCy329_SignalVltSply_0OV" 399 "DFC_RBA_IODIAGPWR_rba_IoExtCy329_SignalVltSply_0SCG" 400 "DFC_RBA_IODIAGPWR_rba_IoExtCy329_SignalVltSply_0UV" 401 "DFC_RBA_IODIAGPWR_rba_IoExtCy329_SignalVltSply_1" 402 "DFC_RBA_IODIAGPWR_rba_IoExtCy329_SignalVltSply_1OT" 403 "DFC_RBA_IODIAGPWR_rba_IoExtCy329_SignalVltSply_1OV" 404 "DFC_RBA_IODIAGPWR_rba_IoExtCy329_SignalVltSply_1SCG" 405 "DFC_RBA_IODIAGPWR_rba_IoExtCy329_SignalVltSply_1UV" 406 "DFC_RBA_IODIAGPWR_rba_IoExtCy329_SignalVltSply_2" 407 "DFC_RBA_IODIAGPWR_rba_IoExtCy329_SignalVltSply_2OT" 408 "DFC_RBA_IODIAGPWR_rba_IoExtCy329_SignalVltSply_2OV" 409 "DFC_RBA_IODIAGPWR_rba_IoExtCy329_SignalVltSply_2SCG" 410 "DFC_RBA_IODIAGPWR_rba_IoExtCy329_SignalVltSply_2UV" 419 "DFC_RBA_IOEXTLIB_KEEPALIVE_DRV" 420 "DFC_RBA_IOEXTLIB_KEEPALIVE_INI" 421 "DFC_rba_IoSigRtc_StopCounter" 423 "DFC_rba_MemDiag_MemReadErr" 424 "DFC_rba_MemDiag_MemWrErr" 422 "DFC_rba_MRly_Diag_Stk_Event" 416 "DFC_rba_MultiStackTrace_Threshold" 425 "DFC_rba_SyC_IrrSwOffTrigEngRun_Event" 426 "DFC_rba_T15_Diag_ComInVld_Event" 427 "DFC_rba_T15_Diag_ComOff_HwOn_Event" 428 "DFC_rba_T15_Diag_ComOn_HwOff_Event" 389 "DFC_RoughRoad" 390 "DFC_SiaEEPRdErr" 391 "DFC_SiaEEPWrngCod" 654 "DFC_SRCHighAPP1" 655 "DFC_SRCHighAPP2" 656 "DFC_SRCLowAPP1" 657 "DFC_SRCLowAPP2" 658 "DFC_SSpMon2" 211 "DFC_StmFault" 213 "DFC_StrtCtlErr" 212 "DFC_StrtCtOffPth" 214 "DFC_StrtFault" 215 "DFC_StrtLckJudg1" 216 "DFC_StrtLckJudg2" 217 "DFC_StrtOL" 218 "DFC_StrtOL2" 219 "DFC_StrtSCB" 220 "DFC_StrtSCB2" 221 "DFC_StrtSCG" 222 "DFC_StrtSCG2" 223 "DFC_StrtStkRly1" 224 "DFC_StrtStkRly2" 659 "DFC_SWReset_0" 660 "DFC_SWReset_1" 661 "DFC_SWReset_2" 662 "DFC_SyncAPP" 307 "DFC_T50Err" 663 "DFC_TAmax_Dummy" 225 "DFC_TEVEmax" 226 "DFC_TEVEmin" 227 "DFC_TEVEsig" 671 "DFC_ThrVlvClsdPosnFirstOffsLrnImpoB1" 672 "DFC_ThrVlvClsdPosnOffsLrnImpoB1" 673 "DFC_ThrVlvClsdPosnOffsLrnMaxB1" 674 "DFC_ThrVlvClsdPosnOffsLrnMinB1" 675 "DFC_ThrVlvCtrlDeB1" 676 "DFC_ThrVlvDycB1" 677 "DFC_ThrVlvLimpAirPosnMaxAbsltDriftB1" 678 "DFC_ThrVlvLimpAirPosnMaxB1" 679 "DFC_ThrVlvLimpAirPosnMaxRelDriftB1" 680 "DFC_ThrVlvLimpAirPosnMinB1" 308 "DFC_ThrVlvLoBattB1" 681 "DFC_ThrVlvOpenLoadB1" 682 "DFC_ThrVlvOpenSprgB1" 683 "DFC_ThrVlvOpenSprgSprdB1" 684 "DFC_ThrVlvOpenSprgTwnB1" 685 "DFC_ThrVlvOverTB1" 686 "DFC_ThrVlvRetSprgB1" 687 "DFC_ThrVlvRetSprgSprdB1" 688 "DFC_ThrVlvRetSprgTwnB1" 689 "DFC_ThrVlvSens1MaxB1" 696 "DFC_ThrvlvSens1MinB1" 690 "DFC_ThrVlvSens1NplB1" 691 "DFC_ThrVlvSens2MaxB1" 692 "DFC_ThrVlvSens2MinB1" 693 "DFC_ThrVlvSens2NplB1" 694 "DFC_ThrVlvShoCircB1" 695 "DFC_ThrVlvSpiErrB1" 697 "DFC_TiOffTBasdChkFast" 698 "DFC_TiOffTBasdChkSlow" 664 "DFC_TKAEmax" 665 "DFC_TKAEmin" 666 "DFC_TKARmax" 667 "DFC_TKARnpl" 668 "DFC_TMmax_Dummy" 669 "DFC_TUMmax_Dummy" 670 "DFC_TWCDPriCatB1" 250 "DFC_UEGOASICS1B1" 392 "DFC_UegoDummy" 699 "DFC_UEGOHeatrCtlS1B1" 356 "DFC_UEGOHeatrPsS1B1Max" 357 "DFC_UEGOHeatrPsS1B1Min" 358 "DFC_UEGOHeatrPsS1B1Sig" 359 "DFC_UEGOHeatrRlyPsOLS1B1" 360 "DFC_UEGOHeatrRlyPsSCBS1B1" 361 "DFC_UEGOHeatrRlyPsSCGS1B1" 257 "DFC_UegoOlApesS1B1" 251 "DFC_UEGOOLIPES1B1" 258 "DFC_UegoOlRCmpS1B1" 252 "DFC_UEGOOLRES1B1" 253 "DFC_UEGOSCBS1B1" 254 "DFC_UEGOSCGS1B1" 700 "DFC_UEGOSnsrMntdS1B1" 256 "DFC_UEGOSnsrS1B1" 255 "DFC_UEGOSPIS1B1" 228 "DFC_VehVAllPlaus" 229 "DFC_VehVNCSnsrElecFailr" 309 "DFC_VehVPhysRngHi" 331 "DFC_VehVPhysRngLo" 230 "DFC_VehVPlausCan" 231 "DFC_VehVPlausFco" 232 "DFC_VehVPlausPwr" 233 "DFC_VehVPlausV2N" 310 "DFC_VehVSclOutOL" 311 "DFC_VehVSclOutOT" 312 "DFC_VehVSclOutSCB" 313 "DFC_VehVSclOutSCG" 701 "DFC_VehVSig" 332 "DFC_VehVSigCan" 333 "DFC_VehVSigCanSafe" 314 "DFC_VehVSnsrARngHi" 315 "DFC_VehVSnsrBRngHi" 316 "DFC_VehVSpdRtyDiag" 234 "DFC_VehVSpdSnsrAElecFailr" 235 "DFC_VehVSpdSnsrBElecFailr" 317 "DFC_VehVWhlErr" 334 "DFC_VlvLftFbOilPSnsrIntk11SRCMax" 335 "DFC_VlvLftFbOilPSnsrIntk11SRCMin" 702 "DFC_VlvLftFbSwtIntk11SpclFail" 703 "DFC_VlvLftFbSwtIntk11StdFail" DEFAULT_VALUE "---" /end COMPU_VTAB
/begin COMPU_METHOD DFES_OneToOne "" RAT_FUNC "%6.2" "-" COEFFS 0 1 0 0 0 1 /end COMPU_METHOD
/begin COMPU_METHOD dfp_verbal "" TAB_VERB "%6.3" "-" COMPU_TAB_REF dfp_verbal /end COMPU_METHOD
/begin COMPU_VTAB dfp_verbal "" TAB_VERB 59 0 "DFP_AAA" 1 "DFP_AGRE" 2 "DFP_AGRL" 3 "DFP_DK" 4 "DFP_DK1P" 5 "DFP_DK2P" 6 "DFP_DKVS" 7 "DFP_DSS" 8 "DFP_DSU" 9 "DFP_DVEE" 10 "DFP_DVEF" 11 "DFP_DVEFO" 12 "DFP_DVEL" 13 "DFP_DVEN" 14 "DFP_DVER" 15 "DFP_DVEU" 16 "DFP_DVEUB" 17 "DFP_DVEUW" 18 "DFP_DYLSU" 19 "DFP_FP1P" 20 "DFP_FP2P" 21 "DFP_FRA" 22 "DFP_HSH" 23 "DFP_HSHE" 24 "DFP_KAT" 25 "DFP_KPE" 26 "DFP_KS1" 27 "DFP_LASH" 28 "DFP_LLR" 29 "DFP_LLRKH" 30 "DFP_LM" 31 "DFP_LSH" 32 "DFP_LZSR" 33 "DFP_MD" 34 "DFP_ORA" 35 "DFP_PLLSU" 36 "DFP_PS2E" 37 "DFP_PSR" 38 "DFP_PSR1" 39 "DFP_PSRB" 40 "DFP_PSRE" 41 "DFP_PSRP" 42 "DFP_PU" 43 "DFP_PUE" 44 "DFP_PUPL" 45 "DFP_PUR" 46 "DFP_TA" 47 "DFP_TASRCS" 48 "DFP_TASRE" 49 "DFP_TASRPRC" 50 "DFP_TASRR" 51 "DFP_TEVE" 52 "DFP_TM" 53 "DFP_TMCS" 54 "DFP_TME" 55 "DFP_TMP" 56 "DFP_UB" 57 "DFP_VFZ" 58 "DFP_ZZZ" DEFAULT_VALUE "---" /end COMPU_VTAB
/begin COMPU_METHOD DINH_OneToOne "" RAT_FUNC "%6.2" "-" COEFFS 0 1 0 0 0 1 /end COMPU_METHOD
/begin COMPU_METHOD DSCHED_FIdExcCauseVerb "" TAB_VERB "%6.3" "-" COMPU_TAB_REF DSCHED_FIdExcCauseVerb /end COMPU_METHOD
/begin COMPU_VTAB DSCHED_FIdExcCauseVerb "" TAB_VERB 19 0 "No_exclusion" 1 "FID_AFRA" 2 "FID_AORA" 3 "FID_ATEH" 4 "FID_ATEL" 5 "FID_ATEN" 6 "FId_EGSDCmnSeg1B1Parl" 7 "FID_BLLRH" 8 "FID_BLLRKH" 9 "FID_BPLSU" 10 "FId_CJ135RvsChrgMeasS1B1" 11 "FId_CatHeatgColdStrtReq" 12 "FId_CatHeatgWrmReq" 13 "FId_EGSDO2SnsrMntdRelsS1B1" 14 "FId_EGSDO2_LamOffsFastS1B1" 15 "FId_MisfDetDnAdpnNv" 253 "NO_PRIO" 254 "MODE_IMPOSSIBLE" 255 "NO_RUN" DEFAULT_VALUE "---" /end COMPU_VTAB
/begin COMPU_METHOD DSCHED_StSimnSeln_C_Verb "" TAB_VERB "%6.3" "" COMPU_TAB_REF DSCHED_StSimnSeln_C_Verb /end COMPU_METHOD
/begin COMPU_VTAB DSCHED_StSimnSeln_C_Verb "" TAB_VERB 2 0 "No_Exclusion_Considered" 1 "Exclusion_Considered" /end COMPU_VTAB
/begin COMPU_METHOD DSCHED_StVerb "" TAB_VERB "%6.3" "-" COMPU_TAB_REF DSCHED_StVerb /end COMPU_METHOD
/begin COMPU_VTAB DSCHED_StVerb "" TAB_VERB 64 0 "____________________________" 2 "_____________________RawPerm" 4 "_________________Act________" 6 "_________________Act_RawPerm" 8 "_____________Lck____________" 10 "_____________Lck_____RawPerm" 12 "_____________Lck_Act________" 14 "_____________Lck_Act_RawPerm" 32 "_________Val________________" 34 "_________Val_________RawPerm" 36 "_________Val_____Act________" 38 "_________Val_____Act_RawPerm" 40 "_________Val_Lck____________" 42 "_________Val_Lck_____RawPerm" 44 "_________Val_Lck_Act________" 46 "_________Val_Lck_Act_RawPerm" 64 "____Perm____________________" 66 "____Perm_____________RawPerm" 68 "____Perm_________Act________" 70 "____Perm_________Act_RawPerm" 72 "____Perm_____Lck____________" 74 "____Perm_____Lck_____RawPerm" 76 "____Perm_____Lck_Act________" 78 "____Perm_____Lck_Act_RawPerm" 96 "____Perm_Val________________" 98 "____Perm_Val_________RawPerm" 100 "____Perm_Val_____Act________" 102 "____Perm_Val_____Act_RawPerm" 104 "____Perm_Val_Lck____________" 106 "____Perm_Val_Lck_____RawPerm" 108 "____Perm_Val_Lck_Act________" 110 "____Perm_Val_Lck_Act_RawPerm" 128 "Rdy_________________________" 130 "Rdy__________________RawPerm" 132 "Rdy______________Act________" 134 "Rdy______________Act_RawPerm" 136 "Rdy__________Lck____________" 138 "Rdy__________Lck_____RawPerm" 140 "Rdy__________Lck_Act________" 142 "Rdy__________Lck_Act_RawPerm" 160 "Rdy______Val________________" 162 "Rdy______Val_________RawPerm" 164 "Rdy______Val_____Act________" 166 "Rdy______Val_____Act_RawPerm" 168 "Rdy______Val_Lck____________" 170 "Rdy______Val_Lck_____RawPerm" 172 "Rdy______Val_Lck_Act________" 174 "Rdy______Val_Lck_Act_RawPerm" 192 "Rdy_Perm____________________" 194 "Rdy_Perm_____________RawPerm" 196 "Rdy_Perm_________Act________" 198 "Rdy_Perm_________Act_RawPerm" 200 "Rdy_Perm_____Lck____________" 202 "Rdy_Perm_____Lck_____RawPerm" 204 "Rdy_Perm_____Lck_Act________" 206 "Rdy_Perm_____Lck_Act_RawPerm" 224 "Rdy_Perm_Val________________" 226 "Rdy_Perm_Val_________RawPerm" 228 "Rdy_Perm_Val_____Act________" 230 "Rdy_Perm_Val_____Act_RawPerm" 232 "Rdy_Perm_Val_Lck____________" 234 "Rdy_Perm_Val_Lck_____RawPerm" 236 "Rdy_Perm_Val_Lck_Act________" 238 "Rdy_Perm_Val_Lck_Act_RawPerm" /end COMPU_VTAB
/begin COMPU_METHOD DSCHED_VirtStVerb "" TAB_VERB "%6.3" "NO" COMPU_TAB_REF DSCHED_VirtStVerb /end COMPU_METHOD
/begin COMPU_VTAB DSCHED_VirtStVerb "" TAB_VERB 8 0 "____________________________" 8 "_____________Lck____________" 64 "____Perm____________________" 72 "____Perm_____Lck____________" 128 "Rdy_________________________" 136 "Rdy__________Lck____________" 192 "Rdy_Perm____________________" 200 "Rdy_Perm_____Lck____________" /end COMPU_VTAB
/begin COMPU_METHOD DSMAUX_stDCyVerb "" TAB_VERB "%6.3" "-" COMPU_TAB_REF DSMAUX_stDCyVerb /end COMPU_METHOD
/begin COMPU_VTAB DSMAUX_stDCyVerb "" TAB_VERB 4 0 "DCy_New" 1 "DCy_Qualified" 2 "DCy_KeyOnCyc" 3 "DCy_Completed" /end COMPU_VTAB
/begin COMPU_METHOD DSMDUR_10m_Counter "" RAT_FUNC "%6.4" "km" COEFFS 0 100 0 0 0 1 /end COMPU_METHOD
/begin COMPU_METHOD DSMDur_EvntSel_Verb "" TAB_VERB "%6.3" "-" COMPU_TAB_REF DSMDur_EvntSel_Verb /end COMPU_METHOD
/begin COMPU_VTAB DSMDur_EvntSel_Verb "" TAB_VERB 5 0 "NoCountEvent" 1 "DistanceEvents" 2 "TimeEvents" 4 "WarmUpCycleEvents" 8 "DistanceEvents10m" /end COMPU_VTAB
/begin COMPU_METHOD DSMDur_StDispl_Verb "" TAB_VERB "%6.3" "-" COMPU_TAB_REF DSMDur_StDispl_Verb /end COMPU_METHOD
/begin COMPU_VTAB DSMDur_StDispl_Verb "" TAB_VERB 3 0 "NotEnabled" 1 "CountingEnabled" 2 "ResetCondition" /end COMPU_VTAB
/begin COMPU_METHOD DSMRdy_OneToOne "" RAT_FUNC "%6.2" "-" COEFFS 0 1 0 0 0 1 /end COMPU_METHOD
/begin COMPU_METHOD ESC_SELNCAMSFTTSKACTVN_SC_Compu "" TAB_VERB "%6.3" "" COMPU_TAB_REF ESC_SELNCAMSFTTSKACTVN_SC_Compu /end COMPU_METHOD
/begin COMPU_VTAB ESC_SELNCAMSFTTSKACTVN_SC_Compu "" TAB_VERB 3 0 "NO_CAMSFTTSKACTVN" 1 "PLAT_CAMSFTTSKACTVN" 2 "HDP_CAMSFTTSKACTVN" /end COMPU_VTAB
/begin COMPU_METHOD ESC_SELNMETHSYNSDL_SC_Compu "" TAB_VERB "%6.3" "" COMPU_TAB_REF ESC_SELNMETHSYNSDL_SC_Compu /end COMPU_METHOD
/begin COMPU_VTAB ESC_SELNMETHSYNSDL_SC_Compu "" TAB_VERB 2 0 "OS_TSK_BASD_SDL" 1 "ESC_CNTNR_BASD_SDL" /end COMPU_VTAB
/begin COMPU_METHOD ESC_SELNNOTSTDTISYNCNTSK_SC_Compu "" TAB_VERB "%6.3" "" COMPU_TAB_REF ESC_SELNNOTSTDTISYNCNTSK_SC_Compu /end COMPU_METHOD
/begin COMPU_VTAB ESC_SELNNOTSTDTISYNCNTSK_SC_Compu "" TAB_VERB 2 0 "NO_SELN" 1 "40ms" /end COMPU_VTAB
/begin COMPU_METHOD ESC_SELSAMPLETICFGMETHOD_SC_Compu "" TAB_VERB "%6.3" "" COMPU_TAB_REF ESC_SELSAMPLETICFGMETHOD_SC_Compu /end COMPU_METHOD
/begin COMPU_VTAB ESC_SELSAMPLETICFGMETHOD_SC_Compu "" TAB_VERB 2 0 "MAN_CFG_METHOD" 1 "AUT_CFG_METHOD" /end COMPU_VTAB
/begin COMPU_METHOD ESC_SWTSYNRTMEASMT_SC_Compu "" TAB_VERB "%6.3" "" COMPU_TAB_REF ESC_SWTSYNRTMEASMT_SC_Compu /end COMPU_METHOD
/begin COMPU_VTAB ESC_SWTSYNRTMEASMT_SC_Compu "" TAB_VERB 2 0 "False" 1 "True" /end COMPU_VTAB
/begin COMPU_METHOD ESC_SYNCTASK_SC_Compu "" TAB_VERB "%6.3" "" COMPU_TAB_REF ESC_SYNCTASK_SC_Compu /end COMPU_METHOD
/begin COMPU_VTAB ESC_SYNCTASK_SC_Compu "" TAB_VERB 3 0 "0" 1 "1" 2 "2" /end COMPU_VTAB
/begin COMPU_METHOD ESNSAD_INHCUST_SY_Compu "" TAB_VERB "%6.3" "" COMPU_TAB_REF ESNSAD_INHCUST_SY_Compu /end COMPU_METHOD
/begin COMPU_VTAB ESNSAD_INHCUST_SY_Compu "" TAB_VERB 2 0 "False" 1 "True" /end COMPU_VTAB
/begin COMPU_METHOD Eta "" RAT_FUNC "%6.4" "Nm/(mg/cyc)" COEFFS 0 128 0 0 0 1 /end COMPU_METHOD
/begin COMPU_METHOD Eta1 "" RAT_FUNC "%6.4" "-" COEFFS 0 128 0 0 0 1 /end COMPU_METHOD
/begin COMPU_METHOD Eta2 "" RAT_FUNC "%6.4" "" COEFFS 0 128 0 0 0 1 /end COMPU_METHOD
/begin COMPU_METHOD ETCtlGovKd_fac "" RAT_FUNC "%7.6" "-" COEFFS 0 12800 0 0 0 1 /end COMPU_METHOD
/begin COMPU_METHOD ETCtlGovKi_fac "" RAT_FUNC "%8.7" "-" COEFFS 0 429496.7296 0 0 0 1 /end COMPU_METHOD
/begin COMPU_METHOD ETCtlGovKp_fac "" RAT_FUNC "%7.6" "-" COEFFS 0 25600 0 0 0 1 /end COMPU_METHOD
/begin COMPU_METHOD ETCtlGovRmp "" RAT_FUNC "%6.3" "s" COEFFS 0 0 1 0 0.0152587890625 0 /end COMPU_METHOD
/begin COMPU_METHOD ETCtlGov_p0q001 "" RAT_FUNC "%6.5" "-" COEFFS 0 1000 0 0 0 1 /end COMPU_METHOD
/begin COMPU_METHOD ETC_Act_SY_Compu "" TAB_VERB "%6.3" "" COMPU_TAB_REF ETC_Act_SY_Compu /end COMPU_METHOD
/begin COMPU_VTAB ETC_Act_SY_Compu "" TAB_VERB 2 0 "False" 1 "True" /end COMPU_VTAB
/begin COMPU_METHOD ETHDETN_SC_Compu "" TAB_VERB "%6.3" "" COMPU_TAB_REF ETHDETN_SC_Compu /end COMPU_METHOD
/begin COMPU_VTAB ETHDETN_SC_Compu "" TAB_VERB 3 0 "ETHDETN_NO" 1 "ETHDETN_SNSR" 2 "ETHDETN_MDL" /end COMPU_VTAB
/begin COMPU_METHOD ETHTSYN_SC_Compu "" TAB_VERB "%6.3" "" COMPU_TAB_REF ETHTSYN_SC_Compu /end COMPU_METHOD
/begin COMPU_VTAB ETHTSYN_SC_Compu "" TAB_VERB 2 0 "False" 1 "True" /end COMPU_VTAB
/begin COMPU_METHOD ETH_SC_Compu "" TAB_VERB "%6.3" "" COMPU_TAB_REF ETH_SC_Compu /end COMPU_METHOD
/begin COMPU_VTAB ETH_SC_Compu "" TAB_VERB 2 0 "False" 1 "True" /end COMPU_VTAB
/begin COMPU_METHOD OneToOne "" RAT_FUNC "%6.2" "-" COEFFS 0 1 0 0 0 1 /end COMPU_METHOD
/begin COMPU_METHOD TempDiff_Kelv "" RAT_FUNC "%6.3" "K" COEFFS 0 10 0 0 0 1 /end COMPU_METHOD
/begin COMPU_METHOD Temp_Cels "" RAT_FUNC "%6.1" "deg C" COEFFS 0 10 2731.4 0 0 1 /end COMPU_METHOD
/begin RECORD_LAYOUT RB_ValA_Wu16 FNC_VALUES 1 UWORD COLUMN_DIR DIRECT /end RECORD_LAYOUT
/begin RECORD_LAYOUT ValA_Wu16 FNC_VALUES 1 UWORD COLUMN_DIR DIRECT /end RECORD_LAYOUT
/begin RECORD_LAYOUT ValA_Wu8 FNC_VALUES 1 UBYTE COLUMN_DIR DIRECT /end RECORD_LAYOUT
/begin RECORD_LAYOUT Val_Ws16 FNC_VALUES 1 SWORD COLUMN_DIR DIRECT /end RECORD_LAYOUT
/begin RECORD_LAYOUT Val_Wu16 FNC_VALUES 1 UWORD COLUMN_DIR DIRECT /end RECORD_LAYOUT
/begin RECORD_LAYOUT Val_Wu32 FNC_VALUES 1 ULONG COLUMN_DIR DIRECT /end RECORD_LAYOUT
/begin RECORD_LAYOUT Val_Wu8 FNC_VALUES 1 UBYTE COLUMN_DIR DIRECT /end RECORD_LAYOUT
/end MODULE
/end PROJECT
