ASAP2_VERSION 1 60
/begin PROJECT MG1CA020 "MG1CA020"
/begin HEADER "" VERSION "MG1CA020_6SAY_V011_TPROT" PROJECT_NO MG1CA020 /end HEADER
/begin MODULE DIM ""
/begin MOD_COMMON "" BYTE_ORDER MSB_LAST ALIGNMENT_BYTE 1 ALIGNMENT_WORD 2 ALIGNMENT_LONG 4 ALIGNMENT_INT64 4 ALIGNMENT_FLOAT32_IEEE 4 ALIGNMENT_FLOAT64_IEEE 4 DATA_SIZE 32 /end MOD_COMMON
/begin CHARACTERISTIC Devlib_PsDisbl.facLowHysLo_C "Structure containing hysterisis limits for battery voltage correction factor / Lower hysterisis limit for battery correction factor LOW." VALUE 0x8053AD28 Kw_Ws16 1.000000 Fact 0.00 1.000000 FORMAT "%8.6" EXTENDED_LIMITS -4.000000 3.999878 /end CHARACTERISTIC
/begin CHARACTERISTIC Devlib_PsDisbl.facLowHysHi_C "Structure containing hysterisis limits for battery voltage correction factor / Higher hysterisis limit for battery correction factor LOW." VALUE 0x8053AD2A Kw_Ws16 1.000000 Fact 0.00 1.000000 FORMAT "%8.6" EXTENDED_LIMITS -4.000000 3.999878 /end CHARACTERISTIC
/begin CHARACTERISTIC Devlib_PsDisbl.facHighHysLo_C "Structure containing hysterisis limits for battery voltage correction factor / Lower hysterisis limit for battery correction factor HIGH." VALUE 0x8053AD2C Kw_Ws16 2.000000 Fact 1.000000 3.000000 FORMAT "%8.6" EXTENDED_LIMITS -4.000000 3.999878 /end CHARACTERISTIC
/begin CHARACTERISTIC Devlib_PsDisbl.facHighHysHi_C "Structure containing hysterisis limits for battery voltage correction factor / Higher hysterisis limit for battery correction factor HIGH." VALUE 0x8053AD2E Kw_Ws16 2.000000 Fact 1.000000 3.000000 FORMAT "%8.6" EXTENDED_LIMITS -4.000000 3.999878 /end CHARACTERISTIC
/begin CHARACTERISTIC DevLib_PWMOutDbgSig_C "Calibration parameter to select the PWM out signal for which the debugging information is to be updated into the measuring points" VALUE 0x8053AD26 Val_Wu16 65535.00 OneToOne 0.00 65535.00 FORMAT "%8.2" /end CHARACTERISTIC
/begin CHARACTERISTIC Devlib_PwrStg.BattLoHysLo_C "Structure containing hysterisis check for battery voltage LOW/HIGH / Lower limit for battery voltage LOW hysterisis check." VALUE 0x8053AD30 Kw_Ws16 9000.000 Volt_Batt 3000.00 12000.00 FORMAT "%8.2" EXTENDED_LIMITS -655360.0 655340.0 /end CHARACTERISTIC
/begin CHARACTERISTIC Devlib_PwrStg.BattLoHysHi_C "Structure containing hysterisis check for battery voltage LOW/HIGH / Higher limit for battery voltage LOW hysterisis check" VALUE 0x8053AD32 Kw_Ws16 9000.000 Volt_Batt 3000.00 12000.00 FORMAT "%8.2" EXTENDED_LIMITS -655360.0 655340.0 /end CHARACTERISTIC
/begin CHARACTERISTIC Devlib_PwrStg.BattHiHysLo_C "Structure containing hysterisis check for battery voltage LOW/HIGH / Lower limit for battery voltage HIGH hysterisis check" VALUE 0x8053AD34 Kw_Ws16 24000.00 Volt_Batt 12000.00 36000.00 FORMAT "%8.2" EXTENDED_LIMITS -655360.0 655340.0 /end CHARACTERISTIC
/begin CHARACTERISTIC Devlib_PwrStg.BattHiHysHi_C "Structure containing hysterisis check for battery voltage LOW/HIGH / Upper limit for battery voltage HIGH hysterisis check" VALUE 0x8053AD36 Kw_Ws16 24000.00 Volt_Batt 12000.00 36000.00 FORMAT "%8.2" EXTENDED_LIMITS -655360.0 655340.0 /end CHARACTERISTIC
/begin MEASUREMENT DevLib_stPWMOutErr_mp "Measuring point that contains the error information received from HWE for the PWM out signal selected by DevLib_PWMOutDbgSig_C" ULONG OneToOne 1 100 0.00 4294967295.00 FORMAT "%13.2" ECU_ADDRESS 0x700087B8 /end MEASUREMENT
/begin MEASUREMENT DevLib_stPwrStgEnaCond "Device Library - state of powerstage enabling conditions" UWORD OneToOne 1 100 0.00 65535.00 FORMAT "%8.2" ECU_ADDRESS 0x60005372 /end MEASUREMENT
/begin MEASUREMENT DFC_b.TST_AltIOACGFailr "Bit encoding / Tested bit for check DFC_AltIOACGFailr" UBYTE DFC_OneToOne 1 100 0.00 1.000 BIT_MASK 0x8 FORMAT "%5.3" ECU_ADDRESS 0x60034A07 /end MEASUREMENT
/begin MEASUREMENT DFC_b.TST_AltIOACGHiVltg "Bit encoding / Tested bit for check DFC_AltIOACGHiVltg" UBYTE DFC_OneToOne 1 100 0.00 1.000 BIT_MASK 0x8 FORMAT "%5.3" ECU_ADDRESS 0x60034A08 /end MEASUREMENT
/begin MEASUREMENT DFC_b.TST_AltIOACGLoVltg "Bit encoding / Tested bit for check DFC_AltIOACGLoVltg" UBYTE DFC_OneToOne 1 100 0.00 1.000 BIT_MASK 0x8 FORMAT "%5.3" ECU_ADDRESS 0x60034A09 /end MEASUREMENT
/begin MEASUREMENT DFC_b.TST_AltIOACGTHi "Bit encoding / Tested bit for check DFC_AltIOACGTHi" UBYTE DFC_OneToOne 1 100 0.00 1.000 BIT_MASK 0x8 FORMAT "%5.3" ECU_ADDRESS 0x60034A0A /end MEASUREMENT
/begin MEASUREMENT DFC_b.TST_AltIODConnACG "Bit encoding / Tested bit for check DFC_AltIODConnACG" UBYTE DFC_OneToOne 1 100 0.00 1.000 BIT_MASK 0x8 FORMAT "%5.3" ECU_ADDRESS 0x60034A0B /end MEASUREMENT
/begin MEASUREMENT DFC_b.TST_BattUHiFailr "Bit encoding / Tested bit for check DFC_BattUHiFailr" UBYTE DFC_OneToOne 1 100 0.00 1.000 BIT_MASK 0x8 FORMAT "%5.3" ECU_ADDRESS 0x60034A0C /end MEASUREMENT
/begin MEASUREMENT DFC_b.TST_BattULoFailr "Bit encoding / Tested bit for check DFC_BattULoFailr" UBYTE DFC_OneToOne 1 100 0.00 1.000 BIT_MASK 0x8 FORMAT "%5.3" ECU_ADDRESS 0x60034A0D /end MEASUREMENT
/begin MEASUREMENT DFC_b.TST_BrkBstPDriftHiErr "Bit encoding / Tested bit for check DFC_BrkBstPDriftHiErr" UBYTE DFC_OneToOne 1 100 0.00 1.000 BIT_MASK 0x8 FORMAT "%5.3" ECU_ADDRESS 0x60034A0E /end MEASUREMENT
/begin MEASUREMENT DFC_b.TST_BrkBstPDriftLoErr "Bit encoding / Tested bit for check DFC_BrkBstPDriftLoErr" UBYTE DFC_OneToOne 1 100 0.00 1.000 BIT_MASK 0x8 FORMAT "%5.3" ECU_ADDRESS 0x60034A0F /end MEASUREMENT
/begin MEASUREMENT DFC_b.TST_BrkBstPSnsrStuck "Bit encoding / Tested bit for check DFC_BrkBstPSnsrStuck" UBYTE DFC_OneToOne 1 100 0.00 1.000 BIT_MASK 0x8 FORMAT "%5.3" ECU_ADDRESS 0x60034A10 /end MEASUREMENT
/begin MEASUREMENT DFC_b.TST_BrkMnSwtContOn "Bit encoding / Tested bit for check DFC_BrkMnSwtContOn" UBYTE DFC_OneToOne 1 100 0.00 1.000 BIT_MASK 0x8 FORMAT "%5.3" ECU_ADDRESS 0x60034A11 /end MEASUREMENT
/begin MEASUREMENT DFC_b.TST_BrkMnSwtNotStp "Bit encoding / Tested bit for check DFC_BrkMnSwtNotStp" UBYTE DFC_OneToOne 1 100 0.00 1.000 BIT_MASK 0x8 FORMAT "%5.3" ECU_ADDRESS 0x60034A12 /end MEASUREMENT
/begin MEASUREMENT DFC_b.TST_BrkNpl "Bit encoding / Tested bit for check DFC_BrkNpl" UBYTE DFC_OneToOne 1 100 0.00 1.000 BIT_MASK 0x8 FORMAT "%5.3" ECU_ADDRESS 0x60034A13 /end MEASUREMENT
/begin MEASUREMENT DFC_b.TST_BrkRdntSwtContOn "Bit encoding / Tested bit for check DFC_BrkRdntSwtContOn" UBYTE DFC_OneToOne 1 100 0.00 1.000 BIT_MASK 0x8 FORMAT "%5.3" ECU_ADDRESS 0x60034A14 /end MEASUREMENT
/begin MEASUREMENT DFC_b.TST_BrkRdntSwtNotStp "Bit encoding / Tested bit for check DFC_BrkRdntSwtNotStp" UBYTE DFC_OneToOne 1 100 0.00 1.000 BIT_MASK 0x8 FORMAT "%5.3" ECU_ADDRESS 0x60034A15 /end MEASUREMENT
/begin MEASUREMENT DFC_b.TST_Clth3ONStuck "Bit encoding / Tested bit for check DFC_Clth3ONStuck" UBYTE DFC_OneToOne 1 100 0.00 1.000 BIT_MASK 0x8 FORMAT "%5.3" ECU_ADDRESS 0x60034A16 /end MEASUREMENT
/begin MEASUREMENT DFC_b.TST_Clth4OFFStuck "Bit encoding / Tested bit for check DFC_Clth4OFFStuck" UBYTE DFC_OneToOne 1 100 0.00 1.000 BIT_MASK 0x8 FORMAT "%5.3" ECU_ADDRESS 0x60034A17 /end MEASUREMENT
/begin MEASUREMENT DFC_b.TST_ClthOFFStuck "Bit encoding / Tested bit for check DFC_ClthOFFStuck" UBYTE DFC_OneToOne 1 100 0.00 1.000 BIT_MASK 0x8 FORMAT "%5.3" ECU_ADDRESS 0x60034A18 /end MEASUREMENT
/begin MEASUREMENT DFC_b.TST_ClthONStuck "Bit encoding / Tested bit for check DFC_ClthONStuck" UBYTE DFC_OneToOne 1 100 0.00 1.000 BIT_MASK 0x8 FORMAT "%5.3" ECU_ADDRESS 0x60034A19 /end MEASUREMENT
/begin MEASUREMENT DFC_b.TST_ClthStkFailInfo "Bit encoding / Tested bit for check DFC_ClthStkFailInfo" UBYTE DFC_OneToOne 1 100 0.00 1.000 BIT_MASK 0x8 FORMAT "%5.3" ECU_ADDRESS 0x60034A1A /end MEASUREMENT
/begin MEASUREMENT DFC_b.TST_ComACFailInfo "Bit encoding / Tested bit for check DFC_ComACFailInfo" UBYTE DFC_OneToOne 1 100 0.00 1.000 BIT_MASK 0x8 FORMAT "%5.3" ECU_ADDRESS 0x60034A1B /end MEASUREMENT
/begin MEASUREMENT DFC_b.TST_ComATFTValErr "Bit encoding / Tested bit for check DFC_ComATFTValErr" UBYTE DFC_OneToOne 1 100 0.00 1.000 BIT_MASK 0x8 FORMAT "%5.3" ECU_ADDRESS 0x60034A1C /end MEASUREMENT
/begin MEASUREMENT DFC_b.TST_ComATMILReq "Bit encoding / Tested bit for check DFC_ComATMILReq" UBYTE DFC_OneToOne 1 100 0.00 1.000 BIT_MASK 0x8 FORMAT "%5.3" ECU_ADDRESS 0x60034A1D /end MEASUREMENT
/begin MEASUREMENT DFC_b.TST_ComAYCAChksum "Bit encoding / Tested bit for check DFC_ComAYCAChksum" UBYTE DFC_OneToOne 1 100 0.00 1.000 BIT_MASK 0x8 FORMAT "%5.3" ECU_ADDRESS 0x60034A1E /end MEASUREMENT
/begin MEASUREMENT DFC_b.TST_ComAYCARingCnt "Bit encoding / Tested bit for check DFC_ComAYCARingCnt" UBYTE DFC_OneToOne 1 100 0.00 1.000 BIT_MASK 0x8 FORMAT "%5.3" ECU_ADDRESS 0x60034A1F /end MEASUREMENT
/begin MEASUREMENT DFC_b.TST_ComAYCATOut "Bit encoding / Tested bit for check DFC_ComAYCATOut" UBYTE DFC_OneToOne 1 100 0.00 1.000 BIT_MASK 0x8 FORMAT "%5.3" ECU_ADDRESS 0x60034A20 /end MEASUREMENT
/begin MEASUREMENT DFC_b.TST_ComAYCDChkSum "Bit encoding / Tested bit for check DFC_ComAYCDChkSum" UBYTE DFC_OneToOne 1 100 0.00 1.000 BIT_MASK 0x8 FORMAT "%5.3" ECU_ADDRESS 0x60034A21 /end MEASUREMENT
/begin MEASUREMENT DFC_b.TST_ComAYCDTOut "Bit encoding / Tested bit for check DFC_ComAYCDTOut" UBYTE DFC_OneToOne 1 100 0.00 1.000 BIT_MASK 0x8 FORMAT "%5.3" ECU_ADDRESS 0x60034A22 /end MEASUREMENT
/begin MEASUREMENT DFC_b.TST_ComAYCFChksum "Bit encoding / Tested bit for check DFC_ComAYCFChksum" UBYTE DFC_OneToOne 1 100 0.00 1.000 BIT_MASK 0x8 FORMAT "%5.3" ECU_ADDRESS 0x60034A23 /end MEASUREMENT
/begin MEASUREMENT DFC_b.TST_ComAYCFRingCnt "Bit encoding / Tested bit for check DFC_ComAYCFRingCnt" UBYTE DFC_OneToOne 1 100 0.00 1.000 BIT_MASK 0x8 FORMAT "%5.3" ECU_ADDRESS 0x60034A24 /end MEASUREMENT
/begin MEASUREMENT DFC_b.TST_ComAYCFTOut "Bit encoding / Tested bit for check DFC_ComAYCFTOut" UBYTE DFC_OneToOne 1 100 0.00 1.000 BIT_MASK 0x8 FORMAT "%5.3" ECU_ADDRESS 0x60034A25 /end MEASUREMENT
/begin MEASUREMENT DFC_b.TST_ComAYCGChksum "Bit encoding / Tested bit for check DFC_ComAYCGChksum" UBYTE DFC_OneToOne 1 100 0.00 1.000 BIT_MASK 0x8 FORMAT "%5.3" ECU_ADDRESS 0x60034A26 /end MEASUREMENT
/begin MEASUREMENT DFC_b.TST_ComAYCGRingCnt "Bit encoding / Tested bit for check DFC_ComAYCGRingCnt" UBYTE DFC_OneToOne 1 100 0.00 1.000 BIT_MASK 0x8 FORMAT "%5.3" ECU_ADDRESS 0x60034A27 /end MEASUREMENT
/begin MEASUREMENT DFC_b.TST_ComAYCGTOut "Bit encoding / Tested bit for check DFC_ComAYCGTOut" UBYTE DFC_OneToOne 1 100 0.00 1.000 BIT_MASK 0x8 FORMAT "%5.3" ECU_ADDRESS 0x60034A28 /end MEASUREMENT
/begin MEASUREMENT DFC_b.TST_ComAYCIChkSum "Bit encoding / Tested bit for check DFC_ComAYCIChkSum" UBYTE DFC_OneToOne 1 100 0.00 1.000 BIT_MASK 0x8 FORMAT "%5.3" ECU_ADDRESS 0x60034A29 /end MEASUREMENT
/begin MEASUREMENT DFC_b.TST_ComAYCIRingCnt "Bit encoding / Tested bit for check DFC_ComAYCIRingCnt" UBYTE DFC_OneToOne 1 100 0.00 1.000 BIT_MASK 0x8 FORMAT "%5.3" ECU_ADDRESS 0x60034A2A /end MEASUREMENT
/begin MEASUREMENT DFC_b.TST_ComAYCITOut "Bit encoding / Tested bit for check DFC_ComAYCITOut" UBYTE DFC_OneToOne 1 100 0.00 1.000 BIT_MASK 0x8 FORMAT "%5.3" ECU_ADDRESS 0x60034A2B /end MEASUREMENT
/begin MEASUREMENT DFC_b.TST_ComBCM1ChkSum "Bit encoding / Tested bit for check DFC_ComBCM1ChkSum" UBYTE DFC_OneToOne 1 100 0.00 1.000 BIT_MASK 0x8 FORMAT "%5.3" ECU_ADDRESS 0x60034A2C /end MEASUREMENT
/begin MEASUREMENT DFC_b.TST_ComBCM1RingCnt "Bit encoding / Tested bit for check DFC_ComBCM1RingCnt" UBYTE DFC_OneToOne 1 100 0.00 1.000 BIT_MASK 0x8 FORMAT "%5.3" ECU_ADDRESS 0x60034A2D /end MEASUREMENT
/begin MEASUREMENT DFC_b.TST_ComBCM1TOut "Bit encoding / Tested bit for check DFC_ComBCM1TOut" UBYTE DFC_OneToOne 1 100 0.00 1.000 BIT_MASK 0x8 FORMAT "%5.3" ECU_ADDRESS 0x60034A2E /end MEASUREMENT
/begin MEASUREMENT DFC_b.TST_ComCANABusOffErr "Bit encoding / Tested bit for check DFC_ComCANABusOffErr" UBYTE DFC_OneToOne 1 100 0.00 1.000 BIT_MASK 0x8 FORMAT "%5.3" ECU_ADDRESS 0x60034A2F /end MEASUREMENT
/begin MEASUREMENT DFC_b.TST_ComCANBBusOffErr "Bit encoding / Tested bit for check DFC_ComCANBBusOffErr" UBYTE DFC_OneToOne 1 100 0.00 1.000 BIT_MASK 0x8 FORMAT "%5.3" ECU_ADDRESS 0x60034A30 /end MEASUREMENT
/begin MEASUREMENT DFC_b.TST_ComCANCBusOffErr "Bit encoding / Tested bit for check DFC_ComCANCBusOffErr" UBYTE DFC_OneToOne 1 100 0.00 1.000 BIT_MASK 0x8 FORMAT "%5.3" ECU_ADDRESS 0x60034A31 /end MEASUREMENT
/begin MEASUREMENT DFC_b.TST_ComCGW1ChkSum "Bit encoding / Tested bit for check DFC_ComCGW1ChkSum" UBYTE DFC_OneToOne 1 100 0.00 1.000 BIT_MASK 0x8 FORMAT "%5.3" ECU_ADDRESS 0x60034A32 /end MEASUREMENT
/begin MEASUREMENT DFC_b.TST_ComCGW1RingCnt "Bit encoding / Tested bit for check DFC_ComCGW1RingCnt" UBYTE DFC_OneToOne 1 100 0.00 1.000 BIT_MASK 0x8 FORMAT "%5.3" ECU_ADDRESS 0x60034A33 /end MEASUREMENT
/begin MEASUREMENT DFC_b.TST_ComCGW1TOut "Bit encoding / Tested bit for check DFC_ComCGW1TOut" UBYTE DFC_OneToOne 1 100 0.00 1.000 BIT_MASK 0x8 FORMAT "%5.3" ECU_ADDRESS 0x60034A34 /end MEASUREMENT
/begin MEASUREMENT DFC_b.TST_ComConvBoostErr "Bit encoding / Tested bit for check DFC_ComConvBoostErr" UBYTE DFC_OneToOne 1 100 0.00 1.000 BIT_MASK 0x8 FORMAT "%5.3" ECU_ADDRESS 0x60034A35 /end MEASUREMENT
/begin MEASUREMENT DFC_b.TST_ComConvSlipErr "Bit encoding / Tested bit for check DFC_ComConvSlipErr" UBYTE DFC_OneToOne 1 100 0.00 1.000 BIT_MASK 0x8 FORMAT "%5.3" ECU_ADDRESS 0x60034A36 /end MEASUREMENT
/begin MEASUREMENT DFC_b.TST_ComEAT10Chksum "Bit encoding / Tested bit for check DFC_ComEAT10Chksum" UBYTE DFC_OneToOne 1 100 0.00 1.000 BIT_MASK 0x8 FORMAT "%5.3" ECU_ADDRESS 0x60034A37 /end MEASUREMENT
/begin MEASUREMENT DFC_b.TST_ComEAT10RingCnt "Bit encoding / Tested bit for check DFC_ComEAT10RingCnt" UBYTE DFC_OneToOne 1 100 0.00 1.000 BIT_MASK 0x8 FORMAT "%5.3" ECU_ADDRESS 0x60034A38 /end MEASUREMENT
/begin MEASUREMENT DFC_b.TST_ComEAT10TOut "Bit encoding / Tested bit for check DFC_ComEAT10TOut" UBYTE DFC_OneToOne 1 100 0.00 1.000 BIT_MASK 0x8 FORMAT "%5.3" ECU_ADDRESS 0x60034A39 /end MEASUREMENT
/begin MEASUREMENT DFC_b.TST_ComEAT11ChkSum "Bit encoding / Tested bit for check DFC_ComEAT11ChkSum" UBYTE DFC_OneToOne 1 100 0.00 1.000 BIT_MASK 0x8 FORMAT "%5.3" ECU_ADDRESS 0x60034A3A /end MEASUREMENT
/begin MEASUREMENT DFC_b.TST_ComEAT11RingCnt "Bit encoding / Tested bit for check DFC_ComEAT11RingCnt" UBYTE DFC_OneToOne 1 100 0.00 1.000 BIT_MASK 0x8 FORMAT "%5.3" ECU_ADDRESS 0x60034A3B /end MEASUREMENT
/begin MEASUREMENT DFC_b.TST_ComEAT11TOut "Bit encoding / Tested bit for check DFC_ComEAT11TOut" UBYTE DFC_OneToOne 1 100 0.00 1.000 BIT_MASK 0x8 FORMAT "%5.3" ECU_ADDRESS 0x60034A3C /end MEASUREMENT
/begin MEASUREMENT DFC_b.TST_ComEAT12ChkSum "Bit encoding / Tested bit for check DFC_ComEAT12ChkSum" UBYTE DFC_OneToOne 1 100 0.00 1.000 BIT_MASK 0x8 FORMAT "%5.3" ECU_ADDRESS 0x60034A3D /end MEASUREMENT
/begin MEASUREMENT DFC_b.TST_ComEAT12RingCnt "Bit encoding / Tested bit for check DFC_ComEAT12RingCnt" UBYTE DFC_OneToOne 1 100 0.00 1.000 BIT_MASK 0x8 FORMAT "%5.3" ECU_ADDRESS 0x60034A3E /end MEASUREMENT
/begin MEASUREMENT DFC_b.TST_ComEAT12TOut "Bit encoding / Tested bit for check DFC_ComEAT12TOut" UBYTE DFC_OneToOne 1 100 0.00 1.000 BIT_MASK 0x8 FORMAT "%5.3" ECU_ADDRESS 0x60034A3F /end MEASUREMENT
/begin MEASUREMENT DFC_b.TST_ComEAT13ChkSum "Bit encoding / Tested bit for check DFC_ComEAT13ChkSum" UBYTE DFC_OneToOne 1 100 0.00 1.000 BIT_MASK 0x8 FORMAT "%5.3" ECU_ADDRESS 0x60034A40 /end MEASUREMENT
/begin MEASUREMENT DFC_b.TST_ComEAT13RingCnt "Bit encoding / Tested bit for check DFC_ComEAT13RingCnt" UBYTE DFC_OneToOne 1 100 0.00 1.000 BIT_MASK 0x8 FORMAT "%5.3" ECU_ADDRESS 0x60034A41 /end MEASUREMENT
/begin MEASUREMENT DFC_b.TST_ComEAT13TOut "Bit encoding / Tested bit for check DFC_ComEAT13TOut" UBYTE DFC_OneToOne 1 100 0.00 1.000 BIT_MASK 0x8 FORMAT "%5.3" ECU_ADDRESS 0x60034A42 /end MEASUREMENT
/begin MEASUREMENT DFC_b.TST_ComEAT1Chksum "Bit encoding / Tested bit for check DFC_ComEAT1Chksum" UBYTE DFC_OneToOne 1 100 0.00 1.000 BIT_MASK 0x8 FORMAT "%5.3" ECU_ADDRESS 0x60034A43 /end MEASUREMENT
/begin MEASUREMENT DFC_b.TST_ComEAT1RingCnt "Bit encoding / Tested bit for check DFC_ComEAT1RingCnt" UBYTE DFC_OneToOne 1 100 0.00 1.000 BIT_MASK 0x8 FORMAT "%5.3" ECU_ADDRESS 0x60034A44 /end MEASUREMENT
/begin MEASUREMENT DFC_b.TST_ComEAT1TOut "Bit encoding / Tested bit for check DFC_ComEAT1TOut" UBYTE DFC_OneToOne 1 100 0.00 1.000 BIT_MASK 0x8 FORMAT "%5.3" ECU_ADDRESS 0x60034A45 /end MEASUREMENT
/begin MEASUREMENT DFC_b.TST_ComEAT2ChkSum "Bit encoding / Tested bit for check DFC_ComEAT2ChkSum" UBYTE DFC_OneToOne 1 100 0.00 1.000 BIT_MASK 0x8 FORMAT "%5.3" ECU_ADDRESS 0x60034A46 /end MEASUREMENT
/begin MEASUREMENT DFC_b.TST_ComEAT2RingCnt "Bit encoding / Tested bit for check DFC_ComEAT2RingCnt" UBYTE DFC_OneToOne 1 100 0.00 1.000 BIT_MASK 0x8 FORMAT "%5.3" ECU_ADDRESS 0x60034A47 /end MEASUREMENT
/begin MEASUREMENT DFC_b.TST_ComEAT2TOut "Bit encoding / Tested bit for check DFC_ComEAT2TOut" UBYTE DFC_OneToOne 1 100 0.00 1.000 BIT_MASK 0x8 FORMAT "%5.3" ECU_ADDRESS 0x60034A48 /end MEASUREMENT
/begin MEASUREMENT DFC_b.TST_ComEAT4ChkSum "Bit encoding / Tested bit for check DFC_ComEAT4ChkSum" UBYTE DFC_OneToOne 1 100 0.00 1.000 BIT_MASK 0x8 FORMAT "%5.3" ECU_ADDRESS 0x60034A49 /end MEASUREMENT
/begin MEASUREMENT DFC_b.TST_ComEAT4RingCnt "Bit encoding / Tested bit for check DFC_ComEAT4RingCnt" UBYTE DFC_OneToOne 1 100 0.00 1.000 BIT_MASK 0x8 FORMAT "%5.3" ECU_ADDRESS 0x60034A4A /end MEASUREMENT
/begin MEASUREMENT DFC_b.TST_ComEAT4TOut "Bit encoding / Tested bit for check DFC_ComEAT4TOut" UBYTE DFC_OneToOne 1 100 0.00 1.000 BIT_MASK 0x8 FORMAT "%5.3" ECU_ADDRESS 0x60034A4B /end MEASUREMENT
/begin MEASUREMENT DFC_b.TST_ComEAT6Chksum "Bit encoding / Tested bit for check DFC_ComEAT6Chksum" UBYTE DFC_OneToOne 1 100 0.00 1.000 BIT_MASK 0x8 FORMAT "%5.3" ECU_ADDRESS 0x60034A4C /end MEASUREMENT
/begin MEASUREMENT DFC_b.TST_ComEAT6RingCnt "Bit encoding / Tested bit for check DFC_ComEAT6RingCnt" UBYTE DFC_OneToOne 1 100 0.00 1.000 BIT_MASK 0x8 FORMAT "%5.3" ECU_ADDRESS 0x60034A4D /end MEASUREMENT
/begin MEASUREMENT DFC_b.TST_ComEAT6TOut "Bit encoding / Tested bit for check DFC_ComEAT6TOut" UBYTE DFC_OneToOne 1 100 0.00 1.000 BIT_MASK 0x8 FORMAT "%5.3" ECU_ADDRESS 0x60034A4E /end MEASUREMENT
/begin MEASUREMENT DFC_b.TST_ComEAT7Chksum "Bit encoding / Tested bit for check DFC_ComEAT7Chksum" UBYTE DFC_OneToOne 1 100 0.00 1.000 BIT_MASK 0x8 FORMAT "%5.3" ECU_ADDRESS 0x60034A4F /end MEASUREMENT
/begin MEASUREMENT DFC_b.TST_ComEAT7RingCnt "Bit encoding / Tested bit for check DFC_ComEAT7RingCnt" UBYTE DFC_OneToOne 1 100 0.00 1.000 BIT_MASK 0x8 FORMAT "%5.3" ECU_ADDRESS 0x60034A50 /end MEASUREMENT
/begin MEASUREMENT DFC_b.TST_ComEAT7TOut "Bit encoding / Tested bit for check DFC_ComEAT7TOut" UBYTE DFC_OneToOne 1 100 0.00 1.000 BIT_MASK 0x8 FORMAT "%5.3" ECU_ADDRESS 0x60034A51 /end MEASUREMENT
/begin MEASUREMENT DFC_b.TST_ComEAT8Chksum "Bit encoding / Tested bit for check DFC_ComEAT8Chksum" UBYTE DFC_OneToOne 1 100 0.00 1.000 BIT_MASK 0x8 FORMAT "%5.3" ECU_ADDRESS 0x60034A52 /end MEASUREMENT
/begin MEASUREMENT DFC_b.TST_ComEAT8RingCnt "Bit encoding / Tested bit for check DFC_ComEAT8RingCnt" UBYTE DFC_OneToOne 1 100 0.00 1.000 BIT_MASK 0x8 FORMAT "%5.3" ECU_ADDRESS 0x60034A53 /end MEASUREMENT
/begin MEASUREMENT DFC_b.TST_ComEAT8TOut "Bit encoding / Tested bit for check DFC_ComEAT8TOut" UBYTE DFC_OneToOne 1 100 0.00 1.000 BIT_MASK 0x8 FORMAT "%5.3" ECU_ADDRESS 0x60034A54 /end MEASUREMENT
/begin MEASUREMENT DFC_b.TST_ComEATAChksum "Bit encoding / Tested bit for check DFC_ComEATAChksum" UBYTE DFC_OneToOne 1 100 0.00 1.000 BIT_MASK 0x8 FORMAT "%5.3" ECU_ADDRESS 0x60034A55 /end MEASUREMENT
/begin MEASUREMENT DFC_b.TST_ComEATARingCnt "Bit encoding / Tested bit for check DFC_ComEATARingCnt" UBYTE DFC_OneToOne 1 100 0.00 1.000 BIT_MASK 0x8 FORMAT "%5.3" ECU_ADDRESS 0x60034A56 /end MEASUREMENT
/begin MEASUREMENT DFC_b.TST_ComEATATOut "Bit encoding / Tested bit for check DFC_ComEATATOut" UBYTE DFC_OneToOne 1 100 0.00 1.000 BIT_MASK 0x8 FORMAT "%5.3" ECU_ADDRESS 0x60034A57 /end MEASUREMENT
/begin MEASUREMENT DFC_b.TST_ComEATBChkSum "Bit encoding / Tested bit for check DFC_ComEATBChkSum" UBYTE DFC_OneToOne 1 100 0.00 1.000 BIT_MASK 0x8 FORMAT "%5.3" ECU_ADDRESS 0x60034A58 /end MEASUREMENT
/begin MEASUREMENT DFC_b.TST_ComEATBRingCnt "Bit encoding / Tested bit for check DFC_ComEATBRingCnt" UBYTE DFC_OneToOne 1 100 0.00 1.000 BIT_MASK 0x8 FORMAT "%5.3" ECU_ADDRESS 0x60034A59 /end MEASUREMENT
/begin MEASUREMENT DFC_b.TST_ComEATBTOut "Bit encoding / Tested bit for check DFC_ComEATBTOut" UBYTE DFC_OneToOne 1 100 0.00 1.000 BIT_MASK 0x8 FORMAT "%5.3" ECU_ADDRESS 0x60034A5A /end MEASUREMENT
/begin MEASUREMENT DFC_b.TST_ComEATCChksum "Bit encoding / Tested bit for check DFC_ComEATCChksum" UBYTE DFC_OneToOne 1 100 0.00 1.000 BIT_MASK 0x8 FORMAT "%5.3" ECU_ADDRESS 0x60034A5B /end MEASUREMENT
/begin MEASUREMENT DFC_b.TST_ComEATCRingCnt "Bit encoding / Tested bit for check DFC_ComEATCRingCnt" UBYTE DFC_OneToOne 1 100 0.00 1.000 BIT_MASK 0x8 FORMAT "%5.3" ECU_ADDRESS 0x60034A5C /end MEASUREMENT
/begin MEASUREMENT DFC_b.TST_ComEATCTOut "Bit encoding / Tested bit for check DFC_ComEATCTOut" UBYTE DFC_OneToOne 1 100 0.00 1.000 BIT_MASK 0x8 FORMAT "%5.3" ECU_ADDRESS 0x60034A5D /end MEASUREMENT
/begin MEASUREMENT DFC_b.TST_ComEBBAChksum "Bit encoding / Tested bit for check DFC_ComEBBAChksum" UBYTE DFC_OneToOne 1 100 0.00 1.000 BIT_MASK 0x8 FORMAT "%5.3" ECU_ADDRESS 0x60034A5E /end MEASUREMENT
/begin MEASUREMENT DFC_b.TST_ComEBBARingCnt "Bit encoding / Tested bit for check DFC_ComEBBARingCnt" UBYTE DFC_OneToOne 1 100 0.00 1.000 BIT_MASK 0x8 FORMAT "%5.3" ECU_ADDRESS 0x60034A5F /end MEASUREMENT
/begin MEASUREMENT DFC_b.TST_ComEBBATOut "Bit encoding / Tested bit for check DFC_ComEBBATOut" UBYTE DFC_OneToOne 1 100 0.00 1.000 BIT_MASK 0x8 FORMAT "%5.3" ECU_ADDRESS 0x60034A60 /end MEASUREMENT
/begin MEASUREMENT DFC_b.TST_ComEPS1Chksum "Bit encoding / Tested bit for check DFC_ComEPS1Chksum" UBYTE DFC_OneToOne 1 100 0.00 1.000 BIT_MASK 0x8 FORMAT "%5.3" ECU_ADDRESS 0x60034A61 /end MEASUREMENT
/begin MEASUREMENT DFC_b.TST_ComEPS1RingCnt "Bit encoding / Tested bit for check DFC_ComEPS1RingCnt" UBYTE DFC_OneToOne 1 100 0.00 1.000 BIT_MASK 0x8 FORMAT "%5.3" ECU_ADDRESS 0x60034A62 /end MEASUREMENT
/begin MEASUREMENT DFC_b.TST_ComEPS1TOut "Bit encoding / Tested bit for check DFC_ComEPS1TOut" UBYTE DFC_OneToOne 1 100 0.00 1.000 BIT_MASK 0x8 FORMAT "%5.3" ECU_ADDRESS 0x60034A63 /end MEASUREMENT
/begin MEASUREMENT DFC_b.TST_ComEngCanRxErr "Bit encoding / Tested bit for check DFC_ComEngCanRxErr" UBYTE DFC_OneToOne 1 100 0.00 1.000 BIT_MASK 0x8 FORMAT "%5.3" ECU_ADDRESS 0x60034A64 /end MEASUREMENT
/begin MEASUREMENT DFC_b.TST_ComGrvySnsrErr "Bit encoding / Tested bit for check DFC_ComGrvySnsrErr" UBYTE DFC_OneToOne 1 100 0.00 1.000 BIT_MASK 0x8 FORMAT "%5.3" ECU_ADDRESS 0x60034A65 /end MEASUREMENT
/begin MEASUREMENT DFC_b.TST_ComGwIMG1ChkSum "Bit encoding / Tested bit for check DFC_ComGwIMG1ChkSum" UBYTE DFC_OneToOne 1 100 0.00 1.000 BIT_MASK 0x8 FORMAT "%5.3" ECU_ADDRESS 0x60034A66 /end MEASUREMENT
/begin MEASUREMENT DFC_b.TST_ComGwIMG1RingCnt "Bit encoding / Tested bit for check DFC_ComGwIMG1RingCnt" UBYTE DFC_OneToOne 1 100 0.00 1.000 BIT_MASK 0x8 FORMAT "%5.3" ECU_ADDRESS 0x60034A67 /end MEASUREMENT
/begin MEASUREMENT DFC_b.TST_ComGwIMG1TOut "Bit encoding / Tested bit for check DFC_ComGwIMG1TOut" UBYTE DFC_OneToOne 1 100 0.00 1.000 BIT_MASK 0x8 FORMAT "%5.3" ECU_ADDRESS 0x60034A68 /end MEASUREMENT
/begin MEASUREMENT DFC_b.TST_ComGwIMG3ChkSum "Bit encoding / Tested bit for check DFC_ComGwIMG3ChkSum" UBYTE DFC_OneToOne 1 100 0.00 1.000 BIT_MASK 0x8 FORMAT "%5.3" ECU_ADDRESS 0x60034A69 /end MEASUREMENT
/begin MEASUREMENT DFC_b.TST_ComGwIMG3RingCnt "Bit encoding / Tested bit for check DFC_ComGwIMG3RingCnt" UBYTE DFC_OneToOne 1 100 0.00 1.000 BIT_MASK 0x8 FORMAT "%5.3" ECU_ADDRESS 0x60034A6A /end MEASUREMENT
/begin MEASUREMENT DFC_b.TST_ComGwIMG3TOut "Bit encoding / Tested bit for check DFC_ComGwIMG3TOut" UBYTE DFC_OneToOne 1 100 0.00 1.000 BIT_MASK 0x8 FORMAT "%5.3" ECU_ADDRESS 0x60034A6B /end MEASUREMENT
/begin MEASUREMENT DFC_b.TST_ComGwIMG4ChkSum "Bit encoding / Tested bit for check DFC_ComGwIMG4ChkSum" UBYTE DFC_OneToOne 1 100 0.00 1.000 BIT_MASK 0x8 FORMAT "%5.3" ECU_ADDRESS 0x60034A6C /end MEASUREMENT
/begin MEASUREMENT DFC_b.TST_ComGwIMG4RingCnt "Bit encoding / Tested bit for check DFC_ComGwIMG4RingCnt" UBYTE DFC_OneToOne 1 100 0.00 1.000 BIT_MASK 0x8 FORMAT "%5.3" ECU_ADDRESS 0x60034A6D /end MEASUREMENT
/begin MEASUREMENT DFC_b.TST_ComGwIMG4TOut "Bit encoding / Tested bit for check DFC_ComGwIMG4TOut" UBYTE DFC_OneToOne 1 100 0.00 1.000 BIT_MASK 0x8 FORMAT "%5.3" ECU_ADDRESS 0x60034A6E /end MEASUREMENT
/begin MEASUREMENT DFC_b.TST_ComGwIMG5ChkSum "Bit encoding / Tested bit for check DFC_ComGwIMG5ChkSum" UBYTE DFC_OneToOne 1 100 0.00 1.000 BIT_MASK 0x8 FORMAT "%5.3" ECU_ADDRESS 0x60034A6F /end MEASUREMENT
/begin MEASUREMENT DFC_b.TST_ComGwIMG5RingCnt "Bit encoding / Tested bit for check DFC_ComGwIMG5RingCnt" UBYTE DFC_OneToOne 1 100 0.00 1.000 BIT_MASK 0x8 FORMAT "%5.3" ECU_ADDRESS 0x60034A70 /end MEASUREMENT
/begin MEASUREMENT DFC_b.TST_ComGwIMG5TOut "Bit encoding / Tested bit for check DFC_ComGwIMG5TOut" UBYTE DFC_OneToOne 1 100 0.00 1.000 BIT_MASK 0x8 FORMAT "%5.3" ECU_ADDRESS 0x60034A71 /end MEASUREMENT
/begin MEASUREMENT DFC_b.TST_ComGwIMG6ChkSum "Bit encoding / Tested bit for check DFC_ComGwIMG6ChkSum" UBYTE DFC_OneToOne 1 100 0.00 1.000 BIT_MASK 0x8 FORMAT "%5.3" ECU_ADDRESS 0x60034A72 /end MEASUREMENT
/begin MEASUREMENT DFC_b.TST_ComGwIMG6RingCnt "Bit encoding / Tested bit for check DFC_ComGwIMG6RingCnt" UBYTE DFC_OneToOne 1 100 0.00 1.000 BIT_MASK 0x8 FORMAT "%5.3" ECU_ADDRESS 0x60034A73 /end MEASUREMENT
/begin MEASUREMENT DFC_b.TST_ComGwIMG6TOut "Bit encoding / Tested bit for check DFC_ComGwIMG6TOut" UBYTE DFC_OneToOne 1 100 0.00 1.000 BIT_MASK 0x8 FORMAT "%5.3" ECU_ADDRESS 0x60034A74 /end MEASUREMENT
/begin MEASUREMENT DFC_b.TST_ComIDASBChksum "Bit encoding / Tested bit for check DFC_ComIDASBChksum" UBYTE DFC_OneToOne 1 100 0.00 1.000 BIT_MASK 0x8 FORMAT "%5.3" ECU_ADDRESS 0x60034A75 /end MEASUREMENT
/begin MEASUREMENT DFC_b.TST_ComIDASBRingCnt "Bit encoding / Tested bit for check DFC_ComIDASBRingCnt" UBYTE DFC_OneToOne 1 100 0.00 1.000 BIT_MASK 0x8 FORMAT "%5.3" ECU_ADDRESS 0x60034A76 /end MEASUREMENT
/begin MEASUREMENT DFC_b.TST_ComIDASBTOut "Bit encoding / Tested bit for check DFC_ComIDASBTOut" UBYTE DFC_OneToOne 1 100 0.00 1.000 BIT_MASK 0x8 FORMAT "%5.3" ECU_ADDRESS 0x60034A77 /end MEASUREMENT
/begin MEASUREMENT DFC_b.TST_ComIMGMILReq "Bit encoding / Tested bit for check DFC_ComIMGMILReq" UBYTE DFC_OneToOne 1 100 0.00 1.000 BIT_MASK 0x8 FORMAT "%5.3" ECU_ADDRESS 0x60034A78 /end MEASUREMENT
/begin MEASUREMENT DFC_b.TST_ComISSPrms "Bit encoding / Tested bit for check DFC_ComISSPrms" UBYTE DFC_OneToOne 1 100 0.00 1.000 BIT_MASK 0x8 FORMAT "%5.3" ECU_ADDRESS 0x60034A79 /end MEASUREMENT
/begin MEASUREMENT DFC_b.TST_ComMETAChksum "Bit encoding / Tested bit for check DFC_ComMETAChksum" UBYTE DFC_OneToOne 1 100 0.00 1.000 BIT_MASK 0x8 FORMAT "%5.3" ECU_ADDRESS 0x60034A7A /end MEASUREMENT
/begin MEASUREMENT DFC_b.TST_ComMETARingCnt "Bit encoding / Tested bit for check DFC_ComMETARingCnt" UBYTE DFC_OneToOne 1 100 0.00 1.000 BIT_MASK 0x8 FORMAT "%5.3" ECU_ADDRESS 0x60034A7B /end MEASUREMENT
/begin MEASUREMENT DFC_b.TST_ComMETATOut "Bit encoding / Tested bit for check DFC_ComMETATOut" UBYTE DFC_OneToOne 1 100 0.00 1.000 BIT_MASK 0x8 FORMAT "%5.3" ECU_ADDRESS 0x60034A7C /end MEASUREMENT
/begin MEASUREMENT DFC_b.TST_ComMETCChksum "Bit encoding / Tested bit for check DFC_ComMETCChksum" UBYTE DFC_OneToOne 1 100 0.00 1.000 BIT_MASK 0x8 FORMAT "%5.3" ECU_ADDRESS 0x60034A7D /end MEASUREMENT
/begin MEASUREMENT DFC_b.TST_ComMETCRingCnt "Bit encoding / Tested bit for check DFC_ComMETCRingCnt" UBYTE DFC_OneToOne 1 100 0.00 1.000 BIT_MASK 0x8 FORMAT "%5.3" ECU_ADDRESS 0x60034A7E /end MEASUREMENT
/begin MEASUREMENT DFC_b.TST_ComMETCTOut "Bit encoding / Tested bit for check DFC_ComMETCTOut" UBYTE DFC_OneToOne 1 100 0.00 1.000 BIT_MASK 0x8 FORMAT "%5.3" ECU_ADDRESS 0x60034A7F /end MEASUREMENT
/begin MEASUREMENT DFC_b.TST_ComMETDChksum "Bit encoding / Tested bit for check DFC_ComMETDChksum" UBYTE DFC_OneToOne 1 100 0.00 1.000 BIT_MASK 0x8 FORMAT "%5.3" ECU_ADDRESS 0x60034A80 /end MEASUREMENT
/begin MEASUREMENT DFC_b.TST_ComMETDRingCnt "Bit encoding / Tested bit for check DFC_ComMETDRingCnt" UBYTE DFC_OneToOne 1 100 0.00 1.000 BIT_MASK 0x8 FORMAT "%5.3" ECU_ADDRESS 0x60034A81 /end MEASUREMENT
/begin MEASUREMENT DFC_b.TST_ComMETDTOut "Bit encoding / Tested bit for check DFC_ComMETDTOut" UBYTE DFC_OneToOne 1 100 0.00 1.000 BIT_MASK 0x8 FORMAT "%5.3" ECU_ADDRESS 0x60034A82 /end MEASUREMENT
/begin MEASUREMENT DFC_b.TST_ComMETE2Chksum "Bit encoding / Tested bit for check DFC_ComMETE2Chksum" UBYTE DFC_OneToOne 1 100 0.00 1.000 BIT_MASK 0x8 FORMAT "%5.3" ECU_ADDRESS 0x60034A83 /end MEASUREMENT
/begin MEASUREMENT DFC_b.TST_ComMETE2RingCnt "Bit encoding / Tested bit for check DFC_ComMETE2RingCnt" UBYTE DFC_OneToOne 1 100 0.00 1.000 BIT_MASK 0x8 FORMAT "%5.3" ECU_ADDRESS 0x60034A84 /end MEASUREMENT
/begin MEASUREMENT DFC_b.TST_ComMETE2TOut "Bit encoding / Tested bit for check DFC_ComMETE2TOut" UBYTE DFC_OneToOne 1 100 0.00 1.000 BIT_MASK 0x8 FORMAT "%5.3" ECU_ADDRESS 0x60034A85 /end MEASUREMENT
/begin MEASUREMENT DFC_b.TST_ComMETFChksum "Bit encoding / Tested bit for check DFC_ComMETFChksum" UBYTE DFC_OneToOne 1 100 0.00 1.000 BIT_MASK 0x8 FORMAT "%5.3" ECU_ADDRESS 0x60034A86 /end MEASUREMENT
/begin MEASUREMENT DFC_b.TST_ComMETFRingCnt "Bit encoding / Tested bit for check DFC_ComMETFRingCnt" UBYTE DFC_OneToOne 1 100 0.00 1.000 BIT_MASK 0x8 FORMAT "%5.3" ECU_ADDRESS 0x60034A87 /end MEASUREMENT
/begin MEASUREMENT DFC_b.TST_ComMETFTOut "Bit encoding / Tested bit for check DFC_ComMETFTOut" UBYTE DFC_OneToOne 1 100 0.00 1.000 BIT_MASK 0x8 FORMAT "%5.3" ECU_ADDRESS 0x60034A88 /end MEASUREMENT
/begin MEASUREMENT DFC_b.TST_ComMETGChksum "Bit encoding / Tested bit for check DFC_ComMETGChksum" UBYTE DFC_OneToOne 1 100 0.00 1.000 BIT_MASK 0x8 FORMAT "%5.3" ECU_ADDRESS 0x60034A89 /end MEASUREMENT
/begin MEASUREMENT DFC_b.TST_ComMETGRingCnt "Bit encoding / Tested bit for check DFC_ComMETGRingCnt" UBYTE DFC_OneToOne 1 100 0.00 1.000 BIT_MASK 0x8 FORMAT "%5.3" ECU_ADDRESS 0x60034A8A /end MEASUREMENT
/begin MEASUREMENT DFC_b.TST_ComMETGTOut "Bit encoding / Tested bit for check DFC_ComMETGTOut" UBYTE DFC_OneToOne 1 100 0.00 1.000 BIT_MASK 0x8 FORMAT "%5.3" ECU_ADDRESS 0x60034A8B /end MEASUREMENT
/begin MEASUREMENT DFC_b.TST_ComMETH2Chksum "Bit encoding / Tested bit for check DFC_ComMETH2Chksum" UBYTE DFC_OneToOne 1 100 0.00 1.000 BIT_MASK 0x8 FORMAT "%5.3" ECU_ADDRESS 0x60034A8C /end MEASUREMENT
/begin MEASUREMENT DFC_b.TST_ComMETH2RingCnt "Bit encoding / Tested bit for check DFC_ComMETH2RingCnt" UBYTE DFC_OneToOne 1 100 0.00 1.000 BIT_MASK 0x8 FORMAT "%5.3" ECU_ADDRESS 0x60034A8D /end MEASUREMENT
/begin MEASUREMENT DFC_b.TST_ComMETH2TOut "Bit encoding / Tested bit for check DFC_ComMETH2TOut" UBYTE DFC_OneToOne 1 100 0.00 1.000 BIT_MASK 0x8 FORMAT "%5.3" ECU_ADDRESS 0x60034A8E /end MEASUREMENT
/begin MEASUREMENT DFC_b.TST_ComMETHChksum "Bit encoding / Tested bit for check DFC_ComMETHChksum" UBYTE DFC_OneToOne 1 100 0.00 1.000 BIT_MASK 0x8 FORMAT "%5.3" ECU_ADDRESS 0x60034A8F /end MEASUREMENT
/begin MEASUREMENT DFC_b.TST_ComMETHRingCnt "Bit encoding / Tested bit for check DFC_ComMETHRingCnt" UBYTE DFC_OneToOne 1 100 0.00 1.000 BIT_MASK 0x8 FORMAT "%5.3" ECU_ADDRESS 0x60034A90 /end MEASUREMENT
/begin MEASUREMENT DFC_b.TST_ComMETHTOut "Bit encoding / Tested bit for check DFC_ComMETHTOut" UBYTE DFC_OneToOne 1 100 0.00 1.000 BIT_MASK 0x8 FORMAT "%5.3" ECU_ADDRESS 0x60034A91 /end MEASUREMENT
/begin MEASUREMENT DFC_b.TST_ComMETIChksum "Bit encoding / Tested bit for check DFC_ComMETIChksum" UBYTE DFC_OneToOne 1 100 0.00 1.000 BIT_MASK 0x8 FORMAT "%5.3" ECU_ADDRESS 0x60034A92 /end MEASUREMENT
/begin MEASUREMENT DFC_b.TST_ComMETIRingCnt "Bit encoding / Tested bit for check DFC_ComMETIRingCnt" UBYTE DFC_OneToOne 1 100 0.00 1.000 BIT_MASK 0x8 FORMAT "%5.3" ECU_ADDRESS 0x60034A93 /end MEASUREMENT
/begin MEASUREMENT DFC_b.TST_ComMETITOut "Bit encoding / Tested bit for check DFC_ComMETITOut" UBYTE DFC_OneToOne 1 100 0.00 1.000 BIT_MASK 0x8 FORMAT "%5.3" ECU_ADDRESS 0x60034A94 /end MEASUREMENT
/begin MEASUREMENT DFC_b.TST_ComMETKChksum "Bit encoding / Tested bit for check DFC_ComMETKChksum" UBYTE DFC_OneToOne 1 100 0.00 1.000 BIT_MASK 0x8 FORMAT "%5.3" ECU_ADDRESS 0x60034A95 /end MEASUREMENT
/begin MEASUREMENT DFC_b.TST_ComMETKRingCnt "Bit encoding / Tested bit for check DFC_ComMETKRingCnt" UBYTE DFC_OneToOne 1 100 0.00 1.000 BIT_MASK 0x8 FORMAT "%5.3" ECU_ADDRESS 0x60034A96 /end MEASUREMENT
/begin MEASUREMENT DFC_b.TST_ComMETKTOut "Bit encoding / Tested bit for check DFC_ComMETKTOut" UBYTE DFC_OneToOne 1 100 0.00 1.000 BIT_MASK 0x8 FORMAT "%5.3" ECU_ADDRESS 0x60034A97 /end MEASUREMENT
/begin MEASUREMENT DFC_b.TST_ComMETLChksum "Bit encoding / Tested bit for check DFC_ComMETLChksum" UBYTE DFC_OneToOne 1 100 0.00 1.000 BIT_MASK 0x8 FORMAT "%5.3" ECU_ADDRESS 0x60034A98 /end MEASUREMENT
/begin MEASUREMENT DFC_b.TST_ComMETLRingCnt "Bit encoding / Tested bit for check DFC_ComMETLRingCnt" UBYTE DFC_OneToOne 1 100 0.00 1.000 BIT_MASK 0x8 FORMAT "%5.3" ECU_ADDRESS 0x60034A99 /end MEASUREMENT
/begin MEASUREMENT DFC_b.TST_ComMETLTOut "Bit encoding / Tested bit for check DFC_ComMETLTOut" UBYTE DFC_OneToOne 1 100 0.00 1.000 BIT_MASK 0x8 FORMAT "%5.3" ECU_ADDRESS 0x60034A9A /end MEASUREMENT
/begin MEASUREMENT DFC_b.TST_ComMETMChksum "Bit encoding / Tested bit for check DFC_ComMETMChksum" UBYTE DFC_OneToOne 1 100 0.00 1.000 BIT_MASK 0x8 FORMAT "%5.3" ECU_ADDRESS 0x60034A9B /end MEASUREMENT
/begin MEASUREMENT DFC_b.TST_ComMETMRingCnt "Bit encoding / Tested bit for check DFC_ComMETMRingCnt" UBYTE DFC_OneToOne 1 100 0.00 1.000 BIT_MASK 0x8 FORMAT "%5.3" ECU_ADDRESS 0x60034A9C /end MEASUREMENT
/begin MEASUREMENT DFC_b.TST_ComMETMTOut "Bit encoding / Tested bit for check DFC_ComMETMTOut" UBYTE DFC_OneToOne 1 100 0.00 1.000 BIT_MASK 0x8 FORMAT "%5.3" ECU_ADDRESS 0x60034A9D /end MEASUREMENT
/begin MEASUREMENT DFC_b.TST_ComMETNChksum "Bit encoding / Tested bit for check DFC_ComMETNChksum" UBYTE DFC_OneToOne 1 100 0.00 1.000 BIT_MASK 0x8 FORMAT "%5.3" ECU_ADDRESS 0x60034A9E /end MEASUREMENT
/begin MEASUREMENT DFC_b.TST_ComMETNRingCnt "Bit encoding / Tested bit for check DFC_ComMETNRingCnt" UBYTE DFC_OneToOne 1 100 0.00 1.000 BIT_MASK 0x8 FORMAT "%5.3" ECU_ADDRESS 0x60034A9F /end MEASUREMENT
/begin MEASUREMENT DFC_b.TST_ComMETNTOut "Bit encoding / Tested bit for check DFC_ComMETNTOut" UBYTE DFC_OneToOne 1 100 0.00 1.000 BIT_MASK 0x8 FORMAT "%5.3" ECU_ADDRESS 0x60034AA0 /end MEASUREMENT
/begin MEASUREMENT DFC_b.TST_ComMtrCom "Bit encoding / Tested bit for check DFC_ComMtrCom" UBYTE DFC_OneToOne 1 100 0.00 1.000 BIT_MASK 0x8 FORMAT "%5.3" ECU_ADDRESS 0x60034AA1 /end MEASUREMENT
/begin MEASUREMENT DFC_b.TST_ComPCUChkSum "Bit encoding / Tested bit for check DFC_ComPCUChkSum" UBYTE DFC_OneToOne 1 100 0.00 1.000 BIT_MASK 0x8 FORMAT "%5.3" ECU_ADDRESS 0x60034AA2 /end MEASUREMENT
/begin MEASUREMENT DFC_b.TST_ComPCURingCnt "Bit encoding / Tested bit for check DFC_ComPCURingCnt" UBYTE DFC_OneToOne 1 100 0.00 1.000 BIT_MASK 0x8 FORMAT "%5.3" ECU_ADDRESS 0x60034AA3 /end MEASUREMENT
/begin MEASUREMENT DFC_b.TST_ComPCUTOut "Bit encoding / Tested bit for check DFC_ComPCUTOut" UBYTE DFC_OneToOne 1 100 0.00 1.000 BIT_MASK 0x8 FORMAT "%5.3" ECU_ADDRESS 0x60034AA4 /end MEASUREMENT
/begin MEASUREMENT DFC_b.TST_ComSRSAChksum "Bit encoding / Tested bit for check DFC_ComSRSAChksum" UBYTE DFC_OneToOne 1 100 0.00 1.000 BIT_MASK 0x8 FORMAT "%5.3" ECU_ADDRESS 0x60034AA5 /end MEASUREMENT
/begin MEASUREMENT DFC_b.TST_ComSRSARingCnt "Bit encoding / Tested bit for check DFC_ComSRSARingCnt" UBYTE DFC_OneToOne 1 100 0.00 1.000 BIT_MASK 0x8 FORMAT "%5.3" ECU_ADDRESS 0x60034AA6 /end MEASUREMENT
/begin MEASUREMENT DFC_b.TST_ComSRSATOut "Bit encoding / Tested bit for check DFC_ComSRSATOut" UBYTE DFC_OneToOne 1 100 0.00 1.000 BIT_MASK 0x8 FORMAT "%5.3" ECU_ADDRESS 0x60034AA7 /end MEASUREMENT
/begin MEASUREMENT DFC_b.TST_ComSRSBChksum "Bit encoding / Tested bit for check DFC_ComSRSBChksum" UBYTE DFC_OneToOne 1 100 0.00 1.000 BIT_MASK 0x8 FORMAT "%5.3" ECU_ADDRESS 0x60034AA8 /end MEASUREMENT
/begin MEASUREMENT DFC_b.TST_ComSRSBRingCnt "Bit encoding / Tested bit for check DFC_ComSRSBRingCnt" UBYTE DFC_OneToOne 1 100 0.00 1.000 BIT_MASK 0x8 FORMAT "%5.3" ECU_ADDRESS 0x60034AA9 /end MEASUREMENT
/begin MEASUREMENT DFC_b.TST_ComSRSBTOut "Bit encoding / Tested bit for check DFC_ComSRSBTOut" UBYTE DFC_OneToOne 1 100 0.00 1.000 BIT_MASK 0x8 FORMAT "%5.3" ECU_ADDRESS 0x60034AAA /end MEASUREMENT
/begin MEASUREMENT DFC_b.TST_ComSRSChksum "Bit encoding / Tested bit for check DFC_ComSRSChksum" UBYTE DFC_OneToOne 1 100 0.00 1.000 BIT_MASK 0x8 FORMAT "%5.3" ECU_ADDRESS 0x60034AAB /end MEASUREMENT
/begin MEASUREMENT DFC_b.TST_ComSRSErr "Bit encoding / Tested bit for check DFC_ComSRSErr" UBYTE DFC_OneToOne 1 100 0.00 1.000 BIT_MASK 0x8 FORMAT "%5.3" ECU_ADDRESS 0x60034AAC /end MEASUREMENT
/begin MEASUREMENT DFC_b.TST_ComSRSRingCnt "Bit encoding / Tested bit for check DFC_ComSRSRingCnt" UBYTE DFC_OneToOne 1 100 0.00 1.000 BIT_MASK 0x8 FORMAT "%5.3" ECU_ADDRESS 0x60034AAD /end MEASUREMENT
/begin MEASUREMENT DFC_b.TST_ComSRSTOut "Bit encoding / Tested bit for check DFC_ComSRSTOut" UBYTE DFC_OneToOne 1 100 0.00 1.000 BIT_MASK 0x8 FORMAT "%5.3" ECU_ADDRESS 0x60034AAE /end MEASUREMENT
/begin MEASUREMENT DFC_b.TST_ComVehSpdPndFltTCU "Bit encoding / Tested bit for check DFC_ComVehSpdPndFltTCU" UBYTE DFC_OneToOne 1 100 0.00 1.000 BIT_MASK 0x8 FORMAT "%5.3" ECU_ADDRESS 0x60034AAF /end MEASUREMENT
/begin MEASUREMENT DFC_b.TST_EbsChartcCurrErr "Bit encoding / Tested bit for check DFC_EbsChartcCurrErr" UBYTE DFC_OneToOne 1 100 0.00 1.000 BIT_MASK 0x8 FORMAT "%5.3" ECU_ADDRESS 0x60034AB0 /end MEASUREMENT
/begin MEASUREMENT DFC_b.TST_EbsSelfDiagErr "Bit encoding / Tested bit for check DFC_EbsSelfDiagErr" UBYTE DFC_OneToOne 1 100 0.00 1.000 BIT_MASK 0x8 FORMAT "%5.3" ECU_ADDRESS 0x60034AB1 /end MEASUREMENT
/begin MEASUREMENT DFC_b.TST_GbxCANDigPlausErr "Bit encoding / Tested bit for check DFC_GbxCANDigPlausErr" UBYTE DFC_OneToOne 1 100 0.00 1.000 BIT_MASK 0x8 FORMAT "%5.3" ECU_ADDRESS 0x60034AB2 /end MEASUREMENT
/begin MEASUREMENT DFC_b.TST_GbxNPos1SRCMax "Bit encoding / Tested bit for check DFC_GbxNPos1SRCMax" UBYTE DFC_OneToOne 1 100 0.00 1.000 BIT_MASK 0x8 FORMAT "%5.3" ECU_ADDRESS 0x60034AB3 /end MEASUREMENT
/begin MEASUREMENT DFC_b.TST_GbxNPos1SRCMin "Bit encoding / Tested bit for check DFC_GbxNPos1SRCMin" UBYTE DFC_OneToOne 1 100 0.00 1.000 BIT_MASK 0x8 FORMAT "%5.3" ECU_ADDRESS 0x60034AB4 /end MEASUREMENT
/begin MEASUREMENT DFC_b.TST_GbxNPos2SRCMax "Bit encoding / Tested bit for check DFC_GbxNPos2SRCMax" UBYTE DFC_OneToOne 1 100 0.00 1.000 BIT_MASK 0x8 FORMAT "%5.3" ECU_ADDRESS 0x60034AB5 /end MEASUREMENT
/begin MEASUREMENT DFC_b.TST_GbxNPos2SRCMin "Bit encoding / Tested bit for check DFC_GbxNPos2SRCMin" UBYTE DFC_OneToOne 1 100 0.00 1.000 BIT_MASK 0x8 FORMAT "%5.3" ECU_ADDRESS 0x60034AB6 /end MEASUREMENT
/begin MEASUREMENT DFC_b.TST_GbxNPosAlvChk "Bit encoding / Tested bit for check DFC_GbxNPosAlvChk" UBYTE DFC_OneToOne 1 100 0.00 1.000 BIT_MASK 0x8 FORMAT "%5.3" ECU_ADDRESS 0x60034AB7 /end MEASUREMENT
/begin MEASUREMENT DFC_b.TST_GbxNPosSyncErr "Bit encoding / Tested bit for check DFC_GbxNPosSyncErr" UBYTE DFC_OneToOne 1 100 0.00 1.000 BIT_MASK 0x8 FORMAT "%5.3" ECU_ADDRESS 0x60034AB8 /end MEASUREMENT
/begin MEASUREMENT DFC_b.TST_HEGOS2B1HtrPsMax "Bit encoding / Tested bit for check DFC_HEGOS2B1HtrPsMax" UBYTE DFC_OneToOne 1 100 0.00 1.000 BIT_MASK 0x8 FORMAT "%5.3" ECU_ADDRESS 0x60034AB9 /end MEASUREMENT
/begin MEASUREMENT DFC_b.TST_HEGOS2B1HtrPsMin "Bit encoding / Tested bit for check DFC_HEGOS2B1HtrPsMin" UBYTE DFC_OneToOne 1 100 0.00 1.000 BIT_MASK 0x8 FORMAT "%5.3" ECU_ADDRESS 0x60034ABA /end MEASUREMENT
/begin MEASUREMENT DFC_b.TST_HEGOS2B1HtrPsSig "Bit encoding / Tested bit for check DFC_HEGOS2B1HtrPsSig" UBYTE DFC_OneToOne 1 100 0.00 1.000 BIT_MASK 0x8 FORMAT "%5.3" ECU_ADDRESS 0x60034ABB /end MEASUREMENT
/begin MEASUREMENT DFC_b.TST_LinCSErrACG "Bit encoding / Tested bit for check DFC_LinCSErrACG" UBYTE DFC_OneToOne 1 100 0.00 1.000 BIT_MASK 0x8 FORMAT "%5.3" ECU_ADDRESS 0x60034ABC /end MEASUREMENT
/begin MEASUREMENT DFC_b.TST_LinCSErrEBS "Bit encoding / Tested bit for check DFC_LinCSErrEBS" UBYTE DFC_OneToOne 1 100 0.00 1.000 BIT_MASK 0x8 FORMAT "%5.3" ECU_ADDRESS 0x60034ABD /end MEASUREMENT
/begin MEASUREMENT DFC_b.TST_LinHdrTimeoutErrACG "Bit encoding / Tested bit for check DFC_LinHdrTimeoutErrACG" UBYTE DFC_OneToOne 1 100 0.00 1.000 BIT_MASK 0x8 FORMAT "%5.3" ECU_ADDRESS 0x60034ABE /end MEASUREMENT
/begin MEASUREMENT DFC_b.TST_LinHdrTimeoutErrEBS "Bit encoding / Tested bit for check DFC_LinHdrTimeoutErrEBS" UBYTE DFC_OneToOne 1 100 0.00 1.000 BIT_MASK 0x8 FORMAT "%5.3" ECU_ADDRESS 0x60034ABF /end MEASUREMENT
/begin MEASUREMENT DFC_b.TST_LinMsgTimeoutErrACG "Bit encoding / Tested bit for check DFC_LinMsgTimeoutErrACG" UBYTE DFC_OneToOne 1 100 0.00 1.000 BIT_MASK 0x8 FORMAT "%5.3" ECU_ADDRESS 0x60034AC0 /end MEASUREMENT
/begin MEASUREMENT DFC_b.TST_LinMsgTimeoutErrEBS "Bit encoding / Tested bit for check DFC_LinMsgTimeoutErrEBS" UBYTE DFC_OneToOne 1 100 0.00 1.000 BIT_MASK 0x8 FORMAT "%5.3" ECU_ADDRESS 0x60034AC1 /end MEASUREMENT
/begin MEASUREMENT DFC_b.TST_LinNoStrtComErr "Bit encoding / Tested bit for check DFC_LinNoStrtComErr" UBYTE DFC_OneToOne 1 100 0.00 1.000 BIT_MASK 0x8 FORMAT "%5.3" ECU_ADDRESS 0x60034AC2 /end MEASUREMENT
/begin MEASUREMENT DFC_b.TST_MisfDetVWhlFrntLeOORHi "Bit encoding / Tested bit for check DFC_MisfDetVWhlFrntLeOORHi" UBYTE DFC_OneToOne 1 100 0.00 1.000 BIT_MASK 0x8 FORMAT "%5.3" ECU_ADDRESS 0x60034AC3 /end MEASUREMENT
/begin MEASUREMENT DFC_b.TST_MisfDetVWhlFrntLeRatyHi "Bit encoding / Tested bit for check DFC_MisfDetVWhlFrntLeRatyHi" UBYTE DFC_OneToOne 1 100 0.00 1.000 BIT_MASK 0x8 FORMAT "%5.3" ECU_ADDRESS 0x60034AC4 /end MEASUREMENT
/begin MEASUREMENT DFC_b.TST_MisfDetVWhlFrntLeRatyLo "Bit encoding / Tested bit for check DFC_MisfDetVWhlFrntLeRatyLo" UBYTE DFC_OneToOne 1 100 0.00 1.000 BIT_MASK 0x8 FORMAT "%5.3" ECU_ADDRESS 0x60034AC5 /end MEASUREMENT
/begin MEASUREMENT DFC_b.TST_MisfDetVWhlFrntLeStuck "Bit encoding / Tested bit for check DFC_MisfDetVWhlFrntLeStuck" UBYTE DFC_OneToOne 1 100 0.00 1.000 BIT_MASK 0x8 FORMAT "%5.3" ECU_ADDRESS 0x60034AC6 /end MEASUREMENT
/begin MEASUREMENT DFC_b.TST_MisfDetVWhlFrntRiOORHi "Bit encoding / Tested bit for check DFC_MisfDetVWhlFrntRiOORHi" UBYTE DFC_OneToOne 1 100 0.00 1.000 BIT_MASK 0x8 FORMAT "%5.3" ECU_ADDRESS 0x60034AC7 /end MEASUREMENT
/begin MEASUREMENT DFC_b.TST_MisfDetVWhlFrntRiRatyHi "Bit encoding / Tested bit for check DFC_MisfDetVWhlFrntRiRatyHi" UBYTE DFC_OneToOne 1 100 0.00 1.000 BIT_MASK 0x8 FORMAT "%5.3" ECU_ADDRESS 0x60034AC8 /end MEASUREMENT
/begin MEASUREMENT DFC_b.TST_MisfDetVWhlFrntRiRatyLo "Bit encoding / Tested bit for check DFC_MisfDetVWhlFrntRiRatyLo" UBYTE DFC_OneToOne 1 100 0.00 1.000 BIT_MASK 0x8 FORMAT "%5.3" ECU_ADDRESS 0x60034AC9 /end MEASUREMENT
/begin MEASUREMENT DFC_b.TST_MisfDetVWhlFrntRiStuck "Bit encoding / Tested bit for check DFC_MisfDetVWhlFrntRiStuck" UBYTE DFC_OneToOne 1 100 0.00 1.000 BIT_MASK 0x8 FORMAT "%5.3" ECU_ADDRESS 0x60034ACA /end MEASUREMENT
/begin MEASUREMENT DFC_b.TST_MisfDetVWhlReLeOORHi "Bit encoding / Tested bit for check DFC_MisfDetVWhlReLeOORHi" UBYTE DFC_OneToOne 1 100 0.00 1.000 BIT_MASK 0x8 FORMAT "%5.3" ECU_ADDRESS 0x60034ACB /end MEASUREMENT
/begin MEASUREMENT DFC_b.TST_MisfDetVWhlReLeRatyHi "Bit encoding / Tested bit for check DFC_MisfDetVWhlReLeRatyHi" UBYTE DFC_OneToOne 1 100 0.00 1.000 BIT_MASK 0x8 FORMAT "%5.3" ECU_ADDRESS 0x60034ACC /end MEASUREMENT
/begin MEASUREMENT DFC_b.TST_MisfDetVWhlReLeRatyLo "Bit encoding / Tested bit for check DFC_MisfDetVWhlReLeRatyLo" UBYTE DFC_OneToOne 1 100 0.00 1.000 BIT_MASK 0x8 FORMAT "%5.3" ECU_ADDRESS 0x60034ACD /end MEASUREMENT
/begin MEASUREMENT DFC_b.TST_MisfDetVWhlReLeStuck "Bit encoding / Tested bit for check DFC_MisfDetVWhlReLeStuck" UBYTE DFC_OneToOne 1 100 0.00 1.000 BIT_MASK 0x8 FORMAT "%5.3" ECU_ADDRESS 0x60034ACE /end MEASUREMENT
/begin MEASUREMENT DFC_b.TST_MisfDetVWhlReRiOORHi "Bit encoding / Tested bit for check DFC_MisfDetVWhlReRiOORHi" UBYTE DFC_OneToOne 1 100 0.00 1.000 BIT_MASK 0x8 FORMAT "%5.3" ECU_ADDRESS 0x60034ACF /end MEASUREMENT
/begin MEASUREMENT DFC_b.TST_MisfDetVWhlReRiRatyHi "Bit encoding / Tested bit for check DFC_MisfDetVWhlReRiRatyHi" UBYTE DFC_OneToOne 1 100 0.00 1.000 BIT_MASK 0x8 FORMAT "%5.3" ECU_ADDRESS 0x60034AD0 /end MEASUREMENT
/begin MEASUREMENT DFC_b.TST_MisfDetVWhlReRiRatyLo "Bit encoding / Tested bit for check DFC_MisfDetVWhlReRiRatyLo" UBYTE DFC_OneToOne 1 100 0.00 1.000 BIT_MASK 0x8 FORMAT "%5.3" ECU_ADDRESS 0x60034AD1 /end MEASUREMENT
/begin MEASUREMENT DFC_b.TST_MisfDetVWhlReRiStuck "Bit encoding / Tested bit for check DFC_MisfDetVWhlReRiStuck" UBYTE DFC_OneToOne 1 100 0.00 1.000 BIT_MASK 0x8 FORMAT "%5.3" ECU_ADDRESS 0x60034AD2 /end MEASUREMENT
/begin MEASUREMENT DFC_b.TST_MisfDetdVWhlFrntLePlaus "Bit encoding / Tested bit for check DFC_MisfDetdVWhlFrntLePlaus" UBYTE DFC_OneToOne 1 100 0.00 1.000 BIT_MASK 0x8 FORMAT "%5.3" ECU_ADDRESS 0x60034AD3 /end MEASUREMENT
/begin MEASUREMENT DFC_b.TST_MisfDetdVWhlFrntRiPlaus "Bit encoding / Tested bit for check DFC_MisfDetdVWhlFrntRiPlaus" UBYTE DFC_OneToOne 1 100 0.00 1.000 BIT_MASK 0x8 FORMAT "%5.3" ECU_ADDRESS 0x60034AD4 /end MEASUREMENT
/begin MEASUREMENT DFC_b.TST_MisfDetdVWhlReLePlaus "Bit encoding / Tested bit for check DFC_MisfDetdVWhlReLePlaus" UBYTE DFC_OneToOne 1 100 0.00 1.000 BIT_MASK 0x8 FORMAT "%5.3" ECU_ADDRESS 0x60034AD5 /end MEASUREMENT
/begin MEASUREMENT DFC_b.TST_MisfDetdVWhlReRiPlaus "Bit encoding / Tested bit for check DFC_MisfDetdVWhlReRiPlaus" UBYTE DFC_OneToOne 1 100 0.00 1.000 BIT_MASK 0x8 FORMAT "%5.3" ECU_ADDRESS 0x60034AD6 /end MEASUREMENT
/begin MEASUREMENT DFC_b.TST_PEnvSigRngMax "Bit encoding / Tested bit for check DFC_PEnvSigRngMax" UBYTE DFC_OneToOne 1 100 0.00 1.000 BIT_MASK 0x8 FORMAT "%5.3" ECU_ADDRESS 0x60034AD7 /end MEASUREMENT
/begin MEASUREMENT DFC_b.TST_PEnvSigRngMin "Bit encoding / Tested bit for check DFC_PEnvSigRngMin" UBYTE DFC_OneToOne 1 100 0.00 1.000 BIT_MASK 0x8 FORMAT "%5.3" ECU_ADDRESS 0x60034AD8 /end MEASUREMENT
/begin MEASUREMENT DFC_b.TST_StmFault "Bit encoding / Tested bit for check DFC_StmFault" UBYTE DFC_OneToOne 1 100 0.00 1.000 BIT_MASK 0x8 FORMAT "%5.3" ECU_ADDRESS 0x60034AD9 /end MEASUREMENT
/begin MEASUREMENT DFC_b.TST_StrtCtOffPth "Bit encoding / Tested bit for check DFC_StrtCtOffPth" UBYTE DFC_OneToOne 1 100 0.00 1.000 BIT_MASK 0x8 FORMAT "%5.3" ECU_ADDRESS 0x60034ADA /end MEASUREMENT
/begin MEASUREMENT DFC_b.TST_StrtCtlErr "Bit encoding / Tested bit for check DFC_StrtCtlErr" UBYTE DFC_OneToOne 1 100 0.00 1.000 BIT_MASK 0x8 FORMAT "%5.3" ECU_ADDRESS 0x60034ADB /end MEASUREMENT
/begin MEASUREMENT DFC_b.TST_StrtFault "Bit encoding / Tested bit for check DFC_StrtFault" UBYTE DFC_OneToOne 1 100 0.00 1.000 BIT_MASK 0x8 FORMAT "%5.3" ECU_ADDRESS 0x60034ADC /end MEASUREMENT
/begin MEASUREMENT DFC_b.TST_StrtLckJudg1 "Bit encoding / Tested bit for check DFC_StrtLckJudg1" UBYTE DFC_OneToOne 1 100 0.00 1.000 BIT_MASK 0x8 FORMAT "%5.3" ECU_ADDRESS 0x60034ADD /end MEASUREMENT
/begin MEASUREMENT DFC_b.TST_StrtLckJudg2 "Bit encoding / Tested bit for check DFC_StrtLckJudg2" UBYTE DFC_OneToOne 1 100 0.00 1.000 BIT_MASK 0x8 FORMAT "%5.3" ECU_ADDRESS 0x60034ADE /end MEASUREMENT
/begin MEASUREMENT DFC_b.TST_StrtOL "Bit encoding / Tested bit for check DFC_StrtOL" UBYTE DFC_OneToOne 1 100 0.00 1.000 BIT_MASK 0x8 FORMAT "%5.3" ECU_ADDRESS 0x60034ADF /end MEASUREMENT
/begin MEASUREMENT DFC_b.TST_StrtOL2 "Bit encoding / Tested bit for check DFC_StrtOL2" UBYTE DFC_OneToOne 1 100 0.00 1.000 BIT_MASK 0x8 FORMAT "%5.3" ECU_ADDRESS 0x60034AE0 /end MEASUREMENT
/begin MEASUREMENT DFC_b.TST_StrtSCB "Bit encoding / Tested bit for check DFC_StrtSCB" UBYTE DFC_OneToOne 1 100 0.00 1.000 BIT_MASK 0x8 FORMAT "%5.3" ECU_ADDRESS 0x60034AE1 /end MEASUREMENT
/begin MEASUREMENT DFC_b.TST_StrtSCB2 "Bit encoding / Tested bit for check DFC_StrtSCB2" UBYTE DFC_OneToOne 1 100 0.00 1.000 BIT_MASK 0x8 FORMAT "%5.3" ECU_ADDRESS 0x60034AE2 /end MEASUREMENT
/begin MEASUREMENT DFC_b.TST_StrtSCG "Bit encoding / Tested bit for check DFC_StrtSCG" UBYTE DFC_OneToOne 1 100 0.00 1.000 BIT_MASK 0x8 FORMAT "%5.3" ECU_ADDRESS 0x60034AE3 /end MEASUREMENT
/begin MEASUREMENT DFC_b.TST_StrtSCG2 "Bit encoding / Tested bit for check DFC_StrtSCG2" UBYTE DFC_OneToOne 1 100 0.00 1.000 BIT_MASK 0x8 FORMAT "%5.3" ECU_ADDRESS 0x60034AE4 /end MEASUREMENT
/begin MEASUREMENT DFC_b.TST_StrtStkRly1 "Bit encoding / Tested bit for check DFC_StrtStkRly1" UBYTE DFC_OneToOne 1 100 0.00 1.000 BIT_MASK 0x8 FORMAT "%5.3" ECU_ADDRESS 0x60034AE5 /end MEASUREMENT
/begin MEASUREMENT DFC_b.TST_StrtStkRly2 "Bit encoding / Tested bit for check DFC_StrtStkRly2" UBYTE DFC_OneToOne 1 100 0.00 1.000 BIT_MASK 0x8 FORMAT "%5.3" ECU_ADDRESS 0x60034AE6 /end MEASUREMENT
/begin MEASUREMENT DFC_b.TST_TEVEmax "Bit encoding / Tested bit for check DFC_TEVEmax" UBYTE DFC_OneToOne 1 100 0.00 1.000 BIT_MASK 0x8 FORMAT "%5.3" ECU_ADDRESS 0x60034AE7 /end MEASUREMENT
/begin MEASUREMENT DFC_b.TST_TEVEmin "Bit encoding / Tested bit for check DFC_TEVEmin" UBYTE DFC_OneToOne 1 100 0.00 1.000 BIT_MASK 0x8 FORMAT "%5.3" ECU_ADDRESS 0x60034AE8 /end MEASUREMENT
/begin MEASUREMENT DFC_b.TST_TEVEsig "Bit encoding / Tested bit for check DFC_TEVEsig" UBYTE DFC_OneToOne 1 100 0.00 1.000 BIT_MASK 0x8 FORMAT "%5.3" ECU_ADDRESS 0x60034AE9 /end MEASUREMENT
/begin MEASUREMENT DFC_b.TST_VehVAllPlaus "Bit encoding / Tested bit for check DFC_VehVAllPlaus" UBYTE DFC_OneToOne 1 100 0.00 1.000 BIT_MASK 0x8 FORMAT "%5.3" ECU_ADDRESS 0x60034AEA /end MEASUREMENT
/begin MEASUREMENT DFC_b.TST_VehVNCSnsrElecFailr "Bit encoding / Tested bit for check DFC_VehVNCSnsrElecFailr" UBYTE DFC_OneToOne 1 100 0.00 1.000 BIT_MASK 0x8 FORMAT "%5.3" ECU_ADDRESS 0x60034AEB /end MEASUREMENT
/begin MEASUREMENT DFC_b.TST_VehVPlausCan "Bit encoding / Tested bit for check DFC_VehVPlausCan" UBYTE DFC_OneToOne 1 100 0.00 1.000 BIT_MASK 0x8 FORMAT "%5.3" ECU_ADDRESS 0x60034AEC /end MEASUREMENT
/begin MEASUREMENT DFC_b.TST_VehVPlausFco "Bit encoding / Tested bit for check DFC_VehVPlausFco" UBYTE DFC_OneToOne 1 100 0.00 1.000 BIT_MASK 0x8 FORMAT "%5.3" ECU_ADDRESS 0x60034AED /end MEASUREMENT
/begin MEASUREMENT DFC_b.TST_VehVPlausPwr "Bit encoding / Tested bit for check DFC_VehVPlausPwr" UBYTE DFC_OneToOne 1 100 0.00 1.000 BIT_MASK 0x8 FORMAT "%5.3" ECU_ADDRESS 0x60034AEE /end MEASUREMENT
/begin MEASUREMENT DFC_b.TST_VehVPlausV2N "Bit encoding / Tested bit for check DFC_VehVPlausV2N" UBYTE DFC_OneToOne 1 100 0.00 1.000 BIT_MASK 0x8 FORMAT "%5.3" ECU_ADDRESS 0x60034AEF /end MEASUREMENT
/begin MEASUREMENT DFC_b.TST_VehVSpdSnsrAElecFailr "Bit encoding / Tested bit for check DFC_VehVSpdSnsrAElecFailr" UBYTE DFC_OneToOne 1 100 0.00 1.000 BIT_MASK 0x8 FORMAT "%5.3" ECU_ADDRESS 0x60034AF0 /end MEASUREMENT
/begin MEASUREMENT DFC_b.TST_VehVSpdSnsrBElecFailr "Bit encoding / Tested bit for check DFC_VehVSpdSnsrBElecFailr" UBYTE DFC_OneToOne 1 100 0.00 1.000 BIT_MASK 0x8 FORMAT "%5.3" ECU_ADDRESS 0x60034AF1 /end MEASUREMENT
/begin MEASUREMENT DFC_b.TST_ClthMax "Bit encoding / Tested bit for check DFC_ClthMax" UBYTE DFC_OneToOne 1 100 0.00 1.000 BIT_MASK 0x8 FORMAT "%5.3" ECU_ADDRESS 0x60034AF2 /end MEASUREMENT
/begin MEASUREMENT DFC_b.TST_IgnClPs_DevComErr "Bit encoding / Tested bit for check DFC_IgnClPs_DevComErr" UBYTE DFC_OneToOne 1 100 0.00 1.000 BIT_MASK 0x8 FORMAT "%5.3" ECU_ADDRESS 0x60034AF3 /end MEASUREMENT
/begin MEASUREMENT DFC_b.TST_IgnClPs_LineOl_0 "Bit encoding / Tested bit for check DFC_IgnClPs_LineOl_0" UBYTE DFC_OneToOne 1 100 0.00 1.000 BIT_MASK 0x8 FORMAT "%5.3" ECU_ADDRESS 0x60034AF4 /end MEASUREMENT
/begin MEASUREMENT DFC_b.TST_IgnClPs_LineOl_1 "Bit encoding / Tested bit for check DFC_IgnClPs_LineOl_1" UBYTE DFC_OneToOne 1 100 0.00 1.000 BIT_MASK 0x8 FORMAT "%5.3" ECU_ADDRESS 0x60034AF5 /end MEASUREMENT
/begin MEASUREMENT DFC_b.TST_IgnClPs_LineOl_2 "Bit encoding / Tested bit for check DFC_IgnClPs_LineOl_2" UBYTE DFC_OneToOne 1 100 0.00 1.000 BIT_MASK 0x8 FORMAT "%5.3" ECU_ADDRESS 0x60034AF6 /end MEASUREMENT
/begin MEASUREMENT DFC_b.TST_IgnClPs_LineOl_3 "Bit encoding / Tested bit for check DFC_IgnClPs_LineOl_3" UBYTE DFC_OneToOne 1 100 0.00 1.000 BIT_MASK 0x8 FORMAT "%5.3" ECU_ADDRESS 0x60034AF7 /end MEASUREMENT
/begin MEASUREMENT DFC_b.TST_IgnClPs_LineScb_0 "Bit encoding / Tested bit for check DFC_IgnClPs_LineScb_0" UBYTE DFC_OneToOne 1 100 0.00 1.000 BIT_MASK 0x8 FORMAT "%5.3" ECU_ADDRESS 0x60034AF8 /end MEASUREMENT
/begin MEASUREMENT DFC_b.TST_IgnClPs_LineScb_1 "Bit encoding / Tested bit for check DFC_IgnClPs_LineScb_1" UBYTE DFC_OneToOne 1 100 0.00 1.000 BIT_MASK 0x8 FORMAT "%5.3" ECU_ADDRESS 0x60034AF9 /end MEASUREMENT
/begin MEASUREMENT DFC_b.TST_IgnClPs_LineScb_2 "Bit encoding / Tested bit for check DFC_IgnClPs_LineScb_2" UBYTE DFC_OneToOne 1 100 0.00 1.000 BIT_MASK 0x8 FORMAT "%5.3" ECU_ADDRESS 0x60034AFA /end MEASUREMENT
/begin MEASUREMENT DFC_b.TST_IgnClPs_LineScb_3 "Bit encoding / Tested bit for check DFC_IgnClPs_LineScb_3" UBYTE DFC_OneToOne 1 100 0.00 1.000 BIT_MASK 0x8 FORMAT "%5.3" ECU_ADDRESS 0x60034AFB /end MEASUREMENT
/begin MEASUREMENT DFC_b.TST_IgnClPs_LineScg_0 "Bit encoding / Tested bit for check DFC_IgnClPs_LineScg_0" UBYTE DFC_OneToOne 1 100 0.00 1.000 BIT_MASK 0x8 FORMAT "%5.3" ECU_ADDRESS 0x60034AFC /end MEASUREMENT
/begin MEASUREMENT DFC_b.TST_IgnClPs_LineScg_1 "Bit encoding / Tested bit for check DFC_IgnClPs_LineScg_1" UBYTE DFC_OneToOne 1 100 0.00 1.000 BIT_MASK 0x8 FORMAT "%5.3" ECU_ADDRESS 0x60034AFD /end MEASUREMENT
/begin MEASUREMENT DFC_b.TST_IgnClPs_LineScg_2 "Bit encoding / Tested bit for check DFC_IgnClPs_LineScg_2" UBYTE DFC_OneToOne 1 100 0.00 1.000 BIT_MASK 0x8 FORMAT "%5.3" ECU_ADDRESS 0x60034AFE /end MEASUREMENT
/begin MEASUREMENT DFC_b.TST_IgnClPs_LineScg_3 "Bit encoding / Tested bit for check DFC_IgnClPs_LineScg_3" UBYTE DFC_OneToOne 1 100 0.00 1.000 BIT_MASK 0x8 FORMAT "%5.3" ECU_ADDRESS 0x60034AFF /end MEASUREMENT
/begin MEASUREMENT DFC_b.TST_UEGOASICS1B1 "Bit encoding / Tested bit for check DFC_UEGOASICS1B1" UBYTE DFC_OneToOne 1 100 0.00 1.000 BIT_MASK 0x8 FORMAT "%5.3" ECU_ADDRESS 0x60034B00 /end MEASUREMENT
/begin MEASUREMENT DFC_b.TST_UEGOOLIPES1B1 "Bit encoding / Tested bit for check DFC_UEGOOLIPES1B1" UBYTE DFC_OneToOne 1 100 0.00 1.000 BIT_MASK 0x8 FORMAT "%5.3" ECU_ADDRESS 0x60034B01 /end MEASUREMENT
/begin MEASUREMENT DFC_b.TST_UEGOOLRES1B1 "Bit encoding / Tested bit for check DFC_UEGOOLRES1B1" UBYTE DFC_OneToOne 1 100 0.00 1.000 BIT_MASK 0x8 FORMAT "%5.3" ECU_ADDRESS 0x60034B02 /end MEASUREMENT
/begin MEASUREMENT DFC_b.TST_UEGOSCBS1B1 "Bit encoding / Tested bit for check DFC_UEGOSCBS1B1" UBYTE DFC_OneToOne 1 100 0.00 1.000 BIT_MASK 0x8 FORMAT "%5.3" ECU_ADDRESS 0x60034B03 /end MEASUREMENT
/begin MEASUREMENT DFC_b.TST_UEGOSCGS1B1 "Bit encoding / Tested bit for check DFC_UEGOSCGS1B1" UBYTE DFC_OneToOne 1 100 0.00 1.000 BIT_MASK 0x8 FORMAT "%5.3" ECU_ADDRESS 0x60034B04 /end MEASUREMENT
/begin MEASUREMENT DFC_b.TST_UEGOSPIS1B1 "Bit encoding / Tested bit for check DFC_UEGOSPIS1B1" UBYTE DFC_OneToOne 1 100 0.00 1.000 BIT_MASK 0x8 FORMAT "%5.3" ECU_ADDRESS 0x60034B05 /end MEASUREMENT
/begin MEASUREMENT DFC_b.TST_UEGOSnsrS1B1 "Bit encoding / Tested bit for check DFC_UEGOSnsrS1B1" UBYTE DFC_OneToOne 1 100 0.00 1.000 BIT_MASK 0x8 FORMAT "%5.3" ECU_ADDRESS 0x60034B06 /end MEASUREMENT
/begin MEASUREMENT DFC_b.TST_UegoOlApesS1B1 "Bit encoding / Tested bit for check DFC_UegoOlApesS1B1" UBYTE DFC_OneToOne 1 100 0.00 1.000 BIT_MASK 0x8 FORMAT "%5.3" ECU_ADDRESS 0x60034B07 /end MEASUREMENT
/begin MEASUREMENT DFC_b.TST_UegoOlRCmpS1B1 "Bit encoding / Tested bit for check DFC_UegoOlRCmpS1B1" UBYTE DFC_OneToOne 1 100 0.00 1.000 BIT_MASK 0x8 FORMAT "%5.3" ECU_ADDRESS 0x60034B08 /end MEASUREMENT
/begin MEASUREMENT DFC_b.TST_AirCCmprOL "Bit encoding / Tested bit for check DFC_AirCCmprOL" UBYTE DFC_OneToOne 1 100 0.00 1.000 BIT_MASK 0x8 FORMAT "%5.3" ECU_ADDRESS 0x60034B09 /end MEASUREMENT
/begin MEASUREMENT DFC_b.TST_AirCCmprOvrTemp "Bit encoding / Tested bit for check DFC_AirCCmprOvrTemp" UBYTE DFC_OneToOne 1 100 0.00 1.000 BIT_MASK 0x8 FORMAT "%5.3" ECU_ADDRESS 0x60034B0A /end MEASUREMENT
/begin MEASUREMENT DFC_b.TST_AirCCmprSCB "Bit encoding / Tested bit for check DFC_AirCCmprSCB" UBYTE DFC_OneToOne 1 100 0.00 1.000 BIT_MASK 0x8 FORMAT "%5.3" ECU_ADDRESS 0x60034B0B /end MEASUREMENT
/begin MEASUREMENT DFC_b.TST_AirCCmprSCG "Bit encoding / Tested bit for check DFC_AirCCmprSCG" UBYTE DFC_OneToOne 1 100 0.00 1.000 BIT_MASK 0x8 FORMAT "%5.3" ECU_ADDRESS 0x60034B0C /end MEASUREMENT
/begin MEASUREMENT DFC_b.TST_AltErr "Bit encoding / Tested bit for check DFC_AltErr" UBYTE DFC_OneToOne 1 100 0.00 1.000 BIT_MASK 0x8 FORMAT "%5.3" ECU_ADDRESS 0x60034B0D /end MEASUREMENT
/begin MEASUREMENT DFC_b.TST_BattUSRCMax "Bit encoding / Tested bit for check DFC_BattUSRCMax" UBYTE DFC_OneToOne 1 100 0.00 1.000 BIT_MASK 0x8 FORMAT "%5.3" ECU_ADDRESS 0x60034B0E /end MEASUREMENT
/begin MEASUREMENT DFC_b.TST_BattUSRCMin "Bit encoding / Tested bit for check DFC_BattUSRCMin" UBYTE DFC_OneToOne 1 100 0.00 1.000 BIT_MASK 0x8 FORMAT "%5.3" ECU_ADDRESS 0x60034B0F /end MEASUREMENT
/begin MEASUREMENT DFC_b.TST_ComChksTCU1 "Bit encoding / Tested bit for check DFC_ComChksTCU1" UBYTE DFC_OneToOne 1 100 0.00 1.000 BIT_MASK 0x8 FORMAT "%5.3" ECU_ADDRESS 0x60034B10 /end MEASUREMENT
/begin MEASUREMENT DFC_b.TST_ComChksTCU11 "Bit encoding / Tested bit for check DFC_ComChksTCU11" UBYTE DFC_OneToOne 1 100 0.00 1.000 BIT_MASK 0x8 FORMAT "%5.3" ECU_ADDRESS 0x60034B11 /end MEASUREMENT
/begin MEASUREMENT DFC_b.TST_ComChksTCU12 "Bit encoding / Tested bit for check DFC_ComChksTCU12" UBYTE DFC_OneToOne 1 100 0.00 1.000 BIT_MASK 0x8 FORMAT "%5.3" ECU_ADDRESS 0x60034B12 /end MEASUREMENT
/begin MEASUREMENT DFC_b.TST_ComChksTCU13 "Bit encoding / Tested bit for check DFC_ComChksTCU13" UBYTE DFC_OneToOne 1 100 0.00 1.000 BIT_MASK 0x8 FORMAT "%5.3" ECU_ADDRESS 0x60034B13 /end MEASUREMENT
/begin MEASUREMENT DFC_b.TST_ComChksTCU2 "Bit encoding / Tested bit for check DFC_ComChksTCU2" UBYTE DFC_OneToOne 1 100 0.00 1.000 BIT_MASK 0x8 FORMAT "%5.3" ECU_ADDRESS 0x60034B14 /end MEASUREMENT
/begin MEASUREMENT DFC_b.TST_ComChksTCU3 "Bit encoding / Tested bit for check DFC_ComChksTCU3" UBYTE DFC_OneToOne 1 100 0.00 1.000 BIT_MASK 0x8 FORMAT "%5.3" ECU_ADDRESS 0x60034B15 /end MEASUREMENT
/begin MEASUREMENT DFC_b.TST_ComChksTCU4 "Bit encoding / Tested bit for check DFC_ComChksTCU4" UBYTE DFC_OneToOne 1 100 0.00 1.000 BIT_MASK 0x8 FORMAT "%5.3" ECU_ADDRESS 0x60034B16 /end MEASUREMENT
/begin MEASUREMENT DFC_b.TST_ComCntTCU1 "Bit encoding / Tested bit for check DFC_ComCntTCU1" UBYTE DFC_OneToOne 1 100 0.00 1.000 BIT_MASK 0x8 FORMAT "%5.3" ECU_ADDRESS 0x60034B17 /end MEASUREMENT
/begin MEASUREMENT DFC_b.TST_ComCntTCU11 "Bit encoding / Tested bit for check DFC_ComCntTCU11" UBYTE DFC_OneToOne 1 100 0.00 1.000 BIT_MASK 0x8 FORMAT "%5.3" ECU_ADDRESS 0x60034B18 /end MEASUREMENT
/begin MEASUREMENT DFC_b.TST_ComCntTCU12 "Bit encoding / Tested bit for check DFC_ComCntTCU12" UBYTE DFC_OneToOne 1 100 0.00 1.000 BIT_MASK 0x8 FORMAT "%5.3" ECU_ADDRESS 0x60034B19 /end MEASUREMENT
/begin MEASUREMENT DFC_b.TST_ComCntTCU13 "Bit encoding / Tested bit for check DFC_ComCntTCU13" UBYTE DFC_OneToOne 1 100 0.00 1.000 BIT_MASK 0x8 FORMAT "%5.3" ECU_ADDRESS 0x60034B1A /end MEASUREMENT
/begin MEASUREMENT DFC_b.TST_ComCntTCU2 "Bit encoding / Tested bit for check DFC_ComCntTCU2" UBYTE DFC_OneToOne 1 100 0.00 1.000 BIT_MASK 0x8 FORMAT "%5.3" ECU_ADDRESS 0x60034B1B /end MEASUREMENT
/begin MEASUREMENT DFC_b.TST_ComCntTCU3 "Bit encoding / Tested bit for check DFC_ComCntTCU3" UBYTE DFC_OneToOne 1 100 0.00 1.000 BIT_MASK 0x8 FORMAT "%5.3" ECU_ADDRESS 0x60034B1C /end MEASUREMENT
/begin MEASUREMENT DFC_b.TST_ComCntTCU4 "Bit encoding / Tested bit for check DFC_ComCntTCU4" UBYTE DFC_OneToOne 1 100 0.00 1.000 BIT_MASK 0x8 FORMAT "%5.3" ECU_ADDRESS 0x60034B1D /end MEASUREMENT
/begin MEASUREMENT DFC_b.TST_ComTOutTCU01 "Bit encoding / Tested bit for check DFC_ComTOutTCU01" UBYTE DFC_OneToOne 1 100 0.00 1.000 BIT_MASK 0x8 FORMAT "%5.3" ECU_ADDRESS 0x60034B1E /end MEASUREMENT
/begin MEASUREMENT DFC_b.TST_ComTOutTCU02 "Bit encoding / Tested bit for check DFC_ComTOutTCU02" UBYTE DFC_OneToOne 1 100 0.00 1.000 BIT_MASK 0x8 FORMAT "%5.3" ECU_ADDRESS 0x60034B1F /end MEASUREMENT
/begin MEASUREMENT DFC_b.TST_ComTOutTCU1 "Bit encoding / Tested bit for check DFC_ComTOutTCU1" UBYTE DFC_OneToOne 1 100 0.00 1.000 BIT_MASK 0x8 FORMAT "%5.3" ECU_ADDRESS 0x60034B20 /end MEASUREMENT
/begin MEASUREMENT DFC_b.TST_ComTOutTCU11 "Bit encoding / Tested bit for check DFC_ComTOutTCU11" UBYTE DFC_OneToOne 1 100 0.00 1.000 BIT_MASK 0x8 FORMAT "%5.3" ECU_ADDRESS 0x60034B21 /end MEASUREMENT
/begin MEASUREMENT DFC_b.TST_ComTOutTCU12 "Bit encoding / Tested bit for check DFC_ComTOutTCU12" UBYTE DFC_OneToOne 1 100 0.00 1.000 BIT_MASK 0x8 FORMAT "%5.3" ECU_ADDRESS 0x60034B22 /end MEASUREMENT
/begin MEASUREMENT DFC_b.TST_ComTOutTCU13 "Bit encoding / Tested bit for check DFC_ComTOutTCU13" UBYTE DFC_OneToOne 1 100 0.00 1.000 BIT_MASK 0x8 FORMAT "%5.3" ECU_ADDRESS 0x60034B23 /end MEASUREMENT
/begin MEASUREMENT DFC_b.TST_ComTOutTCU14 "Bit encoding / Tested bit for check DFC_ComTOutTCU14" UBYTE DFC_OneToOne 1 100 0.00 1.000 BIT_MASK 0x8 FORMAT "%5.3" ECU_ADDRESS 0x60034B24 /end MEASUREMENT
/begin MEASUREMENT DFC_b.TST_ComTOutTCU2 "Bit encoding / Tested bit for check DFC_ComTOutTCU2" UBYTE DFC_OneToOne 1 100 0.00 1.000 BIT_MASK 0x8 FORMAT "%5.3" ECU_ADDRESS 0x60034B25 /end MEASUREMENT
/begin MEASUREMENT DFC_b.TST_ComTOutTCU3 "Bit encoding / Tested bit for check DFC_ComTOutTCU3" UBYTE DFC_OneToOne 1 100 0.00 1.000 BIT_MASK 0x8 FORMAT "%5.3" ECU_ADDRESS 0x60034B26 /end MEASUREMENT
/begin MEASUREMENT DFC_b.TST_ComTOutTCU4 "Bit encoding / Tested bit for check DFC_ComTOutTCU4" UBYTE DFC_OneToOne 1 100 0.00 1.000 BIT_MASK 0x8 FORMAT "%5.3" ECU_ADDRESS 0x60034B27 /end MEASUREMENT
/begin MEASUREMENT DFC_b.TST_DevLibBattUHi "Bit encoding / Tested bit for check DFC_DevLibBattUHi" UBYTE DFC_OneToOne 1 100 0.00 1.000 BIT_MASK 0x8 FORMAT "%5.3" ECU_ADDRESS 0x60034B28 /end MEASUREMENT
/begin MEASUREMENT DFC_b.TST_DevLibBattULo "Bit encoding / Tested bit for check DFC_DevLibBattULo" UBYTE DFC_OneToOne 1 100 0.00 1.000 BIT_MASK 0x8 FORMAT "%5.3" ECU_ADDRESS 0x60034B29 /end MEASUREMENT
/begin MEASUREMENT DFC_b.TST_FanDIOOL_0 "Bit encoding / Tested bit for check DFC_FanDIOOL_0" UBYTE DFC_OneToOne 1 100 0.00 1.000 BIT_MASK 0x8 FORMAT "%5.3" ECU_ADDRESS 0x60034B2A /end MEASUREMENT
/begin MEASUREMENT DFC_b.TST_FanDIOOL_1 "Bit encoding / Tested bit for check DFC_FanDIOOL_1" UBYTE DFC_OneToOne 1 100 0.00 1.000 BIT_MASK 0x8 FORMAT "%5.3" ECU_ADDRESS 0x60034B2B /end MEASUREMENT
/begin MEASUREMENT DFC_b.TST_FanDIOOvrTemp_0 "Bit encoding / Tested bit for check DFC_FanDIOOvrTemp_0" UBYTE DFC_OneToOne 1 100 0.00 1.000 BIT_MASK 0x8 FORMAT "%5.3" ECU_ADDRESS 0x60034B2C /end MEASUREMENT
/begin MEASUREMENT DFC_b.TST_FanDIOOvrTemp_1 "Bit encoding / Tested bit for check DFC_FanDIOOvrTemp_1" UBYTE DFC_OneToOne 1 100 0.00 1.000 BIT_MASK 0x8 FORMAT "%5.3" ECU_ADDRESS 0x60034B2D /end MEASUREMENT
/begin MEASUREMENT DFC_b.TST_FanDIOSCB_0 "Bit encoding / Tested bit for check DFC_FanDIOSCB_0" UBYTE DFC_OneToOne 1 100 0.00 1.000 BIT_MASK 0x8 FORMAT "%5.3" ECU_ADDRESS 0x60034B2E /end MEASUREMENT
/begin MEASUREMENT DFC_b.TST_FanDIOSCB_1 "Bit encoding / Tested bit for check DFC_FanDIOSCB_1" UBYTE DFC_OneToOne 1 100 0.00 1.000 BIT_MASK 0x8 FORMAT "%5.3" ECU_ADDRESS 0x60034B2F /end MEASUREMENT
/begin MEASUREMENT DFC_b.TST_FanDIOSCG_0 "Bit encoding / Tested bit for check DFC_FanDIOSCG_0" UBYTE DFC_OneToOne 1 100 0.00 1.000 BIT_MASK 0x8 FORMAT "%5.3" ECU_ADDRESS 0x60034B30 /end MEASUREMENT
/begin MEASUREMENT DFC_b.TST_FanDIOSCG_1 "Bit encoding / Tested bit for check DFC_FanDIOSCG_1" UBYTE DFC_OneToOne 1 100 0.00 1.000 BIT_MASK 0x8 FORMAT "%5.3" ECU_ADDRESS 0x60034B31 /end MEASUREMENT
/begin MEASUREMENT DFC_b.TST_MRlyDcOL "Bit encoding / Tested bit for check DFC_MRlyDcOL" UBYTE DFC_OneToOne 1 100 0.00 1.000 BIT_MASK 0x8 FORMAT "%5.3" ECU_ADDRESS 0x60034B32 /end MEASUREMENT
/begin MEASUREMENT DFC_b.TST_MRlyDcSCB "Bit encoding / Tested bit for check DFC_MRlyDcSCB" UBYTE DFC_OneToOne 1 100 0.00 1.000 BIT_MASK 0x8 FORMAT "%5.3" ECU_ADDRESS 0x60034B33 /end MEASUREMENT
/begin MEASUREMENT DFC_b.TST_MRlyDcSCG "Bit encoding / Tested bit for check DFC_MRlyDcSCG" UBYTE DFC_OneToOne 1 100 0.00 1.000 BIT_MASK 0x8 FORMAT "%5.3" ECU_ADDRESS 0x60034B34 /end MEASUREMENT
/begin MEASUREMENT DFC_b.TST_PSPOL "Bit encoding / Tested bit for check DFC_PSPOL" UBYTE DFC_OneToOne 1 100 0.00 1.000 BIT_MASK 0x8 FORMAT "%5.3" ECU_ADDRESS 0x60034B35 /end MEASUREMENT
/begin MEASUREMENT DFC_b.TST_PSPOvrTemp "Bit encoding / Tested bit for check DFC_PSPOvrTemp" UBYTE DFC_OneToOne 1 100 0.00 1.000 BIT_MASK 0x8 FORMAT "%5.3" ECU_ADDRESS 0x60034B36 /end MEASUREMENT
/begin MEASUREMENT DFC_b.TST_PSPSCB "Bit encoding / Tested bit for check DFC_PSPSCB" UBYTE DFC_OneToOne 1 100 0.00 1.000 BIT_MASK 0x8 FORMAT "%5.3" ECU_ADDRESS 0x60034B37 /end MEASUREMENT
/begin MEASUREMENT DFC_b.TST_PSPSCG "Bit encoding / Tested bit for check DFC_PSPSCG" UBYTE DFC_OneToOne 1 100 0.00 1.000 BIT_MASK 0x8 FORMAT "%5.3" ECU_ADDRESS 0x60034B38 /end MEASUREMENT
/begin MEASUREMENT DFC_b.TST_T50Err "Bit encoding / Tested bit for check DFC_T50Err" UBYTE DFC_OneToOne 1 100 0.00 1.000 BIT_MASK 0x8 FORMAT "%5.3" ECU_ADDRESS 0x60034B39 /end MEASUREMENT
/begin MEASUREMENT DFC_b.TST_ThrVlvLoBattB1 "Bit encoding / Tested bit for check DFC_ThrVlvLoBattB1" UBYTE DFC_OneToOne 1 100 0.00 1.000 BIT_MASK 0x8 FORMAT "%5.3" ECU_ADDRESS 0x60034B3A /end MEASUREMENT
/begin MEASUREMENT DFC_b.TST_VehVPhysRngHi "Bit encoding / Tested bit for check DFC_VehVPhysRngHi" UBYTE DFC_OneToOne 1 100 0.00 1.000 BIT_MASK 0x8 FORMAT "%5.3" ECU_ADDRESS 0x60034B3B /end MEASUREMENT
/begin MEASUREMENT DFC_b.TST_VehVSclOutOL "Bit encoding / Tested bit for check DFC_VehVSclOutOL" UBYTE DFC_OneToOne 1 100 0.00 1.000 BIT_MASK 0x8 FORMAT "%5.3" ECU_ADDRESS 0x60034B3C /end MEASUREMENT
/begin MEASUREMENT DFC_b.TST_VehVSclOutOT "Bit encoding / Tested bit for check DFC_VehVSclOutOT" UBYTE DFC_OneToOne 1 100 0.00 1.000 BIT_MASK 0x8 FORMAT "%5.3" ECU_ADDRESS 0x60034B3D /end MEASUREMENT
/begin MEASUREMENT DFC_b.TST_VehVSclOutSCB "Bit encoding / Tested bit for check DFC_VehVSclOutSCB" UBYTE DFC_OneToOne 1 100 0.00 1.000 BIT_MASK 0x8 FORMAT "%5.3" ECU_ADDRESS 0x60034B3E /end MEASUREMENT
/begin MEASUREMENT DFC_b.TST_VehVSclOutSCG "Bit encoding / Tested bit for check DFC_VehVSclOutSCG" UBYTE DFC_OneToOne 1 100 0.00 1.000 BIT_MASK 0x8 FORMAT "%5.3" ECU_ADDRESS 0x60034B3F /end MEASUREMENT
/begin MEASUREMENT DFC_b.TST_VehVSnsrARngHi "Bit encoding / Tested bit for check DFC_VehVSnsrARngHi" UBYTE DFC_OneToOne 1 100 0.00 1.000 BIT_MASK 0x8 FORMAT "%5.3" ECU_ADDRESS 0x60034B40 /end MEASUREMENT
/begin MEASUREMENT DFC_b.TST_VehVSnsrBRngHi "Bit encoding / Tested bit for check DFC_VehVSnsrBRngHi" UBYTE DFC_OneToOne 1 100 0.00 1.000 BIT_MASK 0x8 FORMAT "%5.3" ECU_ADDRESS 0x60034B41 /end MEASUREMENT
/begin MEASUREMENT DFC_b.TST_VehVSpdRtyDiag "Bit encoding / Tested bit for check DFC_VehVSpdRtyDiag" UBYTE DFC_OneToOne 1 100 0.00 1.000 BIT_MASK 0x8 FORMAT "%5.3" ECU_ADDRESS 0x60034B42 /end MEASUREMENT
/begin MEASUREMENT DFC_b.TST_VehVWhlErr "Bit encoding / Tested bit for check DFC_VehVWhlErr" UBYTE DFC_OneToOne 1 100 0.00 1.000 BIT_MASK 0x8 FORMAT "%5.3" ECU_ADDRESS 0x60034B43 /end MEASUREMENT
/begin MEASUREMENT DFC_b.TST_ACEvpTSRCMax "Bit encoding / Tested bit for check DFC_ACEvpTSRCMax" UBYTE DFC_OneToOne 1 100 0.00 1.000 BIT_MASK 0x8 FORMAT "%5.3" ECU_ADDRESS 0x60034B44 /end MEASUREMENT
/begin MEASUREMENT DFC_b.TST_ACEvpTSRCMin "Bit encoding / Tested bit for check DFC_ACEvpTSRCMin" UBYTE DFC_OneToOne 1 100 0.00 1.000 BIT_MASK 0x8 FORMAT "%5.3" ECU_ADDRESS 0x60034B45 /end MEASUREMENT
/begin MEASUREMENT DFC_b.TST_AirCClntPAnaSRCMax "Bit encoding / Tested bit for check DFC_AirCClntPAnaSRCMax" UBYTE DFC_OneToOne 1 100 0.00 1.000 BIT_MASK 0x8 FORMAT "%5.3" ECU_ADDRESS 0x60034B46 /end MEASUREMENT
/begin MEASUREMENT DFC_b.TST_AirCClntPAnaSRCMin "Bit encoding / Tested bit for check DFC_AirCClntPAnaSRCMin" UBYTE DFC_OneToOne 1 100 0.00 1.000 BIT_MASK 0x8 FORMAT "%5.3" ECU_ADDRESS 0x60034B47 /end MEASUREMENT
/begin MEASUREMENT DFC_b.TST_AirCSwtNpl "Bit encoding / Tested bit for check DFC_AirCSwtNpl" UBYTE DFC_OneToOne 1 100 0.00 1.000 BIT_MASK 0x8 FORMAT "%5.3" ECU_ADDRESS 0x60034B48 /end MEASUREMENT
/begin MEASUREMENT DFC_b.TST_AirCSwtSig "Bit encoding / Tested bit for check DFC_AirCSwtSig" UBYTE DFC_OneToOne 1 100 0.00 1.000 BIT_MASK 0x8 FORMAT "%5.3" ECU_ADDRESS 0x60034B49 /end MEASUREMENT
/begin MEASUREMENT DFC_b.TST_Brk "Bit encoding / Tested bit for check DFC_Brk" UBYTE DFC_OneToOne 1 100 0.00 1.000 BIT_MASK 0x8 FORMAT "%5.3" ECU_ADDRESS 0x60034B4A /end MEASUREMENT
/begin MEASUREMENT DFC_b.TST_BrkSig "Bit encoding / Tested bit for check DFC_BrkSig" UBYTE DFC_OneToOne 1 100 0.00 1.000 BIT_MASK 0x8 FORMAT "%5.3" ECU_ADDRESS 0x60034B4B /end MEASUREMENT
/begin MEASUREMENT DFC_b.TST_ClthSig "Bit encoding / Tested bit for check DFC_ClthSig" UBYTE DFC_OneToOne 1 100 0.00 1.000 BIT_MASK 0x8 FORMAT "%5.3" ECU_ADDRESS 0x60034B4C /end MEASUREMENT
/begin MEASUREMENT DFC_b.TST_HLSDemOvhtEngLim "Bit encoding / Tested bit for check DFC_HLSDemOvhtEngLim" UBYTE DFC_OneToOne 1 100 0.00 1.000 BIT_MASK 0x8 FORMAT "%5.3" ECU_ADDRESS 0x60034B4D /end MEASUREMENT
/begin MEASUREMENT DFC_b.TST_OilPNpl "Bit encoding / Tested bit for check DFC_OilPNpl" UBYTE DFC_OneToOne 1 100 0.00 1.000 BIT_MASK 0x8 FORMAT "%5.3" ECU_ADDRESS 0x60034B4E /end MEASUREMENT
/begin MEASUREMENT DFC_b.TST_PIntkVUsLineHiB1 "Bit encoding / Tested bit for check DFC_PIntkVUsLineHiB1" UBYTE DFC_OneToOne 1 100 0.00 1.000 BIT_MASK 0x8 FORMAT "%5.3" ECU_ADDRESS 0x60034B4F /end MEASUREMENT
/begin MEASUREMENT DFC_b.TST_PIntkVUsLineLoB1 "Bit encoding / Tested bit for check DFC_PIntkVUsLineLoB1" UBYTE DFC_OneToOne 1 100 0.00 1.000 BIT_MASK 0x8 FORMAT "%5.3" ECU_ADDRESS 0x60034B50 /end MEASUREMENT
/begin MEASUREMENT DFC_b.TST_VehVPhysRngLo "Bit encoding / Tested bit for check DFC_VehVPhysRngLo" UBYTE DFC_OneToOne 1 100 0.00 1.000 BIT_MASK 0x8 FORMAT "%5.3" ECU_ADDRESS 0x60034B51 /end MEASUREMENT
/begin MEASUREMENT DFC_b.TST_VehVSigCan "Bit encoding / Tested bit for check DFC_VehVSigCan" UBYTE DFC_OneToOne 1 100 0.00 1.000 BIT_MASK 0x8 FORMAT "%5.3" ECU_ADDRESS 0x60034B52 /end MEASUREMENT
/begin MEASUREMENT DFC_b.TST_VehVSigCanSafe "Bit encoding / Tested bit for check DFC_VehVSigCanSafe" UBYTE DFC_OneToOne 1 100 0.00 1.000 BIT_MASK 0x8 FORMAT "%5.3" ECU_ADDRESS 0x60034B53 /end MEASUREMENT
/begin MEASUREMENT DFC_b.TST_VlvLftFbOilPSnsrIntk11SRCMax "Bit encoding / Tested bit for check DFC_VlvLftFbOilPSnsrIntk11SRCMax" UBYTE DFC_OneToOne 1 100 0.00 1.000 BIT_MASK 0x8 FORMAT "%5.3" ECU_ADDRESS 0x60034B54 /end MEASUREMENT
/begin MEASUREMENT DFC_b.TST_VlvLftFbOilPSnsrIntk11SRCMin "Bit encoding / Tested bit for check DFC_VlvLftFbOilPSnsrIntk11SRCMin" UBYTE DFC_OneToOne 1 100 0.00 1.000 BIT_MASK 0x8 FORMAT "%5.3" ECU_ADDRESS 0x60034B55 /end MEASUREMENT
/begin MEASUREMENT DFC_b.TST_ClthNpl "Bit encoding / Tested bit for check DFC_ClthNpl" UBYTE DFC_OneToOne 1 100 0.00 1.000 BIT_MASK 0x8 FORMAT "%5.3" ECU_ADDRESS 0x60034B56 /end MEASUREMENT
/begin MEASUREMENT DFC_b.TST_EV1max "Bit encoding / Tested bit for check DFC_EV1max" UBYTE DFC_OneToOne 1 100 0.00 1.000 BIT_MASK 0x8 FORMAT "%5.3" ECU_ADDRESS 0x60034B57 /end MEASUREMENT
/begin MEASUREMENT DFC_b.TST_EV1min "Bit encoding / Tested bit for check DFC_EV1min" UBYTE DFC_OneToOne 1 100 0.00 1.000 BIT_MASK 0x8 FORMAT "%5.3" ECU_ADDRESS 0x60034B58 /end MEASUREMENT
/begin MEASUREMENT DFC_b.TST_EV1sig "Bit encoding / Tested bit for check DFC_EV1sig" UBYTE DFC_OneToOne 1 100 0.00 1.000 BIT_MASK 0x8 FORMAT "%5.3" ECU_ADDRESS 0x60034B59 /end MEASUREMENT
/begin MEASUREMENT DFC_b.TST_EV2max "Bit encoding / Tested bit for check DFC_EV2max" UBYTE DFC_OneToOne 1 100 0.00 1.000 BIT_MASK 0x8 FORMAT "%5.3" ECU_ADDRESS 0x60034B5A /end MEASUREMENT
/begin MEASUREMENT DFC_b.TST_EV2min "Bit encoding / Tested bit for check DFC_EV2min" UBYTE DFC_OneToOne 1 100 0.00 1.000 BIT_MASK 0x8 FORMAT "%5.3" ECU_ADDRESS 0x60034B5B /end MEASUREMENT
/begin MEASUREMENT DFC_b.TST_EV2sig "Bit encoding / Tested bit for check DFC_EV2sig" UBYTE DFC_OneToOne 1 100 0.00 1.000 BIT_MASK 0x8 FORMAT "%5.3" ECU_ADDRESS 0x60034B5C /end MEASUREMENT
/begin MEASUREMENT DFC_b.TST_EV3max "Bit encoding / Tested bit for check DFC_EV3max" UBYTE DFC_OneToOne 1 100 0.00 1.000 BIT_MASK 0x8 FORMAT "%5.3" ECU_ADDRESS 0x60034B5D /end MEASUREMENT
/begin MEASUREMENT DFC_b.TST_EV3min "Bit encoding / Tested bit for check DFC_EV3min" UBYTE DFC_OneToOne 1 100 0.00 1.000 BIT_MASK 0x8 FORMAT "%5.3" ECU_ADDRESS 0x60034B5E /end MEASUREMENT
/begin MEASUREMENT DFC_b.TST_EV3sig "Bit encoding / Tested bit for check DFC_EV3sig" UBYTE DFC_OneToOne 1 100 0.00 1.000 BIT_MASK 0x8 FORMAT "%5.3" ECU_ADDRESS 0x60034B5F /end MEASUREMENT
/begin MEASUREMENT DFC_b.TST_EV4max "Bit encoding / Tested bit for check DFC_EV4max" UBYTE DFC_OneToOne 1 100 0.00 1.000 BIT_MASK 0x8 FORMAT "%5.3" ECU_ADDRESS 0x60034B60 /end MEASUREMENT
/begin MEASUREMENT DFC_b.TST_EV4min "Bit encoding / Tested bit for check DFC_EV4min" UBYTE DFC_OneToOne 1 100 0.00 1.000 BIT_MASK 0x8 FORMAT "%5.3" ECU_ADDRESS 0x60034B61 /end MEASUREMENT
/begin MEASUREMENT DFC_b.TST_EV4sig "Bit encoding / Tested bit for check DFC_EV4sig" UBYTE DFC_OneToOne 1 100 0.00 1.000 BIT_MASK 0x8 FORMAT "%5.3" ECU_ADDRESS 0x60034B62 /end MEASUREMENT
/begin MEASUREMENT DFC_b.TST_GbxPNPosnDrvCdn "Bit encoding / Tested bit for check DFC_GbxPNPosnDrvCdn" UBYTE DFC_OneToOne 1 100 0.00 1.000 BIT_MASK 0x8 FORMAT "%5.3" ECU_ADDRESS 0x60034B63 /end MEASUREMENT
/begin MEASUREMENT DFC_b.TST_GbxPNPosnPlausy "Bit encoding / Tested bit for check DFC_GbxPNPosnPlausy" UBYTE DFC_OneToOne 1 100 0.00 1.000 BIT_MASK 0x8 FORMAT "%5.3" ECU_ADDRESS 0x60034B64 /end MEASUREMENT
/begin MEASUREMENT DFC_b.TST_PEnvCcMax "Bit encoding / Tested bit for check DFC_PEnvCcMax" UBYTE DFC_OneToOne 1 100 0.00 1.000 BIT_MASK 0x8 FORMAT "%5.3" ECU_ADDRESS 0x60034B65 /end MEASUREMENT
/begin MEASUREMENT DFC_b.TST_PEnvCcMin "Bit encoding / Tested bit for check DFC_PEnvCcMin" UBYTE DFC_OneToOne 1 100 0.00 1.000 BIT_MASK 0x8 FORMAT "%5.3" ECU_ADDRESS 0x60034B66 /end MEASUREMENT
/begin MEASUREMENT DFC_b.TST_PEnvRngChkMax "Bit encoding / Tested bit for check DFC_PEnvRngChkMax" UBYTE DFC_OneToOne 1 100 0.00 1.000 BIT_MASK 0x8 FORMAT "%5.3" ECU_ADDRESS 0x60034B67 /end MEASUREMENT
/begin MEASUREMENT DFC_b.TST_PEnvRngChkMin "Bit encoding / Tested bit for check DFC_PEnvRngChkMin" UBYTE DFC_OneToOne 1 100 0.00 1.000 BIT_MASK 0x8 FORMAT "%5.3" ECU_ADDRESS 0x60034B68 /end MEASUREMENT
/begin MEASUREMENT DFC_b.TST_PEnvSnsrPlaus "Bit encoding / Tested bit for check DFC_PEnvSnsrPlaus" UBYTE DFC_OneToOne 1 100 0.00 1.000 BIT_MASK 0x8 FORMAT "%5.3" ECU_ADDRESS 0x60034B69 /end MEASUREMENT
/begin MEASUREMENT DFC_b.TST_UEGOHeatrPsS1B1Max "Bit encoding / Tested bit for check DFC_UEGOHeatrPsS1B1Max" UBYTE DFC_OneToOne 1 100 0.00 1.000 BIT_MASK 0x8 FORMAT "%5.3" ECU_ADDRESS 0x60034B6A /end MEASUREMENT
/begin MEASUREMENT DFC_b.TST_UEGOHeatrPsS1B1Min "Bit encoding / Tested bit for check DFC_UEGOHeatrPsS1B1Min" UBYTE DFC_OneToOne 1 100 0.00 1.000 BIT_MASK 0x8 FORMAT "%5.3" ECU_ADDRESS 0x60034B6B /end MEASUREMENT
/begin MEASUREMENT DFC_b.TST_UEGOHeatrPsS1B1Sig "Bit encoding / Tested bit for check DFC_UEGOHeatrPsS1B1Sig" UBYTE DFC_OneToOne 1 100 0.00 1.000 BIT_MASK 0x8 FORMAT "%5.3" ECU_ADDRESS 0x60034B6C /end MEASUREMENT
/begin MEASUREMENT DFC_b.TST_UEGOHeatrRlyPsOLS1B1 "Bit encoding / Tested bit for check DFC_UEGOHeatrRlyPsOLS1B1" UBYTE DFC_OneToOne 1 100 0.00 1.000 BIT_MASK 0x8 FORMAT "%5.3" ECU_ADDRESS 0x60034B6D /end MEASUREMENT
/begin MEASUREMENT DFC_b.TST_UEGOHeatrRlyPsSCBS1B1 "Bit encoding / Tested bit for check DFC_UEGOHeatrRlyPsSCBS1B1" UBYTE DFC_OneToOne 1 100 0.00 1.000 BIT_MASK 0x8 FORMAT "%5.3" ECU_ADDRESS 0x60034B6E /end MEASUREMENT
/begin MEASUREMENT DFC_b.TST_UEGOHeatrRlyPsSCGS1B1 "Bit encoding / Tested bit for check DFC_UEGOHeatrRlyPsSCGS1B1" UBYTE DFC_OneToOne 1 100 0.00 1.000 BIT_MASK 0x8 FORMAT "%5.3" ECU_ADDRESS 0x60034B6F /end MEASUREMENT
/begin MEASUREMENT DFC_b.TST_KnDetSens1PortAMax "Bit encoding / Tested bit for check DFC_KnDetSens1PortAMax" UBYTE DFC_OneToOne 1 100 0.00 1.000 BIT_MASK 0x8 FORMAT "%5.3" ECU_ADDRESS 0x60034B70 /end MEASUREMENT
/begin MEASUREMENT DFC_b.TST_KnDetSens1PortAMin "Bit encoding / Tested bit for check DFC_KnDetSens1PortAMin" UBYTE DFC_OneToOne 1 100 0.00 1.000 BIT_MASK 0x8 FORMAT "%5.3" ECU_ADDRESS 0x60034B71 /end MEASUREMENT
/begin MEASUREMENT DFC_b.TST_KnDetSens1PortBMax "Bit encoding / Tested bit for check DFC_KnDetSens1PortBMax" UBYTE DFC_OneToOne 1 100 0.00 1.000 BIT_MASK 0x8 FORMAT "%5.3" ECU_ADDRESS 0x60034B72 /end MEASUREMENT
/begin MEASUREMENT DFC_b.TST_KnDetSens1PortBMin "Bit encoding / Tested bit for check DFC_KnDetSens1PortBMin" UBYTE DFC_OneToOne 1 100 0.00 1.000 BIT_MASK 0x8 FORMAT "%5.3" ECU_ADDRESS 0x60034B73 /end MEASUREMENT
/begin MEASUREMENT DFC_b.TST_Clth2ONStuck "Bit encoding / Tested bit for check DFC_Clth2ONStuck" UBYTE DFC_OneToOne 1 100 0.00 1.000 BIT_MASK 0x8 FORMAT "%5.3" ECU_ADDRESS 0x60034B74 /end MEASUREMENT
/begin MEASUREMENT DFC_b.TST_Clth2ONStuckLdc "Bit encoding / Tested bit for check DFC_Clth2ONStuckLdc" UBYTE DFC_OneToOne 1 100 0.00 1.000 BIT_MASK 0x8 FORMAT "%5.3" ECU_ADDRESS 0x60034B75 /end MEASUREMENT
/begin MEASUREMENT DFC_b.TST_Clth3ONStuckLdc "Bit encoding / Tested bit for check DFC_Clth3ONStuckLdc" UBYTE DFC_OneToOne 1 100 0.00 1.000 BIT_MASK 0x8 FORMAT "%5.3" ECU_ADDRESS 0x60034B76 /end MEASUREMENT
/begin MEASUREMENT DFC_b.TST_Clth3ONStuckPostDrv "Bit encoding / Tested bit for check DFC_Clth3ONStuckPostDrv" UBYTE DFC_OneToOne 1 100 0.00 1.000 BIT_MASK 0x8 FORMAT "%5.3" ECU_ADDRESS 0x60034B77 /end MEASUREMENT
/begin MEASUREMENT DFC_b.TST_Clth4ONStuck "Bit encoding / Tested bit for check DFC_Clth4ONStuck" UBYTE DFC_OneToOne 1 100 0.00 1.000 BIT_MASK 0x8 FORMAT "%5.3" ECU_ADDRESS 0x60034B78 /end MEASUREMENT
/begin MEASUREMENT DFC_b.TST_Clth4ONStuckLdc "Bit encoding / Tested bit for check DFC_Clth4ONStuckLdc" UBYTE DFC_OneToOne 1 100 0.00 1.000 BIT_MASK 0x8 FORMAT "%5.3" ECU_ADDRESS 0x60034B79 /end MEASUREMENT
/begin MEASUREMENT DFC_b.TST_ComDLCTCU01 "Bit encoding / Tested bit for check DFC_ComDLCTCU01" UBYTE DFC_OneToOne 1 100 0.00 1.000 BIT_MASK 0x8 FORMAT "%5.3" ECU_ADDRESS 0x60034B7A /end MEASUREMENT
/begin MEASUREMENT DFC_b.TST_ComDLCTCU02 "Bit encoding / Tested bit for check DFC_ComDLCTCU02" UBYTE DFC_OneToOne 1 100 0.00 1.000 BIT_MASK 0x8 FORMAT "%5.3" ECU_ADDRESS 0x60034B7B /end MEASUREMENT
/begin MEASUREMENT DFC_b.TST_ComDLCTCU1 "Bit encoding / Tested bit for check DFC_ComDLCTCU1" UBYTE DFC_OneToOne 1 100 0.00 1.000 BIT_MASK 0x8 FORMAT "%5.3" ECU_ADDRESS 0x60034B7C /end MEASUREMENT
/begin MEASUREMENT DFC_b.TST_ComDLCTCU11 "Bit encoding / Tested bit for check DFC_ComDLCTCU11" UBYTE DFC_OneToOne 1 100 0.00 1.000 BIT_MASK 0x8 FORMAT "%5.3" ECU_ADDRESS 0x60034B7D /end MEASUREMENT
/begin MEASUREMENT DFC_b.TST_ComDLCTCU12 "Bit encoding / Tested bit for check DFC_ComDLCTCU12" UBYTE DFC_OneToOne 1 100 0.00 1.000 BIT_MASK 0x8 FORMAT "%5.3" ECU_ADDRESS 0x60034B7E /end MEASUREMENT
/begin MEASUREMENT DFC_b.TST_ComDLCTCU13 "Bit encoding / Tested bit for check DFC_ComDLCTCU13" UBYTE DFC_OneToOne 1 100 0.00 1.000 BIT_MASK 0x8 FORMAT "%5.3" ECU_ADDRESS 0x60034B7F /end MEASUREMENT
/begin MEASUREMENT DFC_b.TST_ComDLCTCU14 "Bit encoding / Tested bit for check DFC_ComDLCTCU14" UBYTE DFC_OneToOne 1 100 0.00 1.000 BIT_MASK 0x8 FORMAT "%5.3" ECU_ADDRESS 0x60034B80 /end MEASUREMENT
/begin MEASUREMENT DFC_b.TST_ComDLCTCU2 "Bit encoding / Tested bit for check DFC_ComDLCTCU2" UBYTE DFC_OneToOne 1 100 0.00 1.000 BIT_MASK 0x8 FORMAT "%5.3" ECU_ADDRESS 0x60034B81 /end MEASUREMENT
/begin MEASUREMENT DFC_b.TST_ComDLCTCU3 "Bit encoding / Tested bit for check DFC_ComDLCTCU3" UBYTE DFC_OneToOne 1 100 0.00 1.000 BIT_MASK 0x8 FORMAT "%5.3" ECU_ADDRESS 0x60034B82 /end MEASUREMENT
/begin MEASUREMENT DFC_b.TST_ComDLCTCU4 "Bit encoding / Tested bit for check DFC_ComDLCTCU4" UBYTE DFC_OneToOne 1 100 0.00 1.000 BIT_MASK 0x8 FORMAT "%5.3" ECU_ADDRESS 0x60034B83 /end MEASUREMENT
/begin MEASUREMENT DFC_b.TST_EVX "Bit encoding / Tested bit for check DFC_EVX" UBYTE DFC_OneToOne 1 100 0.00 1.000 BIT_MASK 0x8 FORMAT "%5.3" ECU_ADDRESS 0x60034B84 /end MEASUREMENT
/begin MEASUREMENT DFC_b.TST_EbsSocFlt "Bit encoding / Tested bit for check DFC_EbsSocFlt" UBYTE DFC_OneToOne 1 100 0.00 1.000 BIT_MASK 0x8 FORMAT "%5.3" ECU_ADDRESS 0x60034B85 /end MEASUREMENT
/begin MEASUREMENT DFC_b.TST_I14229VINErr "Bit encoding / Tested bit for check DFC_I14229VINErr" UBYTE DFC_OneToOne 1 100 0.00 1.000 BIT_MASK 0x8 FORMAT "%5.3" ECU_ADDRESS 0x60034B86 /end MEASUREMENT
/begin MEASUREMENT DFC_b.TST_LLRKHmax "Bit encoding / Tested bit for check DFC_LLRKHmax" UBYTE DFC_OneToOne 1 100 0.00 1.000 BIT_MASK 0x8 FORMAT "%5.3" ECU_ADDRESS 0x60034B87 /end MEASUREMENT
/begin MEASUREMENT DFC_b.TST_LLRKHmin "Bit encoding / Tested bit for check DFC_LLRKHmin" UBYTE DFC_OneToOne 1 100 0.00 1.000 BIT_MASK 0x8 FORMAT "%5.3" ECU_ADDRESS 0x60034B88 /end MEASUREMENT
/begin MEASUREMENT DFC_b.TST_LLRmax "Bit encoding / Tested bit for check DFC_LLRmax" UBYTE DFC_OneToOne 1 100 0.00 1.000 BIT_MASK 0x8 FORMAT "%5.3" ECU_ADDRESS 0x60034B89 /end MEASUREMENT
/begin MEASUREMENT DFC_b.TST_LLRmin "Bit encoding / Tested bit for check DFC_LLRmin" UBYTE DFC_OneToOne 1 100 0.00 1.000 BIT_MASK 0x8 FORMAT "%5.3" ECU_ADDRESS 0x60034B8A /end MEASUREMENT
/begin MEASUREMENT DFC_b.TST_RoughRoad "Bit encoding / Tested bit for check DFC_RoughRoad" UBYTE DFC_OneToOne 1 100 0.00 1.000 BIT_MASK 0x8 FORMAT "%5.3" ECU_ADDRESS 0x60034B8B /end MEASUREMENT
/begin MEASUREMENT DFC_b.TST_SiaEEPRdErr "Bit encoding / Tested bit for check DFC_SiaEEPRdErr" UBYTE DFC_OneToOne 1 100 0.00 1.000 BIT_MASK 0x8 FORMAT "%5.3" ECU_ADDRESS 0x60034B8C /end MEASUREMENT
/begin MEASUREMENT DFC_b.TST_SiaEEPWrngCod "Bit encoding / Tested bit for check DFC_SiaEEPWrngCod" UBYTE DFC_OneToOne 1 100 0.00 1.000 BIT_MASK 0x8 FORMAT "%5.3" ECU_ADDRESS 0x60034B8D /end MEASUREMENT
/begin MEASUREMENT DFC_b.TST_UegoDummy "Bit encoding / Tested bit for check DFC_UegoDummy" UBYTE DFC_OneToOne 1 100 0.00 1.000 BIT_MASK 0x8 FORMAT "%5.3" ECU_ADDRESS 0x60034B8E /end MEASUREMENT
/begin MEASUREMENT DFC_b.TST_BusDiagCANAPPLBusOff "Bit encoding / Tested bit for check DFC_BusDiagCANAPPLBusOff" UBYTE DFC_OneToOne 1 100 0.00 1.000 BIT_MASK 0x8 FORMAT "%5.3" ECU_ADDRESS 0x60034B8F /end MEASUREMENT
/begin MEASUREMENT DFC_b.TST_BusDiagCANCANCBusOff "Bit encoding / Tested bit for check DFC_BusDiagCANCANCBusOff" UBYTE DFC_OneToOne 1 100 0.00 1.000 BIT_MASK 0x8 FORMAT "%5.3" ECU_ADDRESS 0x60034B90 /end MEASUREMENT
/begin MEASUREMENT DFC_b.TST_BusDiagCANVEHICLEBusOff "Bit encoding / Tested bit for check DFC_BusDiagCANVEHICLEBusOff" UBYTE DFC_OneToOne 1 100 0.00 1.000 BIT_MASK 0x8 FORMAT "%5.3" ECU_ADDRESS 0x60034B91 /end MEASUREMENT
/begin MEASUREMENT DFC_b.TST_RBA_IODIAGPWR_rba_IoExtCy329_SignalVltSply_0 "Bit encoding / Tested bit for check DFC_RBA_IODIAGPWR_rba_IoExtCy329_SignalVltSply_0" UBYTE DFC_OneToOne 1 100 0.00 1.000 BIT_MASK 0x8 FORMAT "%5.3" ECU_ADDRESS 0x60034B92 /end MEASUREMENT
/begin MEASUREMENT DFC_b.TST_RBA_IODIAGPWR_rba_IoExtCy329_SignalVltSply_0OT "Bit encoding / Tested bit for check DFC_RBA_IODIAGPWR_rba_IoExtCy329_SignalVltSply_0OT" UBYTE DFC_OneToOne 1 100 0.00 1.000 BIT_MASK 0x8 FORMAT "%5.3" ECU_ADDRESS 0x60034B93 /end MEASUREMENT
/begin MEASUREMENT DFC_b.TST_RBA_IODIAGPWR_rba_IoExtCy329_SignalVltSply_0OV "Bit encoding / Tested bit for check DFC_RBA_IODIAGPWR_rba_IoExtCy329_SignalVltSply_0OV" UBYTE DFC_OneToOne 1 100 0.00 1.000 BIT_MASK 0x8 FORMAT "%5.3" ECU_ADDRESS 0x60034B94 /end MEASUREMENT
/begin MEASUREMENT DFC_b.TST_RBA_IODIAGPWR_rba_IoExtCy329_SignalVltSply_0SCG "Bit encoding / Tested bit for check DFC_RBA_IODIAGPWR_rba_IoExtCy329_SignalVltSply_0SCG" UBYTE DFC_OneToOne 1 100 0.00 1.000 BIT_MASK 0x8 FORMAT "%5.3" ECU_ADDRESS 0x60034B95 /end MEASUREMENT
/begin MEASUREMENT DFC_b.TST_RBA_IODIAGPWR_rba_IoExtCy329_SignalVltSply_0UV "Bit encoding / Tested bit for check DFC_RBA_IODIAGPWR_rba_IoExtCy329_SignalVltSply_0UV" UBYTE DFC_OneToOne 1 100 0.00 1.000 BIT_MASK 0x8 FORMAT "%5.3" ECU_ADDRESS 0x60034B96 /end MEASUREMENT
/begin MEASUREMENT DFC_b.TST_RBA_IODIAGPWR_rba_IoExtCy329_SignalVltSply_1 "Bit encoding / Tested bit for check DFC_RBA_IODIAGPWR_rba_IoExtCy329_SignalVltSply_1" UBYTE DFC_OneToOne 1 100 0.00 1.000 BIT_MASK 0x8 FORMAT "%5.3" ECU_ADDRESS 0x60034B97 /end MEASUREMENT
/begin MEASUREMENT DFC_b.TST_RBA_IODIAGPWR_rba_IoExtCy329_SignalVltSply_1OT "Bit encoding / Tested bit for check DFC_RBA_IODIAGPWR_rba_IoExtCy329_SignalVltSply_1OT" UBYTE DFC_OneToOne 1 100 0.00 1.000 BIT_MASK 0x8 FORMAT "%5.3" ECU_ADDRESS 0x60034B98 /end MEASUREMENT
/begin MEASUREMENT DFC_b.TST_RBA_IODIAGPWR_rba_IoExtCy329_SignalVltSply_1OV "Bit encoding / Tested bit for check DFC_RBA_IODIAGPWR_rba_IoExtCy329_SignalVltSply_1OV" UBYTE DFC_OneToOne 1 100 0.00 1.000 BIT_MASK 0x8 FORMAT "%5.3" ECU_ADDRESS 0x60034B99 /end MEASUREMENT
/begin MEASUREMENT DFC_b.TST_RBA_IODIAGPWR_rba_IoExtCy329_SignalVltSply_1SCG "Bit encoding / Tested bit for check DFC_RBA_IODIAGPWR_rba_IoExtCy329_SignalVltSply_1SCG" UBYTE DFC_OneToOne 1 100 0.00 1.000 BIT_MASK 0x8 FORMAT "%5.3" ECU_ADDRESS 0x60034B9A /end MEASUREMENT
/begin MEASUREMENT DFC_b.TST_RBA_IODIAGPWR_rba_IoExtCy329_SignalVltSply_1UV "Bit encoding / Tested bit for check DFC_RBA_IODIAGPWR_rba_IoExtCy329_SignalVltSply_1UV" UBYTE DFC_OneToOne 1 100 0.00 1.000 BIT_MASK 0x8 FORMAT "%5.3" ECU_ADDRESS 0x60034B9B /end MEASUREMENT
/begin MEASUREMENT DFC_b.TST_RBA_IODIAGPWR_rba_IoExtCy329_SignalVltSply_2 "Bit encoding / Tested bit for check DFC_RBA_IODIAGPWR_rba_IoExtCy329_SignalVltSply_2" UBYTE DFC_OneToOne 1 100 0.00 1.000 BIT_MASK 0x8 FORMAT "%5.3" ECU_ADDRESS 0x60034B9C /end MEASUREMENT
/begin MEASUREMENT DFC_b.TST_RBA_IODIAGPWR_rba_IoExtCy329_SignalVltSply_2OT "Bit encoding / Tested bit for check DFC_RBA_IODIAGPWR_rba_IoExtCy329_SignalVltSply_2OT" UBYTE DFC_OneToOne 1 100 0.00 1.000 BIT_MASK 0x8 FORMAT "%5.3" ECU_ADDRESS 0x60034B9D /end MEASUREMENT
/begin MEASUREMENT DFC_b.TST_RBA_IODIAGPWR_rba_IoExtCy329_SignalVltSply_2OV "Bit encoding / Tested bit for check DFC_RBA_IODIAGPWR_rba_IoExtCy329_SignalVltSply_2OV" UBYTE DFC_OneToOne 1 100 0.00 1.000 BIT_MASK 0x8 FORMAT "%5.3" ECU_ADDRESS 0x60034B9E /end MEASUREMENT
/begin MEASUREMENT DFC_b.TST_RBA_IODIAGPWR_rba_IoExtCy329_SignalVltSply_2SCG "Bit encoding / Tested bit for check DFC_RBA_IODIAGPWR_rba_IoExtCy329_SignalVltSply_2SCG" UBYTE DFC_OneToOne 1 100 0.00 1.000 BIT_MASK 0x8 FORMAT "%5.3" ECU_ADDRESS 0x60034B9F /end MEASUREMENT
/begin MEASUREMENT DFC_b.TST_RBA_IODIAGPWR_rba_IoExtCy329_SignalVltSply_2UV "Bit encoding / Tested bit for check DFC_RBA_IODIAGPWR_rba_IoExtCy329_SignalVltSply_2UV" UBYTE DFC_OneToOne 1 100 0.00 1.000 BIT_MASK 0x8 FORMAT "%5.3" ECU_ADDRESS 0x60034BA0 /end MEASUREMENT
/begin MEASUREMENT DFC_b.TST_CAN_E_TIMEOUT "Bit encoding / Tested bit for check DFC_CAN_E_TIMEOUT" UBYTE DFC_OneToOne 1 100 0.00 1.000 BIT_MASK 0x8 FORMAT "%5.3" ECU_ADDRESS 0x60034BA1 /end MEASUREMENT
/begin MEASUREMENT DFC_b.TST_LIN_E_TIMEOUT "Bit encoding / Tested bit for check DFC_LIN_E_TIMEOUT" UBYTE DFC_OneToOne 1 100 0.00 1.000 BIT_MASK 0x8 FORMAT "%5.3" ECU_ADDRESS 0x60034BA2 /end MEASUREMENT
/begin MEASUREMENT DFC_b.TST_MRlyOL "Bit encoding / Tested bit for check DFC_MRlyOL" UBYTE DFC_OneToOne 1 100 0.00 1.000 BIT_MASK 0x8 FORMAT "%5.3" ECU_ADDRESS 0x60034BA3 /end MEASUREMENT
/begin MEASUREMENT DFC_b.TST_MRlySCB "Bit encoding / Tested bit for check DFC_MRlySCB" UBYTE DFC_OneToOne 1 100 0.00 1.000 BIT_MASK 0x8 FORMAT "%5.3" ECU_ADDRESS 0x60034BA4 /end MEASUREMENT
/begin MEASUREMENT DFC_b.TST_MRlySCG "Bit encoding / Tested bit for check DFC_MRlySCG" UBYTE DFC_OneToOne 1 100 0.00 1.000 BIT_MASK 0x8 FORMAT "%5.3" ECU_ADDRESS 0x60034BA5 /end MEASUREMENT
/begin MEASUREMENT DFC_b.TST_rba_MultiStackTrace_Threshold "Bit encoding / Tested bit for check DFC_rba_MultiStackTrace_Threshold" UBYTE DFC_OneToOne 1 100 0.00 1.000 BIT_MASK 0x8 FORMAT "%5.3" ECU_ADDRESS 0x60034BA6 /end MEASUREMENT
/begin MEASUREMENT DFC_b.TST_BSWM_E_ACTION_FAILED "Bit encoding / Tested bit for check DFC_BSWM_E_ACTION_FAILED" UBYTE DFC_OneToOne 1 100 0.00 1.000 BIT_MASK 0x8 FORMAT "%5.3" ECU_ADDRESS 0x60034BA7 /end MEASUREMENT
/begin MEASUREMENT DFC_b.TST_BSWM_E_INTRPTQUEUE_FULL "Bit encoding / Tested bit for check DFC_BSWM_E_INTRPTQUEUE_FULL" UBYTE DFC_OneToOne 1 100 0.00 1.000 BIT_MASK 0x8 FORMAT "%5.3" ECU_ADDRESS 0x60034BA8 /end MEASUREMENT
/begin MEASUREMENT DFC_b.TST_RBA_IOEXTLIB_KEEPALIVE_DRV "Bit encoding / Tested bit for check DFC_RBA_IOEXTLIB_KEEPALIVE_DRV" UBYTE DFC_OneToOne 1 100 0.00 1.000 BIT_MASK 0x8 FORMAT "%5.3" ECU_ADDRESS 0x60034BA9 /end MEASUREMENT
/begin MEASUREMENT DFC_b.TST_RBA_IOEXTLIB_KEEPALIVE_INI "Bit encoding / Tested bit for check DFC_RBA_IOEXTLIB_KEEPALIVE_INI" UBYTE DFC_OneToOne 1 100 0.00 1.000 BIT_MASK 0x8 FORMAT "%5.3" ECU_ADDRESS 0x60034BAA /end MEASUREMENT
/begin MEASUREMENT DFC_b.TST_rba_IoSigRtc_StopCounter "Bit encoding / Tested bit for check DFC_rba_IoSigRtc_StopCounter" UBYTE DFC_OneToOne 1 100 0.00 1.000 BIT_MASK 0x8 FORMAT "%5.3" ECU_ADDRESS 0x60034BAB /end MEASUREMENT
/begin MEASUREMENT DFC_b.TST_rba_MRly_Diag_Stk_Event "Bit encoding / Tested bit for check DFC_rba_MRly_Diag_Stk_Event" UBYTE DFC_OneToOne 1 100 0.00 1.000 BIT_MASK 0x8 FORMAT "%5.3" ECU_ADDRESS 0x60034BAC /end MEASUREMENT
/begin MEASUREMENT DFC_b.TST_rba_MemDiag_MemReadErr "Bit encoding / Tested bit for check DFC_rba_MemDiag_MemReadErr" UBYTE DFC_OneToOne 1 100 0.00 1.000 BIT_MASK 0x8 FORMAT "%5.3" ECU_ADDRESS 0x60034BAD /end MEASUREMENT
/begin MEASUREMENT DFC_b.TST_rba_MemDiag_MemWrErr "Bit encoding / Tested bit for check DFC_rba_MemDiag_MemWrErr" UBYTE DFC_OneToOne 1 100 0.00 1.000 BIT_MASK 0x8 FORMAT "%5.3" ECU_ADDRESS 0x60034BAE /end MEASUREMENT
/begin MEASUREMENT DFC_b.TST_rba_SyC_IrrSwOffTrigEngRun_Event "Bit encoding / Tested bit for check DFC_rba_SyC_IrrSwOffTrigEngRun_Event" UBYTE DFC_OneToOne 1 100 0.00 1.000 BIT_MASK 0x8 FORMAT "%5.3" ECU_ADDRESS 0x60034BAF /end MEASUREMENT
/begin MEASUREMENT DFC_b.TST_rba_T15_Diag_ComInVld_Event "Bit encoding / Tested bit for check DFC_rba_T15_Diag_ComInVld_Event" UBYTE DFC_OneToOne 1 100 0.00 1.000 BIT_MASK 0x8 FORMAT "%5.3" ECU_ADDRESS 0x60034BB0 /end MEASUREMENT
/begin MEASUREMENT DFC_b.TST_rba_T15_Diag_ComOff_HwOn_Event "Bit encoding / Tested bit for check DFC_rba_T15_Diag_ComOff_HwOn_Event" UBYTE DFC_OneToOne 1 100 0.00 1.000 BIT_MASK 0x8 FORMAT "%5.3" ECU_ADDRESS 0x60034BB1 /end MEASUREMENT
/begin MEASUREMENT DFC_b.TST_rba_T15_Diag_ComOn_HwOff_Event "Bit encoding / Tested bit for check DFC_rba_T15_Diag_ComOn_HwOff_Event" UBYTE DFC_OneToOne 1 100 0.00 1.000 BIT_MASK 0x8 FORMAT "%5.3" ECU_ADDRESS 0x60034BB2 /end MEASUREMENT
/begin MEASUREMENT DFC_b.TST_AppAllSnsrDfct "Bit encoding / Tested bit for check DFC_AppAllSnsrDfct" UBYTE DFC_OneToOne 1 100 0.00 1.000 BIT_MASK 0x8 FORMAT "%5.3" ECU_ADDRESS 0x60034BB3 /end MEASUREMENT
/begin MEASUREMENT DFC_b.TST_BattUStdbyDiaOL "Bit encoding / Tested bit for check DFC_BattUStdbyDiaOL" UBYTE DFC_OneToOne 1 100 0.00 1.000 BIT_MASK 0x8 FORMAT "%5.3" ECU_ADDRESS 0x60034BB4 /end MEASUREMENT
/begin MEASUREMENT DFC_b.TST_BigLeakIntkMnfldEmiInfl "Bit encoding / Tested bit for check DFC_BigLeakIntkMnfldEmiInfl" UBYTE DFC_OneToOne 1 100 0.00 1.000 BIT_MASK 0x8 FORMAT "%5.3" ECU_ADDRESS 0x60034BB5 /end MEASUREMENT
/begin MEASUREMENT DFC_b.TST_BrkMnSwtContOnWarnLmp "Bit encoding / Tested bit for check DFC_BrkMnSwtContOnWarnLmp" UBYTE DFC_OneToOne 1 100 0.00 1.000 BIT_MASK 0x8 FORMAT "%5.3" ECU_ADDRESS 0x60034BB6 /end MEASUREMENT
/begin MEASUREMENT DFC_b.TST_BrkMnSwtNotStpWarnLmp "Bit encoding / Tested bit for check DFC_BrkMnSwtNotStpWarnLmp" UBYTE DFC_OneToOne 1 100 0.00 1.000 BIT_MASK 0x8 FORMAT "%5.3" ECU_ADDRESS 0x60034BB7 /end MEASUREMENT
/begin MEASUREMENT DFC_b.TST_BrkRdntSwtContOnWarnLmp "Bit encoding / Tested bit for check DFC_BrkRdntSwtContOnWarnLmp" UBYTE DFC_OneToOne 1 100 0.00 1.000 BIT_MASK 0x8 FORMAT "%5.3" ECU_ADDRESS 0x60034BB8 /end MEASUREMENT
/begin MEASUREMENT DFC_b.TST_BrkRdntSwtNotStpWarnLmp "Bit encoding / Tested bit for check DFC_BrkRdntSwtNotStpWarnLmp" UBYTE DFC_OneToOne 1 100 0.00 1.000 BIT_MASK 0x8 FORMAT "%5.3" ECU_ADDRESS 0x60034BB9 /end MEASUREMENT
/begin MEASUREMENT DFC_b.TST_CEngDsTColdStrtMax "Bit encoding / Tested bit for check DFC_CEngDsTColdStrtMax" UBYTE DFC_OneToOne 1 100 0.00 1.000 BIT_MASK 0x8 FORMAT "%5.3" ECU_ADDRESS 0x60034BBA /end MEASUREMENT
/begin MEASUREMENT DFC_b.TST_CEngDsTColdStrtMin "Bit encoding / Tested bit for check DFC_CEngDsTColdStrtMin" UBYTE DFC_OneToOne 1 100 0.00 1.000 BIT_MASK 0x8 FORMAT "%5.3" ECU_ADDRESS 0x60034BBB /end MEASUREMENT
/begin MEASUREMENT DFC_b.TST_CEngDsTImps "Bit encoding / Tested bit for check DFC_CEngDsTImps" UBYTE DFC_OneToOne 1 100 0.00 1.000 BIT_MASK 0x8 FORMAT "%5.3" ECU_ADDRESS 0x60034BBC /end MEASUREMENT
/begin MEASUREMENT DFC_b.TST_CEngDsTPlausLSC "Bit encoding / Tested bit for check DFC_CEngDsTPlausLSC" UBYTE DFC_OneToOne 1 100 0.00 1.000 BIT_MASK 0x8 FORMAT "%5.3" ECU_ADDRESS 0x60034BBD /end MEASUREMENT
/begin MEASUREMENT DFC_b.TST_CEngDsTPlausSTC "Bit encoding / Tested bit for check DFC_CEngDsTPlausSTC" UBYTE DFC_OneToOne 1 100 0.00 1.000 BIT_MASK 0x8 FORMAT "%5.3" ECU_ADDRESS 0x60034BBE /end MEASUREMENT
/begin MEASUREMENT DFC_b.TST_CEngDsTSRCMax "Bit encoding / Tested bit for check DFC_CEngDsTSRCMax" UBYTE DFC_OneToOne 1 100 0.00 1.000 BIT_MASK 0x8 FORMAT "%5.3" ECU_ADDRESS 0x60034BBF /end MEASUREMENT
/begin MEASUREMENT DFC_b.TST_CEngDsTSRCMin "Bit encoding / Tested bit for check DFC_CEngDsTSRCMin" UBYTE DFC_OneToOne 1 100 0.00 1.000 BIT_MASK 0x8 FORMAT "%5.3" ECU_ADDRESS 0x60034BC0 /end MEASUREMENT
/begin MEASUREMENT DFC_b.TST_CEngDsTSig "Bit encoding / Tested bit for check DFC_CEngDsTSig" UBYTE DFC_OneToOne 1 100 0.00 1.000 BIT_MASK 0x8 FORMAT "%5.3" ECU_ADDRESS 0x60034BC1 /end MEASUREMENT
/begin MEASUREMENT DFC_b.TST_CEngUsTSRCMax "Bit encoding / Tested bit for check DFC_CEngUsTSRCMax" UBYTE DFC_OneToOne 1 100 0.00 1.000 BIT_MASK 0x8 FORMAT "%5.3" ECU_ADDRESS 0x60034BC2 /end MEASUREMENT
/begin MEASUREMENT DFC_b.TST_CEngUsTSRCMin "Bit encoding / Tested bit for check DFC_CEngUsTSRCMin" UBYTE DFC_OneToOne 1 100 0.00 1.000 BIT_MASK 0x8 FORMAT "%5.3" ECU_ADDRESS 0x60034BC3 /end MEASUREMENT
/begin MEASUREMENT DFC_b.TST_DCDCFltDet "Bit encoding / Tested bit for check DFC_DCDCFltDet" UBYTE DFC_OneToOne 1 100 0.00 1.000 BIT_MASK 0x8 FORMAT "%5.3" ECU_ADDRESS 0x60034BC4 /end MEASUREMENT
/begin MEASUREMENT DFC_b.TST_DKRSA "Bit encoding / Tested bit for check DFC_DKRSA" UBYTE DFC_OneToOne 1 100 0.00 1.000 BIT_MASK 0x8 FORMAT "%5.3" ECU_ADDRESS 0x60034BC5 /end MEASUREMENT
/begin MEASUREMENT DFC_b.TST_DKVSmax "Bit encoding / Tested bit for check DFC_DKVSmax" UBYTE DFC_OneToOne 1 100 0.00 1.000 BIT_MASK 0x8 FORMAT "%5.3" ECU_ADDRESS 0x60034BC6 /end MEASUREMENT
/begin MEASUREMENT DFC_b.TST_DKnpl "Bit encoding / Tested bit for check DFC_DKnpl" UBYTE DFC_OneToOne 1 100 0.00 1.000 BIT_MASK 0x8 FORMAT "%5.3" ECU_ADDRESS 0x60034BC7 /end MEASUREMENT
/begin MEASUREMENT DFC_b.TST_DSSmax "Bit encoding / Tested bit for check DFC_DSSmax" UBYTE DFC_OneToOne 1 100 0.00 1.000 BIT_MASK 0x8 FORMAT "%5.3" ECU_ADDRESS 0x60034BC8 /end MEASUREMENT
/begin MEASUREMENT DFC_b.TST_DSTTI "Bit encoding / Tested bit for check DFC_DSTTI" UBYTE DFC_OneToOne 1 100 0.00 1.000 BIT_MASK 0x8 FORMAT "%5.3" ECU_ADDRESS 0x60034BC9 /end MEASUREMENT
/begin MEASUREMENT DFC_b.TST_DSUmax "Bit encoding / Tested bit for check DFC_DSUmax" UBYTE DFC_OneToOne 1 100 0.00 1.000 BIT_MASK 0x8 FORMAT "%5.3" ECU_ADDRESS 0x60034BCA /end MEASUREMENT
/begin MEASUREMENT DFC_b.TST_EGRVlvOL "Bit encoding / Tested bit for check DFC_EGRVlvOL" UBYTE DFC_OneToOne 1 100 0.00 1.000 BIT_MASK 0x8 FORMAT "%5.3" ECU_ADDRESS 0x60034BCB /end MEASUREMENT
/begin MEASUREMENT DFC_b.TST_EGRVlvSCB "Bit encoding / Tested bit for check DFC_EGRVlvSCB" UBYTE DFC_OneToOne 1 100 0.00 1.000 BIT_MASK 0x8 FORMAT "%5.3" ECU_ADDRESS 0x60034BCC /end MEASUREMENT
/begin MEASUREMENT DFC_b.TST_EGRVlvSCG "Bit encoding / Tested bit for check DFC_EGRVlvSCG" UBYTE DFC_OneToOne 1 100 0.00 1.000 BIT_MASK 0x8 FORMAT "%5.3" ECU_ADDRESS 0x60034BCD /end MEASUREMENT
/begin MEASUREMENT DFC_b.TST_EGSDUS2B1LtrDly "Bit encoding / Tested bit for check DFC_EGSDUS2B1LtrDly" UBYTE DFC_OneToOne 1 100 0.00 1.000 BIT_MASK 0x8 FORMAT "%5.3" ECU_ADDRESS 0x60034BCE /end MEASUREMENT
/begin MEASUREMENT DFC_b.TST_EGSDUS2B1LtrPT1 "Bit encoding / Tested bit for check DFC_EGSDUS2B1LtrPT1" UBYTE DFC_OneToOne 1 100 0.00 1.000 BIT_MASK 0x8 FORMAT "%5.3" ECU_ADDRESS 0x60034BCF /end MEASUREMENT
/begin MEASUREMENT DFC_b.TST_EGSDUS2B1RtlDly "Bit encoding / Tested bit for check DFC_EGSDUS2B1RtlDly" UBYTE DFC_OneToOne 1 100 0.00 1.000 BIT_MASK 0x8 FORMAT "%5.3" ECU_ADDRESS 0x60034BD0 /end MEASUREMENT
/begin MEASUREMENT DFC_b.TST_EGSDUS2B1RtlPT1 "Bit encoding / Tested bit for check DFC_EGSDUS2B1RtlPT1" UBYTE DFC_OneToOne 1 100 0.00 1.000 BIT_MASK 0x8 FORMAT "%5.3" ECU_ADDRESS 0x60034BD1 /end MEASUREMENT
/begin MEASUREMENT DFC_b.TST_EGSDUS2B1TarLean "Bit encoding / Tested bit for check DFC_EGSDUS2B1TarLean" UBYTE DFC_OneToOne 1 100 0.00 1.000 BIT_MASK 0x8 FORMAT "%5.3" ECU_ADDRESS 0x60034BD2 /end MEASUREMENT
/begin MEASUREMENT DFC_b.TST_EGSDUS2B1TarRich "Bit encoding / Tested bit for check DFC_EGSDUS2B1TarRich" UBYTE DFC_OneToOne 1 100 0.00 1.000 BIT_MASK 0x8 FORMAT "%5.3" ECU_ADDRESS 0x60034BD3 /end MEASUREMENT
/begin MEASUREMENT DFC_b.TST_ETAKHLmax "Bit encoding / Tested bit for check DFC_ETAKHLmax" UBYTE DFC_OneToOne 1 100 0.00 1.000 BIT_MASK 0x8 FORMAT "%5.3" ECU_ADDRESS 0x60034BD4 /end MEASUREMENT
/begin MEASUREMENT DFC_b.TST_ETAKHTmax "Bit encoding / Tested bit for check DFC_ETAKHTmax" UBYTE DFC_OneToOne 1 100 0.00 1.000 BIT_MASK 0x8 FORMAT "%5.3" ECU_ADDRESS 0x60034BD5 /end MEASUREMENT
/begin MEASUREMENT DFC_b.TST_EngICO "Bit encoding / Tested bit for check DFC_EngICO" UBYTE DFC_OneToOne 1 100 0.00 1.000 BIT_MASK 0x8 FORMAT "%5.3" ECU_ADDRESS 0x60034BD6 /end MEASUREMENT
/begin MEASUREMENT DFC_b.TST_EngPrtOvrSpdMon "Bit encoding / Tested bit for check DFC_EngPrtOvrSpdMon" UBYTE DFC_OneToOne 1 100 0.00 1.000 BIT_MASK 0x8 FORMAT "%5.3" ECU_ADDRESS 0x60034BD7 /end MEASUREMENT
/begin MEASUREMENT DFC_b.TST_EpmCaSI1ErrSig "Bit encoding / Tested bit for check DFC_EpmCaSI1ErrSig" UBYTE DFC_OneToOne 1 100 0.00 1.000 BIT_MASK 0x8 FORMAT "%5.3" ECU_ADDRESS 0x60034BD8 /end MEASUREMENT
/begin MEASUREMENT DFC_b.TST_EpmCaSI1NoSig "Bit encoding / Tested bit for check DFC_EpmCaSI1NoSig" UBYTE DFC_OneToOne 1 100 0.00 1.000 BIT_MASK 0x8 FORMAT "%5.3" ECU_ADDRESS 0x60034BD9 /end MEASUREMENT
/begin MEASUREMENT DFC_b.TST_EpmCaSI1OfsErr "Bit encoding / Tested bit for check DFC_EpmCaSI1OfsErr" UBYTE DFC_OneToOne 1 100 0.00 1.000 BIT_MASK 0x8 FORMAT "%5.3" ECU_ADDRESS 0x60034BDA /end MEASUREMENT
/begin MEASUREMENT DFC_b.TST_EpmCrSErrSig "Bit encoding / Tested bit for check DFC_EpmCrSErrSig" UBYTE DFC_OneToOne 1 100 0.00 1.000 BIT_MASK 0x8 FORMAT "%5.3" ECU_ADDRESS 0x60034BDB /end MEASUREMENT
/begin MEASUREMENT DFC_b.TST_EpmCrSNoSig "Bit encoding / Tested bit for check DFC_EpmCrSNoSig" UBYTE DFC_OneToOne 1 100 0.00 1.000 BIT_MASK 0x8 FORMAT "%5.3" ECU_ADDRESS 0x60034BDC /end MEASUREMENT
/begin MEASUREMENT DFC_b.TST_EtaEngIdleNonCsers "Bit encoding / Tested bit for check DFC_EtaEngIdleNonCsers" UBYTE DFC_OneToOne 1 100 0.00 1.000 BIT_MASK 0x8 FORMAT "%5.3" ECU_ADDRESS 0x60034BDD /end MEASUREMENT
/begin MEASUREMENT DFC_b.TST_EtaEngPtlNonCsers "Bit encoding / Tested bit for check DFC_EtaEngPtlNonCsers" UBYTE DFC_OneToOne 1 100 0.00 1.000 BIT_MASK 0x8 FORMAT "%5.3" ECU_ADDRESS 0x60034BDE /end MEASUREMENT
/begin MEASUREMENT DFC_b.TST_FRAmax "Bit encoding / Tested bit for check DFC_FRAmax" UBYTE DFC_OneToOne 1 100 0.00 1.000 BIT_MASK 0x8 FORMAT "%5.3" ECU_ADDRESS 0x60034BDF /end MEASUREMENT
/begin MEASUREMENT DFC_b.TST_FRAmin "Bit encoding / Tested bit for check DFC_FRAmin" UBYTE DFC_OneToOne 1 100 0.00 1.000 BIT_MASK 0x8 FORMAT "%5.3" ECU_ADDRESS 0x60034BE0 /end MEASUREMENT
/begin MEASUREMENT DFC_b.TST_GbxRvsSwtStk "Bit encoding / Tested bit for check DFC_GbxRvsSwtStk" UBYTE DFC_OneToOne 1 100 0.00 1.000 BIT_MASK 0x8 FORMAT "%5.3" ECU_ADDRESS 0x60034BE1 /end MEASUREMENT
/begin MEASUREMENT DFC_b.TST_HDRmax "Bit encoding / Tested bit for check DFC_HDRmax" UBYTE DFC_OneToOne 1 100 0.00 1.000 BIT_MASK 0x8 FORMAT "%5.3" ECU_ADDRESS 0x60034BE2 /end MEASUREMENT
/begin MEASUREMENT DFC_b.TST_HEGOS2B1ElecMax "Bit encoding / Tested bit for check DFC_HEGOS2B1ElecMax" UBYTE DFC_OneToOne 1 100 0.00 1.000 BIT_MASK 0x8 FORMAT "%5.3" ECU_ADDRESS 0x60034BE3 /end MEASUREMENT
/begin MEASUREMENT DFC_b.TST_HEGOS2B1ElecMin "Bit encoding / Tested bit for check DFC_HEGOS2B1ElecMin" UBYTE DFC_OneToOne 1 100 0.00 1.000 BIT_MASK 0x8 FORMAT "%5.3" ECU_ADDRESS 0x60034BE4 /end MEASUREMENT
/begin MEASUREMENT DFC_b.TST_HEGOS2B1ElecSig "Bit encoding / Tested bit for check DFC_HEGOS2B1ElecSig" UBYTE DFC_OneToOne 1 100 0.00 1.000 BIT_MASK 0x8 FORMAT "%5.3" ECU_ADDRESS 0x60034BE5 /end MEASUREMENT
/begin MEASUREMENT DFC_b.TST_HEGOS2B1HtgNpl "Bit encoding / Tested bit for check DFC_HEGOS2B1HtgNpl" UBYTE DFC_OneToOne 1 100 0.00 1.000 BIT_MASK 0x8 FORMAT "%5.3" ECU_ADDRESS 0x60034BE6 /end MEASUREMENT
/begin MEASUREMENT DFC_b.TST_IntkAirTIntkMnfldCrssMax "Bit encoding / Tested bit for check DFC_IntkAirTIntkMnfldCrssMax" UBYTE DFC_OneToOne 1 100 0.00 1.000 BIT_MASK 0x8 FORMAT "%5.3" ECU_ADDRESS 0x60034BE7 /end MEASUREMENT
/begin MEASUREMENT DFC_b.TST_IntkAirTIntkMnfldCrssMin "Bit encoding / Tested bit for check DFC_IntkAirTIntkMnfldCrssMin" UBYTE DFC_OneToOne 1 100 0.00 1.000 BIT_MASK 0x8 FORMAT "%5.3" ECU_ADDRESS 0x60034BE8 /end MEASUREMENT
/begin MEASUREMENT DFC_b.TST_IntkAirTIntkMnfldHSCMax "Bit encoding / Tested bit for check DFC_IntkAirTIntkMnfldHSCMax" UBYTE DFC_OneToOne 1 100 0.00 1.000 BIT_MASK 0x8 FORMAT "%5.3" ECU_ADDRESS 0x60034BE9 /end MEASUREMENT
/begin MEASUREMENT DFC_b.TST_IntkAirTIntkMnfldImps "Bit encoding / Tested bit for check DFC_IntkAirTIntkMnfldImps" UBYTE DFC_OneToOne 1 100 0.00 1.000 BIT_MASK 0x8 FORMAT "%5.3" ECU_ADDRESS 0x60034BEA /end MEASUREMENT
/begin MEASUREMENT DFC_b.TST_IntkAirTIntkMnfldPRCMax "Bit encoding / Tested bit for check DFC_IntkAirTIntkMnfldPRCMax" UBYTE DFC_OneToOne 1 100 0.00 1.000 BIT_MASK 0x8 FORMAT "%5.3" ECU_ADDRESS 0x60034BEB /end MEASUREMENT
/begin MEASUREMENT DFC_b.TST_IntkAirTIntkMnfldPRCMin "Bit encoding / Tested bit for check DFC_IntkAirTIntkMnfldPRCMin" UBYTE DFC_OneToOne 1 100 0.00 1.000 BIT_MASK 0x8 FORMAT "%5.3" ECU_ADDRESS 0x60034BEC /end MEASUREMENT
/begin MEASUREMENT DFC_b.TST_IntkAirTIntkMnfldSRCMax "Bit encoding / Tested bit for check DFC_IntkAirTIntkMnfldSRCMax" UBYTE DFC_OneToOne 1 100 0.00 1.000 BIT_MASK 0x8 FORMAT "%5.3" ECU_ADDRESS 0x60034BED /end MEASUREMENT
/begin MEASUREMENT DFC_b.TST_IntkAirTIntkMnfldSRCMin "Bit encoding / Tested bit for check DFC_IntkAirTIntkMnfldSRCMin" UBYTE DFC_OneToOne 1 100 0.00 1.000 BIT_MASK 0x8 FORMAT "%5.3" ECU_ADDRESS 0x60034BEE /end MEASUREMENT
/begin MEASUREMENT DFC_b.TST_IntkAirTIntkMnfldSTC "Bit encoding / Tested bit for check DFC_IntkAirTIntkMnfldSTC" UBYTE DFC_OneToOne 1 100 0.00 1.000 BIT_MASK 0x8 FORMAT "%5.3" ECU_ADDRESS 0x60034BEF /end MEASUREMENT
/begin MEASUREMENT DFC_b.TST_KS1max "Bit encoding / Tested bit for check DFC_KS1max" UBYTE DFC_OneToOne 1 100 0.00 1.000 BIT_MASK 0x8 FORMAT "%5.3" ECU_ADDRESS 0x60034BF0 /end MEASUREMENT
/begin MEASUREMENT DFC_b.TST_KS1min "Bit encoding / Tested bit for check DFC_KS1min" UBYTE DFC_OneToOne 1 100 0.00 1.000 BIT_MASK 0x8 FORMAT "%5.3" ECU_ADDRESS 0x60034BF1 /end MEASUREMENT
/begin MEASUREMENT DFC_b.TST_LMmax "Bit encoding / Tested bit for check DFC_LMmax" UBYTE DFC_OneToOne 1 100 0.00 1.000 BIT_MASK 0x8 FORMAT "%5.3" ECU_ADDRESS 0x60034BF2 /end MEASUREMENT
/begin MEASUREMENT DFC_b.TST_LZSRnpl "Bit encoding / Tested bit for check DFC_LZSRnpl" UBYTE DFC_OneToOne 1 100 0.00 1.000 BIT_MASK 0x8 FORMAT "%5.3" ECU_ADDRESS 0x60034BF3 /end MEASUREMENT
/begin MEASUREMENT DFC_b.TST_LamDynDiagS1B1 "Bit encoding / Tested bit for check DFC_LamDynDiagS1B1" UBYTE DFC_OneToOne 1 100 0.00 1.000 BIT_MASK 0x8 FORMAT "%5.3" ECU_ADDRESS 0x60034BF4 /end MEASUREMENT
/begin MEASUREMENT DFC_b.TST_LeakIntkMnfldEmiInfl "Bit encoding / Tested bit for check DFC_LeakIntkMnfldEmiInfl" UBYTE DFC_OneToOne 1 100 0.00 1.000 BIT_MASK 0x8 FORMAT "%5.3" ECU_ADDRESS 0x60034BF5 /end MEASUREMENT
/begin MEASUREMENT DFC_b.TST_MD00max "Bit encoding / Tested bit for check DFC_MD00max" UBYTE DFC_OneToOne 1 100 0.00 1.000 BIT_MASK 0x8 FORMAT "%5.3" ECU_ADDRESS 0x60034BF6 /end MEASUREMENT
/begin MEASUREMENT DFC_b.TST_MDBmax "Bit encoding / Tested bit for check DFC_MDBmax" UBYTE DFC_OneToOne 1 100 0.00 1.000 BIT_MASK 0x8 FORMAT "%5.3" ECU_ADDRESS 0x60034BF7 /end MEASUREMENT
/begin MEASUREMENT DFC_b.TST_MDCat "Bit encoding / Tested bit for check DFC_MDCat" UBYTE DFC_OneToOne 1 100 0.00 1.000 BIT_MASK 0x8 FORMAT "%5.3" ECU_ADDRESS 0x60034BF8 /end MEASUREMENT
/begin MEASUREMENT DFC_b.TST_MDCatCrit "Bit encoding / Tested bit for check DFC_MDCatCrit" UBYTE DFC_OneToOne 1 100 0.00 1.000 BIT_MASK 0x8 FORMAT "%5.3" ECU_ADDRESS 0x60034BF9 /end MEASUREMENT
/begin MEASUREMENT DFC_b.TST_MDCatCurr "Bit encoding / Tested bit for check DFC_MDCatCurr" UBYTE DFC_OneToOne 1 100 0.00 1.000 BIT_MASK 0x8 FORMAT "%5.3" ECU_ADDRESS 0x60034BFA /end MEASUREMENT
/begin MEASUREMENT DFC_b.TST_MDCyl_0 "Bit encoding / Tested bit for check DFC_MDCyl_0" UBYTE DFC_OneToOne 1 100 0.00 1.000 BIT_MASK 0x8 FORMAT "%5.3" ECU_ADDRESS 0x60034BFB /end MEASUREMENT
/begin MEASUREMENT DFC_b.TST_MDCyl_1 "Bit encoding / Tested bit for check DFC_MDCyl_1" UBYTE DFC_OneToOne 1 100 0.00 1.000 BIT_MASK 0x8 FORMAT "%5.3" ECU_ADDRESS 0x60034BFC /end MEASUREMENT
/begin MEASUREMENT DFC_b.TST_MDCyl_2 "Bit encoding / Tested bit for check DFC_MDCyl_2" UBYTE DFC_OneToOne 1 100 0.00 1.000 BIT_MASK 0x8 FORMAT "%5.3" ECU_ADDRESS 0x60034BFD /end MEASUREMENT
/begin MEASUREMENT DFC_b.TST_MDCyl_3 "Bit encoding / Tested bit for check DFC_MDCyl_3" UBYTE DFC_OneToOne 1 100 0.00 1.000 BIT_MASK 0x8 FORMAT "%5.3" ECU_ADDRESS 0x60034BFE /end MEASUREMENT
/begin MEASUREMENT DFC_b.TST_MDEmi "Bit encoding / Tested bit for check DFC_MDEmi" UBYTE DFC_OneToOne 1 100 0.00 1.000 BIT_MASK 0x8 FORMAT "%5.3" ECU_ADDRESS 0x60034BFF /end MEASUREMENT
/begin MEASUREMENT DFC_b.TST_MDEmiStrt "Bit encoding / Tested bit for check DFC_MDEmiStrt" UBYTE DFC_OneToOne 1 100 0.00 1.000 BIT_MASK 0x8 FORMAT "%5.3" ECU_ADDRESS 0x60034C00 /end MEASUREMENT
/begin MEASUREMENT DFC_b.TST_MDFco "Bit encoding / Tested bit for check DFC_MDFco" UBYTE DFC_OneToOne 1 100 0.00 1.000 BIT_MASK 0x8 FORMAT "%5.3" ECU_ADDRESS 0x60034C01 /end MEASUREMENT
/begin MEASUREMENT DFC_b.TST_MDMpl "Bit encoding / Tested bit for check DFC_MDMpl" UBYTE DFC_OneToOne 1 100 0.00 1.000 BIT_MASK 0x8 FORMAT "%5.3" ECU_ADDRESS 0x60034C02 /end MEASUREMENT
/begin MEASUREMENT DFC_b.TST_MDSegTiAdpn "Bit encoding / Tested bit for check DFC_MDSegTiAdpn" UBYTE DFC_OneToOne 1 100 0.00 1.000 BIT_MASK 0x8 FORMAT "%5.3" ECU_ADDRESS 0x60034C03 /end MEASUREMENT
/begin MEASUREMENT DFC_b.TST_MDmax "Bit encoding / Tested bit for check DFC_MDmax" UBYTE DFC_OneToOne 1 100 0.00 1.000 BIT_MASK 0x8 FORMAT "%5.3" ECU_ADDRESS 0x60034C04 /end MEASUREMENT
/begin MEASUREMENT DFC_b.TST_MOXEMM_SMU_ALM0_0 "Bit encoding / Tested bit for check DFC_MOXEMM_SMU_ALM0_0" UBYTE DFC_OneToOne 1 100 0.00 1.000 BIT_MASK 0x8 FORMAT "%5.3" ECU_ADDRESS 0x60034C05 /end MEASUREMENT
/begin MEASUREMENT DFC_b.TST_MOXEMM_SMU_ALM0_1 "Bit encoding / Tested bit for check DFC_MOXEMM_SMU_ALM0_1" UBYTE DFC_OneToOne 1 100 0.00 1.000 BIT_MASK 0x8 FORMAT "%5.3" ECU_ADDRESS 0x60034C06 /end MEASUREMENT
/begin MEASUREMENT DFC_b.TST_MOXEMM_SMU_ALM0_10 "Bit encoding / Tested bit for check DFC_MOXEMM_SMU_ALM0_10" UBYTE DFC_OneToOne 1 100 0.00 1.000 BIT_MASK 0x8 FORMAT "%5.3" ECU_ADDRESS 0x60034C07 /end MEASUREMENT
/begin MEASUREMENT DFC_b.TST_MOXEMM_SMU_ALM0_11 "Bit encoding / Tested bit for check DFC_MOXEMM_SMU_ALM0_11" UBYTE DFC_OneToOne 1 100 0.00 1.000 BIT_MASK 0x8 FORMAT "%5.3" ECU_ADDRESS 0x60034C08 /end MEASUREMENT
/begin MEASUREMENT DFC_b.TST_MOXEMM_SMU_ALM0_13 "Bit encoding / Tested bit for check DFC_MOXEMM_SMU_ALM0_13" UBYTE DFC_OneToOne 1 100 0.00 1.000 BIT_MASK 0x8 FORMAT "%5.3" ECU_ADDRESS 0x60034C09 /end MEASUREMENT
/begin MEASUREMENT DFC_b.TST_MOXEMM_SMU_ALM0_14 "Bit encoding / Tested bit for check DFC_MOXEMM_SMU_ALM0_14" UBYTE DFC_OneToOne 1 100 0.00 1.000 BIT_MASK 0x8 FORMAT "%5.3" ECU_ADDRESS 0x60034C0A /end MEASUREMENT
/begin MEASUREMENT DFC_b.TST_MOXEMM_SMU_ALM0_2 "Bit encoding / Tested bit for check DFC_MOXEMM_SMU_ALM0_2" UBYTE DFC_OneToOne 1 100 0.00 1.000 BIT_MASK 0x8 FORMAT "%5.3" ECU_ADDRESS 0x60034C0B /end MEASUREMENT
/begin MEASUREMENT DFC_b.TST_MOXEMM_SMU_ALM0_22 "Bit encoding / Tested bit for check DFC_MOXEMM_SMU_ALM0_22" UBYTE DFC_OneToOne 1 100 0.00 1.000 BIT_MASK 0x8 FORMAT "%5.3" ECU_ADDRESS 0x60034C0C /end MEASUREMENT
/begin MEASUREMENT DFC_b.TST_MOXEMM_SMU_ALM0_23 "Bit encoding / Tested bit for check DFC_MOXEMM_SMU_ALM0_23" UBYTE DFC_OneToOne 1 100 0.00 1.000 BIT_MASK 0x8 FORMAT "%5.3" ECU_ADDRESS 0x60034C0D /end MEASUREMENT
/begin MEASUREMENT DFC_b.TST_MOXEMM_SMU_ALM0_4 "Bit encoding / Tested bit for check DFC_MOXEMM_SMU_ALM0_4" UBYTE DFC_OneToOne 1 100 0.00 1.000 BIT_MASK 0x8 FORMAT "%5.3" ECU_ADDRESS 0x60034C0E /end MEASUREMENT
/begin MEASUREMENT DFC_b.TST_MOXEMM_SMU_ALM0_5 "Bit encoding / Tested bit for check DFC_MOXEMM_SMU_ALM0_5" UBYTE DFC_OneToOne 1 100 0.00 1.000 BIT_MASK 0x8 FORMAT "%5.3" ECU_ADDRESS 0x60034C0F /end MEASUREMENT
/begin MEASUREMENT DFC_b.TST_MOXEMM_SMU_ALM0_7 "Bit encoding / Tested bit for check DFC_MOXEMM_SMU_ALM0_7" UBYTE DFC_OneToOne 1 100 0.00 1.000 BIT_MASK 0x8 FORMAT "%5.3" ECU_ADDRESS 0x60034C10 /end MEASUREMENT
/begin MEASUREMENT DFC_b.TST_MOXEMM_SMU_ALM0_8 "Bit encoding / Tested bit for check DFC_MOXEMM_SMU_ALM0_8" UBYTE DFC_OneToOne 1 100 0.00 1.000 BIT_MASK 0x8 FORMAT "%5.3" ECU_ADDRESS 0x60034C11 /end MEASUREMENT
/begin MEASUREMENT DFC_b.TST_MOXEMM_SMU_ALM10_16 "Bit encoding / Tested bit for check DFC_MOXEMM_SMU_ALM10_16" UBYTE DFC_OneToOne 1 100 0.00 1.000 BIT_MASK 0x8 FORMAT "%5.3" ECU_ADDRESS 0x60034C12 /end MEASUREMENT
/begin MEASUREMENT DFC_b.TST_MOXEMM_SMU_ALM10_17 "Bit encoding / Tested bit for check DFC_MOXEMM_SMU_ALM10_17" UBYTE DFC_OneToOne 1 100 0.00 1.000 BIT_MASK 0x8 FORMAT "%5.3" ECU_ADDRESS 0x60034C13 /end MEASUREMENT
/begin MEASUREMENT DFC_b.TST_MOXEMM_SMU_ALM10_21 "Bit encoding / Tested bit for check DFC_MOXEMM_SMU_ALM10_21" UBYTE DFC_OneToOne 1 100 0.00 1.000 BIT_MASK 0x8 FORMAT "%5.3" ECU_ADDRESS 0x60034C14 /end MEASUREMENT
/begin MEASUREMENT DFC_b.TST_MOXEMM_SMU_ALM11_0 "Bit encoding / Tested bit for check DFC_MOXEMM_SMU_ALM11_0" UBYTE DFC_OneToOne 1 100 0.00 1.000 BIT_MASK 0x8 FORMAT "%5.3" ECU_ADDRESS 0x60034C15 /end MEASUREMENT
/begin MEASUREMENT DFC_b.TST_MOXEMM_SMU_ALM11_1 "Bit encoding / Tested bit for check DFC_MOXEMM_SMU_ALM11_1" UBYTE DFC_OneToOne 1 100 0.00 1.000 BIT_MASK 0x8 FORMAT "%5.3" ECU_ADDRESS 0x60034C16 /end MEASUREMENT
/begin MEASUREMENT DFC_b.TST_MOXEMM_SMU_ALM11_2 "Bit encoding / Tested bit for check DFC_MOXEMM_SMU_ALM11_2" UBYTE DFC_OneToOne 1 100 0.00 1.000 BIT_MASK 0x8 FORMAT "%5.3" ECU_ADDRESS 0x60034C17 /end MEASUREMENT
/begin MEASUREMENT DFC_b.TST_MOXEMM_SMU_ALM11_3 "Bit encoding / Tested bit for check DFC_MOXEMM_SMU_ALM11_3" UBYTE DFC_OneToOne 1 100 0.00 1.000 BIT_MASK 0x8 FORMAT "%5.3" ECU_ADDRESS 0x60034C18 /end MEASUREMENT
/begin MEASUREMENT DFC_b.TST_MOXEMM_SMU_ALM11_4 "Bit encoding / Tested bit for check DFC_MOXEMM_SMU_ALM11_4" UBYTE DFC_OneToOne 1 100 0.00 1.000 BIT_MASK 0x8 FORMAT "%5.3" ECU_ADDRESS 0x60034C19 /end MEASUREMENT
/begin MEASUREMENT DFC_b.TST_MOXEMM_SMU_ALM11_5 "Bit encoding / Tested bit for check DFC_MOXEMM_SMU_ALM11_5" UBYTE DFC_OneToOne 1 100 0.00 1.000 BIT_MASK 0x8 FORMAT "%5.3" ECU_ADDRESS 0x60034C1A /end MEASUREMENT
/begin MEASUREMENT DFC_b.TST_MOXEMM_SMU_ALM11_8 "Bit encoding / Tested bit for check DFC_MOXEMM_SMU_ALM11_8" UBYTE DFC_OneToOne 1 100 0.00 1.000 BIT_MASK 0x8 FORMAT "%5.3" ECU_ADDRESS 0x60034C1B /end MEASUREMENT
/begin MEASUREMENT DFC_b.TST_MOXEMM_SMU_ALM11_9 "Bit encoding / Tested bit for check DFC_MOXEMM_SMU_ALM11_9" UBYTE DFC_OneToOne 1 100 0.00 1.000 BIT_MASK 0x8 FORMAT "%5.3" ECU_ADDRESS 0x60034C1C /end MEASUREMENT
/begin MEASUREMENT DFC_b.TST_MOXEMM_SMU_ALM1_0 "Bit encoding / Tested bit for check DFC_MOXEMM_SMU_ALM1_0" UBYTE DFC_OneToOne 1 100 0.00 1.000 BIT_MASK 0x8 FORMAT "%5.3" ECU_ADDRESS 0x60034C1D /end MEASUREMENT
/begin MEASUREMENT DFC_b.TST_MOXEMM_SMU_ALM1_1 "Bit encoding / Tested bit for check DFC_MOXEMM_SMU_ALM1_1" UBYTE DFC_OneToOne 1 100 0.00 1.000 BIT_MASK 0x8 FORMAT "%5.3" ECU_ADDRESS 0x60034C1E /end MEASUREMENT
/begin MEASUREMENT DFC_b.TST_MOXEMM_SMU_ALM1_10 "Bit encoding / Tested bit for check DFC_MOXEMM_SMU_ALM1_10" UBYTE DFC_OneToOne 1 100 0.00 1.000 BIT_MASK 0x8 FORMAT "%5.3" ECU_ADDRESS 0x60034C1F /end MEASUREMENT
/begin MEASUREMENT DFC_b.TST_MOXEMM_SMU_ALM1_11 "Bit encoding / Tested bit for check DFC_MOXEMM_SMU_ALM1_11" UBYTE DFC_OneToOne 1 100 0.00 1.000 BIT_MASK 0x8 FORMAT "%5.3" ECU_ADDRESS 0x60034C20 /end MEASUREMENT
/begin MEASUREMENT DFC_b.TST_MOXEMM_SMU_ALM1_13 "Bit encoding / Tested bit for check DFC_MOXEMM_SMU_ALM1_13" UBYTE DFC_OneToOne 1 100 0.00 1.000 BIT_MASK 0x8 FORMAT "%5.3" ECU_ADDRESS 0x60034C21 /end MEASUREMENT
/begin MEASUREMENT DFC_b.TST_MOXEMM_SMU_ALM1_14 "Bit encoding / Tested bit for check DFC_MOXEMM_SMU_ALM1_14" UBYTE DFC_OneToOne 1 100 0.00 1.000 BIT_MASK 0x8 FORMAT "%5.3" ECU_ADDRESS 0x60034C22 /end MEASUREMENT
/begin MEASUREMENT DFC_b.TST_MOXEMM_SMU_ALM1_2 "Bit encoding / Tested bit for check DFC_MOXEMM_SMU_ALM1_2" UBYTE DFC_OneToOne 1 100 0.00 1.000 BIT_MASK 0x8 FORMAT "%5.3" ECU_ADDRESS 0x60034C23 /end MEASUREMENT
/begin MEASUREMENT DFC_b.TST_MOXEMM_SMU_ALM1_22 "Bit encoding / Tested bit for check DFC_MOXEMM_SMU_ALM1_22" UBYTE DFC_OneToOne 1 100 0.00 1.000 BIT_MASK 0x8 FORMAT "%5.3" ECU_ADDRESS 0x60034C24 /end MEASUREMENT
/begin MEASUREMENT DFC_b.TST_MOXEMM_SMU_ALM1_23 "Bit encoding / Tested bit for check DFC_MOXEMM_SMU_ALM1_23" UBYTE DFC_OneToOne 1 100 0.00 1.000 BIT_MASK 0x8 FORMAT "%5.3" ECU_ADDRESS 0x60034C25 /end MEASUREMENT
/begin MEASUREMENT DFC_b.TST_MOXEMM_SMU_ALM1_4 "Bit encoding / Tested bit for check DFC_MOXEMM_SMU_ALM1_4" UBYTE DFC_OneToOne 1 100 0.00 1.000 BIT_MASK 0x8 FORMAT "%5.3" ECU_ADDRESS 0x60034C26 /end MEASUREMENT
/begin MEASUREMENT DFC_b.TST_MOXEMM_SMU_ALM1_5 "Bit encoding / Tested bit for check DFC_MOXEMM_SMU_ALM1_5" UBYTE DFC_OneToOne 1 100 0.00 1.000 BIT_MASK 0x8 FORMAT "%5.3" ECU_ADDRESS 0x60034C27 /end MEASUREMENT
/begin MEASUREMENT DFC_b.TST_MOXEMM_SMU_ALM1_7 "Bit encoding / Tested bit for check DFC_MOXEMM_SMU_ALM1_7" UBYTE DFC_OneToOne 1 100 0.00 1.000 BIT_MASK 0x8 FORMAT "%5.3" ECU_ADDRESS 0x60034C28 /end MEASUREMENT
/begin MEASUREMENT DFC_b.TST_MOXEMM_SMU_ALM1_8 "Bit encoding / Tested bit for check DFC_MOXEMM_SMU_ALM1_8" UBYTE DFC_OneToOne 1 100 0.00 1.000 BIT_MASK 0x8 FORMAT "%5.3" ECU_ADDRESS 0x60034C29 /end MEASUREMENT
/begin MEASUREMENT DFC_b.TST_MOXEMM_SMU_ALM21_0 "Bit encoding / Tested bit for check DFC_MOXEMM_SMU_ALM21_0" UBYTE DFC_OneToOne 1 100 0.00 1.000 BIT_MASK 0x8 FORMAT "%5.3" ECU_ADDRESS 0x60034C2A /end MEASUREMENT
/begin MEASUREMENT DFC_b.TST_MOXEMM_SMU_ALM21_16 "Bit encoding / Tested bit for check DFC_MOXEMM_SMU_ALM21_16" UBYTE DFC_OneToOne 1 100 0.00 1.000 BIT_MASK 0x8 FORMAT "%5.3" ECU_ADDRESS 0x60034C2B /end MEASUREMENT
/begin MEASUREMENT DFC_b.TST_MOXEMM_SMU_ALM21_3 "Bit encoding / Tested bit for check DFC_MOXEMM_SMU_ALM21_3" UBYTE DFC_OneToOne 1 100 0.00 1.000 BIT_MASK 0x8 FORMAT "%5.3" ECU_ADDRESS 0x60034C2C /end MEASUREMENT
/begin MEASUREMENT DFC_b.TST_MOXEMM_SMU_ALM2_1 "Bit encoding / Tested bit for check DFC_MOXEMM_SMU_ALM2_1" UBYTE DFC_OneToOne 1 100 0.00 1.000 BIT_MASK 0x8 FORMAT "%5.3" ECU_ADDRESS 0x60034C2D /end MEASUREMENT
/begin MEASUREMENT DFC_b.TST_MOXEMM_SMU_ALM2_10 "Bit encoding / Tested bit for check DFC_MOXEMM_SMU_ALM2_10" UBYTE DFC_OneToOne 1 100 0.00 1.000 BIT_MASK 0x8 FORMAT "%5.3" ECU_ADDRESS 0x60034C2E /end MEASUREMENT
/begin MEASUREMENT DFC_b.TST_MOXEMM_SMU_ALM2_11 "Bit encoding / Tested bit for check DFC_MOXEMM_SMU_ALM2_11" UBYTE DFC_OneToOne 1 100 0.00 1.000 BIT_MASK 0x8 FORMAT "%5.3" ECU_ADDRESS 0x60034C2F /end MEASUREMENT
/begin MEASUREMENT DFC_b.TST_MOXEMM_SMU_ALM2_13 "Bit encoding / Tested bit for check DFC_MOXEMM_SMU_ALM2_13" UBYTE DFC_OneToOne 1 100 0.00 1.000 BIT_MASK 0x8 FORMAT "%5.3" ECU_ADDRESS 0x60034C30 /end MEASUREMENT
/begin MEASUREMENT DFC_b.TST_MOXEMM_SMU_ALM2_14 "Bit encoding / Tested bit for check DFC_MOXEMM_SMU_ALM2_14" UBYTE DFC_OneToOne 1 100 0.00 1.000 BIT_MASK 0x8 FORMAT "%5.3" ECU_ADDRESS 0x60034C31 /end MEASUREMENT
/begin MEASUREMENT DFC_b.TST_MOXEMM_SMU_ALM2_22 "Bit encoding / Tested bit for check DFC_MOXEMM_SMU_ALM2_22" UBYTE DFC_OneToOne 1 100 0.00 1.000 BIT_MASK 0x8 FORMAT "%5.3" ECU_ADDRESS 0x60034C32 /end MEASUREMENT
/begin MEASUREMENT DFC_b.TST_MOXEMM_SMU_ALM2_23 "Bit encoding / Tested bit for check DFC_MOXEMM_SMU_ALM2_23" UBYTE DFC_OneToOne 1 100 0.00 1.000 BIT_MASK 0x8 FORMAT "%5.3" ECU_ADDRESS 0x60034C33 /end MEASUREMENT
/begin MEASUREMENT DFC_b.TST_MOXEMM_SMU_ALM2_4 "Bit encoding / Tested bit for check DFC_MOXEMM_SMU_ALM2_4" UBYTE DFC_OneToOne 1 100 0.00 1.000 BIT_MASK 0x8 FORMAT "%5.3" ECU_ADDRESS 0x60034C34 /end MEASUREMENT
/begin MEASUREMENT DFC_b.TST_MOXEMM_SMU_ALM2_5 "Bit encoding / Tested bit for check DFC_MOXEMM_SMU_ALM2_5" UBYTE DFC_OneToOne 1 100 0.00 1.000 BIT_MASK 0x8 FORMAT "%5.3" ECU_ADDRESS 0x60034C35 /end MEASUREMENT
/begin MEASUREMENT DFC_b.TST_MOXEMM_SMU_ALM2_7 "Bit encoding / Tested bit for check DFC_MOXEMM_SMU_ALM2_7" UBYTE DFC_OneToOne 1 100 0.00 1.000 BIT_MASK 0x8 FORMAT "%5.3" ECU_ADDRESS 0x60034C36 /end MEASUREMENT
/begin MEASUREMENT DFC_b.TST_MOXEMM_SMU_ALM2_8 "Bit encoding / Tested bit for check DFC_MOXEMM_SMU_ALM2_8" UBYTE DFC_OneToOne 1 100 0.00 1.000 BIT_MASK 0x8 FORMAT "%5.3" ECU_ADDRESS 0x60034C37 /end MEASUREMENT
/begin MEASUREMENT DFC_b.TST_MOXEMM_SMU_ALM6_0 "Bit encoding / Tested bit for check DFC_MOXEMM_SMU_ALM6_0" UBYTE DFC_OneToOne 1 100 0.00 1.000 BIT_MASK 0x8 FORMAT "%5.3" ECU_ADDRESS 0x60034C38 /end MEASUREMENT
/begin MEASUREMENT DFC_b.TST_MOXEMM_SMU_ALM6_11 "Bit encoding / Tested bit for check DFC_MOXEMM_SMU_ALM6_11" UBYTE DFC_OneToOne 1 100 0.00 1.000 BIT_MASK 0x8 FORMAT "%5.3" ECU_ADDRESS 0x60034C39 /end MEASUREMENT
/begin MEASUREMENT DFC_b.TST_MOXEMM_SMU_ALM6_12 "Bit encoding / Tested bit for check DFC_MOXEMM_SMU_ALM6_12" UBYTE DFC_OneToOne 1 100 0.00 1.000 BIT_MASK 0x8 FORMAT "%5.3" ECU_ADDRESS 0x60034C3A /end MEASUREMENT
/begin MEASUREMENT DFC_b.TST_MOXEMM_SMU_ALM6_14 "Bit encoding / Tested bit for check DFC_MOXEMM_SMU_ALM6_14" UBYTE DFC_OneToOne 1 100 0.00 1.000 BIT_MASK 0x8 FORMAT "%5.3" ECU_ADDRESS 0x60034C3B /end MEASUREMENT
/begin MEASUREMENT DFC_b.TST_MOXEMM_SMU_ALM6_15 "Bit encoding / Tested bit for check DFC_MOXEMM_SMU_ALM6_15" UBYTE DFC_OneToOne 1 100 0.00 1.000 BIT_MASK 0x8 FORMAT "%5.3" ECU_ADDRESS 0x60034C3C /end MEASUREMENT
/begin MEASUREMENT DFC_b.TST_MOXEMM_SMU_ALM6_17 "Bit encoding / Tested bit for check DFC_MOXEMM_SMU_ALM6_17" UBYTE DFC_OneToOne 1 100 0.00 1.000 BIT_MASK 0x8 FORMAT "%5.3" ECU_ADDRESS 0x60034C3D /end MEASUREMENT
/begin MEASUREMENT DFC_b.TST_MOXEMM_SMU_ALM6_18 "Bit encoding / Tested bit for check DFC_MOXEMM_SMU_ALM6_18" UBYTE DFC_OneToOne 1 100 0.00 1.000 BIT_MASK 0x8 FORMAT "%5.3" ECU_ADDRESS 0x60034C3E /end MEASUREMENT
/begin MEASUREMENT DFC_b.TST_MOXEMM_SMU_ALM6_20 "Bit encoding / Tested bit for check DFC_MOXEMM_SMU_ALM6_20" UBYTE DFC_OneToOne 1 100 0.00 1.000 BIT_MASK 0x8 FORMAT "%5.3" ECU_ADDRESS 0x60034C3F /end MEASUREMENT
/begin MEASUREMENT DFC_b.TST_MOXEMM_SMU_ALM6_21 "Bit encoding / Tested bit for check DFC_MOXEMM_SMU_ALM6_21" UBYTE DFC_OneToOne 1 100 0.00 1.000 BIT_MASK 0x8 FORMAT "%5.3" ECU_ADDRESS 0x60034C40 /end MEASUREMENT
/begin MEASUREMENT DFC_b.TST_MOXEMM_SMU_ALM6_25 "Bit encoding / Tested bit for check DFC_MOXEMM_SMU_ALM6_25" UBYTE DFC_OneToOne 1 100 0.00 1.000 BIT_MASK 0x8 FORMAT "%5.3" ECU_ADDRESS 0x60034C41 /end MEASUREMENT
/begin MEASUREMENT DFC_b.TST_MOXEMM_SMU_ALM6_4 "Bit encoding / Tested bit for check DFC_MOXEMM_SMU_ALM6_4" UBYTE DFC_OneToOne 1 100 0.00 1.000 BIT_MASK 0x8 FORMAT "%5.3" ECU_ADDRESS 0x60034C42 /end MEASUREMENT
/begin MEASUREMENT DFC_b.TST_MOXEMM_SMU_ALM6_5 "Bit encoding / Tested bit for check DFC_MOXEMM_SMU_ALM6_5" UBYTE DFC_OneToOne 1 100 0.00 1.000 BIT_MASK 0x8 FORMAT "%5.3" ECU_ADDRESS 0x60034C43 /end MEASUREMENT
/begin MEASUREMENT DFC_b.TST_MOXEMM_SMU_ALM6_7 "Bit encoding / Tested bit for check DFC_MOXEMM_SMU_ALM6_7" UBYTE DFC_OneToOne 1 100 0.00 1.000 BIT_MASK 0x8 FORMAT "%5.3" ECU_ADDRESS 0x60034C44 /end MEASUREMENT
/begin MEASUREMENT DFC_b.TST_MOXEMM_SMU_ALM6_8 "Bit encoding / Tested bit for check DFC_MOXEMM_SMU_ALM6_8" UBYTE DFC_OneToOne 1 100 0.00 1.000 BIT_MASK 0x8 FORMAT "%5.3" ECU_ADDRESS 0x60034C45 /end MEASUREMENT
/begin MEASUREMENT DFC_b.TST_MOXEMM_SMU_ALM7_1 "Bit encoding / Tested bit for check DFC_MOXEMM_SMU_ALM7_1" UBYTE DFC_OneToOne 1 100 0.00 1.000 BIT_MASK 0x8 FORMAT "%5.3" ECU_ADDRESS 0x60034C46 /end MEASUREMENT
/begin MEASUREMENT DFC_b.TST_MOXEMM_SMU_ALM7_12 "Bit encoding / Tested bit for check DFC_MOXEMM_SMU_ALM7_12" UBYTE DFC_OneToOne 1 100 0.00 1.000 BIT_MASK 0x8 FORMAT "%5.3" ECU_ADDRESS 0x60034C47 /end MEASUREMENT
/begin MEASUREMENT DFC_b.TST_MOXEMM_SMU_ALM7_13 "Bit encoding / Tested bit for check DFC_MOXEMM_SMU_ALM7_13" UBYTE DFC_OneToOne 1 100 0.00 1.000 BIT_MASK 0x8 FORMAT "%5.3" ECU_ADDRESS 0x60034C48 /end MEASUREMENT
/begin MEASUREMENT DFC_b.TST_MOXEMM_SMU_ALM7_14 "Bit encoding / Tested bit for check DFC_MOXEMM_SMU_ALM7_14" UBYTE DFC_OneToOne 1 100 0.00 1.000 BIT_MASK 0x8 FORMAT "%5.3" ECU_ADDRESS 0x60034C49 /end MEASUREMENT
/begin MEASUREMENT DFC_b.TST_MOXEMM_SMU_ALM7_15 "Bit encoding / Tested bit for check DFC_MOXEMM_SMU_ALM7_15" UBYTE DFC_OneToOne 1 100 0.00 1.000 BIT_MASK 0x8 FORMAT "%5.3" ECU_ADDRESS 0x60034C4A /end MEASUREMENT
/begin MEASUREMENT DFC_b.TST_MOXEMM_SMU_ALM7_16 "Bit encoding / Tested bit for check DFC_MOXEMM_SMU_ALM7_16" UBYTE DFC_OneToOne 1 100 0.00 1.000 BIT_MASK 0x8 FORMAT "%5.3" ECU_ADDRESS 0x60034C4B /end MEASUREMENT
/begin MEASUREMENT DFC_b.TST_MOXEMM_SMU_ALM7_17 "Bit encoding / Tested bit for check DFC_MOXEMM_SMU_ALM7_17" UBYTE DFC_OneToOne 1 100 0.00 1.000 BIT_MASK 0x8 FORMAT "%5.3" ECU_ADDRESS 0x60034C4C /end MEASUREMENT
/begin MEASUREMENT DFC_b.TST_MOXEMM_SMU_ALM7_2 "Bit encoding / Tested bit for check DFC_MOXEMM_SMU_ALM7_2" UBYTE DFC_OneToOne 1 100 0.00 1.000 BIT_MASK 0x8 FORMAT "%5.3" ECU_ADDRESS 0x60034C4D /end MEASUREMENT
/begin MEASUREMENT DFC_b.TST_MOXEMM_SMU_ALM7_20 "Bit encoding / Tested bit for check DFC_MOXEMM_SMU_ALM7_20" UBYTE DFC_OneToOne 1 100 0.00 1.000 BIT_MASK 0x8 FORMAT "%5.3" ECU_ADDRESS 0x60034C4E /end MEASUREMENT
/begin MEASUREMENT DFC_b.TST_MOXEMM_SMU_ALM7_25 "Bit encoding / Tested bit for check DFC_MOXEMM_SMU_ALM7_25" UBYTE DFC_OneToOne 1 100 0.00 1.000 BIT_MASK 0x8 FORMAT "%5.3" ECU_ADDRESS 0x60034C4F /end MEASUREMENT
/begin MEASUREMENT DFC_b.TST_MOXEMM_SMU_ALM7_26 "Bit encoding / Tested bit for check DFC_MOXEMM_SMU_ALM7_26" UBYTE DFC_OneToOne 1 100 0.00 1.000 BIT_MASK 0x8 FORMAT "%5.3" ECU_ADDRESS 0x60034C50 /end MEASUREMENT
/begin MEASUREMENT DFC_b.TST_MOXEMM_SMU_ALM7_28 "Bit encoding / Tested bit for check DFC_MOXEMM_SMU_ALM7_28" UBYTE DFC_OneToOne 1 100 0.00 1.000 BIT_MASK 0x8 FORMAT "%5.3" ECU_ADDRESS 0x60034C51 /end MEASUREMENT
/begin MEASUREMENT DFC_b.TST_MOXEMM_SMU_ALM7_29 "Bit encoding / Tested bit for check DFC_MOXEMM_SMU_ALM7_29" UBYTE DFC_OneToOne 1 100 0.00 1.000 BIT_MASK 0x8 FORMAT "%5.3" ECU_ADDRESS 0x60034C52 /end MEASUREMENT
/begin MEASUREMENT DFC_b.TST_MOXEMM_SMU_ALM7_30 "Bit encoding / Tested bit for check DFC_MOXEMM_SMU_ALM7_30" UBYTE DFC_OneToOne 1 100 0.00 1.000 BIT_MASK 0x8 FORMAT "%5.3" ECU_ADDRESS 0x60034C53 /end MEASUREMENT
/begin MEASUREMENT DFC_b.TST_MOXEMM_SMU_ALM7_31 "Bit encoding / Tested bit for check DFC_MOXEMM_SMU_ALM7_31" UBYTE DFC_OneToOne 1 100 0.00 1.000 BIT_MASK 0x8 FORMAT "%5.3" ECU_ADDRESS 0x60034C54 /end MEASUREMENT
/begin MEASUREMENT DFC_b.TST_MOXEMM_SMU_ALM8_0 "Bit encoding / Tested bit for check DFC_MOXEMM_SMU_ALM8_0" UBYTE DFC_OneToOne 1 100 0.00 1.000 BIT_MASK 0x8 FORMAT "%5.3" ECU_ADDRESS 0x60034C55 /end MEASUREMENT
/begin MEASUREMENT DFC_b.TST_MOXEMM_SMU_ALM8_1 "Bit encoding / Tested bit for check DFC_MOXEMM_SMU_ALM8_1" UBYTE DFC_OneToOne 1 100 0.00 1.000 BIT_MASK 0x8 FORMAT "%5.3" ECU_ADDRESS 0x60034C56 /end MEASUREMENT
/begin MEASUREMENT DFC_b.TST_MOXEMM_SMU_ALM8_10 "Bit encoding / Tested bit for check DFC_MOXEMM_SMU_ALM8_10" UBYTE DFC_OneToOne 1 100 0.00 1.000 BIT_MASK 0x8 FORMAT "%5.3" ECU_ADDRESS 0x60034C57 /end MEASUREMENT
/begin MEASUREMENT DFC_b.TST_MOXEMM_SMU_ALM8_11 "Bit encoding / Tested bit for check DFC_MOXEMM_SMU_ALM8_11" UBYTE DFC_OneToOne 1 100 0.00 1.000 BIT_MASK 0x8 FORMAT "%5.3" ECU_ADDRESS 0x60034C58 /end MEASUREMENT
/begin MEASUREMENT DFC_b.TST_MOXEMM_SMU_ALM8_12 "Bit encoding / Tested bit for check DFC_MOXEMM_SMU_ALM8_12" UBYTE DFC_OneToOne 1 100 0.00 1.000 BIT_MASK 0x8 FORMAT "%5.3" ECU_ADDRESS 0x60034C59 /end MEASUREMENT
/begin MEASUREMENT DFC_b.TST_MOXEMM_SMU_ALM8_16 "Bit encoding / Tested bit for check DFC_MOXEMM_SMU_ALM8_16" UBYTE DFC_OneToOne 1 100 0.00 1.000 BIT_MASK 0x8 FORMAT "%5.3" ECU_ADDRESS 0x60034C5A /end MEASUREMENT
/begin MEASUREMENT DFC_b.TST_MOXEMM_SMU_ALM8_18 "Bit encoding / Tested bit for check DFC_MOXEMM_SMU_ALM8_18" UBYTE DFC_OneToOne 1 100 0.00 1.000 BIT_MASK 0x8 FORMAT "%5.3" ECU_ADDRESS 0x60034C5B /end MEASUREMENT
/begin MEASUREMENT DFC_b.TST_MOXEMM_SMU_ALM8_2 "Bit encoding / Tested bit for check DFC_MOXEMM_SMU_ALM8_2" UBYTE DFC_OneToOne 1 100 0.00 1.000 BIT_MASK 0x8 FORMAT "%5.3" ECU_ADDRESS 0x60034C5C /end MEASUREMENT
/begin MEASUREMENT DFC_b.TST_MOXEMM_SMU_ALM8_3 "Bit encoding / Tested bit for check DFC_MOXEMM_SMU_ALM8_3" UBYTE DFC_OneToOne 1 100 0.00 1.000 BIT_MASK 0x8 FORMAT "%5.3" ECU_ADDRESS 0x60034C5D /end MEASUREMENT
/begin MEASUREMENT DFC_b.TST_MOXEMM_SMU_ALM8_31 "Bit encoding / Tested bit for check DFC_MOXEMM_SMU_ALM8_31" UBYTE DFC_OneToOne 1 100 0.00 1.000 BIT_MASK 0x8 FORMAT "%5.3" ECU_ADDRESS 0x60034C5E /end MEASUREMENT
/begin MEASUREMENT DFC_b.TST_MOXEMM_SMU_ALM8_4 "Bit encoding / Tested bit for check DFC_MOXEMM_SMU_ALM8_4" UBYTE DFC_OneToOne 1 100 0.00 1.000 BIT_MASK 0x8 FORMAT "%5.3" ECU_ADDRESS 0x60034C5F /end MEASUREMENT
/begin MEASUREMENT DFC_b.TST_MOXEMM_SMU_ALM9_0 "Bit encoding / Tested bit for check DFC_MOXEMM_SMU_ALM9_0" UBYTE DFC_OneToOne 1 100 0.00 1.000 BIT_MASK 0x8 FORMAT "%5.3" ECU_ADDRESS 0x60034C60 /end MEASUREMENT
/begin MEASUREMENT DFC_b.TST_MOXEMM_SMU_ALM9_15 "Bit encoding / Tested bit for check DFC_MOXEMM_SMU_ALM9_15" UBYTE DFC_OneToOne 1 100 0.00 1.000 BIT_MASK 0x8 FORMAT "%5.3" ECU_ADDRESS 0x60034C61 /end MEASUREMENT
/begin MEASUREMENT DFC_b.TST_MOXEMM_SMU_ALM9_3 "Bit encoding / Tested bit for check DFC_MOXEMM_SMU_ALM9_3" UBYTE DFC_OneToOne 1 100 0.00 1.000 BIT_MASK 0x8 FORMAT "%5.3" ECU_ADDRESS 0x60034C62 /end MEASUREMENT
/begin MEASUREMENT DFC_b.TST_MoCADCNTP "Bit encoding / Tested bit for check DFC_MoCADCNTP" UBYTE DFC_OneToOne 1 100 0.00 1.000 BIT_MASK 0x8 FORMAT "%5.3" ECU_ADDRESS 0x60034C63 /end MEASUREMENT
/begin MEASUREMENT DFC_b.TST_MoCADCTst "Bit encoding / Tested bit for check DFC_MoCADCTst" UBYTE DFC_OneToOne 1 100 0.00 1.000 BIT_MASK 0x8 FORMAT "%5.3" ECU_ADDRESS 0x60034C64 /end MEASUREMENT
/begin MEASUREMENT DFC_b.TST_MoCSOPICO "Bit encoding / Tested bit for check DFC_MoCSOPICO" UBYTE DFC_OneToOne 1 100 0.00 1.000 BIT_MASK 0x8 FORMAT "%5.3" ECU_ADDRESS 0x60034C65 /end MEASUREMENT
/begin MEASUREMENT DFC_b.TST_MoFAPP "Bit encoding / Tested bit for check DFC_MoFAPP" UBYTE DFC_OneToOne 1 100 0.00 1.000 BIT_MASK 0x8 FORMAT "%5.3" ECU_ADDRESS 0x60034C66 /end MEASUREMENT
/begin MEASUREMENT DFC_b.TST_MoFAirFilgPrdc "Bit encoding / Tested bit for check DFC_MoFAirFilgPrdc" UBYTE DFC_OneToOne 1 100 0.00 1.000 BIT_MASK 0x8 FORMAT "%5.3" ECU_ADDRESS 0x60034C67 /end MEASUREMENT
/begin MEASUREMENT DFC_b.TST_MoFAirFlCtOffPfi "Bit encoding / Tested bit for check DFC_MoFAirFlCtOffPfi" UBYTE DFC_OneToOne 1 100 0.00 1.000 BIT_MASK 0x8 FORMAT "%5.3" ECU_ADDRESS 0x60034C68 /end MEASUREMENT
/begin MEASUREMENT DFC_b.TST_MoFAirFlCylPfi "Bit encoding / Tested bit for check DFC_MoFAirFlCylPfi" UBYTE DFC_OneToOne 1 100 0.00 1.000 BIT_MASK 0x8 FORMAT "%5.3" ECU_ADDRESS 0x60034C69 /end MEASUREMENT
/begin MEASUREMENT DFC_b.TST_MoFAirFlIn "Bit encoding / Tested bit for check DFC_MoFAirFlIn" UBYTE DFC_OneToOne 1 100 0.00 1.000 BIT_MASK 0x8 FORMAT "%5.3" ECU_ADDRESS 0x60034C6A /end MEASUREMENT
/begin MEASUREMENT DFC_b.TST_MoFAirFlMixCtlPfiChkAirFl "Bit encoding / Tested bit for check DFC_MoFAirFlMixCtlPfiChkAirFl" UBYTE DFC_OneToOne 1 100 0.00 1.000 BIT_MASK 0x8 FORMAT "%5.3" ECU_ADDRESS 0x60034C6B /end MEASUREMENT
/begin MEASUREMENT DFC_b.TST_MoFAirFlMixCtlPfiChkCtrl "Bit encoding / Tested bit for check DFC_MoFAirFlMixCtlPfiChkCtrl" UBYTE DFC_OneToOne 1 100 0.00 1.000 BIT_MASK 0x8 FORMAT "%5.3" ECU_ADDRESS 0x60034C6C /end MEASUREMENT
/begin MEASUREMENT DFC_b.TST_MoFAirFlMode "Bit encoding / Tested bit for check DFC_MoFAirFlMode" UBYTE DFC_OneToOne 1 100 0.00 1.000 BIT_MASK 0x8 FORMAT "%5.3" ECU_ADDRESS 0x60034C6D /end MEASUREMENT
/begin MEASUREMENT DFC_b.TST_MoFESpd "Bit encoding / Tested bit for check DFC_MoFESpd" UBYTE DFC_OneToOne 1 100 0.00 1.000 BIT_MASK 0x8 FORMAT "%5.3" ECU_ADDRESS 0x60034C6E /end MEASUREMENT
/begin MEASUREMENT DFC_b.TST_MoFIACo "Bit encoding / Tested bit for check DFC_MoFIACo" UBYTE DFC_OneToOne 1 100 0.00 1.000 BIT_MASK 0x8 FORMAT "%5.3" ECU_ADDRESS 0x60034C6F /end MEASUREMENT
/begin MEASUREMENT DFC_b.TST_MoFICOL1 "Bit encoding / Tested bit for check DFC_MoFICOL1" UBYTE DFC_OneToOne 1 100 0.00 1.000 BIT_MASK 0x8 FORMAT "%5.3" ECU_ADDRESS 0x60034C70 /end MEASUREMENT
/begin MEASUREMENT DFC_b.TST_MoFICOL2 "Bit encoding / Tested bit for check DFC_MoFICOL2" UBYTE DFC_OneToOne 1 100 0.00 1.000 BIT_MASK 0x8 FORMAT "%5.3" ECU_ADDRESS 0x60034C71 /end MEASUREMENT
/begin MEASUREMENT DFC_b.TST_MoFStrt "Bit encoding / Tested bit for check DFC_MoFStrt" UBYTE DFC_OneToOne 1 100 0.00 1.000 BIT_MASK 0x8 FORMAT "%5.3" ECU_ADDRESS 0x60034C72 /end MEASUREMENT
/begin MEASUREMENT DFC_b.TST_MoFTrqCmp "Bit encoding / Tested bit for check DFC_MoFTrqCmp" UBYTE DFC_OneToOne 1 100 0.00 1.000 BIT_MASK 0x8 FORMAT "%5.3" ECU_ADDRESS 0x60034C73 /end MEASUREMENT
/begin MEASUREMENT DFC_b.TST_MoFTrqCmpMax "Bit encoding / Tested bit for check DFC_MoFTrqCmpMax" UBYTE DFC_OneToOne 1 100 0.00 1.000 BIT_MASK 0x8 FORMAT "%5.3" ECU_ADDRESS 0x60034C74 /end MEASUREMENT
/begin MEASUREMENT DFC_b.TST_MoFTrqCmpMin "Bit encoding / Tested bit for check DFC_MoFTrqCmpMin" UBYTE DFC_OneToOne 1 100 0.00 1.000 BIT_MASK 0x8 FORMAT "%5.3" ECU_ADDRESS 0x60034C75 /end MEASUREMENT
/begin MEASUREMENT DFC_b.TST_MoFVarPostBldSel "Bit encoding / Tested bit for check DFC_MoFVarPostBldSel" UBYTE DFC_OneToOne 1 100 0.00 1.000 BIT_MASK 0x8 FORMAT "%5.3" ECU_ADDRESS 0x60034C76 /end MEASUREMENT
/begin MEASUREMENT DFC_b.TST_MoXEMMHwLTMCUFW "Bit encoding / Tested bit for check DFC_MoXEMMHwLTMCUFW" UBYTE DFC_OneToOne 1 100 0.00 1.000 BIT_MASK 0x8 FORMAT "%5.3" ECU_ADDRESS 0x60034C77 /end MEASUREMENT
/begin MEASUREMENT DFC_b.TST_MoXEMMHwLTMonBIST "Bit encoding / Tested bit for check DFC_MoXEMMHwLTMonBIST" UBYTE DFC_OneToOne 1 100 0.00 1.000 BIT_MASK 0x8 FORMAT "%5.3" ECU_ADDRESS 0x60034C78 /end MEASUREMENT
/begin MEASUREMENT DFC_b.TST_MoXEMMHwLTRegMonTest "Bit encoding / Tested bit for check DFC_MoXEMMHwLTRegMonTest" UBYTE DFC_OneToOne 1 100 0.00 1.000 BIT_MASK 0x8 FORMAT "%5.3" ECU_ADDRESS 0x60034C79 /end MEASUREMENT
/begin MEASUREMENT DFC_b.TST_MoXEMMHwLTStbySMUAlvTest "Bit encoding / Tested bit for check DFC_MoXEMMHwLTStbySMUAlvTest" UBYTE DFC_OneToOne 1 100 0.00 1.000 BIT_MASK 0x8 FORMAT "%5.3" ECU_ADDRESS 0x60034C7A /end MEASUREMENT
/begin MEASUREMENT DFC_b.TST_MoXEMMHwLTTempSens "Bit encoding / Tested bit for check DFC_MoXEMMHwLTTempSens" UBYTE DFC_OneToOne 1 100 0.00 1.000 BIT_MASK 0x8 FORMAT "%5.3" ECU_ADDRESS 0x60034C7B /end MEASUREMENT
/begin MEASUREMENT DFC_b.TST_MoXEMMHwLTUCBCfg "Bit encoding / Tested bit for check DFC_MoXEMMHwLTUCBCfg" UBYTE DFC_OneToOne 1 100 0.00 1.000 BIT_MASK 0x8 FORMAT "%5.3" ECU_ADDRESS 0x60034C7C /end MEASUREMENT
/begin MEASUREMENT DFC_b.TST_OCWDAABEActv "Bit encoding / Tested bit for check DFC_OCWDAABEActv" UBYTE DFC_OneToOne 1 100 0.00 1.000 BIT_MASK 0x8 FORMAT "%5.3" ECU_ADDRESS 0x60034C7D /end MEASUREMENT
/begin MEASUREMENT DFC_b.TST_OCWDACom "Bit encoding / Tested bit for check DFC_OCWDACom" UBYTE DFC_OneToOne 1 100 0.00 1.000 BIT_MASK 0x8 FORMAT "%5.3" ECU_ADDRESS 0x60034C7E /end MEASUREMENT
/begin MEASUREMENT DFC_b.TST_OCWDAErrPin "Bit encoding / Tested bit for check DFC_OCWDAErrPin" UBYTE DFC_OneToOne 1 100 0.00 1.000 BIT_MASK 0x8 FORMAT "%5.3" ECU_ADDRESS 0x60034C7F /end MEASUREMENT
/begin MEASUREMENT DFC_b.TST_OCWDAOvrVltg "Bit encoding / Tested bit for check DFC_OCWDAOvrVltg" UBYTE DFC_OneToOne 1 100 0.00 1.000 BIT_MASK 0x8 FORMAT "%5.3" ECU_ADDRESS 0x60034C80 /end MEASUREMENT
/begin MEASUREMENT DFC_b.TST_ORAmax "Bit encoding / Tested bit for check DFC_ORAmax" UBYTE DFC_OneToOne 1 100 0.00 1.000 BIT_MASK 0x8 FORMAT "%5.3" ECU_ADDRESS 0x60034C81 /end MEASUREMENT
/begin MEASUREMENT DFC_b.TST_ORAmin "Bit encoding / Tested bit for check DFC_ORAmin" UBYTE DFC_OneToOne 1 100 0.00 1.000 BIT_MASK 0x8 FORMAT "%5.3" ECU_ADDRESS 0x60034C82 /end MEASUREMENT
/begin MEASUREMENT DFC_b.TST_PLLSUmax "Bit encoding / Tested bit for check DFC_PLLSUmax" UBYTE DFC_OneToOne 1 100 0.00 1.000 BIT_MASK 0x8 FORMAT "%5.3" ECU_ADDRESS 0x60034C83 /end MEASUREMENT
/begin MEASUREMENT DFC_b.TST_PLLSUmin "Bit encoding / Tested bit for check DFC_PLLSUmin" UBYTE DFC_OneToOne 1 100 0.00 1.000 BIT_MASK 0x8 FORMAT "%5.3" ECU_ADDRESS 0x60034C84 /end MEASUREMENT
/begin MEASUREMENT DFC_b.TST_PSR1max "Bit encoding / Tested bit for check DFC_PSR1max" UBYTE DFC_OneToOne 1 100 0.00 1.000 BIT_MASK 0x8 FORMAT "%5.3" ECU_ADDRESS 0x60034C85 /end MEASUREMENT
/begin MEASUREMENT DFC_b.TST_PSRBmax "Bit encoding / Tested bit for check DFC_PSRBmax" UBYTE DFC_OneToOne 1 100 0.00 1.000 BIT_MASK 0x8 FORMAT "%5.3" ECU_ADDRESS 0x60034C86 /end MEASUREMENT
/begin MEASUREMENT DFC_b.TST_PSRBmin "Bit encoding / Tested bit for check DFC_PSRBmin" UBYTE DFC_OneToOne 1 100 0.00 1.000 BIT_MASK 0x8 FORMAT "%5.3" ECU_ADDRESS 0x60034C87 /end MEASUREMENT
/begin MEASUREMENT DFC_b.TST_PSRPmax "Bit encoding / Tested bit for check DFC_PSRPmax" UBYTE DFC_OneToOne 1 100 0.00 1.000 BIT_MASK 0x8 FORMAT "%5.3" ECU_ADDRESS 0x60034C88 /end MEASUREMENT
/begin MEASUREMENT DFC_b.TST_PSRPmin "Bit encoding / Tested bit for check DFC_PSRPmin" UBYTE DFC_OneToOne 1 100 0.00 1.000 BIT_MASK 0x8 FORMAT "%5.3" ECU_ADDRESS 0x60034C89 /end MEASUREMENT
/begin MEASUREMENT DFC_b.TST_PSRPsig "Bit encoding / Tested bit for check DFC_PSRPsig" UBYTE DFC_OneToOne 1 100 0.00 1.000 BIT_MASK 0x8 FORMAT "%5.3" ECU_ADDRESS 0x60034C8A /end MEASUREMENT
/begin MEASUREMENT DFC_b.TST_PSRmax "Bit encoding / Tested bit for check DFC_PSRmax" UBYTE DFC_OneToOne 1 100 0.00 1.000 BIT_MASK 0x8 FORMAT "%5.3" ECU_ADDRESS 0x60034C8B /end MEASUREMENT
/begin MEASUREMENT DFC_b.TST_PUmax "Bit encoding / Tested bit for check DFC_PUmax" UBYTE DFC_OneToOne 1 100 0.00 1.000 BIT_MASK 0x8 FORMAT "%5.3" ECU_ADDRESS 0x60034C8C /end MEASUREMENT
/begin MEASUREMENT DFC_b.TST_P_VSE11_OL "Bit encoding / Tested bit for check DFC_P_VSE11_OL" UBYTE DFC_OneToOne 1 100 0.00 1.000 BIT_MASK 0x8 FORMAT "%5.3" ECU_ADDRESS 0x60034C8D /end MEASUREMENT
/begin MEASUREMENT DFC_b.TST_P_VSE11_SCB "Bit encoding / Tested bit for check DFC_P_VSE11_SCB" UBYTE DFC_OneToOne 1 100 0.00 1.000 BIT_MASK 0x8 FORMAT "%5.3" ECU_ADDRESS 0x60034C8E /end MEASUREMENT
/begin MEASUREMENT DFC_b.TST_P_VSE11_SCG "Bit encoding / Tested bit for check DFC_P_VSE11_SCG" UBYTE DFC_OneToOne 1 100 0.00 1.000 BIT_MASK 0x8 FORMAT "%5.3" ECU_ADDRESS 0x60034C8F /end MEASUREMENT
/begin MEASUREMENT DFC_b.TST_PhyHighAPP1 "Bit encoding / Tested bit for check DFC_PhyHighAPP1" UBYTE DFC_OneToOne 1 100 0.00 1.000 BIT_MASK 0x8 FORMAT "%5.3" ECU_ADDRESS 0x60034C90 /end MEASUREMENT
/begin MEASUREMENT DFC_b.TST_PhyHighAPP2 "Bit encoding / Tested bit for check DFC_PhyHighAPP2" UBYTE DFC_OneToOne 1 100 0.00 1.000 BIT_MASK 0x8 FORMAT "%5.3" ECU_ADDRESS 0x60034C91 /end MEASUREMENT
/begin MEASUREMENT DFC_b.TST_PhyLowAPP1 "Bit encoding / Tested bit for check DFC_PhyLowAPP1" UBYTE DFC_OneToOne 1 100 0.00 1.000 BIT_MASK 0x8 FORMAT "%5.3" ECU_ADDRESS 0x60034C92 /end MEASUREMENT
/begin MEASUREMENT DFC_b.TST_PhyLowAPP2 "Bit encoding / Tested bit for check DFC_PhyLowAPP2" UBYTE DFC_OneToOne 1 100 0.00 1.000 BIT_MASK 0x8 FORMAT "%5.3" ECU_ADDRESS 0x60034C93 /end MEASUREMENT
/begin MEASUREMENT DFC_b.TST_SRCHighAPP1 "Bit encoding / Tested bit for check DFC_SRCHighAPP1" UBYTE DFC_OneToOne 1 100 0.00 1.000 BIT_MASK 0x8 FORMAT "%5.3" ECU_ADDRESS 0x60034C94 /end MEASUREMENT
/begin MEASUREMENT DFC_b.TST_SRCHighAPP2 "Bit encoding / Tested bit for check DFC_SRCHighAPP2" UBYTE DFC_OneToOne 1 100 0.00 1.000 BIT_MASK 0x8 FORMAT "%5.3" ECU_ADDRESS 0x60034C95 /end MEASUREMENT
/begin MEASUREMENT DFC_b.TST_SRCLowAPP1 "Bit encoding / Tested bit for check DFC_SRCLowAPP1" UBYTE DFC_OneToOne 1 100 0.00 1.000 BIT_MASK 0x8 FORMAT "%5.3" ECU_ADDRESS 0x60034C96 /end MEASUREMENT
/begin MEASUREMENT DFC_b.TST_SRCLowAPP2 "Bit encoding / Tested bit for check DFC_SRCLowAPP2" UBYTE DFC_OneToOne 1 100 0.00 1.000 BIT_MASK 0x8 FORMAT "%5.3" ECU_ADDRESS 0x60034C97 /end MEASUREMENT
/begin MEASUREMENT DFC_b.TST_SSpMon2 "Bit encoding / Tested bit for check DFC_SSpMon2" UBYTE DFC_OneToOne 1 100 0.00 1.000 BIT_MASK 0x8 FORMAT "%5.3" ECU_ADDRESS 0x60034C98 /end MEASUREMENT
/begin MEASUREMENT DFC_b.TST_SWReset_0 "Bit encoding / Tested bit for check DFC_SWReset_0" UBYTE DFC_OneToOne 1 100 0.00 1.000 BIT_MASK 0x8 FORMAT "%5.3" ECU_ADDRESS 0x60034C99 /end MEASUREMENT
/begin MEASUREMENT DFC_b.TST_SWReset_1 "Bit encoding / Tested bit for check DFC_SWReset_1" UBYTE DFC_OneToOne 1 100 0.00 1.000 BIT_MASK 0x8 FORMAT "%5.3" ECU_ADDRESS 0x60034C9A /end MEASUREMENT
/begin MEASUREMENT DFC_b.TST_SWReset_2 "Bit encoding / Tested bit for check DFC_SWReset_2" UBYTE DFC_OneToOne 1 100 0.00 1.000 BIT_MASK 0x8 FORMAT "%5.3" ECU_ADDRESS 0x60034C9B /end MEASUREMENT
/begin MEASUREMENT DFC_b.TST_SyncAPP "Bit encoding / Tested bit for check DFC_SyncAPP" UBYTE DFC_OneToOne 1 100 0.00 1.000 BIT_MASK 0x8 FORMAT "%5.3" ECU_ADDRESS 0x60034C9C /end MEASUREMENT
/begin MEASUREMENT DFC_b.TST_TAmax_Dummy "Bit encoding / Tested bit for check DFC_TAmax_Dummy" UBYTE DFC_OneToOne 1 100 0.00 1.000 BIT_MASK 0x8 FORMAT "%5.3" ECU_ADDRESS 0x60034C9D /end MEASUREMENT
/begin MEASUREMENT DFC_b.TST_TKAEmax "Bit encoding / Tested bit for check DFC_TKAEmax" UBYTE DFC_OneToOne 1 100 0.00 1.000 BIT_MASK 0x8 FORMAT "%5.3" ECU_ADDRESS 0x60034C9E /end MEASUREMENT
/begin MEASUREMENT DFC_b.TST_TKAEmin "Bit encoding / Tested bit for check DFC_TKAEmin" UBYTE DFC_OneToOne 1 100 0.00 1.000 BIT_MASK 0x8 FORMAT "%5.3" ECU_ADDRESS 0x60034C9F /end MEASUREMENT
/begin MEASUREMENT DFC_b.TST_TKARmax "Bit encoding / Tested bit for check DFC_TKARmax" UBYTE DFC_OneToOne 1 100 0.00 1.000 BIT_MASK 0x8 FORMAT "%5.3" ECU_ADDRESS 0x60034CA0 /end MEASUREMENT
/begin MEASUREMENT DFC_b.TST_TKARnpl "Bit encoding / Tested bit for check DFC_TKARnpl" UBYTE DFC_OneToOne 1 100 0.00 1.000 BIT_MASK 0x8 FORMAT "%5.3" ECU_ADDRESS 0x60034CA1 /end MEASUREMENT
/begin MEASUREMENT DFC_b.TST_TMmax_Dummy "Bit encoding / Tested bit for check DFC_TMmax_Dummy" UBYTE DFC_OneToOne 1 100 0.00 1.000 BIT_MASK 0x8 FORMAT "%5.3" ECU_ADDRESS 0x60034CA2 /end MEASUREMENT
/begin MEASUREMENT DFC_b.TST_TUMmax_Dummy "Bit encoding / Tested bit for check DFC_TUMmax_Dummy" UBYTE DFC_OneToOne 1 100 0.00 1.000 BIT_MASK 0x8 FORMAT "%5.3" ECU_ADDRESS 0x60034CA3 /end MEASUREMENT
/begin MEASUREMENT DFC_b.TST_TWCDPriCatB1 "Bit encoding / Tested bit for check DFC_TWCDPriCatB1" UBYTE DFC_OneToOne 1 100 0.00 1.000 BIT_MASK 0x8 FORMAT "%5.3" ECU_ADDRESS 0x60034CA4 /end MEASUREMENT
/begin MEASUREMENT DFC_b.TST_ThrVlvClsdPosnFirstOffsLrnImpoB1 "Bit encoding / Tested bit for check DFC_ThrVlvClsdPosnFirstOffsLrnImpoB1" UBYTE DFC_OneToOne 1 100 0.00 1.000 BIT_MASK 0x8 FORMAT "%5.3" ECU_ADDRESS 0x60034CA5 /end MEASUREMENT
/begin MEASUREMENT DFC_b.TST_ThrVlvClsdPosnOffsLrnImpoB1 "Bit encoding / Tested bit for check DFC_ThrVlvClsdPosnOffsLrnImpoB1" UBYTE DFC_OneToOne 1 100 0.00 1.000 BIT_MASK 0x8 FORMAT "%5.3" ECU_ADDRESS 0x60034CA6 /end MEASUREMENT
/begin MEASUREMENT DFC_b.TST_ThrVlvClsdPosnOffsLrnMaxB1 "Bit encoding / Tested bit for check DFC_ThrVlvClsdPosnOffsLrnMaxB1" UBYTE DFC_OneToOne 1 100 0.00 1.000 BIT_MASK 0x8 FORMAT "%5.3" ECU_ADDRESS 0x60034CA7 /end MEASUREMENT
/begin MEASUREMENT DFC_b.TST_ThrVlvClsdPosnOffsLrnMinB1 "Bit encoding / Tested bit for check DFC_ThrVlvClsdPosnOffsLrnMinB1" UBYTE DFC_OneToOne 1 100 0.00 1.000 BIT_MASK 0x8 FORMAT "%5.3" ECU_ADDRESS 0x60034CA8 /end MEASUREMENT
/begin MEASUREMENT DFC_b.TST_ThrVlvCtrlDeB1 "Bit encoding / Tested bit for check DFC_ThrVlvCtrlDeB1" UBYTE DFC_OneToOne 1 100 0.00 1.000 BIT_MASK 0x8 FORMAT "%5.3" ECU_ADDRESS 0x60034CA9 /end MEASUREMENT
/begin MEASUREMENT DFC_b.TST_ThrVlvDycB1 "Bit encoding / Tested bit for check DFC_ThrVlvDycB1" UBYTE DFC_OneToOne 1 100 0.00 1.000 BIT_MASK 0x8 FORMAT "%5.3" ECU_ADDRESS 0x60034CAA /end MEASUREMENT
/begin MEASUREMENT DFC_b.TST_ThrVlvLimpAirPosnMaxAbsltDriftB1 "Bit encoding / Tested bit for check DFC_ThrVlvLimpAirPosnMaxAbsltDriftB1" UBYTE DFC_OneToOne 1 100 0.00 1.000 BIT_MASK 0x8 FORMAT "%5.3" ECU_ADDRESS 0x60034CAB /end MEASUREMENT
/begin MEASUREMENT DFC_b.TST_ThrVlvLimpAirPosnMaxB1 "Bit encoding / Tested bit for check DFC_ThrVlvLimpAirPosnMaxB1" UBYTE DFC_OneToOne 1 100 0.00 1.000 BIT_MASK 0x8 FORMAT "%5.3" ECU_ADDRESS 0x60034CAC /end MEASUREMENT
/begin MEASUREMENT DFC_b.TST_ThrVlvLimpAirPosnMaxRelDriftB1 "Bit encoding / Tested bit for check DFC_ThrVlvLimpAirPosnMaxRelDriftB1" UBYTE DFC_OneToOne 1 100 0.00 1.000 BIT_MASK 0x8 FORMAT "%5.3" ECU_ADDRESS 0x60034CAD /end MEASUREMENT
/begin MEASUREMENT DFC_b.TST_ThrVlvLimpAirPosnMinB1 "Bit encoding / Tested bit for check DFC_ThrVlvLimpAirPosnMinB1" UBYTE DFC_OneToOne 1 100 0.00 1.000 BIT_MASK 0x8 FORMAT "%5.3" ECU_ADDRESS 0x60034CAE /end MEASUREMENT
/begin MEASUREMENT DFC_b.TST_ThrVlvOpenLoadB1 "Bit encoding / Tested bit for check DFC_ThrVlvOpenLoadB1" UBYTE DFC_OneToOne 1 100 0.00 1.000 BIT_MASK 0x8 FORMAT "%5.3" ECU_ADDRESS 0x60034CAF /end MEASUREMENT
/begin MEASUREMENT DFC_b.TST_ThrVlvOpenSprgB1 "Bit encoding / Tested bit for check DFC_ThrVlvOpenSprgB1" UBYTE DFC_OneToOne 1 100 0.00 1.000 BIT_MASK 0x8 FORMAT "%5.3" ECU_ADDRESS 0x60034CB0 /end MEASUREMENT
/begin MEASUREMENT DFC_b.TST_ThrVlvOpenSprgSprdB1 "Bit encoding / Tested bit for check DFC_ThrVlvOpenSprgSprdB1" UBYTE DFC_OneToOne 1 100 0.00 1.000 BIT_MASK 0x8 FORMAT "%5.3" ECU_ADDRESS 0x60034CB1 /end MEASUREMENT
/begin MEASUREMENT DFC_b.TST_ThrVlvOpenSprgTwnB1 "Bit encoding / Tested bit for check DFC_ThrVlvOpenSprgTwnB1" UBYTE DFC_OneToOne 1 100 0.00 1.000 BIT_MASK 0x8 FORMAT "%5.3" ECU_ADDRESS 0x60034CB2 /end MEASUREMENT
/begin MEASUREMENT DFC_b.TST_ThrVlvOverTB1 "Bit encoding / Tested bit for check DFC_ThrVlvOverTB1" UBYTE DFC_OneToOne 1 100 0.00 1.000 BIT_MASK 0x8 FORMAT "%5.3" ECU_ADDRESS 0x60034CB3 /end MEASUREMENT
/begin MEASUREMENT DFC_b.TST_ThrVlvRetSprgB1 "Bit encoding / Tested bit for check DFC_ThrVlvRetSprgB1" UBYTE DFC_OneToOne 1 100 0.00 1.000 BIT_MASK 0x8 FORMAT "%5.3" ECU_ADDRESS 0x60034CB4 /end MEASUREMENT
/begin MEASUREMENT DFC_b.TST_ThrVlvRetSprgSprdB1 "Bit encoding / Tested bit for check DFC_ThrVlvRetSprgSprdB1" UBYTE DFC_OneToOne 1 100 0.00 1.000 BIT_MASK 0x8 FORMAT "%5.3" ECU_ADDRESS 0x60034CB5 /end MEASUREMENT
/begin MEASUREMENT DFC_b.TST_ThrVlvRetSprgTwnB1 "Bit encoding / Tested bit for check DFC_ThrVlvRetSprgTwnB1" UBYTE DFC_OneToOne 1 100 0.00 1.000 BIT_MASK 0x8 FORMAT "%5.3" ECU_ADDRESS 0x60034CB6 /end MEASUREMENT
/begin MEASUREMENT DFC_b.TST_ThrVlvSens1MaxB1 "Bit encoding / Tested bit for check DFC_ThrVlvSens1MaxB1" UBYTE DFC_OneToOne 1 100 0.00 1.000 BIT_MASK 0x8 FORMAT "%5.3" ECU_ADDRESS 0x60034CB7 /end MEASUREMENT
/begin MEASUREMENT DFC_b.TST_ThrVlvSens1NplB1 "Bit encoding / Tested bit for check DFC_ThrVlvSens1NplB1" UBYTE DFC_OneToOne 1 100 0.00 1.000 BIT_MASK 0x8 FORMAT "%5.3" ECU_ADDRESS 0x60034CB8 /end MEASUREMENT
/begin MEASUREMENT DFC_b.TST_ThrVlvSens2MaxB1 "Bit encoding / Tested bit for check DFC_ThrVlvSens2MaxB1" UBYTE DFC_OneToOne 1 100 0.00 1.000 BIT_MASK 0x8 FORMAT "%5.3" ECU_ADDRESS 0x60034CB9 /end MEASUREMENT
/begin MEASUREMENT DFC_b.TST_ThrVlvSens2MinB1 "Bit encoding / Tested bit for check DFC_ThrVlvSens2MinB1" UBYTE DFC_OneToOne 1 100 0.00 1.000 BIT_MASK 0x8 FORMAT "%5.3" ECU_ADDRESS 0x60034CBA /end MEASUREMENT
/begin MEASUREMENT DFC_b.TST_ThrVlvSens2NplB1 "Bit encoding / Tested bit for check DFC_ThrVlvSens2NplB1" UBYTE DFC_OneToOne 1 100 0.00 1.000 BIT_MASK 0x8 FORMAT "%5.3" ECU_ADDRESS 0x60034CBB /end MEASUREMENT
/begin MEASUREMENT DFC_b.TST_ThrVlvShoCircB1 "Bit encoding / Tested bit for check DFC_ThrVlvShoCircB1" UBYTE DFC_OneToOne 1 100 0.00 1.000 BIT_MASK 0x8 FORMAT "%5.3" ECU_ADDRESS 0x60034CBC /end MEASUREMENT
/begin MEASUREMENT DFC_b.TST_ThrVlvSpiErrB1 "Bit encoding / Tested bit for check DFC_ThrVlvSpiErrB1" UBYTE DFC_OneToOne 1 100 0.00 1.000 BIT_MASK 0x8 FORMAT "%5.3" ECU_ADDRESS 0x60034CBD /end MEASUREMENT
/begin MEASUREMENT DFC_b.TST_ThrvlvSens1MinB1 "Bit encoding / Tested bit for check DFC_ThrvlvSens1MinB1" UBYTE DFC_OneToOne 1 100 0.00 1.000 BIT_MASK 0x8 FORMAT "%5.3" ECU_ADDRESS 0x60034CBE /end MEASUREMENT
/begin MEASUREMENT DFC_b.TST_TiOffTBasdChkFast "Bit encoding / Tested bit for check DFC_TiOffTBasdChkFast" UBYTE DFC_OneToOne 1 100 0.00 1.000 BIT_MASK 0x8 FORMAT "%5.3" ECU_ADDRESS 0x60034CBF /end MEASUREMENT
/begin MEASUREMENT DFC_b.TST_TiOffTBasdChkSlow "Bit encoding / Tested bit for check DFC_TiOffTBasdChkSlow" UBYTE DFC_OneToOne 1 100 0.00 1.000 BIT_MASK 0x8 FORMAT "%5.3" ECU_ADDRESS 0x60034CC0 /end MEASUREMENT
/begin MEASUREMENT DFC_b.TST_UEGOHeatrCtlS1B1 "Bit encoding / Tested bit for check DFC_UEGOHeatrCtlS1B1" UBYTE DFC_OneToOne 1 100 0.00 1.000 BIT_MASK 0x8 FORMAT "%5.3" ECU_ADDRESS 0x60034CC1 /end MEASUREMENT
/begin MEASUREMENT DFC_b.TST_UEGOSnsrMntdS1B1 "Bit encoding / Tested bit for check DFC_UEGOSnsrMntdS1B1" UBYTE DFC_OneToOne 1 100 0.00 1.000 BIT_MASK 0x8 FORMAT "%5.3" ECU_ADDRESS 0x60034CC2 /end MEASUREMENT
/begin MEASUREMENT DFC_b.TST_VehVSig "Bit encoding / Tested bit for check DFC_VehVSig" UBYTE DFC_OneToOne 1 100 0.00 1.000 BIT_MASK 0x8 FORMAT "%5.3" ECU_ADDRESS 0x60034CC3 /end MEASUREMENT
/begin MEASUREMENT DFC_b.TST_VlvLftFbSwtIntk11SpclFail "Bit encoding / Tested bit for check DFC_VlvLftFbSwtIntk11SpclFail" UBYTE DFC_OneToOne 1 100 0.00 1.000 BIT_MASK 0x8 FORMAT "%5.3" ECU_ADDRESS 0x60034CC4 /end MEASUREMENT
/begin MEASUREMENT DFC_b.TST_VlvLftFbSwtIntk11StdFail "Bit encoding / Tested bit for check DFC_VlvLftFbSwtIntk11StdFail" UBYTE DFC_OneToOne 1 100 0.00 1.000 BIT_MASK 0x8 FORMAT "%5.3" ECU_ADDRESS 0x60034CC5 /end MEASUREMENT
/begin MEASUREMENT DFC_b.LDF_AltIOACGFailr "Bit encoding / Last debounced flag bit for check DFC_AltIOACGFailr" UBYTE DFC_OneToOne 1 100 0.00 1.000 BIT_MASK 0x10 FORMAT "%5.3" ECU_ADDRESS 0x60034A07 /end MEASUREMENT
/begin MEASUREMENT DFC_b.LDF_AltIOACGHiVltg "Bit encoding / Last debounced flag bit for check DFC_AltIOACGHiVltg" UBYTE DFC_OneToOne 1 100 0.00 1.000 BIT_MASK 0x10 FORMAT "%5.3" ECU_ADDRESS 0x60034A08 /end MEASUREMENT
/begin MEASUREMENT DFC_b.LDF_AltIOACGLoVltg "Bit encoding / Last debounced flag bit for check DFC_AltIOACGLoVltg" UBYTE DFC_OneToOne 1 100 0.00 1.000 BIT_MASK 0x10 FORMAT "%5.3" ECU_ADDRESS 0x60034A09 /end MEASUREMENT
/begin MEASUREMENT DFC_b.LDF_AltIOACGTHi "Bit encoding / Last debounced flag bit for check DFC_AltIOACGTHi" UBYTE DFC_OneToOne 1 100 0.00 1.000 BIT_MASK 0x10 FORMAT "%5.3" ECU_ADDRESS 0x60034A0A /end MEASUREMENT
/begin MEASUREMENT DFC_b.LDF_AltIODConnACG "Bit encoding / Last debounced flag bit for check DFC_AltIODConnACG" UBYTE DFC_OneToOne 1 100 0.00 1.000 BIT_MASK 0x10 FORMAT "%5.3" ECU_ADDRESS 0x60034A0B /end MEASUREMENT
/begin MEASUREMENT DFC_b.LDF_BattUHiFailr "Bit encoding / Last debounced flag bit for check DFC_BattUHiFailr" UBYTE DFC_OneToOne 1 100 0.00 1.000 BIT_MASK 0x10 FORMAT "%5.3" ECU_ADDRESS 0x60034A0C /end MEASUREMENT
/begin MEASUREMENT DFC_b.LDF_BattULoFailr "Bit encoding / Last debounced flag bit for check DFC_BattULoFailr" UBYTE DFC_OneToOne 1 100 0.00 1.000 BIT_MASK 0x10 FORMAT "%5.3" ECU_ADDRESS 0x60034A0D /end MEASUREMENT
/begin MEASUREMENT DFC_b.LDF_BrkBstPDriftHiErr "Bit encoding / Last debounced flag bit for check DFC_BrkBstPDriftHiErr" UBYTE DFC_OneToOne 1 100 0.00 1.000 BIT_MASK 0x10 FORMAT "%5.3" ECU_ADDRESS 0x60034A0E /end MEASUREMENT
/begin MEASUREMENT DFC_b.LDF_BrkBstPDriftLoErr "Bit encoding / Last debounced flag bit for check DFC_BrkBstPDriftLoErr" UBYTE DFC_OneToOne 1 100 0.00 1.000 BIT_MASK 0x10 FORMAT "%5.3" ECU_ADDRESS 0x60034A0F /end MEASUREMENT
/begin MEASUREMENT DFC_b.LDF_BrkBstPSnsrStuck "Bit encoding / Last debounced flag bit for check DFC_BrkBstPSnsrStuck" UBYTE DFC_OneToOne 1 100 0.00 1.000 BIT_MASK 0x10 FORMAT "%5.3" ECU_ADDRESS 0x60034A10 /end MEASUREMENT
/begin MEASUREMENT DFC_b.LDF_BrkMnSwtContOn "Bit encoding / Last debounced flag bit for check DFC_BrkMnSwtContOn" UBYTE DFC_OneToOne 1 100 0.00 1.000 BIT_MASK 0x10 FORMAT "%5.3" ECU_ADDRESS 0x60034A11 /end MEASUREMENT
/begin MEASUREMENT DFC_b.LDF_BrkMnSwtNotStp "Bit encoding / Last debounced flag bit for check DFC_BrkMnSwtNotStp" UBYTE DFC_OneToOne 1 100 0.00 1.000 BIT_MASK 0x10 FORMAT "%5.3" ECU_ADDRESS 0x60034A12 /end MEASUREMENT
/begin MEASUREMENT DFC_b.LDF_BrkNpl "Bit encoding / Last debounced flag bit for check DFC_BrkNpl" UBYTE DFC_OneToOne 1 100 0.00 1.000 BIT_MASK 0x10 FORMAT "%5.3" ECU_ADDRESS 0x60034A13 /end MEASUREMENT
/begin MEASUREMENT DFC_b.LDF_BrkRdntSwtContOn "Bit encoding / Last debounced flag bit for check DFC_BrkRdntSwtContOn" UBYTE DFC_OneToOne 1 100 0.00 1.000 BIT_MASK 0x10 FORMAT "%5.3" ECU_ADDRESS 0x60034A14 /end MEASUREMENT
/begin MEASUREMENT DFC_b.LDF_BrkRdntSwtNotStp "Bit encoding / Last debounced flag bit for check DFC_BrkRdntSwtNotStp" UBYTE DFC_OneToOne 1 100 0.00 1.000 BIT_MASK 0x10 FORMAT "%5.3" ECU_ADDRESS 0x60034A15 /end MEASUREMENT
/begin MEASUREMENT DFC_b.LDF_Clth3ONStuck "Bit encoding / Last debounced flag bit for check DFC_Clth3ONStuck" UBYTE DFC_OneToOne 1 100 0.00 1.000 BIT_MASK 0x10 FORMAT "%5.3" ECU_ADDRESS 0x60034A16 /end MEASUREMENT
/begin MEASUREMENT DFC_b.LDF_Clth4OFFStuck "Bit encoding / Last debounced flag bit for check DFC_Clth4OFFStuck" UBYTE DFC_OneToOne 1 100 0.00 1.000 BIT_MASK 0x10 FORMAT "%5.3" ECU_ADDRESS 0x60034A17 /end MEASUREMENT
/begin MEASUREMENT DFC_b.LDF_ClthOFFStuck "Bit encoding / Last debounced flag bit for check DFC_ClthOFFStuck" UBYTE DFC_OneToOne 1 100 0.00 1.000 BIT_MASK 0x10 FORMAT "%5.3" ECU_ADDRESS 0x60034A18 /end MEASUREMENT
/begin MEASUREMENT DFC_b.LDF_ClthONStuck "Bit encoding / Last debounced flag bit for check DFC_ClthONStuck" UBYTE DFC_OneToOne 1 100 0.00 1.000 BIT_MASK 0x10 FORMAT "%5.3" ECU_ADDRESS 0x60034A19 /end MEASUREMENT
/begin MEASUREMENT DFC_b.LDF_ClthStkFailInfo "Bit encoding / Last debounced flag bit for check DFC_ClthStkFailInfo" UBYTE DFC_OneToOne 1 100 0.00 1.000 BIT_MASK 0x10 FORMAT "%5.3" ECU_ADDRESS 0x60034A1A /end MEASUREMENT
/begin MEASUREMENT DFC_b.LDF_ComACFailInfo "Bit encoding / Last debounced flag bit for check DFC_ComACFailInfo" UBYTE DFC_OneToOne 1 100 0.00 1.000 BIT_MASK 0x10 FORMAT "%5.3" ECU_ADDRESS 0x60034A1B /end MEASUREMENT
/begin MEASUREMENT DFC_b.LDF_ComATFTValErr "Bit encoding / Last debounced flag bit for check DFC_ComATFTValErr" UBYTE DFC_OneToOne 1 100 0.00 1.000 BIT_MASK 0x10 FORMAT "%5.3" ECU_ADDRESS 0x60034A1C /end MEASUREMENT
/begin MEASUREMENT DFC_b.LDF_ComATMILReq "Bit encoding / Last debounced flag bit for check DFC_ComATMILReq" UBYTE DFC_OneToOne 1 100 0.00 1.000 BIT_MASK 0x10 FORMAT "%5.3" ECU_ADDRESS 0x60034A1D /end MEASUREMENT
/begin MEASUREMENT DFC_b.LDF_ComAYCAChksum "Bit encoding / Last debounced flag bit for check DFC_ComAYCAChksum" UBYTE DFC_OneToOne 1 100 0.00 1.000 BIT_MASK 0x10 FORMAT "%5.3" ECU_ADDRESS 0x60034A1E /end MEASUREMENT
/begin MEASUREMENT DFC_b.LDF_ComAYCARingCnt "Bit encoding / Last debounced flag bit for check DFC_ComAYCARingCnt" UBYTE DFC_OneToOne 1 100 0.00 1.000 BIT_MASK 0x10 FORMAT "%5.3" ECU_ADDRESS 0x60034A1F /end MEASUREMENT
/begin MEASUREMENT DFC_b.LDF_ComAYCATOut "Bit encoding / Last debounced flag bit for check DFC_ComAYCATOut" UBYTE DFC_OneToOne 1 100 0.00 1.000 BIT_MASK 0x10 FORMAT "%5.3" ECU_ADDRESS 0x60034A20 /end MEASUREMENT
/begin MEASUREMENT DFC_b.LDF_ComAYCDChkSum "Bit encoding / Last debounced flag bit for check DFC_ComAYCDChkSum" UBYTE DFC_OneToOne 1 100 0.00 1.000 BIT_MASK 0x10 FORMAT "%5.3" ECU_ADDRESS 0x60034A21 /end MEASUREMENT
/begin MEASUREMENT DFC_b.LDF_ComAYCDTOut "Bit encoding / Last debounced flag bit for check DFC_ComAYCDTOut" UBYTE DFC_OneToOne 1 100 0.00 1.000 BIT_MASK 0x10 FORMAT "%5.3" ECU_ADDRESS 0x60034A22 /end MEASUREMENT
/begin MEASUREMENT DFC_b.LDF_ComAYCFChksum "Bit encoding / Last debounced flag bit for check DFC_ComAYCFChksum" UBYTE DFC_OneToOne 1 100 0.00 1.000 BIT_MASK 0x10 FORMAT "%5.3" ECU_ADDRESS 0x60034A23 /end MEASUREMENT
/begin MEASUREMENT DFC_b.LDF_ComAYCFRingCnt "Bit encoding / Last debounced flag bit for check DFC_ComAYCFRingCnt" UBYTE DFC_OneToOne 1 100 0.00 1.000 BIT_MASK 0x10 FORMAT "%5.3" ECU_ADDRESS 0x60034A24 /end MEASUREMENT
/begin MEASUREMENT DFC_b.LDF_ComAYCFTOut "Bit encoding / Last debounced flag bit for check DFC_ComAYCFTOut" UBYTE DFC_OneToOne 1 100 0.00 1.000 BIT_MASK 0x10 FORMAT "%5.3" ECU_ADDRESS 0x60034A25 /end MEASUREMENT
/begin MEASUREMENT DFC_b.LDF_ComAYCGChksum "Bit encoding / Last debounced flag bit for check DFC_ComAYCGChksum" UBYTE DFC_OneToOne 1 100 0.00 1.000 BIT_MASK 0x10 FORMAT "%5.3" ECU_ADDRESS 0x60034A26 /end MEASUREMENT
/begin MEASUREMENT DFC_b.LDF_ComAYCGRingCnt "Bit encoding / Last debounced flag bit for check DFC_ComAYCGRingCnt" UBYTE DFC_OneToOne 1 100 0.00 1.000 BIT_MASK 0x10 FORMAT "%5.3" ECU_ADDRESS 0x60034A27 /end MEASUREMENT
/begin MEASUREMENT DFC_b.LDF_ComAYCGTOut "Bit encoding / Last debounced flag bit for check DFC_ComAYCGTOut" UBYTE DFC_OneToOne 1 100 0.00 1.000 BIT_MASK 0x10 FORMAT "%5.3" ECU_ADDRESS 0x60034A28 /end MEASUREMENT
/begin MEASUREMENT DFC_b.LDF_ComAYCIChkSum "Bit encoding / Last debounced flag bit for check DFC_ComAYCIChkSum" UBYTE DFC_OneToOne 1 100 0.00 1.000 BIT_MASK 0x10 FORMAT "%5.3" ECU_ADDRESS 0x60034A29 /end MEASUREMENT
/begin MEASUREMENT DFC_b.LDF_ComAYCIRingCnt "Bit encoding / Last debounced flag bit for check DFC_ComAYCIRingCnt" UBYTE DFC_OneToOne 1 100 0.00 1.000 BIT_MASK 0x10 FORMAT "%5.3" ECU_ADDRESS 0x60034A2A /end MEASUREMENT
/begin MEASUREMENT DFC_b.LDF_ComAYCITOut "Bit encoding / Last debounced flag bit for check DFC_ComAYCITOut" UBYTE DFC_OneToOne 1 100 0.00 1.000 BIT_MASK 0x10 FORMAT "%5.3" ECU_ADDRESS 0x60034A2B /end MEASUREMENT
/begin MEASUREMENT DFC_b.LDF_ComBCM1ChkSum "Bit encoding / Last debounced flag bit for check DFC_ComBCM1ChkSum" UBYTE DFC_OneToOne 1 100 0.00 1.000 BIT_MASK 0x10 FORMAT "%5.3" ECU_ADDRESS 0x60034A2C /end MEASUREMENT
/begin MEASUREMENT DFC_b.LDF_ComBCM1RingCnt "Bit encoding / Last debounced flag bit for check DFC_ComBCM1RingCnt" UBYTE DFC_OneToOne 1 100 0.00 1.000 BIT_MASK 0x10 FORMAT "%5.3" ECU_ADDRESS 0x60034A2D /end MEASUREMENT
/begin MEASUREMENT DFC_b.LDF_ComBCM1TOut "Bit encoding / Last debounced flag bit for check DFC_ComBCM1TOut" UBYTE DFC_OneToOne 1 100 0.00 1.000 BIT_MASK 0x10 FORMAT "%5.3" ECU_ADDRESS 0x60034A2E /end MEASUREMENT
/begin MEASUREMENT DFC_b.LDF_ComCANABusOffErr "Bit encoding / Last debounced flag bit for check DFC_ComCANABusOffErr" UBYTE DFC_OneToOne 1 100 0.00 1.000 BIT_MASK 0x10 FORMAT "%5.3" ECU_ADDRESS 0x60034A2F /end MEASUREMENT
/begin MEASUREMENT DFC_b.LDF_ComCANBBusOffErr "Bit encoding / Last debounced flag bit for check DFC_ComCANBBusOffErr" UBYTE DFC_OneToOne 1 100 0.00 1.000 BIT_MASK 0x10 FORMAT "%5.3" ECU_ADDRESS 0x60034A30 /end MEASUREMENT
/begin MEASUREMENT DFC_b.LDF_ComCANCBusOffErr "Bit encoding / Last debounced flag bit for check DFC_ComCANCBusOffErr" UBYTE DFC_OneToOne 1 100 0.00 1.000 BIT_MASK 0x10 FORMAT "%5.3" ECU_ADDRESS 0x60034A31 /end MEASUREMENT
/begin MEASUREMENT DFC_b.LDF_ComCGW1ChkSum "Bit encoding / Last debounced flag bit for check DFC_ComCGW1ChkSum" UBYTE DFC_OneToOne 1 100 0.00 1.000 BIT_MASK 0x10 FORMAT "%5.3" ECU_ADDRESS 0x60034A32 /end MEASUREMENT
/begin MEASUREMENT DFC_b.LDF_ComCGW1RingCnt "Bit encoding / Last debounced flag bit for check DFC_ComCGW1RingCnt" UBYTE DFC_OneToOne 1 100 0.00 1.000 BIT_MASK 0x10 FORMAT "%5.3" ECU_ADDRESS 0x60034A33 /end MEASUREMENT
/begin MEASUREMENT DFC_b.LDF_ComCGW1TOut "Bit encoding / Last debounced flag bit for check DFC_ComCGW1TOut" UBYTE DFC_OneToOne 1 100 0.00 1.000 BIT_MASK 0x10 FORMAT "%5.3" ECU_ADDRESS 0x60034A34 /end MEASUREMENT
/begin MEASUREMENT DFC_b.LDF_ComConvBoostErr "Bit encoding / Last debounced flag bit for check DFC_ComConvBoostErr" UBYTE DFC_OneToOne 1 100 0.00 1.000 BIT_MASK 0x10 FORMAT "%5.3" ECU_ADDRESS 0x60034A35 /end MEASUREMENT
/begin MEASUREMENT DFC_b.LDF_ComConvSlipErr "Bit encoding / Last debounced flag bit for check DFC_ComConvSlipErr" UBYTE DFC_OneToOne 1 100 0.00 1.000 BIT_MASK 0x10 FORMAT "%5.3" ECU_ADDRESS 0x60034A36 /end MEASUREMENT
/begin MEASUREMENT DFC_b.LDF_ComEAT10Chksum "Bit encoding / Last debounced flag bit for check DFC_ComEAT10Chksum" UBYTE DFC_OneToOne 1 100 0.00 1.000 BIT_MASK 0x10 FORMAT "%5.3" ECU_ADDRESS 0x60034A37 /end MEASUREMENT
/begin MEASUREMENT DFC_b.LDF_ComEAT10RingCnt "Bit encoding / Last debounced flag bit for check DFC_ComEAT10RingCnt" UBYTE DFC_OneToOne 1 100 0.00 1.000 BIT_MASK 0x10 FORMAT "%5.3" ECU_ADDRESS 0x60034A38 /end MEASUREMENT
/begin MEASUREMENT DFC_b.LDF_ComEAT10TOut "Bit encoding / Last debounced flag bit for check DFC_ComEAT10TOut" UBYTE DFC_OneToOne 1 100 0.00 1.000 BIT_MASK 0x10 FORMAT "%5.3" ECU_ADDRESS 0x60034A39 /end MEASUREMENT
/begin MEASUREMENT DFC_b.LDF_ComEAT11ChkSum "Bit encoding / Last debounced flag bit for check DFC_ComEAT11ChkSum" UBYTE DFC_OneToOne 1 100 0.00 1.000 BIT_MASK 0x10 FORMAT "%5.3" ECU_ADDRESS 0x60034A3A /end MEASUREMENT
/begin MEASUREMENT DFC_b.LDF_ComEAT11RingCnt "Bit encoding / Last debounced flag bit for check DFC_ComEAT11RingCnt" UBYTE DFC_OneToOne 1 100 0.00 1.000 BIT_MASK 0x10 FORMAT "%5.3" ECU_ADDRESS 0x60034A3B /end MEASUREMENT
/begin MEASUREMENT DFC_b.LDF_ComEAT11TOut "Bit encoding / Last debounced flag bit for check DFC_ComEAT11TOut" UBYTE DFC_OneToOne 1 100 0.00 1.000 BIT_MASK 0x10 FORMAT "%5.3" ECU_ADDRESS 0x60034A3C /end MEASUREMENT
/begin MEASUREMENT DFC_b.LDF_ComEAT12ChkSum "Bit encoding / Last debounced flag bit for check DFC_ComEAT12ChkSum" UBYTE DFC_OneToOne 1 100 0.00 1.000 BIT_MASK 0x10 FORMAT "%5.3" ECU_ADDRESS 0x60034A3D /end MEASUREMENT
/begin MEASUREMENT DFC_b.LDF_ComEAT12RingCnt "Bit encoding / Last debounced flag bit for check DFC_ComEAT12RingCnt" UBYTE DFC_OneToOne 1 100 0.00 1.000 BIT_MASK 0x10 FORMAT "%5.3" ECU_ADDRESS 0x60034A3E /end MEASUREMENT
/begin MEASUREMENT DFC_b.LDF_ComEAT12TOut "Bit encoding / Last debounced flag bit for check DFC_ComEAT12TOut" UBYTE DFC_OneToOne 1 100 0.00 1.000 BIT_MASK 0x10 FORMAT "%5.3" ECU_ADDRESS 0x60034A3F /end MEASUREMENT
/begin MEASUREMENT DFC_b.LDF_ComEAT13ChkSum "Bit encoding / Last debounced flag bit for check DFC_ComEAT13ChkSum" UBYTE DFC_OneToOne 1 100 0.00 1.000 BIT_MASK 0x10 FORMAT "%5.3" ECU_ADDRESS 0x60034A40 /end MEASUREMENT
/begin MEASUREMENT DFC_b.LDF_ComEAT13RingCnt "Bit encoding / Last debounced flag bit for check DFC_ComEAT13RingCnt" UBYTE DFC_OneToOne 1 100 0.00 1.000 BIT_MASK 0x10 FORMAT "%5.3" ECU_ADDRESS 0x60034A41 /end MEASUREMENT
/begin MEASUREMENT DFC_b.LDF_ComEAT13TOut "Bit encoding / Last debounced flag bit for check DFC_ComEAT13TOut" UBYTE DFC_OneToOne 1 100 0.00 1.000 BIT_MASK 0x10 FORMAT "%5.3" ECU_ADDRESS 0x60034A42 /end MEASUREMENT
/begin MEASUREMENT DFC_b.LDF_ComEAT1Chksum "Bit encoding / Last debounced flag bit for check DFC_ComEAT1Chksum" UBYTE DFC_OneToOne 1 100 0.00 1.000 BIT_MASK 0x10 FORMAT "%5.3" ECU_ADDRESS 0x60034A43 /end MEASUREMENT
/begin MEASUREMENT DFC_b.LDF_ComEAT1RingCnt "Bit encoding / Last debounced flag bit for check DFC_ComEAT1RingCnt" UBYTE DFC_OneToOne 1 100 0.00 1.000 BIT_MASK 0x10 FORMAT "%5.3" ECU_ADDRESS 0x60034A44 /end MEASUREMENT
/begin MEASUREMENT DFC_b.LDF_ComEAT1TOut "Bit encoding / Last debounced flag bit for check DFC_ComEAT1TOut" UBYTE DFC_OneToOne 1 100 0.00 1.000 BIT_MASK 0x10 FORMAT "%5.3" ECU_ADDRESS 0x60034A45 /end MEASUREMENT
/begin MEASUREMENT DFC_b.LDF_ComEAT2ChkSum "Bit encoding / Last debounced flag bit for check DFC_ComEAT2ChkSum" UBYTE DFC_OneToOne 1 100 0.00 1.000 BIT_MASK 0x10 FORMAT "%5.3" ECU_ADDRESS 0x60034A46 /end MEASUREMENT
/begin MEASUREMENT DFC_b.LDF_ComEAT2RingCnt "Bit encoding / Last debounced flag bit for check DFC_ComEAT2RingCnt" UBYTE DFC_OneToOne 1 100 0.00 1.000 BIT_MASK 0x10 FORMAT "%5.3" ECU_ADDRESS 0x60034A47 /end MEASUREMENT
/begin MEASUREMENT DFC_b.LDF_ComEAT2TOut "Bit encoding / Last debounced flag bit for check DFC_ComEAT2TOut" UBYTE DFC_OneToOne 1 100 0.00 1.000 BIT_MASK 0x10 FORMAT "%5.3" ECU_ADDRESS 0x60034A48 /end MEASUREMENT
/begin MEASUREMENT DFC_b.LDF_ComEAT4ChkSum "Bit encoding / Last debounced flag bit for check DFC_ComEAT4ChkSum" UBYTE DFC_OneToOne 1 100 0.00 1.000 BIT_MASK 0x10 FORMAT "%5.3" ECU_ADDRESS 0x60034A49 /end MEASUREMENT
/begin MEASUREMENT DFC_b.LDF_ComEAT4RingCnt "Bit encoding / Last debounced flag bit for check DFC_ComEAT4RingCnt" UBYTE DFC_OneToOne 1 100 0.00 1.000 BIT_MASK 0x10 FORMAT "%5.3" ECU_ADDRESS 0x60034A4A /end MEASUREMENT
/begin MEASUREMENT DFC_b.LDF_ComEAT4TOut "Bit encoding / Last debounced flag bit for check DFC_ComEAT4TOut" UBYTE DFC_OneToOne 1 100 0.00 1.000 BIT_MASK 0x10 FORMAT "%5.3" ECU_ADDRESS 0x60034A4B /end MEASUREMENT
/begin MEASUREMENT DFC_b.LDF_ComEAT6Chksum "Bit encoding / Last debounced flag bit for check DFC_ComEAT6Chksum" UBYTE DFC_OneToOne 1 100 0.00 1.000 BIT_MASK 0x10 FORMAT "%5.3" ECU_ADDRESS 0x60034A4C /end MEASUREMENT
/begin MEASUREMENT DFC_b.LDF_ComEAT6RingCnt "Bit encoding / Last debounced flag bit for check DFC_ComEAT6RingCnt" UBYTE DFC_OneToOne 1 100 0.00 1.000 BIT_MASK 0x10 FORMAT "%5.3" ECU_ADDRESS 0x60034A4D /end MEASUREMENT
/begin MEASUREMENT DFC_b.LDF_ComEAT6TOut "Bit encoding / Last debounced flag bit for check DFC_ComEAT6TOut" UBYTE DFC_OneToOne 1 100 0.00 1.000 BIT_MASK 0x10 FORMAT "%5.3" ECU_ADDRESS 0x60034A4E /end MEASUREMENT
/begin MEASUREMENT DFC_b.LDF_ComEAT7Chksum "Bit encoding / Last debounced flag bit for check DFC_ComEAT7Chksum" UBYTE DFC_OneToOne 1 100 0.00 1.000 BIT_MASK 0x10 FORMAT "%5.3" ECU_ADDRESS 0x60034A4F /end MEASUREMENT
/begin MEASUREMENT DFC_b.LDF_ComEAT7RingCnt "Bit encoding / Last debounced flag bit for check DFC_ComEAT7RingCnt" UBYTE DFC_OneToOne 1 100 0.00 1.000 BIT_MASK 0x10 FORMAT "%5.3" ECU_ADDRESS 0x60034A50 /end MEASUREMENT
/begin MEASUREMENT DFC_b.LDF_ComEAT7TOut "Bit encoding / Last debounced flag bit for check DFC_ComEAT7TOut" UBYTE DFC_OneToOne 1 100 0.00 1.000 BIT_MASK 0x10 FORMAT "%5.3" ECU_ADDRESS 0x60034A51 /end MEASUREMENT
/begin MEASUREMENT DFC_b.LDF_ComEAT8Chksum "Bit encoding / Last debounced flag bit for check DFC_ComEAT8Chksum" UBYTE DFC_OneToOne 1 100 0.00 1.000 BIT_MASK 0x10 FORMAT "%5.3" ECU_ADDRESS 0x60034A52 /end MEASUREMENT
/begin MEASUREMENT DFC_b.LDF_ComEAT8RingCnt "Bit encoding / Last debounced flag bit for check DFC_ComEAT8RingCnt" UBYTE DFC_OneToOne 1 100 0.00 1.000 BIT_MASK 0x10 FORMAT "%5.3" ECU_ADDRESS 0x60034A53 /end MEASUREMENT
/begin MEASUREMENT DFC_b.LDF_ComEAT8TOut "Bit encoding / Last debounced flag bit for check DFC_ComEAT8TOut" UBYTE DFC_OneToOne 1 100 0.00 1.000 BIT_MASK 0x10 FORMAT "%5.3" ECU_ADDRESS 0x60034A54 /end MEASUREMENT
/begin MEASUREMENT DFC_b.LDF_ComEATAChksum "Bit encoding / Last debounced flag bit for check DFC_ComEATAChksum" UBYTE DFC_OneToOne 1 100 0.00 1.000 BIT_MASK 0x10 FORMAT "%5.3" ECU_ADDRESS 0x60034A55 /end MEASUREMENT
/begin MEASUREMENT DFC_b.LDF_ComEATARingCnt "Bit encoding / Last debounced flag bit for check DFC_ComEATARingCnt" UBYTE DFC_OneToOne 1 100 0.00 1.000 BIT_MASK 0x10 FORMAT "%5.3" ECU_ADDRESS 0x60034A56 /end MEASUREMENT
/begin MEASUREMENT DFC_b.LDF_ComEATATOut "Bit encoding / Last debounced flag bit for check DFC_ComEATATOut" UBYTE DFC_OneToOne 1 100 0.00 1.000 BIT_MASK 0x10 FORMAT "%5.3" ECU_ADDRESS 0x60034A57 /end MEASUREMENT
/begin MEASUREMENT DFC_b.LDF_ComEATBChkSum "Bit encoding / Last debounced flag bit for check DFC_ComEATBChkSum" UBYTE DFC_OneToOne 1 100 0.00 1.000 BIT_MASK 0x10 FORMAT "%5.3" ECU_ADDRESS 0x60034A58 /end MEASUREMENT
/begin MEASUREMENT DFC_b.LDF_ComEATBRingCnt "Bit encoding / Last debounced flag bit for check DFC_ComEATBRingCnt" UBYTE DFC_OneToOne 1 100 0.00 1.000 BIT_MASK 0x10 FORMAT "%5.3" ECU_ADDRESS 0x60034A59 /end MEASUREMENT
/begin MEASUREMENT DFC_b.LDF_ComEATBTOut "Bit encoding / Last debounced flag bit for check DFC_ComEATBTOut" UBYTE DFC_OneToOne 1 100 0.00 1.000 BIT_MASK 0x10 FORMAT "%5.3" ECU_ADDRESS 0x60034A5A /end MEASUREMENT
/begin MEASUREMENT DFC_b.LDF_ComEATCChksum "Bit encoding / Last debounced flag bit for check DFC_ComEATCChksum" UBYTE DFC_OneToOne 1 100 0.00 1.000 BIT_MASK 0x10 FORMAT "%5.3" ECU_ADDRESS 0x60034A5B /end MEASUREMENT
/begin MEASUREMENT DFC_b.LDF_ComEATCRingCnt "Bit encoding / Last debounced flag bit for check DFC_ComEATCRingCnt" UBYTE DFC_OneToOne 1 100 0.00 1.000 BIT_MASK 0x10 FORMAT "%5.3" ECU_ADDRESS 0x60034A5C /end MEASUREMENT
/begin MEASUREMENT DFC_b.LDF_ComEATCTOut "Bit encoding / Last debounced flag bit for check DFC_ComEATCTOut" UBYTE DFC_OneToOne 1 100 0.00 1.000 BIT_MASK 0x10 FORMAT "%5.3" ECU_ADDRESS 0x60034A5D /end MEASUREMENT
/begin MEASUREMENT DFC_b.LDF_ComEBBAChksum "Bit encoding / Last debounced flag bit for check DFC_ComEBBAChksum" UBYTE DFC_OneToOne 1 100 0.00 1.000 BIT_MASK 0x10 FORMAT "%5.3" ECU_ADDRESS 0x60034A5E /end MEASUREMENT
/begin MEASUREMENT DFC_b.LDF_ComEBBARingCnt "Bit encoding / Last debounced flag bit for check DFC_ComEBBARingCnt" UBYTE DFC_OneToOne 1 100 0.00 1.000 BIT_MASK 0x10 FORMAT "%5.3" ECU_ADDRESS 0x60034A5F /end MEASUREMENT
/begin MEASUREMENT DFC_b.LDF_ComEBBATOut "Bit encoding / Last debounced flag bit for check DFC_ComEBBATOut" UBYTE DFC_OneToOne 1 100 0.00 1.000 BIT_MASK 0x10 FORMAT "%5.3" ECU_ADDRESS 0x60034A60 /end MEASUREMENT
/begin MEASUREMENT DFC_b.LDF_ComEPS1Chksum "Bit encoding / Last debounced flag bit for check DFC_ComEPS1Chksum" UBYTE DFC_OneToOne 1 100 0.00 1.000 BIT_MASK 0x10 FORMAT "%5.3" ECU_ADDRESS 0x60034A61 /end MEASUREMENT
/begin MEASUREMENT DFC_b.LDF_ComEPS1RingCnt "Bit encoding / Last debounced flag bit for check DFC_ComEPS1RingCnt" UBYTE DFC_OneToOne 1 100 0.00 1.000 BIT_MASK 0x10 FORMAT "%5.3" ECU_ADDRESS 0x60034A62 /end MEASUREMENT
/begin MEASUREMENT DFC_b.LDF_ComEPS1TOut "Bit encoding / Last debounced flag bit for check DFC_ComEPS1TOut" UBYTE DFC_OneToOne 1 100 0.00 1.000 BIT_MASK 0x10 FORMAT "%5.3" ECU_ADDRESS 0x60034A63 /end MEASUREMENT
/begin MEASUREMENT DFC_b.LDF_ComEngCanRxErr "Bit encoding / Last debounced flag bit for check DFC_ComEngCanRxErr" UBYTE DFC_OneToOne 1 100 0.00 1.000 BIT_MASK 0x10 FORMAT "%5.3" ECU_ADDRESS 0x60034A64 /end MEASUREMENT
/begin MEASUREMENT DFC_b.LDF_ComGrvySnsrErr "Bit encoding / Last debounced flag bit for check DFC_ComGrvySnsrErr" UBYTE DFC_OneToOne 1 100 0.00 1.000 BIT_MASK 0x10 FORMAT "%5.3" ECU_ADDRESS 0x60034A65 /end MEASUREMENT
/begin MEASUREMENT DFC_b.LDF_ComGwIMG1ChkSum "Bit encoding / Last debounced flag bit for check DFC_ComGwIMG1ChkSum" UBYTE DFC_OneToOne 1 100 0.00 1.000 BIT_MASK 0x10 FORMAT "%5.3" ECU_ADDRESS 0x60034A66 /end MEASUREMENT
/begin MEASUREMENT DFC_b.LDF_ComGwIMG1RingCnt "Bit encoding / Last debounced flag bit for check DFC_ComGwIMG1RingCnt" UBYTE DFC_OneToOne 1 100 0.00 1.000 BIT_MASK 0x10 FORMAT "%5.3" ECU_ADDRESS 0x60034A67 /end MEASUREMENT
/begin MEASUREMENT DFC_b.LDF_ComGwIMG1TOut "Bit encoding / Last debounced flag bit for check DFC_ComGwIMG1TOut" UBYTE DFC_OneToOne 1 100 0.00 1.000 BIT_MASK 0x10 FORMAT "%5.3" ECU_ADDRESS 0x60034A68 /end MEASUREMENT
/begin MEASUREMENT DFC_b.LDF_ComGwIMG3ChkSum "Bit encoding / Last debounced flag bit for check DFC_ComGwIMG3ChkSum" UBYTE DFC_OneToOne 1 100 0.00 1.000 BIT_MASK 0x10 FORMAT "%5.3" ECU_ADDRESS 0x60034A69 /end MEASUREMENT
/begin MEASUREMENT DFC_b.LDF_ComGwIMG3RingCnt "Bit encoding / Last debounced flag bit for check DFC_ComGwIMG3RingCnt" UBYTE DFC_OneToOne 1 100 0.00 1.000 BIT_MASK 0x10 FORMAT "%5.3" ECU_ADDRESS 0x60034A6A /end MEASUREMENT
/begin MEASUREMENT DFC_b.LDF_ComGwIMG3TOut "Bit encoding / Last debounced flag bit for check DFC_ComGwIMG3TOut" UBYTE DFC_OneToOne 1 100 0.00 1.000 BIT_MASK 0x10 FORMAT "%5.3" ECU_ADDRESS 0x60034A6B /end MEASUREMENT
/begin MEASUREMENT DFC_b.LDF_ComGwIMG4ChkSum "Bit encoding / Last debounced flag bit for check DFC_ComGwIMG4ChkSum" UBYTE DFC_OneToOne 1 100 0.00 1.000 BIT_MASK 0x10 FORMAT "%5.3" ECU_ADDRESS 0x60034A6C /end MEASUREMENT
/begin MEASUREMENT DFC_b.LDF_ComGwIMG4RingCnt "Bit encoding / Last debounced flag bit for check DFC_ComGwIMG4RingCnt" UBYTE DFC_OneToOne 1 100 0.00 1.000 BIT_MASK 0x10 FORMAT "%5.3" ECU_ADDRESS 0x60034A6D /end MEASUREMENT
/begin MEASUREMENT DFC_b.LDF_ComGwIMG4TOut "Bit encoding / Last debounced flag bit for check DFC_ComGwIMG4TOut" UBYTE DFC_OneToOne 1 100 0.00 1.000 BIT_MASK 0x10 FORMAT "%5.3" ECU_ADDRESS 0x60034A6E /end MEASUREMENT
/begin MEASUREMENT DFC_b.LDF_ComGwIMG5ChkSum "Bit encoding / Last debounced flag bit for check DFC_ComGwIMG5ChkSum" UBYTE DFC_OneToOne 1 100 0.00 1.000 BIT_MASK 0x10 FORMAT "%5.3" ECU_ADDRESS 0x60034A6F /end MEASUREMENT
/begin MEASUREMENT DFC_b.LDF_ComGwIMG5RingCnt "Bit encoding / Last debounced flag bit for check DFC_ComGwIMG5RingCnt" UBYTE DFC_OneToOne 1 100 0.00 1.000 BIT_MASK 0x10 FORMAT "%5.3" ECU_ADDRESS 0x60034A70 /end MEASUREMENT
/begin MEASUREMENT DFC_b.LDF_ComGwIMG5TOut "Bit encoding / Last debounced flag bit for check DFC_ComGwIMG5TOut" UBYTE DFC_OneToOne 1 100 0.00 1.000 BIT_MASK 0x10 FORMAT "%5.3" ECU_ADDRESS 0x60034A71 /end MEASUREMENT
/begin MEASUREMENT DFC_b.LDF_ComGwIMG6ChkSum "Bit encoding / Last debounced flag bit for check DFC_ComGwIMG6ChkSum" UBYTE DFC_OneToOne 1 100 0.00 1.000 BIT_MASK 0x10 FORMAT "%5.3" ECU_ADDRESS 0x60034A72 /end MEASUREMENT
/begin MEASUREMENT DFC_b.LDF_ComGwIMG6RingCnt "Bit encoding / Last debounced flag bit for check DFC_ComGwIMG6RingCnt" UBYTE DFC_OneToOne 1 100 0.00 1.000 BIT_MASK 0x10 FORMAT "%5.3" ECU_ADDRESS 0x60034A73 /end MEASUREMENT
/begin MEASUREMENT DFC_b.LDF_ComGwIMG6TOut "Bit encoding / Last debounced flag bit for check DFC_ComGwIMG6TOut" UBYTE DFC_OneToOne 1 100 0.00 1.000 BIT_MASK 0x10 FORMAT "%5.3" ECU_ADDRESS 0x60034A74 /end MEASUREMENT
/begin MEASUREMENT DFC_b.LDF_ComIDASBChksum "Bit encoding / Last debounced flag bit for check DFC_ComIDASBChksum" UBYTE DFC_OneToOne 1 100 0.00 1.000 BIT_MASK 0x10 FORMAT "%5.3" ECU_ADDRESS 0x60034A75 /end MEASUREMENT
/begin FUNCTION DevLib_PWMOutErrHndlr "100.1.0   PWM Output error handling module" /begin DEF_CHARACTERISTIC DevLib_PWMOutDbgSig_C /end DEF_CHARACTERISTIC /begin LOC_MEASUREMENT DevLib_stPWMOutErr_mp /end LOC_MEASUREMENT FUNCTION_VERSION "100.1.0" /end FUNCTION
/begin FUNCTION DevLib_PwrStgState "100.7.0   Power Stage State"
 /begin DEF_CHARACTERISTIC Devlib_PsDisbl.facLowHysLo_C Devlib_PsDisbl.facLowHysHi_C Devlib_PsDisbl.facHighHysLo_C Devlib_PsDisbl.facHighHysHi_C Devlib_PwrStg.BattLoHysLo_C Devlib_PwrStg.BattLoHysHi_C Devlib_PwrStg.BattHiHysLo_C Devlib_PwrStg.BattHiHysHi_C /end DEF_CHARACTERISTIC
 /begin IN_MEASUREMENT BattU_facCor BattU_u DSM_TripChgFinshd MoCSOP_stRdy MoCSOP_stRdyMsg SyC_stSub /end IN_MEASUREMENT
 /begin OUT_MEASUREMENT DevLib_stPwrStgEnaCond /end OUT_MEASUREMENT
 FUNCTION_VERSION "100.7.0" /end FUNCTION
/begin FUNCTION DevLib_SRC "1.145.0   Device Library electrical Signal Range Check" FUNCTION_VERSION "1.145.0" /end FUNCTION
/begin FUNCTION DevLib_TransStage "1.149.0   Device Library Transition Stage for sensor replacement values" FUNCTION_VERSION "1.149.0" /end FUNCTION
/begin FUNCTION DFC "30000.33.0Diagnostic Fault Check"
 /begin OUT_MEASUREMENT DFC_b.TST_AltIOACGFailr DFC_b.TST_AltIOACGHiVltg DFC_b.TST_AltIOACGLoVltg DFC_b.TST_AltIOACGTHi DFC_b.TST_AltIODConnACG DFC_b.TST_BattUHiFailr DFC_b.TST_BattULoFailr DFC_b.TST_BrkBstPDriftHiErr DFC_b.TST_BrkBstPDriftLoErr DFC_b.TST_BrkBstPSnsrStuck DFC_b.TST_BrkMnSwtContOn DFC_b.TST_BrkMnSwtNotStp DFC_b.TST_BrkNpl DFC_b.TST_BrkRdntSwtContOn DFC_b.TST_BrkRdntSwtNotStp DFC_b.TST_Clth3ONStuck DFC_b.TST_Clth4OFFStuck DFC_b.TST_ClthOFFStuck DFC_b.TST_ClthONStuck DFC_b.TST_ClthStkFailInfo DFC_b.TST_ComACFailInfo DFC_b.TST_ComATFTValErr DFC_b.TST_ComATMILReq DFC_b.TST_ComAYCAChksum DFC_b.TST_ComAYCARingCnt DFC_b.TST_ComAYCATOut DFC_b.TST_ComAYCDChkSum DFC_b.TST_ComAYCDTOut DFC_b.TST_ComAYCFChksum DFC_b.TST_ComAYCFRingCnt DFC_b.TST_ComAYCFTOut DFC_b.TST_ComAYCGChksum DFC_b.TST_ComAYCGRingCnt DFC_b.TST_ComAYCGTOut DFC_b.TST_ComAYCIChkSum DFC_b.TST_ComAYCIRingCnt DFC_b.TST_ComAYCITOut DFC_b.TST_ComBCM1ChkSum DFC_b.TST_ComBCM1RingCnt DFC_b.TST_ComBCM1TOut DFC_b.TST_ComCANABusOffErr DFC_b.TST_ComCANBBusOffErr DFC_b.TST_ComCANCBusOffErr DFC_b.TST_ComCGW1ChkSum DFC_b.TST_ComCGW1RingCnt DFC_b.TST_ComCGW1TOut DFC_b.TST_ComConvBoostErr DFC_b.TST_ComConvSlipErr DFC_b.TST_ComEAT10Chksum DFC_b.TST_ComEAT10RingCnt DFC_b.TST_ComEAT10TOut DFC_b.TST_ComEAT11ChkSum DFC_b.TST_ComEAT11RingCnt DFC_b.TST_ComEAT11TOut DFC_b.TST_ComEAT12ChkSum DFC_b.TST_ComEAT12RingCnt DFC_b.TST_ComEAT12TOut DFC_b.TST_ComEAT13ChkSum DFC_b.TST_ComEAT13RingCnt DFC_b.TST_ComEAT13TOut DFC_b.TST_ComEAT1Chksum DFC_b.TST_ComEAT1RingCnt DFC_b.TST_ComEAT1TOut DFC_b.TST_ComEAT2ChkSum DFC_b.TST_ComEAT2RingCnt DFC_b.TST_ComEAT2TOut DFC_b.TST_ComEAT4ChkSum DFC_b.TST_ComEAT4RingCnt DFC_b.TST_ComEAT4TOut DFC_b.TST_ComEAT6Chksum DFC_b.TST_ComEAT6RingCnt DFC_b.TST_ComEAT6TOut DFC_b.TST_ComEAT7Chksum DFC_b.TST_ComEAT7RingCnt DFC_b.TST_ComEAT7TOut DFC_b.TST_ComEAT8Chksum DFC_b.TST_ComEAT8RingCnt DFC_b.TST_ComEAT8TOut DFC_b.TST_ComEATAChksum DFC_b.TST_ComEATARingCnt DFC_b.TST_ComEATATOut DFC_b.TST_ComEATBChkSum DFC_b.TST_ComEATBRingCnt DFC_b.TST_ComEATBTOut DFC_b.TST_ComEATCChksum DFC_b.TST_ComEATCRingCnt DFC_b.TST_ComEATCTOut DFC_b.TST_ComEBBAChksum DFC_b.TST_ComEBBARingCnt DFC_b.TST_ComEBBATOut DFC_b.TST_ComEPS1Chksum DFC_b.TST_ComEPS1RingCnt DFC_b.TST_ComEPS1TOut DFC_b.TST_ComEngCanRxErr DFC_b.TST_ComGrvySnsrErr DFC_b.TST_ComGwIMG1ChkSum DFC_b.TST_ComGwIMG1RingCnt DFC_b.TST_ComGwIMG1TOut DFC_b.TST_ComGwIMG3ChkSum DFC_b.TST_ComGwIMG3RingCnt DFC_b.TST_ComGwIMG3TOut DFC_b.TST_ComGwIMG4ChkSum DFC_b.TST_ComGwIMG4RingCnt DFC_b.TST_ComGwIMG4TOut DFC_b.TST_ComGwIMG5ChkSum DFC_b.TST_ComGwIMG5RingCnt DFC_b.TST_ComGwIMG5TOut DFC_b.TST_ComGwIMG6ChkSum DFC_b.TST_ComGwIMG6RingCnt DFC_b.TST_ComGwIMG6TOut DFC_b.TST_ComIDASBChksum DFC_b.TST_ComIDASBRingCnt DFC_b.TST_ComIDASBTOut DFC_b.TST_ComIMGMILReq DFC_b.TST_ComISSPrms DFC_b.TST_ComMETAChksum DFC_b.TST_ComMETARingCnt DFC_b.TST_ComMETATOut DFC_b.TST_ComMETCChksum DFC_b.TST_ComMETCRingCnt DFC_b.TST_ComMETCTOut DFC_b.TST_ComMETDChksum DFC_b.TST_ComMETDRingCnt DFC_b.TST_ComMETDTOut DFC_b.TST_ComMETE2Chksum DFC_b.TST_ComMETE2RingCnt DFC_b.TST_ComMETE2TOut DFC_b.TST_ComMETFChksum DFC_b.TST_ComMETFRingCnt DFC_b.TST_ComMETFTOut DFC_b.TST_ComMETGChksum DFC_b.TST_ComMETGRingCnt DFC_b.TST_ComMETGTOut DFC_b.TST_ComMETH2Chksum DFC_b.TST_ComMETH2RingCnt DFC_b.TST_ComMETH2TOut DFC_b.TST_ComMETHChksum DFC_b.TST_ComMETHRingCnt DFC_b.TST_ComMETHTOut DFC_b.TST_ComMETIChksum DFC_b.TST_ComMETIRingCnt DFC_b.TST_ComMETITOut DFC_b.TST_ComMETKChksum DFC_b.TST_ComMETKRingCnt DFC_b.TST_ComMETKTOut DFC_b.TST_ComMETLChksum DFC_b.TST_ComMETLRingCnt DFC_b.TST_ComMETLTOut DFC_b.TST_ComMETMChksum DFC_b.TST_ComMETMRingCnt DFC_b.TST_ComMETMTOut DFC_b.TST_ComMETNChksum DFC_b.TST_ComMETNRingCnt DFC_b.TST_ComMETNTOut DFC_b.TST_ComMtrCom DFC_b.TST_ComPCUChkSum DFC_b.TST_ComPCURingCnt DFC_b.TST_ComPCUTOut DFC_b.TST_ComSRSAChksum DFC_b.TST_ComSRSARingCnt DFC_b.TST_ComSRSATOut DFC_b.TST_ComSRSBChksum DFC_b.TST_ComSRSBRingCnt DFC_b.TST_ComSRSBTOut DFC_b.TST_ComSRSChksum DFC_b.TST_ComSRSErr DFC_b.TST_ComSRSRingCnt DFC_b.TST_ComSRSTOut DFC_b.TST_ComVehSpdPndFltTCU DFC_b.TST_EbsChartcCurrErr DFC_b.TST_EbsSelfDiagErr DFC_b.TST_GbxCANDigPlausErr DFC_b.TST_GbxNPos1SRCMax DFC_b.TST_GbxNPos1SRCMin DFC_b.TST_GbxNPos2SRCMax DFC_b.TST_GbxNPos2SRCMin DFC_b.TST_GbxNPosAlvChk DFC_b.TST_GbxNPosSyncErr DFC_b.TST_HEGOS2B1HtrPsMax DFC_b.TST_HEGOS2B1HtrPsMin DFC_b.TST_HEGOS2B1HtrPsSig DFC_b.TST_LinCSErrACG DFC_b.TST_LinCSErrEBS DFC_b.TST_LinHdrTimeoutErrACG DFC_b.TST_LinHdrTimeoutErrEBS DFC_b.TST_LinMsgTimeoutErrACG DFC_b.TST_LinMsgTimeoutErrEBS DFC_b.TST_LinNoStrtComErr DFC_b.TST_MisfDetVWhlFrntLeOORHi DFC_b.TST_MisfDetVWhlFrntLeRatyHi DFC_b.TST_MisfDetVWhlFrntLeRatyLo DFC_b.TST_MisfDetVWhlFrntLeStuck DFC_b.TST_MisfDetVWhlFrntRiOORHi DFC_b.TST_MisfDetVWhlFrntRiRatyHi DFC_b.TST_MisfDetVWhlFrntRiRatyLo DFC_b.TST_MisfDetVWhlFrntRiStuck DFC_b.TST_MisfDetVWhlReLeOORHi DFC_b.TST_MisfDetVWhlReLeRatyHi DFC_b.TST_MisfDetVWhlReLeRatyLo DFC_b.TST_MisfDetVWhlReLeStuck DFC_b.TST_MisfDetVWhlReRiOORHi DFC_b.TST_MisfDetVWhlReRiRatyHi DFC_b.TST_MisfDetVWhlReRiRatyLo DFC_b.TST_MisfDetVWhlReRiStuck DFC_b.TST_MisfDetdVWhlFrntLePlaus DFC_b.TST_MisfDetdVWhlFrntRiPlaus DFC_b.TST_MisfDetdVWhlReLePlaus DFC_b.TST_MisfDetdVWhlReRiPlaus DFC_b.TST_PEnvSigRngMax DFC_b.TST_PEnvSigRngMin DFC_b.TST_StmFault DFC_b.TST_StrtCtOffPth DFC_b.TST_StrtCtlErr DFC_b.TST_StrtFault DFC_b.TST_StrtLckJudg1 DFC_b.TST_StrtLckJudg2 DFC_b.TST_StrtOL DFC_b.TST_StrtOL2 DFC_b.TST_StrtSCB DFC_b.TST_StrtSCB2 DFC_b.TST_StrtSCG DFC_b.TST_StrtSCG2 DFC_b.TST_StrtStkRly1 DFC_b.TST_StrtStkRly2 DFC_b.TST_TEVEmax DFC_b.TST_TEVEmin DFC_b.TST_TEVEsig DFC_b.TST_VehVAllPlaus DFC_b.TST_VehVNCSnsrElecFailr DFC_b.TST_VehVPlausCan DFC_b.TST_VehVPlausFco DFC_b.TST_VehVPlausPwr DFC_b.TST_VehVPlausV2N DFC_b.TST_VehVSpdSnsrAElecFailr DFC_b.TST_VehVSpdSnsrBElecFailr DFC_b.TST_ClthMax DFC_b.TST_IgnClPs_DevComErr DFC_b.TST_IgnClPs_LineOl_0 DFC_b.TST_IgnClPs_LineOl_1 DFC_b.TST_IgnClPs_LineOl_2 DFC_b.TST_IgnClPs_LineOl_3 DFC_b.TST_IgnClPs_LineScb_0 DFC_b.TST_IgnClPs_LineScb_1 DFC_b.TST_IgnClPs_LineScb_2 DFC_b.TST_IgnClPs_LineScb_3 DFC_b.TST_IgnClPs_LineScg_0 DFC_b.TST_IgnClPs_LineScg_1 DFC_b.TST_IgnClPs_LineScg_2 DFC_b.TST_IgnClPs_LineScg_3 DFC_b.TST_UEGOASICS1B1 DFC_b.TST_UEGOOLIPES1B1 DFC_b.TST_UEGOOLRES1B1 DFC_b.TST_UEGOSCBS1B1 DFC_b.TST_UEGOSCGS1B1 DFC_b.TST_UEGOSPIS1B1 DFC_b.TST_UEGOSnsrS1B1 DFC_b.TST_UegoOlApesS1B1 DFC_b.TST_UegoOlRCmpS1B1 DFC_b.TST_AirCCmprOL DFC_b.TST_AirCCmprOvrTemp DFC_b.TST_AirCCmprSCB DFC_b.TST_AirCCmprSCG DFC_b.TST_AltErr DFC_b.TST_BattUSRCMax DFC_b.TST_BattUSRCMin DFC_b.TST_ComChksTCU1 DFC_b.TST_ComChksTCU11 DFC_b.TST_ComChksTCU12 DFC_b.TST_ComChksTCU13 DFC_b.TST_ComChksTCU2 DFC_b.TST_ComChksTCU3 DFC_b.TST_ComChksTCU4 DFC_b.TST_ComCntTCU1 DFC_b.TST_ComCntTCU11 DFC_b.TST_ComCntTCU12 DFC_b.TST_ComCntTCU13 DFC_b.TST_ComCntTCU2 DFC_b.TST_ComCntTCU3 DFC_b.TST_ComCntTCU4 DFC_b.TST_ComTOutTCU01 DFC_b.TST_ComTOutTCU02 DFC_b.TST_ComTOutTCU1 DFC_b.TST_ComTOutTCU11 DFC_b.TST_ComTOutTCU12 DFC_b.TST_ComTOutTCU13 DFC_b.TST_ComTOutTCU14 DFC_b.TST_ComTOutTCU2 DFC_b.TST_ComTOutTCU3 DFC_b.TST_ComTOutTCU4 DFC_b.TST_DevLibBattUHi DFC_b.TST_DevLibBattULo DFC_b.TST_FanDIOOL_0 DFC_b.TST_FanDIOOL_1 DFC_b.TST_FanDIOOvrTemp_0 DFC_b.TST_FanDIOOvrTemp_1 DFC_b.TST_FanDIOSCB_0 DFC_b.TST_FanDIOSCB_1 DFC_b.TST_FanDIOSCG_0 DFC_b.TST_FanDIOSCG_1 DFC_b.TST_MRlyDcOL DFC_b.TST_MRlyDcSCB DFC_b.TST_MRlyDcSCG DFC_b.TST_PSPOL DFC_b.TST_PSPOvrTemp DFC_b.TST_PSPSCB DFC_b.TST_PSPSCG DFC_b.TST_T50Err DFC_b.TST_ThrVlvLoBattB1 DFC_b.TST_VehVPhysRngHi DFC_b.TST_VehVSclOutOL DFC_b.TST_VehVSclOutOT DFC_b.TST_VehVSclOutSCB DFC_b.TST_VehVSclOutSCG DFC_b.TST_VehVSnsrARngHi DFC_b.TST_VehVSnsrBRngHi DFC_b.TST_VehVSpdRtyDiag DFC_b.TST_VehVWhlErr DFC_b.TST_ACEvpTSRCMax DFC_b.TST_ACEvpTSRCMin DFC_b.TST_AirCClntPAnaSRCMax DFC_b.TST_AirCClntPAnaSRCMin DFC_b.TST_AirCSwtNpl DFC_b.TST_AirCSwtSig DFC_b.TST_Brk DFC_b.TST_BrkSig DFC_b.TST_ClthSig DFC_b.TST_HLSDemOvhtEngLim DFC_b.TST_OilPNpl DFC_b.TST_PIntkVUsLineHiB1 DFC_b.TST_PIntkVUsLineLoB1 DFC_b.TST_VehVPhysRngLo DFC_b.TST_VehVSigCan DFC_b.TST_VehVSigCanSafe DFC_b.TST_VlvLftFbOilPSnsrIntk11SRCMax DFC_b.TST_VlvLftFbOilPSnsrIntk11SRCMin DFC_b.TST_ClthNpl DFC_b.TST_EV1max DFC_b.TST_EV1min DFC_b.TST_EV1sig DFC_b.TST_EV2max DFC_b.TST_EV2min DFC_b.TST_EV2sig DFC_b.TST_EV3max DFC_b.TST_EV3min DFC_b.TST_EV3sig DFC_b.TST_EV4max DFC_b.TST_EV4min DFC_b.TST_EV4sig DFC_b.TST_GbxPNPosnDrvCdn DFC_b.TST_GbxPNPosnPlausy DFC_b.TST_PEnvCcMax DFC_b.TST_PEnvCcMin DFC_b.TST_PEnvRngChkMax DFC_b.TST_PEnvRngChkMin DFC_b.TST_PEnvSnsrPlaus DFC_b.TST_UEGOHeatrPsS1B1Max DFC_b.TST_UEGOHeatrPsS1B1Min DFC_b.TST_UEGOHeatrPsS1B1Sig DFC_b.TST_UEGOHeatrRlyPsOLS1B1 DFC_b.TST_UEGOHeatrRlyPsSCBS1B1 DFC_b.TST_UEGOHeatrRlyPsSCGS1B1 DFC_b.TST_KnDetSens1PortAMax DFC_b.TST_KnDetSens1PortAMin DFC_b.TST_KnDetSens1PortBMax DFC_b.TST_KnDetSens1PortBMin DFC_b.TST_Clth2ONStuck DFC_b.TST_Clth2ONStuckLdc DFC_b.TST_Clth3ONStuckLdc DFC_b.TST_Clth3ONStuckPostDrv DFC_b.TST_Clth4ONStuck DFC_b.TST_Clth4ONStuckLdc DFC_b.TST_ComDLCTCU01 DFC_b.TST_ComDLCTCU02 DFC_b.TST_ComDLCTCU1 DFC_b.TST_ComDLCTCU11 DFC_b.TST_ComDLCTCU12 DFC_b.TST_ComDLCTCU13 DFC_b.TST_ComDLCTCU14 DFC_b.TST_ComDLCTCU2 DFC_b.TST_ComDLCTCU3 DFC_b.TST_ComDLCTCU4 DFC_b.TST_EVX DFC_b.TST_EbsSocFlt DFC_b.TST_I14229VINErr DFC_b.TST_LLRKHmax DFC_b.TST_LLRKHmin DFC_b.TST_LLRmax DFC_b.TST_LLRmin DFC_b.TST_RoughRoad DFC_b.TST_SiaEEPRdErr DFC_b.TST_SiaEEPWrngCod DFC_b.TST_UegoDummy DFC_b.TST_BusDiagCANAPPLBusOff DFC_b.TST_BusDiagCANCANCBusOff DFC_b.TST_BusDiagCANVEHICLEBusOff DFC_b.TST_RBA_IODIAGPWR_rba_IoExtCy329_SignalVltSply_0 DFC_b.TST_RBA_IODIAGPWR_rba_IoExtCy329_SignalVltSply_0OT DFC_b.TST_RBA_IODIAGPWR_rba_IoExtCy329_SignalVltSply_0OV DFC_b.TST_RBA_IODIAGPWR_rba_IoExtCy329_SignalVltSply_0SCG DFC_b.TST_RBA_IODIAGPWR_rba_IoExtCy329_SignalVltSply_0UV DFC_b.TST_RBA_IODIAGPWR_rba_IoExtCy329_SignalVltSply_1 DFC_b.TST_RBA_IODIAGPWR_rba_IoExtCy329_SignalVltSply_1OT DFC_b.TST_RBA_IODIAGPWR_rba_IoExtCy329_SignalVltSply_1OV DFC_b.TST_RBA_IODIAGPWR_rba_IoExtCy329_SignalVltSply_1SCG DFC_b.TST_RBA_IODIAGPWR_rba_IoExtCy329_SignalVltSply_1UV DFC_b.TST_RBA_IODIAGPWR_rba_IoExtCy329_SignalVltSply_2 DFC_b.TST_RBA_IODIAGPWR_rba_IoExtCy329_SignalVltSply_2OT DFC_b.TST_RBA_IODIAGPWR_rba_IoExtCy329_SignalVltSply_2OV DFC_b.TST_RBA_IODIAGPWR_rba_IoExtCy329_SignalVltSply_2SCG DFC_b.TST_RBA_IODIAGPWR_rba_IoExtCy329_SignalVltSply_2UV DFC_b.TST_CAN_E_TIMEOUT DFC_b.TST_LIN_E_TIMEOUT DFC_b.TST_MRlyOL DFC_b.TST_MRlySCB DFC_b.TST_MRlySCG DFC_b.TST_rba_MultiStackTrace_Threshold DFC_b.TST_BSWM_E_ACTION_FAILED DFC_b.TST_BSWM_E_INTRPTQUEUE_FULL DFC_b.TST_RBA_IOEXTLIB_KEEPALIVE_DRV DFC_b.TST_RBA_IOEXTLIB_KEEPALIVE_INI DFC_b.TST_rba_IoSigRtc_StopCounter DFC_b.TST_rba_MRly_Diag_Stk_Event DFC_b.TST_rba_MemDiag_MemReadErr DFC_b.TST_rba_MemDiag_MemWrErr DFC_b.TST_rba_SyC_IrrSwOffTrigEngRun_Event DFC_b.TST_rba_T15_Diag_ComInVld_Event DFC_b.TST_rba_T15_Diag_ComOff_HwOn_Event DFC_b.TST_rba_T15_Diag_ComOn_HwOff_Event DFC_b.TST_AppAllSnsrDfct DFC_b.TST_BattUStdbyDiaOL DFC_b.TST_BigLeakIntkMnfldEmiInfl DFC_b.TST_BrkMnSwtContOnWarnLmp DFC_b.TST_BrkMnSwtNotStpWarnLmp DFC_b.TST_BrkRdntSwtContOnWarnLmp DFC_b.TST_BrkRdntSwtNotStpWarnLmp DFC_b.TST_CEngDsTColdStrtMax DFC_b.TST_CEngDsTColdStrtMin DFC_b.TST_CEngDsTImps DFC_b.TST_CEngDsTPlausLSC DFC_b.TST_CEngDsTPlausSTC DFC_b.TST_CEngDsTSRCMax DFC_b.TST_CEngDsTSRCMin DFC_b.TST_CEngDsTSig DFC_b.TST_CEngUsTSRCMax DFC_b.TST_CEngUsTSRCMin DFC_b.TST_DCDCFltDet DFC_b.TST_DKRSA DFC_b.TST_DKVSmax DFC_b.TST_DKnpl DFC_b.TST_DSSmax DFC_b.TST_DSTTI DFC_b.TST_DSUmax DFC_b.TST_EGRVlvOL DFC_b.TST_EGRVlvSCB DFC_b.TST_EGRVlvSCG DFC_b.TST_EGSDUS2B1LtrDly DFC_b.TST_EGSDUS2B1LtrPT1 DFC_b.TST_EGSDUS2B1RtlDly DFC_b.TST_EGSDUS2B1RtlPT1 DFC_b.TST_EGSDUS2B1TarLean DFC_b.TST_EGSDUS2B1TarRich DFC_b.TST_ETAKHLmax DFC_b.TST_ETAKHTmax DFC_b.TST_EngICO DFC_b.TST_EngPrtOvrSpdMon DFC_b.TST_EpmCaSI1ErrSig DFC_b.TST_EpmCaSI1NoSig DFC_b.TST_EpmCaSI1OfsErr DFC_b.TST_EpmCrSErrSig DFC_b.TST_EpmCrSNoSig DFC_b.TST_EtaEngIdleNonCsers DFC_b.TST_EtaEngPtlNonCsers DFC_b.TST_FRAmax DFC_b.TST_FRAmin DFC_b.TST_GbxRvsSwtStk DFC_b.TST_HDRmax DFC_b.TST_HEGOS2B1ElecMax DFC_b.TST_HEGOS2B1ElecMin DFC_b.TST_HEGOS2B1ElecSig DFC_b.TST_HEGOS2B1HtgNpl DFC_b.TST_IntkAirTIntkMnfldCrssMax DFC_b.TST_IntkAirTIntkMnfldCrssMin DFC_b.TST_IntkAirTIntkMnfldHSCMax DFC_b.TST_IntkAirTIntkMnfldImps DFC_b.TST_IntkAirTIntkMnfldPRCMax DFC_b.TST_IntkAirTIntkMnfldPRCMin DFC_b.TST_IntkAirTIntkMnfldSRCMax DFC_b.TST_IntkAirTIntkMnfldSRCMin DFC_b.TST_IntkAirTIntkMnfldSTC DFC_b.TST_KS1max DFC_b.TST_KS1min DFC_b.TST_LMmax DFC_b.TST_LZSRnpl DFC_b.TST_LamDynDiagS1B1 DFC_b.TST_LeakIntkMnfldEmiInfl DFC_b.TST_MD00max DFC_b.TST_MDBmax DFC_b.TST_MDCat DFC_b.TST_MDCatCrit DFC_b.TST_MDCatCurr DFC_b.TST_MDCyl_0 DFC_b.TST_MDCyl_1 DFC_b.TST_MDCyl_2 DFC_b.TST_MDCyl_3 DFC_b.TST_MDEmi DFC_b.TST_MDEmiStrt DFC_b.TST_MDFco DFC_b.TST_MDMpl DFC_b.TST_MDSegTiAdpn DFC_b.TST_MDmax DFC_b.TST_MOXEMM_SMU_ALM0_0 DFC_b.TST_MOXEMM_SMU_ALM0_1 DFC_b.TST_MOXEMM_SMU_ALM0_10 DFC_b.TST_MOXEMM_SMU_ALM0_11 DFC_b.TST_MOXEMM_SMU_ALM0_13 DFC_b.TST_MOXEMM_SMU_ALM0_14 DFC_b.TST_MOXEMM_SMU_ALM0_2 DFC_b.TST_MOXEMM_SMU_ALM0_22 DFC_b.TST_MOXEMM_SMU_ALM0_23 DFC_b.TST_MOXEMM_SMU_ALM0_4 DFC_b.TST_MOXEMM_SMU_ALM0_5 DFC_b.TST_MOXEMM_SMU_ALM0_7 DFC_b.TST_MOXEMM_SMU_ALM0_8 DFC_b.TST_MOXEMM_SMU_ALM10_16 DFC_b.TST_MOXEMM_SMU_ALM10_17 DFC_b.TST_MOXEMM_SMU_ALM10_21 DFC_b.TST_MOXEMM_SMU_ALM11_0 DFC_b.TST_MOXEMM_SMU_ALM11_1 DFC_b.TST_MOXEMM_SMU_ALM11_2 DFC_b.TST_MOXEMM_SMU_ALM11_3 DFC_b.TST_MOXEMM_SMU_ALM11_4 DFC_b.TST_MOXEMM_SMU_ALM11_5 DFC_b.TST_MOXEMM_SMU_ALM11_8 DFC_b.TST_MOXEMM_SMU_ALM11_9 DFC_b.TST_MOXEMM_SMU_ALM1_0 DFC_b.TST_MOXEMM_SMU_ALM1_1 DFC_b.TST_MOXEMM_SMU_ALM1_10 DFC_b.TST_MOXEMM_SMU_ALM1_11 DFC_b.TST_MOXEMM_SMU_ALM1_13 DFC_b.TST_MOXEMM_SMU_ALM1_14 DFC_b.TST_MOXEMM_SMU_ALM1_2 DFC_b.TST_MOXEMM_SMU_ALM1_22 DFC_b.TST_MOXEMM_SMU_ALM1_23 DFC_b.TST_MOXEMM_SMU_ALM1_4 DFC_b.TST_MOXEMM_SMU_ALM1_5 DFC_b.TST_MOXEMM_SMU_ALM1_7 DFC_b.TST_MOXEMM_SMU_ALM1_8 DFC_b.TST_MOXEMM_SMU_ALM21_0 DFC_b.TST_MOXEMM_SMU_ALM21_16 DFC_b.TST_MOXEMM_SMU_ALM21_3 DFC_b.TST_MOXEMM_SMU_ALM2_1 DFC_b.TST_MOXEMM_SMU_ALM2_10 DFC_b.TST_MOXEMM_SMU_ALM2_11 DFC_b.TST_MOXEMM_SMU_ALM2_13 DFC_b.TST_MOXEMM_SMU_ALM2_14 DFC_b.TST_MOXEMM_SMU_ALM2_22 DFC_b.TST_MOXEMM_SMU_ALM2_23 DFC_b.TST_MOXEMM_SMU_ALM2_4 DFC_b.TST_MOXEMM_SMU_ALM2_5 DFC_b.TST_MOXEMM_SMU_ALM2_7 DFC_b.TST_MOXEMM_SMU_ALM2_8 DFC_b.TST_MOXEMM_SMU_ALM6_0 DFC_b.TST_MOXEMM_SMU_ALM6_11 DFC_b.TST_MOXEMM_SMU_ALM6_12 DFC_b.TST_MOXEMM_SMU_ALM6_14 DFC_b.TST_MOXEMM_SMU_ALM6_15 DFC_b.TST_MOXEMM_SMU_ALM6_17 DFC_b.TST_MOXEMM_SMU_ALM6_18 DFC_b.TST_MOXEMM_SMU_ALM6_20 DFC_b.TST_MOXEMM_SMU_ALM6_21 DFC_b.TST_MOXEMM_SMU_ALM6_25 DFC_b.TST_MOXEMM_SMU_ALM6_4 DFC_b.TST_MOXEMM_SMU_ALM6_5 DFC_b.TST_MOXEMM_SMU_ALM6_7 DFC_b.TST_MOXEMM_SMU_ALM6_8 DFC_b.TST_MOXEMM_SMU_ALM7_1 DFC_b.TST_MOXEMM_SMU_ALM7_12 DFC_b.TST_MOXEMM_SMU_ALM7_13 DFC_b.TST_MOXEMM_SMU_ALM7_14 DFC_b.TST_MOXEMM_SMU_ALM7_15 DFC_b.TST_MOXEMM_SMU_ALM7_16 DFC_b.TST_MOXEMM_SMU_ALM7_17 DFC_b.TST_MOXEMM_SMU_ALM7_2 DFC_b.TST_MOXEMM_SMU_ALM7_20 DFC_b.TST_MOXEMM_SMU_ALM7_25 DFC_b.TST_MOXEMM_SMU_ALM7_26 DFC_b.TST_MOXEMM_SMU_ALM7_28 DFC_b.TST_MOXEMM_SMU_ALM7_29 DFC_b.TST_MOXEMM_SMU_ALM7_30 DFC_b.TST_MOXEMM_SMU_ALM7_31 DFC_b.TST_MOXEMM_SMU_ALM8_0 DFC_b.TST_MOXEMM_SMU_ALM8_1 DFC_b.TST_MOXEMM_SMU_ALM8_10 DFC_b.TST_MOXEMM_SMU_ALM8_11 DFC_b.TST_MOXEMM_SMU_ALM8_12 DFC_b.TST_MOXEMM_SMU_ALM8_16 DFC_b.TST_MOXEMM_SMU_ALM8_18 DFC_b.TST_MOXEMM_SMU_ALM8_2 DFC_b.TST_MOXEMM_SMU_ALM8_3 DFC_b.TST_MOXEMM_SMU_ALM8_31 DFC_b.TST_MOXEMM_SMU_ALM8_4 DFC_b.TST_MOXEMM_SMU_ALM9_0 DFC_b.TST_MOXEMM_SMU_ALM9_15 DFC_b.TST_MOXEMM_SMU_ALM9_3 DFC_b.TST_MoCADCNTP DFC_b.TST_MoCADCTst DFC_b.TST_MoCSOPICO DFC_b.TST_MoFAPP DFC_b.TST_MoFAirFilgPrdc DFC_b.TST_MoFAirFlCtOffPfi DFC_b.TST_MoFAirFlCylPfi DFC_b.TST_MoFAirFlIn DFC_b.TST_MoFAirFlMixCtlPfiChkAirFl DFC_b.TST_MoFAirFlMixCtlPfiChkCtrl DFC_b.TST_MoFAirFlMode DFC_b.TST_MoFESpd DFC_b.TST_MoFIACo DFC_b.TST_MoFICOL1 DFC_b.TST_MoFICOL2 DFC_b.TST_MoFStrt DFC_b.TST_MoFTrqCmp DFC_b.TST_MoFTrqCmpMax DFC_b.TST_MoFTrqCmpMin DFC_b.TST_MoFVarPostBldSel DFC_b.TST_MoXEMMHwLTMCUFW DFC_b.TST_MoXEMMHwLTMonBIST DFC_b.TST_MoXEMMHwLTRegMonTest DFC_b.TST_MoXEMMHwLTStbySMUAlvTest DFC_b.TST_MoXEMMHwLTTempSens DFC_b.TST_MoXEMMHwLTUCBCfg DFC_b.TST_OCWDAABEActv DFC_b.TST_OCWDACom DFC_b.TST_OCWDAErrPin DFC_b.TST_OCWDAOvrVltg DFC_b.TST_ORAmax DFC_b.TST_ORAmin DFC_b.TST_PLLSUmax DFC_b.TST_PLLSUmin DFC_b.TST_PSR1max DFC_b.TST_PSRBmax DFC_b.TST_PSRBmin DFC_b.TST_PSRPmax DFC_b.TST_PSRPmin DFC_b.TST_PSRPsig DFC_b.TST_PSRmax DFC_b.TST_PUmax DFC_b.TST_P_VSE11_OL DFC_b.TST_P_VSE11_SCB DFC_b.TST_P_VSE11_SCG DFC_b.TST_PhyHighAPP1 DFC_b.TST_PhyHighAPP2 DFC_b.TST_PhyLowAPP1 DFC_b.TST_PhyLowAPP2 DFC_b.TST_SRCHighAPP1 DFC_b.TST_SRCHighAPP2 DFC_b.TST_SRCLowAPP1 DFC_b.TST_SRCLowAPP2 DFC_b.TST_SSpMon2 DFC_b.TST_SWReset_0 DFC_b.TST_SWReset_1 DFC_b.TST_SWReset_2 DFC_b.TST_SyncAPP DFC_b.TST_TAmax_Dummy DFC_b.TST_TKAEmax DFC_b.TST_TKAEmin DFC_b.TST_TKARmax DFC_b.TST_TKARnpl DFC_b.TST_TMmax_Dummy DFC_b.TST_TUMmax_Dummy DFC_b.TST_TWCDPriCatB1 DFC_b.TST_ThrVlvClsdPosnFirstOffsLrnImpoB1 DFC_b.TST_ThrVlvClsdPosnOffsLrnImpoB1 DFC_b.TST_ThrVlvClsdPosnOffsLrnMaxB1 DFC_b.TST_ThrVlvClsdPosnOffsLrnMinB1 DFC_b.TST_ThrVlvCtrlDeB1 DFC_b.TST_ThrVlvDycB1 DFC_b.TST_ThrVlvLimpAirPosnMaxAbsltDriftB1 DFC_b.TST_ThrVlvLimpAirPosnMaxB1 DFC_b.TST_ThrVlvLimpAirPosnMaxRelDriftB1 DFC_b.TST_ThrVlvLimpAirPosnMinB1 DFC_b.TST_ThrVlvOpenLoadB1 DFC_b.TST_ThrVlvOpenSprgB1 DFC_b.TST_ThrVlvOpenSprgSprdB1 DFC_b.TST_ThrVlvOpenSprgTwnB1 DFC_b.TST_ThrVlvOverTB1 DFC_b.TST_ThrVlvRetSprgB1 DFC_b.TST_ThrVlvRetSprgSprdB1 DFC_b.TST_ThrVlvRetSprgTwnB1 DFC_b.TST_ThrVlvSens1MaxB1 DFC_b.TST_ThrVlvSens1NplB1 DFC_b.TST_ThrVlvSens2MaxB1 DFC_b.TST_ThrVlvSens2MinB1 DFC_b.TST_ThrVlvSens2NplB1 DFC_b.TST_ThrVlvShoCircB1 DFC_b.TST_ThrVlvSpiErrB1 DFC_b.TST_ThrvlvSens1MinB1 DFC_b.TST_TiOffTBasdChkFast DFC_b.TST_TiOffTBasdChkSlow DFC_b.TST_UEGOHeatrCtlS1B1 DFC_b.TST_UEGOSnsrMntdS1B1 DFC_b.TST_VehVSig DFC_b.TST_VlvLftFbSwtIntk11SpclFail DFC_b.TST_VlvLftFbSwtIntk11StdFail DFC_b.LDF_AltIOACGFailr DFC_b.LDF_AltIOACGHiVltg DFC_b.LDF_AltIOACGLoVltg DFC_b.LDF_AltIOACGTHi DFC_b.LDF_AltIODConnACG DFC_b.LDF_BattUHiFailr DFC_b.LDF_BattULoFailr DFC_b.LDF_BrkBstPDriftHiErr DFC_b.LDF_BrkBstPDriftLoErr DFC_b.LDF_BrkBstPSnsrStuck DFC_b.LDF_BrkMnSwtContOn DFC_b.LDF_BrkMnSwtNotStp DFC_b.LDF_BrkNpl DFC_b.LDF_BrkRdntSwtContOn DFC_b.LDF_BrkRdntSwtNotStp DFC_b.LDF_Clth3ONStuck DFC_b.LDF_Clth4OFFStuck DFC_b.LDF_ClthOFFStuck DFC_b.LDF_ClthONStuck DFC_b.LDF_ClthStkFailInfo DFC_b.LDF_ComACFailInfo DFC_b.LDF_ComATFTValErr DFC_b.LDF_ComATMILReq DFC_b.LDF_ComAYCAChksum DFC_b.LDF_ComAYCARingCnt DFC_b.LDF_ComAYCATOut DFC_b.LDF_ComAYCDChkSum DFC_b.LDF_ComAYCDTOut DFC_b.LDF_ComAYCFChksum DFC_b.LDF_ComAYCFRingCnt DFC_b.LDF_ComAYCFTOut DFC_b.LDF_ComAYCGChksum DFC_b.LDF_ComAYCGRingCnt DFC_b.LDF_ComAYCGTOut DFC_b.LDF_ComAYCIChkSum DFC_b.LDF_ComAYCIRingCnt DFC_b.LDF_ComAYCITOut DFC_b.LDF_ComBCM1ChkSum DFC_b.LDF_ComBCM1RingCnt DFC_b.LDF_ComBCM1TOut DFC_b.LDF_ComCANABusOffErr DFC_b.LDF_ComCANBBusOffErr DFC_b.LDF_ComCANCBusOffErr DFC_b.LDF_ComCGW1ChkSum DFC_b.LDF_ComCGW1RingCnt DFC_b.LDF_ComCGW1TOut DFC_b.LDF_ComConvBoostErr DFC_b.LDF_ComConvSlipErr DFC_b.LDF_ComEAT10Chksum DFC_b.LDF_ComEAT10RingCnt DFC_b.LDF_ComEAT10TOut DFC_b.LDF_ComEAT11ChkSum DFC_b.LDF_ComEAT11RingCnt DFC_b.LDF_ComEAT11TOut DFC_b.LDF_ComEAT12ChkSum DFC_b.LDF_ComEAT12RingCnt DFC_b.LDF_ComEAT12TOut DFC_b.LDF_ComEAT13ChkSum DFC_b.LDF_ComEAT13RingCnt DFC_b.LDF_ComEAT13TOut DFC_b.LDF_ComEAT1Chksum DFC_b.LDF_ComEAT1RingCnt DFC_b.LDF_ComEAT1TOut DFC_b.LDF_ComEAT2ChkSum DFC_b.LDF_ComEAT2RingCnt DFC_b.LDF_ComEAT2TOut DFC_b.LDF_ComEAT4ChkSum DFC_b.LDF_ComEAT4RingCnt DFC_b.LDF_ComEAT4TOut DFC_b.LDF_ComEAT6Chksum DFC_b.LDF_ComEAT6RingCnt DFC_b.LDF_ComEAT6TOut DFC_b.LDF_ComEAT7Chksum DFC_b.LDF_ComEAT7RingCnt DFC_b.LDF_ComEAT7TOut DFC_b.LDF_ComEAT8Chksum DFC_b.LDF_ComEAT8RingCnt DFC_b.LDF_ComEAT8TOut DFC_b.LDF_ComEATAChksum DFC_b.LDF_ComEATARingCnt DFC_b.LDF_ComEATATOut DFC_b.LDF_ComEATBChkSum DFC_b.LDF_ComEATBRingCnt DFC_b.LDF_ComEATBTOut DFC_b.LDF_ComEATCChksum DFC_b.LDF_ComEATCRingCnt DFC_b.LDF_ComEATCTOut DFC_b.LDF_ComEBBAChksum DFC_b.LDF_ComEBBARingCnt DFC_b.LDF_ComEBBATOut DFC_b.LDF_ComEPS1Chksum DFC_b.LDF_ComEPS1RingCnt DFC_b.LDF_ComEPS1TOut DFC_b.LDF_ComEngCanRxErr DFC_b.LDF_ComGrvySnsrErr DFC_b.LDF_ComGwIMG1ChkSum DFC_b.LDF_ComGwIMG1RingCnt DFC_b.LDF_ComGwIMG1TOut DFC_b.LDF_ComGwIMG3ChkSum DFC_b.LDF_ComGwIMG3RingCnt DFC_b.LDF_ComGwIMG3TOut DFC_b.LDF_ComGwIMG4ChkSum DFC_b.LDF_ComGwIMG4RingCnt DFC_b.LDF_ComGwIMG4TOut DFC_b.LDF_ComGwIMG5ChkSum DFC_b.LDF_ComGwIMG5RingCnt DFC_b.LDF_ComGwIMG5TOut DFC_b.LDF_ComGwIMG6ChkSum DFC_b.LDF_ComGwIMG6RingCnt DFC_b.LDF_ComGwIMG6TOut DFC_b.LDF_ComIDASBChksum /end OUT_MEASUREMENT
 FUNCTION_VERSION "30000.33.0" /end FUNCTION
/begin COMPU_METHOD DFC_OneToOne "" RAT_FUNC "%6.2" "-" COEFFS 0 1 0 0 0 1 /end COMPU_METHOD
/begin COMPU_METHOD ENVT_TYPAVL_SY_Compu "" TAB_VERB "%6.3" "" COMPU_TAB_REF ENVT_TYPAVL_SY_Compu /end COMPU_METHOD
/begin COMPU_VTAB ENVT_TYPAVL_SY_Compu "" TAB_VERB 2 0 "False" 1 "True" /end COMPU_VTAB
/begin COMPU_METHOD EOBD5PLUS_SC_Compu "" TAB_VERB "%6.3" "" COMPU_TAB_REF EOBD5PLUS_SC_Compu /end COMPU_METHOD
/begin COMPU_VTAB EOBD5PLUS_SC_Compu "" TAB_VERB 2 0 "False" 1 "True" /end COMPU_VTAB
/begin COMPU_METHOD EOMACTVNENA_SC_Compu "" TAB_VERB "%6.3" "" COMPU_TAB_REF EOMACTVNENA_SC_Compu /end COMPU_METHOD
/begin COMPU_VTAB EOMACTVNENA_SC_Compu "" TAB_VERB 2 0 "False" 1 "True" /end COMPU_VTAB
/begin COMPU_METHOD EOMCOORNTYP_SC_Compu "" TAB_VERB "%6.3" "" COMPU_TAB_REF EOMCOORNTYP_SC_Compu /end COMPU_METHOD
/begin COMPU_VTAB EOMCOORNTYP_SC_Compu "" TAB_VERB 5 0 "0" 1 "1" 2 "2" 3 "3" 4 "4" /end COMPU_VTAB
/begin COMPU_METHOD EOMGPFLOAD_SC_Compu "" TAB_VERB "%6.3" "" COMPU_TAB_REF EOMGPFLOAD_SC_Compu /end COMPU_METHOD
/begin COMPU_VTAB EOMGPFLOAD_SC_Compu "" TAB_VERB 2 0 "NO_GPF_LOAD_AVAILABLE" 1 "EOM_GPF_LOAD_AVAILABLE" /end COMPU_VTAB
/begin COMPU_METHOD EOMMTRXSTGCFG_SC_Compu "" TAB_VERB "%6.3" "" COMPU_TAB_REF EOMMTRXSTGCFG_SC_Compu /end COMPU_METHOD
/begin COMPU_VTAB EOMMTRXSTGCFG_SC_Compu "" TAB_VERB 2 0 "physical_based_mode_gasoline" 1 "functional_based_mode_gasoline" /end COMPU_VTAB
/begin COMPU_METHOD EOMVLVLFTINMTRX_SC_Compu "" TAB_VERB "%6.3" "" COMPU_TAB_REF EOMVLVLFTINMTRX_SC_Compu /end COMPU_METHOD
/begin COMPU_VTAB EOMVLVLFTINMTRX_SC_Compu "" TAB_VERB 2 0 "NoValveLiftInMatrix" 1 "ValveLiftInMatrix" /end COMPU_VTAB
/begin COMPU_METHOD EPMCAS_DIAGSRC2_SC_Compu "" RAT_FUNC "%6.2" "" COEFFS 0 1 0 0 0 1 /end COMPU_METHOD
/begin COMPU_METHOD EPMCAS_FACPLAUS_DSTX_SC_Compu "" RAT_FUNC "%6.2" "" COEFFS 0 1 0 0 0 1 /end COMPU_METHOD
/begin COMPU_METHOD EPMCAS_NUMSEGLEN_SC_Compu "" RAT_FUNC "%6.2" "" COEFFS 0 1 0 0 0 1 /end COMPU_METHOD
/begin COMPU_METHOD EPMCAS_NUMSEG_SC_Compu "" RAT_FUNC "%6.2" "" COEFFS 0 1 0 0 0 1 /end COMPU_METHOD
/begin COMPU_METHOD EPMCAS_OFFSAVRGFILSIZE_SC_Compu "" RAT_FUNC "%6.2" "" COEFFS 0 1 0 0 0 1 /end COMPU_METHOD
/begin COMPU_METHOD EPMCAS_OFFSDIAGDTRENA_SC_Compu "" TAB_VERB "%6.3" "" COMPU_TAB_REF EPMCAS_OFFSDIAGDTRENA_SC_Compu /end COMPU_METHOD
/begin COMPU_VTAB EPMCAS_OFFSDIAGDTRENA_SC_Compu "" TAB_VERB 2 0 "False" 1 "True" /end COMPU_VTAB
/begin COMPU_METHOD EPMCAS_PHINCOR_CURX_SC_Compu "" RAT_FUNC "%6.2" "" COEFFS 0 1 0 0 0 1 /end COMPU_METHOD
/begin COMPU_METHOD EPMCAS_PHITEMPADAPCORSIZEDSTX_SC_Compu "" RAT_FUNC "%6.2" "" COEFFS 0 1 0 0 0 1 /end COMPU_METHOD
/begin COMPU_METHOD Fact "" RAT_FUNC "%6.5" "-" COEFFS 0 8192 0 0 0 1 /end COMPU_METHOD
/begin COMPU_METHOD OneToOne "" RAT_FUNC "%6.2" "-" COEFFS 0 1 0 0 0 1 /end COMPU_METHOD
/begin COMPU_METHOD Volt_Batt "" RAT_FUNC "%6.1" "mV" COEFFS 0 0.05 0 0 0 1 /end COMPU_METHOD
/begin RECORD_LAYOUT Kw_Ws16 FNC_VALUES 1 SWORD COLUMN_DIR DIRECT /end RECORD_LAYOUT
/begin RECORD_LAYOUT Val_Wu16 FNC_VALUES 1 UWORD COLUMN_DIR DIRECT /end RECORD_LAYOUT
/end MODULE
/end PROJECT
