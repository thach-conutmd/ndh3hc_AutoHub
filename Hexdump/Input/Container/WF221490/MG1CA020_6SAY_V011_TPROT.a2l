ASAP2_VERSION 1 60
/begin PROJECT MG1CA020 "MG1CA020"
/begin HEADER "" VERSION "MG1CA020_6SAY_V011_TPROT" PROJECT_NO MG1CA020 /end HEADER
/begin MODULE DIM ""
/begin MOD_COMMON "" BYTE_ORDER MSB_LAST ALIGNMENT_BYTE 1 ALIGNMENT_WORD 2 ALIGNMENT_LONG 4 ALIGNMENT_INT64 4 ALIGNMENT_FLOAT32_IEEE 4 ALIGNMENT_FLOAT64_IEEE 4 DATA_SIZE 32 /end MOD_COMMON
/begin MEASUREMENT DFC_b.TSC_PEnvSigRngMin "Bit encoding / Ok-Tested Since Clear bit for check DFC_PEnvSigRngMin" UBYTE DFC_OneToOne 1 100 0.00 1.000 BIT_MASK 0x20 FORMAT "%5.3" ECU_ADDRESS 0x60034AD8 /end MEASUREMENT
/begin MEASUREMENT DFC_b.TSC_StmFault "Bit encoding / Ok-Tested Since Clear bit for check DFC_StmFault" UBYTE DFC_OneToOne 1 100 0.00 1.000 BIT_MASK 0x20 FORMAT "%5.3" ECU_ADDRESS 0x60034AD9 /end MEASUREMENT
/begin MEASUREMENT DFC_b.TSC_StrtCtOffPth "Bit encoding / Ok-Tested Since Clear bit for check DFC_StrtCtOffPth" UBYTE DFC_OneToOne 1 100 0.00 1.000 BIT_MASK 0x20 FORMAT "%5.3" ECU_ADDRESS 0x60034ADA /end MEASUREMENT
/begin MEASUREMENT DFC_b.TSC_StrtCtlErr "Bit encoding / Ok-Tested Since Clear bit for check DFC_StrtCtlErr" UBYTE DFC_OneToOne 1 100 0.00 1.000 BIT_MASK 0x20 FORMAT "%5.3" ECU_ADDRESS 0x60034ADB /end MEASUREMENT
/begin MEASUREMENT DFC_b.TSC_StrtFault "Bit encoding / Ok-Tested Since Clear bit for check DFC_StrtFault" UBYTE DFC_OneToOne 1 100 0.00 1.000 BIT_MASK 0x20 FORMAT "%5.3" ECU_ADDRESS 0x60034ADC /end MEASUREMENT
/begin MEASUREMENT DFC_b.TSC_StrtLckJudg1 "Bit encoding / Ok-Tested Since Clear bit for check DFC_StrtLckJudg1" UBYTE DFC_OneToOne 1 100 0.00 1.000 BIT_MASK 0x20 FORMAT "%5.3" ECU_ADDRESS 0x60034ADD /end MEASUREMENT
/begin MEASUREMENT DFC_b.TSC_StrtLckJudg2 "Bit encoding / Ok-Tested Since Clear bit for check DFC_StrtLckJudg2" UBYTE DFC_OneToOne 1 100 0.00 1.000 BIT_MASK 0x20 FORMAT "%5.3" ECU_ADDRESS 0x60034ADE /end MEASUREMENT
/begin MEASUREMENT DFC_b.TSC_StrtOL "Bit encoding / Ok-Tested Since Clear bit for check DFC_StrtOL" UBYTE DFC_OneToOne 1 100 0.00 1.000 BIT_MASK 0x20 FORMAT "%5.3" ECU_ADDRESS 0x60034ADF /end MEASUREMENT
/begin MEASUREMENT DFC_b.TSC_StrtOL2 "Bit encoding / Ok-Tested Since Clear bit for check DFC_StrtOL2" UBYTE DFC_OneToOne 1 100 0.00 1.000 BIT_MASK 0x20 FORMAT "%5.3" ECU_ADDRESS 0x60034AE0 /end MEASUREMENT
/begin MEASUREMENT DFC_b.TSC_StrtSCB "Bit encoding / Ok-Tested Since Clear bit for check DFC_StrtSCB" UBYTE DFC_OneToOne 1 100 0.00 1.000 BIT_MASK 0x20 FORMAT "%5.3" ECU_ADDRESS 0x60034AE1 /end MEASUREMENT
/begin MEASUREMENT DFC_b.TSC_StrtSCB2 "Bit encoding / Ok-Tested Since Clear bit for check DFC_StrtSCB2" UBYTE DFC_OneToOne 1 100 0.00 1.000 BIT_MASK 0x20 FORMAT "%5.3" ECU_ADDRESS 0x60034AE2 /end MEASUREMENT
/begin MEASUREMENT DFC_b.TSC_StrtSCG "Bit encoding / Ok-Tested Since Clear bit for check DFC_StrtSCG" UBYTE DFC_OneToOne 1 100 0.00 1.000 BIT_MASK 0x20 FORMAT "%5.3" ECU_ADDRESS 0x60034AE3 /end MEASUREMENT
/begin MEASUREMENT DFC_b.TSC_StrtSCG2 "Bit encoding / Ok-Tested Since Clear bit for check DFC_StrtSCG2" UBYTE DFC_OneToOne 1 100 0.00 1.000 BIT_MASK 0x20 FORMAT "%5.3" ECU_ADDRESS 0x60034AE4 /end MEASUREMENT
/begin MEASUREMENT DFC_b.TSC_StrtStkRly1 "Bit encoding / Ok-Tested Since Clear bit for check DFC_StrtStkRly1" UBYTE DFC_OneToOne 1 100 0.00 1.000 BIT_MASK 0x20 FORMAT "%5.3" ECU_ADDRESS 0x60034AE5 /end MEASUREMENT
/begin MEASUREMENT DFC_b.TSC_StrtStkRly2 "Bit encoding / Ok-Tested Since Clear bit for check DFC_StrtStkRly2" UBYTE DFC_OneToOne 1 100 0.00 1.000 BIT_MASK 0x20 FORMAT "%5.3" ECU_ADDRESS 0x60034AE6 /end MEASUREMENT
/begin MEASUREMENT DFC_b.TSC_TEVEmax "Bit encoding / Ok-Tested Since Clear bit for check DFC_TEVEmax" UBYTE DFC_OneToOne 1 100 0.00 1.000 BIT_MASK 0x20 FORMAT "%5.3" ECU_ADDRESS 0x60034AE7 /end MEASUREMENT
/begin MEASUREMENT DFC_b.TSC_TEVEmin "Bit encoding / Ok-Tested Since Clear bit for check DFC_TEVEmin" UBYTE DFC_OneToOne 1 100 0.00 1.000 BIT_MASK 0x20 FORMAT "%5.3" ECU_ADDRESS 0x60034AE8 /end MEASUREMENT
/begin MEASUREMENT DFC_b.TSC_TEVEsig "Bit encoding / Ok-Tested Since Clear bit for check DFC_TEVEsig" UBYTE DFC_OneToOne 1 100 0.00 1.000 BIT_MASK 0x20 FORMAT "%5.3" ECU_ADDRESS 0x60034AE9 /end MEASUREMENT
/begin MEASUREMENT DFC_b.TSC_VehVAllPlaus "Bit encoding / Ok-Tested Since Clear bit for check DFC_VehVAllPlaus" UBYTE DFC_OneToOne 1 100 0.00 1.000 BIT_MASK 0x20 FORMAT "%5.3" ECU_ADDRESS 0x60034AEA /end MEASUREMENT
/begin MEASUREMENT DFC_b.TSC_VehVNCSnsrElecFailr "Bit encoding / Ok-Tested Since Clear bit for check DFC_VehVNCSnsrElecFailr" UBYTE DFC_OneToOne 1 100 0.00 1.000 BIT_MASK 0x20 FORMAT "%5.3" ECU_ADDRESS 0x60034AEB /end MEASUREMENT
/begin MEASUREMENT DFC_b.TSC_VehVPlausCan "Bit encoding / Ok-Tested Since Clear bit for check DFC_VehVPlausCan" UBYTE DFC_OneToOne 1 100 0.00 1.000 BIT_MASK 0x20 FORMAT "%5.3" ECU_ADDRESS 0x60034AEC /end MEASUREMENT
/begin MEASUREMENT DFC_b.TSC_VehVPlausFco "Bit encoding / Ok-Tested Since Clear bit for check DFC_VehVPlausFco" UBYTE DFC_OneToOne 1 100 0.00 1.000 BIT_MASK 0x20 FORMAT "%5.3" ECU_ADDRESS 0x60034AED /end MEASUREMENT
/begin MEASUREMENT DFC_b.TSC_VehVPlausPwr "Bit encoding / Ok-Tested Since Clear bit for check DFC_VehVPlausPwr" UBYTE DFC_OneToOne 1 100 0.00 1.000 BIT_MASK 0x20 FORMAT "%5.3" ECU_ADDRESS 0x60034AEE /end MEASUREMENT
/begin MEASUREMENT DFC_b.TSC_VehVPlausV2N "Bit encoding / Ok-Tested Since Clear bit for check DFC_VehVPlausV2N" UBYTE DFC_OneToOne 1 100 0.00 1.000 BIT_MASK 0x20 FORMAT "%5.3" ECU_ADDRESS 0x60034AEF /end MEASUREMENT
/begin MEASUREMENT DFC_b.TSC_VehVSpdSnsrAElecFailr "Bit encoding / Ok-Tested Since Clear bit for check DFC_VehVSpdSnsrAElecFailr" UBYTE DFC_OneToOne 1 100 0.00 1.000 BIT_MASK 0x20 FORMAT "%5.3" ECU_ADDRESS 0x60034AF0 /end MEASUREMENT
/begin MEASUREMENT DFC_b.TSC_VehVSpdSnsrBElecFailr "Bit encoding / Ok-Tested Since Clear bit for check DFC_VehVSpdSnsrBElecFailr" UBYTE DFC_OneToOne 1 100 0.00 1.000 BIT_MASK 0x20 FORMAT "%5.3" ECU_ADDRESS 0x60034AF1 /end MEASUREMENT
/begin MEASUREMENT DFC_b.TSC_ClthMax "Bit encoding / Ok-Tested Since Clear bit for check DFC_ClthMax" UBYTE DFC_OneToOne 1 100 0.00 1.000 BIT_MASK 0x20 FORMAT "%5.3" ECU_ADDRESS 0x60034AF2 /end MEASUREMENT
/begin MEASUREMENT DFC_b.TSC_IgnClPs_DevComErr "Bit encoding / Ok-Tested Since Clear bit for check DFC_IgnClPs_DevComErr" UBYTE DFC_OneToOne 1 100 0.00 1.000 BIT_MASK 0x20 FORMAT "%5.3" ECU_ADDRESS 0x60034AF3 /end MEASUREMENT
/begin MEASUREMENT DFC_b.TSC_IgnClPs_LineOl_0 "Bit encoding / Ok-Tested Since Clear bit for check DFC_IgnClPs_LineOl_0" UBYTE DFC_OneToOne 1 100 0.00 1.000 BIT_MASK 0x20 FORMAT "%5.3" ECU_ADDRESS 0x60034AF4 /end MEASUREMENT
/begin MEASUREMENT DFC_b.TSC_IgnClPs_LineOl_1 "Bit encoding / Ok-Tested Since Clear bit for check DFC_IgnClPs_LineOl_1" UBYTE DFC_OneToOne 1 100 0.00 1.000 BIT_MASK 0x20 FORMAT "%5.3" ECU_ADDRESS 0x60034AF5 /end MEASUREMENT
/begin MEASUREMENT DFC_b.TSC_IgnClPs_LineOl_2 "Bit encoding / Ok-Tested Since Clear bit for check DFC_IgnClPs_LineOl_2" UBYTE DFC_OneToOne 1 100 0.00 1.000 BIT_MASK 0x20 FORMAT "%5.3" ECU_ADDRESS 0x60034AF6 /end MEASUREMENT
/begin MEASUREMENT DFC_b.TSC_IgnClPs_LineOl_3 "Bit encoding / Ok-Tested Since Clear bit for check DFC_IgnClPs_LineOl_3" UBYTE DFC_OneToOne 1 100 0.00 1.000 BIT_MASK 0x20 FORMAT "%5.3" ECU_ADDRESS 0x60034AF7 /end MEASUREMENT
/begin MEASUREMENT DFC_b.TSC_IgnClPs_LineScb_0 "Bit encoding / Ok-Tested Since Clear bit for check DFC_IgnClPs_LineScb_0" UBYTE DFC_OneToOne 1 100 0.00 1.000 BIT_MASK 0x20 FORMAT "%5.3" ECU_ADDRESS 0x60034AF8 /end MEASUREMENT
/begin MEASUREMENT DFC_b.TSC_IgnClPs_LineScb_1 "Bit encoding / Ok-Tested Since Clear bit for check DFC_IgnClPs_LineScb_1" UBYTE DFC_OneToOne 1 100 0.00 1.000 BIT_MASK 0x20 FORMAT "%5.3" ECU_ADDRESS 0x60034AF9 /end MEASUREMENT
/begin MEASUREMENT DFC_b.TSC_IgnClPs_LineScb_2 "Bit encoding / Ok-Tested Since Clear bit for check DFC_IgnClPs_LineScb_2" UBYTE DFC_OneToOne 1 100 0.00 1.000 BIT_MASK 0x20 FORMAT "%5.3" ECU_ADDRESS 0x60034AFA /end MEASUREMENT
/begin MEASUREMENT DFC_b.TSC_IgnClPs_LineScb_3 "Bit encoding / Ok-Tested Since Clear bit for check DFC_IgnClPs_LineScb_3" UBYTE DFC_OneToOne 1 100 0.00 1.000 BIT_MASK 0x20 FORMAT "%5.3" ECU_ADDRESS 0x60034AFB /end MEASUREMENT
/begin MEASUREMENT DFC_b.TSC_IgnClPs_LineScg_0 "Bit encoding / Ok-Tested Since Clear bit for check DFC_IgnClPs_LineScg_0" UBYTE DFC_OneToOne 1 100 0.00 1.000 BIT_MASK 0x20 FORMAT "%5.3" ECU_ADDRESS 0x60034AFC /end MEASUREMENT
/begin MEASUREMENT DFC_b.TSC_IgnClPs_LineScg_1 "Bit encoding / Ok-Tested Since Clear bit for check DFC_IgnClPs_LineScg_1" UBYTE DFC_OneToOne 1 100 0.00 1.000 BIT_MASK 0x20 FORMAT "%5.3" ECU_ADDRESS 0x60034AFD /end MEASUREMENT
/begin MEASUREMENT DFC_b.TSC_IgnClPs_LineScg_2 "Bit encoding / Ok-Tested Since Clear bit for check DFC_IgnClPs_LineScg_2" UBYTE DFC_OneToOne 1 100 0.00 1.000 BIT_MASK 0x20 FORMAT "%5.3" ECU_ADDRESS 0x60034AFE /end MEASUREMENT
/begin MEASUREMENT DFC_b.TSC_IgnClPs_LineScg_3 "Bit encoding / Ok-Tested Since Clear bit for check DFC_IgnClPs_LineScg_3" UBYTE DFC_OneToOne 1 100 0.00 1.000 BIT_MASK 0x20 FORMAT "%5.3" ECU_ADDRESS 0x60034AFF /end MEASUREMENT
/begin MEASUREMENT DFC_b.TSC_UEGOASICS1B1 "Bit encoding / Ok-Tested Since Clear bit for check DFC_UEGOASICS1B1" UBYTE DFC_OneToOne 1 100 0.00 1.000 BIT_MASK 0x20 FORMAT "%5.3" ECU_ADDRESS 0x60034B00 /end MEASUREMENT
/begin MEASUREMENT DFC_b.TSC_UEGOOLIPES1B1 "Bit encoding / Ok-Tested Since Clear bit for check DFC_UEGOOLIPES1B1" UBYTE DFC_OneToOne 1 100 0.00 1.000 BIT_MASK 0x20 FORMAT "%5.3" ECU_ADDRESS 0x60034B01 /end MEASUREMENT
/begin MEASUREMENT DFC_b.TSC_UEGOOLRES1B1 "Bit encoding / Ok-Tested Since Clear bit for check DFC_UEGOOLRES1B1" UBYTE DFC_OneToOne 1 100 0.00 1.000 BIT_MASK 0x20 FORMAT "%5.3" ECU_ADDRESS 0x60034B02 /end MEASUREMENT
/begin MEASUREMENT DFC_b.TSC_UEGOSCBS1B1 "Bit encoding / Ok-Tested Since Clear bit for check DFC_UEGOSCBS1B1" UBYTE DFC_OneToOne 1 100 0.00 1.000 BIT_MASK 0x20 FORMAT "%5.3" ECU_ADDRESS 0x60034B03 /end MEASUREMENT
/begin MEASUREMENT DFC_b.TSC_UEGOSCGS1B1 "Bit encoding / Ok-Tested Since Clear bit for check DFC_UEGOSCGS1B1" UBYTE DFC_OneToOne 1 100 0.00 1.000 BIT_MASK 0x20 FORMAT "%5.3" ECU_ADDRESS 0x60034B04 /end MEASUREMENT
/begin MEASUREMENT DFC_b.TSC_UEGOSPIS1B1 "Bit encoding / Ok-Tested Since Clear bit for check DFC_UEGOSPIS1B1" UBYTE DFC_OneToOne 1 100 0.00 1.000 BIT_MASK 0x20 FORMAT "%5.3" ECU_ADDRESS 0x60034B05 /end MEASUREMENT
/begin MEASUREMENT DFC_b.TSC_UEGOSnsrS1B1 "Bit encoding / Ok-Tested Since Clear bit for check DFC_UEGOSnsrS1B1" UBYTE DFC_OneToOne 1 100 0.00 1.000 BIT_MASK 0x20 FORMAT "%5.3" ECU_ADDRESS 0x60034B06 /end MEASUREMENT
/begin MEASUREMENT DFC_b.TSC_UegoOlApesS1B1 "Bit encoding / Ok-Tested Since Clear bit for check DFC_UegoOlApesS1B1" UBYTE DFC_OneToOne 1 100 0.00 1.000 BIT_MASK 0x20 FORMAT "%5.3" ECU_ADDRESS 0x60034B07 /end MEASUREMENT
/begin MEASUREMENT DFC_b.TSC_UegoOlRCmpS1B1 "Bit encoding / Ok-Tested Since Clear bit for check DFC_UegoOlRCmpS1B1" UBYTE DFC_OneToOne 1 100 0.00 1.000 BIT_MASK 0x20 FORMAT "%5.3" ECU_ADDRESS 0x60034B08 /end MEASUREMENT
/begin MEASUREMENT DFC_b.TSC_AirCCmprOL "Bit encoding / Ok-Tested Since Clear bit for check DFC_AirCCmprOL" UBYTE DFC_OneToOne 1 100 0.00 1.000 BIT_MASK 0x20 FORMAT "%5.3" ECU_ADDRESS 0x60034B09 /end MEASUREMENT
/begin MEASUREMENT DFC_b.TSC_AirCCmprOvrTemp "Bit encoding / Ok-Tested Since Clear bit for check DFC_AirCCmprOvrTemp" UBYTE DFC_OneToOne 1 100 0.00 1.000 BIT_MASK 0x20 FORMAT "%5.3" ECU_ADDRESS 0x60034B0A /end MEASUREMENT
/begin MEASUREMENT DFC_b.TSC_AirCCmprSCB "Bit encoding / Ok-Tested Since Clear bit for check DFC_AirCCmprSCB" UBYTE DFC_OneToOne 1 100 0.00 1.000 BIT_MASK 0x20 FORMAT "%5.3" ECU_ADDRESS 0x60034B0B /end MEASUREMENT
/begin MEASUREMENT DFC_b.TSC_AirCCmprSCG "Bit encoding / Ok-Tested Since Clear bit for check DFC_AirCCmprSCG" UBYTE DFC_OneToOne 1 100 0.00 1.000 BIT_MASK 0x20 FORMAT "%5.3" ECU_ADDRESS 0x60034B0C /end MEASUREMENT
/begin MEASUREMENT DFC_b.TSC_AltErr "Bit encoding / Ok-Tested Since Clear bit for check DFC_AltErr" UBYTE DFC_OneToOne 1 100 0.00 1.000 BIT_MASK 0x20 FORMAT "%5.3" ECU_ADDRESS 0x60034B0D /end MEASUREMENT
/begin MEASUREMENT DFC_b.TSC_BattUSRCMax "Bit encoding / Ok-Tested Since Clear bit for check DFC_BattUSRCMax" UBYTE DFC_OneToOne 1 100 0.00 1.000 BIT_MASK 0x20 FORMAT "%5.3" ECU_ADDRESS 0x60034B0E /end MEASUREMENT
/begin MEASUREMENT DFC_b.TSC_BattUSRCMin "Bit encoding / Ok-Tested Since Clear bit for check DFC_BattUSRCMin" UBYTE DFC_OneToOne 1 100 0.00 1.000 BIT_MASK 0x20 FORMAT "%5.3" ECU_ADDRESS 0x60034B0F /end MEASUREMENT
/begin MEASUREMENT DFC_b.TSC_ComChksTCU1 "Bit encoding / Ok-Tested Since Clear bit for check DFC_ComChksTCU1" UBYTE DFC_OneToOne 1 100 0.00 1.000 BIT_MASK 0x20 FORMAT "%5.3" ECU_ADDRESS 0x60034B10 /end MEASUREMENT
/begin MEASUREMENT DFC_b.TSC_ComChksTCU11 "Bit encoding / Ok-Tested Since Clear bit for check DFC_ComChksTCU11" UBYTE DFC_OneToOne 1 100 0.00 1.000 BIT_MASK 0x20 FORMAT "%5.3" ECU_ADDRESS 0x60034B11 /end MEASUREMENT
/begin MEASUREMENT DFC_b.TSC_ComChksTCU12 "Bit encoding / Ok-Tested Since Clear bit for check DFC_ComChksTCU12" UBYTE DFC_OneToOne 1 100 0.00 1.000 BIT_MASK 0x20 FORMAT "%5.3" ECU_ADDRESS 0x60034B12 /end MEASUREMENT
/begin MEASUREMENT DFC_b.TSC_ComChksTCU13 "Bit encoding / Ok-Tested Since Clear bit for check DFC_ComChksTCU13" UBYTE DFC_OneToOne 1 100 0.00 1.000 BIT_MASK 0x20 FORMAT "%5.3" ECU_ADDRESS 0x60034B13 /end MEASUREMENT
/begin MEASUREMENT DFC_b.TSC_ComChksTCU2 "Bit encoding / Ok-Tested Since Clear bit for check DFC_ComChksTCU2" UBYTE DFC_OneToOne 1 100 0.00 1.000 BIT_MASK 0x20 FORMAT "%5.3" ECU_ADDRESS 0x60034B14 /end MEASUREMENT
/begin MEASUREMENT DFC_b.TSC_ComChksTCU3 "Bit encoding / Ok-Tested Since Clear bit for check DFC_ComChksTCU3" UBYTE DFC_OneToOne 1 100 0.00 1.000 BIT_MASK 0x20 FORMAT "%5.3" ECU_ADDRESS 0x60034B15 /end MEASUREMENT
/begin MEASUREMENT DFC_b.TSC_ComChksTCU4 "Bit encoding / Ok-Tested Since Clear bit for check DFC_ComChksTCU4" UBYTE DFC_OneToOne 1 100 0.00 1.000 BIT_MASK 0x20 FORMAT "%5.3" ECU_ADDRESS 0x60034B16 /end MEASUREMENT
/begin MEASUREMENT DFC_b.TSC_ComCntTCU1 "Bit encoding / Ok-Tested Since Clear bit for check DFC_ComCntTCU1" UBYTE DFC_OneToOne 1 100 0.00 1.000 BIT_MASK 0x20 FORMAT "%5.3" ECU_ADDRESS 0x60034B17 /end MEASUREMENT
/begin MEASUREMENT DFC_b.TSC_ComCntTCU11 "Bit encoding / Ok-Tested Since Clear bit for check DFC_ComCntTCU11" UBYTE DFC_OneToOne 1 100 0.00 1.000 BIT_MASK 0x20 FORMAT "%5.3" ECU_ADDRESS 0x60034B18 /end MEASUREMENT
/begin MEASUREMENT DFC_b.TSC_ComCntTCU12 "Bit encoding / Ok-Tested Since Clear bit for check DFC_ComCntTCU12" UBYTE DFC_OneToOne 1 100 0.00 1.000 BIT_MASK 0x20 FORMAT "%5.3" ECU_ADDRESS 0x60034B19 /end MEASUREMENT
/begin MEASUREMENT DFC_b.TSC_ComCntTCU13 "Bit encoding / Ok-Tested Since Clear bit for check DFC_ComCntTCU13" UBYTE DFC_OneToOne 1 100 0.00 1.000 BIT_MASK 0x20 FORMAT "%5.3" ECU_ADDRESS 0x60034B1A /end MEASUREMENT
/begin MEASUREMENT DFC_b.TSC_ComCntTCU2 "Bit encoding / Ok-Tested Since Clear bit for check DFC_ComCntTCU2" UBYTE DFC_OneToOne 1 100 0.00 1.000 BIT_MASK 0x20 FORMAT "%5.3" ECU_ADDRESS 0x60034B1B /end MEASUREMENT
/begin MEASUREMENT DFC_b.TSC_ComCntTCU3 "Bit encoding / Ok-Tested Since Clear bit for check DFC_ComCntTCU3" UBYTE DFC_OneToOne 1 100 0.00 1.000 BIT_MASK 0x20 FORMAT "%5.3" ECU_ADDRESS 0x60034B1C /end MEASUREMENT
/begin MEASUREMENT DFC_b.TSC_ComCntTCU4 "Bit encoding / Ok-Tested Since Clear bit for check DFC_ComCntTCU4" UBYTE DFC_OneToOne 1 100 0.00 1.000 BIT_MASK 0x20 FORMAT "%5.3" ECU_ADDRESS 0x60034B1D /end MEASUREMENT
/begin MEASUREMENT DFC_b.TSC_ComTOutTCU01 "Bit encoding / Ok-Tested Since Clear bit for check DFC_ComTOutTCU01" UBYTE DFC_OneToOne 1 100 0.00 1.000 BIT_MASK 0x20 FORMAT "%5.3" ECU_ADDRESS 0x60034B1E /end MEASUREMENT
/begin MEASUREMENT DFC_b.TSC_ComTOutTCU02 "Bit encoding / Ok-Tested Since Clear bit for check DFC_ComTOutTCU02" UBYTE DFC_OneToOne 1 100 0.00 1.000 BIT_MASK 0x20 FORMAT "%5.3" ECU_ADDRESS 0x60034B1F /end MEASUREMENT
/begin MEASUREMENT DFC_b.TSC_ComTOutTCU1 "Bit encoding / Ok-Tested Since Clear bit for check DFC_ComTOutTCU1" UBYTE DFC_OneToOne 1 100 0.00 1.000 BIT_MASK 0x20 FORMAT "%5.3" ECU_ADDRESS 0x60034B20 /end MEASUREMENT
/begin MEASUREMENT DFC_b.TSC_ComTOutTCU11 "Bit encoding / Ok-Tested Since Clear bit for check DFC_ComTOutTCU11" UBYTE DFC_OneToOne 1 100 0.00 1.000 BIT_MASK 0x20 FORMAT "%5.3" ECU_ADDRESS 0x60034B21 /end MEASUREMENT
/begin MEASUREMENT DFC_b.TSC_ComTOutTCU12 "Bit encoding / Ok-Tested Since Clear bit for check DFC_ComTOutTCU12" UBYTE DFC_OneToOne 1 100 0.00 1.000 BIT_MASK 0x20 FORMAT "%5.3" ECU_ADDRESS 0x60034B22 /end MEASUREMENT
/begin MEASUREMENT DFC_b.TSC_ComTOutTCU13 "Bit encoding / Ok-Tested Since Clear bit for check DFC_ComTOutTCU13" UBYTE DFC_OneToOne 1 100 0.00 1.000 BIT_MASK 0x20 FORMAT "%5.3" ECU_ADDRESS 0x60034B23 /end MEASUREMENT
/begin MEASUREMENT DFC_b.TSC_ComTOutTCU14 "Bit encoding / Ok-Tested Since Clear bit for check DFC_ComTOutTCU14" UBYTE DFC_OneToOne 1 100 0.00 1.000 BIT_MASK 0x20 FORMAT "%5.3" ECU_ADDRESS 0x60034B24 /end MEASUREMENT
/begin MEASUREMENT DFC_b.TSC_ComTOutTCU2 "Bit encoding / Ok-Tested Since Clear bit for check DFC_ComTOutTCU2" UBYTE DFC_OneToOne 1 100 0.00 1.000 BIT_MASK 0x20 FORMAT "%5.3" ECU_ADDRESS 0x60034B25 /end MEASUREMENT
/begin MEASUREMENT DFC_b.TSC_ComTOutTCU3 "Bit encoding / Ok-Tested Since Clear bit for check DFC_ComTOutTCU3" UBYTE DFC_OneToOne 1 100 0.00 1.000 BIT_MASK 0x20 FORMAT "%5.3" ECU_ADDRESS 0x60034B26 /end MEASUREMENT
/begin MEASUREMENT DFC_b.TSC_ComTOutTCU4 "Bit encoding / Ok-Tested Since Clear bit for check DFC_ComTOutTCU4" UBYTE DFC_OneToOne 1 100 0.00 1.000 BIT_MASK 0x20 FORMAT "%5.3" ECU_ADDRESS 0x60034B27 /end MEASUREMENT
/begin MEASUREMENT DFC_b.TSC_DevLibBattUHi "Bit encoding / Ok-Tested Since Clear bit for check DFC_DevLibBattUHi" UBYTE DFC_OneToOne 1 100 0.00 1.000 BIT_MASK 0x20 FORMAT "%5.3" ECU_ADDRESS 0x60034B28 /end MEASUREMENT
/begin MEASUREMENT DFC_b.TSC_DevLibBattULo "Bit encoding / Ok-Tested Since Clear bit for check DFC_DevLibBattULo" UBYTE DFC_OneToOne 1 100 0.00 1.000 BIT_MASK 0x20 FORMAT "%5.3" ECU_ADDRESS 0x60034B29 /end MEASUREMENT
/begin MEASUREMENT DFC_b.TSC_FanDIOOL_0 "Bit encoding / Ok-Tested Since Clear bit for check DFC_FanDIOOL_0" UBYTE DFC_OneToOne 1 100 0.00 1.000 BIT_MASK 0x20 FORMAT "%5.3" ECU_ADDRESS 0x60034B2A /end MEASUREMENT
/begin MEASUREMENT DFC_b.TSC_FanDIOOL_1 "Bit encoding / Ok-Tested Since Clear bit for check DFC_FanDIOOL_1" UBYTE DFC_OneToOne 1 100 0.00 1.000 BIT_MASK 0x20 FORMAT "%5.3" ECU_ADDRESS 0x60034B2B /end MEASUREMENT
/begin MEASUREMENT DFC_b.TSC_FanDIOOvrTemp_0 "Bit encoding / Ok-Tested Since Clear bit for check DFC_FanDIOOvrTemp_0" UBYTE DFC_OneToOne 1 100 0.00 1.000 BIT_MASK 0x20 FORMAT "%5.3" ECU_ADDRESS 0x60034B2C /end MEASUREMENT
/begin MEASUREMENT DFC_b.TSC_FanDIOOvrTemp_1 "Bit encoding / Ok-Tested Since Clear bit for check DFC_FanDIOOvrTemp_1" UBYTE DFC_OneToOne 1 100 0.00 1.000 BIT_MASK 0x20 FORMAT "%5.3" ECU_ADDRESS 0x60034B2D /end MEASUREMENT
/begin MEASUREMENT DFC_b.TSC_FanDIOSCB_0 "Bit encoding / Ok-Tested Since Clear bit for check DFC_FanDIOSCB_0" UBYTE DFC_OneToOne 1 100 0.00 1.000 BIT_MASK 0x20 FORMAT "%5.3" ECU_ADDRESS 0x60034B2E /end MEASUREMENT
/begin MEASUREMENT DFC_b.TSC_FanDIOSCB_1 "Bit encoding / Ok-Tested Since Clear bit for check DFC_FanDIOSCB_1" UBYTE DFC_OneToOne 1 100 0.00 1.000 BIT_MASK 0x20 FORMAT "%5.3" ECU_ADDRESS 0x60034B2F /end MEASUREMENT
/begin MEASUREMENT DFC_b.TSC_FanDIOSCG_0 "Bit encoding / Ok-Tested Since Clear bit for check DFC_FanDIOSCG_0" UBYTE DFC_OneToOne 1 100 0.00 1.000 BIT_MASK 0x20 FORMAT "%5.3" ECU_ADDRESS 0x60034B30 /end MEASUREMENT
/begin MEASUREMENT DFC_b.TSC_FanDIOSCG_1 "Bit encoding / Ok-Tested Since Clear bit for check DFC_FanDIOSCG_1" UBYTE DFC_OneToOne 1 100 0.00 1.000 BIT_MASK 0x20 FORMAT "%5.3" ECU_ADDRESS 0x60034B31 /end MEASUREMENT
/begin MEASUREMENT DFC_b.TSC_MRlyDcOL "Bit encoding / Ok-Tested Since Clear bit for check DFC_MRlyDcOL" UBYTE DFC_OneToOne 1 100 0.00 1.000 BIT_MASK 0x20 FORMAT "%5.3" ECU_ADDRESS 0x60034B32 /end MEASUREMENT
/begin MEASUREMENT DFC_b.TSC_MRlyDcSCB "Bit encoding / Ok-Tested Since Clear bit for check DFC_MRlyDcSCB" UBYTE DFC_OneToOne 1 100 0.00 1.000 BIT_MASK 0x20 FORMAT "%5.3" ECU_ADDRESS 0x60034B33 /end MEASUREMENT
/begin MEASUREMENT DFC_b.TSC_MRlyDcSCG "Bit encoding / Ok-Tested Since Clear bit for check DFC_MRlyDcSCG" UBYTE DFC_OneToOne 1 100 0.00 1.000 BIT_MASK 0x20 FORMAT "%5.3" ECU_ADDRESS 0x60034B34 /end MEASUREMENT
/begin MEASUREMENT DFC_b.TSC_PSPOL "Bit encoding / Ok-Tested Since Clear bit for check DFC_PSPOL" UBYTE DFC_OneToOne 1 100 0.00 1.000 BIT_MASK 0x20 FORMAT "%5.3" ECU_ADDRESS 0x60034B35 /end MEASUREMENT
/begin MEASUREMENT DFC_b.TSC_PSPOvrTemp "Bit encoding / Ok-Tested Since Clear bit for check DFC_PSPOvrTemp" UBYTE DFC_OneToOne 1 100 0.00 1.000 BIT_MASK 0x20 FORMAT "%5.3" ECU_ADDRESS 0x60034B36 /end MEASUREMENT
/begin MEASUREMENT DFC_b.TSC_PSPSCB "Bit encoding / Ok-Tested Since Clear bit for check DFC_PSPSCB" UBYTE DFC_OneToOne 1 100 0.00 1.000 BIT_MASK 0x20 FORMAT "%5.3" ECU_ADDRESS 0x60034B37 /end MEASUREMENT
/begin MEASUREMENT DFC_b.TSC_PSPSCG "Bit encoding / Ok-Tested Since Clear bit for check DFC_PSPSCG" UBYTE DFC_OneToOne 1 100 0.00 1.000 BIT_MASK 0x20 FORMAT "%5.3" ECU_ADDRESS 0x60034B38 /end MEASUREMENT
/begin MEASUREMENT DFC_b.TSC_T50Err "Bit encoding / Ok-Tested Since Clear bit for check DFC_T50Err" UBYTE DFC_OneToOne 1 100 0.00 1.000 BIT_MASK 0x20 FORMAT "%5.3" ECU_ADDRESS 0x60034B39 /end MEASUREMENT
/begin MEASUREMENT DFC_b.TSC_ThrVlvLoBattB1 "Bit encoding / Ok-Tested Since Clear bit for check DFC_ThrVlvLoBattB1" UBYTE DFC_OneToOne 1 100 0.00 1.000 BIT_MASK 0x20 FORMAT "%5.3" ECU_ADDRESS 0x60034B3A /end MEASUREMENT
/begin MEASUREMENT DFC_b.TSC_VehVPhysRngHi "Bit encoding / Ok-Tested Since Clear bit for check DFC_VehVPhysRngHi" UBYTE DFC_OneToOne 1 100 0.00 1.000 BIT_MASK 0x20 FORMAT "%5.3" ECU_ADDRESS 0x60034B3B /end MEASUREMENT
/begin MEASUREMENT DFC_b.TSC_VehVSclOutOL "Bit encoding / Ok-Tested Since Clear bit for check DFC_VehVSclOutOL" UBYTE DFC_OneToOne 1 100 0.00 1.000 BIT_MASK 0x20 FORMAT "%5.3" ECU_ADDRESS 0x60034B3C /end MEASUREMENT
/begin MEASUREMENT DFC_b.TSC_VehVSclOutOT "Bit encoding / Ok-Tested Since Clear bit for check DFC_VehVSclOutOT" UBYTE DFC_OneToOne 1 100 0.00 1.000 BIT_MASK 0x20 FORMAT "%5.3" ECU_ADDRESS 0x60034B3D /end MEASUREMENT
/begin MEASUREMENT DFC_b.TSC_VehVSclOutSCB "Bit encoding / Ok-Tested Since Clear bit for check DFC_VehVSclOutSCB" UBYTE DFC_OneToOne 1 100 0.00 1.000 BIT_MASK 0x20 FORMAT "%5.3" ECU_ADDRESS 0x60034B3E /end MEASUREMENT
/begin MEASUREMENT DFC_b.TSC_VehVSclOutSCG "Bit encoding / Ok-Tested Since Clear bit for check DFC_VehVSclOutSCG" UBYTE DFC_OneToOne 1 100 0.00 1.000 BIT_MASK 0x20 FORMAT "%5.3" ECU_ADDRESS 0x60034B3F /end MEASUREMENT
/begin MEASUREMENT DFC_b.TSC_VehVSnsrARngHi "Bit encoding / Ok-Tested Since Clear bit for check DFC_VehVSnsrARngHi" UBYTE DFC_OneToOne 1 100 0.00 1.000 BIT_MASK 0x20 FORMAT "%5.3" ECU_ADDRESS 0x60034B40 /end MEASUREMENT
/begin MEASUREMENT DFC_b.TSC_VehVSnsrBRngHi "Bit encoding / Ok-Tested Since Clear bit for check DFC_VehVSnsrBRngHi" UBYTE DFC_OneToOne 1 100 0.00 1.000 BIT_MASK 0x20 FORMAT "%5.3" ECU_ADDRESS 0x60034B41 /end MEASUREMENT
/begin MEASUREMENT DFC_b.TSC_VehVSpdRtyDiag "Bit encoding / Ok-Tested Since Clear bit for check DFC_VehVSpdRtyDiag" UBYTE DFC_OneToOne 1 100 0.00 1.000 BIT_MASK 0x20 FORMAT "%5.3" ECU_ADDRESS 0x60034B42 /end MEASUREMENT
/begin MEASUREMENT DFC_b.TSC_VehVWhlErr "Bit encoding / Ok-Tested Since Clear bit for check DFC_VehVWhlErr" UBYTE DFC_OneToOne 1 100 0.00 1.000 BIT_MASK 0x20 FORMAT "%5.3" ECU_ADDRESS 0x60034B43 /end MEASUREMENT
/begin MEASUREMENT DFC_b.TSC_ACEvpTSRCMax "Bit encoding / Ok-Tested Since Clear bit for check DFC_ACEvpTSRCMax" UBYTE DFC_OneToOne 1 100 0.00 1.000 BIT_MASK 0x20 FORMAT "%5.3" ECU_ADDRESS 0x60034B44 /end MEASUREMENT
/begin MEASUREMENT DFC_b.TSC_ACEvpTSRCMin "Bit encoding / Ok-Tested Since Clear bit for check DFC_ACEvpTSRCMin" UBYTE DFC_OneToOne 1 100 0.00 1.000 BIT_MASK 0x20 FORMAT "%5.3" ECU_ADDRESS 0x60034B45 /end MEASUREMENT
/begin MEASUREMENT DFC_b.TSC_AirCClntPAnaSRCMax "Bit encoding / Ok-Tested Since Clear bit for check DFC_AirCClntPAnaSRCMax" UBYTE DFC_OneToOne 1 100 0.00 1.000 BIT_MASK 0x20 FORMAT "%5.3" ECU_ADDRESS 0x60034B46 /end MEASUREMENT
/begin MEASUREMENT DFC_b.TSC_AirCClntPAnaSRCMin "Bit encoding / Ok-Tested Since Clear bit for check DFC_AirCClntPAnaSRCMin" UBYTE DFC_OneToOne 1 100 0.00 1.000 BIT_MASK 0x20 FORMAT "%5.3" ECU_ADDRESS 0x60034B47 /end MEASUREMENT
/begin MEASUREMENT DFC_b.TSC_AirCSwtNpl "Bit encoding / Ok-Tested Since Clear bit for check DFC_AirCSwtNpl" UBYTE DFC_OneToOne 1 100 0.00 1.000 BIT_MASK 0x20 FORMAT "%5.3" ECU_ADDRESS 0x60034B48 /end MEASUREMENT
/begin MEASUREMENT DFC_b.TSC_AirCSwtSig "Bit encoding / Ok-Tested Since Clear bit for check DFC_AirCSwtSig" UBYTE DFC_OneToOne 1 100 0.00 1.000 BIT_MASK 0x20 FORMAT "%5.3" ECU_ADDRESS 0x60034B49 /end MEASUREMENT
/begin MEASUREMENT DFC_b.TSC_Brk "Bit encoding / Ok-Tested Since Clear bit for check DFC_Brk" UBYTE DFC_OneToOne 1 100 0.00 1.000 BIT_MASK 0x20 FORMAT "%5.3" ECU_ADDRESS 0x60034B4A /end MEASUREMENT
/begin MEASUREMENT DFC_b.TSC_BrkSig "Bit encoding / Ok-Tested Since Clear bit for check DFC_BrkSig" UBYTE DFC_OneToOne 1 100 0.00 1.000 BIT_MASK 0x20 FORMAT "%5.3" ECU_ADDRESS 0x60034B4B /end MEASUREMENT
/begin MEASUREMENT DFC_b.TSC_ClthSig "Bit encoding / Ok-Tested Since Clear bit for check DFC_ClthSig" UBYTE DFC_OneToOne 1 100 0.00 1.000 BIT_MASK 0x20 FORMAT "%5.3" ECU_ADDRESS 0x60034B4C /end MEASUREMENT
/begin MEASUREMENT DFC_b.TSC_HLSDemOvhtEngLim "Bit encoding / Ok-Tested Since Clear bit for check DFC_HLSDemOvhtEngLim" UBYTE DFC_OneToOne 1 100 0.00 1.000 BIT_MASK 0x20 FORMAT "%5.3" ECU_ADDRESS 0x60034B4D /end MEASUREMENT
/begin MEASUREMENT DFC_b.TSC_OilPNpl "Bit encoding / Ok-Tested Since Clear bit for check DFC_OilPNpl" UBYTE DFC_OneToOne 1 100 0.00 1.000 BIT_MASK 0x20 FORMAT "%5.3" ECU_ADDRESS 0x60034B4E /end MEASUREMENT
/begin MEASUREMENT DFC_b.TSC_PIntkVUsLineHiB1 "Bit encoding / Ok-Tested Since Clear bit for check DFC_PIntkVUsLineHiB1" UBYTE DFC_OneToOne 1 100 0.00 1.000 BIT_MASK 0x20 FORMAT "%5.3" ECU_ADDRESS 0x60034B4F /end MEASUREMENT
/begin MEASUREMENT DFC_b.TSC_PIntkVUsLineLoB1 "Bit encoding / Ok-Tested Since Clear bit for check DFC_PIntkVUsLineLoB1" UBYTE DFC_OneToOne 1 100 0.00 1.000 BIT_MASK 0x20 FORMAT "%5.3" ECU_ADDRESS 0x60034B50 /end MEASUREMENT
/begin MEASUREMENT DFC_b.TSC_VehVPhysRngLo "Bit encoding / Ok-Tested Since Clear bit for check DFC_VehVPhysRngLo" UBYTE DFC_OneToOne 1 100 0.00 1.000 BIT_MASK 0x20 FORMAT "%5.3" ECU_ADDRESS 0x60034B51 /end MEASUREMENT
/begin MEASUREMENT DFC_b.TSC_VehVSigCan "Bit encoding / Ok-Tested Since Clear bit for check DFC_VehVSigCan" UBYTE DFC_OneToOne 1 100 0.00 1.000 BIT_MASK 0x20 FORMAT "%5.3" ECU_ADDRESS 0x60034B52 /end MEASUREMENT
/begin MEASUREMENT DFC_b.TSC_VehVSigCanSafe "Bit encoding / Ok-Tested Since Clear bit for check DFC_VehVSigCanSafe" UBYTE DFC_OneToOne 1 100 0.00 1.000 BIT_MASK 0x20 FORMAT "%5.3" ECU_ADDRESS 0x60034B53 /end MEASUREMENT
/begin MEASUREMENT DFC_b.TSC_VlvLftFbOilPSnsrIntk11SRCMax "Bit encoding / Ok-Tested Since Clear bit for check DFC_VlvLftFbOilPSnsrIntk11SRCMax" UBYTE DFC_OneToOne 1 100 0.00 1.000 BIT_MASK 0x20 FORMAT "%5.3" ECU_ADDRESS 0x60034B54 /end MEASUREMENT
/begin MEASUREMENT DFC_b.TSC_VlvLftFbOilPSnsrIntk11SRCMin "Bit encoding / Ok-Tested Since Clear bit for check DFC_VlvLftFbOilPSnsrIntk11SRCMin" UBYTE DFC_OneToOne 1 100 0.00 1.000 BIT_MASK 0x20 FORMAT "%5.3" ECU_ADDRESS 0x60034B55 /end MEASUREMENT
/begin MEASUREMENT DFC_b.TSC_ClthNpl "Bit encoding / Ok-Tested Since Clear bit for check DFC_ClthNpl" UBYTE DFC_OneToOne 1 100 0.00 1.000 BIT_MASK 0x20 FORMAT "%5.3" ECU_ADDRESS 0x60034B56 /end MEASUREMENT
/begin MEASUREMENT DFC_b.TSC_EV1max "Bit encoding / Ok-Tested Since Clear bit for check DFC_EV1max" UBYTE DFC_OneToOne 1 100 0.00 1.000 BIT_MASK 0x20 FORMAT "%5.3" ECU_ADDRESS 0x60034B57 /end MEASUREMENT
/begin MEASUREMENT DFC_b.TSC_EV1min "Bit encoding / Ok-Tested Since Clear bit for check DFC_EV1min" UBYTE DFC_OneToOne 1 100 0.00 1.000 BIT_MASK 0x20 FORMAT "%5.3" ECU_ADDRESS 0x60034B58 /end MEASUREMENT
/begin MEASUREMENT DFC_b.TSC_EV1sig "Bit encoding / Ok-Tested Since Clear bit for check DFC_EV1sig" UBYTE DFC_OneToOne 1 100 0.00 1.000 BIT_MASK 0x20 FORMAT "%5.3" ECU_ADDRESS 0x60034B59 /end MEASUREMENT
/begin MEASUREMENT DFC_b.TSC_EV2max "Bit encoding / Ok-Tested Since Clear bit for check DFC_EV2max" UBYTE DFC_OneToOne 1 100 0.00 1.000 BIT_MASK 0x20 FORMAT "%5.3" ECU_ADDRESS 0x60034B5A /end MEASUREMENT
/begin MEASUREMENT DFC_b.TSC_EV2min "Bit encoding / Ok-Tested Since Clear bit for check DFC_EV2min" UBYTE DFC_OneToOne 1 100 0.00 1.000 BIT_MASK 0x20 FORMAT "%5.3" ECU_ADDRESS 0x60034B5B /end MEASUREMENT
/begin MEASUREMENT DFC_b.TSC_EV2sig "Bit encoding / Ok-Tested Since Clear bit for check DFC_EV2sig" UBYTE DFC_OneToOne 1 100 0.00 1.000 BIT_MASK 0x20 FORMAT "%5.3" ECU_ADDRESS 0x60034B5C /end MEASUREMENT
/begin MEASUREMENT DFC_b.TSC_EV3max "Bit encoding / Ok-Tested Since Clear bit for check DFC_EV3max" UBYTE DFC_OneToOne 1 100 0.00 1.000 BIT_MASK 0x20 FORMAT "%5.3" ECU_ADDRESS 0x60034B5D /end MEASUREMENT
/begin MEASUREMENT DFC_b.TSC_EV3min "Bit encoding / Ok-Tested Since Clear bit for check DFC_EV3min" UBYTE DFC_OneToOne 1 100 0.00 1.000 BIT_MASK 0x20 FORMAT "%5.3" ECU_ADDRESS 0x60034B5E /end MEASUREMENT
/begin MEASUREMENT DFC_b.TSC_EV3sig "Bit encoding / Ok-Tested Since Clear bit for check DFC_EV3sig" UBYTE DFC_OneToOne 1 100 0.00 1.000 BIT_MASK 0x20 FORMAT "%5.3" ECU_ADDRESS 0x60034B5F /end MEASUREMENT
/begin MEASUREMENT DFC_b.TSC_EV4max "Bit encoding / Ok-Tested Since Clear bit for check DFC_EV4max" UBYTE DFC_OneToOne 1 100 0.00 1.000 BIT_MASK 0x20 FORMAT "%5.3" ECU_ADDRESS 0x60034B60 /end MEASUREMENT
/begin MEASUREMENT DFC_b.TSC_EV4min "Bit encoding / Ok-Tested Since Clear bit for check DFC_EV4min" UBYTE DFC_OneToOne 1 100 0.00 1.000 BIT_MASK 0x20 FORMAT "%5.3" ECU_ADDRESS 0x60034B61 /end MEASUREMENT
/begin MEASUREMENT DFC_b.TSC_EV4sig "Bit encoding / Ok-Tested Since Clear bit for check DFC_EV4sig" UBYTE DFC_OneToOne 1 100 0.00 1.000 BIT_MASK 0x20 FORMAT "%5.3" ECU_ADDRESS 0x60034B62 /end MEASUREMENT
/begin MEASUREMENT DFC_b.TSC_GbxPNPosnDrvCdn "Bit encoding / Ok-Tested Since Clear bit for check DFC_GbxPNPosnDrvCdn" UBYTE DFC_OneToOne 1 100 0.00 1.000 BIT_MASK 0x20 FORMAT "%5.3" ECU_ADDRESS 0x60034B63 /end MEASUREMENT
/begin MEASUREMENT DFC_b.TSC_GbxPNPosnPlausy "Bit encoding / Ok-Tested Since Clear bit for check DFC_GbxPNPosnPlausy" UBYTE DFC_OneToOne 1 100 0.00 1.000 BIT_MASK 0x20 FORMAT "%5.3" ECU_ADDRESS 0x60034B64 /end MEASUREMENT
/begin MEASUREMENT DFC_b.TSC_PEnvCcMax "Bit encoding / Ok-Tested Since Clear bit for check DFC_PEnvCcMax" UBYTE DFC_OneToOne 1 100 0.00 1.000 BIT_MASK 0x20 FORMAT "%5.3" ECU_ADDRESS 0x60034B65 /end MEASUREMENT
/begin MEASUREMENT DFC_b.TSC_PEnvCcMin "Bit encoding / Ok-Tested Since Clear bit for check DFC_PEnvCcMin" UBYTE DFC_OneToOne 1 100 0.00 1.000 BIT_MASK 0x20 FORMAT "%5.3" ECU_ADDRESS 0x60034B66 /end MEASUREMENT
/begin MEASUREMENT DFC_b.TSC_PEnvRngChkMax "Bit encoding / Ok-Tested Since Clear bit for check DFC_PEnvRngChkMax" UBYTE DFC_OneToOne 1 100 0.00 1.000 BIT_MASK 0x20 FORMAT "%5.3" ECU_ADDRESS 0x60034B67 /end MEASUREMENT
/begin MEASUREMENT DFC_b.TSC_PEnvRngChkMin "Bit encoding / Ok-Tested Since Clear bit for check DFC_PEnvRngChkMin" UBYTE DFC_OneToOne 1 100 0.00 1.000 BIT_MASK 0x20 FORMAT "%5.3" ECU_ADDRESS 0x60034B68 /end MEASUREMENT
/begin MEASUREMENT DFC_b.TSC_PEnvSnsrPlaus "Bit encoding / Ok-Tested Since Clear bit for check DFC_PEnvSnsrPlaus" UBYTE DFC_OneToOne 1 100 0.00 1.000 BIT_MASK 0x20 FORMAT "%5.3" ECU_ADDRESS 0x60034B69 /end MEASUREMENT
/begin MEASUREMENT DFC_b.TSC_UEGOHeatrPsS1B1Max "Bit encoding / Ok-Tested Since Clear bit for check DFC_UEGOHeatrPsS1B1Max" UBYTE DFC_OneToOne 1 100 0.00 1.000 BIT_MASK 0x20 FORMAT "%5.3" ECU_ADDRESS 0x60034B6A /end MEASUREMENT
/begin MEASUREMENT DFC_b.TSC_UEGOHeatrPsS1B1Min "Bit encoding / Ok-Tested Since Clear bit for check DFC_UEGOHeatrPsS1B1Min" UBYTE DFC_OneToOne 1 100 0.00 1.000 BIT_MASK 0x20 FORMAT "%5.3" ECU_ADDRESS 0x60034B6B /end MEASUREMENT
/begin MEASUREMENT DFC_b.TSC_UEGOHeatrPsS1B1Sig "Bit encoding / Ok-Tested Since Clear bit for check DFC_UEGOHeatrPsS1B1Sig" UBYTE DFC_OneToOne 1 100 0.00 1.000 BIT_MASK 0x20 FORMAT "%5.3" ECU_ADDRESS 0x60034B6C /end MEASUREMENT
/begin MEASUREMENT DFC_b.TSC_UEGOHeatrRlyPsOLS1B1 "Bit encoding / Ok-Tested Since Clear bit for check DFC_UEGOHeatrRlyPsOLS1B1" UBYTE DFC_OneToOne 1 100 0.00 1.000 BIT_MASK 0x20 FORMAT "%5.3" ECU_ADDRESS 0x60034B6D /end MEASUREMENT
/begin MEASUREMENT DFC_b.TSC_UEGOHeatrRlyPsSCBS1B1 "Bit encoding / Ok-Tested Since Clear bit for check DFC_UEGOHeatrRlyPsSCBS1B1" UBYTE DFC_OneToOne 1 100 0.00 1.000 BIT_MASK 0x20 FORMAT "%5.3" ECU_ADDRESS 0x60034B6E /end MEASUREMENT
/begin MEASUREMENT DFC_b.TSC_UEGOHeatrRlyPsSCGS1B1 "Bit encoding / Ok-Tested Since Clear bit for check DFC_UEGOHeatrRlyPsSCGS1B1" UBYTE DFC_OneToOne 1 100 0.00 1.000 BIT_MASK 0x20 FORMAT "%5.3" ECU_ADDRESS 0x60034B6F /end MEASUREMENT
/begin MEASUREMENT DFC_b.TSC_KnDetSens1PortAMax "Bit encoding / Ok-Tested Since Clear bit for check DFC_KnDetSens1PortAMax" UBYTE DFC_OneToOne 1 100 0.00 1.000 BIT_MASK 0x20 FORMAT "%5.3" ECU_ADDRESS 0x60034B70 /end MEASUREMENT
/begin MEASUREMENT DFC_b.TSC_KnDetSens1PortAMin "Bit encoding / Ok-Tested Since Clear bit for check DFC_KnDetSens1PortAMin" UBYTE DFC_OneToOne 1 100 0.00 1.000 BIT_MASK 0x20 FORMAT "%5.3" ECU_ADDRESS 0x60034B71 /end MEASUREMENT
/begin MEASUREMENT DFC_b.TSC_KnDetSens1PortBMax "Bit encoding / Ok-Tested Since Clear bit for check DFC_KnDetSens1PortBMax" UBYTE DFC_OneToOne 1 100 0.00 1.000 BIT_MASK 0x20 FORMAT "%5.3" ECU_ADDRESS 0x60034B72 /end MEASUREMENT
/begin MEASUREMENT DFC_b.TSC_KnDetSens1PortBMin "Bit encoding / Ok-Tested Since Clear bit for check DFC_KnDetSens1PortBMin" UBYTE DFC_OneToOne 1 100 0.00 1.000 BIT_MASK 0x20 FORMAT "%5.3" ECU_ADDRESS 0x60034B73 /end MEASUREMENT
/begin MEASUREMENT DFC_b.TSC_Clth2ONStuck "Bit encoding / Ok-Tested Since Clear bit for check DFC_Clth2ONStuck" UBYTE DFC_OneToOne 1 100 0.00 1.000 BIT_MASK 0x20 FORMAT "%5.3" ECU_ADDRESS 0x60034B74 /end MEASUREMENT
/begin MEASUREMENT DFC_b.TSC_Clth2ONStuckLdc "Bit encoding / Ok-Tested Since Clear bit for check DFC_Clth2ONStuckLdc" UBYTE DFC_OneToOne 1 100 0.00 1.000 BIT_MASK 0x20 FORMAT "%5.3" ECU_ADDRESS 0x60034B75 /end MEASUREMENT
/begin MEASUREMENT DFC_b.TSC_Clth3ONStuckLdc "Bit encoding / Ok-Tested Since Clear bit for check DFC_Clth3ONStuckLdc" UBYTE DFC_OneToOne 1 100 0.00 1.000 BIT_MASK 0x20 FORMAT "%5.3" ECU_ADDRESS 0x60034B76 /end MEASUREMENT
/begin MEASUREMENT DFC_b.TSC_Clth3ONStuckPostDrv "Bit encoding / Ok-Tested Since Clear bit for check DFC_Clth3ONStuckPostDrv" UBYTE DFC_OneToOne 1 100 0.00 1.000 BIT_MASK 0x20 FORMAT "%5.3" ECU_ADDRESS 0x60034B77 /end MEASUREMENT
/begin MEASUREMENT DFC_b.TSC_Clth4ONStuck "Bit encoding / Ok-Tested Since Clear bit for check DFC_Clth4ONStuck" UBYTE DFC_OneToOne 1 100 0.00 1.000 BIT_MASK 0x20 FORMAT "%5.3" ECU_ADDRESS 0x60034B78 /end MEASUREMENT
/begin MEASUREMENT DFC_b.TSC_Clth4ONStuckLdc "Bit encoding / Ok-Tested Since Clear bit for check DFC_Clth4ONStuckLdc" UBYTE DFC_OneToOne 1 100 0.00 1.000 BIT_MASK 0x20 FORMAT "%5.3" ECU_ADDRESS 0x60034B79 /end MEASUREMENT
/begin MEASUREMENT DFC_b.TSC_ComDLCTCU01 "Bit encoding / Ok-Tested Since Clear bit for check DFC_ComDLCTCU01" UBYTE DFC_OneToOne 1 100 0.00 1.000 BIT_MASK 0x20 FORMAT "%5.3" ECU_ADDRESS 0x60034B7A /end MEASUREMENT
/begin MEASUREMENT DFC_b.TSC_ComDLCTCU02 "Bit encoding / Ok-Tested Since Clear bit for check DFC_ComDLCTCU02" UBYTE DFC_OneToOne 1 100 0.00 1.000 BIT_MASK 0x20 FORMAT "%5.3" ECU_ADDRESS 0x60034B7B /end MEASUREMENT
/begin MEASUREMENT DFC_b.TSC_ComDLCTCU1 "Bit encoding / Ok-Tested Since Clear bit for check DFC_ComDLCTCU1" UBYTE DFC_OneToOne 1 100 0.00 1.000 BIT_MASK 0x20 FORMAT "%5.3" ECU_ADDRESS 0x60034B7C /end MEASUREMENT
/begin MEASUREMENT DFC_b.TSC_ComDLCTCU11 "Bit encoding / Ok-Tested Since Clear bit for check DFC_ComDLCTCU11" UBYTE DFC_OneToOne 1 100 0.00 1.000 BIT_MASK 0x20 FORMAT "%5.3" ECU_ADDRESS 0x60034B7D /end MEASUREMENT
/begin MEASUREMENT DFC_b.TSC_ComDLCTCU12 "Bit encoding / Ok-Tested Since Clear bit for check DFC_ComDLCTCU12" UBYTE DFC_OneToOne 1 100 0.00 1.000 BIT_MASK 0x20 FORMAT "%5.3" ECU_ADDRESS 0x60034B7E /end MEASUREMENT
/begin MEASUREMENT DFC_b.TSC_ComDLCTCU13 "Bit encoding / Ok-Tested Since Clear bit for check DFC_ComDLCTCU13" UBYTE DFC_OneToOne 1 100 0.00 1.000 BIT_MASK 0x20 FORMAT "%5.3" ECU_ADDRESS 0x60034B7F /end MEASUREMENT
/begin MEASUREMENT DFC_b.TSC_ComDLCTCU14 "Bit encoding / Ok-Tested Since Clear bit for check DFC_ComDLCTCU14" UBYTE DFC_OneToOne 1 100 0.00 1.000 BIT_MASK 0x20 FORMAT "%5.3" ECU_ADDRESS 0x60034B80 /end MEASUREMENT
/begin MEASUREMENT DFC_b.TSC_ComDLCTCU2 "Bit encoding / Ok-Tested Since Clear bit for check DFC_ComDLCTCU2" UBYTE DFC_OneToOne 1 100 0.00 1.000 BIT_MASK 0x20 FORMAT "%5.3" ECU_ADDRESS 0x60034B81 /end MEASUREMENT
/begin MEASUREMENT DFC_b.TSC_ComDLCTCU3 "Bit encoding / Ok-Tested Since Clear bit for check DFC_ComDLCTCU3" UBYTE DFC_OneToOne 1 100 0.00 1.000 BIT_MASK 0x20 FORMAT "%5.3" ECU_ADDRESS 0x60034B82 /end MEASUREMENT
/begin MEASUREMENT DFC_b.TSC_ComDLCTCU4 "Bit encoding / Ok-Tested Since Clear bit for check DFC_ComDLCTCU4" UBYTE DFC_OneToOne 1 100 0.00 1.000 BIT_MASK 0x20 FORMAT "%5.3" ECU_ADDRESS 0x60034B83 /end MEASUREMENT
/begin MEASUREMENT DFC_b.TSC_EVX "Bit encoding / Ok-Tested Since Clear bit for check DFC_EVX" UBYTE DFC_OneToOne 1 100 0.00 1.000 BIT_MASK 0x20 FORMAT "%5.3" ECU_ADDRESS 0x60034B84 /end MEASUREMENT
/begin MEASUREMENT DFC_b.TSC_EbsSocFlt "Bit encoding / Ok-Tested Since Clear bit for check DFC_EbsSocFlt" UBYTE DFC_OneToOne 1 100 0.00 1.000 BIT_MASK 0x20 FORMAT "%5.3" ECU_ADDRESS 0x60034B85 /end MEASUREMENT
/begin MEASUREMENT DFC_b.TSC_I14229VINErr "Bit encoding / Ok-Tested Since Clear bit for check DFC_I14229VINErr" UBYTE DFC_OneToOne 1 100 0.00 1.000 BIT_MASK 0x20 FORMAT "%5.3" ECU_ADDRESS 0x60034B86 /end MEASUREMENT
/begin MEASUREMENT DFC_b.TSC_LLRKHmax "Bit encoding / Ok-Tested Since Clear bit for check DFC_LLRKHmax" UBYTE DFC_OneToOne 1 100 0.00 1.000 BIT_MASK 0x20 FORMAT "%5.3" ECU_ADDRESS 0x60034B87 /end MEASUREMENT
/begin MEASUREMENT DFC_b.TSC_LLRKHmin "Bit encoding / Ok-Tested Since Clear bit for check DFC_LLRKHmin" UBYTE DFC_OneToOne 1 100 0.00 1.000 BIT_MASK 0x20 FORMAT "%5.3" ECU_ADDRESS 0x60034B88 /end MEASUREMENT
/begin MEASUREMENT DFC_b.TSC_LLRmax "Bit encoding / Ok-Tested Since Clear bit for check DFC_LLRmax" UBYTE DFC_OneToOne 1 100 0.00 1.000 BIT_MASK 0x20 FORMAT "%5.3" ECU_ADDRESS 0x60034B89 /end MEASUREMENT
/begin MEASUREMENT DFC_b.TSC_LLRmin "Bit encoding / Ok-Tested Since Clear bit for check DFC_LLRmin" UBYTE DFC_OneToOne 1 100 0.00 1.000 BIT_MASK 0x20 FORMAT "%5.3" ECU_ADDRESS 0x60034B8A /end MEASUREMENT
/begin MEASUREMENT DFC_b.TSC_RoughRoad "Bit encoding / Ok-Tested Since Clear bit for check DFC_RoughRoad" UBYTE DFC_OneToOne 1 100 0.00 1.000 BIT_MASK 0x20 FORMAT "%5.3" ECU_ADDRESS 0x60034B8B /end MEASUREMENT
/begin MEASUREMENT DFC_b.TSC_SiaEEPRdErr "Bit encoding / Ok-Tested Since Clear bit for check DFC_SiaEEPRdErr" UBYTE DFC_OneToOne 1 100 0.00 1.000 BIT_MASK 0x20 FORMAT "%5.3" ECU_ADDRESS 0x60034B8C /end MEASUREMENT
/begin MEASUREMENT DFC_b.TSC_SiaEEPWrngCod "Bit encoding / Ok-Tested Since Clear bit for check DFC_SiaEEPWrngCod" UBYTE DFC_OneToOne 1 100 0.00 1.000 BIT_MASK 0x20 FORMAT "%5.3" ECU_ADDRESS 0x60034B8D /end MEASUREMENT
/begin MEASUREMENT DFC_b.TSC_UegoDummy "Bit encoding / Ok-Tested Since Clear bit for check DFC_UegoDummy" UBYTE DFC_OneToOne 1 100 0.00 1.000 BIT_MASK 0x20 FORMAT "%5.3" ECU_ADDRESS 0x60034B8E /end MEASUREMENT
/begin MEASUREMENT DFC_b.TSC_BusDiagCANAPPLBusOff "Bit encoding / Ok-Tested Since Clear bit for check DFC_BusDiagCANAPPLBusOff" UBYTE DFC_OneToOne 1 100 0.00 1.000 BIT_MASK 0x20 FORMAT "%5.3" ECU_ADDRESS 0x60034B8F /end MEASUREMENT
/begin MEASUREMENT DFC_b.TSC_BusDiagCANCANCBusOff "Bit encoding / Ok-Tested Since Clear bit for check DFC_BusDiagCANCANCBusOff" UBYTE DFC_OneToOne 1 100 0.00 1.000 BIT_MASK 0x20 FORMAT "%5.3" ECU_ADDRESS 0x60034B90 /end MEASUREMENT
/begin MEASUREMENT DFC_b.TSC_BusDiagCANVEHICLEBusOff "Bit encoding / Ok-Tested Since Clear bit for check DFC_BusDiagCANVEHICLEBusOff" UBYTE DFC_OneToOne 1 100 0.00 1.000 BIT_MASK 0x20 FORMAT "%5.3" ECU_ADDRESS 0x60034B91 /end MEASUREMENT
/begin MEASUREMENT DFC_b.TSC_RBA_IODIAGPWR_rba_IoExtCy329_SignalVltSply_0 "Bit encoding / Ok-Tested Since Clear bit for check DFC_RBA_IODIAGPWR_rba_IoExtCy329_SignalVltSply_0" UBYTE DFC_OneToOne 1 100 0.00 1.000 BIT_MASK 0x20 FORMAT "%5.3" ECU_ADDRESS 0x60034B92 /end MEASUREMENT
/begin MEASUREMENT DFC_b.TSC_RBA_IODIAGPWR_rba_IoExtCy329_SignalVltSply_0OT "Bit encoding / Ok-Tested Since Clear bit for check DFC_RBA_IODIAGPWR_rba_IoExtCy329_SignalVltSply_0OT" UBYTE DFC_OneToOne 1 100 0.00 1.000 BIT_MASK 0x20 FORMAT "%5.3" ECU_ADDRESS 0x60034B93 /end MEASUREMENT
/begin MEASUREMENT DFC_b.TSC_RBA_IODIAGPWR_rba_IoExtCy329_SignalVltSply_0OV "Bit encoding / Ok-Tested Since Clear bit for check DFC_RBA_IODIAGPWR_rba_IoExtCy329_SignalVltSply_0OV" UBYTE DFC_OneToOne 1 100 0.00 1.000 BIT_MASK 0x20 FORMAT "%5.3" ECU_ADDRESS 0x60034B94 /end MEASUREMENT
/begin MEASUREMENT DFC_b.TSC_RBA_IODIAGPWR_rba_IoExtCy329_SignalVltSply_0SCG "Bit encoding / Ok-Tested Since Clear bit for check DFC_RBA_IODIAGPWR_rba_IoExtCy329_SignalVltSply_0SCG" UBYTE DFC_OneToOne 1 100 0.00 1.000 BIT_MASK 0x20 FORMAT "%5.3" ECU_ADDRESS 0x60034B95 /end MEASUREMENT
/begin MEASUREMENT DFC_b.TSC_RBA_IODIAGPWR_rba_IoExtCy329_SignalVltSply_0UV "Bit encoding / Ok-Tested Since Clear bit for check DFC_RBA_IODIAGPWR_rba_IoExtCy329_SignalVltSply_0UV" UBYTE DFC_OneToOne 1 100 0.00 1.000 BIT_MASK 0x20 FORMAT "%5.3" ECU_ADDRESS 0x60034B96 /end MEASUREMENT
/begin MEASUREMENT DFC_b.TSC_RBA_IODIAGPWR_rba_IoExtCy329_SignalVltSply_1 "Bit encoding / Ok-Tested Since Clear bit for check DFC_RBA_IODIAGPWR_rba_IoExtCy329_SignalVltSply_1" UBYTE DFC_OneToOne 1 100 0.00 1.000 BIT_MASK 0x20 FORMAT "%5.3" ECU_ADDRESS 0x60034B97 /end MEASUREMENT
/begin MEASUREMENT DFC_b.TSC_RBA_IODIAGPWR_rba_IoExtCy329_SignalVltSply_1OT "Bit encoding / Ok-Tested Since Clear bit for check DFC_RBA_IODIAGPWR_rba_IoExtCy329_SignalVltSply_1OT" UBYTE DFC_OneToOne 1 100 0.00 1.000 BIT_MASK 0x20 FORMAT "%5.3" ECU_ADDRESS 0x60034B98 /end MEASUREMENT
/begin MEASUREMENT DFC_b.TSC_RBA_IODIAGPWR_rba_IoExtCy329_SignalVltSply_1OV "Bit encoding / Ok-Tested Since Clear bit for check DFC_RBA_IODIAGPWR_rba_IoExtCy329_SignalVltSply_1OV" UBYTE DFC_OneToOne 1 100 0.00 1.000 BIT_MASK 0x20 FORMAT "%5.3" ECU_ADDRESS 0x60034B99 /end MEASUREMENT
/begin MEASUREMENT DFC_b.TSC_RBA_IODIAGPWR_rba_IoExtCy329_SignalVltSply_1SCG "Bit encoding / Ok-Tested Since Clear bit for check DFC_RBA_IODIAGPWR_rba_IoExtCy329_SignalVltSply_1SCG" UBYTE DFC_OneToOne 1 100 0.00 1.000 BIT_MASK 0x20 FORMAT "%5.3" ECU_ADDRESS 0x60034B9A /end MEASUREMENT
/begin MEASUREMENT DFC_b.TSC_RBA_IODIAGPWR_rba_IoExtCy329_SignalVltSply_1UV "Bit encoding / Ok-Tested Since Clear bit for check DFC_RBA_IODIAGPWR_rba_IoExtCy329_SignalVltSply_1UV" UBYTE DFC_OneToOne 1 100 0.00 1.000 BIT_MASK 0x20 FORMAT "%5.3" ECU_ADDRESS 0x60034B9B /end MEASUREMENT
/begin MEASUREMENT DFC_b.TSC_RBA_IODIAGPWR_rba_IoExtCy329_SignalVltSply_2 "Bit encoding / Ok-Tested Since Clear bit for check DFC_RBA_IODIAGPWR_rba_IoExtCy329_SignalVltSply_2" UBYTE DFC_OneToOne 1 100 0.00 1.000 BIT_MASK 0x20 FORMAT "%5.3" ECU_ADDRESS 0x60034B9C /end MEASUREMENT
/begin MEASUREMENT DFC_b.TSC_RBA_IODIAGPWR_rba_IoExtCy329_SignalVltSply_2OT "Bit encoding / Ok-Tested Since Clear bit for check DFC_RBA_IODIAGPWR_rba_IoExtCy329_SignalVltSply_2OT" UBYTE DFC_OneToOne 1 100 0.00 1.000 BIT_MASK 0x20 FORMAT "%5.3" ECU_ADDRESS 0x60034B9D /end MEASUREMENT
/begin MEASUREMENT DFC_b.TSC_RBA_IODIAGPWR_rba_IoExtCy329_SignalVltSply_2OV "Bit encoding / Ok-Tested Since Clear bit for check DFC_RBA_IODIAGPWR_rba_IoExtCy329_SignalVltSply_2OV" UBYTE DFC_OneToOne 1 100 0.00 1.000 BIT_MASK 0x20 FORMAT "%5.3" ECU_ADDRESS 0x60034B9E /end MEASUREMENT
/begin MEASUREMENT DFC_b.TSC_RBA_IODIAGPWR_rba_IoExtCy329_SignalVltSply_2SCG "Bit encoding / Ok-Tested Since Clear bit for check DFC_RBA_IODIAGPWR_rba_IoExtCy329_SignalVltSply_2SCG" UBYTE DFC_OneToOne 1 100 0.00 1.000 BIT_MASK 0x20 FORMAT "%5.3" ECU_ADDRESS 0x60034B9F /end MEASUREMENT
/begin MEASUREMENT DFC_b.TSC_RBA_IODIAGPWR_rba_IoExtCy329_SignalVltSply_2UV "Bit encoding / Ok-Tested Since Clear bit for check DFC_RBA_IODIAGPWR_rba_IoExtCy329_SignalVltSply_2UV" UBYTE DFC_OneToOne 1 100 0.00 1.000 BIT_MASK 0x20 FORMAT "%5.3" ECU_ADDRESS 0x60034BA0 /end MEASUREMENT
/begin MEASUREMENT DFC_b.TSC_CAN_E_TIMEOUT "Bit encoding / Ok-Tested Since Clear bit for check DFC_CAN_E_TIMEOUT" UBYTE DFC_OneToOne 1 100 0.00 1.000 BIT_MASK 0x20 FORMAT "%5.3" ECU_ADDRESS 0x60034BA1 /end MEASUREMENT
/begin MEASUREMENT DFC_b.TSC_LIN_E_TIMEOUT "Bit encoding / Ok-Tested Since Clear bit for check DFC_LIN_E_TIMEOUT" UBYTE DFC_OneToOne 1 100 0.00 1.000 BIT_MASK 0x20 FORMAT "%5.3" ECU_ADDRESS 0x60034BA2 /end MEASUREMENT
/begin MEASUREMENT DFC_b.TSC_MRlyOL "Bit encoding / Ok-Tested Since Clear bit for check DFC_MRlyOL" UBYTE DFC_OneToOne 1 100 0.00 1.000 BIT_MASK 0x20 FORMAT "%5.3" ECU_ADDRESS 0x60034BA3 /end MEASUREMENT
/begin MEASUREMENT DFC_b.TSC_MRlySCB "Bit encoding / Ok-Tested Since Clear bit for check DFC_MRlySCB" UBYTE DFC_OneToOne 1 100 0.00 1.000 BIT_MASK 0x20 FORMAT "%5.3" ECU_ADDRESS 0x60034BA4 /end MEASUREMENT
/begin MEASUREMENT DFC_b.TSC_MRlySCG "Bit encoding / Ok-Tested Since Clear bit for check DFC_MRlySCG" UBYTE DFC_OneToOne 1 100 0.00 1.000 BIT_MASK 0x20 FORMAT "%5.3" ECU_ADDRESS 0x60034BA5 /end MEASUREMENT
/begin MEASUREMENT DFC_b.TSC_rba_MultiStackTrace_Threshold "Bit encoding / Ok-Tested Since Clear bit for check DFC_rba_MultiStackTrace_Threshold" UBYTE DFC_OneToOne 1 100 0.00 1.000 BIT_MASK 0x20 FORMAT "%5.3" ECU_ADDRESS 0x60034BA6 /end MEASUREMENT
/begin MEASUREMENT DFC_b.TSC_BSWM_E_ACTION_FAILED "Bit encoding / Ok-Tested Since Clear bit for check DFC_BSWM_E_ACTION_FAILED" UBYTE DFC_OneToOne 1 100 0.00 1.000 BIT_MASK 0x20 FORMAT "%5.3" ECU_ADDRESS 0x60034BA7 /end MEASUREMENT
/begin MEASUREMENT DFC_b.TSC_BSWM_E_INTRPTQUEUE_FULL "Bit encoding / Ok-Tested Since Clear bit for check DFC_BSWM_E_INTRPTQUEUE_FULL" UBYTE DFC_OneToOne 1 100 0.00 1.000 BIT_MASK 0x20 FORMAT "%5.3" ECU_ADDRESS 0x60034BA8 /end MEASUREMENT
/begin MEASUREMENT DFC_b.TSC_RBA_IOEXTLIB_KEEPALIVE_DRV "Bit encoding / Ok-Tested Since Clear bit for check DFC_RBA_IOEXTLIB_KEEPALIVE_DRV" UBYTE DFC_OneToOne 1 100 0.00 1.000 BIT_MASK 0x20 FORMAT "%5.3" ECU_ADDRESS 0x60034BA9 /end MEASUREMENT
/begin MEASUREMENT DFC_b.TSC_RBA_IOEXTLIB_KEEPALIVE_INI "Bit encoding / Ok-Tested Since Clear bit for check DFC_RBA_IOEXTLIB_KEEPALIVE_INI" UBYTE DFC_OneToOne 1 100 0.00 1.000 BIT_MASK 0x20 FORMAT "%5.3" ECU_ADDRESS 0x60034BAA /end MEASUREMENT
/begin MEASUREMENT DFC_b.TSC_rba_IoSigRtc_StopCounter "Bit encoding / Ok-Tested Since Clear bit for check DFC_rba_IoSigRtc_StopCounter" UBYTE DFC_OneToOne 1 100 0.00 1.000 BIT_MASK 0x20 FORMAT "%5.3" ECU_ADDRESS 0x60034BAB /end MEASUREMENT
/begin MEASUREMENT DFC_b.TSC_rba_MRly_Diag_Stk_Event "Bit encoding / Ok-Tested Since Clear bit for check DFC_rba_MRly_Diag_Stk_Event" UBYTE DFC_OneToOne 1 100 0.00 1.000 BIT_MASK 0x20 FORMAT "%5.3" ECU_ADDRESS 0x60034BAC /end MEASUREMENT
/begin MEASUREMENT DFC_b.TSC_rba_MemDiag_MemReadErr "Bit encoding / Ok-Tested Since Clear bit for check DFC_rba_MemDiag_MemReadErr" UBYTE DFC_OneToOne 1 100 0.00 1.000 BIT_MASK 0x20 FORMAT "%5.3" ECU_ADDRESS 0x60034BAD /end MEASUREMENT
/begin MEASUREMENT DFC_b.TSC_rba_MemDiag_MemWrErr "Bit encoding / Ok-Tested Since Clear bit for check DFC_rba_MemDiag_MemWrErr" UBYTE DFC_OneToOne 1 100 0.00 1.000 BIT_MASK 0x20 FORMAT "%5.3" ECU_ADDRESS 0x60034BAE /end MEASUREMENT
/begin MEASUREMENT DFC_b.TSC_rba_SyC_IrrSwOffTrigEngRun_Event "Bit encoding / Ok-Tested Since Clear bit for check DFC_rba_SyC_IrrSwOffTrigEngRun_Event" UBYTE DFC_OneToOne 1 100 0.00 1.000 BIT_MASK 0x20 FORMAT "%5.3" ECU_ADDRESS 0x60034BAF /end MEASUREMENT
/begin MEASUREMENT DFC_b.TSC_rba_T15_Diag_ComInVld_Event "Bit encoding / Ok-Tested Since Clear bit for check DFC_rba_T15_Diag_ComInVld_Event" UBYTE DFC_OneToOne 1 100 0.00 1.000 BIT_MASK 0x20 FORMAT "%5.3" ECU_ADDRESS 0x60034BB0 /end MEASUREMENT
/begin MEASUREMENT DFC_b.TSC_rba_T15_Diag_ComOff_HwOn_Event "Bit encoding / Ok-Tested Since Clear bit for check DFC_rba_T15_Diag_ComOff_HwOn_Event" UBYTE DFC_OneToOne 1 100 0.00 1.000 BIT_MASK 0x20 FORMAT "%5.3" ECU_ADDRESS 0x60034BB1 /end MEASUREMENT
/begin MEASUREMENT DFC_b.TSC_rba_T15_Diag_ComOn_HwOff_Event "Bit encoding / Ok-Tested Since Clear bit for check DFC_rba_T15_Diag_ComOn_HwOff_Event" UBYTE DFC_OneToOne 1 100 0.00 1.000 BIT_MASK 0x20 FORMAT "%5.3" ECU_ADDRESS 0x60034BB2 /end MEASUREMENT
/begin MEASUREMENT DFC_b.TSC_AppAllSnsrDfct "Bit encoding / Ok-Tested Since Clear bit for check DFC_AppAllSnsrDfct" UBYTE DFC_OneToOne 1 100 0.00 1.000 BIT_MASK 0x20 FORMAT "%5.3" ECU_ADDRESS 0x60034BB3 /end MEASUREMENT
/begin MEASUREMENT DFC_b.TSC_BattUStdbyDiaOL "Bit encoding / Ok-Tested Since Clear bit for check DFC_BattUStdbyDiaOL" UBYTE DFC_OneToOne 1 100 0.00 1.000 BIT_MASK 0x20 FORMAT "%5.3" ECU_ADDRESS 0x60034BB4 /end MEASUREMENT
/begin MEASUREMENT DFC_b.TSC_BigLeakIntkMnfldEmiInfl "Bit encoding / Ok-Tested Since Clear bit for check DFC_BigLeakIntkMnfldEmiInfl" UBYTE DFC_OneToOne 1 100 0.00 1.000 BIT_MASK 0x20 FORMAT "%5.3" ECU_ADDRESS 0x60034BB5 /end MEASUREMENT
/begin MEASUREMENT DFC_b.TSC_BrkMnSwtContOnWarnLmp "Bit encoding / Ok-Tested Since Clear bit for check DFC_BrkMnSwtContOnWarnLmp" UBYTE DFC_OneToOne 1 100 0.00 1.000 BIT_MASK 0x20 FORMAT "%5.3" ECU_ADDRESS 0x60034BB6 /end MEASUREMENT
/begin MEASUREMENT DFC_b.TSC_BrkMnSwtNotStpWarnLmp "Bit encoding / Ok-Tested Since Clear bit for check DFC_BrkMnSwtNotStpWarnLmp" UBYTE DFC_OneToOne 1 100 0.00 1.000 BIT_MASK 0x20 FORMAT "%5.3" ECU_ADDRESS 0x60034BB7 /end MEASUREMENT
/begin MEASUREMENT DFC_b.TSC_BrkRdntSwtContOnWarnLmp "Bit encoding / Ok-Tested Since Clear bit for check DFC_BrkRdntSwtContOnWarnLmp" UBYTE DFC_OneToOne 1 100 0.00 1.000 BIT_MASK 0x20 FORMAT "%5.3" ECU_ADDRESS 0x60034BB8 /end MEASUREMENT
/begin MEASUREMENT DFC_b.TSC_BrkRdntSwtNotStpWarnLmp "Bit encoding / Ok-Tested Since Clear bit for check DFC_BrkRdntSwtNotStpWarnLmp" UBYTE DFC_OneToOne 1 100 0.00 1.000 BIT_MASK 0x20 FORMAT "%5.3" ECU_ADDRESS 0x60034BB9 /end MEASUREMENT
/begin MEASUREMENT DFC_b.TSC_CEngDsTColdStrtMax "Bit encoding / Ok-Tested Since Clear bit for check DFC_CEngDsTColdStrtMax" UBYTE DFC_OneToOne 1 100 0.00 1.000 BIT_MASK 0x20 FORMAT "%5.3" ECU_ADDRESS 0x60034BBA /end MEASUREMENT
/begin MEASUREMENT DFC_b.TSC_CEngDsTColdStrtMin "Bit encoding / Ok-Tested Since Clear bit for check DFC_CEngDsTColdStrtMin" UBYTE DFC_OneToOne 1 100 0.00 1.000 BIT_MASK 0x20 FORMAT "%5.3" ECU_ADDRESS 0x60034BBB /end MEASUREMENT
/begin MEASUREMENT DFC_b.TSC_CEngDsTImps "Bit encoding / Ok-Tested Since Clear bit for check DFC_CEngDsTImps" UBYTE DFC_OneToOne 1 100 0.00 1.000 BIT_MASK 0x20 FORMAT "%5.3" ECU_ADDRESS 0x60034BBC /end MEASUREMENT
/begin MEASUREMENT DFC_b.TSC_CEngDsTPlausLSC "Bit encoding / Ok-Tested Since Clear bit for check DFC_CEngDsTPlausLSC" UBYTE DFC_OneToOne 1 100 0.00 1.000 BIT_MASK 0x20 FORMAT "%5.3" ECU_ADDRESS 0x60034BBD /end MEASUREMENT
/begin MEASUREMENT DFC_b.TSC_CEngDsTPlausSTC "Bit encoding / Ok-Tested Since Clear bit for check DFC_CEngDsTPlausSTC" UBYTE DFC_OneToOne 1 100 0.00 1.000 BIT_MASK 0x20 FORMAT "%5.3" ECU_ADDRESS 0x60034BBE /end MEASUREMENT
/begin MEASUREMENT DFC_b.TSC_CEngDsTSRCMax "Bit encoding / Ok-Tested Since Clear bit for check DFC_CEngDsTSRCMax" UBYTE DFC_OneToOne 1 100 0.00 1.000 BIT_MASK 0x20 FORMAT "%5.3" ECU_ADDRESS 0x60034BBF /end MEASUREMENT
/begin MEASUREMENT DFC_b.TSC_CEngDsTSRCMin "Bit encoding / Ok-Tested Since Clear bit for check DFC_CEngDsTSRCMin" UBYTE DFC_OneToOne 1 100 0.00 1.000 BIT_MASK 0x20 FORMAT "%5.3" ECU_ADDRESS 0x60034BC0 /end MEASUREMENT
/begin MEASUREMENT DFC_b.TSC_CEngDsTSig "Bit encoding / Ok-Tested Since Clear bit for check DFC_CEngDsTSig" UBYTE DFC_OneToOne 1 100 0.00 1.000 BIT_MASK 0x20 FORMAT "%5.3" ECU_ADDRESS 0x60034BC1 /end MEASUREMENT
/begin MEASUREMENT DFC_b.TSC_CEngUsTSRCMax "Bit encoding / Ok-Tested Since Clear bit for check DFC_CEngUsTSRCMax" UBYTE DFC_OneToOne 1 100 0.00 1.000 BIT_MASK 0x20 FORMAT "%5.3" ECU_ADDRESS 0x60034BC2 /end MEASUREMENT
/begin MEASUREMENT DFC_b.TSC_CEngUsTSRCMin "Bit encoding / Ok-Tested Since Clear bit for check DFC_CEngUsTSRCMin" UBYTE DFC_OneToOne 1 100 0.00 1.000 BIT_MASK 0x20 FORMAT "%5.3" ECU_ADDRESS 0x60034BC3 /end MEASUREMENT
/begin MEASUREMENT DFC_b.TSC_DCDCFltDet "Bit encoding / Ok-Tested Since Clear bit for check DFC_DCDCFltDet" UBYTE DFC_OneToOne 1 100 0.00 1.000 BIT_MASK 0x20 FORMAT "%5.3" ECU_ADDRESS 0x60034BC4 /end MEASUREMENT
/begin MEASUREMENT DFC_b.TSC_DKRSA "Bit encoding / Ok-Tested Since Clear bit for check DFC_DKRSA" UBYTE DFC_OneToOne 1 100 0.00 1.000 BIT_MASK 0x20 FORMAT "%5.3" ECU_ADDRESS 0x60034BC5 /end MEASUREMENT
/begin MEASUREMENT DFC_b.TSC_DKVSmax "Bit encoding / Ok-Tested Since Clear bit for check DFC_DKVSmax" UBYTE DFC_OneToOne 1 100 0.00 1.000 BIT_MASK 0x20 FORMAT "%5.3" ECU_ADDRESS 0x60034BC6 /end MEASUREMENT
/begin MEASUREMENT DFC_b.TSC_DKnpl "Bit encoding / Ok-Tested Since Clear bit for check DFC_DKnpl" UBYTE DFC_OneToOne 1 100 0.00 1.000 BIT_MASK 0x20 FORMAT "%5.3" ECU_ADDRESS 0x60034BC7 /end MEASUREMENT
/begin MEASUREMENT DFC_b.TSC_DSSmax "Bit encoding / Ok-Tested Since Clear bit for check DFC_DSSmax" UBYTE DFC_OneToOne 1 100 0.00 1.000 BIT_MASK 0x20 FORMAT "%5.3" ECU_ADDRESS 0x60034BC8 /end MEASUREMENT
/begin MEASUREMENT DFC_b.TSC_DSTTI "Bit encoding / Ok-Tested Since Clear bit for check DFC_DSTTI" UBYTE DFC_OneToOne 1 100 0.00 1.000 BIT_MASK 0x20 FORMAT "%5.3" ECU_ADDRESS 0x60034BC9 /end MEASUREMENT
/begin MEASUREMENT DFC_b.TSC_DSUmax "Bit encoding / Ok-Tested Since Clear bit for check DFC_DSUmax" UBYTE DFC_OneToOne 1 100 0.00 1.000 BIT_MASK 0x20 FORMAT "%5.3" ECU_ADDRESS 0x60034BCA /end MEASUREMENT
/begin MEASUREMENT DFC_b.TSC_EGRVlvOL "Bit encoding / Ok-Tested Since Clear bit for check DFC_EGRVlvOL" UBYTE DFC_OneToOne 1 100 0.00 1.000 BIT_MASK 0x20 FORMAT "%5.3" ECU_ADDRESS 0x60034BCB /end MEASUREMENT
/begin MEASUREMENT DFC_b.TSC_EGRVlvSCB "Bit encoding / Ok-Tested Since Clear bit for check DFC_EGRVlvSCB" UBYTE DFC_OneToOne 1 100 0.00 1.000 BIT_MASK 0x20 FORMAT "%5.3" ECU_ADDRESS 0x60034BCC /end MEASUREMENT
/begin MEASUREMENT DFC_b.TSC_EGRVlvSCG "Bit encoding / Ok-Tested Since Clear bit for check DFC_EGRVlvSCG" UBYTE DFC_OneToOne 1 100 0.00 1.000 BIT_MASK 0x20 FORMAT "%5.3" ECU_ADDRESS 0x60034BCD /end MEASUREMENT
/begin MEASUREMENT DFC_b.TSC_EGSDUS2B1LtrDly "Bit encoding / Ok-Tested Since Clear bit for check DFC_EGSDUS2B1LtrDly" UBYTE DFC_OneToOne 1 100 0.00 1.000 BIT_MASK 0x20 FORMAT "%5.3" ECU_ADDRESS 0x60034BCE /end MEASUREMENT
/begin MEASUREMENT DFC_b.TSC_EGSDUS2B1LtrPT1 "Bit encoding / Ok-Tested Since Clear bit for check DFC_EGSDUS2B1LtrPT1" UBYTE DFC_OneToOne 1 100 0.00 1.000 BIT_MASK 0x20 FORMAT "%5.3" ECU_ADDRESS 0x60034BCF /end MEASUREMENT
/begin MEASUREMENT DFC_b.TSC_EGSDUS2B1RtlDly "Bit encoding / Ok-Tested Since Clear bit for check DFC_EGSDUS2B1RtlDly" UBYTE DFC_OneToOne 1 100 0.00 1.000 BIT_MASK 0x20 FORMAT "%5.3" ECU_ADDRESS 0x60034BD0 /end MEASUREMENT
/begin MEASUREMENT DFC_b.TSC_EGSDUS2B1RtlPT1 "Bit encoding / Ok-Tested Since Clear bit for check DFC_EGSDUS2B1RtlPT1" UBYTE DFC_OneToOne 1 100 0.00 1.000 BIT_MASK 0x20 FORMAT "%5.3" ECU_ADDRESS 0x60034BD1 /end MEASUREMENT
/begin MEASUREMENT DFC_b.TSC_EGSDUS2B1TarLean "Bit encoding / Ok-Tested Since Clear bit for check DFC_EGSDUS2B1TarLean" UBYTE DFC_OneToOne 1 100 0.00 1.000 BIT_MASK 0x20 FORMAT "%5.3" ECU_ADDRESS 0x60034BD2 /end MEASUREMENT
/begin MEASUREMENT DFC_b.TSC_EGSDUS2B1TarRich "Bit encoding / Ok-Tested Since Clear bit for check DFC_EGSDUS2B1TarRich" UBYTE DFC_OneToOne 1 100 0.00 1.000 BIT_MASK 0x20 FORMAT "%5.3" ECU_ADDRESS 0x60034BD3 /end MEASUREMENT
/begin MEASUREMENT DFC_b.TSC_ETAKHLmax "Bit encoding / Ok-Tested Since Clear bit for check DFC_ETAKHLmax" UBYTE DFC_OneToOne 1 100 0.00 1.000 BIT_MASK 0x20 FORMAT "%5.3" ECU_ADDRESS 0x60034BD4 /end MEASUREMENT
/begin MEASUREMENT DFC_b.TSC_ETAKHTmax "Bit encoding / Ok-Tested Since Clear bit for check DFC_ETAKHTmax" UBYTE DFC_OneToOne 1 100 0.00 1.000 BIT_MASK 0x20 FORMAT "%5.3" ECU_ADDRESS 0x60034BD5 /end MEASUREMENT
/begin MEASUREMENT DFC_b.TSC_EngICO "Bit encoding / Ok-Tested Since Clear bit for check DFC_EngICO" UBYTE DFC_OneToOne 1 100 0.00 1.000 BIT_MASK 0x20 FORMAT "%5.3" ECU_ADDRESS 0x60034BD6 /end MEASUREMENT
/begin MEASUREMENT DFC_b.TSC_EngPrtOvrSpdMon "Bit encoding / Ok-Tested Since Clear bit for check DFC_EngPrtOvrSpdMon" UBYTE DFC_OneToOne 1 100 0.00 1.000 BIT_MASK 0x20 FORMAT "%5.3" ECU_ADDRESS 0x60034BD7 /end MEASUREMENT
/begin MEASUREMENT DFC_b.TSC_EpmCaSI1ErrSig "Bit encoding / Ok-Tested Since Clear bit for check DFC_EpmCaSI1ErrSig" UBYTE DFC_OneToOne 1 100 0.00 1.000 BIT_MASK 0x20 FORMAT "%5.3" ECU_ADDRESS 0x60034BD8 /end MEASUREMENT
/begin MEASUREMENT DFC_b.TSC_EpmCaSI1NoSig "Bit encoding / Ok-Tested Since Clear bit for check DFC_EpmCaSI1NoSig" UBYTE DFC_OneToOne 1 100 0.00 1.000 BIT_MASK 0x20 FORMAT "%5.3" ECU_ADDRESS 0x60034BD9 /end MEASUREMENT
/begin MEASUREMENT DFC_b.TSC_EpmCaSI1OfsErr "Bit encoding / Ok-Tested Since Clear bit for check DFC_EpmCaSI1OfsErr" UBYTE DFC_OneToOne 1 100 0.00 1.000 BIT_MASK 0x20 FORMAT "%5.3" ECU_ADDRESS 0x60034BDA /end MEASUREMENT
/begin MEASUREMENT DFC_b.TSC_EpmCrSErrSig "Bit encoding / Ok-Tested Since Clear bit for check DFC_EpmCrSErrSig" UBYTE DFC_OneToOne 1 100 0.00 1.000 BIT_MASK 0x20 FORMAT "%5.3" ECU_ADDRESS 0x60034BDB /end MEASUREMENT
/begin MEASUREMENT DFC_b.TSC_EpmCrSNoSig "Bit encoding / Ok-Tested Since Clear bit for check DFC_EpmCrSNoSig" UBYTE DFC_OneToOne 1 100 0.00 1.000 BIT_MASK 0x20 FORMAT "%5.3" ECU_ADDRESS 0x60034BDC /end MEASUREMENT
/begin MEASUREMENT DFC_b.TSC_EtaEngIdleNonCsers "Bit encoding / Ok-Tested Since Clear bit for check DFC_EtaEngIdleNonCsers" UBYTE DFC_OneToOne 1 100 0.00 1.000 BIT_MASK 0x20 FORMAT "%5.3" ECU_ADDRESS 0x60034BDD /end MEASUREMENT
/begin MEASUREMENT DFC_b.TSC_EtaEngPtlNonCsers "Bit encoding / Ok-Tested Since Clear bit for check DFC_EtaEngPtlNonCsers" UBYTE DFC_OneToOne 1 100 0.00 1.000 BIT_MASK 0x20 FORMAT "%5.3" ECU_ADDRESS 0x60034BDE /end MEASUREMENT
/begin MEASUREMENT DFC_b.TSC_FRAmax "Bit encoding / Ok-Tested Since Clear bit for check DFC_FRAmax" UBYTE DFC_OneToOne 1 100 0.00 1.000 BIT_MASK 0x20 FORMAT "%5.3" ECU_ADDRESS 0x60034BDF /end MEASUREMENT
/begin MEASUREMENT DFC_b.TSC_FRAmin "Bit encoding / Ok-Tested Since Clear bit for check DFC_FRAmin" UBYTE DFC_OneToOne 1 100 0.00 1.000 BIT_MASK 0x20 FORMAT "%5.3" ECU_ADDRESS 0x60034BE0 /end MEASUREMENT
/begin MEASUREMENT DFC_b.TSC_GbxRvsSwtStk "Bit encoding / Ok-Tested Since Clear bit for check DFC_GbxRvsSwtStk" UBYTE DFC_OneToOne 1 100 0.00 1.000 BIT_MASK 0x20 FORMAT "%5.3" ECU_ADDRESS 0x60034BE1 /end MEASUREMENT
/begin MEASUREMENT DFC_b.TSC_HDRmax "Bit encoding / Ok-Tested Since Clear bit for check DFC_HDRmax" UBYTE DFC_OneToOne 1 100 0.00 1.000 BIT_MASK 0x20 FORMAT "%5.3" ECU_ADDRESS 0x60034BE2 /end MEASUREMENT
/begin MEASUREMENT DFC_b.TSC_HEGOS2B1ElecMax "Bit encoding / Ok-Tested Since Clear bit for check DFC_HEGOS2B1ElecMax" UBYTE DFC_OneToOne 1 100 0.00 1.000 BIT_MASK 0x20 FORMAT "%5.3" ECU_ADDRESS 0x60034BE3 /end MEASUREMENT
/begin MEASUREMENT DFC_b.TSC_HEGOS2B1ElecMin "Bit encoding / Ok-Tested Since Clear bit for check DFC_HEGOS2B1ElecMin" UBYTE DFC_OneToOne 1 100 0.00 1.000 BIT_MASK 0x20 FORMAT "%5.3" ECU_ADDRESS 0x60034BE4 /end MEASUREMENT
/begin MEASUREMENT DFC_b.TSC_HEGOS2B1ElecSig "Bit encoding / Ok-Tested Since Clear bit for check DFC_HEGOS2B1ElecSig" UBYTE DFC_OneToOne 1 100 0.00 1.000 BIT_MASK 0x20 FORMAT "%5.3" ECU_ADDRESS 0x60034BE5 /end MEASUREMENT
/begin MEASUREMENT DFC_b.TSC_HEGOS2B1HtgNpl "Bit encoding / Ok-Tested Since Clear bit for check DFC_HEGOS2B1HtgNpl" UBYTE DFC_OneToOne 1 100 0.00 1.000 BIT_MASK 0x20 FORMAT "%5.3" ECU_ADDRESS 0x60034BE6 /end MEASUREMENT
/begin MEASUREMENT DFC_b.TSC_IntkAirTIntkMnfldCrssMax "Bit encoding / Ok-Tested Since Clear bit for check DFC_IntkAirTIntkMnfldCrssMax" UBYTE DFC_OneToOne 1 100 0.00 1.000 BIT_MASK 0x20 FORMAT "%5.3" ECU_ADDRESS 0x60034BE7 /end MEASUREMENT
/begin MEASUREMENT DFC_b.TSC_IntkAirTIntkMnfldCrssMin "Bit encoding / Ok-Tested Since Clear bit for check DFC_IntkAirTIntkMnfldCrssMin" UBYTE DFC_OneToOne 1 100 0.00 1.000 BIT_MASK 0x20 FORMAT "%5.3" ECU_ADDRESS 0x60034BE8 /end MEASUREMENT
/begin MEASUREMENT DFC_b.TSC_IntkAirTIntkMnfldHSCMax "Bit encoding / Ok-Tested Since Clear bit for check DFC_IntkAirTIntkMnfldHSCMax" UBYTE DFC_OneToOne 1 100 0.00 1.000 BIT_MASK 0x20 FORMAT "%5.3" ECU_ADDRESS 0x60034BE9 /end MEASUREMENT
/begin MEASUREMENT DFC_b.TSC_IntkAirTIntkMnfldImps "Bit encoding / Ok-Tested Since Clear bit for check DFC_IntkAirTIntkMnfldImps" UBYTE DFC_OneToOne 1 100 0.00 1.000 BIT_MASK 0x20 FORMAT "%5.3" ECU_ADDRESS 0x60034BEA /end MEASUREMENT
/begin MEASUREMENT DFC_b.TSC_IntkAirTIntkMnfldPRCMax "Bit encoding / Ok-Tested Since Clear bit for check DFC_IntkAirTIntkMnfldPRCMax" UBYTE DFC_OneToOne 1 100 0.00 1.000 BIT_MASK 0x20 FORMAT "%5.3" ECU_ADDRESS 0x60034BEB /end MEASUREMENT
/begin MEASUREMENT DFC_b.TSC_IntkAirTIntkMnfldPRCMin "Bit encoding / Ok-Tested Since Clear bit for check DFC_IntkAirTIntkMnfldPRCMin" UBYTE DFC_OneToOne 1 100 0.00 1.000 BIT_MASK 0x20 FORMAT "%5.3" ECU_ADDRESS 0x60034BEC /end MEASUREMENT
/begin MEASUREMENT DFC_b.TSC_IntkAirTIntkMnfldSRCMax "Bit encoding / Ok-Tested Since Clear bit for check DFC_IntkAirTIntkMnfldSRCMax" UBYTE DFC_OneToOne 1 100 0.00 1.000 BIT_MASK 0x20 FORMAT "%5.3" ECU_ADDRESS 0x60034BED /end MEASUREMENT
/begin MEASUREMENT DFC_b.TSC_IntkAirTIntkMnfldSRCMin "Bit encoding / Ok-Tested Since Clear bit for check DFC_IntkAirTIntkMnfldSRCMin" UBYTE DFC_OneToOne 1 100 0.00 1.000 BIT_MASK 0x20 FORMAT "%5.3" ECU_ADDRESS 0x60034BEE /end MEASUREMENT
/begin MEASUREMENT DFC_b.TSC_IntkAirTIntkMnfldSTC "Bit encoding / Ok-Tested Since Clear bit for check DFC_IntkAirTIntkMnfldSTC" UBYTE DFC_OneToOne 1 100 0.00 1.000 BIT_MASK 0x20 FORMAT "%5.3" ECU_ADDRESS 0x60034BEF /end MEASUREMENT
/begin MEASUREMENT DFC_b.TSC_KS1max "Bit encoding / Ok-Tested Since Clear bit for check DFC_KS1max" UBYTE DFC_OneToOne 1 100 0.00 1.000 BIT_MASK 0x20 FORMAT "%5.3" ECU_ADDRESS 0x60034BF0 /end MEASUREMENT
/begin MEASUREMENT DFC_b.TSC_KS1min "Bit encoding / Ok-Tested Since Clear bit for check DFC_KS1min" UBYTE DFC_OneToOne 1 100 0.00 1.000 BIT_MASK 0x20 FORMAT "%5.3" ECU_ADDRESS 0x60034BF1 /end MEASUREMENT
/begin MEASUREMENT DFC_b.TSC_LMmax "Bit encoding / Ok-Tested Since Clear bit for check DFC_LMmax" UBYTE DFC_OneToOne 1 100 0.00 1.000 BIT_MASK 0x20 FORMAT "%5.3" ECU_ADDRESS 0x60034BF2 /end MEASUREMENT
/begin MEASUREMENT DFC_b.TSC_LZSRnpl "Bit encoding / Ok-Tested Since Clear bit for check DFC_LZSRnpl" UBYTE DFC_OneToOne 1 100 0.00 1.000 BIT_MASK 0x20 FORMAT "%5.3" ECU_ADDRESS 0x60034BF3 /end MEASUREMENT
/begin MEASUREMENT DFC_b.TSC_LamDynDiagS1B1 "Bit encoding / Ok-Tested Since Clear bit for check DFC_LamDynDiagS1B1" UBYTE DFC_OneToOne 1 100 0.00 1.000 BIT_MASK 0x20 FORMAT "%5.3" ECU_ADDRESS 0x60034BF4 /end MEASUREMENT
/begin MEASUREMENT DFC_b.TSC_LeakIntkMnfldEmiInfl "Bit encoding / Ok-Tested Since Clear bit for check DFC_LeakIntkMnfldEmiInfl" UBYTE DFC_OneToOne 1 100 0.00 1.000 BIT_MASK 0x20 FORMAT "%5.3" ECU_ADDRESS 0x60034BF5 /end MEASUREMENT
/begin MEASUREMENT DFC_b.TSC_MD00max "Bit encoding / Ok-Tested Since Clear bit for check DFC_MD00max" UBYTE DFC_OneToOne 1 100 0.00 1.000 BIT_MASK 0x20 FORMAT "%5.3" ECU_ADDRESS 0x60034BF6 /end MEASUREMENT
/begin MEASUREMENT DFC_b.TSC_MDBmax "Bit encoding / Ok-Tested Since Clear bit for check DFC_MDBmax" UBYTE DFC_OneToOne 1 100 0.00 1.000 BIT_MASK 0x20 FORMAT "%5.3" ECU_ADDRESS 0x60034BF7 /end MEASUREMENT
/begin MEASUREMENT DFC_b.TSC_MDCat "Bit encoding / Ok-Tested Since Clear bit for check DFC_MDCat" UBYTE DFC_OneToOne 1 100 0.00 1.000 BIT_MASK 0x20 FORMAT "%5.3" ECU_ADDRESS 0x60034BF8 /end MEASUREMENT
/begin MEASUREMENT DFC_b.TSC_MDCatCrit "Bit encoding / Ok-Tested Since Clear bit for check DFC_MDCatCrit" UBYTE DFC_OneToOne 1 100 0.00 1.000 BIT_MASK 0x20 FORMAT "%5.3" ECU_ADDRESS 0x60034BF9 /end MEASUREMENT
/begin MEASUREMENT DFC_b.TSC_MDCatCurr "Bit encoding / Ok-Tested Since Clear bit for check DFC_MDCatCurr" UBYTE DFC_OneToOne 1 100 0.00 1.000 BIT_MASK 0x20 FORMAT "%5.3" ECU_ADDRESS 0x60034BFA /end MEASUREMENT
/begin MEASUREMENT DFC_b.TSC_MDCyl_0 "Bit encoding / Ok-Tested Since Clear bit for check DFC_MDCyl_0" UBYTE DFC_OneToOne 1 100 0.00 1.000 BIT_MASK 0x20 FORMAT "%5.3" ECU_ADDRESS 0x60034BFB /end MEASUREMENT
/begin MEASUREMENT DFC_b.TSC_MDCyl_1 "Bit encoding / Ok-Tested Since Clear bit for check DFC_MDCyl_1" UBYTE DFC_OneToOne 1 100 0.00 1.000 BIT_MASK 0x20 FORMAT "%5.3" ECU_ADDRESS 0x60034BFC /end MEASUREMENT
/begin MEASUREMENT DFC_b.TSC_MDCyl_2 "Bit encoding / Ok-Tested Since Clear bit for check DFC_MDCyl_2" UBYTE DFC_OneToOne 1 100 0.00 1.000 BIT_MASK 0x20 FORMAT "%5.3" ECU_ADDRESS 0x60034BFD /end MEASUREMENT
/begin MEASUREMENT DFC_b.TSC_MDCyl_3 "Bit encoding / Ok-Tested Since Clear bit for check DFC_MDCyl_3" UBYTE DFC_OneToOne 1 100 0.00 1.000 BIT_MASK 0x20 FORMAT "%5.3" ECU_ADDRESS 0x60034BFE /end MEASUREMENT
/begin MEASUREMENT DFC_b.TSC_MDEmi "Bit encoding / Ok-Tested Since Clear bit for check DFC_MDEmi" UBYTE DFC_OneToOne 1 100 0.00 1.000 BIT_MASK 0x20 FORMAT "%5.3" ECU_ADDRESS 0x60034BFF /end MEASUREMENT
/begin MEASUREMENT DFC_b.TSC_MDEmiStrt "Bit encoding / Ok-Tested Since Clear bit for check DFC_MDEmiStrt" UBYTE DFC_OneToOne 1 100 0.00 1.000 BIT_MASK 0x20 FORMAT "%5.3" ECU_ADDRESS 0x60034C00 /end MEASUREMENT
/begin MEASUREMENT DFC_b.TSC_MDFco "Bit encoding / Ok-Tested Since Clear bit for check DFC_MDFco" UBYTE DFC_OneToOne 1 100 0.00 1.000 BIT_MASK 0x20 FORMAT "%5.3" ECU_ADDRESS 0x60034C01 /end MEASUREMENT
/begin MEASUREMENT DFC_b.TSC_MDMpl "Bit encoding / Ok-Tested Since Clear bit for check DFC_MDMpl" UBYTE DFC_OneToOne 1 100 0.00 1.000 BIT_MASK 0x20 FORMAT "%5.3" ECU_ADDRESS 0x60034C02 /end MEASUREMENT
/begin MEASUREMENT DFC_b.TSC_MDSegTiAdpn "Bit encoding / Ok-Tested Since Clear bit for check DFC_MDSegTiAdpn" UBYTE DFC_OneToOne 1 100 0.00 1.000 BIT_MASK 0x20 FORMAT "%5.3" ECU_ADDRESS 0x60034C03 /end MEASUREMENT
/begin MEASUREMENT DFC_b.TSC_MDmax "Bit encoding / Ok-Tested Since Clear bit for check DFC_MDmax" UBYTE DFC_OneToOne 1 100 0.00 1.000 BIT_MASK 0x20 FORMAT "%5.3" ECU_ADDRESS 0x60034C04 /end MEASUREMENT
/begin MEASUREMENT DFC_b.TSC_MOXEMM_SMU_ALM0_0 "Bit encoding / Ok-Tested Since Clear bit for check DFC_MOXEMM_SMU_ALM0_0" UBYTE DFC_OneToOne 1 100 0.00 1.000 BIT_MASK 0x20 FORMAT "%5.3" ECU_ADDRESS 0x60034C05 /end MEASUREMENT
/begin MEASUREMENT DFC_b.TSC_MOXEMM_SMU_ALM0_1 "Bit encoding / Ok-Tested Since Clear bit for check DFC_MOXEMM_SMU_ALM0_1" UBYTE DFC_OneToOne 1 100 0.00 1.000 BIT_MASK 0x20 FORMAT "%5.3" ECU_ADDRESS 0x60034C06 /end MEASUREMENT
/begin MEASUREMENT DFC_b.TSC_MOXEMM_SMU_ALM0_10 "Bit encoding / Ok-Tested Since Clear bit for check DFC_MOXEMM_SMU_ALM0_10" UBYTE DFC_OneToOne 1 100 0.00 1.000 BIT_MASK 0x20 FORMAT "%5.3" ECU_ADDRESS 0x60034C07 /end MEASUREMENT
/begin MEASUREMENT DFC_b.TSC_MOXEMM_SMU_ALM0_11 "Bit encoding / Ok-Tested Since Clear bit for check DFC_MOXEMM_SMU_ALM0_11" UBYTE DFC_OneToOne 1 100 0.00 1.000 BIT_MASK 0x20 FORMAT "%5.3" ECU_ADDRESS 0x60034C08 /end MEASUREMENT
/begin MEASUREMENT DFC_b.TSC_MOXEMM_SMU_ALM0_13 "Bit encoding / Ok-Tested Since Clear bit for check DFC_MOXEMM_SMU_ALM0_13" UBYTE DFC_OneToOne 1 100 0.00 1.000 BIT_MASK 0x20 FORMAT "%5.3" ECU_ADDRESS 0x60034C09 /end MEASUREMENT
/begin MEASUREMENT DFC_b.TSC_MOXEMM_SMU_ALM0_14 "Bit encoding / Ok-Tested Since Clear bit for check DFC_MOXEMM_SMU_ALM0_14" UBYTE DFC_OneToOne 1 100 0.00 1.000 BIT_MASK 0x20 FORMAT "%5.3" ECU_ADDRESS 0x60034C0A /end MEASUREMENT
/begin MEASUREMENT DFC_b.TSC_MOXEMM_SMU_ALM0_2 "Bit encoding / Ok-Tested Since Clear bit for check DFC_MOXEMM_SMU_ALM0_2" UBYTE DFC_OneToOne 1 100 0.00 1.000 BIT_MASK 0x20 FORMAT "%5.3" ECU_ADDRESS 0x60034C0B /end MEASUREMENT
/begin MEASUREMENT DFC_b.TSC_MOXEMM_SMU_ALM0_22 "Bit encoding / Ok-Tested Since Clear bit for check DFC_MOXEMM_SMU_ALM0_22" UBYTE DFC_OneToOne 1 100 0.00 1.000 BIT_MASK 0x20 FORMAT "%5.3" ECU_ADDRESS 0x60034C0C /end MEASUREMENT
/begin MEASUREMENT DFC_b.TSC_MOXEMM_SMU_ALM0_23 "Bit encoding / Ok-Tested Since Clear bit for check DFC_MOXEMM_SMU_ALM0_23" UBYTE DFC_OneToOne 1 100 0.00 1.000 BIT_MASK 0x20 FORMAT "%5.3" ECU_ADDRESS 0x60034C0D /end MEASUREMENT
/begin MEASUREMENT DFC_b.TSC_MOXEMM_SMU_ALM0_4 "Bit encoding / Ok-Tested Since Clear bit for check DFC_MOXEMM_SMU_ALM0_4" UBYTE DFC_OneToOne 1 100 0.00 1.000 BIT_MASK 0x20 FORMAT "%5.3" ECU_ADDRESS 0x60034C0E /end MEASUREMENT
/begin MEASUREMENT DFC_b.TSC_MOXEMM_SMU_ALM0_5 "Bit encoding / Ok-Tested Since Clear bit for check DFC_MOXEMM_SMU_ALM0_5" UBYTE DFC_OneToOne 1 100 0.00 1.000 BIT_MASK 0x20 FORMAT "%5.3" ECU_ADDRESS 0x60034C0F /end MEASUREMENT
/begin MEASUREMENT DFC_b.TSC_MOXEMM_SMU_ALM0_7 "Bit encoding / Ok-Tested Since Clear bit for check DFC_MOXEMM_SMU_ALM0_7" UBYTE DFC_OneToOne 1 100 0.00 1.000 BIT_MASK 0x20 FORMAT "%5.3" ECU_ADDRESS 0x60034C10 /end MEASUREMENT
/begin MEASUREMENT DFC_b.TSC_MOXEMM_SMU_ALM0_8 "Bit encoding / Ok-Tested Since Clear bit for check DFC_MOXEMM_SMU_ALM0_8" UBYTE DFC_OneToOne 1 100 0.00 1.000 BIT_MASK 0x20 FORMAT "%5.3" ECU_ADDRESS 0x60034C11 /end MEASUREMENT
/begin MEASUREMENT DFC_b.TSC_MOXEMM_SMU_ALM10_16 "Bit encoding / Ok-Tested Since Clear bit for check DFC_MOXEMM_SMU_ALM10_16" UBYTE DFC_OneToOne 1 100 0.00 1.000 BIT_MASK 0x20 FORMAT "%5.3" ECU_ADDRESS 0x60034C12 /end MEASUREMENT
/begin MEASUREMENT DFC_b.TSC_MOXEMM_SMU_ALM10_17 "Bit encoding / Ok-Tested Since Clear bit for check DFC_MOXEMM_SMU_ALM10_17" UBYTE DFC_OneToOne 1 100 0.00 1.000 BIT_MASK 0x20 FORMAT "%5.3" ECU_ADDRESS 0x60034C13 /end MEASUREMENT
/begin MEASUREMENT DFC_b.TSC_MOXEMM_SMU_ALM10_21 "Bit encoding / Ok-Tested Since Clear bit for check DFC_MOXEMM_SMU_ALM10_21" UBYTE DFC_OneToOne 1 100 0.00 1.000 BIT_MASK 0x20 FORMAT "%5.3" ECU_ADDRESS 0x60034C14 /end MEASUREMENT
/begin MEASUREMENT DFC_b.TSC_MOXEMM_SMU_ALM11_0 "Bit encoding / Ok-Tested Since Clear bit for check DFC_MOXEMM_SMU_ALM11_0" UBYTE DFC_OneToOne 1 100 0.00 1.000 BIT_MASK 0x20 FORMAT "%5.3" ECU_ADDRESS 0x60034C15 /end MEASUREMENT
/begin MEASUREMENT DFC_b.TSC_MOXEMM_SMU_ALM11_1 "Bit encoding / Ok-Tested Since Clear bit for check DFC_MOXEMM_SMU_ALM11_1" UBYTE DFC_OneToOne 1 100 0.00 1.000 BIT_MASK 0x20 FORMAT "%5.3" ECU_ADDRESS 0x60034C16 /end MEASUREMENT
/begin MEASUREMENT DFC_b.TSC_MOXEMM_SMU_ALM11_2 "Bit encoding / Ok-Tested Since Clear bit for check DFC_MOXEMM_SMU_ALM11_2" UBYTE DFC_OneToOne 1 100 0.00 1.000 BIT_MASK 0x20 FORMAT "%5.3" ECU_ADDRESS 0x60034C17 /end MEASUREMENT
/begin MEASUREMENT DFC_b.TSC_MOXEMM_SMU_ALM11_3 "Bit encoding / Ok-Tested Since Clear bit for check DFC_MOXEMM_SMU_ALM11_3" UBYTE DFC_OneToOne 1 100 0.00 1.000 BIT_MASK 0x20 FORMAT "%5.3" ECU_ADDRESS 0x60034C18 /end MEASUREMENT
/begin MEASUREMENT DFC_b.TSC_MOXEMM_SMU_ALM11_4 "Bit encoding / Ok-Tested Since Clear bit for check DFC_MOXEMM_SMU_ALM11_4" UBYTE DFC_OneToOne 1 100 0.00 1.000 BIT_MASK 0x20 FORMAT "%5.3" ECU_ADDRESS 0x60034C19 /end MEASUREMENT
/begin MEASUREMENT DFC_b.TSC_MOXEMM_SMU_ALM11_5 "Bit encoding / Ok-Tested Since Clear bit for check DFC_MOXEMM_SMU_ALM11_5" UBYTE DFC_OneToOne 1 100 0.00 1.000 BIT_MASK 0x20 FORMAT "%5.3" ECU_ADDRESS 0x60034C1A /end MEASUREMENT
/begin MEASUREMENT DFC_b.TSC_MOXEMM_SMU_ALM11_8 "Bit encoding / Ok-Tested Since Clear bit for check DFC_MOXEMM_SMU_ALM11_8" UBYTE DFC_OneToOne 1 100 0.00 1.000 BIT_MASK 0x20 FORMAT "%5.3" ECU_ADDRESS 0x60034C1B /end MEASUREMENT
/begin MEASUREMENT DFC_b.TSC_MOXEMM_SMU_ALM11_9 "Bit encoding / Ok-Tested Since Clear bit for check DFC_MOXEMM_SMU_ALM11_9" UBYTE DFC_OneToOne 1 100 0.00 1.000 BIT_MASK 0x20 FORMAT "%5.3" ECU_ADDRESS 0x60034C1C /end MEASUREMENT
/begin MEASUREMENT DFC_b.TSC_MOXEMM_SMU_ALM1_0 "Bit encoding / Ok-Tested Since Clear bit for check DFC_MOXEMM_SMU_ALM1_0" UBYTE DFC_OneToOne 1 100 0.00 1.000 BIT_MASK 0x20 FORMAT "%5.3" ECU_ADDRESS 0x60034C1D /end MEASUREMENT
/begin MEASUREMENT DFC_b.TSC_MOXEMM_SMU_ALM1_1 "Bit encoding / Ok-Tested Since Clear bit for check DFC_MOXEMM_SMU_ALM1_1" UBYTE DFC_OneToOne 1 100 0.00 1.000 BIT_MASK 0x20 FORMAT "%5.3" ECU_ADDRESS 0x60034C1E /end MEASUREMENT
/begin MEASUREMENT DFC_b.TSC_MOXEMM_SMU_ALM1_10 "Bit encoding / Ok-Tested Since Clear bit for check DFC_MOXEMM_SMU_ALM1_10" UBYTE DFC_OneToOne 1 100 0.00 1.000 BIT_MASK 0x20 FORMAT "%5.3" ECU_ADDRESS 0x60034C1F /end MEASUREMENT
/begin MEASUREMENT DFC_b.TSC_MOXEMM_SMU_ALM1_11 "Bit encoding / Ok-Tested Since Clear bit for check DFC_MOXEMM_SMU_ALM1_11" UBYTE DFC_OneToOne 1 100 0.00 1.000 BIT_MASK 0x20 FORMAT "%5.3" ECU_ADDRESS 0x60034C20 /end MEASUREMENT
/begin MEASUREMENT DFC_b.TSC_MOXEMM_SMU_ALM1_13 "Bit encoding / Ok-Tested Since Clear bit for check DFC_MOXEMM_SMU_ALM1_13" UBYTE DFC_OneToOne 1 100 0.00 1.000 BIT_MASK 0x20 FORMAT "%5.3" ECU_ADDRESS 0x60034C21 /end MEASUREMENT
/begin MEASUREMENT DFC_b.TSC_MOXEMM_SMU_ALM1_14 "Bit encoding / Ok-Tested Since Clear bit for check DFC_MOXEMM_SMU_ALM1_14" UBYTE DFC_OneToOne 1 100 0.00 1.000 BIT_MASK 0x20 FORMAT "%5.3" ECU_ADDRESS 0x60034C22 /end MEASUREMENT
/begin MEASUREMENT DFC_b.TSC_MOXEMM_SMU_ALM1_2 "Bit encoding / Ok-Tested Since Clear bit for check DFC_MOXEMM_SMU_ALM1_2" UBYTE DFC_OneToOne 1 100 0.00 1.000 BIT_MASK 0x20 FORMAT "%5.3" ECU_ADDRESS 0x60034C23 /end MEASUREMENT
/begin MEASUREMENT DFC_b.TSC_MOXEMM_SMU_ALM1_22 "Bit encoding / Ok-Tested Since Clear bit for check DFC_MOXEMM_SMU_ALM1_22" UBYTE DFC_OneToOne 1 100 0.00 1.000 BIT_MASK 0x20 FORMAT "%5.3" ECU_ADDRESS 0x60034C24 /end MEASUREMENT
/begin MEASUREMENT DFC_b.TSC_MOXEMM_SMU_ALM1_23 "Bit encoding / Ok-Tested Since Clear bit for check DFC_MOXEMM_SMU_ALM1_23" UBYTE DFC_OneToOne 1 100 0.00 1.000 BIT_MASK 0x20 FORMAT "%5.3" ECU_ADDRESS 0x60034C25 /end MEASUREMENT
/begin MEASUREMENT DFC_b.TSC_MOXEMM_SMU_ALM1_4 "Bit encoding / Ok-Tested Since Clear bit for check DFC_MOXEMM_SMU_ALM1_4" UBYTE DFC_OneToOne 1 100 0.00 1.000 BIT_MASK 0x20 FORMAT "%5.3" ECU_ADDRESS 0x60034C26 /end MEASUREMENT
/begin MEASUREMENT DFC_b.TSC_MOXEMM_SMU_ALM1_5 "Bit encoding / Ok-Tested Since Clear bit for check DFC_MOXEMM_SMU_ALM1_5" UBYTE DFC_OneToOne 1 100 0.00 1.000 BIT_MASK 0x20 FORMAT "%5.3" ECU_ADDRESS 0x60034C27 /end MEASUREMENT
/begin MEASUREMENT DFC_b.TSC_MOXEMM_SMU_ALM1_7 "Bit encoding / Ok-Tested Since Clear bit for check DFC_MOXEMM_SMU_ALM1_7" UBYTE DFC_OneToOne 1 100 0.00 1.000 BIT_MASK 0x20 FORMAT "%5.3" ECU_ADDRESS 0x60034C28 /end MEASUREMENT
/begin MEASUREMENT DFC_b.TSC_MOXEMM_SMU_ALM1_8 "Bit encoding / Ok-Tested Since Clear bit for check DFC_MOXEMM_SMU_ALM1_8" UBYTE DFC_OneToOne 1 100 0.00 1.000 BIT_MASK 0x20 FORMAT "%5.3" ECU_ADDRESS 0x60034C29 /end MEASUREMENT
/begin MEASUREMENT DFC_b.TSC_MOXEMM_SMU_ALM21_0 "Bit encoding / Ok-Tested Since Clear bit for check DFC_MOXEMM_SMU_ALM21_0" UBYTE DFC_OneToOne 1 100 0.00 1.000 BIT_MASK 0x20 FORMAT "%5.3" ECU_ADDRESS 0x60034C2A /end MEASUREMENT
/begin MEASUREMENT DFC_b.TSC_MOXEMM_SMU_ALM21_16 "Bit encoding / Ok-Tested Since Clear bit for check DFC_MOXEMM_SMU_ALM21_16" UBYTE DFC_OneToOne 1 100 0.00 1.000 BIT_MASK 0x20 FORMAT "%5.3" ECU_ADDRESS 0x60034C2B /end MEASUREMENT
/begin MEASUREMENT DFC_b.TSC_MOXEMM_SMU_ALM21_3 "Bit encoding / Ok-Tested Since Clear bit for check DFC_MOXEMM_SMU_ALM21_3" UBYTE DFC_OneToOne 1 100 0.00 1.000 BIT_MASK 0x20 FORMAT "%5.3" ECU_ADDRESS 0x60034C2C /end MEASUREMENT
/begin MEASUREMENT DFC_b.TSC_MOXEMM_SMU_ALM2_1 "Bit encoding / Ok-Tested Since Clear bit for check DFC_MOXEMM_SMU_ALM2_1" UBYTE DFC_OneToOne 1 100 0.00 1.000 BIT_MASK 0x20 FORMAT "%5.3" ECU_ADDRESS 0x60034C2D /end MEASUREMENT
/begin MEASUREMENT DFC_b.TSC_MOXEMM_SMU_ALM2_10 "Bit encoding / Ok-Tested Since Clear bit for check DFC_MOXEMM_SMU_ALM2_10" UBYTE DFC_OneToOne 1 100 0.00 1.000 BIT_MASK 0x20 FORMAT "%5.3" ECU_ADDRESS 0x60034C2E /end MEASUREMENT
/begin MEASUREMENT DFC_b.TSC_MOXEMM_SMU_ALM2_11 "Bit encoding / Ok-Tested Since Clear bit for check DFC_MOXEMM_SMU_ALM2_11" UBYTE DFC_OneToOne 1 100 0.00 1.000 BIT_MASK 0x20 FORMAT "%5.3" ECU_ADDRESS 0x60034C2F /end MEASUREMENT
/begin MEASUREMENT DFC_b.TSC_MOXEMM_SMU_ALM2_13 "Bit encoding / Ok-Tested Since Clear bit for check DFC_MOXEMM_SMU_ALM2_13" UBYTE DFC_OneToOne 1 100 0.00 1.000 BIT_MASK 0x20 FORMAT "%5.3" ECU_ADDRESS 0x60034C30 /end MEASUREMENT
/begin MEASUREMENT DFC_b.TSC_MOXEMM_SMU_ALM2_14 "Bit encoding / Ok-Tested Since Clear bit for check DFC_MOXEMM_SMU_ALM2_14" UBYTE DFC_OneToOne 1 100 0.00 1.000 BIT_MASK 0x20 FORMAT "%5.3" ECU_ADDRESS 0x60034C31 /end MEASUREMENT
/begin MEASUREMENT DFC_b.TSC_MOXEMM_SMU_ALM2_22 "Bit encoding / Ok-Tested Since Clear bit for check DFC_MOXEMM_SMU_ALM2_22" UBYTE DFC_OneToOne 1 100 0.00 1.000 BIT_MASK 0x20 FORMAT "%5.3" ECU_ADDRESS 0x60034C32 /end MEASUREMENT
/begin MEASUREMENT DFC_b.TSC_MOXEMM_SMU_ALM2_23 "Bit encoding / Ok-Tested Since Clear bit for check DFC_MOXEMM_SMU_ALM2_23" UBYTE DFC_OneToOne 1 100 0.00 1.000 BIT_MASK 0x20 FORMAT "%5.3" ECU_ADDRESS 0x60034C33 /end MEASUREMENT
/begin MEASUREMENT DFC_b.TSC_MOXEMM_SMU_ALM2_4 "Bit encoding / Ok-Tested Since Clear bit for check DFC_MOXEMM_SMU_ALM2_4" UBYTE DFC_OneToOne 1 100 0.00 1.000 BIT_MASK 0x20 FORMAT "%5.3" ECU_ADDRESS 0x60034C34 /end MEASUREMENT
/begin MEASUREMENT DFC_b.TSC_MOXEMM_SMU_ALM2_5 "Bit encoding / Ok-Tested Since Clear bit for check DFC_MOXEMM_SMU_ALM2_5" UBYTE DFC_OneToOne 1 100 0.00 1.000 BIT_MASK 0x20 FORMAT "%5.3" ECU_ADDRESS 0x60034C35 /end MEASUREMENT
/begin MEASUREMENT DFC_b.TSC_MOXEMM_SMU_ALM2_7 "Bit encoding / Ok-Tested Since Clear bit for check DFC_MOXEMM_SMU_ALM2_7" UBYTE DFC_OneToOne 1 100 0.00 1.000 BIT_MASK 0x20 FORMAT "%5.3" ECU_ADDRESS 0x60034C36 /end MEASUREMENT
/begin MEASUREMENT DFC_b.TSC_MOXEMM_SMU_ALM2_8 "Bit encoding / Ok-Tested Since Clear bit for check DFC_MOXEMM_SMU_ALM2_8" UBYTE DFC_OneToOne 1 100 0.00 1.000 BIT_MASK 0x20 FORMAT "%5.3" ECU_ADDRESS 0x60034C37 /end MEASUREMENT
/begin MEASUREMENT DFC_b.TSC_MOXEMM_SMU_ALM6_0 "Bit encoding / Ok-Tested Since Clear bit for check DFC_MOXEMM_SMU_ALM6_0" UBYTE DFC_OneToOne 1 100 0.00 1.000 BIT_MASK 0x20 FORMAT "%5.3" ECU_ADDRESS 0x60034C38 /end MEASUREMENT
/begin MEASUREMENT DFC_b.TSC_MOXEMM_SMU_ALM6_11 "Bit encoding / Ok-Tested Since Clear bit for check DFC_MOXEMM_SMU_ALM6_11" UBYTE DFC_OneToOne 1 100 0.00 1.000 BIT_MASK 0x20 FORMAT "%5.3" ECU_ADDRESS 0x60034C39 /end MEASUREMENT
/begin MEASUREMENT DFC_b.TSC_MOXEMM_SMU_ALM6_12 "Bit encoding / Ok-Tested Since Clear bit for check DFC_MOXEMM_SMU_ALM6_12" UBYTE DFC_OneToOne 1 100 0.00 1.000 BIT_MASK 0x20 FORMAT "%5.3" ECU_ADDRESS 0x60034C3A /end MEASUREMENT
/begin MEASUREMENT DFC_b.TSC_MOXEMM_SMU_ALM6_14 "Bit encoding / Ok-Tested Since Clear bit for check DFC_MOXEMM_SMU_ALM6_14" UBYTE DFC_OneToOne 1 100 0.00 1.000 BIT_MASK 0x20 FORMAT "%5.3" ECU_ADDRESS 0x60034C3B /end MEASUREMENT
/begin MEASUREMENT DFC_b.TSC_MOXEMM_SMU_ALM6_15 "Bit encoding / Ok-Tested Since Clear bit for check DFC_MOXEMM_SMU_ALM6_15" UBYTE DFC_OneToOne 1 100 0.00 1.000 BIT_MASK 0x20 FORMAT "%5.3" ECU_ADDRESS 0x60034C3C /end MEASUREMENT
/begin MEASUREMENT DFC_b.TSC_MOXEMM_SMU_ALM6_17 "Bit encoding / Ok-Tested Since Clear bit for check DFC_MOXEMM_SMU_ALM6_17" UBYTE DFC_OneToOne 1 100 0.00 1.000 BIT_MASK 0x20 FORMAT "%5.3" ECU_ADDRESS 0x60034C3D /end MEASUREMENT
/begin MEASUREMENT DFC_b.TSC_MOXEMM_SMU_ALM6_18 "Bit encoding / Ok-Tested Since Clear bit for check DFC_MOXEMM_SMU_ALM6_18" UBYTE DFC_OneToOne 1 100 0.00 1.000 BIT_MASK 0x20 FORMAT "%5.3" ECU_ADDRESS 0x60034C3E /end MEASUREMENT
/begin MEASUREMENT DFC_b.TSC_MOXEMM_SMU_ALM6_20 "Bit encoding / Ok-Tested Since Clear bit for check DFC_MOXEMM_SMU_ALM6_20" UBYTE DFC_OneToOne 1 100 0.00 1.000 BIT_MASK 0x20 FORMAT "%5.3" ECU_ADDRESS 0x60034C3F /end MEASUREMENT
/begin MEASUREMENT DFC_b.TSC_MOXEMM_SMU_ALM6_21 "Bit encoding / Ok-Tested Since Clear bit for check DFC_MOXEMM_SMU_ALM6_21" UBYTE DFC_OneToOne 1 100 0.00 1.000 BIT_MASK 0x20 FORMAT "%5.3" ECU_ADDRESS 0x60034C40 /end MEASUREMENT
/begin MEASUREMENT DFC_b.TSC_MOXEMM_SMU_ALM6_25 "Bit encoding / Ok-Tested Since Clear bit for check DFC_MOXEMM_SMU_ALM6_25" UBYTE DFC_OneToOne 1 100 0.00 1.000 BIT_MASK 0x20 FORMAT "%5.3" ECU_ADDRESS 0x60034C41 /end MEASUREMENT
/begin MEASUREMENT DFC_b.TSC_MOXEMM_SMU_ALM6_4 "Bit encoding / Ok-Tested Since Clear bit for check DFC_MOXEMM_SMU_ALM6_4" UBYTE DFC_OneToOne 1 100 0.00 1.000 BIT_MASK 0x20 FORMAT "%5.3" ECU_ADDRESS 0x60034C42 /end MEASUREMENT
/begin MEASUREMENT DFC_b.TSC_MOXEMM_SMU_ALM6_5 "Bit encoding / Ok-Tested Since Clear bit for check DFC_MOXEMM_SMU_ALM6_5" UBYTE DFC_OneToOne 1 100 0.00 1.000 BIT_MASK 0x20 FORMAT "%5.3" ECU_ADDRESS 0x60034C43 /end MEASUREMENT
/begin MEASUREMENT DFC_b.TSC_MOXEMM_SMU_ALM6_7 "Bit encoding / Ok-Tested Since Clear bit for check DFC_MOXEMM_SMU_ALM6_7" UBYTE DFC_OneToOne 1 100 0.00 1.000 BIT_MASK 0x20 FORMAT "%5.3" ECU_ADDRESS 0x60034C44 /end MEASUREMENT
/begin MEASUREMENT DFC_b.TSC_MOXEMM_SMU_ALM6_8 "Bit encoding / Ok-Tested Since Clear bit for check DFC_MOXEMM_SMU_ALM6_8" UBYTE DFC_OneToOne 1 100 0.00 1.000 BIT_MASK 0x20 FORMAT "%5.3" ECU_ADDRESS 0x60034C45 /end MEASUREMENT
/begin MEASUREMENT DFC_b.TSC_MOXEMM_SMU_ALM7_1 "Bit encoding / Ok-Tested Since Clear bit for check DFC_MOXEMM_SMU_ALM7_1" UBYTE DFC_OneToOne 1 100 0.00 1.000 BIT_MASK 0x20 FORMAT "%5.3" ECU_ADDRESS 0x60034C46 /end MEASUREMENT
/begin MEASUREMENT DFC_b.TSC_MOXEMM_SMU_ALM7_12 "Bit encoding / Ok-Tested Since Clear bit for check DFC_MOXEMM_SMU_ALM7_12" UBYTE DFC_OneToOne 1 100 0.00 1.000 BIT_MASK 0x20 FORMAT "%5.3" ECU_ADDRESS 0x60034C47 /end MEASUREMENT
/begin MEASUREMENT DFC_b.TSC_MOXEMM_SMU_ALM7_13 "Bit encoding / Ok-Tested Since Clear bit for check DFC_MOXEMM_SMU_ALM7_13" UBYTE DFC_OneToOne 1 100 0.00 1.000 BIT_MASK 0x20 FORMAT "%5.3" ECU_ADDRESS 0x60034C48 /end MEASUREMENT
/begin MEASUREMENT DFC_b.TSC_MOXEMM_SMU_ALM7_14 "Bit encoding / Ok-Tested Since Clear bit for check DFC_MOXEMM_SMU_ALM7_14" UBYTE DFC_OneToOne 1 100 0.00 1.000 BIT_MASK 0x20 FORMAT "%5.3" ECU_ADDRESS 0x60034C49 /end MEASUREMENT
/begin MEASUREMENT DFC_b.TSC_MOXEMM_SMU_ALM7_15 "Bit encoding / Ok-Tested Since Clear bit for check DFC_MOXEMM_SMU_ALM7_15" UBYTE DFC_OneToOne 1 100 0.00 1.000 BIT_MASK 0x20 FORMAT "%5.3" ECU_ADDRESS 0x60034C4A /end MEASUREMENT
/begin MEASUREMENT DFC_b.TSC_MOXEMM_SMU_ALM7_16 "Bit encoding / Ok-Tested Since Clear bit for check DFC_MOXEMM_SMU_ALM7_16" UBYTE DFC_OneToOne 1 100 0.00 1.000 BIT_MASK 0x20 FORMAT "%5.3" ECU_ADDRESS 0x60034C4B /end MEASUREMENT
/begin MEASUREMENT DFC_b.TSC_MOXEMM_SMU_ALM7_17 "Bit encoding / Ok-Tested Since Clear bit for check DFC_MOXEMM_SMU_ALM7_17" UBYTE DFC_OneToOne 1 100 0.00 1.000 BIT_MASK 0x20 FORMAT "%5.3" ECU_ADDRESS 0x60034C4C /end MEASUREMENT
/begin MEASUREMENT DFC_b.TSC_MOXEMM_SMU_ALM7_2 "Bit encoding / Ok-Tested Since Clear bit for check DFC_MOXEMM_SMU_ALM7_2" UBYTE DFC_OneToOne 1 100 0.00 1.000 BIT_MASK 0x20 FORMAT "%5.3" ECU_ADDRESS 0x60034C4D /end MEASUREMENT
/begin MEASUREMENT DFC_b.TSC_MOXEMM_SMU_ALM7_20 "Bit encoding / Ok-Tested Since Clear bit for check DFC_MOXEMM_SMU_ALM7_20" UBYTE DFC_OneToOne 1 100 0.00 1.000 BIT_MASK 0x20 FORMAT "%5.3" ECU_ADDRESS 0x60034C4E /end MEASUREMENT
/begin MEASUREMENT DFC_b.TSC_MOXEMM_SMU_ALM7_25 "Bit encoding / Ok-Tested Since Clear bit for check DFC_MOXEMM_SMU_ALM7_25" UBYTE DFC_OneToOne 1 100 0.00 1.000 BIT_MASK 0x20 FORMAT "%5.3" ECU_ADDRESS 0x60034C4F /end MEASUREMENT
/begin MEASUREMENT DFC_b.TSC_MOXEMM_SMU_ALM7_26 "Bit encoding / Ok-Tested Since Clear bit for check DFC_MOXEMM_SMU_ALM7_26" UBYTE DFC_OneToOne 1 100 0.00 1.000 BIT_MASK 0x20 FORMAT "%5.3" ECU_ADDRESS 0x60034C50 /end MEASUREMENT
/begin MEASUREMENT DFC_b.TSC_MOXEMM_SMU_ALM7_28 "Bit encoding / Ok-Tested Since Clear bit for check DFC_MOXEMM_SMU_ALM7_28" UBYTE DFC_OneToOne 1 100 0.00 1.000 BIT_MASK 0x20 FORMAT "%5.3" ECU_ADDRESS 0x60034C51 /end MEASUREMENT
/begin MEASUREMENT DFC_b.TSC_MOXEMM_SMU_ALM7_29 "Bit encoding / Ok-Tested Since Clear bit for check DFC_MOXEMM_SMU_ALM7_29" UBYTE DFC_OneToOne 1 100 0.00 1.000 BIT_MASK 0x20 FORMAT "%5.3" ECU_ADDRESS 0x60034C52 /end MEASUREMENT
/begin MEASUREMENT DFC_b.TSC_MOXEMM_SMU_ALM7_30 "Bit encoding / Ok-Tested Since Clear bit for check DFC_MOXEMM_SMU_ALM7_30" UBYTE DFC_OneToOne 1 100 0.00 1.000 BIT_MASK 0x20 FORMAT "%5.3" ECU_ADDRESS 0x60034C53 /end MEASUREMENT
/begin MEASUREMENT DFC_b.TSC_MOXEMM_SMU_ALM7_31 "Bit encoding / Ok-Tested Since Clear bit for check DFC_MOXEMM_SMU_ALM7_31" UBYTE DFC_OneToOne 1 100 0.00 1.000 BIT_MASK 0x20 FORMAT "%5.3" ECU_ADDRESS 0x60034C54 /end MEASUREMENT
/begin MEASUREMENT DFC_b.TSC_MOXEMM_SMU_ALM8_0 "Bit encoding / Ok-Tested Since Clear bit for check DFC_MOXEMM_SMU_ALM8_0" UBYTE DFC_OneToOne 1 100 0.00 1.000 BIT_MASK 0x20 FORMAT "%5.3" ECU_ADDRESS 0x60034C55 /end MEASUREMENT
/begin MEASUREMENT DFC_b.TSC_MOXEMM_SMU_ALM8_1 "Bit encoding / Ok-Tested Since Clear bit for check DFC_MOXEMM_SMU_ALM8_1" UBYTE DFC_OneToOne 1 100 0.00 1.000 BIT_MASK 0x20 FORMAT "%5.3" ECU_ADDRESS 0x60034C56 /end MEASUREMENT
/begin MEASUREMENT DFC_b.TSC_MOXEMM_SMU_ALM8_10 "Bit encoding / Ok-Tested Since Clear bit for check DFC_MOXEMM_SMU_ALM8_10" UBYTE DFC_OneToOne 1 100 0.00 1.000 BIT_MASK 0x20 FORMAT "%5.3" ECU_ADDRESS 0x60034C57 /end MEASUREMENT
/begin MEASUREMENT DFC_b.TSC_MOXEMM_SMU_ALM8_11 "Bit encoding / Ok-Tested Since Clear bit for check DFC_MOXEMM_SMU_ALM8_11" UBYTE DFC_OneToOne 1 100 0.00 1.000 BIT_MASK 0x20 FORMAT "%5.3" ECU_ADDRESS 0x60034C58 /end MEASUREMENT
/begin MEASUREMENT DFC_b.TSC_MOXEMM_SMU_ALM8_12 "Bit encoding / Ok-Tested Since Clear bit for check DFC_MOXEMM_SMU_ALM8_12" UBYTE DFC_OneToOne 1 100 0.00 1.000 BIT_MASK 0x20 FORMAT "%5.3" ECU_ADDRESS 0x60034C59 /end MEASUREMENT
/begin MEASUREMENT DFC_b.TSC_MOXEMM_SMU_ALM8_16 "Bit encoding / Ok-Tested Since Clear bit for check DFC_MOXEMM_SMU_ALM8_16" UBYTE DFC_OneToOne 1 100 0.00 1.000 BIT_MASK 0x20 FORMAT "%5.3" ECU_ADDRESS 0x60034C5A /end MEASUREMENT
/begin MEASUREMENT DFC_b.TSC_MOXEMM_SMU_ALM8_18 "Bit encoding / Ok-Tested Since Clear bit for check DFC_MOXEMM_SMU_ALM8_18" UBYTE DFC_OneToOne 1 100 0.00 1.000 BIT_MASK 0x20 FORMAT "%5.3" ECU_ADDRESS 0x60034C5B /end MEASUREMENT
/begin MEASUREMENT DFC_b.TSC_MOXEMM_SMU_ALM8_2 "Bit encoding / Ok-Tested Since Clear bit for check DFC_MOXEMM_SMU_ALM8_2" UBYTE DFC_OneToOne 1 100 0.00 1.000 BIT_MASK 0x20 FORMAT "%5.3" ECU_ADDRESS 0x60034C5C /end MEASUREMENT
/begin MEASUREMENT DFC_b.TSC_MOXEMM_SMU_ALM8_3 "Bit encoding / Ok-Tested Since Clear bit for check DFC_MOXEMM_SMU_ALM8_3" UBYTE DFC_OneToOne 1 100 0.00 1.000 BIT_MASK 0x20 FORMAT "%5.3" ECU_ADDRESS 0x60034C5D /end MEASUREMENT
/begin MEASUREMENT DFC_b.TSC_MOXEMM_SMU_ALM8_31 "Bit encoding / Ok-Tested Since Clear bit for check DFC_MOXEMM_SMU_ALM8_31" UBYTE DFC_OneToOne 1 100 0.00 1.000 BIT_MASK 0x20 FORMAT "%5.3" ECU_ADDRESS 0x60034C5E /end MEASUREMENT
/begin MEASUREMENT DFC_b.TSC_MOXEMM_SMU_ALM8_4 "Bit encoding / Ok-Tested Since Clear bit for check DFC_MOXEMM_SMU_ALM8_4" UBYTE DFC_OneToOne 1 100 0.00 1.000 BIT_MASK 0x20 FORMAT "%5.3" ECU_ADDRESS 0x60034C5F /end MEASUREMENT
/begin MEASUREMENT DFC_b.TSC_MOXEMM_SMU_ALM9_0 "Bit encoding / Ok-Tested Since Clear bit for check DFC_MOXEMM_SMU_ALM9_0" UBYTE DFC_OneToOne 1 100 0.00 1.000 BIT_MASK 0x20 FORMAT "%5.3" ECU_ADDRESS 0x60034C60 /end MEASUREMENT
/begin MEASUREMENT DFC_b.TSC_MOXEMM_SMU_ALM9_15 "Bit encoding / Ok-Tested Since Clear bit for check DFC_MOXEMM_SMU_ALM9_15" UBYTE DFC_OneToOne 1 100 0.00 1.000 BIT_MASK 0x20 FORMAT "%5.3" ECU_ADDRESS 0x60034C61 /end MEASUREMENT
/begin MEASUREMENT DFC_b.TSC_MOXEMM_SMU_ALM9_3 "Bit encoding / Ok-Tested Since Clear bit for check DFC_MOXEMM_SMU_ALM9_3" UBYTE DFC_OneToOne 1 100 0.00 1.000 BIT_MASK 0x20 FORMAT "%5.3" ECU_ADDRESS 0x60034C62 /end MEASUREMENT
/begin MEASUREMENT DFC_b.TSC_MoCADCNTP "Bit encoding / Ok-Tested Since Clear bit for check DFC_MoCADCNTP" UBYTE DFC_OneToOne 1 100 0.00 1.000 BIT_MASK 0x20 FORMAT "%5.3" ECU_ADDRESS 0x60034C63 /end MEASUREMENT
/begin MEASUREMENT DFC_b.TSC_MoCADCTst "Bit encoding / Ok-Tested Since Clear bit for check DFC_MoCADCTst" UBYTE DFC_OneToOne 1 100 0.00 1.000 BIT_MASK 0x20 FORMAT "%5.3" ECU_ADDRESS 0x60034C64 /end MEASUREMENT
/begin MEASUREMENT DFC_b.TSC_MoCSOPICO "Bit encoding / Ok-Tested Since Clear bit for check DFC_MoCSOPICO" UBYTE DFC_OneToOne 1 100 0.00 1.000 BIT_MASK 0x20 FORMAT "%5.3" ECU_ADDRESS 0x60034C65 /end MEASUREMENT
/begin MEASUREMENT DFC_b.TSC_MoFAPP "Bit encoding / Ok-Tested Since Clear bit for check DFC_MoFAPP" UBYTE DFC_OneToOne 1 100 0.00 1.000 BIT_MASK 0x20 FORMAT "%5.3" ECU_ADDRESS 0x60034C66 /end MEASUREMENT
/begin MEASUREMENT DFC_b.TSC_MoFAirFilgPrdc "Bit encoding / Ok-Tested Since Clear bit for check DFC_MoFAirFilgPrdc" UBYTE DFC_OneToOne 1 100 0.00 1.000 BIT_MASK 0x20 FORMAT "%5.3" ECU_ADDRESS 0x60034C67 /end MEASUREMENT
/begin MEASUREMENT DFC_b.TSC_MoFAirFlCtOffPfi "Bit encoding / Ok-Tested Since Clear bit for check DFC_MoFAirFlCtOffPfi" UBYTE DFC_OneToOne 1 100 0.00 1.000 BIT_MASK 0x20 FORMAT "%5.3" ECU_ADDRESS 0x60034C68 /end MEASUREMENT
/begin MEASUREMENT DFC_b.TSC_MoFAirFlCylPfi "Bit encoding / Ok-Tested Since Clear bit for check DFC_MoFAirFlCylPfi" UBYTE DFC_OneToOne 1 100 0.00 1.000 BIT_MASK 0x20 FORMAT "%5.3" ECU_ADDRESS 0x60034C69 /end MEASUREMENT
/begin MEASUREMENT DFC_b.TSC_MoFAirFlIn "Bit encoding / Ok-Tested Since Clear bit for check DFC_MoFAirFlIn" UBYTE DFC_OneToOne 1 100 0.00 1.000 BIT_MASK 0x20 FORMAT "%5.3" ECU_ADDRESS 0x60034C6A /end MEASUREMENT
/begin MEASUREMENT DFC_b.TSC_MoFAirFlMixCtlPfiChkAirFl "Bit encoding / Ok-Tested Since Clear bit for check DFC_MoFAirFlMixCtlPfiChkAirFl" UBYTE DFC_OneToOne 1 100 0.00 1.000 BIT_MASK 0x20 FORMAT "%5.3" ECU_ADDRESS 0x60034C6B /end MEASUREMENT
/begin MEASUREMENT DFC_b.TSC_MoFAirFlMixCtlPfiChkCtrl "Bit encoding / Ok-Tested Since Clear bit for check DFC_MoFAirFlMixCtlPfiChkCtrl" UBYTE DFC_OneToOne 1 100 0.00 1.000 BIT_MASK 0x20 FORMAT "%5.3" ECU_ADDRESS 0x60034C6C /end MEASUREMENT
/begin MEASUREMENT DFC_b.TSC_MoFAirFlMode "Bit encoding / Ok-Tested Since Clear bit for check DFC_MoFAirFlMode" UBYTE DFC_OneToOne 1 100 0.00 1.000 BIT_MASK 0x20 FORMAT "%5.3" ECU_ADDRESS 0x60034C6D /end MEASUREMENT
/begin MEASUREMENT DFC_b.TSC_MoFESpd "Bit encoding / Ok-Tested Since Clear bit for check DFC_MoFESpd" UBYTE DFC_OneToOne 1 100 0.00 1.000 BIT_MASK 0x20 FORMAT "%5.3" ECU_ADDRESS 0x60034C6E /end MEASUREMENT
/begin MEASUREMENT DFC_b.TSC_MoFIACo "Bit encoding / Ok-Tested Since Clear bit for check DFC_MoFIACo" UBYTE DFC_OneToOne 1 100 0.00 1.000 BIT_MASK 0x20 FORMAT "%5.3" ECU_ADDRESS 0x60034C6F /end MEASUREMENT
/begin MEASUREMENT DFC_b.TSC_MoFICOL1 "Bit encoding / Ok-Tested Since Clear bit for check DFC_MoFICOL1" UBYTE DFC_OneToOne 1 100 0.00 1.000 BIT_MASK 0x20 FORMAT "%5.3" ECU_ADDRESS 0x60034C70 /end MEASUREMENT
/begin MEASUREMENT DFC_b.TSC_MoFICOL2 "Bit encoding / Ok-Tested Since Clear bit for check DFC_MoFICOL2" UBYTE DFC_OneToOne 1 100 0.00 1.000 BIT_MASK 0x20 FORMAT "%5.3" ECU_ADDRESS 0x60034C71 /end MEASUREMENT
/begin MEASUREMENT DFC_b.TSC_MoFStrt "Bit encoding / Ok-Tested Since Clear bit for check DFC_MoFStrt" UBYTE DFC_OneToOne 1 100 0.00 1.000 BIT_MASK 0x20 FORMAT "%5.3" ECU_ADDRESS 0x60034C72 /end MEASUREMENT
/begin MEASUREMENT DFC_b.TSC_MoFTrqCmp "Bit encoding / Ok-Tested Since Clear bit for check DFC_MoFTrqCmp" UBYTE DFC_OneToOne 1 100 0.00 1.000 BIT_MASK 0x20 FORMAT "%5.3" ECU_ADDRESS 0x60034C73 /end MEASUREMENT
/begin MEASUREMENT DFC_b.TSC_MoFTrqCmpMax "Bit encoding / Ok-Tested Since Clear bit for check DFC_MoFTrqCmpMax" UBYTE DFC_OneToOne 1 100 0.00 1.000 BIT_MASK 0x20 FORMAT "%5.3" ECU_ADDRESS 0x60034C74 /end MEASUREMENT
/begin MEASUREMENT DFC_b.TSC_MoFTrqCmpMin "Bit encoding / Ok-Tested Since Clear bit for check DFC_MoFTrqCmpMin" UBYTE DFC_OneToOne 1 100 0.00 1.000 BIT_MASK 0x20 FORMAT "%5.3" ECU_ADDRESS 0x60034C75 /end MEASUREMENT
/begin MEASUREMENT DFC_b.TSC_MoFVarPostBldSel "Bit encoding / Ok-Tested Since Clear bit for check DFC_MoFVarPostBldSel" UBYTE DFC_OneToOne 1 100 0.00 1.000 BIT_MASK 0x20 FORMAT "%5.3" ECU_ADDRESS 0x60034C76 /end MEASUREMENT
/begin MEASUREMENT DFC_b.TSC_MoXEMMHwLTMCUFW "Bit encoding / Ok-Tested Since Clear bit for check DFC_MoXEMMHwLTMCUFW" UBYTE DFC_OneToOne 1 100 0.00 1.000 BIT_MASK 0x20 FORMAT "%5.3" ECU_ADDRESS 0x60034C77 /end MEASUREMENT
/begin MEASUREMENT DFC_b.TSC_MoXEMMHwLTMonBIST "Bit encoding / Ok-Tested Since Clear bit for check DFC_MoXEMMHwLTMonBIST" UBYTE DFC_OneToOne 1 100 0.00 1.000 BIT_MASK 0x20 FORMAT "%5.3" ECU_ADDRESS 0x60034C78 /end MEASUREMENT
/begin MEASUREMENT DFC_b.TSC_MoXEMMHwLTRegMonTest "Bit encoding / Ok-Tested Since Clear bit for check DFC_MoXEMMHwLTRegMonTest" UBYTE DFC_OneToOne 1 100 0.00 1.000 BIT_MASK 0x20 FORMAT "%5.3" ECU_ADDRESS 0x60034C79 /end MEASUREMENT
/begin MEASUREMENT DFC_b.TSC_MoXEMMHwLTStbySMUAlvTest "Bit encoding / Ok-Tested Since Clear bit for check DFC_MoXEMMHwLTStbySMUAlvTest" UBYTE DFC_OneToOne 1 100 0.00 1.000 BIT_MASK 0x20 FORMAT "%5.3" ECU_ADDRESS 0x60034C7A /end MEASUREMENT
/begin MEASUREMENT DFC_b.TSC_MoXEMMHwLTTempSens "Bit encoding / Ok-Tested Since Clear bit for check DFC_MoXEMMHwLTTempSens" UBYTE DFC_OneToOne 1 100 0.00 1.000 BIT_MASK 0x20 FORMAT "%5.3" ECU_ADDRESS 0x60034C7B /end MEASUREMENT
/begin MEASUREMENT DFC_b.TSC_MoXEMMHwLTUCBCfg "Bit encoding / Ok-Tested Since Clear bit for check DFC_MoXEMMHwLTUCBCfg" UBYTE DFC_OneToOne 1 100 0.00 1.000 BIT_MASK 0x20 FORMAT "%5.3" ECU_ADDRESS 0x60034C7C /end MEASUREMENT
/begin MEASUREMENT DFC_b.TSC_OCWDAABEActv "Bit encoding / Ok-Tested Since Clear bit for check DFC_OCWDAABEActv" UBYTE DFC_OneToOne 1 100 0.00 1.000 BIT_MASK 0x20 FORMAT "%5.3" ECU_ADDRESS 0x60034C7D /end MEASUREMENT
/begin MEASUREMENT DFC_b.TSC_OCWDACom "Bit encoding / Ok-Tested Since Clear bit for check DFC_OCWDACom" UBYTE DFC_OneToOne 1 100 0.00 1.000 BIT_MASK 0x20 FORMAT "%5.3" ECU_ADDRESS 0x60034C7E /end MEASUREMENT
/begin MEASUREMENT DFC_b.TSC_OCWDAErrPin "Bit encoding / Ok-Tested Since Clear bit for check DFC_OCWDAErrPin" UBYTE DFC_OneToOne 1 100 0.00 1.000 BIT_MASK 0x20 FORMAT "%5.3" ECU_ADDRESS 0x60034C7F /end MEASUREMENT
/begin MEASUREMENT DFC_b.TSC_OCWDAOvrVltg "Bit encoding / Ok-Tested Since Clear bit for check DFC_OCWDAOvrVltg" UBYTE DFC_OneToOne 1 100 0.00 1.000 BIT_MASK 0x20 FORMAT "%5.3" ECU_ADDRESS 0x60034C80 /end MEASUREMENT
/begin MEASUREMENT DFC_b.TSC_ORAmax "Bit encoding / Ok-Tested Since Clear bit for check DFC_ORAmax" UBYTE DFC_OneToOne 1 100 0.00 1.000 BIT_MASK 0x20 FORMAT "%5.3" ECU_ADDRESS 0x60034C81 /end MEASUREMENT
/begin MEASUREMENT DFC_b.TSC_ORAmin "Bit encoding / Ok-Tested Since Clear bit for check DFC_ORAmin" UBYTE DFC_OneToOne 1 100 0.00 1.000 BIT_MASK 0x20 FORMAT "%5.3" ECU_ADDRESS 0x60034C82 /end MEASUREMENT
/begin MEASUREMENT DFC_b.TSC_PLLSUmax "Bit encoding / Ok-Tested Since Clear bit for check DFC_PLLSUmax" UBYTE DFC_OneToOne 1 100 0.00 1.000 BIT_MASK 0x20 FORMAT "%5.3" ECU_ADDRESS 0x60034C83 /end MEASUREMENT
/begin MEASUREMENT DFC_b.TSC_PLLSUmin "Bit encoding / Ok-Tested Since Clear bit for check DFC_PLLSUmin" UBYTE DFC_OneToOne 1 100 0.00 1.000 BIT_MASK 0x20 FORMAT "%5.3" ECU_ADDRESS 0x60034C84 /end MEASUREMENT
/begin MEASUREMENT DFC_b.TSC_PSR1max "Bit encoding / Ok-Tested Since Clear bit for check DFC_PSR1max" UBYTE DFC_OneToOne 1 100 0.00 1.000 BIT_MASK 0x20 FORMAT "%5.3" ECU_ADDRESS 0x60034C85 /end MEASUREMENT
/begin MEASUREMENT DFC_b.TSC_PSRBmax "Bit encoding / Ok-Tested Since Clear bit for check DFC_PSRBmax" UBYTE DFC_OneToOne 1 100 0.00 1.000 BIT_MASK 0x20 FORMAT "%5.3" ECU_ADDRESS 0x60034C86 /end MEASUREMENT
/begin MEASUREMENT DFC_b.TSC_PSRBmin "Bit encoding / Ok-Tested Since Clear bit for check DFC_PSRBmin" UBYTE DFC_OneToOne 1 100 0.00 1.000 BIT_MASK 0x20 FORMAT "%5.3" ECU_ADDRESS 0x60034C87 /end MEASUREMENT
/begin MEASUREMENT DFC_b.TSC_PSRPmax "Bit encoding / Ok-Tested Since Clear bit for check DFC_PSRPmax" UBYTE DFC_OneToOne 1 100 0.00 1.000 BIT_MASK 0x20 FORMAT "%5.3" ECU_ADDRESS 0x60034C88 /end MEASUREMENT
/begin MEASUREMENT DFC_b.TSC_PSRPmin "Bit encoding / Ok-Tested Since Clear bit for check DFC_PSRPmin" UBYTE DFC_OneToOne 1 100 0.00 1.000 BIT_MASK 0x20 FORMAT "%5.3" ECU_ADDRESS 0x60034C89 /end MEASUREMENT
/begin MEASUREMENT DFC_b.TSC_PSRPsig "Bit encoding / Ok-Tested Since Clear bit for check DFC_PSRPsig" UBYTE DFC_OneToOne 1 100 0.00 1.000 BIT_MASK 0x20 FORMAT "%5.3" ECU_ADDRESS 0x60034C8A /end MEASUREMENT
/begin MEASUREMENT DFC_b.TSC_PSRmax "Bit encoding / Ok-Tested Since Clear bit for check DFC_PSRmax" UBYTE DFC_OneToOne 1 100 0.00 1.000 BIT_MASK 0x20 FORMAT "%5.3" ECU_ADDRESS 0x60034C8B /end MEASUREMENT
/begin MEASUREMENT DFC_b.TSC_PUmax "Bit encoding / Ok-Tested Since Clear bit for check DFC_PUmax" UBYTE DFC_OneToOne 1 100 0.00 1.000 BIT_MASK 0x20 FORMAT "%5.3" ECU_ADDRESS 0x60034C8C /end MEASUREMENT
/begin MEASUREMENT DFC_b.TSC_P_VSE11_OL "Bit encoding / Ok-Tested Since Clear bit for check DFC_P_VSE11_OL" UBYTE DFC_OneToOne 1 100 0.00 1.000 BIT_MASK 0x20 FORMAT "%5.3" ECU_ADDRESS 0x60034C8D /end MEASUREMENT
/begin MEASUREMENT DFC_b.TSC_P_VSE11_SCB "Bit encoding / Ok-Tested Since Clear bit for check DFC_P_VSE11_SCB" UBYTE DFC_OneToOne 1 100 0.00 1.000 BIT_MASK 0x20 FORMAT "%5.3" ECU_ADDRESS 0x60034C8E /end MEASUREMENT
/begin MEASUREMENT DFC_b.TSC_P_VSE11_SCG "Bit encoding / Ok-Tested Since Clear bit for check DFC_P_VSE11_SCG" UBYTE DFC_OneToOne 1 100 0.00 1.000 BIT_MASK 0x20 FORMAT "%5.3" ECU_ADDRESS 0x60034C8F /end MEASUREMENT
/begin MEASUREMENT DFC_b.TSC_PhyHighAPP1 "Bit encoding / Ok-Tested Since Clear bit for check DFC_PhyHighAPP1" UBYTE DFC_OneToOne 1 100 0.00 1.000 BIT_MASK 0x20 FORMAT "%5.3" ECU_ADDRESS 0x60034C90 /end MEASUREMENT
/begin MEASUREMENT DFC_b.TSC_PhyHighAPP2 "Bit encoding / Ok-Tested Since Clear bit for check DFC_PhyHighAPP2" UBYTE DFC_OneToOne 1 100 0.00 1.000 BIT_MASK 0x20 FORMAT "%5.3" ECU_ADDRESS 0x60034C91 /end MEASUREMENT
/begin MEASUREMENT DFC_b.TSC_PhyLowAPP1 "Bit encoding / Ok-Tested Since Clear bit for check DFC_PhyLowAPP1" UBYTE DFC_OneToOne 1 100 0.00 1.000 BIT_MASK 0x20 FORMAT "%5.3" ECU_ADDRESS 0x60034C92 /end MEASUREMENT
/begin MEASUREMENT DFC_b.TSC_PhyLowAPP2 "Bit encoding / Ok-Tested Since Clear bit for check DFC_PhyLowAPP2" UBYTE DFC_OneToOne 1 100 0.00 1.000 BIT_MASK 0x20 FORMAT "%5.3" ECU_ADDRESS 0x60034C93 /end MEASUREMENT
/begin MEASUREMENT DFC_b.TSC_SRCHighAPP1 "Bit encoding / Ok-Tested Since Clear bit for check DFC_SRCHighAPP1" UBYTE DFC_OneToOne 1 100 0.00 1.000 BIT_MASK 0x20 FORMAT "%5.3" ECU_ADDRESS 0x60034C94 /end MEASUREMENT
/begin MEASUREMENT DFC_b.TSC_SRCHighAPP2 "Bit encoding / Ok-Tested Since Clear bit for check DFC_SRCHighAPP2" UBYTE DFC_OneToOne 1 100 0.00 1.000 BIT_MASK 0x20 FORMAT "%5.3" ECU_ADDRESS 0x60034C95 /end MEASUREMENT
/begin MEASUREMENT DFC_b.TSC_SRCLowAPP1 "Bit encoding / Ok-Tested Since Clear bit for check DFC_SRCLowAPP1" UBYTE DFC_OneToOne 1 100 0.00 1.000 BIT_MASK 0x20 FORMAT "%5.3" ECU_ADDRESS 0x60034C96 /end MEASUREMENT
/begin MEASUREMENT DFC_b.TSC_SRCLowAPP2 "Bit encoding / Ok-Tested Since Clear bit for check DFC_SRCLowAPP2" UBYTE DFC_OneToOne 1 100 0.00 1.000 BIT_MASK 0x20 FORMAT "%5.3" ECU_ADDRESS 0x60034C97 /end MEASUREMENT
/begin MEASUREMENT DFC_b.TSC_SSpMon2 "Bit encoding / Ok-Tested Since Clear bit for check DFC_SSpMon2" UBYTE DFC_OneToOne 1 100 0.00 1.000 BIT_MASK 0x20 FORMAT "%5.3" ECU_ADDRESS 0x60034C98 /end MEASUREMENT
/begin MEASUREMENT DFC_b.TSC_SWReset_0 "Bit encoding / Ok-Tested Since Clear bit for check DFC_SWReset_0" UBYTE DFC_OneToOne 1 100 0.00 1.000 BIT_MASK 0x20 FORMAT "%5.3" ECU_ADDRESS 0x60034C99 /end MEASUREMENT
/begin MEASUREMENT DFC_b.TSC_SWReset_1 "Bit encoding / Ok-Tested Since Clear bit for check DFC_SWReset_1" UBYTE DFC_OneToOne 1 100 0.00 1.000 BIT_MASK 0x20 FORMAT "%5.3" ECU_ADDRESS 0x60034C9A /end MEASUREMENT
/begin MEASUREMENT DFC_b.TSC_SWReset_2 "Bit encoding / Ok-Tested Since Clear bit for check DFC_SWReset_2" UBYTE DFC_OneToOne 1 100 0.00 1.000 BIT_MASK 0x20 FORMAT "%5.3" ECU_ADDRESS 0x60034C9B /end MEASUREMENT
/begin MEASUREMENT DFC_b.TSC_SyncAPP "Bit encoding / Ok-Tested Since Clear bit for check DFC_SyncAPP" UBYTE DFC_OneToOne 1 100 0.00 1.000 BIT_MASK 0x20 FORMAT "%5.3" ECU_ADDRESS 0x60034C9C /end MEASUREMENT
/begin MEASUREMENT DFC_b.TSC_TAmax_Dummy "Bit encoding / Ok-Tested Since Clear bit for check DFC_TAmax_Dummy" UBYTE DFC_OneToOne 1 100 0.00 1.000 BIT_MASK 0x20 FORMAT "%5.3" ECU_ADDRESS 0x60034C9D /end MEASUREMENT
/begin MEASUREMENT DFC_b.TSC_TKAEmax "Bit encoding / Ok-Tested Since Clear bit for check DFC_TKAEmax" UBYTE DFC_OneToOne 1 100 0.00 1.000 BIT_MASK 0x20 FORMAT "%5.3" ECU_ADDRESS 0x60034C9E /end MEASUREMENT
/begin MEASUREMENT DFC_b.TSC_TKAEmin "Bit encoding / Ok-Tested Since Clear bit for check DFC_TKAEmin" UBYTE DFC_OneToOne 1 100 0.00 1.000 BIT_MASK 0x20 FORMAT "%5.3" ECU_ADDRESS 0x60034C9F /end MEASUREMENT
/begin MEASUREMENT DFC_b.TSC_TKARmax "Bit encoding / Ok-Tested Since Clear bit for check DFC_TKARmax" UBYTE DFC_OneToOne 1 100 0.00 1.000 BIT_MASK 0x20 FORMAT "%5.3" ECU_ADDRESS 0x60034CA0 /end MEASUREMENT
/begin MEASUREMENT DFC_b.TSC_TKARnpl "Bit encoding / Ok-Tested Since Clear bit for check DFC_TKARnpl" UBYTE DFC_OneToOne 1 100 0.00 1.000 BIT_MASK 0x20 FORMAT "%5.3" ECU_ADDRESS 0x60034CA1 /end MEASUREMENT
/begin MEASUREMENT DFC_b.TSC_TMmax_Dummy "Bit encoding / Ok-Tested Since Clear bit for check DFC_TMmax_Dummy" UBYTE DFC_OneToOne 1 100 0.00 1.000 BIT_MASK 0x20 FORMAT "%5.3" ECU_ADDRESS 0x60034CA2 /end MEASUREMENT
/begin MEASUREMENT DFC_b.TSC_TUMmax_Dummy "Bit encoding / Ok-Tested Since Clear bit for check DFC_TUMmax_Dummy" UBYTE DFC_OneToOne 1 100 0.00 1.000 BIT_MASK 0x20 FORMAT "%5.3" ECU_ADDRESS 0x60034CA3 /end MEASUREMENT
/begin MEASUREMENT DFC_b.TSC_TWCDPriCatB1 "Bit encoding / Ok-Tested Since Clear bit for check DFC_TWCDPriCatB1" UBYTE DFC_OneToOne 1 100 0.00 1.000 BIT_MASK 0x20 FORMAT "%5.3" ECU_ADDRESS 0x60034CA4 /end MEASUREMENT
/begin MEASUREMENT DFC_b.TSC_ThrVlvClsdPosnFirstOffsLrnImpoB1 "Bit encoding / Ok-Tested Since Clear bit for check DFC_ThrVlvClsdPosnFirstOffsLrnImpoB1" UBYTE DFC_OneToOne 1 100 0.00 1.000 BIT_MASK 0x20 FORMAT "%5.3" ECU_ADDRESS 0x60034CA5 /end MEASUREMENT
/begin MEASUREMENT DFC_b.TSC_ThrVlvClsdPosnOffsLrnImpoB1 "Bit encoding / Ok-Tested Since Clear bit for check DFC_ThrVlvClsdPosnOffsLrnImpoB1" UBYTE DFC_OneToOne 1 100 0.00 1.000 BIT_MASK 0x20 FORMAT "%5.3" ECU_ADDRESS 0x60034CA6 /end MEASUREMENT
/begin MEASUREMENT DFC_b.TSC_ThrVlvClsdPosnOffsLrnMaxB1 "Bit encoding / Ok-Tested Since Clear bit for check DFC_ThrVlvClsdPosnOffsLrnMaxB1" UBYTE DFC_OneToOne 1 100 0.00 1.000 BIT_MASK 0x20 FORMAT "%5.3" ECU_ADDRESS 0x60034CA7 /end MEASUREMENT
/begin MEASUREMENT DFC_b.TSC_ThrVlvClsdPosnOffsLrnMinB1 "Bit encoding / Ok-Tested Since Clear bit for check DFC_ThrVlvClsdPosnOffsLrnMinB1" UBYTE DFC_OneToOne 1 100 0.00 1.000 BIT_MASK 0x20 FORMAT "%5.3" ECU_ADDRESS 0x60034CA8 /end MEASUREMENT
/begin MEASUREMENT DFC_b.TSC_ThrVlvCtrlDeB1 "Bit encoding / Ok-Tested Since Clear bit for check DFC_ThrVlvCtrlDeB1" UBYTE DFC_OneToOne 1 100 0.00 1.000 BIT_MASK 0x20 FORMAT "%5.3" ECU_ADDRESS 0x60034CA9 /end MEASUREMENT
/begin MEASUREMENT DFC_b.TSC_ThrVlvDycB1 "Bit encoding / Ok-Tested Since Clear bit for check DFC_ThrVlvDycB1" UBYTE DFC_OneToOne 1 100 0.00 1.000 BIT_MASK 0x20 FORMAT "%5.3" ECU_ADDRESS 0x60034CAA /end MEASUREMENT
/begin MEASUREMENT DFC_b.TSC_ThrVlvLimpAirPosnMaxAbsltDriftB1 "Bit encoding / Ok-Tested Since Clear bit for check DFC_ThrVlvLimpAirPosnMaxAbsltDriftB1" UBYTE DFC_OneToOne 1 100 0.00 1.000 BIT_MASK 0x20 FORMAT "%5.3" ECU_ADDRESS 0x60034CAB /end MEASUREMENT
/begin MEASUREMENT DFC_b.TSC_ThrVlvLimpAirPosnMaxB1 "Bit encoding / Ok-Tested Since Clear bit for check DFC_ThrVlvLimpAirPosnMaxB1" UBYTE DFC_OneToOne 1 100 0.00 1.000 BIT_MASK 0x20 FORMAT "%5.3" ECU_ADDRESS 0x60034CAC /end MEASUREMENT
/begin MEASUREMENT DFC_b.TSC_ThrVlvLimpAirPosnMaxRelDriftB1 "Bit encoding / Ok-Tested Since Clear bit for check DFC_ThrVlvLimpAirPosnMaxRelDriftB1" UBYTE DFC_OneToOne 1 100 0.00 1.000 BIT_MASK 0x20 FORMAT "%5.3" ECU_ADDRESS 0x60034CAD /end MEASUREMENT
/begin MEASUREMENT DFC_b.TSC_ThrVlvLimpAirPosnMinB1 "Bit encoding / Ok-Tested Since Clear bit for check DFC_ThrVlvLimpAirPosnMinB1" UBYTE DFC_OneToOne 1 100 0.00 1.000 BIT_MASK 0x20 FORMAT "%5.3" ECU_ADDRESS 0x60034CAE /end MEASUREMENT
/begin MEASUREMENT DFC_b.TSC_ThrVlvOpenLoadB1 "Bit encoding / Ok-Tested Since Clear bit for check DFC_ThrVlvOpenLoadB1" UBYTE DFC_OneToOne 1 100 0.00 1.000 BIT_MASK 0x20 FORMAT "%5.3" ECU_ADDRESS 0x60034CAF /end MEASUREMENT
/begin MEASUREMENT DFC_b.TSC_ThrVlvOpenSprgB1 "Bit encoding / Ok-Tested Since Clear bit for check DFC_ThrVlvOpenSprgB1" UBYTE DFC_OneToOne 1 100 0.00 1.000 BIT_MASK 0x20 FORMAT "%5.3" ECU_ADDRESS 0x60034CB0 /end MEASUREMENT
/begin MEASUREMENT DFC_b.TSC_ThrVlvOpenSprgSprdB1 "Bit encoding / Ok-Tested Since Clear bit for check DFC_ThrVlvOpenSprgSprdB1" UBYTE DFC_OneToOne 1 100 0.00 1.000 BIT_MASK 0x20 FORMAT "%5.3" ECU_ADDRESS 0x60034CB1 /end MEASUREMENT
/begin MEASUREMENT DFC_b.TSC_ThrVlvOpenSprgTwnB1 "Bit encoding / Ok-Tested Since Clear bit for check DFC_ThrVlvOpenSprgTwnB1" UBYTE DFC_OneToOne 1 100 0.00 1.000 BIT_MASK 0x20 FORMAT "%5.3" ECU_ADDRESS 0x60034CB2 /end MEASUREMENT
/begin MEASUREMENT DFC_b.TSC_ThrVlvOverTB1 "Bit encoding / Ok-Tested Since Clear bit for check DFC_ThrVlvOverTB1" UBYTE DFC_OneToOne 1 100 0.00 1.000 BIT_MASK 0x20 FORMAT "%5.3" ECU_ADDRESS 0x60034CB3 /end MEASUREMENT
/begin MEASUREMENT DFC_b.TSC_ThrVlvRetSprgB1 "Bit encoding / Ok-Tested Since Clear bit for check DFC_ThrVlvRetSprgB1" UBYTE DFC_OneToOne 1 100 0.00 1.000 BIT_MASK 0x20 FORMAT "%5.3" ECU_ADDRESS 0x60034CB4 /end MEASUREMENT
/begin MEASUREMENT DFC_b.TSC_ThrVlvRetSprgSprdB1 "Bit encoding / Ok-Tested Since Clear bit for check DFC_ThrVlvRetSprgSprdB1" UBYTE DFC_OneToOne 1 100 0.00 1.000 BIT_MASK 0x20 FORMAT "%5.3" ECU_ADDRESS 0x60034CB5 /end MEASUREMENT
/begin MEASUREMENT DFC_b.TSC_ThrVlvRetSprgTwnB1 "Bit encoding / Ok-Tested Since Clear bit for check DFC_ThrVlvRetSprgTwnB1" UBYTE DFC_OneToOne 1 100 0.00 1.000 BIT_MASK 0x20 FORMAT "%5.3" ECU_ADDRESS 0x60034CB6 /end MEASUREMENT
/begin MEASUREMENT DFC_b.TSC_ThrVlvSens1MaxB1 "Bit encoding / Ok-Tested Since Clear bit for check DFC_ThrVlvSens1MaxB1" UBYTE DFC_OneToOne 1 100 0.00 1.000 BIT_MASK 0x20 FORMAT "%5.3" ECU_ADDRESS 0x60034CB7 /end MEASUREMENT
/begin MEASUREMENT DFC_b.TSC_ThrVlvSens1NplB1 "Bit encoding / Ok-Tested Since Clear bit for check DFC_ThrVlvSens1NplB1" UBYTE DFC_OneToOne 1 100 0.00 1.000 BIT_MASK 0x20 FORMAT "%5.3" ECU_ADDRESS 0x60034CB8 /end MEASUREMENT
/begin MEASUREMENT DFC_b.TSC_ThrVlvSens2MaxB1 "Bit encoding / Ok-Tested Since Clear bit for check DFC_ThrVlvSens2MaxB1" UBYTE DFC_OneToOne 1 100 0.00 1.000 BIT_MASK 0x20 FORMAT "%5.3" ECU_ADDRESS 0x60034CB9 /end MEASUREMENT
/begin MEASUREMENT DFC_b.TSC_ThrVlvSens2MinB1 "Bit encoding / Ok-Tested Since Clear bit for check DFC_ThrVlvSens2MinB1" UBYTE DFC_OneToOne 1 100 0.00 1.000 BIT_MASK 0x20 FORMAT "%5.3" ECU_ADDRESS 0x60034CBA /end MEASUREMENT
/begin MEASUREMENT DFC_b.TSC_ThrVlvSens2NplB1 "Bit encoding / Ok-Tested Since Clear bit for check DFC_ThrVlvSens2NplB1" UBYTE DFC_OneToOne 1 100 0.00 1.000 BIT_MASK 0x20 FORMAT "%5.3" ECU_ADDRESS 0x60034CBB /end MEASUREMENT
/begin MEASUREMENT DFC_b.TSC_ThrVlvShoCircB1 "Bit encoding / Ok-Tested Since Clear bit for check DFC_ThrVlvShoCircB1" UBYTE DFC_OneToOne 1 100 0.00 1.000 BIT_MASK 0x20 FORMAT "%5.3" ECU_ADDRESS 0x60034CBC /end MEASUREMENT
/begin MEASUREMENT DFC_b.TSC_ThrVlvSpiErrB1 "Bit encoding / Ok-Tested Since Clear bit for check DFC_ThrVlvSpiErrB1" UBYTE DFC_OneToOne 1 100 0.00 1.000 BIT_MASK 0x20 FORMAT "%5.3" ECU_ADDRESS 0x60034CBD /end MEASUREMENT
/begin MEASUREMENT DFC_b.TSC_ThrvlvSens1MinB1 "Bit encoding / Ok-Tested Since Clear bit for check DFC_ThrvlvSens1MinB1" UBYTE DFC_OneToOne 1 100 0.00 1.000 BIT_MASK 0x20 FORMAT "%5.3" ECU_ADDRESS 0x60034CBE /end MEASUREMENT
/begin MEASUREMENT DFC_b.TSC_TiOffTBasdChkFast "Bit encoding / Ok-Tested Since Clear bit for check DFC_TiOffTBasdChkFast" UBYTE DFC_OneToOne 1 100 0.00 1.000 BIT_MASK 0x20 FORMAT "%5.3" ECU_ADDRESS 0x60034CBF /end MEASUREMENT
/begin MEASUREMENT DFC_b.TSC_TiOffTBasdChkSlow "Bit encoding / Ok-Tested Since Clear bit for check DFC_TiOffTBasdChkSlow" UBYTE DFC_OneToOne 1 100 0.00 1.000 BIT_MASK 0x20 FORMAT "%5.3" ECU_ADDRESS 0x60034CC0 /end MEASUREMENT
/begin MEASUREMENT DFC_b.TSC_UEGOHeatrCtlS1B1 "Bit encoding / Ok-Tested Since Clear bit for check DFC_UEGOHeatrCtlS1B1" UBYTE DFC_OneToOne 1 100 0.00 1.000 BIT_MASK 0x20 FORMAT "%5.3" ECU_ADDRESS 0x60034CC1 /end MEASUREMENT
/begin MEASUREMENT DFC_b.TSC_UEGOSnsrMntdS1B1 "Bit encoding / Ok-Tested Since Clear bit for check DFC_UEGOSnsrMntdS1B1" UBYTE DFC_OneToOne 1 100 0.00 1.000 BIT_MASK 0x20 FORMAT "%5.3" ECU_ADDRESS 0x60034CC2 /end MEASUREMENT
/begin MEASUREMENT DFC_b.TSC_VehVSig "Bit encoding / Ok-Tested Since Clear bit for check DFC_VehVSig" UBYTE DFC_OneToOne 1 100 0.00 1.000 BIT_MASK 0x20 FORMAT "%5.3" ECU_ADDRESS 0x60034CC3 /end MEASUREMENT
/begin MEASUREMENT DFC_b.TSC_VlvLftFbSwtIntk11SpclFail "Bit encoding / Ok-Tested Since Clear bit for check DFC_VlvLftFbSwtIntk11SpclFail" UBYTE DFC_OneToOne 1 100 0.00 1.000 BIT_MASK 0x20 FORMAT "%5.3" ECU_ADDRESS 0x60034CC4 /end MEASUREMENT
/begin MEASUREMENT DFC_b.TSC_VlvLftFbSwtIntk11StdFail "Bit encoding / Ok-Tested Since Clear bit for check DFC_VlvLftFbSwtIntk11StdFail" UBYTE DFC_OneToOne 1 100 0.00 1.000 BIT_MASK 0x20 FORMAT "%5.3" ECU_ADDRESS 0x60034CC5 /end MEASUREMENT
/begin MEASUREMENT DFC_st.DFC_Unused "Status of DFC / " UBYTE DFC_OneToOne 1 100 0.00 255.0 FORMAT "%5.1" ECU_ADDRESS 0x60034A06 /end MEASUREMENT
/begin MEASUREMENT DFC_st.DFC_AltIOACGFailr "Status of DFC / Status of diagnostic fault check DFC_AltIOACGFailr" UBYTE DFC_OneToOne 1 100 0.00 255.0 FORMAT "%5.1" ECU_ADDRESS 0x60034A07 /end MEASUREMENT
/begin MEASUREMENT DFC_st.DFC_AltIOACGHiVltg "Status of DFC / Status of diagnostic fault check DFC_AltIOACGHiVltg" UBYTE DFC_OneToOne 1 100 0.00 255.0 FORMAT "%5.1" ECU_ADDRESS 0x60034A08 /end MEASUREMENT
/begin MEASUREMENT DFC_st.DFC_AltIOACGLoVltg "Status of DFC / Status of diagnostic fault check DFC_AltIOACGLoVltg" UBYTE DFC_OneToOne 1 100 0.00 255.0 FORMAT "%5.1" ECU_ADDRESS 0x60034A09 /end MEASUREMENT
/begin MEASUREMENT DFC_st.DFC_AltIOACGTHi "Status of DFC / Status of diagnostic fault check DFC_AltIOACGTHi" UBYTE DFC_OneToOne 1 100 0.00 255.0 FORMAT "%5.1" ECU_ADDRESS 0x60034A0A /end MEASUREMENT
/begin MEASUREMENT DFC_st.DFC_AltIODConnACG "Status of DFC / Status of diagnostic fault check DFC_AltIODConnACG" UBYTE DFC_OneToOne 1 100 0.00 255.0 FORMAT "%5.1" ECU_ADDRESS 0x60034A0B /end MEASUREMENT
/begin MEASUREMENT DFC_st.DFC_BattUHiFailr "Status of DFC / Status of diagnostic fault check DFC_BattUHiFailr" UBYTE DFC_OneToOne 1 100 0.00 255.0 FORMAT "%5.1" ECU_ADDRESS 0x60034A0C /end MEASUREMENT
/begin MEASUREMENT DFC_st.DFC_BattULoFailr "Status of DFC / Status of diagnostic fault check DFC_BattULoFailr" UBYTE DFC_OneToOne 1 100 0.00 255.0 FORMAT "%5.1" ECU_ADDRESS 0x60034A0D /end MEASUREMENT
/begin MEASUREMENT DFC_st.DFC_BrkBstPDriftHiErr "Status of DFC / Status of diagnostic fault check DFC_BrkBstPDriftHiErr" UBYTE DFC_OneToOne 1 100 0.00 255.0 FORMAT "%5.1" ECU_ADDRESS 0x60034A0E /end MEASUREMENT
/begin MEASUREMENT DFC_st.DFC_BrkBstPDriftLoErr "Status of DFC / Status of diagnostic fault check DFC_BrkBstPDriftLoErr" UBYTE DFC_OneToOne 1 100 0.00 255.0 FORMAT "%5.1" ECU_ADDRESS 0x60034A0F /end MEASUREMENT
/begin MEASUREMENT DFC_st.DFC_BrkBstPSnsrStuck "Status of DFC / Status of diagnostic fault check DFC_BrkBstPSnsrStuck" UBYTE DFC_OneToOne 1 100 0.00 255.0 FORMAT "%5.1" ECU_ADDRESS 0x60034A10 /end MEASUREMENT
/begin MEASUREMENT DFC_st.DFC_BrkMnSwtContOn "Status of DFC / Status of diagnostic fault check DFC_BrkMnSwtContOn" UBYTE DFC_OneToOne 1 100 0.00 255.0 FORMAT "%5.1" ECU_ADDRESS 0x60034A11 /end MEASUREMENT
/begin MEASUREMENT DFC_st.DFC_BrkMnSwtNotStp "Status of DFC / Status of diagnostic fault check DFC_BrkMnSwtNotStp" UBYTE DFC_OneToOne 1 100 0.00 255.0 FORMAT "%5.1" ECU_ADDRESS 0x60034A12 /end MEASUREMENT
/begin MEASUREMENT DFC_st.DFC_BrkNpl "Status of DFC / Status of diagnostic fault check DFC_BrkNpl" UBYTE DFC_OneToOne 1 100 0.00 255.0 FORMAT "%5.1" ECU_ADDRESS 0x60034A13 /end MEASUREMENT
/begin MEASUREMENT DFC_st.DFC_BrkRdntSwtContOn "Status of DFC / Status of diagnostic fault check DFC_BrkRdntSwtContOn" UBYTE DFC_OneToOne 1 100 0.00 255.0 FORMAT "%5.1" ECU_ADDRESS 0x60034A14 /end MEASUREMENT
/begin MEASUREMENT DFC_st.DFC_BrkRdntSwtNotStp "Status of DFC / Status of diagnostic fault check DFC_BrkRdntSwtNotStp" UBYTE DFC_OneToOne 1 100 0.00 255.0 FORMAT "%5.1" ECU_ADDRESS 0x60034A15 /end MEASUREMENT
/begin MEASUREMENT DFC_st.DFC_Clth3ONStuck "Status of DFC / Status of diagnostic fault check DFC_Clth3ONStuck" UBYTE DFC_OneToOne 1 100 0.00 255.0 FORMAT "%5.1" ECU_ADDRESS 0x60034A16 /end MEASUREMENT
/begin MEASUREMENT DFC_st.DFC_Clth4OFFStuck "Status of DFC / Status of diagnostic fault check DFC_Clth4OFFStuck" UBYTE DFC_OneToOne 1 100 0.00 255.0 FORMAT "%5.1" ECU_ADDRESS 0x60034A17 /end MEASUREMENT
/begin MEASUREMENT DFC_st.DFC_ClthOFFStuck "Status of DFC / Status of diagnostic fault check DFC_ClthOFFStuck" UBYTE DFC_OneToOne 1 100 0.00 255.0 FORMAT "%5.1" ECU_ADDRESS 0x60034A18 /end MEASUREMENT
/begin MEASUREMENT DFC_st.DFC_ClthONStuck "Status of DFC / Status of diagnostic fault check DFC_ClthONStuck" UBYTE DFC_OneToOne 1 100 0.00 255.0 FORMAT "%5.1" ECU_ADDRESS 0x60034A19 /end MEASUREMENT
/begin MEASUREMENT DFC_st.DFC_ClthStkFailInfo "Status of DFC / Status of diagnostic fault check DFC_ClthStkFailInfo" UBYTE DFC_OneToOne 1 100 0.00 255.0 FORMAT "%5.1" ECU_ADDRESS 0x60034A1A /end MEASUREMENT
/begin MEASUREMENT DFC_st.DFC_ComACFailInfo "Status of DFC / Status of diagnostic fault check DFC_ComACFailInfo" UBYTE DFC_OneToOne 1 100 0.00 255.0 FORMAT "%5.1" ECU_ADDRESS 0x60034A1B /end MEASUREMENT
/begin MEASUREMENT DFC_st.DFC_ComATFTValErr "Status of DFC / Status of diagnostic fault check DFC_ComATFTValErr" UBYTE DFC_OneToOne 1 100 0.00 255.0 FORMAT "%5.1" ECU_ADDRESS 0x60034A1C /end MEASUREMENT
/begin MEASUREMENT DFC_st.DFC_ComATMILReq "Status of DFC / Status of diagnostic fault check DFC_ComATMILReq" UBYTE DFC_OneToOne 1 100 0.00 255.0 FORMAT "%5.1" ECU_ADDRESS 0x60034A1D /end MEASUREMENT
/begin MEASUREMENT DFC_st.DFC_ComAYCAChksum "Status of DFC / Status of diagnostic fault check DFC_ComAYCAChksum" UBYTE DFC_OneToOne 1 100 0.00 255.0 FORMAT "%5.1" ECU_ADDRESS 0x60034A1E /end MEASUREMENT
/begin MEASUREMENT DFC_st.DFC_ComAYCARingCnt "Status of DFC / Status of diagnostic fault check DFC_ComAYCARingCnt" UBYTE DFC_OneToOne 1 100 0.00 255.0 FORMAT "%5.1" ECU_ADDRESS 0x60034A1F /end MEASUREMENT
/begin MEASUREMENT DFC_st.DFC_ComAYCATOut "Status of DFC / Status of diagnostic fault check DFC_ComAYCATOut" UBYTE DFC_OneToOne 1 100 0.00 255.0 FORMAT "%5.1" ECU_ADDRESS 0x60034A20 /end MEASUREMENT
/begin MEASUREMENT DFC_st.DFC_ComAYCDChkSum "Status of DFC / Status of diagnostic fault check DFC_ComAYCDChkSum" UBYTE DFC_OneToOne 1 100 0.00 255.0 FORMAT "%5.1" ECU_ADDRESS 0x60034A21 /end MEASUREMENT
/begin MEASUREMENT DFC_st.DFC_ComAYCDTOut "Status of DFC / Status of diagnostic fault check DFC_ComAYCDTOut" UBYTE DFC_OneToOne 1 100 0.00 255.0 FORMAT "%5.1" ECU_ADDRESS 0x60034A22 /end MEASUREMENT
/begin MEASUREMENT DFC_st.DFC_ComAYCFChksum "Status of DFC / Status of diagnostic fault check DFC_ComAYCFChksum" UBYTE DFC_OneToOne 1 100 0.00 255.0 FORMAT "%5.1" ECU_ADDRESS 0x60034A23 /end MEASUREMENT
/begin MEASUREMENT DFC_st.DFC_ComAYCFRingCnt "Status of DFC / Status of diagnostic fault check DFC_ComAYCFRingCnt" UBYTE DFC_OneToOne 1 100 0.00 255.0 FORMAT "%5.1" ECU_ADDRESS 0x60034A24 /end MEASUREMENT
/begin MEASUREMENT DFC_st.DFC_ComAYCFTOut "Status of DFC / Status of diagnostic fault check DFC_ComAYCFTOut" UBYTE DFC_OneToOne 1 100 0.00 255.0 FORMAT "%5.1" ECU_ADDRESS 0x60034A25 /end MEASUREMENT
/begin MEASUREMENT DFC_st.DFC_ComAYCGChksum "Status of DFC / Status of diagnostic fault check DFC_ComAYCGChksum" UBYTE DFC_OneToOne 1 100 0.00 255.0 FORMAT "%5.1" ECU_ADDRESS 0x60034A26 /end MEASUREMENT
/begin MEASUREMENT DFC_st.DFC_ComAYCGRingCnt "Status of DFC / Status of diagnostic fault check DFC_ComAYCGRingCnt" UBYTE DFC_OneToOne 1 100 0.00 255.0 FORMAT "%5.1" ECU_ADDRESS 0x60034A27 /end MEASUREMENT
/begin MEASUREMENT DFC_st.DFC_ComAYCGTOut "Status of DFC / Status of diagnostic fault check DFC_ComAYCGTOut" UBYTE DFC_OneToOne 1 100 0.00 255.0 FORMAT "%5.1" ECU_ADDRESS 0x60034A28 /end MEASUREMENT
/begin MEASUREMENT DFC_st.DFC_ComAYCIChkSum "Status of DFC / Status of diagnostic fault check DFC_ComAYCIChkSum" UBYTE DFC_OneToOne 1 100 0.00 255.0 FORMAT "%5.1" ECU_ADDRESS 0x60034A29 /end MEASUREMENT
/begin MEASUREMENT DFC_st.DFC_ComAYCIRingCnt "Status of DFC / Status of diagnostic fault check DFC_ComAYCIRingCnt" UBYTE DFC_OneToOne 1 100 0.00 255.0 FORMAT "%5.1" ECU_ADDRESS 0x60034A2A /end MEASUREMENT
/begin MEASUREMENT DFC_st.DFC_ComAYCITOut "Status of DFC / Status of diagnostic fault check DFC_ComAYCITOut" UBYTE DFC_OneToOne 1 100 0.00 255.0 FORMAT "%5.1" ECU_ADDRESS 0x60034A2B /end MEASUREMENT
/begin MEASUREMENT DFC_st.DFC_ComBCM1ChkSum "Status of DFC / Status of diagnostic fault check DFC_ComBCM1ChkSum" UBYTE DFC_OneToOne 1 100 0.00 255.0 FORMAT "%5.1" ECU_ADDRESS 0x60034A2C /end MEASUREMENT
/begin MEASUREMENT DFC_st.DFC_ComBCM1RingCnt "Status of DFC / Status of diagnostic fault check DFC_ComBCM1RingCnt" UBYTE DFC_OneToOne 1 100 0.00 255.0 FORMAT "%5.1" ECU_ADDRESS 0x60034A2D /end MEASUREMENT
/begin MEASUREMENT DFC_st.DFC_ComBCM1TOut "Status of DFC / Status of diagnostic fault check DFC_ComBCM1TOut" UBYTE DFC_OneToOne 1 100 0.00 255.0 FORMAT "%5.1" ECU_ADDRESS 0x60034A2E /end MEASUREMENT
/begin MEASUREMENT DFC_st.DFC_ComCANABusOffErr "Status of DFC / Status of diagnostic fault check DFC_ComCANABusOffErr" UBYTE DFC_OneToOne 1 100 0.00 255.0 FORMAT "%5.1" ECU_ADDRESS 0x60034A2F /end MEASUREMENT
/begin MEASUREMENT DFC_st.DFC_ComCANBBusOffErr "Status of DFC / Status of diagnostic fault check DFC_ComCANBBusOffErr" UBYTE DFC_OneToOne 1 100 0.00 255.0 FORMAT "%5.1" ECU_ADDRESS 0x60034A30 /end MEASUREMENT
/begin MEASUREMENT DFC_st.DFC_ComCANCBusOffErr "Status of DFC / Status of diagnostic fault check DFC_ComCANCBusOffErr" UBYTE DFC_OneToOne 1 100 0.00 255.0 FORMAT "%5.1" ECU_ADDRESS 0x60034A31 /end MEASUREMENT
/begin MEASUREMENT DFC_st.DFC_ComCGW1ChkSum "Status of DFC / Status of diagnostic fault check DFC_ComCGW1ChkSum" UBYTE DFC_OneToOne 1 100 0.00 255.0 FORMAT "%5.1" ECU_ADDRESS 0x60034A32 /end MEASUREMENT
/begin MEASUREMENT DFC_st.DFC_ComCGW1RingCnt "Status of DFC / Status of diagnostic fault check DFC_ComCGW1RingCnt" UBYTE DFC_OneToOne 1 100 0.00 255.0 FORMAT "%5.1" ECU_ADDRESS 0x60034A33 /end MEASUREMENT
/begin MEASUREMENT DFC_st.DFC_ComCGW1TOut "Status of DFC / Status of diagnostic fault check DFC_ComCGW1TOut" UBYTE DFC_OneToOne 1 100 0.00 255.0 FORMAT "%5.1" ECU_ADDRESS 0x60034A34 /end MEASUREMENT
/begin MEASUREMENT DFC_st.DFC_ComConvBoostErr "Status of DFC / Status of diagnostic fault check DFC_ComConvBoostErr" UBYTE DFC_OneToOne 1 100 0.00 255.0 FORMAT "%5.1" ECU_ADDRESS 0x60034A35 /end MEASUREMENT
/begin MEASUREMENT DFC_st.DFC_ComConvSlipErr "Status of DFC / Status of diagnostic fault check DFC_ComConvSlipErr" UBYTE DFC_OneToOne 1 100 0.00 255.0 FORMAT "%5.1" ECU_ADDRESS 0x60034A36 /end MEASUREMENT
/begin MEASUREMENT DFC_st.DFC_ComEAT10Chksum "Status of DFC / Status of diagnostic fault check DFC_ComEAT10Chksum" UBYTE DFC_OneToOne 1 100 0.00 255.0 FORMAT "%5.1" ECU_ADDRESS 0x60034A37 /end MEASUREMENT
/begin MEASUREMENT DFC_st.DFC_ComEAT10RingCnt "Status of DFC / Status of diagnostic fault check DFC_ComEAT10RingCnt" UBYTE DFC_OneToOne 1 100 0.00 255.0 FORMAT "%5.1" ECU_ADDRESS 0x60034A38 /end MEASUREMENT
/begin MEASUREMENT DFC_st.DFC_ComEAT10TOut "Status of DFC / Status of diagnostic fault check DFC_ComEAT10TOut" UBYTE DFC_OneToOne 1 100 0.00 255.0 FORMAT "%5.1" ECU_ADDRESS 0x60034A39 /end MEASUREMENT
/begin MEASUREMENT DFC_st.DFC_ComEAT11ChkSum "Status of DFC / Status of diagnostic fault check DFC_ComEAT11ChkSum" UBYTE DFC_OneToOne 1 100 0.00 255.0 FORMAT "%5.1" ECU_ADDRESS 0x60034A3A /end MEASUREMENT
/begin MEASUREMENT DFC_st.DFC_ComEAT11RingCnt "Status of DFC / Status of diagnostic fault check DFC_ComEAT11RingCnt" UBYTE DFC_OneToOne 1 100 0.00 255.0 FORMAT "%5.1" ECU_ADDRESS 0x60034A3B /end MEASUREMENT
/begin MEASUREMENT DFC_st.DFC_ComEAT11TOut "Status of DFC / Status of diagnostic fault check DFC_ComEAT11TOut" UBYTE DFC_OneToOne 1 100 0.00 255.0 FORMAT "%5.1" ECU_ADDRESS 0x60034A3C /end MEASUREMENT
/begin MEASUREMENT DFC_st.DFC_ComEAT12ChkSum "Status of DFC / Status of diagnostic fault check DFC_ComEAT12ChkSum" UBYTE DFC_OneToOne 1 100 0.00 255.0 FORMAT "%5.1" ECU_ADDRESS 0x60034A3D /end MEASUREMENT
/begin MEASUREMENT DFC_st.DFC_ComEAT12RingCnt "Status of DFC / Status of diagnostic fault check DFC_ComEAT12RingCnt" UBYTE DFC_OneToOne 1 100 0.00 255.0 FORMAT "%5.1" ECU_ADDRESS 0x60034A3E /end MEASUREMENT
/begin MEASUREMENT DFC_st.DFC_ComEAT12TOut "Status of DFC / Status of diagnostic fault check DFC_ComEAT12TOut" UBYTE DFC_OneToOne 1 100 0.00 255.0 FORMAT "%5.1" ECU_ADDRESS 0x60034A3F /end MEASUREMENT
/begin MEASUREMENT DFC_st.DFC_ComEAT13ChkSum "Status of DFC / Status of diagnostic fault check DFC_ComEAT13ChkSum" UBYTE DFC_OneToOne 1 100 0.00 255.0 FORMAT "%5.1" ECU_ADDRESS 0x60034A40 /end MEASUREMENT
/begin MEASUREMENT DFC_st.DFC_ComEAT13RingCnt "Status of DFC / Status of diagnostic fault check DFC_ComEAT13RingCnt" UBYTE DFC_OneToOne 1 100 0.00 255.0 FORMAT "%5.1" ECU_ADDRESS 0x60034A41 /end MEASUREMENT
/begin MEASUREMENT DFC_st.DFC_ComEAT13TOut "Status of DFC / Status of diagnostic fault check DFC_ComEAT13TOut" UBYTE DFC_OneToOne 1 100 0.00 255.0 FORMAT "%5.1" ECU_ADDRESS 0x60034A42 /end MEASUREMENT
/begin MEASUREMENT DFC_st.DFC_ComEAT1Chksum "Status of DFC / Status of diagnostic fault check DFC_ComEAT1Chksum" UBYTE DFC_OneToOne 1 100 0.00 255.0 FORMAT "%5.1" ECU_ADDRESS 0x60034A43 /end MEASUREMENT
/begin MEASUREMENT DFC_st.DFC_ComEAT1RingCnt "Status of DFC / Status of diagnostic fault check DFC_ComEAT1RingCnt" UBYTE DFC_OneToOne 1 100 0.00 255.0 FORMAT "%5.1" ECU_ADDRESS 0x60034A44 /end MEASUREMENT
/begin MEASUREMENT DFC_st.DFC_ComEAT1TOut "Status of DFC / Status of diagnostic fault check DFC_ComEAT1TOut" UBYTE DFC_OneToOne 1 100 0.00 255.0 FORMAT "%5.1" ECU_ADDRESS 0x60034A45 /end MEASUREMENT
/begin MEASUREMENT DFC_st.DFC_ComEAT2ChkSum "Status of DFC / Status of diagnostic fault check DFC_ComEAT2ChkSum" UBYTE DFC_OneToOne 1 100 0.00 255.0 FORMAT "%5.1" ECU_ADDRESS 0x60034A46 /end MEASUREMENT
/begin MEASUREMENT DFC_st.DFC_ComEAT2RingCnt "Status of DFC / Status of diagnostic fault check DFC_ComEAT2RingCnt" UBYTE DFC_OneToOne 1 100 0.00 255.0 FORMAT "%5.1" ECU_ADDRESS 0x60034A47 /end MEASUREMENT
/begin MEASUREMENT DFC_st.DFC_ComEAT2TOut "Status of DFC / Status of diagnostic fault check DFC_ComEAT2TOut" UBYTE DFC_OneToOne 1 100 0.00 255.0 FORMAT "%5.1" ECU_ADDRESS 0x60034A48 /end MEASUREMENT
/begin MEASUREMENT DFC_st.DFC_ComEAT4ChkSum "Status of DFC / Status of diagnostic fault check DFC_ComEAT4ChkSum" UBYTE DFC_OneToOne 1 100 0.00 255.0 FORMAT "%5.1" ECU_ADDRESS 0x60034A49 /end MEASUREMENT
/begin MEASUREMENT DFC_st.DFC_ComEAT4RingCnt "Status of DFC / Status of diagnostic fault check DFC_ComEAT4RingCnt" UBYTE DFC_OneToOne 1 100 0.00 255.0 FORMAT "%5.1" ECU_ADDRESS 0x60034A4A /end MEASUREMENT
/begin MEASUREMENT DFC_st.DFC_ComEAT4TOut "Status of DFC / Status of diagnostic fault check DFC_ComEAT4TOut" UBYTE DFC_OneToOne 1 100 0.00 255.0 FORMAT "%5.1" ECU_ADDRESS 0x60034A4B /end MEASUREMENT
/begin MEASUREMENT DFC_st.DFC_ComEAT6Chksum "Status of DFC / Status of diagnostic fault check DFC_ComEAT6Chksum" UBYTE DFC_OneToOne 1 100 0.00 255.0 FORMAT "%5.1" ECU_ADDRESS 0x60034A4C /end MEASUREMENT
/begin MEASUREMENT DFC_st.DFC_ComEAT6RingCnt "Status of DFC / Status of diagnostic fault check DFC_ComEAT6RingCnt" UBYTE DFC_OneToOne 1 100 0.00 255.0 FORMAT "%5.1" ECU_ADDRESS 0x60034A4D /end MEASUREMENT
/begin MEASUREMENT DFC_st.DFC_ComEAT6TOut "Status of DFC / Status of diagnostic fault check DFC_ComEAT6TOut" UBYTE DFC_OneToOne 1 100 0.00 255.0 FORMAT "%5.1" ECU_ADDRESS 0x60034A4E /end MEASUREMENT
/begin MEASUREMENT DFC_st.DFC_ComEAT7Chksum "Status of DFC / Status of diagnostic fault check DFC_ComEAT7Chksum" UBYTE DFC_OneToOne 1 100 0.00 255.0 FORMAT "%5.1" ECU_ADDRESS 0x60034A4F /end MEASUREMENT
/begin MEASUREMENT DFC_st.DFC_ComEAT7RingCnt "Status of DFC / Status of diagnostic fault check DFC_ComEAT7RingCnt" UBYTE DFC_OneToOne 1 100 0.00 255.0 FORMAT "%5.1" ECU_ADDRESS 0x60034A50 /end MEASUREMENT
/begin MEASUREMENT DFC_st.DFC_ComEAT7TOut "Status of DFC / Status of diagnostic fault check DFC_ComEAT7TOut" UBYTE DFC_OneToOne 1 100 0.00 255.0 FORMAT "%5.1" ECU_ADDRESS 0x60034A51 /end MEASUREMENT
/begin MEASUREMENT DFC_st.DFC_ComEAT8Chksum "Status of DFC / Status of diagnostic fault check DFC_ComEAT8Chksum" UBYTE DFC_OneToOne 1 100 0.00 255.0 FORMAT "%5.1" ECU_ADDRESS 0x60034A52 /end MEASUREMENT
/begin MEASUREMENT DFC_st.DFC_ComEAT8RingCnt "Status of DFC / Status of diagnostic fault check DFC_ComEAT8RingCnt" UBYTE DFC_OneToOne 1 100 0.00 255.0 FORMAT "%5.1" ECU_ADDRESS 0x60034A53 /end MEASUREMENT
/begin MEASUREMENT DFC_st.DFC_ComEAT8TOut "Status of DFC / Status of diagnostic fault check DFC_ComEAT8TOut" UBYTE DFC_OneToOne 1 100 0.00 255.0 FORMAT "%5.1" ECU_ADDRESS 0x60034A54 /end MEASUREMENT
/begin MEASUREMENT DFC_st.DFC_ComEATAChksum "Status of DFC / Status of diagnostic fault check DFC_ComEATAChksum" UBYTE DFC_OneToOne 1 100 0.00 255.0 FORMAT "%5.1" ECU_ADDRESS 0x60034A55 /end MEASUREMENT
/begin MEASUREMENT DFC_st.DFC_ComEATARingCnt "Status of DFC / Status of diagnostic fault check DFC_ComEATARingCnt" UBYTE DFC_OneToOne 1 100 0.00 255.0 FORMAT "%5.1" ECU_ADDRESS 0x60034A56 /end MEASUREMENT
/begin MEASUREMENT DFC_st.DFC_ComEATATOut "Status of DFC / Status of diagnostic fault check DFC_ComEATATOut" UBYTE DFC_OneToOne 1 100 0.00 255.0 FORMAT "%5.1" ECU_ADDRESS 0x60034A57 /end MEASUREMENT
/begin MEASUREMENT DFC_st.DFC_ComEATBChkSum "Status of DFC / Status of diagnostic fault check DFC_ComEATBChkSum" UBYTE DFC_OneToOne 1 100 0.00 255.0 FORMAT "%5.1" ECU_ADDRESS 0x60034A58 /end MEASUREMENT
/begin MEASUREMENT DFC_st.DFC_ComEATBRingCnt "Status of DFC / Status of diagnostic fault check DFC_ComEATBRingCnt" UBYTE DFC_OneToOne 1 100 0.00 255.0 FORMAT "%5.1" ECU_ADDRESS 0x60034A59 /end MEASUREMENT
/begin MEASUREMENT DFC_st.DFC_ComEATBTOut "Status of DFC / Status of diagnostic fault check DFC_ComEATBTOut" UBYTE DFC_OneToOne 1 100 0.00 255.0 FORMAT "%5.1" ECU_ADDRESS 0x60034A5A /end MEASUREMENT
/begin MEASUREMENT DFC_st.DFC_ComEATCChksum "Status of DFC / Status of diagnostic fault check DFC_ComEATCChksum" UBYTE DFC_OneToOne 1 100 0.00 255.0 FORMAT "%5.1" ECU_ADDRESS 0x60034A5B /end MEASUREMENT
/begin MEASUREMENT DFC_st.DFC_ComEATCRingCnt "Status of DFC / Status of diagnostic fault check DFC_ComEATCRingCnt" UBYTE DFC_OneToOne 1 100 0.00 255.0 FORMAT "%5.1" ECU_ADDRESS 0x60034A5C /end MEASUREMENT
/begin MEASUREMENT DFC_st.DFC_ComEATCTOut "Status of DFC / Status of diagnostic fault check DFC_ComEATCTOut" UBYTE DFC_OneToOne 1 100 0.00 255.0 FORMAT "%5.1" ECU_ADDRESS 0x60034A5D /end MEASUREMENT
/begin MEASUREMENT DFC_st.DFC_ComEBBAChksum "Status of DFC / Status of diagnostic fault check DFC_ComEBBAChksum" UBYTE DFC_OneToOne 1 100 0.00 255.0 FORMAT "%5.1" ECU_ADDRESS 0x60034A5E /end MEASUREMENT
/begin MEASUREMENT DFC_st.DFC_ComEBBARingCnt "Status of DFC / Status of diagnostic fault check DFC_ComEBBARingCnt" UBYTE DFC_OneToOne 1 100 0.00 255.0 FORMAT "%5.1" ECU_ADDRESS 0x60034A5F /end MEASUREMENT
/begin MEASUREMENT DFC_st.DFC_ComEBBATOut "Status of DFC / Status of diagnostic fault check DFC_ComEBBATOut" UBYTE DFC_OneToOne 1 100 0.00 255.0 FORMAT "%5.1" ECU_ADDRESS 0x60034A60 /end MEASUREMENT
/begin MEASUREMENT DFC_st.DFC_ComEPS1Chksum "Status of DFC / Status of diagnostic fault check DFC_ComEPS1Chksum" UBYTE DFC_OneToOne 1 100 0.00 255.0 FORMAT "%5.1" ECU_ADDRESS 0x60034A61 /end MEASUREMENT
/begin MEASUREMENT DFC_st.DFC_ComEPS1RingCnt "Status of DFC / Status of diagnostic fault check DFC_ComEPS1RingCnt" UBYTE DFC_OneToOne 1 100 0.00 255.0 FORMAT "%5.1" ECU_ADDRESS 0x60034A62 /end MEASUREMENT
/begin MEASUREMENT DFC_st.DFC_ComEPS1TOut "Status of DFC / Status of diagnostic fault check DFC_ComEPS1TOut" UBYTE DFC_OneToOne 1 100 0.00 255.0 FORMAT "%5.1" ECU_ADDRESS 0x60034A63 /end MEASUREMENT
/begin MEASUREMENT DFC_st.DFC_ComEngCanRxErr "Status of DFC / Status of diagnostic fault check DFC_ComEngCanRxErr" UBYTE DFC_OneToOne 1 100 0.00 255.0 FORMAT "%5.1" ECU_ADDRESS 0x60034A64 /end MEASUREMENT
/begin MEASUREMENT DFC_st.DFC_ComGrvySnsrErr "Status of DFC / Status of diagnostic fault check DFC_ComGrvySnsrErr" UBYTE DFC_OneToOne 1 100 0.00 255.0 FORMAT "%5.1" ECU_ADDRESS 0x60034A65 /end MEASUREMENT
/begin MEASUREMENT DFC_st.DFC_ComGwIMG1ChkSum "Status of DFC / Status of diagnostic fault check DFC_ComGwIMG1ChkSum" UBYTE DFC_OneToOne 1 100 0.00 255.0 FORMAT "%5.1" ECU_ADDRESS 0x60034A66 /end MEASUREMENT
/begin MEASUREMENT DFC_st.DFC_ComGwIMG1RingCnt "Status of DFC / Status of diagnostic fault check DFC_ComGwIMG1RingCnt" UBYTE DFC_OneToOne 1 100 0.00 255.0 FORMAT "%5.1" ECU_ADDRESS 0x60034A67 /end MEASUREMENT
/begin MEASUREMENT DFC_st.DFC_ComGwIMG1TOut "Status of DFC / Status of diagnostic fault check DFC_ComGwIMG1TOut" UBYTE DFC_OneToOne 1 100 0.00 255.0 FORMAT "%5.1" ECU_ADDRESS 0x60034A68 /end MEASUREMENT
/begin MEASUREMENT DFC_st.DFC_ComGwIMG3ChkSum "Status of DFC / Status of diagnostic fault check DFC_ComGwIMG3ChkSum" UBYTE DFC_OneToOne 1 100 0.00 255.0 FORMAT "%5.1" ECU_ADDRESS 0x60034A69 /end MEASUREMENT
/begin MEASUREMENT DFC_st.DFC_ComGwIMG3RingCnt "Status of DFC / Status of diagnostic fault check DFC_ComGwIMG3RingCnt" UBYTE DFC_OneToOne 1 100 0.00 255.0 FORMAT "%5.1" ECU_ADDRESS 0x60034A6A /end MEASUREMENT
/begin MEASUREMENT DFC_st.DFC_ComGwIMG3TOut "Status of DFC / Status of diagnostic fault check DFC_ComGwIMG3TOut" UBYTE DFC_OneToOne 1 100 0.00 255.0 FORMAT "%5.1" ECU_ADDRESS 0x60034A6B /end MEASUREMENT
/begin MEASUREMENT DFC_st.DFC_ComGwIMG4ChkSum "Status of DFC / Status of diagnostic fault check DFC_ComGwIMG4ChkSum" UBYTE DFC_OneToOne 1 100 0.00 255.0 FORMAT "%5.1" ECU_ADDRESS 0x60034A6C /end MEASUREMENT
/begin MEASUREMENT DFC_st.DFC_ComGwIMG4RingCnt "Status of DFC / Status of diagnostic fault check DFC_ComGwIMG4RingCnt" UBYTE DFC_OneToOne 1 100 0.00 255.0 FORMAT "%5.1" ECU_ADDRESS 0x60034A6D /end MEASUREMENT
/begin MEASUREMENT DFC_st.DFC_ComGwIMG4TOut "Status of DFC / Status of diagnostic fault check DFC_ComGwIMG4TOut" UBYTE DFC_OneToOne 1 100 0.00 255.0 FORMAT "%5.1" ECU_ADDRESS 0x60034A6E /end MEASUREMENT
/begin MEASUREMENT DFC_st.DFC_ComGwIMG5ChkSum "Status of DFC / Status of diagnostic fault check DFC_ComGwIMG5ChkSum" UBYTE DFC_OneToOne 1 100 0.00 255.0 FORMAT "%5.1" ECU_ADDRESS 0x60034A6F /end MEASUREMENT
/begin MEASUREMENT DFC_st.DFC_ComGwIMG5RingCnt "Status of DFC / Status of diagnostic fault check DFC_ComGwIMG5RingCnt" UBYTE DFC_OneToOne 1 100 0.00 255.0 FORMAT "%5.1" ECU_ADDRESS 0x60034A70 /end MEASUREMENT
/begin MEASUREMENT DFC_st.DFC_ComGwIMG5TOut "Status of DFC / Status of diagnostic fault check DFC_ComGwIMG5TOut" UBYTE DFC_OneToOne 1 100 0.00 255.0 FORMAT "%5.1" ECU_ADDRESS 0x60034A71 /end MEASUREMENT
/begin MEASUREMENT DFC_st.DFC_ComGwIMG6ChkSum "Status of DFC / Status of diagnostic fault check DFC_ComGwIMG6ChkSum" UBYTE DFC_OneToOne 1 100 0.00 255.0 FORMAT "%5.1" ECU_ADDRESS 0x60034A72 /end MEASUREMENT
/begin MEASUREMENT DFC_st.DFC_ComGwIMG6RingCnt "Status of DFC / Status of diagnostic fault check DFC_ComGwIMG6RingCnt" UBYTE DFC_OneToOne 1 100 0.00 255.0 FORMAT "%5.1" ECU_ADDRESS 0x60034A73 /end MEASUREMENT
/begin MEASUREMENT DFC_st.DFC_ComGwIMG6TOut "Status of DFC / Status of diagnostic fault check DFC_ComGwIMG6TOut" UBYTE DFC_OneToOne 1 100 0.00 255.0 FORMAT "%5.1" ECU_ADDRESS 0x60034A74 /end MEASUREMENT
/begin MEASUREMENT DFC_st.DFC_ComIDASBChksum "Status of DFC / Status of diagnostic fault check DFC_ComIDASBChksum" UBYTE DFC_OneToOne 1 100 0.00 255.0 FORMAT "%5.1" ECU_ADDRESS 0x60034A75 /end MEASUREMENT
/begin MEASUREMENT DFC_st.DFC_ComIDASBRingCnt "Status of DFC / Status of diagnostic fault check DFC_ComIDASBRingCnt" UBYTE DFC_OneToOne 1 100 0.00 255.0 FORMAT "%5.1" ECU_ADDRESS 0x60034A76 /end MEASUREMENT
/begin MEASUREMENT DFC_st.DFC_ComIDASBTOut "Status of DFC / Status of diagnostic fault check DFC_ComIDASBTOut" UBYTE DFC_OneToOne 1 100 0.00 255.0 FORMAT "%5.1" ECU_ADDRESS 0x60034A77 /end MEASUREMENT
/begin MEASUREMENT DFC_st.DFC_ComIMGMILReq "Status of DFC / Status of diagnostic fault check DFC_ComIMGMILReq" UBYTE DFC_OneToOne 1 100 0.00 255.0 FORMAT "%5.1" ECU_ADDRESS 0x60034A78 /end MEASUREMENT
/begin MEASUREMENT DFC_st.DFC_ComISSPrms "Status of DFC / Status of diagnostic fault check DFC_ComISSPrms" UBYTE DFC_OneToOne 1 100 0.00 255.0 FORMAT "%5.1" ECU_ADDRESS 0x60034A79 /end MEASUREMENT
/begin MEASUREMENT DFC_st.DFC_ComMETAChksum "Status of DFC / Status of diagnostic fault check DFC_ComMETAChksum" UBYTE DFC_OneToOne 1 100 0.00 255.0 FORMAT "%5.1" ECU_ADDRESS 0x60034A7A /end MEASUREMENT
/begin MEASUREMENT DFC_st.DFC_ComMETARingCnt "Status of DFC / Status of diagnostic fault check DFC_ComMETARingCnt" UBYTE DFC_OneToOne 1 100 0.00 255.0 FORMAT "%5.1" ECU_ADDRESS 0x60034A7B /end MEASUREMENT
/begin MEASUREMENT DFC_st.DFC_ComMETATOut "Status of DFC / Status of diagnostic fault check DFC_ComMETATOut" UBYTE DFC_OneToOne 1 100 0.00 255.0 FORMAT "%5.1" ECU_ADDRESS 0x60034A7C /end MEASUREMENT
/begin MEASUREMENT DFC_st.DFC_ComMETCChksum "Status of DFC / Status of diagnostic fault check DFC_ComMETCChksum" UBYTE DFC_OneToOne 1 100 0.00 255.0 FORMAT "%5.1" ECU_ADDRESS 0x60034A7D /end MEASUREMENT
/begin MEASUREMENT DFC_st.DFC_ComMETCRingCnt "Status of DFC / Status of diagnostic fault check DFC_ComMETCRingCnt" UBYTE DFC_OneToOne 1 100 0.00 255.0 FORMAT "%5.1" ECU_ADDRESS 0x60034A7E /end MEASUREMENT
/begin MEASUREMENT DFC_st.DFC_ComMETCTOut "Status of DFC / Status of diagnostic fault check DFC_ComMETCTOut" UBYTE DFC_OneToOne 1 100 0.00 255.0 FORMAT "%5.1" ECU_ADDRESS 0x60034A7F /end MEASUREMENT
/begin MEASUREMENT DFC_st.DFC_ComMETDChksum "Status of DFC / Status of diagnostic fault check DFC_ComMETDChksum" UBYTE DFC_OneToOne 1 100 0.00 255.0 FORMAT "%5.1" ECU_ADDRESS 0x60034A80 /end MEASUREMENT
/begin MEASUREMENT DFC_st.DFC_ComMETDRingCnt "Status of DFC / Status of diagnostic fault check DFC_ComMETDRingCnt" UBYTE DFC_OneToOne 1 100 0.00 255.0 FORMAT "%5.1" ECU_ADDRESS 0x60034A81 /end MEASUREMENT
/begin MEASUREMENT DFC_st.DFC_ComMETDTOut "Status of DFC / Status of diagnostic fault check DFC_ComMETDTOut" UBYTE DFC_OneToOne 1 100 0.00 255.0 FORMAT "%5.1" ECU_ADDRESS 0x60034A82 /end MEASUREMENT
/begin MEASUREMENT DFC_st.DFC_ComMETE2Chksum "Status of DFC / Status of diagnostic fault check DFC_ComMETE2Chksum" UBYTE DFC_OneToOne 1 100 0.00 255.0 FORMAT "%5.1" ECU_ADDRESS 0x60034A83 /end MEASUREMENT
/begin MEASUREMENT DFC_st.DFC_ComMETE2RingCnt "Status of DFC / Status of diagnostic fault check DFC_ComMETE2RingCnt" UBYTE DFC_OneToOne 1 100 0.00 255.0 FORMAT "%5.1" ECU_ADDRESS 0x60034A84 /end MEASUREMENT
/begin MEASUREMENT DFC_st.DFC_ComMETE2TOut "Status of DFC / Status of diagnostic fault check DFC_ComMETE2TOut" UBYTE DFC_OneToOne 1 100 0.00 255.0 FORMAT "%5.1" ECU_ADDRESS 0x60034A85 /end MEASUREMENT
/begin MEASUREMENT DFC_st.DFC_ComMETFChksum "Status of DFC / Status of diagnostic fault check DFC_ComMETFChksum" UBYTE DFC_OneToOne 1 100 0.00 255.0 FORMAT "%5.1" ECU_ADDRESS 0x60034A86 /end MEASUREMENT
/begin MEASUREMENT DFC_st.DFC_ComMETFRingCnt "Status of DFC / Status of diagnostic fault check DFC_ComMETFRingCnt" UBYTE DFC_OneToOne 1 100 0.00 255.0 FORMAT "%5.1" ECU_ADDRESS 0x60034A87 /end MEASUREMENT
/begin MEASUREMENT DFC_st.DFC_ComMETFTOut "Status of DFC / Status of diagnostic fault check DFC_ComMETFTOut" UBYTE DFC_OneToOne 1 100 0.00 255.0 FORMAT "%5.1" ECU_ADDRESS 0x60034A88 /end MEASUREMENT
/begin MEASUREMENT DFC_st.DFC_ComMETGChksum "Status of DFC / Status of diagnostic fault check DFC_ComMETGChksum" UBYTE DFC_OneToOne 1 100 0.00 255.0 FORMAT "%5.1" ECU_ADDRESS 0x60034A89 /end MEASUREMENT
/begin MEASUREMENT DFC_st.DFC_ComMETGRingCnt "Status of DFC / Status of diagnostic fault check DFC_ComMETGRingCnt" UBYTE DFC_OneToOne 1 100 0.00 255.0 FORMAT "%5.1" ECU_ADDRESS 0x60034A8A /end MEASUREMENT
/begin MEASUREMENT DFC_st.DFC_ComMETGTOut "Status of DFC / Status of diagnostic fault check DFC_ComMETGTOut" UBYTE DFC_OneToOne 1 100 0.00 255.0 FORMAT "%5.1" ECU_ADDRESS 0x60034A8B /end MEASUREMENT
/begin MEASUREMENT DFC_st.DFC_ComMETH2Chksum "Status of DFC / Status of diagnostic fault check DFC_ComMETH2Chksum" UBYTE DFC_OneToOne 1 100 0.00 255.0 FORMAT "%5.1" ECU_ADDRESS 0x60034A8C /end MEASUREMENT
/begin MEASUREMENT DFC_st.DFC_ComMETH2RingCnt "Status of DFC / Status of diagnostic fault check DFC_ComMETH2RingCnt" UBYTE DFC_OneToOne 1 100 0.00 255.0 FORMAT "%5.1" ECU_ADDRESS 0x60034A8D /end MEASUREMENT
/begin MEASUREMENT DFC_st.DFC_ComMETH2TOut "Status of DFC / Status of diagnostic fault check DFC_ComMETH2TOut" UBYTE DFC_OneToOne 1 100 0.00 255.0 FORMAT "%5.1" ECU_ADDRESS 0x60034A8E /end MEASUREMENT
/begin MEASUREMENT DFC_st.DFC_ComMETHChksum "Status of DFC / Status of diagnostic fault check DFC_ComMETHChksum" UBYTE DFC_OneToOne 1 100 0.00 255.0 FORMAT "%5.1" ECU_ADDRESS 0x60034A8F /end MEASUREMENT
/begin MEASUREMENT DFC_st.DFC_ComMETHRingCnt "Status of DFC / Status of diagnostic fault check DFC_ComMETHRingCnt" UBYTE DFC_OneToOne 1 100 0.00 255.0 FORMAT "%5.1" ECU_ADDRESS 0x60034A90 /end MEASUREMENT
/begin MEASUREMENT DFC_st.DFC_ComMETHTOut "Status of DFC / Status of diagnostic fault check DFC_ComMETHTOut" UBYTE DFC_OneToOne 1 100 0.00 255.0 FORMAT "%5.1" ECU_ADDRESS 0x60034A91 /end MEASUREMENT
/begin MEASUREMENT DFC_st.DFC_ComMETIChksum "Status of DFC / Status of diagnostic fault check DFC_ComMETIChksum" UBYTE DFC_OneToOne 1 100 0.00 255.0 FORMAT "%5.1" ECU_ADDRESS 0x60034A92 /end MEASUREMENT
/begin MEASUREMENT DFC_st.DFC_ComMETIRingCnt "Status of DFC / Status of diagnostic fault check DFC_ComMETIRingCnt" UBYTE DFC_OneToOne 1 100 0.00 255.0 FORMAT "%5.1" ECU_ADDRESS 0x60034A93 /end MEASUREMENT
/begin MEASUREMENT DFC_st.DFC_ComMETITOut "Status of DFC / Status of diagnostic fault check DFC_ComMETITOut" UBYTE DFC_OneToOne 1 100 0.00 255.0 FORMAT "%5.1" ECU_ADDRESS 0x60034A94 /end MEASUREMENT
/begin MEASUREMENT DFC_st.DFC_ComMETKChksum "Status of DFC / Status of diagnostic fault check DFC_ComMETKChksum" UBYTE DFC_OneToOne 1 100 0.00 255.0 FORMAT "%5.1" ECU_ADDRESS 0x60034A95 /end MEASUREMENT
/begin MEASUREMENT DFC_st.DFC_ComMETKRingCnt "Status of DFC / Status of diagnostic fault check DFC_ComMETKRingCnt" UBYTE DFC_OneToOne 1 100 0.00 255.0 FORMAT "%5.1" ECU_ADDRESS 0x60034A96 /end MEASUREMENT
/begin MEASUREMENT DFC_st.DFC_ComMETKTOut "Status of DFC / Status of diagnostic fault check DFC_ComMETKTOut" UBYTE DFC_OneToOne 1 100 0.00 255.0 FORMAT "%5.1" ECU_ADDRESS 0x60034A97 /end MEASUREMENT
/begin MEASUREMENT DFC_st.DFC_ComMETLChksum "Status of DFC / Status of diagnostic fault check DFC_ComMETLChksum" UBYTE DFC_OneToOne 1 100 0.00 255.0 FORMAT "%5.1" ECU_ADDRESS 0x60034A98 /end MEASUREMENT
/begin MEASUREMENT DFC_st.DFC_ComMETLRingCnt "Status of DFC / Status of diagnostic fault check DFC_ComMETLRingCnt" UBYTE DFC_OneToOne 1 100 0.00 255.0 FORMAT "%5.1" ECU_ADDRESS 0x60034A99 /end MEASUREMENT
/begin MEASUREMENT DFC_st.DFC_ComMETLTOut "Status of DFC / Status of diagnostic fault check DFC_ComMETLTOut" UBYTE DFC_OneToOne 1 100 0.00 255.0 FORMAT "%5.1" ECU_ADDRESS 0x60034A9A /end MEASUREMENT
/begin MEASUREMENT DFC_st.DFC_ComMETMChksum "Status of DFC / Status of diagnostic fault check DFC_ComMETMChksum" UBYTE DFC_OneToOne 1 100 0.00 255.0 FORMAT "%5.1" ECU_ADDRESS 0x60034A9B /end MEASUREMENT
/begin MEASUREMENT DFC_st.DFC_ComMETMRingCnt "Status of DFC / Status of diagnostic fault check DFC_ComMETMRingCnt" UBYTE DFC_OneToOne 1 100 0.00 255.0 FORMAT "%5.1" ECU_ADDRESS 0x60034A9C /end MEASUREMENT
/begin MEASUREMENT DFC_st.DFC_ComMETMTOut "Status of DFC / Status of diagnostic fault check DFC_ComMETMTOut" UBYTE DFC_OneToOne 1 100 0.00 255.0 FORMAT "%5.1" ECU_ADDRESS 0x60034A9D /end MEASUREMENT
/begin MEASUREMENT DFC_st.DFC_ComMETNChksum "Status of DFC / Status of diagnostic fault check DFC_ComMETNChksum" UBYTE DFC_OneToOne 1 100 0.00 255.0 FORMAT "%5.1" ECU_ADDRESS 0x60034A9E /end MEASUREMENT
/begin MEASUREMENT DFC_st.DFC_ComMETNRingCnt "Status of DFC / Status of diagnostic fault check DFC_ComMETNRingCnt" UBYTE DFC_OneToOne 1 100 0.00 255.0 FORMAT "%5.1" ECU_ADDRESS 0x60034A9F /end MEASUREMENT
/begin MEASUREMENT DFC_st.DFC_ComMETNTOut "Status of DFC / Status of diagnostic fault check DFC_ComMETNTOut" UBYTE DFC_OneToOne 1 100 0.00 255.0 FORMAT "%5.1" ECU_ADDRESS 0x60034AA0 /end MEASUREMENT
/begin MEASUREMENT DFC_st.DFC_ComMtrCom "Status of DFC / Status of diagnostic fault check DFC_ComMtrCom" UBYTE DFC_OneToOne 1 100 0.00 255.0 FORMAT "%5.1" ECU_ADDRESS 0x60034AA1 /end MEASUREMENT
/begin MEASUREMENT DFC_st.DFC_ComPCUChkSum "Status of DFC / Status of diagnostic fault check DFC_ComPCUChkSum" UBYTE DFC_OneToOne 1 100 0.00 255.0 FORMAT "%5.1" ECU_ADDRESS 0x60034AA2 /end MEASUREMENT
/begin MEASUREMENT DFC_st.DFC_ComPCURingCnt "Status of DFC / Status of diagnostic fault check DFC_ComPCURingCnt" UBYTE DFC_OneToOne 1 100 0.00 255.0 FORMAT "%5.1" ECU_ADDRESS 0x60034AA3 /end MEASUREMENT
/begin MEASUREMENT DFC_st.DFC_ComPCUTOut "Status of DFC / Status of diagnostic fault check DFC_ComPCUTOut" UBYTE DFC_OneToOne 1 100 0.00 255.0 FORMAT "%5.1" ECU_ADDRESS 0x60034AA4 /end MEASUREMENT
/begin MEASUREMENT DFC_st.DFC_ComSRSAChksum "Status of DFC / Status of diagnostic fault check DFC_ComSRSAChksum" UBYTE DFC_OneToOne 1 100 0.00 255.0 FORMAT "%5.1" ECU_ADDRESS 0x60034AA5 /end MEASUREMENT
/begin MEASUREMENT DFC_st.DFC_ComSRSARingCnt "Status of DFC / Status of diagnostic fault check DFC_ComSRSARingCnt" UBYTE DFC_OneToOne 1 100 0.00 255.0 FORMAT "%5.1" ECU_ADDRESS 0x60034AA6 /end MEASUREMENT
/begin MEASUREMENT DFC_st.DFC_ComSRSATOut "Status of DFC / Status of diagnostic fault check DFC_ComSRSATOut" UBYTE DFC_OneToOne 1 100 0.00 255.0 FORMAT "%5.1" ECU_ADDRESS 0x60034AA7 /end MEASUREMENT
/begin MEASUREMENT DFC_st.DFC_ComSRSBChksum "Status of DFC / Status of diagnostic fault check DFC_ComSRSBChksum" UBYTE DFC_OneToOne 1 100 0.00 255.0 FORMAT "%5.1" ECU_ADDRESS 0x60034AA8 /end MEASUREMENT
/begin MEASUREMENT DFC_st.DFC_ComSRSBRingCnt "Status of DFC / Status of diagnostic fault check DFC_ComSRSBRingCnt" UBYTE DFC_OneToOne 1 100 0.00 255.0 FORMAT "%5.1" ECU_ADDRESS 0x60034AA9 /end MEASUREMENT
/begin MEASUREMENT DFC_st.DFC_ComSRSBTOut "Status of DFC / Status of diagnostic fault check DFC_ComSRSBTOut" UBYTE DFC_OneToOne 1 100 0.00 255.0 FORMAT "%5.1" ECU_ADDRESS 0x60034AAA /end MEASUREMENT
/begin MEASUREMENT DFC_st.DFC_ComSRSChksum "Status of DFC / Status of diagnostic fault check DFC_ComSRSChksum" UBYTE DFC_OneToOne 1 100 0.00 255.0 FORMAT "%5.1" ECU_ADDRESS 0x60034AAB /end MEASUREMENT
/begin MEASUREMENT DFC_st.DFC_ComSRSErr "Status of DFC / Status of diagnostic fault check DFC_ComSRSErr" UBYTE DFC_OneToOne 1 100 0.00 255.0 FORMAT "%5.1" ECU_ADDRESS 0x60034AAC /end MEASUREMENT
/begin MEASUREMENT DFC_st.DFC_ComSRSRingCnt "Status of DFC / Status of diagnostic fault check DFC_ComSRSRingCnt" UBYTE DFC_OneToOne 1 100 0.00 255.0 FORMAT "%5.1" ECU_ADDRESS 0x60034AAD /end MEASUREMENT
/begin MEASUREMENT DFC_st.DFC_ComSRSTOut "Status of DFC / Status of diagnostic fault check DFC_ComSRSTOut" UBYTE DFC_OneToOne 1 100 0.00 255.0 FORMAT "%5.1" ECU_ADDRESS 0x60034AAE /end MEASUREMENT
/begin MEASUREMENT DFC_st.DFC_ComVehSpdPndFltTCU "Status of DFC / Status of diagnostic fault check DFC_ComVehSpdPndFltTCU" UBYTE DFC_OneToOne 1 100 0.00 255.0 FORMAT "%5.1" ECU_ADDRESS 0x60034AAF /end MEASUREMENT
/begin MEASUREMENT DFC_st.DFC_EbsChartcCurrErr "Status of DFC / Status of diagnostic fault check DFC_EbsChartcCurrErr" UBYTE DFC_OneToOne 1 100 0.00 255.0 FORMAT "%5.1" ECU_ADDRESS 0x60034AB0 /end MEASUREMENT
/begin MEASUREMENT DFC_st.DFC_EbsSelfDiagErr "Status of DFC / Status of diagnostic fault check DFC_EbsSelfDiagErr" UBYTE DFC_OneToOne 1 100 0.00 255.0 FORMAT "%5.1" ECU_ADDRESS 0x60034AB1 /end MEASUREMENT
/begin MEASUREMENT DFC_st.DFC_GbxCANDigPlausErr "Status of DFC / Status of diagnostic fault check DFC_GbxCANDigPlausErr" UBYTE DFC_OneToOne 1 100 0.00 255.0 FORMAT "%5.1" ECU_ADDRESS 0x60034AB2 /end MEASUREMENT
/begin MEASUREMENT DFC_st.DFC_GbxNPos1SRCMax "Status of DFC / Status of diagnostic fault check DFC_GbxNPos1SRCMax" UBYTE DFC_OneToOne 1 100 0.00 255.0 FORMAT "%5.1" ECU_ADDRESS 0x60034AB3 /end MEASUREMENT
/begin MEASUREMENT DFC_st.DFC_GbxNPos1SRCMin "Status of DFC / Status of diagnostic fault check DFC_GbxNPos1SRCMin" UBYTE DFC_OneToOne 1 100 0.00 255.0 FORMAT "%5.1" ECU_ADDRESS 0x60034AB4 /end MEASUREMENT
/begin MEASUREMENT DFC_st.DFC_GbxNPos2SRCMax "Status of DFC / Status of diagnostic fault check DFC_GbxNPos2SRCMax" UBYTE DFC_OneToOne 1 100 0.00 255.0 FORMAT "%5.1" ECU_ADDRESS 0x60034AB5 /end MEASUREMENT
/begin MEASUREMENT DFC_st.DFC_GbxNPos2SRCMin "Status of DFC / Status of diagnostic fault check DFC_GbxNPos2SRCMin" UBYTE DFC_OneToOne 1 100 0.00 255.0 FORMAT "%5.1" ECU_ADDRESS 0x60034AB6 /end MEASUREMENT
/begin MEASUREMENT DFC_st.DFC_GbxNPosAlvChk "Status of DFC / Status of diagnostic fault check DFC_GbxNPosAlvChk" UBYTE DFC_OneToOne 1 100 0.00 255.0 FORMAT "%5.1" ECU_ADDRESS 0x60034AB7 /end MEASUREMENT
/begin MEASUREMENT DFC_st.DFC_GbxNPosSyncErr "Status of DFC / Status of diagnostic fault check DFC_GbxNPosSyncErr" UBYTE DFC_OneToOne 1 100 0.00 255.0 FORMAT "%5.1" ECU_ADDRESS 0x60034AB8 /end MEASUREMENT
/begin MEASUREMENT DFC_st.DFC_HEGOS2B1HtrPsMax "Status of DFC / Status of diagnostic fault check DFC_HEGOS2B1HtrPsMax" UBYTE DFC_OneToOne 1 100 0.00 255.0 FORMAT "%5.1" ECU_ADDRESS 0x60034AB9 /end MEASUREMENT
/begin MEASUREMENT DFC_st.DFC_HEGOS2B1HtrPsMin "Status of DFC / Status of diagnostic fault check DFC_HEGOS2B1HtrPsMin" UBYTE DFC_OneToOne 1 100 0.00 255.0 FORMAT "%5.1" ECU_ADDRESS 0x60034ABA /end MEASUREMENT
/begin MEASUREMENT DFC_st.DFC_HEGOS2B1HtrPsSig "Status of DFC / Status of diagnostic fault check DFC_HEGOS2B1HtrPsSig" UBYTE DFC_OneToOne 1 100 0.00 255.0 FORMAT "%5.1" ECU_ADDRESS 0x60034ABB /end MEASUREMENT
/begin MEASUREMENT DFC_st.DFC_LinCSErrACG "Status of DFC / Status of diagnostic fault check DFC_LinCSErrACG" UBYTE DFC_OneToOne 1 100 0.00 255.0 FORMAT "%5.1" ECU_ADDRESS 0x60034ABC /end MEASUREMENT
/begin MEASUREMENT DFC_st.DFC_LinCSErrEBS "Status of DFC / Status of diagnostic fault check DFC_LinCSErrEBS" UBYTE DFC_OneToOne 1 100 0.00 255.0 FORMAT "%5.1" ECU_ADDRESS 0x60034ABD /end MEASUREMENT
/begin MEASUREMENT DFC_st.DFC_LinHdrTimeoutErrACG "Status of DFC / Status of diagnostic fault check DFC_LinHdrTimeoutErrACG" UBYTE DFC_OneToOne 1 100 0.00 255.0 FORMAT "%5.1" ECU_ADDRESS 0x60034ABE /end MEASUREMENT
/begin MEASUREMENT DFC_st.DFC_LinHdrTimeoutErrEBS "Status of DFC / Status of diagnostic fault check DFC_LinHdrTimeoutErrEBS" UBYTE DFC_OneToOne 1 100 0.00 255.0 FORMAT "%5.1" ECU_ADDRESS 0x60034ABF /end MEASUREMENT
/begin MEASUREMENT DFC_st.DFC_LinMsgTimeoutErrACG "Status of DFC / Status of diagnostic fault check DFC_LinMsgTimeoutErrACG" UBYTE DFC_OneToOne 1 100 0.00 255.0 FORMAT "%5.1" ECU_ADDRESS 0x60034AC0 /end MEASUREMENT
/begin MEASUREMENT DFC_st.DFC_LinMsgTimeoutErrEBS "Status of DFC / Status of diagnostic fault check DFC_LinMsgTimeoutErrEBS" UBYTE DFC_OneToOne 1 100 0.00 255.0 FORMAT "%5.1" ECU_ADDRESS 0x60034AC1 /end MEASUREMENT
/begin MEASUREMENT DFC_st.DFC_LinNoStrtComErr "Status of DFC / Status of diagnostic fault check DFC_LinNoStrtComErr" UBYTE DFC_OneToOne 1 100 0.00 255.0 FORMAT "%5.1" ECU_ADDRESS 0x60034AC2 /end MEASUREMENT
/begin MEASUREMENT DFC_st.DFC_MisfDetVWhlFrntLeOORHi "Status of DFC / Status of diagnostic fault check DFC_MisfDetVWhlFrntLeOORHi" UBYTE DFC_OneToOne 1 100 0.00 255.0 FORMAT "%5.1" ECU_ADDRESS 0x60034AC3 /end MEASUREMENT
/begin MEASUREMENT DFC_st.DFC_MisfDetVWhlFrntLeRatyHi "Status of DFC / Status of diagnostic fault check DFC_MisfDetVWhlFrntLeRatyHi" UBYTE DFC_OneToOne 1 100 0.00 255.0 FORMAT "%5.1" ECU_ADDRESS 0x60034AC4 /end MEASUREMENT
/begin MEASUREMENT DFC_st.DFC_MisfDetVWhlFrntLeRatyLo "Status of DFC / Status of diagnostic fault check DFC_MisfDetVWhlFrntLeRatyLo" UBYTE DFC_OneToOne 1 100 0.00 255.0 FORMAT "%5.1" ECU_ADDRESS 0x60034AC5 /end MEASUREMENT
/begin MEASUREMENT DFC_st.DFC_MisfDetVWhlFrntLeStuck "Status of DFC / Status of diagnostic fault check DFC_MisfDetVWhlFrntLeStuck" UBYTE DFC_OneToOne 1 100 0.00 255.0 FORMAT "%5.1" ECU_ADDRESS 0x60034AC6 /end MEASUREMENT
/begin MEASUREMENT DFC_st.DFC_MisfDetVWhlFrntRiOORHi "Status of DFC / Status of diagnostic fault check DFC_MisfDetVWhlFrntRiOORHi" UBYTE DFC_OneToOne 1 100 0.00 255.0 FORMAT "%5.1" ECU_ADDRESS 0x60034AC7 /end MEASUREMENT
/begin MEASUREMENT DFC_st.DFC_MisfDetVWhlFrntRiRatyHi "Status of DFC / Status of diagnostic fault check DFC_MisfDetVWhlFrntRiRatyHi" UBYTE DFC_OneToOne 1 100 0.00 255.0 FORMAT "%5.1" ECU_ADDRESS 0x60034AC8 /end MEASUREMENT
/begin MEASUREMENT DFC_st.DFC_MisfDetVWhlFrntRiRatyLo "Status of DFC / Status of diagnostic fault check DFC_MisfDetVWhlFrntRiRatyLo" UBYTE DFC_OneToOne 1 100 0.00 255.0 FORMAT "%5.1" ECU_ADDRESS 0x60034AC9 /end MEASUREMENT
/begin MEASUREMENT DFC_st.DFC_MisfDetVWhlFrntRiStuck "Status of DFC / Status of diagnostic fault check DFC_MisfDetVWhlFrntRiStuck" UBYTE DFC_OneToOne 1 100 0.00 255.0 FORMAT "%5.1" ECU_ADDRESS 0x60034ACA /end MEASUREMENT
/begin MEASUREMENT DFC_st.DFC_MisfDetVWhlReLeOORHi "Status of DFC / Status of diagnostic fault check DFC_MisfDetVWhlReLeOORHi" UBYTE DFC_OneToOne 1 100 0.00 255.0 FORMAT "%5.1" ECU_ADDRESS 0x60034ACB /end MEASUREMENT
/begin MEASUREMENT DFC_st.DFC_MisfDetVWhlReLeRatyHi "Status of DFC / Status of diagnostic fault check DFC_MisfDetVWhlReLeRatyHi" UBYTE DFC_OneToOne 1 100 0.00 255.0 FORMAT "%5.1" ECU_ADDRESS 0x60034ACC /end MEASUREMENT
/begin MEASUREMENT DFC_st.DFC_MisfDetVWhlReLeRatyLo "Status of DFC / Status of diagnostic fault check DFC_MisfDetVWhlReLeRatyLo" UBYTE DFC_OneToOne 1 100 0.00 255.0 FORMAT "%5.1" ECU_ADDRESS 0x60034ACD /end MEASUREMENT
/begin MEASUREMENT DFC_st.DFC_MisfDetVWhlReLeStuck "Status of DFC / Status of diagnostic fault check DFC_MisfDetVWhlReLeStuck" UBYTE DFC_OneToOne 1 100 0.00 255.0 FORMAT "%5.1" ECU_ADDRESS 0x60034ACE /end MEASUREMENT
/begin MEASUREMENT DFC_st.DFC_MisfDetVWhlReRiOORHi "Status of DFC / Status of diagnostic fault check DFC_MisfDetVWhlReRiOORHi" UBYTE DFC_OneToOne 1 100 0.00 255.0 FORMAT "%5.1" ECU_ADDRESS 0x60034ACF /end MEASUREMENT
/begin MEASUREMENT DFC_st.DFC_MisfDetVWhlReRiRatyHi "Status of DFC / Status of diagnostic fault check DFC_MisfDetVWhlReRiRatyHi" UBYTE DFC_OneToOne 1 100 0.00 255.0 FORMAT "%5.1" ECU_ADDRESS 0x60034AD0 /end MEASUREMENT
/begin MEASUREMENT DFC_st.DFC_MisfDetVWhlReRiRatyLo "Status of DFC / Status of diagnostic fault check DFC_MisfDetVWhlReRiRatyLo" UBYTE DFC_OneToOne 1 100 0.00 255.0 FORMAT "%5.1" ECU_ADDRESS 0x60034AD1 /end MEASUREMENT
/begin MEASUREMENT DFC_st.DFC_MisfDetVWhlReRiStuck "Status of DFC / Status of diagnostic fault check DFC_MisfDetVWhlReRiStuck" UBYTE DFC_OneToOne 1 100 0.00 255.0 FORMAT "%5.1" ECU_ADDRESS 0x60034AD2 /end MEASUREMENT
/begin MEASUREMENT DFC_st.DFC_MisfDetdVWhlFrntLePlaus "Status of DFC / Status of diagnostic fault check DFC_MisfDetdVWhlFrntLePlaus" UBYTE DFC_OneToOne 1 100 0.00 255.0 FORMAT "%5.1" ECU_ADDRESS 0x60034AD3 /end MEASUREMENT
/begin MEASUREMENT DFC_st.DFC_MisfDetdVWhlFrntRiPlaus "Status of DFC / Status of diagnostic fault check DFC_MisfDetdVWhlFrntRiPlaus" UBYTE DFC_OneToOne 1 100 0.00 255.0 FORMAT "%5.1" ECU_ADDRESS 0x60034AD4 /end MEASUREMENT
/begin MEASUREMENT DFC_st.DFC_MisfDetdVWhlReLePlaus "Status of DFC / Status of diagnostic fault check DFC_MisfDetdVWhlReLePlaus" UBYTE DFC_OneToOne 1 100 0.00 255.0 FORMAT "%5.1" ECU_ADDRESS 0x60034AD5 /end MEASUREMENT
/begin MEASUREMENT DFC_st.DFC_MisfDetdVWhlReRiPlaus "Status of DFC / Status of diagnostic fault check DFC_MisfDetdVWhlReRiPlaus" UBYTE DFC_OneToOne 1 100 0.00 255.0 FORMAT "%5.1" ECU_ADDRESS 0x60034AD6 /end MEASUREMENT
/begin MEASUREMENT DFC_st.DFC_PEnvSigRngMax "Status of DFC / Status of diagnostic fault check DFC_PEnvSigRngMax" UBYTE DFC_OneToOne 1 100 0.00 255.0 FORMAT "%5.1" ECU_ADDRESS 0x60034AD7 /end MEASUREMENT
/begin MEASUREMENT DFC_st.DFC_PEnvSigRngMin "Status of DFC / Status of diagnostic fault check DFC_PEnvSigRngMin" UBYTE DFC_OneToOne 1 100 0.00 255.0 FORMAT "%5.1" ECU_ADDRESS 0x60034AD8 /end MEASUREMENT
/begin MEASUREMENT DFC_st.DFC_StmFault "Status of DFC / Status of diagnostic fault check DFC_StmFault" UBYTE DFC_OneToOne 1 100 0.00 255.0 FORMAT "%5.1" ECU_ADDRESS 0x60034AD9 /end MEASUREMENT
/begin MEASUREMENT DFC_st.DFC_StrtCtOffPth "Status of DFC / Status of diagnostic fault check DFC_StrtCtOffPth" UBYTE DFC_OneToOne 1 100 0.00 255.0 FORMAT "%5.1" ECU_ADDRESS 0x60034ADA /end MEASUREMENT
/begin MEASUREMENT DFC_st.DFC_StrtCtlErr "Status of DFC / Status of diagnostic fault check DFC_StrtCtlErr" UBYTE DFC_OneToOne 1 100 0.00 255.0 FORMAT "%5.1" ECU_ADDRESS 0x60034ADB /end MEASUREMENT
/begin MEASUREMENT DFC_st.DFC_StrtFault "Status of DFC / Status of diagnostic fault check DFC_StrtFault" UBYTE DFC_OneToOne 1 100 0.00 255.0 FORMAT "%5.1" ECU_ADDRESS 0x60034ADC /end MEASUREMENT
/begin MEASUREMENT DFC_st.DFC_StrtLckJudg1 "Status of DFC / Status of diagnostic fault check DFC_StrtLckJudg1" UBYTE DFC_OneToOne 1 100 0.00 255.0 FORMAT "%5.1" ECU_ADDRESS 0x60034ADD /end MEASUREMENT
/begin MEASUREMENT DFC_st.DFC_StrtLckJudg2 "Status of DFC / Status of diagnostic fault check DFC_StrtLckJudg2" UBYTE DFC_OneToOne 1 100 0.00 255.0 FORMAT "%5.1" ECU_ADDRESS 0x60034ADE /end MEASUREMENT
/begin MEASUREMENT DFC_st.DFC_StrtOL "Status of DFC / Status of diagnostic fault check DFC_StrtOL" UBYTE DFC_OneToOne 1 100 0.00 255.0 FORMAT "%5.1" ECU_ADDRESS 0x60034ADF /end MEASUREMENT
/begin MEASUREMENT DFC_st.DFC_StrtOL2 "Status of DFC / Status of diagnostic fault check DFC_StrtOL2" UBYTE DFC_OneToOne 1 100 0.00 255.0 FORMAT "%5.1" ECU_ADDRESS 0x60034AE0 /end MEASUREMENT
/begin MEASUREMENT DFC_st.DFC_StrtSCB "Status of DFC / Status of diagnostic fault check DFC_StrtSCB" UBYTE DFC_OneToOne 1 100 0.00 255.0 FORMAT "%5.1" ECU_ADDRESS 0x60034AE1 /end MEASUREMENT
/begin MEASUREMENT DFC_st.DFC_StrtSCB2 "Status of DFC / Status of diagnostic fault check DFC_StrtSCB2" UBYTE DFC_OneToOne 1 100 0.00 255.0 FORMAT "%5.1" ECU_ADDRESS 0x60034AE2 /end MEASUREMENT
/begin MEASUREMENT DFC_st.DFC_StrtSCG "Status of DFC / Status of diagnostic fault check DFC_StrtSCG" UBYTE DFC_OneToOne 1 100 0.00 255.0 FORMAT "%5.1" ECU_ADDRESS 0x60034AE3 /end MEASUREMENT
/begin MEASUREMENT DFC_st.DFC_StrtSCG2 "Status of DFC / Status of diagnostic fault check DFC_StrtSCG2" UBYTE DFC_OneToOne 1 100 0.00 255.0 FORMAT "%5.1" ECU_ADDRESS 0x60034AE4 /end MEASUREMENT
/begin MEASUREMENT DFC_st.DFC_StrtStkRly1 "Status of DFC / Status of diagnostic fault check DFC_StrtStkRly1" UBYTE DFC_OneToOne 1 100 0.00 255.0 FORMAT "%5.1" ECU_ADDRESS 0x60034AE5 /end MEASUREMENT
/begin MEASUREMENT DFC_st.DFC_StrtStkRly2 "Status of DFC / Status of diagnostic fault check DFC_StrtStkRly2" UBYTE DFC_OneToOne 1 100 0.00 255.0 FORMAT "%5.1" ECU_ADDRESS 0x60034AE6 /end MEASUREMENT
/begin MEASUREMENT DFC_st.DFC_TEVEmax "Status of DFC / Status of diagnostic fault check DFC_TEVEmax" UBYTE DFC_OneToOne 1 100 0.00 255.0 FORMAT "%5.1" ECU_ADDRESS 0x60034AE7 /end MEASUREMENT
/begin MEASUREMENT DFC_st.DFC_TEVEmin "Status of DFC / Status of diagnostic fault check DFC_TEVEmin" UBYTE DFC_OneToOne 1 100 0.00 255.0 FORMAT "%5.1" ECU_ADDRESS 0x60034AE8 /end MEASUREMENT
/begin MEASUREMENT DFC_st.DFC_TEVEsig "Status of DFC / Status of diagnostic fault check DFC_TEVEsig" UBYTE DFC_OneToOne 1 100 0.00 255.0 FORMAT "%5.1" ECU_ADDRESS 0x60034AE9 /end MEASUREMENT
/begin MEASUREMENT DFC_st.DFC_VehVAllPlaus "Status of DFC / Status of diagnostic fault check DFC_VehVAllPlaus" UBYTE DFC_OneToOne 1 100 0.00 255.0 FORMAT "%5.1" ECU_ADDRESS 0x60034AEA /end MEASUREMENT
/begin MEASUREMENT DFC_st.DFC_VehVNCSnsrElecFailr "Status of DFC / Status of diagnostic fault check DFC_VehVNCSnsrElecFailr" UBYTE DFC_OneToOne 1 100 0.00 255.0 FORMAT "%5.1" ECU_ADDRESS 0x60034AEB /end MEASUREMENT
/begin MEASUREMENT DFC_st.DFC_VehVPlausCan "Status of DFC / Status of diagnostic fault check DFC_VehVPlausCan" UBYTE DFC_OneToOne 1 100 0.00 255.0 FORMAT "%5.1" ECU_ADDRESS 0x60034AEC /end MEASUREMENT
/begin MEASUREMENT DFC_st.DFC_VehVPlausFco "Status of DFC / Status of diagnostic fault check DFC_VehVPlausFco" UBYTE DFC_OneToOne 1 100 0.00 255.0 FORMAT "%5.1" ECU_ADDRESS 0x60034AED /end MEASUREMENT
/begin MEASUREMENT DFC_st.DFC_VehVPlausPwr "Status of DFC / Status of diagnostic fault check DFC_VehVPlausPwr" UBYTE DFC_OneToOne 1 100 0.00 255.0 FORMAT "%5.1" ECU_ADDRESS 0x60034AEE /end MEASUREMENT
/begin MEASUREMENT DFC_st.DFC_VehVPlausV2N "Status of DFC / Status of diagnostic fault check DFC_VehVPlausV2N" UBYTE DFC_OneToOne 1 100 0.00 255.0 FORMAT "%5.1" ECU_ADDRESS 0x60034AEF /end MEASUREMENT
/begin MEASUREMENT DFC_st.DFC_VehVSpdSnsrAElecFailr "Status of DFC / Status of diagnostic fault check DFC_VehVSpdSnsrAElecFailr" UBYTE DFC_OneToOne 1 100 0.00 255.0 FORMAT "%5.1" ECU_ADDRESS 0x60034AF0 /end MEASUREMENT
/begin MEASUREMENT DFC_st.DFC_VehVSpdSnsrBElecFailr "Status of DFC / Status of diagnostic fault check DFC_VehVSpdSnsrBElecFailr" UBYTE DFC_OneToOne 1 100 0.00 255.0 FORMAT "%5.1" ECU_ADDRESS 0x60034AF1 /end MEASUREMENT
/begin MEASUREMENT DFC_st.DFC_ClthMax "Status of DFC / Status of diagnostic fault check DFC_ClthMax" UBYTE DFC_OneToOne 1 100 0.00 255.0 FORMAT "%5.1" ECU_ADDRESS 0x60034AF2 /end MEASUREMENT
/begin MEASUREMENT DFC_st.DFC_IgnClPs_DevComErr "Status of DFC / Status of diagnostic fault check DFC_IgnClPs_DevComErr" UBYTE DFC_OneToOne 1 100 0.00 255.0 FORMAT "%5.1" ECU_ADDRESS 0x60034AF3 /end MEASUREMENT
/begin MEASUREMENT DFC_st.DFC_IgnClPs_LineOl_0 "Status of DFC / Status of diagnostic fault check DFC_IgnClPs_LineOl_0" UBYTE DFC_OneToOne 1 100 0.00 255.0 FORMAT "%5.1" ECU_ADDRESS 0x60034AF4 /end MEASUREMENT
/begin MEASUREMENT DFC_st.DFC_IgnClPs_LineOl_1 "Status of DFC / Status of diagnostic fault check DFC_IgnClPs_LineOl_1" UBYTE DFC_OneToOne 1 100 0.00 255.0 FORMAT "%5.1" ECU_ADDRESS 0x60034AF5 /end MEASUREMENT
/begin MEASUREMENT DFC_st.DFC_IgnClPs_LineOl_2 "Status of DFC / Status of diagnostic fault check DFC_IgnClPs_LineOl_2" UBYTE DFC_OneToOne 1 100 0.00 255.0 FORMAT "%5.1" ECU_ADDRESS 0x60034AF6 /end MEASUREMENT
/begin MEASUREMENT DFC_st.DFC_IgnClPs_LineOl_3 "Status of DFC / Status of diagnostic fault check DFC_IgnClPs_LineOl_3" UBYTE DFC_OneToOne 1 100 0.00 255.0 FORMAT "%5.1" ECU_ADDRESS 0x60034AF7 /end MEASUREMENT
/begin MEASUREMENT DFC_st.DFC_IgnClPs_LineScb_0 "Status of DFC / Status of diagnostic fault check DFC_IgnClPs_LineScb_0" UBYTE DFC_OneToOne 1 100 0.00 255.0 FORMAT "%5.1" ECU_ADDRESS 0x60034AF8 /end MEASUREMENT
/begin MEASUREMENT DFC_st.DFC_IgnClPs_LineScb_1 "Status of DFC / Status of diagnostic fault check DFC_IgnClPs_LineScb_1" UBYTE DFC_OneToOne 1 100 0.00 255.0 FORMAT "%5.1" ECU_ADDRESS 0x60034AF9 /end MEASUREMENT
/begin MEASUREMENT DFC_st.DFC_IgnClPs_LineScb_2 "Status of DFC / Status of diagnostic fault check DFC_IgnClPs_LineScb_2" UBYTE DFC_OneToOne 1 100 0.00 255.0 FORMAT "%5.1" ECU_ADDRESS 0x60034AFA /end MEASUREMENT
/begin MEASUREMENT DFC_st.DFC_IgnClPs_LineScb_3 "Status of DFC / Status of diagnostic fault check DFC_IgnClPs_LineScb_3" UBYTE DFC_OneToOne 1 100 0.00 255.0 FORMAT "%5.1" ECU_ADDRESS 0x60034AFB /end MEASUREMENT
/begin MEASUREMENT DFC_st.DFC_IgnClPs_LineScg_0 "Status of DFC / Status of diagnostic fault check DFC_IgnClPs_LineScg_0" UBYTE DFC_OneToOne 1 100 0.00 255.0 FORMAT "%5.1" ECU_ADDRESS 0x60034AFC /end MEASUREMENT
/begin MEASUREMENT DFC_st.DFC_IgnClPs_LineScg_1 "Status of DFC / Status of diagnostic fault check DFC_IgnClPs_LineScg_1" UBYTE DFC_OneToOne 1 100 0.00 255.0 FORMAT "%5.1" ECU_ADDRESS 0x60034AFD /end MEASUREMENT
/begin MEASUREMENT DFC_st.DFC_IgnClPs_LineScg_2 "Status of DFC / Status of diagnostic fault check DFC_IgnClPs_LineScg_2" UBYTE DFC_OneToOne 1 100 0.00 255.0 FORMAT "%5.1" ECU_ADDRESS 0x60034AFE /end MEASUREMENT
/begin MEASUREMENT DFC_st.DFC_IgnClPs_LineScg_3 "Status of DFC / Status of diagnostic fault check DFC_IgnClPs_LineScg_3" UBYTE DFC_OneToOne 1 100 0.00 255.0 FORMAT "%5.1" ECU_ADDRESS 0x60034AFF /end MEASUREMENT
/begin MEASUREMENT DFC_st.DFC_UEGOASICS1B1 "Status of DFC / Status of diagnostic fault check DFC_UEGOASICS1B1" UBYTE DFC_OneToOne 1 100 0.00 255.0 FORMAT "%5.1" ECU_ADDRESS 0x60034B00 /end MEASUREMENT
/begin MEASUREMENT DFC_st.DFC_UEGOOLIPES1B1 "Status of DFC / Status of diagnostic fault check DFC_UEGOOLIPES1B1" UBYTE DFC_OneToOne 1 100 0.00 255.0 FORMAT "%5.1" ECU_ADDRESS 0x60034B01 /end MEASUREMENT
/begin MEASUREMENT DFC_st.DFC_UEGOOLRES1B1 "Status of DFC / Status of diagnostic fault check DFC_UEGOOLRES1B1" UBYTE DFC_OneToOne 1 100 0.00 255.0 FORMAT "%5.1" ECU_ADDRESS 0x60034B02 /end MEASUREMENT
/begin MEASUREMENT DFC_st.DFC_UEGOSCBS1B1 "Status of DFC / Status of diagnostic fault check DFC_UEGOSCBS1B1" UBYTE DFC_OneToOne 1 100 0.00 255.0 FORMAT "%5.1" ECU_ADDRESS 0x60034B03 /end MEASUREMENT
/begin MEASUREMENT DFC_st.DFC_UEGOSCGS1B1 "Status of DFC / Status of diagnostic fault check DFC_UEGOSCGS1B1" UBYTE DFC_OneToOne 1 100 0.00 255.0 FORMAT "%5.1" ECU_ADDRESS 0x60034B04 /end MEASUREMENT
/begin MEASUREMENT DFC_st.DFC_UEGOSPIS1B1 "Status of DFC / Status of diagnostic fault check DFC_UEGOSPIS1B1" UBYTE DFC_OneToOne 1 100 0.00 255.0 FORMAT "%5.1" ECU_ADDRESS 0x60034B05 /end MEASUREMENT
/begin MEASUREMENT DFC_st.DFC_UEGOSnsrS1B1 "Status of DFC / Status of diagnostic fault check DFC_UEGOSnsrS1B1" UBYTE DFC_OneToOne 1 100 0.00 255.0 FORMAT "%5.1" ECU_ADDRESS 0x60034B06 /end MEASUREMENT
/begin MEASUREMENT DFC_st.DFC_UegoOlApesS1B1 "Status of DFC / Status of diagnostic fault check DFC_UegoOlApesS1B1" UBYTE DFC_OneToOne 1 100 0.00 255.0 FORMAT "%5.1" ECU_ADDRESS 0x60034B07 /end MEASUREMENT
/begin MEASUREMENT DFC_st.DFC_UegoOlRCmpS1B1 "Status of DFC / Status of diagnostic fault check DFC_UegoOlRCmpS1B1" UBYTE DFC_OneToOne 1 100 0.00 255.0 FORMAT "%5.1" ECU_ADDRESS 0x60034B08 /end MEASUREMENT
/begin MEASUREMENT DFC_st.DFC_AirCCmprOL "Status of DFC / Status of diagnostic fault check DFC_AirCCmprOL" UBYTE DFC_OneToOne 1 100 0.00 255.0 FORMAT "%5.1" ECU_ADDRESS 0x60034B09 /end MEASUREMENT
/begin MEASUREMENT DFC_st.DFC_AirCCmprOvrTemp "Status of DFC / Status of diagnostic fault check DFC_AirCCmprOvrTemp" UBYTE DFC_OneToOne 1 100 0.00 255.0 FORMAT "%5.1" ECU_ADDRESS 0x60034B0A /end MEASUREMENT
/begin MEASUREMENT DFC_st.DFC_AirCCmprSCB "Status of DFC / Status of diagnostic fault check DFC_AirCCmprSCB" UBYTE DFC_OneToOne 1 100 0.00 255.0 FORMAT "%5.1" ECU_ADDRESS 0x60034B0B /end MEASUREMENT
/begin MEASUREMENT DFC_st.DFC_AirCCmprSCG "Status of DFC / Status of diagnostic fault check DFC_AirCCmprSCG" UBYTE DFC_OneToOne 1 100 0.00 255.0 FORMAT "%5.1" ECU_ADDRESS 0x60034B0C /end MEASUREMENT
/begin MEASUREMENT DFC_st.DFC_AltErr "Status of DFC / Status of diagnostic fault check DFC_AltErr" UBYTE DFC_OneToOne 1 100 0.00 255.0 FORMAT "%5.1" ECU_ADDRESS 0x60034B0D /end MEASUREMENT
/begin MEASUREMENT DFC_st.DFC_BattUSRCMax "Status of DFC / Status of diagnostic fault check DFC_BattUSRCMax" UBYTE DFC_OneToOne 1 100 0.00 255.0 FORMAT "%5.1" ECU_ADDRESS 0x60034B0E /end MEASUREMENT
/begin MEASUREMENT DFC_st.DFC_BattUSRCMin "Status of DFC / Status of diagnostic fault check DFC_BattUSRCMin" UBYTE DFC_OneToOne 1 100 0.00 255.0 FORMAT "%5.1" ECU_ADDRESS 0x60034B0F /end MEASUREMENT
/begin MEASUREMENT DFC_st.DFC_ComChksTCU1 "Status of DFC / Status of diagnostic fault check DFC_ComChksTCU1" UBYTE DFC_OneToOne 1 100 0.00 255.0 FORMAT "%5.1" ECU_ADDRESS 0x60034B10 /end MEASUREMENT
/begin MEASUREMENT DFC_st.DFC_ComChksTCU11 "Status of DFC / Status of diagnostic fault check DFC_ComChksTCU11" UBYTE DFC_OneToOne 1 100 0.00 255.0 FORMAT "%5.1" ECU_ADDRESS 0x60034B11 /end MEASUREMENT
/begin MEASUREMENT DFC_st.DFC_ComChksTCU12 "Status of DFC / Status of diagnostic fault check DFC_ComChksTCU12" UBYTE DFC_OneToOne 1 100 0.00 255.0 FORMAT "%5.1" ECU_ADDRESS 0x60034B12 /end MEASUREMENT
/begin MEASUREMENT DFC_st.DFC_ComChksTCU13 "Status of DFC / Status of diagnostic fault check DFC_ComChksTCU13" UBYTE DFC_OneToOne 1 100 0.00 255.0 FORMAT "%5.1" ECU_ADDRESS 0x60034B13 /end MEASUREMENT
/begin MEASUREMENT DFC_st.DFC_ComChksTCU2 "Status of DFC / Status of diagnostic fault check DFC_ComChksTCU2" UBYTE DFC_OneToOne 1 100 0.00 255.0 FORMAT "%5.1" ECU_ADDRESS 0x60034B14 /end MEASUREMENT
/begin MEASUREMENT DFC_st.DFC_ComChksTCU3 "Status of DFC / Status of diagnostic fault check DFC_ComChksTCU3" UBYTE DFC_OneToOne 1 100 0.00 255.0 FORMAT "%5.1" ECU_ADDRESS 0x60034B15 /end MEASUREMENT
/begin MEASUREMENT DFC_st.DFC_ComChksTCU4 "Status of DFC / Status of diagnostic fault check DFC_ComChksTCU4" UBYTE DFC_OneToOne 1 100 0.00 255.0 FORMAT "%5.1" ECU_ADDRESS 0x60034B16 /end MEASUREMENT
/begin MEASUREMENT DFC_st.DFC_ComCntTCU1 "Status of DFC / Status of diagnostic fault check DFC_ComCntTCU1" UBYTE DFC_OneToOne 1 100 0.00 255.0 FORMAT "%5.1" ECU_ADDRESS 0x60034B17 /end MEASUREMENT
/begin MEASUREMENT DFC_st.DFC_ComCntTCU11 "Status of DFC / Status of diagnostic fault check DFC_ComCntTCU11" UBYTE DFC_OneToOne 1 100 0.00 255.0 FORMAT "%5.1" ECU_ADDRESS 0x60034B18 /end MEASUREMENT
/begin MEASUREMENT DFC_st.DFC_ComCntTCU12 "Status of DFC / Status of diagnostic fault check DFC_ComCntTCU12" UBYTE DFC_OneToOne 1 100 0.00 255.0 FORMAT "%5.1" ECU_ADDRESS 0x60034B19 /end MEASUREMENT
/begin MEASUREMENT DFC_st.DFC_ComCntTCU13 "Status of DFC / Status of diagnostic fault check DFC_ComCntTCU13" UBYTE DFC_OneToOne 1 100 0.00 255.0 FORMAT "%5.1" ECU_ADDRESS 0x60034B1A /end MEASUREMENT
/begin MEASUREMENT DFC_st.DFC_ComCntTCU2 "Status of DFC / Status of diagnostic fault check DFC_ComCntTCU2" UBYTE DFC_OneToOne 1 100 0.00 255.0 FORMAT "%5.1" ECU_ADDRESS 0x60034B1B /end MEASUREMENT
/begin MEASUREMENT DFC_st.DFC_ComCntTCU3 "Status of DFC / Status of diagnostic fault check DFC_ComCntTCU3" UBYTE DFC_OneToOne 1 100 0.00 255.0 FORMAT "%5.1" ECU_ADDRESS 0x60034B1C /end MEASUREMENT
/begin MEASUREMENT DFC_st.DFC_ComCntTCU4 "Status of DFC / Status of diagnostic fault check DFC_ComCntTCU4" UBYTE DFC_OneToOne 1 100 0.00 255.0 FORMAT "%5.1" ECU_ADDRESS 0x60034B1D /end MEASUREMENT
/begin MEASUREMENT DFC_st.DFC_ComTOutTCU01 "Status of DFC / Status of diagnostic fault check DFC_ComTOutTCU01" UBYTE DFC_OneToOne 1 100 0.00 255.0 FORMAT "%5.1" ECU_ADDRESS 0x60034B1E /end MEASUREMENT
/begin MEASUREMENT DFC_st.DFC_ComTOutTCU02 "Status of DFC / Status of diagnostic fault check DFC_ComTOutTCU02" UBYTE DFC_OneToOne 1 100 0.00 255.0 FORMAT "%5.1" ECU_ADDRESS 0x60034B1F /end MEASUREMENT
/begin MEASUREMENT DFC_st.DFC_ComTOutTCU1 "Status of DFC / Status of diagnostic fault check DFC_ComTOutTCU1" UBYTE DFC_OneToOne 1 100 0.00 255.0 FORMAT "%5.1" ECU_ADDRESS 0x60034B20 /end MEASUREMENT
/begin MEASUREMENT DFC_st.DFC_ComTOutTCU11 "Status of DFC / Status of diagnostic fault check DFC_ComTOutTCU11" UBYTE DFC_OneToOne 1 100 0.00 255.0 FORMAT "%5.1" ECU_ADDRESS 0x60034B21 /end MEASUREMENT
/begin MEASUREMENT DFC_st.DFC_ComTOutTCU12 "Status of DFC / Status of diagnostic fault check DFC_ComTOutTCU12" UBYTE DFC_OneToOne 1 100 0.00 255.0 FORMAT "%5.1" ECU_ADDRESS 0x60034B22 /end MEASUREMENT
/begin MEASUREMENT DFC_st.DFC_ComTOutTCU13 "Status of DFC / Status of diagnostic fault check DFC_ComTOutTCU13" UBYTE DFC_OneToOne 1 100 0.00 255.0 FORMAT "%5.1" ECU_ADDRESS 0x60034B23 /end MEASUREMENT
/begin MEASUREMENT DFC_st.DFC_ComTOutTCU14 "Status of DFC / Status of diagnostic fault check DFC_ComTOutTCU14" UBYTE DFC_OneToOne 1 100 0.00 255.0 FORMAT "%5.1" ECU_ADDRESS 0x60034B24 /end MEASUREMENT
/begin MEASUREMENT DFC_st.DFC_ComTOutTCU2 "Status of DFC / Status of diagnostic fault check DFC_ComTOutTCU2" UBYTE DFC_OneToOne 1 100 0.00 255.0 FORMAT "%5.1" ECU_ADDRESS 0x60034B25 /end MEASUREMENT
/begin MEASUREMENT DFC_st.DFC_ComTOutTCU3 "Status of DFC / Status of diagnostic fault check DFC_ComTOutTCU3" UBYTE DFC_OneToOne 1 100 0.00 255.0 FORMAT "%5.1" ECU_ADDRESS 0x60034B26 /end MEASUREMENT
/begin MEASUREMENT DFC_st.DFC_ComTOutTCU4 "Status of DFC / Status of diagnostic fault check DFC_ComTOutTCU4" UBYTE DFC_OneToOne 1 100 0.00 255.0 FORMAT "%5.1" ECU_ADDRESS 0x60034B27 /end MEASUREMENT
/begin MEASUREMENT DFC_st.DFC_DevLibBattUHi "Status of DFC / Status of diagnostic fault check DFC_DevLibBattUHi" UBYTE DFC_OneToOne 1 100 0.00 255.0 FORMAT "%5.1" ECU_ADDRESS 0x60034B28 /end MEASUREMENT
/begin MEASUREMENT DFC_st.DFC_DevLibBattULo "Status of DFC / Status of diagnostic fault check DFC_DevLibBattULo" UBYTE DFC_OneToOne 1 100 0.00 255.0 FORMAT "%5.1" ECU_ADDRESS 0x60034B29 /end MEASUREMENT
/begin MEASUREMENT DFC_st.DFC_FanDIOOL_0 "Status of DFC / Status of diagnostic fault check DFC_FanDIOOL_0" UBYTE DFC_OneToOne 1 100 0.00 255.0 FORMAT "%5.1" ECU_ADDRESS 0x60034B2A /end MEASUREMENT
/begin MEASUREMENT DFC_st.DFC_FanDIOOL_1 "Status of DFC / Status of diagnostic fault check DFC_FanDIOOL_1" UBYTE DFC_OneToOne 1 100 0.00 255.0 FORMAT "%5.1" ECU_ADDRESS 0x60034B2B /end MEASUREMENT
/begin MEASUREMENT DFC_st.DFC_FanDIOOvrTemp_0 "Status of DFC / Status of diagnostic fault check DFC_FanDIOOvrTemp_0" UBYTE DFC_OneToOne 1 100 0.00 255.0 FORMAT "%5.1" ECU_ADDRESS 0x60034B2C /end MEASUREMENT
/begin MEASUREMENT DFC_st.DFC_FanDIOOvrTemp_1 "Status of DFC / Status of diagnostic fault check DFC_FanDIOOvrTemp_1" UBYTE DFC_OneToOne 1 100 0.00 255.0 FORMAT "%5.1" ECU_ADDRESS 0x60034B2D /end MEASUREMENT
/begin MEASUREMENT DFC_st.DFC_FanDIOSCB_0 "Status of DFC / Status of diagnostic fault check DFC_FanDIOSCB_0" UBYTE DFC_OneToOne 1 100 0.00 255.0 FORMAT "%5.1" ECU_ADDRESS 0x60034B2E /end MEASUREMENT
/begin MEASUREMENT DFC_st.DFC_FanDIOSCB_1 "Status of DFC / Status of diagnostic fault check DFC_FanDIOSCB_1" UBYTE DFC_OneToOne 1 100 0.00 255.0 FORMAT "%5.1" ECU_ADDRESS 0x60034B2F /end MEASUREMENT
/begin MEASUREMENT DFC_st.DFC_FanDIOSCG_0 "Status of DFC / Status of diagnostic fault check DFC_FanDIOSCG_0" UBYTE DFC_OneToOne 1 100 0.00 255.0 FORMAT "%5.1" ECU_ADDRESS 0x60034B30 /end MEASUREMENT
/begin MEASUREMENT DFC_st.DFC_FanDIOSCG_1 "Status of DFC / Status of diagnostic fault check DFC_FanDIOSCG_1" UBYTE DFC_OneToOne 1 100 0.00 255.0 FORMAT "%5.1" ECU_ADDRESS 0x60034B31 /end MEASUREMENT
/begin MEASUREMENT DFC_st.DFC_MRlyDcOL "Status of DFC / Status of diagnostic fault check DFC_MRlyDcOL" UBYTE DFC_OneToOne 1 100 0.00 255.0 FORMAT "%5.1" ECU_ADDRESS 0x60034B32 /end MEASUREMENT
/begin MEASUREMENT DFC_st.DFC_MRlyDcSCB "Status of DFC / Status of diagnostic fault check DFC_MRlyDcSCB" UBYTE DFC_OneToOne 1 100 0.00 255.0 FORMAT "%5.1" ECU_ADDRESS 0x60034B33 /end MEASUREMENT
/begin MEASUREMENT DFC_st.DFC_MRlyDcSCG "Status of DFC / Status of diagnostic fault check DFC_MRlyDcSCG" UBYTE DFC_OneToOne 1 100 0.00 255.0 FORMAT "%5.1" ECU_ADDRESS 0x60034B34 /end MEASUREMENT
/begin MEASUREMENT DFC_st.DFC_PSPOL "Status of DFC / Status of diagnostic fault check DFC_PSPOL" UBYTE DFC_OneToOne 1 100 0.00 255.0 FORMAT "%5.1" ECU_ADDRESS 0x60034B35 /end MEASUREMENT
/begin MEASUREMENT DFC_st.DFC_PSPOvrTemp "Status of DFC / Status of diagnostic fault check DFC_PSPOvrTemp" UBYTE DFC_OneToOne 1 100 0.00 255.0 FORMAT "%5.1" ECU_ADDRESS 0x60034B36 /end MEASUREMENT
/begin MEASUREMENT DFC_st.DFC_PSPSCB "Status of DFC / Status of diagnostic fault check DFC_PSPSCB" UBYTE DFC_OneToOne 1 100 0.00 255.0 FORMAT "%5.1" ECU_ADDRESS 0x60034B37 /end MEASUREMENT
/begin MEASUREMENT DFC_st.DFC_PSPSCG "Status of DFC / Status of diagnostic fault check DFC_PSPSCG" UBYTE DFC_OneToOne 1 100 0.00 255.0 FORMAT "%5.1" ECU_ADDRESS 0x60034B38 /end MEASUREMENT
/begin MEASUREMENT DFC_st.DFC_T50Err "Status of DFC / Status of diagnostic fault check DFC_T50Err" UBYTE DFC_OneToOne 1 100 0.00 255.0 FORMAT "%5.1" ECU_ADDRESS 0x60034B39 /end MEASUREMENT
/begin MEASUREMENT DFC_st.DFC_ThrVlvLoBattB1 "Status of DFC / Status of diagnostic fault check DFC_ThrVlvLoBattB1" UBYTE DFC_OneToOne 1 100 0.00 255.0 FORMAT "%5.1" ECU_ADDRESS 0x60034B3A /end MEASUREMENT
/begin MEASUREMENT DFC_st.DFC_VehVPhysRngHi "Status of DFC / Status of diagnostic fault check DFC_VehVPhysRngHi" UBYTE DFC_OneToOne 1 100 0.00 255.0 FORMAT "%5.1" ECU_ADDRESS 0x60034B3B /end MEASUREMENT
/begin MEASUREMENT DFC_st.DFC_VehVSclOutOL "Status of DFC / Status of diagnostic fault check DFC_VehVSclOutOL" UBYTE DFC_OneToOne 1 100 0.00 255.0 FORMAT "%5.1" ECU_ADDRESS 0x60034B3C /end MEASUREMENT
/begin MEASUREMENT DFC_st.DFC_VehVSclOutOT "Status of DFC / Status of diagnostic fault check DFC_VehVSclOutOT" UBYTE DFC_OneToOne 1 100 0.00 255.0 FORMAT "%5.1" ECU_ADDRESS 0x60034B3D /end MEASUREMENT
/begin MEASUREMENT DFC_st.DFC_VehVSclOutSCB "Status of DFC / Status of diagnostic fault check DFC_VehVSclOutSCB" UBYTE DFC_OneToOne 1 100 0.00 255.0 FORMAT "%5.1" ECU_ADDRESS 0x60034B3E /end MEASUREMENT
/begin MEASUREMENT DFC_st.DFC_VehVSclOutSCG "Status of DFC / Status of diagnostic fault check DFC_VehVSclOutSCG" UBYTE DFC_OneToOne 1 100 0.00 255.0 FORMAT "%5.1" ECU_ADDRESS 0x60034B3F /end MEASUREMENT
/begin MEASUREMENT DFC_st.DFC_VehVSnsrARngHi "Status of DFC / Status of diagnostic fault check DFC_VehVSnsrARngHi" UBYTE DFC_OneToOne 1 100 0.00 255.0 FORMAT "%5.1" ECU_ADDRESS 0x60034B40 /end MEASUREMENT
/begin MEASUREMENT DFC_st.DFC_VehVSnsrBRngHi "Status of DFC / Status of diagnostic fault check DFC_VehVSnsrBRngHi" UBYTE DFC_OneToOne 1 100 0.00 255.0 FORMAT "%5.1" ECU_ADDRESS 0x60034B41 /end MEASUREMENT
/begin MEASUREMENT DFC_st.DFC_VehVSpdRtyDiag "Status of DFC / Status of diagnostic fault check DFC_VehVSpdRtyDiag" UBYTE DFC_OneToOne 1 100 0.00 255.0 FORMAT "%5.1" ECU_ADDRESS 0x60034B42 /end MEASUREMENT
/begin MEASUREMENT DFC_st.DFC_VehVWhlErr "Status of DFC / Status of diagnostic fault check DFC_VehVWhlErr" UBYTE DFC_OneToOne 1 100 0.00 255.0 FORMAT "%5.1" ECU_ADDRESS 0x60034B43 /end MEASUREMENT
/begin MEASUREMENT DFC_st.DFC_ACEvpTSRCMax "Status of DFC / Status of diagnostic fault check DFC_ACEvpTSRCMax" UBYTE DFC_OneToOne 1 100 0.00 255.0 FORMAT "%5.1" ECU_ADDRESS 0x60034B44 /end MEASUREMENT
/begin MEASUREMENT DFC_st.DFC_ACEvpTSRCMin "Status of DFC / Status of diagnostic fault check DFC_ACEvpTSRCMin" UBYTE DFC_OneToOne 1 100 0.00 255.0 FORMAT "%5.1" ECU_ADDRESS 0x60034B45 /end MEASUREMENT
/begin MEASUREMENT DFC_st.DFC_AirCClntPAnaSRCMax "Status of DFC / Status of diagnostic fault check DFC_AirCClntPAnaSRCMax" UBYTE DFC_OneToOne 1 100 0.00 255.0 FORMAT "%5.1" ECU_ADDRESS 0x60034B46 /end MEASUREMENT
/begin MEASUREMENT DFC_st.DFC_AirCClntPAnaSRCMin "Status of DFC / Status of diagnostic fault check DFC_AirCClntPAnaSRCMin" UBYTE DFC_OneToOne 1 100 0.00 255.0 FORMAT "%5.1" ECU_ADDRESS 0x60034B47 /end MEASUREMENT
/begin MEASUREMENT DFC_st.DFC_AirCSwtNpl "Status of DFC / Status of diagnostic fault check DFC_AirCSwtNpl" UBYTE DFC_OneToOne 1 100 0.00 255.0 FORMAT "%5.1" ECU_ADDRESS 0x60034B48 /end MEASUREMENT
/begin MEASUREMENT DFC_st.DFC_AirCSwtSig "Status of DFC / Status of diagnostic fault check DFC_AirCSwtSig" UBYTE DFC_OneToOne 1 100 0.00 255.0 FORMAT "%5.1" ECU_ADDRESS 0x60034B49 /end MEASUREMENT
/begin MEASUREMENT DFC_st.DFC_Brk "Status of DFC / Status of diagnostic fault check DFC_Brk" UBYTE DFC_OneToOne 1 100 0.00 255.0 FORMAT "%5.1" ECU_ADDRESS 0x60034B4A /end MEASUREMENT
/begin FUNCTION DFC "30000.33.0Diagnostic Fault Check"
 /begin OUT_MEASUREMENT DFC_b.TSC_PEnvSigRngMin DFC_b.TSC_StmFault DFC_b.TSC_StrtCtOffPth DFC_b.TSC_StrtCtlErr DFC_b.TSC_StrtFault DFC_b.TSC_StrtLckJudg1 DFC_b.TSC_StrtLckJudg2 DFC_b.TSC_StrtOL DFC_b.TSC_StrtOL2 DFC_b.TSC_StrtSCB DFC_b.TSC_StrtSCB2 DFC_b.TSC_StrtSCG DFC_b.TSC_StrtSCG2 DFC_b.TSC_StrtStkRly1 DFC_b.TSC_StrtStkRly2 DFC_b.TSC_TEVEmax DFC_b.TSC_TEVEmin DFC_b.TSC_TEVEsig DFC_b.TSC_VehVAllPlaus DFC_b.TSC_VehVNCSnsrElecFailr DFC_b.TSC_VehVPlausCan DFC_b.TSC_VehVPlausFco DFC_b.TSC_VehVPlausPwr DFC_b.TSC_VehVPlausV2N DFC_b.TSC_VehVSpdSnsrAElecFailr DFC_b.TSC_VehVSpdSnsrBElecFailr DFC_b.TSC_ClthMax DFC_b.TSC_IgnClPs_DevComErr DFC_b.TSC_IgnClPs_LineOl_0 DFC_b.TSC_IgnClPs_LineOl_1 DFC_b.TSC_IgnClPs_LineOl_2 DFC_b.TSC_IgnClPs_LineOl_3 DFC_b.TSC_IgnClPs_LineScb_0 DFC_b.TSC_IgnClPs_LineScb_1 DFC_b.TSC_IgnClPs_LineScb_2 DFC_b.TSC_IgnClPs_LineScb_3 DFC_b.TSC_IgnClPs_LineScg_0 DFC_b.TSC_IgnClPs_LineScg_1 DFC_b.TSC_IgnClPs_LineScg_2 DFC_b.TSC_IgnClPs_LineScg_3 DFC_b.TSC_UEGOASICS1B1 DFC_b.TSC_UEGOOLIPES1B1 DFC_b.TSC_UEGOOLRES1B1 DFC_b.TSC_UEGOSCBS1B1 DFC_b.TSC_UEGOSCGS1B1 DFC_b.TSC_UEGOSPIS1B1 DFC_b.TSC_UEGOSnsrS1B1 DFC_b.TSC_UegoOlApesS1B1 DFC_b.TSC_UegoOlRCmpS1B1 DFC_b.TSC_AirCCmprOL DFC_b.TSC_AirCCmprOvrTemp DFC_b.TSC_AirCCmprSCB DFC_b.TSC_AirCCmprSCG DFC_b.TSC_AltErr DFC_b.TSC_BattUSRCMax DFC_b.TSC_BattUSRCMin DFC_b.TSC_ComChksTCU1 DFC_b.TSC_ComChksTCU11 DFC_b.TSC_ComChksTCU12 DFC_b.TSC_ComChksTCU13 DFC_b.TSC_ComChksTCU2 DFC_b.TSC_ComChksTCU3 DFC_b.TSC_ComChksTCU4 DFC_b.TSC_ComCntTCU1 DFC_b.TSC_ComCntTCU11 DFC_b.TSC_ComCntTCU12 DFC_b.TSC_ComCntTCU13 DFC_b.TSC_ComCntTCU2 DFC_b.TSC_ComCntTCU3 DFC_b.TSC_ComCntTCU4 DFC_b.TSC_ComTOutTCU01 DFC_b.TSC_ComTOutTCU02 DFC_b.TSC_ComTOutTCU1 DFC_b.TSC_ComTOutTCU11 DFC_b.TSC_ComTOutTCU12 DFC_b.TSC_ComTOutTCU13 DFC_b.TSC_ComTOutTCU14 DFC_b.TSC_ComTOutTCU2 DFC_b.TSC_ComTOutTCU3 DFC_b.TSC_ComTOutTCU4 DFC_b.TSC_DevLibBattUHi DFC_b.TSC_DevLibBattULo DFC_b.TSC_FanDIOOL_0 DFC_b.TSC_FanDIOOL_1 DFC_b.TSC_FanDIOOvrTemp_0 DFC_b.TSC_FanDIOOvrTemp_1 DFC_b.TSC_FanDIOSCB_0 DFC_b.TSC_FanDIOSCB_1 DFC_b.TSC_FanDIOSCG_0 DFC_b.TSC_FanDIOSCG_1 DFC_b.TSC_MRlyDcOL DFC_b.TSC_MRlyDcSCB DFC_b.TSC_MRlyDcSCG DFC_b.TSC_PSPOL DFC_b.TSC_PSPOvrTemp DFC_b.TSC_PSPSCB DFC_b.TSC_PSPSCG DFC_b.TSC_T50Err DFC_b.TSC_ThrVlvLoBattB1 DFC_b.TSC_VehVPhysRngHi DFC_b.TSC_VehVSclOutOL DFC_b.TSC_VehVSclOutOT DFC_b.TSC_VehVSclOutSCB DFC_b.TSC_VehVSclOutSCG DFC_b.TSC_VehVSnsrARngHi DFC_b.TSC_VehVSnsrBRngHi DFC_b.TSC_VehVSpdRtyDiag DFC_b.TSC_VehVWhlErr DFC_b.TSC_ACEvpTSRCMax DFC_b.TSC_ACEvpTSRCMin DFC_b.TSC_AirCClntPAnaSRCMax DFC_b.TSC_AirCClntPAnaSRCMin DFC_b.TSC_AirCSwtNpl DFC_b.TSC_AirCSwtSig DFC_b.TSC_Brk DFC_b.TSC_BrkSig DFC_b.TSC_ClthSig DFC_b.TSC_HLSDemOvhtEngLim DFC_b.TSC_OilPNpl DFC_b.TSC_PIntkVUsLineHiB1 DFC_b.TSC_PIntkVUsLineLoB1 DFC_b.TSC_VehVPhysRngLo DFC_b.TSC_VehVSigCan DFC_b.TSC_VehVSigCanSafe DFC_b.TSC_VlvLftFbOilPSnsrIntk11SRCMax DFC_b.TSC_VlvLftFbOilPSnsrIntk11SRCMin DFC_b.TSC_ClthNpl DFC_b.TSC_EV1max DFC_b.TSC_EV1min DFC_b.TSC_EV1sig DFC_b.TSC_EV2max DFC_b.TSC_EV2min DFC_b.TSC_EV2sig DFC_b.TSC_EV3max DFC_b.TSC_EV3min DFC_b.TSC_EV3sig DFC_b.TSC_EV4max DFC_b.TSC_EV4min DFC_b.TSC_EV4sig DFC_b.TSC_GbxPNPosnDrvCdn DFC_b.TSC_GbxPNPosnPlausy DFC_b.TSC_PEnvCcMax DFC_b.TSC_PEnvCcMin DFC_b.TSC_PEnvRngChkMax DFC_b.TSC_PEnvRngChkMin DFC_b.TSC_PEnvSnsrPlaus DFC_b.TSC_UEGOHeatrPsS1B1Max DFC_b.TSC_UEGOHeatrPsS1B1Min DFC_b.TSC_UEGOHeatrPsS1B1Sig DFC_b.TSC_UEGOHeatrRlyPsOLS1B1 DFC_b.TSC_UEGOHeatrRlyPsSCBS1B1 DFC_b.TSC_UEGOHeatrRlyPsSCGS1B1 DFC_b.TSC_KnDetSens1PortAMax DFC_b.TSC_KnDetSens1PortAMin DFC_b.TSC_KnDetSens1PortBMax DFC_b.TSC_KnDetSens1PortBMin DFC_b.TSC_Clth2ONStuck DFC_b.TSC_Clth2ONStuckLdc DFC_b.TSC_Clth3ONStuckLdc DFC_b.TSC_Clth3ONStuckPostDrv DFC_b.TSC_Clth4ONStuck DFC_b.TSC_Clth4ONStuckLdc DFC_b.TSC_ComDLCTCU01 DFC_b.TSC_ComDLCTCU02 DFC_b.TSC_ComDLCTCU1 DFC_b.TSC_ComDLCTCU11 DFC_b.TSC_ComDLCTCU12 DFC_b.TSC_ComDLCTCU13 DFC_b.TSC_ComDLCTCU14 DFC_b.TSC_ComDLCTCU2 DFC_b.TSC_ComDLCTCU3 DFC_b.TSC_ComDLCTCU4 DFC_b.TSC_EVX DFC_b.TSC_EbsSocFlt DFC_b.TSC_I14229VINErr DFC_b.TSC_LLRKHmax DFC_b.TSC_LLRKHmin DFC_b.TSC_LLRmax DFC_b.TSC_LLRmin DFC_b.TSC_RoughRoad DFC_b.TSC_SiaEEPRdErr DFC_b.TSC_SiaEEPWrngCod DFC_b.TSC_UegoDummy DFC_b.TSC_BusDiagCANAPPLBusOff DFC_b.TSC_BusDiagCANCANCBusOff DFC_b.TSC_BusDiagCANVEHICLEBusOff DFC_b.TSC_RBA_IODIAGPWR_rba_IoExtCy329_SignalVltSply_0 DFC_b.TSC_RBA_IODIAGPWR_rba_IoExtCy329_SignalVltSply_0OT DFC_b.TSC_RBA_IODIAGPWR_rba_IoExtCy329_SignalVltSply_0OV DFC_b.TSC_RBA_IODIAGPWR_rba_IoExtCy329_SignalVltSply_0SCG DFC_b.TSC_RBA_IODIAGPWR_rba_IoExtCy329_SignalVltSply_0UV DFC_b.TSC_RBA_IODIAGPWR_rba_IoExtCy329_SignalVltSply_1 DFC_b.TSC_RBA_IODIAGPWR_rba_IoExtCy329_SignalVltSply_1OT DFC_b.TSC_RBA_IODIAGPWR_rba_IoExtCy329_SignalVltSply_1OV DFC_b.TSC_RBA_IODIAGPWR_rba_IoExtCy329_SignalVltSply_1SCG DFC_b.TSC_RBA_IODIAGPWR_rba_IoExtCy329_SignalVltSply_1UV DFC_b.TSC_RBA_IODIAGPWR_rba_IoExtCy329_SignalVltSply_2 DFC_b.TSC_RBA_IODIAGPWR_rba_IoExtCy329_SignalVltSply_2OT DFC_b.TSC_RBA_IODIAGPWR_rba_IoExtCy329_SignalVltSply_2OV DFC_b.TSC_RBA_IODIAGPWR_rba_IoExtCy329_SignalVltSply_2SCG DFC_b.TSC_RBA_IODIAGPWR_rba_IoExtCy329_SignalVltSply_2UV DFC_b.TSC_CAN_E_TIMEOUT DFC_b.TSC_LIN_E_TIMEOUT DFC_b.TSC_MRlyOL DFC_b.TSC_MRlySCB DFC_b.TSC_MRlySCG DFC_b.TSC_rba_MultiStackTrace_Threshold DFC_b.TSC_BSWM_E_ACTION_FAILED DFC_b.TSC_BSWM_E_INTRPTQUEUE_FULL DFC_b.TSC_RBA_IOEXTLIB_KEEPALIVE_DRV DFC_b.TSC_RBA_IOEXTLIB_KEEPALIVE_INI DFC_b.TSC_rba_IoSigRtc_StopCounter DFC_b.TSC_rba_MRly_Diag_Stk_Event DFC_b.TSC_rba_MemDiag_MemReadErr DFC_b.TSC_rba_MemDiag_MemWrErr DFC_b.TSC_rba_SyC_IrrSwOffTrigEngRun_Event DFC_b.TSC_rba_T15_Diag_ComInVld_Event DFC_b.TSC_rba_T15_Diag_ComOff_HwOn_Event DFC_b.TSC_rba_T15_Diag_ComOn_HwOff_Event DFC_b.TSC_AppAllSnsrDfct DFC_b.TSC_BattUStdbyDiaOL DFC_b.TSC_BigLeakIntkMnfldEmiInfl DFC_b.TSC_BrkMnSwtContOnWarnLmp DFC_b.TSC_BrkMnSwtNotStpWarnLmp DFC_b.TSC_BrkRdntSwtContOnWarnLmp DFC_b.TSC_BrkRdntSwtNotStpWarnLmp DFC_b.TSC_CEngDsTColdStrtMax DFC_b.TSC_CEngDsTColdStrtMin DFC_b.TSC_CEngDsTImps DFC_b.TSC_CEngDsTPlausLSC DFC_b.TSC_CEngDsTPlausSTC DFC_b.TSC_CEngDsTSRCMax DFC_b.TSC_CEngDsTSRCMin DFC_b.TSC_CEngDsTSig DFC_b.TSC_CEngUsTSRCMax DFC_b.TSC_CEngUsTSRCMin DFC_b.TSC_DCDCFltDet DFC_b.TSC_DKRSA DFC_b.TSC_DKVSmax DFC_b.TSC_DKnpl DFC_b.TSC_DSSmax DFC_b.TSC_DSTTI DFC_b.TSC_DSUmax DFC_b.TSC_EGRVlvOL DFC_b.TSC_EGRVlvSCB DFC_b.TSC_EGRVlvSCG DFC_b.TSC_EGSDUS2B1LtrDly DFC_b.TSC_EGSDUS2B1LtrPT1 DFC_b.TSC_EGSDUS2B1RtlDly DFC_b.TSC_EGSDUS2B1RtlPT1 DFC_b.TSC_EGSDUS2B1TarLean DFC_b.TSC_EGSDUS2B1TarRich DFC_b.TSC_ETAKHLmax DFC_b.TSC_ETAKHTmax DFC_b.TSC_EngICO DFC_b.TSC_EngPrtOvrSpdMon DFC_b.TSC_EpmCaSI1ErrSig DFC_b.TSC_EpmCaSI1NoSig DFC_b.TSC_EpmCaSI1OfsErr DFC_b.TSC_EpmCrSErrSig DFC_b.TSC_EpmCrSNoSig DFC_b.TSC_EtaEngIdleNonCsers DFC_b.TSC_EtaEngPtlNonCsers DFC_b.TSC_FRAmax DFC_b.TSC_FRAmin DFC_b.TSC_GbxRvsSwtStk DFC_b.TSC_HDRmax DFC_b.TSC_HEGOS2B1ElecMax DFC_b.TSC_HEGOS2B1ElecMin DFC_b.TSC_HEGOS2B1ElecSig DFC_b.TSC_HEGOS2B1HtgNpl DFC_b.TSC_IntkAirTIntkMnfldCrssMax DFC_b.TSC_IntkAirTIntkMnfldCrssMin DFC_b.TSC_IntkAirTIntkMnfldHSCMax DFC_b.TSC_IntkAirTIntkMnfldImps DFC_b.TSC_IntkAirTIntkMnfldPRCMax DFC_b.TSC_IntkAirTIntkMnfldPRCMin DFC_b.TSC_IntkAirTIntkMnfldSRCMax DFC_b.TSC_IntkAirTIntkMnfldSRCMin DFC_b.TSC_IntkAirTIntkMnfldSTC DFC_b.TSC_KS1max DFC_b.TSC_KS1min DFC_b.TSC_LMmax DFC_b.TSC_LZSRnpl DFC_b.TSC_LamDynDiagS1B1 DFC_b.TSC_LeakIntkMnfldEmiInfl DFC_b.TSC_MD00max DFC_b.TSC_MDBmax DFC_b.TSC_MDCat DFC_b.TSC_MDCatCrit DFC_b.TSC_MDCatCurr DFC_b.TSC_MDCyl_0 DFC_b.TSC_MDCyl_1 DFC_b.TSC_MDCyl_2 DFC_b.TSC_MDCyl_3 DFC_b.TSC_MDEmi DFC_b.TSC_MDEmiStrt DFC_b.TSC_MDFco DFC_b.TSC_MDMpl DFC_b.TSC_MDSegTiAdpn DFC_b.TSC_MDmax DFC_b.TSC_MOXEMM_SMU_ALM0_0 DFC_b.TSC_MOXEMM_SMU_ALM0_1 DFC_b.TSC_MOXEMM_SMU_ALM0_10 DFC_b.TSC_MOXEMM_SMU_ALM0_11 DFC_b.TSC_MOXEMM_SMU_ALM0_13 DFC_b.TSC_MOXEMM_SMU_ALM0_14 DFC_b.TSC_MOXEMM_SMU_ALM0_2 DFC_b.TSC_MOXEMM_SMU_ALM0_22 DFC_b.TSC_MOXEMM_SMU_ALM0_23 DFC_b.TSC_MOXEMM_SMU_ALM0_4 DFC_b.TSC_MOXEMM_SMU_ALM0_5 DFC_b.TSC_MOXEMM_SMU_ALM0_7 DFC_b.TSC_MOXEMM_SMU_ALM0_8 DFC_b.TSC_MOXEMM_SMU_ALM10_16 DFC_b.TSC_MOXEMM_SMU_ALM10_17 DFC_b.TSC_MOXEMM_SMU_ALM10_21 DFC_b.TSC_MOXEMM_SMU_ALM11_0 DFC_b.TSC_MOXEMM_SMU_ALM11_1 DFC_b.TSC_MOXEMM_SMU_ALM11_2 DFC_b.TSC_MOXEMM_SMU_ALM11_3 DFC_b.TSC_MOXEMM_SMU_ALM11_4 DFC_b.TSC_MOXEMM_SMU_ALM11_5 DFC_b.TSC_MOXEMM_SMU_ALM11_8 DFC_b.TSC_MOXEMM_SMU_ALM11_9 DFC_b.TSC_MOXEMM_SMU_ALM1_0 DFC_b.TSC_MOXEMM_SMU_ALM1_1 DFC_b.TSC_MOXEMM_SMU_ALM1_10 DFC_b.TSC_MOXEMM_SMU_ALM1_11 DFC_b.TSC_MOXEMM_SMU_ALM1_13 DFC_b.TSC_MOXEMM_SMU_ALM1_14 DFC_b.TSC_MOXEMM_SMU_ALM1_2 DFC_b.TSC_MOXEMM_SMU_ALM1_22 DFC_b.TSC_MOXEMM_SMU_ALM1_23 DFC_b.TSC_MOXEMM_SMU_ALM1_4 DFC_b.TSC_MOXEMM_SMU_ALM1_5 DFC_b.TSC_MOXEMM_SMU_ALM1_7 DFC_b.TSC_MOXEMM_SMU_ALM1_8 DFC_b.TSC_MOXEMM_SMU_ALM21_0 DFC_b.TSC_MOXEMM_SMU_ALM21_16 DFC_b.TSC_MOXEMM_SMU_ALM21_3 DFC_b.TSC_MOXEMM_SMU_ALM2_1 DFC_b.TSC_MOXEMM_SMU_ALM2_10 DFC_b.TSC_MOXEMM_SMU_ALM2_11 DFC_b.TSC_MOXEMM_SMU_ALM2_13 DFC_b.TSC_MOXEMM_SMU_ALM2_14 DFC_b.TSC_MOXEMM_SMU_ALM2_22 DFC_b.TSC_MOXEMM_SMU_ALM2_23 DFC_b.TSC_MOXEMM_SMU_ALM2_4 DFC_b.TSC_MOXEMM_SMU_ALM2_5 DFC_b.TSC_MOXEMM_SMU_ALM2_7 DFC_b.TSC_MOXEMM_SMU_ALM2_8 DFC_b.TSC_MOXEMM_SMU_ALM6_0 DFC_b.TSC_MOXEMM_SMU_ALM6_11 DFC_b.TSC_MOXEMM_SMU_ALM6_12 DFC_b.TSC_MOXEMM_SMU_ALM6_14 DFC_b.TSC_MOXEMM_SMU_ALM6_15 DFC_b.TSC_MOXEMM_SMU_ALM6_17 DFC_b.TSC_MOXEMM_SMU_ALM6_18 DFC_b.TSC_MOXEMM_SMU_ALM6_20 DFC_b.TSC_MOXEMM_SMU_ALM6_21 DFC_b.TSC_MOXEMM_SMU_ALM6_25 DFC_b.TSC_MOXEMM_SMU_ALM6_4 DFC_b.TSC_MOXEMM_SMU_ALM6_5 DFC_b.TSC_MOXEMM_SMU_ALM6_7 DFC_b.TSC_MOXEMM_SMU_ALM6_8 DFC_b.TSC_MOXEMM_SMU_ALM7_1 DFC_b.TSC_MOXEMM_SMU_ALM7_12 DFC_b.TSC_MOXEMM_SMU_ALM7_13 DFC_b.TSC_MOXEMM_SMU_ALM7_14 DFC_b.TSC_MOXEMM_SMU_ALM7_15 DFC_b.TSC_MOXEMM_SMU_ALM7_16 DFC_b.TSC_MOXEMM_SMU_ALM7_17 DFC_b.TSC_MOXEMM_SMU_ALM7_2 DFC_b.TSC_MOXEMM_SMU_ALM7_20 DFC_b.TSC_MOXEMM_SMU_ALM7_25 DFC_b.TSC_MOXEMM_SMU_ALM7_26 DFC_b.TSC_MOXEMM_SMU_ALM7_28 DFC_b.TSC_MOXEMM_SMU_ALM7_29 DFC_b.TSC_MOXEMM_SMU_ALM7_30 DFC_b.TSC_MOXEMM_SMU_ALM7_31 DFC_b.TSC_MOXEMM_SMU_ALM8_0 DFC_b.TSC_MOXEMM_SMU_ALM8_1 DFC_b.TSC_MOXEMM_SMU_ALM8_10 DFC_b.TSC_MOXEMM_SMU_ALM8_11 DFC_b.TSC_MOXEMM_SMU_ALM8_12 DFC_b.TSC_MOXEMM_SMU_ALM8_16 DFC_b.TSC_MOXEMM_SMU_ALM8_18 DFC_b.TSC_MOXEMM_SMU_ALM8_2 DFC_b.TSC_MOXEMM_SMU_ALM8_3 DFC_b.TSC_MOXEMM_SMU_ALM8_31 DFC_b.TSC_MOXEMM_SMU_ALM8_4 DFC_b.TSC_MOXEMM_SMU_ALM9_0 DFC_b.TSC_MOXEMM_SMU_ALM9_15 DFC_b.TSC_MOXEMM_SMU_ALM9_3 DFC_b.TSC_MoCADCNTP DFC_b.TSC_MoCADCTst DFC_b.TSC_MoCSOPICO DFC_b.TSC_MoFAPP DFC_b.TSC_MoFAirFilgPrdc DFC_b.TSC_MoFAirFlCtOffPfi DFC_b.TSC_MoFAirFlCylPfi DFC_b.TSC_MoFAirFlIn DFC_b.TSC_MoFAirFlMixCtlPfiChkAirFl DFC_b.TSC_MoFAirFlMixCtlPfiChkCtrl DFC_b.TSC_MoFAirFlMode DFC_b.TSC_MoFESpd DFC_b.TSC_MoFIACo DFC_b.TSC_MoFICOL1 DFC_b.TSC_MoFICOL2 DFC_b.TSC_MoFStrt DFC_b.TSC_MoFTrqCmp DFC_b.TSC_MoFTrqCmpMax DFC_b.TSC_MoFTrqCmpMin DFC_b.TSC_MoFVarPostBldSel DFC_b.TSC_MoXEMMHwLTMCUFW DFC_b.TSC_MoXEMMHwLTMonBIST DFC_b.TSC_MoXEMMHwLTRegMonTest DFC_b.TSC_MoXEMMHwLTStbySMUAlvTest DFC_b.TSC_MoXEMMHwLTTempSens DFC_b.TSC_MoXEMMHwLTUCBCfg DFC_b.TSC_OCWDAABEActv DFC_b.TSC_OCWDACom DFC_b.TSC_OCWDAErrPin DFC_b.TSC_OCWDAOvrVltg DFC_b.TSC_ORAmax DFC_b.TSC_ORAmin DFC_b.TSC_PLLSUmax DFC_b.TSC_PLLSUmin DFC_b.TSC_PSR1max DFC_b.TSC_PSRBmax DFC_b.TSC_PSRBmin DFC_b.TSC_PSRPmax DFC_b.TSC_PSRPmin DFC_b.TSC_PSRPsig DFC_b.TSC_PSRmax DFC_b.TSC_PUmax DFC_b.TSC_P_VSE11_OL DFC_b.TSC_P_VSE11_SCB DFC_b.TSC_P_VSE11_SCG DFC_b.TSC_PhyHighAPP1 DFC_b.TSC_PhyHighAPP2 DFC_b.TSC_PhyLowAPP1 DFC_b.TSC_PhyLowAPP2 DFC_b.TSC_SRCHighAPP1 DFC_b.TSC_SRCHighAPP2 DFC_b.TSC_SRCLowAPP1 DFC_b.TSC_SRCLowAPP2 DFC_b.TSC_SSpMon2 DFC_b.TSC_SWReset_0 DFC_b.TSC_SWReset_1 DFC_b.TSC_SWReset_2 DFC_b.TSC_SyncAPP DFC_b.TSC_TAmax_Dummy DFC_b.TSC_TKAEmax DFC_b.TSC_TKAEmin DFC_b.TSC_TKARmax DFC_b.TSC_TKARnpl DFC_b.TSC_TMmax_Dummy DFC_b.TSC_TUMmax_Dummy DFC_b.TSC_TWCDPriCatB1 DFC_b.TSC_ThrVlvClsdPosnFirstOffsLrnImpoB1 DFC_b.TSC_ThrVlvClsdPosnOffsLrnImpoB1 DFC_b.TSC_ThrVlvClsdPosnOffsLrnMaxB1 DFC_b.TSC_ThrVlvClsdPosnOffsLrnMinB1 DFC_b.TSC_ThrVlvCtrlDeB1 DFC_b.TSC_ThrVlvDycB1 DFC_b.TSC_ThrVlvLimpAirPosnMaxAbsltDriftB1 DFC_b.TSC_ThrVlvLimpAirPosnMaxB1 DFC_b.TSC_ThrVlvLimpAirPosnMaxRelDriftB1 DFC_b.TSC_ThrVlvLimpAirPosnMinB1 DFC_b.TSC_ThrVlvOpenLoadB1 DFC_b.TSC_ThrVlvOpenSprgB1 DFC_b.TSC_ThrVlvOpenSprgSprdB1 DFC_b.TSC_ThrVlvOpenSprgTwnB1 DFC_b.TSC_ThrVlvOverTB1 DFC_b.TSC_ThrVlvRetSprgB1 DFC_b.TSC_ThrVlvRetSprgSprdB1 DFC_b.TSC_ThrVlvRetSprgTwnB1 DFC_b.TSC_ThrVlvSens1MaxB1 DFC_b.TSC_ThrVlvSens1NplB1 DFC_b.TSC_ThrVlvSens2MaxB1 DFC_b.TSC_ThrVlvSens2MinB1 DFC_b.TSC_ThrVlvSens2NplB1 DFC_b.TSC_ThrVlvShoCircB1 DFC_b.TSC_ThrVlvSpiErrB1 DFC_b.TSC_ThrvlvSens1MinB1 DFC_b.TSC_TiOffTBasdChkFast DFC_b.TSC_TiOffTBasdChkSlow DFC_b.TSC_UEGOHeatrCtlS1B1 DFC_b.TSC_UEGOSnsrMntdS1B1 DFC_b.TSC_VehVSig DFC_b.TSC_VlvLftFbSwtIntk11SpclFail DFC_b.TSC_VlvLftFbSwtIntk11StdFail DFC_st.DFC_Unused DFC_st.DFC_AltIOACGFailr DFC_st.DFC_AltIOACGHiVltg DFC_st.DFC_AltIOACGLoVltg DFC_st.DFC_AltIOACGTHi DFC_st.DFC_AltIODConnACG DFC_st.DFC_BattUHiFailr DFC_st.DFC_BattULoFailr DFC_st.DFC_BrkBstPDriftHiErr DFC_st.DFC_BrkBstPDriftLoErr DFC_st.DFC_BrkBstPSnsrStuck DFC_st.DFC_BrkMnSwtContOn DFC_st.DFC_BrkMnSwtNotStp DFC_st.DFC_BrkNpl DFC_st.DFC_BrkRdntSwtContOn DFC_st.DFC_BrkRdntSwtNotStp DFC_st.DFC_Clth3ONStuck DFC_st.DFC_Clth4OFFStuck DFC_st.DFC_ClthOFFStuck DFC_st.DFC_ClthONStuck DFC_st.DFC_ClthStkFailInfo DFC_st.DFC_ComACFailInfo DFC_st.DFC_ComATFTValErr DFC_st.DFC_ComATMILReq DFC_st.DFC_ComAYCAChksum DFC_st.DFC_ComAYCARingCnt DFC_st.DFC_ComAYCATOut DFC_st.DFC_ComAYCDChkSum DFC_st.DFC_ComAYCDTOut DFC_st.DFC_ComAYCFChksum DFC_st.DFC_ComAYCFRingCnt DFC_st.DFC_ComAYCFTOut DFC_st.DFC_ComAYCGChksum DFC_st.DFC_ComAYCGRingCnt DFC_st.DFC_ComAYCGTOut DFC_st.DFC_ComAYCIChkSum DFC_st.DFC_ComAYCIRingCnt DFC_st.DFC_ComAYCITOut DFC_st.DFC_ComBCM1ChkSum DFC_st.DFC_ComBCM1RingCnt DFC_st.DFC_ComBCM1TOut DFC_st.DFC_ComCANABusOffErr DFC_st.DFC_ComCANBBusOffErr DFC_st.DFC_ComCANCBusOffErr DFC_st.DFC_ComCGW1ChkSum DFC_st.DFC_ComCGW1RingCnt DFC_st.DFC_ComCGW1TOut DFC_st.DFC_ComConvBoostErr DFC_st.DFC_ComConvSlipErr DFC_st.DFC_ComEAT10Chksum DFC_st.DFC_ComEAT10RingCnt DFC_st.DFC_ComEAT10TOut DFC_st.DFC_ComEAT11ChkSum DFC_st.DFC_ComEAT11RingCnt DFC_st.DFC_ComEAT11TOut DFC_st.DFC_ComEAT12ChkSum DFC_st.DFC_ComEAT12RingCnt DFC_st.DFC_ComEAT12TOut DFC_st.DFC_ComEAT13ChkSum DFC_st.DFC_ComEAT13RingCnt DFC_st.DFC_ComEAT13TOut DFC_st.DFC_ComEAT1Chksum DFC_st.DFC_ComEAT1RingCnt DFC_st.DFC_ComEAT1TOut DFC_st.DFC_ComEAT2ChkSum DFC_st.DFC_ComEAT2RingCnt DFC_st.DFC_ComEAT2TOut DFC_st.DFC_ComEAT4ChkSum DFC_st.DFC_ComEAT4RingCnt DFC_st.DFC_ComEAT4TOut DFC_st.DFC_ComEAT6Chksum DFC_st.DFC_ComEAT6RingCnt DFC_st.DFC_ComEAT6TOut DFC_st.DFC_ComEAT7Chksum DFC_st.DFC_ComEAT7RingCnt DFC_st.DFC_ComEAT7TOut DFC_st.DFC_ComEAT8Chksum DFC_st.DFC_ComEAT8RingCnt DFC_st.DFC_ComEAT8TOut DFC_st.DFC_ComEATAChksum DFC_st.DFC_ComEATARingCnt DFC_st.DFC_ComEATATOut DFC_st.DFC_ComEATBChkSum DFC_st.DFC_ComEATBRingCnt DFC_st.DFC_ComEATBTOut DFC_st.DFC_ComEATCChksum DFC_st.DFC_ComEATCRingCnt DFC_st.DFC_ComEATCTOut DFC_st.DFC_ComEBBAChksum DFC_st.DFC_ComEBBARingCnt DFC_st.DFC_ComEBBATOut DFC_st.DFC_ComEPS1Chksum DFC_st.DFC_ComEPS1RingCnt DFC_st.DFC_ComEPS1TOut DFC_st.DFC_ComEngCanRxErr DFC_st.DFC_ComGrvySnsrErr DFC_st.DFC_ComGwIMG1ChkSum DFC_st.DFC_ComGwIMG1RingCnt DFC_st.DFC_ComGwIMG1TOut DFC_st.DFC_ComGwIMG3ChkSum DFC_st.DFC_ComGwIMG3RingCnt DFC_st.DFC_ComGwIMG3TOut DFC_st.DFC_ComGwIMG4ChkSum DFC_st.DFC_ComGwIMG4RingCnt DFC_st.DFC_ComGwIMG4TOut DFC_st.DFC_ComGwIMG5ChkSum DFC_st.DFC_ComGwIMG5RingCnt DFC_st.DFC_ComGwIMG5TOut DFC_st.DFC_ComGwIMG6ChkSum DFC_st.DFC_ComGwIMG6RingCnt DFC_st.DFC_ComGwIMG6TOut DFC_st.DFC_ComIDASBChksum DFC_st.DFC_ComIDASBRingCnt DFC_st.DFC_ComIDASBTOut DFC_st.DFC_ComIMGMILReq DFC_st.DFC_ComISSPrms DFC_st.DFC_ComMETAChksum DFC_st.DFC_ComMETARingCnt DFC_st.DFC_ComMETATOut DFC_st.DFC_ComMETCChksum DFC_st.DFC_ComMETCRingCnt DFC_st.DFC_ComMETCTOut DFC_st.DFC_ComMETDChksum DFC_st.DFC_ComMETDRingCnt DFC_st.DFC_ComMETDTOut DFC_st.DFC_ComMETE2Chksum DFC_st.DFC_ComMETE2RingCnt DFC_st.DFC_ComMETE2TOut DFC_st.DFC_ComMETFChksum DFC_st.DFC_ComMETFRingCnt DFC_st.DFC_ComMETFTOut DFC_st.DFC_ComMETGChksum DFC_st.DFC_ComMETGRingCnt DFC_st.DFC_ComMETGTOut DFC_st.DFC_ComMETH2Chksum DFC_st.DFC_ComMETH2RingCnt DFC_st.DFC_ComMETH2TOut DFC_st.DFC_ComMETHChksum DFC_st.DFC_ComMETHRingCnt DFC_st.DFC_ComMETHTOut DFC_st.DFC_ComMETIChksum DFC_st.DFC_ComMETIRingCnt DFC_st.DFC_ComMETITOut DFC_st.DFC_ComMETKChksum DFC_st.DFC_ComMETKRingCnt DFC_st.DFC_ComMETKTOut DFC_st.DFC_ComMETLChksum DFC_st.DFC_ComMETLRingCnt DFC_st.DFC_ComMETLTOut DFC_st.DFC_ComMETMChksum DFC_st.DFC_ComMETMRingCnt DFC_st.DFC_ComMETMTOut DFC_st.DFC_ComMETNChksum DFC_st.DFC_ComMETNRingCnt DFC_st.DFC_ComMETNTOut DFC_st.DFC_ComMtrCom DFC_st.DFC_ComPCUChkSum DFC_st.DFC_ComPCURingCnt DFC_st.DFC_ComPCUTOut DFC_st.DFC_ComSRSAChksum DFC_st.DFC_ComSRSARingCnt DFC_st.DFC_ComSRSATOut DFC_st.DFC_ComSRSBChksum DFC_st.DFC_ComSRSBRingCnt DFC_st.DFC_ComSRSBTOut DFC_st.DFC_ComSRSChksum DFC_st.DFC_ComSRSErr DFC_st.DFC_ComSRSRingCnt DFC_st.DFC_ComSRSTOut DFC_st.DFC_ComVehSpdPndFltTCU DFC_st.DFC_EbsChartcCurrErr DFC_st.DFC_EbsSelfDiagErr DFC_st.DFC_GbxCANDigPlausErr DFC_st.DFC_GbxNPos1SRCMax DFC_st.DFC_GbxNPos1SRCMin DFC_st.DFC_GbxNPos2SRCMax DFC_st.DFC_GbxNPos2SRCMin DFC_st.DFC_GbxNPosAlvChk DFC_st.DFC_GbxNPosSyncErr DFC_st.DFC_HEGOS2B1HtrPsMax DFC_st.DFC_HEGOS2B1HtrPsMin DFC_st.DFC_HEGOS2B1HtrPsSig DFC_st.DFC_LinCSErrACG DFC_st.DFC_LinCSErrEBS DFC_st.DFC_LinHdrTimeoutErrACG DFC_st.DFC_LinHdrTimeoutErrEBS DFC_st.DFC_LinMsgTimeoutErrACG DFC_st.DFC_LinMsgTimeoutErrEBS DFC_st.DFC_LinNoStrtComErr DFC_st.DFC_MisfDetVWhlFrntLeOORHi DFC_st.DFC_MisfDetVWhlFrntLeRatyHi DFC_st.DFC_MisfDetVWhlFrntLeRatyLo DFC_st.DFC_MisfDetVWhlFrntLeStuck DFC_st.DFC_MisfDetVWhlFrntRiOORHi DFC_st.DFC_MisfDetVWhlFrntRiRatyHi DFC_st.DFC_MisfDetVWhlFrntRiRatyLo DFC_st.DFC_MisfDetVWhlFrntRiStuck DFC_st.DFC_MisfDetVWhlReLeOORHi DFC_st.DFC_MisfDetVWhlReLeRatyHi DFC_st.DFC_MisfDetVWhlReLeRatyLo DFC_st.DFC_MisfDetVWhlReLeStuck DFC_st.DFC_MisfDetVWhlReRiOORHi DFC_st.DFC_MisfDetVWhlReRiRatyHi DFC_st.DFC_MisfDetVWhlReRiRatyLo DFC_st.DFC_MisfDetVWhlReRiStuck DFC_st.DFC_MisfDetdVWhlFrntLePlaus DFC_st.DFC_MisfDetdVWhlFrntRiPlaus DFC_st.DFC_MisfDetdVWhlReLePlaus DFC_st.DFC_MisfDetdVWhlReRiPlaus DFC_st.DFC_PEnvSigRngMax DFC_st.DFC_PEnvSigRngMin DFC_st.DFC_StmFault DFC_st.DFC_StrtCtOffPth DFC_st.DFC_StrtCtlErr DFC_st.DFC_StrtFault DFC_st.DFC_StrtLckJudg1 DFC_st.DFC_StrtLckJudg2 DFC_st.DFC_StrtOL DFC_st.DFC_StrtOL2 DFC_st.DFC_StrtSCB DFC_st.DFC_StrtSCB2 DFC_st.DFC_StrtSCG DFC_st.DFC_StrtSCG2 DFC_st.DFC_StrtStkRly1 DFC_st.DFC_StrtStkRly2 DFC_st.DFC_TEVEmax DFC_st.DFC_TEVEmin DFC_st.DFC_TEVEsig DFC_st.DFC_VehVAllPlaus DFC_st.DFC_VehVNCSnsrElecFailr DFC_st.DFC_VehVPlausCan DFC_st.DFC_VehVPlausFco DFC_st.DFC_VehVPlausPwr DFC_st.DFC_VehVPlausV2N DFC_st.DFC_VehVSpdSnsrAElecFailr DFC_st.DFC_VehVSpdSnsrBElecFailr DFC_st.DFC_ClthMax DFC_st.DFC_IgnClPs_DevComErr DFC_st.DFC_IgnClPs_LineOl_0 DFC_st.DFC_IgnClPs_LineOl_1 DFC_st.DFC_IgnClPs_LineOl_2 DFC_st.DFC_IgnClPs_LineOl_3 DFC_st.DFC_IgnClPs_LineScb_0 DFC_st.DFC_IgnClPs_LineScb_1 DFC_st.DFC_IgnClPs_LineScb_2 DFC_st.DFC_IgnClPs_LineScb_3 DFC_st.DFC_IgnClPs_LineScg_0 DFC_st.DFC_IgnClPs_LineScg_1 DFC_st.DFC_IgnClPs_LineScg_2 DFC_st.DFC_IgnClPs_LineScg_3 DFC_st.DFC_UEGOASICS1B1 DFC_st.DFC_UEGOOLIPES1B1 DFC_st.DFC_UEGOOLRES1B1 DFC_st.DFC_UEGOSCBS1B1 DFC_st.DFC_UEGOSCGS1B1 DFC_st.DFC_UEGOSPIS1B1 DFC_st.DFC_UEGOSnsrS1B1 DFC_st.DFC_UegoOlApesS1B1 DFC_st.DFC_UegoOlRCmpS1B1 DFC_st.DFC_AirCCmprOL DFC_st.DFC_AirCCmprOvrTemp DFC_st.DFC_AirCCmprSCB DFC_st.DFC_AirCCmprSCG DFC_st.DFC_AltErr DFC_st.DFC_BattUSRCMax DFC_st.DFC_BattUSRCMin DFC_st.DFC_ComChksTCU1 DFC_st.DFC_ComChksTCU11 DFC_st.DFC_ComChksTCU12 DFC_st.DFC_ComChksTCU13 DFC_st.DFC_ComChksTCU2 DFC_st.DFC_ComChksTCU3 DFC_st.DFC_ComChksTCU4 DFC_st.DFC_ComCntTCU1 DFC_st.DFC_ComCntTCU11 DFC_st.DFC_ComCntTCU12 DFC_st.DFC_ComCntTCU13 DFC_st.DFC_ComCntTCU2 DFC_st.DFC_ComCntTCU3 DFC_st.DFC_ComCntTCU4 DFC_st.DFC_ComTOutTCU01 DFC_st.DFC_ComTOutTCU02 DFC_st.DFC_ComTOutTCU1 DFC_st.DFC_ComTOutTCU11 DFC_st.DFC_ComTOutTCU12 DFC_st.DFC_ComTOutTCU13 DFC_st.DFC_ComTOutTCU14 DFC_st.DFC_ComTOutTCU2 DFC_st.DFC_ComTOutTCU3 DFC_st.DFC_ComTOutTCU4 DFC_st.DFC_DevLibBattUHi DFC_st.DFC_DevLibBattULo DFC_st.DFC_FanDIOOL_0 DFC_st.DFC_FanDIOOL_1 DFC_st.DFC_FanDIOOvrTemp_0 DFC_st.DFC_FanDIOOvrTemp_1 DFC_st.DFC_FanDIOSCB_0 DFC_st.DFC_FanDIOSCB_1 DFC_st.DFC_FanDIOSCG_0 DFC_st.DFC_FanDIOSCG_1 DFC_st.DFC_MRlyDcOL DFC_st.DFC_MRlyDcSCB DFC_st.DFC_MRlyDcSCG DFC_st.DFC_PSPOL DFC_st.DFC_PSPOvrTemp DFC_st.DFC_PSPSCB DFC_st.DFC_PSPSCG DFC_st.DFC_T50Err DFC_st.DFC_ThrVlvLoBattB1 DFC_st.DFC_VehVPhysRngHi DFC_st.DFC_VehVSclOutOL DFC_st.DFC_VehVSclOutOT DFC_st.DFC_VehVSclOutSCB DFC_st.DFC_VehVSclOutSCG DFC_st.DFC_VehVSnsrARngHi DFC_st.DFC_VehVSnsrBRngHi DFC_st.DFC_VehVSpdRtyDiag DFC_st.DFC_VehVWhlErr DFC_st.DFC_ACEvpTSRCMax DFC_st.DFC_ACEvpTSRCMin DFC_st.DFC_AirCClntPAnaSRCMax DFC_st.DFC_AirCClntPAnaSRCMin DFC_st.DFC_AirCSwtNpl DFC_st.DFC_AirCSwtSig DFC_st.DFC_Brk /end OUT_MEASUREMENT
 FUNCTION_VERSION "30000.33.0" /end FUNCTION
/begin COMPU_METHOD DFC_OneToOne "" RAT_FUNC "%6.2" "-" COEFFS 0 1 0 0 0 1 /end COMPU_METHOD
/end MODULE
/end PROJECT
