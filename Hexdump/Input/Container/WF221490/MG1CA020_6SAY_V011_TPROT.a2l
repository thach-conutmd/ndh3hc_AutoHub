ASAP2_VERSION 1 60
/begin PROJECT MG1CA020 "MG1CA020"
/begin HEADER "" VERSION "MG1CA020_6SAY_V011_TPROT" PROJECT_NO MG1CA020 /end HEADER
/begin MODULE DIM ""
/begin MOD_COMMON "" BYTE_ORDER MSB_LAST ALIGNMENT_BYTE 1 ALIGNMENT_WORD 2 ALIGNMENT_LONG 4 ALIGNMENT_INT64 4 ALIGNMENT_FLOAT32_IEEE 4 ALIGNMENT_FLOAT64_IEEE 4 DATA_SIZE 32 /end MOD_COMMON
/begin CHARACTERISTIC UEGO_CJ135BumTM10_C "reverse charge normal1 empirical parameter Bum TM1" VALUE 0x805379DA RB_Val_Ws16 0.04369000 i_q6p6667Em7_A -0.02184533 0.02184467 FORMAT "%10.8" /end CHARACTERISTIC
/begin CHARACTERISTIC UEGO_CJ135BumTM2f_C "reverse charge normal1 empirical parameter Bum TM2 Rich" VALUE 0x805379DC RB_Val_Ws16 0.04369000 i_q6p6667Em7_A -0.02184533 0.02184467 FORMAT "%10.8" /end CHARACTERISTIC
/begin CHARACTERISTIC UEGO_CJ135BumTM2m_C "reverse charge normal1 empirical parameter Bum TM2 Lean" VALUE 0x805379DE RB_Val_Ws16 0.04369000 i_q6p6667Em7_A -0.02184533 0.02184467 FORMAT "%10.8" /end CHARACTERISTIC
/begin CHARACTERISTIC UEGO_CJ135dIoff_C "reverse charge normal1 empirical parameter current offset" VALUE 0x805379E0 RB_Val_Ws16 0.04369000 i_q6p6667Em7_A -0.02184533 0.02184467 FORMAT "%10.8" /end CHARACTERISTIC
/begin CHARACTERISTIC UEGO_CJ135FMbumM_C "reverse charge normal1 empirical paramtere FMbumM" VALUE 0x805379E2 RB_Val_Ws16 0.1562476 fak_q0p2384em5 -0.07812500 0.07812262 FORMAT "%10.8" /end CHARACTERISTIC
/begin CHARACTERISTIC UEGO_CJ135FMbumP_C "reverse charge normal1 empirical paramtere FMbumP" VALUE 0x805379E4 RB_Val_Ws16 0.1562476 fak_q0p2384em5 -0.07812500 0.07812262 FORMAT "%10.8" /end CHARACTERISTIC
/begin CHARACTERISTIC UEGO_CJ135Moff_C "reverse charge normal1 empirical parameter Moff" VALUE 0x805379E6 RB_Val_Ws16 0.01092250 g_q1p6667Em7_S -0.005461333 0.005461167 FORMAT "%11.9" /end CHARACTERISTIC
/begin CHARACTERISTIC UEGO_CJ135MUapeTM10_C "reverse charge normal1 empirical parameter MUape TM1" VALUE 0x805379E8 RB_Val_Ws16 0.01092250 g_q1p6667Em7_S -0.005461333 0.005461167 FORMAT "%11.9" /end CHARACTERISTIC
/begin CHARACTERISTIC UEGO_CJ135MUapeTM2f_C "reverse charge normal1 empirical parameter MUape TM2 Rich" VALUE 0x805379EA RB_Val_Ws16 0.01092250 g_q1p6667Em7_S -0.005461333 0.005461167 FORMAT "%11.9" /end CHARACTERISTIC
/begin CHARACTERISTIC UEGO_CJ135MUapeTM2m_C "reverse charge normal1 empirical parameter MUape TM2 Lean" VALUE 0x805379EC RB_Val_Ws16 0.01092250 g_q1p6667Em7_S -0.005461333 0.005461167 FORMAT "%11.9" /end CHARACTERISTIC
/begin CHARACTERISTIC UEGO_CJ135MumTM10_C "reverse charge normal1 empirical parameter Mum TM1" VALUE 0x805379EE RB_Val_Ws16 0.01092250 g_q1p6667Em7_S -0.005461333 0.005461167 FORMAT "%11.9" /end CHARACTERISTIC
/begin CHARACTERISTIC UEGO_CJ135MumTM2f_C "reverse charge normal1 empirical parameter Mum TM2 Rich" VALUE 0x805379F0 RB_Val_Ws16 0.01092250 g_q1p6667Em7_S -0.005461333 0.005461167 FORMAT "%11.9" /end CHARACTERISTIC
/begin CHARACTERISTIC UEGO_CJ135MumTM2m_C "reverse charge normal1 empirical parameter Mum TM2 Lean" VALUE 0x805379F2 RB_Val_Ws16 0.01092250 g_q1p6667Em7_S -0.005461333 0.005461167 FORMAT "%11.9" /end CHARACTERISTIC
/begin CHARACTERISTIC UEGO_cndAprvdUp0Corrn_C "empiric conductivity factor of the measured pump voltage Up0" VALUE 0x805379F4 RB_Val_Wu16 0.01092250 g_q1p6667Em7_S 0.00 0.01092250 FORMAT "%10.8" /end CHARACTERISTIC
/begin CHARACTERISTIC UEGO_cpCamgIni_C "Initialization value capacitor in the APE pin between CJ135 and sensor" VALUE 0x805379F6 RB_Val_Wu16 0.000006553500 q1Em10_F 0.00 0.000006553500 FORMAT "%14.12" /end CHARACTERISTIC
/begin CHARACTERISTIC UEGO_cpCigIni_C "Initialization value capacitor in the IPE pin between CJ135 and sensor" VALUE 0x805379F8 RB_Val_Wu16 0.000006553500 q1Em10_F 0.00 0.000006553500 FORMAT "%14.12" /end CHARACTERISTIC
/begin CHARACTERISTIC UEGO_cpCpMeasMax_C "max. value capacitor in the pin between CJ135 and sensor" VALUE 0x80537B14 RB_Val_Wu16 0.000006553500 q1Em10_F 0.00 0.000006553500 FORMAT "%14.12" /end CHARACTERISTIC
/begin CHARACTERISTIC UEGO_cpCpMeasMin_C "min. value capacitor in the pin between CJ135 and sensor" VALUE 0x80537B16 RB_Val_Wu16 0.000006553500 q1Em10_F 0.00 0.000006553500 FORMAT "%14.12" /end CHARACTERISTIC
/begin CHARACTERISTIC UEGO_EngClassS1B1_I.stEng_C "Class Engine Operation Modes for lambda sensor 1 bank 1 / code word for engine state" VALUE 0x80537B4C RB_Val_Wu8 255.0 dez 0.00 255.0 FORMAT "%5.1" /end CHARACTERISTIC
/begin CHARACTERISTIC UEGO_facCorKIA11P_CUR "Correction factor delta Sigma converter" CURVE 0x805379FA RB_Curve_U16_U16 1.999969 fak_uw_b2 0.00 1.999969 FORMAT "%8.6"
 /begin AXIS_DESCR STD_AXIS NO_INPUT_QUANTITY q1Em10_F 4 0.00 0.000006553500 FORMAT "%14.12" DEPOSIT ABSOLUTE /end AXIS_DESCR
/end CHARACTERISTIC
/begin CHARACTERISTIC UEGO_facCorKIA12P_CUR "Correction factor delta Sigma converter" CURVE 0x80537A0C RB_Curve_U16_U16 1.999969 fak_uw_b2 0.00 1.999969 FORMAT "%8.6"
 /begin AXIS_DESCR STD_AXIS NO_INPUT_QUANTITY q1Em10_F 4 0.00 0.000006553500 FORMAT "%14.12" DEPOSIT ABSOLUTE /end AXIS_DESCR
/end CHARACTERISTIC
/begin CHARACTERISTIC UEGO_facCorKIA21P_CUR "Correction factor delta Sigma converter" CURVE 0x80537A1E RB_Curve_U16_U16 1.999969 fak_uw_b2 0.00 1.999969 FORMAT "%8.6"
 /begin AXIS_DESCR STD_AXIS NO_INPUT_QUANTITY q1Em10_F 4 0.00 0.000006553500 FORMAT "%14.12" DEPOSIT ABSOLUTE /end AXIS_DESCR
/end CHARACTERISTIC
/begin CHARACTERISTIC UEGO_facCorKIA22P_CUR "Correction factor delta Sigma converter" CURVE 0x80537A30 RB_Curve_U16_U16 1.999969 fak_uw_b2 0.00 1.999969 FORMAT "%8.6"
 /begin AXIS_DESCR STD_AXIS NO_INPUT_QUANTITY q1Em10_F 4 0.00 0.000006553500 FORMAT "%14.12" DEPOSIT ABSOLUTE /end AXIS_DESCR
/end CHARACTERISTIC
/begin CHARACTERISTIC UEGO_facCorKIV1P_CUR "Correction factor delta Sigma converter" CURVE 0x80537A42 RB_Curve_U16_U16 1.999969 fak_uw_b2 0.00 1.999969 FORMAT "%8.6"
 /begin AXIS_DESCR STD_AXIS NO_INPUT_QUANTITY q1Em10_F 4 0.00 0.000006553500 FORMAT "%14.12" DEPOSIT ABSOLUTE /end AXIS_DESCR
/end CHARACTERISTIC
/begin CHARACTERISTIC UEGO_facCorKIV2P_CUR "Correction factor delta Sigma converter" CURVE 0x80537A54 RB_Curve_U16_U16 1.999969 fak_uw_b2 0.00 1.999969 FORMAT "%8.6"
 /begin AXIS_DESCR STD_AXIS NO_INPUT_QUANTITY q1Em10_F 4 0.00 0.000006553500 FORMAT "%14.12" DEPOSIT ABSOLUTE /end AXIS_DESCR
/end CHARACTERISTIC
/begin CHARACTERISTIC UEGO_facCpFltConst_C "Filter time constant for C Measurement" VALUE 0x80537A66 RB_Val_Wu16 0.9999847 fak_uw_b1 0.00 0.9999847 FORMAT "%9.7" /end CHARACTERISTIC
/begin CHARACTERISTIC UEGO_facDeltaUiFltConst_C "Filter time constant for Ui Measurement" VALUE 0x80537A68 RB_Val_Wu16 0.9999847 fak_uw_b1 0.00 0.9999847 FORMAT "%9.7" /end CHARACTERISTIC
/begin CHARACTERISTIC UEGO_facDeltaUnFltConst_C "Filter Constant for Delta Un0" VALUE 0x8053773A RB_Val_Wu16 0.9999847 fak_uw_b1 0.00 0.9999847 FORMAT "%9.7" /end CHARACTERISTIC
/begin CHARACTERISTIC UEGO_facIPmpRawRvsChrgFltConst_C "Filter time constant of the pump current (raw value)" VALUE 0x80537A6A RB_Val_Wu16 0.9999847 fak_uw_b1 0.00 0.9999847 FORMAT "%9.7" /end CHARACTERISTIC
/begin CHARACTERISTIC UEGO_facRiaFltConst_C "filter constant Ria" VALUE 0x8053773C RB_Val_Wu16 0.9999847 fak_uw_b1 0.00 0.9999847 FORMAT "%9.7" /end CHARACTERISTIC
/begin CHARACTERISTIC UEGO_facRieFltConst_C "filter constant Rie calculation" VALUE 0x8053773E RB_Val_Wu16 0.9999847 fak_uw_b1 0.00 0.9999847 FORMAT "%9.7" /end CHARACTERISTIC
/begin CHARACTERISTIC UEGO_facRieRiaIni_C "Ini value ratio Rie, Ria" VALUE 0x80537740 RB_Val_Wu16 15.99976 fak_q0p000244 0.00 15.99976 FORMAT "%8.5" /end CHARACTERISTIC
/begin CHARACTERISTIC UEGO_facRipdFltConst_C "filter time constant Ripd filter" VALUE 0x80537742 RB_Val_Wu16 0.9999847 fak_uw_b1 0.00 0.9999847 FORMAT "%9.7" /end CHARACTERISTIC
/begin CHARACTERISTIC UEGO_facRipFltConst_C "filter constant Rip" VALUE 0x80537744 RB_Val_Wu16 0.9999847 fak_uw_b1 0.00 0.9999847 FORMAT "%9.7" /end CHARACTERISTIC
/begin CHARACTERISTIC UEGO_facRixQuoFltConst_C "UEGO_facRixQuoFltConst_C" VALUE 0x80537746 RB_Val_Wu16 0.9999847 fak_uw_b1 0.00 0.9999847 FORMAT "%9.7" /end CHARACTERISTIC
/begin CHARACTERISTIC UEGO_facUapeRvsChrgFltConst_C "Filter time constant for Uape value" VALUE 0x80537A6C RB_Val_Wu16 0.9999847 fak_uw_b1 0.00 0.9999847 FORMAT "%9.7" /end CHARACTERISTIC
/begin CHARACTERISTIC UEGO_facUgiFltConst_C "Filter time constant for Ugi value" VALUE 0x80537A6E RB_Val_Wu16 0.9999847 fak_uw_b1 0.00 0.9999847 FORMAT "%9.7" /end CHARACTERISTIC
/begin CHARACTERISTIC UEGO_facUp0RvsChrgFltConst_C "Filter time constant for Up0 value" VALUE 0x80537A70 RB_Val_Wu16 0.9999847 fak_uw_b1 0.00 0.9999847 FORMAT "%9.7" /end CHARACTERISTIC
/begin CHARACTERISTIC UEGO_flgCMeasRvsChrgDi_C "condition C measurement deactivated" VALUE 0x80537B18 RB_Val_Wu8 1.00000000000 B_TRUE 0.00 1.00000000000 FORMAT "%13.11" /end CHARACTERISTIC
/begin CHARACTERISTIC UEGO_iDeltaIsqRegIsq_C "Max. deviation of the measured current source Isq" VALUE 0x80537A72 RB_Val_Wu16 0.04369000 i_q6p6667Em7_A 0.00 0.04369000 FORMAT "%10.8" /end CHARACTERISTIC
/begin CHARACTERISTIC UEGO_idxCyc1371013_CUR "index allocation cycle CJ135 to the measured value" CURVE 0x80537A74 RB_Curve_U8_U8 255.0 dez 0.00 255.0 FORMAT "%5.1" READ_ONLY
 /begin AXIS_DESCR STD_AXIS NO_INPUT_QUANTITY dez 5 0.00 255.0 FORMAT "%5.1" DEPOSIT ABSOLUTE /end AXIS_DESCR
/end CHARACTERISTIC
/begin CHARACTERISTIC UEGO_idxCyc1471015_CUR "index allocation cycle CJ135 to the measured value" CURVE 0x80537A7F RB_Curve_U8_U8 255.0 dez 0.00 255.0 FORMAT "%5.1" READ_ONLY
 /begin AXIS_DESCR STD_AXIS NO_INPUT_QUANTITY dez 5 0.00 255.0 FORMAT "%5.1" DEPOSIT ABSOLUTE /end AXIS_DESCR
/end CHARACTERISTIC
/begin CHARACTERISTIC UEGO_idxCyc2481114_CUR "index allocation cycle CJ135 to the measured value" CURVE 0x80537A8A RB_Curve_U8_U8 255.0 dez 0.00 255.0 FORMAT "%5.1" READ_ONLY
 /begin AXIS_DESCR STD_AXIS NO_INPUT_QUANTITY dez 5 0.00 255.0 FORMAT "%5.1" DEPOSIT ABSOLUTE /end AXIS_DESCR
/end CHARACTERISTIC
/begin CHARACTERISTIC UEGO_iIPmpRvsChrgCorrnOffsTM1Lean_C "empirical reverse charge current (offset) TM1 Lean" VALUE 0x80537A96 RB_Val_Ws16 0.04369000 i_q6p6667Em7_A -0.02184533 0.02184467 FORMAT "%10.8" /end CHARACTERISTIC
/begin CHARACTERISTIC UEGO_iIPmpRvsChrgCorrnOffsTM1Rich_C "empirical reverse charge current (offset) TM1 Rich" VALUE 0x80537A98 RB_Val_Ws16 0.04369000 i_q6p6667Em7_A -0.02184533 0.02184467 FORMAT "%10.8" /end CHARACTERISTIC
/begin CHARACTERISTIC UEGO_iIPmpRvsChrgCorrnOffsTM2Lean_C "empirical reverse charge current (offset) TM2 Lean" VALUE 0x80537A9A RB_Val_Ws16 0.04369000 i_q6p6667Em7_A -0.02184533 0.02184467 FORMAT "%10.8" /end CHARACTERISTIC
/begin CHARACTERISTIC UEGO_iIPmpRvsChrgCorrnOffsTM2Rich_C "empirical reverse charge current (offset) TM2 Rich" VALUE 0x80537A9C RB_Val_Ws16 0.04369000 i_q6p6667Em7_A -0.02184533 0.02184467 FORMAT "%10.8" /end CHARACTERISTIC
/begin CHARACTERISTIC UEGO_iIPmpRvsChrgCorrnTM1Lean_C "empirical reverse charge current factor TM1 Lean" VALUE 0x80537A9E RB_Val_Ws16 0.04369000 i_q6p6667Em7_A -0.02184533 0.02184467 FORMAT "%10.8" /end CHARACTERISTIC
/begin CHARACTERISTIC UEGO_iIPmpRvsChrgCorrnTM1Rich_C "empirical reverse charge current factor TM1 Rich" VALUE 0x80537AA0 RB_Val_Ws16 0.04369000 i_q6p6667Em7_A -0.02184533 0.02184467 FORMAT "%10.8" /end CHARACTERISTIC
/begin CHARACTERISTIC UEGO_iIPmpRvsChrgCorrnTM2Lean_C "empirical reverse charge current factor TM2 Lean" VALUE 0x80537AA2 RB_Val_Ws16 0.04369000 i_q6p6667Em7_A -0.02184533 0.02184467 FORMAT "%10.8" /end CHARACTERISTIC
/begin CHARACTERISTIC UEGO_iIPmpRvsChrgCorrnTM2Rich_C "empirical reverse charge current factor TM2 Rich" VALUE 0x80537AA4 RB_Val_Ws16 0.04369000 i_q6p6667Em7_A -0.02184533 0.02184467 FORMAT "%10.8" /end CHARACTERISTIC
/begin CHARACTERISTIC UEGO_iIRestAPE_C "empirical current remain at pin APE" VALUE 0x80537AA6 RB_Val_Ws16 0.04369000 i_q6p6667Em7_A -0.02184533 0.02184467 FORMAT "%10.8" /end CHARACTERISTIC
/begin CHARACTERISTIC UEGO_iIRestIPE_C "empirical current remain at pin IPE" VALUE 0x80537AA8 RB_Val_Ws16 0.04369000 i_q6p6667Em7_A -0.02184533 0.02184467 FORMAT "%10.8" /end CHARACTERISTIC
/begin CHARACTERISTIC UEGO_iIRestMES_C "empirical current remain at pin MES" VALUE 0x80537AAA RB_Val_Ws16 0.04369000 i_q6p6667Em7_A -0.02184533 0.02184467 FORMAT "%10.8" /end CHARACTERISTIC
/begin CHARACTERISTIC UEGO_iIRestRE_C "empirical current remain at pin RE" VALUE 0x80537AAC RB_Val_Ws16 0.04369000 i_q6p6667Em7_A -0.02184533 0.02184467 FORMAT "%10.8" /end CHARACTERISTIC
/begin CHARACTERISTIC UEGO_nEngHysFilSync_C "Hysteresis delta for deactivation of filter over syncro values by engine speed" VALUE 0x80537B3C RB_Val_Ws16 32767.50 EngN -16384.00 16383.50 FORMAT "%8.2" /end CHARACTERISTIC
/begin CHARACTERISTIC UEGO_nFilSyncActvMax_C "Upper engine speed threshold for activation of filter over syncro values" VALUE 0x80537B3E RB_Val_Ws16 32767.50 EngN -16384.00 16383.50 FORMAT "%8.2" /end CHARACTERISTIC
/begin CHARACTERISTIC UEGO_nFilSyncActvMin_C "Lower engine speed threshold for activation of filter over syncro values" VALUE 0x80537B40 RB_Val_Ws16 32767.50 EngN -16384.00 16383.50 FORMAT "%8.2" /end CHARACTERISTIC
/begin CHARACTERISTIC UEGO_nrTstPlsHeatrRly_C "Number of test pulse in on driving cycle" VALUE 0x80537B5C RB_Val_Wu32 4294967295.00 OneToOne 0.00 4294967295.00 FORMAT "%13.2" /end CHARACTERISTIC
/begin CHARACTERISTIC UEGO_nRvsChrgAdpnEngMax_C "max. threshold engine speed for the adaption RvsChrg" VALUE 0x80537B1A RB_Val_Ws16 32767.50 EngN -16384.00 16383.50 FORMAT "%8.2" /end CHARACTERISTIC
/begin CHARACTERISTIC UEGO_nRvsChrgAdpnEngMin_C "min. threshold engine speed for the adaption RvsChrg" VALUE 0x80537B1C RB_Val_Ws16 32767.50 EngN -16384.00 16383.50 FORMAT "%8.2" /end CHARACTERISTIC
/begin CHARACTERISTIC UEGO_numRegIpoffCMeas_C "set value CJ135 register IPOFF for C measurement" VALUE 0x80537B1E RB_Val_Ws16 1.444324 fak_q1p201Em4 -0.7221622 0.7221622 FORMAT "%9.7" EXTENDED_LIMITS -3.936096 3.935976 /end CHARACTERISTIC
/begin CHARACTERISTIC UEGO_numRegIpoffUi22Meas_C "set value CJ135 register IPOFF for ui measureme" VALUE 0x80537B20 RB_Val_Ws16 7.872072 fak_q1p201Em4 -3.936096 3.935976 FORMAT "%8.6" /end CHARACTERISTIC
/begin CHARACTERISTIC UEGO_numRegIpoffUi23Ui24Meas_C "set value CJ135 register IPOFF for ui measureme" VALUE 0x80537B22 RB_Val_Ws16 7.872072 fak_q1p201Em4 -3.936096 3.935976 FORMAT "%8.6" /end CHARACTERISTIC
/begin CHARACTERISTIC UEGO_numRegIpsmRvsChrg_C "set value CJ135 registerpart IPSM" VALUE 0x80537B24 RB_Val_Wu8 1.000 dez 0.00 1.000 FORMAT "%5.3" EXTENDED_LIMITS 0.00 255.0 /end CHARACTERISTIC
/begin CHARACTERISTIC UEGO_numRegIsqCMeas_C "set value CJ135 registerpart TRIMSQ for C measurement" VALUE 0x80537B25 RB_Val_Wu8 0.01588 i_q1p25Em4_o0p004_A 0.00400 0.01988 FORMAT "%7.5" EXTENDED_LIMITS 0.004000 0.03587 /end CHARACTERISTIC
/begin CHARACTERISTIC UEGO_numRegPatCMeas_C "set value CJ135 registerpart PATTERN for C measurement" VALUE 0x80537B26 RB_Val_Wu16 32767.00 dez 0.00 32767.00 FORMAT "%8.2" EXTENDED_LIMITS 0.00 65535.00 /end CHARACTERISTIC
/begin CHARACTERISTIC UEGO_numRegPatUiMeas_C "set value CJ135 registerpart PATTERN for ui measurement" VALUE 0x80537B28 RB_Val_Wu16 32767.00 dez 0.00 32767.00 FORMAT "%8.2" EXTENDED_LIMITS 0.00 65535.00 /end CHARACTERISTIC
/begin CHARACTERISTIC UEGO_numRiaMn_C "min. Number of Ria calculation" VALUE 0x80537748 RB_Val_Wu16 65535.00 dez 0.00 65535.00 FORMAT "%8.2" /end CHARACTERISTIC
/begin CHARACTERISTIC UEGO_numRieMn_C "min. Number of Rie calculation" VALUE 0x8053774A RB_Val_Wu16 65535.00 dez 0.00 65535.00 FORMAT "%8.2" /end CHARACTERISTIC
/begin CHARACTERISTIC UEGO_numRipdMn_C "minimum number of Ripd measurements for release" VALUE 0x8053774C RB_Val_Wu16 65535.00 dez 0.00 65535.00 FORMAT "%8.2" /end CHARACTERISTIC
/begin CHARACTERISTIC UEGO_numRipMn_C "minimum number of Rip measuerements for valid signal" VALUE 0x8053774E RB_Val_Wu16 65535.00 dez 0.00 65535.00 FORMAT "%8.2" /end CHARACTERISTIC
/begin CHARACTERISTIC UEGO_ratDeltaIPmpRegIpoff_C "max. deviation of the measured ratio pump current" VALUE 0x80537AAE RB_Val_Wu16 7.872072 fak_q1p201Em4 0.00 7.872072 FORMAT "%8.6" /end CHARACTERISTIC
/begin CHARACTERISTIC UEGO_ratIPmpMaxLam1UiAllMeas_C "max. Duty cycle for Ui measurement in Lambda1 learning area" VALUE 0x80537AB0 RB_Val_Ws16 7.872072 fak_q1p201Em4 -3.936096 3.935976 FORMAT "%8.6" /end CHARACTERISTIC
/begin CHARACTERISTIC UEGO_ratIPmpMaxLeanUiAllMeas_C "max. Duty cycle for Ui measurement in lean learning area" VALUE 0x80537AB2 RB_Val_Ws16 7.872072 fak_q1p201Em4 -3.936096 3.935976 FORMAT "%8.6" /end CHARACTERISTIC
/begin CHARACTERISTIC UEGO_ratIPmpMaxRichUiAllMeas_C "max. Duty cycle for Ui measurement in rich learning area" VALUE 0x80537AB4 RB_Val_Ws16 7.872072 fak_q1p201Em4 -3.936096 3.935976 FORMAT "%8.6" /end CHARACTERISTIC
/begin CHARACTERISTIC UEGO_ratIPmpMaxSpcUiAllMeas_C "max. Duty cycle for Ui measurement in spezific learning area" VALUE 0x80537AB6 RB_Val_Ws16 7.872072 fak_q1p201Em4 -3.936096 3.935976 FORMAT "%8.6" /end CHARACTERISTIC
/begin CHARACTERISTIC UEGO_ratIPmpMinLam1UiAllMeas_C "min. Duty cycle for Ui measurement in Lambda1 learning area" VALUE 0x80537AB8 RB_Val_Ws16 7.872072 fak_q1p201Em4 -3.936096 3.935976 FORMAT "%8.6" /end CHARACTERISTIC
/begin CHARACTERISTIC UEGO_ratIPmpMinLeanUiAllMeas_C "min. Duty cycle for Ui measurement in lean learning area" VALUE 0x80537ABA RB_Val_Ws16 7.872072 fak_q1p201Em4 -3.936096 3.935976 FORMAT "%8.6" /end CHARACTERISTIC
/begin CHARACTERISTIC UEGO_ratIPmpMinRichUiAllMeas_C "min. Duty cycle for Ui measurement in rich learning area" VALUE 0x80537ABC RB_Val_Ws16 7.872072 fak_q1p201Em4 -3.936096 3.935976 FORMAT "%8.6" /end CHARACTERISTIC
/begin CHARACTERISTIC UEGO_ratIPmpMinSpcUiAllMeas_C "min. Duty cycle for Ui measurement in spezific learning area" VALUE 0x80537ABE RB_Val_Ws16 7.872072 fak_q1p201Em4 -3.936096 3.935976 FORMAT "%8.6" /end CHARACTERISTIC
/begin CHARACTERISTIC UEGO_resRiaCorrnRiSwtOn_CUR "correction map Ria = f(Ri) im Switchon" CURVE 0x80537750 RB_Curve_U16_S16_Static 6553.500 r_q0p1_Ohm -3276.800 3276.700 FORMAT "%8.3"
 /begin AXIS_DESCR STD_AXIS NO_INPUT_QUANTITY r_q0p1_Ohm 8 0.00 6553.500 FORMAT "%8.3" DEPOSIT ABSOLUTE /end AXIS_DESCR
/end CHARACTERISTIC
/begin CHARACTERISTIC UEGO_resRiaCorrnRiWrmUp_CUR "correction map Ria = f(Ri) im Warmup" CURVE 0x80537772 RB_Curve_U16_S16_Static 6553.500 r_q0p1_Ohm -3276.800 3276.700 FORMAT "%8.3"
 /begin AXIS_DESCR STD_AXIS NO_INPUT_QUANTITY r_q0p1_Ohm 8 0.00 6553.500 FORMAT "%8.3" DEPOSIT ABSOLUTE /end AXIS_DESCR
/end CHARACTERISTIC
/begin CHARACTERISTIC UEGO_resRieCorrnIpTM2R_CUR "Pump current to resistance Curve for TM2R Mode" CURVE 0x80537794 RB_Curve_S16_S16 6553.500 r_q0p1_Ohm -3276.800 3276.700 FORMAT "%8.3"
 /begin AXIS_DESCR STD_AXIS NO_INPUT_QUANTITY i_q6p6667Em7_A 20 -0.02184533 0.02184467 FORMAT "%10.8" DEPOSIT ABSOLUTE /end AXIS_DESCR
/end CHARACTERISTIC
/begin CHARACTERISTIC UEGO_resRieCorrnIp_CUR "Pump current Ip dependent correction characteristic curve for the Rie calculation" CURVE 0x805377E6 RB_Curve_S16_S16 6553.500 r_q0p1_Ohm -3276.800 3276.700 FORMAT "%8.3"
 /begin AXIS_DESCR STD_AXIS NO_INPUT_QUANTITY i_q6p6667Em7_A 20 -0.02184533 0.02184467 FORMAT "%10.8" DEPOSIT ABSOLUTE /end AXIS_DESCR
/end CHARACTERISTIC
/begin CHARACTERISTIC UEGO_resRieCorrnRiNrml_CUR "correction map Rie = f(Ri) im Normalmode" CURVE 0x80537838 RB_Curve_U16_S16_Static 6553.500 r_q0p1_Ohm -3276.800 3276.700 FORMAT "%8.3"
 /begin AXIS_DESCR STD_AXIS NO_INPUT_QUANTITY r_q0p1_Ohm 8 0.00 6553.500 FORMAT "%8.3" DEPOSIT ABSOLUTE /end AXIS_DESCR
/end CHARACTERISTIC
/begin CHARACTERISTIC UEGO_resRieCorrnRiWrmUp_CUR "correction map Rie = f(Ri) im Warmup" CURVE 0x8053785A RB_Curve_U16_S16_Static 6553.500 r_q0p1_Ohm -3276.800 3276.700 FORMAT "%8.3"
 /begin AXIS_DESCR STD_AXIS NO_INPUT_QUANTITY r_q0p1_Ohm 8 0.00 6553.500 FORMAT "%8.3" DEPOSIT ABSOLUTE /end AXIS_DESCR
/end CHARACTERISTIC
/begin CHARACTERISTIC UEGO_resRipdCorrnIp_CUR "correction map Ripd = f(Ip)" CURVE 0x8053787C RB_Curve_S16_S16 6553.500 r_q0p1_Ohm -3276.800 3276.700 FORMAT "%8.3"
 /begin AXIS_DESCR STD_AXIS NO_INPUT_QUANTITY i_q6p6667Em7_A 20 -0.02184533 0.02184467 FORMAT "%10.8" DEPOSIT ABSOLUTE /end AXIS_DESCR
/end CHARACTERISTIC
/begin CHARACTERISTIC UEGO_resRipZ1CorrnIp_CUR "correction curve Rip in dependency from Ip" CURVE 0x805378CE RB_Curve_S16_S16 6553.500 r_q0p1_Ohm -3276.800 3276.700 FORMAT "%8.3"
 /begin AXIS_DESCR STD_AXIS NO_INPUT_QUANTITY i_q6p6667Em7_A 20 -0.02184533 0.02184467 FORMAT "%10.8" DEPOSIT ABSOLUTE /end AXIS_DESCR
/end CHARACTERISTIC
/begin CHARACTERISTIC UEGO_resRipZ2CorrnIp_CUR "pump current dependent correction for inner resistance measurement at pump cell for switching state Z2" CURVE 0x80537920 RB_Curve_S16_S16 6553.500 r_q0p1_Ohm -3276.800 3276.700 FORMAT "%8.3"
 /begin AXIS_DESCR STD_AXIS NO_INPUT_QUANTITY i_q6p6667Em7_A 20 -0.02184533 0.02184467 FORMAT "%10.8" DEPOSIT ABSOLUTE /end AXIS_DESCR
/end CHARACTERISTIC
/begin CHARACTERISTIC UEGO_resRsgaspa_C "switch resistance Rsga, Rspa" VALUE 0x80537AC0 RB_Val_Wu16 6553.500 r_q0p1_Ohm 0.00 6553.500 FORMAT "%8.3" /end CHARACTERISTIC
/begin CHARACTERISTIC UEGO_stCJ135RTEval_C "status word for RTEval-configuaration" VALUE 0x80537972 RB_Val_Wu8 255.0 dez 0.00 255.0 FORMAT "%5.1" /end CHARACTERISTIC
/begin CHARACTERISTIC UEGO_stEngAndEcuRelsMask_C "Mask for engine and ecu state release" VALUE 0x80537B42 RB_Val_Wu8 255.0 OneToOne 0.00 255.0 FORMAT "%5.1" /end CHARACTERISTIC
/begin CHARACTERISTIC UEGO_stHeatrRlyDeactvn_C "Deactivation control of relay for heater of lambda sensor" VALUE 0x80537B50 RB_Val_Wu16 65535.00 OneToOne 0.00 65535.00 FORMAT "%8.2" /end CHARACTERISTIC
/begin CHARACTERISTIC UEGO_stHeatrRlyPsDiagDeactvn_C "Deaktivation of diagnosis of power stage of relay of heater from lambda sensor depending on system contdition" VALUE 0x80537B54 RB_Val_Wu16 65535.00 OneToOne 0.00 65535.00 FORMAT "%8.2" /end CHARACTERISTIC
/begin CHARACTERISTIC UEGO_stHeatrRlyPsDiag_C "Enable diagnosis heater relay powerstage" VALUE 0x80537B60 RB_Val_Wu8 255.0 dez 0.00 255.0 FORMAT "%5.1" /end CHARACTERISTIC
/begin CHARACTERISTIC UEGO_stLrngAr_C "Code word for the activated learning areas" VALUE 0x80537AC2 RB_Val_Wu16 65535.00 dez 0.00 65535.00 FORMAT "%8.2" /end CHARACTERISTIC
/begin CHARACTERISTIC UEGO_stOperLoBatt_C "Bit string defining the operation at low battery voltages" VALUE 0x80537B32 RB_Val_Wu8 255.0 OneToOne 0.00 255.0 FORMAT "%5.1" /end CHARACTERISTIC
/begin CHARACTERISTIC UEGO_swtHeatrRlyOffT15Off_C "Switch off relay for heater lambda sensor at T15 off" VALUE 0x80537B52 RB_Val_Wu8 1.00000000000 B_TRUE 0.00 1.00000000000 FORMAT "%13.11" /end CHARACTERISTIC
/begin CHARACTERISTIC UEGO_swtHeatrRlyPsTestPlsMod_C "Switch to select the test puls mode" VALUE 0x80537B56 RB_Val_Wu8 255.0 OneToOne 0.00 255.0 FORMAT "%5.1" /end CHARACTERISTIC
/begin CHARACTERISTIC UEGO_tFacRieRiaMax_C "UEGO_tFacRieRiaMax_C" VALUE 0x80537974 RB_Val_Wu16 1535.977 temp_q0p0234_o273 -273.150 1262.827 FORMAT "%8.3" /end CHARACTERISTIC
/begin CHARACTERISTIC UEGO_tFacRieRiaMin_C "UEGO_tFacRieRiaMin_C" VALUE 0x80537976 RB_Val_Wu16 1535.977 temp_q0p0234_o273 -273.150 1262.827 FORMAT "%8.3" /end CHARACTERISTIC
/begin CHARACTERISTIC UEGO_tiBtwElecFltHeatrRly_C "Time between two test pulses during electrical fault" VALUE 0x80537B62 RB_Val_Ws16 655350.0 Time_ms -327680.0 327670.0 FORMAT "%8.1" /end CHARACTERISTIC
/begin CHARACTERISTIC UEGO_tiBtwOTFltHeatrRly_C "Time between two test pulses during overtemperature fault" VALUE 0x80537B64 RB_Val_Ws16 655.3500 Time_s -327.6800 327.6700 FORMAT "%8.4" /end CHARACTERISTIC
/begin CHARACTERISTIC UEGO_tiDlyDeltaUnVld_C "Time Delay to reset the Delta Un0 validity flag when there is no Un0 value available" VALUE 0x80537978 RB_Val_Wu16 327.6750 t_q0p005 0.00 327.6750 FORMAT "%8.4" /end CHARACTERISTIC
/begin CHARACTERISTIC UEGO_tiDlyEngRunng_C "Time window for TOFF Delay to keep UEGO_flgEngRunng in TRUE, to enable robust lambda sensor operation during stop phase (especially during restart phases)" VALUE 0x80537B44 RB_Val_Wu16 655.3500 t_q0p01 0.00 655.3500 FORMAT "%8.4" /end CHARACTERISTIC
/begin CHARACTERISTIC UEGO_tiDlyHeatrRlyOn_C "Timedelay to switch on the relay for heater of lambda sensor" VALUE 0x80537B53 RB_Val_Wu8 2.550 t_q0p01 0.00 2.550 FORMAT "%5.3" /end CHARACTERISTIC
/begin CHARACTERISTIC UEGO_tiDlyNewPacMiss_C "Delay time to indicate new package is missing" VALUE 0x80537738 RB_Val_Wu16 327.6750 t_q0p005 0.00 327.6750 FORMAT "%8.4" /end CHARACTERISTIC
/begin CHARACTERISTIC UEGO_tiDlyRiMissMeas_C "delay time for temperature validity status" VALUE 0x8053797A RB_Val_Wu16 327.6700 t_q0p005 0.0050 327.6750 FORMAT "%8.4" EXTENDED_LIMITS 0.00 327.6750 /end CHARACTERISTIC
/begin CHARACTERISTIC UEGO_tiDlyUBattMin_C "Time delay when the battery volatage decreases below the minimum battery voltage" VALUE 0x80537B34 RB_Val_Wu16 655.3500 t_q0p01 0.00 655.3500 FORMAT "%8.4" /end CHARACTERISTIC
/begin CHARACTERISTIC UEGO_tiDlyUBattNorm_C "Time delay before diagnosis report release" VALUE 0x80537B30 RB_Val_Wu16 655.3500 t_q0p01 0.00 655.3500 FORMAT "%8.4" /end CHARACTERISTIC
/begin CHARACTERISTIC UEGO_tiFIdCJ135RvsChrg_C "delay time for release FId_CJ135RvsChrgMeas" VALUE 0x80537B2A RB_Val_Wu16 655.3500 t_q0p01 0.00 655.3500 FORMAT "%8.4" /end CHARACTERISTIC
/begin CHARACTERISTIC UEGO_tiLastUiAllMeas_C "Min. time between Ui measurements" VALUE 0x80537AC4 RB_Val_Wu16 327.6750 t_q0p005 0.00 327.6750 FORMAT "%8.4" /end CHARACTERISTIC
/begin CHARACTERISTIC UEGO_tiMeasAdcRvsChrg_C "Analog-digital converter time" VALUE 0x80537AC6 RB_Val_Wu16 0.06553500 t_q0p000001_s 0.00 0.06553500 FORMAT "%10.8" /end CHARACTERISTIC
/begin CHARACTERISTIC UEGO_tiMeasIPmpTM2Min_C "max. Switch-on time of the current source in TM1 without min. pulse counterpulse" VALUE 0x80537AC8 RB_Val_Wu16 0.06553500 t_q0p000001_s 0.00 0.06553500 FORMAT "%10.8" /end CHARACTERISTIC
/begin CHARACTERISTIC UEGO_tiStEngStop_C "time delay end of stop phase" VALUE 0x80537B46 RB_Val_Wu16 655.3500 t_q0p01 0.00 655.3500 FORMAT "%8.4" /end CHARACTERISTIC
/begin CHARACTERISTIC UEGO_tiTiDeadReq_C "max. Waiting time of the requirement to change the operating mode" VALUE 0x80537ACA RB_Val_Wu16 327.6750 t_q0p005 0.00 327.6750 FORMAT "%8.4" /end CHARACTERISTIC
/begin CHARACTERISTIC UEGO_tiWaitCCalc_C "max. Waiting time to the new requirement for C measurement" VALUE 0x80537ACC RB_Val_Wu16 327.6750 t_q0p005 0.00 327.6750 FORMAT "%8.4" /end CHARACTERISTIC
/begin CHARACTERISTIC UEGO_tiWaitUiAllMeas_C "Min. time for Ui Measurement" VALUE 0x80537ACE RB_Val_Wu16 327.6750 t_q0p005 0.00 327.6750 FORMAT "%8.4" /end CHARACTERISTIC
/begin CHARACTERISTIC UEGO_tMinActvtRie_C "UEGO_tMinActvtRie_C" VALUE 0x8053797C RB_Val_Wu16 1535.977 temp_q0p0234_o273 -273.150 1262.827 FORMAT "%8.3" /end CHARACTERISTIC
/begin CHARACTERISTIC UEGO_tMinActvtRip_C "temperature limit for Rip measurement activation" VALUE 0x8053797E RB_Val_Wu16 1535.977 temp_q0p0234_o273 -273.150 1262.827 FORMAT "%8.3" /end CHARACTERISTIC
/begin CHARACTERISTIC UEGO_tRi2Temp_CUR "CURVE UEGO_tRi2Temp_CUR" CURVE 0x80537980 RB_Curve_U16_U16 1535.977 temp_q0p0234_o273 -273.150 1262.827 FORMAT "%8.3"
 /begin AXIS_DESCR STD_AXIS NO_INPUT_QUANTITY r_q0p1_Ohm 22 0.00 6553.500 FORMAT "%8.3" DEPOSIT ABSOLUTE /end AXIS_DESCR
/end CHARACTERISTIC
/begin CHARACTERISTIC UEGO_uBattMax_C "maximum battery voltage" VALUE 0x80537B36 RB_Val_Ws16 1310700. Volt_Batt -655360.0 655340.0 FORMAT "%8.1" /end CHARACTERISTIC
/begin CHARACTERISTIC UEGO_uBattMin_C "minimum battery voltage" VALUE 0x80537B38 RB_Val_Ws16 1310700. Volt_Batt -655360.0 655340.0 FORMAT "%8.1" /end CHARACTERISTIC
/begin CHARACTERISTIC UEGO_uBattSuff_C "Sufficient battery voltage" VALUE 0x80537B3A RB_Val_Ws16 1310700. Volt_Batt -655360.0 655340.0 FORMAT "%8.1" /end CHARACTERISTIC
/begin CHARACTERISTIC UEGO_uDeltaUi22Ini_C "Initialization value delta Ui22 to Ui21" VALUE 0x80537AD0 RB_Val_Ws16 20.97120 spg_q3p2Em4_V -10.48576 10.48544 FORMAT "%8.5" /end CHARACTERISTIC
/begin CHARACTERISTIC UEGO_uDeltaUi23Ini_C "Initialization value delta Ui23 to Ui21" VALUE 0x80537AD2 RB_Val_Ws16 20.97120 spg_q3p2Em4_V -10.48576 10.48544 FORMAT "%8.5" /end CHARACTERISTIC
/begin CHARACTERISTIC UEGO_uDeltaUi24Ini_C "Initialization value delta Ui24 to Ui21" VALUE 0x80537AD4 RB_Val_Ws16 20.97120 spg_q3p2Em4_V -10.48576 10.48544 FORMAT "%8.5" /end CHARACTERISTIC
/begin CHARACTERISTIC UEGO_uHeatrRlyPsTestPlsRels_C "Threshold for Battery Voltage for Release of Test Puls for Diagnosis of Heater Relay Powerstage" VALUE 0x80537B58 RB_Val_Ws16 1310700. Volt_Batt -655360.0 655340.0 FORMAT "%8.1" /end CHARACTERISTIC
/begin CHARACTERISTIC UEGO_uUgxxDeltaMaxIni_C "Initial allowed deviation for Ugxx peak filter" VALUE 0x80537B2C RB_Val_Wu16 10.48544 spg_q3p2Em4_V 0.00 10.48544 FORMAT "%8.5" EXTENDED_LIMITS 0.00 20.97120 /end CHARACTERISTIC
/begin CHARACTERISTIC UEGO_uUp0IPmpUmCorrnIp_CUR "up0 dependent portion for reverse charge correction in cj135 mode normal 1" CURVE 0x80537AD6 RB_Curve_S16_S16 20.97120 spg_q3p2Em4_V -10.48576 10.48544 FORMAT "%8.5"
 /begin AXIS_DESCR STD_AXIS NO_INPUT_QUANTITY i_q6p6667Em7_A 15 -0.02184533 0.02184467 FORMAT "%10.8" DEPOSIT ABSOLUTE /end AXIS_DESCR
/end CHARACTERISTIC
/begin MEASUREMENT B_rinval_msg "RI Vallidity flag" UBYTE B_TRUE 1 100 0.00 1.00000000000 BIT_MASK 0x1 FORMAT "%13.11" ECU_ADDRESS 0x700009BD /end MEASUREMENT
/begin MEASUREMENT flgCPMeasS1B1ERNM_I.oldSignal "Rising edge for request from Reverse Charge for parameters for capacity measurement / value of input signal last calculation" UBYTE B_TRUE 1 100 0.00 1.00000000000 BIT_MASK 0x1 FORMAT "%13.11" ECU_ADDRESS 0x60006226 /end MEASUREMENT
/begin MEASUREMENT flgUiAllMeasS1B1ERNM_I.oldSignal "Rising edge for request from Reverse Charge for parameters for delta Ui measurement / value of input signal last calculation" UBYTE B_TRUE 1 100 0.00 1.00000000000 BIT_MASK 0x1 FORMAT "%13.11" ECU_ADDRESS 0x60006225 /end MEASUREMENT
/begin MEASUREMENT rinlsu_w_msg "Resistance of nernst cell of LSU" UWORD r_q0p0391 1 100 0.00 2559.961 FORMAT "%8.3" ECU_ADDRESS 0x70002D0A /end MEASUREMENT
/begin MEASUREMENT tkerlsu_w_msg "Temperature of ceramics of LSU" UWORD temp_q0p0234_o273 1 100 -273.150 1262.827 FORMAT "%8.3" ECU_ADDRESS 0x70002D10 /end MEASUREMENT
/begin MEASUREMENT UEGO_CJ135PckEvlnS1B1_I.flgClmpdN "Class instance of the functional class of FC UEGO_CJ135PckEvln for bank 1 sensor 1 / Clamping structure of the nerst cell active" UBYTE B_TRUE 1 100 0.00 1.00000000000 BIT_MASK 0x1 FORMAT "%13.11" ECU_ADDRESS 0x5000200A /end MEASUREMENT
/begin MEASUREMENT UEGO_CJ135PckEvlnS1B1_I.flgClmpdP "Class instance of the functional class of FC UEGO_CJ135PckEvln for bank 1 sensor 1 / Clamping structure of the pump cell active" UBYTE B_TRUE 1 100 0.00 1.00000000000 BIT_MASK 0x1 FORMAT "%13.11" ECU_ADDRESS 0x5000200B /end MEASUREMENT
/begin MEASUREMENT UEGO_CJ135PckEvlnS1B1_I.flgErrSpiRamBnk "Class instance of the functional class of FC UEGO_CJ135PckEvln for bank 1 sensor 1 / SPI error of the RAM bank" UBYTE B_TRUE 1 100 0.00 1.00000000000 BIT_MASK 0x1 FORMAT "%13.11" ECU_ADDRESS 0x5000200C /end MEASUREMENT
/begin MEASUREMENT UEGO_CJ135PckEvlnS1B1_I.flgIPmpActvd "Class instance of the functional class of FC UEGO_CJ135PckEvln for bank 1 sensor 1 / pump current activated" UBYTE B_TRUE 1 100 0.00 1.00000000000 BIT_MASK 0x1 FORMAT "%13.11" ECU_ADDRESS 0x5000200D /end MEASUREMENT
/begin MEASUREMENT UEGO_CJ135PckEvlnS1B1_I.flgLoupeN "Class instance of the functional class of FC UEGO_CJ135PckEvln for bank 1 sensor 1 / Loupe nerst cell measurement active" UBYTE B_TRUE 1 100 0.00 1.00000000000 BIT_MASK 0x1 FORMAT "%13.11" ECU_ADDRESS 0x5000200E /end MEASUREMENT
/begin MEASUREMENT UEGO_CJ135PckEvlnS1B1_I.flgLoupeP "Class instance of the functional class of FC UEGO_CJ135PckEvln for bank 1 sensor 1 / Loupe measurement of pump cell active" UBYTE B_TRUE 1 100 0.00 1.00000000000 BIT_MASK 0x1 FORMAT "%13.11" ECU_ADDRESS 0x5000200F /end MEASUREMENT
/begin MEASUREMENT UEGO_CJ135PckEvlnS1B1_I.flgLstPckAbort "Class instance of the functional class of FC UEGO_CJ135PckEvln for bank 1 sensor 1 / Last packet transfer aborted" UBYTE B_TRUE 1 100 0.00 1.00000000000 BIT_MASK 0x1 FORMAT "%13.11" ECU_ADDRESS 0x50002010 /end MEASUREMENT
/begin MEASUREMENT UEGO_CJ135PckEvlnS1B1_I.flgN3MeasActv "Class instance of the functional class of FC UEGO_CJ135PckEvln for bank 1 sensor 1 / Validity flag for Normal3 measurements" UBYTE B_TRUE 1 100 0.00 1.00000000000 BIT_MASK 0x1 FORMAT "%13.11" ECU_ADDRESS 0x50002011 /end MEASUREMENT
/begin MEASUREMENT UEGO_CJ135PckEvlnS1B1_I.flgN3MeasActvNxtPckVld "Class instance of the functional class of FC UEGO_CJ135PckEvln for bank 1 sensor 1 / Validity flag for Normal3 measurements for the next cycle" UBYTE B_TRUE 1 100 0.00 1.00000000000 BIT_MASK 0x2 FORMAT "%13.11" ECU_ADDRESS 0x50002009 /end MEASUREMENT
/begin MEASUREMENT UEGO_CJ135PckEvlnS1B1_I.flgN3MeasActvVld "Class instance of the functional class of FC UEGO_CJ135PckEvln for bank 1 sensor 1 / Validity flag for Normal3 measurements" UBYTE B_TRUE 1 100 0.00 1.00000000000 BIT_MASK 0x1 FORMAT "%13.11" ECU_ADDRESS 0x50002012 /end MEASUREMENT
/begin MEASUREMENT UEGO_CJ135PckEvlnS1B1_I.flgNewPck "Class instance of the functional class of FC UEGO_CJ135PckEvln for bank 1 sensor 1 / A new packet is available" UBYTE B_TRUE 1 100 0.00 1.00000000000 BIT_MASK 0x1 FORMAT "%13.11" ECU_ADDRESS 0x50002013 /end MEASUREMENT
/begin MEASUREMENT UEGO_CJ135PckEvlnS1B1_I.flgNewPckCstncEnd "Class instance of the functional class of FC UEGO_CJ135PckEvln for bank 1 sensor 1 / Consistency of the new packet information at the beginning of data collection" UBYTE B_TRUE 1 100 0.00 1.00000000000 BIT_MASK 0x1 FORMAT "%13.11" ECU_ADDRESS 0x50002014 /end MEASUREMENT
/begin MEASUREMENT UEGO_CJ135PckEvlnS1B1_I.flgNewPckCstncStrt "Class instance of the functional class of FC UEGO_CJ135PckEvln for bank 1 sensor 1 / Consistency of the new packet information at the end of data collection" UBYTE B_TRUE 1 100 0.00 1.00000000000 BIT_MASK 0x1 FORMAT "%13.11" ECU_ADDRESS 0x50002015 /end MEASUREMENT
/begin MEASUREMENT UEGO_CJ135PckEvlnS1B1_I.flgNewPckMiss "Class instance of the functional class of FC UEGO_CJ135PckEvln for bank 1 sensor 1 / A new packet was missed" UBYTE B_TRUE 1 100 0.00 1.00000000000 BIT_MASK 0x1 FORMAT "%13.11" ECU_ADDRESS 0x50002016 /end MEASUREMENT
/begin MEASUREMENT UEGO_CJ135PckEvlnS1B1_I.flgNewPckVld "Class instance of the functional class of FC UEGO_CJ135PckEvln for bank 1 sensor 1 / Validity of the new packet" UBYTE B_TRUE 1 100 0.00 1.00000000000 BIT_MASK 0x1 FORMAT "%13.11" ECU_ADDRESS 0x50002017 /end MEASUREMENT
/begin MEASUREMENT UEGO_CJ135PckEvlnS1B1_I.flgRParlWoDsbc "Class instance of the functional class of FC UEGO_CJ135PckEvln for bank 1 sensor 1 / Validity flag for Rparl calculation without disturbance" UBYTE B_TRUE 1 100 0.00 1.00000000000 BIT_MASK 0x1 FORMAT "%13.11" ECU_ADDRESS 0x50002018 /end MEASUREMENT
/begin MEASUREMENT UEGO_CJ135PckEvlnS1B1_I.flgRParlWoDsbcNxtPckVld "Class instance of the functional class of FC UEGO_CJ135PckEvln for bank 1 sensor 1 / Validity flag for Rparl calculation without disturbance for the next cycle" UBYTE B_TRUE 1 100 0.00 1.00000000000 BIT_MASK 0x4 FORMAT "%13.11" ECU_ADDRESS 0x50002009 /end MEASUREMENT
/begin MEASUREMENT UEGO_CJ135PckEvlnS1B1_I.flgRParlWoDsbcVld "Class instance of the functional class of FC UEGO_CJ135PckEvln for bank 1 sensor 1 / Validity flag for Rparl calculation without disturbance" UBYTE B_TRUE 1 100 0.00 1.00000000000 BIT_MASK 0x1 FORMAT "%13.11" ECU_ADDRESS 0x50002019 /end MEASUREMENT
/begin MEASUREMENT UEGO_CJ135PckEvlnS1B1_I.flgRefPatChng "Class instance of the functional class of FC UEGO_CJ135PckEvln for bank 1 sensor 1 / Change in the validity of the REFPAT register" UBYTE B_TRUE 1 100 0.00 1.00000000000 BIT_MASK 0x1 FORMAT "%13.11" ECU_ADDRESS 0x5000201A /end MEASUREMENT
/begin MEASUREMENT UEGO_CJ135PckEvlnS1B1_I.flgRefPatNxtPckVld "Class instance of the functional class of FC UEGO_CJ135PckEvln for bank 1 sensor 1 / Validity of the next REFPAT register" UBYTE B_TRUE 1 100 0.00 1.00000000000 BIT_MASK 0x20 FORMAT "%13.11" ECU_ADDRESS 0x50002008 /end MEASUREMENT
/begin MEASUREMENT UEGO_CJ135PckEvlnS1B1_I.flgRefPatVld "Class instance of the functional class of FC UEGO_CJ135PckEvln for bank 1 sensor 1 / Validity of the REFPAT register" UBYTE B_TRUE 1 100 0.00 1.00000000000 BIT_MASK 0x1 FORMAT "%13.11" ECU_ADDRESS 0x5000201B /end MEASUREMENT
/begin MEASUREMENT UEGO_CJ135PckEvlnS1B1_I.flgRegIpoffChng "Class instance of the functional class of FC UEGO_CJ135PckEvln for bank 1 sensor 1 / Change in the register IPOFF" UBYTE B_TRUE 1 100 0.00 1.00000000000 BIT_MASK 0x4 FORMAT "%13.11" ECU_ADDRESS 0x50002008 /end MEASUREMENT
/begin MEASUREMENT UEGO_CJ135PckEvlnS1B1_I.flgRegIpoffNxtPckVld "Class instance of the functional class of FC UEGO_CJ135PckEvln for bank 1 sensor 1 / Validity of register IPOFF value for the next cycle" UBYTE B_TRUE 1 100 0.00 1.00000000000 BIT_MASK 0x1 FORMAT "%13.11" ECU_ADDRESS 0x50002009 /end MEASUREMENT
/begin MEASUREMENT UEGO_CJ135PckEvlnS1B1_I.flgRegIpoffVld "Class instance of the functional class of FC UEGO_CJ135PckEvln for bank 1 sensor 1 / Validity of register IPOFF value" UBYTE B_TRUE 1 100 0.00 1.00000000000 BIT_MASK 0x1 FORMAT "%13.11" ECU_ADDRESS 0x5000201C /end MEASUREMENT
/begin MEASUREMENT UEGO_CJ135PckEvlnS1B1_I.flgRegModNxtPckVld "Class instance of the functional class of FC UEGO_CJ135PckEvln for bank 1 sensor 1 / Validity of register MODE for the next cycle" UBYTE B_TRUE 1 100 0.00 1.00000000000 BIT_MASK 0x8 FORMAT "%13.11" ECU_ADDRESS 0x50002008 /end MEASUREMENT
/begin MEASUREMENT UEGO_CJ135PckEvlnS1B1_I.flgRegModVld "Class instance of the functional class of FC UEGO_CJ135PckEvln for bank 1 sensor 1 / Validity of register MODE" UBYTE B_TRUE 1 100 0.00 1.00000000000 BIT_MASK 0x1 FORMAT "%13.11" ECU_ADDRESS 0x5000201D /end MEASUREMENT
/begin MEASUREMENT UEGO_CJ135PckEvlnS1B1_I.flgRegTrmNxtPckVld "Class instance of the functional class of FC UEGO_CJ135PckEvln for bank 1 sensor 1 / Validity of Trim register for the next cycle" UBYTE B_TRUE 1 100 0.00 1.00000000000 BIT_MASK 0x20 FORMAT "%13.11" ECU_ADDRESS 0x50002009 /end MEASUREMENT
/begin MEASUREMENT UEGO_CJ135PckEvlnS1B1_I.flgRegUnsetNxtPckVld "Class instance of the functional class of FC UEGO_CJ135PckEvln for bank 1 sensor 1 / Validity of unset Trim register for the next cycle" UBYTE B_TRUE 1 100 0.00 1.00000000000 BIT_MASK 0x8 FORMAT "%13.11" ECU_ADDRESS 0x50002009 /end MEASUREMENT
/begin MEASUREMENT UEGO_CJ135PckEvlnS1B1_I.flgRegUnsetVld "Class instance of the functional class of FC UEGO_CJ135PckEvln for bank 1 sensor 1 / Validity of unset Trim register" UBYTE B_TRUE 1 100 0.00 1.00000000000 BIT_MASK 0x1 FORMAT "%13.11" ECU_ADDRESS 0x5000201E /end MEASUREMENT
/begin MEASUREMENT UEGO_CJ135PckEvlnS1B1_I.flgRpcActv "Class instance of the functional class of FC UEGO_CJ135PckEvln for bank 1 sensor 1 / Reverse Pump Current Mode active in Asic" UBYTE B_TRUE 1 100 0.00 1.00000000000 BIT_MASK 0x1 FORMAT "%13.11" ECU_ADDRESS 0x5000201F /end MEASUREMENT
/begin MEASUREMENT UEGO_CJ135PckEvlnS1B1_I.flgRpcActvNxtPckVld "Class instance of the functional class of FC UEGO_CJ135PckEvln for bank 1 sensor 1 / Reverse Pump Current Mode active in Asic for the next cycle" UBYTE B_TRUE 1 100 0.00 1.00000000000 BIT_MASK 0x40 FORMAT "%13.11" ECU_ADDRESS 0x50002008 /end MEASUREMENT
/begin MEASUREMENT UEGO_CJ135PckEvlnS1B1_I.flgRpcActvVld "Class instance of the functional class of FC UEGO_CJ135PckEvln for bank 1 sensor 1 / Validity of Reverse Pump Current Mode" UBYTE B_TRUE 1 100 0.00 1.00000000000 BIT_MASK 0x1 FORMAT "%13.11" ECU_ADDRESS 0x50002020 /end MEASUREMENT
/begin MEASUREMENT UEGO_CJ135PckEvlnS1B1_I.flgSteerPatChng "Class instance of the functional class of FC UEGO_CJ135PckEvln for bank 1 sensor 1 / Change in the status of the STEERPAT register" UBYTE B_TRUE 1 100 0.00 1.00000000000 BIT_MASK 0x1 FORMAT "%13.11" ECU_ADDRESS 0x50002021 /end MEASUREMENT
/begin MEASUREMENT UEGO_CJ135PckEvlnS1B1_I.flgSteerPatNxtPckVld "Class instance of the functional class of FC UEGO_CJ135PckEvln for bank 1 sensor 1 / Validity of Reverse Pump Current Mode for the next cycle" UBYTE B_TRUE 1 100 0.00 1.00000000000 BIT_MASK 0x10 FORMAT "%13.11" ECU_ADDRESS 0x50002009 /end MEASUREMENT
/begin MEASUREMENT UEGO_CJ135PckEvlnS1B1_I.flgSteerPatVld "Class instance of the functional class of FC UEGO_CJ135PckEvln for bank 1 sensor 1 / Validity of SteerPat" UBYTE B_TRUE 1 100 0.00 1.00000000000 BIT_MASK 0x1 FORMAT "%13.11" ECU_ADDRESS 0x50002022 /end MEASUREMENT
/begin MEASUREMENT UEGO_CJ135PckEvlnS1B1_I.flgTrimSqChng "Class instance of the functional class of FC UEGO_CJ135PckEvln for bank 1 sensor 1 / Change in the adjustment bits of ISQ reference" UBYTE B_TRUE 1 100 0.00 1.00000000000 BIT_MASK 0x1 FORMAT "%13.11" ECU_ADDRESS 0x50002023 /end MEASUREMENT
/begin MEASUREMENT UEGO_CJ135PckEvlnS1B1_I.flgTrimSqrChng "Class instance of the functional class of FC UEGO_CJ135PckEvln for bank 1 sensor 1 / Change in the adjustment bits of ISQR reference" UBYTE B_TRUE 1 100 0.00 1.00000000000 BIT_MASK 0x1 FORMAT "%13.11" ECU_ADDRESS 0x50002024 /end MEASUREMENT
/begin MEASUREMENT UEGO_CJ135PckEvlnS1B1_I.flgTrmSqVld "Class instance of the functional class of FC UEGO_CJ135PckEvln for bank 1 sensor 1 / Validity of Trim register" UBYTE B_TRUE 1 100 0.00 1.00000000000 BIT_MASK 0x1 FORMAT "%13.11" ECU_ADDRESS 0x50002025 /end MEASUREMENT
/begin MEASUREMENT UEGO_CJ135PckEvlnS1B1_I.flgTrmSqrVld "Class instance of the functional class of FC UEGO_CJ135PckEvln for bank 1 sensor 1 / Validity of Trim register" UBYTE B_TRUE 1 100 0.00 1.00000000000 BIT_MASK 0x1 FORMAT "%13.11" ECU_ADDRESS 0x50002026 /end MEASUREMENT
/begin MEASUREMENT UEGO_CJ135PckEvlnS1B1_I.flgUPmpCtrlNxtPckVld "Class instance of the functional class of FC UEGO_CJ135PckEvln for bank 1 sensor 1 / Validity UPmpCtrl request for the next cycle" UBYTE B_TRUE 1 100 0.00 1.00000000000 BIT_MASK 0x10 FORMAT "%13.11" ECU_ADDRESS 0x50002008 /end MEASUREMENT
/begin MEASUREMENT UEGO_CJ135PckEvlnS1B1_I.flgUPmpCtrlVld "Class instance of the functional class of FC UEGO_CJ135PckEvln for bank 1 sensor 1 / Validity UPmpCtrl request" UBYTE B_TRUE 1 100 0.00 1.00000000000 BIT_MASK 0x1 FORMAT "%13.11" ECU_ADDRESS 0x50002027 /end MEASUREMENT
/begin MEASUREMENT UEGO_CJ135PckEvlnS1B1_I.flgURIA "Class instance of the functional class of FC UEGO_CJ135PckEvln for bank 1 sensor 1 / Bit URIA in the register MODE" UBYTE B_TRUE 1 100 0.00 1.00000000000 BIT_MASK 0x1 FORMAT "%13.11" ECU_ADDRESS 0x50002028 /end MEASUREMENT
/begin MEASUREMENT UEGO_CJ135PckEvlnS1B1_I.idxOPT "Class instance of the functional class of FC UEGO_CJ135PckEvln for bank 1 sensor 1 / index OPT in the register MODE" UBYTE dez 1 100 0.00 255.0 FORMAT "%5.1" ECU_ADDRESS 0x50002029 /end MEASUREMENT
/begin MEASUREMENT UEGO_CJ135PckEvlnS1B1_I.numModMeas "Class instance of the functional class of FC UEGO_CJ135PckEvln for bank 1 sensor 1 / Measured mode of the asic" UBYTE dez 1 100 0.00 255.0 FORMAT "%5.1" ECU_ADDRESS 0x5000202A /end MEASUREMENT
/begin MEASUREMENT UEGO_CJ135PckEvlnS1B1_I.numPckDataLostCntr "Class instance of the functional class of FC UEGO_CJ135PckEvln for bank 1 sensor 1 / Amount of packets where data was lost" UBYTE dez 1 100 0.00 255.0 FORMAT "%5.1" ECU_ADDRESS 0x5000202B /end MEASUREMENT
/begin MEASUREMENT UEGO_CJ135PckEvlnS1B1_I.numPckNotCmplCntr "Class instance of the functional class of FC UEGO_CJ135PckEvln for bank 1 sensor 1 / Amount of packets which could not been transfered completely" UBYTE dez 1 100 0.00 255.0 FORMAT "%5.1" ECU_ADDRESS 0x5000202C /end MEASUREMENT
/begin MEASUREMENT UEGO_CJ135PckEvlnS1B1_I.numRamRegMod "Class instance of the functional class of FC UEGO_CJ135PckEvln for bank 1 sensor 1 / Value of the register MODE in RAM" UWORD dez 1 100 0.00 65535.00 FORMAT "%8.2" ECU_ADDRESS 0x5000202E /end MEASUREMENT
/begin MEASUREMENT UEGO_CJ135PckEvlnS1B1_I.numRegDiffCntr "Class instance of the functional class of FC UEGO_CJ135PckEvln for bank 1 sensor 1 / Amount of packets where the RAM values where inconsitent to the register ones" UBYTE dez 1 100 0.00 255.0 FORMAT "%5.1" ECU_ADDRESS 0x50002030 /end MEASUREMENT
/begin MEASUREMENT UEGO_CJ135PckEvlnS1B1_I.numRegIpoff "Class instance of the functional class of FC UEGO_CJ135PckEvln for bank 1 sensor 1 / Value of the register IPOFF" UWORD dez 1 100 0.00 65535.00 FORMAT "%8.2" ECU_ADDRESS 0x50002032 /end MEASUREMENT
/begin MEASUREMENT UEGO_CJ135PckEvlnS1B1_I.numRegIpoffNxtPck "Class instance of the functional class of FC UEGO_CJ135PckEvln for bank 1 sensor 1 / Next value of the register IPOFF" UWORD dez 1 100 0.00 65535.00 FORMAT "%8.2" ECU_ADDRESS 0x50002034 /end MEASUREMENT
/begin MEASUREMENT UEGO_CJ135PckEvlnS1B1_I.numRegMod "Class instance of the functional class of FC UEGO_CJ135PckEvln for bank 1 sensor 1 / Value of the register MODE" UWORD dez 1 100 0.00 65535.00 FORMAT "%8.2" ECU_ADDRESS 0x50002036 /end MEASUREMENT
/begin MEASUREMENT UEGO_CJ135PckEvlnS1B1_I.numRegModNxtPck "Class instance of the functional class of FC UEGO_CJ135PckEvln for bank 1 sensor 1 / Next value of the register MODE" UWORD dez 1 100 0.00 65535.00 FORMAT "%8.2" ECU_ADDRESS 0x50002038 /end MEASUREMENT
/begin MEASUREMENT UEGO_CJ135PckEvlnS1B1_I.numRegTrmNxtPck "Class instance of the functional class of FC UEGO_CJ135PckEvln for bank 1 sensor 1 / Next adjustment bits of the current" UWORD dez 1 100 0.00 65535.00 FORMAT "%8.2" ECU_ADDRESS 0x5000203A /end MEASUREMENT
/begin MEASUREMENT UEGO_CJ135PckEvlnS1B1_I.numRegUnset "Class instance of the functional class of FC UEGO_CJ135PckEvln for bank 1 sensor 1 / Value of the register UNSET" UWORD dez 1 100 0.00 65535.00 FORMAT "%8.2" ECU_ADDRESS 0x5000203C /end MEASUREMENT
/begin MEASUREMENT UEGO_CJ135PckEvlnS1B1_I.numRegUnsetNxtPck "Class instance of the functional class of FC UEGO_CJ135PckEvln for bank 1 sensor 1 / Next value of the register UNSET" UWORD dez 1 100 0.00 65535.00 FORMAT "%8.2" ECU_ADDRESS 0x5000203E /end MEASUREMENT
/begin MEASUREMENT UEGO_CJ135PckEvlnS1B1_I.numTrmSq "Class instance of the functional class of FC UEGO_CJ135PckEvln for bank 1 sensor 1 / Adjustment bits of ISQ reference" UWORD dez 1 100 0.00 65535.00 FORMAT "%8.2" ECU_ADDRESS 0x50002040 /end MEASUREMENT
/begin MEASUREMENT UEGO_CJ135PckEvlnS1B1_I.numTrmSqr "Class instance of the functional class of FC UEGO_CJ135PckEvln for bank 1 sensor 1 / Adjustment bits of ISQR reference" UWORD dez 1 100 0.00 65535.00 FORMAT "%8.2" ECU_ADDRESS 0x50002042 /end MEASUREMENT
/begin MEASUREMENT UEGO_CJ135PckEvlnS1B1_I.stLsmRetValMod "Class instance of the functional class of FC UEGO_CJ135PckEvln for bank 1 sensor 1 / Return value of LSM when demanding the register MODE" ULONG dez 1 100 0.00 4294967295.00 FORMAT "%13.2" ECU_ADDRESS 0x50002044 /end MEASUREMENT
/begin MEASUREMENT UEGO_CJ135PckEvlnS1B1_I.stRefPat "Class instance of the functional class of FC UEGO_CJ135PckEvln for bank 1 sensor 1 / Status of the REFPAT register" UWORD dez 1 100 0.00 65535.00 FORMAT "%8.2" ECU_ADDRESS 0x50002048 /end MEASUREMENT
/begin MEASUREMENT UEGO_CJ135PckEvlnS1B1_I.stRefPatNxtPck "Class instance of the functional class of FC UEGO_CJ135PckEvln for bank 1 sensor 1 / Next status of the REFPAT register" UWORD dez 1 100 0.00 65535.00 FORMAT "%8.2" ECU_ADDRESS 0x5000204A /end MEASUREMENT
/begin MEASUREMENT UEGO_CJ135PckEvlnS1B1_I.stSteerPat "Class instance of the functional class of FC UEGO_CJ135PckEvln for bank 1 sensor 1 / Status of the STEERPAT register" UWORD dez 1 100 0.00 65535.00 FORMAT "%8.2" ECU_ADDRESS 0x5000204C /end MEASUREMENT
/begin MEASUREMENT UEGO_CJ135PckEvlnS1B1_I.stSteerPatNxtPck "Class instance of the functional class of FC UEGO_CJ135PckEvln for bank 1 sensor 1 / Next status of the STEERPAT register" UWORD dez 1 100 0.00 65535.00 FORMAT "%8.2" ECU_ADDRESS 0x5000204E /end MEASUREMENT
/begin MEASUREMENT UEGO_CJ135PckEvlnS1B1_I.stUPmpCtrlCurr "Class instance of the functional class of FC UEGO_CJ135PckEvln for bank 1 sensor 1 / Indication for UPmpCtrl request" UWORD dez 1 100 0.00 65535.00 FORMAT "%8.2" ECU_ADDRESS 0x50002050 /end MEASUREMENT
/begin MEASUREMENT UEGO_CJ135PckEvlnS1B1_I.stUPmpCtrlCurrNxtPck "Class instance of the functional class of FC UEGO_CJ135PckEvln for bank 1 sensor 1 / Indication for UPmpCtrl request for the next cycle" UWORD dez 1 100 0.00 65535.00 FORMAT "%8.2" ECU_ADDRESS 0x50002052 /end MEASUREMENT
/begin MEASUREMENT UEGO_CJ135RTEvalS1B1_I.ctReiniProc5msec "Class instance of the functional class of FC UEGO_CJ135RTEval for Bank 1 Sensor 1 / Counter for ReIni process" UBYTE OneToOne 1 100 0.00 255.0 FORMAT "%5.1" ECU_ADDRESS 0x5000205C /end MEASUREMENT
/begin MEASUREMENT UEGO_CJ135RTEvalS1B1_I.facRieRia "Class instance of the functional class of FC UEGO_CJ135RTEval for Bank 1 Sensor 1 / ratio of resistance nernst cell to pump cell" UWORD fak_q0p000244 1 100 0.00 15.99976 FORMAT "%8.5" ECU_ADDRESS 0x600362AA /end MEASUREMENT
/begin MEASUREMENT UEGO_CJ135RTEvalS1B1_I.flgDeltaUnStdVld "Class instance of the functional class of FC UEGO_CJ135RTEval for Bank 1 Sensor 1 / flag Delta Un0 Valid for Standard Operation" UBYTE B_TRUE 1 100 0.00 1.00000000000 BIT_MASK 0x1 FORMAT "%13.11" ECU_ADDRESS 0x5000205B /end MEASUREMENT
/begin MEASUREMENT UEGO_CJ135RTEvalS1B1_I.flgDeltaUnTM2RVld "Class instance of the functional class of FC UEGO_CJ135RTEval for Bank 1 Sensor 1 / flag Delta Un0 Valid for TM2R Mode" UBYTE B_TRUE 1 100 0.00 1.00000000000 BIT_MASK 0x2 FORMAT "%13.11" ECU_ADDRESS 0x5000205B /end MEASUREMENT
/begin MEASUREMENT UEGO_CJ135RTEvalS1B1_I.flgIPmpTM2R "Class instance of the functional class of FC UEGO_CJ135RTEval for Bank 1 Sensor 1 / flag TM2R Active" UBYTE B_TRUE 1 100 0.00 1.00000000000 BIT_MASK 0x8 FORMAT "%13.11" ECU_ADDRESS 0x5000205A /end MEASUREMENT
/begin MEASUREMENT UEGO_CJ135RTEvalS1B1_I.flgRelsRTEval "Class instance of the functional class of FC UEGO_CJ135RTEval for Bank 1 Sensor 1 / RTeval functional class interface flgRelsRTEval" UBYTE B_TRUE 1 100 0.00 1.00000000000 BIT_MASK 0x1 FORMAT "%13.11" ECU_ADDRESS 0x5000205A /end MEASUREMENT
/begin MEASUREMENT UEGO_CJ135RTEvalS1B1_I.flgRiaActvd "Class instance of the functional class of FC UEGO_CJ135RTEval for Bank 1 Sensor 1 / RTeval functional class interface flgRiaActvd" UBYTE B_TRUE 1 100 0.00 1.00000000000 BIT_MASK 0x4 FORMAT "%13.11" ECU_ADDRESS 0x50002058 /end MEASUREMENT
/begin MEASUREMENT UEGO_CJ135RTEvalS1B1_I.flgRiaCalcd "Class instance of the functional class of FC UEGO_CJ135RTEval for Bank 1 Sensor 1 / RTeval functional class interface flgRiaCalcd" UBYTE B_TRUE 1 100 0.00 1.00000000000 BIT_MASK 0x1 FORMAT "%13.11" ECU_ADDRESS 0x50002059 /end MEASUREMENT
/begin MEASUREMENT UEGO_CJ135RTEvalS1B1_I.flgRiaFilRst "Class instance of the functional class of FC UEGO_CJ135RTEval for Bank 1 Sensor 1 / RTeval functional class interface flgRiaFilRst" UBYTE B_TRUE 1 100 0.00 1.00000000000 BIT_MASK 0x2 FORMAT "%13.11" ECU_ADDRESS 0x50002059 /end MEASUREMENT
/begin MEASUREMENT UEGO_CJ135RTEvalS1B1_I.flgRiaHiPrcns "Class instance of the functional class of FC UEGO_CJ135RTEval for Bank 1 Sensor 1 / Ria measured with high precision" UBYTE B_TRUE 1 100 0.00 1.00000000000 BIT_MASK 0x40 FORMAT "%13.11" ECU_ADDRESS 0x5000205A /end MEASUREMENT
/begin MEASUREMENT UEGO_CJ135RTEvalS1B1_I.flgRiaVld "Class instance of the functional class of FC UEGO_CJ135RTEval for Bank 1 Sensor 1 / RTeval functional class interface flgRiaVld" UBYTE B_TRUE 1 100 0.00 1.00000000000 BIT_MASK 0x10 FORMAT "%13.11" ECU_ADDRESS 0x50002058 /end MEASUREMENT
/begin MEASUREMENT UEGO_CJ135RTEvalS1B1_I.flgRieActvd "Class instance of the functional class of FC UEGO_CJ135RTEval for Bank 1 Sensor 1 / condition of temperature calculation based on nernst cell resistance" UBYTE B_TRUE 1 100 0.00 1.00000000000 BIT_MASK 0x20 FORMAT "%13.11" ECU_ADDRESS 0x50002058 /end MEASUREMENT
/begin MEASUREMENT UEGO_CJ135RTEvalS1B1_I.flgRieCalcd "Class instance of the functional class of FC UEGO_CJ135RTEval for Bank 1 Sensor 1 / RTeval functional class interface flgRieCalcd" UBYTE B_TRUE 1 100 0.00 1.00000000000 BIT_MASK 0x4 FORMAT "%13.11" ECU_ADDRESS 0x50002059 /end MEASUREMENT
/begin MEASUREMENT UEGO_CJ135RTEvalS1B1_I.flgRieFilRst "Class instance of the functional class of FC UEGO_CJ135RTEval for Bank 1 Sensor 1 / RTeval functional class interface flgRieFilRst" UBYTE B_TRUE 1 100 0.00 1.00000000000 BIT_MASK 0x8 FORMAT "%13.11" ECU_ADDRESS 0x50002059 /end MEASUREMENT
/begin MEASUREMENT UEGO_CJ135RTEvalS1B1_I.flgRieVld "Class instance of the functional class of FC UEGO_CJ135RTEval for Bank 1 Sensor 1 / RTeval functional class interface flgRieVld" UBYTE B_TRUE 1 100 0.00 1.00000000000 BIT_MASK 0x40 FORMAT "%13.11" ECU_ADDRESS 0x50002058 /end MEASUREMENT
/begin MEASUREMENT UEGO_CJ135RTEvalS1B1_I.flgRipActvd "Class instance of the functional class of FC UEGO_CJ135RTEval for Bank 1 Sensor 1 / RTeval functional class interface flgRipActvd" UBYTE B_TRUE 1 100 0.00 1.00000000000 BIT_MASK 0x80 FORMAT "%13.11" ECU_ADDRESS 0x50002058 /end MEASUREMENT
/begin MEASUREMENT UEGO_CJ135RTEvalS1B1_I.flgRipZ1Calcd "Class instance of the functional class of FC UEGO_CJ135RTEval for Bank 1 Sensor 1 / RTeval functional class interface flgRipZ1Calcd" UBYTE B_TRUE 1 100 0.00 1.00000000000 BIT_MASK 0x10 FORMAT "%13.11" ECU_ADDRESS 0x50002059 /end MEASUREMENT
/begin MEASUREMENT UEGO_CJ135RTEvalS1B1_I.flgRipZ1FilRst "Class instance of the functional class of FC UEGO_CJ135RTEval for Bank 1 Sensor 1 / RTeval functional class interface flgRipZ1FilRst" UBYTE B_TRUE 1 100 0.00 1.00000000000 BIT_MASK 0x20 FORMAT "%13.11" ECU_ADDRESS 0x50002059 /end MEASUREMENT
/begin MEASUREMENT UEGO_CJ135RTEvalS1B1_I.flgRipZ1Vld "Class instance of the functional class of FC UEGO_CJ135RTEval for Bank 1 Sensor 1 / RTeval functional class interface flgRipZ1Vld" UBYTE B_TRUE 1 100 0.00 1.00000000000 BIT_MASK 0x4 FORMAT "%13.11" ECU_ADDRESS 0x5000205A /end MEASUREMENT
/begin MEASUREMENT UEGO_CJ135RTEvalS1B1_I.flgRipZ2Calcd "Class instance of the functional class of FC UEGO_CJ135RTEval for Bank 1 Sensor 1 / RTeval functional class interface flgRipZ2Calcd" UBYTE B_TRUE 1 100 0.00 1.00000000000 BIT_MASK 0x40 FORMAT "%13.11" ECU_ADDRESS 0x50002059 /end MEASUREMENT
/begin MEASUREMENT UEGO_CJ135RTEvalS1B1_I.flgRipZ2FilRst "Class instance of the functional class of FC UEGO_CJ135RTEval for Bank 1 Sensor 1 / RTeval functional class interface flgRipZ2FilRst" UBYTE B_TRUE 1 100 0.00 1.00000000000 BIT_MASK 0x80 FORMAT "%13.11" ECU_ADDRESS 0x50002059 /end MEASUREMENT
/begin MEASUREMENT UEGO_CJ135RTEvalS1B1_I.flgRipZ2Vld "Class instance of the functional class of FC UEGO_CJ135RTEval for Bank 1 Sensor 1 / RTeval functional class interface flgRipZ2Vld" UBYTE B_TRUE 1 100 0.00 1.00000000000 BIT_MASK 0x10 FORMAT "%13.11" ECU_ADDRESS 0x5000205A /end MEASUREMENT
/begin MEASUREMENT UEGO_CJ135RTEvalS1B1_I.flgRipdActvd "Class instance of the functional class of FC UEGO_CJ135RTEval for Bank 1 Sensor 1 / flag Ripd active" UBYTE B_TRUE 1 100 0.00 1.00000000000 BIT_MASK 0x1 FORMAT "%13.11" ECU_ADDRESS 0x50002058 /end MEASUREMENT
/begin MEASUREMENT UEGO_CJ135RTEvalS1B1_I.flgRipdCalcd "Class instance of the functional class of FC UEGO_CJ135RTEval for Bank 1 Sensor 1 / flag Ripd calculated" UBYTE B_TRUE 1 100 0.00 1.00000000000 BIT_MASK 0x80 FORMAT "%13.11" ECU_ADDRESS 0x5000205A /end MEASUREMENT
/begin MEASUREMENT UEGO_CJ135RTEvalS1B1_I.flgRipdFilRst "Class instance of the functional class of FC UEGO_CJ135RTEval for Bank 1 Sensor 1 / Flag Ripd filter reset" UBYTE B_TRUE 1 100 0.00 1.00000000000 BIT_MASK 0x20 FORMAT "%13.11" ECU_ADDRESS 0x5000205A /end MEASUREMENT
/begin MEASUREMENT UEGO_CJ135RTEvalS1B1_I.flgRipdVld "Class instance of the functional class of FC UEGO_CJ135RTEval for Bank 1 Sensor 1 / flag Ripd valid" UBYTE B_TRUE 1 100 0.00 1.00000000000 BIT_MASK 0x2 FORMAT "%13.11" ECU_ADDRESS 0x5000205A /end MEASUREMENT
/begin MEASUREMENT UEGO_CJ135RTEvalS1B1_I.numPacRia "Class instance of the functional class of FC UEGO_CJ135RTEval for Bank 1 Sensor 1 / number of resistance measurement of pumping cell" UWORD dez 1 100 0.00 65535.00 FORMAT "%8.2" ECU_ADDRESS 0x5000205E /end MEASUREMENT
/begin MEASUREMENT UEGO_CJ135RTEvalS1B1_I.numPacRie "Class instance of the functional class of FC UEGO_CJ135RTEval for Bank 1 Sensor 1 / number of resistance measurement of nernst cell" UWORD dez 1 100 0.00 65535.00 FORMAT "%8.2" ECU_ADDRESS 0x50002060 /end MEASUREMENT
/begin MEASUREMENT UEGO_CJ135RTEvalS1B1_I.numPacRipZ1 "Class instance of the functional class of FC UEGO_CJ135RTEval for Bank 1 Sensor 1 / RTeval functional class interface numPacRipZ1" UWORD dez 1 100 0.00 65535.00 FORMAT "%8.2" ECU_ADDRESS 0x50002062 /end MEASUREMENT
/begin MEASUREMENT UEGO_CJ135RTEvalS1B1_I.numPacRipZ2 "Class instance of the functional class of FC UEGO_CJ135RTEval for Bank 1 Sensor 1 / RTeval functional class interface numPacRipZ2" UWORD dez 1 100 0.00 65535.00 FORMAT "%8.2" ECU_ADDRESS 0x50002064 /end MEASUREMENT
/begin MEASUREMENT UEGO_CJ135RTEvalS1B1_I.numPacRipd "Class instance of the functional class of FC UEGO_CJ135RTEval for Bank 1 Sensor 1 / number of measurements used in Ripd" UWORD dez 1 100 0.00 65535.00 FORMAT "%8.2" ECU_ADDRESS 0x50002066 /end MEASUREMENT
/begin MEASUREMENT UEGO_CJ135RTEvalS1B1_I.numUpMeas "Class instance of the functional class of FC UEGO_CJ135RTEval for Bank 1 Sensor 1 / RTeval functional class interface numUpMeas" UBYTE dez 1 100 0.00 255.0 FORMAT "%5.1" ECU_ADDRESS 0x50002068 /end MEASUREMENT
/begin MEASUREMENT UEGO_CJ135RTEvalS1B1_I.numUrieMeas "Class instance of the functional class of FC UEGO_CJ135RTEval for Bank 1 Sensor 1 / number of Urie Measurement" UBYTE dez 1 100 0.00 255.0 FORMAT "%5.1" ECU_ADDRESS 0x50002069 /end MEASUREMENT
/begin MEASUREMENT UEGO_CJ135RTEvalS1B1_I.numUriePacSum "Class instance of the functional class of FC UEGO_CJ135RTEval for Bank 1 Sensor 1 / number of Urie Measurements in a Packet" UBYTE dez 1 100 0.00 255.0 FORMAT "%5.1" ECU_ADDRESS 0x5000206A /end MEASUREMENT
/begin MEASUREMENT UEGO_CJ135RTEvalS1B1_I.resRiaRaw "Class instance of the functional class of FC UEGO_CJ135RTEval for Bank 1 Sensor 1 / resistance of pumping cell without filtering" UWORD r_q0p1_Ohm 1 100 0.00 6553.500 FORMAT "%8.3" ECU_ADDRESS 0x5000206C /end MEASUREMENT
/begin MEASUREMENT UEGO_CJ135RTEvalS1B1_I.resRieEfc "Class instance of the functional class of FC UEGO_CJ135RTEval for Bank 1 Sensor 1 / resistance for temperature determination" UWORD r_q0p1_Ohm 1 100 0.00 6553.500 FORMAT "%8.3" ECU_ADDRESS 0x5000206E /end MEASUREMENT
/begin MEASUREMENT UEGO_CJ135RTEvalS1B1_I.resRieRaw "Class instance of the functional class of FC UEGO_CJ135RTEval for Bank 1 Sensor 1 / resistance of nernst cell without filtering" UWORD r_q0p1_Ohm 1 100 0.00 6553.500 FORMAT "%8.3" ECU_ADDRESS 0x50002070 /end MEASUREMENT
/begin MEASUREMENT UEGO_CJ135RTEvalS1B1_I.resRieRawSum "Class instance of the functional class of FC UEGO_CJ135RTEval for Bank 1 Sensor 1 / Sum of nernstcell resistances in a packet" ULONG r_q0p1_Ohm 1 100 0.00 429496729.500 FORMAT "%13.3" ECU_ADDRESS 0x50002074 /end MEASUREMENT
/begin MEASUREMENT UEGO_CJ135RTEvalS1B1_I.resRipZ1Raw "Class instance of the functional class of FC UEGO_CJ135RTEval for Bank 1 Sensor 1 / RTeval functional class interface resRipZ1Raw" UWORD r_q0p1_Ohm 1 100 0.00 6553.500 FORMAT "%8.3" ECU_ADDRESS 0x50002078 /end MEASUREMENT
/begin MEASUREMENT UEGO_CJ135RTEvalS1B1_I.resRipZ2Raw "Class instance of the functional class of FC UEGO_CJ135RTEval for Bank 1 Sensor 1 / Unfiltered inner resistance measurement at pump cell for switching state Z2" UWORD r_q0p1_Ohm 1 100 0.00 6553.500 FORMAT "%8.3" ECU_ADDRESS 0x5000207A /end MEASUREMENT
/begin MEASUREMENT UEGO_CJ135RTEvalS1B1_I.resRipd "Class instance of the functional class of FC UEGO_CJ135RTEval for Bank 1 Sensor 1 / Ripd resistance after resistance corrections" UWORD r_q0p1_Ohm 1 100 0.00 6553.500 FORMAT "%8.3" ARRAY_SIZE 5 ECU_ADDRESS 0x5000207C /end MEASUREMENT
/begin MEASUREMENT UEGO_CJ135RTEvalS1B1_I.resRipdRaw "Class instance of the functional class of FC UEGO_CJ135RTEval for Bank 1 Sensor 1 / raw value of Ripd" UWORD r_q0p1_Ohm 1 100 0.00 6553.500 FORMAT "%8.3" ECU_ADDRESS 0x50002086 /end MEASUREMENT
/begin MEASUREMENT UEGO_CJ135RTEvalS1B1_I.uDeltaUn "Class instance of the functional class of FC UEGO_CJ135RTEval for Bank 1 Sensor 1 / Difference betwwen UrieBase and Urie" SWORD spg_q3p2Em4_V 1 100 -10.48576 10.48544 FORMAT "%8.5" ECU_ADDRESS 0x50002088 /end MEASUREMENT
/begin MEASUREMENT UEGO_CJ135RTEvalS1B1_I.uDeltaUnExp "Class instance of the functional class of FC UEGO_CJ135RTEval for Bank 1 Sensor 1 / Delta Un0 value exported to other FC NAMELY UEGO_CJ135Ctl" SWORD spg_q3p2Em4_V 1 100 -10.48576 10.48544 FORMAT "%8.5" ECU_ADDRESS 0x5000208A /end MEASUREMENT
/begin MEASUREMENT UEGO_CJ135RTEvalS1B1_I.uUpBRipd "Class instance of the functional class of FC UEGO_CJ135RTEval for Bank 1 Sensor 1 / base raw voltage for Ripd" SWORD spg_q3p2Em4_V 1 100 -10.48576 10.48544 FORMAT "%8.5" ECU_ADDRESS 0x5000208C /end MEASUREMENT
/begin MEASUREMENT UEGO_CJ135RTEvalS1B1_I.uUpBaseZ1 "Class instance of the functional class of FC UEGO_CJ135RTEval for Bank 1 Sensor 1 / base voltage for Rip Z1 measurement" SWORD spg_q3p2Em4_V 1 100 -10.48576 10.48544 FORMAT "%8.5" ECU_ADDRESS 0x5000208E /end MEASUREMENT
/begin MEASUREMENT UEGO_CJ135RTEvalS1B1_I.uUpBaseZ2 "Class instance of the functional class of FC UEGO_CJ135RTEval for Bank 1 Sensor 1 / base voltage for Rip Z2 (TM2) measurement" SWORD spg_q3p2Em4_V 1 100 -10.48576 10.48544 FORMAT "%8.5" ECU_ADDRESS 0x50002090 /end MEASUREMENT
/begin MEASUREMENT UEGO_CJ135RTEvalS1B1_I.uUpRipd "Class instance of the functional class of FC UEGO_CJ135RTEval for Bank 1 Sensor 1 / Up raw voltage for Ripd measurement" SWORD spg_q3p2Em4_V 1 100 -10.48576 10.48544 FORMAT "%8.5" ECU_ADDRESS 0x50002092 /end MEASUREMENT
/begin MEASUREMENT UEGO_CJ135RTEvalS1B1_I.uUpZ1 "Class instance of the functional class of FC UEGO_CJ135RTEval for Bank 1 Sensor 1 / voltage for Rip Z1 measurement" SWORD spg_q3p2Em4_V 1 100 -10.48576 10.48544 FORMAT "%8.5" ECU_ADDRESS 0x50002094 /end MEASUREMENT
/begin MEASUREMENT UEGO_CJ135RTEvalS1B1_I.uUpZ2 "Class instance of the functional class of FC UEGO_CJ135RTEval for Bank 1 Sensor 1 / voltage for Rip Z1 (TM2) measurement" SWORD spg_q3p2Em4_V 1 100 -10.48576 10.48544 FORMAT "%8.5" ECU_ADDRESS 0x50002096 /end MEASUREMENT
/begin MEASUREMENT UEGO_CJ135RTEvalS1B1_I.uUriaBase "Class instance of the functional class of FC UEGO_CJ135RTEval for Bank 1 Sensor 1 / base voltage for Ria measurement" SWORD spg_q3p2Em4_V 1 100 -10.48576 10.48544 FORMAT "%8.5" ECU_ADDRESS 0x50002098 /end MEASUREMENT
/begin MEASUREMENT UEGO_CJ135RTEvalS1B1_I.uUrie "Class instance of the functional class of FC UEGO_CJ135RTEval for Bank 1 Sensor 1 / voltage for Rie measurement" SWORD spg_q3p2Em4_V 1 100 -10.48576 10.48544 FORMAT "%8.5" ECU_ADDRESS 0x5000209A /end MEASUREMENT
/begin MEASUREMENT UEGO_CJ135RTEvalS1B1_I.uUrieBase "Class instance of the functional class of FC UEGO_CJ135RTEval for Bank 1 Sensor 1 / base voltage for Rie measurement" SWORD spg_q3p2Em4_V 1 100 -10.48576 10.48544 FORMAT "%8.5" ECU_ADDRESS 0x5000209C /end MEASUREMENT
/begin MEASUREMENT UEGO_CJ135RTEvalS1B1_I.TOffDlyDeltaUnStdVld_TOFFV_I.outbit "Class instance of the functional class of FC UEGO_CJ135RTEval for Bank 1 Sensor 1 / TurnOffDelay to reset Delta Un0 Standard Validity flag / Output Bit" UBYTE B_TRUE 1 100 0.00 1.00000000000 BIT_MASK 0x1 FORMAT "%13.11" ECU_ADDRESS 0x5000209E /end MEASUREMENT
/begin MEASUREMENT UEGO_CJ135RTEvalS1B1_I.TOffDlyDeltaUnStdVld_TOFFV_I.time "Class instance of the functional class of FC UEGO_CJ135RTEval for Bank 1 Sensor 1 / TurnOffDelay to reset Delta Un0 Standard Validity flag / Occured Time" UWORD t_q0p005 1 100 0.00 327.6750 FORMAT "%8.4" ECU_ADDRESS 0x500020A0 /end MEASUREMENT
/begin MEASUREMENT UEGO_CJ135RTEvalS1B1_I.TOffDlyDeltaUnTM2RVld_TOFFV_I.outbit "Class instance of the functional class of FC UEGO_CJ135RTEval for Bank 1 Sensor 1 / TurnOffDelay to reset Delta Un0 TM2R Validity flag / Output Bit" UBYTE B_TRUE 1 100 0.00 1.00000000000 BIT_MASK 0x1 FORMAT "%13.11" ECU_ADDRESS 0x500020A2 /end MEASUREMENT
/begin MEASUREMENT UEGO_CJ135RTEvalS1B1_I.TOffDlyDeltaUnTM2RVld_TOFFV_I.time "Class instance of the functional class of FC UEGO_CJ135RTEval for Bank 1 Sensor 1 / TurnOffDelay to reset Delta Un0 TM2R Validity flag / Occured Time" UWORD t_q0p005 1 100 0.00 327.6750 FORMAT "%8.4" ECU_ADDRESS 0x500020A4 /end MEASUREMENT
/begin MEASUREMENT UEGO_CJ135RTEvalS1B1_I.facRieRiaFltDL_I.memory "Class instance of the functional class of FC UEGO_CJ135RTEval for Bank 1 Sensor 1 / facRieRiaFltDl digital low pass / current lowpass value" ULONG fak_q3p72529Em9 1 100 0.00 15.9999999963 FORMAT "%13.10" ECU_ADDRESS 0x500020A8 /end MEASUREMENT
/begin MEASUREMENT UEGO_CJ135RTEvalS1B1_I.facRieRipFltDL_I.memory "Class instance of the functional class of FC UEGO_CJ135RTEval for Bank 1 Sensor 1 / facRieRipFltDl digital low pass / current lowpass value" ULONG fak_q3p72529Em9 1 100 0.00 15.9999999963 FORMAT "%13.10" ECU_ADDRESS 0x500020AC /end MEASUREMENT
/begin MEASUREMENT UEGO_CJ135RTEvalS1B1_I.flgRiaCalc_TOFFVNM_I.time "Class instance of the functional class of FC UEGO_CJ135RTEval for Bank 1 Sensor 1 / TOD flgRiaCalc / delay time" UWORD t_q0p005 1 100 0.00 327.6750 FORMAT "%8.4" ECU_ADDRESS 0x500020B0 /end MEASUREMENT
/begin MEASUREMENT UEGO_CJ135RTEvalS1B1_I.flgRieCalc_TOFFVNM_I.time "Class instance of the functional class of FC UEGO_CJ135RTEval for Bank 1 Sensor 1 / TOD flgRieCalc / delay time" UWORD t_q0p005 1 100 0.00 327.6750 FORMAT "%8.4" ECU_ADDRESS 0x500020B2 /end MEASUREMENT
/begin MEASUREMENT UEGO_CJ135RTEvalS1B1_I.flgRipZ1Calc_TOFFVNM_I.time "Class instance of the functional class of FC UEGO_CJ135RTEval for Bank 1 Sensor 1 / TOD flgRipZ1Calc / delay time" UWORD t_q0p005 1 100 0.00 327.6750 FORMAT "%8.4" ECU_ADDRESS 0x500020B4 /end MEASUREMENT
/begin MEASUREMENT UEGO_CJ135RTEvalS1B1_I.flgRipZ2Calc_TOFFVNM_I.time "Class instance of the functional class of FC UEGO_CJ135RTEval for Bank 1 Sensor 1 / TOD flgRipZ2Calc / delay time" UWORD t_q0p005 1 100 0.00 327.6750 FORMAT "%8.4" ECU_ADDRESS 0x500020B6 /end MEASUREMENT
/begin MEASUREMENT UEGO_CJ135RTEvalS1B1_I.flgRipdCalc_TOFFVNM_I.time "Class instance of the functional class of FC UEGO_CJ135RTEval for Bank 1 Sensor 1 / TOD flgRipdCalc / delay time" UWORD t_q0p005 1 100 0.00 327.6750 FORMAT "%8.4" ECU_ADDRESS 0x500020B8 /end MEASUREMENT
/begin MEASUREMENT UEGO_CJ135RTEvalS1B1_I.resRiaDL_I.memory "Class instance of the functional class of FC UEGO_CJ135RTEval for Bank 1 Sensor 1 / digital low pass resRia / current lowpass value" ULONG r_q1p5259Em6_Ohm 1 100 0.00 6553.59999847 FORMAT "%13.8" ECU_ADDRESS 0x500020BC /end MEASUREMENT
/begin MEASUREMENT UEGO_CJ135RTEvalS1B1_I.resRieDL_I.memory "Class instance of the functional class of FC UEGO_CJ135RTEval for Bank 1 Sensor 1 / digital low pass resRie / current lowpass value" ULONG r_q1p5259Em6_Ohm 1 100 0.00 6553.59999847 FORMAT "%13.8" ECU_ADDRESS 0x500020C0 /end MEASUREMENT
/begin MEASUREMENT UEGO_CJ135RTEvalS1B1_I.resRipZ1DL_I.memory "Class instance of the functional class of FC UEGO_CJ135RTEval for Bank 1 Sensor 1 / digital low pass resRipZ1 / current lowpass value" ULONG r_q1p5259Em6_Ohm 1 100 0.00 6553.59999847 FORMAT "%13.8" ECU_ADDRESS 0x500020C4 /end MEASUREMENT
/begin MEASUREMENT UEGO_CJ135RTEvalS1B1_I.resRipZ2DL_I.memory "Class instance of the functional class of FC UEGO_CJ135RTEval for Bank 1 Sensor 1 / digital low pass resRipZ2 / current lowpass value" ULONG r_q1p5259Em6_Ohm 1 100 0.00 6553.59999847 FORMAT "%13.8" ECU_ADDRESS 0x500020C8 /end MEASUREMENT
/begin MEASUREMENT UEGO_CJ135RTEvalS1B1_I.resRipdDL_I.memory "Class instance of the functional class of FC UEGO_CJ135RTEval for Bank 1 Sensor 1 / digital low pass resRipd / current lowpass value" ULONG r_q1p5259Em6_Ohm 1 100 0.00 6553.59999847 FORMAT "%13.8" ECU_ADDRESS 0x500020CC /end MEASUREMENT
/begin MEASUREMENT UEGO_CJ135RTEvalS1B1_I.uDeltaUnStdDL_I.memory "Class instance of the functional class of FC UEGO_CJ135RTEval for Bank 1 Sensor 1 / Filter for Delta Un0 Standard / current lowpass value" SLONG spg_q4p883Em9_V 1 100 -10.4857600000 10.4857599951 FORMAT "%13.10" ECU_ADDRESS 0x500020D0 /end MEASUREMENT
/begin MEASUREMENT UEGO_CJ135RTEvalS1B1_I.uDeltaUnTM2RDL_I.memory "Class instance of the functional class of FC UEGO_CJ135RTEval for Bank 1 Sensor 1 / Filter for Delta Un0 TM2R / current lowpass value" SLONG spg_q4p883Em9_V 1 100 -10.4857600000 10.4857599951 FORMAT "%13.10" ECU_ADDRESS 0x500020D4 /end MEASUREMENT
/begin MEASUREMENT UEGO_CJ135RvsChrgS1B1_I.Detrmt "class instance reverse charge function sensor 1 bank 1 / determinant for calculation of capacitor" SWORD q0p00032_V2 1 100 -10.48576 10.48544 FORMAT "%8.5" ECU_ADDRESS 0x500020DE /end MEASUREMENT
/begin MEASUREMENT UEGO_CJ135RvsChrgS1B1_I.cpCapeCmesCellLimd "class instance reverse charge function sensor 1 bank 1 / calculated ECU capacitor at pin APE, MES (limited)" UWORD q1Em10_F 1 100 0.00 0.000006553500 FORMAT "%14.12" ECU_ADDRESS 0x6003628C /end MEASUREMENT
/begin MEASUREMENT UEGO_CJ135RvsChrgS1B1_I.cpCapeCmesCellLrn "class instance reverse charge function sensor 1 bank 1 / calculated ECU capacitor at pin APE, MES" UWORD q1Em10_F 1 100 0.00 0.000006553500 FORMAT "%14.12" ECU_ADDRESS 0x500020E0 /end MEASUREMENT
/begin MEASUREMENT UEGO_CJ135RvsChrgS1B1_I.cpCigCellLimd "class instance reverse charge function sensor 1 bank 1 / calculated ECU capacitor at pin IPE (limited)" UWORD q1Em10_F 1 100 0.00 0.000006553500 FORMAT "%14.12" ECU_ADDRESS 0x6003628E /end MEASUREMENT
/begin MEASUREMENT UEGO_CJ135RvsChrgS1B1_I.cpCigCellLrn "class instance reverse charge function sensor 1 bank 1 / calculated ECU capacitor at pin IPE" UWORD q1Em10_F 1 100 0.00 0.000006553500 FORMAT "%14.12" ECU_ADDRESS 0x500020E2 /end MEASUREMENT
/begin MEASUREMENT UEGO_CJ135RvsChrgS1B1_I.cpCpAvrgCell "class instance reverse charge function sensor 1 bank 1 / average value to calculated capacitors at pin APE, IPE, MES" UWORD q1Em10_F 1 100 0.00 0.000006553500 FORMAT "%14.12" ECU_ADDRESS 0x500020E4 /end MEASUREMENT
/begin MEASUREMENT UEGO_CJ135RvsChrgS1B1_I.ctReiniProc5msec "class instance reverse charge function sensor 1 bank 1 / local driving cycle counter, which after reinitialization will be overwritten by global driving cycle counter SyC_ctPostDrvLeave." UBYTE OneToOne 1 100 0.00 255.0 FORMAT "%5.1" ECU_ADDRESS 0x500020E6 /end MEASUREMENT
/begin MEASUREMENT UEGO_CJ135RvsChrgS1B1_I.facCorKIA11P "class instance reverse charge function sensor 1 bank 1 / Correction factor of delta Sigma converter" UWORD fak_uw_b2 1 100 0.00 1.999969 FORMAT "%8.6" ECU_ADDRESS 0x500020E8 /end MEASUREMENT
/begin MEASUREMENT UEGO_CJ135RvsChrgS1B1_I.facCorKIA12P "class instance reverse charge function sensor 1 bank 1 / Correction factor of delta Sigma converter" UWORD fak_uw_b2 1 100 0.00 1.999969 FORMAT "%8.6" ECU_ADDRESS 0x500020EA /end MEASUREMENT
/begin MEASUREMENT UEGO_CJ135RvsChrgS1B1_I.facCorKIA21P "class instance reverse charge function sensor 1 bank 1 / Correction factor of delta Sigma converter" UWORD fak_uw_b2 1 100 0.00 1.999969 FORMAT "%8.6" ECU_ADDRESS 0x500020EC /end MEASUREMENT
/begin MEASUREMENT UEGO_CJ135RvsChrgS1B1_I.facCorKIA22P "class instance reverse charge function sensor 1 bank 1 / Correction factor of delta Sigma converter" UWORD fak_uw_b2 1 100 0.00 1.999969 FORMAT "%8.6" ECU_ADDRESS 0x500020EE /end MEASUREMENT
/begin MEASUREMENT UEGO_CJ135RvsChrgS1B1_I.facCorKIV1P "class instance reverse charge function sensor 1 bank 1 / Correction factor of delta Sigma converter" UWORD fak_uw_b2 1 100 0.00 1.999969 FORMAT "%8.6" ECU_ADDRESS 0x500020F0 /end MEASUREMENT
/begin MEASUREMENT UEGO_CJ135RvsChrgS1B1_I.facCorKIV2P "class instance reverse charge function sensor 1 bank 1 / Correction factor of delta Sigma converter" UWORD fak_uw_b2 1 100 0.00 1.999969 FORMAT "%8.6" ECU_ADDRESS 0x500020F2 /end MEASUREMENT
/begin MEASUREMENT UEGO_CJ135RvsChrgS1B1_I.facPlsTaa "class instance reverse charge function sensor 1 bank 1 / Positive pulse duration in TM1" UWORD fak_uw_b1 1 100 0.00 0.9999847 FORMAT "%9.7" ECU_ADDRESS 0x500020F4 /end MEASUREMENT
/begin MEASUREMENT UEGO_CJ135RvsChrgS1B1_I.facPlsTii "class instance reverse charge function sensor 1 bank 1 / Negative pulse duration in TM1" UWORD fak_uw_b1 1 100 0.00 0.9999847 FORMAT "%9.7" ECU_ADDRESS 0x500020F6 /end MEASUREMENT
/begin MEASUREMENT UEGO_CJ135RvsChrgS1B1_I.flgCpCalcd "class instance reverse charge function sensor 1 bank 1 / Condition completed calculation of capacitors in the current trip" UBYTE B_TRUE 1 100 0.00 1.00000000000 BIT_MASK 0x1 FORMAT "%13.11" ECU_ADDRESS 0x500020F8 /end MEASUREMENT
/begin MEASUREMENT UEGO_CJ135RvsChrgS1B1_I.flgCpCalcdEndTot "class instance reverse charge function sensor 1 bank 1 / Condition completed calculation of capacitors" UBYTE B_TRUE 1 100 0.00 1.00000000000 BIT_MASK 0x1 FORMAT "%13.11" ECU_ADDRESS 0x60036290 /end MEASUREMENT
/begin MEASUREMENT UEGO_CJ135RvsChrgS1B1_I.flgCpMeas "class instance reverse charge function sensor 1 bank 1 / Condition requirement test signal for C measurement" UBYTE B_TRUE 1 100 0.00 1.00000000000 BIT_MASK 0x1 FORMAT "%13.11" ECU_ADDRESS 0x500020F9 /end MEASUREMENT
/begin MEASUREMENT UEGO_CJ135RvsChrgS1B1_I.flgDeltaUiAllEndTot "class instance reverse charge function sensor 1 bank 1 / condition measurement delta Ui2x for all area" UBYTE B_TRUE 1 100 0.00 1.00000000000 BIT_MASK 0x1 FORMAT "%13.11" ECU_ADDRESS 0x60036291 /end MEASUREMENT
/begin MEASUREMENT UEGO_CJ135RvsChrgS1B1_I.flgDeltaUiAllLeanMeasd "class instance reverse charge function sensor 1 bank 1 / Condition measurement delta Ui2x for lean area" UBYTE B_TRUE 1 100 0.00 1.00000000000 BIT_MASK 0x1 FORMAT "%13.11" ECU_ADDRESS 0x500020FA /end MEASUREMENT
/begin MEASUREMENT UEGO_CJ135RvsChrgS1B1_I.flgDeltaUiAllMeasd "class instance reverse charge function sensor 1 bank 1 / condition measurement delta Ui2x in the current trip for all area" UBYTE B_TRUE 1 100 0.00 1.00000000000 BIT_MASK 0x1 FORMAT "%13.11" ECU_ADDRESS 0x500020FB /end MEASUREMENT
/begin MEASUREMENT UEGO_CJ135RvsChrgS1B1_I.flgDeltaUiAllModlnLam1Measd "class instance reverse charge function sensor 1 bank 1 / Condition measurement delta Ui2x for lamba1 area" UBYTE B_TRUE 1 100 0.00 1.00000000000 BIT_MASK 0x1 FORMAT "%13.11" ECU_ADDRESS 0x500020FC /end MEASUREMENT
/begin MEASUREMENT UEGO_CJ135RvsChrgS1B1_I.flgDeltaUiAllRichMeasd "class instance reverse charge function sensor 1 bank 1 / Condition measurement delta Ui2x for rich area" UBYTE B_TRUE 1 100 0.00 1.00000000000 BIT_MASK 0x1 FORMAT "%13.11" ECU_ADDRESS 0x500020FD /end MEASUREMENT
/begin MEASUREMENT UEGO_CJ135RvsChrgS1B1_I.flgDeltaUiAllSpcMeasd "class instance reverse charge function sensor 1 bank 1 / Condition measurement delta Ui2x for specific area" UBYTE B_TRUE 1 100 0.00 1.00000000000 BIT_MASK 0x1 FORMAT "%13.11" ECU_ADDRESS 0x500020FE /end MEASUREMENT
/begin MEASUREMENT UEGO_CJ135RvsChrgS1B1_I.flgIPTM2RLst "class instance reverse charge function sensor 1 bank 1 / condition last IPTM2R value" UBYTE B_TRUE 1 100 0.00 1.00000000000 BIT_MASK 0x1 FORMAT "%13.11" ECU_ADDRESS 0x500020FF /end MEASUREMENT
/begin MEASUREMENT UEGO_CJ135RvsChrgS1B1_I.flgIPmpRvsChrgVld "class instance reverse charge function sensor 1 bank 1 / condition validity of reverse charge correction" UBYTE B_TRUE 1 100 0.00 1.00000000000 BIT_MASK 0x1 FORMAT "%13.11" ECU_ADDRESS 0x50002100 /end MEASUREMENT
/begin MEASUREMENT UEGO_CJ135RvsChrgS1B1_I.flgNewCpCalc "class instance reverse charge function sensor 1 bank 1 / Condition new C calculation" UBYTE B_TRUE 1 100 0.00 1.00000000000 BIT_MASK 0x2 FORMAT "%13.11" ECU_ADDRESS 0x500020D8 /end MEASUREMENT
/begin MEASUREMENT UEGO_CJ135RvsChrgS1B1_I.flgNewDataRvsChrgTM1 "class instance reverse charge function sensor 1 bank 1 / condition new data for reverse charge correction TM1" UBYTE B_TRUE 1 100 0.00 1.00000000000 BIT_MASK 0x4 FORMAT "%13.11" ECU_ADDRESS 0x500020D8 /end MEASUREMENT
/begin MEASUREMENT UEGO_CJ135RvsChrgS1B1_I.flgNewDataRvsChrgTM2L "class instance reverse charge function sensor 1 bank 1 / condition new data for reverse charge correction TM2Lean" UBYTE B_TRUE 1 100 0.00 1.00000000000 BIT_MASK 0x8 FORMAT "%13.11" ECU_ADDRESS 0x500020D8 /end MEASUREMENT
/begin MEASUREMENT UEGO_CJ135RvsChrgS1B1_I.flgNewDeltaUiAll "class instance reverse charge function sensor 1 bank 1 / Condition new delta Ui2x" UBYTE B_TRUE 1 100 0.00 1.00000000000 BIT_MASK 0x2 FORMAT "%13.11" ECU_ADDRESS 0x500020DB /end MEASUREMENT
/begin MEASUREMENT UEGO_CJ135RvsChrgS1B1_I.flgNewIPmpPac "class instance reverse charge function sensor 1 bank 1 / Bedingung neues Pumpstrompaket" UBYTE B_TRUE 1 100 0.00 1.00000000000 BIT_MASK 0x1 FORMAT "%13.11" ECU_ADDRESS 0x50002101 /end MEASUREMENT
/begin MEASUREMENT UEGO_CJ135RvsChrgS1B1_I.flgNewIPmpRvsChrg "class instance reverse charge function sensor 1 bank 1 / Condition new reverse charge value" UBYTE B_TRUE 1 100 0.00 1.00000000000 BIT_MASK 0x1 FORMAT "%13.11" ECU_ADDRESS 0x50002102 /end MEASUREMENT
/begin MEASUREMENT UEGO_CJ135RvsChrgS1B1_I.flgNewIPmpRvsChrgTM1 "class instance reverse charge function sensor 1 bank 1 / Condition new reverse charge value for TM1" UBYTE B_TRUE 1 100 0.00 1.00000000000 BIT_MASK 0x1 FORMAT "%13.11" ECU_ADDRESS 0x500020DC /end MEASUREMENT
/begin MEASUREMENT UEGO_CJ135RvsChrgS1B1_I.flgNewIPmpRvsChrgTM1TM2Lean "class instance reverse charge function sensor 1 bank 1 / Condition new reverse charge value for TM1, TM2Lean" UBYTE B_TRUE 1 100 0.00 1.00000000000 BIT_MASK 0x40 FORMAT "%13.11" ECU_ADDRESS 0x500020DC /end MEASUREMENT
/begin MEASUREMENT UEGO_CJ135RvsChrgS1B1_I.flgNewIPmpRvsChrgTM1TM2Rich "class instance reverse charge function sensor 1 bank 1 / Condition new reverse charge value for TM1, TM2Rich" UBYTE B_TRUE 1 100 0.00 1.00000000000 BIT_MASK 0x80 FORMAT "%13.11" ECU_ADDRESS 0x500020DC /end MEASUREMENT
/begin MEASUREMENT UEGO_CJ135RvsChrgS1B1_I.flgNewIPmpRvsChrgTM2L "class instance reverse charge function sensor 1 bank 1 / Condition new reverse charge value for TM2L" UBYTE B_TRUE 1 100 0.00 1.00000000000 BIT_MASK 0x2 FORMAT "%13.11" ECU_ADDRESS 0x500020DC /end MEASUREMENT
/begin MEASUREMENT UEGO_CJ135RvsChrgS1B1_I.flgNewIPmpRvsChrgTM2R "class instance reverse charge function sensor 1 bank 1 / Condition new reverse charge value for TM2R" UBYTE B_TRUE 1 100 0.00 1.00000000000 BIT_MASK 0x4 FORMAT "%13.11" ECU_ADDRESS 0x500020DC /end MEASUREMENT
/begin MEASUREMENT UEGO_CJ135RvsChrgS1B1_I.flgRatIPmpAvrgLam1UiAllMeas "class instance reverse charge function sensor 1 bank 1 / condition ratio IP around Lam1 area" UBYTE B_TRUE 1 100 0.00 1.00000000000 BIT_MASK 0x1 FORMAT "%13.11" ECU_ADDRESS 0x50002103 /end MEASUREMENT
/begin MEASUREMENT UEGO_CJ135RvsChrgS1B1_I.flgRatIPmpAvrgLeanUiAllMeas "class instance reverse charge function sensor 1 bank 1 / condition ratio IP around Lean area" UBYTE B_TRUE 1 100 0.00 1.00000000000 BIT_MASK 0x1 FORMAT "%13.11" ECU_ADDRESS 0x50002104 /end MEASUREMENT
/begin MEASUREMENT UEGO_CJ135RvsChrgS1B1_I.flgRatIPmpAvrgRichUiAllMeas "class instance reverse charge function sensor 1 bank 1 / condition ratio IP around Lean area" UBYTE B_TRUE 1 100 0.00 1.00000000000 BIT_MASK 0x1 FORMAT "%13.11" ECU_ADDRESS 0x50002105 /end MEASUREMENT
/begin MEASUREMENT UEGO_CJ135RvsChrgS1B1_I.flgRatIPmpAvrgSpcUiAllMeas "class instance reverse charge function sensor 1 bank 1 / condition ratio IP around specific area" UBYTE B_TRUE 1 100 0.00 1.00000000000 BIT_MASK 0x1 FORMAT "%13.11" ECU_ADDRESS 0x50002106 /end MEASUREMENT
/begin MEASUREMENT UEGO_CJ135RvsChrgS1B1_I.flgRegRdyCpCalc "class instance reverse charge function sensor 1 bank 1 / Condition setting of the register for C measurement" UBYTE B_TRUE 1 100 0.00 1.00000000000 BIT_MASK 0x1 FORMAT "%13.11" ECU_ADDRESS 0x50002107 /end MEASUREMENT
/begin MEASUREMENT UEGO_CJ135RvsChrgS1B1_I.flgRegRdyDeltaUiAll "class instance reverse charge function sensor 1 bank 1 / Condition setting of the register for Uix measurement" UBYTE B_TRUE 1 100 0.00 1.00000000000 BIT_MASK 0x1 FORMAT "%13.11" ECU_ADDRESS 0x50002108 /end MEASUREMENT
/begin MEASUREMENT UEGO_CJ135RvsChrgS1B1_I.flgUapeZ1Strtd "class instance reverse charge function sensor 1 bank 1 / Condition beginning UapeZ1 measurement" UBYTE B_TRUE 1 100 0.00 1.00000000000 BIT_MASK 0x8 FORMAT "%13.11" ECU_ADDRESS 0x500020DA /end MEASUREMENT
/begin MEASUREMENT UEGO_CJ135RvsChrgS1B1_I.flgUapeZ2Strtd "class instance reverse charge function sensor 1 bank 1 / Condition beginning UapeZ2 measurement" UBYTE B_TRUE 1 100 0.00 1.00000000000 BIT_MASK 0x10 FORMAT "%13.11" ECU_ADDRESS 0x500020DA /end MEASUREMENT
/begin MEASUREMENT UEGO_CJ135RvsChrgS1B1_I.flgUgiZ1Strtd "class instance reverse charge function sensor 1 bank 1 / Condition beginning UgiZ1 measurement" UBYTE B_TRUE 1 100 0.00 1.00000000000 BIT_MASK 0x20 FORMAT "%13.11" ECU_ADDRESS 0x500020DA /end MEASUREMENT
/begin MEASUREMENT UEGO_CJ135RvsChrgS1B1_I.flgUgiZ2Strtd "class instance reverse charge function sensor 1 bank 1 / Condition beginning UgiZ2 measurement" UBYTE B_TRUE 1 100 0.00 1.00000000000 BIT_MASK 0x40 FORMAT "%13.11" ECU_ADDRESS 0x500020DA /end MEASUREMENT
/begin MEASUREMENT UEGO_CJ135RvsChrgS1B1_I.flgUiAllMeas "class instance reverse charge function sensor 1 bank 1 / Condition requirement test signal for Ui2x measurement" UBYTE B_TRUE 1 100 0.00 1.00000000000 BIT_MASK 0x1 FORMAT "%13.11" ECU_ADDRESS 0x50002109 /end MEASUREMENT
/begin MEASUREMENT UEGO_CJ135RvsChrgS1B1_I.flgUp0Z0Strtd "class instance reverse charge function sensor 1 bank 1 / Condition beginning Up0Z0 measurement" UBYTE B_TRUE 1 100 0.00 1.00000000000 BIT_MASK 0x1 FORMAT "%13.11" ECU_ADDRESS 0x500020D9 /end MEASUREMENT
/begin MEASUREMENT UEGO_CJ135RvsChrgS1B1_I.flgUp0Z1Strtd "class instance reverse charge function sensor 1 bank 1 / Condition beginning Up0Z1 measurement" UBYTE B_TRUE 1 100 0.00 1.00000000000 BIT_MASK 0x2 FORMAT "%13.11" ECU_ADDRESS 0x500020D9 /end MEASUREMENT
/begin MEASUREMENT UEGO_CJ135RvsChrgS1B1_I.flgUp0Z2Strtd "class instance reverse charge function sensor 1 bank 1 / Condition beginning Up0Z2 measurement" UBYTE B_TRUE 1 100 0.00 1.00000000000 BIT_MASK 0x4 FORMAT "%13.11" ECU_ADDRESS 0x500020D9 /end MEASUREMENT
/begin MEASUREMENT UEGO_CJ135RvsChrgS1B1_I.iIPmpRvsChrgCorrn1RTM1TM2Rich "class instance reverse charge function sensor 1 bank 1 / reverse charge current Part 1 for TM1 and TM2Rich" SWORD i_q6p6667Em7_A 1 100 -0.02184533 0.02184467 FORMAT "%10.8" ARRAY_SIZE 5 ECU_ADDRESS 0x5000210A /end MEASUREMENT
/begin MEASUREMENT UEGO_CJ135RvsChrgS1B1_I.iIPmpRvsChrgCorrn1RTM2Rich "class instance reverse charge function sensor 1 bank 1 / reverse charge current Part 1 for TM2Rich" SWORD i_q6p6667Em7_A 1 100 -0.02184533 0.02184467 FORMAT "%10.8" ARRAY_SIZE 5 ECU_ADDRESS 0x50002114 /end MEASUREMENT
/begin MEASUREMENT UEGO_CJ135RvsChrgS1B1_I.iIPmpRvsChrgCorrn2RTM1TM2Rich "class instance reverse charge function sensor 1 bank 1 / reverse charge current Part 2 for TM1 and TM2Rich" SWORD i_q6p6667Em7_A 1 100 -0.02184533 0.02184467 FORMAT "%10.8" ARRAY_SIZE 5 ECU_ADDRESS 0x5000211E /end MEASUREMENT
/begin MEASUREMENT UEGO_CJ135RvsChrgS1B1_I.iIPmpRvsChrgCorrn3RTM1TM2Rich "class instance reverse charge function sensor 1 bank 1 / reverse charge current Part 3 for TM1 and TM2Rich" SWORD i_q6p6667Em7_A 1 100 -0.02184533 0.02184467 FORMAT "%10.8" ARRAY_SIZE 5 ECU_ADDRESS 0x50002128 /end MEASUREMENT
/begin MEASUREMENT UEGO_CJ135RvsChrgS1B1_I.iIPmpRvsChrgCorrnIRestTM1 "class instance reverse charge function sensor 1 bank 1 / reverse charge current rest switch for TM1" SWORD i_q6p6667Em7_A 1 100 -0.02184533 0.02184467 FORMAT "%10.8" ARRAY_SIZE 15 ECU_ADDRESS 0x50002132 /end MEASUREMENT
/begin MEASUREMENT UEGO_CJ135RvsChrgS1B1_I.iIPmpRvsChrgCorrnIRestTM2Rich "class instance reverse charge function sensor 1 bank 1 / reverse charge current rest switch for TM2Rich" SWORD i_q6p6667Em7_A 1 100 -0.02184533 0.02184467 FORMAT "%10.8" ARRAY_SIZE 15 ECU_ADDRESS 0x50002150 /end MEASUREMENT
/begin MEASUREMENT UEGO_CJ135RvsChrgS1B1_I.iPmpRaw "class instance reverse charge function sensor 1 bank 1 / Raw pump current" SWORD i_q6p6667Em7_A 1 100 -0.02184533 0.02184467 FORMAT "%10.8" ARRAY_SIZE 15 ECU_ADDRESS 0x5000216E /end MEASUREMENT
/begin MEASUREMENT UEGO_CJ135RvsChrgS1B1_I.numCaCm "class instance reverse charge function sensor 1 bank 1 / number of emv capacitors at pin ape, mes" UBYTE dez 1 100 0.00 4.000 FORMAT "%5.3" ECU_ADDRESS 0x5000218C /end MEASUREMENT
/begin MEASUREMENT UEGO_CJ135RvsChrgS1B1_I.numIPOffOrdCMeas "class instance reverse charge function sensor 1 bank 1 / set value CJ135 register IPOFF for C measurement" SWORD fak_q1p201Em4 1 100 -0.7221622 0.7221622 FORMAT "%9.7" ECU_ADDRESS 0x5000218E /end MEASUREMENT
/begin MEASUREMENT UEGO_CJ135RvsChrgS1B1_I.numIPOffOrdUi23Ui24Meas "class instance reverse charge function sensor 1 bank 1 / set value CJ135 register IPOFF for ui measurement" SWORD fak_q1p201Em4 1 100 -0.7221622 0.7221622 FORMAT "%9.7" ECU_ADDRESS 0x50002190 /end MEASUREMENT
/begin MEASUREMENT UEGO_CJ135RvsChrgS1B1_I.numPatOrd "class instance reverse charge function sensor 1 bank 1 / set value CJ135 registerpart PATTERN" UWORD dez 1 100 0.00 65535.00 FORMAT "%8.2" ECU_ADDRESS 0x50002192 /end MEASUREMENT
/begin MEASUREMENT UEGO_CJ135RvsChrgS1B1_I.numTrimSqOrd "class instance reverse charge function sensor 1 bank 1 / set value CJ135 registerpart TRIMSQ" UBYTE i_q1p25Em4_o0p004_A 1 100 0.00400 0.03587 FORMAT "%7.5" ECU_ADDRESS 0x50002194 /end MEASUREMENT
/begin MEASUREMENT UEGO_CJ135RvsChrgS1B1_I.qC1 "class instance reverse charge function sensor 1 bank 1 / Vector element qC1" SLONG q1Em12_A_s 1 100 -0.00214748364800 0.00214748364700 FORMAT "%16.14" ECU_ADDRESS 0x50002198 /end MEASUREMENT
/begin MEASUREMENT UEGO_CJ135RvsChrgS1B1_I.qC2 "class instance reverse charge function sensor 1 bank 1 / Vector element qC2" SLONG q1Em12_A_s 1 100 -0.00214748364800 0.00214748364700 FORMAT "%16.14" ECU_ADDRESS 0x5000219C /end MEASUREMENT
/begin MEASUREMENT UEGO_CJ135RvsChrgS1B1_I.ratIPmpAvrg "class instance reverse charge function sensor 1 bank 1 / Average value of the duty cycle of the pumping current" SWORD fak_q1p201Em4 1 100 -3.936096 3.935976 FORMAT "%8.6" ECU_ADDRESS 0x500021A0 /end MEASUREMENT
/begin MEASUREMENT UEGO_CJ135RvsChrgS1B1_I.ratIPmpAvrgOld "class instance reverse charge function sensor 1 bank 1 / Average value of the duty cycle of the pumping current" SWORD fak_q1p201Em4 1 100 -3.936096 3.935976 FORMAT "%8.6" ECU_ADDRESS 0x500021A2 /end MEASUREMENT
/begin MEASUREMENT UEGO_CJ135RvsChrgS1B1_I.ratIPmpAvrgUi21 "class instance reverse charge function sensor 1 bank 1 / Average value of the duty cycle of the pumping current" SWORD fak_q1p201Em4 1 100 -3.936096 3.935976 FORMAT "%8.6" ECU_ADDRESS 0x500021A4 /end MEASUREMENT
/begin MEASUREMENT UEGO_CJ135RvsChrgS1B1_I.tiLstCTrig "class instance reverse charge function sensor 1 bank 1 / Execution time requirement on a C measurement" UWORD t_q0p005 1 100 0.00 327.6750 FORMAT "%8.4" ECU_ADDRESS 0x500021A6 /end MEASUREMENT
/begin MEASUREMENT UEGO_CJ135RvsChrgS1B1_I.tiUi2Intrpn1Pnt "class instance reverse charge function sensor 1 bank 1 / the first interpolation point: T1" UWORD t_q0p000001_s 1 100 0.00 0.06553500 FORMAT "%10.8" ECU_ADDRESS 0x500021A8 /end MEASUREMENT
/begin MEASUREMENT UEGO_CJ135RvsChrgS1B1_I.tiUi2Intrpn2Pnt "class instance reverse charge function sensor 1 bank 1 / the second interpolation point: T2" UWORD t_q0p000001_s 1 100 0.00 0.06553500 FORMAT "%10.8" ECU_ADDRESS 0x500021AA /end MEASUREMENT
/begin MEASUREMENT UEGO_CJ135RvsChrgS1B1_I.tiUi2Measd "class instance reverse charge function sensor 1 bank 1 / Operating time of the pumping current on Ui measurement" UWORD t_q0p000001_s 1 100 0.00 0.06553500 FORMAT "%10.8" ECU_ADDRESS 0x500021AC /end MEASUREMENT
/begin MEASUREMENT UEGO_CJ135RvsChrgS1B1_I.uDeltaUapeZ1 "class instance reverse charge function sensor 1 bank 1 / Difference measured and calculated UapeZ1" SWORD spg_q3p2Em4_V 1 100 -10.48576 10.48544 FORMAT "%8.5" ECU_ADDRESS 0x500021AE /end MEASUREMENT
/begin MEASUREMENT UEGO_CJ135RvsChrgS1B1_I.uDeltaUapeZ2 "class instance reverse charge function sensor 1 bank 1 / Difference measured and calculated UapeZ2" SWORD spg_q3p2Em4_V 1 100 -10.48576 10.48544 FORMAT "%8.5" ECU_ADDRESS 0x500021B0 /end MEASUREMENT
/begin MEASUREMENT UEGO_CJ135RvsChrgS1B1_I.uDeltaUi22Lean "class instance reverse charge function sensor 1 bank 1 / Difference measured Ui22 and Ui21 in lean learning area" SWORD spg_q3p2Em4_V 1 100 -10.48576 10.48544 FORMAT "%8.5" ECU_ADDRESS 0x60036292 /end MEASUREMENT
/begin MEASUREMENT UEGO_CJ135RvsChrgS1B1_I.uDeltaUi22ModlnLam1 "class instance reverse charge function sensor 1 bank 1 / Difference measured Ui22 and Ui21 in Lambda1 learning area" SWORD spg_q3p2Em4_V 1 100 -10.48576 10.48544 FORMAT "%8.5" ECU_ADDRESS 0x60036294 /end MEASUREMENT
/begin MEASUREMENT UEGO_CJ135RvsChrgS1B1_I.uDeltaUi22Rich "class instance reverse charge function sensor 1 bank 1 / Difference measured Ui22 and Ui21 in rich learning area" SWORD spg_q3p2Em4_V 1 100 -10.48576 10.48544 FORMAT "%8.5" ECU_ADDRESS 0x60036296 /end MEASUREMENT
/begin MEASUREMENT UEGO_CJ135RvsChrgS1B1_I.uDeltaUi22Spc "class instance reverse charge function sensor 1 bank 1 / Difference measured Ui22 and Ui21 in specific learning area" SWORD spg_q3p2Em4_V 1 100 -10.48576 10.48544 FORMAT "%8.5" ECU_ADDRESS 0x60036298 /end MEASUREMENT
/begin MEASUREMENT UEGO_CJ135RvsChrgS1B1_I.uDeltaUi23Lean "class instance reverse charge function sensor 1 bank 1 / Difference measured Ui23 and Ui21 in lean learning area" SWORD spg_q3p2Em4_V 1 100 -10.48576 10.48544 FORMAT "%8.5" ECU_ADDRESS 0x6003629A /end MEASUREMENT
/begin MEASUREMENT UEGO_CJ135RvsChrgS1B1_I.uDeltaUi23ModlnLam1 "class instance reverse charge function sensor 1 bank 1 / Difference measured Ui23 and Ui21 in lambda1 learning area" SWORD spg_q3p2Em4_V 1 100 -10.48576 10.48544 FORMAT "%8.5" ECU_ADDRESS 0x6003629C /end MEASUREMENT
/begin MEASUREMENT UEGO_CJ135RvsChrgS1B1_I.uDeltaUi23Rich "class instance reverse charge function sensor 1 bank 1 / Difference measured Ui23 and Ui21 in rich learning area" SWORD spg_q3p2Em4_V 1 100 -10.48576 10.48544 FORMAT "%8.5" ECU_ADDRESS 0x6003629E /end MEASUREMENT
/begin MEASUREMENT UEGO_CJ135RvsChrgS1B1_I.uDeltaUi23Spc "class instance reverse charge function sensor 1 bank 1 / Difference measured Ui23 and Ui21 in specific learning area" SWORD spg_q3p2Em4_V 1 100 -10.48576 10.48544 FORMAT "%8.5" ECU_ADDRESS 0x600362A0 /end MEASUREMENT
/begin MEASUREMENT UEGO_CJ135RvsChrgS1B1_I.uDeltaUi24Lean "class instance reverse charge function sensor 1 bank 1 / Difference measured Ui24 and Ui21 in lean learning area" SWORD spg_q3p2Em4_V 1 100 -10.48576 10.48544 FORMAT "%8.5" ECU_ADDRESS 0x600362A2 /end MEASUREMENT
/begin MEASUREMENT UEGO_CJ135RvsChrgS1B1_I.uDeltaUi24ModlnLam1 "class instance reverse charge function sensor 1 bank 1 / Difference measured Ui24 and Ui21 in lambda1 learning area" SWORD spg_q3p2Em4_V 1 100 -10.48576 10.48544 FORMAT "%8.5" ECU_ADDRESS 0x600362A4 /end MEASUREMENT
/begin MEASUREMENT UEGO_CJ135RvsChrgS1B1_I.uDeltaUi24Rich "class instance reverse charge function sensor 1 bank 1 / Difference measured Ui24 and Ui21 in rich learning area" SWORD spg_q3p2Em4_V 1 100 -10.48576 10.48544 FORMAT "%8.5" ECU_ADDRESS 0x600362A6 /end MEASUREMENT
/begin MEASUREMENT UEGO_CJ135RvsChrgS1B1_I.uDeltaUi24Spc "class instance reverse charge function sensor 1 bank 1 / Difference measured Ui24 and Ui21 in specific learning area" SWORD spg_q3p2Em4_V 1 100 -10.48576 10.48544 FORMAT "%8.5" ECU_ADDRESS 0x600362A8 /end MEASUREMENT
/begin MEASUREMENT UEGO_CJ135RvsChrgS1B1_I.uMatrxA11 "class instance reverse charge function sensor 1 bank 1 / Matrix element A11" SWORD spg_q3p2Em4_V 1 100 -10.48576 10.48544 FORMAT "%8.5" ECU_ADDRESS 0x500021B2 /end MEASUREMENT
/begin MEASUREMENT UEGO_CJ135RvsChrgS1B1_I.uMatrxA12 "class instance reverse charge function sensor 1 bank 1 / Matrix element A12" SWORD spg_q3p2Em4_V 1 100 -10.48576 10.48544 FORMAT "%8.5" ECU_ADDRESS 0x500021B4 /end MEASUREMENT
/begin MEASUREMENT UEGO_CJ135RvsChrgS1B1_I.uMatrxA21 "class instance reverse charge function sensor 1 bank 1 / Matrix element A21" SWORD spg_q3p2Em4_V 1 100 -10.48576 10.48544 FORMAT "%8.5" ECU_ADDRESS 0x500021B6 /end MEASUREMENT
/begin MEASUREMENT UEGO_CJ135RvsChrgS1B1_I.uMatrxA22 "class instance reverse charge function sensor 1 bank 1 / Matrix element A22" SWORD spg_q3p2Em4_V 1 100 -10.48576 10.48544 FORMAT "%8.5" ECU_ADDRESS 0x500021B8 /end MEASUREMENT
/begin MEASUREMENT UEGO_CJ135RvsChrgS1B1_I.uUape0Z1 "class instance reverse charge function sensor 1 bank 1 / measured voltage Uape in Z1" SWORD spg_q3p2Em4_V 1 100 -10.48576 10.48544 FORMAT "%8.5" ECU_ADDRESS 0x500021BA /end MEASUREMENT
/begin MEASUREMENT UEGO_CJ135RvsChrgS1B1_I.uUape0Z2 "class instance reverse charge function sensor 1 bank 1 / measured voltage Uape in Z2" SWORD spg_q3p2Em4_V 1 100 -10.48576 10.48544 FORMAT "%8.5" ECU_ADDRESS 0x500021BC /end MEASUREMENT
/begin MEASUREMENT UEGO_CJ135RvsChrgS1B1_I.uUi2Intrpn "class instance reverse charge function sensor 1 bank 1 / Interpolation array Ui2x" SWORD spg_q3p2Em4_V 1 100 -10.48576 10.48544 FORMAT "%8.5" ARRAY_SIZE 5 ECU_ADDRESS 0x500021BE /end MEASUREMENT
/begin MEASUREMENT UEGO_CJ135RvsChrgS1B1_I.uUi2Intrpn1Pnt "class instance reverse charge function sensor 1 bank 1 / the first interpolation point: U1" SWORD spg_q3p2Em4_V 1 100 -10.48576 10.48544 FORMAT "%8.5" ECU_ADDRESS 0x500021C8 /end MEASUREMENT
/begin MEASUREMENT UEGO_CJ135RvsChrgS1B1_I.uUi2Intrpn2Pnt "class instance reverse charge function sensor 1 bank 1 / the second interpolation point: U2" SWORD spg_q3p2Em4_V 1 100 -10.48576 10.48544 FORMAT "%8.5" ECU_ADDRESS 0x500021CA /end MEASUREMENT
/begin MEASUREMENT UEGO_CJ135RvsChrgS1B1_I.uUi2IntrpnDelta "class instance reverse charge function sensor 1 bank 1 / Interpolation array delta Ui2x" SWORD spg_q3p2Em4_V 1 100 -10.48576 10.48544 FORMAT "%8.5" ARRAY_SIZE 5 ECU_ADDRESS 0x500021CC /end MEASUREMENT
/begin MEASUREMENT UEGO_CJ135RvsChrgS1B1_I.uUp0LstUpZ1RvsChrg "class instance reverse charge function sensor 1 bank 1 / electrically corrected Up0 value" SWORD spg_q3p2Em4_V 1 100 -10.48576 10.48544 FORMAT "%8.5" ECU_ADDRESS 0x500021D6 /end MEASUREMENT
/begin MEASUREMENT UEGO_CJ135RvsChrgS1B1_I.uUp0RawC5 "class instance reverse charge function sensor 1 bank 1 / Up0 raw value" SWORD spg_q3p2Em4_V 1 100 -10.48576 10.48544 FORMAT "%8.5" ECU_ADDRESS 0x500021D8 /end MEASUREMENT
/begin MEASUREMENT UEGO_CJ135RvsChrgS1B1_I.FltuUapeZ1ElecCorDL_I.memory "class instance reverse charge function sensor 1 bank 1 / DigitalLowpass FltuUapeZ1ElecCor / current lowpass value" SLONG spg_q4p883Em9_V 1 100 -10.4857600000 10.4857599951 FORMAT "%13.10" ECU_ADDRESS 0x500021DC /end MEASUREMENT
/begin MEASUREMENT UEGO_CJ135RvsChrgS1B1_I.FltuUapeZ2ElecCorDL_I.memory "class instance reverse charge function sensor 1 bank 1 / DigitalLowpass FltuUapeZ2ElecCor / current lowpass value" SLONG spg_q4p883Em9_V 1 100 -10.4857600000 10.4857599951 FORMAT "%13.10" ECU_ADDRESS 0x500021E0 /end MEASUREMENT
/begin MEASUREMENT UEGO_CJ135RvsChrgS1B1_I.FltuUgiZ1ElecCorDL_I.memory "class instance reverse charge function sensor 1 bank 1 / DigitalLowpass FltuUgiZ1ElecCor / current lowpass value" SLONG spg_q4p883Em9_V 1 100 -10.4857600000 10.4857599951 FORMAT "%13.10" ECU_ADDRESS 0x500021E4 /end MEASUREMENT
/begin MEASUREMENT UEGO_CJ135RvsChrgS1B1_I.FltuUgiZ2ElecCorDL_I.memory "class instance reverse charge function sensor 1 bank 1 / DigitalLowpass FltuUgiZ2ElecCor / current lowpass value" SLONG spg_q4p883Em9_V 1 100 -10.4857600000 10.4857599951 FORMAT "%13.10" ECU_ADDRESS 0x500021E8 /end MEASUREMENT
/begin MEASUREMENT UEGO_CJ135RvsChrgS1B1_I.UEGO_cpCapeCmesCellDL_I.memory "class instance reverse charge function sensor 1 bank 1 / Filter calculated ECU capacitor at pin APE, MES / current lowpass value" ULONG ASCET_9_RvsChrg 1 100 0.00 0.000006553599998 FORMAT "%19.17" ECU_ADDRESS 0x500021EC /end MEASUREMENT
/begin MEASUREMENT UEGO_CJ135RvsChrgS1B1_I.UEGO_cpCigCellDL_I.memory "class instance reverse charge function sensor 1 bank 1 / Filter calculated ECU capacitor at pin IPE / current lowpass value" ULONG ASCET_9_RvsChrg 1 100 0.00 0.000006553599998 FORMAT "%19.17" ECU_ADDRESS 0x500021F0 /end MEASUREMENT
/begin MEASUREMENT UEGO_CJ135RvsChrgS1B1_I.UEGO_uDeltaUi22LeanDL_I.memory "class instance reverse charge function sensor 1 bank 1 / filtered Difference measured Ui22 and Ui21 in lean learning area / current lowpass value" SLONG spg_q4p883Em9_V 1 100 -10.4857600000 10.4857599951 FORMAT "%13.10" ECU_ADDRESS 0x500021F4 /end MEASUREMENT
/begin MEASUREMENT UEGO_CJ135RvsChrgS1B1_I.UEGO_uDeltaUi22ModlnLam1DL_I.memory "class instance reverse charge function sensor 1 bank 1 / filtered Difference measured Ui22 and Ui21 in Lambda1 learning area / current lowpass value" SLONG spg_q4p883Em9_V 1 100 -10.4857600000 10.4857599951 FORMAT "%13.10" ECU_ADDRESS 0x500021F8 /end MEASUREMENT
/begin MEASUREMENT UEGO_CJ135RvsChrgS1B1_I.UEGO_uDeltaUi22RichDL_I.memory "class instance reverse charge function sensor 1 bank 1 / filtered Difference measured Ui22 and Ui21 in rich learning area / current lowpass value" SLONG spg_q4p883Em9_V 1 100 -10.4857600000 10.4857599951 FORMAT "%13.10" ECU_ADDRESS 0x500021FC /end MEASUREMENT
/begin MEASUREMENT UEGO_CJ135RvsChrgS1B1_I.UEGO_uDeltaUi22SpcDL_I.memory "class instance reverse charge function sensor 1 bank 1 / filtered Difference measured Ui22 and Ui21 in specific learning area / current lowpass value" SLONG spg_q4p883Em9_V 1 100 -10.4857600000 10.4857599951 FORMAT "%13.10" ECU_ADDRESS 0x50002200 /end MEASUREMENT
/begin MEASUREMENT UEGO_CJ135RvsChrgS1B1_I.UEGO_uDeltaUi23LeanDL_I.memory "class instance reverse charge function sensor 1 bank 1 / filtered Difference measured Ui23 and Ui21 in lean learning area / current lowpass value" SLONG spg_q4p883Em9_V 1 100 -10.4857600000 10.4857599951 FORMAT "%13.10" ECU_ADDRESS 0x50002204 /end MEASUREMENT
/begin MEASUREMENT UEGO_CJ135RvsChrgS1B1_I.UEGO_uDeltaUi23ModlnLam1DL_I.memory "class instance reverse charge function sensor 1 bank 1 / filtered Difference measured Ui23 and Ui21 in Lambda1 learning area / current lowpass value" SLONG spg_q4p883Em9_V 1 100 -10.4857600000 10.4857599951 FORMAT "%13.10" ECU_ADDRESS 0x50002208 /end MEASUREMENT
/begin MEASUREMENT UEGO_CJ135RvsChrgS1B1_I.UEGO_uDeltaUi23RichDL_I.memory "class instance reverse charge function sensor 1 bank 1 / filtered Difference measured Ui23 and Ui21 in rich learning area / current lowpass value" SLONG spg_q4p883Em9_V 1 100 -10.4857600000 10.4857599951 FORMAT "%13.10" ECU_ADDRESS 0x5000220C /end MEASUREMENT
/begin MEASUREMENT UEGO_CJ135RvsChrgS1B1_I.UEGO_uDeltaUi23SpcDL_I.memory "class instance reverse charge function sensor 1 bank 1 / filtered Difference measured Ui23 and Ui21 in specific learning area / current lowpass value" SLONG spg_q4p883Em9_V 1 100 -10.4857600000 10.4857599951 FORMAT "%13.10" ECU_ADDRESS 0x50002210 /end MEASUREMENT
/begin MEASUREMENT UEGO_CJ135RvsChrgS1B1_I.UEGO_uDeltaUi24LeanDL_I.memory "class instance reverse charge function sensor 1 bank 1 / filtered Difference measured Ui24 and Ui21 in lean learning area / current lowpass value" SLONG spg_q4p883Em9_V 1 100 -10.4857600000 10.4857599951 FORMAT "%13.10" ECU_ADDRESS 0x50002214 /end MEASUREMENT
/begin MEASUREMENT UEGO_CJ135RvsChrgS1B1_I.UEGO_uDeltaUi24ModlnLam1DL_I.memory "class instance reverse charge function sensor 1 bank 1 / filtered Difference measured Ui24 and Ui21 in Lambda1 learning area / current lowpass value" SLONG spg_q4p883Em9_V 1 100 -10.4857600000 10.4857599951 FORMAT "%13.10" ECU_ADDRESS 0x50002218 /end MEASUREMENT
/begin MEASUREMENT UEGO_CJ135RvsChrgS1B1_I.UEGO_uDeltaUi24RichDL_I.memory "class instance reverse charge function sensor 1 bank 1 / filtered Difference measured Ui24 and Ui21 in rich learning area / current lowpass value" SLONG spg_q4p883Em9_V 1 100 -10.4857600000 10.4857599951 FORMAT "%13.10" ECU_ADDRESS 0x5000221C /end MEASUREMENT
/begin MEASUREMENT UEGO_CJ135RvsChrgS1B1_I.UEGO_uDeltaUi24SpcDL_I.memory "class instance reverse charge function sensor 1 bank 1 / filtered Difference measured Ui24 and Ui21 in specific learning area / current lowpass value" SLONG spg_q4p883Em9_V 1 100 -10.4857600000 10.4857599951 FORMAT "%13.10" ECU_ADDRESS 0x50002220 /end MEASUREMENT
/begin MEASUREMENT UEGO_CJ135RvsChrgS1B1_I.flgCpCalcdTONV_I.outbit "class instance reverse charge function sensor 1 bank 1 / Turn On Delay Variable of flgCpCalcd / return value" UBYTE B_TRUE 1 100 0.00 1.00000000000 BIT_MASK 0x1 FORMAT "%13.11" ECU_ADDRESS 0x50002224 /end MEASUREMENT
/begin MEASUREMENT UEGO_CJ135RvsChrgS1B1_I.flgCpCalcdTONV_I.time "class instance reverse charge function sensor 1 bank 1 / Turn On Delay Variable of flgCpCalcd / expired delay time" UWORD t_q0p005 1 100 0.00 327.6750 FORMAT "%8.4" ECU_ADDRESS 0x50002226 /end MEASUREMENT
/begin MEASUREMENT UEGO_CJ135RvsChrgS1B1_I.flgRegRdyCpCalcTOFFV_I.outbit "class instance reverse charge function sensor 1 bank 1 / Turn Off Delay Variable flgRegRdyCpCalc / Output Bit" UBYTE B_TRUE 1 100 0.00 1.00000000000 BIT_MASK 0x1 FORMAT "%13.11" ECU_ADDRESS 0x50002228 /end MEASUREMENT
/begin MEASUREMENT UEGO_CJ135RvsChrgS1B1_I.flgRegRdyCpCalcTOFFV_I.time "class instance reverse charge function sensor 1 bank 1 / Turn Off Delay Variable flgRegRdyCpCalc / Occured Time" UWORD t_q0p005 1 100 0.00 327.6750 FORMAT "%8.4" ECU_ADDRESS 0x5000222A /end MEASUREMENT
/begin MEASUREMENT UEGO_CJ135RvsChrgS1B1_I.flgRegRdyDeltaUiAllTOFFV_I.outbit "class instance reverse charge function sensor 1 bank 1 / Turn Off Delay Variable flgRegRdyDeltaUiAll / Output Bit" UBYTE B_TRUE 1 100 0.00 1.00000000000 BIT_MASK 0x1 FORMAT "%13.11" ECU_ADDRESS 0x5000222C /end MEASUREMENT
/begin MEASUREMENT UEGO_CJ135RvsChrgS1B1_I.flgRegRdyDeltaUiAllTOFFV_I.time "class instance reverse charge function sensor 1 bank 1 / Turn Off Delay Variable flgRegRdyDeltaUiAll / Occured Time" UWORD t_q0p005 1 100 0.00 327.6750 FORMAT "%8.4" ECU_ADDRESS 0x5000222E /end MEASUREMENT
/begin MEASUREMENT UEGO_CJ135RvsChrgS1B1_I.flgUiAllMeasLam1TOFFV_I.outbit "class instance reverse charge function sensor 1 bank 1 / Turn Off Delay Variable flgUiAllMeasLam1 / Output Bit" UBYTE B_TRUE 1 100 0.00 1.00000000000 BIT_MASK 0x1 FORMAT "%13.11" ECU_ADDRESS 0x50002230 /end MEASUREMENT
/begin MEASUREMENT UEGO_CJ135RvsChrgS1B1_I.flgUiAllMeasLam1TOFFV_I.time "class instance reverse charge function sensor 1 bank 1 / Turn Off Delay Variable flgUiAllMeasLam1 / Occured Time" UWORD t_q0p005 1 100 0.00 327.6750 FORMAT "%8.4" ECU_ADDRESS 0x50002232 /end MEASUREMENT
/begin MEASUREMENT UEGO_CJ135RvsChrgS1B1_I.flgUiAllMeasLam1_TONV_I.outbit "class instance reverse charge function sensor 1 bank 1 / TurnOnDelayVariable flgUiAllMeasLam1 / return value" UBYTE B_TRUE 1 100 0.00 1.00000000000 BIT_MASK 0x1 FORMAT "%13.11" ECU_ADDRESS 0x50002234 /end MEASUREMENT
/begin MEASUREMENT UEGO_CJ135RvsChrgS1B1_I.flgUiAllMeasLam1_TONV_I.time "class instance reverse charge function sensor 1 bank 1 / TurnOnDelayVariable flgUiAllMeasLam1 / expired delay time" UWORD t_q0p005 1 100 0.00 327.6750 FORMAT "%8.4" ECU_ADDRESS 0x50002236 /end MEASUREMENT
/begin MEASUREMENT UEGO_CJ135RvsChrgS1B1_I.flgUiAllMeasLeanTOFFV_I.outbit "class instance reverse charge function sensor 1 bank 1 / TurnOffDelayVariable flgUiAllMeasLean / Output Bit" UBYTE B_TRUE 1 100 0.00 1.00000000000 BIT_MASK 0x1 FORMAT "%13.11" ECU_ADDRESS 0x50002238 /end MEASUREMENT
/begin MEASUREMENT UEGO_CJ135RvsChrgS1B1_I.flgUiAllMeasLeanTOFFV_I.time "class instance reverse charge function sensor 1 bank 1 / TurnOffDelayVariable flgUiAllMeasLean / Occured Time" UWORD t_q0p005 1 100 0.00 327.6750 FORMAT "%8.4" ECU_ADDRESS 0x5000223A /end MEASUREMENT
/begin MEASUREMENT UEGO_CJ135RvsChrgS1B1_I.flgUiAllMeasLeanTONV_I.outbit "class instance reverse charge function sensor 1 bank 1 / TurnOnDelayVariable flgUiAllMeasLean / return value" UBYTE B_TRUE 1 100 0.00 1.00000000000 BIT_MASK 0x1 FORMAT "%13.11" ECU_ADDRESS 0x5000223C /end MEASUREMENT
/begin MEASUREMENT UEGO_CJ135RvsChrgS1B1_I.flgUiAllMeasLeanTONV_I.time "class instance reverse charge function sensor 1 bank 1 / TurnOnDelayVariable flgUiAllMeasLean / expired delay time" UWORD t_q0p005 1 100 0.00 327.6750 FORMAT "%8.4" ECU_ADDRESS 0x5000223E /end MEASUREMENT
/begin MEASUREMENT UEGO_CJ135RvsChrgS1B1_I.flgUiAllMeasRichTOFFV_I.outbit "class instance reverse charge function sensor 1 bank 1 / TurnOffDelayVariable flgUiAllMeasRich / Output Bit" UBYTE B_TRUE 1 100 0.00 1.00000000000 BIT_MASK 0x1 FORMAT "%13.11" ECU_ADDRESS 0x50002240 /end MEASUREMENT
/begin MEASUREMENT UEGO_CJ135RvsChrgS1B1_I.flgUiAllMeasRichTOFFV_I.time "class instance reverse charge function sensor 1 bank 1 / TurnOffDelayVariable flgUiAllMeasRich / Occured Time" UWORD t_q0p005 1 100 0.00 327.6750 FORMAT "%8.4" ECU_ADDRESS 0x50002242 /end MEASUREMENT
/begin MEASUREMENT UEGO_CJ135RvsChrgS1B1_I.flgUiAllMeasRich_TONV_I.outbit "class instance reverse charge function sensor 1 bank 1 / TurnOnDelayVariable flgUiAllMeasRich / return value" UBYTE B_TRUE 1 100 0.00 1.00000000000 BIT_MASK 0x1 FORMAT "%13.11" ECU_ADDRESS 0x50002244 /end MEASUREMENT
/begin MEASUREMENT UEGO_CJ135RvsChrgS1B1_I.flgUiAllMeasRich_TONV_I.time "class instance reverse charge function sensor 1 bank 1 / TurnOnDelayVariable flgUiAllMeasRich / expired delay time" UWORD t_q0p005 1 100 0.00 327.6750 FORMAT "%8.4" ECU_ADDRESS 0x50002246 /end MEASUREMENT
/begin MEASUREMENT UEGO_CJ135RvsChrgS1B1_I.flgUiAllMeasSpcTOFFV_I.outbit "class instance reverse charge function sensor 1 bank 1 / TurnOffDelayVariable flgUiAllMeasSpc / Output Bit" UBYTE B_TRUE 1 100 0.00 1.00000000000 BIT_MASK 0x1 FORMAT "%13.11" ECU_ADDRESS 0x50002248 /end MEASUREMENT
/begin MEASUREMENT UEGO_CJ135RvsChrgS1B1_I.flgUiAllMeasSpcTOFFV_I.time "class instance reverse charge function sensor 1 bank 1 / TurnOffDelayVariable flgUiAllMeasSpc / Occured Time" UWORD t_q0p005 1 100 0.00 327.6750 FORMAT "%8.4" ECU_ADDRESS 0x5000224A /end MEASUREMENT
/begin MEASUREMENT UEGO_CJ135RvsChrgS1B1_I.flgUiAllMeasSpc_TONV_I.outbit "class instance reverse charge function sensor 1 bank 1 / TurnOnDelayVariable flgUiAllMeasSpc / return value" UBYTE B_TRUE 1 100 0.00 1.00000000000 BIT_MASK 0x1 FORMAT "%13.11" ECU_ADDRESS 0x5000224C /end MEASUREMENT
/begin MEASUREMENT UEGO_CJ135RvsChrgS1B1_I.flgUiAllMeasSpc_TONV_I.time "class instance reverse charge function sensor 1 bank 1 / TurnOnDelayVariable flgUiAllMeasSpc / expired delay time" UWORD t_q0p005 1 100 0.00 327.6750 FORMAT "%8.4" ECU_ADDRESS 0x5000224E /end MEASUREMENT
/begin MEASUREMENT UEGO_CJ135RvsChrgS1B1_I.flgUiAllMeasTOFFV_I.outbit "class instance reverse charge function sensor 1 bank 1 / TurnOffDelayVariable flgUiAllMeas / Output Bit" UBYTE B_TRUE 1 100 0.00 1.00000000000 BIT_MASK 0x1 FORMAT "%13.11" ECU_ADDRESS 0x50002250 /end MEASUREMENT
/begin MEASUREMENT UEGO_CJ135RvsChrgS1B1_I.flgUiAllMeasTOFFV_I.time "class instance reverse charge function sensor 1 bank 1 / TurnOffDelayVariable flgUiAllMeas / Occured Time" UWORD t_q0p005 1 100 0.00 327.6750 FORMAT "%8.4" ECU_ADDRESS 0x50002252 /end MEASUREMENT
/begin MEASUREMENT UEGO_CJ135RvsChrgS1B1_I.flgUiAllMeasTONV_I.outbit "class instance reverse charge function sensor 1 bank 1 / TurnOnDelayVariable flgUiAllMeas / return value" UBYTE B_TRUE 1 100 0.00 1.00000000000 BIT_MASK 0x1 FORMAT "%13.11" ECU_ADDRESS 0x50002254 /end MEASUREMENT
/begin MEASUREMENT UEGO_CJ135RvsChrgS1B1_I.flgUiAllMeasTONV_I.time "class instance reverse charge function sensor 1 bank 1 / TurnOnDelayVariable flgUiAllMeas / expired delay time" UWORD t_q0p005 1 100 0.00 327.6750 FORMAT "%8.4" ECU_ADDRESS 0x50002256 /end MEASUREMENT
/begin MEASUREMENT UEGO_CJ135RvsChrgS1B1_I.iIPmpRawDL_I.memory "class instance reverse charge function sensor 1 bank 1 / DigitalLowpass iIPmpRaw / current lowpass value" SLONG i_q1p01725Em11_A 1 100 -0.0218453333333 0.0218453333232 FORMAT "%15.13" ECU_ADDRESS 0x50002258 /end MEASUREMENT
/begin MEASUREMENT UEGO_CJ135RvsChrgS1B1_I.uUp0Z0FltDL_I.memory "class instance reverse charge function sensor 1 bank 1 / DigitalLowpass uUp0Z0Flt / current lowpass value" SLONG spg_q4p883Em9_V 1 100 -10.4857600000 10.4857599951 FORMAT "%13.10" ECU_ADDRESS 0x5000225C /end MEASUREMENT
/begin MEASUREMENT UEGO_CJ135RvsChrgS1B1_I.uUp0Z1FltDL_I.memory "class instance reverse charge function sensor 1 bank 1 / DigitalLowpass uUp0Z1Flt / current lowpass value" SLONG spg_q4p883Em9_V 1 100 -10.4857600000 10.4857599951 FORMAT "%13.10" ECU_ADDRESS 0x50002260 /end MEASUREMENT
/begin MEASUREMENT UEGO_CJ135RvsChrgS1B1_I.uUp0Z2FltDL_I.memory "class instance reverse charge function sensor 1 bank 1 / DigitalLowpass uUp0Z2Flt / current lowpass value" SLONG spg_q4p883Em9_V 1 100 -10.4857600000 10.4857599951 FORMAT "%13.10" ECU_ADDRESS 0x50002264 /end MEASUREMENT
/begin MEASUREMENT UEGO_CJ135WireEvlnClassS1B1_I.numRamFailPosn "Class instance of the functional class of FC UEGO_CJ135WireEvln for Sensor 1 Bank 1 / RAM position at which the ASIC has shut off in error case" UBYTE dez 1 100 0.00 255.0 FORMAT "%5.1" ECU_ADDRESS 0x500055A0 /end MEASUREMENT
/begin MEASUREMENT UEGO_CJ135WireEvlnClassS1B1_I.numRamSts2 "Class instance of the functional class of FC UEGO_CJ135WireEvln for Sensor 1 Bank 1 / Value of the STATUS-Word II" UWORD dez 1 100 0.00 65535.00 FORMAT "%8.2" ECU_ADDRESS 0x500055A2 /end MEASUREMENT
/begin MEASUREMENT UEGO_CJ135WireEvlnClassS1B1_I.numRamSts3 "Class instance of the functional class of FC UEGO_CJ135WireEvln for Sensor 1 Bank 1 / Value of the STATUS-Word III" UWORD dez 1 100 0.00 65535.00 FORMAT "%8.2" ECU_ADDRESS 0x500055A4 /end MEASUREMENT
/begin MEASUREMENT UEGO_CJ135WireEvlnClassS1B1_I.uDeltaUg0a "Class instance of the functional class of FC UEGO_CJ135WireEvln for Sensor 1 Bank 1 / Voltage Ug0a with reference to Ug0" SWORD spg_q3p2Em4_V 1 100 -10.48576 10.48544 FORMAT "%8.5" ECU_ADDRESS 0x500055A6 /end MEASUREMENT
/begin MEASUREMENT UEGO_CJ135WireEvlnClassS1B1_I.uDeltaUg0e "Class instance of the functional class of FC UEGO_CJ135WireEvln for Sensor 1 Bank 1 / Voltage Ug0e with reference to Ug0" SWORD spg_q3p2Em4_V 1 100 -10.48576 10.48544 FORMAT "%8.5" ECU_ADDRESS 0x500055A8 /end MEASUREMENT
/begin MEASUREMENT UEGO_CJ135WireEvlnClassS1B1_I.uDeltaUg0i "Class instance of the functional class of FC UEGO_CJ135WireEvln for Sensor 1 Bank 1 / Voltage Ug0i with reference to Ug0" SWORD spg_q3p2Em4_V 1 100 -10.48576 10.48544 FORMAT "%8.5" ECU_ADDRESS 0x500055AA /end MEASUREMENT
/begin MEASUREMENT UEGO_CJ135WireEvlnClassS1B1_I.uDeltaUg0iai "Class instance of the functional class of FC UEGO_CJ135WireEvln for Sensor 1 Bank 1 / Voltage Ug0iai with reference to Ug0" SWORD spg_q3p2Em4_V 1 100 -10.48576 10.48544 FORMAT "%8.5" ECU_ADDRESS 0x500055AC /end MEASUREMENT
/begin MEASUREMENT UEGO_CJ135WireEvlnClassS1B1_I.uDeltaUg0iei "Class instance of the functional class of FC UEGO_CJ135WireEvln for Sensor 1 Bank 1 / Voltage Ug0iei with reference to Ug0" SWORD spg_q3p2Em4_V 1 100 -10.48576 10.48544 FORMAT "%8.5" ECU_ADDRESS 0x500055AE /end MEASUREMENT
/begin MEASUREMENT UEGO_CJ135WireEvlnClassS1B1_I.uDeltaUga "Class instance of the functional class of FC UEGO_CJ135WireEvln for Sensor 1 Bank 1 / Voltage Uga with reference to Ug0" SWORD spg_q3p2Em4_V 1 100 -10.48576 10.48544 FORMAT "%8.5" ECU_ADDRESS 0x500055B0 /end MEASUREMENT
/begin MEASUREMENT UEGO_CJ135WireEvlnClassS1B1_I.uDeltaUgi "Class instance of the functional class of FC UEGO_CJ135WireEvln for Sensor 1 Bank 1 / Voltage Ugi with reference to Ug0" SWORD spg_q3p2Em4_V 1 100 -10.48576 10.48544 FORMAT "%8.5" ECU_ADDRESS 0x500055B2 /end MEASUREMENT
/begin MEASUREMENT UEGO_CJ135WireEvlnClassS1B1_I.Ug0aPeakFil_I.flgFilStrtd "Class instance of the functional class of FC UEGO_CJ135WireEvln for Sensor 1 Bank 1 / Filter for DeltaUg0a / Filter started" UBYTE B_TRUE 1 100 0.00 1.00000000000 BIT_MASK 0x1 FORMAT "%13.11" ECU_ADDRESS 0x500055B4 /end MEASUREMENT
/begin MEASUREMENT UEGO_CJ135WireEvlnClassS1B1_I.Ug0aPeakFil_I.uDeltaInOutpMax "Class instance of the functional class of FC UEGO_CJ135WireEvln for Sensor 1 Bank 1 / Filter for DeltaUg0a / Extremal value of the occurred difference between input and output values" SWORD spg_q3p2Em4_V 1 100 -10.48576 10.48544 FORMAT "%8.5" ECU_ADDRESS 0x500055B6 /end MEASUREMENT
/begin MEASUREMENT UEGO_CJ135WireEvlnClassS1B1_I.Ug0ePeakFil_I.flgFilStrtd "Class instance of the functional class of FC UEGO_CJ135WireEvln for Sensor 1 Bank 1 / Filter for DeltaUg0e / Filter started" UBYTE B_TRUE 1 100 0.00 1.00000000000 BIT_MASK 0x1 FORMAT "%13.11" ECU_ADDRESS 0x500055B8 /end MEASUREMENT
/begin MEASUREMENT UEGO_CJ135WireEvlnClassS1B1_I.Ug0ePeakFil_I.uDeltaInOutpMax "Class instance of the functional class of FC UEGO_CJ135WireEvln for Sensor 1 Bank 1 / Filter for DeltaUg0e / Extremal value of the occurred difference between input and output values" SWORD spg_q3p2Em4_V 1 100 -10.48576 10.48544 FORMAT "%8.5" ECU_ADDRESS 0x500055BA /end MEASUREMENT
/begin MEASUREMENT UEGO_CJ135WireEvlnClassS1B1_I.Ug0iPeakFil_I.flgFilStrtd "Class instance of the functional class of FC UEGO_CJ135WireEvln for Sensor 1 Bank 1 / Filter for DeltaUg0i / Filter started" UBYTE B_TRUE 1 100 0.00 1.00000000000 BIT_MASK 0x1 FORMAT "%13.11" ECU_ADDRESS 0x500055BC /end MEASUREMENT
/begin MEASUREMENT UEGO_CJ135WireEvlnClassS1B1_I.Ug0iPeakFil_I.uDeltaInOutpMax "Class instance of the functional class of FC UEGO_CJ135WireEvln for Sensor 1 Bank 1 / Filter for DeltaUg0i / Extremal value of the occurred difference between input and output values" SWORD spg_q3p2Em4_V 1 100 -10.48576 10.48544 FORMAT "%8.5" ECU_ADDRESS 0x500055BE /end MEASUREMENT
/begin MEASUREMENT UEGO_CJ135WireEvlnClassS1B1_I.Ug0iaiPeakFil_I.flgFilStrtd "Class instance of the functional class of FC UEGO_CJ135WireEvln for Sensor 1 Bank 1 / Filter for DeltaUg0iai / Filter started" UBYTE B_TRUE 1 100 0.00 1.00000000000 BIT_MASK 0x1 FORMAT "%13.11" ECU_ADDRESS 0x500055C0 /end MEASUREMENT
/begin MEASUREMENT UEGO_CJ135WireEvlnClassS1B1_I.Ug0iaiPeakFil_I.uDeltaInOutpMax "Class instance of the functional class of FC UEGO_CJ135WireEvln for Sensor 1 Bank 1 / Filter for DeltaUg0iai / Extremal value of the occurred difference between input and output values" SWORD spg_q3p2Em4_V 1 100 -10.48576 10.48544 FORMAT "%8.5" ECU_ADDRESS 0x500055C2 /end MEASUREMENT
/begin MEASUREMENT UEGO_CJ135WireEvlnClassS1B1_I.Ug0ieiPeakFil_I.flgFilStrtd "Class instance of the functional class of FC UEGO_CJ135WireEvln for Sensor 1 Bank 1 / Filter for DeltaUg0iei / Filter started" UBYTE B_TRUE 1 100 0.00 1.00000000000 BIT_MASK 0x1 FORMAT "%13.11" ECU_ADDRESS 0x500055C4 /end MEASUREMENT
/begin MEASUREMENT UEGO_CJ135WireEvlnClassS1B1_I.Ug0ieiPeakFil_I.uDeltaInOutpMax "Class instance of the functional class of FC UEGO_CJ135WireEvln for Sensor 1 Bank 1 / Filter for DeltaUg0iei / Extremal value of the occurred difference between input and output values" SWORD spg_q3p2Em4_V 1 100 -10.48576 10.48544 FORMAT "%8.5" ECU_ADDRESS 0x500055C6 /end MEASUREMENT
/begin MEASUREMENT UEGO_CJ135WireEvlnClassS1B1_I.UgaPeakFil_I.flgFilStrtd "Class instance of the functional class of FC UEGO_CJ135WireEvln for Sensor 1 Bank 1 / Filter for DeltaUga / Filter started" UBYTE B_TRUE 1 100 0.00 1.00000000000 BIT_MASK 0x1 FORMAT "%13.11" ECU_ADDRESS 0x500055C8 /end MEASUREMENT
/begin MEASUREMENT UEGO_CJ135WireEvlnClassS1B1_I.UgaPeakFil_I.uDeltaInOutpMax "Class instance of the functional class of FC UEGO_CJ135WireEvln for Sensor 1 Bank 1 / Filter for DeltaUga / Extremal value of the occurred difference between input and output values" SWORD spg_q3p2Em4_V 1 100 -10.48576 10.48544 FORMAT "%8.5" ECU_ADDRESS 0x500055CA /end MEASUREMENT
/begin MEASUREMENT UEGO_CJ135WireEvlnClassS1B1_I.UgiPeakFil_I.flgFilStrtd "Class instance of the functional class of FC UEGO_CJ135WireEvln for Sensor 1 Bank 1 / Filter for DeltaUgi / Filter started" UBYTE B_TRUE 1 100 0.00 1.00000000000 BIT_MASK 0x1 FORMAT "%13.11" ECU_ADDRESS 0x500055CC /end MEASUREMENT
/begin MEASUREMENT UEGO_CJ135WireEvlnClassS1B1_I.UgiPeakFil_I.uDeltaInOutpMax "Class instance of the functional class of FC UEGO_CJ135WireEvln for Sensor 1 Bank 1 / Filter for DeltaUgi / Extremal value of the occurred difference between input and output values" SWORD spg_q3p2Em4_V 1 100 -10.48576 10.48544 FORMAT "%8.5" ECU_ADDRESS 0x500055CE /end MEASUREMENT
/begin MEASUREMENT UEGO_cpCapeCmesCellS1B1 "calculated ECU capacitor at pin APE, MES Sensor 1 Bank 1" UWORD q1Em10_F 1 100 0.00 0.000006553500 FORMAT "%14.12" ECU_ADDRESS 0x70002C9A /end MEASUREMENT
/begin MEASUREMENT UEGO_cpCigCellS1B1 "calculated ECU capacitor at pin IPE Sensor 1 Bank 1" UWORD q1Em10_F 1 100 0.00 0.000006553500 FORMAT "%14.12" ECU_ADDRESS 0x70002C9C /end MEASUREMENT
/begin MEASUREMENT UEGO_DiagRelsClsS1B1_I.cntrReiniProc10msec "Class instance of the functional class of FC UEGO_DiagRels for Sensor 1 Bank 1 / Drive cycle counter that increments when system state exits Post-drive in 10ms proc" UBYTE OneToOne 1 100 0.00 255.0 FORMAT "%5.1" ECU_ADDRESS 0x6000D98C /end MEASUREMENT
/begin MEASUREMENT UEGO_DiagRelsClsS1B1_I.flgUBattMinTurnOffDly "Class instance of the functional class of FC UEGO_DiagRels for Sensor 1 Bank 1 / Delayed status of UEGO_flgUBattMin ." UBYTE B_TRUE 1 100 0.00 1.00000000000 BIT_MASK 0x1 FORMAT "%13.11" ECU_ADDRESS 0x6000D98D /end MEASUREMENT
/begin MEASUREMENT UEGO_DiagRelsClsS1B1_I.flgUBattMinTOFFVNM_I.time "Class instance of the functional class of FC UEGO_DiagRels for Sensor 1 Bank 1 / Turn-off delay for minimum battery voltage / delay time" UWORD t_q0p01 1 100 0.00 655.3500 FORMAT "%8.4" ECU_ADDRESS 0x6000D98E /end MEASUREMENT
/begin MEASUREMENT UEGO_DiagRelsClsS1B1_I.flgUBattNormTOFFVNM_I.time "Class instance of the functional class of FC UEGO_DiagRels for Sensor 1 Bank 1 / Turn-off delay for normal battery voltage / delay time" UWORD t_q0p01 1 100 0.00 655.3500 FORMAT "%8.4" ECU_ADDRESS 0x6000D990 /end MEASUREMENT
/begin MEASUREMENT UEGO_DiagRels_cntrReiniProc10msec "Drive cycle counter that increments when system state exits Post-drive in 10ms proc" UBYTE OneToOne 1 100 0.00 255.0 FORMAT "%5.1" ECU_ADDRESS 0x60006224 /end MEASUREMENT
/begin MEASUREMENT UEGO_EngClassS1B1_I.flgEngActv "Class Engine Operation Modes for lambda sensor 1 bank 1 / Engine active" UBYTE B_TRUE 1 100 0.00 1.00000000000 BIT_MASK 0x1 FORMAT "%13.11" ECU_ADDRESS 0x6000346C /end MEASUREMENT
/begin MEASUREMENT UEGO_EngClassS1B1_I.flgEngActvSts "Class Engine Operation Modes for lambda sensor 1 bank 1 / Engine active status" UBYTE B_TRUE 1 100 0.00 1.00000000000 BIT_MASK 0x1 FORMAT "%13.11" ECU_ADDRESS 0x6000346D /end MEASUREMENT
/begin MEASUREMENT UEGO_Eng_cntrReiniProc10msec "Drive cycle counter that increments when system state exits Post-drive in 10ms proc" UBYTE OneToOne 1 100 0.00 255.0 FORMAT "%5.1" ECU_ADDRESS 0x60006223 /end MEASUREMENT
/begin MEASUREMENT UEGO_ExhS1B1_I.mEgFlow "Exhaust gas properties for Sensor 1 Bank 1 / exhaust mass flow" UWORD m_uw_b6553p5 1 100 0.00 6553.500 FORMAT "%8.3" ECU_ADDRESS 0x500055D0 /end MEASUREMENT
/begin MEASUREMENT UEGO_ExhS1B1_I.tEgFld "Exhaust gas properties for Sensor 1 Bank 1 / Actual temperature from temperature sensor" SWORD Temp_Cels 1 100 -3549.940 3003.560 FORMAT "%8.3" ECU_ADDRESS 0x500055D2 /end MEASUREMENT
/begin MEASUREMENT UEGO_ExhS1B1_I.tEgMdl "Exhaust gas properties for Sensor 1 Bank 1 / Temperature exhaust gas modelled" SWORD Temp_Cels 1 100 -3549.940 3003.560 FORMAT "%8.3" ECU_ADDRESS 0x500055D4 /end MEASUREMENT
/begin MEASUREMENT UEGO_ExhS1B1_I.tWallMdl "Exhaust gas properties for Sensor 1 Bank 1 / Temperature wall modelled" SWORD Temp_Cels 1 100 -3549.940 3003.560 FORMAT "%8.3" ECU_ADDRESS 0x500055D6 /end MEASUREMENT
/begin MEASUREMENT UEGO_facRieRiaS1B1 "ratio of resistance nernst cell to pumping cell sensor 1 bank 1" UWORD fak_q0p000244 1 100 0.00 15.99976 FORMAT "%8.5" ECU_ADDRESS 0x70002C9E /end MEASUREMENT
/begin MEASUREMENT UEGO_facRieRipS1B1 "ratio of resistance nernst cell to pumping cell sensor 1 bank 1" UWORD fak_q0p000244 1 100 0.00 15.99976 FORMAT "%8.5" ECU_ADDRESS 0x70002CA0 /end MEASUREMENT
/begin MEASUREMENT UEGO_flgAirScav "condition to indicate scavenging is active" UBYTE B_TRUE 1 100 0.00 1.00000000000 BIT_MASK 0x1 FORMAT "%13.11" ECU_ADDRESS 0x70000634 /end MEASUREMENT
/begin MEASUREMENT UEGO_flgAllVlvActv "all injection valve active in operation" UBYTE B_TRUE 1 100 0.00 1.00000000000 BIT_MASK 0x1 FORMAT "%13.11" ECU_ADDRESS 0x70000633 /end MEASUREMENT
/begin MEASUREMENT UEGO_flgClmpdNS1B1 "Clamping structure of the nerst cell active for sensor 1 bank 1" UBYTE B_TRUE 1 100 0.00 1.00000000000 BIT_MASK 0x1 FORMAT "%13.11" ECU_ADDRESS 0x7000062F /end MEASUREMENT
/begin MEASUREMENT UEGO_flgClmpdPS1B1 "Clamping structure of the pump cell active for sensor 1 bank 1" UBYTE B_TRUE 1 100 0.00 1.00000000000 BIT_MASK 0x1 FORMAT "%13.11" ECU_ADDRESS 0x7000062E /end MEASUREMENT
/begin MEASUREMENT UEGO_flgCmbEngTmpStop "Combustion engine temporarliy stopped" UBYTE B_TRUE 1 100 0.00 1.00000000000 BIT_MASK 0x1 FORMAT "%13.11" ECU_ADDRESS 0x7000062D /end MEASUREMENT
/begin MEASUREMENT UEGO_flgCMeasS1B1 "condition C measurement sensor 1 bank 1" UBYTE B_TRUE 1 100 0.00 1.00000000000 BIT_MASK 0x1 FORMAT "%13.11" ECU_ADDRESS 0x70000631 /end MEASUREMENT
/begin MEASUREMENT UEGO_flgCpCalcdS1B1 "condition C measurement finished Sensor 1 Bank 1" UBYTE B_TRUE 1 100 0.00 1.00000000000 BIT_MASK 0x1 FORMAT "%13.11" ECU_ADDRESS 0x700000D1 /end MEASUREMENT
/begin MEASUREMENT UEGO_flgDeltaUiAllMeasdS1B1 "condition ui measurement finished Sensor 1 Bank 1" UBYTE B_TRUE 1 100 0.00 1.00000000000 BIT_MASK 0x1 FORMAT "%13.11" ECU_ADDRESS 0x700000D0 /end MEASUREMENT
/begin MEASUREMENT UEGO_flgDiagRprtRelsS1B1 "Release of diagnosis report sensor 1 bank 1" UBYTE B_TRUE 1 100 0.00 1.00000000000 BIT_MASK 0x1 FORMAT "%13.11" ECU_ADDRESS 0x70000629 /end MEASUREMENT
/begin MEASUREMENT UEGO_flgDsmTripChgFinshd "trip change of DSM finished flag for UEGO FCs" UBYTE B_TRUE 1 100 0.00 1.00000000000 BIT_MASK 0x1 FORMAT "%13.11" ECU_ADDRESS 0x70000628 /end MEASUREMENT
/begin MEASUREMENT UEGO_flgEngActvStsS1B1 "Engine active status, Sensor 1 Bank 1" UBYTE B_TRUE 1 100 0.00 1.00000000000 BIT_MASK 0x1 FORMAT "%13.11" ECU_ADDRESS 0x70000625 /end MEASUREMENT
/begin MEASUREMENT UEGO_flgEngAndEcuSt "Release condition for engine and ecu state" UBYTE B_TRUE 1 100 0.00 1.00000000000 BIT_MASK 0x1 FORMAT "%13.11" ECU_ADDRESS 0x70000624 /end MEASUREMENT
/begin MEASUREMENT UEGO_flgEngCrk "Status engine is cranking" UBYTE B_TRUE 1 100 0.00 1.00000000000 BIT_MASK 0x1 FORMAT "%13.11" ECU_ADDRESS 0x70000623 /end MEASUREMENT
/begin MEASUREMENT UEGO_flgEngRunng "engine running" UBYTE B_TRUE 1 100 0.00 1.00000000000 BIT_MASK 0x1 FORMAT "%13.11" ECU_ADDRESS 0x70000622 /end MEASUREMENT
/begin MEASUREMENT UEGO_flgEngStopPha "engine stop phase" UBYTE B_TRUE 1 100 0.00 1.00000000000 BIT_MASK 0x1 FORMAT "%13.11" ECU_ADDRESS 0x70000621 /end MEASUREMENT
/begin MEASUREMENT UEGO_flgEngStopPhaRaw "Non debounced engine stop phase status" UBYTE B_TRUE 1 100 0.00 1.00000000000 BIT_MASK 0x1 FORMAT "%13.11" ECU_ADDRESS 0x70000620 /end MEASUREMENT
/begin MEASUREMENT UEGO_flgEngStopTOFFVNM_I.time "Turn-off delay to extend the engine stop-phase. / delay time" UWORD t_q0p01 1 100 0.00 655.3500 FORMAT "%8.4" ECU_ADDRESS 0x6000346A /end MEASUREMENT
/begin MEASUREMENT UEGO_flgEomAftRun "engine after run phase" UBYTE B_TRUE 1 100 0.00 1.00000000000 BIT_MASK 0x1 FORMAT "%13.11" ECU_ADDRESS 0x7000061F /end MEASUREMENT
/begin MEASUREMENT UEGO_flgErrSpiRamBnkS1B1 "SPI error of the RAM bank of sensor 1 bank 1" UBYTE B_TRUE 1 100 0.00 1.00000000000 BIT_MASK 0x1 FORMAT "%13.11" ECU_ADDRESS 0x7000061A /end MEASUREMENT
/begin MEASUREMENT UEGO_flgFacRieRiaCalcdS1B1 "condition calculation of ratio resistance sensor 1 bank 1" UBYTE B_TRUE 1 100 0.00 1.00000000000 BIT_MASK 0x1 FORMAT "%13.11" ECU_ADDRESS 0x70000616 /end MEASUREMENT
/begin MEASUREMENT UEGO_flgFacRieRipCalcdS1B1 "condition calculation of ratio resistance sensor 1 bank 1" UBYTE B_TRUE 1 100 0.00 1.00000000000 BIT_MASK 0x1 FORMAT "%13.11" ECU_ADDRESS 0x70000615 /end MEASUREMENT
/begin MEASUREMENT UEGO_flgFIdCJ135RvsChrgMeasRdyS1B1 "condition Readiness FId_CJ135RvsChrgMeas Sensor 1 Bank 1" UBYTE B_TRUE 1 100 0.00 1.00000000000 BIT_MASK 0x1 FORMAT "%13.11" ECU_ADDRESS 0x70000618 /end MEASUREMENT
/begin MEASUREMENT UEGO_flgFIdCJ135RvsChrgReldS1B1 "condition FId_CJ135RvsChrgMeas released Sensor 1 Bank 1" UBYTE B_TRUE 1 100 0.00 1.00000000000 BIT_MASK 0x1 FORMAT "%13.11" ECU_ADDRESS 0x70000617 /end MEASUREMENT
/begin MEASUREMENT UEGO_flgFIdCJ135RvsChrgReldS1B1TONV_I.outbit "TurnOnDelayVariable UEGO_flgFIdCJ135RvsChrgReldS1B1 / return value" UBYTE B_TRUE 1 100 0.00 1.00000000000 BIT_MASK 0x1 FORMAT "%13.11" ECU_ADDRESS 0x6000346E /end MEASUREMENT
/begin MEASUREMENT UEGO_flgFIdCJ135RvsChrgReldS1B1TONV_I.time "TurnOnDelayVariable UEGO_flgFIdCJ135RvsChrgReldS1B1 / expired delay time" UWORD t_q0p01 1 100 0.00 655.3500 FORMAT "%8.4" ECU_ADDRESS 0x60003470 /end MEASUREMENT
/begin MEASUREMENT UEGO_flgHeatrRlyActvS1B1 "Relay for heater of lambda sensor switched on; sensor 1, bank 1" UBYTE B_TRUE 1 100 0.00 1.00000000000 BIT_MASK 0x1 FORMAT "%13.11" ECU_ADDRESS 0x7000060D /end MEASUREMENT
/begin MEASUREMENT UEGO_flgIPmpActvdS1B1 "condition pump current activated sensor 1 bank 1" UBYTE B_TRUE 1 100 0.00 1.00000000000 BIT_MASK 0x1 FORMAT "%13.11" ECU_ADDRESS 0x7000060B /end MEASUREMENT
/begin MEASUREMENT UEGO_flgIPmpFilSyncActv "Condition pump current sync filter is active" UBYTE B_TRUE 1 100 0.00 1.00000000000 BIT_MASK 0x1 FORMAT "%13.11" ECU_ADDRESS 0x70000607 /end MEASUREMENT
/begin MEASUREMENT UEGO_flgIPmpRvsChrgVldS1B1 "condition validity of adaption of reverse charge correction sensor 1 bank 1" UBYTE B_TRUE 1 100 0.00 1.00000000000 BIT_MASK 0x1 FORMAT "%13.11" ECU_ADDRESS 0x70000606 /end MEASUREMENT
/begin MEASUREMENT UEGO_flgLoupeNS1B1 "condition loupe nerst cell measurement active" UBYTE B_TRUE 1 100 0.00 1.00000000000 BIT_MASK 0x1 FORMAT "%13.11" ECU_ADDRESS 0x700005FE /end MEASUREMENT
/begin MEASUREMENT UEGO_flgLoupePS1B1 "condition loupe measurement of pump cell active" UBYTE B_TRUE 1 100 0.00 1.00000000000 BIT_MASK 0x1 FORMAT "%13.11" ECU_ADDRESS 0x700005FD /end MEASUREMENT
/begin MEASUREMENT UEGO_flgLstPckAbortS1B1 "Last packet transfer aborted of sensor 1 bank 1" UBYTE B_TRUE 1 100 0.00 1.00000000000 BIT_MASK 0x1 FORMAT "%13.11" ECU_ADDRESS 0x700005FC /end MEASUREMENT
/begin MEASUREMENT UEGO_flgN3MeasActvS1B1 "Validity flag for Normal3 measurements sensor 1 bank 1" UBYTE B_TRUE 1 100 0.00 1.00000000000 BIT_MASK 0x1 FORMAT "%13.11" ECU_ADDRESS 0x700005FB /end MEASUREMENT
/begin MEASUREMENT UEGO_flgN3MeasActvVldS1B1 "Validity flag for Normal3 measurements sensor 1 bank 1" UBYTE B_TRUE 1 100 0.00 1.00000000000 BIT_MASK 0x1 FORMAT "%13.11" ECU_ADDRESS 0x700005FA /end MEASUREMENT
/begin MEASUREMENT UEGO_flgNewIPmpRvsChrgS1B1 "condition calculation reverse charge sensor 1 bank 1" UBYTE B_TRUE 1 100 0.00 1.00000000000 BIT_MASK 0x1 FORMAT "%13.11" ECU_ADDRESS 0x700005F7 /end MEASUREMENT
/begin MEASUREMENT UEGO_flgNewPckCstncS1B1 "Consistency of the new packet information of sensor 1 bank 1" UBYTE B_TRUE 1 100 0.00 1.00000000000 BIT_MASK 0x1 FORMAT "%13.11" ECU_ADDRESS 0x700005F5 /end MEASUREMENT
/begin MEASUREMENT UEGO_flgNewPckMissS1B1 "A new packet was missed of sensor 1 bank 1" UBYTE B_TRUE 1 100 0.00 1.00000000000 BIT_MASK 0x1 FORMAT "%13.11" ECU_ADDRESS 0x700005F4 /end MEASUREMENT
/begin MEASUREMENT UEGO_flgNewPckS1B1 "A new packet is available from sensor 1 bank 1" UBYTE B_TRUE 1 100 0.00 1.00000000000 BIT_MASK 0x1 FORMAT "%13.11" ECU_ADDRESS 0x700005F3 /end MEASUREMENT
/begin MEASUREMENT UEGO_flgNewPckVldS1B1 "Validity of the new packet from sensor 1 bank 1" UBYTE B_TRUE 1 100 0.00 1.00000000000 BIT_MASK 0x1 FORMAT "%13.11" ECU_ADDRESS 0x700005F2 /end MEASUREMENT
/begin MEASUREMENT UEGO_flgRefPatChngS1B1 "Bedingung Wechsel REFPAT-Register für Sensor 1 und Bank 1" UBYTE B_TRUE 1 100 0.00 1.00000000000 BIT_MASK 0x1 FORMAT "%13.11" ECU_ADDRESS 0x700005CC /end MEASUREMENT
/begin MEASUREMENT UEGO_flgRefPatVldS1B1 "Validity of REFPAT register sensor 1 bank 1" UBYTE B_TRUE 1 100 0.00 1.00000000000 BIT_MASK 0x1 FORMAT "%13.11" ECU_ADDRESS 0x700005CB /end MEASUREMENT
/begin MEASUREMENT UEGO_flgRegIpoffVldS1B1 "Validity of register IPOFF value sensor 1 bank 1" UBYTE B_TRUE 1 100 0.00 1.00000000000 BIT_MASK 0x1 FORMAT "%13.11" ECU_ADDRESS 0x700005CA /end MEASUREMENT
/begin MEASUREMENT UEGO_flgRegModVldS1B1 "Validity of register MODE sensor 1 bank 1" UBYTE B_TRUE 1 100 0.00 1.00000000000 BIT_MASK 0x1 FORMAT "%13.11" ECU_ADDRESS 0x700005C9 /end MEASUREMENT
/begin MEASUREMENT UEGO_flgRegUnsetVldS1B1 "Validity of register unset value sensor 1 bank 1" UBYTE B_TRUE 1 100 0.00 1.00000000000 BIT_MASK 0x1 FORMAT "%13.11" ECU_ADDRESS 0x700005C8 /end MEASUREMENT
/begin MEASUREMENT UEGO_flgRParlWoDsbcS1B1 "Validity flag for Rparl calculation without disturbance sensor 1 bank 1" UBYTE B_TRUE 1 100 0.00 1.00000000000 BIT_MASK 0x1 FORMAT "%13.11" ECU_ADDRESS 0x700005CF /end MEASUREMENT
/begin MEASUREMENT UEGO_flgRParlWoDsbcVldS1B1 "Validity flag for Rparl calculation without disturbance sensor 1 bank 1" UBYTE B_TRUE 1 100 0.00 1.00000000000 BIT_MASK 0x1 FORMAT "%13.11" ECU_ADDRESS 0x700005CE /end MEASUREMENT
/begin MEASUREMENT UEGO_flgRpcActvS1B1 "Reverse Pump Current Mode active in Asic operating Sensor1 Bank 1" UBYTE B_TRUE 1 100 0.00 1.00000000000 BIT_MASK 0x1 FORMAT "%13.11" ECU_ADDRESS 0x700005C6 /end MEASUREMENT
/begin MEASUREMENT UEGO_flgRpcActvVldS1B1 "Validity of Reverse Pump Current Mode sensor 1 bank 1" UBYTE B_TRUE 1 100 0.00 1.00000000000 BIT_MASK 0x1 FORMAT "%13.11" ECU_ADDRESS 0x700005C5 /end MEASUREMENT
/begin MEASUREMENT UEGO_flgRTEvlnVldS1B1 "Condition evaluation temperature valid sensor 1 bank 1" UBYTE B_TRUE 1 100 0.00 1.00000000000 BIT_MASK 0x1 FORMAT "%13.11" ECU_ADDRESS 0x700005CD /end MEASUREMENT
/begin MEASUREMENT UEGO_flgRvsChrgAdpnNEngReld "condition engine speed condition for the adaption (RvsChrg) released" UBYTE B_TRUE 1 100 0.00 1.00000000000 BIT_MASK 0x1 FORMAT "%13.11" ECU_ADDRESS 0x700005C3 /end MEASUREMENT
/begin MEASUREMENT UEGO_flgRvsChrgLoBattReld "condition low battery for RvsChrg released" UBYTE B_TRUE 1 100 0.00 1.00000000000 BIT_MASK 0x1 FORMAT "%13.11" ECU_ADDRESS 0x700005C2 /end MEASUREMENT
/begin MEASUREMENT UEGO_flgSteerPatChngS1B1 "Bedingung Wechsel STEERPAT-register für Sensor 1 und Bank 1" UBYTE B_TRUE 1 100 0.00 1.00000000000 BIT_MASK 0x1 FORMAT "%13.11" ECU_ADDRESS 0x700005BB /end MEASUREMENT
/begin MEASUREMENT UEGO_flgSteerPatVldS1B1 "validity of status of STEERPAT register sensor 1 bank 1" UBYTE B_TRUE 1 100 0.00 1.00000000000 BIT_MASK 0x1 FORMAT "%13.11" ECU_ADDRESS 0x700005BA /end MEASUREMENT
/begin MEASUREMENT UEGO_flgTCerHiPrcsnS1B1 "flag Tcer is high precision" UBYTE B_TRUE 1 100 0.00 1.00000000000 BIT_MASK 0x1 FORMAT "%13.11" ECU_ADDRESS 0x700005B8 /end MEASUREMENT
/begin MEASUREMENT UEGO_flgTCerVldS1B1 "flag Tcer is valid" UBYTE B_TRUE 1 100 0.00 1.00000000000 BIT_MASK 0x1 FORMAT "%13.11" ECU_ADDRESS 0x700005B7 /end MEASUREMENT
/begin MEASUREMENT UEGO_flgTrimSqChngS1B1 "Status for Trim register change sensor 1 bank 1" UBYTE B_TRUE 1 100 0.00 1.00000000000 BIT_MASK 0x1 FORMAT "%13.11" ECU_ADDRESS 0x700005B3 /end MEASUREMENT
/begin MEASUREMENT UEGO_flgTrimSqrChngS1B1 "Status for Trim register change sensor 1 bank 1" UBYTE B_TRUE 1 100 0.00 1.00000000000 BIT_MASK 0x1 FORMAT "%13.11" ECU_ADDRESS 0x700005B2 /end MEASUREMENT
/begin MEASUREMENT UEGO_flgTrmSqrVldS1B1 "Validity of Trim register sensor 1 bank 1" UBYTE B_TRUE 1 100 0.00 1.00000000000 BIT_MASK 0x1 FORMAT "%13.11" ECU_ADDRESS 0x700005B0 /end MEASUREMENT
/begin MEASUREMENT UEGO_flgTrmSqVldS1B1 "Validity of Trim register sensor 1 bank 1" UBYTE B_TRUE 1 100 0.00 1.00000000000 BIT_MASK 0x1 FORMAT "%13.11" ECU_ADDRESS 0x700005B1 /end MEASUREMENT
/begin MEASUREMENT UEGO_flgUBattMax "battery voltage too high" UBYTE B_TRUE 1 100 0.00 1.00000000000 BIT_MASK 0x1 FORMAT "%13.11" ECU_ADDRESS 0x700005AE /end MEASUREMENT
/begin MEASUREMENT UEGO_flgUBattMin "battery voltage too low" UBYTE B_TRUE 1 100 0.00 1.00000000000 BIT_MASK 0x1 FORMAT "%13.11" ECU_ADDRESS 0x700005AD /end MEASUREMENT
/begin MEASUREMENT UEGO_flgUBattSuff "battery voltage is sufficient to operate ASIC CJ135" UBYTE B_TRUE 1 100 0.00 1.00000000000 BIT_MASK 0x1 FORMAT "%13.11" ECU_ADDRESS 0x700005AC /end MEASUREMENT
/begin MEASUREMENT UEGO_flgUiAllMeasS1B1 "condition ui measurement sensor 1 bank 1" UBYTE B_TRUE 1 100 0.00 1.00000000000 BIT_MASK 0x1 FORMAT "%13.11" ECU_ADDRESS 0x700005A9 /end MEASUREMENT
/begin MEASUREMENT UEGO_flgUnBaseCorrnPrsntS1B1 "flag Un Base correction valid" UBYTE B_TRUE 1 100 0.00 1.00000000000 BIT_MASK 0x1 FORMAT "%13.11" ECU_ADDRESS 0x700005A8 /end MEASUREMENT
/begin MEASUREMENT UEGO_flgUPmpCtrlVldS1B1 "Validity of UPmpCtrl request sensor 1 bank 1" UBYTE B_TRUE 1 100 0.00 1.00000000000 BIT_MASK 0x1 FORMAT "%13.11" ECU_ADDRESS 0x700005AB /end MEASUREMENT
/begin MEASUREMENT UEGO_flgURIAS1B1 "condition bit URIA in register MODE sensor 1 bank 1" UBYTE B_TRUE 1 100 0.00 1.00000000000 BIT_MASK 0x1 FORMAT "%13.11" ECU_ADDRESS 0x700005AA /end MEASUREMENT
/begin MEASUREMENT UEGO_HeatrRlyPSCtrlS1B1_I.flgHeatrRlyActv "Instance of class UEGO_HeatrRlyPSCtrl / Relay for heater of lambda sensor active" UBYTE B_TRUE 1 100 0.00 1.00000000000 BIT_MASK 0x1 FORMAT "%13.11" ECU_ADDRESS 0x60000B8A /end MEASUREMENT
/begin MEASUREMENT UEGO_HeatrRlyPsDiagS1B1_I.cntrTestPls "Instance of UEGO_HeatrRlyPsDiag Class / Counter for test pulses" UBYTE OneToOne 1 100 0.00 255.0 FORMAT "%5.1" ECU_ADDRESS 0x60000B87 /end MEASUREMENT
/begin MEASUREMENT UEGO_HeatrRlyPsDiagS1B1_I.flgDSMClrReq "Instance of UEGO_HeatrRlyPsDiag Class / Clear of Faul Memory activ" UBYTE B_TRUE 1 100 0.00 1.00000000000 BIT_MASK 0x1 FORMAT "%13.11" ECU_ADDRESS 0x60000B88 /end MEASUREMENT
/begin MEASUREMENT UEGO_HeatrRlyPsDiagS1B1_I.flgRlyDiagRels "Instance of UEGO_HeatrRlyPsDiag Class / Diagnosis powerstage relay heater lambda sensor released" UBYTE B_TRUE 1 100 0.00 1.00000000000 BIT_MASK 0x1 FORMAT "%13.11" ECU_ADDRESS 0x60000B86 /end MEASUREMENT
/begin MEASUREMENT UEGO_HeatrRlyPsDiagS1B1_I.flgRlyErrOL "Instance of UEGO_HeatrRlyPsDiag Class / Fault open line (OL) powerstage relay heater lambda sensor" UBYTE B_TRUE 1 100 0.00 1.00000000000 BIT_MASK 0x2 FORMAT "%13.11" ECU_ADDRESS 0x60000B86 /end MEASUREMENT
/begin MEASUREMENT UEGO_HeatrRlyPsDiagS1B1_I.flgRlyErrSCB "Instance of UEGO_HeatrRlyPsDiag Class / Fault short circuit to battery (SCB) powerstage relay heater lambda sensor" UBYTE B_TRUE 1 100 0.00 1.00000000000 BIT_MASK 0x4 FORMAT "%13.11" ECU_ADDRESS 0x60000B86 /end MEASUREMENT
/begin MEASUREMENT UEGO_HeatrRlyPsDiagS1B1_I.flgRlyErrSCG "Instance of UEGO_HeatrRlyPsDiag Class / Fault short circuit to ground (SCG) powerstage relay heater lambda sensor" UBYTE B_TRUE 1 100 0.00 1.00000000000 BIT_MASK 0x8 FORMAT "%13.11" ECU_ADDRESS 0x60000B86 /end MEASUREMENT
/begin MEASUREMENT UEGO_HeatrRlyPsDiagS1B1_I.flgRlyIniEnd "Instance of UEGO_HeatrRlyPsDiag Class / Initialisation diagnosis powerstage relay heater lambda sensor successful" UBYTE B_TRUE 1 100 0.00 1.00000000000 BIT_MASK 0x10 FORMAT "%13.11" ECU_ADDRESS 0x60000B86 /end MEASUREMENT
/begin MEASUREMENT UEGO_idxOPTS1B1 "index OPT in register mode sensor 1 bank 1" UBYTE dez 1 100 0.00 255.0 FORMAT "%5.1" ECU_ADDRESS 0x6000A2CC /end MEASUREMENT
/begin MEASUREMENT UEGO_iIPmpRvsChrgS1B1 "Reverse charge current sensor 1 bank 1" SWORD i_q6p6667Em7_A 1 100 -0.02184533 0.02184467 FORMAT "%10.8" ARRAY_SIZE 15 ECU_ADDRESS 0x50005B9E /end MEASUREMENT
/begin MEASUREMENT UEGO_mEgFlowS1B1 "exhaust mass flow at sensor 1 bank 1" UWORD m_uw_b6553p5 1 100 0.00 6553.500 FORMAT "%8.3" ECU_ADDRESS 0x60004C46 /end MEASUREMENT
/begin MEASUREMENT UEGO_numModMeasS1B1 "measured CJ135 Mode sensor 1 bank 1" UBYTE dez 1 100 0.00 255.0 FORMAT "%5.1" ECU_ADDRESS 0x6000A2C6 /end MEASUREMENT
/begin MEASUREMENT UEGO_numRamFailPosnS1B1 "last RAM position sensor 1 bank 1" UBYTE dez 1 100 0.00 255.0 FORMAT "%5.1" ECU_ADDRESS 0x6000A2C5 /end MEASUREMENT
/begin MEASUREMENT UEGO_numRamRegModeS1B1 "Register MODE sensor 1 bank 1" UWORD dez 1 100 0.00 65535.00 FORMAT "%8.2" ECU_ADDRESS 0x60004C44 /end MEASUREMENT
/begin MEASUREMENT UEGO_numRamSts2S1B1 "Value of the STATUS-Word II of sensor 1 bank 1" UWORD dez 1 100 0.00 65535.00 FORMAT "%8.2" ECU_ADDRESS 0x60004C42 /end MEASUREMENT
/begin MEASUREMENT UEGO_numRamSts3S1B1 "Value of the STATUS-Word III of sensor 1 bank 1" UWORD dez 1 100 0.00 65535.00 FORMAT "%8.2" ECU_ADDRESS 0x60004C40 /end MEASUREMENT
/begin MEASUREMENT UEGO_numRegIpoffS1B1 "Value of the register IPOFF of sensor 1 bank 1" UWORD dez 1 100 0.00 65535.00 FORMAT "%8.2" ECU_ADDRESS 0x60004C3E /end MEASUREMENT
/begin MEASUREMENT UEGO_numRegModS1B1 "Value of the register MODE of sensor 1 bank 1" UWORD dez 1 100 0.00 65535.00 FORMAT "%8.2" ECU_ADDRESS 0x70002CB0 /end MEASUREMENT
/begin MEASUREMENT UEGO_numRegUnsetS1B1 "Value of the register UNSET of sensor 1 bank 1" UWORD dez 1 100 0.00 65535.00 FORMAT "%8.2" ECU_ADDRESS 0x60004C3C /end MEASUREMENT
/begin MEASUREMENT UEGO_numTrmSqrS1B1 "Adjustment bits ISQR reference of sensor 1 bank 1" UWORD dez 1 100 0.00 65535.00 FORMAT "%8.2" ECU_ADDRESS 0x60004C38 /end MEASUREMENT
/begin MEASUREMENT UEGO_numTrmSqS1B1 "Adjustment bits ISQ reference of sensor 1 bank 1" UWORD dez 1 100 0.00 65535.00 FORMAT "%8.2" ECU_ADDRESS 0x60004C3A /end MEASUREMENT
/begin MEASUREMENT UEGO_rCerS1B1 "sensor resistance sensor 1 bank 1" UWORD r_q0p1_Ohm 1 100 0.00 6553.500 FORMAT "%8.3" ECU_ADDRESS 0x70002CBC /end MEASUREMENT
/begin MEASUREMENT UEGO_rRiaRawS1B1 "pump cell resistance raw value sensor 1 bank 1" UWORD r_q0p1_Ohm 1 100 0.00 6553.500 FORMAT "%8.3" ECU_ADDRESS 0x70002CC2 /end MEASUREMENT
/begin MEASUREMENT UEGO_rRieRawS1B1 "nernst cell resistance raw value sensor 1 bank 1" UWORD r_q0p1_Ohm 1 100 0.00 6553.500 FORMAT "%8.3" ECU_ADDRESS 0x60004C36 /end MEASUREMENT
/begin MEASUREMENT UEGO_stEngAndEcu "status of engine and ecu" UBYTE OneToOne 1 100 0.00 255.0 FORMAT "%5.1" ECU_ADDRESS 0x70002D6C /end MEASUREMENT
/begin MEASUREMENT UEGO_stRefPatS1B1 "Register REFPAT sensor 1 bank 1" UWORD dez 1 100 0.00 65535.00 FORMAT "%8.2" ECU_ADDRESS 0x60004C24 /end MEASUREMENT
/begin MEASUREMENT UEGO_stSteerPatS1B1 "Status of STEERPAT register sensor 1 bank 1" UWORD dez 1 100 0.00 65535.00 FORMAT "%8.2" ECU_ADDRESS 0x60004C22 /end MEASUREMENT
/begin MEASUREMENT UEGO_stUPmpCtrlCurrS1B1 "Indication for UPmpCtrl request sensor 1 bank 1" UWORD dez 1 100 0.00 65535.00 FORMAT "%8.2" ECU_ADDRESS 0x60004C20 /end MEASUREMENT
/begin MEASUREMENT UEGO_tCerS1B1 "temperature of ceramic sensor 1 bank 1" UWORD temp_q0p0234_o273 1 100 -273.150 1262.827 FORMAT "%8.3" ECU_ADDRESS 0x60004C1A /end MEASUREMENT
/begin MEASUREMENT UEGO_tEgFldS1B1 "Actual temperature from temperature sensor for sensor 1 bank 1" SWORD Temp_Cels 1 100 -3549.940 3003.560 FORMAT "%8.3" ECU_ADDRESS 0x70002CCA /end MEASUREMENT
/begin MEASUREMENT UEGO_tEgMdlS1B1 "modelled exhaust gas temperature at sensor 1 bank 1" SWORD Temp_Cels 1 100 -3549.940 3003.560 FORMAT "%8.3" ECU_ADDRESS 0x60004E8E /end MEASUREMENT
/begin MEASUREMENT UEGO_tiDlyEngRunngTOFFVNM_I.time "TOFF Delay to keep UEGO_flgEngRunng in TRUE, to enable robust lambda sensor operation during stop phase (especially during restart phases) / delay time" UWORD t_q0p01 1 100 0.00 655.3500 FORMAT "%8.4" ECU_ADDRESS 0x70002BA6 /end MEASUREMENT
/begin MEASUREMENT UEGO_tWallMdlS1B1 "Temperature wall modelled, sensor 1, bank 1" SWORD Temp_Cels 1 100 -3549.940 3003.560 FORMAT "%8.3" ECU_ADDRESS 0x60004E8C /end MEASUREMENT
/begin MEASUREMENT UEGO_uDeltaUg0aS1B1 "delta Ug0a sensor 1 bank 1" SWORD spg_q3p2Em4_V 1 100 -10.48576 10.48544 FORMAT "%8.5" ECU_ADDRESS 0x60004E8A /end MEASUREMENT
/begin MEASUREMENT UEGO_uDeltaUg0eS1B1 "delta Ug0e sensor 1 bank 1" SWORD spg_q3p2Em4_V 1 100 -10.48576 10.48544 FORMAT "%8.5" ECU_ADDRESS 0x60004E88 /end MEASUREMENT
/begin MEASUREMENT UEGO_uDeltaUg0iaiS1B1 "delta Ug0iai sensor 1 bank 1" SWORD spg_q3p2Em4_V 1 100 -10.48576 10.48544 FORMAT "%8.5" ECU_ADDRESS 0x60004E84 /end MEASUREMENT
/begin MEASUREMENT UEGO_uDeltaUg0ieiS1B1 "delta Ug0iei sensor 1 bank 1" SWORD spg_q3p2Em4_V 1 100 -10.48576 10.48544 FORMAT "%8.5" ECU_ADDRESS 0x60004E82 /end MEASUREMENT
/begin MEASUREMENT UEGO_uDeltaUg0iS1B1 "delta Ug0i sensor 1 bank 1" SWORD spg_q3p2Em4_V 1 100 -10.48576 10.48544 FORMAT "%8.5" ECU_ADDRESS 0x60004E86 /end MEASUREMENT
/begin MEASUREMENT UEGO_uDeltaUgaS1B1 "Voltage Uga with reference to Ug0 sensor 1 bank 1" SWORD spg_q3p2Em4_V 1 100 -10.48576 10.48544 FORMAT "%8.5" ECU_ADDRESS 0x60004E80 /end MEASUREMENT
/begin MEASUREMENT UEGO_uDeltaUgiS1B1 "Voltage Ugi with reference to Ug0 sensor 1 bank 1" SWORD spg_q3p2Em4_V 1 100 -10.48576 10.48544 FORMAT "%8.5" ECU_ADDRESS 0x60004E7E /end MEASUREMENT
/begin MEASUREMENT UEGO_uDeltaUnS1B1 "uDelta Un of sensor instance" SWORD spg_q3p2Em4_V 1 100 -10.48576 10.48544 FORMAT "%8.5" ECU_ADDRESS 0x60004E7C /end MEASUREMENT
/begin MEASUREMENT UEGO_uUMeasMaxLNS1B1 "Maximum voltage measured at the Nernst cell for UEGO sensor 1 Bank 1" SWORD spg_q3p2Em4_V 1 100 0.00 10.48544 FORMAT "%8.5" ECU_ADDRESS 0x60004E76 /end MEASUREMENT
/begin MEASUREMENT UEGO_uUMeasMaxLPS1B1 "Maximum voltage measured at the Pump cell for UEGO sensor 1 Bank 1" SWORD spg_q3p2Em4_V 1 100 0.00 10.48544 FORMAT "%8.5" ECU_ADDRESS 0x60004E74 /end MEASUREMENT
/begin FUNCTION UEGO_CJ135PckEvln "1.4.0     CJ135 Package Evaluation by UEGO" /begin DEF_CHARACTERISTIC UEGO_tiDlyNewPacMiss_C /end DEF_CHARACTERISTIC /begin REF_CHARACTERISTIC UEGO_idxHWES1B1_C /end REF_CHARACTERISTIC /begin IN_MEASUREMENT UEGO_flgErrSpiRamBnk10msS1B1 UEGO_idxTypS1B1 /end IN_MEASUREMENT
 /begin OUT_MEASUREMENT UEGO_flgClmpdNS1B1 UEGO_flgClmpdPS1B1 UEGO_flgErrSpiRamBnkS1B1 UEGO_flgIPmpActvdS1B1 UEGO_flgLoupeNS1B1 UEGO_flgLoupePS1B1 UEGO_flgLstPckAbortS1B1 UEGO_flgN3MeasActvS1B1 UEGO_flgN3MeasActvVldS1B1 UEGO_flgNewPckCstncS1B1 UEGO_flgNewPckMissS1B1 UEGO_flgNewPckS1B1 UEGO_flgNewPckVldS1B1 UEGO_flgRefPatChngS1B1 UEGO_flgRefPatVldS1B1 UEGO_flgRegIpoffVldS1B1 UEGO_flgRegModVldS1B1 UEGO_flgRegUnsetVldS1B1 UEGO_flgRParlWoDsbcS1B1 UEGO_flgRParlWoDsbcVldS1B1 UEGO_flgRpcActvS1B1 UEGO_flgRpcActvVldS1B1 UEGO_flgSteerPatChngS1B1 UEGO_flgSteerPatVldS1B1 UEGO_flgTrimSqChngS1B1 UEGO_flgTrimSqrChngS1B1 UEGO_flgTrmSqrVldS1B1 UEGO_flgTrmSqVldS1B1 UEGO_flgUPmpCtrlVldS1B1 UEGO_flgURIAS1B1 UEGO_idxOPTS1B1 UEGO_numModMeasS1B1 UEGO_numRamRegModeS1B1 UEGO_numRegIpoffS1B1 UEGO_numRegModS1B1 UEGO_numRegUnsetS1B1 UEGO_numTrmSqrS1B1 UEGO_numTrmSqS1B1 UEGO_stRefPatS1B1 UEGO_stSteerPatS1B1 UEGO_stUPmpCtrlCurrS1B1 /end OUT_MEASUREMENT
 /begin LOC_MEASUREMENT UEGO_CJ135PckEvlnS1B1_I.flgClmpdN UEGO_CJ135PckEvlnS1B1_I.flgClmpdP UEGO_CJ135PckEvlnS1B1_I.flgErrSpiRamBnk UEGO_CJ135PckEvlnS1B1_I.flgIPmpActvd UEGO_CJ135PckEvlnS1B1_I.flgLoupeN UEGO_CJ135PckEvlnS1B1_I.flgLoupeP UEGO_CJ135PckEvlnS1B1_I.flgLstPckAbort UEGO_CJ135PckEvlnS1B1_I.flgN3MeasActv UEGO_CJ135PckEvlnS1B1_I.flgN3MeasActvNxtPckVld UEGO_CJ135PckEvlnS1B1_I.flgN3MeasActvVld UEGO_CJ135PckEvlnS1B1_I.flgNewPck UEGO_CJ135PckEvlnS1B1_I.flgNewPckCstncEnd UEGO_CJ135PckEvlnS1B1_I.flgNewPckCstncStrt UEGO_CJ135PckEvlnS1B1_I.flgNewPckMiss UEGO_CJ135PckEvlnS1B1_I.flgNewPckVld UEGO_CJ135PckEvlnS1B1_I.flgRParlWoDsbc UEGO_CJ135PckEvlnS1B1_I.flgRParlWoDsbcNxtPckVld UEGO_CJ135PckEvlnS1B1_I.flgRParlWoDsbcVld UEGO_CJ135PckEvlnS1B1_I.flgRefPatChng UEGO_CJ135PckEvlnS1B1_I.flgRefPatNxtPckVld UEGO_CJ135PckEvlnS1B1_I.flgRefPatVld UEGO_CJ135PckEvlnS1B1_I.flgRegIpoffChng UEGO_CJ135PckEvlnS1B1_I.flgRegIpoffNxtPckVld UEGO_CJ135PckEvlnS1B1_I.flgRegIpoffVld UEGO_CJ135PckEvlnS1B1_I.flgRegModNxtPckVld UEGO_CJ135PckEvlnS1B1_I.flgRegModVld UEGO_CJ135PckEvlnS1B1_I.flgRegTrmNxtPckVld UEGO_CJ135PckEvlnS1B1_I.flgRegUnsetNxtPckVld UEGO_CJ135PckEvlnS1B1_I.flgRegUnsetVld UEGO_CJ135PckEvlnS1B1_I.flgRpcActv UEGO_CJ135PckEvlnS1B1_I.flgRpcActvNxtPckVld UEGO_CJ135PckEvlnS1B1_I.flgRpcActvVld UEGO_CJ135PckEvlnS1B1_I.flgSteerPatChng UEGO_CJ135PckEvlnS1B1_I.flgSteerPatNxtPckVld UEGO_CJ135PckEvlnS1B1_I.flgSteerPatVld UEGO_CJ135PckEvlnS1B1_I.flgTrimSqChng UEGO_CJ135PckEvlnS1B1_I.flgTrimSqrChng UEGO_CJ135PckEvlnS1B1_I.flgTrmSqVld UEGO_CJ135PckEvlnS1B1_I.flgTrmSqrVld UEGO_CJ135PckEvlnS1B1_I.flgUPmpCtrlNxtPckVld UEGO_CJ135PckEvlnS1B1_I.flgUPmpCtrlVld UEGO_CJ135PckEvlnS1B1_I.flgURIA UEGO_CJ135PckEvlnS1B1_I.idxOPT UEGO_CJ135PckEvlnS1B1_I.numModMeas UEGO_CJ135PckEvlnS1B1_I.numPckDataLostCntr UEGO_CJ135PckEvlnS1B1_I.numPckNotCmplCntr UEGO_CJ135PckEvlnS1B1_I.numRamRegMod UEGO_CJ135PckEvlnS1B1_I.numRegDiffCntr UEGO_CJ135PckEvlnS1B1_I.numRegIpoff UEGO_CJ135PckEvlnS1B1_I.numRegIpoffNxtPck UEGO_CJ135PckEvlnS1B1_I.numRegMod UEGO_CJ135PckEvlnS1B1_I.numRegModNxtPck UEGO_CJ135PckEvlnS1B1_I.numRegTrmNxtPck UEGO_CJ135PckEvlnS1B1_I.numRegUnset UEGO_CJ135PckEvlnS1B1_I.numRegUnsetNxtPck UEGO_CJ135PckEvlnS1B1_I.numTrmSq UEGO_CJ135PckEvlnS1B1_I.numTrmSqr UEGO_CJ135PckEvlnS1B1_I.stLsmRetValMod UEGO_CJ135PckEvlnS1B1_I.stRefPat UEGO_CJ135PckEvlnS1B1_I.stRefPatNxtPck UEGO_CJ135PckEvlnS1B1_I.stSteerPat UEGO_CJ135PckEvlnS1B1_I.stSteerPatNxtPck UEGO_CJ135PckEvlnS1B1_I.stUPmpCtrlCurr UEGO_CJ135PckEvlnS1B1_I.stUPmpCtrlCurrNxtPck /end LOC_MEASUREMENT
 FUNCTION_VERSION "1.4.0" /end FUNCTION
/begin FUNCTION UEGO_CJ135RTEval "4.7.0     UEGO CJ135 temperature data acquisition and preprocessing"
 /begin DEF_CHARACTERISTIC UEGO_facDeltaUnFltConst_C UEGO_facRiaFltConst_C UEGO_facRieFltConst_C UEGO_facRieRiaIni_C UEGO_facRipdFltConst_C UEGO_facRipFltConst_C UEGO_facRixQuoFltConst_C UEGO_numRiaMn_C UEGO_numRieMn_C UEGO_numRipdMn_C UEGO_numRipMn_C UEGO_resRiaCorrnRiSwtOn_CUR UEGO_resRiaCorrnRiWrmUp_CUR UEGO_resRieCorrnIpTM2R_CUR UEGO_resRieCorrnIp_CUR UEGO_resRieCorrnRiNrml_CUR UEGO_resRieCorrnRiWrmUp_CUR UEGO_resRipdCorrnIp_CUR UEGO_resRipZ1CorrnIp_CUR UEGO_resRipZ2CorrnIp_CUR UEGO_stCJ135RTEval_C UEGO_tFacRieRiaMax_C UEGO_tFacRieRiaMin_C UEGO_tiDlyDeltaUnVld_C UEGO_tiDlyRiMissMeas_C UEGO_tMinActvtRie_C UEGO_tMinActvtRip_C UEGO_tRi2Temp_CUR /end DEF_CHARACTERISTIC
 /begin REF_CHARACTERISTIC UEGO_resRFe_C /end REF_CHARACTERISTIC
 /begin IN_MEASUREMENT Eep_EnvRamInvld SyC_ctPostDrvLeave UEGO_flgEcuDataRstReqS1B1 UEGO_flgIPmpActvdS1B1 UEGO_flgIsqrStrtdS1B1 UEGO_flgIsqrVldS1B1 UEGO_flgNewPckVldS1B1 UEGO_flgNewUa2PckAryS1B1 UEGO_flgNewUi21PckAryS1B1 UEGO_flgNewUn0PckAryS1B1 UEGO_flgNewUp0PckAryS1B1 UEGO_flgNewUpPckAryS1B1 UEGO_flgNewUriaPckS1B1 UEGO_flgNewUriePckAryS1B1 UEGO_flgURIAS1B1 UEGO_flgWireDataRstReqS1B1 UEGO_idxOPTS1B1 UEGO_idxTypS1B1 UEGO_iIPmpPacAvrgS1B1 UEGO_iIsqMeasS1B1 UEGO_iIsqrMeasS1B1 UEGO_iIsqrRegDesS1B1 UEGO_numModMeasS1B1 UEGO_numRamRegModeS1B1 UEGO_numUa2PckAryS1B1 UEGO_numUi21PckAryS1B1 UEGO_numUn0PckAryS1B1 UEGO_numUp0PckAryS1B1 UEGO_numUpPckAryS1B1 UEGO_numUriePckAryS1B1 UEGO_stIPmpTM2LS1B1 UEGO_stIPmpTM2RS1B1 UEGO_stRefPatS1B1 UEGO_stUn0PckAryS1B1 UEGO_stUn0Z2PckAryS1B1 UEGO_stUp0PckAryS1B1 UEGO_stUp0Z2PckAryS1B1 UEGO_stUpPckAryS1B1 UEGO_stUpZ2PckAryS1B1 UEGO_uUa2PckAryS1B1 UEGO_uUi21PckAryS1B1 UEGO_uUn0PckAryS1B1 UEGO_uUp0PckAryS1B1 UEGO_uUpPckAryS1B1 UEGO_uUriaPckS1B1 UEGO_uUriePckAryS1B1 /end IN_MEASUREMENT
 /begin OUT_MEASUREMENT B_rinval_msg rinlsu_w_msg tkerlsu_w_msg UEGO_facRieRiaS1B1 UEGO_facRieRipS1B1 UEGO_flgFacRieRiaCalcdS1B1 UEGO_flgFacRieRipCalcdS1B1 UEGO_flgRTEvlnVldS1B1 UEGO_flgTCerHiPrcsnS1B1 UEGO_flgTCerVldS1B1 UEGO_flgUnBaseCorrnPrsntS1B1 UEGO_rCerS1B1 UEGO_rRiaRawS1B1 UEGO_rRieRawS1B1 UEGO_tCerS1B1 UEGO_uDeltaUnS1B1 UEGO_uUMeasMaxLNS1B1 UEGO_uUMeasMaxLPS1B1 /end OUT_MEASUREMENT
 /begin LOC_MEASUREMENT UEGO_CJ135RTEvalS1B1_I.ctReiniProc5msec UEGO_CJ135RTEvalS1B1_I.facRieRia UEGO_CJ135RTEvalS1B1_I.flgDeltaUnStdVld UEGO_CJ135RTEvalS1B1_I.flgDeltaUnTM2RVld UEGO_CJ135RTEvalS1B1_I.flgIPmpTM2R UEGO_CJ135RTEvalS1B1_I.flgRelsRTEval UEGO_CJ135RTEvalS1B1_I.flgRiaActvd UEGO_CJ135RTEvalS1B1_I.flgRiaCalcd UEGO_CJ135RTEvalS1B1_I.flgRiaFilRst UEGO_CJ135RTEvalS1B1_I.flgRiaHiPrcns UEGO_CJ135RTEvalS1B1_I.flgRiaVld UEGO_CJ135RTEvalS1B1_I.flgRieActvd UEGO_CJ135RTEvalS1B1_I.flgRieCalcd UEGO_CJ135RTEvalS1B1_I.flgRieFilRst UEGO_CJ135RTEvalS1B1_I.flgRieVld UEGO_CJ135RTEvalS1B1_I.flgRipActvd UEGO_CJ135RTEvalS1B1_I.flgRipZ1Calcd UEGO_CJ135RTEvalS1B1_I.flgRipZ1FilRst UEGO_CJ135RTEvalS1B1_I.flgRipZ1Vld UEGO_CJ135RTEvalS1B1_I.flgRipZ2Calcd UEGO_CJ135RTEvalS1B1_I.flgRipZ2FilRst UEGO_CJ135RTEvalS1B1_I.flgRipZ2Vld UEGO_CJ135RTEvalS1B1_I.flgRipdActvd UEGO_CJ135RTEvalS1B1_I.flgRipdCalcd UEGO_CJ135RTEvalS1B1_I.flgRipdFilRst UEGO_CJ135RTEvalS1B1_I.flgRipdVld UEGO_CJ135RTEvalS1B1_I.numPacRia UEGO_CJ135RTEvalS1B1_I.numPacRie UEGO_CJ135RTEvalS1B1_I.numPacRipZ1 UEGO_CJ135RTEvalS1B1_I.numPacRipZ2 UEGO_CJ135RTEvalS1B1_I.numPacRipd UEGO_CJ135RTEvalS1B1_I.numUpMeas UEGO_CJ135RTEvalS1B1_I.numUrieMeas UEGO_CJ135RTEvalS1B1_I.numUriePacSum UEGO_CJ135RTEvalS1B1_I.resRiaRaw UEGO_CJ135RTEvalS1B1_I.resRieEfc UEGO_CJ135RTEvalS1B1_I.resRieRaw UEGO_CJ135RTEvalS1B1_I.resRieRawSum UEGO_CJ135RTEvalS1B1_I.resRipZ1Raw UEGO_CJ135RTEvalS1B1_I.resRipZ2Raw UEGO_CJ135RTEvalS1B1_I.resRipd UEGO_CJ135RTEvalS1B1_I.resRipdRaw UEGO_CJ135RTEvalS1B1_I.uDeltaUn UEGO_CJ135RTEvalS1B1_I.uDeltaUnExp UEGO_CJ135RTEvalS1B1_I.uUpBRipd UEGO_CJ135RTEvalS1B1_I.uUpBaseZ1 UEGO_CJ135RTEvalS1B1_I.uUpBaseZ2 UEGO_CJ135RTEvalS1B1_I.uUpRipd UEGO_CJ135RTEvalS1B1_I.uUpZ1 UEGO_CJ135RTEvalS1B1_I.uUpZ2 UEGO_CJ135RTEvalS1B1_I.uUriaBase UEGO_CJ135RTEvalS1B1_I.uUrie UEGO_CJ135RTEvalS1B1_I.uUrieBase UEGO_CJ135RTEvalS1B1_I.TOffDlyDeltaUnStdVld_TOFFV_I.outbit UEGO_CJ135RTEvalS1B1_I.TOffDlyDeltaUnStdVld_TOFFV_I.time UEGO_CJ135RTEvalS1B1_I.TOffDlyDeltaUnTM2RVld_TOFFV_I.outbit UEGO_CJ135RTEvalS1B1_I.TOffDlyDeltaUnTM2RVld_TOFFV_I.time UEGO_CJ135RTEvalS1B1_I.facRieRiaFltDL_I.memory UEGO_CJ135RTEvalS1B1_I.facRieRipFltDL_I.memory UEGO_CJ135RTEvalS1B1_I.flgRiaCalc_TOFFVNM_I.time UEGO_CJ135RTEvalS1B1_I.flgRieCalc_TOFFVNM_I.time UEGO_CJ135RTEvalS1B1_I.flgRipZ1Calc_TOFFVNM_I.time UEGO_CJ135RTEvalS1B1_I.flgRipZ2Calc_TOFFVNM_I.time UEGO_CJ135RTEvalS1B1_I.flgRipdCalc_TOFFVNM_I.time UEGO_CJ135RTEvalS1B1_I.resRiaDL_I.memory UEGO_CJ135RTEvalS1B1_I.resRieDL_I.memory UEGO_CJ135RTEvalS1B1_I.resRipZ1DL_I.memory UEGO_CJ135RTEvalS1B1_I.resRipZ2DL_I.memory UEGO_CJ135RTEvalS1B1_I.resRipdDL_I.memory UEGO_CJ135RTEvalS1B1_I.uDeltaUnStdDL_I.memory UEGO_CJ135RTEvalS1B1_I.uDeltaUnTM2RDL_I.memory /end LOC_MEASUREMENT
 FUNCTION_VERSION "4.7.0" /end FUNCTION
/begin FUNCTION UEGO_CJ135RvsChrg "2.7.0     UEGO CJ135 reverse charge"
 /begin DEF_CHARACTERISTIC UEGO_CJ135BumTM10_C UEGO_CJ135BumTM2f_C UEGO_CJ135BumTM2m_C UEGO_CJ135dIoff_C UEGO_CJ135FMbumM_C UEGO_CJ135FMbumP_C UEGO_CJ135Moff_C UEGO_CJ135MUapeTM10_C UEGO_CJ135MUapeTM2f_C UEGO_CJ135MUapeTM2m_C UEGO_CJ135MumTM10_C UEGO_CJ135MumTM2f_C UEGO_CJ135MumTM2m_C UEGO_cndAprvdUp0Corrn_C UEGO_cpCamgIni_C UEGO_cpCigIni_C UEGO_facCorKIA11P_CUR UEGO_facCorKIA12P_CUR UEGO_facCorKIA21P_CUR UEGO_facCorKIA22P_CUR UEGO_facCorKIV1P_CUR UEGO_facCorKIV2P_CUR UEGO_facCpFltConst_C UEGO_facDeltaUiFltConst_C UEGO_facIPmpRawRvsChrgFltConst_C UEGO_facUapeRvsChrgFltConst_C UEGO_facUgiFltConst_C UEGO_facUp0RvsChrgFltConst_C UEGO_iDeltaIsqRegIsq_C UEGO_idxCyc1371013_CUR UEGO_idxCyc1471015_CUR UEGO_idxCyc2481114_CUR UEGO_iIPmpRvsChrgCorrnOffsTM1Lean_C UEGO_iIPmpRvsChrgCorrnOffsTM1Rich_C UEGO_iIPmpRvsChrgCorrnOffsTM2Lean_C UEGO_iIPmpRvsChrgCorrnOffsTM2Rich_C UEGO_iIPmpRvsChrgCorrnTM1Lean_C UEGO_iIPmpRvsChrgCorrnTM1Rich_C UEGO_iIPmpRvsChrgCorrnTM2Lean_C UEGO_iIPmpRvsChrgCorrnTM2Rich_C UEGO_iIRestAPE_C UEGO_iIRestIPE_C UEGO_iIRestMES_C UEGO_iIRestRE_C UEGO_ratDeltaIPmpRegIpoff_C UEGO_ratIPmpMaxLam1UiAllMeas_C UEGO_ratIPmpMaxLeanUiAllMeas_C UEGO_ratIPmpMaxRichUiAllMeas_C UEGO_ratIPmpMaxSpcUiAllMeas_C UEGO_ratIPmpMinLam1UiAllMeas_C UEGO_ratIPmpMinLeanUiAllMeas_C UEGO_ratIPmpMinRichUiAllMeas_C UEGO_ratIPmpMinSpcUiAllMeas_C UEGO_resRsgaspa_C UEGO_stLrngAr_C UEGO_tiLastUiAllMeas_C UEGO_tiMeasAdcRvsChrg_C UEGO_tiMeasIPmpTM2Min_C UEGO_tiTiDeadReq_C UEGO_tiWaitCCalc_C UEGO_tiWaitUiAllMeas_C UEGO_uDeltaUi22Ini_C UEGO_uDeltaUi23Ini_C UEGO_uDeltaUi24Ini_C UEGO_uUp0IPmpUmCorrnIp_CUR UEGO_cpCpMeasMax_C UEGO_cpCpMeasMin_C UEGO_flgCMeasRvsChrgDi_C UEGO_nRvsChrgAdpnEngMax_C UEGO_nRvsChrgAdpnEngMin_C UEGO_numRegIpoffCMeas_C UEGO_numRegIpoffUi22Meas_C UEGO_numRegIpoffUi23Ui24Meas_C UEGO_numRegIpsmRvsChrg_C UEGO_numRegIsqCMeas_C UEGO_numRegPatCMeas_C UEGO_numRegPatUiMeas_C UEGO_tiFIdCJ135RvsChrg_C /end DEF_CHARACTERISTIC
 /begin REF_CHARACTERISTIC UEGO_resRGnd_C UEGO_stOperLoBatt_C /end REF_CHARACTERISTIC
 /begin IN_MEASUREMENT Eep_EnvRamInvld Epm_nEng SyC_ctPostDrvLeave UEGO_flgIPmpActvdS1B1 UEGO_flgN3MeasActvS1B1 UEGO_flgNewIPmpOKS1B1 UEGO_flgNewIPmpPckAryS1B1 UEGO_flgNewIPmpTMS1B1 UEGO_flgNewPckVldS1B1 UEGO_flgNewUa2PckAryS1B1 UEGO_flgNewUa33PckS1B1 UEGO_flgNewUapePckS1B1 UEGO_flgNewUg0PckS1B1 UEGO_flgNewUgiPckAryS1B1 UEGO_flgNewUguaPckS1B1 UEGO_flgNewUguiPckS1B1 UEGO_flgNewUi21PckAryS1B1 UEGO_flgNewUi22PckS1B1 UEGO_flgNewUi23PckS1B1 UEGO_flgNewUi24PckS1B1 UEGO_flgNewUi4PckS1B1 UEGO_flgNewUi4Z2PckS1B1 UEGO_flgNewUp0PckAryS1B1 UEGO_flgNewUpPckAryS1B1 UEGO_flgRefPatVldS1B1 UEGO_flgRegIpoffVldS1B1 UEGO_flgSteerPatVldS1B1 UEGO_flgTrmSqVldS1B1 UEGO_flgUBattMin UEGO_idxOPTS1B1 UEGO_idxTypS1B1 UEGO_iIsqMeasS1B1 UEGO_numModMeasS1B1 UEGO_numRegIpoffS1B1 UEGO_numTrmSqS1B1 UEGO_numUgiPckAryS1B1 UEGO_numUp0PckAryS1B1 UEGO_ratIPmpRawS1B1 UEGO_stIPmpOKS1B1 UEGO_stIPmpTM2LS1B1 UEGO_stIPmpTM2RS1B1 UEGO_stIPmpTMS1B1 UEGO_stSteerPatS1B1 UEGO_uUa2PckAryS1B1 UEGO_uUa33PckS1B1 UEGO_uUapePckS1B1 UEGO_uUg0PckS1B1 UEGO_uUgiPckAryS1B1 UEGO_uUguaPckS1B1 UEGO_uUguiPckS1B1 UEGO_uUi21PckAryS1B1 UEGO_uUi22PckS1B1 UEGO_uUi23PckS1B1 UEGO_uUi24PckS1B1 UEGO_uUi4PckS1B1 UEGO_uUi4Z2PckS1B1 UEGO_uUp0PckAryS1B1 UEGO_uUpPckAryS1B1 UEGO_uVCC3MeasRefS1B1 /end IN_MEASUREMENT
 /begin OUT_MEASUREMENT UEGO_cpCapeCmesCellS1B1 UEGO_cpCigCellS1B1 UEGO_flgCMeasS1B1 UEGO_flgFIdCJ135RvsChrgMeasRdyS1B1 UEGO_flgIPmpRvsChrgVldS1B1 UEGO_flgNewIPmpRvsChrgS1B1 UEGO_flgUiAllMeasS1B1 UEGO_iIPmpRvsChrgS1B1 /end OUT_MEASUREMENT
 /begin LOC_MEASUREMENT flgCPMeasS1B1ERNM_I.oldSignal flgUiAllMeasS1B1ERNM_I.oldSignal UEGO_CJ135RvsChrgS1B1_I.Detrmt UEGO_CJ135RvsChrgS1B1_I.cpCapeCmesCellLimd UEGO_CJ135RvsChrgS1B1_I.cpCapeCmesCellLrn UEGO_CJ135RvsChrgS1B1_I.cpCigCellLimd UEGO_CJ135RvsChrgS1B1_I.cpCigCellLrn UEGO_CJ135RvsChrgS1B1_I.cpCpAvrgCell UEGO_CJ135RvsChrgS1B1_I.ctReiniProc5msec UEGO_CJ135RvsChrgS1B1_I.facCorKIA11P UEGO_CJ135RvsChrgS1B1_I.facCorKIA12P UEGO_CJ135RvsChrgS1B1_I.facCorKIA21P UEGO_CJ135RvsChrgS1B1_I.facCorKIA22P UEGO_CJ135RvsChrgS1B1_I.facCorKIV1P UEGO_CJ135RvsChrgS1B1_I.facCorKIV2P UEGO_CJ135RvsChrgS1B1_I.facPlsTaa UEGO_CJ135RvsChrgS1B1_I.facPlsTii UEGO_CJ135RvsChrgS1B1_I.flgCpCalcd UEGO_CJ135RvsChrgS1B1_I.flgCpCalcdEndTot UEGO_CJ135RvsChrgS1B1_I.flgCpMeas UEGO_CJ135RvsChrgS1B1_I.flgDeltaUiAllEndTot UEGO_CJ135RvsChrgS1B1_I.flgDeltaUiAllLeanMeasd UEGO_CJ135RvsChrgS1B1_I.flgDeltaUiAllMeasd UEGO_CJ135RvsChrgS1B1_I.flgDeltaUiAllModlnLam1Measd UEGO_CJ135RvsChrgS1B1_I.flgDeltaUiAllRichMeasd UEGO_CJ135RvsChrgS1B1_I.flgDeltaUiAllSpcMeasd UEGO_CJ135RvsChrgS1B1_I.flgIPTM2RLst UEGO_CJ135RvsChrgS1B1_I.flgIPmpRvsChrgVld UEGO_CJ135RvsChrgS1B1_I.flgNewCpCalc UEGO_CJ135RvsChrgS1B1_I.flgNewDataRvsChrgTM1 UEGO_CJ135RvsChrgS1B1_I.flgNewDataRvsChrgTM2L UEGO_CJ135RvsChrgS1B1_I.flgNewDeltaUiAll UEGO_CJ135RvsChrgS1B1_I.flgNewIPmpPac UEGO_CJ135RvsChrgS1B1_I.flgNewIPmpRvsChrg UEGO_CJ135RvsChrgS1B1_I.flgNewIPmpRvsChrgTM1 UEGO_CJ135RvsChrgS1B1_I.flgNewIPmpRvsChrgTM1TM2Lean UEGO_CJ135RvsChrgS1B1_I.flgNewIPmpRvsChrgTM1TM2Rich UEGO_CJ135RvsChrgS1B1_I.flgNewIPmpRvsChrgTM2L UEGO_CJ135RvsChrgS1B1_I.flgNewIPmpRvsChrgTM2R UEGO_CJ135RvsChrgS1B1_I.flgRatIPmpAvrgLam1UiAllMeas UEGO_CJ135RvsChrgS1B1_I.flgRatIPmpAvrgLeanUiAllMeas UEGO_CJ135RvsChrgS1B1_I.flgRatIPmpAvrgRichUiAllMeas UEGO_CJ135RvsChrgS1B1_I.flgRatIPmpAvrgSpcUiAllMeas UEGO_CJ135RvsChrgS1B1_I.flgRegRdyCpCalc UEGO_CJ135RvsChrgS1B1_I.flgRegRdyDeltaUiAll UEGO_CJ135RvsChrgS1B1_I.flgUapeZ1Strtd UEGO_CJ135RvsChrgS1B1_I.flgUapeZ2Strtd UEGO_CJ135RvsChrgS1B1_I.flgUgiZ1Strtd UEGO_CJ135RvsChrgS1B1_I.flgUgiZ2Strtd UEGO_CJ135RvsChrgS1B1_I.flgUiAllMeas UEGO_CJ135RvsChrgS1B1_I.flgUp0Z0Strtd UEGO_CJ135RvsChrgS1B1_I.flgUp0Z1Strtd UEGO_CJ135RvsChrgS1B1_I.flgUp0Z2Strtd UEGO_CJ135RvsChrgS1B1_I.iIPmpRvsChrgCorrn1RTM1TM2Rich UEGO_CJ135RvsChrgS1B1_I.iIPmpRvsChrgCorrn1RTM2Rich UEGO_CJ135RvsChrgS1B1_I.iIPmpRvsChrgCorrn2RTM1TM2Rich UEGO_CJ135RvsChrgS1B1_I.iIPmpRvsChrgCorrn3RTM1TM2Rich UEGO_CJ135RvsChrgS1B1_I.iIPmpRvsChrgCorrnIRestTM1 UEGO_CJ135RvsChrgS1B1_I.iIPmpRvsChrgCorrnIRestTM2Rich UEGO_CJ135RvsChrgS1B1_I.iPmpRaw UEGO_CJ135RvsChrgS1B1_I.numCaCm UEGO_CJ135RvsChrgS1B1_I.numIPOffOrdCMeas UEGO_CJ135RvsChrgS1B1_I.numIPOffOrdUi23Ui24Meas UEGO_CJ135RvsChrgS1B1_I.numPatOrd UEGO_CJ135RvsChrgS1B1_I.numTrimSqOrd UEGO_CJ135RvsChrgS1B1_I.qC1 UEGO_CJ135RvsChrgS1B1_I.qC2 UEGO_CJ135RvsChrgS1B1_I.ratIPmpAvrg UEGO_CJ135RvsChrgS1B1_I.ratIPmpAvrgOld UEGO_CJ135RvsChrgS1B1_I.ratIPmpAvrgUi21 UEGO_CJ135RvsChrgS1B1_I.tiLstCTrig UEGO_CJ135RvsChrgS1B1_I.tiUi2Intrpn1Pnt UEGO_CJ135RvsChrgS1B1_I.tiUi2Intrpn2Pnt UEGO_CJ135RvsChrgS1B1_I.tiUi2Measd UEGO_CJ135RvsChrgS1B1_I.uDeltaUapeZ1 UEGO_CJ135RvsChrgS1B1_I.uDeltaUapeZ2 UEGO_CJ135RvsChrgS1B1_I.uDeltaUi22Lean UEGO_CJ135RvsChrgS1B1_I.uDeltaUi22ModlnLam1 UEGO_CJ135RvsChrgS1B1_I.uDeltaUi22Rich UEGO_CJ135RvsChrgS1B1_I.uDeltaUi22Spc UEGO_CJ135RvsChrgS1B1_I.uDeltaUi23Lean UEGO_CJ135RvsChrgS1B1_I.uDeltaUi23ModlnLam1 UEGO_CJ135RvsChrgS1B1_I.uDeltaUi23Rich UEGO_CJ135RvsChrgS1B1_I.uDeltaUi23Spc UEGO_CJ135RvsChrgS1B1_I.uDeltaUi24Lean UEGO_CJ135RvsChrgS1B1_I.uDeltaUi24ModlnLam1 UEGO_CJ135RvsChrgS1B1_I.uDeltaUi24Rich UEGO_CJ135RvsChrgS1B1_I.uDeltaUi24Spc UEGO_CJ135RvsChrgS1B1_I.uMatrxA11 UEGO_CJ135RvsChrgS1B1_I.uMatrxA12 UEGO_CJ135RvsChrgS1B1_I.uMatrxA21 UEGO_CJ135RvsChrgS1B1_I.uMatrxA22 UEGO_CJ135RvsChrgS1B1_I.uUape0Z1 UEGO_CJ135RvsChrgS1B1_I.uUape0Z2 UEGO_CJ135RvsChrgS1B1_I.uUi2Intrpn UEGO_CJ135RvsChrgS1B1_I.uUi2Intrpn1Pnt UEGO_CJ135RvsChrgS1B1_I.uUi2Intrpn2Pnt UEGO_CJ135RvsChrgS1B1_I.uUi2IntrpnDelta UEGO_CJ135RvsChrgS1B1_I.uUp0LstUpZ1RvsChrg UEGO_CJ135RvsChrgS1B1_I.uUp0RawC5 UEGO_CJ135RvsChrgS1B1_I.FltuUapeZ1ElecCorDL_I.memory UEGO_CJ135RvsChrgS1B1_I.FltuUapeZ2ElecCorDL_I.memory UEGO_CJ135RvsChrgS1B1_I.FltuUgiZ1ElecCorDL_I.memory UEGO_CJ135RvsChrgS1B1_I.FltuUgiZ2ElecCorDL_I.memory UEGO_CJ135RvsChrgS1B1_I.UEGO_cpCapeCmesCellDL_I.memory UEGO_CJ135RvsChrgS1B1_I.UEGO_cpCigCellDL_I.memory UEGO_CJ135RvsChrgS1B1_I.UEGO_uDeltaUi22LeanDL_I.memory UEGO_CJ135RvsChrgS1B1_I.UEGO_uDeltaUi22ModlnLam1DL_I.memory UEGO_CJ135RvsChrgS1B1_I.UEGO_uDeltaUi22RichDL_I.memory UEGO_CJ135RvsChrgS1B1_I.UEGO_uDeltaUi22SpcDL_I.memory UEGO_CJ135RvsChrgS1B1_I.UEGO_uDeltaUi23LeanDL_I.memory UEGO_CJ135RvsChrgS1B1_I.UEGO_uDeltaUi23ModlnLam1DL_I.memory UEGO_CJ135RvsChrgS1B1_I.UEGO_uDeltaUi23RichDL_I.memory UEGO_CJ135RvsChrgS1B1_I.UEGO_uDeltaUi23SpcDL_I.memory UEGO_CJ135RvsChrgS1B1_I.UEGO_uDeltaUi24LeanDL_I.memory UEGO_CJ135RvsChrgS1B1_I.UEGO_uDeltaUi24ModlnLam1DL_I.memory UEGO_CJ135RvsChrgS1B1_I.UEGO_uDeltaUi24RichDL_I.memory UEGO_CJ135RvsChrgS1B1_I.UEGO_uDeltaUi24SpcDL_I.memory UEGO_CJ135RvsChrgS1B1_I.flgCpCalcdTONV_I.outbit UEGO_CJ135RvsChrgS1B1_I.flgCpCalcdTONV_I.time UEGO_CJ135RvsChrgS1B1_I.flgRegRdyCpCalcTOFFV_I.outbit UEGO_CJ135RvsChrgS1B1_I.flgRegRdyCpCalcTOFFV_I.time UEGO_CJ135RvsChrgS1B1_I.flgRegRdyDeltaUiAllTOFFV_I.outbit UEGO_CJ135RvsChrgS1B1_I.flgRegRdyDeltaUiAllTOFFV_I.time UEGO_CJ135RvsChrgS1B1_I.flgUiAllMeasLam1TOFFV_I.outbit UEGO_CJ135RvsChrgS1B1_I.flgUiAllMeasLam1TOFFV_I.time UEGO_CJ135RvsChrgS1B1_I.flgUiAllMeasLam1_TONV_I.outbit UEGO_CJ135RvsChrgS1B1_I.flgUiAllMeasLam1_TONV_I.time UEGO_CJ135RvsChrgS1B1_I.flgUiAllMeasLeanTOFFV_I.outbit UEGO_CJ135RvsChrgS1B1_I.flgUiAllMeasLeanTOFFV_I.time UEGO_CJ135RvsChrgS1B1_I.flgUiAllMeasLeanTONV_I.outbit UEGO_CJ135RvsChrgS1B1_I.flgUiAllMeasLeanTONV_I.time UEGO_CJ135RvsChrgS1B1_I.flgUiAllMeasRichTOFFV_I.outbit UEGO_CJ135RvsChrgS1B1_I.flgUiAllMeasRichTOFFV_I.time UEGO_CJ135RvsChrgS1B1_I.flgUiAllMeasRich_TONV_I.outbit UEGO_CJ135RvsChrgS1B1_I.flgUiAllMeasRich_TONV_I.time UEGO_CJ135RvsChrgS1B1_I.flgUiAllMeasSpcTOFFV_I.outbit UEGO_CJ135RvsChrgS1B1_I.flgUiAllMeasSpcTOFFV_I.time UEGO_CJ135RvsChrgS1B1_I.flgUiAllMeasSpc_TONV_I.outbit UEGO_CJ135RvsChrgS1B1_I.flgUiAllMeasSpc_TONV_I.time UEGO_CJ135RvsChrgS1B1_I.flgUiAllMeasTOFFV_I.outbit UEGO_CJ135RvsChrgS1B1_I.flgUiAllMeasTOFFV_I.time UEGO_CJ135RvsChrgS1B1_I.flgUiAllMeasTONV_I.outbit UEGO_CJ135RvsChrgS1B1_I.flgUiAllMeasTONV_I.time UEGO_CJ135RvsChrgS1B1_I.iIPmpRawDL_I.memory UEGO_CJ135RvsChrgS1B1_I.uUp0Z0FltDL_I.memory UEGO_CJ135RvsChrgS1B1_I.uUp0Z1FltDL_I.memory UEGO_CJ135RvsChrgS1B1_I.uUp0Z2FltDL_I.memory UEGO_flgCpCalcdS1B1 UEGO_flgDeltaUiAllMeasdS1B1 UEGO_flgFIdCJ135RvsChrgReldS1B1 UEGO_flgFIdCJ135RvsChrgReldS1B1TONV_I.outbit UEGO_flgFIdCJ135RvsChrgReldS1B1TONV_I.time UEGO_flgRvsChrgAdpnNEngReld UEGO_flgRvsChrgLoBattReld /end LOC_MEASUREMENT
 FUNCTION_VERSION "2.7.0" /end FUNCTION
/begin FUNCTION UEGO_CJ135WireEvln "1.3.0     Evaluation of Wire Data of CJ135 by UEGO" /begin DEF_CHARACTERISTIC UEGO_uUgxxDeltaMaxIni_C /end DEF_CHARACTERISTIC /begin REF_CHARACTERISTIC UEGO_idxHWES1B1_C /end REF_CHARACTERISTIC
 /begin IN_MEASUREMENT UEGO_CJ135CalcElecCorrnS1B1.flgFKal1Strtd UEGO_CJ135CalcElecCorrnS1B1.flgFKal2Strtd UEGO_CJ135CalcElecCorrnS1B1.flgFKal3Strtd UEGO_CJ135CalcElecCorrnS1B1.flgnCmnMod1Strtd UEGO_CJ135CalcElecCorrnS1B1.flgnCmnMod2Strtd UEGO_CJ135CalcElecCorrnS1B1.flgnumUref22Strtd UEGO_CJ135CalcElecCorrnS1B1.numUref1Corrd UEGO_CJ135CalcElecCorrnS1B1.numUref21Corrd UEGO_CJ135CalcElecCorrnS1B1.numUref22Corrd UEGO_CJ135CalcElecCorrnS1B1.numUref3Corrd UEGO_CJ135CalcElecCorrnS1B1.uCmnMod1 UEGO_CJ135CalcElecCorrnS1B1.uCmnMod2 UEGO_CJ135CalcElecCorrnS1B1.uVCC1Corrd UEGO_CJ135CalcElecCorrnS1B1.uVCC3MeasRef UEGO_CJ135CalcElecCorrnS1B1.uFkal1Flt_DL_I.memory UEGO_CJ135CalcElecCorrnS1B1.uFkal2Flt_DL_I.memory UEGO_CJ135CalcElecCorrnS1B1.uFkal3Flt_DL_I.memory UEGO_flgNewPckS1B1 UEGO_flgNewPckVldS1B1 UEGO_flgWireDataRstReqS1B1 UEGO_idxTypS1B1 /end IN_MEASUREMENT
 /begin OUT_MEASUREMENT UEGO_numRamFailPosnS1B1 UEGO_numRamSts2S1B1 UEGO_numRamSts3S1B1 UEGO_uDeltaUg0aS1B1 UEGO_uDeltaUg0eS1B1 UEGO_uDeltaUg0iaiS1B1 UEGO_uDeltaUg0ieiS1B1 UEGO_uDeltaUg0iS1B1 UEGO_uDeltaUgaS1B1 UEGO_uDeltaUgiS1B1 /end OUT_MEASUREMENT
 /begin LOC_MEASUREMENT UEGO_CJ135WireEvlnClassS1B1_I.numRamFailPosn UEGO_CJ135WireEvlnClassS1B1_I.numRamSts2 UEGO_CJ135WireEvlnClassS1B1_I.numRamSts3 UEGO_CJ135WireEvlnClassS1B1_I.uDeltaUg0a UEGO_CJ135WireEvlnClassS1B1_I.uDeltaUg0e UEGO_CJ135WireEvlnClassS1B1_I.uDeltaUg0i UEGO_CJ135WireEvlnClassS1B1_I.uDeltaUg0iai UEGO_CJ135WireEvlnClassS1B1_I.uDeltaUg0iei UEGO_CJ135WireEvlnClassS1B1_I.uDeltaUga UEGO_CJ135WireEvlnClassS1B1_I.uDeltaUgi UEGO_CJ135WireEvlnClassS1B1_I.Ug0aPeakFil_I.flgFilStrtd UEGO_CJ135WireEvlnClassS1B1_I.Ug0aPeakFil_I.uDeltaInOutpMax UEGO_CJ135WireEvlnClassS1B1_I.Ug0ePeakFil_I.flgFilStrtd UEGO_CJ135WireEvlnClassS1B1_I.Ug0ePeakFil_I.uDeltaInOutpMax UEGO_CJ135WireEvlnClassS1B1_I.Ug0iPeakFil_I.flgFilStrtd UEGO_CJ135WireEvlnClassS1B1_I.Ug0iPeakFil_I.uDeltaInOutpMax UEGO_CJ135WireEvlnClassS1B1_I.Ug0iaiPeakFil_I.flgFilStrtd UEGO_CJ135WireEvlnClassS1B1_I.Ug0iaiPeakFil_I.uDeltaInOutpMax UEGO_CJ135WireEvlnClassS1B1_I.Ug0ieiPeakFil_I.flgFilStrtd UEGO_CJ135WireEvlnClassS1B1_I.Ug0ieiPeakFil_I.uDeltaInOutpMax UEGO_CJ135WireEvlnClassS1B1_I.UgaPeakFil_I.flgFilStrtd UEGO_CJ135WireEvlnClassS1B1_I.UgaPeakFil_I.uDeltaInOutpMax UEGO_CJ135WireEvlnClassS1B1_I.UgiPeakFil_I.flgFilStrtd UEGO_CJ135WireEvlnClassS1B1_I.UgiPeakFil_I.uDeltaInOutpMax /end LOC_MEASUREMENT
 FUNCTION_VERSION "1.3.0" /end FUNCTION
/begin FUNCTION UEGO_DiagRels "2.4.0     Operation Release for UEGO sensor diagnosis"
 /begin DEF_CHARACTERISTIC UEGO_tiDlyUBattNorm_C UEGO_stOperLoBatt_C UEGO_tiDlyUBattMin_C UEGO_uBattMax_C UEGO_uBattMin_C UEGO_uBattSuff_C /end DEF_CHARACTERISTIC
 /begin IN_MEASUREMENT BattU_u B_evloc_msg SyC_ctPostDrvLeave UEGO_idxTypS1B1 /end IN_MEASUREMENT
 /begin OUT_MEASUREMENT UEGO_flgAllVlvActv UEGO_flgDiagRprtRelsS1B1 UEGO_flgDsmTripChgFinshd UEGO_flgUBattMax UEGO_flgUBattMin UEGO_flgUBattSuff /end OUT_MEASUREMENT
 /begin LOC_MEASUREMENT UEGO_DiagRelsClsS1B1_I.cntrReiniProc10msec UEGO_DiagRelsClsS1B1_I.flgUBattMinTurnOffDly UEGO_DiagRelsClsS1B1_I.flgUBattMinTOFFVNM_I.time UEGO_DiagRelsClsS1B1_I.flgUBattNormTOFFVNM_I.time UEGO_DiagRels_cntrReiniProc10msec /end LOC_MEASUREMENT
 FUNCTION_VERSION "2.4.0" /end FUNCTION
/begin FUNCTION UEGO_Eng "2.6.0     Status of the Engine and the ECU"
 /begin DEF_CHARACTERISTIC UEGO_EngClassS1B1_I.stEng_C UEGO_nEngHysFilSync_C UEGO_nFilSyncActvMax_C UEGO_nFilSyncActvMin_C UEGO_stEngAndEcuRelsMask_C UEGO_tiDlyEngRunng_C UEGO_tiStEngStop_C /end DEF_CHARACTERISTIC
 /begin IN_MEASUREMENT B_stopeng_msg B_stopping_msg CoEng_st Epm_nEng SyC_ctPostDrvLeave SyC_stSub UEGO_idxTypS1B1 UEGO_tEgFldS1B1 /end IN_MEASUREMENT
 /begin OUT_MEASUREMENT UEGO_flgAirScav UEGO_flgCmbEngTmpStop UEGO_flgEngActvStsS1B1 UEGO_flgEngAndEcuSt UEGO_flgEngCrk UEGO_flgEngRunng UEGO_flgEngStopPha UEGO_flgEngStopPhaRaw UEGO_flgEomAftRun UEGO_flgIPmpFilSyncActv /end OUT_MEASUREMENT
 /begin LOC_MEASUREMENT UEGO_EngClassS1B1_I.flgEngActv UEGO_EngClassS1B1_I.flgEngActvSts UEGO_Eng_cntrReiniProc10msec UEGO_flgEngStopTOFFVNM_I.time UEGO_stEngAndEcu UEGO_tiDlyEngRunngTOFFVNM_I.time /end LOC_MEASUREMENT
 FUNCTION_VERSION "2.6.0" /end FUNCTION
/begin FUNCTION UEGO_Exh "2.0.0     Properties of exhaust gas"
 /begin IN_MEASUREMENT ExhMod_mfExhB1 ExhMod_tExhS1B1 ExhMod_tWallS1B1 UEGO_idxTypS1B1 /end IN_MEASUREMENT
 /begin OUT_MEASUREMENT UEGO_mEgFlowS1B1 UEGO_tEgFldS1B1 UEGO_tEgMdlS1B1 UEGO_tWallMdlS1B1 /end OUT_MEASUREMENT
 /begin LOC_MEASUREMENT UEGO_ExhS1B1_I.mEgFlow UEGO_ExhS1B1_I.tEgFld UEGO_ExhS1B1_I.tEgMdl UEGO_ExhS1B1_I.tWallMdl /end LOC_MEASUREMENT
 FUNCTION_VERSION "2.0.0" /end FUNCTION
/begin FUNCTION UEGO_HeatrRlyPsCtrl "1.2.0     UEGO Control Relay for Heater of Lambda Sensor"
 /begin DEF_CHARACTERISTIC UEGO_stHeatrRlyDeactvn_C UEGO_swtHeatrRlyOffT15Off_C UEGO_tiDlyHeatrRlyOn_C /end DEF_CHARACTERISTIC
 /begin IN_MEASUREMENT DevLib_stPwrStgEnaCond MRly_st SyC_stPreDrv T15_st UEGO_idxTypS1B1 /end IN_MEASUREMENT
 /begin OUT_MEASUREMENT UEGO_flgHeatrRlyActvS1B1 /end OUT_MEASUREMENT
 /begin LOC_MEASUREMENT UEGO_HeatrRlyPSCtrlS1B1_I.flgHeatrRlyActv /end LOC_MEASUREMENT
 FUNCTION_VERSION "1.2.0" /end FUNCTION
/begin FUNCTION UEGO_HeatrRlyPsDiag "1.1.0     UEGO Diagnosis Relay for Heater of Lambda Sensor"
 /begin DEF_CHARACTERISTIC UEGO_stHeatrRlyPsDiagDeactvn_C UEGO_swtHeatrRlyPsTestPlsMod_C UEGO_uHeatrRlyPsTestPlsRels_C UEGO_nrTstPlsHeatrRly_C UEGO_stHeatrRlyPsDiag_C UEGO_tiBtwElecFltHeatrRly_C UEGO_tiBtwOTFltHeatrRly_C /end DEF_CHARACTERISTIC
 /begin IN_MEASUREMENT BattU_u DevLib_stPwrStgEnaCond UEGO_idxTypS1B1 /end IN_MEASUREMENT
 /begin LOC_MEASUREMENT UEGO_HeatrRlyPsDiagS1B1_I.cntrTestPls UEGO_HeatrRlyPsDiagS1B1_I.flgDSMClrReq UEGO_HeatrRlyPsDiagS1B1_I.flgRlyDiagRels UEGO_HeatrRlyPsDiagS1B1_I.flgRlyErrOL UEGO_HeatrRlyPsDiagS1B1_I.flgRlyErrSCB UEGO_HeatrRlyPsDiagS1B1_I.flgRlyErrSCG UEGO_HeatrRlyPsDiagS1B1_I.flgRlyIniEnd /end LOC_MEASUREMENT
 FUNCTION_VERSION "1.1.0" /end FUNCTION
/begin COMPU_METHOD ASCET_9_RvsChrg "" RAT_FUNC "%17.16" "" COEFFS 0 65536 0 0 0 1e-010 /end COMPU_METHOD
/begin COMPU_METHOD B_TRUE "" TAB_VERB "%6.3" "" COMPU_TAB_REF B_TRUE /end COMPU_METHOD
/begin COMPU_VTAB B_TRUE "" TAB_VERB 2 0 "FALSE" 1 "TRUE" /end COMPU_VTAB
/begin COMPU_METHOD dez "" RAT_FUNC "%6.2" "" COEFFS 0 1 0 0 0 1 /end COMPU_METHOD
/begin COMPU_METHOD EngN "" RAT_FUNC "%6.3" "rpm" COEFFS 0 2 0 0 0 1 /end COMPU_METHOD
/begin COMPU_METHOD fak_q0p000244 "" RAT_FUNC "%6.5" "-" COEFFS 0 65536 0 0 0 16 /end COMPU_METHOD
/begin COMPU_METHOD fak_q0p2384em5 "" RAT_FUNC "%8.7" "-" COEFFS 0 4294967296 0 0 0 10240 /end COMPU_METHOD
/begin COMPU_METHOD fak_q1p201Em4 "" RAT_FUNC "%6.5" "-" COEFFS 0 8325 0 0 0 1 /end COMPU_METHOD
/begin COMPU_METHOD fak_q3p72529Em9 "" RAT_FUNC "%11.10" "" COEFFS 0 268435456 0 0 0 1 /end COMPU_METHOD
/begin COMPU_METHOD fak_uw_b1 "" RAT_FUNC "%7.6" "-" COEFFS 0 65536 0 0 0 1 /end COMPU_METHOD
/begin COMPU_METHOD fak_uw_b2 "" RAT_FUNC "%7.6" "-" COEFFS 0 65536 0 0 0 2 /end COMPU_METHOD
/begin COMPU_METHOD g_q1p6667Em7_S "" RAT_FUNC "%9.8" "s" COEFFS 0 6000000 0 0 0 1 /end COMPU_METHOD
/begin COMPU_METHOD i_q1p01725Em11_A "" RAT_FUNC "%13.12" "A" COEFFS 0 98304 0 0 0 1e-006 /end COMPU_METHOD
/begin COMPU_METHOD i_q1p25Em4_o0p004_A "" RAT_FUNC "%6.5" "A" COEFFS 0 1000000 -4000 0 0 125 /end COMPU_METHOD
/begin COMPU_METHOD i_q6p6667Em7_A "" RAT_FUNC "%9.8" "A" COEFFS 0 1500000 0 0 0 1 /end COMPU_METHOD
/begin COMPU_METHOD m_uw_b6553p5 "" RAT_FUNC "%6.3" "kg/h" COEFFS 0 1 0 0 0 0.1 /end COMPU_METHOD
/begin COMPU_METHOD OneToOne "" RAT_FUNC "%6.2" "-" COEFFS 0 1 0 0 0 1 /end COMPU_METHOD
/begin COMPU_METHOD q0p00032_V2 "" RAT_FUNC "%6.5" "V^2" COEFFS 0 1 0 0 0 0.00032 /end COMPU_METHOD
/begin COMPU_METHOD q1Em10_F "" RAT_FUNC "%13.12" "F" COEFFS 0 100000 0 0 0 1e-005 /end COMPU_METHOD
/begin COMPU_METHOD q1Em12_A_s "" RAT_FUNC "%15.14" "A*s" COEFFS 0 1000000 0 0 0 1e-006 /end COMPU_METHOD
/begin COMPU_METHOD r_q0p0391 "" RAT_FUNC "%6.4" "Ohm" COEFFS 0 65536 0 0 0 2560 /end COMPU_METHOD
/begin COMPU_METHOD r_q0p1_Ohm "" RAT_FUNC "%6.3" "Ohm" COEFFS 0 10 0 0 0 1 /end COMPU_METHOD
/begin COMPU_METHOD r_q1p5259Em6_Ohm "" RAT_FUNC "%8.7" "Ohm" COEFFS 0 655360 0 0 0 1 /end COMPU_METHOD
/begin COMPU_METHOD spg_q3p2Em4_V "" RAT_FUNC "%6.5" "V" COEFFS 0 32768 0 0 0 10.48576 /end COMPU_METHOD
/begin COMPU_METHOD spg_q4p883Em9_V "" RAT_FUNC "%11.10" "V" COEFFS 0 204800000 0 0 0 1 /end COMPU_METHOD
/begin COMPU_METHOD Temp_Cels "" RAT_FUNC "%6.1" "deg C" COEFFS 0 10 2731.4 0 0 1 /end COMPU_METHOD
/begin COMPU_METHOD temp_q0p0234_o273 "" RAT_FUNC "%6.1" "Grad C" COEFFS 0 1 273.15 0 0 0.0234375 /end COMPU_METHOD
/begin COMPU_METHOD Time_ms "" RAT_FUNC "%6.1" "ms" COEFFS 0 0.1 0 0 0 1 /end COMPU_METHOD
/begin COMPU_METHOD Time_s "" RAT_FUNC "%6.4" "s" COEFFS 0 100 0 0 0 1 /end COMPU_METHOD
/begin COMPU_METHOD t_q0p000001_s "" RAT_FUNC "%9.8" "s" COEFFS 0 1000000 0 0 0 1 /end COMPU_METHOD
/begin COMPU_METHOD t_q0p005 "" RAT_FUNC "%6.4" "s" COEFFS 0 1000 0 0 0 5 /end COMPU_METHOD
/begin COMPU_METHOD t_q0p01 "" RAT_FUNC "%6.4" "s" COEFFS 0 100 0 0 0 1 /end COMPU_METHOD
/begin COMPU_METHOD UEGO_DATAVISLSU51_SC_Compu "" TAB_VERB "%6.3" "" COMPU_TAB_REF UEGO_DATAVISLSU51_SC_Compu /end COMPU_METHOD
/begin COMPU_VTAB UEGO_DATAVISLSU51_SC_Compu "" TAB_VERB 2 0 "Invisible" 1 "Visible" /end COMPU_VTAB
/begin COMPU_METHOD UEGO_DATAVISLSU52_SC_Compu "" TAB_VERB "%6.3" "" COMPU_TAB_REF UEGO_DATAVISLSU52_SC_Compu /end COMPU_METHOD
/begin COMPU_VTAB UEGO_DATAVISLSU52_SC_Compu "" TAB_VERB 2 0 "Invisible" 1 "Visible" /end COMPU_VTAB
/begin COMPU_METHOD UEGO_DATAVISLSUADV_SC_Compu "" TAB_VERB "%6.3" "" COMPU_TAB_REF UEGO_DATAVISLSUADV_SC_Compu /end COMPU_METHOD
/begin COMPU_VTAB UEGO_DATAVISLSUADV_SC_Compu "" TAB_VERB 2 0 "Invisible" 1 "Visible" /end COMPU_VTAB
/begin COMPU_METHOD UEGO_DATAVISNORCMPPRSNT_SC_Compu "" TAB_VERB "%6.3" "" COMPU_TAB_REF UEGO_DATAVISNORCMPPRSNT_SC_Compu /end COMPU_METHOD
/begin COMPU_VTAB UEGO_DATAVISNORCMPPRSNT_SC_Compu "" TAB_VERB 2 0 "invisible" 1 "visible" /end COMPU_VTAB
/begin COMPU_METHOD UEGO_DATAVISNTKZFASU2_SC_Compu "" TAB_VERB "%6.3" "" COMPU_TAB_REF UEGO_DATAVISNTKZFASU2_SC_Compu /end COMPU_METHOD
/begin COMPU_VTAB UEGO_DATAVISNTKZFASU2_SC_Compu "" TAB_VERB 2 0 "Invisible" 1 "Visible" /end COMPU_VTAB
/begin COMPU_METHOD UEGO_DATAVISNTKZFASU3_SC_Compu "" TAB_VERB "%6.3" "" COMPU_TAB_REF UEGO_DATAVISNTKZFASU3_SC_Compu /end COMPU_METHOD
/begin COMPU_VTAB UEGO_DATAVISNTKZFASU3_SC_Compu "" TAB_VERB 2 0 "Invisible" 1 "Visible" /end COMPU_VTAB
/begin COMPU_METHOD UEGO_DATAVISRCMPPRSNT_SC_Compu "" TAB_VERB "%6.3" "" COMPU_TAB_REF UEGO_DATAVISRCMPPRSNT_SC_Compu /end COMPU_METHOD
/begin COMPU_VTAB UEGO_DATAVISRCMPPRSNT_SC_Compu "" TAB_VERB 2 0 "Invisible" 1 "visible" /end COMPU_VTAB
/begin COMPU_METHOD UEGO_DDYPAR_SY_Compu "" TAB_VERB "%6.3" "" COMPU_TAB_REF UEGO_DDYPAR_SY_Compu /end COMPU_METHOD
/begin COMPU_VTAB UEGO_DDYPAR_SY_Compu "" TAB_VERB 2 0 "False" 1 "True" /end COMPU_VTAB
/begin COMPU_METHOD UEGO_DGSCMNDRVR_SC_Compu "" TAB_VERB "%6.3" "" COMPU_TAB_REF UEGO_DGSCMNDRVR_SC_Compu /end COMPU_METHOD
/begin COMPU_VTAB UEGO_DGSCMNDRVR_SC_Compu "" TAB_VERB 2 0 "False" 1 "True" /end COMPU_VTAB
/begin COMPU_METHOD UEGO_DIAGHTRCPL_SY_Compu "" TAB_VERB "%6.3" "" COMPU_TAB_REF UEGO_DIAGHTRCPL_SY_Compu /end COMPU_METHOD
/begin COMPU_VTAB UEGO_DIAGHTRCPL_SY_Compu "" TAB_VERB 2 0 "False" 1 "True" /end COMPU_VTAB
/begin COMPU_METHOD UEGO_DYNERRSIMNENA_SC_Compu "" TAB_VERB "%6.3" "" COMPU_TAB_REF UEGO_DYNERRSIMNENA_SC_Compu /end COMPU_METHOD
/begin COMPU_VTAB UEGO_DYNERRSIMNENA_SC_Compu "" TAB_VERB 2 0 "False" 1 "True" /end COMPU_VTAB
/begin COMPU_METHOD UEGO_DYNOPERPNTREQ_SC_Compu "" TAB_VERB "%6.3" "" COMPU_TAB_REF UEGO_DYNOPERPNTREQ_SC_Compu /end COMPU_METHOD
/begin COMPU_VTAB UEGO_DYNOPERPNTREQ_SC_Compu "" TAB_VERB 2 0 "False" 1 "True" /end COMPU_VTAB
/begin COMPU_METHOD UEGO_ENALAMPENVCORRD_SC_Compu "" TAB_VERB "%6.3" "" COMPU_TAB_REF UEGO_ENALAMPENVCORRD_SC_Compu /end COMPU_METHOD
/begin COMPU_VTAB UEGO_ENALAMPENVCORRD_SC_Compu "" TAB_VERB 2 0 "False" 1 "True" /end COMPU_VTAB
/begin COMPU_METHOD UEGO_ENHDSCAVCORRN_SC_Compu "" TAB_VERB "%6.3" "" COMPU_TAB_REF UEGO_ENHDSCAVCORRN_SC_Compu /end COMPU_METHOD
/begin COMPU_VTAB UEGO_ENHDSCAVCORRN_SC_Compu "" TAB_VERB 2 0 "0" 1 "1" /end COMPU_VTAB
/begin COMPU_METHOD UEGO_HEATGUPEXTD_SC_Compu "" TAB_VERB "%6.3" "" COMPU_TAB_REF UEGO_HEATGUPEXTD_SC_Compu /end COMPU_METHOD
/begin COMPU_VTAB UEGO_HEATGUPEXTD_SC_Compu "" TAB_VERB 2 0 "False" 1 "True" /end COMPU_VTAB
/begin COMPU_METHOD UEGO_HEATRFCTENA_SC_Compu "" TAB_VERB "%6.3" "" COMPU_TAB_REF UEGO_HEATRFCTENA_SC_Compu /end COMPU_METHOD
/begin COMPU_VTAB UEGO_HEATRFCTENA_SC_Compu "" TAB_VERB 2 0 "False" 1 "True" /end COMPU_VTAB
/begin COMPU_METHOD UEGO_HEATRRLY_SC_Compu "" TAB_VERB "%6.3" "" COMPU_TAB_REF UEGO_HEATRRLY_SC_Compu /end COMPU_METHOD
/begin COMPU_VTAB UEGO_HEATRRLY_SC_Compu "" TAB_VERB 2 0 "False" 1 "True" /end COMPU_VTAB
/begin COMPU_METHOD UEGO_ICS1B1_SY_Compu "" TAB_VERB "%6.3" "" COMPU_TAB_REF UEGO_ICS1B1_SY_Compu /end COMPU_METHOD
/begin COMPU_VTAB UEGO_ICS1B1_SY_Compu "" TAB_VERB 3 0 "0" 1 "1" 2 "2" /end COMPU_VTAB
/begin COMPU_METHOD UEGO_ICS1B2_SY_Compu "" TAB_VERB "%6.3" "" COMPU_TAB_REF UEGO_ICS1B2_SY_Compu /end COMPU_METHOD
/begin COMPU_VTAB UEGO_ICS1B2_SY_Compu "" TAB_VERB 3 0 "0" 1 "1" 2 "2" /end COMPU_VTAB
/begin COMPU_METHOD UEGO_ICS2B1_SY_Compu "" TAB_VERB "%6.3" "" COMPU_TAB_REF UEGO_ICS2B1_SY_Compu /end COMPU_METHOD
/begin COMPU_VTAB UEGO_ICS2B1_SY_Compu "" TAB_VERB 3 0 "0" 1 "1" 2 "2" /end COMPU_VTAB
/begin COMPU_METHOD UEGO_ICS2B2_SY_Compu "" TAB_VERB "%6.3" "" COMPU_TAB_REF UEGO_ICS2B2_SY_Compu /end COMPU_METHOD
/begin COMPU_VTAB UEGO_ICS2B2_SY_Compu "" TAB_VERB 3 0 "0" 1 "1" 2 "2" /end COMPU_VTAB
/begin COMPU_METHOD UEGO_ICS3B1_SY_Compu "" TAB_VERB "%6.3" "" COMPU_TAB_REF UEGO_ICS3B1_SY_Compu /end COMPU_METHOD
/begin COMPU_VTAB UEGO_ICS3B1_SY_Compu "" TAB_VERB 3 0 "0" 1 "1" 2 "2" /end COMPU_VTAB
/begin COMPU_METHOD UEGO_ICS3B2_SY_Compu "" TAB_VERB "%6.3" "" COMPU_TAB_REF UEGO_ICS3B2_SY_Compu /end COMPU_METHOD
/begin COMPU_VTAB UEGO_ICS3B2_SY_Compu "" TAB_VERB 3 0 "0" 1 "1" 2 "2" /end COMPU_VTAB
/begin COMPU_METHOD UEGO_NREOMMASKSIZE_SC_Compu "" RAT_FUNC "%6.2" "" COEFFS 0 1 0 0 0 1 /end COMPU_METHOD
/begin COMPU_METHOD UEGO_O2LAMFCTENA_SC_Compu "" TAB_VERB "%6.3" "" COMPU_TAB_REF UEGO_O2LAMFCTENA_SC_Compu /end COMPU_METHOD
/begin COMPU_VTAB UEGO_O2LAMFCTENA_SC_Compu "" TAB_VERB 2 0 "False" 1 "True" /end COMPU_VTAB
/begin COMPU_METHOD UEGO_O2MDLENA_SC_Compu "" TAB_VERB "%6.3" "" COMPU_TAB_REF UEGO_O2MDLENA_SC_Compu /end COMPU_METHOD
/begin COMPU_VTAB UEGO_O2MDLENA_SC_Compu "" TAB_VERB 2 0 "Deactivate" 1 "Activate" /end COMPU_VTAB
/begin COMPU_METHOD UEGO_OLRCMPDSTCN_SC_Compu "" TAB_VERB "%6.3" "" COMPU_TAB_REF UEGO_OLRCMPDSTCN_SC_Compu /end COMPU_METHOD
/begin COMPU_VTAB UEGO_OLRCMPDSTCN_SC_Compu "" TAB_VERB 2 0 "False" 1 "True" /end COMPU_VTAB
/begin COMPU_METHOD UEGO_OPERELECTCFCT_SC_Compu "" TAB_VERB "%6.3" "" COMPU_TAB_REF UEGO_OPERELECTCFCT_SC_Compu /end COMPU_METHOD
/begin COMPU_VTAB UEGO_OPERELECTCFCT_SC_Compu "" TAB_VERB 2 0 "False" 1 "True" /end COMPU_VTAB
/begin COMPU_METHOD UEGO_PLAUSOPERPNTREQ_SC_Compu "" TAB_VERB "%6.3" "" COMPU_TAB_REF UEGO_PLAUSOPERPNTREQ_SC_Compu /end COMPU_METHOD
/begin COMPU_VTAB UEGO_PLAUSOPERPNTREQ_SC_Compu "" TAB_VERB 2 0 "False" 1 "True" /end COMPU_VTAB
/begin COMPU_METHOD Volt_Batt "" RAT_FUNC "%6.1" "mV" COEFFS 0 0.05 0 0 0 1 /end COMPU_METHOD
/begin RECORD_LAYOUT RB_Curve_S16_S16 NO_AXIS_PTS_X 1 SWORD AXIS_PTS_X 2 SWORD INDEX_INCR DIRECT FNC_VALUES 3 SWORD COLUMN_DIR DIRECT /end RECORD_LAYOUT
/begin RECORD_LAYOUT RB_Curve_U16_S16_Static NO_AXIS_PTS_X 1 UWORD AXIS_PTS_X 2 UWORD INDEX_INCR DIRECT FNC_VALUES 3 SWORD COLUMN_DIR DIRECT STATIC_RECORD_LAYOUT /end RECORD_LAYOUT
/begin RECORD_LAYOUT RB_Curve_U16_U16 NO_AXIS_PTS_X 1 UWORD AXIS_PTS_X 2 UWORD INDEX_INCR DIRECT FNC_VALUES 3 UWORD COLUMN_DIR DIRECT /end RECORD_LAYOUT
/begin RECORD_LAYOUT RB_Curve_U8_U8 NO_AXIS_PTS_X 1 UBYTE AXIS_PTS_X 2 UBYTE INDEX_INCR DIRECT FNC_VALUES 3 UBYTE COLUMN_DIR DIRECT /end RECORD_LAYOUT
/begin RECORD_LAYOUT RB_Val_Ws16 FNC_VALUES 1 SWORD COLUMN_DIR DIRECT /end RECORD_LAYOUT
/begin RECORD_LAYOUT RB_Val_Wu16 FNC_VALUES 1 UWORD COLUMN_DIR DIRECT /end RECORD_LAYOUT
/begin RECORD_LAYOUT RB_Val_Wu32 FNC_VALUES 1 ULONG COLUMN_DIR DIRECT /end RECORD_LAYOUT
/begin RECORD_LAYOUT RB_Val_Wu8 FNC_VALUES 1 UBYTE COLUMN_DIR DIRECT /end RECORD_LAYOUT
/end MODULE
/end PROJECT
