ASAP2_VERSION 1 60
/begin PROJECT MG1CA020 "MG1CA020"
/begin HEADER "" VERSION "MG1CA020_6SAY_V011_TPROT" PROJECT_NO MG1CA020 /end HEADER
/begin MODULE DIM ""
/begin MOD_COMMON "" BYTE_ORDER MSB_LAST ALIGNMENT_BYTE 1 ALIGNMENT_WORD 2 ALIGNMENT_LONG 4 ALIGNMENT_INT64 4 ALIGNMENT_FLOAT32_IEEE 4 ALIGNMENT_FLOAT64_IEEE 4 DATA_SIZE 32 /end MOD_COMMON
/begin MEASUREMENT DFC_b.LDF_ComIDASBRingCnt "Bit encoding / Last debounced flag bit for check DFC_ComIDASBRingCnt" UBYTE DFC_OneToOne 1 100 0.00 1.000 BIT_MASK 0x10 FORMAT "%5.3" ECU_ADDRESS 0x60034A76 /end MEASUREMENT
/begin MEASUREMENT DFC_b.LDF_ComIDASBTOut "Bit encoding / Last debounced flag bit for check DFC_ComIDASBTOut" UBYTE DFC_OneToOne 1 100 0.00 1.000 BIT_MASK 0x10 FORMAT "%5.3" ECU_ADDRESS 0x60034A77 /end MEASUREMENT
/begin MEASUREMENT DFC_b.LDF_ComIMGMILReq "Bit encoding / Last debounced flag bit for check DFC_ComIMGMILReq" UBYTE DFC_OneToOne 1 100 0.00 1.000 BIT_MASK 0x10 FORMAT "%5.3" ECU_ADDRESS 0x60034A78 /end MEASUREMENT
/begin MEASUREMENT DFC_b.LDF_ComISSPrms "Bit encoding / Last debounced flag bit for check DFC_ComISSPrms" UBYTE DFC_OneToOne 1 100 0.00 1.000 BIT_MASK 0x10 FORMAT "%5.3" ECU_ADDRESS 0x60034A79 /end MEASUREMENT
/begin MEASUREMENT DFC_b.LDF_ComMETAChksum "Bit encoding / Last debounced flag bit for check DFC_ComMETAChksum" UBYTE DFC_OneToOne 1 100 0.00 1.000 BIT_MASK 0x10 FORMAT "%5.3" ECU_ADDRESS 0x60034A7A /end MEASUREMENT
/begin MEASUREMENT DFC_b.LDF_ComMETARingCnt "Bit encoding / Last debounced flag bit for check DFC_ComMETARingCnt" UBYTE DFC_OneToOne 1 100 0.00 1.000 BIT_MASK 0x10 FORMAT "%5.3" ECU_ADDRESS 0x60034A7B /end MEASUREMENT
/begin MEASUREMENT DFC_b.LDF_ComMETATOut "Bit encoding / Last debounced flag bit for check DFC_ComMETATOut" UBYTE DFC_OneToOne 1 100 0.00 1.000 BIT_MASK 0x10 FORMAT "%5.3" ECU_ADDRESS 0x60034A7C /end MEASUREMENT
/begin MEASUREMENT DFC_b.LDF_ComMETCChksum "Bit encoding / Last debounced flag bit for check DFC_ComMETCChksum" UBYTE DFC_OneToOne 1 100 0.00 1.000 BIT_MASK 0x10 FORMAT "%5.3" ECU_ADDRESS 0x60034A7D /end MEASUREMENT
/begin MEASUREMENT DFC_b.LDF_ComMETCRingCnt "Bit encoding / Last debounced flag bit for check DFC_ComMETCRingCnt" UBYTE DFC_OneToOne 1 100 0.00 1.000 BIT_MASK 0x10 FORMAT "%5.3" ECU_ADDRESS 0x60034A7E /end MEASUREMENT
/begin MEASUREMENT DFC_b.LDF_ComMETCTOut "Bit encoding / Last debounced flag bit for check DFC_ComMETCTOut" UBYTE DFC_OneToOne 1 100 0.00 1.000 BIT_MASK 0x10 FORMAT "%5.3" ECU_ADDRESS 0x60034A7F /end MEASUREMENT
/begin MEASUREMENT DFC_b.LDF_ComMETDChksum "Bit encoding / Last debounced flag bit for check DFC_ComMETDChksum" UBYTE DFC_OneToOne 1 100 0.00 1.000 BIT_MASK 0x10 FORMAT "%5.3" ECU_ADDRESS 0x60034A80 /end MEASUREMENT
/begin MEASUREMENT DFC_b.LDF_ComMETDRingCnt "Bit encoding / Last debounced flag bit for check DFC_ComMETDRingCnt" UBYTE DFC_OneToOne 1 100 0.00 1.000 BIT_MASK 0x10 FORMAT "%5.3" ECU_ADDRESS 0x60034A81 /end MEASUREMENT
/begin MEASUREMENT DFC_b.LDF_ComMETDTOut "Bit encoding / Last debounced flag bit for check DFC_ComMETDTOut" UBYTE DFC_OneToOne 1 100 0.00 1.000 BIT_MASK 0x10 FORMAT "%5.3" ECU_ADDRESS 0x60034A82 /end MEASUREMENT
/begin MEASUREMENT DFC_b.LDF_ComMETE2Chksum "Bit encoding / Last debounced flag bit for check DFC_ComMETE2Chksum" UBYTE DFC_OneToOne 1 100 0.00 1.000 BIT_MASK 0x10 FORMAT "%5.3" ECU_ADDRESS 0x60034A83 /end MEASUREMENT
/begin MEASUREMENT DFC_b.LDF_ComMETE2RingCnt "Bit encoding / Last debounced flag bit for check DFC_ComMETE2RingCnt" UBYTE DFC_OneToOne 1 100 0.00 1.000 BIT_MASK 0x10 FORMAT "%5.3" ECU_ADDRESS 0x60034A84 /end MEASUREMENT
/begin MEASUREMENT DFC_b.LDF_ComMETE2TOut "Bit encoding / Last debounced flag bit for check DFC_ComMETE2TOut" UBYTE DFC_OneToOne 1 100 0.00 1.000 BIT_MASK 0x10 FORMAT "%5.3" ECU_ADDRESS 0x60034A85 /end MEASUREMENT
/begin MEASUREMENT DFC_b.LDF_ComMETFChksum "Bit encoding / Last debounced flag bit for check DFC_ComMETFChksum" UBYTE DFC_OneToOne 1 100 0.00 1.000 BIT_MASK 0x10 FORMAT "%5.3" ECU_ADDRESS 0x60034A86 /end MEASUREMENT
/begin MEASUREMENT DFC_b.LDF_ComMETFRingCnt "Bit encoding / Last debounced flag bit for check DFC_ComMETFRingCnt" UBYTE DFC_OneToOne 1 100 0.00 1.000 BIT_MASK 0x10 FORMAT "%5.3" ECU_ADDRESS 0x60034A87 /end MEASUREMENT
/begin MEASUREMENT DFC_b.LDF_ComMETFTOut "Bit encoding / Last debounced flag bit for check DFC_ComMETFTOut" UBYTE DFC_OneToOne 1 100 0.00 1.000 BIT_MASK 0x10 FORMAT "%5.3" ECU_ADDRESS 0x60034A88 /end MEASUREMENT
/begin MEASUREMENT DFC_b.LDF_ComMETGChksum "Bit encoding / Last debounced flag bit for check DFC_ComMETGChksum" UBYTE DFC_OneToOne 1 100 0.00 1.000 BIT_MASK 0x10 FORMAT "%5.3" ECU_ADDRESS 0x60034A89 /end MEASUREMENT
/begin MEASUREMENT DFC_b.LDF_ComMETGRingCnt "Bit encoding / Last debounced flag bit for check DFC_ComMETGRingCnt" UBYTE DFC_OneToOne 1 100 0.00 1.000 BIT_MASK 0x10 FORMAT "%5.3" ECU_ADDRESS 0x60034A8A /end MEASUREMENT
/begin MEASUREMENT DFC_b.LDF_ComMETGTOut "Bit encoding / Last debounced flag bit for check DFC_ComMETGTOut" UBYTE DFC_OneToOne 1 100 0.00 1.000 BIT_MASK 0x10 FORMAT "%5.3" ECU_ADDRESS 0x60034A8B /end MEASUREMENT
/begin MEASUREMENT DFC_b.LDF_ComMETH2Chksum "Bit encoding / Last debounced flag bit for check DFC_ComMETH2Chksum" UBYTE DFC_OneToOne 1 100 0.00 1.000 BIT_MASK 0x10 FORMAT "%5.3" ECU_ADDRESS 0x60034A8C /end MEASUREMENT
/begin MEASUREMENT DFC_b.LDF_ComMETH2RingCnt "Bit encoding / Last debounced flag bit for check DFC_ComMETH2RingCnt" UBYTE DFC_OneToOne 1 100 0.00 1.000 BIT_MASK 0x10 FORMAT "%5.3" ECU_ADDRESS 0x60034A8D /end MEASUREMENT
/begin MEASUREMENT DFC_b.LDF_ComMETH2TOut "Bit encoding / Last debounced flag bit for check DFC_ComMETH2TOut" UBYTE DFC_OneToOne 1 100 0.00 1.000 BIT_MASK 0x10 FORMAT "%5.3" ECU_ADDRESS 0x60034A8E /end MEASUREMENT
/begin MEASUREMENT DFC_b.LDF_ComMETHChksum "Bit encoding / Last debounced flag bit for check DFC_ComMETHChksum" UBYTE DFC_OneToOne 1 100 0.00 1.000 BIT_MASK 0x10 FORMAT "%5.3" ECU_ADDRESS 0x60034A8F /end MEASUREMENT
/begin MEASUREMENT DFC_b.LDF_ComMETHRingCnt "Bit encoding / Last debounced flag bit for check DFC_ComMETHRingCnt" UBYTE DFC_OneToOne 1 100 0.00 1.000 BIT_MASK 0x10 FORMAT "%5.3" ECU_ADDRESS 0x60034A90 /end MEASUREMENT
/begin MEASUREMENT DFC_b.LDF_ComMETHTOut "Bit encoding / Last debounced flag bit for check DFC_ComMETHTOut" UBYTE DFC_OneToOne 1 100 0.00 1.000 BIT_MASK 0x10 FORMAT "%5.3" ECU_ADDRESS 0x60034A91 /end MEASUREMENT
/begin MEASUREMENT DFC_b.LDF_ComMETIChksum "Bit encoding / Last debounced flag bit for check DFC_ComMETIChksum" UBYTE DFC_OneToOne 1 100 0.00 1.000 BIT_MASK 0x10 FORMAT "%5.3" ECU_ADDRESS 0x60034A92 /end MEASUREMENT
/begin MEASUREMENT DFC_b.LDF_ComMETIRingCnt "Bit encoding / Last debounced flag bit for check DFC_ComMETIRingCnt" UBYTE DFC_OneToOne 1 100 0.00 1.000 BIT_MASK 0x10 FORMAT "%5.3" ECU_ADDRESS 0x60034A93 /end MEASUREMENT
/begin MEASUREMENT DFC_b.LDF_ComMETITOut "Bit encoding / Last debounced flag bit for check DFC_ComMETITOut" UBYTE DFC_OneToOne 1 100 0.00 1.000 BIT_MASK 0x10 FORMAT "%5.3" ECU_ADDRESS 0x60034A94 /end MEASUREMENT
/begin MEASUREMENT DFC_b.LDF_ComMETKChksum "Bit encoding / Last debounced flag bit for check DFC_ComMETKChksum" UBYTE DFC_OneToOne 1 100 0.00 1.000 BIT_MASK 0x10 FORMAT "%5.3" ECU_ADDRESS 0x60034A95 /end MEASUREMENT
/begin MEASUREMENT DFC_b.LDF_ComMETKRingCnt "Bit encoding / Last debounced flag bit for check DFC_ComMETKRingCnt" UBYTE DFC_OneToOne 1 100 0.00 1.000 BIT_MASK 0x10 FORMAT "%5.3" ECU_ADDRESS 0x60034A96 /end MEASUREMENT
/begin MEASUREMENT DFC_b.LDF_ComMETKTOut "Bit encoding / Last debounced flag bit for check DFC_ComMETKTOut" UBYTE DFC_OneToOne 1 100 0.00 1.000 BIT_MASK 0x10 FORMAT "%5.3" ECU_ADDRESS 0x60034A97 /end MEASUREMENT
/begin MEASUREMENT DFC_b.LDF_ComMETLChksum "Bit encoding / Last debounced flag bit for check DFC_ComMETLChksum" UBYTE DFC_OneToOne 1 100 0.00 1.000 BIT_MASK 0x10 FORMAT "%5.3" ECU_ADDRESS 0x60034A98 /end MEASUREMENT
/begin MEASUREMENT DFC_b.LDF_ComMETLRingCnt "Bit encoding / Last debounced flag bit for check DFC_ComMETLRingCnt" UBYTE DFC_OneToOne 1 100 0.00 1.000 BIT_MASK 0x10 FORMAT "%5.3" ECU_ADDRESS 0x60034A99 /end MEASUREMENT
/begin MEASUREMENT DFC_b.LDF_ComMETLTOut "Bit encoding / Last debounced flag bit for check DFC_ComMETLTOut" UBYTE DFC_OneToOne 1 100 0.00 1.000 BIT_MASK 0x10 FORMAT "%5.3" ECU_ADDRESS 0x60034A9A /end MEASUREMENT
/begin MEASUREMENT DFC_b.LDF_ComMETMChksum "Bit encoding / Last debounced flag bit for check DFC_ComMETMChksum" UBYTE DFC_OneToOne 1 100 0.00 1.000 BIT_MASK 0x10 FORMAT "%5.3" ECU_ADDRESS 0x60034A9B /end MEASUREMENT
/begin MEASUREMENT DFC_b.LDF_ComMETMRingCnt "Bit encoding / Last debounced flag bit for check DFC_ComMETMRingCnt" UBYTE DFC_OneToOne 1 100 0.00 1.000 BIT_MASK 0x10 FORMAT "%5.3" ECU_ADDRESS 0x60034A9C /end MEASUREMENT
/begin MEASUREMENT DFC_b.LDF_ComMETMTOut "Bit encoding / Last debounced flag bit for check DFC_ComMETMTOut" UBYTE DFC_OneToOne 1 100 0.00 1.000 BIT_MASK 0x10 FORMAT "%5.3" ECU_ADDRESS 0x60034A9D /end MEASUREMENT
/begin MEASUREMENT DFC_b.LDF_ComMETNChksum "Bit encoding / Last debounced flag bit for check DFC_ComMETNChksum" UBYTE DFC_OneToOne 1 100 0.00 1.000 BIT_MASK 0x10 FORMAT "%5.3" ECU_ADDRESS 0x60034A9E /end MEASUREMENT
/begin MEASUREMENT DFC_b.LDF_ComMETNRingCnt "Bit encoding / Last debounced flag bit for check DFC_ComMETNRingCnt" UBYTE DFC_OneToOne 1 100 0.00 1.000 BIT_MASK 0x10 FORMAT "%5.3" ECU_ADDRESS 0x60034A9F /end MEASUREMENT
/begin MEASUREMENT DFC_b.LDF_ComMETNTOut "Bit encoding / Last debounced flag bit for check DFC_ComMETNTOut" UBYTE DFC_OneToOne 1 100 0.00 1.000 BIT_MASK 0x10 FORMAT "%5.3" ECU_ADDRESS 0x60034AA0 /end MEASUREMENT
/begin MEASUREMENT DFC_b.LDF_ComMtrCom "Bit encoding / Last debounced flag bit for check DFC_ComMtrCom" UBYTE DFC_OneToOne 1 100 0.00 1.000 BIT_MASK 0x10 FORMAT "%5.3" ECU_ADDRESS 0x60034AA1 /end MEASUREMENT
/begin MEASUREMENT DFC_b.LDF_ComPCUChkSum "Bit encoding / Last debounced flag bit for check DFC_ComPCUChkSum" UBYTE DFC_OneToOne 1 100 0.00 1.000 BIT_MASK 0x10 FORMAT "%5.3" ECU_ADDRESS 0x60034AA2 /end MEASUREMENT
/begin MEASUREMENT DFC_b.LDF_ComPCURingCnt "Bit encoding / Last debounced flag bit for check DFC_ComPCURingCnt" UBYTE DFC_OneToOne 1 100 0.00 1.000 BIT_MASK 0x10 FORMAT "%5.3" ECU_ADDRESS 0x60034AA3 /end MEASUREMENT
/begin MEASUREMENT DFC_b.LDF_ComPCUTOut "Bit encoding / Last debounced flag bit for check DFC_ComPCUTOut" UBYTE DFC_OneToOne 1 100 0.00 1.000 BIT_MASK 0x10 FORMAT "%5.3" ECU_ADDRESS 0x60034AA4 /end MEASUREMENT
/begin MEASUREMENT DFC_b.LDF_ComSRSAChksum "Bit encoding / Last debounced flag bit for check DFC_ComSRSAChksum" UBYTE DFC_OneToOne 1 100 0.00 1.000 BIT_MASK 0x10 FORMAT "%5.3" ECU_ADDRESS 0x60034AA5 /end MEASUREMENT
/begin MEASUREMENT DFC_b.LDF_ComSRSARingCnt "Bit encoding / Last debounced flag bit for check DFC_ComSRSARingCnt" UBYTE DFC_OneToOne 1 100 0.00 1.000 BIT_MASK 0x10 FORMAT "%5.3" ECU_ADDRESS 0x60034AA6 /end MEASUREMENT
/begin MEASUREMENT DFC_b.LDF_ComSRSATOut "Bit encoding / Last debounced flag bit for check DFC_ComSRSATOut" UBYTE DFC_OneToOne 1 100 0.00 1.000 BIT_MASK 0x10 FORMAT "%5.3" ECU_ADDRESS 0x60034AA7 /end MEASUREMENT
/begin MEASUREMENT DFC_b.LDF_ComSRSBChksum "Bit encoding / Last debounced flag bit for check DFC_ComSRSBChksum" UBYTE DFC_OneToOne 1 100 0.00 1.000 BIT_MASK 0x10 FORMAT "%5.3" ECU_ADDRESS 0x60034AA8 /end MEASUREMENT
/begin MEASUREMENT DFC_b.LDF_ComSRSBRingCnt "Bit encoding / Last debounced flag bit for check DFC_ComSRSBRingCnt" UBYTE DFC_OneToOne 1 100 0.00 1.000 BIT_MASK 0x10 FORMAT "%5.3" ECU_ADDRESS 0x60034AA9 /end MEASUREMENT
/begin MEASUREMENT DFC_b.LDF_ComSRSBTOut "Bit encoding / Last debounced flag bit for check DFC_ComSRSBTOut" UBYTE DFC_OneToOne 1 100 0.00 1.000 BIT_MASK 0x10 FORMAT "%5.3" ECU_ADDRESS 0x60034AAA /end MEASUREMENT
/begin MEASUREMENT DFC_b.LDF_ComSRSChksum "Bit encoding / Last debounced flag bit for check DFC_ComSRSChksum" UBYTE DFC_OneToOne 1 100 0.00 1.000 BIT_MASK 0x10 FORMAT "%5.3" ECU_ADDRESS 0x60034AAB /end MEASUREMENT
/begin MEASUREMENT DFC_b.LDF_ComSRSErr "Bit encoding / Last debounced flag bit for check DFC_ComSRSErr" UBYTE DFC_OneToOne 1 100 0.00 1.000 BIT_MASK 0x10 FORMAT "%5.3" ECU_ADDRESS 0x60034AAC /end MEASUREMENT
/begin MEASUREMENT DFC_b.LDF_ComSRSRingCnt "Bit encoding / Last debounced flag bit for check DFC_ComSRSRingCnt" UBYTE DFC_OneToOne 1 100 0.00 1.000 BIT_MASK 0x10 FORMAT "%5.3" ECU_ADDRESS 0x60034AAD /end MEASUREMENT
/begin MEASUREMENT DFC_b.LDF_ComSRSTOut "Bit encoding / Last debounced flag bit for check DFC_ComSRSTOut" UBYTE DFC_OneToOne 1 100 0.00 1.000 BIT_MASK 0x10 FORMAT "%5.3" ECU_ADDRESS 0x60034AAE /end MEASUREMENT
/begin MEASUREMENT DFC_b.LDF_ComVehSpdPndFltTCU "Bit encoding / Last debounced flag bit for check DFC_ComVehSpdPndFltTCU" UBYTE DFC_OneToOne 1 100 0.00 1.000 BIT_MASK 0x10 FORMAT "%5.3" ECU_ADDRESS 0x60034AAF /end MEASUREMENT
/begin MEASUREMENT DFC_b.LDF_EbsChartcCurrErr "Bit encoding / Last debounced flag bit for check DFC_EbsChartcCurrErr" UBYTE DFC_OneToOne 1 100 0.00 1.000 BIT_MASK 0x10 FORMAT "%5.3" ECU_ADDRESS 0x60034AB0 /end MEASUREMENT
/begin MEASUREMENT DFC_b.LDF_EbsSelfDiagErr "Bit encoding / Last debounced flag bit for check DFC_EbsSelfDiagErr" UBYTE DFC_OneToOne 1 100 0.00 1.000 BIT_MASK 0x10 FORMAT "%5.3" ECU_ADDRESS 0x60034AB1 /end MEASUREMENT
/begin MEASUREMENT DFC_b.LDF_GbxCANDigPlausErr "Bit encoding / Last debounced flag bit for check DFC_GbxCANDigPlausErr" UBYTE DFC_OneToOne 1 100 0.00 1.000 BIT_MASK 0x10 FORMAT "%5.3" ECU_ADDRESS 0x60034AB2 /end MEASUREMENT
/begin MEASUREMENT DFC_b.LDF_GbxNPos1SRCMax "Bit encoding / Last debounced flag bit for check DFC_GbxNPos1SRCMax" UBYTE DFC_OneToOne 1 100 0.00 1.000 BIT_MASK 0x10 FORMAT "%5.3" ECU_ADDRESS 0x60034AB3 /end MEASUREMENT
/begin MEASUREMENT DFC_b.LDF_GbxNPos1SRCMin "Bit encoding / Last debounced flag bit for check DFC_GbxNPos1SRCMin" UBYTE DFC_OneToOne 1 100 0.00 1.000 BIT_MASK 0x10 FORMAT "%5.3" ECU_ADDRESS 0x60034AB4 /end MEASUREMENT
/begin MEASUREMENT DFC_b.LDF_GbxNPos2SRCMax "Bit encoding / Last debounced flag bit for check DFC_GbxNPos2SRCMax" UBYTE DFC_OneToOne 1 100 0.00 1.000 BIT_MASK 0x10 FORMAT "%5.3" ECU_ADDRESS 0x60034AB5 /end MEASUREMENT
/begin MEASUREMENT DFC_b.LDF_GbxNPos2SRCMin "Bit encoding / Last debounced flag bit for check DFC_GbxNPos2SRCMin" UBYTE DFC_OneToOne 1 100 0.00 1.000 BIT_MASK 0x10 FORMAT "%5.3" ECU_ADDRESS 0x60034AB6 /end MEASUREMENT
/begin MEASUREMENT DFC_b.LDF_GbxNPosAlvChk "Bit encoding / Last debounced flag bit for check DFC_GbxNPosAlvChk" UBYTE DFC_OneToOne 1 100 0.00 1.000 BIT_MASK 0x10 FORMAT "%5.3" ECU_ADDRESS 0x60034AB7 /end MEASUREMENT
/begin MEASUREMENT DFC_b.LDF_GbxNPosSyncErr "Bit encoding / Last debounced flag bit for check DFC_GbxNPosSyncErr" UBYTE DFC_OneToOne 1 100 0.00 1.000 BIT_MASK 0x10 FORMAT "%5.3" ECU_ADDRESS 0x60034AB8 /end MEASUREMENT
/begin MEASUREMENT DFC_b.LDF_HEGOS2B1HtrPsMax "Bit encoding / Last debounced flag bit for check DFC_HEGOS2B1HtrPsMax" UBYTE DFC_OneToOne 1 100 0.00 1.000 BIT_MASK 0x10 FORMAT "%5.3" ECU_ADDRESS 0x60034AB9 /end MEASUREMENT
/begin MEASUREMENT DFC_b.LDF_HEGOS2B1HtrPsMin "Bit encoding / Last debounced flag bit for check DFC_HEGOS2B1HtrPsMin" UBYTE DFC_OneToOne 1 100 0.00 1.000 BIT_MASK 0x10 FORMAT "%5.3" ECU_ADDRESS 0x60034ABA /end MEASUREMENT
/begin MEASUREMENT DFC_b.LDF_HEGOS2B1HtrPsSig "Bit encoding / Last debounced flag bit for check DFC_HEGOS2B1HtrPsSig" UBYTE DFC_OneToOne 1 100 0.00 1.000 BIT_MASK 0x10 FORMAT "%5.3" ECU_ADDRESS 0x60034ABB /end MEASUREMENT
/begin MEASUREMENT DFC_b.LDF_LinCSErrACG "Bit encoding / Last debounced flag bit for check DFC_LinCSErrACG" UBYTE DFC_OneToOne 1 100 0.00 1.000 BIT_MASK 0x10 FORMAT "%5.3" ECU_ADDRESS 0x60034ABC /end MEASUREMENT
/begin MEASUREMENT DFC_b.LDF_LinCSErrEBS "Bit encoding / Last debounced flag bit for check DFC_LinCSErrEBS" UBYTE DFC_OneToOne 1 100 0.00 1.000 BIT_MASK 0x10 FORMAT "%5.3" ECU_ADDRESS 0x60034ABD /end MEASUREMENT
/begin MEASUREMENT DFC_b.LDF_LinHdrTimeoutErrACG "Bit encoding / Last debounced flag bit for check DFC_LinHdrTimeoutErrACG" UBYTE DFC_OneToOne 1 100 0.00 1.000 BIT_MASK 0x10 FORMAT "%5.3" ECU_ADDRESS 0x60034ABE /end MEASUREMENT
/begin MEASUREMENT DFC_b.LDF_LinHdrTimeoutErrEBS "Bit encoding / Last debounced flag bit for check DFC_LinHdrTimeoutErrEBS" UBYTE DFC_OneToOne 1 100 0.00 1.000 BIT_MASK 0x10 FORMAT "%5.3" ECU_ADDRESS 0x60034ABF /end MEASUREMENT
/begin MEASUREMENT DFC_b.LDF_LinMsgTimeoutErrACG "Bit encoding / Last debounced flag bit for check DFC_LinMsgTimeoutErrACG" UBYTE DFC_OneToOne 1 100 0.00 1.000 BIT_MASK 0x10 FORMAT "%5.3" ECU_ADDRESS 0x60034AC0 /end MEASUREMENT
/begin MEASUREMENT DFC_b.LDF_LinMsgTimeoutErrEBS "Bit encoding / Last debounced flag bit for check DFC_LinMsgTimeoutErrEBS" UBYTE DFC_OneToOne 1 100 0.00 1.000 BIT_MASK 0x10 FORMAT "%5.3" ECU_ADDRESS 0x60034AC1 /end MEASUREMENT
/begin MEASUREMENT DFC_b.LDF_LinNoStrtComErr "Bit encoding / Last debounced flag bit for check DFC_LinNoStrtComErr" UBYTE DFC_OneToOne 1 100 0.00 1.000 BIT_MASK 0x10 FORMAT "%5.3" ECU_ADDRESS 0x60034AC2 /end MEASUREMENT
/begin MEASUREMENT DFC_b.LDF_MisfDetVWhlFrntLeOORHi "Bit encoding / Last debounced flag bit for check DFC_MisfDetVWhlFrntLeOORHi" UBYTE DFC_OneToOne 1 100 0.00 1.000 BIT_MASK 0x10 FORMAT "%5.3" ECU_ADDRESS 0x60034AC3 /end MEASUREMENT
/begin MEASUREMENT DFC_b.LDF_MisfDetVWhlFrntLeRatyHi "Bit encoding / Last debounced flag bit for check DFC_MisfDetVWhlFrntLeRatyHi" UBYTE DFC_OneToOne 1 100 0.00 1.000 BIT_MASK 0x10 FORMAT "%5.3" ECU_ADDRESS 0x60034AC4 /end MEASUREMENT
/begin MEASUREMENT DFC_b.LDF_MisfDetVWhlFrntLeRatyLo "Bit encoding / Last debounced flag bit for check DFC_MisfDetVWhlFrntLeRatyLo" UBYTE DFC_OneToOne 1 100 0.00 1.000 BIT_MASK 0x10 FORMAT "%5.3" ECU_ADDRESS 0x60034AC5 /end MEASUREMENT
/begin MEASUREMENT DFC_b.LDF_MisfDetVWhlFrntLeStuck "Bit encoding / Last debounced flag bit for check DFC_MisfDetVWhlFrntLeStuck" UBYTE DFC_OneToOne 1 100 0.00 1.000 BIT_MASK 0x10 FORMAT "%5.3" ECU_ADDRESS 0x60034AC6 /end MEASUREMENT
/begin MEASUREMENT DFC_b.LDF_MisfDetVWhlFrntRiOORHi "Bit encoding / Last debounced flag bit for check DFC_MisfDetVWhlFrntRiOORHi" UBYTE DFC_OneToOne 1 100 0.00 1.000 BIT_MASK 0x10 FORMAT "%5.3" ECU_ADDRESS 0x60034AC7 /end MEASUREMENT
/begin MEASUREMENT DFC_b.LDF_MisfDetVWhlFrntRiRatyHi "Bit encoding / Last debounced flag bit for check DFC_MisfDetVWhlFrntRiRatyHi" UBYTE DFC_OneToOne 1 100 0.00 1.000 BIT_MASK 0x10 FORMAT "%5.3" ECU_ADDRESS 0x60034AC8 /end MEASUREMENT
/begin MEASUREMENT DFC_b.LDF_MisfDetVWhlFrntRiRatyLo "Bit encoding / Last debounced flag bit for check DFC_MisfDetVWhlFrntRiRatyLo" UBYTE DFC_OneToOne 1 100 0.00 1.000 BIT_MASK 0x10 FORMAT "%5.3" ECU_ADDRESS 0x60034AC9 /end MEASUREMENT
/begin MEASUREMENT DFC_b.LDF_MisfDetVWhlFrntRiStuck "Bit encoding / Last debounced flag bit for check DFC_MisfDetVWhlFrntRiStuck" UBYTE DFC_OneToOne 1 100 0.00 1.000 BIT_MASK 0x10 FORMAT "%5.3" ECU_ADDRESS 0x60034ACA /end MEASUREMENT
/begin MEASUREMENT DFC_b.LDF_MisfDetVWhlReLeOORHi "Bit encoding / Last debounced flag bit for check DFC_MisfDetVWhlReLeOORHi" UBYTE DFC_OneToOne 1 100 0.00 1.000 BIT_MASK 0x10 FORMAT "%5.3" ECU_ADDRESS 0x60034ACB /end MEASUREMENT
/begin MEASUREMENT DFC_b.LDF_MisfDetVWhlReLeRatyHi "Bit encoding / Last debounced flag bit for check DFC_MisfDetVWhlReLeRatyHi" UBYTE DFC_OneToOne 1 100 0.00 1.000 BIT_MASK 0x10 FORMAT "%5.3" ECU_ADDRESS 0x60034ACC /end MEASUREMENT
/begin MEASUREMENT DFC_b.LDF_MisfDetVWhlReLeRatyLo "Bit encoding / Last debounced flag bit for check DFC_MisfDetVWhlReLeRatyLo" UBYTE DFC_OneToOne 1 100 0.00 1.000 BIT_MASK 0x10 FORMAT "%5.3" ECU_ADDRESS 0x60034ACD /end MEASUREMENT
/begin MEASUREMENT DFC_b.LDF_MisfDetVWhlReLeStuck "Bit encoding / Last debounced flag bit for check DFC_MisfDetVWhlReLeStuck" UBYTE DFC_OneToOne 1 100 0.00 1.000 BIT_MASK 0x10 FORMAT "%5.3" ECU_ADDRESS 0x60034ACE /end MEASUREMENT
/begin MEASUREMENT DFC_b.LDF_MisfDetVWhlReRiOORHi "Bit encoding / Last debounced flag bit for check DFC_MisfDetVWhlReRiOORHi" UBYTE DFC_OneToOne 1 100 0.00 1.000 BIT_MASK 0x10 FORMAT "%5.3" ECU_ADDRESS 0x60034ACF /end MEASUREMENT
/begin MEASUREMENT DFC_b.LDF_MisfDetVWhlReRiRatyHi "Bit encoding / Last debounced flag bit for check DFC_MisfDetVWhlReRiRatyHi" UBYTE DFC_OneToOne 1 100 0.00 1.000 BIT_MASK 0x10 FORMAT "%5.3" ECU_ADDRESS 0x60034AD0 /end MEASUREMENT
/begin MEASUREMENT DFC_b.LDF_MisfDetVWhlReRiRatyLo "Bit encoding / Last debounced flag bit for check DFC_MisfDetVWhlReRiRatyLo" UBYTE DFC_OneToOne 1 100 0.00 1.000 BIT_MASK 0x10 FORMAT "%5.3" ECU_ADDRESS 0x60034AD1 /end MEASUREMENT
/begin MEASUREMENT DFC_b.LDF_MisfDetVWhlReRiStuck "Bit encoding / Last debounced flag bit for check DFC_MisfDetVWhlReRiStuck" UBYTE DFC_OneToOne 1 100 0.00 1.000 BIT_MASK 0x10 FORMAT "%5.3" ECU_ADDRESS 0x60034AD2 /end MEASUREMENT
/begin MEASUREMENT DFC_b.LDF_MisfDetdVWhlFrntLePlaus "Bit encoding / Last debounced flag bit for check DFC_MisfDetdVWhlFrntLePlaus" UBYTE DFC_OneToOne 1 100 0.00 1.000 BIT_MASK 0x10 FORMAT "%5.3" ECU_ADDRESS 0x60034AD3 /end MEASUREMENT
/begin MEASUREMENT DFC_b.LDF_MisfDetdVWhlFrntRiPlaus "Bit encoding / Last debounced flag bit for check DFC_MisfDetdVWhlFrntRiPlaus" UBYTE DFC_OneToOne 1 100 0.00 1.000 BIT_MASK 0x10 FORMAT "%5.3" ECU_ADDRESS 0x60034AD4 /end MEASUREMENT
/begin MEASUREMENT DFC_b.LDF_MisfDetdVWhlReLePlaus "Bit encoding / Last debounced flag bit for check DFC_MisfDetdVWhlReLePlaus" UBYTE DFC_OneToOne 1 100 0.00 1.000 BIT_MASK 0x10 FORMAT "%5.3" ECU_ADDRESS 0x60034AD5 /end MEASUREMENT
/begin MEASUREMENT DFC_b.LDF_MisfDetdVWhlReRiPlaus "Bit encoding / Last debounced flag bit for check DFC_MisfDetdVWhlReRiPlaus" UBYTE DFC_OneToOne 1 100 0.00 1.000 BIT_MASK 0x10 FORMAT "%5.3" ECU_ADDRESS 0x60034AD6 /end MEASUREMENT
/begin MEASUREMENT DFC_b.LDF_PEnvSigRngMax "Bit encoding / Last debounced flag bit for check DFC_PEnvSigRngMax" UBYTE DFC_OneToOne 1 100 0.00 1.000 BIT_MASK 0x10 FORMAT "%5.3" ECU_ADDRESS 0x60034AD7 /end MEASUREMENT
/begin MEASUREMENT DFC_b.LDF_PEnvSigRngMin "Bit encoding / Last debounced flag bit for check DFC_PEnvSigRngMin" UBYTE DFC_OneToOne 1 100 0.00 1.000 BIT_MASK 0x10 FORMAT "%5.3" ECU_ADDRESS 0x60034AD8 /end MEASUREMENT
/begin MEASUREMENT DFC_b.LDF_StmFault "Bit encoding / Last debounced flag bit for check DFC_StmFault" UBYTE DFC_OneToOne 1 100 0.00 1.000 BIT_MASK 0x10 FORMAT "%5.3" ECU_ADDRESS 0x60034AD9 /end MEASUREMENT
/begin MEASUREMENT DFC_b.LDF_StrtCtOffPth "Bit encoding / Last debounced flag bit for check DFC_StrtCtOffPth" UBYTE DFC_OneToOne 1 100 0.00 1.000 BIT_MASK 0x10 FORMAT "%5.3" ECU_ADDRESS 0x60034ADA /end MEASUREMENT
/begin MEASUREMENT DFC_b.LDF_StrtCtlErr "Bit encoding / Last debounced flag bit for check DFC_StrtCtlErr" UBYTE DFC_OneToOne 1 100 0.00 1.000 BIT_MASK 0x10 FORMAT "%5.3" ECU_ADDRESS 0x60034ADB /end MEASUREMENT
/begin MEASUREMENT DFC_b.LDF_StrtFault "Bit encoding / Last debounced flag bit for check DFC_StrtFault" UBYTE DFC_OneToOne 1 100 0.00 1.000 BIT_MASK 0x10 FORMAT "%5.3" ECU_ADDRESS 0x60034ADC /end MEASUREMENT
/begin MEASUREMENT DFC_b.LDF_StrtLckJudg1 "Bit encoding / Last debounced flag bit for check DFC_StrtLckJudg1" UBYTE DFC_OneToOne 1 100 0.00 1.000 BIT_MASK 0x10 FORMAT "%5.3" ECU_ADDRESS 0x60034ADD /end MEASUREMENT
/begin MEASUREMENT DFC_b.LDF_StrtLckJudg2 "Bit encoding / Last debounced flag bit for check DFC_StrtLckJudg2" UBYTE DFC_OneToOne 1 100 0.00 1.000 BIT_MASK 0x10 FORMAT "%5.3" ECU_ADDRESS 0x60034ADE /end MEASUREMENT
/begin MEASUREMENT DFC_b.LDF_StrtOL "Bit encoding / Last debounced flag bit for check DFC_StrtOL" UBYTE DFC_OneToOne 1 100 0.00 1.000 BIT_MASK 0x10 FORMAT "%5.3" ECU_ADDRESS 0x60034ADF /end MEASUREMENT
/begin MEASUREMENT DFC_b.LDF_StrtOL2 "Bit encoding / Last debounced flag bit for check DFC_StrtOL2" UBYTE DFC_OneToOne 1 100 0.00 1.000 BIT_MASK 0x10 FORMAT "%5.3" ECU_ADDRESS 0x60034AE0 /end MEASUREMENT
/begin MEASUREMENT DFC_b.LDF_StrtSCB "Bit encoding / Last debounced flag bit for check DFC_StrtSCB" UBYTE DFC_OneToOne 1 100 0.00 1.000 BIT_MASK 0x10 FORMAT "%5.3" ECU_ADDRESS 0x60034AE1 /end MEASUREMENT
/begin MEASUREMENT DFC_b.LDF_StrtSCB2 "Bit encoding / Last debounced flag bit for check DFC_StrtSCB2" UBYTE DFC_OneToOne 1 100 0.00 1.000 BIT_MASK 0x10 FORMAT "%5.3" ECU_ADDRESS 0x60034AE2 /end MEASUREMENT
/begin MEASUREMENT DFC_b.LDF_StrtSCG "Bit encoding / Last debounced flag bit for check DFC_StrtSCG" UBYTE DFC_OneToOne 1 100 0.00 1.000 BIT_MASK 0x10 FORMAT "%5.3" ECU_ADDRESS 0x60034AE3 /end MEASUREMENT
/begin MEASUREMENT DFC_b.LDF_StrtSCG2 "Bit encoding / Last debounced flag bit for check DFC_StrtSCG2" UBYTE DFC_OneToOne 1 100 0.00 1.000 BIT_MASK 0x10 FORMAT "%5.3" ECU_ADDRESS 0x60034AE4 /end MEASUREMENT
/begin MEASUREMENT DFC_b.LDF_StrtStkRly1 "Bit encoding / Last debounced flag bit for check DFC_StrtStkRly1" UBYTE DFC_OneToOne 1 100 0.00 1.000 BIT_MASK 0x10 FORMAT "%5.3" ECU_ADDRESS 0x60034AE5 /end MEASUREMENT
/begin MEASUREMENT DFC_b.LDF_StrtStkRly2 "Bit encoding / Last debounced flag bit for check DFC_StrtStkRly2" UBYTE DFC_OneToOne 1 100 0.00 1.000 BIT_MASK 0x10 FORMAT "%5.3" ECU_ADDRESS 0x60034AE6 /end MEASUREMENT
/begin MEASUREMENT DFC_b.LDF_TEVEmax "Bit encoding / Last debounced flag bit for check DFC_TEVEmax" UBYTE DFC_OneToOne 1 100 0.00 1.000 BIT_MASK 0x10 FORMAT "%5.3" ECU_ADDRESS 0x60034AE7 /end MEASUREMENT
/begin MEASUREMENT DFC_b.LDF_TEVEmin "Bit encoding / Last debounced flag bit for check DFC_TEVEmin" UBYTE DFC_OneToOne 1 100 0.00 1.000 BIT_MASK 0x10 FORMAT "%5.3" ECU_ADDRESS 0x60034AE8 /end MEASUREMENT
/begin MEASUREMENT DFC_b.LDF_TEVEsig "Bit encoding / Last debounced flag bit for check DFC_TEVEsig" UBYTE DFC_OneToOne 1 100 0.00 1.000 BIT_MASK 0x10 FORMAT "%5.3" ECU_ADDRESS 0x60034AE9 /end MEASUREMENT
/begin MEASUREMENT DFC_b.LDF_VehVAllPlaus "Bit encoding / Last debounced flag bit for check DFC_VehVAllPlaus" UBYTE DFC_OneToOne 1 100 0.00 1.000 BIT_MASK 0x10 FORMAT "%5.3" ECU_ADDRESS 0x60034AEA /end MEASUREMENT
/begin MEASUREMENT DFC_b.LDF_VehVNCSnsrElecFailr "Bit encoding / Last debounced flag bit for check DFC_VehVNCSnsrElecFailr" UBYTE DFC_OneToOne 1 100 0.00 1.000 BIT_MASK 0x10 FORMAT "%5.3" ECU_ADDRESS 0x60034AEB /end MEASUREMENT
/begin MEASUREMENT DFC_b.LDF_VehVPlausCan "Bit encoding / Last debounced flag bit for check DFC_VehVPlausCan" UBYTE DFC_OneToOne 1 100 0.00 1.000 BIT_MASK 0x10 FORMAT "%5.3" ECU_ADDRESS 0x60034AEC /end MEASUREMENT
/begin MEASUREMENT DFC_b.LDF_VehVPlausFco "Bit encoding / Last debounced flag bit for check DFC_VehVPlausFco" UBYTE DFC_OneToOne 1 100 0.00 1.000 BIT_MASK 0x10 FORMAT "%5.3" ECU_ADDRESS 0x60034AED /end MEASUREMENT
/begin MEASUREMENT DFC_b.LDF_VehVPlausPwr "Bit encoding / Last debounced flag bit for check DFC_VehVPlausPwr" UBYTE DFC_OneToOne 1 100 0.00 1.000 BIT_MASK 0x10 FORMAT "%5.3" ECU_ADDRESS 0x60034AEE /end MEASUREMENT
/begin MEASUREMENT DFC_b.LDF_VehVPlausV2N "Bit encoding / Last debounced flag bit for check DFC_VehVPlausV2N" UBYTE DFC_OneToOne 1 100 0.00 1.000 BIT_MASK 0x10 FORMAT "%5.3" ECU_ADDRESS 0x60034AEF /end MEASUREMENT
/begin MEASUREMENT DFC_b.LDF_VehVSpdSnsrAElecFailr "Bit encoding / Last debounced flag bit for check DFC_VehVSpdSnsrAElecFailr" UBYTE DFC_OneToOne 1 100 0.00 1.000 BIT_MASK 0x10 FORMAT "%5.3" ECU_ADDRESS 0x60034AF0 /end MEASUREMENT
/begin MEASUREMENT DFC_b.LDF_VehVSpdSnsrBElecFailr "Bit encoding / Last debounced flag bit for check DFC_VehVSpdSnsrBElecFailr" UBYTE DFC_OneToOne 1 100 0.00 1.000 BIT_MASK 0x10 FORMAT "%5.3" ECU_ADDRESS 0x60034AF1 /end MEASUREMENT
/begin MEASUREMENT DFC_b.LDF_ClthMax "Bit encoding / Last debounced flag bit for check DFC_ClthMax" UBYTE DFC_OneToOne 1 100 0.00 1.000 BIT_MASK 0x10 FORMAT "%5.3" ECU_ADDRESS 0x60034AF2 /end MEASUREMENT
/begin MEASUREMENT DFC_b.LDF_IgnClPs_DevComErr "Bit encoding / Last debounced flag bit for check DFC_IgnClPs_DevComErr" UBYTE DFC_OneToOne 1 100 0.00 1.000 BIT_MASK 0x10 FORMAT "%5.3" ECU_ADDRESS 0x60034AF3 /end MEASUREMENT
/begin MEASUREMENT DFC_b.LDF_IgnClPs_LineOl_0 "Bit encoding / Last debounced flag bit for check DFC_IgnClPs_LineOl_0" UBYTE DFC_OneToOne 1 100 0.00 1.000 BIT_MASK 0x10 FORMAT "%5.3" ECU_ADDRESS 0x60034AF4 /end MEASUREMENT
/begin MEASUREMENT DFC_b.LDF_IgnClPs_LineOl_1 "Bit encoding / Last debounced flag bit for check DFC_IgnClPs_LineOl_1" UBYTE DFC_OneToOne 1 100 0.00 1.000 BIT_MASK 0x10 FORMAT "%5.3" ECU_ADDRESS 0x60034AF5 /end MEASUREMENT
/begin MEASUREMENT DFC_b.LDF_IgnClPs_LineOl_2 "Bit encoding / Last debounced flag bit for check DFC_IgnClPs_LineOl_2" UBYTE DFC_OneToOne 1 100 0.00 1.000 BIT_MASK 0x10 FORMAT "%5.3" ECU_ADDRESS 0x60034AF6 /end MEASUREMENT
/begin MEASUREMENT DFC_b.LDF_IgnClPs_LineOl_3 "Bit encoding / Last debounced flag bit for check DFC_IgnClPs_LineOl_3" UBYTE DFC_OneToOne 1 100 0.00 1.000 BIT_MASK 0x10 FORMAT "%5.3" ECU_ADDRESS 0x60034AF7 /end MEASUREMENT
/begin MEASUREMENT DFC_b.LDF_IgnClPs_LineScb_0 "Bit encoding / Last debounced flag bit for check DFC_IgnClPs_LineScb_0" UBYTE DFC_OneToOne 1 100 0.00 1.000 BIT_MASK 0x10 FORMAT "%5.3" ECU_ADDRESS 0x60034AF8 /end MEASUREMENT
/begin MEASUREMENT DFC_b.LDF_IgnClPs_LineScb_1 "Bit encoding / Last debounced flag bit for check DFC_IgnClPs_LineScb_1" UBYTE DFC_OneToOne 1 100 0.00 1.000 BIT_MASK 0x10 FORMAT "%5.3" ECU_ADDRESS 0x60034AF9 /end MEASUREMENT
/begin MEASUREMENT DFC_b.LDF_IgnClPs_LineScb_2 "Bit encoding / Last debounced flag bit for check DFC_IgnClPs_LineScb_2" UBYTE DFC_OneToOne 1 100 0.00 1.000 BIT_MASK 0x10 FORMAT "%5.3" ECU_ADDRESS 0x60034AFA /end MEASUREMENT
/begin MEASUREMENT DFC_b.LDF_IgnClPs_LineScb_3 "Bit encoding / Last debounced flag bit for check DFC_IgnClPs_LineScb_3" UBYTE DFC_OneToOne 1 100 0.00 1.000 BIT_MASK 0x10 FORMAT "%5.3" ECU_ADDRESS 0x60034AFB /end MEASUREMENT
/begin MEASUREMENT DFC_b.LDF_IgnClPs_LineScg_0 "Bit encoding / Last debounced flag bit for check DFC_IgnClPs_LineScg_0" UBYTE DFC_OneToOne 1 100 0.00 1.000 BIT_MASK 0x10 FORMAT "%5.3" ECU_ADDRESS 0x60034AFC /end MEASUREMENT
/begin MEASUREMENT DFC_b.LDF_IgnClPs_LineScg_1 "Bit encoding / Last debounced flag bit for check DFC_IgnClPs_LineScg_1" UBYTE DFC_OneToOne 1 100 0.00 1.000 BIT_MASK 0x10 FORMAT "%5.3" ECU_ADDRESS 0x60034AFD /end MEASUREMENT
/begin MEASUREMENT DFC_b.LDF_IgnClPs_LineScg_2 "Bit encoding / Last debounced flag bit for check DFC_IgnClPs_LineScg_2" UBYTE DFC_OneToOne 1 100 0.00 1.000 BIT_MASK 0x10 FORMAT "%5.3" ECU_ADDRESS 0x60034AFE /end MEASUREMENT
/begin MEASUREMENT DFC_b.LDF_IgnClPs_LineScg_3 "Bit encoding / Last debounced flag bit for check DFC_IgnClPs_LineScg_3" UBYTE DFC_OneToOne 1 100 0.00 1.000 BIT_MASK 0x10 FORMAT "%5.3" ECU_ADDRESS 0x60034AFF /end MEASUREMENT
/begin MEASUREMENT DFC_b.LDF_UEGOASICS1B1 "Bit encoding / Last debounced flag bit for check DFC_UEGOASICS1B1" UBYTE DFC_OneToOne 1 100 0.00 1.000 BIT_MASK 0x10 FORMAT "%5.3" ECU_ADDRESS 0x60034B00 /end MEASUREMENT
/begin MEASUREMENT DFC_b.LDF_UEGOOLIPES1B1 "Bit encoding / Last debounced flag bit for check DFC_UEGOOLIPES1B1" UBYTE DFC_OneToOne 1 100 0.00 1.000 BIT_MASK 0x10 FORMAT "%5.3" ECU_ADDRESS 0x60034B01 /end MEASUREMENT
/begin MEASUREMENT DFC_b.LDF_UEGOOLRES1B1 "Bit encoding / Last debounced flag bit for check DFC_UEGOOLRES1B1" UBYTE DFC_OneToOne 1 100 0.00 1.000 BIT_MASK 0x10 FORMAT "%5.3" ECU_ADDRESS 0x60034B02 /end MEASUREMENT
/begin MEASUREMENT DFC_b.LDF_UEGOSCBS1B1 "Bit encoding / Last debounced flag bit for check DFC_UEGOSCBS1B1" UBYTE DFC_OneToOne 1 100 0.00 1.000 BIT_MASK 0x10 FORMAT "%5.3" ECU_ADDRESS 0x60034B03 /end MEASUREMENT
/begin MEASUREMENT DFC_b.LDF_UEGOSCGS1B1 "Bit encoding / Last debounced flag bit for check DFC_UEGOSCGS1B1" UBYTE DFC_OneToOne 1 100 0.00 1.000 BIT_MASK 0x10 FORMAT "%5.3" ECU_ADDRESS 0x60034B04 /end MEASUREMENT
/begin MEASUREMENT DFC_b.LDF_UEGOSPIS1B1 "Bit encoding / Last debounced flag bit for check DFC_UEGOSPIS1B1" UBYTE DFC_OneToOne 1 100 0.00 1.000 BIT_MASK 0x10 FORMAT "%5.3" ECU_ADDRESS 0x60034B05 /end MEASUREMENT
/begin MEASUREMENT DFC_b.LDF_UEGOSnsrS1B1 "Bit encoding / Last debounced flag bit for check DFC_UEGOSnsrS1B1" UBYTE DFC_OneToOne 1 100 0.00 1.000 BIT_MASK 0x10 FORMAT "%5.3" ECU_ADDRESS 0x60034B06 /end MEASUREMENT
/begin MEASUREMENT DFC_b.LDF_UegoOlApesS1B1 "Bit encoding / Last debounced flag bit for check DFC_UegoOlApesS1B1" UBYTE DFC_OneToOne 1 100 0.00 1.000 BIT_MASK 0x10 FORMAT "%5.3" ECU_ADDRESS 0x60034B07 /end MEASUREMENT
/begin MEASUREMENT DFC_b.LDF_UegoOlRCmpS1B1 "Bit encoding / Last debounced flag bit for check DFC_UegoOlRCmpS1B1" UBYTE DFC_OneToOne 1 100 0.00 1.000 BIT_MASK 0x10 FORMAT "%5.3" ECU_ADDRESS 0x60034B08 /end MEASUREMENT
/begin MEASUREMENT DFC_b.LDF_AirCCmprOL "Bit encoding / Last debounced flag bit for check DFC_AirCCmprOL" UBYTE DFC_OneToOne 1 100 0.00 1.000 BIT_MASK 0x10 FORMAT "%5.3" ECU_ADDRESS 0x60034B09 /end MEASUREMENT
/begin MEASUREMENT DFC_b.LDF_AirCCmprOvrTemp "Bit encoding / Last debounced flag bit for check DFC_AirCCmprOvrTemp" UBYTE DFC_OneToOne 1 100 0.00 1.000 BIT_MASK 0x10 FORMAT "%5.3" ECU_ADDRESS 0x60034B0A /end MEASUREMENT
/begin MEASUREMENT DFC_b.LDF_AirCCmprSCB "Bit encoding / Last debounced flag bit for check DFC_AirCCmprSCB" UBYTE DFC_OneToOne 1 100 0.00 1.000 BIT_MASK 0x10 FORMAT "%5.3" ECU_ADDRESS 0x60034B0B /end MEASUREMENT
/begin MEASUREMENT DFC_b.LDF_AirCCmprSCG "Bit encoding / Last debounced flag bit for check DFC_AirCCmprSCG" UBYTE DFC_OneToOne 1 100 0.00 1.000 BIT_MASK 0x10 FORMAT "%5.3" ECU_ADDRESS 0x60034B0C /end MEASUREMENT
/begin MEASUREMENT DFC_b.LDF_AltErr "Bit encoding / Last debounced flag bit for check DFC_AltErr" UBYTE DFC_OneToOne 1 100 0.00 1.000 BIT_MASK 0x10 FORMAT "%5.3" ECU_ADDRESS 0x60034B0D /end MEASUREMENT
/begin MEASUREMENT DFC_b.LDF_BattUSRCMax "Bit encoding / Last debounced flag bit for check DFC_BattUSRCMax" UBYTE DFC_OneToOne 1 100 0.00 1.000 BIT_MASK 0x10 FORMAT "%5.3" ECU_ADDRESS 0x60034B0E /end MEASUREMENT
/begin MEASUREMENT DFC_b.LDF_BattUSRCMin "Bit encoding / Last debounced flag bit for check DFC_BattUSRCMin" UBYTE DFC_OneToOne 1 100 0.00 1.000 BIT_MASK 0x10 FORMAT "%5.3" ECU_ADDRESS 0x60034B0F /end MEASUREMENT
/begin MEASUREMENT DFC_b.LDF_ComChksTCU1 "Bit encoding / Last debounced flag bit for check DFC_ComChksTCU1" UBYTE DFC_OneToOne 1 100 0.00 1.000 BIT_MASK 0x10 FORMAT "%5.3" ECU_ADDRESS 0x60034B10 /end MEASUREMENT
/begin MEASUREMENT DFC_b.LDF_ComChksTCU11 "Bit encoding / Last debounced flag bit for check DFC_ComChksTCU11" UBYTE DFC_OneToOne 1 100 0.00 1.000 BIT_MASK 0x10 FORMAT "%5.3" ECU_ADDRESS 0x60034B11 /end MEASUREMENT
/begin MEASUREMENT DFC_b.LDF_ComChksTCU12 "Bit encoding / Last debounced flag bit for check DFC_ComChksTCU12" UBYTE DFC_OneToOne 1 100 0.00 1.000 BIT_MASK 0x10 FORMAT "%5.3" ECU_ADDRESS 0x60034B12 /end MEASUREMENT
/begin MEASUREMENT DFC_b.LDF_ComChksTCU13 "Bit encoding / Last debounced flag bit for check DFC_ComChksTCU13" UBYTE DFC_OneToOne 1 100 0.00 1.000 BIT_MASK 0x10 FORMAT "%5.3" ECU_ADDRESS 0x60034B13 /end MEASUREMENT
/begin MEASUREMENT DFC_b.LDF_ComChksTCU2 "Bit encoding / Last debounced flag bit for check DFC_ComChksTCU2" UBYTE DFC_OneToOne 1 100 0.00 1.000 BIT_MASK 0x10 FORMAT "%5.3" ECU_ADDRESS 0x60034B14 /end MEASUREMENT
/begin MEASUREMENT DFC_b.LDF_ComChksTCU3 "Bit encoding / Last debounced flag bit for check DFC_ComChksTCU3" UBYTE DFC_OneToOne 1 100 0.00 1.000 BIT_MASK 0x10 FORMAT "%5.3" ECU_ADDRESS 0x60034B15 /end MEASUREMENT
/begin MEASUREMENT DFC_b.LDF_ComChksTCU4 "Bit encoding / Last debounced flag bit for check DFC_ComChksTCU4" UBYTE DFC_OneToOne 1 100 0.00 1.000 BIT_MASK 0x10 FORMAT "%5.3" ECU_ADDRESS 0x60034B16 /end MEASUREMENT
/begin MEASUREMENT DFC_b.LDF_ComCntTCU1 "Bit encoding / Last debounced flag bit for check DFC_ComCntTCU1" UBYTE DFC_OneToOne 1 100 0.00 1.000 BIT_MASK 0x10 FORMAT "%5.3" ECU_ADDRESS 0x60034B17 /end MEASUREMENT
/begin MEASUREMENT DFC_b.LDF_ComCntTCU11 "Bit encoding / Last debounced flag bit for check DFC_ComCntTCU11" UBYTE DFC_OneToOne 1 100 0.00 1.000 BIT_MASK 0x10 FORMAT "%5.3" ECU_ADDRESS 0x60034B18 /end MEASUREMENT
/begin MEASUREMENT DFC_b.LDF_ComCntTCU12 "Bit encoding / Last debounced flag bit for check DFC_ComCntTCU12" UBYTE DFC_OneToOne 1 100 0.00 1.000 BIT_MASK 0x10 FORMAT "%5.3" ECU_ADDRESS 0x60034B19 /end MEASUREMENT
/begin MEASUREMENT DFC_b.LDF_ComCntTCU13 "Bit encoding / Last debounced flag bit for check DFC_ComCntTCU13" UBYTE DFC_OneToOne 1 100 0.00 1.000 BIT_MASK 0x10 FORMAT "%5.3" ECU_ADDRESS 0x60034B1A /end MEASUREMENT
/begin MEASUREMENT DFC_b.LDF_ComCntTCU2 "Bit encoding / Last debounced flag bit for check DFC_ComCntTCU2" UBYTE DFC_OneToOne 1 100 0.00 1.000 BIT_MASK 0x10 FORMAT "%5.3" ECU_ADDRESS 0x60034B1B /end MEASUREMENT
/begin MEASUREMENT DFC_b.LDF_ComCntTCU3 "Bit encoding / Last debounced flag bit for check DFC_ComCntTCU3" UBYTE DFC_OneToOne 1 100 0.00 1.000 BIT_MASK 0x10 FORMAT "%5.3" ECU_ADDRESS 0x60034B1C /end MEASUREMENT
/begin MEASUREMENT DFC_b.LDF_ComCntTCU4 "Bit encoding / Last debounced flag bit for check DFC_ComCntTCU4" UBYTE DFC_OneToOne 1 100 0.00 1.000 BIT_MASK 0x10 FORMAT "%5.3" ECU_ADDRESS 0x60034B1D /end MEASUREMENT
/begin MEASUREMENT DFC_b.LDF_ComTOutTCU01 "Bit encoding / Last debounced flag bit for check DFC_ComTOutTCU01" UBYTE DFC_OneToOne 1 100 0.00 1.000 BIT_MASK 0x10 FORMAT "%5.3" ECU_ADDRESS 0x60034B1E /end MEASUREMENT
/begin MEASUREMENT DFC_b.LDF_ComTOutTCU02 "Bit encoding / Last debounced flag bit for check DFC_ComTOutTCU02" UBYTE DFC_OneToOne 1 100 0.00 1.000 BIT_MASK 0x10 FORMAT "%5.3" ECU_ADDRESS 0x60034B1F /end MEASUREMENT
/begin MEASUREMENT DFC_b.LDF_ComTOutTCU1 "Bit encoding / Last debounced flag bit for check DFC_ComTOutTCU1" UBYTE DFC_OneToOne 1 100 0.00 1.000 BIT_MASK 0x10 FORMAT "%5.3" ECU_ADDRESS 0x60034B20 /end MEASUREMENT
/begin MEASUREMENT DFC_b.LDF_ComTOutTCU11 "Bit encoding / Last debounced flag bit for check DFC_ComTOutTCU11" UBYTE DFC_OneToOne 1 100 0.00 1.000 BIT_MASK 0x10 FORMAT "%5.3" ECU_ADDRESS 0x60034B21 /end MEASUREMENT
/begin MEASUREMENT DFC_b.LDF_ComTOutTCU12 "Bit encoding / Last debounced flag bit for check DFC_ComTOutTCU12" UBYTE DFC_OneToOne 1 100 0.00 1.000 BIT_MASK 0x10 FORMAT "%5.3" ECU_ADDRESS 0x60034B22 /end MEASUREMENT
/begin MEASUREMENT DFC_b.LDF_ComTOutTCU13 "Bit encoding / Last debounced flag bit for check DFC_ComTOutTCU13" UBYTE DFC_OneToOne 1 100 0.00 1.000 BIT_MASK 0x10 FORMAT "%5.3" ECU_ADDRESS 0x60034B23 /end MEASUREMENT
/begin MEASUREMENT DFC_b.LDF_ComTOutTCU14 "Bit encoding / Last debounced flag bit for check DFC_ComTOutTCU14" UBYTE DFC_OneToOne 1 100 0.00 1.000 BIT_MASK 0x10 FORMAT "%5.3" ECU_ADDRESS 0x60034B24 /end MEASUREMENT
/begin MEASUREMENT DFC_b.LDF_ComTOutTCU2 "Bit encoding / Last debounced flag bit for check DFC_ComTOutTCU2" UBYTE DFC_OneToOne 1 100 0.00 1.000 BIT_MASK 0x10 FORMAT "%5.3" ECU_ADDRESS 0x60034B25 /end MEASUREMENT
/begin MEASUREMENT DFC_b.LDF_ComTOutTCU3 "Bit encoding / Last debounced flag bit for check DFC_ComTOutTCU3" UBYTE DFC_OneToOne 1 100 0.00 1.000 BIT_MASK 0x10 FORMAT "%5.3" ECU_ADDRESS 0x60034B26 /end MEASUREMENT
/begin MEASUREMENT DFC_b.LDF_ComTOutTCU4 "Bit encoding / Last debounced flag bit for check DFC_ComTOutTCU4" UBYTE DFC_OneToOne 1 100 0.00 1.000 BIT_MASK 0x10 FORMAT "%5.3" ECU_ADDRESS 0x60034B27 /end MEASUREMENT
/begin MEASUREMENT DFC_b.LDF_DevLibBattUHi "Bit encoding / Last debounced flag bit for check DFC_DevLibBattUHi" UBYTE DFC_OneToOne 1 100 0.00 1.000 BIT_MASK 0x10 FORMAT "%5.3" ECU_ADDRESS 0x60034B28 /end MEASUREMENT
/begin MEASUREMENT DFC_b.LDF_DevLibBattULo "Bit encoding / Last debounced flag bit for check DFC_DevLibBattULo" UBYTE DFC_OneToOne 1 100 0.00 1.000 BIT_MASK 0x10 FORMAT "%5.3" ECU_ADDRESS 0x60034B29 /end MEASUREMENT
/begin MEASUREMENT DFC_b.LDF_FanDIOOL_0 "Bit encoding / Last debounced flag bit for check DFC_FanDIOOL_0" UBYTE DFC_OneToOne 1 100 0.00 1.000 BIT_MASK 0x10 FORMAT "%5.3" ECU_ADDRESS 0x60034B2A /end MEASUREMENT
/begin MEASUREMENT DFC_b.LDF_FanDIOOL_1 "Bit encoding / Last debounced flag bit for check DFC_FanDIOOL_1" UBYTE DFC_OneToOne 1 100 0.00 1.000 BIT_MASK 0x10 FORMAT "%5.3" ECU_ADDRESS 0x60034B2B /end MEASUREMENT
/begin MEASUREMENT DFC_b.LDF_FanDIOOvrTemp_0 "Bit encoding / Last debounced flag bit for check DFC_FanDIOOvrTemp_0" UBYTE DFC_OneToOne 1 100 0.00 1.000 BIT_MASK 0x10 FORMAT "%5.3" ECU_ADDRESS 0x60034B2C /end MEASUREMENT
/begin MEASUREMENT DFC_b.LDF_FanDIOOvrTemp_1 "Bit encoding / Last debounced flag bit for check DFC_FanDIOOvrTemp_1" UBYTE DFC_OneToOne 1 100 0.00 1.000 BIT_MASK 0x10 FORMAT "%5.3" ECU_ADDRESS 0x60034B2D /end MEASUREMENT
/begin MEASUREMENT DFC_b.LDF_FanDIOSCB_0 "Bit encoding / Last debounced flag bit for check DFC_FanDIOSCB_0" UBYTE DFC_OneToOne 1 100 0.00 1.000 BIT_MASK 0x10 FORMAT "%5.3" ECU_ADDRESS 0x60034B2E /end MEASUREMENT
/begin MEASUREMENT DFC_b.LDF_FanDIOSCB_1 "Bit encoding / Last debounced flag bit for check DFC_FanDIOSCB_1" UBYTE DFC_OneToOne 1 100 0.00 1.000 BIT_MASK 0x10 FORMAT "%5.3" ECU_ADDRESS 0x60034B2F /end MEASUREMENT
/begin MEASUREMENT DFC_b.LDF_FanDIOSCG_0 "Bit encoding / Last debounced flag bit for check DFC_FanDIOSCG_0" UBYTE DFC_OneToOne 1 100 0.00 1.000 BIT_MASK 0x10 FORMAT "%5.3" ECU_ADDRESS 0x60034B30 /end MEASUREMENT
/begin MEASUREMENT DFC_b.LDF_FanDIOSCG_1 "Bit encoding / Last debounced flag bit for check DFC_FanDIOSCG_1" UBYTE DFC_OneToOne 1 100 0.00 1.000 BIT_MASK 0x10 FORMAT "%5.3" ECU_ADDRESS 0x60034B31 /end MEASUREMENT
/begin MEASUREMENT DFC_b.LDF_MRlyDcOL "Bit encoding / Last debounced flag bit for check DFC_MRlyDcOL" UBYTE DFC_OneToOne 1 100 0.00 1.000 BIT_MASK 0x10 FORMAT "%5.3" ECU_ADDRESS 0x60034B32 /end MEASUREMENT
/begin MEASUREMENT DFC_b.LDF_MRlyDcSCB "Bit encoding / Last debounced flag bit for check DFC_MRlyDcSCB" UBYTE DFC_OneToOne 1 100 0.00 1.000 BIT_MASK 0x10 FORMAT "%5.3" ECU_ADDRESS 0x60034B33 /end MEASUREMENT
/begin MEASUREMENT DFC_b.LDF_MRlyDcSCG "Bit encoding / Last debounced flag bit for check DFC_MRlyDcSCG" UBYTE DFC_OneToOne 1 100 0.00 1.000 BIT_MASK 0x10 FORMAT "%5.3" ECU_ADDRESS 0x60034B34 /end MEASUREMENT
/begin MEASUREMENT DFC_b.LDF_PSPOL "Bit encoding / Last debounced flag bit for check DFC_PSPOL" UBYTE DFC_OneToOne 1 100 0.00 1.000 BIT_MASK 0x10 FORMAT "%5.3" ECU_ADDRESS 0x60034B35 /end MEASUREMENT
/begin MEASUREMENT DFC_b.LDF_PSPOvrTemp "Bit encoding / Last debounced flag bit for check DFC_PSPOvrTemp" UBYTE DFC_OneToOne 1 100 0.00 1.000 BIT_MASK 0x10 FORMAT "%5.3" ECU_ADDRESS 0x60034B36 /end MEASUREMENT
/begin MEASUREMENT DFC_b.LDF_PSPSCB "Bit encoding / Last debounced flag bit for check DFC_PSPSCB" UBYTE DFC_OneToOne 1 100 0.00 1.000 BIT_MASK 0x10 FORMAT "%5.3" ECU_ADDRESS 0x60034B37 /end MEASUREMENT
/begin MEASUREMENT DFC_b.LDF_PSPSCG "Bit encoding / Last debounced flag bit for check DFC_PSPSCG" UBYTE DFC_OneToOne 1 100 0.00 1.000 BIT_MASK 0x10 FORMAT "%5.3" ECU_ADDRESS 0x60034B38 /end MEASUREMENT
/begin MEASUREMENT DFC_b.LDF_T50Err "Bit encoding / Last debounced flag bit for check DFC_T50Err" UBYTE DFC_OneToOne 1 100 0.00 1.000 BIT_MASK 0x10 FORMAT "%5.3" ECU_ADDRESS 0x60034B39 /end MEASUREMENT
/begin MEASUREMENT DFC_b.LDF_ThrVlvLoBattB1 "Bit encoding / Last debounced flag bit for check DFC_ThrVlvLoBattB1" UBYTE DFC_OneToOne 1 100 0.00 1.000 BIT_MASK 0x10 FORMAT "%5.3" ECU_ADDRESS 0x60034B3A /end MEASUREMENT
/begin MEASUREMENT DFC_b.LDF_VehVPhysRngHi "Bit encoding / Last debounced flag bit for check DFC_VehVPhysRngHi" UBYTE DFC_OneToOne 1 100 0.00 1.000 BIT_MASK 0x10 FORMAT "%5.3" ECU_ADDRESS 0x60034B3B /end MEASUREMENT
/begin MEASUREMENT DFC_b.LDF_VehVSclOutOL "Bit encoding / Last debounced flag bit for check DFC_VehVSclOutOL" UBYTE DFC_OneToOne 1 100 0.00 1.000 BIT_MASK 0x10 FORMAT "%5.3" ECU_ADDRESS 0x60034B3C /end MEASUREMENT
/begin MEASUREMENT DFC_b.LDF_VehVSclOutOT "Bit encoding / Last debounced flag bit for check DFC_VehVSclOutOT" UBYTE DFC_OneToOne 1 100 0.00 1.000 BIT_MASK 0x10 FORMAT "%5.3" ECU_ADDRESS 0x60034B3D /end MEASUREMENT
/begin MEASUREMENT DFC_b.LDF_VehVSclOutSCB "Bit encoding / Last debounced flag bit for check DFC_VehVSclOutSCB" UBYTE DFC_OneToOne 1 100 0.00 1.000 BIT_MASK 0x10 FORMAT "%5.3" ECU_ADDRESS 0x60034B3E /end MEASUREMENT
/begin MEASUREMENT DFC_b.LDF_VehVSclOutSCG "Bit encoding / Last debounced flag bit for check DFC_VehVSclOutSCG" UBYTE DFC_OneToOne 1 100 0.00 1.000 BIT_MASK 0x10 FORMAT "%5.3" ECU_ADDRESS 0x60034B3F /end MEASUREMENT
/begin MEASUREMENT DFC_b.LDF_VehVSnsrARngHi "Bit encoding / Last debounced flag bit for check DFC_VehVSnsrARngHi" UBYTE DFC_OneToOne 1 100 0.00 1.000 BIT_MASK 0x10 FORMAT "%5.3" ECU_ADDRESS 0x60034B40 /end MEASUREMENT
/begin MEASUREMENT DFC_b.LDF_VehVSnsrBRngHi "Bit encoding / Last debounced flag bit for check DFC_VehVSnsrBRngHi" UBYTE DFC_OneToOne 1 100 0.00 1.000 BIT_MASK 0x10 FORMAT "%5.3" ECU_ADDRESS 0x60034B41 /end MEASUREMENT
/begin MEASUREMENT DFC_b.LDF_VehVSpdRtyDiag "Bit encoding / Last debounced flag bit for check DFC_VehVSpdRtyDiag" UBYTE DFC_OneToOne 1 100 0.00 1.000 BIT_MASK 0x10 FORMAT "%5.3" ECU_ADDRESS 0x60034B42 /end MEASUREMENT
/begin MEASUREMENT DFC_b.LDF_VehVWhlErr "Bit encoding / Last debounced flag bit for check DFC_VehVWhlErr" UBYTE DFC_OneToOne 1 100 0.00 1.000 BIT_MASK 0x10 FORMAT "%5.3" ECU_ADDRESS 0x60034B43 /end MEASUREMENT
/begin MEASUREMENT DFC_b.LDF_ACEvpTSRCMax "Bit encoding / Last debounced flag bit for check DFC_ACEvpTSRCMax" UBYTE DFC_OneToOne 1 100 0.00 1.000 BIT_MASK 0x10 FORMAT "%5.3" ECU_ADDRESS 0x60034B44 /end MEASUREMENT
/begin MEASUREMENT DFC_b.LDF_ACEvpTSRCMin "Bit encoding / Last debounced flag bit for check DFC_ACEvpTSRCMin" UBYTE DFC_OneToOne 1 100 0.00 1.000 BIT_MASK 0x10 FORMAT "%5.3" ECU_ADDRESS 0x60034B45 /end MEASUREMENT
/begin MEASUREMENT DFC_b.LDF_AirCClntPAnaSRCMax "Bit encoding / Last debounced flag bit for check DFC_AirCClntPAnaSRCMax" UBYTE DFC_OneToOne 1 100 0.00 1.000 BIT_MASK 0x10 FORMAT "%5.3" ECU_ADDRESS 0x60034B46 /end MEASUREMENT
/begin MEASUREMENT DFC_b.LDF_AirCClntPAnaSRCMin "Bit encoding / Last debounced flag bit for check DFC_AirCClntPAnaSRCMin" UBYTE DFC_OneToOne 1 100 0.00 1.000 BIT_MASK 0x10 FORMAT "%5.3" ECU_ADDRESS 0x60034B47 /end MEASUREMENT
/begin MEASUREMENT DFC_b.LDF_AirCSwtNpl "Bit encoding / Last debounced flag bit for check DFC_AirCSwtNpl" UBYTE DFC_OneToOne 1 100 0.00 1.000 BIT_MASK 0x10 FORMAT "%5.3" ECU_ADDRESS 0x60034B48 /end MEASUREMENT
/begin MEASUREMENT DFC_b.LDF_AirCSwtSig "Bit encoding / Last debounced flag bit for check DFC_AirCSwtSig" UBYTE DFC_OneToOne 1 100 0.00 1.000 BIT_MASK 0x10 FORMAT "%5.3" ECU_ADDRESS 0x60034B49 /end MEASUREMENT
/begin MEASUREMENT DFC_b.LDF_Brk "Bit encoding / Last debounced flag bit for check DFC_Brk" UBYTE DFC_OneToOne 1 100 0.00 1.000 BIT_MASK 0x10 FORMAT "%5.3" ECU_ADDRESS 0x60034B4A /end MEASUREMENT
/begin MEASUREMENT DFC_b.LDF_BrkSig "Bit encoding / Last debounced flag bit for check DFC_BrkSig" UBYTE DFC_OneToOne 1 100 0.00 1.000 BIT_MASK 0x10 FORMAT "%5.3" ECU_ADDRESS 0x60034B4B /end MEASUREMENT
/begin MEASUREMENT DFC_b.LDF_ClthSig "Bit encoding / Last debounced flag bit for check DFC_ClthSig" UBYTE DFC_OneToOne 1 100 0.00 1.000 BIT_MASK 0x10 FORMAT "%5.3" ECU_ADDRESS 0x60034B4C /end MEASUREMENT
/begin MEASUREMENT DFC_b.LDF_HLSDemOvhtEngLim "Bit encoding / Last debounced flag bit for check DFC_HLSDemOvhtEngLim" UBYTE DFC_OneToOne 1 100 0.00 1.000 BIT_MASK 0x10 FORMAT "%5.3" ECU_ADDRESS 0x60034B4D /end MEASUREMENT
/begin MEASUREMENT DFC_b.LDF_OilPNpl "Bit encoding / Last debounced flag bit for check DFC_OilPNpl" UBYTE DFC_OneToOne 1 100 0.00 1.000 BIT_MASK 0x10 FORMAT "%5.3" ECU_ADDRESS 0x60034B4E /end MEASUREMENT
/begin MEASUREMENT DFC_b.LDF_PIntkVUsLineHiB1 "Bit encoding / Last debounced flag bit for check DFC_PIntkVUsLineHiB1" UBYTE DFC_OneToOne 1 100 0.00 1.000 BIT_MASK 0x10 FORMAT "%5.3" ECU_ADDRESS 0x60034B4F /end MEASUREMENT
/begin MEASUREMENT DFC_b.LDF_PIntkVUsLineLoB1 "Bit encoding / Last debounced flag bit for check DFC_PIntkVUsLineLoB1" UBYTE DFC_OneToOne 1 100 0.00 1.000 BIT_MASK 0x10 FORMAT "%5.3" ECU_ADDRESS 0x60034B50 /end MEASUREMENT
/begin MEASUREMENT DFC_b.LDF_VehVPhysRngLo "Bit encoding / Last debounced flag bit for check DFC_VehVPhysRngLo" UBYTE DFC_OneToOne 1 100 0.00 1.000 BIT_MASK 0x10 FORMAT "%5.3" ECU_ADDRESS 0x60034B51 /end MEASUREMENT
/begin MEASUREMENT DFC_b.LDF_VehVSigCan "Bit encoding / Last debounced flag bit for check DFC_VehVSigCan" UBYTE DFC_OneToOne 1 100 0.00 1.000 BIT_MASK 0x10 FORMAT "%5.3" ECU_ADDRESS 0x60034B52 /end MEASUREMENT
/begin MEASUREMENT DFC_b.LDF_VehVSigCanSafe "Bit encoding / Last debounced flag bit for check DFC_VehVSigCanSafe" UBYTE DFC_OneToOne 1 100 0.00 1.000 BIT_MASK 0x10 FORMAT "%5.3" ECU_ADDRESS 0x60034B53 /end MEASUREMENT
/begin MEASUREMENT DFC_b.LDF_VlvLftFbOilPSnsrIntk11SRCMax "Bit encoding / Last debounced flag bit for check DFC_VlvLftFbOilPSnsrIntk11SRCMax" UBYTE DFC_OneToOne 1 100 0.00 1.000 BIT_MASK 0x10 FORMAT "%5.3" ECU_ADDRESS 0x60034B54 /end MEASUREMENT
/begin MEASUREMENT DFC_b.LDF_VlvLftFbOilPSnsrIntk11SRCMin "Bit encoding / Last debounced flag bit for check DFC_VlvLftFbOilPSnsrIntk11SRCMin" UBYTE DFC_OneToOne 1 100 0.00 1.000 BIT_MASK 0x10 FORMAT "%5.3" ECU_ADDRESS 0x60034B55 /end MEASUREMENT
/begin MEASUREMENT DFC_b.LDF_ClthNpl "Bit encoding / Last debounced flag bit for check DFC_ClthNpl" UBYTE DFC_OneToOne 1 100 0.00 1.000 BIT_MASK 0x10 FORMAT "%5.3" ECU_ADDRESS 0x60034B56 /end MEASUREMENT
/begin MEASUREMENT DFC_b.LDF_EV1max "Bit encoding / Last debounced flag bit for check DFC_EV1max" UBYTE DFC_OneToOne 1 100 0.00 1.000 BIT_MASK 0x10 FORMAT "%5.3" ECU_ADDRESS 0x60034B57 /end MEASUREMENT
/begin MEASUREMENT DFC_b.LDF_EV1min "Bit encoding / Last debounced flag bit for check DFC_EV1min" UBYTE DFC_OneToOne 1 100 0.00 1.000 BIT_MASK 0x10 FORMAT "%5.3" ECU_ADDRESS 0x60034B58 /end MEASUREMENT
/begin MEASUREMENT DFC_b.LDF_EV1sig "Bit encoding / Last debounced flag bit for check DFC_EV1sig" UBYTE DFC_OneToOne 1 100 0.00 1.000 BIT_MASK 0x10 FORMAT "%5.3" ECU_ADDRESS 0x60034B59 /end MEASUREMENT
/begin MEASUREMENT DFC_b.LDF_EV2max "Bit encoding / Last debounced flag bit for check DFC_EV2max" UBYTE DFC_OneToOne 1 100 0.00 1.000 BIT_MASK 0x10 FORMAT "%5.3" ECU_ADDRESS 0x60034B5A /end MEASUREMENT
/begin MEASUREMENT DFC_b.LDF_EV2min "Bit encoding / Last debounced flag bit for check DFC_EV2min" UBYTE DFC_OneToOne 1 100 0.00 1.000 BIT_MASK 0x10 FORMAT "%5.3" ECU_ADDRESS 0x60034B5B /end MEASUREMENT
/begin MEASUREMENT DFC_b.LDF_EV2sig "Bit encoding / Last debounced flag bit for check DFC_EV2sig" UBYTE DFC_OneToOne 1 100 0.00 1.000 BIT_MASK 0x10 FORMAT "%5.3" ECU_ADDRESS 0x60034B5C /end MEASUREMENT
/begin MEASUREMENT DFC_b.LDF_EV3max "Bit encoding / Last debounced flag bit for check DFC_EV3max" UBYTE DFC_OneToOne 1 100 0.00 1.000 BIT_MASK 0x10 FORMAT "%5.3" ECU_ADDRESS 0x60034B5D /end MEASUREMENT
/begin MEASUREMENT DFC_b.LDF_EV3min "Bit encoding / Last debounced flag bit for check DFC_EV3min" UBYTE DFC_OneToOne 1 100 0.00 1.000 BIT_MASK 0x10 FORMAT "%5.3" ECU_ADDRESS 0x60034B5E /end MEASUREMENT
/begin MEASUREMENT DFC_b.LDF_EV3sig "Bit encoding / Last debounced flag bit for check DFC_EV3sig" UBYTE DFC_OneToOne 1 100 0.00 1.000 BIT_MASK 0x10 FORMAT "%5.3" ECU_ADDRESS 0x60034B5F /end MEASUREMENT
/begin MEASUREMENT DFC_b.LDF_EV4max "Bit encoding / Last debounced flag bit for check DFC_EV4max" UBYTE DFC_OneToOne 1 100 0.00 1.000 BIT_MASK 0x10 FORMAT "%5.3" ECU_ADDRESS 0x60034B60 /end MEASUREMENT
/begin MEASUREMENT DFC_b.LDF_EV4min "Bit encoding / Last debounced flag bit for check DFC_EV4min" UBYTE DFC_OneToOne 1 100 0.00 1.000 BIT_MASK 0x10 FORMAT "%5.3" ECU_ADDRESS 0x60034B61 /end MEASUREMENT
/begin MEASUREMENT DFC_b.LDF_EV4sig "Bit encoding / Last debounced flag bit for check DFC_EV4sig" UBYTE DFC_OneToOne 1 100 0.00 1.000 BIT_MASK 0x10 FORMAT "%5.3" ECU_ADDRESS 0x60034B62 /end MEASUREMENT
/begin MEASUREMENT DFC_b.LDF_GbxPNPosnDrvCdn "Bit encoding / Last debounced flag bit for check DFC_GbxPNPosnDrvCdn" UBYTE DFC_OneToOne 1 100 0.00 1.000 BIT_MASK 0x10 FORMAT "%5.3" ECU_ADDRESS 0x60034B63 /end MEASUREMENT
/begin MEASUREMENT DFC_b.LDF_GbxPNPosnPlausy "Bit encoding / Last debounced flag bit for check DFC_GbxPNPosnPlausy" UBYTE DFC_OneToOne 1 100 0.00 1.000 BIT_MASK 0x10 FORMAT "%5.3" ECU_ADDRESS 0x60034B64 /end MEASUREMENT
/begin MEASUREMENT DFC_b.LDF_PEnvCcMax "Bit encoding / Last debounced flag bit for check DFC_PEnvCcMax" UBYTE DFC_OneToOne 1 100 0.00 1.000 BIT_MASK 0x10 FORMAT "%5.3" ECU_ADDRESS 0x60034B65 /end MEASUREMENT
/begin MEASUREMENT DFC_b.LDF_PEnvCcMin "Bit encoding / Last debounced flag bit for check DFC_PEnvCcMin" UBYTE DFC_OneToOne 1 100 0.00 1.000 BIT_MASK 0x10 FORMAT "%5.3" ECU_ADDRESS 0x60034B66 /end MEASUREMENT
/begin MEASUREMENT DFC_b.LDF_PEnvRngChkMax "Bit encoding / Last debounced flag bit for check DFC_PEnvRngChkMax" UBYTE DFC_OneToOne 1 100 0.00 1.000 BIT_MASK 0x10 FORMAT "%5.3" ECU_ADDRESS 0x60034B67 /end MEASUREMENT
/begin MEASUREMENT DFC_b.LDF_PEnvRngChkMin "Bit encoding / Last debounced flag bit for check DFC_PEnvRngChkMin" UBYTE DFC_OneToOne 1 100 0.00 1.000 BIT_MASK 0x10 FORMAT "%5.3" ECU_ADDRESS 0x60034B68 /end MEASUREMENT
/begin MEASUREMENT DFC_b.LDF_PEnvSnsrPlaus "Bit encoding / Last debounced flag bit for check DFC_PEnvSnsrPlaus" UBYTE DFC_OneToOne 1 100 0.00 1.000 BIT_MASK 0x10 FORMAT "%5.3" ECU_ADDRESS 0x60034B69 /end MEASUREMENT
/begin MEASUREMENT DFC_b.LDF_UEGOHeatrPsS1B1Max "Bit encoding / Last debounced flag bit for check DFC_UEGOHeatrPsS1B1Max" UBYTE DFC_OneToOne 1 100 0.00 1.000 BIT_MASK 0x10 FORMAT "%5.3" ECU_ADDRESS 0x60034B6A /end MEASUREMENT
/begin MEASUREMENT DFC_b.LDF_UEGOHeatrPsS1B1Min "Bit encoding / Last debounced flag bit for check DFC_UEGOHeatrPsS1B1Min" UBYTE DFC_OneToOne 1 100 0.00 1.000 BIT_MASK 0x10 FORMAT "%5.3" ECU_ADDRESS 0x60034B6B /end MEASUREMENT
/begin MEASUREMENT DFC_b.LDF_UEGOHeatrPsS1B1Sig "Bit encoding / Last debounced flag bit for check DFC_UEGOHeatrPsS1B1Sig" UBYTE DFC_OneToOne 1 100 0.00 1.000 BIT_MASK 0x10 FORMAT "%5.3" ECU_ADDRESS 0x60034B6C /end MEASUREMENT
/begin MEASUREMENT DFC_b.LDF_UEGOHeatrRlyPsOLS1B1 "Bit encoding / Last debounced flag bit for check DFC_UEGOHeatrRlyPsOLS1B1" UBYTE DFC_OneToOne 1 100 0.00 1.000 BIT_MASK 0x10 FORMAT "%5.3" ECU_ADDRESS 0x60034B6D /end MEASUREMENT
/begin MEASUREMENT DFC_b.LDF_UEGOHeatrRlyPsSCBS1B1 "Bit encoding / Last debounced flag bit for check DFC_UEGOHeatrRlyPsSCBS1B1" UBYTE DFC_OneToOne 1 100 0.00 1.000 BIT_MASK 0x10 FORMAT "%5.3" ECU_ADDRESS 0x60034B6E /end MEASUREMENT
/begin MEASUREMENT DFC_b.LDF_UEGOHeatrRlyPsSCGS1B1 "Bit encoding / Last debounced flag bit for check DFC_UEGOHeatrRlyPsSCGS1B1" UBYTE DFC_OneToOne 1 100 0.00 1.000 BIT_MASK 0x10 FORMAT "%5.3" ECU_ADDRESS 0x60034B6F /end MEASUREMENT
/begin MEASUREMENT DFC_b.LDF_KnDetSens1PortAMax "Bit encoding / Last debounced flag bit for check DFC_KnDetSens1PortAMax" UBYTE DFC_OneToOne 1 100 0.00 1.000 BIT_MASK 0x10 FORMAT "%5.3" ECU_ADDRESS 0x60034B70 /end MEASUREMENT
/begin MEASUREMENT DFC_b.LDF_KnDetSens1PortAMin "Bit encoding / Last debounced flag bit for check DFC_KnDetSens1PortAMin" UBYTE DFC_OneToOne 1 100 0.00 1.000 BIT_MASK 0x10 FORMAT "%5.3" ECU_ADDRESS 0x60034B71 /end MEASUREMENT
/begin MEASUREMENT DFC_b.LDF_KnDetSens1PortBMax "Bit encoding / Last debounced flag bit for check DFC_KnDetSens1PortBMax" UBYTE DFC_OneToOne 1 100 0.00 1.000 BIT_MASK 0x10 FORMAT "%5.3" ECU_ADDRESS 0x60034B72 /end MEASUREMENT
/begin MEASUREMENT DFC_b.LDF_KnDetSens1PortBMin "Bit encoding / Last debounced flag bit for check DFC_KnDetSens1PortBMin" UBYTE DFC_OneToOne 1 100 0.00 1.000 BIT_MASK 0x10 FORMAT "%5.3" ECU_ADDRESS 0x60034B73 /end MEASUREMENT
/begin MEASUREMENT DFC_b.LDF_Clth2ONStuck "Bit encoding / Last debounced flag bit for check DFC_Clth2ONStuck" UBYTE DFC_OneToOne 1 100 0.00 1.000 BIT_MASK 0x10 FORMAT "%5.3" ECU_ADDRESS 0x60034B74 /end MEASUREMENT
/begin MEASUREMENT DFC_b.LDF_Clth2ONStuckLdc "Bit encoding / Last debounced flag bit for check DFC_Clth2ONStuckLdc" UBYTE DFC_OneToOne 1 100 0.00 1.000 BIT_MASK 0x10 FORMAT "%5.3" ECU_ADDRESS 0x60034B75 /end MEASUREMENT
/begin MEASUREMENT DFC_b.LDF_Clth3ONStuckLdc "Bit encoding / Last debounced flag bit for check DFC_Clth3ONStuckLdc" UBYTE DFC_OneToOne 1 100 0.00 1.000 BIT_MASK 0x10 FORMAT "%5.3" ECU_ADDRESS 0x60034B76 /end MEASUREMENT
/begin MEASUREMENT DFC_b.LDF_Clth3ONStuckPostDrv "Bit encoding / Last debounced flag bit for check DFC_Clth3ONStuckPostDrv" UBYTE DFC_OneToOne 1 100 0.00 1.000 BIT_MASK 0x10 FORMAT "%5.3" ECU_ADDRESS 0x60034B77 /end MEASUREMENT
/begin MEASUREMENT DFC_b.LDF_Clth4ONStuck "Bit encoding / Last debounced flag bit for check DFC_Clth4ONStuck" UBYTE DFC_OneToOne 1 100 0.00 1.000 BIT_MASK 0x10 FORMAT "%5.3" ECU_ADDRESS 0x60034B78 /end MEASUREMENT
/begin MEASUREMENT DFC_b.LDF_Clth4ONStuckLdc "Bit encoding / Last debounced flag bit for check DFC_Clth4ONStuckLdc" UBYTE DFC_OneToOne 1 100 0.00 1.000 BIT_MASK 0x10 FORMAT "%5.3" ECU_ADDRESS 0x60034B79 /end MEASUREMENT
/begin MEASUREMENT DFC_b.LDF_ComDLCTCU01 "Bit encoding / Last debounced flag bit for check DFC_ComDLCTCU01" UBYTE DFC_OneToOne 1 100 0.00 1.000 BIT_MASK 0x10 FORMAT "%5.3" ECU_ADDRESS 0x60034B7A /end MEASUREMENT
/begin MEASUREMENT DFC_b.LDF_ComDLCTCU02 "Bit encoding / Last debounced flag bit for check DFC_ComDLCTCU02" UBYTE DFC_OneToOne 1 100 0.00 1.000 BIT_MASK 0x10 FORMAT "%5.3" ECU_ADDRESS 0x60034B7B /end MEASUREMENT
/begin MEASUREMENT DFC_b.LDF_ComDLCTCU1 "Bit encoding / Last debounced flag bit for check DFC_ComDLCTCU1" UBYTE DFC_OneToOne 1 100 0.00 1.000 BIT_MASK 0x10 FORMAT "%5.3" ECU_ADDRESS 0x60034B7C /end MEASUREMENT
/begin MEASUREMENT DFC_b.LDF_ComDLCTCU11 "Bit encoding / Last debounced flag bit for check DFC_ComDLCTCU11" UBYTE DFC_OneToOne 1 100 0.00 1.000 BIT_MASK 0x10 FORMAT "%5.3" ECU_ADDRESS 0x60034B7D /end MEASUREMENT
/begin MEASUREMENT DFC_b.LDF_ComDLCTCU12 "Bit encoding / Last debounced flag bit for check DFC_ComDLCTCU12" UBYTE DFC_OneToOne 1 100 0.00 1.000 BIT_MASK 0x10 FORMAT "%5.3" ECU_ADDRESS 0x60034B7E /end MEASUREMENT
/begin MEASUREMENT DFC_b.LDF_ComDLCTCU13 "Bit encoding / Last debounced flag bit for check DFC_ComDLCTCU13" UBYTE DFC_OneToOne 1 100 0.00 1.000 BIT_MASK 0x10 FORMAT "%5.3" ECU_ADDRESS 0x60034B7F /end MEASUREMENT
/begin MEASUREMENT DFC_b.LDF_ComDLCTCU14 "Bit encoding / Last debounced flag bit for check DFC_ComDLCTCU14" UBYTE DFC_OneToOne 1 100 0.00 1.000 BIT_MASK 0x10 FORMAT "%5.3" ECU_ADDRESS 0x60034B80 /end MEASUREMENT
/begin MEASUREMENT DFC_b.LDF_ComDLCTCU2 "Bit encoding / Last debounced flag bit for check DFC_ComDLCTCU2" UBYTE DFC_OneToOne 1 100 0.00 1.000 BIT_MASK 0x10 FORMAT "%5.3" ECU_ADDRESS 0x60034B81 /end MEASUREMENT
/begin MEASUREMENT DFC_b.LDF_ComDLCTCU3 "Bit encoding / Last debounced flag bit for check DFC_ComDLCTCU3" UBYTE DFC_OneToOne 1 100 0.00 1.000 BIT_MASK 0x10 FORMAT "%5.3" ECU_ADDRESS 0x60034B82 /end MEASUREMENT
/begin MEASUREMENT DFC_b.LDF_ComDLCTCU4 "Bit encoding / Last debounced flag bit for check DFC_ComDLCTCU4" UBYTE DFC_OneToOne 1 100 0.00 1.000 BIT_MASK 0x10 FORMAT "%5.3" ECU_ADDRESS 0x60034B83 /end MEASUREMENT
/begin MEASUREMENT DFC_b.LDF_EVX "Bit encoding / Last debounced flag bit for check DFC_EVX" UBYTE DFC_OneToOne 1 100 0.00 1.000 BIT_MASK 0x10 FORMAT "%5.3" ECU_ADDRESS 0x60034B84 /end MEASUREMENT
/begin MEASUREMENT DFC_b.LDF_EbsSocFlt "Bit encoding / Last debounced flag bit for check DFC_EbsSocFlt" UBYTE DFC_OneToOne 1 100 0.00 1.000 BIT_MASK 0x10 FORMAT "%5.3" ECU_ADDRESS 0x60034B85 /end MEASUREMENT
/begin MEASUREMENT DFC_b.LDF_I14229VINErr "Bit encoding / Last debounced flag bit for check DFC_I14229VINErr" UBYTE DFC_OneToOne 1 100 0.00 1.000 BIT_MASK 0x10 FORMAT "%5.3" ECU_ADDRESS 0x60034B86 /end MEASUREMENT
/begin MEASUREMENT DFC_b.LDF_LLRKHmax "Bit encoding / Last debounced flag bit for check DFC_LLRKHmax" UBYTE DFC_OneToOne 1 100 0.00 1.000 BIT_MASK 0x10 FORMAT "%5.3" ECU_ADDRESS 0x60034B87 /end MEASUREMENT
/begin MEASUREMENT DFC_b.LDF_LLRKHmin "Bit encoding / Last debounced flag bit for check DFC_LLRKHmin" UBYTE DFC_OneToOne 1 100 0.00 1.000 BIT_MASK 0x10 FORMAT "%5.3" ECU_ADDRESS 0x60034B88 /end MEASUREMENT
/begin MEASUREMENT DFC_b.LDF_LLRmax "Bit encoding / Last debounced flag bit for check DFC_LLRmax" UBYTE DFC_OneToOne 1 100 0.00 1.000 BIT_MASK 0x10 FORMAT "%5.3" ECU_ADDRESS 0x60034B89 /end MEASUREMENT
/begin MEASUREMENT DFC_b.LDF_LLRmin "Bit encoding / Last debounced flag bit for check DFC_LLRmin" UBYTE DFC_OneToOne 1 100 0.00 1.000 BIT_MASK 0x10 FORMAT "%5.3" ECU_ADDRESS 0x60034B8A /end MEASUREMENT
/begin MEASUREMENT DFC_b.LDF_RoughRoad "Bit encoding / Last debounced flag bit for check DFC_RoughRoad" UBYTE DFC_OneToOne 1 100 0.00 1.000 BIT_MASK 0x10 FORMAT "%5.3" ECU_ADDRESS 0x60034B8B /end MEASUREMENT
/begin MEASUREMENT DFC_b.LDF_SiaEEPRdErr "Bit encoding / Last debounced flag bit for check DFC_SiaEEPRdErr" UBYTE DFC_OneToOne 1 100 0.00 1.000 BIT_MASK 0x10 FORMAT "%5.3" ECU_ADDRESS 0x60034B8C /end MEASUREMENT
/begin MEASUREMENT DFC_b.LDF_SiaEEPWrngCod "Bit encoding / Last debounced flag bit for check DFC_SiaEEPWrngCod" UBYTE DFC_OneToOne 1 100 0.00 1.000 BIT_MASK 0x10 FORMAT "%5.3" ECU_ADDRESS 0x60034B8D /end MEASUREMENT
/begin MEASUREMENT DFC_b.LDF_UegoDummy "Bit encoding / Last debounced flag bit for check DFC_UegoDummy" UBYTE DFC_OneToOne 1 100 0.00 1.000 BIT_MASK 0x10 FORMAT "%5.3" ECU_ADDRESS 0x60034B8E /end MEASUREMENT
/begin MEASUREMENT DFC_b.LDF_BusDiagCANAPPLBusOff "Bit encoding / Last debounced flag bit for check DFC_BusDiagCANAPPLBusOff" UBYTE DFC_OneToOne 1 100 0.00 1.000 BIT_MASK 0x10 FORMAT "%5.3" ECU_ADDRESS 0x60034B8F /end MEASUREMENT
/begin MEASUREMENT DFC_b.LDF_BusDiagCANCANCBusOff "Bit encoding / Last debounced flag bit for check DFC_BusDiagCANCANCBusOff" UBYTE DFC_OneToOne 1 100 0.00 1.000 BIT_MASK 0x10 FORMAT "%5.3" ECU_ADDRESS 0x60034B90 /end MEASUREMENT
/begin MEASUREMENT DFC_b.LDF_BusDiagCANVEHICLEBusOff "Bit encoding / Last debounced flag bit for check DFC_BusDiagCANVEHICLEBusOff" UBYTE DFC_OneToOne 1 100 0.00 1.000 BIT_MASK 0x10 FORMAT "%5.3" ECU_ADDRESS 0x60034B91 /end MEASUREMENT
/begin MEASUREMENT DFC_b.LDF_RBA_IODIAGPWR_rba_IoExtCy329_SignalVltSply_0 "Bit encoding / Last debounced flag bit for check DFC_RBA_IODIAGPWR_rba_IoExtCy329_SignalVltSply_0" UBYTE DFC_OneToOne 1 100 0.00 1.000 BIT_MASK 0x10 FORMAT "%5.3" ECU_ADDRESS 0x60034B92 /end MEASUREMENT
/begin MEASUREMENT DFC_b.LDF_RBA_IODIAGPWR_rba_IoExtCy329_SignalVltSply_0OT "Bit encoding / Last debounced flag bit for check DFC_RBA_IODIAGPWR_rba_IoExtCy329_SignalVltSply_0OT" UBYTE DFC_OneToOne 1 100 0.00 1.000 BIT_MASK 0x10 FORMAT "%5.3" ECU_ADDRESS 0x60034B93 /end MEASUREMENT
/begin MEASUREMENT DFC_b.LDF_RBA_IODIAGPWR_rba_IoExtCy329_SignalVltSply_0OV "Bit encoding / Last debounced flag bit for check DFC_RBA_IODIAGPWR_rba_IoExtCy329_SignalVltSply_0OV" UBYTE DFC_OneToOne 1 100 0.00 1.000 BIT_MASK 0x10 FORMAT "%5.3" ECU_ADDRESS 0x60034B94 /end MEASUREMENT
/begin MEASUREMENT DFC_b.LDF_RBA_IODIAGPWR_rba_IoExtCy329_SignalVltSply_0SCG "Bit encoding / Last debounced flag bit for check DFC_RBA_IODIAGPWR_rba_IoExtCy329_SignalVltSply_0SCG" UBYTE DFC_OneToOne 1 100 0.00 1.000 BIT_MASK 0x10 FORMAT "%5.3" ECU_ADDRESS 0x60034B95 /end MEASUREMENT
/begin MEASUREMENT DFC_b.LDF_RBA_IODIAGPWR_rba_IoExtCy329_SignalVltSply_0UV "Bit encoding / Last debounced flag bit for check DFC_RBA_IODIAGPWR_rba_IoExtCy329_SignalVltSply_0UV" UBYTE DFC_OneToOne 1 100 0.00 1.000 BIT_MASK 0x10 FORMAT "%5.3" ECU_ADDRESS 0x60034B96 /end MEASUREMENT
/begin MEASUREMENT DFC_b.LDF_RBA_IODIAGPWR_rba_IoExtCy329_SignalVltSply_1 "Bit encoding / Last debounced flag bit for check DFC_RBA_IODIAGPWR_rba_IoExtCy329_SignalVltSply_1" UBYTE DFC_OneToOne 1 100 0.00 1.000 BIT_MASK 0x10 FORMAT "%5.3" ECU_ADDRESS 0x60034B97 /end MEASUREMENT
/begin MEASUREMENT DFC_b.LDF_RBA_IODIAGPWR_rba_IoExtCy329_SignalVltSply_1OT "Bit encoding / Last debounced flag bit for check DFC_RBA_IODIAGPWR_rba_IoExtCy329_SignalVltSply_1OT" UBYTE DFC_OneToOne 1 100 0.00 1.000 BIT_MASK 0x10 FORMAT "%5.3" ECU_ADDRESS 0x60034B98 /end MEASUREMENT
/begin MEASUREMENT DFC_b.LDF_RBA_IODIAGPWR_rba_IoExtCy329_SignalVltSply_1OV "Bit encoding / Last debounced flag bit for check DFC_RBA_IODIAGPWR_rba_IoExtCy329_SignalVltSply_1OV" UBYTE DFC_OneToOne 1 100 0.00 1.000 BIT_MASK 0x10 FORMAT "%5.3" ECU_ADDRESS 0x60034B99 /end MEASUREMENT
/begin MEASUREMENT DFC_b.LDF_RBA_IODIAGPWR_rba_IoExtCy329_SignalVltSply_1SCG "Bit encoding / Last debounced flag bit for check DFC_RBA_IODIAGPWR_rba_IoExtCy329_SignalVltSply_1SCG" UBYTE DFC_OneToOne 1 100 0.00 1.000 BIT_MASK 0x10 FORMAT "%5.3" ECU_ADDRESS 0x60034B9A /end MEASUREMENT
/begin MEASUREMENT DFC_b.LDF_RBA_IODIAGPWR_rba_IoExtCy329_SignalVltSply_1UV "Bit encoding / Last debounced flag bit for check DFC_RBA_IODIAGPWR_rba_IoExtCy329_SignalVltSply_1UV" UBYTE DFC_OneToOne 1 100 0.00 1.000 BIT_MASK 0x10 FORMAT "%5.3" ECU_ADDRESS 0x60034B9B /end MEASUREMENT
/begin MEASUREMENT DFC_b.LDF_RBA_IODIAGPWR_rba_IoExtCy329_SignalVltSply_2 "Bit encoding / Last debounced flag bit for check DFC_RBA_IODIAGPWR_rba_IoExtCy329_SignalVltSply_2" UBYTE DFC_OneToOne 1 100 0.00 1.000 BIT_MASK 0x10 FORMAT "%5.3" ECU_ADDRESS 0x60034B9C /end MEASUREMENT
/begin MEASUREMENT DFC_b.LDF_RBA_IODIAGPWR_rba_IoExtCy329_SignalVltSply_2OT "Bit encoding / Last debounced flag bit for check DFC_RBA_IODIAGPWR_rba_IoExtCy329_SignalVltSply_2OT" UBYTE DFC_OneToOne 1 100 0.00 1.000 BIT_MASK 0x10 FORMAT "%5.3" ECU_ADDRESS 0x60034B9D /end MEASUREMENT
/begin MEASUREMENT DFC_b.LDF_RBA_IODIAGPWR_rba_IoExtCy329_SignalVltSply_2OV "Bit encoding / Last debounced flag bit for check DFC_RBA_IODIAGPWR_rba_IoExtCy329_SignalVltSply_2OV" UBYTE DFC_OneToOne 1 100 0.00 1.000 BIT_MASK 0x10 FORMAT "%5.3" ECU_ADDRESS 0x60034B9E /end MEASUREMENT
/begin MEASUREMENT DFC_b.LDF_RBA_IODIAGPWR_rba_IoExtCy329_SignalVltSply_2SCG "Bit encoding / Last debounced flag bit for check DFC_RBA_IODIAGPWR_rba_IoExtCy329_SignalVltSply_2SCG" UBYTE DFC_OneToOne 1 100 0.00 1.000 BIT_MASK 0x10 FORMAT "%5.3" ECU_ADDRESS 0x60034B9F /end MEASUREMENT
/begin MEASUREMENT DFC_b.LDF_RBA_IODIAGPWR_rba_IoExtCy329_SignalVltSply_2UV "Bit encoding / Last debounced flag bit for check DFC_RBA_IODIAGPWR_rba_IoExtCy329_SignalVltSply_2UV" UBYTE DFC_OneToOne 1 100 0.00 1.000 BIT_MASK 0x10 FORMAT "%5.3" ECU_ADDRESS 0x60034BA0 /end MEASUREMENT
/begin MEASUREMENT DFC_b.LDF_CAN_E_TIMEOUT "Bit encoding / Last debounced flag bit for check DFC_CAN_E_TIMEOUT" UBYTE DFC_OneToOne 1 100 0.00 1.000 BIT_MASK 0x10 FORMAT "%5.3" ECU_ADDRESS 0x60034BA1 /end MEASUREMENT
/begin MEASUREMENT DFC_b.LDF_LIN_E_TIMEOUT "Bit encoding / Last debounced flag bit for check DFC_LIN_E_TIMEOUT" UBYTE DFC_OneToOne 1 100 0.00 1.000 BIT_MASK 0x10 FORMAT "%5.3" ECU_ADDRESS 0x60034BA2 /end MEASUREMENT
/begin MEASUREMENT DFC_b.LDF_MRlyOL "Bit encoding / Last debounced flag bit for check DFC_MRlyOL" UBYTE DFC_OneToOne 1 100 0.00 1.000 BIT_MASK 0x10 FORMAT "%5.3" ECU_ADDRESS 0x60034BA3 /end MEASUREMENT
/begin MEASUREMENT DFC_b.LDF_MRlySCB "Bit encoding / Last debounced flag bit for check DFC_MRlySCB" UBYTE DFC_OneToOne 1 100 0.00 1.000 BIT_MASK 0x10 FORMAT "%5.3" ECU_ADDRESS 0x60034BA4 /end MEASUREMENT
/begin MEASUREMENT DFC_b.LDF_MRlySCG "Bit encoding / Last debounced flag bit for check DFC_MRlySCG" UBYTE DFC_OneToOne 1 100 0.00 1.000 BIT_MASK 0x10 FORMAT "%5.3" ECU_ADDRESS 0x60034BA5 /end MEASUREMENT
/begin MEASUREMENT DFC_b.LDF_rba_MultiStackTrace_Threshold "Bit encoding / Last debounced flag bit for check DFC_rba_MultiStackTrace_Threshold" UBYTE DFC_OneToOne 1 100 0.00 1.000 BIT_MASK 0x10 FORMAT "%5.3" ECU_ADDRESS 0x60034BA6 /end MEASUREMENT
/begin MEASUREMENT DFC_b.LDF_BSWM_E_ACTION_FAILED "Bit encoding / Last debounced flag bit for check DFC_BSWM_E_ACTION_FAILED" UBYTE DFC_OneToOne 1 100 0.00 1.000 BIT_MASK 0x10 FORMAT "%5.3" ECU_ADDRESS 0x60034BA7 /end MEASUREMENT
/begin MEASUREMENT DFC_b.LDF_BSWM_E_INTRPTQUEUE_FULL "Bit encoding / Last debounced flag bit for check DFC_BSWM_E_INTRPTQUEUE_FULL" UBYTE DFC_OneToOne 1 100 0.00 1.000 BIT_MASK 0x10 FORMAT "%5.3" ECU_ADDRESS 0x60034BA8 /end MEASUREMENT
/begin MEASUREMENT DFC_b.LDF_RBA_IOEXTLIB_KEEPALIVE_DRV "Bit encoding / Last debounced flag bit for check DFC_RBA_IOEXTLIB_KEEPALIVE_DRV" UBYTE DFC_OneToOne 1 100 0.00 1.000 BIT_MASK 0x10 FORMAT "%5.3" ECU_ADDRESS 0x60034BA9 /end MEASUREMENT
/begin MEASUREMENT DFC_b.LDF_RBA_IOEXTLIB_KEEPALIVE_INI "Bit encoding / Last debounced flag bit for check DFC_RBA_IOEXTLIB_KEEPALIVE_INI" UBYTE DFC_OneToOne 1 100 0.00 1.000 BIT_MASK 0x10 FORMAT "%5.3" ECU_ADDRESS 0x60034BAA /end MEASUREMENT
/begin MEASUREMENT DFC_b.LDF_rba_IoSigRtc_StopCounter "Bit encoding / Last debounced flag bit for check DFC_rba_IoSigRtc_StopCounter" UBYTE DFC_OneToOne 1 100 0.00 1.000 BIT_MASK 0x10 FORMAT "%5.3" ECU_ADDRESS 0x60034BAB /end MEASUREMENT
/begin MEASUREMENT DFC_b.LDF_rba_MRly_Diag_Stk_Event "Bit encoding / Last debounced flag bit for check DFC_rba_MRly_Diag_Stk_Event" UBYTE DFC_OneToOne 1 100 0.00 1.000 BIT_MASK 0x10 FORMAT "%5.3" ECU_ADDRESS 0x60034BAC /end MEASUREMENT
/begin MEASUREMENT DFC_b.LDF_rba_MemDiag_MemReadErr "Bit encoding / Last debounced flag bit for check DFC_rba_MemDiag_MemReadErr" UBYTE DFC_OneToOne 1 100 0.00 1.000 BIT_MASK 0x10 FORMAT "%5.3" ECU_ADDRESS 0x60034BAD /end MEASUREMENT
/begin MEASUREMENT DFC_b.LDF_rba_MemDiag_MemWrErr "Bit encoding / Last debounced flag bit for check DFC_rba_MemDiag_MemWrErr" UBYTE DFC_OneToOne 1 100 0.00 1.000 BIT_MASK 0x10 FORMAT "%5.3" ECU_ADDRESS 0x60034BAE /end MEASUREMENT
/begin MEASUREMENT DFC_b.LDF_rba_SyC_IrrSwOffTrigEngRun_Event "Bit encoding / Last debounced flag bit for check DFC_rba_SyC_IrrSwOffTrigEngRun_Event" UBYTE DFC_OneToOne 1 100 0.00 1.000 BIT_MASK 0x10 FORMAT "%5.3" ECU_ADDRESS 0x60034BAF /end MEASUREMENT
/begin MEASUREMENT DFC_b.LDF_rba_T15_Diag_ComInVld_Event "Bit encoding / Last debounced flag bit for check DFC_rba_T15_Diag_ComInVld_Event" UBYTE DFC_OneToOne 1 100 0.00 1.000 BIT_MASK 0x10 FORMAT "%5.3" ECU_ADDRESS 0x60034BB0 /end MEASUREMENT
/begin MEASUREMENT DFC_b.LDF_rba_T15_Diag_ComOff_HwOn_Event "Bit encoding / Last debounced flag bit for check DFC_rba_T15_Diag_ComOff_HwOn_Event" UBYTE DFC_OneToOne 1 100 0.00 1.000 BIT_MASK 0x10 FORMAT "%5.3" ECU_ADDRESS 0x60034BB1 /end MEASUREMENT
/begin MEASUREMENT DFC_b.LDF_rba_T15_Diag_ComOn_HwOff_Event "Bit encoding / Last debounced flag bit for check DFC_rba_T15_Diag_ComOn_HwOff_Event" UBYTE DFC_OneToOne 1 100 0.00 1.000 BIT_MASK 0x10 FORMAT "%5.3" ECU_ADDRESS 0x60034BB2 /end MEASUREMENT
/begin MEASUREMENT DFC_b.LDF_AppAllSnsrDfct "Bit encoding / Last debounced flag bit for check DFC_AppAllSnsrDfct" UBYTE DFC_OneToOne 1 100 0.00 1.000 BIT_MASK 0x10 FORMAT "%5.3" ECU_ADDRESS 0x60034BB3 /end MEASUREMENT
/begin MEASUREMENT DFC_b.LDF_BattUStdbyDiaOL "Bit encoding / Last debounced flag bit for check DFC_BattUStdbyDiaOL" UBYTE DFC_OneToOne 1 100 0.00 1.000 BIT_MASK 0x10 FORMAT "%5.3" ECU_ADDRESS 0x60034BB4 /end MEASUREMENT
/begin MEASUREMENT DFC_b.LDF_BigLeakIntkMnfldEmiInfl "Bit encoding / Last debounced flag bit for check DFC_BigLeakIntkMnfldEmiInfl" UBYTE DFC_OneToOne 1 100 0.00 1.000 BIT_MASK 0x10 FORMAT "%5.3" ECU_ADDRESS 0x60034BB5 /end MEASUREMENT
/begin MEASUREMENT DFC_b.LDF_BrkMnSwtContOnWarnLmp "Bit encoding / Last debounced flag bit for check DFC_BrkMnSwtContOnWarnLmp" UBYTE DFC_OneToOne 1 100 0.00 1.000 BIT_MASK 0x10 FORMAT "%5.3" ECU_ADDRESS 0x60034BB6 /end MEASUREMENT
/begin MEASUREMENT DFC_b.LDF_BrkMnSwtNotStpWarnLmp "Bit encoding / Last debounced flag bit for check DFC_BrkMnSwtNotStpWarnLmp" UBYTE DFC_OneToOne 1 100 0.00 1.000 BIT_MASK 0x10 FORMAT "%5.3" ECU_ADDRESS 0x60034BB7 /end MEASUREMENT
/begin MEASUREMENT DFC_b.LDF_BrkRdntSwtContOnWarnLmp "Bit encoding / Last debounced flag bit for check DFC_BrkRdntSwtContOnWarnLmp" UBYTE DFC_OneToOne 1 100 0.00 1.000 BIT_MASK 0x10 FORMAT "%5.3" ECU_ADDRESS 0x60034BB8 /end MEASUREMENT
/begin MEASUREMENT DFC_b.LDF_BrkRdntSwtNotStpWarnLmp "Bit encoding / Last debounced flag bit for check DFC_BrkRdntSwtNotStpWarnLmp" UBYTE DFC_OneToOne 1 100 0.00 1.000 BIT_MASK 0x10 FORMAT "%5.3" ECU_ADDRESS 0x60034BB9 /end MEASUREMENT
/begin MEASUREMENT DFC_b.LDF_CEngDsTColdStrtMax "Bit encoding / Last debounced flag bit for check DFC_CEngDsTColdStrtMax" UBYTE DFC_OneToOne 1 100 0.00 1.000 BIT_MASK 0x10 FORMAT "%5.3" ECU_ADDRESS 0x60034BBA /end MEASUREMENT
/begin MEASUREMENT DFC_b.LDF_CEngDsTColdStrtMin "Bit encoding / Last debounced flag bit for check DFC_CEngDsTColdStrtMin" UBYTE DFC_OneToOne 1 100 0.00 1.000 BIT_MASK 0x10 FORMAT "%5.3" ECU_ADDRESS 0x60034BBB /end MEASUREMENT
/begin MEASUREMENT DFC_b.LDF_CEngDsTImps "Bit encoding / Last debounced flag bit for check DFC_CEngDsTImps" UBYTE DFC_OneToOne 1 100 0.00 1.000 BIT_MASK 0x10 FORMAT "%5.3" ECU_ADDRESS 0x60034BBC /end MEASUREMENT
/begin MEASUREMENT DFC_b.LDF_CEngDsTPlausLSC "Bit encoding / Last debounced flag bit for check DFC_CEngDsTPlausLSC" UBYTE DFC_OneToOne 1 100 0.00 1.000 BIT_MASK 0x10 FORMAT "%5.3" ECU_ADDRESS 0x60034BBD /end MEASUREMENT
/begin MEASUREMENT DFC_b.LDF_CEngDsTPlausSTC "Bit encoding / Last debounced flag bit for check DFC_CEngDsTPlausSTC" UBYTE DFC_OneToOne 1 100 0.00 1.000 BIT_MASK 0x10 FORMAT "%5.3" ECU_ADDRESS 0x60034BBE /end MEASUREMENT
/begin MEASUREMENT DFC_b.LDF_CEngDsTSRCMax "Bit encoding / Last debounced flag bit for check DFC_CEngDsTSRCMax" UBYTE DFC_OneToOne 1 100 0.00 1.000 BIT_MASK 0x10 FORMAT "%5.3" ECU_ADDRESS 0x60034BBF /end MEASUREMENT
/begin MEASUREMENT DFC_b.LDF_CEngDsTSRCMin "Bit encoding / Last debounced flag bit for check DFC_CEngDsTSRCMin" UBYTE DFC_OneToOne 1 100 0.00 1.000 BIT_MASK 0x10 FORMAT "%5.3" ECU_ADDRESS 0x60034BC0 /end MEASUREMENT
/begin MEASUREMENT DFC_b.LDF_CEngDsTSig "Bit encoding / Last debounced flag bit for check DFC_CEngDsTSig" UBYTE DFC_OneToOne 1 100 0.00 1.000 BIT_MASK 0x10 FORMAT "%5.3" ECU_ADDRESS 0x60034BC1 /end MEASUREMENT
/begin MEASUREMENT DFC_b.LDF_CEngUsTSRCMax "Bit encoding / Last debounced flag bit for check DFC_CEngUsTSRCMax" UBYTE DFC_OneToOne 1 100 0.00 1.000 BIT_MASK 0x10 FORMAT "%5.3" ECU_ADDRESS 0x60034BC2 /end MEASUREMENT
/begin MEASUREMENT DFC_b.LDF_CEngUsTSRCMin "Bit encoding / Last debounced flag bit for check DFC_CEngUsTSRCMin" UBYTE DFC_OneToOne 1 100 0.00 1.000 BIT_MASK 0x10 FORMAT "%5.3" ECU_ADDRESS 0x60034BC3 /end MEASUREMENT
/begin MEASUREMENT DFC_b.LDF_DCDCFltDet "Bit encoding / Last debounced flag bit for check DFC_DCDCFltDet" UBYTE DFC_OneToOne 1 100 0.00 1.000 BIT_MASK 0x10 FORMAT "%5.3" ECU_ADDRESS 0x60034BC4 /end MEASUREMENT
/begin MEASUREMENT DFC_b.LDF_DKRSA "Bit encoding / Last debounced flag bit for check DFC_DKRSA" UBYTE DFC_OneToOne 1 100 0.00 1.000 BIT_MASK 0x10 FORMAT "%5.3" ECU_ADDRESS 0x60034BC5 /end MEASUREMENT
/begin MEASUREMENT DFC_b.LDF_DKVSmax "Bit encoding / Last debounced flag bit for check DFC_DKVSmax" UBYTE DFC_OneToOne 1 100 0.00 1.000 BIT_MASK 0x10 FORMAT "%5.3" ECU_ADDRESS 0x60034BC6 /end MEASUREMENT
/begin MEASUREMENT DFC_b.LDF_DKnpl "Bit encoding / Last debounced flag bit for check DFC_DKnpl" UBYTE DFC_OneToOne 1 100 0.00 1.000 BIT_MASK 0x10 FORMAT "%5.3" ECU_ADDRESS 0x60034BC7 /end MEASUREMENT
/begin MEASUREMENT DFC_b.LDF_DSSmax "Bit encoding / Last debounced flag bit for check DFC_DSSmax" UBYTE DFC_OneToOne 1 100 0.00 1.000 BIT_MASK 0x10 FORMAT "%5.3" ECU_ADDRESS 0x60034BC8 /end MEASUREMENT
/begin MEASUREMENT DFC_b.LDF_DSTTI "Bit encoding / Last debounced flag bit for check DFC_DSTTI" UBYTE DFC_OneToOne 1 100 0.00 1.000 BIT_MASK 0x10 FORMAT "%5.3" ECU_ADDRESS 0x60034BC9 /end MEASUREMENT
/begin MEASUREMENT DFC_b.LDF_DSUmax "Bit encoding / Last debounced flag bit for check DFC_DSUmax" UBYTE DFC_OneToOne 1 100 0.00 1.000 BIT_MASK 0x10 FORMAT "%5.3" ECU_ADDRESS 0x60034BCA /end MEASUREMENT
/begin MEASUREMENT DFC_b.LDF_EGRVlvOL "Bit encoding / Last debounced flag bit for check DFC_EGRVlvOL" UBYTE DFC_OneToOne 1 100 0.00 1.000 BIT_MASK 0x10 FORMAT "%5.3" ECU_ADDRESS 0x60034BCB /end MEASUREMENT
/begin MEASUREMENT DFC_b.LDF_EGRVlvSCB "Bit encoding / Last debounced flag bit for check DFC_EGRVlvSCB" UBYTE DFC_OneToOne 1 100 0.00 1.000 BIT_MASK 0x10 FORMAT "%5.3" ECU_ADDRESS 0x60034BCC /end MEASUREMENT
/begin MEASUREMENT DFC_b.LDF_EGRVlvSCG "Bit encoding / Last debounced flag bit for check DFC_EGRVlvSCG" UBYTE DFC_OneToOne 1 100 0.00 1.000 BIT_MASK 0x10 FORMAT "%5.3" ECU_ADDRESS 0x60034BCD /end MEASUREMENT
/begin MEASUREMENT DFC_b.LDF_EGSDUS2B1LtrDly "Bit encoding / Last debounced flag bit for check DFC_EGSDUS2B1LtrDly" UBYTE DFC_OneToOne 1 100 0.00 1.000 BIT_MASK 0x10 FORMAT "%5.3" ECU_ADDRESS 0x60034BCE /end MEASUREMENT
/begin MEASUREMENT DFC_b.LDF_EGSDUS2B1LtrPT1 "Bit encoding / Last debounced flag bit for check DFC_EGSDUS2B1LtrPT1" UBYTE DFC_OneToOne 1 100 0.00 1.000 BIT_MASK 0x10 FORMAT "%5.3" ECU_ADDRESS 0x60034BCF /end MEASUREMENT
/begin MEASUREMENT DFC_b.LDF_EGSDUS2B1RtlDly "Bit encoding / Last debounced flag bit for check DFC_EGSDUS2B1RtlDly" UBYTE DFC_OneToOne 1 100 0.00 1.000 BIT_MASK 0x10 FORMAT "%5.3" ECU_ADDRESS 0x60034BD0 /end MEASUREMENT
/begin MEASUREMENT DFC_b.LDF_EGSDUS2B1RtlPT1 "Bit encoding / Last debounced flag bit for check DFC_EGSDUS2B1RtlPT1" UBYTE DFC_OneToOne 1 100 0.00 1.000 BIT_MASK 0x10 FORMAT "%5.3" ECU_ADDRESS 0x60034BD1 /end MEASUREMENT
/begin MEASUREMENT DFC_b.LDF_EGSDUS2B1TarLean "Bit encoding / Last debounced flag bit for check DFC_EGSDUS2B1TarLean" UBYTE DFC_OneToOne 1 100 0.00 1.000 BIT_MASK 0x10 FORMAT "%5.3" ECU_ADDRESS 0x60034BD2 /end MEASUREMENT
/begin MEASUREMENT DFC_b.LDF_EGSDUS2B1TarRich "Bit encoding / Last debounced flag bit for check DFC_EGSDUS2B1TarRich" UBYTE DFC_OneToOne 1 100 0.00 1.000 BIT_MASK 0x10 FORMAT "%5.3" ECU_ADDRESS 0x60034BD3 /end MEASUREMENT
/begin MEASUREMENT DFC_b.LDF_ETAKHLmax "Bit encoding / Last debounced flag bit for check DFC_ETAKHLmax" UBYTE DFC_OneToOne 1 100 0.00 1.000 BIT_MASK 0x10 FORMAT "%5.3" ECU_ADDRESS 0x60034BD4 /end MEASUREMENT
/begin MEASUREMENT DFC_b.LDF_ETAKHTmax "Bit encoding / Last debounced flag bit for check DFC_ETAKHTmax" UBYTE DFC_OneToOne 1 100 0.00 1.000 BIT_MASK 0x10 FORMAT "%5.3" ECU_ADDRESS 0x60034BD5 /end MEASUREMENT
/begin MEASUREMENT DFC_b.LDF_EngICO "Bit encoding / Last debounced flag bit for check DFC_EngICO" UBYTE DFC_OneToOne 1 100 0.00 1.000 BIT_MASK 0x10 FORMAT "%5.3" ECU_ADDRESS 0x60034BD6 /end MEASUREMENT
/begin MEASUREMENT DFC_b.LDF_EngPrtOvrSpdMon "Bit encoding / Last debounced flag bit for check DFC_EngPrtOvrSpdMon" UBYTE DFC_OneToOne 1 100 0.00 1.000 BIT_MASK 0x10 FORMAT "%5.3" ECU_ADDRESS 0x60034BD7 /end MEASUREMENT
/begin MEASUREMENT DFC_b.LDF_EpmCaSI1ErrSig "Bit encoding / Last debounced flag bit for check DFC_EpmCaSI1ErrSig" UBYTE DFC_OneToOne 1 100 0.00 1.000 BIT_MASK 0x10 FORMAT "%5.3" ECU_ADDRESS 0x60034BD8 /end MEASUREMENT
/begin MEASUREMENT DFC_b.LDF_EpmCaSI1NoSig "Bit encoding / Last debounced flag bit for check DFC_EpmCaSI1NoSig" UBYTE DFC_OneToOne 1 100 0.00 1.000 BIT_MASK 0x10 FORMAT "%5.3" ECU_ADDRESS 0x60034BD9 /end MEASUREMENT
/begin MEASUREMENT DFC_b.LDF_EpmCaSI1OfsErr "Bit encoding / Last debounced flag bit for check DFC_EpmCaSI1OfsErr" UBYTE DFC_OneToOne 1 100 0.00 1.000 BIT_MASK 0x10 FORMAT "%5.3" ECU_ADDRESS 0x60034BDA /end MEASUREMENT
/begin MEASUREMENT DFC_b.LDF_EpmCrSErrSig "Bit encoding / Last debounced flag bit for check DFC_EpmCrSErrSig" UBYTE DFC_OneToOne 1 100 0.00 1.000 BIT_MASK 0x10 FORMAT "%5.3" ECU_ADDRESS 0x60034BDB /end MEASUREMENT
/begin MEASUREMENT DFC_b.LDF_EpmCrSNoSig "Bit encoding / Last debounced flag bit for check DFC_EpmCrSNoSig" UBYTE DFC_OneToOne 1 100 0.00 1.000 BIT_MASK 0x10 FORMAT "%5.3" ECU_ADDRESS 0x60034BDC /end MEASUREMENT
/begin MEASUREMENT DFC_b.LDF_EtaEngIdleNonCsers "Bit encoding / Last debounced flag bit for check DFC_EtaEngIdleNonCsers" UBYTE DFC_OneToOne 1 100 0.00 1.000 BIT_MASK 0x10 FORMAT "%5.3" ECU_ADDRESS 0x60034BDD /end MEASUREMENT
/begin MEASUREMENT DFC_b.LDF_EtaEngPtlNonCsers "Bit encoding / Last debounced flag bit for check DFC_EtaEngPtlNonCsers" UBYTE DFC_OneToOne 1 100 0.00 1.000 BIT_MASK 0x10 FORMAT "%5.3" ECU_ADDRESS 0x60034BDE /end MEASUREMENT
/begin MEASUREMENT DFC_b.LDF_FRAmax "Bit encoding / Last debounced flag bit for check DFC_FRAmax" UBYTE DFC_OneToOne 1 100 0.00 1.000 BIT_MASK 0x10 FORMAT "%5.3" ECU_ADDRESS 0x60034BDF /end MEASUREMENT
/begin MEASUREMENT DFC_b.LDF_FRAmin "Bit encoding / Last debounced flag bit for check DFC_FRAmin" UBYTE DFC_OneToOne 1 100 0.00 1.000 BIT_MASK 0x10 FORMAT "%5.3" ECU_ADDRESS 0x60034BE0 /end MEASUREMENT
/begin MEASUREMENT DFC_b.LDF_GbxRvsSwtStk "Bit encoding / Last debounced flag bit for check DFC_GbxRvsSwtStk" UBYTE DFC_OneToOne 1 100 0.00 1.000 BIT_MASK 0x10 FORMAT "%5.3" ECU_ADDRESS 0x60034BE1 /end MEASUREMENT
/begin MEASUREMENT DFC_b.LDF_HDRmax "Bit encoding / Last debounced flag bit for check DFC_HDRmax" UBYTE DFC_OneToOne 1 100 0.00 1.000 BIT_MASK 0x10 FORMAT "%5.3" ECU_ADDRESS 0x60034BE2 /end MEASUREMENT
/begin MEASUREMENT DFC_b.LDF_HEGOS2B1ElecMax "Bit encoding / Last debounced flag bit for check DFC_HEGOS2B1ElecMax" UBYTE DFC_OneToOne 1 100 0.00 1.000 BIT_MASK 0x10 FORMAT "%5.3" ECU_ADDRESS 0x60034BE3 /end MEASUREMENT
/begin MEASUREMENT DFC_b.LDF_HEGOS2B1ElecMin "Bit encoding / Last debounced flag bit for check DFC_HEGOS2B1ElecMin" UBYTE DFC_OneToOne 1 100 0.00 1.000 BIT_MASK 0x10 FORMAT "%5.3" ECU_ADDRESS 0x60034BE4 /end MEASUREMENT
/begin MEASUREMENT DFC_b.LDF_HEGOS2B1ElecSig "Bit encoding / Last debounced flag bit for check DFC_HEGOS2B1ElecSig" UBYTE DFC_OneToOne 1 100 0.00 1.000 BIT_MASK 0x10 FORMAT "%5.3" ECU_ADDRESS 0x60034BE5 /end MEASUREMENT
/begin MEASUREMENT DFC_b.LDF_HEGOS2B1HtgNpl "Bit encoding / Last debounced flag bit for check DFC_HEGOS2B1HtgNpl" UBYTE DFC_OneToOne 1 100 0.00 1.000 BIT_MASK 0x10 FORMAT "%5.3" ECU_ADDRESS 0x60034BE6 /end MEASUREMENT
/begin MEASUREMENT DFC_b.LDF_IntkAirTIntkMnfldCrssMax "Bit encoding / Last debounced flag bit for check DFC_IntkAirTIntkMnfldCrssMax" UBYTE DFC_OneToOne 1 100 0.00 1.000 BIT_MASK 0x10 FORMAT "%5.3" ECU_ADDRESS 0x60034BE7 /end MEASUREMENT
/begin MEASUREMENT DFC_b.LDF_IntkAirTIntkMnfldCrssMin "Bit encoding / Last debounced flag bit for check DFC_IntkAirTIntkMnfldCrssMin" UBYTE DFC_OneToOne 1 100 0.00 1.000 BIT_MASK 0x10 FORMAT "%5.3" ECU_ADDRESS 0x60034BE8 /end MEASUREMENT
/begin MEASUREMENT DFC_b.LDF_IntkAirTIntkMnfldHSCMax "Bit encoding / Last debounced flag bit for check DFC_IntkAirTIntkMnfldHSCMax" UBYTE DFC_OneToOne 1 100 0.00 1.000 BIT_MASK 0x10 FORMAT "%5.3" ECU_ADDRESS 0x60034BE9 /end MEASUREMENT
/begin MEASUREMENT DFC_b.LDF_IntkAirTIntkMnfldImps "Bit encoding / Last debounced flag bit for check DFC_IntkAirTIntkMnfldImps" UBYTE DFC_OneToOne 1 100 0.00 1.000 BIT_MASK 0x10 FORMAT "%5.3" ECU_ADDRESS 0x60034BEA /end MEASUREMENT
/begin MEASUREMENT DFC_b.LDF_IntkAirTIntkMnfldPRCMax "Bit encoding / Last debounced flag bit for check DFC_IntkAirTIntkMnfldPRCMax" UBYTE DFC_OneToOne 1 100 0.00 1.000 BIT_MASK 0x10 FORMAT "%5.3" ECU_ADDRESS 0x60034BEB /end MEASUREMENT
/begin MEASUREMENT DFC_b.LDF_IntkAirTIntkMnfldPRCMin "Bit encoding / Last debounced flag bit for check DFC_IntkAirTIntkMnfldPRCMin" UBYTE DFC_OneToOne 1 100 0.00 1.000 BIT_MASK 0x10 FORMAT "%5.3" ECU_ADDRESS 0x60034BEC /end MEASUREMENT
/begin MEASUREMENT DFC_b.LDF_IntkAirTIntkMnfldSRCMax "Bit encoding / Last debounced flag bit for check DFC_IntkAirTIntkMnfldSRCMax" UBYTE DFC_OneToOne 1 100 0.00 1.000 BIT_MASK 0x10 FORMAT "%5.3" ECU_ADDRESS 0x60034BED /end MEASUREMENT
/begin MEASUREMENT DFC_b.LDF_IntkAirTIntkMnfldSRCMin "Bit encoding / Last debounced flag bit for check DFC_IntkAirTIntkMnfldSRCMin" UBYTE DFC_OneToOne 1 100 0.00 1.000 BIT_MASK 0x10 FORMAT "%5.3" ECU_ADDRESS 0x60034BEE /end MEASUREMENT
/begin MEASUREMENT DFC_b.LDF_IntkAirTIntkMnfldSTC "Bit encoding / Last debounced flag bit for check DFC_IntkAirTIntkMnfldSTC" UBYTE DFC_OneToOne 1 100 0.00 1.000 BIT_MASK 0x10 FORMAT "%5.3" ECU_ADDRESS 0x60034BEF /end MEASUREMENT
/begin MEASUREMENT DFC_b.LDF_KS1max "Bit encoding / Last debounced flag bit for check DFC_KS1max" UBYTE DFC_OneToOne 1 100 0.00 1.000 BIT_MASK 0x10 FORMAT "%5.3" ECU_ADDRESS 0x60034BF0 /end MEASUREMENT
/begin MEASUREMENT DFC_b.LDF_KS1min "Bit encoding / Last debounced flag bit for check DFC_KS1min" UBYTE DFC_OneToOne 1 100 0.00 1.000 BIT_MASK 0x10 FORMAT "%5.3" ECU_ADDRESS 0x60034BF1 /end MEASUREMENT
/begin MEASUREMENT DFC_b.LDF_LMmax "Bit encoding / Last debounced flag bit for check DFC_LMmax" UBYTE DFC_OneToOne 1 100 0.00 1.000 BIT_MASK 0x10 FORMAT "%5.3" ECU_ADDRESS 0x60034BF2 /end MEASUREMENT
/begin MEASUREMENT DFC_b.LDF_LZSRnpl "Bit encoding / Last debounced flag bit for check DFC_LZSRnpl" UBYTE DFC_OneToOne 1 100 0.00 1.000 BIT_MASK 0x10 FORMAT "%5.3" ECU_ADDRESS 0x60034BF3 /end MEASUREMENT
/begin MEASUREMENT DFC_b.LDF_LamDynDiagS1B1 "Bit encoding / Last debounced flag bit for check DFC_LamDynDiagS1B1" UBYTE DFC_OneToOne 1 100 0.00 1.000 BIT_MASK 0x10 FORMAT "%5.3" ECU_ADDRESS 0x60034BF4 /end MEASUREMENT
/begin MEASUREMENT DFC_b.LDF_LeakIntkMnfldEmiInfl "Bit encoding / Last debounced flag bit for check DFC_LeakIntkMnfldEmiInfl" UBYTE DFC_OneToOne 1 100 0.00 1.000 BIT_MASK 0x10 FORMAT "%5.3" ECU_ADDRESS 0x60034BF5 /end MEASUREMENT
/begin MEASUREMENT DFC_b.LDF_MD00max "Bit encoding / Last debounced flag bit for check DFC_MD00max" UBYTE DFC_OneToOne 1 100 0.00 1.000 BIT_MASK 0x10 FORMAT "%5.3" ECU_ADDRESS 0x60034BF6 /end MEASUREMENT
/begin MEASUREMENT DFC_b.LDF_MDBmax "Bit encoding / Last debounced flag bit for check DFC_MDBmax" UBYTE DFC_OneToOne 1 100 0.00 1.000 BIT_MASK 0x10 FORMAT "%5.3" ECU_ADDRESS 0x60034BF7 /end MEASUREMENT
/begin MEASUREMENT DFC_b.LDF_MDCat "Bit encoding / Last debounced flag bit for check DFC_MDCat" UBYTE DFC_OneToOne 1 100 0.00 1.000 BIT_MASK 0x10 FORMAT "%5.3" ECU_ADDRESS 0x60034BF8 /end MEASUREMENT
/begin MEASUREMENT DFC_b.LDF_MDCatCrit "Bit encoding / Last debounced flag bit for check DFC_MDCatCrit" UBYTE DFC_OneToOne 1 100 0.00 1.000 BIT_MASK 0x10 FORMAT "%5.3" ECU_ADDRESS 0x60034BF9 /end MEASUREMENT
/begin MEASUREMENT DFC_b.LDF_MDCatCurr "Bit encoding / Last debounced flag bit for check DFC_MDCatCurr" UBYTE DFC_OneToOne 1 100 0.00 1.000 BIT_MASK 0x10 FORMAT "%5.3" ECU_ADDRESS 0x60034BFA /end MEASUREMENT
/begin MEASUREMENT DFC_b.LDF_MDCyl_0 "Bit encoding / Last debounced flag bit for check DFC_MDCyl_0" UBYTE DFC_OneToOne 1 100 0.00 1.000 BIT_MASK 0x10 FORMAT "%5.3" ECU_ADDRESS 0x60034BFB /end MEASUREMENT
/begin MEASUREMENT DFC_b.LDF_MDCyl_1 "Bit encoding / Last debounced flag bit for check DFC_MDCyl_1" UBYTE DFC_OneToOne 1 100 0.00 1.000 BIT_MASK 0x10 FORMAT "%5.3" ECU_ADDRESS 0x60034BFC /end MEASUREMENT
/begin MEASUREMENT DFC_b.LDF_MDCyl_2 "Bit encoding / Last debounced flag bit for check DFC_MDCyl_2" UBYTE DFC_OneToOne 1 100 0.00 1.000 BIT_MASK 0x10 FORMAT "%5.3" ECU_ADDRESS 0x60034BFD /end MEASUREMENT
/begin MEASUREMENT DFC_b.LDF_MDCyl_3 "Bit encoding / Last debounced flag bit for check DFC_MDCyl_3" UBYTE DFC_OneToOne 1 100 0.00 1.000 BIT_MASK 0x10 FORMAT "%5.3" ECU_ADDRESS 0x60034BFE /end MEASUREMENT
/begin MEASUREMENT DFC_b.LDF_MDEmi "Bit encoding / Last debounced flag bit for check DFC_MDEmi" UBYTE DFC_OneToOne 1 100 0.00 1.000 BIT_MASK 0x10 FORMAT "%5.3" ECU_ADDRESS 0x60034BFF /end MEASUREMENT
/begin MEASUREMENT DFC_b.LDF_MDEmiStrt "Bit encoding / Last debounced flag bit for check DFC_MDEmiStrt" UBYTE DFC_OneToOne 1 100 0.00 1.000 BIT_MASK 0x10 FORMAT "%5.3" ECU_ADDRESS 0x60034C00 /end MEASUREMENT
/begin MEASUREMENT DFC_b.LDF_MDFco "Bit encoding / Last debounced flag bit for check DFC_MDFco" UBYTE DFC_OneToOne 1 100 0.00 1.000 BIT_MASK 0x10 FORMAT "%5.3" ECU_ADDRESS 0x60034C01 /end MEASUREMENT
/begin MEASUREMENT DFC_b.LDF_MDMpl "Bit encoding / Last debounced flag bit for check DFC_MDMpl" UBYTE DFC_OneToOne 1 100 0.00 1.000 BIT_MASK 0x10 FORMAT "%5.3" ECU_ADDRESS 0x60034C02 /end MEASUREMENT
/begin MEASUREMENT DFC_b.LDF_MDSegTiAdpn "Bit encoding / Last debounced flag bit for check DFC_MDSegTiAdpn" UBYTE DFC_OneToOne 1 100 0.00 1.000 BIT_MASK 0x10 FORMAT "%5.3" ECU_ADDRESS 0x60034C03 /end MEASUREMENT
/begin MEASUREMENT DFC_b.LDF_MDmax "Bit encoding / Last debounced flag bit for check DFC_MDmax" UBYTE DFC_OneToOne 1 100 0.00 1.000 BIT_MASK 0x10 FORMAT "%5.3" ECU_ADDRESS 0x60034C04 /end MEASUREMENT
/begin MEASUREMENT DFC_b.LDF_MOXEMM_SMU_ALM0_0 "Bit encoding / Last debounced flag bit for check DFC_MOXEMM_SMU_ALM0_0" UBYTE DFC_OneToOne 1 100 0.00 1.000 BIT_MASK 0x10 FORMAT "%5.3" ECU_ADDRESS 0x60034C05 /end MEASUREMENT
/begin MEASUREMENT DFC_b.LDF_MOXEMM_SMU_ALM0_1 "Bit encoding / Last debounced flag bit for check DFC_MOXEMM_SMU_ALM0_1" UBYTE DFC_OneToOne 1 100 0.00 1.000 BIT_MASK 0x10 FORMAT "%5.3" ECU_ADDRESS 0x60034C06 /end MEASUREMENT
/begin MEASUREMENT DFC_b.LDF_MOXEMM_SMU_ALM0_10 "Bit encoding / Last debounced flag bit for check DFC_MOXEMM_SMU_ALM0_10" UBYTE DFC_OneToOne 1 100 0.00 1.000 BIT_MASK 0x10 FORMAT "%5.3" ECU_ADDRESS 0x60034C07 /end MEASUREMENT
/begin MEASUREMENT DFC_b.LDF_MOXEMM_SMU_ALM0_11 "Bit encoding / Last debounced flag bit for check DFC_MOXEMM_SMU_ALM0_11" UBYTE DFC_OneToOne 1 100 0.00 1.000 BIT_MASK 0x10 FORMAT "%5.3" ECU_ADDRESS 0x60034C08 /end MEASUREMENT
/begin MEASUREMENT DFC_b.LDF_MOXEMM_SMU_ALM0_13 "Bit encoding / Last debounced flag bit for check DFC_MOXEMM_SMU_ALM0_13" UBYTE DFC_OneToOne 1 100 0.00 1.000 BIT_MASK 0x10 FORMAT "%5.3" ECU_ADDRESS 0x60034C09 /end MEASUREMENT
/begin MEASUREMENT DFC_b.LDF_MOXEMM_SMU_ALM0_14 "Bit encoding / Last debounced flag bit for check DFC_MOXEMM_SMU_ALM0_14" UBYTE DFC_OneToOne 1 100 0.00 1.000 BIT_MASK 0x10 FORMAT "%5.3" ECU_ADDRESS 0x60034C0A /end MEASUREMENT
/begin MEASUREMENT DFC_b.LDF_MOXEMM_SMU_ALM0_2 "Bit encoding / Last debounced flag bit for check DFC_MOXEMM_SMU_ALM0_2" UBYTE DFC_OneToOne 1 100 0.00 1.000 BIT_MASK 0x10 FORMAT "%5.3" ECU_ADDRESS 0x60034C0B /end MEASUREMENT
/begin MEASUREMENT DFC_b.LDF_MOXEMM_SMU_ALM0_22 "Bit encoding / Last debounced flag bit for check DFC_MOXEMM_SMU_ALM0_22" UBYTE DFC_OneToOne 1 100 0.00 1.000 BIT_MASK 0x10 FORMAT "%5.3" ECU_ADDRESS 0x60034C0C /end MEASUREMENT
/begin MEASUREMENT DFC_b.LDF_MOXEMM_SMU_ALM0_23 "Bit encoding / Last debounced flag bit for check DFC_MOXEMM_SMU_ALM0_23" UBYTE DFC_OneToOne 1 100 0.00 1.000 BIT_MASK 0x10 FORMAT "%5.3" ECU_ADDRESS 0x60034C0D /end MEASUREMENT
/begin MEASUREMENT DFC_b.LDF_MOXEMM_SMU_ALM0_4 "Bit encoding / Last debounced flag bit for check DFC_MOXEMM_SMU_ALM0_4" UBYTE DFC_OneToOne 1 100 0.00 1.000 BIT_MASK 0x10 FORMAT "%5.3" ECU_ADDRESS 0x60034C0E /end MEASUREMENT
/begin MEASUREMENT DFC_b.LDF_MOXEMM_SMU_ALM0_5 "Bit encoding / Last debounced flag bit for check DFC_MOXEMM_SMU_ALM0_5" UBYTE DFC_OneToOne 1 100 0.00 1.000 BIT_MASK 0x10 FORMAT "%5.3" ECU_ADDRESS 0x60034C0F /end MEASUREMENT
/begin MEASUREMENT DFC_b.LDF_MOXEMM_SMU_ALM0_7 "Bit encoding / Last debounced flag bit for check DFC_MOXEMM_SMU_ALM0_7" UBYTE DFC_OneToOne 1 100 0.00 1.000 BIT_MASK 0x10 FORMAT "%5.3" ECU_ADDRESS 0x60034C10 /end MEASUREMENT
/begin MEASUREMENT DFC_b.LDF_MOXEMM_SMU_ALM0_8 "Bit encoding / Last debounced flag bit for check DFC_MOXEMM_SMU_ALM0_8" UBYTE DFC_OneToOne 1 100 0.00 1.000 BIT_MASK 0x10 FORMAT "%5.3" ECU_ADDRESS 0x60034C11 /end MEASUREMENT
/begin MEASUREMENT DFC_b.LDF_MOXEMM_SMU_ALM10_16 "Bit encoding / Last debounced flag bit for check DFC_MOXEMM_SMU_ALM10_16" UBYTE DFC_OneToOne 1 100 0.00 1.000 BIT_MASK 0x10 FORMAT "%5.3" ECU_ADDRESS 0x60034C12 /end MEASUREMENT
/begin MEASUREMENT DFC_b.LDF_MOXEMM_SMU_ALM10_17 "Bit encoding / Last debounced flag bit for check DFC_MOXEMM_SMU_ALM10_17" UBYTE DFC_OneToOne 1 100 0.00 1.000 BIT_MASK 0x10 FORMAT "%5.3" ECU_ADDRESS 0x60034C13 /end MEASUREMENT
/begin MEASUREMENT DFC_b.LDF_MOXEMM_SMU_ALM10_21 "Bit encoding / Last debounced flag bit for check DFC_MOXEMM_SMU_ALM10_21" UBYTE DFC_OneToOne 1 100 0.00 1.000 BIT_MASK 0x10 FORMAT "%5.3" ECU_ADDRESS 0x60034C14 /end MEASUREMENT
/begin MEASUREMENT DFC_b.LDF_MOXEMM_SMU_ALM11_0 "Bit encoding / Last debounced flag bit for check DFC_MOXEMM_SMU_ALM11_0" UBYTE DFC_OneToOne 1 100 0.00 1.000 BIT_MASK 0x10 FORMAT "%5.3" ECU_ADDRESS 0x60034C15 /end MEASUREMENT
/begin MEASUREMENT DFC_b.LDF_MOXEMM_SMU_ALM11_1 "Bit encoding / Last debounced flag bit for check DFC_MOXEMM_SMU_ALM11_1" UBYTE DFC_OneToOne 1 100 0.00 1.000 BIT_MASK 0x10 FORMAT "%5.3" ECU_ADDRESS 0x60034C16 /end MEASUREMENT
/begin MEASUREMENT DFC_b.LDF_MOXEMM_SMU_ALM11_2 "Bit encoding / Last debounced flag bit for check DFC_MOXEMM_SMU_ALM11_2" UBYTE DFC_OneToOne 1 100 0.00 1.000 BIT_MASK 0x10 FORMAT "%5.3" ECU_ADDRESS 0x60034C17 /end MEASUREMENT
/begin MEASUREMENT DFC_b.LDF_MOXEMM_SMU_ALM11_3 "Bit encoding / Last debounced flag bit for check DFC_MOXEMM_SMU_ALM11_3" UBYTE DFC_OneToOne 1 100 0.00 1.000 BIT_MASK 0x10 FORMAT "%5.3" ECU_ADDRESS 0x60034C18 /end MEASUREMENT
/begin MEASUREMENT DFC_b.LDF_MOXEMM_SMU_ALM11_4 "Bit encoding / Last debounced flag bit for check DFC_MOXEMM_SMU_ALM11_4" UBYTE DFC_OneToOne 1 100 0.00 1.000 BIT_MASK 0x10 FORMAT "%5.3" ECU_ADDRESS 0x60034C19 /end MEASUREMENT
/begin MEASUREMENT DFC_b.LDF_MOXEMM_SMU_ALM11_5 "Bit encoding / Last debounced flag bit for check DFC_MOXEMM_SMU_ALM11_5" UBYTE DFC_OneToOne 1 100 0.00 1.000 BIT_MASK 0x10 FORMAT "%5.3" ECU_ADDRESS 0x60034C1A /end MEASUREMENT
/begin MEASUREMENT DFC_b.LDF_MOXEMM_SMU_ALM11_8 "Bit encoding / Last debounced flag bit for check DFC_MOXEMM_SMU_ALM11_8" UBYTE DFC_OneToOne 1 100 0.00 1.000 BIT_MASK 0x10 FORMAT "%5.3" ECU_ADDRESS 0x60034C1B /end MEASUREMENT
/begin MEASUREMENT DFC_b.LDF_MOXEMM_SMU_ALM11_9 "Bit encoding / Last debounced flag bit for check DFC_MOXEMM_SMU_ALM11_9" UBYTE DFC_OneToOne 1 100 0.00 1.000 BIT_MASK 0x10 FORMAT "%5.3" ECU_ADDRESS 0x60034C1C /end MEASUREMENT
/begin MEASUREMENT DFC_b.LDF_MOXEMM_SMU_ALM1_0 "Bit encoding / Last debounced flag bit for check DFC_MOXEMM_SMU_ALM1_0" UBYTE DFC_OneToOne 1 100 0.00 1.000 BIT_MASK 0x10 FORMAT "%5.3" ECU_ADDRESS 0x60034C1D /end MEASUREMENT
/begin MEASUREMENT DFC_b.LDF_MOXEMM_SMU_ALM1_1 "Bit encoding / Last debounced flag bit for check DFC_MOXEMM_SMU_ALM1_1" UBYTE DFC_OneToOne 1 100 0.00 1.000 BIT_MASK 0x10 FORMAT "%5.3" ECU_ADDRESS 0x60034C1E /end MEASUREMENT
/begin MEASUREMENT DFC_b.LDF_MOXEMM_SMU_ALM1_10 "Bit encoding / Last debounced flag bit for check DFC_MOXEMM_SMU_ALM1_10" UBYTE DFC_OneToOne 1 100 0.00 1.000 BIT_MASK 0x10 FORMAT "%5.3" ECU_ADDRESS 0x60034C1F /end MEASUREMENT
/begin MEASUREMENT DFC_b.LDF_MOXEMM_SMU_ALM1_11 "Bit encoding / Last debounced flag bit for check DFC_MOXEMM_SMU_ALM1_11" UBYTE DFC_OneToOne 1 100 0.00 1.000 BIT_MASK 0x10 FORMAT "%5.3" ECU_ADDRESS 0x60034C20 /end MEASUREMENT
/begin MEASUREMENT DFC_b.LDF_MOXEMM_SMU_ALM1_13 "Bit encoding / Last debounced flag bit for check DFC_MOXEMM_SMU_ALM1_13" UBYTE DFC_OneToOne 1 100 0.00 1.000 BIT_MASK 0x10 FORMAT "%5.3" ECU_ADDRESS 0x60034C21 /end MEASUREMENT
/begin MEASUREMENT DFC_b.LDF_MOXEMM_SMU_ALM1_14 "Bit encoding / Last debounced flag bit for check DFC_MOXEMM_SMU_ALM1_14" UBYTE DFC_OneToOne 1 100 0.00 1.000 BIT_MASK 0x10 FORMAT "%5.3" ECU_ADDRESS 0x60034C22 /end MEASUREMENT
/begin MEASUREMENT DFC_b.LDF_MOXEMM_SMU_ALM1_2 "Bit encoding / Last debounced flag bit for check DFC_MOXEMM_SMU_ALM1_2" UBYTE DFC_OneToOne 1 100 0.00 1.000 BIT_MASK 0x10 FORMAT "%5.3" ECU_ADDRESS 0x60034C23 /end MEASUREMENT
/begin MEASUREMENT DFC_b.LDF_MOXEMM_SMU_ALM1_22 "Bit encoding / Last debounced flag bit for check DFC_MOXEMM_SMU_ALM1_22" UBYTE DFC_OneToOne 1 100 0.00 1.000 BIT_MASK 0x10 FORMAT "%5.3" ECU_ADDRESS 0x60034C24 /end MEASUREMENT
/begin MEASUREMENT DFC_b.LDF_MOXEMM_SMU_ALM1_23 "Bit encoding / Last debounced flag bit for check DFC_MOXEMM_SMU_ALM1_23" UBYTE DFC_OneToOne 1 100 0.00 1.000 BIT_MASK 0x10 FORMAT "%5.3" ECU_ADDRESS 0x60034C25 /end MEASUREMENT
/begin MEASUREMENT DFC_b.LDF_MOXEMM_SMU_ALM1_4 "Bit encoding / Last debounced flag bit for check DFC_MOXEMM_SMU_ALM1_4" UBYTE DFC_OneToOne 1 100 0.00 1.000 BIT_MASK 0x10 FORMAT "%5.3" ECU_ADDRESS 0x60034C26 /end MEASUREMENT
/begin MEASUREMENT DFC_b.LDF_MOXEMM_SMU_ALM1_5 "Bit encoding / Last debounced flag bit for check DFC_MOXEMM_SMU_ALM1_5" UBYTE DFC_OneToOne 1 100 0.00 1.000 BIT_MASK 0x10 FORMAT "%5.3" ECU_ADDRESS 0x60034C27 /end MEASUREMENT
/begin MEASUREMENT DFC_b.LDF_MOXEMM_SMU_ALM1_7 "Bit encoding / Last debounced flag bit for check DFC_MOXEMM_SMU_ALM1_7" UBYTE DFC_OneToOne 1 100 0.00 1.000 BIT_MASK 0x10 FORMAT "%5.3" ECU_ADDRESS 0x60034C28 /end MEASUREMENT
/begin MEASUREMENT DFC_b.LDF_MOXEMM_SMU_ALM1_8 "Bit encoding / Last debounced flag bit for check DFC_MOXEMM_SMU_ALM1_8" UBYTE DFC_OneToOne 1 100 0.00 1.000 BIT_MASK 0x10 FORMAT "%5.3" ECU_ADDRESS 0x60034C29 /end MEASUREMENT
/begin MEASUREMENT DFC_b.LDF_MOXEMM_SMU_ALM21_0 "Bit encoding / Last debounced flag bit for check DFC_MOXEMM_SMU_ALM21_0" UBYTE DFC_OneToOne 1 100 0.00 1.000 BIT_MASK 0x10 FORMAT "%5.3" ECU_ADDRESS 0x60034C2A /end MEASUREMENT
/begin MEASUREMENT DFC_b.LDF_MOXEMM_SMU_ALM21_16 "Bit encoding / Last debounced flag bit for check DFC_MOXEMM_SMU_ALM21_16" UBYTE DFC_OneToOne 1 100 0.00 1.000 BIT_MASK 0x10 FORMAT "%5.3" ECU_ADDRESS 0x60034C2B /end MEASUREMENT
/begin MEASUREMENT DFC_b.LDF_MOXEMM_SMU_ALM21_3 "Bit encoding / Last debounced flag bit for check DFC_MOXEMM_SMU_ALM21_3" UBYTE DFC_OneToOne 1 100 0.00 1.000 BIT_MASK 0x10 FORMAT "%5.3" ECU_ADDRESS 0x60034C2C /end MEASUREMENT
/begin MEASUREMENT DFC_b.LDF_MOXEMM_SMU_ALM2_1 "Bit encoding / Last debounced flag bit for check DFC_MOXEMM_SMU_ALM2_1" UBYTE DFC_OneToOne 1 100 0.00 1.000 BIT_MASK 0x10 FORMAT "%5.3" ECU_ADDRESS 0x60034C2D /end MEASUREMENT
/begin MEASUREMENT DFC_b.LDF_MOXEMM_SMU_ALM2_10 "Bit encoding / Last debounced flag bit for check DFC_MOXEMM_SMU_ALM2_10" UBYTE DFC_OneToOne 1 100 0.00 1.000 BIT_MASK 0x10 FORMAT "%5.3" ECU_ADDRESS 0x60034C2E /end MEASUREMENT
/begin MEASUREMENT DFC_b.LDF_MOXEMM_SMU_ALM2_11 "Bit encoding / Last debounced flag bit for check DFC_MOXEMM_SMU_ALM2_11" UBYTE DFC_OneToOne 1 100 0.00 1.000 BIT_MASK 0x10 FORMAT "%5.3" ECU_ADDRESS 0x60034C2F /end MEASUREMENT
/begin MEASUREMENT DFC_b.LDF_MOXEMM_SMU_ALM2_13 "Bit encoding / Last debounced flag bit for check DFC_MOXEMM_SMU_ALM2_13" UBYTE DFC_OneToOne 1 100 0.00 1.000 BIT_MASK 0x10 FORMAT "%5.3" ECU_ADDRESS 0x60034C30 /end MEASUREMENT
/begin MEASUREMENT DFC_b.LDF_MOXEMM_SMU_ALM2_14 "Bit encoding / Last debounced flag bit for check DFC_MOXEMM_SMU_ALM2_14" UBYTE DFC_OneToOne 1 100 0.00 1.000 BIT_MASK 0x10 FORMAT "%5.3" ECU_ADDRESS 0x60034C31 /end MEASUREMENT
/begin MEASUREMENT DFC_b.LDF_MOXEMM_SMU_ALM2_22 "Bit encoding / Last debounced flag bit for check DFC_MOXEMM_SMU_ALM2_22" UBYTE DFC_OneToOne 1 100 0.00 1.000 BIT_MASK 0x10 FORMAT "%5.3" ECU_ADDRESS 0x60034C32 /end MEASUREMENT
/begin MEASUREMENT DFC_b.LDF_MOXEMM_SMU_ALM2_23 "Bit encoding / Last debounced flag bit for check DFC_MOXEMM_SMU_ALM2_23" UBYTE DFC_OneToOne 1 100 0.00 1.000 BIT_MASK 0x10 FORMAT "%5.3" ECU_ADDRESS 0x60034C33 /end MEASUREMENT
/begin MEASUREMENT DFC_b.LDF_MOXEMM_SMU_ALM2_4 "Bit encoding / Last debounced flag bit for check DFC_MOXEMM_SMU_ALM2_4" UBYTE DFC_OneToOne 1 100 0.00 1.000 BIT_MASK 0x10 FORMAT "%5.3" ECU_ADDRESS 0x60034C34 /end MEASUREMENT
/begin MEASUREMENT DFC_b.LDF_MOXEMM_SMU_ALM2_5 "Bit encoding / Last debounced flag bit for check DFC_MOXEMM_SMU_ALM2_5" UBYTE DFC_OneToOne 1 100 0.00 1.000 BIT_MASK 0x10 FORMAT "%5.3" ECU_ADDRESS 0x60034C35 /end MEASUREMENT
/begin MEASUREMENT DFC_b.LDF_MOXEMM_SMU_ALM2_7 "Bit encoding / Last debounced flag bit for check DFC_MOXEMM_SMU_ALM2_7" UBYTE DFC_OneToOne 1 100 0.00 1.000 BIT_MASK 0x10 FORMAT "%5.3" ECU_ADDRESS 0x60034C36 /end MEASUREMENT
/begin MEASUREMENT DFC_b.LDF_MOXEMM_SMU_ALM2_8 "Bit encoding / Last debounced flag bit for check DFC_MOXEMM_SMU_ALM2_8" UBYTE DFC_OneToOne 1 100 0.00 1.000 BIT_MASK 0x10 FORMAT "%5.3" ECU_ADDRESS 0x60034C37 /end MEASUREMENT
/begin MEASUREMENT DFC_b.LDF_MOXEMM_SMU_ALM6_0 "Bit encoding / Last debounced flag bit for check DFC_MOXEMM_SMU_ALM6_0" UBYTE DFC_OneToOne 1 100 0.00 1.000 BIT_MASK 0x10 FORMAT "%5.3" ECU_ADDRESS 0x60034C38 /end MEASUREMENT
/begin MEASUREMENT DFC_b.LDF_MOXEMM_SMU_ALM6_11 "Bit encoding / Last debounced flag bit for check DFC_MOXEMM_SMU_ALM6_11" UBYTE DFC_OneToOne 1 100 0.00 1.000 BIT_MASK 0x10 FORMAT "%5.3" ECU_ADDRESS 0x60034C39 /end MEASUREMENT
/begin MEASUREMENT DFC_b.LDF_MOXEMM_SMU_ALM6_12 "Bit encoding / Last debounced flag bit for check DFC_MOXEMM_SMU_ALM6_12" UBYTE DFC_OneToOne 1 100 0.00 1.000 BIT_MASK 0x10 FORMAT "%5.3" ECU_ADDRESS 0x60034C3A /end MEASUREMENT
/begin MEASUREMENT DFC_b.LDF_MOXEMM_SMU_ALM6_14 "Bit encoding / Last debounced flag bit for check DFC_MOXEMM_SMU_ALM6_14" UBYTE DFC_OneToOne 1 100 0.00 1.000 BIT_MASK 0x10 FORMAT "%5.3" ECU_ADDRESS 0x60034C3B /end MEASUREMENT
/begin MEASUREMENT DFC_b.LDF_MOXEMM_SMU_ALM6_15 "Bit encoding / Last debounced flag bit for check DFC_MOXEMM_SMU_ALM6_15" UBYTE DFC_OneToOne 1 100 0.00 1.000 BIT_MASK 0x10 FORMAT "%5.3" ECU_ADDRESS 0x60034C3C /end MEASUREMENT
/begin MEASUREMENT DFC_b.LDF_MOXEMM_SMU_ALM6_17 "Bit encoding / Last debounced flag bit for check DFC_MOXEMM_SMU_ALM6_17" UBYTE DFC_OneToOne 1 100 0.00 1.000 BIT_MASK 0x10 FORMAT "%5.3" ECU_ADDRESS 0x60034C3D /end MEASUREMENT
/begin MEASUREMENT DFC_b.LDF_MOXEMM_SMU_ALM6_18 "Bit encoding / Last debounced flag bit for check DFC_MOXEMM_SMU_ALM6_18" UBYTE DFC_OneToOne 1 100 0.00 1.000 BIT_MASK 0x10 FORMAT "%5.3" ECU_ADDRESS 0x60034C3E /end MEASUREMENT
/begin MEASUREMENT DFC_b.LDF_MOXEMM_SMU_ALM6_20 "Bit encoding / Last debounced flag bit for check DFC_MOXEMM_SMU_ALM6_20" UBYTE DFC_OneToOne 1 100 0.00 1.000 BIT_MASK 0x10 FORMAT "%5.3" ECU_ADDRESS 0x60034C3F /end MEASUREMENT
/begin MEASUREMENT DFC_b.LDF_MOXEMM_SMU_ALM6_21 "Bit encoding / Last debounced flag bit for check DFC_MOXEMM_SMU_ALM6_21" UBYTE DFC_OneToOne 1 100 0.00 1.000 BIT_MASK 0x10 FORMAT "%5.3" ECU_ADDRESS 0x60034C40 /end MEASUREMENT
/begin MEASUREMENT DFC_b.LDF_MOXEMM_SMU_ALM6_25 "Bit encoding / Last debounced flag bit for check DFC_MOXEMM_SMU_ALM6_25" UBYTE DFC_OneToOne 1 100 0.00 1.000 BIT_MASK 0x10 FORMAT "%5.3" ECU_ADDRESS 0x60034C41 /end MEASUREMENT
/begin MEASUREMENT DFC_b.LDF_MOXEMM_SMU_ALM6_4 "Bit encoding / Last debounced flag bit for check DFC_MOXEMM_SMU_ALM6_4" UBYTE DFC_OneToOne 1 100 0.00 1.000 BIT_MASK 0x10 FORMAT "%5.3" ECU_ADDRESS 0x60034C42 /end MEASUREMENT
/begin MEASUREMENT DFC_b.LDF_MOXEMM_SMU_ALM6_5 "Bit encoding / Last debounced flag bit for check DFC_MOXEMM_SMU_ALM6_5" UBYTE DFC_OneToOne 1 100 0.00 1.000 BIT_MASK 0x10 FORMAT "%5.3" ECU_ADDRESS 0x60034C43 /end MEASUREMENT
/begin MEASUREMENT DFC_b.LDF_MOXEMM_SMU_ALM6_7 "Bit encoding / Last debounced flag bit for check DFC_MOXEMM_SMU_ALM6_7" UBYTE DFC_OneToOne 1 100 0.00 1.000 BIT_MASK 0x10 FORMAT "%5.3" ECU_ADDRESS 0x60034C44 /end MEASUREMENT
/begin MEASUREMENT DFC_b.LDF_MOXEMM_SMU_ALM6_8 "Bit encoding / Last debounced flag bit for check DFC_MOXEMM_SMU_ALM6_8" UBYTE DFC_OneToOne 1 100 0.00 1.000 BIT_MASK 0x10 FORMAT "%5.3" ECU_ADDRESS 0x60034C45 /end MEASUREMENT
/begin MEASUREMENT DFC_b.LDF_MOXEMM_SMU_ALM7_1 "Bit encoding / Last debounced flag bit for check DFC_MOXEMM_SMU_ALM7_1" UBYTE DFC_OneToOne 1 100 0.00 1.000 BIT_MASK 0x10 FORMAT "%5.3" ECU_ADDRESS 0x60034C46 /end MEASUREMENT
/begin MEASUREMENT DFC_b.LDF_MOXEMM_SMU_ALM7_12 "Bit encoding / Last debounced flag bit for check DFC_MOXEMM_SMU_ALM7_12" UBYTE DFC_OneToOne 1 100 0.00 1.000 BIT_MASK 0x10 FORMAT "%5.3" ECU_ADDRESS 0x60034C47 /end MEASUREMENT
/begin MEASUREMENT DFC_b.LDF_MOXEMM_SMU_ALM7_13 "Bit encoding / Last debounced flag bit for check DFC_MOXEMM_SMU_ALM7_13" UBYTE DFC_OneToOne 1 100 0.00 1.000 BIT_MASK 0x10 FORMAT "%5.3" ECU_ADDRESS 0x60034C48 /end MEASUREMENT
/begin MEASUREMENT DFC_b.LDF_MOXEMM_SMU_ALM7_14 "Bit encoding / Last debounced flag bit for check DFC_MOXEMM_SMU_ALM7_14" UBYTE DFC_OneToOne 1 100 0.00 1.000 BIT_MASK 0x10 FORMAT "%5.3" ECU_ADDRESS 0x60034C49 /end MEASUREMENT
/begin MEASUREMENT DFC_b.LDF_MOXEMM_SMU_ALM7_15 "Bit encoding / Last debounced flag bit for check DFC_MOXEMM_SMU_ALM7_15" UBYTE DFC_OneToOne 1 100 0.00 1.000 BIT_MASK 0x10 FORMAT "%5.3" ECU_ADDRESS 0x60034C4A /end MEASUREMENT
/begin MEASUREMENT DFC_b.LDF_MOXEMM_SMU_ALM7_16 "Bit encoding / Last debounced flag bit for check DFC_MOXEMM_SMU_ALM7_16" UBYTE DFC_OneToOne 1 100 0.00 1.000 BIT_MASK 0x10 FORMAT "%5.3" ECU_ADDRESS 0x60034C4B /end MEASUREMENT
/begin MEASUREMENT DFC_b.LDF_MOXEMM_SMU_ALM7_17 "Bit encoding / Last debounced flag bit for check DFC_MOXEMM_SMU_ALM7_17" UBYTE DFC_OneToOne 1 100 0.00 1.000 BIT_MASK 0x10 FORMAT "%5.3" ECU_ADDRESS 0x60034C4C /end MEASUREMENT
/begin MEASUREMENT DFC_b.LDF_MOXEMM_SMU_ALM7_2 "Bit encoding / Last debounced flag bit for check DFC_MOXEMM_SMU_ALM7_2" UBYTE DFC_OneToOne 1 100 0.00 1.000 BIT_MASK 0x10 FORMAT "%5.3" ECU_ADDRESS 0x60034C4D /end MEASUREMENT
/begin MEASUREMENT DFC_b.LDF_MOXEMM_SMU_ALM7_20 "Bit encoding / Last debounced flag bit for check DFC_MOXEMM_SMU_ALM7_20" UBYTE DFC_OneToOne 1 100 0.00 1.000 BIT_MASK 0x10 FORMAT "%5.3" ECU_ADDRESS 0x60034C4E /end MEASUREMENT
/begin MEASUREMENT DFC_b.LDF_MOXEMM_SMU_ALM7_25 "Bit encoding / Last debounced flag bit for check DFC_MOXEMM_SMU_ALM7_25" UBYTE DFC_OneToOne 1 100 0.00 1.000 BIT_MASK 0x10 FORMAT "%5.3" ECU_ADDRESS 0x60034C4F /end MEASUREMENT
/begin MEASUREMENT DFC_b.LDF_MOXEMM_SMU_ALM7_26 "Bit encoding / Last debounced flag bit for check DFC_MOXEMM_SMU_ALM7_26" UBYTE DFC_OneToOne 1 100 0.00 1.000 BIT_MASK 0x10 FORMAT "%5.3" ECU_ADDRESS 0x60034C50 /end MEASUREMENT
/begin MEASUREMENT DFC_b.LDF_MOXEMM_SMU_ALM7_28 "Bit encoding / Last debounced flag bit for check DFC_MOXEMM_SMU_ALM7_28" UBYTE DFC_OneToOne 1 100 0.00 1.000 BIT_MASK 0x10 FORMAT "%5.3" ECU_ADDRESS 0x60034C51 /end MEASUREMENT
/begin MEASUREMENT DFC_b.LDF_MOXEMM_SMU_ALM7_29 "Bit encoding / Last debounced flag bit for check DFC_MOXEMM_SMU_ALM7_29" UBYTE DFC_OneToOne 1 100 0.00 1.000 BIT_MASK 0x10 FORMAT "%5.3" ECU_ADDRESS 0x60034C52 /end MEASUREMENT
/begin MEASUREMENT DFC_b.LDF_MOXEMM_SMU_ALM7_30 "Bit encoding / Last debounced flag bit for check DFC_MOXEMM_SMU_ALM7_30" UBYTE DFC_OneToOne 1 100 0.00 1.000 BIT_MASK 0x10 FORMAT "%5.3" ECU_ADDRESS 0x60034C53 /end MEASUREMENT
/begin MEASUREMENT DFC_b.LDF_MOXEMM_SMU_ALM7_31 "Bit encoding / Last debounced flag bit for check DFC_MOXEMM_SMU_ALM7_31" UBYTE DFC_OneToOne 1 100 0.00 1.000 BIT_MASK 0x10 FORMAT "%5.3" ECU_ADDRESS 0x60034C54 /end MEASUREMENT
/begin MEASUREMENT DFC_b.LDF_MOXEMM_SMU_ALM8_0 "Bit encoding / Last debounced flag bit for check DFC_MOXEMM_SMU_ALM8_0" UBYTE DFC_OneToOne 1 100 0.00 1.000 BIT_MASK 0x10 FORMAT "%5.3" ECU_ADDRESS 0x60034C55 /end MEASUREMENT
/begin MEASUREMENT DFC_b.LDF_MOXEMM_SMU_ALM8_1 "Bit encoding / Last debounced flag bit for check DFC_MOXEMM_SMU_ALM8_1" UBYTE DFC_OneToOne 1 100 0.00 1.000 BIT_MASK 0x10 FORMAT "%5.3" ECU_ADDRESS 0x60034C56 /end MEASUREMENT
/begin MEASUREMENT DFC_b.LDF_MOXEMM_SMU_ALM8_10 "Bit encoding / Last debounced flag bit for check DFC_MOXEMM_SMU_ALM8_10" UBYTE DFC_OneToOne 1 100 0.00 1.000 BIT_MASK 0x10 FORMAT "%5.3" ECU_ADDRESS 0x60034C57 /end MEASUREMENT
/begin MEASUREMENT DFC_b.LDF_MOXEMM_SMU_ALM8_11 "Bit encoding / Last debounced flag bit for check DFC_MOXEMM_SMU_ALM8_11" UBYTE DFC_OneToOne 1 100 0.00 1.000 BIT_MASK 0x10 FORMAT "%5.3" ECU_ADDRESS 0x60034C58 /end MEASUREMENT
/begin MEASUREMENT DFC_b.LDF_MOXEMM_SMU_ALM8_12 "Bit encoding / Last debounced flag bit for check DFC_MOXEMM_SMU_ALM8_12" UBYTE DFC_OneToOne 1 100 0.00 1.000 BIT_MASK 0x10 FORMAT "%5.3" ECU_ADDRESS 0x60034C59 /end MEASUREMENT
/begin MEASUREMENT DFC_b.LDF_MOXEMM_SMU_ALM8_16 "Bit encoding / Last debounced flag bit for check DFC_MOXEMM_SMU_ALM8_16" UBYTE DFC_OneToOne 1 100 0.00 1.000 BIT_MASK 0x10 FORMAT "%5.3" ECU_ADDRESS 0x60034C5A /end MEASUREMENT
/begin MEASUREMENT DFC_b.LDF_MOXEMM_SMU_ALM8_18 "Bit encoding / Last debounced flag bit for check DFC_MOXEMM_SMU_ALM8_18" UBYTE DFC_OneToOne 1 100 0.00 1.000 BIT_MASK 0x10 FORMAT "%5.3" ECU_ADDRESS 0x60034C5B /end MEASUREMENT
/begin MEASUREMENT DFC_b.LDF_MOXEMM_SMU_ALM8_2 "Bit encoding / Last debounced flag bit for check DFC_MOXEMM_SMU_ALM8_2" UBYTE DFC_OneToOne 1 100 0.00 1.000 BIT_MASK 0x10 FORMAT "%5.3" ECU_ADDRESS 0x60034C5C /end MEASUREMENT
/begin MEASUREMENT DFC_b.LDF_MOXEMM_SMU_ALM8_3 "Bit encoding / Last debounced flag bit for check DFC_MOXEMM_SMU_ALM8_3" UBYTE DFC_OneToOne 1 100 0.00 1.000 BIT_MASK 0x10 FORMAT "%5.3" ECU_ADDRESS 0x60034C5D /end MEASUREMENT
/begin MEASUREMENT DFC_b.LDF_MOXEMM_SMU_ALM8_31 "Bit encoding / Last debounced flag bit for check DFC_MOXEMM_SMU_ALM8_31" UBYTE DFC_OneToOne 1 100 0.00 1.000 BIT_MASK 0x10 FORMAT "%5.3" ECU_ADDRESS 0x60034C5E /end MEASUREMENT
/begin MEASUREMENT DFC_b.LDF_MOXEMM_SMU_ALM8_4 "Bit encoding / Last debounced flag bit for check DFC_MOXEMM_SMU_ALM8_4" UBYTE DFC_OneToOne 1 100 0.00 1.000 BIT_MASK 0x10 FORMAT "%5.3" ECU_ADDRESS 0x60034C5F /end MEASUREMENT
/begin MEASUREMENT DFC_b.LDF_MOXEMM_SMU_ALM9_0 "Bit encoding / Last debounced flag bit for check DFC_MOXEMM_SMU_ALM9_0" UBYTE DFC_OneToOne 1 100 0.00 1.000 BIT_MASK 0x10 FORMAT "%5.3" ECU_ADDRESS 0x60034C60 /end MEASUREMENT
/begin MEASUREMENT DFC_b.LDF_MOXEMM_SMU_ALM9_15 "Bit encoding / Last debounced flag bit for check DFC_MOXEMM_SMU_ALM9_15" UBYTE DFC_OneToOne 1 100 0.00 1.000 BIT_MASK 0x10 FORMAT "%5.3" ECU_ADDRESS 0x60034C61 /end MEASUREMENT
/begin MEASUREMENT DFC_b.LDF_MOXEMM_SMU_ALM9_3 "Bit encoding / Last debounced flag bit for check DFC_MOXEMM_SMU_ALM9_3" UBYTE DFC_OneToOne 1 100 0.00 1.000 BIT_MASK 0x10 FORMAT "%5.3" ECU_ADDRESS 0x60034C62 /end MEASUREMENT
/begin MEASUREMENT DFC_b.LDF_MoCADCNTP "Bit encoding / Last debounced flag bit for check DFC_MoCADCNTP" UBYTE DFC_OneToOne 1 100 0.00 1.000 BIT_MASK 0x10 FORMAT "%5.3" ECU_ADDRESS 0x60034C63 /end MEASUREMENT
/begin MEASUREMENT DFC_b.LDF_MoCADCTst "Bit encoding / Last debounced flag bit for check DFC_MoCADCTst" UBYTE DFC_OneToOne 1 100 0.00 1.000 BIT_MASK 0x10 FORMAT "%5.3" ECU_ADDRESS 0x60034C64 /end MEASUREMENT
/begin MEASUREMENT DFC_b.LDF_MoCSOPICO "Bit encoding / Last debounced flag bit for check DFC_MoCSOPICO" UBYTE DFC_OneToOne 1 100 0.00 1.000 BIT_MASK 0x10 FORMAT "%5.3" ECU_ADDRESS 0x60034C65 /end MEASUREMENT
/begin MEASUREMENT DFC_b.LDF_MoFAPP "Bit encoding / Last debounced flag bit for check DFC_MoFAPP" UBYTE DFC_OneToOne 1 100 0.00 1.000 BIT_MASK 0x10 FORMAT "%5.3" ECU_ADDRESS 0x60034C66 /end MEASUREMENT
/begin MEASUREMENT DFC_b.LDF_MoFAirFilgPrdc "Bit encoding / Last debounced flag bit for check DFC_MoFAirFilgPrdc" UBYTE DFC_OneToOne 1 100 0.00 1.000 BIT_MASK 0x10 FORMAT "%5.3" ECU_ADDRESS 0x60034C67 /end MEASUREMENT
/begin MEASUREMENT DFC_b.LDF_MoFAirFlCtOffPfi "Bit encoding / Last debounced flag bit for check DFC_MoFAirFlCtOffPfi" UBYTE DFC_OneToOne 1 100 0.00 1.000 BIT_MASK 0x10 FORMAT "%5.3" ECU_ADDRESS 0x60034C68 /end MEASUREMENT
/begin MEASUREMENT DFC_b.LDF_MoFAirFlCylPfi "Bit encoding / Last debounced flag bit for check DFC_MoFAirFlCylPfi" UBYTE DFC_OneToOne 1 100 0.00 1.000 BIT_MASK 0x10 FORMAT "%5.3" ECU_ADDRESS 0x60034C69 /end MEASUREMENT
/begin MEASUREMENT DFC_b.LDF_MoFAirFlIn "Bit encoding / Last debounced flag bit for check DFC_MoFAirFlIn" UBYTE DFC_OneToOne 1 100 0.00 1.000 BIT_MASK 0x10 FORMAT "%5.3" ECU_ADDRESS 0x60034C6A /end MEASUREMENT
/begin MEASUREMENT DFC_b.LDF_MoFAirFlMixCtlPfiChkAirFl "Bit encoding / Last debounced flag bit for check DFC_MoFAirFlMixCtlPfiChkAirFl" UBYTE DFC_OneToOne 1 100 0.00 1.000 BIT_MASK 0x10 FORMAT "%5.3" ECU_ADDRESS 0x60034C6B /end MEASUREMENT
/begin MEASUREMENT DFC_b.LDF_MoFAirFlMixCtlPfiChkCtrl "Bit encoding / Last debounced flag bit for check DFC_MoFAirFlMixCtlPfiChkCtrl" UBYTE DFC_OneToOne 1 100 0.00 1.000 BIT_MASK 0x10 FORMAT "%5.3" ECU_ADDRESS 0x60034C6C /end MEASUREMENT
/begin MEASUREMENT DFC_b.LDF_MoFAirFlMode "Bit encoding / Last debounced flag bit for check DFC_MoFAirFlMode" UBYTE DFC_OneToOne 1 100 0.00 1.000 BIT_MASK 0x10 FORMAT "%5.3" ECU_ADDRESS 0x60034C6D /end MEASUREMENT
/begin MEASUREMENT DFC_b.LDF_MoFESpd "Bit encoding / Last debounced flag bit for check DFC_MoFESpd" UBYTE DFC_OneToOne 1 100 0.00 1.000 BIT_MASK 0x10 FORMAT "%5.3" ECU_ADDRESS 0x60034C6E /end MEASUREMENT
/begin MEASUREMENT DFC_b.LDF_MoFIACo "Bit encoding / Last debounced flag bit for check DFC_MoFIACo" UBYTE DFC_OneToOne 1 100 0.00 1.000 BIT_MASK 0x10 FORMAT "%5.3" ECU_ADDRESS 0x60034C6F /end MEASUREMENT
/begin MEASUREMENT DFC_b.LDF_MoFICOL1 "Bit encoding / Last debounced flag bit for check DFC_MoFICOL1" UBYTE DFC_OneToOne 1 100 0.00 1.000 BIT_MASK 0x10 FORMAT "%5.3" ECU_ADDRESS 0x60034C70 /end MEASUREMENT
/begin MEASUREMENT DFC_b.LDF_MoFICOL2 "Bit encoding / Last debounced flag bit for check DFC_MoFICOL2" UBYTE DFC_OneToOne 1 100 0.00 1.000 BIT_MASK 0x10 FORMAT "%5.3" ECU_ADDRESS 0x60034C71 /end MEASUREMENT
/begin MEASUREMENT DFC_b.LDF_MoFStrt "Bit encoding / Last debounced flag bit for check DFC_MoFStrt" UBYTE DFC_OneToOne 1 100 0.00 1.000 BIT_MASK 0x10 FORMAT "%5.3" ECU_ADDRESS 0x60034C72 /end MEASUREMENT
/begin MEASUREMENT DFC_b.LDF_MoFTrqCmp "Bit encoding / Last debounced flag bit for check DFC_MoFTrqCmp" UBYTE DFC_OneToOne 1 100 0.00 1.000 BIT_MASK 0x10 FORMAT "%5.3" ECU_ADDRESS 0x60034C73 /end MEASUREMENT
/begin MEASUREMENT DFC_b.LDF_MoFTrqCmpMax "Bit encoding / Last debounced flag bit for check DFC_MoFTrqCmpMax" UBYTE DFC_OneToOne 1 100 0.00 1.000 BIT_MASK 0x10 FORMAT "%5.3" ECU_ADDRESS 0x60034C74 /end MEASUREMENT
/begin MEASUREMENT DFC_b.LDF_MoFTrqCmpMin "Bit encoding / Last debounced flag bit for check DFC_MoFTrqCmpMin" UBYTE DFC_OneToOne 1 100 0.00 1.000 BIT_MASK 0x10 FORMAT "%5.3" ECU_ADDRESS 0x60034C75 /end MEASUREMENT
/begin MEASUREMENT DFC_b.LDF_MoFVarPostBldSel "Bit encoding / Last debounced flag bit for check DFC_MoFVarPostBldSel" UBYTE DFC_OneToOne 1 100 0.00 1.000 BIT_MASK 0x10 FORMAT "%5.3" ECU_ADDRESS 0x60034C76 /end MEASUREMENT
/begin MEASUREMENT DFC_b.LDF_MoXEMMHwLTMCUFW "Bit encoding / Last debounced flag bit for check DFC_MoXEMMHwLTMCUFW" UBYTE DFC_OneToOne 1 100 0.00 1.000 BIT_MASK 0x10 FORMAT "%5.3" ECU_ADDRESS 0x60034C77 /end MEASUREMENT
/begin MEASUREMENT DFC_b.LDF_MoXEMMHwLTMonBIST "Bit encoding / Last debounced flag bit for check DFC_MoXEMMHwLTMonBIST" UBYTE DFC_OneToOne 1 100 0.00 1.000 BIT_MASK 0x10 FORMAT "%5.3" ECU_ADDRESS 0x60034C78 /end MEASUREMENT
/begin MEASUREMENT DFC_b.LDF_MoXEMMHwLTRegMonTest "Bit encoding / Last debounced flag bit for check DFC_MoXEMMHwLTRegMonTest" UBYTE DFC_OneToOne 1 100 0.00 1.000 BIT_MASK 0x10 FORMAT "%5.3" ECU_ADDRESS 0x60034C79 /end MEASUREMENT
/begin MEASUREMENT DFC_b.LDF_MoXEMMHwLTStbySMUAlvTest "Bit encoding / Last debounced flag bit for check DFC_MoXEMMHwLTStbySMUAlvTest" UBYTE DFC_OneToOne 1 100 0.00 1.000 BIT_MASK 0x10 FORMAT "%5.3" ECU_ADDRESS 0x60034C7A /end MEASUREMENT
/begin MEASUREMENT DFC_b.LDF_MoXEMMHwLTTempSens "Bit encoding / Last debounced flag bit for check DFC_MoXEMMHwLTTempSens" UBYTE DFC_OneToOne 1 100 0.00 1.000 BIT_MASK 0x10 FORMAT "%5.3" ECU_ADDRESS 0x60034C7B /end MEASUREMENT
/begin MEASUREMENT DFC_b.LDF_MoXEMMHwLTUCBCfg "Bit encoding / Last debounced flag bit for check DFC_MoXEMMHwLTUCBCfg" UBYTE DFC_OneToOne 1 100 0.00 1.000 BIT_MASK 0x10 FORMAT "%5.3" ECU_ADDRESS 0x60034C7C /end MEASUREMENT
/begin MEASUREMENT DFC_b.LDF_OCWDAABEActv "Bit encoding / Last debounced flag bit for check DFC_OCWDAABEActv" UBYTE DFC_OneToOne 1 100 0.00 1.000 BIT_MASK 0x10 FORMAT "%5.3" ECU_ADDRESS 0x60034C7D /end MEASUREMENT
/begin MEASUREMENT DFC_b.LDF_OCWDACom "Bit encoding / Last debounced flag bit for check DFC_OCWDACom" UBYTE DFC_OneToOne 1 100 0.00 1.000 BIT_MASK 0x10 FORMAT "%5.3" ECU_ADDRESS 0x60034C7E /end MEASUREMENT
/begin MEASUREMENT DFC_b.LDF_OCWDAErrPin "Bit encoding / Last debounced flag bit for check DFC_OCWDAErrPin" UBYTE DFC_OneToOne 1 100 0.00 1.000 BIT_MASK 0x10 FORMAT "%5.3" ECU_ADDRESS 0x60034C7F /end MEASUREMENT
/begin MEASUREMENT DFC_b.LDF_OCWDAOvrVltg "Bit encoding / Last debounced flag bit for check DFC_OCWDAOvrVltg" UBYTE DFC_OneToOne 1 100 0.00 1.000 BIT_MASK 0x10 FORMAT "%5.3" ECU_ADDRESS 0x60034C80 /end MEASUREMENT
/begin MEASUREMENT DFC_b.LDF_ORAmax "Bit encoding / Last debounced flag bit for check DFC_ORAmax" UBYTE DFC_OneToOne 1 100 0.00 1.000 BIT_MASK 0x10 FORMAT "%5.3" ECU_ADDRESS 0x60034C81 /end MEASUREMENT
/begin MEASUREMENT DFC_b.LDF_ORAmin "Bit encoding / Last debounced flag bit for check DFC_ORAmin" UBYTE DFC_OneToOne 1 100 0.00 1.000 BIT_MASK 0x10 FORMAT "%5.3" ECU_ADDRESS 0x60034C82 /end MEASUREMENT
/begin MEASUREMENT DFC_b.LDF_PLLSUmax "Bit encoding / Last debounced flag bit for check DFC_PLLSUmax" UBYTE DFC_OneToOne 1 100 0.00 1.000 BIT_MASK 0x10 FORMAT "%5.3" ECU_ADDRESS 0x60034C83 /end MEASUREMENT
/begin MEASUREMENT DFC_b.LDF_PLLSUmin "Bit encoding / Last debounced flag bit for check DFC_PLLSUmin" UBYTE DFC_OneToOne 1 100 0.00 1.000 BIT_MASK 0x10 FORMAT "%5.3" ECU_ADDRESS 0x60034C84 /end MEASUREMENT
/begin MEASUREMENT DFC_b.LDF_PSR1max "Bit encoding / Last debounced flag bit for check DFC_PSR1max" UBYTE DFC_OneToOne 1 100 0.00 1.000 BIT_MASK 0x10 FORMAT "%5.3" ECU_ADDRESS 0x60034C85 /end MEASUREMENT
/begin MEASUREMENT DFC_b.LDF_PSRBmax "Bit encoding / Last debounced flag bit for check DFC_PSRBmax" UBYTE DFC_OneToOne 1 100 0.00 1.000 BIT_MASK 0x10 FORMAT "%5.3" ECU_ADDRESS 0x60034C86 /end MEASUREMENT
/begin MEASUREMENT DFC_b.LDF_PSRBmin "Bit encoding / Last debounced flag bit for check DFC_PSRBmin" UBYTE DFC_OneToOne 1 100 0.00 1.000 BIT_MASK 0x10 FORMAT "%5.3" ECU_ADDRESS 0x60034C87 /end MEASUREMENT
/begin MEASUREMENT DFC_b.LDF_PSRPmax "Bit encoding / Last debounced flag bit for check DFC_PSRPmax" UBYTE DFC_OneToOne 1 100 0.00 1.000 BIT_MASK 0x10 FORMAT "%5.3" ECU_ADDRESS 0x60034C88 /end MEASUREMENT
/begin MEASUREMENT DFC_b.LDF_PSRPmin "Bit encoding / Last debounced flag bit for check DFC_PSRPmin" UBYTE DFC_OneToOne 1 100 0.00 1.000 BIT_MASK 0x10 FORMAT "%5.3" ECU_ADDRESS 0x60034C89 /end MEASUREMENT
/begin MEASUREMENT DFC_b.LDF_PSRPsig "Bit encoding / Last debounced flag bit for check DFC_PSRPsig" UBYTE DFC_OneToOne 1 100 0.00 1.000 BIT_MASK 0x10 FORMAT "%5.3" ECU_ADDRESS 0x60034C8A /end MEASUREMENT
/begin MEASUREMENT DFC_b.LDF_PSRmax "Bit encoding / Last debounced flag bit for check DFC_PSRmax" UBYTE DFC_OneToOne 1 100 0.00 1.000 BIT_MASK 0x10 FORMAT "%5.3" ECU_ADDRESS 0x60034C8B /end MEASUREMENT
/begin MEASUREMENT DFC_b.LDF_PUmax "Bit encoding / Last debounced flag bit for check DFC_PUmax" UBYTE DFC_OneToOne 1 100 0.00 1.000 BIT_MASK 0x10 FORMAT "%5.3" ECU_ADDRESS 0x60034C8C /end MEASUREMENT
/begin MEASUREMENT DFC_b.LDF_P_VSE11_OL "Bit encoding / Last debounced flag bit for check DFC_P_VSE11_OL" UBYTE DFC_OneToOne 1 100 0.00 1.000 BIT_MASK 0x10 FORMAT "%5.3" ECU_ADDRESS 0x60034C8D /end MEASUREMENT
/begin MEASUREMENT DFC_b.LDF_P_VSE11_SCB "Bit encoding / Last debounced flag bit for check DFC_P_VSE11_SCB" UBYTE DFC_OneToOne 1 100 0.00 1.000 BIT_MASK 0x10 FORMAT "%5.3" ECU_ADDRESS 0x60034C8E /end MEASUREMENT
/begin MEASUREMENT DFC_b.LDF_P_VSE11_SCG "Bit encoding / Last debounced flag bit for check DFC_P_VSE11_SCG" UBYTE DFC_OneToOne 1 100 0.00 1.000 BIT_MASK 0x10 FORMAT "%5.3" ECU_ADDRESS 0x60034C8F /end MEASUREMENT
/begin MEASUREMENT DFC_b.LDF_PhyHighAPP1 "Bit encoding / Last debounced flag bit for check DFC_PhyHighAPP1" UBYTE DFC_OneToOne 1 100 0.00 1.000 BIT_MASK 0x10 FORMAT "%5.3" ECU_ADDRESS 0x60034C90 /end MEASUREMENT
/begin MEASUREMENT DFC_b.LDF_PhyHighAPP2 "Bit encoding / Last debounced flag bit for check DFC_PhyHighAPP2" UBYTE DFC_OneToOne 1 100 0.00 1.000 BIT_MASK 0x10 FORMAT "%5.3" ECU_ADDRESS 0x60034C91 /end MEASUREMENT
/begin MEASUREMENT DFC_b.LDF_PhyLowAPP1 "Bit encoding / Last debounced flag bit for check DFC_PhyLowAPP1" UBYTE DFC_OneToOne 1 100 0.00 1.000 BIT_MASK 0x10 FORMAT "%5.3" ECU_ADDRESS 0x60034C92 /end MEASUREMENT
/begin MEASUREMENT DFC_b.LDF_PhyLowAPP2 "Bit encoding / Last debounced flag bit for check DFC_PhyLowAPP2" UBYTE DFC_OneToOne 1 100 0.00 1.000 BIT_MASK 0x10 FORMAT "%5.3" ECU_ADDRESS 0x60034C93 /end MEASUREMENT
/begin MEASUREMENT DFC_b.LDF_SRCHighAPP1 "Bit encoding / Last debounced flag bit for check DFC_SRCHighAPP1" UBYTE DFC_OneToOne 1 100 0.00 1.000 BIT_MASK 0x10 FORMAT "%5.3" ECU_ADDRESS 0x60034C94 /end MEASUREMENT
/begin MEASUREMENT DFC_b.LDF_SRCHighAPP2 "Bit encoding / Last debounced flag bit for check DFC_SRCHighAPP2" UBYTE DFC_OneToOne 1 100 0.00 1.000 BIT_MASK 0x10 FORMAT "%5.3" ECU_ADDRESS 0x60034C95 /end MEASUREMENT
/begin MEASUREMENT DFC_b.LDF_SRCLowAPP1 "Bit encoding / Last debounced flag bit for check DFC_SRCLowAPP1" UBYTE DFC_OneToOne 1 100 0.00 1.000 BIT_MASK 0x10 FORMAT "%5.3" ECU_ADDRESS 0x60034C96 /end MEASUREMENT
/begin MEASUREMENT DFC_b.LDF_SRCLowAPP2 "Bit encoding / Last debounced flag bit for check DFC_SRCLowAPP2" UBYTE DFC_OneToOne 1 100 0.00 1.000 BIT_MASK 0x10 FORMAT "%5.3" ECU_ADDRESS 0x60034C97 /end MEASUREMENT
/begin MEASUREMENT DFC_b.LDF_SSpMon2 "Bit encoding / Last debounced flag bit for check DFC_SSpMon2" UBYTE DFC_OneToOne 1 100 0.00 1.000 BIT_MASK 0x10 FORMAT "%5.3" ECU_ADDRESS 0x60034C98 /end MEASUREMENT
/begin MEASUREMENT DFC_b.LDF_SWReset_0 "Bit encoding / Last debounced flag bit for check DFC_SWReset_0" UBYTE DFC_OneToOne 1 100 0.00 1.000 BIT_MASK 0x10 FORMAT "%5.3" ECU_ADDRESS 0x60034C99 /end MEASUREMENT
/begin MEASUREMENT DFC_b.LDF_SWReset_1 "Bit encoding / Last debounced flag bit for check DFC_SWReset_1" UBYTE DFC_OneToOne 1 100 0.00 1.000 BIT_MASK 0x10 FORMAT "%5.3" ECU_ADDRESS 0x60034C9A /end MEASUREMENT
/begin MEASUREMENT DFC_b.LDF_SWReset_2 "Bit encoding / Last debounced flag bit for check DFC_SWReset_2" UBYTE DFC_OneToOne 1 100 0.00 1.000 BIT_MASK 0x10 FORMAT "%5.3" ECU_ADDRESS 0x60034C9B /end MEASUREMENT
/begin MEASUREMENT DFC_b.LDF_SyncAPP "Bit encoding / Last debounced flag bit for check DFC_SyncAPP" UBYTE DFC_OneToOne 1 100 0.00 1.000 BIT_MASK 0x10 FORMAT "%5.3" ECU_ADDRESS 0x60034C9C /end MEASUREMENT
/begin MEASUREMENT DFC_b.LDF_TAmax_Dummy "Bit encoding / Last debounced flag bit for check DFC_TAmax_Dummy" UBYTE DFC_OneToOne 1 100 0.00 1.000 BIT_MASK 0x10 FORMAT "%5.3" ECU_ADDRESS 0x60034C9D /end MEASUREMENT
/begin MEASUREMENT DFC_b.LDF_TKAEmax "Bit encoding / Last debounced flag bit for check DFC_TKAEmax" UBYTE DFC_OneToOne 1 100 0.00 1.000 BIT_MASK 0x10 FORMAT "%5.3" ECU_ADDRESS 0x60034C9E /end MEASUREMENT
/begin MEASUREMENT DFC_b.LDF_TKAEmin "Bit encoding / Last debounced flag bit for check DFC_TKAEmin" UBYTE DFC_OneToOne 1 100 0.00 1.000 BIT_MASK 0x10 FORMAT "%5.3" ECU_ADDRESS 0x60034C9F /end MEASUREMENT
/begin MEASUREMENT DFC_b.LDF_TKARmax "Bit encoding / Last debounced flag bit for check DFC_TKARmax" UBYTE DFC_OneToOne 1 100 0.00 1.000 BIT_MASK 0x10 FORMAT "%5.3" ECU_ADDRESS 0x60034CA0 /end MEASUREMENT
/begin MEASUREMENT DFC_b.LDF_TKARnpl "Bit encoding / Last debounced flag bit for check DFC_TKARnpl" UBYTE DFC_OneToOne 1 100 0.00 1.000 BIT_MASK 0x10 FORMAT "%5.3" ECU_ADDRESS 0x60034CA1 /end MEASUREMENT
/begin MEASUREMENT DFC_b.LDF_TMmax_Dummy "Bit encoding / Last debounced flag bit for check DFC_TMmax_Dummy" UBYTE DFC_OneToOne 1 100 0.00 1.000 BIT_MASK 0x10 FORMAT "%5.3" ECU_ADDRESS 0x60034CA2 /end MEASUREMENT
/begin MEASUREMENT DFC_b.LDF_TUMmax_Dummy "Bit encoding / Last debounced flag bit for check DFC_TUMmax_Dummy" UBYTE DFC_OneToOne 1 100 0.00 1.000 BIT_MASK 0x10 FORMAT "%5.3" ECU_ADDRESS 0x60034CA3 /end MEASUREMENT
/begin MEASUREMENT DFC_b.LDF_TWCDPriCatB1 "Bit encoding / Last debounced flag bit for check DFC_TWCDPriCatB1" UBYTE DFC_OneToOne 1 100 0.00 1.000 BIT_MASK 0x10 FORMAT "%5.3" ECU_ADDRESS 0x60034CA4 /end MEASUREMENT
/begin MEASUREMENT DFC_b.LDF_ThrVlvClsdPosnFirstOffsLrnImpoB1 "Bit encoding / Last debounced flag bit for check DFC_ThrVlvClsdPosnFirstOffsLrnImpoB1" UBYTE DFC_OneToOne 1 100 0.00 1.000 BIT_MASK 0x10 FORMAT "%5.3" ECU_ADDRESS 0x60034CA5 /end MEASUREMENT
/begin MEASUREMENT DFC_b.LDF_ThrVlvClsdPosnOffsLrnImpoB1 "Bit encoding / Last debounced flag bit for check DFC_ThrVlvClsdPosnOffsLrnImpoB1" UBYTE DFC_OneToOne 1 100 0.00 1.000 BIT_MASK 0x10 FORMAT "%5.3" ECU_ADDRESS 0x60034CA6 /end MEASUREMENT
/begin MEASUREMENT DFC_b.LDF_ThrVlvClsdPosnOffsLrnMaxB1 "Bit encoding / Last debounced flag bit for check DFC_ThrVlvClsdPosnOffsLrnMaxB1" UBYTE DFC_OneToOne 1 100 0.00 1.000 BIT_MASK 0x10 FORMAT "%5.3" ECU_ADDRESS 0x60034CA7 /end MEASUREMENT
/begin MEASUREMENT DFC_b.LDF_ThrVlvClsdPosnOffsLrnMinB1 "Bit encoding / Last debounced flag bit for check DFC_ThrVlvClsdPosnOffsLrnMinB1" UBYTE DFC_OneToOne 1 100 0.00 1.000 BIT_MASK 0x10 FORMAT "%5.3" ECU_ADDRESS 0x60034CA8 /end MEASUREMENT
/begin MEASUREMENT DFC_b.LDF_ThrVlvCtrlDeB1 "Bit encoding / Last debounced flag bit for check DFC_ThrVlvCtrlDeB1" UBYTE DFC_OneToOne 1 100 0.00 1.000 BIT_MASK 0x10 FORMAT "%5.3" ECU_ADDRESS 0x60034CA9 /end MEASUREMENT
/begin MEASUREMENT DFC_b.LDF_ThrVlvDycB1 "Bit encoding / Last debounced flag bit for check DFC_ThrVlvDycB1" UBYTE DFC_OneToOne 1 100 0.00 1.000 BIT_MASK 0x10 FORMAT "%5.3" ECU_ADDRESS 0x60034CAA /end MEASUREMENT
/begin MEASUREMENT DFC_b.LDF_ThrVlvLimpAirPosnMaxAbsltDriftB1 "Bit encoding / Last debounced flag bit for check DFC_ThrVlvLimpAirPosnMaxAbsltDriftB1" UBYTE DFC_OneToOne 1 100 0.00 1.000 BIT_MASK 0x10 FORMAT "%5.3" ECU_ADDRESS 0x60034CAB /end MEASUREMENT
/begin MEASUREMENT DFC_b.LDF_ThrVlvLimpAirPosnMaxB1 "Bit encoding / Last debounced flag bit for check DFC_ThrVlvLimpAirPosnMaxB1" UBYTE DFC_OneToOne 1 100 0.00 1.000 BIT_MASK 0x10 FORMAT "%5.3" ECU_ADDRESS 0x60034CAC /end MEASUREMENT
/begin MEASUREMENT DFC_b.LDF_ThrVlvLimpAirPosnMaxRelDriftB1 "Bit encoding / Last debounced flag bit for check DFC_ThrVlvLimpAirPosnMaxRelDriftB1" UBYTE DFC_OneToOne 1 100 0.00 1.000 BIT_MASK 0x10 FORMAT "%5.3" ECU_ADDRESS 0x60034CAD /end MEASUREMENT
/begin MEASUREMENT DFC_b.LDF_ThrVlvLimpAirPosnMinB1 "Bit encoding / Last debounced flag bit for check DFC_ThrVlvLimpAirPosnMinB1" UBYTE DFC_OneToOne 1 100 0.00 1.000 BIT_MASK 0x10 FORMAT "%5.3" ECU_ADDRESS 0x60034CAE /end MEASUREMENT
/begin MEASUREMENT DFC_b.LDF_ThrVlvOpenLoadB1 "Bit encoding / Last debounced flag bit for check DFC_ThrVlvOpenLoadB1" UBYTE DFC_OneToOne 1 100 0.00 1.000 BIT_MASK 0x10 FORMAT "%5.3" ECU_ADDRESS 0x60034CAF /end MEASUREMENT
/begin MEASUREMENT DFC_b.LDF_ThrVlvOpenSprgB1 "Bit encoding / Last debounced flag bit for check DFC_ThrVlvOpenSprgB1" UBYTE DFC_OneToOne 1 100 0.00 1.000 BIT_MASK 0x10 FORMAT "%5.3" ECU_ADDRESS 0x60034CB0 /end MEASUREMENT
/begin MEASUREMENT DFC_b.LDF_ThrVlvOpenSprgSprdB1 "Bit encoding / Last debounced flag bit for check DFC_ThrVlvOpenSprgSprdB1" UBYTE DFC_OneToOne 1 100 0.00 1.000 BIT_MASK 0x10 FORMAT "%5.3" ECU_ADDRESS 0x60034CB1 /end MEASUREMENT
/begin MEASUREMENT DFC_b.LDF_ThrVlvOpenSprgTwnB1 "Bit encoding / Last debounced flag bit for check DFC_ThrVlvOpenSprgTwnB1" UBYTE DFC_OneToOne 1 100 0.00 1.000 BIT_MASK 0x10 FORMAT "%5.3" ECU_ADDRESS 0x60034CB2 /end MEASUREMENT
/begin MEASUREMENT DFC_b.LDF_ThrVlvOverTB1 "Bit encoding / Last debounced flag bit for check DFC_ThrVlvOverTB1" UBYTE DFC_OneToOne 1 100 0.00 1.000 BIT_MASK 0x10 FORMAT "%5.3" ECU_ADDRESS 0x60034CB3 /end MEASUREMENT
/begin MEASUREMENT DFC_b.LDF_ThrVlvRetSprgB1 "Bit encoding / Last debounced flag bit for check DFC_ThrVlvRetSprgB1" UBYTE DFC_OneToOne 1 100 0.00 1.000 BIT_MASK 0x10 FORMAT "%5.3" ECU_ADDRESS 0x60034CB4 /end MEASUREMENT
/begin MEASUREMENT DFC_b.LDF_ThrVlvRetSprgSprdB1 "Bit encoding / Last debounced flag bit for check DFC_ThrVlvRetSprgSprdB1" UBYTE DFC_OneToOne 1 100 0.00 1.000 BIT_MASK 0x10 FORMAT "%5.3" ECU_ADDRESS 0x60034CB5 /end MEASUREMENT
/begin MEASUREMENT DFC_b.LDF_ThrVlvRetSprgTwnB1 "Bit encoding / Last debounced flag bit for check DFC_ThrVlvRetSprgTwnB1" UBYTE DFC_OneToOne 1 100 0.00 1.000 BIT_MASK 0x10 FORMAT "%5.3" ECU_ADDRESS 0x60034CB6 /end MEASUREMENT
/begin MEASUREMENT DFC_b.LDF_ThrVlvSens1MaxB1 "Bit encoding / Last debounced flag bit for check DFC_ThrVlvSens1MaxB1" UBYTE DFC_OneToOne 1 100 0.00 1.000 BIT_MASK 0x10 FORMAT "%5.3" ECU_ADDRESS 0x60034CB7 /end MEASUREMENT
/begin MEASUREMENT DFC_b.LDF_ThrVlvSens1NplB1 "Bit encoding / Last debounced flag bit for check DFC_ThrVlvSens1NplB1" UBYTE DFC_OneToOne 1 100 0.00 1.000 BIT_MASK 0x10 FORMAT "%5.3" ECU_ADDRESS 0x60034CB8 /end MEASUREMENT
/begin MEASUREMENT DFC_b.LDF_ThrVlvSens2MaxB1 "Bit encoding / Last debounced flag bit for check DFC_ThrVlvSens2MaxB1" UBYTE DFC_OneToOne 1 100 0.00 1.000 BIT_MASK 0x10 FORMAT "%5.3" ECU_ADDRESS 0x60034CB9 /end MEASUREMENT
/begin MEASUREMENT DFC_b.LDF_ThrVlvSens2MinB1 "Bit encoding / Last debounced flag bit for check DFC_ThrVlvSens2MinB1" UBYTE DFC_OneToOne 1 100 0.00 1.000 BIT_MASK 0x10 FORMAT "%5.3" ECU_ADDRESS 0x60034CBA /end MEASUREMENT
/begin MEASUREMENT DFC_b.LDF_ThrVlvSens2NplB1 "Bit encoding / Last debounced flag bit for check DFC_ThrVlvSens2NplB1" UBYTE DFC_OneToOne 1 100 0.00 1.000 BIT_MASK 0x10 FORMAT "%5.3" ECU_ADDRESS 0x60034CBB /end MEASUREMENT
/begin MEASUREMENT DFC_b.LDF_ThrVlvShoCircB1 "Bit encoding / Last debounced flag bit for check DFC_ThrVlvShoCircB1" UBYTE DFC_OneToOne 1 100 0.00 1.000 BIT_MASK 0x10 FORMAT "%5.3" ECU_ADDRESS 0x60034CBC /end MEASUREMENT
/begin MEASUREMENT DFC_b.LDF_ThrVlvSpiErrB1 "Bit encoding / Last debounced flag bit for check DFC_ThrVlvSpiErrB1" UBYTE DFC_OneToOne 1 100 0.00 1.000 BIT_MASK 0x10 FORMAT "%5.3" ECU_ADDRESS 0x60034CBD /end MEASUREMENT
/begin MEASUREMENT DFC_b.LDF_ThrvlvSens1MinB1 "Bit encoding / Last debounced flag bit for check DFC_ThrvlvSens1MinB1" UBYTE DFC_OneToOne 1 100 0.00 1.000 BIT_MASK 0x10 FORMAT "%5.3" ECU_ADDRESS 0x60034CBE /end MEASUREMENT
/begin MEASUREMENT DFC_b.LDF_TiOffTBasdChkFast "Bit encoding / Last debounced flag bit for check DFC_TiOffTBasdChkFast" UBYTE DFC_OneToOne 1 100 0.00 1.000 BIT_MASK 0x10 FORMAT "%5.3" ECU_ADDRESS 0x60034CBF /end MEASUREMENT
/begin MEASUREMENT DFC_b.LDF_TiOffTBasdChkSlow "Bit encoding / Last debounced flag bit for check DFC_TiOffTBasdChkSlow" UBYTE DFC_OneToOne 1 100 0.00 1.000 BIT_MASK 0x10 FORMAT "%5.3" ECU_ADDRESS 0x60034CC0 /end MEASUREMENT
/begin MEASUREMENT DFC_b.LDF_UEGOHeatrCtlS1B1 "Bit encoding / Last debounced flag bit for check DFC_UEGOHeatrCtlS1B1" UBYTE DFC_OneToOne 1 100 0.00 1.000 BIT_MASK 0x10 FORMAT "%5.3" ECU_ADDRESS 0x60034CC1 /end MEASUREMENT
/begin MEASUREMENT DFC_b.LDF_UEGOSnsrMntdS1B1 "Bit encoding / Last debounced flag bit for check DFC_UEGOSnsrMntdS1B1" UBYTE DFC_OneToOne 1 100 0.00 1.000 BIT_MASK 0x10 FORMAT "%5.3" ECU_ADDRESS 0x60034CC2 /end MEASUREMENT
/begin MEASUREMENT DFC_b.LDF_VehVSig "Bit encoding / Last debounced flag bit for check DFC_VehVSig" UBYTE DFC_OneToOne 1 100 0.00 1.000 BIT_MASK 0x10 FORMAT "%5.3" ECU_ADDRESS 0x60034CC3 /end MEASUREMENT
/begin MEASUREMENT DFC_b.LDF_VlvLftFbSwtIntk11SpclFail "Bit encoding / Last debounced flag bit for check DFC_VlvLftFbSwtIntk11SpclFail" UBYTE DFC_OneToOne 1 100 0.00 1.000 BIT_MASK 0x10 FORMAT "%5.3" ECU_ADDRESS 0x60034CC4 /end MEASUREMENT
/begin MEASUREMENT DFC_b.LDF_VlvLftFbSwtIntk11StdFail "Bit encoding / Last debounced flag bit for check DFC_VlvLftFbSwtIntk11StdFail" UBYTE DFC_OneToOne 1 100 0.00 1.000 BIT_MASK 0x10 FORMAT "%5.3" ECU_ADDRESS 0x60034CC5 /end MEASUREMENT
/begin MEASUREMENT DFC_b.TSC_AltIOACGFailr "Bit encoding / Ok-Tested Since Clear bit for check DFC_AltIOACGFailr" UBYTE DFC_OneToOne 1 100 0.00 1.000 BIT_MASK 0x20 FORMAT "%5.3" ECU_ADDRESS 0x60034A07 /end MEASUREMENT
/begin MEASUREMENT DFC_b.TSC_AltIOACGHiVltg "Bit encoding / Ok-Tested Since Clear bit for check DFC_AltIOACGHiVltg" UBYTE DFC_OneToOne 1 100 0.00 1.000 BIT_MASK 0x20 FORMAT "%5.3" ECU_ADDRESS 0x60034A08 /end MEASUREMENT
/begin MEASUREMENT DFC_b.TSC_AltIOACGLoVltg "Bit encoding / Ok-Tested Since Clear bit for check DFC_AltIOACGLoVltg" UBYTE DFC_OneToOne 1 100 0.00 1.000 BIT_MASK 0x20 FORMAT "%5.3" ECU_ADDRESS 0x60034A09 /end MEASUREMENT
/begin MEASUREMENT DFC_b.TSC_AltIOACGTHi "Bit encoding / Ok-Tested Since Clear bit for check DFC_AltIOACGTHi" UBYTE DFC_OneToOne 1 100 0.00 1.000 BIT_MASK 0x20 FORMAT "%5.3" ECU_ADDRESS 0x60034A0A /end MEASUREMENT
/begin MEASUREMENT DFC_b.TSC_AltIODConnACG "Bit encoding / Ok-Tested Since Clear bit for check DFC_AltIODConnACG" UBYTE DFC_OneToOne 1 100 0.00 1.000 BIT_MASK 0x20 FORMAT "%5.3" ECU_ADDRESS 0x60034A0B /end MEASUREMENT
/begin MEASUREMENT DFC_b.TSC_BattUHiFailr "Bit encoding / Ok-Tested Since Clear bit for check DFC_BattUHiFailr" UBYTE DFC_OneToOne 1 100 0.00 1.000 BIT_MASK 0x20 FORMAT "%5.3" ECU_ADDRESS 0x60034A0C /end MEASUREMENT
/begin MEASUREMENT DFC_b.TSC_BattULoFailr "Bit encoding / Ok-Tested Since Clear bit for check DFC_BattULoFailr" UBYTE DFC_OneToOne 1 100 0.00 1.000 BIT_MASK 0x20 FORMAT "%5.3" ECU_ADDRESS 0x60034A0D /end MEASUREMENT
/begin MEASUREMENT DFC_b.TSC_BrkBstPDriftHiErr "Bit encoding / Ok-Tested Since Clear bit for check DFC_BrkBstPDriftHiErr" UBYTE DFC_OneToOne 1 100 0.00 1.000 BIT_MASK 0x20 FORMAT "%5.3" ECU_ADDRESS 0x60034A0E /end MEASUREMENT
/begin MEASUREMENT DFC_b.TSC_BrkBstPDriftLoErr "Bit encoding / Ok-Tested Since Clear bit for check DFC_BrkBstPDriftLoErr" UBYTE DFC_OneToOne 1 100 0.00 1.000 BIT_MASK 0x20 FORMAT "%5.3" ECU_ADDRESS 0x60034A0F /end MEASUREMENT
/begin MEASUREMENT DFC_b.TSC_BrkBstPSnsrStuck "Bit encoding / Ok-Tested Since Clear bit for check DFC_BrkBstPSnsrStuck" UBYTE DFC_OneToOne 1 100 0.00 1.000 BIT_MASK 0x20 FORMAT "%5.3" ECU_ADDRESS 0x60034A10 /end MEASUREMENT
/begin MEASUREMENT DFC_b.TSC_BrkMnSwtContOn "Bit encoding / Ok-Tested Since Clear bit for check DFC_BrkMnSwtContOn" UBYTE DFC_OneToOne 1 100 0.00 1.000 BIT_MASK 0x20 FORMAT "%5.3" ECU_ADDRESS 0x60034A11 /end MEASUREMENT
/begin MEASUREMENT DFC_b.TSC_BrkMnSwtNotStp "Bit encoding / Ok-Tested Since Clear bit for check DFC_BrkMnSwtNotStp" UBYTE DFC_OneToOne 1 100 0.00 1.000 BIT_MASK 0x20 FORMAT "%5.3" ECU_ADDRESS 0x60034A12 /end MEASUREMENT
/begin MEASUREMENT DFC_b.TSC_BrkNpl "Bit encoding / Ok-Tested Since Clear bit for check DFC_BrkNpl" UBYTE DFC_OneToOne 1 100 0.00 1.000 BIT_MASK 0x20 FORMAT "%5.3" ECU_ADDRESS 0x60034A13 /end MEASUREMENT
/begin MEASUREMENT DFC_b.TSC_BrkRdntSwtContOn "Bit encoding / Ok-Tested Since Clear bit for check DFC_BrkRdntSwtContOn" UBYTE DFC_OneToOne 1 100 0.00 1.000 BIT_MASK 0x20 FORMAT "%5.3" ECU_ADDRESS 0x60034A14 /end MEASUREMENT
/begin MEASUREMENT DFC_b.TSC_BrkRdntSwtNotStp "Bit encoding / Ok-Tested Since Clear bit for check DFC_BrkRdntSwtNotStp" UBYTE DFC_OneToOne 1 100 0.00 1.000 BIT_MASK 0x20 FORMAT "%5.3" ECU_ADDRESS 0x60034A15 /end MEASUREMENT
/begin MEASUREMENT DFC_b.TSC_Clth3ONStuck "Bit encoding / Ok-Tested Since Clear bit for check DFC_Clth3ONStuck" UBYTE DFC_OneToOne 1 100 0.00 1.000 BIT_MASK 0x20 FORMAT "%5.3" ECU_ADDRESS 0x60034A16 /end MEASUREMENT
/begin MEASUREMENT DFC_b.TSC_Clth4OFFStuck "Bit encoding / Ok-Tested Since Clear bit for check DFC_Clth4OFFStuck" UBYTE DFC_OneToOne 1 100 0.00 1.000 BIT_MASK 0x20 FORMAT "%5.3" ECU_ADDRESS 0x60034A17 /end MEASUREMENT
/begin MEASUREMENT DFC_b.TSC_ClthOFFStuck "Bit encoding / Ok-Tested Since Clear bit for check DFC_ClthOFFStuck" UBYTE DFC_OneToOne 1 100 0.00 1.000 BIT_MASK 0x20 FORMAT "%5.3" ECU_ADDRESS 0x60034A18 /end MEASUREMENT
/begin MEASUREMENT DFC_b.TSC_ClthONStuck "Bit encoding / Ok-Tested Since Clear bit for check DFC_ClthONStuck" UBYTE DFC_OneToOne 1 100 0.00 1.000 BIT_MASK 0x20 FORMAT "%5.3" ECU_ADDRESS 0x60034A19 /end MEASUREMENT
/begin MEASUREMENT DFC_b.TSC_ClthStkFailInfo "Bit encoding / Ok-Tested Since Clear bit for check DFC_ClthStkFailInfo" UBYTE DFC_OneToOne 1 100 0.00 1.000 BIT_MASK 0x20 FORMAT "%5.3" ECU_ADDRESS 0x60034A1A /end MEASUREMENT
/begin MEASUREMENT DFC_b.TSC_ComACFailInfo "Bit encoding / Ok-Tested Since Clear bit for check DFC_ComACFailInfo" UBYTE DFC_OneToOne 1 100 0.00 1.000 BIT_MASK 0x20 FORMAT "%5.3" ECU_ADDRESS 0x60034A1B /end MEASUREMENT
/begin MEASUREMENT DFC_b.TSC_ComATFTValErr "Bit encoding / Ok-Tested Since Clear bit for check DFC_ComATFTValErr" UBYTE DFC_OneToOne 1 100 0.00 1.000 BIT_MASK 0x20 FORMAT "%5.3" ECU_ADDRESS 0x60034A1C /end MEASUREMENT
/begin MEASUREMENT DFC_b.TSC_ComATMILReq "Bit encoding / Ok-Tested Since Clear bit for check DFC_ComATMILReq" UBYTE DFC_OneToOne 1 100 0.00 1.000 BIT_MASK 0x20 FORMAT "%5.3" ECU_ADDRESS 0x60034A1D /end MEASUREMENT
/begin MEASUREMENT DFC_b.TSC_ComAYCAChksum "Bit encoding / Ok-Tested Since Clear bit for check DFC_ComAYCAChksum" UBYTE DFC_OneToOne 1 100 0.00 1.000 BIT_MASK 0x20 FORMAT "%5.3" ECU_ADDRESS 0x60034A1E /end MEASUREMENT
/begin MEASUREMENT DFC_b.TSC_ComAYCARingCnt "Bit encoding / Ok-Tested Since Clear bit for check DFC_ComAYCARingCnt" UBYTE DFC_OneToOne 1 100 0.00 1.000 BIT_MASK 0x20 FORMAT "%5.3" ECU_ADDRESS 0x60034A1F /end MEASUREMENT
/begin MEASUREMENT DFC_b.TSC_ComAYCATOut "Bit encoding / Ok-Tested Since Clear bit for check DFC_ComAYCATOut" UBYTE DFC_OneToOne 1 100 0.00 1.000 BIT_MASK 0x20 FORMAT "%5.3" ECU_ADDRESS 0x60034A20 /end MEASUREMENT
/begin MEASUREMENT DFC_b.TSC_ComAYCDChkSum "Bit encoding / Ok-Tested Since Clear bit for check DFC_ComAYCDChkSum" UBYTE DFC_OneToOne 1 100 0.00 1.000 BIT_MASK 0x20 FORMAT "%5.3" ECU_ADDRESS 0x60034A21 /end MEASUREMENT
/begin MEASUREMENT DFC_b.TSC_ComAYCDTOut "Bit encoding / Ok-Tested Since Clear bit for check DFC_ComAYCDTOut" UBYTE DFC_OneToOne 1 100 0.00 1.000 BIT_MASK 0x20 FORMAT "%5.3" ECU_ADDRESS 0x60034A22 /end MEASUREMENT
/begin MEASUREMENT DFC_b.TSC_ComAYCFChksum "Bit encoding / Ok-Tested Since Clear bit for check DFC_ComAYCFChksum" UBYTE DFC_OneToOne 1 100 0.00 1.000 BIT_MASK 0x20 FORMAT "%5.3" ECU_ADDRESS 0x60034A23 /end MEASUREMENT
/begin MEASUREMENT DFC_b.TSC_ComAYCFRingCnt "Bit encoding / Ok-Tested Since Clear bit for check DFC_ComAYCFRingCnt" UBYTE DFC_OneToOne 1 100 0.00 1.000 BIT_MASK 0x20 FORMAT "%5.3" ECU_ADDRESS 0x60034A24 /end MEASUREMENT
/begin MEASUREMENT DFC_b.TSC_ComAYCFTOut "Bit encoding / Ok-Tested Since Clear bit for check DFC_ComAYCFTOut" UBYTE DFC_OneToOne 1 100 0.00 1.000 BIT_MASK 0x20 FORMAT "%5.3" ECU_ADDRESS 0x60034A25 /end MEASUREMENT
/begin MEASUREMENT DFC_b.TSC_ComAYCGChksum "Bit encoding / Ok-Tested Since Clear bit for check DFC_ComAYCGChksum" UBYTE DFC_OneToOne 1 100 0.00 1.000 BIT_MASK 0x20 FORMAT "%5.3" ECU_ADDRESS 0x60034A26 /end MEASUREMENT
/begin MEASUREMENT DFC_b.TSC_ComAYCGRingCnt "Bit encoding / Ok-Tested Since Clear bit for check DFC_ComAYCGRingCnt" UBYTE DFC_OneToOne 1 100 0.00 1.000 BIT_MASK 0x20 FORMAT "%5.3" ECU_ADDRESS 0x60034A27 /end MEASUREMENT
/begin MEASUREMENT DFC_b.TSC_ComAYCGTOut "Bit encoding / Ok-Tested Since Clear bit for check DFC_ComAYCGTOut" UBYTE DFC_OneToOne 1 100 0.00 1.000 BIT_MASK 0x20 FORMAT "%5.3" ECU_ADDRESS 0x60034A28 /end MEASUREMENT
/begin MEASUREMENT DFC_b.TSC_ComAYCIChkSum "Bit encoding / Ok-Tested Since Clear bit for check DFC_ComAYCIChkSum" UBYTE DFC_OneToOne 1 100 0.00 1.000 BIT_MASK 0x20 FORMAT "%5.3" ECU_ADDRESS 0x60034A29 /end MEASUREMENT
/begin MEASUREMENT DFC_b.TSC_ComAYCIRingCnt "Bit encoding / Ok-Tested Since Clear bit for check DFC_ComAYCIRingCnt" UBYTE DFC_OneToOne 1 100 0.00 1.000 BIT_MASK 0x20 FORMAT "%5.3" ECU_ADDRESS 0x60034A2A /end MEASUREMENT
/begin MEASUREMENT DFC_b.TSC_ComAYCITOut "Bit encoding / Ok-Tested Since Clear bit for check DFC_ComAYCITOut" UBYTE DFC_OneToOne 1 100 0.00 1.000 BIT_MASK 0x20 FORMAT "%5.3" ECU_ADDRESS 0x60034A2B /end MEASUREMENT
/begin MEASUREMENT DFC_b.TSC_ComBCM1ChkSum "Bit encoding / Ok-Tested Since Clear bit for check DFC_ComBCM1ChkSum" UBYTE DFC_OneToOne 1 100 0.00 1.000 BIT_MASK 0x20 FORMAT "%5.3" ECU_ADDRESS 0x60034A2C /end MEASUREMENT
/begin MEASUREMENT DFC_b.TSC_ComBCM1RingCnt "Bit encoding / Ok-Tested Since Clear bit for check DFC_ComBCM1RingCnt" UBYTE DFC_OneToOne 1 100 0.00 1.000 BIT_MASK 0x20 FORMAT "%5.3" ECU_ADDRESS 0x60034A2D /end MEASUREMENT
/begin MEASUREMENT DFC_b.TSC_ComBCM1TOut "Bit encoding / Ok-Tested Since Clear bit for check DFC_ComBCM1TOut" UBYTE DFC_OneToOne 1 100 0.00 1.000 BIT_MASK 0x20 FORMAT "%5.3" ECU_ADDRESS 0x60034A2E /end MEASUREMENT
/begin MEASUREMENT DFC_b.TSC_ComCANABusOffErr "Bit encoding / Ok-Tested Since Clear bit for check DFC_ComCANABusOffErr" UBYTE DFC_OneToOne 1 100 0.00 1.000 BIT_MASK 0x20 FORMAT "%5.3" ECU_ADDRESS 0x60034A2F /end MEASUREMENT
/begin MEASUREMENT DFC_b.TSC_ComCANBBusOffErr "Bit encoding / Ok-Tested Since Clear bit for check DFC_ComCANBBusOffErr" UBYTE DFC_OneToOne 1 100 0.00 1.000 BIT_MASK 0x20 FORMAT "%5.3" ECU_ADDRESS 0x60034A30 /end MEASUREMENT
/begin MEASUREMENT DFC_b.TSC_ComCANCBusOffErr "Bit encoding / Ok-Tested Since Clear bit for check DFC_ComCANCBusOffErr" UBYTE DFC_OneToOne 1 100 0.00 1.000 BIT_MASK 0x20 FORMAT "%5.3" ECU_ADDRESS 0x60034A31 /end MEASUREMENT
/begin MEASUREMENT DFC_b.TSC_ComCGW1ChkSum "Bit encoding / Ok-Tested Since Clear bit for check DFC_ComCGW1ChkSum" UBYTE DFC_OneToOne 1 100 0.00 1.000 BIT_MASK 0x20 FORMAT "%5.3" ECU_ADDRESS 0x60034A32 /end MEASUREMENT
/begin MEASUREMENT DFC_b.TSC_ComCGW1RingCnt "Bit encoding / Ok-Tested Since Clear bit for check DFC_ComCGW1RingCnt" UBYTE DFC_OneToOne 1 100 0.00 1.000 BIT_MASK 0x20 FORMAT "%5.3" ECU_ADDRESS 0x60034A33 /end MEASUREMENT
/begin MEASUREMENT DFC_b.TSC_ComCGW1TOut "Bit encoding / Ok-Tested Since Clear bit for check DFC_ComCGW1TOut" UBYTE DFC_OneToOne 1 100 0.00 1.000 BIT_MASK 0x20 FORMAT "%5.3" ECU_ADDRESS 0x60034A34 /end MEASUREMENT
/begin MEASUREMENT DFC_b.TSC_ComConvBoostErr "Bit encoding / Ok-Tested Since Clear bit for check DFC_ComConvBoostErr" UBYTE DFC_OneToOne 1 100 0.00 1.000 BIT_MASK 0x20 FORMAT "%5.3" ECU_ADDRESS 0x60034A35 /end MEASUREMENT
/begin MEASUREMENT DFC_b.TSC_ComConvSlipErr "Bit encoding / Ok-Tested Since Clear bit for check DFC_ComConvSlipErr" UBYTE DFC_OneToOne 1 100 0.00 1.000 BIT_MASK 0x20 FORMAT "%5.3" ECU_ADDRESS 0x60034A36 /end MEASUREMENT
/begin MEASUREMENT DFC_b.TSC_ComEAT10Chksum "Bit encoding / Ok-Tested Since Clear bit for check DFC_ComEAT10Chksum" UBYTE DFC_OneToOne 1 100 0.00 1.000 BIT_MASK 0x20 FORMAT "%5.3" ECU_ADDRESS 0x60034A37 /end MEASUREMENT
/begin MEASUREMENT DFC_b.TSC_ComEAT10RingCnt "Bit encoding / Ok-Tested Since Clear bit for check DFC_ComEAT10RingCnt" UBYTE DFC_OneToOne 1 100 0.00 1.000 BIT_MASK 0x20 FORMAT "%5.3" ECU_ADDRESS 0x60034A38 /end MEASUREMENT
/begin MEASUREMENT DFC_b.TSC_ComEAT10TOut "Bit encoding / Ok-Tested Since Clear bit for check DFC_ComEAT10TOut" UBYTE DFC_OneToOne 1 100 0.00 1.000 BIT_MASK 0x20 FORMAT "%5.3" ECU_ADDRESS 0x60034A39 /end MEASUREMENT
/begin MEASUREMENT DFC_b.TSC_ComEAT11ChkSum "Bit encoding / Ok-Tested Since Clear bit for check DFC_ComEAT11ChkSum" UBYTE DFC_OneToOne 1 100 0.00 1.000 BIT_MASK 0x20 FORMAT "%5.3" ECU_ADDRESS 0x60034A3A /end MEASUREMENT
/begin MEASUREMENT DFC_b.TSC_ComEAT11RingCnt "Bit encoding / Ok-Tested Since Clear bit for check DFC_ComEAT11RingCnt" UBYTE DFC_OneToOne 1 100 0.00 1.000 BIT_MASK 0x20 FORMAT "%5.3" ECU_ADDRESS 0x60034A3B /end MEASUREMENT
/begin MEASUREMENT DFC_b.TSC_ComEAT11TOut "Bit encoding / Ok-Tested Since Clear bit for check DFC_ComEAT11TOut" UBYTE DFC_OneToOne 1 100 0.00 1.000 BIT_MASK 0x20 FORMAT "%5.3" ECU_ADDRESS 0x60034A3C /end MEASUREMENT
/begin MEASUREMENT DFC_b.TSC_ComEAT12ChkSum "Bit encoding / Ok-Tested Since Clear bit for check DFC_ComEAT12ChkSum" UBYTE DFC_OneToOne 1 100 0.00 1.000 BIT_MASK 0x20 FORMAT "%5.3" ECU_ADDRESS 0x60034A3D /end MEASUREMENT
/begin MEASUREMENT DFC_b.TSC_ComEAT12RingCnt "Bit encoding / Ok-Tested Since Clear bit for check DFC_ComEAT12RingCnt" UBYTE DFC_OneToOne 1 100 0.00 1.000 BIT_MASK 0x20 FORMAT "%5.3" ECU_ADDRESS 0x60034A3E /end MEASUREMENT
/begin MEASUREMENT DFC_b.TSC_ComEAT12TOut "Bit encoding / Ok-Tested Since Clear bit for check DFC_ComEAT12TOut" UBYTE DFC_OneToOne 1 100 0.00 1.000 BIT_MASK 0x20 FORMAT "%5.3" ECU_ADDRESS 0x60034A3F /end MEASUREMENT
/begin MEASUREMENT DFC_b.TSC_ComEAT13ChkSum "Bit encoding / Ok-Tested Since Clear bit for check DFC_ComEAT13ChkSum" UBYTE DFC_OneToOne 1 100 0.00 1.000 BIT_MASK 0x20 FORMAT "%5.3" ECU_ADDRESS 0x60034A40 /end MEASUREMENT
/begin MEASUREMENT DFC_b.TSC_ComEAT13RingCnt "Bit encoding / Ok-Tested Since Clear bit for check DFC_ComEAT13RingCnt" UBYTE DFC_OneToOne 1 100 0.00 1.000 BIT_MASK 0x20 FORMAT "%5.3" ECU_ADDRESS 0x60034A41 /end MEASUREMENT
/begin MEASUREMENT DFC_b.TSC_ComEAT13TOut "Bit encoding / Ok-Tested Since Clear bit for check DFC_ComEAT13TOut" UBYTE DFC_OneToOne 1 100 0.00 1.000 BIT_MASK 0x20 FORMAT "%5.3" ECU_ADDRESS 0x60034A42 /end MEASUREMENT
/begin MEASUREMENT DFC_b.TSC_ComEAT1Chksum "Bit encoding / Ok-Tested Since Clear bit for check DFC_ComEAT1Chksum" UBYTE DFC_OneToOne 1 100 0.00 1.000 BIT_MASK 0x20 FORMAT "%5.3" ECU_ADDRESS 0x60034A43 /end MEASUREMENT
/begin MEASUREMENT DFC_b.TSC_ComEAT1RingCnt "Bit encoding / Ok-Tested Since Clear bit for check DFC_ComEAT1RingCnt" UBYTE DFC_OneToOne 1 100 0.00 1.000 BIT_MASK 0x20 FORMAT "%5.3" ECU_ADDRESS 0x60034A44 /end MEASUREMENT
/begin MEASUREMENT DFC_b.TSC_ComEAT1TOut "Bit encoding / Ok-Tested Since Clear bit for check DFC_ComEAT1TOut" UBYTE DFC_OneToOne 1 100 0.00 1.000 BIT_MASK 0x20 FORMAT "%5.3" ECU_ADDRESS 0x60034A45 /end MEASUREMENT
/begin MEASUREMENT DFC_b.TSC_ComEAT2ChkSum "Bit encoding / Ok-Tested Since Clear bit for check DFC_ComEAT2ChkSum" UBYTE DFC_OneToOne 1 100 0.00 1.000 BIT_MASK 0x20 FORMAT "%5.3" ECU_ADDRESS 0x60034A46 /end MEASUREMENT
/begin MEASUREMENT DFC_b.TSC_ComEAT2RingCnt "Bit encoding / Ok-Tested Since Clear bit for check DFC_ComEAT2RingCnt" UBYTE DFC_OneToOne 1 100 0.00 1.000 BIT_MASK 0x20 FORMAT "%5.3" ECU_ADDRESS 0x60034A47 /end MEASUREMENT
/begin MEASUREMENT DFC_b.TSC_ComEAT2TOut "Bit encoding / Ok-Tested Since Clear bit for check DFC_ComEAT2TOut" UBYTE DFC_OneToOne 1 100 0.00 1.000 BIT_MASK 0x20 FORMAT "%5.3" ECU_ADDRESS 0x60034A48 /end MEASUREMENT
/begin MEASUREMENT DFC_b.TSC_ComEAT4ChkSum "Bit encoding / Ok-Tested Since Clear bit for check DFC_ComEAT4ChkSum" UBYTE DFC_OneToOne 1 100 0.00 1.000 BIT_MASK 0x20 FORMAT "%5.3" ECU_ADDRESS 0x60034A49 /end MEASUREMENT
/begin MEASUREMENT DFC_b.TSC_ComEAT4RingCnt "Bit encoding / Ok-Tested Since Clear bit for check DFC_ComEAT4RingCnt" UBYTE DFC_OneToOne 1 100 0.00 1.000 BIT_MASK 0x20 FORMAT "%5.3" ECU_ADDRESS 0x60034A4A /end MEASUREMENT
/begin MEASUREMENT DFC_b.TSC_ComEAT4TOut "Bit encoding / Ok-Tested Since Clear bit for check DFC_ComEAT4TOut" UBYTE DFC_OneToOne 1 100 0.00 1.000 BIT_MASK 0x20 FORMAT "%5.3" ECU_ADDRESS 0x60034A4B /end MEASUREMENT
/begin MEASUREMENT DFC_b.TSC_ComEAT6Chksum "Bit encoding / Ok-Tested Since Clear bit for check DFC_ComEAT6Chksum" UBYTE DFC_OneToOne 1 100 0.00 1.000 BIT_MASK 0x20 FORMAT "%5.3" ECU_ADDRESS 0x60034A4C /end MEASUREMENT
/begin MEASUREMENT DFC_b.TSC_ComEAT6RingCnt "Bit encoding / Ok-Tested Since Clear bit for check DFC_ComEAT6RingCnt" UBYTE DFC_OneToOne 1 100 0.00 1.000 BIT_MASK 0x20 FORMAT "%5.3" ECU_ADDRESS 0x60034A4D /end MEASUREMENT
/begin MEASUREMENT DFC_b.TSC_ComEAT6TOut "Bit encoding / Ok-Tested Since Clear bit for check DFC_ComEAT6TOut" UBYTE DFC_OneToOne 1 100 0.00 1.000 BIT_MASK 0x20 FORMAT "%5.3" ECU_ADDRESS 0x60034A4E /end MEASUREMENT
/begin MEASUREMENT DFC_b.TSC_ComEAT7Chksum "Bit encoding / Ok-Tested Since Clear bit for check DFC_ComEAT7Chksum" UBYTE DFC_OneToOne 1 100 0.00 1.000 BIT_MASK 0x20 FORMAT "%5.3" ECU_ADDRESS 0x60034A4F /end MEASUREMENT
/begin MEASUREMENT DFC_b.TSC_ComEAT7RingCnt "Bit encoding / Ok-Tested Since Clear bit for check DFC_ComEAT7RingCnt" UBYTE DFC_OneToOne 1 100 0.00 1.000 BIT_MASK 0x20 FORMAT "%5.3" ECU_ADDRESS 0x60034A50 /end MEASUREMENT
/begin MEASUREMENT DFC_b.TSC_ComEAT7TOut "Bit encoding / Ok-Tested Since Clear bit for check DFC_ComEAT7TOut" UBYTE DFC_OneToOne 1 100 0.00 1.000 BIT_MASK 0x20 FORMAT "%5.3" ECU_ADDRESS 0x60034A51 /end MEASUREMENT
/begin MEASUREMENT DFC_b.TSC_ComEAT8Chksum "Bit encoding / Ok-Tested Since Clear bit for check DFC_ComEAT8Chksum" UBYTE DFC_OneToOne 1 100 0.00 1.000 BIT_MASK 0x20 FORMAT "%5.3" ECU_ADDRESS 0x60034A52 /end MEASUREMENT
/begin MEASUREMENT DFC_b.TSC_ComEAT8RingCnt "Bit encoding / Ok-Tested Since Clear bit for check DFC_ComEAT8RingCnt" UBYTE DFC_OneToOne 1 100 0.00 1.000 BIT_MASK 0x20 FORMAT "%5.3" ECU_ADDRESS 0x60034A53 /end MEASUREMENT
/begin MEASUREMENT DFC_b.TSC_ComEAT8TOut "Bit encoding / Ok-Tested Since Clear bit for check DFC_ComEAT8TOut" UBYTE DFC_OneToOne 1 100 0.00 1.000 BIT_MASK 0x20 FORMAT "%5.3" ECU_ADDRESS 0x60034A54 /end MEASUREMENT
/begin MEASUREMENT DFC_b.TSC_ComEATAChksum "Bit encoding / Ok-Tested Since Clear bit for check DFC_ComEATAChksum" UBYTE DFC_OneToOne 1 100 0.00 1.000 BIT_MASK 0x20 FORMAT "%5.3" ECU_ADDRESS 0x60034A55 /end MEASUREMENT
/begin MEASUREMENT DFC_b.TSC_ComEATARingCnt "Bit encoding / Ok-Tested Since Clear bit for check DFC_ComEATARingCnt" UBYTE DFC_OneToOne 1 100 0.00 1.000 BIT_MASK 0x20 FORMAT "%5.3" ECU_ADDRESS 0x60034A56 /end MEASUREMENT
/begin MEASUREMENT DFC_b.TSC_ComEATATOut "Bit encoding / Ok-Tested Since Clear bit for check DFC_ComEATATOut" UBYTE DFC_OneToOne 1 100 0.00 1.000 BIT_MASK 0x20 FORMAT "%5.3" ECU_ADDRESS 0x60034A57 /end MEASUREMENT
/begin MEASUREMENT DFC_b.TSC_ComEATBChkSum "Bit encoding / Ok-Tested Since Clear bit for check DFC_ComEATBChkSum" UBYTE DFC_OneToOne 1 100 0.00 1.000 BIT_MASK 0x20 FORMAT "%5.3" ECU_ADDRESS 0x60034A58 /end MEASUREMENT
/begin MEASUREMENT DFC_b.TSC_ComEATBRingCnt "Bit encoding / Ok-Tested Since Clear bit for check DFC_ComEATBRingCnt" UBYTE DFC_OneToOne 1 100 0.00 1.000 BIT_MASK 0x20 FORMAT "%5.3" ECU_ADDRESS 0x60034A59 /end MEASUREMENT
/begin MEASUREMENT DFC_b.TSC_ComEATBTOut "Bit encoding / Ok-Tested Since Clear bit for check DFC_ComEATBTOut" UBYTE DFC_OneToOne 1 100 0.00 1.000 BIT_MASK 0x20 FORMAT "%5.3" ECU_ADDRESS 0x60034A5A /end MEASUREMENT
/begin MEASUREMENT DFC_b.TSC_ComEATCChksum "Bit encoding / Ok-Tested Since Clear bit for check DFC_ComEATCChksum" UBYTE DFC_OneToOne 1 100 0.00 1.000 BIT_MASK 0x20 FORMAT "%5.3" ECU_ADDRESS 0x60034A5B /end MEASUREMENT
/begin MEASUREMENT DFC_b.TSC_ComEATCRingCnt "Bit encoding / Ok-Tested Since Clear bit for check DFC_ComEATCRingCnt" UBYTE DFC_OneToOne 1 100 0.00 1.000 BIT_MASK 0x20 FORMAT "%5.3" ECU_ADDRESS 0x60034A5C /end MEASUREMENT
/begin MEASUREMENT DFC_b.TSC_ComEATCTOut "Bit encoding / Ok-Tested Since Clear bit for check DFC_ComEATCTOut" UBYTE DFC_OneToOne 1 100 0.00 1.000 BIT_MASK 0x20 FORMAT "%5.3" ECU_ADDRESS 0x60034A5D /end MEASUREMENT
/begin MEASUREMENT DFC_b.TSC_ComEBBAChksum "Bit encoding / Ok-Tested Since Clear bit for check DFC_ComEBBAChksum" UBYTE DFC_OneToOne 1 100 0.00 1.000 BIT_MASK 0x20 FORMAT "%5.3" ECU_ADDRESS 0x60034A5E /end MEASUREMENT
/begin MEASUREMENT DFC_b.TSC_ComEBBARingCnt "Bit encoding / Ok-Tested Since Clear bit for check DFC_ComEBBARingCnt" UBYTE DFC_OneToOne 1 100 0.00 1.000 BIT_MASK 0x20 FORMAT "%5.3" ECU_ADDRESS 0x60034A5F /end MEASUREMENT
/begin MEASUREMENT DFC_b.TSC_ComEBBATOut "Bit encoding / Ok-Tested Since Clear bit for check DFC_ComEBBATOut" UBYTE DFC_OneToOne 1 100 0.00 1.000 BIT_MASK 0x20 FORMAT "%5.3" ECU_ADDRESS 0x60034A60 /end MEASUREMENT
/begin MEASUREMENT DFC_b.TSC_ComEPS1Chksum "Bit encoding / Ok-Tested Since Clear bit for check DFC_ComEPS1Chksum" UBYTE DFC_OneToOne 1 100 0.00 1.000 BIT_MASK 0x20 FORMAT "%5.3" ECU_ADDRESS 0x60034A61 /end MEASUREMENT
/begin MEASUREMENT DFC_b.TSC_ComEPS1RingCnt "Bit encoding / Ok-Tested Since Clear bit for check DFC_ComEPS1RingCnt" UBYTE DFC_OneToOne 1 100 0.00 1.000 BIT_MASK 0x20 FORMAT "%5.3" ECU_ADDRESS 0x60034A62 /end MEASUREMENT
/begin MEASUREMENT DFC_b.TSC_ComEPS1TOut "Bit encoding / Ok-Tested Since Clear bit for check DFC_ComEPS1TOut" UBYTE DFC_OneToOne 1 100 0.00 1.000 BIT_MASK 0x20 FORMAT "%5.3" ECU_ADDRESS 0x60034A63 /end MEASUREMENT
/begin MEASUREMENT DFC_b.TSC_ComEngCanRxErr "Bit encoding / Ok-Tested Since Clear bit for check DFC_ComEngCanRxErr" UBYTE DFC_OneToOne 1 100 0.00 1.000 BIT_MASK 0x20 FORMAT "%5.3" ECU_ADDRESS 0x60034A64 /end MEASUREMENT
/begin MEASUREMENT DFC_b.TSC_ComGrvySnsrErr "Bit encoding / Ok-Tested Since Clear bit for check DFC_ComGrvySnsrErr" UBYTE DFC_OneToOne 1 100 0.00 1.000 BIT_MASK 0x20 FORMAT "%5.3" ECU_ADDRESS 0x60034A65 /end MEASUREMENT
/begin MEASUREMENT DFC_b.TSC_ComGwIMG1ChkSum "Bit encoding / Ok-Tested Since Clear bit for check DFC_ComGwIMG1ChkSum" UBYTE DFC_OneToOne 1 100 0.00 1.000 BIT_MASK 0x20 FORMAT "%5.3" ECU_ADDRESS 0x60034A66 /end MEASUREMENT
/begin MEASUREMENT DFC_b.TSC_ComGwIMG1RingCnt "Bit encoding / Ok-Tested Since Clear bit for check DFC_ComGwIMG1RingCnt" UBYTE DFC_OneToOne 1 100 0.00 1.000 BIT_MASK 0x20 FORMAT "%5.3" ECU_ADDRESS 0x60034A67 /end MEASUREMENT
/begin MEASUREMENT DFC_b.TSC_ComGwIMG1TOut "Bit encoding / Ok-Tested Since Clear bit for check DFC_ComGwIMG1TOut" UBYTE DFC_OneToOne 1 100 0.00 1.000 BIT_MASK 0x20 FORMAT "%5.3" ECU_ADDRESS 0x60034A68 /end MEASUREMENT
/begin MEASUREMENT DFC_b.TSC_ComGwIMG3ChkSum "Bit encoding / Ok-Tested Since Clear bit for check DFC_ComGwIMG3ChkSum" UBYTE DFC_OneToOne 1 100 0.00 1.000 BIT_MASK 0x20 FORMAT "%5.3" ECU_ADDRESS 0x60034A69 /end MEASUREMENT
/begin MEASUREMENT DFC_b.TSC_ComGwIMG3RingCnt "Bit encoding / Ok-Tested Since Clear bit for check DFC_ComGwIMG3RingCnt" UBYTE DFC_OneToOne 1 100 0.00 1.000 BIT_MASK 0x20 FORMAT "%5.3" ECU_ADDRESS 0x60034A6A /end MEASUREMENT
/begin MEASUREMENT DFC_b.TSC_ComGwIMG3TOut "Bit encoding / Ok-Tested Since Clear bit for check DFC_ComGwIMG3TOut" UBYTE DFC_OneToOne 1 100 0.00 1.000 BIT_MASK 0x20 FORMAT "%5.3" ECU_ADDRESS 0x60034A6B /end MEASUREMENT
/begin MEASUREMENT DFC_b.TSC_ComGwIMG4ChkSum "Bit encoding / Ok-Tested Since Clear bit for check DFC_ComGwIMG4ChkSum" UBYTE DFC_OneToOne 1 100 0.00 1.000 BIT_MASK 0x20 FORMAT "%5.3" ECU_ADDRESS 0x60034A6C /end MEASUREMENT
/begin MEASUREMENT DFC_b.TSC_ComGwIMG4RingCnt "Bit encoding / Ok-Tested Since Clear bit for check DFC_ComGwIMG4RingCnt" UBYTE DFC_OneToOne 1 100 0.00 1.000 BIT_MASK 0x20 FORMAT "%5.3" ECU_ADDRESS 0x60034A6D /end MEASUREMENT
/begin MEASUREMENT DFC_b.TSC_ComGwIMG4TOut "Bit encoding / Ok-Tested Since Clear bit for check DFC_ComGwIMG4TOut" UBYTE DFC_OneToOne 1 100 0.00 1.000 BIT_MASK 0x20 FORMAT "%5.3" ECU_ADDRESS 0x60034A6E /end MEASUREMENT
/begin MEASUREMENT DFC_b.TSC_ComGwIMG5ChkSum "Bit encoding / Ok-Tested Since Clear bit for check DFC_ComGwIMG5ChkSum" UBYTE DFC_OneToOne 1 100 0.00 1.000 BIT_MASK 0x20 FORMAT "%5.3" ECU_ADDRESS 0x60034A6F /end MEASUREMENT
/begin MEASUREMENT DFC_b.TSC_ComGwIMG5RingCnt "Bit encoding / Ok-Tested Since Clear bit for check DFC_ComGwIMG5RingCnt" UBYTE DFC_OneToOne 1 100 0.00 1.000 BIT_MASK 0x20 FORMAT "%5.3" ECU_ADDRESS 0x60034A70 /end MEASUREMENT
/begin MEASUREMENT DFC_b.TSC_ComGwIMG5TOut "Bit encoding / Ok-Tested Since Clear bit for check DFC_ComGwIMG5TOut" UBYTE DFC_OneToOne 1 100 0.00 1.000 BIT_MASK 0x20 FORMAT "%5.3" ECU_ADDRESS 0x60034A71 /end MEASUREMENT
/begin MEASUREMENT DFC_b.TSC_ComGwIMG6ChkSum "Bit encoding / Ok-Tested Since Clear bit for check DFC_ComGwIMG6ChkSum" UBYTE DFC_OneToOne 1 100 0.00 1.000 BIT_MASK 0x20 FORMAT "%5.3" ECU_ADDRESS 0x60034A72 /end MEASUREMENT
/begin MEASUREMENT DFC_b.TSC_ComGwIMG6RingCnt "Bit encoding / Ok-Tested Since Clear bit for check DFC_ComGwIMG6RingCnt" UBYTE DFC_OneToOne 1 100 0.00 1.000 BIT_MASK 0x20 FORMAT "%5.3" ECU_ADDRESS 0x60034A73 /end MEASUREMENT
/begin MEASUREMENT DFC_b.TSC_ComGwIMG6TOut "Bit encoding / Ok-Tested Since Clear bit for check DFC_ComGwIMG6TOut" UBYTE DFC_OneToOne 1 100 0.00 1.000 BIT_MASK 0x20 FORMAT "%5.3" ECU_ADDRESS 0x60034A74 /end MEASUREMENT
/begin MEASUREMENT DFC_b.TSC_ComIDASBChksum "Bit encoding / Ok-Tested Since Clear bit for check DFC_ComIDASBChksum" UBYTE DFC_OneToOne 1 100 0.00 1.000 BIT_MASK 0x20 FORMAT "%5.3" ECU_ADDRESS 0x60034A75 /end MEASUREMENT
/begin MEASUREMENT DFC_b.TSC_ComIDASBRingCnt "Bit encoding / Ok-Tested Since Clear bit for check DFC_ComIDASBRingCnt" UBYTE DFC_OneToOne 1 100 0.00 1.000 BIT_MASK 0x20 FORMAT "%5.3" ECU_ADDRESS 0x60034A76 /end MEASUREMENT
/begin MEASUREMENT DFC_b.TSC_ComIDASBTOut "Bit encoding / Ok-Tested Since Clear bit for check DFC_ComIDASBTOut" UBYTE DFC_OneToOne 1 100 0.00 1.000 BIT_MASK 0x20 FORMAT "%5.3" ECU_ADDRESS 0x60034A77 /end MEASUREMENT
/begin MEASUREMENT DFC_b.TSC_ComIMGMILReq "Bit encoding / Ok-Tested Since Clear bit for check DFC_ComIMGMILReq" UBYTE DFC_OneToOne 1 100 0.00 1.000 BIT_MASK 0x20 FORMAT "%5.3" ECU_ADDRESS 0x60034A78 /end MEASUREMENT
/begin MEASUREMENT DFC_b.TSC_ComISSPrms "Bit encoding / Ok-Tested Since Clear bit for check DFC_ComISSPrms" UBYTE DFC_OneToOne 1 100 0.00 1.000 BIT_MASK 0x20 FORMAT "%5.3" ECU_ADDRESS 0x60034A79 /end MEASUREMENT
/begin MEASUREMENT DFC_b.TSC_ComMETAChksum "Bit encoding / Ok-Tested Since Clear bit for check DFC_ComMETAChksum" UBYTE DFC_OneToOne 1 100 0.00 1.000 BIT_MASK 0x20 FORMAT "%5.3" ECU_ADDRESS 0x60034A7A /end MEASUREMENT
/begin MEASUREMENT DFC_b.TSC_ComMETARingCnt "Bit encoding / Ok-Tested Since Clear bit for check DFC_ComMETARingCnt" UBYTE DFC_OneToOne 1 100 0.00 1.000 BIT_MASK 0x20 FORMAT "%5.3" ECU_ADDRESS 0x60034A7B /end MEASUREMENT
/begin MEASUREMENT DFC_b.TSC_ComMETATOut "Bit encoding / Ok-Tested Since Clear bit for check DFC_ComMETATOut" UBYTE DFC_OneToOne 1 100 0.00 1.000 BIT_MASK 0x20 FORMAT "%5.3" ECU_ADDRESS 0x60034A7C /end MEASUREMENT
/begin MEASUREMENT DFC_b.TSC_ComMETCChksum "Bit encoding / Ok-Tested Since Clear bit for check DFC_ComMETCChksum" UBYTE DFC_OneToOne 1 100 0.00 1.000 BIT_MASK 0x20 FORMAT "%5.3" ECU_ADDRESS 0x60034A7D /end MEASUREMENT
/begin MEASUREMENT DFC_b.TSC_ComMETCRingCnt "Bit encoding / Ok-Tested Since Clear bit for check DFC_ComMETCRingCnt" UBYTE DFC_OneToOne 1 100 0.00 1.000 BIT_MASK 0x20 FORMAT "%5.3" ECU_ADDRESS 0x60034A7E /end MEASUREMENT
/begin MEASUREMENT DFC_b.TSC_ComMETCTOut "Bit encoding / Ok-Tested Since Clear bit for check DFC_ComMETCTOut" UBYTE DFC_OneToOne 1 100 0.00 1.000 BIT_MASK 0x20 FORMAT "%5.3" ECU_ADDRESS 0x60034A7F /end MEASUREMENT
/begin MEASUREMENT DFC_b.TSC_ComMETDChksum "Bit encoding / Ok-Tested Since Clear bit for check DFC_ComMETDChksum" UBYTE DFC_OneToOne 1 100 0.00 1.000 BIT_MASK 0x20 FORMAT "%5.3" ECU_ADDRESS 0x60034A80 /end MEASUREMENT
/begin MEASUREMENT DFC_b.TSC_ComMETDRingCnt "Bit encoding / Ok-Tested Since Clear bit for check DFC_ComMETDRingCnt" UBYTE DFC_OneToOne 1 100 0.00 1.000 BIT_MASK 0x20 FORMAT "%5.3" ECU_ADDRESS 0x60034A81 /end MEASUREMENT
/begin MEASUREMENT DFC_b.TSC_ComMETDTOut "Bit encoding / Ok-Tested Since Clear bit for check DFC_ComMETDTOut" UBYTE DFC_OneToOne 1 100 0.00 1.000 BIT_MASK 0x20 FORMAT "%5.3" ECU_ADDRESS 0x60034A82 /end MEASUREMENT
/begin MEASUREMENT DFC_b.TSC_ComMETE2Chksum "Bit encoding / Ok-Tested Since Clear bit for check DFC_ComMETE2Chksum" UBYTE DFC_OneToOne 1 100 0.00 1.000 BIT_MASK 0x20 FORMAT "%5.3" ECU_ADDRESS 0x60034A83 /end MEASUREMENT
/begin MEASUREMENT DFC_b.TSC_ComMETE2RingCnt "Bit encoding / Ok-Tested Since Clear bit for check DFC_ComMETE2RingCnt" UBYTE DFC_OneToOne 1 100 0.00 1.000 BIT_MASK 0x20 FORMAT "%5.3" ECU_ADDRESS 0x60034A84 /end MEASUREMENT
/begin MEASUREMENT DFC_b.TSC_ComMETE2TOut "Bit encoding / Ok-Tested Since Clear bit for check DFC_ComMETE2TOut" UBYTE DFC_OneToOne 1 100 0.00 1.000 BIT_MASK 0x20 FORMAT "%5.3" ECU_ADDRESS 0x60034A85 /end MEASUREMENT
/begin MEASUREMENT DFC_b.TSC_ComMETFChksum "Bit encoding / Ok-Tested Since Clear bit for check DFC_ComMETFChksum" UBYTE DFC_OneToOne 1 100 0.00 1.000 BIT_MASK 0x20 FORMAT "%5.3" ECU_ADDRESS 0x60034A86 /end MEASUREMENT
/begin MEASUREMENT DFC_b.TSC_ComMETFRingCnt "Bit encoding / Ok-Tested Since Clear bit for check DFC_ComMETFRingCnt" UBYTE DFC_OneToOne 1 100 0.00 1.000 BIT_MASK 0x20 FORMAT "%5.3" ECU_ADDRESS 0x60034A87 /end MEASUREMENT
/begin MEASUREMENT DFC_b.TSC_ComMETFTOut "Bit encoding / Ok-Tested Since Clear bit for check DFC_ComMETFTOut" UBYTE DFC_OneToOne 1 100 0.00 1.000 BIT_MASK 0x20 FORMAT "%5.3" ECU_ADDRESS 0x60034A88 /end MEASUREMENT
/begin MEASUREMENT DFC_b.TSC_ComMETGChksum "Bit encoding / Ok-Tested Since Clear bit for check DFC_ComMETGChksum" UBYTE DFC_OneToOne 1 100 0.00 1.000 BIT_MASK 0x20 FORMAT "%5.3" ECU_ADDRESS 0x60034A89 /end MEASUREMENT
/begin MEASUREMENT DFC_b.TSC_ComMETGRingCnt "Bit encoding / Ok-Tested Since Clear bit for check DFC_ComMETGRingCnt" UBYTE DFC_OneToOne 1 100 0.00 1.000 BIT_MASK 0x20 FORMAT "%5.3" ECU_ADDRESS 0x60034A8A /end MEASUREMENT
/begin MEASUREMENT DFC_b.TSC_ComMETGTOut "Bit encoding / Ok-Tested Since Clear bit for check DFC_ComMETGTOut" UBYTE DFC_OneToOne 1 100 0.00 1.000 BIT_MASK 0x20 FORMAT "%5.3" ECU_ADDRESS 0x60034A8B /end MEASUREMENT
/begin MEASUREMENT DFC_b.TSC_ComMETH2Chksum "Bit encoding / Ok-Tested Since Clear bit for check DFC_ComMETH2Chksum" UBYTE DFC_OneToOne 1 100 0.00 1.000 BIT_MASK 0x20 FORMAT "%5.3" ECU_ADDRESS 0x60034A8C /end MEASUREMENT
/begin MEASUREMENT DFC_b.TSC_ComMETH2RingCnt "Bit encoding / Ok-Tested Since Clear bit for check DFC_ComMETH2RingCnt" UBYTE DFC_OneToOne 1 100 0.00 1.000 BIT_MASK 0x20 FORMAT "%5.3" ECU_ADDRESS 0x60034A8D /end MEASUREMENT
/begin MEASUREMENT DFC_b.TSC_ComMETH2TOut "Bit encoding / Ok-Tested Since Clear bit for check DFC_ComMETH2TOut" UBYTE DFC_OneToOne 1 100 0.00 1.000 BIT_MASK 0x20 FORMAT "%5.3" ECU_ADDRESS 0x60034A8E /end MEASUREMENT
/begin MEASUREMENT DFC_b.TSC_ComMETHChksum "Bit encoding / Ok-Tested Since Clear bit for check DFC_ComMETHChksum" UBYTE DFC_OneToOne 1 100 0.00 1.000 BIT_MASK 0x20 FORMAT "%5.3" ECU_ADDRESS 0x60034A8F /end MEASUREMENT
/begin MEASUREMENT DFC_b.TSC_ComMETHRingCnt "Bit encoding / Ok-Tested Since Clear bit for check DFC_ComMETHRingCnt" UBYTE DFC_OneToOne 1 100 0.00 1.000 BIT_MASK 0x20 FORMAT "%5.3" ECU_ADDRESS 0x60034A90 /end MEASUREMENT
/begin MEASUREMENT DFC_b.TSC_ComMETHTOut "Bit encoding / Ok-Tested Since Clear bit for check DFC_ComMETHTOut" UBYTE DFC_OneToOne 1 100 0.00 1.000 BIT_MASK 0x20 FORMAT "%5.3" ECU_ADDRESS 0x60034A91 /end MEASUREMENT
/begin MEASUREMENT DFC_b.TSC_ComMETIChksum "Bit encoding / Ok-Tested Since Clear bit for check DFC_ComMETIChksum" UBYTE DFC_OneToOne 1 100 0.00 1.000 BIT_MASK 0x20 FORMAT "%5.3" ECU_ADDRESS 0x60034A92 /end MEASUREMENT
/begin MEASUREMENT DFC_b.TSC_ComMETIRingCnt "Bit encoding / Ok-Tested Since Clear bit for check DFC_ComMETIRingCnt" UBYTE DFC_OneToOne 1 100 0.00 1.000 BIT_MASK 0x20 FORMAT "%5.3" ECU_ADDRESS 0x60034A93 /end MEASUREMENT
/begin MEASUREMENT DFC_b.TSC_ComMETITOut "Bit encoding / Ok-Tested Since Clear bit for check DFC_ComMETITOut" UBYTE DFC_OneToOne 1 100 0.00 1.000 BIT_MASK 0x20 FORMAT "%5.3" ECU_ADDRESS 0x60034A94 /end MEASUREMENT
/begin MEASUREMENT DFC_b.TSC_ComMETKChksum "Bit encoding / Ok-Tested Since Clear bit for check DFC_ComMETKChksum" UBYTE DFC_OneToOne 1 100 0.00 1.000 BIT_MASK 0x20 FORMAT "%5.3" ECU_ADDRESS 0x60034A95 /end MEASUREMENT
/begin MEASUREMENT DFC_b.TSC_ComMETKRingCnt "Bit encoding / Ok-Tested Since Clear bit for check DFC_ComMETKRingCnt" UBYTE DFC_OneToOne 1 100 0.00 1.000 BIT_MASK 0x20 FORMAT "%5.3" ECU_ADDRESS 0x60034A96 /end MEASUREMENT
/begin MEASUREMENT DFC_b.TSC_ComMETKTOut "Bit encoding / Ok-Tested Since Clear bit for check DFC_ComMETKTOut" UBYTE DFC_OneToOne 1 100 0.00 1.000 BIT_MASK 0x20 FORMAT "%5.3" ECU_ADDRESS 0x60034A97 /end MEASUREMENT
/begin MEASUREMENT DFC_b.TSC_ComMETLChksum "Bit encoding / Ok-Tested Since Clear bit for check DFC_ComMETLChksum" UBYTE DFC_OneToOne 1 100 0.00 1.000 BIT_MASK 0x20 FORMAT "%5.3" ECU_ADDRESS 0x60034A98 /end MEASUREMENT
/begin MEASUREMENT DFC_b.TSC_ComMETLRingCnt "Bit encoding / Ok-Tested Since Clear bit for check DFC_ComMETLRingCnt" UBYTE DFC_OneToOne 1 100 0.00 1.000 BIT_MASK 0x20 FORMAT "%5.3" ECU_ADDRESS 0x60034A99 /end MEASUREMENT
/begin MEASUREMENT DFC_b.TSC_ComMETLTOut "Bit encoding / Ok-Tested Since Clear bit for check DFC_ComMETLTOut" UBYTE DFC_OneToOne 1 100 0.00 1.000 BIT_MASK 0x20 FORMAT "%5.3" ECU_ADDRESS 0x60034A9A /end MEASUREMENT
/begin MEASUREMENT DFC_b.TSC_ComMETMChksum "Bit encoding / Ok-Tested Since Clear bit for check DFC_ComMETMChksum" UBYTE DFC_OneToOne 1 100 0.00 1.000 BIT_MASK 0x20 FORMAT "%5.3" ECU_ADDRESS 0x60034A9B /end MEASUREMENT
/begin MEASUREMENT DFC_b.TSC_ComMETMRingCnt "Bit encoding / Ok-Tested Since Clear bit for check DFC_ComMETMRingCnt" UBYTE DFC_OneToOne 1 100 0.00 1.000 BIT_MASK 0x20 FORMAT "%5.3" ECU_ADDRESS 0x60034A9C /end MEASUREMENT
/begin MEASUREMENT DFC_b.TSC_ComMETMTOut "Bit encoding / Ok-Tested Since Clear bit for check DFC_ComMETMTOut" UBYTE DFC_OneToOne 1 100 0.00 1.000 BIT_MASK 0x20 FORMAT "%5.3" ECU_ADDRESS 0x60034A9D /end MEASUREMENT
/begin MEASUREMENT DFC_b.TSC_ComMETNChksum "Bit encoding / Ok-Tested Since Clear bit for check DFC_ComMETNChksum" UBYTE DFC_OneToOne 1 100 0.00 1.000 BIT_MASK 0x20 FORMAT "%5.3" ECU_ADDRESS 0x60034A9E /end MEASUREMENT
/begin MEASUREMENT DFC_b.TSC_ComMETNRingCnt "Bit encoding / Ok-Tested Since Clear bit for check DFC_ComMETNRingCnt" UBYTE DFC_OneToOne 1 100 0.00 1.000 BIT_MASK 0x20 FORMAT "%5.3" ECU_ADDRESS 0x60034A9F /end MEASUREMENT
/begin MEASUREMENT DFC_b.TSC_ComMETNTOut "Bit encoding / Ok-Tested Since Clear bit for check DFC_ComMETNTOut" UBYTE DFC_OneToOne 1 100 0.00 1.000 BIT_MASK 0x20 FORMAT "%5.3" ECU_ADDRESS 0x60034AA0 /end MEASUREMENT
/begin MEASUREMENT DFC_b.TSC_ComMtrCom "Bit encoding / Ok-Tested Since Clear bit for check DFC_ComMtrCom" UBYTE DFC_OneToOne 1 100 0.00 1.000 BIT_MASK 0x20 FORMAT "%5.3" ECU_ADDRESS 0x60034AA1 /end MEASUREMENT
/begin MEASUREMENT DFC_b.TSC_ComPCUChkSum "Bit encoding / Ok-Tested Since Clear bit for check DFC_ComPCUChkSum" UBYTE DFC_OneToOne 1 100 0.00 1.000 BIT_MASK 0x20 FORMAT "%5.3" ECU_ADDRESS 0x60034AA2 /end MEASUREMENT
/begin MEASUREMENT DFC_b.TSC_ComPCURingCnt "Bit encoding / Ok-Tested Since Clear bit for check DFC_ComPCURingCnt" UBYTE DFC_OneToOne 1 100 0.00 1.000 BIT_MASK 0x20 FORMAT "%5.3" ECU_ADDRESS 0x60034AA3 /end MEASUREMENT
/begin MEASUREMENT DFC_b.TSC_ComPCUTOut "Bit encoding / Ok-Tested Since Clear bit for check DFC_ComPCUTOut" UBYTE DFC_OneToOne 1 100 0.00 1.000 BIT_MASK 0x20 FORMAT "%5.3" ECU_ADDRESS 0x60034AA4 /end MEASUREMENT
/begin MEASUREMENT DFC_b.TSC_ComSRSAChksum "Bit encoding / Ok-Tested Since Clear bit for check DFC_ComSRSAChksum" UBYTE DFC_OneToOne 1 100 0.00 1.000 BIT_MASK 0x20 FORMAT "%5.3" ECU_ADDRESS 0x60034AA5 /end MEASUREMENT
/begin MEASUREMENT DFC_b.TSC_ComSRSARingCnt "Bit encoding / Ok-Tested Since Clear bit for check DFC_ComSRSARingCnt" UBYTE DFC_OneToOne 1 100 0.00 1.000 BIT_MASK 0x20 FORMAT "%5.3" ECU_ADDRESS 0x60034AA6 /end MEASUREMENT
/begin MEASUREMENT DFC_b.TSC_ComSRSATOut "Bit encoding / Ok-Tested Since Clear bit for check DFC_ComSRSATOut" UBYTE DFC_OneToOne 1 100 0.00 1.000 BIT_MASK 0x20 FORMAT "%5.3" ECU_ADDRESS 0x60034AA7 /end MEASUREMENT
/begin MEASUREMENT DFC_b.TSC_ComSRSBChksum "Bit encoding / Ok-Tested Since Clear bit for check DFC_ComSRSBChksum" UBYTE DFC_OneToOne 1 100 0.00 1.000 BIT_MASK 0x20 FORMAT "%5.3" ECU_ADDRESS 0x60034AA8 /end MEASUREMENT
/begin MEASUREMENT DFC_b.TSC_ComSRSBRingCnt "Bit encoding / Ok-Tested Since Clear bit for check DFC_ComSRSBRingCnt" UBYTE DFC_OneToOne 1 100 0.00 1.000 BIT_MASK 0x20 FORMAT "%5.3" ECU_ADDRESS 0x60034AA9 /end MEASUREMENT
/begin MEASUREMENT DFC_b.TSC_ComSRSBTOut "Bit encoding / Ok-Tested Since Clear bit for check DFC_ComSRSBTOut" UBYTE DFC_OneToOne 1 100 0.00 1.000 BIT_MASK 0x20 FORMAT "%5.3" ECU_ADDRESS 0x60034AAA /end MEASUREMENT
/begin MEASUREMENT DFC_b.TSC_ComSRSChksum "Bit encoding / Ok-Tested Since Clear bit for check DFC_ComSRSChksum" UBYTE DFC_OneToOne 1 100 0.00 1.000 BIT_MASK 0x20 FORMAT "%5.3" ECU_ADDRESS 0x60034AAB /end MEASUREMENT
/begin MEASUREMENT DFC_b.TSC_ComSRSErr "Bit encoding / Ok-Tested Since Clear bit for check DFC_ComSRSErr" UBYTE DFC_OneToOne 1 100 0.00 1.000 BIT_MASK 0x20 FORMAT "%5.3" ECU_ADDRESS 0x60034AAC /end MEASUREMENT
/begin MEASUREMENT DFC_b.TSC_ComSRSRingCnt "Bit encoding / Ok-Tested Since Clear bit for check DFC_ComSRSRingCnt" UBYTE DFC_OneToOne 1 100 0.00 1.000 BIT_MASK 0x20 FORMAT "%5.3" ECU_ADDRESS 0x60034AAD /end MEASUREMENT
/begin MEASUREMENT DFC_b.TSC_ComSRSTOut "Bit encoding / Ok-Tested Since Clear bit for check DFC_ComSRSTOut" UBYTE DFC_OneToOne 1 100 0.00 1.000 BIT_MASK 0x20 FORMAT "%5.3" ECU_ADDRESS 0x60034AAE /end MEASUREMENT
/begin MEASUREMENT DFC_b.TSC_ComVehSpdPndFltTCU "Bit encoding / Ok-Tested Since Clear bit for check DFC_ComVehSpdPndFltTCU" UBYTE DFC_OneToOne 1 100 0.00 1.000 BIT_MASK 0x20 FORMAT "%5.3" ECU_ADDRESS 0x60034AAF /end MEASUREMENT
/begin MEASUREMENT DFC_b.TSC_EbsChartcCurrErr "Bit encoding / Ok-Tested Since Clear bit for check DFC_EbsChartcCurrErr" UBYTE DFC_OneToOne 1 100 0.00 1.000 BIT_MASK 0x20 FORMAT "%5.3" ECU_ADDRESS 0x60034AB0 /end MEASUREMENT
/begin MEASUREMENT DFC_b.TSC_EbsSelfDiagErr "Bit encoding / Ok-Tested Since Clear bit for check DFC_EbsSelfDiagErr" UBYTE DFC_OneToOne 1 100 0.00 1.000 BIT_MASK 0x20 FORMAT "%5.3" ECU_ADDRESS 0x60034AB1 /end MEASUREMENT
/begin MEASUREMENT DFC_b.TSC_GbxCANDigPlausErr "Bit encoding / Ok-Tested Since Clear bit for check DFC_GbxCANDigPlausErr" UBYTE DFC_OneToOne 1 100 0.00 1.000 BIT_MASK 0x20 FORMAT "%5.3" ECU_ADDRESS 0x60034AB2 /end MEASUREMENT
/begin MEASUREMENT DFC_b.TSC_GbxNPos1SRCMax "Bit encoding / Ok-Tested Since Clear bit for check DFC_GbxNPos1SRCMax" UBYTE DFC_OneToOne 1 100 0.00 1.000 BIT_MASK 0x20 FORMAT "%5.3" ECU_ADDRESS 0x60034AB3 /end MEASUREMENT
/begin MEASUREMENT DFC_b.TSC_GbxNPos1SRCMin "Bit encoding / Ok-Tested Since Clear bit for check DFC_GbxNPos1SRCMin" UBYTE DFC_OneToOne 1 100 0.00 1.000 BIT_MASK 0x20 FORMAT "%5.3" ECU_ADDRESS 0x60034AB4 /end MEASUREMENT
/begin MEASUREMENT DFC_b.TSC_GbxNPos2SRCMax "Bit encoding / Ok-Tested Since Clear bit for check DFC_GbxNPos2SRCMax" UBYTE DFC_OneToOne 1 100 0.00 1.000 BIT_MASK 0x20 FORMAT "%5.3" ECU_ADDRESS 0x60034AB5 /end MEASUREMENT
/begin MEASUREMENT DFC_b.TSC_GbxNPos2SRCMin "Bit encoding / Ok-Tested Since Clear bit for check DFC_GbxNPos2SRCMin" UBYTE DFC_OneToOne 1 100 0.00 1.000 BIT_MASK 0x20 FORMAT "%5.3" ECU_ADDRESS 0x60034AB6 /end MEASUREMENT
/begin MEASUREMENT DFC_b.TSC_GbxNPosAlvChk "Bit encoding / Ok-Tested Since Clear bit for check DFC_GbxNPosAlvChk" UBYTE DFC_OneToOne 1 100 0.00 1.000 BIT_MASK 0x20 FORMAT "%5.3" ECU_ADDRESS 0x60034AB7 /end MEASUREMENT
/begin MEASUREMENT DFC_b.TSC_GbxNPosSyncErr "Bit encoding / Ok-Tested Since Clear bit for check DFC_GbxNPosSyncErr" UBYTE DFC_OneToOne 1 100 0.00 1.000 BIT_MASK 0x20 FORMAT "%5.3" ECU_ADDRESS 0x60034AB8 /end MEASUREMENT
/begin MEASUREMENT DFC_b.TSC_HEGOS2B1HtrPsMax "Bit encoding / Ok-Tested Since Clear bit for check DFC_HEGOS2B1HtrPsMax" UBYTE DFC_OneToOne 1 100 0.00 1.000 BIT_MASK 0x20 FORMAT "%5.3" ECU_ADDRESS 0x60034AB9 /end MEASUREMENT
/begin MEASUREMENT DFC_b.TSC_HEGOS2B1HtrPsMin "Bit encoding / Ok-Tested Since Clear bit for check DFC_HEGOS2B1HtrPsMin" UBYTE DFC_OneToOne 1 100 0.00 1.000 BIT_MASK 0x20 FORMAT "%5.3" ECU_ADDRESS 0x60034ABA /end MEASUREMENT
/begin MEASUREMENT DFC_b.TSC_HEGOS2B1HtrPsSig "Bit encoding / Ok-Tested Since Clear bit for check DFC_HEGOS2B1HtrPsSig" UBYTE DFC_OneToOne 1 100 0.00 1.000 BIT_MASK 0x20 FORMAT "%5.3" ECU_ADDRESS 0x60034ABB /end MEASUREMENT
/begin MEASUREMENT DFC_b.TSC_LinCSErrACG "Bit encoding / Ok-Tested Since Clear bit for check DFC_LinCSErrACG" UBYTE DFC_OneToOne 1 100 0.00 1.000 BIT_MASK 0x20 FORMAT "%5.3" ECU_ADDRESS 0x60034ABC /end MEASUREMENT
/begin MEASUREMENT DFC_b.TSC_LinCSErrEBS "Bit encoding / Ok-Tested Since Clear bit for check DFC_LinCSErrEBS" UBYTE DFC_OneToOne 1 100 0.00 1.000 BIT_MASK 0x20 FORMAT "%5.3" ECU_ADDRESS 0x60034ABD /end MEASUREMENT
/begin MEASUREMENT DFC_b.TSC_LinHdrTimeoutErrACG "Bit encoding / Ok-Tested Since Clear bit for check DFC_LinHdrTimeoutErrACG" UBYTE DFC_OneToOne 1 100 0.00 1.000 BIT_MASK 0x20 FORMAT "%5.3" ECU_ADDRESS 0x60034ABE /end MEASUREMENT
/begin MEASUREMENT DFC_b.TSC_LinHdrTimeoutErrEBS "Bit encoding / Ok-Tested Since Clear bit for check DFC_LinHdrTimeoutErrEBS" UBYTE DFC_OneToOne 1 100 0.00 1.000 BIT_MASK 0x20 FORMAT "%5.3" ECU_ADDRESS 0x60034ABF /end MEASUREMENT
/begin MEASUREMENT DFC_b.TSC_LinMsgTimeoutErrACG "Bit encoding / Ok-Tested Since Clear bit for check DFC_LinMsgTimeoutErrACG" UBYTE DFC_OneToOne 1 100 0.00 1.000 BIT_MASK 0x20 FORMAT "%5.3" ECU_ADDRESS 0x60034AC0 /end MEASUREMENT
/begin MEASUREMENT DFC_b.TSC_LinMsgTimeoutErrEBS "Bit encoding / Ok-Tested Since Clear bit for check DFC_LinMsgTimeoutErrEBS" UBYTE DFC_OneToOne 1 100 0.00 1.000 BIT_MASK 0x20 FORMAT "%5.3" ECU_ADDRESS 0x60034AC1 /end MEASUREMENT
/begin MEASUREMENT DFC_b.TSC_LinNoStrtComErr "Bit encoding / Ok-Tested Since Clear bit for check DFC_LinNoStrtComErr" UBYTE DFC_OneToOne 1 100 0.00 1.000 BIT_MASK 0x20 FORMAT "%5.3" ECU_ADDRESS 0x60034AC2 /end MEASUREMENT
/begin MEASUREMENT DFC_b.TSC_MisfDetVWhlFrntLeOORHi "Bit encoding / Ok-Tested Since Clear bit for check DFC_MisfDetVWhlFrntLeOORHi" UBYTE DFC_OneToOne 1 100 0.00 1.000 BIT_MASK 0x20 FORMAT "%5.3" ECU_ADDRESS 0x60034AC3 /end MEASUREMENT
/begin MEASUREMENT DFC_b.TSC_MisfDetVWhlFrntLeRatyHi "Bit encoding / Ok-Tested Since Clear bit for check DFC_MisfDetVWhlFrntLeRatyHi" UBYTE DFC_OneToOne 1 100 0.00 1.000 BIT_MASK 0x20 FORMAT "%5.3" ECU_ADDRESS 0x60034AC4 /end MEASUREMENT
/begin MEASUREMENT DFC_b.TSC_MisfDetVWhlFrntLeRatyLo "Bit encoding / Ok-Tested Since Clear bit for check DFC_MisfDetVWhlFrntLeRatyLo" UBYTE DFC_OneToOne 1 100 0.00 1.000 BIT_MASK 0x20 FORMAT "%5.3" ECU_ADDRESS 0x60034AC5 /end MEASUREMENT
/begin MEASUREMENT DFC_b.TSC_MisfDetVWhlFrntLeStuck "Bit encoding / Ok-Tested Since Clear bit for check DFC_MisfDetVWhlFrntLeStuck" UBYTE DFC_OneToOne 1 100 0.00 1.000 BIT_MASK 0x20 FORMAT "%5.3" ECU_ADDRESS 0x60034AC6 /end MEASUREMENT
/begin MEASUREMENT DFC_b.TSC_MisfDetVWhlFrntRiOORHi "Bit encoding / Ok-Tested Since Clear bit for check DFC_MisfDetVWhlFrntRiOORHi" UBYTE DFC_OneToOne 1 100 0.00 1.000 BIT_MASK 0x20 FORMAT "%5.3" ECU_ADDRESS 0x60034AC7 /end MEASUREMENT
/begin MEASUREMENT DFC_b.TSC_MisfDetVWhlFrntRiRatyHi "Bit encoding / Ok-Tested Since Clear bit for check DFC_MisfDetVWhlFrntRiRatyHi" UBYTE DFC_OneToOne 1 100 0.00 1.000 BIT_MASK 0x20 FORMAT "%5.3" ECU_ADDRESS 0x60034AC8 /end MEASUREMENT
/begin MEASUREMENT DFC_b.TSC_MisfDetVWhlFrntRiRatyLo "Bit encoding / Ok-Tested Since Clear bit for check DFC_MisfDetVWhlFrntRiRatyLo" UBYTE DFC_OneToOne 1 100 0.00 1.000 BIT_MASK 0x20 FORMAT "%5.3" ECU_ADDRESS 0x60034AC9 /end MEASUREMENT
/begin MEASUREMENT DFC_b.TSC_MisfDetVWhlFrntRiStuck "Bit encoding / Ok-Tested Since Clear bit for check DFC_MisfDetVWhlFrntRiStuck" UBYTE DFC_OneToOne 1 100 0.00 1.000 BIT_MASK 0x20 FORMAT "%5.3" ECU_ADDRESS 0x60034ACA /end MEASUREMENT
/begin MEASUREMENT DFC_b.TSC_MisfDetVWhlReLeOORHi "Bit encoding / Ok-Tested Since Clear bit for check DFC_MisfDetVWhlReLeOORHi" UBYTE DFC_OneToOne 1 100 0.00 1.000 BIT_MASK 0x20 FORMAT "%5.3" ECU_ADDRESS 0x60034ACB /end MEASUREMENT
/begin MEASUREMENT DFC_b.TSC_MisfDetVWhlReLeRatyHi "Bit encoding / Ok-Tested Since Clear bit for check DFC_MisfDetVWhlReLeRatyHi" UBYTE DFC_OneToOne 1 100 0.00 1.000 BIT_MASK 0x20 FORMAT "%5.3" ECU_ADDRESS 0x60034ACC /end MEASUREMENT
/begin MEASUREMENT DFC_b.TSC_MisfDetVWhlReLeRatyLo "Bit encoding / Ok-Tested Since Clear bit for check DFC_MisfDetVWhlReLeRatyLo" UBYTE DFC_OneToOne 1 100 0.00 1.000 BIT_MASK 0x20 FORMAT "%5.3" ECU_ADDRESS 0x60034ACD /end MEASUREMENT
/begin MEASUREMENT DFC_b.TSC_MisfDetVWhlReLeStuck "Bit encoding / Ok-Tested Since Clear bit for check DFC_MisfDetVWhlReLeStuck" UBYTE DFC_OneToOne 1 100 0.00 1.000 BIT_MASK 0x20 FORMAT "%5.3" ECU_ADDRESS 0x60034ACE /end MEASUREMENT
/begin MEASUREMENT DFC_b.TSC_MisfDetVWhlReRiOORHi "Bit encoding / Ok-Tested Since Clear bit for check DFC_MisfDetVWhlReRiOORHi" UBYTE DFC_OneToOne 1 100 0.00 1.000 BIT_MASK 0x20 FORMAT "%5.3" ECU_ADDRESS 0x60034ACF /end MEASUREMENT
/begin MEASUREMENT DFC_b.TSC_MisfDetVWhlReRiRatyHi "Bit encoding / Ok-Tested Since Clear bit for check DFC_MisfDetVWhlReRiRatyHi" UBYTE DFC_OneToOne 1 100 0.00 1.000 BIT_MASK 0x20 FORMAT "%5.3" ECU_ADDRESS 0x60034AD0 /end MEASUREMENT
/begin MEASUREMENT DFC_b.TSC_MisfDetVWhlReRiRatyLo "Bit encoding / Ok-Tested Since Clear bit for check DFC_MisfDetVWhlReRiRatyLo" UBYTE DFC_OneToOne 1 100 0.00 1.000 BIT_MASK 0x20 FORMAT "%5.3" ECU_ADDRESS 0x60034AD1 /end MEASUREMENT
/begin MEASUREMENT DFC_b.TSC_MisfDetVWhlReRiStuck "Bit encoding / Ok-Tested Since Clear bit for check DFC_MisfDetVWhlReRiStuck" UBYTE DFC_OneToOne 1 100 0.00 1.000 BIT_MASK 0x20 FORMAT "%5.3" ECU_ADDRESS 0x60034AD2 /end MEASUREMENT
/begin MEASUREMENT DFC_b.TSC_MisfDetdVWhlFrntLePlaus "Bit encoding / Ok-Tested Since Clear bit for check DFC_MisfDetdVWhlFrntLePlaus" UBYTE DFC_OneToOne 1 100 0.00 1.000 BIT_MASK 0x20 FORMAT "%5.3" ECU_ADDRESS 0x60034AD3 /end MEASUREMENT
/begin MEASUREMENT DFC_b.TSC_MisfDetdVWhlFrntRiPlaus "Bit encoding / Ok-Tested Since Clear bit for check DFC_MisfDetdVWhlFrntRiPlaus" UBYTE DFC_OneToOne 1 100 0.00 1.000 BIT_MASK 0x20 FORMAT "%5.3" ECU_ADDRESS 0x60034AD4 /end MEASUREMENT
/begin MEASUREMENT DFC_b.TSC_MisfDetdVWhlReLePlaus "Bit encoding / Ok-Tested Since Clear bit for check DFC_MisfDetdVWhlReLePlaus" UBYTE DFC_OneToOne 1 100 0.00 1.000 BIT_MASK 0x20 FORMAT "%5.3" ECU_ADDRESS 0x60034AD5 /end MEASUREMENT
/begin MEASUREMENT DFC_b.TSC_MisfDetdVWhlReRiPlaus "Bit encoding / Ok-Tested Since Clear bit for check DFC_MisfDetdVWhlReRiPlaus" UBYTE DFC_OneToOne 1 100 0.00 1.000 BIT_MASK 0x20 FORMAT "%5.3" ECU_ADDRESS 0x60034AD6 /end MEASUREMENT
/begin MEASUREMENT DFC_b.TSC_PEnvSigRngMax "Bit encoding / Ok-Tested Since Clear bit for check DFC_PEnvSigRngMax" UBYTE DFC_OneToOne 1 100 0.00 1.000 BIT_MASK 0x20 FORMAT "%5.3" ECU_ADDRESS 0x60034AD7 /end MEASUREMENT
/begin FUNCTION DFC "30000.33.0Diagnostic Fault Check"
 /begin OUT_MEASUREMENT DFC_b.LDF_ComIDASBRingCnt DFC_b.LDF_ComIDASBTOut DFC_b.LDF_ComIMGMILReq DFC_b.LDF_ComISSPrms DFC_b.LDF_ComMETAChksum DFC_b.LDF_ComMETARingCnt DFC_b.LDF_ComMETATOut DFC_b.LDF_ComMETCChksum DFC_b.LDF_ComMETCRingCnt DFC_b.LDF_ComMETCTOut DFC_b.LDF_ComMETDChksum DFC_b.LDF_ComMETDRingCnt DFC_b.LDF_ComMETDTOut DFC_b.LDF_ComMETE2Chksum DFC_b.LDF_ComMETE2RingCnt DFC_b.LDF_ComMETE2TOut DFC_b.LDF_ComMETFChksum DFC_b.LDF_ComMETFRingCnt DFC_b.LDF_ComMETFTOut DFC_b.LDF_ComMETGChksum DFC_b.LDF_ComMETGRingCnt DFC_b.LDF_ComMETGTOut DFC_b.LDF_ComMETH2Chksum DFC_b.LDF_ComMETH2RingCnt DFC_b.LDF_ComMETH2TOut DFC_b.LDF_ComMETHChksum DFC_b.LDF_ComMETHRingCnt DFC_b.LDF_ComMETHTOut DFC_b.LDF_ComMETIChksum DFC_b.LDF_ComMETIRingCnt DFC_b.LDF_ComMETITOut DFC_b.LDF_ComMETKChksum DFC_b.LDF_ComMETKRingCnt DFC_b.LDF_ComMETKTOut DFC_b.LDF_ComMETLChksum DFC_b.LDF_ComMETLRingCnt DFC_b.LDF_ComMETLTOut DFC_b.LDF_ComMETMChksum DFC_b.LDF_ComMETMRingCnt DFC_b.LDF_ComMETMTOut DFC_b.LDF_ComMETNChksum DFC_b.LDF_ComMETNRingCnt DFC_b.LDF_ComMETNTOut DFC_b.LDF_ComMtrCom DFC_b.LDF_ComPCUChkSum DFC_b.LDF_ComPCURingCnt DFC_b.LDF_ComPCUTOut DFC_b.LDF_ComSRSAChksum DFC_b.LDF_ComSRSARingCnt DFC_b.LDF_ComSRSATOut DFC_b.LDF_ComSRSBChksum DFC_b.LDF_ComSRSBRingCnt DFC_b.LDF_ComSRSBTOut DFC_b.LDF_ComSRSChksum DFC_b.LDF_ComSRSErr DFC_b.LDF_ComSRSRingCnt DFC_b.LDF_ComSRSTOut DFC_b.LDF_ComVehSpdPndFltTCU DFC_b.LDF_EbsChartcCurrErr DFC_b.LDF_EbsSelfDiagErr DFC_b.LDF_GbxCANDigPlausErr DFC_b.LDF_GbxNPos1SRCMax DFC_b.LDF_GbxNPos1SRCMin DFC_b.LDF_GbxNPos2SRCMax DFC_b.LDF_GbxNPos2SRCMin DFC_b.LDF_GbxNPosAlvChk DFC_b.LDF_GbxNPosSyncErr DFC_b.LDF_HEGOS2B1HtrPsMax DFC_b.LDF_HEGOS2B1HtrPsMin DFC_b.LDF_HEGOS2B1HtrPsSig DFC_b.LDF_LinCSErrACG DFC_b.LDF_LinCSErrEBS DFC_b.LDF_LinHdrTimeoutErrACG DFC_b.LDF_LinHdrTimeoutErrEBS DFC_b.LDF_LinMsgTimeoutErrACG DFC_b.LDF_LinMsgTimeoutErrEBS DFC_b.LDF_LinNoStrtComErr DFC_b.LDF_MisfDetVWhlFrntLeOORHi DFC_b.LDF_MisfDetVWhlFrntLeRatyHi DFC_b.LDF_MisfDetVWhlFrntLeRatyLo DFC_b.LDF_MisfDetVWhlFrntLeStuck DFC_b.LDF_MisfDetVWhlFrntRiOORHi DFC_b.LDF_MisfDetVWhlFrntRiRatyHi DFC_b.LDF_MisfDetVWhlFrntRiRatyLo DFC_b.LDF_MisfDetVWhlFrntRiStuck DFC_b.LDF_MisfDetVWhlReLeOORHi DFC_b.LDF_MisfDetVWhlReLeRatyHi DFC_b.LDF_MisfDetVWhlReLeRatyLo DFC_b.LDF_MisfDetVWhlReLeStuck DFC_b.LDF_MisfDetVWhlReRiOORHi DFC_b.LDF_MisfDetVWhlReRiRatyHi DFC_b.LDF_MisfDetVWhlReRiRatyLo DFC_b.LDF_MisfDetVWhlReRiStuck DFC_b.LDF_MisfDetdVWhlFrntLePlaus DFC_b.LDF_MisfDetdVWhlFrntRiPlaus DFC_b.LDF_MisfDetdVWhlReLePlaus DFC_b.LDF_MisfDetdVWhlReRiPlaus DFC_b.LDF_PEnvSigRngMax DFC_b.LDF_PEnvSigRngMin DFC_b.LDF_StmFault DFC_b.LDF_StrtCtOffPth DFC_b.LDF_StrtCtlErr DFC_b.LDF_StrtFault DFC_b.LDF_StrtLckJudg1 DFC_b.LDF_StrtLckJudg2 DFC_b.LDF_StrtOL DFC_b.LDF_StrtOL2 DFC_b.LDF_StrtSCB DFC_b.LDF_StrtSCB2 DFC_b.LDF_StrtSCG DFC_b.LDF_StrtSCG2 DFC_b.LDF_StrtStkRly1 DFC_b.LDF_StrtStkRly2 DFC_b.LDF_TEVEmax DFC_b.LDF_TEVEmin DFC_b.LDF_TEVEsig DFC_b.LDF_VehVAllPlaus DFC_b.LDF_VehVNCSnsrElecFailr DFC_b.LDF_VehVPlausCan DFC_b.LDF_VehVPlausFco DFC_b.LDF_VehVPlausPwr DFC_b.LDF_VehVPlausV2N DFC_b.LDF_VehVSpdSnsrAElecFailr DFC_b.LDF_VehVSpdSnsrBElecFailr DFC_b.LDF_ClthMax DFC_b.LDF_IgnClPs_DevComErr DFC_b.LDF_IgnClPs_LineOl_0 DFC_b.LDF_IgnClPs_LineOl_1 DFC_b.LDF_IgnClPs_LineOl_2 DFC_b.LDF_IgnClPs_LineOl_3 DFC_b.LDF_IgnClPs_LineScb_0 DFC_b.LDF_IgnClPs_LineScb_1 DFC_b.LDF_IgnClPs_LineScb_2 DFC_b.LDF_IgnClPs_LineScb_3 DFC_b.LDF_IgnClPs_LineScg_0 DFC_b.LDF_IgnClPs_LineScg_1 DFC_b.LDF_IgnClPs_LineScg_2 DFC_b.LDF_IgnClPs_LineScg_3 DFC_b.LDF_UEGOASICS1B1 DFC_b.LDF_UEGOOLIPES1B1 DFC_b.LDF_UEGOOLRES1B1 DFC_b.LDF_UEGOSCBS1B1 DFC_b.LDF_UEGOSCGS1B1 DFC_b.LDF_UEGOSPIS1B1 DFC_b.LDF_UEGOSnsrS1B1 DFC_b.LDF_UegoOlApesS1B1 DFC_b.LDF_UegoOlRCmpS1B1 DFC_b.LDF_AirCCmprOL DFC_b.LDF_AirCCmprOvrTemp DFC_b.LDF_AirCCmprSCB DFC_b.LDF_AirCCmprSCG DFC_b.LDF_AltErr DFC_b.LDF_BattUSRCMax DFC_b.LDF_BattUSRCMin DFC_b.LDF_ComChksTCU1 DFC_b.LDF_ComChksTCU11 DFC_b.LDF_ComChksTCU12 DFC_b.LDF_ComChksTCU13 DFC_b.LDF_ComChksTCU2 DFC_b.LDF_ComChksTCU3 DFC_b.LDF_ComChksTCU4 DFC_b.LDF_ComCntTCU1 DFC_b.LDF_ComCntTCU11 DFC_b.LDF_ComCntTCU12 DFC_b.LDF_ComCntTCU13 DFC_b.LDF_ComCntTCU2 DFC_b.LDF_ComCntTCU3 DFC_b.LDF_ComCntTCU4 DFC_b.LDF_ComTOutTCU01 DFC_b.LDF_ComTOutTCU02 DFC_b.LDF_ComTOutTCU1 DFC_b.LDF_ComTOutTCU11 DFC_b.LDF_ComTOutTCU12 DFC_b.LDF_ComTOutTCU13 DFC_b.LDF_ComTOutTCU14 DFC_b.LDF_ComTOutTCU2 DFC_b.LDF_ComTOutTCU3 DFC_b.LDF_ComTOutTCU4 DFC_b.LDF_DevLibBattUHi DFC_b.LDF_DevLibBattULo DFC_b.LDF_FanDIOOL_0 DFC_b.LDF_FanDIOOL_1 DFC_b.LDF_FanDIOOvrTemp_0 DFC_b.LDF_FanDIOOvrTemp_1 DFC_b.LDF_FanDIOSCB_0 DFC_b.LDF_FanDIOSCB_1 DFC_b.LDF_FanDIOSCG_0 DFC_b.LDF_FanDIOSCG_1 DFC_b.LDF_MRlyDcOL DFC_b.LDF_MRlyDcSCB DFC_b.LDF_MRlyDcSCG DFC_b.LDF_PSPOL DFC_b.LDF_PSPOvrTemp DFC_b.LDF_PSPSCB DFC_b.LDF_PSPSCG DFC_b.LDF_T50Err DFC_b.LDF_ThrVlvLoBattB1 DFC_b.LDF_VehVPhysRngHi DFC_b.LDF_VehVSclOutOL DFC_b.LDF_VehVSclOutOT DFC_b.LDF_VehVSclOutSCB DFC_b.LDF_VehVSclOutSCG DFC_b.LDF_VehVSnsrARngHi DFC_b.LDF_VehVSnsrBRngHi DFC_b.LDF_VehVSpdRtyDiag DFC_b.LDF_VehVWhlErr DFC_b.LDF_ACEvpTSRCMax DFC_b.LDF_ACEvpTSRCMin DFC_b.LDF_AirCClntPAnaSRCMax DFC_b.LDF_AirCClntPAnaSRCMin DFC_b.LDF_AirCSwtNpl DFC_b.LDF_AirCSwtSig DFC_b.LDF_Brk DFC_b.LDF_BrkSig DFC_b.LDF_ClthSig DFC_b.LDF_HLSDemOvhtEngLim DFC_b.LDF_OilPNpl DFC_b.LDF_PIntkVUsLineHiB1 DFC_b.LDF_PIntkVUsLineLoB1 DFC_b.LDF_VehVPhysRngLo DFC_b.LDF_VehVSigCan DFC_b.LDF_VehVSigCanSafe DFC_b.LDF_VlvLftFbOilPSnsrIntk11SRCMax DFC_b.LDF_VlvLftFbOilPSnsrIntk11SRCMin DFC_b.LDF_ClthNpl DFC_b.LDF_EV1max DFC_b.LDF_EV1min DFC_b.LDF_EV1sig DFC_b.LDF_EV2max DFC_b.LDF_EV2min DFC_b.LDF_EV2sig DFC_b.LDF_EV3max DFC_b.LDF_EV3min DFC_b.LDF_EV3sig DFC_b.LDF_EV4max DFC_b.LDF_EV4min DFC_b.LDF_EV4sig DFC_b.LDF_GbxPNPosnDrvCdn DFC_b.LDF_GbxPNPosnPlausy DFC_b.LDF_PEnvCcMax DFC_b.LDF_PEnvCcMin DFC_b.LDF_PEnvRngChkMax DFC_b.LDF_PEnvRngChkMin DFC_b.LDF_PEnvSnsrPlaus DFC_b.LDF_UEGOHeatrPsS1B1Max DFC_b.LDF_UEGOHeatrPsS1B1Min DFC_b.LDF_UEGOHeatrPsS1B1Sig DFC_b.LDF_UEGOHeatrRlyPsOLS1B1 DFC_b.LDF_UEGOHeatrRlyPsSCBS1B1 DFC_b.LDF_UEGOHeatrRlyPsSCGS1B1 DFC_b.LDF_KnDetSens1PortAMax DFC_b.LDF_KnDetSens1PortAMin DFC_b.LDF_KnDetSens1PortBMax DFC_b.LDF_KnDetSens1PortBMin DFC_b.LDF_Clth2ONStuck DFC_b.LDF_Clth2ONStuckLdc DFC_b.LDF_Clth3ONStuckLdc DFC_b.LDF_Clth3ONStuckPostDrv DFC_b.LDF_Clth4ONStuck DFC_b.LDF_Clth4ONStuckLdc DFC_b.LDF_ComDLCTCU01 DFC_b.LDF_ComDLCTCU02 DFC_b.LDF_ComDLCTCU1 DFC_b.LDF_ComDLCTCU11 DFC_b.LDF_ComDLCTCU12 DFC_b.LDF_ComDLCTCU13 DFC_b.LDF_ComDLCTCU14 DFC_b.LDF_ComDLCTCU2 DFC_b.LDF_ComDLCTCU3 DFC_b.LDF_ComDLCTCU4 DFC_b.LDF_EVX DFC_b.LDF_EbsSocFlt DFC_b.LDF_I14229VINErr DFC_b.LDF_LLRKHmax DFC_b.LDF_LLRKHmin DFC_b.LDF_LLRmax DFC_b.LDF_LLRmin DFC_b.LDF_RoughRoad DFC_b.LDF_SiaEEPRdErr DFC_b.LDF_SiaEEPWrngCod DFC_b.LDF_UegoDummy DFC_b.LDF_BusDiagCANAPPLBusOff DFC_b.LDF_BusDiagCANCANCBusOff DFC_b.LDF_BusDiagCANVEHICLEBusOff DFC_b.LDF_RBA_IODIAGPWR_rba_IoExtCy329_SignalVltSply_0 DFC_b.LDF_RBA_IODIAGPWR_rba_IoExtCy329_SignalVltSply_0OT DFC_b.LDF_RBA_IODIAGPWR_rba_IoExtCy329_SignalVltSply_0OV DFC_b.LDF_RBA_IODIAGPWR_rba_IoExtCy329_SignalVltSply_0SCG DFC_b.LDF_RBA_IODIAGPWR_rba_IoExtCy329_SignalVltSply_0UV DFC_b.LDF_RBA_IODIAGPWR_rba_IoExtCy329_SignalVltSply_1 DFC_b.LDF_RBA_IODIAGPWR_rba_IoExtCy329_SignalVltSply_1OT DFC_b.LDF_RBA_IODIAGPWR_rba_IoExtCy329_SignalVltSply_1OV DFC_b.LDF_RBA_IODIAGPWR_rba_IoExtCy329_SignalVltSply_1SCG DFC_b.LDF_RBA_IODIAGPWR_rba_IoExtCy329_SignalVltSply_1UV DFC_b.LDF_RBA_IODIAGPWR_rba_IoExtCy329_SignalVltSply_2 DFC_b.LDF_RBA_IODIAGPWR_rba_IoExtCy329_SignalVltSply_2OT DFC_b.LDF_RBA_IODIAGPWR_rba_IoExtCy329_SignalVltSply_2OV DFC_b.LDF_RBA_IODIAGPWR_rba_IoExtCy329_SignalVltSply_2SCG DFC_b.LDF_RBA_IODIAGPWR_rba_IoExtCy329_SignalVltSply_2UV DFC_b.LDF_CAN_E_TIMEOUT DFC_b.LDF_LIN_E_TIMEOUT DFC_b.LDF_MRlyOL DFC_b.LDF_MRlySCB DFC_b.LDF_MRlySCG DFC_b.LDF_rba_MultiStackTrace_Threshold DFC_b.LDF_BSWM_E_ACTION_FAILED DFC_b.LDF_BSWM_E_INTRPTQUEUE_FULL DFC_b.LDF_RBA_IOEXTLIB_KEEPALIVE_DRV DFC_b.LDF_RBA_IOEXTLIB_KEEPALIVE_INI DFC_b.LDF_rba_IoSigRtc_StopCounter DFC_b.LDF_rba_MRly_Diag_Stk_Event DFC_b.LDF_rba_MemDiag_MemReadErr DFC_b.LDF_rba_MemDiag_MemWrErr DFC_b.LDF_rba_SyC_IrrSwOffTrigEngRun_Event DFC_b.LDF_rba_T15_Diag_ComInVld_Event DFC_b.LDF_rba_T15_Diag_ComOff_HwOn_Event DFC_b.LDF_rba_T15_Diag_ComOn_HwOff_Event DFC_b.LDF_AppAllSnsrDfct DFC_b.LDF_BattUStdbyDiaOL DFC_b.LDF_BigLeakIntkMnfldEmiInfl DFC_b.LDF_BrkMnSwtContOnWarnLmp DFC_b.LDF_BrkMnSwtNotStpWarnLmp DFC_b.LDF_BrkRdntSwtContOnWarnLmp DFC_b.LDF_BrkRdntSwtNotStpWarnLmp DFC_b.LDF_CEngDsTColdStrtMax DFC_b.LDF_CEngDsTColdStrtMin DFC_b.LDF_CEngDsTImps DFC_b.LDF_CEngDsTPlausLSC DFC_b.LDF_CEngDsTPlausSTC DFC_b.LDF_CEngDsTSRCMax DFC_b.LDF_CEngDsTSRCMin DFC_b.LDF_CEngDsTSig DFC_b.LDF_CEngUsTSRCMax DFC_b.LDF_CEngUsTSRCMin DFC_b.LDF_DCDCFltDet DFC_b.LDF_DKRSA DFC_b.LDF_DKVSmax DFC_b.LDF_DKnpl DFC_b.LDF_DSSmax DFC_b.LDF_DSTTI DFC_b.LDF_DSUmax DFC_b.LDF_EGRVlvOL DFC_b.LDF_EGRVlvSCB DFC_b.LDF_EGRVlvSCG DFC_b.LDF_EGSDUS2B1LtrDly DFC_b.LDF_EGSDUS2B1LtrPT1 DFC_b.LDF_EGSDUS2B1RtlDly DFC_b.LDF_EGSDUS2B1RtlPT1 DFC_b.LDF_EGSDUS2B1TarLean DFC_b.LDF_EGSDUS2B1TarRich DFC_b.LDF_ETAKHLmax DFC_b.LDF_ETAKHTmax DFC_b.LDF_EngICO DFC_b.LDF_EngPrtOvrSpdMon DFC_b.LDF_EpmCaSI1ErrSig DFC_b.LDF_EpmCaSI1NoSig DFC_b.LDF_EpmCaSI1OfsErr DFC_b.LDF_EpmCrSErrSig DFC_b.LDF_EpmCrSNoSig DFC_b.LDF_EtaEngIdleNonCsers DFC_b.LDF_EtaEngPtlNonCsers DFC_b.LDF_FRAmax DFC_b.LDF_FRAmin DFC_b.LDF_GbxRvsSwtStk DFC_b.LDF_HDRmax DFC_b.LDF_HEGOS2B1ElecMax DFC_b.LDF_HEGOS2B1ElecMin DFC_b.LDF_HEGOS2B1ElecSig DFC_b.LDF_HEGOS2B1HtgNpl DFC_b.LDF_IntkAirTIntkMnfldCrssMax DFC_b.LDF_IntkAirTIntkMnfldCrssMin DFC_b.LDF_IntkAirTIntkMnfldHSCMax DFC_b.LDF_IntkAirTIntkMnfldImps DFC_b.LDF_IntkAirTIntkMnfldPRCMax DFC_b.LDF_IntkAirTIntkMnfldPRCMin DFC_b.LDF_IntkAirTIntkMnfldSRCMax DFC_b.LDF_IntkAirTIntkMnfldSRCMin DFC_b.LDF_IntkAirTIntkMnfldSTC DFC_b.LDF_KS1max DFC_b.LDF_KS1min DFC_b.LDF_LMmax DFC_b.LDF_LZSRnpl DFC_b.LDF_LamDynDiagS1B1 DFC_b.LDF_LeakIntkMnfldEmiInfl DFC_b.LDF_MD00max DFC_b.LDF_MDBmax DFC_b.LDF_MDCat DFC_b.LDF_MDCatCrit DFC_b.LDF_MDCatCurr DFC_b.LDF_MDCyl_0 DFC_b.LDF_MDCyl_1 DFC_b.LDF_MDCyl_2 DFC_b.LDF_MDCyl_3 DFC_b.LDF_MDEmi DFC_b.LDF_MDEmiStrt DFC_b.LDF_MDFco DFC_b.LDF_MDMpl DFC_b.LDF_MDSegTiAdpn DFC_b.LDF_MDmax DFC_b.LDF_MOXEMM_SMU_ALM0_0 DFC_b.LDF_MOXEMM_SMU_ALM0_1 DFC_b.LDF_MOXEMM_SMU_ALM0_10 DFC_b.LDF_MOXEMM_SMU_ALM0_11 DFC_b.LDF_MOXEMM_SMU_ALM0_13 DFC_b.LDF_MOXEMM_SMU_ALM0_14 DFC_b.LDF_MOXEMM_SMU_ALM0_2 DFC_b.LDF_MOXEMM_SMU_ALM0_22 DFC_b.LDF_MOXEMM_SMU_ALM0_23 DFC_b.LDF_MOXEMM_SMU_ALM0_4 DFC_b.LDF_MOXEMM_SMU_ALM0_5 DFC_b.LDF_MOXEMM_SMU_ALM0_7 DFC_b.LDF_MOXEMM_SMU_ALM0_8 DFC_b.LDF_MOXEMM_SMU_ALM10_16 DFC_b.LDF_MOXEMM_SMU_ALM10_17 DFC_b.LDF_MOXEMM_SMU_ALM10_21 DFC_b.LDF_MOXEMM_SMU_ALM11_0 DFC_b.LDF_MOXEMM_SMU_ALM11_1 DFC_b.LDF_MOXEMM_SMU_ALM11_2 DFC_b.LDF_MOXEMM_SMU_ALM11_3 DFC_b.LDF_MOXEMM_SMU_ALM11_4 DFC_b.LDF_MOXEMM_SMU_ALM11_5 DFC_b.LDF_MOXEMM_SMU_ALM11_8 DFC_b.LDF_MOXEMM_SMU_ALM11_9 DFC_b.LDF_MOXEMM_SMU_ALM1_0 DFC_b.LDF_MOXEMM_SMU_ALM1_1 DFC_b.LDF_MOXEMM_SMU_ALM1_10 DFC_b.LDF_MOXEMM_SMU_ALM1_11 DFC_b.LDF_MOXEMM_SMU_ALM1_13 DFC_b.LDF_MOXEMM_SMU_ALM1_14 DFC_b.LDF_MOXEMM_SMU_ALM1_2 DFC_b.LDF_MOXEMM_SMU_ALM1_22 DFC_b.LDF_MOXEMM_SMU_ALM1_23 DFC_b.LDF_MOXEMM_SMU_ALM1_4 DFC_b.LDF_MOXEMM_SMU_ALM1_5 DFC_b.LDF_MOXEMM_SMU_ALM1_7 DFC_b.LDF_MOXEMM_SMU_ALM1_8 DFC_b.LDF_MOXEMM_SMU_ALM21_0 DFC_b.LDF_MOXEMM_SMU_ALM21_16 DFC_b.LDF_MOXEMM_SMU_ALM21_3 DFC_b.LDF_MOXEMM_SMU_ALM2_1 DFC_b.LDF_MOXEMM_SMU_ALM2_10 DFC_b.LDF_MOXEMM_SMU_ALM2_11 DFC_b.LDF_MOXEMM_SMU_ALM2_13 DFC_b.LDF_MOXEMM_SMU_ALM2_14 DFC_b.LDF_MOXEMM_SMU_ALM2_22 DFC_b.LDF_MOXEMM_SMU_ALM2_23 DFC_b.LDF_MOXEMM_SMU_ALM2_4 DFC_b.LDF_MOXEMM_SMU_ALM2_5 DFC_b.LDF_MOXEMM_SMU_ALM2_7 DFC_b.LDF_MOXEMM_SMU_ALM2_8 DFC_b.LDF_MOXEMM_SMU_ALM6_0 DFC_b.LDF_MOXEMM_SMU_ALM6_11 DFC_b.LDF_MOXEMM_SMU_ALM6_12 DFC_b.LDF_MOXEMM_SMU_ALM6_14 DFC_b.LDF_MOXEMM_SMU_ALM6_15 DFC_b.LDF_MOXEMM_SMU_ALM6_17 DFC_b.LDF_MOXEMM_SMU_ALM6_18 DFC_b.LDF_MOXEMM_SMU_ALM6_20 DFC_b.LDF_MOXEMM_SMU_ALM6_21 DFC_b.LDF_MOXEMM_SMU_ALM6_25 DFC_b.LDF_MOXEMM_SMU_ALM6_4 DFC_b.LDF_MOXEMM_SMU_ALM6_5 DFC_b.LDF_MOXEMM_SMU_ALM6_7 DFC_b.LDF_MOXEMM_SMU_ALM6_8 DFC_b.LDF_MOXEMM_SMU_ALM7_1 DFC_b.LDF_MOXEMM_SMU_ALM7_12 DFC_b.LDF_MOXEMM_SMU_ALM7_13 DFC_b.LDF_MOXEMM_SMU_ALM7_14 DFC_b.LDF_MOXEMM_SMU_ALM7_15 DFC_b.LDF_MOXEMM_SMU_ALM7_16 DFC_b.LDF_MOXEMM_SMU_ALM7_17 DFC_b.LDF_MOXEMM_SMU_ALM7_2 DFC_b.LDF_MOXEMM_SMU_ALM7_20 DFC_b.LDF_MOXEMM_SMU_ALM7_25 DFC_b.LDF_MOXEMM_SMU_ALM7_26 DFC_b.LDF_MOXEMM_SMU_ALM7_28 DFC_b.LDF_MOXEMM_SMU_ALM7_29 DFC_b.LDF_MOXEMM_SMU_ALM7_30 DFC_b.LDF_MOXEMM_SMU_ALM7_31 DFC_b.LDF_MOXEMM_SMU_ALM8_0 DFC_b.LDF_MOXEMM_SMU_ALM8_1 DFC_b.LDF_MOXEMM_SMU_ALM8_10 DFC_b.LDF_MOXEMM_SMU_ALM8_11 DFC_b.LDF_MOXEMM_SMU_ALM8_12 DFC_b.LDF_MOXEMM_SMU_ALM8_16 DFC_b.LDF_MOXEMM_SMU_ALM8_18 DFC_b.LDF_MOXEMM_SMU_ALM8_2 DFC_b.LDF_MOXEMM_SMU_ALM8_3 DFC_b.LDF_MOXEMM_SMU_ALM8_31 DFC_b.LDF_MOXEMM_SMU_ALM8_4 DFC_b.LDF_MOXEMM_SMU_ALM9_0 DFC_b.LDF_MOXEMM_SMU_ALM9_15 DFC_b.LDF_MOXEMM_SMU_ALM9_3 DFC_b.LDF_MoCADCNTP DFC_b.LDF_MoCADCTst DFC_b.LDF_MoCSOPICO DFC_b.LDF_MoFAPP DFC_b.LDF_MoFAirFilgPrdc DFC_b.LDF_MoFAirFlCtOffPfi DFC_b.LDF_MoFAirFlCylPfi DFC_b.LDF_MoFAirFlIn DFC_b.LDF_MoFAirFlMixCtlPfiChkAirFl DFC_b.LDF_MoFAirFlMixCtlPfiChkCtrl DFC_b.LDF_MoFAirFlMode DFC_b.LDF_MoFESpd DFC_b.LDF_MoFIACo DFC_b.LDF_MoFICOL1 DFC_b.LDF_MoFICOL2 DFC_b.LDF_MoFStrt DFC_b.LDF_MoFTrqCmp DFC_b.LDF_MoFTrqCmpMax DFC_b.LDF_MoFTrqCmpMin DFC_b.LDF_MoFVarPostBldSel DFC_b.LDF_MoXEMMHwLTMCUFW DFC_b.LDF_MoXEMMHwLTMonBIST DFC_b.LDF_MoXEMMHwLTRegMonTest DFC_b.LDF_MoXEMMHwLTStbySMUAlvTest DFC_b.LDF_MoXEMMHwLTTempSens DFC_b.LDF_MoXEMMHwLTUCBCfg DFC_b.LDF_OCWDAABEActv DFC_b.LDF_OCWDACom DFC_b.LDF_OCWDAErrPin DFC_b.LDF_OCWDAOvrVltg DFC_b.LDF_ORAmax DFC_b.LDF_ORAmin DFC_b.LDF_PLLSUmax DFC_b.LDF_PLLSUmin DFC_b.LDF_PSR1max DFC_b.LDF_PSRBmax DFC_b.LDF_PSRBmin DFC_b.LDF_PSRPmax DFC_b.LDF_PSRPmin DFC_b.LDF_PSRPsig DFC_b.LDF_PSRmax DFC_b.LDF_PUmax DFC_b.LDF_P_VSE11_OL DFC_b.LDF_P_VSE11_SCB DFC_b.LDF_P_VSE11_SCG DFC_b.LDF_PhyHighAPP1 DFC_b.LDF_PhyHighAPP2 DFC_b.LDF_PhyLowAPP1 DFC_b.LDF_PhyLowAPP2 DFC_b.LDF_SRCHighAPP1 DFC_b.LDF_SRCHighAPP2 DFC_b.LDF_SRCLowAPP1 DFC_b.LDF_SRCLowAPP2 DFC_b.LDF_SSpMon2 DFC_b.LDF_SWReset_0 DFC_b.LDF_SWReset_1 DFC_b.LDF_SWReset_2 DFC_b.LDF_SyncAPP DFC_b.LDF_TAmax_Dummy DFC_b.LDF_TKAEmax DFC_b.LDF_TKAEmin DFC_b.LDF_TKARmax DFC_b.LDF_TKARnpl DFC_b.LDF_TMmax_Dummy DFC_b.LDF_TUMmax_Dummy DFC_b.LDF_TWCDPriCatB1 DFC_b.LDF_ThrVlvClsdPosnFirstOffsLrnImpoB1 DFC_b.LDF_ThrVlvClsdPosnOffsLrnImpoB1 DFC_b.LDF_ThrVlvClsdPosnOffsLrnMaxB1 DFC_b.LDF_ThrVlvClsdPosnOffsLrnMinB1 DFC_b.LDF_ThrVlvCtrlDeB1 DFC_b.LDF_ThrVlvDycB1 DFC_b.LDF_ThrVlvLimpAirPosnMaxAbsltDriftB1 DFC_b.LDF_ThrVlvLimpAirPosnMaxB1 DFC_b.LDF_ThrVlvLimpAirPosnMaxRelDriftB1 DFC_b.LDF_ThrVlvLimpAirPosnMinB1 DFC_b.LDF_ThrVlvOpenLoadB1 DFC_b.LDF_ThrVlvOpenSprgB1 DFC_b.LDF_ThrVlvOpenSprgSprdB1 DFC_b.LDF_ThrVlvOpenSprgTwnB1 DFC_b.LDF_ThrVlvOverTB1 DFC_b.LDF_ThrVlvRetSprgB1 DFC_b.LDF_ThrVlvRetSprgSprdB1 DFC_b.LDF_ThrVlvRetSprgTwnB1 DFC_b.LDF_ThrVlvSens1MaxB1 DFC_b.LDF_ThrVlvSens1NplB1 DFC_b.LDF_ThrVlvSens2MaxB1 DFC_b.LDF_ThrVlvSens2MinB1 DFC_b.LDF_ThrVlvSens2NplB1 DFC_b.LDF_ThrVlvShoCircB1 DFC_b.LDF_ThrVlvSpiErrB1 DFC_b.LDF_ThrvlvSens1MinB1 DFC_b.LDF_TiOffTBasdChkFast DFC_b.LDF_TiOffTBasdChkSlow DFC_b.LDF_UEGOHeatrCtlS1B1 DFC_b.LDF_UEGOSnsrMntdS1B1 DFC_b.LDF_VehVSig DFC_b.LDF_VlvLftFbSwtIntk11SpclFail DFC_b.LDF_VlvLftFbSwtIntk11StdFail DFC_b.TSC_AltIOACGFailr DFC_b.TSC_AltIOACGHiVltg DFC_b.TSC_AltIOACGLoVltg DFC_b.TSC_AltIOACGTHi DFC_b.TSC_AltIODConnACG DFC_b.TSC_BattUHiFailr DFC_b.TSC_BattULoFailr DFC_b.TSC_BrkBstPDriftHiErr DFC_b.TSC_BrkBstPDriftLoErr DFC_b.TSC_BrkBstPSnsrStuck DFC_b.TSC_BrkMnSwtContOn DFC_b.TSC_BrkMnSwtNotStp DFC_b.TSC_BrkNpl DFC_b.TSC_BrkRdntSwtContOn DFC_b.TSC_BrkRdntSwtNotStp DFC_b.TSC_Clth3ONStuck DFC_b.TSC_Clth4OFFStuck DFC_b.TSC_ClthOFFStuck DFC_b.TSC_ClthONStuck DFC_b.TSC_ClthStkFailInfo DFC_b.TSC_ComACFailInfo DFC_b.TSC_ComATFTValErr DFC_b.TSC_ComATMILReq DFC_b.TSC_ComAYCAChksum DFC_b.TSC_ComAYCARingCnt DFC_b.TSC_ComAYCATOut DFC_b.TSC_ComAYCDChkSum DFC_b.TSC_ComAYCDTOut DFC_b.TSC_ComAYCFChksum DFC_b.TSC_ComAYCFRingCnt DFC_b.TSC_ComAYCFTOut DFC_b.TSC_ComAYCGChksum DFC_b.TSC_ComAYCGRingCnt DFC_b.TSC_ComAYCGTOut DFC_b.TSC_ComAYCIChkSum DFC_b.TSC_ComAYCIRingCnt DFC_b.TSC_ComAYCITOut DFC_b.TSC_ComBCM1ChkSum DFC_b.TSC_ComBCM1RingCnt DFC_b.TSC_ComBCM1TOut DFC_b.TSC_ComCANABusOffErr DFC_b.TSC_ComCANBBusOffErr DFC_b.TSC_ComCANCBusOffErr DFC_b.TSC_ComCGW1ChkSum DFC_b.TSC_ComCGW1RingCnt DFC_b.TSC_ComCGW1TOut DFC_b.TSC_ComConvBoostErr DFC_b.TSC_ComConvSlipErr DFC_b.TSC_ComEAT10Chksum DFC_b.TSC_ComEAT10RingCnt DFC_b.TSC_ComEAT10TOut DFC_b.TSC_ComEAT11ChkSum DFC_b.TSC_ComEAT11RingCnt DFC_b.TSC_ComEAT11TOut DFC_b.TSC_ComEAT12ChkSum DFC_b.TSC_ComEAT12RingCnt DFC_b.TSC_ComEAT12TOut DFC_b.TSC_ComEAT13ChkSum DFC_b.TSC_ComEAT13RingCnt DFC_b.TSC_ComEAT13TOut DFC_b.TSC_ComEAT1Chksum DFC_b.TSC_ComEAT1RingCnt DFC_b.TSC_ComEAT1TOut DFC_b.TSC_ComEAT2ChkSum DFC_b.TSC_ComEAT2RingCnt DFC_b.TSC_ComEAT2TOut DFC_b.TSC_ComEAT4ChkSum DFC_b.TSC_ComEAT4RingCnt DFC_b.TSC_ComEAT4TOut DFC_b.TSC_ComEAT6Chksum DFC_b.TSC_ComEAT6RingCnt DFC_b.TSC_ComEAT6TOut DFC_b.TSC_ComEAT7Chksum DFC_b.TSC_ComEAT7RingCnt DFC_b.TSC_ComEAT7TOut DFC_b.TSC_ComEAT8Chksum DFC_b.TSC_ComEAT8RingCnt DFC_b.TSC_ComEAT8TOut DFC_b.TSC_ComEATAChksum DFC_b.TSC_ComEATARingCnt DFC_b.TSC_ComEATATOut DFC_b.TSC_ComEATBChkSum DFC_b.TSC_ComEATBRingCnt DFC_b.TSC_ComEATBTOut DFC_b.TSC_ComEATCChksum DFC_b.TSC_ComEATCRingCnt DFC_b.TSC_ComEATCTOut DFC_b.TSC_ComEBBAChksum DFC_b.TSC_ComEBBARingCnt DFC_b.TSC_ComEBBATOut DFC_b.TSC_ComEPS1Chksum DFC_b.TSC_ComEPS1RingCnt DFC_b.TSC_ComEPS1TOut DFC_b.TSC_ComEngCanRxErr DFC_b.TSC_ComGrvySnsrErr DFC_b.TSC_ComGwIMG1ChkSum DFC_b.TSC_ComGwIMG1RingCnt DFC_b.TSC_ComGwIMG1TOut DFC_b.TSC_ComGwIMG3ChkSum DFC_b.TSC_ComGwIMG3RingCnt DFC_b.TSC_ComGwIMG3TOut DFC_b.TSC_ComGwIMG4ChkSum DFC_b.TSC_ComGwIMG4RingCnt DFC_b.TSC_ComGwIMG4TOut DFC_b.TSC_ComGwIMG5ChkSum DFC_b.TSC_ComGwIMG5RingCnt DFC_b.TSC_ComGwIMG5TOut DFC_b.TSC_ComGwIMG6ChkSum DFC_b.TSC_ComGwIMG6RingCnt DFC_b.TSC_ComGwIMG6TOut DFC_b.TSC_ComIDASBChksum DFC_b.TSC_ComIDASBRingCnt DFC_b.TSC_ComIDASBTOut DFC_b.TSC_ComIMGMILReq DFC_b.TSC_ComISSPrms DFC_b.TSC_ComMETAChksum DFC_b.TSC_ComMETARingCnt DFC_b.TSC_ComMETATOut DFC_b.TSC_ComMETCChksum DFC_b.TSC_ComMETCRingCnt DFC_b.TSC_ComMETCTOut DFC_b.TSC_ComMETDChksum DFC_b.TSC_ComMETDRingCnt DFC_b.TSC_ComMETDTOut DFC_b.TSC_ComMETE2Chksum DFC_b.TSC_ComMETE2RingCnt DFC_b.TSC_ComMETE2TOut DFC_b.TSC_ComMETFChksum DFC_b.TSC_ComMETFRingCnt DFC_b.TSC_ComMETFTOut DFC_b.TSC_ComMETGChksum DFC_b.TSC_ComMETGRingCnt DFC_b.TSC_ComMETGTOut DFC_b.TSC_ComMETH2Chksum DFC_b.TSC_ComMETH2RingCnt DFC_b.TSC_ComMETH2TOut DFC_b.TSC_ComMETHChksum DFC_b.TSC_ComMETHRingCnt DFC_b.TSC_ComMETHTOut DFC_b.TSC_ComMETIChksum DFC_b.TSC_ComMETIRingCnt DFC_b.TSC_ComMETITOut DFC_b.TSC_ComMETKChksum DFC_b.TSC_ComMETKRingCnt DFC_b.TSC_ComMETKTOut DFC_b.TSC_ComMETLChksum DFC_b.TSC_ComMETLRingCnt DFC_b.TSC_ComMETLTOut DFC_b.TSC_ComMETMChksum DFC_b.TSC_ComMETMRingCnt DFC_b.TSC_ComMETMTOut DFC_b.TSC_ComMETNChksum DFC_b.TSC_ComMETNRingCnt DFC_b.TSC_ComMETNTOut DFC_b.TSC_ComMtrCom DFC_b.TSC_ComPCUChkSum DFC_b.TSC_ComPCURingCnt DFC_b.TSC_ComPCUTOut DFC_b.TSC_ComSRSAChksum DFC_b.TSC_ComSRSARingCnt DFC_b.TSC_ComSRSATOut DFC_b.TSC_ComSRSBChksum DFC_b.TSC_ComSRSBRingCnt DFC_b.TSC_ComSRSBTOut DFC_b.TSC_ComSRSChksum DFC_b.TSC_ComSRSErr DFC_b.TSC_ComSRSRingCnt DFC_b.TSC_ComSRSTOut DFC_b.TSC_ComVehSpdPndFltTCU DFC_b.TSC_EbsChartcCurrErr DFC_b.TSC_EbsSelfDiagErr DFC_b.TSC_GbxCANDigPlausErr DFC_b.TSC_GbxNPos1SRCMax DFC_b.TSC_GbxNPos1SRCMin DFC_b.TSC_GbxNPos2SRCMax DFC_b.TSC_GbxNPos2SRCMin DFC_b.TSC_GbxNPosAlvChk DFC_b.TSC_GbxNPosSyncErr DFC_b.TSC_HEGOS2B1HtrPsMax DFC_b.TSC_HEGOS2B1HtrPsMin DFC_b.TSC_HEGOS2B1HtrPsSig DFC_b.TSC_LinCSErrACG DFC_b.TSC_LinCSErrEBS DFC_b.TSC_LinHdrTimeoutErrACG DFC_b.TSC_LinHdrTimeoutErrEBS DFC_b.TSC_LinMsgTimeoutErrACG DFC_b.TSC_LinMsgTimeoutErrEBS DFC_b.TSC_LinNoStrtComErr DFC_b.TSC_MisfDetVWhlFrntLeOORHi DFC_b.TSC_MisfDetVWhlFrntLeRatyHi DFC_b.TSC_MisfDetVWhlFrntLeRatyLo DFC_b.TSC_MisfDetVWhlFrntLeStuck DFC_b.TSC_MisfDetVWhlFrntRiOORHi DFC_b.TSC_MisfDetVWhlFrntRiRatyHi DFC_b.TSC_MisfDetVWhlFrntRiRatyLo DFC_b.TSC_MisfDetVWhlFrntRiStuck DFC_b.TSC_MisfDetVWhlReLeOORHi DFC_b.TSC_MisfDetVWhlReLeRatyHi DFC_b.TSC_MisfDetVWhlReLeRatyLo DFC_b.TSC_MisfDetVWhlReLeStuck DFC_b.TSC_MisfDetVWhlReRiOORHi DFC_b.TSC_MisfDetVWhlReRiRatyHi DFC_b.TSC_MisfDetVWhlReRiRatyLo DFC_b.TSC_MisfDetVWhlReRiStuck DFC_b.TSC_MisfDetdVWhlFrntLePlaus DFC_b.TSC_MisfDetdVWhlFrntRiPlaus DFC_b.TSC_MisfDetdVWhlReLePlaus DFC_b.TSC_MisfDetdVWhlReRiPlaus DFC_b.TSC_PEnvSigRngMax /end OUT_MEASUREMENT
 FUNCTION_VERSION "30000.33.0" /end FUNCTION
/begin COMPU_METHOD DFC_OneToOne "" RAT_FUNC "%6.2" "-" COEFFS 0 1 0 0 0 1 /end COMPU_METHOD
/end MODULE
/end PROJECT
