ASAP2_VERSION 1 60
/begin PROJECT MG1CA020 "MG1CA020"
/begin HEADER "" VERSION "MG1CA020_6SAY_V011_TPROT" PROJECT_NO MG1CA020 /end HEADER
/begin MODULE DIM ""
/begin MOD_COMMON "" BYTE_ORDER MSB_LAST ALIGNMENT_BYTE 1 ALIGNMENT_WORD 2 ALIGNMENT_LONG 4 ALIGNMENT_INT64 4 ALIGNMENT_FLOAT32_IEEE 4 ALIGNMENT_FLOAT64_IEEE 4 DATA_SIZE 32 /end MOD_COMMON
/begin CHARACTERISTIC AirMod_facDia_T "Factor delta ignition angle for AirMod" CURVE 0x8050598E RB_Curve_S8_U16_Static 1.000000 fak_uw_b2 0.00 1.000000 FORMAT "%8.6" EXTENDED_LIMITS 0.00 1.999969
 /begin AXIS_DESCR STD_AXIS AirMod_dia kw_q0p75 6 -96.00 95.25 FORMAT "%5.2" DEPOSIT ABSOLUTE /end AXIS_DESCR
/end CHARACTERISTIC
/begin CHARACTERISTIC AirMod_facFcoCorrnRampIn_C "ramp in calibration factor for correction of charge modell at fuel cut of" VALUE 0x805059A2 RB_Val_Wu16 1.000000 fak_uw_b2 0.00 1.000000 FORMAT "%8.6" EXTENDED_LIMITS 0.00 1.999969 /end CHARACTERISTIC
/begin CHARACTERISTIC AirMod_facFcoCorrnRampOut_C "ramp out calibration factor for correction of charge modell at fuel cut of" VALUE 0x805059A4 RB_Val_Wu16 1.000000 fak_uw_b2 0.00 1.000000 FORMAT "%8.6" EXTENDED_LIMITS 0.00 1.999969 /end CHARACTERISTIC
/begin CHARACTERISTIC AirMod_FacFilDmCyl2ExhMnfld_T "Filter time constant of Mass flow scavenged from combustion chamber to exhaust manifold" CURVE 0x805059A6 RB_Curve_U16_U16 0.9999847 fak_uw_b1 0.00 0.9999847 FORMAT "%9.7"
 /begin AXIS_DESCR STD_AXIS vpsrabg_w fak_uw_b2 5 0.00 1.999969 FORMAT "%8.6" DEPOSIT ABSOLUTE /end AXIS_DESCR
/end CHARACTERISTIC
/begin CHARACTERISTIC AirMod_nrSynAirChrgToIgnCalcn_C "Amount of cylinders between charge and ignition(paramter)" VALUE 0x805072D0 RB_Val_Wu8 255.0 OneToOne 0.00 255.0 FORMAT "%5.1" /end CHARACTERISTIC
/begin CHARACTERISTIC AirMod_pExhDeltaDia_M "Delta pressure exhaust gas depending on delta ignition angle" MAP 0x805059BC RB_Map_U16S16_S16 5119.922 p_sw_q0p078 -2560.000 2559.922 FORMAT "%8.3"
 /begin AXIS_DESCR STD_AXIS vpsrpuakt_w fak_uw_b4 10 0.00 3.999939 FORMAT "%8.6" DEPOSIT ABSOLUTE /end AXIS_DESCR
 /begin AXIS_DESCR STD_AXIS nmotsw_w EngN 10 -16384.00 16383.50 FORMAT "%8.2" DEPOSIT ABSOLUTE /end AXIS_DESCR
/end CHARACTERISTIC
/begin CHARACTERISTIC AirMod_pOffsCorrnFcoLoLft_M "pressure offset correction of charge modell at fuel cut off for low lift" MAP 0x80505AB0 RB_Map_S16U16_S16 2559.961 p_sw_q0p039 -1280.000 1279.961 FORMAT "%8.3"
 /begin AXIS_DESCR STD_AXIS Epm_nEng10ms EngN 14 -16384.00 16383.50 FORMAT "%8.2" DEPOSIT ABSOLUTE /end AXIS_DESCR
 /begin AXIS_DESCR STD_AXIS PEnv_p p_uw_q0p039 4 0.00 2559.961 FORMAT "%8.3" DEPOSIT ABSOLUTE /end AXIS_DESCR
/end CHARACTERISTIC
/begin CHARACTERISTIC AirMod_pOffsCorrnFco_M "pressure offset correction of charge modell at fuel cut off" MAP 0x80505B48 RB_Map_S16U16_S16 2559.961 p_sw_q0p039 -1280.000 1279.961 FORMAT "%8.3"
 /begin AXIS_DESCR STD_AXIS Epm_nEng10ms EngN 14 -16384.00 16383.50 FORMAT "%8.2" DEPOSIT ABSOLUTE /end AXIS_DESCR
 /begin AXIS_DESCR STD_AXIS PEnv_p p_uw_q0p039 4 0.00 2559.961 FORMAT "%8.3" DEPOSIT ABSOLUTE /end AXIS_DESCR
/end CHARACTERISTIC
/begin CHARACTERISTIC BFZGRLNBKV "Vehicle acceleration for rlmin calculation BKV" VALUE 0x80507304 RB_Val_Ws16 3555.556 bfzg_q0p1085069 -3555.556 0.00 FORMAT "%8.3" EXTENDED_LIMITS -3555.556 3555.447 /end CHARACTERISTIC
/begin CHARACTERISTIC ChrCtl_facMfUGD_C "factor for switch over to WOT calculation of actual massflow for fast throttle movements" VALUE 0x80506F86 RB_Val_Wu16 1.999969 fak_uw_b2 0.00 1.999969 FORMAT "%8.6" /end CHARACTERISTIC
/begin CHARACTERISTIC ChrCtl_facSuctnRefLoLft_T "Storage reference value fupsrl for correction factor engine speed addressing WOT low valve lift" CURVE 0x80506F88 RB_Curve_S16_U16_Static 0.2999908 rel_uw_b0p3 0.0000046 0.2999954 FORMAT "%9.7" EXTENDED_LIMITS 0.00 0.2999954
 /begin AXIS_DESCR STD_AXIS Epm_nEng EngN 5 -16384.00 16383.50 FORMAT "%8.2" DEPOSIT ABSOLUTE /end AXIS_DESCR
/end CHARACTERISTIC
/begin CHARACTERISTIC ChrCtl_facSuctnRef_T "Storage reference value fupsrl for correction factor engine speed addressing WOT" CURVE 0x80506F9E RB_Curve_S16_U16_Static 0.2999908 rel_uw_b0p3 0.0000046 0.2999954 FORMAT "%9.7" EXTENDED_LIMITS 0.00 0.2999954
 /begin AXIS_DESCR STD_AXIS Epm_nEng EngN 5 -16384.00 16383.50 FORMAT "%8.2" DEPOSIT ABSOLUTE /end AXIS_DESCR
/end CHARACTERISTIC
/begin CHARACTERISTIC ChrCtl_nEngMinLoadMfCorrn_C "Minimum engine speed for calculation of correction factor: load to mass flow" VALUE 0x805071C2 RB_Val_Ws16 32767.50 EngN -16384.00 16383.50 FORMAT "%8.2" /end CHARACTERISTIC
/begin CHARACTERISTIC ChrCtl_pDifOpenThrRefLoLft_T "Storage reference value (pressure difference) for correction factor engine speed addressing WOT low valve lift" CURVE 0x80506FB4 RB_Curve_S16_U16_Static 5119.844 p_q0p078 0.078 5119.922 FORMAT "%8.3" EXTENDED_LIMITS 0.00 5119.922
 /begin AXIS_DESCR STD_AXIS Epm_nEng EngN 5 -16384.00 16383.50 FORMAT "%8.2" DEPOSIT ABSOLUTE /end AXIS_DESCR
/end CHARACTERISTIC
/begin CHARACTERISTIC ChrCtl_pDifOpenThrRef_T "Storage reference value (pressure difference) for correction factor engine speed addressing WOT" CURVE 0x80506FCA RB_Curve_S16_U16_Static 5119.844 p_q0p078 0.078 5119.922 FORMAT "%8.3" EXTENDED_LIMITS 0.00 5119.922
 /begin AXIS_DESCR STD_AXIS Epm_nEng EngN 5 -16384.00 16383.50 FORMAT "%8.2" DEPOSIT ABSOLUTE /end AXIS_DESCR
/end CHARACTERISTIC
/begin CHARACTERISTIC ChrCtl_ratChrgMinOffs_C "The charge offset to reduce the lower limit of the deadzone at the end of fuel cut off" VALUE 0x805071C4 RB_Val_Wu16 1535.977 rel_q0p02344 0.00 1535.977 FORMAT "%8.3" /end CHARACTERISTIC
/begin CHARACTERISTIC ChrCtl_tiFcoEndDlyd_C "Time delay to prevent the effect of end of fuel cut off in air mass value calculation" VALUE 0x805071C6 RB_Val_Wu16 655.3500 t_q0p01 0.00 655.3500 FORMAT "%8.4" /end CHARACTERISTIC
/begin CHARACTERISTIC ChrCtl_tiMFlowAdpnFastNeutVal_C "integrator speed for fast constant mass flow adaption with EGR or unthrottled" VALUE 0x805058B6 RB_Val_Wu16 4.990000 t_q0p01 0.010000 5.000000 FORMAT "%8.6" EXTENDED_LIMITS 0.00 655.3500 /end CHARACTERISTIC
/begin CHARACTERISTIC ChrCtl_tiMFlowAdpnFast_C "integrator speed for fast constant mass-flow adaption(short trip)" VALUE 0x805058B8 RB_Val_Wu16 1.990000 t_q0p01 0.010000 2.000000 FORMAT "%8.6" EXTENDED_LIMITS 0.00 655.3500 /end CHARACTERISTIC
/begin CHARACTERISTIC ChrCtl_tiMFlowAdpnFast_T "Integrator speed for fast constant mass-flow adaption f(pressure ratio over throttle valve)" CURVE 0x805058BA RB_Curve_U16_U16 1.990000 t_q0p01 0.010000 2.000000 FORMAT "%8.6" EXTENDED_LIMITS 0.00 655.3500
 /begin AXIS_DESCR STD_AXIS vpsrvd_w_msg fak_uw_b2 8 0.00 1.999969 FORMAT "%8.6" DEPOSIT ABSOLUTE /end AXIS_DESCR
/end CHARACTERISTIC
/begin CHARACTERISTIC ChrCtl_tiMFlowAdpnSlowEol_C "integrator speed for slow constant mass-flow adaption quik trip" VALUE 0x805058DC RB_Val_Wu16 6553.400 t_q0p1 0.100 6553.500 FORMAT "%8.3" EXTENDED_LIMITS 0.00 6553.500 /end CHARACTERISTIC
/begin CHARACTERISTIC ChrCtl_tiMFlowAdpnSlow_T "integrator speed for slow constant mass-flow adaption" CURVE 0x805058DE RB_Curve_U16_U16 6553.400 t_q0p1 0.100 6553.500 FORMAT "%8.3" EXTENDED_LIMITS 0.00 6553.500
 /begin AXIS_DESCR STD_AXIS vpsrvd_w_msg fak_uw_b2 3 0.00 1.999969 FORMAT "%8.6" DEPOSIT ABSOLUTE /end AXIS_DESCR
/end CHARACTERISTIC
/begin CHARACTERISTIC ChrCtl_tiMFlowFacFastAdjmtRst_C "Time constant reset mass flow adjustment fkmsdk" VALUE 0x805058EC RB_Val_Wu16 655.3000 t_q0p01 0.0500 655.3500 FORMAT "%8.4" EXTENDED_LIMITS 0.00 655.3500 /end CHARACTERISTIC
/begin CHARACTERISTIC ChrCtl_tiMFlowLeakFltMaiLoadSnsr_C "Filter time constant for ofmsndk if fault HFMDSS" VALUE 0x805058EE RB_Val_Wu16 6553.400 t_q0p1 0.100 6553.500 FORMAT "%8.3" EXTENDED_LIMITS 0.00 6553.500 /end CHARACTERISTIC
/begin CHARACTERISTIC ChrCtl_tiThrVlvMFlowLeakAdpnEol_C "Correction value for idling air mass integrator for E gas for quik trip" VALUE 0x805058F0 RB_Val_Wu16 255.9922 q0p00390625_s_h_DIV_kg 0.0039 255.9961 FORMAT "%8.4" EXTENDED_LIMITS 0.00 255.9961 /end CHARACTERISTIC
/begin CHARACTERISTIC ChrCtl_tiThrVlvMFlowLeakAdpnLeak_C "Time constant for fast adaptaion of throttle blade during leakage" VALUE 0x805058F2 RB_Val_Wu16 255.9922 q0p00390625_s_h_DIV_kg 0.0039 255.9961 FORMAT "%8.4" EXTENDED_LIMITS 0.00 255.9961 /end CHARACTERISTIC
/begin CHARACTERISTIC ChrCtl_tiThrVlvMFlowLeakAdpnLrgDe_C "Correction value for idling air mass integrator for E gas for great differences" VALUE 0x805058F4 RB_Val_Wu16 255.9922 q0p00390625_s_h_DIV_kg 0.0039 255.9961 FORMAT "%8.4" EXTENDED_LIMITS 0.00 255.9961 /end CHARACTERISTIC
/begin CHARACTERISTIC ChrCtl_tiThrVlvMFlowLeakAdpn_C "Correction value for idling air mass integrator for E gas" VALUE 0x805058F6 RB_Val_Wu16 255.9922 q0p00390625_s_h_DIV_kg 0.0039 255.9961 FORMAT "%8.4" EXTENDED_LIMITS 0.00 255.9961 /end CHARACTERISTIC
/begin CHARACTERISTIC ChrSet_facCorrnNormCdn_C "Weighting factor to include correction norm condition (temperature)" VALUE 0x805074C0 RB_Val_Wu8 0.9961 fak_ub_b1 0.00 0.9961 /end CHARACTERISTIC
/begin CHARACTERISTIC ChrSet_pAmbNormCdn_C "Ambient pressure at norm conditions (calibrateable)" VALUE 0x805074C2 RB_Val_Wu16 23.00781 p_q0p039 990.000 1013.008 FORMAT "%8.3" EXTENDED_LIMITS 0.00 2559.961 /end CHARACTERISTIC
/begin CHARACTERISTIC ChrSet_tAmbNormCdn_C "Ambient temperature at norm conditions (calibrateable)" VALUE 0x805074C4 RB_Val_Wu8 20.25 temp_ub_q0p75_o48 0.00 20.25 FORMAT "%5.2" EXTENDED_LIMITS -48.00 143.3 /end CHARACTERISTIC
/begin CHARACTERISTIC CWBGFKMS "code word for BGFKMS" VALUE 0x805058F8 RB_Val_Wu16 65535.00 dez 0.00 65535.00 FORMAT "%8.2" /end CHARACTERISTIC
/begin CHARACTERISTIC CWBGLASO "Code word for function BGLASO (calculation of lambda setpoint in exhaust)" VALUE 0x80505986 RB_Val_Wu8 255.0 dez 0.00 255.0 FORMAT "%5.1" /end CHARACTERISTIC
/begin CHARACTERISTIC CWBGLWM "Code word %BGLWM" VALUE 0x80505BE0 RB_Val_Wu8 255.0 dez 0.00 255.0 FORMAT "%5.1" /end CHARACTERISTIC
/begin CHARACTERISTIC CWBGLWM2 "Code word BGLWM 2" VALUE 0x80505BE1 RB_Val_Wu8 255.0 dez 0.00 255.0 FORMAT "%5.1" /end CHARACTERISTIC
/begin CHARACTERISTIC CWBGMSDK "code word for BGMSDK" VALUE 0x80506FE0 RB_Val_Wu16 65535.00 OneToOne 0.00 65535.00 FORMAT "%8.2" /end CHARACTERISTIC
/begin CHARACTERISTIC CWBGMSDKS "code word for BGMSDKS" VALUE 0x805071C8 RB_Val_Wu8 255.0 dez 0.00 255.0 FORMAT "%5.1" /end CHARACTERISTIC
/begin CHARACTERISTIC CWBGRL "code word for BGRL" VALUE 0x805072D1 RB_Val_Wu8 255.0 dez 0.00 255.0 FORMAT "%5.1" /end CHARACTERISTIC
/begin CHARACTERISTIC CWPABEF "Code word for Calculation of effective exhaust gas backpressure for charge models" VALUE 0x80505BE2 RB_Val_Wu8 255.0 dez 0.00 255.0 FORMAT "%5.1" /end CHARACTERISTIC
/begin CHARACTERISTIC CWPABNAV "Codeword for the modelling of the exhaust backpressure" VALUE 0x80507244 RB_Val_Wu8 255.0 dez 0.00 255.0 FORMAT "%5.1" /end CHARACTERISTIC
/begin CHARACTERISTIC CWPIRGKL1 "Code word for configuration of the 1st flap" VALUE 0x80505BE3 RB_Val_Wu8 255.0 dez 0.00 255.0 FORMAT "%5.1" /end CHARACTERISTIC
/begin CHARACTERISTIC CWRLAPPL "codeword desired relative air charge from test bench during calibration phase" VALUE 0x805074C5 RB_Val_Wu8 255.0 dez 0.00 255.0 FORMAT "%5.1" /end CHARACTERISTIC
/begin CHARACTERISTIC DANZSYN "Number of synchros for dynamics delay" VALUE 0x80506FE2 RB_Val_Wu8 255.0 OneToOne 0.00 255.0 FORMAT "%5.1" /end CHARACTERISTIC
/begin CHARACTERISTIC DFAFKPVDKE "Threshold of fast adjust. as of multiplicative throttle valve adapt. steady" VALUE 0x805058FA RB_Val_Wu16 1.999969 fak_uw_b2 0.00 1.999969 FORMAT "%8.6" /end CHARACTERISTIC
/begin CHARACTERISTIC DFAOMSNDE "Threshold of the fast adjust. as of the offset throttle valve adapt. steady" VALUE 0x805058FC RB_Val_Wu16 1.999969 fak_uw_b2 0.00 1.999969 FORMAT "%8.6" /end CHARACTERISTIC
/begin CHARACTERISTIC DFEADKE "Threshold for adjust. HFS to NFS, as of the throttle valve adapt. steady" VALUE 0x805058FE RB_Val_Wu16 1.999969 fak_uw_b2 0.00 1.999969 FORMAT "%8.6" /end CHARACTERISTIC
/begin CHARACTERISTIC DFHYSAOMSNDE "Hysteresis threshold of the fast adjust. as of the offset throttle valve adapt. steady" VALUE 0x80505900 RB_Val_Wu16 1.999969 fak_uw_b2 0.00 1.999969 FORMAT "%8.6" /end CHARACTERISTIC
/begin CHARACTERISTIC DFKMSDSTZ "dead zone for throttle adaptation" VALUE 0x80505902 RB_Val_Ws16 0.9999695 fak_sw_b1 0.00 0.9999695 FORMAT "%9.7" EXTENDED_LIMITS -1.000000 0.9999695 /end CHARACTERISTIC
/begin CHARACTERISTIC DOFMSNDMSLL "Curve: Normalised mass flow upper threshold correction due to big leakage into intake manifold" CURVE 0x80505904 RB_Curve_S16_U16_Static 6553.500 m_q0p1 0.00 6553.500 FORMAT "%8.3"
 /begin AXIS_DESCR STD_AXIS Epm_nEng EngN 5 -16384.00 16383.50 FORMAT "%8.2" DEPOSIT ABSOLUTE /end AXIS_DESCR
/end CHARACTERISTIC
/begin CHARACTERISTIC DPABEFO "Offset on upper limit of effective exhaust gas backpressure for charge models" VALUE 0x80505BE4 RB_Val_Wu16 5119.922 p_uw_q0p078 0.00 5119.922 FORMAT "%8.3" /end CHARACTERISTIC
/begin CHARACTERISTIC DPABEFU "Offset on lower limit of effective exhaust gas backpressure for charge models" VALUE 0x80505BE6 RB_Val_Wu16 5119.922 p_uw_q0p078 0.00 5119.922 FORMAT "%8.3" /end CHARACTERISTIC
/begin CHARACTERISTIC DPBRINTTN "Minimum delta pbrint due to model tolerances" VALUE 0x80505BE8 RB_Val_Wu16 2559.961 p_uw_q0p039 0.00 2559.961 FORMAT "%8.3" /end CHARACTERISTIC
/begin CHARACTERISTIC DPBRINTTX "Maximum delta pbrint due to model tolerances" VALUE 0x80505BEA RB_Val_Wu16 2559.961 p_uw_q0p039 0.00 2559.961 FORMAT "%8.3" /end CHARACTERISTIC
/begin CHARACTERISTIC DPLMDK "Permissible pressure delta between predicted delta pressure in intake manifold and delta pressure in intake manifold, throttle and main charge sensor based (via throttle valve tolerances)" VALUE 0x805074B2 RB_Val_Ws16 2559.922 p_uw_q0p078 0.00 2559.922 FORMAT "%8.3" EXTENDED_LIMITS -2560.000 2559.922 /end CHARACTERISTIC
/begin CHARACTERISTIC DRLFRMNTST "min. delta between rlsol and rl for inclusion in charge controller calculation" CURVE 0x805071CA RB_Curve_U16_S16_Static 768.0000 rel_q0p02344 -768.0000 0.00 FORMAT "%8.4" EXTENDED_LIMITS -768.0000 767.9766
 /begin AXIS_DESCR STD_AXIS tnst_w_msg t_q0p01 2 0.00 655.3500 FORMAT "%8.4" DEPOSIT ABSOLUTE /end AXIS_DESCR
/end CHARACTERISTIC
/begin CHARACTERISTIC DRLFRMXTST "max. delta between rlsol and rl for inclusion in charge controller calculation" CURVE 0x805071D4 RB_Curve_U16_S16_Static 767.9766 rel_q0p02344 0.00 767.9766 FORMAT "%8.4" EXTENDED_LIMITS -768.0000 767.9766
 /begin AXIS_DESCR STD_AXIS tnst_w_msg t_q0p01 2 0.00 655.3500 FORMAT "%8.4" DEPOSIT ABSOLUTE /end AXIS_DESCR
/end CHARACTERISTIC
/begin CHARACTERISTIC DRLMINBG "Hysteresis for condition minimal achievable torque" VALUE 0x805074C6 RB_Val_Wu16 5.015625 rel_q0p02344 0.00 5.015625 FORMAT "%8.6" EXTENDED_LIMITS 0.00 1535.977 /end CHARACTERISTIC
/begin CHARACTERISTIC DRLRLPMAX "Limit for steady delta of relative air charge and predicted relative air charge from monitoring" VALUE 0x805074B4 RB_Val_Wu16 767.9766 rel_uw_q0p0234 0.00 767.9766 FORMAT "%8.4" EXTENDED_LIMITS 0.00 1535.977 /end CHARACTERISTIC
/begin CHARACTERISTIC DRLRLPU "delta relative air charge for predicted relative air charge - lower limit" VALUE 0x805074B6 RB_Val_Wu16 1535.977 rel_uw_q0p0234 0.00 1535.977 FORMAT "%8.3" /end CHARACTERISTIC
/begin CHARACTERISTIC DRLSOLDYN "delta-rl-rlsol to recognize dynamic operation" VALUE 0x805074C8 RB_Val_Wu16 1535.977 rel_q0p02344 0.00 1535.977 FORMAT "%8.3" /end CHARACTERISTIC
/begin CHARACTERISTIC DRLSOLHUM "delta-rl-rlsol for HOM switch" VALUE 0x805074CA RB_Val_Ws16 1535.977 rel_q0p02344 -768.0000 767.9766 FORMAT "%8.4" /end CHARACTERISTIC
/begin CHARACTERISTIC DRLSOLSTAT "delta-rl-rlsol to recognize steady state condition" VALUE 0x805074CC RB_Val_Wu16 1535.977 rel_q0p02344 0.00 1535.977 FORMAT "%8.3" /end CHARACTERISTIC
/begin CHARACTERISTIC DRLSTAT "delta-rl to recognize steady state condition" VALUE 0x805074CE RB_Val_Wu16 1535.977 rel_q0p02344 0.00 1535.977 FORMAT "%8.3" /end CHARACTERISTIC
/begin CHARACTERISTIC DTAFKPVDKE "delta delay time for condition adaption fkpvdk not in steady-state" VALUE 0x8050591A RB_Val_Wu8 10.00 t_q0p1 0.00 10.00 FORMAT "%5.2" EXTENDED_LIMITS 0.00 25.50 /end CHARACTERISTIC
/begin CHARACTERISTIC DTAOMSNDKE "Delay delta for condition adaptation of ofmsndk no longer steady" VALUE 0x8050591B RB_Val_Wu8 10.00 t_q0p1 0.00 10.00 FORMAT "%5.2" EXTENDED_LIMITS 0.00 25.50 /end CHARACTERISTIC
/begin CHARACTERISTIC DWDKMXWDK "max. error of throttle balde angle dependent on angle" CURVE 0x80506FE4 RB_Curve_U16_U16 99.99847 rel_uw_b100 0.00 99.99847 FORMAT "%8.5"
 /begin AXIS_DESCR STD_AXIS wdkm_w rel_uw_b100 3 0.00 99.99847 FORMAT "%8.5" DEPOSIT ABSOLUTE /end AXIS_DESCR
/end CHARACTERISTIC
/begin CHARACTERISTIC EXP1DKAPPA "Curve exponent 1/Kappa" CURVE 0x80505BEC RB_Curve_U16_U16 3.999939 fak_uw_b4 0.00 3.999939 FORMAT "%8.6" READ_ONLY
 /begin AXIS_DESCR STD_AXIS vpexpkap_w fak_uw_b4 9 0.00 3.999939 FORMAT "%8.6" DEPOSIT ABSOLUTE /end AXIS_DESCR
/end CHARACTERISTIC
/begin CHARACTERISTIC EXPKAPPA "Curve exponent Kappa" CURVE 0x80505C12 RB_Curve_U16_U16 3.999939 fak_uw_b4 0.00 3.999939 FORMAT "%8.6" READ_ONLY
 /begin AXIS_DESCR STD_AXIS vvexpkap_w fak_uw_b4 9 0.00 3.999939 FORMAT "%8.6" DEPOSIT ABSOLUTE /end AXIS_DESCR
/end CHARACTERISTIC
/begin CHARACTERISTIC EXPTERMKAP "Curve function with exponent 1/Kappa" CURVE 0x80505C38 RB_Curve_U16_U16 3.999939 fak_uw_b4 0.00 3.999939 FORMAT "%8.6" READ_ONLY
 /begin AXIS_DESCR STD_AXIS vpexpkap_w fak_uw_b4 9 0.00 3.999939 FORMAT "%8.6" DEPOSIT ABSOLUTE /end AXIS_DESCR
/end CHARACTERISTIC
/begin CHARACTERISTIC FAFRSPVP "KLAF for reaspirated inert gas" CURVE 0x80505C5E RB_Curve_U16_U16 1.999969 fak_uw_b2 0.00 1.999969 FORMAT "%8.6"
 /begin AXIS_DESCR STD_AXIS vpsrabg_w fak_uw_b2 10 0.00 1.999969 FORMAT "%8.6" DEPOSIT ABSOLUTE /end AXIS_DESCR
/end CHARACTERISTIC
/begin CHARACTERISTIC FFUPSRLTN "Minimum factor fupsrl due to model tolerances" VALUE 0x80505C88 RB_Val_Wu16 1.999969 fak_uw_b2 0.00 1.999969 FORMAT "%8.6" /end CHARACTERISTIC
/begin CHARACTERISTIC FFUPSRLTX "Maximum factor fupsrl due to model tolerances" VALUE 0x80505C8A RB_Val_Wu16 1.999969 fak_uw_b2 0.00 1.999969 FORMAT "%8.6" /end CHARACTERISTIC
/begin CHARACTERISTIC FGDPSMPDVS "weighting factor extrap. manifold pressure / manifold pressure of throttle" VALUE 0x805074B8 RB_Val_Wu16 0.6999817 fak_uw_b1 0.3000031 0.9999847 FORMAT "%9.7" EXTENDED_LIMITS 0.00 0.9999847 /end CHARACTERISTIC
/begin CHARACTERISTIC FHORLVPSVD "Factor correction by altitude dependig on ratio intake manifold preassure to preassure upstream throttle valve" CURVE 0x805074D0 RB_Curve_U16_U8_Static 0.9961 fak_ub_b1 0.00 0.9961
 /begin AXIS_DESCR STD_AXIS vpsrvdk_w_msg fak_uw_b2 6 0.00 1.999969 FORMAT "%8.6" DEPOSIT ABSOLUTE /end AXIS_DESCR
/end CHARACTERISTIC
/begin CHARACTERISTIC FIMXFADK "Factor for interpolation to pulsation correction for wide opend throttle" CURVE 0x80505C8C RB_Curve_S16_U16_Static 1.999969 fak_uw_b2 0.00 1.999969 FORMAT "%8.6"
 /begin AXIS_DESCR STD_AXIS ThrVlv_ratActPosnB1 rel_q0p0078125 10 -256.0000 255.9922 FORMAT "%8.4" DEPOSIT ABSOLUTE /end AXIS_DESCR
/end CHARACTERISTIC
/begin CHARACTERISTIC FIMXVP "Interpolation factor for pulsation correction depending on pressure ration at throttle valve" CURVE 0x80505CB6 RB_Curve_U16_U16 1.000000 fak_uw_b2 0.00 1.000000 FORMAT "%8.6" EXTENDED_LIMITS 0.00 1.999969
 /begin AXIS_DESCR STD_AXIS vpsrvdk_w_msg fak_uw_b2 10 0.00 1.999969 FORMAT "%8.6" DEPOSIT ABSOLUTE /end AXIS_DESCR
/end CHARACTERISTIC
/begin CHARACTERISTIC FIMXVPVHE "Interpolation factor for pulsation correction depending on pressure ration at throttle valve for operation points with gas exchange valves on 2nd inlet valve lift" CURVE 0x80505CE0 RB_Curve_U16_U16 1.000000 fak_uw_b2 0.00 1.000000 FORMAT "%8.6" EXTENDED_LIMITS 0.00 1.999969
 /begin AXIS_DESCR STD_AXIS vpsrvdk_w_msg fak_uw_b2 10 0.00 1.999969 FORMAT "%8.6" DEPOSIT ABSOLUTE /end AXIS_DESCR
/end CHARACTERISTIC
/begin CHARACTERISTIC FIUWMSDKVHEKXN "Portion of the overtravel as of which the maximum mass flow flows, small cam" CURVE 0x80506FF2 RB_Curve_S16_U16_Static 1.999969 fak_q3p0518Em5 0.00 1.999969 FORMAT "%8.6"
 /begin AXIS_DESCR STD_AXIS ChrCtl_nEngCorrd EngN 5 -16384.00 16383.50 FORMAT "%8.2" DEPOSIT ABSOLUTE /end AXIS_DESCR
/end CHARACTERISTIC
/begin CHARACTERISTIC FIUWMSDKXN "Portion of the overtravel as of which the maximum mass flow flows" CURVE 0x80507008 RB_Curve_S16_U16_Static 1.999969 fak_uw_b2 0.00 1.999969 FORMAT "%8.6"
 /begin AXIS_DESCR STD_AXIS ChrCtl_nEngCorrd EngN 5 -16384.00 16383.50 FORMAT "%8.2" DEPOSIT ABSOLUTE /end AXIS_DESCR
/end CHARACTERISTIC
/begin CHARACTERISTIC FKMSDKMN "low limit for fast mass-flow correction of throttle valve" VALUE 0x8050591C RB_Val_Wu16 3.999939 fak_q6p1035Em5 0.00 3.999939 FORMAT "%8.6" /end CHARACTERISTIC
/begin CHARACTERISTIC FKMSDKMX "high limit for fast mass-flow correction of throttle valve" VALUE 0x8050591E RB_Val_Wu16 3.999939 fak_q6p1035Em5 0.00 3.999939 FORMAT "%8.6" /end CHARACTERISTIC
/begin CHARACTERISTIC FKPVDKMN "lower limit for mass-flow correction of throttle valve" VALUE 0x80505920 RB_Val_Wu16 3.999939 fak_q6p1035Em5 0.00 3.999939 FORMAT "%8.6" /end CHARACTERISTIC
/begin CHARACTERISTIC FKPVDKMSMN "Threshold normed desireds air mass flow for enable adaption of fkpvdk" VALUE 0x80505922 RB_Val_Wu16 6553.500 m_q0p1 0.00 6553.500 FORMAT "%8.3" /end CHARACTERISTIC
/begin CHARACTERISTIC FKPVDKMX "high limit for mass-flow correction of throttle valve" VALUE 0x80505924 RB_Val_Wu16 3.999939 fak_q6p1035Em5 0.00 3.999939 FORMAT "%8.6" /end CHARACTERISTIC
/begin CHARACTERISTIC FKPVDKPMN "pressure ration for enable adaption of fkpvdk" VALUE 0x80505926 RB_Val_Wu16 1.999969 fak_uw_b2 0.00 1.999969 FORMAT "%8.6" /end CHARACTERISTIC
/begin CHARACTERISTIC FKPVDKPUGD "Press. ratio from which on fkpvdk_w will not be calculated anymore" VALUE 0x80505928 RB_Val_Wu16 1.999969 fak_uw_b2 0.00 1.999969 FORMAT "%8.6" /end CHARACTERISTIC
/begin CHARACTERISTIC FKRLXVL "correction factor maximum air charge at full load" VALUE 0x80507432 RB_Val_Wu16 1.200012 fak_uw_b2 0.00 1.200012 FORMAT "%8.6" EXTENDED_LIMITS 0.00 1.999969 /end CHARACTERISTIC
/begin CHARACTERISTIC FKVDVP "characteristic of Saint-Venant" CURVE 0x8050701E RB_FixCurve_U16_U16 1.999969 fak_uw_b2 0.00 1.999969 FORMAT "%8.6" READ_ONLY
 /begin AXIS_DESCR FIX_AXIS vpsrvdb_w_msg fak_uw_b2 30 0.5000000 0.9531250 FORMAT "%9.7" FIX_AXIS_PAR 16384 9 30 /end AXIS_DESCR
/end CHARACTERISTIC
/begin CHARACTERISTIC FMCO2L "Factor: mass CO2 per fuel liter (E0) in g/L" VALUE 0x8050597E RB_Val_Wu16 6553.500 m_q0p1_g_DIV_L 0.00 6553.500 FORMAT "%8.3" /end CHARACTERISTIC
/begin CHARACTERISTIC FMSNDKTN "Minimum factor msndk due to rise tolerances of the throttle valve" VALUE 0x8050705A RB_Val_Wu16 1.999969 fak_q3p0518Em5 0.00 1.999969 FORMAT "%8.6" /end CHARACTERISTIC
/begin CHARACTERISTIC FMSNDKTX "Maximum factor msndk due to rise tolerances of the throttle valve" VALUE 0x8050705C RB_Val_Wu16 1.999969 fak_q3p0518Em5 0.00 1.999969 FORMAT "%8.6" /end CHARACTERISTIC
/begin CHARACTERISTIC FMSPULSDKMN "Factor reduced massflow od throttle Valve through pulsations is max" VALUE 0x805071DE RB_Val_Wu16 1.999969 fak_uw_b2 0.00 1.999969 FORMAT "%8.6" /end CHARACTERISTIC
/begin CHARACTERISTIC FPSPULSMN "Factor reduced intake manifold pressure through pulsations is max" VALUE 0x805072D2 RB_Val_Wu16 1.999969 fak_q3p0518Em5 0.00 1.999969 FORMAT "%8.6" /end CHARACTERISTIC
/begin CHARACTERISTIC FPSPULSMX "Factor: Increased intake manifold pressure due to pulsations" VALUE 0x805072D4 RB_Val_Wu16 1.999969 fak_q3p0518Em5 0.00 1.999969 FORMAT "%8.6" /end CHARACTERISTIC
/begin CHARACTERISTIC FPVMXP "factor for pressure ratio maximum for load prediction" VALUE 0x805074BA RB_Val_Wu16 1.999969 fak_uw_b2 0.00 1.999969 FORMAT "%8.6" /end CHARACTERISTIC
/begin CHARACTERISTIC FPVMXP2 "factor for pressure ratio maximum for umlimited load predictiion" VALUE 0x805074BC RB_Val_Wu16 1.999969 fak_uw_b2 0.00 1.999969 FORMAT "%8.6" /end CHARACTERISTIC
/begin CHARACTERISTIC FPVMXST "factor for pressure ratio at cranking" VALUE 0x805072D6 RB_Val_Wu16 3.999939 fak_q6p1035Em5 0.00 3.999939 FORMAT "%8.6" /end CHARACTERISTIC
/begin CHARACTERISTIC FRIRLABBR "ratio of air mass to exhaust mass in case of stoichiometry (i.e. 14.7 divided by (1+14.7))" VALUE 0x80505988 RB_Val_Wu16 1.999969 fak_q3p0518Em5 0.00 1.999969 FORMAT "%8.6" /end CHARACTERISTIC
/begin CHARACTERISTIC FRLMNPU "correction factor rlmin depending on altitude" CURVE 0x80507306 RB_Curve_U16_U16 1.999969 fak_q3p0518Em5 0.00 1.999969 FORMAT "%8.6"
 /begin AXIS_DESCR STD_AXIS PEnv_p p_q0p039 5 0.00 2559.961 FORMAT "%8.3" DEPOSIT ABSOLUTE /end AXIS_DESCR
/end CHARACTERISTIC
/begin CHARACTERISTIC FRLMNTMOT "correction factor rlmin depending on engine temperature" CURVE 0x8050731C RB_Curve_S16_U16_Static 1.999969 fak_q3p0518Em5 0.00 1.999969 FORMAT "%8.6"
 /begin AXIS_DESCR STD_AXIS CEngDsT_t Temp_Cels 5 -3549.940 3003.560 FORMAT "%8.3" DEPOSIT ABSOLUTE /end AXIS_DESCR
/end CHARACTERISTIC
/begin CHARACTERISTIC FTMSDV "Characteristic curve: factor temperature C for mass flow (root)" CURVE 0x80505D0A RB_Curve_U16_U16 1.999939 fak_uw_b2 0.000031 1.999969 FORMAT "%8.6" EXTENDED_LIMITS 0.00 1.999969
 /begin AXIS_DESCR STD_AXIS NO_INPUT_QUANTITY temp_q0p0234_o273 16 -273.150 1262.827 FORMAT "%8.3" DEPOSIT ABSOLUTE /end AXIS_DESCR
/end CHARACTERISTIC
/begin CHARACTERISTIC FUPSRLMN "Calculation factor pressure to load minimum" VALUE 0x80505D4C RB_Val_Wu16 0.2999954 rel_uw_b0p3 0.00 0.2999954 FORMAT "%9.7" /end CHARACTERISTIC
/begin CHARACTERISTIC FUPSRLMX "Calculation factor pressure to load maximum" VALUE 0x80505D4E RB_Val_Wu16 0.2999954 rel_uw_b0p3 0.00 0.2999954 FORMAT "%9.7" /end CHARACTERISTIC
/begin CHARACTERISTIC FVBR "Fact. volume f. input angle to stroke volume of a cylinder" CURVE 0x80505D50 RB_Curve_S16_U16_Static 1.999969 fak_uw_b2 0.00 1.999969 FORMAT "%8.6"
 /begin AXIS_DESCR STD_AXIS GEVCtl_agIntkClsd kw_q0p0156 20 -512.0000 511.9844 FORMAT "%8.4" DEPOSIT ABSOLUTE /end AXIS_DESCR
/end CHARACTERISTIC
/begin CHARACTERISTIC InjSys_ratStoicPfi_C "Calibration for Stoichiometric ratio air fuel" VALUE 0x80505980 RB_Val_Wu16 31.99902 fak_q0p000488 0.00049 31.99951 FORMAT "%8.5" EXTENDED_LIMITS 0.00 31.99951 /end CHARACTERISTIC
/begin CHARACTERISTIC InjSys_rhoFuStd_C "Fuel density at standard conditions" VALUE 0x80505982 RB_Val_Wu16 6553.400 m_q0p1_g_DIV_L 0.100 6553.500 FORMAT "%8.3" EXTENDED_LIMITS 0.00 6553.500 /end CHARACTERISTIC
/begin CHARACTERISTIC InjSys_volCylPfi_C "Calibration for Cylinder Displacement Volume" VALUE 0x80505984 RB_Val_Wu16 3.276750 vol_q5p0Em5_l 0.00 3.276750 FORMAT "%8.6" /end CHARACTERISTIC
/begin CHARACTERISTIC KFDIPABERGVP "Delta interpolation factor for calculation of effective exhaust gas backpressure for model of internal EGR" MAP 0x80505DA2 RB_Map_U16S16_S16 2.999939 fak_sw_b2 -1.000000 1.999939 FORMAT "%8.6" EXTENDED_LIMITS -2.000000 1.999939
 /begin AXIS_DESCR STD_AXIS vpsab_w fak_uw_b4 10 0.00 3.999939 FORMAT "%8.6" DEPOSIT ABSOLUTE /end AXIS_DESCR
 /begin AXIS_DESCR STD_AXIS Epm_nEng10ms EngN 18 -16384.00 16383.50 FORMAT "%8.2" DEPOSIT ABSOLUTE /end AXIS_DESCR
/end CHARACTERISTIC
/begin CHARACTERISTIC KFDIPABERGVP1 "Delta interpolation factor for calculation of effective exhaust gas backpressure for model of internal EGR 1" MAP 0x80505F46 RB_Map_U16S16_S16 2.999939 fak_sw_b2 -1.000000 1.999939 FORMAT "%8.6" EXTENDED_LIMITS -2.000000 1.999939
 /begin AXIS_DESCR STD_AXIS vpsab_w fak_uw_b4 10 0.00 3.999939 FORMAT "%8.6" DEPOSIT ABSOLUTE /end AXIS_DESCR
 /begin AXIS_DESCR STD_AXIS Epm_nEng10ms EngN 18 -16384.00 16383.50 FORMAT "%8.2" DEPOSIT ABSOLUTE /end AXIS_DESCR
/end CHARACTERISTIC
/begin CHARACTERISTIC KFDPBRMXWE "map: correction value of fupsrl for wide opend trottle valve" MAP 0x805060EA RB_Map_S16S16_S16 0.9999847 fak_q1p526Em5 -0.5000000 0.4999847 FORMAT "%9.7"
 /begin AXIS_DESCR STD_AXIS GEVCtl_agIntkClsd kw_q0p0156 10 -512.0000 511.9844 FORMAT "%8.4" DEPOSIT ABSOLUTE /end AXIS_DESCR
 /begin AXIS_DESCR STD_AXIS nmottkor_w EngN 18 -16384.00 16383.50 FORMAT "%8.2" DEPOSIT ABSOLUTE /end AXIS_DESCR
/end CHARACTERISTIC
/begin CHARACTERISTIC KFDPBRMXWE1 "map: correction value of fupsrl for wide opend trottle valve flap1 active" MAP 0x8050628E RB_Map_S16S16_S16 0.9999847 fak_q1p526Em5 -0.5000000 0.4999847 FORMAT "%9.7"
 /begin AXIS_DESCR STD_AXIS GEVCtl_agIntkClsd kw_q0p0156 10 -512.0000 511.9844 FORMAT "%8.4" DEPOSIT ABSOLUTE /end AXIS_DESCR
 /begin AXIS_DESCR STD_AXIS nmottkor_w EngN 18 -16384.00 16383.50 FORMAT "%8.2" DEPOSIT ABSOLUTE /end AXIS_DESCR
/end CHARACTERISTIC
/begin CHARACTERISTIC KFDPBRMXWU1 "map: correction value of fupsrl for wide opend trottle valve adressed by valve overlap flap1 active" MAP 0x80506432 RB_Map_S16S16_S16 0.9999847 fak_q1p526Em5 -0.5000000 0.4999847 FORMAT "%9.7"
 /begin AXIS_DESCR STD_AXIS wgvum_w_msg kw_q0p0156 10 -512.0000 511.9844 FORMAT "%8.4" DEPOSIT ABSOLUTE /end AXIS_DESCR
 /begin AXIS_DESCR STD_AXIS nmottkor_w EngN 18 -16384.00 16383.50 FORMAT "%8.2" DEPOSIT ABSOLUTE /end AXIS_DESCR
/end CHARACTERISTIC
/begin CHARACTERISTIC KFDPBRWE "map: correction value of fupsrl" MAP 0x805065D6 RB_Map_S16S16_S16 0.9999847 fak_q1p526Em5 -0.5000000 0.4999847 FORMAT "%9.7"
 /begin AXIS_DESCR STD_AXIS GEVCtl_agIntkClsd kw_q0p0156 10 -512.0000 511.9844 FORMAT "%8.4" DEPOSIT ABSOLUTE /end AXIS_DESCR
 /begin AXIS_DESCR STD_AXIS nmottkor_w EngN 18 -16384.00 16383.50 FORMAT "%8.2" DEPOSIT ABSOLUTE /end AXIS_DESCR
/end CHARACTERISTIC
/begin CHARACTERISTIC KFDPBRWE1 "map: correction value of fupsrl flap1 activ" MAP 0x8050677A RB_Map_S16S16_S16 0.9999847 fak_q1p526Em5 -0.5000000 0.4999847 FORMAT "%9.7"
 /begin AXIS_DESCR STD_AXIS GEVCtl_agIntkClsd kw_q0p0156 10 -512.0000 511.9844 FORMAT "%8.4" DEPOSIT ABSOLUTE /end AXIS_DESCR
 /begin AXIS_DESCR STD_AXIS nmottkor_w EngN 18 -16384.00 16383.50 FORMAT "%8.2" DEPOSIT ABSOLUTE /end AXIS_DESCR
/end CHARACTERISTIC
/begin CHARACTERISTIC KFFPBRKSVN "Map slope correction for the adaption of intake manifold pressure to air pressure in the combustion chamber" MAP 0x8050691E RB_Map_U16S16_S16 3.999939 fak_sw_b2 -2.000000 1.999939 FORMAT "%8.6"
 /begin AXIS_DESCR STD_AXIS vpsrpuakt_w fak_uw_b4 18 0.00 3.999939 FORMAT "%8.6" DEPOSIT ABSOLUTE /end AXIS_DESCR
 /begin AXIS_DESCR STD_AXIS nmotsw_w EngN 12 -16384.00 16383.50 FORMAT "%8.2" DEPOSIT ABSOLUTE /end AXIS_DESCR
/end CHARACTERISTIC
/begin CHARACTERISTIC KFFPBRKSVN1 "Map slope correction for the adaption of intake manifold pressure to air pressure in the combustion chamber 1" MAP 0x80506B0E RB_Map_U16S16_S16 3.999939 fak_sw_b2 -2.000000 1.999939 FORMAT "%8.6"
 /begin AXIS_DESCR STD_AXIS vpsrpuakt_w fak_uw_b4 18 0.00 3.999939 FORMAT "%8.6" DEPOSIT ABSOLUTE /end AXIS_DESCR
 /begin AXIS_DESCR STD_AXIS nmotsw_w EngN 12 -16384.00 16383.50 FORMAT "%8.2" DEPOSIT ABSOLUTE /end AXIS_DESCR
/end CHARACTERISTIC
/begin CHARACTERISTIC KFIPABERG "Interpolation factor for calculation of effective exhaust gas backpressure for model of internal EGR" MAP 0x80506CFE RB_Map_S16S16_S16 2.999939 fak_sw_b2 -1.000000 1.999939 FORMAT "%8.6" EXTENDED_LIMITS -2.000000 1.999939
 /begin AXIS_DESCR STD_AXIS wgvum_w_msg kw_q0p0156 10 -512.0000 511.9844 FORMAT "%8.4" DEPOSIT ABSOLUTE /end AXIS_DESCR
 /begin AXIS_DESCR STD_AXIS nmotsw_w EngN 18 -16384.00 16383.50 FORMAT "%8.2" DEPOSIT ABSOLUTE /end AXIS_DESCR
/end CHARACTERISTIC
/begin CHARACTERISTIC KFMSNWDKVP "standardised air mass flow through throttle valve" MAP 0x8050705E RB_Map_U16U16_U16 6553.500 m_q0p1 0.00 6553.500 FORMAT "%8.3"
 /begin AXIS_DESCR STD_AXIS NO_INPUT_QUANTITY rel_uw_b100 18 0.00 99.99847 FORMAT "%8.5" DEPOSIT ABSOLUTE /end AXIS_DESCR
 /begin AXIS_DESCR STD_AXIS vpsrvdb_w_msg fak_uw_b2 8 0.00 1.999969 FORMAT "%8.6" DEPOSIT ABSOLUTE /end AXIS_DESCR
/end CHARACTERISTIC
/begin CHARACTERISTIC KFTEIRLRLSN "Map time constants for stabalization of rlrlsol" MAP 0x805071E0 RB_Map_S16S16_U16 65.51500 t_q0p001 0.02000 65.53500 FORMAT "%8.5" EXTENDED_LIMITS 0.00 65.53500
 /begin AXIS_DESCR STD_AXIS Epm_nEng EngN 5 -16384.00 16383.50 FORMAT "%8.2" DEPOSIT ABSOLUTE /end AXIS_DESCR
 /begin AXIS_DESCR STD_AXIS drlm_w_msg rel_q0p02344 5 -768.0000 767.9766 FORMAT "%8.4" DEPOSIT ABSOLUTE /end AXIS_DESCR
/end CHARACTERISTIC
/begin CHARACTERISTIC KLFPBRGRVIVC "combustion chamber pressure balance correction for inlet calve closing" CURVE 0x80506EA2 RB_Curve_S16_U16_Static 1.999969 fak_uw_b2 0.00 1.999969 FORMAT "%8.6"
 /begin AXIS_DESCR STD_AXIS grfvbr_w fak_sw_q64 12 -512.0000 511.9844 FORMAT "%8.4" DEPOSIT ABSOLUTE /end AXIS_DESCR
/end CHARACTERISTIC
/begin CHARACTERISTIC KLFPBRGRVIVCVHE "combustion chamber pressure balance correction for operation points with gas exchange valves on 2nd inlet valve lift for inlet valve closing" CURVE 0x80506ED4 RB_Curve_S16_U16_Static 1.999969 fak_uw_b2 0.00 1.999969 FORMAT "%8.6"
 /begin AXIS_DESCR STD_AXIS grfvbr_w fak_sw_q64 12 -512.0000 511.9844 FORMAT "%8.4" DEPOSIT ABSOLUTE /end AXIS_DESCR
/end CHARACTERISTIC
/begin CHARACTERISTIC KLGRFVBRWVHE "volume change of cumbustion chamber at inlet valve closing for operation points with gas exchange valves on 2nd inlet valve lift" CURVE 0x80506F06 RB_Curve_S16_S16 63.99902 vol_q9p766Em4_L -32.00000 31.99902 FORMAT "%8.5"
 /begin AXIS_DESCR STD_AXIS GEVCtl_agIntkClsd kw_q0p0156 20 -512.0000 511.9844 FORMAT "%8.4" DEPOSIT ABSOLUTE /end AXIS_DESCR
/end CHARACTERISTIC
/begin CHARACTERISTIC KLMXRLAPIG "maximum air charge limitation to avoid Pre-ignition on low-speed and high-load condition" CURVE 0x80507434 RB_Curve_S16_U16_Static 1535.977 rel_uw_q0p0234 0.00 1535.977 FORMAT "%8.3"
 /begin AXIS_DESCR STD_AXIS NO_INPUT_QUANTITY EngN 10 -16384.00 16383.50 FORMAT "%8.2" DEPOSIT ABSOLUTE /end AXIS_DESCR
/end CHARACTERISTIC
/begin CHARACTERISTIC KLREDOSP "Characteristic line to reduce overshoot problem for prediction psr_w to end of segment" CURVE 0x8050728A RB_Curve_S16_U16_Static 1.999969 fak_uw_b2 0.00 1.999969 FORMAT "%8.6"
 /begin AXIS_DESCR STD_AXIS Epm_nEng EngN 4 -16384.00 16383.50 FORMAT "%8.2" DEPOSIT ABSOLUTE /end AXIS_DESCR
/end CHARACTERISTIC
/begin CHARACTERISTIC KLTANSCRF "Tempetrature correction based on tans" CURVE 0x8050745E RB_Curve_U8_U16_Static 1.999969 fak_uw_b2 0.00 1.999969 FORMAT "%8.6"
 /begin AXIS_DESCR STD_AXIS tans_msg temp_ub_q0p75_o48 6 -48.0 143.3 FORMAT "%5.1" DEPOSIT ABSOLUTE /end AXIS_DESCR
/end CHARACTERISTIC
/begin CHARACTERISTIC KLTMOTCRF "Tempetrature correction based on tmot" CURVE 0x80507472 RB_Curve_S16_U16_Static 1.999969 fak_uw_b2 0.00 1.999969 FORMAT "%8.6"
 /begin AXIS_DESCR STD_AXIS CEngDsT_t Temp_Cels 6 -3549.940 3003.560 FORMAT "%8.3" DEPOSIT ABSOLUTE /end AXIS_DESCR
/end CHARACTERISTIC
/begin CHARACTERISTIC KLTPPSRIFD "lowpass filter psrif_w" CURVE 0x8050729C RB_Curve_U16_U16 1.999969 fak_q3p0518Em5 0.00 1.999969 FORMAT "%8.6"
 /begin AXIS_DESCR STD_AXIS fdpslma_w fak_q3p0518Em5 5 0.00 1.999969 FORMAT "%8.6" DEPOSIT ABSOLUTE /end AXIS_DESCR
/end CHARACTERISTIC
/begin CHARACTERISTIC KLTPPSRIFH "lowpass filter psrif_w in Half Engine Mode" CURVE 0x805072B2 RB_Curve_U16_U16 1.999969 fak_q3p0518Em5 0.00 1.999969 FORMAT "%8.6"
 /begin AXIS_DESCR STD_AXIS fdpslma_w fak_q3p0518Em5 5 0.00 1.999969 FORMAT "%8.6" DEPOSIT ABSOLUTE /end AXIS_DESCR
/end CHARACTERISTIC
/begin CHARACTERISTIC KLVPSPVDMNFASA "Curve: correction in pressure ratio threshold due to a big leakage into intake manifold" CURVE 0x8050592A RB_Curve_S16_U16_Static 1.999969 fak_uw_b2 0.00 1.999969 FORMAT "%8.6"
 /begin AXIS_DESCR STD_AXIS Epm_nEng EngN 5 -16384.00 16383.50 FORMAT "%8.2" DEPOSIT ABSOLUTE /end AXIS_DESCR
/end CHARACTERISTIC
/begin CHARACTERISTIC KMSDK "gain factor for filtering msdk" VALUE 0x805071B6 RB_Val_Wu16 7.999878 fak_q1p22Em4 0.00 7.999878 FORMAT "%8.6" /end CHARACTERISTIC
/begin CHARACTERISTIC KUMSIRL "conversion constant from mass flow to relative air charge" VALUE 0x805072EE RB_Val_Wu16 0.003999938965 kumsrl_uw_b0p004 0.00 0.003999938965 FORMAT "%14.12" /end CHARACTERISTIC
/begin CHARACTERISTIC LASTCMN "Lower bound for stoichiometric lambda" VALUE 0x8050598A RB_Val_Wu16 15.99976 fak_q0p000244 0.00 15.99976 FORMAT "%8.5" /end CHARACTERISTIC
/begin CHARACTERISTIC LASTCMX "Upper bound for stoichiometric lambda" VALUE 0x8050598C RB_Val_Wu16 15.99976 fak_q0p000244 0.00 15.99976 FORMAT "%8.5" /end CHARACTERISTIC
/begin CHARACTERISTIC MSNRIRSP "Curve stand. mass flow of re-asp. inert gas" CURVE 0x80506F58 RB_Curve_S16_U16_Static 204.7969 m_q0p0031 0.00 204.7969 FORMAT "%8.4"
 /begin AXIS_DESCR STD_AXIS wgvum_w_msg kw_sw_q0p0156 10 -512.00000 511.98438 DEPOSIT ABSOLUTE /end AXIS_DESCR
/end CHARACTERISTIC
/begin CHARACTERISTIC MTOLMSTE "Massflow tolerance of TEV massflow" CURVE 0x80505940 RB_Curve_U8_U8 25.50 m_ub_b25p6 0.00 25.50 FORMAT "%5.2"
 /begin AXIS_DESCR STD_AXIS mste_msg m_ub_b25p6 6 0.00 25.50 FORMAT "%5.2" DEPOSIT ABSOLUTE /end AXIS_DESCR
/end CHARACTERISTIC
/begin CHARACTERISTIC MXVVVEKN "Map maximum compression ratio for low lift" CURVE 0x80507248 RB_Curve_S16_U16_Static 7.999878 fak_uw_b8 0.00 7.999878 FORMAT "%8.6"
 /begin AXIS_DESCR STD_AXIS Epm_nEng EngN 16 -16384.00 16383.50 FORMAT "%8.2" DEPOSIT ABSOLUTE /end AXIS_DESCR
/end CHARACTERISTIC
/begin CHARACTERISTIC NDKADVSLMX "max. speed, for disable strat. mode, if throttle not adapted" VALUE 0x8050594D RB_Val_Wu8 10200. EngN_LRes 0.00 10200. FORMAT "%5.0" /end CHARACTERISTIC
/begin CHARACTERISTIC NMOTFADKMN "engine speed for enable adaption of fkpvdk(min)" VALUE 0x8050594E RB_Val_Ws16 32767.50 EngN -16384.00 16383.50 FORMAT "%8.2" /end CHARACTERISTIC
/begin CHARACTERISTIC NMOTFADKMX "engine speed for enable adaption of fkpvdk(max)" VALUE 0x80505950 RB_Val_Ws16 32767.50 EngN -16384.00 16383.50 FORMAT "%8.2" /end CHARACTERISTIC
/begin CHARACTERISTIC NMOTOFDKMN "Engine speed for enable adaptation of ofmsndk min." VALUE 0x80505952 RB_Val_Ws16 32767.50 EngN -16384.00 16383.50 FORMAT "%8.2" /end CHARACTERISTIC
/begin CHARACTERISTIC NMOTOFDKMN2 "Engine speed for enable adaptation of ofmsndk minimum (in window region 2)" VALUE 0x80505954 RB_Val_Ws16 32767.50 EngN -16384.00 16383.50 FORMAT "%8.2" /end CHARACTERISTIC
/begin CHARACTERISTIC NMOTOFDKMX "Engine speed for enable adaptation of ofmsndk max." VALUE 0x80505956 RB_Val_Ws16 32767.50 EngN -16384.00 16383.50 FORMAT "%8.2" /end CHARACTERISTIC
/begin CHARACTERISTIC NMOTOFDKMX2 "Engine speed for enable adaptation of ofmsndk maximum (in window region 2)" VALUE 0x80505958 RB_Val_Ws16 32767.50 EngN -16384.00 16383.50 FORMAT "%8.2" /end CHARACTERISTIC
/begin CHARACTERISTIC NMOTRLNBKV "treshold for engine speed for rlmin calculation for break booster support" VALUE 0x80507332 RB_Val_Ws16 32767.50 EngN -16384.00 16383.50 FORMAT "%8.2" /end CHARACTERISTIC
/begin CHARACTERISTIC NPNDKGMN "engine speed limit for calculating pressure in syn for pressure downstream trottle valve" VALUE 0x80507246 RB_Val_Ws16 32767.50 EngN -16384.00 16383.50 FORMAT "%8.2" /end CHARACTERISTIC
/begin CHARACTERISTIC NPSRSEG "Engine speed threshold for switching to segment raster" VALUE 0x805072C8 RB_Val_Ws16 16383.50 EngN 0.00 16383.50 FORMAT "%8.2" EXTENDED_LIMITS -16384.00 16383.50 /end CHARACTERISTIC
/begin CHARACTERISTIC NPULSMN "engine speed limit where pulsation at manifold appears" VALUE 0x805072CA RB_Val_Ws16 16383.50 EngN 0.00 16383.50 FORMAT "%8.2" EXTENDED_LIMITS -16384.00 16383.50 /end CHARACTERISTIC
/begin CHARACTERISTIC NRLMN "lowest engine speed for calculation of umsrln" VALUE 0x8050722A RB_Val_Wu16 8191.500 nmot_q0p25 0.250 8191.750 FORMAT "%8.3" EXTENDED_LIMITS 0.00 16383.75 /end CHARACTERISTIC
/begin CHARACTERISTIC OFMSNDKINI "Initialisation value normized massflow through throttle blade" VALUE 0x8050595A RB_Val_Ws16 6553.500 m_q0p1 -3276.800 3276.700 FORMAT "%8.3" /end CHARACTERISTIC
/begin CHARACTERISTIC OFMSNDKINI2 "Initialisation value normized massflow through throttle blade in second adaptation region" VALUE 0x8050595C RB_Val_Ws16 6553.500 m_q0p1 -3276.800 3276.700 FORMAT "%8.3" /end CHARACTERISTIC
/begin CHARACTERISTIC OFMSNDKMN "minimum value offset norm air mass flow through throttle" VALUE 0x8050595E RB_Val_Ws16 6553.500 m_q0p1 -3276.800 3276.700 FORMAT "%8.3" /end CHARACTERISTIC
/begin CHARACTERISTIC OFMSNDKMN2 "minimum value offset norm air mass flow through throttle (window region 2)" VALUE 0x80505960 RB_Val_Ws16 6553.500 m_q0p1 -3276.800 3276.700 FORMAT "%8.3" /end CHARACTERISTIC
/begin CHARACTERISTIC OFMSNDKMX "maximum value offset norm air mass flow through throttle" VALUE 0x80505962 RB_Val_Ws16 6553.500 m_q0p1 -3276.800 3276.700 FORMAT "%8.3" /end CHARACTERISTIC
/begin CHARACTERISTIC OFMSNDKMX2 "maximum value offset norm air mass flow through throttle (window region 2)" VALUE 0x80505964 RB_Val_Ws16 6553.500 m_q0p1 -3276.800 3276.700 FORMAT "%8.3" /end CHARACTERISTIC
/begin CHARACTERISTIC OFMSNDKTN "min. leakage of throttle blade for model based diagnosis" VALUE 0x805071B8 RB_Val_Ws16 6553.500 m_q0p1 -3276.800 3276.700 FORMAT "%8.3" /end CHARACTERISTIC
/begin CHARACTERISTIC OFMSNDKTX "max. leakage of throttle blade for model based diagnosis" VALUE 0x805071BA RB_Val_Ws16 6553.500 m_q0p1 -3276.800 3276.700 FORMAT "%8.3" /end CHARACTERISTIC
/begin CHARACTERISTIC OFMSNDMSMN "Threshold normed desireds air mass flow for enable adaption of ofmsndk" VALUE 0x80505966 RB_Val_Wu16 6553.500 m_q0p1 0.00 6553.500 FORMAT "%8.3" /end CHARACTERISTIC
/begin CHARACTERISTIC OFMSNDMSMN2 "Threshold normed desired air mass flow for enable adaption of ofmsndk (in window region 2)" VALUE 0x80505968 RB_Val_Wu16 6553.500 m_q0p1 0.00 6553.500 FORMAT "%8.3" /end CHARACTERISTIC
/begin CHARACTERISTIC OFMSNDMSMX "Maximum threshold normed desireds air mass flow for enable adaption of ofmsndk" VALUE 0x8050596A RB_Val_Wu16 6553.500 m_q0p1 0.00 6553.500 FORMAT "%8.3" /end CHARACTERISTIC
/begin CHARACTERISTIC OFMSNDMSMX2 "Maximum threshold normed desireds air mass flow for enable adaption of ofmsndk (in window region 2)" VALUE 0x8050596C RB_Val_Wu16 6553.500 m_q0p1 0.00 6553.500 FORMAT "%8.3" /end CHARACTERISTIC
/begin CHARACTERISTIC OFMSNDMSMX3 "Maximum threshold normed desired air mass flow for back interpolation to ofmsndk in window region 1" VALUE 0x8050596E RB_Val_Wu16 6553.500 m_q0p1 0.00 6553.500 FORMAT "%8.3" /end CHARACTERISTIC
/begin CHARACTERISTIC PBRINTMN "partial pressure residual gas in chamber minimum" VALUE 0x80506F82 RB_Val_Wu16 2559.961 p_uw_q0p039 0.00 2559.961 FORMAT "%8.3" /end CHARACTERISTIC
/begin CHARACTERISTIC PBRINTMX "partial pressure residual gas in chamber maximum" VALUE 0x80506F84 RB_Val_Wu16 2559.961 p_uw_q0p039 0.00 2559.961 FORMAT "%8.3" /end CHARACTERISTIC
/begin CHARACTERISTIC PIntkVUs_tiSwtFilPrm_C "time, other filterparameter are used in case of change of the intake valve lift" VALUE 0x805072CC RB_Val_Wu16 655.3500 t_q0p01 0.00 655.3500 FORMAT "%8.4" /end CHARACTERISTIC
/begin CHARACTERISTIC PSREMN "Min. replacement value for intake manifold pressure" VALUE 0x805072D8 RB_Val_Wu16 5119.922 p_q0p078 0.00 5119.922 FORMAT "%8.3" /end CHARACTERISTIC
/begin CHARACTERISTIC PSREMX "Max. replacement value for intake manifold pressure" VALUE 0x805072DA RB_Val_Wu16 5119.922 p_q0p078 0.00 5119.922 FORMAT "%8.3" /end CHARACTERISTIC
/begin CHARACTERISTIC RLMNDSAN "Characteristic minimum charge at deactivated fuel cut-off" CURVE 0x80507334 RB_Curve_S16_U16_Static 1535.977 rel_q0p02344 0.00 1535.977 FORMAT "%8.3"
 /begin AXIS_DESCR STD_AXIS Epm_nEng EngN 12 -16384.00 16383.50 FORMAT "%8.2" DEPOSIT ABSOLUTE /end AXIS_DESCR
/end CHARACTERISTIC
/begin CHARACTERISTIC RLMNN "characteristic minimum charge" CURVE 0x80507366 RB_Curve_S16_U16_Static 1535.977 rel_q0p02344 0.00 1535.977 FORMAT "%8.3"
 /begin AXIS_DESCR STD_AXIS Epm_nEng EngN 12 -16384.00 16383.50 FORMAT "%8.2" DEPOSIT ABSOLUTE /end AXIS_DESCR
/end CHARACTERISTIC
/begin CHARACTERISTIC RLMNSABKV "rlmin for break booster support" VALUE 0x80507398 RB_Val_Wu16 1535.977 rel_q0p02344 0.00 1535.977 FORMAT "%8.3" /end CHARACTERISTIC
/begin CHARACTERISTIC RLMNSAN "characteristic minimum charge in overrun" CURVE 0x8050739A RB_Curve_S16_U16_Static 1535.977 rel_q0p02344 0.00 1535.977 FORMAT "%8.3"
 /begin AXIS_DESCR STD_AXIS Epm_nEng EngN 12 -16384.00 16383.50 FORMAT "%8.2" DEPOSIT ABSOLUTE /end AXIS_DESCR
/end CHARACTERISTIC
/begin CHARACTERISTIC RLMNVHEKN "Characteristic minimum charge(small valve lift)" CURVE 0x805073CC RB_Curve_S16_U16_Static 1535.977 rel_q0p02344 0.00 1535.977 FORMAT "%8.3"
 /begin AXIS_DESCR STD_AXIS Epm_nEng EngN 12 -16384.00 16383.50 FORMAT "%8.2" DEPOSIT ABSOLUTE /end AXIS_DESCR
/end CHARACTERISTIC
/begin CHARACTERISTIC RLMNVHEKSAN "Characteristic minimum charge in overrun(small valve lift)" CURVE 0x805073FE RB_Curve_S16_U16_Static 1535.977 rel_q0p02344 0.00 1535.977 FORMAT "%8.3"
 /begin AXIS_DESCR STD_AXIS Epm_nEng EngN 12 -16384.00 16383.50 FORMAT "%8.2" DEPOSIT ABSOLUTE /end AXIS_DESCR
/end CHARACTERISTIC
/begin CHARACTERISTIC RLNOT "limp-home relative air charge rl in case of E_DK and E_LM" CURVE 0x805072F0 RB_Curve_U8_U16_Static 1535.977 rel_uw_q0p0234 0.00 1535.977 FORMAT "%8.3"
 /begin AXIS_DESCR STD_AXIS Epm_nEngLRes EngN_LRes 6 0.00 10200. FORMAT "%5.0" DEPOSIT ABSOLUTE /end AXIS_DESCR
/end CHARACTERISTIC
/begin CHARACTERISTIC RLSOLAP "desired relative air charge (application mode)" VALUE 0x805074E4 RB_Val_Wu16 1535.977 rel_q0p02344 0.00 1535.977 FORMAT "%8.3" /end CHARACTERISTIC
/begin CHARACTERISTIC RLSOLAPW "rlsol-demand by characteristic line for application" CURVE 0x805074E6 RB_Curve_S16_U16_Static 1535.977 rel_q0p02344 0.00 1535.977 FORMAT "%8.3"
 /begin AXIS_DESCR STD_AXIS APP_r Prc 6 -400.0000 399.9878 FORMAT "%8.4" DEPOSIT ABSOLUTE /end AXIS_DESCR
/end CHARACTERISTIC
/begin CHARACTERISTIC RVBRVL "relative volume of combustion chamber at full load" CURVE 0x8050748C RB_Curve_U8_U16_Static 199.9922 rel_uw_q0p0234 0.00 199.9922 FORMAT "%8.4" EXTENDED_LIMITS 0.00 1535.977
 /begin AXIS_DESCR STD_AXIS Epm_nEngLRes EngN_LRes 12 0.00 10200. FORMAT "%5.0" DEPOSIT ABSOLUTE /end AXIS_DESCR
/end CHARACTERISTIC
/begin CHARACTERISTIC SAPSRR "Startvalue fade in adaption psrr_w" VALUE 0x805072CE RB_Val_Wu16 5119.922 p_q0p078 0.00 5119.922 FORMAT "%8.3" /end CHARACTERISTIC
/begin CHARACTERISTIC TAFKPVDKE "delay time for condition adaption fkpvdk in steady-state" VALUE 0x80505970 RB_Val_Wu8 25.50 t_q0p1 0.00 25.50 FORMAT "%5.2" /end CHARACTERISTIC
/begin CHARACTERISTIC TAOFMSNDKE "Time constant for determining leakage air adaptation throttle valve steady" VALUE 0x80505971 RB_Val_Wu8 25.50 t_q0p1 0.00 25.50 FORMAT "%5.2" /end CHARACTERISTIC
/begin CHARACTERISTIC TASRMEW "substitude value for modelled intake manifold temperature" VALUE 0x80507502 RB_Val_Wu16 1535.977 temp_q0p0234_o273 -273.150 1262.827 FORMAT "%8.3" /end CHARACTERISTIC
/begin CHARACTERISTIC TAVDKMEW "substitude value for temperature upstream throttle" VALUE 0x80507506 RB_Val_Wu16 1535.977 temp_q0p0234_o273 -273.150 1262.827 FORMAT "%8.3" /end CHARACTERISTIC
/begin CHARACTERISTIC TDABGLST "Delay enable adjustment after cranking" VALUE 0x80505972 RB_Val_Wu16 655.3500 t_q0p01 0.00 655.3500 FORMAT "%8.4" /end CHARACTERISTIC
/begin CHARACTERISTIC TDDTEVFGAB "Time delay after %DTEV for enabling of throttle adaption" VALUE 0x80505974 RB_Val_Wu16 655.3500 t_q0p01 0.00 655.3500 FORMAT "%8.4" /end CHARACTERISTIC
/begin CHARACTERISTIC TDMWRLSTA "time delay mode change rl-stationary" VALUE 0x80507500 RB_Val_Wu8 5.100 t_q0p02 0.00 5.100 FORMAT "%5.3" /end CHARACTERISTIC
/begin CHARACTERISTIC TDMWRLSTADYN "time delay mode change rl-stationary at dynamic driver demand" VALUE 0x80507501 RB_Val_Wu8 5.100 t_q0p02 0.00 5.100 FORMAT "%5.3" /end CHARACTERISTIC
/begin CHARACTERISTIC TDRLNBKV "time delay for rlmin for break booster support" VALUE 0x80507430 RB_Val_Wu8 2.550 t_q0p01 0.00 2.550 FORMAT "%5.3" /end CHARACTERISTIC
/begin CHARACTERISTIC TDRLRLPMAX "Debounce time for steady state condition of delta of relative air charge and predicted relative air charge" VALUE 0x805074BE RB_Val_Wu16 655.3500 t_q0p01 0.00 655.3500 FORMAT "%8.4" /end CHARACTERISTIC
/begin CHARACTERISTIC TDSAFGABGL "Time delay after Bit B_sa for enabling of throttle adaption" VALUE 0x80505976 RB_Val_Wu16 655.3500 t_q0p01 0.00 655.3500 FORMAT "%8.4" /end CHARACTERISTIC
/begin CHARACTERISTIC TDSAOFMNDP "Time delay after Bit B_sa for enabling B_ofmsndkp" VALUE 0x80505978 RB_Val_Wu16 6553.500 t_q0p1 0.00 6553.500 FORMAT "%8.3" /end CHARACTERISTIC
/begin CHARACTERISTIC TDWDKSUGD "delay time for B_wdksugd" VALUE 0x8050597A RB_Val_Wu8 0.1000 t_q0p01 0.00 0.1000 EXTENDED_LIMITS 0.00 2.550 /end CHARACTERISTIC
/begin CHARACTERISTIC TEIRLRLSZN "Time constants for stabalization of rl/rlsol at rlsol<rl" CURVE 0x8050722C RB_Curve_S16_U16_Static 65.51500 t_q0p001 0.02000 65.53500 FORMAT "%8.5" EXTENDED_LIMITS 0.00 65.53500
 /begin AXIS_DESCR STD_AXIS Epm_nEng EngN 5 -16384.00 16383.50 FORMAT "%8.2" DEPOSIT ABSOLUTE /end AXIS_DESCR
/end CHARACTERISTIC
/begin CHARACTERISTIC TNMNSRMDK "Time when ambient pressure in manifold" VALUE 0x805072DC RB_Val_Wu16 655.3500 t_q0p01 0.00 655.3500 FORMAT "%8.4" /end CHARACTERISTIC
/begin CHARACTERISTIC TNSTUNL "Time after start the release the switch over of the second load signal" VALUE 0x805072DE RB_Val_Wu16 655.3500 t10msxs_uw_b655p35 0.00 655.3500 FORMAT "%8.4" /end CHARACTERISTIC
/begin CHARACTERISTIC TPSRMNXG "Debounce time for switch on the upper and lower intake manifold pressure model psrmmn and psrmmx" VALUE 0x805072E0 RB_Val_Wu8 2.550 t_q0p01 0.00 2.550 FORMAT "%5.3" /end CHARACTERISTIC
/begin CHARACTERISTIC TRLRLSDKMN "min.time constant for time constant rl/rlsol-low-pass filter in the suction area" VALUE 0x80507242 RB_Val_Wu16 0.1900000 t_q0p001 0.0100000 0.2000000 FORMAT "%9.7" EXTENDED_LIMITS 0.00 65.53500 /end CHARACTERISTIC
/begin CHARACTERISTIC TUGDTX "Time delay of the ugd condition calculated with the tolerance-bound throttle valve angle" VALUE 0x805071BC RB_Val_Wu8 2.550 t_q0p01 0.00 2.550 FORMAT "%5.3" /end CHARACTERISTIC
/begin CHARACTERISTIC VHUBZYL "combustion chamber volume" VALUE 0x805072E2 RB_Val_Wu16 46.00562 vol_q0p702Em3_dm3 0.00 46.00562 FORMAT "%8.5" /end CHARACTERISTIC
/begin CHARACTERISTIC VPPSRMSM "ratio manifold pressure to pressure upstram throttle valve for switch of of extrapolation of modeled manifold prassure" VALUE 0x805072E4 RB_Val_Wu16 1.999969 fak_q3p0518Em5 0.00 1.999969 FORMAT "%8.6" /end CHARACTERISTIC
/begin CHARACTERISTIC VPPSRMSMHY "hysteresis for switch off / activation of extrapolation of intake manifold pressure" VALUE 0x805072E6 RB_Val_Wu16 1.999969 fak_q3p0518Em5 0.00 1.999969 FORMAT "%8.6" /end CHARACTERISTIC
/begin CHARACTERISTIC VPSPVDMNFA "min. pressure ration ps/pvdkds for enabling of throttle adaption" VALUE 0x8050597C RB_Val_Wu16 1.999969 fak_uw_b2 0.00 1.999969 FORMAT "%8.6" /end CHARACTERISTIC
/begin CHARACTERISTIC VPSRMHVDUG "Ratio (desired manifold pressure/basic boost pressure) for enabling WOT for MAF-Sensor diagnosis" VALUE 0x805071BE RB_Val_Wu16 1.999969 fak_q3p0518Em5 0.00 1.999969 FORMAT "%8.6" /end CHARACTERISTIC
/begin CHARACTERISTIC VPSRVDUGD "ratio of intake manifold pressure to pressure upstream throttle is 0.95" VALUE 0x805071C0 RB_Val_Wu16 1.999969 fak_uw_b2 0.00 1.999969 FORMAT "%8.6" READ_ONLY /end CHARACTERISTIC
/begin CHARACTERISTIC VSAUGROHNL "Intake manifold volume without intake manifold switch-over" VALUE 0x805072E8 RB_Val_Wu16 46.00491 vol_q0p702Em3_dm3 0.00070 46.00562 FORMAT "%8.5" EXTENDED_LIMITS 0.00 46.00562 /end CHARACTERISTIC
/begin CHARACTERISTIC VSAUGROHR "Intake manifold volume without intake manifold switch-over" VALUE 0x805072EA RB_Val_Wu16 46.00491 vol_q0p702Em3_dm3 0.00070 46.00562 FORMAT "%8.5" EXTENDED_LIMITS 0.00 46.00562 /end CHARACTERISTIC
/begin CHARACTERISTIC ZKORFKISRM "correction factor for cylinder volume" VALUE 0x805072EC RB_Val_Wu16 1.999969 fak_q3p0518Em5 0.00 1.999969 FORMAT "%8.6" /end CHARACTERISTIC
/begin CHARACTERISTIC ZTMMBR "time constant, engine temperature for combustion chamber temp. model" VALUE 0x80507504 RB_Val_Wu16 6553.4999985 zk100msxs_uw_b6553 0.1000015 6553.6000000 FORMAT "%12.7" EXTENDED_LIMITS 0.10000152590 6553.6000000 /end CHARACTERISTIC
/begin MEASUREMENT AirMod_dia "Delta ignition angle for AirMod" SBYTE kw_q0p75 1 100 -96.00 95.25 FORMAT "%5.2" ECU_ADDRESS 0x60000CCE /end MEASUREMENT
/begin MEASUREMENT AirMod_facDia "Factor delta ignition angle for AirMod" UWORD fak_uw_b2 1 100 0.00 1.000000 FORMAT "%8.6" ECU_ADDRESS 0x60000CCC /end MEASUREMENT
/begin MEASUREMENT AirMod_facFcoCorrnRamp "ramp factor for correction of charge modell at fuel cut of" UWORD fak_uw_b2 1 100 0.00 1.000000 FORMAT "%8.6" ECU_ADDRESS 0x60000CCA /end MEASUREMENT
/begin MEASUREMENT AirMod_idxCylAirChrg "Cyliner index for Air Charge" UBYTE OneToOne 1 100 0.00 255.0 FORMAT "%5.1" ECU_ADDRESS 0x50000882 /end MEASUREMENT
/begin MEASUREMENT AirMod_idxCylAirChrgPredHom "Index on cylinder for air charge prediction with homogeneous" UBYTE OneToOne 1 100 0.00 255.0 FORMAT "%5.1" ECU_ADDRESS 0x600006CA /end MEASUREMENT
/begin MEASUREMENT AirMod_idxCylAirChrgPredOld "Index on cylinder for air charge prediction(old value)" UBYTE OneToOne 1 100 0.00 255.0 FORMAT "%5.1" ECU_ADDRESS 0x70001A6A /end MEASUREMENT
/begin MEASUREMENT AirMod_mfAirCyl "Burned air mass flow" SWORD m_q0p1 1 100 -3276.800 3276.700 FORMAT "%8.3" ECU_ADDRESS 0x600004C2 /end MEASUREMENT
/begin MEASUREMENT AirMod_nEng_a "Engine speed array" SWORD EngN 1 100 -16384.00 16383.50 FORMAT "%8.2" ARRAY_SIZE 4 ECU_ADDRESS 0x500000F4 /end MEASUREMENT
/begin MEASUREMENT AirMod_nrSynAirChrgPredOld "Amount of cylinders between charge and charge prediction(old value)" UBYTE OneToOne 1 100 0.00 255.0 FORMAT "%5.1" ECU_ADDRESS 0x50000843 /end MEASUREMENT
/begin MEASUREMENT AirMod_nrSynAirChrgToIgnCalcn "Amount of cylinders between charge and ignition" UBYTE OneToOne 1 100 0.00 255.0 FORMAT "%5.1" ECU_ADDRESS 0x50000885 /end MEASUREMENT
/begin MEASUREMENT AirMod_pOffsCorrnFco "pressure offset correction of charge modell at fuel cut off" SWORD p_sw_q0p039 1 100 -1280.000 1279.961 FORMAT "%8.3" ECU_ADDRESS 0x60000CC8 /end MEASUREMENT
/begin MEASUREMENT AirMod_pOffsCorrnFcoDes "setpoint for pressure offset correction of charge modell at fuel cut off" SWORD p_sw_q0p039 1 100 -1280.000 1279.961 FORMAT "%8.3" ECU_ADDRESS 0x60000CC6 /end MEASUREMENT
/begin MEASUREMENT AirMod_ratChrgAirCyl "Relative charge of air in the cylinder" UWORD rel_q0p0234 1 100 0.00 1535.977 FORMAT "%8.3" ECU_ADDRESS 0x600004C6 /end MEASUREMENT
/begin MEASUREMENT AirMod_ratChrgAirCylAdv_a "Relative charge of air in the cylinder" UWORD rel_q0p0234 1 100 0.00 1535.977 FORMAT "%8.3" ARRAY_SIZE 4 ECU_ADDRESS 0x500004C8 /end MEASUREMENT
/begin MEASUREMENT AirMod_ratChrgAirCylAftSwtPred "Predicted relative charge of air in the cylinder after switch" UWORD rel_q0p0234 1 100 0.00 1535.977 FORMAT "%8.3" ECU_ADDRESS 0x60000AB0 /end MEASUREMENT
/begin MEASUREMENT AirMod_ratChrgAirCylLoResl "relative air charge" UBYTE rel_q0p75 1 100 0.00 191.3 FORMAT "%5.1" ECU_ADDRESS 0x60000755 /end MEASUREMENT
/begin MEASUREMENT AirMod_ratChrgAirEgrCyl "AGR relative air-load over int. and ext. EGR" UWORD rel_q0p0234 1 100 0.00 1535.977 FORMAT "%8.3" ECU_ADDRESS 0x70001D06 /end MEASUREMENT
/begin MEASUREMENT AirMod_ratChrgInertCyl "relative inert gas charge from int. and ext. EGR" UWORD rel_q0p0234 1 100 0.00 1535.977 FORMAT "%8.3" ECU_ADDRESS 0x70001D04 /end MEASUREMENT
/begin MEASUREMENT AirMod_ratInertCyl "Inert gas rate in the cylinder" UWORD rel_uw_b100 1 100 0.00 99.99847 FORMAT "%8.5" ECU_ADDRESS 0x500006D8 /end MEASUREMENT
/begin MEASUREMENT AirMod_ratInertCylAdv_a "Inert gas rate in the cylinder assigend to cylinder" UWORD rel_uw_b100 1 100 0.00 99.99847 FORMAT "%8.5" ARRAY_SIZE 4 ECU_ADDRESS 0x500004D8 /end MEASUREMENT
/begin MEASUREMENT AirMod_ratInertCylPred "Inert gas rate in the cylinder predicted" UWORD rel_uw_b100 1 100 0.00 99.99847 FORMAT "%8.5" ECU_ADDRESS 0x70001D02 /end MEASUREMENT
/begin MEASUREMENT AirMod_ratInertEgrIntCyl "desired inertgas ratio from internal. EGR (Exhaust Gas Recirculation)" UWORD rel_uw_b100 1 100 0.00 99.99847 FORMAT "%8.5" ECU_ADDRESS 0x500006DA /end MEASUREMENT
/begin MEASUREMENT AirMod_ratInertGasCylCorrnFco "rate inert gas correction of charge modell at fuel cut off" SWORD rel_q0p02344 1 100 -768.0000 767.9766 FORMAT "%8.4" ECU_ADDRESS 0x60000CC4 /end MEASUREMENT
/begin MEASUREMENT AirMod_ratInertGasCylCorrnFcoDes "rate inert gas correction of charge modell at fuel cut off desired" SWORD rel_q0p02344 1 100 -768.0000 767.9766 FORMAT "%8.4" ECU_ADDRESS 0x60000CC2 /end MEASUREMENT
/begin MEASUREMENT AirMod_ratRelAirM "relative air mass (calc. load value) acc. to SAE J1979" UBYTE rel_q0p392 1 100 0.00 100.0 FORMAT "%5.1" ECU_ADDRESS 0x60000DB0 /end MEASUREMENT
/begin MEASUREMENT bfzgbkv_w "vehicle acceleration for rlmin calculation BKV" SWORD bfzg_q0p1085069 1 100 -3555.556 3555.447 FORMAT "%8.3" ECU_ADDRESS 0x60000C7A /end MEASUREMENT
/begin MEASUREMENT B_2synpmX_msg "Condition: psrmmn_w, psrmmx_w, msdkpmn_w and msdkpmx_w are calculated with half sample time (i.e. twice per computation step)" UBYTE B_TRUE 1 100 0.00 1.00000000000 BIT_MASK 0x1 FORMAT "%13.11" ECU_ADDRESS 0x70000AC6 /end MEASUREMENT
/begin MEASUREMENT B_abstgp "Condition soak time calculation is valid and plausible" UBYTE B_TRUE 1 100 0.00 1.00000000000 BIT_MASK 0x1 FORMAT "%13.11" ECU_ADDRESS 0x60009BF2 /end MEASUREMENT
/begin MEASUREMENT B_abstgp_msg "Condition soak time calculation is valid and plausible" UBYTE B_TRUE 1 100 0.00 1.00000000000 BIT_MASK 0x1 FORMAT "%13.11" ECU_ADDRESS 0x70000AC3 /end MEASUREMENT
/begin MEASUREMENT B_abstnpl "Condition soak time calculation is not plausible" UBYTE B_TRUE 1 100 0.00 1.00000000000 BIT_MASK 0x1 FORMAT "%13.11" ECU_ADDRESS 0x7000035F /end MEASUREMENT
/begin MEASUREMENT B_adkose_msg "Throttle valve adaptation settled (msndko_w and fkpvdk_w)" UBYTE B_TRUE 1 100 0.00 1.00000000000 BIT_MASK 0x1 FORMAT "%13.11" ECU_ADDRESS 0x6000016E /end MEASUREMENT
/begin MEASUREMENT B_adkospe_msg "Condition, adaptation value throttle valve to DSS Valid(Offset and gradient)" UBYTE B_TRUE 1 100 0.00 1.00000000000 BIT_MASK 0x1 FORMAT "%13.11" ECU_ADDRESS 0x6000016D /end MEASUREMENT
/begin MEASUREMENT B_adkpe_msg "Cond. adapt. throt. valve to DSS steady (throt. valve released as charge sensor)" UBYTE B_TRUE 1 100 0.00 1.00000000000 BIT_MASK 0x1 FORMAT "%13.11" ECU_ADDRESS 0x600349A7 /end MEASUREMENT
/begin MEASUREMENT B_afkpvdei "Condition: adaptation fkpvdk internally stabilized" UBYTE B_TRUE 1 100 0.00 1.00000000000 BIT_MASK 0x1 FORMAT "%13.11" ECU_ADDRESS 0x60034991 /end MEASUREMENT
/begin MEASUREMENT B_afkpvdke_msg "Condition: adaptation fkpvdk stabilized" UBYTE B_TRUE 1 100 0.00 1.00000000000 BIT_MASK 0x1 FORMAT "%13.11" ECU_ADDRESS 0x6000016C /end MEASUREMENT
/begin MEASUREMENT B_afkpvdpe_msg "Condition, adaptation gradient, throttle valve to DSS steady" UBYTE B_TRUE 1 100 0.00 1.00000000000 BIT_MASK 0x1 FORMAT "%13.11" ECU_ADDRESS 0x6000016B /end MEASUREMENT
/begin MEASUREMENT B_ahfsnfsa_msg "Condition: adjustment of main charge sensor/secondary charge sensor active" UBYTE B_TRUE 1 100 0.00 1.00000000000 BIT_MASK 0x1 FORMAT "%13.11" ECU_ADDRESS 0x6000016A /end MEASUREMENT
/begin MEASUREMENT B_amsndkoe_msg "Cond.: slow, additive mass flow adapt. stabilized" UBYTE B_TRUE 1 100 0.00 1.00000000000 BIT_MASK 0x1 FORMAT "%13.11" ECU_ADDRESS 0x60000169 /end MEASUREMENT
/begin MEASUREMENT B_aomsndpe_msg "Offset adaptation throttle valve to DSS steady" UBYTE B_TRUE 1 100 0.00 1.00000000000 BIT_MASK 0x1 FORMAT "%13.11" ECU_ADDRESS 0x600349A6 /end MEASUREMENT
/begin MEASUREMENT B_bfzgbkv "condition: vehicle deceleration so much that rlmin is needed for BKV" UBYTE B_TRUE 1 100 0.00 1.00000000000 BIT_MASK 0x1 FORMAT "%13.11" ECU_ADDRESS 0x600000EC /end MEASUREMENT
/begin MEASUREMENT B_dschlldk_msg "Condition disable stratified mode during idle speed" UBYTE B_TRUE 1 100 0.00 1.00000000000 BIT_MASK 0x1 FORMAT "%13.11" ECU_ADDRESS 0x60000162 /end MEASUREMENT
/begin MEASUREMENT B_dsshfs_msg "Condition, DSS is main charge sensor" UBYTE B_TRUE 1 100 0.00 1.00000000000 BIT_MASK 0x1 FORMAT "%13.11" ECU_ADDRESS 0x60000161 /end MEASUREMENT
/begin MEASUREMENT B_dugdhtx "Condition: Filtering max HFM mass flow after cond. ugd" UBYTE B_TRUE 1 100 0.00 1.00000000000 BIT_MASK 0x1 FORMAT "%13.11" ECU_ADDRESS 0x70000364 /end MEASUREMENT
/begin MEASUREMENT B_dugdtx_msg "Condition: Throttle valve angle unthrottled delayed for the maximum tolerance" UBYTE B_TRUE 1 100 0.00 1.00000000000 BIT_MASK 0x1 FORMAT "%13.11" ECU_ADDRESS 0x70000A8E /end MEASUREMENT
/begin MEASUREMENT B_fadkoap_msg "Condition, throttle valve adaptation to DSS, released depending on EGR" UBYTE B_TRUE 1 100 0.00 1.00000000000 BIT_MASK 0x1 FORMAT "%13.11" ECU_ADDRESS 0x6000015D /end MEASUREMENT
/begin MEASUREMENT B_fedkapb_msg "Cond. throt. valve-based charge determination and throt. valve to DSS adapted" UBYTE B_TRUE 1 100 0.00 1.00000000000 BIT_MASK 0x1 FORMAT "%13.11" ECU_ADDRESS 0x6000015C /end MEASUREMENT
/begin MEASUREMENT B_fedkb_msg "Condition load calculated from throttle valve potentiometer" UBYTE B_TRUE 1 100 0.00 1.00000000000 BIT_MASK 0x1 FORMAT "%13.11" ECU_ADDRESS 0x6000015B /end MEASUREMENT
/begin MEASUREMENT B_fedkoab_msg "Cnd. thrt. vlv-bsd chrg. dterm. & thrt. vlv not main chrg. dterm. sens. adpt." UBYTE B_TRUE 1 100 0.00 1.00000000000 BIT_MASK 0x1 FORMAT "%13.11" ECU_ADDRESS 0x6000015A /end MEASUREMENT
/begin MEASUREMENT B_fedssb_msg "Condition, charge determination based on intake manifold pressure sensor" UBYTE B_TRUE 1 100 0.00 1.00000000000 BIT_MASK 0x1 FORMAT "%13.11" ECU_ADDRESS 0x70000A65 /end MEASUREMENT
/begin MEASUREMENT B_feete_msg "increased tolerances of air charge determination expected" UBYTE B_TRUE 1 100 0.00 1.00000000000 BIT_MASK 0x1 FORMAT "%13.11" ECU_ADDRESS 0x60000159 /end MEASUREMENT
/begin MEASUREMENT B_ferlnotb_msg "Condition charge determination based on RLNOT characteristic curve" UBYTE B_TRUE 1 100 0.00 1.00000000000 BIT_MASK 0x1 FORMAT "%13.11" ECU_ADDRESS 0x60000158 /end MEASUREMENT
/begin MEASUREMENT B_fgabgla_msg "condition: general enable condition for throttle blade adaptation" UBYTE B_TRUE 1 100 0.00 1.00000000000 BIT_MASK 0x1 FORMAT "%13.11" ECU_ADDRESS 0x60000156 /end MEASUREMENT
/begin MEASUREMENT B_fgabglp_msg "Condition, release throttle valve adjustment for DSS" UBYTE B_TRUE 1 100 0.00 1.00000000000 BIT_MASK 0x1 FORMAT "%13.11" ECU_ADDRESS 0x60000155 /end MEASUREMENT
/begin MEASUREMENT B_fgabgl_msg "Condition: Enable charging compensation" UBYTE B_TRUE 1 100 0.00 1.00000000000 BIT_MASK 0x1 FORMAT "%13.11" ECU_ADDRESS 0x60000157 /end MEASUREMENT
/begin MEASUREMENT B_fgsabglp_msg "Condition, release fast throttle valve adjustment for DSS" UBYTE B_TRUE 1 100 0.00 1.00000000000 BIT_MASK 0x1 FORMAT "%13.11" ECU_ADDRESS 0x60000152 /end MEASUREMENT
/begin MEASUREMENT B_fkpvdkp_msg "Condition, release slow multiplicative throttle valve for DSS" UBYTE B_TRUE 1 100 0.00 1.00000000000 BIT_MASK 0x1 FORMAT "%13.11" ECU_ADDRESS 0x6000014F /end MEASUREMENT
/begin MEASUREMENT B_fkpvdk_msg "Confition for the release of the slow multiplicative load trim" UBYTE B_TRUE 1 100 0.00 1.00000000000 BIT_MASK 0x1 FORMAT "%13.11" ECU_ADDRESS 0x60000150 /end MEASUREMENT
/begin MEASUREMENT B_fupivhegloc "local copy: condition pbrint and fupsrl calculation based on high valve lift" UBYTE B_TRUE 1 100 0.00 1.00000000000 BIT_MASK 0x1 FORMAT "%13.11" ECU_ADDRESS 0x60009BF3 /end MEASUREMENT
/begin MEASUREMENT B_fupivheg_msg "condition pbrint and fupsrl calculation based on high valve lift" UBYTE B_TRUE 1 100 0.00 1.00000000000 BIT_MASK 0x1 FORMAT "%13.11" ECU_ADDRESS 0x60000DDC /end MEASUREMENT
/begin MEASUREMENT B_hfmhfs_msg "Condition, mass flow sensor is main charge sensor" UBYTE B_TRUE 1 100 0.00 1.00000000000 BIT_MASK 0x1 FORMAT "%13.11" ECU_ADDRESS 0x600349A2 /end MEASUREMENT
/begin MEASUREMENT B_iniabga_msg "condition: general reset condition for throttle blade adaptation" UBYTE B_TRUE 1 100 0.00 1.00000000000 BIT_MASK 0x1 FORMAT "%13.11" ECU_ADDRESS 0x6000014C /end MEASUREMENT
/begin MEASUREMENT B_inilabgp_msg "Condition, initialization slow throttle valve adjustment to DSS" UBYTE B_TRUE 1 100 0.00 1.00000000000 BIT_MASK 0x1 FORMAT "%13.11" ECU_ADDRESS 0x6000014B /end MEASUREMENT
/begin MEASUREMENT B_inisabgp "Condition, initialization fast throttle valve adjustment to DSS" UBYTE B_TRUE 1 100 0.00 1.00000000000 BIT_MASK 0x1 FORMAT "%13.11" ECU_ADDRESS 0x600000F5 /end MEASUREMENT
/begin MEASUREMENT B_lasostc_msg "Flag lambda setpoint for sensor equal to 1 (stoichiometric)" UBYTE B_TRUE 1 100 0.00 1.00000000000 BIT_MASK 0x1 FORMAT "%13.11" ECU_ADDRESS 0x70000A0E /end MEASUREMENT
/begin MEASUREMENT B_mdmin_msg "Condition minimal possible indicated torque reached" UBYTE B_TRUE 1 100 0.00 1.00000000000 BIT_MASK 0x1 FORMAT "%13.11" ECU_ADDRESS 0x60000147 /end MEASUREMENT
/begin MEASUREMENT B_msddkg_msg "Condition massflow over throttle blade based on throttle angle valid" UBYTE B_TRUE 1 100 0.00 1.00000000000 BIT_MASK 0x1 FORMAT "%13.11" ECU_ADDRESS 0x60000146 /end MEASUREMENT
/begin MEASUREMENT B_msdkdsg_msg "Condition Mass flow at the DK calculated from the sensor signal of the DSS valid" UBYTE B_TRUE 1 100 0.00 1.00000000000 BIT_MASK 0x1 FORMAT "%13.11" ECU_ADDRESS 0x60000145 /end MEASUREMENT
/begin MEASUREMENT B_msdkhfsg_msg "Condition: mass flow main charge sensor active" UBYTE B_TRUE 1 100 0.00 1.00000000000 BIT_MASK 0x1 FORMAT "%13.11" ECU_ADDRESS 0x60000144 /end MEASUREMENT
/begin MEASUREMENT B_msdkpnxg_msg "Condition massflow through throttle blade for MAP-diagnosis valid" UBYTE B_TRUE 1 100 0.00 1.00000000000 BIT_MASK 0x1 FORMAT "%13.11" ECU_ADDRESS 0x60000143 /end MEASUREMENT
/begin MEASUREMENT B_msdpg_msg "Condition predicted massflow through throttle blade valid" UBYTE B_TRUE 1 100 0.00 1.00000000000 BIT_MASK 0x1 FORMAT "%13.11" ECU_ADDRESS 0x60000141 /end MEASUREMENT
/begin MEASUREMENT B_mszsdkb_msg "calculation air mass flow throttle based" UBYTE B_TRUE 1 100 0.00 1.00000000000 BIT_MASK 0x1 FORMAT "%13.11" ECU_ADDRESS 0x60000140 /end MEASUREMENT
/begin MEASUREMENT B_mwrlsta_msg "Condition GDI mode change: air charge at steady state (acknowldegement signal)." UBYTE B_TRUE 1 100 0.00 1.00000000000 BIT_MASK 0x1 FORMAT "%13.11" ECU_ADDRESS 0x6000013F /end MEASUREMENT
/begin MEASUREMENT B_ofmsndkp1_msg "Condition release leakage air adaptation throttle valve to DSS (in window region 1)" UBYTE B_TRUE 1 100 0.00 1.00000000000 BIT_MASK 0x1 FORMAT "%13.11" ECU_ADDRESS 0x6000013A /end MEASUREMENT
/begin MEASUREMENT B_ofmsndkp2_msg "Condition release leakage air adaptation throttle valve to DSS (in window region 2)" UBYTE B_TRUE 1 100 0.00 1.00000000000 BIT_MASK 0x1 FORMAT "%13.11" ECU_ADDRESS 0x60000139 /end MEASUREMENT
/begin MEASUREMENT B_ofmsndkp_msg "Condition release leakage air adaptation throttle valve to DSS" UBYTE B_TRUE 1 100 0.00 1.00000000000 BIT_MASK 0x1 FORMAT "%13.11" ECU_ADDRESS 0x60000138 /end MEASUREMENT
/begin MEASUREMENT B_ofmsndk_msg "release condition for slow add. Mass flow balancing" UBYTE B_TRUE 1 100 0.00 1.00000000000 BIT_MASK 0x1 FORMAT "%13.11" ECU_ADDRESS 0x6000013B /end MEASUREMENT
/begin MEASUREMENT B_pndkg_msg "condition: pressure downstream throttle valve valid" UBYTE B_TRUE 1 100 0.00 1.00000000000 BIT_MASK 0x1 FORMAT "%13.11" ECU_ADDRESS 0x700009D0 /end MEASUREMENT
/begin MEASUREMENT B_psrg1_msg "validity of the pressure value (best of) of the intake manifold - bank 1" UBYTE B_TRUE 1 100 0.00 1.00000000000 BIT_MASK 0x1 FORMAT "%13.11" ECU_ADDRESS 0x700009CD /end MEASUREMENT
/begin MEASUREMENT B_psrgg1_msg "validity of the pressure value (sensor) of the intake manifold - bank 1" UBYTE B_TRUE 1 100 0.00 1.00000000000 BIT_MASK 0x1 FORMAT "%13.11" ECU_ADDRESS 0x700009CB /end MEASUREMENT
/begin MEASUREMENT B_psrgg_msg "validity of the pressure value (sensor) of the intake manifold" UBYTE B_TRUE 1 100 0.00 1.00000000000 BIT_MASK 0x1 FORMAT "%13.11" ECU_ADDRESS 0x700009CA /end MEASUREMENT
/begin MEASUREMENT B_psrg_msg "validity of the pressure value (best of) of the intake manifold" UBYTE B_TRUE 1 100 0.00 1.00000000000 BIT_MASK 0x1 FORMAT "%13.11" ECU_ADDRESS 0x700009CC /end MEASUREMENT
/begin MEASUREMENT B_psrmhg_msg "Condition modeled intake manifold pressure based on MAF (air mass flow sensor) or throttle blade is valid" UBYTE B_TRUE 1 100 0.00 1.00000000000 BIT_MASK 0x1 FORMAT "%13.11" ECU_ADDRESS 0x60000DDB /end MEASUREMENT
/begin MEASUREMENT B_psrmnxg_msg "Condition psrmn/mx valid" UBYTE B_TRUE 1 100 0.00 1.00000000000 BIT_MASK 0x1 FORMAT "%13.11" ECU_ADDRESS 0x70001E99 /end MEASUREMENT
/begin MEASUREMENT B_psrmozdg_msg "condition modelled manifold pressure independent of massflow over throttle blade valid" UBYTE B_TRUE 1 100 0.00 1.00000000000 BIT_MASK 0x1 FORMAT "%13.11" ECU_ADDRESS 0x60000DDA /end MEASUREMENT
/begin MEASUREMENT B_psrmozg_msg "Condition calculation of massflow out of intake manifold valid" UBYTE B_TRUE 1 100 0.00 1.00000000000 BIT_MASK 0x1 FORMAT "%13.11" ECU_ADDRESS 0x60000DD9 /end MEASUREMENT
/begin MEASUREMENT B_psrmozpnxg_msg "Condition calculation of massflow out of intake manifold for intake manifold pressure diagnosis valid" UBYTE B_TRUE 1 100 0.00 1.00000000000 BIT_MASK 0x1 FORMAT "%13.11" ECU_ADDRESS 0x60000DD8 /end MEASUREMENT
/begin MEASUREMENT B_psrmpb "Condition: extrapolated intake manifold pressure limited to maximum predicted intake manifold pressure" UBYTE B_TRUE 1 100 0.00 1.00000000000 BIT_MASK 0x1 FORMAT "%13.11" ECU_ADDRESS 0x70000360 /end MEASUREMENT
/begin MEASUREMENT B_pugd "condition: pressure ratio pspvdkds_w > 0.95" UBYTE B_TRUE 1 100 0.00 1.00000000000 BIT_MASK 0x1 FORMAT "%13.11" ECU_ADDRESS 0x70000363 /end MEASUREMENT
/begin MEASUREMENT B_pugdp "condition: predicted pressure ration over throttle blade > 0.95" UBYTE B_TRUE 1 100 0.00 1.00000000000 BIT_MASK 0x1 FORMAT "%13.11" ECU_ADDRESS 0x70000362 /end MEASUREMENT
/begin MEASUREMENT B_pvdrlseuvheg_msg "Condition desired boost pressurem freezed during switching to high valve lift" UBYTE B_TRUE 1 100 0.00 1.00000000000 BIT_MASK 0x1 FORMAT "%13.11" ECU_ADDRESS 0x60000137 /end MEASUREMENT
/begin MEASUREMENT B_rlmdsg_msg "Condition rlmds_w_msg valid" UBYTE B_TRUE 1 100 0.00 1.00000000000 BIT_MASK 0x1 FORMAT "%13.11" ECU_ADDRESS 0x60000136 /end MEASUREMENT
/begin MEASUREMENT B_rlsolg_msg "condition: rlsol valid" UBYTE B_TRUE 1 100 0.00 1.00000000000 BIT_MASK 0x1 FORMAT "%13.11" ECU_ADDRESS 0x60000132 /end MEASUREMENT
/begin MEASUREMENT B_rlsrlpxs_msg "condition rlsol = rlpxs" UBYTE B_TRUE 1 100 0.00 1.00000000000 BIT_MASK 0x1 FORMAT "%13.11" ECU_ADDRESS 0x60000131 /end MEASUREMENT
/begin MEASUREMENT B_rlvheg_msg "condition calculation of rl at active cam lift" UBYTE B_TRUE 1 100 0.00 1.00000000000 BIT_MASK 0x1 FORMAT "%13.11" ECU_ADDRESS 0x700009BB /end MEASUREMENT
/begin MEASUREMENT B_syn2fe_msg "condition 2nd segment in charge determination" UBYTE B_TRUE 1 100 0.00 1.00000000000 BIT_MASK 0x1 FORMAT "%13.11" ECU_ADDRESS 0x70000994 /end MEASUREMENT
/begin MEASUREMENT B_tasrmg_msg "condition: modelled intake manifold temperature valid" UBYTE B_TRUE 1 100 0.00 1.00000000000 BIT_MASK 0x1 FORMAT "%13.11" ECU_ADDRESS 0x6000012A /end MEASUREMENT
/begin MEASUREMENT B_tavdkmg_msg "Condition: modelled temperature upstream throttle blade is valid" UBYTE B_TRUE 1 100 0.00 1.00000000000 BIT_MASK 0x1 FORMAT "%13.11" ECU_ADDRESS 0x7000098D /end MEASUREMENT
/begin MEASUREMENT B_tengsi_msg "condition: tengsi_l is valid" UBYTE B_TRUE 1 100 0.00 1.00000000000 BIT_MASK 0x1 FORMAT "%13.11" ECU_ADDRESS 0x70000986 /end MEASUREMENT
/begin MEASUREMENT B_totab "Flag all cylinders of bank 1 cut off" UBYTE B_TRUE 1 100 0.00 1.00000000000 BIT_MASK 0x1 FORMAT "%13.11" ECU_ADDRESS 0x600000EE /end MEASUREMENT
/begin MEASUREMENT B_ugdtx_msg "Condition: Throttle valve angle unthrottled for maximum tolerance" UBYTE B_TRUE 1 100 0.00 1.00000000000 BIT_MASK 0x1 FORMAT "%13.11" ECU_ADDRESS 0x60000127 /end MEASUREMENT
/begin MEASUREMENT B_ugd_msg "condition: throttle angle greater or equal wdkugd" UBYTE B_TRUE 1 100 0.00 1.00000000000 BIT_MASK 0x1 FORMAT "%13.11" ECU_ADDRESS 0x7000096C /end MEASUREMENT
/begin MEASUREMENT B_vpdkugd_msg "condition: pressure ratio at throttle blade greater than 0.95(incl. pressure correction dependent on fkmsdk)" UBYTE B_TRUE 1 100 0.00 1.00000000000 BIT_MASK 0x1 FORMAT "%13.11" ECU_ADDRESS 0x7000095B /end MEASUREMENT
/begin MEASUREMENT B_vpspvd "Condition, release throttle valve adjustment" UBYTE B_TRUE 1 100 0.00 1.00000000000 BIT_MASK 0x1 FORMAT "%13.11" ECU_ADDRESS 0x600000F4 /end MEASUREMENT
/begin MEASUREMENT B_wugdp "condition wdkbap greater equal wdkugd" UBYTE B_TRUE 1 100 0.00 1.00000000000 BIT_MASK 0x1 FORMAT "%13.11" ECU_ADDRESS 0x70000361 /end MEASUREMENT
/begin MEASUREMENT B_zwfdkap_msg "condition ignition angle release due to throttle adaption (e.g. at bedstop) with DSS" UBYTE B_TRUE 1 100 0.00 1.00000000000 BIT_MASK 0x1 FORMAT "%13.11" ECU_ADDRESS 0x6000011E /end MEASUREMENT
/begin MEASUREMENT B_zwfdka_msg "condition ignition angle release due to throttle adaption (e.g. at bedstop)" UBYTE B_TRUE 1 100 0.00 1.00000000000 BIT_MASK 0x1 FORMAT "%13.11" ECU_ADDRESS 0x6000011F /end MEASUREMENT
/begin MEASUREMENT B_zwfrlmin_msg "Enable release of ignition angle while rl_w_msg close to rl_min" UBYTE B_TRUE 1 100 0.00 1.00000000000 BIT_MASK 0x1 FORMAT "%13.11" ECU_ADDRESS 0x6000011D /end MEASUREMENT
/begin MEASUREMENT ChrCtl_facPCorrnOpenThr "Correction factor pressure based for engine speed addressing WOT" UWORD fak_q1p22Em4 1 100 0.00 7.999878 FORMAT "%8.6" ECU_ADDRESS 0x60000C8A /end MEASUREMENT
/begin MEASUREMENT ChrCtl_facSuctnCorrnOpenThr "Correction factor fupsrl based for engine speed addressing WOT" UWORD fak_q1p22Em4 1 100 0.00 7.999878 FORMAT "%8.6" ECU_ADDRESS 0x60000C88 /end MEASUREMENT
/begin MEASUREMENT ChrCtl_flgChrgCalcnTiBasd "flag: charge calculation is time based" UBYTE B_TRUE 1 100 0.00 1.00000000000 BIT_MASK 0x1 FORMAT "%13.11" ECU_ADDRESS 0x700008F8 /end MEASUREMENT
/begin MEASUREMENT ChrCtl_flgRstDsmAdpnEtc100ms "fcmclear flag for reset adaptation" UBYTE B_TRUE 1 100 0.00 1.00000000000 BIT_MASK 0x1 FORMAT "%13.11" ECU_ADDRESS 0x600000F3 /end MEASUREMENT
/begin MEASUREMENT ChrCtl_flgRstDsmAdpnEtc10ms "fcmclear flag for reset adaptation" UBYTE B_TRUE 1 100 0.00 1.00000000000 BIT_MASK 0x1 FORMAT "%13.11" ECU_ADDRESS 0x600000F2 /end MEASUREMENT
/begin MEASUREMENT ChrCtl_flgRstDsmAdpnEtcGen "condition reset adaptation general" UBYTE B_TRUE 1 100 0.00 1.00000000000 BIT_MASK 0x1 FORMAT "%13.11" ECU_ADDRESS 0x600000F1 /end MEASUREMENT
/begin MEASUREMENT ChrCtl_flgRstDsmAdpnEtcMAF "condition reset adaptation MAF" UBYTE B_TRUE 1 100 0.00 1.00000000000 BIT_MASK 0x1 FORMAT "%13.11" ECU_ADDRESS 0x600000F0 /end MEASUREMENT
/begin MEASUREMENT ChrCtl_flgRstDsmAdpnEtcMAP "condition reset adaptation MAP" UBYTE B_TRUE 1 100 0.00 1.00000000000 BIT_MASK 0x1 FORMAT "%13.11" ECU_ADDRESS 0x600000EF /end MEASUREMENT
/begin MEASUREMENT ChrCtl_nEngCorrd "Corrected engine speed for addressing WOT" SWORD EngN 1 100 -16384.00 16383.50 FORMAT "%8.2" ECU_ADDRESS 0x60000C86 /end MEASUREMENT
/begin MEASUREMENT ChrCtl_tiMFlowAdpnFastBasdIntkMnfldSnsr "integrator speed for fast constant mass-flow adaption intake manifold sensor based" UWORD t_q0p01 1 100 0.0100 655.3500 FORMAT "%8.4" ECU_ADDRESS 0x60000CE0 /end MEASUREMENT
/begin MEASUREMENT ChrCtl_tiThrVlvMFlowLeakAdpnMAP "time constant for leakage adaptation of throttle blade (general condition)" UWORD q0p00390625_s_h_DIV_kg 1 100 0.0039 255.9961 FORMAT "%8.4" ECU_ADDRESS 0x60000CDC /end MEASUREMENT
/begin MEASUREMENT ChrSet_mfActTraDes "Setpoint exhaust masflow" UWORD m_q0p1 1 100 0.00 6553.500 FORMAT "%8.3" ECU_ADDRESS 0x60000E7C /end MEASUREMENT
/begin MEASUREMENT cycbgkv_w "cycle time BGKV" SLONG Time_Dt 1 100 -2147.48364800 2147.48364700 FORMAT "%13.8" ECU_ADDRESS 0x60001970 /end MEASUREMENT
/begin MEASUREMENT dfkmsdsp_w "Delta fast mass flow adjustment to one (DSS)" SWORD fak_sw_b1 1 100 -1.000000 0.999969 FORMAT "%8.6" ECU_ADDRESS 0x60000CDA /end MEASUREMENT
/begin MEASUREMENT dfmsdsp_w "Delta factor mass flow from throttle valve/DSS to one" SWORD fak_sw_b1 1 100 -1.000000 0.999969 FORMAT "%8.6" ECU_ADDRESS 0x60000CD8 /end MEASUREMENT
/begin MEASUREMENT dfuelanp_w "Input integrator fast throttle valve adjustment(HFM)" SWORD fak_sw_b1 1 100 -0.1800232 0.1800232 FORMAT "%9.7" ECU_ADDRESS 0x60000AA2 /end MEASUREMENT
/begin MEASUREMENT dfuelsan_w_msg "Delta charge sensor to alpha/n-systems" SWORD fak_sw_b1 1 100 -1.000000 0.999969 FORMAT "%8.6" ECU_ADDRESS 0x60000E8C /end MEASUREMENT
/begin MEASUREMENT dkpsrmh_w_msg "correction of modelled intake manifold pressure for calculation of speed of air mass through throttle blade" SWORD p_sw_q0p078 1 100 -2560.000 2559.922 FORMAT "%8.3" ECU_ADDRESS 0x60000AB2 /end MEASUREMENT
/begin MEASUREMENT dmsdkugd_w_msg "delta air mass flow at ps/pvdkds>0.95" UWORD m_q0p1 1 100 0.00 6553.500 FORMAT "%8.3" ECU_ADDRESS 0x60000AB4 /end MEASUREMENT
/begin MEASUREMENT dmsdkugp_w "Predicted mass flow delta at ps/pvdkds>0.95 (in overtravel)" UWORD m_q0p1 1 100 0.00 6553.500 FORMAT "%8.3" ECU_ADDRESS 0x60000AA4 /end MEASUREMENT
/begin MEASUREMENT dmsfue_w "correction offset by air mass controller" SWORD m_q0p1 1 100 -3276.800 3276.700 FORMAT "%8.3" ECU_ADDRESS 0x60000C82 /end MEASUREMENT
/begin MEASUREMENT dofmsndmsll_w "Normalised mass flow upper threshold correction due to big leakage into intake manifold" UWORD m_q0p1 1 100 0.00 6553.500 FORMAT "%8.3" ECU_ADDRESS 0x60000AA6 /end MEASUREMENT
/begin MEASUREMENT dpbreops_w "Delta Pressure between pressure inlet valve opens and intake manifold" SWORD p_sw_q0p078 1 100 -2560.000 2559.922 FORMAT "%8.3" ECU_ADDRESS 0x60000CC0 /end MEASUREMENT
/begin MEASUREMENT dpsfdhfb_w "Delta fresh gas partial pressure in intake manifold from throttle valve and main charge sensor (limited)" SWORD p_sw_q0p078 1 100 -2560.000 2559.922 FORMAT "%8.3" ECU_ADDRESS 0x50000696 /end MEASUREMENT
/begin MEASUREMENT dpsrfdhf_w "Delta fresh gas part.press. in int.manif. from thrott.valve & main charge sens." SWORD p_sw_q0p078 1 100 -2560.000 2559.922 FORMAT "%8.3" ECU_ADDRESS 0x50000698 /end MEASUREMENT
/begin MEASUREMENT dpsrfgk_w "delta fresh air partial pressure in manifold corrected" SWORD p_sw_q0p078 1 100 -2560.000 2559.922 FORMAT "%8.3" ECU_ADDRESS 0x5000069A /end MEASUREMENT
/begin MEASUREMENT dpsrfgmh_w_msg "Delta, fresh-air partial pressure in int.- manifold betw. 2 calc. schedules, HFM" SWORD p_q0p078 1 100 -2560.000 2559.922 FORMAT "%8.3" ECU_ADDRESS 0x500007AA /end MEASUREMENT
/begin MEASUREMENT dpsrfgmp_w_msg "Delta Frischluftpartialdruck im Saugrohr zwischen zwei Rechenrastern beim DSS" SWORD p_q0p078 1 100 -2560.000 2559.922 FORMAT "%8.3" ECU_ADDRESS 0x500007AC /end MEASUREMENT
/begin MEASUREMENT dpsrfg_w_msg "delta fresh air partial pressure in manifold" SWORD p_q0p078 1 100 -2560.000 2559.922 FORMAT "%8.3" ECU_ADDRESS 0x500007A8 /end MEASUREMENT
/begin MEASUREMENT dpsrfmp_w "Delta predicted fresh air partial pressure" SWORD p_sw_q0p078 1 100 -2560.000 2559.922 FORMAT "%8.3" ECU_ADDRESS 0x5000069C /end MEASUREMENT
/begin MEASUREMENT dpsrg1_w_msg "difference of pressure to a previous segment - bank 1" SWORD p_q0p078 1 100 -2560.000 2559.922 FORMAT "%8.3" ECU_ADDRESS 0x500007AE /end MEASUREMENT
/begin MEASUREMENT dpsrg_w_msg "difference of pressure to a previous segment - bank 1" SWORD p_q0p078 1 100 -2560.000 2559.922 FORMAT "%8.3" ECU_ADDRESS 0x500007B0 /end MEASUREMENT
/begin MEASUREMENT dpsrpps_w "predicted change of manifold pressure" SWORD p_sw_q0p078 1 100 -2560.000 2559.922 FORMAT "%8.3" ECU_ADDRESS 0x5000069E /end MEASUREMENT
/begin MEASUREMENT drlas_w_msg "change of air charge at one combustion cycle" SWORD rel_q0p02344 1 100 -768.0000 767.9766 FORMAT "%8.4" ECU_ADDRESS 0x600005CE /end MEASUREMENT
/begin MEASUREMENT drldvls_w_msg "Dynamic pre-contr. rel. air charge f. DK when switching air actuators" SWORD rel_q0p0234 1 100 -768.0000 767.9766 FORMAT "%8.4" ECU_ADDRESS 0x50000F3A /end MEASUREMENT
/begin MEASUREMENT drlm_w_msg "nominal / actual value difference of air mass controller" SWORD rel_q0p02344 1 100 -768.0000 767.9766 FORMAT "%8.4" ECU_ADDRESS 0x60000E84 /end MEASUREMENT
/begin MEASUREMENT drlp_w_msg "delta predicted load for injection time calculation (word)" SWORD rel_sw_q0p0234 1 100 -768.0000 767.9766 FORMAT "%8.4" ECU_ADDRESS 0x500007B4 /end MEASUREMENT
/begin MEASUREMENT drlrlpmx "used Limit for steady delta of relative air charge and predicted relative air charge from monitoring" UWORD rel_uw_q0p0234 1 100 0.00 767.9766 FORMAT "%8.4" ECU_ADDRESS 0x60000470 /end MEASUREMENT
/begin MEASUREMENT drlvhepsrs_w_msg "Change of air charge during cam profil switching at desired manifold pressure" SWORD rel_q0p0234 1 100 -768.0000 767.9766 FORMAT "%8.4" ECU_ADDRESS 0x60000E82 /end MEASUREMENT
/begin MEASUREMENT drl_w_msg "charge change (Word)" SWORD rel_q0p0234 1 100 -768.0000 767.9766 FORMAT "%8.4" ECU_ADDRESS 0x600005CA /end MEASUREMENT
/begin MEASUREMENT EngDa_tiEngOff "Engine off time" SLONG t_q1 1 100 0.00 2147483647.00 FORMAT "%13.2" ECU_ADDRESS 0x6000196C /end MEASUREMENT
/begin MEASUREMENT EngDa_tiEngOn "Engine on time" SLONG TimeEngOn 1 100 0.00 2147483647.00 FORMAT "%13.2" ECU_ADDRESS 0x60001C14 /end MEASUREMENT
/begin MEASUREMENT evabkor_w "Correction factor for modelled lambda setpoint at engine outlet in case of injection valve cutoff" UWORD fak_q4p883Em4 1 100 0.00 31.99951 FORMAT "%8.5" ECU_ADDRESS 0x60000CD4 /end MEASUREMENT
/begin MEASUREMENT fapsrr_w "factor adaption psrr_w" SWORD fak_q3p0518Em5 1 100 -1.000000 0.999969 FORMAT "%8.6" ECU_ADDRESS 0x60000476 /end MEASUREMENT
/begin MEASUREMENT fdpslma_w "factor delta pslm_w absolute" UWORD fak_q3p0518Em5 1 100 0.00 1.999969 FORMAT "%8.6" ECU_ADDRESS 0x60000478 /end MEASUREMENT
/begin MEASUREMENT fhorlnws_w "correction factor: altitude for rlsol" UWORD fak_q6p1035Em5 1 100 0.00 3.999939 FORMAT "%8.6" ECU_ADDRESS 0x60000C72 /end MEASUREMENT
/begin MEASUREMENT fisrm_w_msg "Factor- integrator intake manifold model" UWORD fak1_q0p000407_hPa_div_percent 1 100 0.00 26.66626 FORMAT "%8.5" ECU_ADDRESS 0x60000AB6 /end MEASUREMENT
/begin MEASUREMENT fiuewdk_w_msg "interpolationfactor at wide open throtte" UWORD fak_uw_b2 1 100 0.00 1.999969 FORMAT "%8.6" ECU_ADDRESS 0x60000AB8 /end MEASUREMENT
/begin MEASUREMENT fkisrm_w_msg "actual valid manifold model integrator constant" UWORD fak_q1p526Em5 1 100 0.00 0.9999847 FORMAT "%9.7" ECU_ADDRESS 0x60000ABA /end MEASUREMENT
/begin MEASUREMENT fkl1_w "factor flap 1" UWORD fak_uw_b2 1 100 0.00 1.999969 FORMAT "%8.6" ECU_ADDRESS 0x60000CBE /end MEASUREMENT
/begin MEASUREMENT fkl2_w "factor flap 2" UWORD fak_uw_b2 1 100 0.00 1.999969 FORMAT "%8.6" ECU_ADDRESS 0x60000CBC /end MEASUREMENT
/begin MEASUREMENT fklafa_w_msg "Faktor Ausfluss including adaptation" UWORD fak_uw_b2 1 100 0.00 1.999969 FORMAT "%8.6" ECU_ADDRESS 0x70001C86 /end MEASUREMENT
/begin MEASUREMENT fkmsdkh_w_msg "Correction factor mass flow secondary charge signal(HFM-based)" UWORD fak_q6p1035Em5 1 100 0.00 3.999939 FORMAT "%8.6" ECU_ADDRESS 0x60000E78 /end MEASUREMENT
/begin MEASUREMENT fkmsdkp_w_msg "Correction factor mass flow secondary charge signal(DSS-based)" UWORD fak_q6p1035Em5 1 100 0.00 3.999939 FORMAT "%8.6" ECU_ADDRESS 0x60000E76 /end MEASUREMENT
/begin MEASUREMENT fkmsdksp_w_msg "Correct. factor fast mass flow adjustment secondary charge signal(DSS-based)" UWORD fak_q6p1035Em5 1 100 0.00 3.999939 FORMAT "%8.6" ECU_ADDRESS 0x60000E74 /end MEASUREMENT
/begin MEASUREMENT fkmsdks_w_msg "correction factor for fast mass flow signal" UWORD fak_q6p1035Em5 1 100 0.00 3.999939 FORMAT "%8.6" ECU_ADDRESS 0x60000ABE /end MEASUREMENT
/begin MEASUREMENT fkmsdk_w_msg "correction factor for mass-flow substitute load signal" UWORD fak_q6p1035Em5 1 100 0.00 3.999939 FORMAT "%8.6" ECU_ADDRESS 0x60000E7A /end MEASUREMENT
/begin MEASUREMENT fkpvdkah_w "Old val.: Correct. fact. slow mass flow adjust. second. chrg. sig.(HFM-based)" UWORD fak_q6p1035Em5 1 100 0.00 3.999939 FORMAT "%8.6" ECU_ADDRESS 0x60037E8A /end MEASUREMENT
/begin MEASUREMENT fkpvdkap_w "Old val.: Correct. fact. slow mass flow adjust. second. chrg. sig.(DSS-based)" UWORD fak_q6p1035Em5 1 100 0.00 3.999939 FORMAT "%8.6" ECU_ADDRESS 0x60037E88 /end MEASUREMENT
/begin MEASUREMENT fkpvdkh_w "Correct. factor slow mass flow adjustment secondary charge signal(HFM-based)" UWORD fak_q6p1035Em5 1 100 0.00 3.999939 FORMAT "%8.6" ECU_ADDRESS 0x60037E86 /end MEASUREMENT
/begin MEASUREMENT fkpvdkp_w_msg "Correct. factor slow mass flow adjustment secondary charge signal(DSS-based)" UWORD fak_q6p1035Em5 1 100 0.00 3.999939 FORMAT "%8.6" ECU_ADDRESS 0x60037F0E /end MEASUREMENT
/begin MEASUREMENT fkpvdk_w_msg "correction factor for slow mass flow signal" UWORD fak_q6p1035Em5 1 100 0.00 3.999939 FORMAT "%8.6" ECU_ADDRESS 0x60000AC2 /end MEASUREMENT
/begin MEASUREMENT fpabnav_w_msg "Correction factor exhaust gas pressure (word)" UWORD fak_uw_b8 1 100 0.00 7.999878 FORMAT "%8.6" ECU_ADDRESS 0x60000AC4 /end MEASUREMENT
/begin MEASUREMENT fpbrpsg_w "pulsation correction from base maps" UWORD fak_uw_b4 1 100 0.00 3.999939 FORMAT "%8.6" ECU_ADDRESS 0x60000CBA /end MEASUREMENT
/begin MEASUREMENT fpbrpsmx_w "pulsation correction with complete open throttle" UWORD fak_uw_b4 1 100 0.00 3.999939 FORMAT "%8.6" ECU_ADDRESS 0x60000CB8 /end MEASUREMENT
/begin MEASUREMENT fpbrpsug_w "pulsation correction at pressure ratio over throttle 0.95" UWORD fak_uw_b4 1 100 0.00 3.999939 FORMAT "%8.6" ECU_ADDRESS 0x60000CB6 /end MEASUREMENT
/begin MEASUREMENT fpbrps_w_msg "Fa. for adap. of intake manifold pres. to comb. space pres. (at act. valve pos.)" UWORD fak_uw_b4 1 100 0.00 3.999939 FORMAT "%8.6" ECU_ADDRESS 0x60000E72 /end MEASUREMENT
/begin MEASUREMENT fpbrsrs_w_msg "target value factor for adap. of intake manifold pres. to comb. space pres. (at act. valve pos.)" UWORD fak_uw_b4 1 100 0.00 3.999939 FORMAT "%8.6" ECU_ADDRESS 0x60000E70 /end MEASUREMENT
/begin MEASUREMENT fpndk_w_msg "correction factor for pressure downstream throttle valve" UWORD fak_uw_b8 1 100 0.00 7.999878 FORMAT "%8.6" ECU_ADDRESS 0x70001C82 /end MEASUREMENT
/begin MEASUREMENT frlmntp_w "factor for rlmin correction (altitude and temerature)" UWORD fak_q6p1035Em5 1 100 0.00 3.999939 FORMAT "%8.6" ECU_ADDRESS 0x60000C78 /end MEASUREMENT
/begin MEASUREMENT ftpavdn_w_msg "factor min correction air density for throttle valve flow f(intake air temp.,altit.)" UWORD fak_uw_b8 1 100 0.00 7.999878 FORMAT "%8.6" ECU_ADDRESS 0x60000608 /end MEASUREMENT
/begin MEASUREMENT ftpavdx_w_msg "factor max correction air density for throttle valve flow f(intake air temp.,altit.)" UWORD fak_uw_b8 1 100 0.00 7.999878 FORMAT "%8.6" ECU_ADDRESS 0x6000060C /end MEASUREMENT
/begin MEASUREMENT ftpavd_w_msg "factor correction air density for throttle valve flow f(intake air temp.,altit.)" UWORD fak_uw_b8 1 100 0.00 7.999878 FORMAT "%8.6" ECU_ADDRESS 0x60000AD0 /end MEASUREMENT
/begin MEASUREMENT ftpvd_w_msg "factor temperature + pressure upstream throttle" UWORD fak_uw_b8 1 100 0.00 7.999878 FORMAT "%8.6" ECU_ADDRESS 0x60000E6A /end MEASUREMENT
/begin MEASUREMENT fupshoms_w_msg "target factor system related transformation pressure to load in hom. mode" UWORD rel_uw_b0p3 1 100 0.00 0.2999954 FORMAT "%9.7" ECU_ADDRESS 0x60000DCE /end MEASUREMENT
/begin MEASUREMENT fupsrli_w "internal fupsrl: switch to target value during valve lifting (gas exchange valves inlet)" UWORD rel_uw_b0p3 1 100 0.00 0.2999954 FORMAT "%9.7" ECU_ADDRESS 0x500006A2 /end MEASUREMENT
/begin MEASUREMENT fupsrlloc_w "local copy: factor system related transformation pressure to load (16-Bit)" UWORD rel_uw_b0p3 1 100 0.00 0.2999954 FORMAT "%9.7" ECU_ADDRESS 0x50005654 /end MEASUREMENT
/begin MEASUREMENT fupsrlmx_w_msg "factor system related transformation pressure to load (16-Bit)" UWORD rel_uw_b0p3 1 100 0.00 0.2999954 FORMAT "%9.7" ECU_ADDRESS 0x60000E68 /end MEASUREMENT
/begin MEASUREMENT fupsrlro_w "factor for conversion pressure in cylinder filling" UWORD rel_uw_b0p3 1 100 0.00 0.2999954 FORMAT "%9.7" ECU_ADDRESS 0x60000CB4 /end MEASUREMENT
/begin MEASUREMENT fupsrls_w_msg "Desired factor system related transformation pressure to load (16-Bit)" UWORD rel_uw_b0p3 1 100 0.00 0.2999954 FORMAT "%9.7" ECU_ADDRESS 0x50000F52 /end MEASUREMENT
/begin MEASUREMENT fupsrltn_w_msg "minimum factor due to tolerances for conversion of pressure to charge" UWORD rel_uw_b0p3 1 100 0.00 0.2999954 FORMAT "%9.7" ECU_ADDRESS 0x60000AD6 /end MEASUREMENT
/begin MEASUREMENT fupsrltx_w_msg "maximum factor due to tolerances for conversion of pressure to charge" UWORD rel_uw_b0p3 1 100 0.00 0.2999954 FORMAT "%9.7" ECU_ADDRESS 0x60000AD8 /end MEASUREMENT
/begin MEASUREMENT fupsrlug_w_msg "factor system related transformation pressure to load (16-Bit)" UWORD rel_uw_b0p3 1 100 0.00 0.2999954 FORMAT "%9.7" ECU_ADDRESS 0x60000E66 /end MEASUREMENT
/begin MEASUREMENT fupsrl_w_msg "factor system related transformation pressure to load (16-Bit)" UWORD rel_uw_b0p3 1 100 0.00 0.2999954 FORMAT "%9.7" ECU_ADDRESS 0x60000AD4 /end MEASUREMENT
/begin MEASUREMENT fupsvheg_w_msg "target factor system related transformation pressure to load in VHE mode" UWORD rel_uw_b0p3 1 100 0.00 0.2999954 FORMAT "%9.7" ECU_ADDRESS 0x60000DCC /end MEASUREMENT
/begin MEASUREMENT fupsvhek_w_msg "target factor system related transformation pressure to load in VHE mode small cam" UWORD rel_uw_b0p3 1 100 0.00 0.2999954 FORMAT "%9.7" ECU_ADDRESS 0x60000DCA /end MEASUREMENT
/begin MEASUREMENT gdrlprlctr "debounce counter for big deviation between rlelative air charge and predicted relative air charge" UBYTE dez 1 100 0.00 255.0 FORMAT "%5.1" ECU_ADDRESS 0x60000C74 /end MEASUREMENT
/begin MEASUREMENT grdpssol_w_msg "gradient of the desired manifold pressure (word)" SWORD grd_sw_q0p78 1 100 -25600.00 25599.22 FORMAT "%8.2" ECU_ADDRESS 0x7000299A /end MEASUREMENT
/begin MEASUREMENT grfvbr_w "gradient of combustion chamber volume at inlet valve closing" SWORD fak_sw_q64 1 100 -512.0000 511.9844 FORMAT "%8.4" ECU_ADDRESS 0x60000486 /end MEASUREMENT
/begin MEASUREMENT InjSys_dmCo2 "CO2 output (kg per h)" UWORD m_uw_b1536 1 100 0.00 1535.977 FORMAT "%8.3" ECU_ADDRESS 0x600048A0 /end MEASUREMENT
/begin MEASUREMENT InjSys_dvolFu "Volumetric flow of fuel in L per s" UWORD q1p1921Em6_L_DIV_s 1 100 0.00 0.07812381 FORMAT "%10.8" ECU_ADDRESS 0x6000E290 /end MEASUREMENT
/begin MEASUREMENT InjSys_dvolFuInjr "Calculated fuel volume flow fuel injection valves [l per s]" UWORD q1p1921Em6_L_DIV_s 1 100 0.00 0.07812381 FORMAT "%10.8" ECU_ADDRESS 0x6000489E /end MEASUREMENT
/begin MEASUREMENT InjSys_dvolFumL "volumetric flow of fuel in ml per s" UWORD q1p1921Em3_mL_DIV_s 1 100 0.00 78.12381 FORMAT "%8.5" ECU_ADDRESS 0x6000489C /end MEASUREMENT
/begin MEASUREMENT InjSys_dvolFuPerHr "Volumetric flow of fuel in L per h" UWORD vol_q8p583Em3 1 100 0.00 562.4914 FORMAT "%8.4" ECU_ADDRESS 0x60003F5E /end MEASUREMENT
/begin MEASUREMENT InjSys_facCnvnRatFuMPfiGr "factor conversion relative fuel mass to absolute fuel mass in Gram for PFI" UWORD m_q1Em7_g_DIV_pc 1 100 0.00 0.006553500 FORMAT "%11.9" ECU_ADDRESS 0x60003F5C /end MEASUREMENT
/begin MEASUREMENT InjSys_mfEngFuRate "Engine fuel rate" UWORD RBPtCel_mf_0p02_1 1 100 0.00 1310.700 FORMAT "%8.3" ECU_ADDRESS 0x6000489A /end MEASUREMENT
/begin MEASUREMENT InjSys_mFuMSum "Sum of fuel quantity accumulated per second" ULONG ASCET_tmp6 1 100 0.00 201.326591953 FORMAT "%13.9" ECU_ADDRESS 0x500001DC /end MEASUREMENT
/begin MEASUREMENT InjSys_mFuMSync "Absolute fuel mass calculated every synchro" ULONG ASCET_tmp7 1 100 0.00 20.1326591953 FORMAT "%13.10" ECU_ADDRESS 0x500001E0 /end MEASUREMENT
/begin MEASUREMENT InjSys_mfVehFuRate "Vehicle Fuel rate" UWORD RBPtCel_mf_0p02_1 1 100 0.00 1310.700 FORMAT "%8.3" ECU_ADDRESS 0x60004898 /end MEASUREMENT
/begin MEASUREMENT InjSys_ratFuMPerSync "Percentage of fuel calculated every synchro" UWORD rel_uw_b3072 1 100 0.00 3071.953 FORMAT "%8.3" ECU_ADDRESS 0x60000420 /end MEASUREMENT
/begin MEASUREMENT InjSys_rhoFuStdPfi "density fuel at standard conditions for PFI" UWORD m_q0p1_g_DIV_L 1 100 0.00 6553.500 FORMAT "%8.3" ECU_ADDRESS 0x60003F5A /end MEASUREMENT
/begin MEASUREMENT InjSys_tiSynPerCyc "sum of sychro duration per calculation cycle in BGKV" SLONG Time_Dt 1 100 -2147.48364800 2147.48364700 FORMAT "%13.8" ECU_ADDRESS 0x5000171C /end MEASUREMENT
/begin MEASUREMENT InjSys_volFuConsDrvCyc "fuel consumption in driving cycle [L]" SWORD Vol 1 100 -327.6800 327.6700 FORMAT "%8.4" ECU_ADDRESS 0x6000E292 /end MEASUREMENT
/begin MEASUREMENT InjSys_volFuConsDrvCycCAN "fuel consumption in driving cycle in cubic centimetre for transmission on CAN" ULONG vol_q0p1_cm3 1 100 0.00 429496729.500 FORMAT "%13.3" ECU_ADDRESS 0x60001BD8 /end MEASUREMENT
/begin MEASUREMENT klvpspv_w "correction in pressure ratio threshold due to a big leakage into intake manifold" UWORD fak_uw_b2 1 100 0.00 1.999969 FORMAT "%8.6" ECU_ADDRESS 0x60000AAA /end MEASUREMENT
/begin MEASUREMENT kmsdk_w "gain factor for filtering msdk" UWORD fak_q1p526Em5 1 100 0.00 0.9999847 FORMAT "%9.7" ECU_ADDRESS 0x50000F30 /end MEASUREMENT
/begin MEASUREMENT labbris_w "Lambda of burning cylinder for calculation of internal residual gas" UWORD fak_uw_b16 1 100 0.00 15.99976 FORMAT "%8.5" ECU_ADDRESS 0x60000AAC /end MEASUREMENT
/begin MEASUREMENT labbrm_w_msg "Lambda setpoint for the gas in the fired combustion chambers" UWORD fak_q0p000244 1 100 0.00 15.99976 FORMAT "%8.5" ECU_ADDRESS 0x6000E312 /end MEASUREMENT
/begin MEASUREMENT labrgs_w_msg "Lambda setpoint of the mixture of all cylinders" UWORD fak_q0p000244 1 100 0.00 15.99976 FORMAT "%8.5" ECU_ADDRESS 0x6000E314 /end MEASUREMENT
/begin MEASUREMENT LamCtrl_flgIninSpB1 "Initialization of lambda set point (e.g., after fuel cut-off or start-stop, bank 1)" UBYTE B_TRUE 1 100 0.00 1.00000000000 BIT_MASK 0x1 FORMAT "%13.11" ECU_ADDRESS 0x600000ED /end MEASUREMENT
/begin MEASUREMENT LamCtrl_ratLamSpNoDynS1B1 "Lambda setpoint without dynamics, i.e. without dead time and time constant (sensor 1, bank 1)" UWORD fak_q0p000244 1 100 0.00 15.99976 FORMAT "%8.5" ECU_ADDRESS 0x60004CA4 /end MEASUREMENT
/begin MEASUREMENT LamCtrl_ratLamSpS1B1 "Lambda setpoint with adapted plant parameters (sensor 1, bank 1)" UWORD fak_q0p000244 1 100 0.00 15.99976 FORMAT "%8.5" ECU_ADDRESS 0x60004CA2 /end MEASUREMENT
/begin MEASUREMENT LamCtrl_tiDeadTiCorrdHomStratBnk1 "Corrected plant dead time for stratified or homogeneous stratified operation" UWORD t_q0p01 1 100 0.00 655.3500 FORMAT "%8.4" ECU_ADDRESS 0x60004CA0 /end MEASUREMENT
/begin MEASUREMENT lamsbrs_w_msg "lambda setpoint at engine outlet (considering scavenging or secondary air, if available)" UWORD fak_q0p000244 1 100 0.00 15.99976 FORMAT "%8.5" ECU_ADDRESS 0x60004BF6 /end MEASUREMENT
/begin MEASUREMENT lamsobd_w_msg "required lambda for OBD service 01 and 02" UWORD fak_q0p000244 1 100 0.00 15.99976 FORMAT "%8.5" ECU_ADDRESS 0x6000E31A /end MEASUREMENT
/begin MEASUREMENT lamsons_w_msg "lambda setpoint at sensor mounting position" UWORD fak_q0p000244 1 100 0.00 15.99976 FORMAT "%8.5" ECU_ADDRESS 0x60004BF4 /end MEASUREMENT
/begin MEASUREMENT lassa_w_msg "Lambda setpoint taking into account secondary air" UWORD fak_q0p000244 1 100 0.00 15.99976 FORMAT "%8.5" ECU_ADDRESS 0x6000E31E /end MEASUREMENT
/begin MEASUREMENT ml_msg "air mass flow into cylinder" UBYTE m_q4_kg_DIV_h 1 100 0.00 1020. FORMAT "%5.0" ECU_ADDRESS 0x70001C05 /end MEASUREMENT
/begin MEASUREMENT ml_w_msg "air mass flow into cylinder" UWORD m_q0p1 1 100 0.00 6553.500 FORMAT "%8.3" ECU_ADDRESS 0x6000063A /end MEASUREMENT
/begin MEASUREMENT msdkalm_w_msg "Mass flow over throttle (balance with HFM signal)" UWORD m_q0p1 1 100 0.00 6553.500 FORMAT "%8.3" ECU_ADDRESS 0x60000E5A /end MEASUREMENT
/begin MEASUREMENT msdkdslocadpn_w "local copy for dfuelsan calculation" UWORD m_q0p1 1 100 0.00 6553.500 FORMAT "%8.3" ECU_ADDRESS 0x6000048A /end MEASUREMENT
/begin MEASUREMENT msdkds_w_msg "Mass flow at the DK calculated from the sensor signal of the DSS" UWORD m_q0p1 1 100 0.00 6553.500 FORMAT "%8.3" ECU_ADDRESS 0x60000648 /end MEASUREMENT
/begin MEASUREMENT msdkhfs_w_msg "air mass flow main charge sensor" UWORD m_q0p1 1 100 0.00 6553.500 FORMAT "%8.3" ECU_ADDRESS 0x60000E58 /end MEASUREMENT
/begin MEASUREMENT msdklocadpn_w "local copy for dfuelsan calculation" UWORD m_q0p1 1 100 0.00 6553.500 FORMAT "%8.3" ECU_ADDRESS 0x6000048C /end MEASUREMENT
/begin MEASUREMENT msdkmx_w_msg "max. possible air mass flow through throttle valve" UWORD m_uw_b6553p5 1 100 0.00 6553.500 FORMAT "%8.3" ECU_ADDRESS 0x60000E56 /end MEASUREMENT
/begin MEASUREMENT msdkoolocadpn_w "local copy for dfuelsan calculation" UWORD m_q0p1 1 100 0.00 6553.500 FORMAT "%8.3" ECU_ADDRESS 0x6000048E /end MEASUREMENT
/begin MEASUREMENT msdkosa_w_msg "air-mass flow through throttle valve without fast adjustment" UWORD m_q0p1 1 100 0.00 6553.500 FORMAT "%8.3" ECU_ADDRESS 0x500007FC /end MEASUREMENT
/begin MEASUREMENT msdkoue_w "air-mass flow through throttle valve without ""überweg""" UWORD m_q0p1 1 100 0.00 6553.500 FORMAT "%8.3" ECU_ADDRESS 0x500006A8 /end MEASUREMENT
/begin MEASUREMENT msdkpmn_w_msg "Mass flow through throttle valve for minimum intake manifold pressure" UWORD m_q0p1 1 100 0.00 6553.500 FORMAT "%8.3" ECU_ADDRESS 0x500007FE /end MEASUREMENT
/begin MEASUREMENT msdkpmx_w_msg "Mass flow through throttle valve for max. intake manifold pressure" UWORD m_q0p1 1 100 0.00 6553.500 FORMAT "%8.3" ECU_ADDRESS 0x50000800 /end MEASUREMENT
/begin MEASUREMENT msdksoir_w "set air mass flow through throttling valve without inert gas ratio governor part" UWORD m_uw_b6553p5 1 100 0.00 6553.500 FORMAT "%8.3" ECU_ADDRESS 0x60000AAE /end MEASUREMENT
/begin MEASUREMENT msdks_w_msg "set air mass flow through throttling valve" UWORD m_uw_b6553p5 1 100 0.00 6553.500 FORMAT "%8.3" ECU_ADDRESS 0x60000E54 /end MEASUREMENT
/begin MEASUREMENT msdkugd_w_msg "air mass flow through throttle valve at ps/pvdk=0.95(unthrottled)" UWORD m_uw_b6553p5 1 100 0.00 6553.500 FORMAT "%8.3" ECU_ADDRESS 0x60000ADC /end MEASUREMENT
/begin MEASUREMENT msdkugpn_w_msg "min. air massflow opver throttle blade for MAP-diagnosis at UGD" UWORD m_uw_b6553p5 1 100 0.00 6553.500 FORMAT "%8.3" ECU_ADDRESS 0x60000ADE /end MEASUREMENT
/begin MEASUREMENT msdkugtn_w_msg "minimum mass flow due to tolerances through DK at ps/pvdk=0.95 (unthrottled)" UWORD m_uw_b6553p5 1 100 0.00 6553.500 FORMAT "%8.3" ECU_ADDRESS 0x60000AE0 /end MEASUREMENT
/begin MEASUREMENT msdkugtx_w_msg "maximum mass flow due to tolerances through DK at ps/pvdk=0.95 (unthrottled)" UWORD m_uw_b6553p5 1 100 0.00 6553.500 FORMAT "%8.3" ECU_ADDRESS 0x60000E52 /end MEASUREMENT
/begin MEASUREMENT msdk_w_msg "air-mass flow through throttle valve" UWORD m_q0p1 1 100 0.00 6553.500 FORMAT "%8.3" ECU_ADDRESS 0x60000644 /end MEASUREMENT
/begin MEASUREMENT msdouep_w "predicted air mass flow over throttle blade without overtravel" UWORD m_q0p1 1 100 0.00 6553.500 FORMAT "%8.3" ECU_ADDRESS 0x70001A7A /end MEASUREMENT
/begin MEASUREMENT msdpmn_w "Mass flow through throttle valve for minimum intake manifold pressure" UWORD m_q0p1 1 100 0.00 6553.500 FORMAT "%8.3" ECU_ADDRESS 0x70001A78 /end MEASUREMENT
/begin MEASUREMENT msdpvf_w "predicted air mass flow through throttle blade before filtering" UWORD m_q0p1 1 100 0.00 6553.500 FORMAT "%8.3" ECU_ADDRESS 0x70001A76 /end MEASUREMENT
/begin MEASUREMENT msdp_w_msg "predicted air mass flow through throttle blade" UWORD m_q0p1 1 100 0.00 6553.500 FORMAT "%8.3" ECU_ADDRESS 0x50000802 /end MEASUREMENT
/begin MEASUREMENT msdstats_w_msg "desired air mass flow through throttling valve under stationary conditions" UWORD m_q0p1 1 100 0.00 6553.500 FORMAT "%8.3" ECU_ADDRESS 0x60000E50 /end MEASUREMENT
/begin MEASUREMENT msdue_w "Mass flow via throttle valve for wide open throttle" UWORD m_q0p1 1 100 0.00 6553.500 FORMAT "%8.3" ECU_ADDRESS 0x70001A74 /end MEASUREMENT
/begin MEASUREMENT msdvf_w "air mass flow through throttle blade without filter" UWORD m_q0p1 1 100 0.00 6553.500 FORMAT "%8.3" ECU_ADDRESS 0x70001A72 /end MEASUREMENT
/begin MEASUREMENT msfabr_w_msg "Mass-flow charge flowing through the outlet valves from the combustion chamber" UWORD m_q0p1 1 100 0.00 6553.500 FORMAT "%8.3" ECU_ADDRESS 0x6000064C /end MEASUREMENT
/begin MEASUREMENT msndkoo_w_msg "Normalized mass flow over throttle without offset (word)" UWORD m_q0p1 1 100 0.00 6553.500 FORMAT "%8.3" ECU_ADDRESS 0x50000804 /end MEASUREMENT
/begin MEASUREMENT msndk_w_msg "standardised air mass flow through throttle valve" UWORD m_q0p1 1 100 0.00 6553.500 FORMAT "%8.3" ECU_ADDRESS 0x70001C68 /end MEASUREMENT
/begin MEASUREMENT msrirsp_w "Mass flow of re-aspirated residue gas" UWORD m_q0p00625 1 100 0.00 409.5938 FORMAT "%8.4" ECU_ADDRESS 0x60000CB2 /end MEASUREMENT
/begin MEASUREMENT nmotalt_w "engine speed one working cylce before" SWORD EngN 1 100 -16384.00 16383.50 FORMAT "%8.2" ECU_ADDRESS 0x500006AA /end MEASUREMENT
/begin MEASUREMENT nmotsw_w "engine speed where syn. faster then 10ms" SWORD EngN 1 100 -16384.00 16383.50 FORMAT "%8.2" ECU_ADDRESS 0x60000CB0 /end MEASUREMENT
/begin MEASUREMENT nmottkor_w "Engine speed temperature corrected" SWORD EngN 1 100 -16384.00 16383.50 FORMAT "%8.2" ECU_ADDRESS 0x60000CAE /end MEASUREMENT
/begin MEASUREMENT oafpsrr_w "offset adaption psrr_w" SWORD p_q0p078 1 100 -2560.000 2559.922 FORMAT "%8.3" ECU_ADDRESS 0x60000490 /end MEASUREMENT
/begin MEASUREMENT ofmsdap_w "Old value: Leakage air mass flow throttle valve(DSS-based) of interpolation between window 1 and window 2" SWORD m_q0p1 1 100 -3276.800 3276.700 FORMAT "%8.3" ECU_ADDRESS 0x60000CD6 /end MEASUREMENT
/begin MEASUREMENT ofmsdkp_w "Leakage air mass flow throttle adapted to DSS by interpolation between window 1 and window 2" SWORD m_q0p1 1 100 -3276.800 3276.700 FORMAT "%8.3" ECU_ADDRESS 0x60000CDE /end MEASUREMENT
/begin MEASUREMENT ofmsndah1_w "Old value: Leakage air mass flow throttle valve(HFM-based) in mass flow adaptation window region 1" SWORD m_q0p1 1 100 -3276.800 3276.700 FORMAT "%8.3" ECU_ADDRESS 0x60037E84 /end MEASUREMENT
/begin MEASUREMENT ofmsndah2_w "Old value: Leakage air mass flow throttle valve(HFM-based) in mass flow adaptation window region 2" SWORD m_q0p1 1 100 -3276.800 3276.700 FORMAT "%8.3" ECU_ADDRESS 0x60037E82 /end MEASUREMENT
/begin MEASUREMENT ofmsndap1_w "Old value: Leakage air mass flow throttle valve(DSS-based) in mass flow adaptation region 1" SWORD m_q0p1 1 100 -3276.800 3276.700 FORMAT "%8.3" ECU_ADDRESS 0x60037E80 /end MEASUREMENT
/begin MEASUREMENT ofmsndap2_w "Old value: Leakage air mass flow throttle valve(DSS-based) in mass flow adaptation region 2" SWORD m_q0p1 1 100 -3276.800 3276.700 FORMAT "%8.3" ECU_ADDRESS 0x60037E7E /end MEASUREMENT
/begin MEASUREMENT ofmsndap_w_msg "Old value: Leakage air mass flow throttle valve(DSS-based)" SWORD m_q0p1 1 100 -3276.800 3276.700 FORMAT "%8.3" ECU_ADDRESS 0x60037F28 /end MEASUREMENT
/begin MEASUREMENT ofmsndkh1_w_msg "Leakage air mass flow throttle valve(HFM-based) in mass flow adaptation window region 1" SWORD m_q0p1 1 100 -3276.800 3276.700 FORMAT "%8.3" ECU_ADDRESS 0x60037F26 /end MEASUREMENT
/begin MEASUREMENT ofmsndkh2_w_msg "Leakage air mass flow throttle valve(HFM-based) in mass flow adaptation window region 2" SWORD m_q0p1 1 100 -3276.800 3276.700 FORMAT "%8.3" ECU_ADDRESS 0x60037F24 /end MEASUREMENT
/begin MEASUREMENT ofmsndkp1_w_msg "Leakage air mass flow throttle adapted to DSS (in window region 1)" SWORD m_q0p1 1 100 -3276.800 3276.700 FORMAT "%8.3" ECU_ADDRESS 0x60037F22 /end MEASUREMENT
/begin MEASUREMENT ofmsndkp2_w_msg "Leakage air mass flow throttle adapted to DSS (in window region 2)" SWORD m_q0p1 1 100 -3276.800 3276.700 FORMAT "%8.3" ECU_ADDRESS 0x60037F20 /end MEASUREMENT
/begin MEASUREMENT ofmsndkp_w_msg "Leakage air mass flow throttle adapted to DSS" SWORD m_q0p1 1 100 -3276.800 3276.700 FORMAT "%8.3" ECU_ADDRESS 0x60037F1E /end MEASUREMENT
/begin MEASUREMENT ofmsndk_w_msg "offset norm air mass flow through throttle blade" SWORD m_q0p1 1 100 -3276.800 3276.700 FORMAT "%8.3" ECU_ADDRESS 0x50000F5C /end MEASUREMENT
/begin MEASUREMENT pabefrg_w "Effective exhaust gas backpressure for model of internal EGR" UWORD p_uw_q0p078 1 100 0.00 5119.922 FORMAT "%8.3" ECU_ADDRESS 0x60000CAC /end MEASUREMENT
/begin MEASUREMENT pabnavfe_w_msg "Exhaust gas pressure in manifold (high dynamic)" UWORD p_uw_q0p078 1 100 0.00 5119.922 FORMAT "%8.3" ECU_ADDRESS 0x60000AE6 /end MEASUREMENT
/begin MEASUREMENT pabnav_w_msg "Actual exhaust gas pressure downstream of exhaust valve" UWORD p_uw_q0p078 1 100 0.00 5119.922 FORMAT "%8.3" ECU_ADDRESS 0x60000E4E /end MEASUREMENT
/begin MEASUREMENT pbrihoms_w_msg "target partial pressure residual exhaust gas internal egr in hom. mode" UWORD p_uw_q0p039 1 100 0.00 2559.961 FORMAT "%8.3" ECU_ADDRESS 0x60000DC8 /end MEASUREMENT
/begin MEASUREMENT pbrintc_w "sum of partial pressure of natural gas + partial pressure (inert gas + air) in combustion compart through internal EGR" UWORD p_q0p078 1 100 0.00 5119.922 FORMAT "%8.3" ECU_ADDRESS 0x500006AC /end MEASUREMENT
/begin MEASUREMENT pbrintloc_w "local copy: Partial pressure (inert gas + air) in combustion compart through internal EGR" UWORD p_q0p039 1 100 0.00 2559.961 FORMAT "%8.3" ECU_ADDRESS 0x50005656 /end MEASUREMENT
/begin MEASUREMENT pbrintmx_w_msg "Partial pressure (inert gas + air) in combustion compart through internal EGR" UWORD p_uw_q0p039 1 100 0.00 2559.961 FORMAT "%8.3" ECU_ADDRESS 0x60000E4C /end MEASUREMENT
/begin MEASUREMENT pbrintro_w "unfilter value for partial pressure residual gas internal EGR" UWORD p_uw_q0p039 1 100 0.00 2559.961 FORMAT "%8.3" ECU_ADDRESS 0x60000CAA /end MEASUREMENT
/begin MEASUREMENT pbrints_w_msg "Desired partial pressure (inert gas+air) in combustion compart through int. EGR" UWORD p_uw_q0p039 1 100 0.00 2559.961 FORMAT "%8.3" ECU_ADDRESS 0x50000F62 /end MEASUREMENT
/begin MEASUREMENT pbrinttn_w_msg "min. partial press. (inert gas+air) in the combustion chamber due to tolerances" UWORD p_uw_q0p039 1 100 0.00 2559.961 FORMAT "%8.3" ECU_ADDRESS 0x60000AEA /end MEASUREMENT
/begin MEASUREMENT pbrinttx_w_msg "max. partial press. (inert gas+air) in the combustion chamber due to tolerances" UWORD p_uw_q0p039 1 100 0.00 2559.961 FORMAT "%8.3" ECU_ADDRESS 0x60000AEC /end MEASUREMENT
/begin MEASUREMENT pbrintug_w_msg "Partial pressure (inert gas + air) in combustion compart through internal EGR" UWORD p_uw_q0p039 1 100 0.00 2559.961 FORMAT "%8.3" ECU_ADDRESS 0x60000E4A /end MEASUREMENT
/begin MEASUREMENT pbrintuk_w_msg "Partial press (inert gas + air) in comb. chamber thru inte. EGR, not corrected" UWORD p_uw_q0p039 1 100 0.00 2559.961 FORMAT "%8.3" ECU_ADDRESS 0x60000E48 /end MEASUREMENT
/begin MEASUREMENT pbrint_w_msg "Partial pressure (inert gas + air) in combustion compart through internal EGR" UWORD p_uw_q0p039 1 100 0.00 2559.961 FORMAT "%8.3" ECU_ADDRESS 0x60000AE8 /end MEASUREMENT
/begin MEASUREMENT pbrivheg_w_msg "target partial pressure residual exhaust gas internal egr in VHE mode" UWORD p_uw_q0p039 1 100 0.00 2559.961 FORMAT "%8.3" ECU_ADDRESS 0x60000DC6 /end MEASUREMENT
/begin MEASUREMENT pbrivhek_w_msg "target partial pressure residual exhaust gas internal egr in VHE mode small cam" UWORD p_uw_q0p039 1 100 0.00 2559.961 FORMAT "%8.3" ECU_ADDRESS 0x60000DC4 /end MEASUREMENT
/begin MEASUREMENT PIntkVUs_facNrmPEnv "Ratio: Intake manifold pressure upstream to ambient pressure" UWORD fak_uw_b8 1 100 0.00 7.999878 FORMAT "%8.6" ECU_ADDRESS 0x70001CC6 /end MEASUREMENT
/begin MEASUREMENT PIntkVUs_flgPMeasdVldTiBasdB1 "Validity measured manifold pressure time based 1. bank" UBYTE B_TRUE 1 100 0.00 1.00000000000 BIT_MASK 0x1 FORMAT "%13.11" ECU_ADDRESS 0x7000069B /end MEASUREMENT
/begin MEASUREMENT PIntkVUs_flgPVldTiBasd "Validity of manifold pressure (timebased)" UBYTE B_TRUE 1 100 0.00 1.00000000000 BIT_MASK 0x1 FORMAT "%13.11" ECU_ADDRESS 0x70000698 /end MEASUREMENT
/begin MEASUREMENT PIntkVUs_flgPVldTiBasdB1 "Validity of manifold pressure (timebased) 1. bank" UBYTE B_TRUE 1 100 0.00 1.00000000000 BIT_MASK 0x1 FORMAT "%13.11" ECU_ADDRESS 0x70000697 /end MEASUREMENT
/begin MEASUREMENT PIntkVUs_flgSwtFilPrm "status, if other filterparameter are used in case of change of the intake valve lift" UBYTE B_TRUE 1 100 0.00 1.00000000000 BIT_MASK 0x1 FORMAT "%13.11" ECU_ADDRESS 0x70000696 /end MEASUREMENT
/begin MEASUREMENT PIntkVUs_p "pressure value (best of) of the intake manifold" UWORD p_q0p078 1 100 0.00 5119.922 FORMAT "%8.3" ECU_ADDRESS 0x60000578 /end MEASUREMENT
/begin MEASUREMENT PIntkVUs_pB1 "pressure value (best of) of the intake manifold - bank 1" UWORD p_q0p078 1 100 0.00 5119.922 FORMAT "%8.3" ECU_ADDRESS 0x70001CC4 /end MEASUREMENT
/begin MEASUREMENT PIntkVUs_pMeasdTiBasdB1 "measured manifold pressure time based 1. bank" UWORD p_q0p078 1 100 0.00 5119.922 FORMAT "%8.3" ECU_ADDRESS 0x6000E29A /end MEASUREMENT
/begin MEASUREMENT PIntkVUs_pTiBasd "intake manifold pressure (timebased)" UWORD p_q0p078 1 100 0.00 5119.922 FORMAT "%8.3" ECU_ADDRESS 0x6000E29C /end MEASUREMENT
/begin MEASUREMENT PIntkVUs_pTiBasdB1 "intake manifold pressure (timebased) 1. bank" UWORD p_q0p078 1 100 0.00 5119.922 FORMAT "%8.3" ECU_ADDRESS 0x6000E29E /end MEASUREMENT
/begin MEASUREMENT pndk_w_msg "pressure downstream throttle valve" UWORD p_q0p078 1 100 0.00 5119.922 FORMAT "%8.3" ECU_ADDRESS 0x60000650 /end MEASUREMENT
/begin MEASUREMENT psdkugdn_w_msg "minimum manifold pressure if ratio pressure = 0.95" UWORD p_uw_q0p078 1 100 0.00 5119.922 FORMAT "%8.3" ECU_ADDRESS 0x60000AEE /end MEASUREMENT
/begin MEASUREMENT psdkugdx_w_msg "maximum manifold pressure if ratio pressure = 0.95" UWORD p_uw_q0p078 1 100 0.00 5119.922 FORMAT "%8.3" ECU_ADDRESS 0x60000E46 /end MEASUREMENT
/begin MEASUREMENT psr1_w_msg "pressure value (best of) of the intake manifold - bank 1" UWORD p_q0p078 1 100 0.00 5119.922 FORMAT "%8.3" ECU_ADDRESS 0x70001C64 /end MEASUREMENT
/begin MEASUREMENT psrdkugd_w_msg "Intake manifold pressure at the unthrottled point" UWORD p_uw_q0p078 1 100 0.00 5119.922 FORMAT "%8.3" ECU_ADDRESS 0x60000E44 /end MEASUREMENT
/begin MEASUREMENT psrfgmh_w "fresh air partial pressure in intake manifold based on MAF-sensor" UWORD p_q0p078 1 100 0.00 5119.922 FORMAT "%8.3" ECU_ADDRESS 0x500006AE /end MEASUREMENT
/begin MEASUREMENT psrfgmh_w_msg "fresh air partial pressure in intake manifold based on MAF-sensor" UWORD p_q0p078 1 100 0.00 5119.922 FORMAT "%8.3" ECU_ADDRESS 0x50000806 /end MEASUREMENT
/begin MEASUREMENT psrfgmp_w_msg "Fresh-air partial pressure in intake manifold, DSS-based + internal residual gas" UWORD p_q0p078 1 100 0.00 5119.922 FORMAT "%8.3" ECU_ADDRESS 0x50000808 /end MEASUREMENT
/begin MEASUREMENT psrfg_w_msg "intake manifold fresh air partial pressure" UWORD p_q0p078 1 100 0.00 5119.922 FORMAT "%8.3" ECU_ADDRESS 0x70001C62 /end MEASUREMENT
/begin MEASUREMENT psrg1_w_msg "pressure value (sensor) of the intake manifold - bank 1" UWORD p_q0p078 1 100 0.00 5119.922 FORMAT "%8.3" ECU_ADDRESS 0x70001C60 /end MEASUREMENT
/begin MEASUREMENT psrgsm_w_msg "sensor value after offset adaption" UWORD p_q0p078 1 100 0.00 5119.922 FORMAT "%8.3" ECU_ADDRESS 0x5000080A /end MEASUREMENT
/begin MEASUREMENT psrg_w_msg "pressure value (sensor) of the intake manifold" UWORD p_q0p078 1 100 0.00 5119.922 FORMAT "%8.3" ECU_ADDRESS 0x60000660 /end MEASUREMENT
/begin MEASUREMENT psrhoms_w_msg "Set intake manifold pressure in homogeneous mode" UWORD p_q0p078 1 100 0.00 5119.922 FORMAT "%8.3" ECU_ADDRESS 0x60000E42 /end MEASUREMENT
/begin MEASUREMENT psrmgx_w_msg "maximum threshold for modelled intake manifold pressure" UWORD p_q0p078 1 100 0.00 5119.922 FORMAT "%8.3" ECU_ADDRESS 0x60000662 /end MEASUREMENT
/begin MEASUREMENT psrmhmi_w_msg "with HFM modelled manifold pressure centre of iteration" UWORD p_q0p078 1 100 0.00 5119.922 FORMAT "%8.3" ECU_ADDRESS 0x5000080E /end MEASUREMENT
/begin MEASUREMENT PSRMH_2SYN_I.dpsrfgmh_w "class for psrmh / Delta, fresh-air partial pressure in int.- manifold betw. 2 calc. schedules, HFM" SWORD p_q0p078 1 100 -2560.000 2559.922 FORMAT "%8.3" ECU_ADDRESS 0x50000662 /end MEASUREMENT
/begin MEASUREMENT PSRMH_2SYN_I.dpsrmh_w "class for psrmh / Delta int. manifold pressure between 2 calc. schedules, HFM" SWORD p_q0p078 1 100 -2560.000 2559.922 FORMAT "%8.3" ECU_ADDRESS 0x50000664 /end MEASUREMENT
/begin MEASUREMENT PSRMH_2SYN_I.psrfgmh_w "class for psrmh / fresh air partial pressure in intake manifold based on MAF-sensor" UWORD p_q0p078 1 100 0.00 5119.922 FORMAT "%8.3" ECU_ADDRESS 0x50000666 /end MEASUREMENT
/begin MEASUREMENT PSRMH_2SYN_I.psrmh_w "class for psrmh / with HFM modelled manifold pressure end of segment" UWORD p_q0p078 1 100 0.078 5119.922 FORMAT "%8.3" ECU_ADDRESS 0x50000668 /end MEASUREMENT
/begin MEASUREMENT PSRMH_2SYN_I.psrmhmi_w "class for psrmh / with HFM modelled manifold pressure centre of iteration" UWORD p_q0p078 1 100 0.078 5119.922 FORMAT "%8.3" ECU_ADDRESS 0x5000066A /end MEASUREMENT
/begin MEASUREMENT PSRMH_2SYN_I.rlfsrbrh_w "class for psrmh / relative fresh air charge flowing from intake manifold to combustion chamber" UWORD rel_q0p0234 1 100 0.00 1535.977 FORMAT "%8.3" ECU_ADDRESS 0x5000066E /end MEASUREMENT
/begin MEASUREMENT PSRMH_2SYN_I.INT_PSRX_CL.dpsrmX_w "class for psrmh / Integrator manifold pressure / Delta int. manifold pressure between 2 calc. schedules" SWORD p_q0p078 1 100 -2560.000 2559.922 FORMAT "%8.3" ECU_ADDRESS 0x50000670 /end MEASUREMENT
/begin MEASUREMENT PSRMH_2SYN_I.INT_PSRX_CL.psrmXneu_w "class for psrmh / Integrator manifold pressure / modelled manifold pressure new integrator value (end of segment)" UWORD p_q0p078 1 100 0.00 5119.922 FORMAT "%8.3" ECU_ADDRESS 0x50000672 /end MEASUREMENT
/begin MEASUREMENT psrmh_w "with HFM modelled manifold pressure end of segment" UWORD p_q0p078 1 100 0.078 5119.922 FORMAT "%8.3" ECU_ADDRESS 0x500006B0 /end MEASUREMENT
/begin MEASUREMENT psrmh_w_msg "with HFM modelled manifold pressure end of segment" UWORD p_q0p078 1 100 0.00 5119.922 FORMAT "%8.3" ECU_ADDRESS 0x60000666 /end MEASUREMENT
/begin MEASUREMENT PSRMMN_2SYN_I.psrmX_w "class for psrmmn / max manifold pressure from sensor signal wobble check" UWORD p_q0p078 1 100 0.00 5119.922 FORMAT "%8.3" ECU_ADDRESS 0x50000674 /end MEASUREMENT
/begin MEASUREMENT PSRMMN_2SYN_I.rfasrX_w "class for psrmmn / Relative out-flowing charge from SR" UWORD rel_q0p0234 1 100 0.00 1535.977 FORMAT "%8.3" ECU_ADDRESS 0x50000676 /end MEASUREMENT
/begin MEASUREMENT PSRMMN_2SYN_I.rfzsrX_w "class for psrmmn / Relative in-flowing charge from SR" UWORD rel_q0p0234 1 100 0.00 1535.977 FORMAT "%8.3" ECU_ADDRESS 0x50000678 /end MEASUREMENT
/begin MEASUREMENT psrmmn_w_msg "minimum modeled manifold pressure" UWORD p_q0p078 1 100 0.00 5119.922 FORMAT "%8.3" ECU_ADDRESS 0x60000668 /end MEASUREMENT
/begin MEASUREMENT PSRMMX_2SYN_I.psrmX_w "class for psrmmx / max manifold pressure from sensor signal wobble check" UWORD p_q0p078 1 100 0.00 5119.922 FORMAT "%8.3" ECU_ADDRESS 0x5000067E /end MEASUREMENT
/begin MEASUREMENT PSRMMX_2SYN_I.rfasrX_w "class for psrmmx / Relative out-flowing charge from SR" UWORD rel_q0p0234 1 100 0.00 1535.977 FORMAT "%8.3" ECU_ADDRESS 0x50000680 /end MEASUREMENT
/begin MEASUREMENT PSRMMX_2SYN_I.rfzsrX_w "class for psrmmx / Relative in-flowing charge from SR" UWORD rel_q0p0234 1 100 0.00 1535.977 FORMAT "%8.3" ECU_ADDRESS 0x50000682 /end MEASUREMENT
/begin MEASUREMENT psrmmx_w_msg "maximum modeled manifold pressure" UWORD p_q0p078 1 100 0.00 5119.922 FORMAT "%8.3" ECU_ADDRESS 0x6000066A /end MEASUREMENT
/begin MEASUREMENT psrmp_w_msg "extrapolated intake manifold pressure" UWORD p_uw_q0p078 1 100 0.00 5119.922 FORMAT "%8.3" ECU_ADDRESS 0x50000810 /end MEASUREMENT
/begin MEASUREMENT psrmxveg_w_msg "maximum manifold pressure for operating mode valve lift variation big cam" UWORD p_uw_q0p078 1 100 0.00 5119.922 FORMAT "%8.3" ECU_ADDRESS 0x60000E40 /end MEASUREMENT
/begin MEASUREMENT psrmxvek_w_msg "maximum manifold pressure for operating mode valve lift variation small cam" UWORD p_uw_q0p078 1 100 0.00 5119.922 FORMAT "%8.3" ECU_ADDRESS 0x60000E3E /end MEASUREMENT
/begin MEASUREMENT psrpmx_w "maximum predicted intake manifold pressure" UWORD p_uw_q0p078 1 100 0.00 5119.922 FORMAT "%8.3" ECU_ADDRESS 0x500006B2 /end MEASUREMENT
/begin MEASUREMENT psrpsrs_w "Set intake manifold pressure for acutal mode" UWORD p_q0p078 1 100 0.00 5119.922 FORMAT "%8.3" ECU_ADDRESS 0x60000C70 /end MEASUREMENT
/begin MEASUREMENT psrrf_w_msg "Manifold pressure raw value filtered" UWORD p_q0p078 1 100 0.00 5119.922 FORMAT "%8.3" ECU_ADDRESS 0x50000812 /end MEASUREMENT
/begin MEASUREMENT psrrlpnb_w "unlimited pressure for calculation of unlimited predicted charge" UWORD p_uw_q0p078 1 100 0.00 5119.922 FORMAT "%8.3" ECU_ADDRESS 0x500006B4 /end MEASUREMENT
/begin MEASUREMENT psrrl_w_msg "manifold pressure for calculation of relative charge" UWORD p_q0p078 1 100 0.00 5119.922 FORMAT "%8.3" ECU_ADDRESS 0x50000814 /end MEASUREMENT
/begin MEASUREMENT psrsldr_w_msg "Set intake manifold preassre for boost preassure" UWORD p_q0p078 1 100 0.00 5119.922 FORMAT "%8.3" ECU_ADDRESS 0x60000E3A /end MEASUREMENT
/begin MEASUREMENT psrsuvhe_w_msg "Set intake manifold pressure after shifting valve lift" UWORD p_q0p078 1 100 0.00 5119.922 FORMAT "%8.3" ECU_ADDRESS 0x60000E38 /end MEASUREMENT
/begin MEASUREMENT psrs_w_msg "Set intake manifold pressure" UWORD p_q0p078 1 100 0.00 5119.922 FORMAT "%8.3" ECU_ADDRESS 0x60000E3C /end MEASUREMENT
/begin MEASUREMENT psrxs_w_msg "max. desired manifold pressure" UWORD p_uw_q0p078 1 100 0.00 5119.922 FORMAT "%8.3" ECU_ADDRESS 0x60000E36 /end MEASUREMENT
/begin MEASUREMENT psr_w_msg "pressure value (best of) of the intake manifold" UWORD p_q0p078 1 100 0.00 5119.922 FORMAT "%8.3" ECU_ADDRESS 0x60000658 /end MEASUREMENT
/begin MEASUREMENT qtitimnh_msg "quotient ti / TIMIN (at homogeneous mode - for GDI)" UBYTE fak_ub_b4 1 100 0.00 3.984 FORMAT "%5.3" ECU_ADDRESS 0x60000DAD /end MEASUREMENT
/begin MEASUREMENT qtitimnpfi "quotient ti TIMIN on port fuel injection path" UBYTE fak_ub_b4 1 100 0.00 3.984 FORMAT "%5.3" ECU_ADDRESS 0x60000C7C /end MEASUREMENT
/begin MEASUREMENT rfdsorgi_w_msg "Relative total charge, without DSS-based internal residual gas" UWORD rel_q0p0234 1 100 0.00 1535.977 FORMAT "%8.3" ECU_ADDRESS 0x70001C58 /end MEASUREMENT
/begin MEASUREMENT rfdsorim_w_msg "Relative total charge, without internal residual gas DSS-based (middle synchro)" UWORD rel_q0p0234 1 100 0.00 1535.977 FORMAT "%8.3" ECU_ADDRESS 0x60000680 /end MEASUREMENT
/begin MEASUREMENT rfges_w_msg "total relative charge (including EGR)" UWORD rel_q0p0234 1 100 0.00 1535.977 FORMAT "%8.3" ECU_ADDRESS 0x50000816 /end MEASUREMENT
/begin MEASUREMENT rfkrbrr_w "relative charge from exhaust manifold to combustion chamber(base value)" UWORD rel_uw_q0p0234 1 100 0.00 1535.977 FORMAT "%8.3" ECU_ADDRESS 0x60000CA8 /end MEASUREMENT
/begin MEASUREMENT rflmorgi_w_msg "Relative total charge, without HFM-based internal residual gas" UWORD rel_q0p0234 1 100 0.00 1535.977 FORMAT "%8.3" ECU_ADDRESS 0x60000682 /end MEASUREMENT
/begin MEASUREMENT rforgi_w_msg "Relative total charge, without internal residual gas" UWORD rel_q0p0234 1 100 0.00 1535.977 FORMAT "%8.3" ECU_ADDRESS 0x70001C56 /end MEASUREMENT
/begin MEASUREMENT rforidmx_w_msg "max. relative charge without internal residual gas depends of throttle blade" UWORD rel_q0p02344 1 100 0.00 1535.977 FORMAT "%8.3" ECU_ADDRESS 0x60000AF8 /end MEASUREMENT
/begin MEASUREMENT rforidug_w "relative charage without internal residual gas at pressure ratio 0.95" UWORD rel_q0p02344 1 100 0.00 1535.977 FORMAT "%8.3" ECU_ADDRESS 0x60000C6E /end MEASUREMENT
/begin MEASUREMENT rfrihoms_w_msg "rel. charge (residual gas + air) about int. EGR" UWORD rel_uw_q0p0234 1 100 0.00 1535.977 FORMAT "%8.3" ECU_ADDRESS 0x60000DC0 /end MEASUREMENT
/begin MEASUREMENT rfrimx_w "relative int. EGR charge with complete open throttle" UWORD rel_uw_q0p0234 1 100 0.00 1535.977 FORMAT "%8.3" ECU_ADDRESS 0x60000CA6 /end MEASUREMENT
/begin MEASUREMENT rfrintros_w "Relative charging (inert gas + air) over internal EGR raw value desired" UWORD rel_uw_q0p0234 1 100 0.00 1535.977 FORMAT "%8.3" ECU_ADDRESS 0x60000CA4 /end MEASUREMENT
/begin MEASUREMENT rfrintro_w "Relative charging (inert gas + air) over internal EGR raw value" UWORD rel_uw_q0p0234 1 100 0.00 1535.977 FORMAT "%8.3" ECU_ADDRESS 0x60000CA2 /end MEASUREMENT
/begin MEASUREMENT rfrints_w_msg "rel.desired charge (int.gas +air) about int.AGR" UWORD rel_uw_q0p0234 1 100 0.00 1535.977 FORMAT "%8.3" ECU_ADDRESS 0x60000E34 /end MEASUREMENT
/begin MEASUREMENT rfrint_w_msg "Relative charging (inert gas + air) over internal EGR" UWORD rel_uw_q0p0234 1 100 0.00 1535.977 FORMAT "%8.3" ECU_ADDRESS 0x60000AFA /end MEASUREMENT
/begin MEASUREMENT rfriresr_w "Residual portion of the relative charge (inert gas + air) via internal EGR without savenging" UWORD rel_q0p02344 1 100 0.00 1535.977 FORMAT "%8.3" ECU_ADDRESS 0x60000CA0 /end MEASUREMENT
/begin MEASUREMENT rfrires_w_msg "Residual portion of the relative charge (inert gas + air) via internal EGR" UWORD rel_uw_q0p0234 1 100 0.00 1535.977 FORMAT "%8.3" ECU_ADDRESS 0x60000E32 /end MEASUREMENT
/begin MEASUREMENT rfrirsp_w_msg "Re-aspirated portion of the relative charge (inert gas + air) via internal EGR" UWORD rel_uw_q0p0234 1 100 0.00 1535.977 FORMAT "%8.3" ECU_ADDRESS 0x60000E30 /end MEASUREMENT
/begin MEASUREMENT rfrirssr_w "Residual portion of the relative charge flowing into intake manifold (inert gas + air) via internal EGR without savenging" UWORD rel_q0p02344 1 100 0.00 1535.977 FORMAT "%8.3" ECU_ADDRESS 0x60000C9E /end MEASUREMENT
/begin MEASUREMENT rfriug_w "relative int. EGR charge at point UGD" UWORD rel_uw_q0p0234 1 100 0.00 1535.977 FORMAT "%8.3" ECU_ADDRESS 0x60000C9C /end MEASUREMENT
/begin MEASUREMENT rfrivheg_w_msg "rel.charge (residual gas + air) about int.AGR in mode VHE" UWORD rel_uw_q0p0234 1 100 0.00 1535.977 FORMAT "%8.3" ECU_ADDRESS 0x60000DBE /end MEASUREMENT
/begin MEASUREMENT rfrivhek_w_msg "rel.charge (residual gas + air) about int.AGR in mode VHE small cam" UWORD rel_uw_q0p0234 1 100 0.00 1535.977 FORMAT "%8.3" ECU_ADDRESS 0x60000DBC /end MEASUREMENT
/begin MEASUREMENT rfzuugpn_w_msg "Unthrottled flow into the combustion chamber for max. boundary model" UWORD rel_q0p02344 1 100 0.00 1535.977 FORMAT "%8.3" ECU_ADDRESS 0x60000E2E /end MEASUREMENT
/begin MEASUREMENT rfzuugtn_w_msg "Unthrottled flow into the combustion chamber for min. boundary model" UWORD rel_q0p02344 1 100 0.00 1535.977 FORMAT "%8.3" ECU_ADDRESS 0x60000E2C /end MEASUREMENT
/begin MEASUREMENT rfzuugtx_w_msg "Maximal flow into the combustion chamber for min. boundary model (pressure sensor based charge determination)" UWORD rel_q0p02344 1 100 0.00 1535.977 FORMAT "%8.3" ECU_ADDRESS 0x60000E2A /end MEASUREMENT
/begin MEASUREMENT ririhoms_w_msg "rel. residual gas charge about int.AGR in mode homogeneous" UWORD rel_uw_q0p0234 1 100 0.00 1535.977 FORMAT "%8.3" ECU_ADDRESS 0x60000DBA /end MEASUREMENT
/begin MEASUREMENT ririntp_w_msg "desired relative residual gas about int. EGR pedricted" UWORD rel_uw_q0p0234 1 100 0.00 1535.977 FORMAT "%8.3" ECU_ADDRESS 0x70001C54 /end MEASUREMENT
/begin MEASUREMENT rirints_w_msg "desired relative residual gas about int. EGR" UWORD rel_uw_q0p0234 1 100 0.00 1535.977 FORMAT "%8.3" ECU_ADDRESS 0x50000F6E /end MEASUREMENT
/begin MEASUREMENT rirint_w_msg "Relative inert-gas from internal EGR" UWORD rel_uw_q0p0234 1 100 0.00 1535.977 FORMAT "%8.3" ECU_ADDRESS 0x5000081A /end MEASUREMENT
/begin MEASUREMENT rir_w_msg "relative inert gas charge from int. and ext. EGR" UWORD rel_q0p0234 1 100 0.00 1535.977 FORMAT "%8.3" ECU_ADDRESS 0x60000686 /end MEASUREMENT
/begin MEASUREMENT rklabbr_w "Relative fuel amount for computation of lambda setpoint for burning cylinders" UWORD rel_q0p046875 1 100 0.00 3071.953 FORMAT "%8.3" ECU_ADDRESS 0x60000CD2 /end MEASUREMENT
/begin MEASUREMENT rksumev_w "Integrated (over 100ms) part of rk_w, which is injected by the Inj. vlaves" UWORD rel_uw_b491520 1 100 0.00 491512.5 FORMAT "%8.1" ECU_ADDRESS 0x60003F58 /end MEASUREMENT
/begin MEASUREMENT rksum_w "integrated rk_w" UWORD rel_uw_b491520 1 100 0.00 491512.5 FORMAT "%8.1" ECU_ADDRESS 0x60003F56 /end MEASUREMENT
/begin MEASUREMENT rktesu_w "Integrated rkte_w (over 100ms)" SWORD rel_uw_b491520 1 100 -245760.0 245752.5 FORMAT "%8.1" ECU_ADDRESS 0x60003F54 /end MEASUREMENT
/begin MEASUREMENT rlabs_w_msg "relative air charge (absolute load value) acc. to ISO 15031-5" UWORD rel_q0p0234 1 100 0.00 1535.977 FORMAT "%8.3" ECU_ADDRESS 0x60000DB8 /end MEASUREMENT
/begin MEASUREMENT rlaltas_w "air charge for air charge gradient one combust. cycle before" UWORD rel_uw_q0p0234 1 100 0.00 1535.977 FORMAT "%8.3" ECU_ADDRESS 0x70001A68 /end MEASUREMENT
/begin MEASUREMENT rldkmx_w_msg "relative air charge through throttle valve at pspvdkds = 1" UWORD rel_q0p02344 1 100 0.00 1535.977 FORMAT "%8.3" ECU_ADDRESS 0x60000E22 /end MEASUREMENT
/begin MEASUREMENT rldkugd_w_msg "relative air charge through throttle valve at ps/pvdkds = 0.95" UWORD rel_q0p02344 1 100 0.00 1535.977 FORMAT "%8.3" ECU_ADDRESS 0x60000E20 /end MEASUREMENT
/begin MEASUREMENT rlfdkrohloc_w "rel. fresh air over throttle blade (unfilterd) measured by throttle blade (local copy)" UWORD rel_uw_q0p0234 1 100 0.00 1535.977 FORMAT "%8.3" ECU_ADDRESS 0x500006BC /end MEASUREMENT
/begin MEASUREMENT rlfdkroh_w_msg "rel. fresh air over throttle blade (unfilterd) measured by throttle blade" UWORD rel_uw_q0p0234 1 100 0.00 1535.977 FORMAT "%8.3" ECU_ADDRESS 0x50000822 /end MEASUREMENT
/begin MEASUREMENT rlfgdssm_w_msg "Relative fresh air (air over DK and TEV), DSS-based (middle synchro)" UWORD rel_q0p0234 1 100 0.00 1535.977 FORMAT "%8.3" ECU_ADDRESS 0x50000828 /end MEASUREMENT
/begin MEASUREMENT rlfgdsvheg_w_msg "Relative fresh air charge based on high lift, DSS based" UWORD rel_q0p0234 1 100 0.00 1535.977 FORMAT "%8.3" ECU_ADDRESS 0x60004800 /end MEASUREMENT
/begin MEASUREMENT rlfgdsvhek_w_msg "Relative fresh air charge based on low lift, DSS based" UWORD rel_q0p0234 1 100 0.00 1535.977 FORMAT "%8.3" ECU_ADDRESS 0x600047FE /end MEASUREMENT
/begin MEASUREMENT rlfgds_w_msg "Relative fresh air (air over DK and TEV), DSS-based" UWORD rel_q0p0234 1 100 0.00 1535.977 FORMAT "%8.3" ECU_ADDRESS 0x50000826 /end MEASUREMENT
/begin MEASUREMENT rlfgks_w_msg "Corrected rel. desired air charge (air from throttle and EEC)" UWORD rel_uw_q0p0234 1 100 0.00 1535.977 FORMAT "%8.3" ECU_ADDRESS 0x60000E1E /end MEASUREMENT
/begin MEASUREMENT rlfglm_w_msg "Relative fresh air (air over DK and TEV), HFM-based" UWORD rel_q0p0234 1 100 0.00 1535.977 FORMAT "%8.3" ECU_ADDRESS 0x5000082A /end MEASUREMENT
/begin MEASUREMENT rlfgmnho_w_msg "rel. min. charge over throttle blade in mode homogeneous" UWORD rel_q0p02344 1 100 0.00 1535.977 FORMAT "%8.3" ECU_ADDRESS 0x60000E1C /end MEASUREMENT
/begin MEASUREMENT rlfgmp_w "Predicted relative fresh air in the combustion chamber" UWORD rel_uw_q0p0234 1 100 0.00 1535.977 FORMAT "%8.3" ECU_ADDRESS 0x70001A66 /end MEASUREMENT
/begin MEASUREMENT rlfgroh_w_msg "Relative fresh air over throttle valve before inatke-manifold model (unfiltered)" UWORD rel_uw_q0p0234 1 100 0.00 1535.977 FORMAT "%8.3" ECU_ADDRESS 0x60000696 /end MEASUREMENT
/begin MEASUREMENT rlfgs_w_msg "rel. desired air charge (air from throttle and EEC)" UWORD rel_q0p02344 1 100 0.00 1535.977 FORMAT "%8.3" ECU_ADDRESS 0x60000E1A /end MEASUREMENT
/begin MEASUREMENT rlfg_w_msg "Relative fresh air (air flowing over throttle valve and canister purge valve)" UWORD rel_q0p0234 1 100 0.00 1535.977 FORMAT "%8.3" ECU_ADDRESS 0x50000824 /end MEASUREMENT
/begin MEASUREMENT rlgas_w_msg "gradient of air charge at one combustion cycle" SWORD rel_q0p02344 1 100 -768.0000 767.9766 FORMAT "%8.4" ECU_ADDRESS 0x5000082C /end MEASUREMENT
/begin MEASUREMENT rllabbr_w "Relative load for computation of lambda setpoint for burning cylinders" UWORD rel_q0p0234 1 100 0.00 1535.977 FORMAT "%8.3" ECU_ADDRESS 0x60000CD0 /end MEASUREMENT
/begin MEASUREMENT rlminhom_w_msg "minimum air for homogeneous mode" UWORD rel_q0p02344 1 100 0.00 1535.977 FORMAT "%8.3" ECU_ADDRESS 0x60000E16 /end MEASUREMENT
/begin MEASUREMENT rlmin_w_msg "minimum permissible rl" UWORD rel_q0p02344 1 100 0.00 1535.977 FORMAT "%8.3" ECU_ADDRESS 0x60000E18 /end MEASUREMENT
/begin MEASUREMENT rlmnsa_w_msg "minimum permissible rl for fuel cut-off" UWORD rel_q0p02344 1 100 0.00 1535.977 FORMAT "%8.3" ECU_ADDRESS 0x60000E14 /end MEASUREMENT
/begin MEASUREMENT rlmn_w "minimum permissible rl" UWORD rel_q0p02344 1 100 0.00 1535.977 FORMAT "%8.3" ECU_ADDRESS 0x60000C76 /end MEASUREMENT
/begin MEASUREMENT rlmxsoe_w_msg "maximum desired air charge without further reducing interventions" UWORD rel_q0p0234 1 100 0.00 1535.977 FORMAT "%8.3" ECU_ADDRESS 0x60000DB6 /end MEASUREMENT
/begin MEASUREMENT rlmxs_w_msg "maximum desired air charge" UWORD rel_uw_q0p0234 1 100 0.00 1535.977 FORMAT "%8.3" ECU_ADDRESS 0x60000E12 /end MEASUREMENT
/begin MEASUREMENT rlmxvheg_w_msg "max. desired air charge in mode VHE" UWORD rel_q0p02344 1 100 0.00 1535.977 FORMAT "%8.3" ECU_ADDRESS 0x60000E10 /end MEASUREMENT
/begin MEASUREMENT rlmxvhek_w_msg "max. desired air charge in mode VHE small cam" UWORD rel_q0p02344 1 100 0.00 1535.977 FORMAT "%8.3" ECU_ADDRESS 0x60000E0E /end MEASUREMENT
/begin MEASUREMENT rlmxvl_w_msg "maximum attainable air charge at full load" UWORD rel_uw_q0p0234 1 100 0.00 1535.977 FORMAT "%8.3" ECU_ADDRESS 0x60000E0C /end MEASUREMENT
/begin MEASUREMENT rlnotn_w_msg "Relative air charge for main and sec. load error as a function of nmot (word)" UWORD rel_uw_q0p0234 1 100 0.00 1535.977 FORMAT "%8.3" ECU_ADDRESS 0x50000F70 /end MEASUREMENT
/begin MEASUREMENT rlpnb_w "relative air charge predicted, not limited" UWORD rel_uw_q0p0234 1 100 0.00 1535.977 FORMAT "%8.3" ECU_ADDRESS 0x500006BE /end MEASUREMENT
/begin MEASUREMENT rlpu_w "relative air charge predicted, lower limit" UWORD rel_uw_q0p0234 1 100 0.00 1535.977 FORMAT "%8.3" ECU_ADDRESS 0x70001A64 /end MEASUREMENT
/begin MEASUREMENT rlp_msg "relative air charge predicted for injection calculation" UBYTE rel_ub_q0p75 1 100 0.00 191.3 FORMAT "%5.1" ECU_ADDRESS 0x500008C2 /end MEASUREMENT
/begin MEASUREMENT rlp_w_msg "relative air charge predicted for injection calculation (Word)" UWORD rel_uw_q0p0234 1 100 0.00 1535.977 FORMAT "%8.3" ECU_ADDRESS 0x6000069A /end MEASUREMENT
/begin MEASUREMENT rlrintp_w_msg "Relative air charging internal EGR predicted" UWORD rel_uw_q0p0234 1 100 0.00 1535.977 FORMAT "%8.3" ECU_ADDRESS 0x70001C50 /end MEASUREMENT
/begin MEASUREMENT rlrints_w_msg "desired air charge ratio int. egr" UWORD rel_uw_q0p0234 1 100 0.00 1535.977 FORMAT "%8.3" ECU_ADDRESS 0x50000F72 /end MEASUREMENT
/begin MEASUREMENT rlrint_w_msg "Relative air charging internal EGR" UWORD rel_uw_q0p0234 1 100 0.00 1535.977 FORMAT "%8.3" ECU_ADDRESS 0x600006A2 /end MEASUREMENT
/begin MEASUREMENT rlrohmp_w "Relative air charge intake manifold flow for extrapolated intake manifold pressure" UWORD rel_uw_q0p0234 1 100 0.00 1535.977 FORMAT "%8.3" ECU_ADDRESS 0x500006C0 /end MEASUREMENT
/begin MEASUREMENT rlr_w_msg "relative air-load over int. and ext. EGR" UWORD rel_q0p0234 1 100 0.00 1535.977 FORMAT "%8.3" ECU_ADDRESS 0x600006A0 /end MEASUREMENT
/begin MEASUREMENT rlshhkid_w_msg "rel. desired air charge homogeneous operation mode corrected with Istdynamics" UWORD rel_q0p02344 1 100 0.00 1535.977 FORMAT "%8.3" ECU_ADDRESS 0x700029A0 /end MEASUREMENT
/begin MEASUREMENT rlshhk_w_msg "desired charge for current homogeneous operation mode corrected" UWORD rel_q0p02344 1 100 0.00 1535.977 FORMAT "%8.3" ECU_ADDRESS 0x60000E0A /end MEASUREMENT
/begin MEASUREMENT rlshk_msg "desired relative air charge corrected by altitude" UBYTE rel_ub_q0p75 1 100 0.00 191.3 FORMAT "%5.1" ECU_ADDRESS 0x700029AE /end MEASUREMENT
/begin MEASUREMENT rlshk_w_msg "desired relative air charge corrected by altitude" UWORD rel_q0p02344 1 100 0.00 1535.977 FORMAT "%8.3" ECU_ADDRESS 0x700029A2 /end MEASUREMENT
/begin MEASUREMENT rlsh_w_msg "desired charge for current homogeneous operation mode" UWORD rel_q0p02344 1 100 0.00 1535.977 FORMAT "%8.3" ECU_ADDRESS 0x7000299E /end MEASUREMENT
/begin MEASUREMENT rlsolg_w_msg "desired valid charge (Error --> switch to actual charge)" UWORD rel_q0p02344 1 100 0.00 1535.977 FORMAT "%8.3" ECU_ADDRESS 0x60000E06 /end MEASUREMENT
/begin MEASUREMENT rlsolhom_w_msg "desired relative air charge" UWORD rel_uw_q0p0234 1 100 0.00 1535.977 FORMAT "%8.3" ECU_ADDRESS 0x60000AFE /end MEASUREMENT
/begin MEASUREMENT rlsolubid_w_msg "desired relative air charge unlimited with Istdynamics" UWORD rel_q0p02344 1 100 0.00 1535.977 FORMAT "%8.3" ECU_ADDRESS 0x700029A4 /end MEASUREMENT
/begin MEASUREMENT rlsol_w_msg "desired relative air charge(message)" UWORD rel_q0p02344 1 100 0.00 1535.977 FORMAT "%8.3" ECU_ADDRESS 0x60000E08 /end MEASUREMENT
/begin MEASUREMENT rlsw_w_msg "desired relative air charge for reuse for addressing the camshaft and calculating the desired boost pressure" UWORD rel_q0p02344 1 100 0.00 1535.977 FORMAT "%8.3" ECU_ADDRESS 0x60000E04 /end MEASUREMENT
/begin MEASUREMENT rl_msg "relative air charge" UBYTE rel_q0p75 1 100 0.00 191.3 FORMAT "%5.1" ECU_ADDRESS 0x600007BA /end MEASUREMENT
/begin MEASUREMENT rl_w_msg "Relative air charge" UWORD rel_q0p0234 1 100 0.00 1535.977 FORMAT "%8.3" ECU_ADDRESS 0x50000820 /end MEASUREMENT
/begin MEASUREMENT rml_msg "relative air mass (calc. load value) acc. to SAE J1979" UBYTE rel_ub_b99p6 1 100 0.00 99.61 FORMAT "%5.2" ECU_ADDRESS 0x60000DAC /end MEASUREMENT
/begin MEASUREMENT rri_w_msg "Residue gas/inert gas ratio by internal and external EGR" UWORD rel_uw_b100 1 100 0.00 99.99847 FORMAT "%8.5" ECU_ADDRESS 0x600006A6 /end MEASUREMENT
/begin MEASUREMENT SnsrSlowClassB1.ratLamSp "Lambda set point calculation in case of slow lambda sensor, bank 1 / Lambda setpoint" UWORD fak_q0p000244 1 100 0.00 15.99976 FORMAT "%8.5" ECU_ADDRESS 0x60000A6A /end MEASUREMENT
/begin MEASUREMENT SnsrSlowClassB1.SnsrSlowDT_I.buffer "Lambda set point calculation in case of slow lambda sensor, bank 1 / Delay time element for sensor slow down / Time delay" UWORD fak_uw_b1 1 100 0.00 0.9999847 FORMAT "%9.7" ARRAY_SIZE 21 ECU_ADDRESS 0x60000A6C /end MEASUREMENT
/begin MEASUREMENT SnsrSlowClassB1.SnsrSlowDT_I.counter "Lambda set point calculation in case of slow lambda sensor, bank 1 / Delay time element for sensor slow down / Time delay" UWORD fak_uw_b2 1 100 0.00 1.000000 FORMAT "%8.6" ECU_ADDRESS 0x60000A96 /end MEASUREMENT
/begin MEASUREMENT SnsrSlowClassB1.SnsrSlowDT_I.ds "Lambda set point calculation in case of slow lambda sensor, bank 1 / Delay time element for sensor slow down / Time delay" UWORD fak_uw_b2 1 100 0.00 1.000000 FORMAT "%8.6" ECU_ADDRESS 0x60000A98 /end MEASUREMENT
/begin MEASUREMENT SnsrSlowClassB1.SnsrSlowDT_I.pointer "Lambda set point calculation in case of slow lambda sensor, bank 1 / Delay time element for sensor slow down / Time delay" UBYTE dez 1 100 0.00 255.0 FORMAT "%5.1" ECU_ADDRESS 0x60000A9A /end MEASUREMENT
/begin MEASUREMENT SnsrSlowClassB1.SnsrSlowLT_I.memory "Lambda set point calculation in case of slow lambda sensor, bank 1 / Lowpass for sensor slow down / current lowpass value" ULONG fak_q3p72529Em9 1 100 0.00 15.9999999963 FORMAT "%13.10" ECU_ADDRESS 0x60000A9C /end MEASUREMENT
/begin MEASUREMENT tabmot_w_msg "Engine shut-down time (calculated from combined message)" UWORD t_q4_s 1 100 0.00 262140.0 FORMAT "%8.1" ECU_ADDRESS 0x600047FC /end MEASUREMENT
/begin MEASUREMENT tabst_w "stop time" UWORD t_q1 1 100 0.00 65535.00 FORMAT "%8.2" ECU_ADDRESS 0x60003F50 /end MEASUREMENT
/begin MEASUREMENT tabst_w_msg "stop time" UWORD t_q1 1 100 0.00 65535.00 FORMAT "%8.2" ECU_ADDRESS 0x600047FA /end MEASUREMENT
/begin MEASUREMENT tadk_w_msg "intake air temperature at throttle" UWORD temp_q0p0234_o273 1 100 -273.150 1262.827 FORMAT "%8.3" ECU_ADDRESS 0x600047F8 /end MEASUREMENT
/begin MEASUREMENT tasrm_w_msg "air temperature in manifold, modelled" UWORD temp_q0p0234_o273 1 100 -273.150 1262.827 FORMAT "%8.3" ECU_ADDRESS 0x50005C78 /end MEASUREMENT
/begin MEASUREMENT tas_w_msg "time during one working cycle for rlgas_w_msg" UWORD t_q16us 1 100 0.00 1048560. FORMAT "%8.0" ECU_ADDRESS 0x70001C4E /end MEASUREMENT
/begin MEASUREMENT tavdkm_w_msg "air temperature upstream throttle, modelled" UWORD temp_q0p0234_o273 1 100 -273.150 1262.827 FORMAT "%8.3" ECU_ADDRESS 0x6000E330 /end MEASUREMENT
/begin MEASUREMENT tengsq1z_w_msg "Motorstandzeit zum Zeitpunkt des ersten Motordrehens im Fahrzyklus" UWORD t_q1 1 100 0.00 65535.00 FORMAT "%8.2" ECU_ADDRESS 0x70002D0E /end MEASUREMENT
/begin MEASUREMENT tengsq1_w_msg "engine stop time (measured from each engine stop or stall)" UWORD t_q1 1 100 0.00 65535.00 FORMAT "%8.2" ECU_ADDRESS 0x6000E332 /end MEASUREMENT
/begin MEASUREMENT tengszlst_msg "state of variable tengsz_l" UBYTE dez 1 100 0.00 255.0 FORMAT "%5.1" ECU_ADDRESS 0x60009FE4 /end MEASUREMENT
/begin MEASUREMENT tengsz_w_msg "engine stop time copied at the time of first engine start in the driving cycle" UWORD t_q4_s 1 100 0.00 262140.0 FORMAT "%8.1" ECU_ADDRESS 0x600047EC /end MEASUREMENT
/begin MEASUREMENT tengs_w_msg "engine stop time (measured from each engine stop or stall)" UWORD t_q4_s 1 100 0.00 262140.0 FORMAT "%8.1" ECU_ADDRESS 0x70002D0C /end MEASUREMENT
/begin MEASUREMENT timinausgpfi_w_msg "minimale Einspritzzeit ausgabe PFI im Dualsystem" UWORD t_q0p001_ms 1 100 0.00 65.53500 FORMAT "%8.5" ECU_ADDRESS 0x60000DB2 /end MEASUREMENT
/begin MEASUREMENT tmotfilk_w "filtered engine temperature" UWORD temp_q0p0234_o273 1 100 -273.150 1262.827 FORMAT "%8.3" ECU_ADDRESS 0x60037E7C /end MEASUREMENT
/begin MEASUREMENT top_w_msg "operating time" UWORD t6minxmin_q6 1 100 0.00 393210.0 FORMAT "%8.1" ECU_ADDRESS 0x50005C7A /end MEASUREMENT
/begin MEASUREMENT tppsrifd_w "variable time constant lowpass-filter for psrif_w" UWORD fak_q3p0518Em5 1 100 0.00 1.999969 FORMAT "%8.6" ECU_ADDRESS 0x6000049A /end MEASUREMENT
/begin MEASUREMENT trfrints_w_msg "Temp. of int. residual gas at intake manif.press. level(desired mode)" UWORD temp_q0p0234_o273 1 100 -273.150 1262.827 FORMAT "%8.3" ECU_ADDRESS 0x60000DFC /end MEASUREMENT
/begin MEASUREMENT trfrint_w_msg "Temp. of the internal residue gas at the pressure level of the intake manifold" UWORD temp_q0p0234_o273 1 100 -273.150 1262.827 FORMAT "%8.3" ECU_ADDRESS 0x60000DFE /end MEASUREMENT
/begin MEASUREMENT triresp_w "Temp. of the residual gas that has flown into intake manifold at the pressure level of the intake manifold" UWORD temp_q0p0234 1 100 0.00 1535.977 FORMAT "%8.3" ECU_ADDRESS 0x60000C9A /end MEASUREMENT
/begin MEASUREMENT triresr_w "Temp. of the internal residue gas at the pressure level of the intake manifold" UWORD temp_q0p0234 1 100 0.00 1535.977 FORMAT "%8.3" ECU_ADDRESS 0x60000C98 /end MEASUREMENT
/begin MEASUREMENT trirsp_w_msg "Temp. of re-aspirated portion of the relative charge (inert gas + air) via internal EGR" UWORD temp_q0p0234_o273 1 100 -273.150 1262.827 FORMAT "%8.3" ECU_ADDRESS 0x60000DFA /end MEASUREMENT
/begin MEASUREMENT trlrlsdk_w "time constant for time constant rl/rlsol-low-pass filter in suction area" UWORD t_q0p001 1 100 0.00 65.53500 FORMAT "%8.5" ECU_ADDRESS 0x60000C80 /end MEASUREMENT
/begin MEASUREMENT trlrlsol_w_msg "time constant for settling period of rl/rlsol" UWORD t_q0p01 1 100 0.0100 655.3500 FORMAT "%8.4" ECU_ADDRESS 0x60000DF8 /end MEASUREMENT
/begin MEASUREMENT trlrls_w_msg "time constant for settling period of rlrlsol (more precise resolution than trlrlsol_w_msg)" UWORD zk1msxs_uw_b65p536 1 100 0.001000015 65.536000000 FORMAT "%12.9" ECU_ADDRESS 0x700029A6 /end MEASUREMENT
/begin MEASUREMENT tsaugr_w_msg "Time constant intake manifold" UWORD t_q0p01 1 100 0.0200 655.3500 FORMAT "%8.4" ECU_ADDRESS 0x700029A8 /end MEASUREMENT
/begin MEASUREMENT tsaug_w_msg "Time constant intake manifold (more precise resolution than tsaugr_w_msg)" UWORD t_q0p001 1 100 0.01000 65.53500 FORMAT "%8.5" ECU_ADDRESS 0x60000DF6 /end MEASUREMENT
/begin MEASUREMENT twvev_w_msg "wall temperature of intake manifold near inlet valve" UWORD temp_q0p0234_o273 1 100 -273.150 1262.827 FORMAT "%8.3" ECU_ADDRESS 0x600047DC /end MEASUREMENT
/begin MEASUREMENT ufmsfreg_w "Conversion, charge into mass flow of charge controller" UWORD m_q0p0005 1 100 0.00 32.76750 FORMAT "%8.5" ECU_ADDRESS 0x60000C7E /end MEASUREMENT
/begin MEASUREMENT ummsnms1_w "Conversion of standardized mass flow into mass flow at throttle blade, bank1" UWORD fak_q1p22Em4 1 100 0.00 7.999878 FORMAT "%8.6" ECU_ADDRESS 0x70001A70 /end MEASUREMENT
/begin MEASUREMENT ummsnms_w_msg "Conversion of standardized mass flow into mass flow at throttle blade" UWORD fak_uw_b8 1 100 0.00 7.999878 FORMAT "%8.6" ECU_ADDRESS 0x600006B0 /end MEASUREMENT
/begin MEASUREMENT umsnms1f_w "Conversion of standardized mass flow into mass flow at throttle blade, bank1 msdpvf_w" UWORD fak_q1p22Em4 1 100 0.00 7.999878 FORMAT "%8.6" ECU_ADDRESS 0x70001A6E /end MEASUREMENT
/begin MEASUREMENT umsnms1n_w "Conversion of standardized mass flow into mass flow at throttle blade, bank1 msdkpmn_w" UWORD fak_q1p22Em4 1 100 0.00 7.999878 FORMAT "%8.6" ECU_ADDRESS 0x70001A6C /end MEASUREMENT
/begin MEASUREMENT umsnms1x_w "Conversion of standardized mass flow into mass flow at throttle blade, bank1 msdkpmx_w" UWORD fak_q1p22Em4 1 100 0.00 7.999878 FORMAT "%8.6" ECU_ADDRESS 0x50000F34 /end MEASUREMENT
/begin MEASUREMENT umsnms2n_w "Conversion of standardized mass flow into mass flow at throttle blade, bank2 msdkpmn_w" UWORD fak_q1p22Em4 1 100 0.00 7.999878 FORMAT "%8.6" ECU_ADDRESS 0x6000049C /end MEASUREMENT
/begin MEASUREMENT umsnms2x_w "Conversion of standardized mass flow into mass flow at throttle blade, bank2 msdkpmx_w" UWORD fak_q1p22Em4 1 100 0.00 7.999878 FORMAT "%8.6" ECU_ADDRESS 0x60000C84 /end MEASUREMENT
/begin MEASUREMENT umsrlnk_w_msg "umsrln_w_msg limited at low engine speed" UWORD m_q0p0005 1 100 0.00 32.76750 FORMAT "%8.5" ECU_ADDRESS 0x60000B04 /end MEASUREMENT
/begin MEASUREMENT umsrln_w_msg "calculation factor load to mass flow" UWORD m_q0p0005 1 100 0.00 32.76750 FORMAT "%8.5" ECU_ADDRESS 0x600006B4 /end MEASUREMENT
/begin MEASUREMENT uproml_w "constant for transformation from % into ml" UWORD ASCET_tmp4 1 100 0.00 0.01017237 FORMAT "%10.8" ECU_ADDRESS 0x60003F52 /end MEASUREMENT
/begin MEASUREMENT vpexpkap_w "pressure ratio for adressing of curve ""exponent kappa""" UWORD fak_uw_b4 1 100 0.00 3.999939 FORMAT "%8.6" ECU_ADDRESS 0x60000C96 /end MEASUREMENT
/begin MEASUREMENT vpsab_w "Pressure ratio of manifold pressure and exhaust gas backpressure for effective exhaust gas backpressure for charge models" UWORD fak_uw_b4 1 100 0.00 3.999939 FORMAT "%8.6" ECU_ADDRESS 0x60000C94 /end MEASUREMENT
/begin MEASUREMENT vpsrabg_w "pressure ratio manifold pressure to exhaust gas back pressure" UWORD fak_uw_b2 1 100 0.00 1.999969 FORMAT "%8.6" ECU_ADDRESS 0x60000C92 /end MEASUREMENT
/begin MEASUREMENT vpsrpuakt_w "pressure ratio psr to pu" UWORD fak_uw_b4 1 100 0.00 3.999939 FORMAT "%8.6" ECU_ADDRESS 0x60000C90 /end MEASUREMENT
/begin MEASUREMENT vpsrvdb_w_msg "quotient: int.manif.press.divided by press.upstream of throttle valve limit" UWORD fak_uw_b2 1 100 0.00 1.999969 FORMAT "%8.6" ECU_ADDRESS 0x50000838 /end MEASUREMENT
/begin MEASUREMENT vpsrvdk_w_msg "quotient: intake manifold pressure divided by pressure upstream throttle" UWORD fak_uw_b2 1 100 0.00 1.999969 FORMAT "%8.6" ECU_ADDRESS 0x600006BE /end MEASUREMENT
/begin MEASUREMENT vpsrvd_w_msg "quotient manifold pressure/pressure before throttle plate" UWORD fak_uw_b2 1 100 0.00 1.999969 FORMAT "%8.6" ECU_ADDRESS 0x60000DF4 /end MEASUREMENT
/begin MEASUREMENT vsaugr_w_msg "Volume, intake manifold" UWORD vol_q0p702Em3_dm3 1 100 0.00 46.00562 FORMAT "%8.5" ECU_ADDRESS 0x60000DF2 /end MEASUREMENT
/begin MEASUREMENT vvexpkap_w "volume ratio for adressing of curve ""exponent kappa""" UWORD fak_uw_b4 1 100 0.00 3.999939 FORMAT "%8.6" ECU_ADDRESS 0x60000C8E /end MEASUREMENT
/begin MEASUREMENT wdkmsmx_w_msg "throttle balde angle for maximum air mass flow" UWORD rel_uw_b100 1 100 0.00 99.99847 FORMAT "%8.5" ECU_ADDRESS 0x60000DEE /end MEASUREMENT
/begin MEASUREMENT wdkm_w "throttle angle with respect to lower mechanical stop (mean value 1 seg.)" UWORD rel_uw_b100 1 100 0.00 99.99847 FORMAT "%8.5" ECU_ADDRESS 0x600004A0 /end MEASUREMENT
/begin MEASUREMENT wdktn_w "Throttle valve angle for minimum mass flow through throttle valve due to tolerances" UWORD rel_uw_b100 1 100 0.00 99.99847 FORMAT "%8.5" ECU_ADDRESS 0x600004A2 /end MEASUREMENT
/begin MEASUREMENT wdktx_w "Throttle valve angle for maximum mass flow through throttle valve due to tolerances" UWORD rel_uw_b100 1 100 0.00 99.99847 FORMAT "%8.5" ECU_ADDRESS 0x500006C4 /end MEASUREMENT
/begin MEASUREMENT wgvums_w "Av.value: overlap angle GWV f. re-aspir. residual gas(SCH-mode)" SWORD kw_q0p0156 1 100 -512.0000 511.9844 FORMAT "%8.4" ECU_ADDRESS 0x60000C8C /end MEASUREMENT
/begin MEASUREMENT wgvum_w_msg "Center value overlap angle gas change valve for re-aspirated residue gas" SWORD kw_q0p0156 1 100 -512.0000 511.9844 FORMAT "%8.4" ECU_ADDRESS 0x60000E7E /end MEASUREMENT
/begin FUNCTION BGFKMS "38.1.0    Calculated value correction factor air mass flow"
 /begin DEF_CHARACTERISTIC ChrCtl_tiMFlowAdpnFastNeutVal_C ChrCtl_tiMFlowAdpnFast_C ChrCtl_tiMFlowAdpnFast_T ChrCtl_tiMFlowAdpnSlowEol_C ChrCtl_tiMFlowAdpnSlow_T ChrCtl_tiMFlowFacFastAdjmtRst_C ChrCtl_tiMFlowLeakFltMaiLoadSnsr_C ChrCtl_tiThrVlvMFlowLeakAdpnEol_C ChrCtl_tiThrVlvMFlowLeakAdpnLeak_C ChrCtl_tiThrVlvMFlowLeakAdpnLrgDe_C ChrCtl_tiThrVlvMFlowLeakAdpn_C CWBGFKMS DFAFKPVDKE DFAOMSNDE DFEADKE DFHYSAOMSNDE DFKMSDSTZ DOFMSNDMSLL DTAFKPVDKE DTAOMSNDKE FKMSDKMN FKMSDKMX FKPVDKMN FKPVDKMSMN FKPVDKMX FKPVDKPMN FKPVDKPUGD KLVPSPVDMNFASA MTOLMSTE NDKADVSLMX NMOTFADKMN NMOTFADKMX NMOTOFDKMN NMOTOFDKMN2 NMOTOFDKMX NMOTOFDKMX2 OFMSNDKINI OFMSNDKINI2 OFMSNDKMN OFMSNDKMN2 OFMSNDKMX OFMSNDKMX2 OFMSNDMSMN OFMSNDMSMN2 OFMSNDMSMX OFMSNDMSMX2 OFMSNDMSMX3 TAFKPVDKE TAOFMSNDKE TDABGLST TDDTEVFGAB TDSAFGABGL TDSAOFMNDP TDWDKSUGD VPSPVDMNFA /end DEF_CHARACTERISTIC
 /begin IN_MEASUREMENT B_bkvmsisr_msg B_dsshfs_msg B_dteaam_msg B_dtest_msg B_fafkmsla_msg B_falzsr_msg B_fgdkabgs_msg B_hos_msg B_ll_msg B_msddkg_msg B_psrgg_msg B_psrmozdg_msg B_rqttev_msg B_sa_msg CoEOM_flgStrat dmsnte_w_msg Eep_EnvRamHist Eep_EnvRamInvld Epm_nEng Epm_nEngLRes msdkds_w_msg msdk_w_msg msndks_w_msg mste_msg psr_w_msg pvd_w_msg SyC_stSub ThrVlv_flgSngSensErrSuspcB1 tnst_w_msg /end IN_MEASUREMENT
 /begin OUT_MEASUREMENT B_adkose_msg B_adkospe_msg B_adkpe_msg B_afkpvdke_msg B_afkpvdpe_msg B_ahfsnfsa_msg B_amsndkoe_msg B_aomsndpe_msg B_dschlldk_msg B_fadkoap_msg B_fgabgla_msg B_fgabglp_msg B_fgabgl_msg B_fgsabglp_msg B_fkpvdkp_msg B_fkpvdk_msg B_iniabga_msg B_inilabgp_msg B_ofmsndkp1_msg B_ofmsndkp2_msg B_ofmsndkp_msg B_ofmsndk_msg B_zwfdkap_msg B_zwfdka_msg dfuelsan_w_msg dkpsrmh_w_msg fkmsdkh_w_msg fkmsdkp_w_msg fkmsdksp_w_msg fkmsdks_w_msg fkmsdk_w_msg fkpvdkp_w_msg fkpvdk_w_msg ofmsndap_w_msg ofmsndkh1_w_msg ofmsndkh2_w_msg ofmsndkp1_w_msg ofmsndkp2_w_msg ofmsndkp_w_msg ofmsndk_w_msg vpsrvd_w_msg /end OUT_MEASUREMENT
 /begin LOC_MEASUREMENT B_afkpvdei B_inisabgp B_vpspvd ChrCtl_flgRstDsmAdpnEtc100ms ChrCtl_flgRstDsmAdpnEtc10ms ChrCtl_flgRstDsmAdpnEtcGen ChrCtl_flgRstDsmAdpnEtcMAF ChrCtl_flgRstDsmAdpnEtcMAP ChrCtl_tiMFlowAdpnFastBasdIntkMnfldSnsr ChrCtl_tiThrVlvMFlowLeakAdpnMAP dfkmsdsp_w dfmsdsp_w dfuelanp_w dofmsndmsll_w fkpvdkah_w fkpvdkap_w fkpvdkh_w klvpspv_w msdkdslocadpn_w msdklocadpn_w msdkoolocadpn_w ofmsdap_w ofmsdkp_w ofmsndah1_w ofmsndah2_w ofmsndap1_w ofmsndap2_w /end LOC_MEASUREMENT
 FUNCTION_VERSION "38.1.0" /end FUNCTION
/begin FUNCTION BGKV "18.9.0_6.1.0Calculation variable consumed fuel"
 /begin DEF_CHARACTERISTIC FMCO2L InjSys_ratStoicPfi_C InjSys_rhoFuStd_C InjSys_volCylPfi_C /end DEF_CHARACTERISTIC
 /begin IN_MEASUREMENT Epm_ctCyl Epm_nEng Epm_numCyl evz_austot_msg InjSys_ratFuM rkte_w_msg SyC_stSub /end IN_MEASUREMENT
 /begin OUT_MEASUREMENT InjSys_dmCo2 InjSys_dvolFu InjSys_dvolFuInjr InjSys_dvolFumL InjSys_mfEngFuRate InjSys_mfVehFuRate InjSys_volFuConsDrvCyc InjSys_volFuConsDrvCycCAN /end OUT_MEASUREMENT
 /begin LOC_MEASUREMENT cycbgkv_w InjSys_dvolFuPerHr InjSys_facCnvnRatFuMPfiGr InjSys_mFuMSum InjSys_mFuMSync InjSys_ratFuMPerSync InjSys_rhoFuStdPfi InjSys_tiSynPerCyc rksumev_w rksum_w rktesu_w uproml_w /end LOC_MEASUREMENT
 FUNCTION_VERSION "18.9.0_6.1.0" /end FUNCTION
/begin FUNCTION BGLASO "1.34.0    Calculation of desired lambda for lambda sensor" /begin DEF_CHARACTERISTIC CWBGLASO FRIRLABBR LASTCMN LASTCMX /end DEF_CHARACTERISTIC
 /begin IN_MEASUREMENT B_stendes_msg dlaso_msg EGSDO2_tiDlyAdpnS1B1 EGSDO2_tiTranAdpnS1B1 Epm_nEng InjSys_ratPrdcAirLamDes lamsbg_w_msg redistb1_msg rir_w_msg SyC_stSub tlrslb_w_msg UEGO_rLamS1B1 zlrsb_w_msg /end IN_MEASUREMENT
 /begin OUT_MEASUREMENT B_lasostc_msg labbrm_w_msg labrgs_w_msg LamCtrl_ratLamSpNoDynS1B1 LamCtrl_ratLamSpS1B1 LamCtrl_tiDeadTiCorrdHomStratBnk1 lamsbrs_w_msg lamsobd_w_msg lamsons_w_msg lassa_w_msg /end OUT_MEASUREMENT
 /begin LOC_MEASUREMENT B_totab evabkor_w LamCtrl_flgIninSpB1 rklabbr_w rllabbr_w SnsrSlowClassB1.ratLamSp SnsrSlowClassB1.SnsrSlowDT_I.buffer SnsrSlowClassB1.SnsrSlowDT_I.counter SnsrSlowClassB1.SnsrSlowDT_I.ds SnsrSlowClassB1.SnsrSlowDT_I.pointer SnsrSlowClassB1.SnsrSlowLT_I.memory /end LOC_MEASUREMENT
 FUNCTION_VERSION "1.34.0" /end FUNCTION
/begin FUNCTION BGLWM "37.1.0_1.0.1Calculation for charge exchange model"
 /begin DEF_CHARACTERISTIC AirMod_facDia_T AirMod_facFcoCorrnRampIn_C AirMod_facFcoCorrnRampOut_C AirMod_FacFilDmCyl2ExhMnfld_T AirMod_pExhDeltaDia_M AirMod_pOffsCorrnFcoLoLft_M AirMod_pOffsCorrnFco_M CWBGLWM CWBGLWM2 CWPABEF CWPIRGKL1 DPABEFO DPABEFU DPBRINTTN DPBRINTTX EXP1DKAPPA EXPKAPPA EXPTERMKAP FAFRSPVP FFUPSRLTN FFUPSRLTX FIMXFADK FIMXVP FIMXVPVHE FTMSDV FUPSRLMN FUPSRLMX FVBR KFDIPABERGVP KFDIPABERGVP1 KFDPBRMXWE KFDPBRMXWE1 KFDPBRMXWU1 KFDPBRWE KFDPBRWE1 KFFPBRKSVN KFFPBRKSVN1 KFIPABERG KLFPBRGRVIVC KLFPBRGRVIVCVHE KLGRFVBRWVHE MSNRIRSP PBRINTMN PBRINTMX /end DEF_CHARACTERISTIC
 /begin REF_CHARACTERISTIC KLFEXPSL GEVCtl_stPhaAdpr_C /end REF_CHARACTERISTIC
 /begin IN_MEASUREMENT B_wgvsvheg_msg CEngDsT_t Epm_nEng Epm_nEng10ms ExhMod_pExhCat1UsB1 ExhMod_tExhMnfB1 ExhMod_tExhMnfQstyB1 ftahev_w_msg GEVCtl_agClsdIntkSpclOutl GEVCtl_agClsdIntkStdOutl GEVCtl_agIntkClsd GEVCtl_agIntkOpen GEVCtl_agOutlClsd GEVCtl_agSpclLftIntkClsd GEVCtl_agSpclLftIntkOpen GEVCtl_agSpIntkClsd GEVCtl_agSpIntkOpen GEVCtl_agSpOutlClsd GEVCtl_agStdLftIntkClsd GEVCtl_agStdLftIntkOpen GEVCtl_flgActAgStdLftIntk Ign_iacalc_s8 Ign_iaPr_s8 IntkAirT_tIntkMnfld pabnavfe_w_msg PEnv_p psrdkugd_w_msg psrhoms_w_msg psr_w_msg PthSet_bOvrRun pvd_w_msg quotntke_w_msg SyC_stSub taev_w_msg tahev_w_msg ThrVlv_bDblSensErrSuspcDeb_msg ThrVlv_ratActPosnB1 ThrVlv_ratLimpAirPosnB1 toch_msg umsrln_w_msg vpsrvdk_w_msg wdks_w_msg wdkugd_w_msg wgvohsme_w_msg wgvshsma_w_msg wgvshsme_w_msg /end IN_MEASUREMENT
 /begin OUT_MEASUREMENT B_fupivheg_msg fpbrps_w_msg fpbrsrs_w_msg fupshoms_w_msg fupsrlmx_w_msg fupsrls_w_msg fupsrltn_w_msg fupsrltx_w_msg fupsrlug_w_msg fupsrl_w_msg fupsvheg_w_msg fupsvhek_w_msg pbrihoms_w_msg pbrintmx_w_msg pbrints_w_msg pbrinttn_w_msg pbrinttx_w_msg pbrintug_w_msg pbrintuk_w_msg pbrint_w_msg pbrivheg_w_msg pbrivhek_w_msg rfrihoms_w_msg rfrints_w_msg rfrint_w_msg rfrires_w_msg rfrirsp_w_msg rfrivheg_w_msg rfrivhek_w_msg ririhoms_w_msg ririntp_w_msg rirints_w_msg rirint_w_msg rlrintp_w_msg rlrints_w_msg rlrint_w_msg trfrints_w_msg trfrint_w_msg trirsp_w_msg wgvum_w_msg /end OUT_MEASUREMENT
 /begin LOC_MEASUREMENT AirMod_dia AirMod_facDia AirMod_facFcoCorrnRamp AirMod_pOffsCorrnFco AirMod_pOffsCorrnFcoDes AirMod_ratInertGasCylCorrnFco AirMod_ratInertGasCylCorrnFcoDes dpbreops_w fkl1_w fkl2_w fpbrpsg_w fpbrpsmx_w fpbrpsug_w fupsrlro_w grfvbr_w labbris_w msrirsp_w nmotsw_w nmottkor_w pabefrg_w pbrintro_w rfkrbrr_w rfrimx_w rfrintros_w rfrintro_w rfriresr_w rfrirssr_w rfriug_w triresp_w triresr_w vpexpkap_w vpsab_w vpsrabg_w vpsrpuakt_w vvexpkap_w wgvums_w /end LOC_MEASUREMENT
 FUNCTION_VERSION "37.1.0_1.0.1" /end FUNCTION
/begin FUNCTION BGMSDK "18.8.1    Calculation: mass flow through throttle valve"
 /begin DEF_CHARACTERISTIC ChrCtl_facMfUGD_C ChrCtl_facSuctnRefLoLft_T ChrCtl_facSuctnRef_T ChrCtl_pDifOpenThrRefLoLft_T ChrCtl_pDifOpenThrRef_T CWBGMSDK DANZSYN DWDKMXWDK FIUWMSDKVHEKXN FIUWMSDKXN FKVDVP FMSNDKTN FMSNDKTX KFMSNWDKVP KMSDK OFMSNDKTN OFMSNDKTX TUGDTX VPSRMHVDUG VPSRVDUGD /end DEF_CHARACTERISTIC
 /begin IN_MEASUREMENT B_psrgg_msg B_psrmozdg_msg B_psrmozpnxg_msg B_pvdg_msg B_rlp_msg B_syn2fe_msg B_tavdkg_msg B_vheg_msg dkpsrmh_w_msg Epm_nEng fkmsdks_w_msg fkmsdk_w_msg fpvd_w_msg ftavdkmn_w_msg ftavdkmx_w_msg ftvdk_w_msg fupsrl_w_msg msdkmx_w_msg msdkugd_w_msg msdkugpn_w_msg ofmsndk_w_msg pbrint_w_msg psrgsm_w_msg psrg_w_msg psrmhmi_w_msg psrmh_w_msg psrmmn_w_msg psrmmx_w_msg psrmp_w_msg pvdmn_w_msg pvdmx_w_msg pvd_w_msg SyC_stSub ThrVlv_flgReqFuCutOffB1 ThrVlv_flgSngSensErrSuspcB1 ThrVlv_ratActPosnB1 ThrVlv_ratActPosnMaxB1 ThrVlv_ratActPosnMinB1 ThrVlv_ratLimpAirPosnB1 wdkbap_w_msg wdkugd_w_msg wdkugtx_w_msg /end IN_MEASUREMENT
 /begin OUT_MEASUREMENT B_2synpmX_msg B_dugdtx_msg B_msddkg_msg B_msdkpnxg_msg B_msdpg_msg B_ugdtx_msg B_ugd_msg B_vpdkugd_msg ChrCtl_flgChrgCalcnTiBasd dmsdkugd_w_msg fiuewdk_w_msg fklafa_w_msg ftpavdn_w_msg ftpavdx_w_msg ftpavd_w_msg ftpvd_w_msg msdkosa_w_msg msdkpmn_w_msg msdkpmx_w_msg msdk_w_msg msdp_w_msg msndkoo_w_msg msndk_w_msg ummsnms_w_msg vpsrvdb_w_msg vpsrvdk_w_msg wdkmsmx_w_msg /end OUT_MEASUREMENT
 /begin LOC_MEASUREMENT B_dugdhtx B_pugd B_pugdp B_wugdp ChrCtl_facPCorrnOpenThr ChrCtl_facSuctnCorrnOpenThr ChrCtl_nEngCorrd dmsdkugp_w kmsdk_w msdkoue_w msdouep_w msdpmn_w msdpvf_w msdue_w msdvf_w ummsnms1_w umsnms1f_w umsnms1n_w umsnms1x_w umsnms2n_w umsnms2x_w wdkm_w wdktn_w wdktx_w /end LOC_MEASUREMENT
 FUNCTION_VERSION "18.8.1" /end FUNCTION
/begin FUNCTION BGMSDKS "16.8.0    Calculation of set air mass flow through throttling valve"
 /begin DEF_CHARACTERISTIC ChrCtl_nEngMinLoadMfCorrn_C ChrCtl_ratChrgMinOffs_C ChrCtl_tiFcoEndDlyd_C CWBGMSDKS DRLFRMNTST DRLFRMXTST FMSPULSDKMN KFTEIRLRLSN NRLMN TEIRLRLSZN TRLRLSDKMN /end DEF_CHARACTERISTIC
 /begin REF_CHARACTERISTIC KUMSIRL MSNTEVO /end REF_CHARACTERISTIC
 /begin IN_MEASUREMENT B_sa_msg EngStrt_bStrtEnd Epm_nEng Epm_nEng10ms fupsrl_w_msg IntkAirT_tIntkMnfld mste_msg rfzuugpn_w_msg rfzuugtn_w_msg rfzuugtx_w_msg rldkmx_w_msg rldkugd_w_msg rlfgs_w_msg rlrints_w_msg rlrint_w_msg rlsol_w_msg rl_w_msg SyC_stSub tnst_w_msg umsrln_w_msg vsaugr_w_msg /end IN_MEASUREMENT
 /begin OUT_MEASUREMENT drlm_w_msg msdkmx_w_msg msdks_w_msg msdkugd_w_msg msdkugpn_w_msg msdkugtn_w_msg msdkugtx_w_msg msdstats_w_msg rlfgks_w_msg trlrlsol_w_msg trlrls_w_msg tsaugr_w_msg tsaug_w_msg umsrlnk_w_msg /end OUT_MEASUREMENT
 /begin LOC_MEASUREMENT dmsfue_w msdksoir_w trlrlsdk_w ufmsfreg_w /end LOC_MEASUREMENT
 FUNCTION_VERSION "16.8.0" /end FUNCTION
/begin FUNCTION BGMSDSS "3.2.2     calculation of air mass flow from intake manifold pressure sensor (DS-S signal)"
 /begin IN_MEASUREMENT B_psrgg_msg B_psrmozdg_msg ChrCtl_flgChrgCalcnTiBasd dpsrfgmp_w_msg fisrm_w_msg mste_msg rlfgdssm_w_msg SyC_stSub umsrln_w_msg /end IN_MEASUREMENT
 /begin OUT_MEASUREMENT B_msdkdsg_msg msdkds_w_msg /end OUT_MEASUREMENT
 FUNCTION_VERSION "3.2.2" /end FUNCTION
/begin FUNCTION BGPABNAV "8.6.1     Calculation of pressure downstream exhaust valve" /begin DEF_CHARACTERISTIC CWPABNAV /end DEF_CHARACTERISTIC /begin IN_MEASUREMENT ExhMod_pEnvAppl ExhMod_pExhCat1UsB1 SyC_stSub /end IN_MEASUREMENT /begin OUT_MEASUREMENT fpabnav_w_msg pabnavfe_w_msg pabnav_w_msg /end OUT_MEASUREMENT FUNCTION_VERSION "8.6.1" /end FUNCTION
/begin FUNCTION BGPNDK "3.7.0     Output pressure downstream throttle valve" /begin DEF_CHARACTERISTIC NPNDKGMN /end DEF_CHARACTERISTIC /begin IN_MEASUREMENT B_psrg_msg Epm_nEng Epm_stSync psr_w_msg /end IN_MEASUREMENT /begin OUT_MEASUREMENT B_pndkg_msg fpndk_w_msg pndk_w_msg /end OUT_MEASUREMENT FUNCTION_VERSION "3.7.0" /end FUNCTION
/begin FUNCTION BGPSMAX "5.10.0    Calculated value for manifold pressure unthrottled und maximal" /begin DEF_CHARACTERISTIC MXVVVEKN /end DEF_CHARACTERISTIC /begin REF_CHARACTERISTIC VPSRVDUGD /end REF_CHARACTERISTIC
 /begin IN_MEASUREMENT Epm_nEng PEnv_p psmxbkvg_w_msg pvdmn_w_msg pvdmx_w_msg pvd_w_msg SyC_stSub /end IN_MEASUREMENT
 /begin OUT_MEASUREMENT psdkugdn_w_msg psdkugdx_w_msg psrdkugd_w_msg psrmxveg_w_msg psrmxvek_w_msg psrxs_w_msg /end OUT_MEASUREMENT
 FUNCTION_VERSION "5.10.0" /end FUNCTION
/begin FUNCTION BGPSR "7.10.0    Calculated value manifold pressure"
 /begin DEF_CHARACTERISTIC KLREDOSP KLTPPSRIFD KLTPPSRIFH NPSRSEG NPULSMN PIntkVUs_tiSwtFilPrm_C SAPSRR /end DEF_CHARACTERISTIC
 /begin REF_CHARACTERISTIC PIntkVUs_stCfg_C /end REF_CHARACTERISTIC
 /begin IN_MEASUREMENT B_psrmhg_msg B_psrmw_msg B_psrpl_msg Epm_nEng Epm_stSync GEVCtl_flgStdLftSyncIntk ofpsr_w_msg PEnv_p PIntkVUs_flgPRawVldTiBasdB1 PIntkVUs_pRaw PIntkVUs_pRawTiBasdB1 PIntkVUs_stSRCVld psrmh_w_msg psrrldc_w_msg /end IN_MEASUREMENT
 /begin OUT_MEASUREMENT B_psrg1_msg B_psrgg1_msg B_psrgg_msg B_psrg_msg dpsrg1_w_msg dpsrg_w_msg PIntkVUs_facNrmPEnv PIntkVUs_flgPMeasdVldTiBasdB1 PIntkVUs_flgPVldTiBasd PIntkVUs_flgPVldTiBasdB1 PIntkVUs_p PIntkVUs_pB1 PIntkVUs_pMeasdTiBasdB1 PIntkVUs_pTiBasd PIntkVUs_pTiBasdB1 psr1_w_msg psrg1_w_msg psrgsm_w_msg psrg_w_msg psrrf_w_msg psr_w_msg /end OUT_MEASUREMENT
 /begin LOC_MEASUREMENT fapsrr_w fdpslma_w oafpsrr_w PIntkVUs_flgSwtFilPrm tppsrifd_w /end LOC_MEASUREMENT
 FUNCTION_VERSION "7.10.0" /end FUNCTION
/begin FUNCTION BGQTITIMN "3.3.0     Calculation of quotient ti - TIMIN" /begin REF_CHARACTERISTIC TEMN /end REF_CHARACTERISTIC /begin IN_MEASUREMENT evz_austot_msg SyC_stSub tez_l_msg /end IN_MEASUREMENT /begin OUT_MEASUREMENT qtitimnh_msg timinausgpfi_w_msg /end OUT_MEASUREMENT /begin LOC_MEASUREMENT qtitimnpfi /end LOC_MEASUREMENT FUNCTION_VERSION "3.3.0" /end FUNCTION
/begin FUNCTION BGRL "10.7.0    Calculation of fresh air in combustion chamber" /begin DEF_CHARACTERISTIC AirMod_nrSynAirChrgToIgnCalcn_C CWBGRL /end DEF_CHARACTERISTIC
 /begin IN_MEASUREMENT AirMod_idxCylAirChrgPred AirMod_nrSynAirChrgPred AirMod_nrSynAirChrgPredHom B_adkpe_msg B_fupivheg_msg B_psrgg_msg B_pvdg_msg B_vhefeps_msg B_vhegfe_msg B_vhegs_msg B_vheg_msg B_vheinst_msg ChrCtl_flgChrgCalcnTiBasd dpsrfgmh_w_msg dpsrfgmp_w_msg Epm_ctCyl fupsrls_w_msg fupsrl_w_msg msdkds_w_msg pbrints_w_msg pbrint_w_msg psrfgmh_w_msg psrfgmp_w_msg psrg_w_msg psrmh_w_msg psrsuvhe_w_msg rfdsorgi_w_msg rflmorgi_w_msg rirints_w_msg rirint_w_msg rlfgds_w_msg rlfglm_w_msg rlp_w_msg rlrints_w_msg rlrint_w_msg ThrVlv_flgIrrvFuCutOffB1 umsrln_w_msg /end IN_MEASUREMENT
 /begin OUT_MEASUREMENT AirMod_idxCylAirChrg AirMod_mfAirCyl AirMod_nrSynAirChrgToIgnCalcn AirMod_ratChrgAirCyl AirMod_ratChrgAirCylAdv_a AirMod_ratChrgAirCylAftSwtPred AirMod_ratChrgAirCylLoResl AirMod_ratChrgAirEgrCyl AirMod_ratChrgInertCyl AirMod_ratInertCyl AirMod_ratInertCylAdv_a AirMod_ratInertCylPred AirMod_ratInertEgrIntCyl B_dsshfs_msg B_fedkapb_msg B_fedkb_msg B_fedkoab_msg B_fedssb_msg B_feete_msg B_ferlnotb_msg B_hfmhfs_msg B_msdkhfsg_msg B_rlvheg_msg dpsrfg_w_msg drldvls_w_msg drlvhepsrs_w_msg drl_w_msg ml_msg ml_w_msg msdkhfs_w_msg msfabr_w_msg psrfg_w_msg psrrl_w_msg rfges_w_msg rforgi_w_msg rir_w_msg rlfg_w_msg rlr_w_msg rl_msg rl_w_msg rri_w_msg /end OUT_MEASUREMENT
 /begin LOC_MEASUREMENT AirMod_idxCylAirChrgPredHom AirMod_idxCylAirChrgPredOld AirMod_nrSynAirChrgPredOld /end LOC_MEASUREMENT
 FUNCTION_VERSION "10.7.0" /end FUNCTION
/begin FUNCTION BGRL2SV "8.1.0     Calculation rl-Reference-Values to Service" /begin IN_MEASUREMENT Epm_nEng rlmxvl_w_msg rl_w_msg SyC_stSub /end IN_MEASUREMENT /begin OUT_MEASUREMENT AirMod_ratRelAirM rlabs_w_msg rlmxsoe_w_msg rml_msg /end OUT_MEASUREMENT FUNCTION_VERSION "8.1.0" /end FUNCTION
/begin FUNCTION BGRLFG "28.1.0    calculation of fresh air charge in combustion chamber"
 /begin DEF_CHARACTERISTIC FPSPULSMN FPSPULSMX FPVMXST PSREMN PSREMX TNMNSRMDK TNSTUNL TPSRMNXG VHUBZYL VPPSRMSM VPPSRMSMHY VSAUGROHNL VSAUGROHR ZKORFKISRM /end DEF_CHARACTERISTIC
 /begin REF_CHARACTERISTIC MSNTEVO /end REF_CHARACTERISTIC
 /begin IN_MEASUREMENT B_dugdtx_msg B_fupivheg_msg B_msddkg_msg B_msdkpnxg_msg B_mszsdkb_msg B_psrgg_msg B_pug_msg B_tahevg_msg B_vhegfe_msg ChrCtl_flgChrgCalcnTiBasd dpsrg_w_msg EngStrt_bStrtEnd Epm_nEng Epm_stSpd Epm_stSync ftsr_w_msg fupsrls_w_msg fupsrltn_w_msg fupsrltx_w_msg fupsrl_w_msg fupsvheg_w_msg fupsvhek_w_msg msdkpmn_w_msg msdkpmx_w_msg pbrints_w_msg pbrinttn_w_msg pbrinttx_w_msg pbrint_w_msg pbrivheg_w_msg pbrivhek_w_msg PEnv_p psdkugdn_w_msg psrgsm_w_msg psrg_w_msg pvdmn_w_msg pvdmx_w_msg pvd_w_msg rlfgroh_w_msg SyC_stSub tnst_w_msg umsrln_w_msg /end IN_MEASUREMENT
 /begin OUT_MEASUREMENT B_psrmhg_msg B_psrmnxg_msg B_psrmozdg_msg B_psrmozg_msg B_psrmozpnxg_msg dpsrfgmh_w_msg dpsrfgmp_w_msg fisrm_w_msg fkisrm_w_msg psrfgmh_w_msg psrfgmp_w_msg psrmgx_w_msg psrmhmi_w_msg psrmh_w_msg psrmmn_w_msg psrmmx_w_msg rfdsorgi_w_msg rfdsorim_w_msg rflmorgi_w_msg rlfgdssm_w_msg rlfgdsvheg_w_msg rlfgdsvhek_w_msg rlfgds_w_msg rlfglm_w_msg vsaugr_w_msg /end OUT_MEASUREMENT
 /begin LOC_MEASUREMENT B_fupivhegloc fupsrli_w fupsrlloc_w pbrintc_w pbrintloc_w psrfgmh_w PSRMH_2SYN_I.dpsrfgmh_w PSRMH_2SYN_I.dpsrmh_w PSRMH_2SYN_I.psrfgmh_w PSRMH_2SYN_I.psrmh_w PSRMH_2SYN_I.psrmhmi_w PSRMH_2SYN_I.rlfsrbrh_w PSRMH_2SYN_I.INT_PSRX_CL.dpsrmX_w PSRMH_2SYN_I.INT_PSRX_CL.psrmXneu_w psrmh_w PSRMMN_2SYN_I.psrmX_w PSRMMN_2SYN_I.rfasrX_w PSRMMN_2SYN_I.rfzsrX_w PSRMMX_2SYN_I.psrmX_w PSRMMX_2SYN_I.rfasrX_w PSRMMX_2SYN_I.rfzsrX_w /end LOC_MEASUREMENT
 FUNCTION_VERSION "28.1.0" /end FUNCTION
/begin FUNCTION BGRLFGZS "11.6.0    Calculation of fresh air charge flowing into the intake manifold" /begin DEF_CHARACTERISTIC KUMSIRL RLNOT /end DEF_CHARACTERISTIC
 /begin IN_MEASUREMENT ChrCtl_flgChrgCalcnTiBasd Epm_nEng Epm_nEngLRes msdk_w_msg mste_msg SyC_stSub ThrVlv_flgIrrvFuCutOffB1 /end IN_MEASUREMENT
 /begin OUT_MEASUREMENT B_mszsdkb_msg msdkalm_w_msg rlfdkroh_w_msg rlfgroh_w_msg rlnotn_w_msg umsrln_w_msg /end OUT_MEASUREMENT
 /begin LOC_MEASUREMENT rlfdkrohloc_w /end LOC_MEASUREMENT
 FUNCTION_VERSION "11.6.0" /end FUNCTION
/begin FUNCTION BGRLG "4.0.0     Calculated value RL-GRADIENT" /begin IN_MEASUREMENT Epm_nEng rl_w_msg /end IN_MEASUREMENT /begin OUT_MEASUREMENT drlas_w_msg rlgas_w_msg tas_w_msg /end OUT_MEASUREMENT /begin LOC_MEASUREMENT AirMod_nEng_a nmotalt_w rlaltas_w /end LOC_MEASUREMENT FUNCTION_VERSION "4.0.0" /end FUNCTION
/begin FUNCTION BGRLMIN "12.12.0   Calculation of minimum air flow rlmin"
 /begin DEF_CHARACTERISTIC BFZGRLNBKV FRLMNPU FRLMNTMOT NMOTRLNBKV RLMNDSAN RLMNN RLMNSABKV RLMNSAN RLMNVHEKN RLMNVHEKSAN TDRLNBKV /end DEF_CHARACTERISTIC
 /begin IN_MEASUREMENT B_ll_msg B_sa_msg B_vheg_msg CEngDsT_t Epm_nEng PEnv_p rlrints_w_msg rltedte_w_msg SyC_stSub VehV_v /end IN_MEASUREMENT
 /begin OUT_MEASUREMENT rlfgmnho_w_msg rlminhom_w_msg rlmin_w_msg rlmnsa_w_msg /end OUT_MEASUREMENT
 /begin LOC_MEASUREMENT bfzgbkv_w B_bfzgbkv frlmntp_w rlmn_w /end LOC_MEASUREMENT
 FUNCTION_VERSION "12.12.0" /end FUNCTION
/begin FUNCTION BGRLMXS "22.9.0    Calculation maximum, desired filling" /begin DEF_CHARACTERISTIC FKRLXVL KLMXRLAPIG KLTANSCRF KLTMOTCRF RVBRVL /end DEF_CHARACTERISTIC
 /begin IN_MEASUREMENT CEngDsT_t Epm_nEng Epm_nEngLRes ExhMgT_facCptProtnMisf frlmxbts_w_msg ftahevmx_w_msg IKCtl_facFillgRed_u16 PEnv_facCorrAlti SyC_stSub tans_msg /end IN_MEASUREMENT
 /begin OUT_MEASUREMENT rlmxs_w_msg rlmxvl_w_msg /end OUT_MEASUREMENT
 FUNCTION_VERSION "22.9.0" /end FUNCTION
/begin FUNCTION BGRLP "9.7.1     Calculation variable rlp: predicted air charge"
 /begin DEF_CHARACTERISTIC DPLMDK DRLRLPMAX DRLRLPU FGDPSMPDVS FPVMXP FPVMXP2 TDRLRLPMAX /end DEF_CHARACTERISTIC
 /begin REF_CHARACTERISTIC CWBGRLP /end REF_CHARACTERISTIC
 /begin IN_MEASUREMENT B_rlpdms_msg B_rlpdp_msg B_rlp_msg B_vhefeps_msg ChrCtl_flgChrgCalcnTiBasd dpsrfgmh_w_msg dpsrfg_w_msg fisrm_w_msg fupsrls_w_msg fupsrl_w_msg fwprs_w_msg msdp_w_msg pbrints_w_msg pbrint_w_msg psrrl_w_msg psr_w_msg pvd_w_msg rlfdkroh_w_msg rlfg_w_msg rlr_w_msg rl_w_msg SyC_stSub umsrln_w_msg /end IN_MEASUREMENT
 /begin OUT_MEASUREMENT B_syn2fe_msg drlp_w_msg psrmp_w_msg rlp_msg rlp_w_msg /end OUT_MEASUREMENT
 /begin LOC_MEASUREMENT B_psrmpb dpsfdhfb_w dpsrfdhf_w dpsrfgk_w dpsrfmp_w dpsrpps_w drlrlpmx gdrlprlctr psrpmx_w psrrlpnb_w rlfgmp_w rlpnb_w rlpu_w rlrohmp_w /end LOC_MEASUREMENT
 FUNCTION_VERSION "9.7.1" /end FUNCTION
/begin FUNCTION BGRLSOL "16.8.1    Calculation of desired air charge"
 /begin DEF_CHARACTERISTIC ChrSet_facCorrnNormCdn_C ChrSet_pAmbNormCdn_C ChrSet_tAmbNormCdn_C CWRLAPPL DRLMINBG DRLSOLDYN DRLSOLHUM DRLSOLSTAT DRLSTAT FHORLVPSVD RLSOLAP RLSOLAPW TDMWRLSTA TDMWRLSTADYN /end DEF_CHARACTERISTIC
 /begin IN_MEASUREMENT APP_r B_ahfsnfsa_msg B_msdksg_msg B_mwrlstas_msg B_rlvheg_msg B_vhegfes_msg B_vhegs_msg B_vheg_msg drldvmds_w_msg drl_w_msg EnvT_t Epm_stSpd fupshoms_w_msg fupsrlmx_w_msg fupsrls_w_msg fupsrltn_w_msg fupsrltx_w_msg fupsrlug_w_msg fupsrl_w_msg fupsvheg_w_msg fupsvhek_w_msg pbrihoms_w_msg pbrintmx_w_msg pbrints_w_msg pbrinttn_w_msg pbrinttx_w_msg pbrintug_w_msg pbrint_w_msg pbrivheg_w_msg pbrivhek_w_msg PEnv_p psdkugdn_w_msg psdkugdx_w_msg psrdkugd_w_msg psrmxveg_w_msg psrmxvek_w_msg pvd_w_msg rlmdhoms_w_msg rlmds_w_msg rlminhom_w_msg rlmin_w_msg rlmxs_w_msg rlrints_w_msg rlrint_w_msg rl_w_msg SyC_stSub trlrlsol_w_msg umsrln_w_msg vpsrvdk_w_msg /end IN_MEASUREMENT
 /begin OUT_MEASUREMENT B_mdmin_msg B_mwrlsta_msg B_pvdrlseuvheg_msg B_rlmdsg_msg B_rlsolg_msg B_rlsrlpxs_msg B_zwfrlmin_msg ChrSet_mfActTraDes grdpssol_w_msg psrhoms_w_msg psrsldr_w_msg psrsuvhe_w_msg psrs_w_msg rforidmx_w_msg rfzuugpn_w_msg rfzuugtn_w_msg rfzuugtx_w_msg rldkmx_w_msg rldkugd_w_msg rlfgs_w_msg rlmxvheg_w_msg rlmxvhek_w_msg rlshhkid_w_msg rlshhk_w_msg rlshk_msg rlshk_w_msg rlsh_w_msg rlsolg_w_msg rlsolhom_w_msg rlsolubid_w_msg rlsol_w_msg rlsw_w_msg /end OUT_MEASUREMENT
 /begin LOC_MEASUREMENT fhorlnws_w psrpsrs_w rforidug_w /end LOC_MEASUREMENT
 FUNCTION_VERSION "16.8.1" /end FUNCTION
/begin FUNCTION BGTABSTAD "10.1.1    Engine Off Time TABST by Adapter"
 /begin IN_MEASUREMENT TiEngOff_bTiEngOffEcuActv TiEngOff_stTiFirstStrt TiEngOff_ti TiEngOff_tiFirstStrt TiEngOn_tiTotEngRt TiEngOn_tiTotIgnOn TiOff_stTiStrtEndOff TiOff_tiStrtEndOff /end IN_MEASUREMENT
 /begin OUT_MEASUREMENT B_abstgp B_abstgp_msg B_abstnpl B_tengsi_msg EngDa_tiEngOff EngDa_tiEngOn tabmot_w_msg tabst_w tabst_w_msg tengsq1z_w_msg tengsq1_w_msg tengszlst_msg tengsz_w_msg tengs_w_msg top_w_msg /end OUT_MEASUREMENT
 FUNCTION_VERSION "10.1.1" /end FUNCTION
/begin FUNCTION BGTASRM "2.7.0     Calculation value modelled temperature in intake manifold" /begin DEF_CHARACTERISTIC TASRMEW ZTMMBR /end DEF_CHARACTERISTIC
 /begin IN_MEASUREMENT CEngDsT_t Eep_EnvRamHist Eep_EnvRamInvld IntkAirT_tThrVlvUs SyC_stSub /end IN_MEASUREMENT
 /begin OUT_MEASUREMENT B_tasrmg_msg tadk_w_msg tasrm_w_msg twvev_w_msg /end OUT_MEASUREMENT
 /begin LOC_MEASUREMENT tmotfilk_w /end LOC_MEASUREMENT
 FUNCTION_VERSION "2.7.0" /end FUNCTION
/begin FUNCTION BGTAVDKM "4.5.0     Calculation value modelled temperature upstream throttle blade" /begin DEF_CHARACTERISTIC TAVDKMEW /end DEF_CHARACTERISTIC /begin IN_MEASUREMENT IntkAirT_flgIntkMnfldMeasdVld IntkAirT_tIntkMnfldMeasd /end IN_MEASUREMENT /begin OUT_MEASUREMENT B_tavdkmg_msg tavdkm_w_msg /end OUT_MEASUREMENT FUNCTION_VERSION "4.5.0" /end FUNCTION
/begin COMPU_METHOD ASCET_tmp4 "" RAT_FUNC "%9.8" "" COEFFS 0 65536 0 0 0 0.01017253 /end COMPU_METHOD
/begin COMPU_METHOD ASCET_tmp6 "" RAT_FUNC "%10.9" "g" COEFFS 0 21333333.3333333 0 0 0 1 /end COMPU_METHOD
/begin COMPU_METHOD ASCET_tmp7 "" RAT_FUNC "%11.10" "g" COEFFS 0 213333333.333333 0 0 0 1 /end COMPU_METHOD
/begin COMPU_METHOD bfzg_q0p1085069 "" RAT_FUNC "%6.3" "m/s^2" COEFFS 0 31248000 0 0 0 3390625 /end COMPU_METHOD
/begin COMPU_METHOD B_TRUE "" TAB_VERB "%6.3" "" COMPU_TAB_REF B_TRUE /end COMPU_METHOD
/begin COMPU_VTAB B_TRUE "" TAB_VERB 2 0 "FALSE" 1 "TRUE" /end COMPU_VTAB
/begin COMPU_METHOD CMFTMOD_SC_Compu "" TAB_VERB "%6.3" "" COMPU_TAB_REF CMFTMOD_SC_Compu /end COMPU_METHOD
/begin COMPU_VTAB CMFTMOD_SC_Compu "" TAB_VERB 2 0 "False" 1 "True" /end COMPU_VTAB
/begin COMPU_METHOD CMNPROGTYPE_SC_Compu "" TAB_VERB "%6.3" "" COMPU_TAB_REF CMNPROGTYPE_SC_Compu /end COMPU_METHOD
/begin COMPU_VTAB CMNPROGTYPE_SC_Compu "" TAB_VERB 2 0 "COMPILE" 1 "CALIBRATION" /end COMPU_VTAB
/begin COMPU_METHOD CMPNPROTCOOLGINJ_SC_Compu "" TAB_VERB "%6.3" "" COMPU_TAB_REF CMPNPROTCOOLGINJ_SC_Compu /end COMPU_METHOD
/begin COMPU_VTAB CMPNPROTCOOLGINJ_SC_Compu "" TAB_VERB 2 0 "not active" 1 "active" /end COMPU_VTAB
/begin COMPU_METHOD CMPRAIRBLOW2_SC_Compu "" TAB_VERB "%6.3" "" COMPU_TAB_REF CMPRAIRBLOW2_SC_Compu /end COMPU_METHOD
/begin COMPU_VTAB CMPRAIRBLOW2_SC_Compu "" TAB_VERB 2 0 "False" 1 "True" /end COMPU_VTAB
/begin COMPU_METHOD CMPRAIRBLOW_SC_Compu "" TAB_VERB "%6.3" "" COMPU_TAB_REF CMPRAIRBLOW_SC_Compu /end COMPU_METHOD
/begin COMPU_VTAB CMPRAIRBLOW_SC_Compu "" TAB_VERB 2 0 "False" 1 "True" /end COMPU_VTAB
/begin COMPU_METHOD CMPRBYPVLV_AIRACTR_SC_Compu "" TAB_VERB "%6.3" "" COMPU_TAB_REF CMPRBYPVLV_AIRACTR_SC_Compu /end COMPU_METHOD
/begin COMPU_VTAB CMPRBYPVLV_AIRACTR_SC_Compu "" TAB_VERB 2 0 "INACTIVE" 1 "ACTIVE" /end COMPU_VTAB
/begin COMPU_METHOD CMPRHP2DST_TYPAVL_SC_Compu "" TAB_VERB "%6.3" "" COMPU_TAB_REF CMPRHP2DST_TYPAVL_SC_Compu /end COMPU_METHOD
/begin COMPU_VTAB CMPRHP2DST_TYPAVL_SC_Compu "" TAB_VERB 2 0 "False" 1 "True" /end COMPU_VTAB
/begin COMPU_METHOD Cnd_uS_DIV_Cm_q0p01_COMPU "" RAT_FUNC "%6.4" "µS/Cm" COEFFS 0 100 0 0 0 1 /end COMPU_METHOD
/begin COMPU_METHOD CNG_SY_Compu "" TAB_VERB "%6.3" "" COMPU_TAB_REF CNG_SY_Compu /end COMPU_METHOD
/begin COMPU_VTAB CNG_SY_Compu "" TAB_VERB 5 0 "Kein System mit CNG" 1 "System mit CNG" 2 "System mit CNG und EOBD" 3 "System mit CNG Fehlerpfade ASV1...5" 4 "System mit CNG Plattform" /end COMPU_VTAB
/begin COMPU_METHOD CnvtCoeffCatAir "" RAT_FUNC "%6.4" "J/K/s/m^2" COEFFS 0 50 0 0 0 1 /end COMPU_METHOD
/begin COMPU_METHOD CoeffA "" RAT_FUNC "%6.4" "1/(s*Nm)" COEFFS 0 204.8 0 0 0 1 /end COMPU_METHOD
/begin COMPU_METHOD COENG_APPLANDTESTSUPRTSPST_SC_Compu "" TAB_VERB "%6.3" "" COMPU_TAB_REF COENG_APPLANDTESTSUPRTSPST_SC_Compu /end COMPU_METHOD
/begin COMPU_VTAB COENG_APPLANDTESTSUPRTSPST_SC_Compu "" TAB_VERB 2 0 "False" 1 "True" /end COMPU_VTAB
/begin COMPU_METHOD COENG_BASCONLY_SC_Compu "" TAB_VERB "%6.3" "" COMPU_TAB_REF COENG_BASCONLY_SC_Compu /end COMPU_METHOD
/begin COMPU_VTAB COENG_BASCONLY_SC_Compu "" TAB_VERB 2 0 "False" 1 "True" /end COMPU_VTAB
/begin COMPU_METHOD COENG_DRGDESCDN_SC_Compu "" RAT_FUNC "%6.2" "" COEFFS 0 1 0 0 0 1 /end COMPU_METHOD
/begin COMPU_METHOD COENG_ENANTEPIDS_SC_Compu "" TAB_VERB "%6.3" "" COMPU_TAB_REF COENG_ENANTEPIDS_SC_Compu /end COMPU_METHOD
/begin COMPU_VTAB COENG_ENANTEPIDS_SC_Compu "" TAB_VERB 2 0 "NoNTE_PIDs" 1 "NTE_PIDs_Enabled" /end COMPU_VTAB
/begin COMPU_METHOD CoEng_StEngs_sm_VERB "" TAB_VERB "%6.3" "" COMPU_TAB_REF CoEng_StEngs_sm_VERB /end COMPU_METHOD
/begin COMPU_VTAB CoEng_StEngs_sm_VERB "" TAB_VERB 10 0 "A_STANDBY" 1 "A_AUTOSTOPPING" 2 "A_FINISH" 3 "A_READY" 4 "A_RUNNING" 5 "A_STARTING" 6 "A_STOPPING" 7 "H_DRIVE" 8 "H_POSTDRIVE" 9 "H_PREDRIVE" /end COMPU_VTAB
/begin COMPU_METHOD COENG_STOPENBLCOND1_SC_Compu "" RAT_FUNC "%6.2" "" COEFFS 0 1 0 0 0 1 /end COMPU_METHOD
/begin COMPU_METHOD COENG_STOPENBLCOND2_SC_Compu "" RAT_FUNC "%6.2" "" COEFFS 0 1 0 0 0 1 /end COMPU_METHOD
/begin COMPU_METHOD COENG_STOPENBLCONDIDL_SY_Compu "" RAT_FUNC "%6.2" "" COEFFS 0 1 0 0 0 1 /end COMPU_METHOD
/begin COMPU_METHOD COENG_STOPENBLCOND_SY_Compu "" RAT_FUNC "%6.2" "" COEFFS 0 1 0 0 0 1 /end COMPU_METHOD
/begin COMPU_METHOD COENG_STRTDESCOND1_SC_Compu "" RAT_FUNC "%6.2" "" COEFFS 0 1 0 0 0 1 /end COMPU_METHOD
/begin COMPU_METHOD COENG_STRTDESCOND2_SC_Compu "" RAT_FUNC "%6.2" "" COEFFS 0 1 0 0 0 1 /end COMPU_METHOD
/begin COMPU_METHOD COENG_STRTDESCOND_SC_Compu "" RAT_FUNC "%6.2" "" COEFFS 0 1 0 0 0 1 /end COMPU_METHOD
/begin COMPU_METHOD COENG_STRTENBLCOND_SY_Compu "" RAT_FUNC "%6.2" "" COEFFS 0 1 0 0 0 1 /end COMPU_METHOD
/begin COMPU_METHOD COENG_SWTVEHTYP_SC_Compu "" TAB_VERB "%6.3" "" COMPU_TAB_REF COENG_SWTVEHTYP_SC_Compu /end COMPU_METHOD
/begin COMPU_VTAB COENG_SWTVEHTYP_SC_Compu "" TAB_VERB 3 0 "PC" 5 "CV" 10 "OHW" /end COMPU_VTAB
/begin COMPU_METHOD CoEng_ti_VERB "" TAB_VERB "%6.3" "" COMPU_TAB_REF CoEng_ti_VERB /end COMPU_METHOD
/begin COMPU_VTAB CoEng_ti_VERB "" TAB_VERB 11 0 "COENG_TI_STANDBY" 1 "COENG_TI_READY" 2 "COENG_TI_STARTING" 3 "COENG_TI_AUTOSTOPPING" 4 "COENG_TI_RUNNING" 5 "COENG_TI_STOPPING" 6 "COENG_TI_FINISH" 7 "COENG_TI_START" 8 "COENG_TI_NORMAL" 9 "COENG_TI_AFTERRUN" 10 "COENG_TI_RUNNGSUM" /end COMPU_VTAB
/begin COMPU_METHOD COENG_TYPSTOPRELSHYB_SC_Compu "" TAB_VERB "%6.3" "" COMPU_TAB_REF COENG_TYPSTOPRELSHYB_SC_Compu /end COMPU_METHOD
/begin COMPU_VTAB COENG_TYPSTOPRELSHYB_SC_Compu "" TAB_VERB 2 0 "0" 1 "1" /end COMPU_VTAB
/begin COMPU_METHOD COENG_VAR_SY_Compu "" TAB_VERB "%6.3" "" COMPU_TAB_REF COENG_VAR_SY_Compu /end COMPU_METHOD
/begin COMPU_VTAB COENG_VAR_SY_Compu "" TAB_VERB 52 0 "kein Kundenbezug" 1 "DAI" 3 "VWW" 4 "POR" 5 "AUD" 6 "OPE" 9 "FIA" 11 "BMW" 14 "PSA" 15 "REN" 17 "ALF" 18 "SAB" 19 "VOL" 20 "NIS" 21 "GMU" 22 "FOR" 26 "IMJ" 36 "MAN" 51 "SEA" 53 "CHR" 54 "JAG" 55 "ROL" 69 "FER" 72 "TOY" 123 "MIT" 147 "HYU" 159 "HON" 160 "MAZ" 183 "CU" 190 "LRG" 204 "VVW" 214 "AVT" 242 "Iveco" 243 "DMC" 248 "SUZ" 267 "SSANGYONG" 270 "KEF" 289 "AMG" 308 "TAT" 319 "MVM" 328 "MM" 385 "UAES" 578 "AL" 590 "Scania" 760 "WEICHAI" 828 "RBCD" 898 "MFTBC" 966 "International" 999 "ALL" 2887 "NONOX" 9454 "Fuso" 9546 "CAT" /end COMPU_VTAB
/begin COMPU_METHOD COENG_VLVLFTSPINTKTYP_SC_Compu "" TAB_VERB "%6.3" "" COMPU_TAB_REF COENG_VLVLFTSPINTKTYP_SC_Compu /end COMPU_METHOD
/begin COMPU_VTAB COENG_VLVLFTSPINTKTYP_SC_Compu "" TAB_VERB 3 0 "0" 1 "1" 2 "2" /end COMPU_VTAB
/begin COMPU_METHOD COENG_WPDMDHYBCFG_SC_Compu "" TAB_VERB "%6.3" "" COMPU_TAB_REF COENG_WPDMDHYBCFG_SC_Compu /end COMPU_METHOD
/begin COMPU_VTAB COENG_WPDMDHYBCFG_SC_Compu "" TAB_VERB 3 0 "0" 1 "1" 2 "2" /end COMPU_VTAB
/begin COMPU_METHOD COENG_WPDMDHYBSTC_SC_Compu "" TAB_VERB "%6.3" "" COMPU_TAB_REF COENG_WPDMDHYBSTC_SC_Compu /end COMPU_METHOD
/begin COMPU_VTAB COENG_WPDMDHYBSTC_SC_Compu "" TAB_VERB 2 0 "False" 1 "True" /end COMPU_VTAB
/begin COMPU_METHOD CoEOMSwt "" RAT_FUNC "%10.9" "-" COEFFS 0 16384000 0 0 0 1 /end COMPU_METHOD
/begin COMPU_METHOD CoEOMSwt_S16 "" RAT_FUNC "%7.6" "-" COEFFS 0 16384 0 0 0 1 /end COMPU_METHOD
/begin COMPU_METHOD COEOM_APPLSUPRT_SC_Compu "" RAT_FUNC "%6.2" "" COEFFS 0 1 0 0 0 1 /end COMPU_METHOD
/begin COMPU_METHOD COEOM_INHOUSE_SC_Compu "" TAB_VERB "%6.3" "" COMPU_TAB_REF COEOM_INHOUSE_SC_Compu /end COMPU_METHOD
/begin COMPU_VTAB COEOM_INHOUSE_SC_Compu "" TAB_VERB 3 0 "BOSCH" 1 "OEM" 2 "OEM_and_BOSCH" /end COMPU_VTAB
/begin COMPU_METHOD COEOM_INJCRVMI1NUMMAP_SY_Compu "" RAT_FUNC "%6.2" "" COEFFS 0 1 0 0 0 1 /end COMPU_METHOD
/begin COMPU_METHOD COEOM_INJCRVMI1NUMSWTDES_SY_Compu "" RAT_FUNC "%6.2" "" COEFFS 0 1 0 0 0 1 /end COMPU_METHOD
/begin COMPU_METHOD COEOM_INJCRVPII1NUMMAP_SY_Compu "" RAT_FUNC "%6.2" "" COEFFS 0 1 0 0 0 1 /end COMPU_METHOD
/begin COMPU_METHOD COEOM_INJCRVPII1NUMSWTDES_SY_Compu "" RAT_FUNC "%6.2" "" COEFFS 0 1 0 0 0 1 /end COMPU_METHOD
/begin COMPU_METHOD COEOM_INJCRVPII2NUMMAP_SY_Compu "" RAT_FUNC "%6.2" "" COEFFS 0 1 0 0 0 1 /end COMPU_METHOD
/begin COMPU_METHOD COEOM_INJCRVPII2NUMSWTDES_SY_Compu "" RAT_FUNC "%6.2" "" COEFFS 0 1 0 0 0 1 /end COMPU_METHOD
/begin COMPU_METHOD COEOM_INJCRVPOI1NUMMAP_SY_Compu "" RAT_FUNC "%6.2" "" COEFFS 0 1 0 0 0 1 /end COMPU_METHOD
/begin COMPU_METHOD COEOM_INJCRVPOI1NUMSWTDES_SY_Compu "" RAT_FUNC "%6.2" "" COEFFS 0 1 0 0 0 1 /end COMPU_METHOD
/begin COMPU_METHOD COEOM_INJCRVPOI2NUMMAP_SY_Compu "" RAT_FUNC "%6.2" "" COEFFS 0 1 0 0 0 1 /end COMPU_METHOD
/begin COMPU_METHOD COEOM_INJCRVPOI2NUMSWTDES_SY_Compu "" RAT_FUNC "%6.2" "" COEFFS 0 1 0 0 0 1 /end COMPU_METHOD
/begin COMPU_METHOD COEOM_INJCRVPOI3NUMMAP_SY_Compu "" RAT_FUNC "%6.2" "" COEFFS 0 1 0 0 0 1 /end COMPU_METHOD
/begin COMPU_METHOD COEOM_INJCRVPOI3NUMSWTDES_SY_Compu "" RAT_FUNC "%6.2" "" COEFFS 0 1 0 0 0 1 /end COMPU_METHOD
/begin COMPU_METHOD CoEOM_stEomCmb_VERB "" TAB_VERB "%6.3" "" COMPU_TAB_REF CoEOM_stEomCmb_VERB /end COMPU_METHOD
/begin COMPU_VTAB CoEOM_stEomCmb_VERB "" TAB_VERB 9 0 "n/a [0]" 1 "HOM" 2 "HMM" 4 "HOS" 8 "SCH" 16 "SKH" 32 "n/a [6]" 64 "HSP" 128 "HKS" /end COMPU_VTAB
/begin COMPU_METHOD CoEOM_stEomInjr_VERB "" TAB_VERB "%6.3" "" COMPU_TAB_REF CoEOM_stEomInjr_VERB /end COMPU_METHOD
/begin COMPU_VTAB CoEOM_stEomInjr_VERB "" TAB_VERB 7 0 "n/a [0]" 1 "GDI" 4 "PFI" 8 "CNG" 16 "LPG" 32 "n/a [5]" 2 "PDI" /end COMPU_VTAB
/begin COMPU_METHOD CoEOM_stEomOpSt_VERB "" TAB_VERB "%6.3" "" COMPU_TAB_REF CoEOM_stEomOpSt_VERB /end COMPU_METHOD
/begin COMPU_VTAB CoEOM_stEomOpSt_VERB "" TAB_VERB 7 0 "n/a[0]" 1 "Base" 2 "WrmUp" 4 "CatHtg" 8 "Start" 16 "GPFRgn" 32 "Limp" /end COMPU_VTAB
/begin COMPU_METHOD CoEOM_stEomVlvLftIntk_VERB "" TAB_VERB "%6.3" "" COMPU_TAB_REF CoEOM_stEomVlvLftIntk_VERB /end COMPU_METHOD
/begin COMPU_VTAB CoEOM_stEomVlvLftIntk_VERB "" TAB_VERB 15 0 "n/a [0]" 1 "No Lift" 2 "Full Lift" 4 "EIVC" 8 "LIVO" 16 "EIVO" 32 "LIVC" 64 "Cold Lift" 32772 "EIVC-Vbl" 32776 "LIVO-Vbl" 32784 "EIVO-Vbl" 32800 "LIVC-Vbl" 128 "ZAV" 36 "LivcOrEivc" 32804 "LivcOrEivc-Vbl" /end COMPU_VTAB
/begin COMPU_METHOD COEOM_TYP_SY_Compu "" TAB_VERB "%6.3" "" COMPU_TAB_REF COEOM_TYP_SY_Compu /end COMPU_METHOD
/begin COMPU_VTAB COEOM_TYP_SY_Compu "" TAB_VERB 2 1 "HESRV_SNGLFLW" 2 "HESRV_TWFLW" /end COMPU_VTAB
/begin COMPU_METHOD COESS_RCPTMNG_SY_Compu "" TAB_VERB "%6.3" "" COMPU_TAB_REF COESS_RCPTMNG_SY_Compu /end COMPU_METHOD
/begin COMPU_VTAB COESS_RCPTMNG_SY_Compu "" TAB_VERB 2 0 "False" 1 "True" /end COMPU_VTAB
/begin COMPU_METHOD COLDSTRTHEATGCTRL_SC_Compu "" TAB_VERB "%6.3" "" COMPU_TAB_REF COLDSTRTHEATGCTRL_SC_Compu /end COMPU_METHOD
/begin COMPU_VTAB COLDSTRTHEATGCTRL_SC_Compu "" TAB_VERB 3 0 "NO_FHCU" 1 "FHCU_SER" 2 "FHCU_LIN" /end COMPU_VTAB
/begin COMPU_METHOD COLDSTRTVLV_SC_Compu "" TAB_VERB "%6.3" "" COMPU_TAB_REF COLDSTRTVLV_SC_Compu /end COMPU_METHOD
/begin COMPU_VTAB COLDSTRTVLV_SC_Compu "" TAB_VERB 4 0 "no cold start valve" 1 "angle sync. control" 2 "time sync. control" 3 "no_control_on_cold-start_valve" /end COMPU_VTAB
/begin COMPU_METHOD COMassPerTime "" RAT_FUNC "%6.4" "mg/s" COEFFS 0 20 0 0 0 1 /end COMPU_METHOD
/begin COMPU_METHOD COMCIL_COMTYPE_SY_Compu "" TAB_VERB "%6.3" "" COMPU_TAB_REF COMCIL_COMTYPE_SY_Compu /end COMPU_METHOD
/begin COMPU_VTAB COMCIL_COMTYPE_SY_Compu "" TAB_VERB 4 1 "CAN 11hex" 2 "CAN 12hex" 3 "FlexRay" 4 "BN35up" /end COMPU_VTAB
/begin COMPU_METHOD COMDIA_BITFAIFSUPRT_SC_Compu "" TAB_VERB "%6.3" "" COMPU_TAB_REF COMDIA_BITFAIFSUPRT_SC_Compu /end COMPU_METHOD
/begin COMPU_VTAB COMDIA_BITFAIFSUPRT_SC_Compu "" TAB_VERB 2 0 "False" 1 "True" /end COMPU_VTAB
/begin COMPU_METHOD COMDIA_RTEENA_SC_Compu "" TAB_VERB "%6.3" "" COMPU_TAB_REF COMDIA_RTEENA_SC_Compu /end COMPU_METHOD
/begin COMPU_VTAB COMDIA_RTEENA_SC_Compu "" TAB_VERB 2 0 "False" 1 "True" /end COMPU_VTAB
/begin COMPU_METHOD COMM_SC_Compu "" TAB_VERB "%6.3" "" COMPU_TAB_REF COMM_SC_Compu /end COMPU_METHOD
/begin COMPU_VTAB COMM_SC_Compu "" TAB_VERB 2 0 "False" 1 "True" /end COMPU_VTAB
/begin COMPU_METHOD COMVERS_SC_Compu "" TAB_VERB "%6.3" "" COMPU_TAB_REF COMVERS_SC_Compu /end COMPU_METHOD
/begin COMPU_VTAB COMVERS_SC_Compu "" TAB_VERB 4 0 "COMVERS_V4V5" 1 "COMVERS_MLB" 2 "COMVERS_MQB" 3 "COMVERS_MLBEVO" /end COMPU_VTAB
/begin COMPU_METHOD COM_ENADCDC_SC_Compu "" TAB_VERB "%6.3" "" COMPU_TAB_REF COM_ENADCDC_SC_Compu /end COMPU_METHOD
/begin COMPU_VTAB COM_ENADCDC_SC_Compu "" TAB_VERB 2 0 "False" 1 "True" /end COMPU_VTAB
/begin COMPU_METHOD COM_SC_Compu "" TAB_VERB "%6.3" "" COMPU_TAB_REF COM_SC_Compu /end COMPU_METHOD
/begin COMPU_VTAB COM_SC_Compu "" TAB_VERB 2 0 "False" 1 "True" /end COMPU_VTAB
/begin COMPU_METHOD CONDRDSFLDP_TYPAVL_SC_Compu "" TAB_VERB "%6.3" "" COMPU_TAB_REF CONDRDSFLDP_TYPAVL_SC_Compu /end COMPU_METHOD
/begin COMPU_VTAB CONDRDSFLDP_TYPAVL_SC_Compu "" TAB_VERB 2 0 "False" 1 "True" /end COMPU_VTAB
/begin COMPU_METHOD CONDRDSFLDT_TYPAVL_SC_Compu "" TAB_VERB "%6.3" "" COMPU_TAB_REF CONDRDSFLDT_TYPAVL_SC_Compu /end COMPU_METHOD
/begin COMPU_VTAB CONDRDSFLDT_TYPAVL_SC_Compu "" TAB_VERB 2 0 "False" 1 "True" /end COMPU_VTAB
/begin COMPU_METHOD CONDRUSCOOLTT_TYPAVL_SC_Compu "" TAB_VERB "%6.3" "" COMPU_TAB_REF CONDRUSCOOLTT_TYPAVL_SC_Compu /end COMPU_METHOD
/begin COMPU_VTAB CONDRUSCOOLTT_TYPAVL_SC_Compu "" TAB_VERB 2 0 "False" 1 "True" /end COMPU_VTAB
/begin COMPU_METHOD CONDRUSFLDT_TYPAVL_SC_Compu "" TAB_VERB "%6.3" "" COMPU_TAB_REF CONDRUSFLDT_TYPAVL_SC_Compu /end COMPU_METHOD
/begin COMPU_VTAB CONDRUSFLDT_TYPAVL_SC_Compu "" TAB_VERB 2 0 "False" 1 "True" /end COMPU_VTAB
/begin COMPU_METHOD CONTPOSNEG_SY_Compu "" TAB_VERB "%6.3" "" COMPU_TAB_REF CONTPOSNEG_SY_Compu /end COMPU_METHOD
/begin COMPU_VTAB CONTPOSNEG_SY_Compu "" TAB_VERB 2 0 "FALSE" 1 "TRUE" /end COMPU_VTAB
/begin COMPU_METHOD CONV_LDOILCOOLRPMP_SY_Compu "" TAB_VERB "%6.3" "" COMPU_TAB_REF CONV_LDOILCOOLRPMP_SY_Compu /end COMPU_METHOD
/begin COMPU_VTAB CONV_LDOILCOOLRPMP_SY_Compu "" TAB_VERB 2 0 "False" 1 "True" /end COMPU_VTAB
/begin COMPU_METHOD COOLGVLVCTRLENA_SC_Compu "" TAB_VERB "%6.3" "" COMPU_TAB_REF COOLGVLVCTRLENA_SC_Compu /end COMPU_METHOD
/begin COMPU_VTAB COOLGVLVCTRLENA_SC_Compu "" TAB_VERB 2 0 "False" 1 "True" /end COMPU_VTAB
/begin COMPU_METHOD COOLTCTRLVLV_SC_Compu "" TAB_VERB "%6.3" "" COMPU_TAB_REF COOLTCTRLVLV_SC_Compu /end COMPU_METHOD
/begin COMPU_VTAB COOLTCTRLVLV_SC_Compu "" TAB_VERB 2 0 "NO" 1 "CCV_standard" /end COMPU_VTAB
/begin COMPU_METHOD COOLTPFANDMDVRNTSELN_SC_Compu "" TAB_VERB "%6.3" "" COMPU_TAB_REF COOLTPFANDMDVRNTSELN_SC_Compu /end COMPU_METHOD
/begin COMPU_VTAB COOLTPFANDMDVRNTSELN_SC_Compu "" TAB_VERB 2 1 "2WF_variant" 2 "GDI_variant" /end COMPU_VTAB
/begin COMPU_METHOD COOLTPIN_TYPAVL_SC_Compu "" TAB_VERB "%6.3" "" COMPU_TAB_REF COOLTPIN_TYPAVL_SC_Compu /end COMPU_METHOD
/begin COMPU_VTAB COOLTPIN_TYPAVL_SC_Compu "" TAB_VERB 2 0 "False" 1 "True" /end COMPU_VTAB
/begin COMPU_METHOD COOLTPOUT_TYPAVL_SC_Compu "" TAB_VERB "%6.3" "" COMPU_TAB_REF COOLTPOUT_TYPAVL_SC_Compu /end COMPU_METHOD
/begin COMPU_VTAB COOLTPOUT_TYPAVL_SC_Compu "" TAB_VERB 2 0 "False" 1 "True" /end COMPU_VTAB
/begin COMPU_METHOD COOLTTIN_TYPAVL_SC_Compu "" TAB_VERB "%6.3" "" COMPU_TAB_REF COOLTTIN_TYPAVL_SC_Compu /end COMPU_METHOD
/begin COMPU_VTAB COOLTTIN_TYPAVL_SC_Compu "" TAB_VERB 2 0 "False" 1 "True" /end COMPU_VTAB
/begin COMPU_METHOD COOLTTOUT_TYPAVL_SY_Compu "" TAB_VERB "%6.3" "" COMPU_TAB_REF COOLTTOUT_TYPAVL_SY_Compu /end COMPU_METHOD
/begin COMPU_VTAB COOLTTOUT_TYPAVL_SY_Compu "" TAB_VERB 2 0 "False" 1 "True" /end COMPU_VTAB
/begin COMPU_METHOD COOLTTRADROUT_TYPAVL_SC_Compu "" TAB_VERB "%6.3" "" COMPU_TAB_REF COOLTTRADROUT_TYPAVL_SC_Compu /end COMPU_METHOD
/begin COMPU_VTAB COOLTTRADROUT_TYPAVL_SC_Compu "" TAB_VERB 2 0 "False" 1 "True" /end COMPU_VTAB
/begin COMPU_METHOD dez "" RAT_FUNC "%6.2" "" COEFFS 0 1 0 0 0 1 /end COMPU_METHOD
/begin COMPU_METHOD EngN "" RAT_FUNC "%6.3" "rpm" COEFFS 0 2 0 0 0 1 /end COMPU_METHOD
/begin COMPU_METHOD EngN_LRes "" RAT_FUNC "%6.1" "rpm" COEFFS 0 0.025 0 0 0 1 /end COMPU_METHOD
/begin COMPU_METHOD fak1_q0p000407_hPa_div_percent "" RAT_FUNC "%6.5" "hPa/%" COEFFS 0 12288 0 0 0 5 /end COMPU_METHOD
/begin COMPU_METHOD fak_q0p000244 "" RAT_FUNC "%6.5" "-" COEFFS 0 65536 0 0 0 16 /end COMPU_METHOD
/begin COMPU_METHOD fak_q0p000488 "" RAT_FUNC "%6.5" "-" COEFFS 0 65536 0 0 0 32 /end COMPU_METHOD
/begin COMPU_METHOD fak_q1p22Em4 "" RAT_FUNC "%6.5" "-" COEFFS 0 8192 0 0 0 1 /end COMPU_METHOD
/begin COMPU_METHOD fak_q1p526Em5 "" RAT_FUNC "%7.6" "-" COEFFS 0 65536 0 0 0 1 /end COMPU_METHOD
/begin COMPU_METHOD fak_q3p0518Em5 "" RAT_FUNC "%7.6" "" COEFFS 0 32768 0 0 0 1 /end COMPU_METHOD
/begin COMPU_METHOD fak_q3p72529Em9 "" RAT_FUNC "%11.10" "" COEFFS 0 268435456 0 0 0 1 /end COMPU_METHOD
/begin COMPU_METHOD fak_q4p883Em4 "" RAT_FUNC "%6.5" "-" COEFFS 0 65536 0 0 0 32 /end COMPU_METHOD
/begin COMPU_METHOD fak_q6p1035Em5 "" RAT_FUNC "%7.6" "-" COEFFS 0 65536 0 0 0 4 /end COMPU_METHOD
/begin COMPU_METHOD fak_sw_b1 "" RAT_FUNC "%7.6" "-" COEFFS 0 65536 0 0 0 2 /end COMPU_METHOD
/begin COMPU_METHOD fak_sw_b2 "" RAT_FUNC "%7.6" "-" COEFFS 0 65536 0 0 0 4 /end COMPU_METHOD
/begin COMPU_METHOD fak_sw_q64 "" RAT_FUNC "%6.4" "-" COEFFS 0 64 0 0 0 1 /end COMPU_METHOD
/begin COMPU_METHOD fak_ub_b1 "" RAT_FUNC "%6.4" "-" COEFFS 0 256 0 0 0 1 /end COMPU_METHOD
/begin COMPU_METHOD fak_ub_b4 "" RAT_FUNC "%6.4" "-" COEFFS 0 256 0 0 0 4 /end COMPU_METHOD
/begin COMPU_METHOD fak_uw_b1 "" RAT_FUNC "%7.6" "-" COEFFS 0 65536 0 0 0 1 /end COMPU_METHOD
/begin COMPU_METHOD fak_uw_b16 "" RAT_FUNC "%6.5" "-" COEFFS 0 65536 0 0 0 16 /end COMPU_METHOD
/begin COMPU_METHOD fak_uw_b2 "" RAT_FUNC "%7.6" "-" COEFFS 0 65536 0 0 0 2 /end COMPU_METHOD
/begin COMPU_METHOD fak_uw_b4 "" RAT_FUNC "%7.6" "-" COEFFS 0 65536 0 0 0 4 /end COMPU_METHOD
/begin COMPU_METHOD fak_uw_b8 "" RAT_FUNC "%6.5" "-" COEFFS 0 65536 0 0 0 8 /end COMPU_METHOD
/begin COMPU_METHOD grd_sw_q0p78 "" RAT_FUNC "%6.3" "hPa/s" COEFFS 0 65536 0 0 0 51200 /end COMPU_METHOD
/begin COMPU_METHOD kumsrl_uw_b0p004 "" RAT_FUNC "%13.12" "(kg/h)/(1/min)(%)" COEFFS 0 16384000 0 0 0 1 /end COMPU_METHOD
/begin COMPU_METHOD kw_q0p0156 "" RAT_FUNC "%6.4" "Grad KW" COEFFS 0 64 0 0 0 1 /end COMPU_METHOD
/begin COMPU_METHOD kw_q0p75 "" RAT_FUNC "%6.3" "Grad KW" COEFFS 0 4 0 0 0 3 /end COMPU_METHOD
/begin COMPU_METHOD kw_sw_q0p0156 "" RAT_FUNC "%9.5" "deg KW" COEFFS 0 64 0 0 0 1 /end COMPU_METHOD
/begin COMPU_METHOD m_q0p0005 "" RAT_FUNC "%6.5" "kg/(h*%)" COEFFS 0 1 0 0 0 0.0005 /end COMPU_METHOD
/begin COMPU_METHOD m_q0p0031 "" RAT_FUNC "%6.4" "kg/h" COEFFS 0 320 0 0 0 1 /end COMPU_METHOD
/begin COMPU_METHOD m_q0p00625 "" RAT_FUNC "%6.4" "kg/h" COEFFS 0 160 0 0 0 1 /end COMPU_METHOD
/begin COMPU_METHOD m_q0p1 "" RAT_FUNC "%6.3" "kg/h" COEFFS 0 10 0 0 0 1 /end COMPU_METHOD
/begin COMPU_METHOD m_q0p1_g_DIV_L "" RAT_FUNC "%6.3" "g/l" COEFFS 0 10 0 0 0 1 /end COMPU_METHOD
/begin COMPU_METHOD m_q1Em7_g_DIV_pc "" RAT_FUNC "%10.9" "g/%" COEFFS 0 10000000 0 0 0 1 /end COMPU_METHOD
/begin COMPU_METHOD m_q4_kg_DIV_h "" RAT_FUNC "%6.2" "kg/h" COEFFS 0 1 0 0 0 4 /end COMPU_METHOD
/begin COMPU_METHOD m_ub_b25p6 "" RAT_FUNC "%6.3" "kg/h" COEFFS 0 256 0 0 0 25.6 /end COMPU_METHOD
/begin COMPU_METHOD m_uw_b1536 "" RAT_FUNC "%6.4" "kg/h" COEFFS 0 65536 0 0 0 1536 /end COMPU_METHOD
/begin COMPU_METHOD m_uw_b6553p5 "" RAT_FUNC "%6.3" "kg/h" COEFFS 0 1 0 0 0 0.1 /end COMPU_METHOD
/begin COMPU_METHOD nmot_q0p25 "" RAT_FUNC "%6.3" "1/min" COEFFS 0 4 0 0 0 1 /end COMPU_METHOD
/begin COMPU_METHOD OneToOne "" RAT_FUNC "%6.2" "-" COEFFS 0 1 0 0 0 1 /end COMPU_METHOD
/begin COMPU_METHOD Prc "" RAT_FUNC "%6.4" "%" COEFFS 0 81.92 0 0 0 1 /end COMPU_METHOD
/begin COMPU_METHOD p_q0p039 "" RAT_FUNC "%6.4" "hPa" COEFFS 0 256 0 0 0 10 /end COMPU_METHOD
/begin COMPU_METHOD p_q0p078 "" RAT_FUNC "%6.4" "hPa" COEFFS 0 64 0 0 0 5 /end COMPU_METHOD
/begin COMPU_METHOD p_sw_q0p039 "" RAT_FUNC "%6.4" "hPa" COEFFS 0 256 0 0 0 10 /end COMPU_METHOD
/begin COMPU_METHOD p_sw_q0p078 "" RAT_FUNC "%6.4" "hPa" COEFFS 0 65536 0 0 0 5120 /end COMPU_METHOD
/begin COMPU_METHOD p_uw_q0p039 "" RAT_FUNC "%6.4" "hPa" COEFFS 0 256 0 0 0 10 /end COMPU_METHOD
/begin COMPU_METHOD p_uw_q0p078 "" RAT_FUNC "%6.4" "hPa" COEFFS 0 256 0 0 0 20 /end COMPU_METHOD
/begin COMPU_METHOD q0p00390625_s_h_DIV_kg "" RAT_FUNC "%6.4" "sh/kg" COEFFS 0 256 0 0 0 1 /end COMPU_METHOD
/begin COMPU_METHOD q1p1921Em3_mL_DIV_s "" RAT_FUNC "%6.4" "ml/s" COEFFS 0 65536 0 0 0 78.125 /end COMPU_METHOD
/begin COMPU_METHOD q1p1921Em6_L_DIV_s "" RAT_FUNC "%8.7" "l/s" COEFFS 0 65536 0 0 0 0.078125 /end COMPU_METHOD
/begin COMPU_METHOD RBPtCel_mf_0p02_1 "" RAT_FUNC "%6.4" "g/s" COEFFS 0 50 0 0 0 1 /end COMPU_METHOD
/begin COMPU_METHOD rel_q0p0078125 "" RAT_FUNC "%6.4" "%" COEFFS 0 128 0 0 0 1 /end COMPU_METHOD
/begin COMPU_METHOD rel_q0p0234 "" RAT_FUNC "%6.4" "%" COEFFS 0 128 0 0 0 3 /end COMPU_METHOD
/begin COMPU_METHOD rel_q0p02344 "" RAT_FUNC "%6.4" "%" COEFFS 0 32 0 0 0 0.75 /end COMPU_METHOD
/begin COMPU_METHOD rel_q0p046875 "" RAT_FUNC "%6.4" "%" COEFFS 0 65536 0 0 0 3072 /end COMPU_METHOD
/begin COMPU_METHOD rel_q0p392 "" RAT_FUNC "%6.3" "%" COEFFS 0 255 0 0 0 100 /end COMPU_METHOD
/begin COMPU_METHOD rel_q0p75 "" RAT_FUNC "%6.3" "%" COEFFS 0 4 0 0 0 3 /end COMPU_METHOD
/begin COMPU_METHOD rel_sw_q0p0234 "" RAT_FUNC "%6.4" "%/seg" COEFFS 0 32 0 0 0 0.75 /end COMPU_METHOD
/begin COMPU_METHOD rel_ub_b99p6 "" RAT_FUNC "%6.3" "%" COEFFS 0 256 0 0 0 100 /end COMPU_METHOD
/begin COMPU_METHOD rel_ub_q0p75 "" RAT_FUNC "%6.3" "%" COEFFS 0 1 0 0 0 0.75 /end COMPU_METHOD
/begin COMPU_METHOD rel_uw_b0p3 "" RAT_FUNC "%8.7" "%/hPa" COEFFS 0 65536 0 0 0 0.3 /end COMPU_METHOD
/begin COMPU_METHOD rel_uw_b100 "" RAT_FUNC "%6.4" "%" COEFFS 0 65536 0 0 0 100 /end COMPU_METHOD
/begin COMPU_METHOD rel_uw_b3072 "" RAT_FUNC "%6.4" "%" COEFFS 0 65536 0 0 0 3072 /end COMPU_METHOD
/begin COMPU_METHOD rel_uw_b491520 "" RAT_FUNC "%6.2" "%/s" COEFFS 0 65536 0 0 0 491520 /end COMPU_METHOD
/begin COMPU_METHOD rel_uw_q0p0234 "" RAT_FUNC "%6.4" "%" COEFFS 0 32 0 0 0 0.75 /end COMPU_METHOD
/begin COMPU_METHOD t10msxs_uw_b655p35 "" RAT_FUNC "%6.4" "s" COEFFS 0 1 0 0 0 0.01 /end COMPU_METHOD
/begin COMPU_METHOD t6minxmin_q6 "" RAT_FUNC "%6.2" "min" COEFFS 0 1 0 0 0 6 /end COMPU_METHOD
/begin COMPU_METHOD Temp_Cels "" RAT_FUNC "%6.1" "deg C" COEFFS 0 10 2731.4 0 0 1 /end COMPU_METHOD
/begin COMPU_METHOD temp_q0p0234 "" RAT_FUNC "%6.4" "K" COEFFS 0 256 0 0 0 6 /end COMPU_METHOD
/begin COMPU_METHOD temp_q0p0234_o273 "" RAT_FUNC "%6.1" "Grad C" COEFFS 0 1 273.15 0 0 0.0234375 /end COMPU_METHOD
/begin COMPU_METHOD temp_ub_q0p75_o48 "" RAT_FUNC "%6.2" "Grad C" COEFFS 0 1 48 0 0 0.75 /end COMPU_METHOD
/begin COMPU_METHOD TimeEngOn "" RAT_FUNC "%6.2" "s" COEFFS 0 1 0 0 0 1 /end COMPU_METHOD
/begin COMPU_METHOD Time_Dt "" RAT_FUNC "%9.8" "s" COEFFS 0 1000000 0 0 0 1 /end COMPU_METHOD
/begin COMPU_METHOD t_q0p001 "" RAT_FUNC "%6.5" "s" COEFFS 0 1000 0 0 0 1 /end COMPU_METHOD
/begin COMPU_METHOD t_q0p001_ms "" RAT_FUNC "%6.5" "ms" COEFFS 0 1 0 0 0 0.001 /end COMPU_METHOD
/begin COMPU_METHOD t_q0p01 "" RAT_FUNC "%6.4" "s" COEFFS 0 100 0 0 0 1 /end COMPU_METHOD
/begin COMPU_METHOD t_q0p02 "" RAT_FUNC "%6.4" "s" COEFFS 0 100 0 0 0 2 /end COMPU_METHOD
/begin COMPU_METHOD t_q0p1 "" RAT_FUNC "%6.3" "s" COEFFS 0 10 0 0 0 1 /end COMPU_METHOD
/begin COMPU_METHOD t_q1 "" RAT_FUNC "%6.2" "s" COEFFS 0 1 0 0 0 1 /end COMPU_METHOD
/begin COMPU_METHOD t_q16us "" RAT_FUNC "%6.1" "us" COEFFS 0 1 0 0 0 16 /end COMPU_METHOD
/begin COMPU_METHOD t_q4_s "" RAT_FUNC "%6.2" "s" COEFFS 0 1 0 0 0 4 /end COMPU_METHOD
/begin COMPU_METHOD Vol "" RAT_FUNC "%6.4" "l" COEFFS 0 100 0 0 0 1 /end COMPU_METHOD
/begin COMPU_METHOD vol_q0p1_cm3 "" RAT_FUNC "%6.3" "cm^3" COEFFS 0 10 0 0 0 1 /end COMPU_METHOD
/begin COMPU_METHOD vol_q0p702Em3_dm3 "" RAT_FUNC "%6.5" "dm^3" COEFFS 0 2849 0 0 0 2 /end COMPU_METHOD
/begin COMPU_METHOD vol_q5p0Em5_l "" RAT_FUNC "%7.6" "L" COEFFS 0 20000 0 0 0 1 /end COMPU_METHOD
/begin COMPU_METHOD vol_q8p583Em3 "" RAT_FUNC "%6.4" "l/h" COEFFS 0 131072 0 0 0 1125 /end COMPU_METHOD
/begin COMPU_METHOD vol_q9p766Em4_L "" RAT_FUNC "%6.5" "L" COEFFS 0 65536 0 0 0 64 /end COMPU_METHOD
/begin COMPU_METHOD zk100msxs_uw_b6553 "" RAT_FUNC "%6.1" "s" COEFFS 0 0 65536 0 10 0 /end COMPU_METHOD
/begin COMPU_METHOD zk1msxs_uw_b65p536 "" RAT_FUNC "%6.3" "s" COEFFS 0 0 65536 0 1000 0 /end COMPU_METHOD
/begin RECORD_LAYOUT RB_Curve_S16_S16 NO_AXIS_PTS_X 1 SWORD AXIS_PTS_X 2 SWORD INDEX_INCR DIRECT FNC_VALUES 3 SWORD COLUMN_DIR DIRECT /end RECORD_LAYOUT
/begin RECORD_LAYOUT RB_Curve_S16_U16_Static NO_AXIS_PTS_X 1 SWORD AXIS_PTS_X 2 SWORD INDEX_INCR DIRECT FNC_VALUES 3 UWORD COLUMN_DIR DIRECT STATIC_RECORD_LAYOUT /end RECORD_LAYOUT
/begin RECORD_LAYOUT RB_Curve_S8_U16_Static NO_AXIS_PTS_X 1 SBYTE AXIS_PTS_X 2 SBYTE INDEX_INCR DIRECT FNC_VALUES 3 UWORD COLUMN_DIR DIRECT STATIC_RECORD_LAYOUT /end RECORD_LAYOUT
/begin RECORD_LAYOUT RB_Curve_U16_S16_Static NO_AXIS_PTS_X 1 UWORD AXIS_PTS_X 2 UWORD INDEX_INCR DIRECT FNC_VALUES 3 SWORD COLUMN_DIR DIRECT STATIC_RECORD_LAYOUT /end RECORD_LAYOUT
/begin RECORD_LAYOUT RB_Curve_U16_U16 NO_AXIS_PTS_X 1 UWORD AXIS_PTS_X 2 UWORD INDEX_INCR DIRECT FNC_VALUES 3 UWORD COLUMN_DIR DIRECT /end RECORD_LAYOUT
/begin RECORD_LAYOUT RB_Curve_U16_U8_Static NO_AXIS_PTS_X 1 UWORD AXIS_PTS_X 2 UWORD INDEX_INCR DIRECT FNC_VALUES 3 UBYTE COLUMN_DIR DIRECT STATIC_RECORD_LAYOUT /end RECORD_LAYOUT
/begin RECORD_LAYOUT RB_Curve_U8_U16_Static NO_AXIS_PTS_X 1 UBYTE AXIS_PTS_X 2 UBYTE INDEX_INCR DIRECT FNC_VALUES 3 UWORD COLUMN_DIR DIRECT STATIC_RECORD_LAYOUT /end RECORD_LAYOUT
/begin RECORD_LAYOUT RB_Curve_U8_U8 NO_AXIS_PTS_X 1 UBYTE AXIS_PTS_X 2 UBYTE INDEX_INCR DIRECT FNC_VALUES 3 UBYTE COLUMN_DIR DIRECT /end RECORD_LAYOUT
/begin RECORD_LAYOUT RB_FixCurve_U16_U16 FNC_VALUES 1 UWORD COLUMN_DIR DIRECT /end RECORD_LAYOUT
/begin RECORD_LAYOUT RB_Map_S16S16_S16 NO_AXIS_PTS_X 1 SWORD NO_AXIS_PTS_Y 2 SWORD AXIS_PTS_X 3 SWORD INDEX_INCR DIRECT AXIS_PTS_Y 4 SWORD INDEX_INCR DIRECT FNC_VALUES 5 SWORD COLUMN_DIR DIRECT /end RECORD_LAYOUT
/begin RECORD_LAYOUT RB_Map_S16S16_U16 NO_AXIS_PTS_X 1 SWORD NO_AXIS_PTS_Y 2 SWORD AXIS_PTS_X 3 SWORD INDEX_INCR DIRECT AXIS_PTS_Y 4 SWORD INDEX_INCR DIRECT FNC_VALUES 5 UWORD COLUMN_DIR DIRECT /end RECORD_LAYOUT
/begin RECORD_LAYOUT RB_Map_S16U16_S16 NO_AXIS_PTS_X 1 SWORD NO_AXIS_PTS_Y 2 SWORD AXIS_PTS_X 3 SWORD INDEX_INCR DIRECT AXIS_PTS_Y 4 UWORD INDEX_INCR DIRECT FNC_VALUES 5 SWORD ROW_DIR DIRECT /end RECORD_LAYOUT
/begin RECORD_LAYOUT RB_Map_U16S16_S16 NO_AXIS_PTS_X 1 UWORD NO_AXIS_PTS_Y 2 UWORD AXIS_PTS_X 3 UWORD INDEX_INCR DIRECT AXIS_PTS_Y 4 SWORD INDEX_INCR DIRECT FNC_VALUES 5 SWORD COLUMN_DIR DIRECT /end RECORD_LAYOUT
/begin RECORD_LAYOUT RB_Map_U16U16_U16 NO_AXIS_PTS_X 1 UWORD NO_AXIS_PTS_Y 2 UWORD AXIS_PTS_X 3 UWORD INDEX_INCR DIRECT AXIS_PTS_Y 4 UWORD INDEX_INCR DIRECT FNC_VALUES 5 UWORD COLUMN_DIR DIRECT /end RECORD_LAYOUT
/begin RECORD_LAYOUT RB_Val_Ws16 FNC_VALUES 1 SWORD COLUMN_DIR DIRECT /end RECORD_LAYOUT
/begin RECORD_LAYOUT RB_Val_Wu16 FNC_VALUES 1 UWORD COLUMN_DIR DIRECT /end RECORD_LAYOUT
/begin RECORD_LAYOUT RB_Val_Wu8 FNC_VALUES 1 UBYTE COLUMN_DIR DIRECT /end RECORD_LAYOUT
/end MODULE
/end PROJECT
