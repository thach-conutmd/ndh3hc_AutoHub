ASAP2_VERSION 1 60
/begin PROJECT MG1CA020 "MG1CA020"
/begin HEADER "" VERSION "MG1CA020_6SAY_V011_TPROT" PROJECT_NO MG1CA020 /end HEADER
/begin MODULE DIM ""
/begin MOD_COMMON "" BYTE_ORDER MSB_LAST ALIGNMENT_BYTE 1 ALIGNMENT_WORD 2 ALIGNMENT_LONG 4 ALIGNMENT_INT64 4 ALIGNMENT_FLOAT32_IEEE 4 ALIGNMENT_FLOAT64_IEEE 4 DATA_SIZE 32 /end MOD_COMMON
/begin CHARACTERISTIC DFES_Cls.DFC_LinHdrTimeoutErrACG_C "fault class per DFC / Fault class for check DFC_LinHdrTimeoutErrACG" VALUE 0x804D91E4 Val_Wu8 30.00 DFES_OneToOne 0.00 30.00 FORMAT "%5.2" EXTENDED_LIMITS 0.00 255.0 /end CHARACTERISTIC
/begin CHARACTERISTIC DFES_Cls.DFC_LinHdrTimeoutErrEBS_C "fault class per DFC / Fault class for check DFC_LinHdrTimeoutErrEBS" VALUE 0x804D91E5 Val_Wu8 30.00 DFES_OneToOne 0.00 30.00 FORMAT "%5.2" EXTENDED_LIMITS 0.00 255.0 /end CHARACTERISTIC
/begin CHARACTERISTIC DFES_Cls.DFC_LinMsgTimeoutErrACG_C "fault class per DFC / Fault class for check DFC_LinMsgTimeoutErrACG" VALUE 0x804D91E6 Val_Wu8 30.00 DFES_OneToOne 0.00 30.00 FORMAT "%5.2" EXTENDED_LIMITS 0.00 255.0 /end CHARACTERISTIC
/begin CHARACTERISTIC DFES_Cls.DFC_LinMsgTimeoutErrEBS_C "fault class per DFC / Fault class for check DFC_LinMsgTimeoutErrEBS" VALUE 0x804D91E7 Val_Wu8 30.00 DFES_OneToOne 0.00 30.00 FORMAT "%5.2" EXTENDED_LIMITS 0.00 255.0 /end CHARACTERISTIC
/begin CHARACTERISTIC DFES_Cls.DFC_LinNoStrtComErr_C "fault class per DFC / Fault class for check DFC_LinNoStrtComErr" VALUE 0x804D91E8 Val_Wu8 30.00 DFES_OneToOne 0.00 30.00 FORMAT "%5.2" EXTENDED_LIMITS 0.00 255.0 /end CHARACTERISTIC
/begin CHARACTERISTIC DFES_Cls.DFC_MisfDetVWhlFrntLeOORHi_C "fault class per DFC / Fault class for check DFC_MisfDetVWhlFrntLeOORHi" VALUE 0x804D91E9 Val_Wu8 30.00 DFES_OneToOne 0.00 30.00 FORMAT "%5.2" EXTENDED_LIMITS 0.00 255.0 /end CHARACTERISTIC
/begin CHARACTERISTIC DFES_Cls.DFC_MisfDetVWhlFrntLeRatyHi_C "fault class per DFC / Fault class for check DFC_MisfDetVWhlFrntLeRatyHi" VALUE 0x804D91EA Val_Wu8 30.00 DFES_OneToOne 0.00 30.00 FORMAT "%5.2" EXTENDED_LIMITS 0.00 255.0 /end CHARACTERISTIC
/begin CHARACTERISTIC DFES_Cls.DFC_MisfDetVWhlFrntLeRatyLo_C "fault class per DFC / Fault class for check DFC_MisfDetVWhlFrntLeRatyLo" VALUE 0x804D91EB Val_Wu8 30.00 DFES_OneToOne 0.00 30.00 FORMAT "%5.2" EXTENDED_LIMITS 0.00 255.0 /end CHARACTERISTIC
/begin CHARACTERISTIC DFES_Cls.DFC_MisfDetVWhlFrntLeStuck_C "fault class per DFC / Fault class for check DFC_MisfDetVWhlFrntLeStuck" VALUE 0x804D91EC Val_Wu8 30.00 DFES_OneToOne 0.00 30.00 FORMAT "%5.2" EXTENDED_LIMITS 0.00 255.0 /end CHARACTERISTIC
/begin CHARACTERISTIC DFES_Cls.DFC_MisfDetVWhlFrntRiOORHi_C "fault class per DFC / Fault class for check DFC_MisfDetVWhlFrntRiOORHi" VALUE 0x804D91ED Val_Wu8 30.00 DFES_OneToOne 0.00 30.00 FORMAT "%5.2" EXTENDED_LIMITS 0.00 255.0 /end CHARACTERISTIC
/begin CHARACTERISTIC DFES_Cls.DFC_MisfDetVWhlFrntRiRatyHi_C "fault class per DFC / Fault class for check DFC_MisfDetVWhlFrntRiRatyHi" VALUE 0x804D91EE Val_Wu8 30.00 DFES_OneToOne 0.00 30.00 FORMAT "%5.2" EXTENDED_LIMITS 0.00 255.0 /end CHARACTERISTIC
/begin CHARACTERISTIC DFES_Cls.DFC_MisfDetVWhlFrntRiRatyLo_C "fault class per DFC / Fault class for check DFC_MisfDetVWhlFrntRiRatyLo" VALUE 0x804D91EF Val_Wu8 30.00 DFES_OneToOne 0.00 30.00 FORMAT "%5.2" EXTENDED_LIMITS 0.00 255.0 /end CHARACTERISTIC
/begin CHARACTERISTIC DFES_Cls.DFC_MisfDetVWhlFrntRiStuck_C "fault class per DFC / Fault class for check DFC_MisfDetVWhlFrntRiStuck" VALUE 0x804D91F0 Val_Wu8 30.00 DFES_OneToOne 0.00 30.00 FORMAT "%5.2" EXTENDED_LIMITS 0.00 255.0 /end CHARACTERISTIC
/begin CHARACTERISTIC DFES_Cls.DFC_MisfDetVWhlReLeOORHi_C "fault class per DFC / Fault class for check DFC_MisfDetVWhlReLeOORHi" VALUE 0x804D91F1 Val_Wu8 30.00 DFES_OneToOne 0.00 30.00 FORMAT "%5.2" EXTENDED_LIMITS 0.00 255.0 /end CHARACTERISTIC
/begin CHARACTERISTIC DFES_Cls.DFC_MisfDetVWhlReLeRatyHi_C "fault class per DFC / Fault class for check DFC_MisfDetVWhlReLeRatyHi" VALUE 0x804D91F2 Val_Wu8 30.00 DFES_OneToOne 0.00 30.00 FORMAT "%5.2" EXTENDED_LIMITS 0.00 255.0 /end CHARACTERISTIC
/begin CHARACTERISTIC DFES_Cls.DFC_MisfDetVWhlReLeRatyLo_C "fault class per DFC / Fault class for check DFC_MisfDetVWhlReLeRatyLo" VALUE 0x804D91F3 Val_Wu8 30.00 DFES_OneToOne 0.00 30.00 FORMAT "%5.2" EXTENDED_LIMITS 0.00 255.0 /end CHARACTERISTIC
/begin CHARACTERISTIC DFES_Cls.DFC_MisfDetVWhlReLeStuck_C "fault class per DFC / Fault class for check DFC_MisfDetVWhlReLeStuck" VALUE 0x804D91F4 Val_Wu8 30.00 DFES_OneToOne 0.00 30.00 FORMAT "%5.2" EXTENDED_LIMITS 0.00 255.0 /end CHARACTERISTIC
/begin CHARACTERISTIC DFES_Cls.DFC_MisfDetVWhlReRiOORHi_C "fault class per DFC / Fault class for check DFC_MisfDetVWhlReRiOORHi" VALUE 0x804D91F5 Val_Wu8 30.00 DFES_OneToOne 0.00 30.00 FORMAT "%5.2" EXTENDED_LIMITS 0.00 255.0 /end CHARACTERISTIC
/begin CHARACTERISTIC DFES_Cls.DFC_MisfDetVWhlReRiRatyHi_C "fault class per DFC / Fault class for check DFC_MisfDetVWhlReRiRatyHi" VALUE 0x804D91F6 Val_Wu8 30.00 DFES_OneToOne 0.00 30.00 FORMAT "%5.2" EXTENDED_LIMITS 0.00 255.0 /end CHARACTERISTIC
/begin CHARACTERISTIC DFES_Cls.DFC_MisfDetVWhlReRiRatyLo_C "fault class per DFC / Fault class for check DFC_MisfDetVWhlReRiRatyLo" VALUE 0x804D91F7 Val_Wu8 30.00 DFES_OneToOne 0.00 30.00 FORMAT "%5.2" EXTENDED_LIMITS 0.00 255.0 /end CHARACTERISTIC
/begin CHARACTERISTIC DFES_Cls.DFC_MisfDetVWhlReRiStuck_C "fault class per DFC / Fault class for check DFC_MisfDetVWhlReRiStuck" VALUE 0x804D91F8 Val_Wu8 30.00 DFES_OneToOne 0.00 30.00 FORMAT "%5.2" EXTENDED_LIMITS 0.00 255.0 /end CHARACTERISTIC
/begin CHARACTERISTIC DFES_Cls.DFC_MisfDetdVWhlFrntLePlaus_C "fault class per DFC / Fault class for check DFC_MisfDetdVWhlFrntLePlaus" VALUE 0x804D91F9 Val_Wu8 30.00 DFES_OneToOne 0.00 30.00 FORMAT "%5.2" EXTENDED_LIMITS 0.00 255.0 /end CHARACTERISTIC
/begin CHARACTERISTIC DFES_Cls.DFC_MisfDetdVWhlFrntRiPlaus_C "fault class per DFC / Fault class for check DFC_MisfDetdVWhlFrntRiPlaus" VALUE 0x804D91FA Val_Wu8 30.00 DFES_OneToOne 0.00 30.00 FORMAT "%5.2" EXTENDED_LIMITS 0.00 255.0 /end CHARACTERISTIC
/begin CHARACTERISTIC DFES_Cls.DFC_MisfDetdVWhlReLePlaus_C "fault class per DFC / Fault class for check DFC_MisfDetdVWhlReLePlaus" VALUE 0x804D91FB Val_Wu8 30.00 DFES_OneToOne 0.00 30.00 FORMAT "%5.2" EXTENDED_LIMITS 0.00 255.0 /end CHARACTERISTIC
/begin CHARACTERISTIC DFES_Cls.DFC_MisfDetdVWhlReRiPlaus_C "fault class per DFC / Fault class for check DFC_MisfDetdVWhlReRiPlaus" VALUE 0x804D91FC Val_Wu8 30.00 DFES_OneToOne 0.00 30.00 FORMAT "%5.2" EXTENDED_LIMITS 0.00 255.0 /end CHARACTERISTIC
/begin CHARACTERISTIC DFES_Cls.DFC_PEnvSigRngMax_C "fault class per DFC / Fault class for check DFC_PEnvSigRngMax" VALUE 0x804D91FD Val_Wu8 30.00 DFES_OneToOne 0.00 30.00 FORMAT "%5.2" EXTENDED_LIMITS 0.00 255.0 /end CHARACTERISTIC
/begin CHARACTERISTIC DFES_Cls.DFC_PEnvSigRngMin_C "fault class per DFC / Fault class for check DFC_PEnvSigRngMin" VALUE 0x804D91FE Val_Wu8 30.00 DFES_OneToOne 0.00 30.00 FORMAT "%5.2" EXTENDED_LIMITS 0.00 255.0 /end CHARACTERISTIC
/begin CHARACTERISTIC DFES_Cls.DFC_StmFault_C "fault class per DFC / Fault class for check DFC_StmFault" VALUE 0x804D91FF Val_Wu8 30.00 DFES_OneToOne 0.00 30.00 FORMAT "%5.2" EXTENDED_LIMITS 0.00 255.0 /end CHARACTERISTIC
/begin CHARACTERISTIC DFES_Cls.DFC_StrtCtOffPth_C "fault class per DFC / Fault class for check DFC_StrtCtOffPth" VALUE 0x804D9200 Val_Wu8 30.00 DFES_OneToOne 0.00 30.00 FORMAT "%5.2" EXTENDED_LIMITS 0.00 255.0 /end CHARACTERISTIC
/begin CHARACTERISTIC DFES_Cls.DFC_StrtCtlErr_C "fault class per DFC / Fault class for check DFC_StrtCtlErr" VALUE 0x804D9201 Val_Wu8 30.00 DFES_OneToOne 0.00 30.00 FORMAT "%5.2" EXTENDED_LIMITS 0.00 255.0 /end CHARACTERISTIC
/begin CHARACTERISTIC DFES_Cls.DFC_StrtFault_C "fault class per DFC / Fault class for check DFC_StrtFault" VALUE 0x804D9202 Val_Wu8 30.00 DFES_OneToOne 0.00 30.00 FORMAT "%5.2" EXTENDED_LIMITS 0.00 255.0 /end CHARACTERISTIC
/begin CHARACTERISTIC DFES_Cls.DFC_StrtLckJudg1_C "fault class per DFC / Fault class for check DFC_StrtLckJudg1" VALUE 0x804D9203 Val_Wu8 30.00 DFES_OneToOne 0.00 30.00 FORMAT "%5.2" EXTENDED_LIMITS 0.00 255.0 /end CHARACTERISTIC
/begin CHARACTERISTIC DFES_Cls.DFC_StrtLckJudg2_C "fault class per DFC / Fault class for check DFC_StrtLckJudg2" VALUE 0x804D9204 Val_Wu8 30.00 DFES_OneToOne 0.00 30.00 FORMAT "%5.2" EXTENDED_LIMITS 0.00 255.0 /end CHARACTERISTIC
/begin CHARACTERISTIC DFES_Cls.DFC_StrtOL_C "fault class per DFC / Fault class for check DFC_StrtOL" VALUE 0x804D9205 Val_Wu8 30.00 DFES_OneToOne 0.00 30.00 FORMAT "%5.2" EXTENDED_LIMITS 0.00 255.0 /end CHARACTERISTIC
/begin CHARACTERISTIC DFES_Cls.DFC_StrtOL2_C "fault class per DFC / Fault class for check DFC_StrtOL2" VALUE 0x804D9206 Val_Wu8 30.00 DFES_OneToOne 0.00 30.00 FORMAT "%5.2" EXTENDED_LIMITS 0.00 255.0 /end CHARACTERISTIC
/begin CHARACTERISTIC DFES_Cls.DFC_StrtSCB_C "fault class per DFC / Fault class for check DFC_StrtSCB" VALUE 0x804D9207 Val_Wu8 30.00 DFES_OneToOne 0.00 30.00 FORMAT "%5.2" EXTENDED_LIMITS 0.00 255.0 /end CHARACTERISTIC
/begin CHARACTERISTIC DFES_Cls.DFC_StrtSCB2_C "fault class per DFC / Fault class for check DFC_StrtSCB2" VALUE 0x804D9208 Val_Wu8 30.00 DFES_OneToOne 0.00 30.00 FORMAT "%5.2" EXTENDED_LIMITS 0.00 255.0 /end CHARACTERISTIC
/begin CHARACTERISTIC DFES_Cls.DFC_StrtSCG_C "fault class per DFC / Fault class for check DFC_StrtSCG" VALUE 0x804D9209 Val_Wu8 30.00 DFES_OneToOne 0.00 30.00 FORMAT "%5.2" EXTENDED_LIMITS 0.00 255.0 /end CHARACTERISTIC
/begin CHARACTERISTIC DFES_Cls.DFC_StrtSCG2_C "fault class per DFC / Fault class for check DFC_StrtSCG2" VALUE 0x804D920A Val_Wu8 30.00 DFES_OneToOne 0.00 30.00 FORMAT "%5.2" EXTENDED_LIMITS 0.00 255.0 /end CHARACTERISTIC
/begin CHARACTERISTIC DFES_Cls.DFC_StrtStkRly1_C "fault class per DFC / Fault class for check DFC_StrtStkRly1" VALUE 0x804D920B Val_Wu8 30.00 DFES_OneToOne 0.00 30.00 FORMAT "%5.2" EXTENDED_LIMITS 0.00 255.0 /end CHARACTERISTIC
/begin CHARACTERISTIC DFES_Cls.DFC_StrtStkRly2_C "fault class per DFC / Fault class for check DFC_StrtStkRly2" VALUE 0x804D920C Val_Wu8 30.00 DFES_OneToOne 0.00 30.00 FORMAT "%5.2" EXTENDED_LIMITS 0.00 255.0 /end CHARACTERISTIC
/begin CHARACTERISTIC DFES_Cls.DFC_TEVEmax_C "fault class per DFC / Fault class for check DFC_TEVEmax" VALUE 0x804D920D Val_Wu8 30.00 DFES_OneToOne 0.00 30.00 FORMAT "%5.2" EXTENDED_LIMITS 0.00 255.0 /end CHARACTERISTIC
/begin CHARACTERISTIC DFES_Cls.DFC_TEVEmin_C "fault class per DFC / Fault class for check DFC_TEVEmin" VALUE 0x804D920E Val_Wu8 30.00 DFES_OneToOne 0.00 30.00 FORMAT "%5.2" EXTENDED_LIMITS 0.00 255.0 /end CHARACTERISTIC
/begin CHARACTERISTIC DFES_Cls.DFC_TEVEsig_C "fault class per DFC / Fault class for check DFC_TEVEsig" VALUE 0x804D920F Val_Wu8 30.00 DFES_OneToOne 0.00 30.00 FORMAT "%5.2" EXTENDED_LIMITS 0.00 255.0 /end CHARACTERISTIC
/begin CHARACTERISTIC DFES_Cls.DFC_VehVAllPlaus_C "fault class per DFC / Fault class for check DFC_VehVAllPlaus" VALUE 0x804D9210 Val_Wu8 30.00 DFES_OneToOne 0.00 30.00 FORMAT "%5.2" EXTENDED_LIMITS 0.00 255.0 /end CHARACTERISTIC
/begin CHARACTERISTIC DFES_Cls.DFC_VehVNCSnsrElecFailr_C "fault class per DFC / Fault class for check DFC_VehVNCSnsrElecFailr" VALUE 0x804D9211 Val_Wu8 30.00 DFES_OneToOne 0.00 30.00 FORMAT "%5.2" EXTENDED_LIMITS 0.00 255.0 /end CHARACTERISTIC
/begin CHARACTERISTIC DFES_Cls.DFC_VehVPlausCan_C "fault class per DFC / Fault class for check DFC_VehVPlausCan" VALUE 0x804D9212 Val_Wu8 30.00 DFES_OneToOne 0.00 30.00 FORMAT "%5.2" EXTENDED_LIMITS 0.00 255.0 /end CHARACTERISTIC
/begin CHARACTERISTIC DFES_Cls.DFC_VehVPlausFco_C "fault class per DFC / Fault class for check DFC_VehVPlausFco" VALUE 0x804D9213 Val_Wu8 30.00 DFES_OneToOne 0.00 30.00 FORMAT "%5.2" EXTENDED_LIMITS 0.00 255.0 /end CHARACTERISTIC
/begin CHARACTERISTIC DFES_Cls.DFC_VehVPlausPwr_C "fault class per DFC / Fault class for check DFC_VehVPlausPwr" VALUE 0x804D9214 Val_Wu8 30.00 DFES_OneToOne 0.00 30.00 FORMAT "%5.2" EXTENDED_LIMITS 0.00 255.0 /end CHARACTERISTIC
/begin CHARACTERISTIC DFES_Cls.DFC_VehVPlausV2N_C "fault class per DFC / Fault class for check DFC_VehVPlausV2N" VALUE 0x804D9215 Val_Wu8 30.00 DFES_OneToOne 0.00 30.00 FORMAT "%5.2" EXTENDED_LIMITS 0.00 255.0 /end CHARACTERISTIC
/begin CHARACTERISTIC DFES_Cls.DFC_VehVSpdSnsrAElecFailr_C "fault class per DFC / Fault class for check DFC_VehVSpdSnsrAElecFailr" VALUE 0x804D9216 Val_Wu8 30.00 DFES_OneToOne 0.00 30.00 FORMAT "%5.2" EXTENDED_LIMITS 0.00 255.0 /end CHARACTERISTIC
/begin CHARACTERISTIC DFES_Cls.DFC_VehVSpdSnsrBElecFailr_C "fault class per DFC / Fault class for check DFC_VehVSpdSnsrBElecFailr" VALUE 0x804D9217 Val_Wu8 30.00 DFES_OneToOne 0.00 30.00 FORMAT "%5.2" EXTENDED_LIMITS 0.00 255.0 /end CHARACTERISTIC
/begin CHARACTERISTIC DFES_Cls.DFC_ClthMax_C "fault class per DFC / Fault class for check DFC_ClthMax" VALUE 0x804D9218 Val_Wu8 30.00 DFES_OneToOne 0.00 30.00 FORMAT "%5.2" EXTENDED_LIMITS 0.00 255.0 /end CHARACTERISTIC
/begin CHARACTERISTIC DFES_Cls.DFC_IgnClPs_DevComErr_C "fault class per DFC / Fault class for check DFC_IgnClPs_DevComErr" VALUE 0x804D9219 Val_Wu8 30.00 DFES_OneToOne 0.00 30.00 FORMAT "%5.2" EXTENDED_LIMITS 0.00 255.0 /end CHARACTERISTIC
/begin CHARACTERISTIC DFES_Cls.DFC_IgnClPs_LineOl_0_C "fault class per DFC / Fault class for check DFC_IgnClPs_LineOl_0" VALUE 0x804D921A Val_Wu8 30.00 DFES_OneToOne 0.00 30.00 FORMAT "%5.2" EXTENDED_LIMITS 0.00 255.0 /end CHARACTERISTIC
/begin CHARACTERISTIC DFES_Cls.DFC_IgnClPs_LineOl_1_C "fault class per DFC / Fault class for check DFC_IgnClPs_LineOl_1" VALUE 0x804D921B Val_Wu8 30.00 DFES_OneToOne 0.00 30.00 FORMAT "%5.2" EXTENDED_LIMITS 0.00 255.0 /end CHARACTERISTIC
/begin CHARACTERISTIC DFES_Cls.DFC_IgnClPs_LineOl_2_C "fault class per DFC / Fault class for check DFC_IgnClPs_LineOl_2" VALUE 0x804D921C Val_Wu8 30.00 DFES_OneToOne 0.00 30.00 FORMAT "%5.2" EXTENDED_LIMITS 0.00 255.0 /end CHARACTERISTIC
/begin CHARACTERISTIC DFES_Cls.DFC_IgnClPs_LineOl_3_C "fault class per DFC / Fault class for check DFC_IgnClPs_LineOl_3" VALUE 0x804D921D Val_Wu8 30.00 DFES_OneToOne 0.00 30.00 FORMAT "%5.2" EXTENDED_LIMITS 0.00 255.0 /end CHARACTERISTIC
/begin CHARACTERISTIC DFES_Cls.DFC_IgnClPs_LineScb_0_C "fault class per DFC / Fault class for check DFC_IgnClPs_LineScb_0" VALUE 0x804D921E Val_Wu8 30.00 DFES_OneToOne 0.00 30.00 FORMAT "%5.2" EXTENDED_LIMITS 0.00 255.0 /end CHARACTERISTIC
/begin CHARACTERISTIC DFES_Cls.DFC_IgnClPs_LineScb_1_C "fault class per DFC / Fault class for check DFC_IgnClPs_LineScb_1" VALUE 0x804D921F Val_Wu8 30.00 DFES_OneToOne 0.00 30.00 FORMAT "%5.2" EXTENDED_LIMITS 0.00 255.0 /end CHARACTERISTIC
/begin CHARACTERISTIC DFES_Cls.DFC_IgnClPs_LineScb_2_C "fault class per DFC / Fault class for check DFC_IgnClPs_LineScb_2" VALUE 0x804D9220 Val_Wu8 30.00 DFES_OneToOne 0.00 30.00 FORMAT "%5.2" EXTENDED_LIMITS 0.00 255.0 /end CHARACTERISTIC
/begin CHARACTERISTIC DFES_Cls.DFC_IgnClPs_LineScb_3_C "fault class per DFC / Fault class for check DFC_IgnClPs_LineScb_3" VALUE 0x804D9221 Val_Wu8 30.00 DFES_OneToOne 0.00 30.00 FORMAT "%5.2" EXTENDED_LIMITS 0.00 255.0 /end CHARACTERISTIC
/begin CHARACTERISTIC DFES_Cls.DFC_IgnClPs_LineScg_0_C "fault class per DFC / Fault class for check DFC_IgnClPs_LineScg_0" VALUE 0x804D9222 Val_Wu8 30.00 DFES_OneToOne 0.00 30.00 FORMAT "%5.2" EXTENDED_LIMITS 0.00 255.0 /end CHARACTERISTIC
/begin CHARACTERISTIC DFES_Cls.DFC_IgnClPs_LineScg_1_C "fault class per DFC / Fault class for check DFC_IgnClPs_LineScg_1" VALUE 0x804D9223 Val_Wu8 30.00 DFES_OneToOne 0.00 30.00 FORMAT "%5.2" EXTENDED_LIMITS 0.00 255.0 /end CHARACTERISTIC
/begin CHARACTERISTIC DFES_Cls.DFC_IgnClPs_LineScg_2_C "fault class per DFC / Fault class for check DFC_IgnClPs_LineScg_2" VALUE 0x804D9224 Val_Wu8 30.00 DFES_OneToOne 0.00 30.00 FORMAT "%5.2" EXTENDED_LIMITS 0.00 255.0 /end CHARACTERISTIC
/begin CHARACTERISTIC DFES_Cls.DFC_IgnClPs_LineScg_3_C "fault class per DFC / Fault class for check DFC_IgnClPs_LineScg_3" VALUE 0x804D9225 Val_Wu8 30.00 DFES_OneToOne 0.00 30.00 FORMAT "%5.2" EXTENDED_LIMITS 0.00 255.0 /end CHARACTERISTIC
/begin CHARACTERISTIC DFES_Cls.DFC_UEGOASICS1B1_C "fault class per DFC / Fault class for check DFC_UEGOASICS1B1" VALUE 0x804D9226 Val_Wu8 30.00 DFES_OneToOne 0.00 30.00 FORMAT "%5.2" EXTENDED_LIMITS 0.00 255.0 /end CHARACTERISTIC
/begin CHARACTERISTIC DFES_Cls.DFC_UEGOOLIPES1B1_C "fault class per DFC / Fault class for check DFC_UEGOOLIPES1B1" VALUE 0x804D9227 Val_Wu8 30.00 DFES_OneToOne 0.00 30.00 FORMAT "%5.2" EXTENDED_LIMITS 0.00 255.0 /end CHARACTERISTIC
/begin CHARACTERISTIC DFES_Cls.DFC_UEGOOLRES1B1_C "fault class per DFC / Fault class for check DFC_UEGOOLRES1B1" VALUE 0x804D9228 Val_Wu8 30.00 DFES_OneToOne 0.00 30.00 FORMAT "%5.2" EXTENDED_LIMITS 0.00 255.0 /end CHARACTERISTIC
/begin CHARACTERISTIC DFES_Cls.DFC_UEGOSCBS1B1_C "fault class per DFC / Fault class for check DFC_UEGOSCBS1B1" VALUE 0x804D9229 Val_Wu8 30.00 DFES_OneToOne 0.00 30.00 FORMAT "%5.2" EXTENDED_LIMITS 0.00 255.0 /end CHARACTERISTIC
/begin CHARACTERISTIC DFES_Cls.DFC_UEGOSCGS1B1_C "fault class per DFC / Fault class for check DFC_UEGOSCGS1B1" VALUE 0x804D922A Val_Wu8 30.00 DFES_OneToOne 0.00 30.00 FORMAT "%5.2" EXTENDED_LIMITS 0.00 255.0 /end CHARACTERISTIC
/begin CHARACTERISTIC DFES_Cls.DFC_UEGOSPIS1B1_C "fault class per DFC / Fault class for check DFC_UEGOSPIS1B1" VALUE 0x804D922B Val_Wu8 30.00 DFES_OneToOne 0.00 30.00 FORMAT "%5.2" EXTENDED_LIMITS 0.00 255.0 /end CHARACTERISTIC
/begin CHARACTERISTIC DFES_Cls.DFC_UEGOSnsrS1B1_C "fault class per DFC / Fault class for check DFC_UEGOSnsrS1B1" VALUE 0x804D922C Val_Wu8 30.00 DFES_OneToOne 0.00 30.00 FORMAT "%5.2" EXTENDED_LIMITS 0.00 255.0 /end CHARACTERISTIC
/begin CHARACTERISTIC DFES_Cls.DFC_UegoOlApesS1B1_C "fault class per DFC / Fault class for check DFC_UegoOlApesS1B1" VALUE 0x804D922D Val_Wu8 30.00 DFES_OneToOne 0.00 30.00 FORMAT "%5.2" EXTENDED_LIMITS 0.00 255.0 /end CHARACTERISTIC
/begin CHARACTERISTIC DFES_Cls.DFC_UegoOlRCmpS1B1_C "fault class per DFC / Fault class for check DFC_UegoOlRCmpS1B1" VALUE 0x804D922E Val_Wu8 30.00 DFES_OneToOne 0.00 30.00 FORMAT "%5.2" EXTENDED_LIMITS 0.00 255.0 /end CHARACTERISTIC
/begin CHARACTERISTIC DFES_Cls.DFC_AirCCmprOL_C "fault class per DFC / Fault class for check DFC_AirCCmprOL" VALUE 0x804D922F Val_Wu8 30.00 DFES_OneToOne 0.00 30.00 FORMAT "%5.2" EXTENDED_LIMITS 0.00 255.0 /end CHARACTERISTIC
/begin CHARACTERISTIC DFES_Cls.DFC_AirCCmprOvrTemp_C "fault class per DFC / Fault class for check DFC_AirCCmprOvrTemp" VALUE 0x804D9230 Val_Wu8 30.00 DFES_OneToOne 0.00 30.00 FORMAT "%5.2" EXTENDED_LIMITS 0.00 255.0 /end CHARACTERISTIC
/begin CHARACTERISTIC DFES_Cls.DFC_AirCCmprSCB_C "fault class per DFC / Fault class for check DFC_AirCCmprSCB" VALUE 0x804D9231 Val_Wu8 30.00 DFES_OneToOne 0.00 30.00 FORMAT "%5.2" EXTENDED_LIMITS 0.00 255.0 /end CHARACTERISTIC
/begin CHARACTERISTIC DFES_Cls.DFC_AirCCmprSCG_C "fault class per DFC / Fault class for check DFC_AirCCmprSCG" VALUE 0x804D9232 Val_Wu8 30.00 DFES_OneToOne 0.00 30.00 FORMAT "%5.2" EXTENDED_LIMITS 0.00 255.0 /end CHARACTERISTIC
/begin CHARACTERISTIC DFES_Cls.DFC_AltErr_C "fault class per DFC / Fault class for check DFC_AltErr" VALUE 0x804D9233 Val_Wu8 30.00 DFES_OneToOne 0.00 30.00 FORMAT "%5.2" EXTENDED_LIMITS 0.00 255.0 /end CHARACTERISTIC
/begin CHARACTERISTIC DFES_Cls.DFC_BattUSRCMax_C "fault class per DFC / Fault class for check DFC_BattUSRCMax" VALUE 0x804D9234 Val_Wu8 30.00 DFES_OneToOne 0.00 30.00 FORMAT "%5.2" EXTENDED_LIMITS 0.00 255.0 /end CHARACTERISTIC
/begin CHARACTERISTIC DFES_Cls.DFC_BattUSRCMin_C "fault class per DFC / Fault class for check DFC_BattUSRCMin" VALUE 0x804D9235 Val_Wu8 30.00 DFES_OneToOne 0.00 30.00 FORMAT "%5.2" EXTENDED_LIMITS 0.00 255.0 /end CHARACTERISTIC
/begin CHARACTERISTIC DFES_Cls.DFC_ComChksTCU1_C "fault class per DFC / Fault class for check DFC_ComChksTCU1" VALUE 0x804D9236 Val_Wu8 30.00 DFES_OneToOne 0.00 30.00 FORMAT "%5.2" EXTENDED_LIMITS 0.00 255.0 /end CHARACTERISTIC
/begin CHARACTERISTIC DFES_Cls.DFC_ComChksTCU11_C "fault class per DFC / Fault class for check DFC_ComChksTCU11" VALUE 0x804D9237 Val_Wu8 30.00 DFES_OneToOne 0.00 30.00 FORMAT "%5.2" EXTENDED_LIMITS 0.00 255.0 /end CHARACTERISTIC
/begin CHARACTERISTIC DFES_Cls.DFC_ComChksTCU12_C "fault class per DFC / Fault class for check DFC_ComChksTCU12" VALUE 0x804D9238 Val_Wu8 30.00 DFES_OneToOne 0.00 30.00 FORMAT "%5.2" EXTENDED_LIMITS 0.00 255.0 /end CHARACTERISTIC
/begin CHARACTERISTIC DFES_Cls.DFC_ComChksTCU13_C "fault class per DFC / Fault class for check DFC_ComChksTCU13" VALUE 0x804D9239 Val_Wu8 30.00 DFES_OneToOne 0.00 30.00 FORMAT "%5.2" EXTENDED_LIMITS 0.00 255.0 /end CHARACTERISTIC
/begin CHARACTERISTIC DFES_Cls.DFC_ComChksTCU2_C "fault class per DFC / Fault class for check DFC_ComChksTCU2" VALUE 0x804D923A Val_Wu8 30.00 DFES_OneToOne 0.00 30.00 FORMAT "%5.2" EXTENDED_LIMITS 0.00 255.0 /end CHARACTERISTIC
/begin CHARACTERISTIC DFES_Cls.DFC_ComChksTCU3_C "fault class per DFC / Fault class for check DFC_ComChksTCU3" VALUE 0x804D923B Val_Wu8 30.00 DFES_OneToOne 0.00 30.00 FORMAT "%5.2" EXTENDED_LIMITS 0.00 255.0 /end CHARACTERISTIC
/begin CHARACTERISTIC DFES_Cls.DFC_ComChksTCU4_C "fault class per DFC / Fault class for check DFC_ComChksTCU4" VALUE 0x804D923C Val_Wu8 30.00 DFES_OneToOne 0.00 30.00 FORMAT "%5.2" EXTENDED_LIMITS 0.00 255.0 /end CHARACTERISTIC
/begin CHARACTERISTIC DFES_Cls.DFC_ComCntTCU1_C "fault class per DFC / Fault class for check DFC_ComCntTCU1" VALUE 0x804D923D Val_Wu8 30.00 DFES_OneToOne 0.00 30.00 FORMAT "%5.2" EXTENDED_LIMITS 0.00 255.0 /end CHARACTERISTIC
/begin CHARACTERISTIC DFES_Cls.DFC_ComCntTCU11_C "fault class per DFC / Fault class for check DFC_ComCntTCU11" VALUE 0x804D923E Val_Wu8 30.00 DFES_OneToOne 0.00 30.00 FORMAT "%5.2" EXTENDED_LIMITS 0.00 255.0 /end CHARACTERISTIC
/begin CHARACTERISTIC DFES_Cls.DFC_ComCntTCU12_C "fault class per DFC / Fault class for check DFC_ComCntTCU12" VALUE 0x804D923F Val_Wu8 30.00 DFES_OneToOne 0.00 30.00 FORMAT "%5.2" EXTENDED_LIMITS 0.00 255.0 /end CHARACTERISTIC
/begin CHARACTERISTIC DFES_Cls.DFC_ComCntTCU13_C "fault class per DFC / Fault class for check DFC_ComCntTCU13" VALUE 0x804D9240 Val_Wu8 30.00 DFES_OneToOne 0.00 30.00 FORMAT "%5.2" EXTENDED_LIMITS 0.00 255.0 /end CHARACTERISTIC
/begin CHARACTERISTIC DFES_Cls.DFC_ComCntTCU2_C "fault class per DFC / Fault class for check DFC_ComCntTCU2" VALUE 0x804D9241 Val_Wu8 30.00 DFES_OneToOne 0.00 30.00 FORMAT "%5.2" EXTENDED_LIMITS 0.00 255.0 /end CHARACTERISTIC
/begin CHARACTERISTIC DFES_Cls.DFC_ComCntTCU3_C "fault class per DFC / Fault class for check DFC_ComCntTCU3" VALUE 0x804D9242 Val_Wu8 30.00 DFES_OneToOne 0.00 30.00 FORMAT "%5.2" EXTENDED_LIMITS 0.00 255.0 /end CHARACTERISTIC
/begin CHARACTERISTIC DFES_Cls.DFC_ComCntTCU4_C "fault class per DFC / Fault class for check DFC_ComCntTCU4" VALUE 0x804D9243 Val_Wu8 30.00 DFES_OneToOne 0.00 30.00 FORMAT "%5.2" EXTENDED_LIMITS 0.00 255.0 /end CHARACTERISTIC
/begin CHARACTERISTIC DFES_Cls.DFC_ComTOutTCU01_C "fault class per DFC / Fault class for check DFC_ComTOutTCU01" VALUE 0x804D9244 Val_Wu8 30.00 DFES_OneToOne 0.00 30.00 FORMAT "%5.2" EXTENDED_LIMITS 0.00 255.0 /end CHARACTERISTIC
/begin CHARACTERISTIC DFES_Cls.DFC_ComTOutTCU02_C "fault class per DFC / Fault class for check DFC_ComTOutTCU02" VALUE 0x804D9245 Val_Wu8 30.00 DFES_OneToOne 0.00 30.00 FORMAT "%5.2" EXTENDED_LIMITS 0.00 255.0 /end CHARACTERISTIC
/begin CHARACTERISTIC DFES_Cls.DFC_ComTOutTCU1_C "fault class per DFC / Fault class for check DFC_ComTOutTCU1" VALUE 0x804D9246 Val_Wu8 30.00 DFES_OneToOne 0.00 30.00 FORMAT "%5.2" EXTENDED_LIMITS 0.00 255.0 /end CHARACTERISTIC
/begin CHARACTERISTIC DFES_Cls.DFC_ComTOutTCU11_C "fault class per DFC / Fault class for check DFC_ComTOutTCU11" VALUE 0x804D9247 Val_Wu8 30.00 DFES_OneToOne 0.00 30.00 FORMAT "%5.2" EXTENDED_LIMITS 0.00 255.0 /end CHARACTERISTIC
/begin CHARACTERISTIC DFES_Cls.DFC_ComTOutTCU12_C "fault class per DFC / Fault class for check DFC_ComTOutTCU12" VALUE 0x804D9248 Val_Wu8 30.00 DFES_OneToOne 0.00 30.00 FORMAT "%5.2" EXTENDED_LIMITS 0.00 255.0 /end CHARACTERISTIC
/begin CHARACTERISTIC DFES_Cls.DFC_ComTOutTCU13_C "fault class per DFC / Fault class for check DFC_ComTOutTCU13" VALUE 0x804D9249 Val_Wu8 30.00 DFES_OneToOne 0.00 30.00 FORMAT "%5.2" EXTENDED_LIMITS 0.00 255.0 /end CHARACTERISTIC
/begin CHARACTERISTIC DFES_Cls.DFC_ComTOutTCU14_C "fault class per DFC / Fault class for check DFC_ComTOutTCU14" VALUE 0x804D924A Val_Wu8 30.00 DFES_OneToOne 0.00 30.00 FORMAT "%5.2" EXTENDED_LIMITS 0.00 255.0 /end CHARACTERISTIC
/begin CHARACTERISTIC DFES_Cls.DFC_ComTOutTCU2_C "fault class per DFC / Fault class for check DFC_ComTOutTCU2" VALUE 0x804D924B Val_Wu8 30.00 DFES_OneToOne 0.00 30.00 FORMAT "%5.2" EXTENDED_LIMITS 0.00 255.0 /end CHARACTERISTIC
/begin CHARACTERISTIC DFES_Cls.DFC_ComTOutTCU3_C "fault class per DFC / Fault class for check DFC_ComTOutTCU3" VALUE 0x804D924C Val_Wu8 30.00 DFES_OneToOne 0.00 30.00 FORMAT "%5.2" EXTENDED_LIMITS 0.00 255.0 /end CHARACTERISTIC
/begin CHARACTERISTIC DFES_Cls.DFC_ComTOutTCU4_C "fault class per DFC / Fault class for check DFC_ComTOutTCU4" VALUE 0x804D924D Val_Wu8 30.00 DFES_OneToOne 0.00 30.00 FORMAT "%5.2" EXTENDED_LIMITS 0.00 255.0 /end CHARACTERISTIC
/begin CHARACTERISTIC DFES_Cls.DFC_DevLibBattUHi_C "fault class per DFC / Fault class for check DFC_DevLibBattUHi" VALUE 0x804D924E Val_Wu8 30.00 DFES_OneToOne 0.00 30.00 FORMAT "%5.2" EXTENDED_LIMITS 0.00 255.0 /end CHARACTERISTIC
/begin CHARACTERISTIC DFES_Cls.DFC_DevLibBattULo_C "fault class per DFC / Fault class for check DFC_DevLibBattULo" VALUE 0x804D924F Val_Wu8 30.00 DFES_OneToOne 0.00 30.00 FORMAT "%5.2" EXTENDED_LIMITS 0.00 255.0 /end CHARACTERISTIC
/begin CHARACTERISTIC DFES_Cls.DFC_FanDIOOL_0_C "fault class per DFC / Fault class for check DFC_FanDIOOL_0" VALUE 0x804D9250 Val_Wu8 30.00 DFES_OneToOne 0.00 30.00 FORMAT "%5.2" EXTENDED_LIMITS 0.00 255.0 /end CHARACTERISTIC
/begin CHARACTERISTIC DFES_Cls.DFC_FanDIOOL_1_C "fault class per DFC / Fault class for check DFC_FanDIOOL_1" VALUE 0x804D9251 Val_Wu8 30.00 DFES_OneToOne 0.00 30.00 FORMAT "%5.2" EXTENDED_LIMITS 0.00 255.0 /end CHARACTERISTIC
/begin CHARACTERISTIC DFES_Cls.DFC_FanDIOOvrTemp_0_C "fault class per DFC / Fault class for check DFC_FanDIOOvrTemp_0" VALUE 0x804D9252 Val_Wu8 30.00 DFES_OneToOne 0.00 30.00 FORMAT "%5.2" EXTENDED_LIMITS 0.00 255.0 /end CHARACTERISTIC
/begin CHARACTERISTIC DFES_Cls.DFC_FanDIOOvrTemp_1_C "fault class per DFC / Fault class for check DFC_FanDIOOvrTemp_1" VALUE 0x804D9253 Val_Wu8 30.00 DFES_OneToOne 0.00 30.00 FORMAT "%5.2" EXTENDED_LIMITS 0.00 255.0 /end CHARACTERISTIC
/begin CHARACTERISTIC DFES_Cls.DFC_FanDIOSCB_0_C "fault class per DFC / Fault class for check DFC_FanDIOSCB_0" VALUE 0x804D9254 Val_Wu8 30.00 DFES_OneToOne 0.00 30.00 FORMAT "%5.2" EXTENDED_LIMITS 0.00 255.0 /end CHARACTERISTIC
/begin CHARACTERISTIC DFES_Cls.DFC_FanDIOSCB_1_C "fault class per DFC / Fault class for check DFC_FanDIOSCB_1" VALUE 0x804D9255 Val_Wu8 30.00 DFES_OneToOne 0.00 30.00 FORMAT "%5.2" EXTENDED_LIMITS 0.00 255.0 /end CHARACTERISTIC
/begin CHARACTERISTIC DFES_Cls.DFC_FanDIOSCG_0_C "fault class per DFC / Fault class for check DFC_FanDIOSCG_0" VALUE 0x804D9256 Val_Wu8 30.00 DFES_OneToOne 0.00 30.00 FORMAT "%5.2" EXTENDED_LIMITS 0.00 255.0 /end CHARACTERISTIC
/begin CHARACTERISTIC DFES_Cls.DFC_FanDIOSCG_1_C "fault class per DFC / Fault class for check DFC_FanDIOSCG_1" VALUE 0x804D9257 Val_Wu8 30.00 DFES_OneToOne 0.00 30.00 FORMAT "%5.2" EXTENDED_LIMITS 0.00 255.0 /end CHARACTERISTIC
/begin CHARACTERISTIC DFES_Cls.DFC_MRlyDcOL_C "fault class per DFC / Fault class for check DFC_MRlyDcOL" VALUE 0x804D9258 Val_Wu8 30.00 DFES_OneToOne 0.00 30.00 FORMAT "%5.2" EXTENDED_LIMITS 0.00 255.0 /end CHARACTERISTIC
/begin CHARACTERISTIC DFES_Cls.DFC_MRlyDcSCB_C "fault class per DFC / Fault class for check DFC_MRlyDcSCB" VALUE 0x804D9259 Val_Wu8 30.00 DFES_OneToOne 0.00 30.00 FORMAT "%5.2" EXTENDED_LIMITS 0.00 255.0 /end CHARACTERISTIC
/begin CHARACTERISTIC DFES_Cls.DFC_MRlyDcSCG_C "fault class per DFC / Fault class for check DFC_MRlyDcSCG" VALUE 0x804D925A Val_Wu8 30.00 DFES_OneToOne 0.00 30.00 FORMAT "%5.2" EXTENDED_LIMITS 0.00 255.0 /end CHARACTERISTIC
/begin CHARACTERISTIC DFES_Cls.DFC_PSPOL_C "fault class per DFC / Fault class for check DFC_PSPOL" VALUE 0x804D925B Val_Wu8 30.00 DFES_OneToOne 0.00 30.00 FORMAT "%5.2" EXTENDED_LIMITS 0.00 255.0 /end CHARACTERISTIC
/begin CHARACTERISTIC DFES_Cls.DFC_PSPOvrTemp_C "fault class per DFC / Fault class for check DFC_PSPOvrTemp" VALUE 0x804D925C Val_Wu8 30.00 DFES_OneToOne 0.00 30.00 FORMAT "%5.2" EXTENDED_LIMITS 0.00 255.0 /end CHARACTERISTIC
/begin CHARACTERISTIC DFES_Cls.DFC_PSPSCB_C "fault class per DFC / Fault class for check DFC_PSPSCB" VALUE 0x804D925D Val_Wu8 30.00 DFES_OneToOne 0.00 30.00 FORMAT "%5.2" EXTENDED_LIMITS 0.00 255.0 /end CHARACTERISTIC
/begin CHARACTERISTIC DFES_Cls.DFC_PSPSCG_C "fault class per DFC / Fault class for check DFC_PSPSCG" VALUE 0x804D925E Val_Wu8 30.00 DFES_OneToOne 0.00 30.00 FORMAT "%5.2" EXTENDED_LIMITS 0.00 255.0 /end CHARACTERISTIC
/begin CHARACTERISTIC DFES_Cls.DFC_T50Err_C "fault class per DFC / Fault class for check DFC_T50Err" VALUE 0x804D925F Val_Wu8 30.00 DFES_OneToOne 0.00 30.00 FORMAT "%5.2" EXTENDED_LIMITS 0.00 255.0 /end CHARACTERISTIC
/begin CHARACTERISTIC DFES_Cls.DFC_ThrVlvLoBattB1_C "fault class per DFC / Fault class for check DFC_ThrVlvLoBattB1" VALUE 0x804D9260 Val_Wu8 30.00 DFES_OneToOne 0.00 30.00 FORMAT "%5.2" EXTENDED_LIMITS 0.00 255.0 /end CHARACTERISTIC
/begin CHARACTERISTIC DFES_Cls.DFC_VehVPhysRngHi_C "fault class per DFC / Fault class for check DFC_VehVPhysRngHi" VALUE 0x804D9261 Val_Wu8 30.00 DFES_OneToOne 0.00 30.00 FORMAT "%5.2" EXTENDED_LIMITS 0.00 255.0 /end CHARACTERISTIC
/begin CHARACTERISTIC DFES_Cls.DFC_VehVSclOutOL_C "fault class per DFC / Fault class for check DFC_VehVSclOutOL" VALUE 0x804D9262 Val_Wu8 30.00 DFES_OneToOne 0.00 30.00 FORMAT "%5.2" EXTENDED_LIMITS 0.00 255.0 /end CHARACTERISTIC
/begin CHARACTERISTIC DFES_Cls.DFC_VehVSclOutOT_C "fault class per DFC / Fault class for check DFC_VehVSclOutOT" VALUE 0x804D9263 Val_Wu8 30.00 DFES_OneToOne 0.00 30.00 FORMAT "%5.2" EXTENDED_LIMITS 0.00 255.0 /end CHARACTERISTIC
/begin CHARACTERISTIC DFES_Cls.DFC_VehVSclOutSCB_C "fault class per DFC / Fault class for check DFC_VehVSclOutSCB" VALUE 0x804D9264 Val_Wu8 30.00 DFES_OneToOne 0.00 30.00 FORMAT "%5.2" EXTENDED_LIMITS 0.00 255.0 /end CHARACTERISTIC
/begin CHARACTERISTIC DFES_Cls.DFC_VehVSclOutSCG_C "fault class per DFC / Fault class for check DFC_VehVSclOutSCG" VALUE 0x804D9265 Val_Wu8 30.00 DFES_OneToOne 0.00 30.00 FORMAT "%5.2" EXTENDED_LIMITS 0.00 255.0 /end CHARACTERISTIC
/begin CHARACTERISTIC DFES_Cls.DFC_VehVSnsrARngHi_C "fault class per DFC / Fault class for check DFC_VehVSnsrARngHi" VALUE 0x804D9266 Val_Wu8 30.00 DFES_OneToOne 0.00 30.00 FORMAT "%5.2" EXTENDED_LIMITS 0.00 255.0 /end CHARACTERISTIC
/begin CHARACTERISTIC DFES_Cls.DFC_VehVSnsrBRngHi_C "fault class per DFC / Fault class for check DFC_VehVSnsrBRngHi" VALUE 0x804D9267 Val_Wu8 30.00 DFES_OneToOne 0.00 30.00 FORMAT "%5.2" EXTENDED_LIMITS 0.00 255.0 /end CHARACTERISTIC
/begin CHARACTERISTIC DFES_Cls.DFC_VehVSpdRtyDiag_C "fault class per DFC / Fault class for check DFC_VehVSpdRtyDiag" VALUE 0x804D9268 Val_Wu8 30.00 DFES_OneToOne 0.00 30.00 FORMAT "%5.2" EXTENDED_LIMITS 0.00 255.0 /end CHARACTERISTIC
/begin CHARACTERISTIC DFES_Cls.DFC_VehVWhlErr_C "fault class per DFC / Fault class for check DFC_VehVWhlErr" VALUE 0x804D9269 Val_Wu8 30.00 DFES_OneToOne 0.00 30.00 FORMAT "%5.2" EXTENDED_LIMITS 0.00 255.0 /end CHARACTERISTIC
/begin CHARACTERISTIC DFES_Cls.DFC_ACEvpTSRCMax_C "fault class per DFC / Fault class for check DFC_ACEvpTSRCMax" VALUE 0x804D926A Val_Wu8 30.00 DFES_OneToOne 0.00 30.00 FORMAT "%5.2" EXTENDED_LIMITS 0.00 255.0 /end CHARACTERISTIC
/begin CHARACTERISTIC DFES_Cls.DFC_ACEvpTSRCMin_C "fault class per DFC / Fault class for check DFC_ACEvpTSRCMin" VALUE 0x804D926B Val_Wu8 30.00 DFES_OneToOne 0.00 30.00 FORMAT "%5.2" EXTENDED_LIMITS 0.00 255.0 /end CHARACTERISTIC
/begin CHARACTERISTIC DFES_Cls.DFC_AirCClntPAnaSRCMax_C "fault class per DFC / Fault class for check DFC_AirCClntPAnaSRCMax" VALUE 0x804D926C Val_Wu8 30.00 DFES_OneToOne 0.00 30.00 FORMAT "%5.2" EXTENDED_LIMITS 0.00 255.0 /end CHARACTERISTIC
/begin CHARACTERISTIC DFES_Cls.DFC_AirCClntPAnaSRCMin_C "fault class per DFC / Fault class for check DFC_AirCClntPAnaSRCMin" VALUE 0x804D926D Val_Wu8 30.00 DFES_OneToOne 0.00 30.00 FORMAT "%5.2" EXTENDED_LIMITS 0.00 255.0 /end CHARACTERISTIC
/begin CHARACTERISTIC DFES_Cls.DFC_AirCSwtNpl_C "fault class per DFC / Fault class for check DFC_AirCSwtNpl" VALUE 0x804D926E Val_Wu8 30.00 DFES_OneToOne 0.00 30.00 FORMAT "%5.2" EXTENDED_LIMITS 0.00 255.0 /end CHARACTERISTIC
/begin CHARACTERISTIC DFES_Cls.DFC_AirCSwtSig_C "fault class per DFC / Fault class for check DFC_AirCSwtSig" VALUE 0x804D926F Val_Wu8 30.00 DFES_OneToOne 0.00 30.00 FORMAT "%5.2" EXTENDED_LIMITS 0.00 255.0 /end CHARACTERISTIC
/begin CHARACTERISTIC DFES_Cls.DFC_Brk_C "fault class per DFC / Fault class for check DFC_Brk" VALUE 0x804D9270 Val_Wu8 30.00 DFES_OneToOne 0.00 30.00 FORMAT "%5.2" EXTENDED_LIMITS 0.00 255.0 /end CHARACTERISTIC
/begin CHARACTERISTIC DFES_Cls.DFC_BrkSig_C "fault class per DFC / Fault class for check DFC_BrkSig" VALUE 0x804D9271 Val_Wu8 30.00 DFES_OneToOne 0.00 30.00 FORMAT "%5.2" EXTENDED_LIMITS 0.00 255.0 /end CHARACTERISTIC
/begin CHARACTERISTIC DFES_Cls.DFC_ClthSig_C "fault class per DFC / Fault class for check DFC_ClthSig" VALUE 0x804D9272 Val_Wu8 30.00 DFES_OneToOne 0.00 30.00 FORMAT "%5.2" EXTENDED_LIMITS 0.00 255.0 /end CHARACTERISTIC
/begin CHARACTERISTIC DFES_Cls.DFC_HLSDemOvhtEngLim_C "fault class per DFC / Fault class for check DFC_HLSDemOvhtEngLim" VALUE 0x804D9273 Val_Wu8 30.00 DFES_OneToOne 0.00 30.00 FORMAT "%5.2" EXTENDED_LIMITS 0.00 255.0 /end CHARACTERISTIC
/begin CHARACTERISTIC DFES_Cls.DFC_OilPNpl_C "fault class per DFC / Fault class for check DFC_OilPNpl" VALUE 0x804D9274 Val_Wu8 30.00 DFES_OneToOne 0.00 30.00 FORMAT "%5.2" EXTENDED_LIMITS 0.00 255.0 /end CHARACTERISTIC
/begin CHARACTERISTIC DFES_Cls.DFC_PIntkVUsLineHiB1_C "fault class per DFC / Fault class for check DFC_PIntkVUsLineHiB1" VALUE 0x804D9275 Val_Wu8 30.00 DFES_OneToOne 0.00 30.00 FORMAT "%5.2" EXTENDED_LIMITS 0.00 255.0 /end CHARACTERISTIC
/begin CHARACTERISTIC DFES_Cls.DFC_PIntkVUsLineLoB1_C "fault class per DFC / Fault class for check DFC_PIntkVUsLineLoB1" VALUE 0x804D9276 Val_Wu8 30.00 DFES_OneToOne 0.00 30.00 FORMAT "%5.2" EXTENDED_LIMITS 0.00 255.0 /end CHARACTERISTIC
/begin CHARACTERISTIC DFES_Cls.DFC_VehVPhysRngLo_C "fault class per DFC / Fault class for check DFC_VehVPhysRngLo" VALUE 0x804D9277 Val_Wu8 30.00 DFES_OneToOne 0.00 30.00 FORMAT "%5.2" EXTENDED_LIMITS 0.00 255.0 /end CHARACTERISTIC
/begin CHARACTERISTIC DFES_Cls.DFC_VehVSigCan_C "fault class per DFC / Fault class for check DFC_VehVSigCan" VALUE 0x804D9278 Val_Wu8 30.00 DFES_OneToOne 0.00 30.00 FORMAT "%5.2" EXTENDED_LIMITS 0.00 255.0 /end CHARACTERISTIC
/begin CHARACTERISTIC DFES_Cls.DFC_VehVSigCanSafe_C "fault class per DFC / Fault class for check DFC_VehVSigCanSafe" VALUE 0x804D9279 Val_Wu8 30.00 DFES_OneToOne 0.00 30.00 FORMAT "%5.2" EXTENDED_LIMITS 0.00 255.0 /end CHARACTERISTIC
/begin CHARACTERISTIC DFES_Cls.DFC_VlvLftFbOilPSnsrIntk11SRCMax_C "fault class per DFC / Fault class for check DFC_VlvLftFbOilPSnsrIntk11SRCMax" VALUE 0x804D927A Val_Wu8 30.00 DFES_OneToOne 0.00 30.00 FORMAT "%5.2" EXTENDED_LIMITS 0.00 255.0 /end CHARACTERISTIC
/begin CHARACTERISTIC DFES_Cls.DFC_VlvLftFbOilPSnsrIntk11SRCMin_C "fault class per DFC / Fault class for check DFC_VlvLftFbOilPSnsrIntk11SRCMin" VALUE 0x804D927B Val_Wu8 30.00 DFES_OneToOne 0.00 30.00 FORMAT "%5.2" EXTENDED_LIMITS 0.00 255.0 /end CHARACTERISTIC
/begin CHARACTERISTIC DFES_Cls.DFC_ClthNpl_C "fault class per DFC / Fault class for check DFC_ClthNpl" VALUE 0x804D927C Val_Wu8 30.00 DFES_OneToOne 0.00 30.00 FORMAT "%5.2" EXTENDED_LIMITS 0.00 255.0 /end CHARACTERISTIC
/begin CHARACTERISTIC DFES_Cls.DFC_EV1max_C "fault class per DFC / Fault class for check DFC_EV1max" VALUE 0x804D927D Val_Wu8 30.00 DFES_OneToOne 0.00 30.00 FORMAT "%5.2" EXTENDED_LIMITS 0.00 255.0 /end CHARACTERISTIC
/begin CHARACTERISTIC DFES_Cls.DFC_EV1min_C "fault class per DFC / Fault class for check DFC_EV1min" VALUE 0x804D927E Val_Wu8 30.00 DFES_OneToOne 0.00 30.00 FORMAT "%5.2" EXTENDED_LIMITS 0.00 255.0 /end CHARACTERISTIC
/begin CHARACTERISTIC DFES_Cls.DFC_EV1sig_C "fault class per DFC / Fault class for check DFC_EV1sig" VALUE 0x804D927F Val_Wu8 30.00 DFES_OneToOne 0.00 30.00 FORMAT "%5.2" EXTENDED_LIMITS 0.00 255.0 /end CHARACTERISTIC
/begin CHARACTERISTIC DFES_Cls.DFC_EV2max_C "fault class per DFC / Fault class for check DFC_EV2max" VALUE 0x804D9280 Val_Wu8 30.00 DFES_OneToOne 0.00 30.00 FORMAT "%5.2" EXTENDED_LIMITS 0.00 255.0 /end CHARACTERISTIC
/begin CHARACTERISTIC DFES_Cls.DFC_EV2min_C "fault class per DFC / Fault class for check DFC_EV2min" VALUE 0x804D9281 Val_Wu8 30.00 DFES_OneToOne 0.00 30.00 FORMAT "%5.2" EXTENDED_LIMITS 0.00 255.0 /end CHARACTERISTIC
/begin CHARACTERISTIC DFES_Cls.DFC_EV2sig_C "fault class per DFC / Fault class for check DFC_EV2sig" VALUE 0x804D9282 Val_Wu8 30.00 DFES_OneToOne 0.00 30.00 FORMAT "%5.2" EXTENDED_LIMITS 0.00 255.0 /end CHARACTERISTIC
/begin CHARACTERISTIC DFES_Cls.DFC_EV3max_C "fault class per DFC / Fault class for check DFC_EV3max" VALUE 0x804D9283 Val_Wu8 30.00 DFES_OneToOne 0.00 30.00 FORMAT "%5.2" EXTENDED_LIMITS 0.00 255.0 /end CHARACTERISTIC
/begin CHARACTERISTIC DFES_Cls.DFC_EV3min_C "fault class per DFC / Fault class for check DFC_EV3min" VALUE 0x804D9284 Val_Wu8 30.00 DFES_OneToOne 0.00 30.00 FORMAT "%5.2" EXTENDED_LIMITS 0.00 255.0 /end CHARACTERISTIC
/begin CHARACTERISTIC DFES_Cls.DFC_EV3sig_C "fault class per DFC / Fault class for check DFC_EV3sig" VALUE 0x804D9285 Val_Wu8 30.00 DFES_OneToOne 0.00 30.00 FORMAT "%5.2" EXTENDED_LIMITS 0.00 255.0 /end CHARACTERISTIC
/begin CHARACTERISTIC DFES_Cls.DFC_EV4max_C "fault class per DFC / Fault class for check DFC_EV4max" VALUE 0x804D9286 Val_Wu8 30.00 DFES_OneToOne 0.00 30.00 FORMAT "%5.2" EXTENDED_LIMITS 0.00 255.0 /end CHARACTERISTIC
/begin CHARACTERISTIC DFES_Cls.DFC_EV4min_C "fault class per DFC / Fault class for check DFC_EV4min" VALUE 0x804D9287 Val_Wu8 30.00 DFES_OneToOne 0.00 30.00 FORMAT "%5.2" EXTENDED_LIMITS 0.00 255.0 /end CHARACTERISTIC
/begin CHARACTERISTIC DFES_Cls.DFC_EV4sig_C "fault class per DFC / Fault class for check DFC_EV4sig" VALUE 0x804D9288 Val_Wu8 30.00 DFES_OneToOne 0.00 30.00 FORMAT "%5.2" EXTENDED_LIMITS 0.00 255.0 /end CHARACTERISTIC
/begin CHARACTERISTIC DFES_Cls.DFC_GbxPNPosnDrvCdn_C "fault class per DFC / Fault class for check DFC_GbxPNPosnDrvCdn" VALUE 0x804D9289 Val_Wu8 30.00 DFES_OneToOne 0.00 30.00 FORMAT "%5.2" EXTENDED_LIMITS 0.00 255.0 /end CHARACTERISTIC
/begin CHARACTERISTIC DFES_Cls.DFC_GbxPNPosnPlausy_C "fault class per DFC / Fault class for check DFC_GbxPNPosnPlausy" VALUE 0x804D928A Val_Wu8 30.00 DFES_OneToOne 0.00 30.00 FORMAT "%5.2" EXTENDED_LIMITS 0.00 255.0 /end CHARACTERISTIC
/begin CHARACTERISTIC DFES_Cls.DFC_PEnvCcMax_C "fault class per DFC / Fault class for check DFC_PEnvCcMax" VALUE 0x804D928B Val_Wu8 30.00 DFES_OneToOne 0.00 30.00 FORMAT "%5.2" EXTENDED_LIMITS 0.00 255.0 /end CHARACTERISTIC
/begin CHARACTERISTIC DFES_Cls.DFC_PEnvCcMin_C "fault class per DFC / Fault class for check DFC_PEnvCcMin" VALUE 0x804D928C Val_Wu8 30.00 DFES_OneToOne 0.00 30.00 FORMAT "%5.2" EXTENDED_LIMITS 0.00 255.0 /end CHARACTERISTIC
/begin CHARACTERISTIC DFES_Cls.DFC_PEnvRngChkMax_C "fault class per DFC / Fault class for check DFC_PEnvRngChkMax" VALUE 0x804D928D Val_Wu8 30.00 DFES_OneToOne 0.00 30.00 FORMAT "%5.2" EXTENDED_LIMITS 0.00 255.0 /end CHARACTERISTIC
/begin CHARACTERISTIC DFES_Cls.DFC_PEnvRngChkMin_C "fault class per DFC / Fault class for check DFC_PEnvRngChkMin" VALUE 0x804D928E Val_Wu8 30.00 DFES_OneToOne 0.00 30.00 FORMAT "%5.2" EXTENDED_LIMITS 0.00 255.0 /end CHARACTERISTIC
/begin CHARACTERISTIC DFES_Cls.DFC_PEnvSnsrPlaus_C "fault class per DFC / Fault class for check DFC_PEnvSnsrPlaus" VALUE 0x804D928F Val_Wu8 30.00 DFES_OneToOne 0.00 30.00 FORMAT "%5.2" EXTENDED_LIMITS 0.00 255.0 /end CHARACTERISTIC
/begin CHARACTERISTIC DFES_Cls.DFC_UEGOHeatrPsS1B1Max_C "fault class per DFC / Fault class for check DFC_UEGOHeatrPsS1B1Max" VALUE 0x804D9290 Val_Wu8 30.00 DFES_OneToOne 0.00 30.00 FORMAT "%5.2" EXTENDED_LIMITS 0.00 255.0 /end CHARACTERISTIC
/begin CHARACTERISTIC DFES_Cls.DFC_UEGOHeatrPsS1B1Min_C "fault class per DFC / Fault class for check DFC_UEGOHeatrPsS1B1Min" VALUE 0x804D9291 Val_Wu8 30.00 DFES_OneToOne 0.00 30.00 FORMAT "%5.2" EXTENDED_LIMITS 0.00 255.0 /end CHARACTERISTIC
/begin CHARACTERISTIC DFES_Cls.DFC_UEGOHeatrPsS1B1Sig_C "fault class per DFC / Fault class for check DFC_UEGOHeatrPsS1B1Sig" VALUE 0x804D9292 Val_Wu8 30.00 DFES_OneToOne 0.00 30.00 FORMAT "%5.2" EXTENDED_LIMITS 0.00 255.0 /end CHARACTERISTIC
/begin CHARACTERISTIC DFES_Cls.DFC_UEGOHeatrRlyPsOLS1B1_C "fault class per DFC / Fault class for check DFC_UEGOHeatrRlyPsOLS1B1" VALUE 0x804D9293 Val_Wu8 30.00 DFES_OneToOne 0.00 30.00 FORMAT "%5.2" EXTENDED_LIMITS 0.00 255.0 /end CHARACTERISTIC
/begin CHARACTERISTIC DFES_Cls.DFC_UEGOHeatrRlyPsSCBS1B1_C "fault class per DFC / Fault class for check DFC_UEGOHeatrRlyPsSCBS1B1" VALUE 0x804D9294 Val_Wu8 30.00 DFES_OneToOne 0.00 30.00 FORMAT "%5.2" EXTENDED_LIMITS 0.00 255.0 /end CHARACTERISTIC
/begin CHARACTERISTIC DFES_Cls.DFC_UEGOHeatrRlyPsSCGS1B1_C "fault class per DFC / Fault class for check DFC_UEGOHeatrRlyPsSCGS1B1" VALUE 0x804D9295 Val_Wu8 30.00 DFES_OneToOne 0.00 30.00 FORMAT "%5.2" EXTENDED_LIMITS 0.00 255.0 /end CHARACTERISTIC
/begin CHARACTERISTIC DFES_Cls.DFC_KnDetSens1PortAMax_C "fault class per DFC / Fault class for check DFC_KnDetSens1PortAMax" VALUE 0x804D9296 Val_Wu8 30.00 DFES_OneToOne 0.00 30.00 FORMAT "%5.2" EXTENDED_LIMITS 0.00 255.0 /end CHARACTERISTIC
/begin CHARACTERISTIC DFES_Cls.DFC_KnDetSens1PortAMin_C "fault class per DFC / Fault class for check DFC_KnDetSens1PortAMin" VALUE 0x804D9297 Val_Wu8 30.00 DFES_OneToOne 0.00 30.00 FORMAT "%5.2" EXTENDED_LIMITS 0.00 255.0 /end CHARACTERISTIC
/begin CHARACTERISTIC DFES_Cls.DFC_KnDetSens1PortBMax_C "fault class per DFC / Fault class for check DFC_KnDetSens1PortBMax" VALUE 0x804D9298 Val_Wu8 30.00 DFES_OneToOne 0.00 30.00 FORMAT "%5.2" EXTENDED_LIMITS 0.00 255.0 /end CHARACTERISTIC
/begin CHARACTERISTIC DFES_Cls.DFC_KnDetSens1PortBMin_C "fault class per DFC / Fault class for check DFC_KnDetSens1PortBMin" VALUE 0x804D9299 Val_Wu8 30.00 DFES_OneToOne 0.00 30.00 FORMAT "%5.2" EXTENDED_LIMITS 0.00 255.0 /end CHARACTERISTIC
/begin CHARACTERISTIC DFES_Cls.DFC_Clth2ONStuck_C "fault class per DFC / Fault class for check DFC_Clth2ONStuck" VALUE 0x804D929A Val_Wu8 30.00 DFES_OneToOne 0.00 30.00 FORMAT "%5.2" EXTENDED_LIMITS 0.00 255.0 /end CHARACTERISTIC
/begin CHARACTERISTIC DFES_Cls.DFC_Clth2ONStuckLdc_C "fault class per DFC / Fault class for check DFC_Clth2ONStuckLdc" VALUE 0x804D929B Val_Wu8 30.00 DFES_OneToOne 0.00 30.00 FORMAT "%5.2" EXTENDED_LIMITS 0.00 255.0 /end CHARACTERISTIC
/begin CHARACTERISTIC DFES_Cls.DFC_Clth3ONStuckLdc_C "fault class per DFC / Fault class for check DFC_Clth3ONStuckLdc" VALUE 0x804D929C Val_Wu8 30.00 DFES_OneToOne 0.00 30.00 FORMAT "%5.2" EXTENDED_LIMITS 0.00 255.0 /end CHARACTERISTIC
/begin CHARACTERISTIC DFES_Cls.DFC_Clth3ONStuckPostDrv_C "fault class per DFC / Fault class for check DFC_Clth3ONStuckPostDrv" VALUE 0x804D929D Val_Wu8 30.00 DFES_OneToOne 0.00 30.00 FORMAT "%5.2" EXTENDED_LIMITS 0.00 255.0 /end CHARACTERISTIC
/begin CHARACTERISTIC DFES_Cls.DFC_Clth4ONStuck_C "fault class per DFC / Fault class for check DFC_Clth4ONStuck" VALUE 0x804D929E Val_Wu8 30.00 DFES_OneToOne 0.00 30.00 FORMAT "%5.2" EXTENDED_LIMITS 0.00 255.0 /end CHARACTERISTIC
/begin CHARACTERISTIC DFES_Cls.DFC_Clth4ONStuckLdc_C "fault class per DFC / Fault class for check DFC_Clth4ONStuckLdc" VALUE 0x804D929F Val_Wu8 30.00 DFES_OneToOne 0.00 30.00 FORMAT "%5.2" EXTENDED_LIMITS 0.00 255.0 /end CHARACTERISTIC
/begin CHARACTERISTIC DFES_Cls.DFC_ComDLCTCU01_C "fault class per DFC / Fault class for check DFC_ComDLCTCU01" VALUE 0x804D92A0 Val_Wu8 30.00 DFES_OneToOne 0.00 30.00 FORMAT "%5.2" EXTENDED_LIMITS 0.00 255.0 /end CHARACTERISTIC
/begin CHARACTERISTIC DFES_Cls.DFC_ComDLCTCU02_C "fault class per DFC / Fault class for check DFC_ComDLCTCU02" VALUE 0x804D92A1 Val_Wu8 30.00 DFES_OneToOne 0.00 30.00 FORMAT "%5.2" EXTENDED_LIMITS 0.00 255.0 /end CHARACTERISTIC
/begin CHARACTERISTIC DFES_Cls.DFC_ComDLCTCU1_C "fault class per DFC / Fault class for check DFC_ComDLCTCU1" VALUE 0x804D92A2 Val_Wu8 30.00 DFES_OneToOne 0.00 30.00 FORMAT "%5.2" EXTENDED_LIMITS 0.00 255.0 /end CHARACTERISTIC
/begin CHARACTERISTIC DFES_Cls.DFC_ComDLCTCU11_C "fault class per DFC / Fault class for check DFC_ComDLCTCU11" VALUE 0x804D92A3 Val_Wu8 30.00 DFES_OneToOne 0.00 30.00 FORMAT "%5.2" EXTENDED_LIMITS 0.00 255.0 /end CHARACTERISTIC
/begin CHARACTERISTIC DFES_Cls.DFC_ComDLCTCU12_C "fault class per DFC / Fault class for check DFC_ComDLCTCU12" VALUE 0x804D92A4 Val_Wu8 30.00 DFES_OneToOne 0.00 30.00 FORMAT "%5.2" EXTENDED_LIMITS 0.00 255.0 /end CHARACTERISTIC
/begin CHARACTERISTIC DFES_Cls.DFC_ComDLCTCU13_C "fault class per DFC / Fault class for check DFC_ComDLCTCU13" VALUE 0x804D92A5 Val_Wu8 30.00 DFES_OneToOne 0.00 30.00 FORMAT "%5.2" EXTENDED_LIMITS 0.00 255.0 /end CHARACTERISTIC
/begin CHARACTERISTIC DFES_Cls.DFC_ComDLCTCU14_C "fault class per DFC / Fault class for check DFC_ComDLCTCU14" VALUE 0x804D92A6 Val_Wu8 30.00 DFES_OneToOne 0.00 30.00 FORMAT "%5.2" EXTENDED_LIMITS 0.00 255.0 /end CHARACTERISTIC
/begin CHARACTERISTIC DFES_Cls.DFC_ComDLCTCU2_C "fault class per DFC / Fault class for check DFC_ComDLCTCU2" VALUE 0x804D92A7 Val_Wu8 30.00 DFES_OneToOne 0.00 30.00 FORMAT "%5.2" EXTENDED_LIMITS 0.00 255.0 /end CHARACTERISTIC
/begin CHARACTERISTIC DFES_Cls.DFC_ComDLCTCU3_C "fault class per DFC / Fault class for check DFC_ComDLCTCU3" VALUE 0x804D92A8 Val_Wu8 30.00 DFES_OneToOne 0.00 30.00 FORMAT "%5.2" EXTENDED_LIMITS 0.00 255.0 /end CHARACTERISTIC
/begin CHARACTERISTIC DFES_Cls.DFC_ComDLCTCU4_C "fault class per DFC / Fault class for check DFC_ComDLCTCU4" VALUE 0x804D92A9 Val_Wu8 30.00 DFES_OneToOne 0.00 30.00 FORMAT "%5.2" EXTENDED_LIMITS 0.00 255.0 /end CHARACTERISTIC
/begin CHARACTERISTIC DFES_Cls.DFC_EVX_C "fault class per DFC / Fault class for check DFC_EVX" VALUE 0x804D92AA Val_Wu8 30.00 DFES_OneToOne 0.00 30.00 FORMAT "%5.2" EXTENDED_LIMITS 0.00 255.0 /end CHARACTERISTIC
/begin CHARACTERISTIC DFES_Cls.DFC_EbsSocFlt_C "fault class per DFC / Fault class for check DFC_EbsSocFlt" VALUE 0x804D92AB Val_Wu8 30.00 DFES_OneToOne 0.00 30.00 FORMAT "%5.2" EXTENDED_LIMITS 0.00 255.0 /end CHARACTERISTIC
/begin CHARACTERISTIC DFES_Cls.DFC_I14229VINErr_C "fault class per DFC / Fault class for check DFC_I14229VINErr" VALUE 0x804D92AC Val_Wu8 30.00 DFES_OneToOne 0.00 30.00 FORMAT "%5.2" EXTENDED_LIMITS 0.00 255.0 /end CHARACTERISTIC
/begin CHARACTERISTIC DFES_Cls.DFC_LLRKHmax_C "fault class per DFC / Fault class for check DFC_LLRKHmax" VALUE 0x804D92AD Val_Wu8 30.00 DFES_OneToOne 0.00 30.00 FORMAT "%5.2" EXTENDED_LIMITS 0.00 255.0 /end CHARACTERISTIC
/begin CHARACTERISTIC DFES_Cls.DFC_LLRKHmin_C "fault class per DFC / Fault class for check DFC_LLRKHmin" VALUE 0x804D92AE Val_Wu8 30.00 DFES_OneToOne 0.00 30.00 FORMAT "%5.2" EXTENDED_LIMITS 0.00 255.0 /end CHARACTERISTIC
/begin CHARACTERISTIC DFES_Cls.DFC_LLRmax_C "fault class per DFC / Fault class for check DFC_LLRmax" VALUE 0x804D92AF Val_Wu8 30.00 DFES_OneToOne 0.00 30.00 FORMAT "%5.2" EXTENDED_LIMITS 0.00 255.0 /end CHARACTERISTIC
/begin CHARACTERISTIC DFES_Cls.DFC_LLRmin_C "fault class per DFC / Fault class for check DFC_LLRmin" VALUE 0x804D92B0 Val_Wu8 30.00 DFES_OneToOne 0.00 30.00 FORMAT "%5.2" EXTENDED_LIMITS 0.00 255.0 /end CHARACTERISTIC
/begin CHARACTERISTIC DFES_Cls.DFC_RoughRoad_C "fault class per DFC / Fault class for check DFC_RoughRoad" VALUE 0x804D92B1 Val_Wu8 30.00 DFES_OneToOne 0.00 30.00 FORMAT "%5.2" EXTENDED_LIMITS 0.00 255.0 /end CHARACTERISTIC
/begin CHARACTERISTIC DFES_Cls.DFC_SiaEEPRdErr_C "fault class per DFC / Fault class for check DFC_SiaEEPRdErr" VALUE 0x804D92B2 Val_Wu8 30.00 DFES_OneToOne 0.00 30.00 FORMAT "%5.2" EXTENDED_LIMITS 0.00 255.0 /end CHARACTERISTIC
/begin CHARACTERISTIC DFES_Cls.DFC_SiaEEPWrngCod_C "fault class per DFC / Fault class for check DFC_SiaEEPWrngCod" VALUE 0x804D92B3 Val_Wu8 30.00 DFES_OneToOne 0.00 30.00 FORMAT "%5.2" EXTENDED_LIMITS 0.00 255.0 /end CHARACTERISTIC
/begin CHARACTERISTIC DFES_Cls.DFC_UegoDummy_C "fault class per DFC / Fault class for check DFC_UegoDummy" VALUE 0x804D92B4 Val_Wu8 30.00 DFES_OneToOne 0.00 30.00 FORMAT "%5.2" EXTENDED_LIMITS 0.00 255.0 /end CHARACTERISTIC
/begin CHARACTERISTIC DFES_Cls.DFC_BusDiagCANAPPLBusOff_C "fault class per DFC / Fault class for check DFC_BusDiagCANAPPLBusOff" VALUE 0x804D92B5 Val_Wu8 30.00 DFES_OneToOne 0.00 30.00 FORMAT "%5.2" EXTENDED_LIMITS 0.00 255.0 /end CHARACTERISTIC
/begin CHARACTERISTIC DFES_Cls.DFC_BusDiagCANCANCBusOff_C "fault class per DFC / Fault class for check DFC_BusDiagCANCANCBusOff" VALUE 0x804D92B6 Val_Wu8 30.00 DFES_OneToOne 0.00 30.00 FORMAT "%5.2" EXTENDED_LIMITS 0.00 255.0 /end CHARACTERISTIC
/begin CHARACTERISTIC DFES_Cls.DFC_BusDiagCANVEHICLEBusOff_C "fault class per DFC / Fault class for check DFC_BusDiagCANVEHICLEBusOff" VALUE 0x804D92B7 Val_Wu8 30.00 DFES_OneToOne 0.00 30.00 FORMAT "%5.2" EXTENDED_LIMITS 0.00 255.0 /end CHARACTERISTIC
/begin CHARACTERISTIC DFES_Cls.DFC_RBA_IODIAGPWR_rba_IoExtCy329_SignalVltSply_0_C "fault class per DFC / Fault class for check DFC_RBA_IODIAGPWR_rba_IoExtCy329_SignalVltSply_0" VALUE 0x804D92B8 Val_Wu8 30.00 DFES_OneToOne 0.00 30.00 FORMAT "%5.2" EXTENDED_LIMITS 0.00 255.0 /end CHARACTERISTIC
/begin CHARACTERISTIC DFES_Cls.DFC_RBA_IODIAGPWR_rba_IoExtCy329_SignalVltSply_0OT_C "fault class per DFC / Fault class for check DFC_RBA_IODIAGPWR_rba_IoExtCy329_SignalVltSply_0OT" VALUE 0x804D92B9 Val_Wu8 30.00 DFES_OneToOne 0.00 30.00 FORMAT "%5.2" EXTENDED_LIMITS 0.00 255.0 /end CHARACTERISTIC
/begin CHARACTERISTIC DFES_Cls.DFC_RBA_IODIAGPWR_rba_IoExtCy329_SignalVltSply_0OV_C "fault class per DFC / Fault class for check DFC_RBA_IODIAGPWR_rba_IoExtCy329_SignalVltSply_0OV" VALUE 0x804D92BA Val_Wu8 30.00 DFES_OneToOne 0.00 30.00 FORMAT "%5.2" EXTENDED_LIMITS 0.00 255.0 /end CHARACTERISTIC
/begin CHARACTERISTIC DFES_Cls.DFC_RBA_IODIAGPWR_rba_IoExtCy329_SignalVltSply_0SCG_C "fault class per DFC / Fault class for check DFC_RBA_IODIAGPWR_rba_IoExtCy329_SignalVltSply_0SCG" VALUE 0x804D92BB Val_Wu8 30.00 DFES_OneToOne 0.00 30.00 FORMAT "%5.2" EXTENDED_LIMITS 0.00 255.0 /end CHARACTERISTIC
/begin CHARACTERISTIC DFES_Cls.DFC_RBA_IODIAGPWR_rba_IoExtCy329_SignalVltSply_0UV_C "fault class per DFC / Fault class for check DFC_RBA_IODIAGPWR_rba_IoExtCy329_SignalVltSply_0UV" VALUE 0x804D92BC Val_Wu8 30.00 DFES_OneToOne 0.00 30.00 FORMAT "%5.2" EXTENDED_LIMITS 0.00 255.0 /end CHARACTERISTIC
/begin CHARACTERISTIC DFES_Cls.DFC_RBA_IODIAGPWR_rba_IoExtCy329_SignalVltSply_1_C "fault class per DFC / Fault class for check DFC_RBA_IODIAGPWR_rba_IoExtCy329_SignalVltSply_1" VALUE 0x804D92BD Val_Wu8 30.00 DFES_OneToOne 0.00 30.00 FORMAT "%5.2" EXTENDED_LIMITS 0.00 255.0 /end CHARACTERISTIC
/begin CHARACTERISTIC DFES_Cls.DFC_RBA_IODIAGPWR_rba_IoExtCy329_SignalVltSply_1OT_C "fault class per DFC / Fault class for check DFC_RBA_IODIAGPWR_rba_IoExtCy329_SignalVltSply_1OT" VALUE 0x804D92BE Val_Wu8 30.00 DFES_OneToOne 0.00 30.00 FORMAT "%5.2" EXTENDED_LIMITS 0.00 255.0 /end CHARACTERISTIC
/begin CHARACTERISTIC DFES_Cls.DFC_RBA_IODIAGPWR_rba_IoExtCy329_SignalVltSply_1OV_C "fault class per DFC / Fault class for check DFC_RBA_IODIAGPWR_rba_IoExtCy329_SignalVltSply_1OV" VALUE 0x804D92BF Val_Wu8 30.00 DFES_OneToOne 0.00 30.00 FORMAT "%5.2" EXTENDED_LIMITS 0.00 255.0 /end CHARACTERISTIC
/begin CHARACTERISTIC DFES_Cls.DFC_RBA_IODIAGPWR_rba_IoExtCy329_SignalVltSply_1SCG_C "fault class per DFC / Fault class for check DFC_RBA_IODIAGPWR_rba_IoExtCy329_SignalVltSply_1SCG" VALUE 0x804D92C0 Val_Wu8 30.00 DFES_OneToOne 0.00 30.00 FORMAT "%5.2" EXTENDED_LIMITS 0.00 255.0 /end CHARACTERISTIC
/begin CHARACTERISTIC DFES_Cls.DFC_RBA_IODIAGPWR_rba_IoExtCy329_SignalVltSply_1UV_C "fault class per DFC / Fault class for check DFC_RBA_IODIAGPWR_rba_IoExtCy329_SignalVltSply_1UV" VALUE 0x804D92C1 Val_Wu8 30.00 DFES_OneToOne 0.00 30.00 FORMAT "%5.2" EXTENDED_LIMITS 0.00 255.0 /end CHARACTERISTIC
/begin CHARACTERISTIC DFES_Cls.DFC_RBA_IODIAGPWR_rba_IoExtCy329_SignalVltSply_2_C "fault class per DFC / Fault class for check DFC_RBA_IODIAGPWR_rba_IoExtCy329_SignalVltSply_2" VALUE 0x804D92C2 Val_Wu8 30.00 DFES_OneToOne 0.00 30.00 FORMAT "%5.2" EXTENDED_LIMITS 0.00 255.0 /end CHARACTERISTIC
/begin CHARACTERISTIC DFES_Cls.DFC_RBA_IODIAGPWR_rba_IoExtCy329_SignalVltSply_2OT_C "fault class per DFC / Fault class for check DFC_RBA_IODIAGPWR_rba_IoExtCy329_SignalVltSply_2OT" VALUE 0x804D92C3 Val_Wu8 30.00 DFES_OneToOne 0.00 30.00 FORMAT "%5.2" EXTENDED_LIMITS 0.00 255.0 /end CHARACTERISTIC
/begin CHARACTERISTIC DFES_Cls.DFC_RBA_IODIAGPWR_rba_IoExtCy329_SignalVltSply_2OV_C "fault class per DFC / Fault class for check DFC_RBA_IODIAGPWR_rba_IoExtCy329_SignalVltSply_2OV" VALUE 0x804D92C4 Val_Wu8 30.00 DFES_OneToOne 0.00 30.00 FORMAT "%5.2" EXTENDED_LIMITS 0.00 255.0 /end CHARACTERISTIC
/begin CHARACTERISTIC DFES_Cls.DFC_RBA_IODIAGPWR_rba_IoExtCy329_SignalVltSply_2SCG_C "fault class per DFC / Fault class for check DFC_RBA_IODIAGPWR_rba_IoExtCy329_SignalVltSply_2SCG" VALUE 0x804D92C5 Val_Wu8 30.00 DFES_OneToOne 0.00 30.00 FORMAT "%5.2" EXTENDED_LIMITS 0.00 255.0 /end CHARACTERISTIC
/begin CHARACTERISTIC DFES_Cls.DFC_RBA_IODIAGPWR_rba_IoExtCy329_SignalVltSply_2UV_C "fault class per DFC / Fault class for check DFC_RBA_IODIAGPWR_rba_IoExtCy329_SignalVltSply_2UV" VALUE 0x804D92C6 Val_Wu8 30.00 DFES_OneToOne 0.00 30.00 FORMAT "%5.2" EXTENDED_LIMITS 0.00 255.0 /end CHARACTERISTIC
/begin CHARACTERISTIC DFES_Cls.DFC_CAN_E_TIMEOUT_C "fault class per DFC / Fault class for check DFC_CAN_E_TIMEOUT" VALUE 0x804D92C7 Val_Wu8 30.00 DFES_OneToOne 0.00 30.00 FORMAT "%5.2" EXTENDED_LIMITS 0.00 255.0 /end CHARACTERISTIC
/begin CHARACTERISTIC DFES_Cls.DFC_LIN_E_TIMEOUT_C "fault class per DFC / Fault class for check DFC_LIN_E_TIMEOUT" VALUE 0x804D92C8 Val_Wu8 30.00 DFES_OneToOne 0.00 30.00 FORMAT "%5.2" EXTENDED_LIMITS 0.00 255.0 /end CHARACTERISTIC
/begin CHARACTERISTIC DFES_Cls.DFC_MRlyOL_C "fault class per DFC / Fault class for check DFC_MRlyOL" VALUE 0x804D92C9 Val_Wu8 30.00 DFES_OneToOne 0.00 30.00 FORMAT "%5.2" EXTENDED_LIMITS 0.00 255.0 /end CHARACTERISTIC
/begin CHARACTERISTIC DFES_Cls.DFC_MRlySCB_C "fault class per DFC / Fault class for check DFC_MRlySCB" VALUE 0x804D92CA Val_Wu8 30.00 DFES_OneToOne 0.00 30.00 FORMAT "%5.2" EXTENDED_LIMITS 0.00 255.0 /end CHARACTERISTIC
/begin CHARACTERISTIC DFES_Cls.DFC_MRlySCG_C "fault class per DFC / Fault class for check DFC_MRlySCG" VALUE 0x804D92CB Val_Wu8 30.00 DFES_OneToOne 0.00 30.00 FORMAT "%5.2" EXTENDED_LIMITS 0.00 255.0 /end CHARACTERISTIC
/begin CHARACTERISTIC DFES_Cls.DFC_rba_MultiStackTrace_Threshold_C "fault class per DFC / Fault class for check DFC_rba_MultiStackTrace_Threshold" VALUE 0x804D92CC Val_Wu8 30.00 DFES_OneToOne 0.00 30.00 FORMAT "%5.2" EXTENDED_LIMITS 0.00 255.0 /end CHARACTERISTIC
/begin CHARACTERISTIC DFES_Cls.DFC_BSWM_E_ACTION_FAILED_C "fault class per DFC / Fault class for check DFC_BSWM_E_ACTION_FAILED" VALUE 0x804D92CD Val_Wu8 30.00 DFES_OneToOne 0.00 30.00 FORMAT "%5.2" EXTENDED_LIMITS 0.00 255.0 /end CHARACTERISTIC
/begin CHARACTERISTIC DFES_Cls.DFC_BSWM_E_INTRPTQUEUE_FULL_C "fault class per DFC / Fault class for check DFC_BSWM_E_INTRPTQUEUE_FULL" VALUE 0x804D92CE Val_Wu8 30.00 DFES_OneToOne 0.00 30.00 FORMAT "%5.2" EXTENDED_LIMITS 0.00 255.0 /end CHARACTERISTIC
/begin CHARACTERISTIC DFES_Cls.DFC_RBA_IOEXTLIB_KEEPALIVE_DRV_C "fault class per DFC / Fault class for check DFC_RBA_IOEXTLIB_KEEPALIVE_DRV" VALUE 0x804D92CF Val_Wu8 30.00 DFES_OneToOne 0.00 30.00 FORMAT "%5.2" EXTENDED_LIMITS 0.00 255.0 /end CHARACTERISTIC
/begin CHARACTERISTIC DFES_Cls.DFC_RBA_IOEXTLIB_KEEPALIVE_INI_C "fault class per DFC / Fault class for check DFC_RBA_IOEXTLIB_KEEPALIVE_INI" VALUE 0x804D92D0 Val_Wu8 30.00 DFES_OneToOne 0.00 30.00 FORMAT "%5.2" EXTENDED_LIMITS 0.00 255.0 /end CHARACTERISTIC
/begin CHARACTERISTIC DFES_Cls.DFC_rba_IoSigRtc_StopCounter_C "fault class per DFC / Fault class for check DFC_rba_IoSigRtc_StopCounter" VALUE 0x804D92D1 Val_Wu8 30.00 DFES_OneToOne 0.00 30.00 FORMAT "%5.2" EXTENDED_LIMITS 0.00 255.0 /end CHARACTERISTIC
/begin CHARACTERISTIC DFES_Cls.DFC_rba_MRly_Diag_Stk_Event_C "fault class per DFC / Fault class for check DFC_rba_MRly_Diag_Stk_Event" VALUE 0x804D92D2 Val_Wu8 30.00 DFES_OneToOne 0.00 30.00 FORMAT "%5.2" EXTENDED_LIMITS 0.00 255.0 /end CHARACTERISTIC
/begin CHARACTERISTIC DFES_Cls.DFC_rba_MemDiag_MemReadErr_C "fault class per DFC / Fault class for check DFC_rba_MemDiag_MemReadErr" VALUE 0x804D92D3 Val_Wu8 30.00 DFES_OneToOne 0.00 30.00 FORMAT "%5.2" EXTENDED_LIMITS 0.00 255.0 /end CHARACTERISTIC
/begin CHARACTERISTIC DFES_Cls.DFC_rba_MemDiag_MemWrErr_C "fault class per DFC / Fault class for check DFC_rba_MemDiag_MemWrErr" VALUE 0x804D92D4 Val_Wu8 30.00 DFES_OneToOne 0.00 30.00 FORMAT "%5.2" EXTENDED_LIMITS 0.00 255.0 /end CHARACTERISTIC
/begin CHARACTERISTIC DFES_Cls.DFC_rba_SyC_IrrSwOffTrigEngRun_Event_C "fault class per DFC / Fault class for check DFC_rba_SyC_IrrSwOffTrigEngRun_Event" VALUE 0x804D92D5 Val_Wu8 30.00 DFES_OneToOne 0.00 30.00 FORMAT "%5.2" EXTENDED_LIMITS 0.00 255.0 /end CHARACTERISTIC
/begin CHARACTERISTIC DFES_Cls.DFC_rba_T15_Diag_ComInVld_Event_C "fault class per DFC / Fault class for check DFC_rba_T15_Diag_ComInVld_Event" VALUE 0x804D92D6 Val_Wu8 30.00 DFES_OneToOne 0.00 30.00 FORMAT "%5.2" EXTENDED_LIMITS 0.00 255.0 /end CHARACTERISTIC
/begin CHARACTERISTIC DFES_Cls.DFC_rba_T15_Diag_ComOff_HwOn_Event_C "fault class per DFC / Fault class for check DFC_rba_T15_Diag_ComOff_HwOn_Event" VALUE 0x804D92D7 Val_Wu8 30.00 DFES_OneToOne 0.00 30.00 FORMAT "%5.2" EXTENDED_LIMITS 0.00 255.0 /end CHARACTERISTIC
/begin CHARACTERISTIC DFES_Cls.DFC_rba_T15_Diag_ComOn_HwOff_Event_C "fault class per DFC / Fault class for check DFC_rba_T15_Diag_ComOn_HwOff_Event" VALUE 0x804D92D8 Val_Wu8 30.00 DFES_OneToOne 0.00 30.00 FORMAT "%5.2" EXTENDED_LIMITS 0.00 255.0 /end CHARACTERISTIC
/begin CHARACTERISTIC DFES_Cls.DFC_AppAllSnsrDfct_C "fault class per DFC / Fault class for check DFC_AppAllSnsrDfct" VALUE 0x804D92D9 Val_Wu8 30.00 DFES_OneToOne 0.00 30.00 FORMAT "%5.2" EXTENDED_LIMITS 0.00 255.0 /end CHARACTERISTIC
/begin CHARACTERISTIC DFES_Cls.DFC_BattUStdbyDiaOL_C "fault class per DFC / Fault class for check DFC_BattUStdbyDiaOL" VALUE 0x804D92DA Val_Wu8 30.00 DFES_OneToOne 0.00 30.00 FORMAT "%5.2" EXTENDED_LIMITS 0.00 255.0 /end CHARACTERISTIC
/begin CHARACTERISTIC DFES_Cls.DFC_BigLeakIntkMnfldEmiInfl_C "fault class per DFC / Fault class for check DFC_BigLeakIntkMnfldEmiInfl" VALUE 0x804D92DB Val_Wu8 30.00 DFES_OneToOne 0.00 30.00 FORMAT "%5.2" EXTENDED_LIMITS 0.00 255.0 /end CHARACTERISTIC
/begin CHARACTERISTIC DFES_Cls.DFC_BrkMnSwtContOnWarnLmp_C "fault class per DFC / Fault class for check DFC_BrkMnSwtContOnWarnLmp" VALUE 0x804D92DC Val_Wu8 30.00 DFES_OneToOne 0.00 30.00 FORMAT "%5.2" EXTENDED_LIMITS 0.00 255.0 /end CHARACTERISTIC
/begin CHARACTERISTIC DFES_Cls.DFC_BrkMnSwtNotStpWarnLmp_C "fault class per DFC / Fault class for check DFC_BrkMnSwtNotStpWarnLmp" VALUE 0x804D92DD Val_Wu8 30.00 DFES_OneToOne 0.00 30.00 FORMAT "%5.2" EXTENDED_LIMITS 0.00 255.0 /end CHARACTERISTIC
/begin CHARACTERISTIC DFES_Cls.DFC_BrkRdntSwtContOnWarnLmp_C "fault class per DFC / Fault class for check DFC_BrkRdntSwtContOnWarnLmp" VALUE 0x804D92DE Val_Wu8 30.00 DFES_OneToOne 0.00 30.00 FORMAT "%5.2" EXTENDED_LIMITS 0.00 255.0 /end CHARACTERISTIC
/begin CHARACTERISTIC DFES_Cls.DFC_BrkRdntSwtNotStpWarnLmp_C "fault class per DFC / Fault class for check DFC_BrkRdntSwtNotStpWarnLmp" VALUE 0x804D92DF Val_Wu8 30.00 DFES_OneToOne 0.00 30.00 FORMAT "%5.2" EXTENDED_LIMITS 0.00 255.0 /end CHARACTERISTIC
/begin CHARACTERISTIC DFES_Cls.DFC_CEngDsTColdStrtMax_C "fault class per DFC / Fault class for check DFC_CEngDsTColdStrtMax" VALUE 0x804D92E0 Val_Wu8 30.00 DFES_OneToOne 0.00 30.00 FORMAT "%5.2" EXTENDED_LIMITS 0.00 255.0 /end CHARACTERISTIC
/begin CHARACTERISTIC DFES_Cls.DFC_CEngDsTColdStrtMin_C "fault class per DFC / Fault class for check DFC_CEngDsTColdStrtMin" VALUE 0x804D92E1 Val_Wu8 30.00 DFES_OneToOne 0.00 30.00 FORMAT "%5.2" EXTENDED_LIMITS 0.00 255.0 /end CHARACTERISTIC
/begin CHARACTERISTIC DFES_Cls.DFC_CEngDsTImps_C "fault class per DFC / Fault class for check DFC_CEngDsTImps" VALUE 0x804D92E2 Val_Wu8 30.00 DFES_OneToOne 0.00 30.00 FORMAT "%5.2" EXTENDED_LIMITS 0.00 255.0 /end CHARACTERISTIC
/begin CHARACTERISTIC DFES_Cls.DFC_CEngDsTPlausLSC_C "fault class per DFC / Fault class for check DFC_CEngDsTPlausLSC" VALUE 0x804D92E3 Val_Wu8 30.00 DFES_OneToOne 0.00 30.00 FORMAT "%5.2" EXTENDED_LIMITS 0.00 255.0 /end CHARACTERISTIC
/begin CHARACTERISTIC DFES_Cls.DFC_CEngDsTPlausSTC_C "fault class per DFC / Fault class for check DFC_CEngDsTPlausSTC" VALUE 0x804D92E4 Val_Wu8 30.00 DFES_OneToOne 0.00 30.00 FORMAT "%5.2" EXTENDED_LIMITS 0.00 255.0 /end CHARACTERISTIC
/begin CHARACTERISTIC DFES_Cls.DFC_CEngDsTSRCMax_C "fault class per DFC / Fault class for check DFC_CEngDsTSRCMax" VALUE 0x804D92E5 Val_Wu8 30.00 DFES_OneToOne 0.00 30.00 FORMAT "%5.2" EXTENDED_LIMITS 0.00 255.0 /end CHARACTERISTIC
/begin CHARACTERISTIC DFES_Cls.DFC_CEngDsTSRCMin_C "fault class per DFC / Fault class for check DFC_CEngDsTSRCMin" VALUE 0x804D92E6 Val_Wu8 30.00 DFES_OneToOne 0.00 30.00 FORMAT "%5.2" EXTENDED_LIMITS 0.00 255.0 /end CHARACTERISTIC
/begin CHARACTERISTIC DFES_Cls.DFC_CEngDsTSig_C "fault class per DFC / Fault class for check DFC_CEngDsTSig" VALUE 0x804D92E7 Val_Wu8 30.00 DFES_OneToOne 0.00 30.00 FORMAT "%5.2" EXTENDED_LIMITS 0.00 255.0 /end CHARACTERISTIC
/begin CHARACTERISTIC DFES_Cls.DFC_CEngUsTSRCMax_C "fault class per DFC / Fault class for check DFC_CEngUsTSRCMax" VALUE 0x804D92E8 Val_Wu8 30.00 DFES_OneToOne 0.00 30.00 FORMAT "%5.2" EXTENDED_LIMITS 0.00 255.0 /end CHARACTERISTIC
/begin CHARACTERISTIC DFES_Cls.DFC_CEngUsTSRCMin_C "fault class per DFC / Fault class for check DFC_CEngUsTSRCMin" VALUE 0x804D92E9 Val_Wu8 30.00 DFES_OneToOne 0.00 30.00 FORMAT "%5.2" EXTENDED_LIMITS 0.00 255.0 /end CHARACTERISTIC
/begin CHARACTERISTIC DFES_Cls.DFC_DCDCFltDet_C "fault class per DFC / Fault class for check DFC_DCDCFltDet" VALUE 0x804D92EA Val_Wu8 30.00 DFES_OneToOne 0.00 30.00 FORMAT "%5.2" EXTENDED_LIMITS 0.00 255.0 /end CHARACTERISTIC
/begin CHARACTERISTIC DFES_Cls.DFC_DKRSA_C "fault class per DFC / Fault class for check DFC_DKRSA" VALUE 0x804D92EB Val_Wu8 30.00 DFES_OneToOne 0.00 30.00 FORMAT "%5.2" EXTENDED_LIMITS 0.00 255.0 /end CHARACTERISTIC
/begin CHARACTERISTIC DFES_Cls.DFC_DKVSmax_C "fault class per DFC / Fault class for check DFC_DKVSmax" VALUE 0x804D92EC Val_Wu8 30.00 DFES_OneToOne 0.00 30.00 FORMAT "%5.2" EXTENDED_LIMITS 0.00 255.0 /end CHARACTERISTIC
/begin CHARACTERISTIC DFES_Cls.DFC_DKnpl_C "fault class per DFC / Fault class for check DFC_DKnpl" VALUE 0x804D92ED Val_Wu8 30.00 DFES_OneToOne 0.00 30.00 FORMAT "%5.2" EXTENDED_LIMITS 0.00 255.0 /end CHARACTERISTIC
/begin CHARACTERISTIC DFES_Cls.DFC_DSSmax_C "fault class per DFC / Fault class for check DFC_DSSmax" VALUE 0x804D92EE Val_Wu8 30.00 DFES_OneToOne 0.00 30.00 FORMAT "%5.2" EXTENDED_LIMITS 0.00 255.0 /end CHARACTERISTIC
/begin CHARACTERISTIC DFES_Cls.DFC_DSTTI_C "fault class per DFC / Fault class for check DFC_DSTTI" VALUE 0x804D92EF Val_Wu8 30.00 DFES_OneToOne 0.00 30.00 FORMAT "%5.2" EXTENDED_LIMITS 0.00 255.0 /end CHARACTERISTIC
/begin CHARACTERISTIC DFES_Cls.DFC_DSUmax_C "fault class per DFC / Fault class for check DFC_DSUmax" VALUE 0x804D92F0 Val_Wu8 30.00 DFES_OneToOne 0.00 30.00 FORMAT "%5.2" EXTENDED_LIMITS 0.00 255.0 /end CHARACTERISTIC
/begin CHARACTERISTIC DFES_Cls.DFC_EGRVlvOL_C "fault class per DFC / Fault class for check DFC_EGRVlvOL" VALUE 0x804D92F1 Val_Wu8 30.00 DFES_OneToOne 0.00 30.00 FORMAT "%5.2" EXTENDED_LIMITS 0.00 255.0 /end CHARACTERISTIC
/begin CHARACTERISTIC DFES_Cls.DFC_EGRVlvSCB_C "fault class per DFC / Fault class for check DFC_EGRVlvSCB" VALUE 0x804D92F2 Val_Wu8 30.00 DFES_OneToOne 0.00 30.00 FORMAT "%5.2" EXTENDED_LIMITS 0.00 255.0 /end CHARACTERISTIC
/begin CHARACTERISTIC DFES_Cls.DFC_EGRVlvSCG_C "fault class per DFC / Fault class for check DFC_EGRVlvSCG" VALUE 0x804D92F3 Val_Wu8 30.00 DFES_OneToOne 0.00 30.00 FORMAT "%5.2" EXTENDED_LIMITS 0.00 255.0 /end CHARACTERISTIC
/begin CHARACTERISTIC DFES_Cls.DFC_EGSDUS2B1LtrDly_C "fault class per DFC / Fault class for check DFC_EGSDUS2B1LtrDly" VALUE 0x804D92F4 Val_Wu8 30.00 DFES_OneToOne 0.00 30.00 FORMAT "%5.2" EXTENDED_LIMITS 0.00 255.0 /end CHARACTERISTIC
/begin CHARACTERISTIC DFES_Cls.DFC_EGSDUS2B1LtrPT1_C "fault class per DFC / Fault class for check DFC_EGSDUS2B1LtrPT1" VALUE 0x804D92F5 Val_Wu8 30.00 DFES_OneToOne 0.00 30.00 FORMAT "%5.2" EXTENDED_LIMITS 0.00 255.0 /end CHARACTERISTIC
/begin CHARACTERISTIC DFES_Cls.DFC_EGSDUS2B1RtlDly_C "fault class per DFC / Fault class for check DFC_EGSDUS2B1RtlDly" VALUE 0x804D92F6 Val_Wu8 30.00 DFES_OneToOne 0.00 30.00 FORMAT "%5.2" EXTENDED_LIMITS 0.00 255.0 /end CHARACTERISTIC
/begin CHARACTERISTIC DFES_Cls.DFC_EGSDUS2B1RtlPT1_C "fault class per DFC / Fault class for check DFC_EGSDUS2B1RtlPT1" VALUE 0x804D92F7 Val_Wu8 30.00 DFES_OneToOne 0.00 30.00 FORMAT "%5.2" EXTENDED_LIMITS 0.00 255.0 /end CHARACTERISTIC
/begin CHARACTERISTIC DFES_Cls.DFC_EGSDUS2B1TarLean_C "fault class per DFC / Fault class for check DFC_EGSDUS2B1TarLean" VALUE 0x804D92F8 Val_Wu8 30.00 DFES_OneToOne 0.00 30.00 FORMAT "%5.2" EXTENDED_LIMITS 0.00 255.0 /end CHARACTERISTIC
/begin CHARACTERISTIC DFES_Cls.DFC_EGSDUS2B1TarRich_C "fault class per DFC / Fault class for check DFC_EGSDUS2B1TarRich" VALUE 0x804D92F9 Val_Wu8 30.00 DFES_OneToOne 0.00 30.00 FORMAT "%5.2" EXTENDED_LIMITS 0.00 255.0 /end CHARACTERISTIC
/begin CHARACTERISTIC DFES_Cls.DFC_ETAKHLmax_C "fault class per DFC / Fault class for check DFC_ETAKHLmax" VALUE 0x804D92FA Val_Wu8 30.00 DFES_OneToOne 0.00 30.00 FORMAT "%5.2" EXTENDED_LIMITS 0.00 255.0 /end CHARACTERISTIC
/begin CHARACTERISTIC DFES_Cls.DFC_ETAKHTmax_C "fault class per DFC / Fault class for check DFC_ETAKHTmax" VALUE 0x804D92FB Val_Wu8 30.00 DFES_OneToOne 0.00 30.00 FORMAT "%5.2" EXTENDED_LIMITS 0.00 255.0 /end CHARACTERISTIC
/begin CHARACTERISTIC DFES_Cls.DFC_EngICO_C "fault class per DFC / Fault class for check DFC_EngICO" VALUE 0x804D92FC Val_Wu8 30.00 DFES_OneToOne 0.00 30.00 FORMAT "%5.2" EXTENDED_LIMITS 0.00 255.0 /end CHARACTERISTIC
/begin CHARACTERISTIC DFES_Cls.DFC_EngPrtOvrSpdMon_C "fault class per DFC / Fault class for check DFC_EngPrtOvrSpdMon" VALUE 0x804D92FD Val_Wu8 30.00 DFES_OneToOne 0.00 30.00 FORMAT "%5.2" EXTENDED_LIMITS 0.00 255.0 /end CHARACTERISTIC
/begin CHARACTERISTIC DFES_Cls.DFC_EpmCaSI1ErrSig_C "fault class per DFC / Fault class for check DFC_EpmCaSI1ErrSig" VALUE 0x804D92FE Val_Wu8 30.00 DFES_OneToOne 0.00 30.00 FORMAT "%5.2" EXTENDED_LIMITS 0.00 255.0 /end CHARACTERISTIC
/begin CHARACTERISTIC DFES_Cls.DFC_EpmCaSI1NoSig_C "fault class per DFC / Fault class for check DFC_EpmCaSI1NoSig" VALUE 0x804D92FF Val_Wu8 30.00 DFES_OneToOne 0.00 30.00 FORMAT "%5.2" EXTENDED_LIMITS 0.00 255.0 /end CHARACTERISTIC
/begin CHARACTERISTIC DFES_Cls.DFC_EpmCaSI1OfsErr_C "fault class per DFC / Fault class for check DFC_EpmCaSI1OfsErr" VALUE 0x804D9300 Val_Wu8 30.00 DFES_OneToOne 0.00 30.00 FORMAT "%5.2" EXTENDED_LIMITS 0.00 255.0 /end CHARACTERISTIC
/begin CHARACTERISTIC DFES_Cls.DFC_EpmCrSErrSig_C "fault class per DFC / Fault class for check DFC_EpmCrSErrSig" VALUE 0x804D9301 Val_Wu8 30.00 DFES_OneToOne 0.00 30.00 FORMAT "%5.2" EXTENDED_LIMITS 0.00 255.0 /end CHARACTERISTIC
/begin CHARACTERISTIC DFES_Cls.DFC_EpmCrSNoSig_C "fault class per DFC / Fault class for check DFC_EpmCrSNoSig" VALUE 0x804D9302 Val_Wu8 30.00 DFES_OneToOne 0.00 30.00 FORMAT "%5.2" EXTENDED_LIMITS 0.00 255.0 /end CHARACTERISTIC
/begin CHARACTERISTIC DFES_Cls.DFC_EtaEngIdleNonCsers_C "fault class per DFC / Fault class for check DFC_EtaEngIdleNonCsers" VALUE 0x804D9303 Val_Wu8 30.00 DFES_OneToOne 0.00 30.00 FORMAT "%5.2" EXTENDED_LIMITS 0.00 255.0 /end CHARACTERISTIC
/begin CHARACTERISTIC DFES_Cls.DFC_EtaEngPtlNonCsers_C "fault class per DFC / Fault class for check DFC_EtaEngPtlNonCsers" VALUE 0x804D9304 Val_Wu8 30.00 DFES_OneToOne 0.00 30.00 FORMAT "%5.2" EXTENDED_LIMITS 0.00 255.0 /end CHARACTERISTIC
/begin CHARACTERISTIC DFES_Cls.DFC_FRAmax_C "fault class per DFC / Fault class for check DFC_FRAmax" VALUE 0x804D9305 Val_Wu8 30.00 DFES_OneToOne 0.00 30.00 FORMAT "%5.2" EXTENDED_LIMITS 0.00 255.0 /end CHARACTERISTIC
/begin CHARACTERISTIC DFES_Cls.DFC_FRAmin_C "fault class per DFC / Fault class for check DFC_FRAmin" VALUE 0x804D9306 Val_Wu8 30.00 DFES_OneToOne 0.00 30.00 FORMAT "%5.2" EXTENDED_LIMITS 0.00 255.0 /end CHARACTERISTIC
/begin CHARACTERISTIC DFES_Cls.DFC_GbxRvsSwtStk_C "fault class per DFC / Fault class for check DFC_GbxRvsSwtStk" VALUE 0x804D9307 Val_Wu8 30.00 DFES_OneToOne 0.00 30.00 FORMAT "%5.2" EXTENDED_LIMITS 0.00 255.0 /end CHARACTERISTIC
/begin CHARACTERISTIC DFES_Cls.DFC_HDRmax_C "fault class per DFC / Fault class for check DFC_HDRmax" VALUE 0x804D9308 Val_Wu8 30.00 DFES_OneToOne 0.00 30.00 FORMAT "%5.2" EXTENDED_LIMITS 0.00 255.0 /end CHARACTERISTIC
/begin CHARACTERISTIC DFES_Cls.DFC_HEGOS2B1ElecMax_C "fault class per DFC / Fault class for check DFC_HEGOS2B1ElecMax" VALUE 0x804D9309 Val_Wu8 30.00 DFES_OneToOne 0.00 30.00 FORMAT "%5.2" EXTENDED_LIMITS 0.00 255.0 /end CHARACTERISTIC
/begin CHARACTERISTIC DFES_Cls.DFC_HEGOS2B1ElecMin_C "fault class per DFC / Fault class for check DFC_HEGOS2B1ElecMin" VALUE 0x804D930A Val_Wu8 30.00 DFES_OneToOne 0.00 30.00 FORMAT "%5.2" EXTENDED_LIMITS 0.00 255.0 /end CHARACTERISTIC
/begin CHARACTERISTIC DFES_Cls.DFC_HEGOS2B1ElecSig_C "fault class per DFC / Fault class for check DFC_HEGOS2B1ElecSig" VALUE 0x804D930B Val_Wu8 30.00 DFES_OneToOne 0.00 30.00 FORMAT "%5.2" EXTENDED_LIMITS 0.00 255.0 /end CHARACTERISTIC
/begin CHARACTERISTIC DFES_Cls.DFC_HEGOS2B1HtgNpl_C "fault class per DFC / Fault class for check DFC_HEGOS2B1HtgNpl" VALUE 0x804D930C Val_Wu8 30.00 DFES_OneToOne 0.00 30.00 FORMAT "%5.2" EXTENDED_LIMITS 0.00 255.0 /end CHARACTERISTIC
/begin CHARACTERISTIC DFES_Cls.DFC_IntkAirTIntkMnfldCrssMax_C "fault class per DFC / Fault class for check DFC_IntkAirTIntkMnfldCrssMax" VALUE 0x804D930D Val_Wu8 30.00 DFES_OneToOne 0.00 30.00 FORMAT "%5.2" EXTENDED_LIMITS 0.00 255.0 /end CHARACTERISTIC
/begin CHARACTERISTIC DFES_Cls.DFC_IntkAirTIntkMnfldCrssMin_C "fault class per DFC / Fault class for check DFC_IntkAirTIntkMnfldCrssMin" VALUE 0x804D930E Val_Wu8 30.00 DFES_OneToOne 0.00 30.00 FORMAT "%5.2" EXTENDED_LIMITS 0.00 255.0 /end CHARACTERISTIC
/begin CHARACTERISTIC DFES_Cls.DFC_IntkAirTIntkMnfldHSCMax_C "fault class per DFC / Fault class for check DFC_IntkAirTIntkMnfldHSCMax" VALUE 0x804D930F Val_Wu8 30.00 DFES_OneToOne 0.00 30.00 FORMAT "%5.2" EXTENDED_LIMITS 0.00 255.0 /end CHARACTERISTIC
/begin CHARACTERISTIC DFES_Cls.DFC_IntkAirTIntkMnfldImps_C "fault class per DFC / Fault class for check DFC_IntkAirTIntkMnfldImps" VALUE 0x804D9310 Val_Wu8 30.00 DFES_OneToOne 0.00 30.00 FORMAT "%5.2" EXTENDED_LIMITS 0.00 255.0 /end CHARACTERISTIC
/begin CHARACTERISTIC DFES_Cls.DFC_IntkAirTIntkMnfldPRCMax_C "fault class per DFC / Fault class for check DFC_IntkAirTIntkMnfldPRCMax" VALUE 0x804D9311 Val_Wu8 30.00 DFES_OneToOne 0.00 30.00 FORMAT "%5.2" EXTENDED_LIMITS 0.00 255.0 /end CHARACTERISTIC
/begin CHARACTERISTIC DFES_Cls.DFC_IntkAirTIntkMnfldPRCMin_C "fault class per DFC / Fault class for check DFC_IntkAirTIntkMnfldPRCMin" VALUE 0x804D9312 Val_Wu8 30.00 DFES_OneToOne 0.00 30.00 FORMAT "%5.2" EXTENDED_LIMITS 0.00 255.0 /end CHARACTERISTIC
/begin CHARACTERISTIC DFES_Cls.DFC_IntkAirTIntkMnfldSRCMax_C "fault class per DFC / Fault class for check DFC_IntkAirTIntkMnfldSRCMax" VALUE 0x804D9313 Val_Wu8 30.00 DFES_OneToOne 0.00 30.00 FORMAT "%5.2" EXTENDED_LIMITS 0.00 255.0 /end CHARACTERISTIC
/begin CHARACTERISTIC DFES_Cls.DFC_IntkAirTIntkMnfldSRCMin_C "fault class per DFC / Fault class for check DFC_IntkAirTIntkMnfldSRCMin" VALUE 0x804D9314 Val_Wu8 30.00 DFES_OneToOne 0.00 30.00 FORMAT "%5.2" EXTENDED_LIMITS 0.00 255.0 /end CHARACTERISTIC
/begin CHARACTERISTIC DFES_Cls.DFC_IntkAirTIntkMnfldSTC_C "fault class per DFC / Fault class for check DFC_IntkAirTIntkMnfldSTC" VALUE 0x804D9315 Val_Wu8 30.00 DFES_OneToOne 0.00 30.00 FORMAT "%5.2" EXTENDED_LIMITS 0.00 255.0 /end CHARACTERISTIC
/begin CHARACTERISTIC DFES_Cls.DFC_KS1max_C "fault class per DFC / Fault class for check DFC_KS1max" VALUE 0x804D9316 Val_Wu8 30.00 DFES_OneToOne 0.00 30.00 FORMAT "%5.2" EXTENDED_LIMITS 0.00 255.0 /end CHARACTERISTIC
/begin CHARACTERISTIC DFES_Cls.DFC_KS1min_C "fault class per DFC / Fault class for check DFC_KS1min" VALUE 0x804D9317 Val_Wu8 30.00 DFES_OneToOne 0.00 30.00 FORMAT "%5.2" EXTENDED_LIMITS 0.00 255.0 /end CHARACTERISTIC
/begin CHARACTERISTIC DFES_Cls.DFC_LMmax_C "fault class per DFC / Fault class for check DFC_LMmax" VALUE 0x804D9318 Val_Wu8 30.00 DFES_OneToOne 0.00 30.00 FORMAT "%5.2" EXTENDED_LIMITS 0.00 255.0 /end CHARACTERISTIC
/begin CHARACTERISTIC DFES_Cls.DFC_LZSRnpl_C "fault class per DFC / Fault class for check DFC_LZSRnpl" VALUE 0x804D9319 Val_Wu8 30.00 DFES_OneToOne 0.00 30.00 FORMAT "%5.2" EXTENDED_LIMITS 0.00 255.0 /end CHARACTERISTIC
/begin CHARACTERISTIC DFES_Cls.DFC_LamDynDiagS1B1_C "fault class per DFC / Fault class for check DFC_LamDynDiagS1B1" VALUE 0x804D931A Val_Wu8 30.00 DFES_OneToOne 0.00 30.00 FORMAT "%5.2" EXTENDED_LIMITS 0.00 255.0 /end CHARACTERISTIC
/begin CHARACTERISTIC DFES_Cls.DFC_LeakIntkMnfldEmiInfl_C "fault class per DFC / Fault class for check DFC_LeakIntkMnfldEmiInfl" VALUE 0x804D931B Val_Wu8 30.00 DFES_OneToOne 0.00 30.00 FORMAT "%5.2" EXTENDED_LIMITS 0.00 255.0 /end CHARACTERISTIC
/begin CHARACTERISTIC DFES_Cls.DFC_MD00max_C "fault class per DFC / Fault class for check DFC_MD00max" VALUE 0x804D931C Val_Wu8 30.00 DFES_OneToOne 0.00 30.00 FORMAT "%5.2" EXTENDED_LIMITS 0.00 255.0 /end CHARACTERISTIC
/begin CHARACTERISTIC DFES_Cls.DFC_MDBmax_C "fault class per DFC / Fault class for check DFC_MDBmax" VALUE 0x804D931D Val_Wu8 30.00 DFES_OneToOne 0.00 30.00 FORMAT "%5.2" EXTENDED_LIMITS 0.00 255.0 /end CHARACTERISTIC
/begin CHARACTERISTIC DFES_Cls.DFC_MDCat_C "fault class per DFC / Fault class for check DFC_MDCat" VALUE 0x804D931E Val_Wu8 30.00 DFES_OneToOne 0.00 30.00 FORMAT "%5.2" EXTENDED_LIMITS 0.00 255.0 /end CHARACTERISTIC
/begin CHARACTERISTIC DFES_Cls.DFC_MDCatCrit_C "fault class per DFC / Fault class for check DFC_MDCatCrit" VALUE 0x804D931F Val_Wu8 30.00 DFES_OneToOne 0.00 30.00 FORMAT "%5.2" EXTENDED_LIMITS 0.00 255.0 /end CHARACTERISTIC
/begin CHARACTERISTIC DFES_Cls.DFC_MDCatCurr_C "fault class per DFC / Fault class for check DFC_MDCatCurr" VALUE 0x804D9320 Val_Wu8 30.00 DFES_OneToOne 0.00 30.00 FORMAT "%5.2" EXTENDED_LIMITS 0.00 255.0 /end CHARACTERISTIC
/begin CHARACTERISTIC DFES_Cls.DFC_MDCyl_0_C "fault class per DFC / Fault class for check DFC_MDCyl_0" VALUE 0x804D9321 Val_Wu8 30.00 DFES_OneToOne 0.00 30.00 FORMAT "%5.2" EXTENDED_LIMITS 0.00 255.0 /end CHARACTERISTIC
/begin CHARACTERISTIC DFES_Cls.DFC_MDCyl_1_C "fault class per DFC / Fault class for check DFC_MDCyl_1" VALUE 0x804D9322 Val_Wu8 30.00 DFES_OneToOne 0.00 30.00 FORMAT "%5.2" EXTENDED_LIMITS 0.00 255.0 /end CHARACTERISTIC
/begin CHARACTERISTIC DFES_Cls.DFC_MDCyl_2_C "fault class per DFC / Fault class for check DFC_MDCyl_2" VALUE 0x804D9323 Val_Wu8 30.00 DFES_OneToOne 0.00 30.00 FORMAT "%5.2" EXTENDED_LIMITS 0.00 255.0 /end CHARACTERISTIC
/begin CHARACTERISTIC DFES_Cls.DFC_MDCyl_3_C "fault class per DFC / Fault class for check DFC_MDCyl_3" VALUE 0x804D9324 Val_Wu8 30.00 DFES_OneToOne 0.00 30.00 FORMAT "%5.2" EXTENDED_LIMITS 0.00 255.0 /end CHARACTERISTIC
/begin CHARACTERISTIC DFES_Cls.DFC_MDEmi_C "fault class per DFC / Fault class for check DFC_MDEmi" VALUE 0x804D9325 Val_Wu8 30.00 DFES_OneToOne 0.00 30.00 FORMAT "%5.2" EXTENDED_LIMITS 0.00 255.0 /end CHARACTERISTIC
/begin CHARACTERISTIC DFES_Cls.DFC_MDEmiStrt_C "fault class per DFC / Fault class for check DFC_MDEmiStrt" VALUE 0x804D9326 Val_Wu8 30.00 DFES_OneToOne 0.00 30.00 FORMAT "%5.2" EXTENDED_LIMITS 0.00 255.0 /end CHARACTERISTIC
/begin CHARACTERISTIC DFES_Cls.DFC_MDFco_C "fault class per DFC / Fault class for check DFC_MDFco" VALUE 0x804D9327 Val_Wu8 30.00 DFES_OneToOne 0.00 30.00 FORMAT "%5.2" EXTENDED_LIMITS 0.00 255.0 /end CHARACTERISTIC
/begin CHARACTERISTIC DFES_Cls.DFC_MDMpl_C "fault class per DFC / Fault class for check DFC_MDMpl" VALUE 0x804D9328 Val_Wu8 30.00 DFES_OneToOne 0.00 30.00 FORMAT "%5.2" EXTENDED_LIMITS 0.00 255.0 /end CHARACTERISTIC
/begin CHARACTERISTIC DFES_Cls.DFC_MDSegTiAdpn_C "fault class per DFC / Fault class for check DFC_MDSegTiAdpn" VALUE 0x804D9329 Val_Wu8 30.00 DFES_OneToOne 0.00 30.00 FORMAT "%5.2" EXTENDED_LIMITS 0.00 255.0 /end CHARACTERISTIC
/begin CHARACTERISTIC DFES_Cls.DFC_MDmax_C "fault class per DFC / Fault class for check DFC_MDmax" VALUE 0x804D932A Val_Wu8 30.00 DFES_OneToOne 0.00 30.00 FORMAT "%5.2" EXTENDED_LIMITS 0.00 255.0 /end CHARACTERISTIC
/begin CHARACTERISTIC DFES_Cls.DFC_MOXEMM_SMU_ALM0_0_C "fault class per DFC / Fault class for check DFC_MOXEMM_SMU_ALM0_0" VALUE 0x804D932B Val_Wu8 30.00 DFES_OneToOne 0.00 30.00 FORMAT "%5.2" EXTENDED_LIMITS 0.00 255.0 /end CHARACTERISTIC
/begin CHARACTERISTIC DFES_Cls.DFC_MOXEMM_SMU_ALM0_1_C "fault class per DFC / Fault class for check DFC_MOXEMM_SMU_ALM0_1" VALUE 0x804D932C Val_Wu8 30.00 DFES_OneToOne 0.00 30.00 FORMAT "%5.2" EXTENDED_LIMITS 0.00 255.0 /end CHARACTERISTIC
/begin CHARACTERISTIC DFES_Cls.DFC_MOXEMM_SMU_ALM0_10_C "fault class per DFC / Fault class for check DFC_MOXEMM_SMU_ALM0_10" VALUE 0x804D932D Val_Wu8 30.00 DFES_OneToOne 0.00 30.00 FORMAT "%5.2" EXTENDED_LIMITS 0.00 255.0 /end CHARACTERISTIC
/begin CHARACTERISTIC DFES_Cls.DFC_MOXEMM_SMU_ALM0_11_C "fault class per DFC / Fault class for check DFC_MOXEMM_SMU_ALM0_11" VALUE 0x804D932E Val_Wu8 30.00 DFES_OneToOne 0.00 30.00 FORMAT "%5.2" EXTENDED_LIMITS 0.00 255.0 /end CHARACTERISTIC
/begin CHARACTERISTIC DFES_Cls.DFC_MOXEMM_SMU_ALM0_13_C "fault class per DFC / Fault class for check DFC_MOXEMM_SMU_ALM0_13" VALUE 0x804D932F Val_Wu8 30.00 DFES_OneToOne 0.00 30.00 FORMAT "%5.2" EXTENDED_LIMITS 0.00 255.0 /end CHARACTERISTIC
/begin CHARACTERISTIC DFES_Cls.DFC_MOXEMM_SMU_ALM0_14_C "fault class per DFC / Fault class for check DFC_MOXEMM_SMU_ALM0_14" VALUE 0x804D9330 Val_Wu8 30.00 DFES_OneToOne 0.00 30.00 FORMAT "%5.2" EXTENDED_LIMITS 0.00 255.0 /end CHARACTERISTIC
/begin CHARACTERISTIC DFES_Cls.DFC_MOXEMM_SMU_ALM0_2_C "fault class per DFC / Fault class for check DFC_MOXEMM_SMU_ALM0_2" VALUE 0x804D9331 Val_Wu8 30.00 DFES_OneToOne 0.00 30.00 FORMAT "%5.2" EXTENDED_LIMITS 0.00 255.0 /end CHARACTERISTIC
/begin CHARACTERISTIC DFES_Cls.DFC_MOXEMM_SMU_ALM0_22_C "fault class per DFC / Fault class for check DFC_MOXEMM_SMU_ALM0_22" VALUE 0x804D9332 Val_Wu8 30.00 DFES_OneToOne 0.00 30.00 FORMAT "%5.2" EXTENDED_LIMITS 0.00 255.0 /end CHARACTERISTIC
/begin CHARACTERISTIC DFES_Cls.DFC_MOXEMM_SMU_ALM0_23_C "fault class per DFC / Fault class for check DFC_MOXEMM_SMU_ALM0_23" VALUE 0x804D9333 Val_Wu8 30.00 DFES_OneToOne 0.00 30.00 FORMAT "%5.2" EXTENDED_LIMITS 0.00 255.0 /end CHARACTERISTIC
/begin CHARACTERISTIC DFES_Cls.DFC_MOXEMM_SMU_ALM0_4_C "fault class per DFC / Fault class for check DFC_MOXEMM_SMU_ALM0_4" VALUE 0x804D9334 Val_Wu8 30.00 DFES_OneToOne 0.00 30.00 FORMAT "%5.2" EXTENDED_LIMITS 0.00 255.0 /end CHARACTERISTIC
/begin CHARACTERISTIC DFES_Cls.DFC_MOXEMM_SMU_ALM0_5_C "fault class per DFC / Fault class for check DFC_MOXEMM_SMU_ALM0_5" VALUE 0x804D9335 Val_Wu8 30.00 DFES_OneToOne 0.00 30.00 FORMAT "%5.2" EXTENDED_LIMITS 0.00 255.0 /end CHARACTERISTIC
/begin CHARACTERISTIC DFES_Cls.DFC_MOXEMM_SMU_ALM0_7_C "fault class per DFC / Fault class for check DFC_MOXEMM_SMU_ALM0_7" VALUE 0x804D9336 Val_Wu8 30.00 DFES_OneToOne 0.00 30.00 FORMAT "%5.2" EXTENDED_LIMITS 0.00 255.0 /end CHARACTERISTIC
/begin CHARACTERISTIC DFES_Cls.DFC_MOXEMM_SMU_ALM0_8_C "fault class per DFC / Fault class for check DFC_MOXEMM_SMU_ALM0_8" VALUE 0x804D9337 Val_Wu8 30.00 DFES_OneToOne 0.00 30.00 FORMAT "%5.2" EXTENDED_LIMITS 0.00 255.0 /end CHARACTERISTIC
/begin CHARACTERISTIC DFES_Cls.DFC_MOXEMM_SMU_ALM10_16_C "fault class per DFC / Fault class for check DFC_MOXEMM_SMU_ALM10_16" VALUE 0x804D9338 Val_Wu8 30.00 DFES_OneToOne 0.00 30.00 FORMAT "%5.2" EXTENDED_LIMITS 0.00 255.0 /end CHARACTERISTIC
/begin CHARACTERISTIC DFES_Cls.DFC_MOXEMM_SMU_ALM10_17_C "fault class per DFC / Fault class for check DFC_MOXEMM_SMU_ALM10_17" VALUE 0x804D9339 Val_Wu8 30.00 DFES_OneToOne 0.00 30.00 FORMAT "%5.2" EXTENDED_LIMITS 0.00 255.0 /end CHARACTERISTIC
/begin CHARACTERISTIC DFES_Cls.DFC_MOXEMM_SMU_ALM10_21_C "fault class per DFC / Fault class for check DFC_MOXEMM_SMU_ALM10_21" VALUE 0x804D933A Val_Wu8 30.00 DFES_OneToOne 0.00 30.00 FORMAT "%5.2" EXTENDED_LIMITS 0.00 255.0 /end CHARACTERISTIC
/begin CHARACTERISTIC DFES_Cls.DFC_MOXEMM_SMU_ALM11_0_C "fault class per DFC / Fault class for check DFC_MOXEMM_SMU_ALM11_0" VALUE 0x804D933B Val_Wu8 30.00 DFES_OneToOne 0.00 30.00 FORMAT "%5.2" EXTENDED_LIMITS 0.00 255.0 /end CHARACTERISTIC
/begin CHARACTERISTIC DFES_Cls.DFC_MOXEMM_SMU_ALM11_1_C "fault class per DFC / Fault class for check DFC_MOXEMM_SMU_ALM11_1" VALUE 0x804D933C Val_Wu8 30.00 DFES_OneToOne 0.00 30.00 FORMAT "%5.2" EXTENDED_LIMITS 0.00 255.0 /end CHARACTERISTIC
/begin CHARACTERISTIC DFES_Cls.DFC_MOXEMM_SMU_ALM11_2_C "fault class per DFC / Fault class for check DFC_MOXEMM_SMU_ALM11_2" VALUE 0x804D933D Val_Wu8 30.00 DFES_OneToOne 0.00 30.00 FORMAT "%5.2" EXTENDED_LIMITS 0.00 255.0 /end CHARACTERISTIC
/begin CHARACTERISTIC DFES_Cls.DFC_MOXEMM_SMU_ALM11_3_C "fault class per DFC / Fault class for check DFC_MOXEMM_SMU_ALM11_3" VALUE 0x804D933E Val_Wu8 30.00 DFES_OneToOne 0.00 30.00 FORMAT "%5.2" EXTENDED_LIMITS 0.00 255.0 /end CHARACTERISTIC
/begin CHARACTERISTIC DFES_Cls.DFC_MOXEMM_SMU_ALM11_4_C "fault class per DFC / Fault class for check DFC_MOXEMM_SMU_ALM11_4" VALUE 0x804D933F Val_Wu8 30.00 DFES_OneToOne 0.00 30.00 FORMAT "%5.2" EXTENDED_LIMITS 0.00 255.0 /end CHARACTERISTIC
/begin CHARACTERISTIC DFES_Cls.DFC_MOXEMM_SMU_ALM11_5_C "fault class per DFC / Fault class for check DFC_MOXEMM_SMU_ALM11_5" VALUE 0x804D9340 Val_Wu8 30.00 DFES_OneToOne 0.00 30.00 FORMAT "%5.2" EXTENDED_LIMITS 0.00 255.0 /end CHARACTERISTIC
/begin CHARACTERISTIC DFES_Cls.DFC_MOXEMM_SMU_ALM11_8_C "fault class per DFC / Fault class for check DFC_MOXEMM_SMU_ALM11_8" VALUE 0x804D9341 Val_Wu8 30.00 DFES_OneToOne 0.00 30.00 FORMAT "%5.2" EXTENDED_LIMITS 0.00 255.0 /end CHARACTERISTIC
/begin CHARACTERISTIC DFES_Cls.DFC_MOXEMM_SMU_ALM11_9_C "fault class per DFC / Fault class for check DFC_MOXEMM_SMU_ALM11_9" VALUE 0x804D9342 Val_Wu8 30.00 DFES_OneToOne 0.00 30.00 FORMAT "%5.2" EXTENDED_LIMITS 0.00 255.0 /end CHARACTERISTIC
/begin CHARACTERISTIC DFES_Cls.DFC_MOXEMM_SMU_ALM1_0_C "fault class per DFC / Fault class for check DFC_MOXEMM_SMU_ALM1_0" VALUE 0x804D9343 Val_Wu8 30.00 DFES_OneToOne 0.00 30.00 FORMAT "%5.2" EXTENDED_LIMITS 0.00 255.0 /end CHARACTERISTIC
/begin CHARACTERISTIC DFES_Cls.DFC_MOXEMM_SMU_ALM1_1_C "fault class per DFC / Fault class for check DFC_MOXEMM_SMU_ALM1_1" VALUE 0x804D9344 Val_Wu8 30.00 DFES_OneToOne 0.00 30.00 FORMAT "%5.2" EXTENDED_LIMITS 0.00 255.0 /end CHARACTERISTIC
/begin CHARACTERISTIC DFES_Cls.DFC_MOXEMM_SMU_ALM1_10_C "fault class per DFC / Fault class for check DFC_MOXEMM_SMU_ALM1_10" VALUE 0x804D9345 Val_Wu8 30.00 DFES_OneToOne 0.00 30.00 FORMAT "%5.2" EXTENDED_LIMITS 0.00 255.0 /end CHARACTERISTIC
/begin CHARACTERISTIC DFES_Cls.DFC_MOXEMM_SMU_ALM1_11_C "fault class per DFC / Fault class for check DFC_MOXEMM_SMU_ALM1_11" VALUE 0x804D9346 Val_Wu8 30.00 DFES_OneToOne 0.00 30.00 FORMAT "%5.2" EXTENDED_LIMITS 0.00 255.0 /end CHARACTERISTIC
/begin CHARACTERISTIC DFES_Cls.DFC_MOXEMM_SMU_ALM1_13_C "fault class per DFC / Fault class for check DFC_MOXEMM_SMU_ALM1_13" VALUE 0x804D9347 Val_Wu8 30.00 DFES_OneToOne 0.00 30.00 FORMAT "%5.2" EXTENDED_LIMITS 0.00 255.0 /end CHARACTERISTIC
/begin CHARACTERISTIC DFES_Cls.DFC_MOXEMM_SMU_ALM1_14_C "fault class per DFC / Fault class for check DFC_MOXEMM_SMU_ALM1_14" VALUE 0x804D9348 Val_Wu8 30.00 DFES_OneToOne 0.00 30.00 FORMAT "%5.2" EXTENDED_LIMITS 0.00 255.0 /end CHARACTERISTIC
/begin CHARACTERISTIC DFES_Cls.DFC_MOXEMM_SMU_ALM1_2_C "fault class per DFC / Fault class for check DFC_MOXEMM_SMU_ALM1_2" VALUE 0x804D9349 Val_Wu8 30.00 DFES_OneToOne 0.00 30.00 FORMAT "%5.2" EXTENDED_LIMITS 0.00 255.0 /end CHARACTERISTIC
/begin CHARACTERISTIC DFES_Cls.DFC_MOXEMM_SMU_ALM1_22_C "fault class per DFC / Fault class for check DFC_MOXEMM_SMU_ALM1_22" VALUE 0x804D934A Val_Wu8 30.00 DFES_OneToOne 0.00 30.00 FORMAT "%5.2" EXTENDED_LIMITS 0.00 255.0 /end CHARACTERISTIC
/begin CHARACTERISTIC DFES_Cls.DFC_MOXEMM_SMU_ALM1_23_C "fault class per DFC / Fault class for check DFC_MOXEMM_SMU_ALM1_23" VALUE 0x804D934B Val_Wu8 30.00 DFES_OneToOne 0.00 30.00 FORMAT "%5.2" EXTENDED_LIMITS 0.00 255.0 /end CHARACTERISTIC
/begin CHARACTERISTIC DFES_Cls.DFC_MOXEMM_SMU_ALM1_4_C "fault class per DFC / Fault class for check DFC_MOXEMM_SMU_ALM1_4" VALUE 0x804D934C Val_Wu8 30.00 DFES_OneToOne 0.00 30.00 FORMAT "%5.2" EXTENDED_LIMITS 0.00 255.0 /end CHARACTERISTIC
/begin CHARACTERISTIC DFES_Cls.DFC_MOXEMM_SMU_ALM1_5_C "fault class per DFC / Fault class for check DFC_MOXEMM_SMU_ALM1_5" VALUE 0x804D934D Val_Wu8 30.00 DFES_OneToOne 0.00 30.00 FORMAT "%5.2" EXTENDED_LIMITS 0.00 255.0 /end CHARACTERISTIC
/begin CHARACTERISTIC DFES_Cls.DFC_MOXEMM_SMU_ALM1_7_C "fault class per DFC / Fault class for check DFC_MOXEMM_SMU_ALM1_7" VALUE 0x804D934E Val_Wu8 30.00 DFES_OneToOne 0.00 30.00 FORMAT "%5.2" EXTENDED_LIMITS 0.00 255.0 /end CHARACTERISTIC
/begin CHARACTERISTIC DFES_Cls.DFC_MOXEMM_SMU_ALM1_8_C "fault class per DFC / Fault class for check DFC_MOXEMM_SMU_ALM1_8" VALUE 0x804D934F Val_Wu8 30.00 DFES_OneToOne 0.00 30.00 FORMAT "%5.2" EXTENDED_LIMITS 0.00 255.0 /end CHARACTERISTIC
/begin CHARACTERISTIC DFES_Cls.DFC_MOXEMM_SMU_ALM21_0_C "fault class per DFC / Fault class for check DFC_MOXEMM_SMU_ALM21_0" VALUE 0x804D9350 Val_Wu8 30.00 DFES_OneToOne 0.00 30.00 FORMAT "%5.2" EXTENDED_LIMITS 0.00 255.0 /end CHARACTERISTIC
/begin CHARACTERISTIC DFES_Cls.DFC_MOXEMM_SMU_ALM21_16_C "fault class per DFC / Fault class for check DFC_MOXEMM_SMU_ALM21_16" VALUE 0x804D9351 Val_Wu8 30.00 DFES_OneToOne 0.00 30.00 FORMAT "%5.2" EXTENDED_LIMITS 0.00 255.0 /end CHARACTERISTIC
/begin CHARACTERISTIC DFES_Cls.DFC_MOXEMM_SMU_ALM21_3_C "fault class per DFC / Fault class for check DFC_MOXEMM_SMU_ALM21_3" VALUE 0x804D9352 Val_Wu8 30.00 DFES_OneToOne 0.00 30.00 FORMAT "%5.2" EXTENDED_LIMITS 0.00 255.0 /end CHARACTERISTIC
/begin CHARACTERISTIC DFES_Cls.DFC_MOXEMM_SMU_ALM2_1_C "fault class per DFC / Fault class for check DFC_MOXEMM_SMU_ALM2_1" VALUE 0x804D9353 Val_Wu8 30.00 DFES_OneToOne 0.00 30.00 FORMAT "%5.2" EXTENDED_LIMITS 0.00 255.0 /end CHARACTERISTIC
/begin CHARACTERISTIC DFES_Cls.DFC_MOXEMM_SMU_ALM2_10_C "fault class per DFC / Fault class for check DFC_MOXEMM_SMU_ALM2_10" VALUE 0x804D9354 Val_Wu8 30.00 DFES_OneToOne 0.00 30.00 FORMAT "%5.2" EXTENDED_LIMITS 0.00 255.0 /end CHARACTERISTIC
/begin CHARACTERISTIC DFES_Cls.DFC_MOXEMM_SMU_ALM2_11_C "fault class per DFC / Fault class for check DFC_MOXEMM_SMU_ALM2_11" VALUE 0x804D9355 Val_Wu8 30.00 DFES_OneToOne 0.00 30.00 FORMAT "%5.2" EXTENDED_LIMITS 0.00 255.0 /end CHARACTERISTIC
/begin CHARACTERISTIC DFES_Cls.DFC_MOXEMM_SMU_ALM2_13_C "fault class per DFC / Fault class for check DFC_MOXEMM_SMU_ALM2_13" VALUE 0x804D9356 Val_Wu8 30.00 DFES_OneToOne 0.00 30.00 FORMAT "%5.2" EXTENDED_LIMITS 0.00 255.0 /end CHARACTERISTIC
/begin CHARACTERISTIC DFES_Cls.DFC_MOXEMM_SMU_ALM2_14_C "fault class per DFC / Fault class for check DFC_MOXEMM_SMU_ALM2_14" VALUE 0x804D9357 Val_Wu8 30.00 DFES_OneToOne 0.00 30.00 FORMAT "%5.2" EXTENDED_LIMITS 0.00 255.0 /end CHARACTERISTIC
/begin CHARACTERISTIC DFES_Cls.DFC_MOXEMM_SMU_ALM2_22_C "fault class per DFC / Fault class for check DFC_MOXEMM_SMU_ALM2_22" VALUE 0x804D9358 Val_Wu8 30.00 DFES_OneToOne 0.00 30.00 FORMAT "%5.2" EXTENDED_LIMITS 0.00 255.0 /end CHARACTERISTIC
/begin CHARACTERISTIC DFES_Cls.DFC_MOXEMM_SMU_ALM2_23_C "fault class per DFC / Fault class for check DFC_MOXEMM_SMU_ALM2_23" VALUE 0x804D9359 Val_Wu8 30.00 DFES_OneToOne 0.00 30.00 FORMAT "%5.2" EXTENDED_LIMITS 0.00 255.0 /end CHARACTERISTIC
/begin CHARACTERISTIC DFES_Cls.DFC_MOXEMM_SMU_ALM2_4_C "fault class per DFC / Fault class for check DFC_MOXEMM_SMU_ALM2_4" VALUE 0x804D935A Val_Wu8 30.00 DFES_OneToOne 0.00 30.00 FORMAT "%5.2" EXTENDED_LIMITS 0.00 255.0 /end CHARACTERISTIC
/begin CHARACTERISTIC DFES_Cls.DFC_MOXEMM_SMU_ALM2_5_C "fault class per DFC / Fault class for check DFC_MOXEMM_SMU_ALM2_5" VALUE 0x804D935B Val_Wu8 30.00 DFES_OneToOne 0.00 30.00 FORMAT "%5.2" EXTENDED_LIMITS 0.00 255.0 /end CHARACTERISTIC
/begin CHARACTERISTIC DFES_Cls.DFC_MOXEMM_SMU_ALM2_7_C "fault class per DFC / Fault class for check DFC_MOXEMM_SMU_ALM2_7" VALUE 0x804D935C Val_Wu8 30.00 DFES_OneToOne 0.00 30.00 FORMAT "%5.2" EXTENDED_LIMITS 0.00 255.0 /end CHARACTERISTIC
/begin CHARACTERISTIC DFES_Cls.DFC_MOXEMM_SMU_ALM2_8_C "fault class per DFC / Fault class for check DFC_MOXEMM_SMU_ALM2_8" VALUE 0x804D935D Val_Wu8 30.00 DFES_OneToOne 0.00 30.00 FORMAT "%5.2" EXTENDED_LIMITS 0.00 255.0 /end CHARACTERISTIC
/begin CHARACTERISTIC DFES_Cls.DFC_MOXEMM_SMU_ALM6_0_C "fault class per DFC / Fault class for check DFC_MOXEMM_SMU_ALM6_0" VALUE 0x804D935E Val_Wu8 30.00 DFES_OneToOne 0.00 30.00 FORMAT "%5.2" EXTENDED_LIMITS 0.00 255.0 /end CHARACTERISTIC
/begin CHARACTERISTIC DFES_Cls.DFC_MOXEMM_SMU_ALM6_11_C "fault class per DFC / Fault class for check DFC_MOXEMM_SMU_ALM6_11" VALUE 0x804D935F Val_Wu8 30.00 DFES_OneToOne 0.00 30.00 FORMAT "%5.2" EXTENDED_LIMITS 0.00 255.0 /end CHARACTERISTIC
/begin CHARACTERISTIC DFES_Cls.DFC_MOXEMM_SMU_ALM6_12_C "fault class per DFC / Fault class for check DFC_MOXEMM_SMU_ALM6_12" VALUE 0x804D9360 Val_Wu8 30.00 DFES_OneToOne 0.00 30.00 FORMAT "%5.2" EXTENDED_LIMITS 0.00 255.0 /end CHARACTERISTIC
/begin CHARACTERISTIC DFES_Cls.DFC_MOXEMM_SMU_ALM6_14_C "fault class per DFC / Fault class for check DFC_MOXEMM_SMU_ALM6_14" VALUE 0x804D9361 Val_Wu8 30.00 DFES_OneToOne 0.00 30.00 FORMAT "%5.2" EXTENDED_LIMITS 0.00 255.0 /end CHARACTERISTIC
/begin CHARACTERISTIC DFES_Cls.DFC_MOXEMM_SMU_ALM6_15_C "fault class per DFC / Fault class for check DFC_MOXEMM_SMU_ALM6_15" VALUE 0x804D9362 Val_Wu8 30.00 DFES_OneToOne 0.00 30.00 FORMAT "%5.2" EXTENDED_LIMITS 0.00 255.0 /end CHARACTERISTIC
/begin CHARACTERISTIC DFES_Cls.DFC_MOXEMM_SMU_ALM6_17_C "fault class per DFC / Fault class for check DFC_MOXEMM_SMU_ALM6_17" VALUE 0x804D9363 Val_Wu8 30.00 DFES_OneToOne 0.00 30.00 FORMAT "%5.2" EXTENDED_LIMITS 0.00 255.0 /end CHARACTERISTIC
/begin CHARACTERISTIC DFES_Cls.DFC_MOXEMM_SMU_ALM6_18_C "fault class per DFC / Fault class for check DFC_MOXEMM_SMU_ALM6_18" VALUE 0x804D9364 Val_Wu8 30.00 DFES_OneToOne 0.00 30.00 FORMAT "%5.2" EXTENDED_LIMITS 0.00 255.0 /end CHARACTERISTIC
/begin CHARACTERISTIC DFES_Cls.DFC_MOXEMM_SMU_ALM6_20_C "fault class per DFC / Fault class for check DFC_MOXEMM_SMU_ALM6_20" VALUE 0x804D9365 Val_Wu8 30.00 DFES_OneToOne 0.00 30.00 FORMAT "%5.2" EXTENDED_LIMITS 0.00 255.0 /end CHARACTERISTIC
/begin CHARACTERISTIC DFES_Cls.DFC_MOXEMM_SMU_ALM6_21_C "fault class per DFC / Fault class for check DFC_MOXEMM_SMU_ALM6_21" VALUE 0x804D9366 Val_Wu8 30.00 DFES_OneToOne 0.00 30.00 FORMAT "%5.2" EXTENDED_LIMITS 0.00 255.0 /end CHARACTERISTIC
/begin CHARACTERISTIC DFES_Cls.DFC_MOXEMM_SMU_ALM6_25_C "fault class per DFC / Fault class for check DFC_MOXEMM_SMU_ALM6_25" VALUE 0x804D9367 Val_Wu8 30.00 DFES_OneToOne 0.00 30.00 FORMAT "%5.2" EXTENDED_LIMITS 0.00 255.0 /end CHARACTERISTIC
/begin CHARACTERISTIC DFES_Cls.DFC_MOXEMM_SMU_ALM6_4_C "fault class per DFC / Fault class for check DFC_MOXEMM_SMU_ALM6_4" VALUE 0x804D9368 Val_Wu8 30.00 DFES_OneToOne 0.00 30.00 FORMAT "%5.2" EXTENDED_LIMITS 0.00 255.0 /end CHARACTERISTIC
/begin CHARACTERISTIC DFES_Cls.DFC_MOXEMM_SMU_ALM6_5_C "fault class per DFC / Fault class for check DFC_MOXEMM_SMU_ALM6_5" VALUE 0x804D9369 Val_Wu8 30.00 DFES_OneToOne 0.00 30.00 FORMAT "%5.2" EXTENDED_LIMITS 0.00 255.0 /end CHARACTERISTIC
/begin CHARACTERISTIC DFES_Cls.DFC_MOXEMM_SMU_ALM6_7_C "fault class per DFC / Fault class for check DFC_MOXEMM_SMU_ALM6_7" VALUE 0x804D936A Val_Wu8 30.00 DFES_OneToOne 0.00 30.00 FORMAT "%5.2" EXTENDED_LIMITS 0.00 255.0 /end CHARACTERISTIC
/begin CHARACTERISTIC DFES_Cls.DFC_MOXEMM_SMU_ALM6_8_C "fault class per DFC / Fault class for check DFC_MOXEMM_SMU_ALM6_8" VALUE 0x804D936B Val_Wu8 30.00 DFES_OneToOne 0.00 30.00 FORMAT "%5.2" EXTENDED_LIMITS 0.00 255.0 /end CHARACTERISTIC
/begin CHARACTERISTIC DFES_Cls.DFC_MOXEMM_SMU_ALM7_1_C "fault class per DFC / Fault class for check DFC_MOXEMM_SMU_ALM7_1" VALUE 0x804D936C Val_Wu8 30.00 DFES_OneToOne 0.00 30.00 FORMAT "%5.2" EXTENDED_LIMITS 0.00 255.0 /end CHARACTERISTIC
/begin CHARACTERISTIC DFES_Cls.DFC_MOXEMM_SMU_ALM7_12_C "fault class per DFC / Fault class for check DFC_MOXEMM_SMU_ALM7_12" VALUE 0x804D936D Val_Wu8 30.00 DFES_OneToOne 0.00 30.00 FORMAT "%5.2" EXTENDED_LIMITS 0.00 255.0 /end CHARACTERISTIC
/begin CHARACTERISTIC DFES_Cls.DFC_MOXEMM_SMU_ALM7_13_C "fault class per DFC / Fault class for check DFC_MOXEMM_SMU_ALM7_13" VALUE 0x804D936E Val_Wu8 30.00 DFES_OneToOne 0.00 30.00 FORMAT "%5.2" EXTENDED_LIMITS 0.00 255.0 /end CHARACTERISTIC
/begin CHARACTERISTIC DFES_Cls.DFC_MOXEMM_SMU_ALM7_14_C "fault class per DFC / Fault class for check DFC_MOXEMM_SMU_ALM7_14" VALUE 0x804D936F Val_Wu8 30.00 DFES_OneToOne 0.00 30.00 FORMAT "%5.2" EXTENDED_LIMITS 0.00 255.0 /end CHARACTERISTIC
/begin CHARACTERISTIC DFES_Cls.DFC_MOXEMM_SMU_ALM7_15_C "fault class per DFC / Fault class for check DFC_MOXEMM_SMU_ALM7_15" VALUE 0x804D9370 Val_Wu8 30.00 DFES_OneToOne 0.00 30.00 FORMAT "%5.2" EXTENDED_LIMITS 0.00 255.0 /end CHARACTERISTIC
/begin CHARACTERISTIC DFES_Cls.DFC_MOXEMM_SMU_ALM7_16_C "fault class per DFC / Fault class for check DFC_MOXEMM_SMU_ALM7_16" VALUE 0x804D9371 Val_Wu8 30.00 DFES_OneToOne 0.00 30.00 FORMAT "%5.2" EXTENDED_LIMITS 0.00 255.0 /end CHARACTERISTIC
/begin CHARACTERISTIC DFES_Cls.DFC_MOXEMM_SMU_ALM7_17_C "fault class per DFC / Fault class for check DFC_MOXEMM_SMU_ALM7_17" VALUE 0x804D9372 Val_Wu8 30.00 DFES_OneToOne 0.00 30.00 FORMAT "%5.2" EXTENDED_LIMITS 0.00 255.0 /end CHARACTERISTIC
/begin CHARACTERISTIC DFES_Cls.DFC_MOXEMM_SMU_ALM7_2_C "fault class per DFC / Fault class for check DFC_MOXEMM_SMU_ALM7_2" VALUE 0x804D9373 Val_Wu8 30.00 DFES_OneToOne 0.00 30.00 FORMAT "%5.2" EXTENDED_LIMITS 0.00 255.0 /end CHARACTERISTIC
/begin CHARACTERISTIC DFES_Cls.DFC_MOXEMM_SMU_ALM7_20_C "fault class per DFC / Fault class for check DFC_MOXEMM_SMU_ALM7_20" VALUE 0x804D9374 Val_Wu8 30.00 DFES_OneToOne 0.00 30.00 FORMAT "%5.2" EXTENDED_LIMITS 0.00 255.0 /end CHARACTERISTIC
/begin CHARACTERISTIC DFES_Cls.DFC_MOXEMM_SMU_ALM7_25_C "fault class per DFC / Fault class for check DFC_MOXEMM_SMU_ALM7_25" VALUE 0x804D9375 Val_Wu8 30.00 DFES_OneToOne 0.00 30.00 FORMAT "%5.2" EXTENDED_LIMITS 0.00 255.0 /end CHARACTERISTIC
/begin CHARACTERISTIC DFES_Cls.DFC_MOXEMM_SMU_ALM7_26_C "fault class per DFC / Fault class for check DFC_MOXEMM_SMU_ALM7_26" VALUE 0x804D9376 Val_Wu8 30.00 DFES_OneToOne 0.00 30.00 FORMAT "%5.2" EXTENDED_LIMITS 0.00 255.0 /end CHARACTERISTIC
/begin CHARACTERISTIC DFES_Cls.DFC_MOXEMM_SMU_ALM7_28_C "fault class per DFC / Fault class for check DFC_MOXEMM_SMU_ALM7_28" VALUE 0x804D9377 Val_Wu8 30.00 DFES_OneToOne 0.00 30.00 FORMAT "%5.2" EXTENDED_LIMITS 0.00 255.0 /end CHARACTERISTIC
/begin CHARACTERISTIC DFES_Cls.DFC_MOXEMM_SMU_ALM7_29_C "fault class per DFC / Fault class for check DFC_MOXEMM_SMU_ALM7_29" VALUE 0x804D9378 Val_Wu8 30.00 DFES_OneToOne 0.00 30.00 FORMAT "%5.2" EXTENDED_LIMITS 0.00 255.0 /end CHARACTERISTIC
/begin CHARACTERISTIC DFES_Cls.DFC_MOXEMM_SMU_ALM7_30_C "fault class per DFC / Fault class for check DFC_MOXEMM_SMU_ALM7_30" VALUE 0x804D9379 Val_Wu8 30.00 DFES_OneToOne 0.00 30.00 FORMAT "%5.2" EXTENDED_LIMITS 0.00 255.0 /end CHARACTERISTIC
/begin CHARACTERISTIC DFES_Cls.DFC_MOXEMM_SMU_ALM7_31_C "fault class per DFC / Fault class for check DFC_MOXEMM_SMU_ALM7_31" VALUE 0x804D937A Val_Wu8 30.00 DFES_OneToOne 0.00 30.00 FORMAT "%5.2" EXTENDED_LIMITS 0.00 255.0 /end CHARACTERISTIC
/begin CHARACTERISTIC DFES_Cls.DFC_MOXEMM_SMU_ALM8_0_C "fault class per DFC / Fault class for check DFC_MOXEMM_SMU_ALM8_0" VALUE 0x804D937B Val_Wu8 30.00 DFES_OneToOne 0.00 30.00 FORMAT "%5.2" EXTENDED_LIMITS 0.00 255.0 /end CHARACTERISTIC
/begin CHARACTERISTIC DFES_Cls.DFC_MOXEMM_SMU_ALM8_1_C "fault class per DFC / Fault class for check DFC_MOXEMM_SMU_ALM8_1" VALUE 0x804D937C Val_Wu8 30.00 DFES_OneToOne 0.00 30.00 FORMAT "%5.2" EXTENDED_LIMITS 0.00 255.0 /end CHARACTERISTIC
/begin CHARACTERISTIC DFES_Cls.DFC_MOXEMM_SMU_ALM8_10_C "fault class per DFC / Fault class for check DFC_MOXEMM_SMU_ALM8_10" VALUE 0x804D937D Val_Wu8 30.00 DFES_OneToOne 0.00 30.00 FORMAT "%5.2" EXTENDED_LIMITS 0.00 255.0 /end CHARACTERISTIC
/begin CHARACTERISTIC DFES_Cls.DFC_MOXEMM_SMU_ALM8_11_C "fault class per DFC / Fault class for check DFC_MOXEMM_SMU_ALM8_11" VALUE 0x804D937E Val_Wu8 30.00 DFES_OneToOne 0.00 30.00 FORMAT "%5.2" EXTENDED_LIMITS 0.00 255.0 /end CHARACTERISTIC
/begin CHARACTERISTIC DFES_Cls.DFC_MOXEMM_SMU_ALM8_12_C "fault class per DFC / Fault class for check DFC_MOXEMM_SMU_ALM8_12" VALUE 0x804D937F Val_Wu8 30.00 DFES_OneToOne 0.00 30.00 FORMAT "%5.2" EXTENDED_LIMITS 0.00 255.0 /end CHARACTERISTIC
/begin CHARACTERISTIC DFES_Cls.DFC_MOXEMM_SMU_ALM8_16_C "fault class per DFC / Fault class for check DFC_MOXEMM_SMU_ALM8_16" VALUE 0x804D9380 Val_Wu8 30.00 DFES_OneToOne 0.00 30.00 FORMAT "%5.2" EXTENDED_LIMITS 0.00 255.0 /end CHARACTERISTIC
/begin CHARACTERISTIC DFES_Cls.DFC_MOXEMM_SMU_ALM8_18_C "fault class per DFC / Fault class for check DFC_MOXEMM_SMU_ALM8_18" VALUE 0x804D9381 Val_Wu8 30.00 DFES_OneToOne 0.00 30.00 FORMAT "%5.2" EXTENDED_LIMITS 0.00 255.0 /end CHARACTERISTIC
/begin CHARACTERISTIC DFES_Cls.DFC_MOXEMM_SMU_ALM8_2_C "fault class per DFC / Fault class for check DFC_MOXEMM_SMU_ALM8_2" VALUE 0x804D9382 Val_Wu8 30.00 DFES_OneToOne 0.00 30.00 FORMAT "%5.2" EXTENDED_LIMITS 0.00 255.0 /end CHARACTERISTIC
/begin CHARACTERISTIC DFES_Cls.DFC_MOXEMM_SMU_ALM8_3_C "fault class per DFC / Fault class for check DFC_MOXEMM_SMU_ALM8_3" VALUE 0x804D9383 Val_Wu8 30.00 DFES_OneToOne 0.00 30.00 FORMAT "%5.2" EXTENDED_LIMITS 0.00 255.0 /end CHARACTERISTIC
/begin CHARACTERISTIC DFES_Cls.DFC_MOXEMM_SMU_ALM8_31_C "fault class per DFC / Fault class for check DFC_MOXEMM_SMU_ALM8_31" VALUE 0x804D9384 Val_Wu8 30.00 DFES_OneToOne 0.00 30.00 FORMAT "%5.2" EXTENDED_LIMITS 0.00 255.0 /end CHARACTERISTIC
/begin CHARACTERISTIC DFES_Cls.DFC_MOXEMM_SMU_ALM8_4_C "fault class per DFC / Fault class for check DFC_MOXEMM_SMU_ALM8_4" VALUE 0x804D9385 Val_Wu8 30.00 DFES_OneToOne 0.00 30.00 FORMAT "%5.2" EXTENDED_LIMITS 0.00 255.0 /end CHARACTERISTIC
/begin CHARACTERISTIC DFES_Cls.DFC_MOXEMM_SMU_ALM9_0_C "fault class per DFC / Fault class for check DFC_MOXEMM_SMU_ALM9_0" VALUE 0x804D9386 Val_Wu8 30.00 DFES_OneToOne 0.00 30.00 FORMAT "%5.2" EXTENDED_LIMITS 0.00 255.0 /end CHARACTERISTIC
/begin CHARACTERISTIC DFES_Cls.DFC_MOXEMM_SMU_ALM9_15_C "fault class per DFC / Fault class for check DFC_MOXEMM_SMU_ALM9_15" VALUE 0x804D9387 Val_Wu8 30.00 DFES_OneToOne 0.00 30.00 FORMAT "%5.2" EXTENDED_LIMITS 0.00 255.0 /end CHARACTERISTIC
/begin CHARACTERISTIC DFES_Cls.DFC_MOXEMM_SMU_ALM9_3_C "fault class per DFC / Fault class for check DFC_MOXEMM_SMU_ALM9_3" VALUE 0x804D9388 Val_Wu8 30.00 DFES_OneToOne 0.00 30.00 FORMAT "%5.2" EXTENDED_LIMITS 0.00 255.0 /end CHARACTERISTIC
/begin CHARACTERISTIC DFES_Cls.DFC_MoCADCNTP_C "fault class per DFC / Fault class for check DFC_MoCADCNTP" VALUE 0x804D9389 Val_Wu8 30.00 DFES_OneToOne 0.00 30.00 FORMAT "%5.2" EXTENDED_LIMITS 0.00 255.0 /end CHARACTERISTIC
/begin CHARACTERISTIC DFES_Cls.DFC_MoCADCTst_C "fault class per DFC / Fault class for check DFC_MoCADCTst" VALUE 0x804D938A Val_Wu8 30.00 DFES_OneToOne 0.00 30.00 FORMAT "%5.2" EXTENDED_LIMITS 0.00 255.0 /end CHARACTERISTIC
/begin CHARACTERISTIC DFES_Cls.DFC_MoCSOPICO_C "fault class per DFC / Fault class for check DFC_MoCSOPICO" VALUE 0x804D938B Val_Wu8 30.00 DFES_OneToOne 0.00 30.00 FORMAT "%5.2" EXTENDED_LIMITS 0.00 255.0 /end CHARACTERISTIC
/begin CHARACTERISTIC DFES_Cls.DFC_MoFAPP_C "fault class per DFC / Fault class for check DFC_MoFAPP" VALUE 0x804D938C Val_Wu8 30.00 DFES_OneToOne 0.00 30.00 FORMAT "%5.2" EXTENDED_LIMITS 0.00 255.0 /end CHARACTERISTIC
/begin CHARACTERISTIC DFES_Cls.DFC_MoFAirFilgPrdc_C "fault class per DFC / Fault class for check DFC_MoFAirFilgPrdc" VALUE 0x804D938D Val_Wu8 30.00 DFES_OneToOne 0.00 30.00 FORMAT "%5.2" EXTENDED_LIMITS 0.00 255.0 /end CHARACTERISTIC
/begin CHARACTERISTIC DFES_Cls.DFC_MoFAirFlCtOffPfi_C "fault class per DFC / Fault class for check DFC_MoFAirFlCtOffPfi" VALUE 0x804D938E Val_Wu8 30.00 DFES_OneToOne 0.00 30.00 FORMAT "%5.2" EXTENDED_LIMITS 0.00 255.0 /end CHARACTERISTIC
/begin CHARACTERISTIC DFES_Cls.DFC_MoFAirFlCylPfi_C "fault class per DFC / Fault class for check DFC_MoFAirFlCylPfi" VALUE 0x804D938F Val_Wu8 30.00 DFES_OneToOne 0.00 30.00 FORMAT "%5.2" EXTENDED_LIMITS 0.00 255.0 /end CHARACTERISTIC
/begin CHARACTERISTIC DFES_Cls.DFC_MoFAirFlIn_C "fault class per DFC / Fault class for check DFC_MoFAirFlIn" VALUE 0x804D9390 Val_Wu8 30.00 DFES_OneToOne 0.00 30.00 FORMAT "%5.2" EXTENDED_LIMITS 0.00 255.0 /end CHARACTERISTIC
/begin CHARACTERISTIC DFES_Cls.DFC_MoFAirFlMixCtlPfiChkAirFl_C "fault class per DFC / Fault class for check DFC_MoFAirFlMixCtlPfiChkAirFl" VALUE 0x804D9391 Val_Wu8 30.00 DFES_OneToOne 0.00 30.00 FORMAT "%5.2" EXTENDED_LIMITS 0.00 255.0 /end CHARACTERISTIC
/begin CHARACTERISTIC DFES_Cls.DFC_MoFAirFlMixCtlPfiChkCtrl_C "fault class per DFC / Fault class for check DFC_MoFAirFlMixCtlPfiChkCtrl" VALUE 0x804D9392 Val_Wu8 30.00 DFES_OneToOne 0.00 30.00 FORMAT "%5.2" EXTENDED_LIMITS 0.00 255.0 /end CHARACTERISTIC
/begin CHARACTERISTIC DFES_Cls.DFC_MoFAirFlMode_C "fault class per DFC / Fault class for check DFC_MoFAirFlMode" VALUE 0x804D9393 Val_Wu8 30.00 DFES_OneToOne 0.00 30.00 FORMAT "%5.2" EXTENDED_LIMITS 0.00 255.0 /end CHARACTERISTIC
/begin CHARACTERISTIC DFES_Cls.DFC_MoFESpd_C "fault class per DFC / Fault class for check DFC_MoFESpd" VALUE 0x804D9394 Val_Wu8 30.00 DFES_OneToOne 0.00 30.00 FORMAT "%5.2" EXTENDED_LIMITS 0.00 255.0 /end CHARACTERISTIC
/begin CHARACTERISTIC DFES_Cls.DFC_MoFIACo_C "fault class per DFC / Fault class for check DFC_MoFIACo" VALUE 0x804D9395 Val_Wu8 30.00 DFES_OneToOne 0.00 30.00 FORMAT "%5.2" EXTENDED_LIMITS 0.00 255.0 /end CHARACTERISTIC
/begin CHARACTERISTIC DFES_Cls.DFC_MoFICOL1_C "fault class per DFC / Fault class for check DFC_MoFICOL1" VALUE 0x804D9396 Val_Wu8 30.00 DFES_OneToOne 0.00 30.00 FORMAT "%5.2" EXTENDED_LIMITS 0.00 255.0 /end CHARACTERISTIC
/begin CHARACTERISTIC DFES_Cls.DFC_MoFICOL2_C "fault class per DFC / Fault class for check DFC_MoFICOL2" VALUE 0x804D9397 Val_Wu8 30.00 DFES_OneToOne 0.00 30.00 FORMAT "%5.2" EXTENDED_LIMITS 0.00 255.0 /end CHARACTERISTIC
/begin CHARACTERISTIC DFES_Cls.DFC_MoFStrt_C "fault class per DFC / Fault class for check DFC_MoFStrt" VALUE 0x804D9398 Val_Wu8 30.00 DFES_OneToOne 0.00 30.00 FORMAT "%5.2" EXTENDED_LIMITS 0.00 255.0 /end CHARACTERISTIC
/begin CHARACTERISTIC DFES_Cls.DFC_MoFTrqCmp_C "fault class per DFC / Fault class for check DFC_MoFTrqCmp" VALUE 0x804D9399 Val_Wu8 30.00 DFES_OneToOne 0.00 30.00 FORMAT "%5.2" EXTENDED_LIMITS 0.00 255.0 /end CHARACTERISTIC
/begin CHARACTERISTIC DFES_Cls.DFC_MoFTrqCmpMax_C "fault class per DFC / Fault class for check DFC_MoFTrqCmpMax" VALUE 0x804D939A Val_Wu8 30.00 DFES_OneToOne 0.00 30.00 FORMAT "%5.2" EXTENDED_LIMITS 0.00 255.0 /end CHARACTERISTIC
/begin CHARACTERISTIC DFES_Cls.DFC_MoFTrqCmpMin_C "fault class per DFC / Fault class for check DFC_MoFTrqCmpMin" VALUE 0x804D939B Val_Wu8 30.00 DFES_OneToOne 0.00 30.00 FORMAT "%5.2" EXTENDED_LIMITS 0.00 255.0 /end CHARACTERISTIC
/begin CHARACTERISTIC DFES_Cls.DFC_MoFVarPostBldSel_C "fault class per DFC / Fault class for check DFC_MoFVarPostBldSel" VALUE 0x804D939C Val_Wu8 30.00 DFES_OneToOne 0.00 30.00 FORMAT "%5.2" EXTENDED_LIMITS 0.00 255.0 /end CHARACTERISTIC
/begin CHARACTERISTIC DFES_Cls.DFC_MoXEMMHwLTMCUFW_C "fault class per DFC / Fault class for check DFC_MoXEMMHwLTMCUFW" VALUE 0x804D939D Val_Wu8 30.00 DFES_OneToOne 0.00 30.00 FORMAT "%5.2" EXTENDED_LIMITS 0.00 255.0 /end CHARACTERISTIC
/begin CHARACTERISTIC DFES_Cls.DFC_MoXEMMHwLTMonBIST_C "fault class per DFC / Fault class for check DFC_MoXEMMHwLTMonBIST" VALUE 0x804D939E Val_Wu8 30.00 DFES_OneToOne 0.00 30.00 FORMAT "%5.2" EXTENDED_LIMITS 0.00 255.0 /end CHARACTERISTIC
/begin CHARACTERISTIC DFES_Cls.DFC_MoXEMMHwLTRegMonTest_C "fault class per DFC / Fault class for check DFC_MoXEMMHwLTRegMonTest" VALUE 0x804D939F Val_Wu8 30.00 DFES_OneToOne 0.00 30.00 FORMAT "%5.2" EXTENDED_LIMITS 0.00 255.0 /end CHARACTERISTIC
/begin CHARACTERISTIC DFES_Cls.DFC_MoXEMMHwLTStbySMUAlvTest_C "fault class per DFC / Fault class for check DFC_MoXEMMHwLTStbySMUAlvTest" VALUE 0x804D93A0 Val_Wu8 30.00 DFES_OneToOne 0.00 30.00 FORMAT "%5.2" EXTENDED_LIMITS 0.00 255.0 /end CHARACTERISTIC
/begin CHARACTERISTIC DFES_Cls.DFC_MoXEMMHwLTTempSens_C "fault class per DFC / Fault class for check DFC_MoXEMMHwLTTempSens" VALUE 0x804D93A1 Val_Wu8 30.00 DFES_OneToOne 0.00 30.00 FORMAT "%5.2" EXTENDED_LIMITS 0.00 255.0 /end CHARACTERISTIC
/begin CHARACTERISTIC DFES_Cls.DFC_MoXEMMHwLTUCBCfg_C "fault class per DFC / Fault class for check DFC_MoXEMMHwLTUCBCfg" VALUE 0x804D93A2 Val_Wu8 30.00 DFES_OneToOne 0.00 30.00 FORMAT "%5.2" EXTENDED_LIMITS 0.00 255.0 /end CHARACTERISTIC
/begin CHARACTERISTIC DFES_Cls.DFC_OCWDAABEActv_C "fault class per DFC / Fault class for check DFC_OCWDAABEActv" VALUE 0x804D93A3 Val_Wu8 30.00 DFES_OneToOne 0.00 30.00 FORMAT "%5.2" EXTENDED_LIMITS 0.00 255.0 /end CHARACTERISTIC
/begin CHARACTERISTIC DFES_Cls.DFC_OCWDACom_C "fault class per DFC / Fault class for check DFC_OCWDACom" VALUE 0x804D93A4 Val_Wu8 30.00 DFES_OneToOne 0.00 30.00 FORMAT "%5.2" EXTENDED_LIMITS 0.00 255.0 /end CHARACTERISTIC
/begin CHARACTERISTIC DFES_Cls.DFC_OCWDAErrPin_C "fault class per DFC / Fault class for check DFC_OCWDAErrPin" VALUE 0x804D93A5 Val_Wu8 30.00 DFES_OneToOne 0.00 30.00 FORMAT "%5.2" EXTENDED_LIMITS 0.00 255.0 /end CHARACTERISTIC
/begin CHARACTERISTIC DFES_Cls.DFC_OCWDAOvrVltg_C "fault class per DFC / Fault class for check DFC_OCWDAOvrVltg" VALUE 0x804D93A6 Val_Wu8 30.00 DFES_OneToOne 0.00 30.00 FORMAT "%5.2" EXTENDED_LIMITS 0.00 255.0 /end CHARACTERISTIC
/begin CHARACTERISTIC DFES_Cls.DFC_ORAmax_C "fault class per DFC / Fault class for check DFC_ORAmax" VALUE 0x804D93A7 Val_Wu8 30.00 DFES_OneToOne 0.00 30.00 FORMAT "%5.2" EXTENDED_LIMITS 0.00 255.0 /end CHARACTERISTIC
/begin CHARACTERISTIC DFES_Cls.DFC_ORAmin_C "fault class per DFC / Fault class for check DFC_ORAmin" VALUE 0x804D93A8 Val_Wu8 30.00 DFES_OneToOne 0.00 30.00 FORMAT "%5.2" EXTENDED_LIMITS 0.00 255.0 /end CHARACTERISTIC
/begin CHARACTERISTIC DFES_Cls.DFC_PLLSUmax_C "fault class per DFC / Fault class for check DFC_PLLSUmax" VALUE 0x804D93A9 Val_Wu8 30.00 DFES_OneToOne 0.00 30.00 FORMAT "%5.2" EXTENDED_LIMITS 0.00 255.0 /end CHARACTERISTIC
/begin CHARACTERISTIC DFES_Cls.DFC_PLLSUmin_C "fault class per DFC / Fault class for check DFC_PLLSUmin" VALUE 0x804D93AA Val_Wu8 30.00 DFES_OneToOne 0.00 30.00 FORMAT "%5.2" EXTENDED_LIMITS 0.00 255.0 /end CHARACTERISTIC
/begin CHARACTERISTIC DFES_Cls.DFC_PSR1max_C "fault class per DFC / Fault class for check DFC_PSR1max" VALUE 0x804D93AB Val_Wu8 30.00 DFES_OneToOne 0.00 30.00 FORMAT "%5.2" EXTENDED_LIMITS 0.00 255.0 /end CHARACTERISTIC
/begin CHARACTERISTIC DFES_Cls.DFC_PSRBmax_C "fault class per DFC / Fault class for check DFC_PSRBmax" VALUE 0x804D93AC Val_Wu8 30.00 DFES_OneToOne 0.00 30.00 FORMAT "%5.2" EXTENDED_LIMITS 0.00 255.0 /end CHARACTERISTIC
/begin CHARACTERISTIC DFES_Cls.DFC_PSRBmin_C "fault class per DFC / Fault class for check DFC_PSRBmin" VALUE 0x804D93AD Val_Wu8 30.00 DFES_OneToOne 0.00 30.00 FORMAT "%5.2" EXTENDED_LIMITS 0.00 255.0 /end CHARACTERISTIC
/begin CHARACTERISTIC DFES_Cls.DFC_PSRPmax_C "fault class per DFC / Fault class for check DFC_PSRPmax" VALUE 0x804D93AE Val_Wu8 30.00 DFES_OneToOne 0.00 30.00 FORMAT "%5.2" EXTENDED_LIMITS 0.00 255.0 /end CHARACTERISTIC
/begin CHARACTERISTIC DFES_Cls.DFC_PSRPmin_C "fault class per DFC / Fault class for check DFC_PSRPmin" VALUE 0x804D93AF Val_Wu8 30.00 DFES_OneToOne 0.00 30.00 FORMAT "%5.2" EXTENDED_LIMITS 0.00 255.0 /end CHARACTERISTIC
/begin CHARACTERISTIC DFES_Cls.DFC_PSRPsig_C "fault class per DFC / Fault class for check DFC_PSRPsig" VALUE 0x804D93B0 Val_Wu8 30.00 DFES_OneToOne 0.00 30.00 FORMAT "%5.2" EXTENDED_LIMITS 0.00 255.0 /end CHARACTERISTIC
/begin CHARACTERISTIC DFES_Cls.DFC_PSRmax_C "fault class per DFC / Fault class for check DFC_PSRmax" VALUE 0x804D93B1 Val_Wu8 30.00 DFES_OneToOne 0.00 30.00 FORMAT "%5.2" EXTENDED_LIMITS 0.00 255.0 /end CHARACTERISTIC
/begin CHARACTERISTIC DFES_Cls.DFC_PUmax_C "fault class per DFC / Fault class for check DFC_PUmax" VALUE 0x804D93B2 Val_Wu8 30.00 DFES_OneToOne 0.00 30.00 FORMAT "%5.2" EXTENDED_LIMITS 0.00 255.0 /end CHARACTERISTIC
/begin CHARACTERISTIC DFES_Cls.DFC_P_VSE11_OL_C "fault class per DFC / Fault class for check DFC_P_VSE11_OL" VALUE 0x804D93B3 Val_Wu8 30.00 DFES_OneToOne 0.00 30.00 FORMAT "%5.2" EXTENDED_LIMITS 0.00 255.0 /end CHARACTERISTIC
/begin CHARACTERISTIC DFES_Cls.DFC_P_VSE11_SCB_C "fault class per DFC / Fault class for check DFC_P_VSE11_SCB" VALUE 0x804D93B4 Val_Wu8 30.00 DFES_OneToOne 0.00 30.00 FORMAT "%5.2" EXTENDED_LIMITS 0.00 255.0 /end CHARACTERISTIC
/begin CHARACTERISTIC DFES_Cls.DFC_P_VSE11_SCG_C "fault class per DFC / Fault class for check DFC_P_VSE11_SCG" VALUE 0x804D93B5 Val_Wu8 30.00 DFES_OneToOne 0.00 30.00 FORMAT "%5.2" EXTENDED_LIMITS 0.00 255.0 /end CHARACTERISTIC
/begin CHARACTERISTIC DFES_Cls.DFC_PhyHighAPP1_C "fault class per DFC / Fault class for check DFC_PhyHighAPP1" VALUE 0x804D93B6 Val_Wu8 30.00 DFES_OneToOne 0.00 30.00 FORMAT "%5.2" EXTENDED_LIMITS 0.00 255.0 /end CHARACTERISTIC
/begin CHARACTERISTIC DFES_Cls.DFC_PhyHighAPP2_C "fault class per DFC / Fault class for check DFC_PhyHighAPP2" VALUE 0x804D93B7 Val_Wu8 30.00 DFES_OneToOne 0.00 30.00 FORMAT "%5.2" EXTENDED_LIMITS 0.00 255.0 /end CHARACTERISTIC
/begin CHARACTERISTIC DFES_Cls.DFC_PhyLowAPP1_C "fault class per DFC / Fault class for check DFC_PhyLowAPP1" VALUE 0x804D93B8 Val_Wu8 30.00 DFES_OneToOne 0.00 30.00 FORMAT "%5.2" EXTENDED_LIMITS 0.00 255.0 /end CHARACTERISTIC
/begin CHARACTERISTIC DFES_Cls.DFC_PhyLowAPP2_C "fault class per DFC / Fault class for check DFC_PhyLowAPP2" VALUE 0x804D93B9 Val_Wu8 30.00 DFES_OneToOne 0.00 30.00 FORMAT "%5.2" EXTENDED_LIMITS 0.00 255.0 /end CHARACTERISTIC
/begin CHARACTERISTIC DFES_Cls.DFC_SRCHighAPP1_C "fault class per DFC / Fault class for check DFC_SRCHighAPP1" VALUE 0x804D93BA Val_Wu8 30.00 DFES_OneToOne 0.00 30.00 FORMAT "%5.2" EXTENDED_LIMITS 0.00 255.0 /end CHARACTERISTIC
/begin CHARACTERISTIC DFES_Cls.DFC_SRCHighAPP2_C "fault class per DFC / Fault class for check DFC_SRCHighAPP2" VALUE 0x804D93BB Val_Wu8 30.00 DFES_OneToOne 0.00 30.00 FORMAT "%5.2" EXTENDED_LIMITS 0.00 255.0 /end CHARACTERISTIC
/begin CHARACTERISTIC DFES_Cls.DFC_SRCLowAPP1_C "fault class per DFC / Fault class for check DFC_SRCLowAPP1" VALUE 0x804D93BC Val_Wu8 30.00 DFES_OneToOne 0.00 30.00 FORMAT "%5.2" EXTENDED_LIMITS 0.00 255.0 /end CHARACTERISTIC
/begin CHARACTERISTIC DFES_Cls.DFC_SRCLowAPP2_C "fault class per DFC / Fault class for check DFC_SRCLowAPP2" VALUE 0x804D93BD Val_Wu8 30.00 DFES_OneToOne 0.00 30.00 FORMAT "%5.2" EXTENDED_LIMITS 0.00 255.0 /end CHARACTERISTIC
/begin CHARACTERISTIC DFES_Cls.DFC_SSpMon2_C "fault class per DFC / Fault class for check DFC_SSpMon2" VALUE 0x804D93BE Val_Wu8 30.00 DFES_OneToOne 0.00 30.00 FORMAT "%5.2" EXTENDED_LIMITS 0.00 255.0 /end CHARACTERISTIC
/begin CHARACTERISTIC DFES_Cls.DFC_SWReset_0_C "fault class per DFC / Fault class for check DFC_SWReset_0" VALUE 0x804D93BF Val_Wu8 30.00 DFES_OneToOne 0.00 30.00 FORMAT "%5.2" EXTENDED_LIMITS 0.00 255.0 /end CHARACTERISTIC
/begin CHARACTERISTIC DFES_Cls.DFC_SWReset_1_C "fault class per DFC / Fault class for check DFC_SWReset_1" VALUE 0x804D93C0 Val_Wu8 30.00 DFES_OneToOne 0.00 30.00 FORMAT "%5.2" EXTENDED_LIMITS 0.00 255.0 /end CHARACTERISTIC
/begin CHARACTERISTIC DFES_Cls.DFC_SWReset_2_C "fault class per DFC / Fault class for check DFC_SWReset_2" VALUE 0x804D93C1 Val_Wu8 30.00 DFES_OneToOne 0.00 30.00 FORMAT "%5.2" EXTENDED_LIMITS 0.00 255.0 /end CHARACTERISTIC
/begin CHARACTERISTIC DFES_Cls.DFC_SyncAPP_C "fault class per DFC / Fault class for check DFC_SyncAPP" VALUE 0x804D93C2 Val_Wu8 30.00 DFES_OneToOne 0.00 30.00 FORMAT "%5.2" EXTENDED_LIMITS 0.00 255.0 /end CHARACTERISTIC
/begin CHARACTERISTIC DFES_Cls.DFC_TAmax_Dummy_C "fault class per DFC / Fault class for check DFC_TAmax_Dummy" VALUE 0x804D93C3 Val_Wu8 30.00 DFES_OneToOne 0.00 30.00 FORMAT "%5.2" EXTENDED_LIMITS 0.00 255.0 /end CHARACTERISTIC
/begin CHARACTERISTIC DFES_Cls.DFC_TKAEmax_C "fault class per DFC / Fault class for check DFC_TKAEmax" VALUE 0x804D93C4 Val_Wu8 30.00 DFES_OneToOne 0.00 30.00 FORMAT "%5.2" EXTENDED_LIMITS 0.00 255.0 /end CHARACTERISTIC
/begin CHARACTERISTIC DFES_Cls.DFC_TKAEmin_C "fault class per DFC / Fault class for check DFC_TKAEmin" VALUE 0x804D93C5 Val_Wu8 30.00 DFES_OneToOne 0.00 30.00 FORMAT "%5.2" EXTENDED_LIMITS 0.00 255.0 /end CHARACTERISTIC
/begin CHARACTERISTIC DFES_Cls.DFC_TKARmax_C "fault class per DFC / Fault class for check DFC_TKARmax" VALUE 0x804D93C6 Val_Wu8 30.00 DFES_OneToOne 0.00 30.00 FORMAT "%5.2" EXTENDED_LIMITS 0.00 255.0 /end CHARACTERISTIC
/begin CHARACTERISTIC DFES_Cls.DFC_TKARnpl_C "fault class per DFC / Fault class for check DFC_TKARnpl" VALUE 0x804D93C7 Val_Wu8 30.00 DFES_OneToOne 0.00 30.00 FORMAT "%5.2" EXTENDED_LIMITS 0.00 255.0 /end CHARACTERISTIC
/begin CHARACTERISTIC DFES_Cls.DFC_TMmax_Dummy_C "fault class per DFC / Fault class for check DFC_TMmax_Dummy" VALUE 0x804D93C8 Val_Wu8 30.00 DFES_OneToOne 0.00 30.00 FORMAT "%5.2" EXTENDED_LIMITS 0.00 255.0 /end CHARACTERISTIC
/begin CHARACTERISTIC DFES_Cls.DFC_TUMmax_Dummy_C "fault class per DFC / Fault class for check DFC_TUMmax_Dummy" VALUE 0x804D93C9 Val_Wu8 30.00 DFES_OneToOne 0.00 30.00 FORMAT "%5.2" EXTENDED_LIMITS 0.00 255.0 /end CHARACTERISTIC
/begin CHARACTERISTIC DFES_Cls.DFC_TWCDPriCatB1_C "fault class per DFC / Fault class for check DFC_TWCDPriCatB1" VALUE 0x804D93CA Val_Wu8 30.00 DFES_OneToOne 0.00 30.00 FORMAT "%5.2" EXTENDED_LIMITS 0.00 255.0 /end CHARACTERISTIC
/begin CHARACTERISTIC DFES_Cls.DFC_ThrVlvClsdPosnFirstOffsLrnImpoB1_C "fault class per DFC / Fault class for check DFC_ThrVlvClsdPosnFirstOffsLrnImpoB1" VALUE 0x804D93CB Val_Wu8 30.00 DFES_OneToOne 0.00 30.00 FORMAT "%5.2" EXTENDED_LIMITS 0.00 255.0 /end CHARACTERISTIC
/begin CHARACTERISTIC DFES_Cls.DFC_ThrVlvClsdPosnOffsLrnImpoB1_C "fault class per DFC / Fault class for check DFC_ThrVlvClsdPosnOffsLrnImpoB1" VALUE 0x804D93CC Val_Wu8 30.00 DFES_OneToOne 0.00 30.00 FORMAT "%5.2" EXTENDED_LIMITS 0.00 255.0 /end CHARACTERISTIC
/begin CHARACTERISTIC DFES_Cls.DFC_ThrVlvClsdPosnOffsLrnMaxB1_C "fault class per DFC / Fault class for check DFC_ThrVlvClsdPosnOffsLrnMaxB1" VALUE 0x804D93CD Val_Wu8 30.00 DFES_OneToOne 0.00 30.00 FORMAT "%5.2" EXTENDED_LIMITS 0.00 255.0 /end CHARACTERISTIC
/begin CHARACTERISTIC DFES_Cls.DFC_ThrVlvClsdPosnOffsLrnMinB1_C "fault class per DFC / Fault class for check DFC_ThrVlvClsdPosnOffsLrnMinB1" VALUE 0x804D93CE Val_Wu8 30.00 DFES_OneToOne 0.00 30.00 FORMAT "%5.2" EXTENDED_LIMITS 0.00 255.0 /end CHARACTERISTIC
/begin CHARACTERISTIC DFES_Cls.DFC_ThrVlvCtrlDeB1_C "fault class per DFC / Fault class for check DFC_ThrVlvCtrlDeB1" VALUE 0x804D93CF Val_Wu8 30.00 DFES_OneToOne 0.00 30.00 FORMAT "%5.2" EXTENDED_LIMITS 0.00 255.0 /end CHARACTERISTIC
/begin CHARACTERISTIC DFES_Cls.DFC_ThrVlvDycB1_C "fault class per DFC / Fault class for check DFC_ThrVlvDycB1" VALUE 0x804D93D0 Val_Wu8 30.00 DFES_OneToOne 0.00 30.00 FORMAT "%5.2" EXTENDED_LIMITS 0.00 255.0 /end CHARACTERISTIC
/begin CHARACTERISTIC DFES_Cls.DFC_ThrVlvLimpAirPosnMaxAbsltDriftB1_C "fault class per DFC / Fault class for check DFC_ThrVlvLimpAirPosnMaxAbsltDriftB1" VALUE 0x804D93D1 Val_Wu8 30.00 DFES_OneToOne 0.00 30.00 FORMAT "%5.2" EXTENDED_LIMITS 0.00 255.0 /end CHARACTERISTIC
/begin CHARACTERISTIC DFES_Cls.DFC_ThrVlvLimpAirPosnMaxB1_C "fault class per DFC / Fault class for check DFC_ThrVlvLimpAirPosnMaxB1" VALUE 0x804D93D2 Val_Wu8 30.00 DFES_OneToOne 0.00 30.00 FORMAT "%5.2" EXTENDED_LIMITS 0.00 255.0 /end CHARACTERISTIC
/begin CHARACTERISTIC DFES_Cls.DFC_ThrVlvLimpAirPosnMaxRelDriftB1_C "fault class per DFC / Fault class for check DFC_ThrVlvLimpAirPosnMaxRelDriftB1" VALUE 0x804D93D3 Val_Wu8 30.00 DFES_OneToOne 0.00 30.00 FORMAT "%5.2" EXTENDED_LIMITS 0.00 255.0 /end CHARACTERISTIC
/begin CHARACTERISTIC DFES_Cls.DFC_ThrVlvLimpAirPosnMinB1_C "fault class per DFC / Fault class for check DFC_ThrVlvLimpAirPosnMinB1" VALUE 0x804D93D4 Val_Wu8 30.00 DFES_OneToOne 0.00 30.00 FORMAT "%5.2" EXTENDED_LIMITS 0.00 255.0 /end CHARACTERISTIC
/begin CHARACTERISTIC DFES_Cls.DFC_ThrVlvOpenLoadB1_C "fault class per DFC / Fault class for check DFC_ThrVlvOpenLoadB1" VALUE 0x804D93D5 Val_Wu8 30.00 DFES_OneToOne 0.00 30.00 FORMAT "%5.2" EXTENDED_LIMITS 0.00 255.0 /end CHARACTERISTIC
/begin CHARACTERISTIC DFES_Cls.DFC_ThrVlvOpenSprgB1_C "fault class per DFC / Fault class for check DFC_ThrVlvOpenSprgB1" VALUE 0x804D93D6 Val_Wu8 30.00 DFES_OneToOne 0.00 30.00 FORMAT "%5.2" EXTENDED_LIMITS 0.00 255.0 /end CHARACTERISTIC
/begin CHARACTERISTIC DFES_Cls.DFC_ThrVlvOpenSprgSprdB1_C "fault class per DFC / Fault class for check DFC_ThrVlvOpenSprgSprdB1" VALUE 0x804D93D7 Val_Wu8 30.00 DFES_OneToOne 0.00 30.00 FORMAT "%5.2" EXTENDED_LIMITS 0.00 255.0 /end CHARACTERISTIC
/begin CHARACTERISTIC DFES_Cls.DFC_ThrVlvOpenSprgTwnB1_C "fault class per DFC / Fault class for check DFC_ThrVlvOpenSprgTwnB1" VALUE 0x804D93D8 Val_Wu8 30.00 DFES_OneToOne 0.00 30.00 FORMAT "%5.2" EXTENDED_LIMITS 0.00 255.0 /end CHARACTERISTIC
/begin CHARACTERISTIC DFES_Cls.DFC_ThrVlvOverTB1_C "fault class per DFC / Fault class for check DFC_ThrVlvOverTB1" VALUE 0x804D93D9 Val_Wu8 30.00 DFES_OneToOne 0.00 30.00 FORMAT "%5.2" EXTENDED_LIMITS 0.00 255.0 /end CHARACTERISTIC
/begin CHARACTERISTIC DFES_Cls.DFC_ThrVlvRetSprgB1_C "fault class per DFC / Fault class for check DFC_ThrVlvRetSprgB1" VALUE 0x804D93DA Val_Wu8 30.00 DFES_OneToOne 0.00 30.00 FORMAT "%5.2" EXTENDED_LIMITS 0.00 255.0 /end CHARACTERISTIC
/begin CHARACTERISTIC DFES_Cls.DFC_ThrVlvRetSprgSprdB1_C "fault class per DFC / Fault class for check DFC_ThrVlvRetSprgSprdB1" VALUE 0x804D93DB Val_Wu8 30.00 DFES_OneToOne 0.00 30.00 FORMAT "%5.2" EXTENDED_LIMITS 0.00 255.0 /end CHARACTERISTIC
/begin CHARACTERISTIC DFES_Cls.DFC_ThrVlvRetSprgTwnB1_C "fault class per DFC / Fault class for check DFC_ThrVlvRetSprgTwnB1" VALUE 0x804D93DC Val_Wu8 30.00 DFES_OneToOne 0.00 30.00 FORMAT "%5.2" EXTENDED_LIMITS 0.00 255.0 /end CHARACTERISTIC
/begin CHARACTERISTIC DFES_Cls.DFC_ThrVlvSens1MaxB1_C "fault class per DFC / Fault class for check DFC_ThrVlvSens1MaxB1" VALUE 0x804D93DD Val_Wu8 30.00 DFES_OneToOne 0.00 30.00 FORMAT "%5.2" EXTENDED_LIMITS 0.00 255.0 /end CHARACTERISTIC
/begin CHARACTERISTIC DFES_Cls.DFC_ThrVlvSens1NplB1_C "fault class per DFC / Fault class for check DFC_ThrVlvSens1NplB1" VALUE 0x804D93DE Val_Wu8 30.00 DFES_OneToOne 0.00 30.00 FORMAT "%5.2" EXTENDED_LIMITS 0.00 255.0 /end CHARACTERISTIC
/begin CHARACTERISTIC DFES_Cls.DFC_ThrVlvSens2MaxB1_C "fault class per DFC / Fault class for check DFC_ThrVlvSens2MaxB1" VALUE 0x804D93DF Val_Wu8 30.00 DFES_OneToOne 0.00 30.00 FORMAT "%5.2" EXTENDED_LIMITS 0.00 255.0 /end CHARACTERISTIC
/begin CHARACTERISTIC DFES_Cls.DFC_ThrVlvSens2MinB1_C "fault class per DFC / Fault class for check DFC_ThrVlvSens2MinB1" VALUE 0x804D93E0 Val_Wu8 30.00 DFES_OneToOne 0.00 30.00 FORMAT "%5.2" EXTENDED_LIMITS 0.00 255.0 /end CHARACTERISTIC
/begin CHARACTERISTIC DFES_Cls.DFC_ThrVlvSens2NplB1_C "fault class per DFC / Fault class for check DFC_ThrVlvSens2NplB1" VALUE 0x804D93E1 Val_Wu8 30.00 DFES_OneToOne 0.00 30.00 FORMAT "%5.2" EXTENDED_LIMITS 0.00 255.0 /end CHARACTERISTIC
/begin CHARACTERISTIC DFES_Cls.DFC_ThrVlvShoCircB1_C "fault class per DFC / Fault class for check DFC_ThrVlvShoCircB1" VALUE 0x804D93E2 Val_Wu8 30.00 DFES_OneToOne 0.00 30.00 FORMAT "%5.2" EXTENDED_LIMITS 0.00 255.0 /end CHARACTERISTIC
/begin CHARACTERISTIC DFES_Cls.DFC_ThrVlvSpiErrB1_C "fault class per DFC / Fault class for check DFC_ThrVlvSpiErrB1" VALUE 0x804D93E3 Val_Wu8 30.00 DFES_OneToOne 0.00 30.00 FORMAT "%5.2" EXTENDED_LIMITS 0.00 255.0 /end CHARACTERISTIC
/begin CHARACTERISTIC DFES_Cls.DFC_ThrvlvSens1MinB1_C "fault class per DFC / Fault class for check DFC_ThrvlvSens1MinB1" VALUE 0x804D93E4 Val_Wu8 30.00 DFES_OneToOne 0.00 30.00 FORMAT "%5.2" EXTENDED_LIMITS 0.00 255.0 /end CHARACTERISTIC
/begin CHARACTERISTIC DFES_Cls.DFC_TiOffTBasdChkFast_C "fault class per DFC / Fault class for check DFC_TiOffTBasdChkFast" VALUE 0x804D93E5 Val_Wu8 30.00 DFES_OneToOne 0.00 30.00 FORMAT "%5.2" EXTENDED_LIMITS 0.00 255.0 /end CHARACTERISTIC
/begin CHARACTERISTIC DFES_Cls.DFC_TiOffTBasdChkSlow_C "fault class per DFC / Fault class for check DFC_TiOffTBasdChkSlow" VALUE 0x804D93E6 Val_Wu8 30.00 DFES_OneToOne 0.00 30.00 FORMAT "%5.2" EXTENDED_LIMITS 0.00 255.0 /end CHARACTERISTIC
/begin CHARACTERISTIC DFES_Cls.DFC_UEGOHeatrCtlS1B1_C "fault class per DFC / Fault class for check DFC_UEGOHeatrCtlS1B1" VALUE 0x804D93E7 Val_Wu8 30.00 DFES_OneToOne 0.00 30.00 FORMAT "%5.2" EXTENDED_LIMITS 0.00 255.0 /end CHARACTERISTIC
/begin CHARACTERISTIC DFES_Cls.DFC_UEGOSnsrMntdS1B1_C "fault class per DFC / Fault class for check DFC_UEGOSnsrMntdS1B1" VALUE 0x804D93E8 Val_Wu8 30.00 DFES_OneToOne 0.00 30.00 FORMAT "%5.2" EXTENDED_LIMITS 0.00 255.0 /end CHARACTERISTIC
/begin CHARACTERISTIC DFES_Cls.DFC_VehVSig_C "fault class per DFC / Fault class for check DFC_VehVSig" VALUE 0x804D93E9 Val_Wu8 30.00 DFES_OneToOne 0.00 30.00 FORMAT "%5.2" EXTENDED_LIMITS 0.00 255.0 /end CHARACTERISTIC
/begin CHARACTERISTIC DFES_Cls.DFC_VlvLftFbSwtIntk11SpclFail_C "fault class per DFC / Fault class for check DFC_VlvLftFbSwtIntk11SpclFail" VALUE 0x804D93EA Val_Wu8 30.00 DFES_OneToOne 0.00 30.00 FORMAT "%5.2" EXTENDED_LIMITS 0.00 255.0 /end CHARACTERISTIC
/begin CHARACTERISTIC DFES_Cls.DFC_VlvLftFbSwtIntk11StdFail_C "fault class per DFC / Fault class for check DFC_VlvLftFbSwtIntk11StdFail" VALUE 0x804D93EB Val_Wu8 30.00 DFES_OneToOne 0.00 30.00 FORMAT "%5.2" EXTENDED_LIMITS 0.00 255.0 /end CHARACTERISTIC
/begin CHARACTERISTIC DFES_DbLv_C "Debounce level limit for creating fault entry (valid for all DFCs)" VALUE 0x804D93EC Val_Wu8 15.00 DFES_OneToOne 0.00 15.00 FORMAT "%5.2" EXTENDED_LIMITS 0.00 255.0 /end CHARACTERISTIC
/begin CHARACTERISTIC DFES_DTCO.DFC_Unused_C "OBD specific trouble code / " VALUE 0x804F9304 Val_Wu16 65535.00 DFES_OneToOne 0.00 65535.00 FORMAT "%8.2" READ_ONLY /end CHARACTERISTIC
/begin CHARACTERISTIC DFES_DTCO.DFC_AltIOACGFailr_C "OBD specific trouble code / OBD specific diagnostic trouble code for check DFC_AltIOACGFailr" VALUE 0x804F9306 Val_Wu16 65535.00 DFES_OneToOne 0.00 65535.00 FORMAT "%8.2" /end CHARACTERISTIC
/begin CHARACTERISTIC DFES_DTCO.DFC_AltIOACGHiVltg_C "OBD specific trouble code / OBD specific diagnostic trouble code for check DFC_AltIOACGHiVltg" VALUE 0x804F9308 Val_Wu16 65535.00 DFES_OneToOne 0.00 65535.00 FORMAT "%8.2" /end CHARACTERISTIC
/begin CHARACTERISTIC DFES_DTCO.DFC_AltIOACGLoVltg_C "OBD specific trouble code / OBD specific diagnostic trouble code for check DFC_AltIOACGLoVltg" VALUE 0x804F930A Val_Wu16 65535.00 DFES_OneToOne 0.00 65535.00 FORMAT "%8.2" /end CHARACTERISTIC
/begin CHARACTERISTIC DFES_DTCO.DFC_AltIOACGTHi_C "OBD specific trouble code / OBD specific diagnostic trouble code for check DFC_AltIOACGTHi" VALUE 0x804F930C Val_Wu16 65535.00 DFES_OneToOne 0.00 65535.00 FORMAT "%8.2" /end CHARACTERISTIC
/begin CHARACTERISTIC DFES_DTCO.DFC_AltIODConnACG_C "OBD specific trouble code / OBD specific diagnostic trouble code for check DFC_AltIODConnACG" VALUE 0x804F930E Val_Wu16 65535.00 DFES_OneToOne 0.00 65535.00 FORMAT "%8.2" /end CHARACTERISTIC
/begin CHARACTERISTIC DFES_DTCO.DFC_BattUHiFailr_C "OBD specific trouble code / OBD specific diagnostic trouble code for check DFC_BattUHiFailr" VALUE 0x804F9310 Val_Wu16 65535.00 DFES_OneToOne 0.00 65535.00 FORMAT "%8.2" /end CHARACTERISTIC
/begin CHARACTERISTIC DFES_DTCO.DFC_BattULoFailr_C "OBD specific trouble code / OBD specific diagnostic trouble code for check DFC_BattULoFailr" VALUE 0x804F9312 Val_Wu16 65535.00 DFES_OneToOne 0.00 65535.00 FORMAT "%8.2" /end CHARACTERISTIC
/begin CHARACTERISTIC DFES_DTCO.DFC_BrkBstPDriftHiErr_C "OBD specific trouble code / OBD specific diagnostic trouble code for check DFC_BrkBstPDriftHiErr" VALUE 0x804F9314 Val_Wu16 65535.00 DFES_OneToOne 0.00 65535.00 FORMAT "%8.2" /end CHARACTERISTIC
/begin CHARACTERISTIC DFES_DTCO.DFC_BrkBstPDriftLoErr_C "OBD specific trouble code / OBD specific diagnostic trouble code for check DFC_BrkBstPDriftLoErr" VALUE 0x804F9316 Val_Wu16 65535.00 DFES_OneToOne 0.00 65535.00 FORMAT "%8.2" /end CHARACTERISTIC
/begin CHARACTERISTIC DFES_DTCO.DFC_BrkBstPSnsrStuck_C "OBD specific trouble code / OBD specific diagnostic trouble code for check DFC_BrkBstPSnsrStuck" VALUE 0x804F9318 Val_Wu16 65535.00 DFES_OneToOne 0.00 65535.00 FORMAT "%8.2" /end CHARACTERISTIC
/begin CHARACTERISTIC DFES_DTCO.DFC_BrkMnSwtContOn_C "OBD specific trouble code / OBD specific diagnostic trouble code for check DFC_BrkMnSwtContOn" VALUE 0x804F931A Val_Wu16 65535.00 DFES_OneToOne 0.00 65535.00 FORMAT "%8.2" /end CHARACTERISTIC
/begin CHARACTERISTIC DFES_DTCO.DFC_BrkMnSwtNotStp_C "OBD specific trouble code / OBD specific diagnostic trouble code for check DFC_BrkMnSwtNotStp" VALUE 0x804F931C Val_Wu16 65535.00 DFES_OneToOne 0.00 65535.00 FORMAT "%8.2" /end CHARACTERISTIC
/begin CHARACTERISTIC DFES_DTCO.DFC_BrkNpl_C "OBD specific trouble code / OBD specific diagnostic trouble code for check DFC_BrkNpl" VALUE 0x804F931E Val_Wu16 65535.00 DFES_OneToOne 0.00 65535.00 FORMAT "%8.2" /end CHARACTERISTIC
/begin CHARACTERISTIC DFES_DTCO.DFC_BrkRdntSwtContOn_C "OBD specific trouble code / OBD specific diagnostic trouble code for check DFC_BrkRdntSwtContOn" VALUE 0x804F9320 Val_Wu16 65535.00 DFES_OneToOne 0.00 65535.00 FORMAT "%8.2" /end CHARACTERISTIC
/begin CHARACTERISTIC DFES_DTCO.DFC_BrkRdntSwtNotStp_C "OBD specific trouble code / OBD specific diagnostic trouble code for check DFC_BrkRdntSwtNotStp" VALUE 0x804F9322 Val_Wu16 65535.00 DFES_OneToOne 0.00 65535.00 FORMAT "%8.2" /end CHARACTERISTIC
/begin CHARACTERISTIC DFES_DTCO.DFC_Clth3ONStuck_C "OBD specific trouble code / OBD specific diagnostic trouble code for check DFC_Clth3ONStuck" VALUE 0x804F9324 Val_Wu16 65535.00 DFES_OneToOne 0.00 65535.00 FORMAT "%8.2" /end CHARACTERISTIC
/begin CHARACTERISTIC DFES_DTCO.DFC_Clth4OFFStuck_C "OBD specific trouble code / OBD specific diagnostic trouble code for check DFC_Clth4OFFStuck" VALUE 0x804F9326 Val_Wu16 65535.00 DFES_OneToOne 0.00 65535.00 FORMAT "%8.2" /end CHARACTERISTIC
/begin CHARACTERISTIC DFES_DTCO.DFC_ClthOFFStuck_C "OBD specific trouble code / OBD specific diagnostic trouble code for check DFC_ClthOFFStuck" VALUE 0x804F9328 Val_Wu16 65535.00 DFES_OneToOne 0.00 65535.00 FORMAT "%8.2" /end CHARACTERISTIC
/begin CHARACTERISTIC DFES_DTCO.DFC_ClthONStuck_C "OBD specific trouble code / OBD specific diagnostic trouble code for check DFC_ClthONStuck" VALUE 0x804F932A Val_Wu16 65535.00 DFES_OneToOne 0.00 65535.00 FORMAT "%8.2" /end CHARACTERISTIC
/begin CHARACTERISTIC DFES_DTCO.DFC_ClthStkFailInfo_C "OBD specific trouble code / OBD specific diagnostic trouble code for check DFC_ClthStkFailInfo" VALUE 0x804F932C Val_Wu16 65535.00 DFES_OneToOne 0.00 65535.00 FORMAT "%8.2" /end CHARACTERISTIC
/begin CHARACTERISTIC DFES_DTCO.DFC_ComACFailInfo_C "OBD specific trouble code / OBD specific diagnostic trouble code for check DFC_ComACFailInfo" VALUE 0x804F932E Val_Wu16 65535.00 DFES_OneToOne 0.00 65535.00 FORMAT "%8.2" /end CHARACTERISTIC
/begin CHARACTERISTIC DFES_DTCO.DFC_ComATFTValErr_C "OBD specific trouble code / OBD specific diagnostic trouble code for check DFC_ComATFTValErr" VALUE 0x804F9330 Val_Wu16 65535.00 DFES_OneToOne 0.00 65535.00 FORMAT "%8.2" /end CHARACTERISTIC
/begin CHARACTERISTIC DFES_DTCO.DFC_ComATMILReq_C "OBD specific trouble code / OBD specific diagnostic trouble code for check DFC_ComATMILReq" VALUE 0x804F9332 Val_Wu16 65535.00 DFES_OneToOne 0.00 65535.00 FORMAT "%8.2" /end CHARACTERISTIC
/begin CHARACTERISTIC DFES_DTCO.DFC_ComAYCAChksum_C "OBD specific trouble code / OBD specific diagnostic trouble code for check DFC_ComAYCAChksum" VALUE 0x804F9334 Val_Wu16 65535.00 DFES_OneToOne 0.00 65535.00 FORMAT "%8.2" /end CHARACTERISTIC
/begin CHARACTERISTIC DFES_DTCO.DFC_ComAYCARingCnt_C "OBD specific trouble code / OBD specific diagnostic trouble code for check DFC_ComAYCARingCnt" VALUE 0x804F9336 Val_Wu16 65535.00 DFES_OneToOne 0.00 65535.00 FORMAT "%8.2" /end CHARACTERISTIC
/begin CHARACTERISTIC DFES_DTCO.DFC_ComAYCATOut_C "OBD specific trouble code / OBD specific diagnostic trouble code for check DFC_ComAYCATOut" VALUE 0x804F9338 Val_Wu16 65535.00 DFES_OneToOne 0.00 65535.00 FORMAT "%8.2" /end CHARACTERISTIC
/begin CHARACTERISTIC DFES_DTCO.DFC_ComAYCDChkSum_C "OBD specific trouble code / OBD specific diagnostic trouble code for check DFC_ComAYCDChkSum" VALUE 0x804F933A Val_Wu16 65535.00 DFES_OneToOne 0.00 65535.00 FORMAT "%8.2" /end CHARACTERISTIC
/begin CHARACTERISTIC DFES_DTCO.DFC_ComAYCDTOut_C "OBD specific trouble code / OBD specific diagnostic trouble code for check DFC_ComAYCDTOut" VALUE 0x804F933C Val_Wu16 65535.00 DFES_OneToOne 0.00 65535.00 FORMAT "%8.2" /end CHARACTERISTIC
/begin CHARACTERISTIC DFES_DTCO.DFC_ComAYCFChksum_C "OBD specific trouble code / OBD specific diagnostic trouble code for check DFC_ComAYCFChksum" VALUE 0x804F933E Val_Wu16 65535.00 DFES_OneToOne 0.00 65535.00 FORMAT "%8.2" /end CHARACTERISTIC
/begin CHARACTERISTIC DFES_DTCO.DFC_ComAYCFRingCnt_C "OBD specific trouble code / OBD specific diagnostic trouble code for check DFC_ComAYCFRingCnt" VALUE 0x804F9340 Val_Wu16 65535.00 DFES_OneToOne 0.00 65535.00 FORMAT "%8.2" /end CHARACTERISTIC
/begin CHARACTERISTIC DFES_DTCO.DFC_ComAYCFTOut_C "OBD specific trouble code / OBD specific diagnostic trouble code for check DFC_ComAYCFTOut" VALUE 0x804F9342 Val_Wu16 65535.00 DFES_OneToOne 0.00 65535.00 FORMAT "%8.2" /end CHARACTERISTIC
/begin CHARACTERISTIC DFES_DTCO.DFC_ComAYCGChksum_C "OBD specific trouble code / OBD specific diagnostic trouble code for check DFC_ComAYCGChksum" VALUE 0x804F9344 Val_Wu16 65535.00 DFES_OneToOne 0.00 65535.00 FORMAT "%8.2" /end CHARACTERISTIC
/begin CHARACTERISTIC DFES_DTCO.DFC_ComAYCGRingCnt_C "OBD specific trouble code / OBD specific diagnostic trouble code for check DFC_ComAYCGRingCnt" VALUE 0x804F9346 Val_Wu16 65535.00 DFES_OneToOne 0.00 65535.00 FORMAT "%8.2" /end CHARACTERISTIC
/begin CHARACTERISTIC DFES_DTCO.DFC_ComAYCGTOut_C "OBD specific trouble code / OBD specific diagnostic trouble code for check DFC_ComAYCGTOut" VALUE 0x804F9348 Val_Wu16 65535.00 DFES_OneToOne 0.00 65535.00 FORMAT "%8.2" /end CHARACTERISTIC
/begin CHARACTERISTIC DFES_DTCO.DFC_ComAYCIChkSum_C "OBD specific trouble code / OBD specific diagnostic trouble code for check DFC_ComAYCIChkSum" VALUE 0x804F934A Val_Wu16 65535.00 DFES_OneToOne 0.00 65535.00 FORMAT "%8.2" /end CHARACTERISTIC
/begin CHARACTERISTIC DFES_DTCO.DFC_ComAYCIRingCnt_C "OBD specific trouble code / OBD specific diagnostic trouble code for check DFC_ComAYCIRingCnt" VALUE 0x804F934C Val_Wu16 65535.00 DFES_OneToOne 0.00 65535.00 FORMAT "%8.2" /end CHARACTERISTIC
/begin CHARACTERISTIC DFES_DTCO.DFC_ComAYCITOut_C "OBD specific trouble code / OBD specific diagnostic trouble code for check DFC_ComAYCITOut" VALUE 0x804F934E Val_Wu16 65535.00 DFES_OneToOne 0.00 65535.00 FORMAT "%8.2" /end CHARACTERISTIC
/begin CHARACTERISTIC DFES_DTCO.DFC_ComBCM1ChkSum_C "OBD specific trouble code / OBD specific diagnostic trouble code for check DFC_ComBCM1ChkSum" VALUE 0x804F9350 Val_Wu16 65535.00 DFES_OneToOne 0.00 65535.00 FORMAT "%8.2" /end CHARACTERISTIC
/begin CHARACTERISTIC DFES_DTCO.DFC_ComBCM1RingCnt_C "OBD specific trouble code / OBD specific diagnostic trouble code for check DFC_ComBCM1RingCnt" VALUE 0x804F9352 Val_Wu16 65535.00 DFES_OneToOne 0.00 65535.00 FORMAT "%8.2" /end CHARACTERISTIC
/begin CHARACTERISTIC DFES_DTCO.DFC_ComBCM1TOut_C "OBD specific trouble code / OBD specific diagnostic trouble code for check DFC_ComBCM1TOut" VALUE 0x804F9354 Val_Wu16 65535.00 DFES_OneToOne 0.00 65535.00 FORMAT "%8.2" /end CHARACTERISTIC
/begin CHARACTERISTIC DFES_DTCO.DFC_ComCANABusOffErr_C "OBD specific trouble code / OBD specific diagnostic trouble code for check DFC_ComCANABusOffErr" VALUE 0x804F9356 Val_Wu16 65535.00 DFES_OneToOne 0.00 65535.00 FORMAT "%8.2" /end CHARACTERISTIC
/begin CHARACTERISTIC DFES_DTCO.DFC_ComCANBBusOffErr_C "OBD specific trouble code / OBD specific diagnostic trouble code for check DFC_ComCANBBusOffErr" VALUE 0x804F9358 Val_Wu16 65535.00 DFES_OneToOne 0.00 65535.00 FORMAT "%8.2" /end CHARACTERISTIC
/begin CHARACTERISTIC DFES_DTCO.DFC_ComCANCBusOffErr_C "OBD specific trouble code / OBD specific diagnostic trouble code for check DFC_ComCANCBusOffErr" VALUE 0x804F935A Val_Wu16 65535.00 DFES_OneToOne 0.00 65535.00 FORMAT "%8.2" /end CHARACTERISTIC
/begin CHARACTERISTIC DFES_DTCO.DFC_ComCGW1ChkSum_C "OBD specific trouble code / OBD specific diagnostic trouble code for check DFC_ComCGW1ChkSum" VALUE 0x804F935C Val_Wu16 65535.00 DFES_OneToOne 0.00 65535.00 FORMAT "%8.2" /end CHARACTERISTIC
/begin CHARACTERISTIC DFES_DTCO.DFC_ComCGW1RingCnt_C "OBD specific trouble code / OBD specific diagnostic trouble code for check DFC_ComCGW1RingCnt" VALUE 0x804F935E Val_Wu16 65535.00 DFES_OneToOne 0.00 65535.00 FORMAT "%8.2" /end CHARACTERISTIC
/begin CHARACTERISTIC DFES_DTCO.DFC_ComCGW1TOut_C "OBD specific trouble code / OBD specific diagnostic trouble code for check DFC_ComCGW1TOut" VALUE 0x804F9360 Val_Wu16 65535.00 DFES_OneToOne 0.00 65535.00 FORMAT "%8.2" /end CHARACTERISTIC
/begin CHARACTERISTIC DFES_DTCO.DFC_ComConvBoostErr_C "OBD specific trouble code / OBD specific diagnostic trouble code for check DFC_ComConvBoostErr" VALUE 0x804F9362 Val_Wu16 65535.00 DFES_OneToOne 0.00 65535.00 FORMAT "%8.2" /end CHARACTERISTIC
/begin CHARACTERISTIC DFES_DTCO.DFC_ComConvSlipErr_C "OBD specific trouble code / OBD specific diagnostic trouble code for check DFC_ComConvSlipErr" VALUE 0x804F9364 Val_Wu16 65535.00 DFES_OneToOne 0.00 65535.00 FORMAT "%8.2" /end CHARACTERISTIC
/begin CHARACTERISTIC DFES_DTCO.DFC_ComEAT10Chksum_C "OBD specific trouble code / OBD specific diagnostic trouble code for check DFC_ComEAT10Chksum" VALUE 0x804F9366 Val_Wu16 65535.00 DFES_OneToOne 0.00 65535.00 FORMAT "%8.2" /end CHARACTERISTIC
/begin CHARACTERISTIC DFES_DTCO.DFC_ComEAT10RingCnt_C "OBD specific trouble code / OBD specific diagnostic trouble code for check DFC_ComEAT10RingCnt" VALUE 0x804F9368 Val_Wu16 65535.00 DFES_OneToOne 0.00 65535.00 FORMAT "%8.2" /end CHARACTERISTIC
/begin CHARACTERISTIC DFES_DTCO.DFC_ComEAT10TOut_C "OBD specific trouble code / OBD specific diagnostic trouble code for check DFC_ComEAT10TOut" VALUE 0x804F936A Val_Wu16 65535.00 DFES_OneToOne 0.00 65535.00 FORMAT "%8.2" /end CHARACTERISTIC
/begin CHARACTERISTIC DFES_DTCO.DFC_ComEAT11ChkSum_C "OBD specific trouble code / OBD specific diagnostic trouble code for check DFC_ComEAT11ChkSum" VALUE 0x804F936C Val_Wu16 65535.00 DFES_OneToOne 0.00 65535.00 FORMAT "%8.2" /end CHARACTERISTIC
/begin CHARACTERISTIC DFES_DTCO.DFC_ComEAT11RingCnt_C "OBD specific trouble code / OBD specific diagnostic trouble code for check DFC_ComEAT11RingCnt" VALUE 0x804F936E Val_Wu16 65535.00 DFES_OneToOne 0.00 65535.00 FORMAT "%8.2" /end CHARACTERISTIC
/begin CHARACTERISTIC DFES_DTCO.DFC_ComEAT11TOut_C "OBD specific trouble code / OBD specific diagnostic trouble code for check DFC_ComEAT11TOut" VALUE 0x804F9370 Val_Wu16 65535.00 DFES_OneToOne 0.00 65535.00 FORMAT "%8.2" /end CHARACTERISTIC
/begin CHARACTERISTIC DFES_DTCO.DFC_ComEAT12ChkSum_C "OBD specific trouble code / OBD specific diagnostic trouble code for check DFC_ComEAT12ChkSum" VALUE 0x804F9372 Val_Wu16 65535.00 DFES_OneToOne 0.00 65535.00 FORMAT "%8.2" /end CHARACTERISTIC
/begin CHARACTERISTIC DFES_DTCO.DFC_ComEAT12RingCnt_C "OBD specific trouble code / OBD specific diagnostic trouble code for check DFC_ComEAT12RingCnt" VALUE 0x804F9374 Val_Wu16 65535.00 DFES_OneToOne 0.00 65535.00 FORMAT "%8.2" /end CHARACTERISTIC
/begin CHARACTERISTIC DFES_DTCO.DFC_ComEAT12TOut_C "OBD specific trouble code / OBD specific diagnostic trouble code for check DFC_ComEAT12TOut" VALUE 0x804F9376 Val_Wu16 65535.00 DFES_OneToOne 0.00 65535.00 FORMAT "%8.2" /end CHARACTERISTIC
/begin CHARACTERISTIC DFES_DTCO.DFC_ComEAT13ChkSum_C "OBD specific trouble code / OBD specific diagnostic trouble code for check DFC_ComEAT13ChkSum" VALUE 0x804F9378 Val_Wu16 65535.00 DFES_OneToOne 0.00 65535.00 FORMAT "%8.2" /end CHARACTERISTIC
/begin CHARACTERISTIC DFES_DTCO.DFC_ComEAT13RingCnt_C "OBD specific trouble code / OBD specific diagnostic trouble code for check DFC_ComEAT13RingCnt" VALUE 0x804F937A Val_Wu16 65535.00 DFES_OneToOne 0.00 65535.00 FORMAT "%8.2" /end CHARACTERISTIC
/begin CHARACTERISTIC DFES_DTCO.DFC_ComEAT13TOut_C "OBD specific trouble code / OBD specific diagnostic trouble code for check DFC_ComEAT13TOut" VALUE 0x804F937C Val_Wu16 65535.00 DFES_OneToOne 0.00 65535.00 FORMAT "%8.2" /end CHARACTERISTIC
/begin CHARACTERISTIC DFES_DTCO.DFC_ComEAT1Chksum_C "OBD specific trouble code / OBD specific diagnostic trouble code for check DFC_ComEAT1Chksum" VALUE 0x804F937E Val_Wu16 65535.00 DFES_OneToOne 0.00 65535.00 FORMAT "%8.2" /end CHARACTERISTIC
/begin CHARACTERISTIC DFES_DTCO.DFC_ComEAT1RingCnt_C "OBD specific trouble code / OBD specific diagnostic trouble code for check DFC_ComEAT1RingCnt" VALUE 0x804F9380 Val_Wu16 65535.00 DFES_OneToOne 0.00 65535.00 FORMAT "%8.2" /end CHARACTERISTIC
/begin CHARACTERISTIC DFES_DTCO.DFC_ComEAT1TOut_C "OBD specific trouble code / OBD specific diagnostic trouble code for check DFC_ComEAT1TOut" VALUE 0x804F9382 Val_Wu16 65535.00 DFES_OneToOne 0.00 65535.00 FORMAT "%8.2" /end CHARACTERISTIC
/begin CHARACTERISTIC DFES_DTCO.DFC_ComEAT2ChkSum_C "OBD specific trouble code / OBD specific diagnostic trouble code for check DFC_ComEAT2ChkSum" VALUE 0x804F9384 Val_Wu16 65535.00 DFES_OneToOne 0.00 65535.00 FORMAT "%8.2" /end CHARACTERISTIC
/begin CHARACTERISTIC DFES_DTCO.DFC_ComEAT2RingCnt_C "OBD specific trouble code / OBD specific diagnostic trouble code for check DFC_ComEAT2RingCnt" VALUE 0x804F9386 Val_Wu16 65535.00 DFES_OneToOne 0.00 65535.00 FORMAT "%8.2" /end CHARACTERISTIC
/begin CHARACTERISTIC DFES_DTCO.DFC_ComEAT2TOut_C "OBD specific trouble code / OBD specific diagnostic trouble code for check DFC_ComEAT2TOut" VALUE 0x804F9388 Val_Wu16 65535.00 DFES_OneToOne 0.00 65535.00 FORMAT "%8.2" /end CHARACTERISTIC
/begin CHARACTERISTIC DFES_DTCO.DFC_ComEAT4ChkSum_C "OBD specific trouble code / OBD specific diagnostic trouble code for check DFC_ComEAT4ChkSum" VALUE 0x804F938A Val_Wu16 65535.00 DFES_OneToOne 0.00 65535.00 FORMAT "%8.2" /end CHARACTERISTIC
/begin CHARACTERISTIC DFES_DTCO.DFC_ComEAT4RingCnt_C "OBD specific trouble code / OBD specific diagnostic trouble code for check DFC_ComEAT4RingCnt" VALUE 0x804F938C Val_Wu16 65535.00 DFES_OneToOne 0.00 65535.00 FORMAT "%8.2" /end CHARACTERISTIC
/begin CHARACTERISTIC DFES_DTCO.DFC_ComEAT4TOut_C "OBD specific trouble code / OBD specific diagnostic trouble code for check DFC_ComEAT4TOut" VALUE 0x804F938E Val_Wu16 65535.00 DFES_OneToOne 0.00 65535.00 FORMAT "%8.2" /end CHARACTERISTIC
/begin CHARACTERISTIC DFES_DTCO.DFC_ComEAT6Chksum_C "OBD specific trouble code / OBD specific diagnostic trouble code for check DFC_ComEAT6Chksum" VALUE 0x804F9390 Val_Wu16 65535.00 DFES_OneToOne 0.00 65535.00 FORMAT "%8.2" /end CHARACTERISTIC
/begin CHARACTERISTIC DFES_DTCO.DFC_ComEAT6RingCnt_C "OBD specific trouble code / OBD specific diagnostic trouble code for check DFC_ComEAT6RingCnt" VALUE 0x804F9392 Val_Wu16 65535.00 DFES_OneToOne 0.00 65535.00 FORMAT "%8.2" /end CHARACTERISTIC
/begin CHARACTERISTIC DFES_DTCO.DFC_ComEAT6TOut_C "OBD specific trouble code / OBD specific diagnostic trouble code for check DFC_ComEAT6TOut" VALUE 0x804F9394 Val_Wu16 65535.00 DFES_OneToOne 0.00 65535.00 FORMAT "%8.2" /end CHARACTERISTIC
/begin CHARACTERISTIC DFES_DTCO.DFC_ComEAT7Chksum_C "OBD specific trouble code / OBD specific diagnostic trouble code for check DFC_ComEAT7Chksum" VALUE 0x804F9396 Val_Wu16 65535.00 DFES_OneToOne 0.00 65535.00 FORMAT "%8.2" /end CHARACTERISTIC
/begin CHARACTERISTIC DFES_DTCO.DFC_ComEAT7RingCnt_C "OBD specific trouble code / OBD specific diagnostic trouble code for check DFC_ComEAT7RingCnt" VALUE 0x804F9398 Val_Wu16 65535.00 DFES_OneToOne 0.00 65535.00 FORMAT "%8.2" /end CHARACTERISTIC
/begin CHARACTERISTIC DFES_DTCO.DFC_ComEAT7TOut_C "OBD specific trouble code / OBD specific diagnostic trouble code for check DFC_ComEAT7TOut" VALUE 0x804F939A Val_Wu16 65535.00 DFES_OneToOne 0.00 65535.00 FORMAT "%8.2" /end CHARACTERISTIC
/begin CHARACTERISTIC DFES_DTCO.DFC_ComEAT8Chksum_C "OBD specific trouble code / OBD specific diagnostic trouble code for check DFC_ComEAT8Chksum" VALUE 0x804F939C Val_Wu16 65535.00 DFES_OneToOne 0.00 65535.00 FORMAT "%8.2" /end CHARACTERISTIC
/begin CHARACTERISTIC DFES_DTCO.DFC_ComEAT8RingCnt_C "OBD specific trouble code / OBD specific diagnostic trouble code for check DFC_ComEAT8RingCnt" VALUE 0x804F939E Val_Wu16 65535.00 DFES_OneToOne 0.00 65535.00 FORMAT "%8.2" /end CHARACTERISTIC
/begin CHARACTERISTIC DFES_DTCO.DFC_ComEAT8TOut_C "OBD specific trouble code / OBD specific diagnostic trouble code for check DFC_ComEAT8TOut" VALUE 0x804F93A0 Val_Wu16 65535.00 DFES_OneToOne 0.00 65535.00 FORMAT "%8.2" /end CHARACTERISTIC
/begin CHARACTERISTIC DFES_DTCO.DFC_ComEATAChksum_C "OBD specific trouble code / OBD specific diagnostic trouble code for check DFC_ComEATAChksum" VALUE 0x804F93A2 Val_Wu16 65535.00 DFES_OneToOne 0.00 65535.00 FORMAT "%8.2" /end CHARACTERISTIC
/begin CHARACTERISTIC DFES_DTCO.DFC_ComEATARingCnt_C "OBD specific trouble code / OBD specific diagnostic trouble code for check DFC_ComEATARingCnt" VALUE 0x804F93A4 Val_Wu16 65535.00 DFES_OneToOne 0.00 65535.00 FORMAT "%8.2" /end CHARACTERISTIC
/begin CHARACTERISTIC DFES_DTCO.DFC_ComEATATOut_C "OBD specific trouble code / OBD specific diagnostic trouble code for check DFC_ComEATATOut" VALUE 0x804F93A6 Val_Wu16 65535.00 DFES_OneToOne 0.00 65535.00 FORMAT "%8.2" /end CHARACTERISTIC
/begin CHARACTERISTIC DFES_DTCO.DFC_ComEATBChkSum_C "OBD specific trouble code / OBD specific diagnostic trouble code for check DFC_ComEATBChkSum" VALUE 0x804F93A8 Val_Wu16 65535.00 DFES_OneToOne 0.00 65535.00 FORMAT "%8.2" /end CHARACTERISTIC
/begin CHARACTERISTIC DFES_DTCO.DFC_ComEATBRingCnt_C "OBD specific trouble code / OBD specific diagnostic trouble code for check DFC_ComEATBRingCnt" VALUE 0x804F93AA Val_Wu16 65535.00 DFES_OneToOne 0.00 65535.00 FORMAT "%8.2" /end CHARACTERISTIC
/begin CHARACTERISTIC DFES_DTCO.DFC_ComEATBTOut_C "OBD specific trouble code / OBD specific diagnostic trouble code for check DFC_ComEATBTOut" VALUE 0x804F93AC Val_Wu16 65535.00 DFES_OneToOne 0.00 65535.00 FORMAT "%8.2" /end CHARACTERISTIC
/begin CHARACTERISTIC DFES_DTCO.DFC_ComEATCChksum_C "OBD specific trouble code / OBD specific diagnostic trouble code for check DFC_ComEATCChksum" VALUE 0x804F93AE Val_Wu16 65535.00 DFES_OneToOne 0.00 65535.00 FORMAT "%8.2" /end CHARACTERISTIC
/begin CHARACTERISTIC DFES_DTCO.DFC_ComEATCRingCnt_C "OBD specific trouble code / OBD specific diagnostic trouble code for check DFC_ComEATCRingCnt" VALUE 0x804F93B0 Val_Wu16 65535.00 DFES_OneToOne 0.00 65535.00 FORMAT "%8.2" /end CHARACTERISTIC
/begin CHARACTERISTIC DFES_DTCO.DFC_ComEATCTOut_C "OBD specific trouble code / OBD specific diagnostic trouble code for check DFC_ComEATCTOut" VALUE 0x804F93B2 Val_Wu16 65535.00 DFES_OneToOne 0.00 65535.00 FORMAT "%8.2" /end CHARACTERISTIC
/begin CHARACTERISTIC DFES_DTCO.DFC_ComEBBAChksum_C "OBD specific trouble code / OBD specific diagnostic trouble code for check DFC_ComEBBAChksum" VALUE 0x804F93B4 Val_Wu16 65535.00 DFES_OneToOne 0.00 65535.00 FORMAT "%8.2" /end CHARACTERISTIC
/begin CHARACTERISTIC DFES_DTCO.DFC_ComEBBARingCnt_C "OBD specific trouble code / OBD specific diagnostic trouble code for check DFC_ComEBBARingCnt" VALUE 0x804F93B6 Val_Wu16 65535.00 DFES_OneToOne 0.00 65535.00 FORMAT "%8.2" /end CHARACTERISTIC
/begin CHARACTERISTIC DFES_DTCO.DFC_ComEBBATOut_C "OBD specific trouble code / OBD specific diagnostic trouble code for check DFC_ComEBBATOut" VALUE 0x804F93B8 Val_Wu16 65535.00 DFES_OneToOne 0.00 65535.00 FORMAT "%8.2" /end CHARACTERISTIC
/begin CHARACTERISTIC DFES_DTCO.DFC_ComEPS1Chksum_C "OBD specific trouble code / OBD specific diagnostic trouble code for check DFC_ComEPS1Chksum" VALUE 0x804F93BA Val_Wu16 65535.00 DFES_OneToOne 0.00 65535.00 FORMAT "%8.2" /end CHARACTERISTIC
/begin CHARACTERISTIC DFES_DTCO.DFC_ComEPS1RingCnt_C "OBD specific trouble code / OBD specific diagnostic trouble code for check DFC_ComEPS1RingCnt" VALUE 0x804F93BC Val_Wu16 65535.00 DFES_OneToOne 0.00 65535.00 FORMAT "%8.2" /end CHARACTERISTIC
/begin CHARACTERISTIC DFES_DTCO.DFC_ComEPS1TOut_C "OBD specific trouble code / OBD specific diagnostic trouble code for check DFC_ComEPS1TOut" VALUE 0x804F93BE Val_Wu16 65535.00 DFES_OneToOne 0.00 65535.00 FORMAT "%8.2" /end CHARACTERISTIC
/begin CHARACTERISTIC DFES_DTCO.DFC_ComEngCanRxErr_C "OBD specific trouble code / OBD specific diagnostic trouble code for check DFC_ComEngCanRxErr" VALUE 0x804F93C0 Val_Wu16 65535.00 DFES_OneToOne 0.00 65535.00 FORMAT "%8.2" /end CHARACTERISTIC
/begin CHARACTERISTIC DFES_DTCO.DFC_ComGrvySnsrErr_C "OBD specific trouble code / OBD specific diagnostic trouble code for check DFC_ComGrvySnsrErr" VALUE 0x804F93C2 Val_Wu16 65535.00 DFES_OneToOne 0.00 65535.00 FORMAT "%8.2" /end CHARACTERISTIC
/begin CHARACTERISTIC DFES_DTCO.DFC_ComGwIMG1ChkSum_C "OBD specific trouble code / OBD specific diagnostic trouble code for check DFC_ComGwIMG1ChkSum" VALUE 0x804F93C4 Val_Wu16 65535.00 DFES_OneToOne 0.00 65535.00 FORMAT "%8.2" /end CHARACTERISTIC
/begin CHARACTERISTIC DFES_DTCO.DFC_ComGwIMG1RingCnt_C "OBD specific trouble code / OBD specific diagnostic trouble code for check DFC_ComGwIMG1RingCnt" VALUE 0x804F93C6 Val_Wu16 65535.00 DFES_OneToOne 0.00 65535.00 FORMAT "%8.2" /end CHARACTERISTIC
/begin CHARACTERISTIC DFES_DTCO.DFC_ComGwIMG1TOut_C "OBD specific trouble code / OBD specific diagnostic trouble code for check DFC_ComGwIMG1TOut" VALUE 0x804F93C8 Val_Wu16 65535.00 DFES_OneToOne 0.00 65535.00 FORMAT "%8.2" /end CHARACTERISTIC
/begin CHARACTERISTIC DFES_DTCO.DFC_ComGwIMG3ChkSum_C "OBD specific trouble code / OBD specific diagnostic trouble code for check DFC_ComGwIMG3ChkSum" VALUE 0x804F93CA Val_Wu16 65535.00 DFES_OneToOne 0.00 65535.00 FORMAT "%8.2" /end CHARACTERISTIC
/begin CHARACTERISTIC DFES_DTCO.DFC_ComGwIMG3RingCnt_C "OBD specific trouble code / OBD specific diagnostic trouble code for check DFC_ComGwIMG3RingCnt" VALUE 0x804F93CC Val_Wu16 65535.00 DFES_OneToOne 0.00 65535.00 FORMAT "%8.2" /end CHARACTERISTIC
/begin CHARACTERISTIC DFES_DTCO.DFC_ComGwIMG3TOut_C "OBD specific trouble code / OBD specific diagnostic trouble code for check DFC_ComGwIMG3TOut" VALUE 0x804F93CE Val_Wu16 65535.00 DFES_OneToOne 0.00 65535.00 FORMAT "%8.2" /end CHARACTERISTIC
/begin CHARACTERISTIC DFES_DTCO.DFC_ComGwIMG4ChkSum_C "OBD specific trouble code / OBD specific diagnostic trouble code for check DFC_ComGwIMG4ChkSum" VALUE 0x804F93D0 Val_Wu16 65535.00 DFES_OneToOne 0.00 65535.00 FORMAT "%8.2" /end CHARACTERISTIC
/begin CHARACTERISTIC DFES_DTCO.DFC_ComGwIMG4RingCnt_C "OBD specific trouble code / OBD specific diagnostic trouble code for check DFC_ComGwIMG4RingCnt" VALUE 0x804F93D2 Val_Wu16 65535.00 DFES_OneToOne 0.00 65535.00 FORMAT "%8.2" /end CHARACTERISTIC
/begin CHARACTERISTIC DFES_DTCO.DFC_ComGwIMG4TOut_C "OBD specific trouble code / OBD specific diagnostic trouble code for check DFC_ComGwIMG4TOut" VALUE 0x804F93D4 Val_Wu16 65535.00 DFES_OneToOne 0.00 65535.00 FORMAT "%8.2" /end CHARACTERISTIC
/begin CHARACTERISTIC DFES_DTCO.DFC_ComGwIMG5ChkSum_C "OBD specific trouble code / OBD specific diagnostic trouble code for check DFC_ComGwIMG5ChkSum" VALUE 0x804F93D6 Val_Wu16 65535.00 DFES_OneToOne 0.00 65535.00 FORMAT "%8.2" /end CHARACTERISTIC
/begin CHARACTERISTIC DFES_DTCO.DFC_ComGwIMG5RingCnt_C "OBD specific trouble code / OBD specific diagnostic trouble code for check DFC_ComGwIMG5RingCnt" VALUE 0x804F93D8 Val_Wu16 65535.00 DFES_OneToOne 0.00 65535.00 FORMAT "%8.2" /end CHARACTERISTIC
/begin CHARACTERISTIC DFES_DTCO.DFC_ComGwIMG5TOut_C "OBD specific trouble code / OBD specific diagnostic trouble code for check DFC_ComGwIMG5TOut" VALUE 0x804F93DA Val_Wu16 65535.00 DFES_OneToOne 0.00 65535.00 FORMAT "%8.2" /end CHARACTERISTIC
/begin CHARACTERISTIC DFES_DTCO.DFC_ComGwIMG6ChkSum_C "OBD specific trouble code / OBD specific diagnostic trouble code for check DFC_ComGwIMG6ChkSum" VALUE 0x804F93DC Val_Wu16 65535.00 DFES_OneToOne 0.00 65535.00 FORMAT "%8.2" /end CHARACTERISTIC
/begin CHARACTERISTIC DFES_DTCO.DFC_ComGwIMG6RingCnt_C "OBD specific trouble code / OBD specific diagnostic trouble code for check DFC_ComGwIMG6RingCnt" VALUE 0x804F93DE Val_Wu16 65535.00 DFES_OneToOne 0.00 65535.00 FORMAT "%8.2" /end CHARACTERISTIC
/begin CHARACTERISTIC DFES_DTCO.DFC_ComGwIMG6TOut_C "OBD specific trouble code / OBD specific diagnostic trouble code for check DFC_ComGwIMG6TOut" VALUE 0x804F93E0 Val_Wu16 65535.00 DFES_OneToOne 0.00 65535.00 FORMAT "%8.2" /end CHARACTERISTIC
/begin CHARACTERISTIC DFES_DTCO.DFC_ComIDASBChksum_C "OBD specific trouble code / OBD specific diagnostic trouble code for check DFC_ComIDASBChksum" VALUE 0x804F93E2 Val_Wu16 65535.00 DFES_OneToOne 0.00 65535.00 FORMAT "%8.2" /end CHARACTERISTIC
/begin CHARACTERISTIC DFES_DTCO.DFC_ComIDASBRingCnt_C "OBD specific trouble code / OBD specific diagnostic trouble code for check DFC_ComIDASBRingCnt" VALUE 0x804F93E4 Val_Wu16 65535.00 DFES_OneToOne 0.00 65535.00 FORMAT "%8.2" /end CHARACTERISTIC
/begin CHARACTERISTIC DFES_DTCO.DFC_ComIDASBTOut_C "OBD specific trouble code / OBD specific diagnostic trouble code for check DFC_ComIDASBTOut" VALUE 0x804F93E6 Val_Wu16 65535.00 DFES_OneToOne 0.00 65535.00 FORMAT "%8.2" /end CHARACTERISTIC
/begin CHARACTERISTIC DFES_DTCO.DFC_ComIMGMILReq_C "OBD specific trouble code / OBD specific diagnostic trouble code for check DFC_ComIMGMILReq" VALUE 0x804F93E8 Val_Wu16 65535.00 DFES_OneToOne 0.00 65535.00 FORMAT "%8.2" /end CHARACTERISTIC
/begin CHARACTERISTIC DFES_DTCO.DFC_ComISSPrms_C "OBD specific trouble code / OBD specific diagnostic trouble code for check DFC_ComISSPrms" VALUE 0x804F93EA Val_Wu16 65535.00 DFES_OneToOne 0.00 65535.00 FORMAT "%8.2" /end CHARACTERISTIC
/begin CHARACTERISTIC DFES_DTCO.DFC_ComMETAChksum_C "OBD specific trouble code / OBD specific diagnostic trouble code for check DFC_ComMETAChksum" VALUE 0x804F93EC Val_Wu16 65535.00 DFES_OneToOne 0.00 65535.00 FORMAT "%8.2" /end CHARACTERISTIC
/begin CHARACTERISTIC DFES_DTCO.DFC_ComMETARingCnt_C "OBD specific trouble code / OBD specific diagnostic trouble code for check DFC_ComMETARingCnt" VALUE 0x804F93EE Val_Wu16 65535.00 DFES_OneToOne 0.00 65535.00 FORMAT "%8.2" /end CHARACTERISTIC
/begin CHARACTERISTIC DFES_DTCO.DFC_ComMETATOut_C "OBD specific trouble code / OBD specific diagnostic trouble code for check DFC_ComMETATOut" VALUE 0x804F93F0 Val_Wu16 65535.00 DFES_OneToOne 0.00 65535.00 FORMAT "%8.2" /end CHARACTERISTIC
/begin CHARACTERISTIC DFES_DTCO.DFC_ComMETCChksum_C "OBD specific trouble code / OBD specific diagnostic trouble code for check DFC_ComMETCChksum" VALUE 0x804F93F2 Val_Wu16 65535.00 DFES_OneToOne 0.00 65535.00 FORMAT "%8.2" /end CHARACTERISTIC
/begin CHARACTERISTIC DFES_DTCO.DFC_ComMETCRingCnt_C "OBD specific trouble code / OBD specific diagnostic trouble code for check DFC_ComMETCRingCnt" VALUE 0x804F93F4 Val_Wu16 65535.00 DFES_OneToOne 0.00 65535.00 FORMAT "%8.2" /end CHARACTERISTIC
/begin CHARACTERISTIC DFES_DTCO.DFC_ComMETCTOut_C "OBD specific trouble code / OBD specific diagnostic trouble code for check DFC_ComMETCTOut" VALUE 0x804F93F6 Val_Wu16 65535.00 DFES_OneToOne 0.00 65535.00 FORMAT "%8.2" /end CHARACTERISTIC
/begin CHARACTERISTIC DFES_DTCO.DFC_ComMETDChksum_C "OBD specific trouble code / OBD specific diagnostic trouble code for check DFC_ComMETDChksum" VALUE 0x804F93F8 Val_Wu16 65535.00 DFES_OneToOne 0.00 65535.00 FORMAT "%8.2" /end CHARACTERISTIC
/begin CHARACTERISTIC DFES_DTCO.DFC_ComMETDRingCnt_C "OBD specific trouble code / OBD specific diagnostic trouble code for check DFC_ComMETDRingCnt" VALUE 0x804F93FA Val_Wu16 65535.00 DFES_OneToOne 0.00 65535.00 FORMAT "%8.2" /end CHARACTERISTIC
/begin CHARACTERISTIC DFES_DTCO.DFC_ComMETDTOut_C "OBD specific trouble code / OBD specific diagnostic trouble code for check DFC_ComMETDTOut" VALUE 0x804F93FC Val_Wu16 65535.00 DFES_OneToOne 0.00 65535.00 FORMAT "%8.2" /end CHARACTERISTIC
/begin CHARACTERISTIC DFES_DTCO.DFC_ComMETE2Chksum_C "OBD specific trouble code / OBD specific diagnostic trouble code for check DFC_ComMETE2Chksum" VALUE 0x804F93FE Val_Wu16 65535.00 DFES_OneToOne 0.00 65535.00 FORMAT "%8.2" /end CHARACTERISTIC
/begin CHARACTERISTIC DFES_DTCO.DFC_ComMETE2RingCnt_C "OBD specific trouble code / OBD specific diagnostic trouble code for check DFC_ComMETE2RingCnt" VALUE 0x804F9400 Val_Wu16 65535.00 DFES_OneToOne 0.00 65535.00 FORMAT "%8.2" /end CHARACTERISTIC
/begin CHARACTERISTIC DFES_DTCO.DFC_ComMETE2TOut_C "OBD specific trouble code / OBD specific diagnostic trouble code for check DFC_ComMETE2TOut" VALUE 0x804F9402 Val_Wu16 65535.00 DFES_OneToOne 0.00 65535.00 FORMAT "%8.2" /end CHARACTERISTIC
/begin CHARACTERISTIC DFES_DTCO.DFC_ComMETFChksum_C "OBD specific trouble code / OBD specific diagnostic trouble code for check DFC_ComMETFChksum" VALUE 0x804F9404 Val_Wu16 65535.00 DFES_OneToOne 0.00 65535.00 FORMAT "%8.2" /end CHARACTERISTIC
/begin CHARACTERISTIC DFES_DTCO.DFC_ComMETFRingCnt_C "OBD specific trouble code / OBD specific diagnostic trouble code for check DFC_ComMETFRingCnt" VALUE 0x804F9406 Val_Wu16 65535.00 DFES_OneToOne 0.00 65535.00 FORMAT "%8.2" /end CHARACTERISTIC
/begin CHARACTERISTIC DFES_DTCO.DFC_ComMETFTOut_C "OBD specific trouble code / OBD specific diagnostic trouble code for check DFC_ComMETFTOut" VALUE 0x804F9408 Val_Wu16 65535.00 DFES_OneToOne 0.00 65535.00 FORMAT "%8.2" /end CHARACTERISTIC
/begin CHARACTERISTIC DFES_DTCO.DFC_ComMETGChksum_C "OBD specific trouble code / OBD specific diagnostic trouble code for check DFC_ComMETGChksum" VALUE 0x804F940A Val_Wu16 65535.00 DFES_OneToOne 0.00 65535.00 FORMAT "%8.2" /end CHARACTERISTIC
/begin CHARACTERISTIC DFES_DTCO.DFC_ComMETGRingCnt_C "OBD specific trouble code / OBD specific diagnostic trouble code for check DFC_ComMETGRingCnt" VALUE 0x804F940C Val_Wu16 65535.00 DFES_OneToOne 0.00 65535.00 FORMAT "%8.2" /end CHARACTERISTIC
/begin CHARACTERISTIC DFES_DTCO.DFC_ComMETGTOut_C "OBD specific trouble code / OBD specific diagnostic trouble code for check DFC_ComMETGTOut" VALUE 0x804F940E Val_Wu16 65535.00 DFES_OneToOne 0.00 65535.00 FORMAT "%8.2" /end CHARACTERISTIC
/begin CHARACTERISTIC DFES_DTCO.DFC_ComMETH2Chksum_C "OBD specific trouble code / OBD specific diagnostic trouble code for check DFC_ComMETH2Chksum" VALUE 0x804F9410 Val_Wu16 65535.00 DFES_OneToOne 0.00 65535.00 FORMAT "%8.2" /end CHARACTERISTIC
/begin CHARACTERISTIC DFES_DTCO.DFC_ComMETH2RingCnt_C "OBD specific trouble code / OBD specific diagnostic trouble code for check DFC_ComMETH2RingCnt" VALUE 0x804F9412 Val_Wu16 65535.00 DFES_OneToOne 0.00 65535.00 FORMAT "%8.2" /end CHARACTERISTIC
/begin CHARACTERISTIC DFES_DTCO.DFC_ComMETH2TOut_C "OBD specific trouble code / OBD specific diagnostic trouble code for check DFC_ComMETH2TOut" VALUE 0x804F9414 Val_Wu16 65535.00 DFES_OneToOne 0.00 65535.00 FORMAT "%8.2" /end CHARACTERISTIC
/begin CHARACTERISTIC DFES_DTCO.DFC_ComMETHChksum_C "OBD specific trouble code / OBD specific diagnostic trouble code for check DFC_ComMETHChksum" VALUE 0x804F9416 Val_Wu16 65535.00 DFES_OneToOne 0.00 65535.00 FORMAT "%8.2" /end CHARACTERISTIC
/begin CHARACTERISTIC DFES_DTCO.DFC_ComMETHRingCnt_C "OBD specific trouble code / OBD specific diagnostic trouble code for check DFC_ComMETHRingCnt" VALUE 0x804F9418 Val_Wu16 65535.00 DFES_OneToOne 0.00 65535.00 FORMAT "%8.2" /end CHARACTERISTIC
/begin CHARACTERISTIC DFES_DTCO.DFC_ComMETHTOut_C "OBD specific trouble code / OBD specific diagnostic trouble code for check DFC_ComMETHTOut" VALUE 0x804F941A Val_Wu16 65535.00 DFES_OneToOne 0.00 65535.00 FORMAT "%8.2" /end CHARACTERISTIC
/begin CHARACTERISTIC DFES_DTCO.DFC_ComMETIChksum_C "OBD specific trouble code / OBD specific diagnostic trouble code for check DFC_ComMETIChksum" VALUE 0x804F941C Val_Wu16 65535.00 DFES_OneToOne 0.00 65535.00 FORMAT "%8.2" /end CHARACTERISTIC
/begin CHARACTERISTIC DFES_DTCO.DFC_ComMETIRingCnt_C "OBD specific trouble code / OBD specific diagnostic trouble code for check DFC_ComMETIRingCnt" VALUE 0x804F941E Val_Wu16 65535.00 DFES_OneToOne 0.00 65535.00 FORMAT "%8.2" /end CHARACTERISTIC
/begin CHARACTERISTIC DFES_DTCO.DFC_ComMETITOut_C "OBD specific trouble code / OBD specific diagnostic trouble code for check DFC_ComMETITOut" VALUE 0x804F9420 Val_Wu16 65535.00 DFES_OneToOne 0.00 65535.00 FORMAT "%8.2" /end CHARACTERISTIC
/begin CHARACTERISTIC DFES_DTCO.DFC_ComMETKChksum_C "OBD specific trouble code / OBD specific diagnostic trouble code for check DFC_ComMETKChksum" VALUE 0x804F9422 Val_Wu16 65535.00 DFES_OneToOne 0.00 65535.00 FORMAT "%8.2" /end CHARACTERISTIC
/begin CHARACTERISTIC DFES_DTCO.DFC_ComMETKRingCnt_C "OBD specific trouble code / OBD specific diagnostic trouble code for check DFC_ComMETKRingCnt" VALUE 0x804F9424 Val_Wu16 65535.00 DFES_OneToOne 0.00 65535.00 FORMAT "%8.2" /end CHARACTERISTIC
/begin CHARACTERISTIC DFES_DTCO.DFC_ComMETKTOut_C "OBD specific trouble code / OBD specific diagnostic trouble code for check DFC_ComMETKTOut" VALUE 0x804F9426 Val_Wu16 65535.00 DFES_OneToOne 0.00 65535.00 FORMAT "%8.2" /end CHARACTERISTIC
/begin CHARACTERISTIC DFES_DTCO.DFC_ComMETLChksum_C "OBD specific trouble code / OBD specific diagnostic trouble code for check DFC_ComMETLChksum" VALUE 0x804F9428 Val_Wu16 65535.00 DFES_OneToOne 0.00 65535.00 FORMAT "%8.2" /end CHARACTERISTIC
/begin CHARACTERISTIC DFES_DTCO.DFC_ComMETLRingCnt_C "OBD specific trouble code / OBD specific diagnostic trouble code for check DFC_ComMETLRingCnt" VALUE 0x804F942A Val_Wu16 65535.00 DFES_OneToOne 0.00 65535.00 FORMAT "%8.2" /end CHARACTERISTIC
/begin CHARACTERISTIC DFES_DTCO.DFC_ComMETLTOut_C "OBD specific trouble code / OBD specific diagnostic trouble code for check DFC_ComMETLTOut" VALUE 0x804F942C Val_Wu16 65535.00 DFES_OneToOne 0.00 65535.00 FORMAT "%8.2" /end CHARACTERISTIC
/begin CHARACTERISTIC DFES_DTCO.DFC_ComMETMChksum_C "OBD specific trouble code / OBD specific diagnostic trouble code for check DFC_ComMETMChksum" VALUE 0x804F942E Val_Wu16 65535.00 DFES_OneToOne 0.00 65535.00 FORMAT "%8.2" /end CHARACTERISTIC
/begin CHARACTERISTIC DFES_DTCO.DFC_ComMETMRingCnt_C "OBD specific trouble code / OBD specific diagnostic trouble code for check DFC_ComMETMRingCnt" VALUE 0x804F9430 Val_Wu16 65535.00 DFES_OneToOne 0.00 65535.00 FORMAT "%8.2" /end CHARACTERISTIC
/begin CHARACTERISTIC DFES_DTCO.DFC_ComMETMTOut_C "OBD specific trouble code / OBD specific diagnostic trouble code for check DFC_ComMETMTOut" VALUE 0x804F9432 Val_Wu16 65535.00 DFES_OneToOne 0.00 65535.00 FORMAT "%8.2" /end CHARACTERISTIC
/begin CHARACTERISTIC DFES_DTCO.DFC_ComMETNChksum_C "OBD specific trouble code / OBD specific diagnostic trouble code for check DFC_ComMETNChksum" VALUE 0x804F9434 Val_Wu16 65535.00 DFES_OneToOne 0.00 65535.00 FORMAT "%8.2" /end CHARACTERISTIC
/begin CHARACTERISTIC DFES_DTCO.DFC_ComMETNRingCnt_C "OBD specific trouble code / OBD specific diagnostic trouble code for check DFC_ComMETNRingCnt" VALUE 0x804F9436 Val_Wu16 65535.00 DFES_OneToOne 0.00 65535.00 FORMAT "%8.2" /end CHARACTERISTIC
/begin CHARACTERISTIC DFES_DTCO.DFC_ComMETNTOut_C "OBD specific trouble code / OBD specific diagnostic trouble code for check DFC_ComMETNTOut" VALUE 0x804F9438 Val_Wu16 65535.00 DFES_OneToOne 0.00 65535.00 FORMAT "%8.2" /end CHARACTERISTIC
/begin CHARACTERISTIC DFES_DTCO.DFC_ComMtrCom_C "OBD specific trouble code / OBD specific diagnostic trouble code for check DFC_ComMtrCom" VALUE 0x804F943A Val_Wu16 65535.00 DFES_OneToOne 0.00 65535.00 FORMAT "%8.2" /end CHARACTERISTIC
/begin CHARACTERISTIC DFES_DTCO.DFC_ComPCUChkSum_C "OBD specific trouble code / OBD specific diagnostic trouble code for check DFC_ComPCUChkSum" VALUE 0x804F943C Val_Wu16 65535.00 DFES_OneToOne 0.00 65535.00 FORMAT "%8.2" /end CHARACTERISTIC
/begin CHARACTERISTIC DFES_DTCO.DFC_ComPCURingCnt_C "OBD specific trouble code / OBD specific diagnostic trouble code for check DFC_ComPCURingCnt" VALUE 0x804F943E Val_Wu16 65535.00 DFES_OneToOne 0.00 65535.00 FORMAT "%8.2" /end CHARACTERISTIC
/begin CHARACTERISTIC DFES_DTCO.DFC_ComPCUTOut_C "OBD specific trouble code / OBD specific diagnostic trouble code for check DFC_ComPCUTOut" VALUE 0x804F9440 Val_Wu16 65535.00 DFES_OneToOne 0.00 65535.00 FORMAT "%8.2" /end CHARACTERISTIC
/begin CHARACTERISTIC DFES_DTCO.DFC_ComSRSAChksum_C "OBD specific trouble code / OBD specific diagnostic trouble code for check DFC_ComSRSAChksum" VALUE 0x804F9442 Val_Wu16 65535.00 DFES_OneToOne 0.00 65535.00 FORMAT "%8.2" /end CHARACTERISTIC
/begin CHARACTERISTIC DFES_DTCO.DFC_ComSRSARingCnt_C "OBD specific trouble code / OBD specific diagnostic trouble code for check DFC_ComSRSARingCnt" VALUE 0x804F9444 Val_Wu16 65535.00 DFES_OneToOne 0.00 65535.00 FORMAT "%8.2" /end CHARACTERISTIC
/begin CHARACTERISTIC DFES_DTCO.DFC_ComSRSATOut_C "OBD specific trouble code / OBD specific diagnostic trouble code for check DFC_ComSRSATOut" VALUE 0x804F9446 Val_Wu16 65535.00 DFES_OneToOne 0.00 65535.00 FORMAT "%8.2" /end CHARACTERISTIC
/begin CHARACTERISTIC DFES_DTCO.DFC_ComSRSBChksum_C "OBD specific trouble code / OBD specific diagnostic trouble code for check DFC_ComSRSBChksum" VALUE 0x804F9448 Val_Wu16 65535.00 DFES_OneToOne 0.00 65535.00 FORMAT "%8.2" /end CHARACTERISTIC
/begin CHARACTERISTIC DFES_DTCO.DFC_ComSRSBRingCnt_C "OBD specific trouble code / OBD specific diagnostic trouble code for check DFC_ComSRSBRingCnt" VALUE 0x804F944A Val_Wu16 65535.00 DFES_OneToOne 0.00 65535.00 FORMAT "%8.2" /end CHARACTERISTIC
/begin CHARACTERISTIC DFES_DTCO.DFC_ComSRSBTOut_C "OBD specific trouble code / OBD specific diagnostic trouble code for check DFC_ComSRSBTOut" VALUE 0x804F944C Val_Wu16 65535.00 DFES_OneToOne 0.00 65535.00 FORMAT "%8.2" /end CHARACTERISTIC
/begin CHARACTERISTIC DFES_DTCO.DFC_ComSRSChksum_C "OBD specific trouble code / OBD specific diagnostic trouble code for check DFC_ComSRSChksum" VALUE 0x804F944E Val_Wu16 65535.00 DFES_OneToOne 0.00 65535.00 FORMAT "%8.2" /end CHARACTERISTIC
/begin CHARACTERISTIC DFES_DTCO.DFC_ComSRSErr_C "OBD specific trouble code / OBD specific diagnostic trouble code for check DFC_ComSRSErr" VALUE 0x804F9450 Val_Wu16 65535.00 DFES_OneToOne 0.00 65535.00 FORMAT "%8.2" /end CHARACTERISTIC
/begin CHARACTERISTIC DFES_DTCO.DFC_ComSRSRingCnt_C "OBD specific trouble code / OBD specific diagnostic trouble code for check DFC_ComSRSRingCnt" VALUE 0x804F9452 Val_Wu16 65535.00 DFES_OneToOne 0.00 65535.00 FORMAT "%8.2" /end CHARACTERISTIC
/begin CHARACTERISTIC DFES_DTCO.DFC_ComSRSTOut_C "OBD specific trouble code / OBD specific diagnostic trouble code for check DFC_ComSRSTOut" VALUE 0x804F9454 Val_Wu16 65535.00 DFES_OneToOne 0.00 65535.00 FORMAT "%8.2" /end CHARACTERISTIC
/begin CHARACTERISTIC DFES_DTCO.DFC_ComVehSpdPndFltTCU_C "OBD specific trouble code / OBD specific diagnostic trouble code for check DFC_ComVehSpdPndFltTCU" VALUE 0x804F9456 Val_Wu16 65535.00 DFES_OneToOne 0.00 65535.00 FORMAT "%8.2" /end CHARACTERISTIC
/begin CHARACTERISTIC DFES_DTCO.DFC_EbsChartcCurrErr_C "OBD specific trouble code / OBD specific diagnostic trouble code for check DFC_EbsChartcCurrErr" VALUE 0x804F9458 Val_Wu16 65535.00 DFES_OneToOne 0.00 65535.00 FORMAT "%8.2" /end CHARACTERISTIC
/begin CHARACTERISTIC DFES_DTCO.DFC_EbsSelfDiagErr_C "OBD specific trouble code / OBD specific diagnostic trouble code for check DFC_EbsSelfDiagErr" VALUE 0x804F945A Val_Wu16 65535.00 DFES_OneToOne 0.00 65535.00 FORMAT "%8.2" /end CHARACTERISTIC
/begin CHARACTERISTIC DFES_DTCO.DFC_GbxCANDigPlausErr_C "OBD specific trouble code / OBD specific diagnostic trouble code for check DFC_GbxCANDigPlausErr" VALUE 0x804F945C Val_Wu16 65535.00 DFES_OneToOne 0.00 65535.00 FORMAT "%8.2" /end CHARACTERISTIC
/begin CHARACTERISTIC DFES_DTCO.DFC_GbxNPos1SRCMax_C "OBD specific trouble code / OBD specific diagnostic trouble code for check DFC_GbxNPos1SRCMax" VALUE 0x804F945E Val_Wu16 65535.00 DFES_OneToOne 0.00 65535.00 FORMAT "%8.2" /end CHARACTERISTIC
/begin CHARACTERISTIC DFES_DTCO.DFC_GbxNPos1SRCMin_C "OBD specific trouble code / OBD specific diagnostic trouble code for check DFC_GbxNPos1SRCMin" VALUE 0x804F9460 Val_Wu16 65535.00 DFES_OneToOne 0.00 65535.00 FORMAT "%8.2" /end CHARACTERISTIC
/begin CHARACTERISTIC DFES_DTCO.DFC_GbxNPos2SRCMax_C "OBD specific trouble code / OBD specific diagnostic trouble code for check DFC_GbxNPos2SRCMax" VALUE 0x804F9462 Val_Wu16 65535.00 DFES_OneToOne 0.00 65535.00 FORMAT "%8.2" /end CHARACTERISTIC
/begin CHARACTERISTIC DFES_DTCO.DFC_GbxNPos2SRCMin_C "OBD specific trouble code / OBD specific diagnostic trouble code for check DFC_GbxNPos2SRCMin" VALUE 0x804F9464 Val_Wu16 65535.00 DFES_OneToOne 0.00 65535.00 FORMAT "%8.2" /end CHARACTERISTIC
/begin CHARACTERISTIC DFES_DTCO.DFC_GbxNPosAlvChk_C "OBD specific trouble code / OBD specific diagnostic trouble code for check DFC_GbxNPosAlvChk" VALUE 0x804F9466 Val_Wu16 65535.00 DFES_OneToOne 0.00 65535.00 FORMAT "%8.2" /end CHARACTERISTIC
/begin CHARACTERISTIC DFES_DTCO.DFC_GbxNPosSyncErr_C "OBD specific trouble code / OBD specific diagnostic trouble code for check DFC_GbxNPosSyncErr" VALUE 0x804F9468 Val_Wu16 65535.00 DFES_OneToOne 0.00 65535.00 FORMAT "%8.2" /end CHARACTERISTIC
/begin CHARACTERISTIC DFES_DTCO.DFC_HEGOS2B1HtrPsMax_C "OBD specific trouble code / OBD specific diagnostic trouble code for check DFC_HEGOS2B1HtrPsMax" VALUE 0x804F946A Val_Wu16 65535.00 DFES_OneToOne 0.00 65535.00 FORMAT "%8.2" /end CHARACTERISTIC
/begin CHARACTERISTIC DFES_DTCO.DFC_HEGOS2B1HtrPsMin_C "OBD specific trouble code / OBD specific diagnostic trouble code for check DFC_HEGOS2B1HtrPsMin" VALUE 0x804F946C Val_Wu16 65535.00 DFES_OneToOne 0.00 65535.00 FORMAT "%8.2" /end CHARACTERISTIC
/begin CHARACTERISTIC DFES_DTCO.DFC_HEGOS2B1HtrPsSig_C "OBD specific trouble code / OBD specific diagnostic trouble code for check DFC_HEGOS2B1HtrPsSig" VALUE 0x804F946E Val_Wu16 65535.00 DFES_OneToOne 0.00 65535.00 FORMAT "%8.2" /end CHARACTERISTIC
/begin CHARACTERISTIC DFES_DTCO.DFC_LinCSErrACG_C "OBD specific trouble code / OBD specific diagnostic trouble code for check DFC_LinCSErrACG" VALUE 0x804F9470 Val_Wu16 65535.00 DFES_OneToOne 0.00 65535.00 FORMAT "%8.2" /end CHARACTERISTIC
/begin CHARACTERISTIC DFES_DTCO.DFC_LinCSErrEBS_C "OBD specific trouble code / OBD specific diagnostic trouble code for check DFC_LinCSErrEBS" VALUE 0x804F9472 Val_Wu16 65535.00 DFES_OneToOne 0.00 65535.00 FORMAT "%8.2" /end CHARACTERISTIC
/begin CHARACTERISTIC DFES_DTCO.DFC_LinHdrTimeoutErrACG_C "OBD specific trouble code / OBD specific diagnostic trouble code for check DFC_LinHdrTimeoutErrACG" VALUE 0x804F9474 Val_Wu16 65535.00 DFES_OneToOne 0.00 65535.00 FORMAT "%8.2" /end CHARACTERISTIC
/begin CHARACTERISTIC DFES_DTCO.DFC_LinHdrTimeoutErrEBS_C "OBD specific trouble code / OBD specific diagnostic trouble code for check DFC_LinHdrTimeoutErrEBS" VALUE 0x804F9476 Val_Wu16 65535.00 DFES_OneToOne 0.00 65535.00 FORMAT "%8.2" /end CHARACTERISTIC
/begin CHARACTERISTIC DFES_DTCO.DFC_LinMsgTimeoutErrACG_C "OBD specific trouble code / OBD specific diagnostic trouble code for check DFC_LinMsgTimeoutErrACG" VALUE 0x804F9478 Val_Wu16 65535.00 DFES_OneToOne 0.00 65535.00 FORMAT "%8.2" /end CHARACTERISTIC
/begin CHARACTERISTIC DFES_DTCO.DFC_LinMsgTimeoutErrEBS_C "OBD specific trouble code / OBD specific diagnostic trouble code for check DFC_LinMsgTimeoutErrEBS" VALUE 0x804F947A Val_Wu16 65535.00 DFES_OneToOne 0.00 65535.00 FORMAT "%8.2" /end CHARACTERISTIC
/begin CHARACTERISTIC DFES_DTCO.DFC_LinNoStrtComErr_C "OBD specific trouble code / OBD specific diagnostic trouble code for check DFC_LinNoStrtComErr" VALUE 0x804F947C Val_Wu16 65535.00 DFES_OneToOne 0.00 65535.00 FORMAT "%8.2" /end CHARACTERISTIC
/begin CHARACTERISTIC DFES_DTCO.DFC_MisfDetVWhlFrntLeOORHi_C "OBD specific trouble code / OBD specific diagnostic trouble code for check DFC_MisfDetVWhlFrntLeOORHi" VALUE 0x804F947E Val_Wu16 65535.00 DFES_OneToOne 0.00 65535.00 FORMAT "%8.2" /end CHARACTERISTIC
/begin CHARACTERISTIC DFES_DTCO.DFC_MisfDetVWhlFrntLeRatyHi_C "OBD specific trouble code / OBD specific diagnostic trouble code for check DFC_MisfDetVWhlFrntLeRatyHi" VALUE 0x804F9480 Val_Wu16 65535.00 DFES_OneToOne 0.00 65535.00 FORMAT "%8.2" /end CHARACTERISTIC
/begin CHARACTERISTIC DFES_DTCO.DFC_MisfDetVWhlFrntLeRatyLo_C "OBD specific trouble code / OBD specific diagnostic trouble code for check DFC_MisfDetVWhlFrntLeRatyLo" VALUE 0x804F9482 Val_Wu16 65535.00 DFES_OneToOne 0.00 65535.00 FORMAT "%8.2" /end CHARACTERISTIC
/begin CHARACTERISTIC DFES_DTCO.DFC_MisfDetVWhlFrntLeStuck_C "OBD specific trouble code / OBD specific diagnostic trouble code for check DFC_MisfDetVWhlFrntLeStuck" VALUE 0x804F9484 Val_Wu16 65535.00 DFES_OneToOne 0.00 65535.00 FORMAT "%8.2" /end CHARACTERISTIC
/begin CHARACTERISTIC DFES_DTCO.DFC_MisfDetVWhlFrntRiOORHi_C "OBD specific trouble code / OBD specific diagnostic trouble code for check DFC_MisfDetVWhlFrntRiOORHi" VALUE 0x804F9486 Val_Wu16 65535.00 DFES_OneToOne 0.00 65535.00 FORMAT "%8.2" /end CHARACTERISTIC
/begin CHARACTERISTIC DFES_DTCO.DFC_MisfDetVWhlFrntRiRatyHi_C "OBD specific trouble code / OBD specific diagnostic trouble code for check DFC_MisfDetVWhlFrntRiRatyHi" VALUE 0x804F9488 Val_Wu16 65535.00 DFES_OneToOne 0.00 65535.00 FORMAT "%8.2" /end CHARACTERISTIC
/begin CHARACTERISTIC DFES_DTCO.DFC_MisfDetVWhlFrntRiRatyLo_C "OBD specific trouble code / OBD specific diagnostic trouble code for check DFC_MisfDetVWhlFrntRiRatyLo" VALUE 0x804F948A Val_Wu16 65535.00 DFES_OneToOne 0.00 65535.00 FORMAT "%8.2" /end CHARACTERISTIC
/begin CHARACTERISTIC DFES_DTCO.DFC_MisfDetVWhlFrntRiStuck_C "OBD specific trouble code / OBD specific diagnostic trouble code for check DFC_MisfDetVWhlFrntRiStuck" VALUE 0x804F948C Val_Wu16 65535.00 DFES_OneToOne 0.00 65535.00 FORMAT "%8.2" /end CHARACTERISTIC
/begin CHARACTERISTIC DFES_DTCO.DFC_MisfDetVWhlReLeOORHi_C "OBD specific trouble code / OBD specific diagnostic trouble code for check DFC_MisfDetVWhlReLeOORHi" VALUE 0x804F948E Val_Wu16 65535.00 DFES_OneToOne 0.00 65535.00 FORMAT "%8.2" /end CHARACTERISTIC
/begin CHARACTERISTIC DFES_DTCO.DFC_MisfDetVWhlReLeRatyHi_C "OBD specific trouble code / OBD specific diagnostic trouble code for check DFC_MisfDetVWhlReLeRatyHi" VALUE 0x804F9490 Val_Wu16 65535.00 DFES_OneToOne 0.00 65535.00 FORMAT "%8.2" /end CHARACTERISTIC
/begin CHARACTERISTIC DFES_DTCO.DFC_MisfDetVWhlReLeRatyLo_C "OBD specific trouble code / OBD specific diagnostic trouble code for check DFC_MisfDetVWhlReLeRatyLo" VALUE 0x804F9492 Val_Wu16 65535.00 DFES_OneToOne 0.00 65535.00 FORMAT "%8.2" /end CHARACTERISTIC
/begin CHARACTERISTIC DFES_DTCO.DFC_MisfDetVWhlReLeStuck_C "OBD specific trouble code / OBD specific diagnostic trouble code for check DFC_MisfDetVWhlReLeStuck" VALUE 0x804F9494 Val_Wu16 65535.00 DFES_OneToOne 0.00 65535.00 FORMAT "%8.2" /end CHARACTERISTIC
/begin CHARACTERISTIC DFES_DTCO.DFC_MisfDetVWhlReRiOORHi_C "OBD specific trouble code / OBD specific diagnostic trouble code for check DFC_MisfDetVWhlReRiOORHi" VALUE 0x804F9496 Val_Wu16 65535.00 DFES_OneToOne 0.00 65535.00 FORMAT "%8.2" /end CHARACTERISTIC
/begin CHARACTERISTIC DFES_DTCO.DFC_MisfDetVWhlReRiRatyHi_C "OBD specific trouble code / OBD specific diagnostic trouble code for check DFC_MisfDetVWhlReRiRatyHi" VALUE 0x804F9498 Val_Wu16 65535.00 DFES_OneToOne 0.00 65535.00 FORMAT "%8.2" /end CHARACTERISTIC
/begin CHARACTERISTIC DFES_DTCO.DFC_MisfDetVWhlReRiRatyLo_C "OBD specific trouble code / OBD specific diagnostic trouble code for check DFC_MisfDetVWhlReRiRatyLo" VALUE 0x804F949A Val_Wu16 65535.00 DFES_OneToOne 0.00 65535.00 FORMAT "%8.2" /end CHARACTERISTIC
/begin CHARACTERISTIC DFES_DTCO.DFC_MisfDetVWhlReRiStuck_C "OBD specific trouble code / OBD specific diagnostic trouble code for check DFC_MisfDetVWhlReRiStuck" VALUE 0x804F949C Val_Wu16 65535.00 DFES_OneToOne 0.00 65535.00 FORMAT "%8.2" /end CHARACTERISTIC
/begin CHARACTERISTIC DFES_DTCO.DFC_MisfDetdVWhlFrntLePlaus_C "OBD specific trouble code / OBD specific diagnostic trouble code for check DFC_MisfDetdVWhlFrntLePlaus" VALUE 0x804F949E Val_Wu16 65535.00 DFES_OneToOne 0.00 65535.00 FORMAT "%8.2" /end CHARACTERISTIC
/begin FUNCTION DFES "30000.73.0_2.0.0Diagnostic Fault Event Storage"
 /begin DEF_CHARACTERISTIC DFES_Cls.DFC_LinHdrTimeoutErrACG_C DFES_Cls.DFC_LinHdrTimeoutErrEBS_C DFES_Cls.DFC_LinMsgTimeoutErrACG_C DFES_Cls.DFC_LinMsgTimeoutErrEBS_C DFES_Cls.DFC_LinNoStrtComErr_C DFES_Cls.DFC_MisfDetVWhlFrntLeOORHi_C DFES_Cls.DFC_MisfDetVWhlFrntLeRatyHi_C DFES_Cls.DFC_MisfDetVWhlFrntLeRatyLo_C DFES_Cls.DFC_MisfDetVWhlFrntLeStuck_C DFES_Cls.DFC_MisfDetVWhlFrntRiOORHi_C DFES_Cls.DFC_MisfDetVWhlFrntRiRatyHi_C DFES_Cls.DFC_MisfDetVWhlFrntRiRatyLo_C DFES_Cls.DFC_MisfDetVWhlFrntRiStuck_C DFES_Cls.DFC_MisfDetVWhlReLeOORHi_C DFES_Cls.DFC_MisfDetVWhlReLeRatyHi_C DFES_Cls.DFC_MisfDetVWhlReLeRatyLo_C DFES_Cls.DFC_MisfDetVWhlReLeStuck_C DFES_Cls.DFC_MisfDetVWhlReRiOORHi_C DFES_Cls.DFC_MisfDetVWhlReRiRatyHi_C DFES_Cls.DFC_MisfDetVWhlReRiRatyLo_C DFES_Cls.DFC_MisfDetVWhlReRiStuck_C DFES_Cls.DFC_MisfDetdVWhlFrntLePlaus_C DFES_Cls.DFC_MisfDetdVWhlFrntRiPlaus_C DFES_Cls.DFC_MisfDetdVWhlReLePlaus_C DFES_Cls.DFC_MisfDetdVWhlReRiPlaus_C DFES_Cls.DFC_PEnvSigRngMax_C DFES_Cls.DFC_PEnvSigRngMin_C DFES_Cls.DFC_StmFault_C DFES_Cls.DFC_StrtCtOffPth_C DFES_Cls.DFC_StrtCtlErr_C DFES_Cls.DFC_StrtFault_C DFES_Cls.DFC_StrtLckJudg1_C DFES_Cls.DFC_StrtLckJudg2_C DFES_Cls.DFC_StrtOL_C DFES_Cls.DFC_StrtOL2_C DFES_Cls.DFC_StrtSCB_C DFES_Cls.DFC_StrtSCB2_C DFES_Cls.DFC_StrtSCG_C DFES_Cls.DFC_StrtSCG2_C DFES_Cls.DFC_StrtStkRly1_C DFES_Cls.DFC_StrtStkRly2_C DFES_Cls.DFC_TEVEmax_C DFES_Cls.DFC_TEVEmin_C DFES_Cls.DFC_TEVEsig_C DFES_Cls.DFC_VehVAllPlaus_C DFES_Cls.DFC_VehVNCSnsrElecFailr_C DFES_Cls.DFC_VehVPlausCan_C DFES_Cls.DFC_VehVPlausFco_C DFES_Cls.DFC_VehVPlausPwr_C DFES_Cls.DFC_VehVPlausV2N_C DFES_Cls.DFC_VehVSpdSnsrAElecFailr_C DFES_Cls.DFC_VehVSpdSnsrBElecFailr_C DFES_Cls.DFC_ClthMax_C DFES_Cls.DFC_IgnClPs_DevComErr_C DFES_Cls.DFC_IgnClPs_LineOl_0_C DFES_Cls.DFC_IgnClPs_LineOl_1_C DFES_Cls.DFC_IgnClPs_LineOl_2_C DFES_Cls.DFC_IgnClPs_LineOl_3_C DFES_Cls.DFC_IgnClPs_LineScb_0_C DFES_Cls.DFC_IgnClPs_LineScb_1_C DFES_Cls.DFC_IgnClPs_LineScb_2_C DFES_Cls.DFC_IgnClPs_LineScb_3_C DFES_Cls.DFC_IgnClPs_LineScg_0_C DFES_Cls.DFC_IgnClPs_LineScg_1_C DFES_Cls.DFC_IgnClPs_LineScg_2_C DFES_Cls.DFC_IgnClPs_LineScg_3_C DFES_Cls.DFC_UEGOASICS1B1_C DFES_Cls.DFC_UEGOOLIPES1B1_C DFES_Cls.DFC_UEGOOLRES1B1_C DFES_Cls.DFC_UEGOSCBS1B1_C DFES_Cls.DFC_UEGOSCGS1B1_C DFES_Cls.DFC_UEGOSPIS1B1_C DFES_Cls.DFC_UEGOSnsrS1B1_C DFES_Cls.DFC_UegoOlApesS1B1_C DFES_Cls.DFC_UegoOlRCmpS1B1_C DFES_Cls.DFC_AirCCmprOL_C DFES_Cls.DFC_AirCCmprOvrTemp_C DFES_Cls.DFC_AirCCmprSCB_C DFES_Cls.DFC_AirCCmprSCG_C DFES_Cls.DFC_AltErr_C DFES_Cls.DFC_BattUSRCMax_C DFES_Cls.DFC_BattUSRCMin_C DFES_Cls.DFC_ComChksTCU1_C DFES_Cls.DFC_ComChksTCU11_C DFES_Cls.DFC_ComChksTCU12_C DFES_Cls.DFC_ComChksTCU13_C DFES_Cls.DFC_ComChksTCU2_C DFES_Cls.DFC_ComChksTCU3_C DFES_Cls.DFC_ComChksTCU4_C DFES_Cls.DFC_ComCntTCU1_C DFES_Cls.DFC_ComCntTCU11_C DFES_Cls.DFC_ComCntTCU12_C DFES_Cls.DFC_ComCntTCU13_C DFES_Cls.DFC_ComCntTCU2_C DFES_Cls.DFC_ComCntTCU3_C DFES_Cls.DFC_ComCntTCU4_C DFES_Cls.DFC_ComTOutTCU01_C DFES_Cls.DFC_ComTOutTCU02_C DFES_Cls.DFC_ComTOutTCU1_C DFES_Cls.DFC_ComTOutTCU11_C DFES_Cls.DFC_ComTOutTCU12_C DFES_Cls.DFC_ComTOutTCU13_C DFES_Cls.DFC_ComTOutTCU14_C DFES_Cls.DFC_ComTOutTCU2_C DFES_Cls.DFC_ComTOutTCU3_C DFES_Cls.DFC_ComTOutTCU4_C DFES_Cls.DFC_DevLibBattUHi_C DFES_Cls.DFC_DevLibBattULo_C DFES_Cls.DFC_FanDIOOL_0_C DFES_Cls.DFC_FanDIOOL_1_C DFES_Cls.DFC_FanDIOOvrTemp_0_C DFES_Cls.DFC_FanDIOOvrTemp_1_C DFES_Cls.DFC_FanDIOSCB_0_C DFES_Cls.DFC_FanDIOSCB_1_C DFES_Cls.DFC_FanDIOSCG_0_C DFES_Cls.DFC_FanDIOSCG_1_C DFES_Cls.DFC_MRlyDcOL_C DFES_Cls.DFC_MRlyDcSCB_C DFES_Cls.DFC_MRlyDcSCG_C DFES_Cls.DFC_PSPOL_C DFES_Cls.DFC_PSPOvrTemp_C DFES_Cls.DFC_PSPSCB_C DFES_Cls.DFC_PSPSCG_C DFES_Cls.DFC_T50Err_C DFES_Cls.DFC_ThrVlvLoBattB1_C DFES_Cls.DFC_VehVPhysRngHi_C DFES_Cls.DFC_VehVSclOutOL_C DFES_Cls.DFC_VehVSclOutOT_C DFES_Cls.DFC_VehVSclOutSCB_C DFES_Cls.DFC_VehVSclOutSCG_C DFES_Cls.DFC_VehVSnsrARngHi_C DFES_Cls.DFC_VehVSnsrBRngHi_C DFES_Cls.DFC_VehVSpdRtyDiag_C DFES_Cls.DFC_VehVWhlErr_C DFES_Cls.DFC_ACEvpTSRCMax_C DFES_Cls.DFC_ACEvpTSRCMin_C DFES_Cls.DFC_AirCClntPAnaSRCMax_C DFES_Cls.DFC_AirCClntPAnaSRCMin_C DFES_Cls.DFC_AirCSwtNpl_C DFES_Cls.DFC_AirCSwtSig_C DFES_Cls.DFC_Brk_C DFES_Cls.DFC_BrkSig_C DFES_Cls.DFC_ClthSig_C DFES_Cls.DFC_HLSDemOvhtEngLim_C DFES_Cls.DFC_OilPNpl_C DFES_Cls.DFC_PIntkVUsLineHiB1_C DFES_Cls.DFC_PIntkVUsLineLoB1_C DFES_Cls.DFC_VehVPhysRngLo_C DFES_Cls.DFC_VehVSigCan_C DFES_Cls.DFC_VehVSigCanSafe_C DFES_Cls.DFC_VlvLftFbOilPSnsrIntk11SRCMax_C DFES_Cls.DFC_VlvLftFbOilPSnsrIntk11SRCMin_C DFES_Cls.DFC_ClthNpl_C DFES_Cls.DFC_EV1max_C DFES_Cls.DFC_EV1min_C DFES_Cls.DFC_EV1sig_C DFES_Cls.DFC_EV2max_C DFES_Cls.DFC_EV2min_C DFES_Cls.DFC_EV2sig_C DFES_Cls.DFC_EV3max_C DFES_Cls.DFC_EV3min_C DFES_Cls.DFC_EV3sig_C DFES_Cls.DFC_EV4max_C DFES_Cls.DFC_EV4min_C DFES_Cls.DFC_EV4sig_C DFES_Cls.DFC_GbxPNPosnDrvCdn_C DFES_Cls.DFC_GbxPNPosnPlausy_C DFES_Cls.DFC_PEnvCcMax_C DFES_Cls.DFC_PEnvCcMin_C DFES_Cls.DFC_PEnvRngChkMax_C DFES_Cls.DFC_PEnvRngChkMin_C DFES_Cls.DFC_PEnvSnsrPlaus_C DFES_Cls.DFC_UEGOHeatrPsS1B1Max_C DFES_Cls.DFC_UEGOHeatrPsS1B1Min_C DFES_Cls.DFC_UEGOHeatrPsS1B1Sig_C DFES_Cls.DFC_UEGOHeatrRlyPsOLS1B1_C DFES_Cls.DFC_UEGOHeatrRlyPsSCBS1B1_C DFES_Cls.DFC_UEGOHeatrRlyPsSCGS1B1_C DFES_Cls.DFC_KnDetSens1PortAMax_C DFES_Cls.DFC_KnDetSens1PortAMin_C DFES_Cls.DFC_KnDetSens1PortBMax_C DFES_Cls.DFC_KnDetSens1PortBMin_C DFES_Cls.DFC_Clth2ONStuck_C DFES_Cls.DFC_Clth2ONStuckLdc_C DFES_Cls.DFC_Clth3ONStuckLdc_C DFES_Cls.DFC_Clth3ONStuckPostDrv_C DFES_Cls.DFC_Clth4ONStuck_C DFES_Cls.DFC_Clth4ONStuckLdc_C DFES_Cls.DFC_ComDLCTCU01_C DFES_Cls.DFC_ComDLCTCU02_C DFES_Cls.DFC_ComDLCTCU1_C DFES_Cls.DFC_ComDLCTCU11_C DFES_Cls.DFC_ComDLCTCU12_C DFES_Cls.DFC_ComDLCTCU13_C DFES_Cls.DFC_ComDLCTCU14_C DFES_Cls.DFC_ComDLCTCU2_C DFES_Cls.DFC_ComDLCTCU3_C DFES_Cls.DFC_ComDLCTCU4_C DFES_Cls.DFC_EVX_C DFES_Cls.DFC_EbsSocFlt_C DFES_Cls.DFC_I14229VINErr_C DFES_Cls.DFC_LLRKHmax_C DFES_Cls.DFC_LLRKHmin_C DFES_Cls.DFC_LLRmax_C DFES_Cls.DFC_LLRmin_C DFES_Cls.DFC_RoughRoad_C DFES_Cls.DFC_SiaEEPRdErr_C DFES_Cls.DFC_SiaEEPWrngCod_C DFES_Cls.DFC_UegoDummy_C DFES_Cls.DFC_BusDiagCANAPPLBusOff_C DFES_Cls.DFC_BusDiagCANCANCBusOff_C DFES_Cls.DFC_BusDiagCANVEHICLEBusOff_C DFES_Cls.DFC_RBA_IODIAGPWR_rba_IoExtCy329_SignalVltSply_0_C DFES_Cls.DFC_RBA_IODIAGPWR_rba_IoExtCy329_SignalVltSply_0OT_C DFES_Cls.DFC_RBA_IODIAGPWR_rba_IoExtCy329_SignalVltSply_0OV_C DFES_Cls.DFC_RBA_IODIAGPWR_rba_IoExtCy329_SignalVltSply_0SCG_C DFES_Cls.DFC_RBA_IODIAGPWR_rba_IoExtCy329_SignalVltSply_0UV_C DFES_Cls.DFC_RBA_IODIAGPWR_rba_IoExtCy329_SignalVltSply_1_C DFES_Cls.DFC_RBA_IODIAGPWR_rba_IoExtCy329_SignalVltSply_1OT_C DFES_Cls.DFC_RBA_IODIAGPWR_rba_IoExtCy329_SignalVltSply_1OV_C DFES_Cls.DFC_RBA_IODIAGPWR_rba_IoExtCy329_SignalVltSply_1SCG_C DFES_Cls.DFC_RBA_IODIAGPWR_rba_IoExtCy329_SignalVltSply_1UV_C DFES_Cls.DFC_RBA_IODIAGPWR_rba_IoExtCy329_SignalVltSply_2_C DFES_Cls.DFC_RBA_IODIAGPWR_rba_IoExtCy329_SignalVltSply_2OT_C DFES_Cls.DFC_RBA_IODIAGPWR_rba_IoExtCy329_SignalVltSply_2OV_C DFES_Cls.DFC_RBA_IODIAGPWR_rba_IoExtCy329_SignalVltSply_2SCG_C DFES_Cls.DFC_RBA_IODIAGPWR_rba_IoExtCy329_SignalVltSply_2UV_C DFES_Cls.DFC_CAN_E_TIMEOUT_C DFES_Cls.DFC_LIN_E_TIMEOUT_C DFES_Cls.DFC_MRlyOL_C DFES_Cls.DFC_MRlySCB_C DFES_Cls.DFC_MRlySCG_C DFES_Cls.DFC_rba_MultiStackTrace_Threshold_C DFES_Cls.DFC_BSWM_E_ACTION_FAILED_C DFES_Cls.DFC_BSWM_E_INTRPTQUEUE_FULL_C DFES_Cls.DFC_RBA_IOEXTLIB_KEEPALIVE_DRV_C DFES_Cls.DFC_RBA_IOEXTLIB_KEEPALIVE_INI_C DFES_Cls.DFC_rba_IoSigRtc_StopCounter_C DFES_Cls.DFC_rba_MRly_Diag_Stk_Event_C DFES_Cls.DFC_rba_MemDiag_MemReadErr_C DFES_Cls.DFC_rba_MemDiag_MemWrErr_C DFES_Cls.DFC_rba_SyC_IrrSwOffTrigEngRun_Event_C DFES_Cls.DFC_rba_T15_Diag_ComInVld_Event_C DFES_Cls.DFC_rba_T15_Diag_ComOff_HwOn_Event_C DFES_Cls.DFC_rba_T15_Diag_ComOn_HwOff_Event_C DFES_Cls.DFC_AppAllSnsrDfct_C DFES_Cls.DFC_BattUStdbyDiaOL_C DFES_Cls.DFC_BigLeakIntkMnfldEmiInfl_C DFES_Cls.DFC_BrkMnSwtContOnWarnLmp_C DFES_Cls.DFC_BrkMnSwtNotStpWarnLmp_C DFES_Cls.DFC_BrkRdntSwtContOnWarnLmp_C DFES_Cls.DFC_BrkRdntSwtNotStpWarnLmp_C DFES_Cls.DFC_CEngDsTColdStrtMax_C DFES_Cls.DFC_CEngDsTColdStrtMin_C DFES_Cls.DFC_CEngDsTImps_C DFES_Cls.DFC_CEngDsTPlausLSC_C DFES_Cls.DFC_CEngDsTPlausSTC_C DFES_Cls.DFC_CEngDsTSRCMax_C DFES_Cls.DFC_CEngDsTSRCMin_C DFES_Cls.DFC_CEngDsTSig_C DFES_Cls.DFC_CEngUsTSRCMax_C DFES_Cls.DFC_CEngUsTSRCMin_C DFES_Cls.DFC_DCDCFltDet_C DFES_Cls.DFC_DKRSA_C DFES_Cls.DFC_DKVSmax_C DFES_Cls.DFC_DKnpl_C DFES_Cls.DFC_DSSmax_C DFES_Cls.DFC_DSTTI_C DFES_Cls.DFC_DSUmax_C DFES_Cls.DFC_EGRVlvOL_C DFES_Cls.DFC_EGRVlvSCB_C DFES_Cls.DFC_EGRVlvSCG_C DFES_Cls.DFC_EGSDUS2B1LtrDly_C DFES_Cls.DFC_EGSDUS2B1LtrPT1_C DFES_Cls.DFC_EGSDUS2B1RtlDly_C DFES_Cls.DFC_EGSDUS2B1RtlPT1_C DFES_Cls.DFC_EGSDUS2B1TarLean_C DFES_Cls.DFC_EGSDUS2B1TarRich_C DFES_Cls.DFC_ETAKHLmax_C DFES_Cls.DFC_ETAKHTmax_C DFES_Cls.DFC_EngICO_C DFES_Cls.DFC_EngPrtOvrSpdMon_C DFES_Cls.DFC_EpmCaSI1ErrSig_C DFES_Cls.DFC_EpmCaSI1NoSig_C DFES_Cls.DFC_EpmCaSI1OfsErr_C DFES_Cls.DFC_EpmCrSErrSig_C DFES_Cls.DFC_EpmCrSNoSig_C DFES_Cls.DFC_EtaEngIdleNonCsers_C DFES_Cls.DFC_EtaEngPtlNonCsers_C DFES_Cls.DFC_FRAmax_C DFES_Cls.DFC_FRAmin_C DFES_Cls.DFC_GbxRvsSwtStk_C DFES_Cls.DFC_HDRmax_C DFES_Cls.DFC_HEGOS2B1ElecMax_C DFES_Cls.DFC_HEGOS2B1ElecMin_C DFES_Cls.DFC_HEGOS2B1ElecSig_C DFES_Cls.DFC_HEGOS2B1HtgNpl_C DFES_Cls.DFC_IntkAirTIntkMnfldCrssMax_C DFES_Cls.DFC_IntkAirTIntkMnfldCrssMin_C DFES_Cls.DFC_IntkAirTIntkMnfldHSCMax_C DFES_Cls.DFC_IntkAirTIntkMnfldImps_C DFES_Cls.DFC_IntkAirTIntkMnfldPRCMax_C DFES_Cls.DFC_IntkAirTIntkMnfldPRCMin_C DFES_Cls.DFC_IntkAirTIntkMnfldSRCMax_C DFES_Cls.DFC_IntkAirTIntkMnfldSRCMin_C DFES_Cls.DFC_IntkAirTIntkMnfldSTC_C DFES_Cls.DFC_KS1max_C DFES_Cls.DFC_KS1min_C DFES_Cls.DFC_LMmax_C DFES_Cls.DFC_LZSRnpl_C DFES_Cls.DFC_LamDynDiagS1B1_C DFES_Cls.DFC_LeakIntkMnfldEmiInfl_C DFES_Cls.DFC_MD00max_C DFES_Cls.DFC_MDBmax_C DFES_Cls.DFC_MDCat_C DFES_Cls.DFC_MDCatCrit_C DFES_Cls.DFC_MDCatCurr_C DFES_Cls.DFC_MDCyl_0_C DFES_Cls.DFC_MDCyl_1_C DFES_Cls.DFC_MDCyl_2_C DFES_Cls.DFC_MDCyl_3_C DFES_Cls.DFC_MDEmi_C DFES_Cls.DFC_MDEmiStrt_C DFES_Cls.DFC_MDFco_C DFES_Cls.DFC_MDMpl_C DFES_Cls.DFC_MDSegTiAdpn_C DFES_Cls.DFC_MDmax_C DFES_Cls.DFC_MOXEMM_SMU_ALM0_0_C DFES_Cls.DFC_MOXEMM_SMU_ALM0_1_C DFES_Cls.DFC_MOXEMM_SMU_ALM0_10_C DFES_Cls.DFC_MOXEMM_SMU_ALM0_11_C DFES_Cls.DFC_MOXEMM_SMU_ALM0_13_C DFES_Cls.DFC_MOXEMM_SMU_ALM0_14_C DFES_Cls.DFC_MOXEMM_SMU_ALM0_2_C DFES_Cls.DFC_MOXEMM_SMU_ALM0_22_C DFES_Cls.DFC_MOXEMM_SMU_ALM0_23_C DFES_Cls.DFC_MOXEMM_SMU_ALM0_4_C DFES_Cls.DFC_MOXEMM_SMU_ALM0_5_C DFES_Cls.DFC_MOXEMM_SMU_ALM0_7_C DFES_Cls.DFC_MOXEMM_SMU_ALM0_8_C DFES_Cls.DFC_MOXEMM_SMU_ALM10_16_C DFES_Cls.DFC_MOXEMM_SMU_ALM10_17_C DFES_Cls.DFC_MOXEMM_SMU_ALM10_21_C DFES_Cls.DFC_MOXEMM_SMU_ALM11_0_C DFES_Cls.DFC_MOXEMM_SMU_ALM11_1_C DFES_Cls.DFC_MOXEMM_SMU_ALM11_2_C DFES_Cls.DFC_MOXEMM_SMU_ALM11_3_C DFES_Cls.DFC_MOXEMM_SMU_ALM11_4_C DFES_Cls.DFC_MOXEMM_SMU_ALM11_5_C DFES_Cls.DFC_MOXEMM_SMU_ALM11_8_C DFES_Cls.DFC_MOXEMM_SMU_ALM11_9_C DFES_Cls.DFC_MOXEMM_SMU_ALM1_0_C DFES_Cls.DFC_MOXEMM_SMU_ALM1_1_C DFES_Cls.DFC_MOXEMM_SMU_ALM1_10_C DFES_Cls.DFC_MOXEMM_SMU_ALM1_11_C DFES_Cls.DFC_MOXEMM_SMU_ALM1_13_C DFES_Cls.DFC_MOXEMM_SMU_ALM1_14_C DFES_Cls.DFC_MOXEMM_SMU_ALM1_2_C DFES_Cls.DFC_MOXEMM_SMU_ALM1_22_C DFES_Cls.DFC_MOXEMM_SMU_ALM1_23_C DFES_Cls.DFC_MOXEMM_SMU_ALM1_4_C DFES_Cls.DFC_MOXEMM_SMU_ALM1_5_C DFES_Cls.DFC_MOXEMM_SMU_ALM1_7_C DFES_Cls.DFC_MOXEMM_SMU_ALM1_8_C DFES_Cls.DFC_MOXEMM_SMU_ALM21_0_C DFES_Cls.DFC_MOXEMM_SMU_ALM21_16_C DFES_Cls.DFC_MOXEMM_SMU_ALM21_3_C DFES_Cls.DFC_MOXEMM_SMU_ALM2_1_C DFES_Cls.DFC_MOXEMM_SMU_ALM2_10_C DFES_Cls.DFC_MOXEMM_SMU_ALM2_11_C DFES_Cls.DFC_MOXEMM_SMU_ALM2_13_C DFES_Cls.DFC_MOXEMM_SMU_ALM2_14_C DFES_Cls.DFC_MOXEMM_SMU_ALM2_22_C DFES_Cls.DFC_MOXEMM_SMU_ALM2_23_C DFES_Cls.DFC_MOXEMM_SMU_ALM2_4_C DFES_Cls.DFC_MOXEMM_SMU_ALM2_5_C DFES_Cls.DFC_MOXEMM_SMU_ALM2_7_C DFES_Cls.DFC_MOXEMM_SMU_ALM2_8_C DFES_Cls.DFC_MOXEMM_SMU_ALM6_0_C DFES_Cls.DFC_MOXEMM_SMU_ALM6_11_C DFES_Cls.DFC_MOXEMM_SMU_ALM6_12_C DFES_Cls.DFC_MOXEMM_SMU_ALM6_14_C DFES_Cls.DFC_MOXEMM_SMU_ALM6_15_C DFES_Cls.DFC_MOXEMM_SMU_ALM6_17_C DFES_Cls.DFC_MOXEMM_SMU_ALM6_18_C DFES_Cls.DFC_MOXEMM_SMU_ALM6_20_C DFES_Cls.DFC_MOXEMM_SMU_ALM6_21_C DFES_Cls.DFC_MOXEMM_SMU_ALM6_25_C DFES_Cls.DFC_MOXEMM_SMU_ALM6_4_C DFES_Cls.DFC_MOXEMM_SMU_ALM6_5_C DFES_Cls.DFC_MOXEMM_SMU_ALM6_7_C DFES_Cls.DFC_MOXEMM_SMU_ALM6_8_C DFES_Cls.DFC_MOXEMM_SMU_ALM7_1_C DFES_Cls.DFC_MOXEMM_SMU_ALM7_12_C DFES_Cls.DFC_MOXEMM_SMU_ALM7_13_C DFES_Cls.DFC_MOXEMM_SMU_ALM7_14_C DFES_Cls.DFC_MOXEMM_SMU_ALM7_15_C DFES_Cls.DFC_MOXEMM_SMU_ALM7_16_C DFES_Cls.DFC_MOXEMM_SMU_ALM7_17_C DFES_Cls.DFC_MOXEMM_SMU_ALM7_2_C DFES_Cls.DFC_MOXEMM_SMU_ALM7_20_C DFES_Cls.DFC_MOXEMM_SMU_ALM7_25_C DFES_Cls.DFC_MOXEMM_SMU_ALM7_26_C DFES_Cls.DFC_MOXEMM_SMU_ALM7_28_C DFES_Cls.DFC_MOXEMM_SMU_ALM7_29_C DFES_Cls.DFC_MOXEMM_SMU_ALM7_30_C DFES_Cls.DFC_MOXEMM_SMU_ALM7_31_C DFES_Cls.DFC_MOXEMM_SMU_ALM8_0_C DFES_Cls.DFC_MOXEMM_SMU_ALM8_1_C DFES_Cls.DFC_MOXEMM_SMU_ALM8_10_C DFES_Cls.DFC_MOXEMM_SMU_ALM8_11_C DFES_Cls.DFC_MOXEMM_SMU_ALM8_12_C DFES_Cls.DFC_MOXEMM_SMU_ALM8_16_C DFES_Cls.DFC_MOXEMM_SMU_ALM8_18_C DFES_Cls.DFC_MOXEMM_SMU_ALM8_2_C DFES_Cls.DFC_MOXEMM_SMU_ALM8_3_C DFES_Cls.DFC_MOXEMM_SMU_ALM8_31_C DFES_Cls.DFC_MOXEMM_SMU_ALM8_4_C DFES_Cls.DFC_MOXEMM_SMU_ALM9_0_C DFES_Cls.DFC_MOXEMM_SMU_ALM9_15_C DFES_Cls.DFC_MOXEMM_SMU_ALM9_3_C DFES_Cls.DFC_MoCADCNTP_C DFES_Cls.DFC_MoCADCTst_C DFES_Cls.DFC_MoCSOPICO_C DFES_Cls.DFC_MoFAPP_C DFES_Cls.DFC_MoFAirFilgPrdc_C DFES_Cls.DFC_MoFAirFlCtOffPfi_C DFES_Cls.DFC_MoFAirFlCylPfi_C DFES_Cls.DFC_MoFAirFlIn_C DFES_Cls.DFC_MoFAirFlMixCtlPfiChkAirFl_C DFES_Cls.DFC_MoFAirFlMixCtlPfiChkCtrl_C DFES_Cls.DFC_MoFAirFlMode_C DFES_Cls.DFC_MoFESpd_C DFES_Cls.DFC_MoFIACo_C DFES_Cls.DFC_MoFICOL1_C DFES_Cls.DFC_MoFICOL2_C DFES_Cls.DFC_MoFStrt_C DFES_Cls.DFC_MoFTrqCmp_C DFES_Cls.DFC_MoFTrqCmpMax_C DFES_Cls.DFC_MoFTrqCmpMin_C DFES_Cls.DFC_MoFVarPostBldSel_C DFES_Cls.DFC_MoXEMMHwLTMCUFW_C DFES_Cls.DFC_MoXEMMHwLTMonBIST_C DFES_Cls.DFC_MoXEMMHwLTRegMonTest_C DFES_Cls.DFC_MoXEMMHwLTStbySMUAlvTest_C DFES_Cls.DFC_MoXEMMHwLTTempSens_C DFES_Cls.DFC_MoXEMMHwLTUCBCfg_C DFES_Cls.DFC_OCWDAABEActv_C DFES_Cls.DFC_OCWDACom_C DFES_Cls.DFC_OCWDAErrPin_C DFES_Cls.DFC_OCWDAOvrVltg_C DFES_Cls.DFC_ORAmax_C DFES_Cls.DFC_ORAmin_C DFES_Cls.DFC_PLLSUmax_C DFES_Cls.DFC_PLLSUmin_C DFES_Cls.DFC_PSR1max_C DFES_Cls.DFC_PSRBmax_C DFES_Cls.DFC_PSRBmin_C DFES_Cls.DFC_PSRPmax_C DFES_Cls.DFC_PSRPmin_C DFES_Cls.DFC_PSRPsig_C DFES_Cls.DFC_PSRmax_C DFES_Cls.DFC_PUmax_C DFES_Cls.DFC_P_VSE11_OL_C DFES_Cls.DFC_P_VSE11_SCB_C DFES_Cls.DFC_P_VSE11_SCG_C DFES_Cls.DFC_PhyHighAPP1_C DFES_Cls.DFC_PhyHighAPP2_C DFES_Cls.DFC_PhyLowAPP1_C DFES_Cls.DFC_PhyLowAPP2_C DFES_Cls.DFC_SRCHighAPP1_C DFES_Cls.DFC_SRCHighAPP2_C DFES_Cls.DFC_SRCLowAPP1_C DFES_Cls.DFC_SRCLowAPP2_C DFES_Cls.DFC_SSpMon2_C DFES_Cls.DFC_SWReset_0_C DFES_Cls.DFC_SWReset_1_C DFES_Cls.DFC_SWReset_2_C DFES_Cls.DFC_SyncAPP_C DFES_Cls.DFC_TAmax_Dummy_C DFES_Cls.DFC_TKAEmax_C DFES_Cls.DFC_TKAEmin_C DFES_Cls.DFC_TKARmax_C DFES_Cls.DFC_TKARnpl_C DFES_Cls.DFC_TMmax_Dummy_C DFES_Cls.DFC_TUMmax_Dummy_C DFES_Cls.DFC_TWCDPriCatB1_C DFES_Cls.DFC_ThrVlvClsdPosnFirstOffsLrnImpoB1_C DFES_Cls.DFC_ThrVlvClsdPosnOffsLrnImpoB1_C DFES_Cls.DFC_ThrVlvClsdPosnOffsLrnMaxB1_C DFES_Cls.DFC_ThrVlvClsdPosnOffsLrnMinB1_C DFES_Cls.DFC_ThrVlvCtrlDeB1_C DFES_Cls.DFC_ThrVlvDycB1_C DFES_Cls.DFC_ThrVlvLimpAirPosnMaxAbsltDriftB1_C DFES_Cls.DFC_ThrVlvLimpAirPosnMaxB1_C DFES_Cls.DFC_ThrVlvLimpAirPosnMaxRelDriftB1_C DFES_Cls.DFC_ThrVlvLimpAirPosnMinB1_C DFES_Cls.DFC_ThrVlvOpenLoadB1_C DFES_Cls.DFC_ThrVlvOpenSprgB1_C DFES_Cls.DFC_ThrVlvOpenSprgSprdB1_C DFES_Cls.DFC_ThrVlvOpenSprgTwnB1_C DFES_Cls.DFC_ThrVlvOverTB1_C DFES_Cls.DFC_ThrVlvRetSprgB1_C DFES_Cls.DFC_ThrVlvRetSprgSprdB1_C DFES_Cls.DFC_ThrVlvRetSprgTwnB1_C DFES_Cls.DFC_ThrVlvSens1MaxB1_C DFES_Cls.DFC_ThrVlvSens1NplB1_C DFES_Cls.DFC_ThrVlvSens2MaxB1_C DFES_Cls.DFC_ThrVlvSens2MinB1_C DFES_Cls.DFC_ThrVlvSens2NplB1_C DFES_Cls.DFC_ThrVlvShoCircB1_C DFES_Cls.DFC_ThrVlvSpiErrB1_C DFES_Cls.DFC_ThrvlvSens1MinB1_C DFES_Cls.DFC_TiOffTBasdChkFast_C DFES_Cls.DFC_TiOffTBasdChkSlow_C DFES_Cls.DFC_UEGOHeatrCtlS1B1_C DFES_Cls.DFC_UEGOSnsrMntdS1B1_C DFES_Cls.DFC_VehVSig_C DFES_Cls.DFC_VlvLftFbSwtIntk11SpclFail_C DFES_Cls.DFC_VlvLftFbSwtIntk11StdFail_C DFES_DbLv_C DFES_DTCO.DFC_Unused_C DFES_DTCO.DFC_AltIOACGFailr_C DFES_DTCO.DFC_AltIOACGHiVltg_C DFES_DTCO.DFC_AltIOACGLoVltg_C DFES_DTCO.DFC_AltIOACGTHi_C DFES_DTCO.DFC_AltIODConnACG_C DFES_DTCO.DFC_BattUHiFailr_C DFES_DTCO.DFC_BattULoFailr_C DFES_DTCO.DFC_BrkBstPDriftHiErr_C DFES_DTCO.DFC_BrkBstPDriftLoErr_C DFES_DTCO.DFC_BrkBstPSnsrStuck_C DFES_DTCO.DFC_BrkMnSwtContOn_C DFES_DTCO.DFC_BrkMnSwtNotStp_C DFES_DTCO.DFC_BrkNpl_C DFES_DTCO.DFC_BrkRdntSwtContOn_C DFES_DTCO.DFC_BrkRdntSwtNotStp_C DFES_DTCO.DFC_Clth3ONStuck_C DFES_DTCO.DFC_Clth4OFFStuck_C DFES_DTCO.DFC_ClthOFFStuck_C DFES_DTCO.DFC_ClthONStuck_C DFES_DTCO.DFC_ClthStkFailInfo_C DFES_DTCO.DFC_ComACFailInfo_C DFES_DTCO.DFC_ComATFTValErr_C DFES_DTCO.DFC_ComATMILReq_C DFES_DTCO.DFC_ComAYCAChksum_C DFES_DTCO.DFC_ComAYCARingCnt_C DFES_DTCO.DFC_ComAYCATOut_C DFES_DTCO.DFC_ComAYCDChkSum_C DFES_DTCO.DFC_ComAYCDTOut_C DFES_DTCO.DFC_ComAYCFChksum_C DFES_DTCO.DFC_ComAYCFRingCnt_C DFES_DTCO.DFC_ComAYCFTOut_C DFES_DTCO.DFC_ComAYCGChksum_C DFES_DTCO.DFC_ComAYCGRingCnt_C DFES_DTCO.DFC_ComAYCGTOut_C DFES_DTCO.DFC_ComAYCIChkSum_C DFES_DTCO.DFC_ComAYCIRingCnt_C DFES_DTCO.DFC_ComAYCITOut_C DFES_DTCO.DFC_ComBCM1ChkSum_C DFES_DTCO.DFC_ComBCM1RingCnt_C DFES_DTCO.DFC_ComBCM1TOut_C DFES_DTCO.DFC_ComCANABusOffErr_C DFES_DTCO.DFC_ComCANBBusOffErr_C DFES_DTCO.DFC_ComCANCBusOffErr_C DFES_DTCO.DFC_ComCGW1ChkSum_C DFES_DTCO.DFC_ComCGW1RingCnt_C DFES_DTCO.DFC_ComCGW1TOut_C DFES_DTCO.DFC_ComConvBoostErr_C DFES_DTCO.DFC_ComConvSlipErr_C DFES_DTCO.DFC_ComEAT10Chksum_C DFES_DTCO.DFC_ComEAT10RingCnt_C DFES_DTCO.DFC_ComEAT10TOut_C DFES_DTCO.DFC_ComEAT11ChkSum_C DFES_DTCO.DFC_ComEAT11RingCnt_C DFES_DTCO.DFC_ComEAT11TOut_C DFES_DTCO.DFC_ComEAT12ChkSum_C DFES_DTCO.DFC_ComEAT12RingCnt_C DFES_DTCO.DFC_ComEAT12TOut_C DFES_DTCO.DFC_ComEAT13ChkSum_C DFES_DTCO.DFC_ComEAT13RingCnt_C DFES_DTCO.DFC_ComEAT13TOut_C DFES_DTCO.DFC_ComEAT1Chksum_C DFES_DTCO.DFC_ComEAT1RingCnt_C DFES_DTCO.DFC_ComEAT1TOut_C DFES_DTCO.DFC_ComEAT2ChkSum_C DFES_DTCO.DFC_ComEAT2RingCnt_C DFES_DTCO.DFC_ComEAT2TOut_C DFES_DTCO.DFC_ComEAT4ChkSum_C DFES_DTCO.DFC_ComEAT4RingCnt_C DFES_DTCO.DFC_ComEAT4TOut_C DFES_DTCO.DFC_ComEAT6Chksum_C DFES_DTCO.DFC_ComEAT6RingCnt_C DFES_DTCO.DFC_ComEAT6TOut_C DFES_DTCO.DFC_ComEAT7Chksum_C DFES_DTCO.DFC_ComEAT7RingCnt_C DFES_DTCO.DFC_ComEAT7TOut_C DFES_DTCO.DFC_ComEAT8Chksum_C DFES_DTCO.DFC_ComEAT8RingCnt_C DFES_DTCO.DFC_ComEAT8TOut_C DFES_DTCO.DFC_ComEATAChksum_C DFES_DTCO.DFC_ComEATARingCnt_C DFES_DTCO.DFC_ComEATATOut_C DFES_DTCO.DFC_ComEATBChkSum_C DFES_DTCO.DFC_ComEATBRingCnt_C DFES_DTCO.DFC_ComEATBTOut_C DFES_DTCO.DFC_ComEATCChksum_C DFES_DTCO.DFC_ComEATCRingCnt_C DFES_DTCO.DFC_ComEATCTOut_C DFES_DTCO.DFC_ComEBBAChksum_C DFES_DTCO.DFC_ComEBBARingCnt_C DFES_DTCO.DFC_ComEBBATOut_C DFES_DTCO.DFC_ComEPS1Chksum_C DFES_DTCO.DFC_ComEPS1RingCnt_C DFES_DTCO.DFC_ComEPS1TOut_C DFES_DTCO.DFC_ComEngCanRxErr_C DFES_DTCO.DFC_ComGrvySnsrErr_C DFES_DTCO.DFC_ComGwIMG1ChkSum_C DFES_DTCO.DFC_ComGwIMG1RingCnt_C DFES_DTCO.DFC_ComGwIMG1TOut_C DFES_DTCO.DFC_ComGwIMG3ChkSum_C DFES_DTCO.DFC_ComGwIMG3RingCnt_C DFES_DTCO.DFC_ComGwIMG3TOut_C DFES_DTCO.DFC_ComGwIMG4ChkSum_C DFES_DTCO.DFC_ComGwIMG4RingCnt_C DFES_DTCO.DFC_ComGwIMG4TOut_C DFES_DTCO.DFC_ComGwIMG5ChkSum_C DFES_DTCO.DFC_ComGwIMG5RingCnt_C DFES_DTCO.DFC_ComGwIMG5TOut_C DFES_DTCO.DFC_ComGwIMG6ChkSum_C DFES_DTCO.DFC_ComGwIMG6RingCnt_C DFES_DTCO.DFC_ComGwIMG6TOut_C DFES_DTCO.DFC_ComIDASBChksum_C DFES_DTCO.DFC_ComIDASBRingCnt_C DFES_DTCO.DFC_ComIDASBTOut_C DFES_DTCO.DFC_ComIMGMILReq_C DFES_DTCO.DFC_ComISSPrms_C DFES_DTCO.DFC_ComMETAChksum_C DFES_DTCO.DFC_ComMETARingCnt_C DFES_DTCO.DFC_ComMETATOut_C DFES_DTCO.DFC_ComMETCChksum_C DFES_DTCO.DFC_ComMETCRingCnt_C DFES_DTCO.DFC_ComMETCTOut_C DFES_DTCO.DFC_ComMETDChksum_C DFES_DTCO.DFC_ComMETDRingCnt_C DFES_DTCO.DFC_ComMETDTOut_C DFES_DTCO.DFC_ComMETE2Chksum_C DFES_DTCO.DFC_ComMETE2RingCnt_C DFES_DTCO.DFC_ComMETE2TOut_C DFES_DTCO.DFC_ComMETFChksum_C DFES_DTCO.DFC_ComMETFRingCnt_C DFES_DTCO.DFC_ComMETFTOut_C DFES_DTCO.DFC_ComMETGChksum_C DFES_DTCO.DFC_ComMETGRingCnt_C DFES_DTCO.DFC_ComMETGTOut_C DFES_DTCO.DFC_ComMETH2Chksum_C DFES_DTCO.DFC_ComMETH2RingCnt_C DFES_DTCO.DFC_ComMETH2TOut_C DFES_DTCO.DFC_ComMETHChksum_C DFES_DTCO.DFC_ComMETHRingCnt_C DFES_DTCO.DFC_ComMETHTOut_C DFES_DTCO.DFC_ComMETIChksum_C DFES_DTCO.DFC_ComMETIRingCnt_C DFES_DTCO.DFC_ComMETITOut_C DFES_DTCO.DFC_ComMETKChksum_C DFES_DTCO.DFC_ComMETKRingCnt_C DFES_DTCO.DFC_ComMETKTOut_C DFES_DTCO.DFC_ComMETLChksum_C DFES_DTCO.DFC_ComMETLRingCnt_C DFES_DTCO.DFC_ComMETLTOut_C DFES_DTCO.DFC_ComMETMChksum_C DFES_DTCO.DFC_ComMETMRingCnt_C DFES_DTCO.DFC_ComMETMTOut_C DFES_DTCO.DFC_ComMETNChksum_C DFES_DTCO.DFC_ComMETNRingCnt_C DFES_DTCO.DFC_ComMETNTOut_C DFES_DTCO.DFC_ComMtrCom_C DFES_DTCO.DFC_ComPCUChkSum_C DFES_DTCO.DFC_ComPCURingCnt_C DFES_DTCO.DFC_ComPCUTOut_C DFES_DTCO.DFC_ComSRSAChksum_C DFES_DTCO.DFC_ComSRSARingCnt_C DFES_DTCO.DFC_ComSRSATOut_C DFES_DTCO.DFC_ComSRSBChksum_C DFES_DTCO.DFC_ComSRSBRingCnt_C DFES_DTCO.DFC_ComSRSBTOut_C DFES_DTCO.DFC_ComSRSChksum_C DFES_DTCO.DFC_ComSRSErr_C DFES_DTCO.DFC_ComSRSRingCnt_C DFES_DTCO.DFC_ComSRSTOut_C DFES_DTCO.DFC_ComVehSpdPndFltTCU_C DFES_DTCO.DFC_EbsChartcCurrErr_C DFES_DTCO.DFC_EbsSelfDiagErr_C DFES_DTCO.DFC_GbxCANDigPlausErr_C DFES_DTCO.DFC_GbxNPos1SRCMax_C DFES_DTCO.DFC_GbxNPos1SRCMin_C DFES_DTCO.DFC_GbxNPos2SRCMax_C DFES_DTCO.DFC_GbxNPos2SRCMin_C DFES_DTCO.DFC_GbxNPosAlvChk_C DFES_DTCO.DFC_GbxNPosSyncErr_C DFES_DTCO.DFC_HEGOS2B1HtrPsMax_C DFES_DTCO.DFC_HEGOS2B1HtrPsMin_C DFES_DTCO.DFC_HEGOS2B1HtrPsSig_C DFES_DTCO.DFC_LinCSErrACG_C DFES_DTCO.DFC_LinCSErrEBS_C DFES_DTCO.DFC_LinHdrTimeoutErrACG_C DFES_DTCO.DFC_LinHdrTimeoutErrEBS_C DFES_DTCO.DFC_LinMsgTimeoutErrACG_C DFES_DTCO.DFC_LinMsgTimeoutErrEBS_C DFES_DTCO.DFC_LinNoStrtComErr_C DFES_DTCO.DFC_MisfDetVWhlFrntLeOORHi_C DFES_DTCO.DFC_MisfDetVWhlFrntLeRatyHi_C DFES_DTCO.DFC_MisfDetVWhlFrntLeRatyLo_C DFES_DTCO.DFC_MisfDetVWhlFrntLeStuck_C DFES_DTCO.DFC_MisfDetVWhlFrntRiOORHi_C DFES_DTCO.DFC_MisfDetVWhlFrntRiRatyHi_C DFES_DTCO.DFC_MisfDetVWhlFrntRiRatyLo_C DFES_DTCO.DFC_MisfDetVWhlFrntRiStuck_C DFES_DTCO.DFC_MisfDetVWhlReLeOORHi_C DFES_DTCO.DFC_MisfDetVWhlReLeRatyHi_C DFES_DTCO.DFC_MisfDetVWhlReLeRatyLo_C DFES_DTCO.DFC_MisfDetVWhlReLeStuck_C DFES_DTCO.DFC_MisfDetVWhlReRiOORHi_C DFES_DTCO.DFC_MisfDetVWhlReRiRatyHi_C DFES_DTCO.DFC_MisfDetVWhlReRiRatyLo_C DFES_DTCO.DFC_MisfDetVWhlReRiStuck_C DFES_DTCO.DFC_MisfDetdVWhlFrntLePlaus_C /end DEF_CHARACTERISTIC
 FUNCTION_VERSION "30000.73.0_2.0.0" /end FUNCTION
/begin COMPU_METHOD DFES_OneToOne "" RAT_FUNC "%6.2" "-" COEFFS 0 1 0 0 0 1 /end COMPU_METHOD
/begin RECORD_LAYOUT Val_Wu16 FNC_VALUES 1 UWORD COLUMN_DIR DIRECT /end RECORD_LAYOUT
/begin RECORD_LAYOUT Val_Wu8 FNC_VALUES 1 UBYTE COLUMN_DIR DIRECT /end RECORD_LAYOUT
/end MODULE
/end PROJECT
