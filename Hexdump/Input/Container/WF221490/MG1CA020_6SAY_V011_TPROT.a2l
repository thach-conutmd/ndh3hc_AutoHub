ASAP2_VERSION 1 60
/begin PROJECT MG1CA020 "MG1CA020"
/begin HEADER "" VERSION "MG1CA020_6SAY_V011_TPROT" PROJECT_NO MG1CA020 /end HEADER
/begin MODULE DIM ""
/begin MOD_COMMON "" BYTE_ORDER MSB_LAST ALIGNMENT_BYTE 1 ALIGNMENT_WORD 2 ALIGNMENT_LONG 4 ALIGNMENT_INT64 4 ALIGNMENT_FLOAT32_IEEE 4 ALIGNMENT_FLOAT64_IEEE 4 DATA_SIZE 32 /end MOD_COMMON
/begin CHARACTERISTIC EngStrt_cntrInjStrtEndSpdGovr_C "minimum number of injections for release of engine speed control" VALUE 0x8051E91C RB_Val_Wu8 255.0 OneToOne 0.00 255.0 FORMAT "%5.1" /end CHARACTERISTIC
/begin CHARACTERISTIC EngStrt_dataStrtEnd_C "codeword for EngStrt_StrtEnd" VALUE 0x8051E91D RB_Val_Wu8 255.0 OneToOne 0.00 255.0 FORMAT "%5.1" /end CHARACTERISTIC
/begin CHARACTERISTIC EngStrt_dataSysRels_C "Codeword EngStrt_StrtSysRels" VALUE 0x8051F07C RB_Val_Wu8 255.0 OneToOne 0.00 255.0 FORMAT "%5.1" /end CHARACTERISTIC
/begin CHARACTERISTIC EngStrt_facWrmUpMax_C "max. afterstartwarm up-enrichment for torque monitoring" VALUE 0x8051F080 RB_Val_Wu16 63.99902 fak_uw_b64 0.00 63.99902 FORMAT "%8.5" /end CHARACTERISTIC
/begin CHARACTERISTIC EngStrt_idxClassSelnStrtEnd_T "Curve class selector for detection of end of start" CURVE 0x8051E91E RB_Curve_U16_U8_Static 4.00000000000 ENGSTRT_IDXSTRTEND_SET_COMPU_VERB 0.00 4.00000000000 FORMAT "%13.11"
 /begin AXIS_DESCR STD_AXIS EngStrt_stStrtReq ENGSTRT_STSTRTREQ_SET_COMPU_VERB 6 0.00 16384.0000000 FORMAT "%13.7" DEPOSIT ABSOLUTE /end AXIS_DESCR
/end CHARACTERISTIC
/begin CHARACTERISTIC EngStrt_idxInstSelnNEngCrit_T "Curve class instance selector for detection of end of start over engine speed under critical start condition" CURVE 0x8051E932 RB_Curve_U16_U8_Static 0.00 STRTEND_NENGCRIT_SET_COMPU_VERB 0.00 0.00 FORMAT "%13.2"
 /begin AXIS_DESCR STD_AXIS EngStrt_stStrtReq ENGSTRT_STSTRTREQ_SET_COMPU_VERB 6 0.00 16384.0000000 FORMAT "%13.7" DEPOSIT ABSOLUTE /end AXIS_DESCR
/end CHARACTERISTIC
/begin CHARACTERISTIC EngStrt_idxInstSelnNEngDeb_T "Curve class instance selector for detection of end of start over engine speed , injection counter and debouncing" CURVE 0x8051E946 RB_Curve_U16_U8_Static 0.00 STRTEND_NENGDEB_SET_COMPU_VERB 0.00 0.00 FORMAT "%13.2"
 /begin AXIS_DESCR STD_AXIS EngStrt_stStrtReq ENGSTRT_STSTRTREQ_SET_COMPU_VERB 6 0.00 16384.0000000 FORMAT "%13.7" DEPOSIT ABSOLUTE /end AXIS_DESCR
/end CHARACTERISTIC
/begin CHARACTERISTIC EngStrt_idxInstSelnNEngNrInj_T "Curve class instance selector for detection of end of start over engine speed and injection counter" CURVE 0x8051E95A RB_Curve_U16_U8_Static 1.00000000000 STRTEND_NENGNRINJ_SET_COMPU_VERB 0.00 1.00000000000 FORMAT "%13.11"
 /begin AXIS_DESCR STD_AXIS EngStrt_stStrtReq ENGSTRT_STSTRTREQ_SET_COMPU_VERB 6 0.00 16384.0000000 FORMAT "%13.7" DEPOSIT ABSOLUTE /end AXIS_DESCR
/end CHARACTERISTIC
/begin CHARACTERISTIC EngStrt_idxInstSelnNEng_T "Curve class instance selector for detection of end of start over engine speed" CURVE 0x8051E96E RB_Curve_U16_U8_Static 2.00000000000 STRTEND_NENG_SET_COMPU_VERB 0.00 2.00000000000 FORMAT "%13.11"
 /begin AXIS_DESCR STD_AXIS EngStrt_stStrtReq ENGSTRT_STSTRTREQ_SET_COMPU_VERB 6 0.00 16384.0000000 FORMAT "%13.7" DEPOSIT ABSOLUTE /end AXIS_DESCR
/end CHARACTERISTIC
/begin CHARACTERISTIC EngStrt_idxSelnOverrun_T "Curve class instance selector for overrun" CURVE 0x8051E982 RB_Curve_U16_U8_Static 255.0 OneToOne 0.00 255.0 FORMAT "%5.1"
 /begin AXIS_DESCR STD_AXIS EngStrt_stStrtReq ENGSTRT_STSTRTREQ_SET_COMPU_VERB 6 0.00 16384.0000000 FORMAT "%13.7" DEPOSIT ABSOLUTE /end AXIS_DESCR
/end CHARACTERISTIC
/begin AXIS_PTS EngStrt_nEngMaxCritStrtEnd_AX "Base point distribution over maximum engine speed for start under critical situation" 0x8051E996 EngStrt_nEngMaxCrit RB_Axis_S16 32767.50 EngN 4 -16384.00 16383.50 FORMAT "%8.2" DEPOSIT ABSOLUTE /end AXIS_PTS
/begin CHARACTERISTIC EngStrt_nMnNoStaCom "Threshold engine speed for permission of starter assist at change of mind" VALUE 0x8051F07E RB_Val_Ws16 32767.50 EngN -16384.00 16383.50 FORMAT "%8.2" /end CHARACTERISTIC
/begin CHARACTERISTIC EngStrt_nStrtEndInit_C "engine speed threshold end-of-start, if there is already engine speed in ECU init-phase" VALUE 0x8051E9A0 RB_Val_Ws16 32767.50 EngN -16384.00 16383.50 FORMAT "%8.2" /end CHARACTERISTIC
/begin CHARACTERISTIC EngStrt_nStrt_C "engine speed threshold for detection start" VALUE 0x8051E9A2 RB_Val_Ws16 32767.50 EngN -16384.00 16383.50 FORMAT "%8.2" /end CHARACTERISTIC
/begin AXIS_PTS EngStrt_pStrtEnd_AX "Base point distribution over ambient pressure for detection of end of start" 0x8051E9A4 PEnv_p RB_Axis_U16 2559.961 p_q0p039 8 0.00 2559.961 FORMAT "%8.3" DEPOSIT ABSOLUTE /end AXIS_PTS
/begin CHARACTERISTIC EngStrt_stEomStgWrmUpAllwd_T "curve stage of the operating mode warm up (allowed operating modes)" CURVE 0x8051F082 RB_Curve_U8_U16_Static 65535.00 OneToOne 0.00 65535.00 FORMAT "%8.2"
 /begin AXIS_DESCR STD_AXIS EngStrt_stEomWrmUpAllwd OneToOne 16 0.00 255.0 FORMAT "%5.1" DEPOSIT ABSOLUTE /end AXIS_DESCR
/end CHARACTERISTIC
/begin CHARACTERISTIC EngStrt_stEomWrmUpAllwd_T "curve state of the operating mode warm up (allowed operating modes)" CURVE 0x8051F0B4 RB_Curve_S16_R32_Static 2.00000000E+037 OneToOne -1.00000000E+037 1.00000000E+037 FORMAT "%13.3" EXTENDED_LIMITS -3.40282347E+038 3.40282347E+038
 /begin AXIS_DESCR STD_AXIS EngStrt_stEomWrmUpAllwdLoc OneToOne 16 0.00 255.0000 FORMAT "%8.4" EXTENDED_LIMITS -32768.00 32767.00 DEPOSIT ABSOLUTE /end AXIS_DESCR
/end CHARACTERISTIC
/begin CHARACTERISTIC EngStrt_stPrioWrmUpAllwd_C "Priority of the mode of operation warm up (allowed operating modes)" VALUE 0x8051F118 RB_Val_Wu8 255.0 OneToOne 0.00 255.0 FORMAT "%5.1" /end CHARACTERISTIC
/begin CHARACTERISTIC EngStrt_tiAfterStrtEndMin_C "Time following start-up with switchover ban homogeneous - stratified" VALUE 0x8051F11A RB_Val_Wu16 655.3500 t10msxs_uw_b655p35 0.00 655.3500 FORMAT "%8.4" /end CHARACTERISTIC
/begin CHARACTERISTIC EngStrt_tiDlyStrtEndTqStruct_T "Curve delay time after end of start to set the release of the torque structure" CURVE 0x8051E9B6 RB_Curve_U16_U16 655.3500 t_q0p01 0.00 655.3500 FORMAT "%8.4"
 /begin AXIS_DESCR STD_AXIS EngStrt_stStrtReq ENGSTRT_STSTRTREQ_SET_COMPU_VERB 6 0.00 16384.0000000 FORMAT "%13.7" DEPOSIT ABSOLUTE /end AXIS_DESCR
/end CHARACTERISTIC
/begin CHARACTERISTIC EngStrt_tStrtEndSpdGovr_C "Minumim temperature to activate the early idle control at follow-up start" VALUE 0x8051E9D0 RB_Val_Ws16 3276.700 Temp_Cels -273.140 3003.560 FORMAT "%8.3" EXTENDED_LIMITS -3549.940 3003.560 /end CHARACTERISTIC
/begin AXIS_PTS EngStrt_tStrtEnd_AX "Base point distribution engine temperature for the detection of end of start" 0x8051E9D2 EngStrt_tCoor RB_Axis_S16 3276.700 Temp_Cels 12 -273.140 3003.560 FORMAT "%8.3" EXTENDED_LIMITS -3549.940 3003.560 DEPOSIT ABSOLUTE /end AXIS_PTS
/begin CHARACTERISTIC EngTrqPtd_facSpdGovMax_CUR "engine speed dependent factor for limitation of maximum idle speed governor torque" CURVE 0x8051F11C RB_Curve_S16_U16_Static 1.000000 Fact 0.00 1.000000 FORMAT "%8.6" EXTENDED_LIMITS 0.00 7.999878
 /begin AXIS_DESCR STD_AXIS Epm_nEng EngN 8 -16384.00 16383.50 FORMAT "%8.2" DEPOSIT ABSOLUTE /end AXIS_DESCR
/end CHARACTERISTIC
/begin CHARACTERISTIC EngTrqPtd_nSpdGovPtd_C "Maximum permitted speed govenor operation engine speed" VALUE 0x8051F13E RB_Val_Ws16 32767.50 EngN -16384.00 16383.50 FORMAT "%8.2" /end CHARACTERISTIC
/begin CHARACTERISTIC EngTrqPtd_trqResvMax_CUR "curve maximal reserve torque in extended monitoring" CURVE 0x8051F140 RB_Curve_U8_S16_Static 6553.500 Trq -3276.800 3276.700 FORMAT "%8.3"
 /begin AXIS_DESCR STD_AXIS Epm_nEngLRes EngN_LRes 8 0.00 10200. FORMAT "%5.0" DEPOSIT ABSOLUTE /end AXIS_DESCR
/end CHARACTERISTIC
/begin CHARACTERISTIC EngTrqPtd_trqSpdGOfsPtd_CUR "Torque offset for permitted idle governor torque" CURVE 0x8051F15A RB_Curve_S16_S16 3276.700 md_q0p1 0.00 3276.700 FORMAT "%8.3" EXTENDED_LIMITS -3276.800 3276.700
 /begin AXIS_DESCR STD_AXIS NO_INPUT_QUANTITY EngN 8 -16384.00 16383.50 FORMAT "%8.2" DEPOSIT ABSOLUTE /end AXIS_DESCR
/end CHARACTERISTIC
/begin CHARACTERISTIC EnvT_dmAFSMax_CUR "Load-Engine-Rotation-Area to release the EnvT-modelling" CURVE 0x8051F384 RB_Curve_S16_S16 6553.500 AirMassPerTime -3276.800 3276.700 FORMAT "%8.3"
 /begin AXIS_DESCR STD_AXIS EnvT_nEngStyMod EngN 8 -16384.00 16383.50 FORMAT "%8.2" DEPOSIT ABSOLUTE /end AXIS_DESCR
/end CHARACTERISTIC
/begin CHARACTERISTIC EnvT_dmAFSMinMod_CUR "air mass flow depending on vehicle spped" CURVE 0x8051F3A6 RB_Curve_S16_S16 6553.500 AirMassPerTime -3276.800 3276.700 FORMAT "%8.3"
 /begin AXIS_DESCR STD_AXIS EnvT_vVehStyMod Vel 4 -327.6800 327.6700 FORMAT "%8.4" DEPOSIT ABSOLUTE /end AXIS_DESCR
/end CHARACTERISTIC
/begin CHARACTERISTIC EnvT_drLPPrimModMax_C "Maximum delta load for injection for EnvT-Modelling" VALUE 0x8051F3B8 RB_Val_Ws16 1535.977 rel_sw_q0p0234 -768.0000 767.9766 FORMAT "%8.4" /end CHARACTERISTIC
/begin CHARACTERISTIC EnvT_drLPPrimModMin_C "Minimum delta load for injection for EnvT-Modelling" VALUE 0x8051F3BA RB_Val_Ws16 1535.977 rel_sw_q0p0234 -768.0000 767.9766 FORMAT "%8.4" /end CHARACTERISTIC
/begin CHARACTERISTIC EnvT_dtCEngDsIntkAirMax_C "maximum difference between intake air temperature and engine temperature for initialisation" VALUE 0x8051F3BC RB_Val_Ws16 6553.500 Temp_Cels -3549.940 3003.560 FORMAT "%8.3" /end CHARACTERISTIC
/begin CHARACTERISTIC EnvT_dtCEngDsPrimModBas_C "maximum difference between intake air temperature and engine temperature for cold start detection" VALUE 0x8051F3BE RB_Val_Ws16 6553.500 Temp_Cels -3549.940 3003.560 FORMAT "%8.3" /end CHARACTERISTIC
/begin CHARACTERISTIC EnvT_IfAdprConf_CW "code word for the configuration of EnvT_IfAdpr" VALUE 0x8051F36C RB_Val_Wu8 255.0 dez 0.00 255.0 FORMAT "%5.1" /end CHARACTERISTIC
/begin CHARACTERISTIC EnvT_mAirAcmMinThdOffs_C "Offset for the Minimum threshold of Air Mass Accumulated for environment temperature modelling((Delta value from the previous value of EnvT_mAirAcmThdMdlRels_T))" VALUE 0x8051F3C0 RB_Val_Ws16 655.3500 AirMassKg -327.6800 327.6700 FORMAT "%8.4" /end CHARACTERISTIC
/begin CHARACTERISTIC EnvT_mAirAcmThdMdlRels_T "Curve which gives the threshold of Accumulated Air mass to release the environment temperature model" CURVE 0x8051F3C2 RB_Curve_S16_S16 655.3500 AirMassKg -327.6800 327.6700 FORMAT "%8.4"
 /begin AXIS_DESCR STD_AXIS EnvT_tDifTIntkTEnvMdl Temp_Cels 8 -3549.940 3003.560 FORMAT "%8.3" DEPOSIT ABSOLUTE /end AXIS_DESCR
/end CHARACTERISTIC
/begin CHARACTERISTIC EnvT_mAirModMinHot_C "Threshold for air mass for determination of EnvT-Modelling in case of hot engine" VALUE 0x8051F3E4 RB_Val_Ws16 655.3500 AirMassKg -327.6800 327.6700 FORMAT "%8.4" /end CHARACTERISTIC
/begin CHARACTERISTIC EnvT_mAirModMin_C "Threshold for air mass for determination of EnvT-Modelling" VALUE 0x8051F3E6 RB_Val_Ws16 655.3500 AirMassKg -327.6800 327.6700 FORMAT "%8.4" /end CHARACTERISTIC
/begin CHARACTERISTIC EnvT_maskCEngDsTSq_C "Calibration mask for Signal Quality of Coolant temperature at engine output" VALUE 0x8051F3E8 RB_Val_Wu16 65535.00 OneToOne 0.00 65535.00 FORMAT "%8.2" /end CHARACTERISTIC
/begin CHARACTERISTIC EnvT_maskIntkMnfldSq_C "Calibration mask for signal quality of Intake air temperature in manifold." VALUE 0x8051F3EA RB_Val_Wu16 65535.00 OneToOne 0.00 65535.00 FORMAT "%8.2" /end CHARACTERISTIC
/begin CHARACTERISTIC EnvT_stDfl_C "Default value for ambient temperature sensor" VALUE 0x8051F372 RB_Val_Wu8 255.0 OneToOne 0.00 255.0 FORMAT "%5.1" /end CHARACTERISTIC
/begin CHARACTERISTIC EnvT_stModDfl_C "Default status des EnvT-Modells" VALUE 0x8051F3EC RB_Val_Wu8 255.0 OneToOne 0.00 255.0 FORMAT "%5.1" /end CHARACTERISTIC
/begin CHARACTERISTIC EnvT_swtCfg_CW "Code word (mask) for activating the main feature of the EnvT" VALUE 0x8051F373 RB_Val_Wu8 255.0 OneToOne 0.00 255.0 FORMAT "%5.1" /end CHARACTERISTIC
/begin CHARACTERISTIC EnvT_swtStSensMod_CW "Code word to enabe the sensor based model for EnvT-packet" VALUE 0x8051F374 RB_Val_Wu16 65535.00 OneToOne 0.00 65535.00 FORMAT "%8.2" /end CHARACTERISTIC
/begin CHARACTERISTIC EnvT_tCACDsCmuMax_C "Maximum value of Air_tCACDs for usage as substitute value in the communication time." VALUE 0x8051F376 RB_Val_Ws16 6553.500 Temp_Cels -3549.940 3003.560 FORMAT "%8.3" /end CHARACTERISTIC
/begin CHARACTERISTIC EnvT_tCACDsCmuMin_C "Minimum value of Air_tCACDs for using as substitute value in the communication time" VALUE 0x8051F378 RB_Val_Ws16 6553.500 Temp_Cels -3549.940 3003.560 FORMAT "%8.3" /end CHARACTERISTIC
/begin CHARACTERISTIC EnvT_tCEngDsHotDet_C "Engine temperature to detect a hot engine" VALUE 0x8051F3EE RB_Val_Ws16 6553.500 Temp_Cels -3549.940 3003.560 FORMAT "%8.3" /end CHARACTERISTIC
/begin CHARACTERISTIC EnvT_tCEngDsMaxIniPrimMod_C "Maximum engine temperature to determin EnvT-Model in Initialisation" VALUE 0x8051F3F0 RB_Val_Ws16 6553.500 Temp_Cels -3549.940 3003.560 FORMAT "%8.3" /end CHARACTERISTIC
/begin CHARACTERISTIC EnvT_tCEngDsMaxPrimMod_C "Maximum engine temperature to determin EnvT-Model" VALUE 0x8051F3F2 RB_Val_Ws16 6553.500 Temp_Cels -3549.940 3003.560 FORMAT "%8.3" /end CHARACTERISTIC
/begin CHARACTERISTIC EnvT_tCEngDsMinPrimMod_C "Minimum engine temperature to determin EnvT-Model" VALUE 0x8051F3F4 RB_Val_Ws16 6553.500 Temp_Cels -3549.940 3003.560 FORMAT "%8.3" /end CHARACTERISTIC
/begin CHARACTERISTIC EnvT_tCEngDsPrimModCS_C "Maximum engine temperature to determine a cold start of EnvT-Model" VALUE 0x8051F3F6 RB_Val_Ws16 6553.500 Temp_Cels -3549.940 3003.560 FORMAT "%8.3" /end CHARACTERISTIC
/begin CHARACTERISTIC EnvT_tCEngDsTMax_C "Maximum engine coolant temperature to calculate model value for ambient temperature" VALUE 0x8051F4C4 RB_Val_Ws16 6553.500 Temp_Cels -3549.940 3003.560 FORMAT "%8.3" /end CHARACTERISTIC
/begin CHARACTERISTIC EnvT_tCEngDsWarmPrimMod_C "engine temperature threshold to detect: engine warm" VALUE 0x8051F3F8 RB_Val_Ws16 6553.500 Temp_Cels -3549.940 3003.560 FORMAT "%8.3" /end CHARACTERISTIC
/begin CHARACTERISTIC EnvT_tDifTCEngDsStrtVal_C "Maximum threshold for the difference between CEngDsT and CEngDsT_tStrt so that the Intake Temperature can be reliably applied as modelled Ambient Temperature" VALUE 0x8051F3FA RB_Val_Ws16 6553.500 Temp_Cels -3549.940 3003.560 FORMAT "%8.3" /end CHARACTERISTIC
/begin CHARACTERISTIC EnvT_tiDelSensMeas_C "Duration, in which a EnvT_t-value detected as valid once is retained even after loss of validity." VALUE 0x8051F37A RB_Val_Wu16 6553.500 t_q0p1 0.00 6553.500 FORMAT "%8.3" /end CHARACTERISTIC
/begin CHARACTERISTIC EnvT_tiEngOffPrimModCS_C "minimum engine off time to detect a cold start in EnvT-Modelling" VALUE 0x8051F3FC RB_Val_Ws32 4294967295.00 Time_sec_q1_COMPU -2147483648.00 2147483647.00 FORMAT "%13.2" /end CHARACTERISTIC
/begin CHARACTERISTIC EnvT_tiModHeatingIndcr_C "Time constant of the low pass filter of the environmental temperature model" VALUE 0x8051F400 RB_Val_Wu16 65534.00 t_q1 1.00 65535.00 FORMAT "%8.2" EXTENDED_LIMITS 0.00 65535.00 /end CHARACTERISTIC
/begin CHARACTERISTIC EnvT_tiModStyCnd_C "Delay time for remaining in state modelling of environmental temperature possible" VALUE 0x8051F402 RB_Val_Wu8 255.0 t_q1 0.00 255.0 FORMAT "%5.1" /end CHARACTERISTIC
/begin CHARACTERISTIC EnvT_tiModWrmCntrMin_C "Minimum time of state engine is warm for the release of the environmental temperature modelling" VALUE 0x8051F404 RB_Val_Wu16 65535.00 t_q1 0.00 65535.00 FORMAT "%8.2" /end CHARACTERISTIC
/begin CHARACTERISTIC EnvT_tIntkAirCorrnMdl_C "coefficient to calculate environment temperature" VALUE 0x8051F4C6 RB_Val_Ws16 6553.500 Temp_Cels -3549.940 3003.560 FORMAT "%8.3" /end CHARACTERISTIC
/begin CHARACTERISTIC EnvT_tIntkAirMaxPrimMod_C "Maximum intake air temperature to determine the environmental temperature model" VALUE 0x8051F406 RB_Val_Ws16 6553.500 Temp_Cels -3549.940 3003.560 FORMAT "%8.3" /end CHARACTERISTIC
/begin CHARACTERISTIC EnvT_tIntkAirMinPrimMod_C "Minimum intake air temperature to determine the environmental temperature model" VALUE 0x8051F408 RB_Val_Ws16 6553.500 Temp_Cels -3549.940 3003.560 FORMAT "%8.3" /end CHARACTERISTIC
/begin CHARACTERISTIC EnvT_tIntkCac_C "Default value for the intake air temperature within the CAC communikation" VALUE 0x8051F37C RB_Val_Ws16 6553.500 Temp_Cels -3549.940 3003.560 FORMAT "%8.3" /end CHARACTERISTIC
/begin CHARACTERISTIC EnvT_tIntkDfl_C "Default value for the intake air temperature within the environmental temperature model" VALUE 0x8051F40A RB_Val_Ws16 6553.500 Temp_Cels -3549.940 3003.560 FORMAT "%8.3" /end CHARACTERISTIC
/begin CHARACTERISTIC EnvT_tIntkSnsr_C "calibration parameter to select intake air temperatures." VALUE 0x8051F4C8 RB_Val_Wu8 255.0 OneToOne 0.00 255.0 FORMAT "%5.1" /end CHARACTERISTIC
/begin CHARACTERISTIC EnvT_tiPrimModEngRotDeb_C "Delay time for the locking of cold start after engine rotation" VALUE 0x8051F40C RB_Val_Wu8 255.0 t_q1 0.00 255.0 FORMAT "%5.1" /end CHARACTERISTIC
/begin CHARACTERISTIC EnvT_tiPrimModEngRotFall_C "Delay time for the locking of cold start after engineoff" VALUE 0x8051F40D RB_Val_Wu8 255.0 t_q1 0.00 255.0 FORMAT "%5.1" /end CHARACTERISTIC
/begin CHARACTERISTIC EnvT_tiPrimModIdleHotDet_C "Delay time for the detection of a hot engine in idle state" VALUE 0x8051F40E RB_Val_Wu16 65535.00 t_q1 0.00 65535.00 FORMAT "%8.2" /end CHARACTERISTIC
/begin CHARACTERISTIC EnvT_tModHeatingIndcr_MAP "Compensation for intake air temperature for determination of environmental air temperature" MAP 0x8051F410 RB_Map_S16S16_S16 6553.500 Temp_Cels -3549.940 3003.560 FORMAT "%8.3"
 /begin AXIS_DESCR STD_AXIS EnvT_mfAirCylStyMod AirMassPerTime 8 -3276.800 3276.700 FORMAT "%8.3" DEPOSIT ABSOLUTE /end AXIS_DESCR
 /begin AXIS_DESCR STD_AXIS EnvT_tModHeatgIndcr Temp_Cels 8 -3549.940 3003.560 FORMAT "%8.3" DEPOSIT ABSOLUTE /end AXIS_DESCR
/end CHARACTERISTIC
/begin CHARACTERISTIC EnvT_tPrimModBasHotDetHi_C "Upper Intake air temperature threshold to detect a hot engine" VALUE 0x8051F4B4 RB_Val_Ws16 6553.500 Temp_Cels -3549.940 3003.560 FORMAT "%8.3" /end CHARACTERISTIC
/begin CHARACTERISTIC EnvT_tPrimModBasHotDetLo_C "Lower Intake air temperature threshold to detect a hot engine" VALUE 0x8051F4B6 RB_Val_Ws16 6553.500 Temp_Cels -3549.940 3003.560 FORMAT "%8.3" /end CHARACTERISTIC
/begin CHARACTERISTIC EnvT_tPrimModDfl_C "Default-value for the environmental temperature modelling" VALUE 0x8051F4B8 RB_Val_Ws16 6553.500 Temp_Cels -3549.940 3003.560 FORMAT "%8.3" /end CHARACTERISTIC
/begin CHARACTERISTIC EnvT_tSigValMax_C "Substitute value of the ambient temperature for the tester" VALUE 0x8051F37E RB_Val_Wu8 255.0 temp_q1p0_o40_degC -40.0 215.0 FORMAT "%5.1" /end CHARACTERISTIC
/begin CHARACTERISTIC EnvT_tValMax_C "maximal temperature to detemination the minimal value" VALUE 0x8051F4BA RB_Val_Ws16 6553.500 Temp_Cels -3549.940 3003.560 FORMAT "%8.3" /end CHARACTERISTIC
/begin CHARACTERISTIC EnvT_tVDDfl_C "Default value of the EnvT" VALUE 0x8051F380 RB_Val_Ws16 6553.500 Temp_Cels -3549.940 3003.560 FORMAT "%8.3" /end CHARACTERISTIC
/begin CHARACTERISTIC EnvT_VDMod2_CW "code word 2 to configure the environmental temperature modelling" VALUE 0x8051F4BC RB_Val_Wu8 255.0 OneToOne 0.00 255.0 FORMAT "%5.1" /end CHARACTERISTIC
/begin CHARACTERISTIC EnvT_VDMod3_CW "Code word3 to configure the environmental temperature modelling" VALUE 0x8051F4BD RB_Val_Wu8 255.0 OneToOne 0.00 255.0 FORMAT "%5.1" /end CHARACTERISTIC
/begin CHARACTERISTIC EnvT_VDModSnsrSel_CW "code word for selection the temperatuere sensor" VALUE 0x8051F4BE RB_Val_Wu16 255.0000 OneToOne 0.00 255.0000 FORMAT "%8.4" EXTENDED_LIMITS 0.00 65535.00 /end CHARACTERISTIC
/begin CHARACTERISTIC EnvT_VDMod_CW "Code word to configure the environmental temperature modelling" VALUE 0x8051F4C0 RB_Val_Wu8 255.0 OneToOne 0.00 255.0 FORMAT "%5.1" /end CHARACTERISTIC
/begin CHARACTERISTIC EnvT_vVehMinMdl_C "Minimum vehicle velocity to calculate model value for ambient temperature" VALUE 0x8051F4CA RB_Val_Ws16 655.3500 Vel -327.6800 327.6700 FORMAT "%8.4" /end CHARACTERISTIC
/begin CHARACTERISTIC EnvT_vVehMinMod_C "Minimum vehicle speed to determine the environmental temperature model" VALUE 0x8051F4C2 RB_Val_Ws16 655.3500 Vel -327.6800 327.6700 FORMAT "%8.4" /end CHARACTERISTIC
/begin CHARACTERISTIC EpmBCr_facEngSpdRange_CUR "Defines engine speed range dependent factors for calculating the timeout angle in Backup Crankshaft mode." CURVE 0x8051F4D0 RB_Curve_S16_U16_Static 15.93750 EPM_FAC_PLAUS 0.00 15.93750 FORMAT "%8.5" EXTENDED_LIMITS 0.00 4095.938
 /begin AXIS_DESCR STD_AXIS EpmBCr_nEng EngN 4 0.00 16383.50 FORMAT "%8.2" EXTENDED_LIMITS -16384.00 16383.50 DEPOSIT ABSOLUTE /end AXIS_DESCR
/end CHARACTERISTIC
/begin CHARACTERISTIC EpmBCr_nEngPttFailTol_C "Maximum engine speed before toleranz mechanism gets deactivated" VALUE 0x8051F4CC RB_Val_Ws16 6000.000 EngN 0.00 6000.000 FORMAT "%8.3" EXTENDED_LIMITS -16384.00 16383.50 /end CHARACTERISTIC
/begin CHARACTERISTIC EpmBCr_nrPttMtchFailMaxEve_C "Number of events where a mismatching pattern (due to incorrect segment duration time) is tolerated." VALUE 0x8051F4CE RB_Val_Wu8 15.00 OneToOne 0.00 15.00 FORMAT "%5.2" EXTENDED_LIMITS 0.00 255.0 /end CHARACTERISTIC
/begin CHARACTERISTIC EpmBCr_rSegLimLowr_C "Lower limit to detect a segment duration time ratio being approximately 1" VALUE 0x8053AD5C Val_Wu32 4294967.29500 EPMBCR_FACRATIO 0.00 4294967.29500 FORMAT "%13.5" /end CHARACTERISTIC
/begin CHARACTERISTIC EpmBCr_rSegLimUppr_C "Upper limit to detect a segment duration time ratio being approximately 1" VALUE 0x8053AD60 Val_Wu32 4294967.29500 EPMBCR_FACRATIO 0.00 4294967.29500 FORMAT "%13.5" /end CHARACTERISTIC
/begin CHARACTERISTIC EpmBCr_swtEnable_C "Enable Backup without Crankshaft" VALUE 0x8053AD56 Val_Wu8 2.000 OneToOne 0.00 2.000 FORMAT "%5.3" EXTENDED_LIMITS 0.00 255.0 /end CHARACTERISTIC
/begin CHARACTERISTIC EpmBCr_swtUpdEdge_C "Switch to decide whether backup mode without crankshaft does calculate engine speed and angle clock frequency at all camshaft edges or only at equidistant edges." VALUE 0x8053AD64 RB_Val_Wu8 1.00000000000 EpmBCr_swtUpdEdge_CM 0.00 1.00000000000 FORMAT "%13.11" /end CHARACTERISTIC
/begin CHARACTERISTIC EpmBCr_tEna_C "Threshold engine temperature to allow backup crankshaft" VALUE 0x8053AD58 Val_Ws16 6500.000 Temp_Cels -3500.040 2999.960 FORMAT "%8.3" EXTENDED_LIMITS -3549.940 3003.560 /end CHARACTERISTIC
/begin CHARACTERISTIC EpmCaS_dSegSeries_CA "series of camshaft segments" VAL_BLK 0x8053AD80 ValA_Wu8 255.0 OneToOne 0.00 255.0 FORMAT "%5.1" NUMBER 8 /end CHARACTERISTIC
/begin CHARACTERISTIC EpmCaS_facAdapFil_C "filterfactor for the camshaft adaption" VALUE 0x8051F4E4 Val_Ws32 1.00000000000 EpmCaS_Fac_Adap 0.00 1.00000000000 FORMAT "%13.11" EXTENDED_LIMITS -2147483.64800 2147483.64700 /end CHARACTERISTIC
/begin CHARACTERISTIC EpmCaS_facPlausHigh_GCUR "factor for the upper limit of the plaus-check of the camshaft-signals" CURVE 0x8053AD88 CurG_Ws16 65.53500 EpmCaS_Fac_Plaus -32.76800 32.76700 FORMAT "%8.5"
 /begin AXIS_DESCR COM_AXIS EpmCaS_nEng EngN 80 -16384.00 16383.50 FORMAT "%8.2" AXIS_PTS_REF EpmCaS_facPlaus_DST /end AXIS_DESCR
/end CHARACTERISTIC
/begin CHARACTERISTIC EpmCaS_facPlausLow_GCUR "factor for the lower limit of the plaus-check of the camshaft-signals" CURVE 0x8053AE28 CurG_Ws16 65.53500 EpmCaS_Fac_Plaus -32.76800 32.76700 FORMAT "%8.5"
 /begin AXIS_DESCR COM_AXIS EpmCaS_nEng EngN 80 -16384.00 16383.50 FORMAT "%8.2" AXIS_PTS_REF EpmCaS_facPlaus_DST /end AXIS_DESCR
/end CHARACTERISTIC
/begin AXIS_PTS EpmCaS_facPlaus_DST "Distribution values for the camshaft-signal plausibilisation" 0x8053AEC8 EpmCaS_nEng Axis_Xs16 32767.50 EngN 80 -16384.00 16383.50 FORMAT "%8.2" DEPOSIT ABSOLUTE /end AXIS_PTS
/begin CHARACTERISTIC EpmCaS_flgSwtSnglEdgeTol_C "Switch for activation of the single edge tolerance of the CTEDGE functionality for systems with variable camshaft" VALUE 0x8053AD6A Val_Wu8 255.0 OneToOne 0.00 255.0 FORMAT "%5.1" /end CHARACTERISTIC
/begin CHARACTERISTIC EpmCaS_nEngAdpnRlsMax_C "Maximum Engine Speed for Release of Camshaft adaptation and Offset diagnosis" VALUE 0x8051F4E8 Val_Ws16 10000.00 EngN 0.00 10000.00 FORMAT "%8.2" EXTENDED_LIMITS -16384.00 16383.50 /end CHARACTERISTIC
/begin CHARACTERISTIC EpmCaS_nEngAdpnRlsMin_C "Minimum Engine Speed for Release of Camshaft adaptation and Offset diagnosis" VALUE 0x8051F4EA Val_Ws16 10000.00 EngN 0.00 10000.00 FORMAT "%8.2" EXTENDED_LIMITS -16384.00 16383.50 /end CHARACTERISTIC
/begin CHARACTERISTIC EpmCaS_nMaxCaSSigInvld_C "Maximum engine speed threshold above which camshaft sensor signal is invalid" VALUE 0x8053AF6A Val_Ws16 16000.00 EngN 0.00 16000.00 FORMAT "%8.2" EXTENDED_LIMITS -16384.00 16383.50 /end CHARACTERISTIC
/begin CHARACTERISTIC EpmCaS_nMaxCaSSigVld_C "maximum engine speed at which cam signal is valid" VALUE 0x8053AF6C Val_Ws16 16000.00 EngN 0.00 16000.00 FORMAT "%8.2" EXTENDED_LIMITS -16384.00 16383.50 /end CHARACTERISTIC
/begin CHARACTERISTIC EpmCaS_nMinCaSSigInvld_C "Minimum engine speed threshold below which camshaft sensor signal is invalid" VALUE 0x8053AF6E Val_Ws16 16000.00 EngN 0.00 16000.00 FORMAT "%8.2" EXTENDED_LIMITS -16384.00 16383.50 /end CHARACTERISTIC
/begin CHARACTERISTIC EpmCaS_nMinCaSSigVld_C "minimum engine speed at which cam signal is valid" VALUE 0x8053AF70 Val_Ws16 16000.00 EngN 0.00 16000.00 FORMAT "%8.2" EXTENDED_LIMITS -16384.00 16383.50 /end CHARACTERISTIC
/begin CHARACTERISTIC EpmCaS_nrMaxTryAdpn_C "Calibratable number of adaptation tries or Maximum number of loops for Adaptation cycles" VALUE 0x8053AD68 Val_Wu16 65534.00 OneToOne 1.00 65535.00 FORMAT "%8.2" EXTENDED_LIMITS 0.00 65535.00 /end CHARACTERISTIC
/begin CHARACTERISTIC EpmCaS_numEdgeFltAvrg_CA "Definition of Reference edge for correcting position of current edge (number of equidistand edges before current edge)" VAL_BLK 0x8053AF72 ValA_Wu8 255.0 OneToOne 0.00 255.0 FORMAT "%5.1" NUMBER 1 /end CHARACTERISTIC
/begin CHARACTERISTIC EpmCaS_numErrSigDef_C "Limit of the debounce counter for recognizing a defect when camshaft disturbance occurs" VALUE 0x8053AD6C Val_Wu16 248.0000 CrSRev2CrSInc 2.0000 250.0000 FORMAT "%8.4" EXTENDED_LIMITS 0.00 1820.417 /end CHARACTERISTIC
/begin CHARACTERISTIC EpmCaS_numErrSigOk_C "Limit of the debounce counter for healing a recognized camshaft disturbance" VALUE 0x8053AD6E Val_Wu16 248.0000 CrSRev2CrSInc 2.0000 250.0000 FORMAT "%8.4" EXTENDED_LIMITS 0.00 1820.417 /end CHARACTERISTIC
/begin CHARACTERISTIC EpmCaS_numNoSigDef_C "Limit for debounce counter to recognize the loss of a camshaft signal" VALUE 0x8053AD70 Val_Wu16 248.0000 CrSRev2CrSInc 2.0000 250.0000 FORMAT "%8.4" EXTENDED_LIMITS 0.00 1820.417 /end CHARACTERISTIC
/begin CHARACTERISTIC EpmCaS_numOfsErr_C "number of camshaft revolution until fault path DFC_EpmCaS..OfsErr will set" VALUE 0x8053AD76 Val_Wu8 255.0 OneToOne 0.00 255.0 FORMAT "%5.1" /end CHARACTERISTIC
/begin CHARACTERISTIC EpmCaS_numPriCamSel_C "Primary camshaft which is used to calculate the engine speed from camshaft and to support backup mode" VALUE 0x8053AF73 Val_Wu8 0.00 OneToOne 0.00 0.00 FORMAT "%5.2" EXTENDED_LIMITS 0.00 255.0 /end CHARACTERISTIC
/begin CHARACTERISTIC EpmCaS_numSegSerLst_C "index of last segmment in EpmCaS_dSegSeries" VALUE 0x8053AF74 Val_Wu8 7.000 OneToOne 0.00 7.000 FORMAT "%5.3" EXTENDED_LIMITS 0.00 255.0 /end CHARACTERISTIC
/begin CHARACTERISTIC EpmCaS_phiDiffAdapMax_C "maximum angle-difference between real and adapted angle - adaption is running until this angle is reached" VALUE 0x8051F4EC Val_Ws16 5.998535 AngleCrS 0.00 5.998535 FORMAT "%8.6" EXTENDED_LIMITS -720.0000 719.9780 /end CHARACTERISTIC
/begin CHARACTERISTIC EpmCaS_phiDiffLim_C "maximum angle-difference between real and adapted angle during adaption" VALUE 0x8051F4EE Val_Ws16 50.00977 AngleCrS 0.00 50.00977 FORMAT "%8.5" EXTENDED_LIMITS -720.0000 719.9780 /end CHARACTERISTIC
/begin CHARACTERISTIC EpmCaS_phiEdgeDvtMax_CA "Deactivation of filter if the dynamics between the reference edge and the current edge are larger than the corresponding value in EpmCaS_phiEdgeDvtMax_CA" VAL_BLK 0x8053AF76 ValA_Ws16 1439.978 AngleCrS -720.0000 719.9780 FORMAT "%8.4" NUMBER 1 /end CHARACTERISTIC
/begin CHARACTERISTIC EpmCaS_phiLoLimIn_C "Lower angle limit of the actuator range for the intake camshaft (including tolerances)" VALUE 0x8053AF78 Val_Ws16 1439.978 AngleCrS -720.0000 719.9780 FORMAT "%8.4" /end CHARACTERISTIC
/begin CHARACTERISTIC EpmCaS_phiNCorI1_CUR "engine speed dependent angle correction value of the inlet camshaft signal1" CURVE 0x8053AF7A Cur_Xs16Ws16 1439.978 AngleCrS -720.0000 719.9780 FORMAT "%8.4"
 /begin AXIS_DESCR STD_AXIS Epm_nEng EngN 6 -16384.00 16383.50 FORMAT "%8.2" DEPOSIT ABSOLUTE /end AXIS_DESCR
/end CHARACTERISTIC
/begin CHARACTERISTIC EpmCaS_phiOfsMax_C "max. tolerated angle offset between camshaft and crankshaft" VALUE 0x8053AD78 Val_Ws16 1439.978 AngleCrS -720.0000 719.9780 FORMAT "%8.4" /end CHARACTERISTIC
/begin CHARACTERISTIC EpmCaS_phiOfsMin_C "min. tolerated offset between camshaft and crankshaft" VALUE 0x8053AD7A Val_Ws16 1439.978 AngleCrS -720.0000 719.9780 FORMAT "%8.4" /end CHARACTERISTIC
/begin CHARACTERISTIC EpmCaS_phiSegLenTol_CA "tolerance of each segment length" VAL_BLK 0x8053AF94 ValA_Ws16 1439.978 AngleCrS -720.0000 719.9780 FORMAT "%8.4" NUMBER 2 /end CHARACTERISTIC
/begin CHARACTERISTIC EpmCaS_phiSegLen_CA "length of camshaft segments" VAL_BLK 0x8053AF98 ValA_Ws16 719.9780 AngleCrS 0.00 719.9780 FORMAT "%8.4" EXTENDED_LIMITS -720.0000 719.9780 NUMBER 2 /end CHARACTERISTIC
/begin CHARACTERISTIC EpmCaS_phiSegOfs_CA "angle between physical zeroposition and start of EpmCaS_dSegSeries_C" VAL_BLK 0x8053AF9C ValA_Ws16 719.9780 AngleCrS 0.00 719.9780 FORMAT "%8.4" EXTENDED_LIMITS -720.0000 719.9780 NUMBER 1 /end CHARACTERISTIC
/begin AXIS_PTS EpmCaS_phiTempCor05_DST "distribution for camshaft angle correction depending on temperature" 0x8053AF9E EpmIf_tCoolant Axis_Xs16 6553.500 Temp_Cels 3 -3549.940 3003.560 FORMAT "%8.3" DEPOSIT ABSOLUTE /end AXIS_PTS
/begin CHARACTERISTIC EpmCaS_phiTempCorEngI1_CUR "Angle correction for first inlet camshaft based on temperature correction" CURVE 0x8053AFA6 Cur_Xs16Ws16 1439.978 AngleCrS -720.0000 719.9780 FORMAT "%8.4"
 /begin AXIS_DESCR STD_AXIS EpmCaS_tAgSnsrCorr Temp_Cels 10 -3549.940 3003.560 FORMAT "%8.3" DEPOSIT ABSOLUTE /end AXIS_DESCR
/end CHARACTERISTIC
/begin CHARACTERISTIC EpmCaS_phiTempCorI1_GCUR "angle correction for first inletcamshaft depending on temperature distribution" CURVE 0x8053AFD0 CurG_Ws16 1439.978 AngleCrS -720.0000 719.9780 FORMAT "%8.4"
 /begin AXIS_DESCR COM_AXIS EpmIf_tCoolant Temp_Cels 3 -3549.940 3003.560 FORMAT "%8.3" AXIS_PTS_REF EpmCaS_phiTempCor05_DST /end AXIS_DESCR
/end CHARACTERISTIC
/begin CHARACTERISTIC EpmCaS_phiUpLimIn_C "Upper angle limit of the actuator range for the intake camshaft (including tolerances)" VALUE 0x8053AFD6 Val_Ws16 1439.978 AngleCrS -720.0000 719.9780 FORMAT "%8.4" /end CHARACTERISTIC
/begin CHARACTERISTIC EpmCaS_ratLoadAdpnRlsMax_C "Maximum Engine rate load for Release of Camshaft adaptation and Offset diagnosis" VALUE 0x8051F4F0 Val_Ws16 799.9878 Prc -400.0000 399.9878 FORMAT "%8.4" /end CHARACTERISTIC
/begin CHARACTERISTIC EpmCaS_ratLoadAdpnRlsMin_C "Minimum Engine rate load for Release of Camshaft adaptation and Offset diagnosis" VALUE 0x8051F4F2 Val_Ws16 799.9878 Prc -400.0000 399.9878 FORMAT "%8.4" /end CHARACTERISTIC
/begin CHARACTERISTIC EpmCaS_stActEdge_C "type of camshaft edges to be detected" VALUE 0x8053AFD8 Val_Wu8 255.0 OneToOne 0.00 255.0 FORMAT "%5.1" /end CHARACTERISTIC
/begin CHARACTERISTIC EpmCaS_stDiagMode_C "Disable the camshaft diagnosis in EPM_MODE_OK if a camshaft fault is already detected." VALUE 0x8053AD72 Val_Wu8 255.0 OneToOne 0.00 255.0 FORMAT "%5.1" /end CHARACTERISTIC
/begin CHARACTERISTIC EpmCas_stDirOfsAvrgUnflt_C "direction of unfiltered angular displacement of the camshaft" VALUE 0x8053AD7C Val_Wu8 255.0 OneToOne 0.00 255.0 FORMAT "%5.1" /end CHARACTERISTIC
/begin CHARACTERISTIC EpmCaS_stMinSyncCaSAg_C "minimal value of Epm_stSync after which the calculation of camshaft edges starts" VALUE 0x8053AFD9 Val_Wu8 20.00 OneToOne 10.00 30.00 FORMAT "%5.2" EXTENDED_LIMITS 0.00 255.0 /end CHARACTERISTIC
/begin CHARACTERISTIC EpmCaS_stOfsDiagMode_C "Disable of camshaft offset in EPM_MODE_OK" VALUE 0x8053AD7D Val_Wu8 7.000 OneToOne 0.00 7.000 FORMAT "%5.3" EXTENDED_LIMITS 0.00 255.0 /end CHARACTERISTIC
/begin CHARACTERISTIC EpmCaS_swtAdapStgy_C "strategy of the camshaft edge adaption" VALUE 0x8051F4F4 Val_Wu8 1.000 OneToOne 0.00 1.000 FORMAT "%5.3" EXTENDED_LIMITS 0.00 255.0 /end CHARACTERISTIC
/begin CHARACTERISTIC EpmCaS_swtAdpnRlsTSel_C "Selection of temperature for camshaft adaption" VALUE 0x8051F4F5 Val_Wu8 1.00000000000 EpmIf_swtTSel_VERB 0.00 1.00000000000 FORMAT "%13.11" /end CHARACTERISTIC
/begin CHARACTERISTIC EpmCaS_swtMeasCaS_C "Switch for measuring the camshaft raw values" VALUE 0x8053AD74 Val_Wu8 32.00 OneToOne 0.00 32.00 FORMAT "%5.2" EXTENDED_LIMITS 0.00 255.0 /end CHARACTERISTIC
/begin CHARACTERISTIC EpmCaS_swtOfsDiagTSel_C "Selection of temperature for camshaft offset analysis" VALUE 0x8051F4FC Val_Wu8 1.00000000000 EpmIf_swtTSel_VERB 0.00 1.00000000000 FORMAT "%13.11" /end CHARACTERISTIC
/begin CHARACTERISTIC EpmCaS_swtSegTSel_C "Selection of temperature for camshaft angle correction" VALUE 0x8051F4FD Val_Wu8 1.00000000000 EpmIf_swtTSel_VERB 0.00 1.00000000000 FORMAT "%13.11" /end CHARACTERISTIC
/begin CHARACTERISTIC EpmCaS_swtSeg_C "Setting for the calculation strategy of camshaft angle" VALUE 0x8053AFDA Val_Wu8 255.0 OneToOne 0.00 255.0 FORMAT "%5.1" /end CHARACTERISTIC
/begin CHARACTERISTIC EpmCaS_tEngAdpnRlsMax_C "Maximum Engine temperature for Release of Camshaft adaptation and Offset diagnosis" VALUE 0x8051F4F6 Val_Ws16 6553.500 Temp_Cels -3549.940 3003.560 FORMAT "%8.3" /end CHARACTERISTIC
/begin CHARACTERISTIC EpmCaS_tEngAdpnRlsMin_C "Minimum Engine temperature for Release of Camshaft adaptation and Offset diagnosis" VALUE 0x8051F4F8 Val_Ws16 6553.500 Temp_Cels -3549.940 3003.560 FORMAT "%8.3" /end CHARACTERISTIC
/begin CHARACTERISTIC EpmCaS_tiDlyAdpnRls_C "Delay for Release of Camshaft adaptation and Offset diagnosis" VALUE 0x8051F4FA Val_Wu16 655.3500 Time_s 0.00 655.3500 FORMAT "%8.4" /end CHARACTERISTIC
/begin CHARACTERISTIC EpmCaS_tiGlitchFilter_C "filtertime for the camshaft signal" VALUE 0x8053AFDC Val_Ws32 4294967295.00 OneToOne_us -2147483648.00 2147483647.00 FORMAT "%13.2" /end CHARACTERISTIC
/begin CHARACTERISTIC EpmCaS_tiOfsPT1_C "time factor for filtering camshaft offset" VALUE 0x8053AD7E Val_Wu16 4294901.8 TimeDelay_ms 65.5 4294967.3 FORMAT "%12.1" /end CHARACTERISTIC
/begin CHARACTERISTIC EpmCaS_tiTimeout_C "after the last camshaftedge the system waits this time and then the valid time entries in the camshaftbuffer are cleared" VALUE 0x8053AFE0 Val_Ws32 42949672950.0 Time_ms -21474836480.0 21474836470.0 FORMAT "%13.1" /end CHARACTERISTIC
/begin CHARACTERISTIC EpmCaS_tRefCal_C "reference temperature for camshaft calibration" VALUE 0x8053AFE4 Val_Ws16 6553.500 Temp_Cels -3549.940 3003.560 FORMAT "%8.3" /end CHARACTERISTIC
/begin CHARACTERISTIC EpmCrS_dnEngMax_C "max. engine deceleration to calculate the diagnosis for a disturbances of the crankshaft signal" VALUE 0x8053AFE8 Val_Ws16 32767.00 EngNGrd -16383.50 16383.50 FORMAT "%8.2" EXTENDED_LIMITS -16384.00 16383.50 /end CHARACTERISTIC
/begin CHARACTERISTIC EpmCrS_nDiagOff_C "engine speed threshold to switch off the crankshaft diagnosis" VALUE 0x8053AFEA Val_Ws16 8000.000 EngN 0.00 8000.000 FORMAT "%8.3" EXTENDED_LIMITS -16384.00 16383.50 /end CHARACTERISTIC
/begin CHARACTERISTIC EpmCrS_nDiagOn_C "Engine speed to switch on the crankshaft diagnosis" VALUE 0x8053AFEC Val_Ws16 8000.000 EngN 0.00 8000.000 FORMAT "%8.3" EXTENDED_LIMITS -16384.00 16383.50 /end CHARACTERISTIC
/begin CHARACTERISTIC EpmCrS_numErrSigIncDef_C "step wide defect debouncing crankshaft disturbance" VALUE 0x8053AFEE Val_Ws16 32767.00 OneToOne 0.00 32767.00 FORMAT "%8.2" EXTENDED_LIMITS -32768.00 32767.00 /end CHARACTERISTIC
/begin CHARACTERISTIC EpmCrS_numErrSigIncOK_C "alternative decrement for error healing" VALUE 0x8053AFF0 Val_Ws16 32767.00 OneToOne 0.00 32767.00 FORMAT "%8.2" EXTENDED_LIMITS -32768.00 32767.00 /end CHARACTERISTIC
/begin CHARACTERISTIC EpmCrS_numErrSigMaxDef_C "max. number of disturbance until fault report crankshaft disturbance" VALUE 0x8053AFF2 Val_Ws16 32767.00 OneToOne 0.00 32767.00 FORMAT "%8.2" EXTENDED_LIMITS -32768.00 32767.00 /end CHARACTERISTIC
/begin CHARACTERISTIC EpmCrS_numErrSigMinOK_C "min. number of plausible crankshaft revolutions until healing" VALUE 0x8053AFF4 Val_Ws16 32767.00 OneToOne 0.00 32767.00 FORMAT "%8.2" EXTENDED_LIMITS -32768.00 32767.00 /end CHARACTERISTIC
/begin CHARACTERISTIC EpmCrS_numNoSigDef_C "number of camshaft revolutions until fault report ""no crankshaft signal""" VALUE 0x8053AFF6 Val_Ws16 32767.00 OneToOne 0.00 32767.00 FORMAT "%8.2" EXTENDED_LIMITS -32768.00 32767.00 /end CHARACTERISTIC
/begin CHARACTERISTIC EpmCrS_stDiagT50Reset_C "usage of terminal 50 information for crankshaft diagnosis" VALUE 0x8053AFF8 Val_Wu8 1.000 OneToOne 0.00 1.000 FORMAT "%5.3" EXTENDED_LIMITS 0.00 255.0 /end CHARACTERISTIC
/begin CHARACTERISTIC EpmCrS_swtEnableDiag_C "Switch off crankshaft diagnosis" VALUE 0x8053AFF9 Val_Wu8 255.0 OneToOne 0.00 255.0 FORMAT "%5.1" /end CHARACTERISTIC
/begin CHARACTERISTIC EpmCrS_swtRstDiag_C "Switch for resetting crankshaft diagnosis DFCs" VALUE 0x8053AFFA Val_Wu8 255.0 OneToOne 0.00 255.0 FORMAT "%5.1" /end CHARACTERISTIC
/begin CHARACTERISTIC EpmCrS_VehV_v_Max_C "Upper limit of car speed to deactivate the diagnosis" VALUE 0x8053AFFC Val_Ws16 655.3500 Vel -327.6800 327.6700 FORMAT "%8.4" /end CHARACTERISTIC
/begin CHARACTERISTIC EpmCrS_VehV_v_Min_C "Lower limit of car speed to deactivate the diagnosis" VALUE 0x8053AFFE Val_Ws16 655.3500 Vel -327.6800 327.6700 FORMAT "%8.4" /end CHARACTERISTIC
/begin CHARACTERISTIC MoXTrqPtd_facTqErrMax_C "maximal increment of MoXTrqPtd_facTqErrSum per time" VALUE 0x8051F17C RB_Val_Ws16 127.9980 rel_q0p00195_pc_s -64.00000 63.99805 FORMAT "%8.5" /end CHARACTERISTIC
/begin CHARACTERISTIC MoXTrqPtd_facTqErrMin_C "maximal decrement of MoXTrqPtd_facTqErrSum per time" VALUE 0x8051F17E RB_Val_Ws16 127.9980 rel_q0p00195_pc_s -64.00000 63.99805 FORMAT "%8.5" /end CHARACTERISTIC
/begin CHARACTERISTIC MoXTrqPtd_facTqErrSumActvn_C "threshold for MoXTrqPtd_facTqErrSum to activate torque limitation from extended monitoring" VALUE 0x8051F180 RB_Val_Wu16 127.9980 rel_q0p00195_pc_s 0.00 127.9980 FORMAT "%8.4" /end CHARACTERISTIC
/begin CHARACTERISTIC MoXTrqPtd_facTqErrSumDeactvn_C "threshold for MoXTrqPtd_facTqErrSum to deactivate torque limitation from extended monitoring" VALUE 0x8051F182 RB_Val_Wu16 127.9980 rel_q0p00195_pc_s 0.00 127.9980 FORMAT "%8.4" /end CHARACTERISTIC
/begin CHARACTERISTIC MoXTrqPtd_flgEngLimActvdMnl_C "Calibration value for permanently activation of limitation of extended monitoring" VALUE 0x8051F184 RB_Val_Wu8 1.00000000000 B_TRUE 0.00 1.00000000000 FORMAT "%13.11" /end CHARACTERISTIC
/begin CHARACTERISTIC MoXTrqPtd_tiDelRatTqPtdLvl2_C "delay time for the filtering of the permitted torque" VALUE 0x8051F186 RB_Val_Wu16 1310.720 t_q0p04 0.00 1310.720 FORMAT "%8.3" EXTENDED_LIMITS 0.00 2621.400 /end CHARACTERISTIC
/begin CHARACTERISTIC MoXTrqPtd_tiEngLimDeactv_C "debounce time for the determination of the condition MoXTrqPtd_flgEngLimDeactv_MP" VALUE 0x8051F188 RB_Val_Wu16 2621.400 t_q0p04 0.00 2621.400 FORMAT "%8.3" /end CHARACTERISTIC
/begin CHARACTERISTIC MoXTrqPtd_tiExtIntDeactv_C "Deactivation delay time for level2 status of gearbox intervention" VALUE 0x8051F18A RB_Val_Wu16 655.3500 t_q0p01 0.00 655.3500 FORMAT "%8.4" /end CHARACTERISTIC
/begin CHARACTERISTIC MoXTrqPtd_tiFltRatTqPtdLvl2_C "low pass time constant for permitted torque in extended monitoring" VALUE 0x8051F18C RB_Val_Wu16 2621.3600000 zk40msxs_uw_b2621p4 0.0400000 2621.4000000 FORMAT "%12.7" /end CHARACTERISTIC
/begin CHARACTERISTIC MoXTrqPtd_tqInrPtdSetDeactvn_C "threshold for EngTrqPtd_trqSet to deactivate torque limitation from extended monitoring" VALUE 0x8051F18E RB_Val_Ws16 3276.700 md_q0p1 0.00 3276.700 FORMAT "%8.3" EXTENDED_LIMITS -3276.800 3276.700 /end CHARACTERISTIC
/begin CHARACTERISTIC MoXTrqPtd_tqOffsLvl2_M "offset for the permitted inner torque (corresponding level 2)" MAP 0x8051F190 RB_Map_U8S16_S16 6553.500 Trq -3276.800 3276.700 FORMAT "%8.3"
 /begin AXIS_DESCR STD_AXIS MoFESpd_nEng nmot_q40 8 0.00 10200. FORMAT "%5.0" DEPOSIT ABSOLUTE /end AXIS_DESCR
 /begin AXIS_DESCR STD_AXIS MoXTrqPtd_tqInrPtd Trq 8 -3276.800 3276.700 FORMAT "%8.3" DEPOSIT ABSOLUTE /end AXIS_DESCR
/end CHARACTERISTIC
/begin CHARACTERISTIC MoXTrqPtd_tqPtdFltTqLimLeadOffs_C "offset for the determination of MoXTrqPtd_flgPtdFltEngLimLeadDeactv_MP" VALUE 0x8051F22A RB_Val_Ws16 3276.700 Trq 0.00 3276.700 FORMAT "%8.3" EXTENDED_LIMITS -3276.800 3276.700 /end CHARACTERISTIC
/begin CHARACTERISTIC MoXTrqPtd_tqPtdFltTqLimSetOffs_C "offset for the determination of MoXTrqPtd_flgPtdFltEngLimSetDeactv_MP" VALUE 0x8051F22C RB_Val_Ws16 3276.700 Trq 0.00 3276.700 FORMAT "%8.3" EXTENDED_LIMITS -3276.800 3276.700 /end CHARACTERISTIC
/begin CHARACTERISTIC MoX_ctTrqCmpEngLimActvn_C "threshold for MoF_ctTrqCmp to activate torque limitation from extended monitoring" VALUE 0x8051F22E RB_Val_Wu8 255.0 OneToOne 0.00 255.0 FORMAT "%5.1" /end CHARACTERISTIC
/begin CHARACTERISTIC MoX_rTrqPtdFltWgh_CUR "weighting of the filtered permissible torque in function monitoring" CURVE 0x8051F22F RB_Curve_U8_U8 99.22 rel_q0p39 0.39 99.61 FORMAT "%5.2" EXTENDED_LIMITS 0.00 99.61
 /begin AXIS_DESCR STD_AXIS NO_INPUT_QUANTITY rel_q0p39 8 0.00 99.61 FORMAT "%5.2" DEPOSIT ABSOLUTE /end AXIS_DESCR
/end CHARACTERISTIC
/begin CHARACTERISTIC MoX_tiEvacIntMan_C "the discharge time of the intake manifold in extended monitoring" VALUE 0x8051F240 RB_Val_Wu16 1310.720 t_q0p04 0.00 1310.720 FORMAT "%8.3" EXTENDED_LIMITS 0.00 2621.400 /end CHARACTERISTIC
/begin CHARACTERISTIC MoX_tiFltDash_C "low pass filter time constant for permissible torque in extended monitoring" VALUE 0x8051F242 RB_Val_Wu16 2621.3600000 zk40msxs_uw_b2621p4 0.0400000 2621.4000000 FORMAT "%12.7" /end CHARACTERISTIC
/begin CHARACTERISTIC MoX_trqInrMaxStrt_C "maximum inner torque during start in extended monitoring" VALUE 0x8051F244 RB_Val_Ws16 6553.500 md_q0p1 -3276.800 3276.700 FORMAT "%8.3" /end CHARACTERISTIC
/begin CHARACTERISTIC MoX_trqNorm_C "maximum indicated engine torque for torque standardisation" VALUE 0x8051F246 RB_Val_Ws16 3276.700 md_q0p1 0.00 3276.700 FORMAT "%8.3" EXTENDED_LIMITS -3276.800 3276.700 /end CHARACTERISTIC
/begin CHARACTERISTIC MoX_trqOfs_MAP "offset for maximum permissible torque" MAP 0x8051F248 RB_Map_S16S16_S16 6553.500 md_q0p1 -3276.800 3276.700 FORMAT "%8.3"
 /begin AXIS_DESCR STD_AXIS Epm_nEng EngN 8 -16384.00 16383.50 FORMAT "%8.2" DEPOSIT ABSOLUTE /end AXIS_DESCR
 /begin AXIS_DESCR STD_AXIS MoXTqPtd_tqInrDes md_q0p1 8 -3276.800 3276.700 FORMAT "%8.3" DEPOSIT ABSOLUTE /end AXIS_DESCR
/end CHARACTERISTIC
/begin CHARACTERISTIC NENG.nStrtEnd_GM "Class instance to detect end of start based on engine speed threshold / Map engine speed threshold to detect end of start" MAP 0x8051EC38 RB_MapGroup_S16 32767.50 EngN -16384.00 16383.50 FORMAT "%8.2"
 /begin AXIS_DESCR COM_AXIS EngStrt_tCoor Temp_Cels 12 -273.140 3003.560 FORMAT "%8.3" EXTENDED_LIMITS -3549.940 3003.560 AXIS_PTS_REF EngStrt_tStrtEnd_AX /end AXIS_DESCR
 /begin AXIS_DESCR COM_AXIS PEnv_p p_q0p039 8 0.00 2559.961 FORMAT "%8.3" AXIS_PTS_REF EngStrt_pStrtEnd_AX /end AXIS_DESCR
/end CHARACTERISTIC
/begin CHARACTERISTIC NENGCRIT.nStrtEndCrit_GM "Class instance to detect end of start based on engine speed threshold under critical start condition / Map engine speed threshold for critical start condition to detect end of start" MAP 0x8051ECFC RB_MapGroup_S16 32767.50 EngN -16384.00 16383.50 FORMAT "%8.2"
 /begin AXIS_DESCR COM_AXIS EngStrt_tCoor Temp_Cels 12 -273.140 3003.560 FORMAT "%8.3" EXTENDED_LIMITS -3549.940 3003.560 AXIS_PTS_REF EngStrt_tStrtEnd_AX /end AXIS_DESCR
 /begin AXIS_DESCR COM_AXIS PEnv_p p_q0p039 8 0.00 2559.961 FORMAT "%8.3" AXIS_PTS_REF EngStrt_pStrtEnd_AX /end AXIS_DESCR
/end CHARACTERISTIC
/begin CHARACTERISTIC NENGCRIT.nStrtEnd_GM "Class instance to detect end of start based on engine speed threshold under critical start condition / Map engine speed threshold to detect end of start" MAP 0x8051EDBC RB_MapGroup_S16 32767.50 EngN -16384.00 16383.50 FORMAT "%8.2"
 /begin AXIS_DESCR COM_AXIS EngStrt_tCoor Temp_Cels 12 -273.140 3003.560 FORMAT "%8.3" EXTENDED_LIMITS -3549.940 3003.560 AXIS_PTS_REF EngStrt_tStrtEnd_AX /end AXIS_DESCR
 /begin AXIS_DESCR COM_AXIS PEnv_p p_q0p039 8 0.00 2559.961 FORMAT "%8.3" AXIS_PTS_REF EngStrt_pStrtEnd_AX /end AXIS_DESCR
/end CHARACTERISTIC
/begin CHARACTERISTIC NENGCRIT.tiStrtgStrtEndCrit_GM "Class instance to detect end of start based on engine speed threshold under critical start condition / Map start time to switch to engine speed threshold for critical start condition" MAP 0x8051EE7C RB_MapGroup_U16 655.3500 t_q0p01 0.00 655.3500 FORMAT "%8.4"
 /begin AXIS_DESCR COM_AXIS EngStrt_tCoor Temp_Cels 12 -273.140 3003.560 FORMAT "%8.3" EXTENDED_LIMITS -3549.940 3003.560 AXIS_PTS_REF EngStrt_tStrtEnd_AX /end AXIS_DESCR
 /begin AXIS_DESCR COM_AXIS EngStrt_nEngMaxCrit EngN 4 -16384.00 16383.50 FORMAT "%8.2" AXIS_PTS_REF EngStrt_nEngMaxCritStrtEnd_AX /end AXIS_DESCR
/end CHARACTERISTIC
/begin CHARACTERISTIC NENGDEB.dnEngStrtDeb_C "Class instance to detect end of start based on engine speed threshold, injection counter and debouncing / engine speed gradient to detect end of start" VALUE 0x8051EEE0 RB_Val_Ws16 32767.50 EngNGrd -16384.00 16383.50 FORMAT "%8.2" /end CHARACTERISTIC
/begin CHARACTERISTIC NENGDEB.nStrtEnd_GM "Class instance to detect end of start based on engine speed threshold, injection counter and debouncing / Map engine speed threshold to detect end of start" MAP 0x8051EEE2 RB_MapGroup_S16 32767.50 EngN -16384.00 16383.50 FORMAT "%8.2"
 /begin AXIS_DESCR COM_AXIS EngStrt_tCoor Temp_Cels 12 -273.140 3003.560 FORMAT "%8.3" EXTENDED_LIMITS -3549.940 3003.560 AXIS_PTS_REF EngStrt_tStrtEnd_AX /end AXIS_DESCR
 /begin AXIS_DESCR COM_AXIS PEnv_p p_q0p039 8 0.00 2559.961 FORMAT "%8.3" AXIS_PTS_REF EngStrt_pStrtEnd_AX /end AXIS_DESCR
/end CHARACTERISTIC
/begin CHARACTERISTIC NENGDEB.nrInjStrtEnd_GT "Class instance to detect end of start based on engine speed threshold, injection counter and debouncing / Curve injection counter threshold to detect end of start" CURVE 0x8051EFA2 RB_CurveGroup_U8 255.0 OneToOne 0.00 255.0 FORMAT "%5.1"
 /begin AXIS_DESCR COM_AXIS EngStrt_tCoor Temp_Cels 12 -273.140 3003.560 FORMAT "%8.3" EXTENDED_LIMITS -3549.940 3003.560 AXIS_PTS_REF EngStrt_tStrtEnd_AX /end AXIS_DESCR
/end CHARACTERISTIC
/begin CHARACTERISTIC NENGDEB.tiDnEngStrtDeb_C "Class instance to detect end of start based on engine speed threshold, injection counter and debouncing / Debouncing time after engine speed gradient to detect end of start" VALUE 0x8051EFAE RB_Val_Wu8 2.550 t_q0p01 0.00 2.550 FORMAT "%5.3" /end CHARACTERISTIC
/begin CHARACTERISTIC NENGDEB.tiNEngStrtDebMax_C "Class instance to detect end of start based on engine speed threshold, injection counter and debouncing / Max. debouncing time after beginning of start to detect end of start" VALUE 0x8051EFAF RB_Val_Wu8 2.550 t_q0p01 0.00 2.550 FORMAT "%5.3" /end CHARACTERISTIC
/begin CHARACTERISTIC NENGNRINJ.nStrtEnd_GM "Class instance to detect end of start based on engine speed threshold and injection counter / Map engine speed threshold to detect end of start" MAP 0x8051EFB0 RB_MapGroup_S16 32767.50 EngN -16384.00 16383.50 FORMAT "%8.2"
 /begin AXIS_DESCR COM_AXIS EngStrt_tCoor Temp_Cels 12 -273.140 3003.560 FORMAT "%8.3" EXTENDED_LIMITS -3549.940 3003.560 AXIS_PTS_REF EngStrt_tStrtEnd_AX /end AXIS_DESCR
 /begin AXIS_DESCR COM_AXIS PEnv_p p_q0p039 8 0.00 2559.961 FORMAT "%8.3" AXIS_PTS_REF EngStrt_pStrtEnd_AX /end AXIS_DESCR
/end CHARACTERISTIC
/begin CHARACTERISTIC NENGNRINJ.nrInjStrtEnd_GT "Class instance to detect end of start based on engine speed threshold and injection counter / Curve injection counter threshold to detect end of start" CURVE 0x8051F070 RB_CurveGroup_U8 255.0 OneToOne 0.00 255.0 FORMAT "%5.1"
 /begin AXIS_DESCR COM_AXIS EngStrt_tCoor Temp_Cels 12 -273.140 3003.560 FORMAT "%8.3" EXTENDED_LIMITS -3549.940 3003.560 AXIS_PTS_REF EngStrt_tStrtEnd_AX /end AXIS_DESCR
/end CHARACTERISTIC
/begin CHARACTERISTIC NENGNRINJ_FOLW.nStrtEnd_GM "Class to detect end of start based on engine speed and injection counter / Map engine speed threshold to detect end of start" MAP 0x8051E9EC RB_MapGroup_S16 32767.50 EngN -16384.00 16383.50 FORMAT "%8.2"
 /begin AXIS_DESCR COM_AXIS EngStrt_tCoor Temp_Cels 12 -273.140 3003.560 FORMAT "%8.3" EXTENDED_LIMITS -3549.940 3003.560 AXIS_PTS_REF EngStrt_tStrtEnd_AX /end AXIS_DESCR
 /begin AXIS_DESCR COM_AXIS PEnv_p p_q0p039 8 0.00 2559.961 FORMAT "%8.3" AXIS_PTS_REF EngStrt_pStrtEnd_AX /end AXIS_DESCR
/end CHARACTERISTIC
/begin CHARACTERISTIC NENGNRINJ_FOLW.nrInjStrtEnd_GT "Class to detect end of start based on engine speed and injection counter / Curve injection counter threshold to detect end of start" CURVE 0x8051EAAC RB_CurveGroup_U8 255.0 OneToOne 0.00 255.0 FORMAT "%5.1"
 /begin AXIS_DESCR COM_AXIS EngStrt_tCoor Temp_Cels 12 -273.140 3003.560 FORMAT "%8.3" EXTENDED_LIMITS -3549.940 3003.560 AXIS_PTS_REF EngStrt_tStrtEnd_AX /end AXIS_DESCR
/end CHARACTERISTIC
/begin CHARACTERISTIC NENG_COM.nStrtEnd_GM "Class to detect end of start based on engine speed / Map engine speed threshold to detect end of start" MAP 0x8051EAB8 RB_MapGroup_S16 32767.50 EngN -16384.00 16383.50 FORMAT "%8.2"
 /begin AXIS_DESCR COM_AXIS EngStrt_tCoor Temp_Cels 12 -273.140 3003.560 FORMAT "%8.3" EXTENDED_LIMITS -3549.940 3003.560 AXIS_PTS_REF EngStrt_tStrtEnd_AX /end AXIS_DESCR
 /begin AXIS_DESCR COM_AXIS PEnv_p p_q0p039 8 0.00 2559.961 FORMAT "%8.3" AXIS_PTS_REF EngStrt_pStrtEnd_AX /end AXIS_DESCR
/end CHARACTERISTIC
/begin CHARACTERISTIC NENG_FOLW.nStrtEnd_GM "Class to detect end of start based on engine speed / Map engine speed threshold to detect end of start" MAP 0x8051EB78 RB_MapGroup_S16 32767.50 EngN -16384.00 16383.50 FORMAT "%8.2"
 /begin AXIS_DESCR COM_AXIS EngStrt_tCoor Temp_Cels 12 -273.140 3003.560 FORMAT "%8.3" EXTENDED_LIMITS -3549.940 3003.560 AXIS_PTS_REF EngStrt_tStrtEnd_AX /end AXIS_DESCR
 /begin AXIS_DESCR COM_AXIS PEnv_p p_q0p039 8 0.00 2559.961 FORMAT "%8.3" AXIS_PTS_REF EngStrt_pStrtEnd_AX /end AXIS_DESCR
/end CHARACTERISTIC
/begin CHARACTERISTIC PEnv_facCnvnSlopDig_C "conversion slope for ambient air pressure sensor digital" VALUE 0x8051F2EC RB_Val_Wu16 0.9999847 fak_uw_b1 0.00 0.9999847 FORMAT "%9.7" /end CHARACTERISTIC
/begin CHARACTERISTIC PEnv_flgDiSnsrPlaus_C "Switch of fault detection of sensor internal plausible diagnosis if TRUE" VALUE 0x8051F2EE RB_Val_Wu8 1.00000000000 B_TRUE 0.00 1.00000000000 FORMAT "%13.11" /end CHARACTERISTIC
/begin CHARACTERISTIC PEnv_flgErrStEna_C "Fault simulation and healing simulation in combination with PEnv_stSensErrVal_C if value True, use this only for tests in calibration mode." VALUE 0x8051F2EF RB_Val_Wu8 1.00000000000 B_TRUE 0.00 1.00000000000 FORMAT "%13.11" /end CHARACTERISTIC
/begin CHARACTERISTIC PEnv_pAirFil_T "pressure difference at air filter" CURVE 0x8051F304 RB_Curve_S16_S16 5119.922 p_q0p078 -2560.000 2559.922 FORMAT "%8.3"
 /begin AXIS_DESCR STD_AXIS NO_INPUT_QUANTITY m_uw_b6553p5 8 -3276.800 3276.700 FORMAT "%8.3" DEPOSIT ABSOLUTE /end AXIS_DESCR
/end CHARACTERISTIC
/begin CHARACTERISTIC PEnv_pCnvnOffs_C "conversion offset for ambient air pressure sensor" VALUE 0x8051F2F0 RB_Val_Wu16 2559.961 p_q0p039 0.00 2559.961 FORMAT "%8.3" /end CHARACTERISTIC
/begin CHARACTERISTIC PEnv_pDft_C "substitute value for ambient pressure in case of sensor failure" VALUE 0x8051F326 RB_Val_Wu16 2559.961 p_q0p039 0.00 2559.961 FORMAT "%8.3" /end CHARACTERISTIC
/begin CHARACTERISTIC PEnv_pDifEnvIntkVUsIniMax_C "Delta manifold pressure to max mod. ambient pressure in start" VALUE 0x8051F328 RB_Val_Wu16 2559.961 p_q0p039 0.00 2559.961 FORMAT "%8.3" /end CHARACTERISTIC
/begin CHARACTERISTIC PEnv_pDifEnvIntkVUsIniMin_C "Delta manifold pressure to min. mod. ambient pressure in start" VALUE 0x8051F32A RB_Val_Wu16 2559.961 p_q0p039 0.00 2559.961 FORMAT "%8.3" /end CHARACTERISTIC
/begin CHARACTERISTIC PEnv_pDifEnvIntkVUsMax_C "Delta manifold pressure to max. mod. ambient pressure" VALUE 0x8051F32C RB_Val_Wu16 2559.961 p_q0p039 0.00 2559.961 FORMAT "%8.3" /end CHARACTERISTIC
/begin CHARACTERISTIC PEnv_pDifEnvIntkVUsMin_C "Delta manifold pressure to min. mod. ambient pressure" VALUE 0x8051F32E RB_Val_Wu16 2559.961 p_q0p039 0.00 2559.961 FORMAT "%8.3" /end CHARACTERISTIC
/begin CHARACTERISTIC PEnv_pDifJmpMax_C "upper limit for continuous check" VALUE 0x8051F34C RB_Val_Wu16 2559.961 p_q0p039 0.00 2559.961 FORMAT "%8.3" /end CHARACTERISTIC
/begin CHARACTERISTIC PEnv_pDifLdcMax_C "upper limit for comparison of ambient pressure from last-/actual driving cycle" VALUE 0x8051F34E RB_Val_Wu16 2559.961 p_q0p039 0.00 2559.961 FORMAT "%8.3" /end CHARACTERISTIC
/begin CHARACTERISTIC PEnv_pMaxSnsrTolr_C "max tolerances of ambient pressure sensor" VALUE 0x8051F350 RB_Val_Wu16 2559.961 p_q0p039 0.00 2559.961 FORMAT "%8.3" /end CHARACTERISTIC
/begin CHARACTERISTIC PEnv_pMdlMaxThd_C "upper threshold for modelled ambient pressure" VALUE 0x8051F330 RB_Val_Wu16 2559.961 p_q0p039 0.00 2559.961 FORMAT "%8.3" /end CHARACTERISTIC
/begin CHARACTERISTIC PEnv_pPlausThdMax_C "upper limit for range check ambient pressure" VALUE 0x8051F352 RB_Val_Wu16 2559.961 p_q0p039 0.00 2559.961 FORMAT "%8.3" /end CHARACTERISTIC
/begin CHARACTERISTIC PEnv_pPlausThdMin_C "lower limit for range check ambient pressure" VALUE 0x8051F354 RB_Val_Wu16 2559.961 p_q0p039 0.00 2559.961 FORMAT "%8.3" /end CHARACTERISTIC
/begin CHARACTERISTIC PEnv_ratUnthrMdlTolr_C "Additional offset to throttle opening for determining unthrottled condition" VALUE 0x8051F332 RB_Val_Wu16 99.99847 rel_uw_b100 0.00 99.99847 FORMAT "%8.5" /end CHARACTERISTIC
/begin CHARACTERISTIC PEnv_stSensErrVal_C "Fault simulation and healing simulation in combination with PEnv_flgErrStEna_C, use this only for tests in calibration mode. Fault simulation with error masks, e.g. OBS_SPI_ERR_MASK__CRC_ERROR, healing with the value zero." VALUE 0x8051F2F4 RB_Val_Wu32 4294967295.00 OneToOne 0.00 4294967295.00 FORMAT "%13.2" /end CHARACTERISTIC
/begin CHARACTERISTIC PEnv_swtCodDiag_C "Codeword plausibilty diagnosis ambient air pressure sensor" VALUE 0x8051F356 RB_Val_Wu8 255.0 dez 0.00 255.0 FORMAT "%5.1" /end CHARACTERISTIC
/begin CHARACTERISTIC PEnv_swtCodVd_C "Code word ambient presure adaptation via pressure sensor at the intake manifold" VALUE 0x8051F334 RB_Val_Wu8 255.0 dez 0.00 255.0 FORMAT "%5.1" /end CHARACTERISTIC
/begin CHARACTERISTIC PEnv_tiCcLT_C "time constant for ambient pressure lowpass filter in continuity check" VALUE 0x8051F358 RB_Val_Ws32 4294.9672940000000 TimeDelay_s 0.0000020000000 4294.9672959999998 FORMAT "%19.14" EXTENDED_LIMITS 0.000002000000001 4294.9672959999998 /end CHARACTERISTIC
/begin CHARACTERISTIC PEnv_tiDebSnsrPlaus_C "Debounce time for sensor reset due to plausibility faults" VALUE 0x8051F2F8 RB_Val_Ws32 2147.48364700 Time_Dt 0.00 2147.48364700 FORMAT "%13.8" EXTENDED_LIMITS -2147.48364800 2147.48364700 /end CHARACTERISTIC
/begin CHARACTERISTIC PEnv_tiDlyEnagMdl_C "turn on delay time for enabling PEnv model calculation" VALUE 0x8051F338 RB_Val_Ws32 2147.48364700 Time_Dt 0.00 2147.48364700 FORMAT "%13.8" EXTENDED_LIMITS -2147.48364800 2147.48364700 /end CHARACTERISTIC
/begin CHARACTERISTIC PEnv_tiDlyHealIntkVUs_C "Time delay for zyklus from comparison with manifold pressure" VALUE 0x8051F33C RB_Val_Ws32 2147.48364700 Time_Dt 0.00 2147.48364700 FORMAT "%13.8" EXTENDED_LIMITS -2147.48364800 2147.48364700 /end CHARACTERISTIC
/begin CHARACTERISTIC PEnv_tiDlyRawVld_C "delay for condition ambient pressure signal valid" VALUE 0x8051F35C RB_Val_Ws32 4294.96729500 Time_Dt -2147.48364800 2147.48364700 FORMAT "%13.8" /end CHARACTERISTIC
/begin CHARACTERISTIC PEnv_tiDlyTilPBal "Time delay until pressure balance in air system after engine stop" VALUE 0x8051F340 RB_Val_Ws32 2147.48364700 Time_Dt 0.00 2147.48364700 FORMAT "%13.8" EXTENDED_LIMITS -2147.48364800 2147.48364700 /end CHARACTERISTIC
/begin CHARACTERISTIC PEnv_tiDrvDly_C "Time delay for sensor reset in drive" VALUE 0x8051F2FC RB_Val_Ws32 2147.48364700 Time_Dt 0.00 2147.48364700 FORMAT "%13.8" EXTENDED_LIMITS -2147.48364800 2147.48364700 /end CHARACTERISTIC
/begin CHARACTERISTIC PEnv_tiPLT_C "time constant for filtering PEnv_p and PEnv_FacCorrAlti" VALUE 0x8051F344 RB_Val_Ws32 2147.48364700 Time_Dt 0.00 2147.48364700 FORMAT "%13.8" EXTENDED_LIMITS -2147.48364800 2147.48364700 /end CHARACTERISTIC
/begin CHARACTERISTIC PEnv_tiSnsrBootDly_C "Time delay for sensor boot up after reset" VALUE 0x8051F300 RB_Val_Ws32 2147.48364700 Time_Dt 0.00 2147.48364700 FORMAT "%13.8" EXTENDED_LIMITS -2147.48364800 2147.48364700 /end CHARACTERISTIC
/begin CHARACTERISTIC PEnv_tiStrtReplVld_C "Time after end of start at which PEnv_p corresponds to PEnv_p at the start" VALUE 0x8051F348 RB_Val_Wu16 6553.500 t100msxs_uw_b6553p5 0.00 6553.500 FORMAT "%8.3" /end CHARACTERISTIC
/begin CHARACTERISTIC SF_PU "Sum Fault PU" VAL_BLK 0x8051F360 RB_ValA_Wu16 58.0000000000 dfp_verbal 0.00 58.0000000000 FORMAT "%13.10" READ_ONLY NUMBER 5 /end CHARACTERISTIC
/begin CHARACTERISTIC TDGTUMTRIG "Delay time for B_trigcomp" VALUE 0x8051F36E RB_Val_Wu16 6553.500 t_q0p1 0.00 6553.500 FORMAT "%8.3" /end CHARACTERISTIC
/begin CHARACTERISTIC TUMTAI "initial value of ambient temperature" VALUE 0x8051F370 RB_Val_Wu8 191.3 temp_ub_q0p75_o48 -48.0 143.3 FORMAT "%5.1" /end CHARACTERISTIC
/begin MEASUREMENT B_engrest_msg "EngReStrt- task was called" UBYTE B_TRUE 1 100 0.00 1.00000000000 BIT_MASK 0x1 FORMAT "%13.11" ECU_ADDRESS 0x70000A79 /end MEASUREMENT
/begin MEASUREMENT B_gtumg_msg "validity of ambient temperature, set if model parth is determined, valid and actual or if there is no error in the sensor value" UBYTE B_TRUE 1 100 0.00 1.00000000000 BIT_MASK 0x1 FORMAT "%13.11" ECU_ADDRESS 0x70000A4E /end MEASUREMENT
/begin MEASUREMENT B_nostacom_msg "Condition change of mind without starter assist" UBYTE B_TRUE 1 100 0.00 1.00000000000 BIT_MASK 0x1 FORMAT "%13.11" ECU_ADDRESS 0x700009DC /end MEASUREMENT
/begin MEASUREMENT B_pugg_msg "condition: ambient pressure from sensor valid" UBYTE B_TRUE 1 100 0.00 1.00000000000 BIT_MASK 0x1 FORMAT "%13.11" ECU_ADDRESS 0x700009C5 /end MEASUREMENT
/begin MEASUREMENT B_pug_msg "condition: ambient pressure valid" UBYTE B_TRUE 1 100 0.00 1.00000000000 BIT_MASK 0x1 FORMAT "%13.11" ECU_ADDRESS 0x60009FCB /end MEASUREMENT
/begin MEASUREMENT B_purg_msg "Condition ambient pressure sensor valid" UBYTE B_TRUE 1 100 0.00 1.00000000000 BIT_MASK 0x1 FORMAT "%13.11" ECU_ADDRESS 0x700009C4 /end MEASUREMENT
/begin MEASUREMENT B_stainjen_msg "Condition enable start injection" UBYTE B_TRUE 1 100 0.00 1.00000000000 BIT_MASK 0x1 FORMAT "%13.11" ECU_ADDRESS 0x700009A8 /end MEASUREMENT
/begin MEASUREMENT B_stendes_msg "Condition: end of start also for injection" UBYTE B_TRUE 1 100 0.00 1.00000000000 BIT_MASK 0x1 FORMAT "%13.11" ECU_ADDRESS 0x700009A1 /end MEASUREMENT
/begin MEASUREMENT B_stendll_msg "condition end of start for release of engine speed control" UBYTE B_TRUE 1 100 0.00 1.00000000000 BIT_MASK 0x1 FORMAT "%13.11" ECU_ADDRESS 0x700009A0 /end MEASUREMENT
/begin MEASUREMENT B_stendmd_msg "Condition end of start for activation of md structure" UBYTE B_TRUE 1 100 0.00 1.00000000000 BIT_MASK 0x1 FORMAT "%13.11" ECU_ADDRESS 0x7000099F /end MEASUREMENT
/begin MEASUREMENT B_stendzw_msg "condition end of start for ignition release" UBYTE B_TRUE 1 100 0.00 1.00000000000 BIT_MASK 0x1 FORMAT "%13.11" ECU_ADDRESS 0x7000099E /end MEASUREMENT
/begin MEASUREMENT B_stoevab_msg "Condition injection cutoff for stop request" UBYTE B_TRUE 1 100 0.00 1.00000000000 BIT_MASK 0x1 FORMAT "%13.11" ECU_ADDRESS 0x7000099D /end MEASUREMENT
/begin MEASUREMENT B_stopeng_msg "Condition engine in stop phase" UBYTE B_TRUE 1 100 0.00 1.00000000000 BIT_MASK 0x1 FORMAT "%13.11" ECU_ADDRESS 0x7000099C /end MEASUREMENT
/begin MEASUREMENT B_stopping_msg "Condition engine stopping" UBYTE B_TRUE 1 100 0.00 1.00000000000 BIT_MASK 0x1 FORMAT "%13.11" ECU_ADDRESS 0x7000099B /end MEASUREMENT
/begin MEASUREMENT B_stopz_msg "condition first stop phase in cycle initiated" UBYTE B_TRUE 1 100 0.00 1.00000000000 BIT_MASK 0x1 FORMAT "%13.11" ECU_ADDRESS 0x7000099A /end MEASUREMENT
/begin MEASUREMENT B_stostcom_msg "Condition start order during engine runout" UBYTE B_TRUE 1 100 0.00 1.00000000000 BIT_MASK 0x1 FORMAT "%13.11" ECU_ADDRESS 0x70000999 /end MEASUREMENT
/begin MEASUREMENT B_stprep_msg "condition start preparation" UBYTE B_TRUE 1 100 0.00 1.00000000000 BIT_MASK 0x1 FORMAT "%13.11" ECU_ADDRESS 0x70000998 /end MEASUREMENT
/begin MEASUREMENT B_strtena_msg "condition start enable" UBYTE B_TRUE 1 100 0.00 1.00000000000 BIT_MASK 0x1 FORMAT "%13.11" ECU_ADDRESS 0x70000997 /end MEASUREMENT
/begin MEASUREMENT B_trigcomp_msg "condition: calculated ambient temperature was updated" UBYTE B_TRUE 1 100 0.00 1.00000000000 BIT_MASK 0x1 FORMAT "%13.11" ECU_ADDRESS 0x70000978 /end MEASUREMENT
/begin MEASUREMENT B_tumgg_envtifloc "condition: ambient air temperature sensormodel is error free(loc)" UBYTE B_TRUE 1 100 0.00 1.00000000000 BIT_MASK 0x1 FORMAT "%13.11" ECU_ADDRESS 0x7000026E /end MEASUREMENT
/begin MEASUREMENT B_tumgg_msg "condition: ambient air temperature sensormodel is error free" UBYTE B_TRUE 1 100 0.00 1.00000000000 BIT_MASK 0x1 FORMAT "%13.11" ECU_ADDRESS 0x70000974 /end MEASUREMENT
/begin MEASUREMENT B_tummg_msg "inputs for ambient air temperature model without errors" UBYTE B_TRUE 1 100 0.00 1.00000000000 BIT_MASK 0x1 FORMAT "%13.11" ECU_ADDRESS 0x70000973 /end MEASUREMENT
/begin MEASUREMENT B_tumnpl_msg "Condition ambient air temperature not plausible" UBYTE B_TRUE 1 100 0.00 1.00000000000 BIT_MASK 0x1 FORMAT "%13.11" ECU_ADDRESS 0x70000972 /end MEASUREMENT
/begin MEASUREMENT EngStrt_bChgOfMnd "bit change of mind" UBYTE B_TRUE 1 100 0.00 1.00000000000 BIT_MASK 0x1 FORMAT "%13.11" ECU_ADDRESS 0x7000080A /end MEASUREMENT
/begin MEASUREMENT EngStrt_bFrstStrtEnd "Condition: first end of start in cycle" UBYTE B_TRUE 1 100 0.00 1.00000000000 BIT_MASK 0x1 FORMAT "%13.11" ECU_ADDRESS 0x70000809 /end MEASUREMENT
/begin MEASUREMENT EngStrt_bRstrtWoStaAsst "Condition change of mind without starter assist" UBYTE B_TRUE 1 100 0.00 1.00000000000 BIT_MASK 0x1 FORMAT "%13.11" ECU_ADDRESS 0x70000808 /end MEASUREMENT
/begin MEASUREMENT EngStrt_bStrt "condition start" UBYTE B_TRUE 1 100 0.00 1.00000000000 BIT_MASK 0x1 FORMAT "%13.11" ECU_ADDRESS 0x70000807 /end MEASUREMENT
/begin MEASUREMENT EngStrt_bStrtEnd "end of start reached, combustion engine runs on its own power" UBYTE B_TRUE 1 100 0.00 1.00000000000 BIT_MASK 0x1 FORMAT "%13.11" ECU_ADDRESS 0x70000806 /end MEASUREMENT
/begin MEASUREMENT EngStrt_cntrInjStrtEnd "injection counter" UBYTE OneToOne 1 100 0.00 255.0 FORMAT "%5.1" ECU_ADDRESS 0x60000778 /end MEASUREMENT
/begin MEASUREMENT EngStrt_ctStrtEnd100msDrvEnter "Local Counter for Drive enter in 100ms for EngStrt_StrtEnd" UBYTE OneToOne 1 100 0.00 255.0 FORMAT "%5.1" ECU_ADDRESS 0x6000E3A1 /end MEASUREMENT
/begin MEASUREMENT EngStrt_ctStrtEnd10msDrvEnter "local counetr for 10ms drive enter in StrtEnd" UBYTE OneToOne 1 100 0.00 255.0 FORMAT "%5.1" ECU_ADDRESS 0x6000E412 /end MEASUREMENT
/begin MEASUREMENT EngStrt_ctStrtEndSyncS1DrvEnter "local counetr for SyncS1 drive enter in StrtEnd" UBYTE OneToOne 1 100 0.00 255.0 FORMAT "%5.1" ECU_ADDRESS 0x5000084C /end MEASUREMENT
/begin MEASUREMENT EngStrt_ctVld2Lcy10msDrvEnter "Local counter for 10ms drive enter in EngStrt_Vld2Lcy" UBYTE OneToOne 1 100 0.00 255.0 FORMAT "%5.1" ECU_ADDRESS 0x6000A3B4 /end MEASUREMENT
/begin MEASUREMENT EngStrt_ctWrmUpCoorDrvEntr "Local variable to store the global drive enter counter(SyC_ctDrvEnter)" UBYTE OneToOne 1 100 0.00 255.0 FORMAT "%5.1" ECU_ADDRESS 0x6000654F /end MEASUREMENT
/begin MEASUREMENT EngStrt_EomWrmUp1_I.stOperMod "Class instance for interface between the warm up coordinator and CoEng (first request) / Priority-element of the operation mode structure" ULONG OneToOne 1 100 0.00 4294967295.00 FORMAT "%13.2" ECU_ADDRESS 0x50000154 /end MEASUREMENT
/begin MEASUREMENT EngStrt_EomWrmUp1_I.stOperModPrio "Class instance for interface between the warm up coordinator and CoEng (first request) / Stage-element of the operation mode structure" UBYTE OneToOne 1 100 0.00 255.0 FORMAT "%5.1" ECU_ADDRESS 0x50000158 /end MEASUREMENT
/begin MEASUREMENT EngStrt_EomWrmUp1_I.stOperModStg "Class instance for interface between the warm up coordinator and CoEng (first request) / Operation-mode element of the operation mode structure" UWORD OneToOne 1 100 0.00 65535.00 FORMAT "%8.2" ECU_ADDRESS 0x5000015A /end MEASUREMENT
/begin MEASUREMENT EngStrt_EomWrmUp2_I.stOperMod "Class instance for interface between the warm up coordinator and CoEng (second request) / Priority-element of the operation mode structure" ULONG OneToOne 1 100 0.00 4294967295.00 FORMAT "%13.2" ECU_ADDRESS 0x5000015C /end MEASUREMENT
/begin MEASUREMENT EngStrt_EomWrmUp2_I.stOperModPrio "Class instance for interface between the warm up coordinator and CoEng (second request) / Stage-element of the operation mode structure" UBYTE OneToOne 1 100 0.00 255.0 FORMAT "%5.1" ECU_ADDRESS 0x50000160 /end MEASUREMENT
/begin MEASUREMENT EngStrt_EomWrmUp2_I.stOperModStg "Class instance for interface between the warm up coordinator and CoEng (second request) / Operation-mode element of the operation mode structure" UWORD OneToOne 1 100 0.00 65535.00 FORMAT "%8.2" ECU_ADDRESS 0x50000162 /end MEASUREMENT
/begin MEASUREMENT EngStrt_EomWrmUpAllwd_I.stOperMod "Class instance for interface between the warm up coordinator and CoEng (allowed operating modes) / Priority-element of the operation mode structure" ULONG OneToOne 1 100 0.00 4294967295.00 FORMAT "%13.2" ECU_ADDRESS 0x70001A0C /end MEASUREMENT
/begin MEASUREMENT EngStrt_EomWrmUpAllwd_I.stOperModPrio "Class instance for interface between the warm up coordinator and CoEng (allowed operating modes) / Stage-element of the operation mode structure" UBYTE OneToOne 1 100 0.00 255.0 FORMAT "%5.1" ECU_ADDRESS 0x70001A10 /end MEASUREMENT
/begin MEASUREMENT EngStrt_EomWrmUpAllwd_I.stOperModStg "Class instance for interface between the warm up coordinator and CoEng (allowed operating modes) / Operation-mode element of the operation mode structure" UWORD OneToOne 1 100 0.00 65535.00 FORMAT "%8.2" ECU_ADDRESS 0x70001A12 /end MEASUREMENT
/begin MEASUREMENT EngStrt_flgInjSysRels "Release condition injection system (GDI or PFI)" UBYTE B_TRUE 1 100 0.00 1.00000000000 BIT_MASK 0x1 FORMAT "%13.11" ECU_ADDRESS 0x70000800 /end MEASUREMENT
/begin MEASUREMENT EngStrt_flgOverrun "Condition overrun transition" UBYTE B_TRUE 1 100 0.00 1.00000000000 BIT_MASK 0x1 FORMAT "%13.11" ECU_ADDRESS 0x700007FF /end MEASUREMENT
/begin MEASUREMENT EngStrt_flgPfiStrtRels "Release condition for all PFI starts" UBYTE B_TRUE 1 100 0.00 1.00000000000 BIT_MASK 0x1 FORMAT "%13.11" ECU_ADDRESS 0x700007FE /end MEASUREMENT
/begin MEASUREMENT EngStrt_flgStrtEndIgn "condition end of start for ignition release" UBYTE B_TRUE 1 100 0.00 1.00000000000 BIT_MASK 0x1 FORMAT "%13.11" ECU_ADDRESS 0x700007F7 /end MEASUREMENT
/begin MEASUREMENT EngStrt_flgStrtEndInj "End of start for injection" UBYTE B_TRUE 1 100 0.00 1.00000000000 BIT_MASK 0x1 FORMAT "%13.11" ECU_ADDRESS 0x700007F6 /end MEASUREMENT
/begin MEASUREMENT EngStrt_flgStrtEndSpdGovr "condition end of start for release of engine speed control" UBYTE B_TRUE 1 100 0.00 1.00000000000 BIT_MASK 0x1 FORMAT "%13.11" ECU_ADDRESS 0x700007F5 /end MEASUREMENT
/begin MEASUREMENT EngStrt_flgStrtEndTqStruct "Condition end of start for activation of md structure" UBYTE B_TRUE 1 100 0.00 1.00000000000 BIT_MASK 0x1 FORMAT "%13.11" ECU_ADDRESS 0x700007F4 /end MEASUREMENT
/begin MEASUREMENT EngStrt_flgStrtrStrtRels "Release condition for all starts with the starter" UBYTE B_TRUE 1 100 0.00 1.00000000000 BIT_MASK 0x1 FORMAT "%13.11" ECU_ADDRESS 0x700007F2 /end MEASUREMENT
/begin MEASUREMENT EngStrt_idxClassSeldStrtEnd "selected class for end of start detection" UBYTE ENGSTRT_IDXSTRTEND_SET_COMPU_VERB 1 100 0.00 4.00000000000 FORMAT "%13.11" ECU_ADDRESS 0x60006550 /end MEASUREMENT
/begin MEASUREMENT EngStrt_nEngMaxCrit "maximum engine speed for start under critical situation" SWORD EngN 1 100 -16384.00 16383.50 FORMAT "%8.2" ECU_ADDRESS 0x70002B6C /end MEASUREMENT
/begin MEASUREMENT EngStrt_stEomWrmUpAllwd "allowed operating mode for warm up" UBYTE OneToOne 1 100 0.00 255.0 FORMAT "%5.1" ECU_ADDRESS 0x6000A3B3 /end MEASUREMENT
/begin MEASUREMENT EngStrt_stEomWrmUpAllwdLoc "local copy of EngStrt_stEomWrmUpAllwd" SWORD OneToOne 1 100 0.00 255.0000 FORMAT "%8.4" ECU_ADDRESS 0x70002C38 /end MEASUREMENT
/begin MEASUREMENT EngStrt_tCoor "Engine temperature for the start coordinator" SWORD Temp_Cels 1 100 -273.140 3003.560 FORMAT "%8.3" ECU_ADDRESS 0x6000E1D4 /end MEASUREMENT
/begin MEASUREMENT EngStrt_tiAftFirstStrtEnd "time counter at first end of start in cycle" UWORD t_q0p1 1 100 0.00 6553.500 FORMAT "%8.3" ECU_ADDRESS 0x600048F0 /end MEASUREMENT
/begin MEASUREMENT EngStrt_tiAftStrtEnd "time after end of start" UWORD t_q0p01 1 100 0.00 655.3500 FORMAT "%8.4" ECU_ADDRESS 0x6000E1D8 /end MEASUREMENT
/begin MEASUREMENT EngStrt_tiAftStrtEndLowRes "time after end of start" UWORD t_q0p1 1 100 0.00 6553.500 FORMAT "%8.3" ECU_ADDRESS 0x600048EE /end MEASUREMENT
/begin MEASUREMENT EngStrt_tiOperAftFirstStrtEnd "time of engine operation from first end of start (over ECU-cycle)" UWORD t_q0p1 1 100 0.00 6553.500 FORMAT "%8.3" ECU_ADDRESS 0x600048EC /end MEASUREMENT
/begin MEASUREMENT EngStrt_tStopCoor "engine coolant temperature at engine stop" SWORD Temp_Cels 1 100 -273.140 3003.560 FORMAT "%8.3" ECU_ADDRESS 0x600050A0 /end MEASUREMENT
/begin MEASUREMENT EngStrt_tStrtCoor "Start temperature for the start coordinator" SWORD Temp_Cels 1 100 -273.140 3003.560 FORMAT "%8.3" ECU_ADDRESS 0x6000E1D6 /end MEASUREMENT
/begin MEASUREMENT EngTrqPtd_trqLead "Limiting torque of lead path from the monitoring" SWORD md_q0p1 1 100 -3276.800 3276.700 FORMAT "%8.3" ECU_ADDRESS 0x6000E1DA /end MEASUREMENT
/begin MEASUREMENT EngTrqPtd_trqLeadWoResv "maximum permissible torque for lead path without reserve" SWORD md_q0p1 1 100 -3276.800 3276.700 FORMAT "%8.3" ECU_ADDRESS 0x6000509E /end MEASUREMENT
/begin MEASUREMENT EngTrqPtd_trqSet "Limiting torque of setpoint path from the monitoring" SWORD md_q0p1 1 100 -3276.800 3276.700 FORMAT "%8.3" ECU_ADDRESS 0x6000E1DC /end MEASUREMENT
/begin MEASUREMENT EngTrqPtd_trqSetWoTraIntv "maximum permissible torque for lead path without gearbox intervention" SWORD md_q0p1 1 100 -3276.800 3276.700 FORMAT "%8.3" ECU_ADDRESS 0x6000509C /end MEASUREMENT
/begin MEASUREMENT EnvT_bActvCSC "Bit: Cold start check of the EnvT activated" UBYTE B_TRUE 1 100 0.00 1.00000000000 BIT_MASK 0x1 FORMAT "%13.11" ECU_ADDRESS 0x700007F0 /end MEASUREMENT
/begin MEASUREMENT EnvT_bActvDfl "Bit: activation of the test-mode of the EnvT" UBYTE B_TRUE 1 100 0.00 1.00000000000 BIT_MASK 0x1 FORMAT "%13.11" ECU_ADDRESS 0x700007EF /end MEASUREMENT
/begin MEASUREMENT EnvT_bActvMBC "Bit: Model based Check of the EnvT activated" UBYTE B_TRUE 1 100 0.00 1.00000000000 BIT_MASK 0x1 FORMAT "%13.11" ECU_ADDRESS 0x700007EE /end MEASUREMENT
/begin MEASUREMENT EnvT_bActvPRC "Bit: Physical value range check of the EnvT active" UBYTE B_TRUE 1 100 0.00 1.00000000000 BIT_MASK 0x1 FORMAT "%13.11" ECU_ADDRESS 0x700007ED /end MEASUREMENT
/begin MEASUREMENT EnvT_bActvSens "Bit: Sensor of the EnvT available and to be used for EnvT" UBYTE B_TRUE 1 100 0.00 1.00000000000 BIT_MASK 0x1 FORMAT "%13.11" ECU_ADDRESS 0x700007EC /end MEASUREMENT
/begin MEASUREMENT EnvT_bActvSensADC "ADC sensor is present und used in EnvT" UBYTE B_TRUE 1 100 0.00 1.00000000000 BIT_MASK 0x1 FORMAT "%13.11" ECU_ADDRESS 0x700007EB /end MEASUREMENT
/begin MEASUREMENT EnvT_bActvSensCAN "Bit: CAN sensor of the EnvT available and to be used for EnvT" UBYTE B_TRUE 1 100 0.00 1.00000000000 BIT_MASK 0x1 FORMAT "%13.11" ECU_ADDRESS 0x700007EA /end MEASUREMENT
/begin MEASUREMENT EnvT_bActvSensMod "Bit: Activation of the sensor based EnvT model" UBYTE B_TRUE 1 100 0.00 1.00000000000 BIT_MASK 0x1 FORMAT "%13.11" ECU_ADDRESS 0x700007E9 /end MEASUREMENT
/begin MEASUREMENT EnvT_bModCS "Bit: cold start for EnvT-Modelling detected" UBYTE B_TRUE 1 100 0.00 1.00000000000 BIT_MASK 0x1 FORMAT "%13.11" ECU_ADDRESS 0x700007E8 /end MEASUREMENT
/begin MEASUREMENT EnvT_bModHotDet "Bit: Detection that engine is hot in EnvT-Modelling" UBYTE B_TRUE 1 100 0.00 1.00000000000 BIT_MASK 0x1 FORMAT "%13.11" ECU_ADDRESS 0x7000026A /end MEASUREMENT
/begin MEASUREMENT EnvT_bModPrms "Bit: Release of EnvT-Modelling within EnvT" UBYTE B_TRUE 1 100 0.00 1.00000000000 BIT_MASK 0x1 FORMAT "%13.11" ECU_ADDRESS 0x70000269 /end MEASUREMENT
/begin MEASUREMENT EnvT_bModRels "Bit: Release of EnvT-Modelling within EnvT" UBYTE B_TRUE 1 100 0.00 1.00000000000 BIT_MASK 0x1 FORMAT "%13.11" ECU_ADDRESS 0x70000268 /end MEASUREMENT
/begin MEASUREMENT EnvT_bModSty "Bit: Condition fullfilled for model release" UBYTE B_TRUE 1 100 0.00 1.00000000000 BIT_MASK 0x1 FORMAT "%13.11" ECU_ADDRESS 0x70000267 /end MEASUREMENT
/begin MEASUREMENT EnvT_bModStyCnd "Bit: Condition fullfilled for model release" UBYTE B_TRUE 1 100 0.00 1.00000000000 BIT_MASK 0x1 FORMAT "%13.11" ECU_ADDRESS 0x70000266 /end MEASUREMENT
/begin MEASUREMENT EnvT_bModWrm "Bit: Condition engine warm" UBYTE B_TRUE 1 100 0.00 1.00000000000 BIT_MASK 0x1 FORMAT "%13.11" ECU_ADDRESS 0x70000265 /end MEASUREMENT
/begin MEASUREMENT EnvT_bPrimModBas "Validity the basis value (intake air temperature) for determination of the primary EnvT-Model" UBYTE B_TRUE 1 100 0.00 1.00000000000 BIT_MASK 0x1 FORMAT "%13.11" ECU_ADDRESS 0x70000264 /end MEASUREMENT
/begin MEASUREMENT EnvT_bPrimModBasMin "Validity the basis value from Min-Selection of intake air temperature for determination of the primary EnvT-Model" UBYTE B_TRUE 1 100 0.00 1.00000000000 BIT_MASK 0x1 FORMAT "%13.11" ECU_ADDRESS 0x70000263 /end MEASUREMENT
/begin MEASUREMENT EnvT_bTSensFrz "Condition valid sensor value present" UBYTE B_TRUE 1 100 0.00 1.00000000000 BIT_MASK 0x1 FORMAT "%13.11" ECU_ADDRESS 0x7000026D /end MEASUREMENT
/begin MEASUREMENT EnvT_bTSensFrznVal "condition: back up valid sensor value available" UBYTE B_TRUE 1 100 0.00 1.00000000000 BIT_MASK 0x1 FORMAT "%13.11" ECU_ADDRESS 0x7000026C /end MEASUREMENT
/begin MEASUREMENT EnvT_bTSensIntrLstVal "Condition replacement value for ambient temperature without CAN communication" UBYTE B_TRUE 1 100 0.00 1.00000000000 BIT_MASK 0x1 FORMAT "%13.11" ECU_ADDRESS 0x6003498B /end MEASUREMENT
/begin MEASUREMENT EnvT_bTTiCmu "Condition of substitute value for ambient temperature of CAN communication" UBYTE B_TRUE 1 100 0.00 1.00000000000 BIT_MASK 0x1 FORMAT "%13.11" ECU_ADDRESS 0x7000026B /end MEASUREMENT
/begin MEASUREMENT EnvT_mAirAcmThdCrvVal "Air Mass threshold for Ambient Temperature release from EnvT_mAirAcmThdMdlRels_T" SWORD AirMassKg 1 100 -327.6800 327.6700 FORMAT "%8.4" ECU_ADDRESS 0x60003A40 /end MEASUREMENT
/begin MEASUREMENT EnvT_mAirAcmThdMdlRels "Threshold for the Accumulated Air mass to release the Environment Temperature model" SWORD AirMassKg 1 100 -327.6800 327.6700 FORMAT "%8.4" ECU_ADDRESS 0x60003A3E /end MEASUREMENT
/begin MEASUREMENT EnvT_mAirAcmThdOldVal "Previous value from the curve EnvT_mAirAcmThdMdlRels_T" SWORD AirMassKg 1 100 -327.6800 327.6700 FORMAT "%8.4" ECU_ADDRESS 0x60003A3C /end MEASUREMENT
/begin MEASUREMENT EnvT_mAirAcmThdVal "Limited threshold for the accumulated Air mass" SWORD AirMassKg 1 100 -327.6800 327.6700 FORMAT "%8.4" ECU_ADDRESS 0x60003A3A /end MEASUREMENT
/begin MEASUREMENT EnvT_mAirMod "Air mass to determine the EnvT-modelling" SWORD AirMassKg 1 100 -327.6800 327.6700 FORMAT "%8.4" ECU_ADDRESS 0x60003A38 /end MEASUREMENT
/begin MEASUREMENT EnvT_mAirModInt "Air mass to determine the EnvT-modelling" SLONG AirMassPerTime 1 100 -214748364.800 214748364.700 FORMAT "%13.3" ECU_ADDRESS 0x50001494 /end MEASUREMENT
/begin MEASUREMENT EnvT_mfAirCylStyMod "Copy of AirMod_mfAirCyl for Ambient Temperature steady state model" SWORD AirMassPerTime 1 100 -3276.800 3276.700 FORMAT "%8.3" ECU_ADDRESS 0x60003A36 /end MEASUREMENT
/begin MEASUREMENT EnvT_nEngStyMod "Copy of Epm_nEng for Ambient Temperature Model" SWORD EngN 1 100 -16384.00 16383.50 FORMAT "%8.2" ECU_ADDRESS 0x60003A34 /end MEASUREMENT
/begin MEASUREMENT EnvT_stEepReadMdl "EEP Read status" UBYTE OneToOne 1 100 0.00 255.0 FORMAT "%5.1" ECU_ADDRESS 0x60006546 /end MEASUREMENT
/begin MEASUREMENT EnvT_stSigT "Status to indicate signal quality of sensor value" UBYTE OneToOne 1 100 0.00 255.0 FORMAT "%5.1" ECU_ADDRESS 0x6000A06F /end MEASUREMENT
/begin MEASUREMENT EnvT_stTPlausMod "state of envt-model for plausibilisation" UBYTE OneToOne 1 100 0.00 255.0 FORMAT "%5.1" ECU_ADDRESS 0x6000A06E /end MEASUREMENT
/begin MEASUREMENT EnvT_stTPlausModLoc "state of envt-model for plausibilisation" UBYTE OneToOne 1 100 0.00 255.0 FORMAT "%5.1" ECU_ADDRESS 0x60006545 /end MEASUREMENT
/begin MEASUREMENT EnvT_stTPrimMod "state of primary envt-model" UBYTE OneToOne 1 100 0.00 255.0 FORMAT "%5.1" ECU_ADDRESS 0x60006544 /end MEASUREMENT
/begin MEASUREMENT EnvT_stTReplMod "state of envt-model for replacement" UBYTE OneToOne 1 100 0.00 255.0 FORMAT "%5.1" ECU_ADDRESS 0x6000A06D /end MEASUREMENT
/begin MEASUREMENT EnvT_stTReplModIntr "state of envt-model for replacement internal" UBYTE OneToOne 1 100 0.00 255.0 FORMAT "%5.1" ECU_ADDRESS 0x6000654A /end MEASUREMENT
/begin MEASUREMENT EnvT_stTReplModLoc "state of envt-model for replacement" UBYTE OneToOne 1 100 0.00 255.0 FORMAT "%5.1" ECU_ADDRESS 0x60006543 /end MEASUREMENT
/begin MEASUREMENT EnvT_stTSensIntr "Status of the sensor available via CAN or ADC" UBYTE OneToOne 1 100 0.00 255.0 FORMAT "%5.1" ECU_ADDRESS 0x60006549 /end MEASUREMENT
/begin MEASUREMENT EnvT_stTSensModIntr "Internal status of the sensor based model" UBYTE OneToOne 1 100 0.00 255.0 FORMAT "%5.1" ECU_ADDRESS 0x60006548 /end MEASUREMENT
/begin MEASUREMENT EnvT_swtTSrcSel "Status of selection sensor" UBYTE OneToOne 1 100 0.00 255.0 FORMAT "%5.1" ECU_ADDRESS 0x60006547 /end MEASUREMENT
/begin MEASUREMENT EnvT_t "Environment temperature signal (with replacement reaction in case of sensor error)" SWORD Temp_Cels 1 100 -3549.940 3003.560 FORMAT "%8.3" ECU_ADDRESS 0x60004AEC /end MEASUREMENT
/begin MEASUREMENT EnvT_tCACRepl "Replacement value of the ambient temperature without CAN communication" SWORD Temp_Cels 1 100 -3549.940 3003.560 FORMAT "%8.3" ECU_ADDRESS 0x60003A4A /end MEASUREMENT
/begin MEASUREMENT EnvT_tDifTIntkTEnvMdl "Difference between the Intake Temperature and the modelled Ambient Temperature" SWORD Temp_Cels 1 100 -3549.940 3003.560 FORMAT "%8.3" ECU_ADDRESS 0x60003A32 /end MEASUREMENT
/begin MEASUREMENT EnvT_tiModWrmCntr "Time, the engine is in state warm" UWORD t_q1 1 100 0.00 65535.00 FORMAT "%8.2" ECU_ADDRESS 0x60003A30 /end MEASUREMENT
/begin MEASUREMENT EnvT_tMdl2 "Ambient Temperature Model value for Oil deterioration system" SWORD Temp_Cels 1 100 -3549.940 3003.560 FORMAT "%8.3" ECU_ADDRESS 0x60004AEA /end MEASUREMENT
/begin MEASUREMENT EnvT_tModCS "EnvT-Modelling in Cold start" SWORD Temp_Cels 1 100 -3549.940 3003.560 FORMAT "%8.3" ECU_ADDRESS 0x60003A2E /end MEASUREMENT
/begin MEASUREMENT EnvT_tModHeatgIndcr "Auxillary variable to determine the offset between intake air temperature and EnvT" SWORD Temp_Cels 1 100 -3549.940 3003.560 FORMAT "%8.3" ECU_ADDRESS 0x60003A2C /end MEASUREMENT
/begin MEASUREMENT EnvT_tModHeatgIndcrFlt "Offset between intake air temperature and EnvT (filtered)" SWORD Temp_Cels 1 100 -3549.940 3003.560 FORMAT "%8.3" ECU_ADDRESS 0x60003A2A /end MEASUREMENT
/begin MEASUREMENT EnvT_tModHeatingIndcr "Offset between intake air temperature and EnvT" SWORD Temp_Cels 1 100 -3549.940 3003.560 FORMAT "%8.3" ECU_ADDRESS 0x60003A28 /end MEASUREMENT
/begin MEASUREMENT EnvT_tPlausMod "Value of the EnvT-Model for plausibilisation" SWORD Temp_Cels 1 100 -3549.940 3003.560 FORMAT "%8.3" ECU_ADDRESS 0x60004AE6 /end MEASUREMENT
/begin MEASUREMENT EnvT_tPlausModLoc "Value of the EnvT-Model for plausibilisation" SWORD Temp_Cels 1 100 -3549.940 3003.560 FORMAT "%8.3" ECU_ADDRESS 0x60003A26 /end MEASUREMENT
/begin MEASUREMENT EnvT_tPrimMod "Value of the primary model of the EnvT" SWORD Temp_Cels 1 100 -3549.940 3003.560 FORMAT "%8.3" ECU_ADDRESS 0x600365E0 /end MEASUREMENT
/begin MEASUREMENT EnvT_tPrimModBas "value of the base (intake air temperature) for determination of the primary EnvT-Model" SWORD Temp_Cels 1 100 -3549.940 3003.560 FORMAT "%8.3" ECU_ADDRESS 0x60003A24 /end MEASUREMENT
/begin MEASUREMENT EnvT_tPrimModBasMin "minimal base value (intake air temperature) for determination the primary EnvT-Model" SWORD Temp_Cels 1 100 -3549.940 3003.560 FORMAT "%8.3" ECU_ADDRESS 0x60003A22 /end MEASUREMENT
/begin MEASUREMENT EnvT_tReplMod "Value of the EnvT-Model for replacement" SWORD Temp_Cels 1 100 -3549.940 3003.560 FORMAT "%8.3" ECU_ADDRESS 0x60004AE4 /end MEASUREMENT
/begin MEASUREMENT EnvT_tReplModIntr "Internal value of the environment temperature model for a substitute value" SWORD Temp_Cels 1 100 -3549.940 3003.560 FORMAT "%8.3" ECU_ADDRESS 0x60003A48 /end MEASUREMENT
/begin MEASUREMENT EnvT_tReplModLoc "Value of the EnvT-Model for replacement" SWORD Temp_Cels 1 100 -3549.940 3003.560 FORMAT "%8.3" ECU_ADDRESS 0x60003A20 /end MEASUREMENT
/begin MEASUREMENT EnvT_tSensFrz "sensor value of the ambient temperature maintained" SWORD Temp_Cels 1 100 -3549.940 3003.560 FORMAT "%8.3" ECU_ADDRESS 0x60003A46 /end MEASUREMENT
/begin MEASUREMENT EnvT_tSensIntr "Internal sensor value of the ambient temperature" SWORD Temp_Cels 1 100 -3549.940 3003.560 FORMAT "%8.3" ECU_ADDRESS 0x60003A44 /end MEASUREMENT
/begin MEASUREMENT EnvT_tSensIntrLstVal "Last valid sensor value of the environment temperature" SWORD Temp_Cels 1 100 -3549.940 3003.560 FORMAT "%8.3" ECU_ADDRESS 0x600365E2 /end MEASUREMENT
/begin MEASUREMENT EnvT_tSensLstVal "Message to update stored ambient temperature value" SWORD Temp_Cels 1 100 -3549.940 3003.560 FORMAT "%8.3" ECU_ADDRESS 0x60004AE2 /end MEASUREMENT
/begin MEASUREMENT EnvT_tSensModIntr "Internal copy of the sensor based modeling of the EnvT" SWORD Temp_Cels 1 100 -3549.940 3003.560 FORMAT "%8.3" ECU_ADDRESS 0x60003A42 /end MEASUREMENT
/begin MEASUREMENT EnvT_tSigVal "Environment temperature value for the tester" UBYTE temp_q1p0_o40_degC 1 100 -40.0 215.0 FORMAT "%5.1" ECU_ADDRESS 0x6000A06C /end MEASUREMENT
/begin MEASUREMENT EnvT_tStyMod "Value of the steady model of the EnvT" SWORD Temp_Cels 1 100 -3549.940 3003.560 FORMAT "%8.3" ECU_ADDRESS 0x60003A1E /end MEASUREMENT
/begin MEASUREMENT EnvT_t_Sq "10) Signal Quality of Environment Temperature." UBYTE SigQly_COMPU_VERB 1 100 0.00 15.0000000000 FORMAT "%13.10" ECU_ADDRESS 0x6000A06B /end MEASUREMENT
/begin MEASUREMENT EnvT_vVehStyMod "Copy of VehV_v for Ambient Temperature model" SWORD Vel 1 100 -327.6800 327.6700 FORMAT "%8.4" ECU_ADDRESS 0x60003A1C /end MEASUREMENT
/begin MEASUREMENT EpmBCr_agCasEdge "Angle clock value captured at camshaft edge event in backup crankshaft mode" ULONG OneToOne 1 100 0.00 4294967295.00 FORMAT "%13.2" ECU_ADDRESS 0x600014F4 /end MEASUREMENT
/begin MEASUREMENT EpmBCr_agCurr "Current Angle clock value for the detection of loss of camshaft signal in backup crankshaft mode" ULONG OneToOne 1 100 0.00 4294967295.00 FORMAT "%13.2" ECU_ADDRESS 0x600014F0 /end MEASUREMENT
/begin MEASUREMENT EpmBCr_ctCaSRev "counter for camshaft-revolutions without plausibility" UBYTE OneToOne 1 100 0.00 255.0 FORMAT "%5.1" ECU_ADDRESS 0x60006542 /end MEASUREMENT
/begin MEASUREMENT EpmBCr_ctEdge "Edge counter during the backup crankshaft" UBYTE OneToOne 1 100 0.00 255.0 FORMAT "%5.1" ECU_ADDRESS 0x60006541 /end MEASUREMENT
/begin MEASUREMENT EpmBCr_ctEdgeRefTabIdx "pointer to the angle in the cas-ref-tab of the next edge on the CaS" UBYTE OneToOne 1 100 0.00 255.0 FORMAT "%5.1" ARRAY_SIZE 1 ECU_ADDRESS 0x60006538 /end MEASUREMENT
/begin MEASUREMENT EpmBCr_ctPttMtchFail "Counter for tolerated (as unprecise) segment times" UBYTE OneToOne 1 100 0.00 255.0 FORMAT "%5.1" ECU_ADDRESS 0x60000779 /end MEASUREMENT
/begin MEASUREMENT EpmBCr_ctPttMtchFailEdge "Counter for CaS edge when backup mode is in tolerance state" UBYTE OneToOne 1 100 0.00 255.0 FORMAT "%5.1" ECU_ADDRESS 0x6000077A /end MEASUREMENT
/begin MEASUREMENT EpmBCr_eveIdPriCamShft "Indicates event id for Primary camshaft edge event" UWORD OneToOne 1 100 0.00 65535.00 FORMAT "%8.2" ECU_ADDRESS 0x60003A16 /end MEASUREMENT
/begin MEASUREMENT EpmBCr_facPlaus "Factor used for the calculation of timeout angle to detect loss of camshaft signal in backup crankshaft mode" UBYTE OneToOne 1 100 0.00 255.0 FORMAT "%5.1" ECU_ADDRESS 0x60006539 /end MEASUREMENT
/begin MEASUREMENT EpmBCr_flgStrtDirectAllwd "Indicator whether a direct activation (no error debounce of crankshaft sensor signal) of backupmode (wo crankshaft signal) is currently possible." UBYTE OneToOne 1 100 0.00 255.0 BIT_MASK 0x1 FORMAT "%5.1" ECU_ADDRESS 0x6000E414 /end MEASUREMENT
/begin MEASUREMENT EpmBCr_idxPttSync "Index of pattern where synchronisation currently happens" UBYTE OneToOne 1 100 0.00 255.0 FORMAT "%5.1" ECU_ADDRESS 0x6000A797 /end MEASUREMENT
/begin MEASUREMENT EpmBCr_lvlCaSCurr_mp "Camshaft current level information in Back-up mode" UBYTE OneToOne 1 100 0.00 255.0 FORMAT "%5.1" ECU_ADDRESS 0x70008A9B /end MEASUREMENT
/begin MEASUREMENT EpmBCr_nEng "engine speed calculated during backup crankshaft" SWORD EngN 1 100 -16384.00 16383.50 FORMAT "%8.2" ECU_ADDRESS 0x60003A0E /end MEASUREMENT
/begin MEASUREMENT EpmBCr_nrEdg2NxtSync_mp "Number of edges between current edge (at which synchronisation happened) and last sync mark." UBYTE OneToOne 1 100 0.00 255.0 FORMAT "%5.1" ECU_ADDRESS 0x70008A9A /end MEASUREMENT
/begin MEASUREMENT EpmBCr_nrPttMtchAtIndx_mp "Index of edge where pattern has been recognized" UBYTE OneToOne 1 100 0.00 255.0 FORMAT "%5.1" ECU_ADDRESS 0x70008A99 /end MEASUREMENT
/begin MEASUREMENT EpmBCr_numCtgryPttCur_mp "Number of pattern category based on CaS edge time stamps at the current edge" ULONG OneToOne 1 100 0.00 4294967295.00 FORMAT "%13.2" ECU_ADDRESS 0x700086A8 /end MEASUREMENT
/begin MEASUREMENT EpmBCr_numCtgryPtt_mp "Camshaft pattern for each camshaft edge" ULONG OneToOne 1 100 0.00 4294967295.00 FORMAT "%13.2" ARRAY_SIZE 16 ECU_ADDRESS 0x7000874C /end MEASUREMENT
/begin MEASUREMENT EpmBCr_numEdg2NxtEquiEdge_mp "Number of CaS edges between the current edge and the next equidistant edge" UBYTE OneToOne 1 100 0.00 255.0 FORMAT "%5.1" ECU_ADDRESS 0x70008A98 /end MEASUREMENT
/begin MEASUREMENT EpmBcr_numEdgEqui "Number of equidistant edges on current camshaft flywheel, calculated by and for use in EpmBCr" UBYTE OneToOne 1 100 0.00 255.0 FORMAT "%5.1" ECU_ADDRESS 0x60006540 /end MEASUREMENT
/begin MEASUREMENT EpmBcr_numPttPlaus "Number of required patterns (of ratios of segmentlengths) on the current camshaft flywheel, for being able to detect a unique position." UBYTE OneToOne 1 100 0.00 255.0 FORMAT "%5.1" ECU_ADDRESS 0x6000653F /end MEASUREMENT
/begin MEASUREMENT EpmBcr_numSeg2Sync "Number of required segment timestamps to calculate a pattern of ratios to detect the position on the currently mounted camshaft flywheel" UBYTE OneToOne 1 100 0.00 255.0 FORMAT "%5.1" ECU_ADDRESS 0x6000653E /end MEASUREMENT
/begin MEASUREMENT EpmBCr_numSegPtt "Number of required segments to determine a unique position" UBYTE OneToOne 1 100 0.00 255.0 FORMAT "%5.1" ECU_ADDRESS 0x6000653D /end MEASUREMENT
/begin MEASUREMENT EpmBcr_numSyncMark "Number of synchro marks on the camshaft flywheel" UBYTE OneToOne 1 100 0.00 255.0 FORMAT "%5.1" ECU_ADDRESS 0x6000653C /end MEASUREMENT
/begin MEASUREMENT EpmBCr_phiCaSPos "Position of the camshaft at equidistant edges" SWORD AngleCrS 1 100 -720.0000 719.9780 FORMAT "%8.4" ECU_ADDRESS 0x60003A1A /end MEASUREMENT
/begin MEASUREMENT EpmBCr_phiCurrCaSEdge "position of current detected camshaft edge during backup crankshaft" SWORD AngleCrS 1 100 -720.0000 719.9780 FORMAT "%8.4" ARRAY_SIZE 1 ECU_ADDRESS 0x60003A14 /end MEASUREMENT
/begin MEASUREMENT EpmBCr_phiLastCaSEdge "The last Camshaft edge per Camshaft" SWORD AngleCrS 1 100 -720.0000 719.9780 FORMAT "%8.4" ARRAY_SIZE 1 ECU_ADDRESS 0x60003A12 /end MEASUREMENT
/begin MEASUREMENT EpmBCr_phiNxtCaSEdge "position of the next expected camshaft edge during backup crankshaft" SWORD AngleCrS 1 100 -720.0000 719.9780 FORMAT "%8.4" ECU_ADDRESS 0x60003A0C /end MEASUREMENT
/begin MEASUREMENT EpmBCr_phiPos "engine postion at time of Interrupt at a segment-edge of the camshaft" SWORD AngleCrS 1 100 -720.0000 719.9780 FORMAT "%8.4" ECU_ADDRESS 0x60003A0A /end MEASUREMENT
/begin MEASUREMENT EpmBCr_phiPtt_mp "Angle position of every camshaft edge where a pattern was assigned to" SWORD AngleCrS 1 100 -720.0000 719.9780 FORMAT "%8.4" ARRAY_SIZE 10 ECU_ADDRESS 0x70008884 /end MEASUREMENT
/begin MEASUREMENT EpmBCr_phiSeg2Seg "distance between the segmentedges" SWORD AngleCrS 1 100 -720.0000 719.9780 FORMAT "%8.4" ECU_ADDRESS 0x60003A18 /end MEASUREMENT
/begin MEASUREMENT EpmBCr_phiWaitNoSig "Timeout angle from a previous camshaft edge within which next camshaft edge is expected" SWORD AngleCrS 1 100 -720.0000 719.9780 FORMAT "%8.4" ECU_ADDRESS 0x60003A10 /end MEASUREMENT
/begin MEASUREMENT EpmBCr_phiZero2Sync "Internal prototype size for defining the position Syncmark" SWORD OneToOne 1 100 -32768.00 32767.00 FORMAT "%8.2" ARRAY_SIZE 8 ECU_ADDRESS 0x50005344 /end MEASUREMENT
/begin MEASUREMENT EpmBCr_rSeg2SegCurr_mp "Ratio of the recent two segment lengths at the current camshaft edge in backup mode without crankshaft sensor" ULONG EPMBCR_FACRATIO 1 100 0.00 4294967.29500 FORMAT "%13.5" ECU_ADDRESS 0x70008748 /end MEASUREMENT
/begin MEASUREMENT EpmBCr_rSeg2Seg_mpA "Ratio of the recent two segment lengths at all camshaft edges in backup mode without crankshaft sensor" ULONG EPMBCR_FACRATIO 1 100 0.00 4294967.29500 FORMAT "%13.5" ARRAY_SIZE 16 ECU_ADDRESS 0x70008708 /end MEASUREMENT
/begin MEASUREMENT EpmBCr_stDetailed_mp "Detailed status of backup mode without crankshaft" UBYTE EpmBCr_Plaus_StatusDetails_CM 1 100 0.00 8.00000000000 FORMAT "%13.11" ECU_ADDRESS 0x70008A97 /end MEASUREMENT
/begin MEASUREMENT EpmBCr_stDSMRdy "DSM init state used by the FC" UBYTE OneToOne 1 100 0.00 255.0 BIT_MASK 0x1 FORMAT "%5.1" ECU_ADDRESS 0x70001A08 /end MEASUREMENT
/begin MEASUREMENT EpmBCr_stIniPttFail "Status to display whether initialization of EpmBCr_Plaus has possibly failed" UBYTE OneToOne 1 100 0.00 255.0 FORMAT "%5.1" ECU_ADDRESS 0x6000653B /end MEASUREMENT
/begin MEASUREMENT EpmBCr_stOpModeOld "operation Mode Old" UBYTE Epm_stOpMode_State_t 1 100 1.0000000000 60.0000000000 FORMAT "%13.10" ECU_ADDRESS 0x70002D51 /end MEASUREMENT
/begin MEASUREMENT EpmBCr_stPlaus "state of plausibilisation of the camshaft-signal during backup crankshaft" UBYTE EpmBCr_stPlaus_State 1 100 0.00 2.00000000000 FORMAT "%13.11" ARRAY_SIZE 1 ECU_ADDRESS 0x6000653A /end MEASUREMENT
/begin MEASUREMENT EpmBCr_stPos "state of position-detection during backup crankshaft" UBYTE EpmBCr_stPos_State 1 100 0.00 1.00000000000 FORMAT "%13.11" ECU_ADDRESS 0x60006537 /end MEASUREMENT
/begin MEASUREMENT EpmBCr_stPttCurrIsSync_mp "Status that indicates whether the edge where syncronisation happened is a sync mark" UBYTE OneToOne 1 100 0.00 255.0 FORMAT "%5.1" ECU_ADDRESS 0x70008A96 /end MEASUREMENT
/begin MEASUREMENT EpmBCr_stPttSync_mp "Status measurement which indicates whether a certain camshaft edge is a sync mark." UBYTE OneToOne 1 100 0.00 255.0 FORMAT "%5.1" ARRAY_SIZE 10 ECU_ADDRESS 0x70008A8C /end MEASUREMENT
/begin MEASUREMENT EpmBCr_swtUpdEdge_mp "Indicates whether in backup mode without crankshaft, calculation of engine speed and angle clock frequency is done on all camshaft edges or on equidistant edges, only" UBYTE EpmBCr_swtUpdEdge_CM 1 100 0.00 1.00000000000 FORMAT "%13.11" ECU_ADDRESS 0x70008A8B /end MEASUREMENT
/begin MEASUREMENT EpmBCr_tiCaSEdg_mp "Measurement array which contains the current camshaft edge time stamps." SLONG OneToOne_us 1 100 -2147483648.00 2147483647.00 FORMAT "%13.2" ARRAY_SIZE 7 ECU_ADDRESS 0x700086EC /end MEASUREMENT
/begin MEASUREMENT EpmBCr_tiCaSSegDur_mp "Measurement array which contains the current camshaft segment duration times plus the edge counter" SLONG OneToOne_us 1 100 -2147483648.00 2147483647.00 FORMAT "%13.2" ARRAY_SIZE 16 ECU_ADDRESS 0x700086AC /end MEASUREMENT
/begin MEASUREMENT EpmBCr_tiIncPer "Period-time of a simulated crankshaft-increment" SLONG OneToOne 1 100 -2147483648.00 2147483647.00 FORMAT "%13.2" ECU_ADDRESS 0x600014EC /end MEASUREMENT
/begin MEASUREMENT EpmBCr_tiSeg "time between 2 segment-edges (time during the angle EpmBCr_phiSeg2Seg)" SLONG OneToOne_us 1 100 -2147483648.00 2147483647.00 FORMAT "%13.2" ECU_ADDRESS 0x600014F8 /end MEASUREMENT
/begin MEASUREMENT EpmCaS_agCorrnStat "static corrections of the camshaft position in relation to the calibrated reference position (Calibration array for the Encoded series of camshaft segments, Calibration array for the camshaft segments length)" SWORD AngleCrS 1 100 -720.0000 719.9780 FORMAT "%8.4" ARRAY_SIZE 1 ECU_ADDRESS 0x6000D8C0 /end MEASUREMENT
/begin MEASUREMENT EpmCaS_allCaSEdges "8 bit Camshaft edge counter for all configured camshaft signals" UBYTE OneToOne 1 100 0.00 255.0 FORMAT "%5.1" ARRAY_SIZE 1 ECU_ADDRESS 0x6000A75F /end MEASUREMENT
/begin MEASUREMENT EpmCaS_bActivatePatmat "Bit to activate the camshaft pattern matching inside EpmSyn_CaSPos from the camshaft diagnosis" UBYTE OneToOne 1 100 0.00 255.0 FORMAT "%5.1" ARRAY_SIZE 1 ECU_ADDRESS 0x60006532 /end MEASUREMENT
/begin MEASUREMENT EpmCaS_bCaSDiagflgClr "Request of FCM-clear for DFC_EpmCaS" UBYTE OneToOne 1 100 0.00 255.0 BIT_MASK 0x1 FORMAT "%5.1" ECU_ADDRESS 0x50005D1C /end MEASUREMENT
/begin MEASUREMENT EpmCaS_bCaSEdgeTout "Edges timeout occured on specific camshaft" UBYTE OneToOne 1 100 0.00 255.0 FORMAT "%5.1" ARRAY_SIZE 1 ECU_ADDRESS 0x60006525 /end MEASUREMENT
/begin MEASUREMENT EpmCaS_bfixVariAdapPerm "Status for release to adaptation for fix cam" UBYTE OneToOne 1 100 0.00 255.0 BIT_MASK 0x1 FORMAT "%5.1" ECU_ADDRESS 0x60006536 /end MEASUREMENT
/begin MEASUREMENT EpmCaS_bOfsErrflgClr "Tester demand for clearing for DFC_EpmCaSOfsErr" UBYTE OneToOne 1 100 0.00 255.0 BIT_MASK 0x1 FORMAT "%5.1" ECU_ADDRESS 0x6000652D /end MEASUREMENT
/begin MEASUREMENT EpmCaS_CASI1ctEdge10msU8 "8 bit edge counter for camshaft input signal 1" UBYTE OneToOne 1 100 0.00 255.0 FORMAT "%5.1" ECU_ADDRESS 0x70002D86 /end MEASUREMENT
/begin MEASUREMENT EpmCaS_cntrAdapPostDrvLveOld "internal counter for the postdrive leaving event" UBYTE OneToOne 1 100 0.00 255.0 FORMAT "%5.1" ECU_ADDRESS 0x600006DA /end MEASUREMENT
/begin MEASUREMENT EpmCaS_cntrDiagPostDrvLeave "Local drive cycle counter, which is incremented, when system state SyC_PostDrive is left." UBYTE OneToOne 1 100 0.00 255.0 FORMAT "%5.1" ECU_ADDRESS 0x50005D1D /end MEASUREMENT
/begin MEASUREMENT EpmCaS_cntrEdgeLstCyc "Counter of the number of camshaft edges in the most recent complete camshaft revolution" UWORD OneToOne 1 100 0.00 65535.00 FORMAT "%8.2" ARRAY_SIZE 1 ECU_ADDRESS 0x70002B70 /end MEASUREMENT
/begin MEASUREMENT EpmCaS_cntrOfsEdgeLst "Number of camshaft edges at last call" SWORD OneToOne 1 100 -32768.00 32767.00 FORMAT "%8.2" ARRAY_SIZE 1 ECU_ADDRESS 0x600039F6 /end MEASUREMENT
/begin MEASUREMENT EpmCaS_ctCaSEdgeLast "number of edges on the camshaft since engine was started or the buffer was initialized" UWORD OneToOne 1 100 0.00 65535.00 FORMAT "%8.2" ARRAY_SIZE 1 ECU_ADDRESS 0x60005370 /end MEASUREMENT
/begin MEASUREMENT EpmCaS_ctEdgeEquid "Offset of last equidistant camshaft edge in EpmSyn_ctEdgeMapEquid" SBYTE OneToOne 1 100 -128.0 127.0 FORMAT "%5.1" ARRAY_SIZE 1 ECU_ADDRESS 0x6000A796 /end MEASUREMENT
/begin MEASUREMENT EpmCaS_ctEdgeLst "Number of camshaft edges at last call" SWORD OneToOne 1 100 -32768.00 32767.00 FORMAT "%8.2" ARRAY_SIZE 1 ECU_ADDRESS 0x50005354 /end MEASUREMENT
/begin MEASUREMENT EpmCaS_ctErrSig "Debouncecounter for errors during patternmatching" UWORD CrSRev2CrSInc 1 100 0.00 1820.417 FORMAT "%8.3" ARRAY_SIZE 1 ECU_ADDRESS 0x600039FC /end MEASUREMENT
/begin MEASUREMENT EpmCaS_ctMeasEdgeLstI1 "Number of camshaft edges in the buffer of camshaft I1 at last call" SWORD OneToOne 1 100 -32768.00 32767.00 FORMAT "%8.2" ECU_ADDRESS 0x6000D8C2 /end MEASUREMENT
/begin MEASUREMENT EpmCaS_ctNoSig "debouncing counter for no signal" UWORD CrSRev2CrSInc 1 100 0.00 1820.417 FORMAT "%8.3" ARRAY_SIZE 1 ECU_ADDRESS 0x600039FA /end MEASUREMENT
/begin MEASUREMENT EpmCaS_ctOfsCrSRev "Cam-shaft revolution counter of the cam-shaft offset diagnosis" UWORD OneToOne 1 100 0.00 65535.00 FORMAT "%8.2" ECU_ADDRESS 0x600039F8 /end MEASUREMENT
/begin MEASUREMENT EpmCaS_ctOfsErr "Debounce counter used for healing \ setting of DFC_EpmCaSI1OfsErr" UBYTE OneToOne 1 100 0.00 255.0 FORMAT "%5.1" ARRAY_SIZE 1 ECU_ADDRESS 0x6000652C /end MEASUREMENT
/begin MEASUREMENT EpmCaS_ctRevNoSig "Debouncecounter for nosig-error of camshaft" UWORD RevCnt 1 100 0.00 4095.938 FORMAT "%8.3" ARRAY_SIZE 1 ECU_ADDRESS 0x60003A02 /end MEASUREMENT
/begin MEASUREMENT EpmCaS_ctRevSig "Revolution counter for debouncing camshaft error" UWORD RevCnt 1 100 0.00 4095.938 FORMAT "%8.3" ARRAY_SIZE 1 ECU_ADDRESS 0x50005356 /end MEASUREMENT
/begin MEASUREMENT EpmCaS_ctSigOk "Debouncecounter for healing camshaft-error" UWORD CrSRev2CrSInc 1 100 0.00 1820.417 FORMAT "%8.3" ARRAY_SIZE 1 ECU_ADDRESS 0x50005358 /end MEASUREMENT
/begin MEASUREMENT EpmCaS_ctTriesAdap "Number of adaption attempts" UWORD OneToOne 1 100 0.00 65535.00 FORMAT "%8.2" ARRAY_SIZE 1 ECU_ADDRESS 0x60003A08 /end MEASUREMENT
/begin MEASUREMENT EpmCaS_flgCaSAdapflgClr "status for reset request by testinterface" UBYTE OneToOne 1 100 0.00 255.0 BIT_MASK 0x1 FORMAT "%5.1" ECU_ADDRESS 0x600006DB /end MEASUREMENT
/begin MEASUREMENT EpmCaS_flgResetAfterErr "rest adaptation after activating DFC" UBYTE OneToOne 1 100 0.00 255.0 FORMAT "%5.1" ARRAY_SIZE 1 ECU_ADDRESS 0x600006DC /end MEASUREMENT
/begin MEASUREMENT EpmCaS_flgSwtSnglEdgeTolInt "internal Switch for activation of the single edge tolerance of the CTEDGE functionality for systems with variable camshaft (is set during SyncIni to EpmCaS_flgSwtSnglEdgeTol_C)" UBYTE OneToOne 1 100 0.00 255.0 FORMAT "%5.1" ECU_ADDRESS 0x50005D1E /end MEASUREMENT
/begin MEASUREMENT EpmCaS_nCaS_mp "camshaft spedd based on one camshaft rotation" SWORD EngNCaS 1 100 -8192.000 8191.750 FORMAT "%8.3" ECU_ADDRESS 0x70008870 /end MEASUREMENT
/begin MEASUREMENT EpmCaS_nEng "engine speed based on a camshaft-revolution" SWORD EngN 1 100 -16384.00 16383.50 FORMAT "%8.2" ECU_ADDRESS 0x6000E1DE /end MEASUREMENT
/begin MEASUREMENT EpmCaS_numCurrEdge "Number of counted camshaft edges in the actualcamshaft revolution" UWORD OneToOne 1 100 0.00 65535.00 FORMAT "%8.2" ARRAY_SIZE 1 ECU_ADDRESS 0x5000535A /end MEASUREMENT
/begin MEASUREMENT EpmCaS_numEquidEdg "Number of calibrated equidistant edges over a camshaft rotation" UBYTE OneToOne 1 100 0.00 255.0 FORMAT "%5.1" ARRAY_SIZE 1 ECU_ADDRESS 0x6000A75E /end MEASUREMENT
/begin MEASUREMENT EpmCaS_numErrSigDefInt "internal Limit of the debounce counter for recognizing a defect when camshaft disturbance occurs." UWORD CrSRev2CrSInc 1 100 0.00 1820.417 FORMAT "%8.3" ECU_ADDRESS 0x60003A00 /end MEASUREMENT
/begin MEASUREMENT EpmCaS_numErrSigOkInt "internal Limit of the debounce counter for healing a recognized camshaft disturbance (is set during SyncIni to EpmCaS_numErrSigOk_C)" UWORD CrSRev2CrSInc 1 100 0.00 1820.417 FORMAT "%8.3" ECU_ADDRESS 0x5000535C /end MEASUREMENT
/begin MEASUREMENT EpmCaS_numLosEquidEdg_mp "Number of lost equidistant edges" UBYTE OneToOne 1 100 0.00 255.0 FORMAT "%5.1" ARRAY_SIZE 1 ECU_ADDRESS 0x70008A8A /end MEASUREMENT
/begin MEASUREMENT EpmCaS_numMplPatEquidEdg_mp "Number of multiple patterns with equidistant edges" UBYTE OneToOne 1 100 0.00 255.0 FORMAT "%5.1" ARRAY_SIZE 1 ECU_ADDRESS 0x70008A89 /end MEASUREMENT
/begin MEASUREMENT EpmCaS_numNoSigDefInt "internal Limit for debounce counter to recognize the loss of a camshaft signal (is set during SyncIni to EpmCaS_numNoSigDef_C)" UWORD CrSRev2CrSInc 1 100 0.00 1820.417 FORMAT "%8.3" ECU_ADDRESS 0x600039FE /end MEASUREMENT
/begin MEASUREMENT EpmCaS_numPriCamShft "Primary camshaft which is used to calculate the engine speed from camshaft and to support backup mode" UBYTE OneToOne 1 100 0.00 255.0 FORMAT "%5.1" ECU_ADDRESS 0x70002D52 /end MEASUREMENT
/begin MEASUREMENT EpmCaS_numRawValueI1 "Index of the latest valid element in the array of the camshaft raw values I1" SBYTE OneToOne 1 100 -128.0 127.0 FORMAT "%5.1" ECU_ADDRESS 0x6000E3A2 /end MEASUREMENT
/begin MEASUREMENT EpmCaS_numSegSerLst "Number of calibrated camshaft segments minus one" UBYTE OneToOne 1 100 0.00 255.0 FORMAT "%5.1" ARRAY_SIZE 1 ECU_ADDRESS 0x6000B4C0 /end MEASUREMENT
/begin MEASUREMENT EpmCaS_numValidTime "Number of valid time entries in the buffer of primary camshaft" UBYTE OneToOne 1 100 0.00 255.0 FORMAT "%5.1" ECU_ADDRESS 0x70002D87 /end MEASUREMENT
/begin MEASUREMENT EpmCaS_numVldEquidEdg_mp "Number of valid equidistant edges which have been found" UBYTE OneToOne 1 100 0.00 255.0 FORMAT "%5.1" ARRAY_SIZE 1 ECU_ADDRESS 0x70008A88 /end MEASUREMENT
/begin MEASUREMENT EpmCaS_OfsAvrgBuf "Buffer for Averaging filter for the Cas Offset" SLONG AngleCrS 1 100 -47185920.0000 47185919.9780 FORMAT "%13.4" ARRAY_SIZE 1 ECU_ADDRESS 0x60002F64 /end MEASUREMENT
/begin MEASUREMENT EpmCaS_phiAdapRefPos "Current fine adaption reference positions" SWORD AngleCrS 1 100 -720.0000 719.9780 FORMAT "%8.4" ARRAY_SIZE 8 ECU_ADDRESS 0x600360F8 /end MEASUREMENT
/begin MEASUREMENT EpmCaS_phiAdapRefPosI1 "adapted reference-positions of inlet-camshaft" SWORD AngleCrS 1 100 -720.0000 719.9780 FORMAT "%8.4" ARRAY_SIZE 8 ECU_ADDRESS 0x50005A30 /end MEASUREMENT
/begin MEASUREMENT EpmCaS_phiCaSOfsAvg "average value of camshaft offset" SLONG AngleCrS 1 100 -47185920.0000 47185919.9780 FORMAT "%13.4" ARRAY_SIZE 1 ECU_ADDRESS 0x50004C54 /end MEASUREMENT
/begin MEASUREMENT EpmCaS_phiCor "Correction angle of the camshaft for engine speed and temperature" SWORD AngleCrS 1 100 -720.0000 719.9780 FORMAT "%8.4" ARRAY_SIZE 1 ECU_ADDRESS 0x600053AE /end MEASUREMENT
/begin MEASUREMENT EpmCaS_phiDiffCal2Adap "difference between calibrated and adapted camshaft edges" SWORD AngleCrS 1 100 -720.0000 719.9780 FORMAT "%8.4" ARRAY_SIZE 8 ECU_ADDRESS 0x500058E4 /end MEASUREMENT
/begin MEASUREMENT EpmCaS_phiDiffCal2AdapEqAvg "Average difference between calibrated and adapted positions of equidistant camshaft edges" SWORD AngleCrS 1 100 -720.0000 719.9780 FORMAT "%8.4" ARRAY_SIZE 1 ECU_ADDRESS 0x60003A06 /end MEASUREMENT
/begin MEASUREMENT EpmCaS_phiDiffLim "limited difference of actual camshaft position to reference position" SWORD AngleCrS 1 100 -720.0000 719.9780 FORMAT "%8.4" ARRAY_SIZE 1 ECU_ADDRESS 0x600053AA /end MEASUREMENT
/begin MEASUREMENT EpmCaS_phiDiffLimSecLst "limited difference of actual secondlast camshaft position to reference position" SWORD AngleCrS 1 100 -720.0000 719.9780 FORMAT "%8.4" ARRAY_SIZE 1 ECU_ADDRESS 0x600053AC /end MEASUREMENT
/begin MEASUREMENT EpmCaS_phiDstEquidEdg "Angle between the calibrated equidistant edges in crankshaft degree" SWORD AngleCrS 1 100 -720.0000 719.9780 FORMAT "%8.4" ARRAY_SIZE 1 ECU_ADDRESS 0x600053A8 /end MEASUREMENT
/begin MEASUREMENT EpmCaS_phiEdge "angle of camshaft edge" SWORD AngleCrS 1 100 -720.0000 719.9780 FORMAT "%8.4" ARRAY_SIZE 1 ECU_ADDRESS 0x70002C3E /end MEASUREMENT
/begin MEASUREMENT EpmCaS_phiEdgeDvt_mp "difference between the deviation of the edge No. EpmCaS_numEdgeFltAvrg_C and the current edge to the average camshaft position" SWORD AngleCrS 1 100 -720.0000 719.9780 FORMAT "%8.4" ARRAY_SIZE 1 ECU_ADDRESS 0x7000886E /end MEASUREMENT
/begin MEASUREMENT EpmCaS_phiLosEquidEdg_mp "Angle of the equidistant edge which is lost in crankshaft degree" SWORD AngleCrS 1 100 -720.0000 719.9780 FORMAT "%8.4" ARRAY_SIZE 1 ECU_ADDRESS 0x70008872 /end MEASUREMENT
/begin MEASUREMENT EpmCaS_phiOfsAvrgUnflt "mean value of the relative camshaft edge adaption values, exhaust bank 1" SWORD AngleCrS 1 100 -720.0000 719.9780 FORMAT "%8.4" ARRAY_SIZE 1 ECU_ADDRESS 0x600053A6 /end MEASUREMENT
/begin MEASUREMENT EpmCaS_phiOfsCorr "filtered vaule of camshaft offset" SWORD AngleCrS 1 100 -720.0000 719.9780 FORMAT "%8.4" ARRAY_SIZE 1 ECU_ADDRESS 0x600053A4 /end MEASUREMENT
/begin MEASUREMENT EpmCaS_phiOfsTolc "Tolerance applied to real position of the equidistant edges and calibrated equidistant edges" SWORD AngleCrS 1 100 -720.0000 719.9780 FORMAT "%8.4" ARRAY_SIZE 1 ECU_ADDRESS 0x600053A2 /end MEASUREMENT
/begin MEASUREMENT EpmCaS_phiRawValueI1_mp "Array with the raw values of the edge positions of the camshaft I1" SWORD AngleCrS 1 100 -720.0000 719.9780 FORMAT "%8.4" ARRAY_SIZE 8 ECU_ADDRESS 0x70008874 /end MEASUREMENT
/begin MEASUREMENT EpmCaS_phiRefPos "calibrated positions for camshaft edges" SWORD AngleCrS 1 100 -720.0000 719.9780 FORMAT "%8.4" ARRAY_SIZE 8 ECU_ADDRESS 0x50005904 /end MEASUREMENT
/begin MEASUREMENT EpmCaS_phiRefPosEquiEdg "Reference position of the equidistant edges" SWORD AngleCrS 1 100 -720.0000 719.9780 FORMAT "%8.4" ARRAY_SIZE 8 ECU_ADDRESS 0x500058F4 /end MEASUREMENT
/begin MEASUREMENT EpmCaS_phiSegLenTolc "Tolerance applied to the length of equidistant camshaft segments" SWORD AngleCrS 1 100 -720.0000 719.9780 FORMAT "%8.4" ARRAY_SIZE 1 ECU_ADDRESS 0x600053A0 /end MEASUREMENT
/begin MEASUREMENT EpmCaS_phiTempCor "Angle correction value for each camshaft depending on temperature" SWORD AngleCrS 1 100 -720.0000 719.9780 FORMAT "%8.4" ARRAY_SIZE 1 ECU_ADDRESS 0x6000E1E0 /end MEASUREMENT
/begin MEASUREMENT EpmCaS_phiTempCorEng "Temperature correction factor for engine characteristics" SWORD AngleCrS 1 100 -720.0000 719.9780 FORMAT "%8.4" ARRAY_SIZE 1 ECU_ADDRESS 0x6000539E /end MEASUREMENT
/begin MEASUREMENT EpmCaS_ratLoadAdpnRls "Engine rate load for Release of Camshaft adaptation and Offset diagnosis" SWORD Prc 1 100 -400.0000 399.9878 FORMAT "%8.4" ECU_ADDRESS 0x60003A04 /end MEASUREMENT
/begin MEASUREMENT EpmCaS_stAdap "status of the camshaftadaption" UBYTE EpmCaS_stAdap_State 1 100 0.00 4.00000000000 FORMAT "%13.11" ARRAY_SIZE 1 ECU_ADDRESS 0x600360F6 /end MEASUREMENT
/begin MEASUREMENT EpmCaS_stAdapErr "error of the camshaft adaption which occured during adaption or test" UBYTE OneToOne 1 100 0.00 255.0 FORMAT "%5.1" ARRAY_SIZE 1 ECU_ADDRESS 0x60006534 /end MEASUREMENT
/begin MEASUREMENT EpmCaS_stAgPhaShiftFltActv_mp "Status of camshaft shift angle filter (0=deactivated; 1=activated)" UBYTE OneToOne 1 100 0.00 255.0 FORMAT "%5.1" ARRAY_SIZE 1 ECU_ADDRESS 0x70008A87 /end MEASUREMENT
/begin MEASUREMENT EpmCaS_stAgPhaShiftSecToLst_mp "state of phase shift for second last equistant camshaft edge" UBYTE EpmCaS_stAgPhaShift_t 1 100 0.00 3.00000000000 FORMAT "%13.11" ARRAY_SIZE 1 ECU_ADDRESS 0x70008A86 /end MEASUREMENT
/begin MEASUREMENT EpmCaS_stAgPhaShift_mp "state of the camshaft angle calulation" UBYTE EpmCaS_stAgPhaShift_t 1 100 0.00 3.00000000000 FORMAT "%13.11" ARRAY_SIZE 1 ECU_ADDRESS 0x70008A85 /end MEASUREMENT
/begin MEASUREMENT EpmCaS_stCoEngAdpnRls "Delayed CoEng state for Release of Camshaft adaptation and Offset diagnosis" UBYTE OneToOne 1 100 0.00 255.0 FORMAT "%5.1" ECU_ADDRESS 0x60006533 /end MEASUREMENT
/begin MEASUREMENT EpmCaS_stDiag "State of the camshaft diagnosis" UBYTE EpmCaS_stDiag_t 1 100 0.00 4.00000000000 FORMAT "%13.11" ARRAY_SIZE 1 ECU_ADDRESS 0x6000652F /end MEASUREMENT
/begin MEASUREMENT EpmCaS_stDiagErr "current state of camshaft-diagnosis" UBYTE EpmCaS_stDiagErr_t 1 100 0.00 3.00000000000 FORMAT "%13.11" ARRAY_SIZE 1 ECU_ADDRESS 0x6000652E /end MEASUREMENT
/begin MEASUREMENT EpmCaS_stDiagErrChgd "State of diagnosis has changed, therefore reporting to DSM active for this cycle" UBYTE OneToOne 1 100 0.00 255.0 BIT_MASK 0x1 FORMAT "%5.1" ECU_ADDRESS 0x50005D1F /end MEASUREMENT
/begin MEASUREMENT EpmCaS_stDiagModeInt "internal state to disable the camshaft diagnosis in EPM_MODE_OK if a camshaft fault is already detected. (is set during SyncIni to EpmCaS_stDiagMode_C)" UBYTE OneToOne 1 100 0.00 255.0 FORMAT "%5.1" ECU_ADDRESS 0x50005D20 /end MEASUREMENT
/begin MEASUREMENT EpmCaS_stDiagStopCdn "State diagnosis stop after detection of an error" UBYTE OneToOne 1 100 0.00 255.0 BIT_MASK 0x1 FORMAT "%5.1" ECU_ADDRESS 0x60006531 /end MEASUREMENT
/begin MEASUREMENT EpmCaS_stDSMRdyAdap "DSM init state used by the FC" UBYTE OneToOne 1 100 0.00 255.0 BIT_MASK 0x1 FORMAT "%5.1" ECU_ADDRESS 0x600006DD /end MEASUREMENT
/begin MEASUREMENT EpmCaS_stDSMRdyDiag "DSM init state used by the FC" UBYTE OneToOne 1 100 0.00 255.0 BIT_MASK 0x1 FORMAT "%5.1" ECU_ADDRESS 0x5000084D /end MEASUREMENT
/begin MEASUREMENT EpmCaS_stDSMRdyOfsDiag "DSM init state used by the FC" UBYTE OneToOne 1 100 0.00 255.0 BIT_MASK 0x1 FORMAT "%5.1" ECU_ADDRESS 0x600006DE /end MEASUREMENT
/begin MEASUREMENT EpmCaS_stDSMRdySeg "DSM init state used by the FC" UBYTE OneToOne 1 100 0.00 255.0 BIT_MASK 0x1 FORMAT "%5.1" ECU_ADDRESS 0x60006528 /end MEASUREMENT
/begin MEASUREMENT EpmCaS_stMeasCllsn "is set to TRUE if the call of the measuring function collides between the n-sync and the 10ms task" UBYTE OneToOne 1 100 0.00 255.0 BIT_MASK 0x1 FORMAT "%5.1" ECU_ADDRESS 0x70002D53 /end MEASUREMENT
/begin MEASUREMENT EpmCaS_stMeasUnLckd "Semaphore to inhibit a parallel call of the measuring function" UBYTE OneToOne 1 100 0.00 255.0 BIT_MASK 0x1 FORMAT "%5.1" ECU_ADDRESS 0x6000E3A3 /end MEASUREMENT
/begin MEASUREMENT EpmCaS_stNEng "State of the camshaft engine speed" UBYTE OneToOne 1 100 0.00 255.0 FORMAT "%5.1" ECU_ADDRESS 0x6000A75D /end MEASUREMENT
/begin MEASUREMENT EpmCaS_stOffsCalcn "Status of Camshaft Offset calculated in the current task cycle" UBYTE OneToOne 1 100 0.00 255.0 FORMAT "%5.1" ARRAY_SIZE 1 ECU_ADDRESS 0x6000A75C /end MEASUREMENT
/begin MEASUREMENT EpmCaS_stOfs "state of camshaft offset calculation" UBYTE EpmCas_stOfs_State 1 100 0.00 1.00000000000 FORMAT "%13.11" ARRAY_SIZE 1 ECU_ADDRESS 0x6000652B /end MEASUREMENT
/begin MEASUREMENT EpmCaS_stOfsAvrgUnflt "status of unfiltered angular displacement of the camshaft" UBYTE OneToOne 1 100 0.00 255.0 FORMAT "%5.1" ARRAY_SIZE 1 ECU_ADDRESS 0x6000A75B /end MEASUREMENT
/begin MEASUREMENT EpmCaS_stOfsErr "error state of camshaft offset diagnosis" UBYTE EpmCaS_stOfsErr_Val 1 100 0.00 5.00000000000 FORMAT "%13.11" ARRAY_SIZE 1 ECU_ADDRESS 0x6000652A /end MEASUREMENT
/begin MEASUREMENT EpmCaS_stPhaAdpn_mp "state of the adaption" UBYTE EpmCaS_stAdap_State 1 100 0.00 4.00000000000 FORMAT "%13.11" ARRAY_SIZE 1 ECU_ADDRESS 0x70008A84 /end MEASUREMENT
/begin MEASUREMENT EpmCaS_stPhaRefAdpn_mp "state of the reference adaption" UBYTE EpmCaS_stAdap_State 1 100 0.00 4.00000000000 FORMAT "%13.11" ARRAY_SIZE 1 ECU_ADDRESS 0x70008A83 /end MEASUREMENT
/begin MEASUREMENT EpmCaS_stphiDiffLim "state value for the calculation of the camshaft angle" UBYTE EpmCaS_stphiDiffLim_t 1 100 0.00 8.00000000000 FORMAT "%13.11" ARRAY_SIZE 1 ECU_ADDRESS 0x6000A759 /end MEASUREMENT
/begin MEASUREMENT EpmCaS_stphiDiffLimSecLst "state value for the calculation of the camshaft second last equidistant edge angle" UBYTE EpmCaS_stphiDiffLim_t 1 100 0.00 8.00000000000 FORMAT "%13.11" ARRAY_SIZE 1 ECU_ADDRESS 0x6000A75A /end MEASUREMENT
/begin MEASUREMENT EpmCaS_stPosValid "state if valid camshaft position was found or not" UBYTE OneToOne 1 100 0.00 255.0 FORMAT "%5.1" ARRAY_SIZE 1 ECU_ADDRESS 0x60006527 /end MEASUREMENT
/begin MEASUREMENT EpmCaS_stRefLevBefEquidEdg "Reference signal level before the equidistant edge" UBYTE OneToOne 1 100 0.00 255.0 FORMAT "%5.1" ARRAY_SIZE 8 ECU_ADDRESS 0x50005D45 /end MEASUREMENT
/begin MEASUREMENT EpmCaS_stRstAdap "locale request for reinitialization of locale variables" UBYTE OneToOne 1 100 0.00 255.0 BIT_MASK 0x1 FORMAT "%5.1" ECU_ADDRESS 0x600006DF /end MEASUREMENT
/begin MEASUREMENT EpmCaS_stRstDiag "locale request for reinitialization of locale variables" UBYTE OneToOne 1 100 0.00 255.0 BIT_MASK 0x1 FORMAT "%5.1" ECU_ADDRESS 0x5000084E /end MEASUREMENT
/begin MEASUREMENT EpmCaS_stRstOfsDiag "locale request for reinitialization of locale variables" UBYTE OneToOne 1 100 0.00 255.0 BIT_MASK 0x1 FORMAT "%5.1" ECU_ADDRESS 0x600006E0 /end MEASUREMENT
/begin MEASUREMENT EpmCaS_stRstSeg "locale request for reinitialization of locale variables" UBYTE OneToOne 1 100 0.00 255.0 BIT_MASK 0x1 FORMAT "%5.1" ECU_ADDRESS 0x600006E1 /end MEASUREMENT
/begin MEASUREMENT EpmCaS_stSegFault "Error state over one camshaft revolution" UBYTE OneToOne 1 100 0.00 255.0 FORMAT "%5.1" ARRAY_SIZE 1 ECU_ADDRESS 0x60006530 /end MEASUREMENT
/begin MEASUREMENT EpmCaS_stSnsrDeActvn "Status of deactivation of the configured camshaft" UBYTE OneToOne 1 100 0.00 255.0 FORMAT "%5.1" ARRAY_SIZE 1 ECU_ADDRESS 0x60006526 /end MEASUREMENT
/begin MEASUREMENT EpmCaS_stStrtAdapCondn "Start Adaptation Condition Status" UBYTE OneToOne 1 100 0.00 255.0 FORMAT "%5.1" ARRAY_SIZE 1 ECU_ADDRESS 0x60006535 /end MEASUREMENT
/begin MEASUREMENT EpmCaS_tAdpnRls "Temperature for camshaft adaption" SWORD Temp_Cels 1 100 -3549.940 3003.560 FORMAT "%8.3" ECU_ADDRESS 0x70001A06 /end MEASUREMENT
/begin MEASUREMENT EpmCaS_tAgSnsrCorr "Selection of temperature for camshaft angle correction" SWORD Temp_Cels 1 100 -3549.940 3003.560 FORMAT "%8.3" ECU_ADDRESS 0x600039F4 /end MEASUREMENT
/begin MEASUREMENT EpmCaS_tiDifAgPhaLstEdge_mp "time stamp for the last camshaft edge" SLONG OneToOne_us 1 100 -2147483648.00 2147483647.00 FORMAT "%13.2" ARRAY_SIZE 1 ECU_ADDRESS 0x700086A4 /end MEASUREMENT
/begin MEASUREMENT EpmCaS_tiDifAgPhaLstTwoEdges_mp "time stamp for the camshaft edge before last" SLONG OneToOne_us 1 100 -2147483648.00 2147483647.00 FORMAT "%13.2" ARRAY_SIZE 1 ECU_ADDRESS 0x700086A0 /end MEASUREMENT
/begin MEASUREMENT EpmCaS_tiEdge "time of camshaft edge" SLONG Per_Dur 1 100 -2147483648.00 2147483647.00 FORMAT "%13.2" ARRAY_SIZE 1 ECU_ADDRESS 0x70002B1C /end MEASUREMENT
/begin MEASUREMENT EpmCaS_tiNEngRstTimer "reset timer" SLONG Time_ms 1 100 -21474836480.0 21474836470.0 FORMAT "%13.1" ECU_ADDRESS 0x6000CD5C /end MEASUREMENT
/begin MEASUREMENT EpmCrS_bCrSDiagflgClr "Request of FCM-clear for DFC_EpmCrS" UBYTE OneToOne 1 100 0.00 255.0 FORMAT "%5.1" ECU_ADDRESS 0x60006524 /end MEASUREMENT
/begin MEASUREMENT EpmCrS_bDisturb "Condition that a signal disturbance has occured" UBYTE OneToOne 1 100 0.00 255.0 FORMAT "%5.1" ECU_ADDRESS 0x60006523 /end MEASUREMENT
/begin MEASUREMENT EpmCrS_bEnableCrSCaS "Crankshaft diagnosis - enable condition to check any signal missing" UBYTE B_TRUE 1 100 0.00 1.00000000000 FORMAT "%13.11" ECU_ADDRESS 0x60006522 /end MEASUREMENT
/begin MEASUREMENT EpmCrS_bEnableDisturb "Crankshaft diagnosis - enable condition to check any signal disturbance" UBYTE OneToOne 1 100 0.00 255.0 FORMAT "%5.1" ECU_ADDRESS 0x60006521 /end MEASUREMENT
/begin MEASUREMENT EpmCrS_ctCaSEdgeStart "start value of camshaft edges" SWORD OneToOne 1 100 -32768.00 32767.00 FORMAT "%8.2" ECU_ADDRESS 0x600039F2 /end MEASUREMENT
/begin MEASUREMENT EpmCrS_ctCaSRev_mp "debounce counter no crankshaft signal" SWORD OneToOne 1 100 -32768.00 32767.00 FORMAT "%8.2" ECU_ADDRESS 0x7000886C /end MEASUREMENT
/begin MEASUREMENT EpmCrS_ctErrSig "debounce counter wrong crankshaft signal" SWORD OneToOne 1 100 -32768.00 32767.00 FORMAT "%8.2" ECU_ADDRESS 0x600039E8 /end MEASUREMENT
/begin MEASUREMENT EpmCrS_ctRev "Revolution counter for CrS diagnosis" UWORD OneToOne 1 100 0.00 65535.00 FORMAT "%8.2" ECU_ADDRESS 0x600039F0 /end MEASUREMENT
/begin MEASUREMENT EpmCrS_ctRev20msLim_mp "counter of crankshaft revolutions in 20ms limited" SBYTE OneToOne 1 100 -128.0 127.0 FORMAT "%5.1" ECU_ADDRESS 0x70008A82 /end MEASUREMENT
/begin MEASUREMENT EpmCrS_ctRevWaitDiag "healing debounce counter wrong crankshaft signal" SWORD OneToOne 1 100 -32768.00 32767.00 FORMAT "%8.2" ECU_ADDRESS 0x600039EE /end MEASUREMENT
/begin MEASUREMENT EpmCrS_ctRevWaitDiagSyncIni "Handshaking information between HCrS and diagnosis - healing counter of DFC_EpmCrSErrSig" SWORD OneToOne 1 100 -32768.00 32767.00 FORMAT "%8.2" ECU_ADDRESS 0x600039EC /end MEASUREMENT
/begin MEASUREMENT EpmCrS_dnEngFltSyncIni "Engine speed gradient at SyncIni" SWORD EngNGrd 1 100 -16384.00 16383.50 FORMAT "%8.2" ECU_ADDRESS 0x600039EA /end MEASUREMENT
/begin MEASUREMENT EpmCrS_stDiag "state of crankshaft signal diagnosis" UBYTE EpmCrS_Diag_State 1 100 0.00 3.00000000000 FORMAT "%13.11" ECU_ADDRESS 0x6000A758 /end MEASUREMENT
/begin MEASUREMENT EpmCrS_stDiagErrSig "current state of error wrong crankshaft signal" UBYTE EpmCrS_DiagResult_State 1 100 0.00 4.00000000000 FORMAT "%13.11" ECU_ADDRESS 0x6000651E /end MEASUREMENT
/begin MEASUREMENT EpmCrS_stDiagNoSig "current state of error NoSig" UBYTE EpmCrS_DiagResult_State 1 100 0.00 4.00000000000 FORMAT "%13.11" ECU_ADDRESS 0x6000651D /end MEASUREMENT
/begin MEASUREMENT EpmCrS_stErrSigDiagStop "Stop the healing of DFC_EpmCrSErrSig" UBYTE OneToOne 1 100 0.00 255.0 FORMAT "%5.1" ECU_ADDRESS 0x6000651C /end MEASUREMENT
/begin MEASUREMENT EpmCrS_stNoSigDiagStop "Stop the healing of DFC_EpmCrSNoSig" UBYTE OneToOne 1 100 0.00 255.0 FORMAT "%5.1" ECU_ADDRESS 0x6000651B /end MEASUREMENT
/begin MEASUREMENT EpmCrS_stRstDiag "locale request for reinitialization of locale variables" UBYTE OneToOne 1 100 0.00 255.0 BIT_MASK 0x1 FORMAT "%5.1" ECU_ADDRESS 0x600006E2 /end MEASUREMENT
/begin MEASUREMENT EpmCrS_stSigDiagSrc "reason of cranksahft error" UWORD OneToOne 1 100 0.00 65535.00 FORMAT "%8.2" ECU_ADDRESS 0x6000D8C6 /end MEASUREMENT
/begin MEASUREMENT EpmCrS_swtRstErrSig "Switch for resetting DFC_EpmCrSErrSig" UBYTE OneToOne 1 100 0.00 255.0 FORMAT "%5.1" ECU_ADDRESS 0x60006520 /end MEASUREMENT
/begin MEASUREMENT EpmCrS_swtRstNoSig "Switch for resetting DFC_EpmCrSNoSig" UBYTE OneToOne 1 100 0.00 255.0 FORMAT "%5.1" ECU_ADDRESS 0x6000651F /end MEASUREMENT
/begin MEASUREMENT fho_msg "Altitude correction factor" UBYTE fak_ub_b4 1 100 0.00 3.984 FORMAT "%5.3" ECU_ADDRESS 0x6000E44B /end MEASUREMENT
/begin MEASUREMENT frhol_w_msg "Factor: air density f(intake air temp., altitude), 16-bit" UWORD fak_uw_b2 1 100 0.00 1.999969 FORMAT "%8.6" ECU_ADDRESS 0x6000E30A /end MEASUREMENT
/begin MEASUREMENT MoXTqPtd_tqInrDes "permitted torque without offset" SWORD md_q0p1 1 100 -3276.800 3276.700 FORMAT "%8.3" ECU_ADDRESS 0x60003A76 /end MEASUREMENT
/begin MEASUREMENT MoXTrqPtd_facTqErrSum "error sum of the weighted deviation from the permitted torque" UWORD rel_q0p00195_pc_s 1 100 0.00 127.9980 FORMAT "%8.4" ECU_ADDRESS 0x60003A74 /end MEASUREMENT
/begin MEASUREMENT MoXTrqPtd_flgEngLimActvd "activation condition for the consideration of the permitted torques in the torque coordination" UBYTE B_TRUE 1 100 0.00 1.00000000000 BIT_MASK 0x1 FORMAT "%13.11" ECU_ADDRESS 0x6000654E /end MEASUREMENT
/begin MEASUREMENT MoXTrqPtd_flgEngLimDeactv_MP "torque limitation with the permitted torques inactiv in the torque coordination" UBYTE B_TRUE 1 100 0.00 1.00000000000 BIT_MASK 0x1 FORMAT "%13.11" ECU_ADDRESS 0x70008D92 /end MEASUREMENT
/begin MEASUREMENT MoXTrqPtd_flgPtdFltEngLimLeadDeactv_MP "torque limitation with the permitted torque inactiv on the lead path" UBYTE B_TRUE 1 100 0.00 1.00000000000 BIT_MASK 0x1 FORMAT "%13.11" ECU_ADDRESS 0x70008D91 /end MEASUREMENT
/begin MEASUREMENT MoXTrqPtd_flgPtdFltEngLimSetDeactv_MP "torque limitation with the permitted torque inactiv on the set path" UBYTE B_TRUE 1 100 0.00 1.00000000000 BIT_MASK 0x1 FORMAT "%13.11" ECU_ADDRESS 0x70008D90 /end MEASUREMENT
/begin MEASUREMENT MoXTrqPtd_tqInrPtd "permitted torque without offset" SWORD md_q0p1 1 100 -3276.800 3276.700 FORMAT "%8.3" ECU_ADDRESS 0x60003A72 /end MEASUREMENT
/begin MEASUREMENT MoXTrqPtd_tqInrPtdFildLvl2 "filtered maximal permitted inner torque (corresponding level 2)" SWORD md_q0p1 1 100 -3276.800 3276.700 FORMAT "%8.3" ECU_ADDRESS 0x60003A70 /end MEASUREMENT
/begin MEASUREMENT MoXTrqPtd_tqInrPtdOfsLvl2 "inner permissible torque L2 with offset in extended monitoring" SWORD md_q0p1 1 100 -3276.800 3276.700 FORMAT "%8.3" ECU_ADDRESS 0x60003A6E /end MEASUREMENT
/begin MEASUREMENT MoXTrqPtd_tqOffsLvl2_MP "overall torque offset combustion and electrical engine appropiate L2" SWORD Trq 1 100 -3276.800 3276.700 FORMAT "%8.3" ECU_ADDRESS 0x70008D8E /end MEASUREMENT
/begin MEASUREMENT MoX_tqInrDesPtdOfs "inner permitted torque with offset for Set-path" SWORD md_q0p1 1 100 -3276.800 3276.700 FORMAT "%8.3" ECU_ADDRESS 0x60003A6C /end MEASUREMENT
/begin MEASUREMENT MoX_trqInrDesPtd "Inner permitted torque without LLR and Compensation" SWORD md_q0p1 1 100 -3276.800 3276.700 FORMAT "%8.3" ECU_ADDRESS 0x60003A6A /end MEASUREMENT
/begin MEASUREMENT MoX_trqInrLead "inner permissible torque lead path non filtered" SWORD md_q0p1 1 100 -3276.800 3276.700 FORMAT "%8.3" ECU_ADDRESS 0x60003A68 /end MEASUREMENT
/begin MEASUREMENT MoX_trqInrLeadPtd "inner permissible torque lead path without idle speed control torque and compensation non filtered" SWORD md_q0p1 1 100 -3276.800 3276.700 FORMAT "%8.3" ECU_ADDRESS 0x60003A66 /end MEASUREMENT
/begin MEASUREMENT MoX_trqInrLeadWoResv "inner permissible torque lead path without reserve non filtered" SWORD md_q0p1 1 100 -3276.800 3276.700 FORMAT "%8.3" ECU_ADDRESS 0x60003A64 /end MEASUREMENT
/begin MEASUREMENT MoX_trqInrLeadWoResvFlt "inner permissible torque lead path without reserve filtered+compensation" SWORD md_q0p1 1 100 -3276.800 3276.700 FORMAT "%8.3" ECU_ADDRESS 0x60003A62 /end MEASUREMENT
/begin MEASUREMENT MoX_trqInrPtdLead "inner permissible torque lead path filtered" SWORD md_q0p1 1 100 -3276.800 3276.700 FORMAT "%8.3" ECU_ADDRESS 0x60003A60 /end MEASUREMENT
/begin MEASUREMENT MoX_trqInrPtdLeadWoResv "inner permissible torque lead path without reserve filtered" SWORD md_q0p1 1 100 -3276.800 3276.700 FORMAT "%8.3" ECU_ADDRESS 0x60003A5E /end MEASUREMENT
/begin MEASUREMENT MoX_trqInrPtdSet "inner permissible torque set path filtered" SWORD md_q0p1 1 100 -3276.800 3276.700 FORMAT "%8.3" ECU_ADDRESS 0x60003A5C /end MEASUREMENT
/begin MEASUREMENT MoX_trqInrSet "inner permissible torque set path non filtered" SWORD md_q0p1 1 100 -3276.800 3276.700 FORMAT "%8.3" ECU_ADDRESS 0x60003A5A /end MEASUREMENT
/begin MEASUREMENT MoX_trqOfs "offset for maximum permissible torque" SWORD md_q0p1 1 100 -3276.800 3276.700 FORMAT "%8.3" ECU_ADDRESS 0x60003A58 /end MEASUREMENT
/begin MEASUREMENT MoX_trqSpdGovFlt "Idle control torque in extended monitoring" SWORD md_q0p1 1 100 -3276.800 3276.700 FORMAT "%8.3" ECU_ADDRESS 0x60004FD8 /end MEASUREMENT
/begin MEASUREMENT MoX_trqSpdGovLead "idle speed control lead torque" SWORD md_q0p1 1 100 -3276.800 3276.700 FORMAT "%8.3" ECU_ADDRESS 0x60004FD6 /end MEASUREMENT
/begin MEASUREMENT MoX_trqSpdGovPtd "idle speed control permitted torque in the extended monitoring" UBYTE md_q1p6 1 100 0.00 408.0 FORMAT "%5.1" ECU_ADDRESS 0x6000654D /end MEASUREMENT
/begin MEASUREMENT MoX_trqSpdGovSet "idle speed control set torque in the extended monitoring" SWORD md_q0p1 1 100 -3276.800 3276.700 FORMAT "%8.3" ECU_ADDRESS 0x60004FD4 /end MEASUREMENT
/begin MEASUREMENT MoX_trqVehDesPtd "permissible torque vehicle set path in the extended monitoring" SWORD md_q0p1 1 100 -3276.800 3276.700 FORMAT "%8.3" ECU_ADDRESS 0x60003A56 /end MEASUREMENT
/begin MEASUREMENT MoX_trqVehLeadPtd "permissible torque vehicle lead path in the extended monitoring" SWORD md_q0p1 1 100 -3276.800 3276.700 FORMAT "%8.3" ECU_ADDRESS 0x60003A54 /end MEASUREMENT
/begin MEASUREMENT PEnv_ctDrvEnter "drive state counter" UBYTE OneToOne 1 100 0.00 255.0 FORMAT "%5.1" ECU_ADDRESS 0x6000654C /end MEASUREMENT
/begin MEASUREMENT PEnv_ctPostDrvLeave "post drive state counter" UBYTE OneToOne 1 100 0.00 255.0 FORMAT "%5.1" ECU_ADDRESS 0x6000654B /end MEASUREMENT
/begin MEASUREMENT PEnv_dataDigSnsr "Digital raw data from ambient pressure sensor" ULONG OneToOne 1 100 0.00 4294967295.00 FORMAT "%13.2" ECU_ADDRESS 0x60001500 /end MEASUREMENT
/begin MEASUREMENT PEnv_DD_ctPostDrvLeave "Local drive cycle counter which is incremented when system state SyC_PostDrive is left" UWORD OneToOne 1 100 0.00 256.0000 FORMAT "%8.4" ECU_ADDRESS 0x60003A52 /end MEASUREMENT
/begin MEASUREMENT PEnv_dpAirFilThr "pressure loss at air filter depending on air mass flow" UWORD p_q0p078 1 100 0.00 5119.922 FORMAT "%8.3" ECU_ADDRESS 0x50005AF2 /end MEASUREMENT
/begin MEASUREMENT PEnv_facCorrAlti "Altitude correction factor" UWORD fak_uw_b4 1 100 0.00 3.999939 FORMAT "%8.6" ECU_ADDRESS 0x50005AF4 /end MEASUREMENT
/begin MEASUREMENT PEnv_flgBndMdlRngVld "Healing of continuity check with additional value" UBYTE B_TRUE 1 100 0.00 1.00000000000 BIT_MASK 0x1 FORMAT "%13.11" ECU_ADDRESS 0x700006AE /end MEASUREMENT
/begin MEASUREMENT PEnv_flgBndMdlVirtVld "Condition threshold modells for ambient pressure valid virtuelly" UBYTE B_TRUE 1 100 0.00 1.00000000000 BIT_MASK 0x1 FORMAT "%13.11" ECU_ADDRESS 0x700006AD /end MEASUREMENT
/begin MEASUREMENT PEnv_flgBndMdlVld "Condition threshold modells for ambient pressure valid" UBYTE B_TRUE 1 100 0.00 1.00000000000 BIT_MASK 0x1 FORMAT "%13.11" ECU_ADDRESS 0x700006AC /end MEASUREMENT
/begin MEASUREMENT PEnv_flgCcLdcCmpl "Cycle flag ambient pressure from current driving cycle adopted" UBYTE B_TRUE 1 100 0.00 1.00000000000 BIT_MASK 0x1 FORMAT "%13.11" ECU_ADDRESS 0x700006AB /end MEASUREMENT
/begin MEASUREMENT PEnv_flgCcLdcDiagCmpl "zyklus flag for diagnosis by comparing actual and last driving cycle ambient pressure" UBYTE B_TRUE 1 100 0.00 1.00000000000 BIT_MASK 0x1 FORMAT "%13.11" ECU_ADDRESS 0x70000273 /end MEASUREMENT
/begin MEASUREMENT PEnv_flgCcLdcInvld "Condition: Fault suspicion from continuity check between the drives" UBYTE B_TRUE 1 100 0.00 1.00000000000 BIT_MASK 0x1 FORMAT "%13.11" ECU_ADDRESS 0x70000272 /end MEASUREMENT
/begin MEASUREMENT PEnv_flgCcLdcVld "Condition: Healing from continuity check between the drives" UBYTE B_TRUE 1 100 0.00 1.00000000000 BIT_MASK 0x1 FORMAT "%13.11" ECU_ADDRESS 0x70000271 /end MEASUREMENT
/begin MEASUREMENT PEnv_flgCcMaxInvld "Condition discontinuity ambient air pressure downwards" UBYTE B_TRUE 1 100 0.00 1.00000000000 BIT_MASK 0x1 FORMAT "%13.11" ECU_ADDRESS 0x700006AA /end MEASUREMENT
/begin MEASUREMENT PEnv_flgCcMinInvld "Condition discontinuity ambient air pressure upwards" UBYTE B_TRUE 1 100 0.00 1.00000000000 BIT_MASK 0x1 FORMAT "%13.11" ECU_ADDRESS 0x700006A9 /end MEASUREMENT
/begin MEASUREMENT PEnv_flgCcVld "Condition: Healing from continuity check while driving" UBYTE B_TRUE 1 100 0.00 1.00000000000 BIT_MASK 0x1 FORMAT "%13.11" ECU_ADDRESS 0x700006A8 /end MEASUREMENT
/begin MEASUREMENT PEnv_flgDeadLockPrevn "Condition deadlock threshold modells for ambient pressure valid" UBYTE B_TRUE 1 100 0.00 1.00000000000 BIT_MASK 0x1 FORMAT "%13.11" ECU_ADDRESS 0x700006A7 /end MEASUREMENT
/begin MEASUREMENT PEnv_flgDsmClrTrig "Trigger flag to clear diagnosis relevant elements" UBYTE B_TRUE 1 100 0.00 1.00000000000 BIT_MASK 0x1 FORMAT "%13.11" ECU_ADDRESS 0x70000276 /end MEASUREMENT
/begin MEASUREMENT PEnv_flgErrSuspcCc "Condition: Error suspision from contionious check" UBYTE B_TRUE 1 100 0.00 1.00000000000 BIT_MASK 0x1 FORMAT "%13.11" ECU_ADDRESS 0x6003499A /end MEASUREMENT
/begin MEASUREMENT PEnv_flgGetData "Status bit valid data received form digital ambient pressure sensor" UBYTE B_TRUE 1 100 0.00 1.00000000000 BIT_MASK 0x1 FORMAT "%13.11" ECU_ADDRESS 0x70000275 /end MEASUREMENT
/begin MEASUREMENT PEnv_flgHealSuspcCc "Condition: Healing of error suspision from contionious check" UBYTE B_TRUE 1 100 0.00 1.00000000000 BIT_MASK 0x1 FORMAT "%13.11" ECU_ADDRESS 0x700006A6 /end MEASUREMENT
/begin MEASUREMENT PEnv_flgInctRatCmpl "condition numerator complete for rationality diagnostic of ambient pressure sensor" UBYTE B_TRUE 1 100 0.00 1.00000000000 BIT_MASK 0x1 FORMAT "%13.11" ECU_ADDRESS 0x70000270 /end MEASUREMENT
/begin MEASUREMENT PEnv_flgPBal "Condition: pressure balance for replacement value by referenece sensor" UBYTE B_TRUE 1 100 0.00 1.00000000000 BIT_MASK 0x1 FORMAT "%13.11" ECU_ADDRESS 0x6003498D /end MEASUREMENT
/begin MEASUREMENT PEnv_flgPLdcVld "ambient pressure from last driving cycle valid" UBYTE B_TRUE 1 100 0.00 1.00000000000 BIT_MASK 0x1 FORMAT "%13.11" ECU_ADDRESS 0x60034999 /end MEASUREMENT
/begin MEASUREMENT PEnv_flgPMdlVld "condition: modelled ambient pressure valid" UBYTE B_TRUE 1 100 0.00 1.00000000000 BIT_MASK 0x1 FORMAT "%13.11" ECU_ADDRESS 0x6003498C /end MEASUREMENT
/begin MEASUREMENT PEnv_flgPMeasdVld "condition: ambient pressure from sensor valid" UBYTE B_TRUE 1 100 0.00 1.00000000000 BIT_MASK 0x1 FORMAT "%13.11" ECU_ADDRESS 0x700006A5 /end MEASUREMENT
/begin MEASUREMENT PEnv_flgPPlaus "status indicates the signal is plausible" UBYTE B_TRUE 1 100 0.00 1.00000000000 BIT_MASK 0x1 FORMAT "%13.11" ECU_ADDRESS 0x700006A4 /end MEASUREMENT
/begin MEASUREMENT PEnv_flgPRawVld "Validity flag for the raw ambient pressure sensor" UBYTE B_TRUE 1 100 0.00 1.00000000000 BIT_MASK 0x1 FORMAT "%13.11" ECU_ADDRESS 0x6000A16E /end MEASUREMENT
/begin MEASUREMENT PEnv_flgPRawVldDiag "Condition ambient pressure sensor valid delayed" UBYTE B_TRUE 1 100 0.00 1.00000000000 BIT_MASK 0x1 FORMAT "%13.11" ECU_ADDRESS 0x7000026F /end MEASUREMENT
/begin MEASUREMENT PEnv_flgPVld "condition: ambient pressure valid" UBYTE B_TRUE 1 100 0.00 1.00000000000 BIT_MASK 0x1 FORMAT "%13.11" ECU_ADDRESS 0x700006A3 /end MEASUREMENT
/begin MEASUREMENT PEnv_flgRngChkMaxInvld "Error condition max from physical range check" UBYTE B_TRUE 1 100 0.00 1.00000000000 BIT_MASK 0x1 FORMAT "%13.11" ECU_ADDRESS 0x700006A2 /end MEASUREMENT
/begin MEASUREMENT PEnv_flgRngChkMaxVld "Healing condition max from physical range check" UBYTE B_TRUE 1 100 0.00 1.00000000000 BIT_MASK 0x1 FORMAT "%13.11" ECU_ADDRESS 0x700006A1 /end MEASUREMENT
/begin MEASUREMENT PEnv_flgRngChkMinInvld "Error condition min from physical range check" UBYTE B_TRUE 1 100 0.00 1.00000000000 BIT_MASK 0x1 FORMAT "%13.11" ECU_ADDRESS 0x700006A0 /end MEASUREMENT
/begin MEASUREMENT PEnv_flgRngChkMinVld "Healing condition min from physical range check" UBYTE B_TRUE 1 100 0.00 1.00000000000 BIT_MASK 0x1 FORMAT "%13.11" ECU_ADDRESS 0x7000069F /end MEASUREMENT
/begin MEASUREMENT PEnv_flgSnsrBootRdy "Status of Sensor readiness" UBYTE B_TRUE 1 100 0.00 1.00000000000 BIT_MASK 0x1 FORMAT "%13.11" ECU_ADDRESS 0x7000069E /end MEASUREMENT
/begin MEASUREMENT PEnv_flgSnsrPlausInvld "status plausible error information from digital ambient air pressure sensor" UBYTE B_TRUE 1 100 0.00 1.00000000000 BIT_MASK 0x1 FORMAT "%13.11" ECU_ADDRESS 0x7000069D /end MEASUREMENT
/begin MEASUREMENT PEnv_flgSnsrRst "Sensor reset has been triggered" UBYTE B_TRUE 1 100 0.00 1.00000000000 BIT_MASK 0x1 FORMAT "%13.11" ECU_ADDRESS 0x7000069C /end MEASUREMENT
/begin MEASUREMENT PEnv_flgUseIniAftStrtEnd "condition for valid ambient pressure model based on manifold pressure" UBYTE B_TRUE 1 100 0.00 1.00000000000 BIT_MASK 0x1 FORMAT "%13.11" ECU_ADDRESS 0x70000274 /end MEASUREMENT
/begin MEASUREMENT PEnv_p "Ambient pressure" UWORD p_q0p039 1 100 0.00 2559.961 FORMAT "%8.3" ECU_ADDRESS 0x50005AF8 /end MEASUREMENT
/begin MEASUREMENT PEnv_pBndMdlMax "maximum modelled ambient pressure" UWORD p_q0p039 1 100 0.00 2559.961 FORMAT "%8.3" ECU_ADDRESS 0x6000488C /end MEASUREMENT
/begin MEASUREMENT PEnv_pBndMdlMin "minimal modelled ambient pressure" UWORD p_q0p039 1 100 0.00 2559.961 FORMAT "%8.3" ECU_ADDRESS 0x6000488A /end MEASUREMENT
/begin MEASUREMENT PEnv_pCurrDrvCyc "electr. valid ambient pressure from actual driving cycle" UWORD p_q0p039 1 100 0.00 2559.961 FORMAT "%8.3" ECU_ADDRESS 0x60003A50 /end MEASUREMENT
/begin MEASUREMENT PEnv_pDly "delayed ambient pressure" UWORD p_q0p039 1 100 0.00 2559.961 FORMAT "%8.3" ECU_ADDRESS 0x60003A4E /end MEASUREMENT
/begin MEASUREMENT PEnv_pLdc "ambient pressure from last driving cycle" UWORD p_q0p039 1 100 0.00 2559.961 FORMAT "%8.3" ECU_ADDRESS 0x60037F10 /end MEASUREMENT
/begin MEASUREMENT PEnv_pMdl "Ambient pressure from model" UWORD p_q0p039 1 100 0.00 2559.961 FORMAT "%8.3" ECU_ADDRESS 0x60004888 /end MEASUREMENT
/begin MEASUREMENT PEnv_pMeas "Ambient pressure measured" UWORD p_q0p039 1 100 0.00 2559.961 FORMAT "%8.3" ECU_ADDRESS 0x60004886 /end MEASUREMENT
/begin MEASUREMENT PEnv_pRaw "ambient air pressure raw value measured" UWORD p_q0p039 1 100 0.00 2559.961 FORMAT "%8.3" ECU_ADDRESS 0x50005AFA /end MEASUREMENT
/begin MEASUREMENT PEnv_pRawFild "filtered ambient pressure" UWORD p_q0p039 1 100 0.00 2559.961 FORMAT "%8.3" ECU_ADDRESS 0x60003A4C /end MEASUREMENT
/begin MEASUREMENT PEnv_stErrMsgSens "bit coded error information from digital ambient air pressure sensor" ULONG OneToOne 1 100 0.00 4294967295.00 FORMAT "%13.2" ECU_ADDRESS 0x600014FC /end MEASUREMENT
/begin MEASUREMENT PEnv_stSigP "Signalstatus ambient pressure" UBYTE OneToOne 1 100 0.00 255.0 FORMAT "%5.1" ECU_ADDRESS 0x6000A012 /end MEASUREMENT
/begin MEASUREMENT pum_w_msg "Ambient pressure from model" UWORD p_q0p039 1 100 0.00 2559.961 FORMAT "%8.3" ECU_ADDRESS 0x60037F08 /end MEASUREMENT
/begin MEASUREMENT pur_w_msg "Ambient pressure from sensor" UWORD p_q0p039 1 100 0.00 2559.961 FORMAT "%8.3" ECU_ADDRESS 0x60004804 /end MEASUREMENT
/begin MEASUREMENT pu_msg "Ambient pressure" UBYTE p_ub_q5 1 100 0.00 1275. FORMAT "%5.0" ECU_ADDRESS 0x6000E45A /end MEASUREMENT
/begin MEASUREMENT StSys_stStrt "state of starting system" UBYTE OneToOne 1 100 0.00 255.0 FORMAT "%5.1" ECU_ADDRESS 0x600007AC /end MEASUREMENT
/begin MEASUREMENT tistrtdly_msg "remaining time for delay of starter control" UBYTE t10msxs_ub_q0p01 1 100 0.00 2.550 FORMAT "%5.3" ECU_ADDRESS 0x70002DB4 /end MEASUREMENT
/begin MEASUREMENT tnsezmot_w_msg "time of engine operation from first end of start (over ECU-cycle)" UWORD t_q0p1 1 100 0.00 6553.500 FORMAT "%8.3" ECU_ADDRESS 0x6000E338 /end MEASUREMENT
/begin MEASUREMENT tnsez_w_msg "time counter at first end of start in cycle (16 bit)" UWORD t_q0p1 1 100 0.00 6553.500 FORMAT "%8.3" ECU_ADDRESS 0x600047E6 /end MEASUREMENT
/begin MEASUREMENT tnse_w_msg "time counter at end of start (16 bit)" UWORD t_q0p1 1 100 0.00 6553.500 FORMAT "%8.3" ECU_ADDRESS 0x600047E8 /end MEASUREMENT
/begin MEASUREMENT tnst_w_msg "time after end of start" UWORD t_q0p01 1 100 0.00 655.3500 FORMAT "%8.4" ECU_ADDRESS 0x60004B9C /end MEASUREMENT
/begin MEASUREMENT tumgk_w_msg "Ambient air temperature, output in Grad C, calc. in Kelvin" UWORD temp_q0p0234_o273 1 100 -273.150 1262.827 FORMAT "%8.3" ECU_ADDRESS 0x600047DE /end MEASUREMENT
/begin MEASUREMENT tumg_msg "ambient air temperature" UBYTE temp_ub_q0p75_o48 1 100 -48.0 143.3 FORMAT "%5.1" ECU_ADDRESS 0x6000E45B /end MEASUREMENT
/begin MEASUREMENT tumm_msg "modeled ambient (air) temperature" UBYTE temp_ub_q0p75_o48 1 100 -48.0 143.3 FORMAT "%5.1" ECU_ADDRESS 0x60009FDD /end MEASUREMENT
/begin MEASUREMENT tum_msg "ambient (air) temperature" UBYTE temp_ub_q0p75_o48 1 100 -48.0 143.3 FORMAT "%5.1" ECU_ADDRESS 0x60009FDE /end MEASUREMENT
/begin FUNCTION EngStrt_StrtEnd "3.19.0    Condition Engine start"
 /begin DEF_CHARACTERISTIC EngStrt_cntrInjStrtEndSpdGovr_C EngStrt_dataStrtEnd_C EngStrt_idxClassSelnStrtEnd_T EngStrt_idxInstSelnNEngCrit_T EngStrt_idxInstSelnNEngDeb_T EngStrt_idxInstSelnNEngNrInj_T EngStrt_idxInstSelnNEng_T EngStrt_idxSelnOverrun_T EngStrt_nEngMaxCritStrtEnd_AX EngStrt_nStrtEndInit_C EngStrt_nStrt_C EngStrt_pStrtEnd_AX EngStrt_tiDlyStrtEndTqStruct_T EngStrt_tStrtEndSpdGovr_C EngStrt_tStrtEnd_AX NENG.nStrtEnd_GM NENGCRIT.nStrtEndCrit_GM NENGCRIT.nStrtEnd_GM NENGCRIT.tiStrtgStrtEndCrit_GM NENGDEB.dnEngStrtDeb_C NENGDEB.nStrtEnd_GM NENGDEB.nrInjStrtEnd_GT NENGDEB.tiDnEngStrtDeb_C NENGDEB.tiNEngStrtDebMax_C NENGNRINJ.nStrtEnd_GM NENGNRINJ.nrInjStrtEnd_GT NENGNRINJ_FOLW.nStrtEnd_GM NENGNRINJ_FOLW.nrInjStrtEnd_GT NENG_COM.nStrtEnd_GM NENG_FOLW.nStrtEnd_GM /end DEF_CHARACTERISTIC
 /begin IN_MEASUREMENT anztib_msg CoEng_stMai EngStrt_stRstrtRsn EngStrt_stStrtReq EngStrt_stStrtSit EngStrt_tCoor EngStrt_tStrtCoor Epm_dnEng Epm_nEng Epm_nEng10ms Epm_stSpd HLSDem_nSetPLo PEnv_p PthSet_stOvrRun Strt_stStaActv SyC_ctDrvEnter /end IN_MEASUREMENT
 /begin OUT_MEASUREMENT B_stendes_msg B_stendll_msg B_stendmd_msg B_stendzw_msg EngStrt_bFrstStrtEnd EngStrt_bStrt EngStrt_bStrtEnd EngStrt_cntrInjStrtEnd EngStrt_flgOverrun EngStrt_flgStrtEndIgn EngStrt_flgStrtEndInj EngStrt_flgStrtEndSpdGovr EngStrt_flgStrtEndTqStruct EngStrt_tiAftFirstStrtEnd EngStrt_tiAftStrtEnd EngStrt_tiAftStrtEndLowRes EngStrt_tiOperAftFirstStrtEnd tnsezmot_w_msg tnsez_w_msg tnse_w_msg tnst_w_msg /end OUT_MEASUREMENT
 /begin LOC_MEASUREMENT EngStrt_ctStrtEnd100msDrvEnter EngStrt_ctStrtEnd10msDrvEnter EngStrt_ctStrtEndSyncS1DrvEnter EngStrt_idxClassSeldStrtEnd EngStrt_nEngMaxCrit /end LOC_MEASUREMENT
 FUNCTION_VERSION "3.19.0" /end FUNCTION
/begin FUNCTION EngStrt_StrtSysRels "1.21.0    System Releases for Engine Start" /begin DEF_CHARACTERISTIC EngStrt_dataSysRels_C /end DEF_CHARACTERISTIC /begin IN_MEASUREMENT CEngDsT_t CEngDsT_tStop CEngDsT_tStrt OilSwmpT_t /end IN_MEASUREMENT
 /begin OUT_MEASUREMENT EngStrt_flgInjSysRels EngStrt_flgPfiStrtRels EngStrt_flgStrtrStrtRels EngStrt_tCoor EngStrt_tStopCoor EngStrt_tStrtCoor /end OUT_MEASUREMENT
 FUNCTION_VERSION "1.21.0" /end FUNCTION
/begin FUNCTION EngStrt_Vld2Lcy "8.12.0    interface adapter BC EngStrt to old software" /begin DEF_CHARACTERISTIC EngStrt_nMnNoStaCom /end DEF_CHARACTERISTIC
 /begin IN_MEASUREMENT CoEng_stMai CoVeh_stEngStopOrd CoVeh_stEngStrtOrd EngStrt_bStrtEnd EngStrt_flgInjProhb EngStrt_stRstrtRsn EngStrt_stRstrtStgy Epm_nEngTooth10ms Epm_stSpd SyC_ctDrvEnter /end IN_MEASUREMENT
 /begin OUT_MEASUREMENT B_engrest_msg B_nostacom_msg B_stainjen_msg B_stoevab_msg B_stopeng_msg B_stopping_msg B_stopz_msg B_stostcom_msg B_stprep_msg B_strtena_msg EngStrt_bChgOfMnd EngStrt_bRstrtWoStaAsst StSys_stStrt tistrtdly_msg /end OUT_MEASUREMENT
 /begin LOC_MEASUREMENT EngStrt_ctVld2Lcy10msDrvEnter /end LOC_MEASUREMENT
 FUNCTION_VERSION "8.12.0" /end FUNCTION
/begin FUNCTION EngStrt_WrmUpCoor "2.6.0     Combustion Engine Warm Up Coordinator"
 /begin DEF_CHARACTERISTIC EngStrt_facWrmUpMax_C EngStrt_stEomStgWrmUpAllwd_T EngStrt_stEomWrmUpAllwd_T EngStrt_stPrioWrmUpAllwd_C EngStrt_tiAfterStrtEndMin_C /end DEF_CHARACTERISTIC
 /begin IN_MEASUREMENT B_stopz_msg CoEng_stMai EngStrt_tiAftStrtEnd fnswl_w_msg fst_w_msg SyC_ctDrvEnter /end IN_MEASUREMENT
 /begin OUT_MEASUREMENT EngStrt_EomWrmUp1_I.stOperMod EngStrt_EomWrmUp1_I.stOperModPrio EngStrt_EomWrmUp1_I.stOperModStg EngStrt_EomWrmUp2_I.stOperMod EngStrt_EomWrmUp2_I.stOperModPrio EngStrt_EomWrmUp2_I.stOperModStg EngStrt_EomWrmUpAllwd_I.stOperMod EngStrt_EomWrmUpAllwd_I.stOperModPrio EngStrt_EomWrmUpAllwd_I.stOperModStg EngStrt_stEomWrmUpAllwd /end OUT_MEASUREMENT
 /begin LOC_MEASUREMENT EngStrt_ctWrmUpCoorDrvEntr EngStrt_stEomWrmUpAllwdLoc /end LOC_MEASUREMENT
 FUNCTION_VERSION "2.6.0" /end FUNCTION
/begin FUNCTION EngTrqPtd_Co "62.2.0    Extended Monitoring: Maximum permitted engine torque"
 /begin DEF_CHARACTERISTIC EngTrqPtd_facSpdGovMax_CUR EngTrqPtd_nSpdGovPtd_C EngTrqPtd_trqResvMax_CUR EngTrqPtd_trqSpdGOfsPtd_CUR MoXTrqPtd_facTqErrMax_C MoXTrqPtd_facTqErrMin_C MoXTrqPtd_facTqErrSumActvn_C MoXTrqPtd_facTqErrSumDeactvn_C MoXTrqPtd_flgEngLimActvdMnl_C MoXTrqPtd_tiDelRatTqPtdLvl2_C MoXTrqPtd_tiEngLimDeactv_C MoXTrqPtd_tiExtIntDeactv_C MoXTrqPtd_tiFltRatTqPtdLvl2_C MoXTrqPtd_tqInrPtdSetDeactvn_C MoXTrqPtd_tqOffsLvl2_M MoXTrqPtd_tqPtdFltTqLimLeadOffs_C MoXTrqPtd_tqPtdFltTqLimSetOffs_C MoX_ctTrqCmpEngLimActvn_C MoX_rTrqPtdFltWgh_CUR MoX_tiEvacIntMan_C MoX_tiFltDash_C MoX_trqInrMaxStrt_C MoX_trqNorm_C MoX_trqOfs_MAP /end DEF_CHARACTERISTIC
 /begin REF_CHARACTERISTIC Mo_trqIdcMax_C /end REF_CHARACTERISTIC
 /begin IN_MEASUREMENT EngDem_trqInrLimCtOff Epm_nEng Epm_nEngLRes LIGov_nDiff MoExe_ctCyc MoFESpd_nEng MoFETC_stTstMsg MoFExtInt_stTSCPtdMsg MoFTrqLim_tqInrMinWoCtOffMsg MoFTrqLos_tqLosTotMsg MoFTrqPtd_tqCompMsg MoFTrqPtd_tqInrPtdMsg MoF_ctTrqCmp MoF_rTrqInrAct MoF_trqLosMsg MoX_bSyncLos_msg PhyMod_etaIgnBsAvrg PhyMod_etaIgnMin PthLead_trqInrNoMon PthLead_trqResv PthSet_trqInrIABef PthSet_trqInrLim RngMod_trqInrBs RngMod_trqLos SpdGov_trqFlt SpdGov_trqLead SpdGov_trqSet SyC_stSub ThrVlv_flgLimpModeB1 ThrVlv_flgReqFuCutOffB1 Tra_trqLeadMin /end IN_MEASUREMENT
 /begin OUT_MEASUREMENT EngTrqPtd_trqLead EngTrqPtd_trqLeadWoResv EngTrqPtd_trqSet EngTrqPtd_trqSetWoTraIntv MoX_trqSpdGovFlt MoX_trqSpdGovLead MoX_trqSpdGovSet /end OUT_MEASUREMENT
 /begin LOC_MEASUREMENT MoXTqPtd_tqInrDes MoXTrqPtd_facTqErrSum MoXTrqPtd_flgEngLimActvd MoXTrqPtd_flgEngLimDeactv_MP MoXTrqPtd_flgPtdFltEngLimLeadDeactv_MP MoXTrqPtd_flgPtdFltEngLimSetDeactv_MP MoXTrqPtd_tqInrPtd MoXTrqPtd_tqInrPtdFildLvl2 MoXTrqPtd_tqInrPtdOfsLvl2 MoXTrqPtd_tqOffsLvl2_MP MoX_tqInrDesPtdOfs MoX_trqInrDesPtd MoX_trqInrLead MoX_trqInrLeadPtd MoX_trqInrLeadWoResv MoX_trqInrLeadWoResvFlt MoX_trqInrPtdLead MoX_trqInrPtdLeadWoResv MoX_trqInrPtdSet MoX_trqInrSet MoX_trqOfs MoX_trqSpdGovPtd MoX_trqVehDesPtd MoX_trqVehLeadPtd /end LOC_MEASUREMENT
 FUNCTION_VERSION "62.2.0" /end FUNCTION
/begin FUNCTION EnvP_DD "24.12.0   Environment pressure sensor (device driver)"
 /begin DEF_CHARACTERISTIC PEnv_facCnvnSlopDig_C PEnv_flgDiSnsrPlaus_C PEnv_flgErrStEna_C PEnv_pCnvnOffs_C PEnv_stSensErrVal_C PEnv_tiDebSnsrPlaus_C PEnv_tiDrvDly_C PEnv_tiSnsrBootDly_C /end DEF_CHARACTERISTIC
 /begin IN_MEASUREMENT DSM_TripChgFinshd SyC_ctPostDrvLeave SyC_stSub /end IN_MEASUREMENT
 /begin OUT_MEASUREMENT B_purg_msg PEnv_flgPRawVld PEnv_flgSnsrBootRdy PEnv_flgSnsrPlausInvld PEnv_flgSnsrRst PEnv_pRaw pur_w_msg /end OUT_MEASUREMENT
 /begin LOC_MEASUREMENT PEnv_dataDigSnsr PEnv_DD_ctPostDrvLeave PEnv_flgDsmClrTrig PEnv_flgGetData PEnv_stErrMsgSens /end LOC_MEASUREMENT
 FUNCTION_VERSION "24.12.0" /end FUNCTION
/begin FUNCTION EnvP_VD "26.15.0   Environment pressure sensor (virtual device)"
 /begin DEF_CHARACTERISTIC PEnv_pAirFil_T PEnv_pDft_C PEnv_pDifEnvIntkVUsIniMax_C PEnv_pDifEnvIntkVUsIniMin_C PEnv_pDifEnvIntkVUsMax_C PEnv_pDifEnvIntkVUsMin_C PEnv_pMdlMaxThd_C PEnv_ratUnthrMdlTolr_C PEnv_swtCodVd_C PEnv_tiDlyEnagMdl_C PEnv_tiDlyHealIntkVUs_C PEnv_tiDlyTilPBal PEnv_tiPLT_C PEnv_tiStrtReplVld_C /end DEF_CHARACTERISTIC
 /begin REF_CHARACTERISTIC PEnv_pPlausThdMax_C PEnv_pPlausThdMin_C /end REF_CHARACTERISTIC
 /begin IN_MEASUREMENT B_psini_msg B_psrgg_msg B_psrrg_msg Eep_EnvRamHist Eep_EnvRamInvld Epm_nEng fiuewdk_w_msg ftu_msg msdk_w_msg ofpu_w_msg PEnv_flgCcLdcCmpl PEnv_flgErrSuspcCc PEnv_flgPPlaus PEnv_pRaw PIntkVUs_pRaw PIntkVUs_pRawIni SyC_ctDrvEnter SyC_ctPostDrvLeave SyC_stSub ThrVlv_ratActPosnB1 tnsez_w_msg wdkugd_w_msg /end IN_MEASUREMENT
 /begin OUT_MEASUREMENT B_pug_msg fho_msg frhol_w_msg PEnv_dpAirFilThr PEnv_facCorrAlti PEnv_flgBndMdlVirtVld PEnv_flgBndMdlVld PEnv_flgDeadLockPrevn PEnv_flgPLdcVld PEnv_flgPMeasdVld PEnv_flgPVld PEnv_p PEnv_pBndMdlMax PEnv_pBndMdlMin PEnv_pLdc PEnv_pMdl PEnv_pMeas PEnv_stSigP pum_w_msg pu_msg /end OUT_MEASUREMENT
 /begin LOC_MEASUREMENT PEnv_ctDrvEnter PEnv_ctPostDrvLeave PEnv_flgPBal PEnv_flgPMdlVld PEnv_flgUseIniAftStrtEnd /end LOC_MEASUREMENT
 FUNCTION_VERSION "26.15.0" /end FUNCTION
/begin FUNCTION EnvP_VDDiag "2.11.0    Plausibility diagnosis of environmental pressure sensor"
 /begin DEF_CHARACTERISTIC PEnv_pDifJmpMax_C PEnv_pDifLdcMax_C PEnv_pMaxSnsrTolr_C PEnv_pPlausThdMax_C PEnv_pPlausThdMin_C PEnv_swtCodDiag_C PEnv_tiCcLT_C PEnv_tiDlyRawVld_C SF_PU /end DEF_CHARACTERISTIC
 /begin REF_CHARACTERISTIC PEnv_tiStrtReplVld_C /end REF_CHARACTERISTIC
 /begin IN_MEASUREMENT DSM_TripChgFinshd PEnv_flgBndMdlVirtVld PEnv_flgBndMdlVld PEnv_flgDeadLockPrevn PEnv_flgPLdcVld PEnv_flgPRawVld PEnv_flgSnsrPlausInvld PEnv_flgSnsrRst PEnv_pBndMdlMax PEnv_pBndMdlMin PEnv_pLdc PEnv_pRaw SyC_stSub tnsez_w_msg /end IN_MEASUREMENT
 /begin OUT_MEASUREMENT B_pugg_msg PEnv_flgBndMdlRngVld PEnv_flgCcLdcCmpl PEnv_flgCcMaxInvld PEnv_flgCcMinInvld PEnv_flgCcVld PEnv_flgErrSuspcCc PEnv_flgHealSuspcCc PEnv_flgPPlaus PEnv_flgRngChkMaxInvld PEnv_flgRngChkMaxVld PEnv_flgRngChkMinInvld PEnv_flgRngChkMinVld /end OUT_MEASUREMENT
 /begin LOC_MEASUREMENT PEnv_flgCcLdcDiagCmpl PEnv_flgCcLdcInvld PEnv_flgCcLdcVld PEnv_flgInctRatCmpl PEnv_flgPRawVldDiag PEnv_pCurrDrvCyc PEnv_pDly PEnv_pRawFild /end LOC_MEASUREMENT
 FUNCTION_VERSION "2.11.0" /end FUNCTION
/begin FUNCTION EnvT_IfAdpr "1.12.0    Interface adapter of package Environment Temperature" /begin DEF_CHARACTERISTIC EnvT_IfAdprConf_CW TDGTUMTRIG TUMTAI /end DEF_CHARACTERISTIC /begin IN_MEASUREMENT EnvT_bActvSens EnvT_stTReplMod EnvT_t EnvT_tReplMod /end IN_MEASUREMENT
 /begin OUT_MEASUREMENT B_gtumg_msg B_trigcomp_msg B_tumgg_msg B_tummg_msg B_tumnpl_msg tumgk_w_msg tumg_msg tumm_msg tum_msg /end OUT_MEASUREMENT
 /begin LOC_MEASUREMENT B_tumgg_envtifloc /end LOC_MEASUREMENT
 FUNCTION_VERSION "1.12.0" /end FUNCTION
/begin FUNCTION EnvT_VD "7.12.0    Environment Temperature Virtual Device"
 /begin DEF_CHARACTERISTIC EnvT_stDfl_C EnvT_swtCfg_CW EnvT_swtStSensMod_CW EnvT_tCACDsCmuMax_C EnvT_tCACDsCmuMin_C EnvT_tiDelSensMeas_C EnvT_tIntkCac_C EnvT_tSigValMax_C EnvT_tVDDfl_C /end DEF_CHARACTERISTIC
 /begin IN_MEASUREMENT Eep_EnvRamHist Eep_EnvRamInvld EnvT_stTReplMod EnvT_tReplMod /end IN_MEASUREMENT
 /begin OUT_MEASUREMENT EnvT_bActvCSC EnvT_bActvDfl EnvT_bActvMBC EnvT_bActvPRC EnvT_bActvSens EnvT_bActvSensADC EnvT_bActvSensCAN EnvT_bActvSensMod EnvT_stSigT EnvT_t EnvT_tSensLstVal EnvT_tSigVal EnvT_t_Sq /end OUT_MEASUREMENT
 /begin LOC_MEASUREMENT EnvT_bTSensFrz EnvT_bTSensFrznVal EnvT_bTSensIntrLstVal EnvT_bTTiCmu EnvT_stTReplModIntr EnvT_stTSensIntr EnvT_stTSensModIntr EnvT_swtTSrcSel EnvT_tCACRepl EnvT_tReplModIntr EnvT_tSensFrz EnvT_tSensIntr EnvT_tSensIntrLstVal EnvT_tSensModIntr /end LOC_MEASUREMENT
 FUNCTION_VERSION "7.12.0" /end FUNCTION
/begin FUNCTION EnvT_VdMdl2 "1.2.0     Virtual Device Ambient Temperature Model Calculation for Oil deterioration system"
 /begin DEF_CHARACTERISTIC EnvT_tCEngDsTMax_C EnvT_tIntkAirCorrnMdl_C EnvT_tIntkSnsr_C EnvT_vVehMinMdl_C /end DEF_CHARACTERISTIC
 /begin IN_MEASUREMENT CEngDsT_t IntkAirT_tIntkMnfld IntkAirT_tThrVlvUs OilSwmpT_flgFinshd OilSwmpT_flgInit VehV_v /end IN_MEASUREMENT
 /begin OUT_MEASUREMENT EnvT_tMdl2 /end OUT_MEASUREMENT
 /begin LOC_MEASUREMENT EnvT_stEepReadMdl /end LOC_MEASUREMENT
 FUNCTION_VERSION "1.2.0" /end FUNCTION
/begin FUNCTION EnvT_VDMod "1.13.0    VirtualDevice Ambient Temperature Model Calculation"
 /begin DEF_CHARACTERISTIC EnvT_dmAFSMax_CUR EnvT_dmAFSMinMod_CUR EnvT_drLPPrimModMax_C EnvT_drLPPrimModMin_C EnvT_dtCEngDsIntkAirMax_C EnvT_dtCEngDsPrimModBas_C EnvT_mAirAcmMinThdOffs_C EnvT_mAirAcmThdMdlRels_T EnvT_mAirModMinHot_C EnvT_mAirModMin_C EnvT_maskCEngDsTSq_C EnvT_maskIntkMnfldSq_C EnvT_stModDfl_C EnvT_tCEngDsHotDet_C EnvT_tCEngDsMaxIniPrimMod_C EnvT_tCEngDsMaxPrimMod_C EnvT_tCEngDsMinPrimMod_C EnvT_tCEngDsPrimModCS_C EnvT_tCEngDsWarmPrimMod_C EnvT_tDifTCEngDsStrtVal_C EnvT_tiEngOffPrimModCS_C EnvT_tiModHeatingIndcr_C EnvT_tiModStyCnd_C EnvT_tiModWrmCntrMin_C EnvT_tIntkAirMaxPrimMod_C EnvT_tIntkAirMinPrimMod_C EnvT_tIntkDfl_C EnvT_tiPrimModEngRotDeb_C EnvT_tiPrimModEngRotFall_C EnvT_tiPrimModIdleHotDet_C EnvT_tModHeatingIndcr_MAP EnvT_tPrimModBasHotDetHi_C EnvT_tPrimModBasHotDetLo_C EnvT_tPrimModDfl_C EnvT_tValMax_C EnvT_VDMod2_CW EnvT_VDMod3_CW EnvT_VDModSnsrSel_CW EnvT_VDMod_CW EnvT_vVehMinMod_C /end DEF_CHARACTERISTIC
 /begin IN_MEASUREMENT AirMod_mfAirCyl CEngDsT_flgSnsrVldStrt CEngDsT_t CEngDsT_tStrt CEngDsT_t_Sq CoVMD_flgIdleDrv drlp_w_msg Eep_EnvRamHist Eep_EnvRamInvld Epm_nEng IntkAirT_tIntkMnfld IntkAirT_tIntkMnfld_Sq PthSet_bOvrRun TiEngOff_bEngRot TiEngOff_stTi TiEngOff_ti VehV_v /end IN_MEASUREMENT
 /begin OUT_MEASUREMENT EnvT_bModCS EnvT_stTPlausMod EnvT_stTReplMod EnvT_tPlausMod EnvT_tReplMod /end OUT_MEASUREMENT
 /begin LOC_MEASUREMENT EnvT_bModHotDet EnvT_bModPrms EnvT_bModRels EnvT_bModSty EnvT_bModStyCnd EnvT_bModWrm EnvT_bPrimModBas EnvT_bPrimModBasMin EnvT_mAirAcmThdCrvVal EnvT_mAirAcmThdMdlRels EnvT_mAirAcmThdOldVal EnvT_mAirAcmThdVal EnvT_mAirMod EnvT_mAirModInt EnvT_mfAirCylStyMod EnvT_nEngStyMod EnvT_stTPlausModLoc EnvT_stTPrimMod EnvT_stTReplModLoc EnvT_tDifTIntkTEnvMdl EnvT_tiModWrmCntr EnvT_tModCS EnvT_tModHeatgIndcr EnvT_tModHeatgIndcrFlt EnvT_tModHeatingIndcr EnvT_tPlausModLoc EnvT_tPrimMod EnvT_tPrimModBas EnvT_tPrimModBasMin EnvT_tReplModLoc EnvT_tStyMod EnvT_vVehStyMod /end LOC_MEASUREMENT
 FUNCTION_VERSION "1.13.0" /end FUNCTION
/begin FUNCTION EpmBCr_IntrCo "101.9.7   Backup crankshaft interrupt coordination" /begin DEF_CHARACTERISTIC EpmBCr_swtEnable_C EpmBCr_tEna_C /end DEF_CHARACTERISTIC /begin REF_CHARACTERISTIC EpmCrS_dnEngMax_C EpmCrS_nDiagOff_C /end REF_CHARACTERISTIC
 /begin IN_MEASUREMENT DSM_TripChgFinshd EpmCaS_nEng EpmCaS_stNEng EpmCrS_stDiagErrSig EpmCrS_stDiagNoSig EpmCrS_stErrSigDiagStop EpmCrS_stNoSigDiagStop EpmIf_tCoolant Epm_dnEngFlt Epm_nEng Epm_stOpMode SyC_stSub T15_st /end IN_MEASUREMENT
 /begin OUT_MEASUREMENT EpmBCr_flgStrtDirectAllwd /end OUT_MEASUREMENT
 /begin LOC_MEASUREMENT EpmBCr_stDSMRdy /end LOC_MEASUREMENT
 FUNCTION_VERSION "101.9.7" /end FUNCTION
/begin FUNCTION EpmBCr_Plaus "101.6.4   Backup Crankshaft: Plausibilisation of camshaft signal pattern"
 /begin DEF_CHARACTERISTIC EpmBCr_nEngPttFailTol_C EpmBCr_nrPttMtchFailMaxEve_C EpmBCr_rSegLimLowr_C EpmBCr_rSegLimUppr_C EpmBCr_swtUpdEdge_C /end DEF_CHARACTERISTIC
 /begin IN_MEASUREMENT EpmBCr_phiZero2Sync EpmCaS_numPriCamShft EpmCaS_numSegSerLst EpmCaS_phiRefPos EpmCaS_stAdap Epm_nEng /end IN_MEASUREMENT
 /begin OUT_MEASUREMENT EpmBCr_phiSeg2Seg EpmBCr_tiSeg /end OUT_MEASUREMENT
 /begin LOC_MEASUREMENT EpmBCr_ctCaSRev EpmBCr_ctEdge EpmBCr_ctPttMtchFail EpmBCr_ctPttMtchFailEdge EpmBCr_idxPttSync EpmBCr_lvlCaSCurr_mp EpmBCr_nrEdg2NxtSync_mp EpmBCr_nrPttMtchAtIndx_mp EpmBCr_numCtgryPttCur_mp EpmBCr_numCtgryPtt_mp EpmBCr_numEdg2NxtEquiEdge_mp EpmBcr_numEdgEqui EpmBcr_numPttPlaus EpmBcr_numSeg2Sync EpmBCr_numSegPtt EpmBcr_numSyncMark EpmBCr_phiCaSPos EpmBCr_phiPtt_mp EpmBCr_rSeg2SegCurr_mp EpmBCr_rSeg2Seg_mpA EpmBCr_stDetailed_mp EpmBCr_stIniPttFail EpmBCr_stPlaus EpmBCr_stPttCurrIsSync_mp EpmBCr_stPttSync_mp EpmBCr_swtUpdEdge_mp EpmBCr_tiCaSEdg_mp EpmBCr_tiCaSSegDur_mp /end LOC_MEASUREMENT
 FUNCTION_VERSION "101.6.4" /end FUNCTION
/begin FUNCTION EpmBCr_Pos "101.9.4   Backup Crankshaft: Engine Position" /begin DEF_CHARACTERISTIC EpmBCr_facEngSpdRange_CUR /end DEF_CHARACTERISTIC
 /begin IN_MEASUREMENT EpmBCr_phiSeg2Seg EpmBCr_tiSeg EpmCaS_numPriCamShft EpmCaS_numSegSerLst EpmCaS_phiRefPos EpmCaS_stAdap EpmSeq_eveId EpmSeq_phiEve EpmSyn_phiOffs Epm_stOpMode /end IN_MEASUREMENT
 /begin OUT_MEASUREMENT EpmBCr_ctEdgeRefTabIdx EpmBCr_nEng EpmBCr_phiNxtCaSEdge EpmBCr_phiPos EpmBCr_phiZero2Sync EpmBCr_stPos EpmBCr_tiIncPer /end OUT_MEASUREMENT
 /begin LOC_MEASUREMENT EpmBCr_agCasEdge EpmBCr_agCurr EpmBCr_eveIdPriCamShft EpmBCr_facPlaus EpmBCr_phiCurrCaSEdge EpmBCr_phiLastCaSEdge EpmBCr_phiWaitNoSig EpmBCr_stOpModeOld /end LOC_MEASUREMENT
 FUNCTION_VERSION "101.9.4" /end FUNCTION
/begin FUNCTION EpmCaS_Adap "101.24.0  adaption of the camchaft-edges"
 /begin DEF_CHARACTERISTIC EpmCaS_facAdapFil_C EpmCaS_nEngAdpnRlsMax_C EpmCaS_nEngAdpnRlsMin_C EpmCaS_nrMaxTryAdpn_C EpmCaS_phiDiffAdapMax_C EpmCaS_phiDiffLim_C EpmCaS_ratLoadAdpnRlsMax_C EpmCaS_ratLoadAdpnRlsMin_C EpmCaS_swtAdapStgy_C EpmCaS_swtAdpnRlsTSel_C EpmCaS_tEngAdpnRlsMax_C EpmCaS_tEngAdpnRlsMin_C EpmCaS_tiDlyAdpnRls_C /end DEF_CHARACTERISTIC
 /begin IN_MEASUREMENT ActMod_trqInr CoEng_stMai DSM_TripChgFinshd Eep_EnvRamInvld EpmCaS_numSegSerLst EpmCaS_phiRefPos EpmCaS_phiTempCorEng EpmCaS_stDiag EpmCaS_stSnsrDeActvn EpmIf_tCoolant EpmIf_tOil EpmRRS_bEngSwOff EpmSyn_ctEdgeWcyOfs Epm_nEng Epm_stOpMode RngMod_trqInrMax SyC_ctPostDrvLeave SyC_stSub /end IN_MEASUREMENT
 /begin OUT_MEASUREMENT EpmCaS_agCorrnStat EpmCaS_phiAdapRefPos EpmCaS_phiAdapRefPosI1 EpmCaS_phiDiffCal2AdapEqAvg EpmCaS_ratLoadAdpnRls EpmCaS_stAdap EpmCaS_stAdapErr EpmCaS_stCoEngAdpnRls /end OUT_MEASUREMENT
 /begin LOC_MEASUREMENT EpmCaS_bfixVariAdapPerm EpmCaS_cntrAdapPostDrvLveOld EpmCaS_ctTriesAdap EpmCaS_flgCaSAdapflgClr EpmCaS_flgResetAfterErr EpmCaS_phiDiffCal2Adap EpmCaS_stDSMRdyAdap EpmCaS_stRstAdap EpmCaS_stStrtAdapCondn EpmCaS_tAdpnRls /end LOC_MEASUREMENT
 FUNCTION_VERSION "101.24.0" /end FUNCTION
/begin FUNCTION EpmCaS_Diag "101.10.0  Diagnosis Camshaft Signal"
 /begin DEF_CHARACTERISTIC EpmCaS_flgSwtSnglEdgeTol_C EpmCaS_numErrSigDef_C EpmCaS_numErrSigOk_C EpmCaS_numNoSigDef_C EpmCaS_stDiagMode_C /end DEF_CHARACTERISTIC
 /begin IN_MEASUREMENT DSM_TripChgFinshd EpmCaS_numSegSerLst EpmCaS_stSnsrDeActvn EpmCrS_stSigMode EpmRRS_bEngSwOff EpmSyn_stCaSPos Epm_stOpMode SyC_ctPostDrvLeave SyC_stSub /end IN_MEASUREMENT
 /begin OUT_MEASUREMENT EpmCaS_ctErrSig EpmCaS_ctNoSig EpmCaS_stDiag EpmCaS_stDiagErr /end OUT_MEASUREMENT
 /begin LOC_MEASUREMENT EpmCaS_bActivatePatmat EpmCaS_bCaSDiagflgClr EpmCaS_cntrDiagPostDrvLeave EpmCaS_cntrEdgeLstCyc EpmCaS_ctEdgeLst EpmCaS_ctRevNoSig EpmCaS_ctRevSig EpmCaS_ctSigOk EpmCaS_flgSwtSnglEdgeTolInt EpmCaS_numCurrEdge EpmCaS_numErrSigDefInt EpmCaS_numErrSigOkInt EpmCaS_numNoSigDefInt EpmCaS_stDiagErrChgd EpmCaS_stDiagModeInt EpmCaS_stDiagStopCdn EpmCaS_stDSMRdyDiag EpmCaS_stRstDiag EpmCaS_stSegFault /end LOC_MEASUREMENT
 FUNCTION_VERSION "101.10.0" /end FUNCTION
/begin FUNCTION EpmCaS_Meas "101.5.4   Epm Camshaft Measurement" /begin DEF_CHARACTERISTIC EpmCaS_swtMeasCaS_C /end DEF_CHARACTERISTIC /begin IN_MEASUREMENT EpmCaS_numSegSerLst EpmCrS_stSigMode Epm_stOpMode /end IN_MEASUREMENT
 /begin LOC_MEASUREMENT EpmCaS_ctMeasEdgeLstI1 EpmCaS_numRawValueI1 EpmCaS_phiRawValueI1_mp EpmCaS_stMeasCllsn EpmCaS_stMeasUnLckd /end LOC_MEASUREMENT
 FUNCTION_VERSION "101.5.4" /end FUNCTION
/begin FUNCTION EpmCaS_OfsDiag "101.12.0  offset diagnosis"
 /begin DEF_CHARACTERISTIC EpmCaS_numOfsErr_C EpmCaS_phiOfsMax_C EpmCaS_phiOfsMin_C EpmCas_stDirOfsAvrgUnflt_C EpmCaS_stOfsDiagMode_C EpmCaS_swtOfsDiagTSel_C EpmCaS_tiOfsPT1_C /end DEF_CHARACTERISTIC
 /begin REF_CHARACTERISTIC EpmCaS_nEngAdpnRlsMax_C EpmCaS_nEngAdpnRlsMin_C EpmCaS_phiSegOfs_CA EpmCaS_ratLoadAdpnRlsMax_C EpmCaS_ratLoadAdpnRlsMin_C EpmCaS_tEngAdpnRlsMax_C EpmCaS_tEngAdpnRlsMin_C EpmSyn_dCaSSegMsk_C /end REF_CHARACTERISTIC
 /begin IN_MEASUREMENT DSM_TripChgFinshd EpmCaS_ctErrSig EpmCaS_ctNoSig EpmCaS_numSegSerLst EpmCaS_phiTempCorEng EpmCaS_ratLoadAdpnRls EpmCaS_stCoEngAdpnRls EpmCaS_stSnsrDeActvn EpmIf_tCoolant EpmIf_tOil EpmRRS_bEngSwOff Epm_nEng Epm_stOpMode Epm_stSupressIni SyC_ctPostDrvLeave SyC_stSub /end IN_MEASUREMENT
 /begin OUT_MEASUREMENT EpmCaS_cntrOfsEdgeLst EpmCaS_phiCaSOfsAvg EpmCaS_phiOfsAvrgUnflt EpmCaS_phiOfsCorr EpmCaS_stOfs EpmCaS_stOfsAvrgUnflt EpmCaS_stOfsErr /end OUT_MEASUREMENT
 /begin LOC_MEASUREMENT EpmCaS_bOfsErrflgClr EpmCaS_ctOfsCrSRev EpmCaS_ctOfsErr EpmCaS_numEquidEdg EpmCaS_numLosEquidEdg_mp EpmCaS_numMplPatEquidEdg_mp EpmCaS_numVldEquidEdg_mp EpmCaS_OfsAvrgBuf EpmCaS_phiDstEquidEdg EpmCaS_phiLosEquidEdg_mp EpmCaS_phiOfsTolc EpmCaS_phiRefPosEquiEdg EpmCaS_phiSegLenTolc EpmCaS_stDSMRdyOfsDiag EpmCaS_stOffsCalcn EpmCaS_stRefLevBefEquidEdg EpmCaS_stRstOfsDiag /end LOC_MEASUREMENT
 FUNCTION_VERSION "101.12.0" /end FUNCTION
/begin FUNCTION EpmCaS_Seg "101.14.0  Calculation of CaS segment time and angle diffrence to reference position"
 /begin DEF_CHARACTERISTIC EpmCaS_dSegSeries_CA EpmCaS_facPlausHigh_GCUR EpmCaS_facPlausLow_GCUR EpmCaS_facPlaus_DST EpmCaS_nMaxCaSSigInvld_C EpmCaS_nMaxCaSSigVld_C EpmCaS_nMinCaSSigInvld_C EpmCaS_nMinCaSSigVld_C EpmCaS_numEdgeFltAvrg_CA EpmCaS_numPriCamSel_C EpmCaS_numSegSerLst_C EpmCaS_phiEdgeDvtMax_CA EpmCaS_phiLoLimIn_C EpmCaS_phiNCorI1_CUR EpmCaS_phiSegLenTol_CA EpmCaS_phiSegLen_CA EpmCaS_phiSegOfs_CA EpmCaS_phiTempCor05_DST EpmCaS_phiTempCorEngI1_CUR EpmCaS_phiTempCorI1_GCUR EpmCaS_phiUpLimIn_C EpmCaS_stActEdge_C EpmCaS_stMinSyncCaSAg_C EpmCaS_swtSegTSel_C EpmCaS_swtSeg_C EpmCaS_tiGlitchFilter_C EpmCaS_tiTimeout_C EpmCaS_tRefCal_C /end DEF_CHARACTERISTIC
 /begin IN_MEASUREMENT DSM_TripChgFinshd EpmCaS_stAdap EpmCrS_stSigMode EpmIf_tCoolant EpmIf_tOil EpmSyn_stCaSPos Epm_nEng Epm_stSupressIni Epm_stSync SyC_ctPostDrvLeave SyC_stSub /end IN_MEASUREMENT
 /begin OUT_MEASUREMENT EpmCaS_allCaSEdges EpmCaS_bCaSEdgeTout EpmCaS_CASI1ctEdge10msU8 EpmCaS_ctCaSEdgeLast EpmCaS_ctEdgeEquid EpmCaS_nEng EpmCaS_numPriCamShft EpmCaS_numSegSerLst EpmCaS_numValidTime EpmCaS_phiCor EpmCaS_phiDiffLim EpmCaS_phiDiffLimSecLst EpmCaS_phiEdge EpmCaS_phiRefPos EpmCaS_phiTempCor EpmCaS_phiTempCorEng EpmCaS_stNEng EpmCaS_stphiDiffLim EpmCaS_stphiDiffLimSecLst EpmCaS_stSnsrDeActvn EpmCaS_tiEdge /end OUT_MEASUREMENT
 /begin LOC_MEASUREMENT EpmCaS_nCaS_mp EpmCaS_phiEdgeDvt_mp EpmCaS_stAgPhaShiftFltActv_mp EpmCaS_stAgPhaShiftSecToLst_mp EpmCaS_stAgPhaShift_mp EpmCaS_stDSMRdySeg EpmCaS_stPhaAdpn_mp EpmCaS_stPhaRefAdpn_mp EpmCaS_stPosValid EpmCaS_stRstSeg EpmCaS_tAgSnsrCorr EpmCaS_tiDifAgPhaLstEdge_mp EpmCaS_tiDifAgPhaLstTwoEdges_mp EpmCaS_tiNEngRstTimer /end LOC_MEASUREMENT
 FUNCTION_VERSION "101.14.0" /end FUNCTION
/begin FUNCTION EpmCrS_Diag "103.33.0  Diagnosis of crankhaft signal"
 /begin DEF_CHARACTERISTIC EpmCrS_dnEngMax_C EpmCrS_nDiagOff_C EpmCrS_nDiagOn_C EpmCrS_numErrSigIncDef_C EpmCrS_numErrSigIncOK_C EpmCrS_numErrSigMaxDef_C EpmCrS_numErrSigMinOK_C EpmCrS_numNoSigDef_C EpmCrS_stDiagT50Reset_C EpmCrS_swtEnableDiag_C EpmCrS_swtRstDiag_C EpmCrS_VehV_v_Max_C EpmCrS_VehV_v_Min_C /end DEF_CHARACTERISTIC
 /begin REF_CHARACTERISTIC EpmBCr_swtEnable_C /end REF_CHARACTERISTIC
 /begin IN_MEASUREMENT CoEng_stMai EpmCaS_numPriCamShft EpmCaS_numSegSerLst EpmCaS_stNEng EpmCrS_stSigMode EpmHCrS_cntrEdge EpmHCrS_cntrErr EpmHCrS_stSigErr Epm_dnEngFlt Epm_nEng10ms Epm_stOpMode Epm_stSupressIni Strt_stStaActv SyC_ctPostDrvLeave T15_st VehV_v /end IN_MEASUREMENT
 /begin OUT_MEASUREMENT EpmCrS_ctErrSig EpmCrS_stDiag EpmCrS_stDiagErrSig EpmCrS_stDiagNoSig EpmCrS_stErrSigDiagStop EpmCrS_stNoSigDiagStop EpmCrS_stSigDiagSrc /end OUT_MEASUREMENT
 /begin LOC_MEASUREMENT EpmCrS_bCrSDiagflgClr EpmCrS_bDisturb EpmCrS_bEnableCrSCaS EpmCrS_bEnableDisturb EpmCrS_ctCaSEdgeStart EpmCrS_ctCaSRev_mp EpmCrS_ctRev EpmCrS_ctRev20msLim_mp EpmCrS_ctRevWaitDiag EpmCrS_ctRevWaitDiagSyncIni EpmCrS_dnEngFltSyncIni EpmCrS_stRstDiag EpmCrS_swtRstErrSig EpmCrS_swtRstNoSig /end LOC_MEASUREMENT
 FUNCTION_VERSION "103.33.0" /end FUNCTION
/begin COMPU_METHOD AirMassKg "" RAT_FUNC "%6.4" "Kg" COEFFS 0 100 0 0 0 1 /end COMPU_METHOD
/begin COMPU_METHOD AirMassPerTime "" RAT_FUNC "%6.3" "Kg/h" COEFFS 0 10 0 0 0 1 /end COMPU_METHOD
/begin COMPU_METHOD AngleCrS "" RAT_FUNC "%6.4" "deg CrS" COEFFS 0 45.5111111111 0 0 0 1 /end COMPU_METHOD
/begin COMPU_METHOD B_TRUE "" TAB_VERB "%6.3" "" COMPU_TAB_REF B_TRUE /end COMPU_METHOD
/begin COMPU_VTAB B_TRUE "" TAB_VERB 2 0 "FALSE" 1 "TRUE" /end COMPU_VTAB
/begin COMPU_METHOD CrSRev2CrSInc "" RAT_FUNC "%6.4" "-" COEFFS 0 36 0 0 0 1 /end COMPU_METHOD
/begin COMPU_METHOD dez "" RAT_FUNC "%6.2" "" COEFFS 0 1 0 0 0 1 /end COMPU_METHOD
/begin COMPU_METHOD dfp_verbal "" TAB_VERB "%6.3" "-" COMPU_TAB_REF dfp_verbal /end COMPU_METHOD
/begin COMPU_VTAB dfp_verbal "" TAB_VERB 59 0 "DFP_AAA" 1 "DFP_AGRE" 2 "DFP_AGRL" 3 "DFP_DK" 4 "DFP_DK1P" 5 "DFP_DK2P" 6 "DFP_DKVS" 7 "DFP_DSS" 8 "DFP_DSU" 9 "DFP_DVEE" 10 "DFP_DVEF" 11 "DFP_DVEFO" 12 "DFP_DVEL" 13 "DFP_DVEN" 14 "DFP_DVER" 15 "DFP_DVEU" 16 "DFP_DVEUB" 17 "DFP_DVEUW" 18 "DFP_DYLSU" 19 "DFP_FP1P" 20 "DFP_FP2P" 21 "DFP_FRA" 22 "DFP_HSH" 23 "DFP_HSHE" 24 "DFP_KAT" 25 "DFP_KPE" 26 "DFP_KS1" 27 "DFP_LASH" 28 "DFP_LLR" 29 "DFP_LLRKH" 30 "DFP_LM" 31 "DFP_LSH" 32 "DFP_LZSR" 33 "DFP_MD" 34 "DFP_ORA" 35 "DFP_PLLSU" 36 "DFP_PS2E" 37 "DFP_PSR" 38 "DFP_PSR1" 39 "DFP_PSRB" 40 "DFP_PSRE" 41 "DFP_PSRP" 42 "DFP_PU" 43 "DFP_PUE" 44 "DFP_PUPL" 45 "DFP_PUR" 46 "DFP_TA" 47 "DFP_TASRCS" 48 "DFP_TASRE" 49 "DFP_TASRPRC" 50 "DFP_TASRR" 51 "DFP_TEVE" 52 "DFP_TM" 53 "DFP_TMCS" 54 "DFP_TME" 55 "DFP_TMP" 56 "DFP_UB" 57 "DFP_VFZ" 58 "DFP_ZZZ" DEFAULT_VALUE "---" /end COMPU_VTAB
/begin COMPU_METHOD EngN "" RAT_FUNC "%6.3" "rpm" COEFFS 0 2 0 0 0 1 /end COMPU_METHOD
/begin COMPU_METHOD EngNCaS "" RAT_FUNC "%6.3" "CaSrpm" COEFFS 0 4 0 0 0 1 /end COMPU_METHOD
/begin COMPU_METHOD EngNGrd "" RAT_FUNC "%6.3" "rpm/s" COEFFS 0 2 0 0 0 1 /end COMPU_METHOD
/begin COMPU_METHOD EngN_LRes "" RAT_FUNC "%6.1" "rpm" COEFFS 0 0.025 0 0 0 1 /end COMPU_METHOD
/begin COMPU_METHOD ENGSTRT_IDXSTRTEND_SET_COMPU_VERB "" TAB_VERB "%6.3" "-" COMPU_TAB_REF ENGSTRT_IDXSTRTEND_SET_COMPU_VERB /end COMPU_METHOD
/begin COMPU_VTAB ENGSTRT_IDXSTRTEND_SET_COMPU_VERB "" TAB_VERB 5 0 "IDXSTRTEND_NONE" 1 "IDXSTRTEND_NENG" 2 "IDXSTRTEND_NENGNRINJ" 3 "IDXSTRTEND_NENGDEB" 4 "IDXSTRTEND_NENGCRIT" /end COMPU_VTAB
/begin COMPU_METHOD ENGSTRT_STSTRTREQ_SET_COMPU_VERB "" TAB_VERB "%6.3" "-" COMPU_TAB_REF ENGSTRT_STSTRTREQ_SET_COMPU_VERB /end COMPU_METHOD
/begin COMPU_VTAB ENGSTRT_STSTRTREQ_SET_COMPU_VERB "" TAB_VERB 6 0 "ENGSTRT_NOSTRT" 1025 "ENGSTRT_PFI" 8192 "ENGSTRT_COMRUNNG" 8193 "ENGSTRT_COMSTRTG" 8194 "ENGSTRT_COMWAITSTRTR" 16384 "ENGSTRT_FOLW" /end COMPU_VTAB
/begin COMPU_METHOD EPMBCR_FACRATIO "" RAT_FUNC "%6.5" "" COEFFS 0 1000 0 0 0 1 /end COMPU_METHOD
/begin COMPU_METHOD EpmBCr_Plaus_StatusDetails_CM "" TAB_VERB "%6.3" "" COMPU_TAB_REF EpmBCr_Plaus_StatusDetails_CM /end COMPU_METHOD
/begin COMPU_VTAB EpmBCr_Plaus_StatusDetails_CM "" TAB_VERB 9 0 "INIT" 1 "PTTSEARCHDONE" 2 "BUFREADFAIL" 3 "SYNCREACHED" 4 "SYNCFAILNOPTTMATCH" 5 "SYNCLOSTPTTDIDNOTMATCH" 6 "SYNCKEPTONEQUIEDGE" 7 "SYNCKEPTONSEGEDGE" 8 "SYNCLOSSTOLERATE" /end COMPU_VTAB
/begin COMPU_METHOD EpmBCr_stPlaus_State "" TAB_VERB "%6.3" "" COMPU_TAB_REF EpmBCr_stPlaus_State /end COMPU_METHOD
/begin COMPU_VTAB EpmBCr_stPlaus_State "" TAB_VERB 3 0 "EPMBCR_NOSYNC" 1 "EPMBCR_SYNC" 2 "EPMBCR_SYNCTOL" /end COMPU_VTAB
/begin COMPU_METHOD EpmBCr_stPos_State "" TAB_VERB "%6.3" "" COMPU_TAB_REF EpmBCr_stPos_State /end COMPU_METHOD
/begin COMPU_VTAB EpmBCr_stPos_State "" TAB_VERB 2 0 "EPMBCR_STPOS_NOPOS" 1 "EPMBCR_STPOS_POSFOUND" /end COMPU_VTAB
/begin COMPU_METHOD EpmBCr_swtUpdEdge_CM "" TAB_VERB "%6.3" "" COMPU_TAB_REF EpmBCr_swtUpdEdge_CM /end COMPU_METHOD
/begin COMPU_VTAB EpmBCr_swtUpdEdge_CM "" TAB_VERB 2 0 "UpdateEveryEdge" 1 "UpdateEquiEdge" /end COMPU_VTAB
/begin COMPU_METHOD EpmCaS_Fac_Adap "" RAT_FUNC "%6.5" "-" COEFFS 0 1000 0 0 0 1 /end COMPU_METHOD
/begin COMPU_METHOD EpmCaS_Fac_Plaus "" RAT_FUNC "%6.5" "-" COEFFS 0 1000 0 0 0 1 /end COMPU_METHOD
/begin COMPU_METHOD EpmCaS_stAdap_State "" TAB_VERB "%6.3" "" COMPU_TAB_REF EpmCaS_stAdap_State /end COMPU_METHOD
/begin COMPU_VTAB EpmCaS_stAdap_State "" TAB_VERB 5 0 "EPMCAS_STNOADAP" 1 "EPMCAS_STERRADAP" 2 "EPMCAS_STADAP" 3 "EPMCAS_STADAPSTOP" 4 "EPMCAS_STFULLADAP" /end COMPU_VTAB
/begin COMPU_METHOD EpmCaS_stAgPhaShift_t "" TAB_VERB "%6.3" "" COMPU_TAB_REF EpmCaS_stAgPhaShift_t /end COMPU_METHOD
/begin COMPU_VTAB EpmCaS_stAgPhaShift_t "" TAB_VERB 4 0 "EPMCAS_STAGINVALID" 1 "EPMCAS_STAGFROZEN" 2 "EPMCAS_STAGLIMITED" 3 "EPMCAS_STAGVALID" /end COMPU_VTAB
/begin COMPU_METHOD EpmCaS_stDiagErr_t "" TAB_VERB "%6.3" "" COMPU_TAB_REF EpmCaS_stDiagErr_t /end COMPU_METHOD
/begin COMPU_VTAB EpmCaS_stDiagErr_t "" TAB_VERB 4 0 "EPMCAS_DIAG_AMBI" 1 "EPMCAS_DIAG_OK" 2 "EPMCAS_DIAG_NOSIG" 3 "EPMCAS_DIAG_ERRSIG" /end COMPU_VTAB
/begin COMPU_METHOD EpmCaS_stDiag_t "" TAB_VERB "%6.3" "" COMPU_TAB_REF EpmCaS_stDiag_t /end COMPU_METHOD
/begin COMPU_VTAB EpmCaS_stDiag_t "" TAB_VERB 5 0 "EPMCAS_DIAG_OFF" 1 "EPMCAS_DIAG_PATMAT" 2 "EPMCAS_DIAG_CTEDGE" 3 "EPMCAS_DIAG_NO_SIG" 4 "EPMCAS_DIAG_STOP" /end COMPU_VTAB
/begin COMPU_METHOD EpmCaS_stOfsErr_Val "" TAB_VERB "%6.3" "" COMPU_TAB_REF EpmCaS_stOfsErr_Val /end COMPU_METHOD
/begin COMPU_VTAB EpmCaS_stOfsErr_Val "" TAB_VERB 6 0 "EPMCAS_OFS_AMBI" 1 "EPMCAS_OFS_NOEQUI_EDGE" 2 "EPMCAS_OFS_LOWEQUI_EDGE" 3 "EPMCAS_OFS_NOREFPOS" 4 "EPMCAS_OFS_EXCEED" 5 "EPMCAS_OFS_OK" /end COMPU_VTAB
/begin COMPU_METHOD EpmCas_stOfs_State "" TAB_VERB "%6.3" "" COMPU_TAB_REF EpmCas_stOfs_State /end COMPU_METHOD
/begin COMPU_VTAB EpmCas_stOfs_State "" TAB_VERB 2 0 "EPMCAS_OFS_WAITSEG" 1 "EPMCAS_OFS_SEGCALC" /end COMPU_VTAB
/begin COMPU_METHOD EpmCaS_stphiDiffLim_t "" TAB_VERB "%6.3" "" COMPU_TAB_REF EpmCaS_stphiDiffLim_t /end COMPU_METHOD
/begin COMPU_VTAB EpmCaS_stphiDiffLim_t "" TAB_VERB 8 0 "RET_OK" 1 "RET_SYNADP" 2 "RET_PERM" 3 "RET_PREP" 4 "RET_GETLST" 5 "RET_GETCUR" 6 "RET_NOVALIDEDGE" 8 "RET_MECHLIM" /end COMPU_VTAB
/begin COMPU_METHOD EpmCrS_DiagResult_State "" TAB_VERB "%6.3" "" COMPU_TAB_REF EpmCrS_DiagResult_State /end COMPU_METHOD
/begin COMPU_VTAB EpmCrS_DiagResult_State "" TAB_VERB 5 0 "EPMCRS_DIAG_PENDING" 1 "EPMCRS_DIAG_DEBHEAL" 2 "EPMCRS_DIAG_HEAL" 3 "EPMCRS_DIAG_DEBSET" 4 "EPMCRS_DIAG_SET" /end COMPU_VTAB
/begin COMPU_METHOD EpmCrS_Diag_State "" TAB_VERB "%6.3" "" COMPU_TAB_REF EpmCrS_Diag_State /end COMPU_METHOD
/begin COMPU_VTAB EpmCrS_Diag_State "" TAB_VERB 4 0 "EPMCRS_DIAG_OFF" 1 "EPMCRS_DIAG_ON" 2 "EPMCRS_DIAG_FRZ" 3 "EPMCRS_DIAG_INIT" /end COMPU_VTAB
/begin COMPU_METHOD EpmIf_swtTSel_VERB "" TAB_VERB "%6.3" "" COMPU_TAB_REF EpmIf_swtTSel_VERB /end COMPU_METHOD
/begin COMPU_VTAB EpmIf_swtTSel_VERB "" TAB_VERB 2 0 "Engine temp" 1 "Oil temp" /end COMPU_VTAB
/begin COMPU_METHOD EPM_FAC_PLAUS "" RAT_FUNC "%6.4" "-" COEFFS 0 16 0 0 0 1 /end COMPU_METHOD
/begin COMPU_METHOD Epm_stOpMode_State_t "" TAB_VERB "%6.3" "" COMPU_TAB_REF Epm_stOpMode_State_t /end COMPU_METHOD
/begin COMPU_VTAB Epm_stOpMode_State_t "" TAB_VERB 8 1 "EPM_MODE_WAIT" 5 "EPM_MODE_LOCKRESYNC" 20 "EPM_MODE_ALE" 33 "EPM_MODE_VERIFY" 36 "EPM_MODE_VERIFY_EXT" 38 "EPM_MODE_BACKUP_CAS" 48 "EPM_MODE_OK" 60 "EPM_MODE_BACKUP_CRS" /end COMPU_VTAB
/begin COMPU_METHOD Fact "" RAT_FUNC "%6.5" "-" COEFFS 0 8192 0 0 0 1 /end COMPU_METHOD
/begin COMPU_METHOD fak_ub_b4 "" RAT_FUNC "%6.4" "-" COEFFS 0 256 0 0 0 4 /end COMPU_METHOD
/begin COMPU_METHOD fak_uw_b1 "" RAT_FUNC "%7.6" "-" COEFFS 0 65536 0 0 0 1 /end COMPU_METHOD
/begin COMPU_METHOD fak_uw_b2 "" RAT_FUNC "%7.6" "-" COEFFS 0 65536 0 0 0 2 /end COMPU_METHOD
/begin COMPU_METHOD fak_uw_b4 "" RAT_FUNC "%7.6" "-" COEFFS 0 65536 0 0 0 4 /end COMPU_METHOD
/begin COMPU_METHOD fak_uw_b64 "" RAT_FUNC "%6.5" "-" COEFFS 0 65536 0 0 0 64 /end COMPU_METHOD
/begin COMPU_METHOD HEGOS2HTGEXT_SC_Compu "" TAB_VERB "%6.3" "" COMPU_TAB_REF HEGOS2HTGEXT_SC_Compu /end COMPU_METHOD
/begin COMPU_VTAB HEGOS2HTGEXT_SC_Compu "" TAB_VERB 2 0 "False" 1 "True" /end COMPU_VTAB
/begin COMPU_METHOD HEGOS2MNTGTST_SC_Compu "" TAB_VERB "%6.3" "" COMPU_TAB_REF HEGOS2MNTGTST_SC_Compu /end COMPU_METHOD
/begin COMPU_VTAB HEGOS2MNTGTST_SC_Compu "" TAB_VERB 2 0 "False" 1 "True" /end COMPU_VTAB
/begin COMPU_METHOD HEGOS2OFFSDETN_SC_Compu "" TAB_VERB "%6.3" "" COMPU_TAB_REF HEGOS2OFFSDETN_SC_Compu /end COMPU_METHOD
/begin COMPU_VTAB HEGOS2OFFSDETN_SC_Compu "" TAB_VERB 2 0 "False" 1 "True" /end COMPU_VTAB
/begin COMPU_METHOD HEGOS3B1_SY_Compu "" TAB_VERB "%6.3" "" COMPU_TAB_REF HEGOS3B1_SY_Compu /end COMPU_METHOD
/begin COMPU_VTAB HEGOS3B1_SY_Compu "" TAB_VERB 2 0 "False" 1 "True" /end COMPU_VTAB
/begin COMPU_METHOD HEGOS3B2_SY_Compu "" TAB_VERB "%6.3" "" COMPU_TAB_REF HEGOS3B2_SY_Compu /end COMPU_METHOD
/begin COMPU_VTAB HEGOS3B2_SY_Compu "" TAB_VERB 2 0 "False" 1 "True" /end COMPU_VTAB
/begin COMPU_METHOD HEGOS3COLDOPER_SC_Compu "" TAB_VERB "%6.3" "" COMPU_TAB_REF HEGOS3COLDOPER_SC_Compu /end COMPU_METHOD
/begin COMPU_VTAB HEGOS3COLDOPER_SC_Compu "" TAB_VERB 2 0 "False" 1 "True" /end COMPU_VTAB
/begin COMPU_METHOD HEGOS3FET_SY_Compu "" TAB_VERB "%6.3" "" COMPU_TAB_REF HEGOS3FET_SY_Compu /end COMPU_METHOD
/begin COMPU_VTAB HEGOS3FET_SY_Compu "" TAB_VERB 2 0 "False" 1 "True" /end COMPU_VTAB
/begin COMPU_METHOD HEGOS3HTGENAEXT_SC_Compu "" TAB_VERB "%6.3" "" COMPU_TAB_REF HEGOS3HTGENAEXT_SC_Compu /end COMPU_METHOD
/begin COMPU_VTAB HEGOS3HTGENAEXT_SC_Compu "" TAB_VERB 2 0 "False" 1 "True" /end COMPU_VTAB
/begin COMPU_METHOD HEGOS3HTGEXT_SC_Compu "" TAB_VERB "%6.3" "" COMPU_TAB_REF HEGOS3HTGEXT_SC_Compu /end COMPU_METHOD
/begin COMPU_VTAB HEGOS3HTGEXT_SC_Compu "" TAB_VERB 2 0 "False" 1 "True" /end COMPU_VTAB
/begin COMPU_METHOD HEGOS3MNTGTST_SC_Compu "" TAB_VERB "%6.3" "" COMPU_TAB_REF HEGOS3MNTGTST_SC_Compu /end COMPU_METHOD
/begin COMPU_VTAB HEGOS3MNTGTST_SC_Compu "" TAB_VERB 2 0 "False" 1 "True" /end COMPU_VTAB
/begin COMPU_METHOD HEGO_BINSNSRSWIL_SC_Compu "" TAB_VERB "%6.3" "" COMPU_TAB_REF HEGO_BINSNSRSWIL_SC_Compu /end COMPU_METHOD
/begin COMPU_VTAB HEGO_BINSNSRSWIL_SC_Compu "" TAB_VERB 2 0 "False" 1 "True" /end COMPU_VTAB
/begin COMPU_METHOD HEGO_VAR_SY_Compu "" TAB_VERB "%6.3" "" COMPU_TAB_REF HEGO_VAR_SY_Compu /end COMPU_METHOD
/begin COMPU_VTAB HEGO_VAR_SY_Compu "" TAB_VERB 45 1 "DAI" 3 "VWW" 4 "POR" 5 "AUD" 6 "OPE" 9 "FIA" 11 "BMW" 14 "PSA" 15 "REN" 17 "ALF" 18 "SAB" 19 "VOL" 20 "NIS" 21 "GMU" 22 "FOR" 26 "IMJ" 51 "SEA" 53 "CHR" 54 "JAG" 55 "ROL" 69 "FER" 72 "TOY" 112 "BMW-Motorrad AG" 123 "MIT" 147 "HYU" 159 "HON" 160 "MAZ" 183 "CU" 190 "LRG" 204 "VVW" 214 "AVT" 242 "Iveco" 243 "DMC" 248 "SUZ" 267 "SSANGYONG" 270 "KEF" 289 "AMG" 308 "TAT" 319 "MVM" 385 "UAES" 590 "Scania" 828 "RBCD" 999 "ALL" 2887 "Nonox" 9454 "Fuso" /end COMPU_VTAB
/begin COMPU_METHOD HEMAIRCHMB_SC_Compu "" TAB_VERB "%6.3" "" COMPU_TAB_REF HEMAIRCHMB_SC_Compu /end COMPU_METHOD
/begin COMPU_VTAB HEMAIRCHMB_SC_Compu "" TAB_VERB 2 0 "False" 1 "True" /end COMPU_VTAB
/begin COMPU_METHOD HEM_SY_Compu "" TAB_VERB "%6.3" "" COMPU_TAB_REF HEM_SY_Compu /end COMPU_METHOD
/begin COMPU_VTAB HEM_SY_Compu "" TAB_VERB 3 0 "NO_HEM" 1 "HEM_CYL" 2 "HEM_BNK" /end COMPU_VTAB
/begin COMPU_METHOD HESRV_DEFNGETECUTYPE_SC_Compu "" TAB_VERB "%6.3" "" COMPU_TAB_REF HESRV_DEFNGETECUTYPE_SC_Compu /end COMPU_METHOD
/begin COMPU_VTAB HESRV_DEFNGETECUTYPE_SC_Compu "" TAB_VERB 2 0 "False" 1 "True" /end COMPU_VTAB
/begin COMPU_METHOD HESRV_HETYP_SY_Compu "" TAB_VERB "%6.3" "" COMPU_TAB_REF HESRV_HETYP_SY_Compu /end COMPU_METHOD
/begin COMPU_VTAB HESRV_HETYP_SY_Compu "" TAB_VERB 4 1 "HESRV_MASTERSLAVE" 2 "HESRV_VCU" 3 "HESRV_HCU" 255 "HESRV_ONEBOX" /end COMPU_VTAB
/begin COMPU_METHOD HESRV_MSIDADP_SC_Compu "" TAB_VERB "%6.3" "" COMPU_TAB_REF HESRV_MSIDADP_SC_Compu /end COMPU_METHOD
/begin COMPU_VTAB HESRV_MSIDADP_SC_Compu "" TAB_VERB 2 0 "False" 1 "True" /end COMPU_VTAB
/begin COMPU_METHOD HESRV_MSIDEXCLSN_SC_Compu "" TAB_VERB "%6.3" "" COMPU_TAB_REF HESRV_MSIDEXCLSN_SC_Compu /end COMPU_METHOD
/begin COMPU_VTAB HESRV_MSIDEXCLSN_SC_Compu "" TAB_VERB 2 0 "False" 1 "True" /end COMPU_VTAB
/begin COMPU_METHOD HESRV_MSIDOPENLOAD_SC_Compu "" TAB_VERB "%6.3" "" COMPU_TAB_REF HESRV_MSIDOPENLOAD_SC_Compu /end COMPU_METHOD
/begin COMPU_VTAB HESRV_MSIDOPENLOAD_SC_Compu "" TAB_VERB 2 0 "False" 1 "True" /end COMPU_VTAB
/begin COMPU_METHOD HESRV_MSIDPLAUSCHECK_SC_Compu "" TAB_VERB "%6.3" "" COMPU_TAB_REF HESRV_MSIDPLAUSCHECK_SC_Compu /end COMPU_METHOD
/begin COMPU_VTAB HESRV_MSIDPLAUSCHECK_SC_Compu "" TAB_VERB 2 0 "False" 1 "True" /end COMPU_VTAB
/begin COMPU_METHOD HESRV_MSID_SSPMON_SC_Compu "" TAB_VERB "%6.3" "" COMPU_TAB_REF HESRV_MSID_SSPMON_SC_Compu /end COMPU_METHOD
/begin COMPU_VTAB HESRV_MSID_SSPMON_SC_Compu "" TAB_VERB 4 0 "0" 1 "1" 2 "2" 3 "3" /end COMPU_VTAB
/begin COMPU_METHOD HESRV_MSTSLAVECAL_SC_Compu "" TAB_VERB "%6.3" "" COMPU_TAB_REF HESRV_MSTSLAVECAL_SC_Compu /end COMPU_METHOD
/begin COMPU_VTAB HESRV_MSTSLAVECAL_SC_Compu "" TAB_VERB 2 0 "False" 1 "True" /end COMPU_VTAB
/begin COMPU_METHOD HESRV_MSTSLAVEINFOEEPUPD_SC_Compu "" TAB_VERB "%6.3" "" COMPU_TAB_REF HESRV_MSTSLAVEINFOEEPUPD_SC_Compu /end COMPU_METHOD
/begin COMPU_VTAB HESRV_MSTSLAVEINFOEEPUPD_SC_Compu "" TAB_VERB 2 0 "False" 1 "True" /end COMPU_VTAB
/begin COMPU_METHOD HESRV_SEGPROCENA_SC_Compu "" TAB_VERB "%6.3" "" COMPU_TAB_REF HESRV_SEGPROCENA_SC_Compu /end COMPU_METHOD
/begin COMPU_VTAB HESRV_SEGPROCENA_SC_Compu "" TAB_VERB 2 0 "False" 1 "True" /end COMPU_VTAB
/begin COMPU_METHOD HESRV_SWCSTNCARYSIZE_SC_Compu "" RAT_FUNC "%6.2" "" COEFFS 0 1 0 0 0 1 /end COMPU_METHOD
/begin COMPU_METHOD HESRV_SWCSTNCCHK_SC_Compu "" TAB_VERB "%6.3" "" COMPU_TAB_REF HESRV_SWCSTNCCHK_SC_Compu /end COMPU_METHOD
/begin COMPU_VTAB HESRV_SWCSTNCCHK_SC_Compu "" TAB_VERB 3 0 "HESRV_NOTUSED" 1 "HESRV_CSTNCCHKECU1" 2 "HESRV_CSTNCCHKECU2" /end COMPU_VTAB
/begin COMPU_METHOD HESRV_SWCSTNCSTGY_SC_Compu "" TAB_VERB "%6.3" "" COMPU_TAB_REF HESRV_SWCSTNCSTGY_SC_Compu /end COMPU_METHOD
/begin COMPU_VTAB HESRV_SWCSTNCSTGY_SC_Compu "" TAB_VERB 4 0 "0" 1 "1" 2 "2" 3 "3" /end COMPU_VTAB
/begin COMPU_METHOD HEVCHGR_SY_Compu "" TAB_VERB "%6.3" "" COMPU_TAB_REF HEVCHGR_SY_Compu /end COMPU_METHOD
/begin COMPU_VTAB HEVCHGR_SY_Compu "" TAB_VERB 5 0 "NOCHGR" 1 "CHGR_UHV" 2 "CHGR_UHVLV" 3 "CHGR_BHV" 4 "CHGR_BHVLV" /end COMPU_VTAB
/begin COMPU_METHOD HEVPLINAVL_SC_Compu "" TAB_VERB "%6.3" "" COMPU_TAB_REF HEVPLINAVL_SC_Compu /end COMPU_METHOD
/begin COMPU_VTAB HEVPLINAVL_SC_Compu "" TAB_VERB 2 0 "False" 1 "True" /end COMPU_VTAB
/begin COMPU_METHOD HEVTYP_SY_Compu "" TAB_VERB "%6.3" "" COMPU_TAB_REF HEVTYP_SY_Compu /end COMPU_METHOD
/begin COMPU_VTAB HEVTYP_SY_Compu "" TAB_VERB 8 0 "0" 1 "HEVTYP_SER" 2 "HEVTYP_SERPARL" 3 "HEVTYP_PWRSPLT" 4 "HEVTYP_PARL" 5 "HEVTYP_EAD" 6 "HEVTYP_EDCT" 7 "HEVTYP_PARLSER" /end COMPU_VTAB
/begin COMPU_METHOD HIPSYS_HIPPMPPLAUSDGNSTYP_SC_Compu "" TAB_VERB "%6.3" "" COMPU_TAB_REF HIPSYS_HIPPMPPLAUSDGNSTYP_SC_Compu /end COMPU_METHOD
/begin COMPU_VTAB HIPSYS_HIPPMPPLAUSDGNSTYP_SC_Compu "" TAB_VERB 3 0 "NONE" 1 "DHDRPP" 2 "HiPSys_HiPPmpPlaus" /end COMPU_VTAB
/begin COMPU_METHOD HIREDNSTGGEARINTERTHR_SC_Compu "" TAB_VERB "%6.3" "" COMPU_TAB_REF HIREDNSTGGEARINTERTHR_SC_Compu /end COMPU_METHOD
/begin COMPU_VTAB HIREDNSTGGEARINTERTHR_SC_Compu "" TAB_VERB 2 0 "False" 1 "True" /end COMPU_VTAB
/begin COMPU_METHOD HLN_SY_Compu "" TAB_VERB "%6.3" "" COMPU_TAB_REF HLN_SY_Compu /end COMPU_METHOD
/begin COMPU_VTAB HLN_SY_Compu "" TAB_VERB 2 0 "False" 1 "True" /end COMPU_VTAB
/begin COMPU_METHOD HLSDEMERR1_SY_Compu "" TAB_VERB "%6.3" "" COMPU_TAB_REF HLSDEMERR1_SY_Compu /end COMPU_METHOD
/begin COMPU_VTAB HLSDEMERR1_SY_Compu "" TAB_VERB 2 0 "False" 1 "True" /end COMPU_VTAB
/begin COMPU_METHOD HLSDEMERR2_SY_Compu "" TAB_VERB "%6.3" "" COMPU_TAB_REF HLSDEMERR2_SY_Compu /end COMPU_METHOD
/begin COMPU_VTAB HLSDEMERR2_SY_Compu "" TAB_VERB 2 0 "False" 1 "True" /end COMPU_VTAB
/begin COMPU_METHOD HLSDEM_DRVOFFSUPRTENA_SC_Compu "" TAB_VERB "%6.3" "" COMPU_TAB_REF HLSDEM_DRVOFFSUPRTENA_SC_Compu /end COMPU_METHOD
/begin COMPU_VTAB HLSDEM_DRVOFFSUPRTENA_SC_Compu "" TAB_VERB 2 0 "False" 1 "True" /end COMPU_VTAB
/begin COMPU_METHOD HLSDEM_GEARLIM_SY_Compu "" TAB_VERB "%6.3" "" COMPU_TAB_REF HLSDEM_GEARLIM_SY_Compu /end COMPU_METHOD
/begin COMPU_VTAB HLSDEM_GEARLIM_SY_Compu "" TAB_VERB 2 0 "False" 1 "True" /end COMPU_VTAB
/begin COMPU_METHOD HLSDEM_INHOUSE_SC_Compu "" TAB_VERB "%6.3" "" COMPU_TAB_REF HLSDEM_INHOUSE_SC_Compu /end COMPU_METHOD
/begin COMPU_VTAB HLSDEM_INHOUSE_SC_Compu "" TAB_VERB 2 0 "False" 1 "True" /end COMPU_VTAB
/begin COMPU_METHOD HLSDEM_NMINWOTRAINTV_SY_Compu "" TAB_VERB "%6.3" "" COMPU_TAB_REF HLSDEM_NMINWOTRAINTV_SY_Compu /end COMPU_METHOD
/begin COMPU_VTAB HLSDEM_NMINWOTRAINTV_SY_Compu "" TAB_VERB 2 0 "0" 1 "1" /end COMPU_VTAB
/begin COMPU_METHOD HLSMON_NRPNTSTENG_SC_Compu "" RAT_FUNC "%6.2" "" COEFFS 0 1 0 0 0 1 /end COMPU_METHOD
/begin COMPU_METHOD HPDIFF_TYPAVL_SC_Compu "" TAB_VERB "%6.3" "" COMPU_TAB_REF HPDIFF_TYPAVL_SC_Compu /end COMPU_METHOD
/begin COMPU_VTAB HPDIFF_TYPAVL_SC_Compu "" TAB_VERB 2 0 "False" 1 "True" /end COMPU_VTAB
/begin COMPU_METHOD HPIN_TYPAVL_SC_Compu "" TAB_VERB "%6.3" "" COMPU_TAB_REF HPIN_TYPAVL_SC_Compu /end COMPU_METHOD
/begin COMPU_VTAB HPIN_TYPAVL_SC_Compu "" TAB_VERB 2 0 "False" 1 "True" /end COMPU_VTAB
/begin COMPU_METHOD HPOUTPRR_TYPAVL_SY_Compu "" TAB_VERB "%6.3" "" COMPU_TAB_REF HPOUTPRR_TYPAVL_SY_Compu /end COMPU_METHOD
/begin COMPU_VTAB HPOUTPRR_TYPAVL_SY_Compu "" TAB_VERB 2 0 "False" 1 "True" /end COMPU_VTAB
/begin COMPU_METHOD HTANKP_TYPAVL_SY_Compu "" TAB_VERB "%6.3" "" COMPU_TAB_REF HTANKP_TYPAVL_SY_Compu /end COMPU_METHOD
/begin COMPU_VTAB HTANKP_TYPAVL_SY_Compu "" TAB_VERB 2 0 "False" 1 "True" /end COMPU_VTAB
/begin COMPU_METHOD HTANKT_TYPAVL_SY_Compu "" TAB_VERB "%6.3" "" COMPU_TAB_REF HTANKT_TYPAVL_SY_Compu /end COMPU_METHOD
/begin COMPU_VTAB HTANKT_TYPAVL_SY_Compu "" TAB_VERB 2 0 "False" 1 "True" /end COMPU_VTAB
/begin COMPU_METHOD HTGTSTRS1_SY_Compu "" TAB_VERB "%6.3" "" COMPU_TAB_REF HTGTSTRS1_SY_Compu /end COMPU_METHOD
/begin COMPU_VTAB HTGTSTRS1_SY_Compu "" TAB_VERB 2 0 "False" 1 "True" /end COMPU_VTAB
/begin COMPU_METHOD HTGTSTRS2_SY_Compu "" TAB_VERB "%6.3" "" COMPU_TAB_REF HTGTSTRS2_SY_Compu /end COMPU_METHOD
/begin COMPU_VTAB HTGTSTRS2_SY_Compu "" TAB_VERB 2 0 "False" 1 "True" /end COMPU_VTAB
/begin COMPU_METHOD HTGTSTRS3_SY_Compu "" TAB_VERB "%6.3" "" COMPU_TAB_REF HTGTSTRS3_SY_Compu /end COMPU_METHOD
/begin COMPU_VTAB HTGTSTRS3_SY_Compu "" TAB_VERB 2 0 "False" 1 "True" /end COMPU_VTAB
/begin COMPU_METHOD HTIN_TYPAVL_SC_Compu "" TAB_VERB "%6.3" "" COMPU_TAB_REF HTIN_TYPAVL_SC_Compu /end COMPU_METHOD
/begin COMPU_VTAB HTIN_TYPAVL_SC_Compu "" TAB_VERB 2 0 "False" 1 "True" /end COMPU_VTAB
/begin COMPU_METHOD HTOUT_TYPAVL_SC_Compu "" TAB_VERB "%6.3" "" COMPU_TAB_REF HTOUT_TYPAVL_SC_Compu /end COMPU_METHOD
/begin COMPU_VTAB HTOUT_TYPAVL_SC_Compu "" TAB_VERB 2 0 "False" 1 "True" /end COMPU_VTAB
/begin COMPU_METHOD HumEnvSnsrUsd_SC_Compu "" TAB_VERB "%6.3" "" COMPU_TAB_REF HumEnvSnsrUsd_SC_Compu /end COMPU_METHOD
/begin COMPU_VTAB HumEnvSnsrUsd_SC_Compu "" TAB_VERB 5 0 "No Sensor used" 1 "Bosch_PWM" 2 "Hitachi_PWM" 3 "Bosch_SENT" 4 "Bosch_LIN" /end COMPU_VTAB
/begin COMPU_METHOD HVACHEATPMPP_TYPAVL_SC_Compu "" TAB_VERB "%6.3" "" COMPU_TAB_REF HVACHEATPMPP_TYPAVL_SC_Compu /end COMPU_METHOD
/begin COMPU_VTAB HVACHEATPMPP_TYPAVL_SC_Compu "" TAB_VERB 2 0 "False" 1 "True" /end COMPU_VTAB
/begin COMPU_METHOD HVACHEATPMPT_TYPAVL_SC_Compu "" TAB_VERB "%6.3" "" COMPU_TAB_REF HVACHEATPMPT_TYPAVL_SC_Compu /end COMPU_METHOD
/begin COMPU_VTAB HVACHEATPMPT_TYPAVL_SC_Compu "" TAB_VERB 2 0 "False" 1 "True" /end COMPU_VTAB
/begin COMPU_METHOD HVACSPT_TYPAVL_SC_Compu "" TAB_VERB "%6.3" "" COMPU_TAB_REF HVACSPT_TYPAVL_SC_Compu /end COMPU_METHOD
/begin COMPU_VTAB HVACSPT_TYPAVL_SC_Compu "" TAB_VERB 2 0 "False" 1 "True" /end COMPU_VTAB
/begin COMPU_METHOD HWDPD_SC_Compu "" TAB_VERB "%6.3" "" COMPU_TAB_REF HWDPD_SC_Compu /end COMPU_METHOD
/begin COMPU_VTAB HWDPD_SC_Compu "" TAB_VERB 3 0 "HWDPD_NEUT" 1 "HWDPD_SWNOTSEL" 2 "HWDPD_SWSEL" /end COMPU_VTAB
/begin COMPU_METHOD HYBADDLELECAXLE_SC_Compu "" TAB_VERB "%6.3" "" COMPU_TAB_REF HYBADDLELECAXLE_SC_Compu /end COMPU_METHOD
/begin COMPU_VTAB HYBADDLELECAXLE_SC_Compu "" TAB_VERB 2 0 "NOADDLELACAXLE" 1 "ADDLELECAXLE" /end COMPU_VTAB
/begin COMPU_METHOD HYDSTORGHIPT_TYPAVL_SC_Compu "" TAB_VERB "%6.3" "" COMPU_TAB_REF HYDSTORGHIPT_TYPAVL_SC_Compu /end COMPU_METHOD
/begin COMPU_VTAB HYDSTORGHIPT_TYPAVL_SC_Compu "" TAB_VERB 2 0 "False" 1 "True" /end COMPU_VTAB
/begin COMPU_METHOD HYDSTORGLOPT_TYPAVL_SC_Compu "" TAB_VERB "%6.3" "" COMPU_TAB_REF HYDSTORGLOPT_TYPAVL_SC_Compu /end COMPU_METHOD
/begin COMPU_VTAB HYDSTORGLOPT_TYPAVL_SC_Compu "" TAB_VERB 2 0 "False" 1 "True" /end COMPU_VTAB
/begin COMPU_METHOD HYDSYSHIPTSEC_TYPAVL_SC_Compu "" TAB_VERB "%6.3" "" COMPU_TAB_REF HYDSYSHIPTSEC_TYPAVL_SC_Compu /end COMPU_METHOD
/begin COMPU_VTAB HYDSYSHIPTSEC_TYPAVL_SC_Compu "" TAB_VERB 2 0 "False" 1 "True" /end COMPU_VTAB
/begin COMPU_METHOD HYDSYSLOPT_TYPAVL_SC_Compu "" TAB_VERB "%6.3" "" COMPU_TAB_REF HYDSYSLOPT_TYPAVL_SC_Compu /end COMPU_METHOD
/begin COMPU_VTAB HYDSYSLOPT_TYPAVL_SC_Compu "" TAB_VERB 2 0 "False" 1 "True" /end COMPU_VTAB
/begin COMPU_METHOD I15031EXTD_CVNALGCUST_SC_Compu "" TAB_VERB "%6.3" "" COMPU_TAB_REF I15031EXTD_CVNALGCUST_SC_Compu /end COMPU_METHOD
/begin COMPU_VTAB I15031EXTD_CVNALGCUST_SC_Compu "" TAB_VERB 2 0 "PLATFORM" 1 "HONDA" /end COMPU_VTAB
/begin COMPU_METHOD I15031SRV9VT_SC_Compu "" TAB_VERB "%6.3" "" COMPU_TAB_REF I15031SRV9VT_SC_Compu /end COMPU_METHOD
/begin COMPU_VTAB I15031SRV9VT_SC_Compu "" TAB_VERB 2 0 "VT_disabled" 1 "VT_enabled" /end COMPU_VTAB
/begin COMPU_METHOD I15031_CVNALG_SC_Compu "" TAB_VERB "%6.3" "" COMPU_TAB_REF I15031_CVNALG_SC_Compu /end COMPU_METHOD
/begin COMPU_VTAB I15031_CVNALG_SC_Compu "" TAB_VERB 4 1 "CVN_ALG_CRC32_DIABAS" 2 "CVN_ALG_CRC32_SECULIBS" 3 "CVN_ALG_SHA256_BCL" 4 "CVN_ALG_SHA256_HSM" /end COMPU_VTAB
/begin COMPU_METHOD I15031_EXTCVNSTORGBHVR_SC_Compu "" TAB_VERB "%6.3" "" COMPU_TAB_REF I15031_EXTCVNSTORGBHVR_SC_Compu /end COMPU_METHOD
/begin COMPU_VTAB I15031_EXTCVNSTORGBHVR_SC_Compu "" TAB_VERB 2 1 "PSTDRV" 2 "RAS1s" /end COMPU_VTAB
/begin COMPU_METHOD I15031_OBD_CNTL_SC_Compu "" TAB_VERB "%6.3" "" COMPU_TAB_REF I15031_OBD_CNTL_SC_Compu /end COMPU_METHOD
/begin COMPU_VTAB I15031_OBD_CNTL_SC_Compu "" TAB_VERB 4 0 "I15031_ACTIVE" 1 "I15031_SRV_ADJUST" 2 "I15031_INACTIVE" 3 "I15031_NOT_EXISTING" /end COMPU_VTAB
/begin COMPU_METHOD I15031_SRV8_SY_Compu "" TAB_VERB "%6.3" "" COMPU_TAB_REF I15031_SRV8_SY_Compu /end COMPU_METHOD
/begin COMPU_VTAB I15031_SRV8_SY_Compu "" TAB_VERB 2 0 "0" 1 "1" /end COMPU_VTAB
/begin COMPU_METHOD I27145_SC_Compu "" TAB_VERB "%6.3" "" COMPU_TAB_REF I27145_SC_Compu /end COMPU_METHOD
/begin COMPU_VTAB I27145_SC_Compu "" TAB_VERB 2 0 "False" 1 "True" /end COMPU_VTAB
/begin COMPU_METHOD IATPS11SLAVE_SC_Compu "" TAB_VERB "%6.3" "" COMPU_TAB_REF IATPS11SLAVE_SC_Compu /end COMPU_METHOD
/begin COMPU_VTAB IATPS11SLAVE_SC_Compu "" TAB_VERB 7 0 "no_sensor" 1 "TFA1" 2 "TFA2" 3 "TFA3" 4 "TFA4" 5 "TFA5" 6 "TFA6" /end COMPU_VTAB
/begin COMPU_METHOD md_q0p1 "" RAT_FUNC "%6.3" "Nm" COEFFS 0 10 0 0 0 1 /end COMPU_METHOD
/begin COMPU_METHOD md_q1p6 "" RAT_FUNC "%6.2" "Nm" COEFFS 0 10 0 0 0 16 /end COMPU_METHOD
/begin COMPU_METHOD m_uw_b6553p5 "" RAT_FUNC "%6.3" "kg/h" COEFFS 0 1 0 0 0 0.1 /end COMPU_METHOD
/begin COMPU_METHOD nmot_q40 "" RAT_FUNC "%6.1" "1/min" COEFFS 0 1 0 0 0 40 /end COMPU_METHOD
/begin COMPU_METHOD OneToOne "" RAT_FUNC "%6.2" "-" COEFFS 0 1 0 0 0 1 /end COMPU_METHOD
/begin COMPU_METHOD OneToOne_us "" RAT_FUNC "%6.2" "us" COEFFS 0 1 0 0 0 1 /end COMPU_METHOD
/begin COMPU_METHOD Per_Dur "" RAT_FUNC "%6.2" "usec" COEFFS 0 1 0 0 0 1 /end COMPU_METHOD
/begin COMPU_METHOD Prc "" RAT_FUNC "%6.4" "%" COEFFS 0 81.92 0 0 0 1 /end COMPU_METHOD
/begin COMPU_METHOD p_q0p039 "" RAT_FUNC "%6.4" "hPa" COEFFS 0 256 0 0 0 10 /end COMPU_METHOD
/begin COMPU_METHOD p_q0p078 "" RAT_FUNC "%6.4" "hPa" COEFFS 0 64 0 0 0 5 /end COMPU_METHOD
/begin COMPU_METHOD p_ub_q5 "" RAT_FUNC "%6.2" "hPa" COEFFS 0 1 0 0 0 5 /end COMPU_METHOD
/begin COMPU_METHOD rel_q0p00195_pc_s "" RAT_FUNC "%6.4" "%*s" COEFFS 0 65536 0 0 0 128 /end COMPU_METHOD
/begin COMPU_METHOD rel_q0p39 "" RAT_FUNC "%6.3" "%" COEFFS 0 256 0 0 0 100 /end COMPU_METHOD
/begin COMPU_METHOD rel_sw_q0p0234 "" RAT_FUNC "%6.4" "%/seg" COEFFS 0 32 0 0 0 0.75 /end COMPU_METHOD
/begin COMPU_METHOD rel_uw_b100 "" RAT_FUNC "%6.4" "%" COEFFS 0 65536 0 0 0 100 /end COMPU_METHOD
/begin COMPU_METHOD RevCnt "" RAT_FUNC "%6.4" "-" COEFFS 0 16 0 0 0 1 /end COMPU_METHOD
/begin COMPU_METHOD SigQly_COMPU_VERB "" TAB_VERB "%6.3" "" COMPU_TAB_REF SigQly_COMPU_VERB /end COMPU_METHOD
/begin COMPU_VTAB SigQly_COMPU_VERB "" TAB_VERB 16 0 "SIGQLY_NOTCALC" 1 "SIGQLY_INIT" 2 "SIGQLY_OK" 3 "SIGQLY_MODEL" 4 "SIGQLY_REPLACEMENT" 5 "SIGQLY_FROZEN" 6 "SIGQLY_INVALID" 7 "SIGQLY_RESERVED_7" 8 "SIGQLY_RESERVED_8" 9 "SIGQLY_RESERVED_9" 10 "SIGQLY_RESERVED_10" 11 "SIGQLY_RESERVED_11" 12 "SIGQLY_RESERVED_12" 13 "SIGQLY_RESERVED_13" 14 "SIGQLY_RESERVED_14" 15 "SIGQLY_RESERVED_15" /end COMPU_VTAB
/begin COMPU_METHOD STRTEND_NENGCRIT_SET_COMPU_VERB "" TAB_VERB "%6.3" "-" COMPU_TAB_REF STRTEND_NENGCRIT_SET_COMPU_VERB /end COMPU_METHOD
/begin COMPU_VTAB STRTEND_NENGCRIT_SET_COMPU_VERB "" TAB_VERB 1 0 "NENGCRIT" /end COMPU_VTAB
/begin COMPU_METHOD STRTEND_NENGDEB_SET_COMPU_VERB "" TAB_VERB "%6.3" "-" COMPU_TAB_REF STRTEND_NENGDEB_SET_COMPU_VERB /end COMPU_METHOD
/begin COMPU_VTAB STRTEND_NENGDEB_SET_COMPU_VERB "" TAB_VERB 1 0 "NENGDEB" /end COMPU_VTAB
/begin COMPU_METHOD STRTEND_NENGNRINJ_SET_COMPU_VERB "" TAB_VERB "%6.3" "-" COMPU_TAB_REF STRTEND_NENGNRINJ_SET_COMPU_VERB /end COMPU_METHOD
/begin COMPU_VTAB STRTEND_NENGNRINJ_SET_COMPU_VERB "" TAB_VERB 2 0 "NENGNRINJ" 1 "NENGNRINJ_FOLW" /end COMPU_VTAB
/begin COMPU_METHOD STRTEND_NENG_SET_COMPU_VERB "" TAB_VERB "%6.3" "-" COMPU_TAB_REF STRTEND_NENG_SET_COMPU_VERB /end COMPU_METHOD
/begin COMPU_VTAB STRTEND_NENG_SET_COMPU_VERB "" TAB_VERB 3 0 "NENG" 1 "NENG_FOLW" 2 "NENG_COM" /end COMPU_VTAB
/begin COMPU_METHOD t100msxs_uw_b6553p5 "" RAT_FUNC "%6.3" "s" COEFFS 0 1 0 0 0 0.1 /end COMPU_METHOD
/begin COMPU_METHOD t10msxs_ub_q0p01 "" RAT_FUNC "%6.4" "s" COEFFS 0 1 0 0 0 0.01 /end COMPU_METHOD
/begin COMPU_METHOD t10msxs_uw_b655p35 "" RAT_FUNC "%6.4" "s" COEFFS 0 1 0 0 0 0.01 /end COMPU_METHOD
/begin COMPU_METHOD Temp_Cels "" RAT_FUNC "%6.1" "deg C" COEFFS 0 10 2731.4 0 0 1 /end COMPU_METHOD
/begin COMPU_METHOD temp_q0p0234_o273 "" RAT_FUNC "%6.1" "Grad C" COEFFS 0 1 273.15 0 0 0.0234375 /end COMPU_METHOD
/begin COMPU_METHOD temp_q1p0_o40_degC "" RAT_FUNC "%6.2" "Grad" COEFFS 0 1 40 0 0 1 /end COMPU_METHOD
/begin COMPU_METHOD temp_ub_q0p75_o48 "" RAT_FUNC "%6.2" "Grad C" COEFFS 0 1 48 0 0 0.75 /end COMPU_METHOD
/begin COMPU_METHOD TimeDelay_ms "" RAT_FUNC "%13.2" "ms" COEFFS 0 0 1 0 2.3283064365387e-007 0 /end COMPU_METHOD
/begin COMPU_METHOD TimeDelay_s "" RAT_FUNC "%6.1" "s" COEFFS 0 0 1 0 0.00023283064365387 0 /end COMPU_METHOD
/begin COMPU_METHOD Time_Dt "" RAT_FUNC "%9.8" "s" COEFFS 0 1000000 0 0 0 1 /end COMPU_METHOD
/begin COMPU_METHOD Time_ms "" RAT_FUNC "%6.1" "ms" COEFFS 0 0.1 0 0 0 1 /end COMPU_METHOD
/begin COMPU_METHOD Time_s "" RAT_FUNC "%6.4" "s" COEFFS 0 100 0 0 0 1 /end COMPU_METHOD
/begin COMPU_METHOD Time_sec_q1_COMPU "" RAT_FUNC "%6.2" "s" COEFFS 0 1 0 0 0 1 /end COMPU_METHOD
/begin COMPU_METHOD Trq "" RAT_FUNC "%6.3" "Nm" COEFFS 0 10 0 0 0 1 /end COMPU_METHOD
/begin COMPU_METHOD t_q0p01 "" RAT_FUNC "%6.4" "s" COEFFS 0 100 0 0 0 1 /end COMPU_METHOD
/begin COMPU_METHOD t_q0p04 "" RAT_FUNC "%6.4" "s" COEFFS 0 100 0 0 0 4 /end COMPU_METHOD
/begin COMPU_METHOD t_q0p1 "" RAT_FUNC "%6.3" "s" COEFFS 0 10 0 0 0 1 /end COMPU_METHOD
/begin COMPU_METHOD t_q1 "" RAT_FUNC "%6.2" "s" COEFFS 0 1 0 0 0 1 /end COMPU_METHOD
/begin COMPU_METHOD Vel "" RAT_FUNC "%6.4" "km/h" COEFFS 0 100 0 0 0 1 /end COMPU_METHOD
/begin COMPU_METHOD zk40msxs_uw_b2621p4 "" RAT_FUNC "%6.1" "s" COEFFS 0 0 65535 0 25 0 /end COMPU_METHOD
/*********** End of merged RECORD_LAYOUT blocks ***********/
/begin RECORD_LAYOUT Axis_Xs16 NO_AXIS_PTS_X 1 SWORD AXIS_PTS_X 2 SWORD INDEX_INCR DIRECT /end RECORD_LAYOUT
/begin RECORD_LAYOUT CurG_Ws16 FNC_VALUES 1 SWORD COLUMN_DIR DIRECT /end RECORD_LAYOUT
/begin RECORD_LAYOUT Cur_Xs16Ws16 NO_AXIS_PTS_X 1 SWORD AXIS_PTS_X 2 SWORD INDEX_INCR DIRECT FNC_VALUES 3 SWORD COLUMN_DIR DIRECT /end RECORD_LAYOUT
/begin RECORD_LAYOUT RB_Axis_S16 NO_AXIS_PTS_X 1 SWORD AXIS_PTS_X 2 SWORD INDEX_INCR DIRECT /end RECORD_LAYOUT
/begin RECORD_LAYOUT RB_Axis_U16 NO_AXIS_PTS_X 1 UWORD AXIS_PTS_X 2 UWORD INDEX_INCR DIRECT /end RECORD_LAYOUT
/begin RECORD_LAYOUT RB_CurveGroup_U8 FNC_VALUES 1 UBYTE COLUMN_DIR DIRECT /end RECORD_LAYOUT
/begin RECORD_LAYOUT RB_Curve_S16_R32_Static NO_AXIS_PTS_X 1 SWORD AXIS_PTS_X 2 SWORD INDEX_INCR DIRECT FNC_VALUES 3 FLOAT32_IEEE COLUMN_DIR DIRECT STATIC_RECORD_LAYOUT /end RECORD_LAYOUT
/begin RECORD_LAYOUT RB_Curve_S16_S16 NO_AXIS_PTS_X 1 SWORD AXIS_PTS_X 2 SWORD INDEX_INCR DIRECT FNC_VALUES 3 SWORD COLUMN_DIR DIRECT /end RECORD_LAYOUT
/begin RECORD_LAYOUT RB_Curve_S16_U16_Static NO_AXIS_PTS_X 1 SWORD AXIS_PTS_X 2 SWORD INDEX_INCR DIRECT FNC_VALUES 3 UWORD COLUMN_DIR DIRECT STATIC_RECORD_LAYOUT /end RECORD_LAYOUT
/begin RECORD_LAYOUT RB_Curve_U16_U16 NO_AXIS_PTS_X 1 UWORD AXIS_PTS_X 2 UWORD INDEX_INCR DIRECT FNC_VALUES 3 UWORD COLUMN_DIR DIRECT /end RECORD_LAYOUT
/begin RECORD_LAYOUT RB_Curve_U16_U8_Static NO_AXIS_PTS_X 1 UWORD AXIS_PTS_X 2 UWORD INDEX_INCR DIRECT FNC_VALUES 3 UBYTE COLUMN_DIR DIRECT STATIC_RECORD_LAYOUT /end RECORD_LAYOUT
/begin RECORD_LAYOUT RB_Curve_U8_S16_Static NO_AXIS_PTS_X 1 UBYTE AXIS_PTS_X 2 UBYTE INDEX_INCR DIRECT FNC_VALUES 3 SWORD COLUMN_DIR DIRECT STATIC_RECORD_LAYOUT /end RECORD_LAYOUT
/begin RECORD_LAYOUT RB_Curve_U8_U16_Static NO_AXIS_PTS_X 1 UBYTE AXIS_PTS_X 2 UBYTE INDEX_INCR DIRECT FNC_VALUES 3 UWORD COLUMN_DIR DIRECT STATIC_RECORD_LAYOUT /end RECORD_LAYOUT
/begin RECORD_LAYOUT RB_Curve_U8_U8 NO_AXIS_PTS_X 1 UBYTE AXIS_PTS_X 2 UBYTE INDEX_INCR DIRECT FNC_VALUES 3 UBYTE COLUMN_DIR DIRECT /end RECORD_LAYOUT
/begin RECORD_LAYOUT RB_MapGroup_S16 FNC_VALUES 1 SWORD COLUMN_DIR DIRECT /end RECORD_LAYOUT
/begin RECORD_LAYOUT RB_MapGroup_U16 FNC_VALUES 1 UWORD COLUMN_DIR DIRECT /end RECORD_LAYOUT
/begin RECORD_LAYOUT RB_Map_S16S16_S16 NO_AXIS_PTS_X 1 SWORD NO_AXIS_PTS_Y 2 SWORD AXIS_PTS_X 3 SWORD INDEX_INCR DIRECT AXIS_PTS_Y 4 SWORD INDEX_INCR DIRECT FNC_VALUES 5 SWORD COLUMN_DIR DIRECT /end RECORD_LAYOUT
/begin RECORD_LAYOUT RB_Map_U8S16_S16 NO_AXIS_PTS_X 1 UBYTE NO_AXIS_PTS_Y 2 UBYTE AXIS_PTS_X 3 UBYTE INDEX_INCR DIRECT AXIS_PTS_Y 4 SWORD INDEX_INCR DIRECT FNC_VALUES 5 SWORD ROW_DIR DIRECT /end RECORD_LAYOUT
/begin RECORD_LAYOUT RB_ValA_Wu16 FNC_VALUES 1 UWORD COLUMN_DIR DIRECT /end RECORD_LAYOUT
/begin RECORD_LAYOUT RB_Val_Ws16 FNC_VALUES 1 SWORD COLUMN_DIR DIRECT /end RECORD_LAYOUT
/begin RECORD_LAYOUT RB_Val_Ws32 FNC_VALUES 1 SLONG COLUMN_DIR DIRECT /end RECORD_LAYOUT
/begin RECORD_LAYOUT RB_Val_Wu16 FNC_VALUES 1 UWORD COLUMN_DIR DIRECT /end RECORD_LAYOUT
/begin RECORD_LAYOUT RB_Val_Wu32 FNC_VALUES 1 ULONG COLUMN_DIR DIRECT /end RECORD_LAYOUT
/begin RECORD_LAYOUT RB_Val_Wu8 FNC_VALUES 1 UBYTE COLUMN_DIR DIRECT /end RECORD_LAYOUT
/begin RECORD_LAYOUT ValA_Ws16 FNC_VALUES 1 SWORD COLUMN_DIR DIRECT /end RECORD_LAYOUT
/begin RECORD_LAYOUT ValA_Wu8 FNC_VALUES 1 UBYTE COLUMN_DIR DIRECT /end RECORD_LAYOUT
/begin RECORD_LAYOUT Val_Ws16 FNC_VALUES 1 SWORD COLUMN_DIR DIRECT /end RECORD_LAYOUT
/begin RECORD_LAYOUT Val_Ws32 FNC_VALUES 1 SLONG COLUMN_DIR DIRECT /end RECORD_LAYOUT
/begin RECORD_LAYOUT Val_Wu16 FNC_VALUES 1 UWORD COLUMN_DIR DIRECT /end RECORD_LAYOUT
/begin RECORD_LAYOUT Val_Wu32 FNC_VALUES 1 ULONG COLUMN_DIR DIRECT /end RECORD_LAYOUT
/begin RECORD_LAYOUT Val_Wu8 FNC_VALUES 1 UBYTE COLUMN_DIR DIRECT /end RECORD_LAYOUT
/end MODULE
/end PROJECT
