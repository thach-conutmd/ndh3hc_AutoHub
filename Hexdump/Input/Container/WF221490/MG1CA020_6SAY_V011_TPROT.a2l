ASAP2_VERSION 1 60
/begin PROJECT MG1CA020 "MG1CA020"
/begin HEADER "" VERSION "MG1CA020_6SAY_V011_TPROT" PROJECT_NO MG1CA020 /end HEADER
/begin MODULE DIM ""
/begin MOD_COMMON "" BYTE_ORDER MSB_LAST ALIGNMENT_BYTE 1 ALIGNMENT_WORD 2 ALIGNMENT_LONG 4 ALIGNMENT_INT64 4 ALIGNMENT_FLOAT32_IEEE 4 ALIGNMENT_FLOAT64_IEEE 4 DATA_SIZE 32 /end MOD_COMMON
/begin CHARACTERISTIC DFC_CtlMsk.DFC_Unused_C "Behaviour control mask / " VALUE 0x804D8BA8 Val_Wu16 65535.00 DFES_OneToOne 0.00 65535.00 FORMAT "%8.2" READ_ONLY /end CHARACTERISTIC
/begin CHARACTERISTIC DFC_CtlMsk.DFC_AltIOACGFailr_C "Behaviour control mask / Behaviour control masks of check DFC_AltIOACGFailr" VALUE 0x804D8BAA Val_Wu16 65535.00 DFES_OneToOne 0.00 65535.00 FORMAT "%8.2" /end CHARACTERISTIC
/begin CHARACTERISTIC DFC_CtlMsk.DFC_AltIOACGHiVltg_C "Behaviour control mask / Behaviour control masks of check DFC_AltIOACGHiVltg" VALUE 0x804D8BAC Val_Wu16 65535.00 DFES_OneToOne 0.00 65535.00 FORMAT "%8.2" /end CHARACTERISTIC
/begin CHARACTERISTIC DFC_CtlMsk.DFC_AltIOACGLoVltg_C "Behaviour control mask / Behaviour control masks of check DFC_AltIOACGLoVltg" VALUE 0x804D8BAE Val_Wu16 65535.00 DFES_OneToOne 0.00 65535.00 FORMAT "%8.2" /end CHARACTERISTIC
/begin CHARACTERISTIC DFC_CtlMsk.DFC_AltIOACGTHi_C "Behaviour control mask / Behaviour control masks of check DFC_AltIOACGTHi" VALUE 0x804D8BB0 Val_Wu16 65535.00 DFES_OneToOne 0.00 65535.00 FORMAT "%8.2" /end CHARACTERISTIC
/begin CHARACTERISTIC DFC_CtlMsk.DFC_AltIODConnACG_C "Behaviour control mask / Behaviour control masks of check DFC_AltIODConnACG" VALUE 0x804D8BB2 Val_Wu16 65535.00 DFES_OneToOne 0.00 65535.00 FORMAT "%8.2" /end CHARACTERISTIC
/begin CHARACTERISTIC DFC_CtlMsk.DFC_BattUHiFailr_C "Behaviour control mask / Behaviour control masks of check DFC_BattUHiFailr" VALUE 0x804D8BB4 Val_Wu16 65535.00 DFES_OneToOne 0.00 65535.00 FORMAT "%8.2" /end CHARACTERISTIC
/begin CHARACTERISTIC DFC_CtlMsk.DFC_BattULoFailr_C "Behaviour control mask / Behaviour control masks of check DFC_BattULoFailr" VALUE 0x804D8BB6 Val_Wu16 65535.00 DFES_OneToOne 0.00 65535.00 FORMAT "%8.2" /end CHARACTERISTIC
/begin CHARACTERISTIC DFC_CtlMsk.DFC_BrkBstPDriftHiErr_C "Behaviour control mask / Behaviour control masks of check DFC_BrkBstPDriftHiErr" VALUE 0x804D8BB8 Val_Wu16 65535.00 DFES_OneToOne 0.00 65535.00 FORMAT "%8.2" /end CHARACTERISTIC
/begin CHARACTERISTIC DFC_CtlMsk.DFC_BrkBstPDriftLoErr_C "Behaviour control mask / Behaviour control masks of check DFC_BrkBstPDriftLoErr" VALUE 0x804D8BBA Val_Wu16 65535.00 DFES_OneToOne 0.00 65535.00 FORMAT "%8.2" /end CHARACTERISTIC
/begin CHARACTERISTIC DFC_CtlMsk.DFC_BrkBstPSnsrStuck_C "Behaviour control mask / Behaviour control masks of check DFC_BrkBstPSnsrStuck" VALUE 0x804D8BBC Val_Wu16 65535.00 DFES_OneToOne 0.00 65535.00 FORMAT "%8.2" /end CHARACTERISTIC
/begin CHARACTERISTIC DFC_CtlMsk.DFC_BrkMnSwtContOn_C "Behaviour control mask / Behaviour control masks of check DFC_BrkMnSwtContOn" VALUE 0x804D8BBE Val_Wu16 65535.00 DFES_OneToOne 0.00 65535.00 FORMAT "%8.2" /end CHARACTERISTIC
/begin CHARACTERISTIC DFC_CtlMsk.DFC_BrkMnSwtNotStp_C "Behaviour control mask / Behaviour control masks of check DFC_BrkMnSwtNotStp" VALUE 0x804D8BC0 Val_Wu16 65535.00 DFES_OneToOne 0.00 65535.00 FORMAT "%8.2" /end CHARACTERISTIC
/begin CHARACTERISTIC DFC_CtlMsk.DFC_BrkNpl_C "Behaviour control mask / Behaviour control masks of check DFC_BrkNpl" VALUE 0x804D8BC2 Val_Wu16 65535.00 DFES_OneToOne 0.00 65535.00 FORMAT "%8.2" /end CHARACTERISTIC
/begin CHARACTERISTIC DFC_CtlMsk.DFC_BrkRdntSwtContOn_C "Behaviour control mask / Behaviour control masks of check DFC_BrkRdntSwtContOn" VALUE 0x804D8BC4 Val_Wu16 65535.00 DFES_OneToOne 0.00 65535.00 FORMAT "%8.2" /end CHARACTERISTIC
/begin CHARACTERISTIC DFC_CtlMsk.DFC_BrkRdntSwtNotStp_C "Behaviour control mask / Behaviour control masks of check DFC_BrkRdntSwtNotStp" VALUE 0x804D8BC6 Val_Wu16 65535.00 DFES_OneToOne 0.00 65535.00 FORMAT "%8.2" /end CHARACTERISTIC
/begin CHARACTERISTIC DFC_CtlMsk.DFC_Clth3ONStuck_C "Behaviour control mask / Behaviour control masks of check DFC_Clth3ONStuck" VALUE 0x804D8BC8 Val_Wu16 65535.00 DFES_OneToOne 0.00 65535.00 FORMAT "%8.2" /end CHARACTERISTIC
/begin CHARACTERISTIC DFC_CtlMsk.DFC_Clth4OFFStuck_C "Behaviour control mask / Behaviour control masks of check DFC_Clth4OFFStuck" VALUE 0x804D8BCA Val_Wu16 65535.00 DFES_OneToOne 0.00 65535.00 FORMAT "%8.2" /end CHARACTERISTIC
/begin CHARACTERISTIC DFC_CtlMsk.DFC_ClthOFFStuck_C "Behaviour control mask / Behaviour control masks of check DFC_ClthOFFStuck" VALUE 0x804D8BCC Val_Wu16 65535.00 DFES_OneToOne 0.00 65535.00 FORMAT "%8.2" /end CHARACTERISTIC
/begin CHARACTERISTIC DFC_CtlMsk.DFC_ClthONStuck_C "Behaviour control mask / Behaviour control masks of check DFC_ClthONStuck" VALUE 0x804D8BCE Val_Wu16 65535.00 DFES_OneToOne 0.00 65535.00 FORMAT "%8.2" /end CHARACTERISTIC
/begin CHARACTERISTIC DFC_CtlMsk.DFC_ClthStkFailInfo_C "Behaviour control mask / Behaviour control masks of check DFC_ClthStkFailInfo" VALUE 0x804D8BD0 Val_Wu16 65535.00 DFES_OneToOne 0.00 65535.00 FORMAT "%8.2" /end CHARACTERISTIC
/begin CHARACTERISTIC DFC_CtlMsk.DFC_ComACFailInfo_C "Behaviour control mask / Behaviour control masks of check DFC_ComACFailInfo" VALUE 0x804D8BD2 Val_Wu16 65535.00 DFES_OneToOne 0.00 65535.00 FORMAT "%8.2" /end CHARACTERISTIC
/begin CHARACTERISTIC DFC_CtlMsk.DFC_ComATFTValErr_C "Behaviour control mask / Behaviour control masks of check DFC_ComATFTValErr" VALUE 0x804D8BD4 Val_Wu16 65535.00 DFES_OneToOne 0.00 65535.00 FORMAT "%8.2" /end CHARACTERISTIC
/begin CHARACTERISTIC DFC_CtlMsk.DFC_ComATMILReq_C "Behaviour control mask / Behaviour control masks of check DFC_ComATMILReq" VALUE 0x804D8BD6 Val_Wu16 65535.00 DFES_OneToOne 0.00 65535.00 FORMAT "%8.2" /end CHARACTERISTIC
/begin CHARACTERISTIC DFC_CtlMsk.DFC_ComAYCAChksum_C "Behaviour control mask / Behaviour control masks of check DFC_ComAYCAChksum" VALUE 0x804D8BD8 Val_Wu16 65535.00 DFES_OneToOne 0.00 65535.00 FORMAT "%8.2" /end CHARACTERISTIC
/begin CHARACTERISTIC DFC_CtlMsk.DFC_ComAYCARingCnt_C "Behaviour control mask / Behaviour control masks of check DFC_ComAYCARingCnt" VALUE 0x804D8BDA Val_Wu16 65535.00 DFES_OneToOne 0.00 65535.00 FORMAT "%8.2" /end CHARACTERISTIC
/begin CHARACTERISTIC DFC_CtlMsk.DFC_ComAYCATOut_C "Behaviour control mask / Behaviour control masks of check DFC_ComAYCATOut" VALUE 0x804D8BDC Val_Wu16 65535.00 DFES_OneToOne 0.00 65535.00 FORMAT "%8.2" /end CHARACTERISTIC
/begin CHARACTERISTIC DFC_CtlMsk.DFC_ComAYCDChkSum_C "Behaviour control mask / Behaviour control masks of check DFC_ComAYCDChkSum" VALUE 0x804D8BDE Val_Wu16 65535.00 DFES_OneToOne 0.00 65535.00 FORMAT "%8.2" /end CHARACTERISTIC
/begin CHARACTERISTIC DFC_CtlMsk.DFC_ComAYCDTOut_C "Behaviour control mask / Behaviour control masks of check DFC_ComAYCDTOut" VALUE 0x804D8BE0 Val_Wu16 65535.00 DFES_OneToOne 0.00 65535.00 FORMAT "%8.2" /end CHARACTERISTIC
/begin CHARACTERISTIC DFC_CtlMsk.DFC_ComAYCFChksum_C "Behaviour control mask / Behaviour control masks of check DFC_ComAYCFChksum" VALUE 0x804D8BE2 Val_Wu16 65535.00 DFES_OneToOne 0.00 65535.00 FORMAT "%8.2" /end CHARACTERISTIC
/begin CHARACTERISTIC DFC_CtlMsk.DFC_ComAYCFRingCnt_C "Behaviour control mask / Behaviour control masks of check DFC_ComAYCFRingCnt" VALUE 0x804D8BE4 Val_Wu16 65535.00 DFES_OneToOne 0.00 65535.00 FORMAT "%8.2" /end CHARACTERISTIC
/begin CHARACTERISTIC DFC_CtlMsk.DFC_ComAYCFTOut_C "Behaviour control mask / Behaviour control masks of check DFC_ComAYCFTOut" VALUE 0x804D8BE6 Val_Wu16 65535.00 DFES_OneToOne 0.00 65535.00 FORMAT "%8.2" /end CHARACTERISTIC
/begin CHARACTERISTIC DFC_CtlMsk.DFC_ComAYCGChksum_C "Behaviour control mask / Behaviour control masks of check DFC_ComAYCGChksum" VALUE 0x804D8BE8 Val_Wu16 65535.00 DFES_OneToOne 0.00 65535.00 FORMAT "%8.2" /end CHARACTERISTIC
/begin CHARACTERISTIC DFC_CtlMsk.DFC_ComAYCGRingCnt_C "Behaviour control mask / Behaviour control masks of check DFC_ComAYCGRingCnt" VALUE 0x804D8BEA Val_Wu16 65535.00 DFES_OneToOne 0.00 65535.00 FORMAT "%8.2" /end CHARACTERISTIC
/begin CHARACTERISTIC DFC_CtlMsk.DFC_ComAYCGTOut_C "Behaviour control mask / Behaviour control masks of check DFC_ComAYCGTOut" VALUE 0x804D8BEC Val_Wu16 65535.00 DFES_OneToOne 0.00 65535.00 FORMAT "%8.2" /end CHARACTERISTIC
/begin CHARACTERISTIC DFC_CtlMsk.DFC_ComAYCIChkSum_C "Behaviour control mask / Behaviour control masks of check DFC_ComAYCIChkSum" VALUE 0x804D8BEE Val_Wu16 65535.00 DFES_OneToOne 0.00 65535.00 FORMAT "%8.2" /end CHARACTERISTIC
/begin CHARACTERISTIC DFC_CtlMsk.DFC_ComAYCIRingCnt_C "Behaviour control mask / Behaviour control masks of check DFC_ComAYCIRingCnt" VALUE 0x804D8BF0 Val_Wu16 65535.00 DFES_OneToOne 0.00 65535.00 FORMAT "%8.2" /end CHARACTERISTIC
/begin CHARACTERISTIC DFC_CtlMsk.DFC_ComAYCITOut_C "Behaviour control mask / Behaviour control masks of check DFC_ComAYCITOut" VALUE 0x804D8BF2 Val_Wu16 65535.00 DFES_OneToOne 0.00 65535.00 FORMAT "%8.2" /end CHARACTERISTIC
/begin CHARACTERISTIC DFC_CtlMsk.DFC_ComBCM1ChkSum_C "Behaviour control mask / Behaviour control masks of check DFC_ComBCM1ChkSum" VALUE 0x804D8BF4 Val_Wu16 65535.00 DFES_OneToOne 0.00 65535.00 FORMAT "%8.2" /end CHARACTERISTIC
/begin CHARACTERISTIC DFC_CtlMsk.DFC_ComBCM1RingCnt_C "Behaviour control mask / Behaviour control masks of check DFC_ComBCM1RingCnt" VALUE 0x804D8BF6 Val_Wu16 65535.00 DFES_OneToOne 0.00 65535.00 FORMAT "%8.2" /end CHARACTERISTIC
/begin CHARACTERISTIC DFC_CtlMsk.DFC_ComBCM1TOut_C "Behaviour control mask / Behaviour control masks of check DFC_ComBCM1TOut" VALUE 0x804D8BF8 Val_Wu16 65535.00 DFES_OneToOne 0.00 65535.00 FORMAT "%8.2" /end CHARACTERISTIC
/begin CHARACTERISTIC DFC_CtlMsk.DFC_ComCANABusOffErr_C "Behaviour control mask / Behaviour control masks of check DFC_ComCANABusOffErr" VALUE 0x804D8BFA Val_Wu16 65535.00 DFES_OneToOne 0.00 65535.00 FORMAT "%8.2" /end CHARACTERISTIC
/begin CHARACTERISTIC DFC_CtlMsk.DFC_ComCANBBusOffErr_C "Behaviour control mask / Behaviour control masks of check DFC_ComCANBBusOffErr" VALUE 0x804D8BFC Val_Wu16 65535.00 DFES_OneToOne 0.00 65535.00 FORMAT "%8.2" /end CHARACTERISTIC
/begin CHARACTERISTIC DFC_CtlMsk.DFC_ComCANCBusOffErr_C "Behaviour control mask / Behaviour control masks of check DFC_ComCANCBusOffErr" VALUE 0x804D8BFE Val_Wu16 65535.00 DFES_OneToOne 0.00 65535.00 FORMAT "%8.2" /end CHARACTERISTIC
/begin CHARACTERISTIC DFC_CtlMsk.DFC_ComCGW1ChkSum_C "Behaviour control mask / Behaviour control masks of check DFC_ComCGW1ChkSum" VALUE 0x804D8C00 Val_Wu16 65535.00 DFES_OneToOne 0.00 65535.00 FORMAT "%8.2" /end CHARACTERISTIC
/begin CHARACTERISTIC DFC_CtlMsk.DFC_ComCGW1RingCnt_C "Behaviour control mask / Behaviour control masks of check DFC_ComCGW1RingCnt" VALUE 0x804D8C02 Val_Wu16 65535.00 DFES_OneToOne 0.00 65535.00 FORMAT "%8.2" /end CHARACTERISTIC
/begin CHARACTERISTIC DFC_CtlMsk.DFC_ComCGW1TOut_C "Behaviour control mask / Behaviour control masks of check DFC_ComCGW1TOut" VALUE 0x804D8C04 Val_Wu16 65535.00 DFES_OneToOne 0.00 65535.00 FORMAT "%8.2" /end CHARACTERISTIC
/begin CHARACTERISTIC DFC_CtlMsk.DFC_ComConvBoostErr_C "Behaviour control mask / Behaviour control masks of check DFC_ComConvBoostErr" VALUE 0x804D8C06 Val_Wu16 65535.00 DFES_OneToOne 0.00 65535.00 FORMAT "%8.2" /end CHARACTERISTIC
/begin CHARACTERISTIC DFC_CtlMsk.DFC_ComConvSlipErr_C "Behaviour control mask / Behaviour control masks of check DFC_ComConvSlipErr" VALUE 0x804D8C08 Val_Wu16 65535.00 DFES_OneToOne 0.00 65535.00 FORMAT "%8.2" /end CHARACTERISTIC
/begin CHARACTERISTIC DFC_CtlMsk.DFC_ComEAT10Chksum_C "Behaviour control mask / Behaviour control masks of check DFC_ComEAT10Chksum" VALUE 0x804D8C0A Val_Wu16 65535.00 DFES_OneToOne 0.00 65535.00 FORMAT "%8.2" /end CHARACTERISTIC
/begin CHARACTERISTIC DFC_CtlMsk.DFC_ComEAT10RingCnt_C "Behaviour control mask / Behaviour control masks of check DFC_ComEAT10RingCnt" VALUE 0x804D8C0C Val_Wu16 65535.00 DFES_OneToOne 0.00 65535.00 FORMAT "%8.2" /end CHARACTERISTIC
/begin CHARACTERISTIC DFC_CtlMsk.DFC_ComEAT10TOut_C "Behaviour control mask / Behaviour control masks of check DFC_ComEAT10TOut" VALUE 0x804D8C0E Val_Wu16 65535.00 DFES_OneToOne 0.00 65535.00 FORMAT "%8.2" /end CHARACTERISTIC
/begin CHARACTERISTIC DFC_CtlMsk.DFC_ComEAT11ChkSum_C "Behaviour control mask / Behaviour control masks of check DFC_ComEAT11ChkSum" VALUE 0x804D8C10 Val_Wu16 65535.00 DFES_OneToOne 0.00 65535.00 FORMAT "%8.2" /end CHARACTERISTIC
/begin CHARACTERISTIC DFC_CtlMsk.DFC_ComEAT11RingCnt_C "Behaviour control mask / Behaviour control masks of check DFC_ComEAT11RingCnt" VALUE 0x804D8C12 Val_Wu16 65535.00 DFES_OneToOne 0.00 65535.00 FORMAT "%8.2" /end CHARACTERISTIC
/begin CHARACTERISTIC DFC_CtlMsk.DFC_ComEAT11TOut_C "Behaviour control mask / Behaviour control masks of check DFC_ComEAT11TOut" VALUE 0x804D8C14 Val_Wu16 65535.00 DFES_OneToOne 0.00 65535.00 FORMAT "%8.2" /end CHARACTERISTIC
/begin CHARACTERISTIC DFC_CtlMsk.DFC_ComEAT12ChkSum_C "Behaviour control mask / Behaviour control masks of check DFC_ComEAT12ChkSum" VALUE 0x804D8C16 Val_Wu16 65535.00 DFES_OneToOne 0.00 65535.00 FORMAT "%8.2" /end CHARACTERISTIC
/begin CHARACTERISTIC DFC_CtlMsk.DFC_ComEAT12RingCnt_C "Behaviour control mask / Behaviour control masks of check DFC_ComEAT12RingCnt" VALUE 0x804D8C18 Val_Wu16 65535.00 DFES_OneToOne 0.00 65535.00 FORMAT "%8.2" /end CHARACTERISTIC
/begin CHARACTERISTIC DFC_CtlMsk.DFC_ComEAT12TOut_C "Behaviour control mask / Behaviour control masks of check DFC_ComEAT12TOut" VALUE 0x804D8C1A Val_Wu16 65535.00 DFES_OneToOne 0.00 65535.00 FORMAT "%8.2" /end CHARACTERISTIC
/begin CHARACTERISTIC DFC_CtlMsk.DFC_ComEAT13ChkSum_C "Behaviour control mask / Behaviour control masks of check DFC_ComEAT13ChkSum" VALUE 0x804D8C1C Val_Wu16 65535.00 DFES_OneToOne 0.00 65535.00 FORMAT "%8.2" /end CHARACTERISTIC
/begin CHARACTERISTIC DFC_CtlMsk.DFC_ComEAT13RingCnt_C "Behaviour control mask / Behaviour control masks of check DFC_ComEAT13RingCnt" VALUE 0x804D8C1E Val_Wu16 65535.00 DFES_OneToOne 0.00 65535.00 FORMAT "%8.2" /end CHARACTERISTIC
/begin CHARACTERISTIC DFC_CtlMsk.DFC_ComEAT13TOut_C "Behaviour control mask / Behaviour control masks of check DFC_ComEAT13TOut" VALUE 0x804D8C20 Val_Wu16 65535.00 DFES_OneToOne 0.00 65535.00 FORMAT "%8.2" /end CHARACTERISTIC
/begin CHARACTERISTIC DFC_CtlMsk.DFC_ComEAT1Chksum_C "Behaviour control mask / Behaviour control masks of check DFC_ComEAT1Chksum" VALUE 0x804D8C22 Val_Wu16 65535.00 DFES_OneToOne 0.00 65535.00 FORMAT "%8.2" /end CHARACTERISTIC
/begin CHARACTERISTIC DFC_CtlMsk.DFC_ComEAT1RingCnt_C "Behaviour control mask / Behaviour control masks of check DFC_ComEAT1RingCnt" VALUE 0x804D8C24 Val_Wu16 65535.00 DFES_OneToOne 0.00 65535.00 FORMAT "%8.2" /end CHARACTERISTIC
/begin CHARACTERISTIC DFC_CtlMsk.DFC_ComEAT1TOut_C "Behaviour control mask / Behaviour control masks of check DFC_ComEAT1TOut" VALUE 0x804D8C26 Val_Wu16 65535.00 DFES_OneToOne 0.00 65535.00 FORMAT "%8.2" /end CHARACTERISTIC
/begin CHARACTERISTIC DFC_CtlMsk.DFC_ComEAT2ChkSum_C "Behaviour control mask / Behaviour control masks of check DFC_ComEAT2ChkSum" VALUE 0x804D8C28 Val_Wu16 65535.00 DFES_OneToOne 0.00 65535.00 FORMAT "%8.2" /end CHARACTERISTIC
/begin CHARACTERISTIC DFC_CtlMsk.DFC_ComEAT2RingCnt_C "Behaviour control mask / Behaviour control masks of check DFC_ComEAT2RingCnt" VALUE 0x804D8C2A Val_Wu16 65535.00 DFES_OneToOne 0.00 65535.00 FORMAT "%8.2" /end CHARACTERISTIC
/begin CHARACTERISTIC DFC_CtlMsk.DFC_ComEAT2TOut_C "Behaviour control mask / Behaviour control masks of check DFC_ComEAT2TOut" VALUE 0x804D8C2C Val_Wu16 65535.00 DFES_OneToOne 0.00 65535.00 FORMAT "%8.2" /end CHARACTERISTIC
/begin CHARACTERISTIC DFC_CtlMsk.DFC_ComEAT4ChkSum_C "Behaviour control mask / Behaviour control masks of check DFC_ComEAT4ChkSum" VALUE 0x804D8C2E Val_Wu16 65535.00 DFES_OneToOne 0.00 65535.00 FORMAT "%8.2" /end CHARACTERISTIC
/begin CHARACTERISTIC DFC_CtlMsk.DFC_ComEAT4RingCnt_C "Behaviour control mask / Behaviour control masks of check DFC_ComEAT4RingCnt" VALUE 0x804D8C30 Val_Wu16 65535.00 DFES_OneToOne 0.00 65535.00 FORMAT "%8.2" /end CHARACTERISTIC
/begin CHARACTERISTIC DFC_CtlMsk.DFC_ComEAT4TOut_C "Behaviour control mask / Behaviour control masks of check DFC_ComEAT4TOut" VALUE 0x804D8C32 Val_Wu16 65535.00 DFES_OneToOne 0.00 65535.00 FORMAT "%8.2" /end CHARACTERISTIC
/begin CHARACTERISTIC DFC_CtlMsk.DFC_ComEAT6Chksum_C "Behaviour control mask / Behaviour control masks of check DFC_ComEAT6Chksum" VALUE 0x804D8C34 Val_Wu16 65535.00 DFES_OneToOne 0.00 65535.00 FORMAT "%8.2" /end CHARACTERISTIC
/begin CHARACTERISTIC DFC_CtlMsk.DFC_ComEAT6RingCnt_C "Behaviour control mask / Behaviour control masks of check DFC_ComEAT6RingCnt" VALUE 0x804D8C36 Val_Wu16 65535.00 DFES_OneToOne 0.00 65535.00 FORMAT "%8.2" /end CHARACTERISTIC
/begin CHARACTERISTIC DFC_CtlMsk.DFC_ComEAT6TOut_C "Behaviour control mask / Behaviour control masks of check DFC_ComEAT6TOut" VALUE 0x804D8C38 Val_Wu16 65535.00 DFES_OneToOne 0.00 65535.00 FORMAT "%8.2" /end CHARACTERISTIC
/begin CHARACTERISTIC DFC_CtlMsk.DFC_ComEAT7Chksum_C "Behaviour control mask / Behaviour control masks of check DFC_ComEAT7Chksum" VALUE 0x804D8C3A Val_Wu16 65535.00 DFES_OneToOne 0.00 65535.00 FORMAT "%8.2" /end CHARACTERISTIC
/begin CHARACTERISTIC DFC_CtlMsk.DFC_ComEAT7RingCnt_C "Behaviour control mask / Behaviour control masks of check DFC_ComEAT7RingCnt" VALUE 0x804D8C3C Val_Wu16 65535.00 DFES_OneToOne 0.00 65535.00 FORMAT "%8.2" /end CHARACTERISTIC
/begin CHARACTERISTIC DFC_CtlMsk.DFC_ComEAT7TOut_C "Behaviour control mask / Behaviour control masks of check DFC_ComEAT7TOut" VALUE 0x804D8C3E Val_Wu16 65535.00 DFES_OneToOne 0.00 65535.00 FORMAT "%8.2" /end CHARACTERISTIC
/begin CHARACTERISTIC DFC_CtlMsk.DFC_ComEAT8Chksum_C "Behaviour control mask / Behaviour control masks of check DFC_ComEAT8Chksum" VALUE 0x804D8C40 Val_Wu16 65535.00 DFES_OneToOne 0.00 65535.00 FORMAT "%8.2" /end CHARACTERISTIC
/begin CHARACTERISTIC DFC_CtlMsk.DFC_ComEAT8RingCnt_C "Behaviour control mask / Behaviour control masks of check DFC_ComEAT8RingCnt" VALUE 0x804D8C42 Val_Wu16 65535.00 DFES_OneToOne 0.00 65535.00 FORMAT "%8.2" /end CHARACTERISTIC
/begin CHARACTERISTIC DFC_CtlMsk.DFC_ComEAT8TOut_C "Behaviour control mask / Behaviour control masks of check DFC_ComEAT8TOut" VALUE 0x804D8C44 Val_Wu16 65535.00 DFES_OneToOne 0.00 65535.00 FORMAT "%8.2" /end CHARACTERISTIC
/begin CHARACTERISTIC DFC_CtlMsk.DFC_ComEATAChksum_C "Behaviour control mask / Behaviour control masks of check DFC_ComEATAChksum" VALUE 0x804D8C46 Val_Wu16 65535.00 DFES_OneToOne 0.00 65535.00 FORMAT "%8.2" /end CHARACTERISTIC
/begin CHARACTERISTIC DFC_CtlMsk.DFC_ComEATARingCnt_C "Behaviour control mask / Behaviour control masks of check DFC_ComEATARingCnt" VALUE 0x804D8C48 Val_Wu16 65535.00 DFES_OneToOne 0.00 65535.00 FORMAT "%8.2" /end CHARACTERISTIC
/begin CHARACTERISTIC DFC_CtlMsk.DFC_ComEATATOut_C "Behaviour control mask / Behaviour control masks of check DFC_ComEATATOut" VALUE 0x804D8C4A Val_Wu16 65535.00 DFES_OneToOne 0.00 65535.00 FORMAT "%8.2" /end CHARACTERISTIC
/begin CHARACTERISTIC DFC_CtlMsk.DFC_ComEATBChkSum_C "Behaviour control mask / Behaviour control masks of check DFC_ComEATBChkSum" VALUE 0x804D8C4C Val_Wu16 65535.00 DFES_OneToOne 0.00 65535.00 FORMAT "%8.2" /end CHARACTERISTIC
/begin CHARACTERISTIC DFC_CtlMsk.DFC_ComEATBRingCnt_C "Behaviour control mask / Behaviour control masks of check DFC_ComEATBRingCnt" VALUE 0x804D8C4E Val_Wu16 65535.00 DFES_OneToOne 0.00 65535.00 FORMAT "%8.2" /end CHARACTERISTIC
/begin CHARACTERISTIC DFC_CtlMsk.DFC_ComEATBTOut_C "Behaviour control mask / Behaviour control masks of check DFC_ComEATBTOut" VALUE 0x804D8C50 Val_Wu16 65535.00 DFES_OneToOne 0.00 65535.00 FORMAT "%8.2" /end CHARACTERISTIC
/begin CHARACTERISTIC DFC_CtlMsk.DFC_ComEATCChksum_C "Behaviour control mask / Behaviour control masks of check DFC_ComEATCChksum" VALUE 0x804D8C52 Val_Wu16 65535.00 DFES_OneToOne 0.00 65535.00 FORMAT "%8.2" /end CHARACTERISTIC
/begin CHARACTERISTIC DFC_CtlMsk.DFC_ComEATCRingCnt_C "Behaviour control mask / Behaviour control masks of check DFC_ComEATCRingCnt" VALUE 0x804D8C54 Val_Wu16 65535.00 DFES_OneToOne 0.00 65535.00 FORMAT "%8.2" /end CHARACTERISTIC
/begin CHARACTERISTIC DFC_CtlMsk.DFC_ComEATCTOut_C "Behaviour control mask / Behaviour control masks of check DFC_ComEATCTOut" VALUE 0x804D8C56 Val_Wu16 65535.00 DFES_OneToOne 0.00 65535.00 FORMAT "%8.2" /end CHARACTERISTIC
/begin CHARACTERISTIC DFC_CtlMsk.DFC_ComEBBAChksum_C "Behaviour control mask / Behaviour control masks of check DFC_ComEBBAChksum" VALUE 0x804D8C58 Val_Wu16 65535.00 DFES_OneToOne 0.00 65535.00 FORMAT "%8.2" /end CHARACTERISTIC
/begin CHARACTERISTIC DFC_CtlMsk.DFC_ComEBBARingCnt_C "Behaviour control mask / Behaviour control masks of check DFC_ComEBBARingCnt" VALUE 0x804D8C5A Val_Wu16 65535.00 DFES_OneToOne 0.00 65535.00 FORMAT "%8.2" /end CHARACTERISTIC
/begin CHARACTERISTIC DFC_CtlMsk.DFC_ComEBBATOut_C "Behaviour control mask / Behaviour control masks of check DFC_ComEBBATOut" VALUE 0x804D8C5C Val_Wu16 65535.00 DFES_OneToOne 0.00 65535.00 FORMAT "%8.2" /end CHARACTERISTIC
/begin CHARACTERISTIC DFC_CtlMsk.DFC_ComEPS1Chksum_C "Behaviour control mask / Behaviour control masks of check DFC_ComEPS1Chksum" VALUE 0x804D8C5E Val_Wu16 65535.00 DFES_OneToOne 0.00 65535.00 FORMAT "%8.2" /end CHARACTERISTIC
/begin CHARACTERISTIC DFC_CtlMsk.DFC_ComEPS1RingCnt_C "Behaviour control mask / Behaviour control masks of check DFC_ComEPS1RingCnt" VALUE 0x804D8C60 Val_Wu16 65535.00 DFES_OneToOne 0.00 65535.00 FORMAT "%8.2" /end CHARACTERISTIC
/begin CHARACTERISTIC DFC_CtlMsk.DFC_ComEPS1TOut_C "Behaviour control mask / Behaviour control masks of check DFC_ComEPS1TOut" VALUE 0x804D8C62 Val_Wu16 65535.00 DFES_OneToOne 0.00 65535.00 FORMAT "%8.2" /end CHARACTERISTIC
/begin CHARACTERISTIC DFC_CtlMsk.DFC_ComEngCanRxErr_C "Behaviour control mask / Behaviour control masks of check DFC_ComEngCanRxErr" VALUE 0x804D8C64 Val_Wu16 65535.00 DFES_OneToOne 0.00 65535.00 FORMAT "%8.2" /end CHARACTERISTIC
/begin CHARACTERISTIC DFC_CtlMsk.DFC_ComGrvySnsrErr_C "Behaviour control mask / Behaviour control masks of check DFC_ComGrvySnsrErr" VALUE 0x804D8C66 Val_Wu16 65535.00 DFES_OneToOne 0.00 65535.00 FORMAT "%8.2" /end CHARACTERISTIC
/begin CHARACTERISTIC DFC_CtlMsk.DFC_ComGwIMG1ChkSum_C "Behaviour control mask / Behaviour control masks of check DFC_ComGwIMG1ChkSum" VALUE 0x804D8C68 Val_Wu16 65535.00 DFES_OneToOne 0.00 65535.00 FORMAT "%8.2" /end CHARACTERISTIC
/begin CHARACTERISTIC DFC_CtlMsk.DFC_ComGwIMG1RingCnt_C "Behaviour control mask / Behaviour control masks of check DFC_ComGwIMG1RingCnt" VALUE 0x804D8C6A Val_Wu16 65535.00 DFES_OneToOne 0.00 65535.00 FORMAT "%8.2" /end CHARACTERISTIC
/begin CHARACTERISTIC DFC_CtlMsk.DFC_ComGwIMG1TOut_C "Behaviour control mask / Behaviour control masks of check DFC_ComGwIMG1TOut" VALUE 0x804D8C6C Val_Wu16 65535.00 DFES_OneToOne 0.00 65535.00 FORMAT "%8.2" /end CHARACTERISTIC
/begin CHARACTERISTIC DFC_CtlMsk.DFC_ComGwIMG3ChkSum_C "Behaviour control mask / Behaviour control masks of check DFC_ComGwIMG3ChkSum" VALUE 0x804D8C6E Val_Wu16 65535.00 DFES_OneToOne 0.00 65535.00 FORMAT "%8.2" /end CHARACTERISTIC
/begin CHARACTERISTIC DFC_CtlMsk.DFC_ComGwIMG3RingCnt_C "Behaviour control mask / Behaviour control masks of check DFC_ComGwIMG3RingCnt" VALUE 0x804D8C70 Val_Wu16 65535.00 DFES_OneToOne 0.00 65535.00 FORMAT "%8.2" /end CHARACTERISTIC
/begin CHARACTERISTIC DFC_CtlMsk.DFC_ComGwIMG3TOut_C "Behaviour control mask / Behaviour control masks of check DFC_ComGwIMG3TOut" VALUE 0x804D8C72 Val_Wu16 65535.00 DFES_OneToOne 0.00 65535.00 FORMAT "%8.2" /end CHARACTERISTIC
/begin CHARACTERISTIC DFC_CtlMsk.DFC_ComGwIMG4ChkSum_C "Behaviour control mask / Behaviour control masks of check DFC_ComGwIMG4ChkSum" VALUE 0x804D8C74 Val_Wu16 65535.00 DFES_OneToOne 0.00 65535.00 FORMAT "%8.2" /end CHARACTERISTIC
/begin CHARACTERISTIC DFC_CtlMsk.DFC_ComGwIMG4RingCnt_C "Behaviour control mask / Behaviour control masks of check DFC_ComGwIMG4RingCnt" VALUE 0x804D8C76 Val_Wu16 65535.00 DFES_OneToOne 0.00 65535.00 FORMAT "%8.2" /end CHARACTERISTIC
/begin CHARACTERISTIC DFC_CtlMsk.DFC_ComGwIMG4TOut_C "Behaviour control mask / Behaviour control masks of check DFC_ComGwIMG4TOut" VALUE 0x804D8C78 Val_Wu16 65535.00 DFES_OneToOne 0.00 65535.00 FORMAT "%8.2" /end CHARACTERISTIC
/begin CHARACTERISTIC DFC_CtlMsk.DFC_ComGwIMG5ChkSum_C "Behaviour control mask / Behaviour control masks of check DFC_ComGwIMG5ChkSum" VALUE 0x804D8C7A Val_Wu16 65535.00 DFES_OneToOne 0.00 65535.00 FORMAT "%8.2" /end CHARACTERISTIC
/begin CHARACTERISTIC DFC_CtlMsk.DFC_ComGwIMG5RingCnt_C "Behaviour control mask / Behaviour control masks of check DFC_ComGwIMG5RingCnt" VALUE 0x804D8C7C Val_Wu16 65535.00 DFES_OneToOne 0.00 65535.00 FORMAT "%8.2" /end CHARACTERISTIC
/begin CHARACTERISTIC DFC_CtlMsk.DFC_ComGwIMG5TOut_C "Behaviour control mask / Behaviour control masks of check DFC_ComGwIMG5TOut" VALUE 0x804D8C7E Val_Wu16 65535.00 DFES_OneToOne 0.00 65535.00 FORMAT "%8.2" /end CHARACTERISTIC
/begin CHARACTERISTIC DFC_CtlMsk.DFC_ComGwIMG6ChkSum_C "Behaviour control mask / Behaviour control masks of check DFC_ComGwIMG6ChkSum" VALUE 0x804D8C80 Val_Wu16 65535.00 DFES_OneToOne 0.00 65535.00 FORMAT "%8.2" /end CHARACTERISTIC
/begin CHARACTERISTIC DFC_CtlMsk.DFC_ComGwIMG6RingCnt_C "Behaviour control mask / Behaviour control masks of check DFC_ComGwIMG6RingCnt" VALUE 0x804D8C82 Val_Wu16 65535.00 DFES_OneToOne 0.00 65535.00 FORMAT "%8.2" /end CHARACTERISTIC
/begin CHARACTERISTIC DFC_CtlMsk.DFC_ComGwIMG6TOut_C "Behaviour control mask / Behaviour control masks of check DFC_ComGwIMG6TOut" VALUE 0x804D8C84 Val_Wu16 65535.00 DFES_OneToOne 0.00 65535.00 FORMAT "%8.2" /end CHARACTERISTIC
/begin CHARACTERISTIC DFC_CtlMsk.DFC_ComIDASBChksum_C "Behaviour control mask / Behaviour control masks of check DFC_ComIDASBChksum" VALUE 0x804D8C86 Val_Wu16 65535.00 DFES_OneToOne 0.00 65535.00 FORMAT "%8.2" /end CHARACTERISTIC
/begin CHARACTERISTIC DFC_CtlMsk.DFC_ComIDASBRingCnt_C "Behaviour control mask / Behaviour control masks of check DFC_ComIDASBRingCnt" VALUE 0x804D8C88 Val_Wu16 65535.00 DFES_OneToOne 0.00 65535.00 FORMAT "%8.2" /end CHARACTERISTIC
/begin CHARACTERISTIC DFC_CtlMsk.DFC_ComIDASBTOut_C "Behaviour control mask / Behaviour control masks of check DFC_ComIDASBTOut" VALUE 0x804D8C8A Val_Wu16 65535.00 DFES_OneToOne 0.00 65535.00 FORMAT "%8.2" /end CHARACTERISTIC
/begin CHARACTERISTIC DFC_CtlMsk.DFC_ComIMGMILReq_C "Behaviour control mask / Behaviour control masks of check DFC_ComIMGMILReq" VALUE 0x804D8C8C Val_Wu16 65535.00 DFES_OneToOne 0.00 65535.00 FORMAT "%8.2" /end CHARACTERISTIC
/begin CHARACTERISTIC DFC_CtlMsk.DFC_ComISSPrms_C "Behaviour control mask / Behaviour control masks of check DFC_ComISSPrms" VALUE 0x804D8C8E Val_Wu16 65535.00 DFES_OneToOne 0.00 65535.00 FORMAT "%8.2" /end CHARACTERISTIC
/begin CHARACTERISTIC DFC_CtlMsk.DFC_ComMETAChksum_C "Behaviour control mask / Behaviour control masks of check DFC_ComMETAChksum" VALUE 0x804D8C90 Val_Wu16 65535.00 DFES_OneToOne 0.00 65535.00 FORMAT "%8.2" /end CHARACTERISTIC
/begin CHARACTERISTIC DFC_CtlMsk.DFC_ComMETARingCnt_C "Behaviour control mask / Behaviour control masks of check DFC_ComMETARingCnt" VALUE 0x804D8C92 Val_Wu16 65535.00 DFES_OneToOne 0.00 65535.00 FORMAT "%8.2" /end CHARACTERISTIC
/begin CHARACTERISTIC DFC_CtlMsk.DFC_ComMETATOut_C "Behaviour control mask / Behaviour control masks of check DFC_ComMETATOut" VALUE 0x804D8C94 Val_Wu16 65535.00 DFES_OneToOne 0.00 65535.00 FORMAT "%8.2" /end CHARACTERISTIC
/begin CHARACTERISTIC DFC_CtlMsk.DFC_ComMETCChksum_C "Behaviour control mask / Behaviour control masks of check DFC_ComMETCChksum" VALUE 0x804D8C96 Val_Wu16 65535.00 DFES_OneToOne 0.00 65535.00 FORMAT "%8.2" /end CHARACTERISTIC
/begin CHARACTERISTIC DFC_CtlMsk.DFC_ComMETCRingCnt_C "Behaviour control mask / Behaviour control masks of check DFC_ComMETCRingCnt" VALUE 0x804D8C98 Val_Wu16 65535.00 DFES_OneToOne 0.00 65535.00 FORMAT "%8.2" /end CHARACTERISTIC
/begin CHARACTERISTIC DFC_CtlMsk.DFC_ComMETCTOut_C "Behaviour control mask / Behaviour control masks of check DFC_ComMETCTOut" VALUE 0x804D8C9A Val_Wu16 65535.00 DFES_OneToOne 0.00 65535.00 FORMAT "%8.2" /end CHARACTERISTIC
/begin CHARACTERISTIC DFC_CtlMsk.DFC_ComMETDChksum_C "Behaviour control mask / Behaviour control masks of check DFC_ComMETDChksum" VALUE 0x804D8C9C Val_Wu16 65535.00 DFES_OneToOne 0.00 65535.00 FORMAT "%8.2" /end CHARACTERISTIC
/begin CHARACTERISTIC DFC_CtlMsk.DFC_ComMETDRingCnt_C "Behaviour control mask / Behaviour control masks of check DFC_ComMETDRingCnt" VALUE 0x804D8C9E Val_Wu16 65535.00 DFES_OneToOne 0.00 65535.00 FORMAT "%8.2" /end CHARACTERISTIC
/begin CHARACTERISTIC DFC_CtlMsk.DFC_ComMETDTOut_C "Behaviour control mask / Behaviour control masks of check DFC_ComMETDTOut" VALUE 0x804D8CA0 Val_Wu16 65535.00 DFES_OneToOne 0.00 65535.00 FORMAT "%8.2" /end CHARACTERISTIC
/begin CHARACTERISTIC DFC_CtlMsk.DFC_ComMETE2Chksum_C "Behaviour control mask / Behaviour control masks of check DFC_ComMETE2Chksum" VALUE 0x804D8CA2 Val_Wu16 65535.00 DFES_OneToOne 0.00 65535.00 FORMAT "%8.2" /end CHARACTERISTIC
/begin CHARACTERISTIC DFC_CtlMsk.DFC_ComMETE2RingCnt_C "Behaviour control mask / Behaviour control masks of check DFC_ComMETE2RingCnt" VALUE 0x804D8CA4 Val_Wu16 65535.00 DFES_OneToOne 0.00 65535.00 FORMAT "%8.2" /end CHARACTERISTIC
/begin CHARACTERISTIC DFC_CtlMsk.DFC_ComMETE2TOut_C "Behaviour control mask / Behaviour control masks of check DFC_ComMETE2TOut" VALUE 0x804D8CA6 Val_Wu16 65535.00 DFES_OneToOne 0.00 65535.00 FORMAT "%8.2" /end CHARACTERISTIC
/begin CHARACTERISTIC DFC_CtlMsk.DFC_ComMETFChksum_C "Behaviour control mask / Behaviour control masks of check DFC_ComMETFChksum" VALUE 0x804D8CA8 Val_Wu16 65535.00 DFES_OneToOne 0.00 65535.00 FORMAT "%8.2" /end CHARACTERISTIC
/begin CHARACTERISTIC DFC_CtlMsk.DFC_ComMETFRingCnt_C "Behaviour control mask / Behaviour control masks of check DFC_ComMETFRingCnt" VALUE 0x804D8CAA Val_Wu16 65535.00 DFES_OneToOne 0.00 65535.00 FORMAT "%8.2" /end CHARACTERISTIC
/begin CHARACTERISTIC DFC_CtlMsk.DFC_ComMETFTOut_C "Behaviour control mask / Behaviour control masks of check DFC_ComMETFTOut" VALUE 0x804D8CAC Val_Wu16 65535.00 DFES_OneToOne 0.00 65535.00 FORMAT "%8.2" /end CHARACTERISTIC
/begin CHARACTERISTIC DFC_CtlMsk.DFC_ComMETGChksum_C "Behaviour control mask / Behaviour control masks of check DFC_ComMETGChksum" VALUE 0x804D8CAE Val_Wu16 65535.00 DFES_OneToOne 0.00 65535.00 FORMAT "%8.2" /end CHARACTERISTIC
/begin CHARACTERISTIC DFC_CtlMsk.DFC_ComMETGRingCnt_C "Behaviour control mask / Behaviour control masks of check DFC_ComMETGRingCnt" VALUE 0x804D8CB0 Val_Wu16 65535.00 DFES_OneToOne 0.00 65535.00 FORMAT "%8.2" /end CHARACTERISTIC
/begin CHARACTERISTIC DFC_CtlMsk.DFC_ComMETGTOut_C "Behaviour control mask / Behaviour control masks of check DFC_ComMETGTOut" VALUE 0x804D8CB2 Val_Wu16 65535.00 DFES_OneToOne 0.00 65535.00 FORMAT "%8.2" /end CHARACTERISTIC
/begin CHARACTERISTIC DFC_CtlMsk.DFC_ComMETH2Chksum_C "Behaviour control mask / Behaviour control masks of check DFC_ComMETH2Chksum" VALUE 0x804D8CB4 Val_Wu16 65535.00 DFES_OneToOne 0.00 65535.00 FORMAT "%8.2" /end CHARACTERISTIC
/begin CHARACTERISTIC DFC_CtlMsk.DFC_ComMETH2RingCnt_C "Behaviour control mask / Behaviour control masks of check DFC_ComMETH2RingCnt" VALUE 0x804D8CB6 Val_Wu16 65535.00 DFES_OneToOne 0.00 65535.00 FORMAT "%8.2" /end CHARACTERISTIC
/begin CHARACTERISTIC DFC_CtlMsk.DFC_ComMETH2TOut_C "Behaviour control mask / Behaviour control masks of check DFC_ComMETH2TOut" VALUE 0x804D8CB8 Val_Wu16 65535.00 DFES_OneToOne 0.00 65535.00 FORMAT "%8.2" /end CHARACTERISTIC
/begin CHARACTERISTIC DFC_CtlMsk.DFC_ComMETHChksum_C "Behaviour control mask / Behaviour control masks of check DFC_ComMETHChksum" VALUE 0x804D8CBA Val_Wu16 65535.00 DFES_OneToOne 0.00 65535.00 FORMAT "%8.2" /end CHARACTERISTIC
/begin CHARACTERISTIC DFC_CtlMsk.DFC_ComMETHRingCnt_C "Behaviour control mask / Behaviour control masks of check DFC_ComMETHRingCnt" VALUE 0x804D8CBC Val_Wu16 65535.00 DFES_OneToOne 0.00 65535.00 FORMAT "%8.2" /end CHARACTERISTIC
/begin CHARACTERISTIC DFC_CtlMsk.DFC_ComMETHTOut_C "Behaviour control mask / Behaviour control masks of check DFC_ComMETHTOut" VALUE 0x804D8CBE Val_Wu16 65535.00 DFES_OneToOne 0.00 65535.00 FORMAT "%8.2" /end CHARACTERISTIC
/begin CHARACTERISTIC DFC_CtlMsk.DFC_ComMETIChksum_C "Behaviour control mask / Behaviour control masks of check DFC_ComMETIChksum" VALUE 0x804D8CC0 Val_Wu16 65535.00 DFES_OneToOne 0.00 65535.00 FORMAT "%8.2" /end CHARACTERISTIC
/begin CHARACTERISTIC DFC_CtlMsk.DFC_ComMETIRingCnt_C "Behaviour control mask / Behaviour control masks of check DFC_ComMETIRingCnt" VALUE 0x804D8CC2 Val_Wu16 65535.00 DFES_OneToOne 0.00 65535.00 FORMAT "%8.2" /end CHARACTERISTIC
/begin CHARACTERISTIC DFC_CtlMsk.DFC_ComMETITOut_C "Behaviour control mask / Behaviour control masks of check DFC_ComMETITOut" VALUE 0x804D8CC4 Val_Wu16 65535.00 DFES_OneToOne 0.00 65535.00 FORMAT "%8.2" /end CHARACTERISTIC
/begin CHARACTERISTIC DFC_CtlMsk.DFC_ComMETKChksum_C "Behaviour control mask / Behaviour control masks of check DFC_ComMETKChksum" VALUE 0x804D8CC6 Val_Wu16 65535.00 DFES_OneToOne 0.00 65535.00 FORMAT "%8.2" /end CHARACTERISTIC
/begin CHARACTERISTIC DFC_CtlMsk.DFC_ComMETKRingCnt_C "Behaviour control mask / Behaviour control masks of check DFC_ComMETKRingCnt" VALUE 0x804D8CC8 Val_Wu16 65535.00 DFES_OneToOne 0.00 65535.00 FORMAT "%8.2" /end CHARACTERISTIC
/begin CHARACTERISTIC DFC_CtlMsk.DFC_ComMETKTOut_C "Behaviour control mask / Behaviour control masks of check DFC_ComMETKTOut" VALUE 0x804D8CCA Val_Wu16 65535.00 DFES_OneToOne 0.00 65535.00 FORMAT "%8.2" /end CHARACTERISTIC
/begin CHARACTERISTIC DFC_CtlMsk.DFC_ComMETLChksum_C "Behaviour control mask / Behaviour control masks of check DFC_ComMETLChksum" VALUE 0x804D8CCC Val_Wu16 65535.00 DFES_OneToOne 0.00 65535.00 FORMAT "%8.2" /end CHARACTERISTIC
/begin CHARACTERISTIC DFC_CtlMsk.DFC_ComMETLRingCnt_C "Behaviour control mask / Behaviour control masks of check DFC_ComMETLRingCnt" VALUE 0x804D8CCE Val_Wu16 65535.00 DFES_OneToOne 0.00 65535.00 FORMAT "%8.2" /end CHARACTERISTIC
/begin CHARACTERISTIC DFC_CtlMsk.DFC_ComMETLTOut_C "Behaviour control mask / Behaviour control masks of check DFC_ComMETLTOut" VALUE 0x804D8CD0 Val_Wu16 65535.00 DFES_OneToOne 0.00 65535.00 FORMAT "%8.2" /end CHARACTERISTIC
/begin CHARACTERISTIC DFC_CtlMsk.DFC_ComMETMChksum_C "Behaviour control mask / Behaviour control masks of check DFC_ComMETMChksum" VALUE 0x804D8CD2 Val_Wu16 65535.00 DFES_OneToOne 0.00 65535.00 FORMAT "%8.2" /end CHARACTERISTIC
/begin CHARACTERISTIC DFC_CtlMsk.DFC_ComMETMRingCnt_C "Behaviour control mask / Behaviour control masks of check DFC_ComMETMRingCnt" VALUE 0x804D8CD4 Val_Wu16 65535.00 DFES_OneToOne 0.00 65535.00 FORMAT "%8.2" /end CHARACTERISTIC
/begin CHARACTERISTIC DFC_CtlMsk.DFC_ComMETMTOut_C "Behaviour control mask / Behaviour control masks of check DFC_ComMETMTOut" VALUE 0x804D8CD6 Val_Wu16 65535.00 DFES_OneToOne 0.00 65535.00 FORMAT "%8.2" /end CHARACTERISTIC
/begin CHARACTERISTIC DFC_CtlMsk.DFC_ComMETNChksum_C "Behaviour control mask / Behaviour control masks of check DFC_ComMETNChksum" VALUE 0x804D8CD8 Val_Wu16 65535.00 DFES_OneToOne 0.00 65535.00 FORMAT "%8.2" /end CHARACTERISTIC
/begin CHARACTERISTIC DFC_CtlMsk.DFC_ComMETNRingCnt_C "Behaviour control mask / Behaviour control masks of check DFC_ComMETNRingCnt" VALUE 0x804D8CDA Val_Wu16 65535.00 DFES_OneToOne 0.00 65535.00 FORMAT "%8.2" /end CHARACTERISTIC
/begin CHARACTERISTIC DFC_CtlMsk.DFC_ComMETNTOut_C "Behaviour control mask / Behaviour control masks of check DFC_ComMETNTOut" VALUE 0x804D8CDC Val_Wu16 65535.00 DFES_OneToOne 0.00 65535.00 FORMAT "%8.2" /end CHARACTERISTIC
/begin CHARACTERISTIC DFC_CtlMsk.DFC_ComMtrCom_C "Behaviour control mask / Behaviour control masks of check DFC_ComMtrCom" VALUE 0x804D8CDE Val_Wu16 65535.00 DFES_OneToOne 0.00 65535.00 FORMAT "%8.2" /end CHARACTERISTIC
/begin CHARACTERISTIC DFC_CtlMsk.DFC_ComPCUChkSum_C "Behaviour control mask / Behaviour control masks of check DFC_ComPCUChkSum" VALUE 0x804D8CE0 Val_Wu16 65535.00 DFES_OneToOne 0.00 65535.00 FORMAT "%8.2" /end CHARACTERISTIC
/begin CHARACTERISTIC DFC_CtlMsk.DFC_ComPCURingCnt_C "Behaviour control mask / Behaviour control masks of check DFC_ComPCURingCnt" VALUE 0x804D8CE2 Val_Wu16 65535.00 DFES_OneToOne 0.00 65535.00 FORMAT "%8.2" /end CHARACTERISTIC
/begin CHARACTERISTIC DFC_CtlMsk.DFC_ComPCUTOut_C "Behaviour control mask / Behaviour control masks of check DFC_ComPCUTOut" VALUE 0x804D8CE4 Val_Wu16 65535.00 DFES_OneToOne 0.00 65535.00 FORMAT "%8.2" /end CHARACTERISTIC
/begin CHARACTERISTIC DFC_CtlMsk.DFC_ComSRSAChksum_C "Behaviour control mask / Behaviour control masks of check DFC_ComSRSAChksum" VALUE 0x804D8CE6 Val_Wu16 65535.00 DFES_OneToOne 0.00 65535.00 FORMAT "%8.2" /end CHARACTERISTIC
/begin CHARACTERISTIC DFC_CtlMsk.DFC_ComSRSARingCnt_C "Behaviour control mask / Behaviour control masks of check DFC_ComSRSARingCnt" VALUE 0x804D8CE8 Val_Wu16 65535.00 DFES_OneToOne 0.00 65535.00 FORMAT "%8.2" /end CHARACTERISTIC
/begin CHARACTERISTIC DFC_CtlMsk.DFC_ComSRSATOut_C "Behaviour control mask / Behaviour control masks of check DFC_ComSRSATOut" VALUE 0x804D8CEA Val_Wu16 65535.00 DFES_OneToOne 0.00 65535.00 FORMAT "%8.2" /end CHARACTERISTIC
/begin CHARACTERISTIC DFC_CtlMsk.DFC_ComSRSBChksum_C "Behaviour control mask / Behaviour control masks of check DFC_ComSRSBChksum" VALUE 0x804D8CEC Val_Wu16 65535.00 DFES_OneToOne 0.00 65535.00 FORMAT "%8.2" /end CHARACTERISTIC
/begin CHARACTERISTIC DFC_CtlMsk.DFC_ComSRSBRingCnt_C "Behaviour control mask / Behaviour control masks of check DFC_ComSRSBRingCnt" VALUE 0x804D8CEE Val_Wu16 65535.00 DFES_OneToOne 0.00 65535.00 FORMAT "%8.2" /end CHARACTERISTIC
/begin CHARACTERISTIC DFC_CtlMsk.DFC_ComSRSBTOut_C "Behaviour control mask / Behaviour control masks of check DFC_ComSRSBTOut" VALUE 0x804D8CF0 Val_Wu16 65535.00 DFES_OneToOne 0.00 65535.00 FORMAT "%8.2" /end CHARACTERISTIC
/begin CHARACTERISTIC DFC_CtlMsk.DFC_ComSRSChksum_C "Behaviour control mask / Behaviour control masks of check DFC_ComSRSChksum" VALUE 0x804D8CF2 Val_Wu16 65535.00 DFES_OneToOne 0.00 65535.00 FORMAT "%8.2" /end CHARACTERISTIC
/begin CHARACTERISTIC DFC_CtlMsk.DFC_ComSRSErr_C "Behaviour control mask / Behaviour control masks of check DFC_ComSRSErr" VALUE 0x804D8CF4 Val_Wu16 65535.00 DFES_OneToOne 0.00 65535.00 FORMAT "%8.2" /end CHARACTERISTIC
/begin CHARACTERISTIC DFC_CtlMsk.DFC_ComSRSRingCnt_C "Behaviour control mask / Behaviour control masks of check DFC_ComSRSRingCnt" VALUE 0x804D8CF6 Val_Wu16 65535.00 DFES_OneToOne 0.00 65535.00 FORMAT "%8.2" /end CHARACTERISTIC
/begin CHARACTERISTIC DFC_CtlMsk.DFC_ComSRSTOut_C "Behaviour control mask / Behaviour control masks of check DFC_ComSRSTOut" VALUE 0x804D8CF8 Val_Wu16 65535.00 DFES_OneToOne 0.00 65535.00 FORMAT "%8.2" /end CHARACTERISTIC
/begin CHARACTERISTIC DFC_CtlMsk.DFC_ComVehSpdPndFltTCU_C "Behaviour control mask / Behaviour control masks of check DFC_ComVehSpdPndFltTCU" VALUE 0x804D8CFA Val_Wu16 65535.00 DFES_OneToOne 0.00 65535.00 FORMAT "%8.2" /end CHARACTERISTIC
/begin CHARACTERISTIC DFC_CtlMsk.DFC_EbsChartcCurrErr_C "Behaviour control mask / Behaviour control masks of check DFC_EbsChartcCurrErr" VALUE 0x804D8CFC Val_Wu16 65535.00 DFES_OneToOne 0.00 65535.00 FORMAT "%8.2" /end CHARACTERISTIC
/begin CHARACTERISTIC DFC_CtlMsk.DFC_EbsSelfDiagErr_C "Behaviour control mask / Behaviour control masks of check DFC_EbsSelfDiagErr" VALUE 0x804D8CFE Val_Wu16 65535.00 DFES_OneToOne 0.00 65535.00 FORMAT "%8.2" /end CHARACTERISTIC
/begin CHARACTERISTIC DFC_CtlMsk.DFC_GbxCANDigPlausErr_C "Behaviour control mask / Behaviour control masks of check DFC_GbxCANDigPlausErr" VALUE 0x804D8D00 Val_Wu16 65535.00 DFES_OneToOne 0.00 65535.00 FORMAT "%8.2" /end CHARACTERISTIC
/begin CHARACTERISTIC DFC_CtlMsk.DFC_GbxNPos1SRCMax_C "Behaviour control mask / Behaviour control masks of check DFC_GbxNPos1SRCMax" VALUE 0x804D8D02 Val_Wu16 65535.00 DFES_OneToOne 0.00 65535.00 FORMAT "%8.2" /end CHARACTERISTIC
/begin CHARACTERISTIC DFC_CtlMsk.DFC_GbxNPos1SRCMin_C "Behaviour control mask / Behaviour control masks of check DFC_GbxNPos1SRCMin" VALUE 0x804D8D04 Val_Wu16 65535.00 DFES_OneToOne 0.00 65535.00 FORMAT "%8.2" /end CHARACTERISTIC
/begin CHARACTERISTIC DFC_CtlMsk.DFC_GbxNPos2SRCMax_C "Behaviour control mask / Behaviour control masks of check DFC_GbxNPos2SRCMax" VALUE 0x804D8D06 Val_Wu16 65535.00 DFES_OneToOne 0.00 65535.00 FORMAT "%8.2" /end CHARACTERISTIC
/begin CHARACTERISTIC DFC_CtlMsk.DFC_GbxNPos2SRCMin_C "Behaviour control mask / Behaviour control masks of check DFC_GbxNPos2SRCMin" VALUE 0x804D8D08 Val_Wu16 65535.00 DFES_OneToOne 0.00 65535.00 FORMAT "%8.2" /end CHARACTERISTIC
/begin CHARACTERISTIC DFC_CtlMsk.DFC_GbxNPosAlvChk_C "Behaviour control mask / Behaviour control masks of check DFC_GbxNPosAlvChk" VALUE 0x804D8D0A Val_Wu16 65535.00 DFES_OneToOne 0.00 65535.00 FORMAT "%8.2" /end CHARACTERISTIC
/begin CHARACTERISTIC DFC_CtlMsk.DFC_GbxNPosSyncErr_C "Behaviour control mask / Behaviour control masks of check DFC_GbxNPosSyncErr" VALUE 0x804D8D0C Val_Wu16 65535.00 DFES_OneToOne 0.00 65535.00 FORMAT "%8.2" /end CHARACTERISTIC
/begin CHARACTERISTIC DFC_CtlMsk.DFC_HEGOS2B1HtrPsMax_C "Behaviour control mask / Behaviour control masks of check DFC_HEGOS2B1HtrPsMax" VALUE 0x804D8D0E Val_Wu16 65535.00 DFES_OneToOne 0.00 65535.00 FORMAT "%8.2" /end CHARACTERISTIC
/begin CHARACTERISTIC DFC_CtlMsk.DFC_HEGOS2B1HtrPsMin_C "Behaviour control mask / Behaviour control masks of check DFC_HEGOS2B1HtrPsMin" VALUE 0x804D8D10 Val_Wu16 65535.00 DFES_OneToOne 0.00 65535.00 FORMAT "%8.2" /end CHARACTERISTIC
/begin CHARACTERISTIC DFC_CtlMsk.DFC_HEGOS2B1HtrPsSig_C "Behaviour control mask / Behaviour control masks of check DFC_HEGOS2B1HtrPsSig" VALUE 0x804D8D12 Val_Wu16 65535.00 DFES_OneToOne 0.00 65535.00 FORMAT "%8.2" /end CHARACTERISTIC
/begin CHARACTERISTIC DFC_CtlMsk.DFC_LinCSErrACG_C "Behaviour control mask / Behaviour control masks of check DFC_LinCSErrACG" VALUE 0x804D8D14 Val_Wu16 65535.00 DFES_OneToOne 0.00 65535.00 FORMAT "%8.2" /end CHARACTERISTIC
/begin CHARACTERISTIC DFC_CtlMsk.DFC_LinCSErrEBS_C "Behaviour control mask / Behaviour control masks of check DFC_LinCSErrEBS" VALUE 0x804D8D16 Val_Wu16 65535.00 DFES_OneToOne 0.00 65535.00 FORMAT "%8.2" /end CHARACTERISTIC
/begin CHARACTERISTIC DFC_CtlMsk.DFC_LinHdrTimeoutErrACG_C "Behaviour control mask / Behaviour control masks of check DFC_LinHdrTimeoutErrACG" VALUE 0x804D8D18 Val_Wu16 65535.00 DFES_OneToOne 0.00 65535.00 FORMAT "%8.2" /end CHARACTERISTIC
/begin CHARACTERISTIC DFC_CtlMsk.DFC_LinHdrTimeoutErrEBS_C "Behaviour control mask / Behaviour control masks of check DFC_LinHdrTimeoutErrEBS" VALUE 0x804D8D1A Val_Wu16 65535.00 DFES_OneToOne 0.00 65535.00 FORMAT "%8.2" /end CHARACTERISTIC
/begin CHARACTERISTIC DFC_CtlMsk.DFC_LinMsgTimeoutErrACG_C "Behaviour control mask / Behaviour control masks of check DFC_LinMsgTimeoutErrACG" VALUE 0x804D8D1C Val_Wu16 65535.00 DFES_OneToOne 0.00 65535.00 FORMAT "%8.2" /end CHARACTERISTIC
/begin CHARACTERISTIC DFC_CtlMsk.DFC_LinMsgTimeoutErrEBS_C "Behaviour control mask / Behaviour control masks of check DFC_LinMsgTimeoutErrEBS" VALUE 0x804D8D1E Val_Wu16 65535.00 DFES_OneToOne 0.00 65535.00 FORMAT "%8.2" /end CHARACTERISTIC
/begin CHARACTERISTIC DFC_CtlMsk.DFC_LinNoStrtComErr_C "Behaviour control mask / Behaviour control masks of check DFC_LinNoStrtComErr" VALUE 0x804D8D20 Val_Wu16 65535.00 DFES_OneToOne 0.00 65535.00 FORMAT "%8.2" /end CHARACTERISTIC
/begin CHARACTERISTIC DFC_CtlMsk.DFC_MisfDetVWhlFrntLeOORHi_C "Behaviour control mask / Behaviour control masks of check DFC_MisfDetVWhlFrntLeOORHi" VALUE 0x804D8D22 Val_Wu16 65535.00 DFES_OneToOne 0.00 65535.00 FORMAT "%8.2" /end CHARACTERISTIC
/begin CHARACTERISTIC DFC_CtlMsk.DFC_MisfDetVWhlFrntLeRatyHi_C "Behaviour control mask / Behaviour control masks of check DFC_MisfDetVWhlFrntLeRatyHi" VALUE 0x804D8D24 Val_Wu16 65535.00 DFES_OneToOne 0.00 65535.00 FORMAT "%8.2" /end CHARACTERISTIC
/begin CHARACTERISTIC DFC_CtlMsk.DFC_MisfDetVWhlFrntLeRatyLo_C "Behaviour control mask / Behaviour control masks of check DFC_MisfDetVWhlFrntLeRatyLo" VALUE 0x804D8D26 Val_Wu16 65535.00 DFES_OneToOne 0.00 65535.00 FORMAT "%8.2" /end CHARACTERISTIC
/begin CHARACTERISTIC DFC_CtlMsk.DFC_MisfDetVWhlFrntLeStuck_C "Behaviour control mask / Behaviour control masks of check DFC_MisfDetVWhlFrntLeStuck" VALUE 0x804D8D28 Val_Wu16 65535.00 DFES_OneToOne 0.00 65535.00 FORMAT "%8.2" /end CHARACTERISTIC
/begin CHARACTERISTIC DFC_CtlMsk.DFC_MisfDetVWhlFrntRiOORHi_C "Behaviour control mask / Behaviour control masks of check DFC_MisfDetVWhlFrntRiOORHi" VALUE 0x804D8D2A Val_Wu16 65535.00 DFES_OneToOne 0.00 65535.00 FORMAT "%8.2" /end CHARACTERISTIC
/begin CHARACTERISTIC DFC_CtlMsk.DFC_MisfDetVWhlFrntRiRatyHi_C "Behaviour control mask / Behaviour control masks of check DFC_MisfDetVWhlFrntRiRatyHi" VALUE 0x804D8D2C Val_Wu16 65535.00 DFES_OneToOne 0.00 65535.00 FORMAT "%8.2" /end CHARACTERISTIC
/begin CHARACTERISTIC DFC_CtlMsk.DFC_MisfDetVWhlFrntRiRatyLo_C "Behaviour control mask / Behaviour control masks of check DFC_MisfDetVWhlFrntRiRatyLo" VALUE 0x804D8D2E Val_Wu16 65535.00 DFES_OneToOne 0.00 65535.00 FORMAT "%8.2" /end CHARACTERISTIC
/begin CHARACTERISTIC DFC_CtlMsk.DFC_MisfDetVWhlFrntRiStuck_C "Behaviour control mask / Behaviour control masks of check DFC_MisfDetVWhlFrntRiStuck" VALUE 0x804D8D30 Val_Wu16 65535.00 DFES_OneToOne 0.00 65535.00 FORMAT "%8.2" /end CHARACTERISTIC
/begin CHARACTERISTIC DFC_CtlMsk.DFC_MisfDetVWhlReLeOORHi_C "Behaviour control mask / Behaviour control masks of check DFC_MisfDetVWhlReLeOORHi" VALUE 0x804D8D32 Val_Wu16 65535.00 DFES_OneToOne 0.00 65535.00 FORMAT "%8.2" /end CHARACTERISTIC
/begin CHARACTERISTIC DFC_CtlMsk.DFC_MisfDetVWhlReLeRatyHi_C "Behaviour control mask / Behaviour control masks of check DFC_MisfDetVWhlReLeRatyHi" VALUE 0x804D8D34 Val_Wu16 65535.00 DFES_OneToOne 0.00 65535.00 FORMAT "%8.2" /end CHARACTERISTIC
/begin CHARACTERISTIC DFC_CtlMsk.DFC_MisfDetVWhlReLeRatyLo_C "Behaviour control mask / Behaviour control masks of check DFC_MisfDetVWhlReLeRatyLo" VALUE 0x804D8D36 Val_Wu16 65535.00 DFES_OneToOne 0.00 65535.00 FORMAT "%8.2" /end CHARACTERISTIC
/begin CHARACTERISTIC DFC_CtlMsk.DFC_MisfDetVWhlReLeStuck_C "Behaviour control mask / Behaviour control masks of check DFC_MisfDetVWhlReLeStuck" VALUE 0x804D8D38 Val_Wu16 65535.00 DFES_OneToOne 0.00 65535.00 FORMAT "%8.2" /end CHARACTERISTIC
/begin CHARACTERISTIC DFC_CtlMsk.DFC_MisfDetVWhlReRiOORHi_C "Behaviour control mask / Behaviour control masks of check DFC_MisfDetVWhlReRiOORHi" VALUE 0x804D8D3A Val_Wu16 65535.00 DFES_OneToOne 0.00 65535.00 FORMAT "%8.2" /end CHARACTERISTIC
/begin CHARACTERISTIC DFC_CtlMsk.DFC_MisfDetVWhlReRiRatyHi_C "Behaviour control mask / Behaviour control masks of check DFC_MisfDetVWhlReRiRatyHi" VALUE 0x804D8D3C Val_Wu16 65535.00 DFES_OneToOne 0.00 65535.00 FORMAT "%8.2" /end CHARACTERISTIC
/begin CHARACTERISTIC DFC_CtlMsk.DFC_MisfDetVWhlReRiRatyLo_C "Behaviour control mask / Behaviour control masks of check DFC_MisfDetVWhlReRiRatyLo" VALUE 0x804D8D3E Val_Wu16 65535.00 DFES_OneToOne 0.00 65535.00 FORMAT "%8.2" /end CHARACTERISTIC
/begin CHARACTERISTIC DFC_CtlMsk.DFC_MisfDetVWhlReRiStuck_C "Behaviour control mask / Behaviour control masks of check DFC_MisfDetVWhlReRiStuck" VALUE 0x804D8D40 Val_Wu16 65535.00 DFES_OneToOne 0.00 65535.00 FORMAT "%8.2" /end CHARACTERISTIC
/begin CHARACTERISTIC DFC_CtlMsk.DFC_MisfDetdVWhlFrntLePlaus_C "Behaviour control mask / Behaviour control masks of check DFC_MisfDetdVWhlFrntLePlaus" VALUE 0x804D8D42 Val_Wu16 65535.00 DFES_OneToOne 0.00 65535.00 FORMAT "%8.2" /end CHARACTERISTIC
/begin CHARACTERISTIC DFC_CtlMsk.DFC_MisfDetdVWhlFrntRiPlaus_C "Behaviour control mask / Behaviour control masks of check DFC_MisfDetdVWhlFrntRiPlaus" VALUE 0x804D8D44 Val_Wu16 65535.00 DFES_OneToOne 0.00 65535.00 FORMAT "%8.2" /end CHARACTERISTIC
/begin CHARACTERISTIC DFC_CtlMsk.DFC_MisfDetdVWhlReLePlaus_C "Behaviour control mask / Behaviour control masks of check DFC_MisfDetdVWhlReLePlaus" VALUE 0x804D8D46 Val_Wu16 65535.00 DFES_OneToOne 0.00 65535.00 FORMAT "%8.2" /end CHARACTERISTIC
/begin CHARACTERISTIC DFC_CtlMsk.DFC_MisfDetdVWhlReRiPlaus_C "Behaviour control mask / Behaviour control masks of check DFC_MisfDetdVWhlReRiPlaus" VALUE 0x804D8D48 Val_Wu16 65535.00 DFES_OneToOne 0.00 65535.00 FORMAT "%8.2" /end CHARACTERISTIC
/begin CHARACTERISTIC DFC_CtlMsk.DFC_PEnvSigRngMax_C "Behaviour control mask / Behaviour control masks of check DFC_PEnvSigRngMax" VALUE 0x804D8D4A Val_Wu16 65535.00 DFES_OneToOne 0.00 65535.00 FORMAT "%8.2" /end CHARACTERISTIC
/begin CHARACTERISTIC DFC_CtlMsk.DFC_PEnvSigRngMin_C "Behaviour control mask / Behaviour control masks of check DFC_PEnvSigRngMin" VALUE 0x804D8D4C Val_Wu16 65535.00 DFES_OneToOne 0.00 65535.00 FORMAT "%8.2" /end CHARACTERISTIC
/begin CHARACTERISTIC DFC_CtlMsk.DFC_StmFault_C "Behaviour control mask / Behaviour control masks of check DFC_StmFault" VALUE 0x804D8D4E Val_Wu16 65535.00 DFES_OneToOne 0.00 65535.00 FORMAT "%8.2" /end CHARACTERISTIC
/begin CHARACTERISTIC DFC_CtlMsk.DFC_StrtCtOffPth_C "Behaviour control mask / Behaviour control masks of check DFC_StrtCtOffPth" VALUE 0x804D8D50 Val_Wu16 65535.00 DFES_OneToOne 0.00 65535.00 FORMAT "%8.2" /end CHARACTERISTIC
/begin CHARACTERISTIC DFC_CtlMsk.DFC_StrtCtlErr_C "Behaviour control mask / Behaviour control masks of check DFC_StrtCtlErr" VALUE 0x804D8D52 Val_Wu16 65535.00 DFES_OneToOne 0.00 65535.00 FORMAT "%8.2" /end CHARACTERISTIC
/begin CHARACTERISTIC DFC_CtlMsk.DFC_StrtFault_C "Behaviour control mask / Behaviour control masks of check DFC_StrtFault" VALUE 0x804D8D54 Val_Wu16 65535.00 DFES_OneToOne 0.00 65535.00 FORMAT "%8.2" /end CHARACTERISTIC
/begin CHARACTERISTIC DFC_CtlMsk.DFC_StrtLckJudg1_C "Behaviour control mask / Behaviour control masks of check DFC_StrtLckJudg1" VALUE 0x804D8D56 Val_Wu16 65535.00 DFES_OneToOne 0.00 65535.00 FORMAT "%8.2" /end CHARACTERISTIC
/begin CHARACTERISTIC DFC_CtlMsk.DFC_StrtLckJudg2_C "Behaviour control mask / Behaviour control masks of check DFC_StrtLckJudg2" VALUE 0x804D8D58 Val_Wu16 65535.00 DFES_OneToOne 0.00 65535.00 FORMAT "%8.2" /end CHARACTERISTIC
/begin CHARACTERISTIC DFC_CtlMsk.DFC_StrtOL_C "Behaviour control mask / Behaviour control masks of check DFC_StrtOL" VALUE 0x804D8D5A Val_Wu16 65535.00 DFES_OneToOne 0.00 65535.00 FORMAT "%8.2" /end CHARACTERISTIC
/begin CHARACTERISTIC DFC_CtlMsk.DFC_StrtOL2_C "Behaviour control mask / Behaviour control masks of check DFC_StrtOL2" VALUE 0x804D8D5C Val_Wu16 65535.00 DFES_OneToOne 0.00 65535.00 FORMAT "%8.2" /end CHARACTERISTIC
/begin CHARACTERISTIC DFC_CtlMsk.DFC_StrtSCB_C "Behaviour control mask / Behaviour control masks of check DFC_StrtSCB" VALUE 0x804D8D5E Val_Wu16 65535.00 DFES_OneToOne 0.00 65535.00 FORMAT "%8.2" /end CHARACTERISTIC
/begin CHARACTERISTIC DFC_CtlMsk.DFC_StrtSCB2_C "Behaviour control mask / Behaviour control masks of check DFC_StrtSCB2" VALUE 0x804D8D60 Val_Wu16 65535.00 DFES_OneToOne 0.00 65535.00 FORMAT "%8.2" /end CHARACTERISTIC
/begin CHARACTERISTIC DFC_CtlMsk.DFC_StrtSCG_C "Behaviour control mask / Behaviour control masks of check DFC_StrtSCG" VALUE 0x804D8D62 Val_Wu16 65535.00 DFES_OneToOne 0.00 65535.00 FORMAT "%8.2" /end CHARACTERISTIC
/begin CHARACTERISTIC DFC_CtlMsk.DFC_StrtSCG2_C "Behaviour control mask / Behaviour control masks of check DFC_StrtSCG2" VALUE 0x804D8D64 Val_Wu16 65535.00 DFES_OneToOne 0.00 65535.00 FORMAT "%8.2" /end CHARACTERISTIC
/begin CHARACTERISTIC DFC_CtlMsk.DFC_StrtStkRly1_C "Behaviour control mask / Behaviour control masks of check DFC_StrtStkRly1" VALUE 0x804D8D66 Val_Wu16 65535.00 DFES_OneToOne 0.00 65535.00 FORMAT "%8.2" /end CHARACTERISTIC
/begin CHARACTERISTIC DFC_CtlMsk.DFC_StrtStkRly2_C "Behaviour control mask / Behaviour control masks of check DFC_StrtStkRly2" VALUE 0x804D8D68 Val_Wu16 65535.00 DFES_OneToOne 0.00 65535.00 FORMAT "%8.2" /end CHARACTERISTIC
/begin CHARACTERISTIC DFC_CtlMsk.DFC_TEVEmax_C "Behaviour control mask / Behaviour control masks of check DFC_TEVEmax" VALUE 0x804D8D6A Val_Wu16 65535.00 DFES_OneToOne 0.00 65535.00 FORMAT "%8.2" /end CHARACTERISTIC
/begin CHARACTERISTIC DFC_CtlMsk.DFC_TEVEmin_C "Behaviour control mask / Behaviour control masks of check DFC_TEVEmin" VALUE 0x804D8D6C Val_Wu16 65535.00 DFES_OneToOne 0.00 65535.00 FORMAT "%8.2" /end CHARACTERISTIC
/begin CHARACTERISTIC DFC_CtlMsk.DFC_TEVEsig_C "Behaviour control mask / Behaviour control masks of check DFC_TEVEsig" VALUE 0x804D8D6E Val_Wu16 65535.00 DFES_OneToOne 0.00 65535.00 FORMAT "%8.2" /end CHARACTERISTIC
/begin CHARACTERISTIC DFC_CtlMsk.DFC_VehVAllPlaus_C "Behaviour control mask / Behaviour control masks of check DFC_VehVAllPlaus" VALUE 0x804D8D70 Val_Wu16 65535.00 DFES_OneToOne 0.00 65535.00 FORMAT "%8.2" /end CHARACTERISTIC
/begin CHARACTERISTIC DFC_CtlMsk.DFC_VehVNCSnsrElecFailr_C "Behaviour control mask / Behaviour control masks of check DFC_VehVNCSnsrElecFailr" VALUE 0x804D8D72 Val_Wu16 65535.00 DFES_OneToOne 0.00 65535.00 FORMAT "%8.2" /end CHARACTERISTIC
/begin CHARACTERISTIC DFC_CtlMsk.DFC_VehVPlausCan_C "Behaviour control mask / Behaviour control masks of check DFC_VehVPlausCan" VALUE 0x804D8D74 Val_Wu16 65535.00 DFES_OneToOne 0.00 65535.00 FORMAT "%8.2" /end CHARACTERISTIC
/begin CHARACTERISTIC DFC_CtlMsk.DFC_VehVPlausFco_C "Behaviour control mask / Behaviour control masks of check DFC_VehVPlausFco" VALUE 0x804D8D76 Val_Wu16 65535.00 DFES_OneToOne 0.00 65535.00 FORMAT "%8.2" /end CHARACTERISTIC
/begin CHARACTERISTIC DFC_CtlMsk.DFC_VehVPlausPwr_C "Behaviour control mask / Behaviour control masks of check DFC_VehVPlausPwr" VALUE 0x804D8D78 Val_Wu16 65535.00 DFES_OneToOne 0.00 65535.00 FORMAT "%8.2" /end CHARACTERISTIC
/begin CHARACTERISTIC DFC_CtlMsk.DFC_VehVPlausV2N_C "Behaviour control mask / Behaviour control masks of check DFC_VehVPlausV2N" VALUE 0x804D8D7A Val_Wu16 65535.00 DFES_OneToOne 0.00 65535.00 FORMAT "%8.2" /end CHARACTERISTIC
/begin CHARACTERISTIC DFC_CtlMsk.DFC_VehVSpdSnsrAElecFailr_C "Behaviour control mask / Behaviour control masks of check DFC_VehVSpdSnsrAElecFailr" VALUE 0x804D8D7C Val_Wu16 65535.00 DFES_OneToOne 0.00 65535.00 FORMAT "%8.2" /end CHARACTERISTIC
/begin CHARACTERISTIC DFC_CtlMsk.DFC_VehVSpdSnsrBElecFailr_C "Behaviour control mask / Behaviour control masks of check DFC_VehVSpdSnsrBElecFailr" VALUE 0x804D8D7E Val_Wu16 65535.00 DFES_OneToOne 0.00 65535.00 FORMAT "%8.2" /end CHARACTERISTIC
/begin CHARACTERISTIC DFC_CtlMsk.DFC_ClthMax_C "Behaviour control mask / Behaviour control masks of check DFC_ClthMax" VALUE 0x804D8D80 Val_Wu16 65535.00 DFES_OneToOne 0.00 65535.00 FORMAT "%8.2" /end CHARACTERISTIC
/begin CHARACTERISTIC DFC_CtlMsk.DFC_IgnClPs_DevComErr_C "Behaviour control mask / Behaviour control masks of check DFC_IgnClPs_DevComErr" VALUE 0x804D8D82 Val_Wu16 65535.00 DFES_OneToOne 0.00 65535.00 FORMAT "%8.2" /end CHARACTERISTIC
/begin CHARACTERISTIC DFC_CtlMsk.DFC_IgnClPs_LineOl_0_C "Behaviour control mask / Behaviour control masks of check DFC_IgnClPs_LineOl_0" VALUE 0x804D8D84 Val_Wu16 65535.00 DFES_OneToOne 0.00 65535.00 FORMAT "%8.2" /end CHARACTERISTIC
/begin CHARACTERISTIC DFC_CtlMsk.DFC_IgnClPs_LineOl_1_C "Behaviour control mask / Behaviour control masks of check DFC_IgnClPs_LineOl_1" VALUE 0x804D8D86 Val_Wu16 65535.00 DFES_OneToOne 0.00 65535.00 FORMAT "%8.2" /end CHARACTERISTIC
/begin CHARACTERISTIC DFC_CtlMsk.DFC_IgnClPs_LineOl_2_C "Behaviour control mask / Behaviour control masks of check DFC_IgnClPs_LineOl_2" VALUE 0x804D8D88 Val_Wu16 65535.00 DFES_OneToOne 0.00 65535.00 FORMAT "%8.2" /end CHARACTERISTIC
/begin CHARACTERISTIC DFC_CtlMsk.DFC_IgnClPs_LineOl_3_C "Behaviour control mask / Behaviour control masks of check DFC_IgnClPs_LineOl_3" VALUE 0x804D8D8A Val_Wu16 65535.00 DFES_OneToOne 0.00 65535.00 FORMAT "%8.2" /end CHARACTERISTIC
/begin CHARACTERISTIC DFC_CtlMsk.DFC_IgnClPs_LineScb_0_C "Behaviour control mask / Behaviour control masks of check DFC_IgnClPs_LineScb_0" VALUE 0x804D8D8C Val_Wu16 65535.00 DFES_OneToOne 0.00 65535.00 FORMAT "%8.2" /end CHARACTERISTIC
/begin CHARACTERISTIC DFC_CtlMsk.DFC_IgnClPs_LineScb_1_C "Behaviour control mask / Behaviour control masks of check DFC_IgnClPs_LineScb_1" VALUE 0x804D8D8E Val_Wu16 65535.00 DFES_OneToOne 0.00 65535.00 FORMAT "%8.2" /end CHARACTERISTIC
/begin CHARACTERISTIC DFC_CtlMsk.DFC_IgnClPs_LineScb_2_C "Behaviour control mask / Behaviour control masks of check DFC_IgnClPs_LineScb_2" VALUE 0x804D8D90 Val_Wu16 65535.00 DFES_OneToOne 0.00 65535.00 FORMAT "%8.2" /end CHARACTERISTIC
/begin CHARACTERISTIC DFC_CtlMsk.DFC_IgnClPs_LineScb_3_C "Behaviour control mask / Behaviour control masks of check DFC_IgnClPs_LineScb_3" VALUE 0x804D8D92 Val_Wu16 65535.00 DFES_OneToOne 0.00 65535.00 FORMAT "%8.2" /end CHARACTERISTIC
/begin CHARACTERISTIC DFC_CtlMsk.DFC_IgnClPs_LineScg_0_C "Behaviour control mask / Behaviour control masks of check DFC_IgnClPs_LineScg_0" VALUE 0x804D8D94 Val_Wu16 65535.00 DFES_OneToOne 0.00 65535.00 FORMAT "%8.2" /end CHARACTERISTIC
/begin CHARACTERISTIC DFC_CtlMsk.DFC_IgnClPs_LineScg_1_C "Behaviour control mask / Behaviour control masks of check DFC_IgnClPs_LineScg_1" VALUE 0x804D8D96 Val_Wu16 65535.00 DFES_OneToOne 0.00 65535.00 FORMAT "%8.2" /end CHARACTERISTIC
/begin CHARACTERISTIC DFC_CtlMsk.DFC_IgnClPs_LineScg_2_C "Behaviour control mask / Behaviour control masks of check DFC_IgnClPs_LineScg_2" VALUE 0x804D8D98 Val_Wu16 65535.00 DFES_OneToOne 0.00 65535.00 FORMAT "%8.2" /end CHARACTERISTIC
/begin CHARACTERISTIC DFC_CtlMsk.DFC_IgnClPs_LineScg_3_C "Behaviour control mask / Behaviour control masks of check DFC_IgnClPs_LineScg_3" VALUE 0x804D8D9A Val_Wu16 65535.00 DFES_OneToOne 0.00 65535.00 FORMAT "%8.2" /end CHARACTERISTIC
/begin CHARACTERISTIC DFC_CtlMsk.DFC_UEGOASICS1B1_C "Behaviour control mask / Behaviour control masks of check DFC_UEGOASICS1B1" VALUE 0x804D8D9C Val_Wu16 65535.00 DFES_OneToOne 0.00 65535.00 FORMAT "%8.2" /end CHARACTERISTIC
/begin CHARACTERISTIC DFC_CtlMsk.DFC_UEGOOLIPES1B1_C "Behaviour control mask / Behaviour control masks of check DFC_UEGOOLIPES1B1" VALUE 0x804D8D9E Val_Wu16 65535.00 DFES_OneToOne 0.00 65535.00 FORMAT "%8.2" /end CHARACTERISTIC
/begin CHARACTERISTIC DFC_CtlMsk.DFC_UEGOOLRES1B1_C "Behaviour control mask / Behaviour control masks of check DFC_UEGOOLRES1B1" VALUE 0x804D8DA0 Val_Wu16 65535.00 DFES_OneToOne 0.00 65535.00 FORMAT "%8.2" /end CHARACTERISTIC
/begin CHARACTERISTIC DFC_CtlMsk.DFC_UEGOSCBS1B1_C "Behaviour control mask / Behaviour control masks of check DFC_UEGOSCBS1B1" VALUE 0x804D8DA2 Val_Wu16 65535.00 DFES_OneToOne 0.00 65535.00 FORMAT "%8.2" /end CHARACTERISTIC
/begin CHARACTERISTIC DFC_CtlMsk.DFC_UEGOSCGS1B1_C "Behaviour control mask / Behaviour control masks of check DFC_UEGOSCGS1B1" VALUE 0x804D8DA4 Val_Wu16 65535.00 DFES_OneToOne 0.00 65535.00 FORMAT "%8.2" /end CHARACTERISTIC
/begin CHARACTERISTIC DFC_CtlMsk.DFC_UEGOSPIS1B1_C "Behaviour control mask / Behaviour control masks of check DFC_UEGOSPIS1B1" VALUE 0x804D8DA6 Val_Wu16 65535.00 DFES_OneToOne 0.00 65535.00 FORMAT "%8.2" /end CHARACTERISTIC
/begin CHARACTERISTIC DFC_CtlMsk.DFC_UEGOSnsrS1B1_C "Behaviour control mask / Behaviour control masks of check DFC_UEGOSnsrS1B1" VALUE 0x804D8DA8 Val_Wu16 65535.00 DFES_OneToOne 0.00 65535.00 FORMAT "%8.2" /end CHARACTERISTIC
/begin CHARACTERISTIC DFC_CtlMsk.DFC_UegoOlApesS1B1_C "Behaviour control mask / Behaviour control masks of check DFC_UegoOlApesS1B1" VALUE 0x804D8DAA Val_Wu16 65535.00 DFES_OneToOne 0.00 65535.00 FORMAT "%8.2" /end CHARACTERISTIC
/begin CHARACTERISTIC DFC_CtlMsk.DFC_UegoOlRCmpS1B1_C "Behaviour control mask / Behaviour control masks of check DFC_UegoOlRCmpS1B1" VALUE 0x804D8DAC Val_Wu16 65535.00 DFES_OneToOne 0.00 65535.00 FORMAT "%8.2" /end CHARACTERISTIC
/begin CHARACTERISTIC DFC_CtlMsk.DFC_AirCCmprOL_C "Behaviour control mask / Behaviour control masks of check DFC_AirCCmprOL" VALUE 0x804D8DAE Val_Wu16 65535.00 DFES_OneToOne 0.00 65535.00 FORMAT "%8.2" /end CHARACTERISTIC
/begin CHARACTERISTIC DFC_CtlMsk.DFC_AirCCmprOvrTemp_C "Behaviour control mask / Behaviour control masks of check DFC_AirCCmprOvrTemp" VALUE 0x804D8DB0 Val_Wu16 65535.00 DFES_OneToOne 0.00 65535.00 FORMAT "%8.2" /end CHARACTERISTIC
/begin CHARACTERISTIC DFC_CtlMsk.DFC_AirCCmprSCB_C "Behaviour control mask / Behaviour control masks of check DFC_AirCCmprSCB" VALUE 0x804D8DB2 Val_Wu16 65535.00 DFES_OneToOne 0.00 65535.00 FORMAT "%8.2" /end CHARACTERISTIC
/begin CHARACTERISTIC DFC_CtlMsk.DFC_AirCCmprSCG_C "Behaviour control mask / Behaviour control masks of check DFC_AirCCmprSCG" VALUE 0x804D8DB4 Val_Wu16 65535.00 DFES_OneToOne 0.00 65535.00 FORMAT "%8.2" /end CHARACTERISTIC
/begin CHARACTERISTIC DFC_CtlMsk.DFC_AltErr_C "Behaviour control mask / Behaviour control masks of check DFC_AltErr" VALUE 0x804D8DB6 Val_Wu16 65535.00 DFES_OneToOne 0.00 65535.00 FORMAT "%8.2" /end CHARACTERISTIC
/begin CHARACTERISTIC DFC_CtlMsk.DFC_BattUSRCMax_C "Behaviour control mask / Behaviour control masks of check DFC_BattUSRCMax" VALUE 0x804D8DB8 Val_Wu16 65535.00 DFES_OneToOne 0.00 65535.00 FORMAT "%8.2" /end CHARACTERISTIC
/begin CHARACTERISTIC DFC_CtlMsk.DFC_BattUSRCMin_C "Behaviour control mask / Behaviour control masks of check DFC_BattUSRCMin" VALUE 0x804D8DBA Val_Wu16 65535.00 DFES_OneToOne 0.00 65535.00 FORMAT "%8.2" /end CHARACTERISTIC
/begin CHARACTERISTIC DFC_CtlMsk.DFC_ComChksTCU1_C "Behaviour control mask / Behaviour control masks of check DFC_ComChksTCU1" VALUE 0x804D8DBC Val_Wu16 65535.00 DFES_OneToOne 0.00 65535.00 FORMAT "%8.2" /end CHARACTERISTIC
/begin CHARACTERISTIC DFC_CtlMsk.DFC_ComChksTCU11_C "Behaviour control mask / Behaviour control masks of check DFC_ComChksTCU11" VALUE 0x804D8DBE Val_Wu16 65535.00 DFES_OneToOne 0.00 65535.00 FORMAT "%8.2" /end CHARACTERISTIC
/begin CHARACTERISTIC DFC_CtlMsk.DFC_ComChksTCU12_C "Behaviour control mask / Behaviour control masks of check DFC_ComChksTCU12" VALUE 0x804D8DC0 Val_Wu16 65535.00 DFES_OneToOne 0.00 65535.00 FORMAT "%8.2" /end CHARACTERISTIC
/begin CHARACTERISTIC DFC_CtlMsk.DFC_ComChksTCU13_C "Behaviour control mask / Behaviour control masks of check DFC_ComChksTCU13" VALUE 0x804D8DC2 Val_Wu16 65535.00 DFES_OneToOne 0.00 65535.00 FORMAT "%8.2" /end CHARACTERISTIC
/begin CHARACTERISTIC DFC_CtlMsk.DFC_ComChksTCU2_C "Behaviour control mask / Behaviour control masks of check DFC_ComChksTCU2" VALUE 0x804D8DC4 Val_Wu16 65535.00 DFES_OneToOne 0.00 65535.00 FORMAT "%8.2" /end CHARACTERISTIC
/begin CHARACTERISTIC DFC_CtlMsk.DFC_ComChksTCU3_C "Behaviour control mask / Behaviour control masks of check DFC_ComChksTCU3" VALUE 0x804D8DC6 Val_Wu16 65535.00 DFES_OneToOne 0.00 65535.00 FORMAT "%8.2" /end CHARACTERISTIC
/begin CHARACTERISTIC DFC_CtlMsk.DFC_ComChksTCU4_C "Behaviour control mask / Behaviour control masks of check DFC_ComChksTCU4" VALUE 0x804D8DC8 Val_Wu16 65535.00 DFES_OneToOne 0.00 65535.00 FORMAT "%8.2" /end CHARACTERISTIC
/begin CHARACTERISTIC DFC_CtlMsk.DFC_ComCntTCU1_C "Behaviour control mask / Behaviour control masks of check DFC_ComCntTCU1" VALUE 0x804D8DCA Val_Wu16 65535.00 DFES_OneToOne 0.00 65535.00 FORMAT "%8.2" /end CHARACTERISTIC
/begin CHARACTERISTIC DFC_CtlMsk.DFC_ComCntTCU11_C "Behaviour control mask / Behaviour control masks of check DFC_ComCntTCU11" VALUE 0x804D8DCC Val_Wu16 65535.00 DFES_OneToOne 0.00 65535.00 FORMAT "%8.2" /end CHARACTERISTIC
/begin CHARACTERISTIC DFC_CtlMsk.DFC_ComCntTCU12_C "Behaviour control mask / Behaviour control masks of check DFC_ComCntTCU12" VALUE 0x804D8DCE Val_Wu16 65535.00 DFES_OneToOne 0.00 65535.00 FORMAT "%8.2" /end CHARACTERISTIC
/begin CHARACTERISTIC DFC_CtlMsk.DFC_ComCntTCU13_C "Behaviour control mask / Behaviour control masks of check DFC_ComCntTCU13" VALUE 0x804D8DD0 Val_Wu16 65535.00 DFES_OneToOne 0.00 65535.00 FORMAT "%8.2" /end CHARACTERISTIC
/begin CHARACTERISTIC DFC_CtlMsk.DFC_ComCntTCU2_C "Behaviour control mask / Behaviour control masks of check DFC_ComCntTCU2" VALUE 0x804D8DD2 Val_Wu16 65535.00 DFES_OneToOne 0.00 65535.00 FORMAT "%8.2" /end CHARACTERISTIC
/begin CHARACTERISTIC DFC_CtlMsk.DFC_ComCntTCU3_C "Behaviour control mask / Behaviour control masks of check DFC_ComCntTCU3" VALUE 0x804D8DD4 Val_Wu16 65535.00 DFES_OneToOne 0.00 65535.00 FORMAT "%8.2" /end CHARACTERISTIC
/begin CHARACTERISTIC DFC_CtlMsk.DFC_ComCntTCU4_C "Behaviour control mask / Behaviour control masks of check DFC_ComCntTCU4" VALUE 0x804D8DD6 Val_Wu16 65535.00 DFES_OneToOne 0.00 65535.00 FORMAT "%8.2" /end CHARACTERISTIC
/begin CHARACTERISTIC DFC_CtlMsk.DFC_ComTOutTCU01_C "Behaviour control mask / Behaviour control masks of check DFC_ComTOutTCU01" VALUE 0x804D8DD8 Val_Wu16 65535.00 DFES_OneToOne 0.00 65535.00 FORMAT "%8.2" /end CHARACTERISTIC
/begin CHARACTERISTIC DFC_CtlMsk.DFC_ComTOutTCU02_C "Behaviour control mask / Behaviour control masks of check DFC_ComTOutTCU02" VALUE 0x804D8DDA Val_Wu16 65535.00 DFES_OneToOne 0.00 65535.00 FORMAT "%8.2" /end CHARACTERISTIC
/begin CHARACTERISTIC DFC_CtlMsk.DFC_ComTOutTCU1_C "Behaviour control mask / Behaviour control masks of check DFC_ComTOutTCU1" VALUE 0x804D8DDC Val_Wu16 65535.00 DFES_OneToOne 0.00 65535.00 FORMAT "%8.2" /end CHARACTERISTIC
/begin CHARACTERISTIC DFC_CtlMsk.DFC_ComTOutTCU11_C "Behaviour control mask / Behaviour control masks of check DFC_ComTOutTCU11" VALUE 0x804D8DDE Val_Wu16 65535.00 DFES_OneToOne 0.00 65535.00 FORMAT "%8.2" /end CHARACTERISTIC
/begin CHARACTERISTIC DFC_CtlMsk.DFC_ComTOutTCU12_C "Behaviour control mask / Behaviour control masks of check DFC_ComTOutTCU12" VALUE 0x804D8DE0 Val_Wu16 65535.00 DFES_OneToOne 0.00 65535.00 FORMAT "%8.2" /end CHARACTERISTIC
/begin CHARACTERISTIC DFC_CtlMsk.DFC_ComTOutTCU13_C "Behaviour control mask / Behaviour control masks of check DFC_ComTOutTCU13" VALUE 0x804D8DE2 Val_Wu16 65535.00 DFES_OneToOne 0.00 65535.00 FORMAT "%8.2" /end CHARACTERISTIC
/begin CHARACTERISTIC DFC_CtlMsk.DFC_ComTOutTCU14_C "Behaviour control mask / Behaviour control masks of check DFC_ComTOutTCU14" VALUE 0x804D8DE4 Val_Wu16 65535.00 DFES_OneToOne 0.00 65535.00 FORMAT "%8.2" /end CHARACTERISTIC
/begin CHARACTERISTIC DFC_CtlMsk.DFC_ComTOutTCU2_C "Behaviour control mask / Behaviour control masks of check DFC_ComTOutTCU2" VALUE 0x804D8DE6 Val_Wu16 65535.00 DFES_OneToOne 0.00 65535.00 FORMAT "%8.2" /end CHARACTERISTIC
/begin CHARACTERISTIC DFC_CtlMsk.DFC_ComTOutTCU3_C "Behaviour control mask / Behaviour control masks of check DFC_ComTOutTCU3" VALUE 0x804D8DE8 Val_Wu16 65535.00 DFES_OneToOne 0.00 65535.00 FORMAT "%8.2" /end CHARACTERISTIC
/begin CHARACTERISTIC DFC_CtlMsk.DFC_ComTOutTCU4_C "Behaviour control mask / Behaviour control masks of check DFC_ComTOutTCU4" VALUE 0x804D8DEA Val_Wu16 65535.00 DFES_OneToOne 0.00 65535.00 FORMAT "%8.2" /end CHARACTERISTIC
/begin CHARACTERISTIC DFC_CtlMsk.DFC_DevLibBattUHi_C "Behaviour control mask / Behaviour control masks of check DFC_DevLibBattUHi" VALUE 0x804D8DEC Val_Wu16 65535.00 DFES_OneToOne 0.00 65535.00 FORMAT "%8.2" /end CHARACTERISTIC
/begin CHARACTERISTIC DFC_CtlMsk.DFC_DevLibBattULo_C "Behaviour control mask / Behaviour control masks of check DFC_DevLibBattULo" VALUE 0x804D8DEE Val_Wu16 65535.00 DFES_OneToOne 0.00 65535.00 FORMAT "%8.2" /end CHARACTERISTIC
/begin CHARACTERISTIC DFC_CtlMsk.DFC_FanDIOOL_0_C "Behaviour control mask / Behaviour control masks of check DFC_FanDIOOL_0" VALUE 0x804D8DF0 Val_Wu16 65535.00 DFES_OneToOne 0.00 65535.00 FORMAT "%8.2" /end CHARACTERISTIC
/begin CHARACTERISTIC DFC_CtlMsk.DFC_FanDIOOL_1_C "Behaviour control mask / Behaviour control masks of check DFC_FanDIOOL_1" VALUE 0x804D8DF2 Val_Wu16 65535.00 DFES_OneToOne 0.00 65535.00 FORMAT "%8.2" /end CHARACTERISTIC
/begin CHARACTERISTIC DFC_CtlMsk.DFC_FanDIOOvrTemp_0_C "Behaviour control mask / Behaviour control masks of check DFC_FanDIOOvrTemp_0" VALUE 0x804D8DF4 Val_Wu16 65535.00 DFES_OneToOne 0.00 65535.00 FORMAT "%8.2" /end CHARACTERISTIC
/begin CHARACTERISTIC DFC_CtlMsk.DFC_FanDIOOvrTemp_1_C "Behaviour control mask / Behaviour control masks of check DFC_FanDIOOvrTemp_1" VALUE 0x804D8DF6 Val_Wu16 65535.00 DFES_OneToOne 0.00 65535.00 FORMAT "%8.2" /end CHARACTERISTIC
/begin CHARACTERISTIC DFC_CtlMsk.DFC_FanDIOSCB_0_C "Behaviour control mask / Behaviour control masks of check DFC_FanDIOSCB_0" VALUE 0x804D8DF8 Val_Wu16 65535.00 DFES_OneToOne 0.00 65535.00 FORMAT "%8.2" /end CHARACTERISTIC
/begin CHARACTERISTIC DFC_CtlMsk.DFC_FanDIOSCB_1_C "Behaviour control mask / Behaviour control masks of check DFC_FanDIOSCB_1" VALUE 0x804D8DFA Val_Wu16 65535.00 DFES_OneToOne 0.00 65535.00 FORMAT "%8.2" /end CHARACTERISTIC
/begin CHARACTERISTIC DFC_CtlMsk.DFC_FanDIOSCG_0_C "Behaviour control mask / Behaviour control masks of check DFC_FanDIOSCG_0" VALUE 0x804D8DFC Val_Wu16 65535.00 DFES_OneToOne 0.00 65535.00 FORMAT "%8.2" /end CHARACTERISTIC
/begin CHARACTERISTIC DFC_CtlMsk.DFC_FanDIOSCG_1_C "Behaviour control mask / Behaviour control masks of check DFC_FanDIOSCG_1" VALUE 0x804D8DFE Val_Wu16 65535.00 DFES_OneToOne 0.00 65535.00 FORMAT "%8.2" /end CHARACTERISTIC
/begin CHARACTERISTIC DFC_CtlMsk.DFC_MRlyDcOL_C "Behaviour control mask / Behaviour control masks of check DFC_MRlyDcOL" VALUE 0x804D8E00 Val_Wu16 65535.00 DFES_OneToOne 0.00 65535.00 FORMAT "%8.2" /end CHARACTERISTIC
/begin CHARACTERISTIC DFC_CtlMsk.DFC_MRlyDcSCB_C "Behaviour control mask / Behaviour control masks of check DFC_MRlyDcSCB" VALUE 0x804D8E02 Val_Wu16 65535.00 DFES_OneToOne 0.00 65535.00 FORMAT "%8.2" /end CHARACTERISTIC
/begin MEASUREMENT DFC_lenMaxCllsn "Measurement longest DFC Kollision" ULONG OneToOne 1 100 0.00 4294967295.00 FORMAT "%13.2" ECU_ADDRESS 0x60037E6C /end MEASUREMENT
/begin MEASUREMENT DFC_nrCllsnClear "Number of DFC collisions at fcmclear" ULONG OneToOne 1 100 0.00 4294967295.00 FORMAT "%13.2" ECU_ADDRESS 0x50000148 /end MEASUREMENT
/begin MEASUREMENT DFC_nrCllsnReInit "Number of DFC collisions at reInit" ULONG OneToOne 1 100 0.00 4294967295.00 FORMAT "%13.2" ECU_ADDRESS 0x600001F8 /end MEASUREMENT
/begin MEASUREMENT DFC_nrCllsnReport "Number of DFC collisions at report" ULONG OneToOne 1 100 0.00 4294967295.00 FORMAT "%13.2" ECU_ADDRESS 0x5000014C /end MEASUREMENT
/begin MEASUREMENT DFC_numDfcMaxCllsn "DFC which encountered the longest collision" UWORD DFCDFP_Verb 1 100 0.00 762.000000000 FORMAT "%13.9" ECU_ADDRESS 0x60037E68 /end MEASUREMENT
/begin MEASUREMENT DFC_st.DFC_BrkSig "Status of DFC / Status of diagnostic fault check DFC_BrkSig" UBYTE DFC_OneToOne 1 100 0.00 255.0 FORMAT "%5.1" ECU_ADDRESS 0x60034B4B /end MEASUREMENT
/begin MEASUREMENT DFC_st.DFC_ClthSig "Status of DFC / Status of diagnostic fault check DFC_ClthSig" UBYTE DFC_OneToOne 1 100 0.00 255.0 FORMAT "%5.1" ECU_ADDRESS 0x60034B4C /end MEASUREMENT
/begin MEASUREMENT DFC_st.DFC_HLSDemOvhtEngLim "Status of DFC / Status of diagnostic fault check DFC_HLSDemOvhtEngLim" UBYTE DFC_OneToOne 1 100 0.00 255.0 FORMAT "%5.1" ECU_ADDRESS 0x60034B4D /end MEASUREMENT
/begin MEASUREMENT DFC_st.DFC_OilPNpl "Status of DFC / Status of diagnostic fault check DFC_OilPNpl" UBYTE DFC_OneToOne 1 100 0.00 255.0 FORMAT "%5.1" ECU_ADDRESS 0x60034B4E /end MEASUREMENT
/begin MEASUREMENT DFC_st.DFC_PIntkVUsLineHiB1 "Status of DFC / Status of diagnostic fault check DFC_PIntkVUsLineHiB1" UBYTE DFC_OneToOne 1 100 0.00 255.0 FORMAT "%5.1" ECU_ADDRESS 0x60034B4F /end MEASUREMENT
/begin MEASUREMENT DFC_st.DFC_PIntkVUsLineLoB1 "Status of DFC / Status of diagnostic fault check DFC_PIntkVUsLineLoB1" UBYTE DFC_OneToOne 1 100 0.00 255.0 FORMAT "%5.1" ECU_ADDRESS 0x60034B50 /end MEASUREMENT
/begin MEASUREMENT DFC_st.DFC_VehVPhysRngLo "Status of DFC / Status of diagnostic fault check DFC_VehVPhysRngLo" UBYTE DFC_OneToOne 1 100 0.00 255.0 FORMAT "%5.1" ECU_ADDRESS 0x60034B51 /end MEASUREMENT
/begin MEASUREMENT DFC_st.DFC_VehVSigCan "Status of DFC / Status of diagnostic fault check DFC_VehVSigCan" UBYTE DFC_OneToOne 1 100 0.00 255.0 FORMAT "%5.1" ECU_ADDRESS 0x60034B52 /end MEASUREMENT
/begin MEASUREMENT DFC_st.DFC_VehVSigCanSafe "Status of DFC / Status of diagnostic fault check DFC_VehVSigCanSafe" UBYTE DFC_OneToOne 1 100 0.00 255.0 FORMAT "%5.1" ECU_ADDRESS 0x60034B53 /end MEASUREMENT
/begin MEASUREMENT DFC_st.DFC_VlvLftFbOilPSnsrIntk11SRCMax "Status of DFC / Status of diagnostic fault check DFC_VlvLftFbOilPSnsrIntk11SRCMax" UBYTE DFC_OneToOne 1 100 0.00 255.0 FORMAT "%5.1" ECU_ADDRESS 0x60034B54 /end MEASUREMENT
/begin MEASUREMENT DFC_st.DFC_VlvLftFbOilPSnsrIntk11SRCMin "Status of DFC / Status of diagnostic fault check DFC_VlvLftFbOilPSnsrIntk11SRCMin" UBYTE DFC_OneToOne 1 100 0.00 255.0 FORMAT "%5.1" ECU_ADDRESS 0x60034B55 /end MEASUREMENT
/begin MEASUREMENT DFC_st.DFC_ClthNpl "Status of DFC / Status of diagnostic fault check DFC_ClthNpl" UBYTE DFC_OneToOne 1 100 0.00 255.0 FORMAT "%5.1" ECU_ADDRESS 0x60034B56 /end MEASUREMENT
/begin MEASUREMENT DFC_st.DFC_EV1max "Status of DFC / Status of diagnostic fault check DFC_EV1max" UBYTE DFC_OneToOne 1 100 0.00 255.0 FORMAT "%5.1" ECU_ADDRESS 0x60034B57 /end MEASUREMENT
/begin MEASUREMENT DFC_st.DFC_EV1min "Status of DFC / Status of diagnostic fault check DFC_EV1min" UBYTE DFC_OneToOne 1 100 0.00 255.0 FORMAT "%5.1" ECU_ADDRESS 0x60034B58 /end MEASUREMENT
/begin MEASUREMENT DFC_st.DFC_EV1sig "Status of DFC / Status of diagnostic fault check DFC_EV1sig" UBYTE DFC_OneToOne 1 100 0.00 255.0 FORMAT "%5.1" ECU_ADDRESS 0x60034B59 /end MEASUREMENT
/begin MEASUREMENT DFC_st.DFC_EV2max "Status of DFC / Status of diagnostic fault check DFC_EV2max" UBYTE DFC_OneToOne 1 100 0.00 255.0 FORMAT "%5.1" ECU_ADDRESS 0x60034B5A /end MEASUREMENT
/begin MEASUREMENT DFC_st.DFC_EV2min "Status of DFC / Status of diagnostic fault check DFC_EV2min" UBYTE DFC_OneToOne 1 100 0.00 255.0 FORMAT "%5.1" ECU_ADDRESS 0x60034B5B /end MEASUREMENT
/begin MEASUREMENT DFC_st.DFC_EV2sig "Status of DFC / Status of diagnostic fault check DFC_EV2sig" UBYTE DFC_OneToOne 1 100 0.00 255.0 FORMAT "%5.1" ECU_ADDRESS 0x60034B5C /end MEASUREMENT
/begin MEASUREMENT DFC_st.DFC_EV3max "Status of DFC / Status of diagnostic fault check DFC_EV3max" UBYTE DFC_OneToOne 1 100 0.00 255.0 FORMAT "%5.1" ECU_ADDRESS 0x60034B5D /end MEASUREMENT
/begin MEASUREMENT DFC_st.DFC_EV3min "Status of DFC / Status of diagnostic fault check DFC_EV3min" UBYTE DFC_OneToOne 1 100 0.00 255.0 FORMAT "%5.1" ECU_ADDRESS 0x60034B5E /end MEASUREMENT
/begin MEASUREMENT DFC_st.DFC_EV3sig "Status of DFC / Status of diagnostic fault check DFC_EV3sig" UBYTE DFC_OneToOne 1 100 0.00 255.0 FORMAT "%5.1" ECU_ADDRESS 0x60034B5F /end MEASUREMENT
/begin MEASUREMENT DFC_st.DFC_EV4max "Status of DFC / Status of diagnostic fault check DFC_EV4max" UBYTE DFC_OneToOne 1 100 0.00 255.0 FORMAT "%5.1" ECU_ADDRESS 0x60034B60 /end MEASUREMENT
/begin MEASUREMENT DFC_st.DFC_EV4min "Status of DFC / Status of diagnostic fault check DFC_EV4min" UBYTE DFC_OneToOne 1 100 0.00 255.0 FORMAT "%5.1" ECU_ADDRESS 0x60034B61 /end MEASUREMENT
/begin MEASUREMENT DFC_st.DFC_EV4sig "Status of DFC / Status of diagnostic fault check DFC_EV4sig" UBYTE DFC_OneToOne 1 100 0.00 255.0 FORMAT "%5.1" ECU_ADDRESS 0x60034B62 /end MEASUREMENT
/begin MEASUREMENT DFC_st.DFC_GbxPNPosnDrvCdn "Status of DFC / Status of diagnostic fault check DFC_GbxPNPosnDrvCdn" UBYTE DFC_OneToOne 1 100 0.00 255.0 FORMAT "%5.1" ECU_ADDRESS 0x60034B63 /end MEASUREMENT
/begin MEASUREMENT DFC_st.DFC_GbxPNPosnPlausy "Status of DFC / Status of diagnostic fault check DFC_GbxPNPosnPlausy" UBYTE DFC_OneToOne 1 100 0.00 255.0 FORMAT "%5.1" ECU_ADDRESS 0x60034B64 /end MEASUREMENT
/begin MEASUREMENT DFC_st.DFC_PEnvCcMax "Status of DFC / Status of diagnostic fault check DFC_PEnvCcMax" UBYTE DFC_OneToOne 1 100 0.00 255.0 FORMAT "%5.1" ECU_ADDRESS 0x60034B65 /end MEASUREMENT
/begin MEASUREMENT DFC_st.DFC_PEnvCcMin "Status of DFC / Status of diagnostic fault check DFC_PEnvCcMin" UBYTE DFC_OneToOne 1 100 0.00 255.0 FORMAT "%5.1" ECU_ADDRESS 0x60034B66 /end MEASUREMENT
/begin MEASUREMENT DFC_st.DFC_PEnvRngChkMax "Status of DFC / Status of diagnostic fault check DFC_PEnvRngChkMax" UBYTE DFC_OneToOne 1 100 0.00 255.0 FORMAT "%5.1" ECU_ADDRESS 0x60034B67 /end MEASUREMENT
/begin MEASUREMENT DFC_st.DFC_PEnvRngChkMin "Status of DFC / Status of diagnostic fault check DFC_PEnvRngChkMin" UBYTE DFC_OneToOne 1 100 0.00 255.0 FORMAT "%5.1" ECU_ADDRESS 0x60034B68 /end MEASUREMENT
/begin MEASUREMENT DFC_st.DFC_PEnvSnsrPlaus "Status of DFC / Status of diagnostic fault check DFC_PEnvSnsrPlaus" UBYTE DFC_OneToOne 1 100 0.00 255.0 FORMAT "%5.1" ECU_ADDRESS 0x60034B69 /end MEASUREMENT
/begin MEASUREMENT DFC_st.DFC_UEGOHeatrPsS1B1Max "Status of DFC / Status of diagnostic fault check DFC_UEGOHeatrPsS1B1Max" UBYTE DFC_OneToOne 1 100 0.00 255.0 FORMAT "%5.1" ECU_ADDRESS 0x60034B6A /end MEASUREMENT
/begin MEASUREMENT DFC_st.DFC_UEGOHeatrPsS1B1Min "Status of DFC / Status of diagnostic fault check DFC_UEGOHeatrPsS1B1Min" UBYTE DFC_OneToOne 1 100 0.00 255.0 FORMAT "%5.1" ECU_ADDRESS 0x60034B6B /end MEASUREMENT
/begin MEASUREMENT DFC_st.DFC_UEGOHeatrPsS1B1Sig "Status of DFC / Status of diagnostic fault check DFC_UEGOHeatrPsS1B1Sig" UBYTE DFC_OneToOne 1 100 0.00 255.0 FORMAT "%5.1" ECU_ADDRESS 0x60034B6C /end MEASUREMENT
/begin MEASUREMENT DFC_st.DFC_UEGOHeatrRlyPsOLS1B1 "Status of DFC / Status of diagnostic fault check DFC_UEGOHeatrRlyPsOLS1B1" UBYTE DFC_OneToOne 1 100 0.00 255.0 FORMAT "%5.1" ECU_ADDRESS 0x60034B6D /end MEASUREMENT
/begin MEASUREMENT DFC_st.DFC_UEGOHeatrRlyPsSCBS1B1 "Status of DFC / Status of diagnostic fault check DFC_UEGOHeatrRlyPsSCBS1B1" UBYTE DFC_OneToOne 1 100 0.00 255.0 FORMAT "%5.1" ECU_ADDRESS 0x60034B6E /end MEASUREMENT
/begin MEASUREMENT DFC_st.DFC_UEGOHeatrRlyPsSCGS1B1 "Status of DFC / Status of diagnostic fault check DFC_UEGOHeatrRlyPsSCGS1B1" UBYTE DFC_OneToOne 1 100 0.00 255.0 FORMAT "%5.1" ECU_ADDRESS 0x60034B6F /end MEASUREMENT
/begin MEASUREMENT DFC_st.DFC_KnDetSens1PortAMax "Status of DFC / Status of diagnostic fault check DFC_KnDetSens1PortAMax" UBYTE DFC_OneToOne 1 100 0.00 255.0 FORMAT "%5.1" ECU_ADDRESS 0x60034B70 /end MEASUREMENT
/begin MEASUREMENT DFC_st.DFC_KnDetSens1PortAMin "Status of DFC / Status of diagnostic fault check DFC_KnDetSens1PortAMin" UBYTE DFC_OneToOne 1 100 0.00 255.0 FORMAT "%5.1" ECU_ADDRESS 0x60034B71 /end MEASUREMENT
/begin MEASUREMENT DFC_st.DFC_KnDetSens1PortBMax "Status of DFC / Status of diagnostic fault check DFC_KnDetSens1PortBMax" UBYTE DFC_OneToOne 1 100 0.00 255.0 FORMAT "%5.1" ECU_ADDRESS 0x60034B72 /end MEASUREMENT
/begin MEASUREMENT DFC_st.DFC_KnDetSens1PortBMin "Status of DFC / Status of diagnostic fault check DFC_KnDetSens1PortBMin" UBYTE DFC_OneToOne 1 100 0.00 255.0 FORMAT "%5.1" ECU_ADDRESS 0x60034B73 /end MEASUREMENT
/begin MEASUREMENT DFC_st.DFC_Clth2ONStuck "Status of DFC / Status of diagnostic fault check DFC_Clth2ONStuck" UBYTE DFC_OneToOne 1 100 0.00 255.0 FORMAT "%5.1" ECU_ADDRESS 0x60034B74 /end MEASUREMENT
/begin MEASUREMENT DFC_st.DFC_Clth2ONStuckLdc "Status of DFC / Status of diagnostic fault check DFC_Clth2ONStuckLdc" UBYTE DFC_OneToOne 1 100 0.00 255.0 FORMAT "%5.1" ECU_ADDRESS 0x60034B75 /end MEASUREMENT
/begin MEASUREMENT DFC_st.DFC_Clth3ONStuckLdc "Status of DFC / Status of diagnostic fault check DFC_Clth3ONStuckLdc" UBYTE DFC_OneToOne 1 100 0.00 255.0 FORMAT "%5.1" ECU_ADDRESS 0x60034B76 /end MEASUREMENT
/begin MEASUREMENT DFC_st.DFC_Clth3ONStuckPostDrv "Status of DFC / Status of diagnostic fault check DFC_Clth3ONStuckPostDrv" UBYTE DFC_OneToOne 1 100 0.00 255.0 FORMAT "%5.1" ECU_ADDRESS 0x60034B77 /end MEASUREMENT
/begin MEASUREMENT DFC_st.DFC_Clth4ONStuck "Status of DFC / Status of diagnostic fault check DFC_Clth4ONStuck" UBYTE DFC_OneToOne 1 100 0.00 255.0 FORMAT "%5.1" ECU_ADDRESS 0x60034B78 /end MEASUREMENT
/begin MEASUREMENT DFC_st.DFC_Clth4ONStuckLdc "Status of DFC / Status of diagnostic fault check DFC_Clth4ONStuckLdc" UBYTE DFC_OneToOne 1 100 0.00 255.0 FORMAT "%5.1" ECU_ADDRESS 0x60034B79 /end MEASUREMENT
/begin MEASUREMENT DFC_st.DFC_ComDLCTCU01 "Status of DFC / Status of diagnostic fault check DFC_ComDLCTCU01" UBYTE DFC_OneToOne 1 100 0.00 255.0 FORMAT "%5.1" ECU_ADDRESS 0x60034B7A /end MEASUREMENT
/begin MEASUREMENT DFC_st.DFC_ComDLCTCU02 "Status of DFC / Status of diagnostic fault check DFC_ComDLCTCU02" UBYTE DFC_OneToOne 1 100 0.00 255.0 FORMAT "%5.1" ECU_ADDRESS 0x60034B7B /end MEASUREMENT
/begin MEASUREMENT DFC_st.DFC_ComDLCTCU1 "Status of DFC / Status of diagnostic fault check DFC_ComDLCTCU1" UBYTE DFC_OneToOne 1 100 0.00 255.0 FORMAT "%5.1" ECU_ADDRESS 0x60034B7C /end MEASUREMENT
/begin MEASUREMENT DFC_st.DFC_ComDLCTCU11 "Status of DFC / Status of diagnostic fault check DFC_ComDLCTCU11" UBYTE DFC_OneToOne 1 100 0.00 255.0 FORMAT "%5.1" ECU_ADDRESS 0x60034B7D /end MEASUREMENT
/begin MEASUREMENT DFC_st.DFC_ComDLCTCU12 "Status of DFC / Status of diagnostic fault check DFC_ComDLCTCU12" UBYTE DFC_OneToOne 1 100 0.00 255.0 FORMAT "%5.1" ECU_ADDRESS 0x60034B7E /end MEASUREMENT
/begin MEASUREMENT DFC_st.DFC_ComDLCTCU13 "Status of DFC / Status of diagnostic fault check DFC_ComDLCTCU13" UBYTE DFC_OneToOne 1 100 0.00 255.0 FORMAT "%5.1" ECU_ADDRESS 0x60034B7F /end MEASUREMENT
/begin MEASUREMENT DFC_st.DFC_ComDLCTCU14 "Status of DFC / Status of diagnostic fault check DFC_ComDLCTCU14" UBYTE DFC_OneToOne 1 100 0.00 255.0 FORMAT "%5.1" ECU_ADDRESS 0x60034B80 /end MEASUREMENT
/begin MEASUREMENT DFC_st.DFC_ComDLCTCU2 "Status of DFC / Status of diagnostic fault check DFC_ComDLCTCU2" UBYTE DFC_OneToOne 1 100 0.00 255.0 FORMAT "%5.1" ECU_ADDRESS 0x60034B81 /end MEASUREMENT
/begin MEASUREMENT DFC_st.DFC_ComDLCTCU3 "Status of DFC / Status of diagnostic fault check DFC_ComDLCTCU3" UBYTE DFC_OneToOne 1 100 0.00 255.0 FORMAT "%5.1" ECU_ADDRESS 0x60034B82 /end MEASUREMENT
/begin MEASUREMENT DFC_st.DFC_ComDLCTCU4 "Status of DFC / Status of diagnostic fault check DFC_ComDLCTCU4" UBYTE DFC_OneToOne 1 100 0.00 255.0 FORMAT "%5.1" ECU_ADDRESS 0x60034B83 /end MEASUREMENT
/begin MEASUREMENT DFC_st.DFC_EVX "Status of DFC / Status of diagnostic fault check DFC_EVX" UBYTE DFC_OneToOne 1 100 0.00 255.0 FORMAT "%5.1" ECU_ADDRESS 0x60034B84 /end MEASUREMENT
/begin MEASUREMENT DFC_st.DFC_EbsSocFlt "Status of DFC / Status of diagnostic fault check DFC_EbsSocFlt" UBYTE DFC_OneToOne 1 100 0.00 255.0 FORMAT "%5.1" ECU_ADDRESS 0x60034B85 /end MEASUREMENT
/begin MEASUREMENT DFC_st.DFC_I14229VINErr "Status of DFC / Status of diagnostic fault check DFC_I14229VINErr" UBYTE DFC_OneToOne 1 100 0.00 255.0 FORMAT "%5.1" ECU_ADDRESS 0x60034B86 /end MEASUREMENT
/begin MEASUREMENT DFC_st.DFC_LLRKHmax "Status of DFC / Status of diagnostic fault check DFC_LLRKHmax" UBYTE DFC_OneToOne 1 100 0.00 255.0 FORMAT "%5.1" ECU_ADDRESS 0x60034B87 /end MEASUREMENT
/begin MEASUREMENT DFC_st.DFC_LLRKHmin "Status of DFC / Status of diagnostic fault check DFC_LLRKHmin" UBYTE DFC_OneToOne 1 100 0.00 255.0 FORMAT "%5.1" ECU_ADDRESS 0x60034B88 /end MEASUREMENT
/begin MEASUREMENT DFC_st.DFC_LLRmax "Status of DFC / Status of diagnostic fault check DFC_LLRmax" UBYTE DFC_OneToOne 1 100 0.00 255.0 FORMAT "%5.1" ECU_ADDRESS 0x60034B89 /end MEASUREMENT
/begin MEASUREMENT DFC_st.DFC_LLRmin "Status of DFC / Status of diagnostic fault check DFC_LLRmin" UBYTE DFC_OneToOne 1 100 0.00 255.0 FORMAT "%5.1" ECU_ADDRESS 0x60034B8A /end MEASUREMENT
/begin MEASUREMENT DFC_st.DFC_RoughRoad "Status of DFC / Status of diagnostic fault check DFC_RoughRoad" UBYTE DFC_OneToOne 1 100 0.00 255.0 FORMAT "%5.1" ECU_ADDRESS 0x60034B8B /end MEASUREMENT
/begin MEASUREMENT DFC_st.DFC_SiaEEPRdErr "Status of DFC / Status of diagnostic fault check DFC_SiaEEPRdErr" UBYTE DFC_OneToOne 1 100 0.00 255.0 FORMAT "%5.1" ECU_ADDRESS 0x60034B8C /end MEASUREMENT
/begin MEASUREMENT DFC_st.DFC_SiaEEPWrngCod "Status of DFC / Status of diagnostic fault check DFC_SiaEEPWrngCod" UBYTE DFC_OneToOne 1 100 0.00 255.0 FORMAT "%5.1" ECU_ADDRESS 0x60034B8D /end MEASUREMENT
/begin MEASUREMENT DFC_st.DFC_UegoDummy "Status of DFC / Status of diagnostic fault check DFC_UegoDummy" UBYTE DFC_OneToOne 1 100 0.00 255.0 FORMAT "%5.1" ECU_ADDRESS 0x60034B8E /end MEASUREMENT
/begin MEASUREMENT DFC_st.DFC_BusDiagCANAPPLBusOff "Status of DFC / Status of diagnostic fault check DFC_BusDiagCANAPPLBusOff" UBYTE DFC_OneToOne 1 100 0.00 255.0 FORMAT "%5.1" ECU_ADDRESS 0x60034B8F /end MEASUREMENT
/begin MEASUREMENT DFC_st.DFC_BusDiagCANCANCBusOff "Status of DFC / Status of diagnostic fault check DFC_BusDiagCANCANCBusOff" UBYTE DFC_OneToOne 1 100 0.00 255.0 FORMAT "%5.1" ECU_ADDRESS 0x60034B90 /end MEASUREMENT
/begin MEASUREMENT DFC_st.DFC_BusDiagCANVEHICLEBusOff "Status of DFC / Status of diagnostic fault check DFC_BusDiagCANVEHICLEBusOff" UBYTE DFC_OneToOne 1 100 0.00 255.0 FORMAT "%5.1" ECU_ADDRESS 0x60034B91 /end MEASUREMENT
/begin MEASUREMENT DFC_st.DFC_RBA_IODIAGPWR_rba_IoExtCy329_SignalVltSply_0 "Status of DFC / Status of diagnostic fault check DFC_RBA_IODIAGPWR_rba_IoExtCy329_SignalVltSply_0" UBYTE DFC_OneToOne 1 100 0.00 255.0 FORMAT "%5.1" ECU_ADDRESS 0x60034B92 /end MEASUREMENT
/begin MEASUREMENT DFC_st.DFC_RBA_IODIAGPWR_rba_IoExtCy329_SignalVltSply_0OT "Status of DFC / Status of diagnostic fault check DFC_RBA_IODIAGPWR_rba_IoExtCy329_SignalVltSply_0OT" UBYTE DFC_OneToOne 1 100 0.00 255.0 FORMAT "%5.1" ECU_ADDRESS 0x60034B93 /end MEASUREMENT
/begin MEASUREMENT DFC_st.DFC_RBA_IODIAGPWR_rba_IoExtCy329_SignalVltSply_0OV "Status of DFC / Status of diagnostic fault check DFC_RBA_IODIAGPWR_rba_IoExtCy329_SignalVltSply_0OV" UBYTE DFC_OneToOne 1 100 0.00 255.0 FORMAT "%5.1" ECU_ADDRESS 0x60034B94 /end MEASUREMENT
/begin MEASUREMENT DFC_st.DFC_RBA_IODIAGPWR_rba_IoExtCy329_SignalVltSply_0SCG "Status of DFC / Status of diagnostic fault check DFC_RBA_IODIAGPWR_rba_IoExtCy329_SignalVltSply_0SCG" UBYTE DFC_OneToOne 1 100 0.00 255.0 FORMAT "%5.1" ECU_ADDRESS 0x60034B95 /end MEASUREMENT
/begin MEASUREMENT DFC_st.DFC_RBA_IODIAGPWR_rba_IoExtCy329_SignalVltSply_0UV "Status of DFC / Status of diagnostic fault check DFC_RBA_IODIAGPWR_rba_IoExtCy329_SignalVltSply_0UV" UBYTE DFC_OneToOne 1 100 0.00 255.0 FORMAT "%5.1" ECU_ADDRESS 0x60034B96 /end MEASUREMENT
/begin MEASUREMENT DFC_st.DFC_RBA_IODIAGPWR_rba_IoExtCy329_SignalVltSply_1 "Status of DFC / Status of diagnostic fault check DFC_RBA_IODIAGPWR_rba_IoExtCy329_SignalVltSply_1" UBYTE DFC_OneToOne 1 100 0.00 255.0 FORMAT "%5.1" ECU_ADDRESS 0x60034B97 /end MEASUREMENT
/begin MEASUREMENT DFC_st.DFC_RBA_IODIAGPWR_rba_IoExtCy329_SignalVltSply_1OT "Status of DFC / Status of diagnostic fault check DFC_RBA_IODIAGPWR_rba_IoExtCy329_SignalVltSply_1OT" UBYTE DFC_OneToOne 1 100 0.00 255.0 FORMAT "%5.1" ECU_ADDRESS 0x60034B98 /end MEASUREMENT
/begin MEASUREMENT DFC_st.DFC_RBA_IODIAGPWR_rba_IoExtCy329_SignalVltSply_1OV "Status of DFC / Status of diagnostic fault check DFC_RBA_IODIAGPWR_rba_IoExtCy329_SignalVltSply_1OV" UBYTE DFC_OneToOne 1 100 0.00 255.0 FORMAT "%5.1" ECU_ADDRESS 0x60034B99 /end MEASUREMENT
/begin MEASUREMENT DFC_st.DFC_RBA_IODIAGPWR_rba_IoExtCy329_SignalVltSply_1SCG "Status of DFC / Status of diagnostic fault check DFC_RBA_IODIAGPWR_rba_IoExtCy329_SignalVltSply_1SCG" UBYTE DFC_OneToOne 1 100 0.00 255.0 FORMAT "%5.1" ECU_ADDRESS 0x60034B9A /end MEASUREMENT
/begin MEASUREMENT DFC_st.DFC_RBA_IODIAGPWR_rba_IoExtCy329_SignalVltSply_1UV "Status of DFC / Status of diagnostic fault check DFC_RBA_IODIAGPWR_rba_IoExtCy329_SignalVltSply_1UV" UBYTE DFC_OneToOne 1 100 0.00 255.0 FORMAT "%5.1" ECU_ADDRESS 0x60034B9B /end MEASUREMENT
/begin MEASUREMENT DFC_st.DFC_RBA_IODIAGPWR_rba_IoExtCy329_SignalVltSply_2 "Status of DFC / Status of diagnostic fault check DFC_RBA_IODIAGPWR_rba_IoExtCy329_SignalVltSply_2" UBYTE DFC_OneToOne 1 100 0.00 255.0 FORMAT "%5.1" ECU_ADDRESS 0x60034B9C /end MEASUREMENT
/begin MEASUREMENT DFC_st.DFC_RBA_IODIAGPWR_rba_IoExtCy329_SignalVltSply_2OT "Status of DFC / Status of diagnostic fault check DFC_RBA_IODIAGPWR_rba_IoExtCy329_SignalVltSply_2OT" UBYTE DFC_OneToOne 1 100 0.00 255.0 FORMAT "%5.1" ECU_ADDRESS 0x60034B9D /end MEASUREMENT
/begin MEASUREMENT DFC_st.DFC_RBA_IODIAGPWR_rba_IoExtCy329_SignalVltSply_2OV "Status of DFC / Status of diagnostic fault check DFC_RBA_IODIAGPWR_rba_IoExtCy329_SignalVltSply_2OV" UBYTE DFC_OneToOne 1 100 0.00 255.0 FORMAT "%5.1" ECU_ADDRESS 0x60034B9E /end MEASUREMENT
/begin MEASUREMENT DFC_st.DFC_RBA_IODIAGPWR_rba_IoExtCy329_SignalVltSply_2SCG "Status of DFC / Status of diagnostic fault check DFC_RBA_IODIAGPWR_rba_IoExtCy329_SignalVltSply_2SCG" UBYTE DFC_OneToOne 1 100 0.00 255.0 FORMAT "%5.1" ECU_ADDRESS 0x60034B9F /end MEASUREMENT
/begin MEASUREMENT DFC_st.DFC_RBA_IODIAGPWR_rba_IoExtCy329_SignalVltSply_2UV "Status of DFC / Status of diagnostic fault check DFC_RBA_IODIAGPWR_rba_IoExtCy329_SignalVltSply_2UV" UBYTE DFC_OneToOne 1 100 0.00 255.0 FORMAT "%5.1" ECU_ADDRESS 0x60034BA0 /end MEASUREMENT
/begin MEASUREMENT DFC_st.DFC_CAN_E_TIMEOUT "Status of DFC / Status of diagnostic fault check DFC_CAN_E_TIMEOUT" UBYTE DFC_OneToOne 1 100 0.00 255.0 FORMAT "%5.1" ECU_ADDRESS 0x60034BA1 /end MEASUREMENT
/begin MEASUREMENT DFC_st.DFC_LIN_E_TIMEOUT "Status of DFC / Status of diagnostic fault check DFC_LIN_E_TIMEOUT" UBYTE DFC_OneToOne 1 100 0.00 255.0 FORMAT "%5.1" ECU_ADDRESS 0x60034BA2 /end MEASUREMENT
/begin MEASUREMENT DFC_st.DFC_MRlyOL "Status of DFC / Status of diagnostic fault check DFC_MRlyOL" UBYTE DFC_OneToOne 1 100 0.00 255.0 FORMAT "%5.1" ECU_ADDRESS 0x60034BA3 /end MEASUREMENT
/begin MEASUREMENT DFC_st.DFC_MRlySCB "Status of DFC / Status of diagnostic fault check DFC_MRlySCB" UBYTE DFC_OneToOne 1 100 0.00 255.0 FORMAT "%5.1" ECU_ADDRESS 0x60034BA4 /end MEASUREMENT
/begin MEASUREMENT DFC_st.DFC_MRlySCG "Status of DFC / Status of diagnostic fault check DFC_MRlySCG" UBYTE DFC_OneToOne 1 100 0.00 255.0 FORMAT "%5.1" ECU_ADDRESS 0x60034BA5 /end MEASUREMENT
/begin MEASUREMENT DFC_st.DFC_rba_MultiStackTrace_Threshold "Status of DFC / Status of diagnostic fault check DFC_rba_MultiStackTrace_Threshold" UBYTE DFC_OneToOne 1 100 0.00 255.0 FORMAT "%5.1" ECU_ADDRESS 0x60034BA6 /end MEASUREMENT
/begin MEASUREMENT DFC_st.DFC_BSWM_E_ACTION_FAILED "Status of DFC / Status of diagnostic fault check DFC_BSWM_E_ACTION_FAILED" UBYTE DFC_OneToOne 1 100 0.00 255.0 FORMAT "%5.1" ECU_ADDRESS 0x60034BA7 /end MEASUREMENT
/begin MEASUREMENT DFC_st.DFC_BSWM_E_INTRPTQUEUE_FULL "Status of DFC / Status of diagnostic fault check DFC_BSWM_E_INTRPTQUEUE_FULL" UBYTE DFC_OneToOne 1 100 0.00 255.0 FORMAT "%5.1" ECU_ADDRESS 0x60034BA8 /end MEASUREMENT
/begin MEASUREMENT DFC_st.DFC_RBA_IOEXTLIB_KEEPALIVE_DRV "Status of DFC / Status of diagnostic fault check DFC_RBA_IOEXTLIB_KEEPALIVE_DRV" UBYTE DFC_OneToOne 1 100 0.00 255.0 FORMAT "%5.1" ECU_ADDRESS 0x60034BA9 /end MEASUREMENT
/begin MEASUREMENT DFC_st.DFC_RBA_IOEXTLIB_KEEPALIVE_INI "Status of DFC / Status of diagnostic fault check DFC_RBA_IOEXTLIB_KEEPALIVE_INI" UBYTE DFC_OneToOne 1 100 0.00 255.0 FORMAT "%5.1" ECU_ADDRESS 0x60034BAA /end MEASUREMENT
/begin MEASUREMENT DFC_st.DFC_rba_IoSigRtc_StopCounter "Status of DFC / Status of diagnostic fault check DFC_rba_IoSigRtc_StopCounter" UBYTE DFC_OneToOne 1 100 0.00 255.0 FORMAT "%5.1" ECU_ADDRESS 0x60034BAB /end MEASUREMENT
/begin MEASUREMENT DFC_st.DFC_rba_MRly_Diag_Stk_Event "Status of DFC / Status of diagnostic fault check DFC_rba_MRly_Diag_Stk_Event" UBYTE DFC_OneToOne 1 100 0.00 255.0 FORMAT "%5.1" ECU_ADDRESS 0x60034BAC /end MEASUREMENT
/begin MEASUREMENT DFC_st.DFC_rba_MemDiag_MemReadErr "Status of DFC / Status of diagnostic fault check DFC_rba_MemDiag_MemReadErr" UBYTE DFC_OneToOne 1 100 0.00 255.0 FORMAT "%5.1" ECU_ADDRESS 0x60034BAD /end MEASUREMENT
/begin MEASUREMENT DFC_st.DFC_rba_MemDiag_MemWrErr "Status of DFC / Status of diagnostic fault check DFC_rba_MemDiag_MemWrErr" UBYTE DFC_OneToOne 1 100 0.00 255.0 FORMAT "%5.1" ECU_ADDRESS 0x60034BAE /end MEASUREMENT
/begin MEASUREMENT DFC_st.DFC_rba_SyC_IrrSwOffTrigEngRun_Event "Status of DFC / Status of diagnostic fault check DFC_rba_SyC_IrrSwOffTrigEngRun_Event" UBYTE DFC_OneToOne 1 100 0.00 255.0 FORMAT "%5.1" ECU_ADDRESS 0x60034BAF /end MEASUREMENT
/begin MEASUREMENT DFC_st.DFC_rba_T15_Diag_ComInVld_Event "Status of DFC / Status of diagnostic fault check DFC_rba_T15_Diag_ComInVld_Event" UBYTE DFC_OneToOne 1 100 0.00 255.0 FORMAT "%5.1" ECU_ADDRESS 0x60034BB0 /end MEASUREMENT
/begin MEASUREMENT DFC_st.DFC_rba_T15_Diag_ComOff_HwOn_Event "Status of DFC / Status of diagnostic fault check DFC_rba_T15_Diag_ComOff_HwOn_Event" UBYTE DFC_OneToOne 1 100 0.00 255.0 FORMAT "%5.1" ECU_ADDRESS 0x60034BB1 /end MEASUREMENT
/begin MEASUREMENT DFC_st.DFC_rba_T15_Diag_ComOn_HwOff_Event "Status of DFC / Status of diagnostic fault check DFC_rba_T15_Diag_ComOn_HwOff_Event" UBYTE DFC_OneToOne 1 100 0.00 255.0 FORMAT "%5.1" ECU_ADDRESS 0x60034BB2 /end MEASUREMENT
/begin MEASUREMENT DFC_st.DFC_AppAllSnsrDfct "Status of DFC / Status of diagnostic fault check DFC_AppAllSnsrDfct" UBYTE DFC_OneToOne 1 100 0.00 255.0 FORMAT "%5.1" ECU_ADDRESS 0x60034BB3 /end MEASUREMENT
/begin MEASUREMENT DFC_st.DFC_BattUStdbyDiaOL "Status of DFC / Status of diagnostic fault check DFC_BattUStdbyDiaOL" UBYTE DFC_OneToOne 1 100 0.00 255.0 FORMAT "%5.1" ECU_ADDRESS 0x60034BB4 /end MEASUREMENT
/begin MEASUREMENT DFC_st.DFC_BigLeakIntkMnfldEmiInfl "Status of DFC / Status of diagnostic fault check DFC_BigLeakIntkMnfldEmiInfl" UBYTE DFC_OneToOne 1 100 0.00 255.0 FORMAT "%5.1" ECU_ADDRESS 0x60034BB5 /end MEASUREMENT
/begin MEASUREMENT DFC_st.DFC_BrkMnSwtContOnWarnLmp "Status of DFC / Status of diagnostic fault check DFC_BrkMnSwtContOnWarnLmp" UBYTE DFC_OneToOne 1 100 0.00 255.0 FORMAT "%5.1" ECU_ADDRESS 0x60034BB6 /end MEASUREMENT
/begin MEASUREMENT DFC_st.DFC_BrkMnSwtNotStpWarnLmp "Status of DFC / Status of diagnostic fault check DFC_BrkMnSwtNotStpWarnLmp" UBYTE DFC_OneToOne 1 100 0.00 255.0 FORMAT "%5.1" ECU_ADDRESS 0x60034BB7 /end MEASUREMENT
/begin MEASUREMENT DFC_st.DFC_BrkRdntSwtContOnWarnLmp "Status of DFC / Status of diagnostic fault check DFC_BrkRdntSwtContOnWarnLmp" UBYTE DFC_OneToOne 1 100 0.00 255.0 FORMAT "%5.1" ECU_ADDRESS 0x60034BB8 /end MEASUREMENT
/begin MEASUREMENT DFC_st.DFC_BrkRdntSwtNotStpWarnLmp "Status of DFC / Status of diagnostic fault check DFC_BrkRdntSwtNotStpWarnLmp" UBYTE DFC_OneToOne 1 100 0.00 255.0 FORMAT "%5.1" ECU_ADDRESS 0x60034BB9 /end MEASUREMENT
/begin MEASUREMENT DFC_st.DFC_CEngDsTColdStrtMax "Status of DFC / Status of diagnostic fault check DFC_CEngDsTColdStrtMax" UBYTE DFC_OneToOne 1 100 0.00 255.0 FORMAT "%5.1" ECU_ADDRESS 0x60034BBA /end MEASUREMENT
/begin MEASUREMENT DFC_st.DFC_CEngDsTColdStrtMin "Status of DFC / Status of diagnostic fault check DFC_CEngDsTColdStrtMin" UBYTE DFC_OneToOne 1 100 0.00 255.0 FORMAT "%5.1" ECU_ADDRESS 0x60034BBB /end MEASUREMENT
/begin MEASUREMENT DFC_st.DFC_CEngDsTImps "Status of DFC / Status of diagnostic fault check DFC_CEngDsTImps" UBYTE DFC_OneToOne 1 100 0.00 255.0 FORMAT "%5.1" ECU_ADDRESS 0x60034BBC /end MEASUREMENT
/begin MEASUREMENT DFC_st.DFC_CEngDsTPlausLSC "Status of DFC / Status of diagnostic fault check DFC_CEngDsTPlausLSC" UBYTE DFC_OneToOne 1 100 0.00 255.0 FORMAT "%5.1" ECU_ADDRESS 0x60034BBD /end MEASUREMENT
/begin MEASUREMENT DFC_st.DFC_CEngDsTPlausSTC "Status of DFC / Status of diagnostic fault check DFC_CEngDsTPlausSTC" UBYTE DFC_OneToOne 1 100 0.00 255.0 FORMAT "%5.1" ECU_ADDRESS 0x60034BBE /end MEASUREMENT
/begin MEASUREMENT DFC_st.DFC_CEngDsTSRCMax "Status of DFC / Status of diagnostic fault check DFC_CEngDsTSRCMax" UBYTE DFC_OneToOne 1 100 0.00 255.0 FORMAT "%5.1" ECU_ADDRESS 0x60034BBF /end MEASUREMENT
/begin MEASUREMENT DFC_st.DFC_CEngDsTSRCMin "Status of DFC / Status of diagnostic fault check DFC_CEngDsTSRCMin" UBYTE DFC_OneToOne 1 100 0.00 255.0 FORMAT "%5.1" ECU_ADDRESS 0x60034BC0 /end MEASUREMENT
/begin MEASUREMENT DFC_st.DFC_CEngDsTSig "Status of DFC / Status of diagnostic fault check DFC_CEngDsTSig" UBYTE DFC_OneToOne 1 100 0.00 255.0 FORMAT "%5.1" ECU_ADDRESS 0x60034BC1 /end MEASUREMENT
/begin MEASUREMENT DFC_st.DFC_CEngUsTSRCMax "Status of DFC / Status of diagnostic fault check DFC_CEngUsTSRCMax" UBYTE DFC_OneToOne 1 100 0.00 255.0 FORMAT "%5.1" ECU_ADDRESS 0x60034BC2 /end MEASUREMENT
/begin MEASUREMENT DFC_st.DFC_CEngUsTSRCMin "Status of DFC / Status of diagnostic fault check DFC_CEngUsTSRCMin" UBYTE DFC_OneToOne 1 100 0.00 255.0 FORMAT "%5.1" ECU_ADDRESS 0x60034BC3 /end MEASUREMENT
/begin MEASUREMENT DFC_st.DFC_DCDCFltDet "Status of DFC / Status of diagnostic fault check DFC_DCDCFltDet" UBYTE DFC_OneToOne 1 100 0.00 255.0 FORMAT "%5.1" ECU_ADDRESS 0x60034BC4 /end MEASUREMENT
/begin MEASUREMENT DFC_st.DFC_DKRSA "Status of DFC / Status of diagnostic fault check DFC_DKRSA" UBYTE DFC_OneToOne 1 100 0.00 255.0 FORMAT "%5.1" ECU_ADDRESS 0x60034BC5 /end MEASUREMENT
/begin MEASUREMENT DFC_st.DFC_DKVSmax "Status of DFC / Status of diagnostic fault check DFC_DKVSmax" UBYTE DFC_OneToOne 1 100 0.00 255.0 FORMAT "%5.1" ECU_ADDRESS 0x60034BC6 /end MEASUREMENT
/begin MEASUREMENT DFC_st.DFC_DKnpl "Status of DFC / Status of diagnostic fault check DFC_DKnpl" UBYTE DFC_OneToOne 1 100 0.00 255.0 FORMAT "%5.1" ECU_ADDRESS 0x60034BC7 /end MEASUREMENT
/begin MEASUREMENT DFC_st.DFC_DSSmax "Status of DFC / Status of diagnostic fault check DFC_DSSmax" UBYTE DFC_OneToOne 1 100 0.00 255.0 FORMAT "%5.1" ECU_ADDRESS 0x60034BC8 /end MEASUREMENT
/begin MEASUREMENT DFC_st.DFC_DSTTI "Status of DFC / Status of diagnostic fault check DFC_DSTTI" UBYTE DFC_OneToOne 1 100 0.00 255.0 FORMAT "%5.1" ECU_ADDRESS 0x60034BC9 /end MEASUREMENT
/begin MEASUREMENT DFC_st.DFC_DSUmax "Status of DFC / Status of diagnostic fault check DFC_DSUmax" UBYTE DFC_OneToOne 1 100 0.00 255.0 FORMAT "%5.1" ECU_ADDRESS 0x60034BCA /end MEASUREMENT
/begin MEASUREMENT DFC_st.DFC_EGRVlvOL "Status of DFC / Status of diagnostic fault check DFC_EGRVlvOL" UBYTE DFC_OneToOne 1 100 0.00 255.0 FORMAT "%5.1" ECU_ADDRESS 0x60034BCB /end MEASUREMENT
/begin MEASUREMENT DFC_st.DFC_EGRVlvSCB "Status of DFC / Status of diagnostic fault check DFC_EGRVlvSCB" UBYTE DFC_OneToOne 1 100 0.00 255.0 FORMAT "%5.1" ECU_ADDRESS 0x60034BCC /end MEASUREMENT
/begin MEASUREMENT DFC_st.DFC_EGRVlvSCG "Status of DFC / Status of diagnostic fault check DFC_EGRVlvSCG" UBYTE DFC_OneToOne 1 100 0.00 255.0 FORMAT "%5.1" ECU_ADDRESS 0x60034BCD /end MEASUREMENT
/begin MEASUREMENT DFC_st.DFC_EGSDUS2B1LtrDly "Status of DFC / Status of diagnostic fault check DFC_EGSDUS2B1LtrDly" UBYTE DFC_OneToOne 1 100 0.00 255.0 FORMAT "%5.1" ECU_ADDRESS 0x60034BCE /end MEASUREMENT
/begin MEASUREMENT DFC_st.DFC_EGSDUS2B1LtrPT1 "Status of DFC / Status of diagnostic fault check DFC_EGSDUS2B1LtrPT1" UBYTE DFC_OneToOne 1 100 0.00 255.0 FORMAT "%5.1" ECU_ADDRESS 0x60034BCF /end MEASUREMENT
/begin MEASUREMENT DFC_st.DFC_EGSDUS2B1RtlDly "Status of DFC / Status of diagnostic fault check DFC_EGSDUS2B1RtlDly" UBYTE DFC_OneToOne 1 100 0.00 255.0 FORMAT "%5.1" ECU_ADDRESS 0x60034BD0 /end MEASUREMENT
/begin MEASUREMENT DFC_st.DFC_EGSDUS2B1RtlPT1 "Status of DFC / Status of diagnostic fault check DFC_EGSDUS2B1RtlPT1" UBYTE DFC_OneToOne 1 100 0.00 255.0 FORMAT "%5.1" ECU_ADDRESS 0x60034BD1 /end MEASUREMENT
/begin MEASUREMENT DFC_st.DFC_EGSDUS2B1TarLean "Status of DFC / Status of diagnostic fault check DFC_EGSDUS2B1TarLean" UBYTE DFC_OneToOne 1 100 0.00 255.0 FORMAT "%5.1" ECU_ADDRESS 0x60034BD2 /end MEASUREMENT
/begin MEASUREMENT DFC_st.DFC_EGSDUS2B1TarRich "Status of DFC / Status of diagnostic fault check DFC_EGSDUS2B1TarRich" UBYTE DFC_OneToOne 1 100 0.00 255.0 FORMAT "%5.1" ECU_ADDRESS 0x60034BD3 /end MEASUREMENT
/begin MEASUREMENT DFC_st.DFC_ETAKHLmax "Status of DFC / Status of diagnostic fault check DFC_ETAKHLmax" UBYTE DFC_OneToOne 1 100 0.00 255.0 FORMAT "%5.1" ECU_ADDRESS 0x60034BD4 /end MEASUREMENT
/begin MEASUREMENT DFC_st.DFC_ETAKHTmax "Status of DFC / Status of diagnostic fault check DFC_ETAKHTmax" UBYTE DFC_OneToOne 1 100 0.00 255.0 FORMAT "%5.1" ECU_ADDRESS 0x60034BD5 /end MEASUREMENT
/begin MEASUREMENT DFC_st.DFC_EngICO "Status of DFC / Status of diagnostic fault check DFC_EngICO" UBYTE DFC_OneToOne 1 100 0.00 255.0 FORMAT "%5.1" ECU_ADDRESS 0x60034BD6 /end MEASUREMENT
/begin MEASUREMENT DFC_st.DFC_EngPrtOvrSpdMon "Status of DFC / Status of diagnostic fault check DFC_EngPrtOvrSpdMon" UBYTE DFC_OneToOne 1 100 0.00 255.0 FORMAT "%5.1" ECU_ADDRESS 0x60034BD7 /end MEASUREMENT
/begin MEASUREMENT DFC_st.DFC_EpmCaSI1ErrSig "Status of DFC / Status of diagnostic fault check DFC_EpmCaSI1ErrSig" UBYTE DFC_OneToOne 1 100 0.00 255.0 FORMAT "%5.1" ECU_ADDRESS 0x60034BD8 /end MEASUREMENT
/begin MEASUREMENT DFC_st.DFC_EpmCaSI1NoSig "Status of DFC / Status of diagnostic fault check DFC_EpmCaSI1NoSig" UBYTE DFC_OneToOne 1 100 0.00 255.0 FORMAT "%5.1" ECU_ADDRESS 0x60034BD9 /end MEASUREMENT
/begin MEASUREMENT DFC_st.DFC_EpmCaSI1OfsErr "Status of DFC / Status of diagnostic fault check DFC_EpmCaSI1OfsErr" UBYTE DFC_OneToOne 1 100 0.00 255.0 FORMAT "%5.1" ECU_ADDRESS 0x60034BDA /end MEASUREMENT
/begin MEASUREMENT DFC_st.DFC_EpmCrSErrSig "Status of DFC / Status of diagnostic fault check DFC_EpmCrSErrSig" UBYTE DFC_OneToOne 1 100 0.00 255.0 FORMAT "%5.1" ECU_ADDRESS 0x60034BDB /end MEASUREMENT
/begin MEASUREMENT DFC_st.DFC_EpmCrSNoSig "Status of DFC / Status of diagnostic fault check DFC_EpmCrSNoSig" UBYTE DFC_OneToOne 1 100 0.00 255.0 FORMAT "%5.1" ECU_ADDRESS 0x60034BDC /end MEASUREMENT
/begin MEASUREMENT DFC_st.DFC_EtaEngIdleNonCsers "Status of DFC / Status of diagnostic fault check DFC_EtaEngIdleNonCsers" UBYTE DFC_OneToOne 1 100 0.00 255.0 FORMAT "%5.1" ECU_ADDRESS 0x60034BDD /end MEASUREMENT
/begin MEASUREMENT DFC_st.DFC_EtaEngPtlNonCsers "Status of DFC / Status of diagnostic fault check DFC_EtaEngPtlNonCsers" UBYTE DFC_OneToOne 1 100 0.00 255.0 FORMAT "%5.1" ECU_ADDRESS 0x60034BDE /end MEASUREMENT
/begin MEASUREMENT DFC_st.DFC_FRAmax "Status of DFC / Status of diagnostic fault check DFC_FRAmax" UBYTE DFC_OneToOne 1 100 0.00 255.0 FORMAT "%5.1" ECU_ADDRESS 0x60034BDF /end MEASUREMENT
/begin MEASUREMENT DFC_st.DFC_FRAmin "Status of DFC / Status of diagnostic fault check DFC_FRAmin" UBYTE DFC_OneToOne 1 100 0.00 255.0 FORMAT "%5.1" ECU_ADDRESS 0x60034BE0 /end MEASUREMENT
/begin MEASUREMENT DFC_st.DFC_GbxRvsSwtStk "Status of DFC / Status of diagnostic fault check DFC_GbxRvsSwtStk" UBYTE DFC_OneToOne 1 100 0.00 255.0 FORMAT "%5.1" ECU_ADDRESS 0x60034BE1 /end MEASUREMENT
/begin MEASUREMENT DFC_st.DFC_HDRmax "Status of DFC / Status of diagnostic fault check DFC_HDRmax" UBYTE DFC_OneToOne 1 100 0.00 255.0 FORMAT "%5.1" ECU_ADDRESS 0x60034BE2 /end MEASUREMENT
/begin MEASUREMENT DFC_st.DFC_HEGOS2B1ElecMax "Status of DFC / Status of diagnostic fault check DFC_HEGOS2B1ElecMax" UBYTE DFC_OneToOne 1 100 0.00 255.0 FORMAT "%5.1" ECU_ADDRESS 0x60034BE3 /end MEASUREMENT
/begin MEASUREMENT DFC_st.DFC_HEGOS2B1ElecMin "Status of DFC / Status of diagnostic fault check DFC_HEGOS2B1ElecMin" UBYTE DFC_OneToOne 1 100 0.00 255.0 FORMAT "%5.1" ECU_ADDRESS 0x60034BE4 /end MEASUREMENT
/begin MEASUREMENT DFC_st.DFC_HEGOS2B1ElecSig "Status of DFC / Status of diagnostic fault check DFC_HEGOS2B1ElecSig" UBYTE DFC_OneToOne 1 100 0.00 255.0 FORMAT "%5.1" ECU_ADDRESS 0x60034BE5 /end MEASUREMENT
/begin MEASUREMENT DFC_st.DFC_HEGOS2B1HtgNpl "Status of DFC / Status of diagnostic fault check DFC_HEGOS2B1HtgNpl" UBYTE DFC_OneToOne 1 100 0.00 255.0 FORMAT "%5.1" ECU_ADDRESS 0x60034BE6 /end MEASUREMENT
/begin MEASUREMENT DFC_st.DFC_IntkAirTIntkMnfldCrssMax "Status of DFC / Status of diagnostic fault check DFC_IntkAirTIntkMnfldCrssMax" UBYTE DFC_OneToOne 1 100 0.00 255.0 FORMAT "%5.1" ECU_ADDRESS 0x60034BE7 /end MEASUREMENT
/begin MEASUREMENT DFC_st.DFC_IntkAirTIntkMnfldCrssMin "Status of DFC / Status of diagnostic fault check DFC_IntkAirTIntkMnfldCrssMin" UBYTE DFC_OneToOne 1 100 0.00 255.0 FORMAT "%5.1" ECU_ADDRESS 0x60034BE8 /end MEASUREMENT
/begin MEASUREMENT DFC_st.DFC_IntkAirTIntkMnfldHSCMax "Status of DFC / Status of diagnostic fault check DFC_IntkAirTIntkMnfldHSCMax" UBYTE DFC_OneToOne 1 100 0.00 255.0 FORMAT "%5.1" ECU_ADDRESS 0x60034BE9 /end MEASUREMENT
/begin MEASUREMENT DFC_st.DFC_IntkAirTIntkMnfldImps "Status of DFC / Status of diagnostic fault check DFC_IntkAirTIntkMnfldImps" UBYTE DFC_OneToOne 1 100 0.00 255.0 FORMAT "%5.1" ECU_ADDRESS 0x60034BEA /end MEASUREMENT
/begin MEASUREMENT DFC_st.DFC_IntkAirTIntkMnfldPRCMax "Status of DFC / Status of diagnostic fault check DFC_IntkAirTIntkMnfldPRCMax" UBYTE DFC_OneToOne 1 100 0.00 255.0 FORMAT "%5.1" ECU_ADDRESS 0x60034BEB /end MEASUREMENT
/begin MEASUREMENT DFC_st.DFC_IntkAirTIntkMnfldPRCMin "Status of DFC / Status of diagnostic fault check DFC_IntkAirTIntkMnfldPRCMin" UBYTE DFC_OneToOne 1 100 0.00 255.0 FORMAT "%5.1" ECU_ADDRESS 0x60034BEC /end MEASUREMENT
/begin MEASUREMENT DFC_st.DFC_IntkAirTIntkMnfldSRCMax "Status of DFC / Status of diagnostic fault check DFC_IntkAirTIntkMnfldSRCMax" UBYTE DFC_OneToOne 1 100 0.00 255.0 FORMAT "%5.1" ECU_ADDRESS 0x60034BED /end MEASUREMENT
/begin MEASUREMENT DFC_st.DFC_IntkAirTIntkMnfldSRCMin "Status of DFC / Status of diagnostic fault check DFC_IntkAirTIntkMnfldSRCMin" UBYTE DFC_OneToOne 1 100 0.00 255.0 FORMAT "%5.1" ECU_ADDRESS 0x60034BEE /end MEASUREMENT
/begin MEASUREMENT DFC_st.DFC_IntkAirTIntkMnfldSTC "Status of DFC / Status of diagnostic fault check DFC_IntkAirTIntkMnfldSTC" UBYTE DFC_OneToOne 1 100 0.00 255.0 FORMAT "%5.1" ECU_ADDRESS 0x60034BEF /end MEASUREMENT
/begin MEASUREMENT DFC_st.DFC_KS1max "Status of DFC / Status of diagnostic fault check DFC_KS1max" UBYTE DFC_OneToOne 1 100 0.00 255.0 FORMAT "%5.1" ECU_ADDRESS 0x60034BF0 /end MEASUREMENT
/begin MEASUREMENT DFC_st.DFC_KS1min "Status of DFC / Status of diagnostic fault check DFC_KS1min" UBYTE DFC_OneToOne 1 100 0.00 255.0 FORMAT "%5.1" ECU_ADDRESS 0x60034BF1 /end MEASUREMENT
/begin MEASUREMENT DFC_st.DFC_LMmax "Status of DFC / Status of diagnostic fault check DFC_LMmax" UBYTE DFC_OneToOne 1 100 0.00 255.0 FORMAT "%5.1" ECU_ADDRESS 0x60034BF2 /end MEASUREMENT
/begin MEASUREMENT DFC_st.DFC_LZSRnpl "Status of DFC / Status of diagnostic fault check DFC_LZSRnpl" UBYTE DFC_OneToOne 1 100 0.00 255.0 FORMAT "%5.1" ECU_ADDRESS 0x60034BF3 /end MEASUREMENT
/begin MEASUREMENT DFC_st.DFC_LamDynDiagS1B1 "Status of DFC / Status of diagnostic fault check DFC_LamDynDiagS1B1" UBYTE DFC_OneToOne 1 100 0.00 255.0 FORMAT "%5.1" ECU_ADDRESS 0x60034BF4 /end MEASUREMENT
/begin MEASUREMENT DFC_st.DFC_LeakIntkMnfldEmiInfl "Status of DFC / Status of diagnostic fault check DFC_LeakIntkMnfldEmiInfl" UBYTE DFC_OneToOne 1 100 0.00 255.0 FORMAT "%5.1" ECU_ADDRESS 0x60034BF5 /end MEASUREMENT
/begin MEASUREMENT DFC_st.DFC_MD00max "Status of DFC / Status of diagnostic fault check DFC_MD00max" UBYTE DFC_OneToOne 1 100 0.00 255.0 FORMAT "%5.1" ECU_ADDRESS 0x60034BF6 /end MEASUREMENT
/begin MEASUREMENT DFC_st.DFC_MDBmax "Status of DFC / Status of diagnostic fault check DFC_MDBmax" UBYTE DFC_OneToOne 1 100 0.00 255.0 FORMAT "%5.1" ECU_ADDRESS 0x60034BF7 /end MEASUREMENT
/begin MEASUREMENT DFC_st.DFC_MDCat "Status of DFC / Status of diagnostic fault check DFC_MDCat" UBYTE DFC_OneToOne 1 100 0.00 255.0 FORMAT "%5.1" ECU_ADDRESS 0x60034BF8 /end MEASUREMENT
/begin MEASUREMENT DFC_st.DFC_MDCatCrit "Status of DFC / Status of diagnostic fault check DFC_MDCatCrit" UBYTE DFC_OneToOne 1 100 0.00 255.0 FORMAT "%5.1" ECU_ADDRESS 0x60034BF9 /end MEASUREMENT
/begin MEASUREMENT DFC_st.DFC_MDCatCurr "Status of DFC / Status of diagnostic fault check DFC_MDCatCurr" UBYTE DFC_OneToOne 1 100 0.00 255.0 FORMAT "%5.1" ECU_ADDRESS 0x60034BFA /end MEASUREMENT
/begin MEASUREMENT DFC_st.DFC_MDCyl_0 "Status of DFC / Status of diagnostic fault check DFC_MDCyl_0" UBYTE DFC_OneToOne 1 100 0.00 255.0 FORMAT "%5.1" ECU_ADDRESS 0x60034BFB /end MEASUREMENT
/begin MEASUREMENT DFC_st.DFC_MDCyl_1 "Status of DFC / Status of diagnostic fault check DFC_MDCyl_1" UBYTE DFC_OneToOne 1 100 0.00 255.0 FORMAT "%5.1" ECU_ADDRESS 0x60034BFC /end MEASUREMENT
/begin MEASUREMENT DFC_st.DFC_MDCyl_2 "Status of DFC / Status of diagnostic fault check DFC_MDCyl_2" UBYTE DFC_OneToOne 1 100 0.00 255.0 FORMAT "%5.1" ECU_ADDRESS 0x60034BFD /end MEASUREMENT
/begin MEASUREMENT DFC_st.DFC_MDCyl_3 "Status of DFC / Status of diagnostic fault check DFC_MDCyl_3" UBYTE DFC_OneToOne 1 100 0.00 255.0 FORMAT "%5.1" ECU_ADDRESS 0x60034BFE /end MEASUREMENT
/begin MEASUREMENT DFC_st.DFC_MDEmi "Status of DFC / Status of diagnostic fault check DFC_MDEmi" UBYTE DFC_OneToOne 1 100 0.00 255.0 FORMAT "%5.1" ECU_ADDRESS 0x60034BFF /end MEASUREMENT
/begin MEASUREMENT DFC_st.DFC_MDEmiStrt "Status of DFC / Status of diagnostic fault check DFC_MDEmiStrt" UBYTE DFC_OneToOne 1 100 0.00 255.0 FORMAT "%5.1" ECU_ADDRESS 0x60034C00 /end MEASUREMENT
/begin MEASUREMENT DFC_st.DFC_MDFco "Status of DFC / Status of diagnostic fault check DFC_MDFco" UBYTE DFC_OneToOne 1 100 0.00 255.0 FORMAT "%5.1" ECU_ADDRESS 0x60034C01 /end MEASUREMENT
/begin MEASUREMENT DFC_st.DFC_MDMpl "Status of DFC / Status of diagnostic fault check DFC_MDMpl" UBYTE DFC_OneToOne 1 100 0.00 255.0 FORMAT "%5.1" ECU_ADDRESS 0x60034C02 /end MEASUREMENT
/begin MEASUREMENT DFC_st.DFC_MDSegTiAdpn "Status of DFC / Status of diagnostic fault check DFC_MDSegTiAdpn" UBYTE DFC_OneToOne 1 100 0.00 255.0 FORMAT "%5.1" ECU_ADDRESS 0x60034C03 /end MEASUREMENT
/begin MEASUREMENT DFC_st.DFC_MDmax "Status of DFC / Status of diagnostic fault check DFC_MDmax" UBYTE DFC_OneToOne 1 100 0.00 255.0 FORMAT "%5.1" ECU_ADDRESS 0x60034C04 /end MEASUREMENT
/begin MEASUREMENT DFC_st.DFC_MOXEMM_SMU_ALM0_0 "Status of DFC / Status of diagnostic fault check DFC_MOXEMM_SMU_ALM0_0" UBYTE DFC_OneToOne 1 100 0.00 255.0 FORMAT "%5.1" ECU_ADDRESS 0x60034C05 /end MEASUREMENT
/begin MEASUREMENT DFC_st.DFC_MOXEMM_SMU_ALM0_1 "Status of DFC / Status of diagnostic fault check DFC_MOXEMM_SMU_ALM0_1" UBYTE DFC_OneToOne 1 100 0.00 255.0 FORMAT "%5.1" ECU_ADDRESS 0x60034C06 /end MEASUREMENT
/begin MEASUREMENT DFC_st.DFC_MOXEMM_SMU_ALM0_10 "Status of DFC / Status of diagnostic fault check DFC_MOXEMM_SMU_ALM0_10" UBYTE DFC_OneToOne 1 100 0.00 255.0 FORMAT "%5.1" ECU_ADDRESS 0x60034C07 /end MEASUREMENT
/begin MEASUREMENT DFC_st.DFC_MOXEMM_SMU_ALM0_11 "Status of DFC / Status of diagnostic fault check DFC_MOXEMM_SMU_ALM0_11" UBYTE DFC_OneToOne 1 100 0.00 255.0 FORMAT "%5.1" ECU_ADDRESS 0x60034C08 /end MEASUREMENT
/begin MEASUREMENT DFC_st.DFC_MOXEMM_SMU_ALM0_13 "Status of DFC / Status of diagnostic fault check DFC_MOXEMM_SMU_ALM0_13" UBYTE DFC_OneToOne 1 100 0.00 255.0 FORMAT "%5.1" ECU_ADDRESS 0x60034C09 /end MEASUREMENT
/begin MEASUREMENT DFC_st.DFC_MOXEMM_SMU_ALM0_14 "Status of DFC / Status of diagnostic fault check DFC_MOXEMM_SMU_ALM0_14" UBYTE DFC_OneToOne 1 100 0.00 255.0 FORMAT "%5.1" ECU_ADDRESS 0x60034C0A /end MEASUREMENT
/begin MEASUREMENT DFC_st.DFC_MOXEMM_SMU_ALM0_2 "Status of DFC / Status of diagnostic fault check DFC_MOXEMM_SMU_ALM0_2" UBYTE DFC_OneToOne 1 100 0.00 255.0 FORMAT "%5.1" ECU_ADDRESS 0x60034C0B /end MEASUREMENT
/begin MEASUREMENT DFC_st.DFC_MOXEMM_SMU_ALM0_22 "Status of DFC / Status of diagnostic fault check DFC_MOXEMM_SMU_ALM0_22" UBYTE DFC_OneToOne 1 100 0.00 255.0 FORMAT "%5.1" ECU_ADDRESS 0x60034C0C /end MEASUREMENT
/begin MEASUREMENT DFC_st.DFC_MOXEMM_SMU_ALM0_23 "Status of DFC / Status of diagnostic fault check DFC_MOXEMM_SMU_ALM0_23" UBYTE DFC_OneToOne 1 100 0.00 255.0 FORMAT "%5.1" ECU_ADDRESS 0x60034C0D /end MEASUREMENT
/begin MEASUREMENT DFC_st.DFC_MOXEMM_SMU_ALM0_4 "Status of DFC / Status of diagnostic fault check DFC_MOXEMM_SMU_ALM0_4" UBYTE DFC_OneToOne 1 100 0.00 255.0 FORMAT "%5.1" ECU_ADDRESS 0x60034C0E /end MEASUREMENT
/begin MEASUREMENT DFC_st.DFC_MOXEMM_SMU_ALM0_5 "Status of DFC / Status of diagnostic fault check DFC_MOXEMM_SMU_ALM0_5" UBYTE DFC_OneToOne 1 100 0.00 255.0 FORMAT "%5.1" ECU_ADDRESS 0x60034C0F /end MEASUREMENT
/begin MEASUREMENT DFC_st.DFC_MOXEMM_SMU_ALM0_7 "Status of DFC / Status of diagnostic fault check DFC_MOXEMM_SMU_ALM0_7" UBYTE DFC_OneToOne 1 100 0.00 255.0 FORMAT "%5.1" ECU_ADDRESS 0x60034C10 /end MEASUREMENT
/begin MEASUREMENT DFC_st.DFC_MOXEMM_SMU_ALM0_8 "Status of DFC / Status of diagnostic fault check DFC_MOXEMM_SMU_ALM0_8" UBYTE DFC_OneToOne 1 100 0.00 255.0 FORMAT "%5.1" ECU_ADDRESS 0x60034C11 /end MEASUREMENT
/begin MEASUREMENT DFC_st.DFC_MOXEMM_SMU_ALM10_16 "Status of DFC / Status of diagnostic fault check DFC_MOXEMM_SMU_ALM10_16" UBYTE DFC_OneToOne 1 100 0.00 255.0 FORMAT "%5.1" ECU_ADDRESS 0x60034C12 /end MEASUREMENT
/begin MEASUREMENT DFC_st.DFC_MOXEMM_SMU_ALM10_17 "Status of DFC / Status of diagnostic fault check DFC_MOXEMM_SMU_ALM10_17" UBYTE DFC_OneToOne 1 100 0.00 255.0 FORMAT "%5.1" ECU_ADDRESS 0x60034C13 /end MEASUREMENT
/begin MEASUREMENT DFC_st.DFC_MOXEMM_SMU_ALM10_21 "Status of DFC / Status of diagnostic fault check DFC_MOXEMM_SMU_ALM10_21" UBYTE DFC_OneToOne 1 100 0.00 255.0 FORMAT "%5.1" ECU_ADDRESS 0x60034C14 /end MEASUREMENT
/begin MEASUREMENT DFC_st.DFC_MOXEMM_SMU_ALM11_0 "Status of DFC / Status of diagnostic fault check DFC_MOXEMM_SMU_ALM11_0" UBYTE DFC_OneToOne 1 100 0.00 255.0 FORMAT "%5.1" ECU_ADDRESS 0x60034C15 /end MEASUREMENT
/begin MEASUREMENT DFC_st.DFC_MOXEMM_SMU_ALM11_1 "Status of DFC / Status of diagnostic fault check DFC_MOXEMM_SMU_ALM11_1" UBYTE DFC_OneToOne 1 100 0.00 255.0 FORMAT "%5.1" ECU_ADDRESS 0x60034C16 /end MEASUREMENT
/begin MEASUREMENT DFC_st.DFC_MOXEMM_SMU_ALM11_2 "Status of DFC / Status of diagnostic fault check DFC_MOXEMM_SMU_ALM11_2" UBYTE DFC_OneToOne 1 100 0.00 255.0 FORMAT "%5.1" ECU_ADDRESS 0x60034C17 /end MEASUREMENT
/begin MEASUREMENT DFC_st.DFC_MOXEMM_SMU_ALM11_3 "Status of DFC / Status of diagnostic fault check DFC_MOXEMM_SMU_ALM11_3" UBYTE DFC_OneToOne 1 100 0.00 255.0 FORMAT "%5.1" ECU_ADDRESS 0x60034C18 /end MEASUREMENT
/begin MEASUREMENT DFC_st.DFC_MOXEMM_SMU_ALM11_4 "Status of DFC / Status of diagnostic fault check DFC_MOXEMM_SMU_ALM11_4" UBYTE DFC_OneToOne 1 100 0.00 255.0 FORMAT "%5.1" ECU_ADDRESS 0x60034C19 /end MEASUREMENT
/begin MEASUREMENT DFC_st.DFC_MOXEMM_SMU_ALM11_5 "Status of DFC / Status of diagnostic fault check DFC_MOXEMM_SMU_ALM11_5" UBYTE DFC_OneToOne 1 100 0.00 255.0 FORMAT "%5.1" ECU_ADDRESS 0x60034C1A /end MEASUREMENT
/begin MEASUREMENT DFC_st.DFC_MOXEMM_SMU_ALM11_8 "Status of DFC / Status of diagnostic fault check DFC_MOXEMM_SMU_ALM11_8" UBYTE DFC_OneToOne 1 100 0.00 255.0 FORMAT "%5.1" ECU_ADDRESS 0x60034C1B /end MEASUREMENT
/begin MEASUREMENT DFC_st.DFC_MOXEMM_SMU_ALM11_9 "Status of DFC / Status of diagnostic fault check DFC_MOXEMM_SMU_ALM11_9" UBYTE DFC_OneToOne 1 100 0.00 255.0 FORMAT "%5.1" ECU_ADDRESS 0x60034C1C /end MEASUREMENT
/begin MEASUREMENT DFC_st.DFC_MOXEMM_SMU_ALM1_0 "Status of DFC / Status of diagnostic fault check DFC_MOXEMM_SMU_ALM1_0" UBYTE DFC_OneToOne 1 100 0.00 255.0 FORMAT "%5.1" ECU_ADDRESS 0x60034C1D /end MEASUREMENT
/begin MEASUREMENT DFC_st.DFC_MOXEMM_SMU_ALM1_1 "Status of DFC / Status of diagnostic fault check DFC_MOXEMM_SMU_ALM1_1" UBYTE DFC_OneToOne 1 100 0.00 255.0 FORMAT "%5.1" ECU_ADDRESS 0x60034C1E /end MEASUREMENT
/begin MEASUREMENT DFC_st.DFC_MOXEMM_SMU_ALM1_10 "Status of DFC / Status of diagnostic fault check DFC_MOXEMM_SMU_ALM1_10" UBYTE DFC_OneToOne 1 100 0.00 255.0 FORMAT "%5.1" ECU_ADDRESS 0x60034C1F /end MEASUREMENT
/begin MEASUREMENT DFC_st.DFC_MOXEMM_SMU_ALM1_11 "Status of DFC / Status of diagnostic fault check DFC_MOXEMM_SMU_ALM1_11" UBYTE DFC_OneToOne 1 100 0.00 255.0 FORMAT "%5.1" ECU_ADDRESS 0x60034C20 /end MEASUREMENT
/begin MEASUREMENT DFC_st.DFC_MOXEMM_SMU_ALM1_13 "Status of DFC / Status of diagnostic fault check DFC_MOXEMM_SMU_ALM1_13" UBYTE DFC_OneToOne 1 100 0.00 255.0 FORMAT "%5.1" ECU_ADDRESS 0x60034C21 /end MEASUREMENT
/begin MEASUREMENT DFC_st.DFC_MOXEMM_SMU_ALM1_14 "Status of DFC / Status of diagnostic fault check DFC_MOXEMM_SMU_ALM1_14" UBYTE DFC_OneToOne 1 100 0.00 255.0 FORMAT "%5.1" ECU_ADDRESS 0x60034C22 /end MEASUREMENT
/begin MEASUREMENT DFC_st.DFC_MOXEMM_SMU_ALM1_2 "Status of DFC / Status of diagnostic fault check DFC_MOXEMM_SMU_ALM1_2" UBYTE DFC_OneToOne 1 100 0.00 255.0 FORMAT "%5.1" ECU_ADDRESS 0x60034C23 /end MEASUREMENT
/begin MEASUREMENT DFC_st.DFC_MOXEMM_SMU_ALM1_22 "Status of DFC / Status of diagnostic fault check DFC_MOXEMM_SMU_ALM1_22" UBYTE DFC_OneToOne 1 100 0.00 255.0 FORMAT "%5.1" ECU_ADDRESS 0x60034C24 /end MEASUREMENT
/begin MEASUREMENT DFC_st.DFC_MOXEMM_SMU_ALM1_23 "Status of DFC / Status of diagnostic fault check DFC_MOXEMM_SMU_ALM1_23" UBYTE DFC_OneToOne 1 100 0.00 255.0 FORMAT "%5.1" ECU_ADDRESS 0x60034C25 /end MEASUREMENT
/begin MEASUREMENT DFC_st.DFC_MOXEMM_SMU_ALM1_4 "Status of DFC / Status of diagnostic fault check DFC_MOXEMM_SMU_ALM1_4" UBYTE DFC_OneToOne 1 100 0.00 255.0 FORMAT "%5.1" ECU_ADDRESS 0x60034C26 /end MEASUREMENT
/begin MEASUREMENT DFC_st.DFC_MOXEMM_SMU_ALM1_5 "Status of DFC / Status of diagnostic fault check DFC_MOXEMM_SMU_ALM1_5" UBYTE DFC_OneToOne 1 100 0.00 255.0 FORMAT "%5.1" ECU_ADDRESS 0x60034C27 /end MEASUREMENT
/begin MEASUREMENT DFC_st.DFC_MOXEMM_SMU_ALM1_7 "Status of DFC / Status of diagnostic fault check DFC_MOXEMM_SMU_ALM1_7" UBYTE DFC_OneToOne 1 100 0.00 255.0 FORMAT "%5.1" ECU_ADDRESS 0x60034C28 /end MEASUREMENT
/begin MEASUREMENT DFC_st.DFC_MOXEMM_SMU_ALM1_8 "Status of DFC / Status of diagnostic fault check DFC_MOXEMM_SMU_ALM1_8" UBYTE DFC_OneToOne 1 100 0.00 255.0 FORMAT "%5.1" ECU_ADDRESS 0x60034C29 /end MEASUREMENT
/begin MEASUREMENT DFC_st.DFC_MOXEMM_SMU_ALM21_0 "Status of DFC / Status of diagnostic fault check DFC_MOXEMM_SMU_ALM21_0" UBYTE DFC_OneToOne 1 100 0.00 255.0 FORMAT "%5.1" ECU_ADDRESS 0x60034C2A /end MEASUREMENT
/begin MEASUREMENT DFC_st.DFC_MOXEMM_SMU_ALM21_16 "Status of DFC / Status of diagnostic fault check DFC_MOXEMM_SMU_ALM21_16" UBYTE DFC_OneToOne 1 100 0.00 255.0 FORMAT "%5.1" ECU_ADDRESS 0x60034C2B /end MEASUREMENT
/begin MEASUREMENT DFC_st.DFC_MOXEMM_SMU_ALM21_3 "Status of DFC / Status of diagnostic fault check DFC_MOXEMM_SMU_ALM21_3" UBYTE DFC_OneToOne 1 100 0.00 255.0 FORMAT "%5.1" ECU_ADDRESS 0x60034C2C /end MEASUREMENT
/begin MEASUREMENT DFC_st.DFC_MOXEMM_SMU_ALM2_1 "Status of DFC / Status of diagnostic fault check DFC_MOXEMM_SMU_ALM2_1" UBYTE DFC_OneToOne 1 100 0.00 255.0 FORMAT "%5.1" ECU_ADDRESS 0x60034C2D /end MEASUREMENT
/begin MEASUREMENT DFC_st.DFC_MOXEMM_SMU_ALM2_10 "Status of DFC / Status of diagnostic fault check DFC_MOXEMM_SMU_ALM2_10" UBYTE DFC_OneToOne 1 100 0.00 255.0 FORMAT "%5.1" ECU_ADDRESS 0x60034C2E /end MEASUREMENT
/begin MEASUREMENT DFC_st.DFC_MOXEMM_SMU_ALM2_11 "Status of DFC / Status of diagnostic fault check DFC_MOXEMM_SMU_ALM2_11" UBYTE DFC_OneToOne 1 100 0.00 255.0 FORMAT "%5.1" ECU_ADDRESS 0x60034C2F /end MEASUREMENT
/begin MEASUREMENT DFC_st.DFC_MOXEMM_SMU_ALM2_13 "Status of DFC / Status of diagnostic fault check DFC_MOXEMM_SMU_ALM2_13" UBYTE DFC_OneToOne 1 100 0.00 255.0 FORMAT "%5.1" ECU_ADDRESS 0x60034C30 /end MEASUREMENT
/begin MEASUREMENT DFC_st.DFC_MOXEMM_SMU_ALM2_14 "Status of DFC / Status of diagnostic fault check DFC_MOXEMM_SMU_ALM2_14" UBYTE DFC_OneToOne 1 100 0.00 255.0 FORMAT "%5.1" ECU_ADDRESS 0x60034C31 /end MEASUREMENT
/begin MEASUREMENT DFC_st.DFC_MOXEMM_SMU_ALM2_22 "Status of DFC / Status of diagnostic fault check DFC_MOXEMM_SMU_ALM2_22" UBYTE DFC_OneToOne 1 100 0.00 255.0 FORMAT "%5.1" ECU_ADDRESS 0x60034C32 /end MEASUREMENT
/begin MEASUREMENT DFC_st.DFC_MOXEMM_SMU_ALM2_23 "Status of DFC / Status of diagnostic fault check DFC_MOXEMM_SMU_ALM2_23" UBYTE DFC_OneToOne 1 100 0.00 255.0 FORMAT "%5.1" ECU_ADDRESS 0x60034C33 /end MEASUREMENT
/begin MEASUREMENT DFC_st.DFC_MOXEMM_SMU_ALM2_4 "Status of DFC / Status of diagnostic fault check DFC_MOXEMM_SMU_ALM2_4" UBYTE DFC_OneToOne 1 100 0.00 255.0 FORMAT "%5.1" ECU_ADDRESS 0x60034C34 /end MEASUREMENT
/begin MEASUREMENT DFC_st.DFC_MOXEMM_SMU_ALM2_5 "Status of DFC / Status of diagnostic fault check DFC_MOXEMM_SMU_ALM2_5" UBYTE DFC_OneToOne 1 100 0.00 255.0 FORMAT "%5.1" ECU_ADDRESS 0x60034C35 /end MEASUREMENT
/begin MEASUREMENT DFC_st.DFC_MOXEMM_SMU_ALM2_7 "Status of DFC / Status of diagnostic fault check DFC_MOXEMM_SMU_ALM2_7" UBYTE DFC_OneToOne 1 100 0.00 255.0 FORMAT "%5.1" ECU_ADDRESS 0x60034C36 /end MEASUREMENT
/begin MEASUREMENT DFC_st.DFC_MOXEMM_SMU_ALM2_8 "Status of DFC / Status of diagnostic fault check DFC_MOXEMM_SMU_ALM2_8" UBYTE DFC_OneToOne 1 100 0.00 255.0 FORMAT "%5.1" ECU_ADDRESS 0x60034C37 /end MEASUREMENT
/begin MEASUREMENT DFC_st.DFC_MOXEMM_SMU_ALM6_0 "Status of DFC / Status of diagnostic fault check DFC_MOXEMM_SMU_ALM6_0" UBYTE DFC_OneToOne 1 100 0.00 255.0 FORMAT "%5.1" ECU_ADDRESS 0x60034C38 /end MEASUREMENT
/begin MEASUREMENT DFC_st.DFC_MOXEMM_SMU_ALM6_11 "Status of DFC / Status of diagnostic fault check DFC_MOXEMM_SMU_ALM6_11" UBYTE DFC_OneToOne 1 100 0.00 255.0 FORMAT "%5.1" ECU_ADDRESS 0x60034C39 /end MEASUREMENT
/begin MEASUREMENT DFC_st.DFC_MOXEMM_SMU_ALM6_12 "Status of DFC / Status of diagnostic fault check DFC_MOXEMM_SMU_ALM6_12" UBYTE DFC_OneToOne 1 100 0.00 255.0 FORMAT "%5.1" ECU_ADDRESS 0x60034C3A /end MEASUREMENT
/begin MEASUREMENT DFC_st.DFC_MOXEMM_SMU_ALM6_14 "Status of DFC / Status of diagnostic fault check DFC_MOXEMM_SMU_ALM6_14" UBYTE DFC_OneToOne 1 100 0.00 255.0 FORMAT "%5.1" ECU_ADDRESS 0x60034C3B /end MEASUREMENT
/begin MEASUREMENT DFC_st.DFC_MOXEMM_SMU_ALM6_15 "Status of DFC / Status of diagnostic fault check DFC_MOXEMM_SMU_ALM6_15" UBYTE DFC_OneToOne 1 100 0.00 255.0 FORMAT "%5.1" ECU_ADDRESS 0x60034C3C /end MEASUREMENT
/begin MEASUREMENT DFC_st.DFC_MOXEMM_SMU_ALM6_17 "Status of DFC / Status of diagnostic fault check DFC_MOXEMM_SMU_ALM6_17" UBYTE DFC_OneToOne 1 100 0.00 255.0 FORMAT "%5.1" ECU_ADDRESS 0x60034C3D /end MEASUREMENT
/begin MEASUREMENT DFC_st.DFC_MOXEMM_SMU_ALM6_18 "Status of DFC / Status of diagnostic fault check DFC_MOXEMM_SMU_ALM6_18" UBYTE DFC_OneToOne 1 100 0.00 255.0 FORMAT "%5.1" ECU_ADDRESS 0x60034C3E /end MEASUREMENT
/begin MEASUREMENT DFC_st.DFC_MOXEMM_SMU_ALM6_20 "Status of DFC / Status of diagnostic fault check DFC_MOXEMM_SMU_ALM6_20" UBYTE DFC_OneToOne 1 100 0.00 255.0 FORMAT "%5.1" ECU_ADDRESS 0x60034C3F /end MEASUREMENT
/begin MEASUREMENT DFC_st.DFC_MOXEMM_SMU_ALM6_21 "Status of DFC / Status of diagnostic fault check DFC_MOXEMM_SMU_ALM6_21" UBYTE DFC_OneToOne 1 100 0.00 255.0 FORMAT "%5.1" ECU_ADDRESS 0x60034C40 /end MEASUREMENT
/begin MEASUREMENT DFC_st.DFC_MOXEMM_SMU_ALM6_25 "Status of DFC / Status of diagnostic fault check DFC_MOXEMM_SMU_ALM6_25" UBYTE DFC_OneToOne 1 100 0.00 255.0 FORMAT "%5.1" ECU_ADDRESS 0x60034C41 /end MEASUREMENT
/begin MEASUREMENT DFC_st.DFC_MOXEMM_SMU_ALM6_4 "Status of DFC / Status of diagnostic fault check DFC_MOXEMM_SMU_ALM6_4" UBYTE DFC_OneToOne 1 100 0.00 255.0 FORMAT "%5.1" ECU_ADDRESS 0x60034C42 /end MEASUREMENT
/begin MEASUREMENT DFC_st.DFC_MOXEMM_SMU_ALM6_5 "Status of DFC / Status of diagnostic fault check DFC_MOXEMM_SMU_ALM6_5" UBYTE DFC_OneToOne 1 100 0.00 255.0 FORMAT "%5.1" ECU_ADDRESS 0x60034C43 /end MEASUREMENT
/begin MEASUREMENT DFC_st.DFC_MOXEMM_SMU_ALM6_7 "Status of DFC / Status of diagnostic fault check DFC_MOXEMM_SMU_ALM6_7" UBYTE DFC_OneToOne 1 100 0.00 255.0 FORMAT "%5.1" ECU_ADDRESS 0x60034C44 /end MEASUREMENT
/begin MEASUREMENT DFC_st.DFC_MOXEMM_SMU_ALM6_8 "Status of DFC / Status of diagnostic fault check DFC_MOXEMM_SMU_ALM6_8" UBYTE DFC_OneToOne 1 100 0.00 255.0 FORMAT "%5.1" ECU_ADDRESS 0x60034C45 /end MEASUREMENT
/begin MEASUREMENT DFC_st.DFC_MOXEMM_SMU_ALM7_1 "Status of DFC / Status of diagnostic fault check DFC_MOXEMM_SMU_ALM7_1" UBYTE DFC_OneToOne 1 100 0.00 255.0 FORMAT "%5.1" ECU_ADDRESS 0x60034C46 /end MEASUREMENT
/begin MEASUREMENT DFC_st.DFC_MOXEMM_SMU_ALM7_12 "Status of DFC / Status of diagnostic fault check DFC_MOXEMM_SMU_ALM7_12" UBYTE DFC_OneToOne 1 100 0.00 255.0 FORMAT "%5.1" ECU_ADDRESS 0x60034C47 /end MEASUREMENT
/begin MEASUREMENT DFC_st.DFC_MOXEMM_SMU_ALM7_13 "Status of DFC / Status of diagnostic fault check DFC_MOXEMM_SMU_ALM7_13" UBYTE DFC_OneToOne 1 100 0.00 255.0 FORMAT "%5.1" ECU_ADDRESS 0x60034C48 /end MEASUREMENT
/begin MEASUREMENT DFC_st.DFC_MOXEMM_SMU_ALM7_14 "Status of DFC / Status of diagnostic fault check DFC_MOXEMM_SMU_ALM7_14" UBYTE DFC_OneToOne 1 100 0.00 255.0 FORMAT "%5.1" ECU_ADDRESS 0x60034C49 /end MEASUREMENT
/begin MEASUREMENT DFC_st.DFC_MOXEMM_SMU_ALM7_15 "Status of DFC / Status of diagnostic fault check DFC_MOXEMM_SMU_ALM7_15" UBYTE DFC_OneToOne 1 100 0.00 255.0 FORMAT "%5.1" ECU_ADDRESS 0x60034C4A /end MEASUREMENT
/begin MEASUREMENT DFC_st.DFC_MOXEMM_SMU_ALM7_16 "Status of DFC / Status of diagnostic fault check DFC_MOXEMM_SMU_ALM7_16" UBYTE DFC_OneToOne 1 100 0.00 255.0 FORMAT "%5.1" ECU_ADDRESS 0x60034C4B /end MEASUREMENT
/begin MEASUREMENT DFC_st.DFC_MOXEMM_SMU_ALM7_17 "Status of DFC / Status of diagnostic fault check DFC_MOXEMM_SMU_ALM7_17" UBYTE DFC_OneToOne 1 100 0.00 255.0 FORMAT "%5.1" ECU_ADDRESS 0x60034C4C /end MEASUREMENT
/begin MEASUREMENT DFC_st.DFC_MOXEMM_SMU_ALM7_2 "Status of DFC / Status of diagnostic fault check DFC_MOXEMM_SMU_ALM7_2" UBYTE DFC_OneToOne 1 100 0.00 255.0 FORMAT "%5.1" ECU_ADDRESS 0x60034C4D /end MEASUREMENT
/begin MEASUREMENT DFC_st.DFC_MOXEMM_SMU_ALM7_20 "Status of DFC / Status of diagnostic fault check DFC_MOXEMM_SMU_ALM7_20" UBYTE DFC_OneToOne 1 100 0.00 255.0 FORMAT "%5.1" ECU_ADDRESS 0x60034C4E /end MEASUREMENT
/begin MEASUREMENT DFC_st.DFC_MOXEMM_SMU_ALM7_25 "Status of DFC / Status of diagnostic fault check DFC_MOXEMM_SMU_ALM7_25" UBYTE DFC_OneToOne 1 100 0.00 255.0 FORMAT "%5.1" ECU_ADDRESS 0x60034C4F /end MEASUREMENT
/begin MEASUREMENT DFC_st.DFC_MOXEMM_SMU_ALM7_26 "Status of DFC / Status of diagnostic fault check DFC_MOXEMM_SMU_ALM7_26" UBYTE DFC_OneToOne 1 100 0.00 255.0 FORMAT "%5.1" ECU_ADDRESS 0x60034C50 /end MEASUREMENT
/begin MEASUREMENT DFC_st.DFC_MOXEMM_SMU_ALM7_28 "Status of DFC / Status of diagnostic fault check DFC_MOXEMM_SMU_ALM7_28" UBYTE DFC_OneToOne 1 100 0.00 255.0 FORMAT "%5.1" ECU_ADDRESS 0x60034C51 /end MEASUREMENT
/begin MEASUREMENT DFC_st.DFC_MOXEMM_SMU_ALM7_29 "Status of DFC / Status of diagnostic fault check DFC_MOXEMM_SMU_ALM7_29" UBYTE DFC_OneToOne 1 100 0.00 255.0 FORMAT "%5.1" ECU_ADDRESS 0x60034C52 /end MEASUREMENT
/begin MEASUREMENT DFC_st.DFC_MOXEMM_SMU_ALM7_30 "Status of DFC / Status of diagnostic fault check DFC_MOXEMM_SMU_ALM7_30" UBYTE DFC_OneToOne 1 100 0.00 255.0 FORMAT "%5.1" ECU_ADDRESS 0x60034C53 /end MEASUREMENT
/begin MEASUREMENT DFC_st.DFC_MOXEMM_SMU_ALM7_31 "Status of DFC / Status of diagnostic fault check DFC_MOXEMM_SMU_ALM7_31" UBYTE DFC_OneToOne 1 100 0.00 255.0 FORMAT "%5.1" ECU_ADDRESS 0x60034C54 /end MEASUREMENT
/begin MEASUREMENT DFC_st.DFC_MOXEMM_SMU_ALM8_0 "Status of DFC / Status of diagnostic fault check DFC_MOXEMM_SMU_ALM8_0" UBYTE DFC_OneToOne 1 100 0.00 255.0 FORMAT "%5.1" ECU_ADDRESS 0x60034C55 /end MEASUREMENT
/begin MEASUREMENT DFC_st.DFC_MOXEMM_SMU_ALM8_1 "Status of DFC / Status of diagnostic fault check DFC_MOXEMM_SMU_ALM8_1" UBYTE DFC_OneToOne 1 100 0.00 255.0 FORMAT "%5.1" ECU_ADDRESS 0x60034C56 /end MEASUREMENT
/begin MEASUREMENT DFC_st.DFC_MOXEMM_SMU_ALM8_10 "Status of DFC / Status of diagnostic fault check DFC_MOXEMM_SMU_ALM8_10" UBYTE DFC_OneToOne 1 100 0.00 255.0 FORMAT "%5.1" ECU_ADDRESS 0x60034C57 /end MEASUREMENT
/begin MEASUREMENT DFC_st.DFC_MOXEMM_SMU_ALM8_11 "Status of DFC / Status of diagnostic fault check DFC_MOXEMM_SMU_ALM8_11" UBYTE DFC_OneToOne 1 100 0.00 255.0 FORMAT "%5.1" ECU_ADDRESS 0x60034C58 /end MEASUREMENT
/begin MEASUREMENT DFC_st.DFC_MOXEMM_SMU_ALM8_12 "Status of DFC / Status of diagnostic fault check DFC_MOXEMM_SMU_ALM8_12" UBYTE DFC_OneToOne 1 100 0.00 255.0 FORMAT "%5.1" ECU_ADDRESS 0x60034C59 /end MEASUREMENT
/begin MEASUREMENT DFC_st.DFC_MOXEMM_SMU_ALM8_16 "Status of DFC / Status of diagnostic fault check DFC_MOXEMM_SMU_ALM8_16" UBYTE DFC_OneToOne 1 100 0.00 255.0 FORMAT "%5.1" ECU_ADDRESS 0x60034C5A /end MEASUREMENT
/begin MEASUREMENT DFC_st.DFC_MOXEMM_SMU_ALM8_18 "Status of DFC / Status of diagnostic fault check DFC_MOXEMM_SMU_ALM8_18" UBYTE DFC_OneToOne 1 100 0.00 255.0 FORMAT "%5.1" ECU_ADDRESS 0x60034C5B /end MEASUREMENT
/begin MEASUREMENT DFC_st.DFC_MOXEMM_SMU_ALM8_2 "Status of DFC / Status of diagnostic fault check DFC_MOXEMM_SMU_ALM8_2" UBYTE DFC_OneToOne 1 100 0.00 255.0 FORMAT "%5.1" ECU_ADDRESS 0x60034C5C /end MEASUREMENT
/begin MEASUREMENT DFC_st.DFC_MOXEMM_SMU_ALM8_3 "Status of DFC / Status of diagnostic fault check DFC_MOXEMM_SMU_ALM8_3" UBYTE DFC_OneToOne 1 100 0.00 255.0 FORMAT "%5.1" ECU_ADDRESS 0x60034C5D /end MEASUREMENT
/begin MEASUREMENT DFC_st.DFC_MOXEMM_SMU_ALM8_31 "Status of DFC / Status of diagnostic fault check DFC_MOXEMM_SMU_ALM8_31" UBYTE DFC_OneToOne 1 100 0.00 255.0 FORMAT "%5.1" ECU_ADDRESS 0x60034C5E /end MEASUREMENT
/begin MEASUREMENT DFC_st.DFC_MOXEMM_SMU_ALM8_4 "Status of DFC / Status of diagnostic fault check DFC_MOXEMM_SMU_ALM8_4" UBYTE DFC_OneToOne 1 100 0.00 255.0 FORMAT "%5.1" ECU_ADDRESS 0x60034C5F /end MEASUREMENT
/begin MEASUREMENT DFC_st.DFC_MOXEMM_SMU_ALM9_0 "Status of DFC / Status of diagnostic fault check DFC_MOXEMM_SMU_ALM9_0" UBYTE DFC_OneToOne 1 100 0.00 255.0 FORMAT "%5.1" ECU_ADDRESS 0x60034C60 /end MEASUREMENT
/begin MEASUREMENT DFC_st.DFC_MOXEMM_SMU_ALM9_15 "Status of DFC / Status of diagnostic fault check DFC_MOXEMM_SMU_ALM9_15" UBYTE DFC_OneToOne 1 100 0.00 255.0 FORMAT "%5.1" ECU_ADDRESS 0x60034C61 /end MEASUREMENT
/begin MEASUREMENT DFC_st.DFC_MOXEMM_SMU_ALM9_3 "Status of DFC / Status of diagnostic fault check DFC_MOXEMM_SMU_ALM9_3" UBYTE DFC_OneToOne 1 100 0.00 255.0 FORMAT "%5.1" ECU_ADDRESS 0x60034C62 /end MEASUREMENT
/begin MEASUREMENT DFC_st.DFC_MoCADCNTP "Status of DFC / Status of diagnostic fault check DFC_MoCADCNTP" UBYTE DFC_OneToOne 1 100 0.00 255.0 FORMAT "%5.1" ECU_ADDRESS 0x60034C63 /end MEASUREMENT
/begin MEASUREMENT DFC_st.DFC_MoCADCTst "Status of DFC / Status of diagnostic fault check DFC_MoCADCTst" UBYTE DFC_OneToOne 1 100 0.00 255.0 FORMAT "%5.1" ECU_ADDRESS 0x60034C64 /end MEASUREMENT
/begin MEASUREMENT DFC_st.DFC_MoCSOPICO "Status of DFC / Status of diagnostic fault check DFC_MoCSOPICO" UBYTE DFC_OneToOne 1 100 0.00 255.0 FORMAT "%5.1" ECU_ADDRESS 0x60034C65 /end MEASUREMENT
/begin MEASUREMENT DFC_st.DFC_MoFAPP "Status of DFC / Status of diagnostic fault check DFC_MoFAPP" UBYTE DFC_OneToOne 1 100 0.00 255.0 FORMAT "%5.1" ECU_ADDRESS 0x60034C66 /end MEASUREMENT
/begin MEASUREMENT DFC_st.DFC_MoFAirFilgPrdc "Status of DFC / Status of diagnostic fault check DFC_MoFAirFilgPrdc" UBYTE DFC_OneToOne 1 100 0.00 255.0 FORMAT "%5.1" ECU_ADDRESS 0x60034C67 /end MEASUREMENT
/begin MEASUREMENT DFC_st.DFC_MoFAirFlCtOffPfi "Status of DFC / Status of diagnostic fault check DFC_MoFAirFlCtOffPfi" UBYTE DFC_OneToOne 1 100 0.00 255.0 FORMAT "%5.1" ECU_ADDRESS 0x60034C68 /end MEASUREMENT
/begin MEASUREMENT DFC_st.DFC_MoFAirFlCylPfi "Status of DFC / Status of diagnostic fault check DFC_MoFAirFlCylPfi" UBYTE DFC_OneToOne 1 100 0.00 255.0 FORMAT "%5.1" ECU_ADDRESS 0x60034C69 /end MEASUREMENT
/begin MEASUREMENT DFC_st.DFC_MoFAirFlIn "Status of DFC / Status of diagnostic fault check DFC_MoFAirFlIn" UBYTE DFC_OneToOne 1 100 0.00 255.0 FORMAT "%5.1" ECU_ADDRESS 0x60034C6A /end MEASUREMENT
/begin MEASUREMENT DFC_st.DFC_MoFAirFlMixCtlPfiChkAirFl "Status of DFC / Status of diagnostic fault check DFC_MoFAirFlMixCtlPfiChkAirFl" UBYTE DFC_OneToOne 1 100 0.00 255.0 FORMAT "%5.1" ECU_ADDRESS 0x60034C6B /end MEASUREMENT
/begin MEASUREMENT DFC_st.DFC_MoFAirFlMixCtlPfiChkCtrl "Status of DFC / Status of diagnostic fault check DFC_MoFAirFlMixCtlPfiChkCtrl" UBYTE DFC_OneToOne 1 100 0.00 255.0 FORMAT "%5.1" ECU_ADDRESS 0x60034C6C /end MEASUREMENT
/begin MEASUREMENT DFC_st.DFC_MoFAirFlMode "Status of DFC / Status of diagnostic fault check DFC_MoFAirFlMode" UBYTE DFC_OneToOne 1 100 0.00 255.0 FORMAT "%5.1" ECU_ADDRESS 0x60034C6D /end MEASUREMENT
/begin MEASUREMENT DFC_st.DFC_MoFESpd "Status of DFC / Status of diagnostic fault check DFC_MoFESpd" UBYTE DFC_OneToOne 1 100 0.00 255.0 FORMAT "%5.1" ECU_ADDRESS 0x60034C6E /end MEASUREMENT
/begin MEASUREMENT DFC_st.DFC_MoFIACo "Status of DFC / Status of diagnostic fault check DFC_MoFIACo" UBYTE DFC_OneToOne 1 100 0.00 255.0 FORMAT "%5.1" ECU_ADDRESS 0x60034C6F /end MEASUREMENT
/begin MEASUREMENT DFC_st.DFC_MoFICOL1 "Status of DFC / Status of diagnostic fault check DFC_MoFICOL1" UBYTE DFC_OneToOne 1 100 0.00 255.0 FORMAT "%5.1" ECU_ADDRESS 0x60034C70 /end MEASUREMENT
/begin MEASUREMENT DFC_st.DFC_MoFICOL2 "Status of DFC / Status of diagnostic fault check DFC_MoFICOL2" UBYTE DFC_OneToOne 1 100 0.00 255.0 FORMAT "%5.1" ECU_ADDRESS 0x60034C71 /end MEASUREMENT
/begin MEASUREMENT DFC_st.DFC_MoFStrt "Status of DFC / Status of diagnostic fault check DFC_MoFStrt" UBYTE DFC_OneToOne 1 100 0.00 255.0 FORMAT "%5.1" ECU_ADDRESS 0x60034C72 /end MEASUREMENT
/begin MEASUREMENT DFC_st.DFC_MoFTrqCmp "Status of DFC / Status of diagnostic fault check DFC_MoFTrqCmp" UBYTE DFC_OneToOne 1 100 0.00 255.0 FORMAT "%5.1" ECU_ADDRESS 0x60034C73 /end MEASUREMENT
/begin MEASUREMENT DFC_st.DFC_MoFTrqCmpMax "Status of DFC / Status of diagnostic fault check DFC_MoFTrqCmpMax" UBYTE DFC_OneToOne 1 100 0.00 255.0 FORMAT "%5.1" ECU_ADDRESS 0x60034C74 /end MEASUREMENT
/begin MEASUREMENT DFC_st.DFC_MoFTrqCmpMin "Status of DFC / Status of diagnostic fault check DFC_MoFTrqCmpMin" UBYTE DFC_OneToOne 1 100 0.00 255.0 FORMAT "%5.1" ECU_ADDRESS 0x60034C75 /end MEASUREMENT
/begin MEASUREMENT DFC_st.DFC_MoFVarPostBldSel "Status of DFC / Status of diagnostic fault check DFC_MoFVarPostBldSel" UBYTE DFC_OneToOne 1 100 0.00 255.0 FORMAT "%5.1" ECU_ADDRESS 0x60034C76 /end MEASUREMENT
/begin MEASUREMENT DFC_st.DFC_MoXEMMHwLTMCUFW "Status of DFC / Status of diagnostic fault check DFC_MoXEMMHwLTMCUFW" UBYTE DFC_OneToOne 1 100 0.00 255.0 FORMAT "%5.1" ECU_ADDRESS 0x60034C77 /end MEASUREMENT
/begin MEASUREMENT DFC_st.DFC_MoXEMMHwLTMonBIST "Status of DFC / Status of diagnostic fault check DFC_MoXEMMHwLTMonBIST" UBYTE DFC_OneToOne 1 100 0.00 255.0 FORMAT "%5.1" ECU_ADDRESS 0x60034C78 /end MEASUREMENT
/begin MEASUREMENT DFC_st.DFC_MoXEMMHwLTRegMonTest "Status of DFC / Status of diagnostic fault check DFC_MoXEMMHwLTRegMonTest" UBYTE DFC_OneToOne 1 100 0.00 255.0 FORMAT "%5.1" ECU_ADDRESS 0x60034C79 /end MEASUREMENT
/begin MEASUREMENT DFC_st.DFC_MoXEMMHwLTStbySMUAlvTest "Status of DFC / Status of diagnostic fault check DFC_MoXEMMHwLTStbySMUAlvTest" UBYTE DFC_OneToOne 1 100 0.00 255.0 FORMAT "%5.1" ECU_ADDRESS 0x60034C7A /end MEASUREMENT
/begin MEASUREMENT DFC_st.DFC_MoXEMMHwLTTempSens "Status of DFC / Status of diagnostic fault check DFC_MoXEMMHwLTTempSens" UBYTE DFC_OneToOne 1 100 0.00 255.0 FORMAT "%5.1" ECU_ADDRESS 0x60034C7B /end MEASUREMENT
/begin MEASUREMENT DFC_st.DFC_MoXEMMHwLTUCBCfg "Status of DFC / Status of diagnostic fault check DFC_MoXEMMHwLTUCBCfg" UBYTE DFC_OneToOne 1 100 0.00 255.0 FORMAT "%5.1" ECU_ADDRESS 0x60034C7C /end MEASUREMENT
/begin MEASUREMENT DFC_st.DFC_OCWDAABEActv "Status of DFC / Status of diagnostic fault check DFC_OCWDAABEActv" UBYTE DFC_OneToOne 1 100 0.00 255.0 FORMAT "%5.1" ECU_ADDRESS 0x60034C7D /end MEASUREMENT
/begin MEASUREMENT DFC_st.DFC_OCWDACom "Status of DFC / Status of diagnostic fault check DFC_OCWDACom" UBYTE DFC_OneToOne 1 100 0.00 255.0 FORMAT "%5.1" ECU_ADDRESS 0x60034C7E /end MEASUREMENT
/begin MEASUREMENT DFC_st.DFC_OCWDAErrPin "Status of DFC / Status of diagnostic fault check DFC_OCWDAErrPin" UBYTE DFC_OneToOne 1 100 0.00 255.0 FORMAT "%5.1" ECU_ADDRESS 0x60034C7F /end MEASUREMENT
/begin MEASUREMENT DFC_st.DFC_OCWDAOvrVltg "Status of DFC / Status of diagnostic fault check DFC_OCWDAOvrVltg" UBYTE DFC_OneToOne 1 100 0.00 255.0 FORMAT "%5.1" ECU_ADDRESS 0x60034C80 /end MEASUREMENT
/begin MEASUREMENT DFC_st.DFC_ORAmax "Status of DFC / Status of diagnostic fault check DFC_ORAmax" UBYTE DFC_OneToOne 1 100 0.00 255.0 FORMAT "%5.1" ECU_ADDRESS 0x60034C81 /end MEASUREMENT
/begin MEASUREMENT DFC_st.DFC_ORAmin "Status of DFC / Status of diagnostic fault check DFC_ORAmin" UBYTE DFC_OneToOne 1 100 0.00 255.0 FORMAT "%5.1" ECU_ADDRESS 0x60034C82 /end MEASUREMENT
/begin MEASUREMENT DFC_st.DFC_PLLSUmax "Status of DFC / Status of diagnostic fault check DFC_PLLSUmax" UBYTE DFC_OneToOne 1 100 0.00 255.0 FORMAT "%5.1" ECU_ADDRESS 0x60034C83 /end MEASUREMENT
/begin MEASUREMENT DFC_st.DFC_PLLSUmin "Status of DFC / Status of diagnostic fault check DFC_PLLSUmin" UBYTE DFC_OneToOne 1 100 0.00 255.0 FORMAT "%5.1" ECU_ADDRESS 0x60034C84 /end MEASUREMENT
/begin MEASUREMENT DFC_st.DFC_PSR1max "Status of DFC / Status of diagnostic fault check DFC_PSR1max" UBYTE DFC_OneToOne 1 100 0.00 255.0 FORMAT "%5.1" ECU_ADDRESS 0x60034C85 /end MEASUREMENT
/begin MEASUREMENT DFC_st.DFC_PSRBmax "Status of DFC / Status of diagnostic fault check DFC_PSRBmax" UBYTE DFC_OneToOne 1 100 0.00 255.0 FORMAT "%5.1" ECU_ADDRESS 0x60034C86 /end MEASUREMENT
/begin MEASUREMENT DFC_st.DFC_PSRBmin "Status of DFC / Status of diagnostic fault check DFC_PSRBmin" UBYTE DFC_OneToOne 1 100 0.00 255.0 FORMAT "%5.1" ECU_ADDRESS 0x60034C87 /end MEASUREMENT
/begin MEASUREMENT DFC_st.DFC_PSRPmax "Status of DFC / Status of diagnostic fault check DFC_PSRPmax" UBYTE DFC_OneToOne 1 100 0.00 255.0 FORMAT "%5.1" ECU_ADDRESS 0x60034C88 /end MEASUREMENT
/begin MEASUREMENT DFC_st.DFC_PSRPmin "Status of DFC / Status of diagnostic fault check DFC_PSRPmin" UBYTE DFC_OneToOne 1 100 0.00 255.0 FORMAT "%5.1" ECU_ADDRESS 0x60034C89 /end MEASUREMENT
/begin MEASUREMENT DFC_st.DFC_PSRPsig "Status of DFC / Status of diagnostic fault check DFC_PSRPsig" UBYTE DFC_OneToOne 1 100 0.00 255.0 FORMAT "%5.1" ECU_ADDRESS 0x60034C8A /end MEASUREMENT
/begin MEASUREMENT DFC_st.DFC_PSRmax "Status of DFC / Status of diagnostic fault check DFC_PSRmax" UBYTE DFC_OneToOne 1 100 0.00 255.0 FORMAT "%5.1" ECU_ADDRESS 0x60034C8B /end MEASUREMENT
/begin MEASUREMENT DFC_st.DFC_PUmax "Status of DFC / Status of diagnostic fault check DFC_PUmax" UBYTE DFC_OneToOne 1 100 0.00 255.0 FORMAT "%5.1" ECU_ADDRESS 0x60034C8C /end MEASUREMENT
/begin MEASUREMENT DFC_st.DFC_P_VSE11_OL "Status of DFC / Status of diagnostic fault check DFC_P_VSE11_OL" UBYTE DFC_OneToOne 1 100 0.00 255.0 FORMAT "%5.1" ECU_ADDRESS 0x60034C8D /end MEASUREMENT
/begin MEASUREMENT DFC_st.DFC_P_VSE11_SCB "Status of DFC / Status of diagnostic fault check DFC_P_VSE11_SCB" UBYTE DFC_OneToOne 1 100 0.00 255.0 FORMAT "%5.1" ECU_ADDRESS 0x60034C8E /end MEASUREMENT
/begin MEASUREMENT DFC_st.DFC_P_VSE11_SCG "Status of DFC / Status of diagnostic fault check DFC_P_VSE11_SCG" UBYTE DFC_OneToOne 1 100 0.00 255.0 FORMAT "%5.1" ECU_ADDRESS 0x60034C8F /end MEASUREMENT
/begin MEASUREMENT DFC_st.DFC_PhyHighAPP1 "Status of DFC / Status of diagnostic fault check DFC_PhyHighAPP1" UBYTE DFC_OneToOne 1 100 0.00 255.0 FORMAT "%5.1" ECU_ADDRESS 0x60034C90 /end MEASUREMENT
/begin MEASUREMENT DFC_st.DFC_PhyHighAPP2 "Status of DFC / Status of diagnostic fault check DFC_PhyHighAPP2" UBYTE DFC_OneToOne 1 100 0.00 255.0 FORMAT "%5.1" ECU_ADDRESS 0x60034C91 /end MEASUREMENT
/begin MEASUREMENT DFC_st.DFC_PhyLowAPP1 "Status of DFC / Status of diagnostic fault check DFC_PhyLowAPP1" UBYTE DFC_OneToOne 1 100 0.00 255.0 FORMAT "%5.1" ECU_ADDRESS 0x60034C92 /end MEASUREMENT
/begin MEASUREMENT DFC_st.DFC_PhyLowAPP2 "Status of DFC / Status of diagnostic fault check DFC_PhyLowAPP2" UBYTE DFC_OneToOne 1 100 0.00 255.0 FORMAT "%5.1" ECU_ADDRESS 0x60034C93 /end MEASUREMENT
/begin MEASUREMENT DFC_st.DFC_SRCHighAPP1 "Status of DFC / Status of diagnostic fault check DFC_SRCHighAPP1" UBYTE DFC_OneToOne 1 100 0.00 255.0 FORMAT "%5.1" ECU_ADDRESS 0x60034C94 /end MEASUREMENT
/begin MEASUREMENT DFC_st.DFC_SRCHighAPP2 "Status of DFC / Status of diagnostic fault check DFC_SRCHighAPP2" UBYTE DFC_OneToOne 1 100 0.00 255.0 FORMAT "%5.1" ECU_ADDRESS 0x60034C95 /end MEASUREMENT
/begin MEASUREMENT DFC_st.DFC_SRCLowAPP1 "Status of DFC / Status of diagnostic fault check DFC_SRCLowAPP1" UBYTE DFC_OneToOne 1 100 0.00 255.0 FORMAT "%5.1" ECU_ADDRESS 0x60034C96 /end MEASUREMENT
/begin MEASUREMENT DFC_st.DFC_SRCLowAPP2 "Status of DFC / Status of diagnostic fault check DFC_SRCLowAPP2" UBYTE DFC_OneToOne 1 100 0.00 255.0 FORMAT "%5.1" ECU_ADDRESS 0x60034C97 /end MEASUREMENT
/begin MEASUREMENT DFC_st.DFC_SSpMon2 "Status of DFC / Status of diagnostic fault check DFC_SSpMon2" UBYTE DFC_OneToOne 1 100 0.00 255.0 FORMAT "%5.1" ECU_ADDRESS 0x60034C98 /end MEASUREMENT
/begin MEASUREMENT DFC_st.DFC_SWReset_0 "Status of DFC / Status of diagnostic fault check DFC_SWReset_0" UBYTE DFC_OneToOne 1 100 0.00 255.0 FORMAT "%5.1" ECU_ADDRESS 0x60034C99 /end MEASUREMENT
/begin MEASUREMENT DFC_st.DFC_SWReset_1 "Status of DFC / Status of diagnostic fault check DFC_SWReset_1" UBYTE DFC_OneToOne 1 100 0.00 255.0 FORMAT "%5.1" ECU_ADDRESS 0x60034C9A /end MEASUREMENT
/begin MEASUREMENT DFC_st.DFC_SWReset_2 "Status of DFC / Status of diagnostic fault check DFC_SWReset_2" UBYTE DFC_OneToOne 1 100 0.00 255.0 FORMAT "%5.1" ECU_ADDRESS 0x60034C9B /end MEASUREMENT
/begin MEASUREMENT DFC_st.DFC_SyncAPP "Status of DFC / Status of diagnostic fault check DFC_SyncAPP" UBYTE DFC_OneToOne 1 100 0.00 255.0 FORMAT "%5.1" ECU_ADDRESS 0x60034C9C /end MEASUREMENT
/begin MEASUREMENT DFC_st.DFC_TAmax_Dummy "Status of DFC / Status of diagnostic fault check DFC_TAmax_Dummy" UBYTE DFC_OneToOne 1 100 0.00 255.0 FORMAT "%5.1" ECU_ADDRESS 0x60034C9D /end MEASUREMENT
/begin MEASUREMENT DFC_st.DFC_TKAEmax "Status of DFC / Status of diagnostic fault check DFC_TKAEmax" UBYTE DFC_OneToOne 1 100 0.00 255.0 FORMAT "%5.1" ECU_ADDRESS 0x60034C9E /end MEASUREMENT
/begin MEASUREMENT DFC_st.DFC_TKAEmin "Status of DFC / Status of diagnostic fault check DFC_TKAEmin" UBYTE DFC_OneToOne 1 100 0.00 255.0 FORMAT "%5.1" ECU_ADDRESS 0x60034C9F /end MEASUREMENT
/begin MEASUREMENT DFC_st.DFC_TKARmax "Status of DFC / Status of diagnostic fault check DFC_TKARmax" UBYTE DFC_OneToOne 1 100 0.00 255.0 FORMAT "%5.1" ECU_ADDRESS 0x60034CA0 /end MEASUREMENT
/begin MEASUREMENT DFC_st.DFC_TKARnpl "Status of DFC / Status of diagnostic fault check DFC_TKARnpl" UBYTE DFC_OneToOne 1 100 0.00 255.0 FORMAT "%5.1" ECU_ADDRESS 0x60034CA1 /end MEASUREMENT
/begin MEASUREMENT DFC_st.DFC_TMmax_Dummy "Status of DFC / Status of diagnostic fault check DFC_TMmax_Dummy" UBYTE DFC_OneToOne 1 100 0.00 255.0 FORMAT "%5.1" ECU_ADDRESS 0x60034CA2 /end MEASUREMENT
/begin MEASUREMENT DFC_st.DFC_TUMmax_Dummy "Status of DFC / Status of diagnostic fault check DFC_TUMmax_Dummy" UBYTE DFC_OneToOne 1 100 0.00 255.0 FORMAT "%5.1" ECU_ADDRESS 0x60034CA3 /end MEASUREMENT
/begin MEASUREMENT DFC_st.DFC_TWCDPriCatB1 "Status of DFC / Status of diagnostic fault check DFC_TWCDPriCatB1" UBYTE DFC_OneToOne 1 100 0.00 255.0 FORMAT "%5.1" ECU_ADDRESS 0x60034CA4 /end MEASUREMENT
/begin MEASUREMENT DFC_st.DFC_ThrVlvClsdPosnFirstOffsLrnImpoB1 "Status of DFC / Status of diagnostic fault check DFC_ThrVlvClsdPosnFirstOffsLrnImpoB1" UBYTE DFC_OneToOne 1 100 0.00 255.0 FORMAT "%5.1" ECU_ADDRESS 0x60034CA5 /end MEASUREMENT
/begin MEASUREMENT DFC_st.DFC_ThrVlvClsdPosnOffsLrnImpoB1 "Status of DFC / Status of diagnostic fault check DFC_ThrVlvClsdPosnOffsLrnImpoB1" UBYTE DFC_OneToOne 1 100 0.00 255.0 FORMAT "%5.1" ECU_ADDRESS 0x60034CA6 /end MEASUREMENT
/begin MEASUREMENT DFC_st.DFC_ThrVlvClsdPosnOffsLrnMaxB1 "Status of DFC / Status of diagnostic fault check DFC_ThrVlvClsdPosnOffsLrnMaxB1" UBYTE DFC_OneToOne 1 100 0.00 255.0 FORMAT "%5.1" ECU_ADDRESS 0x60034CA7 /end MEASUREMENT
/begin MEASUREMENT DFC_st.DFC_ThrVlvClsdPosnOffsLrnMinB1 "Status of DFC / Status of diagnostic fault check DFC_ThrVlvClsdPosnOffsLrnMinB1" UBYTE DFC_OneToOne 1 100 0.00 255.0 FORMAT "%5.1" ECU_ADDRESS 0x60034CA8 /end MEASUREMENT
/begin MEASUREMENT DFC_st.DFC_ThrVlvCtrlDeB1 "Status of DFC / Status of diagnostic fault check DFC_ThrVlvCtrlDeB1" UBYTE DFC_OneToOne 1 100 0.00 255.0 FORMAT "%5.1" ECU_ADDRESS 0x60034CA9 /end MEASUREMENT
/begin MEASUREMENT DFC_st.DFC_ThrVlvDycB1 "Status of DFC / Status of diagnostic fault check DFC_ThrVlvDycB1" UBYTE DFC_OneToOne 1 100 0.00 255.0 FORMAT "%5.1" ECU_ADDRESS 0x60034CAA /end MEASUREMENT
/begin MEASUREMENT DFC_st.DFC_ThrVlvLimpAirPosnMaxAbsltDriftB1 "Status of DFC / Status of diagnostic fault check DFC_ThrVlvLimpAirPosnMaxAbsltDriftB1" UBYTE DFC_OneToOne 1 100 0.00 255.0 FORMAT "%5.1" ECU_ADDRESS 0x60034CAB /end MEASUREMENT
/begin MEASUREMENT DFC_st.DFC_ThrVlvLimpAirPosnMaxB1 "Status of DFC / Status of diagnostic fault check DFC_ThrVlvLimpAirPosnMaxB1" UBYTE DFC_OneToOne 1 100 0.00 255.0 FORMAT "%5.1" ECU_ADDRESS 0x60034CAC /end MEASUREMENT
/begin MEASUREMENT DFC_st.DFC_ThrVlvLimpAirPosnMaxRelDriftB1 "Status of DFC / Status of diagnostic fault check DFC_ThrVlvLimpAirPosnMaxRelDriftB1" UBYTE DFC_OneToOne 1 100 0.00 255.0 FORMAT "%5.1" ECU_ADDRESS 0x60034CAD /end MEASUREMENT
/begin MEASUREMENT DFC_st.DFC_ThrVlvLimpAirPosnMinB1 "Status of DFC / Status of diagnostic fault check DFC_ThrVlvLimpAirPosnMinB1" UBYTE DFC_OneToOne 1 100 0.00 255.0 FORMAT "%5.1" ECU_ADDRESS 0x60034CAE /end MEASUREMENT
/begin MEASUREMENT DFC_st.DFC_ThrVlvOpenLoadB1 "Status of DFC / Status of diagnostic fault check DFC_ThrVlvOpenLoadB1" UBYTE DFC_OneToOne 1 100 0.00 255.0 FORMAT "%5.1" ECU_ADDRESS 0x60034CAF /end MEASUREMENT
/begin MEASUREMENT DFC_st.DFC_ThrVlvOpenSprgB1 "Status of DFC / Status of diagnostic fault check DFC_ThrVlvOpenSprgB1" UBYTE DFC_OneToOne 1 100 0.00 255.0 FORMAT "%5.1" ECU_ADDRESS 0x60034CB0 /end MEASUREMENT
/begin MEASUREMENT DFC_st.DFC_ThrVlvOpenSprgSprdB1 "Status of DFC / Status of diagnostic fault check DFC_ThrVlvOpenSprgSprdB1" UBYTE DFC_OneToOne 1 100 0.00 255.0 FORMAT "%5.1" ECU_ADDRESS 0x60034CB1 /end MEASUREMENT
/begin MEASUREMENT DFC_st.DFC_ThrVlvOpenSprgTwnB1 "Status of DFC / Status of diagnostic fault check DFC_ThrVlvOpenSprgTwnB1" UBYTE DFC_OneToOne 1 100 0.00 255.0 FORMAT "%5.1" ECU_ADDRESS 0x60034CB2 /end MEASUREMENT
/begin MEASUREMENT DFC_st.DFC_ThrVlvOverTB1 "Status of DFC / Status of diagnostic fault check DFC_ThrVlvOverTB1" UBYTE DFC_OneToOne 1 100 0.00 255.0 FORMAT "%5.1" ECU_ADDRESS 0x60034CB3 /end MEASUREMENT
/begin MEASUREMENT DFC_st.DFC_ThrVlvRetSprgB1 "Status of DFC / Status of diagnostic fault check DFC_ThrVlvRetSprgB1" UBYTE DFC_OneToOne 1 100 0.00 255.0 FORMAT "%5.1" ECU_ADDRESS 0x60034CB4 /end MEASUREMENT
/begin MEASUREMENT DFC_st.DFC_ThrVlvRetSprgSprdB1 "Status of DFC / Status of diagnostic fault check DFC_ThrVlvRetSprgSprdB1" UBYTE DFC_OneToOne 1 100 0.00 255.0 FORMAT "%5.1" ECU_ADDRESS 0x60034CB5 /end MEASUREMENT
/begin MEASUREMENT DFC_st.DFC_ThrVlvRetSprgTwnB1 "Status of DFC / Status of diagnostic fault check DFC_ThrVlvRetSprgTwnB1" UBYTE DFC_OneToOne 1 100 0.00 255.0 FORMAT "%5.1" ECU_ADDRESS 0x60034CB6 /end MEASUREMENT
/begin MEASUREMENT DFC_st.DFC_ThrVlvSens1MaxB1 "Status of DFC / Status of diagnostic fault check DFC_ThrVlvSens1MaxB1" UBYTE DFC_OneToOne 1 100 0.00 255.0 FORMAT "%5.1" ECU_ADDRESS 0x60034CB7 /end MEASUREMENT
/begin MEASUREMENT DFC_st.DFC_ThrVlvSens1NplB1 "Status of DFC / Status of diagnostic fault check DFC_ThrVlvSens1NplB1" UBYTE DFC_OneToOne 1 100 0.00 255.0 FORMAT "%5.1" ECU_ADDRESS 0x60034CB8 /end MEASUREMENT
/begin MEASUREMENT DFC_st.DFC_ThrVlvSens2MaxB1 "Status of DFC / Status of diagnostic fault check DFC_ThrVlvSens2MaxB1" UBYTE DFC_OneToOne 1 100 0.00 255.0 FORMAT "%5.1" ECU_ADDRESS 0x60034CB9 /end MEASUREMENT
/begin MEASUREMENT DFC_st.DFC_ThrVlvSens2MinB1 "Status of DFC / Status of diagnostic fault check DFC_ThrVlvSens2MinB1" UBYTE DFC_OneToOne 1 100 0.00 255.0 FORMAT "%5.1" ECU_ADDRESS 0x60034CBA /end MEASUREMENT
/begin MEASUREMENT DFC_st.DFC_ThrVlvSens2NplB1 "Status of DFC / Status of diagnostic fault check DFC_ThrVlvSens2NplB1" UBYTE DFC_OneToOne 1 100 0.00 255.0 FORMAT "%5.1" ECU_ADDRESS 0x60034CBB /end MEASUREMENT
/begin MEASUREMENT DFC_st.DFC_ThrVlvShoCircB1 "Status of DFC / Status of diagnostic fault check DFC_ThrVlvShoCircB1" UBYTE DFC_OneToOne 1 100 0.00 255.0 FORMAT "%5.1" ECU_ADDRESS 0x60034CBC /end MEASUREMENT
/begin MEASUREMENT DFC_st.DFC_ThrVlvSpiErrB1 "Status of DFC / Status of diagnostic fault check DFC_ThrVlvSpiErrB1" UBYTE DFC_OneToOne 1 100 0.00 255.0 FORMAT "%5.1" ECU_ADDRESS 0x60034CBD /end MEASUREMENT
/begin MEASUREMENT DFC_st.DFC_ThrvlvSens1MinB1 "Status of DFC / Status of diagnostic fault check DFC_ThrvlvSens1MinB1" UBYTE DFC_OneToOne 1 100 0.00 255.0 FORMAT "%5.1" ECU_ADDRESS 0x60034CBE /end MEASUREMENT
/begin MEASUREMENT DFC_st.DFC_TiOffTBasdChkFast "Status of DFC / Status of diagnostic fault check DFC_TiOffTBasdChkFast" UBYTE DFC_OneToOne 1 100 0.00 255.0 FORMAT "%5.1" ECU_ADDRESS 0x60034CBF /end MEASUREMENT
/begin MEASUREMENT DFC_st.DFC_TiOffTBasdChkSlow "Status of DFC / Status of diagnostic fault check DFC_TiOffTBasdChkSlow" UBYTE DFC_OneToOne 1 100 0.00 255.0 FORMAT "%5.1" ECU_ADDRESS 0x60034CC0 /end MEASUREMENT
/begin MEASUREMENT DFC_st.DFC_UEGOHeatrCtlS1B1 "Status of DFC / Status of diagnostic fault check DFC_UEGOHeatrCtlS1B1" UBYTE DFC_OneToOne 1 100 0.00 255.0 FORMAT "%5.1" ECU_ADDRESS 0x60034CC1 /end MEASUREMENT
/begin MEASUREMENT DFC_st.DFC_UEGOSnsrMntdS1B1 "Status of DFC / Status of diagnostic fault check DFC_UEGOSnsrMntdS1B1" UBYTE DFC_OneToOne 1 100 0.00 255.0 FORMAT "%5.1" ECU_ADDRESS 0x60034CC2 /end MEASUREMENT
/begin MEASUREMENT DFC_st.DFC_VehVSig "Status of DFC / Status of diagnostic fault check DFC_VehVSig" UBYTE DFC_OneToOne 1 100 0.00 255.0 FORMAT "%5.1" ECU_ADDRESS 0x60034CC3 /end MEASUREMENT
/begin MEASUREMENT DFC_st.DFC_VlvLftFbSwtIntk11SpclFail "Status of DFC / Status of diagnostic fault check DFC_VlvLftFbSwtIntk11SpclFail" UBYTE DFC_OneToOne 1 100 0.00 255.0 FORMAT "%5.1" ECU_ADDRESS 0x60034CC4 /end MEASUREMENT
/begin MEASUREMENT DFC_st.DFC_VlvLftFbSwtIntk11StdFail "Status of DFC / Status of diagnostic fault check DFC_VlvLftFbSwtIntk11StdFail" UBYTE DFC_OneToOne 1 100 0.00 255.0 FORMAT "%5.1" ECU_ADDRESS 0x60034CC5 /end MEASUREMENT
/begin MEASUREMENT DFC_stClctFault_mp "Collected error states of all fault checks" UWORD DFC_OneToOne 1 100 0.00 65535.00 FORMAT "%8.2" ARRAY_SIZE 45 ECU_ADDRESS 0x70008968 /end MEASUREMENT
/begin MEASUREMENT DFC_stClctTst_mp "Collected tested states of all fault checks" UWORD DFC_OneToOne 1 100 0.00 65535.00 FORMAT "%8.2" ARRAY_SIZE 45 ECU_ADDRESS 0x7000890E /end MEASUREMENT
/begin MEASUREMENT DFC_stFinal "Disable (or check finished) status of all DFCs (for PID$41 calculation)" UWORD DFC_OneToOne 1 100 0.00 65535.00 FORMAT "%8.2" ARRAY_SIZE 45 ECU_ADDRESS 0x5000573C /end MEASUREMENT
/begin MEASUREMENT DFC_stMem "Fault entry exists - per DFC" UWORD DFC_OneToOne 1 100 0.00 65535.00 FORMAT "%8.2" ARRAY_SIZE 45 ECU_ADDRESS 0x600349AC /end MEASUREMENT
/begin MEASUREMENT DFC_stRdy "Ready state due to ""OK"" per DFC" UWORD DFC_OneToOne 1 100 0.00 65535.00 FORMAT "%8.2" ARRAY_SIZE 45 ECU_ADDRESS 0x60035FDA /end MEASUREMENT
/begin MEASUREMENT DSQ_st.DSQ_ACClntP "Status signal quality / Status of signal quality DSQ_ACClntP" UBYTE DFC_OneToOne 1 100 0.00 255.0 FORMAT "%5.1" ECU_ADDRESS 0x6000AA58 /end MEASUREMENT
/begin MEASUREMENT DSQ_st.DSQ_ACEvpT "Status signal quality / Status of signal quality DSQ_ACEvpT" UBYTE DFC_OneToOne 1 100 0.00 255.0 FORMAT "%5.1" ECU_ADDRESS 0x6000AA59 /end MEASUREMENT
/begin MEASUREMENT DSQ_st.DSQ_AirCCmprActr "Status signal quality / Status of signal quality DSQ_AirCCmprActr" UBYTE DFC_OneToOne 1 100 0.00 255.0 FORMAT "%5.1" ECU_ADDRESS 0x6000AA5A /end MEASUREMENT
/begin MEASUREMENT DSQ_st.DSQ_BattU "Status signal quality / Status of signal quality DSQ_BattU" UBYTE DFC_OneToOne 1 100 0.00 255.0 FORMAT "%5.1" ECU_ADDRESS 0x6000AA5B /end MEASUREMENT
/begin MEASUREMENT DSQ_st.DSQ_BattULo "Status signal quality / Status of signal quality DSQ_BattULo" UBYTE DFC_OneToOne 1 100 0.00 255.0 FORMAT "%5.1" ECU_ADDRESS 0x6000AA5C /end MEASUREMENT
/begin MEASUREMENT DSQ_st.DSQ_CoVMDIDASFail "Status signal quality / Status of signal quality DSQ_CoVMDIDASFail" UBYTE DFC_OneToOne 1 100 0.00 255.0 FORMAT "%5.1" ECU_ADDRESS 0x6000AA5D /end MEASUREMENT
/begin MEASUREMENT DSQ_st.DSQ_DSMInhibitAlways "Status signal quality / Status of signal quality DSQ_DSMInhibitAlways" UBYTE DFC_OneToOne 1 100 0.00 255.0 FORMAT "%5.1" ECU_ADDRESS 0x6000AA5E /end MEASUREMENT
/begin MEASUREMENT DSQ_st.DSQ_ElecLd "Status signal quality / Status of signal quality DSQ_ElecLd" UBYTE DFC_OneToOne 1 100 0.00 255.0 FORMAT "%5.1" ECU_ADDRESS 0x6000AA5F /end MEASUREMENT
/begin MEASUREMENT DSQ_st.DSQ_EngICO "Status signal quality / Status of signal quality DSQ_EngICO" UBYTE DFC_OneToOne 1 100 0.00 255.0 FORMAT "%5.1" ECU_ADDRESS 0x6000AA60 /end MEASUREMENT
/begin MEASUREMENT DSQ_st.DSQ_EpmCaSSigQuality "Status signal quality / Status of signal quality DSQ_EpmCaSSigQuality" UBYTE DFC_OneToOne 1 100 0.00 255.0 FORMAT "%5.1" ECU_ADDRESS 0x6000AA61 /end MEASUREMENT
/begin MEASUREMENT DSQ_st.DSQ_EpmReverseRun "Status signal quality / Status of signal quality DSQ_EpmReverseRun" UBYTE DFC_OneToOne 1 100 0.00 255.0 FORMAT "%5.1" ECU_ADDRESS 0x6000AA62 /end MEASUREMENT
/begin MEASUREMENT DSQ_st.DSQ_FanDIO_0 "Status signal quality / Status of signal quality DSQ_FanDIO_0" UBYTE DFC_OneToOne 1 100 0.00 255.0 FORMAT "%5.1" ECU_ADDRESS 0x6000AA63 /end MEASUREMENT
/begin MEASUREMENT DSQ_st.DSQ_FanDIO_1 "Status signal quality / Status of signal quality DSQ_FanDIO_1" UBYTE DFC_OneToOne 1 100 0.00 255.0 FORMAT "%5.1" ECU_ADDRESS 0x6000AA64 /end MEASUREMENT
/begin MEASUREMENT DSQ_st.DSQ_FuelP "Status signal quality / Status of signal quality DSQ_FuelP" UBYTE DFC_OneToOne 1 100 0.00 255.0 FORMAT "%5.1" ECU_ADDRESS 0x6000AA65 /end MEASUREMENT
/begin MEASUREMENT DSQ_st.DSQ_FuelT "Status signal quality / Status of signal quality DSQ_FuelT" UBYTE DFC_OneToOne 1 100 0.00 255.0 FORMAT "%5.1" ECU_ADDRESS 0x6000AA66 /end MEASUREMENT
/begin MEASUREMENT DSQ_st.DSQ_GbxPNPos "Status signal quality / Status of signal quality DSQ_GbxPNPos" UBYTE DFC_OneToOne 1 100 0.00 255.0 FORMAT "%5.1" ECU_ADDRESS 0x6000AA67 /end MEASUREMENT
/begin MEASUREMENT DSQ_st.DSQ_GbxPosNotPN "Status signal quality / Status of signal quality DSQ_GbxPosNotPN" UBYTE DFC_OneToOne 1 100 0.00 255.0 FORMAT "%5.1" ECU_ADDRESS 0x6000AA68 /end MEASUREMENT
/begin MEASUREMENT DSQ_st.DSQ_MRly "Status signal quality / Status of signal quality DSQ_MRly" UBYTE DFC_OneToOne 1 100 0.00 255.0 FORMAT "%5.1" ECU_ADDRESS 0x6000AA69 /end MEASUREMENT
/begin MEASUREMENT DSQ_st.DSQ_PEnvMeasVld "Status signal quality / Status of signal quality DSQ_PEnvMeasVld" UBYTE DFC_OneToOne 1 100 0.00 255.0 FORMAT "%5.1" ECU_ADDRESS 0x6000AA6A /end MEASUREMENT
/begin MEASUREMENT DSQ_st.DSQ_PEnvVld "Status signal quality / Status of signal quality DSQ_PEnvVld" UBYTE DFC_OneToOne 1 100 0.00 255.0 FORMAT "%5.1" ECU_ADDRESS 0x6000AA6B /end MEASUREMENT
/begin MEASUREMENT DSQ_st.DSQ_PEnv_pRaw "Status signal quality / Status of signal quality DSQ_PEnv_pRaw" UBYTE DFC_OneToOne 1 100 0.00 255.0 FORMAT "%5.1" ECU_ADDRESS 0x6000AA6C /end MEASUREMENT
/begin MEASUREMENT DSQ_st.DSQ_PThrVlvUs "Status signal quality / Status of signal quality DSQ_PThrVlvUs" UBYTE DFC_OneToOne 1 100 0.00 255.0 FORMAT "%5.1" ECU_ADDRESS 0x6000AA6D /end MEASUREMENT
/begin MEASUREMENT DSQ_st.DSQ_PThrVlvUsB1 "Status signal quality / Status of signal quality DSQ_PThrVlvUsB1" UBYTE DFC_OneToOne 1 100 0.00 255.0 FORMAT "%5.1" ECU_ADDRESS 0x6000AA6E /end MEASUREMENT
/begin MEASUREMENT DSQ_st.DSQ_StrtImobChk "Status signal quality / Status of signal quality DSQ_StrtImobChk" UBYTE DFC_OneToOne 1 100 0.00 255.0 FORMAT "%5.1" ECU_ADDRESS 0x6000AA6F /end MEASUREMENT
/begin MEASUREMENT DSQ_st.DSQ_TDevCenColdStrt "Status signal quality / Status of signal quality DSQ_TDevCenColdStrt" UBYTE DFC_OneToOne 1 100 0.00 255.0 FORMAT "%5.1" ECU_ADDRESS 0x6000AA70 /end MEASUREMENT
/begin MEASUREMENT DSQ_st.DSQ_UEGOHeatrPwrOKS1B1 "Status signal quality / Status of signal quality DSQ_UEGOHeatrPwrOKS1B1" UBYTE DFC_OneToOne 1 100 0.00 255.0 FORMAT "%5.1" ECU_ADDRESS 0x6000AA71 /end MEASUREMENT
/begin MEASUREMENT DSQ_st.DSQ_UEGOIPmpS1B1 "Status signal quality / Status of signal quality DSQ_UEGOIPmpS1B1" UBYTE DFC_OneToOne 1 100 0.00 255.0 FORMAT "%5.1" ECU_ADDRESS 0x6000AA72 /end MEASUREMENT
/begin MEASUREMENT DSQ_st.DSQ_UEGOLamS1B1 "Status signal quality / Status of signal quality DSQ_UEGOLamS1B1" UBYTE DFC_OneToOne 1 100 0.00 255.0 FORMAT "%5.1" ECU_ADDRESS 0x6000AA73 /end MEASUREMENT
/begin MEASUREMENT DSQ_st.DSQ_UEGOTCtrlS1B1 "Status signal quality / Status of signal quality DSQ_UEGOTCtrlS1B1" UBYTE DFC_OneToOne 1 100 0.00 255.0 FORMAT "%5.1" ECU_ADDRESS 0x6000AA74 /end MEASUREMENT
/begin MEASUREMENT DSQ_st.DSQ_VehV "Status signal quality / Status of signal quality DSQ_VehV" UBYTE DFC_OneToOne 1 100 0.00 255.0 FORMAT "%5.1" ECU_ADDRESS 0x6000AA75 /end MEASUREMENT
/begin MEASUREMENT DSQ_st.DSQ_VehVSnsr "Status signal quality / Status of signal quality DSQ_VehVSnsr" UBYTE DFC_OneToOne 1 100 0.00 255.0 FORMAT "%5.1" ECU_ADDRESS 0x6000AA76 /end MEASUREMENT
/begin MEASUREMENT DSQ_st.DSQ_stAPP "Status signal quality / Status of signal quality DSQ_stAPP" UBYTE DFC_OneToOne 1 100 0.00 255.0 FORMAT "%5.1" ECU_ADDRESS 0x6000AA77 /end MEASUREMENT
/begin MEASUREMENT DSQ_st.DSQ_stComEAT4 "Status signal quality / Status of signal quality DSQ_stComEAT4" UBYTE DFC_OneToOne 1 100 0.00 255.0 FORMAT "%5.1" ECU_ADDRESS 0x6000AA78 /end MEASUREMENT
/begin FUNCTION DFC "30000.33.0Diagnostic Fault Check"
 /begin DEF_CHARACTERISTIC DFC_CtlMsk.DFC_Unused_C DFC_CtlMsk.DFC_AltIOACGFailr_C DFC_CtlMsk.DFC_AltIOACGHiVltg_C DFC_CtlMsk.DFC_AltIOACGLoVltg_C DFC_CtlMsk.DFC_AltIOACGTHi_C DFC_CtlMsk.DFC_AltIODConnACG_C DFC_CtlMsk.DFC_BattUHiFailr_C DFC_CtlMsk.DFC_BattULoFailr_C DFC_CtlMsk.DFC_BrkBstPDriftHiErr_C DFC_CtlMsk.DFC_BrkBstPDriftLoErr_C DFC_CtlMsk.DFC_BrkBstPSnsrStuck_C DFC_CtlMsk.DFC_BrkMnSwtContOn_C DFC_CtlMsk.DFC_BrkMnSwtNotStp_C DFC_CtlMsk.DFC_BrkNpl_C DFC_CtlMsk.DFC_BrkRdntSwtContOn_C DFC_CtlMsk.DFC_BrkRdntSwtNotStp_C DFC_CtlMsk.DFC_Clth3ONStuck_C DFC_CtlMsk.DFC_Clth4OFFStuck_C DFC_CtlMsk.DFC_ClthOFFStuck_C DFC_CtlMsk.DFC_ClthONStuck_C DFC_CtlMsk.DFC_ClthStkFailInfo_C DFC_CtlMsk.DFC_ComACFailInfo_C DFC_CtlMsk.DFC_ComATFTValErr_C DFC_CtlMsk.DFC_ComATMILReq_C DFC_CtlMsk.DFC_ComAYCAChksum_C DFC_CtlMsk.DFC_ComAYCARingCnt_C DFC_CtlMsk.DFC_ComAYCATOut_C DFC_CtlMsk.DFC_ComAYCDChkSum_C DFC_CtlMsk.DFC_ComAYCDTOut_C DFC_CtlMsk.DFC_ComAYCFChksum_C DFC_CtlMsk.DFC_ComAYCFRingCnt_C DFC_CtlMsk.DFC_ComAYCFTOut_C DFC_CtlMsk.DFC_ComAYCGChksum_C DFC_CtlMsk.DFC_ComAYCGRingCnt_C DFC_CtlMsk.DFC_ComAYCGTOut_C DFC_CtlMsk.DFC_ComAYCIChkSum_C DFC_CtlMsk.DFC_ComAYCIRingCnt_C DFC_CtlMsk.DFC_ComAYCITOut_C DFC_CtlMsk.DFC_ComBCM1ChkSum_C DFC_CtlMsk.DFC_ComBCM1RingCnt_C DFC_CtlMsk.DFC_ComBCM1TOut_C DFC_CtlMsk.DFC_ComCANABusOffErr_C DFC_CtlMsk.DFC_ComCANBBusOffErr_C DFC_CtlMsk.DFC_ComCANCBusOffErr_C DFC_CtlMsk.DFC_ComCGW1ChkSum_C DFC_CtlMsk.DFC_ComCGW1RingCnt_C DFC_CtlMsk.DFC_ComCGW1TOut_C DFC_CtlMsk.DFC_ComConvBoostErr_C DFC_CtlMsk.DFC_ComConvSlipErr_C DFC_CtlMsk.DFC_ComEAT10Chksum_C DFC_CtlMsk.DFC_ComEAT10RingCnt_C DFC_CtlMsk.DFC_ComEAT10TOut_C DFC_CtlMsk.DFC_ComEAT11ChkSum_C DFC_CtlMsk.DFC_ComEAT11RingCnt_C DFC_CtlMsk.DFC_ComEAT11TOut_C DFC_CtlMsk.DFC_ComEAT12ChkSum_C DFC_CtlMsk.DFC_ComEAT12RingCnt_C DFC_CtlMsk.DFC_ComEAT12TOut_C DFC_CtlMsk.DFC_ComEAT13ChkSum_C DFC_CtlMsk.DFC_ComEAT13RingCnt_C DFC_CtlMsk.DFC_ComEAT13TOut_C DFC_CtlMsk.DFC_ComEAT1Chksum_C DFC_CtlMsk.DFC_ComEAT1RingCnt_C DFC_CtlMsk.DFC_ComEAT1TOut_C DFC_CtlMsk.DFC_ComEAT2ChkSum_C DFC_CtlMsk.DFC_ComEAT2RingCnt_C DFC_CtlMsk.DFC_ComEAT2TOut_C DFC_CtlMsk.DFC_ComEAT4ChkSum_C DFC_CtlMsk.DFC_ComEAT4RingCnt_C DFC_CtlMsk.DFC_ComEAT4TOut_C DFC_CtlMsk.DFC_ComEAT6Chksum_C DFC_CtlMsk.DFC_ComEAT6RingCnt_C DFC_CtlMsk.DFC_ComEAT6TOut_C DFC_CtlMsk.DFC_ComEAT7Chksum_C DFC_CtlMsk.DFC_ComEAT7RingCnt_C DFC_CtlMsk.DFC_ComEAT7TOut_C DFC_CtlMsk.DFC_ComEAT8Chksum_C DFC_CtlMsk.DFC_ComEAT8RingCnt_C DFC_CtlMsk.DFC_ComEAT8TOut_C DFC_CtlMsk.DFC_ComEATAChksum_C DFC_CtlMsk.DFC_ComEATARingCnt_C DFC_CtlMsk.DFC_ComEATATOut_C DFC_CtlMsk.DFC_ComEATBChkSum_C DFC_CtlMsk.DFC_ComEATBRingCnt_C DFC_CtlMsk.DFC_ComEATBTOut_C DFC_CtlMsk.DFC_ComEATCChksum_C DFC_CtlMsk.DFC_ComEATCRingCnt_C DFC_CtlMsk.DFC_ComEATCTOut_C DFC_CtlMsk.DFC_ComEBBAChksum_C DFC_CtlMsk.DFC_ComEBBARingCnt_C DFC_CtlMsk.DFC_ComEBBATOut_C DFC_CtlMsk.DFC_ComEPS1Chksum_C DFC_CtlMsk.DFC_ComEPS1RingCnt_C DFC_CtlMsk.DFC_ComEPS1TOut_C DFC_CtlMsk.DFC_ComEngCanRxErr_C DFC_CtlMsk.DFC_ComGrvySnsrErr_C DFC_CtlMsk.DFC_ComGwIMG1ChkSum_C DFC_CtlMsk.DFC_ComGwIMG1RingCnt_C DFC_CtlMsk.DFC_ComGwIMG1TOut_C DFC_CtlMsk.DFC_ComGwIMG3ChkSum_C DFC_CtlMsk.DFC_ComGwIMG3RingCnt_C DFC_CtlMsk.DFC_ComGwIMG3TOut_C DFC_CtlMsk.DFC_ComGwIMG4ChkSum_C DFC_CtlMsk.DFC_ComGwIMG4RingCnt_C DFC_CtlMsk.DFC_ComGwIMG4TOut_C DFC_CtlMsk.DFC_ComGwIMG5ChkSum_C DFC_CtlMsk.DFC_ComGwIMG5RingCnt_C DFC_CtlMsk.DFC_ComGwIMG5TOut_C DFC_CtlMsk.DFC_ComGwIMG6ChkSum_C DFC_CtlMsk.DFC_ComGwIMG6RingCnt_C DFC_CtlMsk.DFC_ComGwIMG6TOut_C DFC_CtlMsk.DFC_ComIDASBChksum_C DFC_CtlMsk.DFC_ComIDASBRingCnt_C DFC_CtlMsk.DFC_ComIDASBTOut_C DFC_CtlMsk.DFC_ComIMGMILReq_C DFC_CtlMsk.DFC_ComISSPrms_C DFC_CtlMsk.DFC_ComMETAChksum_C DFC_CtlMsk.DFC_ComMETARingCnt_C DFC_CtlMsk.DFC_ComMETATOut_C DFC_CtlMsk.DFC_ComMETCChksum_C DFC_CtlMsk.DFC_ComMETCRingCnt_C DFC_CtlMsk.DFC_ComMETCTOut_C DFC_CtlMsk.DFC_ComMETDChksum_C DFC_CtlMsk.DFC_ComMETDRingCnt_C DFC_CtlMsk.DFC_ComMETDTOut_C DFC_CtlMsk.DFC_ComMETE2Chksum_C DFC_CtlMsk.DFC_ComMETE2RingCnt_C DFC_CtlMsk.DFC_ComMETE2TOut_C DFC_CtlMsk.DFC_ComMETFChksum_C DFC_CtlMsk.DFC_ComMETFRingCnt_C DFC_CtlMsk.DFC_ComMETFTOut_C DFC_CtlMsk.DFC_ComMETGChksum_C DFC_CtlMsk.DFC_ComMETGRingCnt_C DFC_CtlMsk.DFC_ComMETGTOut_C DFC_CtlMsk.DFC_ComMETH2Chksum_C DFC_CtlMsk.DFC_ComMETH2RingCnt_C DFC_CtlMsk.DFC_ComMETH2TOut_C DFC_CtlMsk.DFC_ComMETHChksum_C DFC_CtlMsk.DFC_ComMETHRingCnt_C DFC_CtlMsk.DFC_ComMETHTOut_C DFC_CtlMsk.DFC_ComMETIChksum_C DFC_CtlMsk.DFC_ComMETIRingCnt_C DFC_CtlMsk.DFC_ComMETITOut_C DFC_CtlMsk.DFC_ComMETKChksum_C DFC_CtlMsk.DFC_ComMETKRingCnt_C DFC_CtlMsk.DFC_ComMETKTOut_C DFC_CtlMsk.DFC_ComMETLChksum_C DFC_CtlMsk.DFC_ComMETLRingCnt_C DFC_CtlMsk.DFC_ComMETLTOut_C DFC_CtlMsk.DFC_ComMETMChksum_C DFC_CtlMsk.DFC_ComMETMRingCnt_C DFC_CtlMsk.DFC_ComMETMTOut_C DFC_CtlMsk.DFC_ComMETNChksum_C DFC_CtlMsk.DFC_ComMETNRingCnt_C DFC_CtlMsk.DFC_ComMETNTOut_C DFC_CtlMsk.DFC_ComMtrCom_C DFC_CtlMsk.DFC_ComPCUChkSum_C DFC_CtlMsk.DFC_ComPCURingCnt_C DFC_CtlMsk.DFC_ComPCUTOut_C DFC_CtlMsk.DFC_ComSRSAChksum_C DFC_CtlMsk.DFC_ComSRSARingCnt_C DFC_CtlMsk.DFC_ComSRSATOut_C DFC_CtlMsk.DFC_ComSRSBChksum_C DFC_CtlMsk.DFC_ComSRSBRingCnt_C DFC_CtlMsk.DFC_ComSRSBTOut_C DFC_CtlMsk.DFC_ComSRSChksum_C DFC_CtlMsk.DFC_ComSRSErr_C DFC_CtlMsk.DFC_ComSRSRingCnt_C DFC_CtlMsk.DFC_ComSRSTOut_C DFC_CtlMsk.DFC_ComVehSpdPndFltTCU_C DFC_CtlMsk.DFC_EbsChartcCurrErr_C DFC_CtlMsk.DFC_EbsSelfDiagErr_C DFC_CtlMsk.DFC_GbxCANDigPlausErr_C DFC_CtlMsk.DFC_GbxNPos1SRCMax_C DFC_CtlMsk.DFC_GbxNPos1SRCMin_C DFC_CtlMsk.DFC_GbxNPos2SRCMax_C DFC_CtlMsk.DFC_GbxNPos2SRCMin_C DFC_CtlMsk.DFC_GbxNPosAlvChk_C DFC_CtlMsk.DFC_GbxNPosSyncErr_C DFC_CtlMsk.DFC_HEGOS2B1HtrPsMax_C DFC_CtlMsk.DFC_HEGOS2B1HtrPsMin_C DFC_CtlMsk.DFC_HEGOS2B1HtrPsSig_C DFC_CtlMsk.DFC_LinCSErrACG_C DFC_CtlMsk.DFC_LinCSErrEBS_C DFC_CtlMsk.DFC_LinHdrTimeoutErrACG_C DFC_CtlMsk.DFC_LinHdrTimeoutErrEBS_C DFC_CtlMsk.DFC_LinMsgTimeoutErrACG_C DFC_CtlMsk.DFC_LinMsgTimeoutErrEBS_C DFC_CtlMsk.DFC_LinNoStrtComErr_C DFC_CtlMsk.DFC_MisfDetVWhlFrntLeOORHi_C DFC_CtlMsk.DFC_MisfDetVWhlFrntLeRatyHi_C DFC_CtlMsk.DFC_MisfDetVWhlFrntLeRatyLo_C DFC_CtlMsk.DFC_MisfDetVWhlFrntLeStuck_C DFC_CtlMsk.DFC_MisfDetVWhlFrntRiOORHi_C DFC_CtlMsk.DFC_MisfDetVWhlFrntRiRatyHi_C DFC_CtlMsk.DFC_MisfDetVWhlFrntRiRatyLo_C DFC_CtlMsk.DFC_MisfDetVWhlFrntRiStuck_C DFC_CtlMsk.DFC_MisfDetVWhlReLeOORHi_C DFC_CtlMsk.DFC_MisfDetVWhlReLeRatyHi_C DFC_CtlMsk.DFC_MisfDetVWhlReLeRatyLo_C DFC_CtlMsk.DFC_MisfDetVWhlReLeStuck_C DFC_CtlMsk.DFC_MisfDetVWhlReRiOORHi_C DFC_CtlMsk.DFC_MisfDetVWhlReRiRatyHi_C DFC_CtlMsk.DFC_MisfDetVWhlReRiRatyLo_C DFC_CtlMsk.DFC_MisfDetVWhlReRiStuck_C DFC_CtlMsk.DFC_MisfDetdVWhlFrntLePlaus_C DFC_CtlMsk.DFC_MisfDetdVWhlFrntRiPlaus_C DFC_CtlMsk.DFC_MisfDetdVWhlReLePlaus_C DFC_CtlMsk.DFC_MisfDetdVWhlReRiPlaus_C DFC_CtlMsk.DFC_PEnvSigRngMax_C DFC_CtlMsk.DFC_PEnvSigRngMin_C DFC_CtlMsk.DFC_StmFault_C DFC_CtlMsk.DFC_StrtCtOffPth_C DFC_CtlMsk.DFC_StrtCtlErr_C DFC_CtlMsk.DFC_StrtFault_C DFC_CtlMsk.DFC_StrtLckJudg1_C DFC_CtlMsk.DFC_StrtLckJudg2_C DFC_CtlMsk.DFC_StrtOL_C DFC_CtlMsk.DFC_StrtOL2_C DFC_CtlMsk.DFC_StrtSCB_C DFC_CtlMsk.DFC_StrtSCB2_C DFC_CtlMsk.DFC_StrtSCG_C DFC_CtlMsk.DFC_StrtSCG2_C DFC_CtlMsk.DFC_StrtStkRly1_C DFC_CtlMsk.DFC_StrtStkRly2_C DFC_CtlMsk.DFC_TEVEmax_C DFC_CtlMsk.DFC_TEVEmin_C DFC_CtlMsk.DFC_TEVEsig_C DFC_CtlMsk.DFC_VehVAllPlaus_C DFC_CtlMsk.DFC_VehVNCSnsrElecFailr_C DFC_CtlMsk.DFC_VehVPlausCan_C DFC_CtlMsk.DFC_VehVPlausFco_C DFC_CtlMsk.DFC_VehVPlausPwr_C DFC_CtlMsk.DFC_VehVPlausV2N_C DFC_CtlMsk.DFC_VehVSpdSnsrAElecFailr_C DFC_CtlMsk.DFC_VehVSpdSnsrBElecFailr_C DFC_CtlMsk.DFC_ClthMax_C DFC_CtlMsk.DFC_IgnClPs_DevComErr_C DFC_CtlMsk.DFC_IgnClPs_LineOl_0_C DFC_CtlMsk.DFC_IgnClPs_LineOl_1_C DFC_CtlMsk.DFC_IgnClPs_LineOl_2_C DFC_CtlMsk.DFC_IgnClPs_LineOl_3_C DFC_CtlMsk.DFC_IgnClPs_LineScb_0_C DFC_CtlMsk.DFC_IgnClPs_LineScb_1_C DFC_CtlMsk.DFC_IgnClPs_LineScb_2_C DFC_CtlMsk.DFC_IgnClPs_LineScb_3_C DFC_CtlMsk.DFC_IgnClPs_LineScg_0_C DFC_CtlMsk.DFC_IgnClPs_LineScg_1_C DFC_CtlMsk.DFC_IgnClPs_LineScg_2_C DFC_CtlMsk.DFC_IgnClPs_LineScg_3_C DFC_CtlMsk.DFC_UEGOASICS1B1_C DFC_CtlMsk.DFC_UEGOOLIPES1B1_C DFC_CtlMsk.DFC_UEGOOLRES1B1_C DFC_CtlMsk.DFC_UEGOSCBS1B1_C DFC_CtlMsk.DFC_UEGOSCGS1B1_C DFC_CtlMsk.DFC_UEGOSPIS1B1_C DFC_CtlMsk.DFC_UEGOSnsrS1B1_C DFC_CtlMsk.DFC_UegoOlApesS1B1_C DFC_CtlMsk.DFC_UegoOlRCmpS1B1_C DFC_CtlMsk.DFC_AirCCmprOL_C DFC_CtlMsk.DFC_AirCCmprOvrTemp_C DFC_CtlMsk.DFC_AirCCmprSCB_C DFC_CtlMsk.DFC_AirCCmprSCG_C DFC_CtlMsk.DFC_AltErr_C DFC_CtlMsk.DFC_BattUSRCMax_C DFC_CtlMsk.DFC_BattUSRCMin_C DFC_CtlMsk.DFC_ComChksTCU1_C DFC_CtlMsk.DFC_ComChksTCU11_C DFC_CtlMsk.DFC_ComChksTCU12_C DFC_CtlMsk.DFC_ComChksTCU13_C DFC_CtlMsk.DFC_ComChksTCU2_C DFC_CtlMsk.DFC_ComChksTCU3_C DFC_CtlMsk.DFC_ComChksTCU4_C DFC_CtlMsk.DFC_ComCntTCU1_C DFC_CtlMsk.DFC_ComCntTCU11_C DFC_CtlMsk.DFC_ComCntTCU12_C DFC_CtlMsk.DFC_ComCntTCU13_C DFC_CtlMsk.DFC_ComCntTCU2_C DFC_CtlMsk.DFC_ComCntTCU3_C DFC_CtlMsk.DFC_ComCntTCU4_C DFC_CtlMsk.DFC_ComTOutTCU01_C DFC_CtlMsk.DFC_ComTOutTCU02_C DFC_CtlMsk.DFC_ComTOutTCU1_C DFC_CtlMsk.DFC_ComTOutTCU11_C DFC_CtlMsk.DFC_ComTOutTCU12_C DFC_CtlMsk.DFC_ComTOutTCU13_C DFC_CtlMsk.DFC_ComTOutTCU14_C DFC_CtlMsk.DFC_ComTOutTCU2_C DFC_CtlMsk.DFC_ComTOutTCU3_C DFC_CtlMsk.DFC_ComTOutTCU4_C DFC_CtlMsk.DFC_DevLibBattUHi_C DFC_CtlMsk.DFC_DevLibBattULo_C DFC_CtlMsk.DFC_FanDIOOL_0_C DFC_CtlMsk.DFC_FanDIOOL_1_C DFC_CtlMsk.DFC_FanDIOOvrTemp_0_C DFC_CtlMsk.DFC_FanDIOOvrTemp_1_C DFC_CtlMsk.DFC_FanDIOSCB_0_C DFC_CtlMsk.DFC_FanDIOSCB_1_C DFC_CtlMsk.DFC_FanDIOSCG_0_C DFC_CtlMsk.DFC_FanDIOSCG_1_C DFC_CtlMsk.DFC_MRlyDcOL_C DFC_CtlMsk.DFC_MRlyDcSCB_C /end DEF_CHARACTERISTIC
 /begin OUT_MEASUREMENT DFC_st.DFC_BrkSig DFC_st.DFC_ClthSig DFC_st.DFC_HLSDemOvhtEngLim DFC_st.DFC_OilPNpl DFC_st.DFC_PIntkVUsLineHiB1 DFC_st.DFC_PIntkVUsLineLoB1 DFC_st.DFC_VehVPhysRngLo DFC_st.DFC_VehVSigCan DFC_st.DFC_VehVSigCanSafe DFC_st.DFC_VlvLftFbOilPSnsrIntk11SRCMax DFC_st.DFC_VlvLftFbOilPSnsrIntk11SRCMin DFC_st.DFC_ClthNpl DFC_st.DFC_EV1max DFC_st.DFC_EV1min DFC_st.DFC_EV1sig DFC_st.DFC_EV2max DFC_st.DFC_EV2min DFC_st.DFC_EV2sig DFC_st.DFC_EV3max DFC_st.DFC_EV3min DFC_st.DFC_EV3sig DFC_st.DFC_EV4max DFC_st.DFC_EV4min DFC_st.DFC_EV4sig DFC_st.DFC_GbxPNPosnDrvCdn DFC_st.DFC_GbxPNPosnPlausy DFC_st.DFC_PEnvCcMax DFC_st.DFC_PEnvCcMin DFC_st.DFC_PEnvRngChkMax DFC_st.DFC_PEnvRngChkMin DFC_st.DFC_PEnvSnsrPlaus DFC_st.DFC_UEGOHeatrPsS1B1Max DFC_st.DFC_UEGOHeatrPsS1B1Min DFC_st.DFC_UEGOHeatrPsS1B1Sig DFC_st.DFC_UEGOHeatrRlyPsOLS1B1 DFC_st.DFC_UEGOHeatrRlyPsSCBS1B1 DFC_st.DFC_UEGOHeatrRlyPsSCGS1B1 DFC_st.DFC_KnDetSens1PortAMax DFC_st.DFC_KnDetSens1PortAMin DFC_st.DFC_KnDetSens1PortBMax DFC_st.DFC_KnDetSens1PortBMin DFC_st.DFC_Clth2ONStuck DFC_st.DFC_Clth2ONStuckLdc DFC_st.DFC_Clth3ONStuckLdc DFC_st.DFC_Clth3ONStuckPostDrv DFC_st.DFC_Clth4ONStuck DFC_st.DFC_Clth4ONStuckLdc DFC_st.DFC_ComDLCTCU01 DFC_st.DFC_ComDLCTCU02 DFC_st.DFC_ComDLCTCU1 DFC_st.DFC_ComDLCTCU11 DFC_st.DFC_ComDLCTCU12 DFC_st.DFC_ComDLCTCU13 DFC_st.DFC_ComDLCTCU14 DFC_st.DFC_ComDLCTCU2 DFC_st.DFC_ComDLCTCU3 DFC_st.DFC_ComDLCTCU4 DFC_st.DFC_EVX DFC_st.DFC_EbsSocFlt DFC_st.DFC_I14229VINErr DFC_st.DFC_LLRKHmax DFC_st.DFC_LLRKHmin DFC_st.DFC_LLRmax DFC_st.DFC_LLRmin DFC_st.DFC_RoughRoad DFC_st.DFC_SiaEEPRdErr DFC_st.DFC_SiaEEPWrngCod DFC_st.DFC_UegoDummy DFC_st.DFC_BusDiagCANAPPLBusOff DFC_st.DFC_BusDiagCANCANCBusOff DFC_st.DFC_BusDiagCANVEHICLEBusOff DFC_st.DFC_RBA_IODIAGPWR_rba_IoExtCy329_SignalVltSply_0 DFC_st.DFC_RBA_IODIAGPWR_rba_IoExtCy329_SignalVltSply_0OT DFC_st.DFC_RBA_IODIAGPWR_rba_IoExtCy329_SignalVltSply_0OV DFC_st.DFC_RBA_IODIAGPWR_rba_IoExtCy329_SignalVltSply_0SCG DFC_st.DFC_RBA_IODIAGPWR_rba_IoExtCy329_SignalVltSply_0UV DFC_st.DFC_RBA_IODIAGPWR_rba_IoExtCy329_SignalVltSply_1 DFC_st.DFC_RBA_IODIAGPWR_rba_IoExtCy329_SignalVltSply_1OT DFC_st.DFC_RBA_IODIAGPWR_rba_IoExtCy329_SignalVltSply_1OV DFC_st.DFC_RBA_IODIAGPWR_rba_IoExtCy329_SignalVltSply_1SCG DFC_st.DFC_RBA_IODIAGPWR_rba_IoExtCy329_SignalVltSply_1UV DFC_st.DFC_RBA_IODIAGPWR_rba_IoExtCy329_SignalVltSply_2 DFC_st.DFC_RBA_IODIAGPWR_rba_IoExtCy329_SignalVltSply_2OT DFC_st.DFC_RBA_IODIAGPWR_rba_IoExtCy329_SignalVltSply_2OV DFC_st.DFC_RBA_IODIAGPWR_rba_IoExtCy329_SignalVltSply_2SCG DFC_st.DFC_RBA_IODIAGPWR_rba_IoExtCy329_SignalVltSply_2UV DFC_st.DFC_CAN_E_TIMEOUT DFC_st.DFC_LIN_E_TIMEOUT DFC_st.DFC_MRlyOL DFC_st.DFC_MRlySCB DFC_st.DFC_MRlySCG DFC_st.DFC_rba_MultiStackTrace_Threshold DFC_st.DFC_BSWM_E_ACTION_FAILED DFC_st.DFC_BSWM_E_INTRPTQUEUE_FULL DFC_st.DFC_RBA_IOEXTLIB_KEEPALIVE_DRV DFC_st.DFC_RBA_IOEXTLIB_KEEPALIVE_INI DFC_st.DFC_rba_IoSigRtc_StopCounter DFC_st.DFC_rba_MRly_Diag_Stk_Event DFC_st.DFC_rba_MemDiag_MemReadErr DFC_st.DFC_rba_MemDiag_MemWrErr DFC_st.DFC_rba_SyC_IrrSwOffTrigEngRun_Event DFC_st.DFC_rba_T15_Diag_ComInVld_Event DFC_st.DFC_rba_T15_Diag_ComOff_HwOn_Event DFC_st.DFC_rba_T15_Diag_ComOn_HwOff_Event DFC_st.DFC_AppAllSnsrDfct DFC_st.DFC_BattUStdbyDiaOL DFC_st.DFC_BigLeakIntkMnfldEmiInfl DFC_st.DFC_BrkMnSwtContOnWarnLmp DFC_st.DFC_BrkMnSwtNotStpWarnLmp DFC_st.DFC_BrkRdntSwtContOnWarnLmp DFC_st.DFC_BrkRdntSwtNotStpWarnLmp DFC_st.DFC_CEngDsTColdStrtMax DFC_st.DFC_CEngDsTColdStrtMin DFC_st.DFC_CEngDsTImps DFC_st.DFC_CEngDsTPlausLSC DFC_st.DFC_CEngDsTPlausSTC DFC_st.DFC_CEngDsTSRCMax DFC_st.DFC_CEngDsTSRCMin DFC_st.DFC_CEngDsTSig DFC_st.DFC_CEngUsTSRCMax DFC_st.DFC_CEngUsTSRCMin DFC_st.DFC_DCDCFltDet DFC_st.DFC_DKRSA DFC_st.DFC_DKVSmax DFC_st.DFC_DKnpl DFC_st.DFC_DSSmax DFC_st.DFC_DSTTI DFC_st.DFC_DSUmax DFC_st.DFC_EGRVlvOL DFC_st.DFC_EGRVlvSCB DFC_st.DFC_EGRVlvSCG DFC_st.DFC_EGSDUS2B1LtrDly DFC_st.DFC_EGSDUS2B1LtrPT1 DFC_st.DFC_EGSDUS2B1RtlDly DFC_st.DFC_EGSDUS2B1RtlPT1 DFC_st.DFC_EGSDUS2B1TarLean DFC_st.DFC_EGSDUS2B1TarRich DFC_st.DFC_ETAKHLmax DFC_st.DFC_ETAKHTmax DFC_st.DFC_EngICO DFC_st.DFC_EngPrtOvrSpdMon DFC_st.DFC_EpmCaSI1ErrSig DFC_st.DFC_EpmCaSI1NoSig DFC_st.DFC_EpmCaSI1OfsErr DFC_st.DFC_EpmCrSErrSig DFC_st.DFC_EpmCrSNoSig DFC_st.DFC_EtaEngIdleNonCsers DFC_st.DFC_EtaEngPtlNonCsers DFC_st.DFC_FRAmax DFC_st.DFC_FRAmin DFC_st.DFC_GbxRvsSwtStk DFC_st.DFC_HDRmax DFC_st.DFC_HEGOS2B1ElecMax DFC_st.DFC_HEGOS2B1ElecMin DFC_st.DFC_HEGOS2B1ElecSig DFC_st.DFC_HEGOS2B1HtgNpl DFC_st.DFC_IntkAirTIntkMnfldCrssMax DFC_st.DFC_IntkAirTIntkMnfldCrssMin DFC_st.DFC_IntkAirTIntkMnfldHSCMax DFC_st.DFC_IntkAirTIntkMnfldImps DFC_st.DFC_IntkAirTIntkMnfldPRCMax DFC_st.DFC_IntkAirTIntkMnfldPRCMin DFC_st.DFC_IntkAirTIntkMnfldSRCMax DFC_st.DFC_IntkAirTIntkMnfldSRCMin DFC_st.DFC_IntkAirTIntkMnfldSTC DFC_st.DFC_KS1max DFC_st.DFC_KS1min DFC_st.DFC_LMmax DFC_st.DFC_LZSRnpl DFC_st.DFC_LamDynDiagS1B1 DFC_st.DFC_LeakIntkMnfldEmiInfl DFC_st.DFC_MD00max DFC_st.DFC_MDBmax DFC_st.DFC_MDCat DFC_st.DFC_MDCatCrit DFC_st.DFC_MDCatCurr DFC_st.DFC_MDCyl_0 DFC_st.DFC_MDCyl_1 DFC_st.DFC_MDCyl_2 DFC_st.DFC_MDCyl_3 DFC_st.DFC_MDEmi DFC_st.DFC_MDEmiStrt DFC_st.DFC_MDFco DFC_st.DFC_MDMpl DFC_st.DFC_MDSegTiAdpn DFC_st.DFC_MDmax DFC_st.DFC_MOXEMM_SMU_ALM0_0 DFC_st.DFC_MOXEMM_SMU_ALM0_1 DFC_st.DFC_MOXEMM_SMU_ALM0_10 DFC_st.DFC_MOXEMM_SMU_ALM0_11 DFC_st.DFC_MOXEMM_SMU_ALM0_13 DFC_st.DFC_MOXEMM_SMU_ALM0_14 DFC_st.DFC_MOXEMM_SMU_ALM0_2 DFC_st.DFC_MOXEMM_SMU_ALM0_22 DFC_st.DFC_MOXEMM_SMU_ALM0_23 DFC_st.DFC_MOXEMM_SMU_ALM0_4 DFC_st.DFC_MOXEMM_SMU_ALM0_5 DFC_st.DFC_MOXEMM_SMU_ALM0_7 DFC_st.DFC_MOXEMM_SMU_ALM0_8 DFC_st.DFC_MOXEMM_SMU_ALM10_16 DFC_st.DFC_MOXEMM_SMU_ALM10_17 DFC_st.DFC_MOXEMM_SMU_ALM10_21 DFC_st.DFC_MOXEMM_SMU_ALM11_0 DFC_st.DFC_MOXEMM_SMU_ALM11_1 DFC_st.DFC_MOXEMM_SMU_ALM11_2 DFC_st.DFC_MOXEMM_SMU_ALM11_3 DFC_st.DFC_MOXEMM_SMU_ALM11_4 DFC_st.DFC_MOXEMM_SMU_ALM11_5 DFC_st.DFC_MOXEMM_SMU_ALM11_8 DFC_st.DFC_MOXEMM_SMU_ALM11_9 DFC_st.DFC_MOXEMM_SMU_ALM1_0 DFC_st.DFC_MOXEMM_SMU_ALM1_1 DFC_st.DFC_MOXEMM_SMU_ALM1_10 DFC_st.DFC_MOXEMM_SMU_ALM1_11 DFC_st.DFC_MOXEMM_SMU_ALM1_13 DFC_st.DFC_MOXEMM_SMU_ALM1_14 DFC_st.DFC_MOXEMM_SMU_ALM1_2 DFC_st.DFC_MOXEMM_SMU_ALM1_22 DFC_st.DFC_MOXEMM_SMU_ALM1_23 DFC_st.DFC_MOXEMM_SMU_ALM1_4 DFC_st.DFC_MOXEMM_SMU_ALM1_5 DFC_st.DFC_MOXEMM_SMU_ALM1_7 DFC_st.DFC_MOXEMM_SMU_ALM1_8 DFC_st.DFC_MOXEMM_SMU_ALM21_0 DFC_st.DFC_MOXEMM_SMU_ALM21_16 DFC_st.DFC_MOXEMM_SMU_ALM21_3 DFC_st.DFC_MOXEMM_SMU_ALM2_1 DFC_st.DFC_MOXEMM_SMU_ALM2_10 DFC_st.DFC_MOXEMM_SMU_ALM2_11 DFC_st.DFC_MOXEMM_SMU_ALM2_13 DFC_st.DFC_MOXEMM_SMU_ALM2_14 DFC_st.DFC_MOXEMM_SMU_ALM2_22 DFC_st.DFC_MOXEMM_SMU_ALM2_23 DFC_st.DFC_MOXEMM_SMU_ALM2_4 DFC_st.DFC_MOXEMM_SMU_ALM2_5 DFC_st.DFC_MOXEMM_SMU_ALM2_7 DFC_st.DFC_MOXEMM_SMU_ALM2_8 DFC_st.DFC_MOXEMM_SMU_ALM6_0 DFC_st.DFC_MOXEMM_SMU_ALM6_11 DFC_st.DFC_MOXEMM_SMU_ALM6_12 DFC_st.DFC_MOXEMM_SMU_ALM6_14 DFC_st.DFC_MOXEMM_SMU_ALM6_15 DFC_st.DFC_MOXEMM_SMU_ALM6_17 DFC_st.DFC_MOXEMM_SMU_ALM6_18 DFC_st.DFC_MOXEMM_SMU_ALM6_20 DFC_st.DFC_MOXEMM_SMU_ALM6_21 DFC_st.DFC_MOXEMM_SMU_ALM6_25 DFC_st.DFC_MOXEMM_SMU_ALM6_4 DFC_st.DFC_MOXEMM_SMU_ALM6_5 DFC_st.DFC_MOXEMM_SMU_ALM6_7 DFC_st.DFC_MOXEMM_SMU_ALM6_8 DFC_st.DFC_MOXEMM_SMU_ALM7_1 DFC_st.DFC_MOXEMM_SMU_ALM7_12 DFC_st.DFC_MOXEMM_SMU_ALM7_13 DFC_st.DFC_MOXEMM_SMU_ALM7_14 DFC_st.DFC_MOXEMM_SMU_ALM7_15 DFC_st.DFC_MOXEMM_SMU_ALM7_16 DFC_st.DFC_MOXEMM_SMU_ALM7_17 DFC_st.DFC_MOXEMM_SMU_ALM7_2 DFC_st.DFC_MOXEMM_SMU_ALM7_20 DFC_st.DFC_MOXEMM_SMU_ALM7_25 DFC_st.DFC_MOXEMM_SMU_ALM7_26 DFC_st.DFC_MOXEMM_SMU_ALM7_28 DFC_st.DFC_MOXEMM_SMU_ALM7_29 DFC_st.DFC_MOXEMM_SMU_ALM7_30 DFC_st.DFC_MOXEMM_SMU_ALM7_31 DFC_st.DFC_MOXEMM_SMU_ALM8_0 DFC_st.DFC_MOXEMM_SMU_ALM8_1 DFC_st.DFC_MOXEMM_SMU_ALM8_10 DFC_st.DFC_MOXEMM_SMU_ALM8_11 DFC_st.DFC_MOXEMM_SMU_ALM8_12 DFC_st.DFC_MOXEMM_SMU_ALM8_16 DFC_st.DFC_MOXEMM_SMU_ALM8_18 DFC_st.DFC_MOXEMM_SMU_ALM8_2 DFC_st.DFC_MOXEMM_SMU_ALM8_3 DFC_st.DFC_MOXEMM_SMU_ALM8_31 DFC_st.DFC_MOXEMM_SMU_ALM8_4 DFC_st.DFC_MOXEMM_SMU_ALM9_0 DFC_st.DFC_MOXEMM_SMU_ALM9_15 DFC_st.DFC_MOXEMM_SMU_ALM9_3 DFC_st.DFC_MoCADCNTP DFC_st.DFC_MoCADCTst DFC_st.DFC_MoCSOPICO DFC_st.DFC_MoFAPP DFC_st.DFC_MoFAirFilgPrdc DFC_st.DFC_MoFAirFlCtOffPfi DFC_st.DFC_MoFAirFlCylPfi DFC_st.DFC_MoFAirFlIn DFC_st.DFC_MoFAirFlMixCtlPfiChkAirFl DFC_st.DFC_MoFAirFlMixCtlPfiChkCtrl DFC_st.DFC_MoFAirFlMode DFC_st.DFC_MoFESpd DFC_st.DFC_MoFIACo DFC_st.DFC_MoFICOL1 DFC_st.DFC_MoFICOL2 DFC_st.DFC_MoFStrt DFC_st.DFC_MoFTrqCmp DFC_st.DFC_MoFTrqCmpMax DFC_st.DFC_MoFTrqCmpMin DFC_st.DFC_MoFVarPostBldSel DFC_st.DFC_MoXEMMHwLTMCUFW DFC_st.DFC_MoXEMMHwLTMonBIST DFC_st.DFC_MoXEMMHwLTRegMonTest DFC_st.DFC_MoXEMMHwLTStbySMUAlvTest DFC_st.DFC_MoXEMMHwLTTempSens DFC_st.DFC_MoXEMMHwLTUCBCfg DFC_st.DFC_OCWDAABEActv DFC_st.DFC_OCWDACom DFC_st.DFC_OCWDAErrPin DFC_st.DFC_OCWDAOvrVltg DFC_st.DFC_ORAmax DFC_st.DFC_ORAmin DFC_st.DFC_PLLSUmax DFC_st.DFC_PLLSUmin DFC_st.DFC_PSR1max DFC_st.DFC_PSRBmax DFC_st.DFC_PSRBmin DFC_st.DFC_PSRPmax DFC_st.DFC_PSRPmin DFC_st.DFC_PSRPsig DFC_st.DFC_PSRmax DFC_st.DFC_PUmax DFC_st.DFC_P_VSE11_OL DFC_st.DFC_P_VSE11_SCB DFC_st.DFC_P_VSE11_SCG DFC_st.DFC_PhyHighAPP1 DFC_st.DFC_PhyHighAPP2 DFC_st.DFC_PhyLowAPP1 DFC_st.DFC_PhyLowAPP2 DFC_st.DFC_SRCHighAPP1 DFC_st.DFC_SRCHighAPP2 DFC_st.DFC_SRCLowAPP1 DFC_st.DFC_SRCLowAPP2 DFC_st.DFC_SSpMon2 DFC_st.DFC_SWReset_0 DFC_st.DFC_SWReset_1 DFC_st.DFC_SWReset_2 DFC_st.DFC_SyncAPP DFC_st.DFC_TAmax_Dummy DFC_st.DFC_TKAEmax DFC_st.DFC_TKAEmin DFC_st.DFC_TKARmax DFC_st.DFC_TKARnpl DFC_st.DFC_TMmax_Dummy DFC_st.DFC_TUMmax_Dummy DFC_st.DFC_TWCDPriCatB1 DFC_st.DFC_ThrVlvClsdPosnFirstOffsLrnImpoB1 DFC_st.DFC_ThrVlvClsdPosnOffsLrnImpoB1 DFC_st.DFC_ThrVlvClsdPosnOffsLrnMaxB1 DFC_st.DFC_ThrVlvClsdPosnOffsLrnMinB1 DFC_st.DFC_ThrVlvCtrlDeB1 DFC_st.DFC_ThrVlvDycB1 DFC_st.DFC_ThrVlvLimpAirPosnMaxAbsltDriftB1 DFC_st.DFC_ThrVlvLimpAirPosnMaxB1 DFC_st.DFC_ThrVlvLimpAirPosnMaxRelDriftB1 DFC_st.DFC_ThrVlvLimpAirPosnMinB1 DFC_st.DFC_ThrVlvOpenLoadB1 DFC_st.DFC_ThrVlvOpenSprgB1 DFC_st.DFC_ThrVlvOpenSprgSprdB1 DFC_st.DFC_ThrVlvOpenSprgTwnB1 DFC_st.DFC_ThrVlvOverTB1 DFC_st.DFC_ThrVlvRetSprgB1 DFC_st.DFC_ThrVlvRetSprgSprdB1 DFC_st.DFC_ThrVlvRetSprgTwnB1 DFC_st.DFC_ThrVlvSens1MaxB1 DFC_st.DFC_ThrVlvSens1NplB1 DFC_st.DFC_ThrVlvSens2MaxB1 DFC_st.DFC_ThrVlvSens2MinB1 DFC_st.DFC_ThrVlvSens2NplB1 DFC_st.DFC_ThrVlvShoCircB1 DFC_st.DFC_ThrVlvSpiErrB1 DFC_st.DFC_ThrvlvSens1MinB1 DFC_st.DFC_TiOffTBasdChkFast DFC_st.DFC_TiOffTBasdChkSlow DFC_st.DFC_UEGOHeatrCtlS1B1 DFC_st.DFC_UEGOSnsrMntdS1B1 DFC_st.DFC_VehVSig DFC_st.DFC_VlvLftFbSwtIntk11SpclFail DFC_st.DFC_VlvLftFbSwtIntk11StdFail DSQ_st.DSQ_ACClntP DSQ_st.DSQ_ACEvpT DSQ_st.DSQ_AirCCmprActr DSQ_st.DSQ_BattU DSQ_st.DSQ_BattULo DSQ_st.DSQ_CoVMDIDASFail DSQ_st.DSQ_DSMInhibitAlways DSQ_st.DSQ_ElecLd DSQ_st.DSQ_EngICO DSQ_st.DSQ_EpmCaSSigQuality DSQ_st.DSQ_EpmReverseRun DSQ_st.DSQ_FanDIO_0 DSQ_st.DSQ_FanDIO_1 DSQ_st.DSQ_FuelP DSQ_st.DSQ_FuelT DSQ_st.DSQ_GbxPNPos DSQ_st.DSQ_GbxPosNotPN DSQ_st.DSQ_MRly DSQ_st.DSQ_PEnvMeasVld DSQ_st.DSQ_PEnvVld DSQ_st.DSQ_PEnv_pRaw DSQ_st.DSQ_PThrVlvUs DSQ_st.DSQ_PThrVlvUsB1 DSQ_st.DSQ_StrtImobChk DSQ_st.DSQ_TDevCenColdStrt DSQ_st.DSQ_UEGOHeatrPwrOKS1B1 DSQ_st.DSQ_UEGOIPmpS1B1 DSQ_st.DSQ_UEGOLamS1B1 DSQ_st.DSQ_UEGOTCtrlS1B1 DSQ_st.DSQ_VehV DSQ_st.DSQ_VehVSnsr DSQ_st.DSQ_stAPP DSQ_st.DSQ_stComEAT4 /end OUT_MEASUREMENT
 /begin LOC_MEASUREMENT DFC_lenMaxCllsn DFC_nrCllsnClear DFC_nrCllsnReInit DFC_nrCllsnReport DFC_numDfcMaxCllsn DFC_stClctFault_mp DFC_stClctTst_mp DFC_stFinal DFC_stMem DFC_stRdy /end LOC_MEASUREMENT
 FUNCTION_VERSION "30000.33.0" /end FUNCTION
/begin COMPU_METHOD DFCDFP_Verb "" TAB_VERB "%6.3" "-" COMPU_TAB_REF DFCDFP_Verb /end COMPU_METHOD
/begin COMPU_VTAB DFCDFP_Verb "" TAB_VERB 763 0 "NoEntry" 1 "DFC_AltIOACGFailr" 2 "DFC_AltIOACGHiVltg" 3 "DFC_AltIOACGLoVltg" 4 "DFC_AltIOACGTHi" 5 "DFC_AltIODConnACG" 6 "DFC_BattUHiFailr" 7 "DFC_BattULoFailr" 8 "DFC_BrkBstPDriftHiErr" 9 "DFC_BrkBstPDriftLoErr" 10 "DFC_BrkBstPSnsrStuck" 11 "DFC_BrkMnSwtContOn" 12 "DFC_BrkMnSwtNotStp" 13 "DFC_BrkNpl" 14 "DFC_BrkRdntSwtContOn" 15 "DFC_BrkRdntSwtNotStp" 16 "DFC_Clth3ONStuck" 17 "DFC_Clth4OFFStuck" 18 "DFC_ClthOFFStuck" 19 "DFC_ClthONStuck" 20 "DFC_ClthStkFailInfo" 21 "DFC_ComACFailInfo" 22 "DFC_ComATFTValErr" 23 "DFC_ComATMILReq" 24 "DFC_ComAYCAChksum" 25 "DFC_ComAYCARingCnt" 26 "DFC_ComAYCATOut" 27 "DFC_ComAYCDChkSum" 28 "DFC_ComAYCDTOut" 29 "DFC_ComAYCFChksum" 30 "DFC_ComAYCFRingCnt" 31 "DFC_ComAYCFTOut" 32 "DFC_ComAYCGChksum" 33 "DFC_ComAYCGRingCnt" 34 "DFC_ComAYCGTOut" 35 "DFC_ComAYCIChkSum" 36 "DFC_ComAYCIRingCnt" 37 "DFC_ComAYCITOut" 38 "DFC_ComBCM1ChkSum" 39 "DFC_ComBCM1RingCnt" 40 "DFC_ComBCM1TOut" 41 "DFC_ComCANABusOffErr" 42 "DFC_ComCANBBusOffErr" 43 "DFC_ComCANCBusOffErr" 44 "DFC_ComCGW1ChkSum" 45 "DFC_ComCGW1RingCnt" 46 "DFC_ComCGW1TOut" 47 "DFC_ComConvBoostErr" 48 "DFC_ComConvSlipErr" 49 "DFC_ComEAT10Chksum" 50 "DFC_ComEAT10RingCnt" 51 "DFC_ComEAT10TOut" 52 "DFC_ComEAT11ChkSum" 53 "DFC_ComEAT11RingCnt" 54 "DFC_ComEAT11TOut" 55 "DFC_ComEAT12ChkSum" 56 "DFC_ComEAT12RingCnt" 57 "DFC_ComEAT12TOut" 58 "DFC_ComEAT13ChkSum" 59 "DFC_ComEAT13RingCnt" 60 "DFC_ComEAT13TOut" 61 "DFC_ComEAT1Chksum" 62 "DFC_ComEAT1RingCnt" 63 "DFC_ComEAT1TOut" 64 "DFC_ComEAT2ChkSum" 65 "DFC_ComEAT2RingCnt" 66 "DFC_ComEAT2TOut" 67 "DFC_ComEAT4ChkSum" 68 "DFC_ComEAT4RingCnt" 69 "DFC_ComEAT4TOut" 70 "DFC_ComEAT6Chksum" 71 "DFC_ComEAT6RingCnt" 72 "DFC_ComEAT6TOut" 73 "DFC_ComEAT7Chksum" 74 "DFC_ComEAT7RingCnt" 75 "DFC_ComEAT7TOut" 76 "DFC_ComEAT8Chksum" 77 "DFC_ComEAT8RingCnt" 78 "DFC_ComEAT8TOut" 79 "DFC_ComEATAChksum" 80 "DFC_ComEATARingCnt" 81 "DFC_ComEATATOut" 82 "DFC_ComEATBChkSum" 83 "DFC_ComEATBRingCnt" 84 "DFC_ComEATBTOut" 85 "DFC_ComEATCChksum" 86 "DFC_ComEATCRingCnt" 87 "DFC_ComEATCTOut" 88 "DFC_ComEBBAChksum" 89 "DFC_ComEBBARingCnt" 90 "DFC_ComEBBATOut" 91 "DFC_ComEPS1Chksum" 92 "DFC_ComEPS1RingCnt" 93 "DFC_ComEPS1TOut" 94 "DFC_ComEngCanRxErr" 95 "DFC_ComGrvySnsrErr" 96 "DFC_ComGwIMG1ChkSum" 97 "DFC_ComGwIMG1RingCnt" 98 "DFC_ComGwIMG1TOut" 99 "DFC_ComGwIMG3ChkSum" 100 "DFC_ComGwIMG3RingCnt" 101 "DFC_ComGwIMG3TOut" 102 "DFC_ComGwIMG4ChkSum" 103 "DFC_ComGwIMG4RingCnt" 104 "DFC_ComGwIMG4TOut" 105 "DFC_ComGwIMG5ChkSum" 106 "DFC_ComGwIMG5RingCnt" 107 "DFC_ComGwIMG5TOut" 108 "DFC_ComGwIMG6ChkSum" 109 "DFC_ComGwIMG6RingCnt" 110 "DFC_ComGwIMG6TOut" 111 "DFC_ComIDASBChksum" 112 "DFC_ComIDASBRingCnt" 113 "DFC_ComIDASBTOut" 114 "DFC_ComIMGMILReq" 115 "DFC_ComISSPrms" 116 "DFC_ComMETAChksum" 117 "DFC_ComMETARingCnt" 118 "DFC_ComMETATOut" 119 "DFC_ComMETCChksum" 120 "DFC_ComMETCRingCnt" 121 "DFC_ComMETCTOut" 122 "DFC_ComMETDChksum" 123 "DFC_ComMETDRingCnt" 124 "DFC_ComMETDTOut" 125 "DFC_ComMETE2Chksum" 126 "DFC_ComMETE2RingCnt" 127 "DFC_ComMETE2TOut" 128 "DFC_ComMETFChksum" 129 "DFC_ComMETFRingCnt" 130 "DFC_ComMETFTOut" 131 "DFC_ComMETGChksum" 132 "DFC_ComMETGRingCnt" 133 "DFC_ComMETGTOut" 134 "DFC_ComMETH2Chksum" 135 "DFC_ComMETH2RingCnt" 136 "DFC_ComMETH2TOut" 137 "DFC_ComMETHChksum" 138 "DFC_ComMETHRingCnt" 139 "DFC_ComMETHTOut" 140 "DFC_ComMETIChksum" 141 "DFC_ComMETIRingCnt" 142 "DFC_ComMETITOut" 143 "DFC_ComMETKChksum" 144 "DFC_ComMETKRingCnt" 145 "DFC_ComMETKTOut" 146 "DFC_ComMETLChksum" 147 "DFC_ComMETLRingCnt" 148 "DFC_ComMETLTOut" 149 "DFC_ComMETMChksum" 150 "DFC_ComMETMRingCnt" 151 "DFC_ComMETMTOut" 152 "DFC_ComMETNChksum" 153 "DFC_ComMETNRingCnt" 154 "DFC_ComMETNTOut" 155 "DFC_ComMtrCom" 156 "DFC_ComPCUChkSum" 157 "DFC_ComPCURingCnt" 158 "DFC_ComPCUTOut" 159 "DFC_ComSRSAChksum" 160 "DFC_ComSRSARingCnt" 161 "DFC_ComSRSATOut" 162 "DFC_ComSRSBChksum" 163 "DFC_ComSRSBRingCnt" 164 "DFC_ComSRSBTOut" 165 "DFC_ComSRSChksum" 166 "DFC_ComSRSErr" 167 "DFC_ComSRSRingCnt" 168 "DFC_ComSRSTOut" 169 "DFC_ComVehSpdPndFltTCU" 170 "DFC_EbsChartcCurrErr" 171 "DFC_EbsSelfDiagErr" 172 "DFC_GbxCANDigPlausErr" 173 "DFC_GbxNPos1SRCMax" 174 "DFC_GbxNPos1SRCMin" 175 "DFC_GbxNPos2SRCMax" 176 "DFC_GbxNPos2SRCMin" 177 "DFC_GbxNPosAlvChk" 178 "DFC_GbxNPosSyncErr" 179 "DFC_HEGOS2B1HtrPsMax" 180 "DFC_HEGOS2B1HtrPsMin" 181 "DFC_HEGOS2B1HtrPsSig" 182 "DFC_LinCSErrACG" 183 "DFC_LinCSErrEBS" 184 "DFC_LinHdrTimeoutErrACG" 185 "DFC_LinHdrTimeoutErrEBS" 186 "DFC_LinMsgTimeoutErrACG" 187 "DFC_LinMsgTimeoutErrEBS" 188 "DFC_LinNoStrtComErr" 189 "DFC_MisfDetVWhlFrntLeOORHi" 190 "DFC_MisfDetVWhlFrntLeRatyHi" 191 "DFC_MisfDetVWhlFrntLeRatyLo" 192 "DFC_MisfDetVWhlFrntLeStuck" 193 "DFC_MisfDetVWhlFrntRiOORHi" 194 "DFC_MisfDetVWhlFrntRiRatyHi" 195 "DFC_MisfDetVWhlFrntRiRatyLo" 196 "DFC_MisfDetVWhlFrntRiStuck" 197 "DFC_MisfDetVWhlReLeOORHi" 198 "DFC_MisfDetVWhlReLeRatyHi" 199 "DFC_MisfDetVWhlReLeRatyLo" 200 "DFC_MisfDetVWhlReLeStuck" 201 "DFC_MisfDetVWhlReRiOORHi" 202 "DFC_MisfDetVWhlReRiRatyHi" 203 "DFC_MisfDetVWhlReRiRatyLo" 204 "DFC_MisfDetVWhlReRiStuck" 205 "DFC_MisfDetdVWhlFrntLePlaus" 206 "DFC_MisfDetdVWhlFrntRiPlaus" 207 "DFC_MisfDetdVWhlReLePlaus" 208 "DFC_MisfDetdVWhlReRiPlaus" 209 "DFC_PEnvSigRngMax" 210 "DFC_PEnvSigRngMin" 211 "DFC_StmFault" 212 "DFC_StrtCtOffPth" 213 "DFC_StrtCtlErr" 214 "DFC_StrtFault" 215 "DFC_StrtLckJudg1" 216 "DFC_StrtLckJudg2" 217 "DFC_StrtOL" 218 "DFC_StrtOL2" 219 "DFC_StrtSCB" 220 "DFC_StrtSCB2" 221 "DFC_StrtSCG" 222 "DFC_StrtSCG2" 223 "DFC_StrtStkRly1" 224 "DFC_StrtStkRly2" 225 "DFC_TEVEmax" 226 "DFC_TEVEmin" 227 "DFC_TEVEsig" 228 "DFC_VehVAllPlaus" 229 "DFC_VehVNCSnsrElecFailr" 230 "DFC_VehVPlausCan" 231 "DFC_VehVPlausFco" 232 "DFC_VehVPlausPwr" 233 "DFC_VehVPlausV2N" 234 "DFC_VehVSpdSnsrAElecFailr" 235 "DFC_VehVSpdSnsrBElecFailr" 236 "DFC_ClthMax" 237 "DFC_IgnClPs_DevComErr" 238 "DFC_IgnClPs_LineOl_0" 239 "DFC_IgnClPs_LineOl_1" 240 "DFC_IgnClPs_LineOl_2" 241 "DFC_IgnClPs_LineOl_3" 242 "DFC_IgnClPs_LineScb_0" 243 "DFC_IgnClPs_LineScb_1" 244 "DFC_IgnClPs_LineScb_2" 245 "DFC_IgnClPs_LineScb_3" 246 "DFC_IgnClPs_LineScg_0" 247 "DFC_IgnClPs_LineScg_1" 248 "DFC_IgnClPs_LineScg_2" 249 "DFC_IgnClPs_LineScg_3" 250 "DFC_UEGOASICS1B1" 251 "DFC_UEGOOLIPES1B1" 252 "DFC_UEGOOLRES1B1" 253 "DFC_UEGOSCBS1B1" 254 "DFC_UEGOSCGS1B1" 255 "DFC_UEGOSPIS1B1" 256 "DFC_UEGOSnsrS1B1" 257 "DFC_UegoOlApesS1B1" 258 "DFC_UegoOlRCmpS1B1" 259 "DFC_AirCCmprOL" 260 "DFC_AirCCmprOvrTemp" 261 "DFC_AirCCmprSCB" 262 "DFC_AirCCmprSCG" 263 "DFC_AltErr" 264 "DFC_BattUSRCMax" 265 "DFC_BattUSRCMin" 266 "DFC_ComChksTCU1" 267 "DFC_ComChksTCU11" 268 "DFC_ComChksTCU12" 269 "DFC_ComChksTCU13" 270 "DFC_ComChksTCU2" 271 "DFC_ComChksTCU3" 272 "DFC_ComChksTCU4" 273 "DFC_ComCntTCU1" 274 "DFC_ComCntTCU11" 275 "DFC_ComCntTCU12" 276 "DFC_ComCntTCU13" 277 "DFC_ComCntTCU2" 278 "DFC_ComCntTCU3" 279 "DFC_ComCntTCU4" 280 "DFC_ComTOutTCU01" 281 "DFC_ComTOutTCU02" 282 "DFC_ComTOutTCU1" 283 "DFC_ComTOutTCU11" 284 "DFC_ComTOutTCU12" 285 "DFC_ComTOutTCU13" 286 "DFC_ComTOutTCU14" 287 "DFC_ComTOutTCU2" 288 "DFC_ComTOutTCU3" 289 "DFC_ComTOutTCU4" 290 "DFC_DevLibBattUHi" 291 "DFC_DevLibBattULo" 292 "DFC_FanDIOOL_0" 293 "DFC_FanDIOOL_1" 294 "DFC_FanDIOOvrTemp_0" 295 "DFC_FanDIOOvrTemp_1" 296 "DFC_FanDIOSCB_0" 297 "DFC_FanDIOSCB_1" 298 "DFC_FanDIOSCG_0" 299 "DFC_FanDIOSCG_1" 300 "DFC_MRlyDcOL" 301 "DFC_MRlyDcSCB" 302 "DFC_MRlyDcSCG" 303 "DFC_PSPOL" 304 "DFC_PSPOvrTemp" 305 "DFC_PSPSCB" 306 "DFC_PSPSCG" 307 "DFC_T50Err" 308 "DFC_ThrVlvLoBattB1" 309 "DFC_VehVPhysRngHi" 310 "DFC_VehVSclOutOL" 311 "DFC_VehVSclOutOT" 312 "DFC_VehVSclOutSCB" 313 "DFC_VehVSclOutSCG" 314 "DFC_VehVSnsrARngHi" 315 "DFC_VehVSnsrBRngHi" 316 "DFC_VehVSpdRtyDiag" 317 "DFC_VehVWhlErr" 318 "DFC_ACEvpTSRCMax" 319 "DFC_ACEvpTSRCMin" 320 "DFC_AirCClntPAnaSRCMax" 321 "DFC_AirCClntPAnaSRCMin" 322 "DFC_AirCSwtNpl" 323 "DFC_AirCSwtSig" 324 "DFC_Brk" 325 "DFC_BrkSig" 326 "DFC_ClthSig" 327 "DFC_HLSDemOvhtEngLim" 328 "DFC_OilPNpl" 329 "DFC_PIntkVUsLineHiB1" 330 "DFC_PIntkVUsLineLoB1" 331 "DFC_VehVPhysRngLo" 332 "DFC_VehVSigCan" 333 "DFC_VehVSigCanSafe" 334 "DFC_VlvLftFbOilPSnsrIntk11SRCMax" 335 "DFC_VlvLftFbOilPSnsrIntk11SRCMin" 336 "DFC_ClthNpl" 337 "DFC_EV1max" 338 "DFC_EV1min" 339 "DFC_EV1sig" 340 "DFC_EV2max" 341 "DFC_EV2min" 342 "DFC_EV2sig" 343 "DFC_EV3max" 344 "DFC_EV3min" 345 "DFC_EV3sig" 346 "DFC_EV4max" 347 "DFC_EV4min" 348 "DFC_EV4sig" 349 "DFC_GbxPNPosnDrvCdn" 350 "DFC_GbxPNPosnPlausy" 351 "DFC_PEnvCcMax" 352 "DFC_PEnvCcMin" 353 "DFC_PEnvRngChkMax" 354 "DFC_PEnvRngChkMin" 355 "DFC_PEnvSnsrPlaus" 356 "DFC_UEGOHeatrPsS1B1Max" 357 "DFC_UEGOHeatrPsS1B1Min" 358 "DFC_UEGOHeatrPsS1B1Sig" 359 "DFC_UEGOHeatrRlyPsOLS1B1" 360 "DFC_UEGOHeatrRlyPsSCBS1B1" 361 "DFC_UEGOHeatrRlyPsSCGS1B1" 362 "DFC_KnDetSens1PortAMax" 363 "DFC_KnDetSens1PortAMin" 364 "DFC_KnDetSens1PortBMax" 365 "DFC_KnDetSens1PortBMin" 366 "DFC_Clth2ONStuck" 367 "DFC_Clth2ONStuckLdc" 368 "DFC_Clth3ONStuckLdc" 369 "DFC_Clth3ONStuckPostDrv" 370 "DFC_Clth4ONStuck" 371 "DFC_Clth4ONStuckLdc" 372 "DFC_ComDLCTCU01" 373 "DFC_ComDLCTCU02" 374 "DFC_ComDLCTCU1" 375 "DFC_ComDLCTCU11" 376 "DFC_ComDLCTCU12" 377 "DFC_ComDLCTCU13" 378 "DFC_ComDLCTCU14" 379 "DFC_ComDLCTCU2" 380 "DFC_ComDLCTCU3" 381 "DFC_ComDLCTCU4" 382 "DFC_EVX" 383 "DFC_EbsSocFlt" 384 "DFC_I14229VINErr" 385 "DFC_LLRKHmax" 386 "DFC_LLRKHmin" 387 "DFC_LLRmax" 388 "DFC_LLRmin" 389 "DFC_RoughRoad" 390 "DFC_SiaEEPRdErr" 391 "DFC_SiaEEPWrngCod" 392 "DFC_UegoDummy" 393 "DFC_BusDiagCANAPPLBusOff" 394 "DFC_BusDiagCANCANCBusOff" 395 "DFC_BusDiagCANVEHICLEBusOff" 396 "DFC_RBA_IODIAGPWR_rba_IoExtCy329_SignalVltSply_0" 397 "DFC_RBA_IODIAGPWR_rba_IoExtCy329_SignalVltSply_0OT" 398 "DFC_RBA_IODIAGPWR_rba_IoExtCy329_SignalVltSply_0OV" 399 "DFC_RBA_IODIAGPWR_rba_IoExtCy329_SignalVltSply_0SCG" 400 "DFC_RBA_IODIAGPWR_rba_IoExtCy329_SignalVltSply_0UV" 401 "DFC_RBA_IODIAGPWR_rba_IoExtCy329_SignalVltSply_1" 402 "DFC_RBA_IODIAGPWR_rba_IoExtCy329_SignalVltSply_1OT" 403 "DFC_RBA_IODIAGPWR_rba_IoExtCy329_SignalVltSply_1OV" 404 "DFC_RBA_IODIAGPWR_rba_IoExtCy329_SignalVltSply_1SCG" 405 "DFC_RBA_IODIAGPWR_rba_IoExtCy329_SignalVltSply_1UV" 406 "DFC_RBA_IODIAGPWR_rba_IoExtCy329_SignalVltSply_2" 407 "DFC_RBA_IODIAGPWR_rba_IoExtCy329_SignalVltSply_2OT" 408 "DFC_RBA_IODIAGPWR_rba_IoExtCy329_SignalVltSply_2OV" 409 "DFC_RBA_IODIAGPWR_rba_IoExtCy329_SignalVltSply_2SCG" 410 "DFC_RBA_IODIAGPWR_rba_IoExtCy329_SignalVltSply_2UV" 411 "DFC_CAN_E_TIMEOUT" 412 "DFC_LIN_E_TIMEOUT" 413 "DFC_MRlyOL" 414 "DFC_MRlySCB" 415 "DFC_MRlySCG" 416 "DFC_rba_MultiStackTrace_Threshold" 417 "DFC_BSWM_E_ACTION_FAILED" 418 "DFC_BSWM_E_INTRPTQUEUE_FULL" 419 "DFC_RBA_IOEXTLIB_KEEPALIVE_DRV" 420 "DFC_RBA_IOEXTLIB_KEEPALIVE_INI" 421 "DFC_rba_IoSigRtc_StopCounter" 422 "DFC_rba_MRly_Diag_Stk_Event" 423 "DFC_rba_MemDiag_MemReadErr" 424 "DFC_rba_MemDiag_MemWrErr" 425 "DFC_rba_SyC_IrrSwOffTrigEngRun_Event" 426 "DFC_rba_T15_Diag_ComInVld_Event" 427 "DFC_rba_T15_Diag_ComOff_HwOn_Event" 428 "DFC_rba_T15_Diag_ComOn_HwOff_Event" 429 "DFC_AppAllSnsrDfct" 430 "DFC_BattUStdbyDiaOL" 431 "DFC_BigLeakIntkMnfldEmiInfl" 432 "DFC_BrkMnSwtContOnWarnLmp" 433 "DFC_BrkMnSwtNotStpWarnLmp" 434 "DFC_BrkRdntSwtContOnWarnLmp" 435 "DFC_BrkRdntSwtNotStpWarnLmp" 436 "DFC_CEngDsTColdStrtMax" 437 "DFC_CEngDsTColdStrtMin" 438 "DFC_CEngDsTImps" 439 "DFC_CEngDsTPlausLSC" 440 "DFC_CEngDsTPlausSTC" 441 "DFC_CEngDsTSRCMax" 442 "DFC_CEngDsTSRCMin" 443 "DFC_CEngDsTSig" 444 "DFC_CEngUsTSRCMax" 445 "DFC_CEngUsTSRCMin" 446 "DFC_DCDCFltDet" 447 "DFC_DKRSA" 448 "DFC_DKVSmax" 449 "DFC_DKnpl" 450 "DFC_DSSmax" 451 "DFC_DSTTI" 452 "DFC_DSUmax" 453 "DFC_EGRVlvOL" 454 "DFC_EGRVlvSCB" 455 "DFC_EGRVlvSCG" 456 "DFC_EGSDUS2B1LtrDly" 457 "DFC_EGSDUS2B1LtrPT1" 458 "DFC_EGSDUS2B1RtlDly" 459 "DFC_EGSDUS2B1RtlPT1" 460 "DFC_EGSDUS2B1TarLean" 461 "DFC_EGSDUS2B1TarRich" 462 "DFC_ETAKHLmax" 463 "DFC_ETAKHTmax" 464 "DFC_EngICO" 465 "DFC_EngPrtOvrSpdMon" 466 "DFC_EpmCaSI1ErrSig" 467 "DFC_EpmCaSI1NoSig" 468 "DFC_EpmCaSI1OfsErr" 469 "DFC_EpmCrSErrSig" 470 "DFC_EpmCrSNoSig" 471 "DFC_EtaEngIdleNonCsers" 472 "DFC_EtaEngPtlNonCsers" 473 "DFC_FRAmax" 474 "DFC_FRAmin" 475 "DFC_GbxRvsSwtStk" 476 "DFC_HDRmax" 477 "DFC_HEGOS2B1ElecMax" 478 "DFC_HEGOS2B1ElecMin" 479 "DFC_HEGOS2B1ElecSig" 480 "DFC_HEGOS2B1HtgNpl" 481 "DFC_IntkAirTIntkMnfldCrssMax" 482 "DFC_IntkAirTIntkMnfldCrssMin" 483 "DFC_IntkAirTIntkMnfldHSCMax" 484 "DFC_IntkAirTIntkMnfldImps" 485 "DFC_IntkAirTIntkMnfldPRCMax" 486 "DFC_IntkAirTIntkMnfldPRCMin" 487 "DFC_IntkAirTIntkMnfldSRCMax" 488 "DFC_IntkAirTIntkMnfldSRCMin" 489 "DFC_IntkAirTIntkMnfldSTC" 490 "DFC_KS1max" 491 "DFC_KS1min" 492 "DFC_LMmax" 493 "DFC_LZSRnpl" 494 "DFC_LamDynDiagS1B1" 495 "DFC_LeakIntkMnfldEmiInfl" 496 "DFC_MD00max" 497 "DFC_MDBmax" 498 "DFC_MDCat" 499 "DFC_MDCatCrit" 500 "DFC_MDCatCurr" 501 "DFC_MDCyl_0" 502 "DFC_MDCyl_1" 503 "DFC_MDCyl_2" 504 "DFC_MDCyl_3" 505 "DFC_MDEmi" 506 "DFC_MDEmiStrt" 507 "DFC_MDFco" 508 "DFC_MDMpl" 509 "DFC_MDSegTiAdpn" 510 "DFC_MDmax" 511 "DFC_MOXEMM_SMU_ALM0_0" 512 "DFC_MOXEMM_SMU_ALM0_1" 513 "DFC_MOXEMM_SMU_ALM0_10" 514 "DFC_MOXEMM_SMU_ALM0_11" 515 "DFC_MOXEMM_SMU_ALM0_13" 516 "DFC_MOXEMM_SMU_ALM0_14" 517 "DFC_MOXEMM_SMU_ALM0_2" 518 "DFC_MOXEMM_SMU_ALM0_22" 519 "DFC_MOXEMM_SMU_ALM0_23" 520 "DFC_MOXEMM_SMU_ALM0_4" 521 "DFC_MOXEMM_SMU_ALM0_5" 522 "DFC_MOXEMM_SMU_ALM0_7" 523 "DFC_MOXEMM_SMU_ALM0_8" 524 "DFC_MOXEMM_SMU_ALM10_16" 525 "DFC_MOXEMM_SMU_ALM10_17" 526 "DFC_MOXEMM_SMU_ALM10_21" 527 "DFC_MOXEMM_SMU_ALM11_0" 528 "DFC_MOXEMM_SMU_ALM11_1" 529 "DFC_MOXEMM_SMU_ALM11_2" 530 "DFC_MOXEMM_SMU_ALM11_3" 531 "DFC_MOXEMM_SMU_ALM11_4" 532 "DFC_MOXEMM_SMU_ALM11_5" 533 "DFC_MOXEMM_SMU_ALM11_8" 534 "DFC_MOXEMM_SMU_ALM11_9" 535 "DFC_MOXEMM_SMU_ALM1_0" 536 "DFC_MOXEMM_SMU_ALM1_1" 537 "DFC_MOXEMM_SMU_ALM1_10" 538 "DFC_MOXEMM_SMU_ALM1_11" 539 "DFC_MOXEMM_SMU_ALM1_13" 540 "DFC_MOXEMM_SMU_ALM1_14" 541 "DFC_MOXEMM_SMU_ALM1_2" 542 "DFC_MOXEMM_SMU_ALM1_22" 543 "DFC_MOXEMM_SMU_ALM1_23" 544 "DFC_MOXEMM_SMU_ALM1_4" 545 "DFC_MOXEMM_SMU_ALM1_5" 546 "DFC_MOXEMM_SMU_ALM1_7" 547 "DFC_MOXEMM_SMU_ALM1_8" 548 "DFC_MOXEMM_SMU_ALM21_0" 549 "DFC_MOXEMM_SMU_ALM21_16" 550 "DFC_MOXEMM_SMU_ALM21_3" 551 "DFC_MOXEMM_SMU_ALM2_1" 552 "DFC_MOXEMM_SMU_ALM2_10" 553 "DFC_MOXEMM_SMU_ALM2_11" 554 "DFC_MOXEMM_SMU_ALM2_13" 555 "DFC_MOXEMM_SMU_ALM2_14" 556 "DFC_MOXEMM_SMU_ALM2_22" 557 "DFC_MOXEMM_SMU_ALM2_23" 558 "DFC_MOXEMM_SMU_ALM2_4" 559 "DFC_MOXEMM_SMU_ALM2_5" 560 "DFC_MOXEMM_SMU_ALM2_7" 561 "DFC_MOXEMM_SMU_ALM2_8" 562 "DFC_MOXEMM_SMU_ALM6_0" 563 "DFC_MOXEMM_SMU_ALM6_11" 564 "DFC_MOXEMM_SMU_ALM6_12" 565 "DFC_MOXEMM_SMU_ALM6_14" 566 "DFC_MOXEMM_SMU_ALM6_15" 567 "DFC_MOXEMM_SMU_ALM6_17" 568 "DFC_MOXEMM_SMU_ALM6_18" 569 "DFC_MOXEMM_SMU_ALM6_20" 570 "DFC_MOXEMM_SMU_ALM6_21" 571 "DFC_MOXEMM_SMU_ALM6_25" 572 "DFC_MOXEMM_SMU_ALM6_4" 573 "DFC_MOXEMM_SMU_ALM6_5" 574 "DFC_MOXEMM_SMU_ALM6_7" 575 "DFC_MOXEMM_SMU_ALM6_8" 576 "DFC_MOXEMM_SMU_ALM7_1" 577 "DFC_MOXEMM_SMU_ALM7_12" 578 "DFC_MOXEMM_SMU_ALM7_13" 579 "DFC_MOXEMM_SMU_ALM7_14" 580 "DFC_MOXEMM_SMU_ALM7_15" 581 "DFC_MOXEMM_SMU_ALM7_16" 582 "DFC_MOXEMM_SMU_ALM7_17" 583 "DFC_MOXEMM_SMU_ALM7_2" 584 "DFC_MOXEMM_SMU_ALM7_20" 585 "DFC_MOXEMM_SMU_ALM7_25" 586 "DFC_MOXEMM_SMU_ALM7_26" 587 "DFC_MOXEMM_SMU_ALM7_28" 588 "DFC_MOXEMM_SMU_ALM7_29" 589 "DFC_MOXEMM_SMU_ALM7_30" 590 "DFC_MOXEMM_SMU_ALM7_31" 591 "DFC_MOXEMM_SMU_ALM8_0" 592 "DFC_MOXEMM_SMU_ALM8_1" 593 "DFC_MOXEMM_SMU_ALM8_10" 594 "DFC_MOXEMM_SMU_ALM8_11" 595 "DFC_MOXEMM_SMU_ALM8_12" 596 "DFC_MOXEMM_SMU_ALM8_16" 597 "DFC_MOXEMM_SMU_ALM8_18" 598 "DFC_MOXEMM_SMU_ALM8_2" 599 "DFC_MOXEMM_SMU_ALM8_3" 600 "DFC_MOXEMM_SMU_ALM8_31" 601 "DFC_MOXEMM_SMU_ALM8_4" 602 "DFC_MOXEMM_SMU_ALM9_0" 603 "DFC_MOXEMM_SMU_ALM9_15" 604 "DFC_MOXEMM_SMU_ALM9_3" 605 "DFC_MoCADCNTP" 606 "DFC_MoCADCTst" 607 "DFC_MoCSOPICO" 608 "DFC_MoFAPP" 609 "DFC_MoFAirFilgPrdc" 610 "DFC_MoFAirFlCtOffPfi" 611 "DFC_MoFAirFlCylPfi" 612 "DFC_MoFAirFlIn" 613 "DFC_MoFAirFlMixCtlPfiChkAirFl" 614 "DFC_MoFAirFlMixCtlPfiChkCtrl" 615 "DFC_MoFAirFlMode" 616 "DFC_MoFESpd" 617 "DFC_MoFIACo" 618 "DFC_MoFICOL1" 619 "DFC_MoFICOL2" 620 "DFC_MoFStrt" 621 "DFC_MoFTrqCmp" 622 "DFC_MoFTrqCmpMax" 623 "DFC_MoFTrqCmpMin" 624 "DFC_MoFVarPostBldSel" 625 "DFC_MoXEMMHwLTMCUFW" 626 "DFC_MoXEMMHwLTMonBIST" 627 "DFC_MoXEMMHwLTRegMonTest" 628 "DFC_MoXEMMHwLTStbySMUAlvTest" 629 "DFC_MoXEMMHwLTTempSens" 630 "DFC_MoXEMMHwLTUCBCfg" 631 "DFC_OCWDAABEActv" 632 "DFC_OCWDACom" 633 "DFC_OCWDAErrPin" 634 "DFC_OCWDAOvrVltg" 635 "DFC_ORAmax" 636 "DFC_ORAmin" 637 "DFC_PLLSUmax" 638 "DFC_PLLSUmin" 639 "DFC_PSR1max" 640 "DFC_PSRBmax" 641 "DFC_PSRBmin" 642 "DFC_PSRPmax" 643 "DFC_PSRPmin" 644 "DFC_PSRPsig" 645 "DFC_PSRmax" 646 "DFC_PUmax" 647 "DFC_P_VSE11_OL" 648 "DFC_P_VSE11_SCB" 649 "DFC_P_VSE11_SCG" 650 "DFC_PhyHighAPP1" 651 "DFC_PhyHighAPP2" 652 "DFC_PhyLowAPP1" 653 "DFC_PhyLowAPP2" 654 "DFC_SRCHighAPP1" 655 "DFC_SRCHighAPP2" 656 "DFC_SRCLowAPP1" 657 "DFC_SRCLowAPP2" 658 "DFC_SSpMon2" 659 "DFC_SWReset_0" 660 "DFC_SWReset_1" 661 "DFC_SWReset_2" 662 "DFC_SyncAPP" 663 "DFC_TAmax_Dummy" 664 "DFC_TKAEmax" 665 "DFC_TKAEmin" 666 "DFC_TKARmax" 667 "DFC_TKARnpl" 668 "DFC_TMmax_Dummy" 669 "DFC_TUMmax_Dummy" 670 "DFC_TWCDPriCatB1" 671 "DFC_ThrVlvClsdPosnFirstOffsLrnImpoB1" 672 "DFC_ThrVlvClsdPosnOffsLrnImpoB1" 673 "DFC_ThrVlvClsdPosnOffsLrnMaxB1" 674 "DFC_ThrVlvClsdPosnOffsLrnMinB1" 675 "DFC_ThrVlvCtrlDeB1" 676 "DFC_ThrVlvDycB1" 677 "DFC_ThrVlvLimpAirPosnMaxAbsltDriftB1" 678 "DFC_ThrVlvLimpAirPosnMaxB1" 679 "DFC_ThrVlvLimpAirPosnMaxRelDriftB1" 680 "DFC_ThrVlvLimpAirPosnMinB1" 681 "DFC_ThrVlvOpenLoadB1" 682 "DFC_ThrVlvOpenSprgB1" 683 "DFC_ThrVlvOpenSprgSprdB1" 684 "DFC_ThrVlvOpenSprgTwnB1" 685 "DFC_ThrVlvOverTB1" 686 "DFC_ThrVlvRetSprgB1" 687 "DFC_ThrVlvRetSprgSprdB1" 688 "DFC_ThrVlvRetSprgTwnB1" 689 "DFC_ThrVlvSens1MaxB1" 690 "DFC_ThrVlvSens1NplB1" 691 "DFC_ThrVlvSens2MaxB1" 692 "DFC_ThrVlvSens2MinB1" 693 "DFC_ThrVlvSens2NplB1" 694 "DFC_ThrVlvShoCircB1" 695 "DFC_ThrVlvSpiErrB1" 696 "DFC_ThrvlvSens1MinB1" 697 "DFC_TiOffTBasdChkFast" 698 "DFC_TiOffTBasdChkSlow" 699 "DFC_UEGOHeatrCtlS1B1" 700 "DFC_UEGOSnsrMntdS1B1" 701 "DFC_VehVSig" 702 "DFC_VlvLftFbSwtIntk11SpclFail" 703 "DFC_VlvLftFbSwtIntk11StdFail" 704 "DFP_AAA" 705 "DFP_AGRE" 706 "DFP_AGRL" 707 "DFP_DK" 708 "DFP_DK1P" 709 "DFP_DK2P" 710 "DFP_DKVS" 711 "DFP_DSS" 712 "DFP_DSU" 713 "DFP_DVEE" 714 "DFP_DVEF" 715 "DFP_DVEFO" 716 "DFP_DVEL" 717 "DFP_DVEN" 718 "DFP_DVER" 719 "DFP_DVEU" 720 "DFP_DVEUB" 721 "DFP_DVEUW" 722 "DFP_DYLSU" 723 "DFP_FP1P" 724 "DFP_FP2P" 725 "DFP_FRA" 726 "DFP_HSH" 727 "DFP_HSHE" 728 "DFP_KAT" 729 "DFP_KPE" 730 "DFP_KS1" 731 "DFP_LASH" 732 "DFP_LLR" 733 "DFP_LLRKH" 734 "DFP_LM" 735 "DFP_LSH" 736 "DFP_LZSR" 737 "DFP_MD" 738 "DFP_ORA" 739 "DFP_PLLSU" 740 "DFP_PS2E" 741 "DFP_PSR" 742 "DFP_PSR1" 743 "DFP_PSRB" 744 "DFP_PSRE" 745 "DFP_PSRP" 746 "DFP_PU" 747 "DFP_PUE" 748 "DFP_PUPL" 749 "DFP_PUR" 750 "DFP_TA" 751 "DFP_TASRCS" 752 "DFP_TASRE" 753 "DFP_TASRPRC" 754 "DFP_TASRR" 755 "DFP_TEVE" 756 "DFP_TM" 757 "DFP_TMCS" 758 "DFP_TME" 759 "DFP_TMP" 760 "DFP_UB" 761 "DFP_VFZ" 762 "DFP_ZZZ" DEFAULT_VALUE "---" /end COMPU_VTAB
/begin COMPU_METHOD DFC_OneToOne "" RAT_FUNC "%6.2" "-" COEFFS 0 1 0 0 0 1 /end COMPU_METHOD
/begin COMPU_METHOD DFES_OneToOne "" RAT_FUNC "%6.2" "-" COEFFS 0 1 0 0 0 1 /end COMPU_METHOD
/begin COMPU_METHOD OneToOne "" RAT_FUNC "%6.2" "-" COEFFS 0 1 0 0 0 1 /end COMPU_METHOD
/begin RECORD_LAYOUT Val_Wu16 FNC_VALUES 1 UWORD COLUMN_DIR DIRECT /end RECORD_LAYOUT
/end MODULE
/end PROJECT
