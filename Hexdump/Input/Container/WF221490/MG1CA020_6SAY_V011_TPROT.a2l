ASAP2_VERSION 1 60
/begin PROJECT MG1CA020 "MG1CA020"
/begin HEADER "" VERSION "MG1CA020_6SAY_V011_TPROT" PROJECT_NO MG1CA020 /end HEADER
/begin MODULE DIM ""
/begin MOD_COMMON "" BYTE_ORDER MSB_LAST ALIGNMENT_BYTE 1 ALIGNMENT_WORD 2 ALIGNMENT_LONG 4 ALIGNMENT_INT64 4 ALIGNMENT_FLOAT32_IEEE 4 ALIGNMENT_FLOAT64_IEEE 4 DATA_SIZE 32 /end MOD_COMMON
/begin CHARACTERISTIC CALIBID "Calibration ID (Programmstep making) according to SAE J1979 for Mode $09" VAL_BLK 0x804FA854 KwbUb 255.0 dez 0.00 255.0 FORMAT "%5.1" NUMBER 16 /end CHARACTERISTIC
/begin CHARACTERISTIC ComDia_nMaxServCDI_C "maximum enginespeed to clear diagnostic information" VALUE 0x8053AC6A RB_Val_Ws16 32767.50 EngN -16384.00 16383.50 FORMAT "%8.2" /end CHARACTERISTIC
/begin CHARACTERISTIC COMDIA_TGEFN_CA "Test Group Engine Family Number" VAL_BLK 0x8051C158 ValA_Wu8 255.0 dez 0.00 255.0 FORMAT "%5.1" NUMBER 12 /end CHARACTERISTIC
/begin AXIS_PTS CrCtl_vAccnBas_AX "Axis Points for Acceleration Base of cruise control" 0x8051AFF0 CrCtl_vVehUpByte Axis_Xs16 255.0000 Vel_CrCtl1 12 0.00 255.0000 FORMAT "%8.4" EXTENDED_LIMITS -32768.00 32767.00 DEPOSIT ABSOLUTE /end AXIS_PTS
/begin AXIS_PTS CrCtl_vAccnBas_AXIS "Axis Points for Acceleration Base of cruise control" 0x8051B00A CrCtl_vVehUpByte Axis_Xs16 255.0000 Vel_CrCtl1 6 0.00 255.0000 FORMAT "%8.4" EXTENDED_LIMITS -32768.00 32767.00 DEPOSIT ABSOLUTE /end AXIS_PTS
/begin CHARACTERISTIC CrCtl_vAccnDR1DwnSlp_CUR "Acc. Data for DR1 Judgement at CC down slope" CURVE 0x8051B05A RB_Cur_Xs16Ws16 127.9961 Vel_CrCtl 0.00 127.9961 FORMAT "%8.4" EXTENDED_LIMITS -128.0000 127.9961
 /begin AXIS_DESCR STD_AXIS CrCtl_vVehUpByte Vel_CrCtl1 6 0.00 32767.00 FORMAT "%8.2" EXTENDED_LIMITS -32768.00 32767.00 DEPOSIT ABSOLUTE /end AXIS_DESCR
/end CHARACTERISTIC
/begin CHARACTERISTIC CrCtl_vAccnDR2DwnSlpCoast_CUR "Acc. Data for DR2 Judgement at CC down slope during coast" CURVE 0x8051B074 RB_Cur_Xs16Ws16 127.9961 Vel_CrCtl 0.00 127.9961 FORMAT "%8.4" EXTENDED_LIMITS -128.0000 127.9961
 /begin AXIS_DESCR STD_AXIS CrCtl_vVehUpByte Vel_CrCtl1 6 0.00 32767.00 FORMAT "%8.2" EXTENDED_LIMITS -32768.00 32767.00 DEPOSIT ABSOLUTE /end AXIS_DESCR
/end CHARACTERISTIC
/begin CHARACTERISTIC CrCtl_vAccnDR2DwnSlp_CUR "Acc. Data for DR2 Judgement at CC down slope" CURVE 0x8051B08E RB_Cur_Xs16Ws16 127.9961 Vel_CrCtl 0.00 127.9961 FORMAT "%8.4" EXTENDED_LIMITS -128.0000 127.9961
 /begin AXIS_DESCR STD_AXIS CrCtl_vVehUpByte Vel_CrCtl1 6 0.00 32767.00 FORMAT "%8.2" EXTENDED_LIMITS -32768.00 32767.00 DEPOSIT ABSOLUTE /end AXIS_DESCR
/end CHARACTERISTIC
/begin CHARACTERISTIC CrCtl_vAccnDR3DwnSlpCoast_CUR "Acc. Data for DR3 Judgement at CC down slope during coast" CURVE 0x8051B0A8 RB_Cur_Xs16Ws16 127.9961 Vel_CrCtl 0.00 127.9961 FORMAT "%8.4" EXTENDED_LIMITS -128.0000 127.9961
 /begin AXIS_DESCR STD_AXIS CrCtl_vVehUpByte Vel_CrCtl1 6 0.00 32767.00 FORMAT "%8.2" EXTENDED_LIMITS -32768.00 32767.00 DEPOSIT ABSOLUTE /end AXIS_DESCR
/end CHARACTERISTIC
/begin CHARACTERISTIC CrCtl_vAccnDR3DwnSlp_CUR "Acc. Data for DR3 Judgement at CC down slope" CURVE 0x8051B0C2 RB_Cur_Xs16Ws16 127.9961 Vel_CrCtl 0.00 127.9961 FORMAT "%8.4" EXTENDED_LIMITS -128.0000 127.9961
 /begin AXIS_DESCR STD_AXIS CrCtl_vVehUpByte Vel_CrCtl1 6 0.00 32767.00 FORMAT "%8.2" EXTENDED_LIMITS -32768.00 32767.00 DEPOSIT ABSOLUTE /end AXIS_DESCR
/end CHARACTERISTIC
/begin CHARACTERISTIC CrCtl_vAccnDR4DwnSlpCoast_CUR "Accel. Data for DR4 Judgement at CC down slope during coast" CURVE 0x8051B0DC RB_Cur_Xs16Ws16 127.9961 Vel_CrCtl 0.00 127.9961 FORMAT "%8.4" EXTENDED_LIMITS -128.0000 127.9961
 /begin AXIS_DESCR STD_AXIS CrCtl_vVehUpByte Vel_CrCtl1 6 0.00 32767.00 FORMAT "%8.2" EXTENDED_LIMITS -32768.00 32767.00 DEPOSIT ABSOLUTE /end AXIS_DESCR
/end CHARACTERISTIC
/begin CHARACTERISTIC CrCtl_vAccnDR4DwnSlp_CUR "Accel. Data for DR4 Judgement at CC down slope" CURVE 0x8051B0F6 RB_Cur_Xs16Ws16 127.9961 Vel_CrCtl 0.00 127.9961 FORMAT "%8.4" EXTENDED_LIMITS -128.0000 127.9961
 /begin AXIS_DESCR STD_AXIS CrCtl_vVehUpByte Vel_CrCtl1 6 0.00 32767.00 FORMAT "%8.2" EXTENDED_LIMITS -32768.00 32767.00 DEPOSIT ABSOLUTE /end AXIS_DESCR
/end CHARACTERISTIC
/begin CHARACTERISTIC CrCtl_vAccnDR5DwnSlpCoast_CUR "Accel. Data for DR5 Judgement at CC down slope during coast" CURVE 0x8051B110 RB_Cur_Xs16Ws16 127.9961 Vel_CrCtl 0.00 127.9961 FORMAT "%8.4" EXTENDED_LIMITS -128.0000 127.9961
 /begin AXIS_DESCR STD_AXIS CrCtl_vVehUpByte Vel_CrCtl1 6 0.00 32767.00 FORMAT "%8.2" EXTENDED_LIMITS -32768.00 32767.00 DEPOSIT ABSOLUTE /end AXIS_DESCR
/end CHARACTERISTIC
/begin CHARACTERISTIC CrCtl_vAccnDR5DwnSlp_CUR "Accel. Data for DR5 Judgement at CC down slope" CURVE 0x8051B12A RB_Cur_Xs16Ws16 127.9961 Vel_CrCtl 0.00 127.9961 FORMAT "%8.4" EXTENDED_LIMITS -128.0000 127.9961
 /begin AXIS_DESCR STD_AXIS CrCtl_vVehUpByte Vel_CrCtl1 6 0.00 32767.00 FORMAT "%8.2" EXTENDED_LIMITS -32768.00 32767.00 DEPOSIT ABSOLUTE /end AXIS_DESCR
/end CHARACTERISTIC
/begin CHARACTERISTIC CrCtl_vAccnDR6DwnSlpCoast_CUR "Accel. Data for DR6 Judgement at CC down slope during coast" CURVE 0x8051B144 RB_Cur_Xs16Ws16 127.9961 Vel_CrCtl 0.00 127.9961 FORMAT "%8.4" EXTENDED_LIMITS -128.0000 127.9961
 /begin AXIS_DESCR STD_AXIS CrCtl_vVehUpByte Vel_CrCtl1 6 0.00 32767.00 FORMAT "%8.2" EXTENDED_LIMITS -32768.00 32767.00 DEPOSIT ABSOLUTE /end AXIS_DESCR
/end CHARACTERISTIC
/begin CHARACTERISTIC CrCtl_vAccnDR6DwnSlp_CUR "Accel. Data for DR6 Judgement at CC down slope" CURVE 0x8051B15E RB_Cur_Xs16Ws16 127.9961 Vel_CrCtl 0.00 127.9961 FORMAT "%8.4" EXTENDED_LIMITS -128.0000 127.9961
 /begin AXIS_DESCR STD_AXIS CrCtl_vVehUpByte Vel_CrCtl1 6 0.00 32767.00 FORMAT "%8.2" EXTENDED_LIMITS -32768.00 32767.00 DEPOSIT ABSOLUTE /end AXIS_DESCR
/end CHARACTERISTIC
/begin CHARACTERISTIC CrCtl_vAccnDR7DwnSlpCoast_CUR "Accel. Data for DR7 Judgement at CC down slope during coast" CURVE 0x8051B178 RB_Cur_Xs16Ws16 127.9961 Vel_CrCtl 0.00 127.9961 FORMAT "%8.4" EXTENDED_LIMITS -128.0000 127.9961
 /begin AXIS_DESCR STD_AXIS CrCtl_vVehUpByte Vel_CrCtl1 6 0.00 32767.00 FORMAT "%8.2" EXTENDED_LIMITS -32768.00 32767.00 DEPOSIT ABSOLUTE /end AXIS_DESCR
/end CHARACTERISTIC
/begin CHARACTERISTIC CrCtl_vAccnDR7DwnSlp_CUR "Accel. Data for DR7 Judgement at CC down slope" CURVE 0x8051B192 RB_Cur_Xs16Ws16 127.9961 Vel_CrCtl 0.00 127.9961 FORMAT "%8.4" EXTENDED_LIMITS -128.0000 127.9961
 /begin AXIS_DESCR STD_AXIS CrCtl_vVehUpByte Vel_CrCtl1 6 0.00 32767.00 FORMAT "%8.2" EXTENDED_LIMITS -32768.00 32767.00 DEPOSIT ABSOLUTE /end AXIS_DESCR
/end CHARACTERISTIC
/begin CHARACTERISTIC CrCtl_vAccnDvtDR1ACCCnclUpSlp_C "During ACC followup control,deviation in accel data for DR1 judgement of up slope" VALUE 0x8051B1AC Val_Ws16 255.9961 Vel_CrCtl -128.0000 127.9961 FORMAT "%8.4" /end CHARACTERISTIC
/begin CHARACTERISTIC CrCtl_vAccnDvtDR1ACCUpSlp_C "During ACC follow-up control,deviation in accel data for DR1 judgement" VALUE 0x8051B1AE Val_Ws16 255.9961 Vel_CrCtl -128.0000 127.9961 FORMAT "%8.4" /end CHARACTERISTIC
/begin CHARACTERISTIC CrCtl_vAccnDvtDR1CnclUpSlp_C "DR1 cancel judgement for CC up slope" VALUE 0x8051B1B0 Val_Ws16 255.9961 Vel_CrCtl -128.0000 127.9961 FORMAT "%8.4" /end CHARACTERISTIC
/begin CHARACTERISTIC CrCtl_vAccnDvtDR1UpSlp_C "Deviation in accel data for DR1 judgement at CC up slope" VALUE 0x8051B1B2 Val_Ws16 255.9961 Vel_CrCtl -128.0000 127.9961 FORMAT "%8.4" /end CHARACTERISTIC
/begin CHARACTERISTIC CrCtl_vAccnDvtDR2ACCCnclUpSlp_C "During ACC followup control,deviation in accel data for DR2 judgement of up slope" VALUE 0x8051B1B4 Val_Ws16 255.9961 Vel_CrCtl -128.0000 127.9961 FORMAT "%8.4" /end CHARACTERISTIC
/begin CHARACTERISTIC CrCtl_vAccnDvtDR2ACCUpSlp_C "During ACC follow-up control,deviation in accel data for DR2 judgement" VALUE 0x8051B1B6 Val_Ws16 255.9961 Vel_CrCtl -128.0000 127.9961 FORMAT "%8.4" /end CHARACTERISTIC
/begin CHARACTERISTIC CrCtl_vAccnDvtDR2CnclUpSlp_C "DR2 cancel judgement for CC up slope" VALUE 0x8051B1B8 Val_Ws16 255.9961 Vel_CrCtl -128.0000 127.9961 FORMAT "%8.4" /end CHARACTERISTIC
/begin CHARACTERISTIC CrCtl_vAccnDvtDR2UpSlp_C "Deviation in accel data for DR2 judgement at CC up slope" VALUE 0x8051B1BA Val_Ws16 255.9961 Vel_CrCtl -128.0000 127.9961 FORMAT "%8.4" /end CHARACTERISTIC
/begin CHARACTERISTIC CrCtl_vAccnDvtDR3ACCCnclUpSlp_C "During ACC followup control,deviation in accel data for DR3 cancel judgement of up slope" VALUE 0x8051B1BC Val_Ws16 255.9961 Vel_CrCtl -128.0000 127.9961 FORMAT "%8.4" /end CHARACTERISTIC
/begin CHARACTERISTIC CrCtl_vAccnDvtDR3ACCUpSlp_C "During ACC follow-up control,deviation in accel data for DR3 judgement up slope" VALUE 0x8051B1BE Val_Ws16 255.9961 Vel_CrCtl -128.0000 127.9961 FORMAT "%8.4" /end CHARACTERISTIC
/begin CHARACTERISTIC CrCtl_vAccnDvtDR3CnclUpSlp_C "DR3 cancel judgement for CC up slope" VALUE 0x8051B1C0 Val_Ws16 255.9961 Vel_CrCtl -128.0000 127.9961 FORMAT "%8.4" /end CHARACTERISTIC
/begin CHARACTERISTIC CrCtl_vAccnDvtDR3UpSlp_C "Deviation in accel data for DR3 judgement at CC up slope" VALUE 0x8051B1C2 Val_Ws16 255.9961 Vel_CrCtl -128.0000 127.9961 FORMAT "%8.4" /end CHARACTERISTIC
/begin CHARACTERISTIC CrCtl_vAccnDvtDR4ACCCnclUpSlp_C "During ACC follow-up control,deviation in accel data for DR4 judgement of up slope" VALUE 0x8051B1C4 Val_Ws16 255.9961 Vel_CrCtl -128.0000 127.9961 FORMAT "%8.4" /end CHARACTERISTIC
/begin CHARACTERISTIC CrCtl_vAccnDvtDR4ACCUpSlp_C "During ACC follow-up control,deviation in accel data for DR4 judgement" VALUE 0x8051B1C6 Val_Ws16 255.9961 Vel_CrCtl -128.0000 127.9961 FORMAT "%8.4" /end CHARACTERISTIC
/begin CHARACTERISTIC CrCtl_vAccnDvtDR4CnclUpSlp_C "DR4 cancel judgement for CC up slope" VALUE 0x8051B1C8 Val_Ws16 255.9961 Vel_CrCtl -128.0000 127.9961 FORMAT "%8.4" /end CHARACTERISTIC
/begin CHARACTERISTIC CrCtl_vAccnDvtDR4UpSlp_C "Deviation in accel data for DR4 judgement at CC up slope" VALUE 0x8051B1CA Val_Ws16 255.9961 Vel_CrCtl -128.0000 127.9961 FORMAT "%8.4" /end CHARACTERISTIC
/begin CHARACTERISTIC CrCtl_vAccnDvtDR5ACCCnclUpSlp_C "During ACC follow-up control,deviation in accel data for DR5 judgement of up slope" VALUE 0x8051B1CC Val_Ws16 255.9961 Vel_CrCtl -128.0000 127.9961 FORMAT "%8.4" /end CHARACTERISTIC
/begin CHARACTERISTIC CrCtl_vAccnDvtDR5ACCUpSlp_C "During ACC follow-up control,deviation in accel data for DR5 judgement" VALUE 0x8051B1CE Val_Ws16 255.9961 Vel_CrCtl -128.0000 127.9961 FORMAT "%8.4" /end CHARACTERISTIC
/begin CHARACTERISTIC CrCtl_vAccnDvtDR5CnclUpSlp_C "DR5 cancel judgement for CC up slope" VALUE 0x8051B1D0 Val_Ws16 255.9961 Vel_CrCtl -128.0000 127.9961 FORMAT "%8.4" /end CHARACTERISTIC
/begin CHARACTERISTIC CrCtl_vAccnDvtDR5UpSlp_C "Deviation in accel data for DR5 judgement at CC up slope" VALUE 0x8051B1D2 Val_Ws16 255.9961 Vel_CrCtl -128.0000 127.9961 FORMAT "%8.4" /end CHARACTERISTIC
/begin CHARACTERISTIC CrCtl_vAccnDvtDR6ACCCnclUpSlp_C "During ACC follow-up control,deviation in accel data for DR6 judgement of up slope" VALUE 0x8051B1D4 Val_Ws16 255.9961 Vel_CrCtl -128.0000 127.9961 FORMAT "%8.4" /end CHARACTERISTIC
/begin CHARACTERISTIC CrCtl_vAccnDvtDR6ACCUpSlp_C "During ACC follow-up control,deviation in accel data for DR6 judgement" VALUE 0x8051B1D6 Val_Ws16 255.9961 Vel_CrCtl -128.0000 127.9961 FORMAT "%8.4" /end CHARACTERISTIC
/begin CHARACTERISTIC CrCtl_vAccnDvtDR6CnclUpSlp_C "DR6 cancel judgement for CC up slope" VALUE 0x8051B1D8 Val_Ws16 255.9961 Vel_CrCtl -128.0000 127.9961 FORMAT "%8.4" /end CHARACTERISTIC
/begin CHARACTERISTIC CrCtl_vAccnDvtDR6UpSlp_C "Deviation in accel data for DR6 judgement at CC up slope" VALUE 0x8051B1DA Val_Ws16 255.9961 Vel_CrCtl -128.0000 127.9961 FORMAT "%8.4" /end CHARACTERISTIC
/begin CHARACTERISTIC CrCtl_vAccnDvtDR7ACCCnclUpSlp_C "During ACC follow-up control,deviation in accel data for DR7 judgement of up slope" VALUE 0x8051B1DC Val_Ws16 255.9961 Vel_CrCtl -128.0000 127.9961 FORMAT "%8.4" /end CHARACTERISTIC
/begin CHARACTERISTIC CrCtl_vAccnDvtDR7ACCUpSlp_C "During ACC follow-up control,deviation in accel data for DR7 judgement" VALUE 0x8051B1DE Val_Ws16 255.9961 Vel_CrCtl -128.0000 127.9961 FORMAT "%8.4" /end CHARACTERISTIC
/begin CHARACTERISTIC CrCtl_vAccnDvtDR7CnclUpSlp_C "DR7 cancel judgement for CC up slope" VALUE 0x8051B1E0 Val_Ws16 255.9961 Vel_CrCtl -128.0000 127.9961 FORMAT "%8.4" /end CHARACTERISTIC
/begin CHARACTERISTIC CrCtl_vAccnDvtDR7UpSlp_C "Deviation in accel data for DR6 judgement at CC up slope" VALUE 0x8051B1E2 Val_Ws16 255.9961 Vel_CrCtl -128.0000 127.9961 FORMAT "%8.4" /end CHARACTERISTIC
/begin CHARACTERISTIC CrCtl_vACCRPntHysLoNTGKmh_GCUR "Curve for ACC RP hysteresis Lo(Not Top Gear)(Km/h spec)" CURVE 0x8051B1E4 CurG_Ws16 127.9961 Vel_CrCtl 0.00 127.9961 FORMAT "%8.4" EXTENDED_LIMITS -128.0000 127.9961
 /begin AXIS_DESCR COM_AXIS CrCtl_vVehUpBytTbl_mp Vel_CrCtl1 6 0.00 255.0000 FORMAT "%8.4" EXTENDED_LIMITS -32768.00 32767.00 AXIS_PTS_REF CrCtl_vRPntDLimHys_AXIS /end AXIS_DESCR
/end CHARACTERISTIC
/begin CHARACTERISTIC CrCtl_vACCRPntHysLoNTG_GCUR "Curve for ACC RP hysteresis Lo(Not Top Gear)" CURVE 0x8051B1F0 CurG_Ws16 127.9961 Vel_CrCtl 0.00 127.9961 FORMAT "%8.4" EXTENDED_LIMITS -128.0000 127.9961
 /begin AXIS_DESCR COM_AXIS CrCtl_vVehUpBytTbl_mp Vel_CrCtl1 6 0.00 255.0000 FORMAT "%8.4" EXTENDED_LIMITS -32768.00 32767.00 AXIS_PTS_REF CrCtl_vRPntDLimHys_AXIS /end AXIS_DESCR
/end CHARACTERISTIC
/begin CHARACTERISTIC CrCtl_vACCRPntHysLoTGKmh_GCUR "Curve for ACC RP hysteresis Lo(Top Gear)(Km/h spec)" CURVE 0x8051B1FC CurG_Ws16 127.9961 Vel_CrCtl 0.00 127.9961 FORMAT "%8.4" EXTENDED_LIMITS -128.0000 127.9961
 /begin AXIS_DESCR COM_AXIS CrCtl_vVehUpBytTbl_mp Vel_CrCtl1 6 0.00 255.0000 FORMAT "%8.4" EXTENDED_LIMITS -32768.00 32767.00 AXIS_PTS_REF CrCtl_vRPntDLimHys_AXIS /end AXIS_DESCR
/end CHARACTERISTIC
/begin CHARACTERISTIC CrCtl_vACCRPntHysLoTG_GCUR "Curve for ACC RP hysteresis Lo(Top Gear)" CURVE 0x8051B208 CurG_Ws16 127.9961 Vel_CrCtl 0.00 127.9961 FORMAT "%8.4" EXTENDED_LIMITS -128.0000 127.9961
 /begin AXIS_DESCR COM_AXIS CrCtl_vVehUpBytTbl_mp Vel_CrCtl1 6 0.00 255.0000 FORMAT "%8.4" EXTENDED_LIMITS -32768.00 32767.00 AXIS_PTS_REF CrCtl_vRPntDLimHys_AXIS /end AXIS_DESCR
/end CHARACTERISTIC
/begin AXIS_PTS CrCtl_vAPPLim_AXIS "Axis Points for APP Limit speed of cruise control" 0x8051B214 CrCtl_vVehSpd_mp Axis_Xs16 65535.00 Vel_CrCtl1 12 -32768.00 32767.00 FORMAT "%8.2" DEPOSIT ABSOLUTE /end AXIS_PTS
/begin CHARACTERISTIC CrCtl_vCmftACCRPntHysLoNTG_GCUR "Curve for ACC RP hysteresis Lo(Not Top Gear) for Comfort mode" CURVE 0x8051B22E CurG_Ws16 127.9961 Vel_CrCtl 0.00 127.9961 FORMAT "%8.4" EXTENDED_LIMITS -128.0000 127.9961
 /begin AXIS_DESCR COM_AXIS CrCtl_vVehUpBytTbl_mp Vel_CrCtl1 6 0.00 255.0000 FORMAT "%8.4" EXTENDED_LIMITS -32768.00 32767.00 AXIS_PTS_REF CrCtl_vRPntDLimHys_AXIS /end AXIS_DESCR
/end CHARACTERISTIC
/begin CHARACTERISTIC CrCtl_vCmftACCRPntHysLoTG_GCUR "Curve for ACC RP hysteresis Lo(Top Gear) for Comfort mode" CURVE 0x8051B23A CurG_Ws16 127.9961 Vel_CrCtl 0.00 127.9961 FORMAT "%8.4" EXTENDED_LIMITS -128.0000 127.9961
 /begin AXIS_DESCR COM_AXIS CrCtl_vVehUpBytTbl_mp Vel_CrCtl1 6 0.00 255.0000 FORMAT "%8.4" EXTENDED_LIMITS -32768.00 32767.00 AXIS_PTS_REF CrCtl_vRPntDLimHys_AXIS /end AXIS_DESCR
/end CHARACTERISTIC
/begin CHARACTERISTIC CrCtl_vCmftDLimHysHiNTG_GCUR "Curve for CCACC DL hysteresis Hi(Not Top Gear) for Comfort mode" CURVE 0x8051B246 CurG_Ws16 127.9961 Vel_CrCtl 0.00 127.9961 FORMAT "%8.4" EXTENDED_LIMITS -128.0000 127.9961
 /begin AXIS_DESCR COM_AXIS CrCtl_vVehUpBytTbl_mp Vel_CrCtl1 6 0.00 255.0000 FORMAT "%8.4" EXTENDED_LIMITS -32768.00 32767.00 AXIS_PTS_REF CrCtl_vRPntDLimHys_AXIS /end AXIS_DESCR
/end CHARACTERISTIC
/begin CHARACTERISTIC CrCtl_vCmftDLimHysHiTG_GCUR "Curve for CCACC DL hysteresis Hi(Top Gear) for Comfort mode" CURVE 0x8051B252 CurG_Ws16 127.9961 Vel_CrCtl 0.00 127.9961 FORMAT "%8.4" EXTENDED_LIMITS -128.0000 127.9961
 /begin AXIS_DESCR COM_AXIS CrCtl_vVehUpBytTbl_mp Vel_CrCtl1 6 0.00 255.0000 FORMAT "%8.4" EXTENDED_LIMITS -32768.00 32767.00 AXIS_PTS_REF CrCtl_vRPntDLimHys_AXIS /end AXIS_DESCR
/end CHARACTERISTIC
/begin CHARACTERISTIC CrCtl_vCmftDLimHysLoNTG_GCUR "Curve for CCACC DL hysteresis Lo(Not Top Gear) for Comfort mode" CURVE 0x8051B25E CurG_Ws16 127.9961 Vel_CrCtl 0.00 127.9961 FORMAT "%8.4" EXTENDED_LIMITS -128.0000 127.9961
 /begin AXIS_DESCR COM_AXIS CrCtl_vVehUpBytTbl_mp Vel_CrCtl1 6 0.00 255.0000 FORMAT "%8.4" EXTENDED_LIMITS -32768.00 32767.00 AXIS_PTS_REF CrCtl_vRPntDLimHys_AXIS /end AXIS_DESCR
/end CHARACTERISTIC
/begin CHARACTERISTIC CrCtl_vCmftDLimHysLoTG_GCUR "Curve for CCACC DL hysteresis Lo(Top Gear) for Comfort mode" CURVE 0x8051B26A CurG_Ws16 127.9961 Vel_CrCtl 0.00 127.9961 FORMAT "%8.4" EXTENDED_LIMITS -128.0000 127.9961
 /begin AXIS_DESCR COM_AXIS CrCtl_vVehUpBytTbl_mp Vel_CrCtl1 6 0.00 255.0000 FORMAT "%8.4" EXTENDED_LIMITS -32768.00 32767.00 AXIS_PTS_REF CrCtl_vRPntDLimHys_AXIS /end AXIS_DESCR
/end CHARACTERISTIC
/begin CHARACTERISTIC CrCtl_vCmftRPntHysHiNTG_GCUR "Curve for CC RP hysteresis Hi(Not Top Gear) for Comfort mode" CURVE 0x8051B276 CurG_Ws16 127.9961 Vel_CrCtl 0.00 127.9961 FORMAT "%8.4" EXTENDED_LIMITS -128.0000 127.9961
 /begin AXIS_DESCR COM_AXIS CrCtl_vVehUpBytTbl_mp Vel_CrCtl1 6 0.00 255.0000 FORMAT "%8.4" EXTENDED_LIMITS -32768.00 32767.00 AXIS_PTS_REF CrCtl_vRPntDLimHys_AXIS /end AXIS_DESCR
/end CHARACTERISTIC
/begin CHARACTERISTIC CrCtl_vCmftRPntHysHiTG_GCUR "Curve for CC RP hysteresis Hi(Top Gear) for Comfort mode" CURVE 0x8051B282 CurG_Ws16 127.9961 Vel_CrCtl 0.00 127.9961 FORMAT "%8.4" EXTENDED_LIMITS -128.0000 127.9961
 /begin AXIS_DESCR COM_AXIS CrCtl_vVehUpBytTbl_mp Vel_CrCtl1 6 0.00 255.0000 FORMAT "%8.4" EXTENDED_LIMITS -32768.00 32767.00 AXIS_PTS_REF CrCtl_vRPntDLimHys_AXIS /end AXIS_DESCR
/end CHARACTERISTIC
/begin CHARACTERISTIC CrCtl_vCmftRPntHysLoNTG_GCUR "Curve for CC RP hysteresis Lo(Not Top Gear) for Comfort mode" CURVE 0x8051B28E CurG_Ws16 127.9961 Vel_CrCtl 0.00 127.9961 FORMAT "%8.4" EXTENDED_LIMITS -128.0000 127.9961
 /begin AXIS_DESCR COM_AXIS CrCtl_vVehUpBytTbl_mp Vel_CrCtl1 6 0.00 255.0000 FORMAT "%8.4" EXTENDED_LIMITS -32768.00 32767.00 AXIS_PTS_REF CrCtl_vRPntDLimHys_AXIS /end AXIS_DESCR
/end CHARACTERISTIC
/begin CHARACTERISTIC CrCtl_vCmftRPntHysLoTG_GCUR "Curve for CC RP hysteresis Lo(Top Gear) for Comfort mode" CURVE 0x8051B29A CurG_Ws16 127.9961 Vel_CrCtl 0.00 127.9961 FORMAT "%8.4" EXTENDED_LIMITS -128.0000 127.9961
 /begin AXIS_DESCR COM_AXIS CrCtl_vVehUpBytTbl_mp Vel_CrCtl1 6 0.00 255.0000 FORMAT "%8.4" EXTENDED_LIMITS -32768.00 32767.00 AXIS_PTS_REF CrCtl_vRPntDLimHys_AXIS /end AXIS_DESCR
/end CHARACTERISTIC
/begin CHARACTERISTIC CrCtl_vContTUDvtECOff_CUR "Deviation speed for selecting variation of desired vehicle speed for ECON (Continuous TAPUP, Disable hysteresis, ECON sw ON)" CURVE 0x8051B2A6 RB_Cur_Xs16Ws16 127.9961 Vel_CrCtl 0.00 127.9961 FORMAT "%8.4" EXTENDED_LIMITS -128.0000 127.9961
 /begin AXIS_DESCR STD_AXIS CrCtl_vVehUpByte Vel_CrCtl1 12 0.00 255.0000 FORMAT "%8.4" EXTENDED_LIMITS -32768.00 32767.00 DEPOSIT ABSOLUTE /end AXIS_DESCR
/end CHARACTERISTIC
/begin CHARACTERISTIC CrCtl_vContTUDvtECOn_CUR "Offset value of 2nd desired vehicle speed (ECON sw OFF)" CURVE 0x8051B2D8 RB_Cur_Xs16Ws16 127.9961 Vel_CrCtl 0.00 127.9961 FORMAT "%8.4" EXTENDED_LIMITS -128.0000 127.9961
 /begin AXIS_DESCR STD_AXIS CrCtl_vVehUpByte Vel_CrCtl1 12 0.00 255.0000 FORMAT "%8.4" EXTENDED_LIMITS -32768.00 32767.00 DEPOSIT ABSOLUTE /end AXIS_DESCR
/end CHARACTERISTIC
/begin CHARACTERISTIC CrCtl_vContTUDvtHysECOff_CUR "Deviation speed for selecting variation of desired vehicle speed for ECON (Continuous TAPUP, Enable hysteresis, ECON sw ON)" CURVE 0x8051B30A RB_Cur_Xs16Ws16 127.9961 Vel_CrCtl 0.00 127.9961 FORMAT "%8.4" EXTENDED_LIMITS -128.0000 127.9961
 /begin AXIS_DESCR STD_AXIS CrCtl_vVehUpByte Vel_CrCtl1 12 0.00 255.0000 FORMAT "%8.4" EXTENDED_LIMITS -32768.00 32767.00 DEPOSIT ABSOLUTE /end AXIS_DESCR
/end CHARACTERISTIC
/begin CHARACTERISTIC CrCtl_vContTUDvtHysECOn_CUR "Deviation speed for selecting variation of desired vehicle speed for ECON (Continuous TAPUP, Disable hysteresis, ECON sw OFF)" CURVE 0x8051B33C RB_Cur_Xs16Ws16 127.9961 Vel_CrCtl 0.00 127.9961 FORMAT "%8.4" EXTENDED_LIMITS -128.0000 127.9961
 /begin AXIS_DESCR STD_AXIS CrCtl_vVehUpByte Vel_CrCtl1 12 0.00 255.0000 FORMAT "%8.4" EXTENDED_LIMITS -32768.00 32767.00 DEPOSIT ABSOLUTE /end AXIS_DESCR
/end CHARACTERISTIC
/begin CHARACTERISTIC CrCtl_vContTUECOffDesInc1_MAP "Added value2 in each 100ms to desired vehicle speed for ECON (ECON sw OFF, Continuous TAPUP)" MAP 0x8051B36E Map_Xs16Ys16Ws16 127.9961 Vel_CrCtl 0.00 127.9961 FORMAT "%8.4" EXTENDED_LIMITS -128.0000 127.9961
 /begin AXIS_DESCR STD_AXIS CrCtl_vVehUpByte Vel_CrCtl1 12 0.00 255.0000 FORMAT "%8.4" EXTENDED_LIMITS -32768.00 32767.00 DEPOSIT ABSOLUTE /end AXIS_DESCR
 /begin AXIS_DESCR STD_AXIS CrCtl_rEstSlpFltVal Prc_CrCtl4 9 -128.0000 127.9961 FORMAT "%8.4" DEPOSIT ABSOLUTE /end AXIS_DESCR
/end CHARACTERISTIC
/begin CHARACTERISTIC CrCtl_vContTUECOffDesInc2_CUR "Added value1 in each 100ms to desired vehicle speed for ECON (ECON sw ON, Continuous TAPUP)" CURVE 0x8051B474 RB_Cur_Xs16Ws16 127.9961 Vel_CrCtl 0.00 127.9961 FORMAT "%8.4" EXTENDED_LIMITS -128.0000 127.9961
 /begin AXIS_DESCR STD_AXIS CrCtl_vSpdDvt_mp Vel_CrCtl 9 -128.0000 127.9961 FORMAT "%8.4" DEPOSIT ABSOLUTE /end AXIS_DESCR
/end CHARACTERISTIC
/begin CHARACTERISTIC CrCtl_vContTUECOnDesInc1_MAP "Added value2 in each 100ms to desired vehicle speed for ECON (ECON sw ON, Continuous TAPUP)" MAP 0x8051B49A Map_Xs16Ys16Ws16 127.9961 Vel_CrCtl 0.00 127.9961 FORMAT "%8.4" EXTENDED_LIMITS -128.0000 127.9961
 /begin AXIS_DESCR STD_AXIS CrCtl_vVehUpByte Vel_CrCtl1 12 0.00 255.0000 FORMAT "%8.4" EXTENDED_LIMITS -32768.00 32767.00 DEPOSIT ABSOLUTE /end AXIS_DESCR
 /begin AXIS_DESCR STD_AXIS CrCtl_rEstSlpFltVal Prc_CrCtl4 9 -128.0000 127.9961 FORMAT "%8.4" DEPOSIT ABSOLUTE /end AXIS_DESCR
/end CHARACTERISTIC
/begin CHARACTERISTIC CrCtl_vContTUECOnDesInc2_CUR "Selected easily condition to change desired vehicle speed for ECON" CURVE 0x8051B5A0 RB_Cur_Xs16Ws16 127.9961 Vel_CrCtl 0.00 127.9961 FORMAT "%8.4" EXTENDED_LIMITS -128.0000 127.9961
 /begin AXIS_DESCR STD_AXIS CrCtl_vSpdDvt_mp Vel_CrCtl 9 -128.0000 127.9961 FORMAT "%8.4" DEPOSIT ABSOLUTE /end AXIS_DESCR
/end CHARACTERISTIC
/begin CHARACTERISTIC CrCtl_vDes2OffsECOff_MAP "Offset value of 2nd desired vehicle speed (ECON sw ON)" MAP 0x8051B5C6 Map_Xs16Ys16Ws16 255.9961 Vel_CrCtl -128.0000 127.9961 FORMAT "%8.4"
 /begin AXIS_DESCR STD_AXIS CrCtl_vVehUpByte Vel_CrCtl1 12 0.00 255.0000 FORMAT "%8.4" EXTENDED_LIMITS -32768.00 32767.00 DEPOSIT ABSOLUTE /end AXIS_DESCR
 /begin AXIS_DESCR STD_AXIS CrCtl_rEstSlpFltVal Prc_CrCtl4 9 -128.0000 127.9961 FORMAT "%8.4" DEPOSIT ABSOLUTE /end AXIS_DESCR
/end CHARACTERISTIC
/begin CHARACTERISTIC CrCtl_vDes2OffsECOn_MAP "Added value1 in each 100ms to desired vehicle speed for ECON (ECON sw OFF)" MAP 0x8051B6CC Map_Xs16Ys16Ws16 255.9961 Vel_CrCtl -128.0000 127.9961 FORMAT "%8.4"
 /begin AXIS_DESCR STD_AXIS CrCtl_vVehUpByte Vel_CrCtl1 12 0.00 255.0000 FORMAT "%8.4" EXTENDED_LIMITS -32768.00 32767.00 DEPOSIT ABSOLUTE /end AXIS_DESCR
 /begin AXIS_DESCR STD_AXIS CrCtl_rEstSlpFltVal Prc_CrCtl4 9 -128.0000 127.9961 FORMAT "%8.4" DEPOSIT ABSOLUTE /end AXIS_DESCR
/end CHARACTERISTIC
/begin CHARACTERISTIC CrCtl_vDesClthOnStrtAdd_C "setpoint speed add value for Cruise Control Clutch On Start" VALUE 0x8051B7D4 Val_Ws32 8388607.99609 Vel_CrCtl 0.00 8388607.99609 FORMAT "%13.5" EXTENDED_LIMITS -8388608.00000 8388607.99609 /end CHARACTERISTIC
/begin CHARACTERISTIC CrCtl_vDLimHysHiNTGKmh_GCUR "Curve for CC/ACC DL hysteresis Hi(Not Top Gear)(Km/h spec)" CURVE 0x8051B7D8 CurG_Ws16 127.9961 Vel_CrCtl 0.00 127.9961 FORMAT "%8.4" EXTENDED_LIMITS -128.0000 127.9961
 /begin AXIS_DESCR COM_AXIS CrCtl_vVehUpBytTbl_mp Vel_CrCtl1 6 0.00 255.0000 FORMAT "%8.4" EXTENDED_LIMITS -32768.00 32767.00 AXIS_PTS_REF CrCtl_vRPntDLimHys_AXIS /end AXIS_DESCR
/end CHARACTERISTIC
/begin CHARACTERISTIC CrCtl_vDLimHysHiNTG_GCUR "Curve for CC/ACC DL hysteresis Hi(Not Top Gear)" CURVE 0x8051B7E4 CurG_Ws16 127.9961 Vel_CrCtl 0.00 127.9961 FORMAT "%8.4" EXTENDED_LIMITS -128.0000 127.9961
 /begin AXIS_DESCR COM_AXIS CrCtl_vVehUpBytTbl_mp Vel_CrCtl1 6 0.00 255.0000 FORMAT "%8.4" EXTENDED_LIMITS -32768.00 32767.00 AXIS_PTS_REF CrCtl_vRPntDLimHys_AXIS /end AXIS_DESCR
/end CHARACTERISTIC
/begin CHARACTERISTIC CrCtl_vDLimHysHiTGKmh_GCUR "Curve for CC/ACC DL hysteresis Hi(Top Gear)(Km/h spec)" CURVE 0x8051B7F0 CurG_Ws16 127.9961 Vel_CrCtl 0.00 127.9961 FORMAT "%8.4" EXTENDED_LIMITS -128.0000 127.9961
 /begin AXIS_DESCR COM_AXIS CrCtl_vVehUpBytTbl_mp Vel_CrCtl1 6 0.00 255.0000 FORMAT "%8.4" EXTENDED_LIMITS -32768.00 32767.00 AXIS_PTS_REF CrCtl_vRPntDLimHys_AXIS /end AXIS_DESCR
/end CHARACTERISTIC
/begin CHARACTERISTIC CrCtl_vDLimHysHiTG_GCUR "Curve for CC/ACC DL hysteresis Hi(Top Gear)(Km/h spec)" CURVE 0x8051B7FC CurG_Ws16 127.9961 Vel_CrCtl 0.00 127.9961 FORMAT "%8.4" EXTENDED_LIMITS -128.0000 127.9961
 /begin AXIS_DESCR COM_AXIS CrCtl_vVehUpBytTbl_mp Vel_CrCtl1 6 0.00 255.0000 FORMAT "%8.4" EXTENDED_LIMITS -32768.00 32767.00 AXIS_PTS_REF CrCtl_vRPntDLimHys_AXIS /end AXIS_DESCR
/end CHARACTERISTIC
/begin CHARACTERISTIC CrCtl_vDLimHysLoNTGKmh_GCUR "Curve for CC/ACC DL hysteresis Lo(Not Top Gear)(Km/h spec)" CURVE 0x8051B808 CurG_Ws16 127.9961 Vel_CrCtl 0.00 127.9961 FORMAT "%8.4" EXTENDED_LIMITS -128.0000 127.9961
 /begin AXIS_DESCR COM_AXIS CrCtl_vVehUpBytTbl_mp Vel_CrCtl1 6 0.00 255.0000 FORMAT "%8.4" EXTENDED_LIMITS -32768.00 32767.00 AXIS_PTS_REF CrCtl_vRPntDLimHys_AXIS /end AXIS_DESCR
/end CHARACTERISTIC
/begin CHARACTERISTIC CrCtl_vDLimHysLoNTG_GCUR "Curve for CC/ACC DL hysteresis Lo(Not Top Gear)" CURVE 0x8051B814 CurG_Ws16 127.9961 Vel_CrCtl 0.00 127.9961 FORMAT "%8.4" EXTENDED_LIMITS -128.0000 127.9961
 /begin AXIS_DESCR COM_AXIS CrCtl_vVehUpBytTbl_mp Vel_CrCtl1 6 0.00 255.0000 FORMAT "%8.4" EXTENDED_LIMITS -32768.00 32767.00 AXIS_PTS_REF CrCtl_vRPntDLimHys_AXIS /end AXIS_DESCR
/end CHARACTERISTIC
/begin CHARACTERISTIC CrCtl_vDLimHysLoTGKmh_GCUR "Curve for CC/ACC DL hysteresis Lo(Top Gear)(Km/h spec)" CURVE 0x8051B820 CurG_Ws16 127.9961 Vel_CrCtl 0.00 127.9961 FORMAT "%8.4" EXTENDED_LIMITS -128.0000 127.9961
 /begin AXIS_DESCR COM_AXIS CrCtl_vVehUpBytTbl_mp Vel_CrCtl1 6 0.00 255.0000 FORMAT "%8.4" EXTENDED_LIMITS -32768.00 32767.00 AXIS_PTS_REF CrCtl_vRPntDLimHys_AXIS /end AXIS_DESCR
/end CHARACTERISTIC
/begin CHARACTERISTIC CrCtl_vDLimHysLoTG_GCUR "Curve for CC/ACC DL hysteresis Lo(Top Gear)" CURVE 0x8051B82C CurG_Ws16 127.9961 Vel_CrCtl 0.00 127.9961 FORMAT "%8.4" EXTENDED_LIMITS -128.0000 127.9961
 /begin AXIS_DESCR COM_AXIS CrCtl_vVehUpBytTbl_mp Vel_CrCtl1 6 0.00 255.0000 FORMAT "%8.4" EXTENDED_LIMITS -32768.00 32767.00 AXIS_PTS_REF CrCtl_vRPntDLimHys_AXIS /end AXIS_DESCR
/end CHARACTERISTIC
/begin CHARACTERISTIC CrCtl_vDR1DvtDwnSlp_C "Data on speed deviation for DR1 judgement at CC down slp" VALUE 0x8051B838 Val_Ws16 255.9961 Vel_CrCtl -128.0000 127.9961 FORMAT "%8.4" /end CHARACTERISTIC
/begin CHARACTERISTIC CrCtl_vDR1HiHysUpLimACCDnSlp_C "Lo hysterisis for DR1 upper speed limit at ACC down slope" VALUE 0x8051B83C Val_Ws32 16777215.9961 Vel_CrCtl -8388608.00000 8388607.99609 FORMAT "%13.5" /end CHARACTERISTIC
/begin CHARACTERISTIC CrCtl_vDR1HiHysUpLimUpSlp_C "Hi Hys for D1 upper speed limit of CC at up slope" VALUE 0x8051B840 Val_Ws32 16777215.9961 Vel_CrCtl -8388608.00000 8388607.99609 FORMAT "%13.5" /end CHARACTERISTIC
/begin CHARACTERISTIC CrCtl_vDR1LoHysUpLimACCDnSlp_C "Lo Hysteresis of DR1 upper limit of vehicle speed for ACC down slope" VALUE 0x8051B844 Val_Ws32 16777215.9961 Vel_CrCtl -8388608.00000 8388607.99609 FORMAT "%13.5" /end CHARACTERISTIC
/begin CHARACTERISTIC CrCtl_vDR1LoHysUpLimUpSlp_C "Lo Hysteresis for DR1 upper speed limit at CC up slope" VALUE 0x8051B848 Val_Ws32 16777215.9961 Vel_CrCtl -8388608.00000 8388607.99609 FORMAT "%13.5" /end CHARACTERISTIC
/begin CHARACTERISTIC CrCtl_vDR2DvtDwnSlp_C "Data on speed deviation for DR2 judgement at CC down slp" VALUE 0x8051B84C Val_Ws16 255.9961 Vel_CrCtl -128.0000 127.9961 FORMAT "%8.4" /end CHARACTERISTIC
/begin CHARACTERISTIC CrCtl_vDR2HiHysUpLimACCDnSlp_C "Hi Hysterisis for DR2 upper speed limit at ACC down slope" VALUE 0x8051B850 Val_Ws32 16777215.9961 Vel_CrCtl -8388608.00000 8388607.99609 FORMAT "%13.5" /end CHARACTERISTIC
/begin CHARACTERISTIC CrCtl_vDR2HiHysUpLimDnSlp_C "Hi Hysteresis of DR2 upper limit of vehicle speed for CC down slope" VALUE 0x8051B854 Val_Ws32 16777215.9961 Vel_CrCtl -8388608.00000 8388607.99609 FORMAT "%13.5" /end CHARACTERISTIC
/begin CHARACTERISTIC CrCtl_vDR2HiHysUpLimUpSlp_C "Hi Hys for D2 upper speed limit of CC at up slope" VALUE 0x8051B858 Val_Ws32 16777215.9961 Vel_CrCtl -8388608.00000 8388607.99609 FORMAT "%13.5" /end CHARACTERISTIC
/begin CHARACTERISTIC CrCtl_vDR2LoHysUpLimACCDnSlp_C "Lo Hysteresis of DR2 upper limit of vehicle speed for ACC down slope" VALUE 0x8051B85C Val_Ws32 16777215.9961 Vel_CrCtl -8388608.00000 8388607.99609 FORMAT "%13.5" /end CHARACTERISTIC
/begin CHARACTERISTIC CrCtl_vDR2LoHysUpLimDnSlp_C "Lo Hysteresis for DR2 upper speed limit at CC down slope" VALUE 0x8051B860 Val_Ws32 16777215.9961 Vel_CrCtl -8388608.00000 8388607.99609 FORMAT "%13.5" /end CHARACTERISTIC
/begin CHARACTERISTIC CrCtl_vDR2LoHysUpLimUpSlp_C "Lo Hysteresis for DR2 upper speed limit at CC up slope" VALUE 0x8051B864 Val_Ws32 16777215.9961 Vel_CrCtl -8388608.00000 8388607.99609 FORMAT "%13.5" /end CHARACTERISTIC
/begin CHARACTERISTIC CrCtl_vDR3DvtDwnSlp_C "Data on speed deviation for DR3 judgement at CC down slp" VALUE 0x8051B868 Val_Ws16 255.9961 Vel_CrCtl -128.0000 127.9961 FORMAT "%8.4" /end CHARACTERISTIC
/begin CHARACTERISTIC CrCtl_vDR3HiHysUpLimACCDnSlp_C "Hi Hysterisis for DR3 upper speed limit at ACC down slope" VALUE 0x8051B86C Val_Ws32 16777215.9961 Vel_CrCtl -8388608.00000 8388607.99609 FORMAT "%13.5" /end CHARACTERISTIC
/begin CHARACTERISTIC CrCtl_vDR3HiHysUpLimDnSlp_C "Hi Hysteresis of DR3 upper limit of vehicle speed for CC down slope" VALUE 0x8051B870 Val_Ws32 16777215.9961 Vel_CrCtl -8388608.00000 8388607.99609 FORMAT "%13.5" /end CHARACTERISTIC
/begin CHARACTERISTIC CrCtl_vDR3HiHysUpLimUpSlp_C "Hi Hys for D3 upper speed limit of CC at up slope" VALUE 0x8051B874 Val_Ws32 16777215.9961 Vel_CrCtl -8388608.00000 8388607.99609 FORMAT "%13.5" /end CHARACTERISTIC
/begin CHARACTERISTIC CrCtl_vDR3LoHysUpLimACCDnSlp_C "Lo Hysteresis of DR3 upper limit of vehicle speed for ACC down slope" VALUE 0x8051B878 Val_Ws32 16777215.9961 Vel_CrCtl -8388608.00000 8388607.99609 FORMAT "%13.5" /end CHARACTERISTIC
/begin CHARACTERISTIC CrCtl_vDR3LoHysUpLimDnSlp_C "Lo Hysteresis for DR3 upper speed limit at CC down slope" VALUE 0x8051B87C Val_Ws32 16777215.9961 Vel_CrCtl -8388608.00000 8388607.99609 FORMAT "%13.5" /end CHARACTERISTIC
/begin CHARACTERISTIC CrCtl_vDR3LoHysUpLimUpSlp_C "Lo Hysteresis for DR3 upper speed limit at CC up slope" VALUE 0x8051B880 Val_Ws32 16777215.9961 Vel_CrCtl -8388608.00000 8388607.99609 FORMAT "%13.5" /end CHARACTERISTIC
/begin CHARACTERISTIC CrCtl_vDR4DvtDwnSlp_C "Data on speed deviation for DR4 judgement at CC down slope" VALUE 0x8051B884 Val_Ws16 255.9961 Vel_CrCtl -128.0000 127.9961 FORMAT "%8.4" /end CHARACTERISTIC
/begin CHARACTERISTIC CrCtl_vDR4HiHysUpLimACCDnSlp_C "Lo hysterisis for DR4 upper speed limit at ACC down slope" VALUE 0x8051B888 Val_Ws32 16777215.9961 Vel_CrCtl -8388608.00000 8388607.99609 FORMAT "%13.5" /end CHARACTERISTIC
/begin CHARACTERISTIC CrCtl_vDR4HiHysUpLimDnSlp_C "Hi Hysteresis of DR4 upper limit of vehicle speed for CC down slope" VALUE 0x8051B88C Val_Ws32 16777215.9961 Vel_CrCtl -8388608.00000 8388607.99609 FORMAT "%13.5" /end CHARACTERISTIC
/begin CHARACTERISTIC CrCtl_vDR4HiHysUpLimUpSlp_C "Hi Hys for D4 upper speed limit of CC at up slope" VALUE 0x8051B890 Val_Ws32 16777215.9961 Vel_CrCtl -8388608.00000 8388607.99609 FORMAT "%13.5" /end CHARACTERISTIC
/begin CHARACTERISTIC CrCtl_vDR4LoHysUpLimACCDnSlp_C "Lo Hysteresis of DR4 upper limit of vehicle speed for ACC down slope" VALUE 0x8051B894 Val_Ws32 16777215.9961 Vel_CrCtl -8388608.00000 8388607.99609 FORMAT "%13.5" /end CHARACTERISTIC
/begin CHARACTERISTIC CrCtl_vDR4LoHysUpLimDnSlp_C "Lo Hysteresis for DR4 upper speed limit at CC down slope" VALUE 0x8051B898 Val_Ws32 16777215.9961 Vel_CrCtl -8388608.00000 8388607.99609 FORMAT "%13.5" /end CHARACTERISTIC
/begin CHARACTERISTIC CrCtl_vDR4LoHysUpLimUpSlp_C "Lo Hysteresis for DR4 upper speed limit at CC up slope" VALUE 0x8051B89C Val_Ws32 16777215.9961 Vel_CrCtl -8388608.00000 8388607.99609 FORMAT "%13.5" /end CHARACTERISTIC
/begin CHARACTERISTIC CrCtl_vDR5DvtDwnSlp_C "Data on speed deviation for DR5 judgement at CC down slope" VALUE 0x8051B8A0 Val_Ws16 255.9961 Vel_CrCtl -128.0000 127.9961 FORMAT "%8.4" /end CHARACTERISTIC
/begin CHARACTERISTIC CrCtl_vDR5HiHysUpLimACCDnSlp_C "Hi hysterisis for DR5 upper speed limit at ACC down slope" VALUE 0x8051B8A4 Val_Ws32 16777215.9961 Vel_CrCtl -8388608.00000 8388607.99609 FORMAT "%13.5" /end CHARACTERISTIC
/begin CHARACTERISTIC CrCtl_vDR5HiHysUpLimDnSlp_C "Hi Hysteresis of DR5 upper limit of vehicle speed for CC down slope" VALUE 0x8051B8A8 Val_Ws32 16777215.9961 Vel_CrCtl -8388608.00000 8388607.99609 FORMAT "%13.5" /end CHARACTERISTIC
/begin CHARACTERISTIC CrCtl_vDR5HiHysUpLimUpSlp_C "Hi Hys for DR5 upper speed limit of CC at up slope" VALUE 0x8051B8AC Val_Ws32 16777215.9961 Vel_CrCtl -8388608.00000 8388607.99609 FORMAT "%13.5" /end CHARACTERISTIC
/begin CHARACTERISTIC CrCtl_vDR5LoHysUpLimACCDnSlp_C "Lo Hysteresis of DR5 upper limit of vehicle speed for ACC down slope" VALUE 0x8051B8B0 Val_Ws32 16777215.9961 Vel_CrCtl -8388608.00000 8388607.99609 FORMAT "%13.5" /end CHARACTERISTIC
/begin CHARACTERISTIC CrCtl_vDR5LoHysUpLimDnSlp_C "Lo Hysteresis for DR5 upper speed limit at CC down slope" VALUE 0x8051B8B4 Val_Ws32 16777215.9961 Vel_CrCtl -8388608.00000 8388607.99609 FORMAT "%13.5" /end CHARACTERISTIC
/begin CHARACTERISTIC CrCtl_vDR5LoHysUpLimUpSlp_C "Lo Hysteresis for DR5 upper speed limit at CC up slope" VALUE 0x8051B8B8 Val_Ws32 16777215.9961 Vel_CrCtl -8388608.00000 8388607.99609 FORMAT "%13.5" /end CHARACTERISTIC
/begin CHARACTERISTIC CrCtl_vDR6DvtDwnSlp_C "Data on speed deviation for DR6 judgement at CC down slope" VALUE 0x8051B8BC Val_Ws16 255.9961 Vel_CrCtl -128.0000 127.9961 FORMAT "%8.4" /end CHARACTERISTIC
/begin CHARACTERISTIC CrCtl_vDR6HiHysUpLimACCDnSlp_C "Lo hysterisis for DR6 upper speed limit at ACC down slope" VALUE 0x8051B8C0 Val_Ws32 16777215.9961 Vel_CrCtl -8388608.00000 8388607.99609 FORMAT "%13.5" /end CHARACTERISTIC
/begin CHARACTERISTIC CrCtl_vDR6HiHysUpLimDnSlp_C "Hi Hysteresis of DR6 upper limit of vehicle speed for CC down slope" VALUE 0x8051B8C4 Val_Ws32 16777215.9961 Vel_CrCtl -8388608.00000 8388607.99609 FORMAT "%13.5" /end CHARACTERISTIC
/begin CHARACTERISTIC CrCtl_vDR6HiHysUpLimUpSlp_C "Hi Hys for DR6 upper speed limit of CC at up slope" VALUE 0x8051B8C8 Val_Ws32 16777215.9961 Vel_CrCtl -8388608.00000 8388607.99609 FORMAT "%13.5" /end CHARACTERISTIC
/begin CHARACTERISTIC CrCtl_vDR6LoHysUpLimACCDnSlp_C "Lo Hysteresis of DR6 upper limit of vehicle speed for ACC down slope" VALUE 0x8051B8CC Val_Ws32 16777215.9961 Vel_CrCtl -8388608.00000 8388607.99609 FORMAT "%13.5" /end CHARACTERISTIC
/begin CHARACTERISTIC CrCtl_vDR6LoHysUpLimDnSlp_C "Lo Hysteresis for DR6 upper speed limit at CC down slope" VALUE 0x8051B8D0 Val_Ws32 16777215.9961 Vel_CrCtl -8388608.00000 8388607.99609 FORMAT "%13.5" /end CHARACTERISTIC
/begin CHARACTERISTIC CrCtl_vDR6LoHysUpLimUpSlp_C "Lo Hysteresis for DR6 upper speed limit at CC up slope" VALUE 0x8051B8D4 Val_Ws32 16777215.9961 Vel_CrCtl -8388608.00000 8388607.99609 FORMAT "%13.5" /end CHARACTERISTIC
/begin CHARACTERISTIC CrCtl_vDR7DvtDwnSlp_C "Data on speed deviation for DR7 judgement at CC down slope" VALUE 0x8051B8D8 Val_Ws16 255.9961 Vel_CrCtl -128.0000 127.9961 FORMAT "%8.4" /end CHARACTERISTIC
/begin CHARACTERISTIC CrCtl_vDR7HiHysUpLimACCDnSlp_C "Lo hysterisis for DR7 upper speed limit at ACC down slope" VALUE 0x8051B8DC Val_Ws32 16777215.9961 Vel_CrCtl -8388608.00000 8388607.99609 FORMAT "%13.5" /end CHARACTERISTIC
/begin CHARACTERISTIC CrCtl_vDR7HiHysUpLimDnSlp_C "Hi Hysteresis of DR7 upper limit of vehicle speed for CC down slope" VALUE 0x8051B8E0 Val_Ws32 16777215.9961 Vel_CrCtl -8388608.00000 8388607.99609 FORMAT "%13.5" /end CHARACTERISTIC
/begin CHARACTERISTIC CrCtl_vDR7HiHysUpLimUpSlp_C "Hi Hys for DR7 upper speed limit of CC at up slope" VALUE 0x8051B8E4 Val_Ws32 16777215.9961 Vel_CrCtl -8388608.00000 8388607.99609 FORMAT "%13.5" /end CHARACTERISTIC
/begin CHARACTERISTIC CrCtl_vDR7LoHysUpLimACCDnSlp_C "Lo Hysteresis of DR7 upper limit of vehicle speed for ACC down slope" VALUE 0x8051B8E8 Val_Ws32 16777215.9961 Vel_CrCtl -8388608.00000 8388607.99609 FORMAT "%13.5" /end CHARACTERISTIC
/begin CHARACTERISTIC CrCtl_vDR7LoHysUpLimDnSlp_C "Lo Hysteresis for DR7 upper speed limit at CC down slope" VALUE 0x8051B8EC Val_Ws32 16777215.9961 Vel_CrCtl -8388608.00000 8388607.99609 FORMAT "%13.5" /end CHARACTERISTIC
/begin CHARACTERISTIC CrCtl_vDR7LoHysUpLimUpSlp_C "Lo Hysteresis for DR7 upper speed limit at CC up slope" VALUE 0x8051B8F0 Val_Ws32 16777215.9961 Vel_CrCtl -8388608.00000 8388607.99609 FORMAT "%13.5" /end CHARACTERISTIC
/begin CHARACTERISTIC CrCtl_vECAccCtlTarAStd_GCUR "Correct value of initial request APP for ECON" CURVE 0x8051B8F4 CurG_Ws16 255.9961 Vel_CrCtl -128.0000 127.9961 FORMAT "%8.4"
 /begin AXIS_DESCR COM_AXIS CrCtl_vVehUpByte Vel_CrCtl1 6 0.00 255.0000 FORMAT "%8.4" EXTENDED_LIMITS -32768.00 32767.00 AXIS_PTS_REF CrCtl_vAccnBas_AXIS /end AXIS_DESCR
/end CHARACTERISTIC
/begin CHARACTERISTIC CrCtl_vECDR1DvtDwnSlp_C "Data on speed deviation for DR1 judgement at CC down slp for ECON" VALUE 0x8051B900 Val_Ws16 10.00000 Vel_CrCtl 0.00 10.00000 FORMAT "%8.5" EXTENDED_LIMITS -128.0000 127.9961 /end CHARACTERISTIC
/begin CHARACTERISTIC CrCtl_vECDR2DvtDwnSlp_C "Data on speed deviation for DR2 judgement at CC down slp for ECON" VALUE 0x8051B902 Val_Ws16 10.00000 Vel_CrCtl 0.00 10.00000 FORMAT "%8.5" EXTENDED_LIMITS -128.0000 127.9961 /end CHARACTERISTIC
/begin CHARACTERISTIC CrCtl_vECDR3DvtDwnSlp_C "Data on speed deviation for DR3 judgement at CC down slp for ECON" VALUE 0x8051B904 Val_Ws16 10.00000 Vel_CrCtl 0.00 10.00000 FORMAT "%8.5" EXTENDED_LIMITS -128.0000 127.9961 /end CHARACTERISTIC
/begin CHARACTERISTIC CrCtl_vECDR4DvtDwnSlp_C "Data on speed deviation for DR4 judgement at CC down slp for ECON" VALUE 0x8051B906 Val_Ws16 10.00000 Vel_CrCtl 0.00 10.00000 FORMAT "%8.5" EXTENDED_LIMITS -128.0000 127.9961 /end CHARACTERISTIC
/begin CHARACTERISTIC CrCtl_vECDR5DvtDwnSlp_C "Data on speed deviation for DR5 judgement at CC down slp for ECON" VALUE 0x8051B908 Val_Ws16 10.00000 Vel_CrCtl 0.00 10.00000 FORMAT "%8.5" EXTENDED_LIMITS -128.0000 127.9961 /end CHARACTERISTIC
/begin CHARACTERISTIC CrCtl_vECDR6DvtDwnSlp_C "Data on speed deviation for DR6 judgement at CC down slp for ECON" VALUE 0x8051B90A Val_Ws16 10.00000 Vel_CrCtl 0.00 10.00000 FORMAT "%8.5" EXTENDED_LIMITS -128.0000 127.9961 /end CHARACTERISTIC
/begin CHARACTERISTIC CrCtl_vECDR7DvtDwnSlp_C "Data on speed deviation for DR7 judgement at CC down slp for ECON" VALUE 0x8051B90C Val_Ws16 10.00000 Vel_CrCtl 0.00 10.00000 FORMAT "%8.5" EXTENDED_LIMITS -128.0000 127.9961 /end CHARACTERISTIC
/begin CHARACTERISTIC CrCtl_vECDvtDR1UpSlp_C "Deviation in accel data for DR1 judgement at CC up slope for ECON" VALUE 0x8051B90E Val_Ws16 127.9961 Vel_CrCtl 0.00 127.9961 FORMAT "%8.4" EXTENDED_LIMITS -128.0000 127.9961 /end CHARACTERISTIC
/begin CHARACTERISTIC CrCtl_vECDvtDR2UpSlp_C "Deviation in accel data for DR2 judgement at CC up slope for ECON" VALUE 0x8051B910 Val_Ws16 127.9961 Vel_CrCtl 0.00 127.9961 FORMAT "%8.4" EXTENDED_LIMITS -128.0000 127.9961 /end CHARACTERISTIC
/begin CHARACTERISTIC CrCtl_vECDvtDR3UpSlp_C "Deviation in accel data for DR3 judgement at CC up slope for ECON" VALUE 0x8051B912 Val_Ws16 127.9961 Vel_CrCtl 0.00 127.9961 FORMAT "%8.4" EXTENDED_LIMITS -128.0000 127.9961 /end CHARACTERISTIC
/begin CHARACTERISTIC CrCtl_vECDvtDR4UpSlp_C "Deviation in accel data for DR4 judgement at CC up slope for ECON" VALUE 0x8051B914 Val_Ws16 127.9961 Vel_CrCtl 0.00 127.9961 FORMAT "%8.4" EXTENDED_LIMITS -128.0000 127.9961 /end CHARACTERISTIC
/begin CHARACTERISTIC CrCtl_vECDvtDR5UpSlp_C "Deviation in accel data for DR5 judgement at CC up slope for ECON" VALUE 0x8051B916 Val_Ws16 127.9961 Vel_CrCtl 0.00 127.9961 FORMAT "%8.4" EXTENDED_LIMITS -128.0000 127.9961 /end CHARACTERISTIC
/begin CHARACTERISTIC CrCtl_vECDvtDR6UpSlp_C "Deviation in accel data for DR6 judgement at CC up slope for ECON" VALUE 0x8051B918 Val_Ws16 127.9961 Vel_CrCtl 0.00 127.9961 FORMAT "%8.4" EXTENDED_LIMITS -128.0000 127.9961 /end CHARACTERISTIC
/begin CHARACTERISTIC CrCtl_vECDvtDR7UpSlp_C "Deviation in accel data for DR7 judgement at CC up slope for ECON" VALUE 0x8051B91A Val_Ws16 127.9961 Vel_CrCtl 0.00 127.9961 FORMAT "%8.4" EXTENDED_LIMITS -128.0000 127.9961 /end CHARACTERISTIC
/begin CHARACTERISTIC CrCtl_vEcoACCRPntHysLoNTG_GCUR "Curve for ACC RP hysteresis Lo(Not Top Gear) for Eco mode" CURVE 0x8051B91C CurG_Ws16 127.9961 Vel_CrCtl 0.00 127.9961 FORMAT "%8.4" EXTENDED_LIMITS -128.0000 127.9961
 /begin AXIS_DESCR COM_AXIS CrCtl_vVehUpBytTbl_mp Vel_CrCtl1 6 0.00 255.0000 FORMAT "%8.4" EXTENDED_LIMITS -32768.00 32767.00 AXIS_PTS_REF CrCtl_vRPntDLimHys_AXIS /end AXIS_DESCR
/end CHARACTERISTIC
/begin CHARACTERISTIC CrCtl_vEcoACCRPntHysLoTG_GCUR "Curve for ACC RP hysteresis Lo(Top Gear) for Eco mode" CURVE 0x8051B928 CurG_Ws16 127.9961 Vel_CrCtl 0.00 127.9961 FORMAT "%8.4" EXTENDED_LIMITS -128.0000 127.9961
 /begin AXIS_DESCR COM_AXIS CrCtl_vVehUpBytTbl_mp Vel_CrCtl1 6 0.00 255.0000 FORMAT "%8.4" EXTENDED_LIMITS -32768.00 32767.00 AXIS_PTS_REF CrCtl_vRPntDLimHys_AXIS /end AXIS_DESCR
/end CHARACTERISTIC
/begin CHARACTERISTIC CrCtl_vEcoDLimHysHiNTG_GCUR "Curve for CCACC DL hysteresis Hi(Not Top Gear) for Eco mode" CURVE 0x8051B934 CurG_Ws16 127.9961 Vel_CrCtl 0.00 127.9961 FORMAT "%8.4" EXTENDED_LIMITS -128.0000 127.9961
 /begin AXIS_DESCR COM_AXIS CrCtl_vVehUpBytTbl_mp Vel_CrCtl1 6 0.00 255.0000 FORMAT "%8.4" EXTENDED_LIMITS -32768.00 32767.00 AXIS_PTS_REF CrCtl_vRPntDLimHys_AXIS /end AXIS_DESCR
/end CHARACTERISTIC
/begin CHARACTERISTIC CrCtl_vEcoDLimHysHiTG_GCUR "Curve for CCACC DL hysteresis Hi(Top Gear) for Eco mode" CURVE 0x8051B940 CurG_Ws16 127.9961 Vel_CrCtl 0.00 127.9961 FORMAT "%8.4" EXTENDED_LIMITS -128.0000 127.9961
 /begin AXIS_DESCR COM_AXIS CrCtl_vVehUpBytTbl_mp Vel_CrCtl1 6 0.00 255.0000 FORMAT "%8.4" EXTENDED_LIMITS -32768.00 32767.00 AXIS_PTS_REF CrCtl_vRPntDLimHys_AXIS /end AXIS_DESCR
/end CHARACTERISTIC
/begin CHARACTERISTIC CrCtl_vEcoDLimHysLoNTG_GCUR "Curve for CCACC DL hysteresis Lo(Not Top Gear) for Eco mode" CURVE 0x8051B94C CurG_Ws16 127.9961 Vel_CrCtl 0.00 127.9961 FORMAT "%8.4" EXTENDED_LIMITS -128.0000 127.9961
 /begin AXIS_DESCR COM_AXIS CrCtl_vVehUpBytTbl_mp Vel_CrCtl1 6 0.00 255.0000 FORMAT "%8.4" EXTENDED_LIMITS -32768.00 32767.00 AXIS_PTS_REF CrCtl_vRPntDLimHys_AXIS /end AXIS_DESCR
/end CHARACTERISTIC
/begin CHARACTERISTIC CrCtl_vEcoDLimHysLoTG_GCUR "Curve for CCACC DL hysteresis Lo(Top Gear) for Eco mode" CURVE 0x8051B958 CurG_Ws16 127.9961 Vel_CrCtl 0.00 127.9961 FORMAT "%8.4" EXTENDED_LIMITS -128.0000 127.9961
 /begin AXIS_DESCR COM_AXIS CrCtl_vVehUpBytTbl_mp Vel_CrCtl1 6 0.00 255.0000 FORMAT "%8.4" EXTENDED_LIMITS -32768.00 32767.00 AXIS_PTS_REF CrCtl_vRPntDLimHys_AXIS /end AXIS_DESCR
/end CHARACTERISTIC
/begin CHARACTERISTIC CrCtl_vECOffDesInc1_MAP "Added value2 in each 100ms to desired vehicle speed for ECON (ECON sw OFF)" MAP 0x8051B964 Map_Xs16Ys16Ws16 127.9961 Vel_CrCtl 0.00 127.9961 FORMAT "%8.4" EXTENDED_LIMITS -128.0000 127.9961
 /begin AXIS_DESCR STD_AXIS CrCtl_vVehUpByte Vel_CrCtl1 12 0.00 255.0000 FORMAT "%8.4" EXTENDED_LIMITS -32768.00 32767.00 DEPOSIT ABSOLUTE /end AXIS_DESCR
 /begin AXIS_DESCR STD_AXIS CrCtl_rEstSlpFltVal Prc_CrCtl4 9 -128.0000 127.9961 FORMAT "%8.4" DEPOSIT ABSOLUTE /end AXIS_DESCR
/end CHARACTERISTIC
/begin CHARACTERISTIC CrCtl_vECOffDesInc2_CUR "Added value1 in each 100ms to desired vehicle speed for ECON (ECON sw ON)" CURVE 0x8051BA6A RB_Cur_Xs16Ws16 127.9961 Vel_CrCtl 0.00 127.9961 FORMAT "%8.4" EXTENDED_LIMITS -128.0000 127.9961
 /begin AXIS_DESCR STD_AXIS CrCtl_vSpdDvt_mp Vel_CrCtl 9 -128.0000 127.9961 FORMAT "%8.4" DEPOSIT ABSOLUTE /end AXIS_DESCR
/end CHARACTERISTIC
/begin CHARACTERISTIC CrCtl_vECOffDvtDwn1_C "Accel differential coeffecient for DR3 judgement at ACC_F/B" VALUE 0x8051BA90 Val_Ws16 127.9961 Vel_CrCtl 0.00 127.9961 FORMAT "%8.4" EXTENDED_LIMITS -128.0000 127.9961 /end CHARACTERISTIC
/begin CHARACTERISTIC CrCtl_vECOffDvtDwn2_C "Accel differential coeffecient for DR3 judgement at ACC_F/B for ECON" VALUE 0x8051BA92 Val_Ws16 127.9961 Vel_CrCtl 0.00 127.9961 FORMAT "%8.4" EXTENDED_LIMITS -128.0000 127.9961 /end CHARACTERISTIC
/begin CHARACTERISTIC CrCtl_vECOffDvtDwn3_C "Accel differential coeffecient for DR3 judgement at CC_ACCEL for ECON" VALUE 0x8051BA94 Val_Ws16 127.9961 Vel_CrCtl 0.00 127.9961 FORMAT "%8.4" EXTENDED_LIMITS -128.0000 127.9961 /end CHARACTERISTIC
/begin CHARACTERISTIC CrCtl_vECOffDvtDwn4_C "Data on speed deviation for DR1 judgement at CC down slp for ECON" VALUE 0x8051BA96 Val_Ws16 127.9961 Vel_CrCtl 0.00 127.9961 FORMAT "%8.4" EXTENDED_LIMITS -128.0000 127.9961 /end CHARACTERISTIC
/begin CHARACTERISTIC CrCtl_vECOffDvtUp2_C "Accel differential coeffecient for DR1 judgement at ACC_F/B" VALUE 0x8051BA98 Val_Ws16 127.9961 Vel_CrCtl 0.00 127.9961 FORMAT "%8.4" EXTENDED_LIMITS -128.0000 127.9961 /end CHARACTERISTIC
/begin CHARACTERISTIC CrCtl_vECOffDvtUp3_C "Accel differential coeffecient for DR1 judgement at ACC_F/B for ECON" VALUE 0x8051BA9A Val_Ws16 127.9961 Vel_CrCtl 0.00 127.9961 FORMAT "%8.4" EXTENDED_LIMITS -128.0000 127.9961 /end CHARACTERISTIC
/begin CHARACTERISTIC CrCtl_vECOffDvtUp4_C "Accel differential coeffecient for DR1 judgement at CC_ACCEL for ECON" VALUE 0x8051BA9C Val_Ws16 127.9961 Vel_CrCtl 0.00 127.9961 FORMAT "%8.4" EXTENDED_LIMITS -128.0000 127.9961 /end CHARACTERISTIC
/begin CHARACTERISTIC CrCtl_vECOffDvtUp5_C "During ACC follow-up control,deviation in accel data for DR2 judgement for ECON" VALUE 0x8051BA9E Val_Ws16 127.9961 Vel_CrCtl 0.00 127.9961 FORMAT "%8.4" EXTENDED_LIMITS -128.0000 127.9961 /end CHARACTERISTIC
/begin CHARACTERISTIC CrCtl_vECOnDesInc1_MAP "Added value2 in each 100ms to desired vehicle speed for ECON (ECON sw ON)" MAP 0x8051BAA0 Map_Xs16Ys16Ws16 127.9961 Vel_CrCtl 0.00 127.9961 FORMAT "%8.4" EXTENDED_LIMITS -128.0000 127.9961
 /begin AXIS_DESCR STD_AXIS CrCtl_vVehUpByte Vel_CrCtl1 12 0.00 255.0000 FORMAT "%8.4" EXTENDED_LIMITS -32768.00 32767.00 DEPOSIT ABSOLUTE /end AXIS_DESCR
 /begin AXIS_DESCR STD_AXIS CrCtl_rEstSlpFltVal Prc_CrCtl4 9 -128.0000 127.9961 FORMAT "%8.4" DEPOSIT ABSOLUTE /end AXIS_DESCR
/end CHARACTERISTIC
/begin CHARACTERISTIC CrCtl_vECOnDesInc2_CUR "Added value1 in each 100ms to desired vehicle speed for ECON (ECON sw OFF, Continuous TAPUP)" CURVE 0x8051BBA6 RB_Cur_Xs16Ws16 127.9961 Vel_CrCtl 0.00 127.9961 FORMAT "%8.4" EXTENDED_LIMITS -128.0000 127.9961
 /begin AXIS_DESCR STD_AXIS CrCtl_vSpdDvt_mp Vel_CrCtl 9 -128.0000 127.9961 FORMAT "%8.4" DEPOSIT ABSOLUTE /end AXIS_DESCR
/end CHARACTERISTIC
/begin CHARACTERISTIC CrCtl_vECOnDvtDwn1_C "Data on speed deviation for DR2 judgement at CC down slp for ECON" VALUE 0x8051BBCC Val_Ws16 127.9961 Vel_CrCtl 0.00 127.9961 FORMAT "%8.4" EXTENDED_LIMITS -128.0000 127.9961 /end CHARACTERISTIC
/begin CHARACTERISTIC CrCtl_vECOnDvtDwn2_C "Data on speed deviation for DR3 judgement at CC down slp for ECON" VALUE 0x8051BBCE Val_Ws16 127.9961 Vel_CrCtl 0.00 127.9961 FORMAT "%8.4" EXTENDED_LIMITS -128.0000 127.9961 /end CHARACTERISTIC
/begin CHARACTERISTIC CrCtl_vECOnDvtDwn3_C "Output select flag for DR1 judgement at CC down slp for ECON" VALUE 0x8051BBD0 Val_Ws16 127.9961 Vel_CrCtl 0.00 127.9961 FORMAT "%8.4" EXTENDED_LIMITS -128.0000 127.9961 /end CHARACTERISTIC
/begin CHARACTERISTIC CrCtl_vECOnDvtDwn4_C "Output select flag for DR2 judgement at CC down slp for ECON" VALUE 0x8051BBD2 Val_Ws16 127.9961 Vel_CrCtl 0.00 127.9961 FORMAT "%8.4" EXTENDED_LIMITS -128.0000 127.9961 /end CHARACTERISTIC
/begin CHARACTERISTIC CrCtl_vECOnDvtUp2_C "Deviation in accel data for DR2 judgement at CC up slope for ECON" VALUE 0x8051BBD4 Val_Ws16 127.9961 Vel_CrCtl 0.00 127.9961 FORMAT "%8.4" EXTENDED_LIMITS -128.0000 127.9961 /end CHARACTERISTIC
/begin CHARACTERISTIC CrCtl_vECOnDvtUp3_C "Accel differential coeffecient data for DR2 judgement at CC_RESUME for ECON" VALUE 0x8051BBD6 Val_Ws16 127.9961 Vel_CrCtl 0.00 127.9961 FORMAT "%8.4" EXTENDED_LIMITS -128.0000 127.9961 /end CHARACTERISTIC
/begin CHARACTERISTIC CrCtl_vECOnDvtUp4_C "Accel differential coeffecient data for DR2 judgement at ACC_RESUME" VALUE 0x8051BBD8 Val_Ws16 127.9961 Vel_CrCtl 0.00 127.9961 FORMAT "%8.4" EXTENDED_LIMITS -128.0000 127.9961 /end CHARACTERISTIC
/begin CHARACTERISTIC CrCtl_vECOnDvtUp5_C "Accel differential coeffecient data for DR2 judgement at ACC_RESUME for ECON" VALUE 0x8051BBDA Val_Ws16 127.9961 Vel_CrCtl 0.00 127.9961 FORMAT "%8.4" EXTENDED_LIMITS -128.0000 127.9961 /end CHARACTERISTIC
/begin CHARACTERISTIC CrCtl_vEcoRPntHysHiNTG_GCUR "Curve for CC RP hysteresis Hi(Not Top Gear) for Eco mode" CURVE 0x8051BBDC CurG_Ws16 127.9961 Vel_CrCtl 0.00 127.9961 FORMAT "%8.4" EXTENDED_LIMITS -128.0000 127.9961
 /begin AXIS_DESCR COM_AXIS CrCtl_vVehUpBytTbl_mp Vel_CrCtl1 6 0.00 255.0000 FORMAT "%8.4" EXTENDED_LIMITS -32768.00 32767.00 AXIS_PTS_REF CrCtl_vRPntDLimHys_AXIS /end AXIS_DESCR
/end CHARACTERISTIC
/begin CHARACTERISTIC CrCtl_vEcoRPntHysHiTG_GCUR "Curve for CC RP hysteresis Hi(Top Gear) for Eco mode" CURVE 0x8051BBE8 CurG_Ws16 127.9961 Vel_CrCtl 0.00 127.9961 FORMAT "%8.4" EXTENDED_LIMITS -128.0000 127.9961
 /begin AXIS_DESCR COM_AXIS CrCtl_vVehUpBytTbl_mp Vel_CrCtl1 6 0.00 255.0000 FORMAT "%8.4" EXTENDED_LIMITS -32768.00 32767.00 AXIS_PTS_REF CrCtl_vRPntDLimHys_AXIS /end AXIS_DESCR
/end CHARACTERISTIC
/begin CHARACTERISTIC CrCtl_vEcoRPntHysLoNTG_GCUR "Curve for CC RP hysteresis Lo(Not Top Gear) for Eco mode" CURVE 0x8051BBF4 CurG_Ws16 127.9961 Vel_CrCtl 0.00 127.9961 FORMAT "%8.4" EXTENDED_LIMITS -128.0000 127.9961
 /begin AXIS_DESCR COM_AXIS CrCtl_vVehUpBytTbl_mp Vel_CrCtl1 6 0.00 255.0000 FORMAT "%8.4" EXTENDED_LIMITS -32768.00 32767.00 AXIS_PTS_REF CrCtl_vRPntDLimHys_AXIS /end AXIS_DESCR
/end CHARACTERISTIC
/begin CHARACTERISTIC CrCtl_vEcoRPntHysLoTG_GCUR "Curve for CC RP hysteresis Lo(Top Gear) for Eco mode" CURVE 0x8051BC00 CurG_Ws16 127.9961 Vel_CrCtl 0.00 127.9961 FORMAT "%8.4" EXTENDED_LIMITS -128.0000 127.9961
 /begin AXIS_DESCR COM_AXIS CrCtl_vVehUpBytTbl_mp Vel_CrCtl1 6 0.00 255.0000 FORMAT "%8.4" EXTENDED_LIMITS -32768.00 32767.00 AXIS_PTS_REF CrCtl_vRPntDLimHys_AXIS /end AXIS_DESCR
/end CHARACTERISTIC
/begin CHARACTERISTIC CrCtl_vECTarAStdKmh_GCUR "Curve for target acceleration standerd value for ECON (km/h spec)" CURVE 0x8051BC0C CurG_Ws16 255.9961 Vel_CrCtl -128.0000 127.9961 FORMAT "%8.4"
 /begin AXIS_DESCR COM_AXIS CrCtl_vVehUpByte Vel_CrCtl1 6 0.00 255.0000 FORMAT "%8.4" EXTENDED_LIMITS -32768.00 32767.00 AXIS_PTS_REF CrCtl_vAccnBas_AXIS /end AXIS_DESCR
/end CHARACTERISTIC
/begin CHARACTERISTIC CrCtl_vECTarAStd_GCUR "Curve for target acceleration standerd value for ECON (during accel)" CURVE 0x8051BC18 CurG_Ws16 255.9961 Vel_CrCtl -128.0000 127.9961 FORMAT "%8.4"
 /begin AXIS_DESCR COM_AXIS CrCtl_vVehUpByte Vel_CrCtl1 6 0.00 255.0000 FORMAT "%8.4" EXTENDED_LIMITS -32768.00 32767.00 AXIS_PTS_REF CrCtl_vAccnBas_AXIS /end AXIS_DESCR
/end CHARACTERISTIC
/begin AXIS_PTS CrCtl_vFdbkArea_AX "Axis Points for Feedback Area speed of cruise control" 0x8051BC24 CrCtl_vDesUpByte_mp Axis_Xs16 255.0000 Vel_CrCtl1 12 0.00 255.0000 FORMAT "%8.4" EXTENDED_LIMITS -32768.00 32767.00 DEPOSIT ABSOLUTE /end AXIS_PTS
/begin AXIS_PTS CrCtl_vFdbkArea_AXIS "Axis Points for Feedback Area speed of cruise control" 0x8051BC3E CrCtl_vDesUpByte_mp Axis_Xs16 255.0000 Vel_CrCtl1 6 0.00 255.0000 FORMAT "%8.4" EXTENDED_LIMITS -32768.00 32767.00 DEPOSIT ABSOLUTE /end AXIS_PTS
/begin CHARACTERISTIC CrCtl_vGearDwn1UpLim_C "Gear Down 1 Upper Limit Speed value" VALUE 0x8051BC4C Val_Ws32 8388607.99609 Vel_CrCtl 0.00 8388607.99609 FORMAT "%13.5" EXTENDED_LIMITS -8388608.00000 8388607.99609 /end CHARACTERISTIC
/begin CHARACTERISTIC CrCtl_vGearDwn1UpReqClr_C "Gear Down 1 Up request clear Speed value" VALUE 0x8051BC50 Val_Ws32 8388607.99609 Vel_CrCtl 0.00 8388607.99609 FORMAT "%13.5" EXTENDED_LIMITS -8388608.00000 8388607.99609 /end CHARACTERISTIC
/begin CHARACTERISTIC CrCtl_vGearDwn1UpReq_C "Gear Down 1 Up request Speed value" VALUE 0x8051BC54 Val_Ws32 8388607.99609 Vel_CrCtl 0.00 8388607.99609 FORMAT "%13.5" EXTENDED_LIMITS -8388608.00000 8388607.99609 /end CHARACTERISTIC
/begin CHARACTERISTIC CrCtl_vGearDwn2UpLim_C "Gear Down 2 Upper Limit Speed value" VALUE 0x8051BC58 Val_Ws32 8388607.99609 Vel_CrCtl 0.00 8388607.99609 FORMAT "%13.5" EXTENDED_LIMITS -8388608.00000 8388607.99609 /end CHARACTERISTIC
/begin CHARACTERISTIC CrCtl_vGearDwn2UpReqClr_C "Gear Down 2 Up request clear Speed value" VALUE 0x8051BC5C Val_Ws32 8388607.99609 Vel_CrCtl 0.00 8388607.99609 FORMAT "%13.5" EXTENDED_LIMITS -8388608.00000 8388607.99609 /end CHARACTERISTIC
/begin CHARACTERISTIC CrCtl_vGearDwn2UpReq_C "Gear Down 2 Up request Speed value" VALUE 0x8051BC60 Val_Ws32 8388607.99609 Vel_CrCtl 0.00 8388607.99609 FORMAT "%13.5" EXTENDED_LIMITS -8388608.00000 8388607.99609 /end CHARACTERISTIC
/begin CHARACTERISTIC CrCtl_vGearDwn3UpLim_C "Gear Down 3 Upper Limit Speed value" VALUE 0x8051BC64 Val_Ws32 8388607.99609 Vel_CrCtl 0.00 8388607.99609 FORMAT "%13.5" EXTENDED_LIMITS -8388608.00000 8388607.99609 /end CHARACTERISTIC
/begin CHARACTERISTIC CrCtl_vGearDwn3UpReqClr_C "Gear Down 3 Up request clear Speed value" VALUE 0x8051BC68 Val_Ws32 8388607.99609 Vel_CrCtl 0.00 8388607.99609 FORMAT "%13.5" EXTENDED_LIMITS -8388608.00000 8388607.99609 /end CHARACTERISTIC
/begin CHARACTERISTIC CrCtl_vGearDwn3UpReq_C "Gear Down 3 Up request Speed value" VALUE 0x8051BC6C Val_Ws32 8388607.99609 Vel_CrCtl 0.00 8388607.99609 FORMAT "%13.5" EXTENDED_LIMITS -8388608.00000 8388607.99609 /end CHARACTERISTIC
/begin CHARACTERISTIC CrCtl_vGearDwn4UpLim_C "Gear Down 4 Upper Limit Speed value" VALUE 0x8051BC70 Val_Ws32 8388607.99609 Vel_CrCtl 0.00 8388607.99609 FORMAT "%13.5" EXTENDED_LIMITS -8388608.00000 8388607.99609 /end CHARACTERISTIC
/begin CHARACTERISTIC CrCtl_vGearDwn4UpReqClr_C "Gear Down 4 Up request clear Speed value" VALUE 0x8051BC74 Val_Ws32 8388607.99609 Vel_CrCtl 0.00 8388607.99609 FORMAT "%13.5" EXTENDED_LIMITS -8388608.00000 8388607.99609 /end CHARACTERISTIC
/begin CHARACTERISTIC CrCtl_vGearDwn4UpReq_C "Gear Down 4 Up request Speed value" VALUE 0x8051BC78 Val_Ws32 8388607.99609 Vel_CrCtl 0.00 8388607.99609 FORMAT "%13.5" EXTENDED_LIMITS -8388608.00000 8388607.99609 /end CHARACTERISTIC
/begin CHARACTERISTIC CrCtl_vInitOffSpdVar_C "initial off vehicle speed variant value" VALUE 0x8051BC7C Val_Ws32 127.996093750 Vel_CrCtl 0.00 127.996093750 FORMAT "%13.9" EXTENDED_LIMITS -8388608.00000 8388607.99609 /end CHARACTERISTIC
/begin AXIS_PTS CrCtl_vLSFStrtAPP_AXIS "Axis for LSF start demand value" 0x8051BC80 CrCtl_vVehUpByte Axis_Xs16 65535.00 Vel_CrCtl1 12 -32768.00 32767.00 FORMAT "%8.2" DEPOSIT ABSOLUTE /end AXIS_PTS
/begin CHARACTERISTIC CrCtl_vLSFStrt_C "Calibration parameter for minimum velocity for LSF" VALUE 0x8051BC9C Val_Ws32 16777215.9961 Vel_CrCtl -8388608.00000 8388607.99609 FORMAT "%13.5" /end CHARACTERISTIC
/begin CHARACTERISTIC CrCtl_vResOffEndDvtCor_C "Corrected deviation speed to check the end of resume off control" VALUE 0x8051BCA0 Val_Ws16 255.9961 Vel_CrCtl -128.0000 127.9961 FORMAT "%8.4" /end CHARACTERISTIC
/begin AXIS_PTS CrCtl_vRPntDLimHys_AXIS "Axis Points for Resume point (HILO) Decel limit (HILO) speed hysteresis of cruise control" 0x8051BCA2 CrCtl_vVehUpBytTbl_mp Axis_Xs16 255.0000 Vel_CrCtl1 6 0.00 255.0000 FORMAT "%8.4" EXTENDED_LIMITS -32768.00 32767.00 DEPOSIT ABSOLUTE /end AXIS_PTS
/begin CHARACTERISTIC CrCtl_vRPntHysHiNTGKmh_GCUR "Curve for CC/ACC RP hysteresis Hi(Not Top Gear)(Km/h spec)" CURVE 0x8051BCB0 CurG_Ws16 127.9961 Vel_CrCtl 0.00 127.9961 FORMAT "%8.4" EXTENDED_LIMITS -128.0000 127.9961
 /begin AXIS_DESCR COM_AXIS CrCtl_vVehUpBytTbl_mp Vel_CrCtl1 6 0.00 255.0000 FORMAT "%8.4" EXTENDED_LIMITS -32768.00 32767.00 AXIS_PTS_REF CrCtl_vRPntDLimHys_AXIS /end AXIS_DESCR
/end CHARACTERISTIC
/begin CHARACTERISTIC CrCtl_vRPntHysHiNTG_GCUR "Curve for CC/ACC RP hysteresis Hi(Not Top Gear)" CURVE 0x8051BCBC CurG_Ws16 127.9961 Vel_CrCtl 0.00 127.9961 FORMAT "%8.4" EXTENDED_LIMITS -128.0000 127.9961
 /begin AXIS_DESCR COM_AXIS CrCtl_vVehUpBytTbl_mp Vel_CrCtl1 6 0.00 255.0000 FORMAT "%8.4" EXTENDED_LIMITS -32768.00 32767.00 AXIS_PTS_REF CrCtl_vRPntDLimHys_AXIS /end AXIS_DESCR
/end CHARACTERISTIC
/begin CHARACTERISTIC CrCtl_vRPntHysHiTGKmh_GCUR "Curve for CC/ACC RP hysteresis Hi(Top Gear)(Km/h spec)" CURVE 0x8051BCC8 CurG_Ws16 127.9961 Vel_CrCtl 0.00 127.9961 FORMAT "%8.4" EXTENDED_LIMITS -128.0000 127.9961
 /begin AXIS_DESCR COM_AXIS CrCtl_vVehUpBytTbl_mp Vel_CrCtl1 6 0.00 255.0000 FORMAT "%8.4" EXTENDED_LIMITS -32768.00 32767.00 AXIS_PTS_REF CrCtl_vRPntDLimHys_AXIS /end AXIS_DESCR
/end CHARACTERISTIC
/begin CHARACTERISTIC CrCtl_vRPntHysHiTG_GCUR "Curve for CC/ACC RP hysteresis Hi(Top Gear)" CURVE 0x8051BCD4 CurG_Ws16 127.9961 Vel_CrCtl 0.00 127.9961 FORMAT "%8.4" EXTENDED_LIMITS -128.0000 127.9961
 /begin AXIS_DESCR COM_AXIS CrCtl_vVehUpBytTbl_mp Vel_CrCtl1 6 0.00 255.0000 FORMAT "%8.4" EXTENDED_LIMITS -32768.00 32767.00 AXIS_PTS_REF CrCtl_vRPntDLimHys_AXIS /end AXIS_DESCR
/end CHARACTERISTIC
/begin CHARACTERISTIC CrCtl_vRPntHysLoNTGKmh_GCUR "Curve for CC RP hysteresis Lo(Not Top Gear)(Km/h spec)" CURVE 0x8051BCE0 CurG_Ws16 127.9961 Vel_CrCtl 0.00 127.9961 FORMAT "%8.4" EXTENDED_LIMITS -128.0000 127.9961
 /begin AXIS_DESCR COM_AXIS CrCtl_vVehUpBytTbl_mp Vel_CrCtl1 6 0.00 255.0000 FORMAT "%8.4" EXTENDED_LIMITS -32768.00 32767.00 AXIS_PTS_REF CrCtl_vRPntDLimHys_AXIS /end AXIS_DESCR
/end CHARACTERISTIC
/begin CHARACTERISTIC CrCtl_vRPntHysLoNTG_GCUR "Curve for CC RP hysteresis Lo(Not Top Gear)" CURVE 0x8051BCEC CurG_Ws16 127.9961 Vel_CrCtl 0.00 127.9961 FORMAT "%8.4" EXTENDED_LIMITS -128.0000 127.9961
 /begin AXIS_DESCR COM_AXIS CrCtl_vVehUpBytTbl_mp Vel_CrCtl1 6 0.00 255.0000 FORMAT "%8.4" EXTENDED_LIMITS -32768.00 32767.00 AXIS_PTS_REF CrCtl_vRPntDLimHys_AXIS /end AXIS_DESCR
/end CHARACTERISTIC
/begin CHARACTERISTIC CrCtl_vRPntHysLoTGKmh_GCUR "Curve for CC RP hysteresis Lo(Top Gear)(Km/h spec)" CURVE 0x8051BCF8 CurG_Ws16 127.9961 Vel_CrCtl 0.00 127.9961 FORMAT "%8.4" EXTENDED_LIMITS -128.0000 127.9961
 /begin AXIS_DESCR COM_AXIS CrCtl_vVehUpBytTbl_mp Vel_CrCtl1 6 0.00 255.0000 FORMAT "%8.4" EXTENDED_LIMITS -32768.00 32767.00 AXIS_PTS_REF CrCtl_vRPntDLimHys_AXIS /end AXIS_DESCR
/end CHARACTERISTIC
/begin CHARACTERISTIC CrCtl_vRPntHysLoTG_GCUR "Curve for CC RP hysteresis Lo(Top Gear)" CURVE 0x8051BD04 CurG_Ws16 127.9961 Vel_CrCtl 0.00 127.9961 FORMAT "%8.4" EXTENDED_LIMITS -128.0000 127.9961
 /begin AXIS_DESCR COM_AXIS CrCtl_vVehUpBytTbl_mp Vel_CrCtl1 6 0.00 255.0000 FORMAT "%8.4" EXTENDED_LIMITS -32768.00 32767.00 AXIS_PTS_REF CrCtl_vRPntDLimHys_AXIS /end AXIS_DESCR
/end CHARACTERISTIC
/begin CHARACTERISTIC CrCtl_vSpdVarDR1CnclDwnSlp_C "Speed variation for judging DR1 cancellation at CC down slope" VALUE 0x8051BD10 Val_Ws16 255.9961 Vel_CrCtl -128.0000 127.9961 FORMAT "%8.4" /end CHARACTERISTIC
/begin CHARACTERISTIC CrCtl_vSpdVarDR2CnclDwnSlp_C "Speed variation for judging DR2 cancellation at CC down slope" VALUE 0x8051BD12 Val_Ws16 255.9961 Vel_CrCtl -128.0000 127.9961 FORMAT "%8.4" /end CHARACTERISTIC
/begin CHARACTERISTIC CrCtl_vSpdVarDR3CnclDwnSlp_C "Speed variation for judging DR3 cancellation at CC down slope" VALUE 0x8051BD14 Val_Ws16 255.9961 Vel_CrCtl -128.0000 127.9961 FORMAT "%8.4" /end CHARACTERISTIC
/begin CHARACTERISTIC CrCtl_vSpdVarDR4CnclDwnSlp_C "Speed variation for judging DR4 cancellation at CC down slope" VALUE 0x8051BD16 Val_Ws16 255.9961 Vel_CrCtl -128.0000 127.9961 FORMAT "%8.4" /end CHARACTERISTIC
/begin CHARACTERISTIC CrCtl_vSpdVarDR5CnclDwnSlp_C "Speed variation for judging DR5 cancellation at CC down slope" VALUE 0x8051BD18 Val_Ws16 255.9961 Vel_CrCtl -128.0000 127.9961 FORMAT "%8.4" /end CHARACTERISTIC
/begin CHARACTERISTIC CrCtl_vSpdVarDR6CnclDwnSlp_C "Speed variation for judging DR6 cancellation at CC down slope" VALUE 0x8051BD1A Val_Ws16 255.9961 Vel_CrCtl -128.0000 127.9961 FORMAT "%8.4" /end CHARACTERISTIC
/begin CHARACTERISTIC CrCtl_vSpdVarDR7CnclDwnSlp_C "Speed variation for judging DR7 cancellation at CC down slope" VALUE 0x8051BD1C Val_Ws16 255.9961 Vel_CrCtl -128.0000 127.9961 FORMAT "%8.4" /end CHARACTERISTIC
/begin CHARACTERISTIC CrCtl_vSptACCRPntHysLoNTG_GCUR "Curve for ACC RP hysteresis Lo(Not Top Gear) for sport mode" CURVE 0x8051BD1E CurG_Ws16 127.9961 Vel_CrCtl 0.00 127.9961 FORMAT "%8.4" EXTENDED_LIMITS -128.0000 127.9961
 /begin AXIS_DESCR COM_AXIS CrCtl_vVehUpBytTbl_mp Vel_CrCtl1 6 0.00 255.0000 FORMAT "%8.4" EXTENDED_LIMITS -32768.00 32767.00 AXIS_PTS_REF CrCtl_vRPntDLimHys_AXIS /end AXIS_DESCR
/end CHARACTERISTIC
/begin CHARACTERISTIC CrCtl_vSptACCRPntHysLoTG_GCUR "Curve for ACC RP hysteresis Lo(Top Gear) for sport mode" CURVE 0x8051BD2A CurG_Ws16 127.9961 Vel_CrCtl 0.00 127.9961 FORMAT "%8.4" EXTENDED_LIMITS -128.0000 127.9961
 /begin AXIS_DESCR COM_AXIS CrCtl_vVehUpBytTbl_mp Vel_CrCtl1 6 0.00 255.0000 FORMAT "%8.4" EXTENDED_LIMITS -32768.00 32767.00 AXIS_PTS_REF CrCtl_vRPntDLimHys_AXIS /end AXIS_DESCR
/end CHARACTERISTIC
/begin CHARACTERISTIC CrCtl_vSptDLimHysHiNTG_GCUR "Curve for CCACC DL hysteresis Hi(Not Top Gear) for sport mode" CURVE 0x8051BD36 CurG_Ws16 127.9961 Vel_CrCtl 0.00 127.9961 FORMAT "%8.4" EXTENDED_LIMITS -128.0000 127.9961
 /begin AXIS_DESCR COM_AXIS CrCtl_vVehUpBytTbl_mp Vel_CrCtl1 6 0.00 255.0000 FORMAT "%8.4" EXTENDED_LIMITS -32768.00 32767.00 AXIS_PTS_REF CrCtl_vRPntDLimHys_AXIS /end AXIS_DESCR
/end CHARACTERISTIC
/begin CHARACTERISTIC CrCtl_vSptDLimHysHiTG_GCUR "Curve for CCACC DL hysteresis Hi(Top Gear) for sport mode" CURVE 0x8051BD42 CurG_Ws16 127.9961 Vel_CrCtl 0.00 127.9961 FORMAT "%8.4" EXTENDED_LIMITS -128.0000 127.9961
 /begin AXIS_DESCR COM_AXIS CrCtl_vVehUpBytTbl_mp Vel_CrCtl1 6 0.00 255.0000 FORMAT "%8.4" EXTENDED_LIMITS -32768.00 32767.00 AXIS_PTS_REF CrCtl_vRPntDLimHys_AXIS /end AXIS_DESCR
/end CHARACTERISTIC
/begin CHARACTERISTIC CrCtl_vSptDLimHysLoNTG_GCUR "Curve for CCACC DL hysteresis Lo(Not Top Gear) for sport mode" CURVE 0x8051BD4E CurG_Ws16 127.9961 Vel_CrCtl 0.00 127.9961 FORMAT "%8.4" EXTENDED_LIMITS -128.0000 127.9961
 /begin AXIS_DESCR COM_AXIS CrCtl_vVehUpBytTbl_mp Vel_CrCtl1 6 0.00 255.0000 FORMAT "%8.4" EXTENDED_LIMITS -32768.00 32767.00 AXIS_PTS_REF CrCtl_vRPntDLimHys_AXIS /end AXIS_DESCR
/end CHARACTERISTIC
/begin CHARACTERISTIC CrCtl_vSptDLimHysLoTG_GCUR "Curve for CCACC DL hysteresis Lo(Top Gear) for sport mode" CURVE 0x8051BD5A CurG_Ws16 127.9961 Vel_CrCtl 0.00 127.9961 FORMAT "%8.4" EXTENDED_LIMITS -128.0000 127.9961
 /begin AXIS_DESCR COM_AXIS CrCtl_vVehUpBytTbl_mp Vel_CrCtl1 6 0.00 255.0000 FORMAT "%8.4" EXTENDED_LIMITS -32768.00 32767.00 AXIS_PTS_REF CrCtl_vRPntDLimHys_AXIS /end AXIS_DESCR
/end CHARACTERISTIC
/begin CHARACTERISTIC CrCtl_vSptRPntHysHiNTG_GCUR "Curve for CC RP hysteresis Hi(Not Top Gear) for sport mode" CURVE 0x8051BD66 CurG_Ws16 127.9961 Vel_CrCtl 0.00 127.9961 FORMAT "%8.4" EXTENDED_LIMITS -128.0000 127.9961
 /begin AXIS_DESCR COM_AXIS CrCtl_vVehUpBytTbl_mp Vel_CrCtl1 6 0.00 255.0000 FORMAT "%8.4" EXTENDED_LIMITS -32768.00 32767.00 AXIS_PTS_REF CrCtl_vRPntDLimHys_AXIS /end AXIS_DESCR
/end CHARACTERISTIC
/begin CHARACTERISTIC CrCtl_vSptRPntHysHiTG_GCUR "Curve for CC RP hysteresis Hi(Top Gear) for sport mode" CURVE 0x8051BD72 CurG_Ws16 127.9961 Vel_CrCtl 0.00 127.9961 FORMAT "%8.4" EXTENDED_LIMITS -128.0000 127.9961
 /begin AXIS_DESCR COM_AXIS CrCtl_vVehUpBytTbl_mp Vel_CrCtl1 6 0.00 255.0000 FORMAT "%8.4" EXTENDED_LIMITS -32768.00 32767.00 AXIS_PTS_REF CrCtl_vRPntDLimHys_AXIS /end AXIS_DESCR
/end CHARACTERISTIC
/begin CHARACTERISTIC CrCtl_vSptRPntHysLoNTG_GCUR "Curve for CC RP hysteresis Lo(Not Top Gear) for sport mode" CURVE 0x8051BD7E CurG_Ws16 127.9961 Vel_CrCtl 0.00 127.9961 FORMAT "%8.4" EXTENDED_LIMITS -128.0000 127.9961
 /begin AXIS_DESCR COM_AXIS CrCtl_vVehUpBytTbl_mp Vel_CrCtl1 6 0.00 255.0000 FORMAT "%8.4" EXTENDED_LIMITS -32768.00 32767.00 AXIS_PTS_REF CrCtl_vRPntDLimHys_AXIS /end AXIS_DESCR
/end CHARACTERISTIC
/begin CHARACTERISTIC CrCtl_vSptRPntHysLoTG_GCUR "Curve for CC RP hysteresis Lo(Top Gear) for sport mode" CURVE 0x8051BD8A CurG_Ws16 127.9961 Vel_CrCtl 0.00 127.9961 FORMAT "%8.4" EXTENDED_LIMITS -128.0000 127.9961
 /begin AXIS_DESCR COM_AXIS CrCtl_vVehUpBytTbl_mp Vel_CrCtl1 6 0.00 255.0000 FORMAT "%8.4" EXTENDED_LIMITS -32768.00 32767.00 AXIS_PTS_REF CrCtl_vRPntDLimHys_AXIS /end AXIS_DESCR
/end CHARACTERISTIC
/begin AXIS_PTS CrCtl_vTapDnInit_AXIS "Axis Points for Tap Down initial speed of cruise control" 0x8051BD96 CrCtl_vVehUpByte Axis_Xs16 255.0000 Vel_CrCtl1 6 0.00 255.0000 FORMAT "%8.4" EXTENDED_LIMITS -32768.00 32767.00 DEPOSIT ABSOLUTE /end AXIS_PTS
/begin AXIS_PTS CrCtl_vTapUpInit_AXIS "Axis Points for Tap Up initial speed of cruise control" 0x8051BDA4 CrCtl_vVehUpByte Axis_Xs16 255.0000 Vel_CrCtl1 6 0.00 255.0000 FORMAT "%8.4" EXTENDED_LIMITS -32768.00 32767.00 DEPOSIT ABSOLUTE /end AXIS_PTS
/begin CHARACTERISTIC CrCtl_vThdCtOffAllwd_C "delta velocity to reset CrCtl- fuel cutoff prohibition" VALUE 0x8051BDB2 Val_Ws16 255.9961 Vel_CrCtl -128.0000 127.9961 FORMAT "%8.4" /end CHARACTERISTIC
/begin CHARACTERISTIC CrCtl_vThdCtOffPhd_C "delta velocity to set CrCtl- fuel cutoff prohibition" VALUE 0x8051BDB4 Val_Ws16 255.9961 Vel_CrCtl -128.0000 127.9961 FORMAT "%8.4" /end CHARACTERISTIC
/begin CHARACTERISTIC CrCtl_vThresPla_C "Vehicle speed threshold for detecting the plausibility error in vehicle speed for Cruise Control" VALUE 0x8051BDB6 Val_Ws16 327.6700 Vel 0.00 327.6700 FORMAT "%8.4" EXTENDED_LIMITS -327.6800 327.6700 /end CHARACTERISTIC
/begin CHARACTERISTIC CrCtl_vTopGearUpLim_C "Top Gear Upper Limit Speed value" VALUE 0x8051BDB8 Val_Ws32 8388607.99609 Vel_CrCtl 0.00 8388607.99609 FORMAT "%13.5" EXTENDED_LIMITS -8388608.00000 8388607.99609 /end CHARACTERISTIC
/begin CHARACTERISTIC CrCtl_vTrgAccnAccAdd_C "Target acceleration Accel additional value" VALUE 0x8051BDBC Val_Ws32 127.996093750 Vel_CrCtl 0.00 127.996093750 FORMAT "%13.9" EXTENDED_LIMITS -8388608.00000 8388607.99609 /end CHARACTERISTIC
/begin CHARACTERISTIC CrCtl_vTrgAccnStandKmh_GCUR "Curve for target acceleration standerd value(km/h spec)" CURVE 0x8051BDC0 CurG_Ws16 127.9922 Vel_CrCtl 0.0039 127.9961 FORMAT "%8.4" EXTENDED_LIMITS -128.0000 127.9961
 /begin AXIS_DESCR COM_AXIS CrCtl_vVehUpByte Vel_CrCtl1 6 0.00 255.0000 FORMAT "%8.4" EXTENDED_LIMITS -32768.00 32767.00 AXIS_PTS_REF CrCtl_vAccnBas_AXIS /end AXIS_DESCR
/end CHARACTERISTIC
/begin CHARACTERISTIC CrCtl_vTrgAccnStand_GCUR "Curve for target acceleration standerd value" CURVE 0x8051BDCC CurG_Ws16 127.9922 Vel_CrCtl 0.0039 127.9961 FORMAT "%8.4" EXTENDED_LIMITS -128.0000 127.9961
 /begin AXIS_DESCR COM_AXIS CrCtl_vVehUpByte Vel_CrCtl1 6 0.00 255.0000 FORMAT "%8.4" EXTENDED_LIMITS -32768.00 32767.00 AXIS_PTS_REF CrCtl_vAccnBas_AXIS /end AXIS_DESCR
/end CHARACTERISTIC
/begin CHARACTERISTIC CrCtl_vTrgAccnStdLSF_GCUR "Curve for target acceleration standard value for LSF" CURVE 0x8051BDD8 CurG_Ws16 255.9961 Vel_CrCtl -128.0000 127.9961 FORMAT "%8.4"
 /begin AXIS_DESCR COM_AXIS CrCtl_vVehUpByte Vel_CrCtl1 12 0.00 255.0000 FORMAT "%8.4" EXTENDED_LIMITS -32768.00 32767.00 AXIS_PTS_REF CrCtl_vAccnBas_AX /end AXIS_DESCR
/end CHARACTERISTIC
/begin CHARACTERISTIC CrCtl_vTrgVehSpdDvt_C "Control deviation in target vehicle speed for judging the set CC_DR mask timer" VALUE 0x8051BDF0 Val_Ws32 16777215.9961 Vel_CrCtl -8388608.00000 8388607.99609 FORMAT "%13.5" /end CHARACTERISTIC
/begin CHARACTERISTIC CrCUI_ctACCASLSwtErr_C "Counter value for ACC/ASL switch error detection" VALUE 0x80514B84 Val_Wu16 32767.00 OneToOne 0.00 32767.00 FORMAT "%8.2" EXTENDED_LIMITS 0.00 65535.00 /end CHARACTERISTIC
/begin CHARACTERISTIC CrCUI_ctACCASLSwt_C "Counter value for ACC/ASL switch check" VALUE 0x80514B86 Val_Wu8 127.0 OneToOne 0.00 127.0 FORMAT "%5.1" EXTENDED_LIMITS 0.00 255.0 /end CHARACTERISTIC
/begin CHARACTERISTIC CrCUI_ctATFWDPosn_C "Counter value for FWD position check for AT vehicle" VALUE 0x80514B87 Val_Wu8 127.0 OneToOne 0.00 127.0 FORMAT "%5.1" EXTENDED_LIMITS 0.00 255.0 /end CHARACTERISTIC
/begin CHARACTERISTIC CrCUI_ctCancelSwtDeb_C "counter value for CANCEL SW" VALUE 0x80514B88 Val_Wu8 127.0 OneToOne 0.00 127.0 FORMAT "%5.1" EXTENDED_LIMITS 0.00 255.0 /end CHARACTERISTIC
/begin CHARACTERISTIC CrCUI_ctCANRxErr1_C "Counter value for CAN Rx Main Switch Error" VALUE 0x80514B89 Val_Wu8 127.0 OneToOne 0.00 127.0 FORMAT "%5.1" EXTENDED_LIMITS 0.00 255.0 /end CHARACTERISTIC
/begin CHARACTERISTIC CrCUI_ctCANRxErr_C "counter value for CAN Rx Error" VALUE 0x80514B8A Val_Wu8 127.0 OneToOne 0.00 127.0 FORMAT "%5.1" EXTENDED_LIMITS 0.00 255.0 /end CHARACTERISTIC
/begin CHARACTERISTIC CrCUI_ctCrsSwtErr_C "Counter value for Cruise control switch error detection" VALUE 0x80514B8C Val_Wu16 32767.00 OneToOne 0.00 32767.00 FORMAT "%8.2" EXTENDED_LIMITS 0.00 65535.00 /end CHARACTERISTIC
/begin CHARACTERISTIC CrCUI_ctEAT2RxErr_C "Counter value for EAT2 frame Rx Error" VALUE 0x80514B8E Val_Wu8 127.0 OneToOne 0.00 127.0 FORMAT "%5.1" EXTENDED_LIMITS 0.00 255.0 /end CHARACTERISTIC
/begin CHARACTERISTIC CrCUI_ctMaiSwtDeb_C "counter value for the Cruise Control Main SW" VALUE 0x80514B8F Val_Wu8 127.0 OneToOne 0.00 127.0 FORMAT "%5.1" EXTENDED_LIMITS 0.00 255.0 /end CHARACTERISTIC
/begin CHARACTERISTIC CrCUI_ctSwtDeb_C "counter value for the Cruise Control SW" VALUE 0x80514B90 Val_Wu8 127.0 OneToOne 0.00 127.0 FORMAT "%5.1" EXTENDED_LIMITS 0.00 255.0 /end CHARACTERISTIC
/begin CHARACTERISTIC CrCUI_facNeFlt_C "factor of Filtered Ne value for Cruise Control" VALUE 0x80514B92 Val_Ws16 255.9961 Fact_CrCtl -128.0000 127.9961 FORMAT "%8.4" /end CHARACTERISTIC
/begin CHARACTERISTIC CrCUI_flgTypTSRLimSpd_C "Type of TSR limit speed information" VALUE 0x80514B94 Val_Wu8 1.000 OneToOne 0.00 1.000 FORMAT "%5.3" EXTENDED_LIMITS 0.00 255.0 /end CHARACTERISTIC
/begin CHARACTERISTIC CrCUI_nACCBrkCnclLoLim_GCUR "Curve for ACC auto brake cancel Low limit Ne value" CURVE 0x80514B96 CurG_Ws16 65535.00 EngNCrCtl -32768.00 32767.00 FORMAT "%8.2"
 /begin AXIS_DESCR COM_AXIS CrCUI_nLIDes EngNCrCtl 6 0.00 32767.00 FORMAT "%8.2" EXTENDED_LIMITS -32768.00 32767.00 AXIS_PTS_REF CrCUI_nChkVal_AXIS /end AXIS_DESCR
/end CHARACTERISTIC
/begin AXIS_PTS CrCUI_nChkVal_AXIS "Axis Points for Ne Check Value of cruise control" 0x80514BA2 CrCUI_nLIDes Axis_Xs16 32767.00 EngNCrCtl 6 0.00 32767.00 FORMAT "%8.2" EXTENDED_LIMITS -32768.00 32767.00 DEPOSIT ABSOLUTE /end AXIS_PTS
/begin CHARACTERISTIC CrCUI_nCnclLoLim_GCUR "Curve for Cruise Control cancel Low limit Ne value" CURVE 0x80514BB0 CurG_Ws16 32767.00 EngNCrCtl 0.00 32767.00 FORMAT "%8.2" EXTENDED_LIMITS -32768.00 32767.00
 /begin AXIS_DESCR COM_AXIS CrCUI_nLIDes EngNCrCtl 6 0.00 32767.00 FORMAT "%8.2" EXTENDED_LIMITS -32768.00 32767.00 AXIS_PTS_REF CrCUI_nChkVal_AXIS /end AXIS_DESCR
/end CHARACTERISTIC
/begin CHARACTERISTIC CrCUI_nCnclUpoLim_C "Cruise Control cancel Upper limit Ne value" VALUE 0x80514BBC Val_Ws16 32767.00 EngNCrCtl 0.00 32767.00 FORMAT "%8.2" EXTENDED_LIMITS -32768.00 32767.00 /end CHARACTERISTIC
/begin CHARACTERISTIC CrCUI_nShftDnReq_GCUR "Curve for Shift down request Ne Check value" CURVE 0x80514BBE CurG_Ws16 32767.00 EngNCrCtl 0.00 32767.00 FORMAT "%8.2" EXTENDED_LIMITS -32768.00 32767.00
 /begin AXIS_DESCR COM_AXIS CrCUI_nLIDes EngNCrCtl 6 0.00 32767.00 FORMAT "%8.2" EXTENDED_LIMITS -32768.00 32767.00 AXIS_PTS_REF CrCUI_nChkVal_AXIS /end AXIS_DESCR
/end CHARACTERISTIC
/begin CHARACTERISTIC CrCUI_numCrsASLForceSel_C "Cruise control/ASL force select of number" VALUE 0x80514BCA Val_Wu8 127.0 OneToOne 0.00 127.0 FORMAT "%5.1" EXTENDED_LIMITS 0.00 255.0 /end CHARACTERISTIC
/begin CHARACTERISTIC CrCUI_numGearTrgt_CA "Target gear number for cheking gear information" VAL_BLK 0x80514BCB ValA_Wu8 255.0 OneToOne 0.00 255.0 FORMAT "%5.1" NUMBER 12 /end CHARACTERISTIC
/begin CHARACTERISTIC CrCUI_numLSF_C "Calibration parameter for LSF mode selection for ACC" VALUE 0x80514BD7 Val_Wu8 255.0 OneToOne 0.00 255.0 FORMAT "%5.1" /end CHARACTERISTIC
/begin CHARACTERISTIC CrCUI_numTSRErr_C "TSR error judgement value" VALUE 0x80514BD8 Val_Wu8 255.0 OneToOne 0.00 255.0 FORMAT "%5.1" /end CHARACTERISTIC
/begin CHARACTERISTIC CrCUI_numTSRInfo_CUR "Calculate vehicle speed from the received TSR signature info" CURVE 0x80514BDA Cur_Xs16Ws16 65535.00 OneToOne -32768.00 32767.00 FORMAT "%8.2"
 /begin AXIS_DESCR STD_AXIS Com_stDispDmdSignRi OneToOne 128 -32768. 32767. FORMAT "%5.0" DEPOSIT ABSOLUTE /end AXIS_DESCR
/end CHARACTERISTIC
/begin CHARACTERISTIC CrCUI_rGearChk0_C "Gear Down Check value 0" VALUE 0x80514DDC Val_Ws32 16777215.9961 NToVel_CrCtl -8388608.00000 8388607.99609 FORMAT "%13.5" /end CHARACTERISTIC
/begin CHARACTERISTIC CrCUI_rGearChk1_C "Gear Down Check value 1" VALUE 0x80514DE0 Val_Ws32 16777215.9961 NToVel_CrCtl -8388608.00000 8388607.99609 FORMAT "%13.5" /end CHARACTERISTIC
/begin CHARACTERISTIC CrCUI_rGearChk2_C "Gear Down Check value 2" VALUE 0x80514DE4 Val_Ws32 16777215.9961 NToVel_CrCtl -8388608.00000 8388607.99609 FORMAT "%13.5" /end CHARACTERISTIC
/begin CHARACTERISTIC CrCUI_rGearChk3_C "Gear Down Check value 3" VALUE 0x80514DE8 Val_Ws32 16777215.9961 NToVel_CrCtl -8388608.00000 8388607.99609 FORMAT "%13.5" /end CHARACTERISTIC
/begin CHARACTERISTIC CrCUI_rGearChk4_C "Gear Down Check value 4" VALUE 0x80514DEC Val_Ws32 16777215.9961 NToVel_CrCtl -8388608.00000 8388607.99609 FORMAT "%13.5" /end CHARACTERISTIC
/begin CHARACTERISTIC CrCUI_rGearChk5_C "Gear Down Check value 5" VALUE 0x80514DF0 Val_Ws32 16777215.9961 NToVel_CrCtl -8388608.00000 8388607.99609 FORMAT "%13.5" /end CHARACTERISTIC
/begin CHARACTERISTIC CrCUI_rNv0_C "ratio n/v for Gear Down 0 check value" VALUE 0x80514DF4 Val_Ws32 16777215.9961 NToVel_CrCtl -8388608.00000 8388607.99609 FORMAT "%13.5" /end CHARACTERISTIC
/begin CHARACTERISTIC CrCUI_rNv1_C "ratio n/v for Gear Down 1 check value" VALUE 0x80514DF8 Val_Ws32 16777215.9961 NToVel_CrCtl -8388608.00000 8388607.99609 FORMAT "%13.5" /end CHARACTERISTIC
/begin CHARACTERISTIC CrCUI_rNv2_C "ratio n/v for Gear Down 2 check value" VALUE 0x80514DFC Val_Ws32 16777215.9961 NToVel_CrCtl -8388608.00000 8388607.99609 FORMAT "%13.5" /end CHARACTERISTIC
/begin CHARACTERISTIC CrCUI_rNv3_C "ratio n/v for Gear Down 3 check value" VALUE 0x80514E00 Val_Ws32 16777215.9961 NToVel_CrCtl -8388608.00000 8388607.99609 FORMAT "%13.5" /end CHARACTERISTIC
/begin CHARACTERISTIC CrCUI_rNv4_C "ratio n/v for Gear Down 4 check value" VALUE 0x80514E04 Val_Ws32 16777215.9961 NToVel_CrCtl -8388608.00000 8388607.99609 FORMAT "%13.5" /end CHARACTERISTIC
/begin CHARACTERISTIC CrCUI_rNv5_C "ratio n/v for Gear Down 5 check value" VALUE 0x80514E08 Val_Ws32 16777215.9961 NToVel_CrCtl -8388608.00000 8388607.99609 FORMAT "%13.5" /end CHARACTERISTIC
/begin CHARACTERISTIC CrCUI_stASLtoISASpdLim_C "Enable switch for continuing speed limit control at the transition from ASL to ISA via LIM SW 1: Control continuation 0: Control cancellation" VALUE 0x80514E0C Val_Wu8 255.0 OneToOne 0.00 255.0 FORMAT "%5.1" /end CHARACTERISTIC
/begin CHARACTERISTIC CrCUI_stClthCont_C "Clutch continuation data" VALUE 0x80514E0D Val_Wu8 1.000 OneToOne 0.00 1.000 FORMAT "%5.3" EXTENDED_LIMITS 0.00 255.0 /end CHARACTERISTIC
/begin CHARACTERISTIC CrCUI_stClthOnNeChk_C "Clutch on Ne Check select value" VALUE 0x80514E0E Val_Wu8 1.000 OneToOne 0.00 1.000 FORMAT "%5.3" EXTENDED_LIMITS 0.00 255.0 /end CHARACTERISTIC
/begin CHARACTERISTIC CrCUI_stECON_C "Added value2 in each 100ms to desired vehicle speed for ECON (ECON sw OFF)" VALUE 0x80514E0F Val_Wu8 1.000 OneToOne 0.00 1.000 FORMAT "%5.3" EXTENDED_LIMITS 0.00 255.0 /end CHARACTERISTIC
/begin CHARACTERISTIC CrCUI_stFctInfo_C "Information of CC/ACC/ASL function" VALUE 0x80514E10 Val_Wu8 255.0 OneToOne 0.00 255.0 FORMAT "%5.1" /end CHARACTERISTIC
/begin CHARACTERISTIC CrCUI_stGearDownNoLSF_C "Gear Down Number for LSF control" VALUE 0x80514E11 Val_Wu8 255.0 OneToOne 0.00 255.0 FORMAT "%5.1" /end CHARACTERISTIC
/begin CHARACTERISTIC CrCUI_stGearDownNo_CA "Gear Down Number for cruise control" VAL_BLK 0x80514E12 ValA_Wu8 255.0 OneToOne 0.00 255.0 FORMAT "%5.1" NUMBER 12 /end CHARACTERISTIC
/begin CHARACTERISTIC CrCUI_stGuidDispOff_C "Cruise control guidance display off indication" VALUE 0x8051BDF4 Val_Wu8 255.0 OneToOne 0.00 255.0 FORMAT "%5.1" /end CHARACTERISTIC
/begin CHARACTERISTIC CrCUI_stIDSCmft_C "Status of Comfort drive mode active" VALUE 0x80514E1E Val_Wu8 255.0 OneToOne 0.00 255.0 FORMAT "%5.1" /end CHARACTERISTIC
/begin CHARACTERISTIC CrCUI_stIDSEco_C "Status of Eco drive mode active" VALUE 0x80514E1F Val_Wu8 255.0 OneToOne 0.00 255.0 FORMAT "%5.1" /end CHARACTERISTIC
/begin CHARACTERISTIC CrCUI_stIDSSpt_C "Status of Sport drive mode active" VALUE 0x80514E20 Val_Wu8 255.0 OneToOne 0.00 255.0 FORMAT "%5.1" /end CHARACTERISTIC
/begin CHARACTERISTIC CrCUI_stISAContJdgTSRClr_CUR "Calculate ISA control continuation judgment value when TSR is cleared" CURVE 0x80514E22 Cur_Xs16Ws16 65535.00 OneToOne -32768.00 32767.00 FORMAT "%8.2"
 /begin AXIS_DESCR STD_AXIS Com_stTSRClrReas OneToOne 8 -32768. 32767. FORMAT "%5.0" DEPOSIT ABSOLUTE /end AXIS_DESCR
/end CHARACTERISTIC
/begin CHARACTERISTIC CrCUI_stISAtoASLbyResSet_C "Enable switch for transition from ISA to ASL via RES (+)SET (-) during ISA." VALUE 0x80514E44 Val_Wu8 255.0 OneToOne 0.00 255.0 FORMAT "%5.1" /end CHARACTERISTIC
/begin CHARACTERISTIC CrCUI_stMETSpdDspEna_C "Status for display control vehicle speed in meter panel" VALUE 0x80514E45 Val_Wu8 1.000 OneToOne 0.00 1.000 FORMAT "%5.3" EXTENDED_LIMITS 0.00 255.0 /end CHARACTERISTIC
/begin CHARACTERISTIC CrCUI_stMetSpdUnitSwt_C "Calibration to select Unit Switching Menu" VALUE 0x80514E46 Val_Wu8 1.000 OneToOne 0.00 1.000 FORMAT "%5.3" EXTENDED_LIMITS 0.00 255.0 /end CHARACTERISTIC
/begin CHARACTERISTIC CrCUI_stShftPosChkDisbl_C "Disable flag for checking shift position" VALUE 0x80514E47 Val_Wu8 255.0 OneToOne 0.00 255.0 FORMAT "%5.1" /end CHARACTERISTIC
/begin CHARACTERISTIC CrCUI_stSimulResChk_C "Simultaneous On Check value for RESUME SW" VALUE 0x80514E48 Val_Wu8 1.000 OneToOne 0.00 1.000 FORMAT "%5.3" EXTENDED_LIMITS 0.00 255.0 /end CHARACTERISTIC
/begin CHARACTERISTIC CrCUI_stSimulSetChk_C "Simultaneous On Check value for SET SW" VALUE 0x80514E49 Val_Wu8 1.000 OneToOne 0.00 1.000 FORMAT "%5.3" EXTENDED_LIMITS 0.00 255.0 /end CHARACTERISTIC
/begin CHARACTERISTIC CrCUI_stSwtFwdPosnInfo_C "Forward Position information switch" VALUE 0x80514E4A Val_Wu8 1.000 OneToOne 0.00 1.000 FORMAT "%5.3" EXTENDED_LIMITS 0.00 255.0 /end CHARACTERISTIC
/begin CHARACTERISTIC CrCUI_stVehUn_C "Vehicle speed unit for CC/ASL when meter does not send vehicle speed unit information" VALUE 0x80514E4B Val_Wu8 1.000 OneToOne 0.00 1.000 FORMAT "%5.3" EXTENDED_LIMITS 0.00 255.0 /end CHARACTERISTIC
/begin CHARACTERISTIC CrCUI_swtATFWDPosnCntr_C "Software switch for FWD position check counter set for AT vehicle" VALUE 0x80514E4C Val_Wu8 1.000 OneToOne 0.00 1.000 FORMAT "%5.3" EXTENDED_LIMITS 0.00 255.0 /end CHARACTERISTIC
/begin CHARACTERISTIC CrCUI_swtCCSpdDispEnfSeln_C "Force selection for existence set-speed-display" VALUE 0x80514E4D Val_Wu8 1.000 OneToOne 0.00 1.000 FORMAT "%5.3" EXTENDED_LIMITS 0.00 255.0 /end CHARACTERISTIC
/begin CHARACTERISTIC CrCUI_swtCrsSwtTypSel_C "Software switch for Cruise control switch type select" VALUE 0x80514E4E Val_Wu8 1.000 OneToOne 0.00 1.000 FORMAT "%5.3" EXTENDED_LIMITS 0.00 255.0 /end CHARACTERISTIC
/begin CHARACTERISTIC CrCUI_swtMETTyp_C "Speed meter type" VALUE 0x80514E4F Val_Wu8 1.000 OneToOne 0.00 1.000 FORMAT "%5.3" EXTENDED_LIMITS 0.00 255.0 /end CHARACTERISTIC
/begin CHARACTERISTIC CrCUI_swtVehUnForceSel_C "Switch that selects vehicle speed unit forcibly" VALUE 0x80514E50 Val_Wu8 1.000 OneToOne 0.00 1.000 FORMAT "%5.3" EXTENDED_LIMITS 0.00 255.0 /end CHARACTERISTIC
/begin CHARACTERISTIC CrCUI_tiACCAppSpdChng_C "ACC Accel Vehicle speed display time" VALUE 0x80514E52 Val_Ws16 3276700. Time_ms_100ms 0.00 3276700. FORMAT "%8.0" EXTENDED_LIMITS -3276800. 3276700. /end CHARACTERISTIC
/begin CHARACTERISTIC CrCUI_tiACCClthCncl_C "ACC Clutch SW Cancel check time" VALUE 0x80514E54 Val_Ws16 327670.0 Time_ms 0.00 327670.0 FORMAT "%8.1" EXTENDED_LIMITS -327680.0 327670.0 /end CHARACTERISTIC
/begin CHARACTERISTIC CrCUI_tiACCCoaSpdChng_C "ACC Coast Vehicle speed display time" VALUE 0x80514E56 Val_Ws16 3276700. Time_ms_100ms 0.00 3276700. FORMAT "%8.0" EXTENDED_LIMITS -3276800. 3276700. /end CHARACTERISTIC
/begin CHARACTERISTIC CrCUI_tiACCSpdNoUpdRes_C "ACC Accel Vehicle speed display not update request time" VALUE 0x80514E58 Val_Ws16 327670.0 Time_ms 0.00 327670.0 FORMAT "%8.1" EXTENDED_LIMITS -327680.0 327670.0 /end CHARACTERISTIC
/begin CHARACTERISTIC CrCUI_tiACCSpdNoUpdSet_C "ACC Coast Vehicle speed display not update request time" VALUE 0x80514E5A Val_Ws16 327670.0 Time_ms 0.00 327670.0 FORMAT "%8.1" EXTENDED_LIMITS -327680.0 327670.0 /end CHARACTERISTIC
/begin CHARACTERISTIC CrCUI_tiACCSwtResApp_C "ACC Accel check time for RESUME SW" VALUE 0x80514E5C Val_Ws16 327670.0 Time_ms 0.00 327670.0 FORMAT "%8.1" EXTENDED_LIMITS -327680.0 327670.0 /end CHARACTERISTIC
/begin CHARACTERISTIC CrCUI_tiACCSwtSetCoa_C "ACC Coast check time for SET SW" VALUE 0x80514E5E Val_Ws16 327670.0 Time_ms 0.00 327670.0 FORMAT "%8.1" EXTENDED_LIMITS -327680.0 327670.0 /end CHARACTERISTIC
/begin CHARACTERISTIC CrCUI_tiAutoBrkActvChk_C "Time for Auto Brake Active Check." VALUE 0x80514E60 Val_Ws16 327670.0 Time_ms 0.00 327670.0 FORMAT "%8.1" EXTENDED_LIMITS -327680.0 327670.0 /end CHARACTERISTIC
/begin CHARACTERISTIC CrCUI_tiAYCCond_C "AYC condition check time" VALUE 0x80514E62 Val_Ws16 327670.0 Time_ms 0.00 327670.0 FORMAT "%8.1" EXTENDED_LIMITS -327680.0 327670.0 /end CHARACTERISTIC
/begin CHARACTERISTIC CrCUI_tiCCASLMETVehUnFlt_C "Timer of filter for meter customize information" VALUE 0x80514E64 Val_Ws16 327670.0 Time_ms 0.00 327670.0 FORMAT "%8.1" EXTENDED_LIMITS -327680.0 327670.0 /end CHARACTERISTIC
/begin CHARACTERISTIC CrCUI_tiCCASLVehUnInit_C "Time of initial setup for CC/ASL vehicle speed unit" VALUE 0x80514E66 Val_Ws16 327670.0 Time_ms 0.00 327670.0 FORMAT "%8.1" EXTENDED_LIMITS -327680.0 327670.0 /end CHARACTERISTIC
/begin CHARACTERISTIC CrCUI_tiContnsErrChk_C "Time of Cruise control error continuous check value" VALUE 0x80514E68 Val_Ws16 327670.0 Time_ms 0.00 327670.0 FORMAT "%8.1" EXTENDED_LIMITS -327680.0 327670.0 /end CHARACTERISTIC
/begin CHARACTERISTIC CrCUI_tiCrsASLSelInfo_C "Time of CC/ASL select information check value" VALUE 0x80514E6A Val_Ws16 327670.0 Time_ms 0.00 327670.0 FORMAT "%8.1" EXTENDED_LIMITS -327680.0 327670.0 /end CHARACTERISTIC
/begin CHARACTERISTIC CrCUI_tiFWDpos_C "FWD position judgment timer in CC_AT vehicles" VALUE 0x80514E6C Val_Ws16 327670.0 Time_ms 0.00 327670.0 FORMAT "%8.1" EXTENDED_LIMITS -327680.0 327670.0 /end CHARACTERISTIC
/begin CHARACTERISTIC CrCUI_tiGearOff_C "Gear off check time" VALUE 0x80514E6E Val_Ws16 327670.0 Time_ms 0.00 327670.0 FORMAT "%8.1" EXTENDED_LIMITS -327680.0 327670.0 /end CHARACTERISTIC
/begin CHARACTERISTIC CrCUI_tiLSFStpJdgHysHi_C "Time for upper threshold for LSF stop judgement hysterisis" VALUE 0x80514E70 Val_Ws16 655350.0 Time_ms -327680.0 327670.0 FORMAT "%8.1" /end CHARACTERISTIC
/begin CHARACTERISTIC CrCUI_tiLSFStpJdgHysLo_C "Time for lower threshold for LSF stop judgement hysterisis" VALUE 0x80514E72 Val_Ws16 655350.0 Time_ms -327680.0 327670.0 FORMAT "%8.1" /end CHARACTERISTIC
/begin CHARACTERISTIC CrCUI_tiMETCustInfoFlt_C "Timer of filter for meter customize information" VALUE 0x80514E74 Val_Ws16 327670.0 Time_ms 0.00 327670.0 FORMAT "%8.1" EXTENDED_LIMITS -327680.0 327670.0 /end CHARACTERISTIC
/begin CHARACTERISTIC CrCUI_tiResuOnSpdUpd_C "Time of updated vehicle speed during Res SW is on" VALUE 0x80514E76 Val_Ws16 3276700. Time_ms_100ms 0.00 3276700. FORMAT "%8.0" EXTENDED_LIMITS -3276800. 3276700. /end CHARACTERISTIC
/begin CHARACTERISTIC CrCUI_tiSetOnSpdUpd_C "Time of updated vehicle speed during Set SW is on" VALUE 0x80514E78 Val_Ws16 3276700. Time_ms_100ms 0.00 3276700. FORMAT "%8.0" EXTENDED_LIMITS -3276800. 3276700. /end CHARACTERISTIC
/begin CHARACTERISTIC CrCUI_tiShftDn5Det_C "Shift Down 5 Detect check time" VALUE 0x80514E7A Val_Ws16 327670.0 Time_ms 0.00 327670.0 FORMAT "%8.1" EXTENDED_LIMITS -327680.0 327670.0 /end CHARACTERISTIC
/begin CHARACTERISTIC CrCUI_tiShftDnDet_C "Shift Down Detect check time" VALUE 0x80514E7C Val_Ws16 327670.0 Time_ms 0.00 327670.0 FORMAT "%8.1" EXTENDED_LIMITS -327680.0 327670.0 /end CHARACTERISTIC
/begin CHARACTERISTIC CrCUI_tiShftDnRls_C "Shift Down Rlease check time" VALUE 0x80514E7E Val_Ws16 327670.0 Time_ms 0.00 327670.0 FORMAT "%8.1" EXTENDED_LIMITS -327680.0 327670.0 /end CHARACTERISTIC
/begin CHARACTERISTIC CrCUI_tiSwtBrkMn_C "Brake Main SW check time" VALUE 0x80514E80 Val_Ws16 327670.0 Time_ms 0.00 327670.0 FORMAT "%8.1" EXTENDED_LIMITS -327680.0 327670.0 /end CHARACTERISTIC
/begin CHARACTERISTIC CrCUI_tiSwtBrkRed_C "Brake Redundant SW check time" VALUE 0x80514E82 Val_Ws16 327670.0 Time_ms 0.00 327670.0 FORMAT "%8.1" EXTENDED_LIMITS -327680.0 327670.0 /end CHARACTERISTIC
/begin CHARACTERISTIC CrCUI_tiSwtClth_C "Clutch SW check time" VALUE 0x80514E84 Val_Ws16 327670.0 Time_ms 0.00 327670.0 FORMAT "%8.1" EXTENDED_LIMITS -327680.0 327670.0 /end CHARACTERISTIC
/begin CHARACTERISTIC CrCUI_tiSwtInhb_C "Inhibit time for switch information from CAN" VALUE 0x80514E86 Val_Ws16 327670.0 Time_ms 0.00 327670.0 FORMAT "%8.1" EXTENDED_LIMITS -327680.0 327670.0 /end CHARACTERISTIC
/begin CHARACTERISTIC CrCUI_tiSwtResApp_C "Accel check time for RESUME SW" VALUE 0x80514E88 Val_Ws16 327670.0 Time_ms 0.00 327670.0 FORMAT "%8.1" EXTENDED_LIMITS -327680.0 327670.0 /end CHARACTERISTIC
/begin CHARACTERISTIC CrCUI_tiSwtSetCoa_C "Coast check time for SET SW" VALUE 0x80514E8A Val_Ws16 327670.0 Time_ms 0.00 327670.0 FORMAT "%8.1" EXTENDED_LIMITS -327680.0 327670.0 /end CHARACTERISTIC
/begin CHARACTERISTIC CrCUI_tiTSRErrDet_C "Time for detecting camera temperature abnormality,dirty and breakdown" VALUE 0x80514E8C Val_Ws16 327670.0 Time_ms 0.00 327670.0 FORMAT "%8.1" EXTENDED_LIMITS -327680.0 327670.0 /end CHARACTERISTIC
/begin CHARACTERISTIC CrCUI_vLSFStpJdgHysHi_C "Upper threshold for vehicle velocity limit for LSF stop judgement" VALUE 0x80514E90 Val_Ws32 16777215.9961 Vel_CrCtl -8388608.00000 8388607.99609 FORMAT "%13.5" /end CHARACTERISTIC
/begin CHARACTERISTIC CrCUI_vLSFStpJdgHysLo_C "Lower threshold for vehicle velocity limit for LSF stop judgement" VALUE 0x80514E94 Val_Ws32 16777215.9961 Vel_CrCtl -8388608.00000 8388607.99609 FORMAT "%13.5" /end CHARACTERISTIC
/begin CHARACTERISTIC EROTAN "Exhaust Regulation or Type Approval Number" VAL_BLK 0x8051C164 ValA_Wu8 255.0 dez 0.00 255.0 FORMAT "%5.1" NUMBER 17 /end CHARACTERISTIC
/begin CHARACTERISTIC I14229DarkCurrHistMonrPrmFmt_C "Parameter Format Value for Dark Current history Monitor Data (DID E402)" VALUE 0x8053AC76 Val_Wu8 255.0 OneToOne 0.00 255.0 FORMAT "%5.1" /end CHARACTERISTIC
/begin CHARACTERISTIC I14229DarkCurrHistMonrPrmLen_C "Parameter Length Value for Dark Current history Monitor Data (DID E402)" VALUE 0x8053AC77 Val_Wu8 255.0 OneToOne 0.00 255.0 FORMAT "%5.1" /end CHARACTERISTIC
/begin CHARACTERISTIC I14229_DiumprDFC_CA "DFC Element Calibration Array for reading DIUMPR records" VAL_BLK 0x8051C176 RB_ValA_Wu16 703.000000000 DFC_Verb 0.00 703.000000000 FORMAT "%13.9" NUMBER 37 /end CHARACTERISTIC
/begin CHARACTERISTIC I14229_nrFmtReqFuCnsRst_C "Format of request fuel consumption reset" VALUE 0x8051C1C0 RB_Val_Wu8 255.0 OneToOne 0.00 255.0 FORMAT "%5.1" /end CHARACTERISTIC
/begin CHARACTERISTIC I14229_nrStrtrCtrl_AlgTypID_C "Algorithm type ID for Engine starter information" VALUE 0x8053AC78 Val_Wu8 255.0 OneToOne 0.00 255.0 FORMAT "%5.1" /end CHARACTERISTIC
/begin CHARACTERISTIC I14229_nrStrtrCtrl_DataLen_C "Valid data length for Engine starter information" VALUE 0x8053AC79 Val_Wu8 255.0 OneToOne 0.00 255.0 FORMAT "%5.1" /end CHARACTERISTIC
/begin CHARACTERISTIC I14229_nrVldDataLenFuCnsRst_C "Valid data length of reset request fuel consumption" VALUE 0x8051C1C1 RB_Val_Wu8 255.0 OneToOne 0.00 255.0 FORMAT "%5.1" /end CHARACTERISTIC
/begin CHARACTERISTIC I14229_numCompID_CA "Calibration for ECU Component ID" VAL_BLK 0x8053AC7A ValA_Wu8 255.0 OneToOne 0.00 255.0 FORMAT "%5.1" NUMBER 17 /end CHARACTERISTIC
/begin CHARACTERISTIC I14229_numOilLfT_DataLen_C "Valid data length(Used in process for inspection)" VALUE 0x8053AC8B Val_Wu8 255.0 OneToOne 0.00 255.0 FORMAT "%5.1" /end CHARACTERISTIC
/begin CHARACTERISTIC I14229_numProgID_CA "Calibration for ECU Program ID" VAL_BLK 0x8051C1C2 RB_ValA_Wu8 255.0 OneToOne 0.00 255.0 FORMAT "%5.1" NUMBER 14 /end CHARACTERISTIC
/begin CHARACTERISTIC I14229_numReWrECUID_CA "ECU ID for rewriting (Info Read Service)" VAL_BLK 0x8051C1D0 RB_ValA_Wu8 255.0 OneToOne 0.00 255.0 FORMAT "%5.1" NUMBER 5 /end CHARACTERISTIC
/begin CHARACTERISTIC I14229_numTBNAlgTypIDBak_C "Algotrithm Type for Backup purpose" VALUE 0x8053AC8C Val_Wu8 255.0 OneToOne 0.00 255.0 FORMAT "%5.1" /end CHARACTERISTIC
/begin CHARACTERISTIC I14229_numTBNDatLngthBak_C "Valid data length for Backup purpose" VALUE 0x8053AC8D Val_Wu8 255.0 OneToOne 0.00 255.0 FORMAT "%5.1" /end CHARACTERISTIC
/begin CHARACTERISTIC I14229_RcDid0212Ena_C "Calibration to select between support or not support for service 31, DID 0212" VALUE 0x8051C1D5 RB_Val_Wboolean 255.0 OneToOne 0.00 255.0 FORMAT "%5.1" /end CHARACTERISTIC
/begin CHARACTERISTIC I14229_RcDid0213Ena_C "Calibration to enable DID 0x0213" VALUE 0x8051C1D6 RB_Val_Wboolean 255.0 OneToOne 0.00 255.0 FORMAT "%5.1" /end CHARACTERISTIC
/begin CHARACTERISTIC I14229_RcDid021CEna_C "Calibration to select between support or not support for service 31, DID 021C" VALUE 0x8051C1D7 RB_Val_Wboolean 255.0 OneToOne 0.00 255.0 FORMAT "%5.1" /end CHARACTERISTIC
/begin CHARACTERISTIC I14229_stVSAEquip_C "VSA equipment information" VALUE 0x8051C1D8 Val_Wu8 255.0 OneToOne 0.00 255.0 FORMAT "%5.1" /end CHARACTERISTIC
/begin CHARACTERISTIC I14229_volMaxCumFuCns_C "Maximum cumulative fuel consumption output to tester" VALUE 0x8051C1DA RB_Val_Wu16 65535.00 volFilgLvl_ml 0.00 65535.00 FORMAT "%8.2" /end CHARACTERISTIC
/begin CHARACTERISTIC I14229_WdbiDidE81FEna_C "Calibration to select between support or not support service 2E, DIDE81F" VALUE 0x8053AC8E Val_Wu8 1.000 OneToOne 0.00 1.000 FORMAT "%5.3" EXTENDED_LIMITS 0.00 255.0 /end CHARACTERISTIC
/begin CHARACTERISTIC Immo_numSAID_C "Calibration parameter for SAID changes" VALUE 0x8053AC6C RB_Val_Wu8 255.0 OneToOne 0.00 255.0 FORMAT "%5.1" /end CHARACTERISTIC
/begin CHARACTERISTIC Linappl_swtLinSdl_C "switch for LIN scheduler" VALUE 0x8051C1DC RB_Val_Wu8 255.0 OneToOne 0.00 255.0 FORMAT "%5.1" /end CHARACTERISTIC
/begin CHARACTERISTIC SecuAcs_numCustTyp3SC_C "Calibration for Type 3 security" VALUE 0x8053AC6D RB_Val_Wu8 255.0 OneToOne 0.00 255.0 FORMAT "%5.1" /end CHARACTERISTIC
/begin CHARACTERISTIC SecuAcs_numCustTyp4SC_C "Calibration for Type 4 security" VALUE 0x8053AC6E RB_Val_Wu8 255.0 OneToOne 0.00 255.0 FORMAT "%5.1" /end CHARACTERISTIC
/begin CHARACTERISTIC SecuAcs_numS1_C "Security coefficent 1 for key calculation" VALUE 0x8053AC70 RB_Val_Wu16 65535.00 OneToOne 0.00 65535.00 FORMAT "%8.2" /end CHARACTERISTIC
/begin CHARACTERISTIC SecuAcs_numS2_C "Security coefficent 2 for key calculation" VALUE 0x8053AC72 RB_Val_Wu16 65535.00 OneToOne 0.00 65535.00 FORMAT "%8.2" /end CHARACTERISTIC
/begin CHARACTERISTIC SecuAcs_numS3_C "Security coefficent 3 for key calculation" VALUE 0x8053AC74 RB_Val_Wu16 65535.00 OneToOne 0.00 65535.00 FORMAT "%8.2" /end CHARACTERISTIC
/begin MEASUREMENT BasSvr_bFuncTstReq "condition general function request" UBYTE B_TRUE 1 100 0.00 1.00000000000 BIT_MASK 0x1 FORMAT "%13.11" ECU_ADDRESS 0x6000A7CF /end MEASUREMENT
/begin MEASUREMENT CrCUI_ctACCAppSpdChng_mp "Counter for ACC Speedd Change" UWORD OneToOne 1 100 0.00 65535.00 FORMAT "%8.2" ECU_ADDRESS 0x70008E42 /end MEASUREMENT
/begin MEASUREMENT CrCUI_ctACCASLSwtErr_mp "Counter of ACC/ASL switch error detection" UWORD OneToOne 1 100 0.00 65535.00 FORMAT "%8.2" ECU_ADDRESS 0x70008E40 /end MEASUREMENT
/begin MEASUREMENT CrCUI_ctACCASLSwtFild_mp "Counter of ACC/ASL switch filter" UBYTE OneToOne 1 100 0.00 255.0 FORMAT "%5.1" ECU_ADDRESS 0x70008E3E /end MEASUREMENT
/begin MEASUREMENT CrCUI_ctACCCoaSpdChng_mp "Counter value for the Coast Vehicle speed display" UWORD OneToOne 1 100 0.00 65535.00 FORMAT "%8.2" ECU_ADDRESS 0x70008E3C /end MEASUREMENT
/begin MEASUREMENT CrCUI_ctATFWDPosn_mp "Counter of FWD position check for AT vehicle" UBYTE OneToOne 1 100 0.00 255.0 FORMAT "%5.1" ECU_ADDRESS 0x70008E3B /end MEASUREMENT
/begin MEASUREMENT CrCUI_ctCancelSwtDeb_mp "Counter for debouncing cancel switch status" UBYTE OneToOne 1 100 0.00 255.0 FORMAT "%5.1" ECU_ADDRESS 0x70008E3A /end MEASUREMENT
/begin MEASUREMENT CrCUI_ctCANRxErr1_mp "Counter value for CAN Rx Main Switch receive error" UBYTE OneToOne 1 100 0.00 255.0 FORMAT "%5.1" ECU_ADDRESS 0x70008E39 /end MEASUREMENT
/begin MEASUREMENT CrCUI_ctCANRxErr_mp "Counter for debouncing the CAN recieve error" UBYTE OneToOne 1 100 0.00 255.0 FORMAT "%5.1" ECU_ADDRESS 0x70008E38 /end MEASUREMENT
/begin MEASUREMENT CrCUI_ctCrsSwtErr_mp "Counter of Cruise control switch error detection" UWORD OneToOne 1 100 0.00 65535.00 FORMAT "%8.2" ECU_ADDRESS 0x70008E36 /end MEASUREMENT
/begin MEASUREMENT CrCUI_ctCrsSwtFild_mp "Counter of Cruise control switch filter" UBYTE OneToOne 1 100 0.00 255.0 FORMAT "%5.1" ECU_ADDRESS 0x70008E34 /end MEASUREMENT
/begin MEASUREMENT CrCUI_ctEAT2RxErr_mp "Counter of EAT2 communication error check" UBYTE OneToOne 1 100 0.00 255.0 FORMAT "%5.1" ECU_ADDRESS 0x70008E33 /end MEASUREMENT
/begin MEASUREMENT CrCUI_ctMainSwtDeb_mp "Counter for debouncing main switch status" UBYTE OneToOne 1 100 0.00 255.0 FORMAT "%5.1" ECU_ADDRESS 0x70008E32 /end MEASUREMENT
/begin MEASUREMENT CrCUI_ctResSwtDeb_mp "Counter for debouncing resume switch status" UBYTE OneToOne 1 100 0.00 255.0 FORMAT "%5.1" ECU_ADDRESS 0x70008E31 /end MEASUREMENT
/begin MEASUREMENT CrCUI_ctResuOnSpdUpd "Counter of updated vehicle speed during Res SW is on" UWORD OneToOne 1 100 0.00 65535.00 FORMAT "%8.2" ECU_ADDRESS 0x60004D40 /end MEASUREMENT
/begin MEASUREMENT CrCUI_ctSetOnSpdUpd "Counter of updated vehicle speed during Set SW is on" UWORD OneToOne 1 100 0.00 65535.00 FORMAT "%8.2" ECU_ADDRESS 0x60004D3E /end MEASUREMENT
/begin MEASUREMENT CrCUI_ctSetSwtDeb_mp "Counter for debouncing set switch status" UBYTE OneToOne 1 100 0.00 255.0 FORMAT "%5.1" ECU_ADDRESS 0x70008E30 /end MEASUREMENT
/begin MEASUREMENT CrCUI_flgAutoBrkActvChk "Flag for autobrake active check" UBYTE OneToOne 1 100 0.00 255.0 FORMAT "%5.1" ECU_ADDRESS 0x6000A44F /end MEASUREMENT
/begin MEASUREMENT CrCUI_flgClrEEPROM "The clear EEPROM flag" UBYTE B_TRUE 1 100 0.00 1.00000000000 BIT_MASK 0x1 FORMAT "%13.11" ECU_ADDRESS 0x60000C59 /end MEASUREMENT
/begin MEASUREMENT CrCUI_flgCrCUICANRxNorm "Cruise control user interface CAN Rx normal. (FId_CrCUICANRxErr is not inhibited)" UBYTE B_TRUE 1 100 0.00 1.00000000000 BIT_MASK 0x1 FORMAT "%13.11" ECU_ADDRESS 0x6000A19C /end MEASUREMENT
/begin MEASUREMENT CrCUI_flgCrsCtrlShtOffEngNorm "Cruise control shut off engine normal. (FId_CrCtlShutOffEng is not inhibited)" UBYTE B_TRUE 1 100 0.00 1.00000000000 BIT_MASK 0x1 FORMAT "%13.11" ECU_ADDRESS 0x6000A19B /end MEASUREMENT
/begin MEASUREMENT CrCUI_nACCBrkCnclLoLim_mp "ACC auto brake cancel Low limit Ne value" SWORD EngNCrCtl 1 100 -32768.00 32767.00 FORMAT "%8.2" ECU_ADDRESS 0x70008E2E /end MEASUREMENT
/begin MEASUREMENT CrCUI_nCnclLoLim_mp "Cruise Control cancel Low limit Ne value" SWORD EngNCrCtl 1 100 -32768.00 32767.00 FORMAT "%8.2" ECU_ADDRESS 0x70008E2C /end MEASUREMENT
/begin MEASUREMENT CrCUI_nEngSpd "Engine speed for CrCtl" SWORD EngNCrCtl 1 100 -32768.00 32767.00 FORMAT "%8.2" ECU_ADDRESS 0x60005140 /end MEASUREMENT
/begin MEASUREMENT CrCUI_nFlt "Filtered Ne value for Cruise Control" SWORD EngNCrCtl 1 100 -32768.00 32767.00 FORMAT "%8.2" ECU_ADDRESS 0x6000513E /end MEASUREMENT
/begin MEASUREMENT CrCUI_nFltDiff "Cruise Control difference Filtered Ne value" SWORD EngNCrCtl 1 100 -32768.00 32767.00 FORMAT "%8.2" ECU_ADDRESS 0x6000513C /end MEASUREMENT
/begin MEASUREMENT CrCUI_nFltOld_mp "Old Filtered Ne value for Cruise Control" SWORD EngNCrCtl 1 100 -32768.00 32767.00 FORMAT "%8.2" ECU_ADDRESS 0x70008E2A /end MEASUREMENT
/begin MEASUREMENT CrCUI_nLIDes "engine speed setpoint of Low Idle Governor for Cruise Control" SWORD EngNCrCtl 1 100 -32768.00 32767.00 FORMAT "%8.2" ECU_ADDRESS 0x6000513A /end MEASUREMENT
/begin MEASUREMENT CrCUI_nShftDnReq_mp "Shift down request Ne Check value" SWORD EngNCrCtl 1 100 -32768.00 32767.00 FORMAT "%8.2" ECU_ADDRESS 0x70008E28 /end MEASUREMENT
/begin MEASUREMENT CrCUI_numGearPosnADAS "Current Gear position information for Valeo-ADAS" UBYTE OneToOne 1 100 0.00 255.0 FORMAT "%5.1" ECU_ADDRESS 0x6000A44E /end MEASUREMENT
/begin MEASUREMENT CrCUI_numLSF "State of LSF mode selection for ACC" UBYTE OneToOne 1 100 0.00 255.0 FORMAT "%5.1" ECU_ADDRESS 0x6000A44D /end MEASUREMENT
/begin MEASUREMENT CrCUI_numSelMode "State of mode selection of CCASLISA 0:CC 1:ASL 2:ISA" UBYTE OneToOne 1 100 0.00 255.0 FORMAT "%5.1" ECU_ADDRESS 0x6000A44C /end MEASUREMENT
/begin MEASUREMENT CrCUI_numTSRLimSpd "The traffic signature information which TSR detects(including the speed limiting signature)" UBYTE OneToOne 1 100 0.00 255.0 FORMAT "%5.1" ECU_ADDRESS 0x6000A44B /end MEASUREMENT
/begin MEASUREMENT CrCUI_rNvAbs0_mp "absolute value of ratio n/v 0" SLONG NToVel_CrCtl 1 100 -8388608.00000 8388607.99609 FORMAT "%13.5" ECU_ADDRESS 0x70008E24 /end MEASUREMENT
/begin MEASUREMENT CrCUI_rNvAbs1_mp "absolute value of ratio n/v 1" SLONG NToVel_CrCtl 1 100 -8388608.00000 8388607.99609 FORMAT "%13.5" ECU_ADDRESS 0x70008E20 /end MEASUREMENT
/begin MEASUREMENT CrCUI_rNvAbs2_mp "absolute value of ratio n/v 2" SLONG NToVel_CrCtl 1 100 -8388608.00000 8388607.99609 FORMAT "%13.5" ECU_ADDRESS 0x70008E1C /end MEASUREMENT
/begin MEASUREMENT CrCUI_rNvAbs3_mp "absolute value of ratio n/v 3" SLONG NToVel_CrCtl 1 100 -8388608.00000 8388607.99609 FORMAT "%13.5" ECU_ADDRESS 0x70008E18 /end MEASUREMENT
/begin MEASUREMENT CrCUI_rNvAbs4_mp "absolute value of ratio n/v 4" SLONG NToVel_CrCtl 1 100 -8388608.00000 8388607.99609 FORMAT "%13.5" ECU_ADDRESS 0x70008E14 /end MEASUREMENT
/begin MEASUREMENT CrCUI_rNvSubsGear5_mp "value of ratio n/v data 5 - Gear Down Check value 5" SLONG NToVel_CrCtl 1 100 -8388608.00000 8388607.99609 FORMAT "%13.5" ECU_ADDRESS 0x70008E10 /end MEASUREMENT
/begin MEASUREMENT CrCUI_rNv_mp "stored ratio engine speed to vehicle speed" SLONG NToVel_CrCtl 1 100 -8388608.00000 8388607.99609 FORMAT "%13.5" ECU_ADDRESS 0x70008E0C /end MEASUREMENT
/begin MEASUREMENT CrCUI_stACCASLErrTmrIdc_mp "Status of ACC/ASL switch error continuous check timer indication" UBYTE OneToOne 1 100 0.00 255.0 FORMAT "%5.1" ECU_ADDRESS 0x70008E0B /end MEASUREMENT
/begin MEASUREMENT CrCUI_stACCASLSwtErrDet "Status of ACCASL switch error detection" UBYTE OneToOne 1 100 0.00 255.0 FORMAT "%5.1" ECU_ADDRESS 0x6000A44A /end MEASUREMENT
/begin MEASUREMENT CrCUI_stACCASLSwtFild_mp "Status of Filtered ACC/ASL switch information" UBYTE OneToOne 1 100 0.00 255.0 FORMAT "%5.1" ECU_ADDRESS 0x70008E0A /end MEASUREMENT
/begin MEASUREMENT CrCUI_stACCASLSwtOld_mp "Status of ACC/ASL switch information old value" UBYTE OneToOne 1 100 0.00 255.0 FORMAT "%5.1" ECU_ADDRESS 0x70008E09 /end MEASUREMENT
/begin MEASUREMENT CrCUI_stACCBrkCnclReq "Status of ACC auto brake cancel request flag" UBYTE OneToOne 1 100 0.00 255.0 FORMAT "%5.1" ECU_ADDRESS 0x6000A449 /end MEASUREMENT
/begin MEASUREMENT CrCUI_stACCClthCont "Status value for ACC Clutch Control" UBYTE OneToOne 1 100 0.00 255.0 FORMAT "%5.1" ECU_ADDRESS 0x6000A448 /end MEASUREMENT
/begin MEASUREMENT CrCUI_stACCClthOn "Status for ACC Clutch on flag" UBYTE OneToOne 1 100 0.00 255.0 FORMAT "%5.1" ECU_ADDRESS 0x6000A447 /end MEASUREMENT
/begin MEASUREMENT CrCUI_stACCNoUpdReq "Status of Vehicle speed display not update request for ACC" UBYTE OneToOne 1 100 0.00 255.0 FORMAT "%5.1" ECU_ADDRESS 0x6000A446 /end MEASUREMENT
/begin MEASUREMENT CrCUI_stACCSpdIndTrg "tatus for Coast/Accel Vehicle speed display trigger flag" UBYTE OneToOne 1 100 0.00 255.0 FORMAT "%5.1" ECU_ADDRESS 0x6000A445 /end MEASUREMENT
/begin MEASUREMENT CrCUI_stASLMainDeb "Status of after decided main sw for ASL" UBYTE OneToOne 1 100 0.00 255.0 FORMAT "%5.1" ECU_ADDRESS 0x6000A444 /end MEASUREMENT
/begin MEASUREMENT CrCUI_stASLSpdNoUpdReq "Status of desired vehicle speed display no update request" UBYTE OneToOne 1 100 0.00 255.0 FORMAT "%5.1" ECU_ADDRESS 0x6000A443 /end MEASUREMENT
/begin MEASUREMENT CrCUI_stASLtoISASpdLim "Flag indicates that speed limiting control will continue in ISA at the transition from ASL to ISA via LIM SW" UBYTE OneToOne 1 100 0.00 255.0 FORMAT "%5.1" ECU_ADDRESS 0x6000A442 /end MEASUREMENT
/begin MEASUREMENT CrCUI_stATShft "Shift position flag in CC_AT vehicles." UBYTE OneToOne 1 100 0.00 255.0 FORMAT "%5.1" ECU_ADDRESS 0x6000A441 /end MEASUREMENT
/begin MEASUREMENT CrCUI_stAYCCond "Status value for AYC condition" UBYTE OneToOne 1 100 0.00 255.0 FORMAT "%5.1" ECU_ADDRESS 0x6000A440 /end MEASUREMENT
/begin MEASUREMENT CrCUI_stBkupChk "Status of backup ram check for CC-ASL" UBYTE OneToOne 1 100 0.00 255.0 FORMAT "%5.1" ECU_ADDRESS 0x6000A43F /end MEASUREMENT
/begin MEASUREMENT CrCUI_stCancelSwt "Status value of CANCEL SW" UBYTE OneToOne 1 100 0.00 255.0 FORMAT "%5.1" ECU_ADDRESS 0x6000A43C /end MEASUREMENT
/begin MEASUREMENT CrCUI_stCANRxErr "Status of CAN Rx error" UBYTE OneToOne 1 100 0.00 255.0 FORMAT "%5.1" ECU_ADDRESS 0x6000A43E /end MEASUREMENT
/begin MEASUREMENT CrCUI_stCCASLMETVehUnFlt_mp "The vehicle speed unit for CC-ASL after filter" UBYTE OneToOne 1 100 0.00 255.0 FORMAT "%5.1" ECU_ADDRESS 0x70008E08 /end MEASUREMENT
/begin MEASUREMENT CrCUI_stCCASLVehUn "Status of vehicle speed unit for CC/ASL" UBYTE OneToOne 1 100 0.00 255.0 FORMAT "%5.1" ECU_ADDRESS 0x6000A43D /end MEASUREMENT
/begin MEASUREMENT CrCUI_stCCSpdDispExist "Cruise Control Set-speed-display is exist or not" UBYTE OneToOne 1 100 0.00 255.0 BIT_MASK 0x1 FORMAT "%5.1" ECU_ADDRESS 0x6000A19A /end MEASUREMENT
/begin MEASUREMENT CrCUI_stClthCond "Status value for Clutch condition" UBYTE OneToOne 1 100 0.00 255.0 FORMAT "%5.1" ECU_ADDRESS 0x6000A43B /end MEASUREMENT
/begin MEASUREMENT CrCUI_stClu "Status of Clutch status for ACC" UBYTE OneToOne 1 100 0.00 255.0 FORMAT "%5.1" ECU_ADDRESS 0x6000A43A /end MEASUREMENT
/begin MEASUREMENT CrCUI_stCluOld_mp "Status of old clutch status for ACC" UBYTE OneToOne 1 100 0.00 255.0 FORMAT "%5.1" ECU_ADDRESS 0x70008E07 /end MEASUREMENT
/begin MEASUREMENT CrCUI_stCmftDrvMod "Status of Comfort drive mode active" UBYTE OneToOne 1 100 0.00 255.0 FORMAT "%5.1" ECU_ADDRESS 0x6000A199 /end MEASUREMENT
/begin MEASUREMENT CrCUI_stCntFstChk "Status for ACCEL/COAST Vehicle speed display first countup check" UBYTE OneToOne 1 100 0.00 255.0 FORMAT "%5.1" ECU_ADDRESS 0x6000A439 /end MEASUREMENT
/begin MEASUREMENT CrCUI_stCrsASLSelFild "Status of Filtered CCASL select switch condition" UBYTE OneToOne 1 100 0.00 255.0 FORMAT "%5.1" ECU_ADDRESS 0x6000A438 /end MEASUREMENT
/begin MEASUREMENT CrCUI_stCrsASLSelFildOld_mp "Old filtered value of CC\ASL select switch information(CrCUI_stCrsASLSelFild)" UBYTE OneToOne 1 100 0.00 255.0 FORMAT "%5.1" ECU_ADDRESS 0x70008E06 /end MEASUREMENT
/begin MEASUREMENT CrCUI_stCrsASLSelRes_mp "Status of Filtered CC/ASL select result" UBYTE OneToOne 1 100 0.00 255.0 FORMAT "%5.1" ECU_ADDRESS 0x70008E05 /end MEASUREMENT
/begin MEASUREMENT CrCUI_stCrsErrTmrIdc_mp "Status of Cruise control switch error continuous check timer indication" UBYTE OneToOne 1 100 0.00 255.0 FORMAT "%5.1" ECU_ADDRESS 0x70008E04 /end MEASUREMENT
/begin MEASUREMENT CrCUI_stCrsSwtErrDet "Status of Cruise control switch error detection" UBYTE OneToOne 1 100 0.00 255.0 FORMAT "%5.1" ECU_ADDRESS 0x6000A437 /end MEASUREMENT
/begin MEASUREMENT CrCUI_stCrsSwtFild "Status of Filtered Cruise Switch" UBYTE OneToOne 1 100 0.00 255.0 FORMAT "%5.1" ECU_ADDRESS 0x6000A436 /end MEASUREMENT
/begin MEASUREMENT CrCUI_stCrsSwtFildOld_mp "Status of Filtered Cruise control switch information old value" UBYTE OneToOne 1 100 0.00 255.0 FORMAT "%5.1" ECU_ADDRESS 0x70008E03 /end MEASUREMENT
/begin MEASUREMENT CrCUI_stCrsSwtOld_mp "Status of Cruise control switch information old value" UBYTE OneToOne 1 100 0.00 255.0 FORMAT "%5.1" ECU_ADDRESS 0x70008E02 /end MEASUREMENT
/begin MEASUREMENT CrCUI_stCvtLmap "Status of L positions for CVT" UBYTE OneToOne 1 100 0.00 1.000 FORMAT "%5.3" ECU_ADDRESS 0x6000A435 /end MEASUREMENT
/begin MEASUREMENT CrCUI_stEAT2RxErr "Status of EAT2 communication error" UBYTE OneToOne 1 100 0.00 255.0 FORMAT "%5.1" ECU_ADDRESS 0x6000A434 /end MEASUREMENT
/begin MEASUREMENT CrCUI_stEcoDrvMod "Status of ECON drive mode active" UBYTE OneToOne 1 100 0.00 255.0 FORMAT "%5.1" ECU_ADDRESS 0x6000A198 /end MEASUREMENT
/begin MEASUREMENT CrCUI_stECONActv "Status of ECON active for Cruise control" UBYTE OneToOne 1 100 0.00 255.0 FORMAT "%5.1" ECU_ADDRESS 0x6000A433 /end MEASUREMENT
/begin MEASUREMENT CrCUI_stECONActvOld "Status of Old ECON active for Cruise control" UBYTE OneToOne 1 100 0.00 255.0 FORMAT "%5.1" ECU_ADDRESS 0x6000A432 /end MEASUREMENT
/begin MEASUREMENT CrCUI_stFctInfo "Status of CCACCASL function equipped" UBYTE OneToOne 1 100 0.00 255.0 FORMAT "%5.1" ECU_ADDRESS 0x6000A430 /end MEASUREMENT
/begin MEASUREMENT CrCUI_stFiSysFailCond "Status value for Fi system fail condition" UBYTE OneToOne 1 100 0.00 255.0 FORMAT "%5.1" ECU_ADDRESS 0x6000A42F /end MEASUREMENT
/begin MEASUREMENT CrCUI_stFWDPos "Forward shift position flag for AT\CVT" UBYTE OneToOne 1 100 0.00 255.0 FORMAT "%5.1" ECU_ADDRESS 0x6000A431 /end MEASUREMENT
/begin MEASUREMENT CrCUI_stGearDownNo "Status value for Gear Down No" UBYTE OneToOne 1 100 0.00 255.0 FORMAT "%5.1" ECU_ADDRESS 0x6000A42E /end MEASUREMENT
/begin MEASUREMENT CrCUI_stISAContTSRClr "ISA control continuation information when TSR is cleared" UBYTE OneToOne 1 100 0.00 255.0 FORMAT "%5.1" ECU_ADDRESS 0x6000A42D /end MEASUREMENT
/begin MEASUREMENT CrCUI_stISAModeMnSW "ISA mode Main SW status" UBYTE OneToOne 1 100 0.00 255.0 FORMAT "%5.1" ECU_ADDRESS 0x6000A42C /end MEASUREMENT
/begin MEASUREMENT CrCUI_stISAtoASLbyResSet "Flag indicates that transition from ISA to ASL happens due to operation of RES (+)SET (-) during ISA." UBYTE OneToOne 1 100 0.00 255.0 FORMAT "%5.1" ECU_ADDRESS 0x6000A42B /end MEASUREMENT
/begin MEASUREMENT CrCUI_stKeyRead "status of key read from inputs" UBYTE OneToOne 1 100 0.00 255.0 FORMAT "%5.1" ECU_ADDRESS 0x6000A42A /end MEASUREMENT
/begin MEASUREMENT CrCUI_stLowGearCancel "Status value for Low Gear cancel" UBYTE OneToOne 1 100 0.00 255.0 FORMAT "%5.1" ECU_ADDRESS 0x6000A428 /end MEASUREMENT
/begin MEASUREMENT CrCUI_stLSFStpJdg "Status of LSF stop judgement" UBYTE OneToOne 1 100 0.00 255.0 FORMAT "%5.1" ECU_ADDRESS 0x6000A429 /end MEASUREMENT
/begin MEASUREMENT CrCUI_stMainDeb "Status of after decided main sw for cruise control" UBYTE OneToOne 1 100 0.00 255.0 FORMAT "%5.1" ECU_ADDRESS 0x6000A426 /end MEASUREMENT
/begin MEASUREMENT CrCUI_stMaiSwtInter_mp "Status of Cruise control Main switch condition(intermediate value)" UBYTE OneToOne 1 100 0.00 255.0 FORMAT "%5.1" ECU_ADDRESS 0x70008E01 /end MEASUREMENT
/begin MEASUREMENT CrCUI_stMETCustInfoFlt_mp "Status of meter customize information after filter" UBYTE OneToOne 1 100 0.00 255.0 FORMAT "%5.1" ECU_ADDRESS 0x70008E00 /end MEASUREMENT
/begin MEASUREMENT CrCUI_stMETSpdDspEna "Status for display control vehicle speed in meter panel" UBYTE OneToOne 1 100 0.00 255.0 FORMAT "%5.1" ECU_ADDRESS 0x6000A427 /end MEASUREMENT
/begin MEASUREMENT CrCUI_stModeChgCncl "Flag indicates that the mode transition within CC\ASL\ISA is going to happen." UBYTE OneToOne 1 100 0.00 255.0 FORMAT "%5.1" ECU_ADDRESS 0x6000A425 /end MEASUREMENT
/begin MEASUREMENT CrCUI_stNeDnCncl "Status of Cruise Control Cancel from Ne down flag" UBYTE OneToOne 1 100 0.00 255.0 FORMAT "%5.1" ECU_ADDRESS 0x6000A424 /end MEASUREMENT
/begin MEASUREMENT CrCUI_stNeUpCncl "Status of Cruise Control Cancel from Ne Up flag" UBYTE OneToOne 1 100 0.00 255.0 FORMAT "%5.1" ECU_ADDRESS 0x6000A423 /end MEASUREMENT
/begin MEASUREMENT CrCUI_stShftDnReq "Status of Driver Shift down request flag" UBYTE OneToOne 1 100 0.00 255.0 FORMAT "%5.1" ECU_ADDRESS 0x6000A421 /end MEASUREMENT
/begin MEASUREMENT CrCUI_stShftDnRls_mp "Status value for Shift Down Release condition 0 to 4" UBYTE OneToOne 1 100 0.00 255.0 FORMAT "%5.1" ECU_ADDRESS 0x70008DFF /end MEASUREMENT
/begin MEASUREMENT CrCUI_stShftPosCANErr "CAN error flag related to shift position information for AT\CVT" UBYTE OneToOne 1 100 0.00 255.0 FORMAT "%5.1" ECU_ADDRESS 0x6000A420 /end MEASUREMENT
/begin MEASUREMENT CrCUI_stSptDrvMod "Status of Sport drive mode active" UBYTE OneToOne 1 100 0.00 255.0 FORMAT "%5.1" ECU_ADDRESS 0x6000A197 /end MEASUREMENT
/begin MEASUREMENT CrCUI_stSwtBrkMnDeb "Status value of Brake Main SW" UBYTE OneToOne 1 100 0.00 255.0 FORMAT "%5.1" ECU_ADDRESS 0x6000A41F /end MEASUREMENT
/begin MEASUREMENT CrCUI_stSwtBrkMnLSF "Status value of Brake Main SW for LSF" UBYTE OneToOne 1 100 0.00 255.0 FORMAT "%5.1" ECU_ADDRESS 0x6000A41E /end MEASUREMENT
/begin MEASUREMENT CrCUI_stSwtBrkMnOld "Old status value of Brake Main SW" UBYTE OneToOne 1 100 0.00 255.0 FORMAT "%5.1" ECU_ADDRESS 0x6000A41D /end MEASUREMENT
/begin MEASUREMENT CrCUI_stSwtBrkRedDeb "Status value of Brake Redundant SW" UBYTE OneToOne 1 100 0.00 255.0 FORMAT "%5.1" ECU_ADDRESS 0x6000A41C /end MEASUREMENT
/begin MEASUREMENT CrCUI_stSwtBrkRedLSF "Status value of Brake Redundant SW for LSF" UBYTE OneToOne 1 100 0.00 255.0 FORMAT "%5.1" ECU_ADDRESS 0x6000A41B /end MEASUREMENT
/begin MEASUREMENT CrCUI_stSwtBrkRedOld "Old status value of Brake Redundant SW" UBYTE OneToOne 1 100 0.00 255.0 FORMAT "%5.1" ECU_ADDRESS 0x6000A41A /end MEASUREMENT
/begin MEASUREMENT CrCUI_stSwtClthDeb "Status value for Clutch SW" UBYTE OneToOne 1 100 0.00 255.0 FORMAT "%5.1" ECU_ADDRESS 0x6000A419 /end MEASUREMENT
/begin MEASUREMENT CrCUI_stSwtMainDeb_mp "Status value of MAIN SW" UBYTE OneToOne 1 100 0.00 255.0 FORMAT "%5.1" ECU_ADDRESS 0x70008DFE /end MEASUREMENT
/begin MEASUREMENT CrCUI_stSwtOnSpdUpd "Status of updated vehicle speed during Res SW is on" UBYTE OneToOne 1 100 0.00 255.0 FORMAT "%5.1" ECU_ADDRESS 0x6000A418 /end MEASUREMENT
/begin MEASUREMENT CrCUI_stSwtOpErr "Status for SW operation Error" UBYTE OneToOne 1 100 0.00 255.0 FORMAT "%5.1" ECU_ADDRESS 0x6000A417 /end MEASUREMENT
/begin MEASUREMENT CrCUI_stSwtResDeb_mp "Status value of RESUME SW" UBYTE OneToOne 1 100 0.00 255.0 FORMAT "%5.1" ECU_ADDRESS 0x70008DFD /end MEASUREMENT
/begin MEASUREMENT CrCUI_stSwtResNo "Status for RESUME SW condition No" UBYTE OneToOne 1 100 0.00 255.0 FORMAT "%5.1" ECU_ADDRESS 0x6000A416 /end MEASUREMENT
/begin MEASUREMENT CrCUI_stSwtSetDeb_mp "Status value of SET SW" UBYTE OneToOne 1 100 0.00 255.0 FORMAT "%5.1" ECU_ADDRESS 0x70008DFC /end MEASUREMENT
/begin MEASUREMENT CrCUI_stSwtSetNo "Status for SET SW condition No" UBYTE OneToOne 1 100 0.00 255.0 FORMAT "%5.1" ECU_ADDRESS 0x6000A415 /end MEASUREMENT
/begin MEASUREMENT CrCUI_stTmrEndChk "Status for ACCEL/COAST timer end check" UBYTE OneToOne 1 100 0.00 255.0 FORMAT "%5.1" ECU_ADDRESS 0x6000A413 /end MEASUREMENT
/begin MEASUREMENT CrCUI_stTSRErr "Status of TSR error (CAN communication error, TSR failure, or TSR function temporary stops)" UBYTE OneToOne 1 100 0.00 255.0 FORMAT "%5.1" ECU_ADDRESS 0x6000A414 /end MEASUREMENT
/begin MEASUREMENT CrCUI_stVehUn "Status of vehicle speed unit for cruise control" UBYTE OneToOne 1 100 0.00 255.0 FORMAT "%5.1" ECU_ADDRESS 0x6000A412 /end MEASUREMENT
/begin MEASUREMENT CrCUI_swtMETTyp "Status of vehicle speed unit for CC/ASL" UBYTE OneToOne 1 100 0.00 255.0 FORMAT "%5.1" ECU_ADDRESS 0x6000A411 /end MEASUREMENT
/begin MEASUREMENT CrCUI_tiACCAppSpdChng_mp "Timer for Accel Vehicle speed display Check" SWORD Time_ms_100ms 1 100 -3276800. 3276700. FORMAT "%8.0" ECU_ADDRESS 0x70008DFA /end MEASUREMENT
/begin MEASUREMENT CrCUI_tiACCASLContnsErr_mp "Timer of ACC/ASL switch error continuous check" SWORD Time_ms 1 100 -327680.0 327670.0 FORMAT "%8.1" ECU_ADDRESS 0x70008DF8 /end MEASUREMENT
/begin MEASUREMENT CrCUI_tiACCClthCncl_mp "Timer for ACC Clutch SW Cancel Check" SWORD Time_ms 1 100 -327680.0 327670.0 FORMAT "%8.1" ECU_ADDRESS 0x70008DF6 /end MEASUREMENT
/begin MEASUREMENT CrCUI_tiACCClthUpdExtn_mp "Timer of updating clutch status extension for ACC" SWORD Time_ms 1 100 -327680.0 327670.0 FORMAT "%8.1" ECU_ADDRESS 0x70008DF4 /end MEASUREMENT
/begin MEASUREMENT CrCUI_tiACCCoaSpdChng_mp "Timer for Coast Vehicle speed display Check" SWORD Time_ms_100ms 1 100 -3276800. 3276700. FORMAT "%8.0" ECU_ADDRESS 0x70008DF2 /end MEASUREMENT
/begin MEASUREMENT CrCUI_tiACCSpdNoUpdRes_mp "Timer for Accel Vehicle speed display not update request Check" SWORD Time_ms 1 100 -327680.0 327670.0 FORMAT "%8.1" ECU_ADDRESS 0x70008DF0 /end MEASUREMENT
/begin MEASUREMENT CrCUI_tiACCSpdNoUpdSet_mp "Timer for Coast Vehicle speed display not update request Check" SWORD Time_ms 1 100 -327680.0 327670.0 FORMAT "%8.1" ECU_ADDRESS 0x70008DEE /end MEASUREMENT
/begin MEASUREMENT CrCUI_tiAutoBrkActvChk "Timer for Auto Brake Active check." SWORD Time_ms 1 100 -327680.0 327670.0 FORMAT "%8.1" ECU_ADDRESS 0x60005138 /end MEASUREMENT
/begin MEASUREMENT CrCUI_tiAYCCond_mp "Timer of AYC condition check time" SWORD Time_ms 1 100 -327680.0 327670.0 FORMAT "%8.1" ECU_ADDRESS 0x70008DEC /end MEASUREMENT
/begin MEASUREMENT CrCUI_tiCCASLMETVehUnFlt_mp "Timer of filter for CC-ASL vehicle speed unit" SWORD Time_ms 1 100 -327680.0 327670.0 FORMAT "%8.1" ECU_ADDRESS 0x70008DEA /end MEASUREMENT
/begin MEASUREMENT CrCUI_tiCrsASLSelInfo_mp "Timer of CC/ASL select information" SWORD Time_ms 1 100 -327680.0 327670.0 FORMAT "%8.1" ECU_ADDRESS 0x70008DE8 /end MEASUREMENT
/begin MEASUREMENT CrCUI_tiCrsContnsErr_mp "Timer of Cruise control switch error continuous check" SWORD Time_ms 1 100 -327680.0 327670.0 FORMAT "%8.1" ECU_ADDRESS 0x70008DE6 /end MEASUREMENT
/begin MEASUREMENT CrCUI_tiFWDpos_mp "FWD position judgement timer in CC_AT vehicles" SWORD Time_ms 1 100 -327680.0 327670.0 FORMAT "%8.1" ECU_ADDRESS 0x70008DE4 /end MEASUREMENT
/begin MEASUREMENT CrCUI_tiGearOff_mp "Timer for Gear off Check" SWORD Time_ms 1 100 -327680.0 327670.0 FORMAT "%8.1" ECU_ADDRESS 0x70008DE2 /end MEASUREMENT
/begin MEASUREMENT CrCUI_tiLSFStpJdgHysHi_mp "Timer for upper threshold for LSF stop judgement hysterisis" SWORD Time_ms 1 100 -327680.0 327670.0 FORMAT "%8.1" ECU_ADDRESS 0x70008DE0 /end MEASUREMENT
/begin MEASUREMENT CrCUI_tiLSFStpJdgHysLo_mp "Timer for lower threshold for LSF stop judgement hysterisis" SWORD Time_ms 1 100 -327680.0 327670.0 FORMAT "%8.1" ECU_ADDRESS 0x70008DDE /end MEASUREMENT
/begin MEASUREMENT CrCUI_tiMETCustInfoFlt_mp "Timer of filter for CC-ASL vehicle speed unit" SWORD Time_ms 1 100 -327680.0 327670.0 FORMAT "%8.1" ECU_ADDRESS 0x70008DDC /end MEASUREMENT
/begin MEASUREMENT CrCUI_tiResuOnSpdUpd_mp "Timre of updated vehicle speed during Res SW is on" SWORD Time_ms_100ms 1 100 -3276800. 3276700. FORMAT "%8.0" ECU_ADDRESS 0x70008DDA /end MEASUREMENT
/begin MEASUREMENT CrCUI_tiSetOnSpdUpd_mp "Timre of updated vehicle speed during Set SW is on" SWORD Time_ms_100ms 1 100 -3276800. 3276700. FORMAT "%8.0" ECU_ADDRESS 0x70008DD8 /end MEASUREMENT
/begin MEASUREMENT CrCUI_tiShftDn0Det_mp "Timer for Shift Down 0 Detect Check" SWORD Time_ms 1 100 -327680.0 327670.0 FORMAT "%8.1" ECU_ADDRESS 0x70008DD6 /end MEASUREMENT
/begin MEASUREMENT CrCUI_tiShftDn0Rls_mp "Timer for Shift Down 0 Rlease Check" SWORD Time_ms 1 100 -327680.0 327670.0 FORMAT "%8.1" ECU_ADDRESS 0x70008DD4 /end MEASUREMENT
/begin MEASUREMENT CrCUI_tiShftDn1Det_mp "Timer for Shift Down 1 Detect Check" SWORD Time_ms 1 100 -327680.0 327670.0 FORMAT "%8.1" ECU_ADDRESS 0x70008DD2 /end MEASUREMENT
/begin MEASUREMENT CrCUI_tiShftDn1Rls_mp "TTimer for Shift Down 1 Rlease Check" SWORD Time_ms 1 100 -327680.0 327670.0 FORMAT "%8.1" ECU_ADDRESS 0x70008DD0 /end MEASUREMENT
/begin MEASUREMENT CrCUI_tiShftDn2Det_mp "Timer for Shift Down 2 Detect Check" SWORD Time_ms 1 100 -327680.0 327670.0 FORMAT "%8.1" ECU_ADDRESS 0x70008DCE /end MEASUREMENT
/begin MEASUREMENT CrCUI_tiShftDn2Rls_mp "TTimer for Shift Down 2 Rlease Check" SWORD Time_ms 1 100 -327680.0 327670.0 FORMAT "%8.1" ECU_ADDRESS 0x70008DCC /end MEASUREMENT
/begin MEASUREMENT CrCUI_tiShftDn3Det_mp "Timer for Shift Down 3 Detect Check" SWORD Time_ms 1 100 -327680.0 327670.0 FORMAT "%8.1" ECU_ADDRESS 0x70008DCA /end MEASUREMENT
/begin MEASUREMENT CrCUI_tiShftDn3Rls_mp "TTimer for Shift Down 3 Rlease Check" SWORD Time_ms 1 100 -327680.0 327670.0 FORMAT "%8.1" ECU_ADDRESS 0x70008DC8 /end MEASUREMENT
/begin MEASUREMENT CrCUI_tiShftDn4Det_mp "Timer for Shift Down 4 Detect Check" SWORD Time_ms 1 100 -327680.0 327670.0 FORMAT "%8.1" ECU_ADDRESS 0x70008DC6 /end MEASUREMENT
/begin MEASUREMENT CrCUI_tiShftDn4Rls_mp "TTimer for Shift Down 4 Rlease Check" SWORD Time_ms 1 100 -327680.0 327670.0 FORMAT "%8.1" ECU_ADDRESS 0x70008DC4 /end MEASUREMENT
/begin MEASUREMENT CrCUI_tiShftDn5Det_mp "Timer for Shift Down 5 Detect Check" SWORD Time_ms 1 100 -327680.0 327670.0 FORMAT "%8.1" ECU_ADDRESS 0x70008DC2 /end MEASUREMENT
/begin MEASUREMENT CrCUI_tiSwtBrkMn_mp "Timer for Brake Main SW Check" SWORD Time_ms 1 100 -327680.0 327670.0 FORMAT "%8.1" ECU_ADDRESS 0x70008DC0 /end MEASUREMENT
/begin MEASUREMENT CrCUI_tiSwtBrkRed_mp "Timer for Brake Redundant SW Check" SWORD Time_ms 1 100 -327680.0 327670.0 FORMAT "%8.1" ECU_ADDRESS 0x70008DBE /end MEASUREMENT
/begin MEASUREMENT CrCUI_tiSwtClth_mp "Timer for Clutch SW Check" SWORD Time_ms 1 100 -327680.0 327670.0 FORMAT "%8.1" ECU_ADDRESS 0x70008DBC /end MEASUREMENT
/begin MEASUREMENT CrCUI_tiSwtResApp_mp "Timer of Accel check time for RESUME SW" SWORD Time_ms 1 100 -327680.0 327670.0 FORMAT "%8.1" ECU_ADDRESS 0x70008DBA /end MEASUREMENT
/begin MEASUREMENT CrCUI_tiSwtSetCoa_mp "Timer of coast check time for SET SW" SWORD Time_ms 1 100 -327680.0 327670.0 FORMAT "%8.1" ECU_ADDRESS 0x70008DB8 /end MEASUREMENT
/begin MEASUREMENT CrCUI_tiTSRErr_mp "Timer for detecting camera temperature abnormality,dirty and breakdown" SWORD Time_ms 1 100 -327680.0 327670.0 FORMAT "%8.1" ECU_ADDRESS 0x70008DB6 /end MEASUREMENT
/begin MEASUREMENT CrCUI_vMETSpd "Meter Vehicle Speed for Cruise Control" SLONG Vel_CrCtl 1 100 -8388608.00000 8388607.99609 FORMAT "%13.5" ECU_ADDRESS 0x60001D18 /end MEASUREMENT
/begin MEASUREMENT CrCUI_vMETSpd2 "Vehicle speed from meter panel" SLONG Vel_CrCtl 1 100 -8388608.00000 8388607.99609 FORMAT "%13.5" ECU_ADDRESS 0x60001D1C /end MEASUREMENT
/begin MEASUREMENT CtT_stDiagEna "Enable condition for the fault detection of the thermostat diagnosis" UBYTE B_TRUE 1 100 0.00 1.00000000000 BIT_MASK 0x1 FORMAT "%13.11" ECU_ADDRESS 0x60009FB2 /end MEASUREMENT
/begin MEASUREMENT CtT_stReiniMdl "Condition to reset the temperature model for the permanent diagnosis" UBYTE B_TRUE 1 100 0.00 1.00000000000 BIT_MASK 0x1 FORMAT "%13.11" ECU_ADDRESS 0x60009FB1 /end MEASUREMENT
/begin MEASUREMENT DcmDspUds_DID_requestIBChk "Internal variable to request the Info Block check internaly" UBYTE DcmDspUds_DID_requestIBChk_Cnv 1 100 0.00 2.00000000000 FORMAT "%13.11" ECU_ADDRESS 0x600006C6 /end MEASUREMENT
/begin MEASUREMENT Dcm_stCallWr "Call state of writing information into EEPROM" UBYTE OneToOne 1 100 0.00 255.0 FORMAT "%5.1" ECU_ADDRESS 0x6000A3C4 /end MEASUREMENT
/begin MEASUREMENT DCM_stCurrDiagcSession "Status message for Currently active diagnostic session" UWORD OneToOne 1 100 0.00 65535.00 FORMAT "%8.2" ECU_ADDRESS 0x60005374 /end MEASUREMENT
/begin MEASUREMENT Dcm_stEepOrder "EEPROM order state of writing information into EEPROM" UBYTE OneToOne 1 100 0.00 255.0 FORMAT "%5.1" ECU_ADDRESS 0x6000A3C3 /end MEASUREMENT
/begin MEASUREMENT I14229_rPCSDuty "The PCS duty for SDA EVAP" UBYTE rel_q0p39 1 100 0.00 99.61 FORMAT "%5.2" ECU_ADDRESS 0x700016B5 /end MEASUREMENT
/begin MEASUREMENT I14229_stSuppRst "Suppress reset flag" UBYTE OneToOne 1 100 0.00 255.0 FORMAT "%5.1" ECU_ADDRESS 0x70001BDF /end MEASUREMENT
/begin MEASUREMENT I14229_volFuCns "Fuel consumption" UWORD volFilgLvl_ml 1 100 0.00 65535.00 FORMAT "%8.2" ECU_ADDRESS 0x60003C4A /end MEASUREMENT
/begin MEASUREMENT I14229_volFuCnsTmp "Temporary fuel consumption" ULONG volgrd_q5p96Em4 1 100 0.00 2559999.99940 FORMAT "%13.5" ECU_ADDRESS 0x60001BDC /end MEASUREMENT
/begin MEASUREMENT RDBIRES_0 "Rdbi resolution bit 0" UBYTE dez 1 100 0.00 255.0 FORMAT "%5.1" ECU_ADDRESS 0x60009B7E /end MEASUREMENT
/begin MEASUREMENT RDBIRES_1 "Rdbi resolution bit 1" UBYTE dez 1 100 0.00 255.0 FORMAT "%5.1" ECU_ADDRESS 0x60009B7D /end MEASUREMENT
/begin MEASUREMENT RDBIRES_2 "Reserve Bit for RDBI with value is 2" UWORD dez 1 100 0.00 65535.00 FORMAT "%8.2" ECU_ADDRESS 0x60003C4C /end MEASUREMENT
/begin MEASUREMENT RDBIRES_4 "RDBI reserved value 0x04" UBYTE dez 1 100 0.00 255.0 FORMAT "%5.1" ECU_ADDRESS 0x60009B7C /end MEASUREMENT
/begin MEASUREMENT RDBIRES_FF "RDBI service label" UBYTE dez 1 100 0.00 255.0 FORMAT "%5.1" ECU_ADDRESS 0x60009B7B /end MEASUREMENT
/begin MEASUREMENT RDBI_FIX "RDBI service label" UBYTE dez 1 100 0.00 255.0 FORMAT "%5.1" ECU_ADDRESS 0x60009B7A /end MEASUREMENT
/begin MEASUREMENT RDBI_FIX_1 "Fixed value for RDBI" UBYTE dez 1 100 0.00 255.0 FORMAT "%5.1" ECU_ADDRESS 0x60009B79 /end MEASUREMENT
/begin MEASUREMENT RESERVED_BIT0 "reserved bit 0 flag" UBYTE dez 1 100 0.00 255.0 FORMAT "%5.1" ECU_ADDRESS 0x60009B78 /end MEASUREMENT
/begin MEASUREMENT RESERVED_BIT1 "reserved bit 1 flag" UBYTE dez 1 100 0.00 255.0 FORMAT "%5.1" ECU_ADDRESS 0x60009B77 /end MEASUREMENT
/begin MEASUREMENT SecuAcs_stSecuLvl "Status message for currently active secuirty levels" UBYTE OneToOne 1 100 0.00 255.0 FORMAT "%5.1" ECU_ADDRESS 0x600007AB /end MEASUREMENT
/begin FUNCTION CrCtl_TrqCalc "6.2.0     Cruise Control torque calculation"
 /begin DEF_CHARACTERISTIC CrCtl_vAccnDR1DwnSlp_CUR CrCtl_vAccnDR2DwnSlpCoast_CUR CrCtl_vAccnDR2DwnSlp_CUR CrCtl_vAccnDR3DwnSlpCoast_CUR CrCtl_vAccnDR3DwnSlp_CUR CrCtl_vAccnDR4DwnSlpCoast_CUR CrCtl_vAccnDR4DwnSlp_CUR CrCtl_vAccnDR5DwnSlpCoast_CUR CrCtl_vAccnDR5DwnSlp_CUR CrCtl_vAccnDR6DwnSlpCoast_CUR CrCtl_vAccnDR6DwnSlp_CUR CrCtl_vAccnDR7DwnSlpCoast_CUR CrCtl_vAccnDR7DwnSlp_CUR CrCtl_vAccnDvtDR1ACCCnclUpSlp_C CrCtl_vAccnDvtDR1ACCUpSlp_C CrCtl_vAccnDvtDR1CnclUpSlp_C CrCtl_vAccnDvtDR1UpSlp_C CrCtl_vAccnDvtDR2ACCCnclUpSlp_C CrCtl_vAccnDvtDR2ACCUpSlp_C CrCtl_vAccnDvtDR2CnclUpSlp_C CrCtl_vAccnDvtDR2UpSlp_C CrCtl_vAccnDvtDR3ACCCnclUpSlp_C CrCtl_vAccnDvtDR3ACCUpSlp_C CrCtl_vAccnDvtDR3CnclUpSlp_C CrCtl_vAccnDvtDR3UpSlp_C CrCtl_vAccnDvtDR4ACCCnclUpSlp_C CrCtl_vAccnDvtDR4ACCUpSlp_C CrCtl_vAccnDvtDR4CnclUpSlp_C CrCtl_vAccnDvtDR4UpSlp_C CrCtl_vAccnDvtDR5ACCCnclUpSlp_C CrCtl_vAccnDvtDR5ACCUpSlp_C CrCtl_vAccnDvtDR5CnclUpSlp_C CrCtl_vAccnDvtDR5UpSlp_C CrCtl_vAccnDvtDR6ACCCnclUpSlp_C CrCtl_vAccnDvtDR6ACCUpSlp_C CrCtl_vAccnDvtDR6CnclUpSlp_C CrCtl_vAccnDvtDR6UpSlp_C CrCtl_vAccnDvtDR7ACCCnclUpSlp_C CrCtl_vAccnDvtDR7ACCUpSlp_C CrCtl_vAccnDvtDR7CnclUpSlp_C CrCtl_vAccnDvtDR7UpSlp_C CrCtl_vACCRPntHysLoNTGKmh_GCUR CrCtl_vACCRPntHysLoNTG_GCUR CrCtl_vACCRPntHysLoTGKmh_GCUR CrCtl_vACCRPntHysLoTG_GCUR CrCtl_vAPPLim_AXIS CrCtl_vCmftACCRPntHysLoNTG_GCUR CrCtl_vCmftACCRPntHysLoTG_GCUR CrCtl_vCmftDLimHysHiNTG_GCUR CrCtl_vCmftDLimHysHiTG_GCUR CrCtl_vCmftDLimHysLoNTG_GCUR CrCtl_vCmftDLimHysLoTG_GCUR CrCtl_vCmftRPntHysHiNTG_GCUR CrCtl_vCmftRPntHysHiTG_GCUR CrCtl_vCmftRPntHysLoNTG_GCUR CrCtl_vCmftRPntHysLoTG_GCUR CrCtl_vContTUDvtECOff_CUR CrCtl_vContTUDvtECOn_CUR CrCtl_vContTUDvtHysECOff_CUR CrCtl_vContTUDvtHysECOn_CUR CrCtl_vContTUECOffDesInc1_MAP CrCtl_vContTUECOffDesInc2_CUR CrCtl_vContTUECOnDesInc1_MAP CrCtl_vContTUECOnDesInc2_CUR CrCtl_vDes2OffsECOff_MAP CrCtl_vDes2OffsECOn_MAP CrCtl_vDesClthOnStrtAdd_C CrCtl_vDLimHysHiNTGKmh_GCUR CrCtl_vDLimHysHiNTG_GCUR CrCtl_vDLimHysHiTGKmh_GCUR CrCtl_vDLimHysHiTG_GCUR CrCtl_vDLimHysLoNTGKmh_GCUR CrCtl_vDLimHysLoNTG_GCUR CrCtl_vDLimHysLoTGKmh_GCUR CrCtl_vDLimHysLoTG_GCUR CrCtl_vDR1DvtDwnSlp_C CrCtl_vDR1HiHysUpLimACCDnSlp_C CrCtl_vDR1HiHysUpLimUpSlp_C CrCtl_vDR1LoHysUpLimACCDnSlp_C CrCtl_vDR1LoHysUpLimUpSlp_C CrCtl_vDR2DvtDwnSlp_C CrCtl_vDR2HiHysUpLimACCDnSlp_C CrCtl_vDR2HiHysUpLimDnSlp_C CrCtl_vDR2HiHysUpLimUpSlp_C CrCtl_vDR2LoHysUpLimACCDnSlp_C CrCtl_vDR2LoHysUpLimDnSlp_C CrCtl_vDR2LoHysUpLimUpSlp_C CrCtl_vDR3DvtDwnSlp_C CrCtl_vDR3HiHysUpLimACCDnSlp_C CrCtl_vDR3HiHysUpLimDnSlp_C CrCtl_vDR3HiHysUpLimUpSlp_C CrCtl_vDR3LoHysUpLimACCDnSlp_C CrCtl_vDR3LoHysUpLimDnSlp_C CrCtl_vDR3LoHysUpLimUpSlp_C CrCtl_vDR4DvtDwnSlp_C CrCtl_vDR4HiHysUpLimACCDnSlp_C CrCtl_vDR4HiHysUpLimDnSlp_C CrCtl_vDR4HiHysUpLimUpSlp_C CrCtl_vDR4LoHysUpLimACCDnSlp_C CrCtl_vDR4LoHysUpLimDnSlp_C CrCtl_vDR4LoHysUpLimUpSlp_C CrCtl_vDR5DvtDwnSlp_C CrCtl_vDR5HiHysUpLimACCDnSlp_C CrCtl_vDR5HiHysUpLimDnSlp_C CrCtl_vDR5HiHysUpLimUpSlp_C CrCtl_vDR5LoHysUpLimACCDnSlp_C CrCtl_vDR5LoHysUpLimDnSlp_C CrCtl_vDR5LoHysUpLimUpSlp_C CrCtl_vDR6DvtDwnSlp_C CrCtl_vDR6HiHysUpLimACCDnSlp_C CrCtl_vDR6HiHysUpLimDnSlp_C CrCtl_vDR6HiHysUpLimUpSlp_C CrCtl_vDR6LoHysUpLimACCDnSlp_C CrCtl_vDR6LoHysUpLimDnSlp_C CrCtl_vDR6LoHysUpLimUpSlp_C CrCtl_vDR7DvtDwnSlp_C CrCtl_vDR7HiHysUpLimACCDnSlp_C CrCtl_vDR7HiHysUpLimDnSlp_C CrCtl_vDR7HiHysUpLimUpSlp_C CrCtl_vDR7LoHysUpLimACCDnSlp_C CrCtl_vDR7LoHysUpLimDnSlp_C CrCtl_vDR7LoHysUpLimUpSlp_C CrCtl_vECAccCtlTarAStd_GCUR CrCtl_vECDR1DvtDwnSlp_C CrCtl_vECDR2DvtDwnSlp_C CrCtl_vECDR3DvtDwnSlp_C CrCtl_vECDR4DvtDwnSlp_C CrCtl_vECDR5DvtDwnSlp_C CrCtl_vECDR6DvtDwnSlp_C CrCtl_vECDR7DvtDwnSlp_C CrCtl_vECDvtDR1UpSlp_C CrCtl_vECDvtDR2UpSlp_C CrCtl_vECDvtDR3UpSlp_C CrCtl_vECDvtDR4UpSlp_C CrCtl_vECDvtDR5UpSlp_C CrCtl_vECDvtDR6UpSlp_C CrCtl_vECDvtDR7UpSlp_C CrCtl_vEcoACCRPntHysLoNTG_GCUR CrCtl_vEcoACCRPntHysLoTG_GCUR CrCtl_vEcoDLimHysHiNTG_GCUR CrCtl_vEcoDLimHysHiTG_GCUR CrCtl_vEcoDLimHysLoNTG_GCUR CrCtl_vEcoDLimHysLoTG_GCUR CrCtl_vECOffDesInc1_MAP CrCtl_vECOffDesInc2_CUR CrCtl_vECOffDvtDwn1_C CrCtl_vECOffDvtDwn2_C CrCtl_vECOffDvtDwn3_C CrCtl_vECOffDvtDwn4_C CrCtl_vECOffDvtUp2_C CrCtl_vECOffDvtUp3_C CrCtl_vECOffDvtUp4_C CrCtl_vECOffDvtUp5_C CrCtl_vECOnDesInc1_MAP CrCtl_vECOnDesInc2_CUR CrCtl_vECOnDvtDwn1_C CrCtl_vECOnDvtDwn2_C CrCtl_vECOnDvtDwn3_C CrCtl_vECOnDvtDwn4_C CrCtl_vECOnDvtUp2_C CrCtl_vECOnDvtUp3_C CrCtl_vECOnDvtUp4_C CrCtl_vECOnDvtUp5_C CrCtl_vEcoRPntHysHiNTG_GCUR CrCtl_vEcoRPntHysHiTG_GCUR CrCtl_vEcoRPntHysLoNTG_GCUR CrCtl_vEcoRPntHysLoTG_GCUR CrCtl_vECTarAStdKmh_GCUR CrCtl_vECTarAStd_GCUR CrCtl_vFdbkArea_AX CrCtl_vFdbkArea_AXIS CrCtl_vGearDwn1UpLim_C CrCtl_vGearDwn1UpReqClr_C CrCtl_vGearDwn1UpReq_C CrCtl_vGearDwn2UpLim_C CrCtl_vGearDwn2UpReqClr_C CrCtl_vGearDwn2UpReq_C CrCtl_vGearDwn3UpLim_C CrCtl_vGearDwn3UpReqClr_C CrCtl_vGearDwn3UpReq_C CrCtl_vGearDwn4UpLim_C CrCtl_vGearDwn4UpReqClr_C CrCtl_vGearDwn4UpReq_C CrCtl_vInitOffSpdVar_C CrCtl_vLSFStrtAPP_AXIS CrCtl_vLSFStrt_C CrCtl_vResOffEndDvtCor_C CrCtl_vRPntDLimHys_AXIS CrCtl_vRPntHysHiNTGKmh_GCUR CrCtl_vRPntHysHiNTG_GCUR CrCtl_vRPntHysHiTGKmh_GCUR CrCtl_vRPntHysHiTG_GCUR CrCtl_vRPntHysLoNTGKmh_GCUR CrCtl_vRPntHysLoNTG_GCUR CrCtl_vRPntHysLoTGKmh_GCUR CrCtl_vRPntHysLoTG_GCUR CrCtl_vSpdVarDR1CnclDwnSlp_C CrCtl_vSpdVarDR2CnclDwnSlp_C CrCtl_vSpdVarDR3CnclDwnSlp_C CrCtl_vSpdVarDR4CnclDwnSlp_C CrCtl_vSpdVarDR5CnclDwnSlp_C CrCtl_vSpdVarDR6CnclDwnSlp_C CrCtl_vSpdVarDR7CnclDwnSlp_C CrCtl_vSptACCRPntHysLoNTG_GCUR CrCtl_vSptACCRPntHysLoTG_GCUR CrCtl_vSptDLimHysHiNTG_GCUR CrCtl_vSptDLimHysHiTG_GCUR CrCtl_vSptDLimHysLoNTG_GCUR CrCtl_vSptDLimHysLoTG_GCUR CrCtl_vSptRPntHysHiNTG_GCUR CrCtl_vSptRPntHysHiTG_GCUR CrCtl_vSptRPntHysLoNTG_GCUR CrCtl_vSptRPntHysLoTG_GCUR CrCtl_vTapDnInit_AXIS CrCtl_vTapUpInit_AXIS CrCtl_vThdCtOffAllwd_C CrCtl_vThdCtOffPhd_C CrCtl_vThresPla_C CrCtl_vTopGearUpLim_C CrCtl_vTrgAccnAccAdd_C CrCtl_vTrgAccnStandKmh_GCUR CrCtl_vTrgAccnStand_GCUR CrCtl_vTrgAccnStdLSF_GCUR CrCtl_vTrgVehSpdDvt_C CrCUI_stGuidDispOff_C /end DEF_CHARACTERISTIC
 FUNCTION_VERSION "6.2.0" /end FUNCTION
/begin FUNCTION CrCUI_GetUI "87.1.0    cruise control user interface"
 /begin DEF_CHARACTERISTIC CrCUI_ctACCASLSwtErr_C CrCUI_ctACCASLSwt_C CrCUI_ctATFWDPosn_C CrCUI_ctCancelSwtDeb_C CrCUI_ctCANRxErr1_C CrCUI_ctCANRxErr_C CrCUI_ctCrsSwtErr_C CrCUI_ctEAT2RxErr_C CrCUI_ctMaiSwtDeb_C CrCUI_ctSwtDeb_C CrCUI_facNeFlt_C CrCUI_flgTypTSRLimSpd_C CrCUI_nACCBrkCnclLoLim_GCUR CrCUI_nChkVal_AXIS CrCUI_nCnclLoLim_GCUR CrCUI_nCnclUpoLim_C CrCUI_nShftDnReq_GCUR CrCUI_numCrsASLForceSel_C CrCUI_numGearTrgt_CA CrCUI_numLSF_C CrCUI_numTSRErr_C CrCUI_numTSRInfo_CUR CrCUI_rGearChk0_C CrCUI_rGearChk1_C CrCUI_rGearChk2_C CrCUI_rGearChk3_C CrCUI_rGearChk4_C CrCUI_rGearChk5_C CrCUI_rNv0_C CrCUI_rNv1_C CrCUI_rNv2_C CrCUI_rNv3_C CrCUI_rNv4_C CrCUI_rNv5_C CrCUI_stASLtoISASpdLim_C CrCUI_stClthCont_C CrCUI_stClthOnNeChk_C CrCUI_stECON_C CrCUI_stFctInfo_C CrCUI_stGearDownNoLSF_C CrCUI_stGearDownNo_CA CrCUI_stIDSCmft_C CrCUI_stIDSEco_C CrCUI_stIDSSpt_C CrCUI_stISAContJdgTSRClr_CUR CrCUI_stISAtoASLbyResSet_C CrCUI_stMETSpdDspEna_C CrCUI_stMetSpdUnitSwt_C CrCUI_stShftPosChkDisbl_C CrCUI_stSimulResChk_C CrCUI_stSimulSetChk_C CrCUI_stSwtFwdPosnInfo_C CrCUI_stVehUn_C CrCUI_swtATFWDPosnCntr_C CrCUI_swtCCSpdDispEnfSeln_C CrCUI_swtCrsSwtTypSel_C CrCUI_swtMETTyp_C CrCUI_swtVehUnForceSel_C CrCUI_tiACCAppSpdChng_C CrCUI_tiACCClthCncl_C CrCUI_tiACCCoaSpdChng_C CrCUI_tiACCSpdNoUpdRes_C CrCUI_tiACCSpdNoUpdSet_C CrCUI_tiACCSwtResApp_C CrCUI_tiACCSwtSetCoa_C CrCUI_tiAutoBrkActvChk_C CrCUI_tiAYCCond_C CrCUI_tiCCASLMETVehUnFlt_C CrCUI_tiCCASLVehUnInit_C CrCUI_tiContnsErrChk_C CrCUI_tiCrsASLSelInfo_C CrCUI_tiFWDpos_C CrCUI_tiGearOff_C CrCUI_tiLSFStpJdgHysHi_C CrCUI_tiLSFStpJdgHysLo_C CrCUI_tiMETCustInfoFlt_C CrCUI_tiResuOnSpdUpd_C CrCUI_tiSetOnSpdUpd_C CrCUI_tiShftDn5Det_C CrCUI_tiShftDnDet_C CrCUI_tiShftDnRls_C CrCUI_tiSwtBrkMn_C CrCUI_tiSwtBrkRed_C CrCUI_tiSwtClth_C CrCUI_tiSwtInhb_C CrCUI_tiSwtResApp_C CrCUI_tiSwtSetCoa_C CrCUI_tiTSRErrDet_C CrCUI_vLSFStpJdgHysHi_C CrCUI_vLSFStpJdgHysLo_C /end DEF_CHARACTERISTIC
 /begin REF_CHARACTERISTIC CrCtl_facSpdUnConv_C CrCtl_numACCType_C CrCtl_numATType_C CrCtl_SwtDRnrEna_C LLim_numISAMetType_C /end REF_CHARACTERISTIC
 /begin IN_MEASUREMENT AccPed_swtDrvMod Brk_stMnRaw Brk_stRedRaw Clth2_st Com_bDigMtrUnit Com_flgEAT9Norm Com_flgEATANorm Com_numCvtGearShiftMap Com_numGearTrgt Com_stACCBrk Com_stACCSpdUnit Com_stATEnaCond Com_stCamHealDisp Com_stCvtPosnPrms Com_stDispDmdEnvCdn Com_stDispDmdSignRi Com_stEAT8Mon Com_stEATBMon Com_stECON Com_stFrmRxEna Com_stISABasSpd Com_stMonMET Com_stMonMETA Com_stMonMETL Com_stMtrCustDftReq Com_stMtrCustFlg Com_stShftInD Com_stTarSpdDisp Com_stTCamAbnormDisp Com_stTSRClrReas Com_vAnaVeh Com_vDigVeh Com_vDigVehRaw CoVMD_stSwtCCASLTqSeln CrCtl_numACCType CrCtl_stACCCond CrCtl_stACCReqNoDet CrCtl_stModeNo CrCtl_tiIGNOnVeh CrCtl_vVehCont CrC_stKey Dspl_bVelInMiles Dspl_stACCASLSwtInfo Dspl_stCrsASLSelInfo Dspl_stCrsMaiSwtInfo Dspl_stCrsSwtInfo Epm_nEng Gbx_stRvsPos LLim_stActvLmp SpdGov_nSetPLo StbIntv_bAYCIntvActv SyC_ctIrrSwOff SyC_stHistTiPostDrvMax T15_st Tra_numGear VehV_v /end IN_MEASUREMENT
 /begin OUT_MEASUREMENT CrCUI_ctResuOnSpdUpd CrCUI_ctSetOnSpdUpd CrCUI_flgAutoBrkActvChk CrCUI_flgCrCUICANRxNorm CrCUI_flgCrsCtrlShtOffEngNorm CrCUI_nEngSpd CrCUI_nFlt CrCUI_nFltDiff CrCUI_nLIDes CrCUI_numGearPosnADAS CrCUI_numLSF CrCUI_numSelMode CrCUI_numTSRLimSpd CrCUI_stACCASLSwtErrDet CrCUI_stACCBrkCnclReq CrCUI_stACCClthCont CrCUI_stACCClthOn CrCUI_stACCNoUpdReq CrCUI_stACCSpdIndTrg CrCUI_stASLMainDeb CrCUI_stASLSpdNoUpdReq CrCUI_stASLtoISASpdLim CrCUI_stATShft CrCUI_stAYCCond CrCUI_stBkupChk CrCUI_stCancelSwt CrCUI_stCANRxErr CrCUI_stCCASLVehUn CrCUI_stCCSpdDispExist CrCUI_stClthCond CrCUI_stClu CrCUI_stCmftDrvMod CrCUI_stCntFstChk CrCUI_stCrsASLSelFild CrCUI_stCrsSwtErrDet CrCUI_stCrsSwtFild CrCUI_stCvtLmap CrCUI_stEAT2RxErr CrCUI_stEcoDrvMod CrCUI_stECONActv CrCUI_stECONActvOld CrCUI_stFctInfo CrCUI_stFiSysFailCond CrCUI_stFWDPos CrCUI_stGearDownNo CrCUI_stISAContTSRClr CrCUI_stISAModeMnSW CrCUI_stISAtoASLbyResSet CrCUI_stKeyRead CrCUI_stLowGearCancel CrCUI_stLSFStpJdg CrCUI_stMainDeb CrCUI_stMETSpdDspEna CrCUI_stModeChgCncl CrCUI_stNeDnCncl CrCUI_stNeUpCncl CrCUI_stShftDnReq CrCUI_stShftPosCANErr CrCUI_stSptDrvMod CrCUI_stSwtBrkMnDeb CrCUI_stSwtBrkMnLSF CrCUI_stSwtBrkRedDeb CrCUI_stSwtBrkRedLSF CrCUI_stSwtClthDeb CrCUI_stSwtOnSpdUpd CrCUI_stSwtOpErr CrCUI_stSwtResNo CrCUI_stSwtSetNo CrCUI_stTmrEndChk CrCUI_stTSRErr CrCUI_stVehUn CrCUI_swtMETTyp CrCUI_tiAutoBrkActvChk CrCUI_vMETSpd CrCUI_vMETSpd2 /end OUT_MEASUREMENT
 /begin LOC_MEASUREMENT CrCUI_ctACCAppSpdChng_mp CrCUI_ctACCASLSwtErr_mp CrCUI_ctACCASLSwtFild_mp CrCUI_ctACCCoaSpdChng_mp CrCUI_ctATFWDPosn_mp CrCUI_ctCancelSwtDeb_mp CrCUI_ctCANRxErr1_mp CrCUI_ctCANRxErr_mp CrCUI_ctCrsSwtErr_mp CrCUI_ctCrsSwtFild_mp CrCUI_ctEAT2RxErr_mp CrCUI_ctMainSwtDeb_mp CrCUI_ctResSwtDeb_mp CrCUI_ctSetSwtDeb_mp CrCUI_flgClrEEPROM CrCUI_nACCBrkCnclLoLim_mp CrCUI_nCnclLoLim_mp CrCUI_nFltOld_mp CrCUI_nShftDnReq_mp CrCUI_rNvAbs0_mp CrCUI_rNvAbs1_mp CrCUI_rNvAbs2_mp CrCUI_rNvAbs3_mp CrCUI_rNvAbs4_mp CrCUI_rNvSubsGear5_mp CrCUI_rNv_mp CrCUI_stACCASLErrTmrIdc_mp CrCUI_stACCASLSwtFild_mp CrCUI_stACCASLSwtOld_mp CrCUI_stCCASLMETVehUnFlt_mp CrCUI_stCluOld_mp CrCUI_stCrsASLSelFildOld_mp CrCUI_stCrsASLSelRes_mp CrCUI_stCrsErrTmrIdc_mp CrCUI_stCrsSwtFildOld_mp CrCUI_stCrsSwtOld_mp CrCUI_stMaiSwtInter_mp CrCUI_stMETCustInfoFlt_mp CrCUI_stShftDnRls_mp CrCUI_stSwtBrkMnOld CrCUI_stSwtBrkRedOld CrCUI_stSwtMainDeb_mp CrCUI_stSwtResDeb_mp CrCUI_stSwtSetDeb_mp CrCUI_tiACCAppSpdChng_mp CrCUI_tiACCASLContnsErr_mp CrCUI_tiACCClthCncl_mp CrCUI_tiACCClthUpdExtn_mp CrCUI_tiACCCoaSpdChng_mp CrCUI_tiACCSpdNoUpdRes_mp CrCUI_tiACCSpdNoUpdSet_mp CrCUI_tiAYCCond_mp CrCUI_tiCCASLMETVehUnFlt_mp CrCUI_tiCrsASLSelInfo_mp CrCUI_tiCrsContnsErr_mp CrCUI_tiFWDpos_mp CrCUI_tiGearOff_mp CrCUI_tiLSFStpJdgHysHi_mp CrCUI_tiLSFStpJdgHysLo_mp CrCUI_tiMETCustInfoFlt_mp CrCUI_tiResuOnSpdUpd_mp CrCUI_tiSetOnSpdUpd_mp CrCUI_tiShftDn0Det_mp CrCUI_tiShftDn0Rls_mp CrCUI_tiShftDn1Det_mp CrCUI_tiShftDn1Rls_mp CrCUI_tiShftDn2Det_mp CrCUI_tiShftDn2Rls_mp CrCUI_tiShftDn3Det_mp CrCUI_tiShftDn3Rls_mp CrCUI_tiShftDn4Det_mp CrCUI_tiShftDn4Rls_mp CrCUI_tiShftDn5Det_mp CrCUI_tiSwtBrkMn_mp CrCUI_tiSwtBrkRed_mp CrCUI_tiSwtClth_mp CrCUI_tiSwtResApp_mp CrCUI_tiSwtSetCoa_mp CrCUI_tiTSRErr_mp /end LOC_MEASUREMENT
 FUNCTION_VERSION "87.1.0" /end FUNCTION
/begin FUNCTION CrCUI_Lib "1.1.0_2.1.0Cruise Control User interface Library functions" /begin REF_CHARACTERISTIC LLim_numISAMetType_C /end REF_CHARACTERISTIC
 /begin IN_MEASUREMENT CrCUI_stASLMainDeb CrCUI_stMainDeb Dspl_stCrsASLSelInfo Dspl_stCrsMaiSwtInfo /end IN_MEASUREMENT
 FUNCTION_VERSION "1.1.0_2.1.0" /end FUNCTION
/begin FUNCTION CtT_Ctx "1.1.0     context for thermostat diagnosis" /begin OUT_MEASUREMENT CtT_stDiagEna CtT_stReiniMdl /end OUT_MEASUREMENT FUNCTION_VERSION "1.1.0" /end FUNCTION
/begin FUNCTION DASrvLib_AdpvPosnCtrl "1.0.1     This FC provides an adaptive position controller to control an electrical actuator via h-bridge." FUNCTION_VERSION "1.0.1" /end FUNCTION
/begin FUNCTION DASrvLib_ClnVrfy "1.0.0     Clean and Verify Function" FUNCTION_VERSION "1.0.0" /end FUNCTION
/begin FUNCTION DASrvLib_DblDioEvln "1.0.0     Evaluation of two DIO inputs with error handling" FUNCTION_VERSION "1.0.0" /end FUNCTION
/begin FUNCTION DASrvLib_DiagRngChk "1.1.0     Diagnosis range check on input signal" FUNCTION_VERSION "1.1.0" /end FUNCTION
/begin FUNCTION DASrvLib_GetAdcSrc "1.0.0     Analogue input port reading with signal range check" FUNCTION_VERSION "1.0.0" /end FUNCTION
/begin FUNCTION DASrvLib_GetAdcSrcQly "1.0.0     analogue input port reading with signal range check and quality status" FUNCTION_VERSION "1.0.0" /end FUNCTION
/begin FUNCTION DASrvLib_GetAdcSwt "1.0.0     ADC reading and provison of logical switch state" FUNCTION_VERSION "1.0.0" /end FUNCTION
/begin FUNCTION DASrvLib_GetAdcSwtDiag "1.0.0     Analogue input reading, provison of logical switch state and signal diagnosis" FUNCTION_VERSION "1.0.0" /end FUNCTION
/begin FUNCTION DASrvLib_GetDioDeb "1.0.0     DIO reading and debouncing" FUNCTION_VERSION "1.0.0" /end FUNCTION
/begin FUNCTION DASrvLib_GovDvtMon "1.0.0     Governor deviation monitoring" FUNCTION_VERSION "1.0.0" /end FUNCTION
/begin FUNCTION DASrvLib_OffsDetrmLimn "1.0.1     Offset Determination" FUNCTION_VERSION "1.0.1" /end FUNCTION
/begin FUNCTION DASrvLib_OffsDetrmRefZero "1.0.0     class for calculating offset with reference to zero" FUNCTION_VERSION "1.0.0" /end FUNCTION
/begin FUNCTION DASrvLib_OffsFadeIn "1.0.0     Fade in of offset for the input signal" FUNCTION_VERSION "1.0.0" /end FUNCTION
/begin FUNCTION DASrvLib_PosnChgCntr "1.0.0     Actuator position change counter" FUNCTION_VERSION "1.0.0" /end FUNCTION
/begin FUNCTION DASrvLib_SegEndPrdn "1.0.0     Prediction of input signal to the end of segment" FUNCTION_VERSION "1.0.0" /end FUNCTION
/begin FUNCTION DASrvLib_StuckInRngChk "1.0.0     class for stuck in range check" FUNCTION_VERSION "1.0.0" /end FUNCTION
/begin FUNCTION DASrvLib_TransHndlgSwt "1.0.1     Ramp for the transition between two inputs" FUNCTION_VERSION "1.0.1" /end FUNCTION
/begin FUNCTION DcmCore_DslDsd_Appl "360.4.0_1.1.0Adaptions of DcmCore Dsl and Dsd"
 /begin DEF_CHARACTERISTIC ComDia_nMaxServCDI_C Immo_numSAID_C SecuAcs_numCustTyp3SC_C SecuAcs_numCustTyp4SC_C SecuAcs_numS1_C SecuAcs_numS2_C SecuAcs_numS3_C /end DEF_CHARACTERISTIC
 /begin IN_MEASUREMENT CoVOM_bSSEEngStopPassed Epm_nEng T15_st VehV_v /end IN_MEASUREMENT
 /begin OUT_MEASUREMENT BasSvr_bFuncTstReq DCM_stCurrDiagcSession I14229_stSuppRst SecuAcs_stSecuLvl /end OUT_MEASUREMENT
 FUNCTION_VERSION "360.4.0_1.1.0" /end FUNCTION
/begin FUNCTION DcmDspUDS_DID "258.5.0_6.16.0Configuration and Implementation of the DIDs for the DCM UDS Services (RDBI, WDBI, IOCBI)"
 /begin DEF_CHARACTERISTIC CALIBID COMDIA_TGEFN_CA EROTAN I14229DarkCurrHistMonrPrmFmt_C I14229DarkCurrHistMonrPrmLen_C I14229_DiumprDFC_CA I14229_nrFmtReqFuCnsRst_C I14229_nrStrtrCtrl_AlgTypID_C I14229_nrStrtrCtrl_DataLen_C I14229_nrVldDataLenFuCnsRst_C I14229_numCompID_CA I14229_numOilLfT_DataLen_C I14229_numProgID_CA I14229_numReWrECUID_CA I14229_numTBNAlgTypIDBak_C I14229_numTBNDatLngthBak_C I14229_RcDid0212Ena_C I14229_RcDid0213Ena_C I14229_RcDid021CEna_C I14229_stVSAEquip_C I14229_volMaxCumFuCns_C I14229_WdbiDidE81FEna_C Linappl_swtLinSdl_C /end DEF_CHARACTERISTIC
 /begin REF_CHARACTERISTIC I14229_stAutoStrtEna_C MisfDet_swtOn_C /end REF_CHARACTERISTIC
 /begin IN_MEASUREMENT AccPed_tqMapBasd ACEvpT_t ACEvpT_uRaw ActMod_trqInr AirC_stPsCmpr AirC_stSwt AirC_uAnaRawClnt AirMod_ratRelAirM Alt_iExctLim Alt_rAltExct Alt_uFinalDes APP_r APP_uRaw1 APP_uRaw2 BattU_stStabPs BattU_uSens Batt_flgBattExch Batt_flgChrgILo Batt_flgDeternDetd Batt_flgInhbSpst Batt_lMaxCnsChk Batt_lMinCnsChk Batt_qChrgCnsChkAH Batt_qCnsChkAH Batt_qDchaCnsChkAH Batt_qMaxCnsChkAH Batt_qMinCnsChkAH Batt_qSumHi Batt_qSumLo Batt_rMean Batt_stCalc Batt_stEngStopInhbn BdInt_stInhbReas BrkPed_flgISABBrkPSuffVehStill BrkPed_flgSlopeExcd BrkPed_flgVehStandStill Brk_stMn Brk_stRed B_cdmd B_deseehr_msg B_dmdsteol B_kl15_msg B_llri_msg B_mdstop B_nmax_msg B_sa_msg CEngDsT_tPID05Tstr CEngDsT_uRaw CEngUsT_t CEngUsT_t_Adp CEngUsT_uSnsr Clth2_st Clth3_st Clth_st CoEng_stStopEng CoEng_tiCranking CoEng_tiScneEngStrtPrmIdH1F ComAlt_stElecTypB ComAlt_stHiTempTypB ComAlt_stMchnTypB ComDCDC_stCSTHist ComEBS_BattID ComEBS_rBattSensCh ComEBS_uBattSens ComEBS_uBattUCO Com_bBliChrg Com_flgEbsRst Com_iBattEBS Com_lDst Com_rMeasdBattREbs Com_stISABEna Com_stPreStop Com_stShftInNeutr Com_stShftInPark Com_stShipMod Com_stSoc Com_stStSpEngStop Com_stTranStop Com_tBattEBS Com_trqAYCFDes Com_uPeak CoVeh_trqAcs CoVOM_bSSEEna CoVOM_bStopReq CoVOM_bVXSinceStrtDeb CoVOM_stISStopInhb COVOM_stNotHiAlti CoVOM_stStopReqCdn CoVOM_stStopRls CrCtl_stLmpOn CrCtl_stShutOffCode0 CrCtl_stShutOffCode1 CrCtl_stShutOffCode2 CrCtl_stShutOffCode3 CrCtl_stShutOffCode4 CrCtl_stShutOffCode5 CrCtl_stShutOffCode6 CrCtl_stShutOffCode7 CrCtl_stShutOffCode8 CrCtl_stShutOffCode9 DIUMPR_ctGenDenom DIUMPR_ctIgn DRIVE_stCurTrgMode DSMDur_ctPID21h DSMDur_ctPID31h DSMRdy_xPId1 Dspl_stCrsSwtInfo Ebs_qBliChrg Ebs_qBliDcha Ebs_qBliDchaTotDcyc Ebs_stStbIEBSByt0 Ebs_stStbIEBSByt1 Ebs_stStbIEBSByt2 Ebs_stStbIEBSByt3 Ebs_stStbIEBSByt4 Ebs_tiDurnAftIgnOffDcyc ECUSerNum EGSDCmn_flgCat1B1EnaTRngLoParl EGSDCmn_flgSeg1B1ReldParl EngTrqPtd_trqLead EngTrqPtd_trqSet EpmCaS_ctErrSig EpmCaS_ctNoSig EpmCrS_ctCaSRev_mp EpmCrS_ctErrSig Epm_nEng Epm_nEngRaw ErrLmp_stMIL ESS_bEngStopEna ExhMod_tCat1B1 FanCtl_swtTW2SnsrAvl Fan_stPs flglrs_msg fra_w_msg frm_w_msg ftead_w_msg fzabgs_w_msg fzabgzyl_w_msg Gbx_stNPos Gbx_stPNPosnDeb Gbx_stRvsPos GlbDa_lenTotDstDcycHiResl HEGO_bS2B1EnaDElec HEGO_bS2B1HtgOn HEGO_uS2B1Extd HEGO_uS2B1HiRes I14229InjTstFlg_stVal I14229iocbi_numDID I14229iocpMDA_numACGC I14229iocpMDA_numAPS I14229iocpMDA_numPSC I14229iocpMDA_numRFAN I14229iocpMDA_numVTEC I14229iocpMDA_stABV I14229iocpMDA_stACGC I14229iocpMDA_stAPS I14229iocpMDA_stPSC I14229iocpMDA_stRFAN I14229iocpMDA_stRvsLck I14229iocpMDA_stVTEC I14229iocp_numCtlSt I14229iocp_numEXE I14229iocp_numREQ I14229iocp_stAInjDAct I14229iocp_stSFTRJC I14229rcCrCtl_stLmp I14229RDBI_nOvrSpd I14229RDBI_tiOvrSpd I14229_AirC_pAnaClnt I14229_Brk_st I14229_Brk_stRed I14229_ElecLd_iEPSLoadOnly I14229_EpmCaS_ctErrSig2 I14229_EpmCrS_ctErrSig I14229_flgInhbE82E I14229_fzabgs_w I14229_fzabgzyl_w I14229_ivzabg_w I14229_lDst I14229_ml_w_msg I14229_nstat I14229_numDTCFrzFrmHi I14229_numDTCFrzFrmLo I14229_numDTCFrzFrmMid I14229_pEngSrtMin I14229_ps_w I14229_rHtgS2B1 I14229_rTrqPT I14229_stClth3 I14229_stGbxRvsPos I14229_stKSdiag I14229_stSDA I14229_stSuppRst I14229_tiInj1On I14229_tiOilFlowCompl I14229_tiSia I14229_tka I14229_tSnsrFild1 I14229_ubsq I14229_umsrln_w I14229_wdkba_w I14229_wdks_w I14229_wped1 I14229_wped2 I14229_zwist I15031_srv9_ValidCVN Ign_ia_cyl1 IKCtl_agAdpnCurr_s16 IKCtl_agKnkAvrg_s8 IKCtl_wIntgRef_au32 InjSys_dvolFumL IntkAirT_tSnsrTstr IntkAirT_uSnsr1Exprt lamsobd_w_msg longft1_w_msg lutskzyl_w_msg MisfDet_stcEmiThd MisfDet_stStcEmiStrt ofmsndkh1_w_msg ofmsndkh2_w_msg OilLfT_degOilDetern Oil_stPSwmp ora_w_msg PEnv_dataDigSens PEnv_dataDigSnsr PEnv_pRaw PIntkVUs_uRawUnFlt priobbora_msg PSP_stPs psrrff_w_msg ps_w_msg PthLead_trqInrNoMon PthSet_trqInrLtd PT_stTraType PT_trqLos pvd_w_msg rlabs_w_msg RngMod_trqDiffAdap RngMod_trqInrMinWoCtOff SecuAcs_stSecuLvl Sia_stIgnLck SrvCSwt_st Strt_stPs Strt_stTstrActv Strt_uStrtMonDia StSpSwt_st SyC_stSub T50_st tahrlsu_w_msg tateout_w_msg tatesoll_w_msg ThrVlv_flgLimpModeB1 ThrVlv_flgOffsLrnAbortB1 ThrVlv_flgOffsLrnSucB1 ThrVlv_flgRegTqRednB1 ThrVlv_flgReqFuCutOffB1 ThrVlv_ratActSens1AbsltB1_u8 ThrVlv_ratActSens1RelB1_u8 ThrVlv_ratDutyCycB1 ThrVlv_uElStopClsdSens1B1 ThrVlv_uElStopClsdSens2B1 ThrVlv_uRawSens1B1 ThrVlv_uRawSens2B1 TiEngOff_ti tmst Tra_numGear TWCD_rOSCAvrgPriB1 UEGO_iIPmpSrv1S1B1 UEGO_ratLamSrv1S1B1 VehStc_tiRtISSOffAC VehStc_tiRtISSOffBat VehStc_tiRtISSOffBrkBoost VehStc_tiRtISSOffDCDC VehStc_tiRtISSOffPwrSteer VehStc_tiRtISSOffSys VehStc_tiRtISSOffTempEng VehStc_tiRtISSOffUser VehStc_tiRtISSOffvVeh VehStc_tiRtStopSpstOn VehV_v VehV_vSens VlvLft_flgCtrlActrIntk1 VlvLft_flgFbVlvStIntk wdkba_w_msg /end IN_MEASUREMENT
 /begin OUT_MEASUREMENT I14229_rPCSDuty RDBIRES_0 RDBIRES_1 RDBIRES_2 RDBIRES_4 RDBIRES_FF RDBI_FIX RDBI_FIX_1 RESERVED_BIT0 RESERVED_BIT1 /end OUT_MEASUREMENT
 /begin LOC_MEASUREMENT DcmDspUds_DID_requestIBChk Dcm_stCallWr Dcm_stEepOrder I14229_volFuCns I14229_volFuCnsTmp /end LOC_MEASUREMENT
 FUNCTION_VERSION "258.5.0_6.16.0" /end FUNCTION
/begin COMPU_METHOD B_TRUE "" TAB_VERB "%6.3" "" COMPU_TAB_REF B_TRUE /end COMPU_METHOD
/begin COMPU_VTAB B_TRUE "" TAB_VERB 2 0 "FALSE" 1 "TRUE" /end COMPU_VTAB
/begin COMPU_METHOD DcmDspUds_DID_requestIBChk_Cnv "" TAB_VERB "%6.3" "" COMPU_TAB_REF DcmDspUds_DID_requestIBChk_Cnv /end COMPU_METHOD
/begin COMPU_VTAB DcmDspUds_DID_requestIBChk_Cnv "" TAB_VERB 3 0 "DCMDSPUDS_DID_REQUESTIBCHK_INACTIVE" 1 "DCMDSPUDS_DID_REQUESTIBCHK_REQUESTED" 2 "DCMDSPUDS_DID_REQUESTIBCHK_PERFORMED" /end COMPU_VTAB
/begin COMPU_METHOD dez "" RAT_FUNC "%6.2" "" COEFFS 0 1 0 0 0 1 /end COMPU_METHOD
/begin COMPU_METHOD DFC_Verb "" TAB_VERB "%6.3" "-" COMPU_TAB_REF DFC_Verb /end COMPU_METHOD
/begin COMPU_VTAB DFC_Verb "" TAB_VERB 704 0 "DFC_Unused" 318 "DFC_ACEvpTSRCMax" 319 "DFC_ACEvpTSRCMin" 320 "DFC_AirCClntPAnaSRCMax" 321 "DFC_AirCClntPAnaSRCMin" 259 "DFC_AirCCmprOL" 260 "DFC_AirCCmprOvrTemp" 261 "DFC_AirCCmprSCB" 262 "DFC_AirCCmprSCG" 322 "DFC_AirCSwtNpl" 323 "DFC_AirCSwtSig" 263 "DFC_AltErr" 1 "DFC_AltIOACGFailr" 2 "DFC_AltIOACGHiVltg" 3 "DFC_AltIOACGLoVltg" 4 "DFC_AltIOACGTHi" 5 "DFC_AltIODConnACG" 429 "DFC_AppAllSnsrDfct" 6 "DFC_BattUHiFailr" 7 "DFC_BattULoFailr" 264 "DFC_BattUSRCMax" 265 "DFC_BattUSRCMin" 430 "DFC_BattUStdbyDiaOL" 431 "DFC_BigLeakIntkMnfldEmiInfl" 324 "DFC_Brk" 8 "DFC_BrkBstPDriftHiErr" 9 "DFC_BrkBstPDriftLoErr" 10 "DFC_BrkBstPSnsrStuck" 11 "DFC_BrkMnSwtContOn" 432 "DFC_BrkMnSwtContOnWarnLmp" 12 "DFC_BrkMnSwtNotStp" 433 "DFC_BrkMnSwtNotStpWarnLmp" 13 "DFC_BrkNpl" 14 "DFC_BrkRdntSwtContOn" 434 "DFC_BrkRdntSwtContOnWarnLmp" 15 "DFC_BrkRdntSwtNotStp" 435 "DFC_BrkRdntSwtNotStpWarnLmp" 325 "DFC_BrkSig" 417 "DFC_BSWM_E_ACTION_FAILED" 418 "DFC_BSWM_E_INTRPTQUEUE_FULL" 393 "DFC_BusDiagCANAPPLBusOff" 394 "DFC_BusDiagCANCANCBusOff" 395 "DFC_BusDiagCANVEHICLEBusOff" 411 "DFC_CAN_E_TIMEOUT" 436 "DFC_CEngDsTColdStrtMax" 437 "DFC_CEngDsTColdStrtMin" 438 "DFC_CEngDsTImps" 439 "DFC_CEngDsTPlausLSC" 440 "DFC_CEngDsTPlausSTC" 443 "DFC_CEngDsTSig" 441 "DFC_CEngDsTSRCMax" 442 "DFC_CEngDsTSRCMin" 444 "DFC_CEngUsTSRCMax" 445 "DFC_CEngUsTSRCMin" 366 "DFC_Clth2ONStuck" 367 "DFC_Clth2ONStuckLdc" 16 "DFC_Clth3ONStuck" 368 "DFC_Clth3ONStuckLdc" 369 "DFC_Clth3ONStuckPostDrv" 17 "DFC_Clth4OFFStuck" 370 "DFC_Clth4ONStuck" 371 "DFC_Clth4ONStuckLdc" 236 "DFC_ClthMax" 336 "DFC_ClthNpl" 18 "DFC_ClthOFFStuck" 19 "DFC_ClthONStuck" 326 "DFC_ClthSig" 20 "DFC_ClthStkFailInfo" 21 "DFC_ComACFailInfo" 22 "DFC_ComATFTValErr" 23 "DFC_ComATMILReq" 24 "DFC_ComAYCAChksum" 25 "DFC_ComAYCARingCnt" 26 "DFC_ComAYCATOut" 27 "DFC_ComAYCDChkSum" 28 "DFC_ComAYCDTOut" 29 "DFC_ComAYCFChksum" 30 "DFC_ComAYCFRingCnt" 31 "DFC_ComAYCFTOut" 32 "DFC_ComAYCGChksum" 33 "DFC_ComAYCGRingCnt" 34 "DFC_ComAYCGTOut" 35 "DFC_ComAYCIChkSum" 36 "DFC_ComAYCIRingCnt" 37 "DFC_ComAYCITOut" 38 "DFC_ComBCM1ChkSum" 39 "DFC_ComBCM1RingCnt" 40 "DFC_ComBCM1TOut" 41 "DFC_ComCANABusOffErr" 42 "DFC_ComCANBBusOffErr" 43 "DFC_ComCANCBusOffErr" 44 "DFC_ComCGW1ChkSum" 45 "DFC_ComCGW1RingCnt" 46 "DFC_ComCGW1TOut" 266 "DFC_ComChksTCU1" 267 "DFC_ComChksTCU11" 268 "DFC_ComChksTCU12" 269 "DFC_ComChksTCU13" 270 "DFC_ComChksTCU2" 271 "DFC_ComChksTCU3" 272 "DFC_ComChksTCU4" 273 "DFC_ComCntTCU1" 274 "DFC_ComCntTCU11" 275 "DFC_ComCntTCU12" 276 "DFC_ComCntTCU13" 277 "DFC_ComCntTCU2" 278 "DFC_ComCntTCU3" 279 "DFC_ComCntTCU4" 47 "DFC_ComConvBoostErr" 48 "DFC_ComConvSlipErr" 372 "DFC_ComDLCTCU01" 373 "DFC_ComDLCTCU02" 374 "DFC_ComDLCTCU1" 375 "DFC_ComDLCTCU11" 376 "DFC_ComDLCTCU12" 377 "DFC_ComDLCTCU13" 378 "DFC_ComDLCTCU14" 379 "DFC_ComDLCTCU2" 380 "DFC_ComDLCTCU3" 381 "DFC_ComDLCTCU4" 49 "DFC_ComEAT10Chksum" 50 "DFC_ComEAT10RingCnt" 51 "DFC_ComEAT10TOut" 52 "DFC_ComEAT11ChkSum" 53 "DFC_ComEAT11RingCnt" 54 "DFC_ComEAT11TOut" 55 "DFC_ComEAT12ChkSum" 56 "DFC_ComEAT12RingCnt" 57 "DFC_ComEAT12TOut" 58 "DFC_ComEAT13ChkSum" 59 "DFC_ComEAT13RingCnt" 60 "DFC_ComEAT13TOut" 61 "DFC_ComEAT1Chksum" 62 "DFC_ComEAT1RingCnt" 63 "DFC_ComEAT1TOut" 64 "DFC_ComEAT2ChkSum" 65 "DFC_ComEAT2RingCnt" 66 "DFC_ComEAT2TOut" 67 "DFC_ComEAT4ChkSum" 68 "DFC_ComEAT4RingCnt" 69 "DFC_ComEAT4TOut" 70 "DFC_ComEAT6Chksum" 71 "DFC_ComEAT6RingCnt" 72 "DFC_ComEAT6TOut" 73 "DFC_ComEAT7Chksum" 74 "DFC_ComEAT7RingCnt" 75 "DFC_ComEAT7TOut" 76 "DFC_ComEAT8Chksum" 77 "DFC_ComEAT8RingCnt" 78 "DFC_ComEAT8TOut" 79 "DFC_ComEATAChksum" 80 "DFC_ComEATARingCnt" 81 "DFC_ComEATATOut" 82 "DFC_ComEATBChkSum" 83 "DFC_ComEATBRingCnt" 84 "DFC_ComEATBTOut" 85 "DFC_ComEATCChksum" 86 "DFC_ComEATCRingCnt" 87 "DFC_ComEATCTOut" 88 "DFC_ComEBBAChksum" 89 "DFC_ComEBBARingCnt" 90 "DFC_ComEBBATOut" 94 "DFC_ComEngCanRxErr" 91 "DFC_ComEPS1Chksum" 92 "DFC_ComEPS1RingCnt" 93 "DFC_ComEPS1TOut" 95 "DFC_ComGrvySnsrErr" 96 "DFC_ComGwIMG1ChkSum" 97 "DFC_ComGwIMG1RingCnt" 98 "DFC_ComGwIMG1TOut" 99 "DFC_ComGwIMG3ChkSum" 100 "DFC_ComGwIMG3RingCnt" 101 "DFC_ComGwIMG3TOut" 102 "DFC_ComGwIMG4ChkSum" 103 "DFC_ComGwIMG4RingCnt" 104 "DFC_ComGwIMG4TOut" 105 "DFC_ComGwIMG5ChkSum" 106 "DFC_ComGwIMG5RingCnt" 107 "DFC_ComGwIMG5TOut" 108 "DFC_ComGwIMG6ChkSum" 109 "DFC_ComGwIMG6RingCnt" 110 "DFC_ComGwIMG6TOut" 111 "DFC_ComIDASBChksum" 112 "DFC_ComIDASBRingCnt" 113 "DFC_ComIDASBTOut" 114 "DFC_ComIMGMILReq" 115 "DFC_ComISSPrms" 116 "DFC_ComMETAChksum" 117 "DFC_ComMETARingCnt" 118 "DFC_ComMETATOut" 119 "DFC_ComMETCChksum" 120 "DFC_ComMETCRingCnt" 121 "DFC_ComMETCTOut" 122 "DFC_ComMETDChksum" 123 "DFC_ComMETDRingCnt" 124 "DFC_ComMETDTOut" 125 "DFC_ComMETE2Chksum" 126 "DFC_ComMETE2RingCnt" 127 "DFC_ComMETE2TOut" 128 "DFC_ComMETFChksum" 129 "DFC_ComMETFRingCnt" 130 "DFC_ComMETFTOut" 131 "DFC_ComMETGChksum" 132 "DFC_ComMETGRingCnt" 133 "DFC_ComMETGTOut" 134 "DFC_ComMETH2Chksum" 135 "DFC_ComMETH2RingCnt" 136 "DFC_ComMETH2TOut" 137 "DFC_ComMETHChksum" 138 "DFC_ComMETHRingCnt" 139 "DFC_ComMETHTOut" 140 "DFC_ComMETIChksum" 141 "DFC_ComMETIRingCnt" 142 "DFC_ComMETITOut" 143 "DFC_ComMETKChksum" 144 "DFC_ComMETKRingCnt" 145 "DFC_ComMETKTOut" 146 "DFC_ComMETLChksum" 147 "DFC_ComMETLRingCnt" 148 "DFC_ComMETLTOut" 149 "DFC_ComMETMChksum" 150 "DFC_ComMETMRingCnt" 151 "DFC_ComMETMTOut" 152 "DFC_ComMETNChksum" 153 "DFC_ComMETNRingCnt" 154 "DFC_ComMETNTOut" 155 "DFC_ComMtrCom" 156 "DFC_ComPCUChkSum" 157 "DFC_ComPCURingCnt" 158 "DFC_ComPCUTOut" 159 "DFC_ComSRSAChksum" 160 "DFC_ComSRSARingCnt" 161 "DFC_ComSRSATOut" 162 "DFC_ComSRSBChksum" 163 "DFC_ComSRSBRingCnt" 164 "DFC_ComSRSBTOut" 165 "DFC_ComSRSChksum" 166 "DFC_ComSRSErr" 167 "DFC_ComSRSRingCnt" 168 "DFC_ComSRSTOut" 280 "DFC_ComTOutTCU01" 281 "DFC_ComTOutTCU02" 282 "DFC_ComTOutTCU1" 283 "DFC_ComTOutTCU11" 284 "DFC_ComTOutTCU12" 285 "DFC_ComTOutTCU13" 286 "DFC_ComTOutTCU14" 287 "DFC_ComTOutTCU2" 288 "DFC_ComTOutTCU3" 289 "DFC_ComTOutTCU4" 169 "DFC_ComVehSpdPndFltTCU" 446 "DFC_DCDCFltDet" 290 "DFC_DevLibBattUHi" 291 "DFC_DevLibBattULo" 449 "DFC_DKnpl" 447 "DFC_DKRSA" 448 "DFC_DKVSmax" 450 "DFC_DSSmax" 451 "DFC_DSTTI" 452 "DFC_DSUmax" 170 "DFC_EbsChartcCurrErr" 171 "DFC_EbsSelfDiagErr" 383 "DFC_EbsSocFlt" 453 "DFC_EGRVlvOL" 454 "DFC_EGRVlvSCB" 455 "DFC_EGRVlvSCG" 456 "DFC_EGSDUS2B1LtrDly" 457 "DFC_EGSDUS2B1LtrPT1" 458 "DFC_EGSDUS2B1RtlDly" 459 "DFC_EGSDUS2B1RtlPT1" 460 "DFC_EGSDUS2B1TarLean" 461 "DFC_EGSDUS2B1TarRich" 464 "DFC_EngICO" 465 "DFC_EngPrtOvrSpdMon" 466 "DFC_EpmCaSI1ErrSig" 467 "DFC_EpmCaSI1NoSig" 468 "DFC_EpmCaSI1OfsErr" 469 "DFC_EpmCrSErrSig" 470 "DFC_EpmCrSNoSig" 471 "DFC_EtaEngIdleNonCsers" 472 "DFC_EtaEngPtlNonCsers" 462 "DFC_ETAKHLmax" 463 "DFC_ETAKHTmax" 337 "DFC_EV1max" 338 "DFC_EV1min" 339 "DFC_EV1sig" 340 "DFC_EV2max" 341 "DFC_EV2min" 342 "DFC_EV2sig" 343 "DFC_EV3max" 344 "DFC_EV3min" 345 "DFC_EV3sig" 346 "DFC_EV4max" 347 "DFC_EV4min" 348 "DFC_EV4sig" 382 "DFC_EVX" 292 "DFC_FanDIOOL_0" 293 "DFC_FanDIOOL_1" 294 "DFC_FanDIOOvrTemp_0" 295 "DFC_FanDIOOvrTemp_1" 296 "DFC_FanDIOSCB_0" 297 "DFC_FanDIOSCB_1" 298 "DFC_FanDIOSCG_0" 299 "DFC_FanDIOSCG_1" 473 "DFC_FRAmax" 474 "DFC_FRAmin" 172 "DFC_GbxCANDigPlausErr" 173 "DFC_GbxNPos1SRCMax" 174 "DFC_GbxNPos1SRCMin" 175 "DFC_GbxNPos2SRCMax" 176 "DFC_GbxNPos2SRCMin" 177 "DFC_GbxNPosAlvChk" 178 "DFC_GbxNPosSyncErr" 349 "DFC_GbxPNPosnDrvCdn" 350 "DFC_GbxPNPosnPlausy" 475 "DFC_GbxRvsSwtStk" 476 "DFC_HDRmax" 477 "DFC_HEGOS2B1ElecMax" 478 "DFC_HEGOS2B1ElecMin" 479 "DFC_HEGOS2B1ElecSig" 480 "DFC_HEGOS2B1HtgNpl" 179 "DFC_HEGOS2B1HtrPsMax" 180 "DFC_HEGOS2B1HtrPsMin" 181 "DFC_HEGOS2B1HtrPsSig" 327 "DFC_HLSDemOvhtEngLim" 384 "DFC_I14229VINErr" 237 "DFC_IgnClPs_DevComErr" 238 "DFC_IgnClPs_LineOl_0" 239 "DFC_IgnClPs_LineOl_1" 240 "DFC_IgnClPs_LineOl_2" 241 "DFC_IgnClPs_LineOl_3" 242 "DFC_IgnClPs_LineScb_0" 243 "DFC_IgnClPs_LineScb_1" 244 "DFC_IgnClPs_LineScb_2" 245 "DFC_IgnClPs_LineScb_3" 246 "DFC_IgnClPs_LineScg_0" 247 "DFC_IgnClPs_LineScg_1" 248 "DFC_IgnClPs_LineScg_2" 249 "DFC_IgnClPs_LineScg_3" 481 "DFC_IntkAirTIntkMnfldCrssMax" 482 "DFC_IntkAirTIntkMnfldCrssMin" 483 "DFC_IntkAirTIntkMnfldHSCMax" 484 "DFC_IntkAirTIntkMnfldImps" 485 "DFC_IntkAirTIntkMnfldPRCMax" 486 "DFC_IntkAirTIntkMnfldPRCMin" 487 "DFC_IntkAirTIntkMnfldSRCMax" 488 "DFC_IntkAirTIntkMnfldSRCMin" 489 "DFC_IntkAirTIntkMnfldSTC" 362 "DFC_KnDetSens1PortAMax" 363 "DFC_KnDetSens1PortAMin" 364 "DFC_KnDetSens1PortBMax" 365 "DFC_KnDetSens1PortBMin" 490 "DFC_KS1max" 491 "DFC_KS1min" 494 "DFC_LamDynDiagS1B1" 495 "DFC_LeakIntkMnfldEmiInfl" 412 "DFC_LIN_E_TIMEOUT" 182 "DFC_LinCSErrACG" 183 "DFC_LinCSErrEBS" 184 "DFC_LinHdrTimeoutErrACG" 185 "DFC_LinHdrTimeoutErrEBS" 186 "DFC_LinMsgTimeoutErrACG" 187 "DFC_LinMsgTimeoutErrEBS" 188 "DFC_LinNoStrtComErr" 385 "DFC_LLRKHmax" 386 "DFC_LLRKHmin" 387 "DFC_LLRmax" 388 "DFC_LLRmin" 492 "DFC_LMmax" 493 "DFC_LZSRnpl" 496 "DFC_MD00max" 497 "DFC_MDBmax" 498 "DFC_MDCat" 499 "DFC_MDCatCrit" 500 "DFC_MDCatCurr" 501 "DFC_MDCyl_0" 502 "DFC_MDCyl_1" 503 "DFC_MDCyl_2" 504 "DFC_MDCyl_3" 505 "DFC_MDEmi" 506 "DFC_MDEmiStrt" 507 "DFC_MDFco" 510 "DFC_MDmax" 508 "DFC_MDMpl" 509 "DFC_MDSegTiAdpn" 205 "DFC_MisfDetdVWhlFrntLePlaus" 206 "DFC_MisfDetdVWhlFrntRiPlaus" 207 "DFC_MisfDetdVWhlReLePlaus" 208 "DFC_MisfDetdVWhlReRiPlaus" 189 "DFC_MisfDetVWhlFrntLeOORHi" 190 "DFC_MisfDetVWhlFrntLeRatyHi" 191 "DFC_MisfDetVWhlFrntLeRatyLo" 192 "DFC_MisfDetVWhlFrntLeStuck" 193 "DFC_MisfDetVWhlFrntRiOORHi" 194 "DFC_MisfDetVWhlFrntRiRatyHi" 195 "DFC_MisfDetVWhlFrntRiRatyLo" 196 "DFC_MisfDetVWhlFrntRiStuck" 197 "DFC_MisfDetVWhlReLeOORHi" 198 "DFC_MisfDetVWhlReLeRatyHi" 199 "DFC_MisfDetVWhlReLeRatyLo" 200 "DFC_MisfDetVWhlReLeStuck" 201 "DFC_MisfDetVWhlReRiOORHi" 202 "DFC_MisfDetVWhlReRiRatyHi" 203 "DFC_MisfDetVWhlReRiRatyLo" 204 "DFC_MisfDetVWhlReRiStuck" 605 "DFC_MoCADCNTP" 606 "DFC_MoCADCTst" 607 "DFC_MoCSOPICO" 609 "DFC_MoFAirFilgPrdc" 610 "DFC_MoFAirFlCtOffPfi" 611 "DFC_MoFAirFlCylPfi" 612 "DFC_MoFAirFlIn" 613 "DFC_MoFAirFlMixCtlPfiChkAirFl" 614 "DFC_MoFAirFlMixCtlPfiChkCtrl" 615 "DFC_MoFAirFlMode" 608 "DFC_MoFAPP" 616 "DFC_MoFESpd" 617 "DFC_MoFIACo" 618 "DFC_MoFICOL1" 619 "DFC_MoFICOL2" 620 "DFC_MoFStrt" 621 "DFC_MoFTrqCmp" 622 "DFC_MoFTrqCmpMax" 623 "DFC_MoFTrqCmpMin" 624 "DFC_MoFVarPostBldSel" 511 "DFC_MOXEMM_SMU_ALM0_0" 512 "DFC_MOXEMM_SMU_ALM0_1" 513 "DFC_MOXEMM_SMU_ALM0_10" 514 "DFC_MOXEMM_SMU_ALM0_11" 515 "DFC_MOXEMM_SMU_ALM0_13" 516 "DFC_MOXEMM_SMU_ALM0_14" 517 "DFC_MOXEMM_SMU_ALM0_2" 518 "DFC_MOXEMM_SMU_ALM0_22" 519 "DFC_MOXEMM_SMU_ALM0_23" 520 "DFC_MOXEMM_SMU_ALM0_4" 521 "DFC_MOXEMM_SMU_ALM0_5" 522 "DFC_MOXEMM_SMU_ALM0_7" 523 "DFC_MOXEMM_SMU_ALM0_8" 524 "DFC_MOXEMM_SMU_ALM10_16" 525 "DFC_MOXEMM_SMU_ALM10_17" 526 "DFC_MOXEMM_SMU_ALM10_21" 527 "DFC_MOXEMM_SMU_ALM11_0" 528 "DFC_MOXEMM_SMU_ALM11_1" 529 "DFC_MOXEMM_SMU_ALM11_2" 530 "DFC_MOXEMM_SMU_ALM11_3" 531 "DFC_MOXEMM_SMU_ALM11_4" 532 "DFC_MOXEMM_SMU_ALM11_5" 533 "DFC_MOXEMM_SMU_ALM11_8" 534 "DFC_MOXEMM_SMU_ALM11_9" 535 "DFC_MOXEMM_SMU_ALM1_0" 536 "DFC_MOXEMM_SMU_ALM1_1" 537 "DFC_MOXEMM_SMU_ALM1_10" 538 "DFC_MOXEMM_SMU_ALM1_11" 539 "DFC_MOXEMM_SMU_ALM1_13" 540 "DFC_MOXEMM_SMU_ALM1_14" 541 "DFC_MOXEMM_SMU_ALM1_2" 542 "DFC_MOXEMM_SMU_ALM1_22" 543 "DFC_MOXEMM_SMU_ALM1_23" 544 "DFC_MOXEMM_SMU_ALM1_4" 545 "DFC_MOXEMM_SMU_ALM1_5" 546 "DFC_MOXEMM_SMU_ALM1_7" 547 "DFC_MOXEMM_SMU_ALM1_8" 548 "DFC_MOXEMM_SMU_ALM21_0" 549 "DFC_MOXEMM_SMU_ALM21_16" 550 "DFC_MOXEMM_SMU_ALM21_3" 551 "DFC_MOXEMM_SMU_ALM2_1" 552 "DFC_MOXEMM_SMU_ALM2_10" 553 "DFC_MOXEMM_SMU_ALM2_11" 554 "DFC_MOXEMM_SMU_ALM2_13" 555 "DFC_MOXEMM_SMU_ALM2_14" 556 "DFC_MOXEMM_SMU_ALM2_22" 557 "DFC_MOXEMM_SMU_ALM2_23" 558 "DFC_MOXEMM_SMU_ALM2_4" 559 "DFC_MOXEMM_SMU_ALM2_5" 560 "DFC_MOXEMM_SMU_ALM2_7" 561 "DFC_MOXEMM_SMU_ALM2_8" 562 "DFC_MOXEMM_SMU_ALM6_0" 563 "DFC_MOXEMM_SMU_ALM6_11" 564 "DFC_MOXEMM_SMU_ALM6_12" 565 "DFC_MOXEMM_SMU_ALM6_14" 566 "DFC_MOXEMM_SMU_ALM6_15" 567 "DFC_MOXEMM_SMU_ALM6_17" 568 "DFC_MOXEMM_SMU_ALM6_18" 569 "DFC_MOXEMM_SMU_ALM6_20" 570 "DFC_MOXEMM_SMU_ALM6_21" 571 "DFC_MOXEMM_SMU_ALM6_25" 572 "DFC_MOXEMM_SMU_ALM6_4" 573 "DFC_MOXEMM_SMU_ALM6_5" 574 "DFC_MOXEMM_SMU_ALM6_7" 575 "DFC_MOXEMM_SMU_ALM6_8" 576 "DFC_MOXEMM_SMU_ALM7_1" 577 "DFC_MOXEMM_SMU_ALM7_12" 578 "DFC_MOXEMM_SMU_ALM7_13" 579 "DFC_MOXEMM_SMU_ALM7_14" 580 "DFC_MOXEMM_SMU_ALM7_15" 581 "DFC_MOXEMM_SMU_ALM7_16" 582 "DFC_MOXEMM_SMU_ALM7_17" 583 "DFC_MOXEMM_SMU_ALM7_2" 584 "DFC_MOXEMM_SMU_ALM7_20" 585 "DFC_MOXEMM_SMU_ALM7_25" 586 "DFC_MOXEMM_SMU_ALM7_26" 587 "DFC_MOXEMM_SMU_ALM7_28" 588 "DFC_MOXEMM_SMU_ALM7_29" 589 "DFC_MOXEMM_SMU_ALM7_30" 590 "DFC_MOXEMM_SMU_ALM7_31" 591 "DFC_MOXEMM_SMU_ALM8_0" 592 "DFC_MOXEMM_SMU_ALM8_1" 593 "DFC_MOXEMM_SMU_ALM8_10" 594 "DFC_MOXEMM_SMU_ALM8_11" 595 "DFC_MOXEMM_SMU_ALM8_12" 596 "DFC_MOXEMM_SMU_ALM8_16" 597 "DFC_MOXEMM_SMU_ALM8_18" 598 "DFC_MOXEMM_SMU_ALM8_2" 599 "DFC_MOXEMM_SMU_ALM8_3" 600 "DFC_MOXEMM_SMU_ALM8_31" 601 "DFC_MOXEMM_SMU_ALM8_4" 602 "DFC_MOXEMM_SMU_ALM9_0" 603 "DFC_MOXEMM_SMU_ALM9_15" 604 "DFC_MOXEMM_SMU_ALM9_3" 625 "DFC_MoXEMMHwLTMCUFW" 626 "DFC_MoXEMMHwLTMonBIST" 627 "DFC_MoXEMMHwLTRegMonTest" 628 "DFC_MoXEMMHwLTStbySMUAlvTest" 629 "DFC_MoXEMMHwLTTempSens" 630 "DFC_MoXEMMHwLTUCBCfg" 300 "DFC_MRlyDcOL" 301 "DFC_MRlyDcSCB" 302 "DFC_MRlyDcSCG" 413 "DFC_MRlyOL" 414 "DFC_MRlySCB" 415 "DFC_MRlySCG" 631 "DFC_OCWDAABEActv" 632 "DFC_OCWDACom" 633 "DFC_OCWDAErrPin" 634 "DFC_OCWDAOvrVltg" 328 "DFC_OilPNpl" 635 "DFC_ORAmax" 636 "DFC_ORAmin" 647 "DFC_P_VSE11_OL" 648 "DFC_P_VSE11_SCB" 649 "DFC_P_VSE11_SCG" 351 "DFC_PEnvCcMax" 352 "DFC_PEnvCcMin" 353 "DFC_PEnvRngChkMax" 354 "DFC_PEnvRngChkMin" 209 "DFC_PEnvSigRngMax" 210 "DFC_PEnvSigRngMin" 355 "DFC_PEnvSnsrPlaus" 650 "DFC_PhyHighAPP1" 651 "DFC_PhyHighAPP2" 652 "DFC_PhyLowAPP1" 653 "DFC_PhyLowAPP2" 329 "DFC_PIntkVUsLineHiB1" 330 "DFC_PIntkVUsLineLoB1" 637 "DFC_PLLSUmax" 638 "DFC_PLLSUmin" 303 "DFC_PSPOL" 304 "DFC_PSPOvrTemp" 305 "DFC_PSPSCB" 306 "DFC_PSPSCG" 639 "DFC_PSR1max" 640 "DFC_PSRBmax" 641 "DFC_PSRBmin" 645 "DFC_PSRmax" 642 "DFC_PSRPmax" 643 "DFC_PSRPmin" 644 "DFC_PSRPsig" 646 "DFC_PUmax" 396 "DFC_RBA_IODIAGPWR_rba_IoExtCy329_SignalVltSply_0" 397 "DFC_RBA_IODIAGPWR_rba_IoExtCy329_SignalVltSply_0OT" 398 "DFC_RBA_IODIAGPWR_rba_IoExtCy329_SignalVltSply_0OV" 399 "DFC_RBA_IODIAGPWR_rba_IoExtCy329_SignalVltSply_0SCG" 400 "DFC_RBA_IODIAGPWR_rba_IoExtCy329_SignalVltSply_0UV" 401 "DFC_RBA_IODIAGPWR_rba_IoExtCy329_SignalVltSply_1" 402 "DFC_RBA_IODIAGPWR_rba_IoExtCy329_SignalVltSply_1OT" 403 "DFC_RBA_IODIAGPWR_rba_IoExtCy329_SignalVltSply_1OV" 404 "DFC_RBA_IODIAGPWR_rba_IoExtCy329_SignalVltSply_1SCG" 405 "DFC_RBA_IODIAGPWR_rba_IoExtCy329_SignalVltSply_1UV" 406 "DFC_RBA_IODIAGPWR_rba_IoExtCy329_SignalVltSply_2" 407 "DFC_RBA_IODIAGPWR_rba_IoExtCy329_SignalVltSply_2OT" 408 "DFC_RBA_IODIAGPWR_rba_IoExtCy329_SignalVltSply_2OV" 409 "DFC_RBA_IODIAGPWR_rba_IoExtCy329_SignalVltSply_2SCG" 410 "DFC_RBA_IODIAGPWR_rba_IoExtCy329_SignalVltSply_2UV" 419 "DFC_RBA_IOEXTLIB_KEEPALIVE_DRV" 420 "DFC_RBA_IOEXTLIB_KEEPALIVE_INI" 421 "DFC_rba_IoSigRtc_StopCounter" 423 "DFC_rba_MemDiag_MemReadErr" 424 "DFC_rba_MemDiag_MemWrErr" 422 "DFC_rba_MRly_Diag_Stk_Event" 416 "DFC_rba_MultiStackTrace_Threshold" 425 "DFC_rba_SyC_IrrSwOffTrigEngRun_Event" 426 "DFC_rba_T15_Diag_ComInVld_Event" 427 "DFC_rba_T15_Diag_ComOff_HwOn_Event" 428 "DFC_rba_T15_Diag_ComOn_HwOff_Event" 389 "DFC_RoughRoad" 390 "DFC_SiaEEPRdErr" 391 "DFC_SiaEEPWrngCod" 654 "DFC_SRCHighAPP1" 655 "DFC_SRCHighAPP2" 656 "DFC_SRCLowAPP1" 657 "DFC_SRCLowAPP2" 658 "DFC_SSpMon2" 211 "DFC_StmFault" 213 "DFC_StrtCtlErr" 212 "DFC_StrtCtOffPth" 214 "DFC_StrtFault" 215 "DFC_StrtLckJudg1" 216 "DFC_StrtLckJudg2" 217 "DFC_StrtOL" 218 "DFC_StrtOL2" 219 "DFC_StrtSCB" 220 "DFC_StrtSCB2" 221 "DFC_StrtSCG" 222 "DFC_StrtSCG2" 223 "DFC_StrtStkRly1" 224 "DFC_StrtStkRly2" 659 "DFC_SWReset_0" 660 "DFC_SWReset_1" 661 "DFC_SWReset_2" 662 "DFC_SyncAPP" 307 "DFC_T50Err" 663 "DFC_TAmax_Dummy" 225 "DFC_TEVEmax" 226 "DFC_TEVEmin" 227 "DFC_TEVEsig" 671 "DFC_ThrVlvClsdPosnFirstOffsLrnImpoB1" 672 "DFC_ThrVlvClsdPosnOffsLrnImpoB1" 673 "DFC_ThrVlvClsdPosnOffsLrnMaxB1" 674 "DFC_ThrVlvClsdPosnOffsLrnMinB1" 675 "DFC_ThrVlvCtrlDeB1" 676 "DFC_ThrVlvDycB1" 677 "DFC_ThrVlvLimpAirPosnMaxAbsltDriftB1" 678 "DFC_ThrVlvLimpAirPosnMaxB1" 679 "DFC_ThrVlvLimpAirPosnMaxRelDriftB1" 680 "DFC_ThrVlvLimpAirPosnMinB1" 308 "DFC_ThrVlvLoBattB1" 681 "DFC_ThrVlvOpenLoadB1" 682 "DFC_ThrVlvOpenSprgB1" 683 "DFC_ThrVlvOpenSprgSprdB1" 684 "DFC_ThrVlvOpenSprgTwnB1" 685 "DFC_ThrVlvOverTB1" 686 "DFC_ThrVlvRetSprgB1" 687 "DFC_ThrVlvRetSprgSprdB1" 688 "DFC_ThrVlvRetSprgTwnB1" 689 "DFC_ThrVlvSens1MaxB1" 696 "DFC_ThrvlvSens1MinB1" 690 "DFC_ThrVlvSens1NplB1" 691 "DFC_ThrVlvSens2MaxB1" 692 "DFC_ThrVlvSens2MinB1" 693 "DFC_ThrVlvSens2NplB1" 694 "DFC_ThrVlvShoCircB1" 695 "DFC_ThrVlvSpiErrB1" 697 "DFC_TiOffTBasdChkFast" 698 "DFC_TiOffTBasdChkSlow" 664 "DFC_TKAEmax" 665 "DFC_TKAEmin" 666 "DFC_TKARmax" 667 "DFC_TKARnpl" 668 "DFC_TMmax_Dummy" 669 "DFC_TUMmax_Dummy" 670 "DFC_TWCDPriCatB1" 250 "DFC_UEGOASICS1B1" 392 "DFC_UegoDummy" 699 "DFC_UEGOHeatrCtlS1B1" 356 "DFC_UEGOHeatrPsS1B1Max" 357 "DFC_UEGOHeatrPsS1B1Min" 358 "DFC_UEGOHeatrPsS1B1Sig" 359 "DFC_UEGOHeatrRlyPsOLS1B1" 360 "DFC_UEGOHeatrRlyPsSCBS1B1" 361 "DFC_UEGOHeatrRlyPsSCGS1B1" 257 "DFC_UegoOlApesS1B1" 251 "DFC_UEGOOLIPES1B1" 258 "DFC_UegoOlRCmpS1B1" 252 "DFC_UEGOOLRES1B1" 253 "DFC_UEGOSCBS1B1" 254 "DFC_UEGOSCGS1B1" 700 "DFC_UEGOSnsrMntdS1B1" 256 "DFC_UEGOSnsrS1B1" 255 "DFC_UEGOSPIS1B1" 228 "DFC_VehVAllPlaus" 229 "DFC_VehVNCSnsrElecFailr" 309 "DFC_VehVPhysRngHi" 331 "DFC_VehVPhysRngLo" 230 "DFC_VehVPlausCan" 231 "DFC_VehVPlausFco" 232 "DFC_VehVPlausPwr" 233 "DFC_VehVPlausV2N" 310 "DFC_VehVSclOutOL" 311 "DFC_VehVSclOutOT" 312 "DFC_VehVSclOutSCB" 313 "DFC_VehVSclOutSCG" 701 "DFC_VehVSig" 332 "DFC_VehVSigCan" 333 "DFC_VehVSigCanSafe" 314 "DFC_VehVSnsrARngHi" 315 "DFC_VehVSnsrBRngHi" 316 "DFC_VehVSpdRtyDiag" 234 "DFC_VehVSpdSnsrAElecFailr" 235 "DFC_VehVSpdSnsrBElecFailr" 317 "DFC_VehVWhlErr" 334 "DFC_VlvLftFbOilPSnsrIntk11SRCMax" 335 "DFC_VlvLftFbOilPSnsrIntk11SRCMin" 702 "DFC_VlvLftFbSwtIntk11SpclFail" 703 "DFC_VlvLftFbSwtIntk11StdFail" DEFAULT_VALUE "---" /end COMPU_VTAB
/begin COMPU_METHOD ECUOFF_TMR_SY_Compu "" TAB_VERB "%6.3" "" COMPU_TAB_REF ECUOFF_TMR_SY_Compu /end COMPU_METHOD
/begin COMPU_VTAB ECUOFF_TMR_SY_Compu "" TAB_VERB 7 0 "0" 1 "1" 2 "2" 3 "3" 4 "4" 5 "5" 6 "6" /end COMPU_VTAB
/begin COMPU_METHOD ECUTYP_SC_Compu "" TAB_VERB "%6.3" "" COMPU_TAB_REF ECUTYP_SC_Compu /end COMPU_METHOD
/begin COMPU_VTAB ECUTYP_SC_Compu "" TAB_VERB 8 0 "EngEcu" 1 "InvrEcu" 2 "VehEcu" 3 "BattEcu" 4 "DosECU" 6 "PmpECU" 7 "TCMEcu" 8 "FuCellEcu" /end COMPU_VTAB
/begin COMPU_METHOD ECU_GENR_SY_Compu "" TAB_VERB "%6.3" "" COMPU_TAB_REF ECU_GENR_SY_Compu /end COMPU_METHOD
/begin COMPU_VTAB ECU_GENR_SY_Compu "" TAB_VERB 8 0 "Mx7" 1 "Mx9" 2 "Mx17" 3 "EDC17" 4 "VMx17" 5 "DCU17" 6 "MDG1C" 7 "MDG2" /end COMPU_VTAB
/begin COMPU_METHOD EffGrad "" RAT_FUNC "%7.6" "1/s" COEFFS 0 10000 0 0 0 1 /end COMPU_METHOD
/begin COMPU_METHOD EffGradAr "" RAT_FUNC "%8.7" "1/s" COEFFS 0 100000 0 0 0 1 /end COMPU_METHOD
/begin COMPU_METHOD EffGradPrc "" RAT_FUNC "%8.7" "1/s" COEFFS 0 819200 0 0 0 1 /end COMPU_METHOD
/begin COMPU_METHOD EGRCAMSFT_SC_Compu "" RAT_FUNC "%6.2" "" COEFFS 0 1 0 0 0 1 /end COMPU_METHOD
/begin COMPU_METHOD EGRCLGPRS_SY_Compu "" TAB_VERB "%6.3" "" COMPU_TAB_REF EGRCLGPRS_SY_Compu /end COMPU_METHOD
/begin COMPU_VTAB EGRCLGPRS_SY_Compu "" TAB_VERB 2 0 "False" 1 "True" /end COMPU_VTAB
/begin COMPU_METHOD EGREVAPRUSFLDP_TYPAVL_SC_Compu "" TAB_VERB "%6.3" "" COMPU_TAB_REF EGREVAPRUSFLDP_TYPAVL_SC_Compu /end COMPU_METHOD
/begin COMPU_VTAB EGREVAPRUSFLDP_TYPAVL_SC_Compu "" TAB_VERB 2 0 "False" 1 "True" /end COMPU_VTAB
/begin COMPU_METHOD EGRFROMEXHMNFLDFORCHRGSYS_SC_Compu "" TAB_VERB "%6.3" "" COMPU_TAB_REF EGRFROMEXHMNFLDFORCHRGSYS_SC_Compu /end COMPU_METHOD
/begin COMPU_VTAB EGRFROMEXHMNFLDFORCHRGSYS_SC_Compu "" TAB_VERB 2 0 "False" 1 "True" /end COMPU_VTAB
/begin COMPU_METHOD EGRHPMIXPOSN_SC_Compu "" TAB_VERB "%6.3" "" COMPU_TAB_REF EGRHPMIXPOSN_SC_Compu /end COMPU_METHOD
/begin COMPU_VTAB EGRHPMIXPOSN_SC_Compu "" TAB_VERB 2 0 "0" 1 "1" /end COMPU_VTAB
/begin COMPU_METHOD EGRLPPRS_SY_Compu "" TAB_VERB "%6.3" "" COMPU_TAB_REF EGRLPPRS_SY_Compu /end COMPU_METHOD
/begin COMPU_VTAB EGRLPPRS_SY_Compu "" TAB_VERB 2 0 "FALSE" 1 "TRUE" /end COMPU_VTAB
/begin COMPU_METHOD EGRVLVAIRACTR_SC_Compu "" TAB_VERB "%6.3" "" COMPU_TAB_REF EGRVLVAIRACTR_SC_Compu /end COMPU_METHOD
/begin COMPU_VTAB EGRVLVAIRACTR_SC_Compu "" TAB_VERB 2 0 "False" 1 "True" /end COMPU_VTAB
/begin COMPU_METHOD EGRVLVCOOLG_SC_Compu "" TAB_VERB "%6.3" "" COMPU_TAB_REF EGRVLVCOOLG_SC_Compu /end COMPU_METHOD
/begin COMPU_VTAB EGRVLVCOOLG_SC_Compu "" TAB_VERB 2 0 "NOT_COOLED" 1 "COOLANT" /end COMPU_VTAB
/begin COMPU_METHOD EGRVLVINSDT_TYPAVL_SC_Compu "" TAB_VERB "%6.3" "" COMPU_TAB_REF EGRVLVINSDT_TYPAVL_SC_Compu /end COMPU_METHOD
/begin COMPU_VTAB EGRVLVINSDT_TYPAVL_SC_Compu "" TAB_VERB 2 0 "False" 1 "True" /end COMPU_VTAB
/begin COMPU_METHOD EGRVLVI_TYPAVL_SC_Compu "" TAB_VERB "%6.3" "" COMPU_TAB_REF EGRVLVI_TYPAVL_SC_Compu /end COMPU_METHOD
/begin COMPU_VTAB EGRVLVI_TYPAVL_SC_Compu "" TAB_VERB 2 0 "False" 1 "True" /end COMPU_VTAB
/begin COMPU_METHOD EGRVLVLPI_TYPAVL_SC_Compu "" TAB_VERB "%6.3" "" COMPU_TAB_REF EGRVLVLPI_TYPAVL_SC_Compu /end COMPU_METHOD
/begin COMPU_VTAB EGRVLVLPI_TYPAVL_SC_Compu "" TAB_VERB 2 0 "False" 1 "True" /end COMPU_VTAB
/begin COMPU_METHOD EGSDIAPARL_SC_Compu "" TAB_VERB "%6.3" "" COMPU_TAB_REF EGSDIAPARL_SC_Compu /end COMPU_METHOD
/begin COMPU_VTAB EGSDIAPARL_SC_Compu "" TAB_VERB 2 0 "False" 1 "True" /end COMPU_VTAB
/begin COMPU_METHOD EGSDIA_ATS_SC_Compu "" TAB_VERB "%6.3" "" COMPU_TAB_REF EGSDIA_ATS_SC_Compu /end COMPU_METHOD
/begin COMPU_VTAB EGSDIA_ATS_SC_Compu "" TAB_VERB 2 0 "False" 1 "True" /end COMPU_VTAB
/begin COMPU_METHOD EGSDIA_CATHEATGTWCDIAG_SC_Compu "" TAB_VERB "%6.3" "" COMPU_TAB_REF EGSDIA_CATHEATGTWCDIAG_SC_Compu /end COMPU_METHOD
/begin COMPU_VTAB EGSDIA_CATHEATGTWCDIAG_SC_Compu "" TAB_VERB 2 0 "No catalyst heating for TWC diagnose" 1 "Catalyst heating for TWC diagnose" /end COMPU_VTAB
/begin COMPU_METHOD EGSDIA_LAMDYNMULTIDFC_SC_Compu "" TAB_VERB "%6.3" "" COMPU_TAB_REF EGSDIA_LAMDYNMULTIDFC_SC_Compu /end COMPU_METHOD
/begin COMPU_VTAB EGSDIA_LAMDYNMULTIDFC_SC_Compu "" TAB_VERB 2 0 "One_DFC" 1 "Multiple_DFCs" /end COMPU_VTAB
/begin COMPU_METHOD EGSDIA_LAMPLAUS_SC_Compu "" TAB_VERB "%6.3" "" COMPU_TAB_REF EGSDIA_LAMPLAUS_SC_Compu /end COMPU_METHOD
/begin COMPU_VTAB EGSDIA_LAMPLAUS_SC_Compu "" TAB_VERB 3 0 "0" 1 "1" 2 "2" /end COMPU_VTAB
/begin COMPU_METHOD EGSDIA_SNSRTYPES1B1_SC_Compu "" TAB_VERB "%6.3" "" COMPU_TAB_REF EGSDIA_SNSRTYPES1B1_SC_Compu /end COMPU_METHOD
/begin COMPU_VTAB EGSDIA_SNSRTYPES1B1_SC_Compu "" TAB_VERB 4 0 "No_Sensor" 1 "UEGO_Sensor" 2 "NOx_Sensor" 3 "LSF_sensor" /end COMPU_VTAB
/begin COMPU_METHOD EGSDIA_SNSRTYPES1B2_SC_Compu "" TAB_VERB "%6.3" "" COMPU_TAB_REF EGSDIA_SNSRTYPES1B2_SC_Compu /end COMPU_METHOD
/begin COMPU_VTAB EGSDIA_SNSRTYPES1B2_SC_Compu "" TAB_VERB 4 0 "No_Sensor" 1 "UEGO_Sensor" 2 "NOx_Sensor" 3 "LSF_sensor" /end COMPU_VTAB
/begin COMPU_METHOD EGSDIA_SYMTRANONLY_SC_Compu "" TAB_VERB "%6.3" "" COMPU_TAB_REF EGSDIA_SYMTRANONLY_SC_Compu /end COMPU_METHOD
/begin COMPU_VTAB EGSDIA_SYMTRANONLY_SC_Compu "" TAB_VERB 2 0 "False" 1 "True" /end COMPU_VTAB
/begin COMPU_METHOD EGSDIA_VAR_SY_Compu "" TAB_VERB "%6.3" "" COMPU_TAB_REF EGSDIA_VAR_SY_Compu /end COMPU_METHOD
/begin COMPU_VTAB EGSDIA_VAR_SY_Compu "" TAB_VERB 51 0 "kein Kundenbezug" 1 "DAI" 3 "VWW" 4 "POR" 5 "AUD" 6 "OPE" 9 "FIA" 11 "BMW" 14 "PSA" 15 "REN" 17 "ALF" 18 "SAB" 19 "VOL" 20 "NIS" 21 "GMU" 22 "FOR" 26 "IMJ" 36 "MAN" 51 "SEA" 53 "CHR" 54 "JAG" 55 "ROL" 69 "FER" 72 "TOY" 112 "BMWMotorradAG" 123 "MIT" 147 "HYU" 159 "HON" 160 "MAZ" 183 "CU" 190 "LRG" 204 "VVW" 214 "AVT" 242 "Iveco" 243 "DMC" 248 "SUZ" 267 "SSANGYONG" 270 "KEF" 289 "AMG" 308 "TAT" 319 "MVM" 385 "UAES" 578 "AL" 590 "Scania" 760 "WEICHAI" 828 "RBCD" 966 "International" 998 "S1" 999 "ALL" 2887 "NONOX" 9454 "Fuso" /end COMPU_VTAB
/begin COMPU_METHOD EGSDNOX_TRANDS_SC_Compu "" TAB_VERB "%6.3" "" COMPU_TAB_REF EGSDNOX_TRANDS_SC_Compu /end COMPU_METHOD
/begin COMPU_VTAB EGSDNOX_TRANDS_SC_Compu "" TAB_VERB 2 0 "False" 1 "True" /end COMPU_VTAB
/begin COMPU_METHOD EGSDO2_SYMCDYNDIAG_SC_Compu "" TAB_VERB "%6.3" "" COMPU_TAB_REF EGSDO2_SYMCDYNDIAG_SC_Compu /end COMPU_METHOD
/begin COMPU_VTAB EGSDO2_SYMCDYNDIAG_SC_Compu "" TAB_VERB 2 0 "False" 1 "True" /end COMPU_VTAB
/begin COMPU_METHOD EGSDUFILDYN_SC_Compu "" TAB_VERB "%6.3" "" COMPU_TAB_REF EGSDUFILDYN_SC_Compu /end COMPU_METHOD
/begin COMPU_VTAB EGSDUFILDYN_SC_Compu "" TAB_VERB 2 0 "False" 1 "True" /end COMPU_VTAB
/begin COMPU_METHOD EGSDU_CRSSBNK_SC_Compu "" TAB_VERB "%6.3" "" COMPU_TAB_REF EGSDU_CRSSBNK_SC_Compu /end COMPU_METHOD
/begin COMPU_VTAB EGSDU_CRSSBNK_SC_Compu "" TAB_VERB 2 0 "False" 1 "True" /end COMPU_VTAB
/begin COMPU_METHOD EGSDU_DLYLEAN_SC_Compu "" TAB_VERB "%6.3" "" COMPU_TAB_REF EGSDU_DLYLEAN_SC_Compu /end COMPU_METHOD
/begin COMPU_VTAB EGSDU_DLYLEAN_SC_Compu "" TAB_VERB 2 0 "False" 1 "True" /end COMPU_VTAB
/begin COMPU_METHOD EGSDU_EVLNPASDS_SC_Compu "" TAB_VERB "%6.3" "" COMPU_TAB_REF EGSDU_EVLNPASDS_SC_Compu /end COMPU_METHOD
/begin COMPU_VTAB EGSDU_EVLNPASDS_SC_Compu "" TAB_VERB 2 0 "False" 1 "True" /end COMPU_VTAB
/begin COMPU_METHOD EGSDU_FCO_SC_Compu "" TAB_VERB "%6.3" "" COMPU_TAB_REF EGSDU_FCO_SC_Compu /end COMPU_METHOD
/begin COMPU_VTAB EGSDU_FCO_SC_Compu "" TAB_VERB 2 0 "False" 1 "True" /end COMPU_VTAB
/begin COMPU_METHOD EGSDU_LIMDS_SC_Compu "" TAB_VERB "%6.3" "" COMPU_TAB_REF EGSDU_LIMDS_SC_Compu /end COMPU_METHOD
/begin COMPU_VTAB EGSDU_LIMDS_SC_Compu "" TAB_VERB 2 0 "False" 1 "True" /end COMPU_VTAB
/begin COMPU_METHOD EGSDU_STKUS_SC_Compu "" TAB_VERB "%6.3" "" COMPU_TAB_REF EGSDU_STKUS_SC_Compu /end COMPU_METHOD
/begin COMPU_VTAB EGSDU_STKUS_SC_Compu "" TAB_VERB 2 0 "False" 1 "True" /end COMPU_VTAB
/begin COMPU_METHOD EGSDU_TRANPAS_SC_Compu "" TAB_VERB "%6.3" "" COMPU_TAB_REF EGSDU_TRANPAS_SC_Compu /end COMPU_METHOD
/begin COMPU_VTAB EGSDU_TRANPAS_SC_Compu "" TAB_VERB 2 0 "False" 1 "True" /end COMPU_VTAB
/begin COMPU_METHOD EGSSIG_ENALAMPENVCORRD_SC_Compu "" TAB_VERB "%6.3" "" COMPU_TAB_REF EGSSIG_ENALAMPENVCORRD_SC_Compu /end COMPU_METHOD
/begin COMPU_VTAB EGSSIG_ENALAMPENVCORRD_SC_Compu "" TAB_VERB 2 0 "False" 1 "True" /end COMPU_VTAB
/begin COMPU_METHOD EGSSIG_SWTENAEGSSIG_SC_Compu "" TAB_VERB "%6.3" "" COMPU_TAB_REF EGSSIG_SWTENAEGSSIG_SC_Compu /end COMPU_METHOD
/begin COMPU_VTAB EGSSIG_SWTENAEGSSIG_SC_Compu "" TAB_VERB 2 0 "Deactivated" 1 "Activated" /end COMPU_VTAB
/begin COMPU_METHOD EGSSIG_SWTENAO2AIRPADPN_SC_Compu "" TAB_VERB "%6.3" "" COMPU_TAB_REF EGSSIG_SWTENAO2AIRPADPN_SC_Compu /end COMPU_METHOD
/begin COMPU_VTAB EGSSIG_SWTENAO2AIRPADPN_SC_Compu "" TAB_VERB 2 0 "False" 1 "True" /end COMPU_VTAB
/begin COMPU_METHOD EGTFact "" RAT_FUNC "%6.5" "-" COEFFS 0 1000 0 0 0 1 /end COMPU_METHOD
/begin COMPU_METHOD EGTSwt "" RAT_FUNC "%10.9" "-" COEFFS 0 16384000 0 0 0 1 /end COMPU_METHOD
/begin COMPU_METHOD EGTSwt_S16 "" RAT_FUNC "%7.6" "-" COEFFS 0 16384 0 0 0 1 /end COMPU_METHOD
/begin COMPU_METHOD ELDEV_DSQACTVT_SC_Compu "" TAB_VERB "%6.3" "" COMPU_TAB_REF ELDEV_DSQACTVT_SC_Compu /end COMPU_METHOD
/begin COMPU_VTAB ELDEV_DSQACTVT_SC_Compu "" TAB_VERB 2 0 "Inactive" 1 "Active" /end COMPU_VTAB
/begin COMPU_METHOD ELDEV_VAR_SY_Compu "" TAB_VERB "%6.3" "" COMPU_TAB_REF ELDEV_VAR_SY_Compu /end COMPU_METHOD
/begin COMPU_VTAB ELDEV_VAR_SY_Compu "" TAB_VERB 44 1 "DAI" 3 "VWW" 4 "POR" 5 "AUD" 6 "OPE" 9 "FIA" 11 "BMW" 14 "PSA" 15 "REN" 17 "ALF" 18 "SAB" 19 "VOL" 20 "NIS" 21 "GMU" 22 "FOR" 26 "IMJ" 51 "SEA" 53 "CHR" 54 "JAG" 55 "ROL" 69 "FER" 72 "TOY" 123 "MIT" 147 "HYU" 159 "HON" 160 "MAZ" 183 "CU" 190 "LRG" 204 "VVW" 214 "AVT" 242 "Iveco" 243 "DMC" 248 "SUZ" 267 "SSANGYONG" 270 "KEF" 289 "AMG" 308 "TAT" 319 "MVM" 385 "UAES" 590 "Scania" 828 "RBCD" 999 "ALL" 2887 "Nonox" 9454 "Fuso" /end COMPU_VTAB
/begin COMPU_METHOD ELECCMPRPRSNT_SC_Compu "" TAB_VERB "%6.3" "" COMPU_TAB_REF ELECCMPRPRSNT_SC_Compu /end COMPU_METHOD
/begin COMPU_VTAB ELECCMPRPRSNT_SC_Compu "" TAB_VERB 2 0 "False" 1 "True" /end COMPU_VTAB
/begin COMPU_METHOD ELECDRVENGDRG_SC_Compu "" TAB_VERB "%6.3" "" COMPU_TAB_REF ELECDRVENGDRG_SC_Compu /end COMPU_METHOD
/begin COMPU_VTAB ELECDRVENGDRG_SC_Compu "" TAB_VERB 2 0 "False" 1 "True" /end COMPU_VTAB
/begin COMPU_METHOD ELECDRVGPSBL_SC_Compu "" TAB_VERB "%6.3" "" COMPU_TAB_REF ELECDRVGPSBL_SC_Compu /end COMPU_METHOD
/begin COMPU_VTAB ELECDRVGPSBL_SC_Compu "" TAB_VERB 2 0 "False" 1 "True" /end COMPU_VTAB
/begin COMPU_METHOD ELECLDSENS_SC_Compu "" TAB_VERB "%6.3" "" COMPU_TAB_REF ELECLDSENS_SC_Compu /end COMPU_METHOD
/begin COMPU_VTAB ELECLDSENS_SC_Compu "" TAB_VERB 2 0 "False" 1 "True" /end COMPU_VTAB
/begin COMPU_METHOD ELMGOV_SC_Compu "" TAB_VERB "%6.3" "" COMPU_TAB_REF ELMGOV_SC_Compu /end COMPU_METHOD
/begin COMPU_VTAB ELMGOV_SC_Compu "" TAB_VERB 2 0 "not_available" 1 "available" /end COMPU_VTAB
/begin COMPU_METHOD EM01PRSNT_SC_Compu "" TAB_VERB "%6.3" "" COMPU_TAB_REF EM01PRSNT_SC_Compu /end COMPU_METHOD
/begin COMPU_VTAB EM01PRSNT_SC_Compu "" TAB_VERB 2 0 "False" 1 "True" /end COMPU_VTAB
/begin COMPU_METHOD EMGYSHOFFIN2_TYPAVL_SC_Compu "" TAB_VERB "%6.3" "" COMPU_TAB_REF EMGYSHOFFIN2_TYPAVL_SC_Compu /end COMPU_METHOD
/begin COMPU_VTAB EMGYSHOFFIN2_TYPAVL_SC_Compu "" TAB_VERB 2 0 "FALSE" 1 "TRUE" /end COMPU_VTAB
/begin COMPU_METHOD EMGYSTRTSWT2_TYPAVL_SC_Compu "" TAB_VERB "%6.3" "" COMPU_TAB_REF EMGYSTRTSWT2_TYPAVL_SC_Compu /end COMPU_METHOD
/begin COMPU_VTAB EMGYSTRTSWT2_TYPAVL_SC_Compu "" TAB_VERB 2 0 "False" 1 "True" /end COMPU_VTAB
/begin COMPU_METHOD EMLVTYP_SC_Compu "" TAB_VERB "%6.3" "" COMPU_TAB_REF EMLVTYP_SC_Compu /end COMPU_METHOD
/begin COMPU_VTAB EMLVTYP_SC_Compu "" TAB_VERB 3 0 "No_ElM" 1 "Valeo" 2 "Mitsubishi" /end COMPU_VTAB
/begin COMPU_METHOD EMMVTYP_SC_Compu "" TAB_VERB "%6.3" "" COMPU_TAB_REF EMMVTYP_SC_Compu /end COMPU_METHOD
/begin COMPU_VTAB EMMVTYP_SC_Compu "" TAB_VERB 4 0 "No_ElM" 1 "Bosch" 2 "Valeo" 3 "Conti" /end COMPU_VTAB
/begin COMPU_METHOD ENADATASETID_CALPAR_SC_Compu "" TAB_VERB "%6.3" "" COMPU_TAB_REF ENADATASETID_CALPAR_SC_Compu /end COMPU_METHOD
/begin COMPU_VTAB ENADATASETID_CALPAR_SC_Compu "" TAB_VERB 2 0 "False" 1 "True" /end COMPU_VTAB
/begin COMPU_METHOD Energy "" RAT_FUNC "%6.2" "kJ" COEFFS 0 1 0 0 0 1 /end COMPU_METHOD
/begin COMPU_METHOD Energy_J_HiRes "" RAT_FUNC "%6.2" "J" COEFFS 0 1 0 0 0 1 /end COMPU_METHOD
/begin COMPU_METHOD Energy_q0p0001 "" RAT_FUNC "%7.6" "kJ" COEFFS 0 10000 0 0 0 1 /end COMPU_METHOD
/begin COMPU_METHOD Energy_q0p001_COMPU "" RAT_FUNC "%6.5" "kJ" COEFFS 0 1000 0 0 0 1 /end COMPU_METHOD
/begin COMPU_METHOD ENGBRK_SC_Compu "" TAB_VERB "%6.3" "" COMPU_TAB_REF ENGBRK_SC_Compu /end COMPU_METHOD
/begin COMPU_VTAB ENGBRK_SC_Compu "" TAB_VERB 2 0 "False" 1 "True" /end COMPU_VTAB
/begin COMPU_METHOD ENGCMPTMTT_TYPAVL_SY_Compu "" TAB_VERB "%6.3" "" COMPU_TAB_REF ENGCMPTMTT_TYPAVL_SY_Compu /end COMPU_METHOD
/begin COMPU_VTAB ENGCMPTMTT_TYPAVL_SY_Compu "" TAB_VERB 2 0 "False" 1 "True" /end COMPU_VTAB
/begin COMPU_METHOD ENGDA_CTFLD_NUM_Compu "" RAT_FUNC "%6.2" "" COEFFS 0 1 0 0 0 1 /end COMPU_METHOD
/begin COMPU_METHOD ENGDA_TIENGONOBD_SY_Compu "" TAB_VERB "%6.3" "" COMPU_TAB_REF ENGDA_TIENGONOBD_SY_Compu /end COMPU_METHOD
/begin COMPU_VTAB ENGDA_TIENGONOBD_SY_Compu "" TAB_VERB 2 0 "FALSE" 1 "TRUE" /end COMPU_VTAB
/begin COMPU_METHOD ENGDEMTQINC_SC_Compu "" TAB_VERB "%6.3" "" COMPU_TAB_REF ENGDEMTQINC_SC_Compu /end COMPU_METHOD
/begin COMPU_VTAB ENGDEMTQINC_SC_Compu "" TAB_VERB 2 0 "False" 1 "True" /end COMPU_VTAB
/begin COMPU_METHOD ENGDEM_OPERMODTQLIMN_SC_Compu "" TAB_VERB "%6.3" "" COMPU_TAB_REF ENGDEM_OPERMODTQLIMN_SC_Compu /end COMPU_METHOD
/begin COMPU_VTAB ENGDEM_OPERMODTQLIMN_SC_Compu "" TAB_VERB 2 0 "FALSE" 1 "TRUE" /end COMPU_VTAB
/begin COMPU_METHOD ENGDEM_VAR_SY_Compu "" TAB_VERB "%6.3" "" COMPU_TAB_REF ENGDEM_VAR_SY_Compu /end COMPU_METHOD
/begin COMPU_VTAB ENGDEM_VAR_SY_Compu "" TAB_VERB 56 0 "kein Kundenbezug" 1 "DAI" 3 "VWW" 4 "POR" 5 "AUD" 6 "OPE" 9 "FIA" 11 "BMW" 14 "PSA" 15 "REN" 17 "ALF" 18 "SAB" 19 "VOL" 20 "NIS" 21 "GMU" 22 "FOR" 26 "IMJ" 36 "MAN" 51 "SEA" 53 "CHR" 54 "JAG" 55 "ROL" 69 "FER" 72 "TOY" 123 "MIT" 147 "HYU" 159 "HON" 160 "MAZ" 183 "CU" 190 "LRG" 204 "VVW" 214 "AVT" 226 "YUCHAI_OHW" 242 "Iveco" 243 "DMC" 248 "SUZ" 267 "SSANGYONG" 270 "KEF" 289 "AMG" 308 "TAT" 319 "MVM" 328 "MM" 385 "UAES" 578 "AL" 590 "SCANIA" 746 "Naveco" 760 "WEICHAI" 828 "RBCD" 898 "MFTBC" 944 "Doosan" 966 "International" 999 "ALL" 2887 "NONOX" 9047 "No 1 Tractors China" 9347 "SDFG" 9454 "Fuso" /end COMPU_VTAB
/begin COMPU_METHOD ENGMIDT_ADCSENS_SY_Compu "" TAB_VERB "%6.3" "" COMPU_TAB_REF ENGMIDT_ADCSENS_SY_Compu /end COMPU_METHOD
/begin COMPU_VTAB ENGMIDT_ADCSENS_SY_Compu "" TAB_VERB 2 0 "False" 1 "True" /end COMPU_VTAB
/begin COMPU_METHOD ENGMIDT_COLDSTRTDIAG_SC_Compu "" TAB_VERB "%6.3" "" COMPU_TAB_REF ENGMIDT_COLDSTRTDIAG_SC_Compu /end COMPU_METHOD
/begin COMPU_VTAB ENGMIDT_COLDSTRTDIAG_SC_Compu "" TAB_VERB 2 0 "False" 1 "True" /end COMPU_VTAB
/begin COMPU_METHOD ENGMIDT_TYPAVL_SC_Compu "" TAB_VERB "%6.3" "" COMPU_TAB_REF ENGMIDT_TYPAVL_SC_Compu /end COMPU_METHOD
/begin COMPU_VTAB ENGMIDT_TYPAVL_SC_Compu "" TAB_VERB 2 0 "False" 1 "True" /end COMPU_VTAB
/begin COMPU_METHOD EngN "" RAT_FUNC "%6.3" "rpm" COEFFS 0 2 0 0 0 1 /end COMPU_METHOD
/begin COMPU_METHOD EngNCrCtl "" RAT_FUNC "%6.2" "rpm" COEFFS 0 1 0 0 0 1 /end COMPU_METHOD
/begin COMPU_METHOD EngNRmp_Hi "" RAT_FUNC "%6.3" "rpm" COEFFS 0 10 0 0 0 1 /end COMPU_METHOD
/begin COMPU_METHOD ENGNSP_PFAVL_SC_Compu "" TAB_VERB "%6.3" "" COMPU_TAB_REF ENGNSP_PFAVL_SC_Compu /end COMPU_METHOD
/begin COMPU_VTAB ENGNSP_PFAVL_SC_Compu "" TAB_VERB 2 0 "EngNSp_NotAvl" 1 "EngNSp_Avl" /end COMPU_VTAB
/begin COMPU_METHOD ENGNSP_PFREQACTV_SC_Compu "" TAB_VERB "%6.3" "" COMPU_TAB_REF ENGNSP_PFREQACTV_SC_Compu /end COMPU_METHOD
/begin COMPU_VTAB ENGNSP_PFREQACTV_SC_Compu "" TAB_VERB 2 0 "False" 1 "True" /end COMPU_VTAB
/begin COMPU_METHOD EngN_HiRes "" RAT_FUNC "%6.4" "rpm" COEFFS 0 32 0 0 0 1 /end COMPU_METHOD
/begin COMPU_METHOD ENGOILT_TYPAVL_SC_Compu "" TAB_VERB "%6.3" "" COMPU_TAB_REF ENGOILT_TYPAVL_SC_Compu /end COMPU_METHOD
/begin COMPU_VTAB ENGOILT_TYPAVL_SC_Compu "" TAB_VERB 2 0 "False" 1 "True" /end COMPU_VTAB
/begin COMPU_METHOD Fact_CrCtl "" RAT_FUNC "%6.4" "-" COEFFS 0 256 0 0 0 1 /end COMPU_METHOD
/begin COMPU_METHOD NToVel_CrCtl "" RAT_FUNC "%6.4" "-" COEFFS 0 256 0 0 0 1 /end COMPU_METHOD
/begin COMPU_METHOD OneToOne "" RAT_FUNC "%6.2" "-" COEFFS 0 1 0 0 0 1 /end COMPU_METHOD
/begin COMPU_METHOD Prc_CrCtl4 "" RAT_FUNC "%6.4" "%" COEFFS 0 256 0 0 0 1 /end COMPU_METHOD
/begin COMPU_METHOD rel_q0p39 "" RAT_FUNC "%6.3" "%" COEFFS 0 256 0 0 0 100 /end COMPU_METHOD
/begin COMPU_METHOD Time_ms "" RAT_FUNC "%6.1" "ms" COEFFS 0 0.1 0 0 0 1 /end COMPU_METHOD
/begin COMPU_METHOD Time_ms_100ms "" RAT_FUNC "%6.0" "ms" COEFFS 0 0.01 0 0 0 1 /end COMPU_METHOD
/begin COMPU_METHOD Vel "" RAT_FUNC "%6.4" "km/h" COEFFS 0 100 0 0 0 1 /end COMPU_METHOD
/begin COMPU_METHOD Vel_CrCtl "" RAT_FUNC "%6.4" "km/h" COEFFS 0 256 0 0 0 1 /end COMPU_METHOD
/begin COMPU_METHOD Vel_CrCtl1 "" RAT_FUNC "%6.2" "km/h" COEFFS 0 1 0 0 0 1 /end COMPU_METHOD
/begin COMPU_METHOD volFilgLvl_ml "" RAT_FUNC "%6.2" "ml" COEFFS 0 1 0 0 0 1 /end COMPU_METHOD
/begin COMPU_METHOD volgrd_q5p96Em4 "" RAT_FUNC "%6.5" "ml/s" COEFFS 0 65536 0 0 0 39.0625 /end COMPU_METHOD
/*********** End of merged RECORD_LAYOUT blocks ***********/
/begin RECORD_LAYOUT Axis_Xs16 NO_AXIS_PTS_X 1 SWORD AXIS_PTS_X 2 SWORD INDEX_INCR DIRECT /end RECORD_LAYOUT
/begin RECORD_LAYOUT CurG_Ws16 FNC_VALUES 1 SWORD COLUMN_DIR DIRECT /end RECORD_LAYOUT
/begin RECORD_LAYOUT Cur_Xs16Ws16 NO_AXIS_PTS_X 1 SWORD AXIS_PTS_X 2 SWORD INDEX_INCR DIRECT FNC_VALUES 3 SWORD COLUMN_DIR DIRECT /end RECORD_LAYOUT
/begin RECORD_LAYOUT KwbUb FNC_VALUES 1 UBYTE COLUMN_DIR DIRECT /end RECORD_LAYOUT
/begin RECORD_LAYOUT Map_Xs16Ys16Ws16 NO_AXIS_PTS_X 1 SWORD NO_AXIS_PTS_Y 2 SWORD AXIS_PTS_X 3 SWORD INDEX_INCR DIRECT AXIS_PTS_Y 4 SWORD INDEX_INCR DIRECT FNC_VALUES 5 SWORD COLUMN_DIR DIRECT /end RECORD_LAYOUT
/begin RECORD_LAYOUT RB_Cur_Xs16Ws16 NO_AXIS_PTS_X 1 SWORD AXIS_PTS_X 2 SWORD INDEX_INCR DIRECT FNC_VALUES 3 SWORD COLUMN_DIR DIRECT /end RECORD_LAYOUT
/begin RECORD_LAYOUT RB_ValA_Wu16 FNC_VALUES 1 UWORD COLUMN_DIR DIRECT /end RECORD_LAYOUT
/begin RECORD_LAYOUT RB_ValA_Wu8 FNC_VALUES 1 UBYTE COLUMN_DIR DIRECT /end RECORD_LAYOUT
/begin RECORD_LAYOUT RB_Val_Wboolean FNC_VALUES 1 UBYTE COLUMN_DIR DIRECT /end RECORD_LAYOUT
/begin RECORD_LAYOUT RB_Val_Ws16 FNC_VALUES 1 SWORD COLUMN_DIR DIRECT /end RECORD_LAYOUT
/begin RECORD_LAYOUT RB_Val_Wu16 FNC_VALUES 1 UWORD COLUMN_DIR DIRECT /end RECORD_LAYOUT
/begin RECORD_LAYOUT RB_Val_Wu8 FNC_VALUES 1 UBYTE COLUMN_DIR DIRECT /end RECORD_LAYOUT
/begin RECORD_LAYOUT ValA_Wu8 FNC_VALUES 1 UBYTE COLUMN_DIR DIRECT /end RECORD_LAYOUT
/begin RECORD_LAYOUT Val_Ws16 FNC_VALUES 1 SWORD COLUMN_DIR DIRECT /end RECORD_LAYOUT
/begin RECORD_LAYOUT Val_Ws32 FNC_VALUES 1 SLONG COLUMN_DIR DIRECT /end RECORD_LAYOUT
/begin RECORD_LAYOUT Val_Wu16 FNC_VALUES 1 UWORD COLUMN_DIR DIRECT /end RECORD_LAYOUT
/begin RECORD_LAYOUT Val_Wu8 FNC_VALUES 1 UBYTE COLUMN_DIR DIRECT /end RECORD_LAYOUT
/end MODULE
/end PROJECT
