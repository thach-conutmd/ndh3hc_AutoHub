ASAP2_VERSION 1 60
/begin PROJECT MG1CA020 "MG1CA020"
/begin HEADER "" VERSION "MG1CA020_6SAY_V011_TPROT" PROJECT_NO MG1CA020 /end HEADER
/begin MODULE DIM ""
/begin MOD_COMMON "" BYTE_ORDER MSB_LAST ALIGNMENT_BYTE 1 ALIGNMENT_WORD 2 ALIGNMENT_LONG 4 ALIGNMENT_INT64 4 ALIGNMENT_FLOAT32_IEEE 4 ALIGNMENT_FLOAT64_IEEE 4 DATA_SIZE 32 /end MOD_COMMON
/begin CHARACTERISTIC APP_dRawSigFac_C "Factor between sensor raw values" VALUE 0x804FB42C RB_Val_Wu16 7.999878 Fact 0.00 7.999878 FORMAT "%8.6" /end CHARACTERISTIC
/begin CHARACTERISTIC APP_drLimNegLrn_C "Learned max. pedal value decrease per computation step during operation of brake" VALUE 0x804FB42E RB_Val_Ws16 39999.39 PrcPerSec -20000.00 19999.39 FORMAT "%8.2" /end CHARACTERISTIC
/begin CHARACTERISTIC APP_drLimpMaxLrn_C "Limit for APP gradient in limphome mode" VALUE 0x804FB430 RB_Val_Ws16 39999.39 PrcPerSec -20000.00 19999.39 FORMAT "%8.2" /end CHARACTERISTIC
/begin CHARACTERISTIC APP_drLimPosLrn_C "Max. permissible pedal value increase per computation step after operating brake" VALUE 0x804FB432 RB_Val_Ws16 39999.39 PrcPerSec -20000.00 19999.39 FORMAT "%8.2" /end CHARACTERISTIC
/begin CHARACTERISTIC APP_drLinRmp_C "error ramp by the switch between the two sets of linearisation parameters" VALUE 0x804FB434 RB_Val_Ws16 39999.39 PrcPerSec -20000.00 19999.39 FORMAT "%8.2" /end CHARACTERISTIC
/begin CHARACTERISTIC APP_I_P_ATS_ATS.LimitTypeMsk_C "Actuator test APP_I_P_ATS_ATS / Tester demand monitoring enable mask for actuators" VALUE 0x8053A594 Val_Wu8 255.0 OneToOne 0.00 255.0 FORMAT "%5.1" /end CHARACTERISTIC
/begin CHARACTERISTIC APP_I_P_ATS_ATS.CnvNorm_C "Actuator test APP_I_P_ATS_ATS / Conversion norm used for conversion to/from internal scaling" VALUE 0x8053A595 Val_Wu8 255.0 OneToOne 0.00 255.0 FORMAT "%5.1" /end CHARACTERISTIC
/begin CHARACTERISTIC APP_I_P_ATS_ATS.LowLim_C "Actuator test APP_I_P_ATS_ATS / Lower limit for monitoring" VALUE 0x8053A596 Val_Ws16 799.9878 Prc -400.0000 399.9878 FORMAT "%8.4" /end CHARACTERISTIC
/begin CHARACTERISTIC APP_I_P_ATS_ATS.UpLim_C "Actuator test APP_I_P_ATS_ATS / Upper limit for monitoring" VALUE 0x8053A598 Val_Ws16 799.9878 Prc -400.0000 399.9878 FORMAT "%8.4" /end CHARACTERISTIC
/begin CHARACTERISTIC APP_I_P_ATS_ATS.CnvFac_C "Actuator test APP_I_P_ATS_ATS / Factor used for conversion to/from internal scaling" VALUE 0x8053A59C Val_Ws32 4294967295.00 OneToOne -2147483648.00 2147483647.00 FORMAT "%13.2" /end CHARACTERISTIC
/begin CHARACTERISTIC APP_I_P_ATS_ATS.CnvOfs_C "Actuator test APP_I_P_ATS_ATS / Offset used for conversion to/from internal scaling" VALUE 0x8053A5A0 Val_Ws16 65535.00 OneToOne -32768.00 32767.00 FORMAT "%8.2" /end CHARACTERISTIC
/begin CHARACTERISTIC APP_I_P_ATS_ATS.DfltVal_C "Actuator test APP_I_P_ATS_ATS / Default value for standbytest" VALUE 0x8053A5A2 Val_Ws16 65535.00 OneToOne -32768.00 32767.00 FORMAT "%8.2" /end CHARACTERISTIC
/begin CHARACTERISTIC APP_rAppATSMax_C "Maximum acceleration pedal position allowed from ATS" VALUE 0x804FB436 RB_Val_Ws16 799.9878 Prc -400.0000 399.9878 FORMAT "%8.4" /end CHARACTERISTIC
/begin CHARACTERISTIC APP_rAppATSMin_C "Minimum acceleration pedal position allowed from ATS" VALUE 0x804FB438 RB_Val_Ws16 799.9878 Prc -400.0000 399.9878 FORMAT "%8.4" /end CHARACTERISTIC
/begin CHARACTERISTIC APP_rAppLimnMax_C "Maximum limitation acceleration pedal position" VALUE 0x804FB43A RB_Val_Ws16 799.9878 Prc -400.0000 399.9878 FORMAT "%8.4" /end CHARACTERISTIC
/begin CHARACTERISTIC APP_rAppLimnMin_C "Minimum limitation acceleration pedal position" VALUE 0x804FB43C RB_Val_Ws16 799.9878 Prc -400.0000 399.9878 FORMAT "%8.4" /end CHARACTERISTIC
/begin CHARACTERISTIC APP_rAPPMaxLrnFixOffs_C "Calibration parameter(percent) after Fixed Offset calculation(subtraction) from maximum APP ratio, which corresponds to point in APP Linearization curve." VALUE 0x804FB43E RB_Val_Ws16 799.9878 Prc -400.0000 399.9878 FORMAT "%8.4" /end CHARACTERISTIC
/begin CHARACTERISTIC APP_rAPPMaxLrnPosOffs_C "Calibration parameter(percent) after Offset calculation(subtraction) from maximum APP ratio." VALUE 0x804FB440 RB_Val_Ws16 799.9878 Prc -400.0000 399.9878 FORMAT "%8.4" /end CHARACTERISTIC
/begin CHARACTERISTIC APP_rAPPMaxLrnPos_C "Calibration parameter(percent) for maximum APP ratio" VALUE 0x804FB442 RB_Val_Ws16 799.9878 Prc -400.0000 399.9878 FORMAT "%8.4" /end CHARACTERISTIC
/begin CHARACTERISTIC APP_rLimpMaxLrn_C "Limit for APP value in limphome mode" VALUE 0x804FB444 RB_Val_Ws16 799.9878 Prc -400.0000 399.9878 FORMAT "%8.4" /end CHARACTERISTIC
/begin CHARACTERISTIC APP_rLinAPPMax_C "Maximum value of acceleration pedal position" VALUE 0x804FB446 RB_Val_Ws16 799.9878 Prc -400.0000 399.9878 FORMAT "%8.4" /end CHARACTERISTIC
/begin CHARACTERISTIC APP_rLinAPPMin_C "Minimum value of acceleration pedal position" VALUE 0x804FB448 RB_Val_Ws16 799.9878 Prc -400.0000 399.9878 FORMAT "%8.4" /end CHARACTERISTIC
/begin CHARACTERISTIC APP_rPlaMaxValLrn_C "Maximum APP value when plausibility with brake failed" VALUE 0x804FB44A RB_Val_Ws16 799.9878 Prc -400.0000 399.9878 FORMAT "%8.4" /end CHARACTERISTIC
/begin CHARACTERISTIC APP_rPrevLETThd_C "Threshold value of acceleration pedal position to abort LET request" VALUE 0x804FB44C RB_Val_Ws16 799.9878 Prc -400.0000 399.9878 FORMAT "%8.4" /end CHARACTERISTIC
/begin CHARACTERISTIC APP_swtCfg_CW "codeword in APP" VALUE 0x804FB44E RB_Val_Wu16 65535.00 OneToOne 0.00 65535.00 FORMAT "%8.2" /end CHARACTERISTIC
/begin CHARACTERISTIC APP_tiEngOnLETThd_C "Threshold value of engine on time to disable Line End Tester" VALUE 0x804FB450 RB_Val_Wu32 4294967295.00 TimeEngOn 0.00 4294967295.00 FORMAT "%13.2" /end CHARACTERISTIC
/begin CHARACTERISTIC APP_tiPhyHigh1DebDef_C "Defect debounce time for DFC_PhyHighAPP1" VALUE 0x804FB454 RB_Val_Ws16 655350.0 Time_ms -327680.0 327670.0 FORMAT "%8.1" /end CHARACTERISTIC
/begin CHARACTERISTIC APP_tiPhyHigh1DebOk_C "Healing debounce time for DFC_PhyHighAPP1" VALUE 0x804FB456 RB_Val_Ws16 655350.0 Time_ms -327680.0 327670.0 FORMAT "%8.1" /end CHARACTERISTIC
/begin CHARACTERISTIC APP_tiPhyHigh2DebDef_C "Defect debounce time for DFC_PhyHighAPP2" VALUE 0x804FB458 RB_Val_Ws16 655350.0 Time_ms -327680.0 327670.0 FORMAT "%8.1" /end CHARACTERISTIC
/begin CHARACTERISTIC APP_tiPhyHigh2DebOk_C "Healing debounce time for DFC_PhyHighAPP2" VALUE 0x804FB45A RB_Val_Ws16 655350.0 Time_ms -327680.0 327670.0 FORMAT "%8.1" /end CHARACTERISTIC
/begin CHARACTERISTIC APP_tiPhyLow1DebDef_C "Defect debounce time for DFC_PhyLowAPP1" VALUE 0x804FB45C RB_Val_Ws16 655350.0 Time_ms -327680.0 327670.0 FORMAT "%8.1" /end CHARACTERISTIC
/begin CHARACTERISTIC APP_tiPhyLow1DebOk_C "Healing debounce time for DFC_PhyLowAPP1" VALUE 0x804FB45E RB_Val_Ws16 655350.0 Time_ms -327680.0 327670.0 FORMAT "%8.1" /end CHARACTERISTIC
/begin CHARACTERISTIC APP_tiPhyLow2DebDef_C "Defect debounce time for DFC_PhyLowAPP2" VALUE 0x804FB460 RB_Val_Ws16 655350.0 Time_ms -327680.0 327670.0 FORMAT "%8.1" /end CHARACTERISTIC
/begin CHARACTERISTIC APP_tiPhyLow2DebOk_C "Healing debounce time for DFC_PhyLowAPP2" VALUE 0x804FB462 RB_Val_Ws16 655350.0 Time_ms -327680.0 327670.0 FORMAT "%8.1" /end CHARACTERISTIC
/begin CHARACTERISTIC APP_tiPlaAPP12DebDef_C "debounce time fot the defect detection of sync check" VALUE 0x804FB464 RB_Val_Ws16 655350.0 Time_ms -327680.0 327670.0 FORMAT "%8.1" /end CHARACTERISTIC
/begin CHARACTERISTIC APP_tiPlaAPP12DebOk_C "debounce time for the healing of sync check" VALUE 0x804FB466 RB_Val_Ws16 655350.0 Time_ms -327680.0 327670.0 FORMAT "%8.1" /end CHARACTERISTIC
/begin CHARACTERISTIC APP_tiSRCHigh1DebDef_C "Duration of defect debouncing for check DFC_SRCHighAPP1" VALUE 0x804FB468 RB_Val_Ws16 655350.0 Time_ms -327680.0 327670.0 FORMAT "%8.1" /end CHARACTERISTIC
/begin CHARACTERISTIC APP_tiSRCHigh1DebOk_C "Duration of healing debouncing for check DFC_SRCHighAPP1" VALUE 0x804FB46A RB_Val_Ws16 655350.0 Time_ms -327680.0 327670.0 FORMAT "%8.1" /end CHARACTERISTIC
/begin CHARACTERISTIC APP_tiSRCHigh2DebDef_C "Duration of defect debouncing for check DFC_SRCHighAPP2" VALUE 0x804FB46C RB_Val_Ws16 655350.0 Time_ms -327680.0 327670.0 FORMAT "%8.1" /end CHARACTERISTIC
/begin CHARACTERISTIC APP_tiSRCHigh2DebOk_C "Duration of healing debouncing for check DFC_SRCHighAPP2" VALUE 0x804FB46E RB_Val_Ws16 655350.0 Time_ms -327680.0 327670.0 FORMAT "%8.1" /end CHARACTERISTIC
/begin CHARACTERISTIC APP_tiSRCLow1DebDef_C "Duration of defect debouncing for check DFC_SRCLowAPP1" VALUE 0x804FB470 RB_Val_Ws16 655350.0 Time_ms -327680.0 327670.0 FORMAT "%8.1" /end CHARACTERISTIC
/begin CHARACTERISTIC APP_tiSRCLow1DebOk_C "Duration of healing debouncing for check DFC_SRCLowAPP1" VALUE 0x804FB472 RB_Val_Ws16 655350.0 Time_ms -327680.0 327670.0 FORMAT "%8.1" /end CHARACTERISTIC
/begin CHARACTERISTIC APP_tiSRCLow2DebDef_C "Duration of defect debouncing for check DFC_SRCLowAPP2" VALUE 0x804FB474 RB_Val_Ws16 655350.0 Time_ms -327680.0 327670.0 FORMAT "%8.1" /end CHARACTERISTIC
/begin CHARACTERISTIC APP_tiSRCLow2DebOk_C "Duration of healing debouncing for check DFC_SRCLowAPP2" VALUE 0x804FB476 RB_Val_Ws16 655350.0 Time_ms -327680.0 327670.0 FORMAT "%8.1" /end CHARACTERISTIC
/begin CHARACTERISTIC APP_uRaw1Def_C "Substitute value for sensor 1 defect" VALUE 0x804FB478 RB_Val_Ws16 13107.00 Volt -6553.600 6553.400 FORMAT "%8.3" /end CHARACTERISTIC
/begin CHARACTERISTIC APP_uRaw2Def_C "Substitute value for sensor 2 defect" VALUE 0x804FB47A RB_Val_Ws16 13107.00 Volt -6553.600 6553.400 FORMAT "%8.3" /end CHARACTERISTIC
/begin CHARACTERISTIC APP_uRawFullLdLimp_C "upper normalisation parameter in case of limp modus" VALUE 0x804FB47C RB_Val_Ws16 13107.00 Volt -6553.600 6553.400 FORMAT "%8.3" /end CHARACTERISTIC
/begin CHARACTERISTIC APP_uRawFullLd_C "PWG voltage threshold for full-throttle range" VALUE 0x804FB47E RB_Val_Ws16 13107.00 Volt -6553.600 6553.400 FORMAT "%8.3" /end CHARACTERISTIC
/begin CHARACTERISTIC APP_uRawIdlLimp_C "PWG voltage threshold for partial throttle range in Limp mode" VALUE 0x804FB480 RB_Val_Ws16 13107.00 Volt -6553.600 6553.400 FORMAT "%8.3" /end CHARACTERISTIC
/begin CHARACTERISTIC APP_uRawIdl_C "PWG voltage threshold for partial throttle range" VALUE 0x804FB482 RB_Val_Ws16 13107.00 Volt -6553.600 6553.400 FORMAT "%8.3" /end CHARACTERISTIC
/begin CHARACTERISTIC APP_uSnsrMaxOffs_C "Calibration parameter Offset voltage subtracted from APP learned max value." VALUE 0x804FB484 RB_Val_Ws16 13107.00 Volt -6553.600 6553.400 FORMAT "%8.3" /end CHARACTERISTIC
/begin CHARACTERISTIC APP_uSply_C "Sensor supply voltage" VALUE 0x804FB486 RB_Val_Ws16 13107.00 Volt -6553.600 6553.400 FORMAT "%8.3" /end CHARACTERISTIC
/begin CHARACTERISTIC APP_vVehLETThd_C "Threshold value of vehicle velocity to abort LET request" VALUE 0x804FB488 RB_Val_Ws16 655.3500 Vel -327.6800 327.6700 FORMAT "%8.4" /end CHARACTERISTIC
/begin CHARACTERISTIC ASDdc_facNDiff_CUR "antijerk idle speed difference factor for Kd" CURVE 0x804FB48C RB_Curve_S16_U8_Static 1.000000 fak_ub_b2 0.00 1.000000 FORMAT "%8.6" EXTENDED_LIMITS 0.00 1.992188
 /begin AXIS_DESCR STD_AXIS ASDdc_nDiff EngN 2 -16384.00 16383.50 FORMAT "%8.2" DEPOSIT ABSOLUTE /end AXIS_DESCR
/end CHARACTERISTIC
/begin CHARACTERISTIC ASDdc_facTEng_CUR "antijerk engine temperature factor for Kd" CURVE 0x804FB494 RB_Curve_U16_U8_Static 1.000000 fak_ub_b2 0.00 1.000000 FORMAT "%8.6" EXTENDED_LIMITS 0.00 1.992188
 /begin AXIS_DESCR STD_AXIS ASDdc_tEng Temp_Cels 2 -273.140 3003.560 FORMAT "%8.3" EXTENDED_LIMITS -273.1400 6280.360 DEPOSIT ABSOLUTE /end AXIS_DESCR
/end CHARACTERISTIC
/begin CHARACTERISTIC ASDdc_facVVeh_CUR "antijerk vehicle speed factor for Kd" CURVE 0x804FB49C RB_Curve_U16_U8_Static 1.000000 fak_ub_b2 0.00 1.000000 FORMAT "%8.6" EXTENDED_LIMITS 0.00 1.992188
 /begin AXIS_DESCR STD_AXIS ASDdc_v Vel 2 0.00 327.6700 FORMAT "%8.4" EXTENDED_LIMITS 0.00 655.3500 DEPOSIT ABSOLUTE /end AXIS_DESCR
/end CHARACTERISTIC
/begin CHARACTERISTIC ASDdc_KdDynNegSprt_GMAP "Sports Mode:Amplification of dynamic antijerking intervention negative" MAP 0x804FB4A4 RB_MapGroup_U8 7.969 q0p03125_Nm_DIV_rpm 0.00 7.969 FORMAT "%5.3"
 /begin AXIS_DESCR COM_AXIS ASDdc_ratTq TransR 7 -327.6800 327.6700 FORMAT "%8.4" AXIS_PTS_REF ASDdc_rTrq_DST /end AXIS_DESCR
 /begin AXIS_DESCR COM_AXIS ASDdc_nPT EngN 6 -16384.00 16383.50 FORMAT "%8.2" AXIS_PTS_REF ASDdc_nPT_DST /end AXIS_DESCR
/end CHARACTERISTIC
/begin CHARACTERISTIC ASDdc_KdDynNeg_GMAP "Amplification of dynamic antijerking intervention negative" MAP 0x804FB4CE RB_MapGroup_U8 7.969 q0p03125_Nm_DIV_rpm 0.00 7.969 FORMAT "%5.3"
 /begin AXIS_DESCR COM_AXIS ASDdc_ratTq TransR 7 -327.6800 327.6700 FORMAT "%8.4" AXIS_PTS_REF ASDdc_rTrq_DST /end AXIS_DESCR
 /begin AXIS_DESCR COM_AXIS ASDdc_nPT EngN 6 -16384.00 16383.50 FORMAT "%8.2" AXIS_PTS_REF ASDdc_nPT_DST /end AXIS_DESCR
/end CHARACTERISTIC
/begin CHARACTERISTIC ASDdc_KdDynPosSprt_GMAP "Sports Mode:Amplification of dynamic antijerking intervention positive" MAP 0x804FB4F8 RB_MapGroup_U8 7.969 q0p03125_Nm_DIV_rpm 0.00 7.969 FORMAT "%5.3"
 /begin AXIS_DESCR COM_AXIS ASDdc_ratTq TransR 7 -327.6800 327.6700 FORMAT "%8.4" AXIS_PTS_REF ASDdc_rTrq_DST /end AXIS_DESCR
 /begin AXIS_DESCR COM_AXIS ASDdc_nPT EngN 6 -16384.00 16383.50 FORMAT "%8.2" AXIS_PTS_REF ASDdc_nPT_DST /end AXIS_DESCR
/end CHARACTERISTIC
/begin CHARACTERISTIC ASDdc_KdDynPos_GMAP "Amplification of dynamic antijerking intervention positive" MAP 0x804FB522 RB_MapGroup_U8 7.969 q0p03125_Nm_DIV_rpm 0.00 7.969 FORMAT "%5.3"
 /begin AXIS_DESCR COM_AXIS ASDdc_ratTq TransR 7 -327.6800 327.6700 FORMAT "%8.4" AXIS_PTS_REF ASDdc_rTrq_DST /end AXIS_DESCR
 /begin AXIS_DESCR COM_AXIS ASDdc_nPT EngN 6 -16384.00 16383.50 FORMAT "%8.2" AXIS_PTS_REF ASDdc_nPT_DST /end AXIS_DESCR
/end CHARACTERISTIC
/begin CHARACTERISTIC ASDdc_nDifGripDetnMax_C "Maximum difference in speed for grip detection" VALUE 0x804FB54C RB_Val_Ws16 32767.50 EngN -16384.00 16383.50 FORMAT "%8.2" /end CHARACTERISTIC
/begin AXIS_PTS ASDdc_nPT_DST "group axis points engine speed" 0x804FB54E ASDdc_nPT RB_Axis_S16 32767.50 EngN 6 -16384.00 16383.50 FORMAT "%8.2" DEPOSIT ABSOLUTE /end AXIS_PTS
/begin AXIS_PTS ASDdc_rTrq_DST "antijerk gear ratio" 0x804FB55C ASDdc_ratTq RB_Axis_S16 655.3500 TransR 7 -327.6800 327.6700 FORMAT "%8.4" DEPOSIT ABSOLUTE /end AXIS_PTS
/begin CHARACTERISTIC ASDdc_stCfg2_CW "code word ASDdc" VALUE 0x804FB56C RB_Val_Wu8 255.0 dez 0.00 255.0 FORMAT "%5.1" /end CHARACTERISTIC
/begin CHARACTERISTIC ASDdc_stCfg_CW "code word ASDdc" VALUE 0x804FB56E RB_Val_Wu16 65535.00 dez 0.00 65535.00 FORMAT "%8.2" /end CHARACTERISTIC
/begin CHARACTERISTIC ASDdc_swtNDiffSeln_C "selection switch between engine speed difference" VALUE 0x804FB570 RB_Val_Wboolean 1.00000000000 B_TRUE 0.00 1.00000000000 FORMAT "%13.11" /end CHARACTERISTIC
/begin CHARACTERISTIC ASDdc_tiActvAftFCO_C "antijerk delay after deactivation fuel cut off" VALUE 0x804FB571 RB_Val_Wu8 2.550 t_q0p01 0.00 2.550 FORMAT "%5.3" /end CHARACTERISTIC
/begin CHARACTERISTIC ASDdc_tiActvDyn_C "antijerk delay after deactivation dynamic" VALUE 0x804FB572 RB_Val_Wu16 65.53500 t_q0p001 0.00 65.53500 FORMAT "%8.5" /end CHARACTERISTIC
/begin CHARACTERISTIC ASDdc_tiGripDeb_GCUR "time delay after grip condition to enable active surge damper" CURVE 0x804FB574 RB_CurveGroup_U8 2.550 t_q0p01 0.00 2.550 FORMAT "%5.3"
 /begin AXIS_DESCR COM_AXIS ASDdc_trqClthAct md_q0p1 8 -3276.800 3276.700 FORMAT "%8.3" AXIS_PTS_REF ASDdc_trqClthAct_DST /end AXIS_DESCR
/end CHARACTERISTIC
/begin CHARACTERISTIC ASDdc_tiPerDur_GCUR "characteristic jerk time" CURVE 0x804FB57C RB_CurveGroup_U8 0.4961 t_q1p95em3 0.0020 0.4980 EXTENDED_LIMITS 0.00 0.4980
 /begin AXIS_DESCR COM_AXIS ASDdc_ratTq TransR 7 -327.6800 327.6700 FORMAT "%8.4" AXIS_PTS_REF ASDdc_rTrq_DST /end AXIS_DESCR
/end CHARACTERISTIC
/begin CHARACTERISTIC ASDdc_tiShftDeb_GCUR "delay time after gear shift to enable active surge damper" CURVE 0x804FB583 RB_CurveGroup_U8 2.550 t_q0p01 0.00 2.550 FORMAT "%5.3"
 /begin AXIS_DESCR COM_AXIS ASDdc_trqClthWoDstC md_q0p1 8 -3276.800 3276.700 FORMAT "%8.3" AXIS_PTS_REF ASDdc_trqClthWoDstC_DST /end AXIS_DESCR
/end CHARACTERISTIC
/begin AXIS_PTS ASDdc_trqClthAct_DST "group axis points antijerk clutch torque" 0x804FB58C ASDdc_trqClthAct RB_Axis_S16 6553.500 md_q0p1 8 -3276.800 3276.700 FORMAT "%8.3" DEPOSIT ABSOLUTE /end AXIS_PTS
/begin AXIS_PTS ASDdc_trqClthWoDstC_DST "group axis points clutch torque without disturbance control" 0x804FB59E ASDdc_trqClthWoDstC RB_Axis_S16 6553.500 md_q0p1 8 -3276.800 3276.700 FORMAT "%8.3" DEPOSIT ABSOLUTE /end AXIS_PTS
/begin CHARACTERISTIC ASDdc_trqThresDynNegSprt_GMAP "Torque threshold for dynamic antijerking interventions for sport mode (Negative)" MAP 0x804FB5B0 RB_MapGroup_S16 3276.700 md_q0p1 0.00 3276.700 FORMAT "%8.3" EXTENDED_LIMITS -3276.800 3276.700
 /begin AXIS_DESCR COM_AXIS ASDdc_ratTq TransR 7 -327.6800 327.6700 FORMAT "%8.4" AXIS_PTS_REF ASDdc_rTrq_DST /end AXIS_DESCR
 /begin AXIS_DESCR COM_AXIS ASDdc_trqClthAct md_q0p1 8 -3276.800 3276.700 FORMAT "%8.3" AXIS_PTS_REF ASDdc_trqClthAct_DST /end AXIS_DESCR
/end CHARACTERISTIC
/begin CHARACTERISTIC ASDdc_trqThresDynNeg_GMAP "Threshold for dynamic antijerking intervention negative" MAP 0x804FB620 RB_MapGroup_S16 3276.700 md_q0p1 0.00 3276.700 FORMAT "%8.3" EXTENDED_LIMITS -3276.800 3276.700
 /begin AXIS_DESCR COM_AXIS ASDdc_ratTq TransR 7 -327.6800 327.6700 FORMAT "%8.4" AXIS_PTS_REF ASDdc_rTrq_DST /end AXIS_DESCR
 /begin AXIS_DESCR COM_AXIS ASDdc_trqClthAct md_q0p1 8 -3276.800 3276.700 FORMAT "%8.3" AXIS_PTS_REF ASDdc_trqClthAct_DST /end AXIS_DESCR
/end CHARACTERISTIC
/begin CHARACTERISTIC ASDdc_trqThresDynPosSprt_GMAP "Torque threshold for dynamic antijerking interventions for sport mode (positive)" MAP 0x804FB690 RB_MapGroup_S16 3276.700 md_q0p1 0.00 3276.700 FORMAT "%8.3" EXTENDED_LIMITS -3276.800 3276.700
 /begin AXIS_DESCR COM_AXIS ASDdc_ratTq TransR 7 -327.6800 327.6700 FORMAT "%8.4" AXIS_PTS_REF ASDdc_rTrq_DST /end AXIS_DESCR
 /begin AXIS_DESCR COM_AXIS ASDdc_trqClthAct md_q0p1 8 -3276.800 3276.700 FORMAT "%8.3" AXIS_PTS_REF ASDdc_trqClthAct_DST /end AXIS_DESCR
/end CHARACTERISTIC
/begin CHARACTERISTIC ASDdc_trqThresDynPos_GMAP "Threshold for dynamic antijerking intervention positive" MAP 0x804FB700 RB_MapGroup_S16 3276.700 md_q0p1 0.00 3276.700 FORMAT "%8.3" EXTENDED_LIMITS -3276.800 3276.700
 /begin AXIS_DESCR COM_AXIS ASDdc_ratTq TransR 7 -327.6800 327.6700 FORMAT "%8.4" AXIS_PTS_REF ASDdc_rTrq_DST /end AXIS_DESCR
 /begin AXIS_DESCR COM_AXIS ASDdc_trqClthAct md_q0p1 8 -3276.800 3276.700 FORMAT "%8.3" AXIS_PTS_REF ASDdc_trqClthAct_DST /end AXIS_DESCR
/end CHARACTERISTIC
/begin CHARACTERISTIC ASDrf_bPhyTqLyrHybCmpbl_C "Physical torque layer hybrid compatible calibration switch" VALUE 0x804FCA16 RB_Val_Wboolean 1.00000000000 B_TRUE 0.00 1.00000000000 FORMAT "%13.11" /end CHARACTERISTIC
/begin CHARACTERISTIC ASDrf_CfgNew_C "configuration codeword new ASD method" VALUE 0x804FCA18 RB_Val_Wu16 65535.00 OneToOne 0.00 65535.00 FORMAT "%8.2" /end CHARACTERISTIC
/begin CHARACTERISTIC ASDrf_cntrSigMaxReset_C "counter for reset of detection engine speed maximum" VALUE 0x804FCA1A RB_Val_Ws8 255.0 OneToOne -128.0 127.0 FORMAT "%5.1" /end CHARACTERISTIC
/begin CHARACTERISTIC ASDrf_cntrSigMaxSet_C "counter for set of detection engine speed maximum" VALUE 0x804FCA1B RB_Val_Ws8 255.0 OneToOne -128.0 127.0 FORMAT "%5.1" /end CHARACTERISTIC
/begin CHARACTERISTIC ASDrf_dndeltaMaxIni_C "initial value maximum change filtered engine speed gradient" VALUE 0x804FCA1C RB_Val_Ws16 8192.000 EngNGrd 0.00 8192.000 FORMAT "%8.3" EXTENDED_LIMITS -16384.00 16383.50 /end CHARACTERISTIC
/begin CHARACTERISTIC ASDrf_dnEngMaxReset_C "engine speed gradient for reset of detection engine speed maximum" VALUE 0x804FCA1E RB_Val_Ws16 32767.50 EngNGrd -16384.00 16383.50 FORMAT "%8.2" /end CHARACTERISTIC
/begin CHARACTERISTIC ASDrf_dnEngMaxSet_C "engine speed gradient for set of detection engine speed maximum" VALUE 0x804FCA20 RB_Val_Ws16 32767.50 EngNGrd -16384.00 16383.50 FORMAT "%8.2" /end CHARACTERISTIC
/begin CHARACTERISTIC ASDrf_dtqNegMax_C "maximum gradient of torque limitation negative load change" VALUE 0x804FCA22 RB_Val_Ws16 6553.500 mdt_q0p1_Nm_DIV_s -3276.800 3276.700 FORMAT "%8.3" /end CHARACTERISTIC
/begin CHARACTERISTIC ASDrf_dtqNegMin_C "minimum gradient of torque limitation negative load change" VALUE 0x804FCA24 RB_Val_Ws16 6553.500 mdt_q0p1_Nm_DIV_s -3276.800 3276.700 FORMAT "%8.3" /end CHARACTERISTIC
/begin CHARACTERISTIC ASDrf_dtqPosMax_M "gradient for torque limitation positive load change" MAP 0x804FCA26 RB_Map_S16S16_S16 6553.500 mdt_q0p1_Nm_DIV_s -3276.800 3276.700 FORMAT "%8.3"
 /begin AXIS_DESCR STD_AXIS ASDrf_facDesDyn Fact 5 -4.000000 3.999878 FORMAT "%8.6" DEPOSIT ABSOLUTE /end AXIS_DESCR
 /begin AXIS_DESCR STD_AXIS Epm_nEng EngN 6 -16384.00 16383.50 FORMAT "%8.2" DEPOSIT ABSOLUTE /end AXIS_DESCR
/end CHARACTERISTIC
/begin CHARACTERISTIC ASDrf_dtqRampMtModPosAcOn_T "increase of limitation ramp in positive case for manual transmission mode when AC is ON" CURVE 0x804FB774 RB_Curve_S16_S16 327660.0 mdgrad_q10 10.0 327670.0 FORMAT "%8.1" EXTENDED_LIMITS -327680.0 327670.0
 /begin AXIS_DESCR STD_AXIS RngMod_trqClthBs md_q0p1 10 -3276.800 3276.700 FORMAT "%8.3" DEPOSIT ABSOLUTE /end AXIS_DESCR
/end CHARACTERISTIC
/begin CHARACTERISTIC ASDrf_dtqRampMtModPos_T "increase of limitation ramp in positive case for manual transmission mode" CURVE 0x804FB79E RB_Curve_S16_S16 327660.0 mdgrad_q10 10.0 327670.0 FORMAT "%8.1" EXTENDED_LIMITS -327680.0 327670.0
 /begin AXIS_DESCR STD_AXIS RngMod_trqClthBs md_q0p1 10 -3276.800 3276.700 FORMAT "%8.3" DEPOSIT ABSOLUTE /end AXIS_DESCR
/end CHARACTERISTIC
/begin CHARACTERISTIC ASDrf_dtqSprtAirCdnrOnRampPos_T "increase of limitation ramp in positive case for sport mode ac on" CURVE 0x804FB7C8 RB_Curve_S16_S16 327660.0 mdgrad_q10 10.0 327670.0 FORMAT "%8.1" EXTENDED_LIMITS -327680.0 327670.0
 /begin AXIS_DESCR STD_AXIS RngMod_trqClthBs md_q0p1 10 -3276.800 3276.700 FORMAT "%8.3" DEPOSIT ABSOLUTE /end AXIS_DESCR
/end CHARACTERISTIC
/begin CHARACTERISTIC ASDrf_dtqSprtRampMtModPos_T "increase of limitation ramp in positive case for sport manual transmission mode" CURVE 0x804FB7F2 RB_Curve_S16_S16 327660.0 mdgrad_q10 10.0 327670.0 FORMAT "%8.1" EXTENDED_LIMITS -327680.0 327670.0
 /begin AXIS_DESCR STD_AXIS RngMod_trqClthBs md_q0p1 10 -3276.800 3276.700 FORMAT "%8.3" DEPOSIT ABSOLUTE /end AXIS_DESCR
/end CHARACTERISTIC
/begin CHARACTERISTIC ASDrf_dtqSprtRampPos_T "increase of limitation ramp in positive case for sport mode" CURVE 0x804FB81C RB_Curve_S16_S16 327660.0 mdgrad_q10 10.0 327670.0 FORMAT "%8.1" EXTENDED_LIMITS -327680.0 327670.0
 /begin AXIS_DESCR STD_AXIS RngMod_trqClthBs md_q0p1 10 -3276.800 3276.700 FORMAT "%8.3" DEPOSIT ABSOLUTE /end AXIS_DESCR
/end CHARACTERISTIC
/begin CHARACTERISTIC ASDrf_dtqSptRampMtModPosAcOn_T "increase of limitation ramp in positive case for Sport manual transmission mode when AC is ON" CURVE 0x804FB846 RB_Curve_S16_S16 327660.0 mdgrad_q10 10.0 327670.0 FORMAT "%8.1" EXTENDED_LIMITS -327680.0 327670.0
 /begin AXIS_DESCR STD_AXIS RngMod_trqClthBs md_q0p1 10 -3276.800 3276.700 FORMAT "%8.3" DEPOSIT ABSOLUTE /end AXIS_DESCR
/end CHARACTERISTIC
/begin CHARACTERISTIC ASDrf_dtrqRmpPosAcOn_CUR "increase of limitation ramp in positive case during AC On" CURVE 0x804FB870 RB_Curve_S16_S16 327660.0 mdgrad_q10 10.0 327670.0 FORMAT "%8.1" EXTENDED_LIMITS -327680.0 327670.0
 /begin AXIS_DESCR STD_AXIS RngMod_trqClthBs md_q0p1 10 -3276.800 3276.700 FORMAT "%8.3" DEPOSIT ABSOLUTE /end AXIS_DESCR
/end CHARACTERISTIC
/begin CHARACTERISTIC ASDrf_dtrqRmpPos_CUR "increase of limitation ramp in positive case" CURVE 0x804FB89A RB_Curve_S16_S16 327660.0 mdgrad_q10 10.0 327670.0 FORMAT "%8.1" EXTENDED_LIMITS -327680.0 327670.0
 /begin AXIS_DESCR STD_AXIS RngMod_trqClthBs md_q0p1 10 -3276.800 3276.700 FORMAT "%8.3" DEPOSIT ABSOLUTE /end AXIS_DESCR
/end CHARACTERISTIC
/begin CHARACTERISTIC ASDrf_facAirFric_C "factor air friction torque" VALUE 0x804FCA7C RB_Val_Ws16 0.3276700 m_q0p00001 0.00 0.3276700 FORMAT "%9.7" EXTENDED_LIMITS -0.3276800 0.3276700 /end CHARACTERISTIC
/begin AXIS_PTS ASDrf_facDesDyn_DST "driveability factor" 0x804FDA48 ASDrf_facDesDyn RB_Axis_S16 7.999878 Fact 10 -4.000000 3.999878 FORMAT "%8.6" DEPOSIT ABSOLUTE /end AXIS_PTS
/begin CHARACTERISTIC ASDrf_facdtqPosMax_T "gear dependent correction of gradient for torque limitation positive load change" CURVE 0x804FCA7E RB_Curve_S8_U8_Static 3.984 fak_ub_b4 0.00 3.984 FORMAT "%5.3"
 /begin AXIS_DESCR STD_AXIS Tra_numGear OneToOne 10 -128.0 127.0 FORMAT "%5.1" DEPOSIT ABSOLUTE /end AXIS_DESCR
/end CHARACTERISTIC
/begin CHARACTERISTIC ASDrf_facLimAbv_GM "Map: factor for upper limitation edge" MAP 0x804FCA94 RB_MapGroup_U8 1.992188 fak_ub_b2 0.00 1.992188 FORMAT "%8.6"
 /begin AXIS_DESCR COM_AXIS ASDrf_facDesDyn Fact 10 -4.000000 3.999878 FORMAT "%8.6" AXIS_PTS_REF ASDrf_facDesDyn_DST /end AXIS_DESCR
 /begin AXIS_DESCR COM_AXIS ASDrf_nPt EngN 8 -16384.00 16383.50 FORMAT "%8.2" AXIS_PTS_REF ASDrf_nPt_DST /end AXIS_DESCR
/end CHARACTERISTIC
/begin CHARACTERISTIC ASDrf_facLimBlw_GM "Map: factor for lower limitation edge" MAP 0x804FCAE4 RB_MapGroup_U8 1.992188 fak_ub_b2 0.00 1.992188 FORMAT "%8.6"
 /begin AXIS_DESCR COM_AXIS ASDrf_facDesDyn Fact 10 -4.000000 3.999878 FORMAT "%8.6" AXIS_PTS_REF ASDrf_facDesDyn_DST /end AXIS_DESCR
 /begin AXIS_DESCR COM_AXIS ASDrf_nPt EngN 8 -16384.00 16383.50 FORMAT "%8.2" AXIS_PTS_REF ASDrf_nPt_DST /end AXIS_DESCR
/end CHARACTERISTIC
/begin CHARACTERISTIC ASDrf_facRampMtModPosAcOn_GM "weight of positive ramp in manual transmission mode when AC is ON" MAP 0x804FB8C4 RB_MapGroup_U8 1.000000 fak_ub_b2 0.00 1.000000 FORMAT "%8.6" EXTENDED_LIMITS 0.00 1.992188
 /begin AXIS_DESCR COM_AXIS ASDrf_facDesDyn Fact 10 -4.000000 3.999878 FORMAT "%8.6" AXIS_PTS_REF ASDrf_facDesDyn_DST /end AXIS_DESCR
 /begin AXIS_DESCR COM_AXIS Epm_nEng EngN 8 -16384.00 16383.50 FORMAT "%8.2" AXIS_PTS_REF ASDrf_nEng_DST /end AXIS_DESCR
/end CHARACTERISTIC
/begin CHARACTERISTIC ASDrf_facRampMtModPosAcOn_GT "weight of positive ramp in manual transmission mode when AC is ON" CURVE 0x804FB914 RB_CurveGroup_U8 1.000000 fak_ub_b2 0.00 1.000000 FORMAT "%8.6" EXTENDED_LIMITS 0.00 1.992188
 /begin AXIS_DESCR COM_AXIS PT_rTrq TransR 8 -327.6800 327.6700 FORMAT "%8.4" AXIS_PTS_REF ASDrf_rTrq_DST /end AXIS_DESCR
/end CHARACTERISTIC
/begin CHARACTERISTIC ASDrf_facRampMtModPos_GM "weight of positive ramp in manual transmission mode" MAP 0x804FB91C RB_MapGroup_U8 1.000000 fak_ub_b2 0.00 1.000000 FORMAT "%8.6" EXTENDED_LIMITS 0.00 1.992188
 /begin AXIS_DESCR COM_AXIS ASDrf_facDesDyn Fact 10 -4.000000 3.999878 FORMAT "%8.6" AXIS_PTS_REF ASDrf_facDesDyn_DST /end AXIS_DESCR
 /begin AXIS_DESCR COM_AXIS Epm_nEng EngN 8 -16384.00 16383.50 FORMAT "%8.2" AXIS_PTS_REF ASDrf_nEng_DST /end AXIS_DESCR
/end CHARACTERISTIC
/begin CHARACTERISTIC ASDrf_facRampMtModPos_GT "weight of positive ramp in manual transmission mode" CURVE 0x804FB96C RB_CurveGroup_U8 1.000000 fak_ub_b2 0.00 1.000000 FORMAT "%8.6" EXTENDED_LIMITS 0.00 1.992188
 /begin AXIS_DESCR COM_AXIS PT_rTrq TransR 8 -327.6800 327.6700 FORMAT "%8.4" AXIS_PTS_REF ASDrf_rTrq_DST /end AXIS_DESCR
/end CHARACTERISTIC
/begin CHARACTERISTIC ASDrf_facRmpPosAcOn_GCUR "weight of positive ramp during AC On" CURVE 0x804FB974 RB_CurveGroup_U8 1.000000 fak_ub_b2 0.00 1.000000 FORMAT "%8.6" EXTENDED_LIMITS 0.00 1.992188
 /begin AXIS_DESCR COM_AXIS PT_rTrq TransR 8 -327.6800 327.6700 FORMAT "%8.4" AXIS_PTS_REF ASDrf_rTrq_DST /end AXIS_DESCR
/end CHARACTERISTIC
/begin CHARACTERISTIC ASDrf_facRmpPosAcOn_GMAP "weight of positive ramp during AC On" MAP 0x804FB97C RB_MapGroup_U8 1.000000 fak_ub_b2 0.00 1.000000 FORMAT "%8.6" EXTENDED_LIMITS 0.00 1.992188
 /begin AXIS_DESCR COM_AXIS ASDrf_facDesDyn Fact 10 -4.000000 3.999878 FORMAT "%8.6" AXIS_PTS_REF ASDrf_facDesDyn_DST /end AXIS_DESCR
 /begin AXIS_DESCR COM_AXIS Epm_nEng EngN 8 -16384.00 16383.50 FORMAT "%8.2" AXIS_PTS_REF ASDrf_nEng_DST /end AXIS_DESCR
/end CHARACTERISTIC
/begin CHARACTERISTIC ASDrf_facRmpPos_GCUR "weight of positive ramp" CURVE 0x804FB9CC RB_CurveGroup_U8 1.000000 fak_ub_b2 0.00 1.000000 FORMAT "%8.6" EXTENDED_LIMITS 0.00 1.992188
 /begin AXIS_DESCR COM_AXIS PT_rTrq TransR 8 -327.6800 327.6700 FORMAT "%8.4" AXIS_PTS_REF ASDrf_rTrq_DST /end AXIS_DESCR
/end CHARACTERISTIC
/begin CHARACTERISTIC ASDrf_facRmpPos_GMAP "weight of positive ramp" MAP 0x804FB9D4 RB_MapGroup_U8 1.000000 fak_ub_b2 0.00 1.000000 FORMAT "%8.6" EXTENDED_LIMITS 0.00 1.992188
 /begin AXIS_DESCR COM_AXIS ASDrf_facDesDyn Fact 10 -4.000000 3.999878 FORMAT "%8.6" AXIS_PTS_REF ASDrf_facDesDyn_DST /end AXIS_DESCR
 /begin AXIS_DESCR COM_AXIS Epm_nEng EngN 8 -16384.00 16383.50 FORMAT "%8.2" AXIS_PTS_REF ASDrf_nEng_DST /end AXIS_DESCR
/end CHARACTERISTIC
/begin CHARACTERISTIC ASDrf_facRollFric_C "factor rolling friction torque" VALUE 0x804FCB34 RB_Val_Ws16 3276.700 Trq 0.00 3276.700 FORMAT "%8.3" EXTENDED_LIMITS -3276.800 3276.700 /end CHARACTERISTIC
/begin CHARACTERISTIC ASDrf_facSprtAirCdnrOnRampPos_GM "weight of positive ramp in sport mode with AC on" MAP 0x804FBA24 RB_MapGroup_U8 1.000000 fak_ub_b2 0.00 1.000000 FORMAT "%8.6" EXTENDED_LIMITS 0.00 1.992188
 /begin AXIS_DESCR COM_AXIS ASDrf_facDesDyn Fact 10 -4.000000 3.999878 FORMAT "%8.6" AXIS_PTS_REF ASDrf_facDesDyn_DST /end AXIS_DESCR
 /begin AXIS_DESCR COM_AXIS Epm_nEng EngN 8 -16384.00 16383.50 FORMAT "%8.2" AXIS_PTS_REF ASDrf_nEng_DST /end AXIS_DESCR
/end CHARACTERISTIC
/begin CHARACTERISTIC ASDrf_facSprtAirCdnrOnRampPos_GT "time constant Lead path for sport mode with AC on" CURVE 0x804FBA74 RB_CurveGroup_U8 1.000000 fak_ub_b2 0.00 1.000000 FORMAT "%8.6" EXTENDED_LIMITS 0.00 1.992188
 /begin AXIS_DESCR COM_AXIS PT_rTrq TransR 8 -327.6800 327.6700 FORMAT "%8.4" AXIS_PTS_REF ASDrf_rTrq_DST /end AXIS_DESCR
/end CHARACTERISTIC
/begin CHARACTERISTIC ASDrf_facSprtAirCdnrOnTqIniNeg_GM "weighting factor for init-jump lead dashpot in sport mode with AC on" MAP 0x804FBA7C RB_MapGroup_U8 1.000000 fak_ub_b2 0.00 1.000000 FORMAT "%8.6" EXTENDED_LIMITS 0.00 1.992188
 /begin AXIS_DESCR COM_AXIS ASDrf_tqCluBasc Trq 5 -3276.800 3276.700 FORMAT "%8.3" AXIS_PTS_REF ASDrf_trqClthBs_DST /end AXIS_DESCR
 /begin AXIS_DESCR COM_AXIS Epm_nEng EngN 8 -16384.00 16383.50 FORMAT "%8.2" AXIS_PTS_REF ASDrf_nEng_DST /end AXIS_DESCR
/end CHARACTERISTIC
/begin CHARACTERISTIC ASDrf_facSprtAirCdnrOnTqIniNeg_GT "weighting factor for init-jump lead dashpot in sport mode with AC on" CURVE 0x804FBAA4 RB_CurveGroup_U8 7.969 fak_ub_b8 0.00 7.969 FORMAT "%5.3"
 /begin AXIS_DESCR COM_AXIS PT_rTrq TransR 8 -327.6800 327.6700 FORMAT "%8.4" AXIS_PTS_REF ASDrf_rTrq_DST /end AXIS_DESCR
/end CHARACTERISTIC
/begin CHARACTERISTIC ASDrf_facSprtRampMtModPos_GM "weight of positive ramp in sport manual transmission mode" MAP 0x804FBAAC RB_MapGroup_U8 1.000000 fak_ub_b2 0.00 1.000000 FORMAT "%8.6" EXTENDED_LIMITS 0.00 1.992188
 /begin AXIS_DESCR COM_AXIS ASDrf_facDesDyn Fact 10 -4.000000 3.999878 FORMAT "%8.6" AXIS_PTS_REF ASDrf_facDesDyn_DST /end AXIS_DESCR
 /begin AXIS_DESCR COM_AXIS Epm_nEng EngN 8 -16384.00 16383.50 FORMAT "%8.2" AXIS_PTS_REF ASDrf_nEng_DST /end AXIS_DESCR
/end CHARACTERISTIC
/begin CHARACTERISTIC ASDrf_facSprtRampMtModPos_GT "weight of positive ramp in sport manual transmission mode" CURVE 0x804FBAFC RB_CurveGroup_U8 1.000000 fak_ub_b2 0.00 1.000000 FORMAT "%8.6" EXTENDED_LIMITS 0.00 1.992188
 /begin AXIS_DESCR COM_AXIS PT_rTrq TransR 8 -327.6800 327.6700 FORMAT "%8.4" AXIS_PTS_REF ASDrf_rTrq_DST /end AXIS_DESCR
/end CHARACTERISTIC
/begin CHARACTERISTIC ASDrf_facSprtRampPos_GM "weight of positive ramp in sport mode" MAP 0x804FBB04 RB_MapGroup_U8 1.000000 fak_ub_b2 0.00 1.000000 FORMAT "%8.6" EXTENDED_LIMITS 0.00 1.992188
 /begin AXIS_DESCR COM_AXIS ASDrf_facDesDyn Fact 10 -4.000000 3.999878 FORMAT "%8.6" AXIS_PTS_REF ASDrf_facDesDyn_DST /end AXIS_DESCR
 /begin AXIS_DESCR COM_AXIS Epm_nEng EngN 8 -16384.00 16383.50 FORMAT "%8.2" AXIS_PTS_REF ASDrf_nEng_DST /end AXIS_DESCR
/end CHARACTERISTIC
/begin CHARACTERISTIC ASDrf_facSprtRampPos_GT "weight of positive ramp in sport mode" CURVE 0x804FBB54 RB_CurveGroup_U8 1.000000 fak_ub_b2 0.00 1.000000 FORMAT "%8.6" EXTENDED_LIMITS 0.00 1.992188
 /begin AXIS_DESCR COM_AXIS PT_rTrq TransR 8 -327.6800 327.6700 FORMAT "%8.4" AXIS_PTS_REF ASDrf_rTrq_DST /end AXIS_DESCR
/end CHARACTERISTIC
/begin CHARACTERISTIC ASDrf_facSprtTqIniMtModNeg_GM "weighting factor for init-jump lead dashpot in sport manual transmission mode" MAP 0x804FBB5C RB_MapGroup_U8 1.000000 fak_ub_b2 0.00 1.000000 FORMAT "%8.6" EXTENDED_LIMITS 0.00 1.992188
 /begin AXIS_DESCR COM_AXIS ASDrf_tqCluBasc Trq 5 -3276.800 3276.700 FORMAT "%8.3" AXIS_PTS_REF ASDrf_trqClthBs_DST /end AXIS_DESCR
 /begin AXIS_DESCR COM_AXIS Epm_nEng EngN 8 -16384.00 16383.50 FORMAT "%8.2" AXIS_PTS_REF ASDrf_nEng_DST /end AXIS_DESCR
/end CHARACTERISTIC
/begin CHARACTERISTIC ASDrf_facSprtTqIniMtModNeg_GT "weighting factor for init-jump lead dashpot in sport manual transmission mode" CURVE 0x804FBB84 RB_CurveGroup_U8 7.969 fak_ub_b8 0.00 7.969 FORMAT "%5.3"
 /begin AXIS_DESCR COM_AXIS PT_rTrq TransR 8 -327.6800 327.6700 FORMAT "%8.4" AXIS_PTS_REF ASDrf_rTrq_DST /end AXIS_DESCR
/end CHARACTERISTIC
/begin CHARACTERISTIC ASDrf_facSprtTqIniNeg_GM "weighting factor for init-jump lead dashpot in sport mode" MAP 0x804FBB8C RB_MapGroup_U8 1.000000 fak_ub_b2 0.00 1.000000 FORMAT "%8.6" EXTENDED_LIMITS 0.00 1.992188
 /begin AXIS_DESCR COM_AXIS ASDrf_tqCluBasc Trq 5 -3276.800 3276.700 FORMAT "%8.3" AXIS_PTS_REF ASDrf_trqClthBs_DST /end AXIS_DESCR
 /begin AXIS_DESCR COM_AXIS Epm_nEng EngN 8 -16384.00 16383.50 FORMAT "%8.2" AXIS_PTS_REF ASDrf_nEng_DST /end AXIS_DESCR
/end CHARACTERISTIC
/begin CHARACTERISTIC ASDrf_facSprtTqIniNeg_GT "weighting factor for init-jump lead dashpot in sport mode" CURVE 0x804FBBB4 RB_CurveGroup_U8 7.969 fak_ub_b8 0.00 7.969 FORMAT "%5.3"
 /begin AXIS_DESCR COM_AXIS PT_rTrq TransR 8 -327.6800 327.6700 FORMAT "%8.4" AXIS_PTS_REF ASDrf_rTrq_DST /end AXIS_DESCR
/end CHARACTERISTIC
/begin CHARACTERISTIC ASDrf_facSptRampMtModPosAcOn_GM "weight of positive ramp in Sport manual transmission mode when AC is ON" MAP 0x804FBBBC RB_MapGroup_U8 1.000000 fak_ub_b2 0.00 1.000000 FORMAT "%8.6" EXTENDED_LIMITS 0.00 1.992188
 /begin AXIS_DESCR COM_AXIS ASDrf_facDesDyn Fact 10 -4.000000 3.999878 FORMAT "%8.6" AXIS_PTS_REF ASDrf_facDesDyn_DST /end AXIS_DESCR
 /begin AXIS_DESCR COM_AXIS Epm_nEng EngN 8 -16384.00 16383.50 FORMAT "%8.2" AXIS_PTS_REF ASDrf_nEng_DST /end AXIS_DESCR
/end CHARACTERISTIC
/begin CHARACTERISTIC ASDrf_facSptRampMtModPosAcOn_GT "weight of positive ramp in Sport manual transmission mode when AC is ON" CURVE 0x804FBC0C RB_CurveGroup_U8 1.000000 fak_ub_b2 0.00 1.000000 FORMAT "%8.6" EXTENDED_LIMITS 0.00 1.992188
 /begin AXIS_DESCR COM_AXIS PT_rTrq TransR 8 -327.6800 327.6700 FORMAT "%8.4" AXIS_PTS_REF ASDrf_rTrq_DST /end AXIS_DESCR
/end CHARACTERISTIC
/begin CHARACTERISTIC ASDrf_facSptTqIniMtModNegAcOn_GM "weighting factor for init-jump lead dashpot in sport manual transmission mode when AC is ON" MAP 0x804FBC14 RB_MapGroup_U8 1.000000 fak_ub_b2 0.00 1.000000 FORMAT "%8.6" EXTENDED_LIMITS 0.00 1.992188
 /begin AXIS_DESCR COM_AXIS ASDrf_tqCluBasc Trq 5 -3276.800 3276.700 FORMAT "%8.3" AXIS_PTS_REF ASDrf_trqClthBs_DST /end AXIS_DESCR
 /begin AXIS_DESCR COM_AXIS Epm_nEng EngN 8 -16384.00 16383.50 FORMAT "%8.2" AXIS_PTS_REF ASDrf_nEng_DST /end AXIS_DESCR
/end CHARACTERISTIC
/begin CHARACTERISTIC ASDrf_facSptTqIniMtModNegAcOn_GT "weighting factor for init-jump lead dashpot in sport manual transmission mode when AC is ON" CURVE 0x804FBC3C RB_CurveGroup_U8 7.969 fak_ub_b8 0.00 7.969 FORMAT "%5.3"
 /begin AXIS_DESCR COM_AXIS PT_rTrq TransR 8 -327.6800 327.6700 FORMAT "%8.4" AXIS_PTS_REF ASDrf_rTrq_DST /end AXIS_DESCR
/end CHARACTERISTIC
/begin CHARACTERISTIC ASDrf_facTiAirCdnrOnNegLead_GT "weighting factor time constant lead path for AC on" CURVE 0x804FBC44 RB_CurveGroup_U8 7.969 fak_ub_b8 0.00 7.969 FORMAT "%5.3"
 /begin AXIS_DESCR COM_AXIS PT_rTrq TransR 8 -327.6800 327.6700 FORMAT "%8.4" AXIS_PTS_REF ASDrf_rTrq_DST /end AXIS_DESCR
/end CHARACTERISTIC
/begin CHARACTERISTIC ASDrf_facTiMtModNegLeadAcOn_GT "weighting factor time constant lead path when AC is ON" CURVE 0x804FBC4C RB_CurveGroup_U8 7.969 fak_ub_b8 0.00 7.969 FORMAT "%5.3"
 /begin AXIS_DESCR COM_AXIS PT_rTrq TransR 8 -327.6800 327.6700 FORMAT "%8.4" AXIS_PTS_REF ASDrf_rTrq_DST /end AXIS_DESCR
/end CHARACTERISTIC
/begin CHARACTERISTIC ASDrf_facTiMtModNegLead_GT "weighting factor time constant lead path" CURVE 0x804FBC54 RB_CurveGroup_U8 7.969 fak_ub_b8 0.00 7.969 FORMAT "%5.3"
 /begin AXIS_DESCR COM_AXIS PT_rTrq TransR 8 -327.6800 327.6700 FORMAT "%8.4" AXIS_PTS_REF ASDrf_rTrq_DST /end AXIS_DESCR
/end CHARACTERISTIC
/begin CHARACTERISTIC ASDrf_facTiMtModSptNegLeadAcOn_GT "weighting factor time constant lead path in Sport manual transmission when AC is ON" CURVE 0x804FBC5C RB_CurveGroup_U8 7.969 fak_ub_b8 0.00 7.969 FORMAT "%5.3"
 /begin AXIS_DESCR COM_AXIS PT_rTrq TransR 8 -327.6800 327.6700 FORMAT "%8.4" AXIS_PTS_REF ASDrf_rTrq_DST /end AXIS_DESCR
/end CHARACTERISTIC
/begin CHARACTERISTIC ASDrf_facTiMtModSptNegLead_GT "weighting factor time constant lead path in Sport manual transmission" CURVE 0x804FBC64 RB_CurveGroup_U8 7.969 fak_ub_b8 0.00 7.969 FORMAT "%5.3"
 /begin AXIS_DESCR COM_AXIS PT_rTrq TransR 8 -327.6800 327.6700 FORMAT "%8.4" AXIS_PTS_REF ASDrf_rTrq_DST /end AXIS_DESCR
/end CHARACTERISTIC
/begin CHARACTERISTIC ASDrf_facTiNegLead_GCUR "weighting factor time constant lead path" CURVE 0x804FBC6C RB_CurveGroup_U8 7.969 fak_ub_b8 0.00 7.969 FORMAT "%5.3"
 /begin AXIS_DESCR COM_AXIS PT_rTrq TransR 8 -327.6800 327.6700 FORMAT "%8.4" AXIS_PTS_REF ASDrf_rTrq_DST /end AXIS_DESCR
/end CHARACTERISTIC
/begin CHARACTERISTIC ASDrf_facTiOscdtqNeg_C "factor of duration time fo reduction to reference torque negative load change" VALUE 0x804FCB36 RB_Val_Wu8 1.992188 fak_ub_b2 0.00 1.992188 FORMAT "%8.6" /end CHARACTERISTIC
/begin CHARACTERISTIC ASDrf_facTiOscLimPos_C "factor of duration time as maximum time for limitation positive load change" VALUE 0x804FCB37 RB_Val_Wu8 1.992188 fak_ub_b2 0.00 1.992188 FORMAT "%8.6" /end CHARACTERISTIC
/begin CHARACTERISTIC ASDrf_facTiOscStrtRed_C "factor of duration time as maximum time for start torque reduction negative load change" VALUE 0x804FCB38 RB_Val_Wu8 1.992188 fak_ub_b2 0.00 1.992188 FORMAT "%8.6" /end CHARACTERISTIC
/begin CHARACTERISTIC ASDrf_facTiSprtAirCdnrOnNegLead_GT "weighting factor time constant lead path for sport mode with AC on" CURVE 0x804FBC74 RB_CurveGroup_U8 7.969 fak_ub_b8 0.00 7.969 FORMAT "%5.3"
 /begin AXIS_DESCR COM_AXIS PT_rTrq TransR 8 -327.6800 327.6700 FORMAT "%8.4" AXIS_PTS_REF ASDrf_rTrq_DST /end AXIS_DESCR
/end CHARACTERISTIC
/begin CHARACTERISTIC ASDrf_facTiSprtNegLead_GT "weighting factor time constant lead path for sport mode" CURVE 0x804FBC7C RB_CurveGroup_U8 7.969 fak_ub_b8 0.00 7.969 FORMAT "%5.3"
 /begin AXIS_DESCR COM_AXIS PT_rTrq TransR 8 -327.6800 327.6700 FORMAT "%8.4" AXIS_PTS_REF ASDrf_rTrq_DST /end AXIS_DESCR
/end CHARACTERISTIC
/begin CHARACTERISTIC ASDrf_facTqBasLim_C "factor base torque adjustment for requested set torque" VALUE 0x804FB770 RB_Val_Wu8 0.1875000 fak_ub_b2 1.015625 1.203125 FORMAT "%8.6" EXTENDED_LIMITS 0.00 1.992188 /end CHARACTERISTIC
/begin CHARACTERISTIC ASDrf_facTqIniAirCdnrOnNeg_GM "weighting factor for init-jump lead dashpot for AC on" MAP 0x804FBC84 RB_MapGroup_U8 1.000000 fak_ub_b2 0.00 1.000000 FORMAT "%8.6" EXTENDED_LIMITS 0.00 1.992188
 /begin AXIS_DESCR COM_AXIS ASDrf_tqCluBasc Trq 5 -3276.800 3276.700 FORMAT "%8.3" AXIS_PTS_REF ASDrf_trqClthBs_DST /end AXIS_DESCR
 /begin AXIS_DESCR COM_AXIS Epm_nEng EngN 8 -16384.00 16383.50 FORMAT "%8.2" AXIS_PTS_REF ASDrf_nEng_DST /end AXIS_DESCR
/end CHARACTERISTIC
/begin CHARACTERISTIC ASDrf_facTqIniAirCdnrOnNeg_GT "weighting factor for init-jump lead dashpot for AC on" CURVE 0x804FBCAC RB_CurveGroup_U8 7.969 fak_ub_b8 0.00 7.969 FORMAT "%5.3"
 /begin AXIS_DESCR COM_AXIS PT_rTrq TransR 8 -327.6800 327.6700 FORMAT "%8.4" AXIS_PTS_REF ASDrf_rTrq_DST /end AXIS_DESCR
/end CHARACTERISTIC
/begin CHARACTERISTIC ASDrf_facTqIniMtModNegAcOn_GM "weighting factor for init-jump lead dashpot in manual transmission mode when AC is ON" MAP 0x804FBCB4 RB_MapGroup_U8 1.000000 fak_ub_b2 0.00 1.000000 FORMAT "%8.6" EXTENDED_LIMITS 0.00 1.992188
 /begin AXIS_DESCR COM_AXIS ASDrf_tqCluBasc Trq 5 -3276.800 3276.700 FORMAT "%8.3" AXIS_PTS_REF ASDrf_trqClthBs_DST /end AXIS_DESCR
 /begin AXIS_DESCR COM_AXIS Epm_nEng EngN 8 -16384.00 16383.50 FORMAT "%8.2" AXIS_PTS_REF ASDrf_nEng_DST /end AXIS_DESCR
/end CHARACTERISTIC
/begin CHARACTERISTIC ASDrf_facTqIniMtModNegAcOn_GT "weighting factor for init-jump lead dashpot in manual transmission mode when AC is ON" CURVE 0x804FBCDC RB_CurveGroup_U8 7.969 fak_ub_b8 0.00 7.969 FORMAT "%5.3"
 /begin AXIS_DESCR COM_AXIS PT_rTrq TransR 8 -327.6800 327.6700 FORMAT "%8.4" AXIS_PTS_REF ASDrf_rTrq_DST /end AXIS_DESCR
/end CHARACTERISTIC
/begin CHARACTERISTIC ASDrf_facTqIniMtModNeg_GM "weighting factor for init-jump lead dashpot in manual transmission mode" MAP 0x804FBCE4 RB_MapGroup_U8 1.000000 fak_ub_b2 0.00 1.000000 FORMAT "%8.6" EXTENDED_LIMITS 0.00 1.992188
 /begin AXIS_DESCR COM_AXIS ASDrf_tqCluBasc Trq 5 -3276.800 3276.700 FORMAT "%8.3" AXIS_PTS_REF ASDrf_trqClthBs_DST /end AXIS_DESCR
 /begin AXIS_DESCR COM_AXIS Epm_nEng EngN 8 -16384.00 16383.50 FORMAT "%8.2" AXIS_PTS_REF ASDrf_nEng_DST /end AXIS_DESCR
/end CHARACTERISTIC
/begin CHARACTERISTIC ASDrf_facTqIniMtModNeg_GT "weighting factor for init-jump lead dashpot in manual transmission mode" CURVE 0x804FBD0C RB_CurveGroup_U8 7.969 fak_ub_b8 0.00 7.969 FORMAT "%5.3"
 /begin AXIS_DESCR COM_AXIS PT_rTrq TransR 8 -327.6800 327.6700 FORMAT "%8.4" AXIS_PTS_REF ASDrf_rTrq_DST /end AXIS_DESCR
/end CHARACTERISTIC
/begin CHARACTERISTIC ASDrf_facTqIniTEngAirCdnrOnNeg_GT "engine temperature dependent weighting factor for init-jump lead dashpot for AC on" CURVE 0x804FBD14 RB_CurveGroup_U8 1.992188 fak_ub_b2 0.00 1.992188 FORMAT "%8.6"
 /begin AXIS_DESCR COM_AXIS EngDa_tEng Temp_Cels 6 -3549.940 3003.560 FORMAT "%8.3" AXIS_PTS_REF ASDrf_tEng_DST /end AXIS_DESCR
/end CHARACTERISTIC
/begin CHARACTERISTIC ASDrf_facTqIniTEngNeg_GT "engine temperature dependent weighting factor for init-jump lead dashpot" CURVE 0x804FBD1A RB_CurveGroup_U8 1.992188 fak_ub_b2 0.00 1.992188 FORMAT "%8.6"
 /begin AXIS_DESCR COM_AXIS EngDa_tEng Temp_Cels 6 -3549.940 3003.560 FORMAT "%8.3" AXIS_PTS_REF ASDrf_tEng_DST /end AXIS_DESCR
/end CHARACTERISTIC
/begin CHARACTERISTIC ASDrf_factqOffNeg_T "gear dependent correction of offset for reference torque negative load change" CURVE 0x804FCB3A RB_Curve_S8_U8_Static 3.984 fak_ub_b4 0.00 3.984 FORMAT "%5.3"
 /begin AXIS_DESCR STD_AXIS Tra_numGear OneToOne 10 -128.0 127.0 FORMAT "%5.1" DEPOSIT ABSOLUTE /end AXIS_DESCR
/end CHARACTERISTIC
/begin CHARACTERISTIC ASDrf_factqOffPos_T "gear dependent correction of offset for reference torque positive load change" CURVE 0x804FCB50 RB_Curve_S8_U8_Static 3.984 fak_ub_b4 0.00 3.984 FORMAT "%5.3"
 /begin AXIS_DESCR STD_AXIS Tra_numGear OneToOne 10 -128.0 127.0 FORMAT "%5.1" DEPOSIT ABSOLUTE /end AXIS_DESCR
/end CHARACTERISTIC
/begin CHARACTERISTIC ASDrf_facTrqIniNeg_GCUR "weighting factor for init-jump lead dashpot" CURVE 0x804FBD20 RB_CurveGroup_U8 7.969 fak_ub_b8 0.00 7.969 FORMAT "%5.3"
 /begin AXIS_DESCR COM_AXIS PT_rTrq TransR 8 -327.6800 327.6700 FORMAT "%8.4" AXIS_PTS_REF ASDrf_rTrq_DST /end AXIS_DESCR
/end CHARACTERISTIC
/begin CHARACTERISTIC ASDrf_facTrqIniNeg_GMAP "weighting factor for init-jump lead dashpot" MAP 0x804FBD28 RB_MapGroup_U8 1.000000 fak_ub_b2 0.00 1.000000 FORMAT "%8.6" EXTENDED_LIMITS 0.00 1.992188
 /begin AXIS_DESCR COM_AXIS ASDrf_tqCluBasc Trq 5 -3276.800 3276.700 FORMAT "%8.3" AXIS_PTS_REF ASDrf_trqClthBs_DST /end AXIS_DESCR
 /begin AXIS_DESCR COM_AXIS Epm_nEng EngN 8 -16384.00 16383.50 FORMAT "%8.2" AXIS_PTS_REF ASDrf_nEng_DST /end AXIS_DESCR
/end CHARACTERISTIC
/begin AXIS_PTS ASDrf_nEng_DST "engine speed" 0x804FE3AE Epm_nEng RB_Axis_S16 32767.50 EngN 8 -16384.00 16383.50 FORMAT "%8.2" DEPOSIT ABSOLUTE /end AXIS_PTS
/begin AXIS_PTS ASDrf_nPt_DST "speed powertrain" 0x804FE3C0 ASDrf_nPt RB_Axis_S16 32767.50 EngN 8 -16384.00 16383.50 FORMAT "%8.2" DEPOSIT ABSOLUTE /end AXIS_PTS
/begin AXIS_PTS ASDrf_ratApp_DST "Accelerator pedal ratio" 0x804FCB66 APP_r RB_Axis_S16 799.9878 Prc 10 -400.0000 399.9878 FORMAT "%8.4" DEPOSIT ABSOLUTE /end AXIS_PTS
/begin CHARACTERISTIC ASDrf_rGripThdSlip_C "Grip Threshold" VALUE 0x804FCB7C RB_Val_Ws16 655.3500 TransR -327.6800 327.6700 FORMAT "%8.4" /end CHARACTERISTIC
/begin AXIS_PTS ASDrf_rTrq_DST "ratio of transmission" 0x804FED5C PT_rTrq RB_Axis_S16 655.3500 TransR 8 -327.6800 327.6700 FORMAT "%8.4" DEPOSIT ABSOLUTE /end AXIS_PTS
/begin CHARACTERISTIC ASDrf_swtTrqRng_C "Calibration to switch between Inner torque and clutch torque" VALUE 0x804FBD50 RB_Val_Wboolean 1.00000000000 B_TRUE 0.00 1.00000000000 FORMAT "%13.11" /end CHARACTERISTIC
/begin CHARACTERISTIC ASDrf_tCooltHiThd_C "High threshold for coolant temperature" VALUE 0x804FCB7E RB_Val_Ws16 6553.500 Temp_Cels -3549.940 3003.560 FORMAT "%8.3" /end CHARACTERISTIC
/begin CHARACTERISTIC ASDrf_tCooltLoThd_C "Low threshold for coolant temperature" VALUE 0x804FCB80 RB_Val_Ws16 6553.500 Temp_Cels -3549.940 3003.560 FORMAT "%8.3" /end CHARACTERISTIC
/begin AXIS_PTS ASDrf_tEng_DST "engine temperature" 0x804FED92 EngDa_tEng RB_Axis_S16 6553.500 Temp_Cels 6 -3549.940 3003.560 FORMAT "%8.3" DEPOSIT ABSOLUTE /end AXIS_PTS
/begin CHARACTERISTIC ASDrf_tiAirCdnrOnNegLead_GM "time constant Lead path for AC on" MAP 0x804FBD51 RB_MapGroup_U8 2.550 t_q0p01 0.00 2.550 FORMAT "%5.3"
 /begin AXIS_DESCR COM_AXIS ASDrf_tqCluBasc Trq 5 -3276.800 3276.700 FORMAT "%8.3" AXIS_PTS_REF ASDrf_trqClthBs_DST /end AXIS_DESCR
 /begin AXIS_DESCR COM_AXIS Epm_nEng EngN 8 -16384.00 16383.50 FORMAT "%8.2" AXIS_PTS_REF ASDrf_nEng_DST /end AXIS_DESCR
/end CHARACTERISTIC
/begin CHARACTERISTIC ASDrf_tiMaxPos_GMAP "maximum delay time" MAP 0x804FBD79 RB_MapGroup_U8 2.530 t_q0p01 0.010 2.540 FORMAT "%5.3" EXTENDED_LIMITS 0.00 2.550
 /begin AXIS_DESCR COM_AXIS ASDrf_facDesDyn Fact 10 -4.000000 3.999878 FORMAT "%8.6" AXIS_PTS_REF ASDrf_facDesDyn_DST /end AXIS_DESCR
 /begin AXIS_DESCR COM_AXIS ASDrf_nPt EngN 8 -16384.00 16383.50 FORMAT "%8.2" AXIS_PTS_REF ASDrf_nPt_DST /end AXIS_DESCR
/end CHARACTERISTIC
/begin CHARACTERISTIC ASDrf_tiMtModNegLeadAcOn_GM "time constant Lead path for manual transmission mode when AC is ON" MAP 0x804FBDC9 RB_MapGroup_U8 2.550 t_q0p01 0.00 2.550 FORMAT "%5.3"
 /begin AXIS_DESCR COM_AXIS ASDrf_tqCluBasc Trq 5 -3276.800 3276.700 FORMAT "%8.3" AXIS_PTS_REF ASDrf_trqClthBs_DST /end AXIS_DESCR
 /begin AXIS_DESCR COM_AXIS Epm_nEng EngN 8 -16384.00 16383.50 FORMAT "%8.2" AXIS_PTS_REF ASDrf_nEng_DST /end AXIS_DESCR
/end CHARACTERISTIC
/begin CHARACTERISTIC ASDrf_tiMtModNegLead_GM "time constant Lead path for manual transmission mode" MAP 0x804FBDF1 RB_MapGroup_U8 2.550 t_q0p01 0.00 2.550 FORMAT "%5.3"
 /begin AXIS_DESCR COM_AXIS ASDrf_tqCluBasc Trq 5 -3276.800 3276.700 FORMAT "%8.3" AXIS_PTS_REF ASDrf_trqClthBs_DST /end AXIS_DESCR
 /begin AXIS_DESCR COM_AXIS ASDrf_nPt EngN 8 -16384.00 16383.50 FORMAT "%8.2" AXIS_PTS_REF ASDrf_nPt_DST /end AXIS_DESCR
/end CHARACTERISTIC
/begin CHARACTERISTIC ASDrf_tiMtModSptNegLeadAcOn_GM "time constant Lead path for Sport manual transmission mode when AC is ON" MAP 0x804FBE19 RB_MapGroup_U8 2.550 t_q0p01 0.00 2.550 FORMAT "%5.3"
 /begin AXIS_DESCR COM_AXIS ASDrf_tqCluBasc Trq 5 -3276.800 3276.700 FORMAT "%8.3" AXIS_PTS_REF ASDrf_trqClthBs_DST /end AXIS_DESCR
 /begin AXIS_DESCR COM_AXIS Epm_nEng EngN 8 -16384.00 16383.50 FORMAT "%8.2" AXIS_PTS_REF ASDrf_nEng_DST /end AXIS_DESCR
/end CHARACTERISTIC
/begin CHARACTERISTIC ASDrf_tiMtModSptNegLead_GM "time constant Lead path for Sport manual transmission mode" MAP 0x804FBE41 RB_MapGroup_U8 2.550 t_q0p01 0.00 2.550 FORMAT "%5.3"
 /begin AXIS_DESCR COM_AXIS ASDrf_tqCluBasc Trq 5 -3276.800 3276.700 FORMAT "%8.3" AXIS_PTS_REF ASDrf_trqClthBs_DST /end AXIS_DESCR
 /begin AXIS_DESCR COM_AXIS Epm_nEng EngN 8 -16384.00 16383.50 FORMAT "%8.2" AXIS_PTS_REF ASDrf_nEng_DST /end AXIS_DESCR
/end CHARACTERISTIC
/begin CHARACTERISTIC ASDrf_tiNegLead_GMAP "time constant Lead path" MAP 0x804FBE69 RB_MapGroup_U8 2.550 t_q0p01 0.00 2.550 FORMAT "%5.3"
 /begin AXIS_DESCR COM_AXIS ASDrf_tqCluBasc Trq 5 -3276.800 3276.700 FORMAT "%8.3" AXIS_PTS_REF ASDrf_trqClthBs_DST /end AXIS_DESCR
 /begin AXIS_DESCR COM_AXIS ASDrf_nPt EngN 8 -16384.00 16383.50 FORMAT "%8.2" AXIS_PTS_REF ASDrf_nPt_DST /end AXIS_DESCR
/end CHARACTERISTIC
/begin CHARACTERISTIC ASDrf_tiOscNeg_T "cycle duration negative load change" CURVE 0x804FCB82 RB_Curve_S16_U16_Static 655.3500 t_q0p01 0.00 655.3500 FORMAT "%8.4"
 /begin AXIS_DESCR STD_AXIS Tra_numGear OneToOne 10 -128.0000 127.0000 FORMAT "%8.4" EXTENDED_LIMITS -32768.00 32767.00 DEPOSIT ABSOLUTE /end AXIS_DESCR
/end CHARACTERISTIC
/begin CHARACTERISTIC ASDrf_tiOscPos_T "cycle duration positive load change" CURVE 0x804FCBAC RB_Curve_S16_U16_Static 655.3500 t_q0p01 0.00 655.3500 FORMAT "%8.4"
 /begin AXIS_DESCR STD_AXIS Tra_numGear OneToOne 10 -128.0000 127.0000 FORMAT "%8.4" EXTENDED_LIMITS -32768.00 32767.00 DEPOSIT ABSOLUTE /end AXIS_DESCR
/end CHARACTERISTIC
/begin CHARACTERISTIC ASDrf_tiSprtAirCdnrOnNegLead_GM "time constant Lead path for sport mode with AC on" MAP 0x804FBE91 RB_MapGroup_U8 2.550 t_q0p01 0.00 2.550 FORMAT "%5.3"
 /begin AXIS_DESCR COM_AXIS ASDrf_tqCluBasc Trq 5 -3276.800 3276.700 FORMAT "%8.3" AXIS_PTS_REF ASDrf_trqClthBs_DST /end AXIS_DESCR
 /begin AXIS_DESCR COM_AXIS Epm_nEng EngN 8 -16384.00 16383.50 FORMAT "%8.2" AXIS_PTS_REF ASDrf_nEng_DST /end AXIS_DESCR
/end CHARACTERISTIC
/begin CHARACTERISTIC ASDrf_tiSprtNegLead_GM "time constant Lead path for sport mode" MAP 0x804FBEB9 RB_MapGroup_U8 2.550 t_q0p01 0.00 2.550 FORMAT "%5.3"
 /begin AXIS_DESCR COM_AXIS ASDrf_tqCluBasc Trq 5 -3276.800 3276.700 FORMAT "%8.3" AXIS_PTS_REF ASDrf_trqClthBs_DST /end AXIS_DESCR
 /begin AXIS_DESCR COM_AXIS Epm_nEng EngN 8 -16384.00 16383.50 FORMAT "%8.2" AXIS_PTS_REF ASDrf_nEng_DST /end AXIS_DESCR
/end CHARACTERISTIC
/begin CHARACTERISTIC ASDrf_tqLimAbv_GT "Curve: upper limitation edge" CURVE 0x804FCBD6 RB_CurveGroup_S16 6553.500 md_sw_q0p1 -3276.800 3276.700 FORMAT "%8.3"
 /begin AXIS_DESCR COM_AXIS PT_rTrq TransR 8 -327.6800 327.6700 FORMAT "%8.4" AXIS_PTS_REF ASDrf_rTrq_DST /end AXIS_DESCR
/end CHARACTERISTIC
/begin CHARACTERISTIC ASDrf_tqLimBlw_GT "Curve: lower limitation edge" CURVE 0x804FCBE6 RB_CurveGroup_S16 6553.500 md_sw_q0p1 -3276.800 3276.700 FORMAT "%8.3"
 /begin AXIS_DESCR COM_AXIS PT_rTrq TransR 8 -327.6800 327.6700 FORMAT "%8.4" AXIS_PTS_REF ASDrf_rTrq_DST /end AXIS_DESCR
/end CHARACTERISTIC
/begin CHARACTERISTIC ASDrf_tqLimNegOff_C "offset to reference torque to break limitation" VALUE 0x804FCBF6 RB_Val_Ws16 6553.500 Trq -3276.800 3276.700 FORMAT "%8.3" /end CHARACTERISTIC
/begin CHARACTERISTIC ASDrf_tqLossOffsMtModNegLeadAcOn_GT "offset to clutch torque zero in manual transmission mode when AC is ON for negative case" CURVE 0x804FBEE2 RB_CurveGroup_S16 6553.500 md_q0p1 -3276.800 3276.700 FORMAT "%8.3"
 /begin AXIS_DESCR COM_AXIS Epm_nEng EngN 8 -16384.00 16383.50 FORMAT "%8.2" AXIS_PTS_REF ASDrf_nEng_DST /end AXIS_DESCR
/end CHARACTERISTIC
/begin CHARACTERISTIC ASDrf_tqLossOffsMtModNegLead_GT "offset to clutch torque zero in manual transmission mode" CURVE 0x804FBEF2 RB_CurveGroup_S16 6553.500 md_q0p1 -3276.800 3276.700 FORMAT "%8.3"
 /begin AXIS_DESCR COM_AXIS Epm_nEng EngN 8 -16384.00 16383.50 FORMAT "%8.2" AXIS_PTS_REF ASDrf_nEng_DST /end AXIS_DESCR
/end CHARACTERISTIC
/begin CHARACTERISTIC ASDrf_tqLossOffsMtModPosLeadAcOn_GM "offset to clutch torque zero in manual transmission mode when AC is ON for positive case" MAP 0x804FBF02 RB_MapGroup_S16 6553.500 md_q0p1 -3276.800 3276.700 FORMAT "%8.3"
 /begin AXIS_DESCR COM_AXIS ASDrf_facDesDyn Fact 10 -4.000000 3.999878 FORMAT "%8.6" AXIS_PTS_REF ASDrf_facDesDyn_DST /end AXIS_DESCR
 /begin AXIS_DESCR COM_AXIS Epm_nEng EngN 8 -16384.00 16383.50 FORMAT "%8.2" AXIS_PTS_REF ASDrf_nEng_DST /end AXIS_DESCR
/end CHARACTERISTIC
/begin CHARACTERISTIC ASDrf_tqLossOffsMtModPosLead_GM "offset to clutch torque zero in manual transmission mode" MAP 0x804FBFA2 RB_MapGroup_S16 6553.500 md_q0p1 -3276.800 3276.700 FORMAT "%8.3"
 /begin AXIS_DESCR COM_AXIS ASDrf_facDesDyn Fact 10 -4.000000 3.999878 FORMAT "%8.6" AXIS_PTS_REF ASDrf_facDesDyn_DST /end AXIS_DESCR
 /begin AXIS_DESCR COM_AXIS Epm_nEng EngN 8 -16384.00 16383.50 FORMAT "%8.2" AXIS_PTS_REF ASDrf_nEng_DST /end AXIS_DESCR
/end CHARACTERISTIC
/begin CHARACTERISTIC ASDrf_tqLossOffsSlipOpenPos_GM "Offset to Loss-torque for init at open converter clutch (ASDrf_bNoRmp), to avoid dopple crossing of engine speed." MAP 0x804FCBF8 RB_MapGroup_S16 6553.500 md_q0p1 -3276.800 3276.700 FORMAT "%8.3"
 /begin AXIS_DESCR COM_AXIS PT_rTrq TransR 8 -327.6800 327.6700 FORMAT "%8.4" AXIS_PTS_REF ASDrf_rTrq_DST /end AXIS_DESCR
 /begin AXIS_DESCR COM_AXIS APP_r Prc 10 -400.0000 399.9878 FORMAT "%8.4" AXIS_PTS_REF ASDrf_ratApp_DST /end AXIS_DESCR
/end CHARACTERISTIC
/begin CHARACTERISTIC ASDrf_tqLossOffsSlipOpenSpt_GM "Offset to Loss-torque for init at open converter clutch (ASDrf_bNoRmp), to avoid dopple crossing of engine speed for Sport mode" MAP 0x804FCC98 RB_MapGroup_S16 6553.500 md_q0p1 -3276.800 3276.700 FORMAT "%8.3"
 /begin AXIS_DESCR COM_AXIS PT_rTrq TransR 8 -327.6800 327.6700 FORMAT "%8.4" AXIS_PTS_REF ASDrf_rTrq_DST /end AXIS_DESCR
 /begin AXIS_DESCR COM_AXIS APP_r Prc 10 -400.0000 399.9878 FORMAT "%8.4" AXIS_PTS_REF ASDrf_ratApp_DST /end AXIS_DESCR
/end CHARACTERISTIC
/begin CHARACTERISTIC ASDrf_tqLossOffsSlipOpenTrsmMt_GM "Offset to Loss-torque for init at open converter clutch (ASDrf_bNoRmp), to avoid dopple crossing of engine speed for manual transmission" MAP 0x804FCD38 RB_MapGroup_S16 6553.500 md_q0p1 -3276.800 3276.700 FORMAT "%8.3"
 /begin AXIS_DESCR COM_AXIS PT_rTrq TransR 8 -327.6800 327.6700 FORMAT "%8.4" AXIS_PTS_REF ASDrf_rTrq_DST /end AXIS_DESCR
 /begin AXIS_DESCR COM_AXIS APP_r Prc 10 -400.0000 399.9878 FORMAT "%8.4" AXIS_PTS_REF ASDrf_ratApp_DST /end AXIS_DESCR
/end CHARACTERISTIC
/begin CHARACTERISTIC ASDrf_tqLossSprtAirCdnrOnOffsNegLead_GT "offset to clutch torque zero in sport mode with AC on" CURVE 0x804FC042 RB_CurveGroup_S16 6553.500 md_q0p1 -3276.800 3276.700 FORMAT "%8.3"
 /begin AXIS_DESCR COM_AXIS Epm_nEng EngN 8 -16384.00 16383.50 FORMAT "%8.2" AXIS_PTS_REF ASDrf_nEng_DST /end AXIS_DESCR
/end CHARACTERISTIC
/begin CHARACTERISTIC ASDrf_tqLossSprtAirCdnrOnOffsPosLead_GM "offset to clutch torque zero in sport mode with AC on" MAP 0x804FC052 RB_MapGroup_S16 6553.500 md_q0p1 -3276.800 3276.700 FORMAT "%8.3"
 /begin AXIS_DESCR COM_AXIS ASDrf_facDesDyn Fact 10 -4.000000 3.999878 FORMAT "%8.6" AXIS_PTS_REF ASDrf_facDesDyn_DST /end AXIS_DESCR
 /begin AXIS_DESCR COM_AXIS Epm_nEng EngN 8 -16384.00 16383.50 FORMAT "%8.2" AXIS_PTS_REF ASDrf_nEng_DST /end AXIS_DESCR
/end CHARACTERISTIC
/begin CHARACTERISTIC ASDrf_tqLossSprtOffsMtModNegLead_GT "offset to clutch torque zero in sport manual transmission mode" CURVE 0x804FC0F2 RB_CurveGroup_S16 6553.500 md_q0p1 -3276.800 3276.700 FORMAT "%8.3"
 /begin AXIS_DESCR COM_AXIS Epm_nEng EngN 8 -16384.00 16383.50 FORMAT "%8.2" AXIS_PTS_REF ASDrf_nEng_DST /end AXIS_DESCR
/end CHARACTERISTIC
/begin CHARACTERISTIC ASDrf_tqLossSprtOffsMtModPosLead_GM "offset to clutch torque zero in sport manual transmission mode" MAP 0x804FC102 RB_MapGroup_S16 6553.500 md_q0p1 -3276.800 3276.700 FORMAT "%8.3"
 /begin AXIS_DESCR COM_AXIS ASDrf_facDesDyn Fact 10 -4.000000 3.999878 FORMAT "%8.6" AXIS_PTS_REF ASDrf_facDesDyn_DST /end AXIS_DESCR
 /begin AXIS_DESCR COM_AXIS Epm_nEng EngN 8 -16384.00 16383.50 FORMAT "%8.2" AXIS_PTS_REF ASDrf_nEng_DST /end AXIS_DESCR
/end CHARACTERISTIC
/begin CHARACTERISTIC ASDrf_tqLossSprtOffsNegLead_GT "offset to clutch torque zero in sport mode" CURVE 0x804FC1A2 RB_CurveGroup_S16 6553.500 md_q0p1 -3276.800 3276.700 FORMAT "%8.3"
 /begin AXIS_DESCR COM_AXIS Epm_nEng EngN 8 -16384.00 16383.50 FORMAT "%8.2" AXIS_PTS_REF ASDrf_nEng_DST /end AXIS_DESCR
/end CHARACTERISTIC
/begin CHARACTERISTIC ASDrf_tqLossSprtOffsPosLead_GM "offset to clutch torque zero in sport mode" MAP 0x804FC1B2 RB_MapGroup_S16 6553.500 md_q0p1 -3276.800 3276.700 FORMAT "%8.3"
 /begin AXIS_DESCR COM_AXIS ASDrf_facDesDyn Fact 10 -4.000000 3.999878 FORMAT "%8.6" AXIS_PTS_REF ASDrf_facDesDyn_DST /end AXIS_DESCR
 /begin AXIS_DESCR COM_AXIS Epm_nEng EngN 8 -16384.00 16383.50 FORMAT "%8.2" AXIS_PTS_REF ASDrf_nEng_DST /end AXIS_DESCR
/end CHARACTERISTIC
/begin CHARACTERISTIC ASDrf_tqLossSptOffsMtModNegLeadAcOn_GT "offset to clutch torque zero in Sport manual transmission mode when AC is ON for negative case" CURVE 0x804FC252 RB_CurveGroup_S16 6553.500 md_q0p1 -3276.800 3276.700 FORMAT "%8.3"
 /begin AXIS_DESCR COM_AXIS Epm_nEng EngN 8 -16384.00 16383.50 FORMAT "%8.2" AXIS_PTS_REF ASDrf_nEng_DST /end AXIS_DESCR
/end CHARACTERISTIC
/begin CHARACTERISTIC ASDrf_tqLossSptOffsMtModPosLeadAcOn_GM "offset to clutch torque zero in Sport manual transmission mode when AC is ON for positive case" MAP 0x804FC262 RB_MapGroup_S16 6553.500 md_q0p1 -3276.800 3276.700 FORMAT "%8.3"
 /begin AXIS_DESCR COM_AXIS ASDrf_facDesDyn Fact 10 -4.000000 3.999878 FORMAT "%8.6" AXIS_PTS_REF ASDrf_facDesDyn_DST /end AXIS_DESCR
 /begin AXIS_DESCR COM_AXIS Epm_nEng EngN 8 -16384.00 16383.50 FORMAT "%8.2" AXIS_PTS_REF ASDrf_nEng_DST /end AXIS_DESCR
/end CHARACTERISTIC
/begin CHARACTERISTIC ASDrf_tqOffNeg_M "offset for reference torque negative load change" MAP 0x804FCDD8 RB_Map_S16S16_S16 6553.500 Trq -3276.800 3276.700 FORMAT "%8.3"
 /begin AXIS_DESCR STD_AXIS ASDrf_tqAct md_sw_q0p1 5 -3276.800 3276.700 FORMAT "%8.3" DEPOSIT ABSOLUTE /end AXIS_DESCR
 /begin AXIS_DESCR STD_AXIS Epm_nEng EngN 6 -16384.00 16383.50 FORMAT "%8.2" DEPOSIT ABSOLUTE /end AXIS_DESCR
/end CHARACTERISTIC
/begin CHARACTERISTIC ASDrf_tqOffPos_M "offset for reference torque positive load change" MAP 0x804FCE2E RB_Map_S16S16_S16 6553.500 Trq -3276.800 3276.700 FORMAT "%8.3"
 /begin AXIS_DESCR STD_AXIS ASDrf_facDesDyn Fact 5 -4.000000 3.999878 FORMAT "%8.6" DEPOSIT ABSOLUTE /end AXIS_DESCR
 /begin AXIS_DESCR STD_AXIS Epm_nEng EngN 6 -16384.00 16383.50 FORMAT "%8.2" DEPOSIT ABSOLUTE /end AXIS_DESCR
/end CHARACTERISTIC
/begin CHARACTERISTIC ASDrf_tqOffsLimNegMin_C "offset to reference torque for limitation maximum torque at negative load change" VALUE 0x804FCE84 RB_Val_Ws16 6553.500 md_sw_q0p1 -3276.800 3276.700 FORMAT "%8.3" /end CHARACTERISTIC
/begin CHARACTERISTIC ASDrf_tqOfsBasLim_C "offset to reference torque for limitation of requested set torque" VALUE 0x804FB772 RB_Val_Ws16 6553.500 md_sw_q0p1 -3276.800 3276.700 FORMAT "%8.3" /end CHARACTERISTIC
/begin CHARACTERISTIC ASDrf_tqThdMtModNegLeadAcOn_C "Torque threshold for Lead path in manual transmission mode when AC is ON for negative case" VALUE 0x804FC302 RB_Val_Ws16 6553.500 md_q0p1 -3276.800 3276.700 FORMAT "%8.3" /end CHARACTERISTIC
/begin CHARACTERISTIC ASDrf_tqThdMtModNegLead_C "Torque threshold for Lead path in manual transmission mode" VALUE 0x804FC304 RB_Val_Ws16 6553.500 md_q0p1 -3276.800 3276.700 FORMAT "%8.3" /end CHARACTERISTIC
/begin CHARACTERISTIC ASDrf_tqThdMtModPosLeadAcOn_GM "Torque threshold for Lead path in manual transmission mode when AC is ON for positive case" MAP 0x804FC306 RB_MapGroup_S16 6553.500 md_q0p1 -3276.800 3276.700 FORMAT "%8.3"
 /begin AXIS_DESCR COM_AXIS ASDrf_facDesDyn Fact 10 -4.000000 3.999878 FORMAT "%8.6" AXIS_PTS_REF ASDrf_facDesDyn_DST /end AXIS_DESCR
 /begin AXIS_DESCR COM_AXIS Epm_nEng EngN 8 -16384.00 16383.50 FORMAT "%8.2" AXIS_PTS_REF ASDrf_nEng_DST /end AXIS_DESCR
/end CHARACTERISTIC
/begin CHARACTERISTIC ASDrf_tqThdMtModPosLead_GM "Torque threshold for Lead path in manual transmission mode" MAP 0x804FC3A6 RB_MapGroup_S16 6553.500 md_q0p1 -3276.800 3276.700 FORMAT "%8.3"
 /begin AXIS_DESCR COM_AXIS ASDrf_facDesDyn Fact 10 -4.000000 3.999878 FORMAT "%8.6" AXIS_PTS_REF ASDrf_facDesDyn_DST /end AXIS_DESCR
 /begin AXIS_DESCR COM_AXIS Epm_nEng EngN 8 -16384.00 16383.50 FORMAT "%8.2" AXIS_PTS_REF ASDrf_nEng_DST /end AXIS_DESCR
/end CHARACTERISTIC
/begin CHARACTERISTIC ASDrf_tqThdSprtAirCdnrOnNegLead_C "Torque threshold for Lead path in sport mode with AC on" VALUE 0x804FC446 RB_Val_Ws16 6553.500 md_q0p1 -3276.800 3276.700 FORMAT "%8.3" /end CHARACTERISTIC
/begin CHARACTERISTIC ASDrf_tqThdSprtAirCdnrOnPosLead_GM "offset to clutch torque zero for AC on" MAP 0x804FC448 RB_MapGroup_S16 6553.500 md_q0p1 -3276.800 3276.700 FORMAT "%8.3"
 /begin AXIS_DESCR COM_AXIS ASDrf_facDesDyn Fact 10 -4.000000 3.999878 FORMAT "%8.6" AXIS_PTS_REF ASDrf_facDesDyn_DST /end AXIS_DESCR
 /begin AXIS_DESCR COM_AXIS Epm_nEng EngN 8 -16384.00 16383.50 FORMAT "%8.2" AXIS_PTS_REF ASDrf_nEng_DST /end AXIS_DESCR
/end CHARACTERISTIC
/begin CHARACTERISTIC ASDrf_tqThdSprtMtModNegLead_C "Torque threshold for Lead path in sport manual transmission mode" VALUE 0x804FC4E8 RB_Val_Ws16 6553.500 md_q0p1 -3276.800 3276.700 FORMAT "%8.3" /end CHARACTERISTIC
/begin CHARACTERISTIC ASDrf_tqThdSprtMtModPosLead_GM "Torque threshold for Lead path in sport manual transmission mode" MAP 0x804FC4EA RB_MapGroup_S16 6553.500 md_q0p1 -3276.800 3276.700 FORMAT "%8.3"
 /begin AXIS_DESCR COM_AXIS ASDrf_facDesDyn Fact 10 -4.000000 3.999878 FORMAT "%8.6" AXIS_PTS_REF ASDrf_facDesDyn_DST /end AXIS_DESCR
 /begin AXIS_DESCR COM_AXIS Epm_nEng EngN 8 -16384.00 16383.50 FORMAT "%8.2" AXIS_PTS_REF ASDrf_nEng_DST /end AXIS_DESCR
/end CHARACTERISTIC
/begin CHARACTERISTIC ASDrf_tqThdSprtNegLead_C "Torque threshold for Lead path in sport mode" VALUE 0x804FC58A RB_Val_Ws16 6553.500 md_q0p1 -3276.800 3276.700 FORMAT "%8.3" /end CHARACTERISTIC
/begin CHARACTERISTIC ASDrf_tqThdSprtPosLead_GM "Torque threshold for Lead path in sport mode" MAP 0x804FC58C RB_MapGroup_S16 6553.500 md_q0p1 -3276.800 3276.700 FORMAT "%8.3"
 /begin AXIS_DESCR COM_AXIS ASDrf_facDesDyn Fact 10 -4.000000 3.999878 FORMAT "%8.6" AXIS_PTS_REF ASDrf_facDesDyn_DST /end AXIS_DESCR
 /begin AXIS_DESCR COM_AXIS Epm_nEng EngN 8 -16384.00 16383.50 FORMAT "%8.2" AXIS_PTS_REF ASDrf_nEng_DST /end AXIS_DESCR
/end CHARACTERISTIC
/begin CHARACTERISTIC ASDrf_tqThdSptMtModNegLeadAcOn_C "Torque threshold for Lead path in Sport manual transmission mode when AC is ON for negative case" VALUE 0x804FC62C RB_Val_Ws16 6553.500 md_q0p1 -3276.800 3276.700 FORMAT "%8.3" /end CHARACTERISTIC
/begin CHARACTERISTIC ASDrf_tqThdSptMtModPosLeadAcOn_GM "Torque threshold for Lead path in Sport manual transmission mode when AC is ON for positive case" MAP 0x804FC62E RB_MapGroup_S16 6553.500 md_q0p1 -3276.800 3276.700 FORMAT "%8.3"
 /begin AXIS_DESCR COM_AXIS ASDrf_facDesDyn Fact 10 -4.000000 3.999878 FORMAT "%8.6" AXIS_PTS_REF ASDrf_facDesDyn_DST /end AXIS_DESCR
 /begin AXIS_DESCR COM_AXIS Epm_nEng EngN 8 -16384.00 16383.50 FORMAT "%8.2" AXIS_PTS_REF ASDrf_nEng_DST /end AXIS_DESCR
/end CHARACTERISTIC
/begin AXIS_PTS ASDrf_trqClthBs_DST "basic torque on clutch level" 0x804FF39C ASDrf_tqCluBasc RB_Axis_S16 6553.500 Trq 5 -3276.800 3276.700 FORMAT "%8.3" DEPOSIT ABSOLUTE /end AXIS_PTS
/begin CHARACTERISTIC ASDrf_trqLeadPrfm_C "threshold for end of lead filter" VALUE 0x804FC6CE RB_Val_Ws16 6553.500 md_q0p1 -3276.800 3276.700 FORMAT "%8.3" /end CHARACTERISTIC
/begin CHARACTERISTIC ASDrf_trqLosOfsAirCdnrOnNegLead_GT "offset to clutch torque zero in sport mode with AC on" CURVE 0x804FC6D0 RB_CurveGroup_S16 6553.500 md_q0p1 -3276.800 3276.700 FORMAT "%8.3"
 /begin AXIS_DESCR COM_AXIS Epm_nEng EngN 8 -16384.00 16383.50 FORMAT "%8.2" AXIS_PTS_REF ASDrf_nEng_DST /end AXIS_DESCR
/end CHARACTERISTIC
/begin CHARACTERISTIC ASDrf_trqLosOfsLeadSlipOpn_GMAP "offset to initialisation of torque range during open converter clutch" MAP 0x804FC6E0 RB_MapGroup_S16 6553.500 md_q0p1 -3276.800 3276.700 FORMAT "%8.3"
 /begin AXIS_DESCR COM_AXIS ASDrf_facDesDyn Fact 10 -4.000000 3.999878 FORMAT "%8.6" AXIS_PTS_REF ASDrf_facDesDyn_DST /end AXIS_DESCR
 /begin AXIS_DESCR COM_AXIS ASDrf_nPt EngN 8 -16384.00 16383.50 FORMAT "%8.2" AXIS_PTS_REF ASDrf_nPt_DST /end AXIS_DESCR
/end CHARACTERISTIC
/begin CHARACTERISTIC ASDrf_trqLosOfsNegLead_GCUR "offset to clutch torque zero" CURVE 0x804FC780 RB_CurveGroup_S16 6553.500 md_q0p1 -3276.800 3276.700 FORMAT "%8.3"
 /begin AXIS_DESCR COM_AXIS Epm_nEng EngN 8 -16384.00 16383.50 FORMAT "%8.2" AXIS_PTS_REF ASDrf_nEng_DST /end AXIS_DESCR
/end CHARACTERISTIC
/begin CHARACTERISTIC ASDrf_trqLosOfsPosLeadAcOn_GMAP "offset to clutch torque zero during AC On" MAP 0x804FC790 RB_MapGroup_S16 6553.500 md_q0p1 -3276.800 3276.700 FORMAT "%8.3"
 /begin AXIS_DESCR COM_AXIS ASDrf_facDesDyn Fact 10 -4.000000 3.999878 FORMAT "%8.6" AXIS_PTS_REF ASDrf_facDesDyn_DST /end AXIS_DESCR
 /begin AXIS_DESCR COM_AXIS Epm_nEng EngN 8 -16384.00 16383.50 FORMAT "%8.2" AXIS_PTS_REF ASDrf_nEng_DST /end AXIS_DESCR
/end CHARACTERISTIC
/begin CHARACTERISTIC ASDrf_trqLosOfsPosLead_GMAP "offset to clutch torque zero" MAP 0x804FC830 RB_MapGroup_S16 6553.500 md_q0p1 -3276.800 3276.700 FORMAT "%8.3"
 /begin AXIS_DESCR COM_AXIS ASDrf_facDesDyn Fact 10 -4.000000 3.999878 FORMAT "%8.6" AXIS_PTS_REF ASDrf_facDesDyn_DST /end AXIS_DESCR
 /begin AXIS_DESCR COM_AXIS Epm_nEng EngN 8 -16384.00 16383.50 FORMAT "%8.2" AXIS_PTS_REF ASDrf_nEng_DST /end AXIS_DESCR
/end CHARACTERISTIC
/begin CHARACTERISTIC ASDrf_trqOfsAirChrg_C "Upper limit of the torque band, during gradient limitation is activ,as offset to the torque by minimal charge (RngMod_trqMin AirChg)" VALUE 0x804FCE86 RB_Val_Ws16 6553.500 md_q0p1 -3276.800 3276.700 FORMAT "%8.3" /end CHARACTERISTIC
/begin CHARACTERISTIC ASDrf_trqStrtRmpPos_C "neg. starting offset" VALUE 0x804FC8D0 RB_Val_Ws16 6553.500 md_q0p1 -3276.800 3276.700 FORMAT "%8.3" /end CHARACTERISTIC
/begin CHARACTERISTIC ASDrf_trqThresDet_C "Threshold for detection of driver's request gradient" VALUE 0x804FCE88 RB_Val_Wu8 25.50 md_sw_q0p1 0.00 25.50 FORMAT "%5.2" /end CHARACTERISTIC
/begin CHARACTERISTIC ASDrf_trqThresNegLeadAcOn_C "Torque threshold for Lead path with AC on" VALUE 0x804FC8D2 RB_Val_Ws16 6553.500 md_q0p1 -3276.800 3276.700 FORMAT "%8.3" /end CHARACTERISTIC
/begin CHARACTERISTIC ASDrf_trqThresNegLead_C "Torque threshold for Lead path" VALUE 0x804FC8D4 RB_Val_Ws16 6553.500 md_q0p1 -3276.800 3276.700 FORMAT "%8.3" /end CHARACTERISTIC
/begin CHARACTERISTIC ASDrf_trqThresPosLeadAcOn_GMAP "Torque threshold for Lead path during AC On" MAP 0x804FC8D6 RB_MapGroup_S16 6553.500 md_q0p1 -3276.800 3276.700 FORMAT "%8.3"
 /begin AXIS_DESCR COM_AXIS ASDrf_facDesDyn Fact 10 -4.000000 3.999878 FORMAT "%8.6" AXIS_PTS_REF ASDrf_facDesDyn_DST /end AXIS_DESCR
 /begin AXIS_DESCR COM_AXIS Epm_nEng EngN 8 -16384.00 16383.50 FORMAT "%8.2" AXIS_PTS_REF ASDrf_nEng_DST /end AXIS_DESCR
/end CHARACTERISTIC
/begin CHARACTERISTIC ASDrf_trqThresPosLead_GMAP "Torque threshold for Lead path" MAP 0x804FC976 RB_MapGroup_S16 6553.500 md_q0p1 -3276.800 3276.700 FORMAT "%8.3"
 /begin AXIS_DESCR COM_AXIS ASDrf_facDesDyn Fact 10 -4.000000 3.999878 FORMAT "%8.6" AXIS_PTS_REF ASDrf_facDesDyn_DST /end AXIS_DESCR
 /begin AXIS_DESCR COM_AXIS Epm_nEng EngN 8 -16384.00 16383.50 FORMAT "%8.2" AXIS_PTS_REF ASDrf_nEng_DST /end AXIS_DESCR
/end CHARACTERISTIC
/begin MEASUREMENT APP_bT15Deb "Status T15 debounced with maximum debounce time" UBYTE B_TRUE 1 100 0.00 1.00000000000 BIT_MASK 0x1 FORMAT "%13.11" ECU_ADDRESS 0x60009C5E /end MEASUREMENT
/begin MEASUREMENT APP_cntrPostDrvLve "counter for state re-initialization" UBYTE OneToOne 1 100 0.00 255.0 FORMAT "%5.1" ECU_ADDRESS 0x60009C60 /end MEASUREMENT
/begin MEASUREMENT APP_dr "The deviation of accelerator pedal position at every 80ms" SWORD PrcPerSec 1 100 -20000.00 19999.39 FORMAT "%8.2" ECU_ADDRESS 0x600052EE /end MEASUREMENT
/begin MEASUREMENT APP_drUnFlt "Acceleration pedal position gradient of unfilterd value" SWORD PrcPerSec 1 100 -20000.00 19999.39 FORMAT "%8.2" ECU_ADDRESS 0x600052EC /end MEASUREMENT
/begin MEASUREMENT APP_flgATSActv "Acceleration pedal position ATS active status" UBYTE B_TRUE 1 100 0.00 1.00000000000 BIT_MASK 0x1 FORMAT "%13.11" ECU_ADDRESS 0x6000A25F /end MEASUREMENT
/begin MEASUREMENT App_flgLETVldActv "Acceleration pedal position Line End Tester request is active and valid" UBYTE B_TRUE 1 100 0.00 1.00000000000 BIT_MASK 0x1 FORMAT "%13.11" ECU_ADDRESS 0x6000A245 /end MEASUREMENT
/begin MEASUREMENT APP_r "Standardized accelerator pedal position" SWORD Prc 1 100 -400.0000 399.9878 FORMAT "%8.4" ECU_ADDRESS 0x6000E114 /end MEASUREMENT
/begin MEASUREMENT APP_rAppPrev "APP raw value from sensor for COMDIA module" SWORD Prc 1 100 -400.0000 399.9878 FORMAT "%8.4" ECU_ADDRESS 0x600052EA /end MEASUREMENT
/begin MEASUREMENT APP_rLET "Raw APP ratio from Line End Tester" SWORD Prc 1 100 -400.0000 399.9878 FORMAT "%8.4" ECU_ADDRESS 0x600052E8 /end MEASUREMENT
/begin MEASUREMENT APP_rLinRmp "acceleration pedal ratio by the switch between the two sets of linearisation parameters" SWORD Prc 1 100 -400.0000 399.9878 FORMAT "%8.4" ECU_ADDRESS 0x6000401E /end MEASUREMENT
/begin MEASUREMENT APP_rMaxLrnUnFlt "Acceleration pedal position maximum learned value unfiltered" SWORD Prc 1 100 -400.0000 399.9878 FORMAT "%8.4" ECU_ADDRESS 0x600052E6 /end MEASUREMENT
/begin MEASUREMENT APP_rOBDPID5A "Acceleration pedal OBD signal PID 5A" SWORD Prc 1 100 -400.0000 399.9878 FORMAT "%8.4" ECU_ADDRESS 0x70002B50 /end MEASUREMENT
/begin MEASUREMENT APP_rUnFlt "Unfiltered APP value" SWORD Prc 1 100 -400.0000 399.9878 FORMAT "%8.4" ECU_ADDRESS 0x6000E116 /end MEASUREMENT
/begin MEASUREMENT APP_rUnLimMaxLrnUnFlt "Learned acceleration pedal ratio by the acceleration brake plausibility in normal and limp mode" SWORD Prc 1 100 -400.0000 399.9878 FORMAT "%8.4" ECU_ADDRESS 0x6000401C /end MEASUREMENT
/begin MEASUREMENT APP_rUnLimMaxLrn_mp "APP Max learnt value not limited by alive detection" SWORD Prc 1 100 -400.0000 399.9878 FORMAT "%8.4" ECU_ADDRESS 0x70009294 /end MEASUREMENT
/begin MEASUREMENT APP_stLETAbort "Line End Tester abort status" UBYTE B_TRUE 1 100 0.00 1.00000000000 BIT_MASK 0x1 FORMAT "%13.11" ECU_ADDRESS 0x6000A25D /end MEASUREMENT
/begin MEASUREMENT APP_stMaxLrnFixOffsPosnCalc "Offset voltage calculated status" UBYTE B_TRUE 1 100 0.00 1.00000000000 BIT_MASK 0x1 FORMAT "%13.11" ECU_ADDRESS 0x60009C5F /end MEASUREMENT
/begin MEASUREMENT APP_tiPhyHigh1DebDef "Defect debounce time for DFC_PhyHighAPP1" SWORD Time_ms 1 100 -327680.0 327670.0 FORMAT "%8.1" ECU_ADDRESS 0x600052E4 /end MEASUREMENT
/begin MEASUREMENT APP_tiPhyHigh1DebOk "Healing debounce time for DFC_PhyHighAPP1" SWORD Time_ms 1 100 -327680.0 327670.0 FORMAT "%8.1" ECU_ADDRESS 0x600052E2 /end MEASUREMENT
/begin MEASUREMENT APP_tiPhyHigh2DebDef "Defect debounce time for DFC_PhyHighAPP2" SWORD Time_ms 1 100 -327680.0 327670.0 FORMAT "%8.1" ECU_ADDRESS 0x600052E0 /end MEASUREMENT
/begin MEASUREMENT APP_tiPhyHigh2DebOk "Healing debounce time for DFC_PhyHighAPP2" SWORD Time_ms 1 100 -327680.0 327670.0 FORMAT "%8.1" ECU_ADDRESS 0x600052DE /end MEASUREMENT
/begin MEASUREMENT APP_tiPhyLow1DebDef "Defect debounce time for DFC_PhyLowAPP1" SWORD Time_ms 1 100 -327680.0 327670.0 FORMAT "%8.1" ECU_ADDRESS 0x600052DC /end MEASUREMENT
/begin MEASUREMENT APP_tiPhyLow1DebOk "Healing debounce time for DFC_PhyLowAPP1" SWORD Time_ms 1 100 -327680.0 327670.0 FORMAT "%8.1" ECU_ADDRESS 0x600052DA /end MEASUREMENT
/begin MEASUREMENT APP_tiPhyLow2DebDef "Defect debounce time for DFC_PhyLowAPP2" SWORD Time_ms 1 100 -327680.0 327670.0 FORMAT "%8.1" ECU_ADDRESS 0x600052D8 /end MEASUREMENT
/begin MEASUREMENT APP_tiPhyLow2DebOk "Healing debounce time for DFC_PhyLowAPP2" SWORD Time_ms 1 100 -327680.0 327670.0 FORMAT "%8.1" ECU_ADDRESS 0x600052D6 /end MEASUREMENT
/begin MEASUREMENT APP_tiSRCHigh1DebDef "Duration of defect debouncing for check DFC_SRCHighAPP1" SWORD Time_ms 1 100 -327680.0 327670.0 FORMAT "%8.1" ECU_ADDRESS 0x600052D4 /end MEASUREMENT
/begin MEASUREMENT APP_tiSRCHigh1DebOk "Duration of healing debouncing for check DFC_SRCHighAPP1" SWORD Time_ms 1 100 -327680.0 327670.0 FORMAT "%8.1" ECU_ADDRESS 0x600052D2 /end MEASUREMENT
/begin MEASUREMENT APP_tiSRCHigh2DebDef "Duration of defect debouncing for check DFC_SRCHighAPP2" SWORD Time_ms 1 100 -327680.0 327670.0 FORMAT "%8.1" ECU_ADDRESS 0x600052D0 /end MEASUREMENT
/begin MEASUREMENT APP_tiSRCHigh2DebOk "Duration of healing debouncing for check DFC_SRCHighAPP2" SWORD Time_ms 1 100 -327680.0 327670.0 FORMAT "%8.1" ECU_ADDRESS 0x600052CE /end MEASUREMENT
/begin MEASUREMENT APP_tiSRCLow1DebDef "Duration of defect debouncing for check DFC_SRCLowAPP1" SWORD Time_ms 1 100 -327680.0 327670.0 FORMAT "%8.1" ECU_ADDRESS 0x600052CC /end MEASUREMENT
/begin MEASUREMENT APP_tiSRCLow1DebOk "Duration of healing debouncing for check DFC_SRCLowAPP1" SWORD Time_ms 1 100 -327680.0 327670.0 FORMAT "%8.1" ECU_ADDRESS 0x600052CA /end MEASUREMENT
/begin MEASUREMENT APP_tiSRCLow2DebDef "Duration of defect debouncing for check DFC_SRCLowAPP2" SWORD Time_ms 1 100 -327680.0 327670.0 FORMAT "%8.1" ECU_ADDRESS 0x600052C8 /end MEASUREMENT
/begin MEASUREMENT APP_tiSRCLow2DebOk "Duration of healing debouncing for check DFC_SRCLowAPP2" SWORD Time_ms 1 100 -327680.0 327670.0 FORMAT "%8.1" ECU_ADDRESS 0x600052C6 /end MEASUREMENT
/begin MEASUREMENT APP_uMaxLrnFixOffsPosn "Voltage corresponding to APP_rAPPMaxLrnPosOffs_C offset position of dynamic curve" SWORD Volt 1 100 -6553.600 6553.400 FORMAT "%8.3" ECU_ADDRESS 0x6000401A /end MEASUREMENT
/begin MEASUREMENT APP_uPreUnJit1 "Acceleration pedal sensor 1 unjitterd signal" SWORD Volt 1 100 -6553.600 6553.400 FORMAT "%8.3" ECU_ADDRESS 0x60004018 /end MEASUREMENT
/begin MEASUREMENT APP_uPreUnJit2 "Acceleration pedal sensor 2 unjitterd signal" SWORD Volt 1 100 -6553.600 6553.400 FORMAT "%8.3" ECU_ADDRESS 0x70002B56 /end MEASUREMENT
/begin MEASUREMENT APP_uRaw1 "Acceleration Pedal Position D" SWORD Volt 1 100 -6553.600 6553.400 FORMAT "%8.3" ECU_ADDRESS 0x70002C16 /end MEASUREMENT
/begin MEASUREMENT APP_uRaw1Old "frozen value sensor 1" SWORD Volt 1 100 -6553.600 6553.400 FORMAT "%8.3" ECU_ADDRESS 0x70002B58 /end MEASUREMENT
/begin MEASUREMENT APP_uRaw1unLim "Acceleration pedal sensor 1 unlimited raw value" SWORD Volt 1 100 -6553.600 6553.400 FORMAT "%8.3" ECU_ADDRESS 0x6000E118 /end MEASUREMENT
/begin MEASUREMENT APP_uRaw2 "Acceleration Pedal Position E" SWORD Volt 1 100 -6553.600 6553.400 FORMAT "%8.3" ECU_ADDRESS 0x70002C18 /end MEASUREMENT
/begin MEASUREMENT APP_uRaw2Old "frozen value sensor 2" SWORD Volt 1 100 -6553.600 6553.400 FORMAT "%8.3" ECU_ADDRESS 0x70002B5A /end MEASUREMENT
/begin MEASUREMENT APP_uRaw2unLim "Acceleration pedal sensor 2 unlimited raw value" SWORD Volt 1 100 -6553.600 6553.400 FORMAT "%8.3" ECU_ADDRESS 0x70002C1A /end MEASUREMENT
/begin MEASUREMENT APP_uUnJit "Acceleration pedal position unjittered value" SWORD Volt 1 100 -6553.600 6553.400 FORMAT "%8.3" ECU_ADDRESS 0x60000CE8 /end MEASUREMENT
/begin MEASUREMENT ASDdc_bDstCActv "antijerking active on ENG" UBYTE B_TRUE 1 100 0.00 1.00000000000 BIT_MASK 0x1 FORMAT "%13.11" ECU_ADDRESS 0x70001BFF /end MEASUREMENT
/begin MEASUREMENT ASDdc_bDstCActvAftFCO "antijerking active after fuel cut off" UBYTE B_TRUE 1 100 0.00 1.00000000000 BIT_MASK 0x1 FORMAT "%13.11" ECU_ADDRESS 0x70001BFE /end MEASUREMENT
/begin MEASUREMENT ASDdc_bDstCActvEBNM_I.oldSignal "edge disturbance control active / EdgeBiNoMem.oldsignal" UBYTE B_TRUE 1 100 0.00 1.00000000000 BIT_MASK 0x1 FORMAT "%13.11" ECU_ADDRESS 0x50000841 /end MEASUREMENT
/begin MEASUREMENT ASDdc_bDstCActvEna "antijerking ready on ENG" UBYTE B_TRUE 1 100 0.00 1.00000000000 BIT_MASK 0x1 FORMAT "%13.11" ECU_ADDRESS 0x70001AA4 /end MEASUREMENT
/begin MEASUREMENT ASDdc_bDstCActvEnaTONVNM_I.time "turn on delay release disturbance control / Delay Time" UBYTE t_q0p01 1 100 0.00 2.550 FORMAT "%5.3" ECU_ADDRESS 0x60009C59 /end MEASUREMENT
/begin MEASUREMENT ASDdc_bDyn "dynamic antijerk intervention active" UBYTE B_TRUE 1 100 0.00 1.00000000000 BIT_MASK 0x1 FORMAT "%13.11" ECU_ADDRESS 0x70001AA5 /end MEASUREMENT
/begin MEASUREMENT ASDdc_bGrip "grip for disturbance control" UBYTE B_TRUE 1 100 0.00 1.00000000000 BIT_MASK 0x1 FORMAT "%13.11" ECU_ADDRESS 0x6000A25C /end MEASUREMENT
/begin MEASUREMENT ASDdc_bGripSlip "grip with consideration of converter respectively clutch slip" UBYTE B_TRUE 1 100 0.00 1.00000000000 BIT_MASK 0x1 FORMAT "%13.11" ECU_ADDRESS 0x60009C5D /end MEASUREMENT
/begin MEASUREMENT ASDdc_bGripTONV_I.outbit "turn on delay grip detection / return value" UBYTE B_TRUE 1 100 0.00 1.00000000000 BIT_MASK 0x1 FORMAT "%13.11" ECU_ADDRESS 0x6000400C /end MEASUREMENT
/begin MEASUREMENT ASDdc_bGripTONV_I.time "turn on delay grip detection / expired delay time" UBYTE t_q0p01 1 100 0.00 2.550 FORMAT "%5.3" ECU_ADDRESS 0x6000400D /end MEASUREMENT
/begin MEASUREMENT ASDdc_bSignChng "antijerk signal change" UBYTE B_TRUE 1 100 0.00 1.00000000000 BIT_MASK 0x1 FORMAT "%13.11" ECU_ADDRESS 0x70001BFD /end MEASUREMENT
/begin MEASUREMENT ASDdc_cntDyn "dynamic counter" UBYTE t_q1p95em3 1 100 0.00 0.4980 ECU_ADDRESS 0x600006C8 /end MEASUREMENT
/begin MEASUREMENT ASDdc_cntDynIni "dynmaic counter initial value" UBYTE t_q1p95em3 1 100 0.0020 0.4980 ECU_ADDRESS 0x600006C9 /end MEASUREMENT
/begin MEASUREMENT ASDdc_ctIniDrvTrqCalcEng10ms "drive cycle counter 10ms-Eng-task" UBYTE OneToOne 1 100 0.00 255.0 FORMAT "%5.1" ECU_ADDRESS 0x60009C5C /end MEASUREMENT
/begin MEASUREMENT ASDdc_ctIniDrvTrqCalcPT10ms "drive cycle counter 10ms-PT-task" UBYTE OneToOne 1 100 0.00 255.0 FORMAT "%5.1" ECU_ADDRESS 0x60009C5B /end MEASUREMENT
/begin MEASUREMENT ASDdc_ctIniDrvTrqCalcSyncSx "drive cycle counter synchro-task" UBYTE OneToOne 1 100 0.00 255.0 FORMAT "%5.1" ECU_ADDRESS 0x50000842 /end MEASUREMENT
/begin MEASUREMENT ASDdc_D2T2nEng_I.B_bActvOld "D2T2 filter engine speed / Calculation active in last cycle" UBYTE B_TRUE 1 100 0.00 1.00000000000 BIT_MASK 0x1 FORMAT "%13.11" ECU_ADDRESS 0x500000C8 /end MEASUREMENT
/begin MEASUREMENT ASDdc_D2T2nEng_I.B_bSigChg "D2T2 filter engine speed / signal change" UBYTE B_TRUE 1 100 0.00 1.00000000000 BIT_MASK 0x1 FORMAT "%13.11" ECU_ADDRESS 0x500000C9 /end MEASUREMENT
/begin MEASUREMENT ASDdc_D2T2nEng_I.B_msbOld "D2T2 filter engine speed / signal change in last cycle" UBYTE B_TRUE 1 100 0.00 1.00000000000 BIT_MASK 0x1 FORMAT "%13.11" ECU_ADDRESS 0x500000CA /end MEASUREMENT
/begin MEASUREMENT ASDdc_D2T2nEng_I.mem1x_S32 "D2T2 filter engine speed / memory x1 for D2T2" SLONG fak_q0p00195 1 100 -4194304.00000 4194303.99805 FORMAT "%13.5" ECU_ADDRESS 0x500000CC /end MEASUREMENT
/begin MEASUREMENT ASDdc_D2T2nEng_I.mem1y_S32 "D2T2 filter engine speed / memory y1 for D2T2" SLONG fak_q0p00195 1 100 -4194304.00000 4194303.99805 FORMAT "%13.5" ECU_ADDRESS 0x500000D0 /end MEASUREMENT
/begin MEASUREMENT ASDdc_D2T2nEng_I.mem2x_S32 "D2T2 filter engine speed / memory x2 for D2T2" SLONG fak_q0p00195 1 100 -4194304.00000 4194303.99805 FORMAT "%13.5" ECU_ADDRESS 0x500000D4 /end MEASUREMENT
/begin MEASUREMENT ASDdc_D2T2nEng_I.mem2y_S32 "D2T2 filter engine speed / memory y2 for D2T2" SLONG fak_q0p00195 1 100 -4194304.00000 4194303.99805 FORMAT "%13.5" ECU_ADDRESS 0x500000D8 /end MEASUREMENT
/begin MEASUREMENT ASDdc_facKd "correction factor amplification disturbance control" UWORD fak_uw_b2 1 100 0.00 1.999969 FORMAT "%8.6" ECU_ADDRESS 0x60004016 /end MEASUREMENT
/begin MEASUREMENT ASDdc_HMBActvFF_I.status "flip-flop HEM active / current value of RS-FF" UBYTE B_TRUE 1 100 0.00 1.00000000000 BIT_MASK 0x1 FORMAT "%13.11" ECU_ADDRESS 0x60009C5A /end MEASUREMENT
/begin MEASUREMENT ASDdc_KdDyn "Amplification of dynamic antijerking intervention" UBYTE q0p03125_Nm_DIV_rpm 1 100 0.00 7.969 FORMAT "%5.3" ECU_ADDRESS 0x60000751 /end MEASUREMENT
/begin MEASUREMENT ASDdc_KdDynCurr "actual Amplification of dynamic antijerking intervention" UBYTE q0p03125_Nm_DIV_rpm 1 100 0.00 7.969 FORMAT "%5.3" ECU_ADDRESS 0x50000840 /end MEASUREMENT
/begin MEASUREMENT ASDdc_nDiff "antijerk idle speed difference" SWORD EngN 1 100 -16384.00 16383.50 FORMAT "%8.2" ECU_ADDRESS 0x60004014 /end MEASUREMENT
/begin MEASUREMENT ASDdc_nEngOsc "antijerk: engine speed oscillation (out of D2T2 filter)" SWORD nmot_q0p5 1 100 -16384.00 16383.50 FORMAT "%8.2" ECU_ADDRESS 0x500006CC /end MEASUREMENT
/begin MEASUREMENT ASDdc_nPT "powertrain speed" SWORD EngN 1 100 -16384.00 16383.50 FORMAT "%8.2" ECU_ADDRESS 0x70002B5C /end MEASUREMENT
/begin MEASUREMENT ASDdc_ratTq "powertrain torque ratio" SWORD TransR 1 100 -327.6800 327.6700 FORMAT "%8.4" ECU_ADDRESS 0x60004012 /end MEASUREMENT
/begin MEASUREMENT ASDdc_stShftOpTOFFV_I.outbit "turn off delay gear shift active / Output Bit" UBYTE B_TRUE 1 100 0.00 1.00000000000 BIT_MASK 0x1 FORMAT "%13.11" ECU_ADDRESS 0x6000400A /end MEASUREMENT
/begin MEASUREMENT ASDdc_stShftOpTOFFV_I.time "turn off delay gear shift active / Occured Time" UBYTE t_q0p01 1 100 0.00 2.550 FORMAT "%5.3" ECU_ADDRESS 0x6000400B /end MEASUREMENT
/begin MEASUREMENT ASDdc_tEng "antijerk engine temperature" UWORD Temp_Cels 1 100 -273.140 3003.560 FORMAT "%8.3" ECU_ADDRESS 0x60004010 /end MEASUREMENT
/begin MEASUREMENT ASDdc_tiPerDur "time constant for D2T2-model" UBYTE t_q1p95em3 1 100 0.0020 0.4980 ECU_ADDRESS 0x60000753 /end MEASUREMENT
/begin MEASUREMENT ASDdc_TOffVSyncDyn_I.outp "turn off delay dynamic disturbance control active / logical output turn off delay" UBYTE B_TRUE 1 100 0.00 1.00000000000 BIT_MASK 0x1 FORMAT "%13.11" ECU_ADDRESS 0x500000DC /end MEASUREMENT
/begin MEASUREMENT ASDdc_TOffVSyncDyn_I.time "turn off delay dynamic disturbance control active / timer turn off delay" SLONG Per_Dur 1 100 -2147483648.00 2147483647.00 FORMAT "%13.2" ECU_ADDRESS 0x500000E0 /end MEASUREMENT
/begin MEASUREMENT ASDdc_TOffVSyncFadeOutDyn_I.outp "turn off delay fade out dynamic disturbance control active / logical output turn off delay" UBYTE B_TRUE 1 100 0.00 1.00000000000 BIT_MASK 0x1 FORMAT "%13.11" ECU_ADDRESS 0x500000E4 /end MEASUREMENT
/begin MEASUREMENT ASDdc_TOffVSyncFadeOutDyn_I.time "turn off delay fade out dynamic disturbance control active / timer turn off delay" SLONG Per_Dur 1 100 -2147483648.00 2147483647.00 FORMAT "%13.2" ECU_ADDRESS 0x500000E8 /end MEASUREMENT
/begin MEASUREMENT ASDdc_trq "Torque Demand Disturbance Control" SWORD md_q0p1 1 100 -3276.800 3276.700 FORMAT "%8.3" ECU_ADDRESS 0x500006CE /end MEASUREMENT
/begin MEASUREMENT ASDdc_trqClthAct "antijerk clutch torque" SWORD md_q0p1 1 100 -3276.800 3276.700 FORMAT "%8.3" ECU_ADDRESS 0x70002B5E /end MEASUREMENT
/begin MEASUREMENT ASDdc_trqClthWoDstC "clutch torque without disturbance control" SWORD md_q0p1 1 100 -3276.800 3276.700 FORMAT "%8.3" ECU_ADDRESS 0x70002B60 /end MEASUREMENT
/begin MEASUREMENT ASDdc_trqThresDyn "Threshold for dynamic antijerking intervention" SWORD md_q0p1 1 100 0.00 3276.700 FORMAT "%8.3" ECU_ADDRESS 0x600004AA /end MEASUREMENT
/begin MEASUREMENT ASDdc_v "antijerk vehicle speed" UWORD Vel 1 100 0.00 327.6700 FORMAT "%8.4" ECU_ADDRESS 0x6000400E /end MEASUREMENT
/begin MEASUREMENT ASDrf_barmed "check driveability filter without ramping activated" UBYTE B_TRUE 1 100 0.00 1.00000000000 BIT_MASK 0x1 FORMAT "%13.11" ECU_ADDRESS 0x60009C51 /end MEASUREMENT
/begin MEASUREMENT ASDrf_bBsBlw "status bit indicating base clutch torque in lead path is less than losses at clutch level" UBYTE B_TRUE 1 100 0.00 1.00000000000 BIT_MASK 0x1 FORMAT "%13.11" ECU_ADDRESS 0x60009C58 /end MEASUREMENT
/begin MEASUREMENT ASDrf_bCtOffConDelEFNM_I.oldSignal "falling edge delayed release fuel cut off / memory to detect falling edge" UBYTE B_TRUE 1 100 0.00 1.00000000000 BIT_MASK 0x1 FORMAT "%13.11" ECU_ADDRESS 0x60009C46 /end MEASUREMENT
/begin MEASUREMENT ASDrf_bDelLeadActv "delay on lead path active" UBYTE B_TRUE 1 100 0.00 1.00000000000 BIT_MASK 0x1 FORMAT "%13.11" ECU_ADDRESS 0x60009C57 /end MEASUREMENT
/begin MEASUREMENT ASDrf_bDelNeg "condition delay of reduction of airpath torque" UBYTE B_TRUE 1 100 0.00 1.00000000000 BIT_MASK 0x1 FORMAT "%13.11" ECU_ADDRESS 0x60009C56 /end MEASUREMENT
/begin MEASUREMENT ASDrf_bFltDemLeadER_I.buffer "rising edge demand for torque filtering in lead path / rising edge detected" UBYTE B_TRUE 1 100 0.00 1.00000000000 BIT_MASK 0x1 FORMAT "%13.11" ECU_ADDRESS 0x70001AA2 /end MEASUREMENT
/begin MEASUREMENT ASDrf_bFltDemLeadER_I.oldSignal "rising edge demand for torque filtering in lead path / flag rising edge" UBYTE B_TRUE 1 100 0.00 1.00000000000 BIT_MASK 0x1 FORMAT "%13.11" ECU_ADDRESS 0x70001AA3 /end MEASUREMENT
/begin MEASUREMENT ASDrf_bFltNegLead "filtering in lead dashpot active" UBYTE B_TRUE 1 100 0.00 1.00000000000 BIT_MASK 0x1 FORMAT "%13.11" ECU_ADDRESS 0x60009C55 /end MEASUREMENT
/begin MEASUREMENT ASDrf_bFltWoIA "variable dashpot without ignition angle" UBYTE B_TRUE 1 100 0.00 1.00000000000 BIT_MASK 0x1 FORMAT "%13.11" ECU_ADDRESS 0x60009C50 /end MEASUREMENT
/begin MEASUREMENT ASDrf_bLim "limitation active" UBYTE B_TRUE 1 100 0.00 1.00000000000 BIT_MASK 0x1 FORMAT "%13.11" ECU_ADDRESS 0x6000A259 /end MEASUREMENT
/begin MEASUREMENT ASDrf_bNoRmp "realization of driveability without ramping" UBYTE B_TRUE 1 100 0.00 1.00000000000 BIT_MASK 0x1 FORMAT "%13.11" ECU_ADDRESS 0x6000A255 /end MEASUREMENT
/begin MEASUREMENT ASDrf_bNotNCmpOld "engine speed not lower than turbine speed last cycle" UBYTE B_TRUE 1 100 0.00 1.00000000000 BIT_MASK 0x1 FORMAT "%13.11" ECU_ADDRESS 0x60009C4F /end MEASUREMENT
/begin MEASUREMENT ASDrf_bPhyTqLyrHybCmpbl "Physical torque layer hybrid compatible system constant status" UBYTE B_TRUE 1 100 0.00 1.00000000000 BIT_MASK 0x1 FORMAT "%13.11" ECU_ADDRESS 0x60009C4E /end MEASUREMENT
/begin MEASUREMENT ASDrf_bPosNegDes "status driver request Sum" UBYTE B_TRUE 1 100 0.00 1.00000000000 BIT_MASK 0x1 FORMAT "%13.11" ECU_ADDRESS 0x6000A254 /end MEASUREMENT
/begin MEASUREMENT ASDrf_bPosNegLead "status driver request Lead" UBYTE B_TRUE 1 100 0.00 1.00000000000 BIT_MASK 0x1 FORMAT "%13.11" ECU_ADDRESS 0x6000A253 /end MEASUREMENT
/begin MEASUREMENT ASDrf_bRmpLeadActv "ramp on lead path active" UBYTE B_TRUE 1 100 0.00 1.00000000000 BIT_MASK 0x1 FORMAT "%13.11" ECU_ADDRESS 0x60009C54 /end MEASUREMENT
/begin MEASUREMENT ASDrf_bRstEngSt "reset ASD due to engine state" UBYTE B_TRUE 1 100 0.00 1.00000000000 BIT_MASK 0x1 FORMAT "%13.11" ECU_ADDRESS 0x6000A252 /end MEASUREMENT
/begin MEASUREMENT ASDrf_bTrqDemDrv "Torque demand greater than SetPoint" UBYTE B_TRUE 1 100 0.00 1.00000000000 BIT_MASK 0x1 FORMAT "%13.11" ECU_ADDRESS 0x60009C49 /end MEASUREMENT
/begin MEASUREMENT ASDrf_cntrSigndnEng "counter constant engine speed gradient" SBYTE OneToOne 1 100 -128.0 127.0 FORMAT "%5.1" ECU_ADDRESS 0x60009C4D /end MEASUREMENT
/begin MEASUREMENT ASDrf_ctIniDrvFilter10ms "drive cycle counter 10ms-task" UBYTE OneToOne 1 100 0.00 255.0 FORMAT "%5.1" ECU_ADDRESS 0x6000E390 /end MEASUREMENT
/begin MEASUREMENT ASDrf_ctIniDrvLead10ms "drive cycle counter 10ms-task" UBYTE OneToOne 1 100 0.00 255.0 FORMAT "%5.1" ECU_ADDRESS 0x6000E391 /end MEASUREMENT
/begin MEASUREMENT ASDrf_ctIniDrvLimIA10ms "drive cycle counter 10ms-task" UBYTE OneToOne 1 100 0.00 255.0 FORMAT "%5.1" ECU_ADDRESS 0x6000E392 /end MEASUREMENT
/begin MEASUREMENT ASDrf_ctIniDrvMinMax10ms "drive cycle counter 10ms-task" UBYTE OneToOne 1 100 0.00 255.0 FORMAT "%5.1" ECU_ADDRESS 0x6000E393 /end MEASUREMENT
/begin MEASUREMENT ASDrf_ctIniDrvPosNeg10ms "drive cycle counter 10ms-task" UBYTE OneToOne 1 100 0.00 255.0 FORMAT "%5.1" ECU_ADDRESS 0x6000E394 /end MEASUREMENT
/begin MEASUREMENT ASDrf_DetnTqGrdtDes_I.bPosNeg "detection torque gradient of setpoint / status torque gradient" UBYTE B_TRUE 1 100 0.00 1.00000000000 BIT_MASK 0x1 FORMAT "%13.11" ECU_ADDRESS 0x60009C48 /end MEASUREMENT
/begin MEASUREMENT ASDrf_DetnTqGrdtLead_I.bPosNeg "detection torque gradient of airpath setpoint / status torque gradient" UBYTE B_TRUE 1 100 0.00 1.00000000000 BIT_MASK 0x1 FORMAT "%13.11" ECU_ADDRESS 0x60009C47 /end MEASUREMENT
/begin MEASUREMENT ASdrf_dn "difference engine speed gradient - filtered engine speed gradient" SWORD EngNGrd 1 100 -16384.00 16383.50 FORMAT "%8.2" ECU_ADDRESS 0x60003FFC /end MEASUREMENT
/begin MEASUREMENT ASDrf_dndeltaMax "maximum change filtered engine speed gradient" SWORD EngNGrd 1 100 -16384.00 16383.50 FORMAT "%8.2" ECU_ADDRESS 0x60003FFA /end MEASUREMENT
/begin MEASUREMENT ASdrf_dnEngFlt "filtered engine speed gradient" SWORD EngNGrd 1 100 -16384.00 16383.50 FORMAT "%8.2" ECU_ADDRESS 0x60003FF8 /end MEASUREMENT
/begin MEASUREMENT ASDrf_dtqNeg "maximum gradient of torque limitation negative load change" SWORD mdt_q0p1_Nm_DIV_s 1 100 -3276.800 3276.700 FORMAT "%8.3" ECU_ADDRESS 0x60003FF6 /end MEASUREMENT
/begin MEASUREMENT ASDrf_dtqPos "maximum gradient of torque limitation positive load change" SWORD mdt_q0p1_Nm_DIV_s 1 100 -3276.800 3276.700 FORMAT "%8.3" ECU_ADDRESS 0x60003FF4 /end MEASUREMENT
/begin MEASUREMENT ASDrf_dtrqRmp "gradient of limitation ramp" SWORD md_q0p1 1 100 -3276.800 3276.700 FORMAT "%8.3" ECU_ADDRESS 0x60004006 /end MEASUREMENT
/begin MEASUREMENT ASDrf_facStrtNeg "weighting factor for init-jump lead dashpot" UBYTE fak_ub_b2 1 100 0.00 1.000000 FORMAT "%8.6" ECU_ADDRESS 0x6000E396 /end MEASUREMENT
/begin MEASUREMENT ASDrf_flgNMax "flag engine speed maximum detected" UBYTE B_TRUE 1 100 0.00 1.00000000000 BIT_MASK 0x1 FORMAT "%13.11" ECU_ADDRESS 0x60009C4C /end MEASUREMENT
/begin MEASUREMENT ASDrf_flgnMaxEF_I.buffer "edge for detection engine speed maximum / memory to detect falling edge" UBYTE B_TRUE 1 100 0.00 1.00000000000 BIT_MASK 0x1 FORMAT "%13.11" ECU_ADDRESS 0x60003FDC /end MEASUREMENT
/begin MEASUREMENT ASDrf_flgnMaxEF_I.oldSignal "edge for detection engine speed maximum / memory to detect falling edge" UBYTE B_TRUE 1 100 0.00 1.00000000000 BIT_MASK 0x1 FORMAT "%13.11" ECU_ADDRESS 0x60003FDD /end MEASUREMENT
/begin MEASUREMENT ASDrf_flgNMaxTrig "trigger detection engine speed maximum" UBYTE B_TRUE 1 100 0.00 1.00000000000 BIT_MASK 0x1 FORMAT "%13.11" ECU_ADDRESS 0x60009C4B /end MEASUREMENT
/begin MEASUREMENT ASDrf_flgStrtRed "flag start torque reduction negative load change" UBYTE B_TRUE 1 100 0.00 1.00000000000 BIT_MASK 0x1 FORMAT "%13.11" ECU_ADDRESS 0x60009C4A /end MEASUREMENT
/begin MEASUREMENT ASDrf_Leadtimer "timer for delay lead torque increase" UBYTE t_q0p01 1 100 0.00 2.550 FORMAT "%5.3" ECU_ADDRESS 0x60009C53 /end MEASUREMENT
/begin MEASUREMENT ASDrf_posnegEB_I.buffer "edge load change / EdgeBi.buffer" UBYTE B_TRUE 1 100 0.00 1.00000000000 BIT_MASK 0x1 FORMAT "%13.11" ECU_ADDRESS 0x60003FDA /end MEASUREMENT
/begin MEASUREMENT ASDrf_posnegEB_I.oldSignal "edge load change / EdgeBi.odlSignal" UBYTE B_TRUE 1 100 0.00 1.00000000000 BIT_MASK 0x1 FORMAT "%13.11" ECU_ADDRESS 0x60003FDB /end MEASUREMENT
/begin MEASUREMENT ASDrf_stLimMinMax "status statemachine for MinMax-limitation" UBYTE dez 1 100 0.00 255.0 FORMAT "%5.1" ECU_ADDRESS 0x6000A6B8 /end MEASUREMENT
/begin MEASUREMENT ASDrf_tiLead "time constant Lead path" UBYTE t_q0p01 1 100 0.010 2.550 FORMAT "%5.3" ECU_ADDRESS 0x60009C52 /end MEASUREMENT
/begin MEASUREMENT ASDrf_tiOscNeg "cycle duration negative load change" UWORD t_q0p01 1 100 0.00 655.3500 FORMAT "%8.4" ECU_ADDRESS 0x60003FF2 /end MEASUREMENT
/begin MEASUREMENT ASDrf_tiOscPos "cycle duration positive load change" UWORD t_q0p01 1 100 0.00 655.3500 FORMAT "%8.4" ECU_ADDRESS 0x60003FF0 /end MEASUREMENT
/begin MEASUREMENT ASDrf_tiPosNeg "time since last load change (positive or negative)" UWORD t_q0p01 1 100 0.00 655.3500 FORMAT "%8.4" ECU_ADDRESS 0x60003FEE /end MEASUREMENT
/begin MEASUREMENT ASDrf_tqAct "actual engine torque - clutch torque" SWORD md_q0p1 1 100 -3276.800 3276.700 FORMAT "%8.3" ECU_ADDRESS 0x60003FEC /end MEASUREMENT
/begin MEASUREMENT ASDrf_tqAirFric "air friction torque" SWORD Trq 1 100 0.00 3276.700 FORMAT "%8.3" ECU_ADDRESS 0x60003FEA /end MEASUREMENT
/begin MEASUREMENT ASDrf_tqInrFltUnlimLT_I.memory "lowpass filter unlimited driver torque request / current lowpass value" SLONG dez 1 100 -2147483648.00 2147483647.00 FORMAT "%13.2" ECU_ADDRESS 0x6000CCC0 /end MEASUREMENT
/begin MEASUREMENT ASDrf_tqLim "drive friction torque" SWORD md_sw_q0p1 1 100 0.00 3276.700 FORMAT "%8.3" ECU_ADDRESS 0x60003FE8 /end MEASUREMENT
/begin MEASUREMENT ASDrf_tqLimAbv "upper limitation edge" SWORD md_sw_q0p1 1 100 -3276.800 3276.700 FORMAT "%8.3" ECU_ADDRESS 0x70002B64 /end MEASUREMENT
/begin MEASUREMENT ASDrf_tqLimBlw "lower limitation edge" SWORD md_sw_q0p1 1 100 -3276.800 3276.700 FORMAT "%8.3" ECU_ADDRESS 0x6000D860 /end MEASUREMENT
/begin MEASUREMENT ASDrf_tqLimNeg "reference torque negative load change" SWORD Trq 1 100 -3276.800 3276.700 FORMAT "%8.3" ECU_ADDRESS 0x60003FE6 /end MEASUREMENT
/begin MEASUREMENT ASDrf_tqLimPos "reference torque positive load change" SWORD Trq 1 100 -3276.800 3276.700 FORMAT "%8.3" ECU_ADDRESS 0x60003FE4 /end MEASUREMENT
/begin MEASUREMENT ASDrf_tqLosComp "Loss compensation at Clutch level" SWORD Trq 1 100 -3276.800 3276.700 FORMAT "%8.3" ECU_ADDRESS 0x60004004 /end MEASUREMENT
/begin MEASUREMENT ASDrf_tqOffNeg "offset for reference torque negative load change" SWORD Trq 1 100 -3276.800 3276.700 FORMAT "%8.3" ECU_ADDRESS 0x60003FE2 /end MEASUREMENT
/begin MEASUREMENT ASDrf_tqOffPos "offset for reference torque positive load change" SWORD Trq 1 100 -3276.800 3276.700 FORMAT "%8.3" ECU_ADDRESS 0x60003FE0 /end MEASUREMENT
/begin MEASUREMENT ASDrf_tqRollFric "rolling friction torque" SWORD Trq 1 100 0.00 3276.700 FORMAT "%8.3" ECU_ADDRESS 0x60003FDE /end MEASUREMENT
/begin MEASUREMENT ASDrf_tqTgtLeadLT_I.memory "lowpass filter target airpath torque / current lowpass value" SLONG Trq 1 100 -214748364.800 214748364.700 FORMAT "%13.3" ECU_ADDRESS 0x60001980 /end MEASUREMENT
/begin MEASUREMENT ASDrf_trqClthFlt "drivers wish torque filtered" SWORD Trq 1 100 -3276.800 3276.700 FORMAT "%8.3" ECU_ADDRESS 0x500059E4 /end MEASUREMENT
/begin MEASUREMENT ASDrf_trqClthFltUnlim "filtered unlimited driver demand torque on clutch level" SWORD Trq 1 100 -3276.800 3276.700 FORMAT "%8.3" ECU_ADDRESS 0x600052AE /end MEASUREMENT
/begin MEASUREMENT ASDrf_trqClthLeadEng "filtered air torque demand" SWORD Trq 1 100 -3276.800 3276.700 FORMAT "%8.3" ECU_ADDRESS 0x600052AC /end MEASUREMENT
/begin MEASUREMENT ASDrf_trqClthMax "Max torque for limitation" SWORD md_sw_q0p1 1 100 -3276.800 3276.700 FORMAT "%8.3" ECU_ADDRESS 0x600052AA /end MEASUREMENT
/begin MEASUREMENT ASDrf_trqClthMin "Min torque for limitation" SWORD md_sw_q0p1 1 100 -3276.800 3276.700 FORMAT "%8.3" ECU_ADDRESS 0x600052A8 /end MEASUREMENT
/begin MEASUREMENT ASDrf_trqCluBsLim "Limited base Clutch torque" SWORD md_sw_q0p1 1 100 -3276.800 3276.700 FORMAT "%8.3" ECU_ADDRESS 0x60004008 /end MEASUREMENT
/begin MEASUREMENT ASDrf_trqFltDem "Input torque ASD reference filter" SWORD md_sw_q0p1 1 100 -3276.800 3276.700 FORMAT "%8.3" ECU_ADDRESS 0x70002B66 /end MEASUREMENT
/begin MEASUREMENT ASDrf_trqIniLead "initial torque lead path" SWORD md_q0p1 1 100 -3276.800 3276.700 FORMAT "%8.3" ECU_ADDRESS 0x60004002 /end MEASUREMENT
/begin MEASUREMENT ASDrf_trqLosCmp "Torque loss compensation" SWORD Trq 1 100 -3276.800 3276.700 FORMAT "%8.3" ECU_ADDRESS 0x60003FFE /end MEASUREMENT
/begin MEASUREMENT ASDrf_trqLosOfsLead "offset to clutch torque zero" SWORD md_q0p1 1 100 -3276.800 3276.700 FORMAT "%8.3" ECU_ADDRESS 0x6000D862 /end MEASUREMENT
/begin MEASUREMENT ASDrf_trqTgtLead "target value of lead filter" SWORD md_q0p1 1 100 -3276.800 3276.700 FORMAT "%8.3" ECU_ADDRESS 0x60004000 /end MEASUREMENT
/begin MEASUREMENT ASDrf_trqThresLead "Torque threshold for Lead path" SWORD md_q0p1 1 100 -3276.800 3276.700 FORMAT "%8.3" ECU_ADDRESS 0x6000D864 /end MEASUREMENT
/begin FUNCTION APP_VD "169.3.0   Acceleration Pedal Position Virtual Device"
 /begin DEF_CHARACTERISTIC APP_dRawSigFac_C APP_drLimNegLrn_C APP_drLimpMaxLrn_C APP_drLimPosLrn_C APP_drLinRmp_C APP_I_P_ATS_ATS.LimitTypeMsk_C APP_I_P_ATS_ATS.CnvNorm_C APP_I_P_ATS_ATS.LowLim_C APP_I_P_ATS_ATS.UpLim_C APP_I_P_ATS_ATS.CnvFac_C APP_I_P_ATS_ATS.CnvOfs_C APP_I_P_ATS_ATS.DfltVal_C APP_rAppATSMax_C APP_rAppATSMin_C APP_rAppLimnMax_C APP_rAppLimnMin_C APP_rAPPMaxLrnFixOffs_C APP_rAPPMaxLrnPosOffs_C APP_rAPPMaxLrnPos_C APP_rLimpMaxLrn_C APP_rLinAPPMax_C APP_rLinAPPMin_C APP_rPlaMaxValLrn_C APP_rPrevLETThd_C APP_swtCfg_CW APP_tiEngOnLETThd_C APP_tiPhyHigh1DebDef_C APP_tiPhyHigh1DebOk_C APP_tiPhyHigh2DebDef_C APP_tiPhyHigh2DebOk_C APP_tiPhyLow1DebDef_C APP_tiPhyLow1DebOk_C APP_tiPhyLow2DebDef_C APP_tiPhyLow2DebOk_C APP_tiPlaAPP12DebDef_C APP_tiPlaAPP12DebOk_C APP_tiSRCHigh1DebDef_C APP_tiSRCHigh1DebOk_C APP_tiSRCHigh2DebDef_C APP_tiSRCHigh2DebOk_C APP_tiSRCLow1DebDef_C APP_tiSRCLow1DebOk_C APP_tiSRCLow2DebDef_C APP_tiSRCLow2DebOk_C APP_uRaw1Def_C APP_uRaw2Def_C APP_uRawFullLdLimp_C APP_uRawFullLd_C APP_uRawIdlLimp_C APP_uRawIdl_C APP_uSnsrMaxOffs_C APP_uSply_C APP_vVehLETThd_C /end DEF_CHARACTERISTIC
 /begin IN_MEASUREMENT APP_bAlive APP_bAPP1FinalDef APP_bAPP1ProvDef APP_bAPP2FinalDef APP_bAPP2ProvDef APP_bPlaBrk APP_bSync APP_bSyncDeb APP_stSigSrc APP_uCurrSnsrMax APP_uRaw1ADC APP_uRaw2ADC Brk_st B_dksbeg EngDa_tiEngOnOBD Gbx_stGearLvr MoFETC_stTstMsg PT_stTraType SyC_ctPostDrvLeave T15_st VehV_v /end IN_MEASUREMENT
 /begin OUT_MEASUREMENT APP_bT15Deb APP_dr APP_drUnFlt APP_flgATSActv App_flgLETVldActv APP_r APP_rAppPrev APP_rLET APP_rMaxLrnUnFlt APP_rOBDPID5A APP_rUnFlt APP_stLETAbort APP_tiPhyHigh1DebDef APP_tiPhyHigh1DebOk APP_tiPhyHigh2DebDef APP_tiPhyHigh2DebOk APP_tiPhyLow1DebDef APP_tiPhyLow1DebOk APP_tiPhyLow2DebDef APP_tiPhyLow2DebOk APP_tiSRCHigh1DebDef APP_tiSRCHigh1DebOk APP_tiSRCHigh2DebDef APP_tiSRCHigh2DebOk APP_tiSRCLow1DebDef APP_tiSRCLow1DebOk APP_tiSRCLow2DebDef APP_tiSRCLow2DebOk APP_uRaw1 APP_uRaw1unLim APP_uRaw2 APP_uRaw2unLim /end OUT_MEASUREMENT
 /begin LOC_MEASUREMENT APP_cntrPostDrvLve APP_rLinRmp APP_rUnLimMaxLrnUnFlt APP_rUnLimMaxLrn_mp APP_stMaxLrnFixOffsPosnCalc APP_uMaxLrnFixOffsPosn APP_uPreUnJit1 APP_uPreUnJit2 APP_uRaw1Old APP_uRaw2Old APP_uUnJit /end LOC_MEASUREMENT
 FUNCTION_VERSION "169.3.0" /end FUNCTION
/begin FUNCTION ASDdc_TrqCalc "28.3.0    AntiSurgeDamper - disturbance control"
 /begin DEF_CHARACTERISTIC ASDdc_facNDiff_CUR ASDdc_facTEng_CUR ASDdc_facVVeh_CUR ASDdc_KdDynNegSprt_GMAP ASDdc_KdDynNeg_GMAP ASDdc_KdDynPosSprt_GMAP ASDdc_KdDynPos_GMAP ASDdc_nDifGripDetnMax_C ASDdc_nPT_DST ASDdc_rTrq_DST ASDdc_stCfg2_CW ASDdc_stCfg_CW ASDdc_swtNDiffSeln_C ASDdc_tiActvAftFCO_C ASDdc_tiActvDyn_C ASDdc_tiGripDeb_GCUR ASDdc_tiPerDur_GCUR ASDdc_tiShftDeb_GCUR ASDdc_trqClthAct_DST ASDdc_trqClthWoDstC_DST ASDdc_trqThresDynNegSprt_GMAP ASDdc_trqThresDynNeg_GMAP ASDdc_trqThresDynPosSprt_GMAP ASDdc_trqThresDynPos_GMAP /end DEF_CHARACTERISTIC
 /begin IN_MEASUREMENT ActMod_trqCrSWoDstC ASDrf_bPosNegDes ASDrf_flgSptModActv CoETS_bIntvActvDes Com_flgAntiJerkCnvrSlipEna Com_stAntiJerkCtrlInhb Conv_nTrbn CoVeh_trqAcs DOGov_bActv EngDa_tEng EngStrt_flgStrtEndTqStruct Epm_nEng InjSys_bInjVlvActv LIGov_nDiff MESCtrlr_nSpDif PthSet_bEnaIndivRes PT_bConvSlip PT_bConvSlipClsd PT_bGrip PT_bNoGrip PT_nClth PT_rTrq PT_stTraShftOp PT_stTraType PT_tqCluEngWoIntvExt SyC_ctDrvEnter VehMot_stPrpCrCtl VehV_v /end IN_MEASUREMENT
 /begin OUT_MEASUREMENT ASDdc_bDstCActv ASDdc_bDstCActvEna ASDdc_KdDyn ASDdc_nEngOsc ASDdc_tiPerDur ASDdc_trq ASDdc_trqThresDyn /end OUT_MEASUREMENT
 /begin LOC_MEASUREMENT ASDdc_bDstCActvAftFCO ASDdc_bDstCActvEBNM_I.oldSignal ASDdc_bDstCActvEnaTONVNM_I.time ASDdc_bDyn ASDdc_bGrip ASDdc_bGripSlip ASDdc_bGripTONV_I.outbit ASDdc_bGripTONV_I.time ASDdc_bSignChng ASDdc_cntDyn ASDdc_cntDynIni ASDdc_ctIniDrvTrqCalcEng10ms ASDdc_ctIniDrvTrqCalcPT10ms ASDdc_ctIniDrvTrqCalcSyncSx ASDdc_D2T2nEng_I.B_bActvOld ASDdc_D2T2nEng_I.B_bSigChg ASDdc_D2T2nEng_I.B_msbOld ASDdc_D2T2nEng_I.mem1x_S32 ASDdc_D2T2nEng_I.mem1y_S32 ASDdc_D2T2nEng_I.mem2x_S32 ASDdc_D2T2nEng_I.mem2y_S32 ASDdc_facKd ASDdc_HMBActvFF_I.status ASDdc_KdDynCurr ASDdc_nDiff ASDdc_nPT ASDdc_ratTq ASDdc_stShftOpTOFFV_I.outbit ASDdc_stShftOpTOFFV_I.time ASDdc_tEng ASDdc_TOffVSyncDyn_I.outp ASDdc_TOffVSyncDyn_I.time ASDdc_TOffVSyncFadeOutDyn_I.outp ASDdc_TOffVSyncFadeOutDyn_I.time ASDdc_trqClthAct ASDdc_trqClthWoDstC ASDdc_v /end LOC_MEASUREMENT
 FUNCTION_VERSION "28.3.0" /end FUNCTION
/begin FUNCTION ASDrf_Filter "28.2.0    Forming guidance part of drivability functions" /begin DEF_CHARACTERISTIC ASDrf_facTqBasLim_C ASDrf_tqOfsBasLim_C /end DEF_CHARACTERISTIC
 /begin IN_MEASUREMENT ASDrf_KdFltSet ASDrf_tiFltSet ASDrf_trqClthFlt ASDrf_trqLosSet CoETS_bFltDemLead CoVeh_trqAcs RngMod_trqCrSMin RngMod_trqInrBs StatyCoorn_tqCluDesLimd SyC_ctDrvEnter /end IN_MEASUREMENT
 /begin OUT_MEASUREMENT ASDrf_trqClthFltUnlim /end OUT_MEASUREMENT
 /begin LOC_MEASUREMENT ASDrf_ctIniDrvFilter10ms ASDrf_tqInrFltUnlimLT_I.memory ASDrf_trqCluBsLim ASDrf_trqFltDem /end LOC_MEASUREMENT
 FUNCTION_VERSION "28.2.0" /end FUNCTION
/begin FUNCTION ASDrf_Lead "28.4.0    Calculation of torque demand for lead path"
 /begin DEF_CHARACTERISTIC ASDrf_dtqRampMtModPosAcOn_T ASDrf_dtqRampMtModPos_T ASDrf_dtqSprtAirCdnrOnRampPos_T ASDrf_dtqSprtRampMtModPos_T ASDrf_dtqSprtRampPos_T ASDrf_dtqSptRampMtModPosAcOn_T ASDrf_dtrqRmpPosAcOn_CUR ASDrf_dtrqRmpPos_CUR ASDrf_facRampMtModPosAcOn_GM ASDrf_facRampMtModPosAcOn_GT ASDrf_facRampMtModPos_GM ASDrf_facRampMtModPos_GT ASDrf_facRmpPosAcOn_GCUR ASDrf_facRmpPosAcOn_GMAP ASDrf_facRmpPos_GCUR ASDrf_facRmpPos_GMAP ASDrf_facSprtAirCdnrOnRampPos_GM ASDrf_facSprtAirCdnrOnRampPos_GT ASDrf_facSprtAirCdnrOnTqIniNeg_GM ASDrf_facSprtAirCdnrOnTqIniNeg_GT ASDrf_facSprtRampMtModPos_GM ASDrf_facSprtRampMtModPos_GT ASDrf_facSprtRampPos_GM ASDrf_facSprtRampPos_GT ASDrf_facSprtTqIniMtModNeg_GM ASDrf_facSprtTqIniMtModNeg_GT ASDrf_facSprtTqIniNeg_GM ASDrf_facSprtTqIniNeg_GT ASDrf_facSptRampMtModPosAcOn_GM ASDrf_facSptRampMtModPosAcOn_GT ASDrf_facSptTqIniMtModNegAcOn_GM ASDrf_facSptTqIniMtModNegAcOn_GT ASDrf_facTiAirCdnrOnNegLead_GT ASDrf_facTiMtModNegLeadAcOn_GT ASDrf_facTiMtModNegLead_GT ASDrf_facTiMtModSptNegLeadAcOn_GT ASDrf_facTiMtModSptNegLead_GT ASDrf_facTiNegLead_GCUR ASDrf_facTiSprtAirCdnrOnNegLead_GT ASDrf_facTiSprtNegLead_GT ASDrf_facTqIniAirCdnrOnNeg_GM ASDrf_facTqIniAirCdnrOnNeg_GT ASDrf_facTqIniMtModNegAcOn_GM ASDrf_facTqIniMtModNegAcOn_GT ASDrf_facTqIniMtModNeg_GM ASDrf_facTqIniMtModNeg_GT ASDrf_facTqIniTEngAirCdnrOnNeg_GT ASDrf_facTqIniTEngNeg_GT ASDrf_facTrqIniNeg_GCUR ASDrf_facTrqIniNeg_GMAP ASDrf_swtTrqRng_C ASDrf_tiAirCdnrOnNegLead_GM ASDrf_tiMaxPos_GMAP ASDrf_tiMtModNegLeadAcOn_GM ASDrf_tiMtModNegLead_GM ASDrf_tiMtModSptNegLeadAcOn_GM ASDrf_tiMtModSptNegLead_GM ASDrf_tiNegLead_GMAP ASDrf_tiSprtAirCdnrOnNegLead_GM ASDrf_tiSprtNegLead_GM ASDrf_tqLossOffsMtModNegLeadAcOn_GT ASDrf_tqLossOffsMtModNegLead_GT ASDrf_tqLossOffsMtModPosLeadAcOn_GM ASDrf_tqLossOffsMtModPosLead_GM ASDrf_tqLossSprtAirCdnrOnOffsNegLead_GT ASDrf_tqLossSprtAirCdnrOnOffsPosLead_GM ASDrf_tqLossSprtOffsMtModNegLead_GT ASDrf_tqLossSprtOffsMtModPosLead_GM ASDrf_tqLossSprtOffsNegLead_GT ASDrf_tqLossSprtOffsPosLead_GM ASDrf_tqLossSptOffsMtModNegLeadAcOn_GT ASDrf_tqLossSptOffsMtModPosLeadAcOn_GM ASDrf_tqThdMtModNegLeadAcOn_C ASDrf_tqThdMtModNegLead_C ASDrf_tqThdMtModPosLeadAcOn_GM ASDrf_tqThdMtModPosLead_GM ASDrf_tqThdSprtAirCdnrOnNegLead_C ASDrf_tqThdSprtAirCdnrOnPosLead_GM ASDrf_tqThdSprtMtModNegLead_C ASDrf_tqThdSprtMtModPosLead_GM ASDrf_tqThdSprtNegLead_C ASDrf_tqThdSprtPosLead_GM ASDrf_tqThdSptMtModNegLeadAcOn_C ASDrf_tqThdSptMtModPosLeadAcOn_GM ASDrf_trqLeadPrfm_C ASDrf_trqLosOfsAirCdnrOnNegLead_GT ASDrf_trqLosOfsLeadSlipOpn_GMAP ASDrf_trqLosOfsNegLead_GCUR ASDrf_trqLosOfsPosLeadAcOn_GMAP ASDrf_trqLosOfsPosLead_GMAP ASDrf_trqStrtRmpPos_C ASDrf_trqThresNegLeadAcOn_C ASDrf_trqThresNegLead_C ASDrf_trqThresPosLeadAcOn_GMAP ASDrf_trqThresPosLead_GMAP /end DEF_CHARACTERISTIC
 /begin REF_CHARACTERISTIC ASDrf_Cfg2_CW ASDrf_Cfg3_CW ASDrf_Cfg4_CW ASDrf_Cfg_CW ASDrf_facDesDyn_DST ASDrf_nEng_DST ASDrf_nPt_DST ASDrf_nrGear_DST ASDrf_rTrq_DST ASDrf_tEng_DST ASDrf_trqClthBs_DST ASDrf_vDOPos_C /end REF_CHARACTERISTIC
 /begin IN_MEASUREMENT AirC_stPsCmpr ASDrf_bCalcTrqBs ASDrf_bConvSlipOpn ASDrf_bNCmp ASDrf_bNoGrip ASDrf_bPosNegLead ASDrf_facDesDyn ASDrf_flgSptModActv ASDrf_flgTrsmMtModActv ASDrf_nPt ASDrf_tiFltSet ASDrf_tqCluBasc ASDrf_tqCluBasLead CoETS_bFltDemLead EngDa_tEng Epm_nEng Gbx_bATSlipOpn LsComp_tqCmpActvSpdGovr LsComp_tqSwilLossNotFild PT_bConvSlipOpn PT_rTrq PT_stTraType RngMod_trqClthBs RngMod_trqClthMin RngMod_trqInrBs RngMod_trqInrBsMin SpdGov_trqLead StatyCoorn_tqCluLeadLimd SyC_ctDrvEnter VehV_v /end IN_MEASUREMENT
 /begin OUT_MEASUREMENT ASDrf_trqClthLeadEng /end OUT_MEASUREMENT
 /begin LOC_MEASUREMENT ASDrf_bBsBlw ASDrf_bDelLeadActv ASDrf_bDelNeg ASDrf_bFltDemLeadER_I.buffer ASDrf_bFltDemLeadER_I.oldSignal ASDrf_bFltNegLead ASDrf_bRmpLeadActv ASDrf_ctIniDrvLead10ms ASDrf_dtrqRmp ASDrf_facStrtNeg ASDrf_Leadtimer ASDrf_tiLead ASDrf_tqLosComp ASDrf_tqTgtLeadLT_I.memory ASDrf_trqIniLead ASDrf_trqLosOfsLead ASDrf_trqTgtLead ASDrf_trqThresLead /end LOC_MEASUREMENT
 FUNCTION_VERSION "28.4.0" /end FUNCTION
/begin FUNCTION ASDrf_LimIA "28.1.0    Gradient limitation and ignition angle release of drivability functions" /begin REF_CHARACTERISTIC ASDrf_Cfg_CW /end REF_CHARACTERISTIC
 /begin IN_MEASUREMENT ASDrf_trqClthFltUnlim ASDrf_trqClthMax ASDrf_trqClthMin CoEng_bCtOffConDel CoETS_bFltDemSet CoETS_trqInrLimSet LsComp_tqCmpActvSpdGovr LsComp_tqSwilLossNotFild PthSet_bEnaIndivRes PthSet_stOvrRun RngMod_trqClthBsMin RngMod_trqClthMin SpdGov_trqClth StatyCoorn_tqCluDesLimd SyC_ctDrvEnter /end IN_MEASUREMENT
 /begin OUT_MEASUREMENT ASDrf_bLim ASDrf_trqClthFlt /end OUT_MEASUREMENT
 /begin LOC_MEASUREMENT ASDrf_ctIniDrvLimIA10ms ASDrf_trqLosCmp /end LOC_MEASUREMENT
 FUNCTION_VERSION "28.1.0" /end FUNCTION
/begin FUNCTION ASDrf_MinMax "28.3.0    Calculation of extremas of the gradient limitation"
 /begin DEF_CHARACTERISTIC ASDrf_bPhyTqLyrHybCmpbl_C ASDrf_CfgNew_C ASDrf_cntrSigMaxReset_C ASDrf_cntrSigMaxSet_C ASDrf_dndeltaMaxIni_C ASDrf_dnEngMaxReset_C ASDrf_dnEngMaxSet_C ASDrf_dtqNegMax_C ASDrf_dtqNegMin_C ASDrf_dtqPosMax_M ASDrf_facAirFric_C ASDrf_facdtqPosMax_T ASDrf_facLimAbv_GM ASDrf_facLimBlw_GM ASDrf_facRollFric_C ASDrf_facTiOscdtqNeg_C ASDrf_facTiOscLimPos_C ASDrf_facTiOscStrtRed_C ASDrf_factqOffNeg_T ASDrf_factqOffPos_T ASDrf_ratApp_DST ASDrf_rGripThdSlip_C ASDrf_tCooltHiThd_C ASDrf_tCooltLoThd_C ASDrf_tiOscNeg_T ASDrf_tiOscPos_T ASDrf_tqLimAbv_GT ASDrf_tqLimBlw_GT ASDrf_tqLimNegOff_C ASDrf_tqLossOffsSlipOpenPos_GM ASDrf_tqLossOffsSlipOpenSpt_GM ASDrf_tqLossOffsSlipOpenTrsmMt_GM ASDrf_tqOffNeg_M ASDrf_tqOffPos_M ASDrf_tqOffsLimNegMin_C ASDrf_trqOfsAirChrg_C /end DEF_CHARACTERISTIC
 /begin REF_CHARACTERISTIC ASDrf_Cfg2_CW ASDrf_Cfg4_CW ASDrf_Cfg_CW ASDrf_facDesDyn_DST ASDrf_nPt_DST ASDrf_rTrq_DST /end REF_CHARACTERISTIC
 /begin IN_MEASUREMENT APP_r ASDrf_bConvSlipOpn ASDrf_bLim ASDrf_bNCmp ASDrf_bNoGrip ASDrf_bPosNegDes ASDrf_bRstEngSt ASDrf_CoefA ASDrf_CoefB ASDrf_facDesDyn ASDrf_flgSptModActv ASDrf_flgTrsmMtModActv ASDrf_nPt ASDrf_tqCluDemSet ASDrf_trqClthFlt ASDrf_trqClthFltUnlim ASDrf_trqLosSet B_kh_msg CEngDsT_t CoETS_bFltDemLead CoETS_bFltDemSet Epm_dnEng Epm_nEng Gbx_bATSlipOpn PthLead_stTrqResvActv PthLead_trqResv PthSet_bIARlsWoDstC PT_bConvSlipOpn PT_rGrip PT_rTrq PT_stTraType PT_tqCluEngWoIntvExt RngMod_trqInrBs RngMod_trqInrMinAirChrg StatyCoorn_tqCluDesLimd SyC_ctDrvEnter Tra_numGear VehV_v /end IN_MEASUREMENT
 /begin OUT_MEASUREMENT ASDrf_bNoRmp ASDrf_stLimMinMax ASDrf_trqClthMax ASDrf_trqClthMin /end OUT_MEASUREMENT
 /begin LOC_MEASUREMENT ASDrf_barmed ASDrf_bFltWoIA ASDrf_bNotNCmpOld ASDrf_bPhyTqLyrHybCmpbl ASDrf_cntrSigndnEng ASDrf_ctIniDrvMinMax10ms ASdrf_dn ASDrf_dndeltaMax ASdrf_dnEngFlt ASDrf_dtqNeg ASDrf_dtqPos ASDrf_flgNMax ASDrf_flgnMaxEF_I.buffer ASDrf_flgnMaxEF_I.oldSignal ASDrf_flgNMaxTrig ASDrf_flgStrtRed ASDrf_posnegEB_I.buffer ASDrf_posnegEB_I.oldSignal ASDrf_tiOscNeg ASDrf_tiOscPos ASDrf_tiPosNeg ASDrf_tqAct ASDrf_tqAirFric ASDrf_tqLim ASDrf_tqLimAbv ASDrf_tqLimBlw ASDrf_tqLimNeg ASDrf_tqLimPos ASDrf_tqOffNeg ASDrf_tqOffPos ASDrf_tqRollFric /end LOC_MEASUREMENT
 FUNCTION_VERSION "28.3.0" /end FUNCTION
/begin FUNCTION ASDrf_PosNeg "28.1.0    Detection of positive/negative gradient of driver's demand" /begin DEF_CHARACTERISTIC ASDrf_trqThresDet_C /end DEF_CHARACTERISTIC /begin REF_CHARACTERISTIC ASDrf_Cfg2_CW /end REF_CHARACTERISTIC
 /begin IN_MEASUREMENT ASDrf_bSlipOpnActv ASDrf_trqClthFlt ASDrf_trqClthLeadEng CoEng_bCtOffConDel CoEng_stMai PT_tqCluMinWoFco StatyCoorn_tqCluDesLimd StatyCoorn_tqCluLeadLimd SyC_ctDrvEnter /end IN_MEASUREMENT
 /begin OUT_MEASUREMENT ASDrf_bPosNegDes ASDrf_bPosNegLead ASDrf_bRstEngSt /end OUT_MEASUREMENT
 /begin LOC_MEASUREMENT ASDrf_bCtOffConDelEFNM_I.oldSignal ASDrf_bTrqDemDrv ASDrf_ctIniDrvPosNeg10ms ASDrf_DetnTqGrdtDes_I.bPosNeg ASDrf_DetnTqGrdtLead_I.bPosNeg /end LOC_MEASUREMENT
 FUNCTION_VERSION "28.1.0" /end FUNCTION
/begin COMPU_METHOD B_TRUE "" TAB_VERB "%6.3" "" COMPU_TAB_REF B_TRUE /end COMPU_METHOD
/begin COMPU_VTAB B_TRUE "" TAB_VERB 2 0 "FALSE" 1 "TRUE" /end COMPU_VTAB
/begin COMPU_METHOD Calory "" RAT_FUNC "%6.2" "J/g" COEFFS 0 1 0 0 0 1 /end COMPU_METHOD
/begin COMPU_METHOD CalVal_q0p01 "" RAT_FUNC "%6.4" "MJ/Kg" COEFFS 0 100 0 0 0 1 /end COMPU_METHOD
/begin COMPU_METHOD CALWUP_SY_Compu "" TAB_VERB "%6.3" "" COMPU_TAB_REF CALWUP_SY_Compu /end COMPU_METHOD
/begin COMPU_VTAB CALWUP_SY_Compu "" TAB_VERB 2 0 "no calibration wake up" 1 "calibration wake up" /end COMPU_VTAB
/begin COMPU_METHOD CAMSFT_ACTRINTKB2_SC_Compu "" TAB_VERB "%6.3" "" COMPU_TAB_REF CAMSFT_ACTRINTKB2_SC_Compu /end COMPU_METHOD
/begin COMPU_VTAB CAMSFT_ACTRINTKB2_SC_Compu "" TAB_VERB 2 0 "False" 1 "True" /end COMPU_VTAB
/begin COMPU_METHOD CAMSFT_ACTROUTLB2_SC_Compu "" TAB_VERB "%6.3" "" COMPU_TAB_REF CAMSFT_ACTROUTLB2_SC_Compu /end COMPU_METHOD
/begin COMPU_VTAB CAMSFT_ACTROUTLB2_SC_Compu "" TAB_VERB 2 0 "False" 1 "True" /end COMPU_VTAB
/begin COMPU_METHOD CAMSFT_ADAP_SC_Compu "" TAB_VERB "%6.3" "" COMPU_TAB_REF CAMSFT_ADAP_SC_Compu /end COMPU_METHOD
/begin COMPU_VTAB CAMSFT_ADAP_SC_Compu "" TAB_VERB 2 0 "False" 1 "True" /end COMPU_VTAB
/begin COMPU_METHOD CAMSFT_ADPNCLB_SC_Compu "" TAB_VERB "%6.3" "" COMPU_TAB_REF CAMSFT_ADPNCLB_SC_Compu /end COMPU_METHOD
/begin COMPU_VTAB CAMSFT_ADPNCLB_SC_Compu "" TAB_VERB 2 0 "OFF" 1 "ON" /end COMPU_VTAB
/begin COMPU_METHOD CAMSFT_AGSPATS_SC_Compu "" TAB_VERB "%6.3" "" COMPU_TAB_REF CAMSFT_AGSPATS_SC_Compu /end COMPU_METHOD
/begin COMPU_VTAB CAMSFT_AGSPATS_SC_Compu "" TAB_VERB 2 0 "False" 1 "True" /end COMPU_VTAB
/begin COMPU_METHOD CAMSFT_ATS_SC_Compu "" TAB_VERB "%6.3" "" COMPU_TAB_REF CAMSFT_ATS_SC_Compu /end COMPU_METHOD
/begin COMPU_VTAB CAMSFT_ATS_SC_Compu "" TAB_VERB 2 0 "False" 1 "True" /end COMPU_VTAB
/begin COMPU_METHOD CAMSFT_CLNGENGSTALLACTVT_SC_Compu "" TAB_VERB "%6.3" "" COMPU_TAB_REF CAMSFT_CLNGENGSTALLACTVT_SC_Compu /end COMPU_METHOD
/begin COMPU_VTAB CAMSFT_CLNGENGSTALLACTVT_SC_Compu "" TAB_VERB 2 0 "False" 1 "True" /end COMPU_VTAB
/begin COMPU_METHOD CAMSFT_CLNGMOD_SC_Compu "" TAB_VERB "%6.3" "" COMPU_TAB_REF CAMSFT_CLNGMOD_SC_Compu /end COMPU_METHOD
/begin COMPU_VTAB CAMSFT_CLNGMOD_SC_Compu "" TAB_VERB 4 0 "noCl" 1 "Clshft" 2 "ClSwofff" 3 "Clall" /end COMPU_VTAB
/begin COMPU_METHOD CAMSFT_CMNPHAACTRINTKOUTL_SC_Compu "" TAB_VERB "%6.3" "" COMPU_TAB_REF CAMSFT_CMNPHAACTRINTKOUTL_SC_Compu /end COMPU_METHOD
/begin COMPU_VTAB CAMSFT_CMNPHAACTRINTKOUTL_SC_Compu "" TAB_VERB 2 0 "False" 1 "True" /end COMPU_VTAB
/begin COMPU_METHOD CAMSFT_CSERSDIAGEXTD_SC_Compu "" TAB_VERB "%6.3" "" COMPU_TAB_REF CAMSFT_CSERSDIAGEXTD_SC_Compu /end COMPU_METHOD
/begin COMPU_VTAB CAMSFT_CSERSDIAGEXTD_SC_Compu "" TAB_VERB 2 0 "False" 1 "True" /end COMPU_VTAB
/begin COMPU_METHOD CAMSFT_DEACTVENGSTOP_SC_Compu "" TAB_VERB "%6.3" "" COMPU_TAB_REF CAMSFT_DEACTVENGSTOP_SC_Compu /end COMPU_METHOD
/begin COMPU_VTAB CAMSFT_DEACTVENGSTOP_SC_Compu "" TAB_VERB 2 0 "False" 1 "True" /end COMPU_VTAB
/begin COMPU_METHOD CAMSFT_ELECINTKVVT_SC_Compu "" TAB_VERB "%6.3" "" COMPU_TAB_REF CAMSFT_ELECINTKVVT_SC_Compu /end COMPU_METHOD
/begin COMPU_VTAB CAMSFT_ELECINTKVVT_SC_Compu "" TAB_VERB 2 0 "False" 1 "True" /end COMPU_VTAB
/begin COMPU_METHOD CAMSFT_EOMSPDECALCN_SC_Compu "" TAB_VERB "%6.3" "" COMPU_TAB_REF CAMSFT_EOMSPDECALCN_SC_Compu /end COMPU_METHOD
/begin COMPU_VTAB CAMSFT_EOMSPDECALCN_SC_Compu "" TAB_VERB 2 0 "False" 1 "True" /end COMPU_VTAB
/begin COMPU_METHOD CAMSFT_HLDDUTYCYCADPN_SC_Compu "" TAB_VERB "%6.3" "" COMPU_TAB_REF CAMSFT_HLDDUTYCYCADPN_SC_Compu /end COMPU_METHOD
/begin COMPU_VTAB CAMSFT_HLDDUTYCYCADPN_SC_Compu "" TAB_VERB 2 0 "False" 1 "True" /end COMPU_VTAB
/begin COMPU_METHOD CAMSFT_INHPHAADJMTTQLIMN_SC_Compu "" TAB_VERB "%6.3" "" COMPU_TAB_REF CAMSFT_INHPHAADJMTTQLIMN_SC_Compu /end COMPU_METHOD
/begin COMPU_VTAB CAMSFT_INHPHAADJMTTQLIMN_SC_Compu "" TAB_VERB 2 0 "False" 1 "True" /end COMPU_VTAB
/begin COMPU_METHOD CAMSFT_KNKPREVN_SC_Compu "" TAB_VERB "%6.3" "" COMPU_TAB_REF CAMSFT_KNKPREVN_SC_Compu /end COMPU_METHOD
/begin COMPU_VTAB CAMSFT_KNKPREVN_SC_Compu "" TAB_VERB 2 0 "False" 1 "True" /end COMPU_VTAB
/begin COMPU_METHOD CAMSFT_LIMPHOMECFG_SC_Compu "" TAB_VERB "%6.3" "" COMPU_TAB_REF CAMSFT_LIMPHOMECFG_SC_Compu /end COMPU_METHOD
/begin COMPU_VTAB CAMSFT_LIMPHOMECFG_SC_Compu "" TAB_VERB 2 0 "NoLimp" 1 "LftLimpSpclSp" /end COMPU_VTAB
/begin COMPU_METHOD CAMSFT_LOCKDIAGINTK_SC_Compu "" TAB_VERB "%6.3" "" COMPU_TAB_REF CAMSFT_LOCKDIAGINTK_SC_Compu /end COMPU_METHOD
/begin COMPU_VTAB CAMSFT_LOCKDIAGINTK_SC_Compu "" TAB_VERB 2 0 "False" 1 "True" /end COMPU_VTAB
/begin COMPU_METHOD CAMSFT_LOCKDIAGOUTL_SC_Compu "" TAB_VERB "%6.3" "" COMPU_TAB_REF CAMSFT_LOCKDIAGOUTL_SC_Compu /end COMPU_METHOD
/begin COMPU_VTAB CAMSFT_LOCKDIAGOUTL_SC_Compu "" TAB_VERB 2 0 "False" 1 "True" /end COMPU_VTAB
/begin COMPU_METHOD CAMSFT_MIDLOCKPOSNINTK_SC_Compu "" TAB_VERB "%6.3" "" COMPU_TAB_REF CAMSFT_MIDLOCKPOSNINTK_SC_Compu /end COMPU_METHOD
/begin COMPU_VTAB CAMSFT_MIDLOCKPOSNINTK_SC_Compu "" TAB_VERB 2 0 "NO_INTK_MIDLOCKPOSN" 1 "INTK_MIDLOCKPOSN" /end COMPU_VTAB
/begin COMPU_METHOD dez "" RAT_FUNC "%6.2" "" COEFFS 0 1 0 0 0 1 /end COMPU_METHOD
/begin COMPU_METHOD EngN "" RAT_FUNC "%6.3" "rpm" COEFFS 0 2 0 0 0 1 /end COMPU_METHOD
/begin COMPU_METHOD EngNGrd "" RAT_FUNC "%6.3" "rpm/s" COEFFS 0 2 0 0 0 1 /end COMPU_METHOD
/begin COMPU_METHOD Fact "" RAT_FUNC "%6.5" "-" COEFFS 0 8192 0 0 0 1 /end COMPU_METHOD
/begin COMPU_METHOD fak_q0p00195 "" RAT_FUNC "%6.4" "-" COEFFS 0 65536 0 0 0 128 /end COMPU_METHOD
/begin COMPU_METHOD fak_ub_b2 "" RAT_FUNC "%8.5" "-" COEFFS 0 256 0 0 0 2 /end COMPU_METHOD
/begin COMPU_METHOD fak_ub_b4 "" RAT_FUNC "%6.4" "-" COEFFS 0 256 0 0 0 4 /end COMPU_METHOD
/begin COMPU_METHOD fak_ub_b8 "" RAT_FUNC "%6.4" "-" COEFFS 0 256 0 0 0 8 /end COMPU_METHOD
/begin COMPU_METHOD fak_uw_b2 "" RAT_FUNC "%7.6" "-" COEFFS 0 65536 0 0 0 2 /end COMPU_METHOD
/begin COMPU_METHOD mdgrad_q10 "" RAT_FUNC "%6.1" "Nm/s" COEFFS 0 1 0 0 0 10 /end COMPU_METHOD
/begin COMPU_METHOD mdt_q0p1_Nm_DIV_s "" RAT_FUNC "%6.3" "Nm/s" COEFFS 0 10 0 0 0 1 /end COMPU_METHOD
/begin COMPU_METHOD md_q0p1 "" RAT_FUNC "%6.3" "Nm" COEFFS 0 10 0 0 0 1 /end COMPU_METHOD
/begin COMPU_METHOD md_sw_q0p1 "" RAT_FUNC "%6.3" "Nm" COEFFS 0 10 0 0 0 1 /end COMPU_METHOD
/begin COMPU_METHOD m_q0p00001 "" RAT_FUNC "%8.7" "kg" COEFFS 0 100000 0 0 0 1 /end COMPU_METHOD
/begin COMPU_METHOD nmot_q0p5 "" RAT_FUNC "%6.3" "1/min" COEFFS 0 2 0 0 0 1 /end COMPU_METHOD
/begin COMPU_METHOD OneToOne "" RAT_FUNC "%6.2" "-" COEFFS 0 1 0 0 0 1 /end COMPU_METHOD
/begin COMPU_METHOD Per_Dur "" RAT_FUNC "%6.2" "usec" COEFFS 0 1 0 0 0 1 /end COMPU_METHOD
/begin COMPU_METHOD Prc "" RAT_FUNC "%6.4" "%" COEFFS 0 81.92 0 0 0 1 /end COMPU_METHOD
/begin COMPU_METHOD PrcPerSec "" RAT_FUNC "%6.3" "%/s" COEFFS 0 1.6384 0 0 0 1 /end COMPU_METHOD
/begin COMPU_METHOD q0p03125_Nm_DIV_rpm "" RAT_FUNC "%6.4" "Nm/rpm" COEFFS 0 32 0 0 0 1 /end COMPU_METHOD
/begin COMPU_METHOD Temp_Cels "" RAT_FUNC "%6.1" "deg C" COEFFS 0 10 2731.4 0 0 1 /end COMPU_METHOD
/begin COMPU_METHOD TimeEngOn "" RAT_FUNC "%6.2" "s" COEFFS 0 1 0 0 0 1 /end COMPU_METHOD
/begin COMPU_METHOD Time_ms "" RAT_FUNC "%6.1" "ms" COEFFS 0 0.1 0 0 0 1 /end COMPU_METHOD
/begin COMPU_METHOD TransR "" RAT_FUNC "%6.4" "-" COEFFS 0 100 0 0 0 1 /end COMPU_METHOD
/begin COMPU_METHOD Trq "" RAT_FUNC "%6.3" "Nm" COEFFS 0 10 0 0 0 1 /end COMPU_METHOD
/begin COMPU_METHOD t_q0p001 "" RAT_FUNC "%6.5" "s" COEFFS 0 1000 0 0 0 1 /end COMPU_METHOD
/begin COMPU_METHOD t_q0p01 "" RAT_FUNC "%6.4" "s" COEFFS 0 100 0 0 0 1 /end COMPU_METHOD
/begin COMPU_METHOD t_q1p95em3 "" RAT_FUNC "%6.4" "s" COEFFS 0 512 0 0 0 1 /end COMPU_METHOD
/begin COMPU_METHOD Vel "" RAT_FUNC "%6.4" "km/h" COEFFS 0 100 0 0 0 1 /end COMPU_METHOD
/begin COMPU_METHOD Volt "" RAT_FUNC "%6.3" "mV" COEFFS 0 5 0 0 0 1 /end COMPU_METHOD
/begin RECORD_LAYOUT RB_Axis_S16 NO_AXIS_PTS_X 1 SWORD AXIS_PTS_X 2 SWORD INDEX_INCR DIRECT /end RECORD_LAYOUT
/begin RECORD_LAYOUT RB_CurveGroup_S16 FNC_VALUES 1 SWORD COLUMN_DIR DIRECT /end RECORD_LAYOUT
/begin RECORD_LAYOUT RB_CurveGroup_U8 FNC_VALUES 1 UBYTE COLUMN_DIR DIRECT /end RECORD_LAYOUT
/begin RECORD_LAYOUT RB_Curve_S16_S16 NO_AXIS_PTS_X 1 SWORD AXIS_PTS_X 2 SWORD INDEX_INCR DIRECT FNC_VALUES 3 SWORD COLUMN_DIR DIRECT /end RECORD_LAYOUT
/begin RECORD_LAYOUT RB_Curve_S16_U16_Static NO_AXIS_PTS_X 1 SWORD AXIS_PTS_X 2 SWORD INDEX_INCR DIRECT FNC_VALUES 3 UWORD COLUMN_DIR DIRECT STATIC_RECORD_LAYOUT /end RECORD_LAYOUT
/begin RECORD_LAYOUT RB_Curve_S16_U8_Static NO_AXIS_PTS_X 1 SWORD AXIS_PTS_X 2 SWORD INDEX_INCR DIRECT FNC_VALUES 3 UBYTE COLUMN_DIR DIRECT STATIC_RECORD_LAYOUT /end RECORD_LAYOUT
/begin RECORD_LAYOUT RB_Curve_S8_U8_Static NO_AXIS_PTS_X 1 SBYTE AXIS_PTS_X 2 SBYTE INDEX_INCR DIRECT FNC_VALUES 3 UBYTE COLUMN_DIR DIRECT STATIC_RECORD_LAYOUT /end RECORD_LAYOUT
/begin RECORD_LAYOUT RB_Curve_U16_U8_Static NO_AXIS_PTS_X 1 UWORD AXIS_PTS_X 2 UWORD INDEX_INCR DIRECT FNC_VALUES 3 UBYTE COLUMN_DIR DIRECT STATIC_RECORD_LAYOUT /end RECORD_LAYOUT
/begin RECORD_LAYOUT RB_MapGroup_S16 FNC_VALUES 1 SWORD COLUMN_DIR DIRECT /end RECORD_LAYOUT
/begin RECORD_LAYOUT RB_MapGroup_U8 FNC_VALUES 1 UBYTE COLUMN_DIR DIRECT /end RECORD_LAYOUT
/begin RECORD_LAYOUT RB_Map_S16S16_S16 NO_AXIS_PTS_X 1 SWORD NO_AXIS_PTS_Y 2 SWORD AXIS_PTS_X 3 SWORD INDEX_INCR DIRECT AXIS_PTS_Y 4 SWORD INDEX_INCR DIRECT FNC_VALUES 5 SWORD COLUMN_DIR DIRECT /end RECORD_LAYOUT
/begin RECORD_LAYOUT RB_Val_Wboolean FNC_VALUES 1 UBYTE COLUMN_DIR DIRECT /end RECORD_LAYOUT
/begin RECORD_LAYOUT RB_Val_Ws16 FNC_VALUES 1 SWORD COLUMN_DIR DIRECT /end RECORD_LAYOUT
/begin RECORD_LAYOUT RB_Val_Ws8 FNC_VALUES 1 SBYTE COLUMN_DIR DIRECT /end RECORD_LAYOUT
/begin RECORD_LAYOUT RB_Val_Wu16 FNC_VALUES 1 UWORD COLUMN_DIR DIRECT /end RECORD_LAYOUT
/begin RECORD_LAYOUT RB_Val_Wu32 FNC_VALUES 1 ULONG COLUMN_DIR DIRECT /end RECORD_LAYOUT
/begin RECORD_LAYOUT RB_Val_Wu8 FNC_VALUES 1 UBYTE COLUMN_DIR DIRECT /end RECORD_LAYOUT
/begin RECORD_LAYOUT Val_Ws16 FNC_VALUES 1 SWORD COLUMN_DIR DIRECT /end RECORD_LAYOUT
/begin RECORD_LAYOUT Val_Ws32 FNC_VALUES 1 SLONG COLUMN_DIR DIRECT /end RECORD_LAYOUT
/begin RECORD_LAYOUT Val_Wu8 FNC_VALUES 1 UBYTE COLUMN_DIR DIRECT /end RECORD_LAYOUT
/end MODULE
/end PROJECT
