ASAP2_VERSION 1 60
/begin PROJECT MG1CA020 "MG1CA020"
/begin HEADER "" VERSION "MG1CA020_6SAY_V011_TPROT" PROJECT_NO MG1CA020 /end HEADER
/begin MODULE DIM ""
/begin MOD_COMMON "" BYTE_ORDER MSB_LAST ALIGNMENT_BYTE 1 ALIGNMENT_WORD 2 ALIGNMENT_LONG 4 ALIGNMENT_INT64 4 ALIGNMENT_FLOAT32_IEEE 4 ALIGNMENT_FLOAT64_IEEE 4 DATA_SIZE 32 /end MOD_COMMON
/begin CHARACTERISTIC CNFLLRNS "Configuration byte for determination of target engine speed at idle" VALUE 0x80528496 RB_Val_Wu8 255.0 dez 0.00 255.0 FORMAT "%5.1" /end CHARACTERISTIC
/begin CHARACTERISTIC CWKUPPL "Code word for clutch" VALUE 0x80527C34 RB_Val_Wu8 255.0 dez 0.00 255.0 FORMAT "%5.1" /end CHARACTERISTIC
/begin CHARACTERISTIC CWLLRMR "Code word for the configuration of torque reserve in engine speed control" VALUE 0x80527C35 RB_Val_Wu8 255.0 dez 0.00 255.0 FORMAT "%5.1" /end CHARACTERISTIC
/begin CHARACTERISTIC CWLLRMR2 "Code word for the configuration of torque reserve in engine speed control" VALUE 0x80527C36 RB_Val_Wu8 255.0 dez 0.00 255.0 FORMAT "%5.1" /end CHARACTERISTIC
/begin CHARACTERISTIC CWLLRNS "codeword for idle increase." VALUE 0x80528497 RB_Val_Wu8 255.0 dez 0.00 255.0 FORMAT "%5.1" /end CHARACTERISTIC
/begin CHARACTERISTIC CWLLRNSNF "Codeword %LLRNSNF" VALUE 0x80528414 RB_Val_Wu8 255.0 dez 0.00 255.0 FORMAT "%5.1" /end CHARACTERISTIC
/begin CHARACTERISTIC CWNSTAT "Codeword for the Filtration of nstat" VALUE 0x80528498 RB_Val_Wu8 255.0 dez 0.00 255.0 FORMAT "%5.1" /end CHARACTERISTIC
/begin CHARACTERISTIC DMRESHH "Reduction rate for increased torque reserve during rear window heating" VALUE 0x80527C37 RB_Val_Wu8 0.3891 rel_q0p00153 0.00 0.3891 /end CHARACTERISTIC
/begin CHARACTERISTIC DMRESLLDOWN "Torque reserve parameter for reduction in torque reserve raised just after engine speed undershoot" VALUE 0x80527C38 RB_Val_Wu8 0.3891 rel_q0p00153 0.00 0.3891 /end CHARACTERISTIC
/begin CHARACTERISTIC DMRESLLUP "Engine speed control: Increase rate for torque reserve" VALUE 0x80527C39 RB_Val_Wu8 0.3891 rel_q0p00153 0.00 0.3891 /end CHARACTERISTIC
/begin CHARACTERISTIC DMRESUB "Increment to reduce the torque reserve for undervoltage" VALUE 0x80527C3A RB_Val_Wu8 0.3891 rel_q0p00153 0.00 0.3891 /end CHARACTERISTIC
/begin CHARACTERISTIC DNLLRESW "Engine speed control: Threshold for the engine speed deviation for increasing the torque reserve" VALUE 0x80527C3C RB_Val_Ws16 16383.75 nmot_sw_q0p25 -8192.000 8191.750 FORMAT "%8.3" /end CHARACTERISTIC
/begin CHARACTERISTIC DNNSNF "threshold for dns to deactivate speed tracking" VALUE 0x80528416 RB_Val_Ws16 16383.50 nmot_sw_q0p5 0.00 16383.50 FORMAT "%8.2" EXTENDED_LIMITS -16384.00 16383.50 /end CHARACTERISTIC
/begin CHARACTERISTIC DNSNFX_W "Offset to determine the upper limit of target speed" VALUE 0x80528418 RB_Val_Ws16 16383.50 nmot_sw_q0p5 0.00 16383.50 FORMAT "%8.2" EXTENDED_LIMITS -16384.00 16383.50 /end CHARACTERISTIC
/begin CHARACTERISTIC DUBATG "Limit for torque reserve at battery voltage undershoot." VALUE 0x80527C3E RB_Val_Wu16 25.59961 spg_q0p00039 0.00 25.59961 FORMAT "%8.5" /end CHARACTERISTIC
/begin CHARACTERISTIC DUBSUBQ "Increment to reduce the torque reserve for undervoltage" VALUE 0x80527C40 RB_Val_Wu16 25.59961 spg_q0p00039 0.00 25.59961 FORMAT "%8.5" /end CHARACTERISTIC
/begin CHARACTERISTIC FNSNF "factor for desired engine-speed correction" VALUE 0x8052841A RB_Val_Wu8 0.9961 fak_ub_b1 0.00 0.9961 /end CHARACTERISTIC
/begin CHARACTERISTIC FNSSTKM "Factor to weight the desired speed at start during catalyst heating" CURVE 0x8052841C RB_CurveGroup_U16 1.992188 fak_ub_b2 0.00 1.992188 FORMAT "%8.6" EXTENDED_LIMITS 0.00 511.9922
 /begin AXIS_DESCR COM_AXIS llrnsnf_stm06llublLoc temp_ub_q0p75_o48 6 -48.0 143.3 FORMAT "%5.1" AXIS_PTS_REF STM06LLUBL /end AXIS_DESCR
/end CHARACTERISTIC
/begin CHARACTERISTIC FNSSTM "Factor for target engine speed during start" CURVE 0x80528428 RB_CurveGroup_U16 1.992188 fak_ub_b2 0.00 1.992188 FORMAT "%8.6" EXTENDED_LIMITS 0.00 511.9922
 /begin AXIS_DESCR COM_AXIS llrnsnf_stm06llublLoc temp_ub_q0p75_o48 6 -48.0 143.3 FORMAT "%5.1" AXIS_PTS_REF STM06LLUBL /end AXIS_DESCR
/end CHARACTERISTIC
/begin CHARACTERISTIC FZNSMGA "time constant correction factor related to gangi" CURVE 0x80528434 RB_Curve_S16_U8_Static 127.498 rfak_q0p5 0.502 128.000 FORMAT "%7.3" EXTENDED_LIMITS 0.501961 128.000
 /begin AXIS_DESCR STD_AXIS gangsist_llrnsnf_loc dez 6 -128.0000 127.0000 FORMAT "%8.4" EXTENDED_LIMITS -32768.00 32767.00 DEPOSIT ABSOLUTE /end AXIS_DESCR
/end CHARACTERISTIC
/begin CHARACTERISTIC FZNSMTM "time constant correction factor related to tmot" CURVE 0x80528448 RB_CurveGroup_U8 127.498 rfak_q0p5 0.502 128.000 FORMAT "%7.3" EXTENDED_LIMITS 0.501961 128.000
 /begin AXIS_DESCR COM_AXIS llrnsnf_stm06llublLoc temp_ub_q0p75_o48 6 -48.0 143.3 FORMAT "%5.1" AXIS_PTS_REF STM06LLUBL /end AXIS_DESCR
/end CHARACTERISTIC
/begin CHARACTERISTIC KFETAZWOFF "Offset for minimum ignition angle effectiveness dependent on drivers torque wish and engine speed" MAP 0x80527C42 RB_MapGroup_U16 1.000000 fak_uw_b2 0.00 1.000000 FORMAT "%8.6" EXTENDED_LIMITS 0.00 1.999969
 /begin AXIS_DESCR COM_AXIS LLRMR_nmotw_tmp nmot_uw_q0p25 8 0.00 16383.75 FORMAT "%8.2" AXIS_PTS_REF SNM06LLUWL /end AXIS_DESCR
 /begin AXIS_DESCR COM_AXIS LLRMR_mifa_w_tmp rel_uw_b100 8 0.00 99.99847 FORMAT "%8.5" AXIS_PTS_REF SMI04LLUBL /end AXIS_DESCR
/end CHARACTERISTIC
/begin CHARACTERISTIC KFFKTMRFS "Torque reserve factor for closed powertrain" MAP 0x80527CC2 RB_Map_U8U8_U8 3.984 fak_ub_b4 0.00 3.984 FORMAT "%5.3"
 /begin AXIS_DESCR STD_AXIS LLRMR_vfzg_tmp vfzg_ub_q1p25 6 0.00 318.8 FORMAT "%5.1" DEPOSIT ABSOLUTE /end AXIS_DESCR
 /begin AXIS_DESCR STD_AXIS LLRMR_tmot_tmp temp_ub_q0p75_o48 6 -48.0 143.3 FORMAT "%5.1" DEPOSIT ABSOLUTE /end AXIS_DESCR
/end CHARACTERISTIC
/begin CHARACTERISTIC KFMRENHER "torque reserve at idle and near-idle zone, engine heating" MAP 0x80527CF4 RB_Map_S16U8_U16 99.99847 rel_uw_b100 0.00 99.99847 FORMAT "%8.5"
 /begin AXIS_DESCR STD_AXIS WaHt_tDeltaEngT Temp_Cels 6 -3549.940 3003.560 FORMAT "%8.3" DEPOSIT ABSOLUTE /end AXIS_DESCR
 /begin AXIS_DESCR STD_AXIS tumg_msg temp_ub_q0p75_o48 6 -48.0 143.3 FORMAT "%5.1" DEPOSIT ABSOLUTE /end AXIS_DESCR
/end CHARACTERISTIC
/begin CHARACTERISTIC KFMRES "Engine speed control: Torque reserve at idle and near-idle zone" MAP 0x80527D52 RB_MapGroup_U8 24.90 rel_ub_b25 0.00 24.90 FORMAT "%5.2"
 /begin AXIS_DESCR COM_AXIS LLRMR_nmotw_tmp nmot_uw_q0p25 8 0.00 16383.75 FORMAT "%8.2" AXIS_PTS_REF SNM06LLUWL /end AXIS_DESCR
 /begin AXIS_DESCR COM_AXIS LLRMR_mifa_w_tmp rel_uw_b100 8 0.00 99.99847 FORMAT "%8.5" AXIS_PTS_REF SMI04LLUBL /end AXIS_DESCR
/end CHARACTERISTIC
/begin CHARACTERISTIC KFMRESAC "Torque reserve offset for vehicles with air conditioner" MAP 0x80527D92 RB_MapGroup_U8 24.90 rel_ub_b25 0.00 24.90 FORMAT "%5.2"
 /begin AXIS_DESCR COM_AXIS LLRMR_nmotw_tmp nmot_uw_q0p25 8 0.00 16383.75 FORMAT "%8.2" AXIS_PTS_REF SNM06LLUWL /end AXIS_DESCR
 /begin AXIS_DESCR COM_AXIS LLRMR_mifa_w_tmp rel_uw_b100 8 0.00 99.99847 FORMAT "%8.5" AXIS_PTS_REF SMI04LLUBL /end AXIS_DESCR
/end CHARACTERISTIC
/begin CHARACTERISTIC KFMRESACT "Torque reseve offset from Testing for vehicles with air conditioner" MAP 0x80527DD2 RB_MapGroup_U8 24.90 rel_ub_b25 0.00 24.90 FORMAT "%5.2"
 /begin AXIS_DESCR COM_AXIS LLRMR_nmotw_tmp nmot_uw_q0p25 8 0.00 16383.75 FORMAT "%8.2" AXIS_PTS_REF SNM06LLUWL /end AXIS_DESCR
 /begin AXIS_DESCR COM_AXIS LLRMR_mifa_w_tmp rel_uw_b100 8 0.00 99.99847 FORMAT "%8.5" AXIS_PTS_REF SMI04LLUBL /end AXIS_DESCR
/end CHARACTERISTIC
/begin CHARACTERISTIC KFMRESFS "Engine speed control: Torque reserve at idle and near-idle zone for closed powertrain" MAP 0x80527E12 RB_MapGroup_U8 24.90 rel_ub_b25 0.00 24.90 FORMAT "%5.2"
 /begin AXIS_DESCR COM_AXIS LLRMR_nmotw_tmp nmot_uw_q0p25 8 0.00 16383.75 FORMAT "%8.2" AXIS_PTS_REF SNM06LLUWL /end AXIS_DESCR
 /begin AXIS_DESCR COM_AXIS LLRMR_mifa_w_tmp rel_uw_b100 8 0.00 99.99847 FORMAT "%8.5" AXIS_PTS_REF SMI04LLUBL /end AXIS_DESCR
/end CHARACTERISTIC
/begin CHARACTERISTIC KFMRESFSSAIL "Engine speed control: Torque reserve at idle and near-idle zone for closed powertrain, Sailing" MAP 0x80527E52 RB_MapGroup_U8 24.90 rel_ub_b25 0.00 24.90 FORMAT "%5.2"
 /begin AXIS_DESCR COM_AXIS LLRMR_nmotw_tmp nmot_uw_q0p25 8 0.00 16383.75 FORMAT "%8.2" AXIS_PTS_REF SNM06LLUWL /end AXIS_DESCR
 /begin AXIS_DESCR COM_AXIS LLRMR_mifa_w_tmp rel_uw_b100 8 0.00 99.99847 FORMAT "%8.5" AXIS_PTS_REF SMI04LLUBL /end AXIS_DESCR
/end CHARACTERISTIC
/begin CHARACTERISTIC KFMRESFSSP "Engine speed control: Torque reserve at idle and near-idle zone for closed powertrain, Sport" MAP 0x80527E92 RB_MapGroup_U8 24.90 rel_ub_b25 0.00 24.90 FORMAT "%5.2"
 /begin AXIS_DESCR COM_AXIS LLRMR_nmotw_tmp nmot_uw_q0p25 8 0.00 16383.75 FORMAT "%8.2" AXIS_PTS_REF SNM06LLUWL /end AXIS_DESCR
 /begin AXIS_DESCR COM_AXIS LLRMR_mifa_w_tmp rel_uw_b100 8 0.00 99.99847 FORMAT "%8.5" AXIS_PTS_REF SMI04LLUBL /end AXIS_DESCR
/end CHARACTERISTIC
/begin CHARACTERISTIC KFMRESFSSPP "Engine speed control: Torque reserve at idle and near-idle zone for closed powertrain, SportPlus" MAP 0x80527ED2 RB_MapGroup_U8 24.90 rel_ub_b25 0.00 24.90 FORMAT "%5.2"
 /begin AXIS_DESCR COM_AXIS LLRMR_nmotw_tmp nmot_uw_q0p25 8 0.00 16383.75 FORMAT "%8.2" AXIS_PTS_REF SNM06LLUWL /end AXIS_DESCR
 /begin AXIS_DESCR COM_AXIS LLRMR_mifa_w_tmp rel_uw_b100 8 0.00 99.99847 FORMAT "%8.5" AXIS_PTS_REF SMI04LLUBL /end AXIS_DESCR
/end CHARACTERISTIC
/begin CHARACTERISTIC KFMRESI "Engine speed control: Torque reserve at idle and near-idle zone, open powertrain" MAP 0x80527F12 RB_MapGroup_U8 24.90 rel_ub_b25 0.00 24.90 FORMAT "%5.2"
 /begin AXIS_DESCR COM_AXIS LLRMR_nmotw_tmp nmot_uw_q0p25 8 0.00 16383.75 FORMAT "%8.2" AXIS_PTS_REF SNM06LLUWL /end AXIS_DESCR
 /begin AXIS_DESCR COM_AXIS LLRMR_mifa_w_tmp rel_uw_b100 8 0.00 99.99847 FORMAT "%8.5" AXIS_PTS_REF SMI04LLUBL /end AXIS_DESCR
/end CHARACTERISTIC
/begin CHARACTERISTIC KFMRESK "Engine speed control: Torque reserve at idle and near-idle zone, closed powertrain" MAP 0x80527F52 RB_MapGroup_U8 24.90 rel_ub_b25 0.00 24.90 FORMAT "%5.2"
 /begin AXIS_DESCR COM_AXIS LLRMR_nmotw_tmp nmot_uw_q0p25 8 0.00 16383.75 FORMAT "%8.2" AXIS_PTS_REF SNM06LLUWL /end AXIS_DESCR
 /begin AXIS_DESCR COM_AXIS LLRMR_mifa_w_tmp rel_uw_b100 8 0.00 99.99847 FORMAT "%8.5" AXIS_PTS_REF SMI04LLUBL /end AXIS_DESCR
/end CHARACTERISTIC
/begin CHARACTERISTIC KFMRESKH "Torque reserve during catalyst heating" MAP 0x80527F92 RB_MapGroup_U8 24.90 rel_ub_b25 0.00 24.90 FORMAT "%5.2"
 /begin AXIS_DESCR COM_AXIS LLRMR_dns_temp nmot_sw_q0p5 6 -16384.00 16383.50 FORMAT "%8.2" AXIS_PTS_REF SNS06LLSBL /end AXIS_DESCR
 /begin AXIS_DESCR COM_AXIS LLRMR_tmot_tmp temp_ub_q0p75_o48 4 -48.0 143.3 FORMAT "%5.1" AXIS_PTS_REF STM04SAUBL /end AXIS_DESCR
/end CHARACTERISTIC
/begin CHARACTERISTIC KFMRESLT "map: temperature and engine speed depending torque reserve limit" MAP 0x80527FAA RB_Map_U8U8_U8 24.90 rel_ub_b25 0.00 24.90 FORMAT "%5.2"
 /begin AXIS_DESCR STD_AXIS LLRMR_tmot_tmp temp_ub_q0p75_o48 4 -48.0 143.3 FORMAT "%5.1" DEPOSIT ABSOLUTE /end AXIS_DESCR
 /begin AXIS_DESCR STD_AXIS LLRMR_nmot_tmp nmot_ub_q40 4 0.00 10200. FORMAT "%5.0" DEPOSIT ABSOLUTE /end AXIS_DESCR
/end CHARACTERISTIC
/begin CHARACTERISTIC KFMRESNL "Torque reserve in non idling state" MAP 0x80527FC4 RB_MapGroup_U8 24.90 rel_ub_b25 0.00 24.90 FORMAT "%5.2"
 /begin AXIS_DESCR COM_AXIS LLRMR_nmotw_tmp nmot_uw_q0p25 8 0.00 16383.75 FORMAT "%8.2" AXIS_PTS_REF SNM06LLUWL /end AXIS_DESCR
 /begin AXIS_DESCR COM_AXIS LLRMR_mifa_w_tmp rel_uw_b100 8 0.00 99.99847 FORMAT "%8.5" AXIS_PTS_REF SMI04LLUBL /end AXIS_DESCR
/end CHARACTERISTIC
/begin CHARACTERISTIC KFMRESSAIL "Engine speed control: Torque reserve at idle and near-idle zone for closed powertrain, Sailing" MAP 0x80528004 RB_MapGroup_U8 24.90 rel_ub_b25 0.00 24.90 FORMAT "%5.2"
 /begin AXIS_DESCR COM_AXIS LLRMR_nmotw_tmp nmot_uw_q0p25 8 0.00 16383.75 FORMAT "%8.2" AXIS_PTS_REF SNM06LLUWL /end AXIS_DESCR
 /begin AXIS_DESCR COM_AXIS LLRMR_mifa_w_tmp rel_uw_b100 8 0.00 99.99847 FORMAT "%8.5" AXIS_PTS_REF SMI04LLUBL /end AXIS_DESCR
/end CHARACTERISTIC
/begin CHARACTERISTIC KFMRESSP "Engine speed control: Torque reserve at idle and near-idle zone, Sport" MAP 0x80528044 RB_MapGroup_U8 24.90 rel_ub_b25 0.00 24.90 FORMAT "%5.2"
 /begin AXIS_DESCR COM_AXIS LLRMR_nmotw_tmp nmot_uw_q0p25 8 0.00 16383.75 FORMAT "%8.2" AXIS_PTS_REF SNM06LLUWL /end AXIS_DESCR
 /begin AXIS_DESCR COM_AXIS LLRMR_mifa_w_tmp rel_uw_b100 8 0.00 99.99847 FORMAT "%8.5" AXIS_PTS_REF SMI04LLUBL /end AXIS_DESCR
/end CHARACTERISTIC
/begin CHARACTERISTIC KFMRESSPP "Engine speed control: Torque reserve at idle and near-idle zone, SportPlus" MAP 0x80528084 RB_MapGroup_U8 24.90 rel_ub_b25 0.00 24.90 FORMAT "%5.2"
 /begin AXIS_DESCR COM_AXIS LLRMR_nmotw_tmp nmot_uw_q0p25 8 0.00 16383.75 FORMAT "%8.2" AXIS_PTS_REF SNM06LLUWL /end AXIS_DESCR
 /begin AXIS_DESCR COM_AXIS LLRMR_mifa_w_tmp rel_uw_b100 8 0.00 99.99847 FORMAT "%8.5" AXIS_PTS_REF SMI04LLUBL /end AXIS_DESCR
/end CHARACTERISTIC
/begin CHARACTERISTIC KFMRESTA "Torque margin dependent on intake air temperature" MAP 0x805280C4 RB_MapGroup_U8 24.90 rel_ub_b25 0.00 24.90 FORMAT "%5.2"
 /begin AXIS_DESCR COM_AXIS LLRMR_tans_temp temp_ub_q0p75_o48 4 -48.0 143.3 FORMAT "%5.1" AXIS_PTS_REF STA04LLUBL /end AXIS_DESCR
 /begin AXIS_DESCR COM_AXIS LLRMR_mifa_w_tmp rel_uw_b100 8 0.00 99.99847 FORMAT "%8.5" AXIS_PTS_REF SMI04LLUBL /end AXIS_DESCR
/end CHARACTERISTIC
/begin CHARACTERISTIC KLDMRESTM "Map for temperature-dependent reduction of the torque reserve after start" CURVE 0x805280E4 RB_Curve_U8_U8 0.3891 rel_q0p00153 0.00 0.3891
 /begin AXIS_DESCR STD_AXIS LLRMR_tmot_tmp temp_ub_q0p75_o48 4 -48.0 143.3 FORMAT "%5.1" DEPOSIT ABSOLUTE /end AXIS_DESCR
/end CHARACTERISTIC
/begin CHARACTERISTIC KLDNLLDE "characteristic curve: torque reserve for speed undershoot" CURVE 0x805280EE RB_Curve_S16_S8_Static 25500. nmotg_sb_q100 -12800. 12700. FORMAT "%5.0"
 /begin AXIS_DESCR STD_AXIS LLRMR_dns_temp nmot_sw_q0p5 6 -16384.00 16383.50 FORMAT "%8.2" DEPOSIT ABSOLUTE /end AXIS_DESCR
/end CHARACTERISTIC
/begin CHARACTERISTIC KLDNSNFST "speed threshold of nsol-limitation in start from characteristic line" CURVE 0x8052844E RB_CurveGroup_S16 16383.50 nmot_sw_q0p5 0.00 16383.50 FORMAT "%8.2" EXTENDED_LIMITS -16384.00 16383.50
 /begin AXIS_DESCR COM_AXIS tmst_llrnsnf_loc temp_ub_q0p75_o48 8 -48.0 143.3 FORMAT "%5.1" AXIS_PTS_REF STS08ESUBL /end AXIS_DESCR
/end CHARACTERISTIC
/begin CHARACTERISTIC KLGNGW "gear dependent factor for non idle" CURVE 0x80528102 RB_Curve_U8_U8 1.000 fak_uw_q0p1 0.00 1.000 FORMAT "%5.3" EXTENDED_LIMITS 0.00 25.50
 /begin AXIS_DESCR STD_AXIS LLRMR_gangi_tmp OneToOne 6 0.00 255.0 FORMAT "%5.1" DEPOSIT ABSOLUTE /end AXIS_DESCR
/end CHARACTERISTIC
/begin CHARACTERISTIC KLGNSTAT "Gear dependent offset of the engine speed for the activation of underspeed detection to increase the torque reserve" CURVE 0x8052810F RB_Curve_U8_U8 10200. nmot_ub_q40 0.00 10200. FORMAT "%5.0"
 /begin AXIS_DESCR STD_AXIS LLRMR_gangi_tmp OneToOne 10 0.00 255.0 FORMAT "%5.1" DEPOSIT ABSOLUTE /end AXIS_DESCR
/end CHARACTERISTIC
/begin CHARACTERISTIC KLMRESLLSTA "Intake air temperature dependent torque reserve when underspeed is detected" CURVE 0x80528124 RB_Curve_U8_U8 24.90 rel_ub_b25 0.00 24.90 FORMAT "%5.2"
 /begin AXIS_DESCR STD_AXIS LLRMR_tans_temp temp_ub_q0p75_o48 6 -48.0 143.3 FORMAT "%5.1" DEPOSIT ABSOLUTE /end AXIS_DESCR
/end CHARACTERISTIC
/begin CHARACTERISTIC KLMRESPHIR "Adaption of base torque reserve to road resistance index" CURVE 0x80528132 RB_Curve_S16_U8_Static 24.90 rel_ub_b25 0.00 24.90 FORMAT "%5.2"
 /begin AXIS_DESCR STD_AXIS VehPos_rIncIX PrcHigh 6 -32.76800 32.76700 FORMAT "%8.5" DEPOSIT ABSOLUTE /end AXIS_DESCR
/end CHARACTERISTIC
/begin CHARACTERISTIC KLMRESTM "characteristic for torque reserve after start" CURVE 0x80528146 RB_Curve_U8_U8 24.90 rel_ub_b25 0.00 24.90 FORMAT "%5.2"
 /begin AXIS_DESCR STD_AXIS LLRMR_tmot_tmp temp_ub_q0p75_o48 4 -48.0 143.3 FORMAT "%5.1" DEPOSIT ABSOLUTE /end AXIS_DESCR
/end CHARACTERISTIC
/begin CHARACTERISTIC KLMRESUB "Torque reserve depending on voltage drop" CURVE 0x80528150 RB_Curve_U16_U8_Static 24.90 rel_ub_b25 0.00 24.90 FORMAT "%5.2"
 /begin AXIS_DESCR STD_AXIS dmresubg spg_q0p00039 5 0.00 25.59961 FORMAT "%8.5" DEPOSIT ABSOLUTE /end AXIS_DESCR
/end CHARACTERISTIC
/begin CHARACTERISTIC KLMRHO "map: altitude depending torque reserve" CURVE 0x80528162 RB_Curve_U8_U8 24.90 rel_ub_b25 0.00 24.90 FORMAT "%5.2"
 /begin AXIS_DESCR STD_AXIS LLRMR_fho_tmp fak_ub_b4 10 0.00 3.984 FORMAT "%5.3" DEPOSIT ABSOLUTE /end AXIS_DESCR
/end CHARACTERISTIC
/begin CHARACTERISTIC KLMRHOFS "Curve: Altitude depending offset for the torque reserve for engaged driving position" CURVE 0x80528177 RB_Curve_U8_U8 24.90 rel_ub_b25 0.00 24.90 FORMAT "%5.2"
 /begin AXIS_DESCR STD_AXIS LLRMR_fho_tmp fak_ub_b4 10 0.00 3.984 FORMAT "%5.3" DEPOSIT ABSOLUTE /end AXIS_DESCR
/end CHARACTERISTIC
/begin CHARACTERISTIC KLTVRESTM "Map for formation of a temperature-dependent switch-off time for the torque reserve after start" CURVE 0x8052818C RB_Curve_U8_U16_Static 1310.700 t20msxs_uw_q0p02 0.00 1310.700 FORMAT "%8.3"
 /begin AXIS_DESCR STD_AXIS LLRMR_tmot_tmp temp_ub_q0p75_o48 4 -48.0 143.3 FORMAT "%5.1" DEPOSIT ABSOLUTE /end AXIS_DESCR
/end CHARACTERISTIC
/begin CHARACTERISTIC KLVANF "characteristic curve: torque reserve for standing start" CURVE 0x8052819A RB_Curve_U8_U8 158.8 vfzg_ub_q1p25 0.00 158.8 FORMAT "%5.1" EXTENDED_LIMITS 0.00 318.8
 /begin AXIS_DESCR STD_AXIS LLRMR_tosp_tmp temp_ub_q0p75_o48 4 -48.0 143.3 FORMAT "%5.1" DEPOSIT ABSOLUTE /end AXIS_DESCR
/end CHARACTERISTIC
/begin CHARACTERISTIC KLZNSM "time constant for decay of desired idling speed" CURVE 0x8052845E RB_CurveGroup_U16 655.34999985 zk10msxs_uw_b655p36 0.01000015 655.36000000 FORMAT "%12.8" EXTENDED_LIMITS 0.010000152590 655.36000000
 /begin AXIS_DESCR COM_AXIS llrnsnf_sns06llsbLoc nmotd_sb_q10 6 -1280. 1270. FORMAT "%5.0" AXIS_PTS_REF LLRNSNF_nSpLoDiff_X_Ax /end AXIS_DESCR
/end CHARACTERISTIC
/begin CHARACTERISTIC KLZNSMTRA "time constant for decay of desired idling speed for transmisson engine speed demand" CURVE 0x8052846A RB_CurveGroup_U16 655.34999985 zk10msxs_uw_b655p36 0.01000015 655.36000000 FORMAT "%12.8" EXTENDED_LIMITS 0.010000152590 655.36000000
 /begin AXIS_DESCR COM_AXIS llrnsnf_sns06llsbLoc nmotd_sb_q10 6 -1280. 1270. FORMAT "%5.0" AXIS_PTS_REF LLRNSNF_nSpLoDiff_X_Ax /end AXIS_DESCR
/end CHARACTERISTIC
/begin CHARACTERISTIC KNSNF_W "Engine speed follow-up inhibition band" VALUE 0x80528476 RB_Val_Ws16 16383.50 nmot_sw_q0p5 0.00 16383.50 FORMAT "%8.2" EXTENDED_LIMITS -16384.00 16383.50 /end CHARACTERISTIC
/begin CHARACTERISTIC LIVFZDE "Speed limit for speed undershoot." VALUE 0x805281A3 RB_Val_Wu8 318.8 vfzg_ub_q1p25 0.00 318.8 FORMAT "%5.1" /end CHARACTERISTIC
/begin CHARACTERISTIC LIVFZMNDE "Minimum Vehicle velocity limit for speed undershoot." VALUE 0x805281A4 RB_Val_Wu8 318.8 vfzg_ub_q1p25 0.00 318.8 FORMAT "%5.1" /end CHARACTERISTIC
/begin CHARACTERISTIC LLim_ctASLAppATOpenLrn_C "Counter value for AT full open learn value translation check" VALUE 0x80528590 Val_Wu8 127.0 OneToOne 0.00 127.0 FORMAT "%5.1" EXTENDED_LIMITS 0.00 255.0 /end CHARACTERISTIC
/begin CHARACTERISTIC LLim_facAcclDeclCor_CUR "Curve for decelerate correction factor(for accelerate speed control)" CURVE 0x80528592 RB_Curve_S16_S16 1023.984 Fact_CrCtl2 -512.0000 511.9844 FORMAT "%8.4"
 /begin AXIS_DESCR STD_AXIS CrCtl_vASLVehCont Vel 12 -327.6800 327.6700 FORMAT "%8.4" DEPOSIT ABSOLUTE /end AXIS_DESCR
/end CHARACTERISTIC
/begin CHARACTERISTIC LLim_facAPPDiffCor1LGCls_MAP "MAP for Correction factor based on difference of accel pedal position(for 1 level lower gear and close side)" MAP 0x805285C4 RB_Map_S16S16_S16 511.9922 Fact1 -256.0000 255.9922 FORMAT "%8.4"
 /begin AXIS_DESCR STD_AXIS LLim_rDesReq_mp APPCrCtl1 12 -163.8400 163.8350 FORMAT "%8.4" DEPOSIT ABSOLUTE /end AXIS_DESCR
 /begin AXIS_DESCR STD_AXIS CrCtl_vASLVehCont Vel 12 -327.6800 327.6700 FORMAT "%8.4" DEPOSIT ABSOLUTE /end AXIS_DESCR
/end CHARACTERISTIC
/begin CHARACTERISTIC LLim_facAPPDiffCor1LG_MAP "MAP for Correction factor based on difference of accel pedal position(for 1 level lower gear)" MAP 0x80528718 RB_Map_S16S16_S16 511.9922 Fact1 -256.0000 255.9922 FORMAT "%8.4"
 /begin AXIS_DESCR STD_AXIS LLim_rDesReq_mp APPCrCtl1 12 -163.8400 163.8350 FORMAT "%8.4" DEPOSIT ABSOLUTE /end AXIS_DESCR
 /begin AXIS_DESCR STD_AXIS CrCtl_vASLVehCont Vel 12 -327.6800 327.6700 FORMAT "%8.4" DEPOSIT ABSOLUTE /end AXIS_DESCR
/end CHARACTERISTIC
/begin CHARACTERISTIC LLim_facAPPDiffCor2LGCls_MAP "MAP for Correction factor based on difference of accel pedal position(for 2 level lower gear and close side)" MAP 0x8052886C RB_Map_S16S16_S16 511.9922 Fact1 -256.0000 255.9922 FORMAT "%8.4"
 /begin AXIS_DESCR STD_AXIS LLim_rDesReq_mp APPCrCtl1 12 -163.8400 163.8350 FORMAT "%8.4" DEPOSIT ABSOLUTE /end AXIS_DESCR
 /begin AXIS_DESCR STD_AXIS CrCtl_vASLVehCont Vel 12 -327.6800 327.6700 FORMAT "%8.4" DEPOSIT ABSOLUTE /end AXIS_DESCR
/end CHARACTERISTIC
/begin CHARACTERISTIC LLim_facAPPDiffCor2LG_MAP "MAP for Correction factor based on difference of accel pedal position(for 2 level lower gear)" MAP 0x805289C0 RB_Map_S16S16_S16 511.9922 Fact1 -256.0000 255.9922 FORMAT "%8.4"
 /begin AXIS_DESCR STD_AXIS LLim_rDesReq_mp APPCrCtl1 12 -163.8400 163.8350 FORMAT "%8.4" DEPOSIT ABSOLUTE /end AXIS_DESCR
 /begin AXIS_DESCR STD_AXIS CrCtl_vASLVehCont Vel 12 -327.6800 327.6700 FORMAT "%8.4" DEPOSIT ABSOLUTE /end AXIS_DESCR
/end CHARACTERISTIC
/begin CHARACTERISTIC LLim_facAPPDiffCor3LGCls_MAP "MAP for Correction factor based on difference of accel pedal position(for 3 level lower gear and close side)" MAP 0x80528B14 RB_Map_S16S16_S16 511.9922 Fact1 -256.0000 255.9922 FORMAT "%8.4"
 /begin AXIS_DESCR STD_AXIS LLim_rDesReq_mp APPCrCtl1 12 -163.8400 163.8350 FORMAT "%8.4" DEPOSIT ABSOLUTE /end AXIS_DESCR
 /begin AXIS_DESCR STD_AXIS CrCtl_vASLVehCont Vel 12 -327.6800 327.6700 FORMAT "%8.4" DEPOSIT ABSOLUTE /end AXIS_DESCR
/end CHARACTERISTIC
/begin CHARACTERISTIC LLim_facAPPDiffCor3LG_MAP "MAP for Correction factor based on difference of accel pedal position(for 3 level lower gear)" MAP 0x80528C68 RB_Map_S16S16_S16 511.9922 Fact1 -256.0000 255.9922 FORMAT "%8.4"
 /begin AXIS_DESCR STD_AXIS LLim_rDesReq_mp APPCrCtl1 12 -163.8400 163.8350 FORMAT "%8.4" DEPOSIT ABSOLUTE /end AXIS_DESCR
 /begin AXIS_DESCR STD_AXIS CrCtl_vASLVehCont Vel 12 -327.6800 327.6700 FORMAT "%8.4" DEPOSIT ABSOLUTE /end AXIS_DESCR
/end CHARACTERISTIC
/begin CHARACTERISTIC LLim_facAPPDiffCor4LGCls_MAP "MAP for Correction factor based on difference of accel pedal position(for 4 level lower gear and close side)" MAP 0x80528DBC RB_Map_S16S16_S16 511.9922 Fact1 -256.0000 255.9922 FORMAT "%8.4"
 /begin AXIS_DESCR STD_AXIS LLim_rDesReq_mp APPCrCtl1 12 -163.8400 163.8350 FORMAT "%8.4" DEPOSIT ABSOLUTE /end AXIS_DESCR
 /begin AXIS_DESCR STD_AXIS CrCtl_vASLVehCont Vel 12 -327.6800 327.6700 FORMAT "%8.4" DEPOSIT ABSOLUTE /end AXIS_DESCR
/end CHARACTERISTIC
/begin CHARACTERISTIC LLim_facAPPDiffCor4LG_MAP "MAP for Correction factor based on difference of accel pedal position(for 4 level lower gear)" MAP 0x80528F10 RB_Map_S16S16_S16 511.9922 Fact1 -256.0000 255.9922 FORMAT "%8.4"
 /begin AXIS_DESCR STD_AXIS LLim_rDesReq_mp APPCrCtl1 12 -163.8400 163.8350 FORMAT "%8.4" DEPOSIT ABSOLUTE /end AXIS_DESCR
 /begin AXIS_DESCR STD_AXIS CrCtl_vASLVehCont Vel 12 -327.6800 327.6700 FORMAT "%8.4" DEPOSIT ABSOLUTE /end AXIS_DESCR
/end CHARACTERISTIC
/begin CHARACTERISTIC LLim_facAPPDiffCor5LGCls_MAP "MAP for Correction factor based on difference of accel pedal position(for 5 level lower gear and close side)" MAP 0x80529064 RB_Map_S16S16_S16 511.9922 Fact1 -256.0000 255.9922 FORMAT "%8.4"
 /begin AXIS_DESCR STD_AXIS LLim_rDesReq_mp APPCrCtl1 12 -163.8400 163.8350 FORMAT "%8.4" DEPOSIT ABSOLUTE /end AXIS_DESCR
 /begin AXIS_DESCR STD_AXIS CrCtl_vASLVehCont Vel 12 -327.6800 327.6700 FORMAT "%8.4" DEPOSIT ABSOLUTE /end AXIS_DESCR
/end CHARACTERISTIC
/begin CHARACTERISTIC LLim_facAPPDiffCor5LG_MAP "MAP for Correction factor based on difference of accel pedal position(for 5 level lower gear)" MAP 0x805291B8 RB_Map_S16S16_S16 511.9922 Fact1 -256.0000 255.9922 FORMAT "%8.4"
 /begin AXIS_DESCR STD_AXIS LLim_rDesReq_mp APPCrCtl1 12 -163.8400 163.8350 FORMAT "%8.4" DEPOSIT ABSOLUTE /end AXIS_DESCR
 /begin AXIS_DESCR STD_AXIS CrCtl_vASLVehCont Vel 12 -327.6800 327.6700 FORMAT "%8.4" DEPOSIT ABSOLUTE /end AXIS_DESCR
/end CHARACTERISTIC
/begin CHARACTERISTIC LLim_facAPPDiffCorTGCls_MAP "MAP for Correction factor based on difference of accel pedal position(for the top gear and close side)" MAP 0x8052930C RB_Map_S16S16_S16 511.9922 Fact1 -256.0000 255.9922 FORMAT "%8.4"
 /begin AXIS_DESCR STD_AXIS LLim_rDesReq_mp APPCrCtl1 12 -163.8400 163.8350 FORMAT "%8.4" DEPOSIT ABSOLUTE /end AXIS_DESCR
 /begin AXIS_DESCR STD_AXIS CrCtl_vASLVehCont Vel 12 -327.6800 327.6700 FORMAT "%8.4" DEPOSIT ABSOLUTE /end AXIS_DESCR
/end CHARACTERISTIC
/begin CHARACTERISTIC LLim_facAPPDiffCorTG_MAP "MAP for Correction factor based on difference of accel pedal position(for the top gear)" MAP 0x80529460 RB_Map_S16S16_S16 511.9922 Fact1 -256.0000 255.9922 FORMAT "%8.4"
 /begin AXIS_DESCR STD_AXIS LLim_rDesReq_mp APPCrCtl1 12 -163.8400 163.8350 FORMAT "%8.4" DEPOSIT ABSOLUTE /end AXIS_DESCR
 /begin AXIS_DESCR STD_AXIS CrCtl_vASLVehCont Vel 12 -327.6800 327.6700 FORMAT "%8.4" DEPOSIT ABSOLUTE /end AXIS_DESCR
/end CHARACTERISTIC
/begin CHARACTERISTIC LLim_facAPPReqItmFlt_C "Factor of interim value for filtered request accel pedal position" VALUE 0x805295B4 Val_Ws16 255.9961 Fact_CrCtl -128.0000 127.9961 FORMAT "%8.4" /end CHARACTERISTIC
/begin CHARACTERISTIC LLim_facCnvVehUn_C "Conversion factor for unit of vehicle speed" VALUE 0x805295B6 Val_Ws16 3.276700 Fact_10000 0.00 3.276700 FORMAT "%8.6" EXTENDED_LIMITS -3.276800 3.276700 /end CHARACTERISTIC
/begin CHARACTERISTIC LLim_facConstDeclCor_CUR "Curve for decelerate correction factor(for constant speed control)" CURVE 0x805295B8 RB_Curve_S16_S16 1023.984 Fact_CrCtl2 -512.0000 511.9844 FORMAT "%8.4"
 /begin AXIS_DESCR STD_AXIS LLim_vDes_mp Vel 12 -327.6800 327.6700 FORMAT "%8.4" DEPOSIT ABSOLUTE /end AXIS_DESCR
/end CHARACTERISTIC
/begin CHARACTERISTIC LLim_facFdbkAcclP1LG_CUR "Curve for acceleration Feed Back P coefficient factor value(for 1 level lower gear)" CURVE 0x805295EA RB_Curve_S16_S16 1023.984 Fact_CrCtl2 -512.0000 511.9844 FORMAT "%8.4"
 /begin AXIS_DESCR STD_AXIS CrCtl_vASLVehCont Vel 12 -327.6800 327.6700 FORMAT "%8.4" DEPOSIT ABSOLUTE /end AXIS_DESCR
/end CHARACTERISTIC
/begin CHARACTERISTIC LLim_facFdbkAcclP2LG_CUR "Curve for acceleration Feed Back P coefficient factor value(for 2 level lower gear)" CURVE 0x8052961C RB_Curve_S16_S16 1023.984 Fact_CrCtl2 -512.0000 511.9844 FORMAT "%8.4"
 /begin AXIS_DESCR STD_AXIS CrCtl_vASLVehCont Vel 12 -327.6800 327.6700 FORMAT "%8.4" DEPOSIT ABSOLUTE /end AXIS_DESCR
/end CHARACTERISTIC
/begin CHARACTERISTIC LLim_facFdbkAcclP3LG_CUR "Curve for acceleration Feed Back P coefficient factor value(for 3 level lower gear)" CURVE 0x8052964E RB_Curve_S16_S16 1023.984 Fact_CrCtl2 -512.0000 511.9844 FORMAT "%8.4"
 /begin AXIS_DESCR STD_AXIS CrCtl_vASLVehCont Vel 12 -327.6800 327.6700 FORMAT "%8.4" DEPOSIT ABSOLUTE /end AXIS_DESCR
/end CHARACTERISTIC
/begin CHARACTERISTIC LLim_facFdbkAcclP4LG_CUR "Curve for acceleration Feed Back P coefficient factor value(for 4 level lower gear)" CURVE 0x80529680 RB_Curve_S16_S16 1023.984 Fact_CrCtl2 -512.0000 511.9844 FORMAT "%8.4"
 /begin AXIS_DESCR STD_AXIS CrCtl_vASLVehCont Vel 12 -327.6800 327.6700 FORMAT "%8.4" DEPOSIT ABSOLUTE /end AXIS_DESCR
/end CHARACTERISTIC
/begin CHARACTERISTIC LLim_facFdbkAcclP5LG_CUR "Curve for acceleration Feed Back P coefficient factor value(for 5 level lower gear)" CURVE 0x805296B2 RB_Curve_S16_S16 1023.984 Fact_CrCtl2 -512.0000 511.9844 FORMAT "%8.4"
 /begin AXIS_DESCR STD_AXIS CrCtl_vASLVehCont Vel 12 -327.6800 327.6700 FORMAT "%8.4" DEPOSIT ABSOLUTE /end AXIS_DESCR
/end CHARACTERISTIC
/begin CHARACTERISTIC LLim_facFdbkAcclPTG_CUR "Curve for acceleration Feed Back P coefficient factor value(for the top gear)" CURVE 0x805296E4 RB_Curve_S16_S16 1023.984 Fact_CrCtl2 -512.0000 511.9844 FORMAT "%8.4"
 /begin AXIS_DESCR STD_AXIS CrCtl_vASLVehCont Vel 12 -327.6800 327.6700 FORMAT "%8.4" DEPOSIT ABSOLUTE /end AXIS_DESCR
/end CHARACTERISTIC
/begin CHARACTERISTIC LLim_facFdbkD1LG_MAP "MAP for Feed Back D coefficient factor value (for 1 level lower gear)" MAP 0x80529716 RB_Map_S16S16_S16 1023.984 Fact_CrCtl2 -512.0000 511.9844 FORMAT "%8.4"
 /begin AXIS_DESCR STD_AXIS LLim_vDes_mp Vel 12 -327.6800 327.6700 FORMAT "%8.4" DEPOSIT ABSOLUTE /end AXIS_DESCR
 /begin AXIS_DESCR STD_AXIS LLim_vSpdDvt_mp Vel 9 -327.6800 327.6700 FORMAT "%8.4" DEPOSIT ABSOLUTE /end AXIS_DESCR
/end CHARACTERISTIC
/begin CHARACTERISTIC LLim_facFdbkD2LG_MAP "MAP for Feed Back D coefficient factor value (for 2 level lower gear)" MAP 0x8052981C RB_Map_S16S16_S16 1023.984 Fact_CrCtl2 -512.0000 511.9844 FORMAT "%8.4"
 /begin AXIS_DESCR STD_AXIS LLim_vDes_mp Vel 12 -327.6800 327.6700 FORMAT "%8.4" DEPOSIT ABSOLUTE /end AXIS_DESCR
 /begin AXIS_DESCR STD_AXIS LLim_vSpdDvt_mp Vel 9 -327.6800 327.6700 FORMAT "%8.4" DEPOSIT ABSOLUTE /end AXIS_DESCR
/end CHARACTERISTIC
/begin CHARACTERISTIC LLim_facFdbkD3LG_MAP "MAP for Feed Back D coefficient factor value (for 3 level lower gear)" MAP 0x80529922 RB_Map_S16S16_S16 1023.984 Fact_CrCtl2 -512.0000 511.9844 FORMAT "%8.4"
 /begin AXIS_DESCR STD_AXIS LLim_vDes_mp Vel 12 -327.6800 327.6700 FORMAT "%8.4" DEPOSIT ABSOLUTE /end AXIS_DESCR
 /begin AXIS_DESCR STD_AXIS LLim_vSpdDvt_mp Vel 9 -327.6800 327.6700 FORMAT "%8.4" DEPOSIT ABSOLUTE /end AXIS_DESCR
/end CHARACTERISTIC
/begin CHARACTERISTIC LLim_facFdbkD4LG_MAP "MAP for Feed Back D coefficient factor value (for 4 level lower gear)" MAP 0x80529A28 RB_Map_S16S16_S16 1023.984 Fact_CrCtl2 -512.0000 511.9844 FORMAT "%8.4"
 /begin AXIS_DESCR STD_AXIS LLim_vDes_mp Vel 12 -327.6800 327.6700 FORMAT "%8.4" DEPOSIT ABSOLUTE /end AXIS_DESCR
 /begin AXIS_DESCR STD_AXIS LLim_vSpdDvt_mp Vel 9 -327.6800 327.6700 FORMAT "%8.4" DEPOSIT ABSOLUTE /end AXIS_DESCR
/end CHARACTERISTIC
/begin CHARACTERISTIC LLim_facFdbkD5LG_MAP "MAP for Feed Back D coefficient factor value (for 5 level lower gear)" MAP 0x80529B2E RB_Map_S16S16_S16 1023.984 Fact_CrCtl2 -512.0000 511.9844 FORMAT "%8.4"
 /begin AXIS_DESCR STD_AXIS LLim_vDes_mp Vel 12 -327.6800 327.6700 FORMAT "%8.4" DEPOSIT ABSOLUTE /end AXIS_DESCR
 /begin AXIS_DESCR STD_AXIS LLim_vSpdDvt_mp Vel 9 -327.6800 327.6700 FORMAT "%8.4" DEPOSIT ABSOLUTE /end AXIS_DESCR
/end CHARACTERISTIC
/begin CHARACTERISTIC LLim_facFdbkDLmap_MAP "MAP for feedback D coefficient factor value (for L positions)" MAP 0x80529C34 RB_Map_S16S16_S16 1023.984 Fact_CrCtl2 -512.0000 511.9844 FORMAT "%8.4"
 /begin AXIS_DESCR STD_AXIS LLim_vDes_mp Vel 12 -327.6800 327.6700 FORMAT "%8.4" DEPOSIT ABSOLUTE /end AXIS_DESCR
 /begin AXIS_DESCR STD_AXIS LLim_vSpdDvt_mp Vel 9 -327.6800 327.6700 FORMAT "%8.4" DEPOSIT ABSOLUTE /end AXIS_DESCR
/end CHARACTERISTIC
/begin CHARACTERISTIC LLim_facFdbkDTG_MAP "MAP for Feed Back D coefficient factor value (for the top gear)" MAP 0x80529D3A RB_Map_S16S16_S16 1023.984 Fact_CrCtl2 -512.0000 511.9844 FORMAT "%8.4"
 /begin AXIS_DESCR STD_AXIS LLim_vDes_mp Vel 12 -327.6800 327.6700 FORMAT "%8.4" DEPOSIT ABSOLUTE /end AXIS_DESCR
 /begin AXIS_DESCR STD_AXIS LLim_vSpdDvt_mp Vel 9 -327.6800 327.6700 FORMAT "%8.4" DEPOSIT ABSOLUTE /end AXIS_DESCR
/end CHARACTERISTIC
/begin CHARACTERISTIC LLim_facFdbkP1LG_MAP "MAP for Feed Back P coefficient factor value (for 1 level lower gear)" MAP 0x80529E40 RB_Map_S16S16_S16 63.99902 Fact_CrCtl3 -32.00000 31.99902 FORMAT "%8.5"
 /begin AXIS_DESCR STD_AXIS LLim_vDes_mp Vel 12 -327.6800 327.6700 FORMAT "%8.4" DEPOSIT ABSOLUTE /end AXIS_DESCR
 /begin AXIS_DESCR STD_AXIS LLim_vSpdDvt_mp Vel 9 -327.6800 327.6700 FORMAT "%8.4" DEPOSIT ABSOLUTE /end AXIS_DESCR
/end CHARACTERISTIC
/begin CHARACTERISTIC LLim_facFdbkP2LG_MAP "MAP for Feed Back P coefficient factor value (for 2 level lower gear)" MAP 0x80529F46 RB_Map_S16S16_S16 63.99902 Fact_CrCtl3 -32.00000 31.99902 FORMAT "%8.5"
 /begin AXIS_DESCR STD_AXIS LLim_vDes_mp Vel 12 -327.6800 327.6700 FORMAT "%8.4" DEPOSIT ABSOLUTE /end AXIS_DESCR
 /begin AXIS_DESCR STD_AXIS LLim_vSpdDvt_mp Vel 9 -327.6800 327.6700 FORMAT "%8.4" DEPOSIT ABSOLUTE /end AXIS_DESCR
/end CHARACTERISTIC
/begin CHARACTERISTIC LLim_facFdbkP3LG_MAP "MAP for Feed Back P coefficient factor value (for 3 level lower gear)" MAP 0x8052A04C RB_Map_S16S16_S16 63.99902 Fact_CrCtl3 -32.00000 31.99902 FORMAT "%8.5"
 /begin AXIS_DESCR STD_AXIS LLim_vDes_mp Vel 12 -327.6800 327.6700 FORMAT "%8.4" DEPOSIT ABSOLUTE /end AXIS_DESCR
 /begin AXIS_DESCR STD_AXIS LLim_vSpdDvt_mp Vel 9 -327.6800 327.6700 FORMAT "%8.4" DEPOSIT ABSOLUTE /end AXIS_DESCR
/end CHARACTERISTIC
/begin CHARACTERISTIC LLim_facFdbkP4LG_MAP "MAP for Feed Back P coefficient factor value (for 4 level lower gear)" MAP 0x8052A152 RB_Map_S16S16_S16 63.99902 Fact_CrCtl3 -32.00000 31.99902 FORMAT "%8.5"
 /begin AXIS_DESCR STD_AXIS LLim_vDes_mp Vel 12 -327.6800 327.6700 FORMAT "%8.4" DEPOSIT ABSOLUTE /end AXIS_DESCR
 /begin AXIS_DESCR STD_AXIS LLim_vSpdDvt_mp Vel 9 -327.6800 327.6700 FORMAT "%8.4" DEPOSIT ABSOLUTE /end AXIS_DESCR
/end CHARACTERISTIC
/begin CHARACTERISTIC LLim_facFdbkP5LG_MAP "MAP for Feed Back P coefficient factor value (for 5 level lower gear)" MAP 0x8052A258 RB_Map_S16S16_S16 63.99902 Fact_CrCtl3 -32.00000 31.99902 FORMAT "%8.5"
 /begin AXIS_DESCR STD_AXIS LLim_vDes_mp Vel 12 -327.6800 327.6700 FORMAT "%8.4" DEPOSIT ABSOLUTE /end AXIS_DESCR
 /begin AXIS_DESCR STD_AXIS LLim_vSpdDvt_mp Vel 9 -327.6800 327.6700 FORMAT "%8.4" DEPOSIT ABSOLUTE /end AXIS_DESCR
/end CHARACTERISTIC
/begin CHARACTERISTIC LLim_facFdbkPLmap_MAP "MAP for feedback P coefficient factor value (for L positions)" MAP 0x8052A35E RB_Map_S16S16_S16 63.99902 Fact_CrCtl3 -32.00000 31.99902 FORMAT "%8.5"
 /begin AXIS_DESCR STD_AXIS LLim_vDes_mp Vel 12 -327.6800 327.6700 FORMAT "%8.4" DEPOSIT ABSOLUTE /end AXIS_DESCR
 /begin AXIS_DESCR STD_AXIS LLim_vSpdDvt_mp Vel 9 -327.6800 327.6700 FORMAT "%8.4" DEPOSIT ABSOLUTE /end AXIS_DESCR
/end CHARACTERISTIC
/begin CHARACTERISTIC LLim_facFdbkPTG_MAP "MAP for Feed Back P coefficient factor value (for the top gear)" MAP 0x8052A464 RB_Map_S16S16_S16 63.99902 Fact_CrCtl3 -32.00000 31.99902 FORMAT "%8.5"
 /begin AXIS_DESCR STD_AXIS LLim_vDes_mp Vel 12 -327.6800 327.6700 FORMAT "%8.4" DEPOSIT ABSOLUTE /end AXIS_DESCR
 /begin AXIS_DESCR STD_AXIS LLim_vSpdDvt_mp Vel 9 -327.6800 327.6700 FORMAT "%8.4" DEPOSIT ABSOLUTE /end AXIS_DESCR
/end CHARACTERISTIC
/begin CHARACTERISTIC LLim_facSpdUnConv_C "Factor of vehicle speed unit conversion data" VALUE 0x8052A56A Val_Ws16 255.9961 Fact_CrCtl -128.0000 127.9961 FORMAT "%8.4" /end CHARACTERISTIC
/begin CHARACTERISTIC LLim_facSptAPPDiffCor1LGCls_MAP "MAP for Correction factor based on difference of accel pedal position(for 1 level lower gear and close side) for sport mode" MAP 0x8052A56C RB_Map_S16S16_S16 511.9922 Fact1 -256.0000 255.9922 FORMAT "%8.4"
 /begin AXIS_DESCR STD_AXIS LLim_rDesReq_mp APPCrCtl1 12 -163.8400 163.8350 FORMAT "%8.4" DEPOSIT ABSOLUTE /end AXIS_DESCR
 /begin AXIS_DESCR STD_AXIS CrCtl_vASLVehCont Vel 12 -327.6800 327.6700 FORMAT "%8.4" DEPOSIT ABSOLUTE /end AXIS_DESCR
/end CHARACTERISTIC
/begin CHARACTERISTIC LLim_facSptAPPDiffCor1LG_MAP "MAP for Correction factor based on difference of accel pedal position(for 1 level lower gear and open side) for sport mode" MAP 0x8052A6C0 RB_Map_S16S16_S16 511.9922 Fact1 -256.0000 255.9922 FORMAT "%8.4"
 /begin AXIS_DESCR STD_AXIS LLim_rDesReq_mp APPCrCtl1 12 -163.8400 163.8350 FORMAT "%8.4" DEPOSIT ABSOLUTE /end AXIS_DESCR
 /begin AXIS_DESCR STD_AXIS CrCtl_vASLVehCont Vel 12 -327.6800 327.6700 FORMAT "%8.4" DEPOSIT ABSOLUTE /end AXIS_DESCR
/end CHARACTERISTIC
/begin CHARACTERISTIC LLim_facSptAPPDiffCor2LGCls_MAP "MAP for Correction factor based on difference of accel pedal position(for 2 level lower gear and close side) for sport mode" MAP 0x8052A814 RB_Map_S16S16_S16 511.9922 Fact1 -256.0000 255.9922 FORMAT "%8.4"
 /begin AXIS_DESCR STD_AXIS LLim_rDesReq_mp APPCrCtl1 12 -163.8400 163.8350 FORMAT "%8.4" DEPOSIT ABSOLUTE /end AXIS_DESCR
 /begin AXIS_DESCR STD_AXIS CrCtl_vASLVehCont Vel 12 -327.6800 327.6700 FORMAT "%8.4" DEPOSIT ABSOLUTE /end AXIS_DESCR
/end CHARACTERISTIC
/begin CHARACTERISTIC LLim_facSptAPPDiffCor2LG_MAP "MAP for Correction factor based on difference of accel pedal position(for 2 level lower gear and open side) for sport mode" MAP 0x8052A968 RB_Map_S16S16_S16 511.9922 Fact1 -256.0000 255.9922 FORMAT "%8.4"
 /begin AXIS_DESCR STD_AXIS LLim_rDesReq_mp APPCrCtl1 12 -163.8400 163.8350 FORMAT "%8.4" DEPOSIT ABSOLUTE /end AXIS_DESCR
 /begin AXIS_DESCR STD_AXIS CrCtl_vASLVehCont Vel 12 -327.6800 327.6700 FORMAT "%8.4" DEPOSIT ABSOLUTE /end AXIS_DESCR
/end CHARACTERISTIC
/begin CHARACTERISTIC LLim_facSptAPPDiffCor3LGCls_MAP "MAP for Correction factor based on difference of accel pedal position(for 3 level lower gear and close side) for sport mode" MAP 0x8052AABC RB_Map_S16S16_S16 511.9922 Fact1 -256.0000 255.9922 FORMAT "%8.4"
 /begin AXIS_DESCR STD_AXIS LLim_rDesReq_mp APPCrCtl1 12 -163.8400 163.8350 FORMAT "%8.4" DEPOSIT ABSOLUTE /end AXIS_DESCR
 /begin AXIS_DESCR STD_AXIS CrCtl_vASLVehCont Vel 12 -327.6800 327.6700 FORMAT "%8.4" DEPOSIT ABSOLUTE /end AXIS_DESCR
/end CHARACTERISTIC
/begin CHARACTERISTIC LLim_facSptAPPDiffCor3LG_MAP "MAP for Correction factor based on difference of accel pedal position(for 3 level lower gear and open side) for sport mode" MAP 0x8052AC10 RB_Map_S16S16_S16 511.9922 Fact1 -256.0000 255.9922 FORMAT "%8.4"
 /begin AXIS_DESCR STD_AXIS LLim_rDesReq_mp APPCrCtl1 12 -163.8400 163.8350 FORMAT "%8.4" DEPOSIT ABSOLUTE /end AXIS_DESCR
 /begin AXIS_DESCR STD_AXIS CrCtl_vASLVehCont Vel 12 -327.6800 327.6700 FORMAT "%8.4" DEPOSIT ABSOLUTE /end AXIS_DESCR
/end CHARACTERISTIC
/begin CHARACTERISTIC LLim_facSptAPPDiffCor4LGCls_MAP "MAP for Correction factor based on difference of accel pedal position(for 4 level lower gear and close side) for sport mode" MAP 0x8052AD64 RB_Map_S16S16_S16 511.9922 Fact1 -256.0000 255.9922 FORMAT "%8.4"
 /begin AXIS_DESCR STD_AXIS LLim_rDesReq_mp APPCrCtl1 12 -163.8400 163.8350 FORMAT "%8.4" DEPOSIT ABSOLUTE /end AXIS_DESCR
 /begin AXIS_DESCR STD_AXIS CrCtl_vASLVehCont Vel 12 -327.6800 327.6700 FORMAT "%8.4" DEPOSIT ABSOLUTE /end AXIS_DESCR
/end CHARACTERISTIC
/begin CHARACTERISTIC LLim_facSptAPPDiffCor4LG_MAP "MAP for Correction factor based on difference of accel pedal position(for 4 level lower gear and open side) for sport mode" MAP 0x8052AEB8 RB_Map_S16S16_S16 511.9922 Fact1 -256.0000 255.9922 FORMAT "%8.4"
 /begin AXIS_DESCR STD_AXIS LLim_rDesReq_mp APPCrCtl1 12 -163.8400 163.8350 FORMAT "%8.4" DEPOSIT ABSOLUTE /end AXIS_DESCR
 /begin AXIS_DESCR STD_AXIS CrCtl_vASLVehCont Vel 12 -327.6800 327.6700 FORMAT "%8.4" DEPOSIT ABSOLUTE /end AXIS_DESCR
/end CHARACTERISTIC
/begin CHARACTERISTIC LLim_facSptAPPDiffCor5LGCls_MAP "MAP for Correction factor based on difference of accel pedal position(for 5 level lower gear and close side) for sport mode" MAP 0x8052B00C RB_Map_S16S16_S16 511.9922 Fact1 -256.0000 255.9922 FORMAT "%8.4"
 /begin AXIS_DESCR STD_AXIS LLim_rDesReq_mp APPCrCtl1 12 -163.8400 163.8350 FORMAT "%8.4" DEPOSIT ABSOLUTE /end AXIS_DESCR
 /begin AXIS_DESCR STD_AXIS CrCtl_vASLVehCont Vel 12 -327.6800 327.6700 FORMAT "%8.4" DEPOSIT ABSOLUTE /end AXIS_DESCR
/end CHARACTERISTIC
/begin CHARACTERISTIC LLim_facSptAPPDiffCor5LG_MAP "MAP for Correction factor based on difference of accel pedal position(for 5 level lower gear and open side) for sport mode" MAP 0x8052B160 RB_Map_S16S16_S16 511.9922 Fact1 -256.0000 255.9922 FORMAT "%8.4"
 /begin AXIS_DESCR STD_AXIS LLim_rDesReq_mp APPCrCtl1 12 -163.8400 163.8350 FORMAT "%8.4" DEPOSIT ABSOLUTE /end AXIS_DESCR
 /begin AXIS_DESCR STD_AXIS CrCtl_vASLVehCont Vel 12 -327.6800 327.6700 FORMAT "%8.4" DEPOSIT ABSOLUTE /end AXIS_DESCR
/end CHARACTERISTIC
/begin CHARACTERISTIC LLim_facSptAPPdiffCorLmapCls_MAP "MAP for correction factor based on difference of accelerator pedal position(for L positions and close side)" MAP 0x8052B2B4 RB_Map_S16S16_S16 511.9922 Fact1 -256.0000 255.9922 FORMAT "%8.4"
 /begin AXIS_DESCR STD_AXIS LLim_rDesReq_mp APPCrCtl1 12 -163.8400 163.8350 FORMAT "%8.4" DEPOSIT ABSOLUTE /end AXIS_DESCR
 /begin AXIS_DESCR STD_AXIS CrCtl_vASLVehCont Vel 12 -327.6800 327.6700 FORMAT "%8.4" DEPOSIT ABSOLUTE /end AXIS_DESCR
/end CHARACTERISTIC
/begin CHARACTERISTIC LLim_facSptAPPdiffCorLmap_MAP "MAP for correction factor based on difference of accelerator pedal position(for L positions)" MAP 0x8052B408 RB_Map_S16S16_S16 511.9922 Fact1 -256.0000 255.9922 FORMAT "%8.4"
 /begin AXIS_DESCR STD_AXIS LLim_rDesReq_mp APPCrCtl1 12 -163.8400 163.8350 FORMAT "%8.4" DEPOSIT ABSOLUTE /end AXIS_DESCR
 /begin AXIS_DESCR STD_AXIS CrCtl_vASLVehCont Vel 12 -327.6800 327.6700 FORMAT "%8.4" DEPOSIT ABSOLUTE /end AXIS_DESCR
/end CHARACTERISTIC
/begin CHARACTERISTIC LLim_facSptAPPDiffCorTGCls_MAP "MAP for Correction factor based on difference of accel pedal position(for the top gear and close side) for sport mode" MAP 0x8052B55C RB_Map_S16S16_S16 511.9922 Fact1 -256.0000 255.9922 FORMAT "%8.4"
 /begin AXIS_DESCR STD_AXIS LLim_rDesReq_mp APPCrCtl1 12 -163.8400 163.8350 FORMAT "%8.4" DEPOSIT ABSOLUTE /end AXIS_DESCR
 /begin AXIS_DESCR STD_AXIS CrCtl_vASLVehCont Vel 12 -327.6800 327.6700 FORMAT "%8.4" DEPOSIT ABSOLUTE /end AXIS_DESCR
/end CHARACTERISTIC
/begin CHARACTERISTIC LLim_facSptAPPDiffCorTG_MAP "MAP for Correction factor based on difference of accel pedal position(for the top gear and open side) for sport mode" MAP 0x8052B6B0 RB_Map_S16S16_S16 511.9922 Fact1 -256.0000 255.9922 FORMAT "%8.4"
 /begin AXIS_DESCR STD_AXIS LLim_rDesReq_mp APPCrCtl1 12 -163.8400 163.8350 FORMAT "%8.4" DEPOSIT ABSOLUTE /end AXIS_DESCR
 /begin AXIS_DESCR STD_AXIS CrCtl_vASLVehCont Vel 12 -327.6800 327.6700 FORMAT "%8.4" DEPOSIT ABSOLUTE /end AXIS_DESCR
/end CHARACTERISTIC
/begin CHARACTERISTIC LLim_facSptFdbkAcclP1LG_CUR "Curve for acceleration Feed Back P coefficient factor value( for 1 level lower gear) for sport mode" CURVE 0x8052B804 RB_Curve_S16_S16 1023.984 Fact_CrCtl2 -512.0000 511.9844 FORMAT "%8.4"
 /begin AXIS_DESCR STD_AXIS CrCtl_vASLVehCont Vel 12 -327.6800 327.6700 FORMAT "%8.4" DEPOSIT ABSOLUTE /end AXIS_DESCR
/end CHARACTERISTIC
/begin CHARACTERISTIC LLim_facSptFdbkAcclP2LG_CUR "Curve for acceleration Feed Back P coefficient factor value( for 2 level lower gear) for sport mode" CURVE 0x8052B836 RB_Curve_S16_S16 1023.984 Fact_CrCtl2 -512.0000 511.9844 FORMAT "%8.4"
 /begin AXIS_DESCR STD_AXIS CrCtl_vASLVehCont Vel 12 -327.6800 327.6700 FORMAT "%8.4" DEPOSIT ABSOLUTE /end AXIS_DESCR
/end CHARACTERISTIC
/begin CHARACTERISTIC LLim_facSptFdbkAcclP3LG_CUR "Curve for acceleration Feed Back P coefficient factor value( for 3 level lower gear) for sport mode" CURVE 0x8052B868 RB_Curve_S16_S16 1023.984 Fact_CrCtl2 -512.0000 511.9844 FORMAT "%8.4"
 /begin AXIS_DESCR STD_AXIS CrCtl_vASLVehCont Vel 12 -327.6800 327.6700 FORMAT "%8.4" DEPOSIT ABSOLUTE /end AXIS_DESCR
/end CHARACTERISTIC
/begin CHARACTERISTIC LLim_facSptFdbkAcclP4LG_CUR "Curve for acceleration Feed Back P coefficient factor value( for 4 level lower gear) for sport mode" CURVE 0x8052B89A RB_Curve_S16_S16 1023.984 Fact_CrCtl2 -512.0000 511.9844 FORMAT "%8.4"
 /begin AXIS_DESCR STD_AXIS CrCtl_vASLVehCont Vel 12 -327.6800 327.6700 FORMAT "%8.4" DEPOSIT ABSOLUTE /end AXIS_DESCR
/end CHARACTERISTIC
/begin CHARACTERISTIC LLim_facSptFdbkAcclP5LG_CUR "Curve for acceleration Feed Back P coefficient factor value( for 5 level lower gear) for sport mode" CURVE 0x8052B8CC RB_Curve_S16_S16 1023.984 Fact_CrCtl2 -512.0000 511.9844 FORMAT "%8.4"
 /begin AXIS_DESCR STD_AXIS CrCtl_vASLVehCont Vel 12 -327.6800 327.6700 FORMAT "%8.4" DEPOSIT ABSOLUTE /end AXIS_DESCR
/end CHARACTERISTIC
/begin CHARACTERISTIC LLim_facSptFdbkAcclPLmap_CUR "Curve for acceleration feedback P coefficient factor value( for L positions)" CURVE 0x8052B8FE RB_Curve_S16_S16 1023.984 Fact_CrCtl2 -512.0000 511.9844 FORMAT "%8.4"
 /begin AXIS_DESCR STD_AXIS CrCtl_vASLVehCont Vel 12 -327.6800 327.6700 FORMAT "%8.4" DEPOSIT ABSOLUTE /end AXIS_DESCR
/end CHARACTERISTIC
/begin CHARACTERISTIC LLim_facSptFdbkAcclPTG_CUR "Curve for acceleration Feed Back P coefficient factor value( for the top gear) for sport mode" CURVE 0x8052B930 RB_Curve_S16_S16 1023.984 Fact_CrCtl2 -512.0000 511.9844 FORMAT "%8.4"
 /begin AXIS_DESCR STD_AXIS CrCtl_vASLVehCont Vel 12 -327.6800 327.6700 FORMAT "%8.4" DEPOSIT ABSOLUTE /end AXIS_DESCR
/end CHARACTERISTIC
/begin CHARACTERISTIC LLim_facSptFdbkD1LG_MAP "MAP for Feed Back D coefficient factor value (for 1 level lower gear) for sport mode" MAP 0x8052B962 RB_Map_S16S16_S16 1023.984 Fact_CrCtl2 -512.0000 511.9844 FORMAT "%8.4"
 /begin AXIS_DESCR STD_AXIS LLim_vDes_mp Vel 12 -327.6800 327.6700 FORMAT "%8.4" DEPOSIT ABSOLUTE /end AXIS_DESCR
 /begin AXIS_DESCR STD_AXIS LLim_vSpdDvt_mp Vel 9 -327.6800 327.6700 FORMAT "%8.4" DEPOSIT ABSOLUTE /end AXIS_DESCR
/end CHARACTERISTIC
/begin CHARACTERISTIC LLim_facSptFdbkD2LG_MAP "MAP for Feed Back D coefficient factor value (for 2 level lower gear) for sport mode" MAP 0x8052BA68 RB_Map_S16S16_S16 1023.984 Fact_CrCtl2 -512.0000 511.9844 FORMAT "%8.4"
 /begin AXIS_DESCR STD_AXIS LLim_vDes_mp Vel 12 -327.6800 327.6700 FORMAT "%8.4" DEPOSIT ABSOLUTE /end AXIS_DESCR
 /begin AXIS_DESCR STD_AXIS LLim_vSpdDvt_mp Vel 9 -327.6800 327.6700 FORMAT "%8.4" DEPOSIT ABSOLUTE /end AXIS_DESCR
/end CHARACTERISTIC
/begin CHARACTERISTIC LLim_facSptFdbkD3LG_MAP "MAP for Feed Back D coefficient factor value (for 3 level lower gear) for sport mode" MAP 0x8052BB6E RB_Map_S16S16_S16 1023.984 Fact_CrCtl2 -512.0000 511.9844 FORMAT "%8.4"
 /begin AXIS_DESCR STD_AXIS LLim_vDes_mp Vel 12 -327.6800 327.6700 FORMAT "%8.4" DEPOSIT ABSOLUTE /end AXIS_DESCR
 /begin AXIS_DESCR STD_AXIS LLim_vSpdDvt_mp Vel 9 -327.6800 327.6700 FORMAT "%8.4" DEPOSIT ABSOLUTE /end AXIS_DESCR
/end CHARACTERISTIC
/begin CHARACTERISTIC LLim_facSptFdbkD4LG_MAP "MAP for Feed Back D coefficient factor value (for 4 level lower gear) for sport mode" MAP 0x8052BC74 RB_Map_S16S16_S16 1023.984 Fact_CrCtl2 -512.0000 511.9844 FORMAT "%8.4"
 /begin AXIS_DESCR STD_AXIS LLim_vDes_mp Vel 12 -327.6800 327.6700 FORMAT "%8.4" DEPOSIT ABSOLUTE /end AXIS_DESCR
 /begin AXIS_DESCR STD_AXIS LLim_vSpdDvt_mp Vel 9 -327.6800 327.6700 FORMAT "%8.4" DEPOSIT ABSOLUTE /end AXIS_DESCR
/end CHARACTERISTIC
/begin CHARACTERISTIC LLim_facSptFdbkD5LG_MAP "MAP for Feed Back D coefficient factor value (for 5 level lower gear) for sport mode" MAP 0x8052BD7A RB_Map_S16S16_S16 1023.984 Fact_CrCtl2 -512.0000 511.9844 FORMAT "%8.4"
 /begin AXIS_DESCR STD_AXIS LLim_vDes_mp Vel 12 -327.6800 327.6700 FORMAT "%8.4" DEPOSIT ABSOLUTE /end AXIS_DESCR
 /begin AXIS_DESCR STD_AXIS LLim_vSpdDvt_mp Vel 9 -327.6800 327.6700 FORMAT "%8.4" DEPOSIT ABSOLUTE /end AXIS_DESCR
/end CHARACTERISTIC
/begin CHARACTERISTIC LLim_facSptFdbkDTG_MAP "MAP for Feed Back D coefficient factor value (for the top gear) for sport mode" MAP 0x8052BE80 RB_Map_S16S16_S16 1023.984 Fact_CrCtl2 -512.0000 511.9844 FORMAT "%8.4"
 /begin AXIS_DESCR STD_AXIS LLim_vDes_mp Vel 12 -327.6800 327.6700 FORMAT "%8.4" DEPOSIT ABSOLUTE /end AXIS_DESCR
 /begin AXIS_DESCR STD_AXIS LLim_vSpdDvt_mp Vel 9 -327.6800 327.6700 FORMAT "%8.4" DEPOSIT ABSOLUTE /end AXIS_DESCR
/end CHARACTERISTIC
/begin CHARACTERISTIC LLim_facSptFdbkP1LG_MAP "MAP for Feed Back P coefficient factor value (for 1 level lower gear) for sport mode" MAP 0x8052BF86 RB_Map_S16S16_S16 63.99902 Fact_CrCtl3 -32.00000 31.99902 FORMAT "%8.5"
 /begin AXIS_DESCR STD_AXIS LLim_vDes_mp Vel 12 -327.6800 327.6700 FORMAT "%8.4" DEPOSIT ABSOLUTE /end AXIS_DESCR
 /begin AXIS_DESCR STD_AXIS LLim_vSpdDvt_mp Vel 9 -327.6800 327.6700 FORMAT "%8.4" DEPOSIT ABSOLUTE /end AXIS_DESCR
/end CHARACTERISTIC
/begin CHARACTERISTIC LLim_facSptFdbkP2LG_MAP "MAP for Feed Back P coefficient factor value (for 2 level lower gear) for sport mode" MAP 0x8052C08C RB_Map_S16S16_S16 63.99902 Fact_CrCtl3 -32.00000 31.99902 FORMAT "%8.5"
 /begin AXIS_DESCR STD_AXIS LLim_vDes_mp Vel 12 -327.6800 327.6700 FORMAT "%8.4" DEPOSIT ABSOLUTE /end AXIS_DESCR
 /begin AXIS_DESCR STD_AXIS LLim_vSpdDvt_mp Vel 9 -327.6800 327.6700 FORMAT "%8.4" DEPOSIT ABSOLUTE /end AXIS_DESCR
/end CHARACTERISTIC
/begin CHARACTERISTIC LLim_facSptFdbkP3LG_MAP "MAP for Feed Back P coefficient factor value (for 3 level lower gear) for sport mode" MAP 0x8052C192 RB_Map_S16S16_S16 63.99902 Fact_CrCtl3 -32.00000 31.99902 FORMAT "%8.5"
 /begin AXIS_DESCR STD_AXIS LLim_vDes_mp Vel 12 -327.6800 327.6700 FORMAT "%8.4" DEPOSIT ABSOLUTE /end AXIS_DESCR
 /begin AXIS_DESCR STD_AXIS LLim_vSpdDvt_mp Vel 9 -327.6800 327.6700 FORMAT "%8.4" DEPOSIT ABSOLUTE /end AXIS_DESCR
/end CHARACTERISTIC
/begin CHARACTERISTIC LLim_facSptFdbkP4LG_MAP "MAP for Feed Back P coefficient factor value (for 4 level lower gear) for sport mode" MAP 0x8052C298 RB_Map_S16S16_S16 63.99902 Fact_CrCtl3 -32.00000 31.99902 FORMAT "%8.5"
 /begin AXIS_DESCR STD_AXIS LLim_vDes_mp Vel 12 -327.6800 327.6700 FORMAT "%8.4" DEPOSIT ABSOLUTE /end AXIS_DESCR
 /begin AXIS_DESCR STD_AXIS LLim_vSpdDvt_mp Vel 9 -327.6800 327.6700 FORMAT "%8.4" DEPOSIT ABSOLUTE /end AXIS_DESCR
/end CHARACTERISTIC
/begin CHARACTERISTIC LLim_facSptFdbkP5LG_MAP "MAP for Feed Back P coefficient factor value (for 5 level lower gear) for sport mode" MAP 0x8052C39E RB_Map_S16S16_S16 63.99902 Fact_CrCtl3 -32.00000 31.99902 FORMAT "%8.5"
 /begin AXIS_DESCR STD_AXIS LLim_vDes_mp Vel 12 -327.6800 327.6700 FORMAT "%8.4" DEPOSIT ABSOLUTE /end AXIS_DESCR
 /begin AXIS_DESCR STD_AXIS LLim_vSpdDvt_mp Vel 9 -327.6800 327.6700 FORMAT "%8.4" DEPOSIT ABSOLUTE /end AXIS_DESCR
/end CHARACTERISTIC
/begin CHARACTERISTIC LLim_facSptFdbkPTG_MAP "MAP for Feed Back P coefficient factor value (for the top gear) for sport mode" MAP 0x8052C4A4 RB_Map_S16S16_S16 63.99902 Fact_CrCtl3 -32.00000 31.99902 FORMAT "%8.5"
 /begin AXIS_DESCR STD_AXIS LLim_vDes_mp Vel 12 -327.6800 327.6700 FORMAT "%8.4" DEPOSIT ABSOLUTE /end AXIS_DESCR
 /begin AXIS_DESCR STD_AXIS LLim_vSpdDvt_mp Vel 9 -327.6800 327.6700 FORMAT "%8.4" DEPOSIT ABSOLUTE /end AXIS_DESCR
/end CHARACTERISTIC
/begin CHARACTERISTIC LLim_flgASLDispCncl_C "To enabledisable ASL display cancellation based on variant" VALUE 0x8052C5AA Val_Wu8 1.000 OneToOne 0.00 1.000 FORMAT "%5.3" EXTENDED_LIMITS 0.00 255.0 /end CHARACTERISTIC
/begin CHARACTERISTIC LLim_flgMemSpdDisp_C "To enabledisable Memory speed display based on variant" VALUE 0x8052C5AB Val_Wu8 1.000 OneToOne 0.00 1.000 FORMAT "%5.3" EXTENDED_LIMITS 0.00 255.0 /end CHARACTERISTIC
/begin CHARACTERISTIC LLim_flgMtrTypIndcnVehSpdASLCtrl_C "Meter type for indication of vehicle speed by ASL control" VALUE 0x8052C5AC Val_Wu8 1.000 OneToOne 0.00 1.000 FORMAT "%5.3" EXTENDED_LIMITS 0.00 255.0 /end CHARACTERISTIC
/begin CHARACTERISTIC LLim_nASLAppClsLrnStrtAdd_C "NE value to checking APP close learning start for ASL" VALUE 0x8052C5AE Val_Ws16 65535.00 EngNCrCtl -32768.00 32767.00 FORMAT "%8.2" /end CHARACTERISTIC
/begin CHARACTERISTIC LLim_numASLResSel_C "Number to select operation when returning from resume control" VALUE 0x8052C5B0 Val_Wu8 127.0 OneToOne 0.00 127.0 FORMAT "%5.1" EXTENDED_LIMITS 0.00 255.0 /end CHARACTERISTIC
/begin CHARACTERISTIC LLim_numASLSpdInfoMOnNCtl_C "Vehicle speed dispay information for ASL when main sw on and no control" VALUE 0x8052C5B2 Val_Ws16 32767.00 OneToOne 0.00 32767.00 FORMAT "%8.2" EXTENDED_LIMITS -32768.00 32767.00 /end CHARACTERISTIC
/begin CHARACTERISTIC LLim_numISALimSpdOffsetLoMph_C "Offset lower limit of ISA limit speed (mph)" VALUE 0x8052C5B4 Val_Wu8 255.0 OneToOne 0.00 255.0 FORMAT "%5.1" /end CHARACTERISTIC
/begin CHARACTERISTIC LLim_numISALimSpdOffsetLo_C "Offset lower limit of ISA limit speed (kmh)" VALUE 0x8052C5B5 Val_Wu8 255.0 OneToOne 0.00 255.0 FORMAT "%5.1" /end CHARACTERISTIC
/begin CHARACTERISTIC LLim_numISALimSpdOffsetUpMph_C "Offset upper limit of ISA limit speed (mph)" VALUE 0x8052C5B6 Val_Wu8 255.0 OneToOne 0.00 255.0 FORMAT "%5.1" /end CHARACTERISTIC
/begin CHARACTERISTIC LLim_numISALimSpdOffsetUp_C "Offset upper limit of ISA limit speed (kmh)" VALUE 0x8052C5B7 Val_Wu8 255.0 OneToOne 0.00 255.0 FORMAT "%5.1" /end CHARACTERISTIC
/begin CHARACTERISTIC LLim_numISAMetType_C "Unit type for CC\ASL\ISA mode judgement 0: Meter unit 1: FI-ECU" VALUE 0x8052C5B8 Val_Wu8 255.0 OneToOne 0.00 255.0 FORMAT "%5.1" /end CHARACTERISTIC
/begin CHARACTERISTIC LLim_numSpdInfoMOnNCtl_C "Vehicle speed dispay information for CC when main sw on and no control" VALUE 0x8052C5BA Val_Ws16 32767.00 OneToOne 0.00 32767.00 FORMAT "%8.2" EXTENDED_LIMITS -32768.00 32767.00 /end CHARACTERISTIC
/begin CHARACTERISTIC LLim_r10msAddVar_C "APP request every 10ms Add variant value" VALUE 0x8052C5BC Val_Ws16 327.6750 APPCrCtl1 -163.8400 163.8350 FORMAT "%8.4" /end CHARACTERISTIC
/begin CHARACTERISTIC LLim_r10msSubVar_C "APP request every 10ms Sub variant value" VALUE 0x8052C5BE Val_Ws16 327.6750 APPCrCtl1 -163.8400 163.8350 FORMAT "%8.4" /end CHARACTERISTIC
/begin CHARACTERISTIC LLim_rAPPAddVal_C "Driver accel pedal position add value for ASL" VALUE 0x8052C5C0 Val_Ws16 327.6750 APPCrCtl1 -163.8400 163.8350 FORMAT "%8.4" /end CHARACTERISTIC
/begin CHARACTERISTIC LLim_rAPPFulChk_C "Accel pedal full open check value for ASL" VALUE 0x8052C5C2 Val_Ws16 327.6750 APPCrCtl1 -163.8400 163.8350 FORMAT "%8.4" /end CHARACTERISTIC
/begin CHARACTERISTIC LLim_rAPPLimTmpRlsAPP_C "Accel pedal value during enabling temporary release of APP limitation" VALUE 0x8052C5C4 Val_Ws16 163.8350 APPCrCtl1 0.00 163.8350 FORMAT "%8.4" EXTENDED_LIMITS -163.8400 163.8350 /end CHARACTERISTIC
/begin CHARACTERISTIC LLim_rAPPMaxDevl_CUR "Curve for maximum accel pedal position for ASL (for development)" CURVE 0x8052C5C6 RB_Curve_S16_S16 327.6750 APPCrCtl1 -163.8400 163.8350 FORMAT "%8.4"
 /begin AXIS_DESCR STD_AXIS LLim_vMemSpdFin_mp Vel 12 -327.6800 327.6700 FORMAT "%8.4" DEPOSIT ABSOLUTE /end AXIS_DESCR
/end CHARACTERISTIC
/begin CHARACTERISTIC LLim_rAPPMax_CUR "Curve for maximum accel pedal position for ASL" CURVE 0x8052C5F8 RB_Curve_S16_S16 327.6750 APPCrCtl1 -163.8400 163.8350 FORMAT "%8.4"
 /begin AXIS_DESCR STD_AXIS CrCtl_vASLVehCont Vel 12 -327.6800 327.6700 FORMAT "%8.4" DEPOSIT ABSOLUTE /end AXIS_DESCR
/end CHARACTERISTIC
/begin CHARACTERISTIC LLim_rAPPOff1LG_MAP "MAP for Accel pedal off output value(for 1 level lower gear)" MAP 0x8052C62A RB_Map_S16S16_S16 327.6750 APPCrCtl1 -163.8400 163.8350 FORMAT "%8.4"
 /begin AXIS_DESCR STD_AXIS CrCtl_vASLVehCont Vel 12 -327.6800 327.6700 FORMAT "%8.4" DEPOSIT ABSOLUTE /end AXIS_DESCR
 /begin AXIS_DESCR STD_AXIS CrCtl_rEstSlpFltVal Prc_CrCtl4 9 -128.0000 127.9961 FORMAT "%8.4" DEPOSIT ABSOLUTE /end AXIS_DESCR
/end CHARACTERISTIC
/begin CHARACTERISTIC LLim_rAPPOff2LG_MAP "MAP for Accel pedal off output value(for 2 level lower gear)" MAP 0x8052C730 RB_Map_S16S16_S16 327.6750 APPCrCtl1 -163.8400 163.8350 FORMAT "%8.4"
 /begin AXIS_DESCR STD_AXIS CrCtl_vASLVehCont Vel 12 -327.6800 327.6700 FORMAT "%8.4" DEPOSIT ABSOLUTE /end AXIS_DESCR
 /begin AXIS_DESCR STD_AXIS CrCtl_rEstSlpFltVal Prc_CrCtl4 9 -128.0000 127.9961 FORMAT "%8.4" DEPOSIT ABSOLUTE /end AXIS_DESCR
/end CHARACTERISTIC
/begin CHARACTERISTIC LLim_rAPPOff3LG_MAP "MAP for Accel pedal off output value(for 3 level lower gear)" MAP 0x8052C836 RB_Map_S16S16_S16 327.6750 APPCrCtl1 -163.8400 163.8350 FORMAT "%8.4"
 /begin AXIS_DESCR STD_AXIS CrCtl_vASLVehCont Vel 12 -327.6800 327.6700 FORMAT "%8.4" DEPOSIT ABSOLUTE /end AXIS_DESCR
 /begin AXIS_DESCR STD_AXIS CrCtl_rEstSlpFltVal Prc_CrCtl4 9 -128.0000 127.9961 FORMAT "%8.4" DEPOSIT ABSOLUTE /end AXIS_DESCR
/end CHARACTERISTIC
/begin CHARACTERISTIC LLim_rAPPOff4LG_MAP "MAP for Accel pedal off output value(for 4 level lower gear)" MAP 0x8052C93C RB_Map_S16S16_S16 327.6750 APPCrCtl1 -163.8400 163.8350 FORMAT "%8.4"
 /begin AXIS_DESCR STD_AXIS CrCtl_vASLVehCont Vel 12 -327.6800 327.6700 FORMAT "%8.4" DEPOSIT ABSOLUTE /end AXIS_DESCR
 /begin AXIS_DESCR STD_AXIS CrCtl_rEstSlpFltVal Prc_CrCtl4 9 -128.0000 127.9961 FORMAT "%8.4" DEPOSIT ABSOLUTE /end AXIS_DESCR
/end CHARACTERISTIC
/begin CHARACTERISTIC LLim_rAPPOff5LG_MAP "MAP for Accel pedal off output value(for 5 level lower gear)" MAP 0x8052CA42 RB_Map_S16S16_S16 327.6750 APPCrCtl1 -163.8400 163.8350 FORMAT "%8.4"
 /begin AXIS_DESCR STD_AXIS CrCtl_vASLVehCont Vel 12 -327.6800 327.6700 FORMAT "%8.4" DEPOSIT ABSOLUTE /end AXIS_DESCR
 /begin AXIS_DESCR STD_AXIS CrCtl_rEstSlpFltVal Prc_CrCtl4 9 -128.0000 127.9961 FORMAT "%8.4" DEPOSIT ABSOLUTE /end AXIS_DESCR
/end CHARACTERISTIC
/begin CHARACTERISTIC LLim_rAPPOffLmap_MAP "MAP for acceleration pedal off output value(for L positions)" MAP 0x8052CB48 RB_Map_S16S16_S16 327.6750 APPCrCtl1 -163.8400 163.8350 FORMAT "%8.4"
 /begin AXIS_DESCR STD_AXIS CrCtl_vASLVehCont Vel 12 -327.6800 327.6700 FORMAT "%8.4" DEPOSIT ABSOLUTE /end AXIS_DESCR
 /begin AXIS_DESCR STD_AXIS CrCtl_rEstSlpFltVal Prc_CrCtl4 9 -128.0000 127.9961 FORMAT "%8.4" DEPOSIT ABSOLUTE /end AXIS_DESCR
/end CHARACTERISTIC
/begin CHARACTERISTIC LLim_rAPPOffTG_MAP "MAP for Accel pedal off output value(for the top gear)" MAP 0x8052CC4E RB_Map_S16S16_S16 327.6750 APPCrCtl1 -163.8400 163.8350 FORMAT "%8.4"
 /begin AXIS_DESCR STD_AXIS CrCtl_vASLVehCont Vel 12 -327.6800 327.6700 FORMAT "%8.4" DEPOSIT ABSOLUTE /end AXIS_DESCR
 /begin AXIS_DESCR STD_AXIS CrCtl_rEstSlpFltVal Prc_CrCtl4 9 -128.0000 127.9961 FORMAT "%8.4" DEPOSIT ABSOLUTE /end AXIS_DESCR
/end CHARACTERISTIC
/begin CHARACTERISTIC LLim_rAPPReqSet1LG_MAP "MAP for Accel pedal opening when ASL SET(for 1 level lower gear)" MAP 0x8052CD54 RB_Map_S16S16_S16 327.6750 APPCrCtl1 -163.8400 163.8350 FORMAT "%8.4"
 /begin AXIS_DESCR STD_AXIS CrCtl_vASLVehCont Vel 12 -327.6800 327.6700 FORMAT "%8.4" DEPOSIT ABSOLUTE /end AXIS_DESCR
 /begin AXIS_DESCR STD_AXIS CrCtl_rEstSlpFltVal Prc_CrCtl4 9 -128.0000 127.9961 FORMAT "%8.4" DEPOSIT ABSOLUTE /end AXIS_DESCR
/end CHARACTERISTIC
/begin CHARACTERISTIC LLim_rAPPReqSet2LG_MAP "MAP for Accel pedal opening when ASL SET(for 2 level lower gear)" MAP 0x8052CE5A RB_Map_S16S16_S16 327.6750 APPCrCtl1 -163.8400 163.8350 FORMAT "%8.4"
 /begin AXIS_DESCR STD_AXIS CrCtl_vASLVehCont Vel 12 -327.6800 327.6700 FORMAT "%8.4" DEPOSIT ABSOLUTE /end AXIS_DESCR
 /begin AXIS_DESCR STD_AXIS CrCtl_rEstSlpFltVal Prc_CrCtl4 9 -128.0000 127.9961 FORMAT "%8.4" DEPOSIT ABSOLUTE /end AXIS_DESCR
/end CHARACTERISTIC
/begin CHARACTERISTIC LLim_rAPPReqSet3LG_MAP "MAP for Accel pedal opening when ASL SET(for 3 level lower gear)" MAP 0x8052CF60 RB_Map_S16S16_S16 327.6750 APPCrCtl1 -163.8400 163.8350 FORMAT "%8.4"
 /begin AXIS_DESCR STD_AXIS CrCtl_vASLVehCont Vel 12 -327.6800 327.6700 FORMAT "%8.4" DEPOSIT ABSOLUTE /end AXIS_DESCR
 /begin AXIS_DESCR STD_AXIS CrCtl_rEstSlpFltVal Prc_CrCtl4 9 -128.0000 127.9961 FORMAT "%8.4" DEPOSIT ABSOLUTE /end AXIS_DESCR
/end CHARACTERISTIC
/begin CHARACTERISTIC LLim_rAPPReqSet4LG_MAP "MAP for Accel pedal opening when ASL SET(for 4 level lower gear)" MAP 0x8052D066 RB_Map_S16S16_S16 327.6750 APPCrCtl1 -163.8400 163.8350 FORMAT "%8.4"
 /begin AXIS_DESCR STD_AXIS CrCtl_vASLVehCont Vel 12 -327.6800 327.6700 FORMAT "%8.4" DEPOSIT ABSOLUTE /end AXIS_DESCR
 /begin AXIS_DESCR STD_AXIS CrCtl_rEstSlpFltVal Prc_CrCtl4 9 -128.0000 127.9961 FORMAT "%8.4" DEPOSIT ABSOLUTE /end AXIS_DESCR
/end CHARACTERISTIC
/begin CHARACTERISTIC LLim_rAPPReqSet5LG_MAP "MAP for Accel pedal opening when ASL SET(for 5 level lower gear)" MAP 0x8052D16C RB_Map_S16S16_S16 327.6750 APPCrCtl1 -163.8400 163.8350 FORMAT "%8.4"
 /begin AXIS_DESCR STD_AXIS CrCtl_vASLVehCont Vel 12 -327.6800 327.6700 FORMAT "%8.4" DEPOSIT ABSOLUTE /end AXIS_DESCR
 /begin AXIS_DESCR STD_AXIS CrCtl_rEstSlpFltVal Prc_CrCtl4 9 -128.0000 127.9961 FORMAT "%8.4" DEPOSIT ABSOLUTE /end AXIS_DESCR
/end CHARACTERISTIC
/begin CHARACTERISTIC LLim_rAPPReqSetLmap_MAP "MAP for acceleration pedal opening when ASL SET(for L positions)" MAP 0x8052D272 RB_Map_S16S16_S16 327.6750 APPCrCtl1 -163.8400 163.8350 FORMAT "%8.4"
 /begin AXIS_DESCR STD_AXIS CrCtl_vASLVehCont Vel 12 -327.6800 327.6700 FORMAT "%8.4" DEPOSIT ABSOLUTE /end AXIS_DESCR
 /begin AXIS_DESCR STD_AXIS CrCtl_rEstSlpFltVal Prc_CrCtl4 9 -128.0000 127.9961 FORMAT "%8.4" DEPOSIT ABSOLUTE /end AXIS_DESCR
/end CHARACTERISTIC
/begin CHARACTERISTIC LLim_rAPPReqSetTG_MAP "MAP for Accel pedal opening when ASL SET(for the top gear)" MAP 0x8052D378 RB_Map_S16S16_S16 327.6750 APPCrCtl1 -163.8400 163.8350 FORMAT "%8.4"
 /begin AXIS_DESCR STD_AXIS CrCtl_vASLVehCont Vel 12 -327.6800 327.6700 FORMAT "%8.4" DEPOSIT ABSOLUTE /end AXIS_DESCR
 /begin AXIS_DESCR STD_AXIS CrCtl_rEstSlpFltVal Prc_CrCtl4 9 -128.0000 127.9961 FORMAT "%8.4" DEPOSIT ABSOLUTE /end AXIS_DESCR
/end CHARACTERISTIC
/begin CHARACTERISTIC LLim_rAPPRetValAftLimRls_CUR "Accel pedal return value after finishing temporary release of APP limitation" CURVE 0x8052D47E RB_Curve_S16_S16 163.8350 APPCrCtl1 0.00 163.8350 FORMAT "%8.4" EXTENDED_LIMITS -163.8400 163.8350
 /begin AXIS_DESCR STD_AXIS LLim_rAPPLimTmpRlsAPPOld_mp APPCrCtl1 12 -163.8400 163.8350 FORMAT "%8.4" DEPOSIT ABSOLUTE /end AXIS_DESCR
/end CHARACTERISTIC
/begin CHARACTERISTIC LLim_rChngGearChkAPP_C "Accel pedal value to check the gear change operation" VALUE 0x8052D4B0 Val_Ws16 163.8350 APPCrCtl1 0.00 163.8350 FORMAT "%8.4" EXTENDED_LIMITS -163.8400 163.8350 /end CHARACTERISTIC
/begin CHARACTERISTIC LLim_rCnclAPPAdd_CUR "Curve for accel pedal position add value for ASL cancel" CURVE 0x8052D4B2 RB_Curve_S16_S16 327.6750 APPCrCtl1 -163.8400 163.8350 FORMAT "%8.4"
 /begin AXIS_DESCR STD_AXIS LLim_rAPPReqFin_mp APPCrCtl1 12 -163.8400 163.8350 FORMAT "%8.4" DEPOSIT ABSOLUTE /end AXIS_DESCR
/end CHARACTERISTIC
/begin CHARACTERISTIC LLim_rCnclIniAPPAdd_CUR "Curve for initial accel pedal position add value for ASL cancel" CURVE 0x8052D4E4 RB_Curve_S16_S16 327.6750 APPCrCtl1 -163.8400 163.8350 FORMAT "%8.4"
 /begin AXIS_DESCR STD_AXIS LLim_rAPPReqFin_mp APPCrCtl1 12 -163.8400 163.8350 FORMAT "%8.4" DEPOSIT ABSOLUTE /end AXIS_DESCR
/end CHARACTERISTIC
/begin CHARACTERISTIC LLim_rDesAddValFAStrt_CUR "Curve for addition value of desired accel pedal opening in ASL (For free area start)" CURVE 0x8052D516 RB_Curve_S16_S16 327.6750 APPCrCtl1 -163.8400 163.8350 FORMAT "%8.4"
 /begin AXIS_DESCR STD_AXIS CrCtl_vASLVehCont Vel 12 -327.6800 327.6700 FORMAT "%8.4" DEPOSIT ABSOLUTE /end AXIS_DESCR
/end CHARACTERISTIC
/begin CHARACTERISTIC LLim_rDesAddValFreeArea_CUR "Curve for addition value of desired accel pedal opening in ASL (For free area)" CURVE 0x8052D548 RB_Curve_S16_S16 327.6750 APPCrCtl1 -163.8400 163.8350 FORMAT "%8.4"
 /begin AXIS_DESCR STD_AXIS CrCtl_vASLVehCont Vel 12 -327.6800 327.6700 FORMAT "%8.4" DEPOSIT ABSOLUTE /end AXIS_DESCR
/end CHARACTERISTIC
/begin CHARACTERISTIC LLim_rDesAPPDiffLim_C "Limited value for difference of desired accel pedal position" VALUE 0x8052D57A Val_Ws16 327.6750 APPCrCtl1 -163.8400 163.8350 FORMAT "%8.4" /end CHARACTERISTIC
/begin CHARACTERISTIC LLim_rDesSubVal_CUR "Curve for subtraction value of desired accel pedal opening in ASL" CURVE 0x8052D57C RB_Curve_S16_S16 327.6750 APPCrCtl1 -163.8400 163.8350 FORMAT "%8.4"
 /begin AXIS_DESCR STD_AXIS CrCtl_vASLVehCont Vel 12 -327.6800 327.6700 FORMAT "%8.4" DEPOSIT ABSOLUTE /end AXIS_DESCR
/end CHARACTERISTIC
/begin CHARACTERISTIC LLim_rISACnclAPPAdd_CUR "Curve for accel pedal position add value for ISA cancel" CURVE 0x8052D5AE RB_Curve_S16_S16 327.6750 APPCrCtl1 -163.8400 163.8350 FORMAT "%8.4"
 /begin AXIS_DESCR STD_AXIS LLim_rAPPReqFin_mp APPCrCtl1 12 -163.8400 163.8350 FORMAT "%8.4" DEPOSIT ABSOLUTE /end AXIS_DESCR
/end CHARACTERISTIC
/begin CHARACTERISTIC LLim_rISACnclIniAPPAdd_CUR "Curve for initial accel pedal position add value for ISA cancel" CURVE 0x8052D5E0 RB_Curve_S16_S16 327.6750 APPCrCtl1 -163.8400 163.8350 FORMAT "%8.4"
 /begin AXIS_DESCR STD_AXIS LLim_rAPPReqFin_mp APPCrCtl1 12 -163.8400 163.8350 FORMAT "%8.4" DEPOSIT ABSOLUTE /end AXIS_DESCR
/end CHARACTERISTIC
/begin CHARACTERISTIC LLim_rSptAPPMaxDevl_CUR "Curve for maximum accel pedal position for ASL (for development) for sport mode" CURVE 0x8052D612 RB_Curve_S16_S16 327.6750 APPCrCtl1 -163.8400 163.8350 FORMAT "%8.4"
 /begin AXIS_DESCR STD_AXIS LLim_vMemSpdFin_mp Vel 12 -327.6800 327.6700 FORMAT "%8.4" DEPOSIT ABSOLUTE /end AXIS_DESCR
/end CHARACTERISTIC
/begin CHARACTERISTIC LLim_rSptAPPOff1LG_MAP "MAP for Accel pedal off output value(for 1 level lower gear) for sport mode" MAP 0x8052D644 RB_Map_S16S16_S16 327.6750 APPCrCtl1 -163.8400 163.8350 FORMAT "%8.4"
 /begin AXIS_DESCR STD_AXIS CrCtl_vASLVehCont Vel 12 -327.6800 327.6700 FORMAT "%8.4" DEPOSIT ABSOLUTE /end AXIS_DESCR
 /begin AXIS_DESCR STD_AXIS CrCtl_rEstSlpFltVal Prc_CrCtl4 9 -128.0000 127.9961 FORMAT "%8.4" DEPOSIT ABSOLUTE /end AXIS_DESCR
/end CHARACTERISTIC
/begin CHARACTERISTIC LLim_rSptAPPOff2LG_MAP "MAP for Accel pedal off output value(for 2 level lower gear) for sport mode" MAP 0x8052D74A RB_Map_S16S16_S16 327.6750 APPCrCtl1 -163.8400 163.8350 FORMAT "%8.4"
 /begin AXIS_DESCR STD_AXIS CrCtl_vASLVehCont Vel 12 -327.6800 327.6700 FORMAT "%8.4" DEPOSIT ABSOLUTE /end AXIS_DESCR
 /begin AXIS_DESCR STD_AXIS CrCtl_rEstSlpFltVal Prc_CrCtl4 9 -128.0000 127.9961 FORMAT "%8.4" DEPOSIT ABSOLUTE /end AXIS_DESCR
/end CHARACTERISTIC
/begin CHARACTERISTIC LLim_rSptAPPOff3LG_MAP "MAP for Accel pedal off output value(for 3 level lower gear) for sport mode" MAP 0x8052D850 RB_Map_S16S16_S16 327.6750 APPCrCtl1 -163.8400 163.8350 FORMAT "%8.4"
 /begin AXIS_DESCR STD_AXIS CrCtl_vASLVehCont Vel 12 -327.6800 327.6700 FORMAT "%8.4" DEPOSIT ABSOLUTE /end AXIS_DESCR
 /begin AXIS_DESCR STD_AXIS CrCtl_rEstSlpFltVal Prc_CrCtl4 9 -128.0000 127.9961 FORMAT "%8.4" DEPOSIT ABSOLUTE /end AXIS_DESCR
/end CHARACTERISTIC
/begin CHARACTERISTIC LLim_rSptAPPOff4LG_MAP "MAP for Accel pedal off output value(for 4 level lower gear) for sport mode" MAP 0x8052D956 RB_Map_S16S16_S16 327.6750 APPCrCtl1 -163.8400 163.8350 FORMAT "%8.4"
 /begin AXIS_DESCR STD_AXIS CrCtl_vASLVehCont Vel 12 -327.6800 327.6700 FORMAT "%8.4" DEPOSIT ABSOLUTE /end AXIS_DESCR
 /begin AXIS_DESCR STD_AXIS CrCtl_rEstSlpFltVal Prc_CrCtl4 9 -128.0000 127.9961 FORMAT "%8.4" DEPOSIT ABSOLUTE /end AXIS_DESCR
/end CHARACTERISTIC
/begin CHARACTERISTIC LLim_rSptAPPOff5LG_MAP "MAP for Accel pedal off output value(for 5 level lower gear) for sport mode" MAP 0x8052DA5C RB_Map_S16S16_S16 327.6750 APPCrCtl1 -163.8400 163.8350 FORMAT "%8.4"
 /begin AXIS_DESCR STD_AXIS CrCtl_vASLVehCont Vel 12 -327.6800 327.6700 FORMAT "%8.4" DEPOSIT ABSOLUTE /end AXIS_DESCR
 /begin AXIS_DESCR STD_AXIS CrCtl_rEstSlpFltVal Prc_CrCtl4 9 -128.0000 127.9961 FORMAT "%8.4" DEPOSIT ABSOLUTE /end AXIS_DESCR
/end CHARACTERISTIC
/begin CHARACTERISTIC LLim_rSptAPPOffTG_MAP "MAP for Accel pedal off output value(for the top gear) for sport mode" MAP 0x8052DB62 RB_Map_S16S16_S16 327.6750 APPCrCtl1 -163.8400 163.8350 FORMAT "%8.4"
 /begin AXIS_DESCR STD_AXIS CrCtl_vASLVehCont Vel 12 -327.6800 327.6700 FORMAT "%8.4" DEPOSIT ABSOLUTE /end AXIS_DESCR
 /begin AXIS_DESCR STD_AXIS CrCtl_rEstSlpFltVal Prc_CrCtl4 9 -128.0000 127.9961 FORMAT "%8.4" DEPOSIT ABSOLUTE /end AXIS_DESCR
/end CHARACTERISTIC
/begin CHARACTERISTIC LLim_rSptAPPReqSet1LG_MAP "MAP for Accel pedal opening when ASL SET(for 1 level lower gear) for sport mode" MAP 0x8052DC68 RB_Map_S16S16_S16 327.6750 APPCrCtl1 -163.8400 163.8350 FORMAT "%8.4"
 /begin AXIS_DESCR STD_AXIS CrCtl_vASLVehCont Vel 12 -327.6800 327.6700 FORMAT "%8.4" DEPOSIT ABSOLUTE /end AXIS_DESCR
 /begin AXIS_DESCR STD_AXIS CrCtl_rEstSlpFltVal Prc_CrCtl4 9 -128.0000 127.9961 FORMAT "%8.4" DEPOSIT ABSOLUTE /end AXIS_DESCR
/end CHARACTERISTIC
/begin CHARACTERISTIC LLim_rSptAPPReqSet2LG_MAP "MAP for Accel pedal opening when ASL SET(for 2 level lower gear) for sport mode" MAP 0x8052DD6E RB_Map_S16S16_S16 327.6750 APPCrCtl1 -163.8400 163.8350 FORMAT "%8.4"
 /begin AXIS_DESCR STD_AXIS CrCtl_vASLVehCont Vel 12 -327.6800 327.6700 FORMAT "%8.4" DEPOSIT ABSOLUTE /end AXIS_DESCR
 /begin AXIS_DESCR STD_AXIS CrCtl_rEstSlpFltVal Prc_CrCtl4 9 -128.0000 127.9961 FORMAT "%8.4" DEPOSIT ABSOLUTE /end AXIS_DESCR
/end CHARACTERISTIC
/begin CHARACTERISTIC LLim_rSptAPPReqSet3LG_MAP "MAP for Accel pedal opening when ASL SET(for 3 level lower gear) for sport mode" MAP 0x8052DE74 RB_Map_S16S16_S16 327.6750 APPCrCtl1 -163.8400 163.8350 FORMAT "%8.4"
 /begin AXIS_DESCR STD_AXIS CrCtl_vASLVehCont Vel 12 -327.6800 327.6700 FORMAT "%8.4" DEPOSIT ABSOLUTE /end AXIS_DESCR
 /begin AXIS_DESCR STD_AXIS CrCtl_rEstSlpFltVal Prc_CrCtl4 9 -128.0000 127.9961 FORMAT "%8.4" DEPOSIT ABSOLUTE /end AXIS_DESCR
/end CHARACTERISTIC
/begin CHARACTERISTIC LLim_rSptAPPReqSet4LG_MAP "MAP for Accel pedal opening when ASL SET(for 4 level lower gear) for sport mode" MAP 0x8052DF7A RB_Map_S16S16_S16 327.6750 APPCrCtl1 -163.8400 163.8350 FORMAT "%8.4"
 /begin AXIS_DESCR STD_AXIS CrCtl_vASLVehCont Vel 12 -327.6800 327.6700 FORMAT "%8.4" DEPOSIT ABSOLUTE /end AXIS_DESCR
 /begin AXIS_DESCR STD_AXIS CrCtl_rEstSlpFltVal Prc_CrCtl4 9 -128.0000 127.9961 FORMAT "%8.4" DEPOSIT ABSOLUTE /end AXIS_DESCR
/end CHARACTERISTIC
/begin CHARACTERISTIC LLim_rSptAPPReqSet5LG_MAP "MAP for Accel pedal opening when ASL SET(for 5 level lower gear) for sport mode" MAP 0x8052E080 RB_Map_S16S16_S16 327.6750 APPCrCtl1 -163.8400 163.8350 FORMAT "%8.4"
 /begin AXIS_DESCR STD_AXIS CrCtl_vASLVehCont Vel 12 -327.6800 327.6700 FORMAT "%8.4" DEPOSIT ABSOLUTE /end AXIS_DESCR
 /begin AXIS_DESCR STD_AXIS CrCtl_rEstSlpFltVal Prc_CrCtl4 9 -128.0000 127.9961 FORMAT "%8.4" DEPOSIT ABSOLUTE /end AXIS_DESCR
/end CHARACTERISTIC
/begin CHARACTERISTIC LLim_rSptAPPReqSetTG_MAP "MAP for Accel pedal opening when ASL SET(for the top gear) for sport mode" MAP 0x8052E186 RB_Map_S16S16_S16 327.6750 APPCrCtl1 -163.8400 163.8350 FORMAT "%8.4"
 /begin AXIS_DESCR STD_AXIS CrCtl_vASLVehCont Vel 12 -327.6800 327.6700 FORMAT "%8.4" DEPOSIT ABSOLUTE /end AXIS_DESCR
 /begin AXIS_DESCR STD_AXIS CrCtl_rEstSlpFltVal Prc_CrCtl4 9 -128.0000 127.9961 FORMAT "%8.4" DEPOSIT ABSOLUTE /end AXIS_DESCR
/end CHARACTERISTIC
/begin CHARACTERISTIC LLim_stAPPLrnSel_C "Switch to select APP learning method 0: TCU takes care 1: ECU takes care" VALUE 0x8052E28C Val_Wu8 1.000 OneToOne 0.00 1.000 FORMAT "%5.3" EXTENDED_LIMITS 0.00 255.0 /end CHARACTERISTIC
/begin CHARACTERISTIC LLim_stASLResCdnChk_C "Status for selecting resume control shift condition" VALUE 0x8052E28D Val_Wu8 1.000 OneToOne 0.00 1.000 FORMAT "%5.3" EXTENDED_LIMITS 0.00 255.0 /end CHARACTERISTIC
/begin CHARACTERISTIC LLim_stCCASLDataChkEna_C "Status for implementing mutual data check of CC and ASL" VALUE 0x8052E28E Val_Wu8 1.000 OneToOne 0.00 1.000 FORMAT "%5.3" EXTENDED_LIMITS 0.00 255.0 /end CHARACTERISTIC
/begin CHARACTERISTIC LLim_stGearMapNo_CA "Array for Gear Map Number for longitudinal Limiter" VAL_BLK 0x8052E28F ValA_Wu8 255.0 OneToOne 0.00 255.0 FORMAT "%5.1" NUMBER 5 /end CHARACTERISTIC
/begin CHARACTERISTIC LLim_stIDASTrqLowSelA_C "Calibration to determine the IDAS LLIM status based on information received from IDAS ECU" VALUE 0x8052E294 Val_Wu8 255.0 OneToOne 0.00 255.0 FORMAT "%5.1" /end CHARACTERISTIC
/begin CHARACTERISTIC LLim_stIDASTrqLowSelB_C "Calibration to determine the IDAS LLIM status based on information received from IDAS ECU" VALUE 0x8052E295 Val_Wu8 255.0 OneToOne 0.00 255.0 FORMAT "%5.1" /end CHARACTERISTIC
/begin CHARACTERISTIC LLim_stISAContTSRClr_C "ISA control continuation implementation selection when TSR is cleared 0: Not continue ISA control 1: Continue ISA control" VALUE 0x8052E296 Val_Wu8 1.000 OneToOne 0.00 1.000 FORMAT "%5.3" EXTENDED_LIMITS 0.00 255.0 /end CHARACTERISTIC
/begin CHARACTERISTIC LLim_stISATempStpAcclRecvr_C "Enable switch for recovering accel ratio at ISA temporary stop" VALUE 0x8052E297 Val_Wu8 255.0 OneToOne 0.00 255.0 FORMAT "%5.1" /end CHARACTERISTIC
/begin CHARACTERISTIC LLim_swtAcclLimDisbl_C "Software switch to desable of Acceleration limit" VALUE 0x8052E298 Val_Wu8 255.0 OneToOne 0.00 255.0 FORMAT "%5.1" /end CHARACTERISTIC
/begin CHARACTERISTIC LLim_swtAPPLimTmpRls_C "Switch to enable temporary release of APP limitation" VALUE 0x8052E299 Val_Wu8 1.000 OneToOne 0.00 1.000 FORMAT "%5.3" EXTENDED_LIMITS 0.00 255.0 /end CHARACTERISTIC
/begin CHARACTERISTIC LLim_swtAPPMinSel_C "Software switch to Minimum selected of accel pedal position" VALUE 0x8052E29A Val_Wu8 255.0 OneToOne 0.00 255.0 FORMAT "%5.1" /end CHARACTERISTIC
/begin CHARACTERISTIC LLim_swtASLAppClsLrnSel_C "Switch to select APP Close Learning for ASL" VALUE 0x8052E29B Val_Wu8 1.000 OneToOne 0.00 1.000 FORMAT "%5.3" EXTENDED_LIMITS 0.00 255.0 /end CHARACTERISTIC
/begin CHARACTERISTIC LLim_swtASLAppOpenLrnSel_C "Switch to select APP Open Learning for ASL" VALUE 0x8052E29C Val_Wu8 1.000 OneToOne 0.00 1.000 FORMAT "%5.3" EXTENDED_LIMITS 0.00 255.0 /end CHARACTERISTIC
/begin CHARACTERISTIC LLim_swtASLAppSel_C "Software switch of selecting acceleration pedal position for ASL" VALUE 0x8052E29D Val_Wu8 1.000 OneToOne 0.00 1.000 FORMAT "%5.3" EXTENDED_LIMITS 0.00 255.0 /end CHARACTERISTIC
/begin CHARACTERISTIC LLim_swtASLRxErrChkSel_C "Software switch for ASL Rx frame error detect selection" VALUE 0x8052E29E Val_Wu8 1.000 OneToOne 0.00 1.000 FORMAT "%5.3" EXTENDED_LIMITS 0.00 255.0 /end CHARACTERISTIC
/begin CHARACTERISTIC LLim_swtCCSpdNoUpdReq_C "This selects whether alarm is triggered or not." VALUE 0x8052E29F Val_Wu8 255.0 OneToOne 0.00 255.0 FORMAT "%5.1" /end CHARACTERISTIC
/begin CHARACTERISTIC LLim_swtCnclAcclLimEna_C "Software switch to enable of acceleration limit in case of ASL cancel" VALUE 0x8052E2A0 Val_Wu8 255.0 OneToOne 0.00 255.0 FORMAT "%5.1" /end CHARACTERISTIC
/begin CHARACTERISTIC LLim_swtDevlLimSel_C "Switch to select APP limitation for development" VALUE 0x8052E2A1 Val_Wu8 1.000 OneToOne 0.00 1.000 FORMAT "%5.3" EXTENDED_LIMITS 0.00 255.0 /end CHARACTERISTIC
/begin CHARACTERISTIC LLim_swtKickDwnClickCncl_C "Software switch to cancel of Kick down click" VALUE 0x8052E2A2 Val_Wu8 1.000 OneToOne 0.00 1.000 FORMAT "%5.3" EXTENDED_LIMITS 0.00 255.0 /end CHARACTERISTIC
/begin CHARACTERISTIC LLim_swtResu1Disbl_C "Software switch for return to disable in case of resume" VALUE 0x8052E2A3 Val_Wu8 1.000 OneToOne 0.00 1.000 FORMAT "%5.3" EXTENDED_LIMITS 0.00 255.0 /end CHARACTERISTIC
/begin CHARACTERISTIC LLim_swtSetSpdCorEna_C "Enable switch to correct set speed for ASL" VALUE 0x8052E2A4 Val_Wu8 1.000 OneToOne 0.00 1.000 FORMAT "%5.3" EXTENDED_LIMITS 0.00 255.0 /end CHARACTERISTIC
/begin CHARACTERISTIC LLim_swtSpdNoUpdReq_C "Switch that change requirement for no update set vehicle speed value show in meter display." VALUE 0x8052E2A5 Val_Wu8 1.000 OneToOne 0.00 1.000 FORMAT "%5.3" EXTENDED_LIMITS 0.00 255.0 /end CHARACTERISTIC
/begin CHARACTERISTIC LLim_tiAPPLimTmpRls_C "Timer to enable temporary release of APP limitation" VALUE 0x8052E2A6 Val_Ws16 3276700. Time_ms_100ms 0.00 3276700. FORMAT "%8.0" EXTENDED_LIMITS -3276800. 3276700. /end CHARACTERISTIC
/begin CHARACTERISTIC LLim_tiArChgAppSel_C "Time to change APP difference with area change" VALUE 0x8052E2A8 Val_Ws16 6553500. Time_ms_100ms -3276800. 3276700. FORMAT "%8.0" /end CHARACTERISTIC
/begin CHARACTERISTIC LLim_tiASLAppClsLrnStrtWait_C "Timer of waiting APP close learning start" VALUE 0x8052E2AA Val_Ws16 327670.0 Time_ms 0.00 327670.0 FORMAT "%8.1" EXTENDED_LIMITS -327680.0 327670.0 /end CHARACTERISTIC
/begin CHARACTERISTIC LLim_tiASLAppClsLrnUpd0_C "Wait timer for first update of APP close learning value" VALUE 0x8052E2AC Val_Ws16 3276700. Time_ms_100ms 0.00 3276700. FORMAT "%8.0" EXTENDED_LIMITS -3276800. 3276700. /end CHARACTERISTIC
/begin CHARACTERISTIC LLim_tiASLAppClsLrnUpd1_C "Wait timer for update of APP close learning value except first update" VALUE 0x8052E2AE Val_Ws16 3276700. Time_ms_100ms 0.00 3276700. FORMAT "%8.0" EXTENDED_LIMITS -3276800. 3276700. /end CHARACTERISTIC
/begin CHARACTERISTIC LLim_tiASLAppOpenAlrm_C "Timer of checking APP full open alarm continuation for ASL" VALUE 0x8052E2B0 Val_Ws16 3276700. Time_ms_100ms 0.00 3276700. FORMAT "%8.0" EXTENDED_LIMITS -3276800. 3276700. /end CHARACTERISTIC
/begin CHARACTERISTIC LLim_tiASLAppOpenLrnStrt_C "Timer of checking APP open learning start" VALUE 0x8052E2B2 Val_Ws16 327670.0 Time_ms 0.00 327670.0 FORMAT "%8.1" EXTENDED_LIMITS -327680.0 327670.0 /end CHARACTERISTIC
/begin CHARACTERISTIC LLim_tiASLRxErrChk_C "Time of ASL Rx Frame error check value" VALUE 0x8052E2B4 Val_Ws16 327670.0 Time_ms 0.00 327670.0 FORMAT "%8.1" EXTENDED_LIMITS -327680.0 327670.0 /end CHARACTERISTIC
/begin CHARACTERISTIC LLim_tiASLSet_C "Wait time until ASL state shift from PRESET to SET" VALUE 0x8052E2B6 Val_Ws16 327670.0 Time_ms 0.00 327670.0 FORMAT "%8.1" EXTENDED_LIMITS -327680.0 327670.0 /end CHARACTERISTIC
/begin CHARACTERISTIC LLim_tiCCASLDataErr_C "Time to detect mutual data check error of CC and ASL" VALUE 0x8052E2B8 Val_Ws16 327670.0 Time_ms 0.00 327670.0 FORMAT "%8.1" EXTENDED_LIMITS -327680.0 327670.0 /end CHARACTERISTIC
/begin CHARACTERISTIC LLim_tiCtlExtn_C "Time of ASL control extension" VALUE 0x8052E2BA Val_Ws16 655350.0 Time_ms -327680.0 327670.0 FORMAT "%8.1" /end CHARACTERISTIC
/begin CHARACTERISTIC LLim_tiISACtlExtn_C "Time of ISA control extension" VALUE 0x8052E2BC Val_Ws16 655350.0 Time_ms -327680.0 327670.0 FORMAT "%8.1" /end CHARACTERISTIC
/begin CHARACTERISTIC LLim_tiOvrSpdAlrmFin_C "Time of ASL over vehicle speed alarm finish check" VALUE 0x8052E2BE Val_Ws16 6553500. Time_ms_100ms -3276800. 3276700. FORMAT "%8.0" /end CHARACTERISTIC
/begin CHARACTERISTIC LLim_tiOvrSpdAlrmStrt2_C "Timer2 of ASL over vehicle speed alarm start check" VALUE 0x8052E2C0 Val_Ws16 6553500. Time_ms_100ms -3276800. 3276700. FORMAT "%8.0" /end CHARACTERISTIC
/begin CHARACTERISTIC LLim_tiOvrSpdAlrmStrt_C "Time of ASL over vehicle speed alarm start check" VALUE 0x8052E2C2 Val_Ws16 6553500. Time_ms_100ms -3276800. 3276700. FORMAT "%8.0" /end CHARACTERISTIC
/begin CHARACTERISTIC LLim_tiSetSpdBlnOff2_C "Time2 of Set vehicle speed Blink Off" VALUE 0x8052E2C4 Val_Ws16 6553500. Time_ms_100ms -3276800. 3276700. FORMAT "%8.0" /end CHARACTERISTIC
/begin CHARACTERISTIC LLim_tiSetSpdBlnOff3_C "Time3 of Set vehicle speed Blink Off" VALUE 0x8052E2C6 Val_Ws16 6553500. Time_ms_100ms -3276800. 3276700. FORMAT "%8.0" /end CHARACTERISTIC
/begin CHARACTERISTIC LLim_tiSetSpdBlnOff4_C "Time4 of Set vehicle speed Blink Off" VALUE 0x8052E2C8 Val_Ws16 6553500. Time_ms_100ms -3276800. 3276700. FORMAT "%8.0" /end CHARACTERISTIC
/begin CHARACTERISTIC LLim_tiSetSpdBlnOn2_C "Time2 of Set vehicle speed Blink On" VALUE 0x8052E2CA Val_Ws16 6553500. Time_ms_100ms -3276800. 3276700. FORMAT "%8.0" /end CHARACTERISTIC
/begin CHARACTERISTIC LLim_tiSetSpdBlnOn3_C "Time3 of Set vehicle speed Blink On" VALUE 0x8052E2CC Val_Ws16 6553500. Time_ms_100ms -3276800. 3276700. FORMAT "%8.0" /end CHARACTERISTIC
/begin CHARACTERISTIC LLim_tiSetSpdBlnOn4_C "Time4 of Set vehicle speed Blink On" VALUE 0x8052E2CE Val_Ws16 6553500. Time_ms_100ms -3276800. 3276700. FORMAT "%8.0" /end CHARACTERISTIC
/begin CHARACTERISTIC LLim_uASLAppClsLrnChkDvt_C "Differential voltage to check APP close learning start for ASL" VALUE 0x8052E2D0 Val_Ws16 13107.00 Volt -6553.600 6553.400 FORMAT "%8.3" /end CHARACTERISTIC
/begin CHARACTERISTIC LLim_uASLAppClsLrnLoLim_C "Lower limit voltage of APP close learning for ASL" VALUE 0x8052E2D2 Val_Ws16 13107.00 Volt -6553.600 6553.400 FORMAT "%8.3" /end CHARACTERISTIC
/begin CHARACTERISTIC LLim_uASLAppClsLrnUpLim_C "Upper limit voltage of APP close learning for ASL" VALUE 0x8052E2D4 Val_Ws16 13107.00 Volt -6553.600 6553.400 FORMAT "%8.3" /end CHARACTERISTIC
/begin CHARACTERISTIC LLim_uASLAppClsNoLrn_C "Acceleration pedal sensor voltage value of close learning result for ASL" VALUE 0x8052E2D6 Val_Ws16 13107.00 Volt -6553.600 6553.400 FORMAT "%8.3" /end CHARACTERISTIC
/begin CHARACTERISTIC LLim_uASLAppOpenChk_C "Voltage to check APP full open for ASL" VALUE 0x8052E2D8 Val_Ws16 13107.00 Volt -6553.600 6553.400 FORMAT "%8.3" /end CHARACTERISTIC
/begin CHARACTERISTIC LLim_uASLAppOpenLrnLoLim_C "Lower limit voltage of APP open learning for ASL" VALUE 0x8052E2DA Val_Ws16 13107.00 Volt -6553.600 6553.400 FORMAT "%8.3" /end CHARACTERISTIC
/begin CHARACTERISTIC LLim_uASLAppOpenLrnUpLim_C "Upper limit voltage of APP open learning for ASL" VALUE 0x8052E2DC Val_Ws16 13107.00 Volt -6553.600 6553.400 FORMAT "%8.3" /end CHARACTERISTIC
/begin CHARACTERISTIC LLim_uASLAppSnsrErr_C "APP sensor volatage value during error condition" VALUE 0x8052E2DE Val_Ws16 13107.00 Volt -6553.600 6553.400 FORMAT "%8.3" /end CHARACTERISTIC
/begin CHARACTERISTIC LLim_uASLAppSnsrUpLim_C "Upper limit voltage of acceleration pedal position sensor" VALUE 0x8052E2E0 Val_Ws16 13107.00 Volt -6553.600 6553.400 FORMAT "%8.3" /end CHARACTERISTIC
/begin CHARACTERISTIC LLim_vAcclLim_CUR "Curve for acceleration limit value for ASL" CURVE 0x8052E2E2 RB_Curve_S16_S16 655.3500 Vel -327.6800 327.6700 FORMAT "%8.4"
 /begin AXIS_DESCR STD_AXIS CrCtl_vASLVehCont Vel 12 -327.6800 327.6700 FORMAT "%8.4" DEPOSIT ABSOLUTE /end AXIS_DESCR
/end CHARACTERISTIC
/begin CHARACTERISTIC LLim_vAPPLimTmpRlsSpdDvt_C "Vehicle speed deviation to continue temporary release of APP limitation" VALUE 0x8052E314 Val_Ws16 655.3500 Vel -327.6800 327.6700 FORMAT "%8.4" /end CHARACTERISTIC
/begin CHARACTERISTIC LLim_vCnclAcclLim_CUR "Curve for acceleration limit value for ASL cancel" CURVE 0x8052E316 RB_Curve_S16_S16 655.3500 Vel -327.6800 327.6700 FORMAT "%8.4"
 /begin AXIS_DESCR STD_AXIS CrCtl_vASLVehCont Vel 12 -327.6800 327.6700 FORMAT "%8.4" DEPOSIT ABSOLUTE /end AXIS_DESCR
/end CHARACTERISTIC
/begin CHARACTERISTIC LLim_vDLimHysHi1LG_CUR "Curve for ASL Vehicle spped for DL (hysteresis Hi) value(for 1 level lower gear)" CURVE 0x8052E348 RB_Curve_S16_S16 655.3500 Vel -327.6800 327.6700 FORMAT "%8.4"
 /begin AXIS_DESCR STD_AXIS LLim_vDes_mp Vel 12 -327.6800 327.6700 FORMAT "%8.4" DEPOSIT ABSOLUTE /end AXIS_DESCR
/end CHARACTERISTIC
/begin CHARACTERISTIC LLim_vDLimHysHi2LG_CUR "Curve for ASL Vehicle spped for DL (hysteresis Hi) value(for 2 level lower gear)" CURVE 0x8052E37A RB_Curve_S16_S16 655.3500 Vel -327.6800 327.6700 FORMAT "%8.4"
 /begin AXIS_DESCR STD_AXIS LLim_vDes_mp Vel 12 -327.6800 327.6700 FORMAT "%8.4" DEPOSIT ABSOLUTE /end AXIS_DESCR
/end CHARACTERISTIC
/begin CHARACTERISTIC LLim_vDLimHysHi3LG_CUR "Curve for ASL Vehicle spped for DL (hysteresis Hi) value(for 3 level lower gear)" CURVE 0x8052E3AC RB_Curve_S16_S16 655.3500 Vel -327.6800 327.6700 FORMAT "%8.4"
 /begin AXIS_DESCR STD_AXIS LLim_vDes_mp Vel 12 -327.6800 327.6700 FORMAT "%8.4" DEPOSIT ABSOLUTE /end AXIS_DESCR
/end CHARACTERISTIC
/begin CHARACTERISTIC LLim_vDLimHysHi4LG_CUR "Curve for ASL Vehicle spped for DL (hysteresis Hi) value(for 4 level lower gear)" CURVE 0x8052E3DE RB_Curve_S16_S16 655.3500 Vel -327.6800 327.6700 FORMAT "%8.4"
 /begin AXIS_DESCR STD_AXIS LLim_vDes_mp Vel 12 -327.6800 327.6700 FORMAT "%8.4" DEPOSIT ABSOLUTE /end AXIS_DESCR
/end CHARACTERISTIC
/begin CHARACTERISTIC LLim_vDLimHysHi5LG_CUR "Curve for ASL Vehicle spped for DL (hysteresis Hi) value(for 5 level lower gear)" CURVE 0x8052E410 RB_Curve_S16_S16 655.3500 Vel -327.6800 327.6700 FORMAT "%8.4"
 /begin AXIS_DESCR STD_AXIS LLim_vDes_mp Vel 12 -327.6800 327.6700 FORMAT "%8.4" DEPOSIT ABSOLUTE /end AXIS_DESCR
/end CHARACTERISTIC
/begin CHARACTERISTIC LLim_vDLimHysHiLmap_CUR "Curve for ASL vehicle speed for DL (hysteresis Hi) value(for L positions)" CURVE 0x8052E442 RB_Curve_S16_S16 655.3500 Vel -327.6800 327.6700 FORMAT "%8.4"
 /begin AXIS_DESCR STD_AXIS LLim_vDes_mp Vel 12 -327.6800 327.6700 FORMAT "%8.4" DEPOSIT ABSOLUTE /end AXIS_DESCR
/end CHARACTERISTIC
/begin CHARACTERISTIC LLim_vDLimHysHiTG_CUR "Curve for ASL Vehicle spped for DL (hysteresis Hi) value(for the top gear)" CURVE 0x8052E474 RB_Curve_S16_S16 655.3500 Vel -327.6800 327.6700 FORMAT "%8.4"
 /begin AXIS_DESCR STD_AXIS LLim_vDes_mp Vel 12 -327.6800 327.6700 FORMAT "%8.4" DEPOSIT ABSOLUTE /end AXIS_DESCR
/end CHARACTERISTIC
/begin CHARACTERISTIC LLim_vDLimHysLo1LG_CUR "Curve for ASL Vehicle spped for DL (hysteresis Lo) value(for 1 level lower gear)" CURVE 0x8052E4A6 RB_Curve_S16_S16 655.3500 Vel -327.6800 327.6700 FORMAT "%8.4"
 /begin AXIS_DESCR STD_AXIS LLim_vDes_mp Vel 12 -327.6800 327.6700 FORMAT "%8.4" DEPOSIT ABSOLUTE /end AXIS_DESCR
/end CHARACTERISTIC
/begin CHARACTERISTIC LLim_vDLimHysLo2LG_CUR "Curve for ASL Vehicle spped for DL (hysteresis Lo) value(for 2 level lower gear)" CURVE 0x8052E4D8 RB_Curve_S16_S16 655.3500 Vel -327.6800 327.6700 FORMAT "%8.4"
 /begin AXIS_DESCR STD_AXIS LLim_vDes_mp Vel 12 -327.6800 327.6700 FORMAT "%8.4" DEPOSIT ABSOLUTE /end AXIS_DESCR
/end CHARACTERISTIC
/begin CHARACTERISTIC LLim_vDLimHysLo3LG_CUR "Curve for ASL Vehicle spped for DL (hysteresis Lo) value(for 3 level lower gear)" CURVE 0x8052E50A RB_Curve_S16_S16 655.3500 Vel -327.6800 327.6700 FORMAT "%8.4"
 /begin AXIS_DESCR STD_AXIS LLim_vDes_mp Vel 12 -327.6800 327.6700 FORMAT "%8.4" DEPOSIT ABSOLUTE /end AXIS_DESCR
/end CHARACTERISTIC
/begin CHARACTERISTIC LLim_vDLimHysLo4LG_CUR "Curve for ASL Vehicle spped for DL (hysteresis Lo) value(for 4 level lower gear)" CURVE 0x8052E53C RB_Curve_S16_S16 655.3500 Vel -327.6800 327.6700 FORMAT "%8.4"
 /begin AXIS_DESCR STD_AXIS LLim_vDes_mp Vel 12 -327.6800 327.6700 FORMAT "%8.4" DEPOSIT ABSOLUTE /end AXIS_DESCR
/end CHARACTERISTIC
/begin CHARACTERISTIC LLim_vDLimHysLo5LG_CUR "Curve for ASL Vehicle spped for DL (hysteresis Lo) value(for 5 level lower gear)" CURVE 0x8052E56E RB_Curve_S16_S16 655.3500 Vel -327.6800 327.6700 FORMAT "%8.4"
 /begin AXIS_DESCR STD_AXIS LLim_vDes_mp Vel 12 -327.6800 327.6700 FORMAT "%8.4" DEPOSIT ABSOLUTE /end AXIS_DESCR
/end CHARACTERISTIC
/begin CHARACTERISTIC LLim_vDLimHysLoLmap_CUR "Curve for ASL vehicle speed for DL (hysteresis Lo) value(for L positions)" CURVE 0x8052E5A0 RB_Curve_S16_S16 655.3500 Vel -327.6800 327.6700 FORMAT "%8.4"
 /begin AXIS_DESCR STD_AXIS LLim_vDes_mp Vel 12 -327.6800 327.6700 FORMAT "%8.4" DEPOSIT ABSOLUTE /end AXIS_DESCR
/end CHARACTERISTIC
/begin CHARACTERISTIC LLim_vDLimHysLoTG_CUR "Curve for ASL Vehicle spped for DL (hysteresis Lo) value(for the top gear)" CURVE 0x8052E5D2 RB_Curve_S16_S16 655.3500 Vel -327.6800 327.6700 FORMAT "%8.4"
 /begin AXIS_DESCR STD_AXIS LLim_vDes_mp Vel 12 -327.6800 327.6700 FORMAT "%8.4" DEPOSIT ABSOLUTE /end AXIS_DESCR
/end CHARACTERISTIC
/begin CHARACTERISTIC LLim_vDvtSpdOvrAlrmHysHi_C "Vehicle speed deviation value for over speed alarm check(hysteresis Hi)" VALUE 0x8052E604 Val_Ws16 655.3500 Vel -327.6800 327.6700 FORMAT "%8.4" /end CHARACTERISTIC
/begin CHARACTERISTIC LLim_vDvtSpdOvrAlrmHysLo_C "Vehicle speed deviation value for over speed alarm check(hysteresis Lo)" VALUE 0x8052E606 Val_Ws16 655.3500 Vel -327.6800 327.6700 FORMAT "%8.4" /end CHARACTERISTIC
/begin CHARACTERISTIC LLim_vISACnclAcclLim_CUR "Curve for acceleration limit value for ISA cancel" CURVE 0x8052E608 RB_Curve_S16_S16 655.3500 Vel -327.6800 327.6700 FORMAT "%8.4"
 /begin AXIS_DESCR STD_AXIS CrCtl_vASLVehCont Vel 12 -327.6800 327.6700 FORMAT "%8.4" DEPOSIT ABSOLUTE /end AXIS_DESCR
/end CHARACTERISTIC
/begin CHARACTERISTIC LLim_vISAMemSpdLoLimKmh_C "ISA memory lower limit vehicle speed (kmh)" VALUE 0x8052E63A Val_Ws16 655.3500 Vel -327.6800 327.6700 FORMAT "%8.4" /end CHARACTERISTIC
/begin CHARACTERISTIC LLim_vISAMemSpdLoLimMPH_C "ISA memory lower limit vehicle speed (MPH)" VALUE 0x8052E63C Val_Ws32 16777215.9961 Vel_CrCtl_MPH -8388608.00000 8388607.99609 FORMAT "%13.5" /end CHARACTERISTIC
/begin CHARACTERISTIC LLim_vLimSpdIniUpdKmh_C "Initial updated amount of limited veh speed during ASL SW is on (km/h)" VALUE 0x8052E640 Val_Ws16 65535.00 Vel_CrCtl1 -32768.00 32767.00 FORMAT "%8.2" /end CHARACTERISTIC
/begin CHARACTERISTIC LLim_vLimSpdIniUpdMPH_C "Initial updated amount of limited veh speed during ASL SW is on (MPH)" VALUE 0x8052E642 Val_Ws16 65535.00 Vel_CrCtl1_MPH -32768.00 32767.00 FORMAT "%8.2" /end CHARACTERISTIC
/begin CHARACTERISTIC LLim_vLimSpdUpdKmh_C "Updated amount of limited veh speed during ASL SW is on (km/h)" VALUE 0x8052E644 Val_Ws16 65535.00 Vel_CrCtl1 -32768.00 32767.00 FORMAT "%8.2" /end CHARACTERISTIC
/begin CHARACTERISTIC LLim_vLimSpdUpdMPH_C "Updated amount of limited veh speed during ASL SW is on (MPH)" VALUE 0x8052E646 Val_Ws16 65535.00 Vel_CrCtl1_MPH -32768.00 32767.00 FORMAT "%8.2" /end CHARACTERISTIC
/begin CHARACTERISTIC LLim_vMemSpdCorKmh_C "Correct value of memory speed for ASL (km/h)" VALUE 0x8052E648 Val_Ws16 655.3500 Vel -327.6800 327.6700 FORMAT "%8.4" /end CHARACTERISTIC
/begin CHARACTERISTIC LLim_vMemSpdCorMPH_C "Correct value of memory speed for ASL (MPH)" VALUE 0x8052E64A Val_Ws16 65535.00 Vel_CrCtl1_MPH -32768.00 32767.00 FORMAT "%8.2" /end CHARACTERISTIC
/begin CHARACTERISTIC LLim_vMemSpdKMHOffsHysHi_C "High threshold for vehicle speed memory offset in KMPH" VALUE 0x8052E64C Val_Wu16 655.3500 Vel 0.00 655.3500 FORMAT "%8.4" /end CHARACTERISTIC
/begin CHARACTERISTIC LLim_vMemSpdKMHOffsHysLo_C "Low threshold for vehicle speed memory offset in KMPH" VALUE 0x8052E64E Val_Wu16 655.3500 Vel 0.00 655.3500 FORMAT "%8.4" /end CHARACTERISTIC
/begin CHARACTERISTIC LLim_vMemSpdLoLimKmh_C "Lower limit of the memeory vehicle speed for ASL(km/h)" VALUE 0x8052E650 Val_Ws16 655.3500 Vel -327.6800 327.6700 FORMAT "%8.4" /end CHARACTERISTIC
/begin CHARACTERISTIC LLim_vMemSpdLoLimMPH_C "Lower limit of the memeory vehicle speed for ASL(MPH)" VALUE 0x8052E654 Val_Ws32 16777215.9961 Vel_CrCtl_MPH -8388608.00000 8388607.99609 FORMAT "%13.5" /end CHARACTERISTIC
/begin CHARACTERISTIC LLim_vMemSpdMPHOffsHysHi_C "High threshold for vehicle speed memory offset in MPH" VALUE 0x8052E658 Val_Wu16 655.3500 Vel 0.00 655.3500 FORMAT "%8.4" /end CHARACTERISTIC
/begin CHARACTERISTIC LLim_vMemSpdMPHOffsHysLo_C "Low threshold for vehicle speed memory offset in MPH" VALUE 0x8052E65A Val_Wu16 655.3500 Vel 0.00 655.3500 FORMAT "%8.4" /end CHARACTERISTIC
/begin CHARACTERISTIC LLim_vMemSpdUpLimKmh_C "Upper limit of the memeory vehicle speed for ASL(km/h)" VALUE 0x8052E65C Val_Ws16 655.3500 Vel -327.6800 327.6700 FORMAT "%8.4" /end CHARACTERISTIC
/begin CHARACTERISTIC LLim_vMemSpdUpLimMPH_C "Upper limit of the memeory vehicle speed for ASL(MPH)" VALUE 0x8052E660 Val_Ws32 16777215.9961 Vel_CrCtl_MPH -8388608.00000 8388607.99609 FORMAT "%13.5" /end CHARACTERISTIC
/begin CHARACTERISTIC LLim_vNoCtlPntHysHi1LG_CUR "Curve fir ASL Vehicle spped for non control point (hysteresis Hi) value(for 1 level lower gear)" CURVE 0x8052E664 RB_Curve_S16_S16 655.3500 Vel -327.6800 327.6700 FORMAT "%8.4"
 /begin AXIS_DESCR STD_AXIS LLim_vDes_mp Vel 12 -327.6800 327.6700 FORMAT "%8.4" DEPOSIT ABSOLUTE /end AXIS_DESCR
/end CHARACTERISTIC
/begin CHARACTERISTIC LLim_vNoCtlPntHysHi2LG_CUR "Curve fir ASL Vehicle spped for non control point (hysteresis Hi) value(for 2 level lower gear)" CURVE 0x8052E696 RB_Curve_S16_S16 655.3500 Vel -327.6800 327.6700 FORMAT "%8.4"
 /begin AXIS_DESCR STD_AXIS LLim_vDes_mp Vel 12 -327.6800 327.6700 FORMAT "%8.4" DEPOSIT ABSOLUTE /end AXIS_DESCR
/end CHARACTERISTIC
/begin CHARACTERISTIC LLim_vNoCtlPntHysHi3LG_CUR "Curve fir ASL Vehicle spped for non control point (hysteresis Hi) value(for 3 level lower gear)" CURVE 0x8052E6C8 RB_Curve_S16_S16 655.3500 Vel -327.6800 327.6700 FORMAT "%8.4"
 /begin AXIS_DESCR STD_AXIS LLim_vDes_mp Vel 12 -327.6800 327.6700 FORMAT "%8.4" DEPOSIT ABSOLUTE /end AXIS_DESCR
/end CHARACTERISTIC
/begin CHARACTERISTIC LLim_vNoCtlPntHysHi4LG_CUR "Curve fir ASL Vehicle spped for non control point (hysteresis Hi) value(for 4 level lower gear)" CURVE 0x8052E6FA RB_Curve_S16_S16 655.3500 Vel -327.6800 327.6700 FORMAT "%8.4"
 /begin AXIS_DESCR STD_AXIS LLim_vDes_mp Vel 12 -327.6800 327.6700 FORMAT "%8.4" DEPOSIT ABSOLUTE /end AXIS_DESCR
/end CHARACTERISTIC
/begin CHARACTERISTIC LLim_vNoCtlPntHysHi5LG_CUR "Curve fir ASL Vehicle spped for non control point (hysteresis Hi) value(for 5 level lower gear)" CURVE 0x8052E72C RB_Curve_S16_S16 655.3500 Vel -327.6800 327.6700 FORMAT "%8.4"
 /begin AXIS_DESCR STD_AXIS LLim_vDes_mp Vel 12 -327.6800 327.6700 FORMAT "%8.4" DEPOSIT ABSOLUTE /end AXIS_DESCR
/end CHARACTERISTIC
/begin CHARACTERISTIC LLim_vNoCtlPntHysHiLmap_CUR "Curve for ASL vehicle speed for non control point (hysteresis Hi) value(for L positions)" CURVE 0x8052E75E RB_Curve_S16_S16 655.3500 Vel -327.6800 327.6700 FORMAT "%8.4"
 /begin AXIS_DESCR STD_AXIS LLim_vDes_mp Vel 12 -327.6800 327.6700 FORMAT "%8.4" DEPOSIT ABSOLUTE /end AXIS_DESCR
/end CHARACTERISTIC
/begin CHARACTERISTIC LLim_vNoCtlPntHysHiTG_CUR "Curve fir ASL Vehicle spped for non control point (hysteresis Hi) value(for the top gear)" CURVE 0x8052E790 RB_Curve_S16_S16 655.3500 Vel -327.6800 327.6700 FORMAT "%8.4"
 /begin AXIS_DESCR STD_AXIS LLim_vDes_mp Vel 12 -327.6800 327.6700 FORMAT "%8.4" DEPOSIT ABSOLUTE /end AXIS_DESCR
/end CHARACTERISTIC
/begin CHARACTERISTIC LLim_vNoCtlPntHysLo1LG_CUR "Curve fir ASL Vehicle spped for non control point (hysteresis Lo) value(for 1 level lower gear)" CURVE 0x8052E7C2 RB_Curve_S16_S16 655.3500 Vel -327.6800 327.6700 FORMAT "%8.4"
 /begin AXIS_DESCR STD_AXIS LLim_vDes_mp Vel 12 -327.6800 327.6700 FORMAT "%8.4" DEPOSIT ABSOLUTE /end AXIS_DESCR
/end CHARACTERISTIC
/begin CHARACTERISTIC LLim_vNoCtlPntHysLo2LG_CUR "Curve fir ASL Vehicle spped for non control point (hysteresis Lo) value(for 2 level lower gear)" CURVE 0x8052E7F4 RB_Curve_S16_S16 655.3500 Vel -327.6800 327.6700 FORMAT "%8.4"
 /begin AXIS_DESCR STD_AXIS LLim_vDes_mp Vel 12 -327.6800 327.6700 FORMAT "%8.4" DEPOSIT ABSOLUTE /end AXIS_DESCR
/end CHARACTERISTIC
/begin CHARACTERISTIC LLim_vNoCtlPntHysLo3LG_CUR "Curve fir ASL Vehicle spped for non control point (hysteresis Lo) value(for 3 level lower gear)" CURVE 0x8052E826 RB_Curve_S16_S16 655.3500 Vel -327.6800 327.6700 FORMAT "%8.4"
 /begin AXIS_DESCR STD_AXIS LLim_vDes_mp Vel 12 -327.6800 327.6700 FORMAT "%8.4" DEPOSIT ABSOLUTE /end AXIS_DESCR
/end CHARACTERISTIC
/begin CHARACTERISTIC LLim_vNoCtlPntHysLo4LG_CUR "Curve fir ASL Vehicle spped for non control point (hysteresis Lo) value(for 4 level lower gear)" CURVE 0x8052E858 RB_Curve_S16_S16 655.3500 Vel -327.6800 327.6700 FORMAT "%8.4"
 /begin AXIS_DESCR STD_AXIS LLim_vDes_mp Vel 12 -327.6800 327.6700 FORMAT "%8.4" DEPOSIT ABSOLUTE /end AXIS_DESCR
/end CHARACTERISTIC
/begin CHARACTERISTIC LLim_vNoCtlPntHysLo5LG_CUR "Curve fir ASL Vehicle spped for non control point (hysteresis Lo) value(for 5 level lower gear)" CURVE 0x8052E88A RB_Curve_S16_S16 655.3500 Vel -327.6800 327.6700 FORMAT "%8.4"
 /begin AXIS_DESCR STD_AXIS LLim_vDes_mp Vel 12 -327.6800 327.6700 FORMAT "%8.4" DEPOSIT ABSOLUTE /end AXIS_DESCR
/end CHARACTERISTIC
/begin CHARACTERISTIC LLim_vNoCtlPntHysLoLmap_CUR "Curve for ASL vehicle speed for non control point (hysteresis Lo) value(for L positions)" CURVE 0x8052E8BC RB_Curve_S16_S16 655.3500 Vel -327.6800 327.6700 FORMAT "%8.4"
 /begin AXIS_DESCR STD_AXIS LLim_vDes_mp Vel 12 -327.6800 327.6700 FORMAT "%8.4" DEPOSIT ABSOLUTE /end AXIS_DESCR
/end CHARACTERISTIC
/begin CHARACTERISTIC LLim_vNoCtlPntHysLoTG_CUR "Curve fir ASL Vehicle spped for non control point (hysteresis Lo) value(for the top gear)" CURVE 0x8052E8EE RB_Curve_S16_S16 655.3500 Vel -327.6800 327.6700 FORMAT "%8.4"
 /begin AXIS_DESCR STD_AXIS LLim_vDes_mp Vel 12 -327.6800 327.6700 FORMAT "%8.4" DEPOSIT ABSOLUTE /end AXIS_DESCR
/end CHARACTERISTIC
/begin CHARACTERISTIC LLim_vRPntHysHi1LG_CUR "Curve for ASL Vehicle spped for RP (hysteresis Hi) value(for 1 level lower gear)" CURVE 0x8052E920 RB_Curve_S16_S16 655.3500 Vel -327.6800 327.6700 FORMAT "%8.4"
 /begin AXIS_DESCR STD_AXIS LLim_vDes_mp Vel 12 -327.6800 327.6700 FORMAT "%8.4" DEPOSIT ABSOLUTE /end AXIS_DESCR
/end CHARACTERISTIC
/begin CHARACTERISTIC LLim_vRPntHysHi2LG_CUR "Curve for ASL Vehicle spped for RP (hysteresis Hi) value(for 2 level lower gear)" CURVE 0x8052E952 RB_Curve_S16_S16 655.3500 Vel -327.6800 327.6700 FORMAT "%8.4"
 /begin AXIS_DESCR STD_AXIS LLim_vDes_mp Vel 12 -327.6800 327.6700 FORMAT "%8.4" DEPOSIT ABSOLUTE /end AXIS_DESCR
/end CHARACTERISTIC
/begin CHARACTERISTIC LLim_vRPntHysHi3LG_CUR "Curve for ASL Vehicle spped for RP (hysteresis Hi) value(for 3 level lower gear)" CURVE 0x8052E984 RB_Curve_S16_S16 655.3500 Vel -327.6800 327.6700 FORMAT "%8.4"
 /begin AXIS_DESCR STD_AXIS LLim_vDes_mp Vel 12 -327.6800 327.6700 FORMAT "%8.4" DEPOSIT ABSOLUTE /end AXIS_DESCR
/end CHARACTERISTIC
/begin CHARACTERISTIC LLim_vRPntHysHi4LG_CUR "Curve for ASL Vehicle spped for RP (hysteresis Hi) value(for 4 level lower gear)" CURVE 0x8052E9B6 RB_Curve_S16_S16 655.3500 Vel -327.6800 327.6700 FORMAT "%8.4"
 /begin AXIS_DESCR STD_AXIS LLim_vDes_mp Vel 12 -327.6800 327.6700 FORMAT "%8.4" DEPOSIT ABSOLUTE /end AXIS_DESCR
/end CHARACTERISTIC
/begin CHARACTERISTIC LLim_vRPntHysHi5LG_CUR "Curve for ASL Vehicle spped for RP (hysteresis Hi) value(for 5 level lower gear)" CURVE 0x8052E9E8 RB_Curve_S16_S16 655.3500 Vel -327.6800 327.6700 FORMAT "%8.4"
 /begin AXIS_DESCR STD_AXIS LLim_vDes_mp Vel 12 -327.6800 327.6700 FORMAT "%8.4" DEPOSIT ABSOLUTE /end AXIS_DESCR
/end CHARACTERISTIC
/begin CHARACTERISTIC LLim_vRPntHysHiLmap_CUR "Curve for ASL vehicle speed for RP (hysteresis Hi) value(for L positions)" CURVE 0x8052EA1A RB_Curve_S16_S16 655.3500 Vel -327.6800 327.6700 FORMAT "%8.4"
 /begin AXIS_DESCR STD_AXIS LLim_vDes_mp Vel 12 -327.6800 327.6700 FORMAT "%8.4" DEPOSIT ABSOLUTE /end AXIS_DESCR
/end CHARACTERISTIC
/begin CHARACTERISTIC LLim_vRPntHysHiTG_CUR "Curve for ASL Vehicle spped for RP (hysteresis Hi) value(for the top gear)" CURVE 0x8052EA4C RB_Curve_S16_S16 655.3500 Vel -327.6800 327.6700 FORMAT "%8.4"
 /begin AXIS_DESCR STD_AXIS LLim_vDes_mp Vel 12 -327.6800 327.6700 FORMAT "%8.4" DEPOSIT ABSOLUTE /end AXIS_DESCR
/end CHARACTERISTIC
/begin CHARACTERISTIC LLim_vRPntHysLo1LG_CUR "Curve for ASL Vehicle spped for RP (hysteresis Lo) value(for 1 level lower gear)" CURVE 0x8052EA7E RB_Curve_S16_S16 655.3500 Vel -327.6800 327.6700 FORMAT "%8.4"
 /begin AXIS_DESCR STD_AXIS LLim_vDes_mp Vel 12 -327.6800 327.6700 FORMAT "%8.4" DEPOSIT ABSOLUTE /end AXIS_DESCR
/end CHARACTERISTIC
/begin CHARACTERISTIC LLim_vRPntHysLo2LG_CUR "Curve for ASL Vehicle spped for RP (hysteresis Lo) value(for 2 level lower gear)" CURVE 0x8052EAB0 RB_Curve_S16_S16 655.3500 Vel -327.6800 327.6700 FORMAT "%8.4"
 /begin AXIS_DESCR STD_AXIS LLim_vDes_mp Vel 12 -327.6800 327.6700 FORMAT "%8.4" DEPOSIT ABSOLUTE /end AXIS_DESCR
/end CHARACTERISTIC
/begin CHARACTERISTIC LLim_vRPntHysLo3LG_CUR "Curve for ASL Vehicle spped for RP (hysteresis Lo) value(for 3 level lower gear)" CURVE 0x8052EAE2 RB_Curve_S16_S16 655.3500 Vel -327.6800 327.6700 FORMAT "%8.4"
 /begin AXIS_DESCR STD_AXIS LLim_vDes_mp Vel 12 -327.6800 327.6700 FORMAT "%8.4" DEPOSIT ABSOLUTE /end AXIS_DESCR
/end CHARACTERISTIC
/begin CHARACTERISTIC LLim_vRPntHysLo4LG_CUR "Curve for ASL Vehicle spped for RP (hysteresis Lo) value(for 4 level lower gear)" CURVE 0x8052EB14 RB_Curve_S16_S16 655.3500 Vel -327.6800 327.6700 FORMAT "%8.4"
 /begin AXIS_DESCR STD_AXIS LLim_vDes_mp Vel 12 -327.6800 327.6700 FORMAT "%8.4" DEPOSIT ABSOLUTE /end AXIS_DESCR
/end CHARACTERISTIC
/begin CHARACTERISTIC LLim_vRPntHysLo5LG_CUR "Curve for ASL Vehicle spped for RP (hysteresis Lo) value(for 5 level lower gear)" CURVE 0x8052EB46 RB_Curve_S16_S16 655.3500 Vel -327.6800 327.6700 FORMAT "%8.4"
 /begin AXIS_DESCR STD_AXIS LLim_vDes_mp Vel 12 -327.6800 327.6700 FORMAT "%8.4" DEPOSIT ABSOLUTE /end AXIS_DESCR
/end CHARACTERISTIC
/begin CHARACTERISTIC LLim_vRPntHysLoLmap_CUR "Curve for ASL vehicle speed for RP (hysteresis Lo) value(for L positions)" CURVE 0x8052EB78 RB_Curve_S16_S16 655.3500 Vel -327.6800 327.6700 FORMAT "%8.4"
 /begin AXIS_DESCR STD_AXIS LLim_vDes_mp Vel 12 -327.6800 327.6700 FORMAT "%8.4" DEPOSIT ABSOLUTE /end AXIS_DESCR
/end CHARACTERISTIC
/begin CHARACTERISTIC LLim_vRPntHysLoTG_CUR "Curve for ASL Vehicle spped for RP (hysteresis Lo) value(for the top gear)" CURVE 0x8052EBAA RB_Curve_S16_S16 655.3500 Vel -327.6800 327.6700 FORMAT "%8.4"
 /begin AXIS_DESCR STD_AXIS LLim_vDes_mp Vel 12 -327.6800 327.6700 FORMAT "%8.4" DEPOSIT ABSOLUTE /end AXIS_DESCR
/end CHARACTERISTIC
/begin CHARACTERISTIC LLim_vSptDLimHysHi1LG_CUR "Curve for ASL Vehicle speed for DL (hysteresis Hi) value for sport mode( for 1 level lower gear)" CURVE 0x8052EBDC RB_Curve_S16_S16 655.3500 Vel -327.6800 327.6700 FORMAT "%8.4"
 /begin AXIS_DESCR STD_AXIS LLim_vDes_mp Vel 12 -327.6800 327.6700 FORMAT "%8.4" DEPOSIT ABSOLUTE /end AXIS_DESCR
/end CHARACTERISTIC
/begin CHARACTERISTIC LLim_vSptDLimHysHi2LG_CUR "Curve for ASL Vehicle speed for DL (hysteresis Hi) value for sport mode( for 2 level lower gear)" CURVE 0x8052EC0E RB_Curve_S16_S16 655.3500 Vel -327.6800 327.6700 FORMAT "%8.4"
 /begin AXIS_DESCR STD_AXIS LLim_vDes_mp Vel 12 -327.6800 327.6700 FORMAT "%8.4" DEPOSIT ABSOLUTE /end AXIS_DESCR
/end CHARACTERISTIC
/begin CHARACTERISTIC LLim_vSptDLimHysHi3LG_CUR "Curve for ASL Vehicle speed for DL (hysteresis Hi) value for sport mode( for 3 level lower gear)" CURVE 0x8052EC40 RB_Curve_S16_S16 655.3500 Vel -327.6800 327.6700 FORMAT "%8.4"
 /begin AXIS_DESCR STD_AXIS LLim_vDes_mp Vel 12 -327.6800 327.6700 FORMAT "%8.4" DEPOSIT ABSOLUTE /end AXIS_DESCR
/end CHARACTERISTIC
/begin CHARACTERISTIC LLim_vSptDLimHysHi4LG_CUR "Curve for ASL Vehicle speed for DL (hysteresis Hi) value for sport mode( for 4 level lower gear)" CURVE 0x8052EC72 RB_Curve_S16_S16 655.3500 Vel -327.6800 327.6700 FORMAT "%8.4"
 /begin AXIS_DESCR STD_AXIS LLim_vDes_mp Vel 12 -327.6800 327.6700 FORMAT "%8.4" DEPOSIT ABSOLUTE /end AXIS_DESCR
/end CHARACTERISTIC
/begin CHARACTERISTIC LLim_vSptDLimHysHi5LG_CUR "Curve for ASL Vehicle speed for DL (hysteresis Hi) value for sport mode( for 5 level lower gear)" CURVE 0x8052ECA4 RB_Curve_S16_S16 655.3500 Vel -327.6800 327.6700 FORMAT "%8.4"
 /begin AXIS_DESCR STD_AXIS LLim_vDes_mp Vel 12 -327.6800 327.6700 FORMAT "%8.4" DEPOSIT ABSOLUTE /end AXIS_DESCR
/end CHARACTERISTIC
/begin CHARACTERISTIC LLim_vSptDLimHysHiTG_CUR "Curve for ASL Vehicle speed for DL (hysteresis Hi) value for sport mode( for the top gear)" CURVE 0x8052ECD6 RB_Curve_S16_S16 655.3500 Vel -327.6800 327.6700 FORMAT "%8.4"
 /begin AXIS_DESCR STD_AXIS LLim_vDes_mp Vel 12 -327.6800 327.6700 FORMAT "%8.4" DEPOSIT ABSOLUTE /end AXIS_DESCR
/end CHARACTERISTIC
/begin CHARACTERISTIC LLim_vSptDLimHysLo1LG_CUR "Curve for ASL Vehicle speed for DL (hysteresis Lo) value for sport mode( for 1 level lower gear)" CURVE 0x8052ED08 RB_Curve_S16_S16 655.3500 Vel -327.6800 327.6700 FORMAT "%8.4"
 /begin AXIS_DESCR STD_AXIS LLim_vDes_mp Vel 12 -327.6800 327.6700 FORMAT "%8.4" DEPOSIT ABSOLUTE /end AXIS_DESCR
/end CHARACTERISTIC
/begin CHARACTERISTIC LLim_vSptDLimHysLo2LG_CUR "Curve for ASL Vehicle speed for DL (hysteresis Lo) value for sport mode( for 2 level lower gear)" CURVE 0x8052ED3A RB_Curve_S16_S16 655.3500 Vel -327.6800 327.6700 FORMAT "%8.4"
 /begin AXIS_DESCR STD_AXIS LLim_vDes_mp Vel 12 -327.6800 327.6700 FORMAT "%8.4" DEPOSIT ABSOLUTE /end AXIS_DESCR
/end CHARACTERISTIC
/begin CHARACTERISTIC LLim_vSptDLimHysLo3LG_CUR "Curve for ASL Vehicle speed for DL (hysteresis Lo) value for sport mode( for 3 level lower gear)" CURVE 0x8052ED6C RB_Curve_S16_S16 655.3500 Vel -327.6800 327.6700 FORMAT "%8.4"
 /begin AXIS_DESCR STD_AXIS LLim_vDes_mp Vel 12 -327.6800 327.6700 FORMAT "%8.4" DEPOSIT ABSOLUTE /end AXIS_DESCR
/end CHARACTERISTIC
/begin CHARACTERISTIC LLim_vSptDLimHysLo4LG_CUR "Curve for ASL Vehicle speed for DL (hysteresis Lo) value for sport mode( for 4 level lower gear)" CURVE 0x8052ED9E RB_Curve_S16_S16 655.3500 Vel -327.6800 327.6700 FORMAT "%8.4"
 /begin AXIS_DESCR STD_AXIS LLim_vDes_mp Vel 12 -327.6800 327.6700 FORMAT "%8.4" DEPOSIT ABSOLUTE /end AXIS_DESCR
/end CHARACTERISTIC
/begin CHARACTERISTIC LLim_vSptDLimHysLo5LG_CUR "Curve for ASL Vehicle speed for DL (hysteresis Lo) value for sport mode( for 5 level lower gear)" CURVE 0x8052EDD0 RB_Curve_S16_S16 655.3500 Vel -327.6800 327.6700 FORMAT "%8.4"
 /begin AXIS_DESCR STD_AXIS LLim_vDes_mp Vel 12 -327.6800 327.6700 FORMAT "%8.4" DEPOSIT ABSOLUTE /end AXIS_DESCR
/end CHARACTERISTIC
/begin CHARACTERISTIC LLim_vSptDLimHysLoTG_CUR "Curve for ASL Vehicle speed for DL (hysteresis Lo) value for sport mode( for the top gear)" CURVE 0x8052EE02 RB_Curve_S16_S16 655.3500 Vel -327.6800 327.6700 FORMAT "%8.4"
 /begin AXIS_DESCR STD_AXIS LLim_vDes_mp Vel 12 -327.6800 327.6700 FORMAT "%8.4" DEPOSIT ABSOLUTE /end AXIS_DESCR
/end CHARACTERISTIC
/begin CHARACTERISTIC LLim_vSptNoCtlPntHysHi1LG_CUR "Curve for ASL Vehicle speed for non control point (hysteresis Hi) value for sport mode(for 1 level lower gear)" CURVE 0x8052EE34 RB_Curve_S16_S16 655.3500 Vel -327.6800 327.6700 FORMAT "%8.4"
 /begin AXIS_DESCR STD_AXIS LLim_vDes_mp Vel 12 -327.6800 327.6700 FORMAT "%8.4" DEPOSIT ABSOLUTE /end AXIS_DESCR
/end CHARACTERISTIC
/begin CHARACTERISTIC LLim_vSptNoCtlPntHysHi2LG_CUR "Curve for ASL Vehicle speed for non control point (hysteresis Hi) value for sport mode(for 2 level lower gear)" CURVE 0x8052EE66 RB_Curve_S16_S16 655.3500 Vel -327.6800 327.6700 FORMAT "%8.4"
 /begin AXIS_DESCR STD_AXIS LLim_vDes_mp Vel 12 -327.6800 327.6700 FORMAT "%8.4" DEPOSIT ABSOLUTE /end AXIS_DESCR
/end CHARACTERISTIC
/begin CHARACTERISTIC LLim_vSptNoCtlPntHysHi3LG_CUR "Curve for ASL Vehicle speed for non control point (hysteresis Hi) value for sport mode(for 3 level lower gear)" CURVE 0x8052EE98 RB_Curve_S16_S16 655.3500 Vel -327.6800 327.6700 FORMAT "%8.4"
 /begin AXIS_DESCR STD_AXIS LLim_vDes_mp Vel 12 -327.6800 327.6700 FORMAT "%8.4" DEPOSIT ABSOLUTE /end AXIS_DESCR
/end CHARACTERISTIC
/begin CHARACTERISTIC LLim_vSptNoCtlPntHysHi4LG_CUR "Curve for ASL Vehicle speed for non control point (hysteresis Hi) value for sport mode(for 4 level lower gear)" CURVE 0x8052EECA RB_Curve_S16_S16 655.3500 Vel -327.6800 327.6700 FORMAT "%8.4"
 /begin AXIS_DESCR STD_AXIS LLim_vDes_mp Vel 12 -327.6800 327.6700 FORMAT "%8.4" DEPOSIT ABSOLUTE /end AXIS_DESCR
/end CHARACTERISTIC
/begin CHARACTERISTIC LLim_vSptNoCtlPntHysHi5LG_CUR "Curve for ASL Vehicle speed for non control point (hysteresis Hi) value for sport mode(for 5 level lower gear)" CURVE 0x8052EEFC RB_Curve_S16_S16 655.3500 Vel -327.6800 327.6700 FORMAT "%8.4"
 /begin AXIS_DESCR STD_AXIS LLim_vDes_mp Vel 12 -327.6800 327.6700 FORMAT "%8.4" DEPOSIT ABSOLUTE /end AXIS_DESCR
/end CHARACTERISTIC
/begin CHARACTERISTIC LLim_vSptNoCtlPntHysHiTG_CUR "Curve for ASL Vehicle speed for non control point (hysteresis Hi) value for sport mode(for the top gear)" CURVE 0x8052EF2E RB_Curve_S16_S16 655.3500 Vel -327.6800 327.6700 FORMAT "%8.4"
 /begin AXIS_DESCR STD_AXIS LLim_vDes_mp Vel 12 -327.6800 327.6700 FORMAT "%8.4" DEPOSIT ABSOLUTE /end AXIS_DESCR
/end CHARACTERISTIC
/begin CHARACTERISTIC LLim_vSptNoCtlPntHysLo1LG_CUR "Curve for ASL Vehicle speed for non control point (hysteresis Lo) value for sport mode(for 1 level lower gear)" CURVE 0x8052EF60 RB_Curve_S16_S16 655.3500 Vel -327.6800 327.6700 FORMAT "%8.4"
 /begin AXIS_DESCR STD_AXIS LLim_vDes_mp Vel 12 -327.6800 327.6700 FORMAT "%8.4" DEPOSIT ABSOLUTE /end AXIS_DESCR
/end CHARACTERISTIC
/begin CHARACTERISTIC LLim_vSptNoCtlPntHysLo2LG_CUR "Curve for ASL Vehicle speed for non control point (hysteresis Lo) value for sport mode(for 2 level lower gear)" CURVE 0x8052EF92 RB_Curve_S16_S16 655.3500 Vel -327.6800 327.6700 FORMAT "%8.4"
 /begin AXIS_DESCR STD_AXIS LLim_vDes_mp Vel 12 -327.6800 327.6700 FORMAT "%8.4" DEPOSIT ABSOLUTE /end AXIS_DESCR
/end CHARACTERISTIC
/begin CHARACTERISTIC LLim_vSptNoCtlPntHysLo3LG_CUR "Curve for ASL Vehicle speed for non control point (hysteresis Lo) value for sport mode(for 3 level lower gear)" CURVE 0x8052EFC4 RB_Curve_S16_S16 655.3500 Vel -327.6800 327.6700 FORMAT "%8.4"
 /begin AXIS_DESCR STD_AXIS LLim_vDes_mp Vel 12 -327.6800 327.6700 FORMAT "%8.4" DEPOSIT ABSOLUTE /end AXIS_DESCR
/end CHARACTERISTIC
/begin CHARACTERISTIC LLim_vSptNoCtlPntHysLo4LG_CUR "Curve for ASL Vehicle speed for non control point (hysteresis Lo) value for sport mode(for 4 level lower gear)" CURVE 0x8052EFF6 RB_Curve_S16_S16 655.3500 Vel -327.6800 327.6700 FORMAT "%8.4"
 /begin AXIS_DESCR STD_AXIS LLim_vDes_mp Vel 12 -327.6800 327.6700 FORMAT "%8.4" DEPOSIT ABSOLUTE /end AXIS_DESCR
/end CHARACTERISTIC
/begin CHARACTERISTIC LLim_vSptNoCtlPntHysLo5LG_CUR "Curve for ASL Vehicle speed for non control point (hysteresis Lo) value for sport mode(for 5 level lower gear)" CURVE 0x8052F028 RB_Curve_S16_S16 655.3500 Vel -327.6800 327.6700 FORMAT "%8.4"
 /begin AXIS_DESCR STD_AXIS LLim_vDes_mp Vel 12 -327.6800 327.6700 FORMAT "%8.4" DEPOSIT ABSOLUTE /end AXIS_DESCR
/end CHARACTERISTIC
/begin CHARACTERISTIC LLim_vSptNoCtlPntHysLoTG_CUR "Curve for ASL Vehicle speed for non control point (hysteresis Lo) value for sport mode(for the gear)" CURVE 0x8052F05A RB_Curve_S16_S16 655.3500 Vel -327.6800 327.6700 FORMAT "%8.4"
 /begin AXIS_DESCR STD_AXIS LLim_vDes_mp Vel 12 -327.6800 327.6700 FORMAT "%8.4" DEPOSIT ABSOLUTE /end AXIS_DESCR
/end CHARACTERISTIC
/begin CHARACTERISTIC LLim_vSptRPntHysHi1LG_CUR "Curve for ASL Vehicle spped for RP (hysteresis Hi) value for sport mode ( for 1 level lower gear)" CURVE 0x8052F08C RB_Curve_S16_S16 655.3500 Vel -327.6800 327.6700 FORMAT "%8.4"
 /begin AXIS_DESCR STD_AXIS LLim_vDes_mp Vel 12 -327.6800 327.6700 FORMAT "%8.4" DEPOSIT ABSOLUTE /end AXIS_DESCR
/end CHARACTERISTIC
/begin CHARACTERISTIC LLim_vSptRPntHysHi2LG_CUR "Curve for ASL Vehicle spped for RP (hysteresis Hi) value for sport mode ( for 2 level lower gear)" CURVE 0x8052F0BE RB_Curve_S16_S16 655.3500 Vel -327.6800 327.6700 FORMAT "%8.4"
 /begin AXIS_DESCR STD_AXIS LLim_vDes_mp Vel 12 -327.6800 327.6700 FORMAT "%8.4" DEPOSIT ABSOLUTE /end AXIS_DESCR
/end CHARACTERISTIC
/begin CHARACTERISTIC LLim_vSptRPntHysHi3LG_CUR "Curve for ASL Vehicle spped for RP (hysteresis Hi) value for sport mode ( for 3 level lower gear)" CURVE 0x8052F0F0 RB_Curve_S16_S16 655.3500 Vel -327.6800 327.6700 FORMAT "%8.4"
 /begin AXIS_DESCR STD_AXIS LLim_vDes_mp Vel 12 -327.6800 327.6700 FORMAT "%8.4" DEPOSIT ABSOLUTE /end AXIS_DESCR
/end CHARACTERISTIC
/begin CHARACTERISTIC LLim_vSptRPntHysHi4LG_CUR "Curve for ASL Vehicle spped for RP (hysteresis Hi) value for sport mode ( for 4 level lower gear)" CURVE 0x8052F122 RB_Curve_S16_S16 655.3500 Vel -327.6800 327.6700 FORMAT "%8.4"
 /begin AXIS_DESCR STD_AXIS LLim_vDes_mp Vel 12 -327.6800 327.6700 FORMAT "%8.4" DEPOSIT ABSOLUTE /end AXIS_DESCR
/end CHARACTERISTIC
/begin CHARACTERISTIC LLim_vSptRPntHysHi5LG_CUR "Curve for ASL Vehicle spped for RP (hysteresis Hi) value for sport mode ( for 5 level lower gear)" CURVE 0x8052F154 RB_Curve_S16_S16 655.3500 Vel -327.6800 327.6700 FORMAT "%8.4"
 /begin AXIS_DESCR STD_AXIS LLim_vDes_mp Vel 12 -327.6800 327.6700 FORMAT "%8.4" DEPOSIT ABSOLUTE /end AXIS_DESCR
/end CHARACTERISTIC
/begin CHARACTERISTIC LLim_vSptRPntHysHiTG_CUR "Curve for ASL Vehicle spped for RP (hysteresis Hi) value for sport mode ( for the top gear)" CURVE 0x8052F186 RB_Curve_S16_S16 655.3500 Vel -327.6800 327.6700 FORMAT "%8.4"
 /begin AXIS_DESCR STD_AXIS LLim_vDes_mp Vel 12 -327.6800 327.6700 FORMAT "%8.4" DEPOSIT ABSOLUTE /end AXIS_DESCR
/end CHARACTERISTIC
/begin CHARACTERISTIC LLim_vSptRPntHysLo1LG_CUR "Curve for ASL Vehicle spped for RP (hysteresis Lo) value for sport mode ( for 1 level lower gear)" CURVE 0x8052F1B8 RB_Curve_S16_S16 655.3500 Vel -327.6800 327.6700 FORMAT "%8.4"
 /begin AXIS_DESCR STD_AXIS LLim_vDes_mp Vel 12 -327.6800 327.6700 FORMAT "%8.4" DEPOSIT ABSOLUTE /end AXIS_DESCR
/end CHARACTERISTIC
/begin CHARACTERISTIC LLim_vSptRPntHysLo2LG_CUR "Curve for ASL Vehicle spped for RP (hysteresis Lo) value for sport mode ( for 2 level lower gear)" CURVE 0x8052F1EA RB_Curve_S16_S16 655.3500 Vel -327.6800 327.6700 FORMAT "%8.4"
 /begin AXIS_DESCR STD_AXIS LLim_vDes_mp Vel 12 -327.6800 327.6700 FORMAT "%8.4" DEPOSIT ABSOLUTE /end AXIS_DESCR
/end CHARACTERISTIC
/begin CHARACTERISTIC LLim_vSptRPntHysLo3LG_CUR "Curve for ASL Vehicle spped for RP (hysteresis Lo) value for sport mode ( for 3 level lower gear)" CURVE 0x8052F21C RB_Curve_S16_S16 655.3500 Vel -327.6800 327.6700 FORMAT "%8.4"
 /begin AXIS_DESCR STD_AXIS LLim_vDes_mp Vel 12 -327.6800 327.6700 FORMAT "%8.4" DEPOSIT ABSOLUTE /end AXIS_DESCR
/end CHARACTERISTIC
/begin CHARACTERISTIC LLim_vSptRPntHysLo4LG_CUR "Curve for ASL Vehicle spped for RP (hysteresis Lo) value for sport mode ( for 4 level lower gear)" CURVE 0x8052F24E RB_Curve_S16_S16 655.3500 Vel -327.6800 327.6700 FORMAT "%8.4"
 /begin AXIS_DESCR STD_AXIS LLim_vDes_mp Vel 12 -327.6800 327.6700 FORMAT "%8.4" DEPOSIT ABSOLUTE /end AXIS_DESCR
/end CHARACTERISTIC
/begin CHARACTERISTIC LLim_vSptRPntHysLo5LG_CUR "Curve for ASL Vehicle spped for RP (hysteresis Lo) value for sport mode ( for 5 level lower gear)" CURVE 0x8052F280 RB_Curve_S16_S16 655.3500 Vel -327.6800 327.6700 FORMAT "%8.4"
 /begin AXIS_DESCR STD_AXIS LLim_vDes_mp Vel 12 -327.6800 327.6700 FORMAT "%8.4" DEPOSIT ABSOLUTE /end AXIS_DESCR
/end CHARACTERISTIC
/begin CHARACTERISTIC LLim_vSptRPntHysLoTG_CUR "Curve for ASL Vehicle spped for RP (hysteresis Lo) value for sport mode ( for the top gear)" CURVE 0x8052F2B2 RB_Curve_S16_S16 655.3500 Vel -327.6800 327.6700 FORMAT "%8.4"
 /begin AXIS_DESCR STD_AXIS LLim_vDes_mp Vel 12 -327.6800 327.6700 FORMAT "%8.4" DEPOSIT ABSOLUTE /end AXIS_DESCR
/end CHARACTERISTIC
/begin CHARACTERISTIC LLim_vStrtSpdDvt_C "Vehicle speed deviation value for ASL start check" VALUE 0x8052F2E4 Val_Ws16 655.3500 Vel -327.6800 327.6700 FORMAT "%8.4" /end CHARACTERISTIC
/begin CHARACTERISTIC LLim_vTmpRelsAlrmDif_C "Sound alarm if difference between current velocity and set velocity is greater than this value." VALUE 0x8052F2E6 Val_Ws16 655.3500 Vel -327.6800 327.6700 FORMAT "%8.4" /end CHARACTERISTIC
/begin CHARACTERISTIC LLRMR_facTqResvHeatrReq_M "Weighting factor for torque reserve for engine heat up (non-idle)" MAP 0x805281A6 RB_Map_S16U16_U16 327.6750 fak_q0p005 0.00 327.6750 FORMAT "%8.4"
 /begin AXIS_DESCR STD_AXIS Epm_nEng EngN 6 -16384.00 16383.50 FORMAT "%8.2" DEPOSIT ABSOLUTE /end AXIS_DESCR
 /begin AXIS_DESCR STD_AXIS rl_w_msg rel_q0p0234 8 0.00 1535.977 FORMAT "%8.3" DEPOSIT ABSOLUTE /end AXIS_DESCR
/end CHARACTERISTIC
/begin CHARACTERISTIC LLRMR_facTqResvIdleBrkNotActv_M "Torque reserve factor for open powertrain when brake not active" MAP 0x80528226 RB_Map_U8S16_U8 3.984 fak_ub_b4 0.00 3.984 FORMAT "%5.3"
 /begin AXIS_DESCR STD_AXIS LLRMR_vfzg_tmp vfzg_ub_q1p25 8 0.00 318.8 FORMAT "%5.1" DEPOSIT ABSOLUTE /end AXIS_DESCR
 /begin AXIS_DESCR STD_AXIS PT_rTrq TransR 8 -327.6800 327.6700 FORMAT "%8.4" DEPOSIT ABSOLUTE /end AXIS_DESCR
/end CHARACTERISTIC
/begin CHARACTERISTIC LLRMR_facTqResvIdle_M "Torque reserve factor for open powertrain" MAP 0x80528280 RB_Map_U8S8_U8 3.984 fak_ub_b4 0.00 3.984 FORMAT "%5.3"
 /begin AXIS_DESCR STD_AXIS LLRMR_vfzg_tmp vfzg_ub_q1p25 8 0.00 318.8 FORMAT "%5.1" DEPOSIT ABSOLUTE /end AXIS_DESCR
 /begin AXIS_DESCR STD_AXIS Tra_numGear OneToOne 8 -128.0 127.0 FORMAT "%5.1" DEPOSIT ABSOLUTE /end AXIS_DESCR
/end CHARACTERISTIC
/begin CHARACTERISTIC LLRMR_nIdleTqResvThd_C "engine speed threshold to activate the factor for torque reserve at idle" VALUE 0x805282D2 RB_Val_Wu16 16383.75 nmot_uw_q0p25 0.00 16383.75 FORMAT "%8.2" /end CHARACTERISTIC
/begin CHARACTERISTIC LLRMR_nMinNThdRst_C "Engine speed threshold for reset of torque reserve during engine shut off" VALUE 0x805282D4 RB_Val_Wu8 10200. nmot_ub_q40 0.00 10200. FORMAT "%5.0" /end CHARACTERISTIC
/begin CHARACTERISTIC LLRMR_percEngGrdtDwnRmp_C "Decrement to reduce the torque reserve depending on engine speed gradient" VALUE 0x805282D6 RB_Val_Wu16 99.99847 rel_uw_b100 0.00 99.99847 FORMAT "%8.5" /end CHARACTERISTIC
/begin CHARACTERISTIC LLRMR_percTqResvEngGrdt_MAP "Map for the torque reserve depending on engine speed gradient" MAP 0x805282D8 RB_Map_S16S16_U16 99.99847 rel_uw_b100 0.00 99.99847 FORMAT "%8.5"
 /begin AXIS_DESCR STD_AXIS Epm_dnEngFlt EngNGrd 8 -16384.00 16383.50 FORMAT "%8.2" DEPOSIT ABSOLUTE /end AXIS_DESCR
 /begin AXIS_DESCR STD_AXIS LLRMR_dns_temp nmot_sw_q0p5 4 -16384.00 16383.50 FORMAT "%8.2" DEPOSIT ABSOLUTE /end AXIS_DESCR
/end CHARACTERISTIC
/begin CHARACTERISTIC LLRMR_percTqResvHeatrReq_M "Torque reserve for improved engine heat up (non-idle)" MAP 0x80528334 RB_Map_S16S16_U16 99.99847 rel_uw_b100 0.00 99.99847 FORMAT "%8.5"
 /begin AXIS_DESCR STD_AXIS WaHt_tDeltaEngT Temp_Cels 6 -3549.940 3003.560 FORMAT "%8.3" DEPOSIT ABSOLUTE /end AXIS_DESCR
 /begin AXIS_DESCR STD_AXIS EnvT_t Temp_Cels 6 -3549.940 3003.560 FORMAT "%8.3" DEPOSIT ABSOLUTE /end AXIS_DESCR
/end CHARACTERISTIC
/begin CHARACTERISTIC LLRMR_percTqResvMin_C "Torque reserve in case of minimum ignition angle effectiveness is zero" VALUE 0x80528398 RB_Val_Wu16 99.99847 rel_uw_b100 0.00 99.99847 FORMAT "%8.5" /end CHARACTERISTIC
/begin CHARACTERISTIC LLRMR_percTqResvThdDrv_C "Threshold for drivers torque wish to ramp the non idle torque reserve" VALUE 0x8052839A RB_Val_Wu16 99.99847 rel_uw_b100 0.00 99.99847 FORMAT "%8.5" /end CHARACTERISTIC
/begin CHARACTERISTIC LLRMR_slopeNegTqResv_C "Negative slope for torque reserve in non idle" VALUE 0x8052839C RB_Val_Ws32 99999.9999767 q2p32831_Perc_DIV_s -50000.0000000 49999.9999767 FORMAT "%13.7" /end CHARACTERISTIC
/begin CHARACTERISTIC LLRMR_slopePosTqResv_C "Positive slope for torque reserve in non idle" VALUE 0x805283A0 RB_Val_Ws32 99999.9999767 q2p32831_Perc_DIV_s -50000.0000000 49999.9999767 FORMAT "%13.7" /end CHARACTERISTIC
/begin CHARACTERISTIC LLRMR_stCluOpnCmpl_C "bit used for the sensitivity of the clutch state in case of large movements of the clutch pedal" VALUE 0x805283A4 RB_Val_Wu8 7.000 dez 0.00 7.000 FORMAT "%5.3" EXTENDED_LIMITS 0.00 255.0 /end CHARACTERISTIC
/begin CHARACTERISTIC LLRMR_stCluOpnNotCmpl_C "bit used for the sensitivity of the clutch state in case of small movements of the clutch pedal" VALUE 0x805283A5 RB_Val_Wu8 7.000 dez 0.00 7.000 FORMAT "%5.3" EXTENDED_LIMITS 0.00 255.0 /end CHARACTERISTIC
/begin CHARACTERISTIC LLRMR_swtFltSeln_C "Filtered Engine speed gradient selection switch" VALUE 0x805283A6 RB_Val_Wu8 255.0 OneToOne 0.00 255.0 FORMAT "%5.1" /end CHARACTERISTIC
/begin CHARACTERISTIC LLRMR_tCatMaxActvt_C "Upper limit for maximum catalyst temperature for activation of hysteresis at sportive mode" VALUE 0x805283A8 RB_Val_Ws16 3276.700 Temp_Cels -273.140 3003.560 FORMAT "%8.3" EXTENDED_LIMITS -3549.940 3003.560 /end CHARACTERISTIC
/begin CHARACTERISTIC LLRMR_tCatMaxDeactvt_C "Lower limit for maximum catalyst temperature for deactivation of hysteresis at sportive mode" VALUE 0x805283AA RB_Val_Ws16 3276.700 Temp_Cels -273.140 3003.560 FORMAT "%8.3" EXTENDED_LIMITS -3549.940 3003.560 /end CHARACTERISTIC
/begin CHARACTERISTIC LLRMR_tiDlyRmpEngGrdt_C "Hold time for the torque reserve depending on engine speed gradient" VALUE 0x805283AC RB_Val_Wu16 1310.700 t_q0p02 0.00 1310.700 FORMAT "%8.3" /end CHARACTERISTIC
/begin CHARACTERISTIC LLRMR_tMinTqResvActv_C "engine temper threshold to activate the factor for torque reserve at idle" VALUE 0x805283AE RB_Val_Wu8 191.3 temp_ub_q0p75_o48 -48.0 143.3 FORMAT "%5.1" /end CHARACTERISTIC
/begin CHARACTERISTIC LLRNSNF_flgSwtNGrdt_C "flag for filtered engine speed gradient switch" VALUE 0x80528478 RB_Val_Wboolean 1.00000000000 B_TRUE 0.00 1.00000000000 FORMAT "%13.11" /end CHARACTERISTIC
/begin AXIS_PTS LLRNSNF_nSpLoDiff_X_Ax "Datapoint distribution, set-speed deviation, 06 datapoints., idle-speed control." 0x80528479 llrnsnf_sns06llsbLoc RB_Axis_S8 2550. nmotd_sb_q10 6 -1280. 1270. FORMAT "%5.0" DEPOSIT ABSOLUTE /end AXIS_PTS
/begin CHARACTERISTIC LLRNSTAT_nOffsIgnAgnlFix_C "Offset for ignition angle cutoff" VALUE 0x8052849A RB_Val_Ws16 32767.50 nmot_sw_q0p5 -16384.00 16383.50 FORMAT "%8.2" /end CHARACTERISTIC
/begin CHARACTERISTIC LLRNSTAT_nThrIceAdh_M "Idle speed set-point when ice adhesion at throttle valve" MAP 0x8052849C RB_MapGroup_S16 32767.50 nmot_sw_q0p5 -16384.00 16383.50 FORMAT "%8.2"
 /begin AXIS_DESCR COM_AXIS tmot_llrnstat_loc temp_ub_q0p75_o48 6 -48.0 143.3 FORMAT "%5.1" AXIS_PTS_REF STM06LLUB_LLRNSTAT /end AXIS_DESCR
 /begin AXIS_DESCR COM_AXIS gangsist_llrnstat_loc dez 9 -128.0 127.0 FORMAT "%5.1" AXIS_PTS_REF SGA09LLSB /end AXIS_DESCR
/end CHARACTERISTIC
/begin CHARACTERISTIC LLRNSTAT_tiPT1HvyDecel1_C "Time constant 1 for deceleration" VALUE 0x80528508 RB_Val_Wu16 1310.6999997 zk20msxs_uw_b1310 0.0200003 1310.7200000 FORMAT "%12.7" EXTENDED_LIMITS 0.020000305180 1310.7200000 /end CHARACTERISTIC
/begin CHARACTERISTIC LLRNSTAT_tiPT1HvyDecel2_C "Time constant 2 during decelaration" VALUE 0x8052850A RB_Val_Wu16 1310.6999997 zk20msxs_uw_b1310 0.0200003 1310.7200000 FORMAT "%12.7" EXTENDED_LIMITS 0.020000305180 1310.7200000 /end CHARACTERISTIC
/begin CHARACTERISTIC MRENSTA "Offset of the engine speed for the activation of underspeed detection to increase the torque reserve" VALUE 0x805283AF RB_Val_Wu8 10200. nmot_ub_q40 0.00 10200. FORMAT "%5.0" /end CHARACTERISTIC
/begin CHARACTERISTIC MRESHH "Torque reserve during rear window heating." VALUE 0x805283B0 RB_Val_Wu8 24.90 rel_ub_b25 0.00 24.90 FORMAT "%5.2" /end CHARACTERISTIC
/begin CHARACTERISTIC MRESUB "additional torque reserve for undervoltage" VALUE 0x805283B1 RB_Val_Wu8 24.90 rel_ub_b25 0.00 24.90 FORMAT "%5.2" /end CHARACTERISTIC
/begin CHARACTERISTIC NFSMIN "Minimal allowed engine speed at idle with AT in drive" VALUE 0x8052850C RB_Val_Wu8 2550. nmot_ub_q10 0.00 2550. FORMAT "%5.0" /end CHARACTERISTIC
/begin CHARACTERISTIC NGNSNF "Threshold of speed gradient for starting dynamic target idle speed calculation" VALUE 0x80528480 RB_Val_Wu8 25500. nmotg_ub_q100 0.00 25500. FORMAT "%5.0" /end CHARACTERISTIC
/begin CHARACTERISTIC NLLMG "desired engine speed" MAP 0x8052850D RB_MapGroup_U8 2550. nmot_ub_q10 0.00 2550. FORMAT "%5.0"
 /begin AXIS_DESCR COM_AXIS tmot_llrnstat_loc temp_ub_q0p75_o48 6 -48.0 143.3 FORMAT "%5.1" AXIS_PTS_REF STM06LLUB_LLRNSTAT /end AXIS_DESCR
 /begin AXIS_DESCR COM_AXIS gangsist_llrnstat_loc dez 9 -128.0 127.0 FORMAT "%5.1" AXIS_PTS_REF SGA09LLSB /end AXIS_DESCR
/end CHARACTERISTIC
/begin CHARACTERISTIC NLLMGFS "desired idle speed in Drive-mode" MAP 0x80528543 RB_MapGroup_U8 2550. nmot_ub_q10 0.00 2550. FORMAT "%5.0"
 /begin AXIS_DESCR COM_AXIS tmot_llrnstat_loc temp_ub_q0p75_o48 6 -48.0 143.3 FORMAT "%5.1" AXIS_PTS_REF STM06LLUB_LLRNSTAT /end AXIS_DESCR
 /begin AXIS_DESCR COM_AXIS gangsist_llrnstat_loc dez 9 -128.0 127.0 FORMAT "%5.1" AXIS_PTS_REF SGA09LLSB /end AXIS_DESCR
/end CHARACTERISTIC
/begin CHARACTERISTIC NLLMIN "Minimal allowed engine speed at idle" VALUE 0x80528579 RB_Val_Wu8 2550. nmot_ub_q10 0.00 2550. FORMAT "%5.0" /end CHARACTERISTIC
/begin CHARACTERISTIC NSOLMX_W "maximum limitation of target idle speed" VALUE 0x80528482 RB_Val_Ws16 16383.50 nmot_sw_q0p5 0.00 16383.50 FORMAT "%8.2" EXTENDED_LIMITS -16384.00 16383.50 /end CHARACTERISTIC
/begin CHARACTERISTIC NTIPLL "speed limit for TIP-IN" VALUE 0x8052857A RB_Val_Wu8 10200. nmot_ub_q40 0.00 10200. FORMAT "%5.0" /end CHARACTERISTIC
/begin CHARACTERISTIC SDLLRMR "Engine speed threshold to deactivate the torque reserve for engine speed control" VALUE 0x805283B2 RB_Val_Wu8 10200. nmot_ub_q40 0.00 10200. FORMAT "%5.0" /end CHARACTERISTIC
/begin AXIS_PTS SGA09LLSB "distribution for gear information in idle speed controller" 0x8052857B gangsist_llrnstat_loc RB_Axis_S8 255.0 dez 9 -128.0 127.0 FORMAT "%5.1" DEPOSIT ABSOLUTE /end AXIS_PTS
/begin AXIS_PTS SMI04LLUBL "distribution: ind. torque for torque-reserve" 0x805283B4 LLRMR_mifa_w_tmp RB_Axis_U16 99.99847 rel_uw_b100 8 0.00 99.99847 FORMAT "%8.5" DEPOSIT ABSOLUTE /end AXIS_PTS
/begin AXIS_PTS SNM06LLUWL "distribution of engine speed" 0x805283C6 LLRMR_nmotw_tmp RB_Axis_U16 16383.75 nmot_uw_q0p25 8 0.00 16383.75 FORMAT "%8.2" DEPOSIT ABSOLUTE /end AXIS_PTS
/begin AXIS_PTS SNS06LLSBL "Datapoint distribution, set-speed deviation, 06 datapoints., idle-speed control." 0x805283D8 LLRMR_dns_temp RB_Axis_S16 32767.50 nmot_sw_q0p5 6 -16384.00 16383.50 FORMAT "%8.2" DEPOSIT ABSOLUTE /end AXIS_PTS
/begin AXIS_PTS STA04LLUBL "distribution: tans for torque resreve" 0x805283E6 LLRMR_tans_temp RB_Axis_U8 191.3 temp_ub_q0p75_o48 4 -48.0 143.3 FORMAT "%5.1" DEPOSIT ABSOLUTE /end AXIS_PTS
/begin AXIS_PTS STM04SAUBL "Datapoint distribution, engine temperature, 4 datapoints" 0x805283EB LLRMR_tmot_tmp RB_Axis_U8 191.3 temp_ub_q0p75_o48 4 -48.0 143.3 FORMAT "%5.1" DEPOSIT ABSOLUTE /end AXIS_PTS
/begin AXIS_PTS STM06LLUBL "Datapoint distribution, engine temperature, 6 datapoints" 0x80528484 llrnsnf_stm06llublLoc RB_Axis_U8 191.3 temp_ub_q0p75_o48 6 -48.0 143.3 FORMAT "%5.1" DEPOSIT ABSOLUTE /end AXIS_PTS
/begin AXIS_PTS STM06LLUB_LLRNSTAT "Datapoint distribution, engine temperature, 6 datapoints" 0x80528585 tmot_llrnstat_loc RB_Axis_U8 191.3 temp_ub_q0p75_o48 6 -48.0 143.3 FORMAT "%5.1" DEPOSIT ABSOLUTE /end AXIS_PTS
/begin AXIS_PTS STS08ESUBL "Distribution for engine coolant temperature at start" 0x8052848B tmst_llrnsnf_loc RB_Axis_U8 191.3 temp_ub_q0p75_o48 8 -48.0 143.3 FORMAT "%5.1" DEPOSIT ABSOLUTE /end AXIS_PTS
/begin CHARACTERISTIC TDDEANF "turn-on delay: deacitvation speed tracking" VALUE 0x80528494 RB_Val_Wu8 2.550 t_q0p01 0.00 2.550 FORMAT "%5.3" /end CHARACTERISTIC
/begin CHARACTERISTIC TDDMRLLR "time constant for filter torque reserve" CURVE 0x805283F0 RB_Curve_U16_U16 1310.680 t_q0p02 0.020 1310.700 FORMAT "%8.3" EXTENDED_LIMITS 0.00 1310.700
 /begin AXIS_DESCR STD_AXIS ddmrllr_w rel_uw_b100 3 0.00 99.99847 FORMAT "%8.5" DEPOSIT ABSOLUTE /end AXIS_DESCR
/end CHARACTERISTIC
/begin CHARACTERISTIC TDMRESHH "Hold time for the increased torque reserve after rear window heating request." VALUE 0x805283FE RB_Val_Wu8 5.100 t_q0p02 0.00 5.100 FORMAT "%5.3" /end CHARACTERISTIC
/begin CHARACTERISTIC TDMRESLW "Inhibition time for the increased torque reserve after engine start" VALUE 0x80528400 RB_Val_Wu16 655.3500 t10msxs_uw_b655p35 0.00 655.3500 FORMAT "%8.4" /end CHARACTERISTIC
/begin CHARACTERISTIC TDMRESUB "Hold time for increased torque reserve after battery voltage drop" VALUE 0x80528402 RB_Val_Wu8 5.100 t_q0p02 0.00 5.100 FORMAT "%5.3" /end CHARACTERISTIC
/begin CHARACTERISTIC TDSIGNHH "Inhibition time for increased torque reserve after rear window heating request." VALUE 0x80528403 RB_Val_Wu8 5.100 t_q0p02 0.00 5.100 FORMAT "%5.3" /end CHARACTERISTIC
/begin CHARACTERISTIC TDUBSQ "Hold time for increased torque reserve after battery voltage drop" VALUE 0x80528404 RB_Val_Wu8 5.100 t_q0p02 0.00 5.100 FORMAT "%5.3" /end CHARACTERISTIC
/begin CHARACTERISTIC TDUBSTND "Time delay for activation of torque reserve after battery voltage drop after start" VALUE 0x80528406 RB_Val_Wu16 655.3500 t10msxs_uw_b655p35 0.00 655.3500 FORMAT "%8.4" /end CHARACTERISTIC
/begin CHARACTERISTIC TVGRMR "Delay time for gear at torque reserve after speed undershoot" VALUE 0x80528408 RB_Val_Wu8 5.100 t20msxs_ub_b5p1 0.00 5.100 FORMAT "%5.3" /end CHARACTERISTIC
/begin CHARACTERISTIC TVRESLL "Hold time for increased torque reserve after engine speed drop" VALUE 0x8052840A RB_Val_Wu16 1310.700 t_q0p02 0.00 1310.700 FORMAT "%8.3" /end CHARACTERISTIC
/begin CHARACTERISTIC VANF "Speed threshold for approach support" VALUE 0x8052840C RB_Val_Wu8 318.8 vfzg_ub_q1p25 0.00 318.8 FORMAT "%5.1" /end CHARACTERISTIC
/begin CHARACTERISTIC ZKDMRUB "time constant for battery voltage filter" VALUE 0x8052840E RB_Val_Wu16 1310.680 t_q0p02 0.020 1310.700 FORMAT "%8.3" EXTENDED_LIMITS 0.00 1310.700 /end CHARACTERISTIC
/begin CHARACTERISTIC ZKDMRUBF "time constant for battery voltage filter(faster)" VALUE 0x80528410 RB_Val_Wu16 1310.680 t_q0p02 0.020 1310.700 FORMAT "%8.3" EXTENDED_LIMITS 0.00 1310.700 /end CHARACTERISTIC
/begin CHARACTERISTIC ZKNSU_W "Time constant for target engine speed when changing target (rising)" VALUE 0x8052858C RB_Val_Wu16 1310.6999997 zk20msxs_uw_b1310 0.0200003 1310.7200000 FORMAT "%12.7" EXTENDED_LIMITS 0.020000305180 1310.7200000 /end CHARACTERISTIC
/begin CHARACTERISTIC ZKNS_W "Time constant for target engine speed when changing target" VALUE 0x8052858E RB_Val_Wu16 1310.6999997 zk20msxs_uw_b1310 0.0200003 1310.7200000 FORMAT "%12.7" EXTENDED_LIMITS 0.020000305180 1310.7200000 /end CHARACTERISTIC
/begin MEASUREMENT B_brufs_msg "Condition drive and brake activated, combined" UBYTE B_TRUE 1 100 0.00 1.00000000000 BIT_MASK 0x1 FORMAT "%13.11" ECU_ADDRESS 0x70000AA9 /end MEASUREMENT
/begin MEASUREMENT B_freezenf_msg "condition: deactivating speed tracking" UBYTE B_TRUE 1 100 0.00 1.00000000000 BIT_MASK 0x1 FORMAT "%13.11" ECU_ADDRESS 0x6000A23B /end MEASUREMENT
/begin MEASUREMENT B_kuplaus "Clutch is pressed: Powertrain is open" UBYTE B_TRUE 1 100 0.00 1.00000000000 BIT_MASK 0x1 FORMAT "%13.11" ECU_ADDRESS 0x600063B6 /end MEASUREMENT
/begin MEASUREMENT B_llde_msg "Condition speed undershoot" UBYTE B_TRUE 1 100 0.00 1.00000000000 BIT_MASK 0x1 FORMAT "%13.11" ECU_ADDRESS 0x6000A237 /end MEASUREMENT
/begin MEASUREMENT B_tpn_msg "Condition Tip_In" UBYTE B_TRUE 1 100 0.00 1.00000000000 BIT_MASK 0x1 FORMAT "%13.11" ECU_ADDRESS 0x70000979 /end MEASUREMENT
/begin MEASUREMENT B_zwafh_msg "enabling spark operation for vehicle drive-up-support" UBYTE B_TRUE 1 100 0.00 1.00000000000 BIT_MASK 0x1 FORMAT "%13.11" ECU_ADDRESS 0x6000A22A /end MEASUREMENT
/begin MEASUREMENT ddmrllr_w "delta of torque reserve for idle speed control" UWORD rel_uw_b100 1 100 0.00 99.99847 FORMAT "%8.5" ECU_ADDRESS 0x6000D9B2 /end MEASUREMENT
/begin MEASUREMENT dmralt "offset torque based on altitude" UBYTE rel_ub_b25 1 100 0.00 24.90 FORMAT "%5.2" ECU_ADDRESS 0x6000E3BC /end MEASUREMENT
/begin MEASUREMENT dmrdiaiv_w "Offset torque reserve at small injection time" UWORD rel_uw_b100 1 100 0.00 99.99847 FORMAT "%8.5" ECU_ADDRESS 0x6000D9B6 /end MEASUREMENT
/begin MEASUREMENT dmrenher_w "torque reserve for improving the engine heating" UWORD rel_uw_b100 1 100 0.00 99.99847 FORMAT "%8.5" ECU_ADDRESS 0x6000371E /end MEASUREMENT
/begin MEASUREMENT dmresb_w "Basic torque reserve at idle" UWORD rel_uw_b100 1 100 0.00 99.99847 FORMAT "%8.5" ECU_ADDRESS 0x6000371C /end MEASUREMENT
/begin MEASUREMENT dmresll_w_msg "Increased torque reserve at idle after speed undershoot" UWORD rel_q0p00153 1 100 0.00 99.99847 FORMAT "%8.5" ECU_ADDRESS 0x60004C14 /end MEASUREMENT
/begin MEASUREMENT dmresubg "Highest detected undervolage for calculation of the torque reserves" UWORD spg_q0p00039 1 100 0.00 25.59961 FORMAT "%8.5" ECU_ADDRESS 0x6000371A /end MEASUREMENT
/begin MEASUREMENT dmresub_mp "Measuring point of offset reserve for under voltage" UWORD rel_q0p00153 1 100 0.00 99.99847 FORMAT "%8.5" ECU_ADDRESS 0x70008C2E /end MEASUREMENT
/begin MEASUREMENT dmrllr_w_msg "torque reserve for idle speed control" UWORD rel_uw_b100 1 100 0.00 99.99847 FORMAT "%8.5" ECU_ADDRESS 0x60004C12 /end MEASUREMENT
/begin MEASUREMENT gangllrs_msg "gear information for idle speed determination" SBYTE dez 1 100 -128.0 127.0 FORMAT "%5.1" ECU_ADDRESS 0x6000A106 /end MEASUREMENT
/begin MEASUREMENT gangsist_llrnsnf_loc "Current gear" SBYTE dez 1 100 -128.0 127.0 FORMAT "%5.1" ECU_ADDRESS 0x600063AE /end MEASUREMENT
/begin MEASUREMENT gangsist_llrnstat_loc "Current gear" SBYTE dez 1 100 -128.0 127.0 FORMAT "%5.1" ECU_ADDRESS 0x600063A6 /end MEASUREMENT
/begin MEASUREMENT HLSDem_nMinWoCat "idle speed setpoint without catalyst heating" SWORD nmot_sw_q0p5 1 100 -16384.00 16383.50 FORMAT "%8.2" ECU_ADDRESS 0x60005034 /end MEASUREMENT
/begin MEASUREMENT HLSDem_nMinWoTraIntv "CAN - Adapter" SWORD nmot_sw_q0p5 1 100 -16384.00 16383.50 FORMAT "%8.2" ECU_ADDRESS 0x60005032 /end MEASUREMENT
/begin MEASUREMENT HLSDem_nSetPLo "Effective steady-state idle speed" SWORD nmot_sw_q0p5 1 100 -16384.00 16383.50 FORMAT "%8.2" ECU_ADDRESS 0x50005AC6 /end MEASUREMENT
/begin MEASUREMENT HLSDem_nSetPLoDiff "LLR: difference of idle speed precontrol" SWORD nmot_sw_q0p5 1 100 -16384.00 16383.50 FORMAT "%8.2" ECU_ADDRESS 0x6000E288 /end MEASUREMENT
/begin MEASUREMENT HLSDem_nSetPTrck "Idle reference speed" SWORD nmot_sw_q0p5 1 100 -16384.00 16383.50 FORMAT "%8.2" ECU_ADDRESS 0x6000E28A /end MEASUREMENT
/begin MEASUREMENT HLSDem_nStatyEng "Stationary reference speed for V-engine" UBYTE nmot_ub_q10 1 100 0.00 2550. FORMAT "%5.0" ECU_ADDRESS 0x6000A3A2 /end MEASUREMENT
/begin MEASUREMENT HLSDem_nStyFildIdle "Stationary reference speed filtered" SWORD nmot_sw_q0p5 1 100 -16384.00 16383.50 FORMAT "%8.2" ECU_ADDRESS 0x6000502C /end MEASUREMENT
/begin MEASUREMENT LLim_ctASLAppATOpenLrn_mp "Status for temporary release of APP limitation" UBYTE OneToOne 1 100 0.00 255.0 FORMAT "%5.1" ECU_ADDRESS 0x70008D08 /end MEASUREMENT
/begin MEASUREMENT LLim_facAcclP_mp "Factor of acceleration control P coefficient" SWORD Fact_CrCtl2 1 100 -512.0000 511.9844 FORMAT "%8.4" ECU_ADDRESS 0x70008D06 /end MEASUREMENT
/begin MEASUREMENT LLim_facAcclShutOff_mp "Factor of shut off correction for accelerate speed control" SWORD Fact_CrCtl2 1 100 -512.0000 511.9844 FORMAT "%8.4" ECU_ADDRESS 0x70008D04 /end MEASUREMENT
/begin MEASUREMENT LLim_facAPPDiffCor_mp "Correction factor based on difference of accel pedal position" SWORD Fact1 1 100 -256.0000 255.9922 FORMAT "%8.4" ECU_ADDRESS 0x70008D02 /end MEASUREMENT
/begin MEASUREMENT LLim_facConstD_mp "Factor of constant speed control D coefficient" SWORD Fact_CrCtl2 1 100 -512.0000 511.9844 FORMAT "%8.4" ECU_ADDRESS 0x70008D00 /end MEASUREMENT
/begin MEASUREMENT LLim_facConstP_mp "Factor of constant speed control P coefficient" SWORD Fact_CrCtl3 1 100 -32.00000 31.99902 FORMAT "%8.5" ECU_ADDRESS 0x70008CFE /end MEASUREMENT
/begin MEASUREMENT LLim_facConstShutOff_mp "Factor of shut off correction for constant speed control" SWORD Fact_CrCtl2 1 100 -512.0000 511.9844 FORMAT "%8.4" ECU_ADDRESS 0x70008CFC /end MEASUREMENT
/begin MEASUREMENT LLim_flgASLCtrlTmpHalt "Flag during ASL control temporarily halt" UBYTE OneToOne 1 100 0.00 1.000 FORMAT "%5.3" ECU_ADDRESS 0x6000A37D /end MEASUREMENT
/begin MEASUREMENT LLim_flgASLOverSpd "Flag during ASL overspeed" UBYTE OneToOne 1 100 0.00 1.000 FORMAT "%5.3" ECU_ADDRESS 0x6000A37C /end MEASUREMENT
/begin MEASUREMENT LLim_flgISAOccUnitChg "Status of occurrence of kph mph unit changing" UBYTE OneToOne 1 100 0.00 1.000 FORMAT "%5.3" ECU_ADDRESS 0x60000C1A /end MEASUREMENT
/begin MEASUREMENT LLim_flgMemDisp "Memory display function existance" UBYTE OneToOne 1 100 0.00 1.000 FORMAT "%5.3" ECU_ADDRESS 0x6000A37B /end MEASUREMENT
/begin MEASUREMENT LLim_numMETAlrm "Number of indicate meter display alarm" UBYTE OneToOne 1 100 0.00 255.0 FORMAT "%5.1" ECU_ADDRESS 0x6000A37A /end MEASUREMENT
/begin MEASUREMENT LLim_numMETDspSelOld_mp "Old value of LLim_numMETDspSel_mp" UBYTE OneToOne 1 100 0.00 255.0 FORMAT "%5.1" ECU_ADDRESS 0x70008CFA /end MEASUREMENT
/begin MEASUREMENT LLim_numMETDspSel_mp "Selection number of meter display" UBYTE OneToOne 1 100 0.00 255.0 FORMAT "%5.1" ECU_ADDRESS 0x70008CF9 /end MEASUREMENT
/begin MEASUREMENT LLim_numMETMemSpd "Number of memory vehicle speed for meter display in ASL" SWORD OneToOne 1 100 -32768.00 32767.00 FORMAT "%8.2" ECU_ADDRESS 0x6000500A /end MEASUREMENT
/begin MEASUREMENT LLim_numMETSpdBlnOld_mp "Previous number to select how to blink display speed for ASL" UBYTE OneToOne 1 100 0.00 255.0 FORMAT "%5.1" ECU_ADDRESS 0x70008CF8 /end MEASUREMENT
/begin MEASUREMENT LLim_numMETSpdBln_mp "Number to select how to blink display speed for ASL" UBYTE OneToOne 1 100 0.00 255.0 FORMAT "%5.1" ECU_ADDRESS 0x70008CF7 /end MEASUREMENT
/begin MEASUREMENT LLim_numTSRLimSpdClr_mp "Traffic sign information to be displayed on meter for ISA continue at TSR clear" UBYTE OneToOne 1 100 0.00 255.0 FORMAT "%5.1" ECU_ADDRESS 0x70008CF6 /end MEASUREMENT
/begin MEASUREMENT LLim_numTSRLimSpdOffset_mp "Traffic sign information to be displayed on meter for ISA set vehicle speed with offset" UBYTE OneToOne 1 100 0.00 255.0 FORMAT "%5.1" ECU_ADDRESS 0x70008CF5 /end MEASUREMENT
/begin MEASUREMENT LLim_numTSRLimSpdOld_mp "Old value of CrCUI_numTSRLimSpd" UBYTE OneToOne 1 100 0.00 255.0 FORMAT "%5.1" ECU_ADDRESS 0x70008CF4 /end MEASUREMENT
/begin MEASUREMENT LLim_rAcclReqVar_mp "Request accel pedal position variation value of accelerate speed control" SLONG APPCrCtl1 1 100 -10737418.2400 10737418.2350 FORMAT "%13.4" ECU_ADDRESS 0x70008CF0 /end MEASUREMENT
/begin MEASUREMENT LLim_rAppASLCncl_mp "Acceleration pedal position for checking ASL cancel" SWORD APPCrCtl1 1 100 -163.8400 163.8350 FORMAT "%8.4" ECU_ADDRESS 0x70008CEC /end MEASUREMENT
/begin MEASUREMENT LLim_rAPPCnclRetAcclLim_mp "Return value of accel pedal position when ASL cancel is turned on(acceleration limitation)" SWORD APPCrCtl1 1 100 -163.8400 163.8350 FORMAT "%8.4" ECU_ADDRESS 0x70008CEA /end MEASUREMENT
/begin MEASUREMENT LLim_rAPPCnclRetFin_mp "Final return value of accel pedal position when ASL cancel is turned on" SWORD APPCrCtl1 1 100 -163.8400 163.8350 FORMAT "%8.4" ECU_ADDRESS 0x70008CE8 /end MEASUREMENT
/begin MEASUREMENT LLim_rAPPCnclRet_mp "Return value of accel pedal position when ASL cancel is turned on" SWORD APPCrCtl1 1 100 -163.8400 163.8350 FORMAT "%8.4" ECU_ADDRESS 0x70008CE6 /end MEASUREMENT
/begin MEASUREMENT LLim_rAPPIniReq_mp "Initial request accel pedal position for ASL" SWORD APPCrCtl1 1 100 -163.8400 163.8350 FORMAT "%8.4" ECU_ADDRESS 0x70008CE4 /end MEASUREMENT
/begin MEASUREMENT LLim_rAPPLimTmpRlsAPPOld_mp "Previous valur of accel pedal value during enabling temporary release of APP limitation" SWORD APPCrCtl1 1 100 -163.8400 163.8350 FORMAT "%8.4" ECU_ADDRESS 0x70008CE2 /end MEASUREMENT
/begin MEASUREMENT LLim_rAPPLimTmpRlsAPP_mp "Accel pedal value during enabling temporary release of APP limitation" SWORD APPCrCtl1 1 100 -163.8400 163.8350 FORMAT "%8.4" ECU_ADDRESS 0x70008CE0 /end MEASUREMENT
/begin MEASUREMENT LLim_rAPPMax_mp "Maximum accel pedal position for ASL" SWORD APPCrCtl1 1 100 -163.8400 163.8350 FORMAT "%8.4" ECU_ADDRESS 0x70008CDE /end MEASUREMENT
/begin MEASUREMENT LLim_rAPPReqFin_mp "Decided value of requirement accelerator position for ASL" SWORD APPCrCtl1 1 100 -163.8400 163.8350 FORMAT "%8.4" ECU_ADDRESS 0x70008CDC /end MEASUREMENT
/begin MEASUREMENT LLim_rAPPReqItmFltOld_mp "Old Interim value of filtered request accel pedal position" SWORD APPCrCtl1 1 100 -163.8400 163.8350 FORMAT "%8.4" ECU_ADDRESS 0x70008CDA /end MEASUREMENT
/begin MEASUREMENT LLim_rAPPReqItmFlt_mp "Interim value of filtered request accel pedal position" SWORD APPCrCtl1 1 100 -163.8400 163.8350 FORMAT "%8.4" ECU_ADDRESS 0x70008CD8 /end MEASUREMENT
/begin MEASUREMENT LLim_rAPPReqItm_mp "Interim value of request accel pedal position" SWORD APPCrCtl1 1 100 -163.8400 163.8350 FORMAT "%8.4" ECU_ADDRESS 0x70008CD6 /end MEASUREMENT
/begin MEASUREMENT LLim_rAPP_mp "Driver accel pedal position" SWORD APPCrCtl1 1 100 -163.8400 163.8350 FORMAT "%8.4" ECU_ADDRESS 0x70008CD4 /end MEASUREMENT
/begin MEASUREMENT LLim_rCCASLAppReq "APP ratio request of CC or ASL for AT" SWORD Prc 1 100 -400.0000 399.9878 FORMAT "%8.4" ECU_ADDRESS 0x60005008 /end MEASUREMENT
/begin MEASUREMENT LLim_rConstReqVar_mp "Request accel pedal position variation value of constant speed control" SLONG APPCrCtl1 1 100 -10737418.2400 10737418.2350 FORMAT "%13.4" ECU_ADDRESS 0x70008CD0 /end MEASUREMENT
/begin MEASUREMENT LLim_rDeclReqVar_mp "Request accel pedal position variation value of decelerate speed control" SWORD APPCrCtl1 1 100 -163.8400 163.8350 FORMAT "%8.4" ECU_ADDRESS 0x70008CCC /end MEASUREMENT
/begin MEASUREMENT LLim_rDes "Desired accel pedal position for ASL" SWORD Prc 1 100 -400.0000 399.9878 FORMAT "%8.4" ECU_ADDRESS 0x60005006 /end MEASUREMENT
/begin MEASUREMENT LLim_rDesReq_mp "Request desired accel pedal position" SWORD APPCrCtl1 1 100 -163.8400 163.8350 FORMAT "%8.4" ECU_ADDRESS 0x70008CCA /end MEASUREMENT
/begin MEASUREMENT LLim_rDiff100msItm_mp "100ms cycle difference APP ratio request interim value" SWORD APPCrCtl1 1 100 -163.8400 163.8350 FORMAT "%8.4" ECU_ADDRESS 0x70008CC8 /end MEASUREMENT
/begin MEASUREMENT LLim_rDiff100ms_mp "100ms cycle difference APP ratio request value" SWORD APPCrCtl1 1 100 -163.8400 163.8350 FORMAT "%8.4" ECU_ADDRESS 0x70008CC6 /end MEASUREMENT
/begin MEASUREMENT LLim_stActive "Active flag for adjustable speed limiter" UBYTE OneToOne 1 100 0.00 255.0 FORMAT "%5.1" ECU_ADDRESS 0x6000A377 /end MEASUREMENT
/begin MEASUREMENT LLim_stActvLmp "Status of speed limiter active condition lamp" UBYTE OneToOne 1 100 0.00 255.0 FORMAT "%5.1" ECU_ADDRESS 0x6000A376 /end MEASUREMENT
/begin MEASUREMENT LLim_stActvLmpItm1 "Intermediate status1 of speed limiter active condition lamp" UBYTE OneToOne 1 100 0.00 255.0 FORMAT "%5.1" ECU_ADDRESS 0x6000A375 /end MEASUREMENT
/begin MEASUREMENT LLim_stActvLmpItm2 "Intermediate status2 of speed limiter active condition lamp" UBYTE OneToOne 1 100 0.00 255.0 FORMAT "%5.1" ECU_ADDRESS 0x6000A374 /end MEASUREMENT
/begin MEASUREMENT LLim_stAlrmSoundStrtEdge "ASL warning sound start edge" UBYTE OneToOne 1 100 0.00 255.0 FORMAT "%5.1" ECU_ADDRESS 0x6000A373 /end MEASUREMENT
/begin MEASUREMENT LLim_stAlrmStrtEdge "Selection status of continuation time for ASL alarm." UBYTE OneToOne 1 100 0.00 255.0 FORMAT "%5.1" ECU_ADDRESS 0x6000A372 /end MEASUREMENT
/begin MEASUREMENT LLim_stAPPLimTmpRls_mp "Status for temporary release of APP limitation" UBYTE OneToOne 1 100 0.00 255.0 FORMAT "%5.1" ECU_ADDRESS 0x70008CC4 /end MEASUREMENT
/begin MEASUREMENT LLim_stAPPOffReq_mp "Status of accel pedal position off request flag" UBYTE OneToOne 1 100 0.00 255.0 FORMAT "%5.1" ECU_ADDRESS 0x70008CC3 /end MEASUREMENT
/begin MEASUREMENT LLim_stAPPOvr_mp "Status of accel pedal position over flag" UBYTE OneToOne 1 100 0.00 255.0 FORMAT "%5.1" ECU_ADDRESS 0x70008CC2 /end MEASUREMENT
/begin MEASUREMENT LLim_stASLAppClsLrnHist_mp "History status of updating APP close learning value" UBYTE OneToOne 1 100 0.00 255.0 FORMAT "%5.1" ECU_ADDRESS 0x70008CC1 /end MEASUREMENT
/begin MEASUREMENT LLim_stASLAppOpenAlrm_mp "Status of APP full open alarm" UBYTE OneToOne 1 100 0.00 255.0 FORMAT "%5.1" ECU_ADDRESS 0x70008CC0 /end MEASUREMENT
/begin MEASUREMENT LLim_stASLIdasbCanErr "Active status of IDAS CAN communication error for speed limiter" UBYTE OneToOne 1 100 0.00 255.0 FORMAT "%5.1" ECU_ADDRESS 0x6000A379 /end MEASUREMENT
/begin MEASUREMENT LLim_stASLRxErrDet "Status of ASL communication error detection" UBYTE OneToOne 1 100 0.00 255.0 FORMAT "%5.1" ECU_ADDRESS 0x6000A378 /end MEASUREMENT
/begin MEASUREMENT LLim_stCCASLDataErr "Status of mutual data error detection of CC and ASL" UBYTE OneToOne 1 100 0.00 255.0 FORMAT "%5.1" ECU_ADDRESS 0x6000A371 /end MEASUREMENT
/begin MEASUREMENT LLim_stCnclAlrm_mp "Status of cancel alarm for ASL" UBYTE OneToOne 1 100 0.00 255.0 FORMAT "%5.1" ECU_ADDRESS 0x70008CBF /end MEASUREMENT
/begin MEASUREMENT LLim_stCondNo_mp "Status of ASL condition No." UBYTE OneToOne 1 100 0.00 255.0 FORMAT "%5.1" ECU_ADDRESS 0x70008CBE /end MEASUREMENT
/begin MEASUREMENT LLim_stIniOut_mp "Status of initialize output flag" UBYTE OneToOne 1 100 0.00 255.0 FORMAT "%5.1" ECU_ADDRESS 0x70008CBD /end MEASUREMENT
/begin MEASUREMENT LLim_stIniReq_mp "Status of initialize request flag" UBYTE OneToOne 1 100 0.00 255.0 FORMAT "%5.1" ECU_ADDRESS 0x70008CBC /end MEASUREMENT
/begin MEASUREMENT LLim_stISACnclAcclRecvr_mp "Flag indicates that accel pedal is in recovering due to ISA cancelled." UBYTE OneToOne 1 100 0.00 255.0 FORMAT "%5.1" ECU_ADDRESS 0x70008CBB /end MEASUREMENT
/begin MEASUREMENT LLim_stISAContTSRClr "ISA control continuation flag when TSR is cleared" UBYTE OneToOne 1 100 0.00 255.0 FORMAT "%5.1" ECU_ADDRESS 0x6000A370 /end MEASUREMENT
/begin MEASUREMENT LLim_stISAContTSRClrOld_mp "Old value of ISA control continuation information when TSR is cleared" UBYTE OneToOne 1 100 0.00 255.0 FORMAT "%5.1" ECU_ADDRESS 0x70008CBA /end MEASUREMENT
/begin MEASUREMENT LLim_stISATempStpOld_mp "Old value of Llim_stISATempStp_mp" UBYTE OneToOne 1 100 0.00 255.0 FORMAT "%5.1" ECU_ADDRESS 0x70008CB9 /end MEASUREMENT
/begin MEASUREMENT LLim_stISATempStp_mp "Status of ISA mode is temporarily cancelled during ISA control" UBYTE OneToOne 1 100 0.00 255.0 FORMAT "%5.1" ECU_ADDRESS 0x70008CB8 /end MEASUREMENT
/begin MEASUREMENT LLim_stMetCCMode1 "ASL Meter Display Mode 1" UBYTE OneToOne 1 100 0.00 255.0 FORMAT "%5.1" ECU_ADDRESS 0x6000A36D /end MEASUREMENT
/begin MEASUREMENT LLim_stMetCCMode2 "ASL Meter Display Mode 2" UBYTE OneToOne 1 100 0.00 255.0 FORMAT "%5.1" ECU_ADDRESS 0x6000A36C /end MEASUREMENT
/begin MEASUREMENT LLim_stMETVehUn "Status of vehicle speed unit for indicating meter in ASL" UBYTE OneToOne 1 100 0.00 255.0 FORMAT "%5.1" ECU_ADDRESS 0x6000A36F /end MEASUREMENT
/begin MEASUREMENT LLim_stModeNo "Status for ASL Mode No." UBYTE OneToOne 1 100 0.00 255.0 FORMAT "%5.1" ECU_ADDRESS 0x6000A36B /end MEASUREMENT
/begin MEASUREMENT LLim_stModeNoOld_mp "Previous status for ASL Mode No." UBYTE OneToOne 1 100 0.00 255.0 FORMAT "%5.1" ECU_ADDRESS 0x70008CB7 /end MEASUREMENT
/begin MEASUREMENT LLim_stResWait_mp "Status of waiting ASL state shift to RESUME and PRESET" UBYTE OneToOne 1 100 0.00 255.0 FORMAT "%5.1" ECU_ADDRESS 0x70008CB6 /end MEASUREMENT
/begin MEASUREMENT LLim_stSetSpdIdcBlnOff_mp "Status of indicate ASL set vehicle speed blink off" UBYTE OneToOne 1 100 0.00 255.0 FORMAT "%5.1" ECU_ADDRESS 0x70008CB5 /end MEASUREMENT
/begin MEASUREMENT LLim_stSpdNoUpdReq "Status of (CC or ACC) desired vehicle speed display no update request." UBYTE OneToOne 1 100 0.00 255.0 FORMAT "%5.1" ECU_ADDRESS 0x6000A36A /end MEASUREMENT
/begin MEASUREMENT LLim_stVehSpdAreaNoOld_mp "Old ASL area no. of control vehicle speed" UBYTE OneToOne 1 100 0.00 255.0 FORMAT "%5.1" ECU_ADDRESS 0x70008CB4 /end MEASUREMENT
/begin MEASUREMENT LLim_stVehSpdAreaNo_mp "ASL area no. of control vehicle speed" UBYTE OneToOne 1 100 0.00 255.0 FORMAT "%5.1" ECU_ADDRESS 0x70008CB3 /end MEASUREMENT
/begin MEASUREMENT LLim_stVehSpdOver_mp "Status of over speed for ASL" UBYTE OneToOne 1 100 0.00 255.0 FORMAT "%5.1" ECU_ADDRESS 0x70008CB2 /end MEASUREMENT
/begin MEASUREMENT LLim_stVehUnSelOld_mp "Status of old selected value by ASL vehicle speed unit" UBYTE OneToOne 1 100 0.00 255.0 FORMAT "%5.1" ECU_ADDRESS 0x70008CB1 /end MEASUREMENT
/begin MEASUREMENT LLim_stVehUnSel_mp "Status of selected value by ASL vehicle speed unit" UBYTE OneToOne 1 100 0.00 255.0 FORMAT "%5.1" ECU_ADDRESS 0x70008CB0 /end MEASUREMENT
/begin MEASUREMENT LLim_tiAPPLimTmpRls_mp "Timer that check the end of temporary release of APP limitation" SWORD Time_ms_100ms 1 100 -3276800. 3276700. FORMAT "%8.0" ECU_ADDRESS 0x70008CAE /end MEASUREMENT
/begin MEASUREMENT LLim_tiArChgAppSel_mp "Time to change APP difference with area change" SWORD Time_ms_100ms 1 100 -3276800. 3276700. FORMAT "%8.0" ECU_ADDRESS 0x70008CAC /end MEASUREMENT
/begin MEASUREMENT LLim_tiASLAppClsLrnStrt_mp "Timer of checking APP close learning start" SWORD Time_ms 1 100 -327680.0 327670.0 FORMAT "%8.1" ECU_ADDRESS 0x70008CAA /end MEASUREMENT
/begin MEASUREMENT LLim_tiASLAppClsLrnUpd_mp "Wait timer for update of APP close learning value" SWORD Time_ms_100ms 1 100 -3276800. 3276700. FORMAT "%8.0" ECU_ADDRESS 0x70008CA8 /end MEASUREMENT
/begin MEASUREMENT LLim_tiASLAppOpenAlrm_mp "Timer of checking APP full open alarm continuation for ASL" SWORD Time_ms_100ms 1 100 -3276800. 3276700. FORMAT "%8.0" ECU_ADDRESS 0x70008CA6 /end MEASUREMENT
/begin MEASUREMENT LLim_tiASLAppOpenLrnStrt_mp "Timer of checking APP open learning start" SWORD Time_ms 1 100 -327680.0 327670.0 FORMAT "%8.1" ECU_ADDRESS 0x70008CA4 /end MEASUREMENT
/begin MEASUREMENT LLim_tiASLCnclSound "Duration of ASL cancellation beep sound alert" SWORD Time_ms_100ms 1 100 -3276800. 3276700. FORMAT "%8.0" ECU_ADDRESS 0x60000C18 /end MEASUREMENT
/begin MEASUREMENT LLim_tiASLIdasbErr_mp "." SWORD Time_ms 1 100 -327680.0 327670.0 FORMAT "%8.1" ECU_ADDRESS 0x70008CA2 /end MEASUREMENT
/begin MEASUREMENT LLim_tiASLRxErr_mp "Timer of ASL communication error" SWORD Time_ms 1 100 -327680.0 327670.0 FORMAT "%8.1" ECU_ADDRESS 0x70008CA0 /end MEASUREMENT
/begin MEASUREMENT LLim_tiASLSet_mp "Timer of ASL state shift timing from PRESET to SET" SWORD Time_ms 1 100 -327680.0 327670.0 FORMAT "%8.1" ECU_ADDRESS 0x70008C9E /end MEASUREMENT
/begin MEASUREMENT LLim_tiCCASLDataErr_mp "Timer of mutual data error of CC and ASL" SWORD Time_ms 1 100 -327680.0 327670.0 FORMAT "%8.1" ECU_ADDRESS 0x70008C9C /end MEASUREMENT
/begin MEASUREMENT LLim_tiCnclAlrm_mp "Timer of ASL cancel alarm" SWORD Time_ms_100ms 1 100 -3276800. 3276700. FORMAT "%8.0" ECU_ADDRESS 0x70008C9A /end MEASUREMENT
/begin MEASUREMENT LLim_tiCtlExtn_mp "Timer of ASL control extension" SWORD Time_ms 1 100 -327680.0 327670.0 FORMAT "%8.1" ECU_ADDRESS 0x70008C98 /end MEASUREMENT
/begin MEASUREMENT LLim_tiISATempStpBlnk_mp "Timer for blinking for vehicle speed display at ISA temporary stop" SWORD Time_ms_100ms 1 100 -3276800. 3276700. FORMAT "%8.0" ECU_ADDRESS 0x70008C96 /end MEASUREMENT
/begin MEASUREMENT LLim_tiOvrSpdAlrmFin_mp "Timer of ASL over vehicle speed alarm finish check" SWORD Time_ms_100ms 1 100 -3276800. 3276700. FORMAT "%8.0" ECU_ADDRESS 0x70008C94 /end MEASUREMENT
/begin MEASUREMENT LLim_tiOvrSpdAlrmStrt_mp "Timer of ASL over vehicle speed alarm start check" SWORD Time_ms_100ms 1 100 -3276800. 3276700. FORMAT "%8.0" ECU_ADDRESS 0x70008C92 /end MEASUREMENT
/begin MEASUREMENT LLim_tiSetSpdBlnOff_mp "Timer of Set vehicle speed Blink Off" SWORD Time_ms_100ms 1 100 -3276800. 3276700. FORMAT "%8.0" ECU_ADDRESS 0x70008C90 /end MEASUREMENT
/begin MEASUREMENT LLim_tiSetSpdBlnOn_mp "Timer of Set vehicle speed Blink On" SWORD Time_ms_100ms 1 100 -3276800. 3276700. FORMAT "%8.0" ECU_ADDRESS 0x70008C8E /end MEASUREMENT
/begin MEASUREMENT LLim_uASLAppATSnsrOpenLrnOld_mp "Old AP sensor voltage(full open learn value) for AT" SWORD Volt_Batt 1 100 -655360.0 655340.0 FORMAT "%8.1" ECU_ADDRESS 0x70008C8C /end MEASUREMENT
/begin MEASUREMENT LLim_uASLAppClsLrnStrt_mp "Acceleration pedal sensor voltage of checking close learning start for ASL" SWORD Volt 1 100 -6553.600 6553.400 FORMAT "%8.3" ECU_ADDRESS 0x70008C8A /end MEASUREMENT
/begin MEASUREMENT LLim_uASLAppClsLrn_mp "Acceleration pedal sensor voltage of close learning result for ASL" SWORD Volt 1 100 -6553.600 6553.400 FORMAT "%8.3" ECU_ADDRESS 0x70008C88 /end MEASUREMENT
/begin MEASUREMENT LLim_uASLAppOpenLrnStrt_mp "Acceleration pedal sensor voltage of checking open learning start for ASL" SWORD Volt 1 100 -6553.600 6553.400 FORMAT "%8.3" ECU_ADDRESS 0x70008C86 /end MEASUREMENT
/begin MEASUREMENT LLim_uASLAppOpenLrn_mp "Acceleration pedal sensor voltage of open learning result for ASL" SWORD Volt 1 100 -6553.600 6553.400 FORMAT "%8.3" ECU_ADDRESS 0x70008C84 /end MEASUREMENT
/begin MEASUREMENT LLim_uASLAppSnsr_mp "Acceleration pedal sensor voltage for ASL" SWORD Volt 1 100 -6553.600 6553.400 FORMAT "%8.3" ECU_ADDRESS 0x70008C82 /end MEASUREMENT
/begin MEASUREMENT LLim_vAcclDvt_mp "Accelerate deviation value for ASL" SWORD Vel 1 100 -327.6800 327.6700 FORMAT "%8.4" ECU_ADDRESS 0x70008C80 /end MEASUREMENT
/begin MEASUREMENT LLim_vAPPLimTmpRlsSpd_mp "Vehicle speed at start of APP limitation temporary release" SWORD Vel 1 100 -327.6800 327.6700 FORMAT "%8.4" ECU_ADDRESS 0x70008C7E /end MEASUREMENT
/begin MEASUREMENT LLim_vDesAccl_mp "Desired accelerate value for ASL" SWORD Vel 1 100 -327.6800 327.6700 FORMAT "%8.4" ECU_ADDRESS 0x70008C7C /end MEASUREMENT
/begin MEASUREMENT LLim_vDes_mp "Desired vehicle speed for ASL control" SWORD Vel 1 100 -327.6800 327.6700 FORMAT "%8.4" ECU_ADDRESS 0x70008C7A /end MEASUREMENT
/begin MEASUREMENT LLim_vDLimHysHi_mp "ASL Vehicle spped for DL (hysteresis Hi) value" SWORD Vel 1 100 -327.6800 327.6700 FORMAT "%8.4" ECU_ADDRESS 0x70008C78 /end MEASUREMENT
/begin MEASUREMENT LLim_vDLimHysLo_mp "ASL Vehicle spped for DL (hysteresis Lo) value" SWORD Vel 1 100 -327.6800 327.6700 FORMAT "%8.4" ECU_ADDRESS 0x70008C76 /end MEASUREMENT
/begin MEASUREMENT LLim_vDLim_mp "ASL Vehicle speed for Disel limit" SWORD Vel 1 100 -327.6800 327.6700 FORMAT "%8.4" ECU_ADDRESS 0x70008C74 /end MEASUREMENT
/begin MEASUREMENT LLim_vISALimSpdOffsetLo_mp "Lower limit speed with offset calculated by current TSR limit speed" SWORD Vel 1 100 -327.6800 327.6700 FORMAT "%8.4" ECU_ADDRESS 0x70008C72 /end MEASUREMENT
/begin MEASUREMENT LLim_vISALimSpdOffsetUp_mp "Upper limit speed with offset calculated by current TSR limit speed" SWORD Vel 1 100 -327.6800 327.6700 FORMAT "%8.4" ECU_ADDRESS 0x70008C70 /end MEASUREMENT
/begin MEASUREMENT LLim_vMemDisp "Memory speed display" UWORD Vel 1 100 0.00 655.3500 FORMAT "%8.4" ECU_ADDRESS 0x60004CAA /end MEASUREMENT
/begin MEASUREMENT LLim_vMemSpdAftCncl_mp "Memory vehicle speed of after ASL cancel" SWORD Vel 1 100 -327.6800 327.6700 FORMAT "%8.4" ECU_ADDRESS 0x70008C6E /end MEASUREMENT
/begin MEASUREMENT LLim_vMemSpdFinAftCor_mp "Final value of ASL memory vehicle speed after correction" SWORD Vel 1 100 -327.6800 327.6700 FORMAT "%8.4" ECU_ADDRESS 0x70008C6C /end MEASUREMENT
/begin MEASUREMENT LLim_vMemSpdFin_mp "Final value of ASL memory vehicle speed" SWORD Vel 1 100 -327.6800 327.6700 FORMAT "%8.4" ECU_ADDRESS 0x70008C6A /end MEASUREMENT
/begin MEASUREMENT LLim_vMemSpdLoLim_mp "Memory vehicle speed lower limit value for ASL" SWORD Vel 1 100 -327.6800 327.6700 FORMAT "%8.4" ECU_ADDRESS 0x70008C68 /end MEASUREMENT
/begin MEASUREMENT LLim_vMemSpdMPH_mp "Memory vehicle speed(MPH) for ASL" SLONG Vel_CrCtl_MPH 1 100 -8388608.00000 8388607.99609 FORMAT "%13.5" ECU_ADDRESS 0x70008C64 /end MEASUREMENT
/begin MEASUREMENT LLim_vMemSpdOld_mp "Old value of LLim_vMemSpd_mp" SWORD Vel 1 100 -327.6800 327.6700 FORMAT "%8.4" ECU_ADDRESS 0x70008C62 /end MEASUREMENT
/begin MEASUREMENT LLim_vMemSpdResOnKmh_mp "ASL Memory vehicle speed during Res SW is on(Km/h)" SWORD Vel_CrCtl1 1 100 -32768.00 32767.00 FORMAT "%8.2" ECU_ADDRESS 0x70008C60 /end MEASUREMENT
/begin MEASUREMENT LLim_vMemSpdResOnMPH_mp "ASL Memory vehicle speed during Res SW is on(MPH)" SWORD Vel_CrCtl1_MPH 1 100 -32768.00 32767.00 FORMAT "%8.2" ECU_ADDRESS 0x70008C5E /end MEASUREMENT
/begin MEASUREMENT LLim_vMemSpdResTrnOnKmh_mp "ASL Memory vehicle speed when Res SW is turned on(Km/h)" SWORD Vel_CrCtl1 1 100 -32768.00 32767.00 FORMAT "%8.2" ECU_ADDRESS 0x70008C5C /end MEASUREMENT
/begin MEASUREMENT LLim_vMemSpdResTrnOnMPH_mp "ASL Memory vehicle speed when Res SW is turned on(MPH)" SWORD Vel_CrCtl1_MPH 1 100 -32768.00 32767.00 FORMAT "%8.2" ECU_ADDRESS 0x70008C5A /end MEASUREMENT
/begin MEASUREMENT LLim_vMemSpdSetOnKmh_mp "ASL Memory vehicle speed during Set SW is on(Km/h)" SWORD Vel_CrCtl1 1 100 -32768.00 32767.00 FORMAT "%8.2" ECU_ADDRESS 0x70008C58 /end MEASUREMENT
/begin MEASUREMENT LLim_vMemSpdSetOnMPH_mp "ASL Memory vehicle speed during Set SW is on(MPH)" SWORD Vel_CrCtl1_MPH 1 100 -32768.00 32767.00 FORMAT "%8.2" ECU_ADDRESS 0x70008C56 /end MEASUREMENT
/begin MEASUREMENT LLim_vMemSpdSetTrnOnKmh_mp "ASL Memory vehicle speed when Set SW is turned on(Km/h)" SWORD Vel_CrCtl1 1 100 -32768.00 32767.00 FORMAT "%8.2" ECU_ADDRESS 0x70008C54 /end MEASUREMENT
/begin MEASUREMENT LLim_vMemSpdSetTrnOnMPH_mp "ASL Memory vehicle speed when Set SW is turned on(MPH)" SWORD Vel_CrCtl1_MPH 1 100 -32768.00 32767.00 FORMAT "%8.2" ECU_ADDRESS 0x70008C52 /end MEASUREMENT
/begin MEASUREMENT LLim_vMemSpdSwtOnKmh_mp "ASL Memory vehicle speed during SW is on(Km/h)" SWORD Vel 1 100 -327.6800 327.6700 FORMAT "%8.4" ECU_ADDRESS 0x70008C50 /end MEASUREMENT
/begin MEASUREMENT LLim_vMemSpdSwtOnMPH_mp "ASL Memory vehicle speed during SW is on(MPH)" SLONG Vel_CrCtl_MPH 1 100 -8388608.00000 8388607.99609 FORMAT "%13.5" ECU_ADDRESS 0x70008C4C /end MEASUREMENT
/begin MEASUREMENT LLim_vMemSpdUpLim_mp "Memory vehicle speed upper limit value for ASL" SWORD Vel 1 100 -327.6800 327.6700 FORMAT "%8.4" ECU_ADDRESS 0x70008C48 /end MEASUREMENT
/begin MEASUREMENT LLim_vMemSpdVerfDat_mp "Data for ASL memory vehicle speed verification" SWORD Vel 1 100 -327.6800 327.6700 FORMAT "%8.4" ECU_ADDRESS 0x70008C46 /end MEASUREMENT
/begin MEASUREMENT LLim_vMemSpd_mp "Memory vehicle speed for ASL" SWORD Vel 1 100 -327.6800 327.6700 FORMAT "%8.4" ECU_ADDRESS 0x70008C44 /end MEASUREMENT
/begin MEASUREMENT LLim_vMETMemSpdItmKmh_mp "Interim value of memory vehicle speed for indicating meter in ASL (km/h)" SWORD Vel_CrCtl1 1 100 -32768.00 32767.00 FORMAT "%8.2" ECU_ADDRESS 0x70008C42 /end MEASUREMENT
/begin MEASUREMENT LLim_vMETMemSpdItmMPH_mp "Interim value of memory vehicle speed for indicating meter in ASL (MPH)" SWORD Vel_CrCtl1_MPH 1 100 -32768.00 32767.00 FORMAT "%8.2" ECU_ADDRESS 0x70008C40 /end MEASUREMENT
/begin MEASUREMENT LLim_vNoCtlPntHysHi_mp "ASL Vehicle spped for non control point(hysteresis Hi) value" SWORD Vel 1 100 -327.6800 327.6700 FORMAT "%8.4" ECU_ADDRESS 0x70008C3E /end MEASUREMENT
/begin MEASUREMENT LLim_vNoCtlPntHysLo_mp "ASL Vehicle spped for non control point(hysteresis Lo) value" SWORD Vel 1 100 -327.6800 327.6700 FORMAT "%8.4" ECU_ADDRESS 0x70008C3C /end MEASUREMENT
/begin MEASUREMENT LLim_vNoCtlPnt_mp "ASL Vehicle spped for non control point" SWORD Vel 1 100 -327.6800 327.6700 FORMAT "%8.4" ECU_ADDRESS 0x70008C3A /end MEASUREMENT
/begin MEASUREMENT LLim_vRPntHysHi_mp "ASL Vehicle spped for RP (hysteresis Hi) value" SWORD Vel 1 100 -327.6800 327.6700 FORMAT "%8.4" ECU_ADDRESS 0x70008C38 /end MEASUREMENT
/begin MEASUREMENT LLim_vRPntHysLo_mp "ASL Vehicle spped for RP (hysteresis Lo) value" SWORD Vel 1 100 -327.6800 327.6700 FORMAT "%8.4" ECU_ADDRESS 0x70008C36 /end MEASUREMENT
/begin MEASUREMENT LLim_vRPnt_mp "ASL Vehicle speed for Resume Point" SWORD Vel 1 100 -327.6800 327.6700 FORMAT "%8.4" ECU_ADDRESS 0x70008C34 /end MEASUREMENT
/begin MEASUREMENT LLim_vSpdDvt_mp "Deviation of ASL vehicle speed" SWORD Vel 1 100 -327.6800 327.6700 FORMAT "%8.4" ECU_ADDRESS 0x70008C32 /end MEASUREMENT
/begin MEASUREMENT LLim_vTSRLimSpdTmp_mp "Limiting vehicle speed received through the TSR" SWORD Vel 1 100 -327.6800 327.6700 FORMAT "%8.4" ECU_ADDRESS 0x70008C30 /end MEASUREMENT
/begin MEASUREMENT LLRMR_bTrqResActv "Bit; torque-reserve active" UBYTE B_TRUE 1 100 0.00 1.00000000000 BIT_MASK 0x1 FORMAT "%13.11" ECU_ADDRESS 0x6000A17B /end MEASUREMENT
/begin MEASUREMENT LLRMR_bTrqResInActv "Bit; torque-reserve not active" UBYTE B_TRUE 1 100 0.00 1.00000000000 BIT_MASK 0x1 FORMAT "%13.11" ECU_ADDRESS 0x6000A17A /end MEASUREMENT
/begin MEASUREMENT LLRMR_dmreshh "Variable for reduction rate for increased torque reserve during rear window heating" UBYTE B_TRUE 1 100 0.00 1.00000000000 BIT_MASK 0x1 FORMAT "%13.11" ECU_ADDRESS 0x600063B5 /end MEASUREMENT
/begin MEASUREMENT llrmr_dmresll "corrected torque reserve after engine speed drop down" UWORD rel_q0p00153 1 100 0.00 99.99847 FORMAT "%8.5" ECU_ADDRESS 0x6000D9BE /end MEASUREMENT
/begin MEASUREMENT LLRMR_dns_temp "local value for dns in LLRMR" SWORD nmot_sw_q0p5 1 100 -16384.00 16383.50 FORMAT "%8.2" ECU_ADDRESS 0x60003718 /end MEASUREMENT
/begin MEASUREMENT LLRMR_etazwmn "minimum ignition angle effectiveness + offset calculated in LLRMR" UWORD fak_uw_b2 1 100 0.00 1.000000 FORMAT "%8.6" ECU_ADDRESS 0x60003716 /end MEASUREMENT
/begin MEASUREMENT LLRMR_fho_tmp "local value for fho in LLRMR (MDG1)" UBYTE fak_ub_b4 1 100 0.00 3.984 FORMAT "%5.3" ECU_ADDRESS 0x6000E3B4 /end MEASUREMENT
/begin MEASUREMENT LLRMR_flgClthStDefn "Give either the state of the bit LLRMR_stCluOpnNotCmpl_C or bit LLRMR_stCluOpnCmpl_C of the clutch state" UBYTE B_TRUE 1 100 0.00 1.00000000000 BIT_MASK 0x1 FORMAT "%13.11" ECU_ADDRESS 0x60000C17 /end MEASUREMENT
/begin MEASUREMENT LLRMR_flgTrsmClthSt "Give the state of the bit LLRMR_stCluOpnNotCmpl_C of the clutch state in case of Manual Transmission, or FALSE if the transmission is not manual" UBYTE B_TRUE 1 100 0.00 1.00000000000 BIT_MASK 0x1 FORMAT "%13.11" ECU_ADDRESS 0x60000C16 /end MEASUREMENT
/begin MEASUREMENT LLRMR_gangi_tmp "local value for gangi in LLRMR (MDG1)" UBYTE OneToOne 1 100 0.00 255.0 FORMAT "%5.1" ECU_ADDRESS 0x600063B4 /end MEASUREMENT
/begin MEASUREMENT LLRMR_mibmn "internal base torque + offset calculated in LLRMR, LLRMR lower limit for given mode" UWORD rel_uw_b100 1 100 0.00 99.99847 FORMAT "%8.5" ECU_ADDRESS 0x60003714 /end MEASUREMENT
/begin MEASUREMENT LLRMR_mifa_w_tmp "local value for mifa_w in LLRMR (MDG1)" UWORD rel_uw_b100 1 100 0.00 99.99847 FORMAT "%8.5" ECU_ADDRESS 0x60003712 /end MEASUREMENT
/begin MEASUREMENT LLRMR_nmotw_tmp "local value for nmot_w in LLRMR (MDG1)" UWORD nmot_uw_q0p25 1 100 0.00 16383.75 FORMAT "%8.2" ECU_ADDRESS 0x60003710 /end MEASUREMENT
/begin MEASUREMENT LLRMR_nmot_tmp "local value for nmot in LLRMR (MDG1)" UBYTE nmot_ub_q40 1 100 0.00 10200. FORMAT "%5.0" ECU_ADDRESS 0x600063B3 /end MEASUREMENT
/begin MEASUREMENT LLRMR_percTqResvBas "torque reserve in non idle - base torque reserve" UWORD rel_uw_b100 1 100 0.00 99.99847 FORMAT "%8.5" ECU_ADDRESS 0x6000370E /end MEASUREMENT
/begin MEASUREMENT LLRMR_percTqResvDrvMod "Torque reserve in non idle- dependent on driving program , limited" UWORD rel_uw_b100 1 100 0.00 99.99847 FORMAT "%8.5" ECU_ADDRESS 0x6000D92E /end MEASUREMENT
/begin MEASUREMENT LLRMR_percTqResvEngGrdt "Torque reserve depending on engine speed gradient" UWORD rel_uw_b100 1 100 0.00 99.99847 FORMAT "%8.5" ECU_ADDRESS 0x60004CAC /end MEASUREMENT
/begin MEASUREMENT LLRMR_percTqResvEngGrdtOld "Torque reserve depending on engine speed gradient (old value)" UWORD rel_uw_b100 1 100 0.00 99.99847 FORMAT "%8.5" ECU_ADDRESS 0x6000370C /end MEASUREMENT
/begin MEASUREMENT LLRMR_percTqResvHeatrReq "Torque reserve for improved engine heat up (non-idle)" UWORD rel_uw_b100 1 100 0.00 99.99847 FORMAT "%8.5" ECU_ADDRESS 0x6000370A /end MEASUREMENT
/begin MEASUREMENT LLRMR_percTqResvLtd "Torque reserve non idle - limited" UWORD rel_uw_b100 1 100 0.00 99.99847 FORMAT "%8.5" ECU_ADDRESS 0x60003708 /end MEASUREMENT
/begin MEASUREMENT LLRMR_percTqResvOffsLtd "Torque reserve in non idle limited by minimal distance to etazwmn_w_msg" UWORD rel_uw_b100 1 100 0.00 99.99847 FORMAT "%8.5" ECU_ADDRESS 0x60003706 /end MEASUREMENT
/begin MEASUREMENT LLRMR_percTqResvSpv "Torque reserve non idle sportive" UWORD rel_uw_b100 1 100 0.00 99.99847 FORMAT "%8.5" ECU_ADDRESS 0x6000D930 /end MEASUREMENT
/begin MEASUREMENT LLRMR_percTqResvWght "gear based weighted torque reserve non idle" UWORD rel_uw_b100 1 100 0.00 99.99847 FORMAT "%8.5" ECU_ADDRESS 0x6000D932 /end MEASUREMENT
/begin MEASUREMENT LLRMR_tans_temp "local value for tans in LLRMR (MDG1)" UBYTE temp_ub_q0p75_o48 1 100 -48.0 143.3 FORMAT "%5.1" ECU_ADDRESS 0x600063B2 /end MEASUREMENT
/begin MEASUREMENT LLRMR_tmot_tmp "local value for tmot in LLRMR (MDG1)" UBYTE temp_ub_q0p75_o48 1 100 -48.0 143.3 FORMAT "%5.1" ECU_ADDRESS 0x600063B1 /end MEASUREMENT
/begin MEASUREMENT LLRMR_tnst_tmp "Local variable for time after end of start" UWORD t10msxs_uw_b655p35 1 100 0.00 655.3500 FORMAT "%8.4" ECU_ADDRESS 0x60003704 /end MEASUREMENT
/begin MEASUREMENT LLRMR_tosp_tmp "Local value of tosp" UBYTE temp_ub_q0p75_o48 1 100 -48.0 143.3 FORMAT "%5.1" ECU_ADDRESS 0x600063B0 /end MEASUREMENT
/begin MEASUREMENT LLRMR_vfzg_tmp "local value for vehicle speed in LLRMR (MDG1)" UBYTE vfzg_ub_q1p25 1 100 0.00 318.8 FORMAT "%5.1" ECU_ADDRESS 0x600063AF /end MEASUREMENT
/begin MEASUREMENT LLRNSNF_bReqdTrckSpRst "tracking sepoint reset bit when drive off is active" UBYTE B_TRUE 1 100 0.00 1.00000000000 BIT_MASK 0x1 FORMAT "%13.11" ECU_ADDRESS 0x600063AD /end MEASUREMENT
/begin MEASUREMENT LLRNSNF_dnEngFlt "filtered engine speed gradient" UBYTE B_TRUE 1 100 0.00 1.00000000000 BIT_MASK 0x1 FORMAT "%13.11" ECU_ADDRESS 0x600063AC /end MEASUREMENT
/begin MEASUREMENT LLRNSNF_nOffsSpLoTrckEna "Low idle set point offset to enable tracking" SWORD nmot_sw_q0p5 1 100 0.00 16383.50 FORMAT "%8.2" ECU_ADDRESS 0x60005012 /end MEASUREMENT
/begin MEASUREMENT llrnsnf_sns06llsbLoc "llrnsnf" SBYTE nmotd_sb_q10 1 100 -1280. 1270. FORMAT "%5.0" ECU_ADDRESS 0x600063AB /end MEASUREMENT
/begin MEASUREMENT llrnsnf_stm06llublLoc "llrnsnf" UBYTE temp_ub_q0p75_o48 1 100 -48.0 143.3 FORMAT "%5.1" ECU_ADDRESS 0x600063AA /end MEASUREMENT
/begin MEASUREMENT LLRNSTAT_nBascIdlSpdSp "Basic idle speed setpoint after limitation by the minimum setpoint" SWORD nmot_sw_q0p5 1 100 -16384.00 16383.50 FORMAT "%8.2" ECU_ADDRESS 0x600036F6 /end MEASUREMENT
/begin MEASUREMENT LLRNSTAT_nMinBascSpLo "Basic setpoint exported for reference in NSREQ" SWORD nmot_sw_q0p5 1 100 -16384.00 16383.50 FORMAT "%8.2" ECU_ADDRESS 0x60005010 /end MEASUREMENT
/begin MEASUREMENT nllmgfsglb_msg "desired idle speed in Drive-mode" UBYTE nmot_ub_q10 1 100 0.00 2550. FORMAT "%5.0" ECU_ADDRESS 0x60009FEA /end MEASUREMENT
/begin MEASUREMENT nllmgglb_msg "desired idle speed" UBYTE nmot_ub_q10 1 100 0.00 2550. FORMAT "%5.0" ECU_ADDRESS 0x60009FE9 /end MEASUREMENT
/begin MEASUREMENT nsnf_w "LLR: followed-up target speed" SWORD nmot_sw_q0p5 1 100 0.00 16383.50 FORMAT "%8.2" ECU_ADDRESS 0x60003700 /end MEASUREMENT
/begin MEASUREMENT nsolbas_msg "desired idle speed, basic value" UBYTE nmot_ub_q10 1 100 0.00 2550. FORMAT "%5.0" ECU_ADDRESS 0x6000A298 /end MEASUREMENT
/begin MEASUREMENT nsst_msg "Initialisation value for desired RPM during start" UBYTE nmot_ub_q10 1 100 0.00 2550. FORMAT "%5.0" ECU_ADDRESS 0x6000A293 /end MEASUREMENT
/begin MEASUREMENT nstat2_w "stationary desired idle-speed after limitation" SWORD nmot_sw_q0p5 1 100 -16384.00 16383.50 FORMAT "%8.2" ECU_ADDRESS 0x600036F4 /end MEASUREMENT
/begin MEASUREMENT nstat3 "Stationary desired idle-speed pre filter" UBYTE nmot_ub_q10 1 100 0.00 2550. FORMAT "%5.0" ECU_ADDRESS 0x600063A8 /end MEASUREMENT
/begin MEASUREMENT nstateng "Stationary reference speed for V-engine" UBYTE nmot_ub_q10 1 100 0.00 2550. FORMAT "%5.0" ECU_ADDRESS 0x600063A7 /end MEASUREMENT
/begin MEASUREMENT nstateng_w "Stationary reference speed for V-engine" SWORD nmot_sw_q0p5 1 100 -16384.00 16383.50 FORMAT "%8.2" ECU_ADDRESS 0x600036F2 /end MEASUREMENT
/begin MEASUREMENT nstatfil_msg "Stationary reference speed filtered" UBYTE nmot_ub_q10 1 100 0.00 2550. FORMAT "%5.0" ECU_ADDRESS 0x6000A291 /end MEASUREMENT
/begin MEASUREMENT nstatLoc "local variable for nstat" SWORD nmot_sw_q0p5 1 100 -16384.00 16383.50 FORMAT "%8.2" ECU_ADDRESS 0x600036F0 /end MEASUREMENT
/begin MEASUREMENT nstteold_w "frozen nstate" SWORD nmot_sw_q0p5 1 100 0.00 16383.50 FORMAT "%8.2" ECU_ADDRESS 0x600036FE /end MEASUREMENT
/begin MEASUREMENT SpdGov_trqResvRel "Relative torque reserve for idle speed control" SWORD md_sw_q0p1 1 100 -3276.800 3276.700 FORMAT "%8.3" ECU_ADDRESS 0x60004F18 /end MEASUREMENT
/begin MEASUREMENT tmot_llrnstat_loc "Engine temperature" UBYTE temp_ub_q0p75_o48 1 100 -48.0 143.3 FORMAT "%5.1" ECU_ADDRESS 0x600063A5 /end MEASUREMENT
/begin MEASUREMENT tmp_fakll "Factor to weight the desired speed at start during catalyst heating" UWORD fak_ub_b2 1 100 0.00 1.992188 FORMAT "%8.6" ECU_ADDRESS 0x600036FC /end MEASUREMENT
/begin MEASUREMENT tmst_llrnsnf_loc "Engine temperengine temperature at startature" UBYTE temp_ub_q0p75_o48 1 100 -48.0 143.3 FORMAT "%5.1" ECU_ADDRESS 0x600063A9 /end MEASUREMENT
/begin MEASUREMENT ubsqfilf_w "filtered battery voltage(faster)" UWORD spg_q0p00039 1 100 0.00 25.59961 FORMAT "%8.5" ECU_ADDRESS 0x6000D9C6 /end MEASUREMENT
/begin MEASUREMENT ubsqfil_w "filtered battery voltage" UWORD spg_q0p00039 1 100 0.00 25.59961 FORMAT "%8.5" ECU_ADDRESS 0x60003702 /end MEASUREMENT
/begin MEASUREMENT zknslo1_w "local variable to tap interface" UWORD zk10msxs_uw_b655p36 1 100 0.01000015 655.36000000 FORMAT "%12.8" ECU_ADDRESS 0x600036FA /end MEASUREMENT
/begin MEASUREMENT zknslo_w "Time constant for Engine speed set point tracing" UWORD zk10msxs_uw_b655p36 1 100 0.01000015 655.36000000 FORMAT "%12.8" ECU_ADDRESS 0x600036F8 /end MEASUREMENT
/begin FUNCTION LLim_CalcLimExt "13.0.0    Demand for limitation of maximum vehicle speed from extern"
 /begin DEF_CHARACTERISTIC LLim_ctASLAppATOpenLrn_C LLim_facAcclDeclCor_CUR LLim_facAPPDiffCor1LGCls_MAP LLim_facAPPDiffCor1LG_MAP LLim_facAPPDiffCor2LGCls_MAP LLim_facAPPDiffCor2LG_MAP LLim_facAPPDiffCor3LGCls_MAP LLim_facAPPDiffCor3LG_MAP LLim_facAPPDiffCor4LGCls_MAP LLim_facAPPDiffCor4LG_MAP LLim_facAPPDiffCor5LGCls_MAP LLim_facAPPDiffCor5LG_MAP LLim_facAPPDiffCorTGCls_MAP LLim_facAPPDiffCorTG_MAP LLim_facAPPReqItmFlt_C LLim_facCnvVehUn_C LLim_facConstDeclCor_CUR LLim_facFdbkAcclP1LG_CUR LLim_facFdbkAcclP2LG_CUR LLim_facFdbkAcclP3LG_CUR LLim_facFdbkAcclP4LG_CUR LLim_facFdbkAcclP5LG_CUR LLim_facFdbkAcclPTG_CUR LLim_facFdbkD1LG_MAP LLim_facFdbkD2LG_MAP LLim_facFdbkD3LG_MAP LLim_facFdbkD4LG_MAP LLim_facFdbkD5LG_MAP LLim_facFdbkDLmap_MAP LLim_facFdbkDTG_MAP LLim_facFdbkP1LG_MAP LLim_facFdbkP2LG_MAP LLim_facFdbkP3LG_MAP LLim_facFdbkP4LG_MAP LLim_facFdbkP5LG_MAP LLim_facFdbkPLmap_MAP LLim_facFdbkPTG_MAP LLim_facSpdUnConv_C LLim_facSptAPPDiffCor1LGCls_MAP LLim_facSptAPPDiffCor1LG_MAP LLim_facSptAPPDiffCor2LGCls_MAP LLim_facSptAPPDiffCor2LG_MAP LLim_facSptAPPDiffCor3LGCls_MAP LLim_facSptAPPDiffCor3LG_MAP LLim_facSptAPPDiffCor4LGCls_MAP LLim_facSptAPPDiffCor4LG_MAP LLim_facSptAPPDiffCor5LGCls_MAP LLim_facSptAPPDiffCor5LG_MAP LLim_facSptAPPdiffCorLmapCls_MAP LLim_facSptAPPdiffCorLmap_MAP LLim_facSptAPPDiffCorTGCls_MAP LLim_facSptAPPDiffCorTG_MAP LLim_facSptFdbkAcclP1LG_CUR LLim_facSptFdbkAcclP2LG_CUR LLim_facSptFdbkAcclP3LG_CUR LLim_facSptFdbkAcclP4LG_CUR LLim_facSptFdbkAcclP5LG_CUR LLim_facSptFdbkAcclPLmap_CUR LLim_facSptFdbkAcclPTG_CUR LLim_facSptFdbkD1LG_MAP LLim_facSptFdbkD2LG_MAP LLim_facSptFdbkD3LG_MAP LLim_facSptFdbkD4LG_MAP LLim_facSptFdbkD5LG_MAP LLim_facSptFdbkDTG_MAP LLim_facSptFdbkP1LG_MAP LLim_facSptFdbkP2LG_MAP LLim_facSptFdbkP3LG_MAP LLim_facSptFdbkP4LG_MAP LLim_facSptFdbkP5LG_MAP LLim_facSptFdbkPTG_MAP LLim_flgASLDispCncl_C LLim_flgMemSpdDisp_C LLim_flgMtrTypIndcnVehSpdASLCtrl_C LLim_nASLAppClsLrnStrtAdd_C LLim_numASLResSel_C LLim_numASLSpdInfoMOnNCtl_C LLim_numISALimSpdOffsetLoMph_C LLim_numISALimSpdOffsetLo_C LLim_numISALimSpdOffsetUpMph_C LLim_numISALimSpdOffsetUp_C LLim_numISAMetType_C LLim_numSpdInfoMOnNCtl_C LLim_r10msAddVar_C LLim_r10msSubVar_C LLim_rAPPAddVal_C LLim_rAPPFulChk_C LLim_rAPPLimTmpRlsAPP_C LLim_rAPPMaxDevl_CUR LLim_rAPPMax_CUR LLim_rAPPOff1LG_MAP LLim_rAPPOff2LG_MAP LLim_rAPPOff3LG_MAP LLim_rAPPOff4LG_MAP LLim_rAPPOff5LG_MAP LLim_rAPPOffLmap_MAP LLim_rAPPOffTG_MAP LLim_rAPPReqSet1LG_MAP LLim_rAPPReqSet2LG_MAP LLim_rAPPReqSet3LG_MAP LLim_rAPPReqSet4LG_MAP LLim_rAPPReqSet5LG_MAP LLim_rAPPReqSetLmap_MAP LLim_rAPPReqSetTG_MAP LLim_rAPPRetValAftLimRls_CUR LLim_rChngGearChkAPP_C LLim_rCnclAPPAdd_CUR LLim_rCnclIniAPPAdd_CUR LLim_rDesAddValFAStrt_CUR LLim_rDesAddValFreeArea_CUR LLim_rDesAPPDiffLim_C LLim_rDesSubVal_CUR LLim_rISACnclAPPAdd_CUR LLim_rISACnclIniAPPAdd_CUR LLim_rSptAPPMaxDevl_CUR LLim_rSptAPPOff1LG_MAP LLim_rSptAPPOff2LG_MAP LLim_rSptAPPOff3LG_MAP LLim_rSptAPPOff4LG_MAP LLim_rSptAPPOff5LG_MAP LLim_rSptAPPOffTG_MAP LLim_rSptAPPReqSet1LG_MAP LLim_rSptAPPReqSet2LG_MAP LLim_rSptAPPReqSet3LG_MAP LLim_rSptAPPReqSet4LG_MAP LLim_rSptAPPReqSet5LG_MAP LLim_rSptAPPReqSetTG_MAP LLim_stAPPLrnSel_C LLim_stASLResCdnChk_C LLim_stCCASLDataChkEna_C LLim_stGearMapNo_CA LLim_stIDASTrqLowSelA_C LLim_stIDASTrqLowSelB_C LLim_stISAContTSRClr_C LLim_stISATempStpAcclRecvr_C LLim_swtAcclLimDisbl_C LLim_swtAPPLimTmpRls_C LLim_swtAPPMinSel_C LLim_swtASLAppClsLrnSel_C LLim_swtASLAppOpenLrnSel_C LLim_swtASLAppSel_C LLim_swtASLRxErrChkSel_C LLim_swtCCSpdNoUpdReq_C LLim_swtCnclAcclLimEna_C LLim_swtDevlLimSel_C LLim_swtKickDwnClickCncl_C LLim_swtResu1Disbl_C LLim_swtSetSpdCorEna_C LLim_swtSpdNoUpdReq_C LLim_tiAPPLimTmpRls_C LLim_tiArChgAppSel_C LLim_tiASLAppClsLrnStrtWait_C LLim_tiASLAppClsLrnUpd0_C LLim_tiASLAppClsLrnUpd1_C LLim_tiASLAppOpenAlrm_C LLim_tiASLAppOpenLrnStrt_C LLim_tiASLRxErrChk_C LLim_tiASLSet_C LLim_tiCCASLDataErr_C LLim_tiCtlExtn_C LLim_tiISACtlExtn_C LLim_tiOvrSpdAlrmFin_C LLim_tiOvrSpdAlrmStrt2_C LLim_tiOvrSpdAlrmStrt_C LLim_tiSetSpdBlnOff2_C LLim_tiSetSpdBlnOff3_C LLim_tiSetSpdBlnOff4_C LLim_tiSetSpdBlnOn2_C LLim_tiSetSpdBlnOn3_C LLim_tiSetSpdBlnOn4_C LLim_uASLAppClsLrnChkDvt_C LLim_uASLAppClsLrnLoLim_C LLim_uASLAppClsLrnUpLim_C LLim_uASLAppClsNoLrn_C LLim_uASLAppOpenChk_C LLim_uASLAppOpenLrnLoLim_C LLim_uASLAppOpenLrnUpLim_C LLim_uASLAppSnsrErr_C LLim_uASLAppSnsrUpLim_C LLim_vAcclLim_CUR LLim_vAPPLimTmpRlsSpdDvt_C LLim_vCnclAcclLim_CUR LLim_vDLimHysHi1LG_CUR LLim_vDLimHysHi2LG_CUR LLim_vDLimHysHi3LG_CUR LLim_vDLimHysHi4LG_CUR LLim_vDLimHysHi5LG_CUR LLim_vDLimHysHiLmap_CUR LLim_vDLimHysHiTG_CUR LLim_vDLimHysLo1LG_CUR LLim_vDLimHysLo2LG_CUR LLim_vDLimHysLo3LG_CUR LLim_vDLimHysLo4LG_CUR LLim_vDLimHysLo5LG_CUR LLim_vDLimHysLoLmap_CUR LLim_vDLimHysLoTG_CUR LLim_vDvtSpdOvrAlrmHysHi_C LLim_vDvtSpdOvrAlrmHysLo_C LLim_vISACnclAcclLim_CUR LLim_vISAMemSpdLoLimKmh_C LLim_vISAMemSpdLoLimMPH_C LLim_vLimSpdIniUpdKmh_C LLim_vLimSpdIniUpdMPH_C LLim_vLimSpdUpdKmh_C LLim_vLimSpdUpdMPH_C LLim_vMemSpdCorKmh_C LLim_vMemSpdCorMPH_C LLim_vMemSpdKMHOffsHysHi_C LLim_vMemSpdKMHOffsHysLo_C LLim_vMemSpdLoLimKmh_C LLim_vMemSpdLoLimMPH_C LLim_vMemSpdMPHOffsHysHi_C LLim_vMemSpdMPHOffsHysLo_C LLim_vMemSpdUpLimKmh_C LLim_vMemSpdUpLimMPH_C LLim_vNoCtlPntHysHi1LG_CUR LLim_vNoCtlPntHysHi2LG_CUR LLim_vNoCtlPntHysHi3LG_CUR LLim_vNoCtlPntHysHi4LG_CUR LLim_vNoCtlPntHysHi5LG_CUR LLim_vNoCtlPntHysHiLmap_CUR LLim_vNoCtlPntHysHiTG_CUR LLim_vNoCtlPntHysLo1LG_CUR LLim_vNoCtlPntHysLo2LG_CUR LLim_vNoCtlPntHysLo3LG_CUR LLim_vNoCtlPntHysLo4LG_CUR LLim_vNoCtlPntHysLo5LG_CUR LLim_vNoCtlPntHysLoLmap_CUR LLim_vNoCtlPntHysLoTG_CUR LLim_vRPntHysHi1LG_CUR LLim_vRPntHysHi2LG_CUR LLim_vRPntHysHi3LG_CUR LLim_vRPntHysHi4LG_CUR LLim_vRPntHysHi5LG_CUR LLim_vRPntHysHiLmap_CUR LLim_vRPntHysHiTG_CUR LLim_vRPntHysLo1LG_CUR LLim_vRPntHysLo2LG_CUR LLim_vRPntHysLo3LG_CUR LLim_vRPntHysLo4LG_CUR LLim_vRPntHysLo5LG_CUR LLim_vRPntHysLoLmap_CUR LLim_vRPntHysLoTG_CUR LLim_vSptDLimHysHi1LG_CUR LLim_vSptDLimHysHi2LG_CUR LLim_vSptDLimHysHi3LG_CUR LLim_vSptDLimHysHi4LG_CUR LLim_vSptDLimHysHi5LG_CUR LLim_vSptDLimHysHiTG_CUR LLim_vSptDLimHysLo1LG_CUR LLim_vSptDLimHysLo2LG_CUR LLim_vSptDLimHysLo3LG_CUR LLim_vSptDLimHysLo4LG_CUR LLim_vSptDLimHysLo5LG_CUR LLim_vSptDLimHysLoTG_CUR LLim_vSptNoCtlPntHysHi1LG_CUR LLim_vSptNoCtlPntHysHi2LG_CUR LLim_vSptNoCtlPntHysHi3LG_CUR LLim_vSptNoCtlPntHysHi4LG_CUR LLim_vSptNoCtlPntHysHi5LG_CUR LLim_vSptNoCtlPntHysHiTG_CUR LLim_vSptNoCtlPntHysLo1LG_CUR LLim_vSptNoCtlPntHysLo2LG_CUR LLim_vSptNoCtlPntHysLo3LG_CUR LLim_vSptNoCtlPntHysLo4LG_CUR LLim_vSptNoCtlPntHysLo5LG_CUR LLim_vSptNoCtlPntHysLoTG_CUR LLim_vSptRPntHysHi1LG_CUR LLim_vSptRPntHysHi2LG_CUR LLim_vSptRPntHysHi3LG_CUR LLim_vSptRPntHysHi4LG_CUR LLim_vSptRPntHysHi5LG_CUR LLim_vSptRPntHysHiTG_CUR LLim_vSptRPntHysLo1LG_CUR LLim_vSptRPntHysLo2LG_CUR LLim_vSptRPntHysLo3LG_CUR LLim_vSptRPntHysLo4LG_CUR LLim_vSptRPntHysLo5LG_CUR LLim_vSptRPntHysLoTG_CUR LLim_vStrtSpdDvt_C LLim_vTmpRelsAlrmDif_C /end DEF_CHARACTERISTIC
 /begin REF_CHARACTERISTIC CrCtl_tiIdasbErr_C CrCUI_stFctInfo_C CrCUI_stISAtoASLbyResSet_C /end REF_CHARACTERISTIC
 /begin IN_MEASUREMENT AccPed_swtDrvMod APP_r APP_rMaxLrnUnFlt APP_uRaw1 CoEng_st Com_bDigMtrUnit Com_flgGwIMG3Norm Com_flgIDASBNorm Com_stATErr4 Com_stEAT3Mon Com_stIDASEngFail Com_stIDASInhb Com_stIDASTrqLowSel Com_stSpdSnsrFailr CoVMD_rCrCtlACCReq CoVMD_rLLimACCReq CoVMD_stSwtCCASLTqSeln CrCtl_numACCType CrCtl_numATType CrCtl_rDes CrCtl_rEstSlpFltVal CrCtl_stActive CrCtl_stASLSysOffReq CrCtl_stASLTaskCont CrCtl_stCond CrCtl_stErrMTVehSpd CrCtl_stLmpOn CrCtl_tiContInhib CrCtl_tiIGNOnVeh CrCtl_vACCMemSpdKmh CrCtl_vACCMemSpdMPH CrCtl_vASLAcclFltVal CrCtl_vASLVehCont CrCtl_vMemSpd CrCUI_ctResuOnSpdUpd CrCUI_ctSetOnSpdUpd CrCUI_numSelMode CrCUI_numTSRLimSpd CrCUI_stACCASLSwtErrDet CrCUI_stACCClthOn CrCUI_stACCNoUpdReq CrCUI_stASLMainDeb CrCUI_stASLSpdNoUpdReq CrCUI_stASLtoISASpdLim CrCUI_stCancelSwt CrCUI_stCANRxErr CrCUI_stCCASLVehUn CrCUI_stCrsASLSelFild CrCUI_stCrsSwtErrDet CrCUI_stCrsSwtFild CrCUI_stCvtLmap CrCUI_stFctInfo CrCUI_stGearDownNo CrCUI_stISAContTSRClr CrCUI_stISAModeMnSW CrCUI_stISAtoASLbyResSet CrCUI_stMainDeb CrCUI_stMETSpdDspEna CrCUI_stModeChgCncl CrCUI_stSwtClthDeb CrCUI_stSwtOnSpdUpd CrCUI_stSwtResNo CrCUI_stSwtSetNo CrCUI_stTSRErr CrCUI_stVehUn CrCUI_swtMETTyp CrCUI_vMETSpd CrCUI_vMETSpd2 Dspl_stASLRxErr Epm_nEng Gbx_uAPPMaxLrn I14229_stSuppRst PT_stTraType SpdGov_nSetPLo SyC_ctIrrSwOff SyC_stHistTiPostDrvMax T15_st VehV_vSens /end IN_MEASUREMENT
 /begin OUT_MEASUREMENT LLim_flgASLCtrlTmpHalt LLim_flgASLOverSpd LLim_flgMemDisp LLim_numMETAlrm LLim_numMETMemSpd LLim_rCCASLAppReq LLim_rDes LLim_stActive LLim_stActvLmp LLim_stActvLmpItm1 LLim_stActvLmpItm2 LLim_stAlrmSoundStrtEdge LLim_stAlrmStrtEdge LLim_stASLIdasbCanErr LLim_stASLRxErrDet LLim_stCCASLDataErr LLim_stISAContTSRClr LLim_stMetCCMode1 LLim_stMetCCMode2 LLim_stMETVehUn LLim_stModeNo LLim_stSpdNoUpdReq LLim_vMemDisp /end OUT_MEASUREMENT
 /begin LOC_MEASUREMENT LLim_ctASLAppATOpenLrn_mp LLim_facAcclP_mp LLim_facAcclShutOff_mp LLim_facAPPDiffCor_mp LLim_facConstD_mp LLim_facConstP_mp LLim_facConstShutOff_mp LLim_flgISAOccUnitChg LLim_numMETDspSelOld_mp LLim_numMETDspSel_mp LLim_numMETSpdBlnOld_mp LLim_numMETSpdBln_mp LLim_numTSRLimSpdClr_mp LLim_numTSRLimSpdOffset_mp LLim_numTSRLimSpdOld_mp LLim_rAcclReqVar_mp LLim_rAppASLCncl_mp LLim_rAPPCnclRetAcclLim_mp LLim_rAPPCnclRetFin_mp LLim_rAPPCnclRet_mp LLim_rAPPIniReq_mp LLim_rAPPLimTmpRlsAPPOld_mp LLim_rAPPLimTmpRlsAPP_mp LLim_rAPPMax_mp LLim_rAPPReqFin_mp LLim_rAPPReqItmFltOld_mp LLim_rAPPReqItmFlt_mp LLim_rAPPReqItm_mp LLim_rAPP_mp LLim_rConstReqVar_mp LLim_rDeclReqVar_mp LLim_rDesReq_mp LLim_rDiff100msItm_mp LLim_rDiff100ms_mp LLim_stAPPLimTmpRls_mp LLim_stAPPOffReq_mp LLim_stAPPOvr_mp LLim_stASLAppClsLrnHist_mp LLim_stASLAppOpenAlrm_mp LLim_stCnclAlrm_mp LLim_stCondNo_mp LLim_stIniOut_mp LLim_stIniReq_mp LLim_stISACnclAcclRecvr_mp LLim_stISAContTSRClrOld_mp LLim_stISATempStpOld_mp LLim_stISATempStp_mp LLim_stModeNoOld_mp LLim_stResWait_mp LLim_stSetSpdIdcBlnOff_mp LLim_stVehSpdAreaNoOld_mp LLim_stVehSpdAreaNo_mp LLim_stVehSpdOver_mp LLim_stVehUnSelOld_mp LLim_stVehUnSel_mp LLim_tiAPPLimTmpRls_mp LLim_tiArChgAppSel_mp LLim_tiASLAppClsLrnStrt_mp LLim_tiASLAppClsLrnUpd_mp LLim_tiASLAppOpenAlrm_mp LLim_tiASLAppOpenLrnStrt_mp LLim_tiASLCnclSound LLim_tiASLIdasbErr_mp LLim_tiASLRxErr_mp LLim_tiASLSet_mp LLim_tiCCASLDataErr_mp LLim_tiCnclAlrm_mp LLim_tiCtlExtn_mp LLim_tiISATempStpBlnk_mp LLim_tiOvrSpdAlrmFin_mp LLim_tiOvrSpdAlrmStrt_mp LLim_tiSetSpdBlnOff_mp LLim_tiSetSpdBlnOn_mp LLim_uASLAppATSnsrOpenLrnOld_mp LLim_uASLAppClsLrnStrt_mp LLim_uASLAppClsLrn_mp LLim_uASLAppOpenLrnStrt_mp LLim_uASLAppOpenLrn_mp LLim_uASLAppSnsr_mp LLim_vAcclDvt_mp LLim_vAPPLimTmpRlsSpd_mp LLim_vDesAccl_mp LLim_vDes_mp LLim_vDLimHysHi_mp LLim_vDLimHysLo_mp LLim_vDLim_mp LLim_vISALimSpdOffsetLo_mp LLim_vISALimSpdOffsetUp_mp LLim_vMemSpdAftCncl_mp LLim_vMemSpdFinAftCor_mp LLim_vMemSpdFin_mp LLim_vMemSpdLoLim_mp LLim_vMemSpdMPH_mp LLim_vMemSpdOld_mp LLim_vMemSpdResOnKmh_mp LLim_vMemSpdResOnMPH_mp LLim_vMemSpdResTrnOnKmh_mp LLim_vMemSpdResTrnOnMPH_mp LLim_vMemSpdSetOnKmh_mp LLim_vMemSpdSetOnMPH_mp LLim_vMemSpdSetTrnOnKmh_mp LLim_vMemSpdSetTrnOnMPH_mp LLim_vMemSpdSwtOnKmh_mp LLim_vMemSpdSwtOnMPH_mp LLim_vMemSpdUpLim_mp LLim_vMemSpdVerfDat_mp LLim_vMemSpd_mp LLim_vMETMemSpdItmKmh_mp LLim_vMETMemSpdItmMPH_mp LLim_vNoCtlPntHysHi_mp LLim_vNoCtlPntHysLo_mp LLim_vNoCtlPnt_mp LLim_vRPntHysHi_mp LLim_vRPntHysLo_mp LLim_vRPnt_mp LLim_vSpdDvt_mp LLim_vTSRLimSpdTmp_mp /end LOC_MEASUREMENT
 FUNCTION_VERSION "13.0.0" /end FUNCTION
/begin FUNCTION LLim_Lib "1.4.0_2.1.0Adjustable Speed Limiter Library functions" /begin IN_MEASUREMENT AccPed_swtDrvMod CrCUI_stCvtLmap CrCUI_stSptDrvMod /end IN_MEASUREMENT FUNCTION_VERSION "1.4.0_2.1.0" /end FUNCTION
/begin FUNCTION LLRMR "28.1.0    Torque reserve for idle speed control"
 /begin DEF_CHARACTERISTIC CWKUPPL CWLLRMR CWLLRMR2 DMRESHH DMRESLLDOWN DMRESLLUP DMRESUB DNLLRESW DUBATG DUBSUBQ KFETAZWOFF KFFKTMRFS KFMRENHER KFMRES KFMRESAC KFMRESACT KFMRESFS KFMRESFSSAIL KFMRESFSSP KFMRESFSSPP KFMRESI KFMRESK KFMRESKH KFMRESLT KFMRESNL KFMRESSAIL KFMRESSP KFMRESSPP KFMRESTA KLDMRESTM KLDNLLDE KLGNGW KLGNSTAT KLMRESLLSTA KLMRESPHIR KLMRESTM KLMRESUB KLMRHO KLMRHOFS KLTVRESTM KLVANF LIVFZDE LIVFZMNDE LLRMR_facTqResvHeatrReq_M LLRMR_facTqResvIdleBrkNotActv_M LLRMR_facTqResvIdle_M LLRMR_nIdleTqResvThd_C LLRMR_nMinNThdRst_C LLRMR_percEngGrdtDwnRmp_C LLRMR_percTqResvEngGrdt_MAP LLRMR_percTqResvHeatrReq_M LLRMR_percTqResvMin_C LLRMR_percTqResvThdDrv_C LLRMR_slopeNegTqResv_C LLRMR_slopePosTqResv_C LLRMR_stCluOpnCmpl_C LLRMR_stCluOpnNotCmpl_C LLRMR_swtFltSeln_C LLRMR_tCatMaxActvt_C LLRMR_tCatMaxDeactvt_C LLRMR_tiDlyRmpEngGrdt_C LLRMR_tMinTqResvActv_C MRENSTA MRESHH MRESUB SDLLRMR SMI04LLUBL SNM06LLUWL SNS06LLSBL STA04LLUBL STM04SAUBL TDDMRLLR TDMRESHH TDMRESLW TDMRESUB TDSIGNHH TDUBSQ TDUBSTND TVGRMR TVRESLL VANF ZKDMRUB ZKDMRUBF /end DEF_CHARACTERISTIC
 /begin IN_MEASUREMENT AirC_bBackliteHeatgReq BattU_u Brk_st B_fs_msg B_khakw_msg B_kh_msg B_koe_msg B_ll_msg B_sa_msg CEngDsT_t Clth_st Com_flgLETAcTqResvReplcmt Com_stAC DOGov_trqResv DrvPrgSwt_bSprt DrvPrgSwt_bSprtPlus EngStrt_bStrt EnvT_t Epm_dnEngAvg Epm_dnEngAvgFlt Epm_dnEngFlt Epm_nEng Epm_nEngLRes etazwmn_w_msg ExhMod_tCat1MaxB1 fmi2trq_w_msg gangi_msg Gbx_bSailActv HLSDem_nSetPLo mibmn_w_msg mibmx_w_msg mifa_w_msg OilSwmpT_t PEnv_facCorrAlti PT_rTrq PT_stTraType rl_w_msg SpdGov_nSetPLo tans_msg tnst_w_msg Tra_numGear tumg_msg VehPos_rIncIX VehV_v WaHt_flgHeatrRiseReq WaHt_tDeltaEngT /end IN_MEASUREMENT
 /begin OUT_MEASUREMENT B_llde_msg B_zwafh_msg dmresll_w_msg dmrllr_w_msg LLRMR_bTrqResActv LLRMR_bTrqResInActv LLRMR_percTqResvEngGrdt SpdGov_trqResvRel /end OUT_MEASUREMENT
 /begin LOC_MEASUREMENT B_kuplaus ddmrllr_w dmralt dmrdiaiv_w dmrenher_w dmresb_w dmresubg dmresub_mp LLRMR_dmreshh llrmr_dmresll LLRMR_dns_temp LLRMR_etazwmn LLRMR_fho_tmp LLRMR_flgClthStDefn LLRMR_flgTrsmClthSt LLRMR_gangi_tmp LLRMR_mibmn LLRMR_mifa_w_tmp LLRMR_nmotw_tmp LLRMR_nmot_tmp LLRMR_percTqResvBas LLRMR_percTqResvDrvMod LLRMR_percTqResvEngGrdtOld LLRMR_percTqResvHeatrReq LLRMR_percTqResvLtd LLRMR_percTqResvOffsLtd LLRMR_percTqResvSpv LLRMR_percTqResvWght LLRMR_tans_temp LLRMR_tmot_tmp LLRMR_tnst_tmp LLRMR_tosp_tmp LLRMR_vfzg_tmp ubsqfilf_w ubsqfil_w /end LOC_MEASUREMENT
 FUNCTION_VERSION "28.1.0" /end FUNCTION
/begin FUNCTION LLRNSNF "28.1.0    Idle speed guidance"
 /begin DEF_CHARACTERISTIC CWLLRNSNF DNNSNF DNSNFX_W FNSNF FNSSTKM FNSSTM FZNSMGA FZNSMTM KLDNSNFST KLZNSM KLZNSMTRA KNSNF_W LLRNSNF_flgSwtNGrdt_C LLRNSNF_nSpLoDiff_X_Ax NGNSNF NSOLMX_W STM06LLUBL STS08ESUBL TDDEANF /end DEF_CHARACTERISTIC
 /begin IN_MEASUREMENT B_enllri_msg B_khn_msg B_llrein_msg B_llrst_msg B_ll_msg B_nswo1_msg CEngDsT_t CEngDsT_tStrt CoPT_nMinTra Epm_dnEngAvg Epm_dnEngAvgFlt Epm_nEng gangsist_msg HLSDem_bDrvOffSuprtActv HLSDem_nDrvOffSuprtSp HLSDem_nDrvOffSuprtSpRaw HLSDem_nSetPLo /end IN_MEASUREMENT
 /begin OUT_MEASUREMENT B_freezenf_msg HLSDem_nSetPLoDiff HLSDem_nSetPTrck LLRNSNF_nOffsSpLoTrckEna nsst_msg /end OUT_MEASUREMENT
 /begin LOC_MEASUREMENT gangsist_llrnsnf_loc LLRNSNF_bReqdTrckSpRst LLRNSNF_dnEngFlt llrnsnf_sns06llsbLoc llrnsnf_stm06llublLoc nsnf_w nstteold_w tmp_fakll tmst_llrnsnf_loc zknslo1_w zknslo_w /end LOC_MEASUREMENT
 FUNCTION_VERSION "28.1.0" /end FUNCTION
/begin FUNCTION LLRNSTAT "30.0.0    Stationary idle speed, coordination and filtering"
 /begin DEF_CHARACTERISTIC CNFLLRNS CWLLRNS CWNSTAT LLRNSTAT_nOffsIgnAgnlFix_C LLRNSTAT_nThrIceAdh_M LLRNSTAT_tiPT1HvyDecel1_C LLRNSTAT_tiPT1HvyDecel2_C NFSMIN NLLMG NLLMGFS NLLMIN NTIPLL SGA09LLSB STM06LLUB_LLRNSTAT ZKNSU_W ZKNS_W /end DEF_CHARACTERISTIC
 /begin IN_MEASUREMENT Brk_st B_fa_msg B_fs_msg B_khnshp_msg B_kh_msg B_llrein_msg B_ll_msg B_nswo1_msg B_vllr_msg CEngDsT_t CoPT_nMinAcs CoPT_nMinSysErr CoPT_nMinTra CoPT_stNSetPAcs CoPT_stNSetPSysErr CoPT_stNSetPTra EngStrt_bStrtEnd Epm_nEngLRes gangsist_msg Gbx_nIdlDes HLSDem_nDrvOffSuprtSp HLSDem_stDrvOffSuprtSpFilTyp nsmodlph_msg nsolblp_msg nsolcat_msg nsolhti_msg nsollph_msg nsolpts_msg Pt_flgFcoInhb SrvCSwt_st ThrVlv_flgColdCdnOffsActvB1 /end IN_MEASUREMENT
 /begin OUT_MEASUREMENT B_brufs_msg B_tpn_msg gangllrs_msg HLSDem_nMinWoCat HLSDem_nMinWoTraIntv HLSDem_nSetPLo HLSDem_nStatyEng HLSDem_nStyFildIdle LLRNSTAT_nMinBascSpLo nllmgfsglb_msg nllmgglb_msg nsolbas_msg nstatfil_msg /end OUT_MEASUREMENT
 /begin LOC_MEASUREMENT gangsist_llrnstat_loc LLRNSTAT_nBascIdlSpdSp nstat2_w nstat3 nstateng nstateng_w nstatLoc tmot_llrnstat_loc /end LOC_MEASUREMENT
 FUNCTION_VERSION "30.0.0" /end FUNCTION
/begin COMPU_METHOD APPCrCtl1 "" RAT_FUNC "%6.4" "%" COEFFS 0 200 0 0 0 1 /end COMPU_METHOD
/begin COMPU_METHOD B_TRUE "" TAB_VERB "%6.3" "" COMPU_TAB_REF B_TRUE /end COMPU_METHOD
/begin COMPU_VTAB B_TRUE "" TAB_VERB 2 0 "FALSE" 1 "TRUE" /end COMPU_VTAB
/begin COMPU_METHOD dez "" RAT_FUNC "%6.2" "" COEFFS 0 1 0 0 0 1 /end COMPU_METHOD
/begin COMPU_METHOD EngN "" RAT_FUNC "%6.3" "rpm" COEFFS 0 2 0 0 0 1 /end COMPU_METHOD
/begin COMPU_METHOD EngNCrCtl "" RAT_FUNC "%6.2" "rpm" COEFFS 0 1 0 0 0 1 /end COMPU_METHOD
/begin COMPU_METHOD EngNGrd "" RAT_FUNC "%6.3" "rpm/s" COEFFS 0 2 0 0 0 1 /end COMPU_METHOD
/begin COMPU_METHOD Fact1 "" RAT_FUNC "%6.4" "-" COEFFS 0 128 0 0 0 1 /end COMPU_METHOD
/begin COMPU_METHOD Fact_10000 "" RAT_FUNC "%7.6" "-" COEFFS 0 10000 0 0 0 1 /end COMPU_METHOD
/begin COMPU_METHOD Fact_CrCtl "" RAT_FUNC "%6.4" "-" COEFFS 0 256 0 0 0 1 /end COMPU_METHOD
/begin COMPU_METHOD Fact_CrCtl2 "" RAT_FUNC "%6.4" "-" COEFFS 0 64 0 0 0 1 /end COMPU_METHOD
/begin COMPU_METHOD Fact_CrCtl3 "" RAT_FUNC "%6.5" "-" COEFFS 0 1024 0 0 0 1 /end COMPU_METHOD
/begin COMPU_METHOD fak_q0p005 "" RAT_FUNC "%6.4" "" COEFFS 0 200 0 0 0 1 /end COMPU_METHOD
/begin COMPU_METHOD fak_ub_b1 "" RAT_FUNC "%6.4" "-" COEFFS 0 256 0 0 0 1 /end COMPU_METHOD
/begin COMPU_METHOD fak_ub_b2 "" RAT_FUNC "%8.5" "-" COEFFS 0 256 0 0 0 2 /end COMPU_METHOD
/begin COMPU_METHOD fak_ub_b4 "" RAT_FUNC "%6.4" "-" COEFFS 0 256 0 0 0 4 /end COMPU_METHOD
/begin COMPU_METHOD fak_uw_b2 "" RAT_FUNC "%7.6" "-" COEFFS 0 65536 0 0 0 2 /end COMPU_METHOD
/begin COMPU_METHOD fak_uw_q0p1 "" RAT_FUNC "%6.3" "" COEFFS 0 1 0 0 0 0.1 /end COMPU_METHOD
/begin COMPU_METHOD md_sw_q0p1 "" RAT_FUNC "%6.3" "Nm" COEFFS 0 10 0 0 0 1 /end COMPU_METHOD
/begin COMPU_METHOD nmotd_sb_q10 "" RAT_FUNC "%6.1" "1/min" COEFFS 0 1 0 0 0 10 /end COMPU_METHOD
/begin COMPU_METHOD nmotg_sb_q100 "" RAT_FUNC "%6.0" "1/min/s" COEFFS 0 1 0 0 0 100 /end COMPU_METHOD
/begin COMPU_METHOD nmotg_ub_q100 "" RAT_FUNC "%6.0" "1/min/s" COEFFS 0 1 0 0 0 100 /end COMPU_METHOD
/begin COMPU_METHOD nmot_sw_q0p25 "" RAT_FUNC "%6.3" "1/min" COEFFS 0 1 0 0 0 0.25 /end COMPU_METHOD
/begin COMPU_METHOD nmot_sw_q0p5 "" RAT_FUNC "%6.3" "1/min" COEFFS 0 2 0 0 0 1 /end COMPU_METHOD
/begin COMPU_METHOD nmot_ub_q10 "" RAT_FUNC "%6.1" "1/min" COEFFS 0 1 0 0 0 10 /end COMPU_METHOD
/begin COMPU_METHOD nmot_ub_q40 "" RAT_FUNC "%6.1" "1/min" COEFFS 0 1 0 0 0 40 /end COMPU_METHOD
/begin COMPU_METHOD nmot_uw_q0p25 "" RAT_FUNC "%6.3" "1/min" COEFFS 0 1 0 0 0 0.25 /end COMPU_METHOD
/begin COMPU_METHOD OneToOne "" RAT_FUNC "%6.2" "-" COEFFS 0 1 0 0 0 1 /end COMPU_METHOD
/begin COMPU_METHOD Prc "" RAT_FUNC "%6.4" "%" COEFFS 0 81.92 0 0 0 1 /end COMPU_METHOD
/begin COMPU_METHOD PrcHigh "" RAT_FUNC "%6.5" "%" COEFFS 0 1000 0 0 0 1 /end COMPU_METHOD
/begin COMPU_METHOD Prc_CrCtl4 "" RAT_FUNC "%6.4" "%" COEFFS 0 256 0 0 0 1 /end COMPU_METHOD
/begin COMPU_METHOD q2p32831_Perc_DIV_s "" RAT_FUNC "%7.6" "%/s" COEFFS 0 4294967296 0 0 0 100000 /end COMPU_METHOD
/begin COMPU_METHOD rel_q0p00153 "" RAT_FUNC "%6.4" "%" COEFFS 0 65536 0 0 0 100 /end COMPU_METHOD
/begin COMPU_METHOD rel_q0p0234 "" RAT_FUNC "%6.4" "%" COEFFS 0 128 0 0 0 3 /end COMPU_METHOD
/begin COMPU_METHOD rel_ub_b25 "" RAT_FUNC "%6.3" "%" COEFFS 0 256 0 0 0 25 /end COMPU_METHOD
/begin COMPU_METHOD rel_uw_b100 "" RAT_FUNC "%6.4" "%" COEFFS 0 65536 0 0 0 100 /end COMPU_METHOD
/begin COMPU_METHOD rfak_q0p5 "" RAT_FUNC "%6.2" "-" COEFFS 0 0 128 0 1 0 /end COMPU_METHOD
/begin COMPU_METHOD RmpDtyCyc "" RAT_FUNC "%6.5" "%/s" COEFFS 0 6553.6 0 0 0 1 /end COMPU_METHOD
/begin COMPU_METHOD RmpPrc "" RAT_FUNC "%6.5" "%/s" COEFFS 0 5368.70912 0 0 0 1 /end COMPU_METHOD
/begin COMPU_METHOD Rmp_1 "" RAT_FUNC "%6.5" "1/s" COEFFS 0 1000 0 0 0 1 /end COMPU_METHOD
/begin COMPU_METHOD RMTAPP_ENBL_SY_Compu "" TAB_VERB "%6.3" "" COMPU_TAB_REF RMTAPP_ENBL_SY_Compu /end COMPU_METHOD
/begin COMPU_VTAB RMTAPP_ENBL_SY_Compu "" TAB_VERB 2 0 "False" 1 "True" /end COMPU_VTAB
/begin COMPU_METHOD RNGMOD_TQFRICADPNGBXPHD_SC_Compu "" TAB_VERB "%6.3" "" COMPU_TAB_REF RNGMOD_TQFRICADPNGBXPHD_SC_Compu /end COMPU_METHOD
/begin COMPU_VTAB RNGMOD_TQFRICADPNGBXPHD_SC_Compu "" TAB_VERB 2 0 "False" 1 "True" /end COMPU_VTAB
/begin COMPU_METHOD ROADGRDTDETN_SC_Compu "" TAB_VERB "%6.3" "" COMPU_TAB_REF ROADGRDTDETN_SC_Compu /end COMPU_METHOD
/begin COMPU_VTAB ROADGRDTDETN_SC_Compu "" TAB_VERB 2 0 "False" 1 "True" /end COMPU_VTAB
/begin COMPU_METHOD ROCKMOD_SC_Compu "" TAB_VERB "%6.3" "" COMPU_TAB_REF ROCKMOD_SC_Compu /end COMPU_METHOD
/begin COMPU_VTAB ROCKMOD_SC_Compu "" TAB_VERB 2 0 "False" 1 "True" /end COMPU_VTAB
/begin COMPU_METHOD RPLUSMOD_SC_Compu "" TAB_VERB "%6.3" "" COMPU_TAB_REF RPLUSMOD_SC_Compu /end COMPU_METHOD
/begin COMPU_VTAB RPLUSMOD_SC_Compu "" TAB_VERB 2 0 "False" 1 "True" /end COMPU_VTAB
/begin COMPU_METHOD RRDFOGSWT_HWACTV_SC_Compu "" TAB_VERB "%6.3" "" COMPU_TAB_REF RRDFOGSWT_HWACTV_SC_Compu /end COMPU_METHOD
/begin COMPU_VTAB RRDFOGSWT_HWACTV_SC_Compu "" TAB_VERB 2 0 "Inactive" 1 "Active" /end COMPU_VTAB
/begin COMPU_METHOD RTE_RIPSIMPLTIMEDCOM_SC_Compu "" TAB_VERB "%6.3" "" COMPU_TAB_REF RTE_RIPSIMPLTIMEDCOM_SC_Compu /end COMPU_METHOD
/begin COMPU_VTAB RTE_RIPSIMPLTIMEDCOM_SC_Compu "" TAB_VERB 2 0 "False" 1 "True" /end COMPU_VTAB
/begin COMPU_METHOD SAIL_SY_Compu "" TAB_VERB "%6.3" "" COMPU_TAB_REF SAIL_SY_Compu /end COMPU_METHOD
/begin COMPU_VTAB SAIL_SY_Compu "" TAB_VERB 2 0 "False" 1 "True" /end COMPU_VTAB
/begin COMPU_METHOD SANDMOD_SC_Compu "" TAB_VERB "%6.3" "" COMPU_TAB_REF SANDMOD_SC_Compu /end COMPU_METHOD
/begin COMPU_VTAB SANDMOD_SC_Compu "" TAB_VERB 2 0 "False" 1 "True" /end COMPU_VTAB
/begin COMPU_METHOD SCAV_INHOUSE_SY_Compu "" TAB_VERB "%6.3" "" COMPU_TAB_REF SCAV_INHOUSE_SY_Compu /end COMPU_METHOD
/begin COMPU_VTAB SCAV_INHOUSE_SY_Compu "" TAB_VERB 2 0 "False" 1 "True" /end COMPU_VTAB
/begin COMPU_METHOD SCRM_kg_q0p001_COMPU "" RAT_FUNC "%6.5" "kg" COEFFS 0 1000 0 0 0 1 /end COMPU_METHOD
/begin COMPU_METHOD SCR_DmStp0001 "" RAT_FUNC "%6.5" "mg/Step" COEFFS 0 1000 0 0 0 1 /end COMPU_METHOD
/begin COMPU_METHOD spg_q0p00039 "" RAT_FUNC "%6.5" "V" COEFFS 0 1 0 0 0 0.000390625 /end COMPU_METHOD
/begin COMPU_METHOD t10msxs_uw_b655p35 "" RAT_FUNC "%6.4" "s" COEFFS 0 1 0 0 0 0.01 /end COMPU_METHOD
/begin COMPU_METHOD t20msxs_ub_b5p1 "" RAT_FUNC "%6.4" "s" COEFFS 0 1 0 0 0 0.02 /end COMPU_METHOD
/begin COMPU_METHOD t20msxs_uw_q0p02 "" RAT_FUNC "%6.4" "s" COEFFS 0 1 0 0 0 0.02 /end COMPU_METHOD
/begin COMPU_METHOD Temp_Cels "" RAT_FUNC "%6.1" "deg C" COEFFS 0 10 2731.4 0 0 1 /end COMPU_METHOD
/begin COMPU_METHOD temp_ub_q0p75_o48 "" RAT_FUNC "%6.2" "Grad C" COEFFS 0 1 48 0 0 0.75 /end COMPU_METHOD
/begin COMPU_METHOD Time_ms "" RAT_FUNC "%6.1" "ms" COEFFS 0 0.1 0 0 0 1 /end COMPU_METHOD
/begin COMPU_METHOD Time_ms_100ms "" RAT_FUNC "%6.0" "ms" COEFFS 0 0.01 0 0 0 1 /end COMPU_METHOD
/begin COMPU_METHOD TransR "" RAT_FUNC "%6.4" "-" COEFFS 0 100 0 0 0 1 /end COMPU_METHOD
/begin COMPU_METHOD t_q0p01 "" RAT_FUNC "%6.4" "s" COEFFS 0 100 0 0 0 1 /end COMPU_METHOD
/begin COMPU_METHOD t_q0p02 "" RAT_FUNC "%6.4" "s" COEFFS 0 100 0 0 0 2 /end COMPU_METHOD
/begin COMPU_METHOD Vel "" RAT_FUNC "%6.4" "km/h" COEFFS 0 100 0 0 0 1 /end COMPU_METHOD
/begin COMPU_METHOD Vel_CrCtl1 "" RAT_FUNC "%6.2" "km/h" COEFFS 0 1 0 0 0 1 /end COMPU_METHOD
/begin COMPU_METHOD Vel_CrCtl1_MPH "" RAT_FUNC "%6.2" "MPH" COEFFS 0 1 0 0 0 1 /end COMPU_METHOD
/begin COMPU_METHOD Vel_CrCtl_MPH "" RAT_FUNC "%6.4" "MPH" COEFFS 0 256 0 0 0 1 /end COMPU_METHOD
/begin COMPU_METHOD vfzg_ub_q1p25 "" RAT_FUNC "%6.2" "km/h" COEFFS 0 1 0 0 0 1.25 /end COMPU_METHOD
/begin COMPU_METHOD Volt "" RAT_FUNC "%6.3" "mV" COEFFS 0 5 0 0 0 1 /end COMPU_METHOD
/begin COMPU_METHOD Volt_Batt "" RAT_FUNC "%6.1" "mV" COEFFS 0 0.05 0 0 0 1 /end COMPU_METHOD
/begin COMPU_METHOD zk10msxs_uw_b655p36 "" RAT_FUNC "%6.2" "s" COEFFS 0 0 65536 0 100 0 /end COMPU_METHOD
/begin COMPU_METHOD zk20msxs_uw_b1310 "" RAT_FUNC "%6.1" "s" COEFFS 0 0 65536 0 50 0 /end COMPU_METHOD
/begin RECORD_LAYOUT RB_Axis_S16 NO_AXIS_PTS_X 1 SWORD AXIS_PTS_X 2 SWORD INDEX_INCR DIRECT /end RECORD_LAYOUT
/begin RECORD_LAYOUT RB_Axis_S8 NO_AXIS_PTS_X 1 SBYTE AXIS_PTS_X 2 SBYTE INDEX_INCR DIRECT /end RECORD_LAYOUT
/begin RECORD_LAYOUT RB_Axis_U16 NO_AXIS_PTS_X 1 UWORD AXIS_PTS_X 2 UWORD INDEX_INCR DIRECT /end RECORD_LAYOUT
/begin RECORD_LAYOUT RB_Axis_U8 NO_AXIS_PTS_X 1 UBYTE AXIS_PTS_X 2 UBYTE INDEX_INCR DIRECT /end RECORD_LAYOUT
/begin RECORD_LAYOUT RB_CurveGroup_S16 FNC_VALUES 1 SWORD COLUMN_DIR DIRECT /end RECORD_LAYOUT
/begin RECORD_LAYOUT RB_CurveGroup_U16 FNC_VALUES 1 UWORD COLUMN_DIR DIRECT /end RECORD_LAYOUT
/begin RECORD_LAYOUT RB_CurveGroup_U8 FNC_VALUES 1 UBYTE COLUMN_DIR DIRECT /end RECORD_LAYOUT
/begin RECORD_LAYOUT RB_Curve_S16_S16 NO_AXIS_PTS_X 1 SWORD AXIS_PTS_X 2 SWORD INDEX_INCR DIRECT FNC_VALUES 3 SWORD COLUMN_DIR DIRECT /end RECORD_LAYOUT
/begin RECORD_LAYOUT RB_Curve_S16_S8_Static NO_AXIS_PTS_X 1 SWORD AXIS_PTS_X 2 SWORD INDEX_INCR DIRECT FNC_VALUES 3 SBYTE COLUMN_DIR DIRECT STATIC_RECORD_LAYOUT /end RECORD_LAYOUT
/begin RECORD_LAYOUT RB_Curve_S16_U8_Static NO_AXIS_PTS_X 1 SWORD AXIS_PTS_X 2 SWORD INDEX_INCR DIRECT FNC_VALUES 3 UBYTE COLUMN_DIR DIRECT STATIC_RECORD_LAYOUT /end RECORD_LAYOUT
/begin RECORD_LAYOUT RB_Curve_U16_U16 NO_AXIS_PTS_X 1 UWORD AXIS_PTS_X 2 UWORD INDEX_INCR DIRECT FNC_VALUES 3 UWORD COLUMN_DIR DIRECT /end RECORD_LAYOUT
/begin RECORD_LAYOUT RB_Curve_U16_U8_Static NO_AXIS_PTS_X 1 UWORD AXIS_PTS_X 2 UWORD INDEX_INCR DIRECT FNC_VALUES 3 UBYTE COLUMN_DIR DIRECT STATIC_RECORD_LAYOUT /end RECORD_LAYOUT
/begin RECORD_LAYOUT RB_Curve_U8_U16_Static NO_AXIS_PTS_X 1 UBYTE AXIS_PTS_X 2 UBYTE INDEX_INCR DIRECT FNC_VALUES 3 UWORD COLUMN_DIR DIRECT STATIC_RECORD_LAYOUT /end RECORD_LAYOUT
/begin RECORD_LAYOUT RB_Curve_U8_U8 NO_AXIS_PTS_X 1 UBYTE AXIS_PTS_X 2 UBYTE INDEX_INCR DIRECT FNC_VALUES 3 UBYTE COLUMN_DIR DIRECT /end RECORD_LAYOUT
/begin RECORD_LAYOUT RB_MapGroup_S16 FNC_VALUES 1 SWORD COLUMN_DIR DIRECT /end RECORD_LAYOUT
/begin RECORD_LAYOUT RB_MapGroup_U16 FNC_VALUES 1 UWORD COLUMN_DIR DIRECT /end RECORD_LAYOUT
/begin RECORD_LAYOUT RB_MapGroup_U8 FNC_VALUES 1 UBYTE COLUMN_DIR DIRECT /end RECORD_LAYOUT
/begin RECORD_LAYOUT RB_Map_S16S16_S16 NO_AXIS_PTS_X 1 SWORD NO_AXIS_PTS_Y 2 SWORD AXIS_PTS_X 3 SWORD INDEX_INCR DIRECT AXIS_PTS_Y 4 SWORD INDEX_INCR DIRECT FNC_VALUES 5 SWORD COLUMN_DIR DIRECT /end RECORD_LAYOUT
/begin RECORD_LAYOUT RB_Map_S16S16_U16 NO_AXIS_PTS_X 1 SWORD NO_AXIS_PTS_Y 2 SWORD AXIS_PTS_X 3 SWORD INDEX_INCR DIRECT AXIS_PTS_Y 4 SWORD INDEX_INCR DIRECT FNC_VALUES 5 UWORD COLUMN_DIR DIRECT /end RECORD_LAYOUT
/begin RECORD_LAYOUT RB_Map_S16U16_U16 NO_AXIS_PTS_X 1 SWORD NO_AXIS_PTS_Y 2 SWORD AXIS_PTS_X 3 SWORD INDEX_INCR DIRECT AXIS_PTS_Y 4 UWORD INDEX_INCR DIRECT FNC_VALUES 5 UWORD ROW_DIR DIRECT /end RECORD_LAYOUT
/begin RECORD_LAYOUT RB_Map_S16U8_U16 NO_AXIS_PTS_X 1 SWORD NO_AXIS_PTS_Y 2 SWORD AXIS_PTS_X 3 SWORD INDEX_INCR DIRECT AXIS_PTS_Y 4 UBYTE INDEX_INCR DIRECT FNC_VALUES 5 UWORD COLUMN_DIR DIRECT /end RECORD_LAYOUT
/begin RECORD_LAYOUT RB_Map_U8S16_U8 NO_AXIS_PTS_X 1 UBYTE NO_AXIS_PTS_Y 2 UBYTE AXIS_PTS_X 3 UBYTE INDEX_INCR DIRECT AXIS_PTS_Y 4 SWORD INDEX_INCR DIRECT FNC_VALUES 5 UBYTE ROW_DIR DIRECT /end RECORD_LAYOUT
/begin RECORD_LAYOUT RB_Map_U8S8_U8 NO_AXIS_PTS_X 1 UBYTE NO_AXIS_PTS_Y 2 UBYTE AXIS_PTS_X 3 UBYTE INDEX_INCR DIRECT AXIS_PTS_Y 4 SBYTE INDEX_INCR DIRECT FNC_VALUES 5 UBYTE COLUMN_DIR DIRECT /end RECORD_LAYOUT
/begin RECORD_LAYOUT RB_Map_U8U8_U8 NO_AXIS_PTS_X 1 UBYTE NO_AXIS_PTS_Y 2 UBYTE AXIS_PTS_X 3 UBYTE INDEX_INCR DIRECT AXIS_PTS_Y 4 UBYTE INDEX_INCR DIRECT FNC_VALUES 5 UBYTE COLUMN_DIR DIRECT /end RECORD_LAYOUT
/begin RECORD_LAYOUT RB_Val_Wboolean FNC_VALUES 1 UBYTE COLUMN_DIR DIRECT /end RECORD_LAYOUT
/begin RECORD_LAYOUT RB_Val_Ws16 FNC_VALUES 1 SWORD COLUMN_DIR DIRECT /end RECORD_LAYOUT
/begin RECORD_LAYOUT RB_Val_Ws32 FNC_VALUES 1 SLONG COLUMN_DIR DIRECT /end RECORD_LAYOUT
/begin RECORD_LAYOUT RB_Val_Wu16 FNC_VALUES 1 UWORD COLUMN_DIR DIRECT /end RECORD_LAYOUT
/begin RECORD_LAYOUT RB_Val_Wu8 FNC_VALUES 1 UBYTE COLUMN_DIR DIRECT /end RECORD_LAYOUT
/begin RECORD_LAYOUT ValA_Wu8 FNC_VALUES 1 UBYTE COLUMN_DIR DIRECT /end RECORD_LAYOUT
/begin RECORD_LAYOUT Val_Ws16 FNC_VALUES 1 SWORD COLUMN_DIR DIRECT /end RECORD_LAYOUT
/begin RECORD_LAYOUT Val_Ws32 FNC_VALUES 1 SLONG COLUMN_DIR DIRECT /end RECORD_LAYOUT
/begin RECORD_LAYOUT Val_Wu16 FNC_VALUES 1 UWORD COLUMN_DIR DIRECT /end RECORD_LAYOUT
/begin RECORD_LAYOUT Val_Wu8 FNC_VALUES 1 UBYTE COLUMN_DIR DIRECT /end RECORD_LAYOUT
/end MODULE
/end PROJECT
