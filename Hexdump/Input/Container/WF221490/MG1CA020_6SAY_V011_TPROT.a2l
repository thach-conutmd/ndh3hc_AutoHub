ASAP2_VERSION 1 60
/begin PROJECT MG1CA020 "MG1CA020"
/begin HEADER "" VERSION "MG1CA020_6SAY_V011_TPROT" PROJECT_NO MG1CA020 /end HEADER
/begin MODULE DIM ""
/begin MOD_COMMON "" BYTE_ORDER MSB_LAST ALIGNMENT_BYTE 1 ALIGNMENT_WORD 2 ALIGNMENT_LONG 4 ALIGNMENT_INT64 4 ALIGNMENT_FLOAT32_IEEE 4 ALIGNMENT_FLOAT64_IEEE 4 DATA_SIZE 32 /end MOD_COMMON
/begin CHARACTERISTIC DewDet_S1B1_I.egyThd_M "Instance of dew point end class of sensor 1 at bank 1 / map heat quantity threshold for dew-point end" MAP 0x80521934 RB_Map_S16S16_S16 32767.00 q_q1_kJ 0.00 32767.00 FORMAT "%8.2" EXTENDED_LIMITS -32768.00 32767.00
 /begin AXIS_DESCR STD_AXIS DewDet_S1B1_I.tSnsrStrt Temp_Cels 10 -3549.940 3003.560 FORMAT "%8.3" DEPOSIT ABSOLUTE /end AXIS_DESCR
 /begin AXIS_DESCR STD_AXIS ExhMod_tEngStrtDewDet Temp_Cels 10 -3549.940 3003.560 FORMAT "%8.3" DEPOSIT ABSOLUTE /end AXIS_DESCR
/end CHARACTERISTIC
/begin CHARACTERISTIC DewDet_S1B1_I.facCatHeatgWoExo_T "Instance of dew point end class of sensor 1 at bank 1 / Corrective characteristic for heat quantity while catalyst heating without thermal reaction sensor" CURVE 0x80521A28 RB_CurveGroup_U8 31.88 fak_ub_b32 0.00 31.88 FORMAT "%5.2"
 /begin AXIS_DESCR COM_AXIS NO_INPUT_QUANTITY Temp_Cels 10 -3549.940 3003.560 FORMAT "%8.3" AXIS_PTS_REF STN10TMUB /end AXIS_DESCR
/end CHARACTERISTIC
/begin CHARACTERISTIC DewDet_S1B1_I.facCatHeatg_T "Instance of dew point end class of sensor 1 at bank 1 / corrective characteristic for heat quantity while catalyst heating sensor" CURVE 0x80521A32 RB_CurveGroup_U8 31.88 fak_ub_b32 0.00 31.88 FORMAT "%5.2"
 /begin AXIS_DESCR COM_AXIS NO_INPUT_QUANTITY Temp_Cels 10 -3549.940 3003.560 FORMAT "%8.3" AXIS_PTS_REF STN10TMUB /end AXIS_DESCR
/end CHARACTERISTIC
/begin CHARACTERISTIC DewDet_S1B1_I.facCoolgAcmEgy_T "Instance of dew point end class of sensor 1 at bank 1 / weighting accumulated heat quantity (last trip) of sensor dependent on turn off time" CURVE 0x80521A3C RB_Curve_U16_U8_Static 0.9961 fak_ub_b1 0.00 0.9961
 /begin AXIS_DESCR STD_AXIS DewDet_S1B1_I.tiShtDwn t1sxs_uw_q1 8 0.00 65535.00 FORMAT "%8.2" DEPOSIT ABSOLUTE /end AXIS_DESCR
/end CHARACTERISTIC
/begin CHARACTERISTIC DewDet_S1B1_I.facCoolgSnrs_T "Instance of dew point end class of sensor 1 at bank 1 / factor reduction of temperature of sensor = f(stop time)" CURVE 0x80521A56 RB_CurveGroup_U8 1.000000 fak_ub_b2 0.00 1.000000 FORMAT "%8.6" EXTENDED_LIMITS 0.00 1.992188
 /begin AXIS_DESCR COM_AXIS DewDet_tiShDown t1sxs_uw_q1 8 0.00 65535.00 FORMAT "%8.2" AXIS_PTS_REF STS08TMUW /end AXIS_DESCR
/end CHARACTERISTIC
/begin CHARACTERISTIC DewDet_S1B1_I.facCoolgTWall_T "Instance of dew point end class of sensor 1 at bank 1 / factor reduction of temperature of sensor = f(stop time) in stop phase" CURVE 0x80521A5E RB_CurveGroup_U8 1.000000 fak_ub_b2 0.00 1.000000 FORMAT "%8.6" EXTENDED_LIMITS 0.00 1.992188
 /begin AXIS_DESCR COM_AXIS DewDet_tiShDown t1sxs_uw_q1 8 0.00 65535.00 FORMAT "%8.2" AXIS_PTS_REF STS08TMUW /end AXIS_DESCR
/end CHARACTERISTIC
/begin CHARACTERISTIC DewDet_S1B1_I.facCorrnMFlow_T "Instance of dew point end class of sensor 1 at bank 1 / Corrective characteristic for integrated heat quantity sensor dependent on mass flow exhaust gas" CURVE 0x80521A68 RB_Curve_R32_U16_Static 1.992188 fak_ub_b2 0.00 1.992188 FORMAT "%8.6" EXTENDED_LIMITS 0.00 511.9922
 /begin AXIS_DESCR STD_AXIS DewDet_S1B1_I.mfExhSnsr RBPtCel_mf_1p0_1 8 -100000.000 100000.000 FORMAT "%10.3" EXTENDED_LIMITS -3.40282347E+038 3.40282347E+038 DEPOSIT ABSOLUTE /end AXIS_DESCR
/end CHARACTERISTIC
/begin CHARACTERISTIC DewDet_S1B1_I.facHeatThdCldStrtCntr_T "Instance of dew point end class of sensor 1 at bank 1 / Factor to adjust the heat energy threshold depending on the could start counter and the start temperature" CURVE 0x80521A9C RB_Curve_S16_U8_Static 2.550 fak_q0p01 0.00 2.550 FORMAT "%5.3"
 /begin AXIS_DESCR STD_AXIS DewDet_S1B1_I.tSnsrStrt Temp_Cels 4 -3549.940 3003.560 FORMAT "%8.3" DEPOSIT ABSOLUTE /end AXIS_DESCR
/end CHARACTERISTIC
/begin CHARACTERISTIC DewDet_S1B1_I.facHeatThdOffs_T "Instance of dew point end class of sensor 1 at bank 1 / Factor for calculating the offset for the heat quantity threshold" CURVE 0x80521AAA RB_Curve_S16_U8_Static 2.550 fak_q0p01 0.00 2.550 FORMAT "%5.3"
 /begin AXIS_DESCR STD_AXIS NO_INPUT_QUANTITY Temp_Cels 10 -3549.940 3003.560 FORMAT "%8.3" DEPOSIT ABSOLUTE /end AXIS_DESCR
/end CHARACTERISTIC
/begin CHARACTERISTIC DewDet_S1B1_I.facRednHeatFlowIntSec_C "Instance of dew point end class of sensor 1 at bank 1 / factor reduction heat quantity during engine stop sensor dt independent" VALUE 0x80521ACA RB_Val_Wu16 63.99902 q9p7656Em4_kJ_DIV_K 0.00 63.99902 FORMAT "%8.5" /end CHARACTERISTIC
/begin CHARACTERISTIC DewDet_S1B1_I.nrCldStrtSnsrProdLine_C "Instance of dew point end class of sensor 1 at bank 1 / local powerfail information dew-point end" VALUE 0x80521ACC RB_Val_Wu8 255.0 dez 0.00 255.0 FORMAT "%5.1" /end CHARACTERISTIC
/begin CHARACTERISTIC DewDet_S1B1_I.nrMaxCldStrtSnsr_C "Instance of dew point end class of sensor 1 at bank 1 / maximum cold start counter of sensor for dew point end" VALUE 0x80521ACD RB_Val_Wu8 255.0 dez 0.00 255.0 FORMAT "%5.1" /end CHARACTERISTIC
/begin CHARACTERISTIC DewDet_S1B1_I.ratMinHeatThdCldStrt_T "Instance of dew point end class of sensor 1 at bank 1 / map minimum ratio heat-quantity to threshold for unchanged cold start counter sensor" CURVE 0x80521ACE RB_Curve_S16_U16_Static 0.9960938 fak_ub_b1 0.00 0.9960938 FORMAT "%9.7" EXTENDED_LIMITS 0.00 255.9961
 /begin AXIS_DESCR STD_AXIS ExhMod_tEnvDewDet Temp_Cels 4 -3549.940 3003.560 FORMAT "%8.3" DEPOSIT ABSOLUTE /end AXIS_DESCR
/end CHARACTERISTIC
/begin CHARACTERISTIC DewDet_S1B1_I.ratThdNEngRelFuMSet_T "Instance of dew point end class of sensor 1 at bank 1 / threshold current energy input for dew-point end reset if dew-point end of sensor set" CURVE 0x80521AE0 RB_Curve_S16_U16_Static 50330880. relnmot_q768 0.00 50330880. FORMAT "%8.0"
 /begin AXIS_DESCR STD_AXIS ExhMod_tEnvDewDet Temp_Cels 4 -3549.940 3003.560 FORMAT "%8.3" DEPOSIT ABSOLUTE /end AXIS_DESCR
/end CHARACTERISTIC
/begin CHARACTERISTIC DewDet_S1B1_I.ratThdNEngRelFuM_T "Instance of dew point end class of sensor 1 at bank 1 / threshold current energy input for dew-point end reset" CURVE 0x80521AF2 RB_Curve_S16_U16_Static 50330880. relnmot_q768 0.00 50330880. FORMAT "%8.0"
 /begin AXIS_DESCR STD_AXIS ExhMod_tEnvDewDet Temp_Cels 4 -3549.940 3003.560 FORMAT "%8.3" DEPOSIT ABSOLUTE /end AXIS_DESCR
/end CHARACTERISTIC
/begin CHARACTERISTIC DewDet_S1B1_I.tMinNoRstIntEngOff_C "Instance of dew point end class of sensor 1 at bank 1 / temperature threshold for reset condition dew point end of sensor at engine stop" VALUE 0x80521B04 RB_Val_Ws16 6553.500 Temp_Cels -3549.940 3003.560 FORMAT "%8.3" /end CHARACTERISTIC
/begin CHARACTERISTIC DewDet_S1B1_I.tMinNoRstInt_C "Instance of dew point end class of sensor 1 at bank 1 / minimum exhaust gas temperature sensor at which water still evaporates at idle" VALUE 0x80521B06 RB_Val_Ws16 6553.500 Temp_Cels -3549.940 3003.560 FORMAT "%8.3" /end CHARACTERISTIC
/begin CHARACTERISTIC DewDet_S1B1_I.tThdHeatFlowInt_C "Instance of dew point end class of sensor 1 at bank 1 / representative wall temperature for heat quantity calculation sensor" VALUE 0x80521B08 RB_Val_Ws16 6553.500 Temp_Cels -3549.940 3003.560 FORMAT "%8.3" /end CHARACTERISTIC
/begin CHARACTERISTIC DewDet_S1B1_I.tiDlyRstIntEngOff_T "Instance of dew point end class of sensor 1 at bank 1 / time delay to reset the heat quantity integrator at engine stop" CURVE 0x80521B0A RB_Curve_S16_U16_Static 3276.750 t_q0p05 0.00 3276.750 FORMAT "%8.3"
 /begin AXIS_DESCR STD_AXIS ExhMod_tEnvDewDet Temp_Cels 5 -3549.940 3003.560 FORMAT "%8.3" DEPOSIT ABSOLUTE /end AXIS_DESCR
/end CHARACTERISTIC
/begin CHARACTERISTIC DewDet_S1B1_I.tiDlyRstInt_C "Instance of dew point end class of sensor 1 at bank 1 / time delay to reset the heat quantity integrator" VALUE 0x80521B20 RB_Val_Wu16 3276.750 t_q0p05 0.00 3276.750 FORMAT "%8.3" /end CHARACTERISTIC
/begin CHARACTERISTIC DewDet_S2B1_I.egyThd_M "Instance of dew point end class of sensor 2 at bank 1 / map heat quantity threshold for dew-point end" MAP 0x80521B2C RB_Map_S16S16_S16 32767.00 q_q1_kJ 0.00 32767.00 FORMAT "%8.2" EXTENDED_LIMITS -32768.00 32767.00
 /begin AXIS_DESCR STD_AXIS DewDet_S2B1_I.tSnsrStrt Temp_Cels 10 -3549.940 3003.560 FORMAT "%8.3" DEPOSIT ABSOLUTE /end AXIS_DESCR
 /begin AXIS_DESCR STD_AXIS ExhMod_tEngStrtDewDet Temp_Cels 10 -3549.940 3003.560 FORMAT "%8.3" DEPOSIT ABSOLUTE /end AXIS_DESCR
/end CHARACTERISTIC
/begin CHARACTERISTIC DewDet_S2B1_I.facCatHeatgWoExo_T "Instance of dew point end class of sensor 2 at bank 1 / Corrective characteristic for heat quantity while catalyst heating without thermal reaction sensor" CURVE 0x80521C20 RB_CurveGroup_U8 31.88 fak_ub_b32 0.00 31.88 FORMAT "%5.2"
 /begin AXIS_DESCR COM_AXIS NO_INPUT_QUANTITY Temp_Cels 10 -3549.940 3003.560 FORMAT "%8.3" AXIS_PTS_REF STN10TMUB /end AXIS_DESCR
/end CHARACTERISTIC
/begin CHARACTERISTIC DewDet_S2B1_I.facCatHeatg_T "Instance of dew point end class of sensor 2 at bank 1 / corrective characteristic for heat quantity while catalyst heating sensor" CURVE 0x80521C2A RB_CurveGroup_U8 31.88 fak_ub_b32 0.00 31.88 FORMAT "%5.2"
 /begin AXIS_DESCR COM_AXIS NO_INPUT_QUANTITY Temp_Cels 10 -3549.940 3003.560 FORMAT "%8.3" AXIS_PTS_REF STN10TMUB /end AXIS_DESCR
/end CHARACTERISTIC
/begin CHARACTERISTIC DewDet_S2B1_I.facCoolgAcmEgy_T "Instance of dew point end class of sensor 2 at bank 1 / weighting accumulated heat quantity (last trip) of sensor dependent on turn off time" CURVE 0x80521C34 RB_Curve_U16_U8_Static 0.9961 fak_ub_b1 0.00 0.9961
 /begin AXIS_DESCR STD_AXIS DewDet_S2B1_I.tiShtDwn t1sxs_uw_q1 8 0.00 65535.00 FORMAT "%8.2" DEPOSIT ABSOLUTE /end AXIS_DESCR
/end CHARACTERISTIC
/begin CHARACTERISTIC DewDet_S2B1_I.facCoolgSnrs_T "Instance of dew point end class of sensor 2 at bank 1 / factor reduction of temperature of sensor = f(stop time)" CURVE 0x80521C4E RB_CurveGroup_U8 1.000000 fak_ub_b2 0.00 1.000000 FORMAT "%8.6" EXTENDED_LIMITS 0.00 1.992188
 /begin AXIS_DESCR COM_AXIS DewDet_tiShDown t1sxs_uw_q1 8 0.00 65535.00 FORMAT "%8.2" AXIS_PTS_REF STS08TMUW /end AXIS_DESCR
/end CHARACTERISTIC
/begin CHARACTERISTIC DewDet_S2B1_I.facCoolgTWall_T "Instance of dew point end class of sensor 2 at bank 1 / factor reduction of temperature of sensor = f(stop time) in stop phase" CURVE 0x80521C56 RB_CurveGroup_U8 1.000000 fak_ub_b2 0.00 1.000000 FORMAT "%8.6" EXTENDED_LIMITS 0.00 1.992188
 /begin AXIS_DESCR COM_AXIS DewDet_tiShDown t1sxs_uw_q1 8 0.00 65535.00 FORMAT "%8.2" AXIS_PTS_REF STS08TMUW /end AXIS_DESCR
/end CHARACTERISTIC
/begin CHARACTERISTIC DewDet_S2B1_I.facCorrnMFlow_T "Instance of dew point end class of sensor 2 at bank 1 / Corrective characteristic for integrated heat quantity sensor dependent on mass flow exhaust gas" CURVE 0x80521C60 RB_Curve_R32_U16_Static 1.992188 fak_ub_b2 0.00 1.992188 FORMAT "%8.6" EXTENDED_LIMITS 0.00 511.9922
 /begin AXIS_DESCR STD_AXIS DewDet_S2B1_I.mfExhSnsr RBPtCel_mf_1p0_1 8 -100000.000 100000.000 FORMAT "%10.3" EXTENDED_LIMITS -3.40282347E+038 3.40282347E+038 DEPOSIT ABSOLUTE /end AXIS_DESCR
/end CHARACTERISTIC
/begin CHARACTERISTIC DewDet_S2B1_I.facHeatThdCldStrtCntr_T "Instance of dew point end class of sensor 2 at bank 1 / Factor to adjust the heat energy threshold depending on the could start counter and the start temperature" CURVE 0x80521C94 RB_Curve_S16_U8_Static 2.550 fak_q0p01 0.00 2.550 FORMAT "%5.3"
 /begin AXIS_DESCR STD_AXIS DewDet_S2B1_I.tSnsrStrt Temp_Cels 4 -3549.940 3003.560 FORMAT "%8.3" DEPOSIT ABSOLUTE /end AXIS_DESCR
/end CHARACTERISTIC
/begin CHARACTERISTIC DewDet_S2B1_I.facHeatThdOffs_T "Instance of dew point end class of sensor 2 at bank 1 / Factor for calculating the offset for the heat quantity threshold" CURVE 0x80521CA2 RB_Curve_S16_U8_Static 2.550 fak_q0p01 0.00 2.550 FORMAT "%5.3"
 /begin AXIS_DESCR STD_AXIS NO_INPUT_QUANTITY Temp_Cels 10 -3549.940 3003.560 FORMAT "%8.3" DEPOSIT ABSOLUTE /end AXIS_DESCR
/end CHARACTERISTIC
/begin CHARACTERISTIC DewDet_S2B1_I.facRednHeatFlowIntSec_C "Instance of dew point end class of sensor 2 at bank 1 / factor reduction heat quantity during engine stop sensor dt independent" VALUE 0x80521CC2 RB_Val_Wu16 63.99902 q9p7656Em4_kJ_DIV_K 0.00 63.99902 FORMAT "%8.5" /end CHARACTERISTIC
/begin CHARACTERISTIC DewDet_S2B1_I.nrCldStrtSnsrProdLine_C "Instance of dew point end class of sensor 2 at bank 1 / local powerfail information dew-point end" VALUE 0x80521CC4 RB_Val_Wu8 255.0 dez 0.00 255.0 FORMAT "%5.1" /end CHARACTERISTIC
/begin CHARACTERISTIC DewDet_S2B1_I.nrMaxCldStrtSnsr_C "Instance of dew point end class of sensor 2 at bank 1 / maximum cold start counter of sensor for dew point end" VALUE 0x80521CC5 RB_Val_Wu8 255.0 dez 0.00 255.0 FORMAT "%5.1" /end CHARACTERISTIC
/begin CHARACTERISTIC DewDet_S2B1_I.ratMinHeatThdCldStrt_T "Instance of dew point end class of sensor 2 at bank 1 / map minimum ratio heat-quantity to threshold for unchanged cold start counter sensor" CURVE 0x80521CC6 RB_Curve_S16_U16_Static 0.9960938 fak_ub_b1 0.00 0.9960938 FORMAT "%9.7" EXTENDED_LIMITS 0.00 255.9961
 /begin AXIS_DESCR STD_AXIS ExhMod_tEnvDewDet Temp_Cels 4 -3549.940 3003.560 FORMAT "%8.3" DEPOSIT ABSOLUTE /end AXIS_DESCR
/end CHARACTERISTIC
/begin CHARACTERISTIC DewDet_S2B1_I.ratThdNEngRelFuMSet_T "Instance of dew point end class of sensor 2 at bank 1 / threshold current energy input for dew-point end reset if dew-point end of sensor set" CURVE 0x80521CD8 RB_Curve_S16_U16_Static 50330880. relnmot_q768 0.00 50330880. FORMAT "%8.0"
 /begin AXIS_DESCR STD_AXIS ExhMod_tEnvDewDet Temp_Cels 4 -3549.940 3003.560 FORMAT "%8.3" DEPOSIT ABSOLUTE /end AXIS_DESCR
/end CHARACTERISTIC
/begin CHARACTERISTIC DewDet_S2B1_I.ratThdNEngRelFuM_T "Instance of dew point end class of sensor 2 at bank 1 / threshold current energy input for dew-point end reset" CURVE 0x80521CEA RB_Curve_S16_U16_Static 50330880. relnmot_q768 0.00 50330880. FORMAT "%8.0"
 /begin AXIS_DESCR STD_AXIS ExhMod_tEnvDewDet Temp_Cels 4 -3549.940 3003.560 FORMAT "%8.3" DEPOSIT ABSOLUTE /end AXIS_DESCR
/end CHARACTERISTIC
/begin CHARACTERISTIC DewDet_S2B1_I.tMinNoRstIntEngOff_C "Instance of dew point end class of sensor 2 at bank 1 / temperature threshold for reset condition dew point end of sensor at engine stop" VALUE 0x80521CFC RB_Val_Ws16 6553.500 Temp_Cels -3549.940 3003.560 FORMAT "%8.3" /end CHARACTERISTIC
/begin CHARACTERISTIC DewDet_S2B1_I.tMinNoRstInt_C "Instance of dew point end class of sensor 2 at bank 1 / minimum exhaust gas temperature sensor at which water still evaporates at idle" VALUE 0x80521CFE RB_Val_Ws16 6553.500 Temp_Cels -3549.940 3003.560 FORMAT "%8.3" /end CHARACTERISTIC
/begin CHARACTERISTIC DewDet_S2B1_I.tThdHeatFlowInt_C "Instance of dew point end class of sensor 2 at bank 1 / representative wall temperature for heat quantity calculation sensor" VALUE 0x80521D00 RB_Val_Ws16 6553.500 Temp_Cels -3549.940 3003.560 FORMAT "%8.3" /end CHARACTERISTIC
/begin CHARACTERISTIC DewDet_S2B1_I.tiDlyRstIntEngOff_T "Instance of dew point end class of sensor 2 at bank 1 / time delay to reset the heat quantity integrator at engine stop" CURVE 0x80521D02 RB_Curve_S16_U16_Static 3276.750 t_q0p05 0.00 3276.750 FORMAT "%8.3"
 /begin AXIS_DESCR STD_AXIS ExhMod_tEnvDewDet Temp_Cels 5 -3549.940 3003.560 FORMAT "%8.3" DEPOSIT ABSOLUTE /end AXIS_DESCR
/end CHARACTERISTIC
/begin CHARACTERISTIC DewDet_S2B1_I.tiDlyRstInt_C "Instance of dew point end class of sensor 2 at bank 1 / time delay to reset the heat quantity integrator" VALUE 0x80521D18 RB_Val_Wu16 3276.750 t_q0p05 0.00 3276.750 FORMAT "%8.3" /end CHARACTERISTIC
/begin CHARACTERISTIC DewDet_stConfSnsrAryB1_CA "code word block to activate sensor specific dew point end features for sensors of bank 1" VAL_BLK 0x805218D6 RB_ValA_Wu16 65535.00 dez 0.00 65535.00 FORMAT "%8.2" NUMBER 2 /end CHARACTERISTIC
/begin CHARACTERISTIC DewDet_stConf_C "Code word to activate features to determination for dew point end" VALUE 0x805218DC RB_Val_Wu32 4294967295.00 dez 0.00 4294967295.00 FORMAT "%13.2" /end CHARACTERISTIC
/begin CHARACTERISTIC DewDet_stOffTiConf_C "Codeword usage of engine turn off time for dew point end detection" VALUE 0x805218E0 RB_Val_Wu8 255.0 dez 0.00 255.0 FORMAT "%5.1" /end CHARACTERISTIC
/begin CHARACTERISTIC DewDet_tEngStrtMinAcm_C "temperature threshold engine start temperature for setting of condition for calculation accumulation of heat-quantity" VALUE 0x805218E2 RB_Val_Ws16 6553.500 Temp_Cels -3549.940 3003.560 FORMAT "%8.3" /end CHARACTERISTIC
/begin CHARACTERISTIC DewDet_tEnvMinAcm_C "minimum ambient temperature for setting of condition for calculation accumulation of heat-quantity" VALUE 0x805218E4 RB_Val_Ws16 6553.500 Temp_Cels -3549.940 3003.560 FORMAT "%8.3" /end CHARACTERISTIC
/begin CHARACTERISTIC DewDet_tiDlyNEngRelFuM_C "" VALUE 0x805218CC RB_Val_Wu8 12.75 t_q0p05 0.00 12.75 FORMAT "%5.2" /end CHARACTERISTIC
/begin CHARACTERISTIC DewDet_tiMaxSwtOffCldStrt_C "maximum switch off time for logic cold start counter" VALUE 0x805218CE RB_Val_Wu16 65535.00 t1sxs_uw_q1 0.00 65535.00 FORMAT "%8.2" /end CHARACTERISTIC
/begin CHARACTERISTIC DewDet_tiMaxSwtOffWrmStrt_C "switch off time up to cold start can be assumed for logic cold start counter" VALUE 0x805218D0 RB_Val_Wu16 65535.00 t1sxs_uw_q1 0.00 65535.00 FORMAT "%8.2" /end CHARACTERISTIC
/begin CHARACTERISTIC DewDet_tiProlgNEngRelFuM_C "turn off delay for flag current energy input lower threshold sensor or fuel cut-off" VALUE 0x805218D2 RB_Val_Wu8 12.75 t_q0p05 0.00 12.75 FORMAT "%5.2" /end CHARACTERISTIC
/begin CHARACTERISTIC DewDet_tiProlgProdLine_C "Turn off delay for prolongation of B_fabe for cold start counter during end of line test" VALUE 0x805218E6 RB_Val_Wu16 3276.750 t_q0p05 0.00 3276.750 FORMAT "%8.3" /end CHARACTERISTIC
/begin CHARACTERISTIC DewDet_tMinEnvCldStrt_C "minumum ambient temperature for logic cold start counter" VALUE 0x805218D4 RB_Val_Ws16 6553.500 Temp_Cels -3549.940 3003.560 FORMAT "%8.3" /end CHARACTERISTIC
/begin CHARACTERISTIC DLBTSGANG "Delta lambda component protection, gear-dependent" CURVE 0x8052018C RB_Curve_S16_S16 0.6250000 fak_sw_b8 -0.5000000 0.1250000 FORMAT "%9.7" EXTENDED_LIMITS -8.000000 7.999756
 /begin AXIS_DESCR STD_AXIS gangsist_msg dez 10 -128.0000 127.0000 FORMAT "%8.4" EXTENDED_LIMITS -32768.00 32767.00 DEPOSIT ABSOLUTE /end AXIS_DESCR
/end CHARACTERISTIC
/begin CHARACTERISTIC DLBTSTMOT "Delta lambda component protection, engine temperature dependent" CURVE 0x805201B6 RB_Curve_S16_S16 0.6250000 fak_sw_b8 -0.5000000 0.1250000 FORMAT "%9.7" EXTENDED_LIMITS -8.000000 7.999756
 /begin AXIS_DESCR STD_AXIS CEngDsT_t Temp_Cels 6 -3549.940 3003.560 FORMAT "%8.3" DEPOSIT ABSOLUTE /end AXIS_DESCR
/end CHARACTERISTIC
/begin CHARACTERISTIC DLBTSVFZG "Delta lambda component protection, vehicle speed dependent" CURVE 0x805201D0 RB_Curve_S16_S16 0.6250000 fak_sw_b8 -0.5000000 0.1250000 FORMAT "%9.7" EXTENDED_LIMITS -8.000000 7.999756
 /begin AXIS_DESCR STD_AXIS VehV_v Vel 6 -327.6800 327.6700 FORMAT "%8.4" DEPOSIT ABSOLUTE /end AXIS_DESCR
/end CHARACTERISTIC
/begin CHARACTERISTIC DRLMXBTS "Distance between the desired charge and the relative air charge which implies faster reduction of maximum air charge by component protection" VALUE 0x805201EA RB_Val_Wu16 1535.977 rel_uw_q0p0234 0.00 1535.977 FORMAT "%8.3" /end CHARACTERISTIC
/begin CHARACTERISTIC DYNMETKH "dynamic threshold of engine speed for inhibiting diagnosis of engine efficiency for catalyst heating" VALUE 0x8051F64C RB_Val_Wu16 16383.50 EngN 0.00 16383.50 FORMAT "%8.2" EXTENDED_LIMITS 0.00 32767.50 /end CHARACTERISTIC
/begin CHARACTERISTIC DYRLETKH "dynamic threshold of relative air charge for inhibiting diagnosis of engine efficiency for catalyst heating" VALUE 0x8051F64E RB_Val_Wu16 1535.977 rel_uw_q0p0234 0.00 1535.977 FORMAT "%8.3" /end CHARACTERISTIC
/begin CHARACTERISTIC ENDEKHMNLL "threshold release calculation of engine efficiency deviation for diagnosis of ignition during idle" VALUE 0x8051F650 RB_Val_Wu16 1.999969 fak_q3p0518Em5 0.00 1.999969 FORMAT "%8.6" /end CHARACTERISTIC
/begin CHARACTERISTIC ENDEKHMNTL "threshold release calculation of engine efficiency deviation for diagnosis of ignition during part load" VALUE 0x8051F652 RB_Val_Wu16 1.999969 fak_q3p0518Em5 0.00 1.999969 FORMAT "%8.6" /end CHARACTERISTIC
/begin CHARACTERISTIC ExhMgT_DeltaPredLoadCptProtn_T "Relative air charge gradient because of load dynamic at which component protection is necessary" CURVE 0x8051FF1C RB_Curve_S16_S16 1535.977 rel_sw_q0p0234 -768.0000 767.9766 FORMAT "%8.4"
 /begin AXIS_DESCR STD_AXIS Epm_nEng EngN 16 -16384.00 16383.50 FORMAT "%8.2" DEPOSIT ABSOLUTE /end AXIS_DESCR
/end CHARACTERISTIC
/begin CHARACTERISTIC ExhMgT_effEngIdleNonCsersMax_M "maximum allowed deviation of ignition efficiency during catalyst haeting during idle (MAX-Errorpath)" MAP 0x8051F654 RB_Map_S16S16_S16 1.999969 fak_q3p0518Em5 -1.000000 0.999969 FORMAT "%8.6" EXTENDED_LIMITS -1.000000 0.9999695
 /begin AXIS_DESCR STD_AXIS CEngDsT_t Temp_Cels 8 -3549.940 3003.560 FORMAT "%8.3" DEPOSIT ABSOLUTE /end AXIS_DESCR
 /begin AXIS_DESCR STD_AXIS NO_INPUT_QUANTITY fak_sw_b4 4 0.00 3.999878 FORMAT "%8.6" EXTENDED_LIMITS -4.000000 3.999878 DEPOSIT ABSOLUTE /end AXIS_DESCR
/end CHARACTERISTIC
/begin CHARACTERISTIC ExhMgT_effEngPtlNonCsersMax_M "maximum allowed deviation of ignition efficiency during catalyst haeting during part load (MAX-Errorpath)" MAP 0x8051F6B0 RB_Map_S16S16_S16 1.999969 fak_q3p0518Em5 -1.000000 0.999969 FORMAT "%8.6" EXTENDED_LIMITS -1.000000 0.9999695
 /begin AXIS_DESCR STD_AXIS CEngDsT_t Temp_Cels 8 -3549.940 3003.560 FORMAT "%8.3" DEPOSIT ABSOLUTE /end AXIS_DESCR
 /begin AXIS_DESCR STD_AXIS NO_INPUT_QUANTITY fak_sw_b4 4 0.00 3.999878 FORMAT "%8.6" EXTENDED_LIMITS -4.000000 3.999878 DEPOSIT ABSOLUTE /end AXIS_DESCR
/end CHARACTERISTIC
/begin CHARACTERISTIC ExhMgT_facBldFillgCptProtnGov_T "curve for the relative regrow of maximum air charge per second" CURVE 0x805201EC RB_Curve_S16_S16 1.999969 fak_sw_b1 -1.000000 0.999969 FORMAT "%8.6" EXTENDED_LIMITS -1.000000 0.9999695
 /begin AXIS_DESCR STD_AXIS NO_INPUT_QUANTITY temp_q0p1_K 8 -3276.800 3276.700 FORMAT "%8.3" DEPOSIT ABSOLUTE /end AXIS_DESCR
/end CHARACTERISTIC
/begin CHARACTERISTIC ExhMgT_facCptProtnMisf_T "Curve for the desired air charge reduction factor during exhaust component protection due to misfires that lead to catalyst damage based on engine speed" CURVE 0x8052020E RB_Curve_S16_U16_Static 0.3999939 fak_uw_b2 0.600006 1.000000 FORMAT "%8.6" EXTENDED_LIMITS 0.00 1.999969
 /begin AXIS_DESCR STD_AXIS Epm_nEng EngN 6 -16384.00 16383.50 FORMAT "%8.2" DEPOSIT ABSOLUTE /end AXIS_DESCR
/end CHARACTERISTIC
/begin CHARACTERISTIC ExhMgT_facDeltaLamIntkAirTCptProtn_GM "factor for correction of the Delta lambda component protection dependent on intake air temperature above a nominal charge air temperature" MAP 0x80520228 RB_MapGroup_U16 1.999969 fak_uw_b2 0.00 1.999969 FORMAT "%8.6"
 /begin AXIS_DESCR COM_AXIS Epm_nEng EngN 16 -16384.00 16383.50 FORMAT "%8.2" AXIS_PTS_REF SNM16GKUW /end AXIS_DESCR
 /begin AXIS_DESCR COM_AXIS AirMod_ratChrgAirCyl rel_uw_q0p0234 15 0.00 1535.977 FORMAT "%8.3" AXIS_PTS_REF SRL15GKUW /end AXIS_DESCR
/end CHARACTERISTIC
/begin CHARACTERISTIC ExhMgT_facDftlCptProtnGovr_M "factor for D-part of exhaust temperature controller, bench1" MAP 0x80521270 RB_Map_S16S16_S16 655.3500 fak_q0p01 -327.6800 327.6700 FORMAT "%8.4"
 /begin AXIS_DESCR STD_AXIS ExhMgT_tMinTExhGovrCptProtnB1 temp_q0p1_K 12 -3276.800 3276.700 FORMAT "%8.3" DEPOSIT ABSOLUTE /end AXIS_DESCR
 /begin AXIS_DESCR STD_AXIS ExhMgT_tMinGrdtTExhGovrB1 temp_q0p1_K 12 -3276.800 3276.700 FORMAT "%8.3" DEPOSIT ABSOLUTE /end AXIS_DESCR
/end CHARACTERISTIC
/begin CHARACTERISTIC ExhMgT_facDftlTGovrCptProtnCorrnB1_C "correction factor for D-part of exhaust temperature controller" VALUE 0x805213C4 RB_Val_Wu16 655.3500 fak_q0p01 0.00 655.3500 FORMAT "%8.4" /end CHARACTERISTIC
/begin CHARACTERISTIC ExhMgT_facIvsExhMassMax_C "inversereciprocal value of maximum possible exhaust gas flow for normalization of ATR" VALUE 0x805213C6 RB_Val_Wu16 0.04999924 fak_uw_b0p05 0.00 0.04999924 FORMAT "%10.8" /end CHARACTERISTIC
/begin CHARACTERISTIC ExhMgT_facKiCptProtnGovr1B1_M "amplification factor for i-part of exhaust temperature controller, bench1 controler 1" MAP 0x805213C8 RB_Map_S16U16_U16 99.99695 fak_uw_b100 0.00153 99.99847 FORMAT "%8.5" EXTENDED_LIMITS 0.00 99.99847
 /begin AXIS_DESCR STD_AXIS ExhMgT_tMinTExhGovrCptProtnB1 temp_q0p1_K 8 -3276.800 3276.700 FORMAT "%8.3" DEPOSIT ABSOLUTE /end AXIS_DESCR
 /begin AXIS_DESCR STD_AXIS NO_INPUT_QUANTITY m_uw_b6553p5 4 0.00 6553.500 FORMAT "%8.3" DEPOSIT ABSOLUTE /end AXIS_DESCR
/end CHARACTERISTIC
/begin CHARACTERISTIC ExhMgT_facKiCptProtnGovr_C "factor for i-part of exhaust temperature controller, bench1" VALUE 0x80521424 RB_Val_Wu16 0.02441247 zk100msrtemp_q1p589em6 0.00000159 0.02441406 FORMAT "%10.8" EXTENDED_LIMITS 0.00 0.1041651 /end CHARACTERISTIC
/begin CHARACTERISTIC ExhMgT_facKpCptProtnGovr_T "proportional gain for exhaust temperature control over temperature deviation" CURVE 0x80521426 RB_Curve_S16_U16_Static 0.08333206 tempr_q1p272Em6 0.00 0.08333206 FORMAT "%10.8"
 /begin AXIS_DESCR STD_AXIS ExhMgT_tMinTExhGovrCptProtnB1 temp_q0p1_K 5 -3276.800 3276.700 FORMAT "%8.3" DEPOSIT ABSOLUTE /end AXIS_DESCR
/end CHARACTERISTIC
/begin CHARACTERISTIC ExhMgT_facRatEngSplt_T "Curve weighting factor for the engine load to address the catalyst heating operating point maps" CURVE 0x8051F804 RB_Curve_S16_U16_Static 7.999878 fak_uw_b8 0.00 7.999878 FORMAT "%8.6"
 /begin AXIS_DESCR STD_AXIS ExhMgT_tEngCatHeatgOperMod temp_q0p1_o273 6 -3549.940 3003.560 FORMAT "%8.3" DEPOSIT ABSOLUTE /end AXIS_DESCR
/end CHARACTERISTIC
/begin CHARACTERISTIC ExhMgT_facRatLamCptProtnStrt_C "Enrichment, from which lambda-request for component protection is put to lambda coordination" VALUE 0x80520408 RB_Val_Wu16 0.1000977 fak_uw_b16 0.899902 1.000000 FORMAT "%8.6" EXTENDED_LIMITS 0.00 15.99976 /end CHARACTERISTIC
/begin CHARACTERISTIC ExhMgT_facRdcFillgCptProtnFast_T "curve for faster reduction factor for maximum air charge" CURVE 0x8052040A RB_Curve_S16_S16 1.000000 fak_sw_b1 -1.000000 0.00 FORMAT "%8.6" EXTENDED_LIMITS -1.000000 0.9999695
 /begin AXIS_DESCR STD_AXIS NO_INPUT_QUANTITY temp_q0p1_K 8 -3276.800 3276.700 FORMAT "%8.3" DEPOSIT ABSOLUTE /end AXIS_DESCR
/end CHARACTERISTIC
/begin CHARACTERISTIC ExhMgT_facRednCptProtn_T "Relative reduction of maximum air charge per second" CURVE 0x8052042C RB_Curve_S16_S16 1.999969 fak_sw_b1 -1.000000 0.999969 FORMAT "%8.6" EXTENDED_LIMITS -1.000000 0.9999695
 /begin AXIS_DESCR STD_AXIS NO_INPUT_QUANTITY temp_q0p1_K 8 -3276.800 3276.700 FORMAT "%8.3" DEPOSIT ABSOLUTE /end AXIS_DESCR
/end CHARACTERISTIC
/begin CHARACTERISTIC ExhMgT_IaCorrnCptProtn_M "Ignition angle correction offset" MAP 0x8051FF5E RB_Map_S16U16_S16 95.99707 zw_q2p9297Em3_deg_KW 0.00 95.99707 FORMAT "%8.5" EXTENDED_LIMITS -96.00000 95.99707
 /begin AXIS_DESCR STD_AXIS Epm_nEng EngN 16 -16384.00 16383.50 FORMAT "%8.2" DEPOSIT ABSOLUTE /end AXIS_DESCR
 /begin AXIS_DESCR STD_AXIS AirMod_ratChrgAirCyl rel_uw_q0p0234 15 0.00 1535.977 FORMAT "%8.3" DEPOSIT ABSOLUTE /end AXIS_DESCR
/end CHARACTERISTIC
/begin CHARACTERISTIC ExhMgT_nHysDeltaCatHeatg_C "hysteresis threshold for engine speed for catalyst heating because of a request for catalyst warming with lambda split or caused by regeneration" VALUE 0x8051F81E RB_Val_Wu16 16383.50 EngN 0.00 16383.50 FORMAT "%8.2" EXTENDED_LIMITS 0.00 32767.50 /end CHARACTERISTIC
/begin CHARACTERISTIC ExhMgT_nHysDeltaEomCatHeatg_C "engine speed hysteresis for catalyst heating request map" VALUE 0x8051F820 RB_Val_Wu16 16383.50 EngN 0.00 16383.50 FORMAT "%8.2" EXTENDED_LIMITS 0.00 32767.50 /end CHARACTERISTIC
/begin CHARACTERISTIC ExhMgT_nrTExhArySeldB1_C "choice of exhaust temperature from array ExhMod_tExhAryB1" VALUE 0x8052143C RB_Val_Wu16 32767.00 dez 0.00 32767.00 FORMAT "%8.2" EXTENDED_LIMITS 0.00 65535.00 /end CHARACTERISTIC
/begin CHARACTERISTIC ExhMgT_ratChrgExhCptProtn_M "minimum load for exhaust temperature control" MAP 0x8052143E RB_Map_S16S16_U16 1535.977 rel_uw_q0p0234 0.00 1535.977 FORMAT "%8.3"
 /begin AXIS_DESCR STD_AXIS Epm_nEng EngN 5 -16384.00 16383.50 FORMAT "%8.2" DEPOSIT ABSOLUTE /end AXIS_DESCR
 /begin AXIS_DESCR STD_AXIS IntkAirT_tThrVlvUs temp_q0p1_o273 5 -3549.940 3003.560 FORMAT "%8.3" DEPOSIT ABSOLUTE /end AXIS_DESCR
/end CHARACTERISTIC
/begin CHARACTERISTIC ExhMgT_ratDeltaCptProtnGovrCorrn1_C "negative value for d-part controller 1, from which the d-part will be set to 0 after a temperatur jump" VALUE 0x80521488 RB_Val_Ws16 8.000000 fak_sw_b8 -8.000000 0.00 FORMAT "%8.6" EXTENDED_LIMITS -8.000000 7.999756 /end CHARACTERISTIC
/begin CHARACTERISTIC ExhMgT_ratDeltaCptProtnGovrMin_M "minimum limit exhaust temperature controller" MAP 0x8052148A RB_Map_S16U16_S16 0.3999023 fak_sw_b8 -0.3999023 0.00 FORMAT "%9.7" EXTENDED_LIMITS -8.000000 7.999756
 /begin AXIS_DESCR STD_AXIS Epm_nEng EngN 16 -16384.00 16383.50 FORMAT "%8.2" DEPOSIT ABSOLUTE /end AXIS_DESCR
 /begin AXIS_DESCR STD_AXIS AirMod_ratChrgAirCyl rel_uw_q0p0234 15 0.00 1535.977 FORMAT "%8.3" DEPOSIT ABSOLUTE /end AXIS_DESCR
/end CHARACTERISTIC
/begin CHARACTERISTIC ExhMgT_ratDeltaLamCptProtnGovrMax_C "Maximum limit of actuator for exhaust gas temperature feedback control" VALUE 0x805216AC RB_Val_Ws16 0.1499023 fak_sw_b8 0.00 0.1499023 FORMAT "%9.7" EXTENDED_LIMITS -8.000000 7.999756 /end CHARACTERISTIC
/begin CHARACTERISTIC ExhMgT_ratDeltaLamCptProtnIng_GM "Delta-lambda for component protection due to ignition retardation compared to basic ignition timing" MAP 0x8052044E RB_MapGroup_S16 1.000000 fak_sw_b8 -1.000000 0.00 FORMAT "%8.6" EXTENDED_LIMITS -8.000000 7.999756
 /begin AXIS_DESCR COM_AXIS NO_INPUT_QUANTITY fak_uw_b2 8 0.00 1.999969 FORMAT "%8.6" AXIS_PTS_REF SDETA08UW /end AXIS_DESCR
 /begin AXIS_DESCR COM_AXIS Epm_nEng EngN 16 -16384.00 16383.50 FORMAT "%8.2" AXIS_PTS_REF SNM16GKUW /end AXIS_DESCR
/end CHARACTERISTIC
/begin CHARACTERISTIC ExhMgT_ratDeltaLamDftlCptProtnGovr_M "D-part of exhaust temperature controller (Delta-Lambda)" MAP 0x805216AE RB_Map_S16S16_S16 8.000000 fak_sw_b8 -8.000000 0.00 FORMAT "%8.6" EXTENDED_LIMITS -8.000000 7.999756
 /begin AXIS_DESCR STD_AXIS ExhMgT_tMinTExhGovrCptProtnB1 temp_q0p1_K 12 -3276.800 3276.700 FORMAT "%8.3" DEPOSIT ABSOLUTE /end AXIS_DESCR
 /begin AXIS_DESCR STD_AXIS ExhMgT_tMinGrdtTExhGovrB1 temp_q0p1_K 12 -3276.800 3276.700 FORMAT "%8.3" DEPOSIT ABSOLUTE /end AXIS_DESCR
/end CHARACTERISTIC
/begin CHARACTERISTIC ExhMgT_ratDeltaLamIntkAirTCptProtn_T "Delta lambda for component protection based on the intake air temperature above the nominal charge air temperature" CURVE 0x8052054E RB_Curve_S16_S16 0.6250000 fak_sw_b8 -0.5000000 0.1250000 FORMAT "%9.7" EXTENDED_LIMITS -8.000000 7.999756
 /begin AXIS_DESCR STD_AXIS NO_INPUT_QUANTITY temp_q0p1_K 4 -3276.800 3276.700 FORMAT "%8.3" DEPOSIT ABSOLUTE /end AXIS_DESCR
/end CHARACTERISTIC
/begin CHARACTERISTIC ExhMgT_ratHysDeltaCatHeatg_C "hysteresis threshold for actualisation of air charge for catalyst heating because of a request for catalyst warming with lambda split or caused by regeneration" VALUE 0x8051F822 RB_Val_Wu16 767.9766 rel_q0p0234 0.00 767.9766 FORMAT "%8.4" EXTENDED_LIMITS 0.00 1535.977 /end CHARACTERISTIC
/begin CHARACTERISTIC ExhMgT_ratHysDeltaEomCatHeatg_C "load hysteresis for catalyst heating request map" VALUE 0x8051F824 RB_Val_Wu16 767.9766 rel_q0p0234 0.00 767.9766 FORMAT "%8.4" EXTENDED_LIMITS 0.00 1535.977 /end CHARACTERISTIC
/begin CHARACTERISTIC ExhMgT_ratLamCptProtnMin_GM "Min setpoint value for component protection" MAP 0x80520560 RB_MapGroup_U16 15.99976 fak_uw_b16 0.00 15.99976 FORMAT "%8.5"
 /begin AXIS_DESCR COM_AXIS Epm_nEng EngN 16 -16384.00 16383.50 FORMAT "%8.2" AXIS_PTS_REF SNM16GKUW /end AXIS_DESCR
 /begin AXIS_DESCR COM_AXIS AirMod_ratChrgAirCyl rel_uw_q0p0234 15 0.00 1535.977 FORMAT "%8.3" AXIS_PTS_REF SRL15GKUW /end AXIS_DESCR
/end CHARACTERISTIC
/begin CHARACTERISTIC ExhMgT_ratLamCptProtn_GM "Map for component protection lambda based on engine speed and air charge" MAP 0x80520740 RB_MapGroup_U16 1.500000 fak_uw_b16 0.500000 2.000000 FORMAT "%8.6" EXTENDED_LIMITS 0.00 15.99976
 /begin AXIS_DESCR COM_AXIS Epm_nEng EngN 16 -16384.00 16383.50 FORMAT "%8.2" AXIS_PTS_REF SNM16GKUW /end AXIS_DESCR
 /begin AXIS_DESCR COM_AXIS AirMod_ratChrgAirCyl rel_uw_q0p0234 15 0.00 1535.977 FORMAT "%8.3" AXIS_PTS_REF SRL15GKUW /end AXIS_DESCR
/end CHARACTERISTIC
/begin CHARACTERISTIC ExhMgT_ratLamDeltaLeanCat1_C "hysteresis for threshold for catalyst 1 for enable of fuel cut-off" VALUE 0x805211FC RB_Val_Wu16 15.99976 fak_uw_b16 0.00 15.99976 FORMAT "%8.5" /end CHARACTERISTIC
/begin CHARACTERISTIC ExhMgT_ratLamDeltaLeanCat2_C "hysteresis for threshold for catalyst 2 for enable of fuel cut-off" VALUE 0x805211FE RB_Val_Wu16 15.99976 fak_uw_b16 0.00 15.99976 FORMAT "%8.5" /end CHARACTERISTIC
/begin CHARACTERISTIC ExhMgT_ratLamLeanCat1_C "exhaust lambda threshold for catalyst 1 for enable of fuel cut-off" VALUE 0x80521200 RB_Val_Wu16 14.99976 fak_uw_b16 1.00000 15.99976 FORMAT "%8.5" EXTENDED_LIMITS 0.00 15.99976 /end CHARACTERISTIC
/begin CHARACTERISTIC ExhMgT_ratLamLeanCat2_C "exhaust lambda threshold for catalyst 2 for enable of fuel cut-off" VALUE 0x80521202 RB_Val_Wu16 14.99976 fak_uw_b16 1.00000 15.99976 FORMAT "%8.5" EXTENDED_LIMITS 0.00 15.99976 /end CHARACTERISTIC
/begin CHARACTERISTIC ExhMgT_stCptProtnFil_C "code word for the function release fuel cutoff for component protection" VALUE 0x80521204 RB_Val_Wu8 255.0 dez 0.00 255.0 FORMAT "%5.1" /end CHARACTERISTIC
/begin CHARACTERISTIC ExhMgT_stDiagEtaIaCatHeatg2_C "codeword2 für ExhMgT_DiagEtaIaCatHeatg" VALUE 0x8051F70C RB_Val_Wu8 255.0 dez 0.00 255.0 FORMAT "%5.1" /end CHARACTERISTIC
/begin CHARACTERISTIC ExhMgT_stDiagEtaIaCatHeatg_C "codeword für ExhMgT_DiagEtaIaCatHeatg" VALUE 0x8051F70D RB_Val_Wu8 255.0 dez 0.00 255.0 FORMAT "%5.1" /end CHARACTERISTIC
/begin CHARACTERISTIC ExhMgT_stDmdCsersCdnCatHeatg_C "codeword for ExhMgT_DmdCsersCdnCatHeatg" VALUE 0x8051F7F8 RB_Val_Wu8 255.0 dez 0.00 255.0 FORMAT "%5.1" /end CHARACTERISTIC
/begin CHARACTERISTIC ExhMgT_stEomCatHeatg1_C "request operation mode for catalyst heating (desired)" VALUE 0x8051F828 RB_Val_Wu32 4294967295.00 OneToOne 0.00 4294967295.00 FORMAT "%13.2" /end CHARACTERISTIC
/begin CHARACTERISTIC ExhMgT_stEomCatHeatg2_C "request operation mode for catalyst heating (alternative)" VALUE 0x8051F82C RB_Val_Wu32 4294967295.00 OneToOne 0.00 4294967295.00 FORMAT "%13.2" /end CHARACTERISTIC
/begin CHARACTERISTIC ExhMgT_stEomCatHeatg3_C "request operation mode for catalyst heating (fall-back)" VALUE 0x8051F830 RB_Val_Wu32 4294967295.00 OneToOne 0.00 4294967295.00 FORMAT "%13.2" /end CHARACTERISTIC
/begin CHARACTERISTIC ExhMgT_stIaDeltaCptProtn_C "code word for the function delta ignition angle component protection" VALUE 0x80520180 RB_Val_Wu8 255.0 dez 0.00 255.0 FORMAT "%5.1" /end CHARACTERISTIC
/begin CHARACTERISTIC ExhMgT_stOperModCatHeatg_C "Codeword for the function which requests different operating modes during catalyst heating" VALUE 0x8051F834 RB_Val_Wu8 255.0 OneToOne 0.00 255.0 FORMAT "%5.1" /end CHARACTERISTIC
/begin CHARACTERISTIC ExhMgT_stOperModCatWrm_C "operation mode for catalyst warming" VALUE 0x8051F838 RB_Val_Wu32 4294967295.00 OneToOne 0.00 4294967295.00 FORMAT "%13.2" /end CHARACTERISTIC
/begin CHARACTERISTIC ExhMgT_stOperModPrioCatWrm_C "priority of catalyst warming operation mode" VALUE 0x8051F83C RB_Val_Wu8 255.0 OneToOne 0.00 255.0 FORMAT "%5.1" /end CHARACTERISTIC
/begin CHARACTERISTIC ExhMgT_stOperModStgCatWrm_M "map for request of an engine operation mode because of a request for catalyst warming depending on engine speed and engine load" MAP 0x8051F83E RB_Map_U16U16_U16 65535.00 OneToOne 0.00 65535.00 FORMAT "%8.2"
 /begin AXIS_DESCR STD_AXIS ExhMgT_nCatHeatgOperMod EngN 16 0.00 16383.50 FORMAT "%8.2" EXTENDED_LIMITS 0.00 32767.50 DEPOSIT ABSOLUTE /end AXIS_DESCR
 /begin AXIS_DESCR STD_AXIS ExhMgT_ratCatHeatgOperMod rel_q0p0234 16 0.00 1535.977 FORMAT "%8.3" DEPOSIT ABSOLUTE /end AXIS_DESCR
/end CHARACTERISTIC
/begin CHARACTERISTIC ExhMgT_stPrioCatHeatg1_C "priority operation mode request for desired catalyst heating" VALUE 0x8051FA82 RB_Val_Wu8 255.0 OneToOne 0.00 255.0 FORMAT "%5.1" /end CHARACTERISTIC
/begin CHARACTERISTIC ExhMgT_stPrioCatHeatg2_C "priority operation mode request for alternative catalyst heating" VALUE 0x8051FA83 RB_Val_Wu8 255.0 OneToOne 0.00 255.0 FORMAT "%5.1" /end CHARACTERISTIC
/begin CHARACTERISTIC ExhMgT_stPrioCatHeatg3_C "prio request operation mode for catalyst heating (fall-back)" VALUE 0x8051FA84 RB_Val_Wu8 255.0 OneToOne 0.00 255.0 FORMAT "%5.1" /end CHARACTERISTIC
/begin CHARACTERISTIC ExhMgT_stStgCatHeatgEomMod1_M.idxSt_MAP "map for stage of request operation mode for catalyst heating formode 1 (desired) / Look-Up-Table of the Two-D Hystereses-Look-Up-Table (Uint16)" MAP 0x8051FA90 RB_Map_U16U16_U16 65535.00 OneToOne 0.00 65535.00 FORMAT "%8.2"
 /begin AXIS_DESCR STD_AXIS NO_INPUT_QUANTITY EngN 16 0.00 32767.50 FORMAT "%8.2" DEPOSIT ABSOLUTE /end AXIS_DESCR
 /begin AXIS_DESCR STD_AXIS NO_INPUT_QUANTITY rel_q0p0234 16 0.00 1535.977 FORMAT "%8.3" DEPOSIT ABSOLUTE /end AXIS_DESCR
/end CHARACTERISTIC
/begin CHARACTERISTIC ExhMgT_stStgCatHeatgEomMod2_M.idxSt_MAP "map for stage of request operation mode for catalyst heating formode 2 (desired) / Look-Up-Table of the Two-D Hystereses-Look-Up-Table (Uint16)" MAP 0x8051FCD8 RB_Map_U16U16_U16 65535.00 OneToOne 0.00 65535.00 FORMAT "%8.2"
 /begin AXIS_DESCR STD_AXIS NO_INPUT_QUANTITY EngN 16 0.00 32767.50 FORMAT "%8.2" DEPOSIT ABSOLUTE /end AXIS_DESCR
 /begin AXIS_DESCR STD_AXIS NO_INPUT_QUANTITY rel_q0p0234 16 0.00 1535.977 FORMAT "%8.3" DEPOSIT ABSOLUTE /end AXIS_DESCR
/end CHARACTERISTIC
/begin CHARACTERISTIC ExhMgT_stStgHOM_C "stage of request operation mode for catalyst heating for homogenous mode (fall back)" VALUE 0x8051FA86 RB_Val_Wu16 65535.00 OneToOne 0.00 65535.00 FORMAT "%8.2" /end CHARACTERISTIC
/begin CHARACTERISTIC ExhMgT_stTExhFild_C "code word for the filtered temperatures for component protection" VALUE 0x80521205 RB_Val_Wu8 255.0 dez 0.00 255.0 FORMAT "%5.1" /end CHARACTERISTIC
/begin CHARACTERISTIC ExhMgT_stTGovr2_C "codeword of function ATR" VALUE 0x80521802 RB_Val_Wu8 255.0 dez 0.00 255.0 FORMAT "%5.1" /end CHARACTERISTIC
/begin CHARACTERISTIC ExhMgT_stTGovr3_C "codeword of function ATR" VALUE 0x80521803 RB_Val_Wu8 255.0 dez 0.00 255.0 FORMAT "%5.1" /end CHARACTERISTIC
/begin CHARACTERISTIC ExhMgT_stTGovr_C "codeword of function ATR" VALUE 0x80521804 RB_Val_Wu8 255.0 dez 0.00 255.0 FORMAT "%5.1" /end CHARACTERISTIC
/begin CHARACTERISTIC ExhMgT_swtCatHeatg_C "code word for catalyst heating request" VALUE 0x8051FA88 RB_Val_Wu16 65535.00 dez 0.00 65535.00 FORMAT "%8.2" /end CHARACTERISTIC
/begin CHARACTERISTIC ExhMgT_tCat1MaxFcoMax_C "maximal temperature inside 1.catalyst for enable of cut off" VALUE 0x80521206 RB_Val_Ws16 3276.700 temp_q0p1_o273 -273.140 3003.560 FORMAT "%8.3" EXTENDED_LIMITS -3549.940 3003.560 /end CHARACTERISTIC
/begin CHARACTERISTIC ExhMgT_tCat1MaxFcoMin_C "minimum temperature in 1.catalyst for the release of the overrun fuel cut" VALUE 0x80521208 RB_Val_Ws16 3276.700 temp_q0p1_o273 -273.140 3003.560 FORMAT "%8.3" EXTENDED_LIMITS -3549.940 3003.560 /end CHARACTERISTIC
/begin CHARACTERISTIC ExhMgT_tCat1NonCsersMax_C "maximum temperature inside first catalyst to set of Non-Csers conditon" VALUE 0x8051F7FA RB_Val_Ws16 6553.500 Temp_Cels -3549.940 3003.560 FORMAT "%8.3" /end CHARACTERISTIC
/begin CHARACTERISTIC ExhMgT_tCat2MaxFcoMax_C "maximal exhaust maximum temperature in catalyst 2 for enable of fuel cut off" VALUE 0x8052120A RB_Val_Ws16 3276.700 temp_q0p1_o273 -273.140 3003.560 FORMAT "%8.3" EXTENDED_LIMITS -3549.940 3003.560 /end CHARACTERISTIC
/begin CHARACTERISTIC ExhMgT_tCat2MaxFcoMin_C "minimum temperature in the 2nd catalyst for the release of the fuel cut" VALUE 0x8052120C RB_Val_Ws16 3276.700 temp_q0p1_o273 -273.140 3003.560 FORMAT "%8.3" EXTENDED_LIMITS -3549.940 3003.560 /end CHARACTERISTIC
/begin CHARACTERISTIC ExhMgT_tCatCritCorrn_M "critical temperature inside of cataylst for protection of mat between catalyst and catalyst body in dependence of actual operation point" MAP 0x80521806 RB_Map_S16S16_S16 6553.500 Temp_Cels -3549.940 3003.560 FORMAT "%8.3"
 /begin AXIS_DESCR STD_AXIS tumg_msg temp_ub_q0p75_o48 4 -24624.00 24527.25 FORMAT "%8.2" DEPOSIT ABSOLUTE /end AXIS_DESCR
 /begin AXIS_DESCR STD_AXIS NO_INPUT_QUANTITY vfzg_ub_q1p25 4 -40960.00 40958.75 FORMAT "%8.2" DEPOSIT ABSOLUTE /end AXIS_DESCR
/end CHARACTERISTIC
/begin CHARACTERISTIC ExhMgT_tCatCrit_M "critical temperature inside of cataylst for protection of mat between catalyst and catalyst body" MAP 0x8052183A RB_Map_S16U16_S16 6553.500 Temp_Cels -3549.940 3003.560 FORMAT "%8.3"
 /begin AXIS_DESCR STD_AXIS Epm_nEng EngN 4 -16384.00 16383.50 FORMAT "%8.2" DEPOSIT ABSOLUTE /end AXIS_DESCR
 /begin AXIS_DESCR STD_AXIS AirMod_ratChrgAirCyl rel_uw_q0p0234 4 0.00 1535.977 FORMAT "%8.3" DEPOSIT ABSOLUTE /end AXIS_DESCR
/end CHARACTERISTIC
/begin CHARACTERISTIC ExhMgT_tDifDftlCptProtnGovrLim_C "Threshold for the temperature of the for differential gain for exhaust gas temperature feedback control bench1" VALUE 0x8052186E RB_Val_Ws16 6553.500 temp_q0p1_K -3276.800 3276.700 FORMAT "%8.3" /end CHARACTERISTIC
/begin CHARACTERISTIC ExhMgT_tDiffEngEnvNonCsersMax_C "max. temperature difference for fulfilment of Non-Csers condition" VALUE 0x8051F7FC RB_Val_Ws16 6553.500 temp_q0p1_K -3276.800 3276.700 FORMAT "%8.3" /end CHARACTERISTIC
/begin CHARACTERISTIC ExhMgT_tDifLimDftlCptProtnGovr1_C "Threshold for the difference of the temperature for differential gain for exhaust gas temperature feedback control bench 1" VALUE 0x80521870 RB_Val_Ws32 6553.59999847 q1p52588Em6_K -3276.80000000 3276.79999847 FORMAT "%13.8" /end CHARACTERISTIC
/begin CHARACTERISTIC ExhMgT_tEngDsCsersMax_C "maximum engine temperatur up to CSERS condition is fulfilled" VALUE 0x8051F7FE RB_Val_Ws16 6553.500 Temp_Cels -3549.940 3003.560 FORMAT "%8.3" /end CHARACTERISTIC
/begin CHARACTERISTIC ExhMgT_tEngDsCsersMin_C "minimum engine temperatur up to CSERS condition is fulfilled" VALUE 0x8051F800 RB_Val_Ws16 6553.500 Temp_Cels -3549.940 3003.560 FORMAT "%8.3" /end CHARACTERISTIC
/begin CHARACTERISTIC ExhMgT_tExhCat1CoolgMin_C "minimum temperature threshold in catalyst 1 for the release of the fuel cut-off relating to the minimum temperature" VALUE 0x8052120E RB_Val_Wu16 3276.700 temp_q0p1_o273 -273.140 3003.560 FORMAT "%8.3" EXTENDED_LIMITS -273.1400 6280.360 /end CHARACTERISTIC
/begin CHARACTERISTIC ExhMgT_tExhCat1FcoAvrgMin_C "minimum temperature threshold in catalyst 1 for the release of the fuel cut-off relating to the average temperature" VALUE 0x80521210 RB_Val_Wu16 3276.700 temp_q0p1_o273 -273.140 3003.560 FORMAT "%8.3" EXTENDED_LIMITS -273.1400 6280.360 /end CHARACTERISTIC
/begin CHARACTERISTIC ExhMgT_tExhCat1FcoAvrg_C "maximal average temperature of catalyst 1 for enable of fuel cut off" VALUE 0x80521212 RB_Val_Ws16 3276.700 temp_q0p1_o273 -273.140 3003.560 FORMAT "%8.3" EXTENDED_LIMITS -3549.940 3003.560 /end CHARACTERISTIC
/begin CHARACTERISTIC ExhMgT_tExhCat1FcoDsMax_C "maximal exhaust temperature downstream of catalyst 1 for enable of cut off" VALUE 0x80521214 RB_Val_Ws16 3276.700 temp_q0p1_o273 -273.140 3003.560 FORMAT "%8.3" EXTENDED_LIMITS -3549.940 3003.560 /end CHARACTERISTIC
/begin CHARACTERISTIC ExhMgT_tExhCat1FcoDsMin_C "minimum exhaust temperature downstream of catalyst 1 for enable of cut off" VALUE 0x80521216 RB_Val_Ws16 3276.700 temp_q0p1_o273 -273.140 3003.560 FORMAT "%8.3" EXTENDED_LIMITS -3549.940 3003.560 /end CHARACTERISTIC
/begin CHARACTERISTIC ExhMgT_tExhCat1FcoEndMin_C "minimum temperature threshold in catalyst 1 for the release of the fuel cut-off relating to the temperature at the end of catalyst 1" VALUE 0x80521218 RB_Val_Wu16 3276.700 temp_q0p1_o273 -273.140 3003.560 FORMAT "%8.3" EXTENDED_LIMITS -273.1400 6280.360 /end CHARACTERISTIC
/begin CHARACTERISTIC ExhMgT_tExhCat1FcoEnd_C "maximal temperature at the end of catalyst 1 for enable of cut off" VALUE 0x8052121A RB_Val_Ws16 3276.700 temp_q0p1_o273 -273.140 3003.560 FORMAT "%8.3" EXTENDED_LIMITS -3549.940 3003.560 /end CHARACTERISTIC
/begin CHARACTERISTIC ExhMgT_tExhCat1FcoMinMax_C "maximal threshold of the minimum temperature catalyst 1 for enable of cut off" VALUE 0x8052121C RB_Val_Ws16 3276.700 temp_q0p1_o273 -273.140 3003.560 FORMAT "%8.3" EXTENDED_LIMITS -3549.940 3003.560 /end CHARACTERISTIC
/begin CHARACTERISTIC ExhMgT_tExhCat1FcoMin_C "minimum temperature threshold in catalyst 1 for the release of the fuel cut-off relating to the temperature in catalyst 1" VALUE 0x8052121E RB_Val_Wu16 3276.700 temp_q0p1_o273 -273.140 3003.560 FORMAT "%8.3" EXTENDED_LIMITS -273.1400 6280.360 /end CHARACTERISTIC
/begin CHARACTERISTIC ExhMgT_tExhCat1FcoUsMax_C "maximal exhaust temperature upstream of catalyst 1 for enable of cut off" VALUE 0x80521220 RB_Val_Ws16 3276.700 temp_q0p1_o273 -273.140 3003.560 FORMAT "%8.3" EXTENDED_LIMITS -3549.940 3003.560 /end CHARACTERISTIC
/begin CHARACTERISTIC ExhMgT_tExhCat1FcoUsMin_C "minimum temperature in front of 1st catalyst for the release of the fuel cut" VALUE 0x80521222 RB_Val_Wu16 3276.700 temp_q0p1_o273 -273.140 3003.560 FORMAT "%8.3" EXTENDED_LIMITS -273.1400 6280.360 /end CHARACTERISTIC
/begin CHARACTERISTIC ExhMgT_tExhCat1Fco_C "maximal temperature in catalyst 1 for enable of cut off" VALUE 0x80521224 RB_Val_Ws16 3276.700 temp_q0p1_o273 -273.140 3003.560 FORMAT "%8.3" EXTENDED_LIMITS -3549.940 3003.560 /end CHARACTERISTIC
/begin CHARACTERISTIC ExhMgT_tExhCat1UsDelta_C "hysteresis exhaust gas temperature upstream of catalyst1 for predicted component protection at high spark retardation" VALUE 0x80520182 RB_Val_Ws16 3276.700 temp_q0p1_K 0.00 3276.700 FORMAT "%8.3" EXTENDED_LIMITS -3276.800 3276.700 /end CHARACTERISTIC
/begin CHARACTERISTIC ExhMgT_tExhCat1UsHi_C "Threshold exhaust gas temperature upstream of catalyst1 for predicted component protection at high spark retardation" VALUE 0x80520184 RB_Val_Ws16 6553.500 temp_q0p1_o273 -3549.940 3003.560 FORMAT "%8.3" /end CHARACTERISTIC
/begin CHARACTERISTIC ExhMgT_tExhCat2CoolgMin_C "minimum temperature threshold in catalyst 2 for the release of the fuel cut-off relating to the minimum temperature" VALUE 0x80521226 RB_Val_Wu16 3276.700 temp_q0p1_o273 -273.140 3003.560 FORMAT "%8.3" EXTENDED_LIMITS -273.1400 6280.360 /end CHARACTERISTIC
/begin CHARACTERISTIC ExhMgT_tExhCat2FcoAvrgMin_C "minimum temperature threshold in catalyst 2 for the release of the fuel cut-off relating to the average temperature" VALUE 0x80521228 RB_Val_Wu16 3276.700 temp_q0p1_o273 -273.140 3003.560 FORMAT "%8.3" EXTENDED_LIMITS -273.1400 6280.360 /end CHARACTERISTIC
/begin CHARACTERISTIC ExhMgT_tExhCat2FcoAvrg_C "maximal average temperatur of catalyst 2 for enable of fuel cut off" VALUE 0x8052122A RB_Val_Ws16 3276.700 temp_q0p1_o273 -273.140 3003.560 FORMAT "%8.3" EXTENDED_LIMITS -3549.940 3003.560 /end CHARACTERISTIC
/begin CHARACTERISTIC ExhMgT_tExhCat2FcoDsMax_C "maximal exhaust temperatur downstream of catalyst 2 for enable of cut off" VALUE 0x8052122C RB_Val_Ws16 3276.700 temp_q0p1_o273 -273.140 3003.560 FORMAT "%8.3" EXTENDED_LIMITS -3549.940 3003.560 /end CHARACTERISTIC
/begin CHARACTERISTIC ExhMgT_tExhCat2FcoDsMin_C "minimum temperature after 2nd catalyst for the release of the fuel cut" VALUE 0x8052122E RB_Val_Ws16 3276.700 temp_q0p1_o273 -273.140 3003.560 FORMAT "%8.3" EXTENDED_LIMITS -3549.940 3003.560 /end CHARACTERISTIC
/begin CHARACTERISTIC ExhMgT_tExhCat2FcoEndMin_C "minimum temperature threshold in catalyst 2 for the release of the fuel cut-off relating to the temperature at the end of catalyst 2" VALUE 0x80521230 RB_Val_Wu16 3276.700 temp_q0p1_o273 -273.140 3003.560 FORMAT "%8.3" EXTENDED_LIMITS -273.1400 6280.360 /end CHARACTERISTIC
/begin CHARACTERISTIC ExhMgT_tExhCat2FcoEnd_C "maximal temperature at the end of catalyst 2 for enable of cut off" VALUE 0x80521232 RB_Val_Ws16 3276.700 temp_q0p1_o273 -273.140 3003.560 FORMAT "%8.3" EXTENDED_LIMITS -3549.940 3003.560 /end CHARACTERISTIC
/begin CHARACTERISTIC ExhMgT_tExhCat2FcoMinMax_C "maximal threshold of the minimum temperature catalyst 2 for enable of cut off" VALUE 0x80521234 RB_Val_Ws16 3276.700 temp_q0p1_o273 -273.140 3003.560 FORMAT "%8.3" EXTENDED_LIMITS -3549.940 3003.560 /end CHARACTERISTIC
/begin CHARACTERISTIC ExhMgT_tExhCat2FcoMin_C "minimum temperature threshold in catalyst 2 for the release of the fuel cut-off relating to the temperature in catalyst 2" VALUE 0x80521236 RB_Val_Wu16 3276.700 temp_q0p1_o273 -273.140 3003.560 FORMAT "%8.3" EXTENDED_LIMITS -273.1400 6280.360 /end CHARACTERISTIC
/begin CHARACTERISTIC ExhMgT_tExhCat2FcoUsMax_C "maximal exhaust temperature upstream of catalyst 2 for enable of fuel cut off" VALUE 0x80521238 RB_Val_Ws16 3276.700 temp_q0p1_o273 -273.140 3003.560 FORMAT "%8.3" EXTENDED_LIMITS -3549.940 3003.560 /end CHARACTERISTIC
/begin CHARACTERISTIC ExhMgT_tExhCat2FcoUsMin_C "minimum temperature after 2nd catalyst for the release of the fuel cut" VALUE 0x8052123A RB_Val_Ws16 3276.700 temp_q0p1_o273 -273.140 3003.560 FORMAT "%8.3" EXTENDED_LIMITS -3549.940 3003.560 /end CHARACTERISTIC
/begin CHARACTERISTIC ExhMgT_tExhCat2Fco_C "maximal temperature in catalyst 2 for enable of cut off" VALUE 0x8052123C RB_Val_Ws16 3276.700 temp_q0p1_o273 -273.140 3003.560 FORMAT "%8.3" EXTENDED_LIMITS -3549.940 3003.560 /end CHARACTERISTIC
/begin CHARACTERISTIC ExhMgT_tExhMnfIaDelta_C "hysteresis exhaust gas temperature of manifold for predicted component protection at high spark retardation" VALUE 0x80520186 RB_Val_Ws16 3276.700 temp_q0p1_K 0.00 3276.700 FORMAT "%8.3" EXTENDED_LIMITS -3276.800 3276.700 /end CHARACTERISTIC
/begin CHARACTERISTIC ExhMgT_tExhMnfIa_C "Threshold exhaust gas temperature mainifold for predicted component protection at high spark retardation" VALUE 0x80520188 RB_Val_Ws16 6553.500 temp_q0p1_o273 -3549.940 3003.560 FORMAT "%8.3" /end CHARACTERISTIC
/begin CHARACTERISTIC ExhMgT_tiCutOffFirst_C "Time delay before renewed the release of the fuel cut-off to prevent cat cooling down" VALUE 0x8052123E RB_Val_Wu16 3276.750 t_q0p05 0.00 3276.750 FORMAT "%8.3" /end CHARACTERISTIC
/begin CHARACTERISTIC ExhMgT_tiDlyActvtRdcAirFillg_C "Time delay after which immediate withdrawal of air charge restriction due to component protection is possible at state of idle" VALUE 0x80520920 RB_Val_Wu16 5.000000 t_q0p1 0.00 5.000000 FORMAT "%8.6" EXTENDED_LIMITS 0.00 6553.500 /end CHARACTERISTIC
/begin CHARACTERISTIC ExhMgT_tiDlyRdcAirFillg_C "Time delay from which the air charge no longer reduces in idle speed when there is no more limitation of the rich lambda due to possible component protection at idle" VALUE 0x80520922 RB_Val_Wu8 25.50 t_q0p1 0.00 25.50 FORMAT "%5.2" /end CHARACTERISTIC
/begin CHARACTERISTIC ExhMgT_tifacRdcAirFillg_C "Delay time after reaching the min-lambda until the start of the limitation of the maximum filling" VALUE 0x80520923 RB_Val_Wu8 25.50 t_q0p1 0.00 25.50 FORMAT "%5.2" /end CHARACTERISTIC
/begin CHARACTERISTIC ExhMgT_tiFilFuM_C "time constant to filter the injected fuel mass" VALUE 0x8051FA8A RB_Val_Wu16 655.3400 t_q0p01 0.0100 655.3500 FORMAT "%8.4" EXTENDED_LIMITS 0.00 655.3500 /end CHARACTERISTIC
/begin CHARACTERISTIC ExhMgT_tiHeatgIdleNonCsersMin_C "minimum necessary time for catalyst heating in due to a cold start during idle for evaluation of ignition efficiency" VALUE 0x8051F70E RB_Val_Wu16 6553.500 t_q0p1 0.00 6553.500 FORMAT "%8.3" /end CHARACTERISTIC
/begin CHARACTERISTIC ExhMgT_tiHeatgPtlNonCsersMin_C "minimum necessary time for catalyst heating in due to a cold start outside idle for evaluation of ignition efficiency" VALUE 0x8051F710 RB_Val_Wu16 6553.500 t_q0p1 0.00 6553.500 FORMAT "%8.3" /end CHARACTERISTIC
/begin CHARACTERISTIC ExhMgT_tiRelsCptProtnGovr_C "time delay for operation condition for exhaust gas temperature feedback control" VALUE 0x80521874 RB_Val_Wu8 25.50 t_q0p1 0.00 25.50 FORMAT "%5.2" /end CHARACTERISTIC
/begin CHARACTERISTIC ExhMgT_tiRelsCsersIdle_C "time delay for release of diagnosis in Idle" VALUE 0x8051F712 RB_Val_Wu8 25.50 t_q0p1 0.00 25.50 FORMAT "%5.2" /end CHARACTERISTIC
/begin CHARACTERISTIC ExhMgT_tiRelsCsersPartLoad_C "time delay for release of diagnosis in partload" VALUE 0x8051F713 RB_Val_Wu8 25.50 t_q0p1 0.00 25.50 FORMAT "%5.2" /end CHARACTERISTIC
/begin CHARACTERISTIC ExhMgT_tiRelsNonCsersIdle_C "time delay for release of diagnosis in Idle" VALUE 0x8051F714 RB_Val_Wu8 25.50 t_q0p1 0.00 25.50 FORMAT "%5.2" /end CHARACTERISTIC
/begin CHARACTERISTIC ExhMgT_tiRelsNonCsersPartLoad_C "time delay for release of diagnosis in partload" VALUE 0x8051F715 RB_Val_Wu8 25.50 t_q0p1 0.00 25.50 FORMAT "%5.2" /end CHARACTERISTIC
/begin CHARACTERISTIC ExhMgT_tiTCatCritFild_T "time constant for filtering of critical temperature inside of cataylst for protection of mat between catalyst and catalyst body in dependence of exhaust air mass flow" CURVE 0x80521876 RB_Curve_U16_U16 6553.400 t_q0p1 0.100 6553.500 FORMAT "%8.3" EXTENDED_LIMITS 0.00 6553.500
 /begin AXIS_DESCR STD_AXIS NO_INPUT_QUANTITY m_uw_b6553p5 8 0.00 6553.500 FORMAT "%8.3" DEPOSIT ABSOLUTE /end AXIS_DESCR
/end CHARACTERISTIC
/begin CHARACTERISTIC ExhMgT_tiTDsVlvB1_C "filter time constant for the filtered value of the exhaust gas temperature downstream exhaust valve, modelled, bank 1" VALUE 0x8052189C RB_Val_Wu16 3276.700 t_q0p05 0.050 3276.750 FORMAT "%8.3" EXTENDED_LIMITS 0.00 3276.750 /end CHARACTERISTIC
/begin CHARACTERISTIC ExhMgT_tiTFltCat1AvrgB1_C "filter time constant for average temperature catalyst 1 B1" VALUE 0x8052189E RB_Val_Wu16 3276.700 t_q0p05 0.050 3276.750 FORMAT "%8.3" EXTENDED_LIMITS 0.00 3276.750 /end CHARACTERISTIC
/begin CHARACTERISTIC ExhMgT_tiTFltCat1B1_C "filter time constant for temperature catalyst 1 B1" VALUE 0x805218A0 RB_Val_Wu16 3276.700 t_q0p05 0.050 3276.750 FORMAT "%8.3" EXTENDED_LIMITS 0.00 3276.750 /end CHARACTERISTIC
/begin CHARACTERISTIC ExhMgT_tiTFltCat1EndB1_C "filter time constant for the temperature end of catalyst 1 B1" VALUE 0x805218A2 RB_Val_Wu16 3276.700 t_q0p05 0.050 3276.750 FORMAT "%8.3" EXTENDED_LIMITS 0.00 3276.750 /end CHARACTERISTIC
/begin CHARACTERISTIC ExhMgT_tiTFltCat1MaxB1_C "filter time constant for maximal temperature Catalyst 1 bench 1" VALUE 0x805218A4 RB_Val_Wu16 3276.700 t_q0p05 0.050 3276.750 FORMAT "%8.3" EXTENDED_LIMITS 0.00 3276.750 /end CHARACTERISTIC
/begin CHARACTERISTIC ExhMgT_tiTFltCat1MinB1_C "filter time constant for minimum temperature catalyst 1 B1" VALUE 0x805218A6 RB_Val_Wu16 3276.700 t_q0p05 0.050 3276.750 FORMAT "%8.3" EXTENDED_LIMITS 0.00 3276.750 /end CHARACTERISTIC
/begin CHARACTERISTIC ExhMgT_tiTFltCat2AvrgB1_C "filter time constant for average temperature catalyst 2 B1" VALUE 0x805218A8 RB_Val_Wu16 3276.700 t_q0p05 0.050 3276.750 FORMAT "%8.3" EXTENDED_LIMITS 0.00 3276.750 /end CHARACTERISTIC
/begin CHARACTERISTIC ExhMgT_tiTFltCat2B1_C "filter time constant for temperature catalyst 2 B1" VALUE 0x805218AA RB_Val_Wu16 3276.700 t_q0p05 0.050 3276.750 FORMAT "%8.3" EXTENDED_LIMITS 0.00 3276.750 /end CHARACTERISTIC
/begin CHARACTERISTIC ExhMgT_tiTFltCat2EndB1_C "filter time constant for the temperature end of catalyst 2 B1" VALUE 0x805218AC RB_Val_Wu16 3276.700 t_q0p05 0.050 3276.750 FORMAT "%8.3" EXTENDED_LIMITS 0.00 3276.750 /end CHARACTERISTIC
/begin CHARACTERISTIC ExhMgT_tiTFltCat2MaxB1_C "filter time constant for maximal temperature Kat 2 bench 1" VALUE 0x805218AE RB_Val_Wu16 3276.700 t_q0p05 0.050 3276.750 FORMAT "%8.3" EXTENDED_LIMITS 0.00 3276.750 /end CHARACTERISTIC
/begin CHARACTERISTIC ExhMgT_tiTFltCat2MinB1_C "filter time constant for minimum temperature catalyst 2 B1" VALUE 0x805218B0 RB_Val_Wu16 3276.700 t_q0p05 0.050 3276.750 FORMAT "%8.3" EXTENDED_LIMITS 0.00 3276.750 /end CHARACTERISTIC
/begin CHARACTERISTIC ExhMgT_tiTFltExhMnfB1_T "filter time for exhaustgas temperature manifold, Bank 1" CURVE 0x805218B2 RB_Curve_U16_U16 3276.700 t_q0p05 0.050 3276.750 FORMAT "%8.3" EXTENDED_LIMITS 0.00 3276.750
 /begin AXIS_DESCR STD_AXIS NO_INPUT_QUANTITY m_uw_b6553p5 6 0.00 6553.500 FORMAT "%8.3" DEPOSIT ABSOLUTE /end AXIS_DESCR
/end CHARACTERISTIC
/begin CHARACTERISTIC ExhMgT_tiTnCptProtnGovr_C "Time constant for tracking of the D component of the exhaust gas temperature controller, bench1" VALUE 0x80521898 RB_Val_Wu16 6553.400 t_q0p1 0.100 6553.500 FORMAT "%8.3" EXTENDED_LIMITS 0.00 6553.500 /end CHARACTERISTIC
/begin CHARACTERISTIC ExhMgT_tiTondNonCsers_C "time delay for release of diagnosis for monitoring of degradation engine efficiency during catalyst heating in due of Catalyst warming" VALUE 0x8051F716 RB_Val_Wu8 25.50 t_q0p1 0.00 25.50 FORMAT "%5.2" /end CHARACTERISTIC
/begin CHARACTERISTIC ExhMgT_tMinCat1CdaDelta_C "minimal temperature for 1. catalyst component protection" VALUE 0x80521240 RB_Val_Ws16 3276.700 temp_q0p1_K 0.00 3276.700 FORMAT "%8.3" EXTENDED_LIMITS -3276.800 3276.700 /end CHARACTERISTIC
/begin CHARACTERISTIC ExhMgT_tMinCat1CdaHi_C "minimal temperature for 1. catalyst component protection" VALUE 0x80521242 RB_Val_Ws16 3276.700 temp_q0p1_K 0.00 3276.700 FORMAT "%8.3" EXTENDED_LIMITS -3276.800 3276.700 /end CHARACTERISTIC
/begin CHARACTERISTIC ExhMgT_tMinCat1FcoCoolgDelta_C "minimum delta exhaust temperature of the first catalyst for the release of the overrun fuel cut (preventing cooling down)" VALUE 0x80521244 RB_Val_Ws16 3276.700 temp_q0p1_K 0.00 3276.700 FORMAT "%8.3" EXTENDED_LIMITS -3276.800 3276.700 /end CHARACTERISTIC
/begin CHARACTERISTIC ExhMgT_tMinCat1FcoCoolgHi_C "minimum delta exhaust temperature of the first catalyst for the release of the overrun fuel cut (preventing cooling down) (Bank2)" VALUE 0x80521246 RB_Val_Ws16 6553.500 temp_q0p1_K -3276.800 3276.700 FORMAT "%8.3" /end CHARACTERISTIC
/begin CHARACTERISTIC ExhMgT_tMinCat1FcoDelta_C "hysteresis for distance to temperature-threshold for cylinder-individual fuel cut-off, 1. catalyst" VALUE 0x80521248 RB_Val_Ws16 3276.700 temp_q0p1_K 0.00 3276.700 FORMAT "%8.3" EXTENDED_LIMITS -3276.800 3276.700 /end CHARACTERISTIC
/begin CHARACTERISTIC ExhMgT_tMinCat1FcoHi_C "distance to temperature-threshold for cylinder-individual fuel cut-off, 1. catalyst" VALUE 0x8052124A RB_Val_Ws16 3276.700 temp_q0p1_K 0.00 3276.700 FORMAT "%8.3" EXTENDED_LIMITS -3276.800 3276.700 /end CHARACTERISTIC
/begin CHARACTERISTIC ExhMgT_tMinCat2CdaDelta_C "minimal temperature for 2. catalyst component protection" VALUE 0x8052124C RB_Val_Ws16 3276.700 temp_q0p1_K 0.00 3276.700 FORMAT "%8.3" EXTENDED_LIMITS -3276.800 3276.700 /end CHARACTERISTIC
/begin CHARACTERISTIC ExhMgT_tMinCat2CdaHi_C "minimal temperature for 2. catalyst component protection" VALUE 0x8052124E RB_Val_Ws16 3276.700 temp_q0p1_K 0.00 3276.700 FORMAT "%8.3" EXTENDED_LIMITS -3276.800 3276.700 /end CHARACTERISTIC
/begin CHARACTERISTIC ExhMgT_tMinCat2FcoCoolgDelta_C "Hysteresis for distance from the temperature limit for release of the fuel cut-off (preventing cooling down), 2. Catalyst" VALUE 0x80521250 RB_Val_Ws16 3276.700 temp_q0p1_K 0.00 3276.700 FORMAT "%8.3" EXTENDED_LIMITS -3276.800 3276.700 /end CHARACTERISTIC
/begin CHARACTERISTIC ExhMgT_tMinCat2FcoCoolgHi_C "distance from the temperature limit for release of the fuel cut-off (preventing cooling down), 2. Catalyst" VALUE 0x80521252 RB_Val_Ws16 6553.500 temp_q0p1_K -3276.800 3276.700 FORMAT "%8.3" /end CHARACTERISTIC
/begin CHARACTERISTIC ExhMgT_tMinCat2FcoDelta_C "hysteresis for distance to temperature-threshold for cylinder-individual fuel cut-off, 2. catalyst" VALUE 0x80521254 RB_Val_Ws16 3276.700 temp_q0p1_K 0.00 3276.700 FORMAT "%8.3" EXTENDED_LIMITS -3276.800 3276.700 /end CHARACTERISTIC
/begin CHARACTERISTIC ExhMgT_tMinCat2FcoHi_C "distance to temperature-threshold for cylinder-individual fuel cut-off, 2. catalyst" VALUE 0x80521256 RB_Val_Ws16 3276.700 temp_q0p1_K 0.00 3276.700 FORMAT "%8.3" EXTENDED_LIMITS -3276.800 3276.700 /end CHARACTERISTIC
/begin CHARACTERISTIC ExhMgT_tMinCatFco_T "Lower rich limit close above temperature threshold for fuel cut-off" CURVE 0x80521258 RB_Curve_S16_U16_Static 15.99976 fak_uw_b16 0.00 15.99976 FORMAT "%8.5"
 /begin AXIS_DESCR STD_AXIS NO_INPUT_QUANTITY temp_q0p1_o273 4 -3549.940 3003.560 FORMAT "%8.3" DEPOSIT ABSOLUTE /end AXIS_DESCR
/end CHARACTERISTIC
/begin CHARACTERISTIC ExhMgT_tRefIntkAirTCptProtn_GM "group map for nominal charge air temperature for component protection" MAP 0x80520924 RB_MapGroup_S16 3276.700 Temp_Cels -273.140 3003.560 FORMAT "%8.3" EXTENDED_LIMITS -3549.940 3003.560
 /begin AXIS_DESCR COM_AXIS Epm_nEng EngN 16 -16384.00 16383.50 FORMAT "%8.2" AXIS_PTS_REF SNM16GKUW /end AXIS_DESCR
 /begin AXIS_DESCR COM_AXIS AirMod_ratChrgAirCyl rel_uw_q0p0234 15 0.00 1535.977 FORMAT "%8.3" AXIS_PTS_REF SRL15GKUW /end AXIS_DESCR
/end CHARACTERISTIC
/begin CHARACTERISTIC ExhMgT_vEnagEffCatHeat "threshold for minimum necessary velocity for enabling of diagnosis of engine efficiency during catalyst heating phase during part load" VALUE 0x8051F718 RB_Val_Ws16 655.3500 Vel -327.6800 327.6700 FORMAT "%8.4" /end CHARACTERISTIC
/begin CHARACTERISTIC ExhMgT_vLimOverrunFco_C "Limiting speed f. overrun fuel cut-off" VALUE 0x8052126A RB_Val_Ws16 655.3500 Vel -327.6800 327.6700 FORMAT "%8.4" /end CHARACTERISTIC
/begin CHARACTERISTIC ExhMod_facMfIntegEngStrtTiEngOff_T "Factor for reinitialization of Integrated air mass flow from engine start to max. value based on engine off time" CURVE 0x805218E8 RB_Curve_U16_U8_Static 1.000 fak_uw_q0p01 0.00 1.000 FORMAT "%5.3" EXTENDED_LIMITS 0.00 2.550
 /begin AXIS_DESCR STD_AXIS ExhMod_tiEngOff t_q1 8 0.00 65535.00 FORMAT "%8.2" DEPOSIT ABSOLUTE /end AXIS_DESCR
/end CHARACTERISTIC
/begin CHARACTERISTIC ExhMod_stLamCfg_C "Code word modelization of lambda values in exhaust gas system" VALUE 0x80521D20 RB_Val_Wu8 255.0 dez 0.00 255.0 FORMAT "%5.1" /end CHARACTERISTIC
/begin CHARACTERISTIC ExhMod_volBtwCat1Cat2B1_C "Volume between sensor downstream catalyst 1 and catalyst 2 outlet" VALUE 0x80521D22 RB_Val_Wu16 98302.50 vol_q1p5_cm3 0.00 98302.50 FORMAT "%8.2" /end CHARACTERISTIC
/begin CHARACTERISTIC ExhMod_volBtwCat2SDsCat2B1_C "Volume between catalyst 2 outlet and sensor downstream catalyst 2" VALUE 0x80521D24 RB_Val_Wu16 98302.50 vol_q1p5_cm3 0.00 98302.50 FORMAT "%8.2" /end CHARACTERISTIC
/begin CHARACTERISTIC ExhMod_volBtwLS1Cat1B1_C "Volume between lambda sensor 1 and sensor downstream catalyst 1" VALUE 0x80521D26 RB_Val_Wu16 98302.50 vol_q1p5_cm3 0.00 98302.50 FORMAT "%8.2" /end CHARACTERISTIC
/begin CHARACTERISTIC FHOETKH "minimum altitude threshold to enable diagnosis of engine efficiency during catalyst heating" VALUE 0x8051F71A RB_Val_Wu16 3.999939 fak_uw_b4 0.00 3.999939 FORMAT "%8.6" /end CHARACTERISTIC
/begin CHARACTERISTIC FRLBTSMN "lower limit of reduction factor for maximum air charge if component protection reaches rich burning limit" VALUE 0x80520B04 RB_Val_Wu16 0.3999634 fak_uw_b2 0.6000061 0.9999695 FORMAT "%9.7" EXTENDED_LIMITS 0.00 1.999969 /end CHARACTERISTIC
/begin CHARACTERISTIC KFDETAZWLONE "Ignition angle efficiency correction offset" MAP 0x80520B06 RB_MapGroup_U16 1.999969 fak_uw_b2 0.00 1.999969 FORMAT "%8.6"
 /begin AXIS_DESCR COM_AXIS Epm_nEng EngN 16 -16384.00 16383.50 FORMAT "%8.2" AXIS_PTS_REF SNM16GKUW /end AXIS_DESCR
 /begin AXIS_DESCR COM_AXIS AirMod_ratChrgAirCyl rel_uw_q0p0234 15 0.00 1535.977 FORMAT "%8.3" AXIS_PTS_REF SRL15GKUW /end AXIS_DESCR
/end CHARACTERISTIC
/begin CHARACTERISTIC KFFDLBTS "Factor delta nominal Lambda for component protection" MAP 0x80520CE6 RB_MapGroup_U16 1.999969 fak_uw_b2 0.00 1.999969 FORMAT "%8.6"
 /begin AXIS_DESCR COM_AXIS Epm_nEng EngN 16 -16384.00 16383.50 FORMAT "%8.2" AXIS_PTS_REF SNM16GKUW /end AXIS_DESCR
 /begin AXIS_DESCR COM_AXIS AirMod_ratChrgAirCyl rel_uw_q0p0234 15 0.00 1535.977 FORMAT "%8.3" AXIS_PTS_REF SRL15GKUW /end AXIS_DESCR
/end CHARACTERISTIC
/begin CHARACTERISTIC KFLBTSDY "enrichment for component protection during dynamic load" MAP 0x80520EC6 RB_Map_U16S16_U16 1.000000 fak_uw_b16 0.00 1.000000 FORMAT "%8.6" EXTENDED_LIMITS 0.00 15.99976
 /begin AXIS_DESCR STD_AXIS ExhMgT_iaDeltaCptProtn fak_uw_b2 6 0.00 1.999969 FORMAT "%8.6" DEPOSIT ABSOLUTE /end AXIS_DESCR
 /begin AXIS_DESCR STD_AXIS Epm_nEng EngN 6 -16384.00 16383.50 FORMAT "%8.2" DEPOSIT ABSOLUTE /end AXIS_DESCR
/end CHARACTERISTIC
/begin CHARACTERISTIC KFLBTSDYRI "enrichment for component protection during load dynamic (in case of rich engine lambda)" MAP 0x80520F2A RB_Map_U16S16_U16 1.000000 fak_uw_b16 0.00 1.000000 FORMAT "%8.6" EXTENDED_LIMITS 0.00 15.99976
 /begin AXIS_DESCR STD_AXIS ExhMgT_iaDeltaCptProtn fak_uw_b2 6 0.00 1.999969 FORMAT "%8.6" DEPOSIT ABSOLUTE /end AXIS_DESCR
 /begin AXIS_DESCR STD_AXIS Epm_nEng EngN 6 -16384.00 16383.50 FORMAT "%8.2" DEPOSIT ABSOLUTE /end AXIS_DESCR
/end CHARACTERISTIC
/begin CHARACTERISTIC KFLBTSVS "Nominal Lambda for component protection with big valve lift" MAP 0x80520F8E RB_MapGroup_U16 1.500000 fak_uw_b16 0.500000 2.000000 FORMAT "%8.6" EXTENDED_LIMITS 0.00 15.99976
 /begin AXIS_DESCR COM_AXIS Epm_nEng EngN 16 -16384.00 16383.50 FORMAT "%8.2" AXIS_PTS_REF SNM16GKUW /end AXIS_DESCR
 /begin AXIS_DESCR COM_AXIS AirMod_ratChrgAirCyl rel_uw_q0p0234 15 0.00 1535.977 FORMAT "%8.3" AXIS_PTS_REF SRL15GKUW /end AXIS_DESCR
/end CHARACTERISTIC
/begin CHARACTERISTIC KFMXETKHLL "maximum allowed deviation of ignition efficiency during catalyst heating during idle (MAX-Errorpath)" MAP 0x8051F71C RB_Map_S16S16_S16 1.999969 fak_q3p0518Em5 -1.000000 0.999969 FORMAT "%8.6" EXTENDED_LIMITS -1.000000 0.9999695
 /begin AXIS_DESCR STD_AXIS ExhMgT_tEngDiagIaCatHeatg Temp_Cels 8 -3549.940 3003.560 FORMAT "%8.3" DEPOSIT ABSOLUTE /end AXIS_DESCR
 /begin AXIS_DESCR STD_AXIS NO_INPUT_QUANTITY fak_sw_b4 4 0.00 3.999878 FORMAT "%8.6" EXTENDED_LIMITS -4.000000 3.999878 DEPOSIT ABSOLUTE /end AXIS_DESCR
/end CHARACTERISTIC
/begin CHARACTERISTIC KFMXETKHTL "maximum allowed deviation of ignition efficiency during catalyst heating during part load (MAX-Errorpath)" MAP 0x8051F778 RB_Map_S16S16_S16 1.999969 fak_q3p0518Em5 -1.000000 0.999969 FORMAT "%8.6" EXTENDED_LIMITS -1.000000 0.9999695
 /begin AXIS_DESCR STD_AXIS ExhMgT_tEngDiagIaCatHeatg Temp_Cels 8 -3549.940 3003.560 FORMAT "%8.3" DEPOSIT ABSOLUTE /end AXIS_DESCR
 /begin AXIS_DESCR STD_AXIS NO_INPUT_QUANTITY fak_sw_b4 4 0.00 3.999878 FORMAT "%8.6" EXTENDED_LIMITS -4.000000 3.999878 DEPOSIT ABSOLUTE /end AXIS_DESCR
/end CHARACTERISTIC
/begin CHARACTERISTIC KLFINTPLZW "line of interpolation factor for enrichment for component protection during load dynamic (in case of rich engine lambda)" CURVE 0x8052116E RB_Curve_U16_U8_Static 1.992188 fak_ub_b2 0.00 1.992188 FORMAT "%8.6"
 /begin AXIS_DESCR STD_AXIS lbtsmnsp_w fak_uw_b16 4 0.00 15.99976 FORMAT "%8.5" DEPOSIT ABSOLUTE /end AXIS_DESCR
/end CHARACTERISTIC
/begin CHARACTERISTIC KLRLMDVERL "line for maximum allowed air charge in dependence of resistant torque of the engine for enabling of diagnosis of deviation of ignition efficiency during catalyst haeting during idle" CURVE 0x8051F7D4 RB_Curve_U16_U16 1535.977 rel_uw_q0p0234 0.00 1535.977 FORMAT "%8.3"
 /begin AXIS_DESCR STD_AXIS mdverl_w_msg rel_uw_b100 6 0.00 99.99847 FORMAT "%8.5" DEPOSIT ABSOLUTE /end AXIS_DESCR
/end CHARACTERISTIC
/begin CHARACTERISTIC KLZKLBTDY "filter time constant for enrichment for component protection because of load dynamic" CURVE 0x8052117C RB_Curve_U16_U16 655.3400 t_q0p01 0.0100 655.3500 FORMAT "%8.4" EXTENDED_LIMITS 0.00 655.3500
 /begin AXIS_DESCR STD_AXIS miwointv_w rel_uw_b100 6 0.00 99.99847 FORMAT "%8.5" DEPOSIT ABSOLUTE /end AXIS_DESCR
/end CHARACTERISTIC
/begin CHARACTERISTIC KLZWDLBTS "filtertime constant for Delta-lambda for component protection due to ignition retardation compared with basic ignition timing" CURVE 0x80521196 RB_Curve_U16_U16 655.3400 t_q0p01 0.0100 655.3500 FORMAT "%8.4" EXTENDED_LIMITS 0.00 655.3500
 /begin AXIS_DESCR STD_AXIS ml_w_msg m_uw_b6553p5 4 0.00 6553.500 FORMAT "%8.3" DEPOSIT ABSOLUTE /end AXIS_DESCR
/end CHARACTERISTIC
/begin CHARACTERISTIC Lam_mO2CatStThd_C "oxygen threshold for catalyst state" VALUE 0x80521D28 RB_Val_Wu16 0.00 m_q0p1_mg 0.00 0.00 FORMAT "%8.2" EXTENDED_LIMITS 0.00 6553.500 READ_ONLY /end CHARACTERISTIC
/begin CHARACTERISTIC Lam_mO2MaxCat1_C "Maximal value of the OSC of catalyst 1, for plausibility check" VALUE 0x80521D2C RB_Val_Wr32 199998.000 m_q1_mg -99999.0000 99999.0000 FORMAT "%10.4" EXTENDED_LIMITS -3.40282347E+038 3.40282347E+038 /end CHARACTERISTIC
/begin CHARACTERISTIC Lam_mO2StorgIni_C "oxygen capacity at engine start" VALUE 0x80521D1C RB_Val_Wu32 429496729.500 m_q0p1_mg 0.00 429496729.500 FORMAT "%13.3" /end CHARACTERISTIC
/begin CHARACTERISTIC Lam_ratConcO2ThdLean_C "Lean threshold for oxygen concentration for plausibility check" VALUE 0x80521D30 RB_Val_Ws16 15.99976 fak_sw_b8 -8.000000 7.999756 FORMAT "%8.6" /end CHARACTERISTIC
/begin CHARACTERISTIC Lam_ratConcO2ThdRich_C "Rich threshold for oxygen concentration for plausibility check" VALUE 0x80521D32 RB_Val_Ws16 15.99976 fak_sw_b8 -8.000000 7.999756 FORMAT "%8.6" /end CHARACTERISTIC
/begin CHARACTERISTIC Lam_tDlyLSNplFlg "Test time before setting non-plausibility-flag lambda sensor downstream of catalyst" VALUE 0x80521D34 RB_Val_Wu16 2.550000 t_q0p01 0.00 2.550000 FORMAT "%8.6" EXTENDED_LIMITS 0.00 655.3500 /end CHARACTERISTIC
/begin CHARACTERISTIC Lam_uLSCat1Empty_C "Threshold of rear lambda sensor voltage for defined catalyst 1 state empty" VALUE 0x80521D36 RB_Val_Ws16 159.9951 spg_q0p00488 0.00 159.9951 FORMAT "%8.4" EXTENDED_LIMITS -160.0000 159.9951 /end CHARACTERISTIC
/begin CHARACTERISTIC Lam_uLSCat1Full_C "Threshold of rear lambda sensor voltage for defined catalyst 1 state full" VALUE 0x80521D38 RB_Val_Ws16 159.9951 spg_q0p00488 0.00 159.9951 FORMAT "%8.4" EXTENDED_LIMITS -160.0000 159.9951 /end CHARACTERISTIC
/begin CHARACTERISTIC LBTSSAMX "Upper end-lambda for component protection before fuel cutoff is released" VALUE 0x8052126C RB_Val_Wu16 0.6999512 fak_uw_b16 0.800049 1.500000 FORMAT "%8.6" EXTENDED_LIMITS 0.00 15.99976 /end CHARACTERISTIC
/begin CHARACTERISTIC MNTKHLL "minimum necessary time for catalyst heating in due to a cold start during idle for evaluation of ignition efficiency" VALUE 0x8051F7EE RB_Val_Wu16 6553.500 t_q0p1 0.00 6553.500 FORMAT "%8.3" /end CHARACTERISTIC
/begin CHARACTERISTIC MNTKHTL "minimum necessary time for catalyst heating in due to a cold start outside idle for evaluation of ignition efficiency" VALUE 0x8051F7F0 RB_Val_Wu16 6553.500 t_q0p1 0.00 6553.500 FORMAT "%8.3" /end CHARACTERISTIC
/begin AXIS_PTS SDETA08UW "Breakpoint distribution component protection over delta efficiency of spark timing" 0x805211A8 NO_INPUT_QUANTITY RB_Axis_U16 1.999969 fak_uw_b2 8 0.00 1.999969 FORMAT "%8.6" DEPOSIT ABSOLUTE /end AXIS_PTS
/begin AXIS_PTS SNM16GKUW "Datapoint distribution mixture control 16 nmot datapoints" 0x805211BA Epm_nEng RB_Axis_S16 32767.50 EngN 16 -16384.00 16383.50 FORMAT "%8.2" DEPOSIT ABSOLUTE /end AXIS_PTS
/begin AXIS_PTS SRL15GKUW "Datapoint distribution mixture control 15 rl_w datapoints" 0x805211DC AirMod_ratChrgAirCyl RB_Axis_U16 1535.977 rel_uw_q0p0234 15 0.00 1535.977 FORMAT "%8.3" DEPOSIT ABSOLUTE /end AXIS_PTS
/begin AXIS_PTS STN10TMUB "break point distribution: engine start temperature" 0x80521902 NO_INPUT_QUANTITY RB_Axis_S16 6553.500 Temp_Cels 10 -3549.940 3003.560 FORMAT "%8.3" DEPOSIT ABSOLUTE /end AXIS_PTS
/begin AXIS_PTS STS08TMUW "tabstatm dependent basic point (number 8)" 0x80521918 DewDet_tiShDown RB_Axis_U16 65535.00 t1sxs_uw_q1 8 0.00 65535.00 FORMAT "%8.2" DEPOSIT ABSOLUTE /end AXIS_PTS
/begin CHARACTERISTIC TDDETAKH "time delay for release of diagnosis for monitoring of degradation engine efficiency during catalyst heating in due of cold start" VALUE 0x8051F7F2 RB_Val_Wu8 25.50 t_q0p1 0.00 25.50 FORMAT "%5.2" /end CHARACTERISTIC
/begin CHARACTERISTIC TDLBTSSA "Time for transient of lambda from ignited overrun to release of fuel cut-off" VALUE 0x8052126E RB_Val_Wu16 3276.7499992 zk50msxs_uw_b3276p8 0.0500008 3276.8000000 FORMAT "%12.7" EXTENDED_LIMITS 0.050000762951 3276.8000000 /end CHARACTERISTIC
/begin CHARACTERISTIC TVLBTSDY "Delay time for enrichment for component protection due to dynamic load" VALUE 0x8052018A RB_Val_Wu16 655.3500 t_q0p01 0.00 655.3500 FORMAT "%8.4" /end CHARACTERISTIC
/begin CHARACTERISTIC ZKETKHNM "time constant for filtering of engine speed during diagnosis of engine efficiency for catalyst heating" VALUE 0x8051F7F4 RB_Val_Wu16 6553.400 t_q0p1 0.100 6553.500 FORMAT "%8.3" EXTENDED_LIMITS 0.00 6553.500 /end CHARACTERISTIC
/begin CHARACTERISTIC ZKETKHRL "time constant for filtering of relative air charge during diagnosis of engine efficiency for catalyst heating" VALUE 0x8051F7F6 RB_Val_Wu16 6553.400 t_q0p1 0.100 6553.500 FORMAT "%8.3" EXTENDED_LIMITS 0.00 6553.500 /end CHARACTERISTIC
/begin MEASUREMENT B_atrb "condition valid range for exhaust temperature control" UBYTE B_TRUE 1 100 0.00 1.00000000000 BIT_MASK 0x1 FORMAT "%13.11" ECU_ADDRESS 0x70000223 /end MEASUREMENT
/begin MEASUREMENT B_atr_msg "Condition: exhaust temperature control" UBYTE B_TRUE 1 100 0.00 1.00000000000 BIT_MASK 0x1 FORMAT "%13.11" ECU_ADDRESS 0x70000ABD /end MEASUREMENT
/begin MEASUREMENT B_bbatr "Operation condition for exhaust gas temperature feedback control" UBYTE B_TRUE 1 100 0.00 1.00000000000 BIT_MASK 0x1 FORMAT "%13.11" ECU_ADDRESS 0x70000222 /end MEASUREMENT
/begin MEASUREMENT B_dyetkh_msg "condition for recognized dynamic criteria for inhibiting of diagnosis of engine efficiency deviation during catalyst heating phase" UBYTE B_TRUE 1 100 0.00 1.00000000000 BIT_MASK 0x1 FORMAT "%13.11" ECU_ADDRESS 0x70000A8D /end MEASUREMENT
/begin MEASUREMENT B_edekhlmx_msg "condition for detected error of ignition timing efficiency diagnosis for catalyst heating during cold start (MAX-Errorpath) during idle at the end of catalyst heating" UBYTE B_TRUE 1 100 0.00 1.00000000000 BIT_MASK 0x1 FORMAT "%13.11" ECU_ADDRESS 0x70000A88 /end MEASUREMENT
/begin MEASUREMENT B_edekhtmx_msg "condition for detected error of ignition timing efficiency diagnosis for catalyst heating during cold start (MAX-Errorpath) during part load at the end of catalyst heating" UBYTE B_TRUE 1 100 0.00 1.00000000000 BIT_MASK 0x1 FORMAT "%13.11" ECU_ADDRESS 0x70000A87 /end MEASUREMENT
/begin MEASUREMENT B_ekhllmx "condition for detected error of ignition timing efficiency diagnosis for catalyst heating during cold start (MAX-Errorpath) during idle" UBYTE B_TRUE 1 100 0.00 1.00000000000 BIT_MASK 0x1 FORMAT "%13.11" ECU_ADDRESS 0x70000244 /end MEASUREMENT
/begin MEASUREMENT B_ekhtlmx "condition for detected error of ignition timing efficiency diagnosis for catalyst heating during cold start (MAX-Errorpath) during part load" UBYTE B_TRUE 1 100 0.00 1.00000000000 BIT_MASK 0x1 FORMAT "%13.11" ECU_ADDRESS 0x70000243 /end MEASUREMENT
/begin MEASUREMENT B_endcsst_msg "enable of diagnosis of monitoring for cold start strategy" UBYTE B_TRUE 1 100 0.00 1.00000000000 BIT_MASK 0x1 FORMAT "%13.11" ECU_ADDRESS 0x70000A7D /end MEASUREMENT
/begin MEASUREMENT B_enetkhll_msg "release calculation of engine efficiency deviation for diagnosis of ignition during idle" UBYTE B_TRUE 1 100 0.00 1.00000000000 BIT_MASK 0x1 FORMAT "%13.11" ECU_ADDRESS 0x70000A7B /end MEASUREMENT
/begin MEASUREMENT B_enetkhtl_msg "release calculation of engine efficiency deviation for diagnosis of ignition during part load" UBYTE B_TRUE 1 100 0.00 1.00000000000 BIT_MASK 0x1 FORMAT "%13.11" ECU_ADDRESS 0x70000A7A /end MEASUREMENT
/begin MEASUREMENT B_enetkh_msg "release calculation of engine efficiency deviation for diagnosis of ignition" UBYTE B_TRUE 1 100 0.00 1.00000000000 BIT_MASK 0x1 FORMAT "%13.11" ECU_ADDRESS 0x70000A7C /end MEASUREMENT
/begin MEASUREMENT B_fgsabts "Start of lambda-ramp of lower rich limit before fuel cut-off" UBYTE B_TRUE 1 100 0.00 1.00000000000 BIT_MASK 0x1 FORMAT "%13.11" ECU_ADDRESS 0x600064AD /end MEASUREMENT
/begin MEASUREMENT B_fuabts_msg "Condition for reducing the max. desired air charge for component protection" UBYTE B_TRUE 1 100 0.00 1.00000000000 BIT_MASK 0x1 FORMAT "%13.11" ECU_ADDRESS 0x70000A57 /end MEASUREMENT
/begin MEASUREMENT B_lambts_msg "lambda for component protection is active" UBYTE B_TRUE 1 100 0.00 1.00000000000 BIT_MASK 0x1 FORMAT "%13.11" ECU_ADDRESS 0x70000A17 /end MEASUREMENT
/begin MEASUREMENT B_lbtsbg "limitation of desired lambda for component protection" UBYTE B_TRUE 1 100 0.00 1.00000000000 BIT_MASK 0x1 FORMAT "%13.11" ECU_ADDRESS 0x70000A0B /end MEASUREMENT
/begin MEASUREMENT B_sabbts_msg "condition fuel cut-off request by component protection" UBYTE B_TRUE 1 100 0.00 1.00000000000 BIT_MASK 0x1 FORMAT "%13.11" ECU_ADDRESS 0x60009FCA /end MEASUREMENT
/begin MEASUREMENT B_tatmsa_msg "Temperatures in exhaust system permit fuel-cutoff (component protection)" UBYTE B_TRUE 1 100 0.00 1.00000000000 BIT_MASK 0x1 FORMAT "%13.11" ECU_ADDRESS 0x60009FC9 /end MEASUREMENT
/begin MEASUREMENT B_zdekhlmx_msg "condition for OK Status of ignition timing efficiency diagnosis for catalyst heating during cold start (MAX-Errorpath) during idle" UBYTE B_TRUE 1 100 0.00 1.00000000000 BIT_MASK 0x1 FORMAT "%13.11" ECU_ADDRESS 0x70000954 /end MEASUREMENT
/begin MEASUREMENT B_zdekhtmx_msg "condition for OK Status of ignition timing efficiency diagnosis for catalyst heating during cold start (MAX-Errorpath) during part load" UBYTE B_TRUE 1 100 0.00 1.00000000000 BIT_MASK 0x1 FORMAT "%13.11" ECU_ADDRESS 0x70000953 /end MEASUREMENT
/begin MEASUREMENT detakhls_w "differenz between actuell ignition effciency and desired catalyst heating ignition efficiency during idle" SWORD fak_q3p0518Em5 1 100 -1.000000 0.999969 FORMAT "%8.6" ECU_ADDRESS 0x6000392C /end MEASUREMENT
/begin MEASUREMENT detakhl_w "differenz between actuell ignition efficiency and desired catalyst heating ignition efficiency (limited) during idle" SWORD fak_q3p0518Em5 1 100 -1.000000 0.999969 FORMAT "%8.6" ECU_ADDRESS 0x6000392A /end MEASUREMENT
/begin MEASUREMENT detakhts_w "differenz between actuell ignition effciency and desired catalyst heating ignition efficiency during part load" SWORD fak_q3p0518Em5 1 100 -1.000000 0.999969 FORMAT "%8.6" ECU_ADDRESS 0x60003928 /end MEASUREMENT
/begin MEASUREMENT detakht_w "differenz between actuell ignition efficiency and desired catalyst heating ignition efficiency (limited) during part load" SWORD fak_q3p0518Em5 1 100 -1.000000 0.999969 FORMAT "%8.6" ECU_ADDRESS 0x60003926 /end MEASUREMENT
/begin MEASUREMENT detkhlav_w_msg "mean deviation of actuell ignition effciency and desired catalyst heating ignition efficiency during idle" SWORD fak_q3p0518Em5 1 100 -1.000000 0.999969 FORMAT "%8.6" ECU_ADDRESS 0x6000E2F4 /end MEASUREMENT
/begin MEASUREMENT detkhtav_w_msg "mean deviation of actuell ignition effciency and desired catalyst heating ignition efficiency outside idle" SWORD fak_q3p0518Em5 1 100 -1.000000 0.999969 FORMAT "%8.6" ECU_ADDRESS 0x6000E2F6 /end MEASUREMENT
/begin MEASUREMENT DewDet_bFrstStrtEndERNM "condition first end of start in cycle rising edge" UBYTE B_TRUE 1 100 0.00 1.00000000000 BIT_MASK 0x1 FORMAT "%13.11" ECU_ADDRESS 0x7000021C /end MEASUREMENT
/begin MEASUREMENT DewDet_bStrtEndERNM "condition end of start rising edge" UBYTE B_TRUE 1 100 0.00 1.00000000000 BIT_MASK 0x1 FORMAT "%13.11" ECU_ADDRESS 0x7000021B /end MEASUREMENT
/begin MEASUREMENT DewDet_ctReIni "Counter for detecting interrupted postdrive (ReIni)" UBYTE OneToOne 1 100 0.00 255.0 FORMAT "%5.1" ECU_ADDRESS 0x600064A5 /end MEASUREMENT
/begin MEASUREMENT DewDet_flgAcmEgy "flag condition accumulation of heat quantity fullfilled" UBYTE B_TRUE 1 100 0.00 1.00000000000 BIT_MASK 0x1 FORMAT "%13.11" ECU_ADDRESS 0x700008AB /end MEASUREMENT
/begin MEASUREMENT DewDet_flgAcmEgyBasc "flag basic condition accumulation of heat quantity fullfilled" UBYTE B_TRUE 1 100 0.00 1.00000000000 BIT_MASK 0x1 FORMAT "%13.11" ECU_ADDRESS 0x70000220 /end MEASUREMENT
/begin MEASUREMENT DewDet_flgCatHeatgWoExo "Condition catalyst heating for dewdet functions" UBYTE B_TRUE 1 100 0.00 1.00000000000 BIT_MASK 0x1 FORMAT "%13.11" ECU_ADDRESS 0x700008AA /end MEASUREMENT
/begin MEASUREMENT DewDet_flgEngStopER "condition end of start (1-0) for dew point end" UBYTE B_TRUE 1 100 0.00 1.00000000000 BIT_MASK 0x1 FORMAT "%13.11" ECU_ADDRESS 0x7000021A /end MEASUREMENT
/begin MEASUREMENT DewDet_flgEngStopLdc "condition end of start (1-0) detected in cycle for dew point end" UBYTE B_TRUE 1 100 0.00 1.00000000000 BIT_MASK 0x1 FORMAT "%13.11" ECU_ADDRESS 0x7000021F /end MEASUREMENT
/begin MEASUREMENT DewDet_flgInfoStrdEngOff "information end of last engine run stored" UBYTE B_TRUE 1 100 0.00 1.00000000000 BIT_MASK 0x1 FORMAT "%13.11" ECU_ADDRESS 0x70000219 /end MEASUREMENT
/begin MEASUREMENT DewDet_flgProlgProdLine "prolongated B_fabe for cold start counter during end of line test" UBYTE B_TRUE 1 100 0.00 1.00000000000 BIT_MASK 0x1 FORMAT "%13.11" ECU_ADDRESS 0x70000218 /end MEASUREMENT
/begin MEASUREMENT DewDet_flgPwrFail "local powerfail information dew-point end" UBYTE B_TRUE 1 100 0.00 1.00000000000 BIT_MASK 0x1 FORMAT "%13.11" ECU_ADDRESS 0x60034987 /end MEASUREMENT
/begin MEASUREMENT DewDet_flgTUpdEngStrt "condition update sensor start temperature due to engine start" UBYTE B_TRUE 1 100 0.00 1.00000000000 BIT_MASK 0x1 FORMAT "%13.11" ECU_ADDRESS 0x7000021E /end MEASUREMENT
/begin MEASUREMENT DewDet_flgTUpdTiShDown "condition update sensor start temperature due to an updated engine turn off time" UBYTE B_TRUE 1 100 0.00 1.00000000000 BIT_MASK 0x1 FORMAT "%13.11" ECU_ADDRESS 0x7000021D /end MEASUREMENT
/begin MEASUREMENT DewDet_S1B1_I.cntrCldStrtSnsr "Instance of dew point end class of sensor 1 at bank 1 / counter for repeated cold starts dew-point end not reached sensor" UBYTE dez 1 100 0.00 255.0 FORMAT "%5.1" ECU_ADDRESS 0x600365BE /end MEASUREMENT
/begin MEASUREMENT DewDet_S1B1_I.egyInteg "Instance of dew point end class of sensor 1 at bank 1 / heat quantity to dew-point end" SWORD q_q1_kJ 1 100 -32768.00 32767.00 FORMAT "%8.2" ECU_ADDRESS 0x500011A8 /end MEASUREMENT
/begin MEASUREMENT DewDet_S1B1_I.egyIntegAcm "Instance of dew point end class of sensor 1 at bank 1 / accumulated of heat quantity for dew-point end" SWORD q_q1_kJ 1 100 -32768.00 32767.00 FORMAT "%8.2" ECU_ADDRESS 0x500011AA /end MEASUREMENT
/begin MEASUREMENT DewDet_S1B1_I.egyIntegAcmLst "Instance of dew point end class of sensor 1 at bank 1 / accumulated of heat quantity for dew-point end (last trip)" SWORD q_q1_kJ 1 100 -32768.00 32767.00 FORMAT "%8.2" ECU_ADDRESS 0x600365C0 /end MEASUREMENT
/begin MEASUREMENT DewDet_S1B1_I.egyIntegHiResl "Instance of dew point end class of sensor 1 at bank 1 / heat quantity to dew-point end high resolution" SLONG q_q1p5259Em5_kJ 1 100 0.00 32767.9999847 FORMAT "%13.7" ECU_ADDRESS 0x500011AC /end MEASUREMENT
/begin MEASUREMENT DewDet_S1B1_I.egyIntegInp "Instance of dew point end class of sensor 1 at bank 1 / Inout for output egyInteg" SLONG q_q1p5259Em5_kJ 1 100 -32768.0000000 32767.9999847 FORMAT "%13.7" ECU_ADDRESS 0x500011B0 /end MEASUREMENT
/begin MEASUREMENT DewDet_S1B1_I.egyThd "Instance of dew point end class of sensor 1 at bank 1 / heat quantity threshold for dew-point end" SWORD q_q1_kJ 1 100 0.00 32767.00 FORMAT "%8.2" ECU_ADDRESS 0x500011B4 /end MEASUREMENT
/begin MEASUREMENT DewDet_S1B1_I.egyThdEngRunLst "Instance of dew point end class of sensor 1 at bank 1 / heat quantity threshold at end of last engine run for dew-point end downstream" SWORD q_q1_kJ 1 100 0.00 32767.00 FORMAT "%8.2" ECU_ADDRESS 0x500011B6 /end MEASUREMENT
/begin MEASUREMENT DewDet_S1B1_I.egyThdHeat "Instance of dew point end class of sensor 1 at bank 1 / heat quantity threshold for dew-point end" SWORD q_q1_kJ 1 100 0.00 32767.00 FORMAT "%8.2" ECU_ADDRESS 0x500011B8 /end MEASUREMENT
/begin MEASUREMENT DewDet_S1B1_I.egyThdLst "Instance of dew point end class of sensor 1 at bank 1 / heat quantity threshold for dew-point end (last trip)" SWORD q_q1_kJ 1 100 0.00 32767.00 FORMAT "%8.2" ECU_ADDRESS 0x600365C2 /end MEASUREMENT
/begin MEASUREMENT DewDet_S1B1_I.egyThdRaw "Instance of dew point end class of sensor 1 at bank 1 / heat quantity threshold for dew-point end without cold start counter" SWORD q_q1_kJ 1 100 0.00 32767.00 FORMAT "%8.2" ECU_ADDRESS 0x500011BA /end MEASUREMENT
/begin MEASUREMENT DewDet_S1B1_I.egy_inc "Instance of dew point end class of sensor 1 at bank 1 / energy increment" SLONG q_q1p5259Em5_kJ 1 100 -32768.0000000 32767.9999847 FORMAT "%13.7" ECU_ADDRESS 0x500011BC /end MEASUREMENT
/begin MEASUREMENT DewDet_S1B1_I.facCoolgSnrs "Instance of dew point end class of sensor 1 at bank 1 / factor for decrease in temperature of sensor" UBYTE fak_ub_b2 1 100 0.00 1.000000 FORMAT "%8.6" ECU_ADDRESS 0x500011C0 /end MEASUREMENT
/begin MEASUREMENT DewDet_S1B1_I.flgAcmEgySnsr "Instance of dew point end class of sensor 1 at bank 1 / flag calculation accumulation of heat quantity sensor" UBYTE B_TRUE 1 100 0.00 1.00000000000 BIT_MASK 0x1 FORMAT "%13.11" ECU_ADDRESS 0x500011C8 /end MEASUREMENT
/begin MEASUREMENT DewDet_S1B1_I.flgCondRstInt "Instance of dew point end class of sensor 1 at bank 1 / flag condition for reset integrator for dew point fullfilled" UBYTE B_TRUE 1 100 0.00 1.00000000000 BIT_MASK 0x2 FORMAT "%13.11" ECU_ADDRESS 0x500011C8 /end MEASUREMENT
/begin MEASUREMENT DewDet_S1B1_I.flgDewPntEnd "Instance of dew point end class of sensor 1 at bank 1 / flag dew-point end sensor" UBYTE B_TRUE 1 100 0.00 1.00000000000 BIT_MASK 0x4 FORMAT "%13.11" ECU_ADDRESS 0x500011C8 /end MEASUREMENT
/begin MEASUREMENT DewDet_S1B1_I.flgDewPntEndLst "Instance of dew point end class of sensor 1 at bank 1 / flag dew-point end sensor (last trip)" UBYTE B_TRUE 1 100 0.00 1.00000000000 BIT_MASK 0x1 FORMAT "%13.11" ECU_ADDRESS 0x600365C4 /end MEASUREMENT
/begin MEASUREMENT DewDet_S1B1_I.flgRatNEngRelFuM "Instance of dew point end class of sensor 1 at bank 1 / Flag current energy input lower threshold sensor" UBYTE B_TRUE 1 100 0.00 1.00000000000 BIT_MASK 0x40 FORMAT "%13.11" ECU_ADDRESS 0x500011C8 /end MEASUREMENT
/begin MEASUREMENT DewDet_S1B1_I.flgRstDewDet "Instance of dew point end class of sensor 1 at bank 1 / falling edge dew point end" UBYTE B_TRUE 1 100 0.00 1.00000000000 BIT_MASK 0x8 FORMAT "%13.11" ECU_ADDRESS 0x500011C9 /end MEASUREMENT
/begin MEASUREMENT DewDet_S1B1_I.flgRstDewPntEnd "Instance of dew point end class of sensor 1 at bank 1 / flag condition for reset dew-point end sensor" UBYTE B_TRUE 1 100 0.00 1.00000000000 BIT_MASK 0x80 FORMAT "%13.11" ECU_ADDRESS 0x500011C8 /end MEASUREMENT
/begin MEASUREMENT DewDet_S1B1_I.flgRstEngOff "Instance of dew point end class of sensor 1 at bank 1 / condition dew point bit sensor reseted at engine stop" UBYTE B_TRUE 1 100 0.00 1.00000000000 BIT_MASK 0x1 FORMAT "%13.11" ECU_ADDRESS 0x500011C9 /end MEASUREMENT
/begin MEASUREMENT DewDet_S1B1_I.flgRstEngOffStrt "Instance of dew point end class of sensor 1 at bank 1 / condition dew point bit sensor reseted at last engine stop" UBYTE B_TRUE 1 100 0.00 1.00000000000 BIT_MASK 0x10 FORMAT "%13.11" ECU_ADDRESS 0x500011C9 /end MEASUREMENT
/begin MEASUREMENT DewDet_S1B1_I.flgRstInt "Instance of dew point end class of sensor 1 at bank 1 / flag for reset of heat flow integral sensor" UBYTE B_TRUE 1 100 0.00 1.00000000000 BIT_MASK 0x2 FORMAT "%13.11" ECU_ADDRESS 0x500011C9 /end MEASUREMENT
/begin MEASUREMENT DewDet_S1B1_I.flgSetDewPntEnd "Instance of dew point end class of sensor 1 at bank 1 / flag set dew point end sensor" UBYTE B_TRUE 1 100 0.00 1.00000000000 BIT_MASK 0x4 FORMAT "%13.11" ECU_ADDRESS 0x500011C9 /end MEASUREMENT
/begin MEASUREMENT DewDet_S1B1_I.flgTUpdFco "Instance of dew point end class of sensor 1 at bank 1 / condition update sensor start temperature due to reset of dew point end while FCO" UBYTE B_TRUE 1 100 0.00 1.00000000000 BIT_MASK 0x20 FORMAT "%13.11" ECU_ADDRESS 0x500011C9 /end MEASUREMENT
/begin MEASUREMENT DewDet_S1B1_I.mfExhSnsr "Instance of dew point end class of sensor 1 at bank 1 / exhaust-gas mass flows" FLOAT32_IEEE RBPtCel_mf_1p0_1 1 100 -100000.0000 100000.0000 FORMAT "%10.4" ECU_ADDRESS 0x500011C4 /end MEASUREMENT
/begin MEASUREMENT DewDet_S1B1_I.tSnsrCoolg "Instance of dew point end class of sensor 1 at bank 1 / temperature at sensor while engine stop" SWORD Temp_Cels 1 100 -3549.940 3003.560 FORMAT "%8.3" ECU_ADDRESS 0x500011CA /end MEASUREMENT
/begin MEASUREMENT DewDet_S1B1_I.tSnsrEnd "Instance of dew point end class of sensor 1 at bank 1 / temperature at sensor at switch off" SWORD Temp_Cels 1 100 -3549.940 3003.560 FORMAT "%8.3" ECU_ADDRESS 0x600365C6 /end MEASUREMENT
/begin MEASUREMENT DewDet_S1B1_I.tSnsrStrt "Instance of dew point end class of sensor 1 at bank 1 / temperature at sensor at engine start" SWORD Temp_Cels 1 100 -3549.940 3003.560 FORMAT "%8.3" ECU_ADDRESS 0x500011CC /end MEASUREMENT
/begin MEASUREMENT DewDet_S1B1_I.tWallCoolg "Instance of dew point end class of sensor 1 at bank 1 / temperature wall of sensor = f(stop time) in stop phase" SWORD Temp_Cels 1 100 -3549.940 3003.560 FORMAT "%8.3" ECU_ADDRESS 0x500011CE /end MEASUREMENT
/begin MEASUREMENT DewDet_S1B1_I.tWallEngStop "Instance of dew point end class of sensor 1 at bank 1 / temperature wall of sensor bei start of stop phase" SWORD Temp_Cels 1 100 -3549.940 3003.560 FORMAT "%8.3" ECU_ADDRESS 0x500011D0 /end MEASUREMENT
/begin MEASUREMENT DewDet_S1B1_I.tWallSnsrOld "Instance of dew point end class of sensor 1 at bank 1 / wall temperature sensor old" SWORD Temp_Cels 1 100 -3549.940 3003.560 FORMAT "%8.3" ECU_ADDRESS 0x500011D2 /end MEASUREMENT
/begin MEASUREMENT DewDet_S1B1_I.tiShtDwn "Instance of dew point end class of sensor 1 at bank 1 / stop time dew-point end" UWORD t1sxs_uw_q1 1 100 0.00 65535.00 FORMAT "%8.2" ECU_ADDRESS 0x500011D4 /end MEASUREMENT
/begin MEASUREMENT DewDet_S2B1_I.cntrCldStrtSnsr "Instance of dew point end class of sensor 2 at bank 1 / counter for repeated cold starts dew-point end not reached sensor" UBYTE dez 1 100 0.00 255.0 FORMAT "%5.1" ECU_ADDRESS 0x600365B4 /end MEASUREMENT
/begin MEASUREMENT DewDet_S2B1_I.egyInteg "Instance of dew point end class of sensor 2 at bank 1 / heat quantity to dew-point end" SWORD q_q1_kJ 1 100 -32768.00 32767.00 FORMAT "%8.2" ECU_ADDRESS 0x500011E0 /end MEASUREMENT
/begin MEASUREMENT DewDet_S2B1_I.egyIntegAcm "Instance of dew point end class of sensor 2 at bank 1 / accumulated of heat quantity for dew-point end" SWORD q_q1_kJ 1 100 -32768.00 32767.00 FORMAT "%8.2" ECU_ADDRESS 0x500011E2 /end MEASUREMENT
/begin MEASUREMENT DewDet_S2B1_I.egyIntegAcmLst "Instance of dew point end class of sensor 2 at bank 1 / accumulated of heat quantity for dew-point end (last trip)" SWORD q_q1_kJ 1 100 -32768.00 32767.00 FORMAT "%8.2" ECU_ADDRESS 0x600365B6 /end MEASUREMENT
/begin MEASUREMENT DewDet_S2B1_I.egyIntegHiResl "Instance of dew point end class of sensor 2 at bank 1 / heat quantity to dew-point end high resolution" SLONG q_q1p5259Em5_kJ 1 100 0.00 32767.9999847 FORMAT "%13.7" ECU_ADDRESS 0x500011E4 /end MEASUREMENT
/begin MEASUREMENT DewDet_S2B1_I.egyIntegInp "Instance of dew point end class of sensor 2 at bank 1 / Inout for output egyInteg" SLONG q_q1p5259Em5_kJ 1 100 -32768.0000000 32767.9999847 FORMAT "%13.7" ECU_ADDRESS 0x500011E8 /end MEASUREMENT
/begin MEASUREMENT DewDet_S2B1_I.egyThd "Instance of dew point end class of sensor 2 at bank 1 / heat quantity threshold for dew-point end" SWORD q_q1_kJ 1 100 0.00 32767.00 FORMAT "%8.2" ECU_ADDRESS 0x500011EC /end MEASUREMENT
/begin MEASUREMENT DewDet_S2B1_I.egyThdEngRunLst "Instance of dew point end class of sensor 2 at bank 1 / heat quantity threshold at end of last engine run for dew-point end downstream" SWORD q_q1_kJ 1 100 0.00 32767.00 FORMAT "%8.2" ECU_ADDRESS 0x500011EE /end MEASUREMENT
/begin MEASUREMENT DewDet_S2B1_I.egyThdHeat "Instance of dew point end class of sensor 2 at bank 1 / heat quantity threshold for dew-point end" SWORD q_q1_kJ 1 100 0.00 32767.00 FORMAT "%8.2" ECU_ADDRESS 0x500011F0 /end MEASUREMENT
/begin MEASUREMENT DewDet_S2B1_I.egyThdLst "Instance of dew point end class of sensor 2 at bank 1 / heat quantity threshold for dew-point end (last trip)" SWORD q_q1_kJ 1 100 0.00 32767.00 FORMAT "%8.2" ECU_ADDRESS 0x600365B8 /end MEASUREMENT
/begin MEASUREMENT DewDet_S2B1_I.egyThdRaw "Instance of dew point end class of sensor 2 at bank 1 / heat quantity threshold for dew-point end without cold start counter" SWORD q_q1_kJ 1 100 0.00 32767.00 FORMAT "%8.2" ECU_ADDRESS 0x500011F2 /end MEASUREMENT
/begin MEASUREMENT DewDet_S2B1_I.egy_inc "Instance of dew point end class of sensor 2 at bank 1 / energy increment" SLONG q_q1p5259Em5_kJ 1 100 -32768.0000000 32767.9999847 FORMAT "%13.7" ECU_ADDRESS 0x500011F4 /end MEASUREMENT
/begin MEASUREMENT DewDet_S2B1_I.facCoolgSnrs "Instance of dew point end class of sensor 2 at bank 1 / factor for decrease in temperature of sensor" UBYTE fak_ub_b2 1 100 0.00 1.000000 FORMAT "%8.6" ECU_ADDRESS 0x500011F8 /end MEASUREMENT
/begin MEASUREMENT DewDet_S2B1_I.flgAcmEgySnsr "Instance of dew point end class of sensor 2 at bank 1 / flag calculation accumulation of heat quantity sensor" UBYTE B_TRUE 1 100 0.00 1.00000000000 BIT_MASK 0x1 FORMAT "%13.11" ECU_ADDRESS 0x50001200 /end MEASUREMENT
/begin MEASUREMENT DewDet_S2B1_I.flgCondRstInt "Instance of dew point end class of sensor 2 at bank 1 / flag condition for reset integrator for dew point fullfilled" UBYTE B_TRUE 1 100 0.00 1.00000000000 BIT_MASK 0x2 FORMAT "%13.11" ECU_ADDRESS 0x50001200 /end MEASUREMENT
/begin MEASUREMENT DewDet_S2B1_I.flgDewPntEnd "Instance of dew point end class of sensor 2 at bank 1 / flag dew-point end sensor" UBYTE B_TRUE 1 100 0.00 1.00000000000 BIT_MASK 0x4 FORMAT "%13.11" ECU_ADDRESS 0x50001200 /end MEASUREMENT
/begin MEASUREMENT DewDet_S2B1_I.flgDewPntEndLst "Instance of dew point end class of sensor 2 at bank 1 / flag dew-point end sensor (last trip)" UBYTE B_TRUE 1 100 0.00 1.00000000000 BIT_MASK 0x1 FORMAT "%13.11" ECU_ADDRESS 0x600365BA /end MEASUREMENT
/begin MEASUREMENT DewDet_S2B1_I.flgRatNEngRelFuM "Instance of dew point end class of sensor 2 at bank 1 / Flag current energy input lower threshold sensor" UBYTE B_TRUE 1 100 0.00 1.00000000000 BIT_MASK 0x40 FORMAT "%13.11" ECU_ADDRESS 0x50001200 /end MEASUREMENT
/begin MEASUREMENT DewDet_S2B1_I.flgRstDewDet "Instance of dew point end class of sensor 2 at bank 1 / falling edge dew point end" UBYTE B_TRUE 1 100 0.00 1.00000000000 BIT_MASK 0x8 FORMAT "%13.11" ECU_ADDRESS 0x50001201 /end MEASUREMENT
/begin MEASUREMENT DewDet_S2B1_I.flgRstDewPntEnd "Instance of dew point end class of sensor 2 at bank 1 / flag condition for reset dew-point end sensor" UBYTE B_TRUE 1 100 0.00 1.00000000000 BIT_MASK 0x80 FORMAT "%13.11" ECU_ADDRESS 0x50001200 /end MEASUREMENT
/begin MEASUREMENT DewDet_S2B1_I.flgRstEngOff "Instance of dew point end class of sensor 2 at bank 1 / condition dew point bit sensor reseted at engine stop" UBYTE B_TRUE 1 100 0.00 1.00000000000 BIT_MASK 0x1 FORMAT "%13.11" ECU_ADDRESS 0x50001201 /end MEASUREMENT
/begin MEASUREMENT DewDet_S2B1_I.flgRstEngOffStrt "Instance of dew point end class of sensor 2 at bank 1 / condition dew point bit sensor reseted at last engine stop" UBYTE B_TRUE 1 100 0.00 1.00000000000 BIT_MASK 0x10 FORMAT "%13.11" ECU_ADDRESS 0x50001201 /end MEASUREMENT
/begin MEASUREMENT DewDet_S2B1_I.flgRstInt "Instance of dew point end class of sensor 2 at bank 1 / flag for reset of heat flow integral sensor" UBYTE B_TRUE 1 100 0.00 1.00000000000 BIT_MASK 0x2 FORMAT "%13.11" ECU_ADDRESS 0x50001201 /end MEASUREMENT
/begin MEASUREMENT DewDet_S2B1_I.flgSetDewPntEnd "Instance of dew point end class of sensor 2 at bank 1 / flag set dew point end sensor" UBYTE B_TRUE 1 100 0.00 1.00000000000 BIT_MASK 0x4 FORMAT "%13.11" ECU_ADDRESS 0x50001201 /end MEASUREMENT
/begin MEASUREMENT DewDet_S2B1_I.flgTUpdFco "Instance of dew point end class of sensor 2 at bank 1 / condition update sensor start temperature due to reset of dew point end while FCO" UBYTE B_TRUE 1 100 0.00 1.00000000000 BIT_MASK 0x20 FORMAT "%13.11" ECU_ADDRESS 0x50001201 /end MEASUREMENT
/begin MEASUREMENT DewDet_S2B1_I.mfExhSnsr "Instance of dew point end class of sensor 2 at bank 1 / exhaust-gas mass flows" FLOAT32_IEEE RBPtCel_mf_1p0_1 1 100 -100000.0000 100000.0000 FORMAT "%10.4" ECU_ADDRESS 0x500011FC /end MEASUREMENT
/begin MEASUREMENT DewDet_S2B1_I.tSnsrCoolg "Instance of dew point end class of sensor 2 at bank 1 / temperature at sensor while engine stop" SWORD Temp_Cels 1 100 -3549.940 3003.560 FORMAT "%8.3" ECU_ADDRESS 0x50001202 /end MEASUREMENT
/begin MEASUREMENT DewDet_S2B1_I.tSnsrEnd "Instance of dew point end class of sensor 2 at bank 1 / temperature at sensor at switch off" SWORD Temp_Cels 1 100 -3549.940 3003.560 FORMAT "%8.3" ECU_ADDRESS 0x600365BC /end MEASUREMENT
/begin MEASUREMENT DewDet_S2B1_I.tSnsrStrt "Instance of dew point end class of sensor 2 at bank 1 / temperature at sensor at engine start" SWORD Temp_Cels 1 100 -3549.940 3003.560 FORMAT "%8.3" ECU_ADDRESS 0x50001204 /end MEASUREMENT
/begin MEASUREMENT DewDet_S2B1_I.tWallCoolg "Instance of dew point end class of sensor 2 at bank 1 / temperature wall of sensor = f(stop time) in stop phase" SWORD Temp_Cels 1 100 -3549.940 3003.560 FORMAT "%8.3" ECU_ADDRESS 0x50001206 /end MEASUREMENT
/begin MEASUREMENT DewDet_S2B1_I.tWallEngStop "Instance of dew point end class of sensor 2 at bank 1 / temperature wall of sensor bei start of stop phase" SWORD Temp_Cels 1 100 -3549.940 3003.560 FORMAT "%8.3" ECU_ADDRESS 0x50001208 /end MEASUREMENT
/begin MEASUREMENT DewDet_S2B1_I.tWallSnsrOld "Instance of dew point end class of sensor 2 at bank 1 / wall temperature sensor old" SWORD Temp_Cels 1 100 -3549.940 3003.560 FORMAT "%8.3" ECU_ADDRESS 0x5000120A /end MEASUREMENT
/begin MEASUREMENT DewDet_S2B1_I.tiShtDwn "Instance of dew point end class of sensor 2 at bank 1 / stop time dew-point end" UWORD t1sxs_uw_q1 1 100 0.00 65535.00 FORMAT "%8.2" ECU_ADDRESS 0x5000120C /end MEASUREMENT
/begin MEASUREMENT DewDet_tiShDown "stop time dew-point end" UWORD t_q1 1 100 0.00 65535.00 FORMAT "%8.2" ECU_ADDRESS 0x60004918 /end MEASUREMENT
/begin MEASUREMENT dlamatr_w_msg "desired delta lambda of exhaust temperature control" SWORD fak_sw_b8 1 100 -8.000000 7.999756 FORMAT "%8.6" ECU_ADDRESS 0x60004944 /end MEASUREMENT
/begin MEASUREMENT dlambssa_w "Distance between lambda for component protection and release of fuel cut-off" SWORD fak_sw_b8 1 100 -7.999756 7.999756 FORMAT "%8.6" ECU_ADDRESS 0x600038D4 /end MEASUREMENT
/begin MEASUREMENT dlbtszwr_w "Delta-lambda for component protection due to ignition retardation compared with basic ignition timing (raw value)" SWORD fak_sw_b8 1 100 -1.000000 1.000000 FORMAT "%8.6" ECU_ADDRESS 0x600038EE /end MEASUREMENT
/begin MEASUREMENT ECT_bFCOEnaCmpnPrt "condition: torque reduction by injection fade out due to temperature, component protection" UBYTE B_TRUE 1 100 0.00 1.00000000000 BIT_MASK 0x1 FORMAT "%13.11" ECU_ADDRESS 0x60009FB0 /end MEASUREMENT
/begin MEASUREMENT etakhko_w "desired engine efficiency for catalyst heating" UWORD fak_q3p0518Em5 1 100 0.00 1.999969 FORMAT "%8.6" ECU_ADDRESS 0x60003924 /end MEASUREMENT
/begin MEASUREMENT etakhlim_w "desired engine efficiency for catalyst heating by cold start, limited" UWORD fak_uw_b2 1 100 0.00 1.999969 FORMAT "%8.6" ECU_ADDRESS 0x60003922 /end MEASUREMENT
/begin MEASUREMENT etazwg_w "Efficiency of basic ignition timing" UWORD fak_uw_b2 1 100 0.00 1.999969 FORMAT "%8.6" ECU_ADDRESS 0x600038F0 /end MEASUREMENT
/begin MEASUREMENT etkhlmxloc "minimum distance to error threshold (MAX-Errorpath) inside idle (during life cycle)" UBYTE rel_q0p78125 1 100 0.00 199.2 FORMAT "%5.1" ECU_ADDRESS 0x600365CD /end MEASUREMENT
/begin MEASUREMENT etkhlmx_msg "minimum distance to error threshold (MAX-Errorpath) inside idle (during life cycle)" UBYTE rel_q0p78125 1 100 0.00 199.2 FORMAT "%5.1" ECU_ADDRESS 0x6000E448 /end MEASUREMENT
/begin MEASUREMENT etkhtmxloc "minimum distance to error threshold (MAX-Errorpath) outside idle (during life cycle)" UBYTE rel_q0p78125 1 100 0.00 199.2 FORMAT "%5.1" ECU_ADDRESS 0x600365CC /end MEASUREMENT
/begin MEASUREMENT etkhtmx_msg "minimum distance to error threshold (MAX-Errorpath) outside idle (during life cycle)" UBYTE rel_q0p78125 1 100 0.00 199.2 FORMAT "%5.1" ECU_ADDRESS 0x6000E449 /end MEASUREMENT
/begin MEASUREMENT ExhMgT_CatHeatg1_I.stOperMod "connection of catalyst heating at operation mode coordinator / Priority-element of the operation mode structure" ULONG OneToOne 1 100 0.00 4294967295.00 FORMAT "%13.2" ECU_ADDRESS 0x700019CC /end MEASUREMENT
/begin MEASUREMENT ExhMgT_CatHeatg1_I.stOperModPrio "connection of catalyst heating at operation mode coordinator / Stage-element of the operation mode structure" UBYTE OneToOne 1 100 0.00 255.0 FORMAT "%5.1" ECU_ADDRESS 0x700019D0 /end MEASUREMENT
/begin MEASUREMENT ExhMgT_CatHeatg1_I.stOperModStg "connection of catalyst heating at operation mode coordinator / Operation-mode element of the operation mode structure" UWORD OneToOne 1 100 0.00 65535.00 FORMAT "%8.2" ECU_ADDRESS 0x700019D2 /end MEASUREMENT
/begin MEASUREMENT ExhMgT_CatHeatg2_I.stOperMod "connection of catalyst heating at operation mode coordinator / Priority-element of the operation mode structure" ULONG OneToOne 1 100 0.00 4294967295.00 FORMAT "%13.2" ECU_ADDRESS 0x700019C4 /end MEASUREMENT
/begin MEASUREMENT ExhMgT_CatHeatg2_I.stOperModPrio "connection of catalyst heating at operation mode coordinator / Stage-element of the operation mode structure" UBYTE OneToOne 1 100 0.00 255.0 FORMAT "%5.1" ECU_ADDRESS 0x700019C8 /end MEASUREMENT
/begin MEASUREMENT ExhMgT_CatHeatg2_I.stOperModStg "connection of catalyst heating at operation mode coordinator / Operation-mode element of the operation mode structure" UWORD OneToOne 1 100 0.00 65535.00 FORMAT "%8.2" ECU_ADDRESS 0x700019CA /end MEASUREMENT
/begin MEASUREMENT ExhMgT_CatHeatg3_I.stOperMod "connection of catalyst heating at operation mode coordinator / Priority-element of the operation mode structure" ULONG OneToOne 1 100 0.00 4294967295.00 FORMAT "%13.2" ECU_ADDRESS 0x700019BC /end MEASUREMENT
/begin MEASUREMENT ExhMgT_CatHeatg3_I.stOperModPrio "connection of catalyst heating at operation mode coordinator / Stage-element of the operation mode structure" UBYTE OneToOne 1 100 0.00 255.0 FORMAT "%5.1" ECU_ADDRESS 0x700019C0 /end MEASUREMENT
/begin MEASUREMENT ExhMgT_CatHeatg3_I.stOperModStg "connection of catalyst heating at operation mode coordinator / Operation-mode element of the operation mode structure" UWORD OneToOne 1 100 0.00 65535.00 FORMAT "%8.2" ECU_ADDRESS 0x700019C2 /end MEASUREMENT
/begin MEASUREMENT ExhMgT_cntrIniDrvTExhCtrlrCptProtn "local drive cycle counter which is incremented when system state SyC_PostDrive is left" UBYTE OneToOne 1 100 0.00 255.0 FORMAT "%5.1" ECU_ADDRESS 0x600064A7 /end MEASUREMENT
/begin MEASUREMENT ExhMgT_cntrReiniDiagEtaIaCatHeatg "Counter for recognizing the re-initialization of variables and parameters" UBYTE OneToOne 1 100 0.00 255.0 FORMAT "%5.1" ECU_ADDRESS 0x600064B1 /end MEASUREMENT
/begin MEASUREMENT ExhMgT_cntrReiniDmdOperModCatHeatg "Counter for recognizing the re-initialization of variables and parameters" UBYTE OneToOne 1 100 0.00 255.0 FORMAT "%5.1" ECU_ADDRESS 0x600064AF /end MEASUREMENT
/begin MEASUREMENT ExhMgT_cntrReIniIaDeltaCptProtn "local drive cycle counter which is incremented when system state SyC_PostDrive is left" UBYTE OneToOne 1 100 0.00 255.0 FORMAT "%5.1" ECU_ADDRESS 0x600064AE /end MEASUREMENT
/begin MEASUREMENT ExhMgT_cntrReIniRelsFcoTEgSys "counter reini ReIni ExhMgT_RelsFcoTEgSys" UBYTE OneToOne 1 100 0.00 255.0 FORMAT "%5.1" ECU_ADDRESS 0x600064AC /end MEASUREMENT
/begin MEASUREMENT ExhMgT_cntrReIniTExhCtrlrCptProtn "local drive cycle counter which is incremented when system state SyC_PostDrive is left" UBYTE OneToOne 1 100 0.00 255.0 FORMAT "%5.1" ECU_ADDRESS 0x600064A6 /end MEASUREMENT
/begin MEASUREMENT ExhMgT_DmdCsersCdnCatHeatg_ctReIni "local drive cycle counter which is incremented when system state SyC_PostDrive is left" UBYTE dez 1 100 0.00 255.0 FORMAT "%5.1" ECU_ADDRESS 0x600064B0 /end MEASUREMENT
/begin MEASUREMENT ExhMgT_effAvrgEngIdleNonCsers "mean deviation of actuell ignition effciency and desired catalyst heating ignition efficiency during idle" SWORD fak_q3p0518Em5 1 100 -1.000000 0.999969 FORMAT "%8.6" ECU_ADDRESS 0x60003920 /end MEASUREMENT
/begin MEASUREMENT ExhMgT_effAvrgEngPtlNonCsers "mean deviation of actuell ignition effciency and desired catalyst heating ignition efficiency outside idle" SWORD fak_q3p0518Em5 1 100 -1.000000 0.999969 FORMAT "%8.6" ECU_ADDRESS 0x6000391E /end MEASUREMENT
/begin MEASUREMENT ExhMgT_effEngIdleNonCsersMax "maximum allowed deviation of ignition efficiency during catalyst haeting during idle (MAX-Errorpath)" SWORD fak_q3p0518Em5 1 100 -1.000000 0.999969 FORMAT "%8.6" ECU_ADDRESS 0x6000391C /end MEASUREMENT
/begin MEASUREMENT ExhMgT_effEngPtlNonCsersMax "maximum allowed deviation of ignition efficiency during catalyst haeting during part load (MAX-Errorpath)" SWORD fak_q3p0518Em5 1 100 -1.000000 0.999969 FORMAT "%8.6" ECU_ADDRESS 0x6000391A /end MEASUREMENT
/begin MEASUREMENT ExhMgT_effIntegEngIdleNonCsers "integration of differenz between actuell ignition effciency and desired catalyst heating ignition efficiency during idle" SWORD fak_q0p03125 1 100 -1024.000 1023.969 FORMAT "%8.3" ECU_ADDRESS 0x60003918 /end MEASUREMENT
/begin MEASUREMENT ExhMgT_effIntegEngPtlNonCsers "integration of differenz between actuell ignition effciency and desired catalyst heating ignition efficiency outside idle" SWORD fak_q0p03125 1 100 -1024.000 1023.969 FORMAT "%8.3" ECU_ADDRESS 0x60003916 /end MEASUREMENT
/begin MEASUREMENT ExhMgT_facCptProtnMisf "factor for reduction of desired air charge in case of catalyst damaged misfires for component protection of exhaust system" UWORD fak_uw_b2 1 100 0.600006 1.000000 FORMAT "%8.6" ECU_ADDRESS 0x600048E2 /end MEASUREMENT
/begin MEASUREMENT ExhMgT_facDftlCptProtnGovrB1 "factor for D-part of exhaust temperature controller, bench1" SWORD fak_q0p01 1 100 -327.6800 327.6700 FORMAT "%8.4" ECU_ADDRESS 0x600038B2 /end MEASUREMENT
/begin MEASUREMENT ExhMgT_facFirstRdcAirFillg "Previous factor for reducing the maximum desired air charge for component protection" UWORD fak_uw_b2 1 100 0.00 1.999969 FORMAT "%8.6" ECU_ADDRESS 0x600048E0 /end MEASUREMENT
/begin MEASUREMENT ExhMgT_facMinRednCptProtn "dynamic lower limit of reduction factor for maximum air charge component protection" UWORD fak_uw_b2 1 100 0.6000061 0.9999695 FORMAT "%9.7" ECU_ADDRESS 0x600038DE /end MEASUREMENT
/begin MEASUREMENT ExhMgT_facRdcAirFillg "demand of the reduction factor for maximum air charge" UWORD fak_uw_b2 1 100 0.00 1.999969 FORMAT "%8.6" ECU_ADDRESS 0x600048D8 /end MEASUREMENT
/begin MEASUREMENT ExhMgT_facRdcAirFillgCptProtn "Relative factor of the maximum air charge per second during component protection" SWORD fak_sw_b1 1 100 -1.000000 0.999969 FORMAT "%8.6" ECU_ADDRESS 0x600038DC /end MEASUREMENT
/begin MEASUREMENT ExhMgT_flgAllwdFuFco "component protection allowes fired thrust" UBYTE B_TRUE 1 100 0.00 1.00000000000 BIT_MASK 0x1 FORMAT "%13.11" ECU_ADDRESS 0x600064AB /end MEASUREMENT
/begin MEASUREMENT ExhMgT_flgCatHeatgCsers "CSERS relevant catalyst heating is active" UBYTE B_TRUE 1 100 0.00 1.00000000000 BIT_MASK 0x1 FORMAT "%13.11" ECU_ADDRESS 0x700007DE /end MEASUREMENT
/begin MEASUREMENT ExhMgT_flgCatHeatgDmdCond "Condition for operating mode request cold start catalyst heating based on codeword" UBYTE B_TRUE 1 100 0.00 1.00000000000 BIT_MASK 0x1 FORMAT "%13.11" ECU_ADDRESS 0x7000022A /end MEASUREMENT
/begin MEASUREMENT ExhMgT_flgCatHeatgNonCsers "Non CSERS relevant catalyst warming is active" UBYTE B_TRUE 1 100 0.00 1.00000000000 BIT_MASK 0x1 FORMAT "%13.11" ECU_ADDRESS 0x700007D7 /end MEASUREMENT
/begin MEASUREMENT ExhMgT_flgCntDenumIdleCsers "set condition for specific denominator for Idle CSERS type" UBYTE B_TRUE 1 100 0.00 1.00000000000 BIT_MASK 0x1 FORMAT "%13.11" ECU_ADDRESS 0x70000242 /end MEASUREMENT
/begin MEASUREMENT ExhMgT_flgCntDenumIdleNonCsers "set condition for specific denominator for cold start strategy (Non-CSERS) during idle" UBYTE B_TRUE 1 100 0.00 1.00000000000 BIT_MASK 0x1 FORMAT "%13.11" ECU_ADDRESS 0x70000241 /end MEASUREMENT
/begin MEASUREMENT ExhMgT_flgCntDenumPartLoadCsers "set condition for specific denominator for part load CSERS type" UBYTE B_TRUE 1 100 0.00 1.00000000000 BIT_MASK 0x1 FORMAT "%13.11" ECU_ADDRESS 0x70000240 /end MEASUREMENT
/begin MEASUREMENT ExhMgT_flgCntDenumPartLoadNonCsers "set condition for specific denominator for part load non CSERS type" UBYTE B_TRUE 1 100 0.00 1.00000000000 BIT_MASK 0x1 FORMAT "%13.11" ECU_ADDRESS 0x7000023F /end MEASUREMENT
/begin MEASUREMENT ExhMgT_flgColdStrtCatHeatg "condition for coldstart catalyst heating" UBYTE B_TRUE 1 100 0.00 1.00000000000 BIT_MASK 0x1 FORMAT "%13.11" ECU_ADDRESS 0x700007CD /end MEASUREMENT
/begin MEASUREMENT ExhMgT_flgColdStrtDmdCond "Condition for operating mode request cold start catalyst heating" UBYTE B_TRUE 1 100 0.00 1.00000000000 BIT_MASK 0x1 FORMAT "%13.11" ECU_ADDRESS 0x70000229 /end MEASUREMENT
/begin MEASUREMENT ExhMgT_flgCtrlActvCptProtnB1 "condition exhaust temperature control bank 1" UBYTE B_TRUE 1 100 0.00 1.00000000000 BIT_MASK 0x1 FORMAT "%13.11" ECU_ADDRESS 0x700007CC /end MEASUREMENT
/begin MEASUREMENT ExhMgT_flgCutOffFirstTi "The release of the overrun fuel cut to prevent cooling down was at least once transacted" UBYTE B_TRUE 1 100 0.00 1.00000000000 BIT_MASK 0x1 FORMAT "%13.11" ECU_ADDRESS 0x600064AA /end MEASUREMENT
/begin MEASUREMENT ExhMgT_flgDiagCsersIdle "CSERS diagnosis at idle" UBYTE B_TRUE 1 100 0.00 1.00000000000 BIT_MASK 0x1 FORMAT "%13.11" ECU_ADDRESS 0x7000023E /end MEASUREMENT
/begin MEASUREMENT ExhMgT_flgDiagCsersPartLoad "CSERS diagnosis at part load" UBYTE B_TRUE 1 100 0.00 1.00000000000 BIT_MASK 0x1 FORMAT "%13.11" ECU_ADDRESS 0x7000023D /end MEASUREMENT
/begin MEASUREMENT ExhMgT_flgDiagIdlePrms "release of diagnosis in idle" UBYTE B_TRUE 1 100 0.00 1.00000000000 BIT_MASK 0x1 FORMAT "%13.11" ECU_ADDRESS 0x7000023C /end MEASUREMENT
/begin MEASUREMENT ExhMgT_flgDiagPartLoadPrms "release of diagnosis in part load" UBYTE B_TRUE 1 100 0.00 1.00000000000 BIT_MASK 0x1 FORMAT "%13.11" ECU_ADDRESS 0x7000023B /end MEASUREMENT
/begin MEASUREMENT ExhMgT_flgEnaDiagIdleNonCsers "release calculation of engine efficiency deviation for diagnosis of ignition during idle" UBYTE B_TRUE 1 100 0.00 1.00000000000 BIT_MASK 0x1 FORMAT "%13.11" ECU_ADDRESS 0x7000023A /end MEASUREMENT
/begin MEASUREMENT ExhMgT_flgEnaDiagPtlNonCsers "release calculation of engine efficiency deviation for diagnosis of ignition during part load" UBYTE B_TRUE 1 100 0.00 1.00000000000 BIT_MASK 0x1 FORMAT "%13.11" ECU_ADDRESS 0x70000239 /end MEASUREMENT
/begin MEASUREMENT ExhMgT_flgErreffIdleNonCsers "condition for detected error of ignition timing efficiency diagnosis for catalyst heating during cold start (MAX-Errorpath) during idle at the end of catalyst heating" UBYTE B_TRUE 1 100 0.00 1.00000000000 BIT_MASK 0x1 FORMAT "%13.11" ECU_ADDRESS 0x70000238 /end MEASUREMENT
/begin MEASUREMENT ExhMgT_flgErreffIdleNonCsersCurr "condition for detected error of ignition timing efficiency diagnosis for catalyst heating during cold start (MAX-Errorpath) during idle" UBYTE B_TRUE 1 100 0.00 1.00000000000 BIT_MASK 0x1 FORMAT "%13.11" ECU_ADDRESS 0x70000237 /end MEASUREMENT
/begin MEASUREMENT ExhMgT_flgErreffPtlNonCsers "condition for detected error of ignition timing efficiency diagnosis for catalyst heating during cold start (MAX-Errorpath) during part load at the end of catalyst heating" UBYTE B_TRUE 1 100 0.00 1.00000000000 BIT_MASK 0x1 FORMAT "%13.11" ECU_ADDRESS 0x70000236 /end MEASUREMENT
/begin MEASUREMENT ExhMgT_flgErreffPtlNonCsersCurr "condition for detected error of ignition timing efficiency diagnosis for catalyst heating during cold start (MAX-Errorpath) during part load" UBYTE B_TRUE 1 100 0.00 1.00000000000 BIT_MASK 0x1 FORMAT "%13.11" ECU_ADDRESS 0x70000235 /end MEASUREMENT
/begin MEASUREMENT ExhMgT_flgEvlnBlwThdIdle "Deviation of desired ignition angle efficiency in idle below threshold (CSERS)" UBYTE B_TRUE 1 100 0.00 1.00000000000 BIT_MASK 0x1 FORMAT "%13.11" ECU_ADDRESS 0x70000234 /end MEASUREMENT
/begin MEASUREMENT ExhMgT_flgEvlnBlwThdIdleNonCsers "Deviation of desired ignition angle efficiency in idle below threshold (NonCSERS)" UBYTE B_TRUE 1 100 0.00 1.00000000000 BIT_MASK 0x1 FORMAT "%13.11" ECU_ADDRESS 0x70000233 /end MEASUREMENT
/begin MEASUREMENT ExhMgT_flgEvlnBlwThdPartLoad "Deviation of desired ignition angle efficiency in part load below threshold (CSERS)" UBYTE B_TRUE 1 100 0.00 1.00000000000 BIT_MASK 0x1 FORMAT "%13.11" ECU_ADDRESS 0x70000232 /end MEASUREMENT
/begin MEASUREMENT ExhMgT_flgEvlnBlwThdPartLoadNonCsers "Deviation of desired ignition angle efficiency in part load below threshold (NonCSERS)" UBYTE B_TRUE 1 100 0.00 1.00000000000 BIT_MASK 0x1 FORMAT "%13.11" ECU_ADDRESS 0x70000231 /end MEASUREMENT
/begin MEASUREMENT ExhMgT_flgFCMClrEtaCatHeatg "FCM-Clear requested because of diagnosis of engine efficiency during catalyst heating" UBYTE B_TRUE 1 100 0.00 1.00000000000 BIT_MASK 0x1 FORMAT "%13.11" ECU_ADDRESS 0x70000230 /end MEASUREMENT
/begin MEASUREMENT ExhMgT_flgIaDeltaCorrn "flag for consideration of the correction of delta ignition angle efficiency" UBYTE B_TRUE 1 100 0.00 1.00000000000 BIT_MASK 0x1 FORMAT "%13.11" ECU_ADDRESS 0x700007CB /end MEASUREMENT
/begin MEASUREMENT ExhMgT_flgIaIgnDeltaCptProtn "Actualization of Delta ignition angle efficiency for component protection" UBYTE B_TRUE 1 100 0.00 1.00000000000 BIT_MASK 0x1 FORMAT "%13.11" ECU_ADDRESS 0x700007CA /end MEASUREMENT
/begin MEASUREMENT ExhMgT_flgIaIgnDeltaLoadCat1 "Component protection by spark retardation activated by the temperature of the catalyst" UBYTE B_TRUE 1 100 0.00 1.00000000000 BIT_MASK 0x1 FORMAT "%13.11" ECU_ADDRESS 0x700007C9 /end MEASUREMENT
/begin MEASUREMENT ExhMgT_flgIaIgnDeltaLoadCptProtn "Component protection by spark retardation activated" UBYTE B_TRUE 1 100 0.00 1.00000000000 BIT_MASK 0x1 FORMAT "%13.11" ECU_ADDRESS 0x700007C8 /end MEASUREMENT
/begin MEASUREMENT ExhMgT_flgIaIgnDeltaLoadMnf "Component protection by spark retardation activated by the temperature of the manifold" UBYTE B_TRUE 1 100 0.00 1.00000000000 BIT_MASK 0x1 FORMAT "%13.11" ECU_ADDRESS 0x700007C7 /end MEASUREMENT
/begin MEASUREMENT ExhMgT_flgIaIng "activation of component protection because of load dynamic" UBYTE B_TRUE 1 100 0.00 1.00000000000 BIT_MASK 0x1 FORMAT "%13.11" ECU_ADDRESS 0x700007C6 /end MEASUREMENT
/begin MEASUREMENT ExhMgT_flgLamFuFco "Activation of rich lambda by idle speed" UBYTE B_TRUE 1 100 0.00 1.00000000000 BIT_MASK 0x1 FORMAT "%13.11" ECU_ADDRESS 0x60009FA4 /end MEASUREMENT
/begin MEASUREMENT ExhMgT_flgNonCsersCdn "condition for diagnosis of cold start measurements (Non-Csers condition full-filled)" UBYTE B_TRUE 1 100 0.00 1.00000000000 BIT_MASK 0x1 FORMAT "%13.11" ECU_ADDRESS 0x700007C3 /end MEASUREMENT
/begin MEASUREMENT ExhMgT_flgNonCsersCdnTBasd "condition for diagnosis of cold start measurements (Temperature based Non-Csers condition full-filled)" UBYTE B_TRUE 1 100 0.00 1.00000000000 BIT_MASK 0x1 FORMAT "%13.11" ECU_ADDRESS 0x7000022B /end MEASUREMENT
/begin MEASUREMENT ExhMgT_flgOperModWrmDmdCond "Condition for operating mode request for catalyst warming based on codeword" UBYTE B_TRUE 1 100 0.00 1.00000000000 BIT_MASK 0x1 FORMAT "%13.11" ECU_ADDRESS 0x70000228 /end MEASUREMENT
/begin MEASUREMENT ExhMgT_flgRdcAirFillg "activation of the limitation of the rich lambda for component protection" UBYTE B_TRUE 1 100 0.00 1.00000000000 BIT_MASK 0x1 FORMAT "%13.11" ECU_ADDRESS 0x70000226 /end MEASUREMENT
/begin MEASUREMENT ExhMgT_flgRelsCutOffTExhHi "cut-off released due to the exhaust gas temperatures in order to avoid possible overheating (temperature below the critical temperature in the exhaust gas catalyst)" UBYTE B_TRUE 1 100 0.00 1.00000000000 BIT_MASK 0x1 FORMAT "%13.11" ECU_ADDRESS 0x60009FA2 /end MEASUREMENT
/begin MEASUREMENT ExhMgT_flgRelsCutOffTExhLo "cut-off released due to the exhaust gas temperatures in order to avoid possible cooling (temperature below the critical temperature in the exhaust gas catalyst)" UBYTE B_TRUE 1 100 0.00 1.00000000000 BIT_MASK 0x1 FORMAT "%13.11" ECU_ADDRESS 0x60009FA1 /end MEASUREMENT
/begin MEASUREMENT ExhMgT_flgRelsIaThdIdle "Release of idle diagnosis based on desired ignition angle efficiency threshold" UBYTE B_TRUE 1 100 0.00 1.00000000000 BIT_MASK 0x1 FORMAT "%13.11" ECU_ADDRESS 0x7000022F /end MEASUREMENT
/begin MEASUREMENT ExhMgT_flgRelsIaThdPartLoad "Release of part load diagnosis based on desired ignition angle efficiency threshold" UBYTE B_TRUE 1 100 0.00 1.00000000000 BIT_MASK 0x1 FORMAT "%13.11" ECU_ADDRESS 0x7000022E /end MEASUREMENT
/begin MEASUREMENT ExhMgT_flgRstFacRdcAirFillg "Reset of the reduction factor for maximum air charge component protection" UBYTE B_TRUE 1 100 0.00 1.00000000000 BIT_MASK 0x1 FORMAT "%13.11" ECU_ADDRESS 0x70000225 /end MEASUREMENT
/begin MEASUREMENT ExhMgT_flgSpclLft "Outlet or Intake valve lift for charge determination not equals standard lift" UBYTE B_TRUE 1 100 0.00 1.00000000000 BIT_MASK 0x1 FORMAT "%13.11" ECU_ADDRESS 0x70000224 /end MEASUREMENT
/begin MEASUREMENT ExhMgT_flgTFcoCat1 "release fuel cut-off only in dependence of first catalyst" UBYTE B_TRUE 1 100 0.00 1.00000000000 BIT_MASK 0x1 FORMAT "%13.11" ECU_ADDRESS 0x600064A9 /end MEASUREMENT
/begin MEASUREMENT ExhMgT_flgTFcoCat2 "release fuel cut-off only in dependence of second catalyst" UBYTE B_TRUE 1 100 0.00 1.00000000000 BIT_MASK 0x1 FORMAT "%13.11" ECU_ADDRESS 0x600064A8 /end MEASUREMENT
/begin MEASUREMENT ExhMgT_flgTstdeffIdleNonCsers "condition for OK Status of ignition timing efficiency diagnosis for catalyst heating during cold start (MAX-Errorpath) during idle" UBYTE B_TRUE 1 100 0.00 1.00000000000 BIT_MASK 0x1 FORMAT "%13.11" ECU_ADDRESS 0x7000022D /end MEASUREMENT
/begin MEASUREMENT ExhMgT_flgTstdeffPtlNonCsers "condition for OK Status of ignition timing efficiency diagnosis for catalyst heating during cold start (MAX-Errorpath) during part load" UBYTE B_TRUE 1 100 0.00 1.00000000000 BIT_MASK 0x1 FORMAT "%13.11" ECU_ADDRESS 0x7000022C /end MEASUREMENT
/begin MEASUREMENT ExhMgT_flgWrmDmdCond "Condition for operating mode request catalyst warming" UBYTE B_TRUE 1 100 0.00 1.00000000000 BIT_MASK 0x1 FORMAT "%13.11" ECU_ADDRESS 0x70000227 /end MEASUREMENT
/begin MEASUREMENT ExhMgT_IaCptProtn "primary ignition angle component protection" SWORD zw_q2p9297Em3_deg_KW 1 100 -96.00000 95.99707 FORMAT "%8.5" ECU_ADDRESS 0x60005098 /end MEASUREMENT
/begin MEASUREMENT ExhMgT_iaDeltaCptProtn "Delta ignition angle efficiency for component protection" UWORD fak_uw_b2 1 100 0.00 1.999969 FORMAT "%8.6" ECU_ADDRESS 0x60004CE6 /end MEASUREMENT
/begin MEASUREMENT ExhMgT_iaDeltaCptProtnCorr "Breakpoint distribution component protection over delta efficiency of spark timing" UWORD fak_uw_b2 1 100 0.00 1.999969 FORMAT "%8.6" ECU_ADDRESS 0x600048D2 /end MEASUREMENT
/begin MEASUREMENT ExhMgT_mfExhCptProtnGovr "Exhaust gas mass flow for exhaust gas temperature controller bank 1" FLOAT32_IEEE AirMassPerTime_float 1 100 0.00 50000.0000 FORMAT "%10.4" ECU_ADDRESS 0x60001444 /end MEASUREMENT
/begin MEASUREMENT ExhMgT_nCatHeatgOperMod "engine speed for catalyst heating because of a request for catalyst warming with lambda split or because of regeneration" UWORD EngN 1 100 0.00 16383.50 FORMAT "%8.2" ECU_ADDRESS 0x600038FE /end MEASUREMENT
/begin MEASUREMENT ExhMgT_nEngDiffDiagCsers "difference of currect and filtered engine speed" SWORD EngN 1 100 -16384.00 16383.50 FORMAT "%8.2" ECU_ADDRESS 0x60003914 /end MEASUREMENT
/begin MEASUREMENT ExhMgT_nEngFildDiagCsers "filtered engine speed for release of CSERS diagnosis" UWORD EngN 1 100 0.00 16383.50 FORMAT "%8.2" ECU_ADDRESS 0x60003912 /end MEASUREMENT
/begin MEASUREMENT ExhMgT_PidGovr_temp1_B1.ExhMgT_facDftlCptProtnGovrNoCorrn "CLASS_INSTANCE / factor D-Part exhaust temperature controller without correction" SWORD fak_sw_b8 1 100 -8.000000 7.999756 FORMAT "%8.6" ECU_ADDRESS 0x6000142C /end MEASUREMENT
/begin MEASUREMENT ExhMgT_PidGovr_temp1_B1.ExhMgT_ratDeltaLamCptProtnGovrMax "CLASS_INSTANCE / Maximum limit of actuator for exhaust gas temperature feedback control" SWORD fak_sw_b8 1 100 -8.000000 7.999756 FORMAT "%8.6" ECU_ADDRESS 0x6000142E /end MEASUREMENT
/begin MEASUREMENT ExhMgT_PidGovr_temp1_B1.ExhMgT_ratDeltaLamDftlCptProtnGovr "CLASS_INSTANCE / D-part of exhaust temperature controller (delta lambda)" SWORD fak_sw_b8 1 100 -8.000000 0.00 FORMAT "%8.6" ECU_ADDRESS 0x60001430 /end MEASUREMENT
/begin MEASUREMENT ExhMgT_PidGovr_temp1_B1.ExhMgT_ratDeltaLamKiCptProtnGovr "CLASS_INSTANCE / I-part of exhaust temperature controller (delta lambda)" SWORD fak_sw_b8 1 100 -8.000000 7.999756 FORMAT "%8.6" ECU_ADDRESS 0x60001432 /end MEASUREMENT
/begin MEASUREMENT ExhMgT_PidGovr_temp1_B1.ExhMgT_ratDeltaLamKpCptProtnGovr "CLASS_INSTANCE / P-part of exhaust temperature controller (delta lambda)" SWORD fak_sw_b8 1 100 -8.000000 7.999756 FORMAT "%8.6" ECU_ADDRESS 0x60001434 /end MEASUREMENT
/begin MEASUREMENT ExhMgT_PidGovr_temp1_B1.ExhMgT_tDftlCptProtnGovr "CLASS_INSTANCE / temperature of D-Part of exhaust temperature controler" SLONG q1p52588Em6_K 1 100 -3276.80000000 3276.79999847 FORMAT "%13.8" ECU_ADDRESS 0x60001438 /end MEASUREMENT
/begin MEASUREMENT ExhMgT_PidGovr_temp1_B1.ExhMgT_tDifCptProtnGovr "CLASS_INSTANCE / limited temperature of D-Part of exhaust temperature controler" SLONG q1p52588Em6_K 1 100 -3276.80000000 3276.79999847 FORMAT "%13.8" ECU_ADDRESS 0x6000143C /end MEASUREMENT
/begin MEASUREMENT ExhMgT_PidGovr_temp1_B1.CmpPrt_dlatriIKL_I.memory "CLASS_INSTANCE / integrator for I-Part of exhaust temperature controller / Current Integrator value" SLONG dez 1 100 -2147483648.00 2147483647.00 FORMAT "%13.2" ECU_ADDRESS 0x60001440 /end MEASUREMENT
/begin MEASUREMENT ExhMgT_ratCatHeatgOperMod "air charge for catalyst heating because of a request for catalyst warming with lambda split or caused by regeneration" UWORD rel_q0p0234 1 100 0.00 1535.977 FORMAT "%8.3" ECU_ADDRESS 0x600038FC /end MEASUREMENT
/begin MEASUREMENT ExhMgT_ratChrgAirDiffDiagCsers "difference of currect and filtered air charge" SWORD rel_uw_q0p0234 1 100 -768.0000 767.9766 FORMAT "%8.4" ECU_ADDRESS 0x60003910 /end MEASUREMENT
/begin MEASUREMENT ExhMgT_ratChrgAirFildDiagCsers "filtered air charge for release of CSERS diagnosis" UWORD rel_uw_q0p0234 1 100 0.00 1535.977 FORMAT "%8.3" ECU_ADDRESS 0x6000390E /end MEASUREMENT
/begin MEASUREMENT ExhMgT_ratDeltaCptProtnGovr1Min "minimum limit exhaust temperature controller 1" SWORD fak_sw_b8 1 100 -0.3999023 0.00 FORMAT "%9.7" ECU_ADDRESS 0x600038B0 /end MEASUREMENT
/begin MEASUREMENT ExhMgT_ratDeltaCptProtnGovrMin "minimal delta lambda of all controllers" SWORD fak_sw_b8 1 100 -8.000000 7.999756 FORMAT "%8.6" ECU_ADDRESS 0x600038AE /end MEASUREMENT
/begin MEASUREMENT ExhMgT_ratDeltaLamCptProtn "Delta lambda component protection due to ignition angle, speed, gear information, motor temperature, intake air temperature, the soot mass, and the ash mass in a particulate filter" SWORD fak_sw_b8 1 100 -8.000000 7.999756 FORMAT "%8.6" ECU_ADDRESS 0x600038EC /end MEASUREMENT
/begin MEASUREMENT ExhMgT_ratDeltaLamCptProtnIgn "Delta-lambda for component protection due to ignition retardation compared with basic ignition timing" SWORD fak_sw_b8 1 100 -8.000000 7.999756 FORMAT "%8.6" ECU_ADDRESS 0x600038EA /end MEASUREMENT
/begin MEASUREMENT ExhMgT_ratDeltaLamCptProtnTot1 "Delta Lambda component protection due to ignition angle, speed, gear information, motor temperature, and an error of a relevant input variable (Bank 1)" SWORD fak_sw_b8 1 100 -8.000000 7.999756 FORMAT "%8.6" ECU_ADDRESS 0x60004ADC /end MEASUREMENT
/begin MEASUREMENT ExhMgT_ratDeltaLamCtrlCptProtnB1 "desired delta lambda of exhaust temperature control bank 1" SWORD fak_sw_b8 1 100 -8.000000 7.999756 FORMAT "%8.6" ECU_ADDRESS 0x60004ADA /end MEASUREMENT
/begin MEASUREMENT ExhMgT_ratDeltaLamDftlCptProtnGovr "D-part of exhaust temperature controller (Delta-Lambda), bench1" SWORD fak_sw_b8 1 100 -8.000000 0.00 FORMAT "%8.6" ECU_ADDRESS 0x600038AC /end MEASUREMENT
/begin MEASUREMENT ExhMgT_ratDeltaLamTGovrCptProtnB1 "Delta temperature for exhaust gas feedback control bench1" SWORD fak_sw_b8 1 100 -8.000000 7.999756 FORMAT "%8.6" ECU_ADDRESS 0x600038AA /end MEASUREMENT
/begin MEASUREMENT ExhMgT_rateffEngIdleNonCsersMax "minimum distance to error threshold (MAX-Errorpath) inside idle (during life cycle)" UBYTE rel_q0p78125 1 100 0.00 199.2 FORMAT "%5.1" ECU_ADDRESS 0x6000A05D /end MEASUREMENT
/begin MEASUREMENT ExhMgT_rateffEngIdleNonCsersMaxLoc "minimum distance to error threshold (MAX-Errorpath) inside idle (during life cycle)" UBYTE rel_q0p78125 1 100 0.00 199.2 FORMAT "%5.1" ECU_ADDRESS 0x600365CB /end MEASUREMENT
/begin MEASUREMENT ExhMgT_rateffEngPtlNonCsersMax "minimum distance to error threshold (MAX-Errorpath) outside idle (during life cycle)" UBYTE rel_q0p78125 1 100 0.00 199.2 FORMAT "%5.1" ECU_ADDRESS 0x6000A05C /end MEASUREMENT
/begin MEASUREMENT ExhMgT_rateffEngPtlNonCsersMaxLoc "minimum distance to error threshold (MAX-Errorpath) outside idle (during life cycle)" UBYTE rel_q0p78125 1 100 0.00 199.2 FORMAT "%5.1" ECU_ADDRESS 0x600365CA /end MEASUREMENT
/begin MEASUREMENT ExhMgT_ratEngLoadDmdOperMod "relative engine load for catalyst heating" UWORD rel_q0p0234 1 100 0.00 1535.977 FORMAT "%8.3" ECU_ADDRESS 0x600038FA /end MEASUREMENT
/begin MEASUREMENT ExhMgT_ratFuMSeln "Relative fuel mass" UWORD rel_uw_b3072 1 100 0.00 3071.953 FORMAT "%8.3" ECU_ADDRESS 0x600038F8 /end MEASUREMENT
/begin MEASUREMENT ExhMgT_ratLamAgKnkCtrl "enrichment by component protection because of current operation point and average ignition retarding by knock control" UWORD fak_uw_b16 1 100 0.00 1.000000 FORMAT "%8.6" ECU_ADDRESS 0x600038E8 /end MEASUREMENT
/begin MEASUREMENT ExhMgT_ratLamCptProtnIgn "Lambda for component protection because of incomplete combustion due to redarded ignition timing" UWORD fak_uw_b16 1 100 0.00 15.99976 FORMAT "%8.5" ECU_ADDRESS 0x600038E6 /end MEASUREMENT
/begin MEASUREMENT ExhMgT_ratLamFuFco "fuel cut off lambda for component protection" UWORD fak_uw_b16 1 100 0.00 15.99976 FORMAT "%8.5" ECU_ADDRESS 0x600048D0 /end MEASUREMENT
/begin MEASUREMENT ExhMgT_ratLamMinCptProtnB1 "minimum lambda for component protection bank 1" UWORD fak_uw_b16 1 100 0.00 15.99976 FORMAT "%8.5" ECU_ADDRESS 0x600038DA /end MEASUREMENT
/begin MEASUREMENT ExhMgT_ratLamPreIgnCtlCptProtn "korrigierte vorgesteuerte Lambda, das mit dem temperaturabhängigen Interpolationsfaktor angepasst wurde" UWORD fak_uw_b16 1 100 0.500000 2.000000 FORMAT "%8.6" ECU_ADDRESS 0x600048CE /end MEASUREMENT
/begin MEASUREMENT ExhMgT_RelsCptPrortnGovrTONV_I.outbit "time delay for release of exhaust temperature controler bench1 / return value" UBYTE B_TRUE 1 100 0.00 1.00000000000 BIT_MASK 0x1 FORMAT "%13.11" ECU_ADDRESS 0x6000389E /end MEASUREMENT
/begin MEASUREMENT ExhMgT_RelsCptPrortnGovrTONV_I.time "time delay for release of exhaust temperature controler bench1 / expired delay time" UBYTE t_q0p1 1 100 0.00 25.50 FORMAT "%5.2" ECU_ADDRESS 0x6000389F /end MEASUREMENT
/begin MEASUREMENT ExhMgT_stOperModStgCatWrm "engine operation state for catalyst heating because of a request for catalyst warming" UWORD OneToOne 1 100 0.00 65535.00 FORMAT "%8.2" ECU_ADDRESS 0x600038F6 /end MEASUREMENT
/begin MEASUREMENT ExhMgT_stStgCatHeatgEomMod1_M.idxDistbnXOld "map for stage of request operation mode for catalyst heating formode 1 (desired) / Old X-Axis-position-index of the Two-D Hystereses-Look-Up-Table (Uint16)" UBYTE OneToOne 1 100 0.00 255.0 FORMAT "%5.1" ECU_ADDRESS 0x700019B2 /end MEASUREMENT
/begin MEASUREMENT ExhMgT_stStgCatHeatgEomMod1_M.idxDistbnYOld "map for stage of request operation mode for catalyst heating formode 1 (desired) / Old Y-Axis-position-index of the Two-D Hystereses-Look-Up-Table (Uint16)" UBYTE OneToOne 1 100 0.00 255.0 FORMAT "%5.1" ECU_ADDRESS 0x700019B3 /end MEASUREMENT
/begin MEASUREMENT ExhMgT_stStgCatHeatgEomMod2_M.idxDistbnXOld "map for stage of request operation mode for catalyst heating formode 2 (desired) / Old X-Axis-position-index of the Two-D Hystereses-Look-Up-Table (Uint16)" UBYTE OneToOne 1 100 0.00 255.0 FORMAT "%5.1" ECU_ADDRESS 0x700019B0 /end MEASUREMENT
/begin MEASUREMENT ExhMgT_stStgCatHeatgEomMod2_M.idxDistbnYOld "map for stage of request operation mode for catalyst heating formode 2 (desired) / Old Y-Axis-position-index of the Two-D Hystereses-Look-Up-Table (Uint16)" UBYTE OneToOne 1 100 0.00 255.0 FORMAT "%5.1" ECU_ADDRESS 0x700019B1 /end MEASUREMENT
/begin MEASUREMENT ExhMgT_tCat1AvrgFildB1 "filtered average temperature catalyst 1 Bank1" SWORD temp_q0p1_o273 1 100 -3549.940 3003.560 FORMAT "%8.3" ECU_ADDRESS 0x60004AD6 /end MEASUREMENT
/begin MEASUREMENT ExhMgT_tCat1AvrgLocB1 "local average temperature catalyst 1 bank 1 for component protection" SWORD temp_q0p1_o273 1 100 -3549.940 3003.560 FORMAT "%8.3" ECU_ADDRESS 0x600038D2 /end MEASUREMENT
/begin MEASUREMENT ExhMgT_tCat1EndFildB1 "filtered temperature end of catalyst 1 Bank1" SWORD temp_q0p1_o273 1 100 -3549.940 3003.560 FORMAT "%8.3" ECU_ADDRESS 0x60004ACE /end MEASUREMENT
/begin MEASUREMENT ExhMgT_tCat1EndLocB1 "local variable for the temperature at the end of catalyst 1 bank 1 for fuel cut-off" SWORD temp_q0p1_o273 1 100 -3549.940 3003.560 FORMAT "%8.3" ECU_ADDRESS 0x600038D0 /end MEASUREMENT
/begin MEASUREMENT ExhMgT_tCat1FildB1 "filtered temperature of catalyst 1 Bank1" SWORD temp_q0p1_o273 1 100 -3549.940 3003.560 FORMAT "%8.3" ECU_ADDRESS 0x60004ACC /end MEASUREMENT
/begin MEASUREMENT ExhMgT_tCat1LocB1 "local variable for the temperature in the catalyst 1 bank 1 for fuel cut-off" SWORD temp_q0p1_o273 1 100 -3549.940 3003.560 FORMAT "%8.3" ECU_ADDRESS 0x600038CE /end MEASUREMENT
/begin MEASUREMENT ExhMgT_tCat1MaxFildB1 "filtered maximum temperature catalyst 1" SWORD temp_q0p1_o273 1 100 -3549.940 3003.560 FORMAT "%8.3" ECU_ADDRESS 0x60004AC6 /end MEASUREMENT
/begin MEASUREMENT ExhMgT_tCat1MaxLocB1 "local variable for the maximal temperature in the catalyst 1 bank 1 for fuel cut-off" SWORD temp_q0p1_o273 1 100 -3549.940 3003.560 FORMAT "%8.3" ECU_ADDRESS 0x600038CC /end MEASUREMENT
/begin MEASUREMENT ExhMgT_tCat1MinFildB1 "filtered minimum temperature of catalyst 1 B1" SWORD temp_q0p1_o273 1 100 -3549.940 3003.560 FORMAT "%8.3" ECU_ADDRESS 0x60004AC4 /end MEASUREMENT
/begin MEASUREMENT ExhMgT_tCat1MinLocB1 "local variable for the minimal temperature in the catalyst 1 bank 1 for fuel cut-off" SWORD temp_q0p1_o273 1 100 -3549.940 3003.560 FORMAT "%8.3" ECU_ADDRESS 0x600038CA /end MEASUREMENT
/begin MEASUREMENT ExhMgT_tCat2AvrgFildB1 "filtered average temperature catalyst 2 Bank1" SWORD temp_q0p1_o273 1 100 -3549.940 3003.560 FORMAT "%8.3" ECU_ADDRESS 0x60004ABA /end MEASUREMENT
/begin MEASUREMENT ExhMgT_tCat2AvrgLocB1 "local average temperature catalyst 2 bank 1 for component protection" SWORD temp_q0p1_o273 1 100 -3549.940 3003.560 FORMAT "%8.3" ECU_ADDRESS 0x600038C8 /end MEASUREMENT
/begin MEASUREMENT ExhMgT_tCat2EndFildB1 "filtered temperature end of catalyst 2 Bank1" SWORD temp_q0p1_o273 1 100 -3549.940 3003.560 FORMAT "%8.3" ECU_ADDRESS 0x60004AB6 /end MEASUREMENT
/begin MEASUREMENT ExhMgT_tCat2EndLocB1 "local variable for the temperature at the end of catalyst 2 bank 1 for fuel cut-off" SWORD temp_q0p1_o273 1 100 -3549.940 3003.560 FORMAT "%8.3" ECU_ADDRESS 0x600038C6 /end MEASUREMENT
/begin MEASUREMENT ExhMgT_tCat2FildB1 "filtered temperature of catalyst 2 Bank1" SWORD temp_q0p1_o273 1 100 -3549.940 3003.560 FORMAT "%8.3" ECU_ADDRESS 0x60004AB4 /end MEASUREMENT
/begin MEASUREMENT ExhMgT_tCat2LocB1 "local variable for the temperature in the catalyst 2 bank 1 for fuel cut-off" SWORD temp_q0p1_o273 1 100 -3549.940 3003.560 FORMAT "%8.3" ECU_ADDRESS 0x600038C4 /end MEASUREMENT
/begin MEASUREMENT ExhMgT_tCat2MaxFildB1 "filtered maximum temperature catalyst 2" SWORD temp_q0p1_o273 1 100 -3549.940 3003.560 FORMAT "%8.3" ECU_ADDRESS 0x60004AB2 /end MEASUREMENT
/begin MEASUREMENT ExhMgT_tCat2MaxLocB1 "local variable for the maximal temperature in the catalyst 2 bank 1 for fuel cut-off" SWORD temp_q0p1_o273 1 100 -3549.940 3003.560 FORMAT "%8.3" ECU_ADDRESS 0x600038C2 /end MEASUREMENT
/begin MEASUREMENT ExhMgT_tCat2MinFildB1 "filtered minimum temperature of catalyst 2 Bank1" SWORD temp_q0p1_o273 1 100 -3549.940 3003.560 FORMAT "%8.3" ECU_ADDRESS 0x60004AB0 /end MEASUREMENT
/begin MEASUREMENT ExhMgT_tCat2MinLocB1 "local variable for the minimal temperature in the catalyst 2 bank 1 for fuel cut-off" SWORD temp_q0p1_o273 1 100 -3549.940 3003.560 FORMAT "%8.3" ECU_ADDRESS 0x600038C0 /end MEASUREMENT
/begin MEASUREMENT ExhMgT_tCatCritFild "critical temperature inside of cataylst for protection of mat between catalyst and catalyst body (filtered)" SWORD Temp_Cels 1 100 -3549.940 3003.560 FORMAT "%8.3" ECU_ADDRESS 0x600038A8 /end MEASUREMENT
/begin MEASUREMENT ExhMgT_tCatCritLT_I.memory "LowpassT / current lowpass value" SLONG temp_q1p5259Em6_om273 1 100 -3549.94000000 3003.65999847 FORMAT "%13.8" ECU_ADDRESS 0x60001428 /end MEASUREMENT
/begin MEASUREMENT ExhMgT_tCatCritUnfild "critical temperature inside of cataylst for protection of mat between catalyst and catalyst body (unfiltered)" SWORD Temp_Cels 1 100 -3549.940 3003.560 FORMAT "%8.3" ECU_ADDRESS 0x600038A6 /end MEASUREMENT
/begin MEASUREMENT ExhMgT_tDiffCatCritB1 "temperature difference between critical temperature inside of cataylst for protection of mat between catalyst and catalyst body and modelled wall temperature (bank1)" SWORD temp_q0p1_K 1 100 -3276.800 3276.700 FORMAT "%8.3" ECU_ADDRESS 0x600038A4 /end MEASUREMENT
/begin MEASUREMENT ExhMgT_tEngCatHeatgOperMod "engine temperature for catalyst heating operation mode" SWORD Temp_Cels 1 100 -3549.940 3003.560 FORMAT "%8.3" ECU_ADDRESS 0x600038F4 /end MEASUREMENT
/begin MEASUREMENT ExhMgT_tEngDiagIaCatHeatg "engine temperature" SWORD Temp_Cels 1 100 -3549.940 3003.560 FORMAT "%8.3" ECU_ADDRESS 0x6000390C /end MEASUREMENT
/begin MEASUREMENT ExhMgT_tEngStrtDmdOperMod "temperature of the cooling water or the cylinder head by start of catalyst heating" SWORD Temp_Cels 1 100 -3549.940 3003.560 FORMAT "%8.3" ECU_ADDRESS 0x600038F2 /end MEASUREMENT
/begin MEASUREMENT ExhMgT_tExhDsVlvFildB1 "filtered exhaust gas temperature downstream exhaust valve, modelled, bank 1" SWORD temp_q0p1_o273 1 100 -3549.940 3003.560 FORMAT "%8.3" ECU_ADDRESS 0x60004A96 /end MEASUREMENT
/begin MEASUREMENT ExhMgT_tExhMnfB1Prev "exhaustgas temperature manifold from the previous time grid, bank 1" SWORD temp_q0p1_o273 1 100 -3549.940 3003.560 FORMAT "%8.3" ECU_ADDRESS 0x6000389C /end MEASUREMENT
/begin MEASUREMENT ExhMgT_tExhMnfFildB1 "filtered exhaust gas temperature manifold, bank 1" SWORD temp_q0p1_o273 1 100 -3549.940 3003.560 FORMAT "%8.3" ECU_ADDRESS 0x60004A92 /end MEASUREMENT
/begin MEASUREMENT ExhMgT_tExhMnfFildB1Prev "filtered exhaust gas temperature manifold from the previous time grid, bank 1" SWORD temp_q0p1_o273 1 100 -3549.940 3003.560 FORMAT "%8.3" ECU_ADDRESS 0x60004A90 /end MEASUREMENT
/begin MEASUREMENT ExhMgT_tExhMnfFildGrdtB1 "filtered exhaust gas temperature gradient manifold, bank 1" SWORD temp_q0p1_K 1 100 -3276.800 3276.700 FORMAT "%8.3" ECU_ADDRESS 0x60004A8E /end MEASUREMENT
/begin MEASUREMENT ExhMgT_tiHeatgIdleNonCsers "current time for catalyst heating during cold start during idle" UWORD t_q0p1 1 100 0.00 6553.500 FORMAT "%8.3" ECU_ADDRESS 0x6000390A /end MEASUREMENT
/begin MEASUREMENT ExhMgT_tiHeatgPtlNonCsers "current time for catalyst heating during cold start outside idle" UWORD t_q0p1 1 100 0.00 6553.500 FORMAT "%8.3" ECU_ADDRESS 0x60003908 /end MEASUREMENT
/begin MEASUREMENT ExhMgT_tiTFltExhMnf "filter time for exhaustgas temperature manifold, Bank 1" UWORD t_q0p05 1 100 0.050 3276.750 FORMAT "%8.3" ECU_ADDRESS 0x6000389A /end MEASUREMENT
/begin MEASUREMENT ExhMgT_tMinCat1FcoB1 "minmal delta exhaust temperature for 1.catalyst for release of cut off and for cylinder-individual fuel cut-off ( bench1)" SWORD temp_q0p1_K 1 100 -3276.800 3276.700 FORMAT "%8.3" ECU_ADDRESS 0x600038BE /end MEASUREMENT
/begin MEASUREMENT ExhMgT_tMinCat1FcoCoolgB1 "minimum delta exhaust temperature of the first catalyst for the release of the overrun fuel cut (preventing cooling down)" SWORD temp_q0p1_K 1 100 -3276.800 3276.700 FORMAT "%8.3" ECU_ADDRESS 0x600038BC /end MEASUREMENT
/begin MEASUREMENT ExhMgT_tMinCat2FcoB1 "minmal delta exhaust temperature for 2.catalyst for release of cut off and for cylinder-individual fuel cut-off ( bench1)" SWORD temp_q0p1_K 1 100 -3276.800 3276.700 FORMAT "%8.3" ECU_ADDRESS 0x600038BA /end MEASUREMENT
/begin MEASUREMENT ExhMgT_tMinCat2FcoCoolgB1 "minimum delta exhaust gas temperature of the second catalyst for the release of the overrun fuel cut (preventing cooling down)" SWORD temp_q0p1_K 1 100 -3276.800 3276.700 FORMAT "%8.3" ECU_ADDRESS 0x600038B8 /end MEASUREMENT
/begin MEASUREMENT ExhMgT_tMinCatFco "minmal delta exhaust temperature for all .catalysts for release of cut off and for cylinder-individual fuel cut-off ( bench1)" SWORD temp_q0p1_K 1 100 -3276.800 3276.700 FORMAT "%8.3" ECU_ADDRESS 0x600038B6 /end MEASUREMENT
/begin MEASUREMENT ExhMgT_tMinCatFcoCoolg "minimum delta exhaust temperature of all catalysts for the release of the fuel cut-off (preventing cooling down)" SWORD temp_q0p1_K 1 100 -3276.800 3276.700 FORMAT "%8.3" ECU_ADDRESS 0x600038B4 /end MEASUREMENT
/begin MEASUREMENT ExhMgT_tMinGrdtTExhGovrB1 "Temperature gradient of the smallest minimum exhaust gas temperature (distance from the critical components temperatures), bench1" SWORD temp_q0p1_K 1 100 -3276.800 3276.700 FORMAT "%8.3" ECU_ADDRESS 0x600038A2 /end MEASUREMENT
/begin MEASUREMENT ExhMgT_tMinTExhGovrCptProtn "minimum distance of exhaust temperature from critical temperatures of components of all controllers, bench 1" SWORD temp_q0p1_K 1 100 -3276.800 3276.700 FORMAT "%8.3" ECU_ADDRESS 0x60004A7E /end MEASUREMENT
/begin MEASUREMENT ExhMgT_tMinTExhGovrCptProtnB1 "minimum distance of exhaust temperature from critical temperatures of components, bench 1" SWORD temp_q0p1_K 1 100 -3276.800 3276.700 FORMAT "%8.3" ECU_ADDRESS 0x60004A7C /end MEASUREMENT
/begin MEASUREMENT ExhMgT_tMinTExhGovrCptProtnB1old "minimum distance of exhaust temperature from critical temperatures of components, bench 1 (old value)" SWORD temp_q0p1_K 1 100 -3276.800 3276.700 FORMAT "%8.3" ECU_ADDRESS 0x600038A0 /end MEASUREMENT
/begin MEASUREMENT ExhMgT_WrmSustReq_I.stOperMod "connection of catalyst heating because of a request for catalyst warming with lambda split at operation mode coordinator / Priority-element of the operation mode structure" ULONG OneToOne 1 100 0.00 4294967295.00 FORMAT "%13.2" ECU_ADDRESS 0x700019B4 /end MEASUREMENT
/begin MEASUREMENT ExhMgT_WrmSustReq_I.stOperModPrio "connection of catalyst heating because of a request for catalyst warming with lambda split at operation mode coordinator / Stage-element of the operation mode structure" UBYTE OneToOne 1 100 0.00 255.0 FORMAT "%5.1" ECU_ADDRESS 0x700019B8 /end MEASUREMENT
/begin MEASUREMENT ExhMgT_WrmSustReq_I.stOperModStg "connection of catalyst heating because of a request for catalyst warming with lambda split at operation mode coordinator / Operation-mode element of the operation mode structure" UWORD OneToOne 1 100 0.00 65535.00 FORMAT "%8.2" ECU_ADDRESS 0x700019BA /end MEASUREMENT
/begin MEASUREMENT ExhMod_cntrCldStrtAryB1 "array of cold start counter for sensors in bank1" UBYTE dez 1 100 0.00 255.0 FORMAT "%5.1" ARRAY_SIZE 2 ECU_ADDRESS 0x6000A059 /end MEASUREMENT
/begin MEASUREMENT ExhMod_cntrCldStrtS1B1 "counter for repeated cold starts dew-point end not reached sensor 1" UBYTE dez 1 100 0.00 255.0 FORMAT "%5.1" ECU_ADDRESS 0x6000A058 /end MEASUREMENT
/begin MEASUREMENT ExhMod_cntrCldStrtS2B1 "counter for repeated cold starts dew-point end not reached sensor 2" UBYTE dez 1 100 0.00 255.0 FORMAT "%5.1" ECU_ADDRESS 0x6000A057 /end MEASUREMENT
/begin MEASUREMENT ExhMod_dmO2Cat1B1 "Oxygen mass flow in catalyst 1" SWORD m_q0p1_mgs 1 100 -3276.800 3276.700 FORMAT "%8.3" ECU_ADDRESS 0x6000E21C /end MEASUREMENT
/begin MEASUREMENT ExhMod_dmO2Cat2B1 "Oxygen mass flow in catalyst 2" SWORD m_q0p1_mgs 1 100 -3276.800 3276.700 FORMAT "%8.3" ECU_ADDRESS 0x70002C4C /end MEASUREMENT
/begin MEASUREMENT ExhMod_egyDewPntEndS1B1 "heat quantity for dew-point end detection sensor 1" SWORD q_q1_kJ 1 100 -32768.00 32767.00 FORMAT "%8.2" ECU_ADDRESS 0x60004A6E /end MEASUREMENT
/begin MEASUREMENT ExhMod_egyDewPntEndS2B1 "heat quantity for dew-point end detection sensor 2" SWORD q_q1_kJ 1 100 -32768.00 32767.00 FORMAT "%8.2" ECU_ADDRESS 0x60004A6C /end MEASUREMENT
/begin MEASUREMENT ExhMod_egyThdDewPntEndS1B1 "heat quantity threshold for dew-point end detection sensor 1" SWORD q_q1_kJ 1 100 -32768.00 32767.00 FORMAT "%8.2" ECU_ADDRESS 0x60004A6A /end MEASUREMENT
/begin MEASUREMENT ExhMod_egyThdDewPntEndS2B1 "heat quantity threshold for dew-point end detection sensor 2" SWORD q_q1_kJ 1 100 -32768.00 32767.00 FORMAT "%8.2" ECU_ADDRESS 0x60004A68 /end MEASUREMENT
/begin MEASUREMENT ExhMod_flgCfgPlausB1 "bit configuration exhaust system plausibel bank 1" UBYTE B_TRUE 1 100 0.00 1.00000000000 BIT_MASK 0x1 FORMAT "%13.11" ECU_ADDRESS 0x70000221 /end MEASUREMENT
/begin MEASUREMENT ExhMod_flgDewPntEndLstNvS1B1 "flag dew-point end sensor 1 (last trip) NV" UBYTE B_TRUE 1 100 0.00 1.00000000000 BIT_MASK 0x1 FORMAT "%13.11" ECU_ADDRESS 0x60034988 /end MEASUREMENT
/begin MEASUREMENT ExhMod_flgDewPntEndLstS1B1 "flag dew-point end sensor 1 (last trip)" UBYTE B_TRUE 1 100 0.00 1.00000000000 BIT_MASK 0x1 FORMAT "%13.11" ECU_ADDRESS 0x700007BF /end MEASUREMENT
/begin MEASUREMENT ExhMod_flgDewPntEndLstS2B1 "flag dew-point end sensor 2 (last trip)" UBYTE B_TRUE 1 100 0.00 1.00000000000 BIT_MASK 0x1 FORMAT "%13.11" ECU_ADDRESS 0x700007BE /end MEASUREMENT
/begin MEASUREMENT ExhMod_flgDewPntEndS1B1 "flag dew point end sensor 1" UBYTE B_TRUE 1 100 0.00 1.00000000000 BIT_MASK 0x1 FORMAT "%13.11" ECU_ADDRESS 0x700007BC /end MEASUREMENT
/begin MEASUREMENT ExhMod_flgDewPntEndS1B1Sig "flag dew point end sensor 1" UBYTE B_TRUE 1 100 0.00 1.00000000000 BIT_MASK 0x1 FORMAT "%13.11" ECU_ADDRESS 0x60009F9F /end MEASUREMENT
/begin MEASUREMENT ExhMod_flgDewPntEndS2B1 "flag dew point end sensor 2" UBYTE B_TRUE 1 100 0.00 1.00000000000 BIT_MASK 0x1 FORMAT "%13.11" ECU_ADDRESS 0x700007BB /end MEASUREMENT
/begin MEASUREMENT ExhMod_flgDewPntEndS2B1Sig "flag dew point end sensor 2" UBYTE B_TRUE 1 100 0.00 1.00000000000 BIT_MASK 0x1 FORMAT "%13.11" ECU_ADDRESS 0x60009F9E /end MEASUREMENT
/begin MEASUREMENT ExhMod_flgEmptyCat1B1 "flag no oxygen stored in catalyst 1" UBYTE B_TRUE 1 100 0.00 1.00000000000 BIT_MASK 0x1 FORMAT "%13.11" ECU_ADDRESS 0x700007BA /end MEASUREMENT
/begin MEASUREMENT ExhMod_flgEmptyCat2B1 "flag no oxygen stored in catalyst 2" UBYTE B_TRUE 1 100 0.00 1.00000000000 BIT_MASK 0x1 FORMAT "%13.11" ECU_ADDRESS 0x700007B9 /end MEASUREMENT
/begin MEASUREMENT ExhMod_flgFullCat1B1 "flag catalyst 1 full of oxygen" UBYTE B_TRUE 1 100 0.00 1.00000000000 BIT_MASK 0x1 FORMAT "%13.11" ECU_ADDRESS 0x700007B6 /end MEASUREMENT
/begin MEASUREMENT ExhMod_flgFullCat2B1 "flag catalyst 2 full of oxygen" UBYTE B_TRUE 1 100 0.00 1.00000000000 BIT_MASK 0x1 FORMAT "%13.11" ECU_ADDRESS 0x700007B5 /end MEASUREMENT
/begin MEASUREMENT ExhMod_flgLSEmptyCat1B1 "Flag lambda sensor indicates that catalyst 1 is empty of oxygen" UBYTE B_TRUE 1 100 0.00 1.00000000000 BIT_MASK 0x1 FORMAT "%13.11" ECU_ADDRESS 0x700007AE /end MEASUREMENT
/begin MEASUREMENT ExhMod_flgLSFullCat1B1 "Flag lambda sensor indicates that catalyst 1 is full of oxygen" UBYTE B_TRUE 1 100 0.00 1.00000000000 BIT_MASK 0x1 FORMAT "%13.11" ECU_ADDRESS 0x700007AC /end MEASUREMENT
/begin MEASUREMENT ExhMod_flgLSNplCat1B1 "Flag oxygen sensor voltage downstream of catalyst 1 not plausible" UBYTE B_TRUE 1 100 0.00 1.00000000000 BIT_MASK 0x1 FORMAT "%13.11" ECU_ADDRESS 0x700007AB /end MEASUREMENT
/begin MEASUREMENT ExhMod_flgLSNplEmptyCat1B1 "Flag sensor downstream catalyst 1 not plausible when catalyst empty of oxygen" UBYTE B_TRUE 1 100 0.00 1.00000000000 BIT_MASK 0x1 FORMAT "%13.11" ECU_ADDRESS 0x700007AA /end MEASUREMENT
/begin MEASUREMENT ExhMod_flgLSNplFullCat1B1 "Flag sensor downstream catalyst 1 not plausible when catalyst full of oxygen" UBYTE B_TRUE 1 100 0.00 1.00000000000 BIT_MASK 0x1 FORMAT "%13.11" ECU_ADDRESS 0x700007A9 /end MEASUREMENT
/begin MEASUREMENT ExhMod_flgTSnsrStrtCalcdB1 "Flag sensor start temperatures in dew point end calculated" UBYTE B_TRUE 1 100 0.00 1.00000000000 BIT_MASK 0x1 FORMAT "%13.11" ECU_ADDRESS 0x700007A4 /end MEASUREMENT
/begin MEASUREMENT ExhMod_idxFirstBrickCat1B1 "index first brick catalyst 1" UBYTE dez 1 100 0.00 255.0 FORMAT "%5.1" ECU_ADDRESS 0x6000A055 /end MEASUREMENT
/begin MEASUREMENT ExhMod_idxFirstBrickCat2B1 "index first brick catalyst 2" UBYTE dez 1 100 0.00 255.0 FORMAT "%5.1" ECU_ADDRESS 0x6000A054 /end MEASUREMENT
/begin MEASUREMENT ExhMod_idxFrtBrickCatAryB1 "index first brick catalysts" UBYTE dez 1 100 0.00 255.0 FORMAT "%5.1" ARRAY_SIZE 2 ECU_ADDRESS 0x6000A052 /end MEASUREMENT
/begin MEASUREMENT ExhMod_idxLstBrickCatAryB1 "index last brick catalysts" UBYTE dez 1 100 0.00 255.0 FORMAT "%5.1" ARRAY_SIZE 2 ECU_ADDRESS 0x6000A050 /end MEASUREMENT
/begin MEASUREMENT ExhMod_mAirMfIntegEngFirstStrt "integrated air mass flow from engine first start to max. value" UWORD m_uw_b23p3 1 100 0.00 23.30133 FORMAT "%8.5" ECU_ADDRESS 0x600048C8 /end MEASUREMENT
/begin MEASUREMENT ExhMod_mAirMfIntegEngStrt "integrated air mass flow from engine start to max. value" UWORD m_uw_b23p3 1 100 0.00 23.30133 FORMAT "%8.5" ECU_ADDRESS 0x600048C6 /end MEASUREMENT
/begin MEASUREMENT ExhMod_mAirMfIntegEngStrtCalReini "integrated air mass flow from engine start to maximum value with a calibratable reinitialization" UWORD m_uw_b23p3 1 100 0.00 23.30133 FORMAT "%8.5" ECU_ADDRESS 0x600048C4 /end MEASUREMENT
/begin MEASUREMENT ExhMod_mAirMfIntegEngStrtCalReiniNv "Non volatile value of integrated air mass flow from engine start to maximum value" UWORD m_uw_b23p3 1 100 0.00 23.30133 FORMAT "%8.5" ECU_ADDRESS 0x600365C8 /end MEASUREMENT
/begin MEASUREMENT ExhMod_mfO2Cat1B1 "oxygen mass flow in catalyst 1, bank 1" FLOAT32_IEEE mgrad_q1_mgdivs 1 100 0.00 100000.000 FORMAT "%10.3" ECU_ADDRESS 0x60001D74 /end MEASUREMENT
/begin MEASUREMENT ExhMod_mfO2Cat2B1 "oxygen mass flow in catalyst 2, bank 1" FLOAT32_IEEE mgrad_q1_mgdivs 1 100 0.00 100000.000 FORMAT "%10.3" ECU_ADDRESS 0x70002B34 /end MEASUREMENT
/begin MEASUREMENT ExhMod_mO2Cat1B1 "oxygen storage level in catalyst 1" UWORD m_q0p1_mg 1 100 0.00 6553.500 FORMAT "%8.3" ECU_ADDRESS 0x70002C4E /end MEASUREMENT
/begin MEASUREMENT ExhMod_mO2Cat2B1 "oxygen storage level in catalyst 2" UWORD m_q0p1_mg 1 100 0.00 6553.500 FORMAT "%8.3" ECU_ADDRESS 0x60004CE2 /end MEASUREMENT
/begin MEASUREMENT ExhMod_mO2ExtdCat1B1 "oxygen storage level in catalyst 1" ULONG m_q0p1_mg 1 100 0.00 429496729.500 FORMAT "%13.3" ECU_ADDRESS 0x70002B2C /end MEASUREMENT
/begin MEASUREMENT ExhMod_mO2ExtdCat2B1 "oxygen storage level in catalyst 2" ULONG m_q0p1_mg 1 100 0.00 429496729.500 FORMAT "%13.3" ECU_ADDRESS 0x70002B30 /end MEASUREMENT
/begin MEASUREMENT ExhMod_nrBrickCat1B1 "number of bricks catalyst 1" UBYTE dez 1 100 0.00 255.0 FORMAT "%5.1" ECU_ADDRESS 0x6000A04F /end MEASUREMENT
/begin MEASUREMENT ExhMod_nrBrickCat2B1 "number of bricks catalyst 2" UBYTE dez 1 100 0.00 255.0 FORMAT "%5.1" ECU_ADDRESS 0x6000A04E /end MEASUREMENT
/begin MEASUREMENT ExhMod_nrBrickCatAryB1 "number of bricks catalysts" UBYTE dez 1 100 0.00 255.0 FORMAT "%5.1" ARRAY_SIZE 2 ECU_ADDRESS 0x6000A04C /end MEASUREMENT
/begin MEASUREMENT ExhMod_ratConcO2Cat1B1 "oxygen concentration of gas going into catalyst 1" SWORD fak_sw_b8 1 100 -8.000000 7.999756 FORMAT "%8.6" ECU_ADDRESS 0x6000E232 /end MEASUREMENT
/begin MEASUREMENT ExhMod_ratConcO2Cat2B1 "oxygen concentration of gas going into catalyst 2" SWORD fak_sw_b8 1 100 -8.000000 7.999756 FORMAT "%8.6" ECU_ADDRESS 0x70002C52 /end MEASUREMENT
/begin MEASUREMENT ExhMod_rLamCat1DsB1 "exhaust lambda catalyst 1 downstream" UWORD fak_uw_b16 1 100 0.00 15.99976 FORMAT "%8.5" ECU_ADDRESS 0x60004CDE /end MEASUREMENT
/begin MEASUREMENT ExhMod_rLamCat1UsB1 "exhaust lambda catalyst 1 upstream" UWORD fak_uw_b16 1 100 0.00 15.99976 FORMAT "%8.5" ECU_ADDRESS 0x60004CDC /end MEASUREMENT
/begin MEASUREMENT ExhMod_rLamCat2DsB1 "exhaust lambda catalyst 2 downstream" UWORD fak_uw_b16 1 100 0.00 15.99976 FORMAT "%8.5" ECU_ADDRESS 0x6000E230 /end MEASUREMENT
/begin MEASUREMENT ExhMod_rLamCat2DsSB1 "exhaust lambda at sensor downstream catalyst 2" UWORD fak_uw_b16 1 100 0.00 15.99976 FORMAT "%8.5" ECU_ADDRESS 0x70002C50 /end MEASUREMENT
/begin MEASUREMENT ExhMod_rLamCat2UsB1 "exhaust lambda catalyst 2 upstream" UWORD fak_uw_b16 1 100 0.00 15.99976 FORMAT "%8.5" ECU_ADDRESS 0x60004CDA /end MEASUREMENT
/begin MEASUREMENT ExhMod_rLamCatUsAryB1 "Exhaust lambda upstream catalysts" UWORD fak_uw_b16 1 100 0.00 15.99976 FORMAT "%8.5" ARRAY_SIZE 2 ECU_ADDRESS 0x60004CD6 /end MEASUREMENT
/begin MEASUREMENT ExhMod_rLamLS1B1 "Lambda value first sensor bank 1" UWORD fak_uw_b16 1 100 0.00 15.99976 FORMAT "%8.5" ECU_ADDRESS 0x60004CD4 /end MEASUREMENT
/begin MEASUREMENT ExhMod_stCfgPlausB1 "state configuration pausible bank 1" UWORD dez 1 100 0.00 65535.00 FORMAT "%8.2" ECU_ADDRESS 0x60003898 /end MEASUREMENT
/begin MEASUREMENT ExhMod_tEngStrtDewDet "engine temperature at start for dew point end calculation" SWORD Temp_Cels 1 100 -3549.940 3003.560 FORMAT "%8.3" ECU_ADDRESS 0x60004A40 /end MEASUREMENT
/begin MEASUREMENT ExhMod_tEnvDewDet "Ambient temperature for dew point end with influences like block heater" SWORD Temp_Cels 1 100 -3549.940 3003.560 FORMAT "%8.3" ECU_ADDRESS 0x60004A3E /end MEASUREMENT
/begin MEASUREMENT ExhMod_tExhStrtS1B1 "temperature at sensor 1 at engine start" SWORD Temp_Cels 1 100 -3549.940 3003.560 FORMAT "%8.3" ECU_ADDRESS 0x60004A1C /end MEASUREMENT
/begin MEASUREMENT ExhMod_tExhStrtS2B1 "temperature at sensor 2 at engine start" SWORD Temp_Cels 1 100 -3549.940 3003.560 FORMAT "%8.3" ECU_ADDRESS 0x60004A1A /end MEASUREMENT
/begin MEASUREMENT ExhMod_tiBtwLS1Cat1B1 "Exhaust gas transport time from lambda sensor 1 to catalyst 1" UWORD t_q0p01 1 100 0.00 655.3500 FORMAT "%8.4" ECU_ADDRESS 0x60004CC6 /end MEASUREMENT
/begin MEASUREMENT ExhMod_tiBtwLS1Cat2B1 "Exhaust gas transport time from lambda sensor 1 to catalyst 2" UWORD t_q0p01 1 100 0.00 655.3500 FORMAT "%8.4" ECU_ADDRESS 0x70002C54 /end MEASUREMENT
/begin MEASUREMENT frlmxbts_w_msg "reduction factor for maximum air charge if component protection reaches rich or lean burning limit" UWORD fak_uw_b2 1 100 0.00 1.999969 FORMAT "%8.6" ECU_ADDRESS 0x6000E30C /end MEASUREMENT
/begin MEASUREMENT idetakhl_w "integration of differenz between actuell ignition effciency and desired catalyst heating ignition efficiency during idle" SWORD fak_q0p03125 1 100 -1024.000 1023.969 FORMAT "%8.3" ECU_ADDRESS 0x60003906 /end MEASUREMENT
/begin MEASUREMENT idetakht_w "integration of differenz between actuell ignition effciency and desired catalyst heating ignition efficiency outside idle" SWORD fak_q0p03125 1 100 -1024.000 1023.969 FORMAT "%8.3" ECU_ADDRESS 0x60003904 /end MEASUREMENT
/begin MEASUREMENT lambs_w_msg "lambda for component protection (precontrol)" UWORD fak_uw_b16 1 100 0.00 15.99976 FORMAT "%8.5" ECU_ADDRESS 0x60004824 /end MEASUREMENT
/begin MEASUREMENT lambts_w_msg "lambda for component protection" UWORD fak_uw_b16 1 100 0.00 15.99976 FORMAT "%8.5" ECU_ADDRESS 0x60004BFC /end MEASUREMENT
/begin MEASUREMENT Lam_flgRstO2IntgCat1B1 "flag reset oxygen integrator catalyst 1" UBYTE B_TRUE 1 100 0.00 1.00000000000 BIT_MASK 0x1 FORMAT "%13.11" ECU_ADDRESS 0x70000217 /end MEASUREMENT
/begin MEASUREMENT Lam_flgRstO2IntgCat2B1 "flag reset oxygen integrator catalyst 2" UBYTE B_TRUE 1 100 0.00 1.00000000000 BIT_MASK 0x1 FORMAT "%13.11" ECU_ADDRESS 0x70000216 /end MEASUREMENT
/begin MEASUREMENT Lam_mO2RstValCat1B1 "Reset value of the oxygen integral of catalyst 1" ULONG m_q0p1_mg 1 100 0.00 429496729.500 FORMAT "%13.3" ECU_ADDRESS 0x70002A74 /end MEASUREMENT
/begin MEASUREMENT Lam_mO2RstValCat2B1 "Reset value of the oxygen integral of catalyst 2" ULONG m_q0p1_mg 1 100 0.00 429496729.500 FORMAT "%13.3" ECU_ADDRESS 0x70002A78 /end MEASUREMENT
/begin MEASUREMENT Lam_O2IntglExtdCat1B1_I.mfO2 "RB internal / Oxygen massflow" FLOAT32_IEEE mgrad_q1_mgdivs 1 100 -1.00000000E+037 1.00000000E+037 FORMAT "%13.3" ECU_ADDRESS 0x6000CDC4 /end MEASUREMENT
/begin MEASUREMENT Lam_O2IntglExtdCat1B1_I.ratConcO2 "RB internal / Oxygen concentratoin" SWORD fak_q0p000244 1 100 -8.000000 7.999756 FORMAT "%8.6" ECU_ADDRESS 0x6000CDC8 /end MEASUREMENT
/begin MEASUREMENT Lam_O2IntglExtdCat1B1_I.O2IKL_I.memory "RB internal / Integraotr Sauerstoffmassflow / Current Integrator value" FLOAT32_IEEE dez 1 100 -1.00000000E+037 1.00000000E+037 FORMAT "%13.3" ECU_ADDRESS 0x6000CDCC /end MEASUREMENT
/begin MEASUREMENT Lam_O2IntglExtdCat2B1_I.mfO2 "RB internal / Oxygen massflow" FLOAT32_IEEE mgrad_q1_mgdivs 1 100 -1.00000000E+037 1.00000000E+037 FORMAT "%13.3" ECU_ADDRESS 0x6000CDD0 /end MEASUREMENT
/begin MEASUREMENT Lam_O2IntglExtdCat2B1_I.ratConcO2 "RB internal / Oxygen concentratoin" SWORD fak_q0p000244 1 100 -8.000000 7.999756 FORMAT "%8.6" ECU_ADDRESS 0x6000CDD4 /end MEASUREMENT
/begin MEASUREMENT Lam_O2IntglExtdCat2B1_I.O2IKL_I.memory "RB internal / Integraotr Sauerstoffmassflow / Current Integrator value" FLOAT32_IEEE dez 1 100 -1.00000000E+037 1.00000000E+037 FORMAT "%13.3" ECU_ADDRESS 0x6000CDD8 /end MEASUREMENT
/begin MEASUREMENT Lam_PlausChkLSCat1B1_I.CatEmptyFF_I.status "RB internal / FlipFlop for catalyst empty / current value of RS-FF" UBYTE B_TRUE 1 100 0.00 1.00000000000 BIT_MASK 0x1 FORMAT "%13.11" ECU_ADDRESS 0x6000CDDC /end MEASUREMENT
/begin MEASUREMENT Lam_PlausChkLSCat1B1_I.CatFullFF_I.status "RB internal / FlipFlop for catalyst full / current value of RS-FF" UBYTE B_TRUE 1 100 0.00 1.00000000000 BIT_MASK 0x1 FORMAT "%13.11" ECU_ADDRESS 0x6000CDDD /end MEASUREMENT
/begin MEASUREMENT Lam_PlausChkLSCat1B1_I.NotLeanTONV_I.outbit "RB internal / TurnOnDelayVariable / return value" UBYTE B_TRUE 1 100 0.00 1.00000000000 BIT_MASK 0x1 FORMAT "%13.11" ECU_ADDRESS 0x6000CDDE /end MEASUREMENT
/begin MEASUREMENT Lam_PlausChkLSCat1B1_I.NotLeanTONV_I.time "RB internal / TurnOnDelayVariable / expired delay time" UWORD t_q0p01 1 100 0.00 655.3500 FORMAT "%8.4" ECU_ADDRESS 0x6000CDE0 /end MEASUREMENT
/begin MEASUREMENT Lam_PlausChkLSCat1B1_I.NotRichTONV_I.outbit "RB internal / TurnOnDelayVariable / return value" UBYTE B_TRUE 1 100 0.00 1.00000000000 BIT_MASK 0x1 FORMAT "%13.11" ECU_ADDRESS 0x6000CDE2 /end MEASUREMENT
/begin MEASUREMENT Lam_PlausChkLSCat1B1_I.NotRichTONV_I.time "RB internal / TurnOnDelayVariable / expired delay time" UWORD t_q0p01 1 100 0.00 655.3500 FORMAT "%8.4" ECU_ADDRESS 0x6000CDE4 /end MEASUREMENT
/begin MEASUREMENT Lam_PlausChkLSCat1B1_I.oxplIK_I.memory "RB internal / IntegratorK / current integrator value" FLOAT32_IEEE m_q1_mg 1 100 -1.0000E+037 1.0000E+037 FORMAT "%10.4" ECU_ADDRESS 0x6000CDE8 /end MEASUREMENT
/begin MEASUREMENT Lam_stSycSubOld "ECU state during last calculation" UBYTE dez 1 100 0.00 255.0 FORMAT "%5.1" ECU_ADDRESS 0x6000E3B5 /end MEASUREMENT
/begin MEASUREMENT Lam_tiBtwCat1Cat2B1 "Exhaust gas transport time from catalyst 1 to catalyst 2" UWORD t_q0p01 1 100 0.00 655.3500 FORMAT "%8.4" ECU_ADDRESS 0x6000D934 /end MEASUREMENT
/begin MEASUREMENT Lam_tiBtwCat2SDsCat2B1 "Exhaust gas transport time from catalyst 2 to sensor downstream catalyst 2" UWORD t_q0p01 1 100 0.00 655.3500 FORMAT "%8.4" ECU_ADDRESS 0x6000D936 /end MEASUREMENT
/begin MEASUREMENT lbtarsv_w "Set point lambda corrected with delta lambda of exhaust temperature control" UWORD fak_uw_b16 1 100 0.00 15.99976 FORMAT "%8.5" ECU_ADDRESS 0x600038D8 /end MEASUREMENT
/begin MEASUREMENT lbtsaw_w "Selected lambda component protection (bank 1)" UWORD fak_uw_b16 1 100 0.500000 2.000000 FORMAT "%8.6" ECU_ADDRESS 0x6000481A /end MEASUREMENT
/begin MEASUREMENT lbtsbgmn_w "min. allowed engine lambda for component protection (Limitation)" UWORD fak_uw_b16 1 100 0.00 15.99976 FORMAT "%8.5" ECU_ADDRESS 0x60004818 /end MEASUREMENT
/begin MEASUREMENT lbtsgs_w "Lambda component protection with fuel gasoline (bank1)" UWORD fak_uw_b16 1 100 0.500000 2.000000 FORMAT "%8.6" ECU_ADDRESS 0x600038D6 /end MEASUREMENT
/begin MEASUREMENT lbtsmnsp_w "Minimum lambda for component protection out of stationary map and at a high load and low gear (steep slope climbing) (bank1 and bank 2)" UWORD fak_uw_b16 1 100 0.00 15.99976 FORMAT "%8.5" ECU_ADDRESS 0x600038E4 /end MEASUREMENT
/begin MEASUREMENT lbtsskf_w "lambda component protection in case of mega-knock detection" UWORD fak_uw_b16 1 100 0.00 1.000000 FORMAT "%8.6" ECU_ADDRESS 0x600038E2 /end MEASUREMENT
/begin MEASUREMENT miwointv_w "Set point torque without interventions on crankshaft torque level" UWORD rel_uw_b100 1 100 0.00 99.99847 FORMAT "%8.5" ECU_ADDRESS 0x600038E0 /end MEASUREMENT
/begin MEASUREMENT mxetkhll_w_msg "maximum allowed deviation of ignition efficiency during catalyst heating during idle (MAX-Errorpath)" SWORD fak_q3p0518Em5 1 100 -1.000000 0.999969 FORMAT "%8.6" ECU_ADDRESS 0x6000E320 /end MEASUREMENT
/begin MEASUREMENT mxetkhtl_w_msg "maximum allowed deviation of ignition efficiency during catalyst heating during part load (MAX-Errorpath)" SWORD fak_q3p0518Em5 1 100 -1.000000 0.999969 FORMAT "%8.6" ECU_ADDRESS 0x6000E322 /end MEASUREMENT
/begin MEASUREMENT tkhidle_w "current time for catalyst heating during cold start during idle" UWORD t_q0p1 1 100 0.00 6553.500 FORMAT "%8.3" ECU_ADDRESS 0x60003902 /end MEASUREMENT
/begin MEASUREMENT tkhpload_w "current time for catalyst heating during cold start outside idle" UWORD t_q0p1 1 100 0.00 6553.500 FORMAT "%8.3" ECU_ADDRESS 0x60003900 /end MEASUREMENT
/begin FUNCTION ExhMgT_DiagEtaIaCatHeatg "1.11.0    diagnosis of ignition timing efficiency during catalyst heating"
 /begin DEF_CHARACTERISTIC DYNMETKH DYRLETKH ENDEKHMNLL ENDEKHMNTL ExhMgT_effEngIdleNonCsersMax_M ExhMgT_effEngPtlNonCsersMax_M ExhMgT_stDiagEtaIaCatHeatg2_C ExhMgT_stDiagEtaIaCatHeatg_C ExhMgT_tiHeatgIdleNonCsersMin_C ExhMgT_tiHeatgPtlNonCsersMin_C ExhMgT_tiRelsCsersIdle_C ExhMgT_tiRelsCsersPartLoad_C ExhMgT_tiRelsNonCsersIdle_C ExhMgT_tiRelsNonCsersPartLoad_C ExhMgT_tiTondNonCsers_C ExhMgT_vEnagEffCatHeat FHOETKH KFMXETKHLL KFMXETKHTL KLRLMDVERL MNTKHLL MNTKHTL TDDETAKH ZKETKHNM ZKETKHRL /end DEF_CHARACTERISTIC
 /begin IN_MEASUREMENT AirMod_ratChrgAirCyl B_ll_msg B_sa_msg CEngDsT_t Eep_EnvRamInvld Epm_nEng Epm_stSpd etakhdia_w_msg etazwist_w_msg ExhMgT_flgCatHeatgCsers ExhMgT_flgCatHeatgNonCsers fmi2trq_w_msg fwsanfdlut_msg mdverl_w_msg mimaxud_w_msg PEnv_facCorrAlti PthSet_trqInrFlt SyC_ctPostDrvLeave SyC_stSub VehV_v /end IN_MEASUREMENT
 /begin OUT_MEASUREMENT B_dyetkh_msg B_edekhlmx_msg B_edekhtmx_msg B_endcsst_msg B_enetkhll_msg B_enetkhtl_msg B_enetkh_msg B_zdekhlmx_msg B_zdekhtmx_msg detkhlav_w_msg detkhtav_w_msg etkhlmx_msg etkhtmx_msg ExhMgT_flgColdStrtCatHeatg ExhMgT_rateffEngIdleNonCsersMax ExhMgT_rateffEngPtlNonCsersMax mxetkhll_w_msg mxetkhtl_w_msg /end OUT_MEASUREMENT
 /begin LOC_MEASUREMENT B_ekhllmx B_ekhtlmx detakhls_w detakhl_w detakhts_w detakht_w etakhko_w etakhlim_w etkhlmxloc etkhtmxloc ExhMgT_cntrReiniDiagEtaIaCatHeatg ExhMgT_effAvrgEngIdleNonCsers ExhMgT_effAvrgEngPtlNonCsers ExhMgT_effEngIdleNonCsersMax ExhMgT_effEngPtlNonCsersMax ExhMgT_effIntegEngIdleNonCsers ExhMgT_effIntegEngPtlNonCsers ExhMgT_flgCntDenumIdleCsers ExhMgT_flgCntDenumIdleNonCsers ExhMgT_flgCntDenumPartLoadCsers ExhMgT_flgCntDenumPartLoadNonCsers ExhMgT_flgDiagCsersIdle ExhMgT_flgDiagCsersPartLoad ExhMgT_flgDiagIdlePrms ExhMgT_flgDiagPartLoadPrms ExhMgT_flgEnaDiagIdleNonCsers ExhMgT_flgEnaDiagPtlNonCsers ExhMgT_flgErreffIdleNonCsers ExhMgT_flgErreffIdleNonCsersCurr ExhMgT_flgErreffPtlNonCsers ExhMgT_flgErreffPtlNonCsersCurr ExhMgT_flgEvlnBlwThdIdle ExhMgT_flgEvlnBlwThdIdleNonCsers ExhMgT_flgEvlnBlwThdPartLoad ExhMgT_flgEvlnBlwThdPartLoadNonCsers ExhMgT_flgFCMClrEtaCatHeatg ExhMgT_flgRelsIaThdIdle ExhMgT_flgRelsIaThdPartLoad ExhMgT_flgTstdeffIdleNonCsers ExhMgT_flgTstdeffPtlNonCsers ExhMgT_nEngDiffDiagCsers ExhMgT_nEngFildDiagCsers ExhMgT_ratChrgAirDiffDiagCsers ExhMgT_ratChrgAirFildDiagCsers ExhMgT_rateffEngIdleNonCsersMaxLoc ExhMgT_rateffEngPtlNonCsersMaxLoc ExhMgT_tEngDiagIaCatHeatg ExhMgT_tiHeatgIdleNonCsers ExhMgT_tiHeatgPtlNonCsers idetakhl_w idetakht_w tkhidle_w tkhpload_w /end LOC_MEASUREMENT
 FUNCTION_VERSION "1.11.0" /end FUNCTION
/begin FUNCTION ExhMgT_DmdCsersCdnCatHeatg "3.4.1     calculation of conditions if diagnoses are CSERS relevant"
 /begin DEF_CHARACTERISTIC ExhMgT_stDmdCsersCdnCatHeatg_C ExhMgT_tCat1NonCsersMax_C ExhMgT_tDiffEngEnvNonCsersMax_C ExhMgT_tEngDsCsersMax_C ExhMgT_tEngDsCsersMin_C /end DEF_CHARACTERISTIC
 /begin IN_MEASUREMENT B_khakt_msg B_kh_msg CEngDsT_t EnvT_t ExhMgT_flgCatHeatWrmReq ExhMgT_tCat1Min SyC_ctPostDrvLeave SyC_stSub /end IN_MEASUREMENT
 /begin OUT_MEASUREMENT ExhMgT_flgCatHeatgCsers ExhMgT_flgCatHeatgNonCsers ExhMgT_flgNonCsersCdn /end OUT_MEASUREMENT
 /begin LOC_MEASUREMENT ExhMgT_DmdCsersCdnCatHeatg_ctReIni ExhMgT_flgNonCsersCdnTBasd /end LOC_MEASUREMENT
 FUNCTION_VERSION "3.4.1" /end FUNCTION
/begin FUNCTION ExhMgT_DmdOperModCatHeatg "6.8.0     Demand of Operation Mode for Catalyst Heating"
 /begin DEF_CHARACTERISTIC ExhMgT_facRatEngSplt_T ExhMgT_nHysDeltaCatHeatg_C ExhMgT_nHysDeltaEomCatHeatg_C ExhMgT_ratHysDeltaCatHeatg_C ExhMgT_ratHysDeltaEomCatHeatg_C ExhMgT_stEomCatHeatg1_C ExhMgT_stEomCatHeatg2_C ExhMgT_stEomCatHeatg3_C ExhMgT_stOperModCatHeatg_C ExhMgT_stOperModCatWrm_C ExhMgT_stOperModPrioCatWrm_C ExhMgT_stOperModStgCatWrm_M ExhMgT_stPrioCatHeatg1_C ExhMgT_stPrioCatHeatg2_C ExhMgT_stPrioCatHeatg3_C ExhMgT_stStgCatHeatgEomMod1_M.idxSt_MAP ExhMgT_stStgCatHeatgEomMod2_M.idxSt_MAP ExhMgT_stStgHOM_C ExhMgT_swtCatHeatg_C ExhMgT_tiFilFuM_C /end DEF_CHARACTERISTIC
 /begin IN_MEASUREMENT AirMod_ratChrgAirCyl B_fa_msg CEngDsT_t CoEOM_percEngLoad Epm_nEng Epm_stSpd ExhMgT_flgCatHeatgColdStrtReq ExhMgT_flgCatHeatgColdStrtWoFIdReq ExhMgT_flgCatHeatgUpActv ExhMgT_flgCatHeatgWrmReq ExhMgT_flgCatHeatgWrmWoFIdReq ExhMgT_tEngCatHeatgFild InjSys_ratFuM SyC_ctPostDrvLeave SyC_stSub /end IN_MEASUREMENT
 /begin OUT_MEASUREMENT ExhMgT_CatHeatg1_I.stOperMod ExhMgT_CatHeatg1_I.stOperModPrio ExhMgT_CatHeatg1_I.stOperModStg ExhMgT_CatHeatg2_I.stOperMod ExhMgT_CatHeatg2_I.stOperModPrio ExhMgT_CatHeatg2_I.stOperModStg ExhMgT_CatHeatg3_I.stOperMod ExhMgT_CatHeatg3_I.stOperModPrio ExhMgT_CatHeatg3_I.stOperModStg ExhMgT_WrmSustReq_I.stOperMod ExhMgT_WrmSustReq_I.stOperModPrio ExhMgT_WrmSustReq_I.stOperModStg /end OUT_MEASUREMENT
 /begin LOC_MEASUREMENT ExhMgT_cntrReiniDmdOperModCatHeatg ExhMgT_flgCatHeatgDmdCond ExhMgT_flgColdStrtDmdCond ExhMgT_flgOperModWrmDmdCond ExhMgT_flgWrmDmdCond ExhMgT_nCatHeatgOperMod ExhMgT_ratCatHeatgOperMod ExhMgT_ratEngLoadDmdOperMod ExhMgT_ratFuMSeln ExhMgT_stOperModStgCatWrm ExhMgT_stStgCatHeatgEomMod1_M.idxDistbnXOld ExhMgT_stStgCatHeatgEomMod1_M.idxDistbnYOld ExhMgT_stStgCatHeatgEomMod2_M.idxDistbnXOld ExhMgT_stStgCatHeatgEomMod2_M.idxDistbnYOld ExhMgT_tEngCatHeatgOperMod ExhMgT_tEngStrtDmdOperMod /end LOC_MEASUREMENT
 FUNCTION_VERSION "6.8.0" /end FUNCTION
/begin FUNCTION ExhMgT_IaDeltaCptProtn "1.5.0     Calculation of Delta Ignition Angle for component protection"
 /begin DEF_CHARACTERISTIC ExhMgT_DeltaPredLoadCptProtn_T ExhMgT_IaCorrnCptProtn_M ExhMgT_stIaDeltaCptProtn_C ExhMgT_tExhCat1UsDelta_C ExhMgT_tExhCat1UsHi_C ExhMgT_tExhMnfIaDelta_C ExhMgT_tExhMnfIa_C TVLBTSDY /end DEF_CHARACTERISTIC
 /begin IN_MEASUREMENT AirMod_ratChrgAirCyl B_sa_msg Clth_st drlp_w_msg EngStrt_bStrtEnd Epm_nEng etazwist_w_msg ExhMgT_flgActvCptProtnTExh ExhMod_effIgnAgAvrgB1 ExhMod_tExhCat1UsB1 ExhMod_tExhMnfB1 Gbx_bTSCIntv IgCtl_iaPrimMinCptProtnIntv Ign_iaPr_s8 SyC_ctPostDrvLeave SyC_stSub zwopt_w_msg /end IN_MEASUREMENT
 /begin OUT_MEASUREMENT ExhMgT_flgIaDeltaCorrn ExhMgT_flgIaIgnDeltaCptProtn ExhMgT_flgIaIgnDeltaLoadCptProtn ExhMgT_iaDeltaCptProtn /end OUT_MEASUREMENT
 /begin LOC_MEASUREMENT etazwg_w ExhMgT_cntrReIniIaDeltaCptProtn ExhMgT_flgIaIgnDeltaLoadCat1 ExhMgT_flgIaIgnDeltaLoadMnf ExhMgT_flgIaIng ExhMgT_IaCptProtn /end LOC_MEASUREMENT
 FUNCTION_VERSION "1.5.0" /end FUNCTION
/begin FUNCTION ExhMgT_LamCptProtn "20.0.0    Calculation of lambda for component protection"
 /begin DEF_CHARACTERISTIC DLBTSGANG DLBTSTMOT DLBTSVFZG DRLMXBTS ExhMgT_facBldFillgCptProtnGov_T ExhMgT_facCptProtnMisf_T ExhMgT_facDeltaLamIntkAirTCptProtn_GM ExhMgT_facRatLamCptProtnStrt_C ExhMgT_facRdcFillgCptProtnFast_T ExhMgT_facRednCptProtn_T ExhMgT_ratDeltaLamCptProtnIng_GM ExhMgT_ratDeltaLamIntkAirTCptProtn_T ExhMgT_ratLamCptProtnMin_GM ExhMgT_ratLamCptProtn_GM ExhMgT_tiDlyActvtRdcAirFillg_C ExhMgT_tiDlyRdcAirFillg_C ExhMgT_tifacRdcAirFillg_C ExhMgT_tRefIntkAirTCptProtn_GM FRLBTSMN KFDETAZWLONE KFFDLBTS KFLBTSDY KFLBTSDYRI KFLBTSVS KLFINTPLZW KLZKLBTDY KLZWDLBTS SDETA08UW SNM16GKUW SRL15GKUW /end DEF_CHARACTERISTIC
 /begin IN_MEASUREMENT AirMod_ratChrgAirCyl B_atr_msg B_bevab_msg B_lalgf_msg B_ll_msg CEngDsT_t dlamatr_w_msg EngStrt_bStrtEnd Epm_nEng etazwb_w_msg etazwmn_w_msg ExhMgT_facLamCptProtnTExh ExhMgT_flgActvCptProtnTExh ExhMgT_flgIaDeltaCorrn ExhMgT_flgIaIgnDeltaCptProtn ExhMgT_flgIaIgnDeltaLoadCptProtn ExhMgT_iaDeltaCptProtn ExhMgT_ratDeltaLamLimp ExhMgT_tMinTExhCptProtnGlb ftrq2mi_w_msg gangsist_msg GEVCtl_flgStdLftChrgDetrmIntk IntkAirT_tThrVlvUs MisfDet_stCatDmgFcoCyl ml_w_msg PT_trqCrSWoIntv rlsol_w_msg SyC_stSub VehV_v /end IN_MEASUREMENT
 /begin OUT_MEASUREMENT B_fuabts_msg B_lambts_msg ExhMgT_facCptProtnMisf ExhMgT_facRdcAirFillg ExhMgT_ratLamPreIgnCtlCptProtn frlmxbts_w_msg lambs_w_msg lambts_w_msg /end OUT_MEASUREMENT
 /begin LOC_MEASUREMENT B_lbtsbg dlbtszwr_w ExhMgT_facFirstRdcAirFillg ExhMgT_facMinRednCptProtn ExhMgT_facRdcAirFillgCptProtn ExhMgT_flgRdcAirFillg ExhMgT_flgRstFacRdcAirFillg ExhMgT_flgSpclLft ExhMgT_iaDeltaCptProtnCorr ExhMgT_ratDeltaLamCptProtn ExhMgT_ratDeltaLamCptProtnIgn ExhMgT_ratDeltaLamCptProtnTot1 ExhMgT_ratLamAgKnkCtrl ExhMgT_ratLamCptProtnIgn ExhMgT_ratLamMinCptProtnB1 lbtarsv_w lbtsaw_w lbtsbgmn_w lbtsgs_w lbtsmnsp_w lbtsskf_w miwointv_w /end LOC_MEASUREMENT
 FUNCTION_VERSION "20.0.0" /end FUNCTION
/begin FUNCTION ExhMgT_RelsFcoTEgSys "1.6.0     Release of fuel cut-off because of temperature of the exhaust gas system"
 /begin DEF_CHARACTERISTIC ExhMgT_ratLamDeltaLeanCat1_C ExhMgT_ratLamDeltaLeanCat2_C ExhMgT_ratLamLeanCat1_C ExhMgT_ratLamLeanCat2_C ExhMgT_stCptProtnFil_C ExhMgT_stTExhFild_C ExhMgT_tCat1MaxFcoMax_C ExhMgT_tCat1MaxFcoMin_C ExhMgT_tCat2MaxFcoMax_C ExhMgT_tCat2MaxFcoMin_C ExhMgT_tExhCat1CoolgMin_C ExhMgT_tExhCat1FcoAvrgMin_C ExhMgT_tExhCat1FcoAvrg_C ExhMgT_tExhCat1FcoDsMax_C ExhMgT_tExhCat1FcoDsMin_C ExhMgT_tExhCat1FcoEndMin_C ExhMgT_tExhCat1FcoEnd_C ExhMgT_tExhCat1FcoMinMax_C ExhMgT_tExhCat1FcoMin_C ExhMgT_tExhCat1FcoUsMax_C ExhMgT_tExhCat1FcoUsMin_C ExhMgT_tExhCat1Fco_C ExhMgT_tExhCat2CoolgMin_C ExhMgT_tExhCat2FcoAvrgMin_C ExhMgT_tExhCat2FcoAvrg_C ExhMgT_tExhCat2FcoDsMax_C ExhMgT_tExhCat2FcoDsMin_C ExhMgT_tExhCat2FcoEndMin_C ExhMgT_tExhCat2FcoEnd_C ExhMgT_tExhCat2FcoMinMax_C ExhMgT_tExhCat2FcoMin_C ExhMgT_tExhCat2FcoUsMax_C ExhMgT_tExhCat2FcoUsMin_C ExhMgT_tExhCat2Fco_C ExhMgT_tiCutOffFirst_C ExhMgT_tMinCat1CdaDelta_C ExhMgT_tMinCat1CdaHi_C ExhMgT_tMinCat1FcoCoolgDelta_C ExhMgT_tMinCat1FcoCoolgHi_C ExhMgT_tMinCat1FcoDelta_C ExhMgT_tMinCat1FcoHi_C ExhMgT_tMinCat2CdaDelta_C ExhMgT_tMinCat2CdaHi_C ExhMgT_tMinCat2FcoCoolgDelta_C ExhMgT_tMinCat2FcoCoolgHi_C ExhMgT_tMinCat2FcoDelta_C ExhMgT_tMinCat2FcoHi_C ExhMgT_tMinCatFco_T ExhMgT_vLimOverrunFco_C LBTSSAMX TDLBTSSA /end DEF_CHARACTERISTIC
 /begin IN_MEASUREMENT B_evloc_msg B_lambts_msg B_ll_msg B_sa_msg CoEng_flgCpvClsForFco CoEng_stMai EngStrt_bStrtEnd ExhMgT_tCat1AvrgFildB1 ExhMgT_tCat1EndFildB1 ExhMgT_tCat1FildB1 ExhMgT_tCat1MaxFildB1 ExhMgT_tCat1MinFildB1 ExhMgT_tCat2AvrgFildB1 ExhMgT_tCat2EndFildB1 ExhMgT_tCat2FildB1 ExhMgT_tCat2MaxFildB1 ExhMgT_tCat2MinFildB1 ExhMod_rLamCat1DsB1 ExhMod_rLamCat1UsB1 ExhMod_rLamCat2DsB1 ExhMod_rLamCat2DsSB1 ExhMod_rLamCat2UsB1 ExhMod_tCat1AvrgB1 ExhMod_tCat1B1 ExhMod_tCat1EndB1 ExhMod_tCat1MaxB1 ExhMod_tCat1MinB1 ExhMod_tCat2AvrgB1 ExhMod_tCat2B1 ExhMod_tCat2EndB1 ExhMod_tCat2MaxB1 ExhMod_tCat2MinB1 ExhMod_tExhCat1DsB1 ExhMod_tExhCat1UsB1 ExhMod_tExhCat2DsB1 ExhMod_tExhCat2UsB1 lambts_w_msg SyC_ctPostDrvLeave SyC_stSub VehV_v /end IN_MEASUREMENT
 /begin OUT_MEASUREMENT B_sabbts_msg B_tatmsa_msg ECT_bFCOEnaCmpnPrt ExhMgT_flgLamFuFco ExhMgT_flgRelsCutOffTExhHi ExhMgT_flgRelsCutOffTExhLo ExhMgT_ratLamFuFco /end OUT_MEASUREMENT
 /begin LOC_MEASUREMENT B_fgsabts dlambssa_w ExhMgT_cntrReIniRelsFcoTEgSys ExhMgT_flgAllwdFuFco ExhMgT_flgCutOffFirstTi ExhMgT_flgTFcoCat1 ExhMgT_flgTFcoCat2 ExhMgT_tCat1AvrgLocB1 ExhMgT_tCat1EndLocB1 ExhMgT_tCat1LocB1 ExhMgT_tCat1MaxLocB1 ExhMgT_tCat1MinLocB1 ExhMgT_tCat2AvrgLocB1 ExhMgT_tCat2EndLocB1 ExhMgT_tCat2LocB1 ExhMgT_tCat2MaxLocB1 ExhMgT_tCat2MinLocB1 ExhMgT_tMinCat1FcoB1 ExhMgT_tMinCat1FcoCoolgB1 ExhMgT_tMinCat2FcoB1 ExhMgT_tMinCat2FcoCoolgB1 ExhMgT_tMinCatFco ExhMgT_tMinCatFcoCoolg /end LOC_MEASUREMENT
 FUNCTION_VERSION "1.6.0" /end FUNCTION
/begin FUNCTION ExhMgT_TExhCtrlrCptProtn "3.3.0_1.1.0exhaust temperature controller for component protection"
 /begin DEF_CHARACTERISTIC ExhMgT_facDftlCptProtnGovr_M ExhMgT_facDftlTGovrCptProtnCorrnB1_C ExhMgT_facIvsExhMassMax_C ExhMgT_facKiCptProtnGovr1B1_M ExhMgT_facKiCptProtnGovr_C ExhMgT_facKpCptProtnGovr_T ExhMgT_nrTExhArySeldB1_C ExhMgT_ratChrgExhCptProtn_M ExhMgT_ratDeltaCptProtnGovrCorrn1_C ExhMgT_ratDeltaCptProtnGovrMin_M ExhMgT_ratDeltaLamCptProtnGovrMax_C ExhMgT_ratDeltaLamDftlCptProtnGovr_M ExhMgT_stTGovr2_C ExhMgT_stTGovr3_C ExhMgT_stTGovr_C ExhMgT_tCatCritCorrn_M ExhMgT_tCatCrit_M ExhMgT_tDifDftlCptProtnGovrLim_C ExhMgT_tDifLimDftlCptProtnGovr1_C ExhMgT_tiRelsCptProtnGovr_C ExhMgT_tiTCatCritFild_T ExhMgT_tiTnCptProtnGovr_C /end DEF_CHARACTERISTIC
 /begin IN_MEASUREMENT AirMod_ratChrgAirCyl B_ate_msg B_bevab_msg EngStrt_bStrtEnd Epm_nEng ExhMgT_flgActvCptProtnTExh ExhMgT_tMinExhB1 ExhMgT_tMinTExhCptProtnB1 ExhMgT_tMinTWallCptProtnB1 ExhMod_mfExhB1 ExhMod_tExhAryB1 IntkAirT_tThrVlvUs lambs_w_msg SyC_ctDrvEnter SyC_ctPostDrvLeave SyC_stSub tumg_msg VehV_v /end IN_MEASUREMENT
 /begin OUT_MEASUREMENT B_atr_msg dlamatr_w_msg ExhMgT_flgCtrlActvCptProtnB1 ExhMgT_ratDeltaLamCtrlCptProtnB1 ExhMgT_tMinTExhGovrCptProtn ExhMgT_tMinTExhGovrCptProtnB1 /end OUT_MEASUREMENT
 /begin LOC_MEASUREMENT B_atrb B_bbatr ExhMgT_cntrIniDrvTExhCtrlrCptProtn ExhMgT_cntrReIniTExhCtrlrCptProtn ExhMgT_facDftlCptProtnGovrB1 ExhMgT_mfExhCptProtnGovr ExhMgT_PidGovr_temp1_B1.ExhMgT_facDftlCptProtnGovrNoCorrn ExhMgT_PidGovr_temp1_B1.ExhMgT_ratDeltaLamCptProtnGovrMax ExhMgT_PidGovr_temp1_B1.ExhMgT_ratDeltaLamDftlCptProtnGovr ExhMgT_PidGovr_temp1_B1.ExhMgT_ratDeltaLamKiCptProtnGovr ExhMgT_PidGovr_temp1_B1.ExhMgT_ratDeltaLamKpCptProtnGovr ExhMgT_PidGovr_temp1_B1.ExhMgT_tDftlCptProtnGovr ExhMgT_PidGovr_temp1_B1.ExhMgT_tDifCptProtnGovr ExhMgT_PidGovr_temp1_B1.CmpPrt_dlatriIKL_I.memory ExhMgT_ratDeltaCptProtnGovr1Min ExhMgT_ratDeltaCptProtnGovrMin ExhMgT_ratDeltaLamDftlCptProtnGovr ExhMgT_ratDeltaLamTGovrCptProtnB1 ExhMgT_RelsCptPrortnGovrTONV_I.outbit ExhMgT_RelsCptPrortnGovrTONV_I.time ExhMgT_tCatCritFild ExhMgT_tCatCritLT_I.memory ExhMgT_tCatCritUnfild ExhMgT_tDiffCatCritB1 ExhMgT_tMinGrdtTExhGovrB1 ExhMgT_tMinTExhGovrCptProtnB1old /end LOC_MEASUREMENT
 FUNCTION_VERSION "3.3.0_1.1.0" /end FUNCTION
/begin FUNCTION ExhMgT_TExhFild "1.4.0     Exhaust temperature filtered"
 /begin DEF_CHARACTERISTIC ExhMgT_tiTDsVlvB1_C ExhMgT_tiTFltCat1AvrgB1_C ExhMgT_tiTFltCat1B1_C ExhMgT_tiTFltCat1EndB1_C ExhMgT_tiTFltCat1MaxB1_C ExhMgT_tiTFltCat1MinB1_C ExhMgT_tiTFltCat2AvrgB1_C ExhMgT_tiTFltCat2B1_C ExhMgT_tiTFltCat2EndB1_C ExhMgT_tiTFltCat2MaxB1_C ExhMgT_tiTFltCat2MinB1_C ExhMgT_tiTFltExhMnfB1_T /end DEF_CHARACTERISTIC
 /begin IN_MEASUREMENT EngStrt_bStrtEnd ExhMod_mfExhB1 ExhMod_tCat1AvrgB1 ExhMod_tCat1B1 ExhMod_tCat1EndB1 ExhMod_tCat1MaxB1 ExhMod_tCat1MinB1 ExhMod_tCat2AvrgB1 ExhMod_tCat2B1 ExhMod_tCat2EndB1 ExhMod_tCat2MaxB1 ExhMod_tCat2MinB1 ExhMod_tExhDsVlvB1 ExhMod_tExhMnfB1 SyC_stSub /end IN_MEASUREMENT
 /begin OUT_MEASUREMENT ExhMgT_tCat1AvrgFildB1 ExhMgT_tCat1EndFildB1 ExhMgT_tCat1FildB1 ExhMgT_tCat1MaxFildB1 ExhMgT_tCat1MinFildB1 ExhMgT_tCat2AvrgFildB1 ExhMgT_tCat2EndFildB1 ExhMgT_tCat2FildB1 ExhMgT_tCat2MaxFildB1 ExhMgT_tCat2MinFildB1 ExhMgT_tExhDsVlvFildB1 ExhMgT_tExhMnfFildB1 ExhMgT_tExhMnfFildB1Prev ExhMgT_tExhMnfFildGrdtB1 /end OUT_MEASUREMENT
 /begin LOC_MEASUREMENT ExhMgT_tExhMnfB1Prev ExhMgT_tiTFltExhMnf /end LOC_MEASUREMENT
 FUNCTION_VERSION "1.4.0" /end FUNCTION
/begin FUNCTION ExhMod_DevPos "1.12.0    Calculation of device-postions in exhaust system" /begin REF_CHARACTERISTIC ExhMod_stCfgExhSysB1_CA /end REF_CHARACTERISTIC
 /begin OUT_MEASUREMENT ExhMod_idxFirstBrickCat1B1 ExhMod_idxFirstBrickCat2B1 ExhMod_idxFrtBrickCatAryB1 ExhMod_idxLstBrickCatAryB1 ExhMod_nrBrickCat1B1 ExhMod_nrBrickCat2B1 ExhMod_nrBrickCatAryB1 /end OUT_MEASUREMENT
 /begin LOC_MEASUREMENT ExhMod_flgCfgPlausB1 ExhMod_stCfgPlausB1 /end LOC_MEASUREMENT
 FUNCTION_VERSION "1.12.0" /end FUNCTION
/begin FUNCTION ExhMod_DewDetRels "2.45.0    Calculated value of dew point in exhaust system branch"
 /begin DEF_CHARACTERISTIC DewDet_tiDlyNEngRelFuM_C DewDet_tiMaxSwtOffCldStrt_C DewDet_tiMaxSwtOffWrmStrt_C DewDet_tiProlgNEngRelFuM_C DewDet_tMinEnvCldStrt_C DewDet_S1B1_I.egyThd_M DewDet_S1B1_I.facCatHeatgWoExo_T DewDet_S1B1_I.facCatHeatg_T DewDet_S1B1_I.facCoolgAcmEgy_T DewDet_S1B1_I.facCoolgSnrs_T DewDet_S1B1_I.facCoolgTWall_T DewDet_S1B1_I.facCorrnMFlow_T DewDet_S1B1_I.facHeatThdCldStrtCntr_T DewDet_S1B1_I.facHeatThdOffs_T DewDet_S1B1_I.facRednHeatFlowIntSec_C DewDet_S1B1_I.nrCldStrtSnsrProdLine_C DewDet_S1B1_I.nrMaxCldStrtSnsr_C DewDet_S1B1_I.ratMinHeatThdCldStrt_T DewDet_S1B1_I.ratThdNEngRelFuMSet_T DewDet_S1B1_I.ratThdNEngRelFuM_T DewDet_S1B1_I.tMinNoRstIntEngOff_C DewDet_S1B1_I.tMinNoRstInt_C DewDet_S1B1_I.tThdHeatFlowInt_C DewDet_S1B1_I.tiDlyRstIntEngOff_T DewDet_S1B1_I.tiDlyRstInt_C DewDet_S2B1_I.egyThd_M DewDet_S2B1_I.facCatHeatgWoExo_T DewDet_S2B1_I.facCatHeatg_T DewDet_S2B1_I.facCoolgAcmEgy_T DewDet_S2B1_I.facCoolgSnrs_T DewDet_S2B1_I.facCoolgTWall_T DewDet_S2B1_I.facCorrnMFlow_T DewDet_S2B1_I.facHeatThdCldStrtCntr_T DewDet_S2B1_I.facHeatThdOffs_T DewDet_S2B1_I.facRednHeatFlowIntSec_C DewDet_S2B1_I.nrCldStrtSnsrProdLine_C DewDet_S2B1_I.nrMaxCldStrtSnsr_C DewDet_S2B1_I.ratMinHeatThdCldStrt_T DewDet_S2B1_I.ratThdNEngRelFuMSet_T DewDet_S2B1_I.ratThdNEngRelFuM_T DewDet_S2B1_I.tMinNoRstIntEngOff_C DewDet_S2B1_I.tMinNoRstInt_C DewDet_S2B1_I.tThdHeatFlowInt_C DewDet_S2B1_I.tiDlyRstIntEngOff_T DewDet_S2B1_I.tiDlyRstInt_C DewDet_stConfSnsrAryB1_CA DewDet_stConf_C DewDet_stOffTiConf_C DewDet_tEngStrtMinAcm_C DewDet_tEnvMinAcm_C DewDet_tiProlgProdLine_C ExhMod_facMfIntegEngStrtTiEngOff_T STN10TMUB STS08TMUW /end DEF_CHARACTERISTIC
 /begin IN_MEASUREMENT CoEng_st ExhMod_mfExhSnsrAryB1 ExhMod_tExhSnsrAryB1 ExhMod_tWallSnsrAryB1 B_fabe_msg B_khakt_msg B_kh_msg B_trkonz_msg CEngDsT_tStrt CEngDsT_tStrtFrst Eep_EnvRamHist Eep_EnvRamInvld EnvT_t Epm_nEng ExhMod_flgEngRunngTiEngOff ExhMod_flgTiEngOffVld ExhMod_tiEngOff InjSys_ratFuMTot ml_w_msg PthSet_stOvrRun SyC_ctPostDrvLeave tka_msg /end IN_MEASUREMENT
 /begin OUT_MEASUREMENT DewDet_bFrstStrtEndERNM DewDet_bStrtEndERNM DewDet_flgAcmEgy DewDet_flgCatHeatgWoExo DewDet_flgEngStopER DewDet_flgInfoStrdEngOff DewDet_flgProlgProdLine DewDet_flgPwrFail DewDet_tiShDown ExhMod_cntrCldStrtAryB1 ExhMod_cntrCldStrtS1B1 ExhMod_cntrCldStrtS2B1 ExhMod_egyDewPntEndS1B1 ExhMod_egyDewPntEndS2B1 ExhMod_egyThdDewPntEndS1B1 ExhMod_egyThdDewPntEndS2B1 ExhMod_flgDewPntEndLstS1B1 ExhMod_flgDewPntEndLstS2B1 ExhMod_flgDewPntEndS1B1 ExhMod_flgDewPntEndS1B1Sig ExhMod_flgDewPntEndS2B1 ExhMod_flgDewPntEndS2B1Sig ExhMod_flgTSnsrStrtCalcdB1 ExhMod_mAirMfIntegEngFirstStrt ExhMod_mAirMfIntegEngStrt ExhMod_mAirMfIntegEngStrtCalReini ExhMod_tEngStrtDewDet ExhMod_tEnvDewDet ExhMod_tExhStrtS1B1 ExhMod_tExhStrtS2B1 /end OUT_MEASUREMENT
 /begin LOC_MEASUREMENT DewDet_ctReIni DewDet_flgAcmEgyBasc DewDet_flgEngStopLdc DewDet_flgTUpdEngStrt DewDet_flgTUpdTiShDown DewDet_S1B1_I.cntrCldStrtSnsr DewDet_S1B1_I.egyInteg DewDet_S1B1_I.egyIntegAcm DewDet_S1B1_I.egyIntegAcmLst DewDet_S1B1_I.egyIntegHiResl DewDet_S1B1_I.egyIntegInp DewDet_S1B1_I.egyThd DewDet_S1B1_I.egyThdEngRunLst DewDet_S1B1_I.egyThdHeat DewDet_S1B1_I.egyThdLst DewDet_S1B1_I.egyThdRaw DewDet_S1B1_I.egy_inc DewDet_S1B1_I.facCoolgSnrs DewDet_S1B1_I.flgAcmEgySnsr DewDet_S1B1_I.flgCondRstInt DewDet_S1B1_I.flgDewPntEnd DewDet_S1B1_I.flgDewPntEndLst DewDet_S1B1_I.flgRatNEngRelFuM DewDet_S1B1_I.flgRstDewDet DewDet_S1B1_I.flgRstDewPntEnd DewDet_S1B1_I.flgRstEngOff DewDet_S1B1_I.flgRstEngOffStrt DewDet_S1B1_I.flgRstInt DewDet_S1B1_I.flgSetDewPntEnd DewDet_S1B1_I.flgTUpdFco DewDet_S1B1_I.mfExhSnsr DewDet_S1B1_I.tSnsrCoolg DewDet_S1B1_I.tSnsrEnd DewDet_S1B1_I.tSnsrStrt DewDet_S1B1_I.tWallCoolg DewDet_S1B1_I.tWallEngStop DewDet_S1B1_I.tWallSnsrOld DewDet_S1B1_I.tiShtDwn DewDet_S2B1_I.cntrCldStrtSnsr DewDet_S2B1_I.egyInteg DewDet_S2B1_I.egyIntegAcm DewDet_S2B1_I.egyIntegAcmLst DewDet_S2B1_I.egyIntegHiResl DewDet_S2B1_I.egyIntegInp DewDet_S2B1_I.egyThd DewDet_S2B1_I.egyThdEngRunLst DewDet_S2B1_I.egyThdHeat DewDet_S2B1_I.egyThdLst DewDet_S2B1_I.egyThdRaw DewDet_S2B1_I.egy_inc DewDet_S2B1_I.facCoolgSnrs DewDet_S2B1_I.flgAcmEgySnsr DewDet_S2B1_I.flgCondRstInt DewDet_S2B1_I.flgDewPntEnd DewDet_S2B1_I.flgDewPntEndLst DewDet_S2B1_I.flgRatNEngRelFuM DewDet_S2B1_I.flgRstDewDet DewDet_S2B1_I.flgRstDewPntEnd DewDet_S2B1_I.flgRstEngOff DewDet_S2B1_I.flgRstEngOffStrt DewDet_S2B1_I.flgRstInt DewDet_S2B1_I.flgSetDewPntEnd DewDet_S2B1_I.flgTUpdFco DewDet_S2B1_I.mfExhSnsr DewDet_S2B1_I.tSnsrCoolg DewDet_S2B1_I.tSnsrEnd DewDet_S2B1_I.tSnsrStrt DewDet_S2B1_I.tWallCoolg DewDet_S2B1_I.tWallEngStop DewDet_S2B1_I.tWallSnsrOld DewDet_S2B1_I.tiShtDwn ExhMod_flgDewPntEndLstNvS1B1 ExhMod_mAirMfIntegEngStrtCalReiniNv /end LOC_MEASUREMENT
 FUNCTION_VERSION "2.45.0" /end FUNCTION
/begin FUNCTION ExhMod_LamMdl "1.12.0    Modelling Of Lambda In The Exhaust Gas System"
 /begin DEF_CHARACTERISTIC Lam_mO2StorgIni_C ExhMod_stLamCfg_C ExhMod_volBtwCat1Cat2B1_C ExhMod_volBtwCat2SDsCat2B1_C ExhMod_volBtwLS1Cat1B1_C Lam_mO2CatStThd_C Lam_mO2MaxCat1_C Lam_ratConcO2ThdLean_C Lam_ratConcO2ThdRich_C Lam_tDlyLSNplFlg Lam_uLSCat1Empty_C Lam_uLSCat1Full_C /end DEF_CHARACTERISTIC
 /begin IN_MEASUREMENT EngStrt_bStrtEnd B_bevab_msg B_sbblsu_msg ExhMod_flgLSEnaCat1B1 ExhMod_mfExhCat1B1 ExhMod_mfExhCat2B1 ExhMod_mfExhWoFuUsCat1B1 ExhMod_mfExhWoFuUsCat2B1 ExhMod_mO2StrExtdCat1B1 ExhMod_mO2StrExtdCat2B1 ExhMod_pDsLstCat ExhMod_pExhCat1UsB1 ExhMod_pExhCat2UsB1 ExhMod_tExhCat1UsAvrgB1 ExhMod_tExhCat2DsB1 ExhMod_tExhCat2UsAvrgB1 ExhMod_uCat1DsB1 lamsons_w_msg SyC_stSub UEGO_rLamS1B1 /end IN_MEASUREMENT
 /begin OUT_MEASUREMENT ExhMod_dmO2Cat1B1 ExhMod_dmO2Cat2B1 ExhMod_flgEmptyCat1B1 ExhMod_flgEmptyCat2B1 ExhMod_flgFullCat1B1 ExhMod_flgFullCat2B1 ExhMod_flgLSEmptyCat1B1 ExhMod_flgLSFullCat1B1 ExhMod_flgLSNplCat1B1 ExhMod_flgLSNplEmptyCat1B1 ExhMod_flgLSNplFullCat1B1 ExhMod_mfO2Cat1B1 ExhMod_mfO2Cat2B1 ExhMod_mO2Cat1B1 ExhMod_mO2Cat2B1 ExhMod_mO2ExtdCat1B1 ExhMod_mO2ExtdCat2B1 ExhMod_ratConcO2Cat1B1 ExhMod_ratConcO2Cat2B1 ExhMod_rLamCat1DsB1 ExhMod_rLamCat1UsB1 ExhMod_rLamCat2DsB1 ExhMod_rLamCat2DsSB1 ExhMod_rLamCat2UsB1 ExhMod_rLamCatUsAryB1 ExhMod_rLamLS1B1 ExhMod_tiBtwLS1Cat1B1 ExhMod_tiBtwLS1Cat2B1 /end OUT_MEASUREMENT
 /begin LOC_MEASUREMENT Lam_flgRstO2IntgCat1B1 Lam_flgRstO2IntgCat2B1 Lam_mO2RstValCat1B1 Lam_mO2RstValCat2B1 Lam_O2IntglExtdCat1B1_I.mfO2 Lam_O2IntglExtdCat1B1_I.ratConcO2 Lam_O2IntglExtdCat1B1_I.O2IKL_I.memory Lam_O2IntglExtdCat2B1_I.mfO2 Lam_O2IntglExtdCat2B1_I.ratConcO2 Lam_O2IntglExtdCat2B1_I.O2IKL_I.memory Lam_PlausChkLSCat1B1_I.CatEmptyFF_I.status Lam_PlausChkLSCat1B1_I.CatFullFF_I.status Lam_PlausChkLSCat1B1_I.NotLeanTONV_I.outbit Lam_PlausChkLSCat1B1_I.NotLeanTONV_I.time Lam_PlausChkLSCat1B1_I.NotRichTONV_I.outbit Lam_PlausChkLSCat1B1_I.NotRichTONV_I.time Lam_PlausChkLSCat1B1_I.oxplIK_I.memory Lam_stSycSubOld Lam_tiBtwCat1Cat2B1 Lam_tiBtwCat2SDsCat2B1 /end LOC_MEASUREMENT
 FUNCTION_VERSION "1.12.0" /end FUNCTION
/begin COMPU_METHOD AirMassPerTime_float "" RAT_FUNC "%6.2" "Kg/h" COEFFS 0 1 0 0 0 1 /end COMPU_METHOD
/begin COMPU_METHOD B_TRUE "" TAB_VERB "%6.3" "" COMPU_TAB_REF B_TRUE /end COMPU_METHOD
/begin COMPU_VTAB B_TRUE "" TAB_VERB 2 0 "FALSE" 1 "TRUE" /end COMPU_VTAB
/begin COMPU_METHOD dez "" RAT_FUNC "%6.2" "" COEFFS 0 1 0 0 0 1 /end COMPU_METHOD
/begin COMPU_METHOD EngN "" RAT_FUNC "%6.3" "rpm" COEFFS 0 2 0 0 0 1 /end COMPU_METHOD
/begin COMPU_METHOD fak_q0p000244 "" RAT_FUNC "%6.5" "-" COEFFS 0 65536 0 0 0 16 /end COMPU_METHOD
/begin COMPU_METHOD fak_q0p01 "" RAT_FUNC "%6.4" "" COEFFS 0 100 0 0 0 1 /end COMPU_METHOD
/begin COMPU_METHOD fak_q0p03125 "" RAT_FUNC "%6.4" "" COEFFS 0 32 0 0 0 1 /end COMPU_METHOD
/begin COMPU_METHOD fak_q3p0518Em5 "" RAT_FUNC "%7.6" "" COEFFS 0 32768 0 0 0 1 /end COMPU_METHOD
/begin COMPU_METHOD fak_sw_b1 "" RAT_FUNC "%7.6" "-" COEFFS 0 65536 0 0 0 2 /end COMPU_METHOD
/begin COMPU_METHOD fak_sw_b4 "" RAT_FUNC "%6.5" "-" COEFFS 0 65536 0 0 0 8 /end COMPU_METHOD
/begin COMPU_METHOD fak_sw_b8 "" RAT_FUNC "%6.5" "-" COEFFS 0 65536 0 0 0 16 /end COMPU_METHOD
/begin COMPU_METHOD fak_ub_b1 "" RAT_FUNC "%6.4" "-" COEFFS 0 256 0 0 0 1 /end COMPU_METHOD
/begin COMPU_METHOD fak_ub_b2 "" RAT_FUNC "%8.5" "-" COEFFS 0 256 0 0 0 2 /end COMPU_METHOD
/begin COMPU_METHOD fak_ub_b32 "" RAT_FUNC "%6.3" "-" COEFFS 0 256 0 0 0 32 /end COMPU_METHOD
/begin COMPU_METHOD fak_uw_b0p05 "" RAT_FUNC "%9.8" "-" COEFFS 0 65536 0 0 0 0.05 /end COMPU_METHOD
/begin COMPU_METHOD fak_uw_b100 "" RAT_FUNC "%6.4" "-" COEFFS 0 65536 0 0 0 100 /end COMPU_METHOD
/begin COMPU_METHOD fak_uw_b16 "" RAT_FUNC "%6.5" "-" COEFFS 0 65536 0 0 0 16 /end COMPU_METHOD
/begin COMPU_METHOD fak_uw_b2 "" RAT_FUNC "%7.6" "-" COEFFS 0 65536 0 0 0 2 /end COMPU_METHOD
/begin COMPU_METHOD fak_uw_b4 "" RAT_FUNC "%7.6" "-" COEFFS 0 65536 0 0 0 4 /end COMPU_METHOD
/begin COMPU_METHOD fak_uw_b8 "" RAT_FUNC "%6.5" "-" COEFFS 0 65536 0 0 0 8 /end COMPU_METHOD
/begin COMPU_METHOD fak_uw_q0p01 "" RAT_FUNC "%6.4" "-" COEFFS 0 1 0 0 0 0.01 /end COMPU_METHOD
/begin COMPU_METHOD KLINE_SY_Compu "" TAB_VERB "%6.3" "" COMPU_TAB_REF KLINE_SY_Compu /end COMPU_METHOD
/begin COMPU_VTAB KLINE_SY_Compu "" TAB_VERB 2 0 "False" 1 "True" /end COMPU_VTAB
/begin COMPU_METHOD KNKCTLBLK_SC_Compu "" TAB_VERB "%6.3" "" COMPU_TAB_REF KNKCTLBLK_SC_Compu /end COMPU_METHOD
/begin COMPU_VTAB KNKCTLBLK_SC_Compu "" TAB_VERB 2 0 "False" 1 "True" /end COMPU_VTAB
/begin COMPU_METHOD KNKDEACTVNTSTRIF_SC_Compu "" TAB_VERB "%6.3" "" COMPU_TAB_REF KNKDEACTVNTSTRIF_SC_Compu /end COMPU_METHOD
/begin COMPU_VTAB KNKDEACTVNTSTRIF_SC_Compu "" TAB_VERB 2 0 "False" 1 "True" /end COMPU_VTAB
/begin COMPU_METHOD KNKPREVNHITLOLOAD_SC_Compu "" TAB_VERB "%6.3" "" COMPU_TAB_REF KNKPREVNHITLOLOAD_SC_Compu /end COMPU_METHOD
/begin COMPU_VTAB KNKPREVNHITLOLOAD_SC_Compu "" TAB_VERB 2 0 "False" 1 "True" /end COMPU_VTAB
/begin COMPU_METHOD KNKSNSRCONNDIAG_SC_Compu "" TAB_VERB "%6.3" "" COMPU_TAB_REF KNKSNSRCONNDIAG_SC_Compu /end COMPU_METHOD
/begin COMPU_VTAB KNKSNSRCONNDIAG_SC_Compu "" TAB_VERB 2 0 "False" 1 "True" /end COMPU_VTAB
/begin COMPU_METHOD Kp "" RAT_FUNC "%7.6" "1/1" COEFFS 0 32768 0 0 0 1 /end COMPU_METHOD
/begin COMPU_METHOD Kp_1 "" RAT_FUNC "%6.4" "1/1" COEFFS 0 64 0 0 0 1 /end COMPU_METHOD
/begin COMPU_METHOD Kp_LmbdRec2InjMass_1 "" RAT_FUNC "%6.4" "mg/stroke" COEFFS 0 81.92 0 0 0 1 /end COMPU_METHOD
/begin COMPU_METHOD Kp_pRail2Q_1 "" RAT_FUNC "%7.6" "mm^3/s/hPa" COEFFS 0 81920 0 0 0 1 /end COMPU_METHOD
/begin COMPU_METHOD Kp_Temp2EGTFact "" RAT_FUNC "%7.6" "-" COEFFS 0 25600 0 0 0 1 /end COMPU_METHOD
/begin COMPU_METHOD L9779_SC_Compu "" TAB_VERB "%6.3" "" COMPU_TAB_REF L9779_SC_Compu /end COMPU_METHOD
/begin COMPU_VTAB L9779_SC_Compu "" TAB_VERB 2 0 "False" 1 "True" /end COMPU_VTAB
/begin COMPU_METHOD L9959_SC_Compu "" RAT_FUNC "%6.2" "" COEFFS 0 1 0 0 0 1 /end COMPU_METHOD
/begin COMPU_METHOD L9966_SC_Compu "" RAT_FUNC "%6.2" "" COEFFS 0 1 0 0 0 1 /end COMPU_METHOD
/begin COMPU_METHOD lambda "" RAT_FUNC "%6.5" "-" COEFFS 0 1000 0 0 0 1 /end COMPU_METHOD
/begin COMPU_METHOD lambdaRec "" RAT_FUNC "%7.6" "-" COEFFS 0 10000 0 0 0 1 /end COMPU_METHOD
/begin COMPU_METHOD lambdaRecVal "" RAT_FUNC "%6.5" "-" COEFFS 0 1000 0 0 0 1 /end COMPU_METHOD
/begin COMPU_METHOD Lambda_DiffQuot "" RAT_FUNC "%6.4" "1/s" COEFFS 0 20 0 0 0 1 /end COMPU_METHOD
/begin COMPU_METHOD LAMCL_CTRLRALG_SC_Compu "" TAB_VERB "%6.3" "" COMPU_TAB_REF LAMCL_CTRLRALG_SC_Compu /end COMPU_METHOD
/begin COMPU_VTAB LAMCL_CTRLRALG_SC_Compu "" TAB_VERB 3 0 "IMC" 1 "SmithPred" 255 "Calibratable" /end COMPU_VTAB
/begin COMPU_METHOD LAMCL_VAR_SY_Compu "" TAB_VERB "%6.3" "" COMPU_TAB_REF LAMCL_VAR_SY_Compu /end COMPU_METHOD
/begin COMPU_VTAB LAMCL_VAR_SY_Compu "" TAB_VERB 47 1 "DAI" 3 "VWW" 4 "POR" 5 "AUD" 6 "OPE" 9 "FIA" 11 "BMW" 14 "PSA" 15 "REN" 17 "ALF" 18 "SAB" 19 "VOL" 20 "NIS" 21 "GMU" 22 "FOR" 26 "IMJ" 51 "SEA" 53 "CHR" 54 "JAG" 55 "ROL" 69 "FER" 72 "TOY" 123 "MIT" 147 "HYU" 159 "HON" 160 "MAZ" 183 "CU" 190 "LRG" 204 "VVW" 214 "AVT" 242 "Iveco" 243 "DMC" 248 "SUZ" 267 "SSANGYONG" 270 "KEF" 289 "AMG" 308 "TAT" 319 "MVM" 330 "TVS" 385 "UAES" 386 "Bajaj Auto Indien" 425 "Polaris" 590 "Scania" 828 "RBCD" 999 "ALL" 2887 "Nonox" 9454 "Fuso" /end COMPU_VTAB
/begin COMPU_METHOD LAMCOORNEXHTINT_SC_Compu "" TAB_VERB "%6.3" "" COMPU_TAB_REF LAMCOORNEXHTINT_SC_Compu /end COMPU_METHOD
/begin COMPU_VTAB LAMCOORNEXHTINT_SC_Compu "" TAB_VERB 2 0 "False" 1 "True" /end COMPU_VTAB
/begin COMPU_METHOD LAMCORENGTEMP_SY_Compu "" TAB_VERB "%6.3" "" COMPU_TAB_REF LAMCORENGTEMP_SY_Compu /end COMPU_METHOD
/begin COMPU_VTAB LAMCORENGTEMP_SY_Compu "" TAB_VERB 2 0 "False" 1 "True" /end COMPU_VTAB
/begin COMPU_METHOD LAMCTLAGSYN_SY_Compu "" TAB_VERB "%6.3" "" COMPU_TAB_REF LAMCTLAGSYN_SY_Compu /end COMPU_METHOD
/begin COMPU_VTAB LAMCTLAGSYN_SY_Compu "" TAB_VERB 2 0 "False" 1 "True" /end COMPU_VTAB
/begin COMPU_METHOD LAMCTRLCONTNSHEGO_SC_Compu "" TAB_VERB "%6.3" "" COMPU_TAB_REF LAMCTRLCONTNSHEGO_SC_Compu /end COMPU_METHOD
/begin COMPU_VTAB LAMCTRLCONTNSHEGO_SC_Compu "" TAB_VERB 2 0 "False" 1 "True" /end COMPU_VTAB
/begin COMPU_METHOD LAMCTRL_GAINCHGENGT_SC_Compu "" TAB_VERB "%6.3" "" COMPU_TAB_REF LAMCTRL_GAINCHGENGT_SC_Compu /end COMPU_METHOD
/begin COMPU_VTAB LAMCTRL_GAINCHGENGT_SC_Compu "" TAB_VERB 2 0 "False" 1 "True" /end COMPU_VTAB
/begin COMPU_METHOD LAMCTRL_GAINCHGTIAFTSTRT_SC_Compu "" TAB_VERB "%6.3" "" COMPU_TAB_REF LAMCTRL_GAINCHGTIAFTSTRT_SC_Compu /end COMPU_METHOD
/begin COMPU_VTAB LAMCTRL_GAINCHGTIAFTSTRT_SC_Compu "" TAB_VERB 2 0 "False" 1 "True" /end COMPU_VTAB
/begin COMPU_METHOD LASP_SY_Compu "" TAB_VERB "%6.3" "" COMPU_TAB_REF LASP_SY_Compu /end COMPU_METHOD
/begin COMPU_VTAB LASP_SY_Compu "" TAB_VERB 2 0 "Lambda-Split no active" 1 "Lambda-Split active" /end COMPU_VTAB
/begin COMPU_METHOD LDCOM_SC_Compu "" TAB_VERB "%6.3" "" COMPU_TAB_REF LDCOM_SC_Compu /end COMPU_METHOD
/begin COMPU_VTAB LDCOM_SC_Compu "" TAB_VERB 2 0 "False" 1 "True" /end COMPU_VTAB
/begin COMPU_METHOD LengthFine "" RAT_FUNC "%6.5" "m" COEFFS 0 1000 0 0 0 1 /end COMPU_METHOD
/begin COMPU_METHOD LengthKm "" RAT_FUNC "%6.1" "Km" COEFFS 0 0.05 0 0 0 1 /end COMPU_METHOD
/begin COMPU_METHOD LengthMm "" RAT_FUNC "%6.2" "mm" COEFFS 0 1 0 0 0 1 /end COMPU_METHOD
/begin COMPU_METHOD Length_km "" RAT_FUNC "%6.2" "km" COEFFS 0 1 0 0 0 1 /end COMPU_METHOD
/begin COMPU_METHOD Len_Km_q0p00001_COMPU "" RAT_FUNC "%8.7" "Km" COEFFS 0 100000 0 0 0 1 /end COMPU_METHOD
/begin COMPU_METHOD len_q0p0007629_m "" RAT_FUNC "%6.5" "m" COEFFS 0 65536 0 0 0 50 /end COMPU_METHOD
/begin COMPU_METHOD LGTASNSR_SC_Compu "" TAB_VERB "%6.3" "" COMPU_TAB_REF LGTASNSR_SC_Compu /end COMPU_METHOD
/begin COMPU_VTAB LGTASNSR_SC_Compu "" TAB_VERB 2 0 "False" 1 "True" /end COMPU_VTAB
/begin COMPU_METHOD LICTRLAVL_SC_Compu "" TAB_VERB "%6.3" "" COMPU_TAB_REF LICTRLAVL_SC_Compu /end COMPU_METHOD
/begin COMPU_VTAB LICTRLAVL_SC_Compu "" TAB_VERB 2 0 "False" 1 "True" /end COMPU_VTAB
/begin COMPU_METHOD mgrad_q1_mgdivs "" RAT_FUNC "%6.2" "mg/s" COEFFS 0 1 0 0 0 1 /end COMPU_METHOD
/begin COMPU_METHOD m_q0p1_mg "" RAT_FUNC "%6.3" "mg" COEFFS 0 1 0 0 0 0.1 /end COMPU_METHOD
/begin COMPU_METHOD m_q0p1_mgs "" RAT_FUNC "%6.3" "mg/s" COEFFS 0 1 0 0 0 0.1 /end COMPU_METHOD
/begin COMPU_METHOD m_q1_mg "" RAT_FUNC "%6.2" "mg" COEFFS 0 1 0 0 0 1 /end COMPU_METHOD
/begin COMPU_METHOD m_uw_b23p3 "" RAT_FUNC "%6.5" "kg" COEFFS 0 2812.5 0 0 0 1 /end COMPU_METHOD
/begin COMPU_METHOD m_uw_b6553p5 "" RAT_FUNC "%6.3" "kg/h" COEFFS 0 1 0 0 0 0.1 /end COMPU_METHOD
/begin COMPU_METHOD OneToOne "" RAT_FUNC "%6.2" "-" COEFFS 0 1 0 0 0 1 /end COMPU_METHOD
/begin COMPU_METHOD q1p52588Em6_K "" RAT_FUNC "%8.7" "K" COEFFS 0 655360 0 0 0 1 /end COMPU_METHOD
/begin COMPU_METHOD q9p7656Em4_kJ_DIV_K "" RAT_FUNC "%6.5" "KJ/K" COEFFS 0 1024 0 0 0 1 /end COMPU_METHOD
/begin COMPU_METHOD q_q1p5259Em5_kJ "" RAT_FUNC "%7.6" "kJ" COEFFS 0 65536 0 0 0 1 /end COMPU_METHOD
/begin COMPU_METHOD q_q1_kJ "" RAT_FUNC "%6.2" "kJ" COEFFS 0 1 0 0 0 1 /end COMPU_METHOD
/begin COMPU_METHOD RBPtCel_mf_1p0_1 "" RAT_FUNC "%6.2" "kg/h" COEFFS 0 1 0 0 0 1 /end COMPU_METHOD
/begin COMPU_METHOD relnmot_q768 "" RAT_FUNC "%6.0" "%/min" COEFFS 0 1 0 0 0 768 /end COMPU_METHOD
/begin COMPU_METHOD rel_q0p0234 "" RAT_FUNC "%6.4" "%" COEFFS 0 128 0 0 0 3 /end COMPU_METHOD
/begin COMPU_METHOD rel_q0p78125 "" RAT_FUNC "%6.3" "%" COEFFS 0 256 0 0 0 200 /end COMPU_METHOD
/begin COMPU_METHOD rel_sw_q0p0234 "" RAT_FUNC "%6.4" "%/seg" COEFFS 0 32 0 0 0 0.75 /end COMPU_METHOD
/begin COMPU_METHOD rel_uw_b100 "" RAT_FUNC "%6.4" "%" COEFFS 0 65536 0 0 0 100 /end COMPU_METHOD
/begin COMPU_METHOD rel_uw_b3072 "" RAT_FUNC "%6.4" "%" COEFFS 0 65536 0 0 0 3072 /end COMPU_METHOD
/begin COMPU_METHOD rel_uw_q0p0234 "" RAT_FUNC "%6.4" "%" COEFFS 0 32 0 0 0 0.75 /end COMPU_METHOD
/begin COMPU_METHOD spg_q0p00488 "" RAT_FUNC "%6.4" "V" COEFFS 0 1024 0 0 0 5 /end COMPU_METHOD
/begin COMPU_METHOD t1sxs_uw_q1 "" RAT_FUNC "%6.2" "s" COEFFS 0 1 0 0 0 1 /end COMPU_METHOD
/begin COMPU_METHOD tempr_q1p272Em6 "" RAT_FUNC "%8.7" "1/K" COEFFS 0 786432 0 0 0 1 /end COMPU_METHOD
/begin COMPU_METHOD Temp_Cels "" RAT_FUNC "%6.1" "deg C" COEFFS 0 10 2731.4 0 0 1 /end COMPU_METHOD
/begin COMPU_METHOD temp_q0p1_K "" RAT_FUNC "%6.3" "K" COEFFS 0 10 0 0 0 1 /end COMPU_METHOD
/begin COMPU_METHOD temp_q0p1_o273 "" RAT_FUNC "%6.1" "Grad C" COEFFS 0 10 2731.4 0 0 1 /end COMPU_METHOD
/begin COMPU_METHOD temp_q1p5259Em6_om273 "" RAT_FUNC "%6.1" "°C" COEFFS 0 65536 17900503.04 0 0 0.1 /end COMPU_METHOD
/begin COMPU_METHOD temp_ub_q0p75_o48 "" RAT_FUNC "%6.2" "Grad C" COEFFS 0 1 48 0 0 0.75 /end COMPU_METHOD
/begin COMPU_METHOD t_q0p01 "" RAT_FUNC "%6.4" "s" COEFFS 0 100 0 0 0 1 /end COMPU_METHOD
/begin COMPU_METHOD t_q0p05 "" RAT_FUNC "%6.4" "s" COEFFS 0 100 0 0 0 5 /end COMPU_METHOD
/begin COMPU_METHOD t_q0p1 "" RAT_FUNC "%6.3" "s" COEFFS 0 10 0 0 0 1 /end COMPU_METHOD
/begin COMPU_METHOD t_q1 "" RAT_FUNC "%6.2" "s" COEFFS 0 1 0 0 0 1 /end COMPU_METHOD
/begin COMPU_METHOD Vel "" RAT_FUNC "%6.4" "km/h" COEFFS 0 100 0 0 0 1 /end COMPU_METHOD
/begin COMPU_METHOD vfzg_ub_q1p25 "" RAT_FUNC "%6.2" "km/h" COEFFS 0 1 0 0 0 1.25 /end COMPU_METHOD
/begin COMPU_METHOD vol_q1p5_cm3 "" RAT_FUNC "%6.2" "cm3" COEFFS 0 10 0 0 0 15 /end COMPU_METHOD
/begin COMPU_METHOD zk100msrtemp_q1p589em6 "" RAT_FUNC "%8.7" "1/sK" COEFFS 0 6291456 0 0 0 10 /end COMPU_METHOD
/begin COMPU_METHOD zk50msxs_uw_b3276p8 "" RAT_FUNC "%6.1" "s" COEFFS 0 0 65536 0 20 0 /end COMPU_METHOD
/begin COMPU_METHOD zw_q2p9297Em3_deg_KW "" RAT_FUNC "%6.4" "deg KW" COEFFS 0 1024 0 0 0 3 /end COMPU_METHOD
/begin RECORD_LAYOUT RB_Axis_S16 NO_AXIS_PTS_X 1 SWORD AXIS_PTS_X 2 SWORD INDEX_INCR DIRECT /end RECORD_LAYOUT
/begin RECORD_LAYOUT RB_Axis_U16 NO_AXIS_PTS_X 1 UWORD AXIS_PTS_X 2 UWORD INDEX_INCR DIRECT /end RECORD_LAYOUT
/begin RECORD_LAYOUT RB_CurveGroup_U8 FNC_VALUES 1 UBYTE COLUMN_DIR DIRECT /end RECORD_LAYOUT
/begin RECORD_LAYOUT RB_Curve_R32_U16_Static NO_AXIS_PTS_X 1 ULONG AXIS_PTS_X 2 FLOAT32_IEEE INDEX_INCR DIRECT FNC_VALUES 3 UWORD COLUMN_DIR DIRECT STATIC_RECORD_LAYOUT /end RECORD_LAYOUT
/begin RECORD_LAYOUT RB_Curve_S16_S16 NO_AXIS_PTS_X 1 SWORD AXIS_PTS_X 2 SWORD INDEX_INCR DIRECT FNC_VALUES 3 SWORD COLUMN_DIR DIRECT /end RECORD_LAYOUT
/begin RECORD_LAYOUT RB_Curve_S16_U16_Static NO_AXIS_PTS_X 1 SWORD AXIS_PTS_X 2 SWORD INDEX_INCR DIRECT FNC_VALUES 3 UWORD COLUMN_DIR DIRECT STATIC_RECORD_LAYOUT /end RECORD_LAYOUT
/begin RECORD_LAYOUT RB_Curve_S16_U8_Static NO_AXIS_PTS_X 1 SWORD AXIS_PTS_X 2 SWORD INDEX_INCR DIRECT FNC_VALUES 3 UBYTE COLUMN_DIR DIRECT STATIC_RECORD_LAYOUT /end RECORD_LAYOUT
/begin RECORD_LAYOUT RB_Curve_U16_U16 NO_AXIS_PTS_X 1 UWORD AXIS_PTS_X 2 UWORD INDEX_INCR DIRECT FNC_VALUES 3 UWORD COLUMN_DIR DIRECT /end RECORD_LAYOUT
/begin RECORD_LAYOUT RB_Curve_U16_U8_Static NO_AXIS_PTS_X 1 UWORD AXIS_PTS_X 2 UWORD INDEX_INCR DIRECT FNC_VALUES 3 UBYTE COLUMN_DIR DIRECT STATIC_RECORD_LAYOUT /end RECORD_LAYOUT
/begin RECORD_LAYOUT RB_MapGroup_S16 FNC_VALUES 1 SWORD COLUMN_DIR DIRECT /end RECORD_LAYOUT
/begin RECORD_LAYOUT RB_MapGroup_U16 FNC_VALUES 1 UWORD COLUMN_DIR DIRECT /end RECORD_LAYOUT
/begin RECORD_LAYOUT RB_Map_S16S16_S16 NO_AXIS_PTS_X 1 SWORD NO_AXIS_PTS_Y 2 SWORD AXIS_PTS_X 3 SWORD INDEX_INCR DIRECT AXIS_PTS_Y 4 SWORD INDEX_INCR DIRECT FNC_VALUES 5 SWORD COLUMN_DIR DIRECT /end RECORD_LAYOUT
/begin RECORD_LAYOUT RB_Map_S16S16_U16 NO_AXIS_PTS_X 1 SWORD NO_AXIS_PTS_Y 2 SWORD AXIS_PTS_X 3 SWORD INDEX_INCR DIRECT AXIS_PTS_Y 4 SWORD INDEX_INCR DIRECT FNC_VALUES 5 UWORD COLUMN_DIR DIRECT /end RECORD_LAYOUT
/begin RECORD_LAYOUT RB_Map_S16U16_S16 NO_AXIS_PTS_X 1 SWORD NO_AXIS_PTS_Y 2 SWORD AXIS_PTS_X 3 SWORD INDEX_INCR DIRECT AXIS_PTS_Y 4 UWORD INDEX_INCR DIRECT FNC_VALUES 5 SWORD ROW_DIR DIRECT /end RECORD_LAYOUT
/begin RECORD_LAYOUT RB_Map_S16U16_U16 NO_AXIS_PTS_X 1 SWORD NO_AXIS_PTS_Y 2 SWORD AXIS_PTS_X 3 SWORD INDEX_INCR DIRECT AXIS_PTS_Y 4 UWORD INDEX_INCR DIRECT FNC_VALUES 5 UWORD ROW_DIR DIRECT /end RECORD_LAYOUT
/begin RECORD_LAYOUT RB_Map_U16S16_U16 NO_AXIS_PTS_X 1 UWORD NO_AXIS_PTS_Y 2 UWORD AXIS_PTS_X 3 UWORD INDEX_INCR DIRECT AXIS_PTS_Y 4 SWORD INDEX_INCR DIRECT FNC_VALUES 5 UWORD COLUMN_DIR DIRECT /end RECORD_LAYOUT
/begin RECORD_LAYOUT RB_Map_U16U16_U16 NO_AXIS_PTS_X 1 UWORD NO_AXIS_PTS_Y 2 UWORD AXIS_PTS_X 3 UWORD INDEX_INCR DIRECT AXIS_PTS_Y 4 UWORD INDEX_INCR DIRECT FNC_VALUES 5 UWORD COLUMN_DIR DIRECT /end RECORD_LAYOUT
/begin RECORD_LAYOUT RB_ValA_Wu16 FNC_VALUES 1 UWORD COLUMN_DIR DIRECT /end RECORD_LAYOUT
/begin RECORD_LAYOUT RB_Val_Wr32 FNC_VALUES 1 FLOAT32_IEEE COLUMN_DIR DIRECT /end RECORD_LAYOUT
/begin RECORD_LAYOUT RB_Val_Ws16 FNC_VALUES 1 SWORD COLUMN_DIR DIRECT /end RECORD_LAYOUT
/begin RECORD_LAYOUT RB_Val_Ws32 FNC_VALUES 1 SLONG COLUMN_DIR DIRECT /end RECORD_LAYOUT
/begin RECORD_LAYOUT RB_Val_Wu16 FNC_VALUES 1 UWORD COLUMN_DIR DIRECT /end RECORD_LAYOUT
/begin RECORD_LAYOUT RB_Val_Wu32 FNC_VALUES 1 ULONG COLUMN_DIR DIRECT /end RECORD_LAYOUT
/begin RECORD_LAYOUT RB_Val_Wu8 FNC_VALUES 1 UBYTE COLUMN_DIR DIRECT /end RECORD_LAYOUT
/end MODULE
/end PROJECT
