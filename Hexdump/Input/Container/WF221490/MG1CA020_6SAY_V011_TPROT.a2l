ASAP2_VERSION 1 60
/begin PROJECT MG1CA020 "MG1CA020"
/begin HEADER "" VERSION "MG1CA020_6SAY_V011_TPROT" PROJECT_NO MG1CA020 /end HEADER
/begin MODULE DIM ""
/begin MOD_COMMON "" BYTE_ORDER MSB_LAST ALIGNMENT_BYTE 1 ALIGNMENT_WORD 2 ALIGNMENT_LONG 4 ALIGNMENT_INT64 4 ALIGNMENT_FLOAT32_IEEE 4 ALIGNMENT_FLOAT64_IEEE 4 DATA_SIZE 32 /end MOD_COMMON
/begin CHARACTERISTIC ANZTILRA "min. number of injections for enabling fuel mixture adaptation" VALUE 0x8052F3FE RB_Val_Wu16 65535.00 dez 0.00 65535.00 FORMAT "%8.2" /end CHARACTERISTIC
/begin CHARACTERISTIC CWDMDZAG "code word DMDZAG configuration" VALUE 0x8053B15C Val_Wu8 0.00 OneToOne 3.000 3.000 FORMAT "%5.3" EXTENDED_LIMITS 0.00 255.0 READ_ONLY /end CHARACTERISTIC
/begin CHARACTERISTIC CWFRAINIT "Code word to select different initialization values for multiplicative correction of mixture adaptation" VALUE 0x8052F326 RB_Val_Wu8 255.0 dez 0.00 255.0 FORMAT "%5.1" /end CHARACTERISTIC
/begin CHARACTERISTIC CWLOCONOHK "Codeword for configuration NOx-sensor" VALUE 0x8052F324 RB_Val_Wu8 255.0 dez 0.00 255.0 FORMAT "%5.1" /end CHARACTERISTIC
/begin CHARACTERISTIC CWLRADLSUCHK "Code word for activating the writing of the adaptation values from the last driving cycle" VALUE 0x8052F327 RB_Val_Wu8 255.0 dez 0.00 255.0 FORMAT "%5.1" /end CHARACTERISTIC
/begin CHARACTERISTIC CWLRAEB "code word for mixture adaptation" VALUE 0x8052F400 RB_Val_Wu8 255.0 dez 0.00 255.0 FORMAT "%5.1" /end CHARACTERISTIC
/begin CHARACTERISTIC CWLRAEBORA "codeword to configure additive correction of the mixture adaptation (ORA) enable conditions" VALUE 0x8052F401 RB_Val_Wu8 255.0 dez 0.00 255.0 FORMAT "%5.1" /end CHARACTERISTIC
/begin CHARACTERISTIC CWLRMS "Code word enleanment protection" VALUE 0x8052F48E RB_Val_Wu8 255.0 dez 0.00 255.0 FORMAT "%5.1" /end CHARACTERISTIC
/begin CHARACTERISTIC CWLRS "Code word for function LRS (LRS: continuous lambda control)" VALUE 0x8052F48F RB_Val_Wu8 255.0 dez 0.00 255.0 FORMAT "%5.1" /end CHARACTERISTIC
/begin CHARACTERISTIC CWLRSEB "Code word to enable LRS" VALUE 0x8052F638 RB_Val_Wu8 255.0 dez 0.00 255.0 FORMAT "%5.1" /end CHARACTERISTIC
/begin CHARACTERISTIC CWLRSEB2 "Code word to enable LRS, no. 2" VALUE 0x8052F639 RB_Val_Wu8 255.0 dez 0.00 255.0 FORMAT "%5.1" /end CHARACTERISTIC
/begin CHARACTERISTIC CWMDIST "codeword MDIST - engine torque computation" VALUE 0x8052FAC4 RB_Val_Wu8 255.0 dez 0.00 255.0 FORMAT "%5.1" /end CHARACTERISTIC
/begin CHARACTERISTIC CWMDMAX "codeword in MDMAX" VALUE 0x8052FAD0 RB_Val_Wu8 255.0 dez 0.00 255.0 FORMAT "%5.1" /end CHARACTERISTIC
/begin CHARACTERISTIC CWMDRLMN "configuration (codeword) of MDRLMN" VALUE 0x8052FB52 RB_Val_Wu8 255.0 dez 0.00 255.0 FORMAT "%5.1" /end CHARACTERISTIC
/begin CHARACTERISTIC CWORAP "code word for calculation or consideration additive correction of the mixture adaptation orap_w(Manifold Air Pressure sensor systems)" VALUE 0x8052F328 RB_Val_Wu8 255.0 dez 0.00 255.0 FORMAT "%5.1" /end CHARACTERISTIC
/begin CHARACTERISTIC CWRKANMIL "Codeword to enable additive adaptive correction of the relative fuel amount (rka_w) calculation based on moment and engine speed" VALUE 0x8052F329 RB_Val_Wu8 255.0 dez 0.00 255.0 FORMAT "%5.1" /end CHARACTERISTIC
/begin CHARACTERISTIC CWRKANMOT "Codeword to enable additive adaptive correction of the relative fuel amount (rka_w) calculation based on engine speed(nmot)" VALUE 0x8052F32A RB_Val_Wu8 255.0 dez 0.00 255.0 FORMAT "%5.1" /end CHARACTERISTIC
/begin CHARACTERISTIC DFRAABO "factor for multiplicative correction of the mixture adaptation at start of drive cycle" VALUE 0x8052F32C RB_Val_Wu16 1.999969 fak_uw_b2 0.00 1.999969 FORMAT "%8.6" /end CHARACTERISTIC
/begin CHARACTERISTIC DFRMAX "Maximum limit for delta control factor of lambda control" VALUE 0x8052F490 RB_Val_Ws16 1.999969 fak_sw_b1 -1.000000 0.999969 FORMAT "%8.6" EXTENDED_LIMITS -1.000000 0.9999695 /end CHARACTERISTIC
/begin CHARACTERISTIC DLAHPLRAMN "lower limitation of taking into account the P-component of the lambda controller downstream in fuel mixture adaptation" VALUE 0x8052F32E RB_Val_Ws16 1.999969 fak_sw_b1 -1.000000 0.999969 FORMAT "%8.6" EXTENDED_LIMITS -1.000000 0.9999695 /end CHARACTERISTIC
/begin CHARACTERISTIC DLAHPLRAMX "upper limitation of taking into account the P-component of the lambda controller downstream in fuel mixture adaptation" VALUE 0x8052F330 RB_Val_Ws16 1.999969 fak_sw_b1 -1.000000 0.999969 FORMAT "%8.6" EXTENDED_LIMITS -1.000000 0.9999695 /end CHARACTERISTIC
/begin CHARACTERISTIC DLAMXSA "maximum control error for enabling closed-loop lambda control after fuel cut-off" VALUE 0x8052F63A RB_Val_Wu16 15.99976 fak_uw_b16 0.00 15.99976 FORMAT "%8.5" /end CHARACTERISTIC
/begin CHARACTERISTIC DMDNSM "Torque offset for after cranking compensation" CURVE 0x8052FC18 RB_Curve_U8_U8 99.61 rel_ub_b99p6 0.00 99.61 FORMAT "%5.2"
 /begin AXIS_DESCR STD_AXIS tomdvermot temp_ub_q0p75_o48 8 -48.0 143.3 FORMAT "%5.1" DEPOSIT ABSOLUTE /end AXIS_DESCR
/end CHARACTERISTIC
/begin CHARACTERISTIC DMDSTHZG "delta torque compensation of start with park heating" CURVE 0x8052FC29 RB_Curve_U8_U8 99.61 rel_ub_b99p6 0.00 99.61 FORMAT "%5.2"
 /begin AXIS_DESCR STD_AXIS dtdmdsh temp_ub_q0p75_o48 4 -48.0 143.3 FORMAT "%5.1" DEPOSIT ABSOLUTE /end AXIS_DESCR
/end CHARACTERISTIC
/begin CHARACTERISTIC DMRAA "general torque margin quick trip" VALUE 0x8052FC0A RB_Val_Wu16 99.99847 rel_uw_b100 0.00 99.99847 FORMAT "%8.5" /end CHARACTERISTIC
/begin CHARACTERISTIC DORAABO "factor for additive correction of the mixture adaptation at start of drive cycle" VALUE 0x8052F332 RB_Val_Ws16 3071.953 rel_sw_b1536 -1536.000 1535.953 FORMAT "%8.3" /end CHARACTERISTIC
/begin CHARACTERISTIC EnvP_pDfl_C "Default value for environment pressure" VALUE 0x8052FE4C RB_Val_Ws16 3500.000 Pres_hPa 0.00 3500.000 FORMAT "%8.3" EXTENDED_LIMITS -32768.00 32767.00 /end CHARACTERISTIC
/begin CHARACTERISTIC EnvT_tDfl_C "Default value for temperature of environment air" VALUE 0x8052FE4E RB_Val_Ws16 6553.500 Temp_Cels -3549.940 3003.560 FORMAT "%8.3" /end CHARACTERISTIC
/begin CHARACTERISTIC ExhCo_flgLsfNoxSnsrOptn_CW "Codebit to choose LSF or Nox sensor into consideration." VALUE 0x8052F325 RB_Val_Wu8 1.00000000000 B_TRUE 0.00 1.00000000000 FORMAT "%13.11" /end CHARACTERISTIC
/begin CHARACTERISTIC FFRAKFV "factor for increasing integration speed integrator FRA_IK(Integrator for multiplicative correction of mixture adaptation) in case of error suspicion" VALUE 0x8052F334 RB_Val_Wu16 31.87500 fak_ub_b32 0.00 31.87500 FORMAT "%8.5" EXTENDED_LIMITS 0.00 8191.875 /end CHARACTERISTIC
/begin CHARACTERISTIC FKTMOD "Interpolation factor temperature for drag torque calculation" VALUE 0x8052FC32 RB_Val_Wu8 0.9961 fak_ub_b1 0.00 0.9961 /end CHARACTERISTIC
/begin CHARACTERISTIC FlMA_facAftStrtWrmUp_C "Threshold of factor after start and warm up for mixture adaptation" VALUE 0x8052F402 RB_Val_Wu16 15.99976 fak_uw_b16 0.00 15.99976 FORMAT "%8.5" /end CHARACTERISTIC
/begin CHARACTERISTIC FlMA_stCfgEnaCnd "Codeword to configure the enabling condition of mixture adaptation" VALUE 0x8052F404 RB_Val_Wu8 255.0 dez 0.00 255.0 FORMAT "%5.1" /end CHARACTERISTIC
/begin CHARACTERISTIC FMIISTSTN "Ramp-up factor for actual engine torque during start over engine speed" CURVE 0x8052FAC5 RB_Curve_U8_U8 1.992188 fak_ub_b2 0.00 1.992188 FORMAT "%8.6"
 /begin AXIS_DESCR STD_AXIS NO_INPUT_QUANTITY nmot_q10 5 0.00 2550. FORMAT "%5.0" DEPOSIT ABSOLUTE /end AXIS_DESCR
/end CHARACTERISTIC
/begin CHARACTERISTIC FORAKFV "factor for increasing integration speed integrator ORA_IK(Integrator for additive correction of mixture adaptation) in case of error suspicion" VALUE 0x8052F336 RB_Val_Wu8 31.88 fak_ub_b32 0.00 31.88 FORMAT "%5.2" /end CHARACTERISTIC
/begin CHARACTERISTIC FRADIFF "Threshold of changes in frai_w(multiplicative correction of the mixture adaptation) from last driving cycle when the lamda sensor is not yet OK tested" VALUE 0x8052F338 RB_Val_Wu16 1.999969 fak_uw_b2 0.00 1.999969 FORMAT "%8.6" /end CHARACTERISTIC
/begin CHARACTERISTIC FRAMN "Lower limit for multiplicative correction of the mixture adaptation(fra)" VALUE 0x8052F33A RB_Val_Wu16 1.999969 fak_uw_b2 0.00 1.999969 FORMAT "%8.6" /end CHARACTERISTIC
/begin CHARACTERISTIC FRAMX "Upper limit for multiplicative correction of the mixture adaptation(fra)" VALUE 0x8052F33C RB_Val_Wu16 1.999969 fak_uw_b2 0.00 1.999969 FORMAT "%8.6" /end CHARACTERISTIC
/begin CHARACTERISTIC FRARN "reduced lower limit of correction factor fra" VALUE 0x8052F33E RB_Val_Wu16 1.999969 fak_uw_b2 0.00 1.999969 FORMAT "%8.6" /end CHARACTERISTIC
/begin CHARACTERISTIC FREDMN "Interpolation factor - minimum reduction stage" VALUE 0x8052FB16 RB_Val_Wu8 0.9961 fak_ub_b1 0.00 0.9961 /end CHARACTERISTIC
/begin CHARACTERISTIC FREDMX "Interpolation factor - maximum reduction stage" VALUE 0x8052FB17 RB_Val_Wu8 0.9961 fak_ub_b1 0.00 0.9961 /end CHARACTERISTIC
/begin CHARACTERISTIC FREDTYP "strategy for computation of desired reduction stage (based on specific request)" VALUE 0x8052FB18 RB_Val_Wu8 255.0 dez 0.00 255.0 FORMAT "%5.1" /end CHARACTERISTIC
/begin CHARACTERISTIC FRMAX "Maximum limit for absolute control factor of lambda control" VALUE 0x8052F492 RB_Val_Wu16 1.999969 fak_uw_b2 0.00 1.999969 FORMAT "%8.6" /end CHARACTERISTIC
/begin CHARACTERISTIC FRMIN "Minimum limit for absolute control factor of lambda control" VALUE 0x8052F494 RB_Val_Wu16 1.999969 fak_uw_b2 0.00 1.999969 FORMAT "%8.6" /end CHARACTERISTIC
/begin CHARACTERISTIC FRMINKH "Lean limit of lambda controller in case of catalyst heating with secondary air" VALUE 0x8052F496 RB_Val_Wu16 1.999969 fak_uw_b2 0.00 1.999969 FORMAT "%8.6" /end CHARACTERISTIC
/begin CHARACTERISTIC FVLRAS "threshold for indication of an error suspicion in LRA(Lambda closed loop control; Adaptive pilot control)" VALUE 0x8052F340 RB_Val_Wu16 1.999969 fak_uw_b2 0.00 1.999969 FORMAT "%8.6" /end CHARACTERISTIC
/begin CHARACTERISTIC IMLEVABS "Threshold air mass integral before lambda control enable after cylinder cut-off" VALUE 0x8052F63C RB_Val_Wu16 4660.267 m_uw_b4660 0.00 4660.267 FORMAT "%8.3" /end CHARACTERISTIC
/begin CHARACTERISTIC IMLSALR "Threshold for air mass integral before lambda control is enabled after fuel cut-off" VALUE 0x8052F63E RB_Val_Wu16 4660.267 m_uw_b4660 0.00 4660.267 FORMAT "%8.3" /end CHARACTERISTIC
/begin CHARACTERISTIC IMTEFVDFRM "minimum canister purge mass for error suspicion via dfrm_w(deviation of fast lambda controller mean value from 1.0)" VALUE 0x8052F342 RB_Val_Wu8 11.32 m_ub_q0p0444 0.00 11.32 FORMAT "%5.2" /end CHARACTERISTIC
/begin CHARACTERISTIC INITFRA "Initialization value of FRA(multiplicative mixture adaptation factor)" VALUE 0x8052F344 RB_Val_Wu16 1.999969 fak_uw_b2 0.00 1.999969 FORMAT "%8.6" /end CHARACTERISTIC
/begin CHARACTERISTIC INITORA "Initialization value of ORA(additive correction of mixture adaptation)" VALUE 0x8052F346 RB_Val_Ws16 3071.953 rel_sw_b1536 -1536.000 1535.953 FORMAT "%8.3" /end CHARACTERISTIC
/begin CHARACTERISTIC KFETAVFZG "Interpolation factor lower base point depending on vehicle speed/accelerator pedal angle" MAP 0x8052FB54 RB_Map_S16S16_U8 0.9961 fak_ub_b1 0.00 0.9961
 /begin AXIS_DESCR STD_AXIS VehV_v Vel 4 -327.6800 327.6700 FORMAT "%8.4" DEPOSIT ABSOLUTE /end AXIS_DESCR
 /begin AXIS_DESCR STD_AXIS APP_r Prc 4 -400.0000 399.9878 FORMAT "%8.4" DEPOSIT ABSOLUTE /end AXIS_DESCR
/end CHARACTERISTIC
/begin CHARACTERISTIC KFLRSSIG "Map of controller gain sigma for continuous lambda control" MAP 0x8052F498 RB_MapGroup_U8 2.550 fak_q0p01 0.00 2.550 FORMAT "%5.3"
 /begin AXIS_DESCR COM_AXIS LamCtrl_nEngESPLANT nmot_uw_q0p25 7 0.00 16383.75 FORMAT "%8.2" AXIS_PTS_REF SNM07LSUW /end AXIS_DESCR
 /begin AXIS_DESCR COM_AXIS LamCtrl_ratFillgPlaPrm rel_uw_q0p0234 8 0.00 1535.977 FORMAT "%8.3" AXIS_PTS_REF SRL08LSUW /end AXIS_DESCR
/end CHARACTERISTIC
/begin CHARACTERISTIC KFMDS "map for engine drag torque" MAP 0x8052FC34 RB_MapGroup_U16 99.99847 rel_uw_b100 0.00 99.99847 FORMAT "%8.5"
 /begin AXIS_DESCR COM_AXIS NO_INPUT_QUANTITY nmot_uw_q0p25 16 0.00 16383.75 FORMAT "%8.2" AXIS_PTS_REF SNM16_UW /end AXIS_DESCR
 /begin AXIS_DESCR COM_AXIS dpsu_w_msg p_sw_q0p078 11 -2560.000 2559.922 FORMAT "%8.3" AXIS_PTS_REF SPS11MDSW /end AXIS_DESCR
/end CHARACTERISTIC
/begin CHARACTERISTIC KFMDSM "temperature share of drag torque" MAP 0x8052FD94 RB_Map_U8U16_U16 99.99847 rel_uw_b100 0.00 99.99847 FORMAT "%8.5"
 /begin AXIS_DESCR STD_AXIS tsmdvermot temp_ub_q0p75_o48 3 -48.0 143.3 FORMAT "%5.1" DEPOSIT ABSOLUTE /end AXIS_DESCR
 /begin AXIS_DESCR STD_AXIS tmotlok temp_ub_q0p75_o48 10 -48.00 49103.25 FORMAT "%8.2" DEPOSIT ABSOLUTE /end AXIS_DESCR
/end CHARACTERISTIC
/begin CHARACTERISTIC KFMIOP "map optimum engine torque" MAP 0x8052F6C4 RB_Map_U16U16_U16 99.99847 rel_uw_b100 0.00 99.99847 FORMAT "%8.5"
 /begin AXIS_DESCR STD_AXIS NO_INPUT_QUANTITY nmot_uw_q0p25 16 0.00 16383.75 FORMAT "%8.2" DEPOSIT ABSOLUTE /end AXIS_DESCR
 /begin AXIS_DESCR STD_AXIS NO_INPUT_QUANTITY rel_uw_q0p0234 14 0.00 1535.977 FORMAT "%8.3" DEPOSIT ABSOLUTE /end AXIS_DESCR
/end CHARACTERISTIC
/begin CHARACTERISTIC KFMIRL "map for calculation of nominal charge" MAP 0x8052F8C4 RB_Map_U16U16_U16 1535.977 rel_uw_q0p0234 0.00 1535.977 FORMAT "%8.3"
 /begin AXIS_DESCR STD_AXIS NO_INPUT_QUANTITY nmot_uw_q0p25 16 0.00 16383.75 FORMAT "%8.2" DEPOSIT ABSOLUTE /end AXIS_DESCR
 /begin AXIS_DESCR STD_AXIS NO_INPUT_QUANTITY rel_uw_b100 14 0.00 99.99847 FORMAT "%8.5" DEPOSIT ABSOLUTE /end AXIS_DESCR
/end CHARACTERISTIC
/begin CHARACTERISTIC KFRKANMIL "Characteristic map to calculate the moment - engine speed dependent weighting factor of ora_w(Additive correction of mixture adaptation)" MAP 0x8052F348 RB_Map_U8U16_U16 1.999969 fak_uw_b2 0.00 1.999969 FORMAT "%8.6"
 /begin AXIS_DESCR STD_AXIS FlMA_nEng nmot_ub_q40 6 0.00 10200. FORMAT "%5.0" DEPOSIT ABSOLUTE /end AXIS_DESCR
 /begin AXIS_DESCR STD_AXIS milsol_w_msg rel_uw_b100 6 0.00 99.99847 FORMAT "%8.5" DEPOSIT ABSOLUTE /end AXIS_DESCR
/end CHARACTERISTIC
/begin CHARACTERISTIC KFTETAMIMN "filter time constant for computation of min. indicated torque (lower base)" MAP 0x8052FB78 RB_Map_U16U16_U16 655.3400 t_q0p01 0.0100 655.3500 FORMAT "%8.4" EXTENDED_LIMITS 0.00 655.3500
 /begin AXIS_DESCR STD_AXIS TME_nAvrgEngSpdLoc EngN 5 0.00 16383.50 FORMAT "%8.2" EXTENDED_LIMITS 0.00 32767.50 DEPOSIT ABSOLUTE /end AXIS_DESCR
 /begin AXIS_DESCR STD_AXIS drlmn_w rel_uw_q0p0234 5 0.00 1535.977 FORMAT "%8.3" DEPOSIT ABSOLUTE /end AXIS_DESCR
/end CHARACTERISTIC
/begin CHARACTERISTIC KLDFRKFRAK "Integration speed of integrator FRA_IK(Multiplicative correction of mixture adaptation integrator) depending on absolute value of corrected deviation of the fast lambda controller mean value (dfrmk_w)" CURVE 0x8052F3A4 RB_Curve_U16_U16 4.999924 q7p63Em5_DIV_s 0.00 4.999924 FORMAT "%8.6"
 /begin AXIS_DESCR STD_AXIS dfrmkb_w fak_uw_b2 6 0.00 1.999969 FORMAT "%8.6" DEPOSIT ABSOLUTE /end AXIS_DESCR
/end CHARACTERISTIC
/begin CHARACTERISTIC KLDFRKORAK "Integration speed of integrator ORA_IK(Additive correction of mixture adaptation integrator) depending on absolute value of corrected deviation of the fast lambda controller mean value (dfrmk_w)" CURVE 0x8052F3BE RB_Curve_U16_U16 3839.941 q0p0586_pc_DIV_s 0.00 3839.941 FORMAT "%8.3"
 /begin AXIS_DESCR STD_AXIS dfrmkb_w fak_uw_b2 6 0.00 1.999969 FORMAT "%8.6" DEPOSIT ABSOLUTE /end AXIS_DESCR
/end CHARACTERISTIC
/begin CHARACTERISTIC KLETADRLMN "Interpolation factor for minimum ignition angle eta" CURVE 0x8052FBC2 RB_Curve_U16_U8_Static 0.9961 fak_ub_b1 0.00 0.9961
 /begin AXIS_DESCR STD_AXIS drlmn_w rel_uw_q0p0234 6 0.00 1535.977 FORMAT "%8.3" DEPOSIT ABSOLUTE /end AXIS_DESCR
/end CHARACTERISTIC
/begin CHARACTERISTIC KLETAMN "minimum ignition angle effectiveness at minimun air charge" CURVE 0x8052FBD6 RB_Curve_S16_U16_Static 1.000000 fak_uw_b2 0.00 1.000000 FORMAT "%8.6" EXTENDED_LIMITS 0.00 1.999969
 /begin AXIS_DESCR STD_AXIS Epm_nEng EngN 6 -16384.00 16383.50 FORMAT "%8.2" DEPOSIT ABSOLUTE /end AXIS_DESCR
/end CHARACTERISTIC
/begin CHARACTERISTIC KLETAMNLL "minimum ignition angle effectiveness at minimun air charge" CURVE 0x8052FBF0 RB_Curve_S16_U16_Static 1.000000 fak_uw_b2 0.00 1.000000 FORMAT "%8.6" EXTENDED_LIMITS 0.00 1.999969
 /begin AXIS_DESCR STD_AXIS Epm_nEng EngN 6 -16384.00 16383.50 FORMAT "%8.2" DEPOSIT ABSOLUTE /end AXIS_DESCR
/end CHARACTERISTIC
/begin CHARACTERISTIC KLETAVGMN "Lookup table minimum defined efficiency" CURVE 0x8052FAD2 RB_Curve_U16_U16 1.000000 fak_uw_b2 0.00 1.000000 FORMAT "%8.6" EXTENDED_LIMITS 0.00 1.999969
 /begin AXIS_DESCR STD_AXIS NO_INPUT_QUANTITY nmot_uw_q0p25 16 0.00 16383.75 FORMAT "%8.2" DEPOSIT ABSOLUTE /end AXIS_DESCR
/end CHARACTERISTIC
/begin CHARACTERISTIC KLFRAMILH "Upper limit area for fra(multiplicative mixture adaptation factor)" CURVE 0x8052F406 RB_Curve_U8_U16_Static 99.99847 rel_uw_b100 0.00 99.99847 FORMAT "%8.5"
 /begin AXIS_DESCR STD_AXIS FlMA_nEngLRes nmot_ub_q40 4 0.00 10200. FORMAT "%5.0" DEPOSIT ABSOLUTE /end AXIS_DESCR
/end CHARACTERISTIC
/begin CHARACTERISTIC KLFRAMILL "Lower limit area for fra(multiplicative mixture adaptation factor)" CURVE 0x8052F414 RB_Curve_U8_U16_Static 99.99847 rel_uw_b100 0.00 99.99847 FORMAT "%8.5"
 /begin AXIS_DESCR STD_AXIS FlMA_nEngLRes nmot_ub_q40 4 0.00 10200. FORMAT "%5.0" DEPOSIT ABSOLUTE /end AXIS_DESCR
/end CHARACTERISTIC
/begin CHARACTERISTIC KLFRKANMOT "Characteristic curve to determine the weighing factor based on engine speed for rka_w(additive adaptive correction of the relative fuel amount) calculation." CURVE 0x8052F3D8 RB_Curve_U8_U16_Static 1.999969 fak_uw_b2 0.00 1.999969 FORMAT "%8.6"
 /begin AXIS_DESCR STD_AXIS FlMA_nEng nmot_ub_q40 8 0.00 10200. FORMAT "%5.0" DEPOSIT ABSOLUTE /end AXIS_DESCR
/end CHARACTERISTIC
/begin CHARACTERISTIC KLLRUW "debouncing anti windup" CURVE 0x8052F4D0 RB_Curve_U16_U16 655.3500 t_q0p01 0.00 655.3500 FORMAT "%8.4"
 /begin AXIS_DESCR STD_AXIS LamCtrl_mfExhB1 m_uw_b6553p5 2 0.00 6553.500 FORMAT "%8.3" DEPOSIT ABSOLUTE /end AXIS_DESCR
/end CHARACTERISTIC
/begin CHARACTERISTIC KLMRKFHO "Correctionb factor altitude depending torque reserve" CURVE 0x8052FC0C RB_Curve_U16_U8_Static 15.94 fak_ub_b16 0.00 15.94 FORMAT "%5.2"
 /begin AXIS_DESCR STD_AXIS PEnv_facCorrAlti fak_uw_b4 3 0.00 3.999939 FORMAT "%8.6" DEPOSIT ABSOLUTE /end AXIS_DESCR
/end CHARACTERISTIC
/begin CHARACTERISTIC KLORAMILH "Upper limit area for ora(additive correction of mixture adaptation)" CURVE 0x8052F422 RB_Curve_U8_U16_Static 99.99847 rel_uw_b100 0.00 99.99847 FORMAT "%8.5"
 /begin AXIS_DESCR STD_AXIS FlMA_nEngLRes nmot_ub_q40 4 0.00 10200. FORMAT "%5.0" DEPOSIT ABSOLUTE /end AXIS_DESCR
/end CHARACTERISTIC
/begin CHARACTERISTIC KLORAMILHF "Upper limit area for ora(additive correction of mixture adaptation) in case of error suspicion for Pressure sensor offset." CURVE 0x8052F430 RB_Curve_U8_U16_Static 99.99847 rel_uw_b100 0.00 99.99847 FORMAT "%8.5"
 /begin AXIS_DESCR STD_AXIS FlMA_nEngLRes nmot_ub_q40 4 0.00 10200. FORMAT "%5.0" DEPOSIT ABSOLUTE /end AXIS_DESCR
/end CHARACTERISTIC
/begin CHARACTERISTIC KLORAMILL "Lower limit area for ora(additive correction of mixture adaptation)" CURVE 0x8052F43E RB_Curve_U8_U16_Static 99.99847 rel_uw_b100 0.00 99.99847 FORMAT "%8.5"
 /begin AXIS_DESCR STD_AXIS FlMA_nEngLRes nmot_ub_q40 4 0.00 10200. FORMAT "%5.0" DEPOSIT ABSOLUTE /end AXIS_DESCR
/end CHARACTERISTIC
/begin CHARACTERISTIC KLREDNMX "maximum reduction step for sequential fuel cutoff (depending on gear), engine speed limitation" CURVE 0x8052FB19 RB_FixCurve_S8_S8 24.00 dez 0.00 24.00 FORMAT "%5.2" EXTENDED_LIMITS -128.0 127.0
 /begin AXIS_DESCR FIX_AXIS Tra_numGear OneToOne 11 -1.000 9.000 FORMAT "%5.3" FIX_AXIS_PAR -1 0 11 /end AXIS_DESCR
/end CHARACTERISTIC
/begin CHARACTERISTIC KLTMRAA "cut-in temperature adaptive precontrol for lambda closed-loop control" CURVE 0x8052F44C RB_Curve_U8_U8 191.3 temp_ub_q0p75_o48 -48.0 143.3 FORMAT "%5.1"
 /begin AXIS_DESCR STD_AXIS FlMA_tCEngDsStrt temp_ub_q0p75_o48 8 -48.0 143.3 FORMAT "%5.1" DEPOSIT ABSOLUTE /end AXIS_DESCR
/end CHARACTERISTIC
/begin CHARACTERISTIC KWTFRAMX "Start value: active Phase FRA" VALUE 0x8052F470 RB_Val_Wu16 13107.00 t_q0p2 0.00 13107.00 FORMAT "%8.2" /end CHARACTERISTIC
/begin CHARACTERISTIC KWTORAMX "Start value: active Phase ORA" VALUE 0x8052F472 RB_Val_Wu16 13107.00 t_q0p2 0.00 13107.00 FORMAT "%8.2" /end CHARACTERISTIC
/begin CHARACTERISTIC KWTPFRAMX "Start value: pause phase FRA" VALUE 0x8052F474 RB_Val_Wu16 13107.00 t_q0p2 0.00 13107.00 FORMAT "%8.2" /end CHARACTERISTIC
/begin CHARACTERISTIC KWTPORAMX "Start value: pause phase ORA" VALUE 0x8052F476 RB_Val_Wu16 13107.00 t_q0p2 0.00 13107.00 FORMAT "%8.2" /end CHARACTERISTIC
/begin CHARACTERISTIC LADIFFTHR "Threshold of absolute lambda difference for reset of lambda control due to enleanment protection" VALUE 0x8052F4DA RB_Val_Wu16 1.999969 fak_uw_b2 0.00 1.999969 FORMAT "%8.6" /end CHARACTERISTIC
/begin CHARACTERISTIC LALIUSMN "minimum measurable lambda" VALUE 0x8052F4DC RB_Val_Wu16 15.99976 fak_uw_b16 0.00 15.99976 FORMAT "%8.5" /end CHARACTERISTIC
/begin CHARACTERISTIC LamCtrl_dfacCtrlDeltaLimCtrl_C "Slope to ramp down control factor of lambda control during limit control (i.e. physical lambda value and lambda setpoint are smaller than the minimal measurable lambda value)" VALUE 0x8052F4DE RB_Val_Ws16 0.9999695 freq_q3p0518Em5 0.00 0.9999695 FORMAT "%9.7" EXTENDED_LIMITS -1.000000 0.9999695 /end CHARACTERISTIC
/begin CHARACTERISTIC LamCtrl_facCtrlDeltaMaxEnlnmtProtB1_T "Maximum limit for delta control factor of lambda control during enleanment protection depending on current delta control factor, bank 1" CURVE 0x8052F4E0 RB_Curve_S16_S16 1.999969 fak_sw_b1 -1.000000 0.999969 FORMAT "%8.6" EXTENDED_LIMITS -1.000000 0.9999695
 /begin AXIS_DESCR STD_AXIS LamCtrl_facCtrlDeltaEnlnmtProtB1 fak_sw_b1 7 -1.000000 0.999969 FORMAT "%8.6" EXTENDED_LIMITS -1.000000 0.9999695 DEPOSIT ABSOLUTE /end AXIS_DESCR
/end CHARACTERISTIC
/begin CHARACTERISTIC LamCtrl_facCtrlDeltaMinEnlnmtProtB1_T "Minimum limit for delta control factor of lambda control during enleanment protection depending on current delta control factor, bank 1" CURVE 0x8052F4FE RB_Curve_S16_S16 1.999969 fak_sw_b1 -1.000000 0.999969 FORMAT "%8.6" EXTENDED_LIMITS -1.000000 0.9999695
 /begin AXIS_DESCR STD_AXIS LamCtrl_facCtrlDeltaEnlnmtProtB1 fak_sw_b1 7 -1.000000 0.999969 FORMAT "%8.6" EXTENDED_LIMITS -1.000000 0.9999695 DEPOSIT ABSOLUTE /end AXIS_DESCR
/end CHARACTERISTIC
/begin CHARACTERISTIC LamCtrl_facMinLim_M "Minimum limit for absolute control factor of lambda control" MAP 0x8052F51C RB_Map_U8U16_U16 1.999969 fak_uw_b2 0.00 1.999969 FORMAT "%8.6"
 /begin AXIS_DESCR STD_AXIS LamCtrl_tCEngDs temp_ub_q0p75_o48 5 -48.0 143.3 FORMAT "%5.1" DEPOSIT ABSOLUTE /end AXIS_DESCR
 /begin AXIS_DESCR STD_AXIS LamCtrl_tiAftStrtEnd t_q0p01 4 0.00 655.3500 FORMAT "%8.4" DEPOSIT ABSOLUTE /end AXIS_DESCR
/end CHARACTERISTIC
/begin CHARACTERISTIC LamCtrl_facSigmaIdleCtrlB1_M "Robustness factor sigma during active idle speed governor, bank 1" MAP 0x8052F554 RB_Map_U8U16_U8 2.550 fak_q0p01 0.00 2.550 FORMAT "%5.3"
 /begin AXIS_DESCR STD_AXIS LamCtrl_nEngLResLRS nmot_ub_q40 4 0.00 10200. FORMAT "%5.0" DEPOSIT ABSOLUTE /end AXIS_DESCR
 /begin AXIS_DESCR STD_AXIS LamCtrl_ratFillgLRS rel_uw_q0p0234 4 0.00 1535.977 FORMAT "%8.3" DEPOSIT ABSOLUTE /end AXIS_DESCR
/end CHARACTERISTIC
/begin CHARACTERISTIC LamCtrl_facVCtrlDif_T "Factor for controller velocity dependent on control difference" CURVE 0x8052F572 RB_Curve_S16_U8_Static 1.992188 fak_ub_b2 0.00 1.992188 FORMAT "%8.6"
 /begin AXIS_DESCR STD_AXIS LamCtrl_ratLamDifPrelB1 fak_sw_b1 5 -1.000000 0.999969 FORMAT "%8.6" EXTENDED_LIMITS -1.000000 0.9999695 DEPOSIT ABSOLUTE /end AXIS_DESCR
/end CHARACTERISTIC
/begin CHARACTERISTIC LamCtrl_facVDlyAdpn_T "Factor for lambda controller velocity at adapted delay time dependent on delay time ratio" CURVE 0x8052F584 RB_Curve_U16_U8_Static 1.992188 fak_ub_b2 0.00 1.992188 FORMAT "%8.6"
 /begin AXIS_DESCR STD_AXIS LamCtrl_ratDlyTiB1 t_q0p01 4 0.00 655.3500 FORMAT "%8.4" DEPOSIT ABSOLUTE /end AXIS_DESCR
/end CHARACTERISTIC
/begin CHARACTERISTIC LamCtrl_facVTranAdpn_C "Factor for lambda controller velocity at adapted transition time" VALUE 0x8052F592 RB_Val_Wu8 1.992188 fak_ub_b2 0.00 1.992188 FORMAT "%8.6" /end CHARACTERISTIC
/begin CHARACTERISTIC LamCtrl_facVTranAdpn_T "Factor for lambda controller velocity at adapted transition time dependent on transition time ratio" CURVE 0x8052F594 RB_Curve_U16_U8_Static 1.992188 fak_ub_b2 0.00 1.992188 FORMAT "%8.6"
 /begin AXIS_DESCR STD_AXIS LamCtrl_ratTranTiB1 t_q0p01 4 0.00 655.3500 FORMAT "%8.4" DEPOSIT ABSOLUTE /end AXIS_DESCR
/end CHARACTERISTIC
/begin CHARACTERISTIC LamCtrl_flgEnaWrmUpAirM_CW "Code bit to activate air mass based controller enabling during warm-up" VALUE 0x8052F640 RB_Val_Wu8 1.00000000000 B_TRUE 0.00 1.00000000000 FORMAT "%13.11" /end CHARACTERISTIC
/begin CHARACTERISTIC LamCtrl_mAirEnaWrmUpHotStrt_C "Air mass threshold to enable controller during warm-up at hot start" VALUE 0x8052F642 RB_Val_Wu16 1820.417 m_q0p0277_g 0.00 1820.417 FORMAT "%8.3" /end CHARACTERISTIC
/begin CHARACTERISTIC LamCtrl_mAirEnaWrmUpSpst_T "Air mass threshold to enable controller during warm-up after start-stop" CURVE 0x8052F644 RB_Curve_U8_U16_Static 1820.417 m_q0p0277_g 0.00 1820.417 FORMAT "%8.3"
 /begin AXIS_DESCR STD_AXIS LamCtrl_tEngStrtWrmUp temp_ub_q0p75_o48 5 -48.0 143.3 FORMAT "%5.1" DEPOSIT ABSOLUTE /end AXIS_DESCR
/end CHARACTERISTIC
/begin CHARACTERISTIC LamCtrl_mAirEnaWrmUp_T "Air mass threshold to enable controller during warm-up" CURVE 0x8052F654 RB_Curve_U8_U16_Static 1820.417 m_q0p0277_g 0.00 1820.417 FORMAT "%8.3"
 /begin AXIS_DESCR STD_AXIS LamCtrl_tEngStrtWrmUp temp_ub_q0p75_o48 5 -48.0 143.3 FORMAT "%5.1" DEPOSIT ABSOLUTE /end AXIS_DESCR
/end CHARACTERISTIC
/begin CHARACTERISTIC LamCtrl_ratLamSpCorrnB1_M "Correction of the lambda setpoint for the continuous lambda controller" MAP 0x8052F5A2 RB_Map_U8U16_S8 0.06226 fak_sb_b0p03125 -0.03125 0.03101 FORMAT "%7.5"
 /begin AXIS_DESCR STD_AXIS LamCtrl_nEngLResLRS nmot_ub_q40 10 0.00 10200. FORMAT "%5.0" DEPOSIT ABSOLUTE /end AXIS_DESCR
 /begin AXIS_DESCR STD_AXIS LamCtrl_ratFillgLRS rel_uw_q0p0234 10 0.00 1535.977 FORMAT "%8.3" DEPOSIT ABSOLUTE /end AXIS_DESCR
/end CHARACTERISTIC
/begin CHARACTERISTIC LamCtrl_tiDlyEnagPlaFco_C "Additional delay time (additive) to plant parameters to enable closed-loop control after fuel cut-off" VALUE 0x8052F664 RB_Val_Wu16 6553.500 t_q0p1 0.00 6553.500 FORMAT "%8.3" /end CHARACTERISTIC
/begin CHARACTERISTIC LamCtrl_tiEnlnmtProtLrgVlvLft_C "Switch-on time of enleament protection after switching to large valve lift" VALUE 0x8052F666 RB_Val_Wu16 655.3500 t_q0p01 0.00 655.3500 FORMAT "%8.4" /end CHARACTERISTIC
/begin CHARACTERISTIC LamCtrl_tiEnlnmtProtSmlVlvLft_C "Switch-on time of enleanment protection after switching to small valve lift" VALUE 0x8052F668 RB_Val_Wu16 655.3500 t_q0p01 0.00 655.3500 FORMAT "%8.4" /end CHARACTERISTIC
/begin CHARACTERISTIC LamCtrl_tiRampDe_T "curve for ramp up time for control deviation after turn on" CURVE 0x8052F626 RB_Curve_U16_U16 655.3400 t_q0p01 0.0100 655.3500 FORMAT "%8.4" EXTENDED_LIMITS 0.00 655.3500
 /begin AXIS_DESCR STD_AXIS LamCtrl_tiAdpnMaxS1B1 t_q0p01 4 0.00 655.3500 FORMAT "%8.4" DEPOSIT ABSOLUTE /end AXIS_DESCR
/end CHARACTERISTIC
/begin CHARACTERISTIC LAMGAFVMN "minimum of lambda threshold (error suspicion) for mixture adaptation active" VALUE 0x8052F45E RB_Val_Wu16 15.99976 fak_uw_b16 0.00 15.99976 FORMAT "%8.5" /end CHARACTERISTIC
/begin CHARACTERISTIC LAMGAMN "minimum of lambda threshold for mixture adaptation active" VALUE 0x8052F460 RB_Val_Wu16 15.99976 fak_uw_b16 0.00 15.99976 FORMAT "%8.5" /end CHARACTERISTIC
/begin CHARACTERISTIC LAMGAMX "maximum of lambda threshold for mixture adaptation active" VALUE 0x8052F462 RB_Val_Wu16 15.99976 fak_uw_b16 0.00 15.99976 FORMAT "%8.5" /end CHARACTERISTIC
/begin CHARACTERISTIC LsComp_bLossCmpActvd_C "State of compensation of the switchable losses (False=OFF, True=ON)" VALUE 0x8052F6BC RB_Val_Wu8 1.00000000000 B_TRUE 0.00 1.00000000000 FORMAT "%13.11" /end CHARACTERISTIC
/begin CHARACTERISTIC LsComp_tiFlt_C "filter time constant of the DT1-filters" VALUE 0x8052F6C0 RB_Val_Ws32 4294.9672940000000 TimeDelay_s 0.0000020000000 4294.9672959999998 FORMAT "%19.14" EXTENDED_LIMITS 0.000002000000001 4294.9672959999998 /end CHARACTERISTIC
/begin CHARACTERISTIC MDSH "Part of the resistant torque depending on altitude" CURVE 0x8052FDEA RB_Curve_U8_S8_Static 49.80 rel_q0p1953 -25.00 24.80 FORMAT "%5.2"
 /begin AXIS_DESCR STD_AXIS NO_INPUT_QUANTITY fak_ub_b4 6 0.00 3.984 FORMAT "%5.3" DEPOSIT ABSOLUTE /end AXIS_DESCR
/end CHARACTERISTIC
/begin CHARACTERISTIC MILLmp_stMILCfg_CW "configuration parameter for the MIL control" VALUE 0x8053B158 Val_Wu8 255.0 OneToOne 0.00 255.0 FORMAT "%5.1" /end CHARACTERISTIC
/begin CHARACTERISTIC MILLmp_tiAftStrt_C "time for MIL_ON after engine start" VALUE 0x8053B159 Val_Wu8 254.0 t1sxs_q1 1.0 255.0 FORMAT "%5.1" EXTENDED_LIMITS 0.00 255.0 /end CHARACTERISTIC
/begin CHARACTERISTIC MILLmp_tiRdnBln_C "time for Readiness-Blinking" VALUE 0x8053B15A Val_Wu8 5.000 t1sxs_q1 5.00 10.00 FORMAT "%5.2" EXTENDED_LIMITS 0.00 255.0 /end CHARACTERISTIC
/begin CHARACTERISTIC MILLmp_tiVisTst_C "time for function test of the MIL" VALUE 0x8053B15B Val_Wu8 5.000 t1sxs_q1 15.00 20.00 FORMAT "%5.2" EXTENDED_LIMITS 0.00 255.0 /end CHARACTERISTIC
/begin CHARACTERISTIC MisfDet_nSetPLoDiffMax_C "maximum low idle control deviation for detection of open drivetrain" VALUE 0x80530858 RB_Val_Ws16 32767.50 EngN -16384.00 16383.50 FORMAT "%8.2" /end CHARACTERISTIC
/begin CHARACTERISTIC MisfDet_openPtDlyCntr_C "Debouncing for detection of open drive train" VALUE 0x8053085A RB_Val_Wu8 255.0 OneToOne 0.00 255.0 FORMAT "%5.1" /end CHARACTERISTIC
/begin CHARACTERISTIC MisfDet_redStgDly_C "delay of informatino of reduction stage for calculation of torque" VALUE 0x8053085B RB_Val_Wu8 4.000 OneToOne 0.00 4.000 FORMAT "%5.3" EXTENDED_LIMITS 0.00 255.0 /end CHARACTERISTIC
/begin CHARACTERISTIC MisfDet_stCfgOpenPt_C "configuration switch for detection of open drive train" VALUE 0x8053085C RB_Val_Wu8 255.0 OneToOne 0.00 255.0 FORMAT "%5.1" /end CHARACTERISTIC
/begin CHARACTERISTIC MisfDet_stCmnMiscCfg_C "configuration switch CmnMisc" VALUE 0x8053085D RB_Val_Wu8 255.0 OneToOne 0.00 255.0 FORMAT "%5.1" /end CHARACTERISTIC
/begin CHARACTERISTIC MisfDet_tqNrm_C "normalisation torque" VALUE 0x8053085E RB_Val_Ws16 6553.500 Trq -3276.800 3276.700 FORMAT "%8.3" /end CHARACTERISTIC
/begin CHARACTERISTIC N0 "conversion constant for calculation of the mixture correction rka_w(additive adaptive correction of the relative fuel amount)" VALUE 0x8052F3F2 RB_Val_Wu8 10200. nmot_ub_q40 0.00 10200. FORMAT "%5.0" /end CHARACTERISTIC
/begin CHARACTERISTIC NOLRA "codeword for release of adaptation" VALUE 0x8052F464 RB_Val_Wu8 255.0 dez 0.00 255.0 FORMAT "%5.1" /end CHARACTERISTIC
/begin CHARACTERISTIC NRKAB "minimum engine speed limitation for rka_w(additive adaptive correction of the relative fuel amount) correction." VALUE 0x8052F3F3 RB_Val_Wu8 10200. nmot_ub_q40 0.00 10200. FORMAT "%5.0" /end CHARACTERISTIC
/begin CHARACTERISTIC ORAMN "Lower threshold for additive correction of the mixture adaptation" VALUE 0x8052F3F4 RB_Val_Ws16 3071.953 rel_sw_b1536 -1536.000 1535.953 FORMAT "%8.3" /end CHARACTERISTIC
/begin CHARACTERISTIC ORAMX "Upper threshold for additive correction of the mixture adaptation" VALUE 0x8052F3F6 RB_Val_Ws16 3071.953 rel_sw_b1536 -1536.000 1535.953 FORMAT "%8.3" /end CHARACTERISTIC
/begin CHARACTERISTIC ORARN "reduced lower threshold of additive correction" VALUE 0x8052F3F8 RB_Val_Ws16 3071.953 rel_sw_b1536 -1536.000 1535.953 FORMAT "%8.3" /end CHARACTERISTIC
/begin CHARACTERISTIC ORASPV "Vehicle speed threshold to disable additive fuel mixture adaptation learning" VALUE 0x8052F466 RB_Val_Wu16 511.9922 vfzg_uw_b512 0.00 511.9922 FORMAT "%8.4" /end CHARACTERISTIC
/begin CHARACTERISTIC PHUFRAHP "physical urgentcy fra high priority" VALUE 0x8052F478 RB_Val_Wu8 255.0 dez 0.00 255.0 FORMAT "%5.1" /end CHARACTERISTIC
/begin CHARACTERISTIC PHUFRALP "Physical urgency fra low priority" VALUE 0x8052F479 RB_Val_Wu8 255.0 dez 0.00 255.0 FORMAT "%5.1" /end CHARACTERISTIC
/begin CHARACTERISTIC PHUORAHP "Physical urgentcy high priority" VALUE 0x8052F47A RB_Val_Wu8 255.0 dez 0.00 255.0 FORMAT "%5.1" /end CHARACTERISTIC
/begin CHARACTERISTIC PHUORALP "Physical urgentcy low priority" VALUE 0x8052F47B RB_Val_Wu8 255.0 dez 0.00 255.0 FORMAT "%5.1" /end CHARACTERISTIC
/begin CHARACTERISTIC REDHYOC "hysteresis of reduction step at bigger desired red. step than actual value" VALUE 0x8052FB24 RB_Val_Ws8 1.992 fak_sb_b1 -1.000 0.992 FORMAT "%5.3" EXTENDED_LIMITS -1.000 0.9922 /end CHARACTERISTIC
/begin CHARACTERISTIC REDHYOCESP "hysteresis of reduction step at bigger desired red. step than actual value during ESP-intervention" VALUE 0x8052FB25 RB_Val_Ws8 1.992 fak_sb_b1 -1.000 0.992 FORMAT "%5.3" EXTENDED_LIMITS -1.000 0.9922 /end CHARACTERISTIC
/begin CHARACTERISTIC REDHYOCGSN "hysteresis of reduction step at bigger desired red. step than actual value during gear shift" VALUE 0x8052FB26 RB_Val_Ws8 1.992 fak_sb_b1 -1.000 0.992 FORMAT "%5.3" EXTENDED_LIMITS -1.000 0.9922 /end CHARACTERISTIC
/begin CHARACTERISTIC REDHYUC "hysteresis of reduction step at smaller desired red. step than actual value" VALUE 0x8052FB27 RB_Val_Ws8 1.992 fak_sb_b1 -1.000 0.992 FORMAT "%5.3" EXTENDED_LIMITS -1.000 0.9922 /end CHARACTERISTIC
/begin CHARACTERISTIC REDHYUCESP "hysteresis of reduction step at smaller desired red. step than actual value during ESP-intervention" VALUE 0x8052FB28 RB_Val_Ws8 1.992 fak_sb_b1 -1.000 0.992 FORMAT "%5.3" EXTENDED_LIMITS -1.000 0.9922 /end CHARACTERISTIC
/begin CHARACTERISTIC REDHYUCGSN "hysteresis of reduction step at smaller desired red. step than actual value during gear shift" VALUE 0x8052FB29 RB_Val_Ws8 1.992 fak_sb_b1 -1.000 0.992 FORMAT "%5.3" EXTENDED_LIMITS -1.000 0.9922 /end CHARACTERISTIC
/begin CHARACTERISTIC REDMXGS "maximum reduction step for gear shift" VALUE 0x8052FB2A RB_Val_Wu8 24.00 OneToOne 0.00 24.00 FORMAT "%5.2" EXTENDED_LIMITS 0.00 255.0 /end CHARACTERISTIC
/begin CHARACTERISTIC REDZEM "threshold between ignition intervention and injector disabling" CURVE 0x8052FB2C RB_Curve_S16_U8_Static 24.00 dez 0.00 24.00 FORMAT "%5.2" EXTENDED_LIMITS 0.00 255.0
 /begin AXIS_DESCR STD_AXIS CEngDsT_t Temp_Cels 5 -3549.940 3003.560 FORMAT "%8.3" DEPOSIT ABSOLUTE /end AXIS_DESCR
/end CHARACTERISTIC
/begin CHARACTERISTIC REDZEMNL "threshold between ignition intervention and injector disabling, emergency mode" CURVE 0x8052FB3E RB_Curve_S16_U8_Static 24.00 dez 0.00 24.00 FORMAT "%5.2" EXTENDED_LIMITS 0.00 255.0
 /begin AXIS_DESCR STD_AXIS CEngDsT_t Temp_Cels 5 -3549.940 3003.560 FORMAT "%8.3" DEPOSIT ABSOLUTE /end AXIS_DESCR
/end CHARACTERISTIC
/begin AXIS_PTS SNM07LSUW "Base point distribution for LRS controller parameters" 0x8051D12C LamCtrl_nEngESPLANT RB_Axis_U16 16383.75 nmot_uw_q0p25 7 0.00 16383.75 FORMAT "%8.2" DEPOSIT ABSOLUTE /end AXIS_PTS
/begin AXIS_PTS SNM16_UW "16 speed set points for drag torque map" 0x8052FDF8 NO_INPUT_QUANTITY RB_Axis_U16 16383.75 nmot_uw_q0p25 16 0.00 16383.75 FORMAT "%8.2" DEPOSIT ABSOLUTE /end AXIS_PTS
/begin AXIS_PTS SPS11MDSW "distribution: manifold pressure for engine torque loss" 0x8052FE1A dpsu_w_msg RB_Axis_S16 5119.922 p_sw_q0p078 11 -2560.000 2559.922 FORMAT "%8.3" DEPOSIT ABSOLUTE /end AXIS_PTS
/begin AXIS_PTS SRL08LSUW "air charge set points for the controller parameters" 0x8051D13C LamCtrl_ratFillgPlaPrm RB_Axis_U16 1535.977 rel_uw_q0p0234 8 0.00 1535.977 FORMAT "%8.3" DEPOSIT ABSOLUTE /end AXIS_PTS
/begin CHARACTERISTIC TARA "temperature threshold intake air" VALUE 0x8052F468 RB_Val_Wu8 191.3 temp_ub_q0p75_o48 -48.0 143.3 FORMAT "%5.1" /end CHARACTERISTIC
/begin CHARACTERISTIC TASHS "threshold for intake air temperature for hot start detection" VALUE 0x8052F66A RB_Val_Wu8 191.3 temp_ub_q0p75_o48 -48.0 143.3 FORMAT "%5.1" /end CHARACTERISTIC
/begin CHARACTERISTIC TETAMIMX "filter time constant for computation of max. indicated torque" VALUE 0x8052FB14 RB_Val_Wu16 655.34999985 zk10msxs_uw_b655 0.01000015 655.36000000 FORMAT "%12.8" EXTENDED_LIMITS 0.010000152590 655.36000000 /end CHARACTERISTIC
/begin CHARACTERISTIC TFRAFV "start value for count down timer case of fault suspicion fra" VALUE 0x8052F47C RB_Val_Wu16 13107.00 t_q0p2 0.00 13107.00 FORMAT "%8.2" /end CHARACTERISTIC
/begin CHARACTERISTIC TFRAINI "Initialisation value of count down timer fra" VALUE 0x8052F47E RB_Val_Wu16 13107.00 t_q0p2 0.00 13107.00 FORMAT "%8.2" /end CHARACTERISTIC
/begin CHARACTERISTIC TFRAPH "threshold for priority step 2 fra" VALUE 0x8052F480 RB_Val_Wu16 13107.00 t_q0p2 0.00 13107.00 FORMAT "%8.2" /end CHARACTERISTIC
/begin CHARACTERISTIC TFRASTABZ "start value for count down timer case of GA stabilized and Z_fra" VALUE 0x8052F482 RB_Val_Wu16 13107.00 t_q0p2 0.00 13107.00 FORMAT "%8.2" /end CHARACTERISTIC
/begin CHARACTERISTIC TLRBAM "Turn-off delay time for activation of closed-loop lambda control after acceleration enrichment" CURVE 0x8052F66C RB_Curve_U8_U16_Static 655.3500 t_q0p01 0.00 655.3500 FORMAT "%8.4"
 /begin AXIS_DESCR STD_AXIS LamCtrl_tEngEnlnmt temp_ub_q0p75_o48 8 -48.0 143.3 FORMAT "%5.1" DEPOSIT ABSOLUTE /end AXIS_DESCR
/end CHARACTERISTIC
/begin CHARACTERISTIC TLRHS "Turn-on delay time for activation of closed-loop lambda control in case of hot start" VALUE 0x8052F686 RB_Val_Wu8 25.50 t_q0p1 0.00 25.50 FORMAT "%5.2" /end CHARACTERISTIC
/begin CHARACTERISTIC TLRSZWSA "Time for hard switch-on of closed loop lambda control after fuel cut-off" VALUE 0x8052F688 RB_Val_Wu16 6553.500 t_q0p1 0.00 6553.500 FORMAT "%8.3" /end CHARACTERISTIC
/begin CHARACTERISTIC TLRTMS "Turn-on delay time for activation of closed-loop lambda control depending on engine start temperature" CURVE 0x8052F68A RB_Curve_U8_U16_Static 6553.500 t_q0p1 0.00 6553.500 FORMAT "%8.3"
 /begin AXIS_DESCR STD_AXIS LamCtrl_tEngStrtWrmUp temp_ub_q0p75_o48 5 -48.0 143.3 FORMAT "%5.1" DEPOSIT ABSOLUTE /end AXIS_DESCR
/end CHARACTERISTIC
/begin CHARACTERISTIC TLRVAM "Turn-off delay time for activation of closed-loop lambda control after deceleration enleanment" CURVE 0x8052F69A RB_Curve_U8_U16_Static 655.3500 t_q0p01 0.00 655.3500 FORMAT "%8.4"
 /begin AXIS_DESCR STD_AXIS LamCtrl_tEngEnlnmt temp_ub_q0p75_o48 8 -48.0 143.3 FORMAT "%5.1" DEPOSIT ABSOLUTE /end AXIS_DESCR
/end CHARACTERISTIC
/begin CHARACTERISTIC TMECnv_flgRedStgMaxThdGbx_C "Calibration to activate gear box by protection by changing the reduction stage maximum threshold" VALUE 0x8052FB50 RB_Val_Wboolean 1.00000000000 B_TRUE 0.00 1.00000000000 FORMAT "%13.11" /end CHARACTERISTIC
/begin CHARACTERISTIC TMECnv_RedStgMaxThdGbx_C "Maximum reduction stage threshold for gear box protection" VALUE 0x8052FB51 RB_Val_Wu8 255.0 dez 0.00 255.0 FORMAT "%5.1" /end CHARACTERISTIC
/begin CHARACTERISTIC TMFVDFRM "Enable temperature threshold to determine the error suspicion via dfrm_w(deviation of fast lambda controller mean value from 1.0)" VALUE 0x8052F3FA RB_Val_Wu8 191.3 temp_ub_q0p75_o48 -48.0 143.3 FORMAT "%5.1" /end CHARACTERISTIC
/begin CHARACTERISTIC TMRAA "cut-in temperature adaptive precontrol for lambda closed-loop control" VALUE 0x8052F469 RB_Val_Wu8 191.3 temp_ub_q0p75_o48 -48.0 143.3 FORMAT "%5.1" /end CHARACTERISTIC
/begin CHARACTERISTIC TMSHS "threshold for engine temperature for hot start detection" VALUE 0x8052F6B4 RB_Val_Wu8 191.3 temp_ub_q0p75_o48 -48.0 143.3 FORMAT "%5.1" /end CHARACTERISTIC
/begin CHARACTERISTIC TORAFDGS "Reset value for count down timer in case of B_fdgser" VALUE 0x8052F484 RB_Val_Wu16 13107.00 t_q0p2 0.00 13107.00 FORMAT "%8.2" /end CHARACTERISTIC
/begin CHARACTERISTIC TORAFV "Reset value for count down timer in case of fault suspition B_fvlra" VALUE 0x8052F486 RB_Val_Wu16 13107.00 t_q0p2 0.00 13107.00 FORMAT "%8.2" /end CHARACTERISTIC
/begin CHARACTERISTIC TORAINI "Initialisation value of count down timer ora" VALUE 0x8052F488 RB_Val_Wu16 13107.00 t_q0p2 0.00 13107.00 FORMAT "%8.2" /end CHARACTERISTIC
/begin CHARACTERISTIC TORAPH "Threshold of phase 2 (Ga possible)" VALUE 0x8052F48A RB_Val_Wu16 13107.00 t_q0p2 0.00 13107.00 FORMAT "%8.2" /end CHARACTERISTIC
/begin CHARACTERISTIC TORASTA "start value for count down timer case of GA stabilized" VALUE 0x8052F48C RB_Val_Wu16 13107.00 t_q0p2 0.00 13107.00 FORMAT "%8.2" /end CHARACTERISTIC
/begin CHARACTERISTIC TTPDFRM "time constant for deviation of fast lambda controller mean value from 1.0 lowpass filter" VALUE 0x8052F3FC RB_Val_Wu16 13106.999997 zk200msxs_uw_b13107 0.200003 13107.200000 FORMAT "%12.6" EXTENDED_LIMITS 0.20000305180 13107.200000 /end CHARACTERISTIC
/begin CHARACTERISTIC TVLRA "delay time for activation of the lambda adaption after lambda control active" VALUE 0x8052F46A RB_Val_Wu8 51.00 t_q0p2 0.00 51.00 FORMAT "%5.2" /end CHARACTERISTIC
/begin CHARACTERISTIC TVNLGA "Switch-off time for operating readiness for adaption factor" VALUE 0x8052F46B RB_Val_Wu8 51.00 t_q0p2 0.00 51.00 FORMAT "%5.2" /end CHARACTERISTIC
/begin CHARACTERISTIC TVUBLRA "switch off time for avoidance of operating mode switching in range limit" VALUE 0x8052F46C RB_Val_Wu8 51.00 t_q0p2 0.00 51.00 FORMAT "%5.2" /end CHARACTERISTIC
/begin CHARACTERISTIC TVUBLRAFRA "delay time operating mode independent enable conditions of multiplicative mixture adaptation factor (FRA)" VALUE 0x8052F46D RB_Val_Wu8 51.00 t_q0p2 0.00 51.00 FORMAT "%5.2" /end CHARACTERISTIC
/begin CHARACTERISTIC TVUBLRAORA "delay time operating mode independent enable conditions of additive correction of the mixture adaptation (ORA)" VALUE 0x8052F46E RB_Val_Wu8 51.00 t_q0p2 0.00 51.00 FORMAT "%5.2" /end CHARACTERISTIC
/begin CHARACTERISTIC ZMDNSMW "time constant for decay of torque offset after cranking" CURVE 0x8052FE32 RB_Curve_U8_U16_Static 1310.6999997 zk20msxs_uw_b1310p72 0.0200003 1310.7200000 FORMAT "%12.7" EXTENDED_LIMITS 0.020000305180 1310.7200000
 /begin AXIS_DESCR STD_AXIS tomdvermot temp_ub_q0p75_o48 8 -48.0 143.3 FORMAT "%5.1" DEPOSIT ABSOLUTE /end AXIS_DESCR
/end CHARACTERISTIC
/begin MEASUREMENT AirMod_mfGasIntkVlv "gas mass flow over intake valve" SWORD m_q0p1 1 100 -3276.800 3276.700 FORMAT "%8.3" ECU_ADDRESS 0x70001DAC /end MEASUREMENT
/begin MEASUREMENT AirSys_bMinPsblIdcTrqRea "Condition minimal possible indicated torque reached" UBYTE B_TRUE 1 100 0.00 1.00000000000 BIT_MASK 0x1 FORMAT "%13.11" ECU_ADDRESS 0x60000172 /end MEASUREMENT
/begin MEASUREMENT AirSys_bThrVlvUnthr "Condition: throttle angle greater or equal wdkugd" UBYTE B_TRUE 1 100 0.00 1.00000000000 BIT_MASK 0x1 FORMAT "%13.11" ECU_ADDRESS 0x60000171 /end MEASUREMENT
/begin MEASUREMENT AirSys_bTrqInflCmft "Request (dynamic) intervention by air system considering comfort" UBYTE B_TRUE 1 100 0.00 1.00000000000 BIT_MASK 0x1 FORMAT "%13.11" ECU_ADDRESS 0x60000170 /end MEASUREMENT
/begin MEASUREMENT AirSys_bTrqInflLimp "Request (dynamic) intervention by air system - limp home" UBYTE B_TRUE 1 100 0.00 1.00000000000 BIT_MASK 0x1 FORMAT "%13.11" ECU_ADDRESS 0x6000016F /end MEASUREMENT
/begin MEASUREMENT AirSys_mAirThrVlv "air mass flow through throttle valve" UWORD m_q0p1 1 100 0.00 6553.500 FORMAT "%8.3" ECU_ADDRESS 0x70001D00 /end MEASUREMENT
/begin MEASUREMENT AirSys_rChCyl "Relative air charge in the cylinder" SWORD rel_q0p02344 1 100 0.00 767.9766 FORMAT "%8.4" ECU_ADDRESS 0x70001DAA /end MEASUREMENT
/begin MEASUREMENT AirSys_rChCylLRes "Relative air charge in the cylinder lower resolution" UBYTE rel_q0p75 1 100 0.00 191.3 FORMAT "%5.1" ECU_ADDRESS 0x70001C3B /end MEASUREMENT
/begin MEASUREMENT AirSys_rChrgCyl "Relative air charge in the cylinder" SWORD rel_q0p02344 1 100 0.00 767.9766 FORMAT "%8.4" ECU_ADDRESS 0x600004D0 /end MEASUREMENT
/begin MEASUREMENT AirSys_rMsCyl "relative air mass (calc. load value) acc. to SAE J1979" UBYTE rel_ub_b99p6 1 100 0.00 99.61 FORMAT "%5.2" ECU_ADDRESS 0x6000A103 /end MEASUREMENT
/begin MEASUREMENT AirSys_rPhiThrVlv "Throttle angle with respect to lower mechanical stop" SWORD relDK_q0p02441 1 100 -800.0000 799.9756 FORMAT "%8.4" ECU_ADDRESS 0x60000892 /end MEASUREMENT
/begin MEASUREMENT blrs_IT.memory "Enabling ramp, integrator, bank 1 / current integrator value" SLONG fak_q9p3132Em10 1 100 0.00 1.99999999907 FORMAT "%13.11" ECU_ADDRESS 0x60000BF0 /end MEASUREMENT
/begin MEASUREMENT BMLEVAB.imlevab_l "Class instance to disable lambda control during and after fuel cut-off (bank 1) / Air mass after cylinder cut-off" ULONG m_q2p777Em4_g 1 100 0.00 1193046.47083 FORMAT "%13.5" ECU_ADDRESS 0x60000BE0 /end MEASUREMENT
/begin MEASUREMENT B_abgien_msg "condition end of 1000 CR interval" UBYTE B_TRUE 1 100 0.00 1.00000000000 BIT_MASK 0x1 FORMAT "%13.11" ECU_ADDRESS 0x6000A7D6 /end MEASUREMENT
/begin MEASUREMENT B_avfra_msg "condition multiplicative mixture adaptation active" UBYTE B_TRUE 1 100 0.00 1.00000000000 BIT_MASK 0x1 FORMAT "%13.11" ECU_ADDRESS 0x70000AB9 /end MEASUREMENT
/begin MEASUREMENT B_avora_msg "condition additive mixture adaptation active" UBYTE B_TRUE 1 100 0.00 1.00000000000 BIT_MASK 0x1 FORMAT "%13.11" ECU_ADDRESS 0x70000AB8 /end MEASUREMENT
/begin MEASUREMENT B_balra_msg "Operating mode dependent Readiness for function LRA(Lambda closed loop control; Adaptive pilot control)" UBYTE B_TRUE 1 100 0.00 1.00000000000 BIT_MASK 0x1 FORMAT "%13.11" ECU_ADDRESS 0x70000AB7 /end MEASUREMENT
/begin MEASUREMENT B_cntmde_msg "Conditions for incrementing failure counters for a detected misfire." UBYTE B_TRUE 1 100 0.00 1.00000000000 BIT_MASK 0x1 FORMAT "%13.11" ECU_ADDRESS 0x70002D78 /end MEASUREMENT
/begin MEASUREMENT B_dlutsk_msg "difference engine roughness exceeds threshold in current operation area" UBYTE B_TRUE 1 100 0.00 1.00000000000 BIT_MASK 0x1 FORMAT "%13.11" ECU_ADDRESS 0x50005D6B /end MEASUREMENT
/begin MEASUREMENT B_dmddiszg_msg "DMD disable condition for cylinder fuel imbalance adaptation in homogenous mode" UBYTE B_TRUE 1 100 0.00 1.00000000000 BIT_MASK 0x1 FORMAT "%13.11" ECU_ADDRESS 0x70002D79 /end MEASUREMENT
/begin MEASUREMENT B_elsvga_msg "condition: lambda sensor error for mixture adaptation" UBYTE B_TRUE 1 100 0.00 1.00000000000 BIT_MASK 0x1 FORMAT "%13.11" ECU_ADDRESS 0x70000A80 /end MEASUREMENT
/begin MEASUREMENT B_eobdlr_msg "error flag: OBD II summary fault, disables lambda control (OBD: on-board-diagnosis)" UBYTE B_TRUE 1 100 0.00 1.00000000000 BIT_MASK 0x1 FORMAT "%13.11" ECU_ADDRESS 0x70000A77 /end MEASUREMENT
/begin MEASUREMENT B_fofadpen_msg "condition fuel-off adaptation is enabled" UBYTE B_TRUE 1 100 0.00 1.00000000000 BIT_MASK 0x1 FORMAT "%13.11" ECU_ADDRESS 0x70002D7A /end MEASUREMENT
/begin MEASUREMENT B_fofresf_msg "Reset of Fuel-Off-Adaptation performed" UBYTE B_TRUE 1 100 0.00 1.00000000000 BIT_MASK 0x1 FORMAT "%13.11" ECU_ADDRESS 0x6000A7D5 /end MEASUREMENT
/begin MEASUREMENT B_fofrkh_msg "cond. fuel-off adaptation for catalyst heating ready" UBYTE B_TRUE 1 100 0.00 1.00000000000 BIT_MASK 0x1 FORMAT "%13.11" ECU_ADDRESS 0x6000A7D4 /end MEASUREMENT
/begin MEASUREMENT B_fofrun_msg "state fuel-off adaptation active" UBYTE B_TRUE 1 100 0.00 1.00000000000 BIT_MASK 0x1 FORMAT "%13.11" ECU_ADDRESS 0x70002D7C /end MEASUREMENT
/begin MEASUREMENT B_fofr_msg "cond. fuel-off adaptation in actual speed range ready" UBYTE B_TRUE 1 100 0.00 1.00000000000 BIT_MASK 0x1 FORMAT "%13.11" ECU_ADDRESS 0x70002D7B /end MEASUREMENT
/begin MEASUREMENT B_fonr_msg "condition fuel-on adaptation actual ready" UBYTE B_TRUE 1 100 0.00 1.00000000000 BIT_MASK 0x1 FORMAT "%13.11" ECU_ADDRESS 0x70002D7D /end MEASUREMENT
/begin MEASUREMENT B_forun_msg "state fuel-on/-off adaptation active" UBYTE B_TRUE 1 100 0.00 1.00000000000 BIT_MASK 0x1 FORMAT "%13.11" ECU_ADDRESS 0x6000A7D3 /end MEASUREMENT
/begin MEASUREMENT B_fraprdy "Condition physical readiness of fra(multiplicative mixture adaptation factor) adaptation" UBYTE B_TRUE 1 100 0.00 1.00000000000 BIT_MASK 0x1 FORMAT "%13.11" ECU_ADDRESS 0x700001B9 /end MEASUREMENT
/begin MEASUREMENT B_frfvlra_FF.status "variable existing only due to software reason / current value of RS-FF" UBYTE B_TRUE 1 100 0.00 1.00000000000 BIT_MASK 0x1 FORMAT "%13.11" ECU_ADDRESS 0x600063A4 /end MEASUREMENT
/begin MEASUREMENT B_frmax_msg "lambda control at upper limit without special conditions (e.g. enleanment protection)" UBYTE B_TRUE 1 100 0.00 1.00000000000 BIT_MASK 0x1 FORMAT "%13.11" ECU_ADDRESS 0x70000A5F /end MEASUREMENT
/begin MEASUREMENT B_frmin_msg "lambda control at lower limit without special conditions (e.g. enleanment protection)" UBYTE B_TRUE 1 100 0.00 1.00000000000 BIT_MASK 0x1 FORMAT "%13.11" ECU_ADDRESS 0x70000A5E /end MEASUREMENT
/begin MEASUREMENT B_frmn_msg "lambda control at lower limit with special conditions (e.g. enleanment protection), bank 1" UBYTE B_TRUE 1 100 0.00 1.00000000000 BIT_MASK 0x1 FORMAT "%13.11" ECU_ADDRESS 0x70000A5D /end MEASUREMENT
/begin MEASUREMENT B_fvdfrm "Condition error suspicion from the fast mean value of lambda control factor (frm) deviation" UBYTE B_TRUE 1 100 0.00 1.00000000000 BIT_MASK 0x1 FORMAT "%13.11" ECU_ADDRESS 0x700001BA /end MEASUREMENT
/begin MEASUREMENT B_fvdfrmeb_msg "basic willingness for identification of error suspicion" UBYTE B_TRUE 1 100 0.00 1.00000000000 BIT_MASK 0x1 FORMAT "%13.11" ECU_ADDRESS 0x70000A56 /end MEASUREMENT
/begin MEASUREMENT B_fvlra_msg "condition error suspicion in mixture adaptation" UBYTE B_TRUE 1 100 0.00 1.00000000000 BIT_MASK 0x1 FORMAT "%13.11" ECU_ADDRESS 0x70000A54 /end MEASUREMENT
/begin MEASUREMENT B_lrab_msg "fundamental operating mode independent operation readiness of mixture adaptation" UBYTE B_TRUE 1 100 0.00 1.00000000000 BIT_MASK 0x1 FORMAT "%13.11" ECU_ADDRESS 0x700009FF /end MEASUREMENT
/begin MEASUREMENT B_lradlsuchk "Condition that lambda sensor diagnosis was tested ok" UBYTE B_TRUE 1 100 0.00 1.00000000000 BIT_MASK 0x1 FORMAT "%13.11" ECU_ADDRESS 0x60034985 /end MEASUREMENT
/begin MEASUREMENT B_lrafra_msg "multiplicative range of mixture adaptation is active" UBYTE B_TRUE 1 100 0.00 1.00000000000 BIT_MASK 0x1 FORMAT "%13.11" ECU_ADDRESS 0x700009FE /end MEASUREMENT
/begin MEASUREMENT B_lraora_msg "additive range of the mixture adaptation is active" UBYTE B_TRUE 1 100 0.00 1.00000000000 BIT_MASK 0x1 FORMAT "%13.11" ECU_ADDRESS 0x700009FD /end MEASUREMENT
/begin MEASUREMENT B_lrareb_msg "condition reset readiness of mixture adaptation" UBYTE B_TRUE 1 100 0.00 1.00000000000 BIT_MASK 0x1 FORMAT "%13.11" ECU_ADDRESS 0x700009FA /end MEASUREMENT
/begin MEASUREMENT B_lrare_msg "condition reset of mixture adaptation" UBYTE B_TRUE 1 100 0.00 1.00000000000 BIT_MASK 0x1 FORMAT "%13.11" ECU_ADDRESS 0x700009FB /end MEASUREMENT
/begin MEASUREMENT B_lrmsbs_ER.buffer "Condition lean mixture forbidden for lambda control, edge rising / rising edge detected" UBYTE B_TRUE 1 100 0.00 1.00000000000 BIT_MASK 0x1 FORMAT "%13.11" ECU_ADDRESS 0x60000BF6 /end MEASUREMENT
/begin MEASUREMENT B_lrmsbs_ER.oldSignal "Condition lean mixture forbidden for lambda control, edge rising / flag rising edge" UBYTE B_TRUE 1 100 0.00 1.00000000000 BIT_MASK 0x1 FORMAT "%13.11" ECU_ADDRESS 0x60000BF7 /end MEASUREMENT
/begin MEASUREMENT B_lrmsbs_msg "Condition lean mixture forbidden for lambda control, bank 1" UBYTE B_TRUE 1 100 0.00 1.00000000000 BIT_MASK 0x1 FORMAT "%13.11" ECU_ADDRESS 0x700009F9 /end MEASUREMENT
/begin MEASUREMENT B_lrmstr_msg "Condition lean mixture forbidden at load change" UBYTE B_TRUE 1 100 0.00 1.00000000000 BIT_MASK 0x1 FORMAT "%13.11" ECU_ADDRESS 0x700009F8 /end MEASUREMENT
/begin MEASUREMENT B_lrnbsnc "bank independent neccessary conditions for lambda control" UBYTE B_TRUE 1 100 0.00 1.00000000000 BIT_MASK 0x1 FORMAT "%13.11" ECU_ADDRESS 0x600000D4 /end MEASUREMENT
/begin MEASUREMENT B_lrnda_msg "lambda control bank 1 active, possibly limited" UBYTE B_TRUE 1 100 0.00 1.00000000000 BIT_MASK 0x1 FORMAT "%13.11" ECU_ADDRESS 0x700009F7 /end MEASUREMENT
/begin MEASUREMENT B_lrseta_msg "Continuous lambda control: setpoint active" UBYTE B_TRUE 1 100 0.00 1.00000000000 BIT_MASK 0x1 FORMAT "%13.11" ECU_ADDRESS 0x700009F5 /end MEASUREMENT
/begin MEASUREMENT B_lrsrems "Condition fr-Reset if lean mixture forbidden, bank 1" UBYTE B_TRUE 1 100 0.00 1.00000000000 BIT_MASK 0x1 FORMAT "%13.11" ECU_ADDRESS 0x600000D9 /end MEASUREMENT
/begin MEASUREMENT B_lrssa_msg "switch on continuous lambda control after fuel cut off with slow sensor" UBYTE B_TRUE 1 100 0.00 1.00000000000 BIT_MASK 0x1 FORMAT "%13.11" ECU_ADDRESS 0x700009F4 /end MEASUREMENT
/begin MEASUREMENT B_lrs_msg "Enabling condition for lambda closed loop control upstream catalyst, bank 1" UBYTE B_TRUE 1 100 0.00 1.00000000000 BIT_MASK 0x1 FORMAT "%13.11" ECU_ADDRESS 0x700009F6 /end MEASUREMENT
/begin MEASUREMENT B_lr_msg "Closed loop lambda upstream catalyst enabled without restrictions" UBYTE B_TRUE 1 100 0.00 1.00000000000 BIT_MASK 0x1 FORMAT "%13.11" ECU_ADDRESS 0x70000A00 /end MEASUREMENT
/begin MEASUREMENT B_lutsk_msg "engine roughness exceeds threshold in current operation area" UBYTE B_TRUE 1 100 0.00 1.00000000000 BIT_MASK 0x1 FORMAT "%13.11" ECU_ADDRESS 0x50005D6C /end MEASUREMENT
/begin MEASUREMENT B_mdarv_msg "critical misfire rate detected" UBYTE B_TRUE 1 100 0.00 1.00000000000 BIT_MASK 0x1 FORMAT "%13.11" ECU_ADDRESS 0x6000E3F0 /end MEASUREMENT
/begin MEASUREMENT B_mdeevb_msg "condition: torque reduction by injection fade out, excluding function monitoring" UBYTE B_TRUE 1 100 0.00 1.00000000000 BIT_MASK 0x1 FORMAT "%13.11" ECU_ADDRESS 0x70001BFA /end MEASUREMENT
/begin MEASUREMENT B_mdee_msg "Condition: torque reduction by injection fade out is permitted" UBYTE B_TRUE 1 100 0.00 1.00000000000 BIT_MASK 0x1 FORMAT "%13.11" ECU_ADDRESS 0x70001BFB /end MEASUREMENT
/begin MEASUREMENT B_mderk_msg "misfiring detected from multiple functions" UBYTE B_TRUE 1 100 0.00 1.00000000000 BIT_MASK 0x1 FORMAT "%13.11" ECU_ADDRESS 0x50005D6D /end MEASUREMENT
/begin MEASUREMENT B_mdist "Condition Actual Torque Computation active" UBYTE B_TRUE 1 100 0.00 1.00000000000 BIT_MASK 0x1 FORMAT "%13.11" ECU_ADDRESS 0x700001B6 /end MEASUREMENT
/begin MEASUREMENT B_mdkat_msg "cat. damaging misfire rate exceeded (for deactivation of other functions)" UBYTE B_TRUE 1 100 0.00 1.00000000000 BIT_MASK 0x1 FORMAT "%13.11" ECU_ADDRESS 0x6000E3F1 /end MEASUREMENT
/begin MEASUREMENT B_mdmi_msg "Condition misfire detection low load-threshold" UBYTE B_TRUE 1 100 0.00 1.00000000000 BIT_MASK 0x1 FORMAT "%13.11" ECU_ADDRESS 0x6000A7D2 /end MEASUREMENT
/begin MEASUREMENT B_mdstop_msg "misfire detection stop" UBYTE B_TRUE 1 100 0.00 1.00000000000 BIT_MASK 0x1 FORMAT "%13.11" ECU_ADDRESS 0x50005D6E /end MEASUREMENT
/begin MEASUREMENT B_milstp_msg "statistic of misfire detection (DMDMIL) stop" UBYTE B_TRUE 1 100 0.00 1.00000000000 BIT_MASK 0x1 FORMAT "%13.11" ECU_ADDRESS 0x6000E3F2 /end MEASUREMENT
/begin MEASUREMENT B_MisfCont_msg "Misfire in several consecutive working cycles detected" UBYTE B_TRUE 1 100 0.00 1.00000000000 BIT_MASK 0x1 FORMAT "%13.11" ECU_ADDRESS 0x6000A7D7 /end MEASUREMENT
/begin MEASUREMENT B_mlevab_msg "Bit lambda control disabled during or after cylinder cut-off" UBYTE B_TRUE 1 100 0.00 1.00000000000 BIT_MASK 0x1 FORMAT "%13.11" ECU_ADDRESS 0x700009EE /end MEASUREMENT
/begin MEASUREMENT B_mlrsa_FF.status "FlipFlop for air-mass based disabling condition / current value of RS-FF" UBYTE B_TRUE 1 100 0.00 1.00000000000 BIT_MASK 0x1 FORMAT "%13.11" ECU_ADDRESS 0x60000BDE /end MEASUREMENT
/begin MEASUREMENT B_mlrsa_msg "Air mass based switch off of lambda control during and after fuel cut off" UBYTE B_TRUE 1 100 0.00 1.00000000000 BIT_MASK 0x1 FORMAT "%13.11" ECU_ADDRESS 0x700009ED /end MEASUREMENT
/begin MEASUREMENT B_nofra_msg "condition no fra(multiplicative correction of mixture adaptation) adaptation active" UBYTE B_TRUE 1 100 0.00 1.00000000000 BIT_MASK 0x1 FORMAT "%13.11" ECU_ADDRESS 0x700009DE /end MEASUREMENT
/begin MEASUREMENT B_noora_msg "condition additive correction of the mixture adaptation switched off" UBYTE B_TRUE 1 100 0.00 1.00000000000 BIT_MASK 0x1 FORMAT "%13.11" ECU_ADDRESS 0x700009DD /end MEASUREMENT
/begin MEASUREMENT B_nozwe_msg "condition no intervention of torque-model via ignition angle" UBYTE B_TRUE 1 100 0.00 1.00000000000 BIT_MASK 0x1 FORMAT "%13.11" ECU_ADDRESS 0x700009DB /end MEASUREMENT
/begin MEASUREMENT B_oraprdy "Condition physical readiness of ora adaptation" UBYTE B_TRUE 1 100 0.00 1.00000000000 BIT_MASK 0x1 FORMAT "%13.11" ECU_ADDRESS 0x700001B8 /end MEASUREMENT
/begin MEASUREMENT B_orap_msg "Condition for switching from HFM(Hot film meter) System to P-System(Pressure Sensor)" UBYTE B_TRUE 1 100 0.00 1.00000000000 BIT_MASK 0x1 FORMAT "%13.11" ECU_ADDRESS 0x700009D3 /end MEASUREMENT
/begin MEASUREMENT B_pspaus "condition lambda control inactive by project specific disabling condition" UBYTE B_TRUE 1 100 0.00 1.00000000000 BIT_MASK 0x1 FORMAT "%13.11" ECU_ADDRESS 0x600000D3 /end MEASUREMENT
/begin MEASUREMENT B_pspwl_msg "condition lambda control possible since warmup finished" UBYTE B_TRUE 1 100 0.00 1.00000000000 BIT_MASK 0x1 FORMAT "%13.11" ECU_ADDRESS 0x700009CE /end MEASUREMENT
/begin MEASUREMENT B_redmxgs_msg "condition: limitation of reduction stage for cylinder individual fuel cut-off at gear shift" UBYTE B_TRUE 1 100 0.00 1.00000000000 BIT_MASK 0x1 FORMAT "%13.11" ECU_ADDRESS 0x70001BF8 /end MEASUREMENT
/begin MEASUREMENT B_refrast_msg "condition: reset of stabilisation bit of adaption fra" UBYTE B_TRUE 1 100 0.00 1.00000000000 BIT_MASK 0x1 FORMAT "%13.11" ECU_ADDRESS 0x700009C1 /end MEASUREMENT
/begin MEASUREMENT B_reorast_msg "condition: reset of stabilisation bit of adaption ora" UBYTE B_TRUE 1 100 0.00 1.00000000000 BIT_MASK 0x1 FORMAT "%13.11" ECU_ADDRESS 0x700009C0 /end MEASUREMENT
/begin MEASUREMENT B_reqlra_msg "fuel mixture adaptation requirement detected" UBYTE B_TRUE 1 100 0.00 1.00000000000 BIT_MASK 0x1 FORMAT "%13.11" ECU_ADDRESS 0x600349A0 /end MEASUREMENT
/begin MEASUREMENT B_swe_msg "Condition rough road detected" UBYTE B_TRUE 1 100 0.00 1.00000000000 BIT_MASK 0x1 FORMAT "%13.11" ECU_ADDRESS 0x50005D70 /end MEASUREMENT
/begin MEASUREMENT B_teminlrs_ER.buffer "Minimum injection time reached, edge rising / rising edge detected" UBYTE B_TRUE 1 100 0.00 1.00000000000 BIT_MASK 0x1 FORMAT "%13.11" ECU_ADDRESS 0x60000BF4 /end MEASUREMENT
/begin MEASUREMENT B_teminlrs_ER.oldSignal "Minimum injection time reached, edge rising / flag rising edge" UBYTE B_TRUE 1 100 0.00 1.00000000000 BIT_MASK 0x1 FORMAT "%13.11" ECU_ADDRESS 0x60000BF5 /end MEASUREMENT
/begin MEASUREMENT B_temin_TOFFV.outbit "Minimum injection time reached, turn off delay / Output Bit" UBYTE B_TRUE 1 100 0.00 1.00000000000 BIT_MASK 0x1 FORMAT "%13.11" ECU_ADDRESS 0x50000F08 /end MEASUREMENT
/begin MEASUREMENT B_temin_TOFFV.time "Minimum injection time reached, turn off delay / Occured Time" UWORD t_q0p01 1 100 0.00 655.3500 FORMAT "%8.4" ECU_ADDRESS 0x50000F0A /end MEASUREMENT
/begin MEASUREMENT B_tsbready_msg "condition segment duration plausible" UBYTE B_TRUE 1 100 0.00 1.00000000000 BIT_MASK 0x1 FORMAT "%13.11" ECU_ADDRESS 0x6000A7D1 /end MEASUREMENT
/begin MEASUREMENT B_tsroov_msg "condition segment duration word overflow" UBYTE B_TRUE 1 100 0.00 1.00000000000 BIT_MASK 0x1 FORMAT "%13.11" ECU_ADDRESS 0x6000A7D0 /end MEASUREMENT
/begin MEASUREMENT B_ubfra_msg "fra (multiplicative mixture adaptation factor)operational readiness independent of the operating mode" UBYTE B_TRUE 1 100 0.00 1.00000000000 BIT_MASK 0x1 FORMAT "%13.11" ECU_ADDRESS 0x70000970 /end MEASUREMENT
/begin MEASUREMENT B_ubora_msg "ora(additive correction of the mixture adaptation) operational readiness independent of the operating mode" UBYTE B_TRUE 1 100 0.00 1.00000000000 BIT_MASK 0x1 FORMAT "%13.11" ECU_ADDRESS 0x7000096F /end MEASUREMENT
/begin MEASUREMENT B_ubphyfra_msg "Operating mode-independent physical readiness for FRA(Multiplicative correction of the mixture adaptation) adaptation" UBYTE B_TRUE 1 100 0.00 1.00000000000 BIT_MASK 0x1 FORMAT "%13.11" ECU_ADDRESS 0x7000096E /end MEASUREMENT
/begin MEASUREMENT B_ubphyora_msg "Operating mode-independent physical readiness for ORA(Additive correction of the mixture adaptation) adaptation" UBYTE B_TRUE 1 100 0.00 1.00000000000 BIT_MASK 0x1 FORMAT "%13.11" ECU_ADDRESS 0x7000096D /end MEASUREMENT
/begin MEASUREMENT dfrmax_w_msg "maximum limit for delta control factor of lambda control" SWORD fak_sw_b1 1 100 -1.000000 0.999969 FORMAT "%8.6" ECU_ADDRESS 0x6000E2F8 /end MEASUREMENT
/begin MEASUREMENT dfrmin_w_msg "minimum limit for delta control factor of lambda control" SWORD fak_sw_b1 1 100 -1.000000 0.999969 FORMAT "%8.6" ECU_ADDRESS 0x6000E2FA /end MEASUREMENT
/begin MEASUREMENT dfrmkb_w "absolute value of dfrm(2)_w(deviation of fast lambda controller mean value from 1) corrected with the P-part(Proportional) of HK(Catalytic converter in downstream) controllerof the HK controller" UWORD fak_uw_b2 1 100 0.00 1.999969 FORMAT "%8.6" ECU_ADDRESS 0x600036EE /end MEASUREMENT
/begin MEASUREMENT dfrmk_w_msg "dfrm_w(deviation of fast lambda controller mean value from 1) corrected with the P-part(Proportional) of the HK(Catalytic converter in downstream) controller" SWORD fak_sw_b1 1 100 -1.000000 0.999969 FORMAT "%8.6" ECU_ADDRESS 0x60004946 /end MEASUREMENT
/begin MEASUREMENT dfrmnms_w "minimum limit for delta control factor of lambda control due to enleanment protection" SWORD fak_sw_b1 1 100 -1.000000 0.999969 FORMAT "%8.6" ECU_ADDRESS 0x60000C14 /end MEASUREMENT
/begin MEASUREMENT dfrmn_w_msg "minimum limit for delta control factor of lambda control without special conditions (e.g. enleanment protection)" SWORD fak_sw_b1 1 100 -1.000000 0.999969 FORMAT "%8.6" ECU_ADDRESS 0x50005C5A /end MEASUREMENT
/begin MEASUREMENT dfrmtp_w_msg "low pass filtered, deviation of fast lambda controller mean value from 1.0 (dfrm_w)" UWORD fak_uw_b2 1 100 0.00 1.999969 FORMAT "%8.6" ECU_ADDRESS 0x6000484A /end MEASUREMENT
/begin MEASUREMENT dfrmx_w_msg "maximum limit for delta control factor of lambda control without special conditions (e.g. enleanment protection)" SWORD fak_sw_b1 1 100 -1.000000 0.999969 FORMAT "%8.6" ECU_ADDRESS 0x6000E2FC /end MEASUREMENT
/begin MEASUREMENT dfrm_w_msg "deviation of fast lambda controller mean value from 1.0" SWORD fak_sw_b1 1 100 -1.000000 0.999969 FORMAT "%8.6" ECU_ADDRESS 0x60004948 /end MEASUREMENT
/begin MEASUREMENT dfr_w_msg "Delta lambda controller (factor), bank1" SWORD fak_sw_b1 1 100 -1.000000 0.999969 FORMAT "%8.6" ECU_ADDRESS 0x60004DE2 /end MEASUREMENT
/begin MEASUREMENT dlaso_msg "Correction of lambda setpoint for continuous lambda control, 8 Bit" SBYTE fak_sb_b0p03125 1 100 -0.03125 0.03101 FORMAT "%7.5" ECU_ADDRESS 0x6000A6C9 /end MEASUREMENT
/begin MEASUREMENT dpsu_w_msg "local variable deviation of manifold- and ambient pressure" SWORD p_sw_q0p078 1 100 -2560.000 2559.922 FORMAT "%8.3" ECU_ADDRESS 0x60000E88 /end MEASUREMENT
/begin MEASUREMENT drldvmds_w_msg "dynamic reserve for compensating the change in air charge caused by switching of air charge actuators" SWORD rel_q0p02344 1 100 -768.0000 767.9766 FORMAT "%8.4" ECU_ADDRESS 0x60004DDA /end MEASUREMENT
/begin MEASUREMENT drlmn_w "difference of actual to minimum air charge" UWORD rel_uw_q0p0234 1 100 0.00 1535.977 FORMAT "%8.3" ECU_ADDRESS 0x600036D2 /end MEASUREMENT
/begin MEASUREMENT dtdmdsh "temperature difference coolant air during start" UBYTE temp_ub_q0p75_o48 1 100 -48.0 143.3 FORMAT "%5.1" ECU_ADDRESS 0x60000BD0 /end MEASUREMENT
/begin MEASUREMENT dzwi_w "Difference between optimized model reference ignition angle and actual ignition angle" SWORD zw_q2p9297Em3_deg_KW 1 100 0.00 95.99707 FORMAT "%8.5" ECU_ADDRESS 0x7000190A /end MEASUREMENT
/begin MEASUREMENT EGSys_bCH "condition catalyst heating activated" UBYTE B_TRUE 1 100 0.00 1.00000000000 BIT_MASK 0x1 FORMAT "%13.11" ECU_ADDRESS 0x70000812 /end MEASUREMENT
/begin MEASUREMENT EGSys_bFCORdnCoPr "condition fuel cutoff request by component protection" UBYTE B_TRUE 1 100 0.00 1.00000000000 BIT_MASK 0x1 FORMAT "%13.11" ECU_ADDRESS 0x70000811 /end MEASUREMENT
/begin MEASUREMENT EGSys_etaCH "Efficiency requirement of the exhaust gas system for catalyst heating" UWORD fak_uw_b2 1 100 0.00 1.999969 FORMAT "%8.6" ECU_ADDRESS 0x600048F8 /end MEASUREMENT
/begin MEASUREMENT EGSys_trqResvCH "Torque reserve for catalyst heating" SWORD md_q0p1 1 100 -3276.800 3276.700 FORMAT "%8.3" ECU_ADDRESS 0x70002C34 /end MEASUREMENT
/begin MEASUREMENT EngReq_trqResvQckTst "Torque reserve during quicktest (previously: dmrkt_w)" SWORD Trq 1 100 -3276.800 3276.700 FORMAT "%8.3" ECU_ADDRESS 0x6000E1D0 /end MEASUREMENT
/begin MEASUREMENT EnvP_p "Ambient pressure" SWORD Pres_hPa 1 100 0.00 3500.000 FORMAT "%8.3" ECU_ADDRESS 0x60004AEE /end MEASUREMENT
/begin MEASUREMENT EnvT_tMod "Modeled environment air temperature" SWORD Temp_Cels 1 100 -3549.940 3003.560 FORMAT "%8.3" ECU_ADDRESS 0x60004AE8 /end MEASUREMENT
/begin MEASUREMENT ErrLmp_stMIL "MIL status indicator" UBYTE OneToOne 1 100 0.00 255.0 FORMAT "%5.1" ECU_ADDRESS 0x6000E41E /end MEASUREMENT
/begin MEASUREMENT etafue_w_msg "efficiency for torque calculation air charge path" UWORD fak_uw_b2 1 100 0.00 1.999969 FORMAT "%8.6" ECU_ADDRESS 0x600005DA /end MEASUREMENT
/begin MEASUREMENT etalfue_w "Efficiency of the air charge control" UWORD fak_uw_b2 1 100 0.00 1.999969 FORMAT "%8.6" ECU_ADDRESS 0x70002BA8 /end MEASUREMENT
/begin MEASUREMENT etamimx_w_msg "smoothed efficieny for computation of maximal indicated optimal torque" UWORD fak_uw_b2 1 100 0.00 1.999969 FORMAT "%8.6" ECU_ADDRESS 0x60004C10 /end MEASUREMENT
/begin MEASUREMENT etazaist_w_msg "actual cylinder masking efficiency" UWORD fak_uw_b2 1 100 0.00 1.000000 FORMAT "%8.6" ECU_ADDRESS 0x500007C2 /end MEASUREMENT
/begin MEASUREMENT etazwbm_w_msg "mean ignition angle effectiveness of basic ignition angle" UWORD fak_uw_b2 1 100 0.00 1.999969 FORMAT "%8.6" ECU_ADDRESS 0x600005E4 /end MEASUREMENT
/begin MEASUREMENT etazwb_w_msg "ignition angle effectiveness of basic ignition angle" UWORD fak_uw_b2 1 100 0.00 1.000000 FORMAT "%8.6" ECU_ADDRESS 0x600005E0 /end MEASUREMENT
/begin MEASUREMENT etazwist_w_msg "actual spark efficiency" UWORD fak_uw_b2 1 100 0.00 1.999969 FORMAT "%8.6" ECU_ADDRESS 0x600005EA /end MEASUREMENT
/begin MEASUREMENT etazwmni_w "minimum ignition angle effectiveness" UWORD fak_uw_b2 1 100 0.00 1.999969 FORMAT "%8.6" ECU_ADDRESS 0x600036D0 /end MEASUREMENT
/begin MEASUREMENT etazwmnm_w_msg "average minimum ignition angle effectiveness" UWORD fak_uw_b2 1 100 0.00 1.000000 FORMAT "%8.6" ECU_ADDRESS 0x70001C88 /end MEASUREMENT
/begin MEASUREMENT etazwmns_w "Efficiency of ignition for desired operating mode" UWORD fak_uw_b2 1 100 0.00 1.000000 FORMAT "%8.6" ECU_ADDRESS 0x7000190C /end MEASUREMENT
/begin MEASUREMENT etazwmn_w_msg "minimum ignition angle effectiveness" UWORD fak_uw_b2 1 100 0.00 1.000000 FORMAT "%8.6" ECU_ADDRESS 0x600005F2 /end MEASUREMENT
/begin MEASUREMENT etazwsol_w_msg "nominal spark efficiency" UWORD fak_uw_b2 1 100 0.00 1.999969 FORMAT "%8.6" ECU_ADDRESS 0x500007CC /end MEASUREMENT
/begin MEASUREMENT ExhCo_Idx1d "location of oxygen sensors (4 banks and 2 sensors) - Parameter Identification 1D according with ISO15031-5. 2 banks and 4 sensors are identified by the index 13" UBYTE dez 1 100 0.00 255.0 FORMAT "%5.1" ECU_ADDRESS 0x6000A06A /end MEASUREMENT
/begin MEASUREMENT facetazwmn_w "Interpolation factor for minimum ignition angle eta" UWORD fak_ub_b1 1 100 0.00 0.9960938 FORMAT "%9.7" ECU_ADDRESS 0x70002BAA /end MEASUREMENT
/begin MEASUREMENT flgmdkatbnk_msg "exhaust bank individual statusbyte for cat. damaging misfire rate exceeded" UBYTE dez 1 100 0.00 255.0 FORMAT "%5.1" ECU_ADDRESS 0x6000A29E /end MEASUREMENT
/begin MEASUREMENT flgstign_w_msg "flagword for stimulated ignition misfires" UWORD dez 1 100 0.00 65535.00 FORMAT "%8.2" ECU_ADDRESS 0x500007CE /end MEASUREMENT
/begin MEASUREMENT flgstinj_w_msg "flagword for stimulated injection misfires" UWORD dez 1 100 0.00 65535.00 FORMAT "%8.2" ECU_ADDRESS 0x500007D0 /end MEASUREMENT
/begin MEASUREMENT flgtiab_msg "state flag fuel cutoff by catalyst damaging misfiring rates" UBYTE dez 1 100 0.00 255.0 FORMAT "%5.1" ECU_ADDRESS 0x600007B7 /end MEASUREMENT
/begin MEASUREMENT FlMA_ctPostDrvLeave "Local variable to store the global drive cycle counter (Global drive cycle counter which is incremented when system state SyC_PostDrive is left (SyC_ctPostDrvLeave))" UBYTE OneToOne 1 100 0.00 255.0 FORMAT "%5.1" ECU_ADDRESS 0x600063A3 /end MEASUREMENT
/begin MEASUREMENT FlMA_facSubMulLamSnsrErr "Substitute multiplicative adaptation value when the lambda sensor error for mixture adaptation" UWORD fak_uw_b2 1 100 0.00 1.999969 FORMAT "%8.6" ECU_ADDRESS 0x600036EC /end MEASUREMENT
/begin MEASUREMENT FlMA_flgAddlEnaCdn "Additional enable conditions of the fuel mixture adaptation fulfilled" UBYTE B_TRUE 1 100 0.00 1.00000000000 BIT_MASK 0x1 FORMAT "%13.11" ECU_ADDRESS 0x700007A1 /end MEASUREMENT
/begin MEASUREMENT FlMA_flgBascEnaCdn "Basic enable conditions of the fuel mixture adaptation fulfilled" UBYTE B_TRUE 1 100 0.00 1.00000000000 BIT_MASK 0x1 FORMAT "%13.11" ECU_ADDRESS 0x700007A0 /end MEASUREMENT
/begin MEASUREMENT FlMA_flgDsmClrFinshdAckd "DSM(Diagnostic System Management) Clear has been finished" UBYTE B_TRUE 1 100 0.00 1.00000000000 BIT_MASK 0x1 FORMAT "%13.11" ECU_ADDRESS 0x6003499C /end MEASUREMENT
/begin MEASUREMENT FlMA_flgDSMClrFra "Condition clear request exists for multiplicative mixture adaptation faults on fault memory clear request." UBYTE B_TRUE 1 100 0.00 1.00000000000 BIT_MASK 0x1 FORMAT "%13.11" ECU_ADDRESS 0x7000079E /end MEASUREMENT
/begin MEASUREMENT FlMA_flgDSMClrLRA "Condition clearing fault memory for function LRA is active" UBYTE B_TRUE 1 100 0.00 1.00000000000 BIT_MASK 0x1 FORMAT "%13.11" ECU_ADDRESS 0x7000079D /end MEASUREMENT
/begin MEASUREMENT FlMA_flgDSMClrLRAEB "Condition clearing fault memory for function LRAEB(Conditions adaptive pilot control) is active" UBYTE B_TRUE 1 100 0.00 1.00000000000 BIT_MASK 0x1 FORMAT "%13.11" ECU_ADDRESS 0x7000079C /end MEASUREMENT
/begin MEASUREMENT FlMA_flgDSMClrLRAPHU "Condition clearing fault memory for function LRAPHU is active" UBYTE B_TRUE 1 100 0.00 1.00000000000 BIT_MASK 0x1 FORMAT "%13.11" ECU_ADDRESS 0x700001B7 /end MEASUREMENT
/begin MEASUREMENT FlMA_flgDSMClrLRAProc1 "Flag to signify fault memory clear trigger request for current process" UBYTE B_TRUE 1 100 0.00 1.00000000000 BIT_MASK 0x1 FORMAT "%13.11" ECU_ADDRESS 0x7000079B /end MEASUREMENT
/begin MEASUREMENT FlMA_flgDSMClrOra "Condition clear request exists for additive mixture adaptation faults on fault memory clear request." UBYTE B_TRUE 1 100 0.00 1.00000000000 BIT_MASK 0x1 FORMAT "%13.11" ECU_ADDRESS 0x7000079A /end MEASUREMENT
/begin MEASUREMENT FlMA_flgDsmClrTrig "DSM(Diagnostic System Management) Clear has been triggered" UBYTE B_TRUE 1 100 0.00 1.00000000000 BIT_MASK 0x1 FORMAT "%13.11" ECU_ADDRESS 0x6003499B /end MEASUREMENT
/begin MEASUREMENT FlMA_flgFncRqstMixAdpn "condition: requirement adaption close loop" UBYTE B_TRUE 1 100 0.00 1.00000000000 BIT_MASK 0x1 FORMAT "%13.11" ECU_ADDRESS 0x70000799 /end MEASUREMENT
/begin MEASUREMENT FlMA_flgIninFinshdAckd "Finish of the initialization acknowledged" UBYTE B_TRUE 1 100 0.00 1.00000000000 BIT_MASK 0x1 FORMAT "%13.11" ECU_ADDRESS 0x60009F93 /end MEASUREMENT
/begin MEASUREMENT FlMA_flgIninTrig "Initialization triggered" UBYTE B_TRUE 1 100 0.00 1.00000000000 BIT_MASK 0x1 FORMAT "%13.11" ECU_ADDRESS 0x70000798 /end MEASUREMENT
/begin MEASUREMENT FlMA_flgTEngEnaCdn "Enable temperature of the fuel mixture adaptation fulfilled" UBYTE B_TRUE 1 100 0.00 1.00000000000 BIT_MASK 0x1 FORMAT "%13.11" ECU_ADDRESS 0x70000797 /end MEASUREMENT
/begin MEASUREMENT FlMA_nEng "engine speed with low resolution" UBYTE nmot_ub_q40 1 100 0.00 10200. FORMAT "%5.0" ECU_ADDRESS 0x6000A049 /end MEASUREMENT
/begin MEASUREMENT FlMA_nEngLRes "Engine speed with low resolution" UBYTE nmot_ub_q40 1 100 0.00 10200. FORMAT "%5.0" ECU_ADDRESS 0x600063A2 /end MEASUREMENT
/begin MEASUREMENT FlMA_ratSubAddlLamSnsrErr "Substitute additive adaptation value when the lambda sensor error for mixture adaptation" SWORD rel_sw_b1536 1 100 -1536.000 1535.953 FORMAT "%8.3" ECU_ADDRESS 0x600036EA /end MEASUREMENT
/begin MEASUREMENT FlMA_tCEngDsStrt "Coolant temperature at engine output" UBYTE temp_ub_q0p75_o48 1 100 -48.0 143.3 FORMAT "%5.1" ECU_ADDRESS 0x600063A1 /end MEASUREMENT
/begin MEASUREMENT FlMA_tEngEna "Enable temperature of the fuel mixture adaptation" UBYTE temp_ub_q0p75_o48 1 100 -48.0 143.3 FORMAT "%5.1" ECU_ADDRESS 0x6000A048 /end MEASUREMENT
/begin MEASUREMENT FlMA_tEnv "enviroment temperature Actual physical value" UBYTE temp_ub_q0p75_o48 1 100 -48.0 143.3 FORMAT "%5.1" ECU_ADDRESS 0x600063A0 /end MEASUREMENT
/begin MEASUREMENT fofstat_msg "state of fuel-off adaptation in actual map range" UBYTE dez 1 100 0.00 255.0 FORMAT "%5.1" ECU_ADDRESS 0x500008BA /end MEASUREMENT
/begin MEASUREMENT fonstat_msg "state of fuel-on adaptation in actual map range" UBYTE dez 1 100 0.00 255.0 FORMAT "%5.1" ECU_ADDRESS 0x70001C09 /end MEASUREMENT
/begin MEASUREMENT fraildcy_w "multiplicative correction of the mixture adaptation (frai_w) from the last driving cycle" UWORD fak_uw_b2 1 100 0.00 1.999969 FORMAT "%8.6" ECU_ADDRESS 0x6003651A /end MEASUREMENT
/begin MEASUREMENT fraini_w_msg "multiplicative correction of the mixture adaptation at initialization" UWORD fak_uw_b2 1 100 0.00 1.999969 FORMAT "%8.6" ECU_ADDRESS 0x60037F0A /end MEASUREMENT
/begin MEASUREMENT frai_w_msg "multiplicative correction of the mixture adaptation" UWORD fak_uw_b2 1 100 0.00 1.999969 FORMAT "%8.6" ECU_ADDRESS 0x60037F0C /end MEASUREMENT
/begin MEASUREMENT frak_w_msg "integration speed integrator FRA_IK" UWORD q7p63Em5_DIV_s 1 100 0.00 4.999924 FORMAT "%8.6" ECU_ADDRESS 0x6000482E /end MEASUREMENT
/begin MEASUREMENT framn_w "lower limit of multiplicative correction factor(fra_w)" UWORD fak_uw_b2 1 100 0.00 1.999969 FORMAT "%8.6" ECU_ADDRESS 0x6000482C /end MEASUREMENT
/begin MEASUREMENT framx_w "upper limit of multiplicative correction factor(fra_w)" UWORD fak_uw_b2 1 100 0.00 1.999969 FORMAT "%8.6" ECU_ADDRESS 0x6000482A /end MEASUREMENT
/begin MEASUREMENT fraw_w "multiplicative mixture adaptation factor in warm engine operation mode" UWORD fak_uw_b2 1 100 0.00 1.999969 FORMAT "%8.6" ECU_ADDRESS 0x600036E8 /end MEASUREMENT
/begin MEASUREMENT fra_w_msg "multiplicative correction of the mixture adaptation (word)" UWORD fak_uw_b2 1 100 0.00 1.999969 FORMAT "%8.6" ECU_ADDRESS 0x50005C62 /end MEASUREMENT
/begin MEASUREMENT frmn_w_msg "lambda regulator output min." UWORD fak_uw_b2 1 100 0.00 1.999969 FORMAT "%8.6" ECU_ADDRESS 0x6000E30E /end MEASUREMENT
/begin MEASUREMENT frmx_w_msg "Maximum limit for absolute control factor of lambda control without special conditions (e.g. enleanment protection)" UWORD fak_uw_b2 1 100 0.00 1.999969 FORMAT "%8.6" ECU_ADDRESS 0x60004826 /end MEASUREMENT
/begin MEASUREMENT frm_w_msg "fast mean value of lambda control factor (word)" UWORD fak_uw_b2 1 100 0.00 1.999969 FORMAT "%8.6" ECU_ADDRESS 0x60004C0A /end MEASUREMENT
/begin MEASUREMENT fr_w_msg "Lambda controller output (word)" UWORD fak_uw_b2 1 100 0.00 1.999969 FORMAT "%8.6" ECU_ADDRESS 0x50005C5E /end MEASUREMENT
/begin MEASUREMENT fsr_w_msg "array of adaptation values for all cylinders" SWORD lu_MEx 1 100 -232.8306 232.8235 FORMAT "%8.4" ARRAY_SIZE 4 ECU_ADDRESS 0x70001D20 /end MEASUREMENT
/begin MEASUREMENT fzabgs_w_msg "fault counter, summary, counts emission relevant misfirings of all cylinders" UWORD dez 1 100 0.00 65535.00 FORMAT "%8.2" ECU_ADDRESS 0x60000612 /end MEASUREMENT
/begin MEASUREMENT fzabgzyl_w_msg "DMD counter in exhaust intervall" UWORD dez 1 100 0.00 65535.00 FORMAT "%8.2" ARRAY_SIZE 4 ECU_ADDRESS 0x500005D4 /end MEASUREMENT
/begin MEASUREMENT fzkatsb_w_msg "counter for catalyst damaging misfire per cylinder bank" UWORD dez 1 100 0.00 65535.00 FORMAT "%8.2" ARRAY_SIZE 1 ECU_ADDRESS 0x70001C7E /end MEASUREMENT
/begin MEASUREMENT fzkats_w_msg "fault counter, summary, counts catalyst damaging misfirings of all cylinders for message" UWORD dez 1 100 0.00 65535.00 FORMAT "%8.2" ECU_ADDRESS 0x70001C80 /end MEASUREMENT
/begin MEASUREMENT fzkatzyl_w_msg "weighted misfire counter for determination of catalyst damage" UWORD dez 1 100 0.00 65535.00 FORMAT "%8.2" ARRAY_SIZE 4 ECU_ADDRESS 0x500005DC /end MEASUREMENT
/begin MEASUREMENT fzmdzyl_w_msg "array for number of misfire per cylinder" UWORD dez 1 100 0.00 65535.00 FORMAT "%8.2" ARRAY_SIZE 4 ECU_ADDRESS 0x70001C76 /end MEASUREMENT
/begin MEASUREMENT IMC_B1.a0lrs_w "IMC controller for continuous lambda control bank 1 / a0 parameter of discretized IMC lambda controller" UWORD t_q2p5Em4 1 100 0.00 16.38375 FORMAT "%8.5" ECU_ADDRESS 0x600009E0 /end MEASUREMENT
/begin MEASUREMENT IMC_B1.b0lrs_w "IMC controller for continuous lambda control bank 1 / b0 parameter of discretized IMC lambda controller" UWORD t_q2p5Em4 1 100 0.00 16.38375 FORMAT "%8.5" ECU_ADDRESS 0x600009E2 /end MEASUREMENT
/begin MEASUREMENT IMC_B1.dfr_w "IMC controller for continuous lambda control bank 1 / Delta lambda controller (factor)" SWORD fak_sw_b1 1 100 -1.000000 0.999969 FORMAT "%8.6" ECU_ADDRESS 0x600009E6 /end MEASUREMENT
/begin MEASUREMENT IMC_B1.dfrpr_w "IMC controller for continuous lambda control bank 1 / Delta lambda controller; temporary value before test for enleanment protection" SWORD fak_sw_b1 1 100 -1.000000 0.999969 FORMAT "%8.6" ECU_ADDRESS 0x600009EC /end MEASUREMENT
/begin MEASUREMENT IMC_B1.dlrs_w "IMC controller for continuous lambda control bank 1 / Delay time parameter of discretized IMC lambda controller" UWORD fak_uw_b2 1 100 0.00 1.999969 FORMAT "%8.6" ECU_ADDRESS 0x600009EE /end MEASUREMENT
/begin MEASUREMENT IMC_B1.m1lrs_w "IMC controller for continuous lambda control bank 1 / m1 parameter of discretized IMC lambda controller" UWORD t_q2p5Em4 1 100 0.00 16.38375 FORMAT "%8.5" ECU_ADDRESS 0x600009F0 /end MEASUREMENT
/begin MEASUREMENT IMC_B1.n0lrs_w "IMC controller for continuous lambda control bank 1 / n0 parameter of discretized IMC lambda controller" UWORD t_q2p5Em4 1 100 0.00 16.38375 FORMAT "%8.5" ECU_ADDRESS 0x600009F2 /end MEASUREMENT
/begin MEASUREMENT IMC_B1.planto_w "IMC controller for continuous lambda control bank 1 / Output of plant model" SWORD fak_sw_b1 1 100 -1.000000 0.999969 FORMAT "%8.6" ECU_ADDRESS 0x600009F4 /end MEASUREMENT
/begin MEASUREMENT IMC_B1.r1lrs_w "IMC controller for continuous lambda control bank 1 / r1 parameter of discretized IMC lambda controller" UWORD t_q2p5Em4 1 100 0.00 16.38375 FORMAT "%8.5" ECU_ADDRESS 0x600009F8 /end MEASUREMENT
/begin MEASUREMENT IMC_B1.s0lrs_w "IMC controller for continuous lambda control bank 1 / s0 parameter of discretized IMC lambda controller" UWORD t_q2p5Em4 1 100 0.00 16.38375 FORMAT "%8.5" ECU_ADDRESS 0x600009FA /end MEASUREMENT
/begin MEASUREMENT IMC_B1.s1lrs_w "IMC controller for continuous lambda control bank 1 / s1 parameter of discretized IMC lambda controller" SWORD t_q2p5Em4 1 100 -8.192000 0.00 FORMAT "%8.6" ECU_ADDRESS 0x600009FC /end MEASUREMENT
/begin MEASUREMENT IMC_B1.LRScl_DelayTime_ds_opt.buffer "IMC controller for continuous lambda control bank 1 / Delay time element of IMC lambda controller / buffer" SWORD fak_sw_b1 1 100 -1.000000 0.999969 FORMAT "%8.6" ARRAY_SIZE 50 ECU_ADDRESS 0x600009FE /end MEASUREMENT
/begin MEASUREMENT IMC_B1.LRScl_DelayTime_ds_opt.counter "IMC controller for continuous lambda control bank 1 / Delay time element of IMC lambda controller / counter" UWORD fak_uw_b2 1 100 0.00 1.999969 FORMAT "%8.6" ECU_ADDRESS 0x60000A62 /end MEASUREMENT
/begin MEASUREMENT IMC_B1.LRScl_DelayTime_ds_opt.out_val "IMC controller for continuous lambda control bank 1 / Delay time element of IMC lambda controller / out_val" SWORD fak_sw_b1 1 100 -1.000000 0.999969 FORMAT "%8.6" ECU_ADDRESS 0x60000A64 /end MEASUREMENT
/begin MEASUREMENT IMC_B1.LRScl_DelayTime_ds_opt.pointer "IMC controller for continuous lambda control bank 1 / Delay time element of IMC lambda controller / pointer" UBYTE dez 1 100 0.00 255.0 FORMAT "%5.1" ECU_ADDRESS 0x60000A66 /end MEASUREMENT
/begin MEASUREMENT IMC_B1.LRScl_DelayTime_ds_opt.pointerIni "IMC controller for continuous lambda control bank 1 / Delay time element of IMC lambda controller / pointerIni" UBYTE dez 1 100 0.00 255.0 FORMAT "%5.1" ECU_ADDRESS 0x60000A67 /end MEASUREMENT
/begin MEASUREMENT ivzabg_w_msg "interval counter for emission relevant faults (0 - 1000 crankshaft revolutions)" UWORD dez 1 100 0.00 65535.00 FORMAT "%8.2" ECU_ADDRESS 0x70001C74 /end MEASUREMENT
/begin MEASUREMENT ivzkat_w_msg "interval counter for catalyst damaging misfirings (0 - 200 crankshaft revs.)" UWORD dez 1 100 0.00 65535.00 FORMAT "%8.2" ECU_ADDRESS 0x70001C72 /end MEASUREMENT
/begin MEASUREMENT kfmds_w "engine drag torque" UWORD rel_uw_b100 1 100 0.00 99.99847 FORMAT "%8.5" ECU_ADDRESS 0x60000BCE /end MEASUREMENT
/begin MEASUREMENT ladiff_w_msg "control error continuous lambda control" SWORD fak_sw_b1 1 100 -1.000000 0.999969 FORMAT "%8.6" ECU_ADDRESS 0x60004DD2 /end MEASUREMENT
/begin MEASUREMENT LamCtrl_facCtrlDeltaEnlnmtProtB1 "Lambda control factor (delta) for enleanment protection (bank 1)" SWORD fak_sw_b1 1 100 -1.000000 0.999969 FORMAT "%8.6" ECU_ADDRESS 0x60000C12 /end MEASUREMENT
/begin MEASUREMENT LamCtrl_facCtrlDeltaLimCtrlB1 "Upper and lower limit (delta) of manipulated variable of lambda control during limit control (bank 1)" SWORD fak_sw_b1 1 100 -1.000000 0.999969 FORMAT "%8.6" ECU_ADDRESS 0x60000C10 /end MEASUREMENT
/begin MEASUREMENT LamCtrl_facCtrlDeltaMaxEnlnmtProtB1 "Maximum limit for delta control factor of lambda control during enleanment protection depending on current delta control factor, bank 1" SWORD fak_sw_b1 1 100 -1.000000 0.999969 FORMAT "%8.6" ECU_ADDRESS 0x60000C0E /end MEASUREMENT
/begin MEASUREMENT LamCtrl_facVBasB1 "Base value for controller velocity (bank 1)" UBYTE fak_q0p01 1 100 0.00 2.550 FORMAT "%5.3" ECU_ADDRESS 0x60000C0C /end MEASUREMENT
/begin MEASUREMENT LamCtrl_facVDlyAdpnB1 "Factor for lambda controller velocity at adapted delay time (bank 1)" UBYTE fak_ub_b2 1 100 0.00 1.992188 FORMAT "%8.6" ECU_ADDRESS 0x60000C0B /end MEASUREMENT
/begin MEASUREMENT LamCtrl_facVTranAdpnB1 "Factor for lambda controller velocity at adapted transition time (bank 1)" UBYTE fak_ub_b2 1 100 0.00 1.992188 FORMAT "%8.6" ECU_ADDRESS 0x60000C0A /end MEASUREMENT
/begin MEASUREMENT LamCtrl_flgEnlnmtProtActvB1 "Enleanment protection for continuous lambda control active, bank 1" UBYTE B_TRUE 1 100 0.00 1.00000000000 BIT_MASK 0x1 FORMAT "%13.11" ECU_ADDRESS 0x700006FF /end MEASUREMENT
/begin MEASUREMENT LamCtrl_flgHotStrt "Hot start detected" UBYTE B_TRUE 1 100 0.00 1.00000000000 BIT_MASK 0x1 FORMAT "%13.11" ECU_ADDRESS 0x60000BEC /end MEASUREMENT
/begin MEASUREMENT LamCtrl_flgLamBlwMinB1 "Lambda (measured and setpoint) below minimal measurable lambda, bank 1" UBYTE B_TRUE 1 100 0.00 1.00000000000 BIT_MASK 0x1 FORMAT "%13.11" ECU_ADDRESS 0x600000D8 /end MEASUREMENT
/begin MEASUREMENT LamCtrl_flgLamMeasBlwMinB1 "Lambda (measured) below minimal measurable lambda (bank 1)" UBYTE B_TRUE 1 100 0.00 1.00000000000 BIT_MASK 0x1 FORMAT "%13.11" ECU_ADDRESS 0x600000D7 /end MEASUREMENT
/begin MEASUREMENT LamCtrl_flgLamSpBlwMinB1 "Lambda (setpoint) below minimal measurable lambda (bank 1)" UBYTE B_TRUE 1 100 0.00 1.00000000000 BIT_MASK 0x1 FORMAT "%13.11" ECU_ADDRESS 0x600000D6 /end MEASUREMENT
/begin MEASUREMENT LamCtrl_flgRdnRstEnlnmtProtnB1 "Readiness for reset at enleanment protection (bank 1)" UBYTE B_TRUE 1 100 0.00 1.00000000000 BIT_MASK 0x1 FORMAT "%13.11" ECU_ADDRESS 0x600000D5 /end MEASUREMENT
/begin MEASUREMENT LamCtrl_LimCtrlB1RMP_I.Memory "instance lambda ramp, bank 1 / memory element" SLONG fak_sw_b1 1 100 -65536.0000000 65535.9999695 FORMAT "%13.7" ECU_ADDRESS 0x50000F0C /end MEASUREMENT
/begin MEASUREMENT LamCtrl_LimCtrlB1RMP_I.RmpEnd "instance lambda ramp, bank 1 / ramp end" UBYTE B_TRUE 1 100 0.00 1.00000000000 BIT_MASK 0x1 FORMAT "%13.11" ECU_ADDRESS 0x50000F10 /end MEASUREMENT
/begin MEASUREMENT LamCtrl_LrgVlvLftER_I.buffer "Rising edge on switching intake valve lift (large lift) / rising edge detected" UBYTE B_TRUE 1 100 0.00 1.00000000000 BIT_MASK 0x1 FORMAT "%13.11" ECU_ADDRESS 0x60000BDC /end MEASUREMENT
/begin MEASUREMENT LamCtrl_LrgVlvLftER_I.oldSignal "Rising edge on switching intake valve lift (large lift) / flag rising edge" UBYTE B_TRUE 1 100 0.00 1.00000000000 BIT_MASK 0x1 FORMAT "%13.11" ECU_ADDRESS 0x60000BDD /end MEASUREMENT
/begin MEASUREMENT LamCtrl_LrgVlvLftTOFV_I.outbit "Turn-off delay after switching to large intake valve lift / Output Bit" UBYTE B_TRUE 1 100 0.00 1.00000000000 BIT_MASK 0x1 FORMAT "%13.11" ECU_ADDRESS 0x50000F14 /end MEASUREMENT
/begin MEASUREMENT LamCtrl_LrgVlvLftTOFV_I.time "Turn-off delay after switching to large intake valve lift / Occured Time" UWORD t_q0p01 1 100 0.00 655.3500 FORMAT "%8.4" ECU_ADDRESS 0x50000F16 /end MEASUREMENT
/begin MEASUREMENT LamCtrl_mAirEnaStrtEndIK_I.memory "Air mass after start end to enable controller / current integrator value" ULONG m_q4p239Em7_g 1 100 0.00 1820.44907366 FORMAT "%13.8" ECU_ADDRESS 0x50000F18 /end MEASUREMENT
/begin MEASUREMENT LamCtrl_mAirEnaWrmUpThd "Current air mass threshold to enable controller during warm-up after" UWORD m_q0p0277_g 1 100 0.00 1820.417 FORMAT "%8.3" ECU_ADDRESS 0x60000BEA /end MEASUREMENT
/begin MEASUREMENT LamCtrl_mfExhB1 "mass flow exhaust gas (bank 1)" UWORD m_uw_b6553p5 1 100 0.00 6553.500 FORMAT "%8.3" ECU_ADDRESS 0x60000C08 /end MEASUREMENT
/begin MEASUREMENT LamCtrl_nEngLResLRS "Engine speed with low resolution (in FC LRS)" UBYTE nmot_ub_q40 1 100 0.00 10200. FORMAT "%5.0" ECU_ADDRESS 0x60000C06 /end MEASUREMENT
/begin MEASUREMENT LamCtrl_nEngLRS "Engine speed" SWORD EngN 1 100 -16384.00 16383.50 FORMAT "%8.2" ECU_ADDRESS 0x60000C04 /end MEASUREMENT
/begin MEASUREMENT LamCtrl_ratDlyTiB1 "Ratio of base delay time and delay time with dynamics adaptation for lambda control plant model, bank 1" UWORD t_q0p01 1 100 0.00 655.3500 FORMAT "%8.4" ECU_ADDRESS 0x60000C02 /end MEASUREMENT
/begin MEASUREMENT LamCtrl_ratFillgLRS "Relative air charge (in FC LRS)" UWORD rel_uw_q0p0234 1 100 0.00 1535.977 FORMAT "%8.3" ECU_ADDRESS 0x60000C00 /end MEASUREMENT
/begin MEASUREMENT LamCtrl_ratFillgLRSEB "Relative air charge (in FC LRSEB)" UWORD rel_uw_q0p0234 1 100 0.00 1535.977 FORMAT "%8.3" ECU_ADDRESS 0x60000AA0 /end MEASUREMENT
/begin MEASUREMENT LamCtrl_ratLamDifPrelB1 "Control difference in lambda or reciprocal lambda (always calculated preliminary value), bank 1" SWORD fak_sw_b1 1 100 -1.000000 0.999969 FORMAT "%8.6" ECU_ADDRESS 0x60005002 /end MEASUREMENT
/begin MEASUREMENT LamCtrl_ratTranTiB1 "Ratio of transition times (bank 1)" UWORD t_q0p01 1 100 0.00 655.3500 FORMAT "%8.4" ECU_ADDRESS 0x60000BFE /end MEASUREMENT
/begin MEASUREMENT LamCtrl_SmlVlvLftEF_I.buffer "Falling edge on switching intake valve lift (small lift) / memory to detect falling edge" UBYTE B_TRUE 1 100 0.00 1.00000000000 BIT_MASK 0x1 FORMAT "%13.11" ECU_ADDRESS 0x60000BDA /end MEASUREMENT
/begin MEASUREMENT LamCtrl_SmlVlvLftEF_I.oldSignal "Falling edge on switching intake valve lift (small lift) / memory to detect falling edge" UBYTE B_TRUE 1 100 0.00 1.00000000000 BIT_MASK 0x1 FORMAT "%13.11" ECU_ADDRESS 0x60000BDB /end MEASUREMENT
/begin MEASUREMENT LamCtrl_SmlVlvLftTOFV_I.outbit "Turn-off delay after switching to small intake valve lift / Output Bit" UBYTE B_TRUE 1 100 0.00 1.00000000000 BIT_MASK 0x1 FORMAT "%13.11" ECU_ADDRESS 0x60000BD6 /end MEASUREMENT
/begin MEASUREMENT LamCtrl_SmlVlvLftTOFV_I.time "Turn-off delay after switching to small intake valve lift / Occured Time" UWORD t_q0p01 1 100 0.00 655.3500 FORMAT "%8.4" ECU_ADDRESS 0x60000BD8 /end MEASUREMENT
/begin MEASUREMENT LamCtrl_tCEngDs "Coolant temperature at engine output" UBYTE temp_ub_q0p75_o48 1 100 -48.0 143.3 FORMAT "%5.1" ECU_ADDRESS 0x60000BFC /end MEASUREMENT
/begin MEASUREMENT LamCtrl_tEngEnlnmt "Engine temperature (for enleanment protection in FC LRSEB)" UBYTE temp_ub_q0p75_o48 1 100 -48.0 143.3 FORMAT "%5.1" ECU_ADDRESS 0x60000B0A /end MEASUREMENT
/begin MEASUREMENT LamCtrl_tEngStrtWrmUp "Engine temperature at start (for warm-up phase in FC LRSEB)" UBYTE temp_ub_q0p75_o48 1 100 -48.0 143.3 FORMAT "%5.1" ECU_ADDRESS 0x60000BE8 /end MEASUREMENT
/begin MEASUREMENT LamCtrl_tiAdpnMaxS1B1 "Maximal adapted delay or tranisition time (sensor 1, bank 1)" UWORD t_q0p01 1 100 0.00 655.3500 FORMAT "%8.4" ECU_ADDRESS 0x60000BFA /end MEASUREMENT
/begin MEASUREMENT LamCtrl_tiAftStrtEnd "time after end of start" UWORD t_q0p01 1 100 0.00 655.3500 FORMAT "%8.4" ECU_ADDRESS 0x60000BF8 /end MEASUREMENT
/begin MEASUREMENT LamCtrl_tiTurnOffDlyA "Actual turn-off delay for enleanment protection after acceleration enrichment" UWORD t_q0p01 1 100 0.00 655.3500 FORMAT "%8.4" ECU_ADDRESS 0x60004892 /end MEASUREMENT
/begin MEASUREMENT LamCtrl_tiTurnOffDlyDecel "Actual turn-off delay for enleanment protection after deceleration enleanment" UWORD t_q0p01 1 100 0.00 655.3500 FORMAT "%8.4" ECU_ADDRESS 0x60004890 /end MEASUREMENT
/begin MEASUREMENT lamssok_w_msg "Lambda setpoint for sensor after addition of trim control action" UWORD fak_uw_b16 1 100 0.00 15.99976 FORMAT "%8.5" ECU_ADDRESS 0x6000E31C /end MEASUREMENT
/begin MEASUREMENT lamzak_w_msg "measured lambda value corrected by external signal" UWORD fak_uw_b16 1 100 0.00 15.99976 FORMAT "%8.5" ECU_ADDRESS 0x60004BF2 /end MEASUREMENT
/begin MEASUREMENT lft1_w "long term fuel trim bank1" UWORD fak_uw_b2 1 100 0.00 1.999969 FORMAT "%8.6" ECU_ADDRESS 0x600036E4 /end MEASUREMENT
/begin MEASUREMENT longft1_w_msg "long term fuel trim bank1" UWORD fak_uw_b2 1 100 0.00 1.999969 FORMAT "%8.6" ECU_ADDRESS 0x60004816 /end MEASUREMENT
/begin MEASUREMENT lrdtwl_w "Turn-on delay of lambda control at warm-up" UWORD t_q0p1 1 100 0.00 6553.500 FORMAT "%8.3" ECU_ADDRESS 0x60000BE6 /end MEASUREMENT
/begin MEASUREMENT lrssig_msg "Controller bandwidth of closed loop lambda control upstream catalyst" UBYTE fak_q0p01 1 100 0.010 2.550 FORMAT "%5.3" ECU_ADDRESS 0x6000E454 /end MEASUREMENT
/begin MEASUREMENT LsComp_bLossCmpActvd "State of compensation of the switchable losses (False=OFF, True=ON)" UBYTE B_TRUE 1 100 0.00 1.00000000000 BIT_MASK 0x1 FORMAT "%13.11" ECU_ADDRESS 0x6000A174 /end MEASUREMENT
/begin MEASUREMENT LsComp_facCmpNoFlt "Compensation factor for loss compensation minus factor one" SWORD Fact 1 100 -1.000000 1.000000 FORMAT "%8.6" ECU_ADDRESS 0x600036DC /end MEASUREMENT
/begin MEASUREMENT LsComp_tqCmpActvSpdGovr "Part of compensated torque during active speed governor" SWORD Trq 1 100 -3276.800 3276.700 FORMAT "%8.3" ECU_ADDRESS 0x60005000 /end MEASUREMENT
/begin MEASUREMENT LsComp_tqConvLd "Gradient of torque load from the converter" SWORD Trq 1 100 -3276.800 3276.700 FORMAT "%8.3" ECU_ADDRESS 0x600036DA /end MEASUREMENT
/begin MEASUREMENT LsComp_tqDesCmpDt1 "Filtered value of desired compensation which will not be send throu ASD filter" SWORD Trq 1 100 -3276.800 3276.700 FORMAT "%8.3" ECU_ADDRESS 0x600036D8 /end MEASUREMENT
/begin MEASUREMENT LsComp_tqResv "Torque reserve for accessories" SWORD Trq 1 100 -3276.800 3276.700 FORMAT "%8.3" ECU_ADDRESS 0x60004FFE /end MEASUREMENT
/begin MEASUREMENT LsComp_tqSwilLossNotFild "Torque part of Switchable losses that has to bypass the ASD filter." SWORD Trq 1 100 -3276.800 3276.700 FORMAT "%8.3" ECU_ADDRESS 0x60004FFC /end MEASUREMENT
/begin MEASUREMENT lutsinvala_l_msg "bit-structure for delayed condition luts-signal invalid" ULONG dez 1 100 0.00 4294967295.00 FORMAT "%13.2" ECU_ADDRESS 0x600003DC /end MEASUREMENT
/begin MEASUREMENT lutsinvala_msg "bit-structure for delayed condition luts-signal invalid" UWORD dez 1 100 0.00 65535.00 FORMAT "%8.2" ECU_ADDRESS 0x70001C70 /end MEASUREMENT
/begin MEASUREMENT lutskzyl_w_msg "engine roughness test value, corrected, array with all cylinders" SWORD lu_MEx 1 100 -232.8306 232.8235 FORMAT "%8.4" ARRAY_SIZE 4 ECU_ADDRESS 0x70001D16 /end MEASUREMENT
/begin MEASUREMENT lutsk_w_msg "engine roughness test value, corrected" SWORD lu_MEx 1 100 -232.8306 232.8235 FORMAT "%8.4" ECU_ADDRESS 0x70001D1E /end MEASUREMENT
/begin MEASUREMENT lutszyl_w_msg "engine roughness test value, array with all cylinders" SWORD lu_MEx 1 100 -232.8306 232.8235 FORMAT "%8.4" ARRAY_SIZE 4 ECU_ADDRESS 0x70001D0E /end MEASUREMENT
/begin MEASUREMENT luts_w_msg "engine roughness test value" SWORD lu_MEx 1 100 -232.8306 232.8235 FORMAT "%8.4" ECU_ADDRESS 0x500007EC /end MEASUREMENT
/begin MEASUREMENT mdeemodfg "requests for reduction stages - release conditions" UBYTE dez 1 100 0.00 255.0 FORMAT "%5.1" ECU_ADDRESS 0x60000742 /end MEASUREMENT
/begin MEASUREMENT mdistratzz "Ramp-up factor for actual engine torque during start" UBYTE fak_ub_b2 1 100 0.00 1.992188 FORMAT "%8.6" ECU_ADDRESS 0x6000639F /end MEASUREMENT
/begin MEASUREMENT mdns_w_msg "torque after start" UWORD rel_uw_b100 1 100 0.00 99.99847 FORMAT "%8.5" ECU_ADDRESS 0x60000E64 /end MEASUREMENT
/begin MEASUREMENT mdsh_w_msg "altitude compensation of drag torque" SWORD rel_sw_b50 1 100 -50.00000 49.99847 FORMAT "%8.5" ECU_ADDRESS 0x60000E80 /end MEASUREMENT
/begin MEASUREMENT mdslw_w_msg "torque loss: charge exchange" UWORD rel_uw_b100 1 100 0.00 99.99847 FORMAT "%8.5" ECU_ADDRESS 0x60000E60 /end MEASUREMENT
/begin MEASUREMENT mdsmn_w "engine loss without pumping work" UWORD rel_uw_b100 1 100 0.00 99.99847 FORMAT "%8.5" ECU_ADDRESS 0x60000BCC /end MEASUREMENT
/begin MEASUREMENT mdsm_w_msg "Drag torque temperature component" UWORD rel_uw_b100 1 100 0.00 99.99847 FORMAT "%8.5" ECU_ADDRESS 0x60000E5E /end MEASUREMENT
/begin MEASUREMENT mdssta_w_msg "Engine-temperature-dependent component after start-up for drag torque" UWORD rel_uw_b100 1 100 0.00 99.99847 FORMAT "%8.5" ECU_ADDRESS 0x60000E5C /end MEASUREMENT
/begin MEASUREMENT mds_w_msg "engine drag torque" UWORD rel_uw_b100 1 100 0.00 99.99847 FORMAT "%8.5" ECU_ADDRESS 0x60000E62 /end MEASUREMENT
/begin MEASUREMENT MDVERMOT_facCorrnAlti_MP "Measurement point to hold altitude correction factor" UBYTE fak_ub_b4 1 100 0.00 3.984 FORMAT "%5.3" ECU_ADDRESS 0x70008C2C /end MEASUREMENT
/begin MEASUREMENT MDVERMOT_nEng_MP "Measurement point to store engine speed" UWORD nmot_uw_q0p25 1 100 0.00 16383.75 FORMAT "%8.2" ECU_ADDRESS 0x70008C2A /end MEASUREMENT
/begin MEASUREMENT MED2FSS_bdummy "Dummy variable in MED2FSS to avoid compiler warning" UBYTE B_TRUE 1 100 0.00 1.00000000000 BIT_MASK 0x1 FORMAT "%13.11" ECU_ADDRESS 0x600000D2 /end MEASUREMENT
/begin MEASUREMENT mibas_w_msg "indicated basic torque" UWORD rel_uw_b100 1 100 0.00 99.99847 FORMAT "%8.5" ECU_ADDRESS 0x6000062C /end MEASUREMENT
/begin MEASUREMENT mibminm_w_msg "average internal base torque, lower limit for given mode" UWORD rel_uw_b100 1 100 0.00 99.99847 FORMAT "%8.5" ECU_ADDRESS 0x500007EE /end MEASUREMENT
/begin MEASUREMENT mibmn_w_msg "internal base torque, lower limit for given mode" UWORD rel_uw_b100 1 100 0.00 99.99847 FORMAT "%8.5" ECU_ADDRESS 0x6000062E /end MEASUREMENT
/begin MEASUREMENT mibmx_w_msg "internal base torque, upper limit for given mode" UWORD rel_uw_b100 1 100 0.00 99.99847 FORMAT "%8.5" ECU_ADDRESS 0x60000632 /end MEASUREMENT
/begin MEASUREMENT midmd_msg "reference moment for misfire detection" UBYTE rel_ub_b99p6 1 100 0.00 99.61 FORMAT "%5.2" ECU_ADDRESS 0x70001C06 /end MEASUREMENT
/begin MEASUREMENT midmd_w_msg "reference moment for misfire detection" UWORD rel_uw_b100 1 100 0.00 99.99847 FORMAT "%8.5" ECU_ADDRESS 0x70001C6C /end MEASUREMENT
/begin MEASUREMENT miistz_w "Indicated engine torque high pressure phase, cylinder individual (actual value)" UWORD rel_uw_b100 1 100 0.00 99.99847 FORMAT "%8.5" ECU_ADDRESS 0x60000636 /end MEASUREMENT
/begin MEASUREMENT miist_w_msg "indicated real engine torque" UWORD rel_uw_b100 1 100 0.00 99.99847 FORMAT "%8.5" ECU_ADDRESS 0x60004BEE /end MEASUREMENT
/begin MEASUREMENT MILLmp_stMIL "MIL status (permanently illuminated, off, blink frequency)" UBYTE OneToOne 1 100 0.00 255.0 FORMAT "%5.1" ECU_ADDRESS 0x6000A799 /end MEASUREMENT
/begin MEASUREMENT MILLmp_stMILWoTstr "MIL status without tester intervention" UBYTE OneToOne 1 100 0.00 255.0 FORMAT "%5.1" ECU_ADDRESS 0x6000E45D /end MEASUREMENT
/begin MEASUREMENT MILLmp_stPs "status of the MIL lamp (on, off)" UBYTE OneToOne 1 100 0.00 255.0 BIT_MASK 0x1 FORMAT "%5.1" ECU_ADDRESS 0x6000A798 /end MEASUREMENT
/begin MEASUREMENT MILLmp_stReqBln "MIL request register for blinking MIL requests" UBYTE MILLmp_ReqVerb 1 100 0.00 255.000000000 FORMAT "%13.9" ECU_ADDRESS 0x600360F4 /end MEASUREMENT
/begin MEASUREMENT MILLmp_stReqOn "MIL request register for continuous MIL requests" UBYTE MILLmp_ReqVerb 1 100 0.00 255.000000000 FORMAT "%13.9" ECU_ADDRESS 0x600360F5 /end MEASUREMENT
/begin MEASUREMENT MILLmp_stSt "state of the MIL's state machine" UBYTE MILLmp_StVerb 1 100 0.00 129.000000000 FORMAT "%13.9" ECU_ADDRESS 0x6000E45E /end MEASUREMENT
/begin MEASUREMENT MILLmp_tiRmnBln "remaining time for MIL trigger during MIL_BLINK" UBYTE t50msxs_q0p05 1 100 0.00 12.75 FORMAT "%5.2" ECU_ADDRESS 0x6000B9F8 /end MEASUREMENT
/begin MEASUREMENT MILLmp_tiRmnSt "remaining state time for states with time trigger" UBYTE t1sxs_q1 1 100 0.00 255.0 FORMAT "%5.1" ECU_ADDRESS 0x6000B3C1 /end MEASUREMENT
/begin MEASUREMENT milshfra_w_msg "upper milsol(coordinated torque request for charge)threshold for learning range multiplicative mixture adaptation factor (FRA)" UWORD rel_uw_b100 1 100 0.00 99.99847 FORMAT "%8.5" ECU_ADDRESS 0x60004812 /end MEASUREMENT
/begin MEASUREMENT milshora_w_msg "upper milsol(coordinated torque request for charge)threshold for learning range additive correction of the mixture adaptation (ORA)" UWORD rel_uw_b100 1 100 0.00 99.99847 FORMAT "%8.5" ECU_ADDRESS 0x60004810 /end MEASUREMENT
/begin MEASUREMENT milslfra_w_msg "lower milsol(coordinated torque request for charge)threshold for learning range multiplicative mixture adaptation factor (FRA)" UWORD rel_uw_b100 1 100 0.00 99.99847 FORMAT "%8.5" ECU_ADDRESS 0x6000480E /end MEASUREMENT
/begin MEASUREMENT milslora_w_msg "lower milsol(coordinated torque request for charge)threshold for learning range additive correction of the mixture adaptation (ORA)" UWORD rel_uw_b100 1 100 0.00 99.99847 FORMAT "%8.5" ECU_ADDRESS 0x6000480C /end MEASUREMENT
/begin MEASUREMENT mimaxa_w_msg "maximum, currently attainable indicated torque" UWORD rel_uw_b100 1 100 0.00 99.99847 FORMAT "%8.5" ECU_ADDRESS 0x60004BE8 /end MEASUREMENT
/begin MEASUREMENT mimaxud_w_msg "maximum attainable relative inner torque for increase of inlet manifold pressure to current pressure upstream throttle" UWORD rel_uw_b100 1 100 0.00 99.99847 FORMAT "%8.5" ECU_ADDRESS 0x60004BE6 /end MEASUREMENT
/begin MEASUREMENT mimax_w_msg "maximum attainable indicated torque" UWORD rel_uw_b100 1 100 0.00 99.99847 FORMAT "%8.5" ECU_ADDRESS 0x60004BEA /end MEASUREMENT
/begin MEASUREMENT miofof_w_msg "upper torque limit to enable DMDFOF adaptation" SWORD md_q0p1 1 100 -3276.800 3276.700 FORMAT "%8.3" ECU_ADDRESS 0x70001D0C /end MEASUREMENT
/begin MEASUREMENT mioptl1h_w_msg "optimal torque at lambda = 1 homogeneous mode" UWORD rel_uw_b100 1 100 0.00 99.99847 FORMAT "%8.5" ECU_ADDRESS 0x500007F8 /end MEASUREMENT
/begin MEASUREMENT miopt_w_msg "optimum indicated torque" UWORD rel_uw_b100 1 100 0.00 99.99847 FORMAT "%8.5" ECU_ADDRESS 0x500007F6 /end MEASUREMENT
/begin MEASUREMENT MisfDet_nEngSync "engine speed synchronised" SWORD EngN 1 100 -16384.00 16383.50 FORMAT "%8.2" ECU_ADDRESS 0x60000546 /end MEASUREMENT
/begin MEASUREMENT MisfDet_nSetPLoDiff "low idle control deviation" SWORD EngN 1 100 -16384.00 16383.50 FORMAT "%8.2" ECU_ADDRESS 0x6000054A /end MEASUREMENT
/begin MEASUREMENT MisfDet_openPtDlyCntr "Debounce counter for detection of open drive train" UBYTE OneToOne 1 100 0.00 255.0 FORMAT "%5.1" ECU_ADDRESS 0x700018FC /end MEASUREMENT
/begin MEASUREMENT MisfDet_stAsr "Torque intervention by road handling control" UBYTE B_TRUE 1 100 0.00 1.00000000000 BIT_MASK 0x1 FORMAT "%13.11" ECU_ADDRESS 0x6000A7C7 /end MEASUREMENT
/begin MEASUREMENT MisfDet_stCatHeat "Condition catalyst heating for misfire detection" UBYTE B_TRUE 1 100 0.00 1.00000000000 BIT_MASK 0x1 FORMAT "%13.11" ECU_ADDRESS 0x50005D90 /end MEASUREMENT
/begin MEASUREMENT MisfDet_stDnAdpnRstReqAvs "Reset request Dn-adaptation via AVS" UBYTE B_TRUE 1 100 0.00 1.00000000000 BIT_MASK 0x1 FORMAT "%13.11" ECU_ADDRESS 0x6000A7BB /end MEASUREMENT
/begin MEASUREMENT MisfDet_stFcmClr "falg staus to request the fault memory clear" UBYTE B_TRUE 1 100 0.00 1.00000000000 BIT_MASK 0x1 FORMAT "%13.11" ECU_ADDRESS 0x50005D96 /end MEASUREMENT
/begin MEASUREMENT MisfDet_stFcmClr1000ms "Condition clear fault code memory (for 1000ms process)" UBYTE B_TRUE 1 100 0.00 1.00000000000 BIT_MASK 0x1 FORMAT "%13.11" ECU_ADDRESS 0x6000A7B8 /end MEASUREMENT
/begin MEASUREMENT MisfDet_stFcmClr100ms "Condition clear fault code memory (for 100ms process)" UBYTE B_TRUE 1 100 0.00 1.00000000000 BIT_MASK 0x1 FORMAT "%13.11" ECU_ADDRESS 0x6000A7B7 /end MEASUREMENT
/begin MEASUREMENT MisfDet_stFcmClr10ms "Condition clear fault code memory (for 10ms process)" UBYTE B_TRUE 1 100 0.00 1.00000000000 BIT_MASK 0x1 FORMAT "%13.11" ECU_ADDRESS 0x6000A7B6 /end MEASUREMENT
/begin MEASUREMENT MisfDet_stFcmClr200ms "Condition clear fault code memory (for 200ms process)" UBYTE B_TRUE 1 100 0.00 1.00000000000 BIT_MASK 0x1 FORMAT "%13.11" ECU_ADDRESS 0x6000A7B5 /end MEASUREMENT
/begin MEASUREMENT MisfDet_stFcmClr20ms "Condition clear fault code memory (for 20ms process)" UBYTE B_TRUE 1 100 0.00 1.00000000000 BIT_MASK 0x1 FORMAT "%13.11" ECU_ADDRESS 0x6000A7B4 /end MEASUREMENT
/begin MEASUREMENT MisfDet_stIdle "engine is in idle state" UBYTE B_TRUE 1 100 0.00 1.00000000000 BIT_MASK 0x1 FORMAT "%13.11" ECU_ADDRESS 0x50005D97 /end MEASUREMENT
/begin MEASUREMENT MisfDet_stInjLockdOpen "Status injector is locked open" UWORD OneToOne 1 100 0.00 65535.00 FORMAT "%8.2" ECU_ADDRESS 0x5000075C /end MEASUREMENT
/begin MEASUREMENT MisfDet_stMisfStiSync "state misfire was stimulated by misfire generator, synchronised" UBYTE B_TRUE 1 100 0.00 1.00000000000 BIT_MASK 0x1 FORMAT "%13.11" ECU_ADDRESS 0x6000A7B3 /end MEASUREMENT
/begin MEASUREMENT MisfDet_stMsr "condition MSR" UBYTE B_TRUE 1 100 0.00 1.00000000000 BIT_MASK 0x1 FORMAT "%13.11" ECU_ADDRESS 0x6000A7B2 /end MEASUREMENT
/begin MEASUREMENT MisfDet_stNoInj "Status no injection" UBYTE B_TRUE 1 100 0.00 1.00000000000 BIT_MASK 0x1 FORMAT "%13.11" ECU_ADDRESS 0x6000A7B1 /end MEASUREMENT
/begin MEASUREMENT MisfDet_stNoInjSync "no injection synchronised" UBYTE B_TRUE 1 100 0.00 1.00000000000 BIT_MASK 0x1 FORMAT "%13.11" ECU_ADDRESS 0x50005D9A /end MEASUREMENT
/begin MEASUREMENT MisfDet_stOpenPt "status drive train open" UBYTE B_TRUE 1 100 0.00 1.00000000000 BIT_MASK 0x1 FORMAT "%13.11" ECU_ADDRESS 0x50005D9B /end MEASUREMENT
/begin MEASUREMENT MisfDet_stRedStgTrqSyncSegTi "no injection cutoff request active synchronized with segment time" UBYTE B_TRUE 1 100 0.00 1.00000000000 BIT_MASK 0x1 FORMAT "%13.11" ECU_ADDRESS 0x6000A7AD /end MEASUREMENT
/begin MEASUREMENT MisfDet_stReIni "Condition - ECU is in state Re-Initialization (Used in synchronous task)" UBYTE B_TRUE 1 100 0.00 1.00000000000 BIT_MASK 0x1 FORMAT "%13.11" ECU_ADDRESS 0x50005D9D /end MEASUREMENT
/begin MEASUREMENT MisfDet_stReIni100ms "Condition ECU is in state ReIni (for 100ms process)" UBYTE B_TRUE 1 100 0.00 1.00000000000 BIT_MASK 0x1 FORMAT "%13.11" ECU_ADDRESS 0x6000A7B0 /end MEASUREMENT
/begin MEASUREMENT MisfDet_stReIni200ms "Condition ECU is in state ReIni (for 200ms process)" UBYTE B_TRUE 1 100 0.00 1.00000000000 BIT_MASK 0x1 FORMAT "%13.11" ECU_ADDRESS 0x6000A7AF /end MEASUREMENT
/begin MEASUREMENT MisfDet_stReIni20ms "Condition ECU is in state ReIni (for 20ms process)" UBYTE B_TRUE 1 100 0.00 1.00000000000 BIT_MASK 0x1 FORMAT "%13.11" ECU_ADDRESS 0x6000A7AE /end MEASUREMENT
/begin MEASUREMENT MisfDet_stSegTiAdpnRstReq "Reset request to segment time adaptation" UBYTE B_TRUE 1 100 0.00 1.00000000000 BIT_MASK 0x1 FORMAT "%13.11" ECU_ADDRESS 0x6000A7A4 /end MEASUREMENT
/begin MEASUREMENT MisfDet_tEng "engine temperature for MisfDet" SWORD Temp_Cels 1 100 -3549.940 3003.560 FORMAT "%8.3" ECU_ADDRESS 0x50005AEC /end MEASUREMENT
/begin MEASUREMENT MisfDet_tEngStrt "Engine temperature at start" SWORD Temp_Cels 1 100 -3549.940 3003.560 FORMAT "%8.3" ECU_ADDRESS 0x50005AEE /end MEASUREMENT
/begin MEASUREMENT MisfDet_tiEngRun "engine running time" UWORD t_q0p1 1 100 0.00 6553.500 FORMAT "%8.3" ECU_ADDRESS 0x60000560 /end MEASUREMENT
/begin MEASUREMENT MisfDet_tiEngRunSum "accumulated engine running time" UWORD t_q0p1 1 100 0.00 6553.500 FORMAT "%8.3" ECU_ADDRESS 0x60000562 /end MEASUREMENT
/begin MEASUREMENT MisfDet_tqAct "normed engine torque for misfire detection" UWORD rel_uw_b100 1 100 0.00 99.99847 FORMAT "%8.5" ECU_ADDRESS 0x60000564 /end MEASUREMENT
/begin MEASUREMENT MisfDet_tqBasc "base torque" UWORD rel_uw_b100 1 100 0.00 99.99847 FORMAT "%8.5" ECU_ADDRESS 0x5000076E /end MEASUREMENT
/begin MEASUREMENT MisfDet_tqBascSync "synchronised base torque" UWORD rel_uw_b100 1 100 0.00 99.99847 FORMAT "%8.5" ECU_ADDRESS 0x60000568 /end MEASUREMENT
/begin MEASUREMENT miufof_w_msg "lower torque limit to enable DMDFOF adaptation" SWORD md_q0p1 1 100 -3276.800 3276.700 FORMAT "%8.3" ECU_ADDRESS 0x70001D0A /end MEASUREMENT
/begin MEASUREMENT nofof_w_msg "upper engine speed limit to enable DMDFOF adaptation" UBYTE EngN_LRes 1 100 0.00 10200. FORMAT "%5.0" ECU_ADDRESS 0x70001C04 /end MEASUREMENT
/begin MEASUREMENT nufof_w_msg "lower engine speed limit to enable DMDFOF adaptation" UBYTE EngN_LRes 1 100 0.00 10200. FORMAT "%5.0" ECU_ADDRESS 0x70001C03 /end MEASUREMENT
/begin MEASUREMENT orahini_w_msg "additive correction of the mixture adaptation for HFM(Hot Film Meter) system at initialization" SWORD rel_sw_b1536 1 100 -1536.000 1535.953 FORMAT "%8.3" ECU_ADDRESS 0x60037F1A /end MEASUREMENT
/begin MEASUREMENT orah_w_msg "additive correction of the mixture adaptation for HFM(Hot Film Meter) system" SWORD rel_sw_b1536 1 100 -1536.000 1535.953 FORMAT "%8.3" ECU_ADDRESS 0x60037F1C /end MEASUREMENT
/begin MEASUREMENT orai_w_msg "additive correction of the mixture adaptation" SWORD rel_sw_b1536 1 100 -1536.000 1535.953 FORMAT "%8.3" ECU_ADDRESS 0x60004938 /end MEASUREMENT
/begin MEASUREMENT orak_w_msg "integration speed integrator ORA_IK" UWORD q0p0586_pc_DIV_s 1 100 0.00 3839.941 FORMAT "%8.3" ECU_ADDRESS 0x6000480A /end MEASUREMENT
/begin MEASUREMENT oramn_w "lower limit of additive correction factor(ora_w)" SWORD rel_sw_b1536 1 100 -1536.000 1535.953 FORMAT "%8.3" ECU_ADDRESS 0x60004936 /end MEASUREMENT
/begin MEASUREMENT oramx_w "upper limit of additive correction factor(ora_w) ." SWORD rel_sw_b1536 1 100 -1536.000 1535.953 FORMAT "%8.3" ECU_ADDRESS 0x60004934 /end MEASUREMENT
/begin MEASUREMENT orapini_w_msg "additive correction of the mixture adaptation (Pressure sensor based system) at initialization" SWORD rel_sw_b1536 1 100 -1536.000 1535.953 FORMAT "%8.3" ECU_ADDRESS 0x60037F16 /end MEASUREMENT
/begin MEASUREMENT orap_w_msg "additive correction of the mixture adaptation (pressure sensor based system)" SWORD rel_sw_b1536 1 100 -1536.000 1535.953 FORMAT "%8.3" ECU_ADDRESS 0x60037F18 /end MEASUREMENT
/begin MEASUREMENT oraw_w "additive correction of the mixture adaptation in warm engine operation mode" SWORD rel_sw_b1536 1 100 -1536.000 1535.953 FORMAT "%8.3" ECU_ADDRESS 0x600036E6 /end MEASUREMENT
/begin MEASUREMENT ora_w_msg "additive correction of the mixture adaptation" SWORD rel_sw_b1536 1 100 -1536.000 1535.953 FORMAT "%8.3" ECU_ADDRESS 0x6000493A /end MEASUREMENT
/begin MEASUREMENT phufraloc_msg "local physical urgency fra" UBYTE dez 1 100 0.00 255.0 FORMAT "%5.1" ECU_ADDRESS 0x60009FE7 /end MEASUREMENT
/begin MEASUREMENT phuoraloc_msg "local physical urgentcy ora" UBYTE dez 1 100 0.00 255.0 FORMAT "%5.1" ECU_ADDRESS 0x60009FE6 /end MEASUREMENT
/begin MEASUREMENT redeta_w "Reduction stage for cylinder individual fuel cutoff" UWORD fak_uw_b32 1 100 0.00 24.00000 FORMAT "%8.5" ECU_ADDRESS 0x60000492 /end MEASUREMENT
/begin MEASUREMENT redneu "new calculated cylinder cut-off step" UBYTE dez 1 100 0.00 24.00 FORMAT "%5.2" ECU_ADDRESS 0x60000743 /end MEASUREMENT
/begin MEASUREMENT redze "threshold between ignition intervention and injector disabling" UBYTE dez 1 100 0.00 24.00 FORMAT "%5.2" ECU_ADDRESS 0x60000744 /end MEASUREMENT
/begin MEASUREMENT redzenl "threshold between ignition intervention and injector disabling, limp home mode" UBYTE dez 1 100 0.00 24.00 FORMAT "%5.2" ECU_ADDRESS 0x60000745 /end MEASUREMENT
/begin MEASUREMENT redzenmx "threshold between ignition intervention and injector disabling, engine speed limitation" UBYTE dez 1 100 0.00 24.00 FORMAT "%5.2" ECU_ADDRESS 0x70001909 /end MEASUREMENT
/begin MEASUREMENT rka_w_msg "additive adaptive correction of the relative fuel amount" SWORD rel_sw_b1536 1 100 -1536.000 1535.953 FORMAT "%8.3" ECU_ADDRESS 0x50005C70 /end MEASUREMENT
/begin MEASUREMENT rlmdmax_w "maximum air-charge limited by maximum calibrated nominal torque and maximum calibrated air-charge" UWORD rel_uw_q0p0234 1 100 0.00 1535.977 FORMAT "%8.3" ECU_ADDRESS 0x600036D6 /end MEASUREMENT
/begin MEASUREMENT rlmds_w_msg "desired relative air charge" UWORD rel_uw_q0p0234 1 100 0.00 1535.977 FORMAT "%8.3" ECU_ADDRESS 0x60004BBA /end MEASUREMENT
/begin MEASUREMENT RngMod_trqComp "Torque to be compensated" SWORD md_sw_q0p1 1 100 0.00 3276.700 FORMAT "%8.3" ECU_ADDRESS 0x6000E2BE /end MEASUREMENT
/begin MEASUREMENT RngMod_trqCrSLeadMin "minimum stationary engine torque - Lead path" SWORD md_q0p1 1 100 -3276.800 3276.700 FORMAT "%8.3" ECU_ADDRESS 0x60004F50 /end MEASUREMENT
/begin MEASUREMENT RngMod_trqCrSLeadMinAvl "minimum stationary engine torque - Lead path (soft limit)" SWORD md_q0p1 1 100 -3276.800 3276.700 FORMAT "%8.3" ECU_ADDRESS 0x60004F4E /end MEASUREMENT
/begin MEASUREMENT RngMod_trqInrLeadMin "minimum stationary engine torque - Lead path" SWORD md_q0p1 1 100 -3276.800 3276.700 FORMAT "%8.3" ECU_ADDRESS 0x70002C7A /end MEASUREMENT
/begin MEASUREMENT RngMod_trqInrLeadMinAvl "minimum stationary engine torque - Lead path (soft limit)" SWORD md_q0p1 1 100 0.00 3276.700 FORMAT "%8.3" ECU_ADDRESS 0x6000E2C2 /end MEASUREMENT
/begin MEASUREMENT RngMod_trqInrMinAirChrg "torque at min. cylinder charge" SWORD md_q0p1 1 100 0.00 3276.700 FORMAT "%8.3" ECU_ADDRESS 0x70002C7C /end MEASUREMENT
/begin MEASUREMENT RngMod_trqLosEng "engine losses" SWORD md_sw_q0p1 1 100 0.00 3276.700 FORMAT "%8.3" ECU_ADDRESS 0x6000E2C6 /end MEASUREMENT
/begin MEASUREMENT tfraffv_w "Last initial value of tfraf_w" UWORD t_q0p2 1 100 0.00 13107.00 FORMAT "%8.2" ECU_ADDRESS 0x600036E2 /end MEASUREMENT
/begin MEASUREMENT tfraf_w "count down timer, switches between phy. urgencies fra" UWORD t_q0p2 1 100 0.00 13107.00 FORMAT "%8.2" ECU_ADDRESS 0x600036E0 /end MEASUREMENT
/begin MEASUREMENT TLRBAM_TOFV.outbit "Turn-off delay after acceleration enrichment / Output Bit" UBYTE B_TRUE 1 100 0.00 1.00000000000 BIT_MASK 0x1 FORMAT "%13.11" ECU_ADDRESS 0x60000BD2 /end MEASUREMENT
/begin MEASUREMENT TLRBAM_TOFV.time "Turn-off delay after acceleration enrichment / Occured Time" UWORD t_q0p01 1 100 0.00 655.3500 FORMAT "%8.4" ECU_ADDRESS 0x60000BD4 /end MEASUREMENT
/begin MEASUREMENT TLRHS_TONV.outbit "Turn-on delay after end of start / return value" UBYTE B_TRUE 1 100 0.00 1.00000000000 BIT_MASK 0x1 FORMAT "%13.11" ECU_ADDRESS 0x50000F20 /end MEASUREMENT
/begin MEASUREMENT TLRHS_TONV.time "Turn-on delay after end of start / expired delay time" UWORD t_q0p1 1 100 0.00 6553.500 FORMAT "%8.3" ECU_ADDRESS 0x50000F22 /end MEASUREMENT
/begin MEASUREMENT TLRVAM_TOFV.outbit "Turn-off delay after deceleration enleanment / Output Bit" UBYTE B_TRUE 1 100 0.00 1.00000000000 BIT_MASK 0x1 FORMAT "%13.11" ECU_ADDRESS 0x50000F24 /end MEASUREMENT
/begin MEASUREMENT TLRVAM_TOFV.time "Turn-off delay after deceleration enleanment / Occured Time" UWORD t_q0p01 1 100 0.00 655.3500 FORMAT "%8.4" ECU_ADDRESS 0x50000F26 /end MEASUREMENT
/begin MEASUREMENT tlrzwsa_w "Time running down after fuel cut-off for enabling lambda control" UWORD t_q0p1 1 100 0.00 6553.500 FORMAT "%8.3" ECU_ADDRESS 0x60000BE4 /end MEASUREMENT
/begin MEASUREMENT TMEAct_facIaAdv_a "extended ring buffer for cylinder individual ignition factor" UWORD fak_uw_b2 1 100 0.00 1.999969 FORMAT "%8.6" ARRAY_SIZE 4 ECU_ADDRESS 0x70001CAE /end MEASUREMENT
/begin MEASUREMENT TMECmb_facChrgAdv_a "stretching factor for torque calculation air charge path" UWORD fak_uw_b2 1 100 0.00 1.999969 FORMAT "%8.6" ARRAY_SIZE 4 ECU_ADDRESS 0x70001CA6 /end MEASUREMENT
/begin MEASUREMENT TMECmb_facIaBasAdv_a "stretching factor for base torque calculation" UWORD fak_uw_b2 1 100 0.00 1.000000 FORMAT "%8.6" ARRAY_SIZE 4 ECU_ADDRESS 0x70001C9E /end MEASUREMENT
/begin MEASUREMENT TMECmb_facIaBasMinAdv_a "stretching factor for calculation of minimum base torque" UWORD fak_uw_b2 1 100 0.00 1.000000 FORMAT "%8.6" ARRAY_SIZE 4 ECU_ADDRESS 0x70001C96 /end MEASUREMENT
/begin MEASUREMENT TMECmb_ratTqRefAdv_a "optimum indicated torque" UWORD rel_uw_b100 1 100 0.00 99.99847 FORMAT "%8.5" ARRAY_SIZE 4 ECU_ADDRESS 0x70001C8E /end MEASUREMENT
/begin MEASUREMENT TMECnv_etaIgnBasc "base ignition angle efficiency" UWORD fak_uw_b2 1 100 0.00 1.999969 FORMAT "%8.6" ECU_ADDRESS 0x70002C82 /end MEASUREMENT
/begin MEASUREMENT TMECnv_flgFacRedStgMax "activation of Interpolation factor for maximum reduction stage" UBYTE B_TRUE 1 100 0.00 1.00000000000 BIT_MASK 0x1 FORMAT "%13.11" ECU_ADDRESS 0x70001908 /end MEASUREMENT
/begin MEASUREMENT TMECnv_iaDesAdv_a "desired ign.angle from BC TME" SWORD zw_q2p9297Em3_deg_KW 1 100 -96.00000 95.99707 FORMAT "%8.5" ARRAY_SIZE 4 ECU_ADDRESS 0x70001D32 /end MEASUREMENT
/begin MEASUREMENT TMECnv_nrRedStg "calculated cylinder cut-off stage (before limitation)" UBYTE dez 1 100 0.00 24.00 FORMAT "%5.2" ECU_ADDRESS 0x6000072B /end MEASUREMENT
/begin MEASUREMENT TMECnv_nrRedStgContns "preliminary calculated cylinder cut-off stage (continuous)" UWORD fak_uw_b32 1 100 0.00 24.00000 FORMAT "%8.5" ECU_ADDRESS 0x60000466 /end MEASUREMENT
/begin MEASUREMENT TMECnv_nrRedStgHysAbv "hysteresis of reduction step at bigger desired red. step than actual value" SWORD fak_sw_b256 1 100 -2.000000 2.000000 FORMAT "%8.6" ECU_ADDRESS 0x60000468 /end MEASUREMENT
/begin MEASUREMENT TMECnv_nrRedStgHysBlw "hysteresis of reduction step at smaller desired red. step than actual value" SWORD fak_sw_b256 1 100 -2.000000 2.000000 FORMAT "%8.6" ECU_ADDRESS 0x6000046A /end MEASUREMENT
/begin MEASUREMENT TMECnv_ratTqInnrRefRed "optimum indicated torque considering reduction stage" UWORD rel_uw_b100 1 100 0.00 99.99847 FORMAT "%8.5" ECU_ADDRESS 0x700018FE /end MEASUREMENT
/begin MEASUREMENT TMECnv_ratTqRefCco "indicated reference torque for calculation of desired indivudual cutoff-stage" UWORD rel_uw_b100 1 100 0.00 99.99847 FORMAT "%8.5" ECU_ADDRESS 0x6000046C /end MEASUREMENT
/begin MEASUREMENT TMERng_ctBascDrvEnter "Local driving cycle counter for transition to drive state" UBYTE OneToOne 1 100 0.00 255.0 FORMAT "%5.1" ECU_ADDRESS 0x7000190E /end MEASUREMENT
/begin MEASUREMENT TMERng_ctDrvEntrMDMAX "Drive enter counter MDMAX" UBYTE OneToOne 1 100 0.00 255.0 FORMAT "%5.1" ECU_ADDRESS 0x6000639E /end MEASUREMENT
/begin MEASUREMENT TMERng_ctDrvEntrMDRLMN "Drive enter counter MDRLMN" UBYTE OneToOne 1 100 0.00 255.0 FORMAT "%5.1" ECU_ADDRESS 0x6000639D /end MEASUREMENT
/begin MEASUREMENT TMERng_etaAirChrgFild "Filtered air charge efficiency for torque calculation in MDRLMN" UWORD fak_uw_b2 1 100 0.00 1.999969 FORMAT "%8.6" ECU_ADDRESS 0x600036CE /end MEASUREMENT
/begin MEASUREMENT TMERng_etaChrg "efficiency for torque calculation air charge path" UWORD fak_uw_b2 1 100 0.00 1.999969 FORMAT "%8.6" ECU_ADDRESS 0x600005B6 /end MEASUREMENT
/begin MEASUREMENT TMERng_etaChrgWoCda "efficiency for torque calculation air charge path without cylinder deactivation" UWORD fak_uw_b2 1 100 0.00 1.999969 FORMAT "%8.6" ECU_ADDRESS 0x70001C8C /end MEASUREMENT
/begin MEASUREMENT TMERng_etaMinIaFild "Filtered ignition angle efficiency for torque calculation in MDRLMN" UWORD fak_uw_b2 1 100 0.00 1.999969 FORMAT "%8.6" ECU_ADDRESS 0x600036CC /end MEASUREMENT
/begin MEASUREMENT TMERng_facTqMaxFild "Maximum torque scaling factor, filtered" UWORD fak_uw_b2 1 100 0.00 1.999969 FORMAT "%8.6" ECU_ADDRESS 0x600036D4 /end MEASUREMENT
/begin MEASUREMENT TMERng_ratTqBascMinCylPred "indicated minimum torque including predicted air charge step" UWORD rel_uw_b100 1 100 0.00 99.99847 FORMAT "%8.5" ECU_ADDRESS 0x60004C54 /end MEASUREMENT
/begin MEASUREMENT TMERng_ratTqBascPred "predicted basic torque (from rlp_w)" UWORD rel_uw_b100 1 100 0.00 99.99847 FORMAT "%8.5" ECU_ADDRESS 0x60004C52 /end MEASUREMENT
/begin MEASUREMENT TME_etafueLT_I.memory "internal memory filter etafue / current lowpass value" ULONG dez 1 100 0.00 4294967295.00 FORMAT "%13.2" ECU_ADDRESS 0x60001380 /end MEASUREMENT
/begin MEASUREMENT TME_etazwmnLT_I.memory "internal memory filter etazwmn / current lowpass value" ULONG dez 1 100 0.00 4294967295.00 FORMAT "%13.2" ECU_ADDRESS 0x6000137C /end MEASUREMENT
/begin MEASUREMENT TME_nAvrgEngSpdLoc "Local varaible for engine speed" UWORD EngN 1 100 0.00 16383.50 FORMAT "%8.2" ECU_ADDRESS 0x70002B8E /end MEASUREMENT
/begin MEASUREMENT tmotlok "Engine- oiltemperature for drag torque calculation" UWORD temp_ub_q0p75_o48 1 100 -48.00 49103.25 FORMAT "%8.2" ECU_ADDRESS 0x60000BCA /end MEASUREMENT
/begin MEASUREMENT tmraaein_msg "ambient tmperature for forced activation of fuel mixture adaptation" UBYTE temp_ub_q0p75_o48 1 100 -48.0 143.3 FORMAT "%5.1" ECU_ADDRESS 0x60009FE3 /end MEASUREMENT
/begin MEASUREMENT tomdvermot "engine temperature (eng. coolant or cyl. head), local copy" UBYTE temp_ub_q0p75_o48 1 100 -48.0 143.3 FORMAT "%5.1" ECU_ADDRESS 0x60000BC9 /end MEASUREMENT
/begin MEASUREMENT toraffv_w "Last initial value of toraf_w" UWORD t_q0p2 1 100 0.00 13107.00 FORMAT "%8.2" ECU_ADDRESS 0x600036DE /end MEASUREMENT
/begin MEASUREMENT toraf_w_msg "count down timer, switched between three different phy. urgentses ora" UWORD t_q0p2 1 100 0.00 13107.00 FORMAT "%8.2" ECU_ADDRESS 0x600047E4 /end MEASUREMENT
/begin MEASUREMENT TrqCnv_numRedStgDem "calculated desired cylinder cut-off step" UBYTE dez 1 100 0.00 24.00 FORMAT "%5.2" ECU_ADDRESS 0x600007AD /end MEASUREMENT
/begin MEASUREMENT tsmdvermot "engine temperature at start (eng. coolant or cyl. head), local copy" UBYTE temp_ub_q0p75_o48 1 100 -48.0 143.3 FORMAT "%5.1" ECU_ADDRESS 0x60000BC8 /end MEASUREMENT
/begin MEASUREMENT tsroh_l_msg "segment duration (DMD) uncorrected" ULONG tsquant_l 1 100 0.00 214748364.750 FORMAT "%13.3" ECU_ADDRESS 0x500005FC /end MEASUREMENT
/begin MEASUREMENT zwsol_w_msg "desired ignition angle from torque intervention" SWORD zw_q2p9297Em3_deg_KW 1 100 -96.00000 95.99707 FORMAT "%8.5" ECU_ADDRESS 0x5000083E /end MEASUREMENT
/begin MEASUREMENT zzyldmd_msg "SW-cylinder counter for DMD" UBYTE OneToOne 1 100 0.00 255.0 FORMAT "%5.1" ECU_ADDRESS 0x500008CC /end MEASUREMENT
/begin MEASUREMENT zzyllfb_msg "SW-cylinder counter for DMD" UBYTE dez 1 100 0.00 255.0 FORMAT "%5.1" ECU_ADDRESS 0x500008CD /end MEASUREMENT
/begin FUNCTION LOCOS2SV "4.1.0     Interface Oxygen Sensors Location for OBD2 Service $01/$02" /begin DEF_CHARACTERISTIC CWLOCONOHK ExhCo_flgLsfNoxSnsrOptn_CW /end DEF_CHARACTERISTIC /begin OUT_MEASUREMENT ExhCo_Idx1d /end OUT_MEASUREMENT FUNCTION_VERSION "4.1.0" /end FUNCTION
/begin FUNCTION LRA "30001.28.1Lambda closed loop control; Adaptive pilot control"
 /begin DEF_CHARACTERISTIC CWFRAINIT CWLRADLSUCHK CWORAP CWRKANMIL CWRKANMOT DFRAABO DLAHPLRAMN DLAHPLRAMX DORAABO FFRAKFV FORAKFV FRADIFF FRAMN FRAMX FRARN FVLRAS IMTEFVDFRM INITFRA INITORA KFRKANMIL KLDFRKFRAK KLDFRKORAK KLFRKANMOT N0 NRKAB ORAMN ORAMX ORARN TMFVDFRM TTPDFRM /end DEF_CHARACTERISTIC
 /begin REF_CHARACTERISTIC ANZTILRA /end REF_CHARACTERISTIC
 /begin IN_MEASUREMENT anztib_w_msg B_abor_msg B_fedkapb_msg B_fedssb_msg B_fvgte_msg B_lrafra_msg B_lraora_msg B_lrareb_msg B_lrare_msg B_lr_msg B_nofra_msg B_noora_msg B_reqddskv_msg B_te_msg B_zora_msg CEngDsT_t Epm_nEngLRes FlMA_flgDSMClrLRAEB FlMA_flgIninFinshdAckd FlMA_flgIninTrig frm_w_msg imsteini_msg milsol_w_msg SyC_stSub TWCC_rPCtlPriB1 /end IN_MEASUREMENT
 /begin OUT_MEASUREMENT B_elsvga_msg B_fvdfrmeb_msg B_fvlra_msg B_orap_msg B_reqlra_msg dfrmk_w_msg dfrmtp_w_msg dfrm_w_msg FlMA_flgFncRqstMixAdpn fraini_w_msg frai_w_msg frak_w_msg fra_w_msg orahini_w_msg orah_w_msg orai_w_msg orak_w_msg orapini_w_msg orap_w_msg ora_w_msg rka_w_msg /end OUT_MEASUREMENT
 /begin LOC_MEASUREMENT B_frfvlra_FF.status B_fvdfrm B_lradlsuchk dfrmkb_w FlMA_facSubMulLamSnsrErr FlMA_flgDSMClrFra FlMA_flgDSMClrLRA FlMA_flgDSMClrLRAProc1 FlMA_flgDSMClrOra FlMA_nEng FlMA_ratSubAddlLamSnsrErr fraildcy_w framn_w framx_w fraw_w oramn_w oramx_w oraw_w /end LOC_MEASUREMENT
 FUNCTION_VERSION "30001.28.1" /end FUNCTION
/begin FUNCTION LRA2SV "3.6.0     Connection %LRA to OBD Service"
 /begin IN_MEASUREMENT anztib_w_msg FlMA_flgIninFinshdAckd FlMA_flgIninTrig frai_w_msg fra_w_msg InjSys_ratPrdcAirLamDes rka_w_msg rlp_w_msg /end IN_MEASUREMENT
 /begin OUT_MEASUREMENT longft1_w_msg /end OUT_MEASUREMENT
 /begin LOC_MEASUREMENT lft1_w /end LOC_MEASUREMENT
 FUNCTION_VERSION "3.6.0" /end FUNCTION
/begin FUNCTION LRAEB "30001.27.0_2.2.0Conditions adaptive pilot control"
 /begin DEF_CHARACTERISTIC ANZTILRA CWLRAEB CWLRAEBORA FlMA_facAftStrtWrmUp_C FlMA_stCfgEnaCnd KLFRAMILH KLFRAMILL KLORAMILH KLORAMILHF KLORAMILL KLTMRAA LAMGAFVMN LAMGAMN LAMGAMX NOLRA ORASPV TARA TMRAA TVLRA TVNLGA TVUBLRA TVUBLRAFRA TVUBLRAORA /end DEF_CHARACTERISTIC
 /begin REF_CHARACTERISTIC FRAMN FRAMX /end REF_CHARACTERISTIC
 /begin IN_MEASUREMENT anztib_w_msg B_bkvmsisr_msg B_fedssb_msg B_feete_msg B_frastab_msg B_lamkh_msg B_lr_msg B_orastab_msg B_reqlra_msg B_ukg_msg B_vl_msg CEngDsT_t CEngDsT_tStrt Com_flgLETNoInjCntrCdn DSM_TripChgFinshd Eep_EnvRamInvld EnvT_t Epm_nEngLRes fnswl_w_msg frai_w_msg lamsons_w_msg milsol_w_msg SyC_ctPostDrvLeave tans_msg UEGO_flgAirScav VehV_v /end IN_MEASUREMENT
 /begin OUT_MEASUREMENT B_avfra_msg B_avora_msg B_balra_msg B_lrab_msg B_lrafra_msg B_lraora_msg B_lrareb_msg B_lrare_msg B_nofra_msg B_noora_msg B_ubfra_msg B_ubora_msg B_ubphyfra_msg B_ubphyora_msg FlMA_flgAddlEnaCdn FlMA_flgBascEnaCdn FlMA_flgDsmClrFinshdAckd FlMA_flgDSMClrLRAEB FlMA_flgDsmClrTrig FlMA_flgIninFinshdAckd FlMA_flgIninTrig FlMA_flgTEngEnaCdn FlMA_tEngEna milshfra_w_msg milshora_w_msg milslfra_w_msg milslora_w_msg tmraaein_msg /end OUT_MEASUREMENT
 /begin LOC_MEASUREMENT B_fraprdy B_oraprdy FlMA_ctPostDrvLeave FlMA_nEngLRes FlMA_tCEngDsStrt FlMA_tEnv /end LOC_MEASUREMENT
 FUNCTION_VERSION "30001.27.0_2.2.0" /end FUNCTION
/begin FUNCTION LRAPHU "30001.11.0Formation of physical urgency of mixture adaptation"
 /begin DEF_CHARACTERISTIC KWTFRAMX KWTORAMX KWTPFRAMX KWTPORAMX PHUFRAHP PHUFRALP PHUORAHP PHUORALP TFRAFV TFRAINI TFRAPH TFRASTABZ TORAFDGS TORAFV TORAINI TORAPH TORASTA /end DEF_CHARACTERISTIC
 /begin IN_MEASUREMENT B_avfra_msg B_avora_msg B_edkvs_msg B_fdgser_msg B_frastab_msg B_fvlra_msg B_odgser_msg B_orastab_msg EngStrt_bFrstStrtEnd FlMA_flgDSMClrLRAEB FlMA_flgIninFinshdAckd FlMA_flgIninTrig /end IN_MEASUREMENT
 /begin OUT_MEASUREMENT B_refrast_msg B_reorast_msg phufraloc_msg phuoraloc_msg toraf_w_msg /end OUT_MEASUREMENT
 /begin LOC_MEASUREMENT FlMA_flgDSMClrLRAPHU tfraffv_w tfraf_w toraffv_w /end LOC_MEASUREMENT
 FUNCTION_VERSION "30001.11.0" /end FUNCTION
/begin FUNCTION LRS "1.57.1    Continuous lambda control"
 /begin DEF_CHARACTERISTIC CWLRMS CWLRS DFRMAX FRMAX FRMIN FRMINKH KFLRSSIG KLLRUW LADIFFTHR LALIUSMN LamCtrl_dfacCtrlDeltaLimCtrl_C LamCtrl_facCtrlDeltaMaxEnlnmtProtB1_T LamCtrl_facCtrlDeltaMinEnlnmtProtB1_T LamCtrl_facMinLim_M LamCtrl_facSigmaIdleCtrlB1_M LamCtrl_facVCtrlDif_T LamCtrl_facVDlyAdpn_T LamCtrl_facVTranAdpn_C LamCtrl_facVTranAdpn_T LamCtrl_ratLamSpCorrnB1_M LamCtrl_tiRampDe_T /end DEF_CHARACTERISTIC
 /begin REF_CHARACTERISTIC EGSDCmn_facLamCtrlVParl_C SNM07LSUW SRL08LSUW /end REF_CHARACTERISTIC
 /begin IN_MEASUREMENT B_gaeing_msg B_kh_msg B_lasostc_msg B_llr_msg B_lrmsbs_msg B_lrs_msg CEngDsT_t EGSDO2_tiDlyAdpnS1B1 EGSDO2_tiTranAdpnS1B1 Epm_nEng Epm_nEngLRes ExhMod_mfExhB1 InjSys_bMinPtdInjDurActv LamCtrl_nEngESPLANT LamCtrl_ratFillgPlaPrm LamCtrl_ratLamSpS1B1 rl_w_msg SyC_stSub tlrslb_w_msg tlrsl_w_msg tlrs_w_msg tnst_w_msg TWCC_facFlModlnB1 TWCC_rCtlPriB1 TWCC_rLamFltModlnB1 TWCC_rSetPUsGlbB1 UEGO_ratLamSymS1B1 zlamko_msg zlrslb_w_msg zlrsl_w_msg zlrs_w_msg /end IN_MEASUREMENT
 /begin OUT_MEASUREMENT B_frmax_msg B_frmin_msg B_frmn_msg B_lrnda_msg dfrmax_w_msg dfrmin_w_msg dfrmn_w_msg dfrmx_w_msg dfr_w_msg dlaso_msg frmn_w_msg frmx_w_msg frm_w_msg fr_w_msg ladiff_w_msg LamCtrl_flgEnlnmtProtActvB1 LamCtrl_ratLamDifPrelB1 lamssok_w_msg lamzak_w_msg lrssig_msg /end OUT_MEASUREMENT
 /begin LOC_MEASUREMENT blrs_IT.memory B_lrmsbs_ER.buffer B_lrmsbs_ER.oldSignal B_lrsrems B_teminlrs_ER.buffer B_teminlrs_ER.oldSignal B_temin_TOFFV.outbit B_temin_TOFFV.time dfrmnms_w IMC_B1.a0lrs_w IMC_B1.b0lrs_w IMC_B1.dfr_w IMC_B1.dfrpr_w IMC_B1.dlrs_w IMC_B1.m1lrs_w IMC_B1.n0lrs_w IMC_B1.planto_w IMC_B1.r1lrs_w IMC_B1.s0lrs_w IMC_B1.s1lrs_w IMC_B1.LRScl_DelayTime_ds_opt.buffer IMC_B1.LRScl_DelayTime_ds_opt.counter IMC_B1.LRScl_DelayTime_ds_opt.out_val IMC_B1.LRScl_DelayTime_ds_opt.pointer IMC_B1.LRScl_DelayTime_ds_opt.pointerIni LamCtrl_facCtrlDeltaEnlnmtProtB1 LamCtrl_facCtrlDeltaLimCtrlB1 LamCtrl_facCtrlDeltaMaxEnlnmtProtB1 LamCtrl_facVBasB1 LamCtrl_facVDlyAdpnB1 LamCtrl_facVTranAdpnB1 LamCtrl_flgLamBlwMinB1 LamCtrl_flgLamMeasBlwMinB1 LamCtrl_flgLamSpBlwMinB1 LamCtrl_flgRdnRstEnlnmtProtnB1 LamCtrl_LimCtrlB1RMP_I.Memory LamCtrl_LimCtrlB1RMP_I.RmpEnd LamCtrl_mfExhB1 LamCtrl_nEngLResLRS LamCtrl_nEngLRS LamCtrl_ratDlyTiB1 LamCtrl_ratFillgLRS LamCtrl_ratTranTiB1 LamCtrl_tCEngDs LamCtrl_tiAdpnMaxS1B1 LamCtrl_tiAftStrtEnd /end LOC_MEASUREMENT
 FUNCTION_VERSION "1.57.1" /end FUNCTION
/begin FUNCTION LRSEB "1.42.0    Activation conditions for continuous Lambda control"
 /begin DEF_CHARACTERISTIC CWLRSEB CWLRSEB2 DLAMXSA IMLEVABS IMLSALR LamCtrl_flgEnaWrmUpAirM_CW LamCtrl_mAirEnaWrmUpHotStrt_C LamCtrl_mAirEnaWrmUpSpst_T LamCtrl_mAirEnaWrmUp_T LamCtrl_tiDlyEnagPlaFco_C LamCtrl_tiEnlnmtProtLrgVlvLft_C LamCtrl_tiEnlnmtProtSmlVlvLft_C TASHS TLRBAM TLRHS TLRSZWSA TLRTMS TLRVAM TMSHS /end DEF_CHARACTERISTIC
 /begin REF_CHARACTERISTIC LALIUSMN /end REF_CHARACTERISTIC
 /begin IN_MEASUREMENT B_bag_msg B_bevab_msg B_eev_msg B_frmax_msg B_frmn_msg B_sa_msg B_sbblsu_msg B_stopz_msg B_vag_msg B_vhegfe_msg CEngDsT_t CEngDsT_tStrt EngStrt_bStrtEnd InjSys_bMinPtdInjDurActv LamCtrl_ratLamDifPrelB1 lamsons_w_msg lamssok_w_msg ml_w_msg rl_w_msg SyC_stSub tansst_msg tlrsl_w_msg zlrsl_w_msg /end IN_MEASUREMENT
 /begin OUT_MEASUREMENT B_eobdlr_msg B_lrmsbs_msg B_lrmstr_msg B_lrseta_msg B_lrssa_msg B_lrs_msg B_lr_msg B_mlevab_msg B_mlrsa_msg B_pspwl_msg LamCtrl_tiTurnOffDlyA LamCtrl_tiTurnOffDlyDecel /end OUT_MEASUREMENT
 /begin LOC_MEASUREMENT BMLEVAB.imlevab_l B_lrnbsnc B_mlrsa_FF.status B_pspaus LamCtrl_flgHotStrt LamCtrl_LrgVlvLftER_I.buffer LamCtrl_LrgVlvLftER_I.oldSignal LamCtrl_LrgVlvLftTOFV_I.outbit LamCtrl_LrgVlvLftTOFV_I.time LamCtrl_mAirEnaStrtEndIK_I.memory LamCtrl_mAirEnaWrmUpThd LamCtrl_ratFillgLRSEB LamCtrl_SmlVlvLftEF_I.buffer LamCtrl_SmlVlvLftEF_I.oldSignal LamCtrl_SmlVlvLftTOFV_I.outbit LamCtrl_SmlVlvLftTOFV_I.time LamCtrl_tEngEnlnmt LamCtrl_tEngStrtWrmUp lrdtwl_w TLRBAM_TOFV.outbit TLRBAM_TOFV.time TLRHS_TONV.outbit TLRHS_TONV.time TLRVAM_TOFV.outbit TLRVAM_TOFV.time tlrzwsa_w /end LOC_MEASUREMENT
 FUNCTION_VERSION "1.42.0" /end FUNCTION
/begin FUNCTION LsComp_TrqCalc "27.1.0    Calculation of compensation of accessory torque loss" /begin DEF_CHARACTERISTIC LsComp_bLossCmpActvd_C LsComp_tiFlt_C /end DEF_CHARACTERISTIC
 /begin IN_MEASUREMENT CoME_trqDesComp CoME_trqResv Conv_trqLd SpdGov_facComp VehMot_facCompAcs /end IN_MEASUREMENT
 /begin OUT_MEASUREMENT LsComp_bLossCmpActvd LsComp_tqCmpActvSpdGovr LsComp_tqResv LsComp_tqSwilLossNotFild /end OUT_MEASUREMENT
 /begin LOC_MEASUREMENT LsComp_facCmpNoFlt LsComp_tqConvLd LsComp_tqDesCmpDt1 /end LOC_MEASUREMENT
 FUNCTION_VERSION "27.1.0" /end FUNCTION
/begin FUNCTION MDBAS "11.12.1   Basic calculation for torque interface" /begin DEF_CHARACTERISTIC KFMIOP /end DEF_CHARACTERISTIC
 /begin IN_MEASUREMENT AirMod_ratChrgAirCylAdv_a AirMod_ratChrgAirCylAftSwtPred CoEOM_flgEomSwtActv Epm_ctCyl Epm_nEng etalab_w_msg Gen_ctCylAdv Ign_iaBas_s16 Ign_ia_LT SyC_ctDrvEnter zwopt_w_msg /end IN_MEASUREMENT
 /begin OUT_MEASUREMENT etafue_w_msg etazwbm_w_msg etazwb_w_msg etazwmnm_w_msg etazwmns_w etazwmn_w_msg mibas_w_msg mibminm_w_msg mibmn_w_msg mibmx_w_msg mioptl1h_w_msg miopt_w_msg TMECmb_facChrgAdv_a TMECmb_facIaBasAdv_a TMECmb_facIaBasMinAdv_a TMECmb_ratTqRefAdv_a TMERng_etaChrg TMERng_etaChrgWoCda TMERng_ratTqBascMinCylPred TMERng_ratTqBascPred /end OUT_MEASUREMENT
 /begin LOC_MEASUREMENT TMERng_ctBascDrvEnter /end LOC_MEASUREMENT
 FUNCTION_VERSION "11.12.1" /end FUNCTION
/begin FUNCTION MDFUE "10.5.0    Nominal-value input from nominal torque for airmass" /begin DEF_CHARACTERISTIC KFMIRL /end DEF_CHARACTERISTIC
 /begin IN_MEASUREMENT B_rlvheg_msg B_vhegfes_msg B_vhegs_msg drlvhepsrs_w_msg Epm_nEng etazwbm_w_msg milsol_w_msg TMERng_etaChrg /end IN_MEASUREMENT
 /begin OUT_MEASUREMENT drldvmds_w_msg rlmds_w_msg /end OUT_MEASUREMENT
 /begin LOC_MEASUREMENT etalfue_w TMECnv_etaIgnBasc /end LOC_MEASUREMENT
 FUNCTION_VERSION "10.5.0" /end FUNCTION
/begin FUNCTION MDIST "1.23.1    Engine torque calculation" /begin DEF_CHARACTERISTIC CWMDIST FMIISTSTN /end DEF_CHARACTERISTIC
 /begin IN_MEASUREMENT B_stendmd_msg Epm_ctCyl Epm_nEngTooth10ms Gen_ctCylAdv InjSys_stActRedStg miopt_w_msg zwopt_w_msg zwoutzyl_w_msg zzaehl_msg /end IN_MEASUREMENT
 /begin OUT_MEASUREMENT etazaist_w_msg etazwist_w_msg miistz_w miist_w_msg TMEAct_facIaAdv_a /end OUT_MEASUREMENT
 /begin LOC_MEASUREMENT B_mdist dzwi_w mdistratzz /end LOC_MEASUREMENT
 FUNCTION_VERSION "1.23.1" /end FUNCTION
/begin FUNCTION MDMAX "1.23.0    Calculation maximum indicated torque" /begin DEF_CHARACTERISTIC CWMDMAX KLETAVGMN TETAMIMX /end DEF_CHARACTERISTIC /begin REF_CHARACTERISTIC KFMIOP /end REF_CHARACTERISTIC
 /begin IN_MEASUREMENT Epm_nEng etafue_w_msg etazwbm_w_msg rldkmx_w_msg rlmxs_w_msg SyC_ctDrvEnter /end IN_MEASUREMENT
 /begin OUT_MEASUREMENT etamimx_w_msg mimaxa_w_msg mimaxud_w_msg mimax_w_msg /end OUT_MEASUREMENT
 /begin LOC_MEASUREMENT rlmdmax_w TMERng_ctDrvEntrMDMAX TMERng_facTqMaxFild /end LOC_MEASUREMENT
 FUNCTION_VERSION "1.23.0" /end FUNCTION
/begin FUNCTION MDRED "159.0.0   Calculation reduction stage from torque demand"
 /begin DEF_CHARACTERISTIC FREDMN FREDMX FREDTYP KLREDNMX REDHYOC REDHYOCESP REDHYOCGSN REDHYUC REDHYUCESP REDHYUCGSN REDMXGS REDZEM REDZEMNL TMECnv_flgRedStgMaxThdGbx_C TMECnv_RedStgMaxThdGbx_C /end DEF_CHARACTERISTIC
 /begin IN_MEASUREMENT CEngDsT_t ECT_bFCOEnaCmpnPrt ftrq2mi_w_msg Gbx_bLimp mibas_w_msg mibminm_w_msg PthSet_bOvrRun PthSet_stCylIndivCtOff PthSet_stTrgFCO PthSet_trqInrCtOff Tra_numGear /end IN_MEASUREMENT
 /begin OUT_MEASUREMENT B_mdeevb_msg B_mdee_msg B_redmxgs_msg TrqCnv_numRedStgDem /end OUT_MEASUREMENT
 /begin LOC_MEASUREMENT mdeemodfg redeta_w redneu redze redzenl redzenmx TMECnv_flgFacRedStgMax TMECnv_nrRedStg TMECnv_nrRedStgContns TMECnv_nrRedStgHysAbv TMECnv_nrRedStgHysBlw TMECnv_ratTqRefCco /end LOC_MEASUREMENT
 FUNCTION_VERSION "159.0.0" /end FUNCTION
/begin FUNCTION MDRLMN "1.14.0    Calculation torque for minimum charge" /begin DEF_CHARACTERISTIC CWMDRLMN KFETAVFZG KFTETAMIMN KLETADRLMN KLETAMN KLETAMNLL /end DEF_CHARACTERISTIC /begin REF_CHARACTERISTIC KFMIOP /end REF_CHARACTERISTIC
 /begin IN_MEASUREMENT APP_r Epm_nEng etafue_w_msg etazwbm_w_msg etazwmn_w_msg fmi2trq_w_msg rlfgmnho_w_msg rl_w_msg RngMod_trqCrSMin SyC_ctDrvEnter VehV_v /end IN_MEASUREMENT
 /begin OUT_MEASUREMENT RngMod_trqCrSLeadMin RngMod_trqCrSLeadMinAvl RngMod_trqInrLeadMin RngMod_trqInrLeadMinAvl RngMod_trqInrMinAirChrg /end OUT_MEASUREMENT
 /begin LOC_MEASUREMENT drlmn_w etazwmni_w facetazwmn_w TMERng_ctDrvEntrMDRLMN TMERng_etaAirChrgFild TMERng_etaMinIaFild TME_etafueLT_I.memory TME_etazwmnLT_I.memory TME_nAvrgEngSpdLoc /end LOC_MEASUREMENT
 FUNCTION_VERSION "1.14.0" /end FUNCTION
/begin FUNCTION MDTRIP "4.3.0     Calculation of torque reserve for short trip" /begin DEF_CHARACTERISTIC DMRAA KLMRKFHO /end DEF_CHARACTERISTIC
 /begin IN_MEASUREMENT B_faam_msg fmi2trq_w_msg PEnv_facCorrAlti Shtrp_rTrqSetPointDia /end IN_MEASUREMENT
 /begin OUT_MEASUREMENT EngReq_trqResvQckTst /end OUT_MEASUREMENT
 FUNCTION_VERSION "4.3.0" /end FUNCTION
/begin FUNCTION MDVERMOT "3.5.0     calculation engine losses"
 /begin DEF_CHARACTERISTIC DMDNSM DMDSTHZG FKTMOD KFMDS KFMDSM MDSH SNM16_UW SPS11MDSW ZMDNSMW /end DEF_CHARACTERISTIC
 /begin IN_MEASUREMENT AuxHtg_bActv B_llrein_msg CEngDsT_t CEngDsT_tStrt EngStrt_bStrtEnd Epm_nEng fmi2trq_w_msg HLSDem_nSetPTrck OilSwmpT_t PEnv_facCorrAlti PEnv_p psr_w_msg tans_msg /end IN_MEASUREMENT
 /begin OUT_MEASUREMENT dpsu_w_msg mdns_w_msg mdsh_w_msg mdslw_w_msg mdsm_w_msg mdssta_w_msg mds_w_msg RngMod_trqComp RngMod_trqLosEng /end OUT_MEASUREMENT
 /begin LOC_MEASUREMENT dtdmdsh kfmds_w mdsmn_w MDVERMOT_facCorrnAlti_MP MDVERMOT_nEng_MP tmotlok tomdvermot tsmdvermot /end LOC_MEASUREMENT
 FUNCTION_VERSION "3.5.0" /end FUNCTION
/begin FUNCTION MDZW "1.19.2    Calculation of torque in nominal ignition timing"
 /begin IN_MEASUREMENT ftrq2mi_w_msg Gen_ctCylAdv Ign_iaBas_s16 Ign_ia_LT InjSys_stActRedStg miopt_w_msg PthSet_bIAIntv PthSet_trqInrIA zwopt_w_msg /end IN_MEASUREMENT
 /begin OUT_MEASUREMENT B_nozwe_msg etazwsol_w_msg TMECnv_iaDesAdv_a zwsol_w_msg /end OUT_MEASUREMENT
 /begin LOC_MEASUREMENT TMECnv_ratTqInnrRefRed /end LOC_MEASUREMENT
 FUNCTION_VERSION "1.19.2" /end FUNCTION
/begin FUNCTION MED2ADC "3.2.0     Interface adapter MED to ADC"
 /begin IN_MEASUREMENT ChrCtl_flgChrgCalcnTiBasd rl_msg rl_w_msg rml_msg umsrln_w_msg /end IN_MEASUREMENT
 /begin OUT_MEASUREMENT AirMod_mfGasIntkVlv AirSys_rChCyl AirSys_rChCylLRes AirSys_rChrgCyl AirSys_rMsCyl /end OUT_MEASUREMENT
 FUNCTION_VERSION "3.2.0" /end FUNCTION
/begin FUNCTION MED2ATC "4.1.0     Interface adapter MED to ATC"
 /begin IN_MEASUREMENT B_mdfasfk_msg B_mdfasnl_msg B_mdmin_msg B_ugd_msg ChrCtl_flgChrgCalcnTiBasd msdk_w_msg SyC_stSub ThrVlv_ratActPosnB1 ThrVlv_ratLimpAirPosnB1 /end IN_MEASUREMENT
 /begin OUT_MEASUREMENT AirSys_bMinPsblIdcTrqRea AirSys_bThrVlvUnthr AirSys_bTrqInflCmft AirSys_bTrqInflLimp AirSys_mAirThrVlv AirSys_rPhiThrVlv /end OUT_MEASUREMENT
 FUNCTION_VERSION "4.1.0" /end FUNCTION
/begin FUNCTION MED2ECT "3.2.0     Interface adapter MED to ECT" /begin REF_CHARACTERISTIC MDNORM /end REF_CHARACTERISTIC /begin IN_MEASUREMENT B_kh_msg B_sabbts_msg etakh_w_msg SyC_stSub /end IN_MEASUREMENT /begin OUT_MEASUREMENT EGSys_bCH EGSys_bFCORdnCoPr EGSys_etaCH EGSys_trqResvCH /end OUT_MEASUREMENT FUNCTION_VERSION "3.2.0" /end FUNCTION
/begin FUNCTION MED2EnvP "3.3.0     Interface Adapter MED to EnvP" /begin DEF_CHARACTERISTIC EnvP_pDfl_C /end DEF_CHARACTERISTIC /begin IN_MEASUREMENT PEnv_p /end IN_MEASUREMENT /begin OUT_MEASUREMENT EnvP_p /end OUT_MEASUREMENT FUNCTION_VERSION "3.3.0" /end FUNCTION
/begin FUNCTION MED2EnvT "4.5.0     Interface Adapter MED to EnvT" /begin DEF_CHARACTERISTIC EnvT_tDfl_C /end DEF_CHARACTERISTIC /begin IN_MEASUREMENT tumg_msg /end IN_MEASUREMENT /begin OUT_MEASUREMENT EnvT_tMod /end OUT_MEASUREMENT FUNCTION_VERSION "4.5.0" /end FUNCTION
/begin FUNCTION MED2FSS "51.6.0    Interface adapter MED to FSS" /begin LOC_MEASUREMENT MED2FSS_bdummy /end LOC_MEASUREMENT FUNCTION_VERSION "51.6.0" /end FUNCTION
/begin FUNCTION MEDC_Axispoints_Custom "14700.0.0_1.0.0customer specific axispoints" FUNCTION_VERSION "14700.0.0_1.0.0" /end FUNCTION
/begin FUNCTION MEDC_Compu_Core_CELPrj "30059.0.0 Computation Methods for core, which are migrated from DS classis" FUNCTION_VERSION "30059.0.0" /end FUNCTION
/begin FUNCTION MEDC_Compu_Custom "1.0.0_1.0.0deprectared: have to be migrated to CEL_Compu" FUNCTION_VERSION "1.0.0_1.0.0" /end FUNCTION
/begin FUNCTION MEDC_Compu_Custom_CELPrj "30059.0.0 Customer specific computation formulas from Clearcase" FUNCTION_VERSION "30059.0.0" /end FUNCTION
/begin FUNCTION MEDC_Compu_DS_CELPrj "30059.0.0 computation methods of DS from Clearcase" FUNCTION_VERSION "30059.0.0" /end FUNCTION
/begin FUNCTION MEDC_Compu_DS_GS_CELPrj "30059.0.0 computation methods, common used by DS and GS from Clearcase" FUNCTION_VERSION "30059.0.0" /end FUNCTION
/begin FUNCTION MEDC_FixConst_Core_CELPrj "30059.0.0 central system constants of the core from Clearcase" FUNCTION_VERSION "30059.0.0" /end FUNCTION
/begin FUNCTION MEDC_FixConst_Custom "1.3.0_1.0.0deprectared: have to be migrated to CEL_Const" FUNCTION_VERSION "1.3.0_1.0.0" /end FUNCTION
/begin FUNCTION MEDC_FixConst_Custom_CELPrj "30059.0.0 Customer specific central system constants from Clearcase" FUNCTION_VERSION "30059.0.0" /end FUNCTION
/begin FUNCTION MEDC_FixConst_DS_CELPrj "30059.0.0 DS central system constants from Clearcase" FUNCTION_VERSION "30059.0.0" /end FUNCTION
/begin FUNCTION MEDC_FixConst_DS_GS_CELPrj "30059.0.0 central systemkonstants, common used by DS and GS from Clearcase" FUNCTION_VERSION "30059.0.0" /end FUNCTION
/begin FUNCTION MEDC_Models_DS_CELPrj "30059.0.0 models DS from Clearcase" FUNCTION_VERSION "30059.0.0" /end FUNCTION
/begin FUNCTION MEDC_Models_DS_GS_CELPrj "30059.0.0 common models GS and DS from Clearcase" FUNCTION_VERSION "30059.0.0" /end FUNCTION
/begin FUNCTION MEDC_SimpleModels "30001.0.0 Simple models for diesel gasoline systems" FUNCTION_VERSION "30001.0.0" /end FUNCTION
/begin FUNCTION MILLmp_DD "1.10.0    Device Driver for the MIL Control" /begin IN_MEASUREMENT MILLmp_stReqBln MILLmp_stReqOn SyC_stSub /end IN_MEASUREMENT /begin OUT_MEASUREMENT ErrLmp_stMIL MILLmp_stMIL MILLmp_stPs /end OUT_MEASUREMENT /begin LOC_MEASUREMENT MILLmp_tiRmnBln /end LOC_MEASUREMENT FUNCTION_VERSION "1.10.0" /end FUNCTION
/begin FUNCTION MILLmp_VD "1.19.0    Virtual Device for the MIL Control"
 /begin DEF_CHARACTERISTIC MILLmp_stMILCfg_CW MILLmp_tiAftStrt_C MILLmp_tiRdnBln_C MILLmp_tiVisTst_C /end DEF_CHARACTERISTIC
 /begin OUT_MEASUREMENT MILLmp_stReqBln MILLmp_stReqOn /end OUT_MEASUREMENT
 /begin LOC_MEASUREMENT MILLmp_stMILWoTstr MILLmp_stSt MILLmp_tiRmnSt /end LOC_MEASUREMENT
 FUNCTION_VERSION "1.19.0" /end FUNCTION
/begin FUNCTION MisfDet_AdpPrj "100.22.0  Softwareadapter Misfire Detection" /begin DEF_CHARACTERISTIC CWDMDZAG /end DEF_CHARACTERISTIC
 /begin IN_MEASUREMENT Clth_st MisfDet_cylCntr MisfDet_cylCntrSegTi MisfDet_dn MisfDet_dnAdpnQlyFac MisfDet_dnAdpnVal MisfDet_dnCyl MisfDet_dnDly MisfDet_dnRaw MisfDet_dnRawCyl MisfDet_flgRoughRoad MisfDet_maskMisfStiIgn MisfDet_maskMisfStiInj MisfDet_misfCntrCyl MisfDet_segTiAdpnNMax MisfDet_segTiAdpnNMin MisfDet_segTiAdpnTqMax MisfDet_segTiAdpnTqMin MisfDet_segTiRawAry MisfDet_stBlkStc MisfDet_stCatDmg MisfDet_stCatDmgBnk MisfDet_stCatDmgFcoCyl MisfDet_stcCatIgnCntr MisfDet_stcCatMisfCntrBnk MisfDet_stcCatMisfCntrCyl MisfDet_stcEmiIgnCntr MisfDet_stcEmiMisfCntrCyl MisfDet_stcEmiMisfCntrSum MisfDet_stCntMisf MisfDet_stDet MisfDet_stDnAdpnNvCalc MisfDet_stDnAdpnNvRdyCurr MisfDet_stDnDet MisfDet_stExhDmgSuspc MisfDet_stMisfCont MisfDet_stSegTiAdpnActv MisfDet_stSegTiAdpnEna MisfDet_stSegTiAdpnRdy MisfDet_stSegTiAdpnRdyPosn MisfDet_stSegTiVld MisfDet_stTqZero MisfDet_tqBasc MisfDet_tqBascSync /end IN_MEASUREMENT
 /begin OUT_MEASUREMENT B_abgien_msg B_cntmde_msg B_dlutsk_msg B_dmddiszg_msg B_fofadpen_msg B_fofresf_msg B_fofrkh_msg B_fofrun_msg B_fofr_msg B_fonr_msg B_forun_msg B_lutsk_msg B_mdarv_msg B_mderk_msg B_mdkat_msg B_mdmi_msg B_mdstop_msg B_milstp_msg B_MisfCont_msg B_swe_msg B_tsbready_msg B_tsroov_msg flgmdkatbnk_msg flgstign_w_msg flgstinj_w_msg flgtiab_msg fofstat_msg fonstat_msg fsr_w_msg fzabgs_w_msg fzabgzyl_w_msg fzkatsb_w_msg fzkats_w_msg fzkatzyl_w_msg fzmdzyl_w_msg ivzabg_w_msg ivzkat_w_msg lutsinvala_l_msg lutsinvala_msg lutskzyl_w_msg lutsk_w_msg lutszyl_w_msg luts_w_msg midmd_msg midmd_w_msg miofof_w_msg miufof_w_msg nofof_w_msg nufof_w_msg tsroh_l_msg zzyldmd_msg zzyllfb_msg /end OUT_MEASUREMENT
 FUNCTION_VERSION "100.22.0" /end FUNCTION
/begin FUNCTION MisfDet_CmnMisc "1.42.0    Misfire detection, Common functions and encapsulation of variables"
 /begin DEF_CHARACTERISTIC MisfDet_nSetPLoDiffMax_C MisfDet_openPtDlyCntr_C MisfDet_redStgDly_C MisfDet_stCfgOpenPt_C MisfDet_stCmnMiscCfg_C MisfDet_tqNrm_C /end DEF_CHARACTERISTIC
 /begin REF_CHARACTERISTIC MisfDet_thdNEngStrt_C /end REF_CHARACTERISTIC
 /begin IN_MEASUREMENT ActMod_trqInr B_asr_msg B_evasldel_msg B_khakt_msg B_kh_msg B_ll_msg B_msr_msg CEngDsT_t Epm_nEng HLSDem_nSetPLoDiff InjSys_flgNoInjReq InjSys_stActRedStg MisfDet_dnDly MisfDet_segTiDly MisfDet_stDnAdpnRstCfm MisfDet_stMisfSti MisfDet_stSegTiAdpnRstCfm SyC_stSub Tra_numGear VehV_v /end IN_MEASUREMENT
 /begin OUT_MEASUREMENT MisfDet_nEngSync MisfDet_nSetPLoDiff MisfDet_stAsr MisfDet_stCatHeat MisfDet_stDnAdpnRstReqAvs MisfDet_stFcmClr MisfDet_stFcmClr1000ms MisfDet_stFcmClr100ms MisfDet_stFcmClr10ms MisfDet_stFcmClr200ms MisfDet_stFcmClr20ms MisfDet_stIdle MisfDet_stInjLockdOpen MisfDet_stMisfStiSync MisfDet_stMsr MisfDet_stNoInj MisfDet_stNoInjSync MisfDet_stOpenPt MisfDet_stRedStgTrqSyncSegTi MisfDet_stReIni MisfDet_stReIni100ms MisfDet_stReIni200ms MisfDet_stReIni20ms MisfDet_stSegTiAdpnRstReq MisfDet_tEng MisfDet_tEngStrt MisfDet_tiEngRun MisfDet_tiEngRunSum MisfDet_tqAct MisfDet_tqBasc MisfDet_tqBascSync /end OUT_MEASUREMENT
 /begin LOC_MEASUREMENT MisfDet_openPtDlyCntr /end LOC_MEASUREMENT
 FUNCTION_VERSION "1.42.0" /end FUNCTION
/begin COMPU_METHOD B_TRUE "" TAB_VERB "%6.3" "" COMPU_TAB_REF B_TRUE /end COMPU_METHOD
/begin COMPU_VTAB B_TRUE "" TAB_VERB 2 0 "FALSE" 1 "TRUE" /end COMPU_VTAB
/begin COMPU_METHOD dez "" RAT_FUNC "%6.2" "" COEFFS 0 1 0 0 0 1 /end COMPU_METHOD
/begin COMPU_METHOD EngN "" RAT_FUNC "%6.3" "rpm" COEFFS 0 2 0 0 0 1 /end COMPU_METHOD
/begin COMPU_METHOD EngN_LRes "" RAT_FUNC "%6.1" "rpm" COEFFS 0 0.025 0 0 0 1 /end COMPU_METHOD
/begin COMPU_METHOD Fact "" RAT_FUNC "%6.5" "-" COEFFS 0 8192 0 0 0 1 /end COMPU_METHOD
/begin COMPU_METHOD fak_q0p01 "" RAT_FUNC "%6.4" "" COEFFS 0 100 0 0 0 1 /end COMPU_METHOD
/begin COMPU_METHOD fak_q9p3132Em10 "" RAT_FUNC "%12.11" "-" COEFFS 0 1073741824 0 0 0 1 /end COMPU_METHOD
/begin COMPU_METHOD fak_sb_b0p03125 "" RAT_FUNC "%6.5" "-" COEFFS 0 256 0 0 0 0.0625 /end COMPU_METHOD
/begin COMPU_METHOD fak_sb_b1 "" RAT_FUNC "%6.4" "-" COEFFS 0 256 0 0 0 2 /end COMPU_METHOD
/begin COMPU_METHOD fak_sw_b1 "" RAT_FUNC "%7.6" "-" COEFFS 0 65536 0 0 0 2 /end COMPU_METHOD
/begin COMPU_METHOD fak_sw_b256 "" RAT_FUNC "%6.4" "-" COEFFS 0 65536 0 0 0 512 /end COMPU_METHOD
/begin COMPU_METHOD fak_ub_b1 "" RAT_FUNC "%6.4" "-" COEFFS 0 256 0 0 0 1 /end COMPU_METHOD
/begin COMPU_METHOD fak_ub_b16 "" RAT_FUNC "%6.4" "-" COEFFS 0 256 0 0 0 16 /end COMPU_METHOD
/begin COMPU_METHOD fak_ub_b2 "" RAT_FUNC "%8.5" "-" COEFFS 0 256 0 0 0 2 /end COMPU_METHOD
/begin COMPU_METHOD fak_ub_b32 "" RAT_FUNC "%6.3" "-" COEFFS 0 256 0 0 0 32 /end COMPU_METHOD
/begin COMPU_METHOD fak_ub_b4 "" RAT_FUNC "%6.4" "-" COEFFS 0 256 0 0 0 4 /end COMPU_METHOD
/begin COMPU_METHOD fak_uw_b16 "" RAT_FUNC "%6.5" "-" COEFFS 0 65536 0 0 0 16 /end COMPU_METHOD
/begin COMPU_METHOD fak_uw_b2 "" RAT_FUNC "%7.6" "-" COEFFS 0 65536 0 0 0 2 /end COMPU_METHOD
/begin COMPU_METHOD fak_uw_b32 "" RAT_FUNC "%6.5" "-" COEFFS 0 65536 0 0 0 32 /end COMPU_METHOD
/begin COMPU_METHOD fak_uw_b4 "" RAT_FUNC "%7.6" "-" COEFFS 0 65536 0 0 0 4 /end COMPU_METHOD
/begin COMPU_METHOD freq_q3p0518Em5 "" RAT_FUNC "%7.6" "1/s" COEFFS 0 65536 0 0 0 2 /end COMPU_METHOD
/begin COMPU_METHOD lu_MEx "" RAT_FUNC "%6.4" "(Umdr./sec)^2" COEFFS 0 140.7374884 0 0 0 1 /end COMPU_METHOD
/begin COMPU_METHOD md_q0p1 "" RAT_FUNC "%6.3" "Nm" COEFFS 0 10 0 0 0 1 /end COMPU_METHOD
/begin COMPU_METHOD md_sw_q0p1 "" RAT_FUNC "%6.3" "Nm" COEFFS 0 10 0 0 0 1 /end COMPU_METHOD
/begin COMPU_METHOD MILLmp_ReqVerb "" TAB_VERB "%6.3" "" COMPU_TAB_REF MILLmp_ReqVerb /end COMPU_METHOD
/begin COMPU_VTAB MILLmp_ReqVerb "" TAB_VERB 256 0 "---|---|---|---|---|---|---|---" 1 "---|---|---|---|---|---|---|FES" 2 "---|---|---|---|---|---|DMD|---" 3 "---|---|---|---|---|---|DMD|FES" 4 "---|---|---|---|---|TRA|---|---" 5 "---|---|---|---|---|TRA|---|FES" 6 "---|---|---|---|---|TRA|DMD|---" 7 "---|---|---|---|---|TRA|DMD|FES" 8 "---|---|---|---|ECU1|---|---|---" 9 "---|---|---|---|ECU1|---|---|FES" 10 "---|---|---|---|ECU1|---|DMD|---" 11 "---|---|---|---|ECU1|---|DMD|FES" 12 "---|---|---|---|ECU1|TRA|---|---" 13 "---|---|---|---|ECU1|TRA|---|FES" 14 "---|---|---|---|ECU1|TRA|DMD|---" 15 "---|---|---|---|ECU1|TRA|DMD|FES" 16 "---|---|---|ECU2|---|---|---|---" 17 "---|---|---|ECU2|---|---|---|FES" 18 "---|---|---|ECU2|---|---|DMD|---" 19 "---|---|---|ECU2|---|---|DMD|FES" 20 "---|---|---|ECU2|---|TRA|---|---" 21 "---|---|---|ECU2|---|TRA|---|FES" 22 "---|---|---|ECU2|---|TRA|DMD|---" 23 "---|---|---|ECU2|---|TRA|DMD|FES" 24 "---|---|---|ECU2|ECU1|---|---|---" 25 "---|---|---|ECU2|ECU1|---|---|FES" 26 "---|---|---|ECU2|ECU1|---|DMD|---" 27 "---|---|---|ECU2|ECU1|---|DMD|FES" 28 "---|---|---|ECU2|ECU1|TRA|---|---" 29 "---|---|---|ECU2|ECU1|TRA|---|FES" 30 "---|---|---|ECU2|ECU1|TRA|DMD|---" 31 "---|---|---|ECU2|ECU1|TRA|DMD|FES" 32 "---|---|ECU3|---|---|---|---|---" 33 "---|---|ECU3|---|---|---|---|FES" 34 "---|---|ECU3|---|---|---|DMD|---" 35 "---|---|ECU3|---|---|---|DMD|FES" 36 "---|---|ECU3|---|---|TRA|---|---" 37 "---|---|ECU3|---|---|TRA|---|FES" 38 "---|---|ECU3|---|---|TRA|DMD|---" 39 "---|---|ECU3|---|---|TRA|DMD|FES" 40 "---|---|ECU3|---|ECU1|---|---|---" 41 "---|---|ECU3|---|ECU1|---|---|FES" 42 "---|---|ECU3|---|ECU1|---|DMD|---" 43 "---|---|ECU3|---|ECU1|---|DMD|FES" 44 "---|---|ECU3|---|ECU1|TRA|---|---" 45 "---|---|ECU3|---|ECU1|TRA|---|FES" 46 "---|---|ECU3|---|ECU1|TRA|DMD|---" 47 "---|---|ECU3|---|ECU1|TRA|DMD|FES" 48 "---|---|ECU3|ECU2|---|---|---|---" 49 "---|---|ECU3|ECU2|---|---|---|FES" 50 "---|---|ECU3|ECU2|---|---|DMD|---" 51 "---|---|ECU3|ECU2|---|---|DMD|FES" 52 "---|---|ECU3|ECU2|---|TRA|---|---" 53 "---|---|ECU3|ECU2|---|TRA|---|FES" 54 "---|---|ECU3|ECU2|---|TRA|DMD|---" 55 "---|---|ECU3|ECU2|---|TRA|DMD|FES" 56 "---|---|ECU3|ECU2|ECU1|---|---|---" 57 "---|---|ECU3|ECU2|ECU1|---|---|FES" 58 "---|---|ECU3|ECU2|ECU1|---|DMD|---" 59 "---|---|ECU3|ECU2|ECU1|---|DMD|FES" 60 "---|---|ECU3|ECU2|ECU1|TRA|---|---" 61 "---|---|ECU3|ECU2|ECU1|TRA|---|FES" 62 "---|---|ECU3|ECU2|ECU1|TRA|DMD|---" 63 "---|---|ECU3|ECU2|ECU1|TRA|DMD|FES" 64 "---|ECU4|---|---|---|---|---|---" 65 "---|ECU4|---|---|---|---|---|FES" 66 "---|ECU4|---|---|---|---|DMD|---" 67 "---|ECU4|---|---|---|---|DMD|FES" 68 "---|ECU4|---|---|---|TRA|---|---" 69 "---|ECU4|---|---|---|TRA|---|FES" 70 "---|ECU4|---|---|---|TRA|DMD|---" 71 "---|ECU4|---|---|---|TRA|DMD|FES" 72 "---|ECU4|---|---|ECU1|---|---|---" 73 "---|ECU4|---|---|ECU1|---|---|FES" 74 "---|ECU4|---|---|ECU1|---|DMD|---" 75 "---|ECU4|---|---|ECU1|---|DMD|FES" 76 "---|ECU4|---|---|ECU1|TRA|---|---" 77 "---|ECU4|---|---|ECU1|TRA|---|FES" 78 "---|ECU4|---|---|ECU1|TRA|DMD|---" 79 "---|ECU4|---|---|ECU1|TRA|DMD|FES" 80 "---|ECU4|---|ECU2|---|---|---|---" 81 "---|ECU4|---|ECU2|---|---|---|FES" 82 "---|ECU4|---|ECU2|---|---|DMD|---" 83 "---|ECU4|---|ECU2|---|---|DMD|FES" 84 "---|ECU4|---|ECU2|---|TRA|---|---" 85 "---|ECU4|---|ECU2|---|TRA|---|FES" 86 "---|ECU4|---|ECU2|---|TRA|DMD|---" 87 "---|ECU4|---|ECU2|---|TRA|DMD|FES" 88 "---|ECU4|---|ECU2|ECU1|---|---|---" 89 "---|ECU4|---|ECU2|ECU1|---|---|FES" 90 "---|ECU4|---|ECU2|ECU1|---|DMD|---" 91 "---|ECU4|---|ECU2|ECU1|---|DMD|FES" 92 "---|ECU4|---|ECU2|ECU1|TRA|---|---" 93 "---|ECU4|---|ECU2|ECU1|TRA|---|FES" 94 "---|ECU4|---|ECU2|ECU1|TRA|DMD|---" 95 "---|ECU4|---|ECU2|ECU1|TRA|DMD|FES" 96 "---|ECU4|ECU3|---|---|---|---|---" 97 "---|ECU4|ECU3|---|---|---|---|FES" 98 "---|ECU4|ECU3|---|---|---|DMD|---" 99 "---|ECU4|ECU3|---|---|---|DMD|FES" 100 "---|ECU4|ECU3|---|---|TRA|---|---" 101 "---|ECU4|ECU3|---|---|TRA|---|FES" 102 "---|ECU4|ECU3|---|---|TRA|DMD|---" 103 "---|ECU4|ECU3|---|---|TRA|DMD|FES" 104 "---|ECU4|ECU3|---|ECU1|---|---|---" 105 "---|ECU4|ECU3|---|ECU1|---|---|FES" 106 "---|ECU4|ECU3|---|ECU1|---|DMD|---" 107 "---|ECU4|ECU3|---|ECU1|---|DMD|FES" 108 "---|ECU4|ECU3|---|ECU1|TRA|---|---" 109 "---|ECU4|ECU3|---|ECU1|TRA|---|FES" 110 "---|ECU4|ECU3|---|ECU1|TRA|DMD|---" 111 "---|ECU4|ECU3|---|ECU1|TRA|DMD|FES" 112 "---|ECU4|ECU3|ECU2|---|---|---|---" 113 "---|ECU4|ECU3|ECU2|---|---|---|FES" 114 "---|ECU4|ECU3|ECU2|---|---|DMD|---" 115 "---|ECU4|ECU3|ECU2|---|---|DMD|FES" 116 "---|ECU4|ECU3|ECU2|---|TRA|---|---" 117 "---|ECU4|ECU3|ECU2|---|TRA|---|FES" 118 "---|ECU4|ECU3|ECU2|---|TRA|DMD|---" 119 "---|ECU4|ECU3|ECU2|---|TRA|DMD|FES" 120 "---|ECU4|ECU3|ECU2|ECU1|---|---|---" 121 "---|ECU4|ECU3|ECU2|ECU1|---|---|FES" 122 "---|ECU4|ECU3|ECU2|ECU1|---|DMD|---" 123 "---|ECU4|ECU3|ECU2|ECU1|---|DMD|FES" 124 "---|ECU4|ECU3|ECU2|ECU1|TRA|---|---" 125 "---|ECU4|ECU3|ECU2|ECU1|TRA|---|FES" 126 "---|ECU4|ECU3|ECU2|ECU1|TRA|DMD|---" 127 "---|ECU4|ECU3|ECU2|ECU1|TRA|DMD|FES" 128 "SLV|---|---|---|---|---|---|---" 129 "SLV|---|---|---|---|---|---|FES" 130 "SLV|---|---|---|---|---|DMD|---" 131 "SLV|---|---|---|---|---|DMD|FES" 132 "SLV|---|---|---|---|TRA|---|---" 133 "SLV|---|---|---|---|TRA|---|FES" 134 "SLV|---|---|---|---|TRA|DMD|---" 135 "SLV|---|---|---|---|TRA|DMD|FES" 136 "SLV|---|---|---|ECU1|---|---|---" 137 "SLV|---|---|---|ECU1|---|---|FES" 138 "SLV|---|---|---|ECU1|---|DMD|---" 139 "SLV|---|---|---|ECU1|---|DMD|FES" 140 "SLV|---|---|---|ECU1|TRA|---|---" 141 "SLV|---|---|---|ECU1|TRA|---|FES" 142 "SLV|---|---|---|ECU1|TRA|DMD|---" 143 "SLV|---|---|---|ECU1|TRA|DMD|FES" 144 "SLV|---|---|ECU2|---|---|---|---" 145 "SLV|---|---|ECU2|---|---|---|FES" 146 "SLV|---|---|ECU2|---|---|DMD|---" 147 "SLV|---|---|ECU2|---|---|DMD|FES" 148 "SLV|---|---|ECU2|---|TRA|---|---" 149 "SLV|---|---|ECU2|---|TRA|---|FES" 150 "SLV|---|---|ECU2|---|TRA|DMD|---" 151 "SLV|---|---|ECU2|---|TRA|DMD|FES" 152 "SLV|---|---|ECU2|ECU1|---|---|---" 153 "SLV|---|---|ECU2|ECU1|---|---|FES" 154 "SLV|---|---|ECU2|ECU1|---|DMD|---" 155 "SLV|---|---|ECU2|ECU1|---|DMD|FES" 156 "SLV|---|---|ECU2|ECU1|TRA|---|---" 157 "SLV|---|---|ECU2|ECU1|TRA|---|FES" 158 "SLV|---|---|ECU2|ECU1|TRA|DMD|---" 159 "SLV|---|---|ECU2|ECU1|TRA|DMD|FES" 160 "SLV|---|ECU3|---|---|---|---|---" 161 "SLV|---|ECU3|---|---|---|---|FES" 162 "SLV|---|ECU3|---|---|---|DMD|---" 163 "SLV|---|ECU3|---|---|---|DMD|FES" 164 "SLV|---|ECU3|---|---|TRA|---|---" 165 "SLV|---|ECU3|---|---|TRA|---|FES" 166 "SLV|---|ECU3|---|---|TRA|DMD|---" 167 "SLV|---|ECU3|---|---|TRA|DMD|FES" 168 "SLV|---|ECU3|---|ECU1|---|---|---" 169 "SLV|---|ECU3|---|ECU1|---|---|FES" 170 "SLV|---|ECU3|---|ECU1|---|DMD|---" 171 "SLV|---|ECU3|---|ECU1|---|DMD|FES" 172 "SLV|---|ECU3|---|ECU1|TRA|---|---" 173 "SLV|---|ECU3|---|ECU1|TRA|---|FES" 174 "SLV|---|ECU3|---|ECU1|TRA|DMD|---" 175 "SLV|---|ECU3|---|ECU1|TRA|DMD|FES" 176 "SLV|---|ECU3|ECU2|---|---|---|---" 177 "SLV|---|ECU3|ECU2|---|---|---|FES" 178 "SLV|---|ECU3|ECU2|---|---|DMD|---" 179 "SLV|---|ECU3|ECU2|---|---|DMD|FES" 180 "SLV|---|ECU3|ECU2|---|TRA|---|---" 181 "SLV|---|ECU3|ECU2|---|TRA|---|FES" 182 "SLV|---|ECU3|ECU2|---|TRA|DMD|---" 183 "SLV|---|ECU3|ECU2|---|TRA|DMD|FES" 184 "SLV|---|ECU3|ECU2|ECU1|---|---|---" 185 "SLV|---|ECU3|ECU2|ECU1|---|---|FES" 186 "SLV|---|ECU3|ECU2|ECU1|---|DMD|---" 187 "SLV|---|ECU3|ECU2|ECU1|---|DMD|FES" 188 "SLV|---|ECU3|ECU2|ECU1|TRA|---|---" 189 "SLV|---|ECU3|ECU2|ECU1|TRA|---|FES" 190 "SLV|---|ECU3|ECU2|ECU1|TRA|DMD|---" 191 "SLV|---|ECU3|ECU2|ECU1|TRA|DMD|FES" 192 "SLV|ECU4|---|---|---|---|---|---" 193 "SLV|ECU4|---|---|---|---|---|FES" 194 "SLV|ECU4|---|---|---|---|DMD|---" 195 "SLV|ECU4|---|---|---|---|DMD|FES" 196 "SLV|ECU4|---|---|---|TRA|---|---" 197 "SLV|ECU4|---|---|---|TRA|---|FES" 198 "SLV|ECU4|---|---|---|TRA|DMD|---" 199 "SLV|ECU4|---|---|---|TRA|DMD|FES" 200 "SLV|ECU4|---|---|ECU1|---|---|---" 201 "SLV|ECU4|---|---|ECU1|---|---|FES" 202 "SLV|ECU4|---|---|ECU1|---|DMD|---" 203 "SLV|ECU4|---|---|ECU1|---|DMD|FES" 204 "SLV|ECU4|---|---|ECU1|TRA|---|---" 205 "SLV|ECU4|---|---|ECU1|TRA|---|FES" 206 "SLV|ECU4|---|---|ECU1|TRA|DMD|---" 207 "SLV|ECU4|---|---|ECU1|TRA|DMD|FES" 208 "SLV|ECU4|---|ECU2|---|---|---|---" 209 "SLV|ECU4|---|ECU2|---|---|---|FES" 210 "SLV|ECU4|---|ECU2|---|---|DMD|---" 211 "SLV|ECU4|---|ECU2|---|---|DMD|FES" 212 "SLV|ECU4|---|ECU2|---|TRA|---|---" 213 "SLV|ECU4|---|ECU2|---|TRA|---|FES" 214 "SLV|ECU4|---|ECU2|---|TRA|DMD|---" 215 "SLV|ECU4|---|ECU2|---|TRA|DMD|FES" 216 "SLV|ECU4|---|ECU2|ECU1|---|---|---" 217 "SLV|ECU4|---|ECU2|ECU1|---|---|FES" 218 "SLV|ECU4|---|ECU2|ECU1|---|DMD|---" 219 "SLV|ECU4|---|ECU2|ECU1|---|DMD|FES" 220 "SLV|ECU4|---|ECU2|ECU1|TRA|---|---" 221 "SLV|ECU4|---|ECU2|ECU1|TRA|---|FES" 222 "SLV|ECU4|---|ECU2|ECU1|TRA|DMD|---" 223 "SLV|ECU4|---|ECU2|ECU1|TRA|DMD|FES" 224 "SLV|ECU4|ECU3|---|---|---|---|---" 225 "SLV|ECU4|ECU3|---|---|---|---|FES" 226 "SLV|ECU4|ECU3|---|---|---|DMD|---" 227 "SLV|ECU4|ECU3|---|---|---|DMD|FES" 228 "SLV|ECU4|ECU3|---|---|TRA|---|---" 229 "SLV|ECU4|ECU3|---|---|TRA|---|FES" 230 "SLV|ECU4|ECU3|---|---|TRA|DMD|---" 231 "SLV|ECU4|ECU3|---|---|TRA|DMD|FES" 232 "SLV|ECU4|ECU3|---|ECU1|---|---|---" 233 "SLV|ECU4|ECU3|---|ECU1|---|---|FES" 234 "SLV|ECU4|ECU3|---|ECU1|---|DMD|---" 235 "SLV|ECU4|ECU3|---|ECU1|---|DMD|FES" 236 "SLV|ECU4|ECU3|---|ECU1|TRA|---|---" 237 "SLV|ECU4|ECU3|---|ECU1|TRA|---|FES" 238 "SLV|ECU4|ECU3|---|ECU1|TRA|DMD|---" 239 "SLV|ECU4|ECU3|---|ECU1|TRA|DMD|FES" 240 "SLV|ECU4|ECU3|ECU2|---|---|---|---" 241 "SLV|ECU4|ECU3|ECU2|---|---|---|FES" 242 "SLV|ECU4|ECU3|ECU2|---|---|DMD|---" 243 "SLV|ECU4|ECU3|ECU2|---|---|DMD|FES" 244 "SLV|ECU4|ECU3|ECU2|---|TRA|---|---" 245 "SLV|ECU4|ECU3|ECU2|---|TRA|---|FES" 246 "SLV|ECU4|ECU3|ECU2|---|TRA|DMD|---" 247 "SLV|ECU4|ECU3|ECU2|---|TRA|DMD|FES" 248 "SLV|ECU4|ECU3|ECU2|ECU1|---|---|---" 249 "SLV|ECU4|ECU3|ECU2|ECU1|---|---|FES" 250 "SLV|ECU4|ECU3|ECU2|ECU1|---|DMD|---" 251 "SLV|ECU4|ECU3|ECU2|ECU1|---|DMD|FES" 252 "SLV|ECU4|ECU3|ECU2|ECU1|TRA|---|---" 253 "SLV|ECU4|ECU3|ECU2|ECU1|TRA|---|FES" 254 "SLV|ECU4|ECU3|ECU2|ECU1|TRA|DMD|---" 255 "SLV|ECU4|ECU3|ECU2|ECU1|TRA|DMD|FES" /end COMPU_VTAB
/begin COMPU_METHOD MILLmp_StVerb "" TAB_VERB "%6.3" "" COMPU_TAB_REF MILLmp_StVerb /end COMPU_METHOD
/begin COMPU_VTAB MILLmp_StVerb "" TAB_VERB 7 0 "Init_State" 17 "PreStart_VisTest" 33 "PreStart_RdnBln" 65 "PreStart_WaitForStart" 129 "PreStart_WaitForStart_MILON" 2 "AfterStart" 4 "Cruising" /end COMPU_VTAB
/begin COMPU_METHOD m_q0p0277_g "" RAT_FUNC "%6.4" "g" COEFFS 0 36 0 0 0 1 /end COMPU_METHOD
/begin COMPU_METHOD m_q0p1 "" RAT_FUNC "%6.3" "kg/h" COEFFS 0 10 0 0 0 1 /end COMPU_METHOD
/begin COMPU_METHOD m_q2p777Em4_g "" RAT_FUNC "%6.5" "g" COEFFS 0 3600 0 0 0 1 /end COMPU_METHOD
/begin COMPU_METHOD m_q4p239Em7_g "" RAT_FUNC "%9.8" "g" COEFFS 0 2359290 0 0 0 1 /end COMPU_METHOD
/begin COMPU_METHOD m_ub_q0p0444 "" RAT_FUNC "%6.4" "g" COEFFS 0 1 0 0 0 0.0444 /end COMPU_METHOD
/begin COMPU_METHOD m_uw_b4660 "" RAT_FUNC "%6.4" "g" COEFFS 0 3600 0 0 0 256 /end COMPU_METHOD
/begin COMPU_METHOD m_uw_b6553p5 "" RAT_FUNC "%6.3" "kg/h" COEFFS 0 1 0 0 0 0.1 /end COMPU_METHOD
/begin COMPU_METHOD nmot_q10 "" RAT_FUNC "%6.1" "1/min" COEFFS 0 1 0 0 0 10 /end COMPU_METHOD
/begin COMPU_METHOD nmot_ub_q40 "" RAT_FUNC "%6.1" "1/min" COEFFS 0 1 0 0 0 40 /end COMPU_METHOD
/begin COMPU_METHOD nmot_uw_q0p25 "" RAT_FUNC "%6.3" "1/min" COEFFS 0 1 0 0 0 0.25 /end COMPU_METHOD
/begin COMPU_METHOD OneToOne "" RAT_FUNC "%6.2" "-" COEFFS 0 1 0 0 0 1 /end COMPU_METHOD
/begin COMPU_METHOD Prc "" RAT_FUNC "%6.4" "%" COEFFS 0 81.92 0 0 0 1 /end COMPU_METHOD
/begin COMPU_METHOD Pres_hPa "" RAT_FUNC "%6.2" "hPa" COEFFS 0 1 0 0 0 1 /end COMPU_METHOD
/begin COMPU_METHOD p_sw_q0p078 "" RAT_FUNC "%6.4" "hPa" COEFFS 0 65536 0 0 0 5120 /end COMPU_METHOD
/begin COMPU_METHOD q0p0586_pc_DIV_s "" RAT_FUNC "%6.4" "%/s" COEFFS 0 256 0 0 0 15 /end COMPU_METHOD
/begin COMPU_METHOD q7p63Em5_DIV_s "" RAT_FUNC "%7.6" "1/s" COEFFS 0 65536 0 0 0 5 /end COMPU_METHOD
/begin COMPU_METHOD relDK_q0p02441 "" RAT_FUNC "%6.4" "%DK" COEFFS 0 65536 0 0 0 1600 /end COMPU_METHOD
/begin COMPU_METHOD rel_q0p02344 "" RAT_FUNC "%6.4" "%" COEFFS 0 32 0 0 0 0.75 /end COMPU_METHOD
/begin COMPU_METHOD rel_q0p1953 "" RAT_FUNC "%6.3" "%" COEFFS 0 256 0 0 0 50 /end COMPU_METHOD
/begin COMPU_METHOD rel_q0p75 "" RAT_FUNC "%6.3" "%" COEFFS 0 4 0 0 0 3 /end COMPU_METHOD
/begin COMPU_METHOD rel_sw_b1536 "" RAT_FUNC "%6.4" "%" COEFFS 0 65536 0 0 0 3072 /end COMPU_METHOD
/begin COMPU_METHOD rel_sw_b50 "" RAT_FUNC "%6.4" "%" COEFFS 0 65536 0 0 0 100 /end COMPU_METHOD
/begin COMPU_METHOD rel_ub_b99p6 "" RAT_FUNC "%6.3" "%" COEFFS 0 256 0 0 0 100 /end COMPU_METHOD
/begin COMPU_METHOD rel_uw_b100 "" RAT_FUNC "%6.4" "%" COEFFS 0 65536 0 0 0 100 /end COMPU_METHOD
/begin COMPU_METHOD rel_uw_q0p0234 "" RAT_FUNC "%6.4" "%" COEFFS 0 32 0 0 0 0.75 /end COMPU_METHOD
/begin COMPU_METHOD SCR_kPa_10 "" RAT_FUNC "%6.1" "kPa" COEFFS 0 0.1 0 0 0 1 /end COMPU_METHOD
/begin COMPU_METHOD SCR_kPa_100 "" RAT_FUNC "%6.0" "kPa" COEFFS 0 0.01 0 0 0 1 /end COMPU_METHOD
/begin COMPU_METHOD SCR_MSSENBL_SY_Compu "" TAB_VERB "%6.3" "" COMPU_TAB_REF SCR_MSSENBL_SY_Compu /end COMPU_METHOD
/begin COMPU_VTAB SCR_MSSENBL_SY_Compu "" TAB_VERB 2 0 "False" 1 "True" /end COMPU_VTAB
/begin COMPU_METHOD SCR_SY_Compu "" TAB_VERB "%6.3" "" COMPU_TAB_REF SCR_SY_Compu /end COMPU_METHOD
/begin COMPU_VTAB SCR_SY_Compu "" TAB_VERB 4 0 "NOSCR" 1 "RBSCR" 2 "INERGYSCR" 3 "AGKSCR" /end COMPU_VTAB
/begin COMPU_METHOD SCR_Volt_q0p0001227 "" RAT_FUNC "%6.5" "V" COEFFS 0 8192 0 0 0 1 /end COMPU_METHOD
/begin COMPU_METHOD SCTPMP1T_TYPAVL_SY_Compu "" TAB_VERB "%6.3" "" COMPU_TAB_REF SCTPMP1T_TYPAVL_SY_Compu /end COMPU_METHOD
/begin COMPU_VTAB SCTPMP1T_TYPAVL_SY_Compu "" TAB_VERB 2 0 "False" 1 "True" /end COMPU_VTAB
/begin COMPU_METHOD SCTPMP2_TYPAVL_SY_Compu "" TAB_VERB "%6.3" "" COMPU_TAB_REF SCTPMP2_TYPAVL_SY_Compu /end COMPU_METHOD
/begin COMPU_VTAB SCTPMP2_TYPAVL_SY_Compu "" TAB_VERB 2 0 "False" 1 "True" /end COMPU_VTAB
/begin COMPU_METHOD SEAWTRP_TYPAVL_SC_Compu "" TAB_VERB "%6.3" "" COMPU_TAB_REF SEAWTRP_TYPAVL_SC_Compu /end COMPU_METHOD
/begin COMPU_VTAB SEAWTRP_TYPAVL_SC_Compu "" TAB_VERB 2 0 "False" 1 "True" /end COMPU_VTAB
/begin COMPU_METHOD SEAWTRT_TYPAVL_SC_Compu "" TAB_VERB "%6.3" "" COMPU_TAB_REF SEAWTRT_TYPAVL_SC_Compu /end COMPU_METHOD
/begin COMPU_VTAB SEAWTRT_TYPAVL_SC_Compu "" TAB_VERB 2 0 "False" 1 "True" /end COMPU_VTAB
/begin COMPU_METHOD SECBATT_SC_Compu "" TAB_VERB "%6.3" "" COMPU_TAB_REF SECBATT_SC_Compu /end COMPU_METHOD
/begin COMPU_VTAB SECBATT_SC_Compu "" TAB_VERB 2 0 "False" 1 "True" /end COMPU_VTAB
/begin COMPU_METHOD SECUPCK_SC_Compu "" TAB_VERB "%6.3" "" COMPU_TAB_REF SECUPCK_SC_Compu /end COMPU_METHOD
/begin COMPU_VTAB SECUPCK_SC_Compu "" TAB_VERB 4 0 "None" 1 "SecuMgr" 2 "EcuSecu_HSM" 3 "EcuSecu_SSM" /end COMPU_VTAB
/begin COMPU_METHOD SELVRNTBASDAIRCDNSHOFF_SC_Compu "" TAB_VERB "%6.3" "" COMPU_TAB_REF SELVRNTBASDAIRCDNSHOFF_SC_Compu /end COMPU_METHOD
/begin COMPU_VTAB SELVRNTBASDAIRCDNSHOFF_SC_Compu "" TAB_VERB 3 1 "2WF_variant" 2 "2CF_variant" 3 "2SV_Variant" /end COMPU_VTAB
/begin COMPU_METHOD SENTIPCORETYPE_SC_Compu "" TAB_VERB "%6.3" "" COMPU_TAB_REF SENTIPCORETYPE_SC_Compu /end COMPU_METHOD
/begin COMPU_VTAB SENTIPCORETYPE_SC_Compu "" TAB_VERB 2 0 "0" 1 "1" /end COMPU_VTAB
/begin COMPU_METHOD SENT_SC_Compu "" TAB_VERB "%6.3" "" COMPU_TAB_REF SENT_SC_Compu /end COMPU_METHOD
/begin COMPU_VTAB SENT_SC_Compu "" TAB_VERB 2 0 "False" 1 "True" /end COMPU_VTAB
/begin COMPU_METHOD SEPAIRVOLINTKMNFLD_SC_Compu "" TAB_VERB "%6.3" "" COMPU_TAB_REF SEPAIRVOLINTKMNFLD_SC_Compu /end COMPU_METHOD
/begin COMPU_VTAB SEPAIRVOLINTKMNFLD_SC_Compu "" TAB_VERB 2 0 "False" 1 "True" /end COMPU_VTAB
/begin COMPU_METHOD SEPAIRVOLTHRVLVUS_SC_Compu "" TAB_VERB "%6.3" "" COMPU_TAB_REF SEPAIRVOLTHRVLVUS_SC_Compu /end COMPU_METHOD
/begin COMPU_VTAB SEPAIRVOLTHRVLVUS_SC_Compu "" TAB_VERB 2 0 "False" 1 "True" /end COMPU_VTAB
/begin COMPU_METHOD SETPOINTCALC_TRQBASED_SY_Compu "" TAB_VERB "%6.3" "" COMPU_TAB_REF SETPOINTCALC_TRQBASED_SY_Compu /end COMPU_METHOD
/begin COMPU_VTAB SETPOINTCALC_TRQBASED_SY_Compu "" TAB_VERB 2 0 "QUANTITY" 1 "TORQUE" /end COMPU_VTAB
/begin COMPU_METHOD SG_INTVENG_SY_Compu "" TAB_VERB "%6.3" "" COMPU_TAB_REF SG_INTVENG_SY_Compu /end COMPU_METHOD
/begin COMPU_VTAB SG_INTVENG_SY_Compu "" TAB_VERB 2 0 "False" 1 "True" /end COMPU_VTAB
/begin COMPU_METHOD SIGNALS_OBDDIDSUPRT_SC_Compu "" TAB_VERB "%6.3" "" COMPU_TAB_REF SIGNALS_OBDDIDSUPRT_SC_Compu /end COMPU_METHOD
/begin COMPU_VTAB SIGNALS_OBDDIDSUPRT_SC_Compu "" TAB_VERB 2 0 "Disabled" 1 "Enabled" /end COMPU_VTAB
/begin COMPU_METHOD Signals_OneToOne "" RAT_FUNC "%6.2" "" COEFFS 0 1 0 0 0 1 /end COMPU_METHOD
/begin COMPU_METHOD Sig_I15031_LeanAppl_SY_Compu "" RAT_FUNC "%6.2" "" COEFFS 0 1 0 0 0 1 /end COMPU_METHOD
/begin COMPU_METHOD SMTACTR_SC_Compu "" TAB_VERB "%6.3" "" COMPU_TAB_REF SMTACTR_SC_Compu /end COMPU_METHOD
/begin COMPU_VTAB SMTACTR_SC_Compu "" TAB_VERB 2 0 "noSmartActuator" 1 "SmartActuator" /end COMPU_VTAB
/begin COMPU_METHOD Soot_gPerLtr "" RAT_FUNC "%6.4" "g/l" COEFFS 0 100 0 0 0 1 /end COMPU_METHOD
/begin COMPU_METHOD SotMassPerDist "" RAT_FUNC "%7.6" "g/km" COEFFS 0 10000 0 0 0 1 /end COMPU_METHOD
/begin COMPU_METHOD SotMassPerSec "" RAT_FUNC "%6.3" "g/s" COEFFS 0 10 0 0 0 1 /end COMPU_METHOD
/begin COMPU_METHOD SotMassPerTime "" RAT_FUNC "%6.4" "mg/s" COEFFS 0 100 0 0 0 1 /end COMPU_METHOD
/begin COMPU_METHOD SotMsPerkm_COMPU "" RAT_FUNC "%6.5" "g/km" COEFFS 0 8192 0 0 0 1 /end COMPU_METHOD
/begin COMPU_METHOD SotMs_KgPrSec_COMPU "" RAT_FUNC "%6.2" "kg/s" COEFFS 0 1 0 0 0 1 /end COMPU_METHOD
/begin COMPU_METHOD SOUNDTUN_SC_Compu "" TAB_VERB "%6.3" "" COMPU_TAB_REF SOUNDTUN_SC_Compu /end COMPU_METHOD
/begin COMPU_VTAB SOUNDTUN_SC_Compu "" TAB_VERB 2 0 "False" 1 "True" /end COMPU_VTAB
/begin COMPU_METHOD SOxMassPerTime "" RAT_FUNC "%7.6" "mg/s" COEFFS 0 10000 0 0 0 1 /end COMPU_METHOD
/begin COMPU_METHOD SPAF_SY_Compu "" TAB_VERB "%6.3" "" COMPU_TAB_REF SPAF_SY_Compu /end COMPU_METHOD
/begin COMPU_VTAB SPAF_SY_Compu "" TAB_VERB 2 0 "False" 1 "True" /end COMPU_VTAB
/begin COMPU_METHOD SpaVel "" RAT_FUNC "%6.1" "l/h" COEFFS 0 0.1 0 0 0 1 /end COMPU_METHOD
/begin COMPU_METHOD SPC_SY_Compu "" TAB_VERB "%6.3" "" COMPU_TAB_REF SPC_SY_Compu /end COMPU_METHOD
/begin COMPU_VTAB SPC_SY_Compu "" TAB_VERB 2 0 "no SPC available" 1 "SPC available" /end COMPU_VTAB
/begin COMPU_METHOD SPDCTL_CRPINCBRKVAC_SC_Compu "" TAB_VERB "%6.3" "" COMPU_TAB_REF SPDCTL_CRPINCBRKVAC_SC_Compu /end COMPU_METHOD
/begin COMPU_VTAB SPDCTL_CRPINCBRKVAC_SC_Compu "" TAB_VERB 2 0 "False" 1 "True" /end COMPU_VTAB
/begin COMPU_METHOD SPDCTL_DRVMODACTVTQRESV_SC_Compu "" TAB_VERB "%6.3" "" COMPU_TAB_REF SPDCTL_DRVMODACTVTQRESV_SC_Compu /end COMPU_METHOD
/begin COMPU_VTAB SPDCTL_DRVMODACTVTQRESV_SC_Compu "" TAB_VERB 2 0 "False" 1 "True" /end COMPU_VTAB
/begin COMPU_METHOD SPDCTL_ENAGQUICKSTRT_SC_Compu "" TAB_VERB "%6.3" "" COMPU_TAB_REF SPDCTL_ENAGQUICKSTRT_SC_Compu /end COMPU_METHOD
/begin COMPU_VTAB SPDCTL_ENAGQUICKSTRT_SC_Compu "" TAB_VERB 2 0 "False" 1 "True" /end COMPU_VTAB
/begin COMPU_METHOD SPDCTL_GPFPROTN_SC_Compu "" TAB_VERB "%6.3" "" COMPU_TAB_REF SPDCTL_GPFPROTN_SC_Compu /end COMPU_METHOD
/begin COMPU_VTAB SPDCTL_GPFPROTN_SC_Compu "" TAB_VERB 2 0 "Disable" 1 "Enable" /end COMPU_VTAB
/begin COMPU_METHOD SPDCTL_HPTQRESV_SC_Compu "" TAB_VERB "%6.3" "" COMPU_TAB_REF SPDCTL_HPTQRESV_SC_Compu /end COMPU_METHOD
/begin COMPU_VTAB SPDCTL_HPTQRESV_SC_Compu "" TAB_VERB 2 0 "False" 1 "True" /end COMPU_VTAB
/begin COMPU_METHOD SPDCTL_HYB_SC_Compu "" TAB_VERB "%6.3" "" COMPU_TAB_REF SPDCTL_HYB_SC_Compu /end COMPU_METHOD
/begin COMPU_VTAB SPDCTL_HYB_SC_Compu "" TAB_VERB 2 0 "False" 1 "True" /end COMPU_VTAB
/begin COMPU_METHOD SPDCTL_IDLESPDSPDEFRST_SC_Compu "" TAB_VERB "%6.3" "" COMPU_TAB_REF SPDCTL_IDLESPDSPDEFRST_SC_Compu /end COMPU_METHOD
/begin COMPU_VTAB SPDCTL_IDLESPDSPDEFRST_SC_Compu "" TAB_VERB 3 0 "Disabled" 1 "IdleSpd" 2 "IdleSpd_DesMod" /end COMPU_VTAB
/begin COMPU_METHOD SPDCTL_SGA09LLSBSIZE_SC_Compu "" RAT_FUNC "%6.2" "" COEFFS 0 1 0 0 0 1 /end COMPU_METHOD
/begin COMPU_METHOD SPDCTL_TNRMAXSIZE_SC_Compu "" RAT_FUNC "%6.2" "" COEFFS 0 1 0 0 0 1 /end COMPU_METHOD
/begin COMPU_METHOD SPDCTL_TQLVL_SC_Compu "" TAB_VERB "%6.3" "" COMPU_TAB_REF SPDCTL_TQLVL_SC_Compu /end COMPU_METHOD
/begin COMPU_VTAB SPDCTL_TQLVL_SC_Compu "" TAB_VERB 2 0 "0" 1 "1" /end COMPU_VTAB
/begin COMPU_METHOD SPDCTL_VAR_SY_Compu "" TAB_VERB "%6.3" "" COMPU_TAB_REF SPDCTL_VAR_SY_Compu /end COMPU_METHOD
/begin COMPU_VTAB SPDCTL_VAR_SY_Compu "" TAB_VERB 54 1 "DAI" 3 "VWW" 4 "POR" 5 "AUD" 6 "OPE" 9 "FIA" 11 "BMW" 14 "PSA" 15 "REN" 17 "ALF" 18 "SAB" 19 "VOL" 20 "NIS" 21 "GMU" 22 "FOR" 26 "IMJ" 51 "SEA" 53 "CHR" 54 "JAG" 55 "ROL" 69 "FER" 72 "TOY" 123 "MIT" 147 "HYU" 159 "HON" 160 "MAZ" 183 "CU" 190 "LRG" 204 "VVW" 214 "AVT" 242 "Iveco" 243 "DMC" 248 "SUZ" 267 "SSANGYONG" 270 "KEF" 289 "AMG" 308 "TAT" 319 "MVM" 328 "MM" 385 "UAES" 425 "Polaris" 590 "Scania" 828 "RBCD" 858 "Kubota" 898 "MFTBC" 944 "DOOSAN_Infracore" 973 "Yanmar_Japan" 987 "Shanghai Diesel" 999 "ALL" 2887 "Nonox" 9347 "SDFG" 9454 "Fuso" 9797 "Mitsubishi_Heavy_Industr" 9947 "SONSTIGE" /end COMPU_VTAB
/begin COMPU_METHOD SPDLIM_SY_Compu "" TAB_VERB "%6.3" "" COMPU_TAB_REF SPDLIM_SY_Compu /end COMPU_METHOD
/begin COMPU_VTAB SPDLIM_SY_Compu "" TAB_VERB 2 0 "False" 1 "True" /end COMPU_VTAB
/begin COMPU_METHOD SpecHeatFine "" RAT_FUNC "%6.3" "J/Kg/K" COEFFS 0 5 0 0 0 1 /end COMPU_METHOD
/begin COMPU_METHOD SpecificHeat "" RAT_FUNC "%7.6" "J/g/K" COEFFS 0 10000 0 0 0 1 /end COMPU_METHOD
/begin COMPU_METHOD SPRTEXTD_SY_Compu "" TAB_VERB "%6.3" "" COMPU_TAB_REF SPRTEXTD_SY_Compu /end COMPU_METHOD
/begin COMPU_VTAB SPRTEXTD_SY_Compu "" TAB_VERB 2 0 "inactive" 1 "active" /end COMPU_VTAB
/begin COMPU_METHOD SPRTTYP_SY_Compu "" TAB_VERB "%6.3" "" COMPU_TAB_REF SPRTTYP_SY_Compu /end COMPU_METHOD
/begin COMPU_VTAB SPRTTYP_SY_Compu "" TAB_VERB 2 0 "SPRTTYP_CHRSM" 1 "SPRTTYP_SPRTSWT" /end COMPU_VTAB
/begin COMPU_METHOD SPRT_SY_Compu "" TAB_VERB "%6.3" "" COMPU_TAB_REF SPRT_SY_Compu /end COMPU_METHOD
/begin COMPU_VTAB SPRT_SY_Compu "" TAB_VERB 2 0 "no sport driving mode available" 1 "sport driving mode available" /end COMPU_VTAB
/begin COMPU_METHOD SPTENGSTRT_SC_Compu "" TAB_VERB "%6.3" "" COMPU_TAB_REF SPTENGSTRT_SC_Compu /end COMPU_METHOD
/begin COMPU_VTAB SPTENGSTRT_SC_Compu "" TAB_VERB 2 0 "False" 1 "True" /end COMPU_VTAB
/begin COMPU_METHOD SPTPLUS_SC_Compu "" TAB_VERB "%6.3" "" COMPU_TAB_REF SPTPLUS_SC_Compu /end COMPU_METHOD
/begin COMPU_VTAB SPTPLUS_SC_Compu "" TAB_VERB 2 0 "False" 1 "True" /end COMPU_VTAB
/begin COMPU_METHOD SqrVltg_s "" RAT_FUNC "%6.3" "V^2s" COEFFS 0 10 0 0 0 1 /end COMPU_METHOD
/begin COMPU_METHOD SSPRITNUM_SY_Compu "" TAB_VERB "%6.3" "" COMPU_TAB_REF SSPRITNUM_SY_Compu /end COMPU_METHOD
/begin COMPU_VTAB SSPRITNUM_SY_Compu "" TAB_VERB 2 0 "False" 1 "True" /end COMPU_VTAB
/begin COMPU_METHOD STADAP_INHCUST_SY_Compu "" TAB_VERB "%6.3" "" COMPU_TAB_REF STADAP_INHCUST_SY_Compu /end COMPU_METHOD
/begin COMPU_VTAB STADAP_INHCUST_SY_Compu "" TAB_VERB 2 0 "False" 1 "True" /end COMPU_VTAB
/begin COMPU_METHOD STF_SY_Compu "" TAB_VERB "%6.3" "" COMPU_TAB_REF STF_SY_Compu /end COMPU_METHOD
/begin COMPU_VTAB STF_SY_Compu "" TAB_VERB 2 0 "False" 1 "True" /end COMPU_VTAB
/begin COMPU_METHOD STNETHAD_INHCUST_SY_Compu "" TAB_VERB "%6.3" "" COMPU_TAB_REF STNETHAD_INHCUST_SY_Compu /end COMPU_METHOD
/begin COMPU_VTAB STNETHAD_INHCUST_SY_Compu "" TAB_VERB 2 0 "False" 1 "True" /end COMPU_VTAB
/begin COMPU_METHOD STNETH_INHCUST_SY_Compu "" TAB_VERB "%6.3" "" COMPU_TAB_REF STNETH_INHCUST_SY_Compu /end COMPU_METHOD
/begin COMPU_VTAB STNETH_INHCUST_SY_Compu "" TAB_VERB 2 0 "False" 1 "True" /end COMPU_VTAB
/begin COMPU_METHOD STNETH_SY_Compu "" TAB_VERB "%6.3" "" COMPU_TAB_REF STNETH_SY_Compu /end COMPU_METHOD
/begin COMPU_VTAB STNETH_SY_Compu "" TAB_VERB 3 0 "ZERO" 1 "ONE" 2 "TWO" /end COMPU_VTAB
/begin COMPU_METHOD STOPPHDREDN_SC_Compu "" TAB_VERB "%6.3" "" COMPU_TAB_REF STOPPHDREDN_SC_Compu /end COMPU_METHOD
/begin COMPU_VTAB STOPPHDREDN_SC_Compu "" TAB_VERB 4 0 "Reduction of stop prohibition not active" 1 "Reduction of stop proh. PF reset of steady state" 2 "Reduction of stop prohibition active for Audi feat" 3 "Reduction of stop proh. PF no reset of stead" /end COMPU_VTAB
/begin COMPU_METHOD STRGOILP_SC_Compu "" TAB_VERB "%6.3" "" COMPU_TAB_REF STRGOILP_SC_Compu /end COMPU_METHOD
/begin COMPU_VTAB STRGOILP_SC_Compu "" TAB_VERB 2 0 "False" 1 "True" /end COMPU_VTAB
/begin COMPU_METHOD STRGTYP_SY_Compu "" TAB_VERB "%6.3" "" COMPU_TAB_REF STRGTYP_SY_Compu /end COMPU_METHOD
/begin COMPU_VTAB STRGTYP_SY_Compu "" TAB_VERB 5 0 "STRGTYP_NOSTRG" 1 "STRGTYP_MECH" 2 "STRGTYP_LVELEC" 3 "STRGTYP_HVELEC" 4 "STRGTYP_DIFPWRSTRG" /end COMPU_VTAB
/begin COMPU_METHOD stroke_pml "" RAT_FUNC "%6.3" "1/ml" COEFFS 0 10 0 0 0 1 /end COMPU_METHOD
/begin COMPU_METHOD STRTCTL_ONEPUSHSTRT_SC_Compu "" TAB_VERB "%6.3" "" COMPU_TAB_REF STRTCTL_ONEPUSHSTRT_SC_Compu /end COMPU_METHOD
/begin COMPU_VTAB STRTCTL_ONEPUSHSTRT_SC_Compu "" TAB_VERB 2 0 "False" 1 "True" /end COMPU_VTAB
/begin COMPU_METHOD STRTCTL_SC_Compu "" TAB_VERB "%6.3" "" COMPU_TAB_REF STRTCTL_SC_Compu /end COMPU_METHOD
/begin COMPU_VTAB STRTCTL_SC_Compu "" TAB_VERB 5 0 "NOSTARTER" 1 "STRTCTLEXT" 2 "STRTCTLCOMMON" 3 "STRTCTLDS" 4 "STRTCTLGS" /end COMPU_VTAB
/begin COMPU_METHOD STRTLEAN_SC_Compu "" TAB_VERB "%6.3" "" COMPU_TAB_REF STRTLEAN_SC_Compu /end COMPU_METHOD
/begin COMPU_VTAB STRTLEAN_SC_Compu "" TAB_VERB 2 0 "False" 1 "True" /end COMPU_VTAB
/begin COMPU_METHOD STRT_STRTRACTVNRLY_SC_Compu "" TAB_VERB "%6.3" "" COMPU_TAB_REF STRT_STRTRACTVNRLY_SC_Compu /end COMPU_METHOD
/begin COMPU_VTAB STRT_STRTRACTVNRLY_SC_Compu "" TAB_VERB 2 0 "False" 1 "True" /end COMPU_VTAB
/begin COMPU_METHOD STSPTYP_SY_Compu "" TAB_VERB "%6.3" "" COMPU_TAB_REF STSPTYP_SY_Compu /end COMPU_METHOD
/begin COMPU_VTAB STSPTYP_SY_Compu "" TAB_VERB 5 0 "STSPTYP_NO" 1 "STSPTYP_FMC" 2 "STSPTYP_VCC" 3 "STSPTYP_SMCINT" 4 "STSPTYP_SMCEXT" /end COMPU_VTAB
/begin COMPU_METHOD STSP_EXT_SY_Compu "" TAB_VERB "%6.3" "" COMPU_TAB_REF STSP_EXT_SY_Compu /end COMPU_METHOD
/begin COMPU_VTAB STSP_EXT_SY_Compu "" TAB_VERB 2 0 "False" 1 "True" /end COMPU_VTAB
/begin COMPU_METHOD STSP_SY_Compu "" TAB_VERB "%6.3" "" COMPU_TAB_REF STSP_SY_Compu /end COMPU_METHOD
/begin COMPU_VTAB STSP_SY_Compu "" TAB_VERB 2 0 "FALSE" 1 "TRUE" /end COMPU_VTAB
/begin COMPU_METHOD SUPCH_SY_Compu "" TAB_VERB "%6.3" "" COMPU_TAB_REF SUPCH_SY_Compu /end COMPU_METHOD
/begin COMPU_VTAB SUPCH_SY_Compu "" TAB_VERB 2 0 "FALSE" 1 "TRUE" /end COMPU_VTAB
/begin COMPU_METHOD SVCrnt_mA_COMPU "" RAT_FUNC "%6.1" "mA" COEFFS 0 0.0341 0 0 0 1 /end COMPU_METHOD
/begin COMPU_METHOD SVS_SY_Compu "" TAB_VERB "%6.3" "" COMPU_TAB_REF SVS_SY_Compu /end COMPU_METHOD
/begin COMPU_VTAB SVS_SY_Compu "" TAB_VERB 2 0 "False" 1 "True" /end COMPU_VTAB
/begin COMPU_METHOD SWAPMP_PMP1_SY_Compu "" TAB_VERB "%6.3" "" COMPU_TAB_REF SWAPMP_PMP1_SY_Compu /end COMPU_METHOD
/begin COMPU_VTAB SWAPMP_PMP1_SY_Compu "" TAB_VERB 2 0 "SWT_DISABLED" 1 "SWT_ENABLED" /end COMPU_VTAB
/begin COMPU_METHOD SWAPMP_PMP2_SY_Compu "" TAB_VERB "%6.3" "" COMPU_TAB_REF SWAPMP_PMP2_SY_Compu /end COMPU_METHOD
/begin COMPU_VTAB SWAPMP_PMP2_SY_Compu "" TAB_VERB 2 0 "SWT_DISABLED" 1 "SWT_ENABLED" /end COMPU_VTAB
/begin COMPU_METHOD SWAPMP_PMP3_SY_Compu "" TAB_VERB "%6.3" "" COMPU_TAB_REF SWAPMP_PMP3_SY_Compu /end COMPU_METHOD
/begin COMPU_VTAB SWAPMP_PMP3_SY_Compu "" TAB_VERB 2 0 "SWT_DISABLED" 1 "SWT_ENABLED" /end COMPU_VTAB
/begin COMPU_METHOD SWSAVW_AIRSYS_Compu "" TAB_VERB "%6.3" "" COMPU_TAB_REF SWSAVW_AIRSYS_Compu /end COMPU_METHOD
/begin COMPU_VTAB SWSAVW_AIRSYS_Compu "" TAB_VERB 2 0 "False" 1 "True" /end COMPU_VTAB
/begin COMPU_METHOD SWSVW_CHAELGDIAG_SY_Compu "" TAB_VERB "%6.3" "" COMPU_TAB_REF SWSVW_CHAELGDIAG_SY_Compu /end COMPU_METHOD
/begin COMPU_VTAB SWSVW_CHAELGDIAG_SY_Compu "" TAB_VERB 2 0 "FALSE" 1 "TRUE" /end COMPU_VTAB
/begin COMPU_METHOD SWSVW_DTEV_SY_Compu "" TAB_VERB "%6.3" "" COMPU_TAB_REF SWSVW_DTEV_SY_Compu /end COMPU_METHOD
/begin COMPU_VTAB SWSVW_DTEV_SY_Compu "" TAB_VERB 2 0 "False" 1 "True" /end COMPU_VTAB
/begin COMPU_METHOD SWSVW_IFMBAL_SY_Compu "" TAB_VERB "%6.3" "" COMPU_TAB_REF SWSVW_IFMBAL_SY_Compu /end COMPU_METHOD
/begin COMPU_VTAB SWSVW_IFMBAL_SY_Compu "" TAB_VERB 2 0 "FALSE" 1 "TRUE" /end COMPU_VTAB
/begin COMPU_METHOD SWSVW_PCRMONOTURBO_SY_Compu "" TAB_VERB "%6.3" "" COMPU_TAB_REF SWSVW_PCRMONOTURBO_SY_Compu /end COMPU_METHOD
/begin COMPU_VTAB SWSVW_PCRMONOTURBO_SY_Compu "" TAB_VERB 2 0 "False" 1 "True" /end COMPU_VTAB
/begin COMPU_METHOD SWSVW_PIGPROT_SY_Compu "" TAB_VERB "%6.3" "" COMPU_TAB_REF SWSVW_PIGPROT_SY_Compu /end COMPU_METHOD
/begin COMPU_VTAB SWSVW_PIGPROT_SY_Compu "" TAB_VERB 2 0 "no SWSVW PIGPROT" 1 "SWSVW PIGPROT" /end COMPU_VTAB
/begin COMPU_METHOD SYC_AFTRUNDIAG_SC_Compu "" TAB_VERB "%6.3" "" COMPU_TAB_REF SYC_AFTRUNDIAG_SC_Compu /end COMPU_METHOD
/begin COMPU_VTAB SYC_AFTRUNDIAG_SC_Compu "" TAB_VERB 2 0 "False" 1 "True" /end COMPU_VTAB
/begin COMPU_METHOD SYC_CAL_PERMSPLYSYS_SY_Compu "" TAB_VERB "%6.3" "" COMPU_TAB_REF SYC_CAL_PERMSPLYSYS_SY_Compu /end COMPU_METHOD
/begin COMPU_VTAB SYC_CAL_PERMSPLYSYS_SY_Compu "" TAB_VERB 2 0 "False" 1 "True" /end COMPU_VTAB
/begin COMPU_METHOD SYC_CNTPOSTDRV_SC_Compu "" TAB_VERB "%6.3" "" COMPU_TAB_REF SYC_CNTPOSTDRV_SC_Compu /end COMPU_METHOD
/begin COMPU_VTAB SYC_CNTPOSTDRV_SC_Compu "" TAB_VERB 2 0 "False" 1 "True" /end COMPU_VTAB
/begin COMPU_METHOD SYC_COORD_SC_Compu "" TAB_VERB "%6.3" "" COMPU_TAB_REF SYC_COORD_SC_Compu /end COMPU_METHOD
/begin COMPU_VTAB SYC_COORD_SC_Compu "" TAB_VERB 2 0 "False" 1 "True" /end COMPU_VTAB
/begin COMPU_METHOD SYC_ENALCYPROLG_SC_Compu "" TAB_VERB "%6.3" "" COMPU_TAB_REF SYC_ENALCYPROLG_SC_Compu /end COMPU_METHOD
/begin COMPU_VTAB SYC_ENALCYPROLG_SC_Compu "" TAB_VERB 2 0 "False" 1 "True" /end COMPU_VTAB
/begin COMPU_METHOD SYC_FSTSWOFF_SY_Compu "" TAB_VERB "%6.3" "" COMPU_TAB_REF SYC_FSTSWOFF_SY_Compu /end COMPU_METHOD
/begin COMPU_VTAB SYC_FSTSWOFF_SY_Compu "" TAB_VERB 2 0 "False" 1 "True" /end COMPU_VTAB
/begin COMPU_METHOD SYC_MRLY_SC_Compu "" TAB_VERB "%6.3" "" COMPU_TAB_REF SYC_MRLY_SC_Compu /end COMPU_METHOD
/begin COMPU_VTAB SYC_MRLY_SC_Compu "" TAB_VERB 2 0 "False" 1 "True" /end COMPU_VTAB
/begin COMPU_METHOD SYC_POWERUNDERVOLTAGE_SC_Compu "" TAB_VERB "%6.3" "" COMPU_TAB_REF SYC_POWERUNDERVOLTAGE_SC_Compu /end COMPU_METHOD
/begin COMPU_VTAB SYC_POWERUNDERVOLTAGE_SC_Compu "" TAB_VERB 2 0 "False" 1 "True" /end COMPU_VTAB
/begin COMPU_METHOD SYC_POWER_SC_Compu "" TAB_VERB "%6.3" "" COMPU_TAB_REF SYC_POWER_SC_Compu /end COMPU_METHOD
/begin COMPU_VTAB SYC_POWER_SC_Compu "" TAB_VERB 2 0 "False" 1 "True" /end COMPU_VTAB
/begin COMPU_METHOD SYC_PROLGPREDRV_SC_Compu "" TAB_VERB "%6.3" "" COMPU_TAB_REF SYC_PROLGPREDRV_SC_Compu /end COMPU_METHOD
/begin COMPU_VTAB SYC_PROLGPREDRV_SC_Compu "" TAB_VERB 2 0 "False" 1 "True" /end COMPU_VTAB
/begin COMPU_METHOD SYC_SHUTDOWNSERVICES_SC_Compu "" TAB_VERB "%6.3" "" COMPU_TAB_REF SYC_SHUTDOWNSERVICES_SC_Compu /end COMPU_METHOD
/begin COMPU_VTAB SYC_SHUTDOWNSERVICES_SC_Compu "" TAB_VERB 2 0 "False" 1 "True" /end COMPU_VTAB
/begin COMPU_METHOD SYC_SYSTYP_SC_Compu "" TAB_VERB "%6.3" "" COMPU_TAB_REF SYC_SYSTYP_SC_Compu /end COMPU_METHOD
/begin COMPU_VTAB SYC_SYSTYP_SC_Compu "" TAB_VERB 2 0 "SysB" 1 "EcuCtrl" /end COMPU_VTAB
/begin COMPU_METHOD SYC_T15POSTPREDRV_SWRST_SY_Compu "" TAB_VERB "%6.3" "" COMPU_TAB_REF SYC_T15POSTPREDRV_SWRST_SY_Compu /end COMPU_METHOD
/begin COMPU_VTAB SYC_T15POSTPREDRV_SWRST_SY_Compu "" TAB_VERB 2 0 "False" 1 "True" /end COMPU_VTAB
/begin COMPU_METHOD SYC_T15RSTSIM_SY_Compu "" TAB_VERB "%6.3" "" COMPU_TAB_REF SYC_T15RSTSIM_SY_Compu /end COMPU_METHOD
/begin COMPU_VTAB SYC_T15RSTSIM_SY_Compu "" TAB_VERB 2 0 "False" 1 "True" /end COMPU_VTAB
/begin COMPU_METHOD SYC_WREEPBLK_SY_Compu "" TAB_VERB "%6.3" "" COMPU_TAB_REF SYC_WREEPBLK_SY_Compu /end COMPU_METHOD
/begin COMPU_VTAB SYC_WREEPBLK_SY_Compu "" TAB_VERB 2 0 "EEP-Block for SyC is not written" 1 "EEP-Block for SyC is written" /end COMPU_VTAB
/begin COMPU_METHOD SYC_X2ME_SC_Compu "" TAB_VERB "%6.3" "" COMPU_TAB_REF SYC_X2ME_SC_Compu /end COMPU_METHOD
/begin COMPU_VTAB SYC_X2ME_SC_Compu "" TAB_VERB 2 0 "False" 1 "True" /end COMPU_VTAB
/begin COMPU_METHOD SYSA_DSQACTVT_SC_Compu "" TAB_VERB "%6.3" "" COMPU_TAB_REF SYSA_DSQACTVT_SC_Compu /end COMPU_METHOD
/begin COMPU_VTAB SYSA_DSQACTVT_SC_Compu "" TAB_VERB 2 0 "Inactive" 1 "Active" /end COMPU_VTAB
/begin COMPU_METHOD SYSB_ENAUSER_SC_Compu "" TAB_VERB "%6.3" "" COMPU_TAB_REF SYSB_ENAUSER_SC_Compu /end COMPU_METHOD
/begin COMPU_VTAB SYSB_ENAUSER_SC_Compu "" TAB_VERB 2 0 "False" 1 "True" /end COMPU_VTAB
/begin COMPU_METHOD SYSB_PHYTERMINAL15_SC_Compu "" TAB_VERB "%6.3" "" COMPU_TAB_REF SYSB_PHYTERMINAL15_SC_Compu /end COMPU_METHOD
/begin COMPU_VTAB SYSB_PHYTERMINAL15_SC_Compu "" TAB_VERB 2 0 "False" 1 "True" /end COMPU_VTAB
/begin COMPU_METHOD SYSDIAG_EOLTESTCOORRENA_SC_Compu "" TAB_VERB "%6.3" "" COMPU_TAB_REF SYSDIAG_EOLTESTCOORRENA_SC_Compu /end COMPU_METHOD
/begin COMPU_VTAB SYSDIAG_EOLTESTCOORRENA_SC_Compu "" TAB_VERB 2 0 "False" 1 "True" /end COMPU_VTAB
/begin COMPU_METHOD SYSDIAG_NRAFTRUNCOORRARRELEM_SC_Compu "" RAT_FUNC "%6.2" "" COEFFS 0 1 0 0 0 1 /end COMPU_METHOD
/begin COMPU_METHOD SYSDIAG_NROBDOBSVRCFG_SC_Compu "" TAB_VERB "%6.3" "" COMPU_TAB_REF SYSDIAG_NROBDOBSVRCFG_SC_Compu /end COMPU_METHOD
/begin COMPU_VTAB SYSDIAG_NROBDOBSVRCFG_SC_Compu "" TAB_VERB 3 0 "0" 1 "1" 2 "2" /end COMPU_VTAB
/begin COMPU_METHOD SYSDIAG_SWTEMGYSTACTV_SC_Compu "" TAB_VERB "%6.3" "" COMPU_TAB_REF SYSDIAG_SWTEMGYSTACTV_SC_Compu /end COMPU_METHOD
/begin COMPU_VTAB SYSDIAG_SWTEMGYSTACTV_SC_Compu "" TAB_VERB 2 0 "Disable" 1 "Enable" /end COMPU_VTAB
/begin COMPU_METHOD SY_2HDP2_Compu "" TAB_VERB "%6.3" "" COMPU_TAB_REF SY_2HDP2_Compu /end COMPU_METHOD
/begin COMPU_VTAB SY_2HDP2_Compu "" TAB_VERB 2 0 "1 HDP" 1 "2 HDP" /end COMPU_VTAB
/begin COMPU_METHOD SY_2LBK_Compu "" TAB_VERB "%6.3" "" COMPU_TAB_REF SY_2LBK_Compu /end COMPU_METHOD
/begin COMPU_VTAB SY_2LBK_Compu "" TAB_VERB 2 0 "no LBK for Bank 2" 1 "LBK for Bank 2 is present" /end COMPU_VTAB
/begin COMPU_METHOD SY_2SGHST_Compu "" TAB_VERB "%6.3" "" COMPU_TAB_REF SY_2SGHST_Compu /end COMPU_METHOD
/begin COMPU_VTAB SY_2SGHST_Compu "" TAB_VERB 2 0 "Heißstartbed. auch im SLAVE berechnet" 1 "Heißstartbed. nur im MASTER berechnet" /end COMPU_VTAB
/begin COMPU_METHOD SY_2SG_Compu "" TAB_VERB "%6.3" "" COMPU_TAB_REF SY_2SG_Compu /end COMPU_METHOD
/begin COMPU_VTAB SY_2SG_Compu "" TAB_VERB 2 0 "1 Steuergerät" 1 "2 Steuergeräte" /end COMPU_VTAB
/begin COMPU_METHOD SY_2TANK_Compu "" TAB_VERB "%6.3" "" COMPU_TAB_REF SY_2TANK_Compu /end COMPU_METHOD
/begin COMPU_VTAB SY_2TANK_Compu "" TAB_VERB 2 0 "SY_2TANK =0" 1 "SY_2TANK >0" /end COMPU_VTAB
/begin COMPU_METHOD SY_2TEV_Compu "" TAB_VERB "%6.3" "" COMPU_TAB_REF SY_2TEV_Compu /end COMPU_METHOD
/begin COMPU_VTAB SY_2TEV_Compu "" TAB_VERB 2 0 "kein TEV-Fehlerpfad fuer Bank 2 vorhanden" 1 "TEV-Fehlerpfad fuer Bank 2 vorhanden" /end COMPU_VTAB
/begin COMPU_METHOD SY_2VD_Compu "" TAB_VERB "%6.3" "" COMPU_TAB_REF SY_2VD_Compu /end COMPU_METHOD
/begin COMPU_VTAB SY_2VD_Compu "" TAB_VERB 4 0 "kein zweit. Verdichter" 1 "ATL" 2 "Kompressor" 3 "EZV" /end COMPU_VTAB
/begin COMPU_METHOD SY_AAV_Compu "" TAB_VERB "%6.3" "" COMPU_TAB_REF SY_AAV_Compu /end COMPU_METHOD
/begin COMPU_VTAB SY_AAV_Compu "" TAB_VERB 2 0 "AKFShutOffValve_NotAvailable" 1 "AKFShutOffValve_Available" /end COMPU_VTAB
/begin COMPU_METHOD SY_ABGKL_Compu "" TAB_VERB "%6.3" "" COMPU_TAB_REF SY_ABGKL_Compu /end COMPU_METHOD
/begin COMPU_VTAB SY_ABGKL_Compu "" TAB_VERB 2 0 "keine Abgasklappe vorhanden" 1 "Abgasklappe vorhanden" /end COMPU_VTAB
/begin COMPU_METHOD SY_ABGYVBP_Compu "" TAB_VERB "%6.3" "" COMPU_TAB_REF SY_ABGYVBP_Compu /end COMPU_METHOD
/begin COMPU_VTAB SY_ABGYVBP_Compu "" TAB_VERB 5 0 "keine Y-Zusammenführung" 5 "Y-Zusammenführung vor Bauteileposition 5" 9 "Y-Zusammenführung vor Bauteileposition 9" 12 "Y-Zusammenführung vor Bauteileposition 12" 13 "Y-Zusammenführung vor Bauteileposition 13" /end COMPU_VTAB
/begin COMPU_METHOD SY_ABGY_Compu "" TAB_VERB "%6.3" "" COMPU_TAB_REF SY_ABGY_Compu /end COMPU_METHOD
/begin COMPU_VTAB SY_ABGY_Compu "" TAB_VERB 2 0 "kein Y-Abgassystem" 1 "Y-Abgassystem" /end COMPU_VTAB
/begin COMPU_METHOD SY_ABMZND_Compu "" TAB_VERB "%6.3" "" COMPU_TAB_REF SY_ABMZND_Compu /end COMPU_METHOD
/begin COMPU_VTAB SY_ABMZND_Compu "" TAB_VERB 2 0 "keine Einspritzausblendung bei Zuendfehler" 1 "Einspritzausblendung bei Zuendfehler" /end COMPU_VTAB
/begin COMPU_METHOD SY_ADTESK_Compu "" TAB_VERB "%6.3" "" COMPU_TAB_REF SY_ADTESK_Compu /end COMPU_METHOD
/begin COMPU_VTAB SY_ADTESK_Compu "" TAB_VERB 2 0 "False" 1 "True" /end COMPU_VTAB
/begin COMPU_METHOD SY_AFIMVAR_Compu "" TAB_VERB "%6.3" "" COMPU_TAB_REF SY_AFIMVAR_Compu /end COMPU_METHOD
/begin COMPU_VTAB SY_AFIMVAR_Compu "" TAB_VERB 6 0 "NOAFIM" 1 "AFIMDIS" 2 "AFIMEZLA" 3 "AFIMMFK" 4 "AFIMEZFRQ" 5 "AFIMCILCN" /end COMPU_VTAB
/begin COMPU_METHOD SY_AGR2_Compu "" TAB_VERB "%6.3" "" COMPU_TAB_REF SY_AGR2_Compu /end COMPU_METHOD
/begin COMPU_VTAB SY_AGR2_Compu "" TAB_VERB 2 0 "FALSE" 1 "TRUE" /end COMPU_VTAB
/begin COMPU_METHOD SY_AGRBZSV_Compu "" TAB_VERB "%6.3" "" COMPU_TAB_REF SY_AGRBZSV_Compu /end COMPU_METHOD
/begin COMPU_VTAB SY_AGRBZSV_Compu "" TAB_VERB 2 0 "Feste Blende zw.  AGR und SR nicht vorhanden" 1 "Feste Blende zw.  AGR und SR vorhanden" /end COMPU_VTAB
/begin COMPU_METHOD SY_AGRCLV_Compu "" TAB_VERB "%6.3" "" COMPU_TAB_REF SY_AGRCLV_Compu /end COMPU_METHOD
/begin COMPU_VTAB SY_AGRCLV_Compu "" TAB_VERB 2 0 "Feature disabled" 1 "Feature enabled" /end COMPU_VTAB
/begin COMPU_METHOD SY_AGREDK_Compu "" TAB_VERB "%6.3" "" COMPU_TAB_REF SY_AGREDK_Compu /end COMPU_METHOD
/begin COMPU_VTAB SY_AGREDK_Compu "" TAB_VERB 2 0 "keine Erwärmung der Drosselklappe durch ext. AGR" 1 "Erwärmung der Drosselklappe durch ext. AGR" /end COMPU_VTAB
/begin COMPU_METHOD SY_AGREOA_Compu "" TAB_VERB "%6.3" "" COMPU_TAB_REF SY_AGREOA_Compu /end COMPU_METHOD
/begin COMPU_VTAB SY_AGREOA_Compu "" TAB_VERB 3 0 "aus Bank1" 1 "aus Bank2" 2 "aus Bank 1 und 2" /end COMPU_VTAB
/begin COMPU_METHOD SY_AGREOB_Compu "" TAB_VERB "%6.3" "" COMPU_TAB_REF SY_AGREOB_Compu /end COMPU_METHOD
/begin COMPU_VTAB SY_AGREOB_Compu "" TAB_VERB 5 0 "im Krümmer" 1 "vor Vorkat" 2 "hinter Vorkat" 3 "vor Speicherkat" 4 "im Krümmer mit Aufladung" /end COMPU_VTAB
/begin COMPU_METHOD SY_AGRKOMP_Compu "" TAB_VERB "%6.3" "" COMPU_TAB_REF SY_AGRKOMP_Compu /end COMPU_METHOD
/begin COMPU_VTAB SY_AGRKOMP_Compu "" TAB_VERB 6 0 "kein AGR" 1 "Proportionalmagnet" 2 "Steppermotor" 3 "DC-Motor" 4 "MELCO Tellerstössel" 5 "Delphi Torquer-Ventil" /end COMPU_VTAB
/begin COMPU_METHOD SY_AGRTS_Compu "" TAB_VERB "%6.3" "" COMPU_TAB_REF SY_AGRTS_Compu /end COMPU_METHOD
/begin COMPU_VTAB SY_AGRTS_Compu "" TAB_VERB 2 0 "keine Abschaltung AGR wird bei zu hoher Temp." 1 "Abschaltung AGR wird bei zu hoher Temp." /end COMPU_VTAB
/begin COMPU_METHOD SY_AGRVR_Compu "" TAB_VERB "%6.3" "" COMPU_TAB_REF SY_AGRVR_Compu /end COMPU_METHOD
/begin COMPU_VTAB SY_AGRVR_Compu "" TAB_VERB 2 0 "False" 1 "True" /end COMPU_VTAB
/begin COMPU_METHOD SY_AGR_Compu "" TAB_VERB "%6.3" "" COMPU_TAB_REF SY_AGR_Compu /end COMPU_METHOD
/begin COMPU_VTAB SY_AGR_Compu "" TAB_VERB 2 0 "FALSE" 1 "TRUE" /end COMPU_VTAB
/begin COMPU_METHOD SY_AIRBAG_Compu "" TAB_VERB "%6.3" "" COMPU_TAB_REF SY_AIRBAG_Compu /end COMPU_METHOD
/begin COMPU_VTAB SY_AIRBAG_Compu "" TAB_VERB 2 0 "kein Airbagsignal verfügbar" 1 "Airbagsignal verfügbar" /end COMPU_VTAB
/begin COMPU_METHOD SY_AMSHFMP_Compu "" TAB_VERB "%6.3" "" COMPU_TAB_REF SY_AMSHFMP_Compu /end COMPU_METHOD
/begin COMPU_VTAB SY_AMSHFMP_Compu "" TAB_VERB 2 0 "inactiv" 1 "based on MAP" /end COMPU_VTAB
/begin COMPU_METHOD SY_ANST_Compu "" TAB_VERB "%6.3" "" COMPU_TAB_REF SY_ANST_Compu /end COMPU_METHOD
/begin COMPU_VTAB SY_ANST_Compu "" TAB_VERB 2 0 "False" 1 "True" /end COMPU_VTAB
/begin COMPU_METHOD SY_ANZEKP_Compu "" RAT_FUNC "%6.2" "" COEFFS 0 1 0 0 0 1 /end COMPU_METHOD
/begin COMPU_METHOD t1sxs_q1 "" RAT_FUNC "%6.2" "s" COEFFS 0 1 0 0 0 1 /end COMPU_METHOD
/begin COMPU_METHOD t50msxs_q0p05 "" RAT_FUNC "%6.4" "s" COEFFS 0 1 0 0 0 0.05 /end COMPU_METHOD
/begin COMPU_METHOD Temp_Cels "" RAT_FUNC "%6.1" "deg C" COEFFS 0 10 2731.4 0 0 1 /end COMPU_METHOD
/begin COMPU_METHOD temp_ub_q0p75_o48 "" RAT_FUNC "%6.2" "Grad C" COEFFS 0 1 48 0 0 0.75 /end COMPU_METHOD
/begin COMPU_METHOD TimeDelay_s "" RAT_FUNC "%6.1" "s" COEFFS 0 0 1 0 0.00023283064365387 0 /end COMPU_METHOD
/begin COMPU_METHOD Trq "" RAT_FUNC "%6.3" "Nm" COEFFS 0 10 0 0 0 1 /end COMPU_METHOD
/begin COMPU_METHOD tsquant_l "" RAT_FUNC "%6.4" "us" COEFFS 0 20 0 0 0 1 /end COMPU_METHOD
/begin COMPU_METHOD t_q0p01 "" RAT_FUNC "%6.4" "s" COEFFS 0 100 0 0 0 1 /end COMPU_METHOD
/begin COMPU_METHOD t_q0p1 "" RAT_FUNC "%6.3" "s" COEFFS 0 10 0 0 0 1 /end COMPU_METHOD
/begin COMPU_METHOD t_q0p2 "" RAT_FUNC "%6.3" "s" COEFFS 0 10 0 0 0 2 /end COMPU_METHOD
/begin COMPU_METHOD t_q2p5Em4 "" RAT_FUNC "%6.5" "s" COEFFS 0 4000 0 0 0 1 /end COMPU_METHOD
/begin COMPU_METHOD Vel "" RAT_FUNC "%6.4" "km/h" COEFFS 0 100 0 0 0 1 /end COMPU_METHOD
/begin COMPU_METHOD vfzg_uw_b512 "" RAT_FUNC "%6.4" "km/h" COEFFS 0 65536 0 0 0 512 /end COMPU_METHOD
/begin COMPU_METHOD zk10msxs_uw_b655 "" RAT_FUNC "%6.2" "s" COEFFS 0 0 65536 0 100 0 /end COMPU_METHOD
/begin COMPU_METHOD zk200msxs_uw_b13107 "" RAT_FUNC "%6.0" "s" COEFFS 0 0 13107.2 0 1 0 /end COMPU_METHOD
/begin COMPU_METHOD zk20msxs_uw_b1310p72 "" RAT_FUNC "%6.1" "s" COEFFS 0 0 65536 0 50 0 /end COMPU_METHOD
/begin COMPU_METHOD zw_q2p9297Em3_deg_KW "" RAT_FUNC "%6.4" "deg KW" COEFFS 0 1024 0 0 0 3 /end COMPU_METHOD
/begin RECORD_LAYOUT RB_Axis_S16 NO_AXIS_PTS_X 1 SWORD AXIS_PTS_X 2 SWORD INDEX_INCR DIRECT /end RECORD_LAYOUT
/begin RECORD_LAYOUT RB_Axis_U16 NO_AXIS_PTS_X 1 UWORD AXIS_PTS_X 2 UWORD INDEX_INCR DIRECT /end RECORD_LAYOUT
/begin RECORD_LAYOUT RB_Curve_S16_S16 NO_AXIS_PTS_X 1 SWORD AXIS_PTS_X 2 SWORD INDEX_INCR DIRECT FNC_VALUES 3 SWORD COLUMN_DIR DIRECT /end RECORD_LAYOUT
/begin RECORD_LAYOUT RB_Curve_S16_U16_Static NO_AXIS_PTS_X 1 SWORD AXIS_PTS_X 2 SWORD INDEX_INCR DIRECT FNC_VALUES 3 UWORD COLUMN_DIR DIRECT STATIC_RECORD_LAYOUT /end RECORD_LAYOUT
/begin RECORD_LAYOUT RB_Curve_S16_U8_Static NO_AXIS_PTS_X 1 SWORD AXIS_PTS_X 2 SWORD INDEX_INCR DIRECT FNC_VALUES 3 UBYTE COLUMN_DIR DIRECT STATIC_RECORD_LAYOUT /end RECORD_LAYOUT
/begin RECORD_LAYOUT RB_Curve_U16_U16 NO_AXIS_PTS_X 1 UWORD AXIS_PTS_X 2 UWORD INDEX_INCR DIRECT FNC_VALUES 3 UWORD COLUMN_DIR DIRECT /end RECORD_LAYOUT
/begin RECORD_LAYOUT RB_Curve_U16_U8_Static NO_AXIS_PTS_X 1 UWORD AXIS_PTS_X 2 UWORD INDEX_INCR DIRECT FNC_VALUES 3 UBYTE COLUMN_DIR DIRECT STATIC_RECORD_LAYOUT /end RECORD_LAYOUT
/begin RECORD_LAYOUT RB_Curve_U8_S8_Static NO_AXIS_PTS_X 1 UBYTE AXIS_PTS_X 2 UBYTE INDEX_INCR DIRECT FNC_VALUES 3 SBYTE COLUMN_DIR DIRECT STATIC_RECORD_LAYOUT /end RECORD_LAYOUT
/begin RECORD_LAYOUT RB_Curve_U8_U16_Static NO_AXIS_PTS_X 1 UBYTE AXIS_PTS_X 2 UBYTE INDEX_INCR DIRECT FNC_VALUES 3 UWORD COLUMN_DIR DIRECT STATIC_RECORD_LAYOUT /end RECORD_LAYOUT
/begin RECORD_LAYOUT RB_Curve_U8_U8 NO_AXIS_PTS_X 1 UBYTE AXIS_PTS_X 2 UBYTE INDEX_INCR DIRECT FNC_VALUES 3 UBYTE COLUMN_DIR DIRECT /end RECORD_LAYOUT
/begin RECORD_LAYOUT RB_FixCurve_S8_S8 FNC_VALUES 1 SBYTE COLUMN_DIR DIRECT /end RECORD_LAYOUT
/begin RECORD_LAYOUT RB_MapGroup_U16 FNC_VALUES 1 UWORD COLUMN_DIR DIRECT /end RECORD_LAYOUT
/begin RECORD_LAYOUT RB_MapGroup_U8 FNC_VALUES 1 UBYTE COLUMN_DIR DIRECT /end RECORD_LAYOUT
/begin RECORD_LAYOUT RB_Map_S16S16_U8 NO_AXIS_PTS_X 1 SWORD NO_AXIS_PTS_Y 2 SWORD AXIS_PTS_X 3 SWORD INDEX_INCR DIRECT AXIS_PTS_Y 4 SWORD INDEX_INCR DIRECT FNC_VALUES 5 UBYTE COLUMN_DIR DIRECT /end RECORD_LAYOUT
/begin RECORD_LAYOUT RB_Map_U16U16_U16 NO_AXIS_PTS_X 1 UWORD NO_AXIS_PTS_Y 2 UWORD AXIS_PTS_X 3 UWORD INDEX_INCR DIRECT AXIS_PTS_Y 4 UWORD INDEX_INCR DIRECT FNC_VALUES 5 UWORD COLUMN_DIR DIRECT /end RECORD_LAYOUT
/begin RECORD_LAYOUT RB_Map_U8U16_S8 NO_AXIS_PTS_X 1 UBYTE NO_AXIS_PTS_Y 2 UBYTE AXIS_PTS_X 3 UBYTE INDEX_INCR DIRECT AXIS_PTS_Y 4 UWORD INDEX_INCR DIRECT FNC_VALUES 5 SBYTE ROW_DIR DIRECT /end RECORD_LAYOUT
/begin RECORD_LAYOUT RB_Map_U8U16_U16 NO_AXIS_PTS_X 1 UBYTE NO_AXIS_PTS_Y 2 UBYTE AXIS_PTS_X 3 UBYTE INDEX_INCR DIRECT AXIS_PTS_Y 4 UWORD INDEX_INCR DIRECT FNC_VALUES 5 UWORD ROW_DIR DIRECT /end RECORD_LAYOUT
/begin RECORD_LAYOUT RB_Map_U8U16_U8 NO_AXIS_PTS_X 1 UBYTE NO_AXIS_PTS_Y 2 UBYTE AXIS_PTS_X 3 UBYTE INDEX_INCR DIRECT AXIS_PTS_Y 4 UWORD INDEX_INCR DIRECT FNC_VALUES 5 UBYTE ROW_DIR DIRECT /end RECORD_LAYOUT
/begin RECORD_LAYOUT RB_Val_Wboolean FNC_VALUES 1 UBYTE COLUMN_DIR DIRECT /end RECORD_LAYOUT
/begin RECORD_LAYOUT RB_Val_Ws16 FNC_VALUES 1 SWORD COLUMN_DIR DIRECT /end RECORD_LAYOUT
/begin RECORD_LAYOUT RB_Val_Ws32 FNC_VALUES 1 SLONG COLUMN_DIR DIRECT /end RECORD_LAYOUT
/begin RECORD_LAYOUT RB_Val_Ws8 FNC_VALUES 1 SBYTE COLUMN_DIR DIRECT /end RECORD_LAYOUT
/begin RECORD_LAYOUT RB_Val_Wu16 FNC_VALUES 1 UWORD COLUMN_DIR DIRECT /end RECORD_LAYOUT
/begin RECORD_LAYOUT RB_Val_Wu8 FNC_VALUES 1 UBYTE COLUMN_DIR DIRECT /end RECORD_LAYOUT
/begin RECORD_LAYOUT Val_Wu8 FNC_VALUES 1 UBYTE COLUMN_DIR DIRECT /end RECORD_LAYOUT
/end MODULE
/end PROJECT
