ASAP2_VERSION 1 60
/begin PROJECT MG1CS022 "MG1CS022"
/begin HEADER "" VERSION "MG1CS022_62XSC_V037" PROJECT_NO MG1CS022 /end HEADER
/begin MODULE DIM ""
/begin MOD_COMMON "" BYTE_ORDER MSB_LAST ALIGNMENT_BYTE 1 ALIGNMENT_WORD 2 ALIGNMENT_LONG 4 ALIGNMENT_INT64 4 ALIGNMENT_FLOAT32_IEEE 4 ALIGNMENT_FLOAT64_IEEE 4 DATA_SIZE 32 /end MOD_COMMON
/begin CHARACTERISTIC DFES_Cls.DFC_MfPsDiaScHiS1_C "fault class per DFC / Fault class for check DFC_MfPsDiaScHiS1" VALUE 0x804D9850 Val_Wu8 30.00 DFES_OneToOne 0.00 30.00 FORMAT "%5.2" EXTENDED_LIMITS 0.00 255.0 /end CHARACTERISTIC
/begin CHARACTERISTIC DFES_Cls.DFC_MfPsDiaScHiSLowS1_C "fault class per DFC / Fault class for check DFC_MfPsDiaScHiSLowS1" VALUE 0x804D9851 Val_Wu8 30.00 DFES_OneToOne 0.00 30.00 FORMAT "%5.2" EXTENDED_LIMITS 0.00 255.0 /end CHARACTERISTIC
/begin CHARACTERISTIC DFES_Cls.DFC_MfPsDiaScLowS1_C "fault class per DFC / Fault class for check DFC_MfPsDiaScLowS1" VALUE 0x804D9852 Val_Wu8 30.00 DFES_OneToOne 0.00 30.00 FORMAT "%5.2" EXTENDED_LIMITS 0.00 255.0 /end CHARACTERISTIC
/begin CHARACTERISTIC DFES_Cls.DFC_ACEvpTPhysRngHi_C "fault class per DFC / Fault class for check DFC_ACEvpTPhysRngHi" VALUE 0x804D9853 Val_Wu8 30.00 DFES_OneToOne 0.00 30.00 FORMAT "%5.2" EXTENDED_LIMITS 0.00 255.0 /end CHARACTERISTIC
/begin CHARACTERISTIC DFES_Cls.DFC_ACEvpTPhysRngLo_C "fault class per DFC / Fault class for check DFC_ACEvpTPhysRngLo" VALUE 0x804D9854 Val_Wu8 30.00 DFES_OneToOne 0.00 30.00 FORMAT "%5.2" EXTENDED_LIMITS 0.00 255.0 /end CHARACTERISTIC
/begin CHARACTERISTIC DFES_Cls.DFC_ACEvpTSRCMax_C "fault class per DFC / Fault class for check DFC_ACEvpTSRCMax" VALUE 0x804D9855 Val_Wu8 30.00 DFES_OneToOne 0.00 30.00 FORMAT "%5.2" EXTENDED_LIMITS 0.00 255.0 /end CHARACTERISTIC
/begin CHARACTERISTIC DFES_Cls.DFC_ACEvpTSRCMin_C "fault class per DFC / Fault class for check DFC_ACEvpTSRCMin" VALUE 0x804D9856 Val_Wu8 30.00 DFES_OneToOne 0.00 30.00 FORMAT "%5.2" EXTENDED_LIMITS 0.00 255.0 /end CHARACTERISTIC
/begin CHARACTERISTIC DFES_Cls.DFC_AfsRawSigRngHiB1_C "fault class per DFC / Fault class for check DFC_AfsRawSigRngHiB1" VALUE 0x804D9857 Val_Wu8 30.00 DFES_OneToOne 0.00 30.00 FORMAT "%5.2" EXTENDED_LIMITS 0.00 255.0 /end CHARACTERISTIC
/begin CHARACTERISTIC DFES_Cls.DFC_AfsRawSigRngLoB1_C "fault class per DFC / Fault class for check DFC_AfsRawSigRngLoB1" VALUE 0x804D9858 Val_Wu8 30.00 DFES_OneToOne 0.00 30.00 FORMAT "%5.2" EXTENDED_LIMITS 0.00 255.0 /end CHARACTERISTIC
/begin CHARACTERISTIC DFES_Cls.DFC_AfsSnsrErrB1_C "fault class per DFC / Fault class for check DFC_AfsSnsrErrB1" VALUE 0x804D9859 Val_Wu8 30.00 DFES_OneToOne 0.00 30.00 FORMAT "%5.2" EXTENDED_LIMITS 0.00 255.0 /end CHARACTERISTIC
/begin CHARACTERISTIC DFES_Cls.DFC_AirCClntPAnaSRCMax_C "fault class per DFC / Fault class for check DFC_AirCClntPAnaSRCMax" VALUE 0x804D985A Val_Wu8 30.00 DFES_OneToOne 0.00 30.00 FORMAT "%5.2" EXTENDED_LIMITS 0.00 255.0 /end CHARACTERISTIC
/begin CHARACTERISTIC DFES_Cls.DFC_AirCClntPAnaSRCMin_C "fault class per DFC / Fault class for check DFC_AirCClntPAnaSRCMin" VALUE 0x804D985B Val_Wu8 30.00 DFES_OneToOne 0.00 30.00 FORMAT "%5.2" EXTENDED_LIMITS 0.00 255.0 /end CHARACTERISTIC
/begin CHARACTERISTIC DFES_Cls.DFC_AirCSwtNpl_C "fault class per DFC / Fault class for check DFC_AirCSwtNpl" VALUE 0x804D985C Val_Wu8 30.00 DFES_OneToOne 0.00 30.00 FORMAT "%5.2" EXTENDED_LIMITS 0.00 255.0 /end CHARACTERISTIC
/begin CHARACTERISTIC DFES_Cls.DFC_AirCSwtSig_C "fault class per DFC / Fault class for check DFC_AirCSwtSig" VALUE 0x804D985D Val_Wu8 30.00 DFES_OneToOne 0.00 30.00 FORMAT "%5.2" EXTENDED_LIMITS 0.00 255.0 /end CHARACTERISTIC
/begin CHARACTERISTIC DFES_Cls.DFC_Brk_C "fault class per DFC / Fault class for check DFC_Brk" VALUE 0x804D985E Val_Wu8 30.00 DFES_OneToOne 0.00 30.00 FORMAT "%5.2" EXTENDED_LIMITS 0.00 255.0 /end CHARACTERISTIC
/begin CHARACTERISTIC DFES_Cls.DFC_BrkBstSensSCB_C "fault class per DFC / Fault class for check DFC_BrkBstSensSCB" VALUE 0x804D985F Val_Wu8 30.00 DFES_OneToOne 0.00 30.00 FORMAT "%5.2" EXTENDED_LIMITS 0.00 255.0 /end CHARACTERISTIC
/begin CHARACTERISTIC DFES_Cls.DFC_BrkBstSensSCG_C "fault class per DFC / Fault class for check DFC_BrkBstSensSCG" VALUE 0x804D9860 Val_Wu8 30.00 DFES_OneToOne 0.00 30.00 FORMAT "%5.2" EXTENDED_LIMITS 0.00 255.0 /end CHARACTERISTIC
/begin CHARACTERISTIC DFES_Cls.DFC_BrkSig_C "fault class per DFC / Fault class for check DFC_BrkSig" VALUE 0x804D9861 Val_Wu8 30.00 DFES_OneToOne 0.00 30.00 FORMAT "%5.2" EXTENDED_LIMITS 0.00 255.0 /end CHARACTERISTIC
/begin CHARACTERISTIC DFES_Cls.DFC_ClthSig_C "fault class per DFC / Fault class for check DFC_ClthSig" VALUE 0x804D9862 Val_Wu8 30.00 DFES_OneToOne 0.00 30.00 FORMAT "%5.2" EXTENDED_LIMITS 0.00 255.0 /end CHARACTERISTIC
/begin CHARACTERISTIC DFES_Cls.DFC_EGRVlvCurrLim_C "fault class per DFC / Fault class for check DFC_EGRVlvCurrLim" VALUE 0x804D9863 Val_Wu8 30.00 DFES_OneToOne 0.00 30.00 FORMAT "%5.2" EXTENDED_LIMITS 0.00 255.0 /end CHARACTERISTIC
/begin CHARACTERISTIC DFES_Cls.DFC_EGRVlvOL_C "fault class per DFC / Fault class for check DFC_EGRVlvOL" VALUE 0x804D9864 Val_Wu8 30.00 DFES_OneToOne 0.00 30.00 FORMAT "%5.2" EXTENDED_LIMITS 0.00 255.0 /end CHARACTERISTIC
/begin CHARACTERISTIC DFES_Cls.DFC_EGRVlvOvrTemp_C "fault class per DFC / Fault class for check DFC_EGRVlvOvrTemp" VALUE 0x804D9865 Val_Wu8 30.00 DFES_OneToOne 0.00 30.00 FORMAT "%5.2" EXTENDED_LIMITS 0.00 255.0 /end CHARACTERISTIC
/begin CHARACTERISTIC DFES_Cls.DFC_EGRVlvSCB_C "fault class per DFC / Fault class for check DFC_EGRVlvSCB" VALUE 0x804D9866 Val_Wu8 30.00 DFES_OneToOne 0.00 30.00 FORMAT "%5.2" EXTENDED_LIMITS 0.00 255.0 /end CHARACTERISTIC
/begin CHARACTERISTIC DFES_Cls.DFC_EGRVlvSCG_C "fault class per DFC / Fault class for check DFC_EGRVlvSCG" VALUE 0x804D9867 Val_Wu8 30.00 DFES_OneToOne 0.00 30.00 FORMAT "%5.2" EXTENDED_LIMITS 0.00 255.0 /end CHARACTERISTIC
/begin CHARACTERISTIC DFES_Cls.DFC_EGRVlvSRCMax_C "fault class per DFC / Fault class for check DFC_EGRVlvSRCMax" VALUE 0x804D9868 Val_Wu8 30.00 DFES_OneToOne 0.00 30.00 FORMAT "%5.2" EXTENDED_LIMITS 0.00 255.0 /end CHARACTERISTIC
/begin CHARACTERISTIC DFES_Cls.DFC_EGRVlvSRCMin_C "fault class per DFC / Fault class for check DFC_EGRVlvSRCMin" VALUE 0x804D9869 Val_Wu8 30.00 DFES_OneToOne 0.00 30.00 FORMAT "%5.2" EXTENDED_LIMITS 0.00 255.0 /end CHARACTERISTIC
/begin CHARACTERISTIC DFES_Cls.DFC_HLSDemOvhtEngLim_C "fault class per DFC / Fault class for check DFC_HLSDemOvhtEngLim" VALUE 0x804D986A Val_Wu8 30.00 DFES_OneToOne 0.00 30.00 FORMAT "%5.2" EXTENDED_LIMITS 0.00 255.0 /end CHARACTERISTIC
/begin CHARACTERISTIC DFES_Cls.DFC_OilPSwmpSRCMax_C "fault class per DFC / Fault class for check DFC_OilPSwmpSRCMax" VALUE 0x804D986B Val_Wu8 30.00 DFES_OneToOne 0.00 30.00 FORMAT "%5.2" EXTENDED_LIMITS 0.00 255.0 /end CHARACTERISTIC
/begin CHARACTERISTIC DFES_Cls.DFC_OilPSwmpSRCMin_C "fault class per DFC / Fault class for check DFC_OilPSwmpSRCMin" VALUE 0x804D986C Val_Wu8 30.00 DFES_OneToOne 0.00 30.00 FORMAT "%5.2" EXTENDED_LIMITS 0.00 255.0 /end CHARACTERISTIC
/begin CHARACTERISTIC DFES_Cls.DFC_PIntkVUsLineHiB1_C "fault class per DFC / Fault class for check DFC_PIntkVUsLineHiB1" VALUE 0x804D986D Val_Wu8 30.00 DFES_OneToOne 0.00 30.00 FORMAT "%5.2" EXTENDED_LIMITS 0.00 255.0 /end CHARACTERISTIC
/begin CHARACTERISTIC DFES_Cls.DFC_PIntkVUsLineLoB1_C "fault class per DFC / Fault class for check DFC_PIntkVUsLineLoB1" VALUE 0x804D986E Val_Wu8 30.00 DFES_OneToOne 0.00 30.00 FORMAT "%5.2" EXTENDED_LIMITS 0.00 255.0 /end CHARACTERISTIC
/begin CHARACTERISTIC DFES_Cls.DFC_VehVPhysRngLo_C "fault class per DFC / Fault class for check DFC_VehVPhysRngLo" VALUE 0x804D986F Val_Wu8 30.00 DFES_OneToOne 0.00 30.00 FORMAT "%5.2" EXTENDED_LIMITS 0.00 255.0 /end CHARACTERISTIC
/begin CHARACTERISTIC DFES_Cls.DFC_VehVSigCan_C "fault class per DFC / Fault class for check DFC_VehVSigCan" VALUE 0x804D9870 Val_Wu8 30.00 DFES_OneToOne 0.00 30.00 FORMAT "%5.2" EXTENDED_LIMITS 0.00 255.0 /end CHARACTERISTIC
/begin CHARACTERISTIC DFES_Cls.DFC_VehVSigCanSafe_C "fault class per DFC / Fault class for check DFC_VehVSigCanSafe" VALUE 0x804D9871 Val_Wu8 30.00 DFES_OneToOne 0.00 30.00 FORMAT "%5.2" EXTENDED_LIMITS 0.00 255.0 /end CHARACTERISTIC
/begin CHARACTERISTIC DFES_Cls.DFC_VlvLftFbOilPSnsrIntk11SRCMax_C "fault class per DFC / Fault class for check DFC_VlvLftFbOilPSnsrIntk11SRCMax" VALUE 0x804D9872 Val_Wu8 30.00 DFES_OneToOne 0.00 30.00 FORMAT "%5.2" EXTENDED_LIMITS 0.00 255.0 /end CHARACTERISTIC
/begin CHARACTERISTIC DFES_Cls.DFC_VlvLftFbOilPSnsrIntk11SRCMin_C "fault class per DFC / Fault class for check DFC_VlvLftFbOilPSnsrIntk11SRCMin" VALUE 0x804D9873 Val_Wu8 30.00 DFES_OneToOne 0.00 30.00 FORMAT "%5.2" EXTENDED_LIMITS 0.00 255.0 /end CHARACTERISTIC
/begin CHARACTERISTIC DFES_Cls.DFC_ClthNpl_C "fault class per DFC / Fault class for check DFC_ClthNpl" VALUE 0x804D9874 Val_Wu8 30.00 DFES_OneToOne 0.00 30.00 FORMAT "%5.2" EXTENDED_LIMITS 0.00 255.0 /end CHARACTERISTIC
/begin CHARACTERISTIC DFES_Cls.DFC_GbxPNPosnDrvCdn_C "fault class per DFC / Fault class for check DFC_GbxPNPosnDrvCdn" VALUE 0x804D9875 Val_Wu8 30.00 DFES_OneToOne 0.00 30.00 FORMAT "%5.2" EXTENDED_LIMITS 0.00 255.0 /end CHARACTERISTIC
/begin CHARACTERISTIC DFES_Cls.DFC_GbxPNPosnPlausy_C "fault class per DFC / Fault class for check DFC_GbxPNPosnPlausy" VALUE 0x804D9876 Val_Wu8 30.00 DFES_OneToOne 0.00 30.00 FORMAT "%5.2" EXTENDED_LIMITS 0.00 255.0 /end CHARACTERISTIC
/begin CHARACTERISTIC DFES_Cls.DFC_AfsSigErrLineHiB1_C "fault class per DFC / Fault class for check DFC_AfsSigErrLineHiB1" VALUE 0x804D9877 Val_Wu8 30.00 DFES_OneToOne 0.00 30.00 FORMAT "%5.2" EXTENDED_LIMITS 0.00 255.0 /end CHARACTERISTIC
/begin CHARACTERISTIC DFES_Cls.DFC_AfsSigErrLineLoB1_C "fault class per DFC / Fault class for check DFC_AfsSigErrLineLoB1" VALUE 0x804D9878 Val_Wu8 30.00 DFES_OneToOne 0.00 30.00 FORMAT "%5.2" EXTENDED_LIMITS 0.00 255.0 /end CHARACTERISTIC
/begin CHARACTERISTIC DFES_Cls.DFC_PEnvCcMax_C "fault class per DFC / Fault class for check DFC_PEnvCcMax" VALUE 0x804D9879 Val_Wu8 30.00 DFES_OneToOne 0.00 30.00 FORMAT "%5.2" EXTENDED_LIMITS 0.00 255.0 /end CHARACTERISTIC
/begin CHARACTERISTIC DFES_Cls.DFC_PEnvCcMin_C "fault class per DFC / Fault class for check DFC_PEnvCcMin" VALUE 0x804D987A Val_Wu8 30.00 DFES_OneToOne 0.00 30.00 FORMAT "%5.2" EXTENDED_LIMITS 0.00 255.0 /end CHARACTERISTIC
/begin CHARACTERISTIC DFES_Cls.DFC_PEnvRngChkMax_C "fault class per DFC / Fault class for check DFC_PEnvRngChkMax" VALUE 0x804D987B Val_Wu8 30.00 DFES_OneToOne 0.00 30.00 FORMAT "%5.2" EXTENDED_LIMITS 0.00 255.0 /end CHARACTERISTIC
/begin CHARACTERISTIC DFES_Cls.DFC_PEnvRngChkMin_C "fault class per DFC / Fault class for check DFC_PEnvRngChkMin" VALUE 0x804D987C Val_Wu8 30.00 DFES_OneToOne 0.00 30.00 FORMAT "%5.2" EXTENDED_LIMITS 0.00 255.0 /end CHARACTERISTIC
/begin CHARACTERISTIC DFES_Cls.DFC_PEnvSnsrPlaus_C "fault class per DFC / Fault class for check DFC_PEnvSnsrPlaus" VALUE 0x804D987D Val_Wu8 30.00 DFES_OneToOne 0.00 30.00 FORMAT "%5.2" EXTENDED_LIMITS 0.00 255.0 /end CHARACTERISTIC
/begin CHARACTERISTIC DFES_Cls.DFC_UEGOHeatrRlyPsOLS1B1_C "fault class per DFC / Fault class for check DFC_UEGOHeatrRlyPsOLS1B1" VALUE 0x804D987E Val_Wu8 30.00 DFES_OneToOne 0.00 30.00 FORMAT "%5.2" EXTENDED_LIMITS 0.00 255.0 /end CHARACTERISTIC
/begin CHARACTERISTIC DFES_Cls.DFC_UEGOHeatrRlyPsSCBS1B1_C "fault class per DFC / Fault class for check DFC_UEGOHeatrRlyPsSCBS1B1" VALUE 0x804D987F Val_Wu8 30.00 DFES_OneToOne 0.00 30.00 FORMAT "%5.2" EXTENDED_LIMITS 0.00 255.0 /end CHARACTERISTIC
/begin CHARACTERISTIC DFES_Cls.DFC_UEGOHeatrRlyPsSCGS1B1_C "fault class per DFC / Fault class for check DFC_UEGOHeatrRlyPsSCGS1B1" VALUE 0x804D9880 Val_Wu8 30.00 DFES_OneToOne 0.00 30.00 FORMAT "%5.2" EXTENDED_LIMITS 0.00 255.0 /end CHARACTERISTIC
/begin CHARACTERISTIC DFES_Cls.DFC_UegoHeatrWireOlS1B1_C "fault class per DFC / Fault class for check DFC_UegoHeatrWireOlS1B1" VALUE 0x804D9881 Val_Wu8 30.00 DFES_OneToOne 0.00 30.00 FORMAT "%5.2" EXTENDED_LIMITS 0.00 255.0 /end CHARACTERISTIC
/begin CHARACTERISTIC DFES_Cls.DFC_UegoHeatrWireScbS1B1_C "fault class per DFC / Fault class for check DFC_UegoHeatrWireScbS1B1" VALUE 0x804D9882 Val_Wu8 30.00 DFES_OneToOne 0.00 30.00 FORMAT "%5.2" EXTENDED_LIMITS 0.00 255.0 /end CHARACTERISTIC
/begin CHARACTERISTIC DFES_Cls.DFC_UegoHeatrWireScgS1B1_C "fault class per DFC / Fault class for check DFC_UegoHeatrWireScgS1B1" VALUE 0x804D9883 Val_Wu8 30.00 DFES_OneToOne 0.00 30.00 FORMAT "%5.2" EXTENDED_LIMITS 0.00 255.0 /end CHARACTERISTIC
/begin CHARACTERISTIC DFES_Cls.DFC_KnDetSens1PortAMax_C "fault class per DFC / Fault class for check DFC_KnDetSens1PortAMax" VALUE 0x804D9884 Val_Wu8 30.00 DFES_OneToOne 0.00 30.00 FORMAT "%5.2" EXTENDED_LIMITS 0.00 255.0 /end CHARACTERISTIC
/begin CHARACTERISTIC DFES_Cls.DFC_KnDetSens1PortAMin_C "fault class per DFC / Fault class for check DFC_KnDetSens1PortAMin" VALUE 0x804D9885 Val_Wu8 30.00 DFES_OneToOne 0.00 30.00 FORMAT "%5.2" EXTENDED_LIMITS 0.00 255.0 /end CHARACTERISTIC
/begin CHARACTERISTIC DFES_Cls.DFC_KnDetSens1PortBMax_C "fault class per DFC / Fault class for check DFC_KnDetSens1PortBMax" VALUE 0x804D9886 Val_Wu8 30.00 DFES_OneToOne 0.00 30.00 FORMAT "%5.2" EXTENDED_LIMITS 0.00 255.0 /end CHARACTERISTIC
/begin CHARACTERISTIC DFES_Cls.DFC_KnDetSens1PortBMin_C "fault class per DFC / Fault class for check DFC_KnDetSens1PortBMin" VALUE 0x804D9887 Val_Wu8 30.00 DFES_OneToOne 0.00 30.00 FORMAT "%5.2" EXTENDED_LIMITS 0.00 255.0 /end CHARACTERISTIC
/begin CHARACTERISTIC DFES_Cls.DFC_Clth2ONStuck_C "fault class per DFC / Fault class for check DFC_Clth2ONStuck" VALUE 0x804D9888 Val_Wu8 30.00 DFES_OneToOne 0.00 30.00 FORMAT "%5.2" EXTENDED_LIMITS 0.00 255.0 /end CHARACTERISTIC
/begin CHARACTERISTIC DFES_Cls.DFC_Clth2ONStuckLdc_C "fault class per DFC / Fault class for check DFC_Clth2ONStuckLdc" VALUE 0x804D9889 Val_Wu8 30.00 DFES_OneToOne 0.00 30.00 FORMAT "%5.2" EXTENDED_LIMITS 0.00 255.0 /end CHARACTERISTIC
/begin CHARACTERISTIC DFES_Cls.DFC_Clth3ONStuckLdc_C "fault class per DFC / Fault class for check DFC_Clth3ONStuckLdc" VALUE 0x804D988A Val_Wu8 30.00 DFES_OneToOne 0.00 30.00 FORMAT "%5.2" EXTENDED_LIMITS 0.00 255.0 /end CHARACTERISTIC
/begin CHARACTERISTIC DFES_Cls.DFC_Clth3ONStuckPostDrv_C "fault class per DFC / Fault class for check DFC_Clth3ONStuckPostDrv" VALUE 0x804D988B Val_Wu8 30.00 DFES_OneToOne 0.00 30.00 FORMAT "%5.2" EXTENDED_LIMITS 0.00 255.0 /end CHARACTERISTIC
/begin CHARACTERISTIC DFES_Cls.DFC_Clth4ONStuck_C "fault class per DFC / Fault class for check DFC_Clth4ONStuck" VALUE 0x804D988C Val_Wu8 30.00 DFES_OneToOne 0.00 30.00 FORMAT "%5.2" EXTENDED_LIMITS 0.00 255.0 /end CHARACTERISTIC
/begin CHARACTERISTIC DFES_Cls.DFC_Clth4ONStuckLdc_C "fault class per DFC / Fault class for check DFC_Clth4ONStuckLdc" VALUE 0x804D988D Val_Wu8 30.00 DFES_OneToOne 0.00 30.00 FORMAT "%5.2" EXTENDED_LIMITS 0.00 255.0 /end CHARACTERISTIC
/begin CHARACTERISTIC DFES_Cls.DFC_ComBCMUnit_C "fault class per DFC / Fault class for check DFC_ComBCMUnit" VALUE 0x804D988E Val_Wu8 30.00 DFES_OneToOne 0.00 30.00 FORMAT "%5.2" EXTENDED_LIMITS 0.00 255.0 /end CHARACTERISTIC
/begin CHARACTERISTIC DFES_Cls.DFC_ComDLCTCU01_C "fault class per DFC / Fault class for check DFC_ComDLCTCU01" VALUE 0x804D988F Val_Wu8 30.00 DFES_OneToOne 0.00 30.00 FORMAT "%5.2" EXTENDED_LIMITS 0.00 255.0 /end CHARACTERISTIC
/begin CHARACTERISTIC DFES_Cls.DFC_ComDLCTCU02_C "fault class per DFC / Fault class for check DFC_ComDLCTCU02" VALUE 0x804D9890 Val_Wu8 30.00 DFES_OneToOne 0.00 30.00 FORMAT "%5.2" EXTENDED_LIMITS 0.00 255.0 /end CHARACTERISTIC
/begin CHARACTERISTIC DFES_Cls.DFC_ComDLCTCU1_C "fault class per DFC / Fault class for check DFC_ComDLCTCU1" VALUE 0x804D9891 Val_Wu8 30.00 DFES_OneToOne 0.00 30.00 FORMAT "%5.2" EXTENDED_LIMITS 0.00 255.0 /end CHARACTERISTIC
/begin CHARACTERISTIC DFES_Cls.DFC_ComDLCTCU11_C "fault class per DFC / Fault class for check DFC_ComDLCTCU11" VALUE 0x804D9892 Val_Wu8 30.00 DFES_OneToOne 0.00 30.00 FORMAT "%5.2" EXTENDED_LIMITS 0.00 255.0 /end CHARACTERISTIC
/begin CHARACTERISTIC DFES_Cls.DFC_ComDLCTCU12_C "fault class per DFC / Fault class for check DFC_ComDLCTCU12" VALUE 0x804D9893 Val_Wu8 30.00 DFES_OneToOne 0.00 30.00 FORMAT "%5.2" EXTENDED_LIMITS 0.00 255.0 /end CHARACTERISTIC
/begin CHARACTERISTIC DFES_Cls.DFC_ComDLCTCU13_C "fault class per DFC / Fault class for check DFC_ComDLCTCU13" VALUE 0x804D9894 Val_Wu8 30.00 DFES_OneToOne 0.00 30.00 FORMAT "%5.2" EXTENDED_LIMITS 0.00 255.0 /end CHARACTERISTIC
/begin CHARACTERISTIC DFES_Cls.DFC_ComDLCTCU14_C "fault class per DFC / Fault class for check DFC_ComDLCTCU14" VALUE 0x804D9895 Val_Wu8 30.00 DFES_OneToOne 0.00 30.00 FORMAT "%5.2" EXTENDED_LIMITS 0.00 255.0 /end CHARACTERISTIC
/begin CHARACTERISTIC DFES_Cls.DFC_ComDLCTCU2_C "fault class per DFC / Fault class for check DFC_ComDLCTCU2" VALUE 0x804D9896 Val_Wu8 30.00 DFES_OneToOne 0.00 30.00 FORMAT "%5.2" EXTENDED_LIMITS 0.00 255.0 /end CHARACTERISTIC
/begin CHARACTERISTIC DFES_Cls.DFC_ComDLCTCU3_C "fault class per DFC / Fault class for check DFC_ComDLCTCU3" VALUE 0x804D9897 Val_Wu8 30.00 DFES_OneToOne 0.00 30.00 FORMAT "%5.2" EXTENDED_LIMITS 0.00 255.0 /end CHARACTERISTIC
/begin CHARACTERISTIC DFES_Cls.DFC_ComDLCTCU4_C "fault class per DFC / Fault class for check DFC_ComDLCTCU4" VALUE 0x804D9898 Val_Wu8 30.00 DFES_OneToOne 0.00 30.00 FORMAT "%5.2" EXTENDED_LIMITS 0.00 255.0 /end CHARACTERISTIC
/begin CHARACTERISTIC DFES_Cls.DFC_ComEPSUnit_C "fault class per DFC / Fault class for check DFC_ComEPSUnit" VALUE 0x804D9899 Val_Wu8 30.00 DFES_OneToOne 0.00 30.00 FORMAT "%5.2" EXTENDED_LIMITS 0.00 255.0 /end CHARACTERISTIC
/begin CHARACTERISTIC DFES_Cls.DFC_ComIDASBUnit_C "fault class per DFC / Fault class for check DFC_ComIDASBUnit" VALUE 0x804D989A Val_Wu8 30.00 DFES_OneToOne 0.00 30.00 FORMAT "%5.2" EXTENDED_LIMITS 0.00 255.0 /end CHARACTERISTIC
/begin CHARACTERISTIC DFES_Cls.DFC_ComIMGUnit_C "fault class per DFC / Fault class for check DFC_ComIMGUnit" VALUE 0x804D989B Val_Wu8 30.00 DFES_OneToOne 0.00 30.00 FORMAT "%5.2" EXTENDED_LIMITS 0.00 255.0 /end CHARACTERISTIC
/begin CHARACTERISTIC DFES_Cls.DFC_ComMETUnit_C "fault class per DFC / Fault class for check DFC_ComMETUnit" VALUE 0x804D989C Val_Wu8 30.00 DFES_OneToOne 0.00 30.00 FORMAT "%5.2" EXTENDED_LIMITS 0.00 255.0 /end CHARACTERISTIC
/begin CHARACTERISTIC DFES_Cls.DFC_ComSRSUnit_C "fault class per DFC / Fault class for check DFC_ComSRSUnit" VALUE 0x804D989D Val_Wu8 30.00 DFES_OneToOne 0.00 30.00 FORMAT "%5.2" EXTENDED_LIMITS 0.00 255.0 /end CHARACTERISTIC
/begin CHARACTERISTIC DFES_Cls.DFC_ComVSAUnit_C "fault class per DFC / Fault class for check DFC_ComVSAUnit" VALUE 0x804D989E Val_Wu8 30.00 DFES_OneToOne 0.00 30.00 FORMAT "%5.2" EXTENDED_LIMITS 0.00 255.0 /end CHARACTERISTIC
/begin CHARACTERISTIC DFES_Cls.DFC_EbsSocFlt_C "fault class per DFC / Fault class for check DFC_EbsSocFlt" VALUE 0x804D989F Val_Wu8 30.00 DFES_OneToOne 0.00 30.00 FORMAT "%5.2" EXTENDED_LIMITS 0.00 255.0 /end CHARACTERISTIC
/begin CHARACTERISTIC DFES_Cls.DFC_I14229VINErr_C "fault class per DFC / Fault class for check DFC_I14229VINErr" VALUE 0x804D98A0 Val_Wu8 30.00 DFES_OneToOne 0.00 30.00 FORMAT "%5.2" EXTENDED_LIMITS 0.00 255.0 /end CHARACTERISTIC
/begin CHARACTERISTIC DFES_Cls.DFC_InjCatHeatgErr_C "fault class per DFC / Fault class for check DFC_InjCatHeatgErr" VALUE 0x804D98A1 Val_Wu8 30.00 DFES_OneToOne 0.00 30.00 FORMAT "%5.2" EXTENDED_LIMITS 0.00 255.0 /end CHARACTERISTIC
/begin CHARACTERISTIC DFES_Cls.DFC_InjSysMulInjDiagErr_C "fault class per DFC / Fault class for check DFC_InjSysMulInjDiagErr" VALUE 0x804D98A2 Val_Wu8 30.00 DFES_OneToOne 0.00 30.00 FORMAT "%5.2" EXTENDED_LIMITS 0.00 255.0 /end CHARACTERISTIC
/begin CHARACTERISTIC DFES_Cls.DFC_LLRHmax_C "fault class per DFC / Fault class for check DFC_LLRHmax" VALUE 0x804D98A3 Val_Wu8 30.00 DFES_OneToOne 0.00 30.00 FORMAT "%5.2" EXTENDED_LIMITS 0.00 255.0 /end CHARACTERISTIC
/begin CHARACTERISTIC DFES_Cls.DFC_LLRHmin_C "fault class per DFC / Fault class for check DFC_LLRHmin" VALUE 0x804D98A4 Val_Wu8 30.00 DFES_OneToOne 0.00 30.00 FORMAT "%5.2" EXTENDED_LIMITS 0.00 255.0 /end CHARACTERISTIC
/begin CHARACTERISTIC DFES_Cls.DFC_LLRHnpl_C "fault class per DFC / Fault class for check DFC_LLRHnpl" VALUE 0x804D98A5 Val_Wu8 30.00 DFES_OneToOne 0.00 30.00 FORMAT "%5.2" EXTENDED_LIMITS 0.00 255.0 /end CHARACTERISTIC
/begin CHARACTERISTIC DFES_Cls.DFC_LLRKHmax_C "fault class per DFC / Fault class for check DFC_LLRKHmax" VALUE 0x804D98A6 Val_Wu8 30.00 DFES_OneToOne 0.00 30.00 FORMAT "%5.2" EXTENDED_LIMITS 0.00 255.0 /end CHARACTERISTIC
/begin CHARACTERISTIC DFES_Cls.DFC_LLRKHmin_C "fault class per DFC / Fault class for check DFC_LLRKHmin" VALUE 0x804D98A7 Val_Wu8 30.00 DFES_OneToOne 0.00 30.00 FORMAT "%5.2" EXTENDED_LIMITS 0.00 255.0 /end CHARACTERISTIC
/begin CHARACTERISTIC DFES_Cls.DFC_LLRKHnpl_C "fault class per DFC / Fault class for check DFC_LLRKHnpl" VALUE 0x804D98A8 Val_Wu8 30.00 DFES_OneToOne 0.00 30.00 FORMAT "%5.2" EXTENDED_LIMITS 0.00 255.0 /end CHARACTERISTIC
/begin CHARACTERISTIC DFES_Cls.DFC_LinACGUnit_C "fault class per DFC / Fault class for check DFC_LinACGUnit" VALUE 0x804D98A9 Val_Wu8 30.00 DFES_OneToOne 0.00 30.00 FORMAT "%5.2" EXTENDED_LIMITS 0.00 255.0 /end CHARACTERISTIC
/begin CHARACTERISTIC DFES_Cls.DFC_LinAEVUnit_C "fault class per DFC / Fault class for check DFC_LinAEVUnit" VALUE 0x804D98AA Val_Wu8 30.00 DFES_OneToOne 0.00 30.00 FORMAT "%5.2" EXTENDED_LIMITS 0.00 255.0 /end CHARACTERISTIC
/begin CHARACTERISTIC DFES_Cls.DFC_LinEBSUnit_C "fault class per DFC / Fault class for check DFC_LinEBSUnit" VALUE 0x804D98AB Val_Wu8 30.00 DFES_OneToOne 0.00 30.00 FORMAT "%5.2" EXTENDED_LIMITS 0.00 255.0 /end CHARACTERISTIC
/begin CHARACTERISTIC DFES_Cls.DFC_RoughRoad_C "fault class per DFC / Fault class for check DFC_RoughRoad" VALUE 0x804D98AC Val_Wu8 30.00 DFES_OneToOne 0.00 30.00 FORMAT "%5.2" EXTENDED_LIMITS 0.00 255.0 /end CHARACTERISTIC
/begin CHARACTERISTIC DFES_Cls.DFC_SiaEEPRdErr_C "fault class per DFC / Fault class for check DFC_SiaEEPRdErr" VALUE 0x804D98AD Val_Wu8 30.00 DFES_OneToOne 0.00 30.00 FORMAT "%5.2" EXTENDED_LIMITS 0.00 255.0 /end CHARACTERISTIC
/begin CHARACTERISTIC DFES_Cls.DFC_SiaEEPWrngCod_C "fault class per DFC / Fault class for check DFC_SiaEEPWrngCod" VALUE 0x804D98AE Val_Wu8 30.00 DFES_OneToOne 0.00 30.00 FORMAT "%5.2" EXTENDED_LIMITS 0.00 255.0 /end CHARACTERISTIC
/begin CHARACTERISTIC DFES_Cls.DFC_UegoHeatrStrtS1B1_C "fault class per DFC / Fault class for check DFC_UegoHeatrStrtS1B1" VALUE 0x804D98AF Val_Wu8 30.00 DFES_OneToOne 0.00 30.00 FORMAT "%5.2" EXTENDED_LIMITS 0.00 255.0 /end CHARACTERISTIC
/begin CHARACTERISTIC DFES_Cls.DFC_BusDiagCANAPPLBusOff_C "fault class per DFC / Fault class for check DFC_BusDiagCANAPPLBusOff" VALUE 0x804D98B0 Val_Wu8 30.00 DFES_OneToOne 0.00 30.00 FORMAT "%5.2" EXTENDED_LIMITS 0.00 255.0 /end CHARACTERISTIC
/begin CHARACTERISTIC DFES_Cls.DFC_BusDiagCANCANCBusOff_C "fault class per DFC / Fault class for check DFC_BusDiagCANCANCBusOff" VALUE 0x804D98B1 Val_Wu8 30.00 DFES_OneToOne 0.00 30.00 FORMAT "%5.2" EXTENDED_LIMITS 0.00 255.0 /end CHARACTERISTIC
/begin CHARACTERISTIC DFES_Cls.DFC_BusDiagCANVEHICLEBusOff_C "fault class per DFC / Fault class for check DFC_BusDiagCANVEHICLEBusOff" VALUE 0x804D98B2 Val_Wu8 30.00 DFES_OneToOne 0.00 30.00 FORMAT "%5.2" EXTENDED_LIMITS 0.00 255.0 /end CHARACTERISTIC
/begin CHARACTERISTIC DFES_Cls.DFC_RBA_IODIAGPWR_rba_IoExtCy329_SignalVltSply_0_C "fault class per DFC / Fault class for check DFC_RBA_IODIAGPWR_rba_IoExtCy329_SignalVltSply_0" VALUE 0x804D98B3 Val_Wu8 30.00 DFES_OneToOne 0.00 30.00 FORMAT "%5.2" EXTENDED_LIMITS 0.00 255.0 /end CHARACTERISTIC
/begin CHARACTERISTIC DFES_Cls.DFC_RBA_IODIAGPWR_rba_IoExtCy329_SignalVltSply_0OT_C "fault class per DFC / Fault class for check DFC_RBA_IODIAGPWR_rba_IoExtCy329_SignalVltSply_0OT" VALUE 0x804D98B4 Val_Wu8 30.00 DFES_OneToOne 0.00 30.00 FORMAT "%5.2" EXTENDED_LIMITS 0.00 255.0 /end CHARACTERISTIC
/begin CHARACTERISTIC DFES_Cls.DFC_RBA_IODIAGPWR_rba_IoExtCy329_SignalVltSply_0OV_C "fault class per DFC / Fault class for check DFC_RBA_IODIAGPWR_rba_IoExtCy329_SignalVltSply_0OV" VALUE 0x804D98B5 Val_Wu8 30.00 DFES_OneToOne 0.00 30.00 FORMAT "%5.2" EXTENDED_LIMITS 0.00 255.0 /end CHARACTERISTIC
/begin CHARACTERISTIC DFES_Cls.DFC_RBA_IODIAGPWR_rba_IoExtCy329_SignalVltSply_0SCG_C "fault class per DFC / Fault class for check DFC_RBA_IODIAGPWR_rba_IoExtCy329_SignalVltSply_0SCG" VALUE 0x804D98B6 Val_Wu8 30.00 DFES_OneToOne 0.00 30.00 FORMAT "%5.2" EXTENDED_LIMITS 0.00 255.0 /end CHARACTERISTIC
/begin CHARACTERISTIC DFES_Cls.DFC_RBA_IODIAGPWR_rba_IoExtCy329_SignalVltSply_0UV_C "fault class per DFC / Fault class for check DFC_RBA_IODIAGPWR_rba_IoExtCy329_SignalVltSply_0UV" VALUE 0x804D98B7 Val_Wu8 30.00 DFES_OneToOne 0.00 30.00 FORMAT "%5.2" EXTENDED_LIMITS 0.00 255.0 /end CHARACTERISTIC
/begin CHARACTERISTIC DFES_Cls.DFC_RBA_IODIAGPWR_rba_IoExtCy329_SignalVltSply_1_C "fault class per DFC / Fault class for check DFC_RBA_IODIAGPWR_rba_IoExtCy329_SignalVltSply_1" VALUE 0x804D98B8 Val_Wu8 30.00 DFES_OneToOne 0.00 30.00 FORMAT "%5.2" EXTENDED_LIMITS 0.00 255.0 /end CHARACTERISTIC
/begin CHARACTERISTIC DFES_Cls.DFC_RBA_IODIAGPWR_rba_IoExtCy329_SignalVltSply_1OT_C "fault class per DFC / Fault class for check DFC_RBA_IODIAGPWR_rba_IoExtCy329_SignalVltSply_1OT" VALUE 0x804D98B9 Val_Wu8 30.00 DFES_OneToOne 0.00 30.00 FORMAT "%5.2" EXTENDED_LIMITS 0.00 255.0 /end CHARACTERISTIC
/begin CHARACTERISTIC DFES_Cls.DFC_RBA_IODIAGPWR_rba_IoExtCy329_SignalVltSply_1OV_C "fault class per DFC / Fault class for check DFC_RBA_IODIAGPWR_rba_IoExtCy329_SignalVltSply_1OV" VALUE 0x804D98BA Val_Wu8 30.00 DFES_OneToOne 0.00 30.00 FORMAT "%5.2" EXTENDED_LIMITS 0.00 255.0 /end CHARACTERISTIC
/begin CHARACTERISTIC DFES_Cls.DFC_RBA_IODIAGPWR_rba_IoExtCy329_SignalVltSply_1SCG_C "fault class per DFC / Fault class for check DFC_RBA_IODIAGPWR_rba_IoExtCy329_SignalVltSply_1SCG" VALUE 0x804D98BB Val_Wu8 30.00 DFES_OneToOne 0.00 30.00 FORMAT "%5.2" EXTENDED_LIMITS 0.00 255.0 /end CHARACTERISTIC
/begin CHARACTERISTIC DFES_Cls.DFC_RBA_IODIAGPWR_rba_IoExtCy329_SignalVltSply_1UV_C "fault class per DFC / Fault class for check DFC_RBA_IODIAGPWR_rba_IoExtCy329_SignalVltSply_1UV" VALUE 0x804D98BC Val_Wu8 30.00 DFES_OneToOne 0.00 30.00 FORMAT "%5.2" EXTENDED_LIMITS 0.00 255.0 /end CHARACTERISTIC
/begin CHARACTERISTIC DFES_Cls.DFC_RBA_IODIAGPWR_rba_IoExtCy329_SignalVltSply_2_C "fault class per DFC / Fault class for check DFC_RBA_IODIAGPWR_rba_IoExtCy329_SignalVltSply_2" VALUE 0x804D98BD Val_Wu8 30.00 DFES_OneToOne 0.00 30.00 FORMAT "%5.2" EXTENDED_LIMITS 0.00 255.0 /end CHARACTERISTIC
/begin CHARACTERISTIC DFES_Cls.DFC_RBA_IODIAGPWR_rba_IoExtCy329_SignalVltSply_2OT_C "fault class per DFC / Fault class for check DFC_RBA_IODIAGPWR_rba_IoExtCy329_SignalVltSply_2OT" VALUE 0x804D98BE Val_Wu8 30.00 DFES_OneToOne 0.00 30.00 FORMAT "%5.2" EXTENDED_LIMITS 0.00 255.0 /end CHARACTERISTIC
/begin CHARACTERISTIC DFES_Cls.DFC_RBA_IODIAGPWR_rba_IoExtCy329_SignalVltSply_2OV_C "fault class per DFC / Fault class for check DFC_RBA_IODIAGPWR_rba_IoExtCy329_SignalVltSply_2OV" VALUE 0x804D98BF Val_Wu8 30.00 DFES_OneToOne 0.00 30.00 FORMAT "%5.2" EXTENDED_LIMITS 0.00 255.0 /end CHARACTERISTIC
/begin CHARACTERISTIC DFES_Cls.DFC_RBA_IODIAGPWR_rba_IoExtCy329_SignalVltSply_2SCG_C "fault class per DFC / Fault class for check DFC_RBA_IODIAGPWR_rba_IoExtCy329_SignalVltSply_2SCG" VALUE 0x804D98C0 Val_Wu8 30.00 DFES_OneToOne 0.00 30.00 FORMAT "%5.2" EXTENDED_LIMITS 0.00 255.0 /end CHARACTERISTIC
/begin CHARACTERISTIC DFES_Cls.DFC_RBA_IODIAGPWR_rba_IoExtCy329_SignalVltSply_2UV_C "fault class per DFC / Fault class for check DFC_RBA_IODIAGPWR_rba_IoExtCy329_SignalVltSply_2UV" VALUE 0x804D98C1 Val_Wu8 30.00 DFES_OneToOne 0.00 30.00 FORMAT "%5.2" EXTENDED_LIMITS 0.00 255.0 /end CHARACTERISTIC
/begin CHARACTERISTIC DFES_Cls.DFC_CAN_E_TIMEOUT_C "fault class per DFC / Fault class for check DFC_CAN_E_TIMEOUT" VALUE 0x804D98C2 Val_Wu8 30.00 DFES_OneToOne 0.00 30.00 FORMAT "%5.2" EXTENDED_LIMITS 0.00 255.0 /end CHARACTERISTIC
/begin CHARACTERISTIC DFES_Cls.DFC_LIN_E_TIMEOUT_C "fault class per DFC / Fault class for check DFC_LIN_E_TIMEOUT" VALUE 0x804D98C3 Val_Wu8 30.00 DFES_OneToOne 0.00 30.00 FORMAT "%5.2" EXTENDED_LIMITS 0.00 255.0 /end CHARACTERISTIC
/begin CHARACTERISTIC DFES_Cls.DFC_MRlyOL_C "fault class per DFC / Fault class for check DFC_MRlyOL" VALUE 0x804D98C4 Val_Wu8 30.00 DFES_OneToOne 0.00 30.00 FORMAT "%5.2" EXTENDED_LIMITS 0.00 255.0 /end CHARACTERISTIC
/begin CHARACTERISTIC DFES_Cls.DFC_MRlySCB_C "fault class per DFC / Fault class for check DFC_MRlySCB" VALUE 0x804D98C5 Val_Wu8 30.00 DFES_OneToOne 0.00 30.00 FORMAT "%5.2" EXTENDED_LIMITS 0.00 255.0 /end CHARACTERISTIC
/begin CHARACTERISTIC DFES_Cls.DFC_MRlySCG_C "fault class per DFC / Fault class for check DFC_MRlySCG" VALUE 0x804D98C6 Val_Wu8 30.00 DFES_OneToOne 0.00 30.00 FORMAT "%5.2" EXTENDED_LIMITS 0.00 255.0 /end CHARACTERISTIC
/begin CHARACTERISTIC DFES_Cls.DFC_rba_MultiStackTrace_Threshold_C "fault class per DFC / Fault class for check DFC_rba_MultiStackTrace_Threshold" VALUE 0x804D98C7 Val_Wu8 30.00 DFES_OneToOne 0.00 30.00 FORMAT "%5.2" EXTENDED_LIMITS 0.00 255.0 /end CHARACTERISTIC
/begin CHARACTERISTIC DFES_Cls.DFC_BSWM_E_ACTION_FAILED_C "fault class per DFC / Fault class for check DFC_BSWM_E_ACTION_FAILED" VALUE 0x804D98C8 Val_Wu8 30.00 DFES_OneToOne 0.00 30.00 FORMAT "%5.2" EXTENDED_LIMITS 0.00 255.0 /end CHARACTERISTIC
/begin CHARACTERISTIC DFES_Cls.DFC_BSWM_E_INTRPTQUEUE_FULL_C "fault class per DFC / Fault class for check DFC_BSWM_E_INTRPTQUEUE_FULL" VALUE 0x804D98C9 Val_Wu8 30.00 DFES_OneToOne 0.00 30.00 FORMAT "%5.2" EXTENDED_LIMITS 0.00 255.0 /end CHARACTERISTIC
/begin CHARACTERISTIC DFES_Cls.DFC_RBA_IOEXTLIB_KEEPALIVE_DRV_C "fault class per DFC / Fault class for check DFC_RBA_IOEXTLIB_KEEPALIVE_DRV" VALUE 0x804D98CA Val_Wu8 30.00 DFES_OneToOne 0.00 30.00 FORMAT "%5.2" EXTENDED_LIMITS 0.00 255.0 /end CHARACTERISTIC
/begin CHARACTERISTIC DFES_Cls.DFC_RBA_IOEXTLIB_KEEPALIVE_INI_C "fault class per DFC / Fault class for check DFC_RBA_IOEXTLIB_KEEPALIVE_INI" VALUE 0x804D98CB Val_Wu8 30.00 DFES_OneToOne 0.00 30.00 FORMAT "%5.2" EXTENDED_LIMITS 0.00 255.0 /end CHARACTERISTIC
/begin CHARACTERISTIC DFES_Cls.DFC_rba_IoSigRtc_StopCounter_C "fault class per DFC / Fault class for check DFC_rba_IoSigRtc_StopCounter" VALUE 0x804D98CC Val_Wu8 30.00 DFES_OneToOne 0.00 30.00 FORMAT "%5.2" EXTENDED_LIMITS 0.00 255.0 /end CHARACTERISTIC
/begin CHARACTERISTIC DFES_Cls.DFC_rba_MRly_Diag_Stk_Event_C "fault class per DFC / Fault class for check DFC_rba_MRly_Diag_Stk_Event" VALUE 0x804D98CD Val_Wu8 30.00 DFES_OneToOne 0.00 30.00 FORMAT "%5.2" EXTENDED_LIMITS 0.00 255.0 /end CHARACTERISTIC
/begin CHARACTERISTIC DFES_Cls.DFC_rba_MemDiag_MemReadErr_C "fault class per DFC / Fault class for check DFC_rba_MemDiag_MemReadErr" VALUE 0x804D98CE Val_Wu8 30.00 DFES_OneToOne 0.00 30.00 FORMAT "%5.2" EXTENDED_LIMITS 0.00 255.0 /end CHARACTERISTIC
/begin CHARACTERISTIC DFES_Cls.DFC_rba_MemDiag_MemWrErr_C "fault class per DFC / Fault class for check DFC_rba_MemDiag_MemWrErr" VALUE 0x804D98CF Val_Wu8 30.00 DFES_OneToOne 0.00 30.00 FORMAT "%5.2" EXTENDED_LIMITS 0.00 255.0 /end CHARACTERISTIC
/begin CHARACTERISTIC DFES_Cls.DFC_rba_SyC_IrrSwOffTrigEngRun_Event_C "fault class per DFC / Fault class for check DFC_rba_SyC_IrrSwOffTrigEngRun_Event" VALUE 0x804D98D0 Val_Wu8 30.00 DFES_OneToOne 0.00 30.00 FORMAT "%5.2" EXTENDED_LIMITS 0.00 255.0 /end CHARACTERISTIC
/begin CHARACTERISTIC DFES_Cls.DFC_rba_T15_Diag_ComInVld_Event_C "fault class per DFC / Fault class for check DFC_rba_T15_Diag_ComInVld_Event" VALUE 0x804D98D1 Val_Wu8 30.00 DFES_OneToOne 0.00 30.00 FORMAT "%5.2" EXTENDED_LIMITS 0.00 255.0 /end CHARACTERISTIC
/begin CHARACTERISTIC DFES_Cls.DFC_rba_T15_Diag_ComOff_HwOn_Event_C "fault class per DFC / Fault class for check DFC_rba_T15_Diag_ComOff_HwOn_Event" VALUE 0x804D98D2 Val_Wu8 30.00 DFES_OneToOne 0.00 30.00 FORMAT "%5.2" EXTENDED_LIMITS 0.00 255.0 /end CHARACTERISTIC
/begin CHARACTERISTIC DFES_Cls.DFC_rba_T15_Diag_ComOn_HwOff_Event_C "fault class per DFC / Fault class for check DFC_rba_T15_Diag_ComOn_HwOff_Event" VALUE 0x804D98D3 Val_Wu8 30.00 DFES_OneToOne 0.00 30.00 FORMAT "%5.2" EXTENDED_LIMITS 0.00 255.0 /end CHARACTERISTIC
/begin CHARACTERISTIC DFES_Cls.DFC_AAVmin_C "fault class per DFC / Fault class for check DFC_AAVmin" VALUE 0x804D98D4 Val_Wu8 30.00 DFES_OneToOne 0.00 30.00 FORMAT "%5.2" EXTENDED_LIMITS 0.00 255.0 /end CHARACTERISTIC
/begin CHARACTERISTIC DFES_Cls.DFC_AGRSUS_C "fault class per DFC / Fault class for check DFC_AGRSUS" VALUE 0x804D98D5 Val_Wu8 30.00 DFES_OneToOne 0.00 30.00 FORMAT "%5.2" EXTENDED_LIMITS 0.00 255.0 /end CHARACTERISTIC
/begin CHARACTERISTIC DFES_Cls.DFC_AfsPlausDiagHi_C "fault class per DFC / Fault class for check DFC_AfsPlausDiagHi" VALUE 0x804D98D6 Val_Wu8 30.00 DFES_OneToOne 0.00 30.00 FORMAT "%5.2" EXTENDED_LIMITS 0.00 255.0 /end CHARACTERISTIC
/begin CHARACTERISTIC DFES_Cls.DFC_AfsPlausDiagLo_C "fault class per DFC / Fault class for check DFC_AfsPlausDiagLo" VALUE 0x804D98D7 Val_Wu8 30.00 DFES_OneToOne 0.00 30.00 FORMAT "%5.2" EXTENDED_LIMITS 0.00 255.0 /end CHARACTERISTIC
/begin CHARACTERISTIC DFES_Cls.DFC_AfsVrntDiagErrB1_C "fault class per DFC / Fault class for check DFC_AfsVrntDiagErrB1" VALUE 0x804D98D8 Val_Wu8 30.00 DFES_OneToOne 0.00 30.00 FORMAT "%5.2" EXTENDED_LIMITS 0.00 255.0 /end CHARACTERISTIC
/begin CHARACTERISTIC DFES_Cls.DFC_AppAllSnsrDfct_C "fault class per DFC / Fault class for check DFC_AppAllSnsrDfct" VALUE 0x804D98D9 Val_Wu8 30.00 DFES_OneToOne 0.00 30.00 FORMAT "%5.2" EXTENDED_LIMITS 0.00 255.0 /end CHARACTERISTIC
/begin CHARACTERISTIC DFES_Cls.DFC_BBKRnldg_C "fault class per DFC / Fault class for check DFC_BBKRnldg" VALUE 0x804D98DA Val_Wu8 30.00 DFES_OneToOne 0.00 30.00 FORMAT "%5.2" EXTENDED_LIMITS 0.00 255.0 /end CHARACTERISTIC
/begin CHARACTERISTIC DFES_Cls.DFC_BBKRsyne_C "fault class per DFC / Fault class for check DFC_BBKRsyne" VALUE 0x804D98DB Val_Wu8 30.00 DFES_OneToOne 0.00 30.00 FORMAT "%5.2" EXTENDED_LIMITS 0.00 255.0 /end CHARACTERISTIC
/begin CHARACTERISTIC DFES_Cls.DFC_BattUStdbyDiaOL_C "fault class per DFC / Fault class for check DFC_BattUStdbyDiaOL" VALUE 0x804D98DC Val_Wu8 30.00 DFES_OneToOne 0.00 30.00 FORMAT "%5.2" EXTENDED_LIMITS 0.00 255.0 /end CHARACTERISTIC
/begin CHARACTERISTIC DFES_Cls.DFC_BigLeakIntkMnfldEmiInfl_C "fault class per DFC / Fault class for check DFC_BigLeakIntkMnfldEmiInfl" VALUE 0x804D98DD Val_Wu8 30.00 DFES_OneToOne 0.00 30.00 FORMAT "%5.2" EXTENDED_LIMITS 0.00 255.0 /end CHARACTERISTIC
/begin CHARACTERISTIC DFES_Cls.DFC_BlkdLineTank_C "fault class per DFC / Fault class for check DFC_BlkdLineTank" VALUE 0x804D98DE Val_Wu8 30.00 DFES_OneToOne 0.00 30.00 FORMAT "%5.2" EXTENDED_LIMITS 0.00 255.0 /end CHARACTERISTIC
/begin CHARACTERISTIC DFES_Cls.DFC_BrkMnSwtContOnWarnLmp_C "fault class per DFC / Fault class for check DFC_BrkMnSwtContOnWarnLmp" VALUE 0x804D98DF Val_Wu8 30.00 DFES_OneToOne 0.00 30.00 FORMAT "%5.2" EXTENDED_LIMITS 0.00 255.0 /end CHARACTERISTIC
/begin CHARACTERISTIC DFES_Cls.DFC_BrkMnSwtNotStpWarnLmp_C "fault class per DFC / Fault class for check DFC_BrkMnSwtNotStpWarnLmp" VALUE 0x804D98E0 Val_Wu8 30.00 DFES_OneToOne 0.00 30.00 FORMAT "%5.2" EXTENDED_LIMITS 0.00 255.0 /end CHARACTERISTIC
/begin CHARACTERISTIC DFES_Cls.DFC_BrkRdntSwtContOnWarnLmp_C "fault class per DFC / Fault class for check DFC_BrkRdntSwtContOnWarnLmp" VALUE 0x804D98E1 Val_Wu8 30.00 DFES_OneToOne 0.00 30.00 FORMAT "%5.2" EXTENDED_LIMITS 0.00 255.0 /end CHARACTERISTIC
/begin CHARACTERISTIC DFES_Cls.DFC_BrkRdntSwtNotStpWarnLmp_C "fault class per DFC / Fault class for check DFC_BrkRdntSwtNotStpWarnLmp" VALUE 0x804D98E2 Val_Wu8 30.00 DFES_OneToOne 0.00 30.00 FORMAT "%5.2" EXTENDED_LIMITS 0.00 255.0 /end CHARACTERISTIC
/begin CHARACTERISTIC DFES_Cls.DFC_CEngDsTColdStrtMax_C "fault class per DFC / Fault class for check DFC_CEngDsTColdStrtMax" VALUE 0x804D98E3 Val_Wu8 30.00 DFES_OneToOne 0.00 30.00 FORMAT "%5.2" EXTENDED_LIMITS 0.00 255.0 /end CHARACTERISTIC
/begin CHARACTERISTIC DFES_Cls.DFC_CEngDsTColdStrtMin_C "fault class per DFC / Fault class for check DFC_CEngDsTColdStrtMin" VALUE 0x804D98E4 Val_Wu8 30.00 DFES_OneToOne 0.00 30.00 FORMAT "%5.2" EXTENDED_LIMITS 0.00 255.0 /end CHARACTERISTIC
/begin CHARACTERISTIC DFES_Cls.DFC_CEngDsTImps_C "fault class per DFC / Fault class for check DFC_CEngDsTImps" VALUE 0x804D98E5 Val_Wu8 30.00 DFES_OneToOne 0.00 30.00 FORMAT "%5.2" EXTENDED_LIMITS 0.00 255.0 /end CHARACTERISTIC
/begin CHARACTERISTIC DFES_Cls.DFC_CEngDsTPlausHSC_C "fault class per DFC / Fault class for check DFC_CEngDsTPlausHSC" VALUE 0x804D98E6 Val_Wu8 30.00 DFES_OneToOne 0.00 30.00 FORMAT "%5.2" EXTENDED_LIMITS 0.00 255.0 /end CHARACTERISTIC
/begin CHARACTERISTIC DFES_Cls.DFC_CEngDsTPlausLSC_C "fault class per DFC / Fault class for check DFC_CEngDsTPlausLSC" VALUE 0x804D98E7 Val_Wu8 30.00 DFES_OneToOne 0.00 30.00 FORMAT "%5.2" EXTENDED_LIMITS 0.00 255.0 /end CHARACTERISTIC
/begin CHARACTERISTIC DFES_Cls.DFC_CEngDsTPlausSTC_C "fault class per DFC / Fault class for check DFC_CEngDsTPlausSTC" VALUE 0x804D98E8 Val_Wu8 30.00 DFES_OneToOne 0.00 30.00 FORMAT "%5.2" EXTENDED_LIMITS 0.00 255.0 /end CHARACTERISTIC
/begin CHARACTERISTIC DFES_Cls.DFC_CEngDsTSRCMax_C "fault class per DFC / Fault class for check DFC_CEngDsTSRCMax" VALUE 0x804D98E9 Val_Wu8 30.00 DFES_OneToOne 0.00 30.00 FORMAT "%5.2" EXTENDED_LIMITS 0.00 255.0 /end CHARACTERISTIC
/begin CHARACTERISTIC DFES_Cls.DFC_CEngDsTSRCMin_C "fault class per DFC / Fault class for check DFC_CEngDsTSRCMin" VALUE 0x804D98EA Val_Wu8 30.00 DFES_OneToOne 0.00 30.00 FORMAT "%5.2" EXTENDED_LIMITS 0.00 255.0 /end CHARACTERISTIC
/begin CHARACTERISTIC DFES_Cls.DFC_CEngDsTSig_C "fault class per DFC / Fault class for check DFC_CEngDsTSig" VALUE 0x804D98EB Val_Wu8 30.00 DFES_OneToOne 0.00 30.00 FORMAT "%5.2" EXTENDED_LIMITS 0.00 255.0 /end CHARACTERISTIC
/begin CHARACTERISTIC DFES_Cls.DFC_CEngUsTColdStrtMax_C "fault class per DFC / Fault class for check DFC_CEngUsTColdStrtMax" VALUE 0x804D98EC Val_Wu8 30.00 DFES_OneToOne 0.00 30.00 FORMAT "%5.2" EXTENDED_LIMITS 0.00 255.0 /end CHARACTERISTIC
/begin CHARACTERISTIC DFES_Cls.DFC_CEngUsTColdStrtMin_C "fault class per DFC / Fault class for check DFC_CEngUsTColdStrtMin" VALUE 0x804D98ED Val_Wu8 30.00 DFES_OneToOne 0.00 30.00 FORMAT "%5.2" EXTENDED_LIMITS 0.00 255.0 /end CHARACTERISTIC
/begin CHARACTERISTIC DFES_Cls.DFC_CEngUsTLooseCnctn_C "fault class per DFC / Fault class for check DFC_CEngUsTLooseCnctn" VALUE 0x804D98EE Val_Wu8 30.00 DFES_OneToOne 0.00 30.00 FORMAT "%5.2" EXTENDED_LIMITS 0.00 255.0 /end CHARACTERISTIC
/begin CHARACTERISTIC DFES_Cls.DFC_CEngUsTSRCMax_C "fault class per DFC / Fault class for check DFC_CEngUsTSRCMax" VALUE 0x804D98EF Val_Wu8 30.00 DFES_OneToOne 0.00 30.00 FORMAT "%5.2" EXTENDED_LIMITS 0.00 255.0 /end CHARACTERISTIC
/begin CHARACTERISTIC DFES_Cls.DFC_CEngUsTSRCMin_C "fault class per DFC / Fault class for check DFC_CEngUsTSRCMin" VALUE 0x804D98F0 Val_Wu8 30.00 DFES_OneToOne 0.00 30.00 FORMAT "%5.2" EXTENDED_LIMITS 0.00 255.0 /end CHARACTERISTIC
/begin CHARACTERISTIC DFES_Cls.DFC_ComDCDCACCFailr_C "fault class per DFC / Fault class for check DFC_ComDCDCACCFailr" VALUE 0x804D98F1 Val_Wu8 30.00 DFES_OneToOne 0.00 30.00 FORMAT "%5.2" EXTENDED_LIMITS 0.00 255.0 /end CHARACTERISTIC
/begin CHARACTERISTIC DFES_Cls.DFC_DCDCFltDet_C "fault class per DFC / Fault class for check DFC_DCDCFltDet" VALUE 0x804D98F2 Val_Wu8 30.00 DFES_OneToOne 0.00 30.00 FORMAT "%5.2" EXTENDED_LIMITS 0.00 255.0 /end CHARACTERISTIC
/begin CHARACTERISTIC DFES_Cls.DFC_DKRSA_C "fault class per DFC / Fault class for check DFC_DKRSA" VALUE 0x804D98F3 Val_Wu8 30.00 DFES_OneToOne 0.00 30.00 FORMAT "%5.2" EXTENDED_LIMITS 0.00 255.0 /end CHARACTERISTIC
/begin CHARACTERISTIC DFES_Cls.DFC_DKVSmax_C "fault class per DFC / Fault class for check DFC_DKVSmax" VALUE 0x804D98F4 Val_Wu8 30.00 DFES_OneToOne 0.00 30.00 FORMAT "%5.2" EXTENDED_LIMITS 0.00 255.0 /end CHARACTERISTIC
/begin CHARACTERISTIC DFES_Cls.DFC_DKnpl_C "fault class per DFC / Fault class for check DFC_DKnpl" VALUE 0x804D98F5 Val_Wu8 30.00 DFES_OneToOne 0.00 30.00 FORMAT "%5.2" EXTENDED_LIMITS 0.00 255.0 /end CHARACTERISTIC
/begin CHARACTERISTIC DFES_Cls.DFC_DSKVRmax_C "fault class per DFC / Fault class for check DFC_DSKVRmax" VALUE 0x804D98F6 Val_Wu8 30.00 DFES_OneToOne 0.00 30.00 FORMAT "%5.2" EXTENDED_LIMITS 0.00 255.0 /end CHARACTERISTIC
/begin CHARACTERISTIC DFES_Cls.DFC_DSKVRmin_C "fault class per DFC / Fault class for check DFC_DSKVRmin" VALUE 0x804D98F7 Val_Wu8 30.00 DFES_OneToOne 0.00 30.00 FORMAT "%5.2" EXTENDED_LIMITS 0.00 255.0 /end CHARACTERISTIC
/begin CHARACTERISTIC DFES_Cls.DFC_DSKVRnpl_C "fault class per DFC / Fault class for check DFC_DSKVRnpl" VALUE 0x804D98F8 Val_Wu8 30.00 DFES_OneToOne 0.00 30.00 FORMAT "%5.2" EXTENDED_LIMITS 0.00 255.0 /end CHARACTERISTIC
/begin CHARACTERISTIC DFES_Cls.DFC_DSKVRsig_C "fault class per DFC / Fault class for check DFC_DSKVRsig" VALUE 0x804D98F9 Val_Wu8 30.00 DFES_OneToOne 0.00 30.00 FORMAT "%5.2" EXTENDED_LIMITS 0.00 255.0 /end CHARACTERISTIC
/begin CHARACTERISTIC DFES_Cls.DFC_DSKVSsig_C "fault class per DFC / Fault class for check DFC_DSKVSsig" VALUE 0x804D98FA Val_Wu8 30.00 DFES_OneToOne 0.00 30.00 FORMAT "%5.2" EXTENDED_LIMITS 0.00 255.0 /end CHARACTERISTIC
/begin CHARACTERISTIC DFES_Cls.DFC_DSSmax_C "fault class per DFC / Fault class for check DFC_DSSmax" VALUE 0x804D98FB Val_Wu8 30.00 DFES_OneToOne 0.00 30.00 FORMAT "%5.2" EXTENDED_LIMITS 0.00 255.0 /end CHARACTERISTIC
/begin CHARACTERISTIC DFES_Cls.DFC_DSTDmax_C "fault class per DFC / Fault class for check DFC_DSTDmax" VALUE 0x804D98FC Val_Wu8 30.00 DFES_OneToOne 0.00 30.00 FORMAT "%5.2" EXTENDED_LIMITS 0.00 255.0 /end CHARACTERISTIC
/begin CHARACTERISTIC DFES_Cls.DFC_DSTEmax_C "fault class per DFC / Fault class for check DFC_DSTEmax" VALUE 0x804D98FD Val_Wu8 30.00 DFES_OneToOne 0.00 30.00 FORMAT "%5.2" EXTENDED_LIMITS 0.00 255.0 /end CHARACTERISTIC
/begin CHARACTERISTIC DFES_Cls.DFC_DSTEmin_C "fault class per DFC / Fault class for check DFC_DSTEmin" VALUE 0x804D98FE Val_Wu8 30.00 DFES_OneToOne 0.00 30.00 FORMAT "%5.2" EXTENDED_LIMITS 0.00 255.0 /end CHARACTERISTIC
/begin CHARACTERISTIC DFES_Cls.DFC_DSTOFmax_C "fault class per DFC / Fault class for check DFC_DSTOFmax" VALUE 0x804D98FF Val_Wu8 30.00 DFES_OneToOne 0.00 30.00 FORMAT "%5.2" EXTENDED_LIMITS 0.00 255.0 /end CHARACTERISTIC
/begin CHARACTERISTIC DFES_Cls.DFC_DSTRmax_C "fault class per DFC / Fault class for check DFC_DSTRmax" VALUE 0x804D9900 Val_Wu8 30.00 DFES_OneToOne 0.00 30.00 FORMAT "%5.2" EXTENDED_LIMITS 0.00 255.0 /end CHARACTERISTIC
/begin CHARACTERISTIC DFES_Cls.DFC_DSTRmin_C "fault class per DFC / Fault class for check DFC_DSTRmin" VALUE 0x804D9901 Val_Wu8 30.00 DFES_OneToOne 0.00 30.00 FORMAT "%5.2" EXTENDED_LIMITS 0.00 255.0 /end CHARACTERISTIC
/begin CHARACTERISTIC DFES_Cls.DFC_DSTRnpl_C "fault class per DFC / Fault class for check DFC_DSTRnpl" VALUE 0x804D9902 Val_Wu8 30.00 DFES_OneToOne 0.00 30.00 FORMAT "%5.2" EXTENDED_LIMITS 0.00 255.0 /end CHARACTERISTIC
/begin CHARACTERISTIC DFES_Cls.DFC_DSTRsig_C "fault class per DFC / Fault class for check DFC_DSTRsig" VALUE 0x804D9903 Val_Wu8 30.00 DFES_OneToOne 0.00 30.00 FORMAT "%5.2" EXTENDED_LIMITS 0.00 255.0 /end CHARACTERISTIC
/begin CHARACTERISTIC DFES_Cls.DFC_DSTTI_C "fault class per DFC / Fault class for check DFC_DSTTI" VALUE 0x804D9904 Val_Wu8 30.00 DFES_OneToOne 0.00 30.00 FORMAT "%5.2" EXTENDED_LIMITS 0.00 255.0 /end CHARACTERISTIC
/begin CHARACTERISTIC DFES_Cls.DFC_DSUmax_C "fault class per DFC / Fault class for check DFC_DSUmax" VALUE 0x804D9905 Val_Wu8 30.00 DFES_OneToOne 0.00 30.00 FORMAT "%5.2" EXTENDED_LIMITS 0.00 255.0 /end CHARACTERISTIC
/begin CHARACTERISTIC DFES_Cls.DFC_DiagCpv1DteskLoLoadStuckClsd_C "fault class per DFC / Fault class for check DFC_DiagCpv1DteskLoLoadStuckClsd" VALUE 0x804D9906 Val_Wu8 30.00 DFES_OneToOne 0.00 30.00 FORMAT "%5.2" EXTENDED_LIMITS 0.00 255.0 /end CHARACTERISTIC
/begin CHARACTERISTIC DFES_Cls.DFC_DiagCpv1DteskLoLoadStuckOpen_C "fault class per DFC / Fault class for check DFC_DiagCpv1DteskLoLoadStuckOpen" VALUE 0x804D9907 Val_Wu8 30.00 DFES_OneToOne 0.00 30.00 FORMAT "%5.2" EXTENDED_LIMITS 0.00 255.0 /end CHARACTERISTIC
/begin CHARACTERISTIC DFES_Cls.DFC_EGRVlvDrftClsd_C "fault class per DFC / Fault class for check DFC_EGRVlvDrftClsd" VALUE 0x804D9908 Val_Wu8 30.00 DFES_OneToOne 0.00 30.00 FORMAT "%5.2" EXTENDED_LIMITS 0.00 255.0 /end CHARACTERISTIC
/begin CHARACTERISTIC DFES_Cls.DFC_EGRVlvDrftOpn_C "fault class per DFC / Fault class for check DFC_EGRVlvDrftOpn" VALUE 0x804D9909 Val_Wu8 30.00 DFES_OneToOne 0.00 30.00 FORMAT "%5.2" EXTENDED_LIMITS 0.00 255.0 /end CHARACTERISTIC
/begin CHARACTERISTIC DFES_Cls.DFC_EGRVlvJamVlvClsd_C "fault class per DFC / Fault class for check DFC_EGRVlvJamVlvClsd" VALUE 0x804D990A Val_Wu8 30.00 DFES_OneToOne 0.00 30.00 FORMAT "%5.2" EXTENDED_LIMITS 0.00 255.0 /end CHARACTERISTIC
/begin CHARACTERISTIC DFES_Cls.DFC_EGRVlvJamVlvOpn_C "fault class per DFC / Fault class for check DFC_EGRVlvJamVlvOpn" VALUE 0x804D990B Val_Wu8 30.00 DFES_OneToOne 0.00 30.00 FORMAT "%5.2" EXTENDED_LIMITS 0.00 255.0 /end CHARACTERISTIC
/begin CHARACTERISTIC DFES_Cls.DFC_EGRVlvSprgBrk_C "fault class per DFC / Fault class for check DFC_EGRVlvSprgBrk" VALUE 0x804D990C Val_Wu8 30.00 DFES_OneToOne 0.00 30.00 FORMAT "%5.2" EXTENDED_LIMITS 0.00 255.0 /end CHARACTERISTIC
/begin CHARACTERISTIC DFES_Cls.DFC_EGRVlvTempMdlEEPErr_C "fault class per DFC / Fault class for check DFC_EGRVlvTempMdlEEPErr" VALUE 0x804D990D Val_Wu8 30.00 DFES_OneToOne 0.00 30.00 FORMAT "%5.2" EXTENDED_LIMITS 0.00 255.0 /end CHARACTERISTIC
/begin CHARACTERISTIC DFES_Cls.DFC_EGRVlvTmpErr_C "fault class per DFC / Fault class for check DFC_EGRVlvTmpErr" VALUE 0x804D990E Val_Wu8 30.00 DFES_OneToOne 0.00 30.00 FORMAT "%5.2" EXTENDED_LIMITS 0.00 255.0 /end CHARACTERISTIC
/begin CHARACTERISTIC DFES_Cls.DFC_EGSDUS2B1LtrDly_C "fault class per DFC / Fault class for check DFC_EGSDUS2B1LtrDly" VALUE 0x804D990F Val_Wu8 30.00 DFES_OneToOne 0.00 30.00 FORMAT "%5.2" EXTENDED_LIMITS 0.00 255.0 /end CHARACTERISTIC
/begin CHARACTERISTIC DFES_Cls.DFC_EGSDUS2B1LtrPT1_C "fault class per DFC / Fault class for check DFC_EGSDUS2B1LtrPT1" VALUE 0x804D9910 Val_Wu8 30.00 DFES_OneToOne 0.00 30.00 FORMAT "%5.2" EXTENDED_LIMITS 0.00 255.0 /end CHARACTERISTIC
/begin CHARACTERISTIC DFES_Cls.DFC_EGSDUS2B1RtlDly_C "fault class per DFC / Fault class for check DFC_EGSDUS2B1RtlDly" VALUE 0x804D9911 Val_Wu8 30.00 DFES_OneToOne 0.00 30.00 FORMAT "%5.2" EXTENDED_LIMITS 0.00 255.0 /end CHARACTERISTIC
/begin CHARACTERISTIC DFES_Cls.DFC_EGSDUS2B1RtlPT1_C "fault class per DFC / Fault class for check DFC_EGSDUS2B1RtlPT1" VALUE 0x804D9912 Val_Wu8 30.00 DFES_OneToOne 0.00 30.00 FORMAT "%5.2" EXTENDED_LIMITS 0.00 255.0 /end CHARACTERISTIC
/begin CHARACTERISTIC DFES_Cls.DFC_EGSDUS2B1TarLean_C "fault class per DFC / Fault class for check DFC_EGSDUS2B1TarLean" VALUE 0x804D9913 Val_Wu8 30.00 DFES_OneToOne 0.00 30.00 FORMAT "%5.2" EXTENDED_LIMITS 0.00 255.0 /end CHARACTERISTIC
/begin CHARACTERISTIC DFES_Cls.DFC_EGSDUS2B1TarRich_C "fault class per DFC / Fault class for check DFC_EGSDUS2B1TarRich" VALUE 0x804D9914 Val_Wu8 30.00 DFES_OneToOne 0.00 30.00 FORMAT "%5.2" EXTENDED_LIMITS 0.00 255.0 /end CHARACTERISTIC
/begin CHARACTERISTIC DFES_Cls.DFC_EONVmax_C "fault class per DFC / Fault class for check DFC_EONVmax" VALUE 0x804D9915 Val_Wu8 30.00 DFES_OneToOne 0.00 30.00 FORMAT "%5.2" EXTENDED_LIMITS 0.00 255.0 /end CHARACTERISTIC
/begin CHARACTERISTIC DFES_Cls.DFC_ETAKHLmax_C "fault class per DFC / Fault class for check DFC_ETAKHLmax" VALUE 0x804D9916 Val_Wu8 30.00 DFES_OneToOne 0.00 30.00 FORMAT "%5.2" EXTENDED_LIMITS 0.00 255.0 /end CHARACTERISTIC
/begin CHARACTERISTIC DFES_Cls.DFC_ETAKHTmax_C "fault class per DFC / Fault class for check DFC_ETAKHTmax" VALUE 0x804D9917 Val_Wu8 30.00 DFES_OneToOne 0.00 30.00 FORMAT "%5.2" EXTENDED_LIMITS 0.00 255.0 /end CHARACTERISTIC
/begin CHARACTERISTIC DFES_Cls.DFC_ETHSEmax_C "fault class per DFC / Fault class for check DFC_ETHSEmax" VALUE 0x804D9918 Val_Wu8 30.00 DFES_OneToOne 0.00 30.00 FORMAT "%5.2" EXTENDED_LIMITS 0.00 255.0 /end CHARACTERISTIC
/begin CHARACTERISTIC DFES_Cls.DFC_ETHSEmin_C "fault class per DFC / Fault class for check DFC_ETHSEmin" VALUE 0x804D9919 Val_Wu8 30.00 DFES_OneToOne 0.00 30.00 FORMAT "%5.2" EXTENDED_LIMITS 0.00 255.0 /end CHARACTERISTIC
/begin CHARACTERISTIC DFES_Cls.DFC_ETHSFmax_C "fault class per DFC / Fault class for check DFC_ETHSFmax" VALUE 0x804D991A Val_Wu8 30.00 DFES_OneToOne 0.00 30.00 FORMAT "%5.2" EXTENDED_LIMITS 0.00 255.0 /end CHARACTERISTIC
/begin CHARACTERISTIC DFES_Cls.DFC_ETHSFmin_C "fault class per DFC / Fault class for check DFC_ETHSFmin" VALUE 0x804D991B Val_Wu8 30.00 DFES_OneToOne 0.00 30.00 FORMAT "%5.2" EXTENDED_LIMITS 0.00 255.0 /end CHARACTERISTIC
/begin CHARACTERISTIC DFES_Cls.DFC_ETHSFsig_C "fault class per DFC / Fault class for check DFC_ETHSFsig" VALUE 0x804D991C Val_Wu8 30.00 DFES_OneToOne 0.00 30.00 FORMAT "%5.2" EXTENDED_LIMITS 0.00 255.0 /end CHARACTERISTIC
/begin CHARACTERISTIC DFES_Cls.DFC_ETHSNPWmax_C "fault class per DFC / Fault class for check DFC_ETHSNPWmax" VALUE 0x804D991D Val_Wu8 30.00 DFES_OneToOne 0.00 30.00 FORMAT "%5.2" EXTENDED_LIMITS 0.00 255.0 /end CHARACTERISTIC
/begin CHARACTERISTIC DFES_Cls.DFC_ETHSNPWmin_C "fault class per DFC / Fault class for check DFC_ETHSNPWmin" VALUE 0x804D991E Val_Wu8 30.00 DFES_OneToOne 0.00 30.00 FORMAT "%5.2" EXTENDED_LIMITS 0.00 255.0 /end CHARACTERISTIC
/begin CHARACTERISTIC DFES_Cls.DFC_ETHSNPWsig_C "fault class per DFC / Fault class for check DFC_ETHSNPWsig" VALUE 0x804D991F Val_Wu8 30.00 DFES_OneToOne 0.00 30.00 FORMAT "%5.2" EXTENDED_LIMITS 0.00 255.0 /end CHARACTERISTIC
/begin CHARACTERISTIC DFES_Cls.DFC_ETHSPLnpl_C "fault class per DFC / Fault class for check DFC_ETHSPLnpl" VALUE 0x804D9920 Val_Wu8 30.00 DFES_OneToOne 0.00 30.00 FORMAT "%5.2" EXTENDED_LIMITS 0.00 255.0 /end CHARACTERISTIC
/begin CHARACTERISTIC DFES_Cls.DFC_ETHSTPLnpl_C "fault class per DFC / Fault class for check DFC_ETHSTPLnpl" VALUE 0x804D9921 Val_Wu8 30.00 DFES_OneToOne 0.00 30.00 FORMAT "%5.2" EXTENDED_LIMITS 0.00 255.0 /end CHARACTERISTIC
/begin CHARACTERISTIC DFES_Cls.DFC_EngICO_C "fault class per DFC / Fault class for check DFC_EngICO" VALUE 0x804D9922 Val_Wu8 30.00 DFES_OneToOne 0.00 30.00 FORMAT "%5.2" EXTENDED_LIMITS 0.00 255.0 /end CHARACTERISTIC
/begin CHARACTERISTIC DFES_Cls.DFC_EngPrtOvrSpdMon_C "fault class per DFC / Fault class for check DFC_EngPrtOvrSpdMon" VALUE 0x804D9923 Val_Wu8 30.00 DFES_OneToOne 0.00 30.00 FORMAT "%5.2" EXTENDED_LIMITS 0.00 255.0 /end CHARACTERISTIC
/begin CHARACTERISTIC DFES_Cls.DFC_EpmCaSI1ErrSig_C "fault class per DFC / Fault class for check DFC_EpmCaSI1ErrSig" VALUE 0x804D9924 Val_Wu8 30.00 DFES_OneToOne 0.00 30.00 FORMAT "%5.2" EXTENDED_LIMITS 0.00 255.0 /end CHARACTERISTIC
/begin CHARACTERISTIC DFES_Cls.DFC_EpmCaSI1MntErr_C "fault class per DFC / Fault class for check DFC_EpmCaSI1MntErr" VALUE 0x804D9925 Val_Wu8 30.00 DFES_OneToOne 0.00 30.00 FORMAT "%5.2" EXTENDED_LIMITS 0.00 255.0 /end CHARACTERISTIC
/begin CHARACTERISTIC DFES_Cls.DFC_EpmCaSI1NoSigMax_C "fault class per DFC / Fault class for check DFC_EpmCaSI1NoSigMax" VALUE 0x804D9926 Val_Wu8 30.00 DFES_OneToOne 0.00 30.00 FORMAT "%5.2" EXTENDED_LIMITS 0.00 255.0 /end CHARACTERISTIC
/begin CHARACTERISTIC DFES_Cls.DFC_EpmCaSI1NoSigMin_C "fault class per DFC / Fault class for check DFC_EpmCaSI1NoSigMin" VALUE 0x804D9927 Val_Wu8 30.00 DFES_OneToOne 0.00 30.00 FORMAT "%5.2" EXTENDED_LIMITS 0.00 255.0 /end CHARACTERISTIC
/begin CHARACTERISTIC DFES_Cls.DFC_EpmCaSI1OfsErr_C "fault class per DFC / Fault class for check DFC_EpmCaSI1OfsErr" VALUE 0x804D9928 Val_Wu8 30.00 DFES_OneToOne 0.00 30.00 FORMAT "%5.2" EXTENDED_LIMITS 0.00 255.0 /end CHARACTERISTIC
/begin CHARACTERISTIC DFES_Cls.DFC_EpmCrSDGI_C "fault class per DFC / Fault class for check DFC_EpmCrSDGI" VALUE 0x804D9929 Val_Wu8 30.00 DFES_OneToOne 0.00 30.00 FORMAT "%5.2" EXTENDED_LIMITS 0.00 255.0 /end CHARACTERISTIC
/begin CHARACTERISTIC DFES_Cls.DFC_EpmCrSErrSig_C "fault class per DFC / Fault class for check DFC_EpmCrSErrSig" VALUE 0x804D992A Val_Wu8 30.00 DFES_OneToOne 0.00 30.00 FORMAT "%5.2" EXTENDED_LIMITS 0.00 255.0 /end CHARACTERISTIC
/begin CHARACTERISTIC DFES_Cls.DFC_EpmCrSNoSig_C "fault class per DFC / Fault class for check DFC_EpmCrSNoSig" VALUE 0x804D992B Val_Wu8 30.00 DFES_OneToOne 0.00 30.00 FORMAT "%5.2" EXTENDED_LIMITS 0.00 255.0 /end CHARACTERISTIC
/begin CHARACTERISTIC DFES_Cls.DFC_EtaEngIdleNonCsers_C "fault class per DFC / Fault class for check DFC_EtaEngIdleNonCsers" VALUE 0x804D992C Val_Wu8 30.00 DFES_OneToOne 0.00 30.00 FORMAT "%5.2" EXTENDED_LIMITS 0.00 255.0 /end CHARACTERISTIC
/begin CHARACTERISTIC DFES_Cls.DFC_EtaEngPtlNonCsers_C "fault class per DFC / Fault class for check DFC_EtaEngPtlNonCsers" VALUE 0x804D992D Val_Wu8 30.00 DFES_OneToOne 0.00 30.00 FORMAT "%5.2" EXTENDED_LIMITS 0.00 255.0 /end CHARACTERISTIC
/begin CHARACTERISTIC DFES_Cls.DFC_FRAmax_C "fault class per DFC / Fault class for check DFC_FRAmax" VALUE 0x804D992E Val_Wu8 30.00 DFES_OneToOne 0.00 30.00 FORMAT "%5.2" EXTENDED_LIMITS 0.00 255.0 /end CHARACTERISTIC
/begin CHARACTERISTIC DFES_Cls.DFC_FRAmin_C "fault class per DFC / Fault class for check DFC_FRAmin" VALUE 0x804D992F Val_Wu8 30.00 DFES_OneToOne 0.00 30.00 FORMAT "%5.2" EXTENDED_LIMITS 0.00 255.0 /end CHARACTERISTIC
/begin CHARACTERISTIC DFES_Cls.DFC_FSTEmax_C "fault class per DFC / Fault class for check DFC_FSTEmax" VALUE 0x804D9930 Val_Wu8 30.00 DFES_OneToOne 0.00 30.00 FORMAT "%5.2" EXTENDED_LIMITS 0.00 255.0 /end CHARACTERISTIC
/begin CHARACTERISTIC DFES_Cls.DFC_FSTEmin_C "fault class per DFC / Fault class for check DFC_FSTEmin" VALUE 0x804D9931 Val_Wu8 30.00 DFES_OneToOne 0.00 30.00 FORMAT "%5.2" EXTENDED_LIMITS 0.00 255.0 /end CHARACTERISTIC
/begin CHARACTERISTIC DFES_Cls.DFC_FSTRmax_C "fault class per DFC / Fault class for check DFC_FSTRmax" VALUE 0x804D9932 Val_Wu8 30.00 DFES_OneToOne 0.00 30.00 FORMAT "%5.2" EXTENDED_LIMITS 0.00 255.0 /end CHARACTERISTIC
/begin CHARACTERISTIC DFES_Cls.DFC_FSTRmin_C "fault class per DFC / Fault class for check DFC_FSTRmin" VALUE 0x804D9933 Val_Wu8 30.00 DFES_OneToOne 0.00 30.00 FORMAT "%5.2" EXTENDED_LIMITS 0.00 255.0 /end CHARACTERISTIC
/begin CHARACTERISTIC DFES_Cls.DFC_FSTRnpl_C "fault class per DFC / Fault class for check DFC_FSTRnpl" VALUE 0x804D9934 Val_Wu8 30.00 DFES_OneToOne 0.00 30.00 FORMAT "%5.2" EXTENDED_LIMITS 0.00 255.0 /end CHARACTERISTIC
/begin CHARACTERISTIC DFES_Cls.DFC_FSTmax_C "fault class per DFC / Fault class for check DFC_FSTmax" VALUE 0x804D9935 Val_Wu8 30.00 DFES_OneToOne 0.00 30.00 FORMAT "%5.2" EXTENDED_LIMITS 0.00 255.0 /end CHARACTERISTIC
/begin CHARACTERISTIC DFES_Cls.DFC_FTDLAmax_C "fault class per DFC / Fault class for check DFC_FTDLAmax" VALUE 0x804D9936 Val_Wu8 30.00 DFES_OneToOne 0.00 30.00 FORMAT "%5.2" EXTENDED_LIMITS 0.00 255.0 /end CHARACTERISTIC
/begin CHARACTERISTIC DFES_Cls.DFC_FTDLAmin_C "fault class per DFC / Fault class for check DFC_FTDLAmin" VALUE 0x804D9937 Val_Wu8 30.00 DFES_OneToOne 0.00 30.00 FORMAT "%5.2" EXTENDED_LIMITS 0.00 255.0 /end CHARACTERISTIC
/begin CHARACTERISTIC DFES_Cls.DFC_FuPHiSnsrEleclmax_C "fault class per DFC / Fault class for check DFC_FuPHiSnsrEleclmax" VALUE 0x804D9938 Val_Wu8 30.00 DFES_OneToOne 0.00 30.00 FORMAT "%5.2" EXTENDED_LIMITS 0.00 255.0 /end CHARACTERISTIC
/begin CHARACTERISTIC DFES_Cls.DFC_FuPHiSnsrEleclmin_C "fault class per DFC / Fault class for check DFC_FuPHiSnsrEleclmin" VALUE 0x804D9939 Val_Wu8 30.00 DFES_OneToOne 0.00 30.00 FORMAT "%5.2" EXTENDED_LIMITS 0.00 255.0 /end CHARACTERISTIC
/begin CHARACTERISTIC DFES_Cls.DFC_FuPHiSnsrEleclnpl_C "fault class per DFC / Fault class for check DFC_FuPHiSnsrEleclnpl" VALUE 0x804D993A Val_Wu8 30.00 DFES_OneToOne 0.00 30.00 FORMAT "%5.2" EXTENDED_LIMITS 0.00 255.0 /end CHARACTERISTIC
/begin CHARACTERISTIC DFES_Cls.DFC_FuPHiSnsrURngMax_C "fault class per DFC / Fault class for check DFC_FuPHiSnsrURngMax" VALUE 0x804D993B Val_Wu8 30.00 DFES_OneToOne 0.00 30.00 FORMAT "%5.2" EXTENDED_LIMITS 0.00 255.0 /end CHARACTERISTIC
/begin CHARACTERISTIC DFES_Cls.DFC_FuPHiSnsrURngMin_C "fault class per DFC / Fault class for check DFC_FuPHiSnsrURngMin" VALUE 0x804D993C Val_Wu8 30.00 DFES_OneToOne 0.00 30.00 FORMAT "%5.2" EXTENDED_LIMITS 0.00 255.0 /end CHARACTERISTIC
/begin CHARACTERISTIC DFES_Cls.DFC_FuSnsrPhyRngMaxErr_C "fault class per DFC / Fault class for check DFC_FuSnsrPhyRngMaxErr" VALUE 0x804D993D Val_Wu8 30.00 DFES_OneToOne 0.00 30.00 FORMAT "%5.2" EXTENDED_LIMITS 0.00 255.0 /end CHARACTERISTIC
/begin CHARACTERISTIC DFES_Cls.DFC_FuSnsrPhyRngMinErr_C "fault class per DFC / Fault class for check DFC_FuSnsrPhyRngMinErr" VALUE 0x804D993E Val_Wu8 30.00 DFES_OneToOne 0.00 30.00 FORMAT "%5.2" EXTENDED_LIMITS 0.00 255.0 /end CHARACTERISTIC
/begin CHARACTERISTIC DFES_Cls.DFC_GEVlvLockPinDiagIntkB1_C "fault class per DFC / Fault class for check DFC_GEVlvLockPinDiagIntkB1" VALUE 0x804D993F Val_Wu8 30.00 DFES_OneToOne 0.00 30.00 FORMAT "%5.2" EXTENDED_LIMITS 0.00 255.0 /end CHARACTERISTIC
/begin CHARACTERISTIC DFES_Cls.DFC_GEVlvPhaSlowIntkB1_C "fault class per DFC / Fault class for check DFC_GEVlvPhaSlowIntkB1" VALUE 0x804D9940 Val_Wu8 30.00 DFES_OneToOne 0.00 30.00 FORMAT "%5.2" EXTENDED_LIMITS 0.00 255.0 /end CHARACTERISTIC
/begin CHARACTERISTIC DFES_Cls.DFC_GEVlvPhaTargIntkB1_C "fault class per DFC / Fault class for check DFC_GEVlvPhaTargIntkB1" VALUE 0x804D9941 Val_Wu8 30.00 DFES_OneToOne 0.00 30.00 FORMAT "%5.2" EXTENDED_LIMITS 0.00 255.0 /end CHARACTERISTIC
/begin CHARACTERISTIC DFES_Cls.DFC_GbxRvsSwtStk_C "fault class per DFC / Fault class for check DFC_GbxRvsSwtStk" VALUE 0x804D9942 Val_Wu8 30.00 DFES_OneToOne 0.00 30.00 FORMAT "%5.2" EXTENDED_LIMITS 0.00 255.0 /end CHARACTERISTIC
/begin CHARACTERISTIC DFES_Cls.DFC_HDRKHmax_C "fault class per DFC / Fault class for check DFC_HDRKHmax" VALUE 0x804D9943 Val_Wu8 30.00 DFES_OneToOne 0.00 30.00 FORMAT "%5.2" EXTENDED_LIMITS 0.00 255.0 /end CHARACTERISTIC
/begin CHARACTERISTIC DFES_Cls.DFC_HDRKHmin_C "fault class per DFC / Fault class for check DFC_HDRKHmin" VALUE 0x804D9944 Val_Wu8 30.00 DFES_OneToOne 0.00 30.00 FORMAT "%5.2" EXTENDED_LIMITS 0.00 255.0 /end CHARACTERISTIC
/begin CHARACTERISTIC DFES_Cls.DFC_HDRPLmax_C "fault class per DFC / Fault class for check DFC_HDRPLmax" VALUE 0x804D9945 Val_Wu8 30.00 DFES_OneToOne 0.00 30.00 FORMAT "%5.2" EXTENDED_LIMITS 0.00 255.0 /end CHARACTERISTIC
/begin CHARACTERISTIC DFES_Cls.DFC_HDRPLmin_C "fault class per DFC / Fault class for check DFC_HDRPLmin" VALUE 0x804D9946 Val_Wu8 30.00 DFES_OneToOne 0.00 30.00 FORMAT "%5.2" EXTENDED_LIMITS 0.00 255.0 /end CHARACTERISTIC
/begin CHARACTERISTIC DFES_Cls.DFC_HDRmax_C "fault class per DFC / Fault class for check DFC_HDRmax" VALUE 0x804D9947 Val_Wu8 30.00 DFES_OneToOne 0.00 30.00 FORMAT "%5.2" EXTENDED_LIMITS 0.00 255.0 /end CHARACTERISTIC
/begin CHARACTERISTIC DFES_Cls.DFC_HDRmin_C "fault class per DFC / Fault class for check DFC_HDRmin" VALUE 0x804D9948 Val_Wu8 30.00 DFES_OneToOne 0.00 30.00 FORMAT "%5.2" EXTENDED_LIMITS 0.00 255.0 /end CHARACTERISTIC
/begin CHARACTERISTIC DFES_Cls.DFC_HEGOS2B1ElecMax_C "fault class per DFC / Fault class for check DFC_HEGOS2B1ElecMax" VALUE 0x804D9949 Val_Wu8 30.00 DFES_OneToOne 0.00 30.00 FORMAT "%5.2" EXTENDED_LIMITS 0.00 255.0 /end CHARACTERISTIC
/begin CHARACTERISTIC DFES_Cls.DFC_HEGOS2B1ElecMin_C "fault class per DFC / Fault class for check DFC_HEGOS2B1ElecMin" VALUE 0x804D994A Val_Wu8 30.00 DFES_OneToOne 0.00 30.00 FORMAT "%5.2" EXTENDED_LIMITS 0.00 255.0 /end CHARACTERISTIC
/begin CHARACTERISTIC DFES_Cls.DFC_HEGOS2B1ElecSig_C "fault class per DFC / Fault class for check DFC_HEGOS2B1ElecSig" VALUE 0x804D994B Val_Wu8 30.00 DFES_OneToOne 0.00 30.00 FORMAT "%5.2" EXTENDED_LIMITS 0.00 255.0 /end CHARACTERISTIC
/begin CHARACTERISTIC DFES_Cls.DFC_HEGOS2B1HtgNpl_C "fault class per DFC / Fault class for check DFC_HEGOS2B1HtgNpl" VALUE 0x804D994C Val_Wu8 30.00 DFES_OneToOne 0.00 30.00 FORMAT "%5.2" EXTENDED_LIMITS 0.00 255.0 /end CHARACTERISTIC
/begin CHARACTERISTIC DFES_Cls.DFC_HEV00max_C "fault class per DFC / Fault class for check DFC_HEV00max" VALUE 0x804D994D Val_Wu8 30.00 DFES_OneToOne 0.00 30.00 FORMAT "%5.2" EXTENDED_LIMITS 0.00 255.0 /end CHARACTERISTIC
/begin CHARACTERISTIC DFES_Cls.DFC_HEV01max_C "fault class per DFC / Fault class for check DFC_HEV01max" VALUE 0x804D994E Val_Wu8 30.00 DFES_OneToOne 0.00 30.00 FORMAT "%5.2" EXTENDED_LIMITS 0.00 255.0 /end CHARACTERISTIC
/begin CHARACTERISTIC DFES_Cls.DFC_HEV02max_C "fault class per DFC / Fault class for check DFC_HEV02max" VALUE 0x804D994F Val_Wu8 30.00 DFES_OneToOne 0.00 30.00 FORMAT "%5.2" EXTENDED_LIMITS 0.00 255.0 /end CHARACTERISTIC
/begin CHARACTERISTIC DFES_Cls.DFC_HEV03max_C "fault class per DFC / Fault class for check DFC_HEV03max" VALUE 0x804D9950 Val_Wu8 30.00 DFES_OneToOne 0.00 30.00 FORMAT "%5.2" EXTENDED_LIMITS 0.00 255.0 /end CHARACTERISTIC
/begin CHARACTERISTIC DFES_Cls.DFC_HEVE0max_C "fault class per DFC / Fault class for check DFC_HEVE0max" VALUE 0x804D9951 Val_Wu8 30.00 DFES_OneToOne 0.00 30.00 FORMAT "%5.2" EXTENDED_LIMITS 0.00 255.0 /end CHARACTERISTIC
/begin CHARACTERISTIC DFES_Cls.DFC_HEVE1max_C "fault class per DFC / Fault class for check DFC_HEVE1max" VALUE 0x804D9952 Val_Wu8 30.00 DFES_OneToOne 0.00 30.00 FORMAT "%5.2" EXTENDED_LIMITS 0.00 255.0 /end CHARACTERISTIC
/begin CHARACTERISTIC DFES_Cls.DFC_HFMmax_C "fault class per DFC / Fault class for check DFC_HFMmax" VALUE 0x804D9953 Val_Wu8 30.00 DFES_OneToOne 0.00 30.00 FORMAT "%5.2" EXTENDED_LIMITS 0.00 255.0 /end CHARACTERISTIC
/begin CHARACTERISTIC DFES_Cls.DFC_HiPSysHiPMaxLimExcdd_C "fault class per DFC / Fault class for check DFC_HiPSysHiPMaxLimExcdd" VALUE 0x804D9954 Val_Wu8 30.00 DFES_OneToOne 0.00 30.00 FORMAT "%5.2" EXTENDED_LIMITS 0.00 255.0 /end CHARACTERISTIC
/begin CHARACTERISTIC DFES_Cls.DFC_IVGdiCtlCvoErrMax_0_C "fault class per DFC / Fault class for check DFC_IVGdiCtlCvoErrMax_0" VALUE 0x804D9955 Val_Wu8 30.00 DFES_OneToOne 0.00 30.00 FORMAT "%5.2" EXTENDED_LIMITS 0.00 255.0 /end CHARACTERISTIC
/begin CHARACTERISTIC DFES_Cls.DFC_IVGdiCtlCvoErrMax_1_C "fault class per DFC / Fault class for check DFC_IVGdiCtlCvoErrMax_1" VALUE 0x804D9956 Val_Wu8 30.00 DFES_OneToOne 0.00 30.00 FORMAT "%5.2" EXTENDED_LIMITS 0.00 255.0 /end CHARACTERISTIC
/begin CHARACTERISTIC DFES_Cls.DFC_IVGdiCtlCvoErrMax_2_C "fault class per DFC / Fault class for check DFC_IVGdiCtlCvoErrMax_2" VALUE 0x804D9957 Val_Wu8 30.00 DFES_OneToOne 0.00 30.00 FORMAT "%5.2" EXTENDED_LIMITS 0.00 255.0 /end CHARACTERISTIC
/begin CHARACTERISTIC DFES_Cls.DFC_IVGdiCtlCvoErrMax_3_C "fault class per DFC / Fault class for check DFC_IVGdiCtlCvoErrMax_3" VALUE 0x804D9958 Val_Wu8 30.00 DFES_OneToOne 0.00 30.00 FORMAT "%5.2" EXTENDED_LIMITS 0.00 255.0 /end CHARACTERISTIC
/begin CHARACTERISTIC DFES_Cls.DFC_IVGdiCtlCvoErrMin_0_C "fault class per DFC / Fault class for check DFC_IVGdiCtlCvoErrMin_0" VALUE 0x804D9959 Val_Wu8 30.00 DFES_OneToOne 0.00 30.00 FORMAT "%5.2" EXTENDED_LIMITS 0.00 255.0 /end CHARACTERISTIC
/begin CHARACTERISTIC DFES_Cls.DFC_IVGdiCtlCvoErrMin_1_C "fault class per DFC / Fault class for check DFC_IVGdiCtlCvoErrMin_1" VALUE 0x804D995A Val_Wu8 30.00 DFES_OneToOne 0.00 30.00 FORMAT "%5.2" EXTENDED_LIMITS 0.00 255.0 /end CHARACTERISTIC
/begin CHARACTERISTIC DFES_Cls.DFC_IVGdiCtlCvoErrMin_2_C "fault class per DFC / Fault class for check DFC_IVGdiCtlCvoErrMin_2" VALUE 0x804D995B Val_Wu8 30.00 DFES_OneToOne 0.00 30.00 FORMAT "%5.2" EXTENDED_LIMITS 0.00 255.0 /end CHARACTERISTIC
/begin CHARACTERISTIC DFES_Cls.DFC_IVGdiCtlCvoErrMin_3_C "fault class per DFC / Fault class for check DFC_IVGdiCtlCvoErrMin_3" VALUE 0x804D995C Val_Wu8 30.00 DFES_OneToOne 0.00 30.00 FORMAT "%5.2" EXTENDED_LIMITS 0.00 255.0 /end CHARACTERISTIC
/begin CHARACTERISTIC DFES_Cls.DFC_IVGdiCtlCvoErrMinMax_C "fault class per DFC / Fault class for check DFC_IVGdiCtlCvoErrMinMax" VALUE 0x804D995D Val_Wu8 30.00 DFES_OneToOne 0.00 30.00 FORMAT "%5.2" EXTENDED_LIMITS 0.00 255.0 /end CHARACTERISTIC
/begin CHARACTERISTIC DFES_Cls.DFC_IVGdiCtlCvoSigPlausErrSmrCdn_C "fault class per DFC / Fault class for check DFC_IVGdiCtlCvoSigPlausErrSmrCdn" VALUE 0x804D995E Val_Wu8 30.00 DFES_OneToOne 0.00 30.00 FORMAT "%5.2" EXTENDED_LIMITS 0.00 255.0 /end CHARACTERISTIC
/begin CHARACTERISTIC DFES_Cls.DFC_IVGdiCtl_CvoErr_C "fault class per DFC / Fault class for check DFC_IVGdiCtl_CvoErr" VALUE 0x804D995F Val_Wu8 30.00 DFES_OneToOne 0.00 30.00 FORMAT "%5.2" EXTENDED_LIMITS 0.00 255.0 /end CHARACTERISTIC
/begin CHARACTERISTIC DFES_Cls.DFC_IVGdiCtl_CvoSigPlaus_0_C "fault class per DFC / Fault class for check DFC_IVGdiCtl_CvoSigPlaus_0" VALUE 0x804D9960 Val_Wu8 30.00 DFES_OneToOne 0.00 30.00 FORMAT "%5.2" EXTENDED_LIMITS 0.00 255.0 /end CHARACTERISTIC
/begin CHARACTERISTIC DFES_Cls.DFC_IVGdiCtl_CvoSigPlaus_1_C "fault class per DFC / Fault class for check DFC_IVGdiCtl_CvoSigPlaus_1" VALUE 0x804D9961 Val_Wu8 30.00 DFES_OneToOne 0.00 30.00 FORMAT "%5.2" EXTENDED_LIMITS 0.00 255.0 /end CHARACTERISTIC
/begin CHARACTERISTIC DFES_Cls.DFC_IVGdiCtl_CvoSigPlaus_2_C "fault class per DFC / Fault class for check DFC_IVGdiCtl_CvoSigPlaus_2" VALUE 0x804D9962 Val_Wu8 30.00 DFES_OneToOne 0.00 30.00 FORMAT "%5.2" EXTENDED_LIMITS 0.00 255.0 /end CHARACTERISTIC
/begin CHARACTERISTIC DFES_Cls.DFC_IVGdiCtl_CvoSigPlaus_3_C "fault class per DFC / Fault class for check DFC_IVGdiCtl_CvoSigPlaus_3" VALUE 0x804D9963 Val_Wu8 30.00 DFES_OneToOne 0.00 30.00 FORMAT "%5.2" EXTENDED_LIMITS 0.00 255.0 /end CHARACTERISTIC
/begin CHARACTERISTIC DFES_Cls.DFC_IntkAirTAirFltDsCrssMax_C "fault class per DFC / Fault class for check DFC_IntkAirTAirFltDsCrssMax" VALUE 0x804D9964 Val_Wu8 30.00 DFES_OneToOne 0.00 30.00 FORMAT "%5.2" EXTENDED_LIMITS 0.00 255.0 /end CHARACTERISTIC
/begin CHARACTERISTIC DFES_Cls.DFC_IntkAirTAirFltDsCrssMin_C "fault class per DFC / Fault class for check DFC_IntkAirTAirFltDsCrssMin" VALUE 0x804D9965 Val_Wu8 30.00 DFES_OneToOne 0.00 30.00 FORMAT "%5.2" EXTENDED_LIMITS 0.00 255.0 /end CHARACTERISTIC
/begin CHARACTERISTIC DFES_Cls.DFC_IntkAirTAirFltDsHSCMax_C "fault class per DFC / Fault class for check DFC_IntkAirTAirFltDsHSCMax" VALUE 0x804D9966 Val_Wu8 30.00 DFES_OneToOne 0.00 30.00 FORMAT "%5.2" EXTENDED_LIMITS 0.00 255.0 /end CHARACTERISTIC
/begin CHARACTERISTIC DFES_Cls.DFC_IntkAirTAirFltDsImps_C "fault class per DFC / Fault class for check DFC_IntkAirTAirFltDsImps" VALUE 0x804D9967 Val_Wu8 30.00 DFES_OneToOne 0.00 30.00 FORMAT "%5.2" EXTENDED_LIMITS 0.00 255.0 /end CHARACTERISTIC
/begin CHARACTERISTIC DFES_Cls.DFC_IntkAirTAirFltDsPRCMax_C "fault class per DFC / Fault class for check DFC_IntkAirTAirFltDsPRCMax" VALUE 0x804D9968 Val_Wu8 30.00 DFES_OneToOne 0.00 30.00 FORMAT "%5.2" EXTENDED_LIMITS 0.00 255.0 /end CHARACTERISTIC
/begin CHARACTERISTIC DFES_Cls.DFC_IntkAirTAirFltDsPRCMin_C "fault class per DFC / Fault class for check DFC_IntkAirTAirFltDsPRCMin" VALUE 0x804D9969 Val_Wu8 30.00 DFES_OneToOne 0.00 30.00 FORMAT "%5.2" EXTENDED_LIMITS 0.00 255.0 /end CHARACTERISTIC
/begin CHARACTERISTIC DFES_Cls.DFC_IntkAirTAirFltDsSRCMax_C "fault class per DFC / Fault class for check DFC_IntkAirTAirFltDsSRCMax" VALUE 0x804D996A Val_Wu8 30.00 DFES_OneToOne 0.00 30.00 FORMAT "%5.2" EXTENDED_LIMITS 0.00 255.0 /end CHARACTERISTIC
/begin CHARACTERISTIC DFES_Cls.DFC_IntkAirTAirFltDsSRCMin_C "fault class per DFC / Fault class for check DFC_IntkAirTAirFltDsSRCMin" VALUE 0x804D996B Val_Wu8 30.00 DFES_OneToOne 0.00 30.00 FORMAT "%5.2" EXTENDED_LIMITS 0.00 255.0 /end CHARACTERISTIC
/begin CHARACTERISTIC DFES_Cls.DFC_IntkAirTAirFltDsSTC_C "fault class per DFC / Fault class for check DFC_IntkAirTAirFltDsSTC" VALUE 0x804D996C Val_Wu8 30.00 DFES_OneToOne 0.00 30.00 FORMAT "%5.2" EXTENDED_LIMITS 0.00 255.0 /end CHARACTERISTIC
/begin CHARACTERISTIC DFES_Cls.DFC_IntkAirTIntkMnfldCrssMax_C "fault class per DFC / Fault class for check DFC_IntkAirTIntkMnfldCrssMax" VALUE 0x804D996D Val_Wu8 30.00 DFES_OneToOne 0.00 30.00 FORMAT "%5.2" EXTENDED_LIMITS 0.00 255.0 /end CHARACTERISTIC
/begin CHARACTERISTIC DFES_Cls.DFC_IntkAirTIntkMnfldCrssMin_C "fault class per DFC / Fault class for check DFC_IntkAirTIntkMnfldCrssMin" VALUE 0x804D996E Val_Wu8 30.00 DFES_OneToOne 0.00 30.00 FORMAT "%5.2" EXTENDED_LIMITS 0.00 255.0 /end CHARACTERISTIC
/begin CHARACTERISTIC DFES_Cls.DFC_IntkAirTIntkMnfldHSCMax_C "fault class per DFC / Fault class for check DFC_IntkAirTIntkMnfldHSCMax" VALUE 0x804D996F Val_Wu8 30.00 DFES_OneToOne 0.00 30.00 FORMAT "%5.2" EXTENDED_LIMITS 0.00 255.0 /end CHARACTERISTIC
/begin CHARACTERISTIC DFES_Cls.DFC_IntkAirTIntkMnfldImps_C "fault class per DFC / Fault class for check DFC_IntkAirTIntkMnfldImps" VALUE 0x804D9970 Val_Wu8 30.00 DFES_OneToOne 0.00 30.00 FORMAT "%5.2" EXTENDED_LIMITS 0.00 255.0 /end CHARACTERISTIC
/begin CHARACTERISTIC DFES_Cls.DFC_IntkAirTIntkMnfldPRCMax_C "fault class per DFC / Fault class for check DFC_IntkAirTIntkMnfldPRCMax" VALUE 0x804D9971 Val_Wu8 30.00 DFES_OneToOne 0.00 30.00 FORMAT "%5.2" EXTENDED_LIMITS 0.00 255.0 /end CHARACTERISTIC
/begin CHARACTERISTIC DFES_Cls.DFC_IntkAirTIntkMnfldPRCMin_C "fault class per DFC / Fault class for check DFC_IntkAirTIntkMnfldPRCMin" VALUE 0x804D9972 Val_Wu8 30.00 DFES_OneToOne 0.00 30.00 FORMAT "%5.2" EXTENDED_LIMITS 0.00 255.0 /end CHARACTERISTIC
/begin CHARACTERISTIC DFES_Cls.DFC_IntkAirTIntkMnfldSRCMax_C "fault class per DFC / Fault class for check DFC_IntkAirTIntkMnfldSRCMax" VALUE 0x804D9973 Val_Wu8 30.00 DFES_OneToOne 0.00 30.00 FORMAT "%5.2" EXTENDED_LIMITS 0.00 255.0 /end CHARACTERISTIC
/begin CHARACTERISTIC DFES_Cls.DFC_IntkAirTIntkMnfldSRCMin_C "fault class per DFC / Fault class for check DFC_IntkAirTIntkMnfldSRCMin" VALUE 0x804D9974 Val_Wu8 30.00 DFES_OneToOne 0.00 30.00 FORMAT "%5.2" EXTENDED_LIMITS 0.00 255.0 /end CHARACTERISTIC
/begin CHARACTERISTIC DFES_Cls.DFC_IntkAirTIntkMnfldSTC_C "fault class per DFC / Fault class for check DFC_IntkAirTIntkMnfldSTC" VALUE 0x804D9975 Val_Wu8 30.00 DFES_OneToOne 0.00 30.00 FORMAT "%5.2" EXTENDED_LIMITS 0.00 255.0 /end CHARACTERISTIC
/begin CHARACTERISTIC DFES_Cls.DFC_KRREGRLMX_C "fault class per DFC / Fault class for check DFC_KRREGRLMX" VALUE 0x804D9976 Val_Wu8 30.00 DFES_OneToOne 0.00 30.00 FORMAT "%5.2" EXTENDED_LIMITS 0.00 255.0 /end CHARACTERISTIC
/begin CHARACTERISTIC DFES_Cls.DFC_KRVEKOCVLCI_C "fault class per DFC / Fault class for check DFC_KRVEKOCVLCI" VALUE 0x804D9977 Val_Wu8 30.00 DFES_OneToOne 0.00 30.00 FORMAT "%5.2" EXTENDED_LIMITS 0.00 255.0 /end CHARACTERISTIC
/begin CHARACTERISTIC DFES_Cls.DFC_KRVEKOENCHMT_C "fault class per DFC / Fault class for check DFC_KRVEKOENCHMT" VALUE 0x804D9978 Val_Wu8 30.00 DFES_OneToOne 0.00 30.00 FORMAT "%5.2" EXTENDED_LIMITS 0.00 255.0 /end CHARACTERISTIC
/begin CHARACTERISTIC DFES_Cls.DFC_KRVEKOENCHMT0_C "fault class per DFC / Fault class for check DFC_KRVEKOENCHMT0" VALUE 0x804D9979 Val_Wu8 30.00 DFES_OneToOne 0.00 30.00 FORMAT "%5.2" EXTENDED_LIMITS 0.00 255.0 /end CHARACTERISTIC
/begin CHARACTERISTIC DFES_Cls.DFC_KRVEKOENCHMT1_C "fault class per DFC / Fault class for check DFC_KRVEKOENCHMT1" VALUE 0x804D997A Val_Wu8 30.00 DFES_OneToOne 0.00 30.00 FORMAT "%5.2" EXTENDED_LIMITS 0.00 255.0 /end CHARACTERISTIC
/begin CHARACTERISTIC DFES_Cls.DFC_KRVEKOENCHMT2_C "fault class per DFC / Fault class for check DFC_KRVEKOENCHMT2" VALUE 0x804D997B Val_Wu8 30.00 DFES_OneToOne 0.00 30.00 FORMAT "%5.2" EXTENDED_LIMITS 0.00 255.0 /end CHARACTERISTIC
/begin CHARACTERISTIC DFES_Cls.DFC_KRVEKOENCHMT3_C "fault class per DFC / Fault class for check DFC_KRVEKOENCHMT3" VALUE 0x804D997C Val_Wu8 30.00 DFES_OneToOne 0.00 30.00 FORMAT "%5.2" EXTENDED_LIMITS 0.00 255.0 /end CHARACTERISTIC
/begin CHARACTERISTIC DFES_Cls.DFC_KRVEKOENCHMT4_C "fault class per DFC / Fault class for check DFC_KRVEKOENCHMT4" VALUE 0x804D997D Val_Wu8 30.00 DFES_OneToOne 0.00 30.00 FORMAT "%5.2" EXTENDED_LIMITS 0.00 255.0 /end CHARACTERISTIC
/begin CHARACTERISTIC DFES_Cls.DFC_KRVEKOENCHMT5_C "fault class per DFC / Fault class for check DFC_KRVEKOENCHMT5" VALUE 0x804D997E Val_Wu8 30.00 DFES_OneToOne 0.00 30.00 FORMAT "%5.2" EXTENDED_LIMITS 0.00 255.0 /end CHARACTERISTIC
/begin CHARACTERISTIC DFES_Cls.DFC_KRVEKOENCHMT6_C "fault class per DFC / Fault class for check DFC_KRVEKOENCHMT6" VALUE 0x804D997F Val_Wu8 30.00 DFES_OneToOne 0.00 30.00 FORMAT "%5.2" EXTENDED_LIMITS 0.00 255.0 /end CHARACTERISTIC
/begin CHARACTERISTIC DFES_Cls.DFC_KRVEKOENCHMT7_C "fault class per DFC / Fault class for check DFC_KRVEKOENCHMT7" VALUE 0x804D9980 Val_Wu8 30.00 DFES_OneToOne 0.00 30.00 FORMAT "%5.2" EXTENDED_LIMITS 0.00 255.0 /end CHARACTERISTIC
/begin CHARACTERISTIC DFES_Cls.DFC_KRVEKORLMX_C "fault class per DFC / Fault class for check DFC_KRVEKORLMX" VALUE 0x804D9981 Val_Wu8 30.00 DFES_OneToOne 0.00 30.00 FORMAT "%5.2" EXTENDED_LIMITS 0.00 255.0 /end CHARACTERISTIC
/begin CHARACTERISTIC DFES_Cls.DFC_KRVEKORLMXL_C "fault class per DFC / Fault class for check DFC_KRVEKORLMXL" VALUE 0x804D9982 Val_Wu8 30.00 DFES_OneToOne 0.00 30.00 FORMAT "%5.2" EXTENDED_LIMITS 0.00 255.0 /end CHARACTERISTIC
/begin CHARACTERISTIC DFES_Cls.DFC_KS1max_C "fault class per DFC / Fault class for check DFC_KS1max" VALUE 0x804D9983 Val_Wu8 30.00 DFES_OneToOne 0.00 30.00 FORMAT "%5.2" EXTENDED_LIMITS 0.00 255.0 /end CHARACTERISTIC
/begin CHARACTERISTIC DFES_Cls.DFC_KS1min_C "fault class per DFC / Fault class for check DFC_KS1min" VALUE 0x804D9984 Val_Wu8 30.00 DFES_OneToOne 0.00 30.00 FORMAT "%5.2" EXTENDED_LIMITS 0.00 255.0 /end CHARACTERISTIC
/begin CHARACTERISTIC DFES_Cls.DFC_LMmax_C "fault class per DFC / Fault class for check DFC_LMmax" VALUE 0x804D9985 Val_Wu8 30.00 DFES_OneToOne 0.00 30.00 FORMAT "%5.2" EXTENDED_LIMITS 0.00 255.0 /end CHARACTERISTIC
/begin CHARACTERISTIC DFES_Cls.DFC_LZSRnpl_C "fault class per DFC / Fault class for check DFC_LZSRnpl" VALUE 0x804D9986 Val_Wu8 30.00 DFES_OneToOne 0.00 30.00 FORMAT "%5.2" EXTENDED_LIMITS 0.00 255.0 /end CHARACTERISTIC
/begin CHARACTERISTIC DFES_Cls.DFC_LamDynDiagS1B1_C "fault class per DFC / Fault class for check DFC_LamDynDiagS1B1" VALUE 0x804D9987 Val_Wu8 30.00 DFES_OneToOne 0.00 30.00 FORMAT "%5.2" EXTENDED_LIMITS 0.00 255.0 /end CHARACTERISTIC
/begin CHARACTERISTIC DFES_Cls.DFC_LeakIntkMnfldEmiInfl_C "fault class per DFC / Fault class for check DFC_LeakIntkMnfldEmiInfl" VALUE 0x804D9988 Val_Wu8 30.00 DFES_OneToOne 0.00 30.00 FORMAT "%5.2" EXTENDED_LIMITS 0.00 255.0 /end CHARACTERISTIC
/begin CHARACTERISTIC DFES_Cls.DFC_LinFrameErrDCDC_C "fault class per DFC / Fault class for check DFC_LinFrameErrDCDC" VALUE 0x804D9989 Val_Wu8 30.00 DFES_OneToOne 0.00 30.00 FORMAT "%5.2" EXTENDED_LIMITS 0.00 255.0 /end CHARACTERISTIC
/begin CHARACTERISTIC DFES_Cls.DFC_LinOverrunErrDCDC_C "fault class per DFC / Fault class for check DFC_LinOverrunErrDCDC" VALUE 0x804D998A Val_Wu8 30.00 DFES_OneToOne 0.00 30.00 FORMAT "%5.2" EXTENDED_LIMITS 0.00 255.0 /end CHARACTERISTIC
/begin CHARACTERISTIC DFES_Cls.DFC_MD00max_C "fault class per DFC / Fault class for check DFC_MD00max" VALUE 0x804D998B Val_Wu8 30.00 DFES_OneToOne 0.00 30.00 FORMAT "%5.2" EXTENDED_LIMITS 0.00 255.0 /end CHARACTERISTIC
/begin CHARACTERISTIC DFES_Cls.DFC_MDBmax_C "fault class per DFC / Fault class for check DFC_MDBmax" VALUE 0x804D998C Val_Wu8 30.00 DFES_OneToOne 0.00 30.00 FORMAT "%5.2" EXTENDED_LIMITS 0.00 255.0 /end CHARACTERISTIC
/begin CHARACTERISTIC DFES_Cls.DFC_MDCat_C "fault class per DFC / Fault class for check DFC_MDCat" VALUE 0x804D998D Val_Wu8 30.00 DFES_OneToOne 0.00 30.00 FORMAT "%5.2" EXTENDED_LIMITS 0.00 255.0 /end CHARACTERISTIC
/begin CHARACTERISTIC DFES_Cls.DFC_MDCatCrit_C "fault class per DFC / Fault class for check DFC_MDCatCrit" VALUE 0x804D998E Val_Wu8 30.00 DFES_OneToOne 0.00 30.00 FORMAT "%5.2" EXTENDED_LIMITS 0.00 255.0 /end CHARACTERISTIC
/begin CHARACTERISTIC DFES_Cls.DFC_MDCatCurr_C "fault class per DFC / Fault class for check DFC_MDCatCurr" VALUE 0x804D998F Val_Wu8 30.00 DFES_OneToOne 0.00 30.00 FORMAT "%5.2" EXTENDED_LIMITS 0.00 255.0 /end CHARACTERISTIC
/begin CHARACTERISTIC DFES_Cls.DFC_MDCyl_0_C "fault class per DFC / Fault class for check DFC_MDCyl_0" VALUE 0x804D9990 Val_Wu8 30.00 DFES_OneToOne 0.00 30.00 FORMAT "%5.2" EXTENDED_LIMITS 0.00 255.0 /end CHARACTERISTIC
/begin CHARACTERISTIC DFES_Cls.DFC_MDCyl_1_C "fault class per DFC / Fault class for check DFC_MDCyl_1" VALUE 0x804D9991 Val_Wu8 30.00 DFES_OneToOne 0.00 30.00 FORMAT "%5.2" EXTENDED_LIMITS 0.00 255.0 /end CHARACTERISTIC
/begin CHARACTERISTIC DFES_Cls.DFC_MDCyl_2_C "fault class per DFC / Fault class for check DFC_MDCyl_2" VALUE 0x804D9992 Val_Wu8 30.00 DFES_OneToOne 0.00 30.00 FORMAT "%5.2" EXTENDED_LIMITS 0.00 255.0 /end CHARACTERISTIC
/begin CHARACTERISTIC DFES_Cls.DFC_MDCyl_3_C "fault class per DFC / Fault class for check DFC_MDCyl_3" VALUE 0x804D9993 Val_Wu8 30.00 DFES_OneToOne 0.00 30.00 FORMAT "%5.2" EXTENDED_LIMITS 0.00 255.0 /end CHARACTERISTIC
/begin CHARACTERISTIC DFES_Cls.DFC_MDEmi_C "fault class per DFC / Fault class for check DFC_MDEmi" VALUE 0x804D9994 Val_Wu8 30.00 DFES_OneToOne 0.00 30.00 FORMAT "%5.2" EXTENDED_LIMITS 0.00 255.0 /end CHARACTERISTIC
/begin CHARACTERISTIC DFES_Cls.DFC_MDEmiStrt_C "fault class per DFC / Fault class for check DFC_MDEmiStrt" VALUE 0x804D9995 Val_Wu8 30.00 DFES_OneToOne 0.00 30.00 FORMAT "%5.2" EXTENDED_LIMITS 0.00 255.0 /end CHARACTERISTIC
/begin CHARACTERISTIC DFES_Cls.DFC_MDFco_C "fault class per DFC / Fault class for check DFC_MDFco" VALUE 0x804D9996 Val_Wu8 30.00 DFES_OneToOne 0.00 30.00 FORMAT "%5.2" EXTENDED_LIMITS 0.00 255.0 /end CHARACTERISTIC
/begin CHARACTERISTIC DFES_Cls.DFC_MDMpl_C "fault class per DFC / Fault class for check DFC_MDMpl" VALUE 0x804D9997 Val_Wu8 30.00 DFES_OneToOne 0.00 30.00 FORMAT "%5.2" EXTENDED_LIMITS 0.00 255.0 /end CHARACTERISTIC
/begin CHARACTERISTIC DFES_Cls.DFC_MDSegTiAdpn_C "fault class per DFC / Fault class for check DFC_MDSegTiAdpn" VALUE 0x804D9998 Val_Wu8 30.00 DFES_OneToOne 0.00 30.00 FORMAT "%5.2" EXTENDED_LIMITS 0.00 255.0 /end CHARACTERISTIC
/begin CHARACTERISTIC DFES_Cls.DFC_MDmax_C "fault class per DFC / Fault class for check DFC_MDmax" VALUE 0x804D9999 Val_Wu8 30.00 DFES_OneToOne 0.00 30.00 FORMAT "%5.2" EXTENDED_LIMITS 0.00 255.0 /end CHARACTERISTIC
/begin CHARACTERISTIC DFES_Cls.DFC_MFuOilMax_C "fault class per DFC / Fault class for check DFC_MFuOilMax" VALUE 0x804D999A Val_Wu8 30.00 DFES_OneToOne 0.00 30.00 FORMAT "%5.2" EXTENDED_LIMITS 0.00 255.0 /end CHARACTERISTIC
/begin CHARACTERISTIC DFES_Cls.DFC_MOXEMM_SMU_ALM0_0_C "fault class per DFC / Fault class for check DFC_MOXEMM_SMU_ALM0_0" VALUE 0x804D999B Val_Wu8 30.00 DFES_OneToOne 0.00 30.00 FORMAT "%5.2" EXTENDED_LIMITS 0.00 255.0 /end CHARACTERISTIC
/begin CHARACTERISTIC DFES_Cls.DFC_MOXEMM_SMU_ALM0_1_C "fault class per DFC / Fault class for check DFC_MOXEMM_SMU_ALM0_1" VALUE 0x804D999C Val_Wu8 30.00 DFES_OneToOne 0.00 30.00 FORMAT "%5.2" EXTENDED_LIMITS 0.00 255.0 /end CHARACTERISTIC
/begin CHARACTERISTIC DFES_Cls.DFC_MOXEMM_SMU_ALM0_10_C "fault class per DFC / Fault class for check DFC_MOXEMM_SMU_ALM0_10" VALUE 0x804D999D Val_Wu8 30.00 DFES_OneToOne 0.00 30.00 FORMAT "%5.2" EXTENDED_LIMITS 0.00 255.0 /end CHARACTERISTIC
/begin CHARACTERISTIC DFES_Cls.DFC_MOXEMM_SMU_ALM0_11_C "fault class per DFC / Fault class for check DFC_MOXEMM_SMU_ALM0_11" VALUE 0x804D999E Val_Wu8 30.00 DFES_OneToOne 0.00 30.00 FORMAT "%5.2" EXTENDED_LIMITS 0.00 255.0 /end CHARACTERISTIC
/begin CHARACTERISTIC DFES_Cls.DFC_MOXEMM_SMU_ALM0_13_C "fault class per DFC / Fault class for check DFC_MOXEMM_SMU_ALM0_13" VALUE 0x804D999F Val_Wu8 30.00 DFES_OneToOne 0.00 30.00 FORMAT "%5.2" EXTENDED_LIMITS 0.00 255.0 /end CHARACTERISTIC
/begin CHARACTERISTIC DFES_Cls.DFC_MOXEMM_SMU_ALM0_14_C "fault class per DFC / Fault class for check DFC_MOXEMM_SMU_ALM0_14" VALUE 0x804D99A0 Val_Wu8 30.00 DFES_OneToOne 0.00 30.00 FORMAT "%5.2" EXTENDED_LIMITS 0.00 255.0 /end CHARACTERISTIC
/begin CHARACTERISTIC DFES_Cls.DFC_MOXEMM_SMU_ALM0_2_C "fault class per DFC / Fault class for check DFC_MOXEMM_SMU_ALM0_2" VALUE 0x804D99A1 Val_Wu8 30.00 DFES_OneToOne 0.00 30.00 FORMAT "%5.2" EXTENDED_LIMITS 0.00 255.0 /end CHARACTERISTIC
/begin CHARACTERISTIC DFES_Cls.DFC_MOXEMM_SMU_ALM0_22_C "fault class per DFC / Fault class for check DFC_MOXEMM_SMU_ALM0_22" VALUE 0x804D99A2 Val_Wu8 30.00 DFES_OneToOne 0.00 30.00 FORMAT "%5.2" EXTENDED_LIMITS 0.00 255.0 /end CHARACTERISTIC
/begin CHARACTERISTIC DFES_Cls.DFC_MOXEMM_SMU_ALM0_23_C "fault class per DFC / Fault class for check DFC_MOXEMM_SMU_ALM0_23" VALUE 0x804D99A3 Val_Wu8 30.00 DFES_OneToOne 0.00 30.00 FORMAT "%5.2" EXTENDED_LIMITS 0.00 255.0 /end CHARACTERISTIC
/begin CHARACTERISTIC DFES_Cls.DFC_MOXEMM_SMU_ALM0_4_C "fault class per DFC / Fault class for check DFC_MOXEMM_SMU_ALM0_4" VALUE 0x804D99A4 Val_Wu8 30.00 DFES_OneToOne 0.00 30.00 FORMAT "%5.2" EXTENDED_LIMITS 0.00 255.0 /end CHARACTERISTIC
/begin CHARACTERISTIC DFES_Cls.DFC_MOXEMM_SMU_ALM0_5_C "fault class per DFC / Fault class for check DFC_MOXEMM_SMU_ALM0_5" VALUE 0x804D99A5 Val_Wu8 30.00 DFES_OneToOne 0.00 30.00 FORMAT "%5.2" EXTENDED_LIMITS 0.00 255.0 /end CHARACTERISTIC
/begin CHARACTERISTIC DFES_Cls.DFC_MOXEMM_SMU_ALM0_7_C "fault class per DFC / Fault class for check DFC_MOXEMM_SMU_ALM0_7" VALUE 0x804D99A6 Val_Wu8 30.00 DFES_OneToOne 0.00 30.00 FORMAT "%5.2" EXTENDED_LIMITS 0.00 255.0 /end CHARACTERISTIC
/begin CHARACTERISTIC DFES_Cls.DFC_MOXEMM_SMU_ALM0_8_C "fault class per DFC / Fault class for check DFC_MOXEMM_SMU_ALM0_8" VALUE 0x804D99A7 Val_Wu8 30.00 DFES_OneToOne 0.00 30.00 FORMAT "%5.2" EXTENDED_LIMITS 0.00 255.0 /end CHARACTERISTIC
/begin CHARACTERISTIC DFES_Cls.DFC_MOXEMM_SMU_ALM10_16_C "fault class per DFC / Fault class for check DFC_MOXEMM_SMU_ALM10_16" VALUE 0x804D99A8 Val_Wu8 30.00 DFES_OneToOne 0.00 30.00 FORMAT "%5.2" EXTENDED_LIMITS 0.00 255.0 /end CHARACTERISTIC
/begin CHARACTERISTIC DFES_Cls.DFC_MOXEMM_SMU_ALM10_17_C "fault class per DFC / Fault class for check DFC_MOXEMM_SMU_ALM10_17" VALUE 0x804D99A9 Val_Wu8 30.00 DFES_OneToOne 0.00 30.00 FORMAT "%5.2" EXTENDED_LIMITS 0.00 255.0 /end CHARACTERISTIC
/begin CHARACTERISTIC DFES_Cls.DFC_MOXEMM_SMU_ALM10_21_C "fault class per DFC / Fault class for check DFC_MOXEMM_SMU_ALM10_21" VALUE 0x804D99AA Val_Wu8 30.00 DFES_OneToOne 0.00 30.00 FORMAT "%5.2" EXTENDED_LIMITS 0.00 255.0 /end CHARACTERISTIC
/begin CHARACTERISTIC DFES_Cls.DFC_MOXEMM_SMU_ALM11_0_C "fault class per DFC / Fault class for check DFC_MOXEMM_SMU_ALM11_0" VALUE 0x804D99AB Val_Wu8 30.00 DFES_OneToOne 0.00 30.00 FORMAT "%5.2" EXTENDED_LIMITS 0.00 255.0 /end CHARACTERISTIC
/begin CHARACTERISTIC DFES_Cls.DFC_MOXEMM_SMU_ALM11_1_C "fault class per DFC / Fault class for check DFC_MOXEMM_SMU_ALM11_1" VALUE 0x804D99AC Val_Wu8 30.00 DFES_OneToOne 0.00 30.00 FORMAT "%5.2" EXTENDED_LIMITS 0.00 255.0 /end CHARACTERISTIC
/begin CHARACTERISTIC DFES_Cls.DFC_MOXEMM_SMU_ALM11_2_C "fault class per DFC / Fault class for check DFC_MOXEMM_SMU_ALM11_2" VALUE 0x804D99AD Val_Wu8 30.00 DFES_OneToOne 0.00 30.00 FORMAT "%5.2" EXTENDED_LIMITS 0.00 255.0 /end CHARACTERISTIC
/begin CHARACTERISTIC DFES_Cls.DFC_MOXEMM_SMU_ALM11_3_C "fault class per DFC / Fault class for check DFC_MOXEMM_SMU_ALM11_3" VALUE 0x804D99AE Val_Wu8 30.00 DFES_OneToOne 0.00 30.00 FORMAT "%5.2" EXTENDED_LIMITS 0.00 255.0 /end CHARACTERISTIC
/begin CHARACTERISTIC DFES_Cls.DFC_MOXEMM_SMU_ALM11_4_C "fault class per DFC / Fault class for check DFC_MOXEMM_SMU_ALM11_4" VALUE 0x804D99AF Val_Wu8 30.00 DFES_OneToOne 0.00 30.00 FORMAT "%5.2" EXTENDED_LIMITS 0.00 255.0 /end CHARACTERISTIC
/begin CHARACTERISTIC DFES_Cls.DFC_MOXEMM_SMU_ALM11_5_C "fault class per DFC / Fault class for check DFC_MOXEMM_SMU_ALM11_5" VALUE 0x804D99B0 Val_Wu8 30.00 DFES_OneToOne 0.00 30.00 FORMAT "%5.2" EXTENDED_LIMITS 0.00 255.0 /end CHARACTERISTIC
/begin CHARACTERISTIC DFES_Cls.DFC_MOXEMM_SMU_ALM11_8_C "fault class per DFC / Fault class for check DFC_MOXEMM_SMU_ALM11_8" VALUE 0x804D99B1 Val_Wu8 30.00 DFES_OneToOne 0.00 30.00 FORMAT "%5.2" EXTENDED_LIMITS 0.00 255.0 /end CHARACTERISTIC
/begin CHARACTERISTIC DFES_Cls.DFC_MOXEMM_SMU_ALM11_9_C "fault class per DFC / Fault class for check DFC_MOXEMM_SMU_ALM11_9" VALUE 0x804D99B2 Val_Wu8 30.00 DFES_OneToOne 0.00 30.00 FORMAT "%5.2" EXTENDED_LIMITS 0.00 255.0 /end CHARACTERISTIC
/begin CHARACTERISTIC DFES_Cls.DFC_MOXEMM_SMU_ALM1_0_C "fault class per DFC / Fault class for check DFC_MOXEMM_SMU_ALM1_0" VALUE 0x804D99B3 Val_Wu8 30.00 DFES_OneToOne 0.00 30.00 FORMAT "%5.2" EXTENDED_LIMITS 0.00 255.0 /end CHARACTERISTIC
/begin CHARACTERISTIC DFES_Cls.DFC_MOXEMM_SMU_ALM1_1_C "fault class per DFC / Fault class for check DFC_MOXEMM_SMU_ALM1_1" VALUE 0x804D99B4 Val_Wu8 30.00 DFES_OneToOne 0.00 30.00 FORMAT "%5.2" EXTENDED_LIMITS 0.00 255.0 /end CHARACTERISTIC
/begin CHARACTERISTIC DFES_Cls.DFC_MOXEMM_SMU_ALM1_10_C "fault class per DFC / Fault class for check DFC_MOXEMM_SMU_ALM1_10" VALUE 0x804D99B5 Val_Wu8 30.00 DFES_OneToOne 0.00 30.00 FORMAT "%5.2" EXTENDED_LIMITS 0.00 255.0 /end CHARACTERISTIC
/begin CHARACTERISTIC DFES_Cls.DFC_MOXEMM_SMU_ALM1_11_C "fault class per DFC / Fault class for check DFC_MOXEMM_SMU_ALM1_11" VALUE 0x804D99B6 Val_Wu8 30.00 DFES_OneToOne 0.00 30.00 FORMAT "%5.2" EXTENDED_LIMITS 0.00 255.0 /end CHARACTERISTIC
/begin CHARACTERISTIC DFES_Cls.DFC_MOXEMM_SMU_ALM1_13_C "fault class per DFC / Fault class for check DFC_MOXEMM_SMU_ALM1_13" VALUE 0x804D99B7 Val_Wu8 30.00 DFES_OneToOne 0.00 30.00 FORMAT "%5.2" EXTENDED_LIMITS 0.00 255.0 /end CHARACTERISTIC
/begin CHARACTERISTIC DFES_Cls.DFC_MOXEMM_SMU_ALM1_14_C "fault class per DFC / Fault class for check DFC_MOXEMM_SMU_ALM1_14" VALUE 0x804D99B8 Val_Wu8 30.00 DFES_OneToOne 0.00 30.00 FORMAT "%5.2" EXTENDED_LIMITS 0.00 255.0 /end CHARACTERISTIC
/begin CHARACTERISTIC DFES_Cls.DFC_MOXEMM_SMU_ALM1_2_C "fault class per DFC / Fault class for check DFC_MOXEMM_SMU_ALM1_2" VALUE 0x804D99B9 Val_Wu8 30.00 DFES_OneToOne 0.00 30.00 FORMAT "%5.2" EXTENDED_LIMITS 0.00 255.0 /end CHARACTERISTIC
/begin CHARACTERISTIC DFES_Cls.DFC_MOXEMM_SMU_ALM1_22_C "fault class per DFC / Fault class for check DFC_MOXEMM_SMU_ALM1_22" VALUE 0x804D99BA Val_Wu8 30.00 DFES_OneToOne 0.00 30.00 FORMAT "%5.2" EXTENDED_LIMITS 0.00 255.0 /end CHARACTERISTIC
/begin CHARACTERISTIC DFES_Cls.DFC_MOXEMM_SMU_ALM1_23_C "fault class per DFC / Fault class for check DFC_MOXEMM_SMU_ALM1_23" VALUE 0x804D99BB Val_Wu8 30.00 DFES_OneToOne 0.00 30.00 FORMAT "%5.2" EXTENDED_LIMITS 0.00 255.0 /end CHARACTERISTIC
/begin CHARACTERISTIC DFES_Cls.DFC_MOXEMM_SMU_ALM1_4_C "fault class per DFC / Fault class for check DFC_MOXEMM_SMU_ALM1_4" VALUE 0x804D99BC Val_Wu8 30.00 DFES_OneToOne 0.00 30.00 FORMAT "%5.2" EXTENDED_LIMITS 0.00 255.0 /end CHARACTERISTIC
/begin CHARACTERISTIC DFES_Cls.DFC_MOXEMM_SMU_ALM1_5_C "fault class per DFC / Fault class for check DFC_MOXEMM_SMU_ALM1_5" VALUE 0x804D99BD Val_Wu8 30.00 DFES_OneToOne 0.00 30.00 FORMAT "%5.2" EXTENDED_LIMITS 0.00 255.0 /end CHARACTERISTIC
/begin CHARACTERISTIC DFES_Cls.DFC_MOXEMM_SMU_ALM1_7_C "fault class per DFC / Fault class for check DFC_MOXEMM_SMU_ALM1_7" VALUE 0x804D99BE Val_Wu8 30.00 DFES_OneToOne 0.00 30.00 FORMAT "%5.2" EXTENDED_LIMITS 0.00 255.0 /end CHARACTERISTIC
/begin CHARACTERISTIC DFES_Cls.DFC_MOXEMM_SMU_ALM1_8_C "fault class per DFC / Fault class for check DFC_MOXEMM_SMU_ALM1_8" VALUE 0x804D99BF Val_Wu8 30.00 DFES_OneToOne 0.00 30.00 FORMAT "%5.2" EXTENDED_LIMITS 0.00 255.0 /end CHARACTERISTIC
/begin CHARACTERISTIC DFES_Cls.DFC_MOXEMM_SMU_ALM21_0_C "fault class per DFC / Fault class for check DFC_MOXEMM_SMU_ALM21_0" VALUE 0x804D99C0 Val_Wu8 30.00 DFES_OneToOne 0.00 30.00 FORMAT "%5.2" EXTENDED_LIMITS 0.00 255.0 /end CHARACTERISTIC
/begin CHARACTERISTIC DFES_Cls.DFC_MOXEMM_SMU_ALM21_16_C "fault class per DFC / Fault class for check DFC_MOXEMM_SMU_ALM21_16" VALUE 0x804D99C1 Val_Wu8 30.00 DFES_OneToOne 0.00 30.00 FORMAT "%5.2" EXTENDED_LIMITS 0.00 255.0 /end CHARACTERISTIC
/begin CHARACTERISTIC DFES_Cls.DFC_MOXEMM_SMU_ALM21_3_C "fault class per DFC / Fault class for check DFC_MOXEMM_SMU_ALM21_3" VALUE 0x804D99C2 Val_Wu8 30.00 DFES_OneToOne 0.00 30.00 FORMAT "%5.2" EXTENDED_LIMITS 0.00 255.0 /end CHARACTERISTIC
/begin CHARACTERISTIC DFES_Cls.DFC_MOXEMM_SMU_ALM2_1_C "fault class per DFC / Fault class for check DFC_MOXEMM_SMU_ALM2_1" VALUE 0x804D99C3 Val_Wu8 30.00 DFES_OneToOne 0.00 30.00 FORMAT "%5.2" EXTENDED_LIMITS 0.00 255.0 /end CHARACTERISTIC
/begin CHARACTERISTIC DFES_Cls.DFC_MOXEMM_SMU_ALM2_10_C "fault class per DFC / Fault class for check DFC_MOXEMM_SMU_ALM2_10" VALUE 0x804D99C4 Val_Wu8 30.00 DFES_OneToOne 0.00 30.00 FORMAT "%5.2" EXTENDED_LIMITS 0.00 255.0 /end CHARACTERISTIC
/begin CHARACTERISTIC DFES_Cls.DFC_MOXEMM_SMU_ALM2_11_C "fault class per DFC / Fault class for check DFC_MOXEMM_SMU_ALM2_11" VALUE 0x804D99C5 Val_Wu8 30.00 DFES_OneToOne 0.00 30.00 FORMAT "%5.2" EXTENDED_LIMITS 0.00 255.0 /end CHARACTERISTIC
/begin CHARACTERISTIC DFES_Cls.DFC_MOXEMM_SMU_ALM2_13_C "fault class per DFC / Fault class for check DFC_MOXEMM_SMU_ALM2_13" VALUE 0x804D99C6 Val_Wu8 30.00 DFES_OneToOne 0.00 30.00 FORMAT "%5.2" EXTENDED_LIMITS 0.00 255.0 /end CHARACTERISTIC
/begin CHARACTERISTIC DFES_Cls.DFC_MOXEMM_SMU_ALM2_14_C "fault class per DFC / Fault class for check DFC_MOXEMM_SMU_ALM2_14" VALUE 0x804D99C7 Val_Wu8 30.00 DFES_OneToOne 0.00 30.00 FORMAT "%5.2" EXTENDED_LIMITS 0.00 255.0 /end CHARACTERISTIC
/begin CHARACTERISTIC DFES_Cls.DFC_MOXEMM_SMU_ALM2_22_C "fault class per DFC / Fault class for check DFC_MOXEMM_SMU_ALM2_22" VALUE 0x804D99C8 Val_Wu8 30.00 DFES_OneToOne 0.00 30.00 FORMAT "%5.2" EXTENDED_LIMITS 0.00 255.0 /end CHARACTERISTIC
/begin CHARACTERISTIC DFES_Cls.DFC_MOXEMM_SMU_ALM2_23_C "fault class per DFC / Fault class for check DFC_MOXEMM_SMU_ALM2_23" VALUE 0x804D99C9 Val_Wu8 30.00 DFES_OneToOne 0.00 30.00 FORMAT "%5.2" EXTENDED_LIMITS 0.00 255.0 /end CHARACTERISTIC
/begin CHARACTERISTIC DFES_Cls.DFC_MOXEMM_SMU_ALM2_4_C "fault class per DFC / Fault class for check DFC_MOXEMM_SMU_ALM2_4" VALUE 0x804D99CA Val_Wu8 30.00 DFES_OneToOne 0.00 30.00 FORMAT "%5.2" EXTENDED_LIMITS 0.00 255.0 /end CHARACTERISTIC
/begin CHARACTERISTIC DFES_Cls.DFC_MOXEMM_SMU_ALM2_5_C "fault class per DFC / Fault class for check DFC_MOXEMM_SMU_ALM2_5" VALUE 0x804D99CB Val_Wu8 30.00 DFES_OneToOne 0.00 30.00 FORMAT "%5.2" EXTENDED_LIMITS 0.00 255.0 /end CHARACTERISTIC
/begin CHARACTERISTIC DFES_Cls.DFC_MOXEMM_SMU_ALM2_7_C "fault class per DFC / Fault class for check DFC_MOXEMM_SMU_ALM2_7" VALUE 0x804D99CC Val_Wu8 30.00 DFES_OneToOne 0.00 30.00 FORMAT "%5.2" EXTENDED_LIMITS 0.00 255.0 /end CHARACTERISTIC
/begin CHARACTERISTIC DFES_Cls.DFC_MOXEMM_SMU_ALM2_8_C "fault class per DFC / Fault class for check DFC_MOXEMM_SMU_ALM2_8" VALUE 0x804D99CD Val_Wu8 30.00 DFES_OneToOne 0.00 30.00 FORMAT "%5.2" EXTENDED_LIMITS 0.00 255.0 /end CHARACTERISTIC
/begin CHARACTERISTIC DFES_Cls.DFC_MOXEMM_SMU_ALM6_0_C "fault class per DFC / Fault class for check DFC_MOXEMM_SMU_ALM6_0" VALUE 0x804D99CE Val_Wu8 30.00 DFES_OneToOne 0.00 30.00 FORMAT "%5.2" EXTENDED_LIMITS 0.00 255.0 /end CHARACTERISTIC
/begin CHARACTERISTIC DFES_Cls.DFC_MOXEMM_SMU_ALM6_11_C "fault class per DFC / Fault class for check DFC_MOXEMM_SMU_ALM6_11" VALUE 0x804D99CF Val_Wu8 30.00 DFES_OneToOne 0.00 30.00 FORMAT "%5.2" EXTENDED_LIMITS 0.00 255.0 /end CHARACTERISTIC
/begin CHARACTERISTIC DFES_Cls.DFC_MOXEMM_SMU_ALM6_12_C "fault class per DFC / Fault class for check DFC_MOXEMM_SMU_ALM6_12" VALUE 0x804D99D0 Val_Wu8 30.00 DFES_OneToOne 0.00 30.00 FORMAT "%5.2" EXTENDED_LIMITS 0.00 255.0 /end CHARACTERISTIC
/begin CHARACTERISTIC DFES_Cls.DFC_MOXEMM_SMU_ALM6_14_C "fault class per DFC / Fault class for check DFC_MOXEMM_SMU_ALM6_14" VALUE 0x804D99D1 Val_Wu8 30.00 DFES_OneToOne 0.00 30.00 FORMAT "%5.2" EXTENDED_LIMITS 0.00 255.0 /end CHARACTERISTIC
/begin CHARACTERISTIC DFES_Cls.DFC_MOXEMM_SMU_ALM6_15_C "fault class per DFC / Fault class for check DFC_MOXEMM_SMU_ALM6_15" VALUE 0x804D99D2 Val_Wu8 30.00 DFES_OneToOne 0.00 30.00 FORMAT "%5.2" EXTENDED_LIMITS 0.00 255.0 /end CHARACTERISTIC
/begin CHARACTERISTIC DFES_Cls.DFC_MOXEMM_SMU_ALM6_17_C "fault class per DFC / Fault class for check DFC_MOXEMM_SMU_ALM6_17" VALUE 0x804D99D3 Val_Wu8 30.00 DFES_OneToOne 0.00 30.00 FORMAT "%5.2" EXTENDED_LIMITS 0.00 255.0 /end CHARACTERISTIC
/begin CHARACTERISTIC DFES_Cls.DFC_MOXEMM_SMU_ALM6_18_C "fault class per DFC / Fault class for check DFC_MOXEMM_SMU_ALM6_18" VALUE 0x804D99D4 Val_Wu8 30.00 DFES_OneToOne 0.00 30.00 FORMAT "%5.2" EXTENDED_LIMITS 0.00 255.0 /end CHARACTERISTIC
/begin CHARACTERISTIC DFES_Cls.DFC_MOXEMM_SMU_ALM6_20_C "fault class per DFC / Fault class for check DFC_MOXEMM_SMU_ALM6_20" VALUE 0x804D99D5 Val_Wu8 30.00 DFES_OneToOne 0.00 30.00 FORMAT "%5.2" EXTENDED_LIMITS 0.00 255.0 /end CHARACTERISTIC
/begin CHARACTERISTIC DFES_Cls.DFC_MOXEMM_SMU_ALM6_21_C "fault class per DFC / Fault class for check DFC_MOXEMM_SMU_ALM6_21" VALUE 0x804D99D6 Val_Wu8 30.00 DFES_OneToOne 0.00 30.00 FORMAT "%5.2" EXTENDED_LIMITS 0.00 255.0 /end CHARACTERISTIC
/begin CHARACTERISTIC DFES_Cls.DFC_MOXEMM_SMU_ALM6_25_C "fault class per DFC / Fault class for check DFC_MOXEMM_SMU_ALM6_25" VALUE 0x804D99D7 Val_Wu8 30.00 DFES_OneToOne 0.00 30.00 FORMAT "%5.2" EXTENDED_LIMITS 0.00 255.0 /end CHARACTERISTIC
/begin CHARACTERISTIC DFES_Cls.DFC_MOXEMM_SMU_ALM6_4_C "fault class per DFC / Fault class for check DFC_MOXEMM_SMU_ALM6_4" VALUE 0x804D99D8 Val_Wu8 30.00 DFES_OneToOne 0.00 30.00 FORMAT "%5.2" EXTENDED_LIMITS 0.00 255.0 /end CHARACTERISTIC
/begin CHARACTERISTIC DFES_Cls.DFC_MOXEMM_SMU_ALM6_5_C "fault class per DFC / Fault class for check DFC_MOXEMM_SMU_ALM6_5" VALUE 0x804D99D9 Val_Wu8 30.00 DFES_OneToOne 0.00 30.00 FORMAT "%5.2" EXTENDED_LIMITS 0.00 255.0 /end CHARACTERISTIC
/begin CHARACTERISTIC DFES_Cls.DFC_MOXEMM_SMU_ALM6_7_C "fault class per DFC / Fault class for check DFC_MOXEMM_SMU_ALM6_7" VALUE 0x804D99DA Val_Wu8 30.00 DFES_OneToOne 0.00 30.00 FORMAT "%5.2" EXTENDED_LIMITS 0.00 255.0 /end CHARACTERISTIC
/begin CHARACTERISTIC DFES_Cls.DFC_MOXEMM_SMU_ALM6_8_C "fault class per DFC / Fault class for check DFC_MOXEMM_SMU_ALM6_8" VALUE 0x804D99DB Val_Wu8 30.00 DFES_OneToOne 0.00 30.00 FORMAT "%5.2" EXTENDED_LIMITS 0.00 255.0 /end CHARACTERISTIC
/begin CHARACTERISTIC DFES_Cls.DFC_MOXEMM_SMU_ALM7_1_C "fault class per DFC / Fault class for check DFC_MOXEMM_SMU_ALM7_1" VALUE 0x804D99DC Val_Wu8 30.00 DFES_OneToOne 0.00 30.00 FORMAT "%5.2" EXTENDED_LIMITS 0.00 255.0 /end CHARACTERISTIC
/begin CHARACTERISTIC DFES_Cls.DFC_MOXEMM_SMU_ALM7_12_C "fault class per DFC / Fault class for check DFC_MOXEMM_SMU_ALM7_12" VALUE 0x804D99DD Val_Wu8 30.00 DFES_OneToOne 0.00 30.00 FORMAT "%5.2" EXTENDED_LIMITS 0.00 255.0 /end CHARACTERISTIC
/begin CHARACTERISTIC DFES_Cls.DFC_MOXEMM_SMU_ALM7_13_C "fault class per DFC / Fault class for check DFC_MOXEMM_SMU_ALM7_13" VALUE 0x804D99DE Val_Wu8 30.00 DFES_OneToOne 0.00 30.00 FORMAT "%5.2" EXTENDED_LIMITS 0.00 255.0 /end CHARACTERISTIC
/begin CHARACTERISTIC DFES_Cls.DFC_MOXEMM_SMU_ALM7_14_C "fault class per DFC / Fault class for check DFC_MOXEMM_SMU_ALM7_14" VALUE 0x804D99DF Val_Wu8 30.00 DFES_OneToOne 0.00 30.00 FORMAT "%5.2" EXTENDED_LIMITS 0.00 255.0 /end CHARACTERISTIC
/begin CHARACTERISTIC DFES_Cls.DFC_MOXEMM_SMU_ALM7_15_C "fault class per DFC / Fault class for check DFC_MOXEMM_SMU_ALM7_15" VALUE 0x804D99E0 Val_Wu8 30.00 DFES_OneToOne 0.00 30.00 FORMAT "%5.2" EXTENDED_LIMITS 0.00 255.0 /end CHARACTERISTIC
/begin CHARACTERISTIC DFES_Cls.DFC_MOXEMM_SMU_ALM7_16_C "fault class per DFC / Fault class for check DFC_MOXEMM_SMU_ALM7_16" VALUE 0x804D99E1 Val_Wu8 30.00 DFES_OneToOne 0.00 30.00 FORMAT "%5.2" EXTENDED_LIMITS 0.00 255.0 /end CHARACTERISTIC
/begin CHARACTERISTIC DFES_Cls.DFC_MOXEMM_SMU_ALM7_17_C "fault class per DFC / Fault class for check DFC_MOXEMM_SMU_ALM7_17" VALUE 0x804D99E2 Val_Wu8 30.00 DFES_OneToOne 0.00 30.00 FORMAT "%5.2" EXTENDED_LIMITS 0.00 255.0 /end CHARACTERISTIC
/begin CHARACTERISTIC DFES_Cls.DFC_MOXEMM_SMU_ALM7_2_C "fault class per DFC / Fault class for check DFC_MOXEMM_SMU_ALM7_2" VALUE 0x804D99E3 Val_Wu8 30.00 DFES_OneToOne 0.00 30.00 FORMAT "%5.2" EXTENDED_LIMITS 0.00 255.0 /end CHARACTERISTIC
/begin CHARACTERISTIC DFES_Cls.DFC_MOXEMM_SMU_ALM7_20_C "fault class per DFC / Fault class for check DFC_MOXEMM_SMU_ALM7_20" VALUE 0x804D99E4 Val_Wu8 30.00 DFES_OneToOne 0.00 30.00 FORMAT "%5.2" EXTENDED_LIMITS 0.00 255.0 /end CHARACTERISTIC
/begin CHARACTERISTIC DFES_Cls.DFC_MOXEMM_SMU_ALM7_25_C "fault class per DFC / Fault class for check DFC_MOXEMM_SMU_ALM7_25" VALUE 0x804D99E5 Val_Wu8 30.00 DFES_OneToOne 0.00 30.00 FORMAT "%5.2" EXTENDED_LIMITS 0.00 255.0 /end CHARACTERISTIC
/begin CHARACTERISTIC DFES_Cls.DFC_MOXEMM_SMU_ALM7_26_C "fault class per DFC / Fault class for check DFC_MOXEMM_SMU_ALM7_26" VALUE 0x804D99E6 Val_Wu8 30.00 DFES_OneToOne 0.00 30.00 FORMAT "%5.2" EXTENDED_LIMITS 0.00 255.0 /end CHARACTERISTIC
/begin CHARACTERISTIC DFES_Cls.DFC_MOXEMM_SMU_ALM7_28_C "fault class per DFC / Fault class for check DFC_MOXEMM_SMU_ALM7_28" VALUE 0x804D99E7 Val_Wu8 30.00 DFES_OneToOne 0.00 30.00 FORMAT "%5.2" EXTENDED_LIMITS 0.00 255.0 /end CHARACTERISTIC
/begin CHARACTERISTIC DFES_Cls.DFC_MOXEMM_SMU_ALM7_29_C "fault class per DFC / Fault class for check DFC_MOXEMM_SMU_ALM7_29" VALUE 0x804D99E8 Val_Wu8 30.00 DFES_OneToOne 0.00 30.00 FORMAT "%5.2" EXTENDED_LIMITS 0.00 255.0 /end CHARACTERISTIC
/begin CHARACTERISTIC DFES_Cls.DFC_MOXEMM_SMU_ALM7_30_C "fault class per DFC / Fault class for check DFC_MOXEMM_SMU_ALM7_30" VALUE 0x804D99E9 Val_Wu8 30.00 DFES_OneToOne 0.00 30.00 FORMAT "%5.2" EXTENDED_LIMITS 0.00 255.0 /end CHARACTERISTIC
/begin CHARACTERISTIC DFES_Cls.DFC_MOXEMM_SMU_ALM7_31_C "fault class per DFC / Fault class for check DFC_MOXEMM_SMU_ALM7_31" VALUE 0x804D99EA Val_Wu8 30.00 DFES_OneToOne 0.00 30.00 FORMAT "%5.2" EXTENDED_LIMITS 0.00 255.0 /end CHARACTERISTIC
/begin CHARACTERISTIC DFES_Cls.DFC_MOXEMM_SMU_ALM8_0_C "fault class per DFC / Fault class for check DFC_MOXEMM_SMU_ALM8_0" VALUE 0x804D99EB Val_Wu8 30.00 DFES_OneToOne 0.00 30.00 FORMAT "%5.2" EXTENDED_LIMITS 0.00 255.0 /end CHARACTERISTIC
/begin CHARACTERISTIC DFES_Cls.DFC_MOXEMM_SMU_ALM8_1_C "fault class per DFC / Fault class for check DFC_MOXEMM_SMU_ALM8_1" VALUE 0x804D99EC Val_Wu8 30.00 DFES_OneToOne 0.00 30.00 FORMAT "%5.2" EXTENDED_LIMITS 0.00 255.0 /end CHARACTERISTIC
/begin CHARACTERISTIC DFES_Cls.DFC_MOXEMM_SMU_ALM8_10_C "fault class per DFC / Fault class for check DFC_MOXEMM_SMU_ALM8_10" VALUE 0x804D99ED Val_Wu8 30.00 DFES_OneToOne 0.00 30.00 FORMAT "%5.2" EXTENDED_LIMITS 0.00 255.0 /end CHARACTERISTIC
/begin CHARACTERISTIC DFES_Cls.DFC_MOXEMM_SMU_ALM8_11_C "fault class per DFC / Fault class for check DFC_MOXEMM_SMU_ALM8_11" VALUE 0x804D99EE Val_Wu8 30.00 DFES_OneToOne 0.00 30.00 FORMAT "%5.2" EXTENDED_LIMITS 0.00 255.0 /end CHARACTERISTIC
/begin CHARACTERISTIC DFES_Cls.DFC_MOXEMM_SMU_ALM8_12_C "fault class per DFC / Fault class for check DFC_MOXEMM_SMU_ALM8_12" VALUE 0x804D99EF Val_Wu8 30.00 DFES_OneToOne 0.00 30.00 FORMAT "%5.2" EXTENDED_LIMITS 0.00 255.0 /end CHARACTERISTIC
/begin CHARACTERISTIC DFES_Cls.DFC_MOXEMM_SMU_ALM8_16_C "fault class per DFC / Fault class for check DFC_MOXEMM_SMU_ALM8_16" VALUE 0x804D99F0 Val_Wu8 30.00 DFES_OneToOne 0.00 30.00 FORMAT "%5.2" EXTENDED_LIMITS 0.00 255.0 /end CHARACTERISTIC
/begin CHARACTERISTIC DFES_Cls.DFC_MOXEMM_SMU_ALM8_18_C "fault class per DFC / Fault class for check DFC_MOXEMM_SMU_ALM8_18" VALUE 0x804D99F1 Val_Wu8 30.00 DFES_OneToOne 0.00 30.00 FORMAT "%5.2" EXTENDED_LIMITS 0.00 255.0 /end CHARACTERISTIC
/begin CHARACTERISTIC DFES_Cls.DFC_MOXEMM_SMU_ALM8_2_C "fault class per DFC / Fault class for check DFC_MOXEMM_SMU_ALM8_2" VALUE 0x804D99F2 Val_Wu8 30.00 DFES_OneToOne 0.00 30.00 FORMAT "%5.2" EXTENDED_LIMITS 0.00 255.0 /end CHARACTERISTIC
/begin CHARACTERISTIC DFES_Cls.DFC_MOXEMM_SMU_ALM8_3_C "fault class per DFC / Fault class for check DFC_MOXEMM_SMU_ALM8_3" VALUE 0x804D99F3 Val_Wu8 30.00 DFES_OneToOne 0.00 30.00 FORMAT "%5.2" EXTENDED_LIMITS 0.00 255.0 /end CHARACTERISTIC
/begin CHARACTERISTIC DFES_Cls.DFC_MOXEMM_SMU_ALM8_31_C "fault class per DFC / Fault class for check DFC_MOXEMM_SMU_ALM8_31" VALUE 0x804D99F4 Val_Wu8 30.00 DFES_OneToOne 0.00 30.00 FORMAT "%5.2" EXTENDED_LIMITS 0.00 255.0 /end CHARACTERISTIC
/begin CHARACTERISTIC DFES_Cls.DFC_MOXEMM_SMU_ALM8_4_C "fault class per DFC / Fault class for check DFC_MOXEMM_SMU_ALM8_4" VALUE 0x804D99F5 Val_Wu8 30.00 DFES_OneToOne 0.00 30.00 FORMAT "%5.2" EXTENDED_LIMITS 0.00 255.0 /end CHARACTERISTIC
/begin CHARACTERISTIC DFES_Cls.DFC_MOXEMM_SMU_ALM9_0_C "fault class per DFC / Fault class for check DFC_MOXEMM_SMU_ALM9_0" VALUE 0x804D99F6 Val_Wu8 30.00 DFES_OneToOne 0.00 30.00 FORMAT "%5.2" EXTENDED_LIMITS 0.00 255.0 /end CHARACTERISTIC
/begin CHARACTERISTIC DFES_Cls.DFC_MOXEMM_SMU_ALM9_15_C "fault class per DFC / Fault class for check DFC_MOXEMM_SMU_ALM9_15" VALUE 0x804D99F7 Val_Wu8 30.00 DFES_OneToOne 0.00 30.00 FORMAT "%5.2" EXTENDED_LIMITS 0.00 255.0 /end CHARACTERISTIC
/begin CHARACTERISTIC DFES_Cls.DFC_MOXEMM_SMU_ALM9_3_C "fault class per DFC / Fault class for check DFC_MOXEMM_SMU_ALM9_3" VALUE 0x804D99F8 Val_Wu8 30.00 DFES_OneToOne 0.00 30.00 FORMAT "%5.2" EXTENDED_LIMITS 0.00 255.0 /end CHARACTERISTIC
/begin CHARACTERISTIC DFES_Cls.DFC_MoCADCNTP_C "fault class per DFC / Fault class for check DFC_MoCADCNTP" VALUE 0x804D99F9 Val_Wu8 30.00 DFES_OneToOne 0.00 30.00 FORMAT "%5.2" EXTENDED_LIMITS 0.00 255.0 /end CHARACTERISTIC
/begin CHARACTERISTIC DFES_Cls.DFC_MoCADCTst_C "fault class per DFC / Fault class for check DFC_MoCADCTst" VALUE 0x804D99FA Val_Wu8 30.00 DFES_OneToOne 0.00 30.00 FORMAT "%5.2" EXTENDED_LIMITS 0.00 255.0 /end CHARACTERISTIC
/begin CHARACTERISTIC DFES_Cls.DFC_MoCSOPICO_C "fault class per DFC / Fault class for check DFC_MoCSOPICO" VALUE 0x804D99FB Val_Wu8 30.00 DFES_OneToOne 0.00 30.00 FORMAT "%5.2" EXTENDED_LIMITS 0.00 255.0 /end CHARACTERISTIC
/begin CHARACTERISTIC DFES_Cls.DFC_MoFAPP_C "fault class per DFC / Fault class for check DFC_MoFAPP" VALUE 0x804D99FC Val_Wu8 30.00 DFES_OneToOne 0.00 30.00 FORMAT "%5.2" EXTENDED_LIMITS 0.00 255.0 /end CHARACTERISTIC
/begin CHARACTERISTIC DFES_Cls.DFC_MoFAirFilgPrdc_C "fault class per DFC / Fault class for check DFC_MoFAirFilgPrdc" VALUE 0x804D99FD Val_Wu8 30.00 DFES_OneToOne 0.00 30.00 FORMAT "%5.2" EXTENDED_LIMITS 0.00 255.0 /end CHARACTERISTIC
/begin CHARACTERISTIC DFES_Cls.DFC_MoFAirFlCtOffGdi_C "fault class per DFC / Fault class for check DFC_MoFAirFlCtOffGdi" VALUE 0x804D99FE Val_Wu8 30.00 DFES_OneToOne 0.00 30.00 FORMAT "%5.2" EXTENDED_LIMITS 0.00 255.0 /end CHARACTERISTIC
/begin CHARACTERISTIC DFES_Cls.DFC_MoFAirFlCylGdi_C "fault class per DFC / Fault class for check DFC_MoFAirFlCylGdi" VALUE 0x804D99FF Val_Wu8 30.00 DFES_OneToOne 0.00 30.00 FORMAT "%5.2" EXTENDED_LIMITS 0.00 255.0 /end CHARACTERISTIC
/begin CHARACTERISTIC DFES_Cls.DFC_MoFAirFlFF_C "fault class per DFC / Fault class for check DFC_MoFAirFlFF" VALUE 0x804D9A00 Val_Wu8 30.00 DFES_OneToOne 0.00 30.00 FORMAT "%5.2" EXTENDED_LIMITS 0.00 255.0 /end CHARACTERISTIC
/begin CHARACTERISTIC DFES_Cls.DFC_MoFAirFlIn_C "fault class per DFC / Fault class for check DFC_MoFAirFlIn" VALUE 0x804D9A01 Val_Wu8 30.00 DFES_OneToOne 0.00 30.00 FORMAT "%5.2" EXTENDED_LIMITS 0.00 255.0 /end CHARACTERISTIC
/begin CHARACTERISTIC DFES_Cls.DFC_MoFAirFlMixCtlGdiChkAirFl_C "fault class per DFC / Fault class for check DFC_MoFAirFlMixCtlGdiChkAirFl" VALUE 0x804D9A02 Val_Wu8 30.00 DFES_OneToOne 0.00 30.00 FORMAT "%5.2" EXTENDED_LIMITS 0.00 255.0 /end CHARACTERISTIC
/begin CHARACTERISTIC DFES_Cls.DFC_MoFAirFlMixCtlGdiChkCtrl_C "fault class per DFC / Fault class for check DFC_MoFAirFlMixCtlGdiChkCtrl" VALUE 0x804D9A03 Val_Wu8 30.00 DFES_OneToOne 0.00 30.00 FORMAT "%5.2" EXTENDED_LIMITS 0.00 255.0 /end CHARACTERISTIC
/begin CHARACTERISTIC DFES_Cls.DFC_MoFAirFlMode_C "fault class per DFC / Fault class for check DFC_MoFAirFlMode" VALUE 0x804D9A04 Val_Wu8 30.00 DFES_OneToOne 0.00 30.00 FORMAT "%5.2" EXTENDED_LIMITS 0.00 255.0 /end CHARACTERISTIC
/begin CHARACTERISTIC DFES_Cls.DFC_MoFESpd_C "fault class per DFC / Fault class for check DFC_MoFESpd" VALUE 0x804D9A05 Val_Wu8 30.00 DFES_OneToOne 0.00 30.00 FORMAT "%5.2" EXTENDED_LIMITS 0.00 255.0 /end CHARACTERISTIC
/begin CHARACTERISTIC DFES_Cls.DFC_MoFIACo_C "fault class per DFC / Fault class for check DFC_MoFIACo" VALUE 0x804D9A06 Val_Wu8 30.00 DFES_OneToOne 0.00 30.00 FORMAT "%5.2" EXTENDED_LIMITS 0.00 255.0 /end CHARACTERISTIC
/begin CHARACTERISTIC DFES_Cls.DFC_MoFICOL1_C "fault class per DFC / Fault class for check DFC_MoFICOL1" VALUE 0x804D9A07 Val_Wu8 30.00 DFES_OneToOne 0.00 30.00 FORMAT "%5.2" EXTENDED_LIMITS 0.00 255.0 /end CHARACTERISTIC
/begin CHARACTERISTIC DFES_Cls.DFC_MoFICOL2_C "fault class per DFC / Fault class for check DFC_MoFICOL2" VALUE 0x804D9A08 Val_Wu8 30.00 DFES_OneToOne 0.00 30.00 FORMAT "%5.2" EXTENDED_LIMITS 0.00 255.0 /end CHARACTERISTIC
/begin CHARACTERISTIC DFES_Cls.DFC_MoFStrt_C "fault class per DFC / Fault class for check DFC_MoFStrt" VALUE 0x804D9A09 Val_Wu8 30.00 DFES_OneToOne 0.00 30.00 FORMAT "%5.2" EXTENDED_LIMITS 0.00 255.0 /end CHARACTERISTIC
/begin CHARACTERISTIC DFES_Cls.DFC_MoFTrqCmp_C "fault class per DFC / Fault class for check DFC_MoFTrqCmp" VALUE 0x804D9A0A Val_Wu8 30.00 DFES_OneToOne 0.00 30.00 FORMAT "%5.2" EXTENDED_LIMITS 0.00 255.0 /end CHARACTERISTIC
/begin CHARACTERISTIC DFES_Cls.DFC_MoFTrqCmpMax_C "fault class per DFC / Fault class for check DFC_MoFTrqCmpMax" VALUE 0x804D9A0B Val_Wu8 30.00 DFES_OneToOne 0.00 30.00 FORMAT "%5.2" EXTENDED_LIMITS 0.00 255.0 /end CHARACTERISTIC
/begin CHARACTERISTIC DFES_Cls.DFC_MoFTrqCmpMin_C "fault class per DFC / Fault class for check DFC_MoFTrqCmpMin" VALUE 0x804D9A0C Val_Wu8 30.00 DFES_OneToOne 0.00 30.00 FORMAT "%5.2" EXTENDED_LIMITS 0.00 255.0 /end CHARACTERISTIC
/begin CHARACTERISTIC DFES_Cls.DFC_MoFVarPostBldSel_C "fault class per DFC / Fault class for check DFC_MoFVarPostBldSel" VALUE 0x804D9A0D Val_Wu8 30.00 DFES_OneToOne 0.00 30.00 FORMAT "%5.2" EXTENDED_LIMITS 0.00 255.0 /end CHARACTERISTIC
/begin CHARACTERISTIC DFES_Cls.DFC_MoXEMMHwLTMCUFW_C "fault class per DFC / Fault class for check DFC_MoXEMMHwLTMCUFW" VALUE 0x804D9A0E Val_Wu8 30.00 DFES_OneToOne 0.00 30.00 FORMAT "%5.2" EXTENDED_LIMITS 0.00 255.0 /end CHARACTERISTIC
/begin CHARACTERISTIC DFES_Cls.DFC_MoXEMMHwLTMonBIST_C "fault class per DFC / Fault class for check DFC_MoXEMMHwLTMonBIST" VALUE 0x804D9A0F Val_Wu8 30.00 DFES_OneToOne 0.00 30.00 FORMAT "%5.2" EXTENDED_LIMITS 0.00 255.0 /end CHARACTERISTIC
/begin CHARACTERISTIC DFES_Cls.DFC_MoXEMMHwLTRegMonTest_C "fault class per DFC / Fault class for check DFC_MoXEMMHwLTRegMonTest" VALUE 0x804D9A10 Val_Wu8 30.00 DFES_OneToOne 0.00 30.00 FORMAT "%5.2" EXTENDED_LIMITS 0.00 255.0 /end CHARACTERISTIC
/begin CHARACTERISTIC DFES_Cls.DFC_MoXEMMHwLTStbySMUAlvTest_C "fault class per DFC / Fault class for check DFC_MoXEMMHwLTStbySMUAlvTest" VALUE 0x804D9A11 Val_Wu8 30.00 DFES_OneToOne 0.00 30.00 FORMAT "%5.2" EXTENDED_LIMITS 0.00 255.0 /end CHARACTERISTIC
/begin CHARACTERISTIC DFES_Cls.DFC_MoXEMMHwLTTempSens_C "fault class per DFC / Fault class for check DFC_MoXEMMHwLTTempSens" VALUE 0x804D9A12 Val_Wu8 30.00 DFES_OneToOne 0.00 30.00 FORMAT "%5.2" EXTENDED_LIMITS 0.00 255.0 /end CHARACTERISTIC
/begin CHARACTERISTIC DFES_Cls.DFC_MoXEMMHwLTUCBCfg_C "fault class per DFC / Fault class for check DFC_MoXEMMHwLTUCBCfg" VALUE 0x804D9A13 Val_Wu8 30.00 DFES_OneToOne 0.00 30.00 FORMAT "%5.2" EXTENDED_LIMITS 0.00 255.0 /end CHARACTERISTIC
/begin CHARACTERISTIC DFES_Cls.DFC_NWSEmax_C "fault class per DFC / Fault class for check DFC_NWSEmax" VALUE 0x804D9A14 Val_Wu8 30.00 DFES_OneToOne 0.00 30.00 FORMAT "%5.2" EXTENDED_LIMITS 0.00 255.0 /end CHARACTERISTIC
/begin CHARACTERISTIC DFES_Cls.DFC_NWSmax_C "fault class per DFC / Fault class for check DFC_NWSmax" VALUE 0x804D9A15 Val_Wu8 30.00 DFES_OneToOne 0.00 30.00 FORMAT "%5.2" EXTENDED_LIMITS 0.00 255.0 /end CHARACTERISTIC
/begin CHARACTERISTIC DFES_Cls.DFC_OCWDAABEActv_C "fault class per DFC / Fault class for check DFC_OCWDAABEActv" VALUE 0x804D9A16 Val_Wu8 30.00 DFES_OneToOne 0.00 30.00 FORMAT "%5.2" EXTENDED_LIMITS 0.00 255.0 /end CHARACTERISTIC
/begin CHARACTERISTIC DFES_Cls.DFC_OCWDACom_C "fault class per DFC / Fault class for check DFC_OCWDACom" VALUE 0x804D9A17 Val_Wu8 30.00 DFES_OneToOne 0.00 30.00 FORMAT "%5.2" EXTENDED_LIMITS 0.00 255.0 /end CHARACTERISTIC
/begin CHARACTERISTIC DFES_Cls.DFC_OCWDAErrPin_C "fault class per DFC / Fault class for check DFC_OCWDAErrPin" VALUE 0x804D9A18 Val_Wu8 30.00 DFES_OneToOne 0.00 30.00 FORMAT "%5.2" EXTENDED_LIMITS 0.00 255.0 /end CHARACTERISTIC
/begin CHARACTERISTIC DFES_Cls.DFC_OCWDAOvrVltg_C "fault class per DFC / Fault class for check DFC_OCWDAOvrVltg" VALUE 0x804D9A19 Val_Wu8 30.00 DFES_OneToOne 0.00 30.00 FORMAT "%5.2" EXTENDED_LIMITS 0.00 255.0 /end CHARACTERISTIC
/begin CHARACTERISTIC DFES_Cls.DFC_ORAmax_C "fault class per DFC / Fault class for check DFC_ORAmax" VALUE 0x804D9A1A Val_Wu8 30.00 DFES_OneToOne 0.00 30.00 FORMAT "%5.2" EXTENDED_LIMITS 0.00 255.0 /end CHARACTERISTIC
/begin CHARACTERISTIC DFES_Cls.DFC_ORAmin_C "fault class per DFC / Fault class for check DFC_ORAmin" VALUE 0x804D9A1B Val_Wu8 30.00 DFES_OneToOne 0.00 30.00 FORMAT "%5.2" EXTENDED_LIMITS 0.00 255.0 /end CHARACTERISTIC
/begin CHARACTERISTIC DFES_Cls.DFC_OilPPlaus_C "fault class per DFC / Fault class for check DFC_OilPPlaus" VALUE 0x804D9A1C Val_Wu8 30.00 DFES_OneToOne 0.00 30.00 FORMAT "%5.2" EXTENDED_LIMITS 0.00 255.0 /end CHARACTERISTIC
/begin CHARACTERISTIC DFES_Cls.DFC_PLLSUmax_C "fault class per DFC / Fault class for check DFC_PLLSUmax" VALUE 0x804D9A1D Val_Wu8 30.00 DFES_OneToOne 0.00 30.00 FORMAT "%5.2" EXTENDED_LIMITS 0.00 255.0 /end CHARACTERISTIC
/begin CHARACTERISTIC DFES_Cls.DFC_PLLSUmin_C "fault class per DFC / Fault class for check DFC_PLLSUmin" VALUE 0x804D9A1E Val_Wu8 30.00 DFES_OneToOne 0.00 30.00 FORMAT "%5.2" EXTENDED_LIMITS 0.00 255.0 /end CHARACTERISTIC
/begin CHARACTERISTIC DFES_Cls.DFC_PSR1max_C "fault class per DFC / Fault class for check DFC_PSR1max" VALUE 0x804D9A1F Val_Wu8 30.00 DFES_OneToOne 0.00 30.00 FORMAT "%5.2" EXTENDED_LIMITS 0.00 255.0 /end CHARACTERISTIC
/begin CHARACTERISTIC DFES_Cls.DFC_PSRBmax_C "fault class per DFC / Fault class for check DFC_PSRBmax" VALUE 0x804D9A20 Val_Wu8 30.00 DFES_OneToOne 0.00 30.00 FORMAT "%5.2" EXTENDED_LIMITS 0.00 255.0 /end CHARACTERISTIC
/begin CHARACTERISTIC DFES_Cls.DFC_PSRBmin_C "fault class per DFC / Fault class for check DFC_PSRBmin" VALUE 0x804D9A21 Val_Wu8 30.00 DFES_OneToOne 0.00 30.00 FORMAT "%5.2" EXTENDED_LIMITS 0.00 255.0 /end CHARACTERISTIC
/begin CHARACTERISTIC DFES_Cls.DFC_PSRPmax_C "fault class per DFC / Fault class for check DFC_PSRPmax" VALUE 0x804D9A22 Val_Wu8 30.00 DFES_OneToOne 0.00 30.00 FORMAT "%5.2" EXTENDED_LIMITS 0.00 255.0 /end CHARACTERISTIC
/begin CHARACTERISTIC DFES_Cls.DFC_PSRPmin_C "fault class per DFC / Fault class for check DFC_PSRPmin" VALUE 0x804D9A23 Val_Wu8 30.00 DFES_OneToOne 0.00 30.00 FORMAT "%5.2" EXTENDED_LIMITS 0.00 255.0 /end CHARACTERISTIC
/begin CHARACTERISTIC DFES_Cls.DFC_PSRPsig_C "fault class per DFC / Fault class for check DFC_PSRPsig" VALUE 0x804D9A24 Val_Wu8 30.00 DFES_OneToOne 0.00 30.00 FORMAT "%5.2" EXTENDED_LIMITS 0.00 255.0 /end CHARACTERISTIC
/begin CHARACTERISTIC DFES_Cls.DFC_PSRmax_C "fault class per DFC / Fault class for check DFC_PSRmax" VALUE 0x804D9A25 Val_Wu8 30.00 DFES_OneToOne 0.00 30.00 FORMAT "%5.2" EXTENDED_LIMITS 0.00 255.0 /end CHARACTERISTIC
/begin CHARACTERISTIC DFES_Cls.DFC_PUmax_C "fault class per DFC / Fault class for check DFC_PUmax" VALUE 0x804D9A26 Val_Wu8 30.00 DFES_OneToOne 0.00 30.00 FORMAT "%5.2" EXTENDED_LIMITS 0.00 255.0 /end CHARACTERISTIC
/begin CHARACTERISTIC DFES_Cls.DFC_P_VSE11_OL_C "fault class per DFC / Fault class for check DFC_P_VSE11_OL" VALUE 0x804D9A27 Val_Wu8 30.00 DFES_OneToOne 0.00 30.00 FORMAT "%5.2" EXTENDED_LIMITS 0.00 255.0 /end CHARACTERISTIC
/begin CHARACTERISTIC DFES_Cls.DFC_P_VSE11_SCB_C "fault class per DFC / Fault class for check DFC_P_VSE11_SCB" VALUE 0x804D9A28 Val_Wu8 30.00 DFES_OneToOne 0.00 30.00 FORMAT "%5.2" EXTENDED_LIMITS 0.00 255.0 /end CHARACTERISTIC
/begin CHARACTERISTIC DFES_Cls.DFC_P_VSE11_SCG_C "fault class per DFC / Fault class for check DFC_P_VSE11_SCG" VALUE 0x804D9A29 Val_Wu8 30.00 DFES_OneToOne 0.00 30.00 FORMAT "%5.2" EXTENDED_LIMITS 0.00 255.0 /end CHARACTERISTIC
/begin CHARACTERISTIC DFES_Cls.DFC_PhyHighAPP1_C "fault class per DFC / Fault class for check DFC_PhyHighAPP1" VALUE 0x804D9A2A Val_Wu8 30.00 DFES_OneToOne 0.00 30.00 FORMAT "%5.2" EXTENDED_LIMITS 0.00 255.0 /end CHARACTERISTIC
/begin CHARACTERISTIC DFES_Cls.DFC_PhyHighAPP2_C "fault class per DFC / Fault class for check DFC_PhyHighAPP2" VALUE 0x804D9A2B Val_Wu8 30.00 DFES_OneToOne 0.00 30.00 FORMAT "%5.2" EXTENDED_LIMITS 0.00 255.0 /end CHARACTERISTIC
/begin CHARACTERISTIC DFES_Cls.DFC_PhyLowAPP1_C "fault class per DFC / Fault class for check DFC_PhyLowAPP1" VALUE 0x804D9A2C Val_Wu8 30.00 DFES_OneToOne 0.00 30.00 FORMAT "%5.2" EXTENDED_LIMITS 0.00 255.0 /end CHARACTERISTIC
/begin CHARACTERISTIC DFES_Cls.DFC_PhyLowAPP2_C "fault class per DFC / Fault class for check DFC_PhyLowAPP2" VALUE 0x804D9A2D Val_Wu8 30.00 DFES_OneToOne 0.00 30.00 FORMAT "%5.2" EXTENDED_LIMITS 0.00 255.0 /end CHARACTERISTIC
/begin CHARACTERISTIC DFES_Cls.DFC_SRCHighAPP1_C "fault class per DFC / Fault class for check DFC_SRCHighAPP1" VALUE 0x804D9A2E Val_Wu8 30.00 DFES_OneToOne 0.00 30.00 FORMAT "%5.2" EXTENDED_LIMITS 0.00 255.0 /end CHARACTERISTIC
/begin CHARACTERISTIC DFES_Cls.DFC_SRCHighAPP2_C "fault class per DFC / Fault class for check DFC_SRCHighAPP2" VALUE 0x804D9A2F Val_Wu8 30.00 DFES_OneToOne 0.00 30.00 FORMAT "%5.2" EXTENDED_LIMITS 0.00 255.0 /end CHARACTERISTIC
/begin CHARACTERISTIC DFES_Cls.DFC_SRCLowAPP1_C "fault class per DFC / Fault class for check DFC_SRCLowAPP1" VALUE 0x804D9A30 Val_Wu8 30.00 DFES_OneToOne 0.00 30.00 FORMAT "%5.2" EXTENDED_LIMITS 0.00 255.0 /end CHARACTERISTIC
/begin CHARACTERISTIC DFES_Cls.DFC_SRCLowAPP2_C "fault class per DFC / Fault class for check DFC_SRCLowAPP2" VALUE 0x804D9A31 Val_Wu8 30.00 DFES_OneToOne 0.00 30.00 FORMAT "%5.2" EXTENDED_LIMITS 0.00 255.0 /end CHARACTERISTIC
/begin CHARACTERISTIC DFES_Cls.DFC_SSpMon2_C "fault class per DFC / Fault class for check DFC_SSpMon2" VALUE 0x804D9A32 Val_Wu8 30.00 DFES_OneToOne 0.00 30.00 FORMAT "%5.2" EXTENDED_LIMITS 0.00 255.0 /end CHARACTERISTIC
/begin CHARACTERISTIC DFES_Cls.DFC_STHDRmax_C "fault class per DFC / Fault class for check DFC_STHDRmax" VALUE 0x804D9A33 Val_Wu8 30.00 DFES_OneToOne 0.00 30.00 FORMAT "%5.2" EXTENDED_LIMITS 0.00 255.0 /end CHARACTERISTIC
/begin CHARACTERISTIC DFES_Cls.DFC_SWReset_0_C "fault class per DFC / Fault class for check DFC_SWReset_0" VALUE 0x804D9A34 Val_Wu8 30.00 DFES_OneToOne 0.00 30.00 FORMAT "%5.2" EXTENDED_LIMITS 0.00 255.0 /end CHARACTERISTIC
/begin CHARACTERISTIC DFES_Cls.DFC_SWReset_1_C "fault class per DFC / Fault class for check DFC_SWReset_1" VALUE 0x804D9A35 Val_Wu8 30.00 DFES_OneToOne 0.00 30.00 FORMAT "%5.2" EXTENDED_LIMITS 0.00 255.0 /end CHARACTERISTIC
/begin CHARACTERISTIC DFES_Cls.DFC_SWReset_2_C "fault class per DFC / Fault class for check DFC_SWReset_2" VALUE 0x804D9A36 Val_Wu8 30.00 DFES_OneToOne 0.00 30.00 FORMAT "%5.2" EXTENDED_LIMITS 0.00 255.0 /end CHARACTERISTIC
/begin CHARACTERISTIC DFES_Cls.DFC_SyncAPP_C "fault class per DFC / Fault class for check DFC_SyncAPP" VALUE 0x804D9A37 Val_Wu8 30.00 DFES_OneToOne 0.00 30.00 FORMAT "%5.2" EXTENDED_LIMITS 0.00 255.0 /end CHARACTERISTIC
/begin CHARACTERISTIC DFES_Cls.DFC_TANKLnpl_C "fault class per DFC / Fault class for check DFC_TANKLnpl" VALUE 0x804D9A38 Val_Wu8 30.00 DFES_OneToOne 0.00 30.00 FORMAT "%5.2" EXTENDED_LIMITS 0.00 255.0 /end CHARACTERISTIC
/begin CHARACTERISTIC DFES_Cls.DFC_TAmax_Dummy_C "fault class per DFC / Fault class for check DFC_TAmax_Dummy" VALUE 0x804D9A39 Val_Wu8 30.00 DFES_OneToOne 0.00 30.00 FORMAT "%5.2" EXTENDED_LIMITS 0.00 255.0 /end CHARACTERISTIC
/begin CHARACTERISTIC DFES_Cls.DFC_TESFmax_C "fault class per DFC / Fault class for check DFC_TESFmax" VALUE 0x804D9A3A Val_Wu8 30.00 DFES_OneToOne 0.00 30.00 FORMAT "%5.2" EXTENDED_LIMITS 0.00 255.0 /end CHARACTERISTIC
/begin CHARACTERISTIC DFES_Cls.DFC_TESGmax_C "fault class per DFC / Fault class for check DFC_TESGmax" VALUE 0x804D9A3B Val_Wu8 30.00 DFES_OneToOne 0.00 30.00 FORMAT "%5.2" EXTENDED_LIMITS 0.00 255.0 /end CHARACTERISTIC
/begin CHARACTERISTIC DFES_Cls.DFC_TKAEmax_C "fault class per DFC / Fault class for check DFC_TKAEmax" VALUE 0x804D9A3C Val_Wu8 30.00 DFES_OneToOne 0.00 30.00 FORMAT "%5.2" EXTENDED_LIMITS 0.00 255.0 /end CHARACTERISTIC
/begin CHARACTERISTIC DFES_Cls.DFC_TKAEmin_C "fault class per DFC / Fault class for check DFC_TKAEmin" VALUE 0x804D9A3D Val_Wu8 30.00 DFES_OneToOne 0.00 30.00 FORMAT "%5.2" EXTENDED_LIMITS 0.00 255.0 /end CHARACTERISTIC
/begin CHARACTERISTIC DFES_Cls.DFC_TKARmax_C "fault class per DFC / Fault class for check DFC_TKARmax" VALUE 0x804D9A3E Val_Wu8 30.00 DFES_OneToOne 0.00 30.00 FORMAT "%5.2" EXTENDED_LIMITS 0.00 255.0 /end CHARACTERISTIC
/begin CHARACTERISTIC DFES_Cls.DFC_TKARnpl_C "fault class per DFC / Fault class for check DFC_TKARnpl" VALUE 0x804D9A3F Val_Wu8 30.00 DFES_OneToOne 0.00 30.00 FORMAT "%5.2" EXTENDED_LIMITS 0.00 255.0 /end CHARACTERISTIC
/begin CHARACTERISTIC DFES_Cls.DFC_TMmax_Dummy_C "fault class per DFC / Fault class for check DFC_TMmax_Dummy" VALUE 0x804D9A40 Val_Wu8 30.00 DFES_OneToOne 0.00 30.00 FORMAT "%5.2" EXTENDED_LIMITS 0.00 255.0 /end CHARACTERISTIC
/begin CHARACTERISTIC DFES_Cls.DFC_TUMmax_Dummy_C "fault class per DFC / Fault class for check DFC_TUMmax_Dummy" VALUE 0x804D9A41 Val_Wu8 30.00 DFES_OneToOne 0.00 30.00 FORMAT "%5.2" EXTENDED_LIMITS 0.00 255.0 /end CHARACTERISTIC
/begin CHARACTERISTIC DFES_Cls.DFC_TWCDPriCatB1_C "fault class per DFC / Fault class for check DFC_TWCDPriCatB1" VALUE 0x804D9A42 Val_Wu8 30.00 DFES_OneToOne 0.00 30.00 FORMAT "%5.2" EXTENDED_LIMITS 0.00 255.0 /end CHARACTERISTIC
/begin CHARACTERISTIC DFES_Cls.DFC_ThrVlvClsdPosnFirstOffsLrnImpoB1_C "fault class per DFC / Fault class for check DFC_ThrVlvClsdPosnFirstOffsLrnImpoB1" VALUE 0x804D9A43 Val_Wu8 30.00 DFES_OneToOne 0.00 30.00 FORMAT "%5.2" EXTENDED_LIMITS 0.00 255.0 /end CHARACTERISTIC
/begin CHARACTERISTIC DFES_Cls.DFC_ThrVlvClsdPosnOffsLrnImpoB1_C "fault class per DFC / Fault class for check DFC_ThrVlvClsdPosnOffsLrnImpoB1" VALUE 0x804D9A44 Val_Wu8 30.00 DFES_OneToOne 0.00 30.00 FORMAT "%5.2" EXTENDED_LIMITS 0.00 255.0 /end CHARACTERISTIC
/begin CHARACTERISTIC DFES_Cls.DFC_ThrVlvClsdPosnOffsLrnMaxB1_C "fault class per DFC / Fault class for check DFC_ThrVlvClsdPosnOffsLrnMaxB1" VALUE 0x804D9A45 Val_Wu8 30.00 DFES_OneToOne 0.00 30.00 FORMAT "%5.2" EXTENDED_LIMITS 0.00 255.0 /end CHARACTERISTIC
/begin CHARACTERISTIC DFES_Cls.DFC_ThrVlvClsdPosnOffsLrnMinB1_C "fault class per DFC / Fault class for check DFC_ThrVlvClsdPosnOffsLrnMinB1" VALUE 0x804D9A46 Val_Wu8 30.00 DFES_OneToOne 0.00 30.00 FORMAT "%5.2" EXTENDED_LIMITS 0.00 255.0 /end CHARACTERISTIC
/begin CHARACTERISTIC DFES_Cls.DFC_ThrVlvCtrlDeB1_C "fault class per DFC / Fault class for check DFC_ThrVlvCtrlDeB1" VALUE 0x804D9A47 Val_Wu8 30.00 DFES_OneToOne 0.00 30.00 FORMAT "%5.2" EXTENDED_LIMITS 0.00 255.0 /end CHARACTERISTIC
/begin CHARACTERISTIC DFES_Cls.DFC_ThrVlvDycB1_C "fault class per DFC / Fault class for check DFC_ThrVlvDycB1" VALUE 0x804D9A48 Val_Wu8 30.00 DFES_OneToOne 0.00 30.00 FORMAT "%5.2" EXTENDED_LIMITS 0.00 255.0 /end CHARACTERISTIC
/begin CHARACTERISTIC DFES_Cls.DFC_ThrVlvLimpAirPosnMaxAbsltDriftB1_C "fault class per DFC / Fault class for check DFC_ThrVlvLimpAirPosnMaxAbsltDriftB1" VALUE 0x804D9A49 Val_Wu8 30.00 DFES_OneToOne 0.00 30.00 FORMAT "%5.2" EXTENDED_LIMITS 0.00 255.0 /end CHARACTERISTIC
/begin CHARACTERISTIC DFES_Cls.DFC_ThrVlvLimpAirPosnMaxB1_C "fault class per DFC / Fault class for check DFC_ThrVlvLimpAirPosnMaxB1" VALUE 0x804D9A4A Val_Wu8 30.00 DFES_OneToOne 0.00 30.00 FORMAT "%5.2" EXTENDED_LIMITS 0.00 255.0 /end CHARACTERISTIC
/begin CHARACTERISTIC DFES_Cls.DFC_ThrVlvLimpAirPosnMaxRelDriftB1_C "fault class per DFC / Fault class for check DFC_ThrVlvLimpAirPosnMaxRelDriftB1" VALUE 0x804D9A4B Val_Wu8 30.00 DFES_OneToOne 0.00 30.00 FORMAT "%5.2" EXTENDED_LIMITS 0.00 255.0 /end CHARACTERISTIC
/begin CHARACTERISTIC DFES_Cls.DFC_ThrVlvLimpAirPosnMinB1_C "fault class per DFC / Fault class for check DFC_ThrVlvLimpAirPosnMinB1" VALUE 0x804D9A4C Val_Wu8 30.00 DFES_OneToOne 0.00 30.00 FORMAT "%5.2" EXTENDED_LIMITS 0.00 255.0 /end CHARACTERISTIC
/begin CHARACTERISTIC DFES_Cls.DFC_ThrVlvOpenLoadB1_C "fault class per DFC / Fault class for check DFC_ThrVlvOpenLoadB1" VALUE 0x804D9A4D Val_Wu8 30.00 DFES_OneToOne 0.00 30.00 FORMAT "%5.2" EXTENDED_LIMITS 0.00 255.0 /end CHARACTERISTIC
/begin CHARACTERISTIC DFES_Cls.DFC_ThrVlvOpenSprgB1_C "fault class per DFC / Fault class for check DFC_ThrVlvOpenSprgB1" VALUE 0x804D9A4E Val_Wu8 30.00 DFES_OneToOne 0.00 30.00 FORMAT "%5.2" EXTENDED_LIMITS 0.00 255.0 /end CHARACTERISTIC
/begin CHARACTERISTIC DFES_Cls.DFC_ThrVlvOpenSprgSprdB1_C "fault class per DFC / Fault class for check DFC_ThrVlvOpenSprgSprdB1" VALUE 0x804D9A4F Val_Wu8 30.00 DFES_OneToOne 0.00 30.00 FORMAT "%5.2" EXTENDED_LIMITS 0.00 255.0 /end CHARACTERISTIC
/begin CHARACTERISTIC DFES_Cls.DFC_ThrVlvOpenSprgTwnB1_C "fault class per DFC / Fault class for check DFC_ThrVlvOpenSprgTwnB1" VALUE 0x804D9A50 Val_Wu8 30.00 DFES_OneToOne 0.00 30.00 FORMAT "%5.2" EXTENDED_LIMITS 0.00 255.0 /end CHARACTERISTIC
/begin CHARACTERISTIC DFES_Cls.DFC_ThrVlvOverTB1_C "fault class per DFC / Fault class for check DFC_ThrVlvOverTB1" VALUE 0x804D9A51 Val_Wu8 30.00 DFES_OneToOne 0.00 30.00 FORMAT "%5.2" EXTENDED_LIMITS 0.00 255.0 /end CHARACTERISTIC
/begin CHARACTERISTIC DFES_Cls.DFC_ThrVlvRetSprgB1_C "fault class per DFC / Fault class for check DFC_ThrVlvRetSprgB1" VALUE 0x804D9A52 Val_Wu8 30.00 DFES_OneToOne 0.00 30.00 FORMAT "%5.2" EXTENDED_LIMITS 0.00 255.0 /end CHARACTERISTIC
/begin CHARACTERISTIC DFES_Cls.DFC_ThrVlvRetSprgSprdB1_C "fault class per DFC / Fault class for check DFC_ThrVlvRetSprgSprdB1" VALUE 0x804D9A53 Val_Wu8 30.00 DFES_OneToOne 0.00 30.00 FORMAT "%5.2" EXTENDED_LIMITS 0.00 255.0 /end CHARACTERISTIC
/begin CHARACTERISTIC DFES_Cls.DFC_ThrVlvRetSprgTwnB1_C "fault class per DFC / Fault class for check DFC_ThrVlvRetSprgTwnB1" VALUE 0x804D9A54 Val_Wu8 30.00 DFES_OneToOne 0.00 30.00 FORMAT "%5.2" EXTENDED_LIMITS 0.00 255.0 /end CHARACTERISTIC
/begin CHARACTERISTIC DFES_Cls.DFC_ThrVlvSens1MaxB1_C "fault class per DFC / Fault class for check DFC_ThrVlvSens1MaxB1" VALUE 0x804D9A55 Val_Wu8 30.00 DFES_OneToOne 0.00 30.00 FORMAT "%5.2" EXTENDED_LIMITS 0.00 255.0 /end CHARACTERISTIC
/begin CHARACTERISTIC DFES_Cls.DFC_ThrVlvSens1NplB1_C "fault class per DFC / Fault class for check DFC_ThrVlvSens1NplB1" VALUE 0x804D9A56 Val_Wu8 30.00 DFES_OneToOne 0.00 30.00 FORMAT "%5.2" EXTENDED_LIMITS 0.00 255.0 /end CHARACTERISTIC
/begin CHARACTERISTIC DFES_Cls.DFC_ThrVlvSens2MaxB1_C "fault class per DFC / Fault class for check DFC_ThrVlvSens2MaxB1" VALUE 0x804D9A57 Val_Wu8 30.00 DFES_OneToOne 0.00 30.00 FORMAT "%5.2" EXTENDED_LIMITS 0.00 255.0 /end CHARACTERISTIC
/begin CHARACTERISTIC DFES_Cls.DFC_ThrVlvSens2MinB1_C "fault class per DFC / Fault class for check DFC_ThrVlvSens2MinB1" VALUE 0x804D9A58 Val_Wu8 30.00 DFES_OneToOne 0.00 30.00 FORMAT "%5.2" EXTENDED_LIMITS 0.00 255.0 /end CHARACTERISTIC
/begin CHARACTERISTIC DFES_Cls.DFC_ThrVlvSens2NplB1_C "fault class per DFC / Fault class for check DFC_ThrVlvSens2NplB1" VALUE 0x804D9A59 Val_Wu8 30.00 DFES_OneToOne 0.00 30.00 FORMAT "%5.2" EXTENDED_LIMITS 0.00 255.0 /end CHARACTERISTIC
/begin CHARACTERISTIC DFES_Cls.DFC_ThrVlvShoCircB1_C "fault class per DFC / Fault class for check DFC_ThrVlvShoCircB1" VALUE 0x804D9A5A Val_Wu8 30.00 DFES_OneToOne 0.00 30.00 FORMAT "%5.2" EXTENDED_LIMITS 0.00 255.0 /end CHARACTERISTIC
/begin CHARACTERISTIC DFES_Cls.DFC_ThrVlvSpiErrB1_C "fault class per DFC / Fault class for check DFC_ThrVlvSpiErrB1" VALUE 0x804D9A5B Val_Wu8 30.00 DFES_OneToOne 0.00 30.00 FORMAT "%5.2" EXTENDED_LIMITS 0.00 255.0 /end CHARACTERISTIC
/begin CHARACTERISTIC DFES_Cls.DFC_ThrvlvSens1MinB1_C "fault class per DFC / Fault class for check DFC_ThrvlvSens1MinB1" VALUE 0x804D9A5C Val_Wu8 30.00 DFES_OneToOne 0.00 30.00 FORMAT "%5.2" EXTENDED_LIMITS 0.00 255.0 /end CHARACTERISTIC
/begin CHARACTERISTIC DFES_Cls.DFC_TiOffTBasdChkFast_C "fault class per DFC / Fault class for check DFC_TiOffTBasdChkFast" VALUE 0x804D9A5D Val_Wu8 30.00 DFES_OneToOne 0.00 30.00 FORMAT "%5.2" EXTENDED_LIMITS 0.00 255.0 /end CHARACTERISTIC
/begin CHARACTERISTIC DFES_Cls.DFC_TiOffTBasdChkSlow_C "fault class per DFC / Fault class for check DFC_TiOffTBasdChkSlow" VALUE 0x804D9A5E Val_Wu8 30.00 DFES_OneToOne 0.00 30.00 FORMAT "%5.2" EXTENDED_LIMITS 0.00 255.0 /end CHARACTERISTIC
/begin CHARACTERISTIC DFES_Cls.DFC_UEGOSnsrMntdS1B1_C "fault class per DFC / Fault class for check DFC_UEGOSnsrMntdS1B1" VALUE 0x804D9A5F Val_Wu8 30.00 DFES_OneToOne 0.00 30.00 FORMAT "%5.2" EXTENDED_LIMITS 0.00 255.0 /end CHARACTERISTIC
/begin CHARACTERISTIC DFES_Cls.DFC_VehVSig_C "fault class per DFC / Fault class for check DFC_VehVSig" VALUE 0x804D9A60 Val_Wu8 30.00 DFES_OneToOne 0.00 30.00 FORMAT "%5.2" EXTENDED_LIMITS 0.00 255.0 /end CHARACTERISTIC
/begin CHARACTERISTIC DFES_Cls.DFC_VlvLftFbSwtIntk11SpclFail_C "fault class per DFC / Fault class for check DFC_VlvLftFbSwtIntk11SpclFail" VALUE 0x804D9A61 Val_Wu8 30.00 DFES_OneToOne 0.00 30.00 FORMAT "%5.2" EXTENDED_LIMITS 0.00 255.0 /end CHARACTERISTIC
/begin CHARACTERISTIC DFES_Cls.DFC_VlvLftFbSwtIntk11StdFail_C "fault class per DFC / Fault class for check DFC_VlvLftFbSwtIntk11StdFail" VALUE 0x804D9A62 Val_Wu8 30.00 DFES_OneToOne 0.00 30.00 FORMAT "%5.2" EXTENDED_LIMITS 0.00 255.0 /end CHARACTERISTIC
/begin CHARACTERISTIC DFES_DbLv_C "Debounce level limit for creating fault entry (valid for all DFCs)" VALUE 0x804D9A64 Val_Wu8 15.00 DFES_OneToOne 0.00 15.00 FORMAT "%5.2" EXTENDED_LIMITS 0.00 255.0 /end CHARACTERISTIC
/begin CHARACTERISTIC DFES_DTCO.DFC_Unused_C "OBD specific trouble code / " VALUE 0x80504292 Val_Wu16 65535.00 DFES_OneToOne 0.00 65535.00 FORMAT "%8.2" READ_ONLY /end CHARACTERISTIC
/begin CHARACTERISTIC DFES_DTCO.DFC_AAVEmax_C "OBD specific trouble code / OBD specific diagnostic trouble code for check DFC_AAVEmax" VALUE 0x80504294 Val_Wu16 65535.00 DFES_OneToOne 0.00 65535.00 FORMAT "%8.2" /end CHARACTERISTIC
/begin CHARACTERISTIC DFES_DTCO.DFC_AAVEmin_C "OBD specific trouble code / OBD specific diagnostic trouble code for check DFC_AAVEmin" VALUE 0x80504296 Val_Wu16 65535.00 DFES_OneToOne 0.00 65535.00 FORMAT "%8.2" /end CHARACTERISTIC
/begin CHARACTERISTIC DFES_DTCO.DFC_AAVEsig_C "OBD specific trouble code / OBD specific diagnostic trouble code for check DFC_AAVEsig" VALUE 0x80504298 Val_Wu16 65535.00 DFES_OneToOne 0.00 65535.00 FORMAT "%8.2" /end CHARACTERISTIC
/begin CHARACTERISTIC DFES_DTCO.DFC_AltIOACGFailr_C "OBD specific trouble code / OBD specific diagnostic trouble code for check DFC_AltIOACGFailr" VALUE 0x8050429A Val_Wu16 65535.00 DFES_OneToOne 0.00 65535.00 FORMAT "%8.2" /end CHARACTERISTIC
/begin CHARACTERISTIC DFES_DTCO.DFC_AltIOACGHiVltg_C "OBD specific trouble code / OBD specific diagnostic trouble code for check DFC_AltIOACGHiVltg" VALUE 0x8050429C Val_Wu16 65535.00 DFES_OneToOne 0.00 65535.00 FORMAT "%8.2" /end CHARACTERISTIC
/begin CHARACTERISTIC DFES_DTCO.DFC_AltIOACGLoVltg_C "OBD specific trouble code / OBD specific diagnostic trouble code for check DFC_AltIOACGLoVltg" VALUE 0x8050429E Val_Wu16 65535.00 DFES_OneToOne 0.00 65535.00 FORMAT "%8.2" /end CHARACTERISTIC
/begin CHARACTERISTIC DFES_DTCO.DFC_AltIOACGTHi_C "OBD specific trouble code / OBD specific diagnostic trouble code for check DFC_AltIOACGTHi" VALUE 0x805042A0 Val_Wu16 65535.00 DFES_OneToOne 0.00 65535.00 FORMAT "%8.2" /end CHARACTERISTIC
/begin CHARACTERISTIC DFES_DTCO.DFC_AltIODConnACG_C "OBD specific trouble code / OBD specific diagnostic trouble code for check DFC_AltIODConnACG" VALUE 0x805042A2 Val_Wu16 65535.00 DFES_OneToOne 0.00 65535.00 FORMAT "%8.2" /end CHARACTERISTIC
/begin CHARACTERISTIC DFES_DTCO.DFC_BGOELWAF_C "OBD specific trouble code / OBD specific diagnostic trouble code for check DFC_BGOELWAF" VALUE 0x805042A4 Val_Wu16 65535.00 DFES_OneToOne 0.00 65535.00 FORMAT "%8.2" /end CHARACTERISTIC
/begin CHARACTERISTIC DFES_DTCO.DFC_BattUHiFailr_C "OBD specific trouble code / OBD specific diagnostic trouble code for check DFC_BattUHiFailr" VALUE 0x805042A6 Val_Wu16 65535.00 DFES_OneToOne 0.00 65535.00 FORMAT "%8.2" /end CHARACTERISTIC
/begin CHARACTERISTIC DFES_DTCO.DFC_BattULoFailr_C "OBD specific trouble code / OBD specific diagnostic trouble code for check DFC_BattULoFailr" VALUE 0x805042A8 Val_Wu16 65535.00 DFES_OneToOne 0.00 65535.00 FORMAT "%8.2" /end CHARACTERISTIC
/begin CHARACTERISTIC DFES_DTCO.DFC_BrkBstPDriftHiErr_C "OBD specific trouble code / OBD specific diagnostic trouble code for check DFC_BrkBstPDriftHiErr" VALUE 0x805042AA Val_Wu16 65535.00 DFES_OneToOne 0.00 65535.00 FORMAT "%8.2" /end CHARACTERISTIC
/begin CHARACTERISTIC DFES_DTCO.DFC_BrkBstPDriftLoErr_C "OBD specific trouble code / OBD specific diagnostic trouble code for check DFC_BrkBstPDriftLoErr" VALUE 0x805042AC Val_Wu16 65535.00 DFES_OneToOne 0.00 65535.00 FORMAT "%8.2" /end CHARACTERISTIC
/begin CHARACTERISTIC DFES_DTCO.DFC_BrkBstPSnsrStuck_C "OBD specific trouble code / OBD specific diagnostic trouble code for check DFC_BrkBstPSnsrStuck" VALUE 0x805042AE Val_Wu16 65535.00 DFES_OneToOne 0.00 65535.00 FORMAT "%8.2" /end CHARACTERISTIC
/begin CHARACTERISTIC DFES_DTCO.DFC_BrkMnSwtContOn_C "OBD specific trouble code / OBD specific diagnostic trouble code for check DFC_BrkMnSwtContOn" VALUE 0x805042B0 Val_Wu16 65535.00 DFES_OneToOne 0.00 65535.00 FORMAT "%8.2" /end CHARACTERISTIC
/begin CHARACTERISTIC DFES_DTCO.DFC_BrkMnSwtNotStp_C "OBD specific trouble code / OBD specific diagnostic trouble code for check DFC_BrkMnSwtNotStp" VALUE 0x805042B2 Val_Wu16 65535.00 DFES_OneToOne 0.00 65535.00 FORMAT "%8.2" /end CHARACTERISTIC
/begin CHARACTERISTIC DFES_DTCO.DFC_BrkNpl_C "OBD specific trouble code / OBD specific diagnostic trouble code for check DFC_BrkNpl" VALUE 0x805042B4 Val_Wu16 65535.00 DFES_OneToOne 0.00 65535.00 FORMAT "%8.2" /end CHARACTERISTIC
/begin CHARACTERISTIC DFES_DTCO.DFC_BrkRdntSwtContOn_C "OBD specific trouble code / OBD specific diagnostic trouble code for check DFC_BrkRdntSwtContOn" VALUE 0x805042B6 Val_Wu16 65535.00 DFES_OneToOne 0.00 65535.00 FORMAT "%8.2" /end CHARACTERISTIC
/begin CHARACTERISTIC DFES_DTCO.DFC_BrkRdntSwtNotStp_C "OBD specific trouble code / OBD specific diagnostic trouble code for check DFC_BrkRdntSwtNotStp" VALUE 0x805042B8 Val_Wu16 65535.00 DFES_OneToOne 0.00 65535.00 FORMAT "%8.2" /end CHARACTERISTIC
/begin CHARACTERISTIC DFES_DTCO.DFC_Clth3ONStuck_C "OBD specific trouble code / OBD specific diagnostic trouble code for check DFC_Clth3ONStuck" VALUE 0x805042BA Val_Wu16 65535.00 DFES_OneToOne 0.00 65535.00 FORMAT "%8.2" /end CHARACTERISTIC
/begin CHARACTERISTIC DFES_DTCO.DFC_Clth4OFFStuck_C "OBD specific trouble code / OBD specific diagnostic trouble code for check DFC_Clth4OFFStuck" VALUE 0x805042BC Val_Wu16 65535.00 DFES_OneToOne 0.00 65535.00 FORMAT "%8.2" /end CHARACTERISTIC
/begin CHARACTERISTIC DFES_DTCO.DFC_ClthOFFStuck_C "OBD specific trouble code / OBD specific diagnostic trouble code for check DFC_ClthOFFStuck" VALUE 0x805042BE Val_Wu16 65535.00 DFES_OneToOne 0.00 65535.00 FORMAT "%8.2" /end CHARACTERISTIC
/begin CHARACTERISTIC DFES_DTCO.DFC_ClthONStuck_C "OBD specific trouble code / OBD specific diagnostic trouble code for check DFC_ClthONStuck" VALUE 0x805042C0 Val_Wu16 65535.00 DFES_OneToOne 0.00 65535.00 FORMAT "%8.2" /end CHARACTERISTIC
/begin CHARACTERISTIC DFES_DTCO.DFC_ClthStkFailInfo_C "OBD specific trouble code / OBD specific diagnostic trouble code for check DFC_ClthStkFailInfo" VALUE 0x805042C2 Val_Wu16 65535.00 DFES_OneToOne 0.00 65535.00 FORMAT "%8.2" /end CHARACTERISTIC
/begin CHARACTERISTIC DFES_DTCO.DFC_ComACFailInfo_C "OBD specific trouble code / OBD specific diagnostic trouble code for check DFC_ComACFailInfo" VALUE 0x805042C4 Val_Wu16 65535.00 DFES_OneToOne 0.00 65535.00 FORMAT "%8.2" /end CHARACTERISTIC
/begin CHARACTERISTIC DFES_DTCO.DFC_ComATFTValErr_C "OBD specific trouble code / OBD specific diagnostic trouble code for check DFC_ComATFTValErr" VALUE 0x805042C6 Val_Wu16 65535.00 DFES_OneToOne 0.00 65535.00 FORMAT "%8.2" /end CHARACTERISTIC
/begin CHARACTERISTIC DFES_DTCO.DFC_ComATMILReq_C "OBD specific trouble code / OBD specific diagnostic trouble code for check DFC_ComATMILReq" VALUE 0x805042C8 Val_Wu16 65535.00 DFES_OneToOne 0.00 65535.00 FORMAT "%8.2" /end CHARACTERISTIC
/begin CHARACTERISTIC DFES_DTCO.DFC_ComAYCAChksum_C "OBD specific trouble code / OBD specific diagnostic trouble code for check DFC_ComAYCAChksum" VALUE 0x805042CA Val_Wu16 65535.00 DFES_OneToOne 0.00 65535.00 FORMAT "%8.2" /end CHARACTERISTIC
/begin CHARACTERISTIC DFES_DTCO.DFC_ComAYCARingCnt_C "OBD specific trouble code / OBD specific diagnostic trouble code for check DFC_ComAYCARingCnt" VALUE 0x805042CC Val_Wu16 65535.00 DFES_OneToOne 0.00 65535.00 FORMAT "%8.2" /end CHARACTERISTIC
/begin CHARACTERISTIC DFES_DTCO.DFC_ComAYCATOut_C "OBD specific trouble code / OBD specific diagnostic trouble code for check DFC_ComAYCATOut" VALUE 0x805042CE Val_Wu16 65535.00 DFES_OneToOne 0.00 65535.00 FORMAT "%8.2" /end CHARACTERISTIC
/begin CHARACTERISTIC DFES_DTCO.DFC_ComAYCDChkSum_C "OBD specific trouble code / OBD specific diagnostic trouble code for check DFC_ComAYCDChkSum" VALUE 0x805042D0 Val_Wu16 65535.00 DFES_OneToOne 0.00 65535.00 FORMAT "%8.2" /end CHARACTERISTIC
/begin CHARACTERISTIC DFES_DTCO.DFC_ComAYCDTOut_C "OBD specific trouble code / OBD specific diagnostic trouble code for check DFC_ComAYCDTOut" VALUE 0x805042D2 Val_Wu16 65535.00 DFES_OneToOne 0.00 65535.00 FORMAT "%8.2" /end CHARACTERISTIC
/begin CHARACTERISTIC DFES_DTCO.DFC_ComAYCFChksum_C "OBD specific trouble code / OBD specific diagnostic trouble code for check DFC_ComAYCFChksum" VALUE 0x805042D4 Val_Wu16 65535.00 DFES_OneToOne 0.00 65535.00 FORMAT "%8.2" /end CHARACTERISTIC
/begin CHARACTERISTIC DFES_DTCO.DFC_ComAYCFRingCnt_C "OBD specific trouble code / OBD specific diagnostic trouble code for check DFC_ComAYCFRingCnt" VALUE 0x805042D6 Val_Wu16 65535.00 DFES_OneToOne 0.00 65535.00 FORMAT "%8.2" /end CHARACTERISTIC
/begin CHARACTERISTIC DFES_DTCO.DFC_ComAYCFTOut_C "OBD specific trouble code / OBD specific diagnostic trouble code for check DFC_ComAYCFTOut" VALUE 0x805042D8 Val_Wu16 65535.00 DFES_OneToOne 0.00 65535.00 FORMAT "%8.2" /end CHARACTERISTIC
/begin CHARACTERISTIC DFES_DTCO.DFC_ComAYCGChksum_C "OBD specific trouble code / OBD specific diagnostic trouble code for check DFC_ComAYCGChksum" VALUE 0x805042DA Val_Wu16 65535.00 DFES_OneToOne 0.00 65535.00 FORMAT "%8.2" /end CHARACTERISTIC
/begin CHARACTERISTIC DFES_DTCO.DFC_ComAYCGRingCnt_C "OBD specific trouble code / OBD specific diagnostic trouble code for check DFC_ComAYCGRingCnt" VALUE 0x805042DC Val_Wu16 65535.00 DFES_OneToOne 0.00 65535.00 FORMAT "%8.2" /end CHARACTERISTIC
/begin CHARACTERISTIC DFES_DTCO.DFC_ComAYCGTOut_C "OBD specific trouble code / OBD specific diagnostic trouble code for check DFC_ComAYCGTOut" VALUE 0x805042DE Val_Wu16 65535.00 DFES_OneToOne 0.00 65535.00 FORMAT "%8.2" /end CHARACTERISTIC
/begin CHARACTERISTIC DFES_DTCO.DFC_ComAYCIChkSum_C "OBD specific trouble code / OBD specific diagnostic trouble code for check DFC_ComAYCIChkSum" VALUE 0x805042E0 Val_Wu16 65535.00 DFES_OneToOne 0.00 65535.00 FORMAT "%8.2" /end CHARACTERISTIC
/begin CHARACTERISTIC DFES_DTCO.DFC_ComAYCIRingCnt_C "OBD specific trouble code / OBD specific diagnostic trouble code for check DFC_ComAYCIRingCnt" VALUE 0x805042E2 Val_Wu16 65535.00 DFES_OneToOne 0.00 65535.00 FORMAT "%8.2" /end CHARACTERISTIC
/begin CHARACTERISTIC DFES_DTCO.DFC_ComAYCITOut_C "OBD specific trouble code / OBD specific diagnostic trouble code for check DFC_ComAYCITOut" VALUE 0x805042E4 Val_Wu16 65535.00 DFES_OneToOne 0.00 65535.00 FORMAT "%8.2" /end CHARACTERISTIC
/begin CHARACTERISTIC DFES_DTCO.DFC_ComBCM1ChkSum_C "OBD specific trouble code / OBD specific diagnostic trouble code for check DFC_ComBCM1ChkSum" VALUE 0x805042E6 Val_Wu16 65535.00 DFES_OneToOne 0.00 65535.00 FORMAT "%8.2" /end CHARACTERISTIC
/begin CHARACTERISTIC DFES_DTCO.DFC_ComBCM1RingCnt_C "OBD specific trouble code / OBD specific diagnostic trouble code for check DFC_ComBCM1RingCnt" VALUE 0x805042E8 Val_Wu16 65535.00 DFES_OneToOne 0.00 65535.00 FORMAT "%8.2" /end CHARACTERISTIC
/begin CHARACTERISTIC DFES_DTCO.DFC_ComBCM1TOut_C "OBD specific trouble code / OBD specific diagnostic trouble code for check DFC_ComBCM1TOut" VALUE 0x805042EA Val_Wu16 65535.00 DFES_OneToOne 0.00 65535.00 FORMAT "%8.2" /end CHARACTERISTIC
/begin CHARACTERISTIC DFES_DTCO.DFC_ComCANABusOffErr_C "OBD specific trouble code / OBD specific diagnostic trouble code for check DFC_ComCANABusOffErr" VALUE 0x805042EC Val_Wu16 65535.00 DFES_OneToOne 0.00 65535.00 FORMAT "%8.2" /end CHARACTERISTIC
/begin CHARACTERISTIC DFES_DTCO.DFC_ComCANBBusOffErr_C "OBD specific trouble code / OBD specific diagnostic trouble code for check DFC_ComCANBBusOffErr" VALUE 0x805042EE Val_Wu16 65535.00 DFES_OneToOne 0.00 65535.00 FORMAT "%8.2" /end CHARACTERISTIC
/begin CHARACTERISTIC DFES_DTCO.DFC_ComCANCBusOffErr_C "OBD specific trouble code / OBD specific diagnostic trouble code for check DFC_ComCANCBusOffErr" VALUE 0x805042F0 Val_Wu16 65535.00 DFES_OneToOne 0.00 65535.00 FORMAT "%8.2" /end CHARACTERISTIC
/begin CHARACTERISTIC DFES_DTCO.DFC_ComCGW1ChkSum_C "OBD specific trouble code / OBD specific diagnostic trouble code for check DFC_ComCGW1ChkSum" VALUE 0x805042F2 Val_Wu16 65535.00 DFES_OneToOne 0.00 65535.00 FORMAT "%8.2" /end CHARACTERISTIC
/begin CHARACTERISTIC DFES_DTCO.DFC_ComCGW1RingCnt_C "OBD specific trouble code / OBD specific diagnostic trouble code for check DFC_ComCGW1RingCnt" VALUE 0x805042F4 Val_Wu16 65535.00 DFES_OneToOne 0.00 65535.00 FORMAT "%8.2" /end CHARACTERISTIC
/begin CHARACTERISTIC DFES_DTCO.DFC_ComCGW1TOut_C "OBD specific trouble code / OBD specific diagnostic trouble code for check DFC_ComCGW1TOut" VALUE 0x805042F6 Val_Wu16 65535.00 DFES_OneToOne 0.00 65535.00 FORMAT "%8.2" /end CHARACTERISTIC
/begin CHARACTERISTIC DFES_DTCO.DFC_ComConvBoostErr_C "OBD specific trouble code / OBD specific diagnostic trouble code for check DFC_ComConvBoostErr" VALUE 0x805042F8 Val_Wu16 65535.00 DFES_OneToOne 0.00 65535.00 FORMAT "%8.2" /end CHARACTERISTIC
/begin CHARACTERISTIC DFES_DTCO.DFC_ComConvSlipErr_C "OBD specific trouble code / OBD specific diagnostic trouble code for check DFC_ComConvSlipErr" VALUE 0x805042FA Val_Wu16 65535.00 DFES_OneToOne 0.00 65535.00 FORMAT "%8.2" /end CHARACTERISTIC
/begin CHARACTERISTIC DFES_DTCO.DFC_ComDCDCPrfmncErr_C "OBD specific trouble code / OBD specific diagnostic trouble code for check DFC_ComDCDCPrfmncErr" VALUE 0x805042FC Val_Wu16 65535.00 DFES_OneToOne 0.00 65535.00 FORMAT "%8.2" /end CHARACTERISTIC
/begin CHARACTERISTIC DFES_DTCO.DFC_ComDCDCTempWarn_C "OBD specific trouble code / OBD specific diagnostic trouble code for check DFC_ComDCDCTempWarn" VALUE 0x805042FE Val_Wu16 65535.00 DFES_OneToOne 0.00 65535.00 FORMAT "%8.2" /end CHARACTERISTIC
/begin CHARACTERISTIC DFES_DTCO.DFC_ComEAT10Chksum_C "OBD specific trouble code / OBD specific diagnostic trouble code for check DFC_ComEAT10Chksum" VALUE 0x80504300 Val_Wu16 65535.00 DFES_OneToOne 0.00 65535.00 FORMAT "%8.2" /end CHARACTERISTIC
/begin CHARACTERISTIC DFES_DTCO.DFC_ComEAT10RingCnt_C "OBD specific trouble code / OBD specific diagnostic trouble code for check DFC_ComEAT10RingCnt" VALUE 0x80504302 Val_Wu16 65535.00 DFES_OneToOne 0.00 65535.00 FORMAT "%8.2" /end CHARACTERISTIC
/begin CHARACTERISTIC DFES_DTCO.DFC_ComEAT10TOut_C "OBD specific trouble code / OBD specific diagnostic trouble code for check DFC_ComEAT10TOut" VALUE 0x80504304 Val_Wu16 65535.00 DFES_OneToOne 0.00 65535.00 FORMAT "%8.2" /end CHARACTERISTIC
/begin CHARACTERISTIC DFES_DTCO.DFC_ComEAT11ChkSum_C "OBD specific trouble code / OBD specific diagnostic trouble code for check DFC_ComEAT11ChkSum" VALUE 0x80504306 Val_Wu16 65535.00 DFES_OneToOne 0.00 65535.00 FORMAT "%8.2" /end CHARACTERISTIC
/begin CHARACTERISTIC DFES_DTCO.DFC_ComEAT11RingCnt_C "OBD specific trouble code / OBD specific diagnostic trouble code for check DFC_ComEAT11RingCnt" VALUE 0x80504308 Val_Wu16 65535.00 DFES_OneToOne 0.00 65535.00 FORMAT "%8.2" /end CHARACTERISTIC
/begin CHARACTERISTIC DFES_DTCO.DFC_ComEAT11TOut_C "OBD specific trouble code / OBD specific diagnostic trouble code for check DFC_ComEAT11TOut" VALUE 0x8050430A Val_Wu16 65535.00 DFES_OneToOne 0.00 65535.00 FORMAT "%8.2" /end CHARACTERISTIC
/begin CHARACTERISTIC DFES_DTCO.DFC_ComEAT12ChkSum_C "OBD specific trouble code / OBD specific diagnostic trouble code for check DFC_ComEAT12ChkSum" VALUE 0x8050430C Val_Wu16 65535.00 DFES_OneToOne 0.00 65535.00 FORMAT "%8.2" /end CHARACTERISTIC
/begin CHARACTERISTIC DFES_DTCO.DFC_ComEAT12RingCnt_C "OBD specific trouble code / OBD specific diagnostic trouble code for check DFC_ComEAT12RingCnt" VALUE 0x8050430E Val_Wu16 65535.00 DFES_OneToOne 0.00 65535.00 FORMAT "%8.2" /end CHARACTERISTIC
/begin CHARACTERISTIC DFES_DTCO.DFC_ComEAT12TOut_C "OBD specific trouble code / OBD specific diagnostic trouble code for check DFC_ComEAT12TOut" VALUE 0x80504310 Val_Wu16 65535.00 DFES_OneToOne 0.00 65535.00 FORMAT "%8.2" /end CHARACTERISTIC
/begin CHARACTERISTIC DFES_DTCO.DFC_ComEAT13ChkSum_C "OBD specific trouble code / OBD specific diagnostic trouble code for check DFC_ComEAT13ChkSum" VALUE 0x80504312 Val_Wu16 65535.00 DFES_OneToOne 0.00 65535.00 FORMAT "%8.2" /end CHARACTERISTIC
/begin CHARACTERISTIC DFES_DTCO.DFC_ComEAT13RingCnt_C "OBD specific trouble code / OBD specific diagnostic trouble code for check DFC_ComEAT13RingCnt" VALUE 0x80504314 Val_Wu16 65535.00 DFES_OneToOne 0.00 65535.00 FORMAT "%8.2" /end CHARACTERISTIC
/begin CHARACTERISTIC DFES_DTCO.DFC_ComEAT13TOut_C "OBD specific trouble code / OBD specific diagnostic trouble code for check DFC_ComEAT13TOut" VALUE 0x80504316 Val_Wu16 65535.00 DFES_OneToOne 0.00 65535.00 FORMAT "%8.2" /end CHARACTERISTIC
/begin CHARACTERISTIC DFES_DTCO.DFC_ComEAT1Chksum_C "OBD specific trouble code / OBD specific diagnostic trouble code for check DFC_ComEAT1Chksum" VALUE 0x80504318 Val_Wu16 65535.00 DFES_OneToOne 0.00 65535.00 FORMAT "%8.2" /end CHARACTERISTIC
/begin CHARACTERISTIC DFES_DTCO.DFC_ComEAT1RingCnt_C "OBD specific trouble code / OBD specific diagnostic trouble code for check DFC_ComEAT1RingCnt" VALUE 0x8050431A Val_Wu16 65535.00 DFES_OneToOne 0.00 65535.00 FORMAT "%8.2" /end CHARACTERISTIC
/begin CHARACTERISTIC DFES_DTCO.DFC_ComEAT1TOut_C "OBD specific trouble code / OBD specific diagnostic trouble code for check DFC_ComEAT1TOut" VALUE 0x8050431C Val_Wu16 65535.00 DFES_OneToOne 0.00 65535.00 FORMAT "%8.2" /end CHARACTERISTIC
/begin CHARACTERISTIC DFES_DTCO.DFC_ComEAT2ChkSum_C "OBD specific trouble code / OBD specific diagnostic trouble code for check DFC_ComEAT2ChkSum" VALUE 0x8050431E Val_Wu16 65535.00 DFES_OneToOne 0.00 65535.00 FORMAT "%8.2" /end CHARACTERISTIC
/begin CHARACTERISTIC DFES_DTCO.DFC_ComEAT2RingCnt_C "OBD specific trouble code / OBD specific diagnostic trouble code for check DFC_ComEAT2RingCnt" VALUE 0x80504320 Val_Wu16 65535.00 DFES_OneToOne 0.00 65535.00 FORMAT "%8.2" /end CHARACTERISTIC
/begin CHARACTERISTIC DFES_DTCO.DFC_ComEAT2TOut_C "OBD specific trouble code / OBD specific diagnostic trouble code for check DFC_ComEAT2TOut" VALUE 0x80504322 Val_Wu16 65535.00 DFES_OneToOne 0.00 65535.00 FORMAT "%8.2" /end CHARACTERISTIC
/begin CHARACTERISTIC DFES_DTCO.DFC_ComEAT4ChkSum_C "OBD specific trouble code / OBD specific diagnostic trouble code for check DFC_ComEAT4ChkSum" VALUE 0x80504324 Val_Wu16 65535.00 DFES_OneToOne 0.00 65535.00 FORMAT "%8.2" /end CHARACTERISTIC
/begin CHARACTERISTIC DFES_DTCO.DFC_ComEAT4RingCnt_C "OBD specific trouble code / OBD specific diagnostic trouble code for check DFC_ComEAT4RingCnt" VALUE 0x80504326 Val_Wu16 65535.00 DFES_OneToOne 0.00 65535.00 FORMAT "%8.2" /end CHARACTERISTIC
/begin CHARACTERISTIC DFES_DTCO.DFC_ComEAT4TOut_C "OBD specific trouble code / OBD specific diagnostic trouble code for check DFC_ComEAT4TOut" VALUE 0x80504328 Val_Wu16 65535.00 DFES_OneToOne 0.00 65535.00 FORMAT "%8.2" /end CHARACTERISTIC
/begin CHARACTERISTIC DFES_DTCO.DFC_ComEAT6Chksum_C "OBD specific trouble code / OBD specific diagnostic trouble code for check DFC_ComEAT6Chksum" VALUE 0x8050432A Val_Wu16 65535.00 DFES_OneToOne 0.00 65535.00 FORMAT "%8.2" /end CHARACTERISTIC
/begin CHARACTERISTIC DFES_DTCO.DFC_ComEAT6RingCnt_C "OBD specific trouble code / OBD specific diagnostic trouble code for check DFC_ComEAT6RingCnt" VALUE 0x8050432C Val_Wu16 65535.00 DFES_OneToOne 0.00 65535.00 FORMAT "%8.2" /end CHARACTERISTIC
/begin CHARACTERISTIC DFES_DTCO.DFC_ComEAT6TOut_C "OBD specific trouble code / OBD specific diagnostic trouble code for check DFC_ComEAT6TOut" VALUE 0x8050432E Val_Wu16 65535.00 DFES_OneToOne 0.00 65535.00 FORMAT "%8.2" /end CHARACTERISTIC
/begin CHARACTERISTIC DFES_DTCO.DFC_ComEAT7Chksum_C "OBD specific trouble code / OBD specific diagnostic trouble code for check DFC_ComEAT7Chksum" VALUE 0x80504330 Val_Wu16 65535.00 DFES_OneToOne 0.00 65535.00 FORMAT "%8.2" /end CHARACTERISTIC
/begin CHARACTERISTIC DFES_DTCO.DFC_ComEAT7RingCnt_C "OBD specific trouble code / OBD specific diagnostic trouble code for check DFC_ComEAT7RingCnt" VALUE 0x80504332 Val_Wu16 65535.00 DFES_OneToOne 0.00 65535.00 FORMAT "%8.2" /end CHARACTERISTIC
/begin CHARACTERISTIC DFES_DTCO.DFC_ComEAT7TOut_C "OBD specific trouble code / OBD specific diagnostic trouble code for check DFC_ComEAT7TOut" VALUE 0x80504334 Val_Wu16 65535.00 DFES_OneToOne 0.00 65535.00 FORMAT "%8.2" /end CHARACTERISTIC
/begin CHARACTERISTIC DFES_DTCO.DFC_ComEAT8Chksum_C "OBD specific trouble code / OBD specific diagnostic trouble code for check DFC_ComEAT8Chksum" VALUE 0x80504336 Val_Wu16 65535.00 DFES_OneToOne 0.00 65535.00 FORMAT "%8.2" /end CHARACTERISTIC
/begin CHARACTERISTIC DFES_DTCO.DFC_ComEAT8RingCnt_C "OBD specific trouble code / OBD specific diagnostic trouble code for check DFC_ComEAT8RingCnt" VALUE 0x80504338 Val_Wu16 65535.00 DFES_OneToOne 0.00 65535.00 FORMAT "%8.2" /end CHARACTERISTIC
/begin CHARACTERISTIC DFES_DTCO.DFC_ComEAT8TOut_C "OBD specific trouble code / OBD specific diagnostic trouble code for check DFC_ComEAT8TOut" VALUE 0x8050433A Val_Wu16 65535.00 DFES_OneToOne 0.00 65535.00 FORMAT "%8.2" /end CHARACTERISTIC
/begin CHARACTERISTIC DFES_DTCO.DFC_ComEATAChksum_C "OBD specific trouble code / OBD specific diagnostic trouble code for check DFC_ComEATAChksum" VALUE 0x8050433C Val_Wu16 65535.00 DFES_OneToOne 0.00 65535.00 FORMAT "%8.2" /end CHARACTERISTIC
/begin CHARACTERISTIC DFES_DTCO.DFC_ComEATARingCnt_C "OBD specific trouble code / OBD specific diagnostic trouble code for check DFC_ComEATARingCnt" VALUE 0x8050433E Val_Wu16 65535.00 DFES_OneToOne 0.00 65535.00 FORMAT "%8.2" /end CHARACTERISTIC
/begin CHARACTERISTIC DFES_DTCO.DFC_ComEATATOut_C "OBD specific trouble code / OBD specific diagnostic trouble code for check DFC_ComEATATOut" VALUE 0x80504340 Val_Wu16 65535.00 DFES_OneToOne 0.00 65535.00 FORMAT "%8.2" /end CHARACTERISTIC
/begin CHARACTERISTIC DFES_DTCO.DFC_ComEATBChkSum_C "OBD specific trouble code / OBD specific diagnostic trouble code for check DFC_ComEATBChkSum" VALUE 0x80504342 Val_Wu16 65535.00 DFES_OneToOne 0.00 65535.00 FORMAT "%8.2" /end CHARACTERISTIC
/begin CHARACTERISTIC DFES_DTCO.DFC_ComEATBRingCnt_C "OBD specific trouble code / OBD specific diagnostic trouble code for check DFC_ComEATBRingCnt" VALUE 0x80504344 Val_Wu16 65535.00 DFES_OneToOne 0.00 65535.00 FORMAT "%8.2" /end CHARACTERISTIC
/begin CHARACTERISTIC DFES_DTCO.DFC_ComEATBTOut_C "OBD specific trouble code / OBD specific diagnostic trouble code for check DFC_ComEATBTOut" VALUE 0x80504346 Val_Wu16 65535.00 DFES_OneToOne 0.00 65535.00 FORMAT "%8.2" /end CHARACTERISTIC
/begin CHARACTERISTIC DFES_DTCO.DFC_ComEATCChksum_C "OBD specific trouble code / OBD specific diagnostic trouble code for check DFC_ComEATCChksum" VALUE 0x80504348 Val_Wu16 65535.00 DFES_OneToOne 0.00 65535.00 FORMAT "%8.2" /end CHARACTERISTIC
/begin CHARACTERISTIC DFES_DTCO.DFC_ComEATCRingCnt_C "OBD specific trouble code / OBD specific diagnostic trouble code for check DFC_ComEATCRingCnt" VALUE 0x8050434A Val_Wu16 65535.00 DFES_OneToOne 0.00 65535.00 FORMAT "%8.2" /end CHARACTERISTIC
/begin CHARACTERISTIC DFES_DTCO.DFC_ComEATCTOut_C "OBD specific trouble code / OBD specific diagnostic trouble code for check DFC_ComEATCTOut" VALUE 0x8050434C Val_Wu16 65535.00 DFES_OneToOne 0.00 65535.00 FORMAT "%8.2" /end CHARACTERISTIC
/begin CHARACTERISTIC DFES_DTCO.DFC_ComEPBBChkSum_C "OBD specific trouble code / OBD specific diagnostic trouble code for check DFC_ComEPBBChkSum" VALUE 0x8050434E Val_Wu16 65535.00 DFES_OneToOne 0.00 65535.00 FORMAT "%8.2" /end CHARACTERISTIC
/begin CHARACTERISTIC DFES_DTCO.DFC_ComEPBBRingCnt_C "OBD specific trouble code / OBD specific diagnostic trouble code for check DFC_ComEPBBRingCnt" VALUE 0x80504350 Val_Wu16 65535.00 DFES_OneToOne 0.00 65535.00 FORMAT "%8.2" /end CHARACTERISTIC
/begin CHARACTERISTIC DFES_DTCO.DFC_ComEPBBTOut_C "OBD specific trouble code / OBD specific diagnostic trouble code for check DFC_ComEPBBTOut" VALUE 0x80504352 Val_Wu16 65535.00 DFES_OneToOne 0.00 65535.00 FORMAT "%8.2" /end CHARACTERISTIC
/begin CHARACTERISTIC DFES_DTCO.DFC_ComEPBChksum_C "OBD specific trouble code / OBD specific diagnostic trouble code for check DFC_ComEPBChksum" VALUE 0x80504354 Val_Wu16 65535.00 DFES_OneToOne 0.00 65535.00 FORMAT "%8.2" /end CHARACTERISTIC
/begin CHARACTERISTIC DFES_DTCO.DFC_ComEPBTOut_C "OBD specific trouble code / OBD specific diagnostic trouble code for check DFC_ComEPBTOut" VALUE 0x80504356 Val_Wu16 65535.00 DFES_OneToOne 0.00 65535.00 FORMAT "%8.2" /end CHARACTERISTIC
/begin CHARACTERISTIC DFES_DTCO.DFC_ComEPBctRing_C "OBD specific trouble code / OBD specific diagnostic trouble code for check DFC_ComEPBctRing" VALUE 0x80504358 Val_Wu16 65535.00 DFES_OneToOne 0.00 65535.00 FORMAT "%8.2" /end CHARACTERISTIC
/begin CHARACTERISTIC DFES_DTCO.DFC_ComEPS1Chksum_C "OBD specific trouble code / OBD specific diagnostic trouble code for check DFC_ComEPS1Chksum" VALUE 0x8050435A Val_Wu16 65535.00 DFES_OneToOne 0.00 65535.00 FORMAT "%8.2" /end CHARACTERISTIC
/begin CHARACTERISTIC DFES_DTCO.DFC_ComEPS1RingCnt_C "OBD specific trouble code / OBD specific diagnostic trouble code for check DFC_ComEPS1RingCnt" VALUE 0x8050435C Val_Wu16 65535.00 DFES_OneToOne 0.00 65535.00 FORMAT "%8.2" /end CHARACTERISTIC
/begin CHARACTERISTIC DFES_DTCO.DFC_ComEPS1TOut_C "OBD specific trouble code / OBD specific diagnostic trouble code for check DFC_ComEPS1TOut" VALUE 0x8050435E Val_Wu16 65535.00 DFES_OneToOne 0.00 65535.00 FORMAT "%8.2" /end CHARACTERISTIC
/begin CHARACTERISTIC DFES_DTCO.DFC_ComEngCanRxErr_C "OBD specific trouble code / OBD specific diagnostic trouble code for check DFC_ComEngCanRxErr" VALUE 0x80504360 Val_Wu16 65535.00 DFES_OneToOne 0.00 65535.00 FORMAT "%8.2" /end CHARACTERISTIC
/begin CHARACTERISTIC DFES_DTCO.DFC_ComGrvySnsrErr_C "OBD specific trouble code / OBD specific diagnostic trouble code for check DFC_ComGrvySnsrErr" VALUE 0x80504362 Val_Wu16 65535.00 DFES_OneToOne 0.00 65535.00 FORMAT "%8.2" /end CHARACTERISTIC
/begin CHARACTERISTIC DFES_DTCO.DFC_ComGwIMG1ChkSum_C "OBD specific trouble code / OBD specific diagnostic trouble code for check DFC_ComGwIMG1ChkSum" VALUE 0x80504364 Val_Wu16 65535.00 DFES_OneToOne 0.00 65535.00 FORMAT "%8.2" /end CHARACTERISTIC
/begin CHARACTERISTIC DFES_DTCO.DFC_ComGwIMG1RingCnt_C "OBD specific trouble code / OBD specific diagnostic trouble code for check DFC_ComGwIMG1RingCnt" VALUE 0x80504366 Val_Wu16 65535.00 DFES_OneToOne 0.00 65535.00 FORMAT "%8.2" /end CHARACTERISTIC
/begin CHARACTERISTIC DFES_DTCO.DFC_ComGwIMG1TOut_C "OBD specific trouble code / OBD specific diagnostic trouble code for check DFC_ComGwIMG1TOut" VALUE 0x80504368 Val_Wu16 65535.00 DFES_OneToOne 0.00 65535.00 FORMAT "%8.2" /end CHARACTERISTIC
/begin CHARACTERISTIC DFES_DTCO.DFC_ComGwIMG3ChkSum_C "OBD specific trouble code / OBD specific diagnostic trouble code for check DFC_ComGwIMG3ChkSum" VALUE 0x8050436A Val_Wu16 65535.00 DFES_OneToOne 0.00 65535.00 FORMAT "%8.2" /end CHARACTERISTIC
/begin CHARACTERISTIC DFES_DTCO.DFC_ComGwIMG3RingCnt_C "OBD specific trouble code / OBD specific diagnostic trouble code for check DFC_ComGwIMG3RingCnt" VALUE 0x8050436C Val_Wu16 65535.00 DFES_OneToOne 0.00 65535.00 FORMAT "%8.2" /end CHARACTERISTIC
/begin CHARACTERISTIC DFES_DTCO.DFC_ComGwIMG3TOut_C "OBD specific trouble code / OBD specific diagnostic trouble code for check DFC_ComGwIMG3TOut" VALUE 0x8050436E Val_Wu16 65535.00 DFES_OneToOne 0.00 65535.00 FORMAT "%8.2" /end CHARACTERISTIC
/begin CHARACTERISTIC DFES_DTCO.DFC_ComGwIMG4ChkSum_C "OBD specific trouble code / OBD specific diagnostic trouble code for check DFC_ComGwIMG4ChkSum" VALUE 0x80504370 Val_Wu16 65535.00 DFES_OneToOne 0.00 65535.00 FORMAT "%8.2" /end CHARACTERISTIC
/begin CHARACTERISTIC DFES_DTCO.DFC_ComGwIMG4RingCnt_C "OBD specific trouble code / OBD specific diagnostic trouble code for check DFC_ComGwIMG4RingCnt" VALUE 0x80504372 Val_Wu16 65535.00 DFES_OneToOne 0.00 65535.00 FORMAT "%8.2" /end CHARACTERISTIC
/begin CHARACTERISTIC DFES_DTCO.DFC_ComGwIMG4TOut_C "OBD specific trouble code / OBD specific diagnostic trouble code for check DFC_ComGwIMG4TOut" VALUE 0x80504374 Val_Wu16 65535.00 DFES_OneToOne 0.00 65535.00 FORMAT "%8.2" /end CHARACTERISTIC
/begin CHARACTERISTIC DFES_DTCO.DFC_ComGwIMG5ChkSum_C "OBD specific trouble code / OBD specific diagnostic trouble code for check DFC_ComGwIMG5ChkSum" VALUE 0x80504376 Val_Wu16 65535.00 DFES_OneToOne 0.00 65535.00 FORMAT "%8.2" /end CHARACTERISTIC
/begin CHARACTERISTIC DFES_DTCO.DFC_ComGwIMG5RingCnt_C "OBD specific trouble code / OBD specific diagnostic trouble code for check DFC_ComGwIMG5RingCnt" VALUE 0x80504378 Val_Wu16 65535.00 DFES_OneToOne 0.00 65535.00 FORMAT "%8.2" /end CHARACTERISTIC
/begin CHARACTERISTIC DFES_DTCO.DFC_ComGwIMG5TOut_C "OBD specific trouble code / OBD specific diagnostic trouble code for check DFC_ComGwIMG5TOut" VALUE 0x8050437A Val_Wu16 65535.00 DFES_OneToOne 0.00 65535.00 FORMAT "%8.2" /end CHARACTERISTIC
/begin CHARACTERISTIC DFES_DTCO.DFC_ComGwIMG6ChkSum_C "OBD specific trouble code / OBD specific diagnostic trouble code for check DFC_ComGwIMG6ChkSum" VALUE 0x8050437C Val_Wu16 65535.00 DFES_OneToOne 0.00 65535.00 FORMAT "%8.2" /end CHARACTERISTIC
/begin CHARACTERISTIC DFES_DTCO.DFC_ComGwIMG6RingCnt_C "OBD specific trouble code / OBD specific diagnostic trouble code for check DFC_ComGwIMG6RingCnt" VALUE 0x8050437E Val_Wu16 65535.00 DFES_OneToOne 0.00 65535.00 FORMAT "%8.2" /end CHARACTERISTIC
/begin CHARACTERISTIC DFES_DTCO.DFC_ComGwIMG6TOut_C "OBD specific trouble code / OBD specific diagnostic trouble code for check DFC_ComGwIMG6TOut" VALUE 0x80504380 Val_Wu16 65535.00 DFES_OneToOne 0.00 65535.00 FORMAT "%8.2" /end CHARACTERISTIC
/begin CHARACTERISTIC DFES_DTCO.DFC_ComIDASBChksum_C "OBD specific trouble code / OBD specific diagnostic trouble code for check DFC_ComIDASBChksum" VALUE 0x80504382 Val_Wu16 65535.00 DFES_OneToOne 0.00 65535.00 FORMAT "%8.2" /end CHARACTERISTIC
/begin CHARACTERISTIC DFES_DTCO.DFC_ComIDASBRingCnt_C "OBD specific trouble code / OBD specific diagnostic trouble code for check DFC_ComIDASBRingCnt" VALUE 0x80504384 Val_Wu16 65535.00 DFES_OneToOne 0.00 65535.00 FORMAT "%8.2" /end CHARACTERISTIC
/begin CHARACTERISTIC DFES_DTCO.DFC_ComIDASBTOut_C "OBD specific trouble code / OBD specific diagnostic trouble code for check DFC_ComIDASBTOut" VALUE 0x80504386 Val_Wu16 65535.00 DFES_OneToOne 0.00 65535.00 FORMAT "%8.2" /end CHARACTERISTIC
/begin CHARACTERISTIC DFES_DTCO.DFC_ComIMGMILReq_C "OBD specific trouble code / OBD specific diagnostic trouble code for check DFC_ComIMGMILReq" VALUE 0x80504388 Val_Wu16 65535.00 DFES_OneToOne 0.00 65535.00 FORMAT "%8.2" /end CHARACTERISTIC
/begin CHARACTERISTIC DFES_DTCO.DFC_ComISSPrms_C "OBD specific trouble code / OBD specific diagnostic trouble code for check DFC_ComISSPrms" VALUE 0x8050438A Val_Wu16 65535.00 DFES_OneToOne 0.00 65535.00 FORMAT "%8.2" /end CHARACTERISTIC
/begin CHARACTERISTIC DFES_DTCO.DFC_ComMETAChksum_C "OBD specific trouble code / OBD specific diagnostic trouble code for check DFC_ComMETAChksum" VALUE 0x8050438C Val_Wu16 65535.00 DFES_OneToOne 0.00 65535.00 FORMAT "%8.2" /end CHARACTERISTIC
/begin CHARACTERISTIC DFES_DTCO.DFC_ComMETAChksumPstDrv_C "OBD specific trouble code / OBD specific diagnostic trouble code for check DFC_ComMETAChksumPstDrv" VALUE 0x8050438E Val_Wu16 65535.00 DFES_OneToOne 0.00 65535.00 FORMAT "%8.2" /end CHARACTERISTIC
/begin CHARACTERISTIC DFES_DTCO.DFC_ComMETARingCnt_C "OBD specific trouble code / OBD specific diagnostic trouble code for check DFC_ComMETARingCnt" VALUE 0x80504390 Val_Wu16 65535.00 DFES_OneToOne 0.00 65535.00 FORMAT "%8.2" /end CHARACTERISTIC
/begin CHARACTERISTIC DFES_DTCO.DFC_ComMETARingCntPstDrv_C "OBD specific trouble code / OBD specific diagnostic trouble code for check DFC_ComMETARingCntPstDrv" VALUE 0x80504392 Val_Wu16 65535.00 DFES_OneToOne 0.00 65535.00 FORMAT "%8.2" /end CHARACTERISTIC
/begin CHARACTERISTIC DFES_DTCO.DFC_ComMETATOut_C "OBD specific trouble code / OBD specific diagnostic trouble code for check DFC_ComMETATOut" VALUE 0x80504394 Val_Wu16 65535.00 DFES_OneToOne 0.00 65535.00 FORMAT "%8.2" /end CHARACTERISTIC
/begin CHARACTERISTIC DFES_DTCO.DFC_ComMETATOutPstDrv_C "OBD specific trouble code / OBD specific diagnostic trouble code for check DFC_ComMETATOutPstDrv" VALUE 0x80504396 Val_Wu16 65535.00 DFES_OneToOne 0.00 65535.00 FORMAT "%8.2" /end CHARACTERISTIC
/begin CHARACTERISTIC DFES_DTCO.DFC_ComMETCChksum_C "OBD specific trouble code / OBD specific diagnostic trouble code for check DFC_ComMETCChksum" VALUE 0x80504398 Val_Wu16 65535.00 DFES_OneToOne 0.00 65535.00 FORMAT "%8.2" /end CHARACTERISTIC
/begin CHARACTERISTIC DFES_DTCO.DFC_ComMETCRingCnt_C "OBD specific trouble code / OBD specific diagnostic trouble code for check DFC_ComMETCRingCnt" VALUE 0x8050439A Val_Wu16 65535.00 DFES_OneToOne 0.00 65535.00 FORMAT "%8.2" /end CHARACTERISTIC
/begin CHARACTERISTIC DFES_DTCO.DFC_ComMETCTOut_C "OBD specific trouble code / OBD specific diagnostic trouble code for check DFC_ComMETCTOut" VALUE 0x8050439C Val_Wu16 65535.00 DFES_OneToOne 0.00 65535.00 FORMAT "%8.2" /end CHARACTERISTIC
/begin CHARACTERISTIC DFES_DTCO.DFC_ComMETDChksum_C "OBD specific trouble code / OBD specific diagnostic trouble code for check DFC_ComMETDChksum" VALUE 0x8050439E Val_Wu16 65535.00 DFES_OneToOne 0.00 65535.00 FORMAT "%8.2" /end CHARACTERISTIC
/begin CHARACTERISTIC DFES_DTCO.DFC_ComMETDRingCnt_C "OBD specific trouble code / OBD specific diagnostic trouble code for check DFC_ComMETDRingCnt" VALUE 0x805043A0 Val_Wu16 65535.00 DFES_OneToOne 0.00 65535.00 FORMAT "%8.2" /end CHARACTERISTIC
/begin CHARACTERISTIC DFES_DTCO.DFC_ComMETDTOut_C "OBD specific trouble code / OBD specific diagnostic trouble code for check DFC_ComMETDTOut" VALUE 0x805043A2 Val_Wu16 65535.00 DFES_OneToOne 0.00 65535.00 FORMAT "%8.2" /end CHARACTERISTIC
/begin CHARACTERISTIC DFES_DTCO.DFC_ComMETE2Chksum_C "OBD specific trouble code / OBD specific diagnostic trouble code for check DFC_ComMETE2Chksum" VALUE 0x805043A4 Val_Wu16 65535.00 DFES_OneToOne 0.00 65535.00 FORMAT "%8.2" /end CHARACTERISTIC
/begin CHARACTERISTIC DFES_DTCO.DFC_ComMETE2RingCnt_C "OBD specific trouble code / OBD specific diagnostic trouble code for check DFC_ComMETE2RingCnt" VALUE 0x805043A6 Val_Wu16 65535.00 DFES_OneToOne 0.00 65535.00 FORMAT "%8.2" /end CHARACTERISTIC
/begin CHARACTERISTIC DFES_DTCO.DFC_ComMETE2TOut_C "OBD specific trouble code / OBD specific diagnostic trouble code for check DFC_ComMETE2TOut" VALUE 0x805043A8 Val_Wu16 65535.00 DFES_OneToOne 0.00 65535.00 FORMAT "%8.2" /end CHARACTERISTIC
/begin CHARACTERISTIC DFES_DTCO.DFC_ComMETFChksum_C "OBD specific trouble code / OBD specific diagnostic trouble code for check DFC_ComMETFChksum" VALUE 0x805043AA Val_Wu16 65535.00 DFES_OneToOne 0.00 65535.00 FORMAT "%8.2" /end CHARACTERISTIC
/begin CHARACTERISTIC DFES_DTCO.DFC_ComMETFRingCnt_C "OBD specific trouble code / OBD specific diagnostic trouble code for check DFC_ComMETFRingCnt" VALUE 0x805043AC Val_Wu16 65535.00 DFES_OneToOne 0.00 65535.00 FORMAT "%8.2" /end CHARACTERISTIC
/begin CHARACTERISTIC DFES_DTCO.DFC_ComMETFTOut_C "OBD specific trouble code / OBD specific diagnostic trouble code for check DFC_ComMETFTOut" VALUE 0x805043AE Val_Wu16 65535.00 DFES_OneToOne 0.00 65535.00 FORMAT "%8.2" /end CHARACTERISTIC
/begin CHARACTERISTIC DFES_DTCO.DFC_ComMETGChksum_C "OBD specific trouble code / OBD specific diagnostic trouble code for check DFC_ComMETGChksum" VALUE 0x805043B0 Val_Wu16 65535.00 DFES_OneToOne 0.00 65535.00 FORMAT "%8.2" /end CHARACTERISTIC
/begin CHARACTERISTIC DFES_DTCO.DFC_ComMETGRingCnt_C "OBD specific trouble code / OBD specific diagnostic trouble code for check DFC_ComMETGRingCnt" VALUE 0x805043B2 Val_Wu16 65535.00 DFES_OneToOne 0.00 65535.00 FORMAT "%8.2" /end CHARACTERISTIC
/begin CHARACTERISTIC DFES_DTCO.DFC_ComMETGTOut_C "OBD specific trouble code / OBD specific diagnostic trouble code for check DFC_ComMETGTOut" VALUE 0x805043B4 Val_Wu16 65535.00 DFES_OneToOne 0.00 65535.00 FORMAT "%8.2" /end CHARACTERISTIC
/begin CHARACTERISTIC DFES_DTCO.DFC_ComMETH2Chksum_C "OBD specific trouble code / OBD specific diagnostic trouble code for check DFC_ComMETH2Chksum" VALUE 0x805043B6 Val_Wu16 65535.00 DFES_OneToOne 0.00 65535.00 FORMAT "%8.2" /end CHARACTERISTIC
/begin CHARACTERISTIC DFES_DTCO.DFC_ComMETH2RingCnt_C "OBD specific trouble code / OBD specific diagnostic trouble code for check DFC_ComMETH2RingCnt" VALUE 0x805043B8 Val_Wu16 65535.00 DFES_OneToOne 0.00 65535.00 FORMAT "%8.2" /end CHARACTERISTIC
/begin CHARACTERISTIC DFES_DTCO.DFC_ComMETH2TOut_C "OBD specific trouble code / OBD specific diagnostic trouble code for check DFC_ComMETH2TOut" VALUE 0x805043BA Val_Wu16 65535.00 DFES_OneToOne 0.00 65535.00 FORMAT "%8.2" /end CHARACTERISTIC
/begin CHARACTERISTIC DFES_DTCO.DFC_ComMETHChksum_C "OBD specific trouble code / OBD specific diagnostic trouble code for check DFC_ComMETHChksum" VALUE 0x805043BC Val_Wu16 65535.00 DFES_OneToOne 0.00 65535.00 FORMAT "%8.2" /end CHARACTERISTIC
/begin CHARACTERISTIC DFES_DTCO.DFC_ComMETHRingCnt_C "OBD specific trouble code / OBD specific diagnostic trouble code for check DFC_ComMETHRingCnt" VALUE 0x805043BE Val_Wu16 65535.00 DFES_OneToOne 0.00 65535.00 FORMAT "%8.2" /end CHARACTERISTIC
/begin CHARACTERISTIC DFES_DTCO.DFC_ComMETHTOut_C "OBD specific trouble code / OBD specific diagnostic trouble code for check DFC_ComMETHTOut" VALUE 0x805043C0 Val_Wu16 65535.00 DFES_OneToOne 0.00 65535.00 FORMAT "%8.2" /end CHARACTERISTIC
/begin CHARACTERISTIC DFES_DTCO.DFC_ComMETIChksum_C "OBD specific trouble code / OBD specific diagnostic trouble code for check DFC_ComMETIChksum" VALUE 0x805043C2 Val_Wu16 65535.00 DFES_OneToOne 0.00 65535.00 FORMAT "%8.2" /end CHARACTERISTIC
/begin CHARACTERISTIC DFES_DTCO.DFC_ComMETIRingCnt_C "OBD specific trouble code / OBD specific diagnostic trouble code for check DFC_ComMETIRingCnt" VALUE 0x805043C4 Val_Wu16 65535.00 DFES_OneToOne 0.00 65535.00 FORMAT "%8.2" /end CHARACTERISTIC
/begin CHARACTERISTIC DFES_DTCO.DFC_ComMETITOut_C "OBD specific trouble code / OBD specific diagnostic trouble code for check DFC_ComMETITOut" VALUE 0x805043C6 Val_Wu16 65535.00 DFES_OneToOne 0.00 65535.00 FORMAT "%8.2" /end CHARACTERISTIC
/begin CHARACTERISTIC DFES_DTCO.DFC_ComMETKChksum_C "OBD specific trouble code / OBD specific diagnostic trouble code for check DFC_ComMETKChksum" VALUE 0x805043C8 Val_Wu16 65535.00 DFES_OneToOne 0.00 65535.00 FORMAT "%8.2" /end CHARACTERISTIC
/begin CHARACTERISTIC DFES_DTCO.DFC_ComMETKRingCnt_C "OBD specific trouble code / OBD specific diagnostic trouble code for check DFC_ComMETKRingCnt" VALUE 0x805043CA Val_Wu16 65535.00 DFES_OneToOne 0.00 65535.00 FORMAT "%8.2" /end CHARACTERISTIC
/begin CHARACTERISTIC DFES_DTCO.DFC_ComMETKTOut_C "OBD specific trouble code / OBD specific diagnostic trouble code for check DFC_ComMETKTOut" VALUE 0x805043CC Val_Wu16 65535.00 DFES_OneToOne 0.00 65535.00 FORMAT "%8.2" /end CHARACTERISTIC
/begin CHARACTERISTIC DFES_DTCO.DFC_ComMETLChksum_C "OBD specific trouble code / OBD specific diagnostic trouble code for check DFC_ComMETLChksum" VALUE 0x805043CE Val_Wu16 65535.00 DFES_OneToOne 0.00 65535.00 FORMAT "%8.2" /end CHARACTERISTIC
/begin CHARACTERISTIC DFES_DTCO.DFC_ComMETLRingCnt_C "OBD specific trouble code / OBD specific diagnostic trouble code for check DFC_ComMETLRingCnt" VALUE 0x805043D0 Val_Wu16 65535.00 DFES_OneToOne 0.00 65535.00 FORMAT "%8.2" /end CHARACTERISTIC
/begin CHARACTERISTIC DFES_DTCO.DFC_ComMETLTOut_C "OBD specific trouble code / OBD specific diagnostic trouble code for check DFC_ComMETLTOut" VALUE 0x805043D2 Val_Wu16 65535.00 DFES_OneToOne 0.00 65535.00 FORMAT "%8.2" /end CHARACTERISTIC
/begin CHARACTERISTIC DFES_DTCO.DFC_ComMETMChksum_C "OBD specific trouble code / OBD specific diagnostic trouble code for check DFC_ComMETMChksum" VALUE 0x805043D4 Val_Wu16 65535.00 DFES_OneToOne 0.00 65535.00 FORMAT "%8.2" /end CHARACTERISTIC
/begin CHARACTERISTIC DFES_DTCO.DFC_ComMETMRingCnt_C "OBD specific trouble code / OBD specific diagnostic trouble code for check DFC_ComMETMRingCnt" VALUE 0x805043D6 Val_Wu16 65535.00 DFES_OneToOne 0.00 65535.00 FORMAT "%8.2" /end CHARACTERISTIC
/begin CHARACTERISTIC DFES_DTCO.DFC_ComMETMTOut_C "OBD specific trouble code / OBD specific diagnostic trouble code for check DFC_ComMETMTOut" VALUE 0x805043D8 Val_Wu16 65535.00 DFES_OneToOne 0.00 65535.00 FORMAT "%8.2" /end CHARACTERISTIC
/begin CHARACTERISTIC DFES_DTCO.DFC_ComMETNChksum_C "OBD specific trouble code / OBD specific diagnostic trouble code for check DFC_ComMETNChksum" VALUE 0x805043DA Val_Wu16 65535.00 DFES_OneToOne 0.00 65535.00 FORMAT "%8.2" /end CHARACTERISTIC
/begin CHARACTERISTIC DFES_DTCO.DFC_ComMETNRingCnt_C "OBD specific trouble code / OBD specific diagnostic trouble code for check DFC_ComMETNRingCnt" VALUE 0x805043DC Val_Wu16 65535.00 DFES_OneToOne 0.00 65535.00 FORMAT "%8.2" /end CHARACTERISTIC
/begin CHARACTERISTIC DFES_DTCO.DFC_ComMETNTOut_C "OBD specific trouble code / OBD specific diagnostic trouble code for check DFC_ComMETNTOut" VALUE 0x805043DE Val_Wu16 65535.00 DFES_OneToOne 0.00 65535.00 FORMAT "%8.2" /end CHARACTERISTIC
/begin CHARACTERISTIC DFES_DTCO.DFC_ComMtrCom_C "OBD specific trouble code / OBD specific diagnostic trouble code for check DFC_ComMtrCom" VALUE 0x805043E0 Val_Wu16 65535.00 DFES_OneToOne 0.00 65535.00 FORMAT "%8.2" /end CHARACTERISTIC
/begin CHARACTERISTIC DFES_DTCO.DFC_ComPCUChkSum_C "OBD specific trouble code / OBD specific diagnostic trouble code for check DFC_ComPCUChkSum" VALUE 0x805043E2 Val_Wu16 65535.00 DFES_OneToOne 0.00 65535.00 FORMAT "%8.2" /end CHARACTERISTIC
/begin CHARACTERISTIC DFES_DTCO.DFC_ComPCURingCnt_C "OBD specific trouble code / OBD specific diagnostic trouble code for check DFC_ComPCURingCnt" VALUE 0x805043E4 Val_Wu16 65535.00 DFES_OneToOne 0.00 65535.00 FORMAT "%8.2" /end CHARACTERISTIC
/begin CHARACTERISTIC DFES_DTCO.DFC_ComPCUTOut_C "OBD specific trouble code / OBD specific diagnostic trouble code for check DFC_ComPCUTOut" VALUE 0x805043E6 Val_Wu16 65535.00 DFES_OneToOne 0.00 65535.00 FORMAT "%8.2" /end CHARACTERISTIC
/begin CHARACTERISTIC DFES_DTCO.DFC_ComSRSAChksum_C "OBD specific trouble code / OBD specific diagnostic trouble code for check DFC_ComSRSAChksum" VALUE 0x805043E8 Val_Wu16 65535.00 DFES_OneToOne 0.00 65535.00 FORMAT "%8.2" /end CHARACTERISTIC
/begin CHARACTERISTIC DFES_DTCO.DFC_ComSRSARingCnt_C "OBD specific trouble code / OBD specific diagnostic trouble code for check DFC_ComSRSARingCnt" VALUE 0x805043EA Val_Wu16 65535.00 DFES_OneToOne 0.00 65535.00 FORMAT "%8.2" /end CHARACTERISTIC
/begin CHARACTERISTIC DFES_DTCO.DFC_ComSRSATOut_C "OBD specific trouble code / OBD specific diagnostic trouble code for check DFC_ComSRSATOut" VALUE 0x805043EC Val_Wu16 65535.00 DFES_OneToOne 0.00 65535.00 FORMAT "%8.2" /end CHARACTERISTIC
/begin CHARACTERISTIC DFES_DTCO.DFC_ComSRSBChksum_C "OBD specific trouble code / OBD specific diagnostic trouble code for check DFC_ComSRSBChksum" VALUE 0x805043EE Val_Wu16 65535.00 DFES_OneToOne 0.00 65535.00 FORMAT "%8.2" /end CHARACTERISTIC
/begin CHARACTERISTIC DFES_DTCO.DFC_ComSRSBRingCnt_C "OBD specific trouble code / OBD specific diagnostic trouble code for check DFC_ComSRSBRingCnt" VALUE 0x805043F0 Val_Wu16 65535.00 DFES_OneToOne 0.00 65535.00 FORMAT "%8.2" /end CHARACTERISTIC
/begin CHARACTERISTIC DFES_DTCO.DFC_ComSRSBTOut_C "OBD specific trouble code / OBD specific diagnostic trouble code for check DFC_ComSRSBTOut" VALUE 0x805043F2 Val_Wu16 65535.00 DFES_OneToOne 0.00 65535.00 FORMAT "%8.2" /end CHARACTERISTIC
/begin CHARACTERISTIC DFES_DTCO.DFC_ComSRSChksum_C "OBD specific trouble code / OBD specific diagnostic trouble code for check DFC_ComSRSChksum" VALUE 0x805043F4 Val_Wu16 65535.00 DFES_OneToOne 0.00 65535.00 FORMAT "%8.2" /end CHARACTERISTIC
/begin CHARACTERISTIC DFES_DTCO.DFC_ComSRSErr_C "OBD specific trouble code / OBD specific diagnostic trouble code for check DFC_ComSRSErr" VALUE 0x805043F6 Val_Wu16 65535.00 DFES_OneToOne 0.00 65535.00 FORMAT "%8.2" /end CHARACTERISTIC
/begin CHARACTERISTIC DFES_DTCO.DFC_ComSRSRingCnt_C "OBD specific trouble code / OBD specific diagnostic trouble code for check DFC_ComSRSRingCnt" VALUE 0x805043F8 Val_Wu16 65535.00 DFES_OneToOne 0.00 65535.00 FORMAT "%8.2" /end CHARACTERISTIC
/begin CHARACTERISTIC DFES_DTCO.DFC_ComSRSTOut_C "OBD specific trouble code / OBD specific diagnostic trouble code for check DFC_ComSRSTOut" VALUE 0x805043FA Val_Wu16 65535.00 DFES_OneToOne 0.00 65535.00 FORMAT "%8.2" /end CHARACTERISTIC
/begin CHARACTERISTIC DFES_DTCO.DFC_ComVehSpdPndFltTCU_C "OBD specific trouble code / OBD specific diagnostic trouble code for check DFC_ComVehSpdPndFltTCU" VALUE 0x805043FC Val_Wu16 65535.00 DFES_OneToOne 0.00 65535.00 FORMAT "%8.2" /end CHARACTERISTIC
/begin CHARACTERISTIC DFES_DTCO.DFC_EbsChartcCurrErr_C "OBD specific trouble code / OBD specific diagnostic trouble code for check DFC_EbsChartcCurrErr" VALUE 0x805043FE Val_Wu16 65535.00 DFES_OneToOne 0.00 65535.00 FORMAT "%8.2" /end CHARACTERISTIC
/begin CHARACTERISTIC DFES_DTCO.DFC_EbsSelfDiagErr_C "OBD specific trouble code / OBD specific diagnostic trouble code for check DFC_EbsSelfDiagErr" VALUE 0x80504400 Val_Wu16 65535.00 DFES_OneToOne 0.00 65535.00 FORMAT "%8.2" /end CHARACTERISTIC
/begin CHARACTERISTIC DFES_DTCO.DFC_GEVlvPhaCsersIntkB1_C "OBD specific trouble code / OBD specific diagnostic trouble code for check DFC_GEVlvPhaCsersIntkB1" VALUE 0x80504402 Val_Wu16 65535.00 DFES_OneToOne 0.00 65535.00 FORMAT "%8.2" /end CHARACTERISTIC
/begin CHARACTERISTIC DFES_DTCO.DFC_GEVlvPhaPsOpenLoadIntkB1_C "OBD specific trouble code / OBD specific diagnostic trouble code for check DFC_GEVlvPhaPsOpenLoadIntkB1" VALUE 0x80504404 Val_Wu16 65535.00 DFES_OneToOne 0.00 65535.00 FORMAT "%8.2" /end CHARACTERISTIC
/begin CHARACTERISTIC DFES_DTCO.DFC_GEVlvPhaPsShoToBattIntkB1_C "OBD specific trouble code / OBD specific diagnostic trouble code for check DFC_GEVlvPhaPsShoToBattIntkB1" VALUE 0x80504406 Val_Wu16 65535.00 DFES_OneToOne 0.00 65535.00 FORMAT "%8.2" /end CHARACTERISTIC
/begin CHARACTERISTIC DFES_DTCO.DFC_GEVlvPhaPsShoToGndIntkB1_C "OBD specific trouble code / OBD specific diagnostic trouble code for check DFC_GEVlvPhaPsShoToGndIntkB1" VALUE 0x80504408 Val_Wu16 65535.00 DFES_OneToOne 0.00 65535.00 FORMAT "%8.2" /end CHARACTERISTIC
/begin CHARACTERISTIC DFES_DTCO.DFC_GbxCANDigPlausErr_C "OBD specific trouble code / OBD specific diagnostic trouble code for check DFC_GbxCANDigPlausErr" VALUE 0x8050440A Val_Wu16 65535.00 DFES_OneToOne 0.00 65535.00 FORMAT "%8.2" /end CHARACTERISTIC
/begin CHARACTERISTIC DFES_DTCO.DFC_GbxNPos1SRCMax_C "OBD specific trouble code / OBD specific diagnostic trouble code for check DFC_GbxNPos1SRCMax" VALUE 0x8050440C Val_Wu16 65535.00 DFES_OneToOne 0.00 65535.00 FORMAT "%8.2" /end CHARACTERISTIC
/begin CHARACTERISTIC DFES_DTCO.DFC_GbxNPos1SRCMin_C "OBD specific trouble code / OBD specific diagnostic trouble code for check DFC_GbxNPos1SRCMin" VALUE 0x8050440E Val_Wu16 65535.00 DFES_OneToOne 0.00 65535.00 FORMAT "%8.2" /end CHARACTERISTIC
/begin CHARACTERISTIC DFES_DTCO.DFC_GbxNPos2SRCMax_C "OBD specific trouble code / OBD specific diagnostic trouble code for check DFC_GbxNPos2SRCMax" VALUE 0x80504410 Val_Wu16 65535.00 DFES_OneToOne 0.00 65535.00 FORMAT "%8.2" /end CHARACTERISTIC
/begin CHARACTERISTIC DFES_DTCO.DFC_GbxNPos2SRCMin_C "OBD specific trouble code / OBD specific diagnostic trouble code for check DFC_GbxNPos2SRCMin" VALUE 0x80504412 Val_Wu16 65535.00 DFES_OneToOne 0.00 65535.00 FORMAT "%8.2" /end CHARACTERISTIC
/begin CHARACTERISTIC DFES_DTCO.DFC_GbxNPosAlvChk_C "OBD specific trouble code / OBD specific diagnostic trouble code for check DFC_GbxNPosAlvChk" VALUE 0x80504414 Val_Wu16 65535.00 DFES_OneToOne 0.00 65535.00 FORMAT "%8.2" /end CHARACTERISTIC
/begin CHARACTERISTIC DFES_DTCO.DFC_GbxNPosSyncErr_C "OBD specific trouble code / OBD specific diagnostic trouble code for check DFC_GbxNPosSyncErr" VALUE 0x80504416 Val_Wu16 65535.00 DFES_OneToOne 0.00 65535.00 FORMAT "%8.2" /end CHARACTERISTIC
/begin CHARACTERISTIC DFES_DTCO.DFC_HEGOS2B1HtrPsMax_C "OBD specific trouble code / OBD specific diagnostic trouble code for check DFC_HEGOS2B1HtrPsMax" VALUE 0x80504418 Val_Wu16 65535.00 DFES_OneToOne 0.00 65535.00 FORMAT "%8.2" /end CHARACTERISTIC
/begin CHARACTERISTIC DFES_DTCO.DFC_HEGOS2B1HtrPsMin_C "OBD specific trouble code / OBD specific diagnostic trouble code for check DFC_HEGOS2B1HtrPsMin" VALUE 0x8050441A Val_Wu16 65535.00 DFES_OneToOne 0.00 65535.00 FORMAT "%8.2" /end CHARACTERISTIC
/begin CHARACTERISTIC DFES_DTCO.DFC_HEGOS2B1HtrPsSig_C "OBD specific trouble code / OBD specific diagnostic trouble code for check DFC_HEGOS2B1HtrPsSig" VALUE 0x8050441C Val_Wu16 65535.00 DFES_OneToOne 0.00 65535.00 FORMAT "%8.2" /end CHARACTERISTIC
/begin CHARACTERISTIC DFES_DTCO.DFC_LinCSErrACG_C "OBD specific trouble code / OBD specific diagnostic trouble code for check DFC_LinCSErrACG" VALUE 0x8050441E Val_Wu16 65535.00 DFES_OneToOne 0.00 65535.00 FORMAT "%8.2" /end CHARACTERISTIC
/begin CHARACTERISTIC DFES_DTCO.DFC_LinCSErrAEV_C "OBD specific trouble code / OBD specific diagnostic trouble code for check DFC_LinCSErrAEV" VALUE 0x80504420 Val_Wu16 65535.00 DFES_OneToOne 0.00 65535.00 FORMAT "%8.2" /end CHARACTERISTIC
/begin CHARACTERISTIC DFES_DTCO.DFC_LinCSErrDCDC_C "OBD specific trouble code / OBD specific diagnostic trouble code for check DFC_LinCSErrDCDC" VALUE 0x80504422 Val_Wu16 65535.00 DFES_OneToOne 0.00 65535.00 FORMAT "%8.2" /end CHARACTERISTIC
/begin CHARACTERISTIC DFES_DTCO.DFC_LinCSErrEBS_C "OBD specific trouble code / OBD specific diagnostic trouble code for check DFC_LinCSErrEBS" VALUE 0x80504424 Val_Wu16 65535.00 DFES_OneToOne 0.00 65535.00 FORMAT "%8.2" /end CHARACTERISTIC
/begin CHARACTERISTIC DFES_DTCO.DFC_LinHdrTimeoutErrACG_C "OBD specific trouble code / OBD specific diagnostic trouble code for check DFC_LinHdrTimeoutErrACG" VALUE 0x80504426 Val_Wu16 65535.00 DFES_OneToOne 0.00 65535.00 FORMAT "%8.2" /end CHARACTERISTIC
/begin CHARACTERISTIC DFES_DTCO.DFC_LinHdrTimeoutErrAEV_C "OBD specific trouble code / OBD specific diagnostic trouble code for check DFC_LinHdrTimeoutErrAEV" VALUE 0x80504428 Val_Wu16 65535.00 DFES_OneToOne 0.00 65535.00 FORMAT "%8.2" /end CHARACTERISTIC
/begin FUNCTION DFES "30000.73.0_2.0.0Diagnostic Fault Event Storage"
 /begin DEF_CHARACTERISTIC DFES_Cls.DFC_MfPsDiaScHiS1_C DFES_Cls.DFC_MfPsDiaScHiSLowS1_C DFES_Cls.DFC_MfPsDiaScLowS1_C DFES_Cls.DFC_ACEvpTPhysRngHi_C DFES_Cls.DFC_ACEvpTPhysRngLo_C DFES_Cls.DFC_ACEvpTSRCMax_C DFES_Cls.DFC_ACEvpTSRCMin_C DFES_Cls.DFC_AfsRawSigRngHiB1_C DFES_Cls.DFC_AfsRawSigRngLoB1_C DFES_Cls.DFC_AfsSnsrErrB1_C DFES_Cls.DFC_AirCClntPAnaSRCMax_C DFES_Cls.DFC_AirCClntPAnaSRCMin_C DFES_Cls.DFC_AirCSwtNpl_C DFES_Cls.DFC_AirCSwtSig_C DFES_Cls.DFC_Brk_C DFES_Cls.DFC_BrkBstSensSCB_C DFES_Cls.DFC_BrkBstSensSCG_C DFES_Cls.DFC_BrkSig_C DFES_Cls.DFC_ClthSig_C DFES_Cls.DFC_EGRVlvCurrLim_C DFES_Cls.DFC_EGRVlvOL_C DFES_Cls.DFC_EGRVlvOvrTemp_C DFES_Cls.DFC_EGRVlvSCB_C DFES_Cls.DFC_EGRVlvSCG_C DFES_Cls.DFC_EGRVlvSRCMax_C DFES_Cls.DFC_EGRVlvSRCMin_C DFES_Cls.DFC_HLSDemOvhtEngLim_C DFES_Cls.DFC_OilPSwmpSRCMax_C DFES_Cls.DFC_OilPSwmpSRCMin_C DFES_Cls.DFC_PIntkVUsLineHiB1_C DFES_Cls.DFC_PIntkVUsLineLoB1_C DFES_Cls.DFC_VehVPhysRngLo_C DFES_Cls.DFC_VehVSigCan_C DFES_Cls.DFC_VehVSigCanSafe_C DFES_Cls.DFC_VlvLftFbOilPSnsrIntk11SRCMax_C DFES_Cls.DFC_VlvLftFbOilPSnsrIntk11SRCMin_C DFES_Cls.DFC_ClthNpl_C DFES_Cls.DFC_GbxPNPosnDrvCdn_C DFES_Cls.DFC_GbxPNPosnPlausy_C DFES_Cls.DFC_AfsSigErrLineHiB1_C DFES_Cls.DFC_AfsSigErrLineLoB1_C DFES_Cls.DFC_PEnvCcMax_C DFES_Cls.DFC_PEnvCcMin_C DFES_Cls.DFC_PEnvRngChkMax_C DFES_Cls.DFC_PEnvRngChkMin_C DFES_Cls.DFC_PEnvSnsrPlaus_C DFES_Cls.DFC_UEGOHeatrRlyPsOLS1B1_C DFES_Cls.DFC_UEGOHeatrRlyPsSCBS1B1_C DFES_Cls.DFC_UEGOHeatrRlyPsSCGS1B1_C DFES_Cls.DFC_UegoHeatrWireOlS1B1_C DFES_Cls.DFC_UegoHeatrWireScbS1B1_C DFES_Cls.DFC_UegoHeatrWireScgS1B1_C DFES_Cls.DFC_KnDetSens1PortAMax_C DFES_Cls.DFC_KnDetSens1PortAMin_C DFES_Cls.DFC_KnDetSens1PortBMax_C DFES_Cls.DFC_KnDetSens1PortBMin_C DFES_Cls.DFC_Clth2ONStuck_C DFES_Cls.DFC_Clth2ONStuckLdc_C DFES_Cls.DFC_Clth3ONStuckLdc_C DFES_Cls.DFC_Clth3ONStuckPostDrv_C DFES_Cls.DFC_Clth4ONStuck_C DFES_Cls.DFC_Clth4ONStuckLdc_C DFES_Cls.DFC_ComBCMUnit_C DFES_Cls.DFC_ComDLCTCU01_C DFES_Cls.DFC_ComDLCTCU02_C DFES_Cls.DFC_ComDLCTCU1_C DFES_Cls.DFC_ComDLCTCU11_C DFES_Cls.DFC_ComDLCTCU12_C DFES_Cls.DFC_ComDLCTCU13_C DFES_Cls.DFC_ComDLCTCU14_C DFES_Cls.DFC_ComDLCTCU2_C DFES_Cls.DFC_ComDLCTCU3_C DFES_Cls.DFC_ComDLCTCU4_C DFES_Cls.DFC_ComEPSUnit_C DFES_Cls.DFC_ComIDASBUnit_C DFES_Cls.DFC_ComIMGUnit_C DFES_Cls.DFC_ComMETUnit_C DFES_Cls.DFC_ComSRSUnit_C DFES_Cls.DFC_ComVSAUnit_C DFES_Cls.DFC_EbsSocFlt_C DFES_Cls.DFC_I14229VINErr_C DFES_Cls.DFC_InjCatHeatgErr_C DFES_Cls.DFC_InjSysMulInjDiagErr_C DFES_Cls.DFC_LLRHmax_C DFES_Cls.DFC_LLRHmin_C DFES_Cls.DFC_LLRHnpl_C DFES_Cls.DFC_LLRKHmax_C DFES_Cls.DFC_LLRKHmin_C DFES_Cls.DFC_LLRKHnpl_C DFES_Cls.DFC_LinACGUnit_C DFES_Cls.DFC_LinAEVUnit_C DFES_Cls.DFC_LinEBSUnit_C DFES_Cls.DFC_RoughRoad_C DFES_Cls.DFC_SiaEEPRdErr_C DFES_Cls.DFC_SiaEEPWrngCod_C DFES_Cls.DFC_UegoHeatrStrtS1B1_C DFES_Cls.DFC_BusDiagCANAPPLBusOff_C DFES_Cls.DFC_BusDiagCANCANCBusOff_C DFES_Cls.DFC_BusDiagCANVEHICLEBusOff_C DFES_Cls.DFC_RBA_IODIAGPWR_rba_IoExtCy329_SignalVltSply_0_C DFES_Cls.DFC_RBA_IODIAGPWR_rba_IoExtCy329_SignalVltSply_0OT_C DFES_Cls.DFC_RBA_IODIAGPWR_rba_IoExtCy329_SignalVltSply_0OV_C DFES_Cls.DFC_RBA_IODIAGPWR_rba_IoExtCy329_SignalVltSply_0SCG_C DFES_Cls.DFC_RBA_IODIAGPWR_rba_IoExtCy329_SignalVltSply_0UV_C DFES_Cls.DFC_RBA_IODIAGPWR_rba_IoExtCy329_SignalVltSply_1_C DFES_Cls.DFC_RBA_IODIAGPWR_rba_IoExtCy329_SignalVltSply_1OT_C DFES_Cls.DFC_RBA_IODIAGPWR_rba_IoExtCy329_SignalVltSply_1OV_C DFES_Cls.DFC_RBA_IODIAGPWR_rba_IoExtCy329_SignalVltSply_1SCG_C DFES_Cls.DFC_RBA_IODIAGPWR_rba_IoExtCy329_SignalVltSply_1UV_C DFES_Cls.DFC_RBA_IODIAGPWR_rba_IoExtCy329_SignalVltSply_2_C DFES_Cls.DFC_RBA_IODIAGPWR_rba_IoExtCy329_SignalVltSply_2OT_C DFES_Cls.DFC_RBA_IODIAGPWR_rba_IoExtCy329_SignalVltSply_2OV_C DFES_Cls.DFC_RBA_IODIAGPWR_rba_IoExtCy329_SignalVltSply_2SCG_C DFES_Cls.DFC_RBA_IODIAGPWR_rba_IoExtCy329_SignalVltSply_2UV_C DFES_Cls.DFC_CAN_E_TIMEOUT_C DFES_Cls.DFC_LIN_E_TIMEOUT_C DFES_Cls.DFC_MRlyOL_C DFES_Cls.DFC_MRlySCB_C DFES_Cls.DFC_MRlySCG_C DFES_Cls.DFC_rba_MultiStackTrace_Threshold_C DFES_Cls.DFC_BSWM_E_ACTION_FAILED_C DFES_Cls.DFC_BSWM_E_INTRPTQUEUE_FULL_C DFES_Cls.DFC_RBA_IOEXTLIB_KEEPALIVE_DRV_C DFES_Cls.DFC_RBA_IOEXTLIB_KEEPALIVE_INI_C DFES_Cls.DFC_rba_IoSigRtc_StopCounter_C DFES_Cls.DFC_rba_MRly_Diag_Stk_Event_C DFES_Cls.DFC_rba_MemDiag_MemReadErr_C DFES_Cls.DFC_rba_MemDiag_MemWrErr_C DFES_Cls.DFC_rba_SyC_IrrSwOffTrigEngRun_Event_C DFES_Cls.DFC_rba_T15_Diag_ComInVld_Event_C DFES_Cls.DFC_rba_T15_Diag_ComOff_HwOn_Event_C DFES_Cls.DFC_rba_T15_Diag_ComOn_HwOff_Event_C DFES_Cls.DFC_AAVmin_C DFES_Cls.DFC_AGRSUS_C DFES_Cls.DFC_AfsPlausDiagHi_C DFES_Cls.DFC_AfsPlausDiagLo_C DFES_Cls.DFC_AfsVrntDiagErrB1_C DFES_Cls.DFC_AppAllSnsrDfct_C DFES_Cls.DFC_BBKRnldg_C DFES_Cls.DFC_BBKRsyne_C DFES_Cls.DFC_BattUStdbyDiaOL_C DFES_Cls.DFC_BigLeakIntkMnfldEmiInfl_C DFES_Cls.DFC_BlkdLineTank_C DFES_Cls.DFC_BrkMnSwtContOnWarnLmp_C DFES_Cls.DFC_BrkMnSwtNotStpWarnLmp_C DFES_Cls.DFC_BrkRdntSwtContOnWarnLmp_C DFES_Cls.DFC_BrkRdntSwtNotStpWarnLmp_C DFES_Cls.DFC_CEngDsTColdStrtMax_C DFES_Cls.DFC_CEngDsTColdStrtMin_C DFES_Cls.DFC_CEngDsTImps_C DFES_Cls.DFC_CEngDsTPlausHSC_C DFES_Cls.DFC_CEngDsTPlausLSC_C DFES_Cls.DFC_CEngDsTPlausSTC_C DFES_Cls.DFC_CEngDsTSRCMax_C DFES_Cls.DFC_CEngDsTSRCMin_C DFES_Cls.DFC_CEngDsTSig_C DFES_Cls.DFC_CEngUsTColdStrtMax_C DFES_Cls.DFC_CEngUsTColdStrtMin_C DFES_Cls.DFC_CEngUsTLooseCnctn_C DFES_Cls.DFC_CEngUsTSRCMax_C DFES_Cls.DFC_CEngUsTSRCMin_C DFES_Cls.DFC_ComDCDCACCFailr_C DFES_Cls.DFC_DCDCFltDet_C DFES_Cls.DFC_DKRSA_C DFES_Cls.DFC_DKVSmax_C DFES_Cls.DFC_DKnpl_C DFES_Cls.DFC_DSKVRmax_C DFES_Cls.DFC_DSKVRmin_C DFES_Cls.DFC_DSKVRnpl_C DFES_Cls.DFC_DSKVRsig_C DFES_Cls.DFC_DSKVSsig_C DFES_Cls.DFC_DSSmax_C DFES_Cls.DFC_DSTDmax_C DFES_Cls.DFC_DSTEmax_C DFES_Cls.DFC_DSTEmin_C DFES_Cls.DFC_DSTOFmax_C DFES_Cls.DFC_DSTRmax_C DFES_Cls.DFC_DSTRmin_C DFES_Cls.DFC_DSTRnpl_C DFES_Cls.DFC_DSTRsig_C DFES_Cls.DFC_DSTTI_C DFES_Cls.DFC_DSUmax_C DFES_Cls.DFC_DiagCpv1DteskLoLoadStuckClsd_C DFES_Cls.DFC_DiagCpv1DteskLoLoadStuckOpen_C DFES_Cls.DFC_EGRVlvDrftClsd_C DFES_Cls.DFC_EGRVlvDrftOpn_C DFES_Cls.DFC_EGRVlvJamVlvClsd_C DFES_Cls.DFC_EGRVlvJamVlvOpn_C DFES_Cls.DFC_EGRVlvSprgBrk_C DFES_Cls.DFC_EGRVlvTempMdlEEPErr_C DFES_Cls.DFC_EGRVlvTmpErr_C DFES_Cls.DFC_EGSDUS2B1LtrDly_C DFES_Cls.DFC_EGSDUS2B1LtrPT1_C DFES_Cls.DFC_EGSDUS2B1RtlDly_C DFES_Cls.DFC_EGSDUS2B1RtlPT1_C DFES_Cls.DFC_EGSDUS2B1TarLean_C DFES_Cls.DFC_EGSDUS2B1TarRich_C DFES_Cls.DFC_EONVmax_C DFES_Cls.DFC_ETAKHLmax_C DFES_Cls.DFC_ETAKHTmax_C DFES_Cls.DFC_ETHSEmax_C DFES_Cls.DFC_ETHSEmin_C DFES_Cls.DFC_ETHSFmax_C DFES_Cls.DFC_ETHSFmin_C DFES_Cls.DFC_ETHSFsig_C DFES_Cls.DFC_ETHSNPWmax_C DFES_Cls.DFC_ETHSNPWmin_C DFES_Cls.DFC_ETHSNPWsig_C DFES_Cls.DFC_ETHSPLnpl_C DFES_Cls.DFC_ETHSTPLnpl_C DFES_Cls.DFC_EngICO_C DFES_Cls.DFC_EngPrtOvrSpdMon_C DFES_Cls.DFC_EpmCaSI1ErrSig_C DFES_Cls.DFC_EpmCaSI1MntErr_C DFES_Cls.DFC_EpmCaSI1NoSigMax_C DFES_Cls.DFC_EpmCaSI1NoSigMin_C DFES_Cls.DFC_EpmCaSI1OfsErr_C DFES_Cls.DFC_EpmCrSDGI_C DFES_Cls.DFC_EpmCrSErrSig_C DFES_Cls.DFC_EpmCrSNoSig_C DFES_Cls.DFC_EtaEngIdleNonCsers_C DFES_Cls.DFC_EtaEngPtlNonCsers_C DFES_Cls.DFC_FRAmax_C DFES_Cls.DFC_FRAmin_C DFES_Cls.DFC_FSTEmax_C DFES_Cls.DFC_FSTEmin_C DFES_Cls.DFC_FSTRmax_C DFES_Cls.DFC_FSTRmin_C DFES_Cls.DFC_FSTRnpl_C DFES_Cls.DFC_FSTmax_C DFES_Cls.DFC_FTDLAmax_C DFES_Cls.DFC_FTDLAmin_C DFES_Cls.DFC_FuPHiSnsrEleclmax_C DFES_Cls.DFC_FuPHiSnsrEleclmin_C DFES_Cls.DFC_FuPHiSnsrEleclnpl_C DFES_Cls.DFC_FuPHiSnsrURngMax_C DFES_Cls.DFC_FuPHiSnsrURngMin_C DFES_Cls.DFC_FuSnsrPhyRngMaxErr_C DFES_Cls.DFC_FuSnsrPhyRngMinErr_C DFES_Cls.DFC_GEVlvLockPinDiagIntkB1_C DFES_Cls.DFC_GEVlvPhaSlowIntkB1_C DFES_Cls.DFC_GEVlvPhaTargIntkB1_C DFES_Cls.DFC_GbxRvsSwtStk_C DFES_Cls.DFC_HDRKHmax_C DFES_Cls.DFC_HDRKHmin_C DFES_Cls.DFC_HDRPLmax_C DFES_Cls.DFC_HDRPLmin_C DFES_Cls.DFC_HDRmax_C DFES_Cls.DFC_HDRmin_C DFES_Cls.DFC_HEGOS2B1ElecMax_C DFES_Cls.DFC_HEGOS2B1ElecMin_C DFES_Cls.DFC_HEGOS2B1ElecSig_C DFES_Cls.DFC_HEGOS2B1HtgNpl_C DFES_Cls.DFC_HEV00max_C DFES_Cls.DFC_HEV01max_C DFES_Cls.DFC_HEV02max_C DFES_Cls.DFC_HEV03max_C DFES_Cls.DFC_HEVE0max_C DFES_Cls.DFC_HEVE1max_C DFES_Cls.DFC_HFMmax_C DFES_Cls.DFC_HiPSysHiPMaxLimExcdd_C DFES_Cls.DFC_IVGdiCtlCvoErrMax_0_C DFES_Cls.DFC_IVGdiCtlCvoErrMax_1_C DFES_Cls.DFC_IVGdiCtlCvoErrMax_2_C DFES_Cls.DFC_IVGdiCtlCvoErrMax_3_C DFES_Cls.DFC_IVGdiCtlCvoErrMin_0_C DFES_Cls.DFC_IVGdiCtlCvoErrMin_1_C DFES_Cls.DFC_IVGdiCtlCvoErrMin_2_C DFES_Cls.DFC_IVGdiCtlCvoErrMin_3_C DFES_Cls.DFC_IVGdiCtlCvoErrMinMax_C DFES_Cls.DFC_IVGdiCtlCvoSigPlausErrSmrCdn_C DFES_Cls.DFC_IVGdiCtl_CvoErr_C DFES_Cls.DFC_IVGdiCtl_CvoSigPlaus_0_C DFES_Cls.DFC_IVGdiCtl_CvoSigPlaus_1_C DFES_Cls.DFC_IVGdiCtl_CvoSigPlaus_2_C DFES_Cls.DFC_IVGdiCtl_CvoSigPlaus_3_C DFES_Cls.DFC_IntkAirTAirFltDsCrssMax_C DFES_Cls.DFC_IntkAirTAirFltDsCrssMin_C DFES_Cls.DFC_IntkAirTAirFltDsHSCMax_C DFES_Cls.DFC_IntkAirTAirFltDsImps_C DFES_Cls.DFC_IntkAirTAirFltDsPRCMax_C DFES_Cls.DFC_IntkAirTAirFltDsPRCMin_C DFES_Cls.DFC_IntkAirTAirFltDsSRCMax_C DFES_Cls.DFC_IntkAirTAirFltDsSRCMin_C DFES_Cls.DFC_IntkAirTAirFltDsSTC_C DFES_Cls.DFC_IntkAirTIntkMnfldCrssMax_C DFES_Cls.DFC_IntkAirTIntkMnfldCrssMin_C DFES_Cls.DFC_IntkAirTIntkMnfldHSCMax_C DFES_Cls.DFC_IntkAirTIntkMnfldImps_C DFES_Cls.DFC_IntkAirTIntkMnfldPRCMax_C DFES_Cls.DFC_IntkAirTIntkMnfldPRCMin_C DFES_Cls.DFC_IntkAirTIntkMnfldSRCMax_C DFES_Cls.DFC_IntkAirTIntkMnfldSRCMin_C DFES_Cls.DFC_IntkAirTIntkMnfldSTC_C DFES_Cls.DFC_KRREGRLMX_C DFES_Cls.DFC_KRVEKOCVLCI_C DFES_Cls.DFC_KRVEKOENCHMT_C DFES_Cls.DFC_KRVEKOENCHMT0_C DFES_Cls.DFC_KRVEKOENCHMT1_C DFES_Cls.DFC_KRVEKOENCHMT2_C DFES_Cls.DFC_KRVEKOENCHMT3_C DFES_Cls.DFC_KRVEKOENCHMT4_C DFES_Cls.DFC_KRVEKOENCHMT5_C DFES_Cls.DFC_KRVEKOENCHMT6_C DFES_Cls.DFC_KRVEKOENCHMT7_C DFES_Cls.DFC_KRVEKORLMX_C DFES_Cls.DFC_KRVEKORLMXL_C DFES_Cls.DFC_KS1max_C DFES_Cls.DFC_KS1min_C DFES_Cls.DFC_LMmax_C DFES_Cls.DFC_LZSRnpl_C DFES_Cls.DFC_LamDynDiagS1B1_C DFES_Cls.DFC_LeakIntkMnfldEmiInfl_C DFES_Cls.DFC_LinFrameErrDCDC_C DFES_Cls.DFC_LinOverrunErrDCDC_C DFES_Cls.DFC_MD00max_C DFES_Cls.DFC_MDBmax_C DFES_Cls.DFC_MDCat_C DFES_Cls.DFC_MDCatCrit_C DFES_Cls.DFC_MDCatCurr_C DFES_Cls.DFC_MDCyl_0_C DFES_Cls.DFC_MDCyl_1_C DFES_Cls.DFC_MDCyl_2_C DFES_Cls.DFC_MDCyl_3_C DFES_Cls.DFC_MDEmi_C DFES_Cls.DFC_MDEmiStrt_C DFES_Cls.DFC_MDFco_C DFES_Cls.DFC_MDMpl_C DFES_Cls.DFC_MDSegTiAdpn_C DFES_Cls.DFC_MDmax_C DFES_Cls.DFC_MFuOilMax_C DFES_Cls.DFC_MOXEMM_SMU_ALM0_0_C DFES_Cls.DFC_MOXEMM_SMU_ALM0_1_C DFES_Cls.DFC_MOXEMM_SMU_ALM0_10_C DFES_Cls.DFC_MOXEMM_SMU_ALM0_11_C DFES_Cls.DFC_MOXEMM_SMU_ALM0_13_C DFES_Cls.DFC_MOXEMM_SMU_ALM0_14_C DFES_Cls.DFC_MOXEMM_SMU_ALM0_2_C DFES_Cls.DFC_MOXEMM_SMU_ALM0_22_C DFES_Cls.DFC_MOXEMM_SMU_ALM0_23_C DFES_Cls.DFC_MOXEMM_SMU_ALM0_4_C DFES_Cls.DFC_MOXEMM_SMU_ALM0_5_C DFES_Cls.DFC_MOXEMM_SMU_ALM0_7_C DFES_Cls.DFC_MOXEMM_SMU_ALM0_8_C DFES_Cls.DFC_MOXEMM_SMU_ALM10_16_C DFES_Cls.DFC_MOXEMM_SMU_ALM10_17_C DFES_Cls.DFC_MOXEMM_SMU_ALM10_21_C DFES_Cls.DFC_MOXEMM_SMU_ALM11_0_C DFES_Cls.DFC_MOXEMM_SMU_ALM11_1_C DFES_Cls.DFC_MOXEMM_SMU_ALM11_2_C DFES_Cls.DFC_MOXEMM_SMU_ALM11_3_C DFES_Cls.DFC_MOXEMM_SMU_ALM11_4_C DFES_Cls.DFC_MOXEMM_SMU_ALM11_5_C DFES_Cls.DFC_MOXEMM_SMU_ALM11_8_C DFES_Cls.DFC_MOXEMM_SMU_ALM11_9_C DFES_Cls.DFC_MOXEMM_SMU_ALM1_0_C DFES_Cls.DFC_MOXEMM_SMU_ALM1_1_C DFES_Cls.DFC_MOXEMM_SMU_ALM1_10_C DFES_Cls.DFC_MOXEMM_SMU_ALM1_11_C DFES_Cls.DFC_MOXEMM_SMU_ALM1_13_C DFES_Cls.DFC_MOXEMM_SMU_ALM1_14_C DFES_Cls.DFC_MOXEMM_SMU_ALM1_2_C DFES_Cls.DFC_MOXEMM_SMU_ALM1_22_C DFES_Cls.DFC_MOXEMM_SMU_ALM1_23_C DFES_Cls.DFC_MOXEMM_SMU_ALM1_4_C DFES_Cls.DFC_MOXEMM_SMU_ALM1_5_C DFES_Cls.DFC_MOXEMM_SMU_ALM1_7_C DFES_Cls.DFC_MOXEMM_SMU_ALM1_8_C DFES_Cls.DFC_MOXEMM_SMU_ALM21_0_C DFES_Cls.DFC_MOXEMM_SMU_ALM21_16_C DFES_Cls.DFC_MOXEMM_SMU_ALM21_3_C DFES_Cls.DFC_MOXEMM_SMU_ALM2_1_C DFES_Cls.DFC_MOXEMM_SMU_ALM2_10_C DFES_Cls.DFC_MOXEMM_SMU_ALM2_11_C DFES_Cls.DFC_MOXEMM_SMU_ALM2_13_C DFES_Cls.DFC_MOXEMM_SMU_ALM2_14_C DFES_Cls.DFC_MOXEMM_SMU_ALM2_22_C DFES_Cls.DFC_MOXEMM_SMU_ALM2_23_C DFES_Cls.DFC_MOXEMM_SMU_ALM2_4_C DFES_Cls.DFC_MOXEMM_SMU_ALM2_5_C DFES_Cls.DFC_MOXEMM_SMU_ALM2_7_C DFES_Cls.DFC_MOXEMM_SMU_ALM2_8_C DFES_Cls.DFC_MOXEMM_SMU_ALM6_0_C DFES_Cls.DFC_MOXEMM_SMU_ALM6_11_C DFES_Cls.DFC_MOXEMM_SMU_ALM6_12_C DFES_Cls.DFC_MOXEMM_SMU_ALM6_14_C DFES_Cls.DFC_MOXEMM_SMU_ALM6_15_C DFES_Cls.DFC_MOXEMM_SMU_ALM6_17_C DFES_Cls.DFC_MOXEMM_SMU_ALM6_18_C DFES_Cls.DFC_MOXEMM_SMU_ALM6_20_C DFES_Cls.DFC_MOXEMM_SMU_ALM6_21_C DFES_Cls.DFC_MOXEMM_SMU_ALM6_25_C DFES_Cls.DFC_MOXEMM_SMU_ALM6_4_C DFES_Cls.DFC_MOXEMM_SMU_ALM6_5_C DFES_Cls.DFC_MOXEMM_SMU_ALM6_7_C DFES_Cls.DFC_MOXEMM_SMU_ALM6_8_C DFES_Cls.DFC_MOXEMM_SMU_ALM7_1_C DFES_Cls.DFC_MOXEMM_SMU_ALM7_12_C DFES_Cls.DFC_MOXEMM_SMU_ALM7_13_C DFES_Cls.DFC_MOXEMM_SMU_ALM7_14_C DFES_Cls.DFC_MOXEMM_SMU_ALM7_15_C DFES_Cls.DFC_MOXEMM_SMU_ALM7_16_C DFES_Cls.DFC_MOXEMM_SMU_ALM7_17_C DFES_Cls.DFC_MOXEMM_SMU_ALM7_2_C DFES_Cls.DFC_MOXEMM_SMU_ALM7_20_C DFES_Cls.DFC_MOXEMM_SMU_ALM7_25_C DFES_Cls.DFC_MOXEMM_SMU_ALM7_26_C DFES_Cls.DFC_MOXEMM_SMU_ALM7_28_C DFES_Cls.DFC_MOXEMM_SMU_ALM7_29_C DFES_Cls.DFC_MOXEMM_SMU_ALM7_30_C DFES_Cls.DFC_MOXEMM_SMU_ALM7_31_C DFES_Cls.DFC_MOXEMM_SMU_ALM8_0_C DFES_Cls.DFC_MOXEMM_SMU_ALM8_1_C DFES_Cls.DFC_MOXEMM_SMU_ALM8_10_C DFES_Cls.DFC_MOXEMM_SMU_ALM8_11_C DFES_Cls.DFC_MOXEMM_SMU_ALM8_12_C DFES_Cls.DFC_MOXEMM_SMU_ALM8_16_C DFES_Cls.DFC_MOXEMM_SMU_ALM8_18_C DFES_Cls.DFC_MOXEMM_SMU_ALM8_2_C DFES_Cls.DFC_MOXEMM_SMU_ALM8_3_C DFES_Cls.DFC_MOXEMM_SMU_ALM8_31_C DFES_Cls.DFC_MOXEMM_SMU_ALM8_4_C DFES_Cls.DFC_MOXEMM_SMU_ALM9_0_C DFES_Cls.DFC_MOXEMM_SMU_ALM9_15_C DFES_Cls.DFC_MOXEMM_SMU_ALM9_3_C DFES_Cls.DFC_MoCADCNTP_C DFES_Cls.DFC_MoCADCTst_C DFES_Cls.DFC_MoCSOPICO_C DFES_Cls.DFC_MoFAPP_C DFES_Cls.DFC_MoFAirFilgPrdc_C DFES_Cls.DFC_MoFAirFlCtOffGdi_C DFES_Cls.DFC_MoFAirFlCylGdi_C DFES_Cls.DFC_MoFAirFlFF_C DFES_Cls.DFC_MoFAirFlIn_C DFES_Cls.DFC_MoFAirFlMixCtlGdiChkAirFl_C DFES_Cls.DFC_MoFAirFlMixCtlGdiChkCtrl_C DFES_Cls.DFC_MoFAirFlMode_C DFES_Cls.DFC_MoFESpd_C DFES_Cls.DFC_MoFIACo_C DFES_Cls.DFC_MoFICOL1_C DFES_Cls.DFC_MoFICOL2_C DFES_Cls.DFC_MoFStrt_C DFES_Cls.DFC_MoFTrqCmp_C DFES_Cls.DFC_MoFTrqCmpMax_C DFES_Cls.DFC_MoFTrqCmpMin_C DFES_Cls.DFC_MoFVarPostBldSel_C DFES_Cls.DFC_MoXEMMHwLTMCUFW_C DFES_Cls.DFC_MoXEMMHwLTMonBIST_C DFES_Cls.DFC_MoXEMMHwLTRegMonTest_C DFES_Cls.DFC_MoXEMMHwLTStbySMUAlvTest_C DFES_Cls.DFC_MoXEMMHwLTTempSens_C DFES_Cls.DFC_MoXEMMHwLTUCBCfg_C DFES_Cls.DFC_NWSEmax_C DFES_Cls.DFC_NWSmax_C DFES_Cls.DFC_OCWDAABEActv_C DFES_Cls.DFC_OCWDACom_C DFES_Cls.DFC_OCWDAErrPin_C DFES_Cls.DFC_OCWDAOvrVltg_C DFES_Cls.DFC_ORAmax_C DFES_Cls.DFC_ORAmin_C DFES_Cls.DFC_OilPPlaus_C DFES_Cls.DFC_PLLSUmax_C DFES_Cls.DFC_PLLSUmin_C DFES_Cls.DFC_PSR1max_C DFES_Cls.DFC_PSRBmax_C DFES_Cls.DFC_PSRBmin_C DFES_Cls.DFC_PSRPmax_C DFES_Cls.DFC_PSRPmin_C DFES_Cls.DFC_PSRPsig_C DFES_Cls.DFC_PSRmax_C DFES_Cls.DFC_PUmax_C DFES_Cls.DFC_P_VSE11_OL_C DFES_Cls.DFC_P_VSE11_SCB_C DFES_Cls.DFC_P_VSE11_SCG_C DFES_Cls.DFC_PhyHighAPP1_C DFES_Cls.DFC_PhyHighAPP2_C DFES_Cls.DFC_PhyLowAPP1_C DFES_Cls.DFC_PhyLowAPP2_C DFES_Cls.DFC_SRCHighAPP1_C DFES_Cls.DFC_SRCHighAPP2_C DFES_Cls.DFC_SRCLowAPP1_C DFES_Cls.DFC_SRCLowAPP2_C DFES_Cls.DFC_SSpMon2_C DFES_Cls.DFC_STHDRmax_C DFES_Cls.DFC_SWReset_0_C DFES_Cls.DFC_SWReset_1_C DFES_Cls.DFC_SWReset_2_C DFES_Cls.DFC_SyncAPP_C DFES_Cls.DFC_TANKLnpl_C DFES_Cls.DFC_TAmax_Dummy_C DFES_Cls.DFC_TESFmax_C DFES_Cls.DFC_TESGmax_C DFES_Cls.DFC_TKAEmax_C DFES_Cls.DFC_TKAEmin_C DFES_Cls.DFC_TKARmax_C DFES_Cls.DFC_TKARnpl_C DFES_Cls.DFC_TMmax_Dummy_C DFES_Cls.DFC_TUMmax_Dummy_C DFES_Cls.DFC_TWCDPriCatB1_C DFES_Cls.DFC_ThrVlvClsdPosnFirstOffsLrnImpoB1_C DFES_Cls.DFC_ThrVlvClsdPosnOffsLrnImpoB1_C DFES_Cls.DFC_ThrVlvClsdPosnOffsLrnMaxB1_C DFES_Cls.DFC_ThrVlvClsdPosnOffsLrnMinB1_C DFES_Cls.DFC_ThrVlvCtrlDeB1_C DFES_Cls.DFC_ThrVlvDycB1_C DFES_Cls.DFC_ThrVlvLimpAirPosnMaxAbsltDriftB1_C DFES_Cls.DFC_ThrVlvLimpAirPosnMaxB1_C DFES_Cls.DFC_ThrVlvLimpAirPosnMaxRelDriftB1_C DFES_Cls.DFC_ThrVlvLimpAirPosnMinB1_C DFES_Cls.DFC_ThrVlvOpenLoadB1_C DFES_Cls.DFC_ThrVlvOpenSprgB1_C DFES_Cls.DFC_ThrVlvOpenSprgSprdB1_C DFES_Cls.DFC_ThrVlvOpenSprgTwnB1_C DFES_Cls.DFC_ThrVlvOverTB1_C DFES_Cls.DFC_ThrVlvRetSprgB1_C DFES_Cls.DFC_ThrVlvRetSprgSprdB1_C DFES_Cls.DFC_ThrVlvRetSprgTwnB1_C DFES_Cls.DFC_ThrVlvSens1MaxB1_C DFES_Cls.DFC_ThrVlvSens1NplB1_C DFES_Cls.DFC_ThrVlvSens2MaxB1_C DFES_Cls.DFC_ThrVlvSens2MinB1_C DFES_Cls.DFC_ThrVlvSens2NplB1_C DFES_Cls.DFC_ThrVlvShoCircB1_C DFES_Cls.DFC_ThrVlvSpiErrB1_C DFES_Cls.DFC_ThrvlvSens1MinB1_C DFES_Cls.DFC_TiOffTBasdChkFast_C DFES_Cls.DFC_TiOffTBasdChkSlow_C DFES_Cls.DFC_UEGOSnsrMntdS1B1_C DFES_Cls.DFC_VehVSig_C DFES_Cls.DFC_VlvLftFbSwtIntk11SpclFail_C DFES_Cls.DFC_VlvLftFbSwtIntk11StdFail_C DFES_DbLv_C DFES_DTCO.DFC_Unused_C DFES_DTCO.DFC_AAVEmax_C DFES_DTCO.DFC_AAVEmin_C DFES_DTCO.DFC_AAVEsig_C DFES_DTCO.DFC_AltIOACGFailr_C DFES_DTCO.DFC_AltIOACGHiVltg_C DFES_DTCO.DFC_AltIOACGLoVltg_C DFES_DTCO.DFC_AltIOACGTHi_C DFES_DTCO.DFC_AltIODConnACG_C DFES_DTCO.DFC_BGOELWAF_C DFES_DTCO.DFC_BattUHiFailr_C DFES_DTCO.DFC_BattULoFailr_C DFES_DTCO.DFC_BrkBstPDriftHiErr_C DFES_DTCO.DFC_BrkBstPDriftLoErr_C DFES_DTCO.DFC_BrkBstPSnsrStuck_C DFES_DTCO.DFC_BrkMnSwtContOn_C DFES_DTCO.DFC_BrkMnSwtNotStp_C DFES_DTCO.DFC_BrkNpl_C DFES_DTCO.DFC_BrkRdntSwtContOn_C DFES_DTCO.DFC_BrkRdntSwtNotStp_C DFES_DTCO.DFC_Clth3ONStuck_C DFES_DTCO.DFC_Clth4OFFStuck_C DFES_DTCO.DFC_ClthOFFStuck_C DFES_DTCO.DFC_ClthONStuck_C DFES_DTCO.DFC_ClthStkFailInfo_C DFES_DTCO.DFC_ComACFailInfo_C DFES_DTCO.DFC_ComATFTValErr_C DFES_DTCO.DFC_ComATMILReq_C DFES_DTCO.DFC_ComAYCAChksum_C DFES_DTCO.DFC_ComAYCARingCnt_C DFES_DTCO.DFC_ComAYCATOut_C DFES_DTCO.DFC_ComAYCDChkSum_C DFES_DTCO.DFC_ComAYCDTOut_C DFES_DTCO.DFC_ComAYCFChksum_C DFES_DTCO.DFC_ComAYCFRingCnt_C DFES_DTCO.DFC_ComAYCFTOut_C DFES_DTCO.DFC_ComAYCGChksum_C DFES_DTCO.DFC_ComAYCGRingCnt_C DFES_DTCO.DFC_ComAYCGTOut_C DFES_DTCO.DFC_ComAYCIChkSum_C DFES_DTCO.DFC_ComAYCIRingCnt_C DFES_DTCO.DFC_ComAYCITOut_C DFES_DTCO.DFC_ComBCM1ChkSum_C DFES_DTCO.DFC_ComBCM1RingCnt_C DFES_DTCO.DFC_ComBCM1TOut_C DFES_DTCO.DFC_ComCANABusOffErr_C DFES_DTCO.DFC_ComCANBBusOffErr_C DFES_DTCO.DFC_ComCANCBusOffErr_C DFES_DTCO.DFC_ComCGW1ChkSum_C DFES_DTCO.DFC_ComCGW1RingCnt_C DFES_DTCO.DFC_ComCGW1TOut_C DFES_DTCO.DFC_ComConvBoostErr_C DFES_DTCO.DFC_ComConvSlipErr_C DFES_DTCO.DFC_ComDCDCPrfmncErr_C DFES_DTCO.DFC_ComDCDCTempWarn_C DFES_DTCO.DFC_ComEAT10Chksum_C DFES_DTCO.DFC_ComEAT10RingCnt_C DFES_DTCO.DFC_ComEAT10TOut_C DFES_DTCO.DFC_ComEAT11ChkSum_C DFES_DTCO.DFC_ComEAT11RingCnt_C DFES_DTCO.DFC_ComEAT11TOut_C DFES_DTCO.DFC_ComEAT12ChkSum_C DFES_DTCO.DFC_ComEAT12RingCnt_C DFES_DTCO.DFC_ComEAT12TOut_C DFES_DTCO.DFC_ComEAT13ChkSum_C DFES_DTCO.DFC_ComEAT13RingCnt_C DFES_DTCO.DFC_ComEAT13TOut_C DFES_DTCO.DFC_ComEAT1Chksum_C DFES_DTCO.DFC_ComEAT1RingCnt_C DFES_DTCO.DFC_ComEAT1TOut_C DFES_DTCO.DFC_ComEAT2ChkSum_C DFES_DTCO.DFC_ComEAT2RingCnt_C DFES_DTCO.DFC_ComEAT2TOut_C DFES_DTCO.DFC_ComEAT4ChkSum_C DFES_DTCO.DFC_ComEAT4RingCnt_C DFES_DTCO.DFC_ComEAT4TOut_C DFES_DTCO.DFC_ComEAT6Chksum_C DFES_DTCO.DFC_ComEAT6RingCnt_C DFES_DTCO.DFC_ComEAT6TOut_C DFES_DTCO.DFC_ComEAT7Chksum_C DFES_DTCO.DFC_ComEAT7RingCnt_C DFES_DTCO.DFC_ComEAT7TOut_C DFES_DTCO.DFC_ComEAT8Chksum_C DFES_DTCO.DFC_ComEAT8RingCnt_C DFES_DTCO.DFC_ComEAT8TOut_C DFES_DTCO.DFC_ComEATAChksum_C DFES_DTCO.DFC_ComEATARingCnt_C DFES_DTCO.DFC_ComEATATOut_C DFES_DTCO.DFC_ComEATBChkSum_C DFES_DTCO.DFC_ComEATBRingCnt_C DFES_DTCO.DFC_ComEATBTOut_C DFES_DTCO.DFC_ComEATCChksum_C DFES_DTCO.DFC_ComEATCRingCnt_C DFES_DTCO.DFC_ComEATCTOut_C DFES_DTCO.DFC_ComEPBBChkSum_C DFES_DTCO.DFC_ComEPBBRingCnt_C DFES_DTCO.DFC_ComEPBBTOut_C DFES_DTCO.DFC_ComEPBChksum_C DFES_DTCO.DFC_ComEPBTOut_C DFES_DTCO.DFC_ComEPBctRing_C DFES_DTCO.DFC_ComEPS1Chksum_C DFES_DTCO.DFC_ComEPS1RingCnt_C DFES_DTCO.DFC_ComEPS1TOut_C DFES_DTCO.DFC_ComEngCanRxErr_C DFES_DTCO.DFC_ComGrvySnsrErr_C DFES_DTCO.DFC_ComGwIMG1ChkSum_C DFES_DTCO.DFC_ComGwIMG1RingCnt_C DFES_DTCO.DFC_ComGwIMG1TOut_C DFES_DTCO.DFC_ComGwIMG3ChkSum_C DFES_DTCO.DFC_ComGwIMG3RingCnt_C DFES_DTCO.DFC_ComGwIMG3TOut_C DFES_DTCO.DFC_ComGwIMG4ChkSum_C DFES_DTCO.DFC_ComGwIMG4RingCnt_C DFES_DTCO.DFC_ComGwIMG4TOut_C DFES_DTCO.DFC_ComGwIMG5ChkSum_C DFES_DTCO.DFC_ComGwIMG5RingCnt_C DFES_DTCO.DFC_ComGwIMG5TOut_C DFES_DTCO.DFC_ComGwIMG6ChkSum_C DFES_DTCO.DFC_ComGwIMG6RingCnt_C DFES_DTCO.DFC_ComGwIMG6TOut_C DFES_DTCO.DFC_ComIDASBChksum_C DFES_DTCO.DFC_ComIDASBRingCnt_C DFES_DTCO.DFC_ComIDASBTOut_C DFES_DTCO.DFC_ComIMGMILReq_C DFES_DTCO.DFC_ComISSPrms_C DFES_DTCO.DFC_ComMETAChksum_C DFES_DTCO.DFC_ComMETAChksumPstDrv_C DFES_DTCO.DFC_ComMETARingCnt_C DFES_DTCO.DFC_ComMETARingCntPstDrv_C DFES_DTCO.DFC_ComMETATOut_C DFES_DTCO.DFC_ComMETATOutPstDrv_C DFES_DTCO.DFC_ComMETCChksum_C DFES_DTCO.DFC_ComMETCRingCnt_C DFES_DTCO.DFC_ComMETCTOut_C DFES_DTCO.DFC_ComMETDChksum_C DFES_DTCO.DFC_ComMETDRingCnt_C DFES_DTCO.DFC_ComMETDTOut_C DFES_DTCO.DFC_ComMETE2Chksum_C DFES_DTCO.DFC_ComMETE2RingCnt_C DFES_DTCO.DFC_ComMETE2TOut_C DFES_DTCO.DFC_ComMETFChksum_C DFES_DTCO.DFC_ComMETFRingCnt_C DFES_DTCO.DFC_ComMETFTOut_C DFES_DTCO.DFC_ComMETGChksum_C DFES_DTCO.DFC_ComMETGRingCnt_C DFES_DTCO.DFC_ComMETGTOut_C DFES_DTCO.DFC_ComMETH2Chksum_C DFES_DTCO.DFC_ComMETH2RingCnt_C DFES_DTCO.DFC_ComMETH2TOut_C DFES_DTCO.DFC_ComMETHChksum_C DFES_DTCO.DFC_ComMETHRingCnt_C DFES_DTCO.DFC_ComMETHTOut_C DFES_DTCO.DFC_ComMETIChksum_C DFES_DTCO.DFC_ComMETIRingCnt_C DFES_DTCO.DFC_ComMETITOut_C DFES_DTCO.DFC_ComMETKChksum_C DFES_DTCO.DFC_ComMETKRingCnt_C DFES_DTCO.DFC_ComMETKTOut_C DFES_DTCO.DFC_ComMETLChksum_C DFES_DTCO.DFC_ComMETLRingCnt_C DFES_DTCO.DFC_ComMETLTOut_C DFES_DTCO.DFC_ComMETMChksum_C DFES_DTCO.DFC_ComMETMRingCnt_C DFES_DTCO.DFC_ComMETMTOut_C DFES_DTCO.DFC_ComMETNChksum_C DFES_DTCO.DFC_ComMETNRingCnt_C DFES_DTCO.DFC_ComMETNTOut_C DFES_DTCO.DFC_ComMtrCom_C DFES_DTCO.DFC_ComPCUChkSum_C DFES_DTCO.DFC_ComPCURingCnt_C DFES_DTCO.DFC_ComPCUTOut_C DFES_DTCO.DFC_ComSRSAChksum_C DFES_DTCO.DFC_ComSRSARingCnt_C DFES_DTCO.DFC_ComSRSATOut_C DFES_DTCO.DFC_ComSRSBChksum_C DFES_DTCO.DFC_ComSRSBRingCnt_C DFES_DTCO.DFC_ComSRSBTOut_C DFES_DTCO.DFC_ComSRSChksum_C DFES_DTCO.DFC_ComSRSErr_C DFES_DTCO.DFC_ComSRSRingCnt_C DFES_DTCO.DFC_ComSRSTOut_C DFES_DTCO.DFC_ComVehSpdPndFltTCU_C DFES_DTCO.DFC_EbsChartcCurrErr_C DFES_DTCO.DFC_EbsSelfDiagErr_C DFES_DTCO.DFC_GEVlvPhaCsersIntkB1_C DFES_DTCO.DFC_GEVlvPhaPsOpenLoadIntkB1_C DFES_DTCO.DFC_GEVlvPhaPsShoToBattIntkB1_C DFES_DTCO.DFC_GEVlvPhaPsShoToGndIntkB1_C DFES_DTCO.DFC_GbxCANDigPlausErr_C DFES_DTCO.DFC_GbxNPos1SRCMax_C DFES_DTCO.DFC_GbxNPos1SRCMin_C DFES_DTCO.DFC_GbxNPos2SRCMax_C DFES_DTCO.DFC_GbxNPos2SRCMin_C DFES_DTCO.DFC_GbxNPosAlvChk_C DFES_DTCO.DFC_GbxNPosSyncErr_C DFES_DTCO.DFC_HEGOS2B1HtrPsMax_C DFES_DTCO.DFC_HEGOS2B1HtrPsMin_C DFES_DTCO.DFC_HEGOS2B1HtrPsSig_C DFES_DTCO.DFC_LinCSErrACG_C DFES_DTCO.DFC_LinCSErrAEV_C DFES_DTCO.DFC_LinCSErrDCDC_C DFES_DTCO.DFC_LinCSErrEBS_C DFES_DTCO.DFC_LinHdrTimeoutErrACG_C DFES_DTCO.DFC_LinHdrTimeoutErrAEV_C /end DEF_CHARACTERISTIC
 FUNCTION_VERSION "30000.73.0_2.0.0" /end FUNCTION
/begin COMPU_METHOD DFES_OneToOne "" RAT_FUNC "%6.2" "-" COEFFS 0 1 0 0 0 1 /end COMPU_METHOD
/begin RECORD_LAYOUT Val_Wu16 FNC_VALUES 1 UWORD COLUMN_DIR DIRECT /end RECORD_LAYOUT
/begin RECORD_LAYOUT Val_Wu8 FNC_VALUES 1 UBYTE COLUMN_DIR DIRECT /end RECORD_LAYOUT
/end MODULE
/end PROJECT
