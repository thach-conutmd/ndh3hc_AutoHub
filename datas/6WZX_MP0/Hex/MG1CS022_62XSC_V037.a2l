ASAP2_VERSION 1 60
/begin PROJECT MG1CS022 "MG1CS022"
/begin HEADER "" VERSION "MG1CS022_62XSC_V037" PROJECT_NO MG1CS022 /end HEADER
/begin MODULE DIM ""
/begin MOD_COMMON "" BYTE_ORDER MSB_LAST ALIGNMENT_BYTE 1 ALIGNMENT_WORD 2 ALIGNMENT_LONG 4 ALIGNMENT_INT64 4 ALIGNMENT_FLOAT32_IEEE 4 ALIGNMENT_FLOAT64_IEEE 4 DATA_SIZE 32 /end MOD_COMMON
/begin CHARACTERISTIC AGRVPO "The upper limit of the hysteresis beyond which the bit B_agrofkl is set" VALUE 0x8051DE78 RB_Val_Wu16 99.99847 rel_uw_b100 0.00 99.99847 FORMAT "%8.5" /end CHARACTERISTIC
/begin CHARACTERISTIC AGRVPOFF "smallest actual valve position for consideration of offset" VALUE 0x8051DE7A RB_Val_Wu16 99.99847 rel_uw_b100 0.00 99.99847 FORMAT "%8.5" /end CHARACTERISTIC
/begin CHARACTERISTIC AHENSADMX "misfire frequency to switch off afterstart adaptation" VALUE 0x8051D706 RB_Val_Wu16 65535.00 dez 0.00 65535.00 FORMAT "%8.2" /end CHARACTERISTIC
/begin CHARACTERISTIC AirMod_facAdpnFastDftVal_C "factor integrator of fast adaptation" VALUE 0x8051D736 RB_Val_Wu16 99.99847 k10ms_uw_b100 0.00 99.99847 FORMAT "%8.5" /end CHARACTERISTIC
/begin CHARACTERISTIC AirMod_facAdpnFastMax_C "Max limit for fast adaptation" VALUE 0x8051D738 RB_Val_Wu16 1.999969 fak_q3p0518Em5 0.00 1.999969 FORMAT "%8.6" /end CHARACTERISTIC
/begin CHARACTERISTIC AirMod_facAdpnFastMin_C "Min limit for fast adaptation" VALUE 0x8051D73A RB_Val_Wu16 1.999969 fak_q3p0518Em5 0.00 1.999969 FORMAT "%8.6" /end CHARACTERISTIC
/begin CHARACTERISTIC AirMod_facAdpnFastWithSlow_T "Factor integrator of fast adapatation with slow adaptation in parallel." CURVE 0x8051D73C RB_Curve_S16_U16_Static 99.99847 k10ms_uw_b100 0.00 99.99847 FORMAT "%8.5"
 /begin AXIS_DESCR STD_AXIS Epm_nEng EngN 8 -16384.00 16383.50 FORMAT "%8.2" DEPOSIT ABSOLUTE /end AXIS_DESCR
/end CHARACTERISTIC
/begin CHARACTERISTIC AirMod_facAdpnFastWoSlow_T "Factor integrator of fast adapatation without slow adaptation in parallel." CURVE 0x8051D75E RB_Curve_S16_U16_Static 99.99847 k10ms_uw_b100 0.00 99.99847 FORMAT "%8.5"
 /begin AXIS_DESCR STD_AXIS Epm_nEng EngN 8 -16384.00 16383.50 FORMAT "%8.2" DEPOSIT ABSOLUTE /end AXIS_DESCR
/end CHARACTERISTIC
/begin CHARACTERISTIC AirMod_facDiffRlFastDbnd_C "limit deadband for differnce in relative air charge for fast adaptation" VALUE 0x8051D780 RB_Val_Ws16 0.9999695 fak_q3p0518Em5 0.00 0.9999695 FORMAT "%9.7" EXTENDED_LIMITS -1.000000 0.9999695 /end CHARACTERISTIC
/begin CHARACTERISTIC AirMod_facPAdpnFastMax_C "max limit for release of fast adaptation (additonally to release for slow adaptation) based on pressure ratio" VALUE 0x8051D782 RB_Val_Wu16 1.999969 fak_uw_b2 0.00 1.999969 FORMAT "%8.6" /end CHARACTERISTIC
/begin CHARACTERISTIC AirMod_facPAdpnFastMin_C "min limit for release of fast adaptation (additonally to release for slow adaptation) based on pressure ratio" VALUE 0x8051D784 RB_Val_Wu16 1.999969 fak_uw_b2 0.00 1.999969 FORMAT "%8.6" /end CHARACTERISTIC
/begin CHARACTERISTIC AirMod_flgFastAdpnEna_C "code word: activation of fast adaptation" VALUE 0x8051D786 RB_Val_Wboolean 1.00000000000 B_TRUE 0.00 1.00000000000 FORMAT "%13.11" /end CHARACTERISTIC
/begin CHARACTERISTIC AirMod_pDeltaLeakIntkMnfldEgrOffs_M "offset for delta threshold between modelled and measured intake manifold pressure for detection of leakage in intake manifold without dead zone with EGR" MAP 0x8051D788 RB_Map_U16S16_S16 2559.961 p_q0p039 -1280.000 1279.961 FORMAT "%8.3"
 /begin AXIS_DESCR STD_AXIS msagr_w_msg m_uw_b6553p5 8 0.00 6553.500 FORMAT "%8.3" DEPOSIT ABSOLUTE /end AXIS_DESCR
 /begin AXIS_DESCR STD_AXIS Epm_nEng EngN 8 -16384.00 16383.50 FORMAT "%8.2" DEPOSIT ABSOLUTE /end AXIS_DESCR
/end CHARACTERISTIC
/begin CHARACTERISTIC AirMod_pDeltaLeakIntkMnfldEgr_M "delta threshold between modelled and measured intake manifold pressure for detection of leakage in intake manifold without dead zone with EGR" MAP 0x8051D82C RB_Map_U16S16_S16 2559.961 p_q0p039 -1280.000 1279.961 FORMAT "%8.3"
 /begin AXIS_DESCR STD_AXIS PEnv_p p_q0p039 8 0.00 2559.961 FORMAT "%8.3" DEPOSIT ABSOLUTE /end AXIS_DESCR
 /begin AXIS_DESCR STD_AXIS Epm_nEng EngN 8 -16384.00 16383.50 FORMAT "%8.2" DEPOSIT ABSOLUTE /end AXIS_DESCR
/end CHARACTERISTIC
/begin CHARACTERISTIC AirMod_ratAppThdLeakIntkMnfldDiag_C "Threshold of accelerator pedal position for offset adaption of air mass flow through throttle valve in case of running engine" VALUE 0x8051D8D0 RB_Val_Ws16 799.9878 Prc -400.0000 399.9878 FORMAT "%8.4" /end CHARACTERISTIC
/begin CHARACTERISTIC AirMod_tiAdpnRelsFast_C "debounce time for fast adaption" VALUE 0x8051D8D2 RB_Val_Wu16 655.3500 t_q0p01 0.00 655.3500 FORMAT "%8.4" /end CHARACTERISTIC
/begin CHARACTERISTIC AirMod_tiDebCdnLeakMflowAdpn_C "Debounce time of flag for leakage massflow adaptation" VALUE 0x8051D8D4 RB_Val_Wu16 13107.00 t_q0p2 0.00 13107.00 FORMAT "%8.2" /end CHARACTERISTIC
/begin CHARACTERISTIC AirMod_tiDlyLeakMnfld_C "Threshold to adjust time for condition error" VALUE 0x8051D8D6 RB_Val_Wu8 51.00 t_q0p2 0.00 51.00 FORMAT "%5.2" /end CHARACTERISTIC
/begin CHARACTERISTIC AirMod_vVehThdLeakIntkMnfldDiag_C "Threshold of vehicle speed for offset adaption of air mass flow through throttle valve in case of running engine" VALUE 0x8051D8D8 RB_Val_Ws16 655.3500 Vel -327.6800 327.6700 FORMAT "%8.4" /end CHARACTERISTIC
/begin CHARACTERISTIC ANZTIMNSAD "threshold: number of injections til begin of evaluation ""engine roughness with warm engine""" VALUE 0x8051D708 RB_Val_Wu16 65535.00 dez 0.00 65535.00 FORMAT "%8.2" /end CHARACTERISTIC
/begin CHARACTERISTIC AZDISAGRT "max. Number of EGR shutdowns, after blocking the EGR in the driving cycle" VALUE 0x8051E994 RB_Val_Wu8 255.0 dez 0.00 255.0 FORMAT "%5.1" /end CHARACTERISTIC
/begin CHARACTERISTIC BdInt_stPCU_C "Calibration for upadting Panel control unit availability status" VALUE 0x805265A4 RB_Val_Wu8 1.000 OneToOne 0.00 1.000 FORMAT "%5.3" EXTENDED_LIMITS 0.00 255.0 /end CHARACTERISTIC
/begin CHARACTERISTIC BdInt_swtEngStopEna_C "Selection condition switch to enable engine stop" VALUE 0x805265A5 RB_Val_Wu8 255.0 OneToOne 0.00 255.0 FORMAT "%5.1" /end CHARACTERISTIC
/begin CHARACTERISTIC BdInt_swtEngStrtEna_C "Select condition switch ot enable engine start" VALUE 0x805265A6 RB_Val_Wu8 255.0 OneToOne 0.00 255.0 FORMAT "%5.1" /end CHARACTERISTIC
/begin CHARACTERISTIC BdInt_swtRstrtNoPtdEna_C "Select condition switch to enable engine start permission" VALUE 0x805265A7 RB_Val_Wu8 255.0 OneToOne 0.00 255.0 FORMAT "%5.1" /end CHARACTERISTIC
/begin CHARACTERISTIC BdInt_swtStrtEnaClthSel_C "switch for selecting clutch signal for start enable condition" VALUE 0x805265A8 RB_Val_Wu8 1.000 OneToOne 0.00 1.000 FORMAT "%5.3" EXTENDED_LIMITS 0.00 255.0 /end CHARACTERISTIC
/begin CHARACTERISTIC BdInt_tiAutoRstrtReqGr1_C "Delay time for engine restart permit 1" VALUE 0x805265AA RB_Val_Ws16 655350.0 Time_ms -327680.0 327670.0 FORMAT "%8.1" /end CHARACTERISTIC
/begin CHARACTERISTIC BdInt_tiAutoRstrtReqGr2_C "Delay time for engine restart permit 2" VALUE 0x805265AC RB_Val_Ws16 655350.0 Time_ms -327680.0 327670.0 FORMAT "%8.1" /end CHARACTERISTIC
/begin CHARACTERISTIC BdInt_tiClthOnDspReqDly_C "Delay time for clutch on display request" VALUE 0x805265B0 RB_Val_Ws32 4294.96729500 Time_Dt -2147.48364800 2147.48364700 FORMAT "%13.8" /end CHARACTERISTIC
/begin CHARACTERISTIC BdInt_tiEngHoodOpen_C "Delay time for detection of engine Hood Open Condition" VALUE 0x805265B4 RB_Val_Ws16 655350.0 Time_ms -327680.0 327670.0 FORMAT "%8.1" /end CHARACTERISTIC
/begin CHARACTERISTIC BdInt_tiRstrtNoPtdCdn_C "Delay time requesting for seat belt off to on when there is a auto restart request" VALUE 0x805265B6 RB_Val_Ws16 655350.0 Time_ms -327680.0 327670.0 FORMAT "%8.1" /end CHARACTERISTIC
/begin CHARACTERISTIC BdInt_tiSeatBltOff_C "Delay timer for seat belt off" VALUE 0x805265B8 RB_Val_Ws32 4294.96729500 Time_Dt -2147.48364800 2147.48364700 FORMAT "%13.8" /end CHARACTERISTIC
/begin CHARACTERISTIC BrkS_facDifBrkPmpAFMDec_C "Brake Pumping AFM difference decreasing factor" VALUE 0x8051E9A8 RB_Val_Wu16 0.9999847 fak_uw_b1 0.00 0.9999847 FORMAT "%9.7" /end CHARACTERISTIC
/begin CHARACTERISTIC BrkS_facDifBrkPmpAFM_C "Differential break pumping factor" VALUE 0x8051E9AA RB_Val_Wu16 0.9999847 fak_uw_b1 0.00 0.9999847 FORMAT "%9.7" /end CHARACTERISTIC
/begin CHARACTERISTIC BrkS_mfAFMDifLoadChg_C "Mass flow AFM difference load change" VALUE 0x8051E9AC RB_Val_Ws16 3276.700 m_q0p1 0.00 3276.700 FORMAT "%8.3" EXTENDED_LIMITS -3276.800 3276.700 /end CHARACTERISTIC
/begin CHARACTERISTIC BrkS_mfBrkPmpgAFMHi_C "Mass flow for break pumping AFM high value" VALUE 0x8051E9AE RB_Val_Wu16 6553.500 m_q0p1 0.00 6553.500 FORMAT "%8.3" /end CHARACTERISTIC
/begin CHARACTERISTIC BrkS_mfBrkPmpgAFMLo_C "Mass flow for break pumping AFM low value" VALUE 0x8051E9B0 RB_Val_Wu16 6553.500 m_q0p1 0.00 6553.500 FORMAT "%8.3" /end CHARACTERISTIC
/begin CHARACTERISTIC BrkS_mfIntegDbndLowrThd_C "Lower deadband threshold of integrator" VALUE 0x8051E9B2 RB_Val_Wu16 6553.500 m_q0p1 0.00 6553.500 FORMAT "%8.3" /end CHARACTERISTIC
/begin CHARACTERISTIC BrkS_mfIntegDbndUpprThd_C "Upper deadband threshold of integrator" VALUE 0x8051E9B4 RB_Val_Wu16 6553.500 m_q0p1 0.00 6553.500 FORMAT "%8.3" /end CHARACTERISTIC
/begin CHARACTERISTIC BrkS_mfIntegIniVal_C "Initial value of integrator for brake pumping" VALUE 0x8051E9B6 RB_Val_Wu16 6553.500 m_q0p1 0.00 6553.500 FORMAT "%8.3" /end CHARACTERISTIC
/begin CHARACTERISTIC BrkS_mfIntegLowrThd_C "Lower thresholf of integrated mass flow" VALUE 0x8051E9B8 RB_Val_Ws16 6553.500 m_q0p1 -3276.800 3276.700 FORMAT "%8.3" /end CHARACTERISTIC
/begin CHARACTERISTIC BrkS_mfIntegUpprThd_T "Tabel for Upper threshold of integrated air mass flow based on Ambient pressure" CURVE 0x8051E9BA RB_Curve_U16_S16_Static 6553.500 m_q0p1 -3276.800 3276.700 FORMAT "%8.3"
 /begin AXIS_DESCR STD_AXIS PEnv_p p_q0p039 5 0.00 2559.961 FORMAT "%8.3" DEPOSIT ABSOLUTE /end AXIS_DESCR
/end CHARACTERISTIC
/begin CHARACTERISTIC BrkS_mfLimBrkPmpgActvDetn_C "Air mass flow limit beyond which brake pumping is detected as active" VALUE 0x8051E9D0 RB_Val_Wu16 6553.500 m_q0p1 0.00 6553.500 FORMAT "%8.3" /end CHARACTERISTIC
/begin CHARACTERISTIC BrkS_mfLimBrkPmpgInactvDetn_C "Air mass flow limit below which brake pumping is detected as inactive" VALUE 0x8051E9D2 RB_Val_Ws16 6553.500 m_q0p1 -3276.800 3276.700 FORMAT "%8.3" /end CHARACTERISTIC
/begin CHARACTERISTIC BrkS_nEngThd_C "Threshold for Engine speed" VALUE 0x8051E9D4 RB_Val_Ws16 32767.50 EngN -16384.00 16383.50 FORMAT "%8.2" /end CHARACTERISTIC
/begin CHARACTERISTIC BrkS_pIntegDbndLowrThd_C "Lower deadband threshold of integrator" VALUE 0x8051E9D6 RB_Val_Ws16 5119.922 p_q0p078 -2560.000 2559.922 FORMAT "%8.3" /end CHARACTERISTIC
/begin CHARACTERISTIC BrkS_pIntegDbndUpprThd_C "Upper deadband threshold of integrator" VALUE 0x8051E9D8 RB_Val_Ws16 5119.922 p_q0p078 -2560.000 2559.922 FORMAT "%8.3" /end CHARACTERISTIC
/begin CHARACTERISTIC BrkS_stEnaCdn_C "Codeword in BrkS" VALUE 0x8051E9DA RB_Val_Wu16 65535.00 OneToOne 0.00 65535.00 FORMAT "%8.2" /end CHARACTERISTIC
/begin CHARACTERISTIC BrkS_stSwtBrkDetdDlyEna_C "Brake detected delay enable switch" VALUE 0x8051E9DC RB_Val_Wboolean 1.00000000000 B_TRUE 0.00 1.00000000000 FORMAT "%13.11" /end CHARACTERISTIC
/begin CHARACTERISTIC BrkS_stSwtBrkPmpDetd2Tsk_C "Brake pumping second task detected switch" VALUE 0x8051E9DD RB_Val_Wboolean 1.00000000000 B_TRUE 0.00 1.00000000000 FORMAT "%13.11" /end CHARACTERISTIC
/begin CHARACTERISTIC BrkS_stSwtBrkPmpg_C "Brake pumping switch status" VALUE 0x8051E9DE RB_Val_Wboolean 1.00000000000 B_TRUE 0.00 1.00000000000 FORMAT "%13.11" /end CHARACTERISTIC
/begin CHARACTERISTIC BrkS_tiAFMLoadChgDly_C "AFM load change delay time" VALUE 0x8051E9E0 RB_Val_Wu16 18.98000 Time_s 0.02000 19.00000 FORMAT "%8.5" EXTENDED_LIMITS 0.00 655.3500 /end CHARACTERISTIC
/begin CHARACTERISTIC BrkS_tiBrkPmpgAFMEna_C "Time for break pumping AFM enable" VALUE 0x8051E9E2 RB_Val_Wu16 655.3500 Time_s 0.00 655.3500 FORMAT "%8.4" /end CHARACTERISTIC
/begin CHARACTERISTIC BrkS_tiDlyapbrint_C "Debounce to detect condition apbrint" VALUE 0x8051E9E4 RB_Val_Ws16 25.50000 Time_s 0.00 25.50000 FORMAT "%8.5" EXTENDED_LIMITS -327.6800 327.6700 /end CHARACTERISTIC
/begin CHARACTERISTIC BrkS_tiDlyAppReleased_C "Time delay when APP released" VALUE 0x8051E9E6 RB_Val_Wu16 655.3500 Time_s 0.00 655.3500 FORMAT "%8.4" /end CHARACTERISTIC
/begin CHARACTERISTIC BrkS_tiDlyEngStrtFinshd_C "Debounce to detect engine start finished" VALUE 0x8051E9E8 RB_Val_Ws16 25.50000 Time_s 0.00 25.50000 FORMAT "%8.5" EXTENDED_LIMITS -327.6800 327.6700 /end CHARACTERISTIC
/begin CHARACTERISTIC BrkS_tiInteg_C "Reset time of integrator" VALUE 0x8051E9EC RB_Val_Ws32 4294.9672940000000 TimeDelay_s 0.0000020000000 4294.9672959999998 FORMAT "%19.14" EXTENDED_LIMITS 0.000002000000001 4294.9672959999998 /end CHARACTERISTIC
/begin CHARACTERISTIC BrkS_vVehVThd_C "Threshold for Vehicle speed" VALUE 0x8051E9F0 RB_Val_Ws16 655.3500 Vel -327.6800 327.6700 FORMAT "%8.4" /end CHARACTERISTIC
/begin CHARACTERISTIC Brk_tiBrkDetdActvTi_C "Brake Detected Active Time" VALUE 0x8051E9F2 RB_Val_Wu16 655.3500 Time_s 0.00 655.3500 FORMAT "%8.4" /end CHARACTERISTIC
/begin CHARACTERISTIC CES_CVTNRstrt_GCUR "Fuel restart-speed at transmission intervention" CURVE 0x8051D144 RB_CurveGroup_U8 10200. nmot_ub_q40 0.00 10200. FORMAT "%5.0"
 /begin AXIS_DESCR COM_AXIS CEngDsT_t temp_q0p1_o273 5 -3549.940 3003.560 FORMAT "%8.3" AXIS_PTS_REF CES_tEng_AXIS /end AXIS_DESCR
/end CHARACTERISTIC
/begin AXIS_PTS CES_Gear_AXIS "base point distribution for Tra_numGear smaller than 7" 0x8051D149 CoEng_numGearFcoLoc RB_Axis_S8 255.0 dez 12 -128.0 127.0 FORMAT "%5.1" DEPOSIT ABSOLUTE /end AXIS_PTS
/begin AXIS_PTS CES_nEngGrdt_AXIS "base point distribution for engine speed gradient" 0x8051D156 Epm_dnEngFlt RB_Axis_S16 32767.50 EngNGrd 8 -16384.00 16383.50 FORMAT "%8.2" DEPOSIT ABSOLUTE /end AXIS_PTS
/begin CHARACTERISTIC CES_nRstrtConvSlip_GMAP "Engine-speed for fuel cut-in - converter in slip mode" MAP 0x8051D168 RB_MapGroup_S16 16383.50 nmot_q0p5 0.00 16383.50 FORMAT "%8.2" EXTENDED_LIMITS -16384.00 16383.50
 /begin AXIS_DESCR COM_AXIS CEngDsT_t temp_q0p1_o273 5 -3549.940 3003.560 FORMAT "%8.3" AXIS_PTS_REF CES_tEng_AXIS /end AXIS_DESCR
 /begin AXIS_DESCR COM_AXIS CoEng_numGearFcoLoc dez 12 -128.0 127.0 FORMAT "%5.1" AXIS_PTS_REF CES_Gear_AXIS /end AXIS_DESCR
/end CHARACTERISTIC
/begin CHARACTERISTIC CES_nRstrt_GMAP "Engine-speed for fuel cut-in" MAP 0x8051D1E0 RB_MapGroup_S16 16383.50 nmot_q0p5 0.00 16383.50 FORMAT "%8.2" EXTENDED_LIMITS -16384.00 16383.50
 /begin AXIS_DESCR COM_AXIS CEngDsT_t temp_q0p1_o273 5 -3549.940 3003.560 FORMAT "%8.3" AXIS_PTS_REF CES_tEng_AXIS /end AXIS_DESCR
 /begin AXIS_DESCR COM_AXIS CoEng_numGearFcoLoc dez 12 -128.0 127.0 FORMAT "%5.1" AXIS_PTS_REF CES_Gear_AXIS /end AXIS_DESCR
/end CHARACTERISTIC
/begin CHARACTERISTIC CES_rGrip_C "Overrun and Restart: grip threshold for switching to separate calibration labels" VALUE 0x8051D258 RB_Val_Ws16 327.6700 Fact100 0.00 327.6700 FORMAT "%8.4" EXTENDED_LIMITS -327.6800 327.6700 /end CHARACTERISTIC
/begin AXIS_PTS CES_tEng_AXIS "Datapoint distribution, engine temperature, 5 datapoints" 0x8051D25A CEngDsT_t RB_Axis_S16 6553.500 temp_q0p1_o273 5 -3549.940 3003.560 FORMAT "%8.3" DEPOSIT ABSOLUTE /end AXIS_PTS
/begin AXIS_PTS CES_V_AXIS "base point distribution for vehicle velocity" 0x8051D266 VehV_v RB_Axis_S16 655.3500 vel_q0p01 5 -327.6800 327.6700 FORMAT "%8.4" DEPOSIT ABSOLUTE /end AXIS_PTS
/begin CHARACTERISTIC CLUTWMENMN "Threshold for counter clutwmen_w to reset the engine roughness enable condtion with warm engine" VALUE 0x8051D70A RB_Val_Wu16 65535.00 dez 0.00 65535.00 FORMAT "%8.2" /end CHARACTERISTIC
/begin CHARACTERISTIC CoEng_flgFcoRelsCatHeatg_C "Release fuel cutoff in catalyst heating" VALUE 0x8051D272 RB_Val_Wboolean 1.00000000000 B_TRUE 0.00 1.00000000000 FORMAT "%13.11" /end CHARACTERISTIC
/begin CHARACTERISTIC CoEng_flgSwtInhbnFcoFuSysErr_C "An error in the fuel system inhibits fuel cutoff" VALUE 0x8051D273 RB_Val_Wboolean 1.00000000000 B_TRUE 0.00 1.00000000000 FORMAT "%13.11" /end CHARACTERISTIC
/begin CHARACTERISTIC CoEng_flgUseCatWrmReq_C "Cutoff inhibition also for catalyst warming" VALUE 0x8051D274 RB_Val_Wboolean 1.00000000000 B_TRUE 0.00 1.00000000000 FORMAT "%13.11" /end CHARACTERISTIC
/begin CHARACTERISTIC CoEng_idxGearDetnSelnFco_C "Index to choose the gear signal" VALUE 0x8051D275 RB_Val_Wu8 255.0 OneToOne 0.00 255.0 FORMAT "%5.1" /end CHARACTERISTIC
/begin CHARACTERISTIC CoEng_mfFcoThdMaxEvap_C "Threshold of max. evaporation for cutoff" VALUE 0x8051D276 RB_Val_Ws16 14222.01 m_q0p2170 -7111.111 7110.894 FORMAT "%8.3" /end CHARACTERISTIC
/begin CHARACTERISTIC CoEng_nDeltaNVEngTemp_M "Increase of the engine speed limit for fuel cut-off for a certain vehicle speed range." MAP 0x8051D278 RB_Map_S16S16_S16 16383.50 nmot_q0p5 0.00 16383.50 FORMAT "%8.2" EXTENDED_LIMITS -16384.00 16383.50
 /begin AXIS_DESCR STD_AXIS VehV_v vel_q0p01 5 -327.6800 327.6700 FORMAT "%8.4" DEPOSIT ABSOLUTE /end AXIS_DESCR
 /begin AXIS_DESCR STD_AXIS CEngDsT_t Temp_Cels 5 -3549.940 3003.560 FORMAT "%8.3" DEPOSIT ABSOLUTE /end AXIS_DESCR
/end CHARACTERISTIC
/begin CHARACTERISTIC CoEng_nDeltaNVGear_M "Increase of the engine speed limit for fuel cut-off for low gears." MAP 0x8051D2C2 RB_Map_S16S8_S16 16383.50 nmot_q0p5 0.00 16383.50 FORMAT "%8.2" EXTENDED_LIMITS -16384.00 16383.50
 /begin AXIS_DESCR STD_AXIS VehV_v vel_q0p01 5 -327.6800 327.6700 FORMAT "%8.4" DEPOSIT ABSOLUTE /end AXIS_DESCR
 /begin AXIS_DESCR STD_AXIS CoEng_numGearFcoLoc OneToOne 12 -128.0 127.0 FORMAT "%5.1" DEPOSIT ABSOLUTE /end AXIS_DESCR
/end CHARACTERISTIC
/begin CHARACTERISTIC CoEng_nDeltaRstrtClimaV_T "Offset dependent on vehicle velocity for restart speed with clima compressor on." CURVE 0x8051D354 RB_Curve_S16_U8_Static 10200. nmot_ub_q40 0.00 10200. FORMAT "%5.0"
 /begin AXIS_DESCR STD_AXIS VehV_v vel_q0p01 5 -327.6800 327.6700 FORMAT "%8.4" DEPOSIT ABSOLUTE /end AXIS_DESCR
/end CHARACTERISTIC
/begin CHARACTERISTIC CoEng_nDeltaRstrtClima_GMAP "Offset to the restart speed due to the air conditioning compressor load" MAP 0x8051D366 RB_MapGroup_U8 10200. nmot_ub_q40 0.00 10200. FORMAT "%5.0"
 /begin AXIS_DESCR COM_AXIS CEngDsT_t temp_q0p1_o273 5 -3549.940 3003.560 FORMAT "%8.3" AXIS_PTS_REF CES_tEng_AXIS /end AXIS_DESCR
 /begin AXIS_DESCR COM_AXIS CoEng_numGearFcoLoc dez 12 -128.0 127.0 FORMAT "%5.1" AXIS_PTS_REF CES_Gear_AXIS /end AXIS_DESCR
/end CHARACTERISTIC
/begin CHARACTERISTIC CoEng_nDeltaRstrtEngSpdGrdAtLockExtdMod_M "An offset for engine speed limit based on CVT lock up is extended by Alt_flgLockUpCluExtnReq." MAP 0x8051D3A2 RB_Map_S16S16_U8 10200. nmot_ub_q40 0.00 10200. FORMAT "%5.0"
 /begin AXIS_DESCR STD_AXIS Epm_dnEngFlt EngNGrd 5 -16384.00 16383.50 FORMAT "%8.2" DEPOSIT ABSOLUTE /end AXIS_DESCR
 /begin AXIS_DESCR STD_AXIS VehV_v vel_q0p01 5 -327.6800 327.6700 FORMAT "%8.4" DEPOSIT ABSOLUTE /end AXIS_DESCR
/end CHARACTERISTIC
/begin CHARACTERISTIC CoEng_nDeltaRstrtEngSpdGrdAt_M "An offset for engine speed limit based on CVT lock up is not extended by Alt_flgLockUpCluExtnReq." MAP 0x8051D3D4 RB_Map_S16S16_U8 10200. nmot_ub_q40 0.00 10200. FORMAT "%5.0"
 /begin AXIS_DESCR STD_AXIS Epm_dnEngFlt EngNGrd 5 -16384.00 16383.50 FORMAT "%8.2" DEPOSIT ABSOLUTE /end AXIS_DESCR
 /begin AXIS_DESCR STD_AXIS VehV_v vel_q0p01 5 -327.6800 327.6700 FORMAT "%8.4" DEPOSIT ABSOLUTE /end AXIS_DESCR
/end CHARACTERISTIC
/begin CHARACTERISTIC CoEng_nDeltaRstrtNGrdt_M "An offset for engine speed limit based on neutral gear position" MAP 0x8051D406 RB_Map_S16S16_U8 10200. nmot_ub_q40 0.00 10200. FORMAT "%5.0"
 /begin AXIS_DESCR STD_AXIS Epm_dnEngFlt EngNGrd 8 -16384.00 16383.50 FORMAT "%8.2" DEPOSIT ABSOLUTE /end AXIS_DESCR
 /begin AXIS_DESCR STD_AXIS VehV_v vel_q0p01 5 -327.6800 327.6700 FORMAT "%8.4" DEPOSIT ABSOLUTE /end AXIS_DESCR
/end CHARACTERISTIC
/begin CHARACTERISTIC CoEng_nrCmbDlyLamSwtVlvLft_C "Number of combustions after valve lift switching for delay of lambda modification" VALUE 0x8051E9F4 RB_Val_Wu16 65535.00 OneToOne 0.00 65535.00 FORMAT "%8.2" /end CHARACTERISTIC
/begin CHARACTERISTIC CoEng_nRstrtAirCdng_C "Delta speed to restart fuel feed if air conditioning has just been switched on" VALUE 0x8051D44C RB_Val_Wu8 10200. nmot_ub_q40 0.00 10200. FORMAT "%5.0" /end CHARACTERISTIC
/begin CHARACTERISTIC CoEng_nSpLoOffs_T "Value to increase the engine speed for retsart" CURVE 0x8051D44E RB_Curve_S16_S16 16383.50 nmot_sw_q0p5 0.00 16383.50 FORMAT "%8.2" EXTENDED_LIMITS -16384.00 16383.50
 /begin AXIS_DESCR STD_AXIS HLSDem_nSetPLo nmot_sw_q0p5 6 -16384.00 16383.50 FORMAT "%8.2" DEPOSIT ABSOLUTE /end AXIS_DESCR
/end CHARACTERISTIC
/begin CHARACTERISTIC CoEng_nThdRstrtABSFailr_C "Engine speed threshold for engine restart during ABS failure" VALUE 0x8051D468 RB_Val_Ws16 32767.50 nmot_q0p5 -16384.00 16383.50 FORMAT "%8.2" /end CHARACTERISTIC
/begin CHARACTERISTIC CoEng_ratLamHomMinEth_Crv "Minimum permissible lambda for homogeneous mode in systems with ethanol sensor." CURVE 0x8051E9F6 RB_Curve_U8_U16_Static 15.99976 fak_q0p000244 0.00 15.99976 FORMAT "%8.5"
 /begin AXIS_DESCR STD_AXIS alchpct_msg rel_q0p39 5 0.00 99.61 FORMAT "%5.2" DEPOSIT ABSOLUTE /end AXIS_DESCR
/end CHARACTERISTIC
/begin CHARACTERISTIC CoEng_ratLamMaxSwtHiLo_C "Upper lambda limit while switching from high to low valve lift" VALUE 0x8051EA06 RB_Val_Wu16 15.99976 fak_q0p000244 0.00 15.99976 FORMAT "%8.5" /end CHARACTERISTIC
/begin CHARACTERISTIC CoEng_ratLamMaxSwtLoHi_C "Upper lambda limit while switching from low to high valve lift" VALUE 0x8051EA08 RB_Val_Wu16 15.99976 fak_q0p000244 0.00 15.99976 FORMAT "%8.5" /end CHARACTERISTIC
/begin CHARACTERISTIC CoEng_stFcoGearCatHeatg_T "Fuel cut-off status of the gear catalyst heating." CURVE 0x8051D46A RB_Curve_S8_S8 127.0 dez 0.00 127.0 FORMAT "%5.1" EXTENDED_LIMITS -128.0 127.0
 /begin AXIS_DESCR STD_AXIS Tra_numGear dez 11 -128.0 127.0 FORMAT "%5.1" DEPOSIT ABSOLUTE /end AXIS_DESCR
/end CHARACTERISTIC
/begin CHARACTERISTIC CoEng_stTqDmdFcoInhbnMask_C "Thershold for torque demand Fuel-cut off inhibition" VALUE 0x8051D484 RB_Val_Wu32 4294967295.00 OneToOne 0.00 4294967295.00 FORMAT "%13.2" /end CHARACTERISTIC
/begin CHARACTERISTIC CoEng_tEngMinFco_C "Engine temperature lower threshold for fuel cutoff" VALUE 0x8051D488 RB_Val_Ws16 6553.500 Temp_Cels -3549.940 3003.560 FORMAT "%8.3" /end CHARACTERISTIC
/begin CHARACTERISTIC CoEng_tFcoThdExhGas_C "Exhaus gas temperature treshold for prohibition of fuel cut-off" VALUE 0x8051D48A RB_Val_Wu16 1535.977 temp_q0p0234_o273 -273.150 1262.827 FORMAT "%8.3" /end CHARACTERISTIC
/begin CHARACTERISTIC CoEng_tiFcoEthnl_T "Delay for fuel cut-off after engine start for ethanol" CURVE 0x8051D48C RB_Curve_S16_U16_Static 655.3500 t_q0p01 0.00 655.3500 FORMAT "%8.4"
 /begin AXIS_DESCR STD_AXIS CEngDsT_t temp_q0p1_o273 6 -3549.940 3003.560 FORMAT "%8.3" DEPOSIT ABSOLUTE /end AXIS_DESCR
/end CHARACTERISTIC
/begin CHARACTERISTIC CoEng_tiRstrtAirCdng_C "Time to retain delta speed for restarting fuel feed after air conditioning is switched on" VALUE 0x8051D4A6 RB_Val_Wu16 655.3500 t_q0p01 0.00 655.3500 FORMAT "%8.4" /end CHARACTERISTIC
/begin CHARACTERISTIC CoEng_vThdVehStop_C "Threshold for vehicle standstill detection" VALUE 0x8051D4A8 RB_Val_Ws16 10.00000 vel_q0p01 0.00 10.00000 FORMAT "%8.5" EXTENDED_LIMITS -327.6800 327.6700 /end CHARACTERISTIC
/begin CHARACTERISTIC Com_aLatGA_C "Default value of Lattitude_G information" VALUE 0x8058AEBC Val_Wu16 48.95205 Com_aLgtG_Compu -24.49995 24.45210 FORMAT "%8.5" EXTENDED_LIMITS -24.49995 3111.446 /end CHARACTERISTIC
/begin CHARACTERISTIC Com_aLgtG_C "Default value parameter for Com_aLgtG message" VALUE 0x8058AEBE Val_Wu16 48.95205 Com_aLgtG_Compu -24.49995 24.45210 FORMAT "%8.5" EXTENDED_LIMITS -24.49995 3111.446 /end CHARACTERISTIC
/begin CHARACTERISTIC Com_ctCRingSRSA_C "Default value parameter for Com_ctCRingSRSA message" VALUE 0x8058AEC0 Val_Wu8 3.000 OneToOne 0.00 3.000 FORMAT "%5.3" EXTENDED_LIMITS 0.00 255.0 /end CHARACTERISTIC
/begin CHARACTERISTIC Com_ctCRingSRSB_C "Default application value for Com_ctCRingSRSB in case of defective reception" VALUE 0x805265C8 RB_Val_Wu8 3.000 OneToOne 0.00 3.000 FORMAT "%5.3" EXTENDED_LIMITS 0.00 255.0 /end CHARACTERISTIC
/begin CHARACTERISTIC Com_ctCRingSRS_C "Default application value for Com_ctCRingSRS in case of defective reception" VALUE 0x805265BE RB_Val_Wu8 3.000 OneToOne 0.00 3.000 FORMAT "%5.3" EXTENDED_LIMITS 0.00 255.0 /end CHARACTERISTIC
/begin CHARACTERISTIC Com_ctSRSReWrThres_C "Threshold of receiving counter of SRS reprogramming start flag" VALUE 0x805265C9 RB_Val_Wu8 25.00 OneToOne 0.00 25.00 FORMAT "%5.2" EXTENDED_LIMITS 0.00 255.0 /end CHARACTERISTIC
/begin CHARACTERISTIC Com_dBCM1MaxDiff_C "BCM1 calibration for max difference" VALUE 0x805265BC RB_Val_Wu8 255.0 OneToOne 0.00 255.0 FORMAT "%5.1" /end CHARACTERISTIC
/begin CHARACTERISTIC Com_dBCM1MaxPer_C "BCM1 calibration for max period" VALUE 0x805265BD RB_Val_Wu8 255.0 OneToOne 0.00 255.0 FORMAT "%5.1" /end CHARACTERISTIC
/begin CHARACTERISTIC Com_dSRSAMaxDiff_C "Maximum value of period for detection of SRSA stopped message counter" VALUE 0x8058AEC1 Val_Wu8 255.0 OneToOne 0.00 255.0 FORMAT "%5.1" /end CHARACTERISTIC
/begin CHARACTERISTIC Com_dSRSAMaxPer_C "Maximum value of period for detection of SRSA stopped message counter" VALUE 0x8058AEC2 Val_Wu8 255.0 OneToOne 0.00 255.0 FORMAT "%5.1" /end CHARACTERISTIC
/begin CHARACTERISTIC Com_dSRSASigSel_C "Signal selection data for SRSA frame" VALUE 0x805265C4 RB_Val_Wu8 255.0 OneToOne 0.00 255.0 FORMAT "%5.1" /end CHARACTERISTIC
/begin CHARACTERISTIC Com_dSRSBMaxDiff_C "Application constant for Maximum difference between the counter values for SRSB frame." VALUE 0x805265CA RB_Val_Wu8 255.0 OneToOne 0.00 255.0 FORMAT "%5.1" /end CHARACTERISTIC
/begin CHARACTERISTIC Com_dSRSBMaxPer_C "Period for SRSB frame" VALUE 0x805265CB RB_Val_Wu8 255.0 OneToOne 0.00 255.0 FORMAT "%5.1" /end CHARACTERISTIC
/begin CHARACTERISTIC Com_dSRSMaxDiff_C "Application constant for Maximum difference between the counter values for SRS frame." VALUE 0x805265BF RB_Val_Wu8 255.0 OneToOne 0.00 255.0 FORMAT "%5.1" /end CHARACTERISTIC
/begin CHARACTERISTIC Com_dSRSMaxPer_C "Period for SRS frame." VALUE 0x805265C0 RB_Val_Wu8 255.0 OneToOne 0.00 255.0 FORMAT "%5.1" /end CHARACTERISTIC
/begin CHARACTERISTIC Com_numCsumSRSA_C "default value parameter for Com_numCsumSRSA message" VALUE 0x8058AEC3 Val_Wu8 15.00 OneToOne 0.00 15.00 FORMAT "%5.2" EXTENDED_LIMITS 0.00 255.0 /end CHARACTERISTIC
/begin CHARACTERISTIC Com_numCsumSRSB_C "Default application value for Com_numCsumSRSB in case of defective reception" VALUE 0x805265CC RB_Val_Wu8 15.00 OneToOne 0.00 15.00 FORMAT "%5.2" EXTENDED_LIMITS 0.00 255.0 /end CHARACTERISTIC
/begin CHARACTERISTIC Com_numCsumSRS_C "Default application value for Com_numCsumSRS in case of defective reception." VALUE 0x805265C1 RB_Val_Wu8 15.00 OneToOne 0.00 15.00 FORMAT "%5.2" EXTENDED_LIMITS 0.00 255.0 /end CHARACTERISTIC
/begin CHARACTERISTIC Com_nYaw1UpprData_C "YAW1 Upper Data parameter" VALUE 0x8058AEC4 Val_Wu16 249.7559 YawRate_q0p2441_om125 -125.0000 124.7559 FORMAT "%8.4" EXTENDED_LIMITS -125.0000 15874.76 /end CHARACTERISTIC
/begin CHARACTERISTIC Com_stAbnormCpu_C "Default value parameter for Com_stAbnormCpu message" VALUE 0x8058AEC6 Val_Wu8 1.000 OneToOne 0.00 1.000 FORMAT "%5.3" EXTENDED_LIMITS 0.00 255.0 /end CHARACTERISTIC
/begin CHARACTERISTIC Com_stAbnormVcc_C "Default value parameter for Com_stAbnormVcc message" VALUE 0x8058AEC7 Val_Wu8 1.000 OneToOne 0.00 1.000 FORMAT "%5.3" EXTENDED_LIMITS 0.00 255.0 /end CHARACTERISTIC
/begin CHARACTERISTIC Com_stCalCmplLatG_C "Default value of Lateral_G calibration complete" VALUE 0x805265C5 RB_Val_Wu8 255.0 OneToOne 0.00 255.0 FORMAT "%5.1" /end CHARACTERISTIC
/begin CHARACTERISTIC Com_stCalCmplLgtG_C "Default value parameter for Com_stCalCmplLgtG message" VALUE 0x805265C6 RB_Val_Wu8 255.0 OneToOne 0.00 255.0 FORMAT "%5.1" /end CHARACTERISTIC
/begin CHARACTERISTIC Com_stFailrLatG_C "Default value of Lateral_G failure" VALUE 0x8058AEC8 Val_Wu8 1.000 OneToOne 0.00 1.000 FORMAT "%5.3" EXTENDED_LIMITS 0.00 255.0 /end CHARACTERISTIC
/begin CHARACTERISTIC Com_stFailrLgtG_C "Default value parameter for Com_stFailrLgtG message" VALUE 0x8058AEC9 Val_Wu8 1.000 OneToOne 0.00 1.000 FORMAT "%5.3" EXTENDED_LIMITS 0.00 255.0 /end CHARACTERISTIC
/begin CHARACTERISTIC Com_stPrmntErrYaw1_C "YAW1 Permanent Error Parameter" VALUE 0x8058AECA Val_Wu8 255.0 OneToOne 0.00 255.0 FORMAT "%5.1" /end CHARACTERISTIC
/begin CHARACTERISTIC Com_stSeatBltInfo_C "Default application value for Com_stSeatBltInfoin case of defective reception." VALUE 0x805265C2 RB_Val_Wu8 3.00000000000 Com_stSeatBltInfo_COMPU_VERB 0.00 3.00000000000 FORMAT "%13.11" /end CHARACTERISTIC
/begin CHARACTERISTIC Com_stStrtupProc_C "Default value parameter for Com_stStrtupProc message" VALUE 0x8058AECB Val_Wu8 1.000 OneToOne 0.00 1.000 FORMAT "%5.3" EXTENDED_LIMITS 0.00 255.0 /end CHARACTERISTIC
/begin CHARACTERISTIC Com_stTempAbnormLatG_C "Default value of Temporarily abnormal Lateral-G" VALUE 0x8058AECC Val_Wu8 1.000 OneToOne 0.00 1.000 FORMAT "%5.3" EXTENDED_LIMITS 0.00 255.0 /end CHARACTERISTIC
/begin CHARACTERISTIC Com_stTempAbnormLgtG_C "Default value parameter for Com_stTempAbnormLgtG message" VALUE 0x8058AECD Val_Wu8 1.000 OneToOne 0.00 1.000 FORMAT "%5.3" EXTENDED_LIMITS 0.00 255.0 /end CHARACTERISTIC
/begin CHARACTERISTIC Com_stTmpErrYaw1_C "YAW1 Temporary Error Parameter" VALUE 0x8058AECE Val_Wu8 3.000 OneToOne 0.00 3.000 FORMAT "%5.3" EXTENDED_LIMITS 0.00 255.0 /end CHARACTERISTIC
/begin CHARACTERISTIC CWAGRVUGD "Codeword to switch between the UGD-Calculation with the desired and the actual EGR rates" VALUE 0x8051DE7C RB_Val_Wu8 255.0 OneToOne 0.00 255.0 FORMAT "%5.1" /end CHARACTERISTIC
/begin CHARACTERISTIC CWBBSTNSAD "Codeword for operation condition of start- afterstart adaptation" VALUE 0x8051D70C RB_Val_Wu8 255.0 dez 0.00 255.0 FORMAT "%5.1" /end CHARACTERISTIC
/begin CHARACTERISTIC CWBBSTNSAD2 "Codeword for operation condition of start- afterstart adaptation" VALUE 0x8051D70D RB_Val_Wu8 255.0 dez 0.00 255.0 FORMAT "%5.1" /end CHARACTERISTIC
/begin CHARACTERISTIC CWBBSTNSAD3 "Codeword for operation condition of start- afterstart adaptation" VALUE 0x8051D70E RB_Val_Wu8 255.0 dez 0.00 255.0 FORMAT "%5.1" /end CHARACTERISTIC
/begin CHARACTERISTIC CWBGADAP "code word for BGADAP" VALUE 0x8051D8DA RB_Val_Wu8 255.0 dez 0.00 255.0 FORMAT "%5.1" /end CHARACTERISTIC
/begin CHARACTERISTIC CWBGAGRA "Code word for calculation variable EGR adaptation" VALUE 0x8051DF2A RB_Val_Wu16 65535.00 dez 0.00 65535.00 FORMAT "%8.2" /end CHARACTERISTIC
/begin CHARACTERISTIC CWBGAGRDS "internal codeword for BGAGRDS" VALUE 0x8051DFF2 RB_Val_Wu8 255.0 dez 0.00 255.0 FORMAT "%5.1" /end CHARACTERISTIC
/begin CHARACTERISTIC CWBGAGRSOL "Code word BGAGRSOL" VALUE 0x8051DFFA RB_Val_Wu8 255.0 OneToOne 0.00 255.0 FORMAT "%5.1" /end CHARACTERISTIC
/begin CHARACTERISTIC CWBGAGRTS "internal codeword for %BGAGRTS" VALUE 0x8051E995 RB_Val_Wu8 255.0 dez 0.00 255.0 FORMAT "%5.1" /end CHARACTERISTIC
/begin CHARACTERISTIC CWBGFKEZ "Code Word for cylinderind. fuel correction quantity" VALUE 0x8051F34C RB_Val_Wu8 255.0 dez 0.00 255.0 FORMAT "%5.1" /end CHARACTERISTIC
/begin CHARACTERISTIC CWBH "cw for configuration of %BGBH" VALUE 0x8051E9A4 RB_Val_Wu8 255.0 dez 0.00 255.0 FORMAT "%5.1" /end CHARACTERISTIC
/begin CHARACTERISTIC CWHDST "Codeword function BBSTHDR" VALUE 0x8051D620 RB_Val_Wu8 255.0 OneToOne 0.00 255.0 FORMAT "%5.1" /end CHARACTERISTIC
/begin CHARACTERISTIC CWNWEGTR "Code word: resume speed at transmission-shift control" VALUE 0x8051D4AA RB_Val_Wu8 255.0 dez 0.00 255.0 FORMAT "%5.1" /end CHARACTERISTIC
/begin CHARACTERISTIC CWSAWE "code word to enable fuel cut off - fuel restart" VALUE 0x8051D4AC RB_Val_Wu16 65535.00 dez 0.00 65535.00 FORMAT "%8.2" /end CHARACTERISTIC
/begin CHARACTERISTIC DFKBLAGR "difference of egr correction calculated in fast and slow egr adaptation" VALUE 0x8051DF2C RB_Val_Wu16 1.999939 fak_q3p0518Em5 0.000031 1.999969 FORMAT "%8.6" EXTENDED_LIMITS 0.00 1.999969 /end CHARACTERISTIC
/begin CHARACTERISTIC DFKMSAGRBL "dead zone for EGR adaptation" VALUE 0x8051DF2E RB_Val_Ws16 1.999939 fak_q6p1035Em5 0.00 1.999939 FORMAT "%8.6" EXTENDED_LIMITS -2.000000 1.999939 /end CHARACTERISTIC
/begin CHARACTERISTIC DFKMSAGRS "dead zone for EGR adaptation" VALUE 0x8051DF30 RB_Val_Ws16 1.999939 fak_q6p1035Em5 0.00 1.999939 FORMAT "%8.6" EXTENDED_LIMITS -2.000000 1.999939 /end CHARACTERISTIC
/begin CHARACTERISTIC DFKMSDELSR "allowed delta between fkmsdks and 1 for detection of leakage to manifold" VALUE 0x8051D8DC RB_Val_Wu16 0.2000122 fak_q6p1035Em5 0.00 0.2000122 FORMAT "%9.7" EXTENDED_LIMITS 0.00 3.999939 /end CHARACTERISTIC
/begin CHARACTERISTIC DNSAH "Delta n overrun cut-off high with reference to n reinstatement" VALUE 0x8051D4AE RB_Val_Ws16 8191.750 nmot_sw_q0p25 0.00 8191.750 FORMAT "%8.3" EXTENDED_LIMITS -8192.000 8191.750 /end CHARACTERISTIC
/begin CHARACTERISTIC DNSAHS "Delta n overrun cut-off high with reference to n reinstatement - converter in slip mode" VALUE 0x8051D4B0 RB_Val_Ws16 8191.750 nmot_sw_q0p25 0.00 8191.750 FORMAT "%8.3" EXTENDED_LIMITS -8192.000 8191.750 /end CHARACTERISTIC
/begin CHARACTERISTIC DNSAL "Delta n overrun cut-off low with reference to n reinstatement" VALUE 0x8051D4B2 RB_Val_Ws16 8191.750 nmot_sw_q0p25 0.00 8191.750 FORMAT "%8.3" EXTENDED_LIMITS -8192.000 8191.750 /end CHARACTERISTIC
/begin CHARACTERISTIC DNSALH "Delta n overrun cut-off high with reference to n reinstatement at idle" VALUE 0x8051D4B4 RB_Val_Ws16 8191.750 nmot_sw_q0p25 0.00 8191.750 FORMAT "%8.3" EXTENDED_LIMITS -8192.000 8191.750 /end CHARACTERISTIC
/begin CHARACTERISTIC DNSALHS "Delta n overrun cut-off high with reference to n reinstatement at idle - converter in slip mode" VALUE 0x8051D4B6 RB_Val_Ws16 8191.750 nmot_sw_q0p25 0.00 8191.750 FORMAT "%8.3" EXTENDED_LIMITS -8192.000 8191.750 /end CHARACTERISTIC
/begin CHARACTERISTIC DNSALS "Delta n overrun cut-off low with reference to n reinstatement - converter in slip mode" VALUE 0x8051D4B8 RB_Val_Ws16 8191.750 nmot_sw_q0p25 0.00 8191.750 FORMAT "%8.3" EXTENDED_LIMITS -8192.000 8191.750 /end CHARACTERISTIC
/begin CHARACTERISTIC DNSATIP "cut off engine speed increase at tip gutter" VALUE 0x8051D4BA RB_Val_Ws16 16383.50 nmot_q0p5 0.00 16383.50 FORMAT "%8.2" EXTENDED_LIMITS -16384.00 16383.50 /end CHARACTERISTIC
/begin CHARACTERISTIC DNSLL "Overrun cut-off hysteresis for reinstatement at idle" VALUE 0x8051D4BC RB_Val_Ws16 8191.750 nmot_sw_q0p25 0.00 8191.750 FORMAT "%8.3" EXTENDED_LIMITS -8192.000 8191.750 /end CHARACTERISTIC
/begin CHARACTERISTIC DNSLLK "Overrun cut-off hysteresis for reinstatement at idle and disengaged clutch" VALUE 0x8051D4BE RB_Val_Ws16 16383.50 nmot_q0p5 0.00 16383.50 FORMAT "%8.2" EXTENDED_LIMITS -16384.00 16383.50 /end CHARACTERISTIC
/begin CHARACTERISTIC DNSLLS "Overrun cut-off hysteresis for reinstatement at idle - converter in slip mode" VALUE 0x8051D4C0 RB_Val_Ws16 8191.750 nmot_sw_q0p25 0.00 8191.750 FORMAT "%8.3" EXTENDED_LIMITS -8192.000 8191.750 /end CHARACTERISTIC
/begin CHARACTERISTIC DOFMSNDK "Threshold for difference between actual and old leakage air massflow throttle valve" VALUE 0x8051D8DE RB_Val_Ws16 6553.500 m_q0p1 -3276.800 3276.700 FORMAT "%8.3" /end CHARACTERISTIC
/begin CHARACTERISTIC DPAMNDAS "min. difference of exhaust gas pressure to cal. fast egr adaptation" VALUE 0x8051DF32 RB_Val_Wu16 2559.961 p_uw_q0p039 0.00 2559.961 FORMAT "%8.3" /end CHARACTERISTIC
/begin CHARACTERISTIC DPLMDSFE "delta pslm-psdss threshold for detection fkfupsrl steady state" VALUE 0x8051D8E0 RB_Val_Wu16 2559.961 p_q0p039 0.00 2559.961 FORMAT "%8.3" /end CHARACTERISTIC
/begin CHARACTERISTIC DPLMDSOE "delta pslm-psdss threshold for detection ofpbrint steady state" VALUE 0x8051D8E2 RB_Val_Wu16 638.9844 p_q0p039 0.00 638.9844 FORMAT "%8.4" EXTENDED_LIMITS 0.00 2559.961 /end CHARACTERISTIC
/begin CHARACTERISTIC DPLMDSOEK "delta pslm-psdss threshold for detection ofpbrint steady state for short trip" VALUE 0x8051D8E4 RB_Val_Wu16 638.9844 p_q0p039 0.00 638.9844 FORMAT "%8.4" EXTENDED_LIMITS 0.00 2559.961 /end CHARACTERISTIC
/begin CHARACTERISTIC DPLMDSTZF "difference modelled to measured manifold pressure death zone factor" VALUE 0x8051D8E6 RB_Val_Ws16 1279.961 p_q0p039 0.00 1279.961 FORMAT "%8.3" EXTENDED_LIMITS -1280.000 1279.961 /end CHARACTERISTIC
/begin CHARACTERISTIC DPLMDSTZO "difference modelled to measured manifold pressure death zone offset" VALUE 0x8051D8E8 RB_Val_Ws16 638.9844 p_q0p039 0.00 638.9844 FORMAT "%8.4" EXTENDED_LIMITS -1280.000 1279.961 /end CHARACTERISTIC
/begin CHARACTERISTIC DRRIEXTSMZ "Delta for reduction EGR rate during mode switch in target mode HOM" VALUE 0x8051DFFC RB_Val_Wu16 99.99847 rel_uw_b100 0.00 99.99847 FORMAT "%8.5" /end CHARACTERISTIC
/begin CHARACTERISTIC DRRIEXTSMZSRR "Delta inertgas ratio reduction of external EGR during mode switch for increasing EGR ratio" VALUE 0x8051DFFE RB_Val_Wu16 99.99847 rel_uw_b100 0.00 99.99847 FORMAT "%8.5" /end CHARACTERISTIC
/begin CHARACTERISTIC DRRIEXTSMZVHEK "Delta for reduction EGR rate during mode switch in target mode VHE low lift" VALUE 0x8051E000 RB_Val_Wu16 99.99847 rel_uw_b100 0.00 99.99847 FORMAT "%8.5" /end CHARACTERISTIC
/begin CHARACTERISTIC DSDLUTSR "Number of synchros lead for calculation of standard deviation of engine roughness" VALUE 0x8051D70F RB_Val_Wu8 255.0 dez 0.00 255.0 FORMAT "%5.1" /end CHARACTERISTIC
/begin CHARACTERISTIC DTASAGRTS "Hysterese for max. permissible inlet air temperature" VALUE 0x8051E996 RB_Val_Wu16 1535.977 temp_q0p0234 0.00 1535.977 FORMAT "%8.3" /end CHARACTERISTIC
/begin CHARACTERISTIC DTMSRT "difference of engine cool.temp.to starttemp.for retriggering models (blockheater" VALUE 0x8051E9A5 RB_Val_Wu8 191.3 temp_ub_q0p75_o48 -48.0 143.3 FORMAT "%5.1" /end CHARACTERISTIC
/begin CHARACTERISTIC DZWETAI "Delta ignition angle from efficiency" CURVE 0x8051EA14 RB_Curve_U16_S16_Static 95.99707 zw_q2p9297Em3_deg_KW 0.00 95.99707 FORMAT "%8.5" EXTENDED_LIMITS -96.00000 95.99707
 /begin AXIS_DESCR STD_AXIS NO_INPUT_QUANTITY fak_uw_b2 41 0.00 1.000000 FORMAT "%8.6" EXTENDED_LIMITS 0.00 1.999969 DEPOSIT ABSOLUTE /end AXIS_DESCR
/end CHARACTERISTIC
/begin CHARACTERISTIC DZWETAI2 "Delta ignition angle from efficiency - 2nd fuel" CURVE 0x8051EABA RB_Curve_U16_S16_Static 95.99707 zw_q2p9297Em3_deg_KW 0.00 95.99707 FORMAT "%8.5" EXTENDED_LIMITS -96.00000 95.99707
 /begin AXIS_DESCR STD_AXIS NO_INPUT_QUANTITY fak_uw_b2 41 0.00 1.000000 FORMAT "%8.6" EXTENDED_LIMITS 0.00 1.999969 DEPOSIT ABSOLUTE /end AXIS_DESCR
/end CHARACTERISTIC
/begin CHARACTERISTIC DZWETAI2H "Delta ignition angle from efficiency - 2nd fuel, homogeneous split injection" CURVE 0x8051EB60 RB_Curve_U16_S16_Static 95.99707 zw_q2p9297Em3_deg_KW 0.00 95.99707 FORMAT "%8.5" EXTENDED_LIMITS -96.00000 95.99707
 /begin AXIS_DESCR STD_AXIS NO_INPUT_QUANTITY fak_uw_b2 41 0.00 1.000000 FORMAT "%8.6" EXTENDED_LIMITS 0.00 1.999969 DEPOSIT ABSOLUTE /end AXIS_DESCR
/end CHARACTERISTIC
/begin CHARACTERISTIC DZWETAIH "Delta ignition angle from efficiency - homogeneous split injection" CURVE 0x8051EC06 RB_Curve_U16_S16_Static 95.99707 zw_q2p9297Em3_deg_KW 0.00 95.99707 FORMAT "%8.5" EXTENDED_LIMITS -96.00000 95.99707
 /begin AXIS_DESCR STD_AXIS NO_INPUT_QUANTITY fak_uw_b2 41 0.00 1.000000 FORMAT "%8.6" EXTENDED_LIMITS 0.00 1.999969 DEPOSIT ABSOLUTE /end AXIS_DESCR
/end CHARACTERISTIC
/begin CHARACTERISTIC EngStrt_cntrAftStrtDly_C "Caliberation to set delay in stopping afterstart adaptation" VALUE 0x8051D710 RB_Val_Wu8 255.0 OneToOne 0.00 255.0 FORMAT "%5.1" /end CHARACTERISTIC
/begin CHARACTERISTIC EngStrt_cntrInjRelsHiPStrtEOL_T "Curve for the counter of Injection release" CURVE 0x8051D622 RB_Curve_S16_U8_Static 255.0 OneToOne 0.00 255.0 FORMAT "%5.1"
 /begin AXIS_DESCR STD_AXIS EngStrt_tStrtCoor Temp_Cels 6 -273.140 3003.560 FORMAT "%8.3" EXTENDED_LIMITS -3549.940 3003.560 DEPOSIT ABSOLUTE /end AXIS_DESCR
/end CHARACTERISTIC
/begin CHARACTERISTIC EngStrt_cntrInjRelsHiPStrt_T "Counter for injection release." CURVE 0x8051D636 RB_Curve_S16_U8_Static 255.0 OneToOne 0.00 255.0 FORMAT "%5.1"
 /begin AXIS_DESCR STD_AXIS EngStrt_tStrtCoor Temp_Cels 6 -273.140 3003.560 FORMAT "%8.3" EXTENDED_LIMITS -3549.940 3003.560 DEPOSIT ABSOLUTE /end AXIS_DESCR
/end CHARACTERISTIC
/begin CHARACTERISTIC EngStrt_cntrRstHiPStrtEOL_T "Curve for the total number of synchros for waiting on high fuel pressure at initial fueling mode" CURVE 0x8051D64A RB_Curve_S16_U8_Static 255.0 OneToOne 0.00 255.0 FORMAT "%5.1"
 /begin AXIS_DESCR STD_AXIS EngStrt_tStrtCoor Temp_Cels 6 -273.140 3003.560 FORMAT "%8.3" EXTENDED_LIMITS -3549.940 3003.560 DEPOSIT ABSOLUTE /end AXIS_DESCR
/end CHARACTERISTIC
/begin CHARACTERISTIC EngStrt_cntrRstHiPStrt_T "Number of synchros for waiting for high fuel pressure" CURVE 0x8051D65E RB_Curve_S16_U8_Static 255.0 OneToOne 0.00 255.0 FORMAT "%5.1"
 /begin AXIS_DESCR STD_AXIS EngStrt_tStrtCoor Temp_Cels 6 -273.140 3003.560 FORMAT "%8.3" EXTENDED_LIMITS -3549.940 3003.560 DEPOSIT ABSOLUTE /end AXIS_DESCR
/end CHARACTERISTIC
/begin CHARACTERISTIC EngStrt_pEthRailHiPStrtRels_M "Map for threshold set value for rail pressure during high pressure start with flex fuel" MAP 0x8051D672 RB_Map_S16U16_U16 131.0700 RBPtCel_p_0p002_1 0.00 131.0700 FORMAT "%8.4"
 /begin AXIS_DESCR STD_AXIS EngStrt_tStrtCoor Temp_Cels 8 -273.140 3003.560 FORMAT "%8.3" EXTENDED_LIMITS -3549.940 3003.560 DEPOSIT ABSOLUTE /end AXIS_DESCR
 /begin AXIS_DESCR STD_AXIS FfPrm_facEthCurr fak_uw_b2 4 0.00 1.999969 FORMAT "%8.6" DEPOSIT ABSOLUTE /end AXIS_DESCR
/end CHARACTERISTIC
/begin CHARACTERISTIC EngStrt_pRailHiPStrtAbort_C "Threshold rail pressure for reset of start with high fuel pressure" VALUE 0x8051D6CE RB_Val_Wu16 131.0700 RBPtCel_p_0p002_1 0.00 131.0700 FORMAT "%8.4" /end CHARACTERISTIC
/begin CHARACTERISTIC EngStrt_swtAftStopInhb_C "Codeword for enabling condition of After stop inhibition" VALUE 0x8051D711 RB_Val_Wu8 255.0 OneToOne 0.00 255.0 FORMAT "%5.1" /end CHARACTERISTIC
/begin CHARACTERISTIC EngStrt_tAftStrtSwtOff_C "Time delay switch off afterstart adaptation by active lambda control" VALUE 0x8051D712 RB_Val_Wu16 60.00000 t100msxs_uw_b6553p5 0.00 60.00000 FORMAT "%8.5" EXTENDED_LIMITS 0.00 6553.500 /end CHARACTERISTIC
/begin CHARACTERISTIC EngStrt_tiFallDebStOfClu_C "stopping time after release clutch" VALUE 0x8051D714 RB_Val_Wu8 25.50 t100msxs_ub_b25p5 0.00 25.50 FORMAT "%5.2" /end CHARACTERISTIC
/begin CHARACTERISTIC EngStrt_tiRiseDebStOfClu_C "stopping time after step on clutch" VALUE 0x8051D715 RB_Val_Wu8 25.50 t100msxs_ub_b25p5 0.00 25.50 FORMAT "%5.2" /end CHARACTERISTIC
/begin CHARACTERISTIC EngStrt_tiRstHiPStrtEOL_T "Curve fir the Max. waiting time for high fuel pressure at initial fueling mode" CURVE 0x8051D6D0 RB_Curve_S16_U16_Static 655.3500 t_q0p01 0.00 655.3500 FORMAT "%8.4"
 /begin AXIS_DESCR STD_AXIS EngStrt_tStrtCoor Temp_Cels 6 -273.140 3003.560 FORMAT "%8.3" EXTENDED_LIMITS -3549.940 3003.560 DEPOSIT ABSOLUTE /end AXIS_DESCR
/end CHARACTERISTIC
/begin CHARACTERISTIC EngStrt_tiRstHiPStrt_T "Max. waiting time for high fuel pressure" CURVE 0x8051D6EA RB_Curve_S16_U16_Static 655.3500 t_q0p01 0.00 655.3500 FORMAT "%8.4"
 /begin AXIS_DESCR STD_AXIS EngStrt_tStrtCoor Temp_Cels 6 -273.140 3003.560 FORMAT "%8.3" EXTENDED_LIMITS -3549.940 3003.560 DEPOSIT ABSOLUTE /end AXIS_DESCR
/end CHARACTERISTIC
/begin CHARACTERISTIC EngStrt_tStrtLoPActvPmp_C "Min. temperature for low pressure start with activated high pressure pump" VALUE 0x8051D704 RB_Val_Ws16 3276.700 Temp_Cels -273.140 3003.560 FORMAT "%8.3" EXTENDED_LIMITS -3549.940 3003.560 /end CHARACTERISTIC
/begin CHARACTERISTIC ENSAD "Number of exceeding e. roughness th. for activation afterstart adaption" VALUE 0x8051D716 RB_Val_Wu8 255.0 dez 0.00 255.0 FORMAT "%5.1" /end CHARACTERISTIC
/begin CHARACTERISTIC ESDLUTS "Number of synchros for calculation of standard dev. of engine roughness" VALUE 0x8051D717 RB_Val_Wu8 255.0 dez 0.00 255.0 FORMAT "%5.1" /end CHARACTERISTIC
/begin CHARACTERISTIC ETADZWI "ignition efficiency depending on delta ignition angle" CURVE 0x8051ECAC RB_Curve_S16_U16_Static 1.000000 fak_uw_b2 0.00 1.000000 FORMAT "%8.6" EXTENDED_LIMITS 0.00 1.999969
 /begin AXIS_DESCR STD_AXIS NO_INPUT_QUANTITY zw_q2p9297Em3_deg_KW 41 -96.00000 95.99707 FORMAT "%8.5" DEPOSIT ABSOLUTE /end AXIS_DESCR
/end CHARACTERISTIC
/begin CHARACTERISTIC ETADZWI2 "ignition efficiency depending on delta ignition angle, 2nd fuel type" CURVE 0x8051ED52 RB_Curve_S16_U16_Static 1.000000 fak_uw_b2 0.00 1.000000 FORMAT "%8.6" EXTENDED_LIMITS 0.00 1.999969
 /begin AXIS_DESCR STD_AXIS NO_INPUT_QUANTITY zw_q2p9297Em3_deg_KW 41 -96.00000 95.99707 FORMAT "%8.5" DEPOSIT ABSOLUTE /end AXIS_DESCR
/end CHARACTERISTIC
/begin CHARACTERISTIC ETADZWI2H "ignition efficiency depending on delta ignition angle, 2nd fuel type, hom.-split injection" CURVE 0x8051EDF8 RB_Curve_S16_U16_Static 1.000000 fak_uw_b2 0.00 1.000000 FORMAT "%8.6" EXTENDED_LIMITS 0.00 1.999969
 /begin AXIS_DESCR STD_AXIS NO_INPUT_QUANTITY zw_q2p9297Em3_deg_KW 41 -96.00000 95.99707 FORMAT "%8.5" DEPOSIT ABSOLUTE /end AXIS_DESCR
/end CHARACTERISTIC
/begin CHARACTERISTIC ETADZWIH "ignition efficiency depending on delta ignition angle,hom.-split injection" CURVE 0x8051EE9E RB_Curve_S16_U16_Static 1.000000 fak_uw_b2 0.00 1.000000 FORMAT "%8.6" EXTENDED_LIMITS 0.00 1.999969
 /begin AXIS_DESCR STD_AXIS NO_INPUT_QUANTITY zw_q2p9297Em3_deg_KW 41 -96.00000 95.99707 FORMAT "%8.5" DEPOSIT ABSOLUTE /end AXIS_DESCR
/end CHARACTERISTIC
/begin CHARACTERISTIC FKBLAGRUS "min. threshold to reset slow adaptation with value of fast adaptation" VALUE 0x8051DF34 RB_Val_Wu16 1.999969 fak_q3p0518Em5 0.00 1.999969 FORMAT "%8.6" /end CHARACTERISTIC
/begin CHARACTERISTIC FKFUPSRLMN "Minimum integrator adaptation value for fupsrl adaptation" VALUE 0x8051D8EA RB_Val_Wu16 1.999969 fak_uw_b2 0.00 1.999969 FORMAT "%8.6" /end CHARACTERISTIC
/begin CHARACTERISTIC FKFUPSRLMX "Maximum integrator adaptation value for fupsrl adaptation" VALUE 0x8051D8EC RB_Val_Wu16 1.999969 fak_uw_b2 0.00 1.999969 FORMAT "%8.6" /end CHARACTERISTIC
/begin CHARACTERISTIC FKLAF2I "inverse saint venant 2 reciprocal" CURVE 0x8051DF36 RB_Curve_U16_U16 7.999878 fak_q0p000122 0.00 7.999878 FORMAT "%8.6"
 /begin AXIS_DESCR STD_AXIS NO_INPUT_QUANTITY fak_q0p000122 13 0.00 7.999878 FORMAT "%8.6" DEPOSIT ABSOLUTE /end AXIS_DESCR
/end CHARACTERISTIC
/begin CHARACTERISTIC FKLAF2IR "inverse saint venant 2 reciprocal" CURVE 0x8051DF6C RB_Curve_U16_U16 7.999878 fak_q0p000122 0.00 7.999878 FORMAT "%8.6"
 /begin AXIS_DESCR STD_AXIS NO_INPUT_QUANTITY fak_q0p000122 13 0.00 7.999878 FORMAT "%8.6" DEPOSIT ABSOLUTE /end AXIS_DESCR
/end CHARACTERISTIC
/begin CHARACTERISTIC FKMSAGRSMN "low limit for fast EGR mass-flow correction" VALUE 0x8051DFA2 RB_Val_Ws16 7.999878 fak_sw_b4 -4.000000 3.999878 FORMAT "%8.6" /end CHARACTERISTIC
/begin CHARACTERISTIC FKMSAGRSMX "high limit for fast EGR mass-flow correction" VALUE 0x8051DFA4 RB_Val_Ws16 7.999878 fak_sw_b4 -4.000000 3.999878 FORMAT "%8.6" /end CHARACTERISTIC
/begin CHARACTERISTIC FKMSAGRSN "Norn factor fkmsagrs_w for adaptation without fast adjustment" VALUE 0x8051DFA6 RB_Val_Ws16 7.999878 fak_sw_b4 -4.000000 3.999878 FORMAT "%8.6" /end CHARACTERISTIC
/begin CHARACTERISTIC FMSAGRREG "Factor part of the total mass flow for the dead zone calculation of the correction factor EGR-massflow control fast rate" VALUE 0x8051DFA8 RB_Val_Wu16 0.9999847 fak_q1p5258Em5 0.00 0.9999847 FORMAT "%9.7" /end CHARACTERISTIC
/begin CHARACTERISTIC FRAGRSAB "down-integration controlling parameter egr value" VALUE 0x8051E002 RB_Val_Ws16 1.000000 fak_q3p0518Em5 -1.000000 0.00 FORMAT "%8.6" EXTENDED_LIMITS -1.000000 0.9999695 /end CHARACTERISTIC
/begin CHARACTERISTIC FRAGRSMN "minimum controll factor egr value" VALUE 0x8051E004 RB_Val_Wu16 1.999969 fak_q3p0518Em5 0.00 1.999969 FORMAT "%8.6" /end CHARACTERISTIC
/begin CHARACTERISTIC FRAGRSZU "up-integration controlling parameter egr value" VALUE 0x8051E006 RB_Val_Ws16 0.9999695 fak_q3p0518Em5 0.00 0.9999695 FORMAT "%9.7" EXTENDED_LIMITS -1.000000 0.9999695 /end CHARACTERISTIC
/begin CHARACTERISTIC FSDLUSOL "Factor desired value standard deviation engine roughness" VALUE 0x8051D718 RB_Val_Wu8 1.992188 fak_ub_b2 0.00 1.992188 FORMAT "%8.6" /end CHARACTERISTIC
/begin CHARACTERISTIC HWKRMAAGR "hysteresis for max. average ignition retard of knock control while EGR is enable" VALUE 0x8051E008 RB_Val_Ws8 191.3 zw_q0p75 -96.00 95.25 FORMAT "%5.2" /end CHARACTERISTIC
/begin CHARACTERISTIC Injsys_facCylIndCorrn0_M "map : Cyl 0 correction factor for injection time cylinder individual during small valve lift" MAP 0x8051F34D RB_MapGroup_U8 0.9961 fak_q0p0039_op0p5 0.500 1.496 FORMAT "%5.3"
 /begin AXIS_DESCR COM_AXIS InjSys_nEngSpdLoc nmot_ub_q40 16 0.00 10200. FORMAT "%5.0" AXIS_PTS_REF SNM16CIUB /end AXIS_DESCR
 /begin AXIS_DESCR COM_AXIS rl_w_msg rel_uw_q0p0234 16 0.00 1535.977 FORMAT "%8.3" AXIS_PTS_REF SRL08CIUW /end AXIS_DESCR
/end CHARACTERISTIC
/begin CHARACTERISTIC Injsys_facCylIndCorrn1_M "map : Cyl 1 correction factor for injection time cylinder individual during small valve lift" MAP 0x8051F44D RB_MapGroup_U8 0.9961 fak_q0p0039_op0p5 0.500 1.496 FORMAT "%5.3"
 /begin AXIS_DESCR COM_AXIS InjSys_nEngSpdLoc nmot_ub_q40 16 0.00 10200. FORMAT "%5.0" AXIS_PTS_REF SNM16CIUB /end AXIS_DESCR
 /begin AXIS_DESCR COM_AXIS rl_w_msg rel_uw_q0p0234 16 0.00 1535.977 FORMAT "%8.3" AXIS_PTS_REF SRL08CIUW /end AXIS_DESCR
/end CHARACTERISTIC
/begin CHARACTERISTIC Injsys_facCylIndCorrn2_M "map : Cyl 2 correction factor for injection time cylinder individual during small valve lift" MAP 0x8051F54D RB_MapGroup_U8 0.9961 fak_q0p0039_op0p5 0.500 1.496 FORMAT "%5.3"
 /begin AXIS_DESCR COM_AXIS InjSys_nEngSpdLoc nmot_ub_q40 16 0.00 10200. FORMAT "%5.0" AXIS_PTS_REF SNM16CIUB /end AXIS_DESCR
 /begin AXIS_DESCR COM_AXIS rl_w_msg rel_uw_q0p0234 16 0.00 1535.977 FORMAT "%8.3" AXIS_PTS_REF SRL08CIUW /end AXIS_DESCR
/end CHARACTERISTIC
/begin CHARACTERISTIC Injsys_facCylIndCorrn3_M "map : Cyl 3 correction factor for injection time cylinder individual during small valve lift" MAP 0x8051F64D RB_MapGroup_U8 0.9961 fak_q0p0039_op0p5 0.500 1.496 FORMAT "%5.3"
 /begin AXIS_DESCR COM_AXIS InjSys_nEngSpdLoc nmot_ub_q40 16 0.00 10200. FORMAT "%5.0" AXIS_PTS_REF SNM16CIUB /end AXIS_DESCR
 /begin AXIS_DESCR COM_AXIS rl_w_msg rel_uw_q0p0234 16 0.00 1535.977 FORMAT "%8.3" AXIS_PTS_REF SRL08CIUW /end AXIS_DESCR
/end CHARACTERISTIC
/begin CHARACTERISTIC KBLAGRKT "Time constant for EGR orifice factor short test" VALUE 0x8051DFAA RB_Val_Wu16 6553.400 t_q0p1 0.100 6553.500 FORMAT "%8.3" EXTENDED_LIMITS 0.00 6553.500 /end CHARACTERISTIC
/begin CHARACTERISTIC KBLAGRMN "low limit for correction of EGR orifice factor" VALUE 0x8051DFAC RB_Val_Ws16 0.9999390 fak_q6p1035Em5 0.00 0.9999390 FORMAT "%9.7" EXTENDED_LIMITS -2.000000 1.999939 /end CHARACTERISTIC
/begin CHARACTERISTIC KFAPIRGMN "Minimum integrator adaptation value for pbrint adaptation" MAP 0x8051D8EE RB_Map_U16U16_S16 2559.961 p_q0p039 -1280.000 1279.961 FORMAT "%8.3"
 /begin AXIS_DESCR STD_AXIS AirMod_nEngSpdLoc EngN 12 0.00 16383.50 FORMAT "%8.2" EXTENDED_LIMITS 0.00 32767.50 DEPOSIT ABSOLUTE /end AXIS_DESCR
 /begin AXIS_DESCR STD_AXIS rl_w_msg rel_q0p02344 12 0.00 1535.977 FORMAT "%8.3" DEPOSIT ABSOLUTE /end AXIS_DESCR
/end CHARACTERISTIC
/begin CHARACTERISTIC KFAPIRGMX "Maximum integrator adaptation value for pbrint adaptation" MAP 0x8051DA42 RB_Map_U16U16_S16 2559.961 p_q0p039 -1280.000 1279.961 FORMAT "%8.3"
 /begin AXIS_DESCR STD_AXIS AirMod_nEngSpdLoc EngN 12 0.00 16383.50 FORMAT "%8.2" EXTENDED_LIMITS 0.00 32767.50 DEPOSIT ABSOLUTE /end AXIS_DESCR
 /begin AXIS_DESCR STD_AXIS rl_w_msg rel_q0p02344 12 0.00 1535.977 FORMAT "%8.3" DEPOSIT ABSOLUTE /end AXIS_DESCR
/end CHARACTERISTIC
/begin CHARACTERISTIC KFFZN0 "Cylinder individual factor at neutral camshaft position for cylinder 0 - 7" MAP 0x8051F74E RB_MapGroup_U16 0.9960938 fak_q0p0039_op0p5 0.500000 1.496094 FORMAT "%8.6" EXTENDED_LIMITS 0.5000000 256.4961
 /begin AXIS_DESCR COM_AXIS InjSys_nEngSpdLoc nmot_ub_q40 16 0.00 10200. FORMAT "%5.0" AXIS_PTS_REF SNM16CIUB /end AXIS_DESCR
 /begin AXIS_DESCR COM_AXIS rl_w_msg rel_uw_q0p0234 16 0.00 1535.977 FORMAT "%8.3" AXIS_PTS_REF SRL08CIUW /end AXIS_DESCR
/end CHARACTERISTIC
/begin CHARACTERISTIC KFFZN1 "Cylinder individual factor at neutral camshaft position for cylinder 1" MAP 0x8051F94E RB_MapGroup_U8 0.9961 fak_q0p0039_op0p5 0.500 1.496 FORMAT "%5.3"
 /begin AXIS_DESCR COM_AXIS InjSys_nEngSpdLoc nmot_ub_q40 16 0.00 10200. FORMAT "%5.0" AXIS_PTS_REF SNM16CIUB /end AXIS_DESCR
 /begin AXIS_DESCR COM_AXIS rl_w_msg rel_uw_q0p0234 16 0.00 1535.977 FORMAT "%8.3" AXIS_PTS_REF SRL08CIUW /end AXIS_DESCR
/end CHARACTERISTIC
/begin CHARACTERISTIC KFFZN2 "Cylinder individual factor at neutral camshaft position for cylinder 2" MAP 0x8051FA4E RB_MapGroup_U8 0.9961 fak_q0p0039_op0p5 0.500 1.496 FORMAT "%5.3"
 /begin AXIS_DESCR COM_AXIS InjSys_nEngSpdLoc nmot_ub_q40 16 0.00 10200. FORMAT "%5.0" AXIS_PTS_REF SNM16CIUB /end AXIS_DESCR
 /begin AXIS_DESCR COM_AXIS rl_w_msg rel_uw_q0p0234 16 0.00 1535.977 FORMAT "%8.3" AXIS_PTS_REF SRL08CIUW /end AXIS_DESCR
/end CHARACTERISTIC
/begin CHARACTERISTIC KFFZN3 "Cylinder individual factor at neutral camshaft position for cylinder 3" MAP 0x8051FB4E RB_MapGroup_U8 0.9961 fak_q0p0039_op0p5 0.500 1.496 FORMAT "%5.3"
 /begin AXIS_DESCR COM_AXIS InjSys_nEngSpdLoc nmot_ub_q40 16 0.00 10200. FORMAT "%5.0" AXIS_PTS_REF SNM16CIUB /end AXIS_DESCR
 /begin AXIS_DESCR COM_AXIS rl_w_msg rel_uw_q0p0234 16 0.00 1535.977 FORMAT "%8.3" AXIS_PTS_REF SRL08CIUW /end AXIS_DESCR
/end CHARACTERISTIC
/begin CHARACTERISTIC KFFZTM0 "TMOT dependant correction for cylinder individual injection for cylinder 0 -7" MAP 0x8051FC4E RB_Map_U8U8_U8 0.9961 fak_q0p0039_op0p5 0.500 1.496 FORMAT "%5.3"
 /begin AXIS_DESCR STD_AXIS InjSys_tEngTLoc temp_ub_q0p75_o48 4 -48.0 143.3 FORMAT "%5.1" DEPOSIT ABSOLUTE /end AXIS_DESCR
 /begin AXIS_DESCR STD_AXIS fkaez_a0 fak_q0p0039_op0p5 9 0.500 1.496 FORMAT "%5.3" DEPOSIT ABSOLUTE /end AXIS_DESCR
/end CHARACTERISTIC
/begin CHARACTERISTIC KFFZTM1 "TMOT dependant correction for cylinder individual injection for cylinder 1" MAP 0x8051FC81 RB_Map_U8U8_U8 0.9961 fak_q0p0039_op0p5 0.500 1.496 FORMAT "%5.3"
 /begin AXIS_DESCR STD_AXIS InjSys_tEngTLoc temp_ub_q0p75_o48 4 -48.0 143.3 FORMAT "%5.1" DEPOSIT ABSOLUTE /end AXIS_DESCR
 /begin AXIS_DESCR STD_AXIS fkaez_a1 fak_q0p0039_op0p5 9 0.500 1.496 FORMAT "%5.3" DEPOSIT ABSOLUTE /end AXIS_DESCR
/end CHARACTERISTIC
/begin CHARACTERISTIC KFFZTM2 "TMOT dependant correction for cylinder individual injection for cylinder 2" MAP 0x8051FCB4 RB_Map_U8U8_U8 0.9961 fak_q0p0039_op0p5 0.500 1.496 FORMAT "%5.3"
 /begin AXIS_DESCR STD_AXIS InjSys_tEngTLoc temp_ub_q0p75_o48 4 -48.0 143.3 FORMAT "%5.1" DEPOSIT ABSOLUTE /end AXIS_DESCR
 /begin AXIS_DESCR STD_AXIS fkaez_a2 fak_q0p0039_op0p5 9 0.500 1.496 FORMAT "%5.3" DEPOSIT ABSOLUTE /end AXIS_DESCR
/end CHARACTERISTIC
/begin CHARACTERISTIC KFFZTM3 "TMOT dependant correction for cylinder individual injection for cylinder 3" MAP 0x8051FCE7 RB_Map_U8U8_U8 0.9961 fak_q0p0039_op0p5 0.500 1.496 FORMAT "%5.3"
 /begin AXIS_DESCR STD_AXIS InjSys_tEngTLoc temp_ub_q0p75_o48 4 -48.0 143.3 FORMAT "%5.1" DEPOSIT ABSOLUTE /end AXIS_DESCR
 /begin AXIS_DESCR STD_AXIS fkaez_a3 fak_q0p0039_op0p5 9 0.500 1.496 FORMAT "%5.3" DEPOSIT ABSOLUTE /end AXIS_DESCR
/end CHARACTERISTIC
/begin CHARACTERISTIC KFIFDZW "stretching factor of spark efficiency curve" MAP 0x8051EF44 RB_Map_U16U16_U8 3.984 fak_ub_b4 0.00 3.984 FORMAT "%5.3"
 /begin AXIS_DESCR STD_AXIS NO_INPUT_QUANTITY nmot_uw_q0p25 16 0.00 16383.75 FORMAT "%8.2" DEPOSIT ABSOLUTE /end AXIS_DESCR
 /begin AXIS_DESCR STD_AXIS NO_INPUT_QUANTITY rel_q0p02344 12 0.00 1535.977 FORMAT "%8.3" DEPOSIT ABSOLUTE /end AXIS_DESCR
/end CHARACTERISTIC
/begin CHARACTERISTIC KFIFDZWH "stretching factor of spark efficiency curve, HSP" MAP 0x8051F040 RB_Map_U16U16_U8 3.984 fak_ub_b4 0.00 3.984 FORMAT "%5.3"
 /begin AXIS_DESCR STD_AXIS NO_INPUT_QUANTITY nmot_uw_q0p25 16 0.00 16383.75 FORMAT "%8.2" DEPOSIT ABSOLUTE /end AXIS_DESCR
 /begin AXIS_DESCR STD_AXIS NO_INPUT_QUANTITY rel_q0p02344 12 0.00 1535.977 FORMAT "%8.3" DEPOSIT ABSOLUTE /end AXIS_DESCR
/end CHARACTERISTIC
/begin CHARACTERISTIC KFMSNAPVP "Map EGR mass flow via valve opening" MAP 0x8051DE7E RB_Map_U16U16_U16 6553.500 m_q0p1 0.00 6553.500 FORMAT "%8.3"
 /begin AXIS_DESCR STD_AXIS agrvp_w_msg rel_uw_b100 15 0.00 99.99847 FORMAT "%8.5" DEPOSIT ABSOLUTE /end AXIS_DESCR
 /begin AXIS_DESCR STD_AXIS vpsvagb_w_msg fak_q3p0518Em5 4 0.00 1.999969 FORMAT "%8.6" DEPOSIT ABSOLUTE /end AXIS_DESCR
/end CHARACTERISTIC
/begin CHARACTERISTIC KFRRIEHFFVS "Characteristic extern egr ratio (inert gas) target value for flexible fuel vehicle E100" MAP 0x8051E00A RB_Map_S16U16_U16 99.99847 rel_uw_b100 0.00 99.99847 FORMAT "%8.5"
 /begin AXIS_DESCR STD_AXIS Epm_nEng EngN 14 -16384.00 16383.50 FORMAT "%8.2" DEPOSIT ABSOLUTE /end AXIS_DESCR
 /begin AXIS_DESCR STD_AXIS ChrSet_ratAirChrgDesEgrIntkVlvLft rel_q0p02344 12 0.00 1535.977 FORMAT "%8.3" DEPOSIT ABSOLUTE /end AXIS_DESCR
/end CHARACTERISTIC
/begin CHARACTERISTIC KFRRIEHOMA "calibration characteristic extern egr ratio (inert gas) target value hom. mode" MAP 0x8051E192 RB_Map_S16U16_U16 99.99847 rel_uw_b100 0.00 99.99847 FORMAT "%8.5"
 /begin AXIS_DESCR STD_AXIS Epm_nEng EngN 14 -16384.00 16383.50 FORMAT "%8.2" DEPOSIT ABSOLUTE /end AXIS_DESCR
 /begin AXIS_DESCR STD_AXIS rkm_w_msg rel_uw_b3072 12 0.00 3071.953 FORMAT "%8.3" DEPOSIT ABSOLUTE /end AXIS_DESCR
/end CHARACTERISTIC
/begin CHARACTERISTIC KFRRIEHOMS "characteristic extern egr ratio (inert gas) target value hom. mode" MAP 0x8051E31A RB_Map_S16U16_U16 99.99847 rel_uw_b100 0.00 99.99847 FORMAT "%8.5"
 /begin AXIS_DESCR STD_AXIS Epm_nEng EngN 14 -16384.00 16383.50 FORMAT "%8.2" DEPOSIT ABSOLUTE /end AXIS_DESCR
 /begin AXIS_DESCR STD_AXIS ChrSet_ratAirChrgDesEgrIntkVlvLft rel_q0p02344 12 0.00 1535.977 FORMAT "%8.3" DEPOSIT ABSOLUTE /end AXIS_DESCR
/end CHARACTERISTIC
/begin CHARACTERISTIC KFRRIEST "Map: desired value of the external residual exhaust gas rate in temp. dep." MAP 0x8051E4A2 RB_Map_S16U16_U16 1.999969 fak_q3p0518Em5 0.00 1.999969 FORMAT "%8.6"
 /begin AXIS_DESCR STD_AXIS CEngDsT_t Temp_Cels 6 -3549.940 3003.560 FORMAT "%8.3" DEPOSIT ABSOLUTE /end AXIS_DESCR
 /begin AXIS_DESCR STD_AXIS tansk_w_msg temp_q0p0234_o273 4 -273.150 1262.827 FORMAT "%8.3" DEPOSIT ABSOLUTE /end AXIS_DESCR
/end CHARACTERISTIC
/begin CHARACTERISTIC KFRRIEVHEFFVS "characteristic extern egr ratio (inert gas) target value low valve lift for flex fuel vehicle" MAP 0x8051E4EA RB_Map_S16U16_U16 99.99847 rel_uw_b100 0.00 99.99847 FORMAT "%8.5"
 /begin AXIS_DESCR STD_AXIS Epm_nEng EngN 14 -16384.00 16383.50 FORMAT "%8.2" DEPOSIT ABSOLUTE /end AXIS_DESCR
 /begin AXIS_DESCR STD_AXIS ChrSet_ratAirChrgDesEgrExtLoLft rel_q0p02344 12 0.00 1535.977 FORMAT "%8.3" DEPOSIT ABSOLUTE /end AXIS_DESCR
/end CHARACTERISTIC
/begin CHARACTERISTIC KFRRIEVHEKA "calibration characteristic extern egr ratio (inert gas) target value low valve lift" MAP 0x8051E672 RB_Map_S16U16_U16 99.99847 rel_uw_b100 0.00 99.99847 FORMAT "%8.5"
 /begin AXIS_DESCR STD_AXIS Epm_nEng EngN 14 -16384.00 16383.50 FORMAT "%8.2" DEPOSIT ABSOLUTE /end AXIS_DESCR
 /begin AXIS_DESCR STD_AXIS rkm_w_msg rel_uw_b3072 12 0.00 3071.953 FORMAT "%8.3" DEPOSIT ABSOLUTE /end AXIS_DESCR
/end CHARACTERISTIC
/begin CHARACTERISTIC KFRRIEVHEKS "characteristic extern egr ratio (inert gas) target value low valve lift" MAP 0x8051E7FA RB_Map_S16U16_U16 99.99847 rel_uw_b100 0.00 99.99847 FORMAT "%8.5"
 /begin AXIS_DESCR STD_AXIS Epm_nEng EngN 14 -16384.00 16383.50 FORMAT "%8.2" DEPOSIT ABSOLUTE /end AXIS_DESCR
 /begin AXIS_DESCR STD_AXIS ChrSet_ratAirChrgDesEgrExtLoLft rel_q0p02344 12 0.00 1535.977 FORMAT "%8.3" DEPOSIT ABSOLUTE /end AXIS_DESCR
/end CHARACTERISTIC
/begin CHARACTERISTIC KFTNSEADMX "Maximal time for afterstart adaptation" MAP 0x8051D719 RB_Map_U8U8_U8 1020. t_q4_s 0.00 1020. FORMAT "%5.0"
 /begin AXIS_DESCR STD_AXIS tmstbstnsd temp_ub_q0p75_o48 4 -48.0 143.3 FORMAT "%5.1" DEPOSIT ABSOLUTE /end AXIS_DESCR
 /begin AXIS_DESCR STD_AXIS fvapskstaa fak_ub_b2 2 0.00 1.992188 FORMAT "%8.6" DEPOSIT ABSOLUTE /end AXIS_DESCR
/end CHARACTERISTIC
/begin CHARACTERISTIC KFTVSA "Retard time for overrun fuel cut-off" MAP 0x8051D4C2 RB_MapGroup_U8 2.550 t_q0p01 0.00 2.550 FORMAT "%5.3"
 /begin AXIS_DESCR COM_AXIS CEngDsT_t temp_q0p1_o273 5 -3549.940 3003.560 FORMAT "%8.3" AXIS_PTS_REF CES_tEng_AXIS /end AXIS_DESCR
 /begin AXIS_DESCR COM_AXIS Epm_nEng EngN 8 -16384.00 16383.50 FORMAT "%8.2" AXIS_PTS_REF SNM08SAUB /end AXIS_DESCR
/end CHARACTERISTIC
/begin CHARACTERISTIC KFTVSAGNG "map delay time fuel cutoff depend on gear step" MAP 0x8051D4EA RB_Map_S16S16_S16 327.6700 t_q0p01 0.00 327.6700 FORMAT "%8.4" EXTENDED_LIMITS -327.6800 327.6700
 /begin AXIS_DESCR STD_AXIS Tra_numGear dez 12 -128.0000 127.0000 FORMAT "%8.4" EXTENDED_LIMITS -32768.00 32767.00 DEPOSIT ABSOLUTE /end AXIS_DESCR
 /begin AXIS_DESCR STD_AXIS Epm_nEng nmot_q0p5 3 -16384.00 16383.50 FORMAT "%8.2" DEPOSIT ABSOLUTE /end AXIS_DESCR
/end CHARACTERISTIC
/begin CHARACTERISTIC KFTVSAKAT "delay time for fuel cut-off at high speeds and high catalyst temperatures" MAP 0x8051D554 RB_MapGroup_U8 10.20 t_q0p04 0.00 10.20 FORMAT "%5.2"
 /begin AXIS_DESCR COM_AXIS Epm_nEng EngN 8 -16384.00 16383.50 FORMAT "%8.2" AXIS_PTS_REF SNM08SAUB /end AXIS_DESCR
 /begin AXIS_DESCR COM_AXIS tkattmp temp_q0p1_o273 4 -3549.940 3003.560 FORMAT "%8.3" AXIS_PTS_REF STK04SAUB /end AXIS_DESCR
/end CHARACTERISTIC
/begin CHARACTERISTIC KFTVSAVG "Delay time for Fuel Cut Off at gear shifting" MAP 0x8051D574 RB_MapGroup_U8 10.20 t_q0p04 0.00 10.20 FORMAT "%5.2"
 /begin AXIS_DESCR COM_AXIS CEngDsT_t temp_q0p1_o273 5 -3549.940 3003.560 FORMAT "%8.3" AXIS_PTS_REF CES_tEng_AXIS /end AXIS_DESCR
 /begin AXIS_DESCR COM_AXIS Epm_nEng EngN 8 -16384.00 16383.50 FORMAT "%8.2" AXIS_PTS_REF SNM08SAUB /end AXIS_DESCR
/end CHARACTERISTIC
/begin CHARACTERISTIC KFTVSAVGV0 "Delay time for Fuel Cut Off at gear shifting in vehicle standstill" MAP 0x8051D59C RB_MapGroup_U8 10.20 t_q0p04 0.00 10.20 FORMAT "%5.2"
 /begin AXIS_DESCR COM_AXIS CEngDsT_t temp_q0p1_o273 5 -3549.940 3003.560 FORMAT "%8.3" AXIS_PTS_REF CES_tEng_AXIS /end AXIS_DESCR
 /begin AXIS_DESCR COM_AXIS Epm_nEng EngN 8 -16384.00 16383.50 FORMAT "%8.2" AXIS_PTS_REF SNM08SAUB /end AXIS_DESCR
/end CHARACTERISTIC
/begin CHARACTERISTIC KFUPSRLMN "Minimum integrator adaptation value for fupsrl adaptation" MAP 0x8051DB96 RB_Map_U16U16_U16 1.999969 fak_q3p0518Em5 0.00 1.999969 FORMAT "%8.6"
 /begin AXIS_DESCR STD_AXIS Epm_nEng EngN 12 0.00 16383.50 FORMAT "%8.2" EXTENDED_LIMITS 0.00 32767.50 DEPOSIT ABSOLUTE /end AXIS_DESCR
 /begin AXIS_DESCR STD_AXIS rl_w_msg rel_q0p02344 12 0.00 1535.977 FORMAT "%8.3" DEPOSIT ABSOLUTE /end AXIS_DESCR
/end CHARACTERISTIC
/begin CHARACTERISTIC KFUPSRLMX "maximum integrator adaptation value for fupsrl adaptation" MAP 0x8051DCEA RB_Map_U16U16_U16 1.999969 fak_q3p0518Em5 0.00 1.999969 FORMAT "%8.6"
 /begin AXIS_DESCR STD_AXIS Epm_nEng EngN 12 0.00 16383.50 FORMAT "%8.2" EXTENDED_LIMITS 0.00 32767.50 DEPOSIT ABSOLUTE /end AXIS_DESCR
 /begin AXIS_DESCR STD_AXIS rl_w_msg rel_q0p02344 12 0.00 1535.977 FORMAT "%8.3" DEPOSIT ABSOLUTE /end AXIS_DESCR
/end CHARACTERISTIC
/begin CHARACTERISTIC KIFKFUPSRL "Integrator coefficient for fupsrl adaptation" VALUE 0x8051DE3E RB_Val_Wu16 19.99969 t50msxs_q3p052em4 0.00 19.99969 FORMAT "%8.5" /end CHARACTERISTIC
/begin CHARACTERISTIC KIFUPSKT "Integrator coefficient for fupsrl adaptation at short test" VALUE 0x8051DE40 RB_Val_Wu16 19.99969 t50msxs_q3p052em4 0.00 19.99969 FORMAT "%8.5" /end CHARACTERISTIC
/begin CHARACTERISTIC KIOFAPIRG "Integrator coefficient for pirg adaptation" VALUE 0x8051DE42 RB_Val_Wu16 19.99969 t50msxs_q3p052em4 0.00 19.99969 FORMAT "%8.5" /end CHARACTERISTIC
/begin CHARACTERISTIC KIPBRIKT "Integrator coefficient for pirg adaptation at short test" VALUE 0x8051DE44 RB_Val_Wu16 19.99969 t50msxs_q3p052em4 0.00 19.99969 FORMAT "%8.5" /end CHARACTERISTIC
/begin CHARACTERISTIC KLFKBLAGR "characteristic line to calculate mass flow correction factor egr" CURVE 0x8051DFAE RB_Curve_U16_U16 1.999969 fak_q3p0518Em5 0.00 1.999969 FORMAT "%8.6"
 /begin AXIS_DESCR STD_AXIS wblagrs_w_msg fak_q0p000488 8 0.00 31.99951 FORMAT "%8.5" DEPOSIT ABSOLUTE /end AXIS_DESCR
/end CHARACTERISTIC
/begin CHARACTERISTIC KLKBLAGR "characteristic line time constant for EGR orifice factor" CURVE 0x8051DFD0 RB_Curve_U16_U16 6553.400 t_q0p1 0.100 6553.500 FORMAT "%8.3" EXTENDED_LIMITS 0.00 6553.500
 /begin AXIS_DESCR STD_AXIS NO_INPUT_QUANTITY fak_q6p1035Em5 4 0.00 3.999939 FORMAT "%8.6" DEPOSIT ABSOLUTE /end AXIS_DESCR
/end CHARACTERISTIC
/begin CHARACTERISTIC KMSAGRDS "constant EGR mass flow into intake manifold" VALUE 0x8051DFF4 RB_Val_Wu16 0.9999847 fak_q1p5258Em5 0.00 0.9999847 FORMAT "%9.7" /end CHARACTERISTIC
/begin CHARACTERISTIC KMSAGRDSSA "Filter constant measured EGR mass flow (in fuel cut-off)" VALUE 0x8051DFF6 RB_Val_Wu16 0.9999847 fak_q1p5258Em5 0.00 0.9999847 FORMAT "%9.7" /end CHARACTERISTIC
/begin CHARACTERISTIC KOFAGR "Time constant for EGR offset adaption" VALUE 0x8051DFE2 RB_Val_Wu16 6553.4999985 zk100msxs_uw_b6553 0.1000015 6553.6000000 FORMAT "%12.7" EXTENDED_LIMITS 0.10000152590 6553.6000000 /end CHARACTERISTIC
/begin CHARACTERISTIC KOFAGRKT "Time constant for EGR offset adaption short trip" VALUE 0x8051DFE4 RB_Val_Wu16 6553.4999985 zk100msxs_uw_b6553 0.1000015 6553.6000000 FORMAT "%12.7" EXTENDED_LIMITS 0.10000152590 6553.6000000 /end CHARACTERISTIC
/begin CHARACTERISTIC KSTANSAD "Threshold factor start adaptation for activation of afterstart adaptation" VALUE 0x8051D729 RB_Val_Wu8 1.992188 fak_ub_b2 0.00 1.992188 FORMAT "%8.6" /end CHARACTERISTIC
/begin CHARACTERISTIC LADMXHOM "maximum permissible lambda for homogeneous mode" VALUE 0x8051EA0A RB_Val_Wu16 15.99976 fak_q0p000244 0.00 15.99976 FORMAT "%8.5" /end CHARACTERISTIC
/begin CHARACTERISTIC LZSRPUMN "min. threshold for ambient pressure to enable leakage detection via ofmsndkp_w" VALUE 0x8051DE46 RB_Val_Wu16 2559.961 p_q0p039 0.00 2559.961 FORMAT "%8.3" /end CHARACTERISTIC
/begin CHARACTERISTIC LZSRTMOTMN "min. threshold for engine temperature to enable leakage detection via ofmsndkp_w" VALUE 0x8051DE48 RB_Val_Ws16 6553.500 Temp_Cels -3549.940 3003.560 FORMAT "%8.3" /end CHARACTERISTIC
/begin CHARACTERISTIC LZSRTMOTMX "max. threshold for engine temperature to enable leakage detection via ofmsndkp_w" VALUE 0x8051DE4A RB_Val_Ws16 6553.500 Temp_Cels -3549.940 3003.560 FORMAT "%8.3" /end CHARACTERISTIC
/begin CHARACTERISTIC MNCLUTWM "Threshold to reset the engine roughness enable condtion with warm engine" VALUE 0x8051D72A RB_Val_Wu16 65535.00 dez 0.00 65535.00 FORMAT "%8.2" /end CHARACTERISTIC
/begin CHARACTERISTIC MSAGRADAMN "The massflow threshold where the relative difference of the modeled to measured EGR massflow is set to zero" VALUE 0x8051DFE6 RB_Val_Wu16 6553.500 m_q0p1 0.00 6553.500 FORMAT "%8.3" /end CHARACTERISTIC
/begin CHARACTERISTIC MSAGRDSMX "maximum egr mass flow claulcated by manifold pressure" VALUE 0x8051DFF8 RB_Val_Wu16 6553.500 m_q0p1 0.00 6553.500 FORMAT "%8.3" /end CHARACTERISTIC
/begin CHARACTERISTIC MSAGROFFAD "turn off threshold pirg/fupsrl adaption" VALUE 0x8051DE4C RB_Val_Wu16 6553.500 m_uw_b6553p5 0.00 6553.500 FORMAT "%8.3" /end CHARACTERISTIC
/begin CHARACTERISTIC MSAGRREG "The massflow threshold where the fast adaptation factor fkmsagrs_w will be traced back to 1" VALUE 0x8051DFE8 RB_Val_Wu16 6553.500 m_q0p1 0.00 6553.500 FORMAT "%8.3" /end CHARACTERISTIC
/begin CHARACTERISTIC MSNAGRLE "leakage egr mass flow standardized" VALUE 0x8051DF20 RB_Val_Wu16 6553.500 m_q0p1 0.00 6553.500 FORMAT "%8.3" /end CHARACTERISTIC
/begin CHARACTERISTIC MXCLUTWM "max-threshold: combustions with engine roughness at warm engine" VALUE 0x8051D72C RB_Val_Wu16 65535.00 dez 0.00 65535.00 FORMAT "%8.2" /end CHARACTERISTIC
/begin CHARACTERISTIC MXWKRMAAGR "max. average ignition retard of knock control while EGR is enabled" VALUE 0x8051E982 RB_Val_Ws8 191.3 zw_q0p75 -96.00 95.25 FORMAT "%5.2" /end CHARACTERISTIC
/begin CHARACTERISTIC NAPLMDSO "adaptation pslm-psdss speed upper limit" VALUE 0x8051DE4E RB_Val_Wu8 10200. EngN_LRes 0.00 10200. FORMAT "%5.0" /end CHARACTERISTIC
/begin CHARACTERISTIC NAPLMDSU "adaptation pslm-psdss speed lower limit" VALUE 0x8051DE4F RB_Val_Wu8 10200. EngN_LRes 0.00 10200. FORMAT "%5.0" /end CHARACTERISTIC
/begin CHARACTERISTIC NGDNSA "Engine speed gradient during decreasing the cut-off hysteresis" VALUE 0x8051D5C4 RB_Val_Ws16 16383.75 nmotd_sw_q0p25 -8192.000 8191.750 FORMAT "%8.3" /end CHARACTERISTIC
/begin CHARACTERISTIC NGDNSAL "Engine speed gradient during decreasing the cut-off hysteresis at idle" VALUE 0x8051D5C6 RB_Val_Ws16 16383.75 nmotd_sw_q0p25 -8192.000 8191.750 FORMAT "%8.3" /end CHARACTERISTIC
/begin CHARACTERISTIC NGDNSALS "Engine speed gradient during decreasing the cut-off hysteresis at idle - converter in slip mode" VALUE 0x8051D5C8 RB_Val_Ws16 16383.75 nmotd_sw_q0p25 -8192.000 8191.750 FORMAT "%8.3" /end CHARACTERISTIC
/begin CHARACTERISTIC NGDNSAS "Engine speed gradient during decreasing the cut-off hysteresis - converter in slip mode" VALUE 0x8051D5CA RB_Val_Ws16 16383.75 nmotd_sw_q0p25 -8192.000 8191.750 FORMAT "%8.3" /end CHARACTERISTIC
/begin CHARACTERISTIC NMOTTHASYN "Threshold value for engine speed to switch between time synchronous or speed synchronous interfaces" VALUE 0x8051D5CC RB_Val_Ws16 32767.50 EngN -16384.00 16383.50 FORMAT "%8.2" /end CHARACTERISTIC
/begin CHARACTERISTIC NMXHDEV "max. allowed engine speed in case of open clamping HPIV" VALUE 0x8051E9A0 RB_Val_Wu16 16383.75 nmot_uw_q0p25 0.00 16383.75 FORMAT "%8.2" /end CHARACTERISTIC
/begin CHARACTERISTIC NMXNSAD "Max. engine speed for afterstart adaptation" VALUE 0x8051D72E RB_Val_Wu8 10200. nmot_ub_q40 0.00 10200. FORMAT "%5.0" /end CHARACTERISTIC
/begin CHARACTERISTIC NWEGS "Maximum engine speed for fuel-cutoff inhibition during gearshift" VALUE 0x8051D5CE RB_Val_Ws16 32767.50 EngN -16384.00 16383.50 FORMAT "%8.2" /end CHARACTERISTIC
/begin CHARACTERISTIC OFAGRMN "min offset correction extern egr valve position" VALUE 0x8051DFEA RB_Val_Ws16 50.00000 rel_sw_b100 -50.00000 0.00 FORMAT "%8.5" EXTENDED_LIMITS -100.0000 99.99695 /end CHARACTERISTIC
/begin CHARACTERISTIC OFAGRMX "max offset correction extern egr valve position" VALUE 0x8051DFEC RB_Val_Ws16 49.99695 rel_sw_b100 0.00 49.99695 FORMAT "%8.5" EXTENDED_LIMITS -100.0000 99.99695 /end CHARACTERISTIC
/begin CHARACTERISTIC OFAPIRGMN "Minimum integrator adaptation value for pirg adaptation" VALUE 0x8051DE50 RB_Val_Ws16 2559.961 p_q0p039 -1280.000 1279.961 FORMAT "%8.3" /end CHARACTERISTIC
/begin CHARACTERISTIC OFAPIRGMX "Maximum integrator adaptation value for pirg adaptation" VALUE 0x8051DE52 RB_Val_Ws16 2559.961 p_q0p039 -1280.000 1279.961 FORMAT "%8.3" /end CHARACTERISTIC
/begin CHARACTERISTIC OMSNDKGLSMX "threshold for detection of big leakage in intake manifold based leakage of throttle blade" VALUE 0x8051DE54 RB_Val_Wu16 3276.800 m_uw_b6553p5 0.00 3276.800 FORMAT "%8.3" EXTENDED_LIMITS 0.00 6553.500 /end CHARACTERISTIC
/begin CHARACTERISTIC OMSNDKLSMX "Threshold f. detect. of a leak in the intake manifold" VALUE 0x8051DE56 RB_Val_Wu16 3276.800 m_uw_b6553p5 0.00 3276.800 FORMAT "%8.3" EXTENDED_LIMITS 0.00 6553.500 /end CHARACTERISTIC
/begin CHARACTERISTIC ORRIESHOM2 "offset value short test hom. mode / aperture modell" VALUE 0x8051E984 RB_Val_Ws16 99.99847 rel_sw_b50 -50.00000 49.99847 FORMAT "%8.5" /end CHARACTERISTIC
/begin CHARACTERISTIC ORRIESHOMT "offset value short test hom. mode" VALUE 0x8051E986 RB_Val_Ws16 99.99847 rel_sw_b50 -50.00000 49.99847 FORMAT "%8.5" /end CHARACTERISTIC
/begin CHARACTERISTIC ORRIESVHE2 "offset value short test VHE low lift mode aperture modell" VALUE 0x8051E988 RB_Val_Ws16 99.99847 rel_sw_b50 -50.00000 49.99847 FORMAT "%8.5" /end CHARACTERISTIC
/begin CHARACTERISTIC ORRIESVHET "offset value short test VHE low lift mode" VALUE 0x8051E98A RB_Val_Ws16 99.99847 rel_sw_b50 -50.00000 49.99847 FORMAT "%8.5" /end CHARACTERISTIC
/begin CHARACTERISTIC PRIOAS "priority operation point demand from air - system" VALUE 0x8051E99E RB_Val_Wu8 255.0 OneToOne 0.00 255.0 FORMAT "%5.1" /end CHARACTERISTIC
/begin CHARACTERISTIC PVAPIRGMN "Minimum pressure-ratio threshold when pirg-offset adaptation still active" VALUE 0x8051DE58 RB_Val_Wu16 1.999969 fak_uw_b2 0.00 1.999969 FORMAT "%8.6" /end CHARACTERISTIC
/begin CHARACTERISTIC PVAPIRGMX "Maximum pressure-ratio threshold when pirg-offset adaptation still active" VALUE 0x8051DE5A RB_Val_Wu16 1.999969 fak_uw_b2 0.00 1.999969 FORMAT "%8.6" /end CHARACTERISTIC
/begin CHARACTERISTIC PVFKFUMN "min. threshold of pressure ratio for fupsrl-adaption" VALUE 0x8051DE5C RB_Val_Wu16 1.999969 fak_uw_b2 0.00 1.999969 FORMAT "%8.6" /end CHARACTERISTIC
/begin CHARACTERISTIC PVFKFUMX "max. threshold of pressure ratio for fupsrl-adaption" VALUE 0x8051DE5E RB_Val_Wu16 1.999969 fak_uw_b2 0.00 1.999969 FORMAT "%8.6" /end CHARACTERISTIC
/begin CHARACTERISTIC RLMXHDEV "max. allowed charge in case of open clamping HPIV" VALUE 0x8051E9A2 RB_Val_Wu16 1535.977 rel_uw_q0p0234 0.00 1535.977 FORMAT "%8.3" /end CHARACTERISTIC
/begin CHARACTERISTIC RRIESAP "calibration value extern egr (inert) target value" VALUE 0x8051E98C RB_Val_Wu16 99.99847 rel_uw_b100 0.00 99.99847 FORMAT "%8.5" /end CHARACTERISTIC
/begin CHARACTERISTIC RRIESRKMN "Minimum inert residual gas rate for decreasing target value" VALUE 0x8051E98E RB_Val_Wu16 99.99847 rel_uw_b100 0.00 99.99847 FORMAT "%8.5" /end CHARACTERISTIC
/begin CHARACTERISTIC RRIESRMN "minimum of ratio burned gas for enable target value controlling" VALUE 0x8051E990 RB_Val_Wu16 99.99847 rel_uw_b100 0.00 99.99847 FORMAT "%8.5" /end CHARACTERISTIC
/begin CHARACTERISTIC RRIEXTSMZ "Inert residual exhaust gas rate f. ext. desired AGR-value in the int. mode state" VALUE 0x8051E992 RB_Val_Wu16 99.99847 rel_uw_b100 0.00 99.99847 FORMAT "%8.5" /end CHARACTERISTIC
/begin CHARACTERISTIC SAVGANGIKL "gear dependent delay time switch" CURVE 0x8051D5D0 RB_FixCurve_S8_S8 127.0 dez 0.00 127.0 FORMAT "%5.1" EXTENDED_LIMITS -128.0 127.0
 /begin AXIS_DESCR FIX_AXIS Tra_numGear dez 12 -1.00 10.00 FORMAT "%5.2" FIX_AXIS_PAR -1 0 12 /end AXIS_DESCR
/end CHARACTERISTIC
/begin CHARACTERISTIC SCHMSNAGRL "Threshold of leakage egr mass flow standardized" VALUE 0x8051DF22 RB_Val_Wu16 6553.500 m_q0p1 0.00 6553.500 FORMAT "%8.3" /end CHARACTERISTIC
/begin CHARACTERISTIC SF_DKVS "Sum Fault DKVS" VAL_BLK 0x8051EA0C RB_ValA_Wu16 82.0000000000 dfp_verbal 0.00 82.0000000000 FORMAT "%13.10" READ_ONLY NUMBER 4 /end CHARACTERISTIC
/begin AXIS_PTS SNM08SAUB "Base point distribution" 0x8051D5DC Epm_nEng RB_Axis_S16 32767.50 EngN 8 -16384.00 16383.50 FORMAT "%8.2" DEPOSIT ABSOLUTE /end AXIS_PTS
/begin AXIS_PTS SNM16CIUB "Base point distribution of engine speed, 16 base pts." 0x8051FD1A InjSys_nEngSpdLoc RB_Axis_U8 10200. nmot_ub_q40 16 0.00 10200. FORMAT "%5.0" DEPOSIT ABSOLUTE /end AXIS_PTS
/begin AXIS_PTS SRL08CIUW "Base point distribution relative air charge , 8 rl_w base pts." 0x8051FD2C rl_w_msg RB_Axis_U16 1535.977 rel_uw_q0p0234 16 0.00 1535.977 FORMAT "%8.3" DEPOSIT ABSOLUTE /end AXIS_PTS
/begin AXIS_PTS STK04SAUB "base point distribution catalyst temperature for function SAWE" 0x8051D5EE tkattmp RB_Axis_S16 6553.500 temp_q0p1_o273 4 -3549.940 3003.560 FORMAT "%8.3" DEPOSIT ABSOLUTE /end AXIS_PTS
/begin CHARACTERISTIC TAFUPSRLE "time delay for condition adaptation fupsrl stationary" VALUE 0x8051DE60 RB_Val_Wu8 51.00 t_q0p2 0.00 51.00 FORMAT "%5.2" /end CHARACTERISTIC
/begin CHARACTERISTIC TAPBRINT "ab der pslm-psdss für Setzen von E/Z_lzsr ausgewertet wird" VALUE 0x8051DE62 RB_Val_Wu16 13107.00 t_q0p2 0.00 13107.00 FORMAT "%8.2" /end CHARACTERISTIC
/begin CHARACTERISTIC TAPBRINTKT "Adapt. time f. pbrint (analogous to TAPBRINT)" VALUE 0x8051DE64 RB_Val_Wu16 13107.00 t_q0p2 0.00 13107.00 FORMAT "%8.2" /end CHARACTERISTIC
/begin CHARACTERISTIC TASAGRTSMX "maximum permissible inlet air temperature in the intake manifold" VALUE 0x8051E998 RB_Val_Wu16 1535.977 temp_q0p0234_o273 -273.150 1262.827 FORMAT "%8.3" /end CHARACTERISTIC
/begin CHARACTERISTIC TDAPBRINT "delay of B_apbrint" VALUE 0x8051DE66 RB_Val_Wu16 13107.00 t_q0p2 0.00 13107.00 FORMAT "%8.2" /end CHARACTERISTIC
/begin CHARACTERISTIC TDDISAGRT "Delay time of the condition B_disagrt from FALSE to TRUE." VALUE 0x8051E99A RB_Val_Wu16 6553.500 t_q0p1 0.00 6553.500 FORMAT "%8.3" /end CHARACTERISTIC
/begin CHARACTERISTIC TDENAGRT "Delay time of the condition B_disagrt from TRUE to FALSE" VALUE 0x8051E99C RB_Val_Wu16 6553.500 t_q0p1 0.00 6553.500 FORMAT "%8.3" /end CHARACTERISTIC
/begin CHARACTERISTIC TDFGADPS "time delay for enabling of adaption of the suction pipe model" VALUE 0x8051DE68 RB_Val_Wu16 3276.750 t_q0p05 0.00 3276.750 FORMAT "%8.3" /end CHARACTERISTIC
/begin CHARACTERISTIC TDFGINI "time delay for initialize of the adjustments with neutral values" VALUE 0x8051DE6A RB_Val_Wu8 12.75 t_q0p05 0.00 12.75 FORMAT "%5.2" /end CHARACTERISTIC
/begin CHARACTERISTIC TDGLSR "debounce time for error path big leak to manifold" VALUE 0x8051DE6B RB_Val_Wu8 51.00 t_q0p2 0.00 51.00 FORMAT "%5.2" /end CHARACTERISTIC
/begin CHARACTERISTIC TDLZSR "debounce time for error path leak to manifold" VALUE 0x8051DE6C RB_Val_Wu8 51.00 t_q0p2 0.00 51.00 FORMAT "%5.2" /end CHARACTERISTIC
/begin CHARACTERISTIC TDPSLMDS "time constant for low pass fil. of difference bet. mod. and meas. man. pres." VALUE 0x8051DE6E RB_Val_Wu16 13106.999997 zk200msxs_uw_b13107p2 0.200003 13107.200000 FORMAT "%12.6" EXTENDED_LIMITS 0.20000305180 13107.200000 /end CHARACTERISTIC
/begin CHARACTERISTIC TDTAPLMDS "delay DTEV for enable adaptation pslm-pdss" VALUE 0x8051DE70 RB_Val_Wu8 12.70 t_q0p05 0.05 12.75 FORMAT "%5.2" EXTENDED_LIMITS 0.00 12.75 /end CHARACTERISTIC
/begin CHARACTERISTIC TMECmb_facDiaInert_T "stretching factor curve of spark efficiency in dependency of residual inert gas" CURVE 0x8051F13C RB_Curve_U16_U16 3.999939 fak_uw_b4 0.00 3.999939 FORMAT "%8.6"
 /begin AXIS_DESCR STD_AXIS NO_INPUT_QUANTITY rel_uw_b100 10 0.00 99.99847 FORMAT "%8.5" DEPOSIT ABSOLUTE /end AXIS_DESCR
/end CHARACTERISTIC
/begin CHARACTERISTIC TMECmb_facDiaLamNEngChrgAir_M "stretching factor map of spark efficiency in dependency of engine output power" MAP 0x8051F166 RB_Map_U16U16_U16 3.999939 fak_uw_b4 0.00 3.999939 FORMAT "%8.6"
 /begin AXIS_DESCR STD_AXIS NO_INPUT_QUANTITY nmot_uw_q0p25 16 0.00 16383.75 FORMAT "%8.2" DEPOSIT ABSOLUTE /end AXIS_DESCR
 /begin AXIS_DESCR STD_AXIS NO_INPUT_QUANTITY rel_q0p02344 12 0.00 1535.977 FORMAT "%8.3" DEPOSIT ABSOLUTE /end AXIS_DESCR
/end CHARACTERISTIC
/begin CHARACTERISTIC TMECmb_facDiaLam_T "stretching factor curve of spark efficiency in dependency of lambda" CURVE 0x8051F322 RB_Curve_U16_U16 3.999939 fak_uw_b4 0.00 3.999939 FORMAT "%8.6"
 /begin AXIS_DESCR STD_AXIS NO_INPUT_QUANTITY fak_uw_b16 10 0.00 15.99976 FORMAT "%8.5" DEPOSIT ABSOLUTE /end AXIS_DESCR
/end CHARACTERISTIC
/begin CHARACTERISTIC TMMXRT "max. engine cool.temp. for retriggering models (blockheater-detection)" VALUE 0x8051E9A6 RB_Val_Wu8 191.3 temp_ub_q0p75_o48 -48.0 143.3 FORMAT "%5.1" /end CHARACTERISTIC
/begin CHARACTERISTIC TMNSADMN "Minimal engine temperature for afterstart adaptation" VALUE 0x8051D72F RB_Val_Wu8 191.3 temp_ub_q0p75_o48 -48.0 143.3 FORMAT "%5.1" /end CHARACTERISTIC
/begin CHARACTERISTIC TMNSADMX "Maximal engine temperature for afterstart adaptation" VALUE 0x8051D730 RB_Val_Wu8 191.3 temp_ub_q0p75_o48 -48.0 143.3 FORMAT "%5.1" /end CHARACTERISTIC
/begin CHARACTERISTIC TMOTMNSAD "engine temperature threshold for evaluation ""engine roughness with warm engine""" VALUE 0x8051D731 RB_Val_Wu8 191.3 temp_q0p75_om48 -48.0 143.3 FORMAT "%5.1" /end CHARACTERISTIC
/begin CHARACTERISTIC TNSFKEZ "Delay time for release zyl. ind. Mixture correction after starting" VALUE 0x8051FD4E RB_Val_Wu16 655.3500 t10msxs_uw_b655p35 0.00 655.3500 FORMAT "%8.4" /end CHARACTERISTIC
/begin CHARACTERISTIC TNSRT "max. time after start to retrigger calculation of engine temperature model" VALUE 0x8051E9A7 RB_Val_Wu8 255.0 t_q1 0.00 255.0 FORMAT "%5.1" /end CHARACTERISTIC
/begin CHARACTERISTIC TOLAGRV "Tolerance of EGR valve" VALUE 0x8051DF24 RB_Val_Wu16 99.99847 rel_uw_b100 0.00 99.99847 FORMAT "%8.5" /end CHARACTERISTIC
/begin CHARACTERISTIC TOLPAGR "Tolerance of pressure in front of EGR valve" VALUE 0x8051DF26 RB_Val_Wu16 2559.961 p_q0p039 0.00 2559.961 FORMAT "%8.3" /end CHARACTERISTIC
/begin CHARACTERISTIC TOLTAGR "Tolerance of temperature in front of EGR valve" VALUE 0x8051DF28 RB_Val_Wu8 1530. temp_q6 0.00 1530. FORMAT "%5.0" /end CHARACTERISTIC
/begin CHARACTERISTIC TOMSZCGLSRI "maximum duration of ofmsndkp_w adaptation to ensure, that an error(big leak to manifold) could have been found under all boundary conditions" VALUE 0x8051DE72 RB_Val_Wu16 13107.00 t_q0p2 0.00 13107.00 FORMAT "%8.2" /end CHARACTERISTIC
/begin CHARACTERISTIC TOMSZLZSRI "duration time of ofmsndkp_w adaptation to ensure an error LZSR detection under worst case conditions" VALUE 0x8051DE74 RB_Val_Wu16 13107.00 t_q0p2 0.00 13107.00 FORMAT "%8.2" /end CHARACTERISTIC
/begin CHARACTERISTIC TSTAPLMDS "delay after cranking for enable adaptation pslm-pdss" VALUE 0x8051DE76 RB_Val_Wu16 655.3400 t10msxs_uw_b655p35 0.0100 655.3500 FORMAT "%8.4" EXTENDED_LIMITS 0.00 655.3500 /end CHARACTERISTIC
/begin CHARACTERISTIC TVBGSCH "Delay time after detected gearshift" VALUE 0x8051D5F8 RB_Val_Wu8 2.550 t_q0p01 0.00 2.550 FORMAT "%5.3" /end CHARACTERISTIC
/begin CHARACTERISTIC TVDAGRSS "Time constant of the fast diagnosis EGR system" VALUE 0x8051DF29 RB_Val_Wu8 5.100 t_q0p02 0.00 5.100 FORMAT "%5.3" /end CHARACTERISTIC
/begin CHARACTERISTIC TVNSKUPPEF "stopping time after release clutch" VALUE 0x8051D732 RB_Val_Wu8 25.50 t100msxs_ub_b25p5 0.00 25.50 FORMAT "%5.2" /end CHARACTERISTIC
/begin CHARACTERISTIC TVNSKUPPER "stopping time after step on clutch" VALUE 0x8051D733 RB_Val_Wu8 25.50 t100msxs_ub_b25p5 0.00 25.50 FORMAT "%5.2" /end CHARACTERISTIC
/begin CHARACTERISTIC TVSABFA "Fuel-cutoff delay time at function request in gear 0" VALUE 0x8051D5FA RB_Val_Wu16 655.3500 t_q0p01 0.00 655.3500 FORMAT "%8.4" /end CHARACTERISTIC
/begin CHARACTERISTIC TVSABTE "Delay time for closing the canister purge valve before fuel-cutoff" VALUE 0x8051D5FC RB_Val_Wu16 655.3500 t_q0p01 0.00 655.3500 FORMAT "%8.4" /end CHARACTERISTIC
/begin CHARACTERISTIC TVSAGSCH "Delay time during detected gearshift" VALUE 0x8051D5FE RB_Val_Wu16 655.3500 t_q0p01 0.00 655.3500 FORMAT "%8.4" /end CHARACTERISTIC
/begin CHARACTERISTIC TVSAKUPPL "Disabling time for fuel cut-off during clutch engaging" VALUE 0x8051D600 RB_Val_Wu8 2.550 t_q0p01 0.00 2.550 FORMAT "%5.3" /end CHARACTERISTIC
/begin CHARACTERISTIC TVSATM "delay time after cranking for fuel cut off" CURVE 0x8051D602 RB_Curve_S16_U16_Static 655.3500 t_q0p01 0.00 655.3500 FORMAT "%8.4"
 /begin AXIS_DESCR STD_AXIS CEngDsT_t temp_q0p1_o273 6 -3549.940 3003.560 FORMAT "%8.3" DEPOSIT ABSOLUTE /end AXIS_DESCR
/end CHARACTERISTIC
/begin CHARACTERISTIC TVTOFLUT "Debounce engine roughness quality" VALUE 0x8051D734 RB_Val_Wu8 25.50 t100msxs_ub_b25p5 0.00 25.50 FORMAT "%5.2" /end CHARACTERISTIC
/begin CHARACTERISTIC VWE "Maximum vehicle velocity for fuel-cutoff inhibition during gearshift" VALUE 0x8051D61C RB_Val_Ws16 655.3500 vel_q0p01 -327.6800 327.6700 FORMAT "%8.4" /end CHARACTERISTIC
/begin CHARACTERISTIC ZFKMSAGRS "integrator speed for fast constant EGR mass-flow adaption" VALUE 0x8051DFEE RB_Val_Wu16 1310.6999997 zk20msxs_uw_b1310p72 0.0200003 1310.7200000 FORMAT "%12.7" EXTENDED_LIMITS 0.020000305180 1310.7200000 /end CHARACTERISTIC
/begin CHARACTERISTIC ZKWBLAGRS "filter time of mass flow resistance calculted by fast egr adaptation" VALUE 0x8051DFF0 RB_Val_Wu16 6553.4999985 zk100msxs_uw_b6553 0.1000015 6553.6000000 FORMAT "%12.7" EXTENDED_LIMITS 0.10000152590 6553.6000000 /end CHARACTERISTIC
/begin MEASUREMENT agrvpbg_w_msg "egr valve position (calculated value)" UWORD rel_uw_b100 1 100 0.00 99.99847 FORMAT "%8.5" ECU_ADDRESS 0x60001616 /end MEASUREMENT
/begin MEASUREMENT AirMod_facCorrnPToLdCnvn "Factor for converting(transforming) pressure to load" UWORD fak_q3p0518Em5 1 100 0.00 1.999969 FORMAT "%8.6" ECU_ADDRESS 0x60001622 /end MEASUREMENT
/begin MEASUREMENT AirMod_facCorrnPToLdCnvnIntegOutp "Correction factor for pressure to load conversion after integrator" UWORD fak_q3p0518Em5 1 100 0.00 1.999969 FORMAT "%8.6" ECU_ADDRESS 0x6003989A /end MEASUREMENT
/begin MEASUREMENT AirMod_facCorrnPToLdCnvnMax "Maximum value of pressure to load correction factor." UWORD fak_q3p0518Em5 1 100 0.00 1.999969 FORMAT "%8.6" ECU_ADDRESS 0x60001620 /end MEASUREMENT
/begin MEASUREMENT AirMod_facCorrnPToLdCnvnMin "Minimum value of pressure to load correction factor." UWORD fak_q3p0518Em5 1 100 0.00 1.999969 FORMAT "%8.6" ECU_ADDRESS 0x6000161E /end MEASUREMENT
/begin MEASUREMENT AirMod_flgAdpnFast "Flag indicating fast adaptation" UBYTE B_TRUE 1 100 0.00 1.00000000000 BIT_MASK 0x1 FORMAT "%13.11" ECU_ADDRESS 0x600011CC /end MEASUREMENT
/begin MEASUREMENT AirMod_nEngSpdLoc "Engine speed local" UWORD EngN 1 100 0.00 16383.50 FORMAT "%8.2" ECU_ADDRESS 0x600011C2 /end MEASUREMENT
/begin MEASUREMENT AirMod_pDifMnfldFastAdapn "Pressure difference fast adaptation" SWORD p_q0p039 1 100 -1280.000 1279.961 FORMAT "%8.3" ECU_ADDRESS 0x600011CA /end MEASUREMENT
/begin MEASUREMENT AirMod_pDifMnfldMdlToMeasd "Pressure difference between intake manifold modelled value and measured value." SWORD p_q0p039 1 100 -1280.000 1279.961 FORMAT "%8.3" ECU_ADDRESS 0x6000165A /end MEASUREMENT
/begin MEASUREMENT AirMon_flgBigLeakIntkMnfldEmiInflReld_mp "DFC_BigLeakIntkMnfldEmiInfl disabled by DisblMsk" UBYTE B_TRUE 1 100 0.00 1.00000000000 BIT_MASK 0x1 FORMAT "%13.11" ECU_ADDRESS 0x7000A801 /end MEASUREMENT
/begin MEASUREMENT AirMon_flgLeakIntkMnfldEmiInflReld_mp "DFC_LeakIntkMnfldEmiInfl disabled by DisblMsk" UBYTE B_TRUE 1 100 0.00 1.00000000000 BIT_MASK 0x1 FORMAT "%13.11" ECU_ADDRESS 0x7000A800 /end MEASUREMENT
/begin MEASUREMENT AirSys_stPrioWpDmdHyb "priority operation point demand from air - system" UBYTE OneToOne 1 100 0.00 255.0 FORMAT "%5.1" ECU_ADDRESS 0x60001516 /end MEASUREMENT
/begin MEASUREMENT anzdisagr "Number of identified EGR shutdowns in the driving cycle" UBYTE dez 1 100 0.00 255.0 FORMAT "%5.1" ECU_ADDRESS 0x60001192 /end MEASUREMENT
/begin MEASUREMENT BdInt_bClthOnDspReqPreCond "clutch on display request" UBYTE OneToOne 1 100 0.00 255.0 FORMAT "%5.1" ECU_ADDRESS 0x6000FFD9 /end MEASUREMENT
/begin MEASUREMENT BdInt_bEngStopEna "stop release driver physical presence detection and engine bonnet" UBYTE OneToOne 1 100 0.00 255.0 BIT_MASK 0x1 FORMAT "%5.1" ECU_ADDRESS 0x6000FA3D /end MEASUREMENT
/begin MEASUREMENT BdInt_bEngStrtEna "start release driver physical presence detection and engine bonnet" UBYTE OneToOne 1 100 0.00 255.0 BIT_MASK 0x1 FORMAT "%5.1" ECU_ADDRESS 0x6000FA3C /end MEASUREMENT
/begin MEASUREMENT BdInt_bRstrtNoPtd "Engine restart not permitted condition" UBYTE OneToOne 1 100 0.00 255.0 FORMAT "%5.1" ECU_ADDRESS 0x6000FFD8 /end MEASUREMENT
/begin MEASUREMENT BdInt_cntrIniDrv "ReIni drive counter" UBYTE OneToOne 1 100 0.00 255.0 FORMAT "%5.1" ECU_ADDRESS 0x6000F143 /end MEASUREMENT
/begin MEASUREMENT BdInt_stDCDCCdn "status of idle stop permitteddconditions depending on DCDC" UBYTE OneToOne 1 100 0.00 255.0 FORMAT "%5.1" ECU_ADDRESS 0x6000FFD7 /end MEASUREMENT
/begin MEASUREMENT BdInt_stEngHoodOpen_MP "Engine Hood Open status" UBYTE OneToOne 1 100 0.00 255.0 FORMAT "%5.1" ECU_ADDRESS 0x7000A809 /end MEASUREMENT
/begin MEASUREMENT BdInt_stEngStrtCdn "Engine start condition" UBYTE OneToOne 1 100 0.00 255.0 FORMAT "%5.1" ECU_ADDRESS 0x6000FFD6 /end MEASUREMENT
/begin MEASUREMENT BdInt_stEngStrtEna_mp "Engine start enable status" UBYTE OneToOne 1 100 0.00 255.0 FORMAT "%5.1" ECU_ADDRESS 0x7000A808 /end MEASUREMENT
/begin MEASUREMENT BdInt_stFrEngStrtCdn_mp "Forced engine start condition" UBYTE OneToOne 1 100 0.00 255.0 FORMAT "%5.1" ECU_ADDRESS 0x7000A807 /end MEASUREMENT
/begin MEASUREMENT BdInt_stHoodOpenDurgEngStrt "Engine Hood Open During Engine Starting" UBYTE OneToOne 1 100 0.00 255.0 FORMAT "%5.1" ECU_ADDRESS 0x6000FFD5 /end MEASUREMENT
/begin MEASUREMENT BdInt_stInhbReas "ISS Inhibit reason" UBYTE OneToOne 1 100 0.00 255.0 FORMAT "%5.1" ECU_ADDRESS 0x6000FFD4 /end MEASUREMENT
/begin MEASUREMENT BdInt_stPCU "Panel control unit availability status" UBYTE OneToOne 1 100 0.00 255.0 FORMAT "%5.1" ECU_ADDRESS 0x6000FFD3 /end MEASUREMENT
/begin MEASUREMENT BdInt_stRstrtNoPtdCdn_mp "Condition of engine restart permission" UBYTE OneToOne 1 100 0.00 255.0 FORMAT "%5.1" ECU_ADDRESS 0x7000A806 /end MEASUREMENT
/begin MEASUREMENT BdyECU_ctBCM1RngCnt_MP "Alive counter measurement point" UBYTE OneToOne 1 100 0.00 3.000 FORMAT "%5.3" ECU_ADDRESS 0x7000A805 /end MEASUREMENT
/begin MEASUREMENT BdyECU_ctRngSRSA_MP "SRSA frame counter information" UBYTE OneToOne 1 100 0.00 255.0 FORMAT "%5.1" ECU_ADDRESS 0x7000A803 /end MEASUREMENT
/begin MEASUREMENT BdyECU_ctRngSRSB_MP "Alive counter measurent point for SRSB frame" UBYTE OneToOne 1 100 0.00 255.0 FORMAT "%5.1" ECU_ADDRESS 0x7000A802 /end MEASUREMENT
/begin MEASUREMENT BdyECU_ctRngSRS_MP "Alive counter mersurent point for SRS frame" UBYTE OneToOne 1 100 0.00 255.0 FORMAT "%5.1" ECU_ADDRESS 0x7000A804 /end MEASUREMENT
/begin MEASUREMENT BrkS_cntrReIni "counter for state re-initialization" UBYTE OneToOne 1 100 0.00 255.0 FORMAT "%5.1" ECU_ADDRESS 0x6000F140 /end MEASUREMENT
/begin MEASUREMENT BrkS_flgBrkPmpDetd2Tsk "Brake pumping second task detected flag" UBYTE B_TRUE 1 100 0.00 1.00000000000 BIT_MASK 0x1 FORMAT "%13.11" ECU_ADDRESS 0x6000F13F /end MEASUREMENT
/begin MEASUREMENT BrkS_flgBrkPmpDetdActv "Brake Pumping detected Active flag" UBYTE B_TRUE 1 100 0.00 1.00000000000 BIT_MASK 0x1 FORMAT "%13.11" ECU_ADDRESS 0x6000F13E /end MEASUREMENT
/begin MEASUREMENT BrkS_flgBrkPmpDetdOld "Brake Pumping old signal detected flag" UBYTE B_TRUE 1 100 0.00 1.00000000000 BIT_MASK 0x1 FORMAT "%13.11" ECU_ADDRESS 0x6000F13D /end MEASUREMENT
/begin MEASUREMENT BrkS_flgBrkPmpgActv "Flag to indicate if brake pumping is active" UBYTE B_TRUE 1 100 0.00 1.00000000000 BIT_MASK 0x1 FORMAT "%13.11" ECU_ADDRESS 0x6000FA2C /end MEASUREMENT
/begin MEASUREMENT BrkS_flgBrkPmpgAFMEna "Brake pumping AFM enable" UBYTE B_TRUE 1 100 0.00 1.00000000000 BIT_MASK 0x1 FORMAT "%13.11" ECU_ADDRESS 0x6000F13C /end MEASUREMENT
/begin MEASUREMENT BrkS_flgBrkPmpgDetd "Brake Pumping Detected" UBYTE B_TRUE 1 100 0.00 1.00000000000 BIT_MASK 0x1 FORMAT "%13.11" ECU_ADDRESS 0x6000FA2B /end MEASUREMENT
/begin MEASUREMENT BrkS_flgBrkPmpTOffDly "Brake Pumping Turn Off Delay flag" UBYTE B_TRUE 1 100 0.00 1.00000000000 BIT_MASK 0x1 FORMAT "%13.11" ECU_ADDRESS 0x6000F13B /end MEASUREMENT
/begin MEASUREMENT BrkS_flgIdle "Flag for Idle condition" UBYTE B_TRUE 1 100 0.00 1.00000000000 BIT_MASK 0x1 FORMAT "%13.11" ECU_ADDRESS 0x6000FA2A /end MEASUREMENT
/begin MEASUREMENT BrkS_mfBrkPmpg "Integrated mass flow at brake pumping" UWORD m_q0p1 1 100 0.00 6553.500 FORMAT "%8.3" ECU_ADDRESS 0x6000808C /end MEASUREMENT
/begin MEASUREMENT BrkS_mfBrkPmpgCnvn "Pressure difference in intake manifold converted to mass flow" SLONG m_q0p1 1 100 -214748364.800 214748364.700 FORMAT "%13.3" ECU_ADDRESS 0x60003228 /end MEASUREMENT
/begin MEASUREMENT BrkS_mfBrkPmpgFild "Filtered Integrated mass flow at brake pumping" UWORD m_q0p1 1 100 0.00 6553.500 FORMAT "%8.3" ECU_ADDRESS 0x6000808A /end MEASUREMENT
/begin MEASUREMENT BrkS_mfDifmsdkhfm "Mass flow at the DK calculated from the sensor signal of the HFM Difference" SWORD m_q0p1 1 100 -3276.800 3276.700 FORMAT "%8.3" ECU_ADDRESS 0x60008088 /end MEASUREMENT
/begin MEASUREMENT BrkS_mfIntegUpprThd "Upper thresholf of integrated mass flow" SWORD m_q0p1 1 100 -3276.800 3276.700 FORMAT "%8.3" ECU_ADDRESS 0x60008086 /end MEASUREMENT
/begin MEASUREMENT BrkS_mfPrevmsdkhfm "Mass flow at the DK calculated from the sensor signal of the HFM Previous value" UWORD m_q0p1 1 100 0.00 6553.500 FORMAT "%8.3" ECU_ADDRESS 0x60008084 /end MEASUREMENT
/begin MEASUREMENT BrkS_pDifBrkPmpg "Pressure difference between measured and modelled intake manifold pressure" SLONG p_q0p078 1 100 -167772160.000 167772159.922 FORMAT "%13.3" ECU_ADDRESS 0x60003224 /end MEASUREMENT
/begin MEASUREMENT BrkS_tiAFMLoadChgTOffTmr "AFM load change turn off timer" UWORD Time_s 1 100 0.00 655.3500 FORMAT "%8.4" ECU_ADDRESS 0x60008082 /end MEASUREMENT
/begin MEASUREMENT B_afupsrle_msg "condition: adaptation fupsrl stationary" UBYTE B_TRUE 1 100 0.00 1.00000000000 BIT_MASK 0x1 FORMAT "%13.11" ECU_ADDRESS 0x6000150D /end MEASUREMENT
/begin MEASUREMENT B_afupsrl_msg "condition: adaptation fupsrl" UBYTE B_TRUE 1 100 0.00 1.00000000000 BIT_MASK 0x1 FORMAT "%13.11" ECU_ADDRESS 0x60001401 /end MEASUREMENT
/begin MEASUREMENT B_agrofkl_msg "Condition EGR massflow is given through EGR valve" UBYTE B_TRUE 1 100 0.00 1.00000000000 BIT_MASK 0x1 FORMAT "%13.11" ECU_ADDRESS 0x6000150C /end MEASUREMENT
/begin MEASUREMENT B_agronhom "Condition EGR homogeneous mode possible" UBYTE B_TRUE 1 100 0.00 1.00000000000 BIT_MASK 0x1 FORMAT "%13.11" ECU_ADDRESS 0x600011A5 /end MEASUREMENT
/begin MEASUREMENT B_agrsr_msg "Condition egr desired value controlled" UBYTE B_TRUE 1 100 0.00 1.00000000000 BIT_MASK 0x1 FORMAT "%13.11" ECU_ADDRESS 0x6000024F /end MEASUREMENT
/begin MEASUREMENT B_agrvo_msg "Condition, open EGR-valve" UBYTE B_TRUE 1 100 0.00 1.00000000000 BIT_MASK 0x1 FORMAT "%13.11" ECU_ADDRESS 0x6000150A /end MEASUREMENT
/begin MEASUREMENT B_aosupsrl_msg "Condition Adaption offdet and gradient for conversion pressurt to charge" UBYTE B_TRUE 1 100 0.00 1.00000000000 BIT_MASK 0x1 FORMAT "%13.11" ECU_ADDRESS 0x60001400 /end MEASUREMENT
/begin MEASUREMENT B_apbrinte_msg "condition: adaptation pbrint stationary" UBYTE B_TRUE 1 100 0.00 1.00000000000 BIT_MASK 0x1 FORMAT "%13.11" ECU_ADDRESS 0x60001509 /end MEASUREMENT
/begin MEASUREMENT B_apbrint_msg "condition: adaptation pbrint" UBYTE B_TRUE 1 100 0.00 1.00000000000 BIT_MASK 0x1 FORMAT "%13.11" ECU_ADDRESS 0x600013FF /end MEASUREMENT
/begin MEASUREMENT B_apsfoagr_msg "condition: adaptation pslm-psdss enabled independent of ext. EGR" UBYTE B_TRUE 1 100 0.00 1.00000000000 BIT_MASK 0x1 FORMAT "%13.11" ECU_ADDRESS 0x60001508 /end MEASUREMENT
/begin MEASUREMENT B_apslmdse_msg "condition: adaptation modelled to measured manifold pressure stationary" UBYTE B_TRUE 1 100 0.00 1.00000000000 BIT_MASK 0x1 FORMAT "%13.11" ECU_ADDRESS 0x60001506 /end MEASUREMENT
/begin MEASUREMENT B_apslmds_msg "condition: adaptation modelled to measured manifold pressure run" UBYTE B_TRUE 1 100 0.00 1.00000000000 BIT_MASK 0x1 FORMAT "%13.11" ECU_ADDRESS 0x60001507 /end MEASUREMENT
/begin MEASUREMENT B_bevab_msg "Condition: Injection valve cut off on Bank 1" UBYTE B_TRUE 1 100 0.00 1.00000000000 BIT_MASK 0x1 FORMAT "%13.11" ECU_ADDRESS 0x70000C33 /end MEASUREMENT
/begin MEASUREMENT B_bgagroff_msg "Condition disable calculation bgagr" UBYTE B_TRUE 1 100 0.00 1.00000000000 BIT_MASK 0x1 FORMAT "%13.11" ECU_ADDRESS 0x60001505 /end MEASUREMENT
/begin MEASUREMENT B_clcbh "condition: blockheater-detection active" UBYTE B_TRUE 1 100 0.00 1.00000000000 BIT_MASK 0x1 FORMAT "%13.11" ECU_ADDRESS 0x700003FE /end MEASUREMENT
/begin MEASUREMENT B_disagrt "condition high EGR-temperature into (plastic) intake manifold detected" UBYTE B_TRUE 1 100 0.00 1.00000000000 BIT_MASK 0x1 FORMAT "%13.11" ECU_ADDRESS 0x6000014C /end MEASUREMENT
/begin MEASUREMENT B_disagrtis "Condition exceedingly high EGR temperature for EGR during overrun fuel cutoff detected" UBYTE B_TRUE 1 100 0.00 1.00000000000 BIT_MASK 0x1 FORMAT "%13.11" ECU_ADDRESS 0x6000014B /end MEASUREMENT
/begin MEASUREMENT B_disagrtisr "Condition disable EGR during overrun fuel cutoff because of exceedingly high EGR temperature into intake manifold" UBYTE B_TRUE 1 100 0.00 1.00000000000 BIT_MASK 0x1 FORMAT "%13.11" ECU_ADDRESS 0x6000014A /end MEASUREMENT
/begin MEASUREMENT B_disagrts_msg "condition egr disable caused by high temperature into (plastic) intake manifold" UBYTE B_TRUE 1 100 0.00 1.00000000000 BIT_MASK 0x1 FORMAT "%13.11" ECU_ADDRESS 0x60000241 /end MEASUREMENT
/begin MEASUREMENT B_dmdadap "Bit to indicate the type of signal processing for misfire detection" UBYTE B_TRUE 1 100 0.00 1.00000000000 BIT_MASK 0x1 FORMAT "%13.11" ECU_ADDRESS 0x5000094B /end MEASUREMENT
/begin MEASUREMENT B_dnsll "condition fuel cut off engine speed hysteresis DNSLL" UBYTE B_TRUE 1 100 0.00 1.00000000000 BIT_MASK 0x1 FORMAT "%13.11" ECU_ADDRESS 0x6000F155 /end MEASUREMENT
/begin MEASUREMENT B_elzsr "condition: error leak to manifold" UBYTE B_TRUE 1 100 0.00 1.00000000000 BIT_MASK 0x1 FORMAT "%13.11" ECU_ADDRESS 0x600011C9 /end MEASUREMENT
/begin MEASUREMENT B_enbhtr_msg "BlockHeater-Detection is enabled" UBYTE B_TRUE 1 100 0.00 1.00000000000 BIT_MASK 0x1 FORMAT "%13.11" ECU_ADDRESS 0x70000BF1 /end MEASUREMENT
/begin MEASUREMENT B_engroads "condition ""rough engine run with warm engine"" as criterium for stop of ""bad fuel adaptions""" UBYTE B_TRUE 1 100 0.00 1.00000000000 BIT_MASK 0x1 FORMAT "%13.11" ECU_ADDRESS 0x60036DF1 /end MEASUREMENT
/begin MEASUREMENT B_engroold """old value"" of B_engroads" UBYTE B_TRUE 1 100 0.00 1.00000000000 BIT_MASK 0x1 FORMAT "%13.11" ECU_ADDRESS 0x70000408 /end MEASUREMENT
/begin MEASUREMENT B_engstdas_msg "condition start desired (engine demand) from air system" UBYTE B_TRUE 1 100 0.00 1.00000000000 BIT_MASK 0x1 FORMAT "%13.11" ECU_ADDRESS 0x60000230 /end MEASUREMENT
/begin MEASUREMENT B_ensad "Condition enable afterstart adaptation" UBYTE B_TRUE 1 100 0.00 1.00000000000 BIT_MASK 0x1 FORMAT "%13.11" ECU_ADDRESS 0x70000407 /end MEASUREMENT
/begin MEASUREMENT B_entist_msg "Condition enable start injection" UBYTE B_TRUE 1 100 0.00 1.00000000000 BIT_MASK 0x1 FORMAT "%13.11" ECU_ADDRESS 0x6000FAB5 /end MEASUREMENT
/begin MEASUREMENT B_esdluts "Condition enable calculation of standard deviation of engine roughness" UBYTE B_TRUE 1 100 0.00 1.00000000000 BIT_MASK 0x1 FORMAT "%13.11" ECU_ADDRESS 0x70000406 /end MEASUREMENT
/begin MEASUREMENT B_evakt_msg "Condition all injection valves active" UBYTE B_TRUE 1 100 0.00 1.00000000000 BIT_MASK 0x1 FORMAT "%13.11" ECU_ADDRESS 0x70000BD5 /end MEASUREMENT
/begin MEASUREMENT B_evloc_msg "Condition all injection valves are activated, two camshaft revolutions delayed after fuel cutoff" UBYTE B_TRUE 1 100 0.00 1.00000000000 BIT_MASK 0x1 FORMAT "%13.11" ECU_ADDRESS 0x70000BD3 /end MEASUREMENT
/begin MEASUREMENT B_evzaush_msg "actual homogeneous injection is canceled" UBYTE B_TRUE 1 100 0.00 1.00000000000 BIT_MASK 0x1 FORMAT "%13.11" ECU_ADDRESS 0x70000BD2 /end MEASUREMENT
/begin MEASUREMENT B_evzauss_msg "actual stratified injection is canceled" UBYTE B_TRUE 1 100 0.00 1.00000000000 BIT_MASK 0x1 FORMAT "%13.11" ECU_ADDRESS 0x70000BD1 /end MEASUREMENT
/begin MEASUREMENT B_fapslmdsagr "Enable adaptation dependent of external EGR" UBYTE B_TRUE 1 100 0.00 1.00000000000 BIT_MASK 0x1 FORMAT "%13.11" ECU_ADDRESS 0x600013DF /end MEASUREMENT
/begin MEASUREMENT B_fapslmdsoagr "Enable adaptation independent of external EGR" UBYTE B_TRUE 1 100 0.00 1.00000000000 BIT_MASK 0x1 FORMAT "%13.11" ECU_ADDRESS 0x600013DE /end MEASUREMENT
/begin MEASUREMENT B_fgdlzsr "Conditiion: Enable conditon of LZSR diagnosis" UBYTE B_TRUE 1 100 0.00 1.00000000000 BIT_MASK 0x1 FORMAT "%13.11" ECU_ADDRESS 0x600013DC /end MEASUREMENT
/begin MEASUREMENT B_fkbndrycond "Condition for the update of the unlimited correction factor fupsrl_w (internal value)" UBYTE B_TRUE 1 100 0.00 1.00000000000 BIT_MASK 0x1 FORMAT "%13.11" ECU_ADDRESS 0x6000FAAC /end MEASUREMENT
/begin MEASUREMENT B_glsr_msg "error flag for big leak in the intake manifold" UBYTE B_TRUE 1 100 0.00 1.00000000000 BIT_MASK 0x1 FORMAT "%13.11" ECU_ADDRESS 0x600013D3 /end MEASUREMENT
/begin MEASUREMENT B_inhengro "inhibit condition ""rough engine run is not caused by bad fuel""" UBYTE B_TRUE 1 100 0.00 1.00000000000 BIT_MASK 0x1 FORMAT "%13.11" ECU_ADDRESS 0x70000405 /end MEASUREMENT
/begin MEASUREMENT B_inhronu "inhibit condition ""do not use engine roughness information at the moment""" UBYTE B_TRUE 1 100 0.00 1.00000000000 BIT_MASK 0x1 FORMAT "%13.11" ECU_ADDRESS 0x70000404 /end MEASUREMENT
/begin MEASUREMENT B_koe_loc "Condition for AC (air condition) compressor on" UBYTE B_TRUE 1 100 0.00 1.00000000000 BIT_MASK 0x1 FORMAT "%13.11" ECU_ADDRESS 0x6000F154 /end MEASUREMENT
/begin MEASUREMENT B_krdisagr "disable EGR" UBYTE B_TRUE 1 100 0.00 1.00000000000 BIT_MASK 0x1 FORMAT "%13.11" ECU_ADDRESS 0x600011A4 /end MEASUREMENT
/begin MEASUREMENT B_lzsrhfmp "condition: leakage detetction in intake manifold dependent on MAF and MAP" UBYTE B_TRUE 1 100 0.00 1.00000000000 BIT_MASK 0x1 FORMAT "%13.11" ECU_ADDRESS 0x600013CB /end MEASUREMENT
/begin MEASUREMENT B_mdfasfk_msg "Condition: AS request to torque structure to control the torque (actual to desired) with pay attention to the driveability" UBYTE B_TRUE 1 100 0.00 1.00000000000 BIT_MASK 0x1 FORMAT "%13.11" ECU_ADDRESS 0x60000205 /end MEASUREMENT
/begin MEASUREMENT B_mdfasnl_msg "Condition: AS request to torque structure to control the torque (actual to desired) without pay attention to the driveability (limp home)" UBYTE B_TRUE 1 100 0.00 1.00000000000 BIT_MASK 0x1 FORMAT "%13.11" ECU_ADDRESS 0x60000204 /end MEASUREMENT
/begin MEASUREMENT B_msagdsdb_msg "Condition calculated EGR masslow based on throttle valve and DSS" UBYTE B_TRUE 1 100 0.00 1.00000000000 BIT_MASK 0x1 FORMAT "%13.11" ECU_ADDRESS 0x70000B67 /end MEASUREMENT
/begin MEASUREMENT B_msagrsrg_msg "EGR desired mass flow into manifold is valid" UBYTE B_TRUE 1 100 0.00 1.00000000000 BIT_MASK 0x1 FORMAT "%13.11" ECU_ADDRESS 0x600014F2 /end MEASUREMENT
/begin MEASUREMENT B_nbhtr_msg "condition: no blockheater has been detected" UBYTE B_TRUE 1 100 0.00 1.00000000000 BIT_MASK 0x1 FORMAT "%13.11" ECU_ADDRESS 0x70000B5E /end MEASUREMENT
/begin MEASUREMENT B_nibhtr_msg "condition: blockheater-detection not possible" UBYTE B_TRUE 1 100 0.00 1.00000000000 BIT_MASK 0x1 FORMAT "%13.11" ECU_ADDRESS 0x70000B5D /end MEASUREMENT
/begin MEASUREMENT B_nostopas_msg "condition stop prohibition because of a request from the air system" UBYTE B_TRUE 1 100 0.00 1.00000000000 BIT_MASK 0x1 FORMAT "%13.11" ECU_ADDRESS 0x600001EF /end MEASUREMENT
/begin MEASUREMENT B_nsadend_msg "Condition finish afterstart adaptation" UBYTE B_TRUE 1 100 0.00 1.00000000000 BIT_MASK 0x1 FORMAT "%13.11" ECU_ADDRESS 0x70000B53 /end MEASUREMENT
/begin MEASUREMENT B_nsadh_msg "Condition hold afterstart adaptation" UBYTE B_TRUE 1 100 0.00 1.00000000000 BIT_MASK 0x1 FORMAT "%13.11" ECU_ADDRESS 0x70000B52 /end MEASUREMENT
/begin MEASUREMENT B_nsadstp "Condition stop afterstart adaptation" UBYTE B_TRUE 1 100 0.00 1.00000000000 BIT_MASK 0x1 FORMAT "%13.11" ECU_ADDRESS 0x70000403 /end MEASUREMENT
/begin MEASUREMENT B_nsad_msg "Condition afterstart adaptation active" UBYTE B_TRUE 1 100 0.00 1.00000000000 BIT_MASK 0x1 FORMAT "%13.11" ECU_ADDRESS 0x70000B54 /end MEASUREMENT
/begin MEASUREMENT B_nwemg "Condition: switch-over of the resume speed at 'clutch opens'" UBYTE B_TRUE 1 100 0.00 1.00000000000 BIT_MASK 0x1 FORMAT "%13.11" ECU_ADDRESS 0x6000F153 /end MEASUREMENT
/begin MEASUREMENT B_pbndrycond "Condition for the update of the unlimited offset correction of pbrintuk_w HFMDSS adaptation (internal value)" UBYTE B_TRUE 1 100 0.00 1.00000000000 BIT_MASK 0x1 FORMAT "%13.11" ECU_ADDRESS 0x6000FA7C /end MEASUREMENT
/begin MEASUREMENT B_pnbhtr "condition: no blockheater has been detected (provisionally)" UBYTE B_TRUE 1 100 0.00 1.00000000000 BIT_MASK 0x1 FORMAT "%13.11" ECU_ADDRESS 0x700003FD /end MEASUREMENT
/begin MEASUREMENT B_rapshds "condition: reset adaptation between MAF based intake manifold pressure and measured intake manifold pressure" UBYTE B_TRUE 1 100 0.00 1.00000000000 BIT_MASK 0x1 FORMAT "%13.11" ECU_ADDRESS 0x600014EA /end MEASUREMENT
/begin MEASUREMENT B_rapskt "condition: reset adap. modelled to measured manifold pressure for short test egr" UBYTE B_TRUE 1 100 0.00 1.00000000000 BIT_MASK 0x1 FORMAT "%13.11" ECU_ADDRESS 0x600013C5 /end MEASUREMENT
/begin MEASUREMENT B_rapslmds_msg "condition: reset adaptation modelled to measured manifold pressure" UBYTE B_TRUE 1 100 0.00 1.00000000000 BIT_MASK 0x1 FORMAT "%13.11" ECU_ADDRESS 0x600014E9 /end MEASUREMENT
/begin MEASUREMENT B_rqschfea_msg "Condition: request stratified mode because of the adaptation of the air charge determination" UBYTE B_TRUE 1 100 0.00 1.00000000000 BIT_MASK 0x1 FORMAT "%13.11" ECU_ADDRESS 0x600014E5 /end MEASUREMENT
/begin MEASUREMENT B_sabvorLoc "Fuel-cutoff prerelease" UBYTE B_TRUE 1 100 0.00 1.00000000000 BIT_MASK 0x1 FORMAT "%13.11" ECU_ADDRESS 0x6000F152 /end MEASUREMENT
/begin MEASUREMENT B_saen_msg "Overrun fuel cutoff is fundamentally released." UBYTE B_TRUE 1 100 0.00 1.00000000000 BIT_MASK 0x1 FORMAT "%13.11" ECU_ADDRESS 0x6000FA75 /end MEASUREMENT
/begin MEASUREMENT B_sccnsad "FID: Fault Identity Detection afterstart adaptation" UBYTE B_TRUE 1 100 0.00 1.00000000000 BIT_MASK 0x1 FORMAT "%13.11" ECU_ADDRESS 0x70000402 /end MEASUREMENT
/begin MEASUREMENT B_sccnsad2 "FID: Fault Identity Detection afterstart adaptation" UBYTE B_TRUE 1 100 0.00 1.00000000000 BIT_MASK 0x1 FORMAT "%13.11" ECU_ADDRESS 0x70000401 /end MEASUREMENT
/begin MEASUREMENT B_sdlutsr_msg "Condition calculation standard deviation engine roughnessis ready" UBYTE B_TRUE 1 100 0.00 1.00000000000 BIT_MASK 0x1 FORMAT "%13.11" ECU_ADDRESS 0x70000B2F /end MEASUREMENT
/begin MEASUREMENT B_sdluts_msg "Condition calculation standard deviation engine roughness" UBYTE B_TRUE 1 100 0.00 1.00000000000 BIT_MASK 0x1 FORMAT "%13.11" ECU_ADDRESS 0x70000B30 /end MEASUREMENT
/begin MEASUREMENT B_staclr_msg "cond. start adaption: clear adaption values" UBYTE B_TRUE 1 100 0.00 1.00000000000 BIT_MASK 0x1 FORMAT "%13.11" ECU_ADDRESS 0x70000B2D /end MEASUREMENT
/begin MEASUREMENT B_staneut_msg "condition start adaption: output neutral value" UBYTE B_TRUE 1 100 0.00 1.00000000000 BIT_MASK 0x1 FORMAT "%13.11" ECU_ADDRESS 0x70000B2B /end MEASUREMENT
/begin MEASUREMENT B_stanodec_msg "cond. startadaption: forbid decrementation" UBYTE B_TRUE 1 100 0.00 1.00000000000 BIT_MASK 0x1 FORMAT "%13.11" ECU_ADDRESS 0x70000B2A /end MEASUREMENT
/begin MEASUREMENT B_stanoinc_msg "cond. startadaption: forbid incrementation" UBYTE B_TRUE 1 100 0.00 1.00000000000 BIT_MASK 0x1 FORMAT "%13.11" ECU_ADDRESS 0x70000B29 /end MEASUREMENT
/begin MEASUREMENT B_stanosav_msg "cond. startadaption: forbid store of ad. values" UBYTE B_TRUE 1 100 0.00 1.00000000000 BIT_MASK 0x1 FORMAT "%13.11" ECU_ADDRESS 0x70000B28 /end MEASUREMENT
/begin MEASUREMENT B_sthdp_msg "Condition start with high pressure pump active" UBYTE B_TRUE 1 100 0.00 1.00000000000 BIT_MASK 0x1 FORMAT "%13.11" ECU_ADDRESS 0x6000FA67 /end MEASUREMENT
/begin MEASUREMENT B_sthdrpre_msg "Condition high fuel pressure start with pre-injection" UBYTE B_TRUE 1 100 0.00 1.00000000000 BIT_MASK 0x1 FORMAT "%13.11" ECU_ADDRESS 0x6000FA65 /end MEASUREMENT
/begin MEASUREMENT B_sthdr_msg "Condition start with high fuel pressure" UBYTE B_TRUE 1 100 0.00 1.00000000000 BIT_MASK 0x1 FORMAT "%13.11" ECU_ADDRESS 0x6000FA66 /end MEASUREMENT
/begin MEASUREMENT B_tmmn_msg "Condition: blockheater detected" UBYTE B_TRUE 1 100 0.00 1.00000000000 BIT_MASK 0x1 FORMAT "%13.11" ECU_ADDRESS 0x70000B0C /end MEASUREMENT
/begin MEASUREMENT B_tmsrt_msg "condition: retriggering engine temperature model after start" UBYTE B_TRUE 1 100 0.00 1.00000000000 BIT_MASK 0x1 FORMAT "%13.11" ECU_ADDRESS 0x70000B0B /end MEASUREMENT
/begin MEASUREMENT B_zlzsr "condition: cylce leak to manifold" UBYTE B_TRUE 1 100 0.00 1.00000000000 BIT_MASK 0x1 FORMAT "%13.11" ECU_ADDRESS 0x600011C8 /end MEASUREMENT
/begin MEASUREMENT CEngDsT_flgBlkHeatrActvd "condittion: Blockheater influence" UBYTE B_TRUE 1 100 0.00 1.00000000000 BIT_MASK 0x1 FORMAT "%13.11" ECU_ADDRESS 0x70000ADA /end MEASUREMENT
/begin MEASUREMENT censad_msg "Counter enable afterstart adaptation" UBYTE dez 1 100 0.00 255.0 FORMAT "%5.1" ECU_ADDRESS 0x60000997 /end MEASUREMENT
/begin MEASUREMENT cesdluts "Counter enable calculation standard deviation engine roughness" UBYTE dez 1 100 0.00 255.0 FORMAT "%5.1" ECU_ADDRESS 0x50000978 /end MEASUREMENT
/begin MEASUREMENT cesdlutsr "counter of synchros since %ESDSDLUT is active" UBYTE dez 1 100 0.00 255.0 FORMAT "%5.1" ECU_ADDRESS 0x50000979 /end MEASUREMENT
/begin MEASUREMENT ChrCtl_flgRstDsmEgrAdpn100ms "fcmclr flag for EGR Adaption reset in 100ms" UBYTE B_TRUE 1 100 0.00 1.00000000000 BIT_MASK 0x1 FORMAT "%13.11" ECU_ADDRESS 0x600011B2 /end MEASUREMENT
/begin MEASUREMENT ChrCtl_flgRstDsmEgrAdpn20ms "fcmclr flag for EGR Adaption reset in 20ms" UBYTE B_TRUE 1 100 0.00 1.00000000000 BIT_MASK 0x1 FORMAT "%13.11" ECU_ADDRESS 0x600011B3 /end MEASUREMENT
/begin MEASUREMENT ChrSet_ratAirChrgDesEgrExtLoLft "Relative air charge for calculation of desired Egr rate for low lift" UWORD rel_q0p02344 1 100 0.00 1535.977 FORMAT "%8.3" ECU_ADDRESS 0x600011A2 /end MEASUREMENT
/begin MEASUREMENT ChrSet_ratAirChrgDesEgrIntkVlvLft "Relative air charge for calculation of desired Egr rate for homogenous mode" UWORD rel_q0p02344 1 100 0.00 1535.977 FORMAT "%8.3" ECU_ADDRESS 0x600011A0 /end MEASUREMENT
/begin MEASUREMENT clutwmen_w_msg "counter for enable condition for counter engine roughness with warm engine" UWORD dez 1 100 0.00 65535.00 FORMAT "%8.2" ECU_ADDRESS 0x50000898 /end MEASUREMENT
/begin MEASUREMENT clutwm_w_msg "counter engine roughness with warm engine" UWORD dez 1 100 0.00 65535.00 FORMAT "%8.2" ECU_ADDRESS 0x50000896 /end MEASUREMENT
/begin MEASUREMENT CoEng_bCtOffConDel "delayed release condition for Cut Off" UBYTE B_TRUE 1 100 0.00 1.00000000000 BIT_MASK 0x1 FORMAT "%13.11" ECU_ADDRESS 0x6000FA18 /end MEASUREMENT
/begin MEASUREMENT CoEng_cntrDlyLamSwtVlvLft "Counter for delay of lambda modification during valve lift switching" UWORD OneToOne 1 100 0.00 65535.00 FORMAT "%8.2" ECU_ADDRESS 0x7000318E /end MEASUREMENT
/begin MEASUREMENT CoEng_FcoRelsDlyTONV_I.outbit "Delay of fuel-cutoff release / return value" UBYTE B_TRUE 1 100 0.00 1.00000000000 BIT_MASK 0x1 FORMAT "%13.11" ECU_ADDRESS 0x60008090 /end MEASUREMENT
/begin MEASUREMENT CoEng_FcoRelsDlyTONV_I.time "Delay of fuel-cutoff release / expired delay time" UWORD t_q0p01 1 100 0.00 655.3500 FORMAT "%8.4" ECU_ADDRESS 0x60008092 /end MEASUREMENT
/begin MEASUREMENT CoEng_flgCpvClsForFco "Flag: close canister purge valve for fuel cut-off." UBYTE B_TRUE 1 100 0.00 1.00000000000 BIT_MASK 0x1 FORMAT "%13.11" ECU_ADDRESS 0x6000FA16 /end MEASUREMENT
/begin MEASUREMENT CoEng_flgEvapOil "Flag status of high evaporation from oil" UBYTE B_TRUE 1 100 0.00 1.00000000000 BIT_MASK 0x1 FORMAT "%13.11" ECU_ADDRESS 0x6000F151 /end MEASUREMENT
/begin MEASUREMENT CoEng_flgFcoRdnBasc "Flag: Overrun fuel cutoff is fundamentally allowed and meaningful." UBYTE B_TRUE 1 100 0.00 1.00000000000 BIT_MASK 0x1 FORMAT "%13.11" ECU_ADDRESS 0x6000FA12 /end MEASUREMENT
/begin MEASUREMENT CoEng_flgFcoRdnEF_I.buffer "Fuel-cutoff readiness, falling edge / memory to detect falling edge" UBYTE B_TRUE 1 100 0.00 1.00000000000 BIT_MASK 0x1 FORMAT "%13.11" ECU_ADDRESS 0x600011CE /end MEASUREMENT
/begin MEASUREMENT CoEng_flgFcoRdnEF_I.oldSignal "Fuel-cutoff readiness, falling edge / memory to detect falling edge" UBYTE B_TRUE 1 100 0.00 1.00000000000 BIT_MASK 0x1 FORMAT "%13.11" ECU_ADDRESS 0x600011CF /end MEASUREMENT
/begin MEASUREMENT CoEng_flgFcoRelsEng "Release of fuel cutoff from engine" UBYTE B_TRUE 1 100 0.00 1.00000000000 BIT_MASK 0x1 FORMAT "%13.11" ECU_ADDRESS 0x6000F150 /end MEASUREMENT
/begin MEASUREMENT CoEng_flgFcoRelsVeh "Release of fuel cutoff from vehicle functions" UBYTE B_TRUE 1 100 0.00 1.00000000000 BIT_MASK 0x1 FORMAT "%13.11" ECU_ADDRESS 0x6000F14F /end MEASUREMENT
/begin MEASUREMENT CoEng_flgFcoTrsm "Condition fuel cut-off enabled" UBYTE B_TRUE 1 100 0.00 1.00000000000 BIT_MASK 0x1 FORMAT "%13.11" ECU_ADDRESS 0x6000FA11 /end MEASUREMENT
/begin MEASUREMENT CoEng_flgLamSwtLoHi "Recognition of switching from low to high valve lift for lambda modification" UBYTE B_TRUE 1 100 0.00 1.00000000000 BIT_MASK 0x1 FORMAT "%13.11" ECU_ADDRESS 0x700003FC /end MEASUREMENT
/begin MEASUREMENT CoEng_flgNRstrtMinAbsFailr "ABS failure detected, restart speed limited to a minimum value" UBYTE B_TRUE 1 100 0.00 1.00000000000 BIT_MASK 0x1 FORMAT "%13.11" ECU_ADDRESS 0x6000F14E /end MEASUREMENT
/begin MEASUREMENT CoEng_flgRelsFco "Flag: overrun fuel cutoff is released." UBYTE B_TRUE 1 100 0.00 1.00000000000 BIT_MASK 0x1 FORMAT "%13.11" ECU_ADDRESS 0x6000FA10 /end MEASUREMENT
/begin MEASUREMENT CoEng_flgTiDpdtOverrunHysRst "Overrun hysteresis reset flag" UBYTE B_TRUE 1 100 0.00 1.00000000000 BIT_MASK 0x1 FORMAT "%13.11" ECU_ADDRESS 0x6000F14D /end MEASUREMENT
/begin MEASUREMENT CoEng_nDeltaRstrtClimaTot "Increase of the restart speed due to AC compressor" UBYTE nmot_ub_q40 1 100 0.00 10200. FORMAT "%5.0" ECU_ADDRESS 0x7000544F /end MEASUREMENT
/begin MEASUREMENT CoEng_nDeltaRstrtNGrdt "Increase of the restart speed due to high engine speed gradient" UBYTE nmot_ub_q40 1 100 0.00 10200. FORMAT "%5.0" ECU_ADDRESS 0x6000F14C /end MEASUREMENT
/begin MEASUREMENT CoEng_nFco "Engine speed for fuel cut-off." SWORD EngN 1 100 0.00 16383.50 FORMAT "%8.2" ECU_ADDRESS 0x600147A8 /end MEASUREMENT
/begin MEASUREMENT CoEng_nRstrt "engine speed for fuel cut-in" SWORD nmot_q0p5 1 100 0.00 16383.50 FORMAT "%8.2" ECU_ADDRESS 0x600147AA /end MEASUREMENT
/begin MEASUREMENT CoEng_nRstrtBasc "Fundamental value of the fuel cut-in speed." SWORD EngN 1 100 -16384.00 16383.50 FORMAT "%8.2" ECU_ADDRESS 0x7000528C /end MEASUREMENT
/begin MEASUREMENT CoEng_nRstrtBascTrsm "Fundamental value of the fuel cut-in speed from transmission" SWORD EngN 1 100 -16384.00 16383.50 FORMAT "%8.2" ECU_ADDRESS 0x600080A6 /end MEASUREMENT
/begin MEASUREMENT CoEng_numGearFcoLoc "Gear for the fuel-cutoff release" SBYTE OneToOne 1 100 -128.0 127.0 FORMAT "%5.1" ECU_ADDRESS 0x6000F14B /end MEASUREMENT
/begin MEASUREMENT CoEng_ratLamHomMinLoc "Interpolation result of CoEng_ratLamHomMin_Crv." UWORD fak_q0p000244 1 100 0.00 15.99976 FORMAT "%8.5" ECU_ADDRESS 0x60009586 /end MEASUREMENT
/begin MEASUREMENT Com_stRxSRSA "Status of SRSA Frame Reception" UBYTE OneToOne 1 100 0.00 255.0 FORMAT "%5.1" ECU_ADDRESS 0x6000FD98 /end MEASUREMENT
/begin MEASUREMENT Com_stRxSRSAChkSumOk "Status of Checksum Error of SRSA frame" UBYTE OneToOne 1 100 0.00 255.0 FORMAT "%5.1" ECU_ADDRESS 0x6000FD97 /end MEASUREMENT
/begin MEASUREMENT Com_stRxSRSADeb "Debounced Status of SRSA Frame Reception" UBYTE OneToOne 1 100 0.00 255.0 FORMAT "%5.1" ECU_ADDRESS 0x6000FD96 /end MEASUREMENT
/begin MEASUREMENT Com_stRxSRSAOk "Error Status of SRSA Frame Reception" UBYTE OneToOne 1 100 0.00 255.0 FORMAT "%5.1" ECU_ADDRESS 0x6000FD95 /end MEASUREMENT
/begin MEASUREMENT Com_stRxSRSARingCntOk "Ring Counter Error Status of SRSA Frame" UBYTE OneToOne 1 100 0.00 255.0 FORMAT "%5.1" ECU_ADDRESS 0x6000FD94 /end MEASUREMENT
/begin MEASUREMENT Com_stSRSActvDlyd "SRS Active after delay status" UBYTE OneToOne 1 100 0.00 255.0 FORMAT "%5.1" ECU_ADDRESS 0x6000FD93 /end MEASUREMENT
/begin MEASUREMENT CoPOM_bCtOffDem "Cut-Off demand" UBYTE B_TRUE 1 100 0.00 1.00000000000 BIT_MASK 0x1 FORMAT "%13.11" ECU_ADDRESS 0x6000F9FF /end MEASUREMENT
/begin MEASUREMENT dnsavg "Delta engine speed from velocity and gear" SWORD nmot_q0p5 1 100 0.00 16383.50 FORMAT "%8.2" ECU_ADDRESS 0x600080A4 /end MEASUREMENT
/begin MEASUREMENT dnsavt "Delta engine speed from velocity and engine temperature" SWORD nmot_q0p5 1 100 0.00 16383.50 FORMAT "%8.2" ECU_ADDRESS 0x600080A2 /end MEASUREMENT
/begin MEASUREMENT dnsa_w "time depending overrun hysteresis" SWORD nmot_q0p5 1 100 0.00 16383.50 FORMAT "%8.2" ECU_ADDRESS 0x600080A0 /end MEASUREMENT
/begin MEASUREMENT dpapvagr_w "difference exhaust gas pressure and pressure upstream egr valve" UWORD p_uw_q0p039 1 100 0.00 2559.961 FORMAT "%8.3" ECU_ADDRESS 0x600011B0 /end MEASUREMENT
/begin MEASUREMENT dpslmdsf_w_msg "difference modelled to measured manifold pressure(filtert)" SWORD p_q0p039 1 100 -1280.000 1279.961 FORMAT "%8.3" ECU_ADDRESS 0x60001644 /end MEASUREMENT
/begin MEASUREMENT drriextsmz_w_msg "calculated Delta inert residual exhaust gas rate f. ext. desired AGR-value in the int. mode state" UWORD rel_uw_b100 1 100 0.00 99.99847 FORMAT "%8.5" ECU_ADDRESS 0x60001610 /end MEASUREMENT
/begin MEASUREMENT EngStrt_cntrAftStrtDly "Counter to delay in stopping afterstart adaptation" UBYTE OneToOne 1 100 0.00 255.0 FORMAT "%5.1" ECU_ADDRESS 0x5000094F /end MEASUREMENT
/begin MEASUREMENT EngStrt_cntrInjRelsHiPStrt "counter for injection release for high pressure start." UBYTE OneToOne 1 100 0.00 255.0 FORMAT "%5.1" ECU_ADDRESS 0x7000319C /end MEASUREMENT
/begin MEASUREMENT EngStrt_cntrRstHiPStrt "Counter for reset of condition start wirth high fuel pressure" UBYTE OneToOne 1 100 0.00 255.0 FORMAT "%5.1" ECU_ADDRESS 0x7000319B /end MEASUREMENT
/begin MEASUREMENT EngStrt_cntrRstHipStrtIf "Counter for reset of condition start wirth high fuel pressure (interface)" UBYTE OneToOne 1 100 0.00 255.0 FORMAT "%5.1" ECU_ADDRESS 0x7000370C /end MEASUREMENT
/begin MEASUREMENT EngStrt_cntrRstHiPStrtIni "Counter for reset of condition start wirth high fuel pressure (Init-Value)" UBYTE OneToOne 1 100 0.00 255.0 FORMAT "%5.1" ECU_ADDRESS 0x7000370D /end MEASUREMENT
/begin MEASUREMENT EngStrt_cntrRstHiPStrtLocIni "local copy of ini-value of EngStrt_cntrRstHiPStrt" UBYTE OneToOne 1 100 0.00 255.0 FORMAT "%5.1" ECU_ADDRESS 0x7000319A /end MEASUREMENT
/begin MEASUREMENT EngStrt_ctDrvEntrBBSTNSAD100ms "Local variable to store the global drive enter counter(SyC_ctDrvEnter)" UBYTE OneToOne 1 100 0.00 255.0 FORMAT "%5.1" ECU_ADDRESS 0x60014A33 /end MEASUREMENT
/begin MEASUREMENT EngStrt_ctDrvEntrBBSTNSAD20ms "Local variable to store the global drive enter counter(SyC_ctDrvEnter)" UBYTE OneToOne 1 100 0.00 255.0 FORMAT "%5.1" ECU_ADDRESS 0x6000F145 /end MEASUREMENT
/begin MEASUREMENT EngStrt_ctDrvEntrBBSTNSADSyncS0 "Local variable to store the global drive enter counter(SyC_ctDrvEnter)" UBYTE OneToOne 1 100 0.00 255.0 FORMAT "%5.1" ECU_ADDRESS 0x50000950 /end MEASUREMENT
/begin MEASUREMENT EngStrt_flgAftStopInhb "Flag to inhibit stopping of afterstart adaptation" UBYTE B_TRUE 1 100 0.00 1.00000000000 BIT_MASK 0x1 FORMAT "%13.11" ECU_ADDRESS 0x70000400 /end MEASUREMENT
/begin MEASUREMENT EngStrt_flgAftStopInhbHld "Flag to Hold the inhibition condition for stopping afterstart adaptation" UBYTE B_TRUE 1 100 0.00 1.00000000000 BIT_MASK 0x1 FORMAT "%13.11" ECU_ADDRESS 0x700003FF /end MEASUREMENT
/begin MEASUREMENT EngStrt_flgCntrRstHiPStrt "Condition counter for reset of start with high fuel pressure is zero" UBYTE B_TRUE 1 100 0.00 1.00000000000 BIT_MASK 0x1 FORMAT "%13.11" ECU_ADDRESS 0x70003199 /end MEASUREMENT
/begin MEASUREMENT EngStrt_flgFuPExcdd "Condition pressure threshold exceeded" UBYTE B_TRUE 1 100 0.00 1.00000000000 BIT_MASK 0x1 FORMAT "%13.11" ECU_ADDRESS 0x6000F982 /end MEASUREMENT
/begin MEASUREMENT EngStrt_flgFuPRels "release condition for high pressure start on fuel pressure" UBYTE B_TRUE 1 100 0.00 1.00000000000 BIT_MASK 0x1 FORMAT "%13.11" ECU_ADDRESS 0x6000F981 /end MEASUREMENT
/begin MEASUREMENT EngStrt_flgHiPStrt "High pressure start" UBYTE B_TRUE 1 100 0.00 1.00000000000 BIT_MASK 0x1 FORMAT "%13.11" ECU_ADDRESS 0x6000F980 /end MEASUREMENT
/begin MEASUREMENT EngStrt_flgHiPStrtReq "Condition request start with high fuel pressure" UBYTE B_TRUE 1 100 0.00 1.00000000000 BIT_MASK 0x1 FORMAT "%13.11" ECU_ADDRESS 0x7000361E /end MEASUREMENT
/begin MEASUREMENT EngStrt_flgIninCntrHiPStrt "Enabling condition to reset the counter" UBYTE B_TRUE 1 100 0.00 1.00000000000 BIT_MASK 0x1 FORMAT "%13.11" ECU_ADDRESS 0x6000F147 /end MEASUREMENT
/begin MEASUREMENT EngStrt_flgInjRels "Condition enable start injection" UBYTE B_TRUE 1 100 0.00 1.00000000000 BIT_MASK 0x1 FORMAT "%13.11" ECU_ADDRESS 0x6000F97E /end MEASUREMENT
/begin MEASUREMENT EngStrt_flgInjRelsHiPStrt "injection release status bit." UBYTE B_TRUE 1 100 0.00 1.00000000000 BIT_MASK 0x1 FORMAT "%13.11" ECU_ADDRESS 0x70003198 /end MEASUREMENT
/begin MEASUREMENT EngStrt_flgPreInjLoPLoc "local to measure preinjection with low pressure" UBYTE B_TRUE 1 100 0.00 1.00000000000 BIT_MASK 0x1 FORMAT "%13.11" ECU_ADDRESS 0x6000F146 /end MEASUREMENT
/begin MEASUREMENT EngStrt_flgRstHiPStrt "Condition cancel start with high fuel pressure" UBYTE B_TRUE 1 100 0.00 1.00000000000 BIT_MASK 0x1 FORMAT "%13.11" ECU_ADDRESS 0x6000F97B /end MEASUREMENT
/begin MEASUREMENT EngStrt_flgStrtActvPmp "Condition start with high pressure pump active" UBYTE B_TRUE 1 100 0.00 1.00000000000 BIT_MASK 0x1 FORMAT "%13.11" ECU_ADDRESS 0x6000F979 /end MEASUREMENT
/begin MEASUREMENT EngStrt_pRailHiPStrtRels "threshold rail pressure for HDST" UWORD RBPtCel_p_0p002_1 1 100 0.00 131.0700 FORMAT "%8.4" ECU_ADDRESS 0x6000949C /end MEASUREMENT
/begin MEASUREMENT EngStrt_tiRstHiPStrtIf "Time counter for reset of condition start wirth high fuel pressure (interface)" UWORD t_q0p01 1 100 0.00 655.3500 FORMAT "%8.4" ECU_ADDRESS 0x6000949A /end MEASUREMENT
/begin MEASUREMENT EngStrt_tiRstHiPStrtIni "Time counter for reset of condition start wirth high fuel pressure (Init-Value)" UWORD t_q0p01 1 100 0.00 655.3500 FORMAT "%8.4" ECU_ADDRESS 0x60009498 /end MEASUREMENT
/begin MEASUREMENT EngStrt_tiRstHiPStrtLoc "Time counter for reset of condition start wirth high fuel pressure (local copy)" UWORD t_q0p01 1 100 0.00 655.3500 FORMAT "%8.4" ECU_ADDRESS 0x6000808E /end MEASUREMENT
/begin MEASUREMENT EngStrt_tiRstHiPStrtLocIni "local copy of ini-value of EngStrt_tiRstHiPStrt" UWORD t_q0p01 1 100 0.00 655.3500 FORMAT "%8.4" ECU_ADDRESS 0x70003196 /end MEASUREMENT
/begin MEASUREMENT evz_ausold "injection cut off pattern total at time t-1" UBYTE dez 1 100 0.00 255.0 FORMAT "%5.1" ECU_ADDRESS 0x6000F13A /end MEASUREMENT
/begin MEASUREMENT fkaezloc_w "factor for cor.injection time during act. var. camshaft- for all cylinders" UWORD fak_uw_b2 1 100 0.00 1.999969 FORMAT "%8.6" ARRAY_SIZE 4 ECU_ADDRESS 0x50005830 /end MEASUREMENT
/begin MEASUREMENT fkaez_a0 "factor for cyl. 0 cor. injection time cylinderind. during act. var. camshaft" UBYTE fak_q0p0039_op0p5 1 100 0.500 1.496 FORMAT "%5.3" ECU_ADDRESS 0x6000F73C /end MEASUREMENT
/begin MEASUREMENT fkaez_a1 "factor for cyl. 1 cor.injection time individual cylinder during act. var. camshaft" UBYTE fak_q0p0039_op0p5 1 100 0.500 1.496 FORMAT "%5.3" ECU_ADDRESS 0x6000F73B /end MEASUREMENT
/begin MEASUREMENT fkaez_a2 "factor for cyl. 2 cor.injection time individual cylinder during act. var. camshaft" UBYTE fak_q0p0039_op0p5 1 100 0.500 1.496 FORMAT "%5.3" ECU_ADDRESS 0x6000F73A /end MEASUREMENT
/begin MEASUREMENT fkaez_a3 "factor for cyl. 3 cor.injection time individual cylinder during act. var. camshaft" UBYTE fak_q0p0039_op0p5 1 100 0.500 1.496 FORMAT "%5.3" ECU_ADDRESS 0x6000F739 /end MEASUREMENT
/begin MEASUREMENT fkaez_w_msg "factor to correct injection time cylinderindividuell, array over all cylinder" UWORD fak_uw_b2 1 100 0.500000 1.500000 FORMAT "%8.6" ARRAY_SIZE 4 ECU_ADDRESS 0x6001498C /end MEASUREMENT
/begin MEASUREMENT fkblagkl_w "correction of egr line profile (fast adaptation) out KL" UWORD fak_q3p0518Em5 1 100 0.00 1.999969 FORMAT "%8.6" ECU_ADDRESS 0x600011AE /end MEASUREMENT
/begin MEASUREMENT fkblagrs_w_msg "correction of egr line profile (fast adaptation)" UWORD fak_q3p0518Em5 1 100 0.00 1.999969 FORMAT "%8.6" ECU_ADDRESS 0x60001488 /end MEASUREMENT
/begin MEASUREMENT fkblagr_w_msg "correction of egr line profile" UWORD fak_q3p0518Em5 1 100 0.00 1.999969 FORMAT "%8.6" ECU_ADDRESS 0x60039878 /end MEASUREMENT
/begin MEASUREMENT fkfupsrl_w_msg "correction factor fupsrl_w" UWORD fak_q3p0518Em5 1 100 0.00 1.999969 FORMAT "%8.6" ECU_ADDRESS 0x60000CCC /end MEASUREMENT
/begin MEASUREMENT fklaf2ir_w "Factor inverse saint venant 2 reciprocal" UWORD fak_q0p000122 1 100 0.00 7.999878 FORMAT "%8.6" ECU_ADDRESS 0x600011AC /end MEASUREMENT
/begin MEASUREMENT fkmsagrs_w_msg "fast egr correction factor" UWORD fak_q3p0518Em5 1 100 0.00 1.999969 FORMAT "%8.6" ECU_ADDRESS 0x6000160C /end MEASUREMENT
/begin MEASUREMENT fkmsasz_w "fast egr correction factor calculation value" SWORD fak_uw_b4 1 100 -2.000000 1.999939 FORMAT "%8.6" ECU_ADDRESS 0x6000163A /end MEASUREMENT
/begin MEASUREMENT fktrries_w_msg "Faktor Sollwert externe Restgasrate in Temp,- Abh." UWORD fak_q3p0518Em5 1 100 0.00 1.999969 FORMAT "%8.6" ECU_ADDRESS 0x600015FC /end MEASUREMENT
/begin MEASUREMENT fkupsrliunlim_w "unlimited correction factor fupsrl_w (internal value)" UWORD fak_q3p0518Em5 1 100 0.00 1.999969 FORMAT "%8.6" ECU_ADDRESS 0x60000CAC /end MEASUREMENT
/begin MEASUREMENT fkupsrli_w "correction factor fupsrl_w (internal value)" UWORD fak_q3p0518Em5 1 100 0.00 1.999969 FORMAT "%8.6" ECU_ADDRESS 0x600011C6 /end MEASUREMENT
/begin MEASUREMENT fragrs_w "controll factor egr value" UWORD fak_q3p0518Em5 1 100 0.00 1.999969 FORMAT "%8.6" ECU_ADDRESS 0x6000119E /end MEASUREMENT
/begin MEASUREMENT frrieas_msg "factor from ratio of external inertial gas ratios deactivated desired value" UBYTE fak_q0p00781 1 100 0.00 1.992 FORMAT "%5.3" ECU_ADDRESS 0x60001514 /end MEASUREMENT
/begin MEASUREMENT fvapskstaa "Enrichment factor kstaa or fuelvaps_w afterstart adaptation" UBYTE fak_ub_b2 1 100 0.00 1.992188 FORMAT "%8.6" ECU_ADDRESS 0x6000091A /end MEASUREMENT
/begin MEASUREMENT InjSys_bInjVlvActv "Condition all injection valves active" UBYTE B_TRUE 1 100 0.00 1.00000000000 BIT_MASK 0x1 FORMAT "%13.11" ECU_ADDRESS 0x70000895 /end MEASUREMENT
/begin MEASUREMENT InjSys_flgFcoBnk "Condition total fuel cut-off in BankBank1" UBYTE B_TRUE 1 100 0.00 1.00000000000 BIT_MASK 0x1 FORMAT "%13.11" ECU_ADDRESS 0x7000087E /end MEASUREMENT
/begin MEASUREMENT InjSys_flgFuEngOperActv "Fueled engine operation active" UBYTE B_TRUE 1 100 0.00 1.00000000000 BIT_MASK 0x1 FORMAT "%13.11" ECU_ADDRESS 0x7000087D /end MEASUREMENT
/begin MEASUREMENT InjSys_nEngSpdLoc "Engine Speed(rpm) Local" UBYTE nmot_ub_q40 1 100 0.00 10200. FORMAT "%5.0" ECU_ADDRESS 0x6000F139 /end MEASUREMENT
/begin MEASUREMENT InjSys_nMaxHPInjVlvStkOpn "Engine speed limit in case of open clamping HDEV" SWORD EngN 1 100 -16384.00 16383.50 FORMAT "%8.2" ECU_ADDRESS 0x60009078 /end MEASUREMENT
/begin MEASUREMENT InjSys_stActRedStg "Real cylinder cut-off step" UBYTE dez 1 100 0.00 255.0 FORMAT "%5.1" ECU_ADDRESS 0x5000608A /end MEASUREMENT
/begin MEASUREMENT InjSys_stInjDeactv "Substitute injection cutoff sample instead of evzaustot for Dualsystem" UBYTE dez 1 100 0.00 255.0 FORMAT "%5.1" ECU_ADDRESS 0x70003699 /end MEASUREMENT
/begin MEASUREMENT InjSys_stInjDeactvSyns "Substitute injection cutoff sample instead of evzaustot for Dualsystem" UBYTE dez 1 100 0.00 255.0 FORMAT "%5.1" ECU_ADDRESS 0x70003698 /end MEASUREMENT
/begin MEASUREMENT InjSys_stInjDeactv_a "Cylinder individual Fuel cutoff mask" UBYTE dez 1 100 0.00 255.0 FORMAT "%5.1" ARRAY_SIZE 4 ECU_ADDRESS 0x70003694 /end MEASUREMENT
/begin MEASUREMENT InjSys_tEngTLoc "Engine Temperature Local" UBYTE temp_ub_q0p75_o48 1 100 -48.0 143.3 FORMAT "%5.1" ECU_ADDRESS 0x6000F138 /end MEASUREMENT
/begin MEASUREMENT lamax_w_msg "Upper dynamic lambda limit." UWORD fak_q0p000244 1 100 0.00 15.99976 FORMAT "%8.5" ECU_ADDRESS 0x7000378E /end MEASUREMENT
/begin MEASUREMENT lamin_w_msg "Lower dynamic lambda limit." UWORD fak_q0p000244 1 100 0.00 15.99976 FORMAT "%8.5" ECU_ADDRESS 0x7000378C /end MEASUREMENT
/begin MEASUREMENT LAS_a "Longitudinal Acceleration" SWORD Acc 1 100 -32.76800 32.76700 FORMAT "%8.5" ECU_ADDRESS 0x600098B4 /end MEASUREMENT
/begin MEASUREMENT LGT_a "Longitudinal G Acceleration information" SWORD AccGrv 1 100 -327.6800 327.6700 FORMAT "%8.4" ECU_ADDRESS 0x600098B0 /end MEASUREMENT
/begin MEASUREMENT msagrdsz_w "EGR mass flow into intake manifold calculation value" SWORD m_q0p1 1 100 -3276.800 3276.700 FORMAT "%8.3" ECU_ADDRESS 0x70003192 /end MEASUREMENT
/begin MEASUREMENT msagrds_w_msg "EGR mass flow into intake manifold" UWORD m_q0p1 1 100 0.00 6553.500 FORMAT "%8.3" ECU_ADDRESS 0x70003782 /end MEASUREMENT
/begin MEASUREMENT msagrm_w "EGR mass flow into intake manifold (calculated)" UWORD m_q0p1 1 100 0.00 6553.500 FORMAT "%8.3" ECU_ADDRESS 0x600011BC /end MEASUREMENT
/begin MEASUREMENT msagrsr_w_msg "EGR mass flow into manifold" UWORD m_q0p1 1 100 0.00 6553.500 FORMAT "%8.3" ECU_ADDRESS 0x60000CF2 /end MEASUREMENT
/begin MEASUREMENT msagrtn_w_msg "EGR mass flow in the intake manifold due to tolerances, minimum" UWORD m_q0p1 1 100 0.00 6553.500 FORMAT "%8.3" ECU_ADDRESS 0x60000CF6 /end MEASUREMENT
/begin MEASUREMENT msagrtx_w_msg "EGR mass flow in the intake manifold due to tolerances, maximum" UWORD m_q0p1 1 100 0.00 6553.500 FORMAT "%8.3" ECU_ADDRESS 0x60000CF8 /end MEASUREMENT
/begin MEASUREMENT msagr_w_msg "EGR mass flow from bank1" UWORD m_q0p1 1 100 0.00 6553.500 FORMAT "%8.3" ECU_ADDRESS 0x600015E6 /end MEASUREMENT
/begin MEASUREMENT msbkvsr_w_msg "Modeled extra air from brake booster" UWORD m_q0p1 1 100 0.00 6553.500 FORMAT "%8.3" ECU_ADDRESS 0x60008080 /end MEASUREMENT
/begin MEASUREMENT msdksrtk_w "total mass flow into manifold, pressure based and temperature compensated" UWORD m_q0p1 1 100 0.00 6553.500 FORMAT "%8.3" ECU_ADDRESS 0x70003190 /end MEASUREMENT
/begin MEASUREMENT msnagrx_w "standardised EGR mass flow with max. tolerance" UWORD m_q0p1 1 100 0.00 6553.500 FORMAT "%8.3" ECU_ADDRESS 0x600011BA /end MEASUREMENT
/begin MEASUREMENT msnagr_w_msg "standardised EGR mass flow" UWORD m_q0p1 1 100 0.00 6553.500 FORMAT "%8.3" ECU_ADDRESS 0x600015CA /end MEASUREMENT
/begin MEASUREMENT mszsrptk_w "mass flow over throttle valve into manifold, temperature compensated" UWORD m_q0p1 1 100 0.00 6553.500 FORMAT "%8.3" ECU_ADDRESS 0x5000078C /end MEASUREMENT
/begin MEASUREMENT nwecvt "engine speed fuel restart at CVT" SWORD nmot_q0p5 1 100 0.00 16383.50 FORMAT "%8.2" ECU_ADDRESS 0x6000809E /end MEASUREMENT
/begin MEASUREMENT nwema "engine speed fuel restart" SWORD nmot_q0p5 1 100 0.00 16383.50 FORMAT "%8.2" ECU_ADDRESS 0x6000809C /end MEASUREMENT
/begin MEASUREMENT nwemas "engine speed fuel restart - converter in slip mode" SWORD nmot_q0p5 1 100 0.00 16383.50 FORMAT "%8.2" ECU_ADDRESS 0x6000809A /end MEASUREMENT
/begin MEASUREMENT oagrugd_w "Offset egr mass flow unthrottled" UWORD m_q0p1 1 100 0.00 6553.500 FORMAT "%8.3" ECU_ADDRESS 0x600011B8 /end MEASUREMENT
/begin MEASUREMENT ofpbriiunlim_w "Unlimited offset correction of pbrintuk_w HFMDSS adaptation (internal value)" SWORD p_q0p039 1 100 -1280.000 1279.961 FORMAT "%8.3" ECU_ADDRESS 0x600397A4 /end MEASUREMENT
/begin MEASUREMENT ofpbrii_w "Offset correction of pbrintuk_w HFM/DSS adaptation (internal value)" SWORD p_q0p039 1 100 -1280.000 1279.961 FORMAT "%8.3" ECU_ADDRESS 0x60001638 /end MEASUREMENT
/begin MEASUREMENT ofpbrint_w_msg "Offset correction of pbrintuk_w HFMDSS adaptation" SWORD p_q0p039 1 100 -1280.000 1279.961 FORMAT "%8.3" ECU_ADDRESS 0x60000D06 /end MEASUREMENT
/begin MEASUREMENT ofvpagr_w_msg "offset correction extern egr valve position" SWORD rel_sw_b50 1 100 -50.00000 49.99847 FORMAT "%8.5" ECU_ADDRESS 0x600398A8 /end MEASUREMENT
/begin MEASUREMENT priobbas_msg "Priority of requested operating conditions for air system" UBYTE dez 1 100 0.00 255.0 FORMAT "%5.1" ECU_ADDRESS 0x60001513 /end MEASUREMENT
/begin MEASUREMENT pvagrvbg_w "Calculated variable: pressure upstream of EGR valve" UWORD p_uw_q0p039 1 100 0.00 2559.961 FORMAT "%8.3" ECU_ADDRESS 0x600011AA /end MEASUREMENT
/begin MEASUREMENT pvagrvds_w "pressure upstream of egr valve (based on manifold pressure sensor)" UWORD p_uw_q0p039 1 100 0.00 2559.961 FORMAT "%8.3" ECU_ADDRESS 0x600011A8 /end MEASUREMENT
/begin MEASUREMENT redistar_msg "redist array for the delay of miist_w" UBYTE dez 1 100 0.00 255.0 FORMAT "%5.1" ARRAY_SIZE 4 ECU_ADDRESS 0x70003652 /end MEASUREMENT
/begin MEASUREMENT redistb1_msg "Real cut off step bank 1" UBYTE dez 1 100 0.00 126.0 FORMAT "%5.1" ECU_ADDRESS 0x6000FB29 /end MEASUREMENT
/begin MEASUREMENT redist_msg "real cylinder cut-off step" UBYTE dez 1 100 0.00 255.0 FORMAT "%5.1" ECU_ADDRESS 0x6000FB2A /end MEASUREMENT
/begin MEASUREMENT rfoiehom_w "Relative charge without the inert-restgas from external EGR in HOM" UWORD rel_q0p02344 1 100 0.00 1535.977 FORMAT "%8.3" ECU_ADDRESS 0x6000119C /end MEASUREMENT
/begin MEASUREMENT rfrexroh_w_msg "egr charge ratio into manifold" UWORD rel_q0p02344 1 100 0.00 1535.977 FORMAT "%8.3" ECU_ADDRESS 0x60000D26 /end MEASUREMENT
/begin MEASUREMENT rirehoms_w_msg "desired relative inertgas charge from ext. EGR in hom. mode" UWORD rel_q0p02344 1 100 0.00 1535.977 FORMAT "%8.3" ECU_ADDRESS 0x60001580 /end MEASUREMENT
/begin MEASUREMENT rirehsg_w_msg "relative desired valid inertgas charge from ext. EGR in hom. mode" UWORD rel_q0p02344 1 100 0.00 1535.977 FORMAT "%8.3" ECU_ADDRESS 0x6000143A /end MEASUREMENT
/begin MEASUREMENT rlmxhdev_w_msg "Air charge reduction because of injection valve error" UWORD rel_uw_q0p0234 1 100 0.00 1535.977 FORMAT "%8.3" ECU_ADDRESS 0x60008D22 /end MEASUREMENT
/begin MEASUREMENT rriehmsh_w "desired inertgas ratio from ext. EGR in homogeneous mode" UWORD rel_uw_b100 1 100 0.00 99.99847 FORMAT "%8.5" ECU_ADDRESS 0x6000119A /end MEASUREMENT
/begin MEASUREMENT rriehmxs_w "max. desired inertgas ratio from ext. EGR in homogeneous mode" UWORD rel_uw_b100 1 100 0.00 99.99847 FORMAT "%8.5" ECU_ADDRESS 0x60001198 /end MEASUREMENT
/begin MEASUREMENT rriehoms_w_msg "desired inertgas ratio from ext. EGR in homogeneous mode" UWORD rel_uw_b100 1 100 0.00 99.99847 FORMAT "%8.5" ECU_ADDRESS 0x60001558 /end MEASUREMENT
/begin MEASUREMENT rriehskk_w_msg "Residual exhaust gas rate inert external desired value corrected out of the map" UWORD rel_uw_b100 1 100 0.00 99.99847 FORMAT "%8.5" ECU_ADDRESS 0x60001554 /end MEASUREMENT
/begin MEASUREMENT rriehsk_w_msg "Residual exhaust gas rate inert external desired value corrected out of the map" UWORD rel_uw_b100 1 100 0.00 99.99847 FORMAT "%8.5" ECU_ADDRESS 0x60001556 /end MEASUREMENT
/begin MEASUREMENT rriehvheksk_w_msg "Residual exhaust gas rate inert external desired value out of the map in VHE low lift mode" UWORD rel_uw_b100 1 100 0.00 99.99847 FORMAT "%8.5" ECU_ADDRESS 0x60001552 /end MEASUREMENT
/begin MEASUREMENT rrievheksh_w_msg "desired inertgas ratio from ext. EGR in VHE low lift mode" UWORD rel_uw_b100 1 100 0.00 99.99847 FORMAT "%8.5" ECU_ADDRESS 0x6000154E /end MEASUREMENT
/begin MEASUREMENT rrievheks_w_msg "desired inertgas ratio from ext. EGR in VHE low lift mode" UWORD rel_uw_b100 1 100 0.00 99.99847 FORMAT "%8.5" ECU_ADDRESS 0x60001550 /end MEASUREMENT
/begin MEASUREMENT rriexofs_w_msg "relative rate burned residual gas extern without egr-release in desired mode" UWORD rel_uw_b100 1 100 0.00 99.99847 FORMAT "%8.5" ECU_ADDRESS 0x6000154C /end MEASUREMENT
/begin MEASUREMENT rriextsa_w "ratio of burned residual gas form extern egr in actual operation mode" UWORD rel_uw_b100 1 100 0.00 99.99847 FORMAT "%8.5" ECU_ADDRESS 0x60001196 /end MEASUREMENT
/begin MEASUREMENT rriextss_w "ratio of burned residual gas form extern egr in desired operation mode" UWORD rel_uw_b100 1 100 0.00 99.99847 FORMAT "%8.5" ECU_ADDRESS 0x60001194 /end MEASUREMENT
/begin MEASUREMENT rriexts_w_msg "ratio of burned residual gas form extern egr" UWORD rel_uw_b100 1 100 0.00 99.99847 FORMAT "%8.5" ECU_ADDRESS 0x60000D2E /end MEASUREMENT
/begin MEASUREMENT sdlutact_w "Threshold desired value standard deviation engine roughness corrected" SWORD lu_MEx 1 100 -232.8306 232.8235 FORMAT "%8.4" ECU_ADDRESS 0x60000610 /end MEASUREMENT
/begin MEASUREMENT sdpmglsr_w_msg "threshold for pressure delta to detect leakage in intake manifold" SWORD p_q0p039 1 100 -1280.000 1279.961 FORMAT "%8.3" ECU_ADDRESS 0x600014B6 /end MEASUREMENT
/begin MEASUREMENT sumb0_l "Sum formation injection factor for Bank 0" ULONG fak_uw_b2 1 100 0.00 131071.999969 FORMAT "%13.6" ECU_ADDRESS 0x60003220 /end MEASUREMENT
/begin MEASUREMENT sumb1_l "Sum formation injection factor for Bank 1" ULONG fak_uw_b2 1 100 0.00 131071.999969 FORMAT "%13.6" ECU_ADDRESS 0x6000321C /end MEASUREMENT
/begin MEASUREMENT tapbrint_w "Time during which the pbrint adaptation is active" UWORD t_q0p2 1 100 0.00 13107.00 FORMAT "%8.2" ECU_ADDRESS 0x600011C4 /end MEASUREMENT
/begin MEASUREMENT TAS_a "Output value of Transversal Acceleration" SWORD AccGrv 1 100 -327.6800 327.6700 FORMAT "%8.4" ECU_ADDRESS 0x60009792 /end MEASUREMENT
/begin MEASUREMENT tbhsw "threshold for blockheater-detection" UBYTE temp_ub_q0p75_o48 1 100 -48.0 143.3 FORMAT "%5.1" ECU_ADDRESS 0x6000F142 /end MEASUREMENT
/begin MEASUREMENT tkattmp "Catalyst temperature" SWORD temp_q0p1_o273 1 100 -3549.940 3003.560 FORMAT "%8.3" ECU_ADDRESS 0x60008098 /end MEASUREMENT
/begin MEASUREMENT TMECmb_IfEtaIaGnrl_I.HSPActv "general combustion dataset next ignition calculation / Combustion dataset: condition GDI-operating mode for actual ignition cylinder is homogeneous-split" UBYTE dez 1 100 0.00 255.0 FORMAT "%5.1" ECU_ADDRESS 0x70003180 /end MEASUREMENT
/begin MEASUREMENT TMECmb_IfEtaIaGnrl_I.f2kazw "general combustion dataset next ignition calculation / combustion data set" UBYTE fak_ub_b1 1 100 0.00 0.9961 ECU_ADDRESS 0x70003181 /end MEASUREMENT
/begin MEASUREMENT TMECmb_IfEtaIaGnrl_I.flb "general combustion dataset next ignition calculation / Combustion dataset: Factor charge-movement" UBYTE fak_ub_b1 1 100 0.00 0.9961 ECU_ADDRESS 0x70003182 /end MEASUREMENT
/begin MEASUREMENT TMECmb_IfEtaIaGnrl_I.lamsbg "general combustion dataset next ignition calculation / lambda input for interface class" UWORD fak_uw_b16 1 100 0.00 15.99976 FORMAT "%8.5" ECU_ADDRESS 0x70003184 /end MEASUREMENT
/begin MEASUREMENT TMECmb_IfEtaIaGnrl_I.nEng "general combustion dataset next ignition calculation / Combustion dataset: Average engine speed of one cylinder segment" UWORD nmot_uw_q0p25 1 100 0.00 16383.75 FORMAT "%8.2" ECU_ADDRESS 0x70003186 /end MEASUREMENT
/begin MEASUREMENT TMECmb_IfEtaIaGnrl_I.rl "general combustion dataset next ignition calculation / Combustion dataset: Relative air charge" UWORD rel_uw_q0p0234 1 100 0.00 1535.977 FORMAT "%8.3" ECU_ADDRESS 0x70003188 /end MEASUREMENT
/begin MEASUREMENT TMECmb_IfEtaIaGnrl_I.rri "general combustion dataset next ignition calculation / inert gas rate input for interface class" UWORD rel_uw_b100 1 100 0.00 99.99847 FORMAT "%8.5" ECU_ADDRESS 0x7000318A /end MEASUREMENT
/begin MEASUREMENT TMECmb_IfEtaIaGnrl_I.split2ka "general combustion dataset next ignition calculation / Combustion dataset: Factor for splitting CNG and Gasoline" UWORD fak_uw_b2 1 100 0.00 1.000000 FORMAT "%8.6" ECU_ADDRESS 0x7000318C /end MEASUREMENT
/begin MEASUREMENT tmmxbh "interim signal for blockheater-detection" UBYTE temp_ub_q0p75_o48 1 100 -48.0 143.3 FORMAT "%5.1" ECU_ADDRESS 0x6000F141 /end MEASUREMENT
/begin MEASUREMENT tmotbstnsd "local copy of engine temperature in %BBSTNSAD (either tmot or CHdT_t)" UBYTE temp_q0p75_om48 1 100 -48.0 143.3 FORMAT "%5.1" ECU_ADDRESS 0x50006022 /end MEASUREMENT
/begin MEASUREMENT tmstbstnsd "temperature of engine after checking CHDT_SY > 0." UBYTE temp_q0p75_om48 1 100 -48.0 143.3 FORMAT "%5.1" ECU_ADDRESS 0x6000F144 /end MEASUREMENT
/begin MEASUREMENT tofmsndkpcg_w "duration of ofmsndkp_w adaptation for calcuation of virtual cylce flaf for IUMPR for LZSR (big leakage)" UWORD t_q0p2 1 100 0.00 13107.00 FORMAT "%8.2" ECU_ADDRESS 0x600011C0 /end MEASUREMENT
/begin MEASUREMENT tofmsndkp_w "duration of ofmsndkp_w adaptation for calcuation of virtual cylce flaf for IUMPR for LZSR" UWORD t_q0p2 1 100 0.00 13107.00 FORMAT "%8.2" ECU_ADDRESS 0x600011BE /end MEASUREMENT
/begin MEASUREMENT tvsaa "delay fuel cut-off" UBYTE t_q0p01 1 100 0.00 2.550 FORMAT "%5.3" ECU_ADDRESS 0x6000F14A /end MEASUREMENT
/begin MEASUREMENT tvsab_w "delay time fuel cut-off requested" UWORD t_q0p01 1 100 0.00 655.3500 FORMAT "%8.4" ECU_ADDRESS 0x60008094 /end MEASUREMENT
/begin MEASUREMENT tvsab_w_msg "Delay time fuel cut-off requested." UWORD t_q0p01 1 100 0.00 655.3500 FORMAT "%8.4" ECU_ADDRESS 0x7000540C /end MEASUREMENT
/begin MEASUREMENT tvsag_w "delay time fuel cutoff depend on gear step" UWORD t_q0p01 1 100 0.00 655.3500 FORMAT "%8.4" ECU_ADDRESS 0x60008096 /end MEASUREMENT
/begin MEASUREMENT tvsakat "delay time for fuel cut-off at high speed and at high catalyst temperature" UBYTE t_q0p04 1 100 0.00 10.20 FORMAT "%5.2" ECU_ADDRESS 0x6000F149 /end MEASUREMENT
/begin MEASUREMENT tvsavg "Delay time for fuel-cutoff during gearshift" UBYTE t_q0p04 1 100 0.00 10.20 FORMAT "%5.2" ECU_ADDRESS 0x6000F148 /end MEASUREMENT
/begin MEASUREMENT umsnsax_w "Conversion of standardized mass flow into mass flow at EGR valve by max. tolerance" UWORD fak_q0p000122 1 100 0.00 7.999878 FORMAT "%8.6" ECU_ADDRESS 0x600011B6 /end MEASUREMENT
/begin MEASUREMENT vpsvagn_w "pressure ratio man. pressure and pressure upstream egr with min. tolerance" UWORD fak_q3p0518Em5 1 100 0.00 1.999969 FORMAT "%8.6" ECU_ADDRESS 0x600011B4 /end MEASUREMENT
/begin MEASUREMENT vpvagnag_w "ratio: pressure downstream and pressure upstream egr" UWORD fak_q0p000122 1 100 0.00 7.999878 FORMAT "%8.6" ECU_ADDRESS 0x600011A6 /end MEASUREMENT
/begin MEASUREMENT wblagrs_w_msg "resistance of egr mass flow line calculated by fast adaptation" UWORD fak_q0p000488 1 100 0.00 31.99951 FORMAT "%8.5" ECU_ADDRESS 0x60039866 /end MEASUREMENT
/begin MEASUREMENT zylzg "corresponds to the product of Real number of cylinders and Number of ECUs in a multiple ECU system" UBYTE dez 1 100 0.00 255.0 FORMAT "%5.1" ECU_ADDRESS 0x70003194 /end MEASUREMENT
/begin MEASUREMENT zzbank0 "cylinder allocation to exhaust bank 0" UBYTE dez 1 100 0.00 255.0 FORMAT "%5.1" ECU_ADDRESS 0x6000F137 /end MEASUREMENT
/begin MEASUREMENT zzbank1 "cylinder allocation to exhaust bank 1" UBYTE dez 1 100 0.00 255.0 FORMAT "%5.1" ECU_ADDRESS 0x6000F136 /end MEASUREMENT
/begin FUNCTION BBSAFG "1.48.0_2.1.0Operation condition fuel cut-off release"
 /begin DEF_CHARACTERISTIC CES_CVTNRstrt_GCUR CES_Gear_AXIS CES_nEngGrdt_AXIS CES_nRstrtConvSlip_GMAP CES_nRstrt_GMAP CES_rGrip_C CES_tEng_AXIS CES_V_AXIS CoEng_flgFcoRelsCatHeatg_C CoEng_flgSwtInhbnFcoFuSysErr_C CoEng_flgUseCatWrmReq_C CoEng_idxGearDetnSelnFco_C CoEng_mfFcoThdMaxEvap_C CoEng_nDeltaNVEngTemp_M CoEng_nDeltaNVGear_M CoEng_nDeltaRstrtClimaV_T CoEng_nDeltaRstrtClima_GMAP CoEng_nDeltaRstrtEngSpdGrdAtLockExtdMod_M CoEng_nDeltaRstrtEngSpdGrdAt_M CoEng_nDeltaRstrtNGrdt_M CoEng_nRstrtAirCdng_C CoEng_nSpLoOffs_T CoEng_nThdRstrtABSFailr_C CoEng_stFcoGearCatHeatg_T CoEng_stTqDmdFcoInhbnMask_C CoEng_tEngMinFco_C CoEng_tFcoThdExhGas_C CoEng_tiFcoEthnl_T CoEng_tiRstrtAirCdng_C CoEng_vThdVehStop_C CWNWEGTR CWSAWE DNSAH DNSAHS DNSAL DNSALH DNSALHS DNSALS DNSATIP DNSLL DNSLLK DNSLLS KFTVSA KFTVSAGNG KFTVSAKAT KFTVSAVG KFTVSAVGV0 NGDNSA NGDNSAL NGDNSALS NGDNSAS NMOTTHASYN NWEGS SAVGANGIKL SNM08SAUB STK04SAUB TVBGSCH TVSABFA TVSABTE TVSAGSCH TVSAKUPPL TVSATM VWE /end DEF_CHARACTERISTIC
 /begin IN_MEASUREMENT ACCtl_stOut Alt_flgLockUpCluExtnReq B_abor_msg B_cvt_msg B_fa_msg B_fs_msg B_gsch_msg B_invlvbcd_msg B_khakt_msg B_khakw_msg B_kh_msg B_koe_msg B_kuppl_msg B_ll_msg B_sabbts_msg B_tatmsa_msg B_te_msg B_tippg_msg CEngDsT_t CoEng_bFrstStrtEnd Com_stABSWrn EGSys_bFCORdnCoPr EngStrt_bStrtEnd Epm_dnEngFlt Epm_nEng Epm_nEng10ms ExhMod_tCat2B1 ExhMod_tExhMnfB1 FfPrm_facEth Gbx_bOvrRstrtActv Gbx_numGearTrgt GlbDa_stTrqDem HLSDem_nSetPLo I14229_stABSFailCnclActv LLim_bFcoDes_msg mskausg_w_msg PthSet_bOvrRun PthSet_stOvrRunEna PT_bCtOffPhd PT_bNoGrip Pt_flgFcoInhb PT_rGrip PT_stTraType SpdGov_nSetPLo SyC_stSub SysDiag_flgCModJdg Tra_numGear VehMot_stCtOffPhd VehV_v /end IN_MEASUREMENT
 /begin OUT_MEASUREMENT B_saen_msg CoEng_bCtOffConDel CoEng_flgCpvClsForFco CoEng_flgFcoRdnBasc CoEng_flgFcoTrsm CoEng_flgRelsFco CoEng_nFco CoEng_nRstrt CoPOM_bCtOffDem tvsab_w tvsab_w_msg /end OUT_MEASUREMENT
 /begin LOC_MEASUREMENT B_dnsll B_koe_loc B_nwemg B_sabvorLoc CoEng_FcoRelsDlyTONV_I.outbit CoEng_FcoRelsDlyTONV_I.time CoEng_flgEvapOil CoEng_flgFcoRdnEF_I.buffer CoEng_flgFcoRdnEF_I.oldSignal CoEng_flgFcoRelsEng CoEng_flgFcoRelsVeh CoEng_flgNRstrtMinAbsFailr CoEng_flgTiDpdtOverrunHysRst CoEng_nDeltaRstrtClimaTot CoEng_nDeltaRstrtNGrdt CoEng_nRstrtBasc CoEng_nRstrtBascTrsm CoEng_numGearFcoLoc dnsavg dnsavt dnsa_w nwecvt nwema nwemas tkattmp tvsaa tvsag_w tvsakat tvsavg /end LOC_MEASUREMENT
 FUNCTION_VERSION "1.48.0_2.1.0" /end FUNCTION
/begin FUNCTION BBSTHDR "14.13.0_1.2.0Operating conditions start with high fuel pressure"
 /begin DEF_CHARACTERISTIC CWHDST EngStrt_cntrInjRelsHiPStrtEOL_T EngStrt_cntrInjRelsHiPStrt_T EngStrt_cntrRstHiPStrtEOL_T EngStrt_cntrRstHiPStrt_T EngStrt_pEthRailHiPStrtRels_M EngStrt_pRailHiPStrtAbort_C EngStrt_tiRstHiPStrtEOL_T EngStrt_tiRstHiPStrt_T EngStrt_tStrtLoPActvPmp_C /end DEF_CHARACTERISTIC
 /begin IN_MEASUREMENT CoEng_stMai EngStrt_flgHiPStrtRels EngStrt_stStrtReq EngStrt_tStrtCoor Epm_stSpd FfPrm_facEthCurr FuPHi_pRail /end IN_MEASUREMENT
 /begin OUT_MEASUREMENT B_entist_msg B_sthdp_msg B_sthdrpre_msg B_sthdr_msg EngStrt_cntrRstHipStrtIf EngStrt_cntrRstHiPStrtIni EngStrt_flgFuPExcdd EngStrt_flgFuPRels EngStrt_flgHiPStrt EngStrt_flgInjRels EngStrt_flgRstHiPStrt EngStrt_flgStrtActvPmp EngStrt_tiRstHiPStrtIf EngStrt_tiRstHiPStrtIni /end OUT_MEASUREMENT
 /begin LOC_MEASUREMENT EngStrt_cntrInjRelsHiPStrt EngStrt_cntrRstHiPStrt EngStrt_cntrRstHiPStrtLocIni EngStrt_flgCntrRstHiPStrt EngStrt_flgHiPStrtReq EngStrt_flgIninCntrHiPStrt EngStrt_flgInjRelsHiPStrt EngStrt_flgPreInjLoPLoc EngStrt_pRailHiPStrtRels EngStrt_tiRstHiPStrtLoc EngStrt_tiRstHiPStrtLocIni /end LOC_MEASUREMENT
 FUNCTION_VERSION "14.13.0_1.2.0" /end FUNCTION
/begin FUNCTION BBSTNSAD "5.20.0    Operation condition start-/ afterstart adaptation"
 /begin DEF_CHARACTERISTIC AHENSADMX ANZTIMNSAD CLUTWMENMN CWBBSTNSAD CWBBSTNSAD2 CWBBSTNSAD3 DSDLUTSR EngStrt_cntrAftStrtDly_C EngStrt_swtAftStopInhb_C EngStrt_tAftStrtSwtOff_C EngStrt_tiFallDebStOfClu_C EngStrt_tiRiseDebStOfClu_C ENSAD ESDLUTS FSDLUSOL KFTNSEADMX KSTANSAD MNCLUTWM MXCLUTWM NMXNSAD TMNSADMN TMNSADMX TMOTMNSAD TVNSKUPPEF TVNSKUPPER TVTOFLUT /end DEF_CHARACTERISTIC
 /begin IN_MEASUREMENT anztib_w_msg B_edkvs_msg B_gsch_msg B_ll_msg B_lr_msg B_vheg_msg B_wkr_msg CEngDsT_t CEngDsT_tStrt Clth_st EngStrt_bStrtEnd Epm_nEngLRes Epm_numCyl Epm_stOpMode Epm_stSpd MisfDet_flgRoughRoad MisfDet_maskRelsStc MisfDet_stcEmiMisfCntrSum MisfDet_stDet MisfDet_stSegTiAdpnRdy MisfDet_stSegTiVld MisfDet_stTqZero sdlutsol_w_msg sdluts_w_msg SyC_ctDrvEnter tnse_w_msg /end IN_MEASUREMENT
 /begin OUT_MEASUREMENT B_nsadend_msg B_nsadh_msg B_nsad_msg B_sdlutsr_msg B_sdluts_msg B_staclr_msg B_staneut_msg B_stanodec_msg B_stanoinc_msg B_stanosav_msg censad_msg clutwmen_w_msg clutwm_w_msg /end OUT_MEASUREMENT
 /begin LOC_MEASUREMENT B_dmdadap B_engroads B_engroold B_ensad B_esdluts B_inhengro B_inhronu B_nsadstp B_sccnsad B_sccnsad2 cesdluts cesdlutsr EngStrt_cntrAftStrtDly EngStrt_ctDrvEntrBBSTNSAD100ms EngStrt_ctDrvEntrBBSTNSAD20ms EngStrt_ctDrvEntrBBSTNSADSyncS0 EngStrt_flgAftStopInhb EngStrt_flgAftStopInhbHld fvapskstaa sdlutact_w tmotbstnsd tmstbstnsd zylzg /end LOC_MEASUREMENT
 FUNCTION_VERSION "5.20.0" /end FUNCTION
/begin FUNCTION BdInt_SetData "2.0.0     Body interior Set Data"
 /begin DEF_CHARACTERISTIC BdInt_stPCU_C BdInt_swtEngStopEna_C BdInt_swtEngStrtEna_C BdInt_swtRstrtNoPtdEna_C BdInt_swtStrtEnaClthSel_C BdInt_tiAutoRstrtReqGr1_C BdInt_tiAutoRstrtReqGr2_C BdInt_tiClthOnDspReqDly_C BdInt_tiEngHoodOpen_C BdInt_tiRstrtNoPtdCdn_C BdInt_tiSeatBltOff_C /end DEF_CHARACTERISTIC
 /begin IN_MEASUREMENT Clth3_st Clth4_st CoEng_st ComDCDC_stDiagCirc1 ComDCDC_stDiagCirc2 ComDCDC_stRxErr Com_stEngHoodOpn Com_stSeatBltInfo CoVOM_stAutoRstrtReq CoVOM_stAutoRstrtReqGr1 CoVOM_stAutoRstrtReqGr2 I14229_stABSFailCnclActv I14229_stIdlStopCdn PT_bAutoStrtRls StrtCtl_stClthForStrtReqJdg SyC_ctPostDrvLeave SysDiag_flgCModJdg T15_st T50_st /end IN_MEASUREMENT
 /begin OUT_MEASUREMENT BdInt_bClthOnDspReqPreCond BdInt_bEngStopEna BdInt_bEngStrtEna BdInt_bRstrtNoPtd BdInt_stDCDCCdn BdInt_stEngStrtCdn BdInt_stHoodOpenDurgEngStrt BdInt_stInhbReas BdInt_stPCU /end OUT_MEASUREMENT
 /begin LOC_MEASUREMENT BdInt_cntrIniDrv BdInt_stEngHoodOpen_MP BdInt_stEngStrtEna_mp BdInt_stFrEngStrtCdn_mp BdInt_stRstrtNoPtdCdn_mp /end LOC_MEASUREMENT
 FUNCTION_VERSION "2.0.0" /end FUNCTION
/begin FUNCTION BdyECU_BCM1 "8.3.0_6SAAReception process for the CAN frame BCM1" /begin DEF_CHARACTERISTIC Com_dBCM1MaxDiff_C Com_dBCM1MaxPer_C /end DEF_CHARACTERISTIC
 /begin IN_MEASUREMENT Com_ctCRingBCM1 Com_numCsumBCM1 Com_stBCANReprogm Com_stFrmRxEna Com_stMon Com_stRemEngStrtr /end IN_MEASUREMENT
 /begin LOC_MEASUREMENT BdyECU_ctBCM1RngCnt_MP /end LOC_MEASUREMENT
 FUNCTION_VERSION "8.3.0_6SAA" /end FUNCTION
/begin FUNCTION BdyECU_SRS "5.2.0_6SAACAN messages of the Body ECU (SRS)"
 /begin DEF_CHARACTERISTIC Com_ctCRingSRS_C Com_dSRSMaxDiff_C Com_dSRSMaxPer_C Com_numCsumSRS_C Com_stSeatBltInfo_C /end DEF_CHARACTERISTIC
 /begin IN_MEASUREMENT Com_ctCRingSRS Com_numCsumSRS Com_stFrmRxEna Com_stMon Com_stSeatBltInfo /end IN_MEASUREMENT
 /begin LOC_MEASUREMENT BdyECU_ctRngSRS_MP /end LOC_MEASUREMENT
 FUNCTION_VERSION "5.2.0_6SAA" /end FUNCTION
/begin FUNCTION BdyECU_SRSA "4.7.0     CAN messages of the Body ECU (SRSA)"
 /begin DEF_CHARACTERISTIC Com_aLatGA_C Com_aLgtG_C Com_ctCRingSRSA_C Com_dSRSAMaxDiff_C Com_dSRSAMaxPer_C Com_dSRSASigSel_C Com_numCsumSRSA_C Com_nYaw1UpprData_C Com_stAbnormCpu_C Com_stAbnormVcc_C Com_stCalCmplLatG_C Com_stCalCmplLgtG_C Com_stFailrLatG_C Com_stFailrLgtG_C Com_stPrmntErrYaw1_C Com_stStrtupProc_C Com_stTempAbnormLatG_C Com_stTempAbnormLgtG_C Com_stTmpErrYaw1_C /end DEF_CHARACTERISTIC
 /begin IN_MEASUREMENT Com_aLatGA Com_aLgtG Com_ctCRingSRSA Com_numCsumSRSA Com_nYaw1UpprData Com_stAbnormCpu Com_stAbnormVcc Com_stCalCmplLatG Com_stCalCmplLgtG Com_stCANANoBusOff Com_stFailrLatG Com_stFailrLgtG Com_stFrmRxEna Com_stMon Com_stPrmntErrYaw1 Com_stStrtupProc Com_stTempAbnormLatG Com_stTempAbnormLgtG Com_stTmpErrYaw1 T15_st /end IN_MEASUREMENT
 /begin OUT_MEASUREMENT Com_stRxSRSA Com_stRxSRSAChkSumOk Com_stRxSRSADeb Com_stRxSRSAOk Com_stRxSRSARingCntOk LAS_a LGT_a TAS_a /end OUT_MEASUREMENT
 /begin LOC_MEASUREMENT BdyECU_ctRngSRSA_MP /end LOC_MEASUREMENT
 FUNCTION_VERSION "4.7.0" /end FUNCTION
/begin FUNCTION BdyECU_SRSB "6.2.0_6SAACAN messages of the Body ECU (SRSB)"
 /begin DEF_CHARACTERISTIC Com_ctCRingSRSB_C Com_ctSRSReWrThres_C Com_dSRSBMaxDiff_C Com_dSRSBMaxPer_C Com_numCsumSRSB_C /end DEF_CHARACTERISTIC
 /begin IN_MEASUREMENT Com_ctCRingSRSB Com_numCsumSRSB Com_stCllsnDetn Com_stFrmRxEna Com_stMon /end IN_MEASUREMENT
 /begin OUT_MEASUREMENT Com_stSRSActvDlyd /end OUT_MEASUREMENT
 /begin LOC_MEASUREMENT BdyECU_ctRngSRSB_MP /end LOC_MEASUREMENT
 FUNCTION_VERSION "6.2.0_6SAA" /end FUNCTION
/begin FUNCTION BGADAP "25.2.0    Alignment of measuring and modeling intake manifold pressure"
 /begin DEF_CHARACTERISTIC AirMod_facAdpnFastDftVal_C AirMod_facAdpnFastMax_C AirMod_facAdpnFastMin_C AirMod_facAdpnFastWithSlow_T AirMod_facAdpnFastWoSlow_T AirMod_facDiffRlFastDbnd_C AirMod_facPAdpnFastMax_C AirMod_facPAdpnFastMin_C AirMod_flgFastAdpnEna_C AirMod_pDeltaLeakIntkMnfldEgrOffs_M AirMod_pDeltaLeakIntkMnfldEgr_M AirMod_ratAppThdLeakIntkMnfldDiag_C AirMod_tiAdpnRelsFast_C AirMod_tiDebCdnLeakMflowAdpn_C AirMod_tiDlyLeakMnfld_C AirMod_vVehThdLeakIntkMnfldDiag_C CWBGADAP DFKMSDELSR DOFMSNDK DPLMDSFE DPLMDSOE DPLMDSOEK DPLMDSTZF DPLMDSTZO FKFUPSRLMN FKFUPSRLMX KFAPIRGMN KFAPIRGMX KFUPSRLMN KFUPSRLMX KIFKFUPSRL KIFUPSKT KIOFAPIRG KIPBRIKT LZSRPUMN LZSRTMOTMN LZSRTMOTMX MSAGROFFAD NAPLMDSO NAPLMDSU OFAPIRGMN OFAPIRGMX OMSNDKGLSMX OMSNDKLSMX PVAPIRGMN PVAPIRGMX PVFKFUMN PVFKFUMX TAFUPSRLE TAPBRINT TAPBRINTKT TDAPBRINT TDFGADPS TDFGINI TDGLSR TDLZSR TDPSLMDS TDTAPLMDS TOMSZCGLSRI TOMSZLZSRI TSTAPLMDS /end DEF_CHARACTERISTIC
 /begin IN_MEASUREMENT APP_r B_adkose_msg B_agrofkl_msg B_bkvmsisr_msg B_cdehfm_msg B_dteaam_msg B_dtest_msg B_faagr_msg B_fadkoap_msg B_fkpvdkp_msg B_inilabgp_msg B_msdkhfmg_msg B_ofmsndkp_msg B_psrgg_msg B_psrmhg_msg CEngDsT_t Eep_EnvRamInvld EngStrt_bStrtEnd Epm_nEng Epm_nEngLRes Epm_stSpd Epm_stSync fkmsdksp_w_msg msagrsrs_w_msg msagr_w_msg ofmsndap_w_msg ofmsndkp_w_msg PEnv_p psrg_w_msg psrmh_w_msg psrs_w_msg pvd_w_msg rl_w_msg SyC_stSub tnst_w_msg VehV_v /end IN_MEASUREMENT
 /begin OUT_MEASUREMENT B_afupsrle_msg B_afupsrl_msg B_aosupsrl_msg B_apbrinte_msg B_apbrint_msg B_apsfoagr_msg B_apslmdse_msg B_apslmds_msg B_fgdlzsr B_fkbndrycond B_glsr_msg B_pbndrycond B_rapslmds_msg B_rqschfea_msg dpslmdsf_w_msg fkfupsrl_w_msg ofpbrint_w_msg sdpmglsr_w_msg /end OUT_MEASUREMENT
 /begin LOC_MEASUREMENT AirMod_facCorrnPToLdCnvn AirMod_facCorrnPToLdCnvnIntegOutp AirMod_facCorrnPToLdCnvnMax AirMod_facCorrnPToLdCnvnMin AirMod_flgAdpnFast AirMod_nEngSpdLoc AirMod_pDifMnfldFastAdapn AirMod_pDifMnfldMdlToMeasd AirMon_flgBigLeakIntkMnfldEmiInflReld_mp AirMon_flgLeakIntkMnfldEmiInflReld_mp B_elzsr B_fapslmdsagr B_fapslmdsoagr B_lzsrhfmp B_rapshds B_rapskt B_zlzsr fkupsrliunlim_w fkupsrli_w ofpbriiunlim_w ofpbrii_w tapbrint_w tofmsndkpcg_w tofmsndkp_w /end LOC_MEASUREMENT
 FUNCTION_VERSION "25.2.0" /end FUNCTION
/begin FUNCTION BGAGR "6.1.0     calculation of air charge by exhaust gas recirculation"
 /begin DEF_CHARACTERISTIC AGRVPO AGRVPOFF CWAGRVUGD KFMSNAPVP MSNAGRLE SCHMSNAGRL TOLAGRV TOLPAGR TOLTAGR TVDAGRSS /end DEF_CHARACTERISTIC
 /begin REF_CHARACTERISTIC FKVDVP CWAGR FDVAGR /end REF_CHARACTERISTIC
 /begin IN_MEASUREMENT agrvp_w_msg agrvugdi_w_msg agrvugd_w_msg B_agron_msg B_agrstm_msg B_agrvg_msg B_cdagr_msg B_dagrss_msg Epm_stSpd msagrds_w_msg msagrmxi_w_msg msagrmx_w_msg msagrugdi_w_msg msagrugd_w_msg ofvpagr_w_msg pagreo_w_msg psrmmx_w_msg SyC_stSub tgagrv_msg umsnmsa_w_msg umsrlnk_w_msg vpsvagb_w_msg /end IN_MEASUREMENT
 /begin OUT_MEASUREMENT agrvpbg_w_msg B_agrofkl_msg B_agrvo_msg B_bgagroff_msg B_msagrsrg_msg msagrsr_w_msg msagrtn_w_msg msagrtx_w_msg msagr_w_msg msnagr_w_msg rfrexroh_w_msg /end OUT_MEASUREMENT
 /begin LOC_MEASUREMENT msagrm_w msnagrx_w oagrugd_w umsnsax_w vpsvagn_w /end LOC_MEASUREMENT
 FUNCTION_VERSION "6.1.0" /end FUNCTION
/begin FUNCTION BGAGRA "13.1.0    Calculation egr adaption"
 /begin DEF_CHARACTERISTIC CWBGAGRA DFKBLAGR DFKMSAGRBL DFKMSAGRS DPAMNDAS FKBLAGRUS FKLAF2I FKLAF2IR FKMSAGRSMN FKMSAGRSMX FKMSAGRSN FMSAGRREG KBLAGRKT KBLAGRMN KLFKBLAGR KLKBLAGR KOFAGR KOFAGRKT MSAGRADAMN MSAGRREG OFAGRMN OFAGRMX ZFKMSAGRS ZKWBLAGRS /end DEF_CHARACTERISTIC
 /begin IN_MEASUREMENT B_agron_msg B_agrvsg_msg B_cdagr_msg B_dagrssf_msg B_enkbagr_msg B_enofagr_msg B_faagr_msg B_fgblagrs_msg B_ktagra_msg B_msagdsdb_msg B_zdagrss_msg Eep_EnvRamInvld fktpbagr_w_msg ftmagr_msg msagrds_w_msg msagrsr_w_msg msagr_w_msg msnagr_w_msg paagreo_w_msg pnagrv_w_msg rfdsorim_w_msg SyC_stSub umsrln_w_msg /end IN_MEASUREMENT
 /begin OUT_MEASUREMENT fkblagrs_w_msg fkblagr_w_msg fkmsagrs_w_msg ofvpagr_w_msg wblagrs_w_msg /end OUT_MEASUREMENT
 /begin LOC_MEASUREMENT ChrCtl_flgRstDsmEgrAdpn100ms ChrCtl_flgRstDsmEgrAdpn20ms dpapvagr_w fkblagkl_w fklaf2ir_w fkmsasz_w pvagrvbg_w pvagrvds_w vpvagnag_w /end LOC_MEASUREMENT
 FUNCTION_VERSION "13.1.0" /end FUNCTION
/begin FUNCTION BGAGRDS "4.1.1     Calculation variable: AGR mass flow from pressure measurement" /begin DEF_CHARACTERISTIC CWBGAGRDS KMSAGRDS KMSAGRDSSA MSAGRDSMX /end DEF_CHARACTERISTIC
 /begin IN_MEASUREMENT B_msdkhfmg_msg B_sa_msg dpsrg_w_msg fisrm_w_msg IntkAirT_tIntkMnfld IntkAirT_tThrVlvUs msdkhfm_w_msg msdkosa_w_msg mste_msg rfdsorim_w_msg tagrsr_w_msg tasrm_w_msg umsrln_w_msg /end IN_MEASUREMENT
 /begin OUT_MEASUREMENT B_msagdsdb_msg msagrds_w_msg /end OUT_MEASUREMENT
 /begin LOC_MEASUREMENT msagrdsz_w msdksrtk_w mszsrptk_w /end LOC_MEASUREMENT
 FUNCTION_VERSION "4.1.1" /end FUNCTION
/begin FUNCTION BGAGRSOL "6.1.0     Calculated variable: desired AGR-rate"
 /begin DEF_CHARACTERISTIC CWBGAGRSOL DRRIEXTSMZ DRRIEXTSMZSRR DRRIEXTSMZVHEK FRAGRSAB FRAGRSMN FRAGRSZU HWKRMAAGR KFRRIEHFFVS KFRRIEHOMA KFRRIEHOMS KFRRIEST KFRRIEVHEFFVS KFRRIEVHEKA KFRRIEVHEKS MXWKRMAAGR ORRIESHOM2 ORRIESHOMT ORRIESVHE2 ORRIESVHET RRIESAP RRIESRKMN RRIESRMN RRIEXTSMZ /end DEF_CHARACTERISTIC
 /begin REF_CHARACTERISTIC CWAGR /end REF_CHARACTERISTIC
 /begin IN_MEASUREMENT B_agrfsg_msg B_agrhen_msg B_agron_msg B_cdagr_msg B_cwagrhap_msg B_eagrv_msg B_faagr_msg B_hspagrs_msg B_mdarv_msg B_mwagrs_msg B_ofagreg_msg B_rriesap_msg B_vhegfes_msg B_vheg_msg CEngDsT_t Epm_nEng FfPrm_facEth IKCtl_agKnkAvrgGen_s8 miglsol_w_msg reclagre_w_msg rfoirext_w_msg rfreugds_w_msg rirext_w_msg ririhoms_w_msg rkm_w_msg rlshk_w_msg rlsolhom_w_msg rlsol_w_msg rriext_w_msg SyC_stSub tansk_w_msg /end IN_MEASUREMENT
 /begin OUT_MEASUREMENT B_agrsr_msg drriextsmz_w_msg fktrries_w_msg frrieas_msg rirehoms_w_msg rirehsg_w_msg rriehoms_w_msg rriehskk_w_msg rriehsk_w_msg rriehvheksk_w_msg rrievheksh_w_msg rrievheks_w_msg rriexofs_w_msg rriexts_w_msg /end OUT_MEASUREMENT
 /begin LOC_MEASUREMENT B_agronhom B_krdisagr ChrSet_ratAirChrgDesEgrExtLoLft ChrSet_ratAirChrgDesEgrIntkVlvLft fragrs_w rfoiehom_w rriehmsh_w rriehmxs_w rriextsa_w rriextss_w /end LOC_MEASUREMENT
 FUNCTION_VERSION "6.1.0" /end FUNCTION
/begin FUNCTION BGAGRTS "2.2.0     Calculated EGR-temperature in plastic intake manifold"
 /begin DEF_CHARACTERISTIC AZDISAGRT CWBGAGRTS DTASAGRTS TASAGRTSMX TDDISAGRT TDENAGRT /end DEF_CHARACTERISTIC
 /begin IN_MEASUREMENT IntkAirT_tIntkMnfld SyC_stSub tasrg_w_msg /end IN_MEASUREMENT
 /begin OUT_MEASUREMENT B_disagrts_msg /end OUT_MEASUREMENT
 /begin LOC_MEASUREMENT anzdisagr B_disagrt B_disagrtis B_disagrtisr /end LOC_MEASUREMENT
 FUNCTION_VERSION "2.2.0" /end FUNCTION
/begin FUNCTION BGASMDF "4.1.0     Calculation of air sysem values to torque structure"
 /begin IN_MEASUREMENT B_wdksg_msg B_zwfdka_msg B_zwfrlmin_msg SyC_stSub ThrVlv_flgLimpModeB1 ThrVlv_flgReqFuCutOffB1 /end IN_MEASUREMENT
 /begin OUT_MEASUREMENT B_mdfasfk_msg B_mdfasnl_msg /end OUT_MEASUREMENT
 FUNCTION_VERSION "4.1.0" /end FUNCTION
/begin FUNCTION BGASNOSTOP "2.4.0     Calculation of no engine stop enable from air system" /begin DEF_CHARACTERISTIC PRIOAS /end DEF_CHARACTERISTIC
 /begin IN_MEASUREMENT B_amsndkoe_msg B_dknotb_msg B_nostoagr_msg B_nwflade SyC_stSub /end IN_MEASUREMENT
 /begin OUT_MEASUREMENT AirSys_stPrioWpDmdHyb B_engstdas_msg B_nostopas_msg priobbas_msg /end OUT_MEASUREMENT
 FUNCTION_VERSION "2.4.0" /end FUNCTION
/begin FUNCTION BGAUSBLAN "2.9.0     Calculated values for fuel cutoff requests"
 /begin IN_MEASUREMENT evz_austot_msg InjSys_flgInjEnad InjSys_stInjTmng zzylh_msg zzyls_msg /end IN_MEASUREMENT
 /begin OUT_MEASUREMENT B_evzaush_msg B_evzauss_msg InjSys_stInjDeactv InjSys_stInjDeactvSyns /end OUT_MEASUREMENT
 FUNCTION_VERSION "2.9.0" /end FUNCTION
/begin FUNCTION BGBGHDEVO "2.3.0     calculation limitations for open HPIV" /begin DEF_CHARACTERISTIC NMXHDEV RLMXHDEV /end DEF_CHARACTERISTIC /begin IN_MEASUREMENT B_hdevo_msg B_ll_msg SyC_stSub /end IN_MEASUREMENT /begin OUT_MEASUREMENT InjSys_nMaxHPInjVlvStkOpn rlmxhdev_w_msg /end OUT_MEASUREMENT FUNCTION_VERSION "2.3.0" /end FUNCTION
/begin FUNCTION BGBH "1.9.0     Calculated variable block heater (detection)" /begin DEF_CHARACTERISTIC CWBH DTMSRT TMMXRT TNSRT /end DEF_CHARACTERISTIC /begin IN_MEASUREMENT CEngDsT_flgSnsrVld CEngDsT_tSnsrFild Epm_stSpd SyC_stSub /end IN_MEASUREMENT
 /begin OUT_MEASUREMENT B_enbhtr_msg B_nbhtr_msg B_nibhtr_msg B_tmmn_msg B_tmsrt_msg CEngDsT_flgBlkHeatrActvd /end OUT_MEASUREMENT
 /begin LOC_MEASUREMENT B_clcbh B_pnbhtr tbhsw tmmxbh /end LOC_MEASUREMENT
 FUNCTION_VERSION "1.9.0" /end FUNCTION
/begin FUNCTION BGBKVMSISR "233.0.0   Calculation of mass flow from brake booster to intake manifold"
 /begin DEF_CHARACTERISTIC BrkS_facDifBrkPmpAFMDec_C BrkS_facDifBrkPmpAFM_C BrkS_mfAFMDifLoadChg_C BrkS_mfBrkPmpgAFMHi_C BrkS_mfBrkPmpgAFMLo_C BrkS_mfIntegDbndLowrThd_C BrkS_mfIntegDbndUpprThd_C BrkS_mfIntegIniVal_C BrkS_mfIntegLowrThd_C BrkS_mfIntegUpprThd_T BrkS_mfLimBrkPmpgActvDetn_C BrkS_mfLimBrkPmpgInactvDetn_C BrkS_nEngThd_C BrkS_pIntegDbndLowrThd_C BrkS_pIntegDbndUpprThd_C BrkS_stEnaCdn_C BrkS_stSwtBrkDetdDlyEna_C BrkS_stSwtBrkPmpDetd2Tsk_C BrkS_stSwtBrkPmpg_C BrkS_tiAFMLoadChgDly_C BrkS_tiBrkPmpgAFMEna_C BrkS_tiDlyapbrint_C BrkS_tiDlyAppReleased_C BrkS_tiDlyEngStrtFinshd_C BrkS_tiInteg_C BrkS_vVehVThd_C Brk_tiBrkDetdActvTi_C /end DEF_CHARACTERISTIC
 /begin IN_MEASUREMENT AirMod_mfBrkBooster B_apbrint_msg B_ll_msg EngStrt_bStrtEnd Epm_nEng fupsrl_w_msg LIGov_bInactv msdkhfm_w_msg PEnv_p psrg_w_msg psrmh_w_msg SyC_ctPostDrvLeave SyC_stSub umsrln_w_msg VehV_v /end IN_MEASUREMENT
 /begin OUT_MEASUREMENT BrkS_flgBrkPmpgActv BrkS_flgBrkPmpgDetd BrkS_flgIdle msbkvsr_w_msg /end OUT_MEASUREMENT
 /begin LOC_MEASUREMENT BrkS_cntrReIni BrkS_flgBrkPmpDetd2Tsk BrkS_flgBrkPmpDetdActv BrkS_flgBrkPmpDetdOld BrkS_flgBrkPmpgAFMEna BrkS_flgBrkPmpTOffDly BrkS_mfBrkPmpg BrkS_mfBrkPmpgCnvn BrkS_mfBrkPmpgFild BrkS_mfDifmsdkhfm BrkS_mfIntegUpprThd BrkS_mfPrevmsdkhfm BrkS_pDifBrkPmpg BrkS_tiAFMLoadChgTOffTmr /end LOC_MEASUREMENT
 FUNCTION_VERSION "233.0.0" /end FUNCTION
/begin FUNCTION BGBVG "1.11.0    Limits of combustion modes"
 /begin DEF_CHARACTERISTIC CoEng_nrCmbDlyLamSwtVlvLft_C CoEng_ratLamHomMinEth_Crv CoEng_ratLamMaxSwtHiLo_C CoEng_ratLamMaxSwtLoHi_C LADMXHOM /end DEF_CHARACTERISTIC
 /begin IN_MEASUREMENT alchpct_msg B_vhegs_msg B_vheg_msg /end IN_MEASUREMENT
 /begin OUT_MEASUREMENT lamax_w_msg lamin_w_msg /end OUT_MEASUREMENT
 /begin LOC_MEASUREMENT CoEng_cntrDlyLamSwtVlvLft CoEng_flgLamSwtLoHi CoEng_ratLamHomMinLoc /end LOC_MEASUREMENT
 FUNCTION_VERSION "1.11.0" /end FUNCTION
/begin FUNCTION BGEDKVS "7.3.1     Determination of error DKVS (adapter)" /begin DEF_CHARACTERISTIC SF_DKVS /end DEF_CHARACTERISTIC /begin IN_MEASUREMENT SyC_stSub /end IN_MEASUREMENT FUNCTION_VERSION "7.3.1" /end FUNCTION
/begin FUNCTION BGETADZW "4.7.0     computation methods for spark efficiency"
 /begin DEF_CHARACTERISTIC DZWETAI DZWETAI2 DZWETAI2H DZWETAIH ETADZWI ETADZWI2 ETADZWI2H ETADZWIH KFIFDZW KFIFDZWH TMECmb_facDiaInert_T TMECmb_facDiaLamNEngChrgAir_M TMECmb_facDiaLam_T /end DEF_CHARACTERISTIC
 /begin IN_MEASUREMENT AirMod_ratChrgAirCylAdv_a AirMod_ratInertCylAdv_a Epm_nEng f2kazw_msg fethmnmx_w_msg Gen_ctCylAdv Ign_flgHspNxtCmb lamsbg_w_msg /end IN_MEASUREMENT
 /begin OUT_MEASUREMENT TMECmb_IfEtaIaGnrl_I.HSPActv TMECmb_IfEtaIaGnrl_I.f2kazw TMECmb_IfEtaIaGnrl_I.flb TMECmb_IfEtaIaGnrl_I.lamsbg TMECmb_IfEtaIaGnrl_I.nEng TMECmb_IfEtaIaGnrl_I.rl TMECmb_IfEtaIaGnrl_I.rri TMECmb_IfEtaIaGnrl_I.split2ka /end OUT_MEASUREMENT
 FUNCTION_VERSION "4.7.0" /end FUNCTION
/begin FUNCTION BGEVAB "7.7.0     Calculation of the actual reduction stage by ignition-valve cut-off"
 /begin IN_MEASUREMENT anztib_msg B_sthdrpre_msg evz_austot_msg InjSys_flgInjEnad stateaevab_msg zzbank_msg zzylh_msg /end IN_MEASUREMENT
 /begin OUT_MEASUREMENT B_bevab_msg B_evakt_msg B_evloc_msg InjSys_bInjVlvActv InjSys_flgFcoBnk InjSys_flgFuEngOperActv InjSys_stActRedStg InjSys_stInjDeactv_a redistar_msg redistb1_msg redist_msg /end OUT_MEASUREMENT
 /begin LOC_MEASUREMENT evz_ausold /end LOC_MEASUREMENT
 FUNCTION_VERSION "7.7.0" /end FUNCTION
/begin FUNCTION BGFKEZ "5.4.1     Calculated variable: cylinder-specific factors for fuel correction"
 /begin DEF_CHARACTERISTIC CWBGFKEZ Injsys_facCylIndCorrn0_M Injsys_facCylIndCorrn1_M Injsys_facCylIndCorrn2_M Injsys_facCylIndCorrn3_M KFFZN0 KFFZN1 KFFZN2 KFFZN3 KFFZTM0 KFFZTM1 KFFZTM2 KFFZTM3 SNM16CIUB SRL08CIUW TNSFKEZ /end DEF_CHARACTERISTIC
 /begin IN_MEASUREMENT B_vhegfe_msg CEngDsT_t Epm_nEngLRes rl_w_msg tnst_w_msg zzbank_msg /end IN_MEASUREMENT
 /begin OUT_MEASUREMENT fkaez_a0 fkaez_a1 fkaez_a2 fkaez_a3 fkaez_w_msg /end OUT_MEASUREMENT
 /begin LOC_MEASUREMENT fkaezloc_w InjSys_nEngSpdLoc InjSys_tEngTLoc sumb0_l sumb1_l zzbank0 zzbank1 /end LOC_MEASUREMENT
 FUNCTION_VERSION "5.4.1" /end FUNCTION
/begin COMPU_METHOD Acc "" RAT_FUNC "%6.5" "m/s^2" COEFFS 0 1000 0 0 0 1 /end COMPU_METHOD
/begin COMPU_METHOD AccGrv "" RAT_FUNC "%6.4" "g" COEFFS 0 100 0 0 0 1 /end COMPU_METHOD
/begin COMPU_METHOD B_TRUE "" TAB_VERB "%6.3" "" COMPU_TAB_REF B_TRUE /end COMPU_METHOD
/begin COMPU_VTAB B_TRUE "" TAB_VERB 2 0 "FALSE" 1 "TRUE" /end COMPU_VTAB
/begin COMPU_METHOD CENGDST_CFG_SC_Compu "" TAB_VERB "%6.3" "" COMPU_TAB_REF CENGDST_CFG_SC_Compu /end COMPU_METHOD
/begin COMPU_VTAB CENGDST_CFG_SC_Compu "" TAB_VERB 4 0 "no CEngDsT-sensor" 1 "CEngDsT_ADC" 2 "CEngDsT_CAN" 3 "CEngDsT_Sent" /end COMPU_VTAB
/begin COMPU_METHOD CENGDST_CMBTYP_SC_Compu "" TAB_VERB "%6.3" "" COMPU_TAB_REF CENGDST_CMBTYP_SC_Compu /end COMPU_METHOD
/begin COMPU_VTAB CENGDST_CMBTYP_SC_Compu "" TAB_VERB 3 0 "GS" 1 "DS" 2 "DGS" /end COMPU_VTAB
/begin COMPU_METHOD CENGDST_COLDCHKCFG_SC_Compu "" TAB_VERB "%6.3" "" COMPU_TAB_REF CENGDST_COLDCHKCFG_SC_Compu /end COMPU_METHOD
/begin COMPU_VTAB CENGDST_COLDCHKCFG_SC_Compu "" TAB_VERB 2 0 "Deactivated" 1 "Cnfg1" /end COMPU_VTAB
/begin COMPU_METHOD CENGDST_EXTHEATGWTRPMP_SC_Compu "" TAB_VERB "%6.3" "" COMPU_TAB_REF CENGDST_EXTHEATGWTRPMP_SC_Compu /end COMPU_METHOD
/begin COMPU_VTAB CENGDST_EXTHEATGWTRPMP_SC_Compu "" TAB_VERB 2 0 "CENGDST_HEATGWTRPMPCORRN_NOTAVL" 1 "CENGDST_HEATGWTRPMPCORRN_AVL" /end COMPU_VTAB
/begin COMPU_METHOD CENGDST_LOOSECONNCHK_SC_Compu "" TAB_VERB "%6.3" "" COMPU_TAB_REF CENGDST_LOOSECONNCHK_SC_Compu /end COMPU_METHOD
/begin COMPU_VTAB CENGDST_LOOSECONNCHK_SC_Compu "" TAB_VERB 2 0 "False" 1 "True" /end COMPU_VTAB
/begin COMPU_METHOD CENGDST_PHYSRNGCHK_SY_Compu "" TAB_VERB "%6.3" "" COMPU_TAB_REF CENGDST_PHYSRNGCHK_SY_Compu /end COMPU_METHOD
/begin COMPU_VTAB CENGDST_PHYSRNGCHK_SY_Compu "" TAB_VERB 2 0 "False" 1 "True" /end COMPU_VTAB
/begin COMPU_METHOD CENGDST_PLAUSDIAGLSCHK_SC_Compu "" TAB_VERB "%6.3" "" COMPU_TAB_REF CENGDST_PLAUSDIAGLSCHK_SC_Compu /end COMPU_METHOD
/begin COMPU_VTAB CENGDST_PLAUSDIAGLSCHK_SC_Compu "" TAB_VERB 2 0 "Disable" 1 "Enable" /end COMPU_VTAB
/begin COMPU_METHOD CENGDST_PLAUSDIAGSTUCKCHK_SC_Compu "" TAB_VERB "%6.3" "" COMPU_TAB_REF CENGDST_PLAUSDIAGSTUCKCHK_SC_Compu /end COMPU_METHOD
/begin COMPU_VTAB CENGDST_PLAUSDIAGSTUCKCHK_SC_Compu "" TAB_VERB 2 0 "False" 1 "True" /end COMPU_VTAB
/begin COMPU_METHOD CENGDST_REPLMDLEXT_SC_Compu "" TAB_VERB "%6.3" "" COMPU_TAB_REF CENGDST_REPLMDLEXT_SC_Compu /end COMPU_METHOD
/begin COMPU_VTAB CENGDST_REPLMDLEXT_SC_Compu "" TAB_VERB 2 0 "False" 1 "True" /end COMPU_VTAB
/begin COMPU_METHOD CENGDST_SWTHWORCAN_SY_Compu "" TAB_VERB "%6.3" "" COMPU_TAB_REF CENGDST_SWTHWORCAN_SY_Compu /end COMPU_METHOD
/begin COMPU_VTAB CENGDST_SWTHWORCAN_SY_Compu "" TAB_VERB 3 0 "0" 1 "1" 2 "2" /end COMPU_VTAB
/begin COMPU_METHOD CENGDST_TYPAVL_SY_Compu "" TAB_VERB "%6.3" "" COMPU_TAB_REF CENGDST_TYPAVL_SY_Compu /end COMPU_METHOD
/begin COMPU_VTAB CENGDST_TYPAVL_SY_Compu "" TAB_VERB 2 0 "False" 1 "True" /end COMPU_VTAB
/begin COMPU_METHOD CENGUST2_TYPAVL_SC_Compu "" TAB_VERB "%6.3" "" COMPU_TAB_REF CENGUST2_TYPAVL_SC_Compu /end COMPU_METHOD
/begin COMPU_VTAB CENGUST2_TYPAVL_SC_Compu "" TAB_VERB 2 0 "False" 1 "True" /end COMPU_VTAB
/begin COMPU_METHOD CENGUST_CFGHSC_SC_Compu "" TAB_VERB "%6.3" "" COMPU_TAB_REF CENGUST_CFGHSC_SC_Compu /end COMPU_METHOD
/begin COMPU_VTAB CENGUST_CFGHSC_SC_Compu "" TAB_VERB 2 0 "False" 1 "True" /end COMPU_VTAB
/begin COMPU_METHOD CENGUST_CFGLSC_SC_Compu "" TAB_VERB "%6.3" "" COMPU_TAB_REF CENGUST_CFGLSC_SC_Compu /end COMPU_METHOD
/begin COMPU_VTAB CENGUST_CFGLSC_SC_Compu "" TAB_VERB 2 0 "False" 1 "True" /end COMPU_VTAB
/begin COMPU_METHOD CENGUST_CFGSTUCKCHK_SC_Compu "" TAB_VERB "%6.3" "" COMPU_TAB_REF CENGUST_CFGSTUCKCHK_SC_Compu /end COMPU_METHOD
/begin COMPU_VTAB CENGUST_CFGSTUCKCHK_SC_Compu "" TAB_VERB 2 0 "False" 1 "True" /end COMPU_VTAB
/begin COMPU_METHOD CENGUST_COLDSTRTDIAG_SC_Compu "" TAB_VERB "%6.3" "" COMPU_TAB_REF CENGUST_COLDSTRTDIAG_SC_Compu /end COMPU_METHOD
/begin COMPU_VTAB CENGUST_COLDSTRTDIAG_SC_Compu "" TAB_VERB 2 0 "False" 1 "True" /end COMPU_VTAB
/begin COMPU_METHOD CENGUST_GRDTCHKCFG_SC_Compu "" TAB_VERB "%6.3" "" COMPU_TAB_REF CENGUST_GRDTCHKCFG_SC_Compu /end COMPU_METHOD
/begin COMPU_VTAB CENGUST_GRDTCHKCFG_SC_Compu "" TAB_VERB 2 0 "GradientChk_Disabled" 1 "GradientChk_Enabled" /end COMPU_VTAB
/begin COMPU_METHOD CENGUST_LOOSECNCTNCHK_SC_Compu "" TAB_VERB "%6.3" "" COMPU_TAB_REF CENGUST_LOOSECNCTNCHK_SC_Compu /end COMPU_METHOD
/begin COMPU_VTAB CENGUST_LOOSECNCTNCHK_SC_Compu "" TAB_VERB 2 0 "False" 1 "True" /end COMPU_VTAB
/begin COMPU_METHOD CENGUST_PHYRNGCHK_SC_Compu "" TAB_VERB "%6.3" "" COMPU_TAB_REF CENGUST_PHYRNGCHK_SC_Compu /end COMPU_METHOD
/begin COMPU_VTAB CENGUST_PHYRNGCHK_SC_Compu "" TAB_VERB 2 0 "False" 1 "True" /end COMPU_VTAB
/begin COMPU_METHOD CENGUST_SNSRPRSNT_SC_Compu "" TAB_VERB "%6.3" "" COMPU_TAB_REF CENGUST_SNSRPRSNT_SC_Compu /end COMPU_METHOD
/begin COMPU_VTAB CENGUST_SNSRPRSNT_SC_Compu "" TAB_VERB 2 0 "False" 1 "True" /end COMPU_VTAB
/begin COMPU_METHOD CENGUST_SNSRTYP_SC_Compu "" TAB_VERB "%6.3" "" COMPU_TAB_REF CENGUST_SNSRTYP_SC_Compu /end COMPU_METHOD
/begin COMPU_VTAB CENGUST_SNSRTYP_SC_Compu "" TAB_VERB 4 0 "ADC" 1 "CAN" 2 "ADCCAN" 255 "ApplicationParameter" /end COMPU_VTAB
/begin COMPU_METHOD CENGUST_TYPAVL_SY_Compu "" TAB_VERB "%6.3" "" COMPU_TAB_REF CENGUST_TYPAVL_SY_Compu /end COMPU_METHOD
/begin COMPU_VTAB CENGUST_TYPAVL_SY_Compu "" TAB_VERB 2 0 "False" 1 "True" /end COMPU_VTAB
/begin COMPU_METHOD CFMSNSROFFSMISF_SC_Compu "" TAB_VERB "%6.3" "" COMPU_TAB_REF CFMSNSROFFSMISF_SC_Compu /end COMPU_METHOD
/begin COMPU_VTAB CFMSNSROFFSMISF_SC_Compu "" TAB_VERB 2 0 "False" 1 "True" /end COMPU_VTAB
/begin COMPU_METHOD CHDT_PLAUSCOLD_SY_Compu "" TAB_VERB "%6.3" "" COMPU_TAB_REF CHDT_PLAUSCOLD_SY_Compu /end COMPU_METHOD
/begin COMPU_VTAB CHDT_PLAUSCOLD_SY_Compu "" TAB_VERB 2 0 "No_CHDT_CrossCheck" 1 "CHDT_CrossCheck_Enabled" /end COMPU_VTAB
/begin COMPU_METHOD CHDT_SENS_SY_Compu "" TAB_VERB "%6.3" "" COMPU_TAB_REF CHDT_SENS_SY_Compu /end COMPU_METHOD
/begin COMPU_VTAB CHDT_SENS_SY_Compu "" TAB_VERB 3 0 "CHDTNO" 1 "CHDTMOD" 2 "CHDTADC" /end COMPU_VTAB
/begin COMPU_METHOD CHDT_SY_Compu "" TAB_VERB "%6.3" "" COMPU_TAB_REF CHDT_SY_Compu /end COMPU_METHOD
/begin COMPU_VTAB CHDT_SY_Compu "" TAB_VERB 2 0 "False" 1 "True" /end COMPU_VTAB
/begin COMPU_METHOD CHRCTL_BASCONLY_SC_Compu "" TAB_VERB "%6.3" "" COMPU_TAB_REF CHRCTL_BASCONLY_SC_Compu /end COMPU_METHOD
/begin COMPU_VTAB CHRCTL_BASCONLY_SC_Compu "" TAB_VERB 2 0 "False" 1 "True" /end COMPU_VTAB
/begin COMPU_METHOD CHRCTL_EIAECD_SY_Compu "" TAB_VERB "%6.3" "" COMPU_TAB_REF CHRCTL_EIAECD_SY_Compu /end COMPU_METHOD
/begin COMPU_VTAB CHRCTL_EIAECD_SY_Compu "" TAB_VERB 2 0 "False" 1 "True" /end COMPU_VTAB
/begin COMPU_METHOD CHRCTL_LIMTHRAGAFSPLST_SC_Compu "" TAB_VERB "%6.3" "" COMPU_TAB_REF CHRCTL_LIMTHRAGAFSPLST_SC_Compu /end COMPU_METHOD
/begin COMPU_VTAB CHRCTL_LIMTHRAGAFSPLST_SC_Compu "" TAB_VERB 2 0 "False" 1 "True" /end COMPU_VTAB
/begin COMPU_METHOD CHRCTL_OPNGEGRVLVUNTHRCDN_SC_Compu "" TAB_VERB "%6.3" "" COMPU_TAB_REF CHRCTL_OPNGEGRVLVUNTHRCDN_SC_Compu /end COMPU_METHOD
/begin COMPU_VTAB CHRCTL_OPNGEGRVLVUNTHRCDN_SC_Compu "" TAB_VERB 2 0 "no_unthrottled_EGR" 1 "unthrottled_EGR" /end COMPU_VTAB
/begin COMPU_METHOD CHRCTL_STMONEXTD_SC_Compu "" TAB_VERB "%6.3" "" COMPU_TAB_REF CHRCTL_STMONEXTD_SC_Compu /end COMPU_METHOD
/begin COMPU_VTAB CHRCTL_STMONEXTD_SC_Compu "" TAB_VERB 2 0 "False" 1 "True" /end COMPU_VTAB
/begin COMPU_METHOD CHRCTL_VAR_SY_Compu "" TAB_VERB "%6.3" "" COMPU_TAB_REF CHRCTL_VAR_SY_Compu /end COMPU_METHOD
/begin COMPU_VTAB CHRCTL_VAR_SY_Compu "" TAB_VERB 57 0 "kein Kundenbezug" 1 "DAI" 3 "VWW" 4 "POR" 5 "AUD" 6 "OPE" 9 "FIA" 11 "BMW" 14 "PSA" 15 "REN" 17 "ALF" 18 "SAB" 19 "VOL" 20 "NIS" 21 "GMU" 22 "FOR" 26 "IMJ" 36 "MAN" 51 "SEA" 53 "CHR" 54 "JAG" 55 "ROL" 69 "FER" 72 "TOY" 123 "MIT" 147 "HYU" 159 "HON" 160 "MAZ" 183 "CU" 190 "LRG" 204 "VVW" 214 "AVT" 242 "Iveco" 243 "DMC" 248 "SUZ" 267 "SSANGYONG" 270 "KEF" 289 "AMG" 308 "TAT" 319 "MVM" 327 "OTOSAN" 328 "Mahindra" 385 "UAES" 578 "AL" 590 "Scania" 609 "Deutz" 760 "WEICHAI" 788 "Saic_motors" 828 "RBCD" 898 "MFTBC" 936 "Anhui_Quanchai" 944 "DOOSAN Infracore" 966 "International" 984 "FAW - Wuxi" 999 "ALL" 2887 "NONOX" 9454 "Fuso" /end COMPU_VTAB
/begin COMPU_METHOD CHRGCTRLVLVSWTCAMSFTAG_SC_Compu "" TAB_VERB "%6.3" "" COMPU_TAB_REF CHRGCTRLVLVSWTCAMSFTAG_SC_Compu /end COMPU_METHOD
/begin COMPU_VTAB CHRGCTRLVLVSWTCAMSFTAG_SC_Compu "" TAB_VERB 2 0 "Desired_cam_angle" 1 "Steady_state_cam_angle" /end COMPU_VTAB
/begin COMPU_METHOD CHRGEXCHMDLFSTCALCN_SC_Compu "" TAB_VERB "%6.3" "" COMPU_TAB_REF CHRGEXCHMDLFSTCALCN_SC_Compu /end COMPU_METHOD
/begin COMPU_VTAB CHRGEXCHMDLFSTCALCN_SC_Compu "" TAB_VERB 2 0 "False" 1 "True" /end COMPU_VTAB
/begin COMPU_METHOD CHRGEXCHMDLPROCCALCN_SC_Compu "" TAB_VERB "%6.3" "" COMPU_TAB_REF CHRGEXCHMDLPROCCALCN_SC_Compu /end COMPU_METHOD
/begin COMPU_VTAB CHRGEXCHMDLPROCCALCN_SC_Compu "" TAB_VERB 3 0 "default" 1 "10ms" 2 "synchro" /end COMPU_VTAB
/begin COMPU_METHOD CHRGGOVRBASP_SC_Compu "" TAB_VERB "%6.3" "" COMPU_TAB_REF CHRGGOVRBASP_SC_Compu /end COMPU_METHOD
/begin COMPU_VTAB CHRGGOVRBASP_SC_Compu "" TAB_VERB 2 0 "0" 1 "1" /end COMPU_VTAB
/begin COMPU_METHOD CHRGPRDCUSEAGCAMSFTPRDC_SC_Compu "" TAB_VERB "%6.3" "" COMPU_TAB_REF CHRGPRDCUSEAGCAMSFTPRDC_SC_Compu /end COMPU_METHOD
/begin COMPU_VTAB CHRGPRDCUSEAGCAMSFTPRDC_SC_Compu "" TAB_VERB 2 0 "False" 1 "True" /end COMPU_VTAB
/begin COMPU_METHOD CHRSET_VAR_SY_Compu "" TAB_VERB "%6.3" "" COMPU_TAB_REF CHRSET_VAR_SY_Compu /end COMPU_METHOD
/begin COMPU_VTAB CHRSET_VAR_SY_Compu "" TAB_VERB 57 0 "kein Kundenbezug" 1 "DAI" 3 "VWW" 4 "POR" 5 "AUD" 6 "OPE" 9 "FIA" 11 "BMW" 14 "PSA" 15 "REN" 17 "ALF" 18 "SAB" 19 "VOL" 20 "NIS" 21 "GMU" 22 "FOR" 26 "IMJ" 36 "MAN" 51 "SEA" 53 "CHR" 54 "JAG" 55 "ROL" 69 "FER" 72 "TOY" 123 "MIT" 147 "HYU" 159 "HON" 160 "MAZ" 183 "CU" 190 "LRG" 204 "VVW" 214 "AVT" 242 "Iveco" 243 "DMC" 248 "SUZ" 267 "SSANGYONG" 270 "KEF" 289 "AMG" 308 "TAT" 319 "MVM" 327 "OTOSAN" 328 "MM" 385 "UAES" 590 "Scania" 609 "Deutz" 720 "Greatwall" 745 "JMC Ford" 788 "Saic Motor" 828 "RBCD" 898 "MFTBC" 936 "Anhui_Quanchai" 944 "DOOSAN Infracore" 984 "FAW - Wuxi" 999 "ALL" 2887 "Nonox" 9454 "Fuso" 9707 "Hatz" /end COMPU_VTAB
/begin COMPU_METHOD CIB_AFIMVIRTDFCOPTN_SC_Compu "" TAB_VERB "%6.3" "" COMPU_TAB_REF CIB_AFIMVIRTDFCOPTN_SC_Compu /end COMPU_METHOD
/begin COMPU_VTAB CIB_AFIMVIRTDFCOPTN_SC_Compu "" TAB_VERB 4 0 "NO_INHIBIT" 1 "INHIBIT_BY_DAFIM" 2 "INHIBIT_BY_DAFIMRAW" 3 "INHIBIT_ALL" /end COMPU_VTAB
/begin COMPU_METHOD CILCN_DPIADPN_SC_Compu "" TAB_VERB "%6.3" "" COMPU_TAB_REF CILCN_DPIADPN_SC_Compu /end COMPU_METHOD
/begin COMPU_VTAB CILCN_DPIADPN_SC_Compu "" TAB_VERB 2 0 "Disabled" 1 "Cyl_Lam_Imbal" /end COMPU_VTAB
/begin COMPU_METHOD CILCN_SELNSEGPOSN_SC_Compu "" TAB_VERB "%6.3" "" COMPU_TAB_REF CILCN_SELNSEGPOSN_SC_Compu /end COMPU_METHOD
/begin COMPU_VTAB CILCN_SELNSEGPOSN_SC_Compu "" TAB_VERB 3 1 "CMNSEGPOSN" 2 "SEPSEGPOSN" 3 "SEPSEGPOSNWITHSEGADPN" /end COMPU_VTAB
/begin COMPU_METHOD CIVVL_SY_Compu "" TAB_VERB "%6.3" "" COMPU_TAB_REF CIVVL_SY_Compu /end COMPU_METHOD
/begin COMPU_VTAB CIVVL_SY_Compu "" TAB_VERB 3 0 "NO_CIVVL" 1 "CIVVL_INLET" 2 "CIVVL_OUTLET" /end COMPU_VTAB
/begin COMPU_METHOD CJ135_SC_Compu "" TAB_VERB "%6.3" "" COMPU_TAB_REF CJ135_SC_Compu /end COMPU_METHOD
/begin COMPU_VTAB CJ135_SC_Compu "" TAB_VERB 5 0 "no_CJ135" 1 "one_CJ135" 2 "two_CJ135" 3 "three_CJ135" 4 "four_CJ135" /end COMPU_VTAB
/begin COMPU_METHOD CJ721_SC_Compu "" TAB_VERB "%6.3" "" COMPU_TAB_REF CJ721_SC_Compu /end COMPU_METHOD
/begin COMPU_VTAB CJ721_SC_Compu "" TAB_VERB 2 0 "no_Cj721" 1 "one_Cj721" /end COMPU_VTAB
/begin COMPU_METHOD CJ722_SC_Compu "" TAB_VERB "%6.3" "" COMPU_TAB_REF CJ722_SC_Compu /end COMPU_METHOD
/begin COMPU_VTAB CJ722_SC_Compu "" TAB_VERB 2 0 "no_Cj722" 1 "one_Cj722" /end COMPU_VTAB
/begin COMPU_METHOD CJ930_SY_Compu "" TAB_VERB "%6.3" "" COMPU_TAB_REF CJ930_SY_Compu /end COMPU_METHOD
/begin COMPU_VTAB CJ930_SY_Compu "" TAB_VERB 2 0 "no CJ930" 1 "one CJ930" /end COMPU_VTAB
/begin COMPU_METHOD CJ950_SY_Compu "" TAB_VERB "%6.3" "" COMPU_TAB_REF CJ950_SY_Compu /end COMPU_METHOD
/begin COMPU_VTAB CJ950_SY_Compu "" TAB_VERB 5 0 "NO_CJ950" 1 "1_CJ950" 2 "2_CJ950" 3 "3_CJ950" 4 "4_CJ950" /end COMPU_VTAB
/begin COMPU_METHOD CJ960_SC_Compu "" TAB_VERB "%6.3" "" COMPU_TAB_REF CJ960_SC_Compu /end COMPU_METHOD
/begin COMPU_VTAB CJ960_SC_Compu "" TAB_VERB 11 0 "No CJ960" 1 "1 CJ960" 2 "2 CJ960" 3 "3 CJ960" 4 "4 CJ960" 5 "5 CJ960" 6 "6 CJ960" 7 "7 CJ960" 8 "8 CJ960" 9 "9 CJ960" 10 "10 CJ960" /end COMPU_VTAB
/begin COMPU_METHOD CJ970_SC_Compu "" TAB_VERB "%6.3" "" COMPU_TAB_REF CJ970_SC_Compu /end COMPU_METHOD
/begin COMPU_VTAB CJ970_SC_Compu "" TAB_VERB 6 0 "0" 1 "1" 2 "2" 3 "3" 4 "4" 5 "5" /end COMPU_VTAB
/begin COMPU_METHOD CLTH_ATS_SY_Compu "" TAB_VERB "%6.3" "" COMPU_TAB_REF CLTH_ATS_SY_Compu /end COMPU_METHOD
/begin COMPU_VTAB CLTH_ATS_SY_Compu "" TAB_VERB 2 0 "ATS_Disabled" 1 "ATS_Enabled" /end COMPU_VTAB
/begin COMPU_METHOD CLUINTLCK_SC_Compu "" TAB_VERB "%6.3" "" COMPU_TAB_REF CLUINTLCK_SC_Compu /end COMPU_METHOD
/begin COMPU_VTAB CLUINTLCK_SC_Compu "" TAB_VERB 5 0 "CLUINTLCK_NOINTLCK" 1 "CLUINTLCK_MT" 2 "CLUINTLCK_AT" 3 "CLUINTLCK_ATNOINTLCK" 255 "CLUINTLCK_ALL" /end COMPU_VTAB
/begin COMPU_METHOD CLUSTRTTYP_SC_Compu "" TAB_VERB "%6.3" "" COMPU_TAB_REF CLUSTRTTYP_SC_Compu /end COMPU_METHOD
/begin COMPU_VTAB CLUSTRTTYP_SC_Compu "" TAB_VERB 3 0 "NO_CLU_STRT" 1 "CLU_STRT_SPD" 2 "CLU_STRT_TQ" /end COMPU_VTAB
/begin COMPU_METHOD CMBENGSLFRUN_SY_Compu "" TAB_VERB "%6.3" "" COMPU_TAB_REF CMBENGSLFRUN_SY_Compu /end COMPU_METHOD
/begin COMPU_VTAB CMBENGSLFRUN_SY_Compu "" TAB_VERB 2 0 "False" 1 "True" /end COMPU_VTAB
/begin COMPU_METHOD CmbNoi "" RAT_FUNC "%6.5" "-" COEFFS 0 1024 0 0 0 1 /end COMPU_METHOD
/begin COMPU_METHOD CMBTYP_SC_Compu "" TAB_VERB "%6.3" "" COMPU_TAB_REF CMBTYP_SC_Compu /end COMPU_METHOD
/begin COMPU_VTAB CMBTYP_SC_Compu "" TAB_VERB 2 0 "CMBTYP_DS" 1 "CMBTYP_GS" /end COMPU_VTAB
/begin COMPU_METHOD CMBTYP_SY_Compu "" TAB_VERB "%6.3" "" COMPU_TAB_REF CMBTYP_SY_Compu /end COMPU_METHOD
/begin COMPU_VTAB CMBTYP_SY_Compu "" TAB_VERB 2 0 "CMBTYP_DS" 1 "CMBTYP_GS" /end COMPU_VTAB
/begin COMPU_METHOD CMFTMOD_SC_Compu "" TAB_VERB "%6.3" "" COMPU_TAB_REF CMFTMOD_SC_Compu /end COMPU_METHOD
/begin COMPU_VTAB CMFTMOD_SC_Compu "" TAB_VERB 2 0 "False" 1 "True" /end COMPU_VTAB
/begin COMPU_METHOD CMNPROGTYPE_SC_Compu "" TAB_VERB "%6.3" "" COMPU_TAB_REF CMNPROGTYPE_SC_Compu /end COMPU_METHOD
/begin COMPU_VTAB CMNPROGTYPE_SC_Compu "" TAB_VERB 2 0 "COMPILE" 1 "CALIBRATION" /end COMPU_VTAB
/begin COMPU_METHOD CMPNPROTCOOLGINJ_SC_Compu "" TAB_VERB "%6.3" "" COMPU_TAB_REF CMPNPROTCOOLGINJ_SC_Compu /end COMPU_METHOD
/begin COMPU_VTAB CMPNPROTCOOLGINJ_SC_Compu "" TAB_VERB 2 0 "not active" 1 "active" /end COMPU_VTAB
/begin COMPU_METHOD CMPRAIRBLOW2_SC_Compu "" TAB_VERB "%6.3" "" COMPU_TAB_REF CMPRAIRBLOW2_SC_Compu /end COMPU_METHOD
/begin COMPU_VTAB CMPRAIRBLOW2_SC_Compu "" TAB_VERB 2 0 "False" 1 "True" /end COMPU_VTAB
/begin COMPU_METHOD CMPRAIRBLOW_SC_Compu "" TAB_VERB "%6.3" "" COMPU_TAB_REF CMPRAIRBLOW_SC_Compu /end COMPU_METHOD
/begin COMPU_VTAB CMPRAIRBLOW_SC_Compu "" TAB_VERB 2 0 "False" 1 "True" /end COMPU_VTAB
/begin COMPU_METHOD CMPRBYPVLV_AIRACTR_SC_Compu "" TAB_VERB "%6.3" "" COMPU_TAB_REF CMPRBYPVLV_AIRACTR_SC_Compu /end COMPU_METHOD
/begin COMPU_VTAB CMPRBYPVLV_AIRACTR_SC_Compu "" TAB_VERB 2 0 "INACTIVE" 1 "ACTIVE" /end COMPU_VTAB
/begin COMPU_METHOD Com_aLgtG_Compu "" RAT_FUNC "%6.2" "Mtr_per_sec2" COEFFS 0 208980 5120000 0 0 10000 /end COMPU_METHOD
/begin COMPU_METHOD Com_stSeatBltInfo_COMPU_VERB "" TAB_VERB "%6.3" "" COMPU_TAB_REF Com_stSeatBltInfo_COMPU_VERB /end COMPU_METHOD
/begin COMPU_VTAB Com_stSeatBltInfo_COMPU_VERB "" TAB_VERB 4 0 "UNABLE_TO_CONFIRM" 1 "SEATBELT_NOT_WEARING" 2 "SEATBELT_WEARING" 3 "SEATBELT_BUCKLESW_ERROR" /end COMPU_VTAB
/begin COMPU_METHOD dez "" RAT_FUNC "%6.2" "" COEFFS 0 1 0 0 0 1 /end COMPU_METHOD
/begin COMPU_METHOD dfp_verbal "" TAB_VERB "%6.3" "-" COMPU_TAB_REF dfp_verbal /end COMPU_METHOD
/begin COMPU_VTAB dfp_verbal "" TAB_VERB 83 0 "DFP_AAA" 1 "DFP_AAV" 2 "DFP_AAVE" 3 "DFP_AGRE" 4 "DFP_AGRS" 5 "DFP_DHFHD" 6 "DFP_DK" 7 "DFP_DK1P" 8 "DFP_DK2P" 9 "DFP_DKVS" 10 "DFP_DSKV" 11 "DFP_DSKVR" 12 "DFP_DSKVS" 13 "DFP_DSS" 14 "DFP_DSU" 15 "DFP_DVEE" 16 "DFP_DVEF" 17 "DFP_DVEFO" 18 "DFP_DVEL" 19 "DFP_DVEN" 20 "DFP_DVER" 21 "DFP_DVEU" 22 "DFP_DVEUB" 23 "DFP_DVEUW" 24 "DFP_DYLSU" 25 "DFP_ENWCS" 26 "DFP_ENWS" 27 "DFP_ENWSE" 28 "DFP_EONV" 29 "DFP_FP1P" 30 "DFP_FP2P" 31 "DFP_FRA" 32 "DFP_FST" 33 "DFP_FSTE" 34 "DFP_FSTR" 35 "DFP_FTDLA" 36 "DFP_HDR" 37 "DFP_HDRKH" 38 "DFP_HDRPL" 39 "DFP_HFM" 40 "DFP_HSH" 41 "DFP_HSHE" 42 "DFP_KAT" 43 "DFP_KPE" 44 "DFP_KS1" 45 "DFP_LLRH" 46 "DFP_LLRKH" 47 "DFP_LM" 48 "DFP_LSH" 49 "DFP_LZSR" 50 "DFP_MD" 51 "DFP_NWS" 52 "DFP_NWSE" 53 "DFP_ORA" 54 "DFP_PLLSU" 55 "DFP_PSR" 56 "DFP_PSR1" 57 "DFP_PSRB" 58 "DFP_PSRE" 59 "DFP_PSRP" 60 "DFP_PU" 61 "DFP_PUE" 62 "DFP_PUPL" 63 "DFP_PUR" 64 "DFP_STHDR" 65 "DFP_TA" 66 "DFP_TANKL" 67 "DFP_TANLCS" 68 "DFP_TANLPRC" 69 "DFP_TANLR" 70 "DFP_TASRCS" 71 "DFP_TASRE" 72 "DFP_TASRPRC" 73 "DFP_TASRR" 74 "DFP_TESF" 75 "DFP_TESG" 76 "DFP_TM" 77 "DFP_TMCS" 78 "DFP_TME" 79 "DFP_TMP" 80 "DFP_UB" 81 "DFP_VFZ" 82 "DFP_ZZZ" DEFAULT_VALUE "---" /end COMPU_VTAB
/begin COMPU_METHOD EngN "" RAT_FUNC "%6.3" "rpm" COEFFS 0 2 0 0 0 1 /end COMPU_METHOD
/begin COMPU_METHOD EngNGrd "" RAT_FUNC "%6.3" "rpm/s" COEFFS 0 2 0 0 0 1 /end COMPU_METHOD
/begin COMPU_METHOD EngN_LRes "" RAT_FUNC "%6.1" "rpm" COEFFS 0 0.025 0 0 0 1 /end COMPU_METHOD
/begin COMPU_METHOD Fact100 "" RAT_FUNC "%6.4" "-" COEFFS 0 100 0 0 0 1 /end COMPU_METHOD
/begin COMPU_METHOD fak_q0p000122 "" RAT_FUNC "%6.5" "1/(g*s)" COEFFS 0 65536 0 0 0 8 /end COMPU_METHOD
/begin COMPU_METHOD fak_q0p000244 "" RAT_FUNC "%6.5" "-" COEFFS 0 65536 0 0 0 16 /end COMPU_METHOD
/begin COMPU_METHOD fak_q0p000488 "" RAT_FUNC "%6.5" "-" COEFFS 0 65536 0 0 0 32 /end COMPU_METHOD
/begin COMPU_METHOD fak_q0p0039_op0p5 "" RAT_FUNC "%6.3" "" COEFFS 0 256 -128 0 0 1 /end COMPU_METHOD
/begin COMPU_METHOD fak_q0p00781 "" RAT_FUNC "%6.4" "-" COEFFS 0 128 0 0 0 1 /end COMPU_METHOD
/begin COMPU_METHOD fak_q1p5258Em5 "" RAT_FUNC "%7.6" "h/kg" COEFFS 0 65536 0 0 0 1 /end COMPU_METHOD
/begin COMPU_METHOD fak_q3p0518Em5 "" RAT_FUNC "%7.6" "" COEFFS 0 32768 0 0 0 1 /end COMPU_METHOD
/begin COMPU_METHOD fak_q6p1035Em5 "" RAT_FUNC "%7.6" "-" COEFFS 0 65536 0 0 0 4 /end COMPU_METHOD
/begin COMPU_METHOD fak_sw_b4 "" RAT_FUNC "%6.5" "-" COEFFS 0 65536 0 0 0 8 /end COMPU_METHOD
/begin COMPU_METHOD fak_ub_b1 "" RAT_FUNC "%6.4" "-" COEFFS 0 256 0 0 0 1 /end COMPU_METHOD
/begin COMPU_METHOD fak_ub_b2 "" RAT_FUNC "%8.5" "-" COEFFS 0 256 0 0 0 2 /end COMPU_METHOD
/begin COMPU_METHOD fak_ub_b4 "" RAT_FUNC "%6.4" "-" COEFFS 0 256 0 0 0 4 /end COMPU_METHOD
/begin COMPU_METHOD fak_uw_b1 "" RAT_FUNC "%7.6" "-" COEFFS 0 65536 0 0 0 1 /end COMPU_METHOD
/begin COMPU_METHOD fak_uw_b16 "" RAT_FUNC "%6.5" "-" COEFFS 0 65536 0 0 0 16 /end COMPU_METHOD
/begin COMPU_METHOD fak_uw_b2 "" RAT_FUNC "%7.6" "-" COEFFS 0 65536 0 0 0 2 /end COMPU_METHOD
/begin COMPU_METHOD fak_uw_b4 "" RAT_FUNC "%7.6" "-" COEFFS 0 65536 0 0 0 4 /end COMPU_METHOD
/begin COMPU_METHOD k10ms_uw_b100 "" RAT_FUNC "%6.4" "1/s" COEFFS 0 65536 0 0 0 100 /end COMPU_METHOD
/begin COMPU_METHOD lu_MEx "" RAT_FUNC "%6.4" "(Umdr./sec)^2" COEFFS 0 140.7374884 0 0 0 1 /end COMPU_METHOD
/begin COMPU_METHOD m_q0p1 "" RAT_FUNC "%6.3" "kg/h" COEFFS 0 10 0 0 0 1 /end COMPU_METHOD
/begin COMPU_METHOD m_q0p2170 "" RAT_FUNC "%6.3" "mg/s" COEFFS 0 9216 0 0 0 2000 /end COMPU_METHOD
/begin COMPU_METHOD m_uw_b6553p5 "" RAT_FUNC "%6.3" "kg/h" COEFFS 0 1 0 0 0 0.1 /end COMPU_METHOD
/begin COMPU_METHOD nmotd_sw_q0p25 "" RAT_FUNC "%6.3" "1/min" COEFFS 0 1 0 0 0 0.25 /end COMPU_METHOD
/begin COMPU_METHOD nmot_q0p5 "" RAT_FUNC "%6.3" "1/min" COEFFS 0 2 0 0 0 1 /end COMPU_METHOD
/begin COMPU_METHOD nmot_sw_q0p25 "" RAT_FUNC "%6.3" "1/min" COEFFS 0 1 0 0 0 0.25 /end COMPU_METHOD
/begin COMPU_METHOD nmot_sw_q0p5 "" RAT_FUNC "%6.3" "1/min" COEFFS 0 2 0 0 0 1 /end COMPU_METHOD
/begin COMPU_METHOD nmot_ub_q40 "" RAT_FUNC "%6.1" "1/min" COEFFS 0 1 0 0 0 40 /end COMPU_METHOD
/begin COMPU_METHOD nmot_uw_q0p25 "" RAT_FUNC "%6.3" "1/min" COEFFS 0 1 0 0 0 0.25 /end COMPU_METHOD
/begin COMPU_METHOD OneToOne "" RAT_FUNC "%6.2" "-" COEFFS 0 1 0 0 0 1 /end COMPU_METHOD
/begin COMPU_METHOD Prc "" RAT_FUNC "%6.4" "%" COEFFS 0 81.92 0 0 0 1 /end COMPU_METHOD
/begin COMPU_METHOD p_q0p039 "" RAT_FUNC "%6.4" "hPa" COEFFS 0 256 0 0 0 10 /end COMPU_METHOD
/begin COMPU_METHOD p_q0p078 "" RAT_FUNC "%6.4" "hPa" COEFFS 0 64 0 0 0 5 /end COMPU_METHOD
/begin COMPU_METHOD p_uw_q0p039 "" RAT_FUNC "%6.4" "hPa" COEFFS 0 256 0 0 0 10 /end COMPU_METHOD
/begin COMPU_METHOD RBPtCel_p_0p002_1 "" RAT_FUNC "%6.4" "MPa" COEFFS 0 1000 0 0 0 2 /end COMPU_METHOD
/begin COMPU_METHOD rel_q0p02344 "" RAT_FUNC "%6.4" "%" COEFFS 0 32 0 0 0 0.75 /end COMPU_METHOD
/begin COMPU_METHOD rel_q0p39 "" RAT_FUNC "%6.3" "%" COEFFS 0 256 0 0 0 100 /end COMPU_METHOD
/begin COMPU_METHOD rel_sw_b100 "" RAT_FUNC "%6.4" "%" COEFFS 0 32768 0 0 0 100 /end COMPU_METHOD
/begin COMPU_METHOD rel_sw_b50 "" RAT_FUNC "%6.4" "%" COEFFS 0 65536 0 0 0 100 /end COMPU_METHOD
/begin COMPU_METHOD rel_uw_b100 "" RAT_FUNC "%6.4" "%" COEFFS 0 65536 0 0 0 100 /end COMPU_METHOD
/begin COMPU_METHOD rel_uw_b3072 "" RAT_FUNC "%6.4" "%" COEFFS 0 65536 0 0 0 3072 /end COMPU_METHOD
/begin COMPU_METHOD rel_uw_q0p0234 "" RAT_FUNC "%6.4" "%" COEFFS 0 32 0 0 0 0.75 /end COMPU_METHOD
/begin COMPU_METHOD t100msxs_ub_b25p5 "" RAT_FUNC "%6.3" "s" COEFFS 0 1 0 0 0 0.1 /end COMPU_METHOD
/begin COMPU_METHOD t100msxs_uw_b6553p5 "" RAT_FUNC "%6.3" "s" COEFFS 0 1 0 0 0 0.1 /end COMPU_METHOD
/begin COMPU_METHOD t10msxs_uw_b655p35 "" RAT_FUNC "%6.4" "s" COEFFS 0 1 0 0 0 0.01 /end COMPU_METHOD
/begin COMPU_METHOD t50msxs_q3p052em4 "" RAT_FUNC "%6.5" "1/s" COEFFS 0 65536 0 0 0 20 /end COMPU_METHOD
/begin COMPU_METHOD Temp_Cels "" RAT_FUNC "%6.1" "deg C" COEFFS 0 10 2731.4 0 0 1 /end COMPU_METHOD
/begin COMPU_METHOD temp_q0p0234 "" RAT_FUNC "%6.4" "K" COEFFS 0 256 0 0 0 6 /end COMPU_METHOD
/begin COMPU_METHOD temp_q0p0234_o273 "" RAT_FUNC "%6.1" "Grad C" COEFFS 0 1 273.15 0 0 0.0234375 /end COMPU_METHOD
/begin COMPU_METHOD temp_q0p1_o273 "" RAT_FUNC "%6.1" "Grad C" COEFFS 0 10 2731.4 0 0 1 /end COMPU_METHOD
/begin COMPU_METHOD temp_q0p75_om48 "" RAT_FUNC "%6.2" "Grad C" COEFFS 0 4 192 0 0 3 /end COMPU_METHOD
/begin COMPU_METHOD temp_q6 "" RAT_FUNC "%6.2" "K" COEFFS 0 1 0 0 0 6 /end COMPU_METHOD
/begin COMPU_METHOD temp_ub_q0p75_o48 "" RAT_FUNC "%6.2" "Grad C" COEFFS 0 1 48 0 0 0.75 /end COMPU_METHOD
/begin COMPU_METHOD TimeDelay_s "" RAT_FUNC "%6.1" "s" COEFFS 0 0 1 0 0.00023283064365387 0 /end COMPU_METHOD
/begin COMPU_METHOD Time_Dt "" RAT_FUNC "%9.8" "s" COEFFS 0 1000000 0 0 0 1 /end COMPU_METHOD
/begin COMPU_METHOD Time_ms "" RAT_FUNC "%6.1" "ms" COEFFS 0 0.1 0 0 0 1 /end COMPU_METHOD
/begin COMPU_METHOD Time_s "" RAT_FUNC "%6.4" "s" COEFFS 0 100 0 0 0 1 /end COMPU_METHOD
/begin COMPU_METHOD t_q0p01 "" RAT_FUNC "%6.4" "s" COEFFS 0 100 0 0 0 1 /end COMPU_METHOD
/begin COMPU_METHOD t_q0p02 "" RAT_FUNC "%6.4" "s" COEFFS 0 100 0 0 0 2 /end COMPU_METHOD
/begin COMPU_METHOD t_q0p04 "" RAT_FUNC "%6.4" "s" COEFFS 0 100 0 0 0 4 /end COMPU_METHOD
/begin COMPU_METHOD t_q0p05 "" RAT_FUNC "%6.4" "s" COEFFS 0 100 0 0 0 5 /end COMPU_METHOD
/begin COMPU_METHOD t_q0p1 "" RAT_FUNC "%6.3" "s" COEFFS 0 10 0 0 0 1 /end COMPU_METHOD
/begin COMPU_METHOD t_q0p2 "" RAT_FUNC "%6.3" "s" COEFFS 0 10 0 0 0 2 /end COMPU_METHOD
/begin COMPU_METHOD t_q1 "" RAT_FUNC "%6.2" "s" COEFFS 0 1 0 0 0 1 /end COMPU_METHOD
/begin COMPU_METHOD t_q4_s "" RAT_FUNC "%6.2" "s" COEFFS 0 1 0 0 0 4 /end COMPU_METHOD
/begin COMPU_METHOD Vel "" RAT_FUNC "%6.4" "km/h" COEFFS 0 100 0 0 0 1 /end COMPU_METHOD
/begin COMPU_METHOD vel_q0p01 "" RAT_FUNC "%6.4" "km/h" COEFFS 0 100 0 0 0 1 /end COMPU_METHOD
/begin COMPU_METHOD YawRate_q0p2441_om125 "" RAT_FUNC "%6.3" "Deg/s" COEFFS 0 1023 127875 0 0 249.7559 /end COMPU_METHOD
/begin COMPU_METHOD zk100msxs_uw_b6553 "" RAT_FUNC "%6.1" "s" COEFFS 0 0 65536 0 10 0 /end COMPU_METHOD
/begin COMPU_METHOD zk200msxs_uw_b13107p2 "" RAT_FUNC "%6.0" "s" COEFFS 0 0 65536 0 5 0 /end COMPU_METHOD
/begin COMPU_METHOD zk20msxs_uw_b1310p72 "" RAT_FUNC "%6.1" "s" COEFFS 0 0 65536 0 50 0 /end COMPU_METHOD
/begin COMPU_METHOD zw_q0p75 "" RAT_FUNC "%6.3" "Grad KW" COEFFS 0 4 0 0 0 3 /end COMPU_METHOD
/begin COMPU_METHOD zw_q2p9297Em3_deg_KW "" RAT_FUNC "%6.4" "deg KW" COEFFS 0 1024 0 0 0 3 /end COMPU_METHOD
/begin RECORD_LAYOUT RB_Axis_S16 NO_AXIS_PTS_X 1 SWORD AXIS_PTS_X 2 SWORD INDEX_INCR DIRECT /end RECORD_LAYOUT
/begin RECORD_LAYOUT RB_Axis_S8 NO_AXIS_PTS_X 1 SBYTE AXIS_PTS_X 2 SBYTE INDEX_INCR DIRECT /end RECORD_LAYOUT
/begin RECORD_LAYOUT RB_Axis_U16 NO_AXIS_PTS_X 1 UWORD AXIS_PTS_X 2 UWORD INDEX_INCR DIRECT /end RECORD_LAYOUT
/begin RECORD_LAYOUT RB_Axis_U8 NO_AXIS_PTS_X 1 UBYTE AXIS_PTS_X 2 UBYTE INDEX_INCR DIRECT /end RECORD_LAYOUT
/begin RECORD_LAYOUT RB_CurveGroup_U8 FNC_VALUES 1 UBYTE COLUMN_DIR DIRECT /end RECORD_LAYOUT
/begin RECORD_LAYOUT RB_Curve_S16_S16 NO_AXIS_PTS_X 1 SWORD AXIS_PTS_X 2 SWORD INDEX_INCR DIRECT FNC_VALUES 3 SWORD COLUMN_DIR DIRECT /end RECORD_LAYOUT
/begin RECORD_LAYOUT RB_Curve_S16_U16_Static NO_AXIS_PTS_X 1 SWORD AXIS_PTS_X 2 SWORD INDEX_INCR DIRECT FNC_VALUES 3 UWORD COLUMN_DIR DIRECT STATIC_RECORD_LAYOUT /end RECORD_LAYOUT
/begin RECORD_LAYOUT RB_Curve_S16_U8_Static NO_AXIS_PTS_X 1 SWORD AXIS_PTS_X 2 SWORD INDEX_INCR DIRECT FNC_VALUES 3 UBYTE COLUMN_DIR DIRECT STATIC_RECORD_LAYOUT /end RECORD_LAYOUT
/begin RECORD_LAYOUT RB_Curve_S8_S8 NO_AXIS_PTS_X 1 SBYTE AXIS_PTS_X 2 SBYTE INDEX_INCR DIRECT FNC_VALUES 3 SBYTE COLUMN_DIR DIRECT /end RECORD_LAYOUT
/begin RECORD_LAYOUT RB_Curve_U16_S16_Static NO_AXIS_PTS_X 1 UWORD AXIS_PTS_X 2 UWORD INDEX_INCR DIRECT FNC_VALUES 3 SWORD COLUMN_DIR DIRECT STATIC_RECORD_LAYOUT /end RECORD_LAYOUT
/begin RECORD_LAYOUT RB_Curve_U16_U16 NO_AXIS_PTS_X 1 UWORD AXIS_PTS_X 2 UWORD INDEX_INCR DIRECT FNC_VALUES 3 UWORD COLUMN_DIR DIRECT /end RECORD_LAYOUT
/begin RECORD_LAYOUT RB_Curve_U8_U16_Static NO_AXIS_PTS_X 1 UBYTE AXIS_PTS_X 2 UBYTE INDEX_INCR DIRECT FNC_VALUES 3 UWORD COLUMN_DIR DIRECT STATIC_RECORD_LAYOUT /end RECORD_LAYOUT
/begin RECORD_LAYOUT RB_FixCurve_S8_S8 FNC_VALUES 1 SBYTE COLUMN_DIR DIRECT /end RECORD_LAYOUT
/begin RECORD_LAYOUT RB_MapGroup_S16 FNC_VALUES 1 SWORD COLUMN_DIR DIRECT /end RECORD_LAYOUT
/begin RECORD_LAYOUT RB_MapGroup_U16 FNC_VALUES 1 UWORD COLUMN_DIR DIRECT /end RECORD_LAYOUT
/begin RECORD_LAYOUT RB_MapGroup_U8 FNC_VALUES 1 UBYTE COLUMN_DIR DIRECT /end RECORD_LAYOUT
/begin RECORD_LAYOUT RB_Map_S16S16_S16 NO_AXIS_PTS_X 1 SWORD NO_AXIS_PTS_Y 2 SWORD AXIS_PTS_X 3 SWORD INDEX_INCR DIRECT AXIS_PTS_Y 4 SWORD INDEX_INCR DIRECT FNC_VALUES 5 SWORD COLUMN_DIR DIRECT /end RECORD_LAYOUT
/begin RECORD_LAYOUT RB_Map_S16S16_U8 NO_AXIS_PTS_X 1 SWORD NO_AXIS_PTS_Y 2 SWORD AXIS_PTS_X 3 SWORD INDEX_INCR DIRECT AXIS_PTS_Y 4 SWORD INDEX_INCR DIRECT FNC_VALUES 5 UBYTE COLUMN_DIR DIRECT /end RECORD_LAYOUT
/begin RECORD_LAYOUT RB_Map_S16S8_S16 NO_AXIS_PTS_X 1 SWORD NO_AXIS_PTS_Y 2 SWORD AXIS_PTS_X 3 SWORD INDEX_INCR DIRECT AXIS_PTS_Y 4 SBYTE INDEX_INCR DIRECT FNC_VALUES 5 SWORD COLUMN_DIR DIRECT /end RECORD_LAYOUT
/begin RECORD_LAYOUT RB_Map_S16U16_U16 NO_AXIS_PTS_X 1 SWORD NO_AXIS_PTS_Y 2 SWORD AXIS_PTS_X 3 SWORD INDEX_INCR DIRECT AXIS_PTS_Y 4 UWORD INDEX_INCR DIRECT FNC_VALUES 5 UWORD ROW_DIR DIRECT /end RECORD_LAYOUT
/begin RECORD_LAYOUT RB_Map_U16S16_S16 NO_AXIS_PTS_X 1 UWORD NO_AXIS_PTS_Y 2 UWORD AXIS_PTS_X 3 UWORD INDEX_INCR DIRECT AXIS_PTS_Y 4 SWORD INDEX_INCR DIRECT FNC_VALUES 5 SWORD COLUMN_DIR DIRECT /end RECORD_LAYOUT
/begin RECORD_LAYOUT RB_Map_U16U16_S16 NO_AXIS_PTS_X 1 UWORD NO_AXIS_PTS_Y 2 UWORD AXIS_PTS_X 3 UWORD INDEX_INCR DIRECT AXIS_PTS_Y 4 UWORD INDEX_INCR DIRECT FNC_VALUES 5 SWORD COLUMN_DIR DIRECT /end RECORD_LAYOUT
/begin RECORD_LAYOUT RB_Map_U16U16_U16 NO_AXIS_PTS_X 1 UWORD NO_AXIS_PTS_Y 2 UWORD AXIS_PTS_X 3 UWORD INDEX_INCR DIRECT AXIS_PTS_Y 4 UWORD INDEX_INCR DIRECT FNC_VALUES 5 UWORD COLUMN_DIR DIRECT /end RECORD_LAYOUT
/begin RECORD_LAYOUT RB_Map_U16U16_U8 NO_AXIS_PTS_X 1 UWORD NO_AXIS_PTS_Y 2 UWORD AXIS_PTS_X 3 UWORD INDEX_INCR DIRECT AXIS_PTS_Y 4 UWORD INDEX_INCR DIRECT FNC_VALUES 5 UBYTE COLUMN_DIR DIRECT /end RECORD_LAYOUT
/begin RECORD_LAYOUT RB_Map_U8U8_U8 NO_AXIS_PTS_X 1 UBYTE NO_AXIS_PTS_Y 2 UBYTE AXIS_PTS_X 3 UBYTE INDEX_INCR DIRECT AXIS_PTS_Y 4 UBYTE INDEX_INCR DIRECT FNC_VALUES 5 UBYTE COLUMN_DIR DIRECT /end RECORD_LAYOUT
/begin RECORD_LAYOUT RB_ValA_Wu16 FNC_VALUES 1 UWORD COLUMN_DIR DIRECT /end RECORD_LAYOUT
/begin RECORD_LAYOUT RB_Val_Wboolean FNC_VALUES 1 UBYTE COLUMN_DIR DIRECT /end RECORD_LAYOUT
/begin RECORD_LAYOUT RB_Val_Ws16 FNC_VALUES 1 SWORD COLUMN_DIR DIRECT /end RECORD_LAYOUT
/begin RECORD_LAYOUT RB_Val_Ws32 FNC_VALUES 1 SLONG COLUMN_DIR DIRECT /end RECORD_LAYOUT
/begin RECORD_LAYOUT RB_Val_Ws8 FNC_VALUES 1 SBYTE COLUMN_DIR DIRECT /end RECORD_LAYOUT
/begin RECORD_LAYOUT RB_Val_Wu16 FNC_VALUES 1 UWORD COLUMN_DIR DIRECT /end RECORD_LAYOUT
/begin RECORD_LAYOUT RB_Val_Wu32 FNC_VALUES 1 ULONG COLUMN_DIR DIRECT /end RECORD_LAYOUT
/begin RECORD_LAYOUT RB_Val_Wu8 FNC_VALUES 1 UBYTE COLUMN_DIR DIRECT /end RECORD_LAYOUT
/begin RECORD_LAYOUT Val_Wu16 FNC_VALUES 1 UWORD COLUMN_DIR DIRECT /end RECORD_LAYOUT
/begin RECORD_LAYOUT Val_Wu8 FNC_VALUES 1 UBYTE COLUMN_DIR DIRECT /end RECORD_LAYOUT
/end MODULE
/end PROJECT
