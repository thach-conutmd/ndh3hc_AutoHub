ASAP2_VERSION 1 60
/begin PROJECT MG1CS022 "MG1CS022"
/begin HEADER "" VERSION "MG1CS022_62XSC_V037" PROJECT_NO MG1CS022 /end HEADER
/begin MODULE DIM ""
/begin MOD_COMMON "" BYTE_ORDER MSB_LAST ALIGNMENT_BYTE 1 ALIGNMENT_WORD 2 ALIGNMENT_LONG 4 ALIGNMENT_INT64 4 ALIGNMENT_FLOAT32_IEEE 4 ALIGNMENT_FLOAT64_IEEE 4 DATA_SIZE 32 /end MOD_COMMON
/begin CHARACTERISTIC APRBVACP "Maximum number of times this process can be activated without exiting Phase 2" VALUE 0x8053B8A6 RB_Val_Wu8 255.0 dez 0.00 255.0 FORMAT "%5.1" /end CHARACTERISTIC
/begin CHARACTERISTIC CCPVPLAUMX "max number of CPV plausibility-checks" VALUE 0x8053B42E RB_Val_Wu8 255.0 dez 0.00 255.0 FORMAT "%5.1" /end CHARACTERISTIC
/begin CHARACTERISTIC CstrPurg_stDiagCpvDteskSeln_C "Code word to select which purge line or Bank are using a DTESK based algorithm" VALUE 0x8053B490 RB_Val_Wu8 255.0 OneToOne 0.00 255.0 FORMAT "%5.1" /end CHARACTERISTIC
/begin CHARACTERISTIC CWCCVCLSD "Codeword to enable DTESK diagnosis counter increment when CCV is closed" VALUE 0x8053B5F4 RB_Val_Wu8 255.0 dez 0.00 255.0 FORMAT "%5.1" /end CHARACTERISTIC
/begin CHARACTERISTIC CWDEONVTC "service test enabled" VALUE 0x8053BD10 RB_Val_Wu8 255.0 dez 0.00 255.0 FORMAT "%5.1" /end CHARACTERISTIC
/begin CHARACTERISTIC CWDTESKAPP "codeword for activating a desired tank leakage diagnosis (for calibration purpose)" VALUE 0x8053B5F5 RB_Val_Wu8 6.000 dez 0.00 6.000 FORMAT "%5.3" EXTENDED_LIMITS 0.00 255.0 /end CHARACTERISTIC
/begin CHARACTERISTIC CWDTESKEB "code word for switch on tank leak diagnosis" VALUE 0x8053B5F6 RB_Val_Wu16 65535.00 dez 0.00 65535.00 FORMAT "%8.2" /end CHARACTERISTIC
/begin CHARACTERISTIC CWDTESKSTC "code word: calculation of request engine running" VALUE 0x8053B5F8 RB_Val_Wu8 255.0 dez 0.00 255.0 FORMAT "%5.1" /end CHARACTERISTIC
/begin CHARACTERISTIC CWDTESKTC "code word for DTESK tester communication" VALUE 0x8053B89C RB_Val_Wu8 255.0 dez 0.00 255.0 FORMAT "%5.1" /end CHARACTERISTIC
/begin CHARACTERISTIC CWDTESKTEAD "Codeword to select the method for the disable condition because of high canister load" VALUE 0x8053B5F9 RB_Val_Wu8 255.0 dez 0.00 255.0 FORMAT "%5.1" /end CHARACTERISTIC
/begin CHARACTERISTIC CWDTESKZA "code word for features of %DTESKZA" VALUE 0x8053B664 RB_Val_Wu8 255.0 dez 0.00 255.0 FORMAT "%5.1" /end CHARACTERISTIC
/begin CHARACTERISTIC CWEONV "code word EONV diagnosis" VALUE 0x8053BCCC RB_Val_Wu8 255.0 dez 0.00 255.0 FORMAT "%5.1" /end CHARACTERISTIC
/begin CHARACTERISTIC CWEONVIR "configuration code word für DEONVIR" VALUE 0x8053BCBA RB_Val_Wu8 255.0 dez 0.00 255.0 FORMAT "%5.1" /end CHARACTERISTIC
/begin CHARACTERISTIC CWSFTEDAFA "Codeword for high canister load detection at tester request" VALUE 0x8053B5FA RB_Val_Wu8 255.0 dez 0.00 255.0 FORMAT "%5.1" /end CHARACTERISTIC
/begin CHARACTERISTIC CWTLDDD "code word for enabling distance debounce in DTESK (byte)" VALUE 0x8053B5EA RB_Val_Wu8 255.0 dez 0.00 255.0 FORMAT "%5.1" /end CHARACTERISTIC
/begin CHARACTERISTIC CWTLDOBD "code word for specification of the OBD-diagnosis" VALUE 0x8053B5FB RB_Val_Wu8 255.0 dez 0.00 255.0 FORMAT "%5.1" /end CHARACTERISTIC
/begin CHARACTERISTIC DDPTEAR "pressure difference for termination of vacuum built-up" VALUE 0x8053B666 RB_Val_Ws16 79.99878 p_q0p00122 -40.00000 39.99878 FORMAT "%8.5" /end CHARACTERISTIC
/begin CHARACTERISTIC DDPTEDT05 "pressure difference for further vacuum built up (0.5-mm-check)" VALUE 0x8053B668 RB_Val_Ws16 79.99878 p_q0p00122 -40.00000 39.99878 FORMAT "%8.5" /end CHARACTERISTIC
/begin CHARACTERISTIC DDPTEKU "lower threshold for difference pressure while compensation gradient generation" VALUE 0x8053B66A RB_Val_Ws16 79.99878 p_q0p00122 -40.00000 39.99878 FORMAT "%8.5" /end CHARACTERISTIC
/begin CHARACTERISTIC DDPTETA "pressure threshold for detection of refueling process" VALUE 0x8053B5EC RB_Val_Ws16 79.99878 p_q0p00122 -40.00000 39.99878 FORMAT "%8.5" /end CHARACTERISTIC
/begin CHARACTERISTIC DiaActr_ElecPsDiag_DbgSigId_C "Signal Id to be debugged" VALUE 0x8058B604 Val_Wu32 4294967295.00 OneToOne 0.00 4294967295.00 FORMAT "%13.2" /end CHARACTERISTIC
/begin CHARACTERISTIC DiaActr_ElecPsDiag_DbgSigTyp_C "Type of the output signal (PWMOut, DigOut, Pmd) to be debugged." VALUE 0x8058B608 Val_Wu8 3.00000000000 DiaActr_ElecPsDiag_DbgSigTyp_COMPU_VERB 0.00 3.00000000000 FORMAT "%13.11" /end CHARACTERISTIC
/begin CHARACTERISTIC DiaActr_ElecPsDiag_SigOutDurgOpenLd_C "Take into account Open-Load-Error for Shut-Off request." VALUE 0x8058B609 Val_Wu8 1.000 OneToOne 0.00 1.000 FORMAT "%5.3" EXTENDED_LIMITS 0.00 255.0 /end CHARACTERISTIC
/begin CHARACTERISTIC DiagCpt_mfMinOffsChkPSnsr_C "Minimum integrated mass flow for release of offset check tank pressure sensor to avoid chock canister condition" VALUE 0x8053B430 RB_Val_Wu16 2909.754 m_ub_q0p0444 0.00 2909.754 FORMAT "%8.3" /end CHARACTERISTIC
/begin CHARACTERISTIC DiagCpt_mfMinOffsEol_C "Minimum integrated mass flow for release of offset check tank pressure sensor to avoid chock canister condition during end of line test" VALUE 0x8053B432 RB_Val_Wu16 2909.754 m_ub_q0p0444 0.00 2909.754 FORMAT "%8.3" /end CHARACTERISTIC
/begin CHARACTERISTIC DiagCpt_stOffsDiag_C "Codeword for offsetdiagnosis" VALUE 0x8053B434 RB_Val_Wu8 255.0 dez 0.00 255.0 FORMAT "%5.1" /end CHARACTERISTIC
/begin CHARACTERISTIC DiagCpt_stPSnsrTankDiag_C "Code word to configure diagnosis tank pressure sensor (1 sensor)" VALUE 0x8053B435 RB_Val_Wu8 255.0 dez 0.00 255.0 FORMAT "%5.1" /end CHARACTERISTIC
/begin CHARACTERISTIC DiagCpt_vMinOffsEol_C "minimum vehicle velocity for the offset diagnosis during end of line test" VALUE 0x8053B436 RB_Val_Ws16 655.3500 Vel -327.6800 327.6700 FORMAT "%8.4" /end CHARACTERISTIC
/begin CHARACTERISTIC Diff_rTrqDfftl_C "Defaultvalue for the Differential ratio" VALUE 0x8053BD34 RB_Val_Ws16 655.3500 TransR -327.6800 327.6700 FORMAT "%8.4" /end CHARACTERISTIC
/begin CHARACTERISTIC DMSNSTLD "Minimum deviation of CPV mass flow for tank leakage diagnosis" VALUE 0x8053B66C RB_Val_Wu16 25.59961 m_uw_b25p6 0.00 25.59961 FORMAT "%8.5" /end CHARACTERISTIC
/begin CHARACTERISTIC DMSNTEVMN "Minimum PCV differential mass flow for incremental check of tank pressure sensor" VALUE 0x8053B438 RB_Val_Wu16 25.59961 m_uw_b25p6 0.00 25.59961 FORMAT "%8.5" /end CHARACTERISTIC
/begin CHARACTERISTIC DPCPVPOF "maximum pressure change during cpv active" VALUE 0x8053B43A RB_Val_Wu16 79.99878 p_q0p00122 0.00 79.99878 FORMAT "%8.5" /end CHARACTERISTIC
/begin CHARACTERISTIC DPDELTA "pressure changing for detection of responding tank pressure sensor" VALUE 0x8053B66E RB_Val_Ws16 79.99878 p_q0p00122 -40.00000 39.99878 FORMAT "%8.5" /end CHARACTERISTIC
/begin CHARACTERISTIC DPDSTNPW "minimum tank pressure difference for plausibility error detection (Word)" VALUE 0x8053B43C RB_Val_Wu16 79.99878 p_q0p00122 0.00 79.99878 FORMAT "%8.5" /end CHARACTERISTIC
/begin CHARACTERISTIC DPDTED "pressure difference for check of tank pressure minimum" VALUE 0x8053B670 RB_Val_Ws16 79.99878 p_q0p00122 -40.00000 39.99878 FORMAT "%8.5" /end CHARACTERISTIC
/begin CHARACTERISTIC DPKOND "pressure difference for abort of diagnosis at fuel condensation" VALUE 0x8053B672 RB_Val_Ws16 79.99878 p_q0p00122 -40.00000 39.99878 FORMAT "%8.5" /end CHARACTERISTIC
/begin CHARACTERISTIC DPLINMX "Threshold for Change of Pressure deviation for linearisation check for tank leakage diagnosis" VALUE 0x8053B674 RB_Val_Wu16 79.99878 p_q0p00122 0.00 79.99878 FORMAT "%8.5" /end CHARACTERISTIC
/begin CHARACTERISTIC DPTEDPU "positive pressure threshold for refuelling detection" VALUE 0x8053BD1A RB_Val_Ws16 79.99878 p_q0p00122 -40.00000 39.99878 FORMAT "%8.5" /end CHARACTERISTIC
/begin CHARACTERISTIC DPTEDSCH "pressure difference during PCV-shot" VALUE 0x8053B676 RB_Val_Ws16 79.99756 p_q0p00122 -39.99878 39.99878 FORMAT "%8.5" EXTENDED_LIMITS -40.00000 39.99878 /end CHARACTERISTIC
/begin CHARACTERISTIC DPTEDTD "threshold for band pass filtered pressure for detection of opened filler cap" VALUE 0x8053BD1C RB_Val_Wu16 79.99878 p_q0p00122 0.00 79.99878 FORMAT "%8.5" /end CHARACTERISTIC
/begin CHARACTERISTIC DPTEDTK "threshold for band pass filtered pressure for refuelling detection" VALUE 0x8053BD1E RB_Val_Ws16 79.99878 p_q0p00122 -40.00000 39.99878 FORMAT "%8.5" /end CHARACTERISTIC
/begin CHARACTERISTIC DPTEKDTHMX "max value delta tank pressure for offset diagnosis tank pressure sensor" VALUE 0x8053B43E RB_Val_Wu16 79.99878 p_q0p00122 0.00 79.99878 FORMAT "%8.5" /end CHARACTERISTIC
/begin CHARACTERISTIC DPTEKO "limit for identification offet-failure tank pressure" VALUE 0x8053B440 RB_Val_Wu16 79.99878 p_q0p00122 0.00 79.99878 FORMAT "%8.5" /end CHARACTERISTIC
/begin CHARACTERISTIC DPTLDDU "threshold for detection that pressure obtain target pressure" VALUE 0x8053B678 RB_Val_Ws16 79.99878 p_q0p00122 -40.00000 39.99878 FORMAT "%8.5" /end CHARACTERISTIC
/begin CHARACTERISTIC DTESKZA_GKTEDKX05_CUR "max. compensation gradient for smallest leak detection" CURVE 0x8053B67A RB_Curve_U16_U16 1.562476 pgrad_q2p38Em5 0.00 1.562476 FORMAT "%8.6"
 /begin AXIS_DESCR STD_AXIS fstt_w_msg vol_q0p1_l 4 0.00 6553.500 FORMAT "%8.3" DEPOSIT ABSOLUTE /end AXIS_DESCR
/end CHARACTERISTIC
/begin CHARACTERISTIC DTESKZA_LimpGKTEDKX05_C "max. compensation gradient for smallest leak detection" VALUE 0x8053B68C RB_Val_Wu16 1.562476 pgrad_q2p38Em5 0.00 1.562476 FORMAT "%8.6" /end CHARACTERISTIC
/begin CHARACTERISTIC ENVTDSTOMN "Minimum ambient temperature for check of tank pressure sensor for offset" VALUE 0x8053B442 RB_Val_Ws16 6553.500 Temp_Cels -3549.940 3003.560 FORMAT "%8.3" /end CHARACTERISTIC
/begin CHARACTERISTIC ENVTDSTOMX "Maximum ambient temperature for check of tank pressure sensor for offset" VALUE 0x8053B444 RB_Val_Ws16 6553.500 Temp_Cels -3549.940 3003.560 FORMAT "%8.3" /end CHARACTERISTIC
/begin CHARACTERISTIC ENVTDSTUMN "Minimum ambient temperature for diagnosis of tank pressure sensor" VALUE 0x8053B446 RB_Val_Ws16 6553.500 Temp_Cels -3549.940 3003.560 FORMAT "%8.3" /end CHARACTERISTIC
/begin CHARACTERISTIC ENVTDSTUMX "Maximum ambient temperature for diagnosis of tank pressure sensor" VALUE 0x8053B448 RB_Val_Ws16 6553.500 Temp_Cels -3549.940 3003.560 FORMAT "%8.3" /end CHARACTERISTIC
/begin CHARACTERISTIC EONVDKMN "Min distance at a configurable speed to enable the EONV diag." VALUE 0x8053BCCE RB_Val_Wu16 91020.83 s_q1p3888_m 0.00 91020.83 FORMAT "%8.2" /end CHARACTERISTIC
/begin CHARACTERISTIC EONVEFC "Coefficient used for 0.020"" EWMA calculation when in the failing state" VALUE 0x8053BCBB RB_Val_Wu8 1.000000 fak_ub_b2 0.00 1.000000 FORMAT "%8.6" EXTENDED_LIMITS 0.00 1.992188 /end CHARACTERISTIC
/begin CHARACTERISTIC EONVEFS "start value for EWMA filter" VALUE 0x8053BCBC RB_Val_Wu16 1.999969 fak_uw_b2 0.00 1.999969 FORMAT "%8.6" /end CHARACTERISTIC
/begin CHARACTERISTIC EONVEFT "Threshold value to set out the MIL it is exceeded by EWMA filter result" VALUE 0x8053BCBE RB_Val_Wu16 1.999969 fak_uw_b2 0.00 1.999969 FORMAT "%8.6" /end CHARACTERISTIC
/begin CHARACTERISTIC EONVENFC "Filter coefficient used for 0.020"" EWMA calc. when currently in passing state" VALUE 0x8053BCC0 RB_Val_Wu8 1.000000 fak_ub_b2 0.00 1.000000 FORMAT "%8.6" EXTENDED_LIMITS 0.00 1.992188 /end CHARACTERISTIC
/begin CHARACTERISTIC EONVENFT "The EWMA threshold value that will be used when the system is passing" VALUE 0x8053BCC2 RB_Val_Wu16 1.999969 fak_uw_b2 0.00 1.999969 FORMAT "%8.6" /end CHARACTERISTIC
/begin CHARACTERISTIC EONVETSP "Num EWMA test samples required before diagnostic report a pass" VALUE 0x8053BCC4 RB_Val_Wu8 255.0 dez 0.00 255.0 FORMAT "%5.1" /end CHARACTERISTIC
/begin CHARACTERISTIC EONVFST "Default fuel level for EONV when no external system is present" VALUE 0x8053B8A8 RB_Val_Wu16 6553.500 vol_q0p1_l 0.00 6553.500 FORMAT "%8.3" /end CHARACTERISTIC
/begin CHARACTERISTIC EONVSRS "necessary result of overpressure phase after detecting a pressure peak to finish the diagnosis immediately" VALUE 0x8053B8AA RB_Val_Wu16 0.1499939 fak_uw_b2 0.00 0.1499939 FORMAT "%9.7" EXTENDED_LIMITS 0.00 1.999969 /end CHARACTERISTIC
/begin CHARACTERISTIC EONVSTFT "Threshold value to set the MIL once it is exceeded by EWMA" VALUE 0x8053BCC6 RB_Val_Wu16 1.999969 fak_uw_b2 0.00 1.999969 FORMAT "%8.6" /end CHARACTERISTIC
/begin CHARACTERISTIC Eonv_pPeakMaxRejSuspc_M "maximum pressure threshold for suspicion in the overpressure phase for a pressure pattern, for which there is not enough selectivity between a leak and tight system" MAP 0x8053B8AC RB_Map_U8U16_U16 39.99878 p_q0p00122 0.00 39.99878 FORMAT "%8.5" EXTENDED_LIMITS 0.00 79.99878
 /begin AXIS_DESCR STD_AXIS tumg_msg temp_ub_q0p75_o48 9 -48.0 143.3 FORMAT "%5.1" DEPOSIT ABSOLUTE /end AXIS_DESCR
 /begin AXIS_DESCR STD_AXIS fstteonv_w vol_q0p1_l 15 0.00 6553.500 FORMAT "%8.3" DEPOSIT ABSOLUTE /end AXIS_DESCR
/end CHARACTERISTIC
/begin CHARACTERISTIC Eonv_pPeakMinRejSuspc_M "minimum pressure threshold for suspicion in the overpressure phase for a pressure pattern, for which there is not enough selectivity between a leak and tight system" MAP 0x8053B9E4 RB_Map_U8U16_U16 39.99878 p_q0p00122 0.00 39.99878 FORMAT "%8.5" EXTENDED_LIMITS 0.00 79.99878
 /begin AXIS_DESCR STD_AXIS tumg_msg temp_ub_q0p75_o48 9 -48.0 143.3 FORMAT "%5.1" DEPOSIT ABSOLUTE /end AXIS_DESCR
 /begin AXIS_DESCR STD_AXIS fstteonv_w vol_q0p1_l 15 0.00 6553.500 FORMAT "%8.3" DEPOSIT ABSOLUTE /end AXIS_DESCR
/end CHARACTERISTIC
/begin CHARACTERISTIC Eonv_pThdErrWoEWMA_M "final threshold for pressure difference between overpressure and underpressure phase" MAP 0x8053BB1C RB_Map_S16U16_U16 39.99878 p_q0p00122 0.00 39.99878 FORMAT "%8.5" EXTENDED_LIMITS 0.00 79.99878
 /begin AXIS_DESCR STD_AXIS EnvT_t Temp_Cels 9 -3549.940 3003.560 FORMAT "%8.3" DEPOSIT ABSOLUTE /end AXIS_DESCR
 /begin AXIS_DESCR STD_AXIS fstteonv_w vol_q0p1_l 9 0.00 6553.500 FORMAT "%8.3" DEPOSIT ABSOLUTE /end AXIS_DESCR
/end CHARACTERISTIC
/begin CHARACTERISTIC Eonv_stAlg_C "Codeword for DEONVALG" VALUE 0x8053BBE6 RB_Val_Wu8 255.0 OneToOne 0.00 255.0 FORMAT "%5.1" /end CHARACTERISTIC
/begin CHARACTERISTIC EvapDi_facEthnlMax_C "Max ethanol concentration factor threshold" VALUE 0x8053B492 RB_Val_Wu16 1.999969 fak_uw_b2 0.00 1.999969 FORMAT "%8.6" /end CHARACTERISTIC
/begin CHARACTERISTIC EvapDi_facPGradCalcdThdFlexfu_M "pressure gradient calculation threshold for flexfuel" MAP 0x8053B494 RB_Map_U16U16_U16 1.562476 pgrad_q2p38Em5 0.00 1.562476 FORMAT "%8.6"
 /begin AXIS_DESCR STD_AXIS fstttld_w_msg vol_q0p1_l 10 0.00 6553.500 FORMAT "%8.3" DEPOSIT ABSOLUTE /end AXIS_DESCR
 /begin AXIS_DESCR STD_AXIS TankLeakDiag_facEthnlSensVal fak_uw_b2 6 0.00 1.999969 FORMAT "%8.6" DEPOSIT ABSOLUTE /end AXIS_DESCR
/end CHARACTERISTIC
/begin CHARACTERISTIC EvapDi_flgEthnlSnsrSwt_C "Ethanol sensor switc" VALUE 0x8053B5FC RB_Val_Wboolean 1.00000000000 B_TRUE 0.00 1.00000000000 FORMAT "%13.11" /end CHARACTERISTIC
/begin CHARACTERISTIC EvapDi_stObdOpt_C "Fuel level consideration for OBD-Br3" VALUE 0x8053B5EE RB_Val_Wu8 255.0 OneToOne 0.00 255.0 FORMAT "%5.1" /end CHARACTERISTIC
/begin CHARACTERISTIC FSTDSTOZMX "Maximum fuel tank level for enabling oscillation check" VALUE 0x8053B44A RB_Val_Wu16 6553.500 vol_q0p1_l 0.00 6553.500 FORMAT "%8.3" /end CHARACTERISTIC
/begin CHARACTERISTIC FSTEADENMN "Lower threshold of the hysteresis for the disable condition because of high canister load" VALUE 0x8053B5FE RB_Val_Ws16 127.9980 fak_sw_b64 -64.00000 63.99805 FORMAT "%8.5" /end CHARACTERISTIC
/begin CHARACTERISTIC FSTEADENMX "Upper threshold of the hysteresis for the disable condition because of high canister load" VALUE 0x8053B600 RB_Val_Ws16 127.9980 fak_sw_b64 -64.00000 63.99805 FORMAT "%8.5" /end CHARACTERISTIC
/begin CHARACTERISTIC FSTTTLD "fuel level replacement value from tank leak diagnosis" VALUE 0x8053B68E RB_Val_Wu16 6553.500 vol_q0p1_l 0.00 6553.500 FORMAT "%8.3" /end CHARACTERISTIC
/begin CHARACTERISTIC FTEADSTOMN "max value factor fuel purge adaptation for offset-check tank pressure sensor" VALUE 0x8053B44C RB_Val_Ws16 127.9980 fak_sw_b64 -64.00000 63.99805 FORMAT "%8.5" /end CHARACTERISTIC
/begin CHARACTERISTIC FuEvapLeak_cwCcvPErrIgr_C "Codeword to define which error bits should be considered to set error" VALUE 0x8053B5EF RB_Val_Wu8 255.0 OneToOne 0.00 255.0 FORMAT "%5.1" /end CHARACTERISTIC
/begin CHARACTERISTIC GKTEDKXFA "Max. compensation gradient for smallest leak detection (0.5-mm-check) in EOL testing" VALUE 0x8053B690 RB_Val_Wu16 1.562476 pgrad_q2p38Em5 0.00 1.562476 FORMAT "%8.6" /end CHARACTERISTIC
/begin CHARACTERISTIC GKTEDKXFAG "Max. compensation gradient for smallest leak detection (0.5-mm-check) in garage testing" VALUE 0x8053B692 RB_Val_Wu16 1.562476 pgrad_q2p38Em5 0.00 1.562476 FORMAT "%8.6" /end CHARACTERISTIC
/begin CHARACTERISTIC HPUTEDU "lower pressure threshold for performing of the 0.5mm tank leak diagnosis" VALUE 0x8053B602 RB_Val_Wu16 2559.961 p_uw_q0p039 0.00 2559.961 FORMAT "%8.3" /end CHARACTERISTIC
/begin CHARACTERISTIC IMSTEMNTLD "min. integral of purge mass flow for TLD" VALUE 0x8053B604 RB_Val_Wu8 11.32 m_ub_q0p0444 0.00 11.32 FORMAT "%5.2" /end CHARACTERISTIC
/begin CHARACTERISTIC KFEONVPT "Pressure threshold attainable only by system with leak less than 0.020""" MAP 0x8053BBE8 RB_Map_U8U16_U16 39.84253 p_q0p00122 0.15625 39.99878 FORMAT "%8.5" EXTENDED_LIMITS 0.00 79.99878
 /begin AXIS_DESCR STD_AXIS Eonv_tAmbAir temp_ub_q0p75_o48 9 -48.0 143.3 FORMAT "%5.1" DEPOSIT ABSOLUTE /end AXIS_DESCR
 /begin AXIS_DESCR STD_AXIS fstteonv_w vol_q0p1_l 9 0.00 6553.500 FORMAT "%8.3" DEPOSIT ABSOLUTE /end AXIS_DESCR
/end CHARACTERISTIC
/begin CHARACTERISTIC KFFUTNKCENGT "Map for correcting pressure removal gradiant using coolant temprature in DTESK" MAP 0x8053B530 RB_Map_U16S16_U8 1.992188 fak_ub_b2 0.00 1.992188 FORMAT "%8.6"
 /begin AXIS_DESCR STD_AXIS tnse_w_msg t100msxs_uw_b6553p5 6 0.00 6553.500 FORMAT "%8.3" DEPOSIT ABSOLUTE /end AXIS_DESCR
 /begin AXIS_DESCR STD_AXIS CEngDsT_t Temp_Cels 6 -3549.940 3003.560 FORMAT "%8.3" DEPOSIT ABSOLUTE /end AXIS_DESCR
/end CHARACTERISTIC
/begin CHARACTERISTIC KLDPENVTDUD "Modelled value of environment temperature" CURVE 0x8053B694 RB_Curve_S16_S16 79.99878 p_q0p00122 -40.00000 39.99878 FORMAT "%8.5"
 /begin AXIS_DESCR STD_AXIS EnvT_t Temp_Cels 6 -3549.940 3003.560 FORMAT "%8.3" DEPOSIT ABSOLUTE /end AXIS_DESCR
/end CHARACTERISTIC
/begin CHARACTERISTIC KLENVT "Curve for correcting pressure removal gradiant using Enviornment temprature in DTESK" CURVE 0x8053B570 RB_Curve_S16_U8_Static 1.992188 fak_ub_b2 0.00 1.992188 FORMAT "%8.6"
 /begin AXIS_DESCR STD_AXIS EnvT_t Temp_Cels 6 -3549.940 3003.560 FORMAT "%8.3" DEPOSIT ABSOLUTE /end AXIS_DESCR
/end CHARACTERISTIC
/begin CHARACTERISTIC KLFACCORRALTI "Curve for correcting pressure removal gradiant using altitude change in DTESK" CURVE 0x8053B584 RB_Curve_U16_U8_Static 1.992188 fak_ub_b2 0.00 1.992188 FORMAT "%8.6"
 /begin AXIS_DESCR STD_AXIS PEnv_facCorrAlti fak_uw_b4 6 0.00 3.999939 FORMAT "%8.6" DEPOSIT ABSOLUTE /end AXIS_DESCR
/end CHARACTERISTIC
/begin CHARACTERISTIC KLFSTTEWM "fuel level replacement values depends from integrated CPV-mass flow at vacuum built up" CURVE 0x8053B6AE RB_Curve_U16_U16 6553.500 vol_q0p1_l 0.00 6553.500 FORMAT "%8.3"
 /begin AXIS_DESCR STD_AXIS msnitld_w_msg m_3p47222Em4_g 10 0.00 22.75521 FORMAT "%8.5" DEPOSIT ABSOLUTE /end AXIS_DESCR
/end CHARACTERISTIC
/begin CHARACTERISTIC KLFTEADDTESK "curve line high canister load disabeled tank leak diagnoisi" CURVE 0x8053B606 RB_Curve_U8_S16_Static 127.9980 fak_sw_b64 -64.00000 63.99805 FORMAT "%8.5"
 /begin AXIS_DESCR STD_AXIS PurgLeakDiag_tAmbAir temp_ub_q0p75_o48 8 -48.0 143.3 FORMAT "%5.1" DEPOSIT ABSOLUTE /end AXIS_DESCR
/end CHARACTERISTIC
/begin CHARACTERISTIC KLMSSTLD "characteristic linie requested CPV-Mass-Flow over time for tank leakage diagnosis" CURVE 0x8053B6D8 RB_Curve_U8_U16_Static 25.59961 m_uw_b25p6 0.00 25.59961 FORMAT "%8.5"
 /begin AXIS_DESCR STD_AXIS tdtedps t_q0p1 6 0.00 25.50 FORMAT "%5.2" DEPOSIT ABSOLUTE /end AXIS_DESCR
/end CHARACTERISTIC
/begin CHARACTERISTIC KLTCENGDSTGK05 "time for measurement of compensation gradient (0.5-mm-check)" CURVE 0x8053B6EC RB_Curve_S16_U8_Static 25.50 t_q0p1 0.00 25.50 FORMAT "%5.2"
 /begin AXIS_DESCR STD_AXIS CEngDsT_tStrt Temp_Cels 4 -3549.940 3003.560 FORMAT "%8.3" DEPOSIT ABSOLUTE /end AXIS_DESCR
/end CHARACTERISTIC
/begin CHARACTERISTIC KLTLDSFS05 "Threshold for tank leak diagnosis" CURVE 0x8053B598 RB_CurveGroup_U16 1.562476 pgrad_q2p38Em5 0.00 1.562476 FORMAT "%8.6"
 /begin AXIS_DESCR COM_AXIS fstttld_w_msg vol_q0p1_l 10 0.00 6553.500 FORMAT "%8.3" AXIS_PTS_REF STFST10TLD /end AXIS_DESCR
/end CHARACTERISTIC
/begin CHARACTERISTIC KLTLDSFSFA "Threshold for tank leak diagnosis" CURVE 0x8053B5AC RB_CurveGroup_U16 1.562476 pgrad_q2p38Em5 0.00 1.562476 FORMAT "%8.6"
 /begin AXIS_DESCR COM_AXIS fstttld_w_msg vol_q0p1_l 10 0.00 6553.500 FORMAT "%8.3" AXIS_PTS_REF STFST10TLD /end AXIS_DESCR
/end CHARACTERISTIC
/begin CHARACTERISTIC KLTLDSFSFG "Threshold for tank leak diagnosis in garage" CURVE 0x8053B5C0 RB_CurveGroup_U16 1.562476 pgrad_q2p38Em5 0.00 1.562476 FORMAT "%8.6"
 /begin AXIS_DESCR COM_AXIS fstttld_w_msg vol_q0p1_l 10 0.00 6553.500 FORMAT "%8.3" AXIS_PTS_REF STFST10TLD /end AXIS_DESCR
/end CHARACTERISTIC
/begin CHARACTERISTIC KLTMSTVDDMX05 "maximum duration of vacuum decay (0.5-mm-check)" CURVE 0x8053B6FA RB_Curve_S16_U8_Static 25.50 t_q0p1 0.00 25.50 FORMAT "%5.2"
 /begin AXIS_DESCR STD_AXIS CEngDsT_tStrt Temp_Cels 4 -3549.940 3003.560 FORMAT "%8.3" DEPOSIT ABSOLUTE /end AXIS_DESCR
/end CHARACTERISTIC
/begin CHARACTERISTIC MSIDST "Threshold integrated CPV-mass flow for diagnosis for CPV stuck closed" VALUE 0x8053B708 RB_Val_Wu16 22.75521 m_3p47222Em4_g 0.00 22.75521 FORMAT "%8.5" /end CHARACTERISTIC
/begin CHARACTERISTIC MSNTVMX05 "Threshold of integrated Massflow for rough leak detection at tevschuss (0.5-mm-check)" VALUE 0x8053B70A RB_Val_Wu16 22.75521 m_3p47222Em4_g 0.00 22.75521 FORMAT "%8.5" /end CHARACTERISTIC
/begin CHARACTERISTIC MSTEDSOMNL "minimum threshold for plausibility check" VALUE 0x8053B44E RB_Val_Wu16 25.59961 m_uw_b25p6 0.00 25.59961 FORMAT "%8.5" /end CHARACTERISTIC
/begin CHARACTERISTIC MSTEDSTOMN "min purge mass flow for go on of CPV-plausibility-check" VALUE 0x8053B450 RB_Val_Wu16 25.59961 m_uw_b25p6 0.00 25.59961 FORMAT "%8.5" /end CHARACTERISTIC
/begin CHARACTERISTIC MSTEPOFH "hystere mass flow" VALUE 0x8053B452 RB_Val_Wu16 25.59961 m_uw_b25p6 0.00 25.59961 FORMAT "%8.5" /end CHARACTERISTIC
/begin CHARACTERISTIC MSTEPTOFMN "mass flow for change thresholds" VALUE 0x8053B454 RB_Val_Wu16 25.59961 m_uw_b25p6 0.00 25.59961 FORMAT "%8.5" /end CHARACTERISTIC
/begin CHARACTERISTIC MSTLDTC "Threshold mass flow for complete closing of CPV for Tank Leakage Diagnosis" VALUE 0x8053B70C RB_Val_Wu16 25.59961 m_uw_b25p6 0.00 25.59961 FORMAT "%8.5" /end CHARACTERISTIC
/begin CHARACTERISTIC MXDTESK05 "max. threshold of active-counter for smallest leak diagnosis (0,5mm)" VALUE 0x8053B620 RB_Val_Wu8 255.0 dez 0.00 255.0 FORMAT "%5.1" /end CHARACTERISTIC
/begin CHARACTERISTIC PEONVDFP "decrease/increase in pressure after a peak needed to identify it as a overpressure/vacuum peak" VALUE 0x8053BCA8 RB_Val_Ws16 79.99878 p_q0p00122 -40.00000 39.99878 FORMAT "%8.5" /end CHARACTERISTIC
/begin CHARACTERISTIC PEONVPZERO "boundary at which pressure is considered zero in EONV" VALUE 0x8053BCAA RB_Val_Ws16 79.99878 p_q0p00122 -40.00000 39.99878 FORMAT "%8.5" /end CHARACTERISTIC
/begin CHARACTERISTIC PNDKPUEB "enable threshold for the ratio of pndk_w to pu_w" VALUE 0x8053B621 RB_Val_Wu8 1.992188 fak_ub_b2 0.00 1.992188 FORMAT "%8.6" /end CHARACTERISTIC
/begin CHARACTERISTIC PPRBMX "Lower boundary at which pressure is considered essentially zero" VALUE 0x8053BCAC RB_Val_Ws16 79.99878 p_q0p00122 -40.00000 39.99878 FORMAT "%8.5" /end CHARACTERISTIC
/begin CHARACTERISTIC PSPUDSTMX "maximum quotient: manifold pressure to ambient pressure for plausibility check offset diagnosis tank pressure sensor" VALUE 0x8053B456 RB_Val_Wu8 1.992188 fak_ub_b2 0.00 1.992188 FORMAT "%8.6" /end CHARACTERISTIC
/begin CHARACTERISTIC PSPUTH "enable threshold for the ratio of ps_w/pu_w" VALUE 0x8053B457 RB_Val_Wu8 1.992188 fak_ub_b2 0.00 1.992188 FORMAT "%8.6" /end CHARACTERISTIC
/begin CHARACTERISTIC PTEBPTH "threshold for band pass filtered rectified pressure for slosh detection" VALUE 0x8053BD20 RB_Val_Wu16 79.99878 p_q0p00122 0.00 79.99878 FORMAT "%8.5" /end CHARACTERISTIC
/begin CHARACTERISTIC PTEDE "pressure difference for stabilized tank pressure" VALUE 0x8053B70E RB_Val_Ws16 79.99878 p_q0p00122 -40.00000 39.99878 FORMAT "%8.5" /end CHARACTERISTIC
/begin CHARACTERISTIC PTEDOZ "pressure difference for rationality check of pressure sensor" VALUE 0x8053B458 RB_Val_Wu16 20479.69 p_q0p3125 0.00 20479.69 FORMAT "%8.2" /end CHARACTERISTIC
/begin CHARACTERISTIC PTEINCERMN "Minimum Tank Pressurel for incremental check of Pressure Sensor Diagnosis, enlarged range" VALUE 0x8053B45A RB_Val_Ws16 159.9976 p_sw_q0p00244 -80.00000 79.99756 FORMAT "%8.5" /end CHARACTERISTIC
/begin CHARACTERISTIC PTEINCERMX "Maximum Tank Pressurel for incremental check of Pressure Sensor Diagnosis, enlarged range" VALUE 0x8053B45C RB_Val_Ws16 159.9976 p_sw_q0p00244 -80.00000 79.99756 FORMAT "%8.5" /end CHARACTERISTIC
/begin CHARACTERISTIC PTEKORMN "minimum pressure threshold for operating range of the tank leak diagnosis" VALUE 0x8053B622 RB_Val_Ws16 79.99878 p_q0p00122 -40.00000 39.99878 FORMAT "%8.5" /end CHARACTERISTIC
/begin CHARACTERISTIC PTEKORMX "maximum pressure threshold for operating range of the tank leak diagnosis" VALUE 0x8053B624 RB_Val_Ws16 79.99878 p_q0p00122 -40.00000 39.99878 FORMAT "%8.5" /end CHARACTERISTIC
/begin CHARACTERISTIC PTEKREFMN "minimum value for difference reference value and minimum value tank pressure" VALUE 0x8053B45E RB_Val_Wu16 79.99878 p_q0p00122 0.00 79.99878 FORMAT "%8.5" /end CHARACTERISTIC
/begin CHARACTERISTIC PTEKREFMNL "minimum change for pressure because of CPV open and close" VALUE 0x8053B460 RB_Val_Wu16 79.99878 p_q0p00122 0.00 79.99878 FORMAT "%8.5" /end CHARACTERISTIC
/begin CHARACTERISTIC PTEKREFMX "max. deviation 1. reference value to 2. reference value tank pressure" VALUE 0x8053B462 RB_Val_Wu16 79.99878 p_q0p00122 0.00 79.99878 FORMAT "%8.5" /end CHARACTERISTIC
/begin CHARACTERISTIC PUEONVMN "min ambient pressure for EONV diagnostic" VALUE 0x8053BCD0 RB_Val_Wu8 1275. p_ub_q5 0.00 1275. FORMAT "%5.0" /end CHARACTERISTIC
/begin CHARACTERISTIC PUREFDMX "max deviation Ambient pressure to reference pressure" VALUE 0x8053B464 RB_Val_Wu16 2559.961 p_uw_q0p039 0.00 2559.961 FORMAT "%8.3" /end CHARACTERISTIC
/begin CHARACTERISTIC PurgeLeakDiag_mfIntegdCpv_C "Threshold integrated CPV-mass flow for detection of CPV is sticked with some foreign substances after long term usage" VALUE 0x8053B710 RB_Val_Wu16 22.75521 m_3p47222Em4_g 0.00 22.75521 FORMAT "%8.5" /end CHARACTERISTIC
/begin CHARACTERISTIC PurgLeakDiag_facEthMaxEonv_C "Max. ethanol content in fuel for tank leakage diagnosis through EONV" VALUE 0x8053BCD2 RB_Val_Wu16 1.999969 fak_uw_b2 0.00 1.999969 FORMAT "%8.6" /end CHARACTERISTIC
/begin CHARACTERISTIC PurgLeakDiag_facIncCpvMf_T "Factor to increase mass flow request of the purge valve during dtesk diagnosis" CURVE 0x8053B712 RB_Curve_U16_U16 25.59961 fak_uw_b25p6 0.00 25.59961 FORMAT "%8.5"
 /begin AXIS_DESCR STD_AXIS msnitld_w_msg m_3p47222Em4_g 6 0.00 22.75521 FORMAT "%8.5" DEPOSIT ABSOLUTE /end AXIS_DESCR
/end CHARACTERISTIC
/begin CHARACTERISTIC PurgLeakDiag_flgDlyEonvEngOff_C "Usage of engine-off time for calculation of afterrun-delay time until start of EONV diagnosis" VALUE 0x8053BCD4 RB_Val_Wboolean 1.00000000000 B_TRUE 0.00 1.00000000000 FORMAT "%13.11" /end CHARACTERISTIC
/begin CHARACTERISTIC PurgLeakDiag_mfMinIntegdVacPha_T "minimum integrated massflow during vaccum phase" CURVE 0x8053B72C RB_Curve_U16_U16 22.75521 m_3p47222Em4_g 0.00 22.75521 FORMAT "%8.5"
 /begin AXIS_DESCR STD_AXIS fstttld_w_msg vol_q0p1_l 10 0.00 6553.500 FORMAT "%8.3" DEPOSIT ABSOLUTE /end AXIS_DESCR
/end CHARACTERISTIC
/begin CHARACTERISTIC PurgLeakDiag_tAbortDlyEol_C "Delay tim for next diagnosis after internal abortion, during tester request" VALUE 0x8053B626 RB_Val_Wu16 6553.500 t_q0p1 0.00 6553.500 FORMAT "%8.3" /end CHARACTERISTIC
/begin CHARACTERISTIC PurgLeakDiag_ThdTarPEOL_M "Target pressure threshold for EOL" MAP 0x8053B756 RB_Map_U16S16_S16 79.99878 p_q0p00122 -40.00000 39.99878 FORMAT "%8.5"
 /begin AXIS_DESCR STD_AXIS fstt_w_msg vol_q0p1_l 10 0.00 6553.500 FORMAT "%8.3" DEPOSIT ABSOLUTE /end AXIS_DESCR
 /begin AXIS_DESCR STD_AXIS EnvT_t Temp_Cels 6 -3549.940 3003.560 FORMAT "%8.3" DEPOSIT ABSOLUTE /end AXIS_DESCR
/end CHARACTERISTIC
/begin CHARACTERISTIC PurgLeakDiag_ThdTarP_M "Target pressure threshold" MAP 0x8053B7F2 RB_Map_U16S16_S16 79.99878 p_q0p00122 -40.00000 39.99878 FORMAT "%8.5"
 /begin AXIS_DESCR STD_AXIS fstt_w_msg vol_q0p1_l 10 0.00 6553.500 FORMAT "%8.3" DEPOSIT ABSOLUTE /end AXIS_DESCR
 /begin AXIS_DESCR STD_AXIS EnvT_t Temp_Cels 6 -3549.940 3003.560 FORMAT "%8.3" DEPOSIT ABSOLUTE /end AXIS_DESCR
/end CHARACTERISTIC
/begin CHARACTERISTIC PurgLeakDiag_tiColdStrtEngOffMin_C "Minimum engine off time for cold start detection DTESK" VALUE 0x8053B628 RB_Val_Ws32 4294967295.00 Time_sec_q1_COMPU -2147483648.00 2147483647.00 FORMAT "%13.2" /end CHARACTERISTIC
/begin CHARACTERISTIC PurgLeakDiag_tiDlyEonvDiag_T "Afterrun-delay time until tank leakage diagnosis start through EONV" CURVE 0x8053BCD6 RB_Curve_S16_U16_Static 6553.500 t_q0p1 0.00 6553.500 FORMAT "%8.3"
 /begin AXIS_DESCR STD_AXIS EnvT_t Temp_Cels 6 -3549.940 3003.560 FORMAT "%8.3" DEPOSIT ABSOLUTE /end AXIS_DESCR
/end CHARACTERISTIC
/begin CHARACTERISTIC PurgLeakDiag_vMaxPrio_C "Velocity threshold of the car, under which a stop inhibit is requested" VALUE 0x8053B62C RB_Val_Wu16 511.9922 vfzg_uw_b512 0.00 511.9922 FORMAT "%8.4" /end CHARACTERISTIC
/begin CHARACTERISTIC PurgLeakDiag_volDiagBlkdLineErrThd_C "Error threshold of the calculated free gas valume of the EVAP system for the blocked line diagnosis, to detect a blocked line error" VALUE 0x8053B88E RB_Val_Wu16 655.3500 vol_q0p01_l 0.00 655.3500 FORMAT "%8.4" /end CHARACTERISTIC
/begin CHARACTERISTIC PUTEDO "maximum threshold for change of the ambient pressure" VALUE 0x8053B62E RB_Val_Wu16 2559.961 p_uw_q0p039 0.00 2559.961 FORMAT "%8.3" /end CHARACTERISTIC
/begin CHARACTERISTIC PVACBMN "Lower boundary at which vacuum is considered to be building" VALUE 0x8053BCAE RB_Val_Ws16 79.99878 p_q0p00122 -40.00000 39.99878 FORMAT "%8.5" /end CHARACTERISTIC
/begin CHARACTERISTIC SDMGLVU "lower threshold of driving distance from refueling to supposed rough leak" VALUE 0x8053B5F0 RB_Val_Wu16 1820.417 s_q0p02777_m 0.00 1820.417 FORMAT "%8.3" /end CHARACTERISTIC
/begin CHARACTERISTIC SEONVDISMN "required minimum distance for EONV start by tester" VALUE 0x8053BD12 RB_Val_Wu16 91020.83 s_q1p3888_m 0.00 91020.83 FORMAT "%8.2" /end CHARACTERISTIC
/begin CHARACTERISTIC SFEONVA "threshold of canister load factor for EONV abortion" VALUE 0x8053BCF0 RB_Val_Ws16 127.9980 fak_sw_b64 -64.00000 63.99805 FORMAT "%8.5" /end CHARACTERISTIC
/begin CHARACTERISTIC SFEONVAR "threshold of canister load factor for reset EONV abortion" VALUE 0x8053BCF2 RB_Val_Ws16 127.9980 fak_sw_b64 -64.00000 63.99805 FORMAT "%8.5" /end CHARACTERISTIC
/begin CHARACTERISTIC SFTEDA05 "max. threshold of HC-charge for allowed leak diagnose (0.5mm check)" VALUE 0x8053B630 RB_Val_Ws16 127.9980 fak_sw_b64 -64.00000 63.99805 FORMAT "%8.5" /end CHARACTERISTIC
/begin CHARACTERISTIC SFTEDA05FA "max. threshold of HC-charge for allowed leak diagnose (0.5mm check) at tester request" VALUE 0x8053B632 RB_Val_Ws16 127.9980 fak_sw_b64 -64.00000 63.99805 FORMAT "%8.5" /end CHARACTERISTIC
/begin CHARACTERISTIC SFTEDAO05 "upper threshold of HC-charge for allowed leak diagnose (0.5mm check)" VALUE 0x8053B634 RB_Val_Ws16 127.9980 fak_sw_b64 -64.00000 63.99805 FORMAT "%8.5" /end CHARACTERISTIC
/begin AXIS_PTS STFST10TLD "Steps of fuel level for tank leakage diagnosis" 0x8053B5D4 fstttld_w_msg RB_Axis_U16 6553.500 vol_q0p1_l 10 0.00 6553.500 FORMAT "%8.3" DEPOSIT ABSOLUTE /end AXIS_PTS
/begin CHARACTERISTIC TABORDELAY "Delay tim for next diagnosis after internal abortion" VALUE 0x8053B636 RB_Val_Wu16 6553.500 t_q0p1 0.00 6553.500 FORMAT "%8.3" /end CHARACTERISTIC
/begin CHARACTERISTIC TBPVACMN "The minimum time to wait between Phase 1 and Phase 2" VALUE 0x8053BD0C RB_Val_Wu16 6553.500 t_q0p1 0.00 6553.500 FORMAT "%8.3" /end CHARACTERISTIC
/begin CHARACTERISTIC TCOOLMN "Min. coolant temperarure to be sure that the engine has warmed up" VALUE 0x8053BCF4 RB_Val_Wu8 191.3 temp_ub_q0p75_o48 -48.0 143.3 FORMAT "%5.1" /end CHARACTERISTIC
/begin CHARACTERISTIC TDCPVPOF "minimum time after pressure change" VALUE 0x8053B466 RB_Val_Wu16 6553.500 t_q0p1 0.00 6553.500 FORMAT "%8.3" /end CHARACTERISTIC
/begin CHARACTERISTIC TDDPTETA "time constant for detection of refueling process" VALUE 0x8053B5F2 RB_Val_Wu8 25.50 t_q0p1 0.00 25.50 FORMAT "%5.2" /end CHARACTERISTIC
/begin CHARACTERISTIC TDDSTCON "debouncing time for AAV-opening at tank pressure sensor" VALUE 0x8053B468 RB_Val_Wu8 25.50 t_q0p1 0.00 25.50 FORMAT "%5.2" /end CHARACTERISTIC
/begin CHARACTERISTIC TDDSTCPVA "debounce time for CPV active phase" VALUE 0x8053B469 RB_Val_Wu8 25.50 t_q0p1 0.00 25.50 FORMAT "%5.2" /end CHARACTERISTIC
/begin CHARACTERISTIC TDDSTCPVIA "debounce time for CPV inactive phase" VALUE 0x8053B46A RB_Val_Wu8 25.50 t_q0p1 0.00 25.50 FORMAT "%5.2" /end CHARACTERISTIC
/begin CHARACTERISTIC TDDSTD "Debounce time for check of tank pressure sensor for drift" VALUE 0x8053B46B RB_Val_Wu8 25.50 t_q0p1 0.00 25.50 FORMAT "%5.2" /end CHARACTERISTIC
/begin CHARACTERISTIC TDDSTMSTE "time constant mass flow filtering" VALUE 0x8053B46C RB_Val_Wu16 6553.4999985 zk100msxs_uw_b6553p6 0.1000015 6553.6000000 FORMAT "%12.7" EXTENDED_LIMITS 0.10000152590 6553.6000000 /end CHARACTERISTIC
/begin CHARACTERISTIC TDDSTPTEK "time constant pressure filtering" VALUE 0x8053B46E RB_Val_Wu16 655.34999985 zk10msxs_uw_b655p36 0.01000015 655.36000000 FORMAT "%12.8" EXTENDED_LIMITS 0.010000152590 655.36000000 /end CHARACTERISTIC
/begin CHARACTERISTIC TDIAGMX "The elapsed time allowed to execute the EONV Diagnostic" VALUE 0x8053BCB0 RB_Val_Wu16 6553.500 t_q0p1 0.00 6553.500 FORMAT "%8.3" /end CHARACTERISTIC
/begin CHARACTERISTIC TDIFEONVMX "max. temperature-difference for EONV diagnosis" VALUE 0x8053BCF5 RB_Val_Wu8 191.3 temp_ub_q0p75 0.00 191.3 FORMAT "%5.1" /end CHARACTERISTIC
/begin CHARACTERISTIC TDPTEKH "time constant pressure filtering" VALUE 0x8053B470 RB_Val_Wu16 655.34999985 zk10msxs_uw_b655p36 0.01000015 655.36000000 FORMAT "%12.8" EXTENDED_LIMITS 0.010000152590 655.36000000 /end CHARACTERISTIC
/begin CHARACTERISTIC TDPURE "reset time during changes of the ambient pressure" VALUE 0x8053B638 RB_Val_Wu16 6553.500 t_q0p1 0.00 6553.500 FORMAT "%8.3" /end CHARACTERISTIC
/begin CHARACTERISTIC TDSTPTEKS "time constant pressure filtering" VALUE 0x8053B472 RB_Val_Wu16 655.34999985 zk10msxs_uw_b655p36 0.01000015 655.36000000 FORMAT "%12.8" EXTENDED_LIMITS 0.010000152590 655.36000000 /end CHARACTERISTIC
/begin CHARACTERISTIC TDTED "time out for detection of tight purge system" VALUE 0x8053B890 RB_Val_Wu8 25.50 t_q0p1 0.00 25.50 FORMAT "%5.2" /end CHARACTERISTIC
/begin CHARACTERISTIC TDTESKOFF "Turn on delay time for DTESK Off" VALUE 0x8053B474 RB_Val_Wu8 25.50 t_q0p1 0.00 25.50 FORMAT "%5.2" /end CHARACTERISTIC
/begin CHARACTERISTIC TDTHPTEK "Filterconstant for the filter to calculate the tank pressure difference" VALUE 0x8053B476 RB_Val_Wu16 655.34999985 zk10msxs_uw_b655p36 0.01000015 655.36000000 FORMAT "%12.8" EXTENDED_LIMITS 0.010000152590 655.36000000 /end CHARACTERISTIC
/begin CHARACTERISTIC TDTLDFSTVE "delay time for information fuel level valid in driving distance debouncing EONV" VALUE 0x8053BCC8 RB_Val_Wu8 25.50 t_q0p1 0.00 25.50 FORMAT "%5.2" /end CHARACTERISTIC
/begin CHARACTERISTIC TDTLIN "time window for linearisation check for tank leakage diagnosis" VALUE 0x8053B891 RB_Val_Wu8 25.50 t_q0p1 0.00 25.50 FORMAT "%5.2" /end CHARACTERISTIC
/begin CHARACTERISTIC TEDSTO "debounce time for direct setting offset-failure tank pressure sensor" VALUE 0x8053B478 RB_Val_Wu8 25.50 t_q0p1 0.00 25.50 FORMAT "%5.2" /end CHARACTERISTIC
/begin CHARACTERISTIC TEFABE "Duration diagnosis-systemtest at end of line" VALUE 0x8053B89E RB_Val_Wu16 393210.0 t6minxmin_q6 0.00 393210.0 FORMAT "%8.1" /end CHARACTERISTIC
/begin CHARACTERISTIC TEONVAHMN "Lower boundary of the ambient air temperature window by hot start used to enable EONV" VALUE 0x8053BD14 RB_Val_Wu8 191.3 temp_ub_q0p75_o48 -48.0 143.3 FORMAT "%5.1" /end CHARACTERISTIC
/begin CHARACTERISTIC TEONVAHMX "Upper boundary of the ambient air temperature window by hot start used to enable EONV" VALUE 0x8053BD15 RB_Val_Wu8 191.3 temp_ub_q0p75_o48 -48.0 143.3 FORMAT "%5.1" /end CHARACTERISTIC
/begin CHARACTERISTIC TEONVAMN "Lower boundary of the ambient air temperature window by cold start used to enable EONV" VALUE 0x8053BCF6 RB_Val_Wu8 191.3 temp_ub_q0p75_o48 -48.0 143.3 FORMAT "%5.1" /end CHARACTERISTIC
/begin CHARACTERISTIC TEONVAMX "Upper boundary of the ambient air temperature window by cold start used to enable EONV" VALUE 0x8053BCF7 RB_Val_Wu8 191.3 temp_ub_q0p75_o48 -48.0 143.3 FORMAT "%5.1" /end CHARACTERISTIC
/begin CHARACTERISTIC TEONVCSMX "DEONV Enable condition hold time." VALUE 0x8053BCF8 RB_Val_Wu16 262140.0 t_q4_s 0.00 262140.0 FORMAT "%8.1" /end CHARACTERISTIC
/begin CHARACTERISTIC TEONVDFP "time decrease/increase in pressure after a peak needed to identify it as a overpressure/vacuum" VALUE 0x8053BCB2 RB_Val_Wu16 6553.500 t_q0p1 0.00 6553.500 FORMAT "%8.3" /end CHARACTERISTIC
/begin CHARACTERISTIC TEONVERTMN "minimum engine run time for EONV start by tester" VALUE 0x8053BD16 RB_Val_Wu16 6553.500 t_q0p1 0.00 6553.500 FORMAT "%8.3" /end CHARACTERISTIC
/begin CHARACTERISTIC TEONVST "time used to indicate the pressure has stabilized at zero (EONV-diagn.)" VALUE 0x8053BCB4 RB_Val_Wu16 6553.500 t_q0p1 0.00 6553.500 FORMAT "%8.3" /end CHARACTERISTIC
/begin CHARACTERISTIC TEONVVACBP "Time unsed to indicate the Phase 1 vacuum build (EONV-diagnostic)" VALUE 0x8053BCB6 RB_Val_Wu8 25.50 t_q0p1 0.00 25.50 FORMAT "%5.2" /end CHARACTERISTIC
/begin CHARACTERISTIC TERMN "Min. Engine run time to start EONV to be sure engine has warmed up" VALUE 0x8053BCFA RB_Val_Wu16 6553.500 t_q0p1 0.00 6553.500 FORMAT "%8.3" /end CHARACTERISTIC
/begin CHARACTERISTIC TFATLDMX "max. duration for tank leak diagnosis systemtest at end of line" VALUE 0x8053B8A0 RB_Val_Wu16 6553.500 t_q0p1 0.00 6553.500 FORMAT "%8.3" /end CHARACTERISTIC
/begin CHARACTERISTIC TFATLDMXEOL "max. duration for tank leak diagnosis system test at end of line during EOL test request" VALUE 0x8053B8A2 RB_Val_Wu16 6553.500 t_q0p1 0.00 6553.500 FORMAT "%8.3" /end CHARACTERISTIC
/begin CHARACTERISTIC TLDPTFFA "fast filter time constant for low pass filtering of fuel tank pressure" VALUE 0x8053BD22 RB_Val_Wu16 655.34999985 zk10msxs_uw_b655p36 0.01000015 655.36000000 FORMAT "%12.8" EXTENDED_LIMITS 0.010000152590 655.36000000 /end CHARACTERISTIC
/begin CHARACTERISTIC TLDPTFHP "filter time constant for high pass filtering of fuel tank pressure" VALUE 0x8053BD24 RB_Val_Wu16 6553.4999985 zk100msxs_uw_b6553p6 0.1000015 6553.6000000 FORMAT "%12.7" EXTENDED_LIMITS 0.10000152590 6553.6000000 /end CHARACTERISTIC
/begin CHARACTERISTIC TLDPTFNO "filter time constant for noise reduction of fuel tank pressure signal" VALUE 0x8053BD26 RB_Val_Wu16 655.34999985 zk10msxs_uw_b655p36 0.01000015 655.36000000 FORMAT "%12.8" EXTENDED_LIMITS 0.010000152590 655.36000000 /end CHARACTERISTIC
/begin CHARACTERISTIC TLDPTFSH "filter constant for tank pressure high pass filtering for slosh detection" VALUE 0x8053BD28 RB_Val_Wu16 6553.4999985 zk100msxs_uw_b6553p6 0.1000015 6553.6000000 FORMAT "%12.7" EXTENDED_LIMITS 0.10000152590 6553.6000000 /end CHARACTERISTIC
/begin CHARACTERISTIC TLDPTFSL "slow filter time constant for low pass filtering of fuel tank pressure" VALUE 0x8053BD2A RB_Val_Wu16 655.34999985 zk10msxs_uw_b655p36 0.01000015 655.36000000 FORMAT "%12.8" EXTENDED_LIMITS 0.010000152590 655.36000000 /end CHARACTERISTIC
/begin CHARACTERISTIC TMNHTOHTLD "minimum time between two halts for new request of TLD" VALUE 0x8053B63A RB_Val_Wu8 25.50 t_q0p1 0.00 25.50 FORMAT "%5.2" /end CHARACTERISTIC
/begin CHARACTERISTIC TMSEONVMX "max. engine-temperature threshold for EONV diagnosis" VALUE 0x8053BCFC RB_Val_Wu8 191.3 temp_ub_q0p75_o48 -48.0 143.3 FORMAT "%5.1" /end CHARACTERISTIC
/begin CHARACTERISTIC TMSEONVTMX "maximum engine temperature for EONV start by tester" VALUE 0x8053BD18 RB_Val_Wu8 191.3 temp_ub_q0p75_o48 -48.0 143.3 FORMAT "%5.1" /end CHARACTERISTIC
/begin CHARACTERISTIC TMSTLDHB05 "Engine start temperature for direct disabling of tank leak diagnosis by high evaporation (0.5mm test)" VALUE 0x8053B63B RB_Val_Wu8 191.3 temp_ub_q0p75_o48 -48.0 143.3 FORMAT "%5.1" /end CHARACTERISTIC
/begin CHARACTERISTIC TMSTLDMN05 "Minimum engine start temperature for enabling tank leak diagnosis 0.5mm test" VALUE 0x8053B63C RB_Val_Wu8 191.3 temp_ub_q0p75_o48 -48.0 143.3 FORMAT "%5.1" /end CHARACTERISTIC
/begin CHARACTERISTIC TMSTLDMX05 "Maximum engine start temperature for enabling tank leak diagnosis 0.5mm test" VALUE 0x8053B63D RB_Val_Wu8 191.3 temp_ub_q0p75_o48 -48.0 143.3 FORMAT "%5.1" /end CHARACTERISTIC
/begin CHARACTERISTIC TNODTES "time after engine start prohibition of TE diagnosis" VALUE 0x8053B63E RB_Val_Wu16 6553.500 t_q0p1 0.00 6553.500 FORMAT "%8.3" /end CHARACTERISTIC
/begin CHARACTERISTIC TNSETLD05 "time threshold after start end for enabling 0.5mm tank leak diagnosis" VALUE 0x8053B640 RB_Val_Wu16 6553.500 t_q0p1 0.00 6553.500 FORMAT "%8.3" /end CHARACTERISTIC
/begin CHARACTERISTIC TOCVVACP "Open time for canister vent after pressure build in Phase 2" VALUE 0x8053BD0E RB_Val_Wu16 6553.500 t_q0p1 0.00 6553.500 FORMAT "%8.3" /end CHARACTERISTIC
/begin CHARACTERISTIC TPMMX "Max. time to execute the pressure monitoring of the EONV Diag." VALUE 0x8053BCB8 RB_Val_Wu16 6553.500 t_q0p1 0.00 6553.500 FORMAT "%8.3" /end CHARACTERISTIC
/begin CHARACTERISTIC TPTEE05 "time for detection of stabilized tank pressure (0.5-mm-check)" VALUE 0x8053B892 RB_Val_Wu8 25.50 t_q0p1 0.00 25.50 FORMAT "%5.2" /end CHARACTERISTIC
/begin CHARACTERISTIC TPTEEBMX "maximum waiting time for detection of stabilized tank pressure" VALUE 0x8053B893 RB_Val_Wu8 25.50 t_q0p1 0.00 25.50 FORMAT "%5.2" /end CHARACTERISTIC
/begin CHARACTERISTIC TPTEKSTOMX "time window for calculation ptekref_w" VALUE 0x8053B479 RB_Val_Wu8 25.50 t_q0p1 0.00 25.50 FORMAT "%5.2" /end CHARACTERISTIC
/begin CHARACTERISTIC TPUREFDSMX "maximum time for pressure change" VALUE 0x8053B47A RB_Val_Wu16 6553.500 t_q0p1 0.00 6553.500 FORMAT "%8.3" /end CHARACTERISTIC
/begin CHARACTERISTIC TPUTEDSV "timer start value for change of ambient pressure" VALUE 0x8053B642 RB_Val_Wu16 6553.500 t_q0p1 0.00 6553.500 FORMAT "%8.3" /end CHARACTERISTIC
/begin CHARACTERISTIC TRIRVFZG "debounce time reset of idle request either stop disable depending of vehicle speed" VALUE 0x8053B644 RB_Val_Wu8 25.50 t_q0p1 0.00 25.50 FORMAT "%5.2" /end CHARACTERISTIC
/begin CHARACTERISTIC TSTDSTO "debounce time switch on condition offset-diagnosis tank pressure sensor" VALUE 0x8053B47C RB_Val_Wu8 25.50 t_q0p1 0.00 25.50 FORMAT "%5.2" /end CHARACTERISTIC
/begin CHARACTERISTIC TSTPTLD "Delay time for decision Tank Leakage Diagnosis can not run" VALUE 0x8053B8A4 RB_Val_Wu8 25.50 t_q0p1 0.00 25.50 FORMAT "%5.2" /end CHARACTERISTIC
/begin CHARACTERISTIC TTDSTDST "Delay time for enable conditions of check of tank pressure sensor for drift" VALUE 0x8053B47D RB_Val_Wu8 25.50 t_q0p1 0.00 25.50 FORMAT "%5.2" /end CHARACTERISTIC
/begin CHARACTERISTIC TTDSTP "time period for stabilization of low pass" VALUE 0x8053B47E RB_Val_Wu8 25.50 t_q0p1 0.00 25.50 FORMAT "%5.2" /end CHARACTERISTIC
/begin CHARACTERISTIC TTDTESKSTO "maximum waiting time for request of engine running via DTESK" VALUE 0x8053B646 RB_Val_Wu16 6553.500 t_q0p1 0.00 6553.500 FORMAT "%8.3" /end CHARACTERISTIC
/begin CHARACTERISTIC TTEDFTE05 "canister load is lower a threshold for this time (0.5mm)" VALUE 0x8053B648 RB_Val_Wu16 6553.500 t_q0p1 0.00 6553.500 FORMAT "%8.3" /end CHARACTERISTIC
/begin CHARACTERISTIC TTEDFTEO05 "high canister load is lower a threshold for this time (0.5mm)" VALUE 0x8053B64A RB_Val_Wu16 6553.500 t_q0p1 0.00 6553.500 FORMAT "%8.3" /end CHARACTERISTIC
/begin CHARACTERISTIC TTEDOZ "minimum test time for rationality check of pressure sensor" VALUE 0x8053B47F RB_Val_Wu8 25.50 t_q0p1 0.00 25.50 FORMAT "%5.2" /end CHARACTERISTIC
/begin CHARACTERISTIC TTEDOZG "overall test time for rationality check of pressure sensor" VALUE 0x8053B480 RB_Val_Wu8 25.50 t_q0p1 0.00 25.50 FORMAT "%5.2" /end CHARACTERISTIC
/begin CHARACTERISTIC TTEDWD05 "waiting time before measurement of vacuum decay gradient (0.5-mm-Prüfung)" VALUE 0x8053B894 RB_Val_Wu8 25.50 t_q0p1 0.00 25.50 FORMAT "%5.2" /end CHARACTERISTIC
/begin CHARACTERISTIC TTEDWU "waiting time if pressure sensor at lower limit" VALUE 0x8053B895 RB_Val_Wu8 25.50 t_q0p1 0.00 25.50 FORMAT "%5.2" /end CHARACTERISTIC
/begin CHARACTERISTIC TTENCT05 "delay time for display the purge period (0.5mm check)" VALUE 0x8053B64C RB_Val_Wu16 6553.500 t_q0p1 0.00 6553.500 FORMAT "%8.3" /end CHARACTERISTIC
/begin CHARACTERISTIC TTENOT05 "max. time since last purge period (0.5mm check)" VALUE 0x8053B64E RB_Val_Wu16 6553.500 t_q0p1 0.00 6553.500 FORMAT "%8.3" /end CHARACTERISTIC
/begin CHARACTERISTIC TTFTEADPTF "time constant for filtering of the canister load factor" VALUE 0x8053B650 RB_Val_Wu16 6553.4999985 zk100msxs_uw_b6553p6 0.1000015 6553.6000000 FORMAT "%12.7" EXTENDED_LIMITS 0.10000152590 6553.6000000 /end CHARACTERISTIC
/begin CHARACTERISTIC TTLDFRRS "time for take-back the lambda controller reset from tank leak diagnosis" VALUE 0x8053B896 RB_Val_Wu8 25.50 t_q0p1 0.00 25.50 FORMAT "%5.2" /end CHARACTERISTIC
/begin CHARACTERISTIC TTLDFRRW "Delay time for lambda-controller reset after TEV closing" VALUE 0x8053B897 RB_Val_Wu8 25.50 t_q0p1 0.00 25.50 FORMAT "%5.2" /end CHARACTERISTIC
/begin CHARACTERISTIC TTLDVNL "ECU switch off delay after end of tank leak diagnosis" VALUE 0x8053BCFD RB_Val_Wu8 25.50 t_q0p1 0.00 25.50 FORMAT "%5.2" /end CHARACTERISTIC
/begin CHARACTERISTIC TTLDVNLST "ECU switch off delay after end of tank leak diagnosis in case of service bay test" VALUE 0x8053BCFE RB_Val_Wu16 6553.500 t_q0p1 0.00 6553.500 FORMAT "%8.3" /end CHARACTERISTIC
/begin CHARACTERISTIC TUMSRVTLDO "upper thrshold ambient temperatur" VALUE 0x8053B652 RB_Val_Wu8 191.3 temp_ub_q0p75_o48 -48.0 143.3 FORMAT "%5.1" /end CHARACTERISTIC
/begin CHARACTERISTIC TUMSRVTLDU "lower threshold ambient temperature" VALUE 0x8053B653 RB_Val_Wu8 191.3 temp_ub_q0p75_o48 -48.0 143.3 FORMAT "%5.1" /end CHARACTERISTIC
/begin CHARACTERISTIC TUMTHEB "Ambient temperature limit for tank leak diagnosis" VALUE 0x8053B654 RB_Val_Wu8 191.3 temp_ub_q0p75 0.00 191.3 FORMAT "%5.1" /end CHARACTERISTIC
/begin CHARACTERISTIC TUMTLDO "upper TUMG-threshold for evap system monitoring" VALUE 0x8053B655 RB_Val_Wu8 191.3 temp_ub_q0p75_o48 -48.0 143.3 FORMAT "%5.1" /end CHARACTERISTIC
/begin CHARACTERISTIC TUMTLDU "lower TUMG-threshold for evap system monitoring" VALUE 0x8053B656 RB_Val_Wu8 191.3 temp_ub_q0p75_o48 -48.0 143.3 FORMAT "%5.1" /end CHARACTERISTIC
/begin CHARACTERISTIC TVAAV05 "delay time before closing of canister vent valve (0.5-mm-check)" VALUE 0x8053B898 RB_Val_Wu8 25.50 t_q0p1 0.00 25.50 FORMAT "%5.2" /end CHARACTERISTIC
/begin CHARACTERISTIC TWDTESKF "wating time from finish DTESK until start EONV" VALUE 0x8053BD00 RB_Val_Wu8 25.50 t_q0p1 0.00 25.50 FORMAT "%5.2" /end CHARACTERISTIC
/begin CHARACTERISTIC TWEONVHCLR "delay time for reset EONV abortion because of high canister load" VALUE 0x8053BD02 RB_Val_Wu16 65535.00 t_q1 0.00 65535.00 FORMAT "%8.2" /end CHARACTERISTIC
/begin CHARACTERISTIC TWTEFBPW "waiting time for switching filter time contants of band filter (word)" VALUE 0x8053BD2C RB_Val_Wu8 25.50 t_q0p1 0.00 25.50 FORMAT "%5.2" /end CHARACTERISTIC
/begin CHARACTERISTIC UBEONVMN "Min. system voltage below which EONV Diagnoses is not enabled" VALUE 0x8053BD04 RB_Val_Wu8 25.50 spg_q0p1 0.00 25.50 FORMAT "%5.2" /end CHARACTERISTIC
/begin CHARACTERISTIC UBTEDO "maximum battery voltage for diagnosis" VALUE 0x8053B658 RB_Val_Wu16 25.59961 spg_q0p00039 0.00 25.59961 FORMAT "%8.5" /end CHARACTERISTIC
/begin CHARACTERISTIC UBTEDU "minimum battery voltage for evap leakage diagnosis" VALUE 0x8053B65A RB_Val_Wu16 25.59961 spg_q0p00039 0.00 25.59961 FORMAT "%8.5" /end CHARACTERISTIC
/begin CHARACTERISTIC VEHDDSTOMN "minimum vehicle acceleration during inactive CPV-phase" VALUE 0x8053B482 RB_Val_Ws16 655.3500 Vel -327.6800 327.6700 FORMAT "%8.4" /end CHARACTERISTIC
/begin CHARACTERISTIC VEHDDSTOMX "maximum vehicle acceleration during inactive CPV-phase" VALUE 0x8053B484 RB_Val_Ws16 655.3500 Vel -327.6800 327.6700 FORMAT "%8.4" /end CHARACTERISTIC
/begin CHARACTERISTIC VEHDSTMN "minimum velocity for plausibility check of the tank pressure sensor" VALUE 0x8053B486 RB_Val_Ws16 655.3500 Vel -327.6800 327.6700 FORMAT "%8.4" /end CHARACTERISTIC
/begin CHARACTERISTIC VEHDSTMX "maximum velocity for plausibility check of the tank pressure sensor" VALUE 0x8053B488 RB_Val_Ws16 655.3500 Vel -327.6800 327.6700 FORMAT "%8.4" /end CHARACTERISTIC
/begin CHARACTERISTIC VehMot_tqWhlDftlProtn_C "Differential protection torque at wheel level" VALUE 0x8053BD30 RB_Val_Ws32 429496729.500 Trq -214748364.800 214748364.700 FORMAT "%13.3" /end CHARACTERISTIC
/begin CHARACTERISTIC VFZGGDSOMX "maximum speed change for offset tank pressure diagnosis" VALUE 0x8053B48A RB_Val_Wu16 1422.201 acc_q0p021701_m_DIV_s2 0.00 1422.201 FORMAT "%8.3" /end CHARACTERISTIC
/begin CHARACTERISTIC VFZGGDSTMX "maximum vehicle acceleration during inactive CPV-phase" VALUE 0x8053B48C RB_Val_Wu16 1422.201 acc_q0p021701_m_DIV_s2 0.00 1422.201 FORMAT "%8.3" /end CHARACTERISTIC
/begin CHARACTERISTIC VFZGTLDEB "threshold vehicle speed of enable tank leak diagnosis" VALUE 0x8053B65C RB_Val_Wu16 511.9922 vfzg_uw_b512 0.00 511.9922 FORMAT "%8.4" /end CHARACTERISTIC
/begin CHARACTERISTIC VFZGTLDSRO "offset threshold vehicle speed taking back of request for engine running" VALUE 0x8053B65E RB_Val_Ws16 511.9922 vfzg_uw_b512 -256.0000 255.9922 FORMAT "%8.4" /end CHARACTERISTIC
/begin CHARACTERISTIC VHDISTMN "Mileage at which the EONV Diagnostic can begin running" VALUE 0x8053BD08 RB_Val_Ws32 4294967295.00 Length -2147483648.00 2147483647.00 FORMAT "%13.2" /end CHARACTERISTIC
/begin CHARACTERISTIC ZADIAGSTOP "zadiag limit for reset of stop prohibition" VALUE 0x8053B660 RB_Val_Wu8 241.0 dez 14.0 255.0 FORMAT "%5.1" EXTENDED_LIMITS 0.00 255.0 /end CHARACTERISTIC
/begin CHARACTERISTIC ZKMSNTLD "Time konstant for closing the cpv before tank leakage diagnosis" VALUE 0x8053B89A RB_Val_Wu16 6553.4999985 zk100msxs_uw_b6553p6 0.1000015 6553.6000000 FORMAT "%12.7" EXTENDED_LIMITS 0.10000152590 6553.6000000 /end CHARACTERISTIC
/begin CHARACTERISTIC ZKMSTDST "Time Constant for filtering of CPV-Mass-Flow for diagnosis of tank pressure sensor" VALUE 0x8053B48E RB_Val_Wu16 6553.4999985 zk100msxs_uw_b6553p6 0.1000015 6553.6000000 FORMAT "%12.7" EXTENDED_LIMITS 0.10000152590 6553.6000000 /end CHARACTERISTIC
/begin MEASUREMENT aktbeg_msg "maximum activated tank leakage diagnoses" UBYTE dez 1 100 0.00 255.0 FORMAT "%5.1" ECU_ADDRESS 0x60001420 /end MEASUREMENT
/begin MEASUREMENT aktdtesk_msg "requested tank leakage diagnoses" UBYTE dez 1 100 0.00 255.0 FORMAT "%5.1" ECU_ADDRESS 0x6000141F /end MEASUREMENT
/begin MEASUREMENT aktend_msg "finished tank leak diagnosis" UBYTE dez 1 100 0.00 255.0 FORMAT "%5.1" ECU_ADDRESS 0x6000141E /end MEASUREMENT
/begin MEASUREMENT aktlauft "enabled tank leakage diagnoses before priorisation" UBYTE dez 1 100 0.00 255.0 FORMAT "%5.1" ECU_ADDRESS 0x60000FEE /end MEASUREMENT
/begin MEASUREMENT aktlauf_msg "running fuel tank diagnosis" UBYTE dez 1 100 0.00 255.0 FORMAT "%5.1" ECU_ADDRESS 0x6000141D /end MEASUREMENT
/begin MEASUREMENT aktloc "requested tank leakage diagnoses" UBYTE dez 1 100 0.00 255.0 FORMAT "%5.1" ECU_ADDRESS 0x60000FED /end MEASUREMENT
/begin MEASUREMENT aktstopt "stopped tank leakage diagnoses" UBYTE dez 1 100 0.00 255.0 FORMAT "%5.1" ECU_ADDRESS 0x60000FEC /end MEASUREMENT
/begin MEASUREMENT B_abbrtldloc "local variable to store the time bit value of B_abbrtld_msg after the TOFF delay. Introduced for ease of testing" UBYTE B_TRUE 1 100 0.00 1.00000000000 BIT_MASK 0x1 FORMAT "%13.11" ECU_ADDRESS 0x60001402 /end MEASUREMENT
/begin MEASUREMENT B_abbrtld_msg "Condition: stop of the tank leak diagnosis" UBYTE B_TRUE 1 100 0.00 1.00000000000 BIT_MASK 0x1 FORMAT "%13.11" ECU_ADDRESS 0x60001403 /end MEASUREMENT
/begin MEASUREMENT B_ambpof "ambient conditions are fullfilled for offset diagnosis" UBYTE B_TRUE 1 100 0.00 1.00000000000 BIT_MASK 0x1 FORMAT "%13.11" ECU_ADDRESS 0x60001037 /end MEASUREMENT
/begin MEASUREMENT B_ccveonv_msg "canister close valve is closed for EONV" UBYTE B_TRUE 1 100 0.00 1.00000000000 BIT_MASK 0x1 FORMAT "%13.11" ECU_ADDRESS 0x60000249 /end MEASUREMENT
/begin MEASUREMENT B_cmpltld "Readiness for tank leak diagnosis is with iO complete" UBYTE B_TRUE 1 100 0.00 1.00000000000 BIT_MASK 0x1 FORMAT "%13.11" ECU_ADDRESS 0x60001000 /end MEASUREMENT
/begin MEASUREMENT B_cpvacheck "CPV active for plausibility check" UBYTE B_TRUE 1 100 0.00 1.00000000000 BIT_MASK 0x1 FORMAT "%13.11" ECU_ADDRESS 0x60001036 /end MEASUREMENT
/begin MEASUREMENT B_cpvacof "pressure by open CPV is calculated" UBYTE B_TRUE 1 100 0.00 1.00000000000 BIT_MASK 0x1 FORMAT "%13.11" ECU_ADDRESS 0x60001035 /end MEASUREMENT
/begin MEASUREMENT B_cpvplaus "CPV-plausibility-check successful" UBYTE B_TRUE 1 100 0.00 1.00000000000 BIT_MASK 0x1 FORMAT "%13.11" ECU_ADDRESS 0x60001034 /end MEASUREMENT
/begin MEASUREMENT B_cpvplwth "lower threshold for plausibility because of cpv" UBYTE B_TRUE 1 100 0.00 1.00000000000 BIT_MASK 0x1 FORMAT "%13.11" ECU_ADDRESS 0x60001033 /end MEASUREMENT
/begin MEASUREMENT B_ddstnpo "request pressure sensor offset diagnosis" UBYTE B_TRUE 1 100 0.00 1.00000000000 BIT_MASK 0x1 FORMAT "%13.11" ECU_ADDRESS 0x60001032 /end MEASUREMENT
/begin MEASUREMENT B_ddstnpp "request pressure sensor plausibility" UBYTE B_TRUE 1 100 0.00 1.00000000000 BIT_MASK 0x1 FORMAT "%13.11" ECU_ADDRESS 0x60001031 /end MEASUREMENT
/begin MEASUREMENT B_ddstnp_msg "cpv is not active" UBYTE B_TRUE 1 100 0.00 1.00000000000 BIT_MASK 0x1 FORMAT "%13.11" ECU_ADDRESS 0x600013FC /end MEASUREMENT
/begin MEASUREMENT B_dstden "Release tank pressure sensor drift check" UBYTE B_TRUE 1 100 0.00 1.00000000000 BIT_MASK 0x1 FORMAT "%13.11" ECU_ADDRESS 0x60039760 /end MEASUREMENT
/begin MEASUREMENT B_dsteonvfcl_msg "fault clear EONV" UBYTE B_TRUE 1 100 0.00 1.00000000000 BIT_MASK 0x1 FORMAT "%13.11" ECU_ADDRESS 0x60039858 /end MEASUREMENT
/begin MEASUREMENT B_dstrerr_msg "Diagnosis of tank pressure sensor inhibited due to errors" UBYTE B_TRUE 1 100 0.00 1.00000000000 BIT_MASK 0x1 FORMAT "%13.11" ECU_ADDRESS 0x600013FA /end MEASUREMENT
/begin MEASUREMENT B_dstrir_msg "Enable condition for incrementation of IUMPR counter for FID_CDSTR" UBYTE B_TRUE 1 100 0.00 1.00000000000 BIT_MASK 0x1 FORMAT "%13.11" ECU_ADDRESS 0x600013F9 /end MEASUREMENT
/begin MEASUREMENT B_dsttesffcl_msg "fault memory path DTESK" UBYTE B_TRUE 1 100 0.00 1.00000000000 BIT_MASK 0x1 FORMAT "%13.11" ECU_ADDRESS 0x60039857 /end MEASUREMENT
/begin MEASUREMENT B_dteaav_msg "canister vent valve closed" UBYTE B_TRUE 1 100 0.00 1.00000000000 BIT_MASK 0x1 FORMAT "%13.11" ECU_ADDRESS 0x600013F7 /end MEASUREMENT
/begin MEASUREMENT B_dteaa_msg "Condition diagnosis CPV by opening the CPV active" UBYTE B_TRUE 1 100 0.00 1.00000000000 BIT_MASK 0x1 FORMAT "%13.11" ECU_ADDRESS 0x6000F6FD /end MEASUREMENT
/begin MEASUREMENT B_dtefrr_msg "condition of lambda controller reset" UBYTE B_TRUE 1 100 0.00 1.00000000000 BIT_MASK 0x1 FORMAT "%13.11" ECU_ADDRESS 0x600013F6 /end MEASUREMENT
/begin MEASUREMENT B_dtesk05 "diagnosis request for smallest leak check (0.5mm)" UBYTE B_TRUE 1 100 0.00 1.00000000000 BIT_MASK 0x1 FORMAT "%13.11" ECU_ADDRESS 0x60000FEB /end MEASUREMENT
/begin MEASUREMENT B_dteskddr_msg "Driving distance debounce for DTESK required" UBYTE B_TRUE 1 100 0.00 1.00000000000 BIT_MASK 0x1 FORMAT "%13.11" ECU_ADDRESS 0x60039856 /end MEASUREMENT
/begin MEASUREMENT B_dteskddv "Virtual driving distance debounce for IUMPR-calculation of DTESK required" UBYTE B_TRUE 1 100 0.00 1.00000000000 BIT_MASK 0x1 FORMAT "%13.11" ECU_ADDRESS 0x60039755 /end MEASUREMENT
/begin MEASUREMENT B_dteskfzg_msg "vehicle conditions for enabling diagnosis" UBYTE B_TRUE 1 100 0.00 1.00000000000 BIT_MASK 0x1 FORMAT "%13.11" ECU_ADDRESS 0x600013F5 /end MEASUREMENT
/begin MEASUREMENT B_dteskpid_msg "conditions for tank leakage diagnosis (DTESK) PID41 enabled" UBYTE B_TRUE 1 100 0.00 1.00000000000 BIT_MASK 0x1 FORMAT "%13.11" ECU_ADDRESS 0x600013F4 /end MEASUREMENT
/begin MEASUREMENT B_dtest_msg "condition for start of TEV opening" UBYTE B_TRUE 1 100 0.00 1.00000000000 BIT_MASK 0x1 FORMAT "%13.11" ECU_ADDRESS 0x6000F6FB /end MEASUREMENT
/begin MEASUREMENT B_dtes_msg "Condition for active diagnosis of canister purge system" UBYTE B_TRUE 1 100 0.00 1.00000000000 BIT_MASK 0x1 FORMAT "%13.11" ECU_ADDRESS 0x6000F6FC /end MEASUREMENT
/begin MEASUREMENT B_dtetk_msg "Condition refueling recognized" UBYTE B_TRUE 1 100 0.00 1.00000000000 BIT_MASK 0x1 FORMAT "%13.11" ECU_ADDRESS 0x600013F3 /end MEASUREMENT
/begin MEASUREMENT B_dtezamh_msg "DTEV test in homogeneous Lambda=1 mode enabled" UBYTE B_TRUE 1 100 0.00 1.00000000000 BIT_MASK 0x1 FORMAT "%13.11" ECU_ADDRESS 0x6000FABB /end MEASUREMENT
/begin MEASUREMENT B_dte_msg "Condition for active diagnosis of canister purge system" UBYTE B_TRUE 1 100 0.00 1.00000000000 BIT_MASK 0x1 FORMAT "%13.11" ECU_ADDRESS 0x600013F8 /end MEASUREMENT
/begin MEASUREMENT B_eaavp_msg "internal error flag CCV error" UBYTE B_TRUE 1 100 0.00 1.00000000000 BIT_MASK 0x1 FORMAT "%13.11" ECU_ADDRESS 0x600013F1 /end MEASUREMENT
/begin MEASUREMENT B_eaav_msg "internal condition: AAV error" UBYTE B_TRUE 1 100 0.00 1.00000000000 BIT_MASK 0x1 FORMAT "%13.11" ECU_ADDRESS 0x600013F2 /end MEASUREMENT
/begin MEASUREMENT B_edstoft "internal offset diagnosis cycle flag" UBYTE B_TRUE 1 100 0.00 1.00000000000 BIT_MASK 0x1 FORMAT "%13.11" ECU_ADDRESS 0x60001030 /end MEASUREMENT
/begin MEASUREMENT B_edstof_msg "failure offset-diagnosis tank-pressure sensor (internal)" UBYTE B_TRUE 1 100 0.00 1.00000000000 BIT_MASK 0x1 FORMAT "%13.11" ECU_ADDRESS 0x600013F0 /end MEASUREMENT
/begin MEASUREMENT B_edstosci "oscillations in the fuel tank pressure signal detected" UBYTE B_TRUE 1 100 0.00 1.00000000000 BIT_MASK 0x1 FORMAT "%13.11" ECU_ADDRESS 0x600013EF /end MEASUREMENT
/begin MEASUREMENT B_eeonvld "EONV: 0.02inch leak was detected in previous diagnosis" UBYTE B_TRUE 1 100 0.00 1.00000000000 BIT_MASK 0x1 FORMAT "%13.11" ECU_ADDRESS 0x60039738 /end MEASUREMENT
/begin MEASUREMENT B_eeonv_msg "evap system monitoring - 0.02inch leak" UBYTE B_TRUE 1 100 0.00 1.00000000000 BIT_MASK 0x1 FORMAT "%13.11" ECU_ADDRESS 0x600013EE /end MEASUREMENT
/begin MEASUREMENT B_eincch "condition plausibility error (incremental check) in tank pressure sensor" UBYTE B_TRUE 1 100 0.00 1.00000000000 BIT_MASK 0x1 FORMAT "%13.11" ECU_ADDRESS 0x600013EB /end MEASUREMENT
/begin MEASUREMENT B_endeonv_msg "EONV diagnosis is finished" UBYTE B_TRUE 1 100 0.00 1.00000000000 BIT_MASK 0x1 FORMAT "%13.11" ECU_ADDRESS 0x600013EA /end MEASUREMENT
/begin MEASUREMENT B_endtesk_msg "internal condition smallest leak check complete in this trip" UBYTE B_TRUE 1 100 0.00 1.00000000000 BIT_MASK 0x1 FORMAT "%13.11" ECU_ADDRESS 0x600013E9 /end MEASUREMENT
/begin MEASUREMENT B_eonirn_msg "Condition: Small leak has been or could have been detected." UBYTE B_TRUE 1 100 0.00 1.00000000000 BIT_MASK 0x1 FORMAT "%13.11" ECU_ADDRESS 0x600013E8 /end MEASUREMENT
/begin MEASUREMENT B_eonperlk "Condition 0.5mm leak: last test with leak" UBYTE B_TRUE 1 100 0.00 1.00000000000 BIT_MASK 0x1 FORMAT "%13.11" ECU_ADDRESS 0x60039737 /end MEASUREMENT
/begin MEASUREMENT B_eonperno "Condition 0.5mm leak: last test without leak" UBYTE B_TRUE 1 100 0.00 1.00000000000 BIT_MASK 0x1 FORMAT "%13.11" ECU_ADDRESS 0x60039736 /end MEASUREMENT
/begin MEASUREMENT B_eonvab_msg "condition EONV aborted" UBYTE B_TRUE 1 100 0.00 1.00000000000 BIT_MASK 0x1 FORMAT "%13.11" ECU_ADDRESS 0x6000022D /end MEASUREMENT
/begin MEASUREMENT B_eonvmil_msg "MIL on because of EONV" UBYTE B_TRUE 1 100 0.00 1.00000000000 BIT_MASK 0x1 FORMAT "%13.11" ECU_ADDRESS 0x60039855 /end MEASUREMENT
/begin MEASUREMENT B_eonvnerr_msg "condition EONV enabled due to no master errors being set" UBYTE B_TRUE 1 100 0.00 1.00000000000 BIT_MASK 0x1 FORMAT "%13.11" ECU_ADDRESS 0x6000022C /end MEASUREMENT
/begin MEASUREMENT B_eonvrssf_msg "Reset of B_eonvsfen due to too short standing time or detected refueling" UBYTE B_TRUE 1 100 0.00 1.00000000000 BIT_MASK 0x1 FORMAT "%13.11" ECU_ADDRESS 0x600013E7 /end MEASUREMENT
/begin MEASUREMENT B_eonvsrd "indication if service test has been done" UBYTE B_TRUE 1 100 0.00 1.00000000000 BIT_MASK 0x1 FORMAT "%13.11" ECU_ADDRESS 0x600000F3 /end MEASUREMENT
/begin MEASUREMENT B_etesf_msg "internal condition: small leak detected" UBYTE B_TRUE 1 100 0.00 1.00000000000 BIT_MASK 0x1 FORMAT "%13.11" ECU_ADDRESS 0x600013E5 /end MEASUREMENT
/begin MEASUREMENT B_etesgdd_msg "canister purge system diagnosis - rough leak after distance debounce" UBYTE B_TRUE 1 100 0.00 1.00000000000 BIT_MASK 0x1 FORMAT "%13.11" ECU_ADDRESS 0x600013E4 /end MEASUREMENT
/begin MEASUREMENT B_etesggv "internal condition: virtual rough leak gradient error for calculation of IUMPR detected" UBYTE B_TRUE 1 100 0.00 1.00000000000 BIT_MASK 0x1 FORMAT "%13.11" ECU_ADDRESS 0x60000FFF /end MEASUREMENT
/begin MEASUREMENT B_etesgg_msg "internal condition: rough leak gradient error detected" UBYTE B_TRUE 1 100 0.00 1.00000000000 BIT_MASK 0x1 FORMAT "%13.11" ECU_ADDRESS 0x600013E3 /end MEASUREMENT
/begin MEASUREMENT B_etesgloc_msg "Local copy of the condition of rough leak" UBYTE B_TRUE 1 100 0.00 1.00000000000 BIT_MASK 0x1 FORMAT "%13.11" ECU_ADDRESS 0x60039854 /end MEASUREMENT
/begin MEASUREMENT B_etesk_msg "internal condition: smallest leak detected" UBYTE B_TRUE 1 100 0.00 1.00000000000 BIT_MASK 0x1 FORMAT "%13.11" ECU_ADDRESS 0x600013E2 /end MEASUREMENT
/begin MEASUREMENT B_etvtldmn_msg "condition purge control valve min-error detected by tank leak diagnostics" UBYTE B_TRUE 1 100 0.00 1.00000000000 BIT_MASK 0x1 FORMAT "%13.11" ECU_ADDRESS 0x600013E1 /end MEASUREMENT
/begin MEASUREMENT B_etvtldmx_msg "condition purge control valve max-error detected by tank leak diagnostics" UBYTE B_TRUE 1 100 0.00 1.00000000000 BIT_MASK 0x1 FORMAT "%13.11" ECU_ADDRESS 0x600013E0 /end MEASUREMENT
/begin MEASUREMENT B_eveonvac_msg "environment related conditions for tank leak diagnosis fulfilled" UBYTE B_TRUE 1 100 0.00 1.00000000000 BIT_MASK 0x1 FORMAT "%13.11" ECU_ADDRESS 0x6000022A /end MEASUREMENT
/begin MEASUREMENT B_eveonvoc_msg "operation conditions for tank leak diagnosis EONV fulfilled" UBYTE B_TRUE 1 100 0.00 1.00000000000 BIT_MASK 0x1 FORMAT "%13.11" ECU_ADDRESS 0x60000229 /end MEASUREMENT
/begin MEASUREMENT B_fadstof_msg "condition service function request for tank pressure sensor offset diagnosis" UBYTE B_TRUE 1 100 0.00 1.00000000000 BIT_MASK 0x1 FORMAT "%13.11" ECU_ADDRESS 0x6000F6EF /end MEASUREMENT
/begin MEASUREMENT B_faeonvdt_msg "indication if service test DTESK is requested from EONV" UBYTE B_TRUE 1 100 0.00 1.00000000000 BIT_MASK 0x1 FORMAT "%13.11" ECU_ADDRESS 0x60000227 /end MEASUREMENT
/begin MEASUREMENT B_fatld05_msg "condition service function request for smallest leak diagnosis" UBYTE B_TRUE 1 100 0.00 1.00000000000 BIT_MASK 0x1 FORMAT "%13.11" ECU_ADDRESS 0x600013DD /end MEASUREMENT
/begin MEASUREMENT B_fatldtev_msg "condition leak detection request by tank leakage detection" UBYTE B_TRUE 1 100 0.00 1.00000000000 BIT_MASK 0x1 FORMAT "%13.11" ECU_ADDRESS 0x6000F6ED /end MEASUREMENT
/begin MEASUREMENT B_feonv_msg "EONV is finished" UBYTE B_TRUE 1 100 0.00 1.00000000000 BIT_MASK 0x1 FORMAT "%13.11" ECU_ADDRESS 0x60000223 /end MEASUREMENT
/begin MEASUREMENT B_hotst "hot sart" UBYTE B_TRUE 1 100 0.00 1.00000000000 BIT_MASK 0x1 FORMAT "%13.11" ECU_ADDRESS 0x600000F2 /end MEASUREMENT
/begin MEASUREMENT B_iatlddu_msg "internal abortion of tld because of pressure undershooting" UBYTE B_TRUE 1 100 0.00 1.00000000000 BIT_MASK 0x1 FORMAT "%13.11" ECU_ADDRESS 0x600013D1 /end MEASUREMENT
/begin MEASUREMENT B_iatldha_msg "internal abortion of the TLD because of high evaporation" UBYTE B_TRUE 1 100 0.00 1.00000000000 BIT_MASK 0x1 FORMAT "%13.11" ECU_ADDRESS 0x600013D0 /end MEASUREMENT
/begin MEASUREMENT B_iatldko_msg "internal abortion of the TLD because of fuel condensation" UBYTE B_TRUE 1 100 0.00 1.00000000000 BIT_MASK 0x1 FORMAT "%13.11" ECU_ADDRESS 0x600013CF /end MEASUREMENT
/begin MEASUREMENT B_iatldms_msg "internal abortion of tld: Massflow of CPV to small" UBYTE B_TRUE 1 100 0.00 1.00000000000 BIT_MASK 0x1 FORMAT "%13.11" ECU_ADDRESS 0x600013CE /end MEASUREMENT
/begin MEASUREMENT B_iatldpt_msg "internal abortion of tld: pressure does not stabilize" UBYTE B_TRUE 1 100 0.00 1.00000000000 BIT_MASK 0x1 FORMAT "%13.11" ECU_ADDRESS 0x600013CD /end MEASUREMENT
/begin MEASUREMENT B_infoEONVmax "information 0.02inch leak EONV" UBYTE B_TRUE 1 100 0.00 1.00000000000 BIT_MASK 0x1 FORMAT "%13.11" ECU_ADDRESS 0x60000FB1 /end MEASUREMENT
/begin MEASUREMENT B_infoTESFmax "Info-Bit of DFC_TESGLmax" UBYTE B_TRUE 1 100 0.00 1.00000000000 BIT_MASK 0x1 FORMAT "%13.11" ECU_ADDRESS 0x60000FFE /end MEASUREMENT
/begin MEASUREMENT B_infoTESGmax "Info-Bit of DFC_TESGmax" UBYTE B_TRUE 1 100 0.00 1.00000000000 BIT_MASK 0x1 FORMAT "%13.11" ECU_ADDRESS 0x60000FFD /end MEASUREMENT
/begin MEASUREMENT B_nldte_msg "request for ECM afterrun from leak detection" UBYTE B_TRUE 1 100 0.00 1.00000000000 BIT_MASK 0x1 FORMAT "%13.11" ECU_ADDRESS 0x600001F2 /end MEASUREMENT
/begin MEASUREMENT B_nvdicscm_msg "cold start checks met for EONV diagnosis" UBYTE B_TRUE 1 100 0.00 1.00000000000 BIT_MASK 0x1 FORMAT "%13.11" ECU_ADDRESS 0x60036E14 /end MEASUREMENT
/begin MEASUREMENT B_occveonv_msg "condition opening canister close valve" UBYTE B_TRUE 1 100 0.00 1.00000000000 BIT_MASK 0x1 FORMAT "%13.11" ECU_ADDRESS 0x600001EE /end MEASUREMENT
/begin MEASUREMENT B_ppheonv_msg "pressure phase EONV is activated" UBYTE B_TRUE 1 100 0.00 1.00000000000 BIT_MASK 0x1 FORMAT "%13.11" ECU_ADDRESS 0x600001E4 /end MEASUREMENT
/begin MEASUREMENT B_pphfeonv_msg "pressure phase EONV is finished" UBYTE B_TRUE 1 100 0.00 1.00000000000 BIT_MASK 0x1 FORMAT "%13.11" ECU_ADDRESS 0x600001E3 /end MEASUREMENT
/begin MEASUREMENT B_priodesk_msg "priority of requested operating conditions for tank leak diagnosis" UBYTE B_TRUE 1 100 0.00 1.00000000000 BIT_MASK 0x1 FORMAT "%13.11" ECU_ADDRESS 0x600013C9 /end MEASUREMENT
/begin MEASUREMENT B_priodest "priority of requested operating conditions for tank leak diagnosis, temporary" UBYTE B_TRUE 1 100 0.00 1.00000000000 BIT_MASK 0x1 FORMAT "%13.11" ECU_ADDRESS 0x60000FEA /end MEASUREMENT
/begin MEASUREMENT B_ptekstof "tank pressure is stable for offset diagnosis" UBYTE B_TRUE 1 100 0.00 1.00000000000 BIT_MASK 0x1 FORMAT "%13.11" ECU_ADDRESS 0x6000102F /end MEASUREMENT
/begin MEASUREMENT B_ptfslo_msg "tank pressure filtering with slow filter time constant" UBYTE B_TRUE 1 100 0.00 1.00000000000 BIT_MASK 0x1 FORMAT "%13.11" ECU_ADDRESS 0x600013C7 /end MEASUREMENT
/begin MEASUREMENT B_punxc_msg "no extreme conditions of ambient pressure" UBYTE B_TRUE 1 100 0.00 1.00000000000 BIT_MASK 0x1 FORMAT "%13.11" ECU_ADDRESS 0x600013C6 /end MEASUREMENT
/begin MEASUREMENT B_pustpof "ambient pressure for offset diagnosis is fullfilled" UBYTE B_TRUE 1 100 0.00 1.00000000000 BIT_MASK 0x1 FORMAT "%13.11" ECU_ADDRESS 0x6000102E /end MEASUREMENT
/begin MEASUREMENT B_refdstd "Refrence value for check of tank pressure sensor for drift stored in this driving cycle" UBYTE B_TRUE 1 100 0.00 1.00000000000 BIT_MASK 0x1 FORMAT "%13.11" ECU_ADDRESS 0x6000102D /end MEASUREMENT
/begin MEASUREMENT B_rirvfzg "reset of idle request either stop disable depending of vehicle speed" UBYTE B_TRUE 1 100 0.00 1.00000000000 BIT_MASK 0x1 FORMAT "%13.11" ECU_ADDRESS 0x60000FE9 /end MEASUREMENT
/begin MEASUREMENT B_rlirn "Condition: Rough leak has been or could have been detected." UBYTE B_TRUE 1 100 0.00 1.00000000000 BIT_MASK 0x1 FORMAT "%13.11" ECU_ADDRESS 0x60000FFC /end MEASUREMENT
/begin MEASUREMENT B_rlirnv "Condition: Rough leak could have been performed." UBYTE B_TRUE 1 100 0.00 1.00000000000 BIT_MASK 0x1 FORMAT "%13.11" ECU_ADDRESS 0x60000FFB /end MEASUREMENT
/begin MEASUREMENT B_rqeonv "physically allowed tank leak tests after enable conditions (DSM not included)" UBYTE B_TRUE 1 100 0.00 1.00000000000 BIT_MASK 0x1 FORMAT "%13.11" ECU_ADDRESS 0x600000F8 /end MEASUREMENT
/begin MEASUREMENT B_rtldio "Condition set readiness due to tank leack diagnosis ok" UBYTE B_TRUE 1 100 0.00 1.00000000000 BIT_MASK 0x1 FORMAT "%13.11" ECU_ADDRESS 0x60039754 /end MEASUREMENT
/begin MEASUREMENT B_runeonv_msg "running tank leak diagnosis EONV" UBYTE B_TRUE 1 100 0.00 1.00000000000 BIT_MASK 0x1 FORMAT "%13.11" ECU_ADDRESS 0x600001D7 /end MEASUREMENT
/begin MEASUREMENT B_sbteonva_msg "EONV service test access accepted" UBYTE B_TRUE 1 100 0.00 1.00000000000 BIT_MASK 0x1 FORMAT "%13.11" ECU_ADDRESS 0x600001D6 /end MEASUREMENT
/begin MEASUREMENT B_scatldo_msg "release by scheduler: tank leak diagnosis, OBD-diagnosis" UBYTE B_TRUE 1 100 0.00 1.00000000000 BIT_MASK 0x1 FORMAT "%13.11" ECU_ADDRESS 0x600013C4 /end MEASUREMENT
/begin MEASUREMENT B_sfatlde "latched tank leak diagnosis function request" UBYTE B_TRUE 1 100 0.00 1.00000000000 BIT_MASK 0x1 FORMAT "%13.11" ECU_ADDRESS 0x60000FC4 /end MEASUREMENT
/begin MEASUREMENT B_sm8te "Condition Mode 8 Request Stored" UBYTE B_TRUE 1 100 0.00 1.00000000000 BIT_MASK 0x1 FORMAT "%13.11" ECU_ADDRESS 0x60000FC3 /end MEASUREMENT
/begin MEASUREMENT B_spdtetld_msg "Locking of CPV check from tank leak diagnosis" UBYTE B_TRUE 1 100 0.00 1.00000000000 BIT_MASK 0x1 FORMAT "%13.11" ECU_ADDRESS 0x600013C3 /end MEASUREMENT
/begin MEASUREMENT B_sstp "engine stop phase for DTESK active" UBYTE B_TRUE 1 100 0.00 1.00000000000 BIT_MASK 0x1 FORMAT "%13.11" ECU_ADDRESS 0x60000FE8 /end MEASUREMENT
/begin MEASUREMENT B_stdsto_msg "Condition start check of tank pressure sensor for offset" UBYTE B_TRUE 1 100 0.00 1.00000000000 BIT_MASK 0x1 FORMAT "%13.11" ECU_ADDRESS 0x600013C2 /end MEASUREMENT
/begin MEASUREMENT B_stincche "end condition for max. diagnosis time of inc. plausibility check" UBYTE B_TRUE 1 100 0.00 1.00000000000 BIT_MASK 0x1 FORMAT "%13.11" ECU_ADDRESS 0x6000102C /end MEASUREMENT
/begin MEASUREMENT B_stincch_msg "Condition start increment check of tank pressure sensor" UBYTE B_TRUE 1 100 0.00 1.00000000000 BIT_MASK 0x1 FORMAT "%13.11" ECU_ADDRESS 0x600013C1 /end MEASUREMENT
/begin MEASUREMENT B_stosche "end condition for max. diagnosis time of oscillation check" UBYTE B_TRUE 1 100 0.00 1.00000000000 BIT_MASK 0x1 FORMAT "%13.11" ECU_ADDRESS 0x6000102B /end MEASUREMENT
/begin MEASUREMENT B_stosch_msg "Condition start oscillation check of tank pressure sensor" UBYTE B_TRUE 1 100 0.00 1.00000000000 BIT_MASK 0x1 FORMAT "%13.11" ECU_ADDRESS 0x600013C0 /end MEASUREMENT
/begin MEASUREMENT B_tesfmilerr_msg "MIL on and error detected because of 0.04 inch leak in DTESK" UBYTE B_TRUE 1 100 0.00 1.00000000000 BIT_MASK 0x1 FORMAT "%13.11" ECU_ADDRESS 0x600013B9 /end MEASUREMENT
/begin MEASUREMENT B_tesfmil_msg "MIL on because of 0.04 inch leak in DTESK" UBYTE B_TRUE 1 100 0.00 1.00000000000 BIT_MASK 0x1 FORMAT "%13.11" ECU_ADDRESS 0x6003984E /end MEASUREMENT
/begin MEASUREMENT B_tesgmilerr_msg "MIL on and error detected because of 0.09 inch leak in DTESK" UBYTE B_TRUE 1 100 0.00 1.00000000000 BIT_MASK 0x1 FORMAT "%13.11" ECU_ADDRESS 0x600013B8 /end MEASUREMENT
/begin MEASUREMENT B_tesgmil_msg "MIL on due to 0.04inch leak" UBYTE B_TRUE 1 100 0.00 1.00000000000 BIT_MASK 0x1 FORMAT "%13.11" ECU_ADDRESS 0x6003984D /end MEASUREMENT
/begin MEASUREMENT B_tldav_msg "condition tank leak diagnosis active" UBYTE B_TRUE 1 100 0.00 1.00000000000 BIT_MASK 0x1 FORMAT "%13.11" ECU_ADDRESS 0x600013B7 /end MEASUREMENT
/begin MEASUREMENT B_tldbccon_msg "basic conditions for tank leak diagnosis fulfilled" UBYTE B_TRUE 1 100 0.00 1.00000000000 BIT_MASK 0x1 FORMAT "%13.11" ECU_ADDRESS 0x600013B6 /end MEASUREMENT
/begin MEASUREMENT B_tldbcstp "basic stop conditions for tank leakage diagnosis fulfilled" UBYTE B_TRUE 1 100 0.00 1.00000000000 BIT_MASK 0x1 FORMAT "%13.11" ECU_ADDRESS 0x60000FE7 /end MEASUREMENT
/begin MEASUREMENT B_tlddicon_msg "conditions with no influence to the tank leak diagnosis" UBYTE B_TRUE 1 100 0.00 1.00000000000 BIT_MASK 0x1 FORMAT "%13.11" ECU_ADDRESS 0x600013B5 /end MEASUREMENT
/begin MEASUREMENT B_tldhb05_msg "high canister load detected (0.5mm check)" UBYTE B_TRUE 1 100 0.00 1.00000000000 BIT_MASK 0x1 FORMAT "%13.11" ECU_ADDRESS 0x600013B4 /end MEASUREMENT
/begin MEASUREMENT B_tldinfo_msg "condition tank leak test for information purposes" UBYTE B_TRUE 1 100 0.00 1.00000000000 BIT_MASK 0x1 FORMAT "%13.11" ECU_ADDRESS 0x600013B3 /end MEASUREMENT
/begin MEASUREMENT B_tldklcon_msg "conditions for 0.5mm tank leak diagnosis fulfilled" UBYTE B_TRUE 1 100 0.00 1.00000000000 BIT_MASK 0x1 FORMAT "%13.11" ECU_ADDRESS 0x600013B2 /end MEASUREMENT
/begin MEASUREMENT B_tldklnx_msg "conditions for 0.5mm tank leak diagnosis wo ambient conditions fulfilled" UBYTE B_TRUE 1 100 0.00 1.00000000000 BIT_MASK 0x1 FORMAT "%13.11" ECU_ADDRESS 0x600013B1 /end MEASUREMENT
/begin MEASUREMENT B_tldmderr_msg "error in DTESK-components (AAV, TEV, pressure components)" UBYTE B_TRUE 1 100 0.00 1.00000000000 BIT_MASK 0x1 FORMAT "%13.11" ECU_ADDRESS 0x600013B0 /end MEASUREMENT
/begin MEASUREMENT B_tldobd_msg "condition tank leak test with obd-relevance" UBYTE B_TRUE 1 100 0.00 1.00000000000 BIT_MASK 0x1 FORMAT "%13.11" ECU_ADDRESS 0x600013AF /end MEASUREMENT
/begin MEASUREMENT B_tldpsd_msg "fuel slosh detected with fuel tank pressure signal" UBYTE B_TRUE 1 100 0.00 1.00000000000 BIT_MASK 0x1 FORMAT "%13.11" ECU_ADDRESS 0x600013AE /end MEASUREMENT
/begin MEASUREMENT B_tldres_msg "condition: reset of evopourativ leakage control from external request" UBYTE B_TRUE 1 100 0.00 1.00000000000 BIT_MASK 0x1 FORMAT "%13.11" ECU_ADDRESS 0x600013AD /end MEASUREMENT
/begin MEASUREMENT B_tldrlcv "conditions for virtual rough leak gradient tank leakage diagnosis fulfilled" UBYTE B_TRUE 1 100 0.00 1.00000000000 BIT_MASK 0x1 FORMAT "%13.11" ECU_ADDRESS 0x60000FFA /end MEASUREMENT
/begin MEASUREMENT B_tldrlerr_msg "rough leak error after DTESK-check" UBYTE B_TRUE 1 100 0.00 1.00000000000 BIT_MASK 0x1 FORMAT "%13.11" ECU_ADDRESS 0x600013AC /end MEASUREMENT
/begin MEASUREMENT B_tldstnai_msg "tank leak diagnosis stops because of inactive injection" UBYTE B_TRUE 1 100 0.00 1.00000000000 BIT_MASK 0x1 FORMAT "%13.11" ECU_ADDRESS 0x600013AB /end MEASUREMENT
/begin MEASUREMENT B_tldstpt_msg "tank difference pressure out of range" UBYTE B_TRUE 1 100 0.00 1.00000000000 BIT_MASK 0x1 FORMAT "%13.11" ECU_ADDRESS 0x600013AA /end MEASUREMENT
/begin MEASUREMENT B_tldstub_msg "battery voltage out of range" UBYTE B_TRUE 1 100 0.00 1.00000000000 BIT_MASK 0x1 FORMAT "%13.11" ECU_ADDRESS 0x600013A9 /end MEASUREMENT
/begin MEASUREMENT B_tldtehcl "tank leak diagnosis is aborted because of high canister load" UBYTE B_TRUE 1 100 0.00 1.00000000000 BIT_MASK 0x1 FORMAT "%13.11" ECU_ADDRESS 0x600001C2 /end MEASUREMENT
/begin MEASUREMENT B_tldtestp "stop of tank leakage diagnosis because CPV can not be opened" UBYTE B_TRUE 1 100 0.00 1.00000000000 BIT_MASK 0x1 FORMAT "%13.11" ECU_ADDRESS 0x60000FE6 /end MEASUREMENT
/begin MEASUREMENT B_tldto_msg "condition for start of TEV opening from TLD" UBYTE B_TRUE 1 100 0.00 1.00000000000 BIT_MASK 0x1 FORMAT "%13.11" ECU_ADDRESS 0x600013A8 /end MEASUREMENT
/begin MEASUREMENT B_tldvfzg "stored condition (RSFF) vehicle speed (km/h)" UBYTE B_TRUE 1 100 0.00 1.00000000000 BIT_MASK 0x1 FORMAT "%13.11" ECU_ADDRESS 0x60000FE5 /end MEASUREMENT
/begin MEASUREMENT B_tldvrlc "timer for virtual rough leaktest running" UBYTE B_TRUE 1 100 0.00 1.00000000000 BIT_MASK 0x1 FORMAT "%13.11" ECU_ADDRESS 0x60000FF9 /end MEASUREMENT
/begin MEASUREMENT B_tldwdcon_msg "conditions with small influence to the tank leak diagnosis" UBYTE B_TRUE 1 100 0.00 1.00000000000 BIT_MASK 0x1 FORMAT "%13.11" ECU_ADDRESS 0x600013A7 /end MEASUREMENT
/begin MEASUREMENT B_tmstkpid "engine start temperature of %DTESK cold start check for PID$41" UBYTE B_TRUE 1 100 0.00 1.00000000000 BIT_MASK 0x1 FORMAT "%13.11" ECU_ADDRESS 0x60000FE4 /end MEASUREMENT
/begin MEASUREMENT B_tumgnxc_msg "no extreme conditions of ambient temperature" UBYTE B_TRUE 1 100 0.00 1.00000000000 BIT_MASK 0x1 FORMAT "%13.11" ECU_ADDRESS 0x600013A6 /end MEASUREMENT
/begin MEASUREMENT B_tumgsrv_msg "ambient temperature for tank leak diagnosis is fullfilled" UBYTE B_TRUE 1 100 0.00 1.00000000000 BIT_MASK 0x1 FORMAT "%13.11" ECU_ADDRESS 0x600013A5 /end MEASUREMENT
/begin MEASUREMENT B_ubeonva_msg "condition EONV aborted due to battery voltage" UBYTE B_TRUE 1 100 0.00 1.00000000000 BIT_MASK 0x1 FORMAT "%13.11" ECU_ADDRESS 0x600001C0 /end MEASUREMENT
/begin MEASUREMENT B_vfzpof "vehicle speed conditions are fullfilled for offset diagnosis" UBYTE B_TRUE 1 100 0.00 1.00000000000 BIT_MASK 0x1 FORMAT "%13.11" ECU_ADDRESS 0x6000102A /end MEASUREMENT
/begin MEASUREMENT B_vpheonv_msg "vacuum phase EONV is activated" UBYTE B_TRUE 1 100 0.00 1.00000000000 BIT_MASK 0x1 FORMAT "%13.11" ECU_ADDRESS 0x600001BE /end MEASUREMENT
/begin MEASUREMENT B_vphseonv_msg "condition start vacuum phase without opening canister close valve" UBYTE B_TRUE 1 100 0.00 1.00000000000 BIT_MASK 0x1 FORMAT "%13.11" ECU_ADDRESS 0x600001BD /end MEASUREMENT
/begin MEASUREMENT B_zaavp_msg "internal cycle flag CCV error" UBYTE B_TRUE 1 100 0.00 1.00000000000 BIT_MASK 0x1 FORMAT "%13.11" ECU_ADDRESS 0x600013A3 /end MEASUREMENT
/begin MEASUREMENT B_zaav_msg "internal condition: AAV check complete" UBYTE B_TRUE 1 100 0.00 1.00000000000 BIT_MASK 0x1 FORMAT "%13.11" ECU_ADDRESS 0x600013A4 /end MEASUREMENT
/begin MEASUREMENT B_zdstoft "internal offset error pressure sensor" UBYTE B_TRUE 1 100 0.00 1.00000000000 BIT_MASK 0x1 FORMAT "%13.11" ECU_ADDRESS 0x60001029 /end MEASUREMENT
/begin MEASUREMENT B_zdstof_msg "cycle-flag offset-diagnosis tank-pressure sensor (internal)" UBYTE B_TRUE 1 100 0.00 1.00000000000 BIT_MASK 0x1 FORMAT "%13.11" ECU_ADDRESS 0x600013A2 /end MEASUREMENT
/begin MEASUREMENT B_zdstosci "Condition: Oscillation test completed" UBYTE B_TRUE 1 100 0.00 1.00000000000 BIT_MASK 0x1 FORMAT "%13.11" ECU_ADDRESS 0x60001028 /end MEASUREMENT
/begin MEASUREMENT B_zeonv_msg "cycle flag of evap system monitoring - 0.02inch leak" UBYTE B_TRUE 1 100 0.00 1.00000000000 BIT_MASK 0x1 FORMAT "%13.11" ECU_ADDRESS 0x600013A1 /end MEASUREMENT
/begin MEASUREMENT B_zincch "condition (incremental check) of tank pressure sensor finished" UBYTE B_TRUE 1 100 0.00 1.00000000000 BIT_MASK 0x1 FORMAT "%13.11" ECU_ADDRESS 0x60001027 /end MEASUREMENT
/begin MEASUREMENT B_ztesf_msg "internal condition small leak check complete" UBYTE B_TRUE 1 100 0.00 1.00000000000 BIT_MASK 0x1 FORMAT "%13.11" ECU_ADDRESS 0x600013A0 /end MEASUREMENT
/begin MEASUREMENT B_ztesgdd_msg "Internal cycle bit of evap system monitoring - rough leak after distance debounce" UBYTE B_TRUE 1 100 0.00 1.00000000000 BIT_MASK 0x1 FORMAT "%13.11" ECU_ADDRESS 0x6000139F /end MEASUREMENT
/begin MEASUREMENT B_ztesgg_msg "internal condition rough leak gradient check complete" UBYTE B_TRUE 1 100 0.00 1.00000000000 BIT_MASK 0x1 FORMAT "%13.11" ECU_ADDRESS 0x6000139E /end MEASUREMENT
/begin MEASUREMENT B_ztesgst "stored internal cycle flag for abortion high canister load" UBYTE B_TRUE 1 100 0.00 1.00000000000 BIT_MASK 0x1 FORMAT "%13.11" ECU_ADDRESS 0x60000FE3 /end MEASUREMENT
/begin MEASUREMENT B_ztesk_msg "internal condition smallest leak check complete" UBYTE B_TRUE 1 100 0.00 1.00000000000 BIT_MASK 0x1 FORMAT "%13.11" ECU_ADDRESS 0x6000139D /end MEASUREMENT
/begin MEASUREMENT B_ztevtld_msg "purge control valve test performed by tank leak diagnosis in present DCY" UBYTE B_TRUE 1 100 0.00 1.00000000000 BIT_MASK 0x1 FORMAT "%13.11" ECU_ADDRESS 0x6000139C /end MEASUREMENT
/begin MEASUREMENT cccvoeonv "EONV counter canister close valve open during Phase 2" UBYTE dez 1 100 0.00 255.0 FORMAT "%5.1" ECU_ADDRESS 0x60000FC1 /end MEASUREMENT
/begin MEASUREMENT ccpvplaus "counter CPV-plausibility-checks" UBYTE dez 1 100 0.00 255.0 FORMAT "%5.1" ECU_ADDRESS 0x60001026 /end MEASUREMENT
/begin MEASUREMENT CstrPurg_flgCpvDiagDteskActv "CPV diagnosis via DTESK active" UBYTE B_TRUE 1 100 0.00 1.00000000000 BIT_MASK 0x1 FORMAT "%13.11" ECU_ADDRESS 0x6000F6BE /end MEASUREMENT
/begin MEASUREMENT CstrPurg_flgCpvDiagDteskCpvOpenChk "CPV diagnosis via DTESK by opening the CPV active" UBYTE B_TRUE 1 100 0.00 1.00000000000 BIT_MASK 0x1 FORMAT "%13.11" ECU_ADDRESS 0x6000F6BD /end MEASUREMENT
/begin MEASUREMENT CstrPurg_flgCpvDiagDteskCpvStrtOpen "CPV diagnosis via DTESK start opening CPV" UBYTE B_TRUE 1 100 0.00 1.00000000000 BIT_MASK 0x1 FORMAT "%13.11" ECU_ADDRESS 0x6000F6BC /end MEASUREMENT
/begin MEASUREMENT CstrPurg_flgDiagCpv1DteskLoLoad "Diag CPV Bank1 in the low load purge line using DTESK algorithm (Release via code word)" UBYTE B_TRUE 1 100 0.00 1.00000000000 BIT_MASK 0x1 FORMAT "%13.11" ECU_ADDRESS 0x6000F6BB /end MEASUREMENT
/begin MEASUREMENT CstrPurg_flgTstrReq "general tester request" UBYTE B_TRUE 1 100 0.00 1.00000000000 BIT_MASK 0x1 FORMAT "%13.11" ECU_ADDRESS 0x6000F6B6 /end MEASUREMENT
/begin MEASUREMENT CstrPurg_mfDiagCpv1w "CPV Diagnosis requested massflow during diagnosis for the 1st. CPV" UWORD m_uw_b25p6 1 100 0.00 25.59961 FORMAT "%8.5" ECU_ADDRESS 0x60009504 /end MEASUREMENT
/begin MEASUREMENT ctdtesk05 "active counter for smallest leak diagnosis (0,5mm)" UBYTE dez 1 100 0.00 255.0 FORMAT "%5.1" ECU_ADDRESS 0x60000FE2 /end MEASUREMENT
/begin MEASUREMENT ddpterl_w_msg "threshold differential tank pressure for rough leak check" SWORD p_q0p00122 1 100 -40.00000 39.99878 FORMAT "%8.5" ECU_ADDRESS 0x600014D0 /end MEASUREMENT
/begin MEASUREMENT DEONVDFP_flgRstDsm "DSM Clear request flag for function DEONVDFP" UBYTE B_TRUE 1 100 0.00 1.00000000000 BIT_MASK 0x1 FORMAT "%13.11" ECU_ADDRESS 0x60000FB0 /end MEASUREMENT
/begin MEASUREMENT DEONVEB_flgRstDsm "Flag for DSM clear process" UBYTE B_TRUE 1 100 0.00 1.00000000000 BIT_MASK 0x1 FORMAT "%13.11" ECU_ADDRESS 0x600000F7 /end MEASUREMENT
/begin MEASUREMENT DEONVEB_pEnvP "Ambient pressure" UBYTE p_ub_q5 1 100 0.00 1275. FORMAT "%5.0" ECU_ADDRESS 0x60000FAF /end MEASUREMENT
/begin MEASUREMENT DEONVEB_tCEngDstStop "engine coolant temperature at engine stop or cut-off cranking" UBYTE temp_ub_q0p75_o48 1 100 -48.0 143.3 FORMAT "%5.1" ECU_ADDRESS 0x60000FAE /end MEASUREMENT
/begin MEASUREMENT DEONVEB_tCEngDsTStrtFrst "Engine coolant downstream temperature during the first engine start of the driving cycle." UBYTE temp_ub_q0p75_o48 1 100 -48.0 143.3 FORMAT "%5.1" ECU_ADDRESS 0x60000FAD /end MEASUREMENT
/begin MEASUREMENT DEONVEB_tEnvT "Actual physical value" UBYTE temp_ub_q0p75_o48 1 100 -48.0 143.3 FORMAT "%5.1" ECU_ADDRESS 0x60000FAC /end MEASUREMENT
/begin MEASUREMENT DEONVEB_uBatt "Battery voltage" UBYTE spg_q0p1 1 100 0.00 25.50 FORMAT "%5.2" ECU_ADDRESS 0x60000FAB /end MEASUREMENT
/begin MEASUREMENT DiaActrElecPsDiag_cntTestPlsTsk_mp "L-1 L=enNumber of testpulses in current driving cycleL-1" UWORD OneToOne 1 100 0.00 65535.00 FORMAT "%8.2" ECU_ADDRESS 0x70009DF2 /end MEASUREMENT
/begin MEASUREMENT DiaActrElecPsDiag_nrDiagErr_mp "Number of supported errors of the diagnosis signal" UBYTE OneToOne 1 100 0.00 255.0 FORMAT "%5.1" ECU_ADDRESS 0x70009FD9 /end MEASUREMENT
/begin MEASUREMENT DiaActrElecPsDiag_nrTestPls_mp "Number of testpulses in current driving cycle" ULONG OneToOne 1 100 0.00 4294967295.00 FORMAT "%13.2" ECU_ADDRESS 0x70009C18 /end MEASUREMENT
/begin MEASUREMENT DiaActrElecPsDiag_stAttribOL_mp "Current DSM attribute (Tested detection) of the open load error when reporting open load error to DSM module" ULONG OneToOne 1 100 0.00 4294967295.00 FORMAT "%13.2" ECU_ADDRESS 0x70009C14 /end MEASUREMENT
/begin MEASUREMENT DiaActrElecPsDiag_stAttribOT_mp "Current DSM attribute (Tested detection) of the overtemperature error when reporting overtemperature error to DSM module" ULONG OneToOne 1 100 0.00 4294967295.00 FORMAT "%13.2" ECU_ADDRESS 0x70009C10 /end MEASUREMENT
/begin MEASUREMENT DiaActrElecPsDiag_stAttribSCB_mp "Current DSM attribute (Tested detection) of the short circuit to battery error when reporting short circuit to battery error to DSM module" ULONG OneToOne 1 100 0.00 4294967295.00 FORMAT "%13.2" ECU_ADDRESS 0x70009C0C /end MEASUREMENT
/begin MEASUREMENT DiaActrElecPsDiag_stAttribSCG_mp "Current DSM attribute (Tested detection) of the short circuit to ground error when reporting short circuit to ground error to DSM module" ULONG OneToOne 1 100 0.00 4294967295.00 FORMAT "%13.2" ECU_ADDRESS 0x70009C08 /end MEASUREMENT
/begin MEASUREMENT DiaActrElecPsDiag_stDsmDebOpenLoad_mp "Debounce status of OL error" ULONG OneToOne 1 100 0.00 4294967295.00 FORMAT "%13.2" ECU_ADDRESS 0x70009C04 /end MEASUREMENT
/begin MEASUREMENT DiaActrElecPsDiag_stDsmDebOverT_mp "Debounce status of OT error" ULONG OneToOne 1 100 0.00 4294967295.00 FORMAT "%13.2" ECU_ADDRESS 0x70009C00 /end MEASUREMENT
/begin MEASUREMENT DiaActrElecPsDiag_stDsmDebScb_mp "Debounce status of SCB error" ULONG OneToOne 1 100 0.00 4294967295.00 FORMAT "%13.2" ECU_ADDRESS 0x70009BFC /end MEASUREMENT
/begin MEASUREMENT DiaActrElecPsDiag_stDsmDebScg_mp "Debounce status of SCG error" ULONG OneToOne 1 100 0.00 4294967295.00 FORMAT "%13.2" ECU_ADDRESS 0x70009BF8 /end MEASUREMENT
/begin MEASUREMENT DiaActrElecPsDiag_stErrCfgOpenLoad_mp "Configuration of behaviour for OL error" UBYTE OneToOne 1 100 0.00 255.0 FORMAT "%5.1" ECU_ADDRESS 0x70009FD8 /end MEASUREMENT
/begin MEASUREMENT DiaActrElecPsDiag_stErrCfgOverT_mp "Configuration of behaviour for OT error" UBYTE OneToOne 1 100 0.00 255.0 FORMAT "%5.1" ECU_ADDRESS 0x70009FD7 /end MEASUREMENT
/begin MEASUREMENT DiaActrElecPsDiag_stErrCfgScb_mp "Configuration of behaviour for SCB error" UBYTE OneToOne 1 100 0.00 255.0 FORMAT "%5.1" ECU_ADDRESS 0x70009FD6 /end MEASUREMENT
/begin MEASUREMENT DiaActrElecPsDiag_stErrCfgScg_mp "Configuration of behaviour for SCG error" UBYTE OneToOne 1 100 0.00 255.0 FORMAT "%5.1" ECU_ADDRESS 0x70009FD5 /end MEASUREMENT
/begin MEASUREMENT DiaActrElecPsDiag_stPrvTstRslt_mp "The latest result of test impulse" ULONG OneToOne 1 100 0.00 4294967295.00 FORMAT "%13.2" ECU_ADDRESS 0x70009BF4 /end MEASUREMENT
/begin MEASUREMENT DiaActrElecPsDiag_stSigCfg_mp "Configuration of the diagnosis signal" UBYTE OneToOne 1 100 0.00 255.0 FORMAT "%5.1" ECU_ADDRESS 0x70009FD4 /end MEASUREMENT
/begin MEASUREMENT DiaActrElecPsDiag_stSigErrInfo_mp "The last error information of HWE read from the chip" ULONG OneToOne 1 100 0.00 4294967295.00 FORMAT "%13.2" ECU_ADDRESS 0x70009BF0 /end MEASUREMENT
/begin MEASUREMENT DiaActrElecPsDiag_stSig_mp "Actual state of the diagnosis signal: INVALID, NOTEST, NOFAULT, FAULT, PREFAULT, HEALFAULT, WAITSTATE" UBYTE DiaActrElecPsDiag_stSig_COMPU_VERB 1 100 0.00 6.00000000000 FORMAT "%13.11" ECU_ADDRESS 0x70009FD3 /end MEASUREMENT
/begin MEASUREMENT DiaActrElecPsDiag_stTestPls_mp "L-1 L=enThe actual state of the testpulse state machine: NO, REQUESTED, RUN, FINISHED, RE-TRIGGEREDL-1" UBYTE DiaActrElecPsDiag_stTestPls_COMPU_VERB 1 100 1.00000000000 5.00000000000 FORMAT "%13.11" ECU_ADDRESS 0x70009FD2 /end MEASUREMENT
/begin MEASUREMENT DiaActrElecPsDiag_stTmngTestPls_mp "The current time to wait between two testpulses" UBYTE DiaActrElecPsDiag_stTmngTestPls_COMPU_VERB 1 100 0.00 3.00000000000 FORMAT "%13.11" ECU_ADDRESS 0x70009FD1 /end MEASUREMENT
/begin MEASUREMENT DiaActrElecPsDiag_tiTstPls_mp "Current status of timer for the time between testpulses during permanent fault" SWORD OneToOne 1 100 -32768.00 32767.00 FORMAT "%8.2" ECU_ADDRESS 0x70009DF0 /end MEASUREMENT
/begin MEASUREMENT DiaActrElecPsDiag_TstPlsCnt_Cfg_mp "Measurement points for test pulse counter setting" UBYTE OneToOne 1 100 0.00 255.0 FORMAT "%5.1" ECU_ADDRESS 0x70009FD0 /end MEASUREMENT
/begin MEASUREMENT DiagCpt_flgPSnsrTankClr "Flag for checking the DSM_clear in tank pressure sensor module" UBYTE B_TRUE 1 100 0.00 1.00000000000 BIT_MASK 0x1 FORMAT "%13.11" ECU_ADDRESS 0x60001025 /end MEASUREMENT
/begin MEASUREMENT DiagCpt_flgPSnsrTankIUMPRClr "Flag for checking the DSM_clear in tank pressure sensor IUMPR" UBYTE B_TRUE 1 100 0.00 1.00000000000 BIT_MASK 0x1 FORMAT "%13.11" ECU_ADDRESS 0x60001024 /end MEASUREMENT
/begin MEASUREMENT DiagCpv_cntrReIniBasc1 "Local variable to store the global drive cycle counter" UBYTE dez 1 100 0.00 255.0 FORMAT "%5.1" ECU_ADDRESS 0x6000F068 /end MEASUREMENT
/begin MEASUREMENT DiagCpv_flgCpv1TrbCdnFirstActvn "Turbo denominator purge conditions first time active for 2 seconds" UBYTE B_TRUE 1 100 0.00 1.00000000000 BIT_MASK 0x1 FORMAT "%13.11" ECU_ADDRESS 0x6000F067 /end MEASUREMENT
/begin MEASUREMENT DiagCpv_flgCpv1TrbCdnSecActvn "Turbo denominator purge conditions second time active for 2 seconds" UBYTE B_TRUE 1 100 0.00 1.00000000000 BIT_MASK 0x1 FORMAT "%13.11" ECU_ADDRESS 0x6000F066 /end MEASUREMENT
/begin MEASUREMENT DiagCpv_flgCpv2TrbCdnFirstActvn "Turbo denominator purge conditions first time active for 2 seconds- bank 2" UBYTE B_TRUE 1 100 0.00 1.00000000000 BIT_MASK 0x1 FORMAT "%13.11" ECU_ADDRESS 0x6000F065 /end MEASUREMENT
/begin MEASUREMENT DiagCpv_flgCpv2TrbCdnSecActvn "Turbo denominator purge conditions second time active for 2 seconds - bank 2" UBYTE B_TRUE 1 100 0.00 1.00000000000 BIT_MASK 0x1 FORMAT "%13.11" ECU_ADDRESS 0x6000F064 /end MEASUREMENT
/begin MEASUREMENT DiagCpv_flgReIniBasc1 "ReIni flag for Proc_1_20ms (calculation of High Load Purge Denominator)" UBYTE B_TRUE 1 100 0.00 1.00000000000 BIT_MASK 0x1 FORMAT "%13.11" ECU_ADDRESS 0x6000F998 /end MEASUREMENT
/begin MEASUREMENT DiagCpv_tiPrpnSysActv "Denominator high load purge line counter. Elapsed time with propulsion system active and environment temperature 4.4C." UWORD t_q0p02 1 100 0.00 1310.700 FORMAT "%8.3" ECU_ADDRESS 0x60007CCE /end MEASUREMENT
/begin MEASUREMENT DiagCpv_tiSumCpv1TrbCond "Denminator high load purge line counter. Accumulative elapsed time with purge conditions available." UWORD t_q0p02 1 100 0.00 1310.700 FORMAT "%8.3" ECU_ADDRESS 0x60007CCC /end MEASUREMENT
/begin MEASUREMENT DiagCpv_tiSumCpv2TrbCond "Denminator high load purge line counter. Accumulative elapsed time with purge conditions available - bank 2" UWORD t_q0p02 1 100 0.00 1310.700 FORMAT "%8.3" ECU_ADDRESS 0x60007CCA /end MEASUREMENT
/begin MEASUREMENT DINH_DSQSrv7Vis "Service 0x07 visibility of DSQs" UWORD OneToOne 1 100 0.00 65535.00 FORMAT "%8.2" ARRAY_SIZE 3 ECU_ADDRESS 0x500059D0 /end MEASUREMENT
/begin MEASUREMENT DINH_FIdSrv7Vis "Service 0x07 visibility of FIds" UWORD OneToOne 1 100 0.00 65535.00 FORMAT "%8.2" ARRAY_SIZE 61 ECU_ADDRESS 0x500059D6 /end MEASUREMENT
/begin MEASUREMENT DINH_nrActvInhReas.FID_AFRA "Number of active inhibit reasons for the FIds / Number of active inhibit reasons for FID_AFRA" UWORD DINH_ct_Compu 1 100 -4095.000 4096.000 BIT_MASK 0x1fff FORMAT "%8.3" ECU_ADDRESS 0x60013F0E /end MEASUREMENT
/begin MEASUREMENT DINH_nrActvInhReas.FID_AORA "Number of active inhibit reasons for the FIds / Number of active inhibit reasons for FID_AORA" UWORD DINH_ct_Compu 1 100 -4095.000 4096.000 BIT_MASK 0x1fff FORMAT "%8.3" ECU_ADDRESS 0x60013F10 /end MEASUREMENT
/begin MEASUREMENT DINH_nrActvInhReas.FID_ATEH "Number of active inhibit reasons for the FIds / Number of active inhibit reasons for FID_ATEH" UWORD DINH_ct_Compu 1 100 -4095.000 4096.000 BIT_MASK 0x1fff FORMAT "%8.3" ECU_ADDRESS 0x60013F12 /end MEASUREMENT
/begin MEASUREMENT DINH_nrActvInhReas.FID_ATEL "Number of active inhibit reasons for the FIds / Number of active inhibit reasons for FID_ATEL" UWORD DINH_ct_Compu 1 100 -4095.000 4096.000 BIT_MASK 0x1fff FORMAT "%8.3" ECU_ADDRESS 0x60013F14 /end MEASUREMENT
/begin MEASUREMENT DINH_nrActvInhReas.FID_ATEN "Number of active inhibit reasons for the FIds / Number of active inhibit reasons for FID_ATEN" UWORD DINH_ct_Compu 1 100 -4095.000 4096.000 BIT_MASK 0x1fff FORMAT "%8.3" ECU_ADDRESS 0x60013F16 /end MEASUREMENT
/begin MEASUREMENT DINH_nrActvInhReas.FID_ATLDI "Number of active inhibit reasons for the FIds / Number of active inhibit reasons for FID_ATLDI" UWORD DINH_ct_Compu 1 100 -4095.000 4096.000 BIT_MASK 0x1fff FORMAT "%8.3" ECU_ADDRESS 0x60013F18 /end MEASUREMENT
/begin MEASUREMENT DINH_nrActvInhReas.FID_ATLDO "Number of active inhibit reasons for the FIds / Number of active inhibit reasons for FID_ATLDO" UWORD DINH_ct_Compu 1 100 -4095.000 4096.000 BIT_MASK 0x1fff FORMAT "%8.3" ECU_ADDRESS 0x60013F1A /end MEASUREMENT
/begin MEASUREMENT DINH_nrActvInhReas.FID_BEONV "Number of active inhibit reasons for the FIds / Number of active inhibit reasons for FID_BEONV" UWORD DINH_ct_Compu 1 100 -4095.000 4096.000 BIT_MASK 0x1fff FORMAT "%8.3" ECU_ADDRESS 0x60013F1C /end MEASUREMENT
/begin MEASUREMENT DINH_nrActvInhReas.FId_EGSDCmnSeg1B1Parl "Number of active inhibit reasons for the FIds / Number of active inhibit reasons for FId_EGSDCmnSeg1B1Parl" UWORD DINH_ct_Compu 1 100 -4095.000 4096.000 BIT_MASK 0x1fff FORMAT "%8.3" ECU_ADDRESS 0x60013F1E /end MEASUREMENT
/begin MEASUREMENT DINH_nrActvInhReas.FID_BAGRA "Number of active inhibit reasons for the FIds / Number of active inhibit reasons for FID_BAGRA" UWORD DINH_ct_Compu 1 100 -4095.000 4096.000 BIT_MASK 0x1fff FORMAT "%8.3" ECU_ADDRESS 0x60013F20 /end MEASUREMENT
/begin MEASUREMENT DINH_nrActvInhReas.FID_BAGRASD "Number of active inhibit reasons for the FIds / Number of active inhibit reasons for FID_BAGRASD" UWORD DINH_ct_Compu 1 100 -4095.000 4096.000 BIT_MASK 0x1fff FORMAT "%8.3" ECU_ADDRESS 0x60013F22 /end MEASUREMENT
/begin MEASUREMENT DINH_nrActvInhReas.FID_BDSTOF "Number of active inhibit reasons for the FIds / Number of active inhibit reasons for FID_BDSTOF" UWORD DINH_ct_Compu 1 100 -4095.000 4096.000 BIT_MASK 0x1fff FORMAT "%8.3" ECU_ADDRESS 0x60013F24 /end MEASUREMENT
/begin MEASUREMENT DINH_nrActvInhReas.FID_BFVDFRM "Number of active inhibit reasons for the FIds / Number of active inhibit reasons for FID_BFVDFRM" UWORD DINH_ct_Compu 1 100 -4095.000 4096.000 BIT_MASK 0x1fff FORMAT "%8.3" ECU_ADDRESS 0x60013F26 /end MEASUREMENT
/begin MEASUREMENT DINH_nrActvInhReas.FID_BHOM "Number of active inhibit reasons for the FIds / Number of active inhibit reasons for FID_BHOM" UWORD DINH_ct_Compu 1 100 -4095.000 4096.000 BIT_MASK 0x1fff FORMAT "%8.3" ECU_ADDRESS 0x60013F28 /end MEASUREMENT
/begin MEASUREMENT DINH_nrActvInhReas.FID_BLLRH "Number of active inhibit reasons for the FIds / Number of active inhibit reasons for FID_BLLRH" UWORD DINH_ct_Compu 1 100 -4095.000 4096.000 BIT_MASK 0x1fff FORMAT "%8.3" ECU_ADDRESS 0x60013F2A /end MEASUREMENT
/begin MEASUREMENT DINH_nrActvInhReas.FID_BLLRKH "Number of active inhibit reasons for the FIds / Number of active inhibit reasons for FID_BLLRKH" UWORD DINH_ct_Compu 1 100 -4095.000 4096.000 BIT_MASK 0x1fff FORMAT "%8.3" ECU_ADDRESS 0x60013F2C /end MEASUREMENT
/begin MEASUREMENT DINH_nrActvInhReas.FID_BPLSU "Number of active inhibit reasons for the FIds / Number of active inhibit reasons for FID_BPLSU" UWORD DINH_ct_Compu 1 100 -4095.000 4096.000 BIT_MASK 0x1fff FORMAT "%8.3" ECU_ADDRESS 0x60013F2E /end MEASUREMENT
/begin MEASUREMENT DINH_nrActvInhReas.FID_FRAMBAVMB "Number of active inhibit reasons for the FIds / Number of active inhibit reasons for FID_FRAMBAVMB" UWORD DINH_ct_Compu 1 100 -4095.000 4096.000 BIT_MASK 0x1fff FORMAT "%8.3" ECU_ADDRESS 0x60013F30 /end MEASUREMENT
/begin MEASUREMENT DINH_nrActvInhReas.FId_CatHeatgColdStrtReq "Number of active inhibit reasons for the FIds / Number of active inhibit reasons for FId_CatHeatgColdStrtReq" UWORD DINH_ct_Compu 1 100 -4095.000 4096.000 BIT_MASK 0x1fff FORMAT "%8.3" ECU_ADDRESS 0x60013F32 /end MEASUREMENT
/begin MEASUREMENT DINH_nrActvInhReas.FId_CatHeatgWrmReq "Number of active inhibit reasons for the FIds / Number of active inhibit reasons for FId_CatHeatgWrmReq" UWORD DINH_ct_Compu 1 100 -4095.000 4096.000 BIT_MASK 0x1fff FORMAT "%8.3" ECU_ADDRESS 0x60013F34 /end MEASUREMENT
/begin MEASUREMENT DINH_nrActvInhReas.FId_DSMBDEPHSpOpMode "Number of active inhibit reasons for the FIds / Number of active inhibit reasons for FId_DSMBDEPHSpOpMode" UWORD DINH_ct_Compu 1 100 -4095.000 4096.000 BIT_MASK 0x1fff FORMAT "%8.3" ECU_ADDRESS 0x60013F36 /end MEASUREMENT
/begin MEASUREMENT DINH_nrActvInhReas.FId_EGRVlvCoord "Number of active inhibit reasons for the FIds / Number of active inhibit reasons for FId_EGRVlvCoord" UWORD DINH_ct_Compu 1 100 -4095.000 4096.000 BIT_MASK 0x1fff FORMAT "%8.3" ECU_ADDRESS 0x60013F38 /end MEASUREMENT
/begin MEASUREMENT DINH_nrActvInhReas.FId_EGSDO2FuTrmB1 "Number of active inhibit reasons for the FIds / Number of active inhibit reasons for FId_EGSDO2FuTrmB1" UWORD DINH_ct_Compu 1 100 -4095.000 4096.000 BIT_MASK 0x1fff FORMAT "%8.3" ECU_ADDRESS 0x60013F3A /end MEASUREMENT
/begin MEASUREMENT DINH_nrActvInhReas.FId_EGSDO2SnsrMntdRelsS1B1 "Number of active inhibit reasons for the FIds / Number of active inhibit reasons for FId_EGSDO2SnsrMntdRelsS1B1" UWORD DINH_ct_Compu 1 100 -4095.000 4096.000 BIT_MASK 0x1fff FORMAT "%8.3" ECU_ADDRESS 0x60013F3C /end MEASUREMENT
/begin MEASUREMENT DINH_nrActvInhReas.FId_EGSDO2_LamOffsFastS1B1 "Number of active inhibit reasons for the FIds / Number of active inhibit reasons for FId_EGSDO2_LamOffsFastS1B1" UWORD DINH_ct_Compu 1 100 -4095.000 4096.000 BIT_MASK 0x1fff FORMAT "%8.3" ECU_ADDRESS 0x60013F3E /end MEASUREMENT
/begin MEASUREMENT DINH_nrActvInhReas.FId_MisfDetDnAdpnNv "Number of active inhibit reasons for the FIds / Number of active inhibit reasons for FId_MisfDetDnAdpnNv" UWORD DINH_ct_Compu 1 100 -4095.000 4096.000 BIT_MASK 0x1fff FORMAT "%8.3" ECU_ADDRESS 0x60013F40 /end MEASUREMENT
/begin MEASUREMENT DINH_nrActvInhReas.FId_bascadpncvo "Number of active inhibit reasons for the FIds / Number of active inhibit reasons for FId_bascadpncvo" UWORD DINH_ct_Compu 1 100 -4095.000 4096.000 BIT_MASK 0x1fff FORMAT "%8.3" ECU_ADDRESS 0x60013F42 /end MEASUREMENT
/begin MEASUREMENT DINH_nrActvInhReas.FID_AGRS "Number of active inhibit reasons for the FIds / Number of active inhibit reasons for FID_AGRS" UWORD DINH_ct_Compu 1 100 -4095.000 4096.000 BIT_MASK 0x1fff FORMAT "%8.3" ECU_ADDRESS 0x60013F44 /end MEASUREMENT
/begin MEASUREMENT DINH_nrActvInhReas.FID_BBAGR "Number of active inhibit reasons for the FIds / Number of active inhibit reasons for FID_BBAGR" UWORD DINH_ct_Compu 1 100 -4095.000 4096.000 BIT_MASK 0x1fff FORMAT "%8.3" ECU_ADDRESS 0x60013F46 /end MEASUREMENT
/begin MEASUREMENT DINH_nrActvInhReas.FID_BBAGRA "Number of active inhibit reasons for the FIds / Number of active inhibit reasons for FID_BBAGRA" UWORD DINH_ct_Compu 1 100 -4095.000 4096.000 BIT_MASK 0x1fff FORMAT "%8.3" ECU_ADDRESS 0x60013F48 /end MEASUREMENT
/begin MEASUREMENT DINH_nrActvInhReas.FID_BGFKMS "Number of active inhibit reasons for the FIds / Number of active inhibit reasons for FID_BGFKMS" UWORD DINH_ct_Compu 1 100 -4095.000 4096.000 BIT_MASK 0x1fff FORMAT "%8.3" ECU_ADDRESS 0x60013F4A /end MEASUREMENT
/begin MEASUREMENT DINH_nrActvInhReas.FID_BGMSDKS "Number of active inhibit reasons for the FIds / Number of active inhibit reasons for FID_BGMSDKS" UWORD DINH_ct_Compu 1 100 -4095.000 4096.000 BIT_MASK 0x1fff FORMAT "%8.3" ECU_ADDRESS 0x60013F4C /end MEASUREMENT
/begin MEASUREMENT DINH_nrActvInhReas.FID_CAGRSUS "Number of active inhibit reasons for the FIds / Number of active inhibit reasons for FID_CAGRSUS" UWORD DINH_ct_Compu 1 100 -4095.000 4096.000 BIT_MASK 0x1fff FORMAT "%8.3" ECU_ADDRESS 0x60013F4E /end MEASUREMENT
/begin MEASUREMENT DINH_nrActvInhReas.FID_CBGTFUELM "Number of active inhibit reasons for the FIds / Number of active inhibit reasons for FID_CBGTFUELM" UWORD DINH_ct_Compu 1 100 -4095.000 4096.000 BIT_MASK 0x1fff FORMAT "%8.3" ECU_ADDRESS 0x60013F50 /end MEASUREMENT
/begin MEASUREMENT DINH_nrActvInhReas.FID_CBGTHDEV "Number of active inhibit reasons for the FIds / Number of active inhibit reasons for FID_CBGTHDEV" UWORD DINH_ct_Compu 1 100 -4095.000 4096.000 BIT_MASK 0x1fff FORMAT "%8.3" ECU_ADDRESS 0x60013F52 /end MEASUREMENT
/begin MEASUREMENT DINH_nrActvInhReas.FID_CDESVF "Number of active inhibit reasons for the FIds / Number of active inhibit reasons for FID_CDESVF" UWORD DINH_ct_Compu 1 100 -4095.000 4096.000 BIT_MASK 0x1fff FORMAT "%8.3" ECU_ADDRESS 0x60013F54 /end MEASUREMENT
/begin MEASUREMENT DINH_nrActvInhReas.FID_CDETHS "Number of active inhibit reasons for the FIds / Number of active inhibit reasons for FID_CDETHS" UWORD DINH_ct_Compu 1 100 -4095.000 4096.000 BIT_MASK 0x1fff FORMAT "%8.3" ECU_ADDRESS 0x60013F56 /end MEASUREMENT
/begin MEASUREMENT DINH_nrActvInhReas.FID_CDRCTSTRT "Number of active inhibit reasons for the FIds / Number of active inhibit reasons for FID_CDRCTSTRT" UWORD DINH_ct_Compu 1 100 -4095.000 4096.000 BIT_MASK 0x1fff FORMAT "%8.3" ECU_ADDRESS 0x60013F58 /end MEASUREMENT
/begin MEASUREMENT DINH_nrActvInhReas.FID_CDSKV "Number of active inhibit reasons for the FIds / Number of active inhibit reasons for FID_CDSKV" UWORD DINH_ct_Compu 1 100 -4095.000 4096.000 BIT_MASK 0x1fff FORMAT "%8.3" ECU_ADDRESS 0x60013F5A /end MEASUREMENT
/begin MEASUREMENT DINH_nrActvInhReas.FID_CDSKVRNO "Number of active inhibit reasons for the FIds / Number of active inhibit reasons for FID_CDSKVRNO" UWORD DINH_ct_Compu 1 100 -4095.000 4096.000 BIT_MASK 0x1fff FORMAT "%8.3" ECU_ADDRESS 0x60013F5C /end MEASUREMENT
/begin MEASUREMENT DINH_nrActvInhReas.FID_CDSKVRPO "Number of active inhibit reasons for the FIds / Number of active inhibit reasons for FID_CDSKVRPO" UWORD DINH_ct_Compu 1 100 -4095.000 4096.000 BIT_MASK 0x1fff FORMAT "%8.3" ECU_ADDRESS 0x60013F5E /end MEASUREMENT
/begin MEASUREMENT DINH_nrActvInhReas.FID_CDSKVRaty "Number of active inhibit reasons for the FIds / Number of active inhibit reasons for FID_CDSKVRaty" UWORD DINH_ct_Compu 1 100 -4095.000 4096.000 BIT_MASK 0x1fff FORMAT "%8.3" ECU_ADDRESS 0x60013F60 /end MEASUREMENT
/begin MEASUREMENT DINH_nrActvInhReas.FID_CDSKVRng "Number of active inhibit reasons for the FIds / Number of active inhibit reasons for FID_CDSKVRng" UWORD DINH_ct_Compu 1 100 -4095.000 4096.000 BIT_MASK 0x1fff FORMAT "%8.3" ECU_ADDRESS 0x60013F62 /end MEASUREMENT
/begin MEASUREMENT DINH_nrActvInhReas.FID_CDSKVS "Number of active inhibit reasons for the FIds / Number of active inhibit reasons for FID_CDSKVS" UWORD DINH_ct_Compu 1 100 -4095.000 4096.000 BIT_MASK 0x1fff FORMAT "%8.3" ECU_ADDRESS 0x60013F64 /end MEASUREMENT
/begin MEASUREMENT DINH_nrActvInhReas.FID_CDSTR "Number of active inhibit reasons for the FIds / Number of active inhibit reasons for FID_CDSTR" UWORD DINH_ct_Compu 1 100 -4095.000 4096.000 BIT_MASK 0x1fff FORMAT "%8.3" ECU_ADDRESS 0x60013F66 /end MEASUREMENT
/begin MEASUREMENT DINH_nrActvInhReas.FID_CDSTTI "Number of active inhibit reasons for the FIds / Number of active inhibit reasons for FID_CDSTTI" UWORD DINH_ct_Compu 1 100 -4095.000 4096.000 BIT_MASK 0x1fff FORMAT "%8.3" ECU_ADDRESS 0x60013F68 /end MEASUREMENT
/begin MEASUREMENT DINH_nrActvInhReas.FID_CETHG "Number of active inhibit reasons for the FIds / Number of active inhibit reasons for FID_CETHG" UWORD DINH_ct_Compu 1 100 -4095.000 4096.000 BIT_MASK 0x1fff FORMAT "%8.3" ECU_ADDRESS 0x60013F6A /end MEASUREMENT
/begin MEASUREMENT DINH_nrActvInhReas.FID_CETHSPLnpl "Number of active inhibit reasons for the FIds / Number of active inhibit reasons for FID_CETHSPLnpl" UWORD DINH_ct_Compu 1 100 -4095.000 4096.000 BIT_MASK 0x1fff FORMAT "%8.3" ECU_ADDRESS 0x60013F6C /end MEASUREMENT
/begin MEASUREMENT DINH_nrActvInhReas.FID_CETHSTPLnpl "Number of active inhibit reasons for the FIds / Number of active inhibit reasons for FID_CETHSTPLnpl" UWORD DINH_ct_Compu 1 100 -4095.000 4096.000 BIT_MASK 0x1fff FORMAT "%8.3" ECU_ADDRESS 0x60013F6E /end MEASUREMENT
/begin MEASUREMENT DINH_nrActvInhReas.FID_CETKHL "Number of active inhibit reasons for the FIds / Number of active inhibit reasons for FID_CETKHL" UWORD DINH_ct_Compu 1 100 -4095.000 4096.000 BIT_MASK 0x1fff FORMAT "%8.3" ECU_ADDRESS 0x60013F70 /end MEASUREMENT
/begin MEASUREMENT DINH_nrActvInhReas.FID_CETKHT "Number of active inhibit reasons for the FIds / Number of active inhibit reasons for FID_CETKHT" UWORD DINH_ct_Compu 1 100 -4095.000 4096.000 BIT_MASK 0x1fff FORMAT "%8.3" ECU_ADDRESS 0x60013F72 /end MEASUREMENT
/begin MEASUREMENT DINH_nrActvInhReas.FID_CGDISTRT "Number of active inhibit reasons for the FIds / Number of active inhibit reasons for FID_CGDISTRT" UWORD DINH_ct_Compu 1 100 -4095.000 4096.000 BIT_MASK 0x1fff FORMAT "%8.3" ECU_ADDRESS 0x60013F74 /end MEASUREMENT
/begin MEASUREMENT DINH_nrActvInhReas.FID_CGLSRDP "Number of active inhibit reasons for the FIds / Number of active inhibit reasons for FID_CGLSRDP" UWORD DINH_ct_Compu 1 100 -4095.000 4096.000 BIT_MASK 0x1fff FORMAT "%8.3" ECU_ADDRESS 0x60013F76 /end MEASUREMENT
/begin MEASUREMENT DINH_nrActvInhReas.FID_CHDR "Number of active inhibit reasons for the FIds / Number of active inhibit reasons for FID_CHDR" UWORD DINH_ct_Compu 1 100 -4095.000 4096.000 BIT_MASK 0x1fff FORMAT "%8.3" ECU_ADDRESS 0x60013F78 /end MEASUREMENT
/begin MEASUREMENT DINH_nrActvInhReas.FID_CHDRKH "Number of active inhibit reasons for the FIds / Number of active inhibit reasons for FID_CHDRKH" UWORD DINH_ct_Compu 1 100 -4095.000 4096.000 BIT_MASK 0x1fff FORMAT "%8.3" ECU_ADDRESS 0x60013F7A /end MEASUREMENT
/begin MEASUREMENT DINH_nrActvInhReas.FID_CHDRPL "Number of active inhibit reasons for the FIds / Number of active inhibit reasons for FID_CHDRPL" UWORD DINH_ct_Compu 1 100 -4095.000 4096.000 BIT_MASK 0x1fff FORMAT "%8.3" ECU_ADDRESS 0x60013F7C /end MEASUREMENT
/begin MEASUREMENT DINH_nrActvInhReas.FID_CLLKHV "Number of active inhibit reasons for the FIds / Number of active inhibit reasons for FID_CLLKHV" UWORD DINH_ct_Compu 1 100 -4095.000 4096.000 BIT_MASK 0x1fff FORMAT "%8.3" ECU_ADDRESS 0x60013F7E /end MEASUREMENT
/begin MEASUREMENT DINH_nrActvInhReas.FID_CLLRHV "Number of active inhibit reasons for the FIds / Number of active inhibit reasons for FID_CLLRHV" UWORD DINH_ct_Compu 1 100 -4095.000 4096.000 BIT_MASK 0x1fff FORMAT "%8.3" ECU_ADDRESS 0x60013F80 /end MEASUREMENT
/begin MEASUREMENT DINH_nrActvInhReas.FID_CLZSRDP "Number of active inhibit reasons for the FIds / Number of active inhibit reasons for FID_CLZSRDP" UWORD DINH_ct_Compu 1 100 -4095.000 4096.000 BIT_MASK 0x1fff FORMAT "%8.3" ECU_ADDRESS 0x60013F82 /end MEASUREMENT
/begin MEASUREMENT DINH_nrActvInhReas.FID_CLZSRHP "Number of active inhibit reasons for the FIds / Number of active inhibit reasons for FID_CLZSRHP" UWORD DINH_ct_Compu 1 100 -4095.000 4096.000 BIT_MASK 0x1fff FORMAT "%8.3" ECU_ADDRESS 0x60013F84 /end MEASUREMENT
/begin MEASUREMENT DINH_nrActvInhReas.FID_CNLHP "Number of active inhibit reasons for the FIds / Number of active inhibit reasons for FID_CNLHP" UWORD DINH_ct_Compu 1 100 -4095.000 4096.000 BIT_MASK 0x1fff FORMAT "%8.3" ECU_ADDRESS 0x60013F86 /end MEASUREMENT
/begin MEASUREMENT DINH_nrActvInhReas.FID_CNLHP2 "Number of active inhibit reasons for the FIds / Number of active inhibit reasons for FID_CNLHP2" UWORD DINH_ct_Compu 1 100 -4095.000 4096.000 BIT_MASK 0x1fff FORMAT "%8.3" ECU_ADDRESS 0x60013F88 /end MEASUREMENT
/begin MEASUREMENT DINH_nrActvInhReas.FID_CNLKO2 "Number of active inhibit reasons for the FIds / Number of active inhibit reasons for FID_CNLKO2" UWORD DINH_ct_Compu 1 100 -4095.000 4096.000 BIT_MASK 0x1fff FORMAT "%8.3" ECU_ADDRESS 0x60013F8A /end MEASUREMENT
/begin MEASUREMENT DINH_nrActvInhReas.FID_CNLKO3 "Number of active inhibit reasons for the FIds / Number of active inhibit reasons for FID_CNLKO3" UWORD DINH_ct_Compu 1 100 -4095.000 4096.000 BIT_MASK 0x1fff FORMAT "%8.3" ECU_ADDRESS 0x60013F8C /end MEASUREMENT
/begin MEASUREMENT DINH_nrActvInhReas.FID_CNLLP "Number of active inhibit reasons for the FIds / Number of active inhibit reasons for FID_CNLLP" UWORD DINH_ct_Compu 1 100 -4095.000 4096.000 BIT_MASK 0x1fff FORMAT "%8.3" ECU_ADDRESS 0x60013F8E /end MEASUREMENT
/begin MEASUREMENT DINH_nrActvInhReas.FID_CNLPL "Number of active inhibit reasons for the FIds / Number of active inhibit reasons for FID_CNLPL" UWORD DINH_ct_Compu 1 100 -4095.000 4096.000 BIT_MASK 0x1fff FORMAT "%8.3" ECU_ADDRESS 0x60013F90 /end MEASUREMENT
/begin MEASUREMENT DINH_nrActvInhReas.FID_CNLPS "Number of active inhibit reasons for the FIds / Number of active inhibit reasons for FID_CNLPS" UWORD DINH_ct_Compu 1 100 -4095.000 4096.000 BIT_MASK 0x1fff FORMAT "%8.3" ECU_ADDRESS 0x60013F92 /end MEASUREMENT
/begin MEASUREMENT DINH_nrActvInhReas.FID_CNSAD "Number of active inhibit reasons for the FIds / Number of active inhibit reasons for FID_CNSAD" UWORD DINH_ct_Compu 1 100 -4095.000 4096.000 BIT_MASK 0x1fff FORMAT "%8.3" ECU_ADDRESS 0x60013F94 /end MEASUREMENT
/begin MEASUREMENT DINH_nrActvInhReas.FID_CNSAD2 "Number of active inhibit reasons for the FIds / Number of active inhibit reasons for FID_CNSAD2" UWORD DINH_ct_Compu 1 100 -4095.000 4096.000 BIT_MASK 0x1fff FORMAT "%8.3" ECU_ADDRESS 0x60013F96 /end MEASUREMENT
/begin MEASUREMENT DINH_nrActvInhReas.FID_CPSRB "Number of active inhibit reasons for the FIds / Number of active inhibit reasons for FID_CPSRB" UWORD DINH_ct_Compu 1 100 -4095.000 4096.000 BIT_MASK 0x1fff FORMAT "%8.3" ECU_ADDRESS 0x60013F98 /end MEASUREMENT
/begin MEASUREMENT DINH_nrActvInhReas.FID_CPSRP "Number of active inhibit reasons for the FIds / Number of active inhibit reasons for FID_CPSRP" UWORD DINH_ct_Compu 1 100 -4095.000 4096.000 BIT_MASK 0x1fff FORMAT "%8.3" ECU_ADDRESS 0x60013F9A /end MEASUREMENT
/begin MEASUREMENT DINH_nrActvInhReas.FID_CSTHDR "Number of active inhibit reasons for the FIds / Number of active inhibit reasons for FID_CSTHDR" UWORD DINH_ct_Compu 1 100 -4095.000 4096.000 BIT_MASK 0x1fff FORMAT "%8.3" ECU_ADDRESS 0x60013F9C /end MEASUREMENT
/begin MEASUREMENT DINH_nrActvInhReas.FID_CSTRTCTL "Number of active inhibit reasons for the FIds / Number of active inhibit reasons for FID_CSTRTCTL" UWORD DINH_ct_Compu 1 100 -4095.000 4096.000 BIT_MASK 0x1fff FORMAT "%8.3" ECU_ADDRESS 0x60013F9E /end MEASUREMENT
/begin MEASUREMENT DINH_nrActvInhReas.FID_CTESF "Number of active inhibit reasons for the FIds / Number of active inhibit reasons for FID_CTESF" UWORD DINH_ct_Compu 1 100 -4095.000 4096.000 BIT_MASK 0x1fff FORMAT "%8.3" ECU_ADDRESS 0x60013FA0 /end MEASUREMENT
/begin MEASUREMENT DINH_nrActvInhReas.FID_CTESG "Number of active inhibit reasons for the FIds / Number of active inhibit reasons for FID_CTESG" UWORD DINH_ct_Compu 1 100 -4095.000 4096.000 BIT_MASK 0x1fff FORMAT "%8.3" ECU_ADDRESS 0x60013FA2 /end MEASUREMENT
/begin MEASUREMENT DINH_nrActvInhReas.FID_CTHIPSTRT "Number of active inhibit reasons for the FIds / Number of active inhibit reasons for FID_CTHIPSTRT" UWORD DINH_ct_Compu 1 100 -4095.000 4096.000 BIT_MASK 0x1fff FORMAT "%8.3" ECU_ADDRESS 0x60013FA4 /end MEASUREMENT
/begin MEASUREMENT DINH_nrActvInhReas.FID_CTKACS "Number of active inhibit reasons for the FIds / Number of active inhibit reasons for FID_CTKACS" UWORD DINH_ct_Compu 1 100 -4095.000 4096.000 BIT_MASK 0x1fff FORMAT "%8.3" ECU_ADDRESS 0x60013FA6 /end MEASUREMENT
/begin MEASUREMENT DINH_nrActvInhReas.FID_CTMSV "Number of active inhibit reasons for the FIds / Number of active inhibit reasons for FID_CTMSV" UWORD DINH_ct_Compu 1 100 -4095.000 4096.000 BIT_MASK 0x1fff FORMAT "%8.3" ECU_ADDRESS 0x60013FA8 /end MEASUREMENT
/begin MEASUREMENT DINH_nrActvInhReas.FID_CTOSP "Number of active inhibit reasons for the FIds / Number of active inhibit reasons for FID_CTOSP" UWORD DINH_ct_Compu 1 100 -4095.000 4096.000 BIT_MASK 0x1fff FORMAT "%8.3" ECU_ADDRESS 0x60013FAA /end MEASUREMENT
/begin MEASUREMENT DINH_nrActvInhReas.FID_DHFERR "Number of active inhibit reasons for the FIds / Number of active inhibit reasons for FID_DHFERR" UWORD DINH_ct_Compu 1 100 -4095.000 4096.000 BIT_MASK 0x1fff FORMAT "%8.3" ECU_ADDRESS 0x60013FAC /end MEASUREMENT
/begin MEASUREMENT DINH_nrActvInhReas.FID_DKRSA "Number of active inhibit reasons for the FIds / Number of active inhibit reasons for FID_DKRSA" UWORD DINH_ct_Compu 1 100 -4095.000 4096.000 BIT_MASK 0x1fff FORMAT "%8.3" ECU_ADDRESS 0x60013FAE /end MEASUREMENT
/begin MEASUREMENT DINH_nrActvInhReas.FID_DLLRBandEndTst "Number of active inhibit reasons for the FIds / Number of active inhibit reasons for FID_DLLRBandEndTst" UWORD DINH_ct_Compu 1 100 -4095.000 4096.000 BIT_MASK 0x1fff FORMAT "%8.3" ECU_ADDRESS 0x60013FB0 /end MEASUREMENT
/begin MEASUREMENT DINH_nrActvInhReas.FID_DLLRShrtTrpSpdRmp "Number of active inhibit reasons for the FIds / Number of active inhibit reasons for FID_DLLRShrtTrpSpdRmp" UWORD DINH_ct_Compu 1 100 -4095.000 4096.000 BIT_MASK 0x1fff FORMAT "%8.3" ECU_ADDRESS 0x60013FB2 /end MEASUREMENT
/begin MEASUREMENT DINH_nrActvInhReas.FID_FEDKAHB "Number of active inhibit reasons for the FIds / Number of active inhibit reasons for FID_FEDKAHB" UWORD DINH_ct_Compu 1 100 -4095.000 4096.000 BIT_MASK 0x1fff FORMAT "%8.3" ECU_ADDRESS 0x60013FB4 /end MEASUREMENT
/begin MEASUREMENT DINH_nrActvInhReas.FID_FEDKAPB "Number of active inhibit reasons for the FIds / Number of active inhibit reasons for FID_FEDKAPB" UWORD DINH_ct_Compu 1 100 -4095.000 4096.000 BIT_MASK 0x1fff FORMAT "%8.3" ECU_ADDRESS 0x60013FB6 /end MEASUREMENT
/begin MEASUREMENT DINH_nrActvInhReas.FID_FEDSSB "Number of active inhibit reasons for the FIds / Number of active inhibit reasons for FID_FEDSSB" UWORD DINH_ct_Compu 1 100 -4095.000 4096.000 BIT_MASK 0x1fff FORMAT "%8.3" ECU_ADDRESS 0x60013FB8 /end MEASUREMENT
/begin MEASUREMENT DINH_nrActvInhReas.FID_FOFSTP "Number of active inhibit reasons for the FIds / Number of active inhibit reasons for FID_FOFSTP" UWORD DINH_ct_Compu 1 100 -4095.000 4096.000 BIT_MASK 0x1fff FORMAT "%8.3" ECU_ADDRESS 0x60013FBA /end MEASUREMENT
/begin MEASUREMENT DINH_nrActvInhReas.FID_FONSTP "Number of active inhibit reasons for the FIds / Number of active inhibit reasons for FID_FONSTP" UWORD DINH_ct_Compu 1 100 -4095.000 4096.000 BIT_MASK 0x1fff FORMAT "%8.3" ECU_ADDRESS 0x60013FBC /end MEASUREMENT
/begin MEASUREMENT DINH_nrActvInhReas.FID_FUEDK "Number of active inhibit reasons for the FIds / Number of active inhibit reasons for FID_FUEDK" UWORD DINH_ct_Compu 1 100 -4095.000 4096.000 BIT_MASK 0x1fff FORMAT "%8.3" ECU_ADDRESS 0x60013FBE /end MEASUREMENT
/begin MEASUREMENT DINH_nrActvInhReas.FID_FVLRA "Number of active inhibit reasons for the FIds / Number of active inhibit reasons for FID_FVLRA" UWORD DINH_ct_Compu 1 100 -4095.000 4096.000 BIT_MASK 0x1fff FORMAT "%8.3" ECU_ADDRESS 0x60013FC0 /end MEASUREMENT
/begin MEASUREMENT DINH_nrActvInhReas.FID_KRREGact "Number of active inhibit reasons for the FIds / Number of active inhibit reasons for FID_KRREGact" UWORD DINH_ct_Compu 1 100 -4095.000 4096.000 BIT_MASK 0x1fff FORMAT "%8.3" ECU_ADDRESS 0x60013FC2 /end MEASUREMENT
/begin MEASUREMENT DINH_nrActvInhReas.FID_KRREGloc "Number of active inhibit reasons for the FIds / Number of active inhibit reasons for FID_KRREGloc" UWORD DINH_ct_Compu 1 100 -4095.000 4096.000 BIT_MASK 0x1fff FORMAT "%8.3" ECU_ADDRESS 0x60013FC4 /end MEASUREMENT
/begin MEASUREMENT DINH_nrActvInhReas.FID_LRADLSU "Number of active inhibit reasons for the FIds / Number of active inhibit reasons for FID_LRADLSU" UWORD DINH_ct_Compu 1 100 -4095.000 4096.000 BIT_MASK 0x1fff FORMAT "%8.3" ECU_ADDRESS 0x60013FC6 /end MEASUREMENT
/begin MEASUREMENT DINH_nrActvInhReas.FID_LRALSVErr "Number of active inhibit reasons for the FIds / Number of active inhibit reasons for FID_LRALSVErr" UWORD DINH_ct_Compu 1 100 -4095.000 4096.000 BIT_MASK 0x1fff FORMAT "%8.3" ECU_ADDRESS 0x60013FC8 /end MEASUREMENT
/begin MEASUREMENT DINH_nrActvInhReas.FID_LRAPLLSU "Number of active inhibit reasons for the FIds / Number of active inhibit reasons for FID_LRAPLLSU" UWORD DINH_ct_Compu 1 100 -4095.000 4096.000 BIT_MASK 0x1fff FORMAT "%8.3" ECU_ADDRESS 0x60013FCA /end MEASUREMENT
/begin MEASUREMENT DINH_nrActvInhReas.FID_LUSTP "Number of active inhibit reasons for the FIds / Number of active inhibit reasons for FID_LUSTP" UWORD DINH_ct_Compu 1 100 -4095.000 4096.000 BIT_MASK 0x1fff FORMAT "%8.3" ECU_ADDRESS 0x60013FCC /end MEASUREMENT
/begin MEASUREMENT DINH_nrActvInhReas.FID_LnKS1 "Number of active inhibit reasons for the FIds / Number of active inhibit reasons for FID_LnKS1" UWORD DINH_ct_Compu 1 100 -4095.000 4096.000 BIT_MASK 0x1fff FORMAT "%8.3" ECU_ADDRESS 0x60013FCE /end MEASUREMENT
/begin MEASUREMENT DINH_nrActvInhReas.FID_PLSUV "Number of active inhibit reasons for the FIds / Number of active inhibit reasons for FID_PLSUV" UWORD DINH_ct_Compu 1 100 -4095.000 4096.000 BIT_MASK 0x1fff FORMAT "%8.3" ECU_ADDRESS 0x60013FD0 /end MEASUREMENT
/begin MEASUREMENT DINH_nrActvInhReas.FID_PSRMOZDG "Number of active inhibit reasons for the FIds / Number of active inhibit reasons for FID_PSRMOZDG" UWORD DINH_ct_Compu 1 100 -4095.000 4096.000 BIT_MASK 0x1fff FORMAT "%8.3" ECU_ADDRESS 0x60013FD2 /end MEASUREMENT
/begin MEASUREMENT DINH_nrActvInhReas.FID_PSRMOZG "Number of active inhibit reasons for the FIds / Number of active inhibit reasons for FID_PSRMOZG" UWORD DINH_ct_Compu 1 100 -4095.000 4096.000 BIT_MASK 0x1fff FORMAT "%8.3" ECU_ADDRESS 0x60013FD4 /end MEASUREMENT
/begin MEASUREMENT DINH_nrActvInhReas.FID_STRTDIA "Number of active inhibit reasons for the FIds / Number of active inhibit reasons for FID_STRTDIA" UWORD DINH_ct_Compu 1 100 -4095.000 4096.000 BIT_MASK 0x1fff FORMAT "%8.3" ECU_ADDRESS 0x60013FD6 /end MEASUREMENT
/begin MEASUREMENT DINH_nrActvInhReas.FID_STRTSTM "Number of active inhibit reasons for the FIds / Number of active inhibit reasons for FID_STRTSTM" UWORD DINH_ct_Compu 1 100 -4095.000 4096.000 BIT_MASK 0x1fff FORMAT "%8.3" ECU_ADDRESS 0x60013FD8 /end MEASUREMENT
/begin MEASUREMENT DINH_nrActvInhReas.FID_TFA1CSMW "Number of active inhibit reasons for the FIds / Number of active inhibit reasons for FID_TFA1CSMW" UWORD DINH_ct_Compu 1 100 -4095.000 4096.000 BIT_MASK 0x1fff FORMAT "%8.3" ECU_ADDRESS 0x60013FDA /end MEASUREMENT
/begin MEASUREMENT DINH_nrActvInhReas.FID_TFA2CSMW "Number of active inhibit reasons for the FIds / Number of active inhibit reasons for FID_TFA2CSMW" UWORD DINH_ct_Compu 1 100 -4095.000 4096.000 BIT_MASK 0x1fff FORMAT "%8.3" ECU_ADDRESS 0x60013FDC /end MEASUREMENT
/begin MEASUREMENT DINH_nrActvInhReas.FID_TKACSMW "Number of active inhibit reasons for the FIds / Number of active inhibit reasons for FID_TKACSMW" UWORD DINH_ct_Compu 1 100 -4095.000 4096.000 BIT_MASK 0x1fff FORMAT "%8.3" ECU_ADDRESS 0x60013FDE /end MEASUREMENT
/begin MEASUREMENT DINH_nrActvInhReas.FID_TMCSMW "Number of active inhibit reasons for the FIds / Number of active inhibit reasons for FID_TMCSMW" UWORD DINH_ct_Compu 1 100 -4095.000 4096.000 BIT_MASK 0x1fff FORMAT "%8.3" ECU_ADDRESS 0x60013FE0 /end MEASUREMENT
/begin MEASUREMENT DINH_nrActvInhReas.FID_TOCHOilSwmpTQly "Number of active inhibit reasons for the FIds / Number of active inhibit reasons for FID_TOCHOilSwmpTQly" UWORD DINH_ct_Compu 1 100 -4095.000 4096.000 BIT_MASK 0x1fff FORMAT "%8.3" ECU_ADDRESS 0x60013FE2 /end MEASUREMENT
/begin MEASUREMENT DINH_nrActvInhReas.FID_TOCHTME "Number of active inhibit reasons for the FIds / Number of active inhibit reasons for FID_TOCHTME" UWORD DINH_ct_Compu 1 100 -4095.000 4096.000 BIT_MASK 0x1fff FORMAT "%8.3" ECU_ADDRESS 0x60013FE4 /end MEASUREMENT
/begin MEASUREMENT DINH_nrActvInhReas.FID_TOSPCSMW "Number of active inhibit reasons for the FIds / Number of active inhibit reasons for FID_TOSPCSMW" UWORD DINH_ct_Compu 1 100 -4095.000 4096.000 BIT_MASK 0x1fff FORMAT "%8.3" ECU_ADDRESS 0x60013FE6 /end MEASUREMENT
/begin MEASUREMENT DINH_nrActvInhReas.FID_TSRLX "Number of active inhibit reasons for the FIds / Number of active inhibit reasons for FID_TSRLX" UWORD DINH_ct_Compu 1 100 -4095.000 4096.000 BIT_MASK 0x1fff FORMAT "%8.3" ECU_ADDRESS 0x60013FE8 /end MEASUREMENT
/begin MEASUREMENT DINH_nrActvInhReas.FID_UEGOHeatrRlyS1B1 "Number of active inhibit reasons for the FIds / Number of active inhibit reasons for FID_UEGOHeatrRlyS1B1" UWORD DINH_ct_Compu 1 100 -4095.000 4096.000 BIT_MASK 0x1fff FORMAT "%8.3" ECU_ADDRESS 0x60013FEA /end MEASUREMENT
/begin MEASUREMENT DINH_nrActvInhReas.FID_VehStvSSEOk "Number of active inhibit reasons for the FIds / Number of active inhibit reasons for FID_VehStvSSEOk" UWORD DINH_ct_Compu 1 100 -4095.000 4096.000 BIT_MASK 0x1fff FORMAT "%8.3" ECU_ADDRESS 0x60013FEC /end MEASUREMENT
/begin MEASUREMENT DINH_nrActvInhReas.FID_VldtLamPlausMaxS1B1 "Number of active inhibit reasons for the FIds / Number of active inhibit reasons for FID_VldtLamPlausMaxS1B1" UWORD DINH_ct_Compu 1 100 -4095.000 4096.000 BIT_MASK 0x1fff FORMAT "%8.3" ECU_ADDRESS 0x60013FEE /end MEASUREMENT
/begin MEASUREMENT DINH_nrActvInhReas.FID_VldtLamPlausMinS1B1 "Number of active inhibit reasons for the FIds / Number of active inhibit reasons for FID_VldtLamPlausMinS1B1" UWORD DINH_ct_Compu 1 100 -4095.000 4096.000 BIT_MASK 0x1fff FORMAT "%8.3" ECU_ADDRESS 0x60013FF0 /end MEASUREMENT
/begin MEASUREMENT DINH_nrActvInhReas.FId_ACClntPSSPMon "Number of active inhibit reasons for the FIds / Number of active inhibit reasons for FId_ACClntPSSPMon" UWORD DINH_ct_Compu 1 100 -4095.000 4096.000 BIT_MASK 0x1fff FORMAT "%8.3" ECU_ADDRESS 0x60013FF2 /end MEASUREMENT
/begin MEASUREMENT DINH_nrActvInhReas.FId_ACCompComCANBusOff "Number of active inhibit reasons for the FIds / Number of active inhibit reasons for FId_ACCompComCANBusOff" UWORD DINH_ct_Compu 1 100 -4095.000 4096.000 BIT_MASK 0x1fff FORMAT "%8.3" ECU_ADDRESS 0x60013FF4 /end MEASUREMENT
/begin MEASUREMENT DINH_nrActvInhReas.FId_ACCompComCANErrMtr "Number of active inhibit reasons for the FIds / Number of active inhibit reasons for FId_ACCompComCANErrMtr" UWORD DINH_ct_Compu 1 100 -4095.000 4096.000 BIT_MASK 0x1fff FORMAT "%8.3" ECU_ADDRESS 0x60013FF6 /end MEASUREMENT
/begin MEASUREMENT DINH_nrActvInhReas.FId_ACComp_HiUTWSnsrErr "Number of active inhibit reasons for the FIds / Number of active inhibit reasons for FId_ACComp_HiUTWSnsrErr" UWORD DINH_ct_Compu 1 100 -4095.000 4096.000 BIT_MASK 0x1fff FORMAT "%8.3" ECU_ADDRESS 0x60013FF8 /end MEASUREMENT
/begin MEASUREMENT DINH_nrActvInhReas.FId_ACComp_LoUTWSnsrErr "Number of active inhibit reasons for the FIds / Number of active inhibit reasons for FId_ACComp_LoUTWSnsrErr" UWORD DINH_ct_Compu 1 100 -4095.000 4096.000 BIT_MASK 0x1fff FORMAT "%8.3" ECU_ADDRESS 0x60013FFA /end MEASUREMENT
/begin MEASUREMENT DINH_nrActvInhReas.FId_ACComp_PDSnsrErr "Number of active inhibit reasons for the FIds / Number of active inhibit reasons for FId_ACComp_PDSnsrErr" UWORD DINH_ct_Compu 1 100 -4095.000 4096.000 BIT_MASK 0x1fff FORMAT "%8.3" ECU_ADDRESS 0x60013FFC /end MEASUREMENT
/begin MEASUREMENT DINH_nrActvInhReas.FId_ACComp_VehSpdSnsrErr "Number of active inhibit reasons for the FIds / Number of active inhibit reasons for FId_ACComp_VehSpdSnsrErr" UWORD DINH_ct_Compu 1 100 -4095.000 4096.000 BIT_MASK 0x1fff FORMAT "%8.3" ECU_ADDRESS 0x60013FFE /end MEASUREMENT
/begin MEASUREMENT DINH_nrActvInhReas.FId_ACCtl_ACStrtCut "Number of active inhibit reasons for the FIds / Number of active inhibit reasons for FId_ACCtl_ACStrtCut" UWORD DINH_ct_Compu 1 100 -4095.000 4096.000 BIT_MASK 0x1fff FORMAT "%8.3" ECU_ADDRESS 0x60014000 /end MEASUREMENT
/begin MEASUREMENT DINH_nrActvInhReas.FId_ACCtl_APP1 "Number of active inhibit reasons for the FIds / Number of active inhibit reasons for FId_ACCtl_APP1" UWORD DINH_ct_Compu 1 100 -4095.000 4096.000 BIT_MASK 0x1fff FORMAT "%8.3" ECU_ADDRESS 0x60014002 /end MEASUREMENT
/begin MEASUREMENT DINH_nrActvInhReas.FId_ACCtl_APP2 "Number of active inhibit reasons for the FIds / Number of active inhibit reasons for FId_ACCtl_APP2" UWORD DINH_ct_Compu 1 100 -4095.000 4096.000 BIT_MASK 0x1fff FORMAT "%8.3" ECU_ADDRESS 0x60014004 /end MEASUREMENT
/begin MEASUREMENT DINH_nrActvInhReas.FId_ACCtl_APPSync "Number of active inhibit reasons for the FIds / Number of active inhibit reasons for FId_ACCtl_APPSync" UWORD DINH_ct_Compu 1 100 -4095.000 4096.000 BIT_MASK 0x1fff FORMAT "%8.3" ECU_ADDRESS 0x60014006 /end MEASUREMENT
/begin MEASUREMENT DINH_nrActvInhReas.FId_ACCtl_AcOff "Number of active inhibit reasons for the FIds / Number of active inhibit reasons for FId_ACCtl_AcOff" UWORD DINH_ct_Compu 1 100 -4095.000 4096.000 BIT_MASK 0x1fff FORMAT "%8.3" ECU_ADDRESS 0x60014008 /end MEASUREMENT
/begin MEASUREMENT DINH_nrActvInhReas.FId_ACCtl_Clmb "Number of active inhibit reasons for the FIds / Number of active inhibit reasons for FId_ACCtl_Clmb" UWORD DINH_ct_Compu 1 100 -4095.000 4096.000 BIT_MASK 0x1fff FORMAT "%8.3" ECU_ADDRESS 0x6001400A /end MEASUREMENT
/begin MEASUREMENT DINH_nrActvInhReas.FId_ACCtl_DK1 "Number of active inhibit reasons for the FIds / Number of active inhibit reasons for FId_ACCtl_DK1" UWORD DINH_ct_Compu 1 100 -4095.000 4096.000 BIT_MASK 0x1fff FORMAT "%8.3" ECU_ADDRESS 0x6001400C /end MEASUREMENT
/begin MEASUREMENT DINH_nrActvInhReas.FId_ACCtl_DK2 "Number of active inhibit reasons for the FIds / Number of active inhibit reasons for FId_ACCtl_DK2" UWORD DINH_ct_Compu 1 100 -4095.000 4096.000 BIT_MASK 0x1fff FORMAT "%8.3" ECU_ADDRESS 0x6001400E /end MEASUREMENT
/begin MEASUREMENT DINH_nrActvInhReas.FId_ACCtl_DKSync "Number of active inhibit reasons for the FIds / Number of active inhibit reasons for FId_ACCtl_DKSync" UWORD DINH_ct_Compu 1 100 -4095.000 4096.000 BIT_MASK 0x1fff FORMAT "%8.3" ECU_ADDRESS 0x60014010 /end MEASUREMENT
/begin MEASUREMENT DINH_nrActvInhReas.FId_ACCtl_VehSpdSnsrErr "Number of active inhibit reasons for the FIds / Number of active inhibit reasons for FId_ACCtl_VehSpdSnsrErr" UWORD DINH_ct_Compu 1 100 -4095.000 4096.000 BIT_MASK 0x1fff FORMAT "%8.3" ECU_ADDRESS 0x60014012 /end MEASUREMENT
/begin MEASUREMENT DINH_nrActvInhReas.FId_ACCtl_pAC "Number of active inhibit reasons for the FIds / Number of active inhibit reasons for FId_ACCtl_pAC" UWORD DINH_ct_Compu 1 100 -4095.000 4096.000 BIT_MASK 0x1fff FORMAT "%8.3" ECU_ADDRESS 0x60014014 /end MEASUREMENT
/begin MEASUREMENT DINH_nrActvInhReas.FId_ACEvpTCANErr "Number of active inhibit reasons for the FIds / Number of active inhibit reasons for FId_ACEvpTCANErr" UWORD DINH_ct_Compu 1 100 -4095.000 4096.000 BIT_MASK 0x1fff FORMAT "%8.3" ECU_ADDRESS 0x60014016 /end MEASUREMENT
/begin MEASUREMENT DINH_nrActvInhReas.FId_ACEvpTFrzVal "Number of active inhibit reasons for the FIds / Number of active inhibit reasons for FId_ACEvpTFrzVal" UWORD DINH_ct_Compu 1 100 -4095.000 4096.000 BIT_MASK 0x1fff FORMAT "%8.3" ECU_ADDRESS 0x60014018 /end MEASUREMENT
/begin MEASUREMENT DINH_nrActvInhReas.FId_ACEvpTPhysRng "Number of active inhibit reasons for the FIds / Number of active inhibit reasons for FId_ACEvpTPhysRng" UWORD DINH_ct_Compu 1 100 -4095.000 4096.000 BIT_MASK 0x1fff FORMAT "%8.3" ECU_ADDRESS 0x6001401A /end MEASUREMENT
/begin MEASUREMENT DINH_nrActvInhReas.FId_ACEvpTRplVal "Number of active inhibit reasons for the FIds / Number of active inhibit reasons for FId_ACEvpTRplVal" UWORD DINH_ct_Compu 1 100 -4095.000 4096.000 BIT_MASK 0x1fff FORMAT "%8.3" ECU_ADDRESS 0x6001401C /end MEASUREMENT
/begin MEASUREMENT DINH_nrActvInhReas.FId_AFCLFailr "Number of active inhibit reasons for the FIds / Number of active inhibit reasons for FId_AFCLFailr" UWORD DINH_ct_Compu 1 100 -4095.000 4096.000 BIT_MASK 0x1fff FORMAT "%8.3" ECU_ADDRESS 0x6001401E /end MEASUREMENT
/begin MEASUREMENT DINH_nrActvInhReas.FId_AFS "Number of active inhibit reasons for the FIds / Number of active inhibit reasons for FId_AFS" UWORD DINH_ct_Compu 1 100 -4095.000 4096.000 BIT_MASK 0x1fff FORMAT "%8.3" ECU_ADDRESS 0x60014020 /end MEASUREMENT
/begin MEASUREMENT DINH_nrActvInhReas.FId_AFSPhyRng "Number of active inhibit reasons for the FIds / Number of active inhibit reasons for FId_AFSPhyRng" UWORD DINH_ct_Compu 1 100 -4095.000 4096.000 BIT_MASK 0x1fff FORMAT "%8.3" ECU_ADDRESS 0x60014022 /end MEASUREMENT
/begin MEASUREMENT DINH_nrActvInhReas.FId_APP1SigPath "Number of active inhibit reasons for the FIds / Number of active inhibit reasons for FId_APP1SigPath" UWORD DINH_ct_Compu 1 100 -4095.000 4096.000 BIT_MASK 0x1fff FORMAT "%8.3" ECU_ADDRESS 0x60014024 /end MEASUREMENT
/begin MEASUREMENT DINH_nrActvInhReas.FId_APP2SigPath "Number of active inhibit reasons for the FIds / Number of active inhibit reasons for FId_APP2SigPath" UWORD DINH_ct_Compu 1 100 -4095.000 4096.000 BIT_MASK 0x1fff FORMAT "%8.3" ECU_ADDRESS 0x60014026 /end MEASUREMENT
/begin MEASUREMENT DINH_nrActvInhReas.FId_APPBrkErr "Number of active inhibit reasons for the FIds / Number of active inhibit reasons for FId_APPBrkErr" UWORD DINH_ct_Compu 1 100 -4095.000 4096.000 BIT_MASK 0x1fff FORMAT "%8.3" ECU_ADDRESS 0x60014028 /end MEASUREMENT
/begin MEASUREMENT DINH_stDFCPid41Di "Disable status of all DFCs for PID41 calculation due to service 07 visible faults." UWORD OneToOne 1 100 0.00 65535.00 FORMAT "%8.2" ARRAY_SIZE 57 ECU_ADDRESS 0x60007C56 /end MEASUREMENT
/begin MEASUREMENT dmsntev_w_msg "Difference between Max and Min purge mass flow for incremental check of tank pressure sensor" UWORD m_uw_b25p6 1 100 0.00 25.59961 FORMAT "%8.5" ECU_ADDRESS 0x60001498 /end MEASUREMENT
/begin MEASUREMENT dplin_w "Change of Pressure deviation for linearisation check for tank leakage diagnosis" SWORD p_q0p00122 1 100 -40.00000 39.99878 FORMAT "%8.5" ECU_ADDRESS 0x60000FCA /end MEASUREMENT
/begin MEASUREMENT dptekdth_w "tank pressure filtered for offset-diagnosis tank pressure sensor highpass absolut" UWORD p_q0p00122 1 100 0.00 79.99878 FORMAT "%8.5" ECU_ADDRESS 0x60001022 /end MEASUREMENT
/begin MEASUREMENT dptekp_w "tank pressure change" UWORD p_q0p00122 1 100 0.00 79.99878 FORMAT "%8.5" ECU_ADDRESS 0x60001496 /end MEASUREMENT
/begin MEASUREMENT dpte_w "tank pressure difference in tank leak diagnosis" UWORD p_q0p3125 1 100 0.00 20479.69 FORMAT "%8.2" ECU_ADDRESS 0x60001020 /end MEASUREMENT
/begin MEASUREMENT Dsteonv_msg "distance EONV result" SLONG Length 1 100 0.00 2147483647.00 FORMAT "%13.2" ECU_ADDRESS 0x600398CC /end MEASUREMENT
/begin MEASUREMENT dtesktc_flgclr "Flag for setting the dsm clear condition for DTESKTC" UBYTE B_TRUE 1 100 0.00 1.00000000000 BIT_MASK 0x1 FORMAT "%13.11" ECU_ADDRESS 0x60000FC2 /end MEASUREMENT
/begin MEASUREMENT DTESK_flgRstDsmDfp "To maintain consistency: DSM reset flag to ensure clear process take places in same process where calc happens." UBYTE B_TRUE 1 100 0.00 1.00000000000 BIT_MASK 0x1 FORMAT "%13.11" ECU_ADDRESS 0x60000FF8 /end MEASUREMENT
/begin MEASUREMENT eonvabort_msg "Enumeration abort of EONV service test" UBYTE dez 1 100 0.00 255.0 FORMAT "%5.1" ECU_ADDRESS 0x6000141C /end MEASUREMENT
/begin MEASUREMENT eonvddr_w_msg "remaining drive distance to start service test" UWORD s_q0p1_km 1 100 0.00 6553.500 FORMAT "%8.3" ECU_ADDRESS 0x60001492 /end MEASUREMENT
/begin MEASUREMENT eonvdtko_w_msg "EONV value for distance travelled this key on" UWORD s_q1p3888_m 1 100 0.00 91020.83 FORMAT "%8.2" ECU_ADDRESS 0x60001490 /end MEASUREMENT
/begin MEASUREMENT eonvewma_w_msg "EWMA filtered value for 0.02 leak test" UWORD fak_uw_b2 1 100 0.00 1.999969 FORMAT "%8.6" ECU_ADDRESS 0x6003987C /end MEASUREMENT
/begin MEASUREMENT eonvewth_w_msg "0.020 EWMA threshold for EONV leak decision" UWORD fak_uw_b2 1 100 0.00 1.999969 FORMAT "%8.6" ECU_ADDRESS 0x6000148E /end MEASUREMENT
/begin MEASUREMENT eonvfd "number of 0.02"" EWMA filter test samples" UBYTE dez 1 100 0.00 255.0 FORMAT "%5.1" ECU_ADDRESS 0x60039735 /end MEASUREMENT
/begin MEASUREMENT eonvnr_w_msg "EONV normalized result" UWORD fak_uw_b2 1 100 0.00 1.999969 FORMAT "%8.6" ECU_ADDRESS 0x6000148C /end MEASUREMENT
/begin MEASUREMENT eonvresult_msg "engine off natural vacuum service bay test result" UBYTE dez 1 100 0.00 255.0 FORMAT "%5.1" ECU_ADDRESS 0x6000141B /end MEASUREMENT
/begin MEASUREMENT eonvrtr_w_msg "remaining motor run time to start service test" UWORD t_q0p1 1 100 0.00 6553.500 FORMAT "%8.3" ECU_ADDRESS 0x6000148A /end MEASUREMENT
/begin MEASUREMENT eonvsta_msg "indication if service test is accepted" UBYTE dez 1 100 0.00 255.0 FORMAT "%5.1" ECU_ADDRESS 0x6000141A /end MEASUREMENT
/begin MEASUREMENT eonvstdr_msg "denial reason for service test" UBYTE dez 1 100 0.00 255.0 FORMAT "%5.1" ECU_ADDRESS 0x60001419 /end MEASUREMENT
/begin MEASUREMENT eonvstmcp_msg "reason why service test malfunction codes present" UBYTE dez 1 100 0.00 255.0 FORMAT "%5.1" ECU_ADDRESS 0x60001418 /end MEASUREMENT
/begin MEASUREMENT Eonv_flgColdStrtVld "Cold start calculation is valid" UBYTE B_TRUE 1 100 0.00 1.00000000000 BIT_MASK 0x1 FORMAT "%13.11" ECU_ADDRESS 0x600001B6 /end MEASUREMENT
/begin MEASUREMENT Eonv_flgPEnvVld "Environmental pressure condition for EONV is valid" UBYTE B_TRUE 1 100 0.00 1.00000000000 BIT_MASK 0x1 FORMAT "%13.11" ECU_ADDRESS 0x600001B5 /end MEASUREMENT
/begin MEASUREMENT Eonv_pDifLeakErrWoEwma "pressure difference for leak decision between overpressure and vacuum phase, if EWMA filter is deactivated" SWORD p_q0p00122 1 100 -40.00000 39.99878 FORMAT "%8.5" ECU_ADDRESS 0x600014D8 /end MEASUREMENT
/begin MEASUREMENT Eonv_pThdErrWoEWMA "pressure threshold to detect a leak if EWMA filter is deactivated" SWORD p_q0p00122 1 100 -40.00000 39.99878 FORMAT "%8.5" ECU_ADDRESS 0x600014D6 /end MEASUREMENT
/begin MEASUREMENT Eonv_stLeakErrWoEwma "Error-Flag EONV, if EWMA filter is deactivated" UBYTE B_TRUE 1 100 0.00 1.00000000000 BIT_MASK 0x1 FORMAT "%13.11" ECU_ADDRESS 0x600001B4 /end MEASUREMENT
/begin MEASUREMENT Eonv_stRejDiagRes "Diagnosis is rejected, because with the measured pressure curve pattern, there is no selectivity between leak and tight system" UBYTE B_TRUE 1 100 0.00 1.00000000000 BIT_MASK 0x1 FORMAT "%13.11" ECU_ADDRESS 0x600001B3 /end MEASUREMENT
/begin MEASUREMENT Eonv_stRejDiagResActv "rejection of diagnosis because of the pressure curve pattern is activated" UBYTE B_TRUE 1 100 0.00 1.00000000000 BIT_MASK 0x1 FORMAT "%13.11" ECU_ADDRESS 0x70000989 /end MEASUREMENT
/begin MEASUREMENT Eonv_stRejDiagResSuspc "Suspicion in the overpressure phase for a pressure pattern, for which there is not enough selectivity between a leak and tight system" UBYTE B_TRUE 1 100 0.00 1.00000000000 BIT_MASK 0x1 FORMAT "%13.11" ECU_ADDRESS 0x600000F9 /end MEASUREMENT
/begin MEASUREMENT Eonv_tAmbAir "Ambient air temperature" UBYTE temp_ub_q0p75_o48 1 100 -48.0 143.3 FORMAT "%5.1" ECU_ADDRESS 0x60000FC0 /end MEASUREMENT
/begin MEASUREMENT evapesbts_msg "evaporative emissions service bay test status" UBYTE dez 1 100 0.00 255.0 FORMAT "%5.1" ECU_ADDRESS 0x60001417 /end MEASUREMENT
/begin MEASUREMENT FPCtl_flgCpvDiagFullEngModReq "CPV Diagnosis requests a full engine (or high valve lift) mode" UBYTE B_TRUE 1 100 0.00 1.00000000000 BIT_MASK 0x1 FORMAT "%13.11" ECU_ADDRESS 0x6000F970 /end MEASUREMENT
/begin MEASUREMENT FPCtl_flgRqstShrtTrpCPV1MnfPurgLn "Tester request for short trip CPV Diagnosis (Purge line to intake manifold). Replacement of B_fates" UBYTE B_TRUE 1 100 0.00 1.00000000000 BIT_MASK 0x1 FORMAT "%13.11" ECU_ADDRESS 0x6000F696 /end MEASUREMENT
/begin MEASUREMENT frdter_w_msg "lambda control factor as reference value for CPV diagnosis" UWORD fak_uw_b2 1 100 0.00 1.999969 FORMAT "%8.6" ECU_ADDRESS 0x60001486 /end MEASUREMENT
/begin MEASUREMENT fstteonv_w "fuel level for EONV" UWORD vol_q0p1_l 1 100 0.00 6553.500 FORMAT "%8.3" ECU_ADDRESS 0x60000FBE /end MEASUREMENT
/begin MEASUREMENT fstttld_w_msg "fuel level calculated with tank leak diagnosis" UWORD vol_q0p1_l 1 100 0.00 6553.500 FORMAT "%8.3" ECU_ADDRESS 0x6000147E /end MEASUREMENT
/begin MEASUREMENT fteadptf_w "filtered charcoal canister charge" SWORD fak_sw_b64 1 100 -64.00000 63.99805 FORMAT "%8.5" ECU_ADDRESS 0x60000FE0 /end MEASUREMENT
/begin MEASUREMENT gkomp_w_msg "compensation gradient" UWORD pgrad_q2p38Em5 1 100 0.00 1.562476 FORMAT "%8.6" ECU_ADDRESS 0x6000146A /end MEASUREMENT
/begin MEASUREMENT guatld05_w_msg "calculated leak threshold for smallest leak check" UWORD pgrad_q2p38Em5 1 100 0.00 1.562476 FORMAT "%8.6" ECU_ADDRESS 0x60001468 /end MEASUREMENT
/begin MEASUREMENT guatld10_w_msg "calculated leak threshold for small leak check" UWORD pgrad_q2p38Em5 1 100 0.00 1.562476 FORMAT "%8.6" ECU_ADDRESS 0x60001466 /end MEASUREMENT
/begin MEASUREMENT gudabkk10_w_msg "corrected pressure removal gradient" UWORD pgrad_q2p38Em5 1 100 0.00 1.562476 FORMAT "%8.6" ECU_ADDRESS 0x60001460 /end MEASUREMENT
/begin MEASUREMENT gudabkk_w_msg "corrected pressure removal gradient" UWORD pgrad_q2p38Em5 1 100 0.00 1.562476 FORMAT "%8.6" ECU_ADDRESS 0x6000145E /end MEASUREMENT
/begin MEASUREMENT gudabk_w_msg "corrected pressure removal gradient" UWORD pgrad_q2p38Em5 1 100 0.00 1.562476 FORMAT "%8.6" ECU_ADDRESS 0x60001462 /end MEASUREMENT
/begin MEASUREMENT gudab_w_msg "vacuum decay gradient" UWORD pgrad_q2p38Em5 1 100 0.00 1.562476 FORMAT "%8.6" ECU_ADDRESS 0x60001464 /end MEASUREMENT
/begin MEASUREMENT idmste_w "Integrated mass flow for release of offset check tank pressure sensor" UWORD m_ub_q0p0444 1 100 0.00 2909.754 FORMAT "%8.3" ECU_ADDRESS 0x6000101E /end MEASUREMENT
/begin MEASUREMENT InjSys_bCPVOpnForDia "Condition CPV open for diagnosis" UBYTE B_TRUE 1 100 0.00 1.00000000000 BIT_MASK 0x1 FORMAT "%13.11" ECU_ADDRESS 0x6000F67B /end MEASUREMENT
/begin MEASUREMENT InjSys_bCPVRdyForDia "Condition CPV ready for diagnosis" UBYTE B_TRUE 1 100 0.00 1.00000000000 BIT_MASK 0x1 FORMAT "%13.11" ECU_ADDRESS 0x6000F67A /end MEASUREMENT
/begin MEASUREMENT msnitldv_w "Virtual integrated CPV - mass flow for calculation of IUMPR for tank leakage diagnosis" UWORD m_3p47222Em4_g 1 100 0.00 22.75521 FORMAT "%8.5" ECU_ADDRESS 0x60000FF6 /end MEASUREMENT
/begin MEASUREMENT msnitld_w_msg "Integrated CPV - mass flow for tank leakage diagnosis" UWORD m_3p47222Em4_g 1 100 0.00 22.75521 FORMAT "%8.5" ECU_ADDRESS 0x60001454 /end MEASUREMENT
/begin MEASUREMENT msnstld_w_msg "requested mass flow through purge control valve for tank leakage diagnosis" UWORD m_uw_b25p6 1 100 0.00 25.59961 FORMAT "%8.5" ECU_ADDRESS 0x60001452 /end MEASUREMENT
/begin MEASUREMENT msnv_w "vortual mass flow PCV for calculation of IUMPR for tank leakage diagnosis" UWORD m_uw_b25p6 1 100 0.00 25.59961 FORMAT "%8.5" ECU_ADDRESS 0x60000FF4 /end MEASUREMENT
/begin MEASUREMENT mstedtf_w "purge massflow (filtered value) for offset-diagnosis tank pressure sensor" UWORD m_uw_b25p6 1 100 0.00 25.59961 FORMAT "%8.5" ECU_ADDRESS 0x6000101C /end MEASUREMENT
/begin MEASUREMENT mstmxold_w "old maximum value CPV-mass flow for CPV-plausibility-check tank pressure sensor diagnosis" UWORD m_uw_b25p6 1 100 0.00 25.59961 FORMAT "%8.5" ECU_ADDRESS 0x6000101A /end MEASUREMENT
/begin MEASUREMENT mstmxsto_w "maximum value CPV-mass flow for CPV-plausibility-check tank pressure sensor diagnosis" UWORD m_uw_b25p6 1 100 0.00 25.59961 FORMAT "%8.5" ECU_ADDRESS 0x60001018 /end MEASUREMENT
/begin MEASUREMENT pdptedud_w_msg "Modelled value of environment temperature" SWORD p_q0p00122 1 100 -40.00000 39.99878 FORMAT "%8.5" ECU_ADDRESS 0x600014CA /end MEASUREMENT
/begin MEASUREMENT peonvpp_w "EONV pressure maximum" SWORD p_q0p00122 1 100 -40.00000 39.99878 FORMAT "%8.5" ECU_ADDRESS 0x60000FBC /end MEASUREMENT
/begin MEASUREMENT peonvpt_w "pressure threshold attainable only by system with leak less than 0.020""" SWORD p_q0p00122 1 100 -40.00000 39.99878 FORMAT "%8.5" ECU_ADDRESS 0x60000FBA /end MEASUREMENT
/begin MEASUREMENT peonvvp_w "EONV pressure minimum" SWORD p_q0p00122 1 100 -40.00000 39.99878 FORMAT "%8.5" ECU_ADDRESS 0x60000FB8 /end MEASUREMENT
/begin MEASUREMENT peonvvt_w "EONV vacuum threshold for phase 2" SWORD p_q0p00122 1 100 -40.00000 39.99878 FORMAT "%8.5" ECU_ADDRESS 0x60000FB6 /end MEASUREMENT
/begin MEASUREMENT pteaav_w_msg "ccv error threshold because cpv can not open because of vacuum" SWORD p_q0p00122 1 100 -40.00000 39.99878 FORMAT "%8.5" ECU_ADDRESS 0x600014C8 /end MEASUREMENT
/begin MEASUREMENT ptebprct_w "band pass filtered rectified tank pressure signal for slosh detection" UWORD p_q0p00122 1 100 0.00 79.99878 FORMAT "%8.5" ECU_ADDRESS 0x60000FA8 /end MEASUREMENT
/begin MEASUREMENT ptebp_w "band pass filtered tank pressure signal for refuelling or cap opening detection" SWORD p_q0p00122 1 100 -40.00000 39.99878 FORMAT "%8.5" ECU_ADDRESS 0x60000FA6 /end MEASUREMENT
/begin MEASUREMENT ptekfdst_w "tank pressure filtered for offset-diagnosis tank pressure sensor" SWORD p_q0p00122 1 100 -40.00000 39.99878 FORMAT "%8.5" ECU_ADDRESS 0x600014C6 /end MEASUREMENT
/begin MEASUREMENT ptekfdth_w "tank pressure filtered for offset-diagnosis tank pressure sensor highpass" SWORD p_q0p00122 1 100 -40.00000 39.99878 FORMAT "%8.5" ECU_ADDRESS 0x600014C4 /end MEASUREMENT
/begin MEASUREMENT ptekmaxdst_w "Maximum tank pressure for increment check tank pressure sensor (stuck signal)" SWORD p_q0p00122 1 100 -40.00000 39.99878 FORMAT "%8.5" ECU_ADDRESS 0x600014C2 /end MEASUREMENT
/begin MEASUREMENT ptekmindst_w "Minimum tank pressure for increment check tank pressure sensor (stuck signal)" SWORD p_q0p00122 1 100 -40.00000 39.99878 FORMAT "%8.5" ECU_ADDRESS 0x600014C0 /end MEASUREMENT
/begin MEASUREMENT ptekold "Referenze value of tank pressure for Oscillation test" SWORD p_q0p3125 1 100 -10240.00 10239.69 FORMAT "%8.2" ECU_ADDRESS 0x60001016 /end MEASUREMENT
/begin MEASUREMENT ptekrefo_w "old reference value tank pressure for offset-diagnosis tank pressure sensor" SWORD p_q0p00122 1 100 -40.00000 39.99878 FORMAT "%8.5" ECU_ADDRESS 0x60001014 /end MEASUREMENT
/begin MEASUREMENT ptekref_w "reference value tank pressure for offset-diagnosis tank pressure sensor" SWORD p_q0p00122 1 100 -40.00000 39.99878 FORMAT "%8.5" ECU_ADDRESS 0x60001012 /end MEASUREMENT
/begin MEASUREMENT pteksfdt_w_msg "tank pressure filtered for offset-diagnosis tank pressure sensor" SWORD p_q0p00122 1 100 -40.00000 39.99878 FORMAT "%8.5" ECU_ADDRESS 0x600014BE /end MEASUREMENT
/begin MEASUREMENT ptemnsto_w "minimum value tank pressure for offset-diagnosis tank pressure sensor" SWORD p_q0p00122 1 100 -40.00000 39.99878 FORMAT "%8.5" ECU_ADDRESS 0x60001010 /end MEASUREMENT
/begin MEASUREMENT ptetp_w_msg "Filtered tank pressure (16 Bit) for DTESK" SWORD p_q0p00122 1 100 -40.00000 39.99878 FORMAT "%8.5" ECU_ADDRESS 0x600014BC /end MEASUREMENT
/begin MEASUREMENT ptkdfdst_w "difference tank pressure for %DDST-diagnosis (Word)" UWORD p_q0p00122 1 100 0.00 79.99878 FORMAT "%8.5" ECU_ADDRESS 0x6000100E /end MEASUREMENT
/begin MEASUREMENT pttpstrt_w "start pressure for TLD : DTESK" SWORD p_q0p00122 1 100 -40.00000 39.99878 FORMAT "%8.5" ECU_ADDRESS 0x60000FC8 /end MEASUREMENT
/begin MEASUREMENT pttp_w_msg "lowpass filtered tank pressure" SWORD p_q0p00122 1 100 -40.00000 39.99878 FORMAT "%8.5" ECU_ADDRESS 0x60001628 /end MEASUREMENT
/begin MEASUREMENT pttr_w_msg "reference value of differential tank pressure" SWORD p_q0p00122 1 100 -40.00000 39.99878 FORMAT "%8.5" ECU_ADDRESS 0x600014BA /end MEASUREMENT
/begin MEASUREMENT ptvfstrt_w "start pressure for TLD : DEONV" SWORD p_q0p00122 1 100 -40.00000 39.99878 FORMAT "%8.5" ECU_ADDRESS 0x60000FA4 /end MEASUREMENT
/begin MEASUREMENT ptvf_w_msg "tank pressure filtered" SWORD p_q0p00122 1 100 -40.00000 39.99878 FORMAT "%8.5" ECU_ADDRESS 0x600014B8 /end MEASUREMENT
/begin MEASUREMENT puold_w "ambient pressure (old value)" UWORD p_uw_q0p039 1 100 0.00 2559.961 FORMAT "%8.3" ECU_ADDRESS 0x60000FDE /end MEASUREMENT
/begin MEASUREMENT purefdsa_w "array for ambient pressure change" UWORD p_uw_q0p039 1 100 0.00 2559.961 FORMAT "%8.3" ARRAY_SIZE 5 ECU_ADDRESS 0x60039756 /end MEASUREMENT
/begin MEASUREMENT PurgLeakDiag_facEonvSngNrmRes "EONV single normalised result" UWORD fak_uw_b2 1 100 0.00 1.999969 FORMAT "%8.6" ECU_ADDRESS 0x6003974C /end MEASUREMENT
/begin MEASUREMENT PurgLeakDiag_flgBlkdLineErr "Error blocked line between tank and active carbon canister" UBYTE B_TRUE 1 100 0.00 1.00000000000 BIT_MASK 0x1 FORMAT "%13.11" ECU_ADDRESS 0x6000F063 /end MEASUREMENT
/begin MEASUREMENT PurgLeakDiag_flgColdStrtVld "Cold start condition for DTESK was calculated correctly" UBYTE B_TRUE 1 100 0.00 1.00000000000 BIT_MASK 0x1 FORMAT "%13.11" ECU_ADDRESS 0x60001396 /end MEASUREMENT
/begin MEASUREMENT PurgLeakDiag_flgCycCpvStuckClsdChk "Cycle flag for CPV stuck closed check completed" UBYTE B_TRUE 1 100 0.00 1.00000000000 BIT_MASK 0x1 FORMAT "%13.11" ECU_ADDRESS 0x60001395 /end MEASUREMENT
/begin MEASUREMENT PurgLeakDiag_flgCycCpvStuckOpenChk "Cycle flag for CPV stuck open check completed" UBYTE B_TRUE 1 100 0.00 1.00000000000 BIT_MASK 0x1 FORMAT "%13.11" ECU_ADDRESS 0x60001394 /end MEASUREMENT
/begin MEASUREMENT PurgLeakDiag_flgDiagBlkdLineActv "blocked line diagnosis is calibrated to active" UBYTE B_TRUE 1 100 0.00 1.00000000000 BIT_MASK 0x1 FORMAT "%13.11" ECU_ADDRESS 0x6000F669 /end MEASUREMENT
/begin MEASUREMENT PurgLeakDiag_flgDiagBlkdLineCyc "Cycle flag of the blocked line error of a blocked line between tank and active carbon canister" UBYTE B_TRUE 1 100 0.00 1.00000000000 BIT_MASK 0x1 FORMAT "%13.11" ECU_ADDRESS 0x6000F668 /end MEASUREMENT
/begin MEASUREMENT PurgLeakDiag_flgDiagBlkdLineErr "Error flag of the blocked line error of a blocked line between tank and active carbon canister" UBYTE B_TRUE 1 100 0.00 1.00000000000 BIT_MASK 0x1 FORMAT "%13.11" ECU_ADDRESS 0x6000F667 /end MEASUREMENT
/begin MEASUREMENT PurgLeakDiag_flgDlyNewIdle "Diagnosis is released if idle phase was not fullfilled for a certain time" UBYTE B_TRUE 1 100 0.00 1.00000000000 BIT_MASK 0x1 FORMAT "%13.11" ECU_ADDRESS 0x60000FDD /end MEASUREMENT
/begin MEASUREMENT PurgLeakDiag_flgDSMChk "local flag for DSM Clear check" UBYTE B_TRUE 1 100 0.00 1.00000000000 BIT_MASK 0x1 FORMAT "%13.11" ECU_ADDRESS 0x60000FDC /end MEASUREMENT
/begin MEASUREMENT PurgLeakDiag_flgDSMclr "DSM clear flag" UBYTE B_TRUE 1 100 0.00 1.00000000000 BIT_MASK 0x1 FORMAT "%13.11" ECU_ADDRESS 0x60000FDB /end MEASUREMENT
/begin MEASUREMENT PurgLeakDiag_flgDteskTstrReq "condition service function request for 2.3mm leak diagnosis at EOL" UBYTE B_TRUE 1 100 0.00 1.00000000000 BIT_MASK 0x1 FORMAT "%13.11" ECU_ADDRESS 0x60001393 /end MEASUREMENT
/begin MEASUREMENT PurgLeakDiag_flgEnaCdnFuMixAdpn "conditions of the mixture adaptation for the DTESK are fulfilled" UBYTE B_TRUE 1 100 0.00 1.00000000000 BIT_MASK 0x1 FORMAT "%13.11" ECU_ADDRESS 0x60000FDA /end MEASUREMENT
/begin MEASUREMENT PurgLeakDiag_flgEnaCdnIdleCtrl "Idle phase for diagnosis detected" UBYTE B_TRUE 1 100 0.00 1.00000000000 BIT_MASK 0x1 FORMAT "%13.11" ECU_ADDRESS 0x60000FD9 /end MEASUREMENT
/begin MEASUREMENT PurgLeakDiag_flgEonvDiagEnad "EONV diagnosis enabled" UBYTE B_TRUE 1 100 0.00 1.00000000000 BIT_MASK 0x1 FORMAT "%13.11" ECU_ADDRESS 0x600000F6 /end MEASUREMENT
/begin MEASUREMENT PurgLeakDiag_flgTankLeakDiagFinshd "DTESK Diagnosis is inhibited, because it would not run again" UBYTE B_TRUE 1 100 0.00 1.00000000000 BIT_MASK 0x1 FORMAT "%13.11" ECU_ADDRESS 0x60001392 /end MEASUREMENT
/begin MEASUREMENT PurgLeakDiag_lenDstDrvnBfrStrtEonv "Distance driven by vehiucle before start of EONV diagnosis" SLONG Length 1 100 -2147483648.00 2147483647.00 FORMAT "%13.2" ECU_ADDRESS 0x60039748 /end MEASUREMENT
/begin MEASUREMENT PurgLeakDiag_mfDifGasCapChk "massflow difference from threshold during gas cap check" UWORD m_3p47222Em4_g 1 100 0.00 22.75521 FORMAT "%8.5" ECU_ADDRESS 0x60039750 /end MEASUREMENT
/begin MEASUREMENT PurgLeakDiag_mfDifLrgLeakChk "massfflow difference from threshold during large leak check" UWORD m_3p47222Em4_g 1 100 0.00 22.75521 FORMAT "%8.5" ECU_ADDRESS 0x6003974E /end MEASUREMENT
/begin MEASUREMENT PurgLeakDiag_mIntglMfDiagBlkdLine "Integrated Massflow over the CPV during vacuum build up of DTESK for the blocked line diagnosis" UWORD m_3p47222Em4_g 1 100 0.00 22.75521 FORMAT "%8.5" ECU_ADDRESS 0x60007CC8 /end MEASUREMENT
/begin MEASUREMENT PurgLeakDiag_nrEonvDiagResAvl "Number of EONV diagnosis results available" UWORD OneToOne 1 100 0.00 65535.00 FORMAT "%8.2" ECU_ADDRESS 0x60039746 /end MEASUREMENT
/begin MEASUREMENT PurgLeakDiag_pPPhaEonv "Pressure during pressure phase of EONV" SWORD p_q0p00122 1 100 -40.00000 39.99878 FORMAT "%8.5" ECU_ADDRESS 0x60039744 /end MEASUREMENT
/begin MEASUREMENT PurgLeakDiag_pVacPhaEonv "Pressure during vaccum phase of EONV" SWORD p_q0p00122 1 100 -40.00000 39.99878 FORMAT "%8.5" ECU_ADDRESS 0x60039742 /end MEASUREMENT
/begin MEASUREMENT PurgLeakDiag_stDteskDetdOkSys "flag to indicate that DTESK detected an OK system" UBYTE B_TRUE 1 100 0.00 1.00000000000 BIT_MASK 0x1 FORMAT "%13.11" ECU_ADDRESS 0x600000F5 /end MEASUREMENT
/begin MEASUREMENT PurgLeakDiag_stEonvAbortReas "abort reasons for EONV diagnosis" UBYTE OneToOne 1 100 0.00 255.0 FORMAT "%5.1" ECU_ADDRESS 0x60039734 /end MEASUREMENT
/begin MEASUREMENT PurgLeakDiag_stEonvDiagRes "Status of current EONV diagnosis result" UBYTE B_TRUE 1 100 0.00 1.00000000000 BIT_MASK 0x1 FORMAT "%13.11" ECU_ADDRESS 0x60036DE3 /end MEASUREMENT
/begin MEASUREMENT PurgLeakDiag_stEonvDiagStopd "flag to indiacte EONV diagnosis has stopped" UBYTE B_TRUE 1 100 0.00 1.00000000000 BIT_MASK 0x1 FORMAT "%13.11" ECU_ADDRESS 0x600000F4 /end MEASUREMENT
/begin MEASUREMENT PurgLeakDiag_stEonvInhbnReas "inhibition reasons for EONV diagnosis" UBYTE OneToOne 1 100 0.00 255.0 FORMAT "%5.1" ECU_ADDRESS 0x60039733 /end MEASUREMENT
/begin MEASUREMENT PurgLeakDiag_stftead "disabling because of high canister load." UBYTE B_TRUE 1 100 0.00 1.00000000000 BIT_MASK 0x1 FORMAT "%13.11" ECU_ADDRESS 0x60000FD8 /end MEASUREMENT
/begin MEASUREMENT PurgLeakDiag_tAmbAir "Ambient air temperature" UBYTE temp_ub_q0p75_o48 1 100 -48.0 143.3 FORMAT "%5.1" ECU_ADDRESS 0x60000FD7 /end MEASUREMENT
/begin MEASUREMENT PurgLeakDiag_tAmbTStrtEonv "Ambient temperature at start of EONV diagnosis" SWORD Temp_Cels 1 100 -3549.940 3003.560 FORMAT "%8.3" ECU_ADDRESS 0x60039740 /end MEASUREMENT
/begin MEASUREMENT PurgLeakDiag_tCEngStrt "Engine coolant downstream temperature during the first engine start of the driving cycle." UBYTE temp_ub_q0p75_o48 1 100 -48.0 143.3 FORMAT "%5.1" ECU_ADDRESS 0x60000FD6 /end MEASUREMENT
/begin MEASUREMENT PurgLeakDiag_tiPPhaEonv "Time for pressure phase of EONV" UWORD t_q0p1 1 100 0.00 6553.500 FORMAT "%8.3" ECU_ADDRESS 0x6003973E /end MEASUREMENT
/begin MEASUREMENT PurgLeakDiag_tiVapPhaEonv "Tiem for vacuum phase of EONV" UWORD t_q0p1 1 100 0.00 6553.500 FORMAT "%8.3" ECU_ADDRESS 0x6003973C /end MEASUREMENT
/begin MEASUREMENT PurgLeakDiag_uBatt "Battery voltage" UWORD spg_q0p00039 1 100 0.00 25.59961 FORMAT "%8.5" ECU_ADDRESS 0x60000FD4 /end MEASUREMENT
/begin MEASUREMENT PurgLeakDiag_volDiagBlkdLine "Calculated free gas valume of the EVAP system for the blocked line diagnosis" UWORD vol_q0p01_l 1 100 0.00 655.3500 FORMAT "%8.4" ECU_ADDRESS 0x60008DF0 /end MEASUREMENT
/begin MEASUREMENT PurgLeakDiag_volFuLvlStrtEonv "Fuel LEvel at start of EONV diagnosis" UWORD vol_q0p1_l 1 100 0.00 6553.500 FORMAT "%8.3" ECU_ADDRESS 0x6003973A /end MEASUREMENT
/begin MEASUREMENT PurgLeakDiag_vVeh "Vehicle speed" UWORD vfzg_uw_b512 1 100 0.00 511.9922 FORMAT "%8.4" ECU_ADDRESS 0x60000FD2 /end MEASUREMENT
/begin MEASUREMENT reqdtesk_msg "physically allowed tank leakage diagnoses" UBYTE dez 1 100 0.00 255.0 FORMAT "%5.1" ECU_ADDRESS 0x60001412 /end MEASUREMENT
/begin MEASUREMENT rqdteskt "physically allowed tank leakage diagnoses after enable condition" UBYTE dez 1 100 0.00 255.0 FORMAT "%5.1" ECU_ADDRESS 0x60000FD0 /end MEASUREMENT
/begin MEASUREMENT sdmglvav_w "virtual driven distance since virtual rough leak suspicion" UWORD s_q0p02777_m 1 100 0.00 1820.417 FORMAT "%8.3" ECU_ADDRESS 0x60000FF2 /end MEASUREMENT
/begin MEASUREMENT sdmglva_w "driven distance since rough leak recognized" UWORD s_q0p02777_m 1 100 0.00 1820.417 FORMAT "%8.3" ECU_ADDRESS 0x60000FF0 /end MEASUREMENT
/begin MEASUREMENT seonvcts "state number of the EONV state machine" UBYTE dez 1 100 0.00 255.0 FORMAT "%5.1" ECU_ADDRESS 0x60000FAA /end MEASUREMENT
/begin MEASUREMENT stptldab_msg "function state counter abort reason for tank leak diagnosis for tester" UBYTE dez 1 100 0.00 255.0 FORMAT "%5.1" ECU_ADDRESS 0x6003985C /end MEASUREMENT
/begin MEASUREMENT stptld_msg "function state counter tank leak diagnosis for tester" UBYTE dez 1 100 0.00 255.0 FORMAT "%5.1" ECU_ADDRESS 0x6003985D /end MEASUREMENT
/begin MEASUREMENT TankLeakDiag_facEthnlSensVal "Ethanol sensor value" UWORD fak_uw_b2 1 100 0.00 1.999969 FORMAT "%8.6" ECU_ADDRESS 0x60008DDE /end MEASUREMENT
/begin MEASUREMENT TankP_pDifTankOffsChk "Pressure difference of tank pressure for offset check" UWORD p_q0p00122 1 100 0.00 79.99878 FORMAT "%8.5" ECU_ADDRESS 0x6000100C /end MEASUREMENT
/begin MEASUREMENT TankP_pDifTankStuckChk "Pressure difference of tank pressure for stuck check" ULONG p_q0p00122 1 100 0.00 5242879.99878 FORMAT "%13.5" ECU_ADDRESS 0x60001008 /end MEASUREMENT
/begin MEASUREMENT tdpu_w "timer for change in ambient pressure" UWORD t_q0p1 1 100 0.00 6553.500 FORMAT "%8.3" ECU_ADDRESS 0x60000FCE /end MEASUREMENT
/begin MEASUREMENT tdtedp "time for miscellaneous measurements" UBYTE t_q0p1 1 100 0.00 25.50 FORMAT "%5.2" ECU_ADDRESS 0x60000FC7 /end MEASUREMENT
/begin MEASUREMENT tdtedppr_msg "Check-time for miscellaneous measurements" UBYTE t_q0p1 1 100 0.00 25.50 FORMAT "%5.2" ECU_ADDRESS 0x6000140D /end MEASUREMENT
/begin MEASUREMENT tdtedps "time for spezial miscellaneous measurements" UBYTE t_q0p1 1 100 0.00 25.50 FORMAT "%5.2" ECU_ADDRESS 0x60000FC6 /end MEASUREMENT
/begin MEASUREMENT tedfto05_w "Remaining Inhibition time for tank leakage diagnosis (0.5mm) after high canister load" UWORD t_q0p1 1 100 0.00 6553.500 FORMAT "%8.3" ECU_ADDRESS 0x60000FCC /end MEASUREMENT
/begin MEASUREMENT teonvv "timer for EONV phase 1 vacuum build" UBYTE t_q0p1 1 100 0.00 25.50 FORMAT "%5.2" ECU_ADDRESS 0x60000FB4 /end MEASUREMENT
/begin MEASUREMENT teonvzer_w "timer for EONV pressure stabilization at zero" UWORD t_q0p1 1 100 0.00 6553.500 FORMAT "%8.3" ECU_ADDRESS 0x60000FB2 /end MEASUREMENT
/begin MEASUREMENT tldnostp_msg "tank leakage diagnoses without fulfilled stop conditions" UBYTE dez 1 100 0.00 255.0 FORMAT "%5.1" ECU_ADDRESS 0x60001407 /end MEASUREMENT
/begin MEASUREMENT tpteksto "timer time window for calculation ptekref_w" UBYTE t_q0p1 1 100 0.00 25.50 FORMAT "%5.2" ECU_ADDRESS 0x60001006 /end MEASUREMENT
/begin MEASUREMENT tpurefdst_w "Counter for pressure change in tank pressure sensor" UWORD t_q0p1 1 100 0.00 6553.500 FORMAT "%8.3" ECU_ADDRESS 0x60001004 /end MEASUREMENT
/begin MEASUREMENT ttldfrr "Time counter for setting of B_tldfrr" UBYTE t_q0p1 1 100 0.00 25.50 FORMAT "%5.2" ECU_ADDRESS 0x60000FC5 /end MEASUREMENT
/begin MEASUREMENT VehMot_rTrqDfftl "Torque ratio of differential" SWORD TransR 1 100 -327.6800 327.6700 FORMAT "%8.4" ECU_ADDRESS 0x60009628 /end MEASUREMENT
/begin MEASUREMENT VehMot_tqCluDftlProtn "Differential protection torque at clutch level" SWORD Trq 1 100 -3276.800 3276.700 FORMAT "%8.3" ECU_ADDRESS 0x60009622 /end MEASUREMENT
/begin MEASUREMENT VehMot_trqPrtDfftl "Differential protection torque" SLONG TrqPrpHigh 1 100 -214748364.800 214748364.700 FORMAT "%13.3" ECU_ADDRESS 0x50005044 /end MEASUREMENT
/begin MEASUREMENT vfzggdst_w "vehicle acceleration for offset-diagnosis tank pressure sensor" SWORD acc_q0p021701_m_DIV_s2 1 100 -711.1111 711.0894 FORMAT "%8.4" ECU_ADDRESS 0x60001002 /end MEASUREMENT
/begin MEASUREMENT zadiagpr_msg "state pointer for check state of Mode06" UBYTE dez 1 100 0.00 255.0 FORMAT "%5.1" ECU_ADDRESS 0x60001404 /end MEASUREMENT
/begin MEASUREMENT zadiag_msg "pointer for TLD processing" UBYTE dez 1 100 0.00 255.0 FORMAT "%5.1" ECU_ADDRESS 0x60001405 /end MEASUREMENT
/begin MEASUREMENT ztesggmx_w_msg "Latched upper threshold of rough leak gradient check for Mode6" SWORD p_q0p00122 1 100 -40.00000 39.99878 FORMAT "%8.5" ECU_ADDRESS 0x6003989C /end MEASUREMENT
/begin MEASUREMENT ztesgg_w "Latched measured value of rough leak gradient check for Mode6" SWORD p_q0p00122 1 100 -40.00000 39.99878 FORMAT "%8.5" ECU_ADDRESS 0x60039752 /end MEASUREMENT
/begin FUNCTION DiaActr_ElecPsDiag "1.6.0     Standardized electrical power stage diagnosis for discrete output signals"
 /begin DEF_CHARACTERISTIC DiaActr_ElecPsDiag_DbgSigId_C DiaActr_ElecPsDiag_DbgSigTyp_C DiaActr_ElecPsDiag_SigOutDurgOpenLd_C /end DEF_CHARACTERISTIC
 /begin LOC_MEASUREMENT DiaActrElecPsDiag_cntTestPlsTsk_mp DiaActrElecPsDiag_nrDiagErr_mp DiaActrElecPsDiag_nrTestPls_mp DiaActrElecPsDiag_stAttribOL_mp DiaActrElecPsDiag_stAttribOT_mp DiaActrElecPsDiag_stAttribSCB_mp DiaActrElecPsDiag_stAttribSCG_mp DiaActrElecPsDiag_stDsmDebOpenLoad_mp DiaActrElecPsDiag_stDsmDebOverT_mp DiaActrElecPsDiag_stDsmDebScb_mp DiaActrElecPsDiag_stDsmDebScg_mp DiaActrElecPsDiag_stErrCfgOpenLoad_mp DiaActrElecPsDiag_stErrCfgOverT_mp DiaActrElecPsDiag_stErrCfgScb_mp DiaActrElecPsDiag_stErrCfgScg_mp DiaActrElecPsDiag_stPrvTstRslt_mp DiaActrElecPsDiag_stSigCfg_mp DiaActrElecPsDiag_stSigErrInfo_mp DiaActrElecPsDiag_stSig_mp DiaActrElecPsDiag_stTestPls_mp DiaActrElecPsDiag_stTmngTestPls_mp DiaActrElecPsDiag_tiTstPls_mp DiaActrElecPsDiag_TstPlsCnt_Cfg_mp /end LOC_MEASUREMENT
 FUNCTION_VERSION "1.6.0" /end FUNCTION
/begin FUNCTION DiaBas_BufAcs "30000.7.0 Functions for platform independent access (swapping) to data stored in an MSB buffer" FUNCTION_VERSION "30000.7.0" /end FUNCTION
/begin FUNCTION DiagCpt_1PSnsrTank "30201.3.0 Tank pressure sensor diagnosis (1 sensor)"
 /begin DEF_CHARACTERISTIC CCPVPLAUMX DiagCpt_mfMinOffsChkPSnsr_C DiagCpt_mfMinOffsEol_C DiagCpt_stOffsDiag_C DiagCpt_stPSnsrTankDiag_C DiagCpt_vMinOffsEol_C DMSNTEVMN DPCPVPOF DPDSTNPW DPTEKDTHMX DPTEKO ENVTDSTOMN ENVTDSTOMX ENVTDSTUMN ENVTDSTUMX FSTDSTOZMX FTEADSTOMN MSTEDSOMNL MSTEDSTOMN MSTEPOFH MSTEPTOFMN PSPUDSTMX PSPUTH PTEDOZ PTEINCERMN PTEINCERMX PTEKREFMN PTEKREFMNL PTEKREFMX PUREFDMX TDCPVPOF TDDSTCON TDDSTCPVA TDDSTCPVIA TDDSTD TDDSTMSTE TDDSTPTEK TDPTEKH TDSTPTEKS TDTESKOFF TDTHPTEK TEDSTO TPTEKSTOMX TPUREFDSMX TSTDSTO TTDSTDST TTDSTP TTEDOZ TTEDOZG VEHDDSTOMN VEHDDSTOMX VEHDSTMN VEHDSTMX VFZGGDSOMX VFZGGDSTMX ZKMSTDST /end DEF_CHARACTERISTIC
 /begin REF_CHARACTERISTIC HPUTEDU MSTEPTEK /end REF_CHARACTERISTIC
 /begin IN_MEASUREMENT B_cddst_msg B_fadstof_msg B_fstdmn_msg B_fstdmx_msg B_fsttg_msg B_fsttldv_msg B_llr_msg B_tankg_msg B_tank_msg B_tldcvs_msg EngStrt_bFrstStrtEnd EngStrt_bStrt EnvT_t Epm_stSpd fstt_w_msg ftead_w_msg mstedte_w_msg mstesnc_w_msg PEnv_p pspu_msg pteker_msg pteker_w_msg ptek_msg ptek_w_msg SyC_stSub VehV_v /end IN_MEASUREMENT
 /begin OUT_MEASUREMENT B_ddstnp_msg B_dstrerr_msg B_dstrir_msg B_eaavp_msg B_edstof_msg B_stdsto_msg B_stincch_msg B_stosch_msg B_zaavp_msg B_zdstof_msg dmsntev_w_msg pteaav_w_msg ptekmaxdst_w ptekmindst_w pteksfdt_w_msg /end OUT_MEASUREMENT
 /begin LOC_MEASUREMENT B_ambpof B_cpvacheck B_cpvacof B_cpvplaus B_cpvplwth B_ddstnpo B_ddstnpp B_dstden B_edstoft B_edstosci B_eincch B_ptekstof B_pustpof B_refdstd B_stincche B_stosche B_vfzpof B_zdstoft B_zdstosci B_zincch ccpvplaus DiagCpt_flgPSnsrTankClr DiagCpt_flgPSnsrTankIUMPRClr dptekdth_w dptekp_w dpte_w idmste_w mstedtf_w mstmxold_w mstmxsto_w ptekfdst_w ptekfdth_w ptekold ptekrefo_w ptekref_w ptemnsto_w ptkdfdst_w purefdsa_w TankP_pDifTankOffsChk TankP_pDifTankStuckChk tpteksto tpurefdst_w vfzggdst_w /end LOC_MEASUREMENT
 FUNCTION_VERSION "30201.3.0" /end FUNCTION
/begin FUNCTION DiagCpv_Basc "30301.11.0diagnosis canister purge valve basic coordination" /begin DEF_CHARACTERISTIC CstrPurg_stDiagCpvDteskSeln_C /end DEF_CHARACTERISTIC
 /begin IN_MEASUREMENT B_cdtes_msg B_fates_msg B_tldinfo_msg B_tldobd_msg B_tldto_msg msnstld_w_msg SyC_ctPostDrvLeave SyC_stSub /end IN_MEASUREMENT
 /begin OUT_MEASUREMENT B_dteaa_msg B_dtest_msg B_dtes_msg B_dtezamh_msg B_fatldtev_msg CstrPurg_flgCpvDiagDteskActv CstrPurg_flgDiagCpv1DteskLoLoad CstrPurg_flgTstrReq CstrPurg_mfDiagCpv1w FPCtl_flgCpvDiagFullEngModReq FPCtl_flgRqstShrtTrpCPV1MnfPurgLn InjSys_bCPVOpnForDia InjSys_bCPVRdyForDia /end OUT_MEASUREMENT
 /begin LOC_MEASUREMENT CstrPurg_flgCpvDiagDteskCpvOpenChk CstrPurg_flgCpvDiagDteskCpvStrtOpen DiagCpv_cntrReIniBasc1 DiagCpv_flgCpv1TrbCdnFirstActvn DiagCpv_flgCpv1TrbCdnSecActvn DiagCpv_flgCpv2TrbCdnFirstActvn DiagCpv_flgCpv2TrbCdnSecActvn DiagCpv_flgReIniBasc1 DiagCpv_tiPrpnSysActv DiagCpv_tiSumCpv1TrbCond DiagCpv_tiSumCpv2TrbCond /end LOC_MEASUREMENT
 FUNCTION_VERSION "30301.11.0" /end FUNCTION
/begin FUNCTION DiagCpv_PSnsrTankDsm "30201.1.0 CPV diagnosis by tank pressure sensor DSM" /begin REF_CHARACTERISTIC DDPTEKU DPDELTA /end REF_CHARACTERISTIC
 /begin IN_MEASUREMENT B_eaav_msg B_etvtldmn_msg B_etvtldmx_msg B_spdtetld_msg B_tldobd_msg B_zaav_msg B_ztevtld_msg CstrPurg_flgDiagCpv1DteskLoLoad pttr_w_msg PurgLeakDiag_flgCycCpvStuckClsdChk PurgLeakDiag_flgCycCpvStuckOpenChk SyC_stSub /end IN_MEASUREMENT
 FUNCTION_VERSION "30201.1.0" /end FUNCTION
/begin FUNCTION DiagLeakDtesk_Alg "30201.2.0 Tank leak diagnosis DTESK algorithm"
 /begin DEF_CHARACTERISTIC EvapDi_facEthnlMax_C EvapDi_facPGradCalcdThdFlexfu_M KFFUTNKCENGT KLENVT KLFACCORRALTI KLTLDSFS05 KLTLDSFSFA KLTLDSFSFG STFST10TLD /end DEF_CHARACTERISTIC
 /begin IN_MEASUREMENT B_fatld05_msg B_fatldeg_msg CEngDsT_t EnvT_t Eonv_stRejDiagResActv fstttld_w_msg gkomp_w_msg gudab_w_msg PEnv_facCorrAlti SyC_stSub TankLeakDiag_facEthnlSensVal tnse_w_msg zadiagpr_msg /end IN_MEASUREMENT
 /begin OUT_MEASUREMENT B_etesf_msg B_etesk_msg B_ztesf_msg B_ztesk_msg guatld05_w_msg guatld10_w_msg gudabkk10_w_msg gudabkk_w_msg gudabk_w_msg /end OUT_MEASUREMENT
 FUNCTION_VERSION "30201.2.0" /end FUNCTION
/begin FUNCTION DiagLeakDtesk_Dsm "30201.3.0 Tank leak diagnosis DTESK DSM"
 /begin DEF_CHARACTERISTIC CWTLDDD DDPTETA EvapDi_stObdOpt_C FuEvapLeak_cwCcvPErrIgr_C SDMGLVU TDDPTETA /end DEF_CHARACTERISTIC
 /begin REF_CHARACTERISTIC EvapDi_facEthnlMax_C MSNTVMX05 PurgLeakDiag_volDiagBlkdLineErrThd_C /end REF_CHARACTERISTIC
 /begin IN_MEASUREMENT aktlauf_msg B_cddtesk_msg B_dteskfzg_msg B_dteskpid_msg B_eaavp_msg B_eaav_msg B_eeonv_msg B_etesf_msg B_etesgg_msg B_fatld05_msg B_fstdmn_msg B_fstdmx_msg B_fsttldv_msg B_tankg_msg B_tank_msg B_tldbccon_msg B_tlddicon_msg B_tldinfo_msg B_tldklcon_msg B_tldobd_msg B_tldwdcon_msg B_zaavp_msg B_zaav_msg B_zeonv_msg B_ztesf_msg B_ztesgg_msg B_ztesk_msg ddpterl_w_msg Eonv_stLeakErrWoEwma Eonv_stRejDiagResActv guatld10_w_msg gudabk_w_msg mstedte_w_msg pdptedud_w_msg pteaav_w_msg pteksfdt_w_msg ptek_w_msg pttp_w_msg pttr_w_msg PurgLeakDiag_flgColdStrtVld PurgLeakDiag_flgDiagBlkdLineActv PurgLeakDiag_flgDiagBlkdLineCyc PurgLeakDiag_flgDiagBlkdLineErr PurgLeakDiag_flgTankLeakDiagFinshd PurgLeakDiag_volDiagBlkdLine SyC_stSub TankLeakDiag_facEthnlSensVal tldnostp_msg VehV_v zadiag_msg /end IN_MEASUREMENT
 /begin OUT_MEASUREMENT B_dsttesffcl_msg B_dteskddr_msg B_endtesk_msg B_etesgdd_msg B_etesgloc_msg B_spdtetld_msg B_tesfmilerr_msg B_tesfmil_msg B_tesgmilerr_msg B_tesgmil_msg B_ztesgdd_msg ztesggmx_w_msg /end OUT_MEASUREMENT
 /begin LOC_MEASUREMENT B_cmpltld B_dteskddv B_etesggv B_infoTESFmax B_infoTESGmax B_rlirn B_rlirnv B_rtldio B_tldrlcv B_tldvrlc DTESK_flgRstDsmDfp msnitldv_w msnv_w sdmglvav_w sdmglva_w ztesgg_w /end LOC_MEASUREMENT
 FUNCTION_VERSION "30201.3.0" /end FUNCTION
/begin FUNCTION DiagLeakDtesk_EnaCdn "30201.2.0 Tank leak diagnosis DTESK enable conditions"
 /begin DEF_CHARACTERISTIC CWCCVCLSD CWDTESKAPP CWDTESKEB CWDTESKSTC CWDTESKTEAD CWSFTEDAFA CWTLDOBD EvapDi_flgEthnlSnsrSwt_C FSTEADENMN FSTEADENMX HPUTEDU IMSTEMNTLD KLFTEADDTESK MXDTESK05 PNDKPUEB PTEKORMN PTEKORMX PurgLeakDiag_tAbortDlyEol_C PurgLeakDiag_tiColdStrtEngOffMin_C PurgLeakDiag_vMaxPrio_C PUTEDO SFTEDA05 SFTEDA05FA SFTEDAO05 TABORDELAY TDPURE TMNHTOHTLD TMSTLDHB05 TMSTLDMN05 TMSTLDMX05 TNODTES TNSETLD05 TPUTEDSV TRIRVFZG TTDTESKSTO TTEDFTE05 TTEDFTEO05 TTENCT05 TTENOT05 TTFTEADPTF TUMSRVTLDO TUMSRVTLDU TUMTHEB TUMTLDO TUMTLDU UBTEDO UBTEDU VFZGTLDEB VFZGTLDSRO ZADIAGSTOP /end DEF_CHARACTERISTIC
 /begin REF_CHARACTERISTIC EvapDi_facEthnlMax_C /end REF_CHARACTERISTIC
 /begin IN_MEASUREMENT aktend_msg BattU_u B_abbrtld_msg B_cddtesk_msg B_dtetk_msg B_endtesk_msg B_etesgloc_msg B_fatld05_msg B_fatldtev_msg B_fa_msg B_fstdmn_msg B_fstdmx_msg B_fsttg_msg B_fvlra_msg B_gae_msg B_iatlddu_msg B_iatldha_msg B_llr_msg B_lr_msg B_mstefg_msg B_te_msg B_tldav_msg B_tldpsd_msg B_tumgg_msg B_ztesgdd_msg B_ztesgg_msg CEngDsT_tStrtFrst EngStrt_bFrstStrtEnd EnvT_t Epm_stSpd ETHSCP_perEthRaw FfPrm_facEth FlLvl_flgMaxFuLvlDiagcFct FlLvl_flgMinFuLvlDiagcFct ftead_w_msg imsteini_msg InjSys_bInjVlvActv PEnv_p pndkpu_w_msg ptek_w_msg PurgLeakDiag_flgDiagBlkdLineActv SyC_stSub TiEngOff_stTiFirstStrt TiEngOff_tiFirstStrt tnsez_w_msg VehV_v zadiag_msg /end IN_MEASUREMENT
 /begin OUT_MEASUREMENT aktbeg_msg aktdtesk_msg aktlauf_msg B_dteskfzg_msg B_dteskpid_msg B_dte_msg B_priodesk_msg B_punxc_msg B_scatldo_msg B_tldbccon_msg B_tlddicon_msg B_tldhb05_msg B_tldinfo_msg B_tldklcon_msg B_tldklnx_msg B_tldmderr_msg B_tldobd_msg B_tldres_msg B_tldrlerr_msg B_tldstnai_msg B_tldstpt_msg B_tldstub_msg B_tldwdcon_msg B_tumgnxc_msg B_tumgsrv_msg PurgLeakDiag_flgColdStrtVld PurgLeakDiag_flgTankLeakDiagFinshd reqdtesk_msg TankLeakDiag_facEthnlSensVal tldnostp_msg /end OUT_MEASUREMENT
 /begin LOC_MEASUREMENT aktlauft aktloc aktstopt B_abbrtldloc B_dtesk05 B_priodest B_rirvfzg B_sstp B_tldbcstp B_tldtestp B_tldvfzg B_tmstkpid B_ztesgst ctdtesk05 fteadptf_w puold_w PurgLeakDiag_flgBlkdLineErr PurgLeakDiag_flgDlyNewIdle PurgLeakDiag_flgDSMChk PurgLeakDiag_flgDSMclr PurgLeakDiag_flgEnaCdnFuMixAdpn PurgLeakDiag_flgEnaCdnIdleCtrl PurgLeakDiag_stftead PurgLeakDiag_tAmbAir PurgLeakDiag_tCEngStrt PurgLeakDiag_uBatt PurgLeakDiag_vVeh rqdteskt tdpu_w tedfto05_w /end LOC_MEASUREMENT
 FUNCTION_VERSION "30201.2.0" /end FUNCTION
/begin FUNCTION DiagLeakDtesk_StMac "30201.1.0 Tank leak diagnosis DTESK state machine"
 /begin DEF_CHARACTERISTIC CWDTESKZA DDPTEAR DDPTEDT05 DDPTEKU DMSNSTLD DPDELTA DPDTED DPKOND DPLINMX DPTEDSCH DPTLDDU DTESKZA_GKTEDKX05_CUR DTESKZA_LimpGKTEDKX05_C FSTTTLD GKTEDKXFA GKTEDKXFAG KLDPENVTDUD KLFSTTEWM KLMSSTLD KLTCENGDSTGK05 KLTMSTVDDMX05 MSIDST MSNTVMX05 MSTLDTC PTEDE PurgeLeakDiag_mfIntegdCpv_C PurgLeakDiag_facIncCpvMf_T PurgLeakDiag_mfMinIntegdVacPha_T PurgLeakDiag_ThdTarPEOL_M PurgLeakDiag_ThdTarP_M PurgLeakDiag_volDiagBlkdLineErrThd_C TDTED TDTLIN TPTEE05 TPTEEBMX TTEDWD05 TTEDWU TTLDFRRS TTLDFRRW TVAAV05 ZKMSNTLD /end DEF_CHARACTERISTIC
 /begin IN_MEASUREMENT aktlauf_msg B_dte_msg B_fatld05_msg B_fatldeg_msg B_fsttldv_msg CEngDsT_tStrt CstrPurg_mfCpvDteskBlkdLine Eep_EnvRamHist Eep_EnvRamInvld EnvT_t frm_w_msg fstt_w_msg mstedte_w_msg PEnv_p pttp_w_msg SyC_stSub tumg_msg /end IN_MEASUREMENT
 /begin OUT_MEASUREMENT aktend_msg B_abbrtld_msg B_dteaav_msg B_dtefrr_msg B_eaav_msg B_etesgg_msg B_etvtldmn_msg B_etvtldmx_msg B_iatlddu_msg B_iatldha_msg B_iatldko_msg B_iatldms_msg B_iatldpt_msg B_ptfslo_msg B_tldav_msg B_tldto_msg B_zaav_msg B_ztesgg_msg B_ztevtld_msg ddpterl_w_msg frdter_w_msg fstttld_w_msg gkomp_w_msg gudab_w_msg msnitld_w_msg msnstld_w_msg pdptedud_w_msg pttr_w_msg PurgLeakDiag_flgCycCpvStuckClsdChk PurgLeakDiag_flgCycCpvStuckOpenChk PurgLeakDiag_flgDiagBlkdLineActv PurgLeakDiag_flgDiagBlkdLineCyc PurgLeakDiag_flgDiagBlkdLineErr PurgLeakDiag_mIntglMfDiagBlkdLine PurgLeakDiag_volDiagBlkdLine tdtedppr_msg zadiagpr_msg zadiag_msg /end OUT_MEASUREMENT
 /begin LOC_MEASUREMENT dplin_w pttpstrt_w PurgLeakDiag_mfDifGasCapChk PurgLeakDiag_mfDifLrgLeakChk tdtedp tdtedps ttldfrr /end LOC_MEASUREMENT
 FUNCTION_VERSION "30201.1.0" /end FUNCTION
/begin FUNCTION DiagLeakDtesk_Tstr "30201.3.0 Tank leak diagnosis DTESK tester output" /begin DEF_CHARACTERISTIC CWDTESKTC TEFABE TFATLDMX TFATLDMXEOL TSTPTLD /end DEF_CHARACTERISTIC
 /begin IN_MEASUREMENT aktlauf_msg B_cddtesk_msg B_dtetk_msg B_eaav_msg B_etesf_msg B_etesgg_msg B_etesk_msg B_etvtldmn_msg B_etvtldmx_msg B_faeonvdt_msg B_fatlde_msg B_fatlds_msg B_iatlddu_msg B_iatldha_msg B_iatldko_msg B_iatldms_msg B_iatldpt_msg B_m8te_msg B_punxc_msg B_tldhb05_msg B_tldpsd_msg B_tldres_msg B_tldstnai_msg B_tldstpt_msg B_tldstub_msg B_zdstof_msg B_ztesf_msg B_ztesk_msg Epm_stSpd reqdtesk_msg SyC_stSub top_w_msg /end IN_MEASUREMENT
 /begin OUT_MEASUREMENT B_fadstof_msg B_fatld05_msg PurgLeakDiag_flgDteskTstrReq stptldab_msg stptld_msg /end OUT_MEASUREMENT
 /begin LOC_MEASUREMENT B_sfatlde B_sm8te dtesktc_flgclr /end LOC_MEASUREMENT
 FUNCTION_VERSION "30201.3.0" /end FUNCTION
/begin FUNCTION DiagLeakEonv_Alg "30201.0.0 Tank leak diagnosis EONV algorithm"
 /begin DEF_CHARACTERISTIC APRBVACP EONVFST EONVSRS Eonv_pPeakMaxRejSuspc_M Eonv_pPeakMinRejSuspc_M Eonv_pThdErrWoEWMA_M Eonv_stAlg_C KFEONVPT PEONVDFP PEONVPZERO PPRBMX PVACBMN TDIAGMX TEONVDFP TEONVST TEONVVACBP TPMMX /end DEF_CHARACTERISTIC
 /begin IN_MEASUREMENT B_cdeonv_msg B_fsttldv_msg B_ppheonv_msg B_runeonv_msg B_vpheonv_msg Eep_EnvRamHist Eep_EnvRamInvld EnvT_t fstt_w_msg GlbDa_lTotDst ptvf_w_msg SyC_stSub tnachl_w_msg tumg_msg /end IN_MEASUREMENT
 /begin OUT_MEASUREMENT B_feonv_msg B_occveonv_msg B_pphfeonv_msg B_vphseonv_msg eonvnr_w_msg Eonv_pDifLeakErrWoEwma Eonv_pThdErrWoEWMA Eonv_stLeakErrWoEwma Eonv_stRejDiagRes Eonv_stRejDiagResActv /end OUT_MEASUREMENT
 /begin LOC_MEASUREMENT cccvoeonv Eonv_stRejDiagResSuspc Eonv_tAmbAir fstteonv_w peonvpp_w peonvpt_w peonvvp_w peonvvt_w PurgLeakDiag_facEonvSngNrmRes PurgLeakDiag_lenDstDrvnBfrStrtEonv PurgLeakDiag_nrEonvDiagResAvl PurgLeakDiag_pPPhaEonv PurgLeakDiag_pVacPhaEonv PurgLeakDiag_stEonvDiagRes PurgLeakDiag_tAmbTStrtEonv PurgLeakDiag_tiPPhaEonv PurgLeakDiag_tiVapPhaEonv PurgLeakDiag_volFuLvlStrtEonv teonvv teonvzer_w /end LOC_MEASUREMENT
 FUNCTION_VERSION "30201.0.0" /end FUNCTION
/begin FUNCTION DiagLeakEonv_Dsm "30201.1.0 Tank leak diagnosis EONV DSM"
 /begin DEF_CHARACTERISTIC CWEONVIR EONVEFC EONVEFS EONVEFT EONVENFC EONVENFT EONVETSP EONVSTFT TDTLDFSTVE /end DEF_CHARACTERISTIC
 /begin REF_CHARACTERISTIC TDIAGMX /end REF_CHARACTERISTIC
 /begin IN_MEASUREMENT B_cdeonv_msg B_eonvab_msg B_etesk_msg B_eveonvac_msg B_eveonvoc_msg B_faeonv_msg B_feonv_msg B_fsttldv_msg B_nachl_msg B_nvdicscm_msg B_tankg_msg B_tank_msg B_tesfmilerr_msg B_tesfmil_msg B_tesgmilerr_msg B_tesgmil_msg B_ztesk_msg eonvnr_w_msg Eonv_flgColdStrtVld Eonv_flgPEnvVld Eonv_pDifLeakErrWoEwma Eonv_pThdErrWoEWMA Eonv_stLeakErrWoEwma Eonv_stRejDiagResActv GlbDa_lTotDst SyC_stSub tengszlst_msg tengsz_w_msg /end IN_MEASUREMENT
 /begin OUT_MEASUREMENT B_dsteonvfcl_msg B_eeonv_msg B_endeonv_msg B_eonirn_msg B_eonvmil_msg B_eonvrssf_msg B_zeonv_msg Dsteonv_msg eonvewma_w_msg eonvewth_w_msg /end OUT_MEASUREMENT
 /begin LOC_MEASUREMENT B_eeonvld B_eonperlk B_eonperno B_infoEONVmax DEONVDFP_flgRstDsm eonvfd /end LOC_MEASUREMENT
 FUNCTION_VERSION "30201.1.0" /end FUNCTION
/begin FUNCTION DiagLeakEonv_EnaCdn "30201.0.0 Tank leak diagnosis EONV enable conditions"
 /begin DEF_CHARACTERISTIC CWEONV EONVDKMN PUEONVMN PurgLeakDiag_facEthMaxEonv_C PurgLeakDiag_flgDlyEonvEngOff_C PurgLeakDiag_tiDlyEonvDiag_T SFEONVA SFEONVAR TCOOLMN TDIFEONVMX TEONVAMN TEONVAMX TEONVCSMX TERMN TMSEONVMX TTLDVNL TTLDVNLST TWDTESKF TWEONVHCLR UBEONVMN VHDISTMN /end DEF_CHARACTERISTIC
 /begin IN_MEASUREMENT aktlauf_msg BattU_u B_cdeonv_msg B_dtetk_msg B_endeonv_msg B_fstdmn_msg B_fstdmx_msg B_fsttldv_msg B_nachl_msg B_sbteonva_msg B_tldpsd_msg B_tumgg_msg CEngDsT_tStop CEngDsT_tStrtFrst Eep_EnvRamHist Eep_EnvRamInvld EngStrt_bFrstStrtEnd EnvT_t Eonv_stRejDiagRes Eonv_stRejDiagResActv Epm_stSpd fethev_w_msg ftead_w_msg GlbDa_lDstVeh PEnv_p SyC_stSub tengszlst_msg tengsz_w_msg TiEngOff_ti tnachl_w_msg tnsez_w_msg VehV_v /end IN_MEASUREMENT
 /begin OUT_MEASUREMENT B_eonvab_msg B_eonvnerr_msg B_eveonvac_msg B_eveonvoc_msg B_nldte_msg B_nvdicscm_msg B_runeonv_msg B_ubeonva_msg eonvdtko_w_msg Eonv_flgColdStrtVld Eonv_flgPEnvVld /end OUT_MEASUREMENT
 /begin LOC_MEASUREMENT B_rqeonv B_tldtehcl DEONVEB_flgRstDsm DEONVEB_pEnvP DEONVEB_tCEngDstStop DEONVEB_tCEngDsTStrtFrst DEONVEB_tEnvT DEONVEB_uBatt PurgLeakDiag_flgEonvDiagEnad PurgLeakDiag_stDteskDetdOkSys PurgLeakDiag_stEonvAbortReas PurgLeakDiag_stEonvDiagStopd PurgLeakDiag_stEonvInhbnReas /end LOC_MEASUREMENT
 FUNCTION_VERSION "30201.0.0" /end FUNCTION
/begin FUNCTION DiagLeakEonv_StMac "30201.0.0 Tank leak diagnosis EONV state machine" /begin DEF_CHARACTERISTIC TBPVACMN TOCVVACP /end DEF_CHARACTERISTIC
 /begin IN_MEASUREMENT B_feonv_msg B_occveonv_msg B_pphfeonv_msg B_runeonv_msg B_vphseonv_msg SyC_stSub /end IN_MEASUREMENT
 /begin OUT_MEASUREMENT B_ccveonv_msg B_ppheonv_msg B_vpheonv_msg /end OUT_MEASUREMENT
 /begin LOC_MEASUREMENT seonvcts /end LOC_MEASUREMENT
 FUNCTION_VERSION "30201.0.0" /end FUNCTION
/begin FUNCTION DiagLeakEonv_Tstr "30201.0.0 Tank leak diagnosis EONV tester output"
 /begin DEF_CHARACTERISTIC CWDEONVTC SEONVDISMN TEONVAHMN TEONVAHMX TEONVERTMN TMSEONVTMX /end DEF_CHARACTERISTIC
 /begin REF_CHARACTERISTIC TEONVAMN TEONVAMX /end REF_CHARACTERISTIC
 /begin IN_MEASUREMENT B_cddtesk_msg B_cdeonv_msg B_dtetk_msg B_dte_msg B_eeonv_msg B_endeonv_msg B_endtesk_msg B_eonvnerr_msg B_etesk_msg B_faeonv_msg B_fstdmn_msg B_fstdmx_msg B_kl15_msg B_nvdicscm_msg B_runeonv_msg B_tldpsd_msg B_ubeonva_msg B_zeonv_msg CEngDsT_tStrtFrst EnvT_t eonvdtko_w_msg Eonv_stRejDiagRes Eonv_stRejDiagResActv Epm_stSpd SyC_stSub tnsez_w_msg /end IN_MEASUREMENT
 /begin OUT_MEASUREMENT B_faeonvdt_msg B_sbteonva_msg eonvabort_msg eonvddr_w_msg eonvresult_msg eonvrtr_w_msg eonvsta_msg eonvstdr_msg eonvstmcp_msg evapesbts_msg /end OUT_MEASUREMENT
 /begin LOC_MEASUREMENT B_eonvsrd B_hotst /end LOC_MEASUREMENT
 FUNCTION_VERSION "30201.0.0" /end FUNCTION
/begin FUNCTION DiagPTank_Fil "30303.0.0 Tank pressure preparetion (p.ex. offset, filtering)"
 /begin DEF_CHARACTERISTIC DPTEDPU DPTEDTD DPTEDTK PTEBPTH TLDPTFFA TLDPTFHP TLDPTFNO TLDPTFSH TLDPTFSL TWTEFBPW /end DEF_CHARACTERISTIC
 /begin IN_MEASUREMENT B_nachl_msg B_ptfslo_msg B_runeonv_msg B_tldcvs_msg ptek_w_msg SyC_stSub /end IN_MEASUREMENT
 /begin OUT_MEASUREMENT B_dtetk_msg B_tldpsd_msg ptetp_w_msg pttp_w_msg ptvf_w_msg /end OUT_MEASUREMENT
 /begin LOC_MEASUREMENT ptebprct_w ptebp_w ptvfstrt_w /end LOC_MEASUREMENT
 FUNCTION_VERSION "30303.0.0" /end FUNCTION
/begin FUNCTION Diff_PlausPrtTrq "135.0.0   Differential protection torque - Error substitute reactions" /begin DEF_CHARACTERISTIC VehMot_tqWhlDftlProtn_C /end DEF_CHARACTERISTIC /begin IN_MEASUREMENT AccPed_rTrq PT_trqLos /end IN_MEASUREMENT /begin OUT_MEASUREMENT VehMot_tqCluDftlProtn VehMot_trqPrtDfftl /end OUT_MEASUREMENT FUNCTION_VERSION "135.0.0" /end FUNCTION
/begin FUNCTION Diff_TrqRat "23.4.0    Differential ratio - Error substitute reactions" /begin DEF_CHARACTERISTIC Diff_rTrqDfftl_C /end DEF_CHARACTERISTIC /begin OUT_MEASUREMENT VehMot_rTrqDfftl /end OUT_MEASUREMENT FUNCTION_VERSION "23.4.0" /end FUNCTION
/begin FUNCTION DINH "30000.27.0_1.0.0Diagnostic Inhibit Handler" /begin OUT_MEASUREMENT DINH_stDFCPid41Di /end OUT_MEASUREMENT
 /begin LOC_MEASUREMENT DINH_DSQSrv7Vis DINH_FIdSrv7Vis DINH_nrActvInhReas.FID_AFRA DINH_nrActvInhReas.FID_AORA DINH_nrActvInhReas.FID_ATEH DINH_nrActvInhReas.FID_ATEL DINH_nrActvInhReas.FID_ATEN DINH_nrActvInhReas.FID_ATLDI DINH_nrActvInhReas.FID_ATLDO DINH_nrActvInhReas.FID_BEONV DINH_nrActvInhReas.FId_EGSDCmnSeg1B1Parl DINH_nrActvInhReas.FID_BAGRA DINH_nrActvInhReas.FID_BAGRASD DINH_nrActvInhReas.FID_BDSTOF DINH_nrActvInhReas.FID_BFVDFRM DINH_nrActvInhReas.FID_BHOM DINH_nrActvInhReas.FID_BLLRH DINH_nrActvInhReas.FID_BLLRKH DINH_nrActvInhReas.FID_BPLSU DINH_nrActvInhReas.FID_FRAMBAVMB DINH_nrActvInhReas.FId_CatHeatgColdStrtReq DINH_nrActvInhReas.FId_CatHeatgWrmReq DINH_nrActvInhReas.FId_DSMBDEPHSpOpMode DINH_nrActvInhReas.FId_EGRVlvCoord DINH_nrActvInhReas.FId_EGSDO2FuTrmB1 DINH_nrActvInhReas.FId_EGSDO2SnsrMntdRelsS1B1 DINH_nrActvInhReas.FId_EGSDO2_LamOffsFastS1B1 DINH_nrActvInhReas.FId_MisfDetDnAdpnNv DINH_nrActvInhReas.FId_bascadpncvo DINH_nrActvInhReas.FID_AGRS DINH_nrActvInhReas.FID_BBAGR DINH_nrActvInhReas.FID_BBAGRA DINH_nrActvInhReas.FID_BGFKMS DINH_nrActvInhReas.FID_BGMSDKS DINH_nrActvInhReas.FID_CAGRSUS DINH_nrActvInhReas.FID_CBGTFUELM DINH_nrActvInhReas.FID_CBGTHDEV DINH_nrActvInhReas.FID_CDESVF DINH_nrActvInhReas.FID_CDETHS DINH_nrActvInhReas.FID_CDRCTSTRT DINH_nrActvInhReas.FID_CDSKV DINH_nrActvInhReas.FID_CDSKVRNO DINH_nrActvInhReas.FID_CDSKVRPO DINH_nrActvInhReas.FID_CDSKVRaty DINH_nrActvInhReas.FID_CDSKVRng DINH_nrActvInhReas.FID_CDSKVS DINH_nrActvInhReas.FID_CDSTR DINH_nrActvInhReas.FID_CDSTTI DINH_nrActvInhReas.FID_CETHG DINH_nrActvInhReas.FID_CETHSPLnpl DINH_nrActvInhReas.FID_CETHSTPLnpl DINH_nrActvInhReas.FID_CETKHL DINH_nrActvInhReas.FID_CETKHT DINH_nrActvInhReas.FID_CGDISTRT DINH_nrActvInhReas.FID_CGLSRDP DINH_nrActvInhReas.FID_CHDR DINH_nrActvInhReas.FID_CHDRKH DINH_nrActvInhReas.FID_CHDRPL DINH_nrActvInhReas.FID_CLLKHV DINH_nrActvInhReas.FID_CLLRHV DINH_nrActvInhReas.FID_CLZSRDP DINH_nrActvInhReas.FID_CLZSRHP DINH_nrActvInhReas.FID_CNLHP DINH_nrActvInhReas.FID_CNLHP2 DINH_nrActvInhReas.FID_CNLKO2 DINH_nrActvInhReas.FID_CNLKO3 DINH_nrActvInhReas.FID_CNLLP DINH_nrActvInhReas.FID_CNLPL DINH_nrActvInhReas.FID_CNLPS DINH_nrActvInhReas.FID_CNSAD DINH_nrActvInhReas.FID_CNSAD2 DINH_nrActvInhReas.FID_CPSRB DINH_nrActvInhReas.FID_CPSRP DINH_nrActvInhReas.FID_CSTHDR DINH_nrActvInhReas.FID_CSTRTCTL DINH_nrActvInhReas.FID_CTESF DINH_nrActvInhReas.FID_CTESG DINH_nrActvInhReas.FID_CTHIPSTRT DINH_nrActvInhReas.FID_CTKACS DINH_nrActvInhReas.FID_CTMSV DINH_nrActvInhReas.FID_CTOSP DINH_nrActvInhReas.FID_DHFERR DINH_nrActvInhReas.FID_DKRSA DINH_nrActvInhReas.FID_DLLRBandEndTst DINH_nrActvInhReas.FID_DLLRShrtTrpSpdRmp DINH_nrActvInhReas.FID_FEDKAHB DINH_nrActvInhReas.FID_FEDKAPB DINH_nrActvInhReas.FID_FEDSSB DINH_nrActvInhReas.FID_FOFSTP DINH_nrActvInhReas.FID_FONSTP DINH_nrActvInhReas.FID_FUEDK DINH_nrActvInhReas.FID_FVLRA DINH_nrActvInhReas.FID_KRREGact DINH_nrActvInhReas.FID_KRREGloc DINH_nrActvInhReas.FID_LRADLSU DINH_nrActvInhReas.FID_LRALSVErr DINH_nrActvInhReas.FID_LRAPLLSU DINH_nrActvInhReas.FID_LUSTP DINH_nrActvInhReas.FID_LnKS1 DINH_nrActvInhReas.FID_PLSUV DINH_nrActvInhReas.FID_PSRMOZDG DINH_nrActvInhReas.FID_PSRMOZG DINH_nrActvInhReas.FID_STRTDIA DINH_nrActvInhReas.FID_STRTSTM DINH_nrActvInhReas.FID_TFA1CSMW DINH_nrActvInhReas.FID_TFA2CSMW DINH_nrActvInhReas.FID_TKACSMW DINH_nrActvInhReas.FID_TMCSMW DINH_nrActvInhReas.FID_TOCHOilSwmpTQly DINH_nrActvInhReas.FID_TOCHTME DINH_nrActvInhReas.FID_TOSPCSMW DINH_nrActvInhReas.FID_TSRLX DINH_nrActvInhReas.FID_UEGOHeatrRlyS1B1 DINH_nrActvInhReas.FID_VehStvSSEOk DINH_nrActvInhReas.FID_VldtLamPlausMaxS1B1 DINH_nrActvInhReas.FID_VldtLamPlausMinS1B1 DINH_nrActvInhReas.FId_ACClntPSSPMon DINH_nrActvInhReas.FId_ACCompComCANBusOff DINH_nrActvInhReas.FId_ACCompComCANErrMtr DINH_nrActvInhReas.FId_ACComp_HiUTWSnsrErr DINH_nrActvInhReas.FId_ACComp_LoUTWSnsrErr DINH_nrActvInhReas.FId_ACComp_PDSnsrErr DINH_nrActvInhReas.FId_ACComp_VehSpdSnsrErr DINH_nrActvInhReas.FId_ACCtl_ACStrtCut DINH_nrActvInhReas.FId_ACCtl_APP1 DINH_nrActvInhReas.FId_ACCtl_APP2 DINH_nrActvInhReas.FId_ACCtl_APPSync DINH_nrActvInhReas.FId_ACCtl_AcOff DINH_nrActvInhReas.FId_ACCtl_Clmb DINH_nrActvInhReas.FId_ACCtl_DK1 DINH_nrActvInhReas.FId_ACCtl_DK2 DINH_nrActvInhReas.FId_ACCtl_DKSync DINH_nrActvInhReas.FId_ACCtl_VehSpdSnsrErr DINH_nrActvInhReas.FId_ACCtl_pAC DINH_nrActvInhReas.FId_ACEvpTCANErr DINH_nrActvInhReas.FId_ACEvpTFrzVal DINH_nrActvInhReas.FId_ACEvpTPhysRng DINH_nrActvInhReas.FId_ACEvpTRplVal DINH_nrActvInhReas.FId_AFCLFailr DINH_nrActvInhReas.FId_AFS DINH_nrActvInhReas.FId_AFSPhyRng DINH_nrActvInhReas.FId_APP1SigPath DINH_nrActvInhReas.FId_APP2SigPath DINH_nrActvInhReas.FId_APPBrkErr /end LOC_MEASUREMENT
 FUNCTION_VERSION "30000.27.0_1.0.0" /end FUNCTION
/begin COMPU_METHOD acc_q0p021701_m_DIV_s2 "" RAT_FUNC "%6.4" "m/s^2" COEFFS 0 1152 0 0 0 25 /end COMPU_METHOD
/begin COMPU_METHOD B_TRUE "" TAB_VERB "%6.3" "" COMPU_TAB_REF B_TRUE /end COMPU_METHOD
/begin COMPU_VTAB B_TRUE "" TAB_VERB 2 0 "FALSE" 1 "TRUE" /end COMPU_VTAB
/begin COMPU_METHOD dez "" RAT_FUNC "%6.2" "" COEFFS 0 1 0 0 0 1 /end COMPU_METHOD
/begin COMPU_METHOD DiaActrElecPsDiag_stSig_COMPU_VERB "" TAB_VERB "%6.3" "" COMPU_TAB_REF DiaActrElecPsDiag_stSig_COMPU_VERB /end COMPU_METHOD
/begin COMPU_VTAB DiaActrElecPsDiag_stSig_COMPU_VERB "" TAB_VERB 7 0 "INVALID" 1 "NOTEST" 2 "NOFAULT" 3 "FAULT" 4 "PREFAULT" 5 "HEALFAULT" 6 "WAITSTATE" DEFAULT_VALUE "0" /end COMPU_VTAB
/begin COMPU_METHOD DiaActrElecPsDiag_stTestPls_COMPU_VERB "" TAB_VERB "%6.3" "" COMPU_TAB_REF DiaActrElecPsDiag_stTestPls_COMPU_VERB /end COMPU_METHOD
/begin COMPU_VTAB DiaActrElecPsDiag_stTestPls_COMPU_VERB "" TAB_VERB 5 1 "NO" 2 "REQUESTED" 3 "RUNNING" 4 "FINISHED" 5 "RE-TRIGGERED" DEFAULT_VALUE "1" /end COMPU_VTAB
/begin COMPU_METHOD DiaActrElecPsDiag_stTmngTestPls_COMPU_VERB "" TAB_VERB "%6.3" "" COMPU_TAB_REF DiaActrElecPsDiag_stTmngTestPls_COMPU_VERB /end COMPU_METHOD
/begin COMPU_VTAB DiaActrElecPsDiag_stTmngTestPls_COMPU_VERB "" TAB_VERB 4 1 "EVERY_RASTER" 2 "TIME_BETWEEN_TEST_1" 3 "TIME_BETWEEN_TEST_2" 0 "NO" DEFAULT_VALUE "0" /end COMPU_VTAB
/begin COMPU_METHOD DiaActr_ElecPsDiag_DbgSigTyp_COMPU_VERB "" TAB_VERB "%6.3" "" COMPU_TAB_REF DiaActr_ElecPsDiag_DbgSigTyp_COMPU_VERB /end COMPU_METHOD
/begin COMPU_VTAB DiaActr_ElecPsDiag_DbgSigTyp_COMPU_VERB "" TAB_VERB 4 1 "DIGITAL_OUTPUT" 2 "PWM_OUTPUT" 3 "PMD_OUTPUT" 0 "NONE" DEFAULT_VALUE "0" /end COMPU_VTAB
/begin COMPU_METHOD DINH_ct_Compu "" RAT_FUNC "%6.0" "" COEFFS 0 -1 4096 0 0 1 /end COMPU_METHOD
/begin COMPU_METHOD EPSLOADSNSRONLY_SC_Compu "" TAB_VERB "%6.3" "" COMPU_TAB_REF EPSLOADSNSRONLY_SC_Compu /end COMPU_METHOD
/begin COMPU_VTAB EPSLOADSNSRONLY_SC_Compu "" TAB_VERB 2 0 "EPSLOADSNSRONLY_OFF" 1 "EPSLOADSNSRONLY_ON" /end COMPU_VTAB
/begin COMPU_METHOD ERCLNTVLVI_TYPAVL_SC_Compu "" TAB_VERB "%6.3" "" COMPU_TAB_REF ERCLNTVLVI_TYPAVL_SC_Compu /end COMPU_METHOD
/begin COMPU_VTAB ERCLNTVLVI_TYPAVL_SC_Compu "" TAB_VERB 2 0 "False" 1 "True" /end COMPU_VTAB
/begin COMPU_METHOD ERCLNTVLVT_TYPAVL_SC_Compu "" TAB_VERB "%6.3" "" COMPU_TAB_REF ERCLNTVLVT_TYPAVL_SC_Compu /end COMPU_METHOD
/begin COMPU_VTAB ERCLNTVLVT_TYPAVL_SC_Compu "" TAB_VERB 2 0 "False" 1 "True" /end COMPU_VTAB
/begin COMPU_METHOD ERCLNTVLV_TYPAVLACTRLIB_SY_Compu "" TAB_VERB "%6.3" "" COMPU_TAB_REF ERCLNTVLV_TYPAVLACTRLIB_SY_Compu /end COMPU_METHOD
/begin COMPU_VTAB ERCLNTVLV_TYPAVLACTRLIB_SY_Compu "" TAB_VERB 2 0 "False" 1 "True" /end COMPU_VTAB
/begin COMPU_METHOD ERCLNTVLV_TYPAVL_SY_Compu "" TAB_VERB "%6.3" "" COMPU_TAB_REF ERCLNTVLV_TYPAVL_SY_Compu /end COMPU_METHOD
/begin COMPU_VTAB ERCLNTVLV_TYPAVL_SY_Compu "" TAB_VERB 2 0 "FALSE" 1 "TRUE" /end COMPU_VTAB
/begin COMPU_METHOD ERRLMP_CUST_SY_Compu "" TAB_VERB "%6.3" "" COMPU_TAB_REF ERRLMP_CUST_SY_Compu /end COMPU_METHOD
/begin COMPU_VTAB ERRLMP_CUST_SY_Compu "" TAB_VERB 5 0 "ERRLMP_RB" 1 "ERRLMP_VAG" 2 "ERRLMP_BMW" 3 "ERRLMP_DAcom" 4 "ERRLMP_MSE" /end COMPU_VTAB
/begin COMPU_METHOD ERRLMP_UNIFY_SC_Compu "" TAB_VERB "%6.3" "" COMPU_TAB_REF ERRLMP_UNIFY_SC_Compu /end COMPU_METHOD
/begin COMPU_VTAB ERRLMP_UNIFY_SC_Compu "" TAB_VERB 2 0 "False" 1 "True" /end COMPU_VTAB
/begin COMPU_METHOD ERRREACHPINJVLVSTK_SY_Compu "" TAB_VERB "%6.3" "" COMPU_TAB_REF ERRREACHPINJVLVSTK_SY_Compu /end COMPU_METHOD
/begin COMPU_VTAB ERRREACHPINJVLVSTK_SY_Compu "" TAB_VERB 2 0 "FALSE" 1 "TRUE" /end COMPU_VTAB
/begin COMPU_METHOD ESC_ACTVTSYNCHAINCFG_SC_Compu "" TAB_VERB "%6.3" "" COMPU_TAB_REF ESC_ACTVTSYNCHAINCFG_SC_Compu /end COMPU_METHOD
/begin COMPU_VTAB ESC_ACTVTSYNCHAINCFG_SC_Compu "" TAB_VERB 3 0 "ACTVTSYNCHAIN_NONE" 1 "ACTVTSYNCHAIN_EBOS" 2 "ACTVTSYNCHAIN_ESC" /end COMPU_VTAB
/begin COMPU_METHOD ESC_ACTVTSYNTSKCHAIN_SC_Compu "" TAB_VERB "%6.3" "" COMPU_TAB_REF ESC_ACTVTSYNTSKCHAIN_SC_Compu /end COMPU_METHOD
/begin COMPU_VTAB ESC_ACTVTSYNTSKCHAIN_SC_Compu "" TAB_VERB 2 0 "DEACTIVE" 1 "ACTIVE" /end COMPU_VTAB
/begin COMPU_METHOD ESC_ENAPROCGROUP_SC_Compu "" TAB_VERB "%6.3" "" COMPU_TAB_REF ESC_ENAPROCGROUP_SC_Compu /end COMPU_METHOD
/begin COMPU_VTAB ESC_ENAPROCGROUP_SC_Compu "" TAB_VERB 2 0 "DISABLED" 1 "ENABLED" /end COMPU_VTAB
/begin COMPU_METHOD ESC_MONSYNCTSKACTV_SC_Compu "" TAB_VERB "%6.3" "" COMPU_TAB_REF ESC_MONSYNCTSKACTV_SC_Compu /end COMPU_METHOD
/begin COMPU_VTAB ESC_MONSYNCTSKACTV_SC_Compu "" TAB_VERB 2 0 "ESC_MOSYNCTSK_INACTIVE" 1 "ESC_MOSYNCTSK_ACTIVE" /end COMPU_VTAB
/begin COMPU_METHOD ESC_NRAGEVEWCYC_SC_Compu "" RAT_FUNC "%6.2" "" COEFFS 0 1 0 0 0 1 /end COMPU_METHOD
/begin COMPU_METHOD ESC_NRTSKAGEVE_SC_Compu "" RAT_FUNC "%6.2" "" COEFFS 0 1 0 0 0 1 /end COMPU_METHOD
/begin COMPU_METHOD ESC_SAMPLETICALCN_SC_Compu "" TAB_VERB "%6.3" "" COMPU_TAB_REF ESC_SAMPLETICALCN_SC_Compu /end COMPU_METHOD
/begin COMPU_VTAB ESC_SAMPLETICALCN_SC_Compu "" TAB_VERB 2 0 "SEG_AG_BASD" 1 "TSK_TI_STAMP_BASD" /end COMPU_VTAB
/begin COMPU_METHOD ESC_SELNCAMSFTTSKACTVN_SC_Compu "" TAB_VERB "%6.3" "" COMPU_TAB_REF ESC_SELNCAMSFTTSKACTVN_SC_Compu /end COMPU_METHOD
/begin COMPU_VTAB ESC_SELNCAMSFTTSKACTVN_SC_Compu "" TAB_VERB 3 0 "NO_CAMSFTTSKACTVN" 1 "PLAT_CAMSFTTSKACTVN" 2 "HDP_CAMSFTTSKACTVN" /end COMPU_VTAB
/begin COMPU_METHOD ESC_SELNMETHSYNSDL_SC_Compu "" TAB_VERB "%6.3" "" COMPU_TAB_REF ESC_SELNMETHSYNSDL_SC_Compu /end COMPU_METHOD
/begin COMPU_VTAB ESC_SELNMETHSYNSDL_SC_Compu "" TAB_VERB 2 0 "OS_TSK_BASD_SDL" 1 "ESC_CNTNR_BASD_SDL" /end COMPU_VTAB
/begin COMPU_METHOD ESC_SELNNOTSTDTISYNCNTSK_SC_Compu "" TAB_VERB "%6.3" "" COMPU_TAB_REF ESC_SELNNOTSTDTISYNCNTSK_SC_Compu /end COMPU_METHOD
/begin COMPU_VTAB ESC_SELNNOTSTDTISYNCNTSK_SC_Compu "" TAB_VERB 2 0 "NO_SELN" 1 "40ms" /end COMPU_VTAB
/begin COMPU_METHOD ESC_SELSAMPLETICFGMETHOD_SC_Compu "" TAB_VERB "%6.3" "" COMPU_TAB_REF ESC_SELSAMPLETICFGMETHOD_SC_Compu /end COMPU_METHOD
/begin COMPU_VTAB ESC_SELSAMPLETICFGMETHOD_SC_Compu "" TAB_VERB 2 0 "MAN_CFG_METHOD" 1 "AUT_CFG_METHOD" /end COMPU_VTAB
/begin COMPU_METHOD ESC_SWTSYNRTMEASMT_SC_Compu "" TAB_VERB "%6.3" "" COMPU_TAB_REF ESC_SWTSYNRTMEASMT_SC_Compu /end COMPU_METHOD
/begin COMPU_VTAB ESC_SWTSYNRTMEASMT_SC_Compu "" TAB_VERB 2 0 "False" 1 "True" /end COMPU_VTAB
/begin COMPU_METHOD ESC_SYNCTASK_SC_Compu "" TAB_VERB "%6.3" "" COMPU_TAB_REF ESC_SYNCTASK_SC_Compu /end COMPU_METHOD
/begin COMPU_VTAB ESC_SYNCTASK_SC_Compu "" TAB_VERB 3 0 "0" 1 "1" 2 "2" /end COMPU_VTAB
/begin COMPU_METHOD ESNSAD_INHCUST_SY_Compu "" TAB_VERB "%6.3" "" COMPU_TAB_REF ESNSAD_INHCUST_SY_Compu /end COMPU_METHOD
/begin COMPU_VTAB ESNSAD_INHCUST_SY_Compu "" TAB_VERB 2 0 "False" 1 "True" /end COMPU_VTAB
/begin COMPU_METHOD Eta "" RAT_FUNC "%6.4" "Nm/(mg/cyc)" COEFFS 0 128 0 0 0 1 /end COMPU_METHOD
/begin COMPU_METHOD Eta1 "" RAT_FUNC "%6.4" "-" COEFFS 0 128 0 0 0 1 /end COMPU_METHOD
/begin COMPU_METHOD Eta2 "" RAT_FUNC "%6.4" "" COEFFS 0 128 0 0 0 1 /end COMPU_METHOD
/begin COMPU_METHOD ETCtlGovKd_fac "" RAT_FUNC "%7.6" "-" COEFFS 0 12800 0 0 0 1 /end COMPU_METHOD
/begin COMPU_METHOD ETCtlGovKi_fac "" RAT_FUNC "%8.7" "-" COEFFS 0 429496.7296 0 0 0 1 /end COMPU_METHOD
/begin COMPU_METHOD ETCtlGovKp_fac "" RAT_FUNC "%7.6" "-" COEFFS 0 25600 0 0 0 1 /end COMPU_METHOD
/begin COMPU_METHOD ETCtlGovRmp "" RAT_FUNC "%6.3" "s" COEFFS 0 0 1 0 0.0152587890625 0 /end COMPU_METHOD
/begin COMPU_METHOD ETCtlGov_p0q001 "" RAT_FUNC "%6.5" "-" COEFFS 0 1000 0 0 0 1 /end COMPU_METHOD
/begin COMPU_METHOD ETC_Act_SY_Compu "" TAB_VERB "%6.3" "" COMPU_TAB_REF ETC_Act_SY_Compu /end COMPU_METHOD
/begin COMPU_VTAB ETC_Act_SY_Compu "" TAB_VERB 2 0 "False" 1 "True" /end COMPU_VTAB
/begin COMPU_METHOD ETHDETN_SC_Compu "" TAB_VERB "%6.3" "" COMPU_TAB_REF ETHDETN_SC_Compu /end COMPU_METHOD
/begin COMPU_VTAB ETHDETN_SC_Compu "" TAB_VERB 3 0 "ETHDETN_NO" 1 "ETHDETN_SNSR" 2 "ETHDETN_MDL" /end COMPU_VTAB
/begin COMPU_METHOD ETHTSYN_SC_Compu "" TAB_VERB "%6.3" "" COMPU_TAB_REF ETHTSYN_SC_Compu /end COMPU_METHOD
/begin COMPU_VTAB ETHTSYN_SC_Compu "" TAB_VERB 2 0 "False" 1 "True" /end COMPU_VTAB
/begin COMPU_METHOD ETH_SC_Compu "" TAB_VERB "%6.3" "" COMPU_TAB_REF ETH_SC_Compu /end COMPU_METHOD
/begin COMPU_VTAB ETH_SC_Compu "" TAB_VERB 2 0 "False" 1 "True" /end COMPU_VTAB
/begin COMPU_METHOD ETKS_SY_Compu "" TAB_VERB "%6.3" "" COMPU_TAB_REF ETKS_SY_Compu /end COMPU_METHOD
/begin COMPU_VTAB ETKS_SY_Compu "" TAB_VERB 2 0 "No ETKS" 1 "ETKS" /end COMPU_VTAB
/begin COMPU_METHOD ETS_LEAN_SY_Compu "" RAT_FUNC "%6.2" "" COEFFS 0 1 0 0 0 1 /end COMPU_METHOD
/begin COMPU_METHOD ETS_NSC_SY_Compu "" RAT_FUNC "%6.2" "" COEFFS 0 1 0 0 0 1 /end COMPU_METHOD
/begin COMPU_METHOD ETS_PFLT1_SY_Compu "" RAT_FUNC "%6.2" "" COEFFS 0 1 0 0 0 1 /end COMPU_METHOD
/begin COMPU_METHOD ETS_PFLT2_SY_Compu "" RAT_FUNC "%6.2" "" COEFFS 0 1 0 0 0 1 /end COMPU_METHOD
/begin COMPU_METHOD ETS_PHC_SY_Compu "" RAT_FUNC "%6.2" "" COEFFS 0 1 0 0 0 1 /end COMPU_METHOD
/begin COMPU_METHOD ETS_SOX_SY_Compu "" RAT_FUNC "%6.2" "" COEFFS 0 1 0 0 0 1 /end COMPU_METHOD
/begin COMPU_METHOD EVAPACTR_CCV_SC_Compu "" TAB_VERB "%6.3" "" COMPU_TAB_REF EVAPACTR_CCV_SC_Compu /end COMPU_METHOD
/begin COMPU_VTAB EVAPACTR_CCV_SC_Compu "" TAB_VERB 2 0 "00_NO_CCV" 1 "01_DO_OPEN" /end COMPU_VTAB
/begin COMPU_METHOD EVAPACTR_CPPUHILOAD_SC_Compu "" TAB_VERB "%6.3" "" COMPU_TAB_REF EVAPACTR_CPPUHILOAD_SC_Compu /end COMPU_METHOD
/begin COMPU_VTAB EVAPACTR_CPPUHILOAD_SC_Compu "" TAB_VERB 3 0 "00_NO_CPPU" 1 "01_CPPU" 2 "02_CODWORD" /end COMPU_VTAB
/begin COMPU_METHOD EVAPACTR_CPVPWRSTG_SC_Compu "" TAB_VERB "%6.3" "" COMPU_TAB_REF EVAPACTR_CPVPWRSTG_SC_Compu /end COMPU_METHOD
/begin COMPU_VTAB EVAPACTR_CPVPWRSTG_SC_Compu "" TAB_VERB 3 0 "NO_CPV_PS_DIAG" 1 "CPV_STD_PS_DIAG" 2 "CPV_PS_DIAG_BTS7200" /end COMPU_VTAB
/begin COMPU_METHOD EVAPACTR_DMTLFRQDETN_SC_Compu "" TAB_VERB "%6.3" "" COMPU_TAB_REF EVAPACTR_DMTLFRQDETN_SC_Compu /end COMPU_METHOD
/begin COMPU_VTAB EVAPACTR_DMTLFRQDETN_SC_Compu "" TAB_VERB 5 0 "00_NO_FRQDETN" 1 "01_FRQDETN_RIPPEL" 2 "02_CODWORD" 3 "03_FREQDETN_BACKEMF" 4 "04_FREQDETN_TIBASD" /end COMPU_VTAB
/begin COMPU_METHOD EVAPACTR_VAR_SY_Compu "" TAB_VERB "%6.3" "" COMPU_TAB_REF EVAPACTR_VAR_SY_Compu /end COMPU_METHOD
/begin COMPU_VTAB EVAPACTR_VAR_SY_Compu "" TAB_VERB 58 0 "kein Kundenbezug" 1 "DAI" 3 "VWW" 4 "POR" 5 "AUD" 6 "OPE" 9 "FIA" 11 "BMW" 14 "PSA" 15 "REN" 17 "ALF" 18 "SAB" 19 "VOL" 20 "NIS" 21 "GMU" 22 "FOR" 26 "IMJ" 36 "MAN" 51 "SEA" 53 "CHR" 54 "JAG" 55 "ROL" 69 "FER" 72 "TOY" 73 "LAM" 123 "MIT" 147 "HYU" 159 "HON" 160 "MAZ" 183 "CU" 190 "LRG" 204 "VVW" 214 "AVT" 242 "Iveco" 243 "DMC" 248 "SUZ" 267 "SSANGYONG" 270 "KEF" 289 "AMG" 308 "TAT" 319 "MVM" 327 "OTOSAN" 328 "MM" 385 "UAES" 590 "Scania" 609 "Deutz" 720 "Greatwall" 745 "JMC Ford" 788 "Saic Motor" 828 "RBCD" 898 "MFTBC" 936 "Anhui_Quanchai" 944 "DOOSAN Infracore" 984 "FAW - Wuxi" 999 "ALL" 2887 "Nonox" 9454 "Fuso" 9707 "Hatz" /end COMPU_VTAB
/begin COMPU_METHOD EVAPCP_CPPU_SC_Compu "" TAB_VERB "%6.3" "" COMPU_TAB_REF EVAPCP_CPPU_SC_Compu /end COMPU_METHOD
/begin COMPU_VTAB EVAPCP_CPPU_SC_Compu "" TAB_VERB 2 0 "False" 1 "True" /end COMPU_VTAB
/begin COMPU_METHOD EVAPDI_BLKDLINE_SC_Compu "" TAB_VERB "%6.3" "" COMPU_TAB_REF EVAPDI_BLKDLINE_SC_Compu /end COMPU_METHOD
/begin COMPU_VTAB EVAPDI_BLKDLINE_SC_Compu "" TAB_VERB 2 0 "disabled" 1 "enabled" /end COMPU_VTAB
/begin COMPU_METHOD fak_sw_b64 "" RAT_FUNC "%6.4" "-" COEFFS 0 65536 0 0 0 128 /end COMPU_METHOD
/begin COMPU_METHOD fak_ub_b2 "" RAT_FUNC "%8.5" "-" COEFFS 0 256 0 0 0 2 /end COMPU_METHOD
/begin COMPU_METHOD fak_uw_b2 "" RAT_FUNC "%7.6" "-" COEFFS 0 65536 0 0 0 2 /end COMPU_METHOD
/begin COMPU_METHOD fak_uw_b25p6 "" RAT_FUNC "%6.5" "-" COEFFS 0 2560 0 0 0 1 /end COMPU_METHOD
/begin COMPU_METHOD fak_uw_b4 "" RAT_FUNC "%7.6" "-" COEFFS 0 65536 0 0 0 4 /end COMPU_METHOD
/begin COMPU_METHOD Length "" RAT_FUNC "%6.2" "m" COEFFS 0 1 0 0 0 1 /end COMPU_METHOD
/begin COMPU_METHOD m_3p47222Em4_g "" RAT_FUNC "%6.5" "g" COEFFS 0 2880 0 0 0 1 /end COMPU_METHOD
/begin COMPU_METHOD m_ub_q0p0444 "" RAT_FUNC "%6.4" "g" COEFFS 0 1 0 0 0 0.0444 /end COMPU_METHOD
/begin COMPU_METHOD m_uw_b25p6 "" RAT_FUNC "%6.5" "kg/h" COEFFS 0 65536 0 0 0 25.6 /end COMPU_METHOD
/begin COMPU_METHOD OneToOne "" RAT_FUNC "%6.2" "-" COEFFS 0 1 0 0 0 1 /end COMPU_METHOD
/begin COMPU_METHOD pgrad_q2p38Em5 "" RAT_FUNC "%7.6" "hPa/s" COEFFS 0 65536 0 0 0 1.5625 /end COMPU_METHOD
/begin COMPU_METHOD p_q0p00122 "" RAT_FUNC "%6.4" "hPa" COEFFS 0 65536 0 0 0 80 /end COMPU_METHOD
/begin COMPU_METHOD p_q0p3125 "" RAT_FUNC "%6.3" "hPa" COEFFS 0 256 0 0 0 80 /end COMPU_METHOD
/begin COMPU_METHOD p_sw_q0p00244 "" RAT_FUNC "%6.4" "hPa" COEFFS 0 32768 0 0 0 80 /end COMPU_METHOD
/begin COMPU_METHOD p_ub_q5 "" RAT_FUNC "%6.2" "hPa" COEFFS 0 1 0 0 0 5 /end COMPU_METHOD
/begin COMPU_METHOD p_uw_q0p039 "" RAT_FUNC "%6.4" "hPa" COEFFS 0 256 0 0 0 10 /end COMPU_METHOD
/begin COMPU_METHOD spg_q0p00039 "" RAT_FUNC "%6.5" "V" COEFFS 0 1 0 0 0 0.000390625 /end COMPU_METHOD
/begin COMPU_METHOD spg_q0p1 "" RAT_FUNC "%6.3" "V" COEFFS 0 1 0 0 0 0.1 /end COMPU_METHOD
/begin COMPU_METHOD s_q0p02777_m "" RAT_FUNC "%6.4" "m" COEFFS 0 36 0 0 0 1 /end COMPU_METHOD
/begin COMPU_METHOD s_q0p1_km "" RAT_FUNC "%6.3" "Km" COEFFS 0 1 0 0 0 0.1 /end COMPU_METHOD
/begin COMPU_METHOD s_q1p3888_m "" RAT_FUNC "%6.2" "m" COEFFS 0 18 0 0 0 25 /end COMPU_METHOD
/begin COMPU_METHOD t100msxs_uw_b6553p5 "" RAT_FUNC "%6.3" "s" COEFFS 0 1 0 0 0 0.1 /end COMPU_METHOD
/begin COMPU_METHOD t6minxmin_q6 "" RAT_FUNC "%6.2" "min" COEFFS 0 1 0 0 0 6 /end COMPU_METHOD
/begin COMPU_METHOD Temp_Cels "" RAT_FUNC "%6.1" "deg C" COEFFS 0 10 2731.4 0 0 1 /end COMPU_METHOD
/begin COMPU_METHOD temp_ub_q0p75 "" RAT_FUNC "%6.3" "Grad C" COEFFS 0 1 0 0 0 0.75 /end COMPU_METHOD
/begin COMPU_METHOD temp_ub_q0p75_o48 "" RAT_FUNC "%6.2" "Grad C" COEFFS 0 1 48 0 0 0.75 /end COMPU_METHOD
/begin COMPU_METHOD Time_sec_q1_COMPU "" RAT_FUNC "%6.2" "s" COEFFS 0 1 0 0 0 1 /end COMPU_METHOD
/begin COMPU_METHOD TransR "" RAT_FUNC "%6.4" "-" COEFFS 0 100 0 0 0 1 /end COMPU_METHOD
/begin COMPU_METHOD Trq "" RAT_FUNC "%6.3" "Nm" COEFFS 0 10 0 0 0 1 /end COMPU_METHOD
/begin COMPU_METHOD TrqPrpHigh "" RAT_FUNC "%6.3" "Nm" COEFFS 0 10 0 0 0 1 /end COMPU_METHOD
/begin COMPU_METHOD t_q0p02 "" RAT_FUNC "%6.4" "s" COEFFS 0 100 0 0 0 2 /end COMPU_METHOD
/begin COMPU_METHOD t_q0p1 "" RAT_FUNC "%6.3" "s" COEFFS 0 10 0 0 0 1 /end COMPU_METHOD
/begin COMPU_METHOD t_q1 "" RAT_FUNC "%6.2" "s" COEFFS 0 1 0 0 0 1 /end COMPU_METHOD
/begin COMPU_METHOD t_q4_s "" RAT_FUNC "%6.2" "s" COEFFS 0 1 0 0 0 4 /end COMPU_METHOD
/begin COMPU_METHOD Vel "" RAT_FUNC "%6.4" "km/h" COEFFS 0 100 0 0 0 1 /end COMPU_METHOD
/begin COMPU_METHOD vfzg_uw_b512 "" RAT_FUNC "%6.4" "km/h" COEFFS 0 65536 0 0 0 512 /end COMPU_METHOD
/begin COMPU_METHOD vol_q0p01_l "" RAT_FUNC "%6.4" "L" COEFFS 0 100 0 0 0 1 /end COMPU_METHOD
/begin COMPU_METHOD vol_q0p1_l "" RAT_FUNC "%6.3" "l" COEFFS 0 1 0 0 0 0.1 /end COMPU_METHOD
/begin COMPU_METHOD zk100msxs_uw_b6553p6 "" RAT_FUNC "%6.1" "s" COEFFS 0 0 65536 0 10 0 /end COMPU_METHOD
/begin COMPU_METHOD zk10msxs_uw_b655p36 "" RAT_FUNC "%6.2" "s" COEFFS 0 0 65536 0 100 0 /end COMPU_METHOD
/begin RECORD_LAYOUT RB_Axis_U16 NO_AXIS_PTS_X 1 UWORD AXIS_PTS_X 2 UWORD INDEX_INCR DIRECT /end RECORD_LAYOUT
/begin RECORD_LAYOUT RB_CurveGroup_U16 FNC_VALUES 1 UWORD COLUMN_DIR DIRECT /end RECORD_LAYOUT
/begin RECORD_LAYOUT RB_Curve_S16_S16 NO_AXIS_PTS_X 1 SWORD AXIS_PTS_X 2 SWORD INDEX_INCR DIRECT FNC_VALUES 3 SWORD COLUMN_DIR DIRECT /end RECORD_LAYOUT
/begin RECORD_LAYOUT RB_Curve_S16_U16_Static NO_AXIS_PTS_X 1 SWORD AXIS_PTS_X 2 SWORD INDEX_INCR DIRECT FNC_VALUES 3 UWORD COLUMN_DIR DIRECT STATIC_RECORD_LAYOUT /end RECORD_LAYOUT
/begin RECORD_LAYOUT RB_Curve_S16_U8_Static NO_AXIS_PTS_X 1 SWORD AXIS_PTS_X 2 SWORD INDEX_INCR DIRECT FNC_VALUES 3 UBYTE COLUMN_DIR DIRECT STATIC_RECORD_LAYOUT /end RECORD_LAYOUT
/begin RECORD_LAYOUT RB_Curve_U16_U16 NO_AXIS_PTS_X 1 UWORD AXIS_PTS_X 2 UWORD INDEX_INCR DIRECT FNC_VALUES 3 UWORD COLUMN_DIR DIRECT /end RECORD_LAYOUT
/begin RECORD_LAYOUT RB_Curve_U16_U8_Static NO_AXIS_PTS_X 1 UWORD AXIS_PTS_X 2 UWORD INDEX_INCR DIRECT FNC_VALUES 3 UBYTE COLUMN_DIR DIRECT STATIC_RECORD_LAYOUT /end RECORD_LAYOUT
/begin RECORD_LAYOUT RB_Curve_U8_S16_Static NO_AXIS_PTS_X 1 UBYTE AXIS_PTS_X 2 UBYTE INDEX_INCR DIRECT FNC_VALUES 3 SWORD COLUMN_DIR DIRECT STATIC_RECORD_LAYOUT /end RECORD_LAYOUT
/begin RECORD_LAYOUT RB_Curve_U8_U16_Static NO_AXIS_PTS_X 1 UBYTE AXIS_PTS_X 2 UBYTE INDEX_INCR DIRECT FNC_VALUES 3 UWORD COLUMN_DIR DIRECT STATIC_RECORD_LAYOUT /end RECORD_LAYOUT
/begin RECORD_LAYOUT RB_Map_S16U16_U16 NO_AXIS_PTS_X 1 SWORD NO_AXIS_PTS_Y 2 SWORD AXIS_PTS_X 3 SWORD INDEX_INCR DIRECT AXIS_PTS_Y 4 UWORD INDEX_INCR DIRECT FNC_VALUES 5 UWORD ROW_DIR DIRECT /end RECORD_LAYOUT
/begin RECORD_LAYOUT RB_Map_U16S16_S16 NO_AXIS_PTS_X 1 UWORD NO_AXIS_PTS_Y 2 UWORD AXIS_PTS_X 3 UWORD INDEX_INCR DIRECT AXIS_PTS_Y 4 SWORD INDEX_INCR DIRECT FNC_VALUES 5 SWORD COLUMN_DIR DIRECT /end RECORD_LAYOUT
/begin RECORD_LAYOUT RB_Map_U16S16_U8 NO_AXIS_PTS_X 1 UWORD NO_AXIS_PTS_Y 2 UWORD AXIS_PTS_X 3 UWORD INDEX_INCR DIRECT AXIS_PTS_Y 4 SWORD INDEX_INCR DIRECT FNC_VALUES 5 UBYTE COLUMN_DIR DIRECT /end RECORD_LAYOUT
/begin RECORD_LAYOUT RB_Map_U16U16_U16 NO_AXIS_PTS_X 1 UWORD NO_AXIS_PTS_Y 2 UWORD AXIS_PTS_X 3 UWORD INDEX_INCR DIRECT AXIS_PTS_Y 4 UWORD INDEX_INCR DIRECT FNC_VALUES 5 UWORD COLUMN_DIR DIRECT /end RECORD_LAYOUT
/begin RECORD_LAYOUT RB_Map_U8U16_U16 NO_AXIS_PTS_X 1 UBYTE NO_AXIS_PTS_Y 2 UBYTE AXIS_PTS_X 3 UBYTE INDEX_INCR DIRECT AXIS_PTS_Y 4 UWORD INDEX_INCR DIRECT FNC_VALUES 5 UWORD ROW_DIR DIRECT /end RECORD_LAYOUT
/begin RECORD_LAYOUT RB_Val_Wboolean FNC_VALUES 1 UBYTE COLUMN_DIR DIRECT /end RECORD_LAYOUT
/begin RECORD_LAYOUT RB_Val_Ws16 FNC_VALUES 1 SWORD COLUMN_DIR DIRECT /end RECORD_LAYOUT
/begin RECORD_LAYOUT RB_Val_Ws32 FNC_VALUES 1 SLONG COLUMN_DIR DIRECT /end RECORD_LAYOUT
/begin RECORD_LAYOUT RB_Val_Wu16 FNC_VALUES 1 UWORD COLUMN_DIR DIRECT /end RECORD_LAYOUT
/begin RECORD_LAYOUT RB_Val_Wu8 FNC_VALUES 1 UBYTE COLUMN_DIR DIRECT /end RECORD_LAYOUT
/begin RECORD_LAYOUT Val_Wu32 FNC_VALUES 1 ULONG COLUMN_DIR DIRECT /end RECORD_LAYOUT
/begin RECORD_LAYOUT Val_Wu8 FNC_VALUES 1 UBYTE COLUMN_DIR DIRECT /end RECORD_LAYOUT
/end MODULE
/end PROJECT
