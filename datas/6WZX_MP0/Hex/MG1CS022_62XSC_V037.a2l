ASAP2_VERSION 1 60
/begin PROJECT MG1CS022 "MG1CS022"
/begin HEADER "" VERSION "MG1CS022_62XSC_V037" PROJECT_NO MG1CS022 /end HEADER
/begin MODULE DIM ""
/begin MOD_COMMON "" BYTE_ORDER MSB_LAST ALIGNMENT_BYTE 1 ALIGNMENT_WORD 2 ALIGNMENT_LONG 4 ALIGNMENT_INT64 4 ALIGNMENT_FLOAT32_IEEE 4 ALIGNMENT_FLOAT64_IEEE 4 DATA_SIZE 32 /end MOD_COMMON
/begin CHARACTERISTIC ANFKWPR2 "threshold for request a priority for catalyst heating" VALUE 0x8056D410 RB_Val_Wu16 1.999969 fak_uw_b2 0.00 1.999969 FORMAT "%8.6" /end CHARACTERISTIC
/begin CHARACTERISTIC CWKHMR "codeword for catalyst heating torque reserve" VALUE 0x8056D68C RB_Val_Wu16 65535.00 dez 0.00 65535.00 FORMAT "%8.2" /end CHARACTERISTIC
/begin CHARACTERISTIC DANFKWPR1 "threshold for request of a priority for catalyst heating" VALUE 0x8056D412 RB_Val_Wu16 1.999969 fak_uw_b2 0.00 1.999969 FORMAT "%8.6" /end CHARACTERISTIC
/begin CHARACTERISTIC DETAHOMKH "Minimum distance to minimum efficiency by switch Homogeneous Split injection (for catalyst heating)" VALUE 0x8056D68E RB_Val_Wu16 1.999969 fak_uw_b2 0.00 1.999969 FORMAT "%8.6" /end CHARACTERISTIC
/begin CHARACTERISTIC ExhMgT_effCatHeatgLimMax_C "maximum limitation of the desired engine efficiency for catalyst heating" VALUE 0x8056D690 RB_Val_Ws16 3.999939 fak_sw_b2 -2.000000 1.999939 FORMAT "%8.6" /end CHARACTERISTIC
/begin CHARACTERISTIC ExhMgT_effCatHeatgLimMin_C "minimum limitation of the desired engine efficiency for catalyst heating" VALUE 0x8056D692 RB_Val_Ws16 3.999939 fak_sw_b2 -2.000000 1.999939 FORMAT "%8.6" /end CHARACTERISTIC
/begin CHARACTERISTIC ExhMgT_effCatHeatgVlvLftDrvgSt_M "map for desired engine efficiency for catalyst heating in case of cold start by idle for valve lift and driving state condition" MAP 0x8056D694 RB_MapGroup_U16 1.999969 fak_uw_b2 0.00 1.999969 FORMAT "%8.6"
 /begin AXIS_DESCR COM_AXIS NO_INPUT_QUANTITY rel_uw_b100 8 0.00 99.99847 FORMAT "%8.5" AXIS_PTS_REF SMG08KHNGUW /end AXIS_DESCR
 /begin AXIS_DESCR COM_AXIS NO_INPUT_QUANTITY EngN 8 -16384.00 16383.50 FORMAT "%8.2" AXIS_PTS_REF SNM08KHUW /end AXIS_DESCR
/end CHARACTERISTIC
/begin CHARACTERISTIC ExhMgt_etaCatHeatgIdleMod_M "limitation of worsening of engine efficiency in case of a request for catalyst warming in idle" MAP 0x8056D714 RB_Map_S16U16_U16 1.999969 fak_uw_b2 0.00 1.999969 FORMAT "%8.6"
 /begin AXIS_DESCR STD_AXIS Epm_nEng EngN 3 -16384.00 16383.50 FORMAT "%8.2" DEPOSIT ABSOLUTE /end AXIS_DESCR
 /begin AXIS_DESCR STD_AXIS AirMod_ratChrgAirCyl rel_uw_q0p0234 3 0.00 1535.977 FORMAT "%8.3" DEPOSIT ABSOLUTE /end AXIS_DESCR
/end CHARACTERISTIC
/begin CHARACTERISTIC ExhMgt_etaCatHeatgPartLoadMod_M "limitation of worsening of engine efficiency in case of a request for catalyst warming in part load" MAP 0x8056D736 RB_Map_S16U16_U16 1.999969 fak_uw_b2 0.00 1.999969 FORMAT "%8.6"
 /begin AXIS_DESCR STD_AXIS Epm_nEng EngN 3 -16384.00 16383.50 FORMAT "%8.2" DEPOSIT ABSOLUTE /end AXIS_DESCR
 /begin AXIS_DESCR STD_AXIS AirMod_ratChrgAirCyl rel_uw_q0p0234 3 0.00 1535.977 FORMAT "%8.3" DEPOSIT ABSOLUTE /end AXIS_DESCR
/end CHARACTERISTIC
/begin CHARACTERISTIC ExhMgT_etaCatWrmIdleGearEngd_GM "map for desired engine efficiency for catalyst warming in idle with automatic gear box" MAP 0x8056D758 RB_MapGroup_U16 1.999969 fak_uw_b2 0.00 1.999969 FORMAT "%8.6"
 /begin AXIS_DESCR COM_AXIS NO_INPUT_QUANTITY rel_uw_b100 13 0.00 99.99847 FORMAT "%8.5" AXIS_PTS_REF SMG13KHUW /end AXIS_DESCR
 /begin AXIS_DESCR COM_AXIS Epm_nEng EngN 12 -16384.00 16383.50 FORMAT "%8.2" AXIS_PTS_REF SNM12KHUW /end AXIS_DESCR
/end CHARACTERISTIC
/begin CHARACTERISTIC ExhMgT_etaCatWrmIdle_GM "map for desired engine efficiency in case of catalyst warming in idle" MAP 0x8056D890 RB_MapGroup_U16 1.999969 fak_uw_b2 0.00 1.999969 FORMAT "%8.6"
 /begin AXIS_DESCR COM_AXIS NO_INPUT_QUANTITY rel_uw_b100 13 0.00 99.99847 FORMAT "%8.5" AXIS_PTS_REF SMG13KHUW /end AXIS_DESCR
 /begin AXIS_DESCR COM_AXIS Epm_nEng EngN 12 -16384.00 16383.50 FORMAT "%8.2" AXIS_PTS_REF SNM12KHUW /end AXIS_DESCR
/end CHARACTERISTIC
/begin CHARACTERISTIC ExhMgT_etaCatWrmPartLoad_GM "map for desired engine efficiency in case of catalyst warming during part load" MAP 0x8056D9C8 RB_MapGroup_U16 1.999969 fak_uw_b2 0.00 1.999969 FORMAT "%8.6"
 /begin AXIS_DESCR COM_AXIS NO_INPUT_QUANTITY rel_uw_b100 13 0.00 99.99847 FORMAT "%8.5" AXIS_PTS_REF SMG13KHUW /end AXIS_DESCR
 /begin AXIS_DESCR COM_AXIS Epm_nEng EngN 12 -16384.00 16383.50 FORMAT "%8.2" AXIS_PTS_REF SNM12KHUW /end AXIS_DESCR
/end CHARACTERISTIC
/begin CHARACTERISTIC ExhMgT_facCorrnEffOil_M "factor for correction of required worsening of engine efficiency for cold start catalyst heating in dependence of oil temperature and catalyst heat progress" MAP 0x8056DB00 RB_Map_S16U16_U16 1.992188 fak_ub_b2 0.00 1.992188 FORMAT "%8.6" EXTENDED_LIMITS 0.00 511.9922
 /begin AXIS_DESCR STD_AXIS ExhMgT_tOilMdlCatHeatg Temp_Cels 8 -3549.940 3003.560 FORMAT "%8.3" DEPOSIT ABSOLUTE /end AXIS_DESCR
 /begin AXIS_DESCR STD_AXIS ExhMgT_facCatHeatgProgs fak_uw_b1 8 0.00 0.9999847 FORMAT "%9.7" DEPOSIT ABSOLUTE /end AXIS_DESCR
/end CHARACTERISTIC
/begin CHARACTERISTIC ExhMgt_facEngEffEngCdn_M "weighting factor for desired engine efficiency for catalyst heating in case of a cold start in dependence on time after start and engine current temperature in altitde" MAP 0x8056DBA4 RB_Map_S16U16_U16 1.992188 fak_ub_b2 0.00 1.992188 FORMAT "%8.6" EXTENDED_LIMITS 0.00 511.9922
 /begin AXIS_DESCR STD_AXIS ExhMgT_tEngCatHeatgFild Temp_Cels 4 -3549.940 3003.560 FORMAT "%8.3" DEPOSIT ABSOLUTE /end AXIS_DESCR
 /begin AXIS_DESCR STD_AXIS tnse_w_msg t100msxs_uw_b6553p5 8 0.00 6553.500 FORMAT "%8.3" DEPOSIT ABSOLUTE /end AXIS_DESCR
/end CHARACTERISTIC
/begin CHARACTERISTIC ExhMgT_facEngEffTStrt_M "control factor for desired engine efficiency by catalyst heating in case of cold start in dependence of the engine temperature at start and of therelative amount of integrated air mass" MAP 0x8056DC00 RB_Map_S16U16_U16 1.992188 fak_ub_b2 0.00 1.992188 FORMAT "%8.6" EXTENDED_LIMITS 0.00 511.9922
 /begin AXIS_DESCR STD_AXIS ExhMgT_tEngCatHeatgFild Temp_Cels 8 -3549.940 3003.560 FORMAT "%8.3" DEPOSIT ABSOLUTE /end AXIS_DESCR
 /begin AXIS_DESCR STD_AXIS ExhMgT_facCatHeatgProgs fak_uw_b1 8 0.00 0.9999847 FORMAT "%9.7" DEPOSIT ABSOLUTE /end AXIS_DESCR
/end CHARACTERISTIC
/begin CHARACTERISTIC ExhMgT_facEtaCatWrmAltiT_M "map for control factor of desired engine efficiency by catalyst heating in case of catalyst warming depending on altitude and engine temperature" MAP 0x8056DCA4 RB_Map_S16U16_U16 1.992188 fak_ub_b2 0.00 1.992188 FORMAT "%8.6" EXTENDED_LIMITS 0.00 511.9922
 /begin AXIS_DESCR STD_AXIS ExhMgT_tEngCatHeatgFild Temp_Cels 8 -3549.940 3003.560 FORMAT "%8.3" DEPOSIT ABSOLUTE /end AXIS_DESCR
 /begin AXIS_DESCR STD_AXIS PEnv_facCorrAlti fak_uw_b4 4 0.00 3.999939 FORMAT "%8.6" DEPOSIT ABSOLUTE /end AXIS_DESCR
/end CHARACTERISTIC
/begin CHARACTERISTIC ExhMgT_facEtaEngCatHeatg_T "map for correction of weighting factor during catalyst heating" CURVE 0x8056DD00 RB_Curve_S16_U8_Static 1.992 fak_q0p00781 0.00 1.992 FORMAT "%5.3"
 /begin AXIS_DESCR STD_AXIS ExhMgT_tCat1Seln1 Temp_Cels 6 -3549.940 3003.560 FORMAT "%8.3" DEPOSIT ABSOLUTE /end AXIS_DESCR
/end CHARACTERISTIC
/begin CHARACTERISTIC ExhMgT_facEtaEngLoVlvLftAltiT_M "weighing factor for desired engine efficiency for catalyst heating in case of a cold start cold engine in dependence on altitude and engine start temperature" MAP 0x8056DD14 RB_Map_S16U16_U16 1.992188 fak_ub_b2 0.00 1.992188 FORMAT "%8.6" EXTENDED_LIMITS 0.00 511.9922
 /begin AXIS_DESCR STD_AXIS ExhMgT_tEngCatHeatgFild Temp_Cels 8 -3549.940 3003.560 FORMAT "%8.3" DEPOSIT ABSOLUTE /end AXIS_DESCR
 /begin AXIS_DESCR STD_AXIS PEnv_facCorrAlti fak_uw_b4 4 0.00 3.999939 FORMAT "%8.6" DEPOSIT ABSOLUTE /end AXIS_DESCR
/end CHARACTERISTIC
/begin CHARACTERISTIC ExhMgT_facEtaEngLoVlvLftFfv_M "map for desired engine efficiency for catalyst heating in case of cold start by idle for low valve lift and driving state condition (second fuel, for instance CNG or FFV)" MAP 0x8056DD70 RB_Map_S16U16_U16 1.992188 fak_ub_b2 0.00 1.992188 FORMAT "%8.6" EXTENDED_LIMITS 0.00 511.9922
 /begin AXIS_DESCR STD_AXIS ExhMgT_tEngCatHeatgFild Temp_Cels 8 -3549.940 3003.560 FORMAT "%8.3" DEPOSIT ABSOLUTE /end AXIS_DESCR
 /begin AXIS_DESCR STD_AXIS PEnv_facCorrAlti fak_uw_b4 4 0.00 3.999939 FORMAT "%8.6" DEPOSIT ABSOLUTE /end AXIS_DESCR
/end CHARACTERISTIC
/begin CHARACTERISTIC ExhMgT_facTEngCatHeatgFilTn_T "time constant for filtering of the engine temperature in dependance of the rate of change of engine temperature" CURVE 0x8056DDCC RB_Curve_U16_U16 655.3400 t_q0p01 0.0100 655.3500 FORMAT "%8.4" EXTENDED_LIMITS 0.00 655.3500
 /begin AXIS_DESCR STD_AXIS ExhMgT_tEngCatHeatgDif temp_q0p1_K 4 0.00 6553.500 FORMAT "%8.3" DEPOSIT ABSOLUTE /end AXIS_DESCR
/end CHARACTERISTIC
/begin CHARACTERISTIC ExhMgT_facTrqInrMaxDesCorrn_C "factor for correction of allowed max. torque of combustion engine during catalyst heating" VALUE 0x8056D414 RB_Val_Wu16 1.999969 fak_uw_b2 0.00 1.999969 FORMAT "%8.6" /end CHARACTERISTIC
/begin CHARACTERISTIC ExhMgT_facTrqInrMinDesCorrn_C "factor for correction of allowed min. torque of combustion engine during catalyst heating" VALUE 0x8056D416 RB_Val_Wu16 1.999969 fak_uw_b2 0.00 1.999969 FORMAT "%8.6" /end CHARACTERISTIC
/begin CHARACTERISTIC ExhMgT_facWghCatWrmLimMax_C "maximum limitation of the weighting factor for catalyst warming" VALUE 0x8056DDDE RB_Val_Ws16 1.999939 fak_sw_b2 0.00 1.999939 FORMAT "%8.6" EXTENDED_LIMITS -2.000000 1.999939 /end CHARACTERISTIC
/begin CHARACTERISTIC ExhMgT_facWghCatWrmLimMin_C "minimum limitation of the weighting factor for catalyst warming" VALUE 0x8056DDE0 RB_Val_Ws16 2.000000 fak_sw_b2 -2.000000 0.00 FORMAT "%8.6" EXTENDED_LIMITS -2.000000 1.999939 /end CHARACTERISTIC
/begin CHARACTERISTIC ExhMgt_facWghDesEngEffAlti_T "weighting factor for desired engine efficiency for catalyst heating by cold engine in dependence of altitude correction factor" CURVE 0x8056DDE2 RB_Curve_U16_U8_Static 1.992188 fak_ub_b2 0.00 1.992188 FORMAT "%8.6"
 /begin AXIS_DESCR STD_AXIS PEnv_facCorrAlti fak_uw_b4 8 0.00 3.999939 FORMAT "%8.6" DEPOSIT ABSOLUTE /end AXIS_DESCR
/end CHARACTERISTIC
/begin CHARACTERISTIC ExhMgT_iaCatHeatgVlvLftDrvgSt_M "map for desired ignition timing for catalyst heating in case of cold start by idle for valve lift and driving state condition" MAP 0x8056DDFC RB_MapGroup_S16 191.9971 zw_q2p9297Em3_deg_KW -96.00000 95.99707 FORMAT "%8.5"
 /begin AXIS_DESCR COM_AXIS NO_INPUT_QUANTITY rel_uw_b100 8 0.00 99.99847 FORMAT "%8.5" AXIS_PTS_REF SMG08KHNGUW /end AXIS_DESCR
 /begin AXIS_DESCR COM_AXIS NO_INPUT_QUANTITY EngN 8 -16384.00 16383.50 FORMAT "%8.2" AXIS_PTS_REF SNM08KHUW /end AXIS_DESCR
/end CHARACTERISTIC
/begin CHARACTERISTIC ExhMgT_iaCatWrmIdleGearEngd_GM "map for desired ignition-timing for catalyst warming in idle with engaged gear" MAP 0x8056DE7C RB_MapGroup_S16 191.9971 zw_q2p9297Em3_deg_KW -96.00000 95.99707 FORMAT "%8.5"
 /begin AXIS_DESCR COM_AXIS NO_INPUT_QUANTITY rel_uw_b100 13 0.00 99.99847 FORMAT "%8.5" AXIS_PTS_REF SMG13KHUW /end AXIS_DESCR
 /begin AXIS_DESCR COM_AXIS Epm_nEng EngN 12 -16384.00 16383.50 FORMAT "%8.2" AXIS_PTS_REF SNM12KHUW /end AXIS_DESCR
/end CHARACTERISTIC
/begin CHARACTERISTIC ExhMgT_iaCatWrmIdle_GM "map for desired ignition-timing for catalyst warming in idle" MAP 0x8056DFB4 RB_MapGroup_S16 191.9971 zw_q2p9297Em3_deg_KW -96.00000 95.99707 FORMAT "%8.5"
 /begin AXIS_DESCR COM_AXIS NO_INPUT_QUANTITY rel_uw_b100 13 0.00 99.99847 FORMAT "%8.5" AXIS_PTS_REF SMG13KHUW /end AXIS_DESCR
 /begin AXIS_DESCR COM_AXIS Epm_nEng EngN 12 -16384.00 16383.50 FORMAT "%8.2" AXIS_PTS_REF SNM12KHUW /end AXIS_DESCR
/end CHARACTERISTIC
/begin CHARACTERISTIC ExhMgT_iaCatWrmPartLoad_GM "map for desired ignition-timing for catalyst warming during part load" MAP 0x8056E0EC RB_MapGroup_S16 191.9971 zw_q2p9297Em3_deg_KW -96.00000 95.99707 FORMAT "%8.5"
 /begin AXIS_DESCR COM_AXIS NO_INPUT_QUANTITY rel_uw_b100 13 0.00 99.99847 FORMAT "%8.5" AXIS_PTS_REF SMG13KHUW /end AXIS_DESCR
 /begin AXIS_DESCR COM_AXIS Epm_nEng EngN 12 -16384.00 16383.50 FORMAT "%8.2" AXIS_PTS_REF SNM12KHUW /end AXIS_DESCR
/end CHARACTERISTIC
/begin CHARACTERISTIC ExhMgT_nMaxDesCatWrm_T "max. engine speed for catalyst heating (catalyst warming) in dependence of catalyst temperature" CURVE 0x8056D418 RB_Curve_U16_S16_Static 32767.50 EngN -16384.00 16383.50 FORMAT "%8.2"
 /begin AXIS_DESCR STD_AXIS ExhMgT_facCatWrmSeln fak_uw_b2 6 0.00 1.999969 FORMAT "%8.6" DEPOSIT ABSOLUTE /end AXIS_DESCR
/end CHARACTERISTIC
/begin CHARACTERISTIC ExhMgT_nMaxDesRatAirM_T "max. engine speed for catalyst heating (during cold start) in dependence of relative heating progress" CURVE 0x8056D432 RB_Curve_U16_S16_Static 32767.50 EngN -16384.00 16383.50 FORMAT "%8.2"
 /begin AXIS_DESCR STD_AXIS ExhMgT_facCatHeatgProgsTqDes fak_uw_b1 6 0.00 0.9999847 FORMAT "%9.7" DEPOSIT ABSOLUTE /end AXIS_DESCR
/end CHARACTERISTIC
/begin CHARACTERISTIC ExhMgT_nMinDesCatWrm_T "min. desired torque for catalyst heating (catalyst warming) in dependence of catalyst temperature" CURVE 0x8056D44C RB_Curve_U16_S16_Static 32767.50 EngN -16384.00 16383.50 FORMAT "%8.2"
 /begin AXIS_DESCR STD_AXIS ExhMgT_facCatWrmSeln fak_uw_b2 6 0.00 1.999969 FORMAT "%8.6" DEPOSIT ABSOLUTE /end AXIS_DESCR
/end CHARACTERISTIC
/begin CHARACTERISTIC ExhMgT_nMinDesRatAirM_T "min. engine speed for catalyst heating (during electric start with cold engine) in dependence of relative heating progress" CURVE 0x8056D466 RB_Curve_U16_S16_Static 32767.50 EngN -16384.00 16383.50 FORMAT "%8.2"
 /begin AXIS_DESCR STD_AXIS ExhMgT_facCatHeatgProgsTqDes fak_uw_b1 6 0.00 0.9999847 FORMAT "%9.7" DEPOSIT ABSOLUTE /end AXIS_DESCR
/end CHARACTERISTIC
/begin CHARACTERISTIC ExhMgT_stCatHeatgLoadPntShift_C "status word for activation of function features" VALUE 0x8056D480 RB_Val_Wu16 65535.00 dez 0.00 65535.00 FORMAT "%8.2" /end CHARACTERISTIC
/begin CHARACTERISTIC ExhMgT_stEtaCatHeatg_C "codeword for efficiency worsening during catalyst heating" VALUE 0x8056E224 RB_Val_Wu16 65535.00 dez 0.00 65535.00 FORMAT "%8.2" /end CHARACTERISTIC
/begin CHARACTERISTIC ExhMgT_stOperModCatHeatProgs_M "map for request of a operation state of the power train to the hybrid coordinator for catalyst heating because of a coldstart in dependence of catalyst heating progress" MAP 0x8056D482 RB_Map_U16S16_U16 65535.00 dez 0.00 65535.00 FORMAT "%8.2"
 /begin AXIS_DESCR STD_AXIS ExhMgT_facCatHeatgProgsTqDes fak_uw_b1 6 0.00 0.9999847 FORMAT "%9.7" DEPOSIT ABSOLUTE /end AXIS_DESCR
 /begin AXIS_DESCR STD_AXIS ExhMgT_trqInrDes Trq 4 -3276.800 3276.700 FORMAT "%8.3" DEPOSIT ABSOLUTE /end AXIS_DESCR
/end CHARACTERISTIC
/begin CHARACTERISTIC ExhMgT_stOperModCatWrm_M "map for request of a operation state of the power train to the hybrid coordinator for catalyst heating because of catalyst warming" MAP 0x8056D4CA RB_Map_U16S16_U16 65535.00 dez 0.00 65535.00 FORMAT "%8.2"
 /begin AXIS_DESCR STD_AXIS ExhMgT_facCatWrmSeln fak_uw_b2 6 0.00 1.999969 FORMAT "%8.6" DEPOSIT ABSOLUTE /end AXIS_DESCR
 /begin AXIS_DESCR STD_AXIS ExhMgT_trqInrDes Trq 4 -3276.800 3276.700 FORMAT "%8.3" DEPOSIT ABSOLUTE /end AXIS_DESCR
/end CHARACTERISTIC
/begin CHARACTERISTIC ExhMgT_stOperModDmdWrmUpOff_C "request of an operation state of the power train to the hybrid coordinator (after regular catalyst heating)" VALUE 0x8056D512 RB_Val_Wu16 65535.00 dez 0.00 65535.00 FORMAT "%8.2" /end CHARACTERISTIC
/begin CHARACTERISTIC ExhMgT_stOperModDmdWrmUpOn_C "request of an operation state of the power train to the hybrid coordinator (after regular catalyst heating)" VALUE 0x8056D514 RB_Val_Wu16 65535.00 dez 0.00 65535.00 FORMAT "%8.2" /end CHARACTERISTIC
/begin CHARACTERISTIC ExhMgT_stOperModNoStopCatHeatg_C "request of a operation state of the power train to the hybrid coordinator" VALUE 0x8056D516 RB_Val_Wu16 65535.00 dez 0.00 65535.00 FORMAT "%8.2" /end CHARACTERISTIC
/begin CHARACTERISTIC ExhMgT_stWpDmdPrioColdHeatg_C "priority value of the operation condition for catalyst heating because of cold start" VALUE 0x8056D518 RB_Val_Wu8 255.0 dez 0.00 255.0 FORMAT "%5.1" /end CHARACTERISTIC
/begin CHARACTERISTIC ExhMgT_stWpDmdPrioNoStopCatHeatg_C "request for operation point after regular catalyst heating" VALUE 0x8056D519 RB_Val_Wu8 255.0 dez 0.00 255.0 FORMAT "%5.1" /end CHARACTERISTIC
/begin CHARACTERISTIC ExhMgT_stWpDmdPrioWrmHeatg1_C "priority 1 value of the operation condition for catalyst heating because of catalyst warming" VALUE 0x8056D51A RB_Val_Wu8 255.0 dez 0.00 255.0 FORMAT "%5.1" /end CHARACTERISTIC
/begin CHARACTERISTIC ExhMgT_stWpDmdPrioWrmHeatg2_C "priority 2 value of the operation condition for catalyst heating because of catalyst warming" VALUE 0x8056D51B RB_Val_Wu8 255.0 dez 0.00 255.0 FORMAT "%5.1" /end CHARACTERISTIC
/begin CHARACTERISTIC ExhMgT_stWpDmdPrioWrmUpOff_C "request for operation point for catalyst warming at the end of falling torque rate" VALUE 0x8056D51C RB_Val_Wu8 255.0 dez 0.00 255.0 FORMAT "%5.1" /end CHARACTERISTIC
/begin CHARACTERISTIC ExhMgT_stWpDmdPrioWrmUp_C "request for operation point for heating of catalyst (after regular catalyst heating)" VALUE 0x8056D51D RB_Val_Wu8 255.0 dez 0.00 255.0 FORMAT "%5.1" /end CHARACTERISTIC
/begin CHARACTERISTIC ExhMgT_tDeltaEngWrmUpMax_C "hysteresis for maximal engine temperature till the condition ExhMgT_flgColdHeatgFinshd can be set" VALUE 0x8056D51E RB_Val_Ws16 6553.500 temp_q0p1_K -3276.800 3276.700 FORMAT "%8.3" /end CHARACTERISTIC
/begin CHARACTERISTIC ExhMgT_tDeltaOelWrmUpMax_C "hysteresis for maximal oil temperature till the condition ExhMgT_flgColdHeatgFinshd can be set" VALUE 0x8056D520 RB_Val_Ws16 6553.500 temp_q0p1_K -3276.800 3276.700 FORMAT "%8.3" /end CHARACTERISTIC
/begin CHARACTERISTIC ExhMgT_tEngWrmUpMax_C "maximal engine temperature till the condition cold start catalyst heating is finished" VALUE 0x8056D522 RB_Val_Ws16 6553.500 Temp_Cels -3549.940 3003.560 FORMAT "%8.3" /end CHARACTERISTIC
/begin CHARACTERISTIC ExhMgt_tiCatHeatgIdle_C "time from idle to partload" VALUE 0x8056E226 RB_Val_Wu16 655.34999985 zk10msxs_uw_b655p36 0.01000015 655.36000000 FORMAT "%12.8" EXTENDED_LIMITS 0.010000152590 655.36000000 /end CHARACTERISTIC
/begin CHARACTERISTIC ExhMgt_tiCatHeatgPartLoad_C "time for transition to partload" VALUE 0x8056E228 RB_Val_Wu16 655.34999985 zk10msxs_uw_b655p36 0.01000015 655.36000000 FORMAT "%12.8" EXTENDED_LIMITS 0.010000152590 655.36000000 /end CHARACTERISTIC
/begin CHARACTERISTIC ExhMgT_tiColdHeatgOff_C "time delay for consideration of reset of condition for catalyst heating" VALUE 0x8056D524 RB_Val_Wu16 6553.500 t_q0p1 0.00 6553.500 FORMAT "%8.3" /end CHARACTERISTIC
/begin CHARACTERISTIC ExhMgT_tiEtaCatWrmFild_C "time delay for filtering of desired engine efficiency for catalyst warming" VALUE 0x8056E22A RB_Val_Wu16 655.34999985 zk10msxs_uw_b655p36 0.01000015 655.36000000 FORMAT "%12.8" EXTENDED_LIMITS 0.010000152590 655.36000000 /end CHARACTERISTIC
/begin CHARACTERISTIC ExhMgT_tiTrqInrMaxDesWrmUpOff_C "time threshold for switch over of maximal desired torque for heating of catalyst (after regular catalyst heating)" VALUE 0x8056D526 RB_Val_Wu16 6553.500 t100msxs_uw_b6553p5 0.00 6553.500 FORMAT "%8.3" /end CHARACTERISTIC
/begin CHARACTERISTIC ExhMgT_tOelWrmUpMax_C "maximal oil temperature till the condition cold start catalyst heating is finished" VALUE 0x8056D528 RB_Val_Ws16 6553.500 Temp_Cels -3549.940 3003.560 FORMAT "%8.3" /end CHARACTERISTIC
/begin CHARACTERISTIC ExhMgT_tqMaxDesCatWrmIdleLoad_T "Calibration to determine maximum desired torque for catalyst heating (catalyst warming) in dependence of catalyst temperature by idle load" CURVE 0x8056D52A RB_Curve_U16_U16 99.99847 rel_uw_b100 0.00 99.99847 FORMAT "%8.5"
 /begin AXIS_DESCR STD_AXIS ExhMgT_facCatWrmSeln fak_uw_b2 6 0.00 1.999969 FORMAT "%8.6" DEPOSIT ABSOLUTE /end AXIS_DESCR
/end CHARACTERISTIC
/begin CHARACTERISTIC ExhMgT_tqMaxDesCatWrmPtlLoad_T "Calibration to determine maximum desired torque for catalyst heating (catalyst warming) in dependence of catalyst temperature by part load" CURVE 0x8056D544 RB_Curve_U16_U16 99.99847 rel_uw_b100 0.00 99.99847 FORMAT "%8.5"
 /begin AXIS_DESCR STD_AXIS ExhMgT_facCatWrmSeln fak_uw_b2 6 0.00 1.999969 FORMAT "%8.6" DEPOSIT ABSOLUTE /end AXIS_DESCR
/end CHARACTERISTIC
/begin CHARACTERISTIC ExhMgT_tqMinDesCatWrmIdleLoad_T "Calibration to determine minimum desired torque for catalyst heating (catalyst warming) in dependence of catalyst temperature by idle load" CURVE 0x8056D55E RB_Curve_U16_U16 99.99847 rel_uw_b100 0.00 99.99847 FORMAT "%8.5"
 /begin AXIS_DESCR STD_AXIS ExhMgT_facCatWrmSeln fak_uw_b2 6 0.00 1.999969 FORMAT "%8.6" DEPOSIT ABSOLUTE /end AXIS_DESCR
/end CHARACTERISTIC
/begin CHARACTERISTIC ExhMgT_tqMinDesCatWrmPtlLoad_T "Calibration to determine minimum desired torque for catalyst heating (catalyst warming) in dependence of catalyst temperature by part load" CURVE 0x8056D578 RB_Curve_U16_U16 99.99847 rel_uw_b100 0.00 99.99847 FORMAT "%8.5"
 /begin AXIS_DESCR STD_AXIS ExhMgT_facCatWrmSeln fak_uw_b2 6 0.00 1.999969 FORMAT "%8.6" DEPOSIT ABSOLUTE /end AXIS_DESCR
/end CHARACTERISTIC
/begin CHARACTERISTIC ExhMgT_trqInrMaxDesWrmUpMax_C "maximal change of maximal desired torque for heating of catalyst (after regular catalyst heating) per calculation step" VALUE 0x8056D592 RB_Val_Ws16 6553.500 trq_q0p1 -3276.800 3276.700 FORMAT "%8.3" /end CHARACTERISTIC
/begin CHARACTERISTIC ExhMgT_trqInrMaxDesWrmUpMin_C "minimal change of maximal desired torque for heating of catalyst (after regular catalyst heating) per calculation step" VALUE 0x8056D594 RB_Val_Ws16 6553.500 trq_q0p1 -3276.800 3276.700 FORMAT "%8.3" /end CHARACTERISTIC
/begin CHARACTERISTIC ExhMgT_trqInrMaxDesWrmUpOff_C "maximal desired torque for heating of catalyst (after regular catalyst heating) after exceeding a time threshold" VALUE 0x8056D596 RB_Val_Ws16 6553.500 trq_q0p1 -3276.800 3276.700 FORMAT "%8.3" /end CHARACTERISTIC
/begin CHARACTERISTIC ExhMgT_trqInrMaxDesWrmUp_T "curve for maximal desired torque for heating of catalyst (after regular catalyst heating)" CURVE 0x8056D598 RB_Curve_S16_S16 6553.500 trq_q0p1 -3276.800 3276.700 FORMAT "%8.3"
 /begin AXIS_DESCR STD_AXIS ExhMgT_tWarmUpSeln Temp_Cels 6 -3549.940 3003.560 FORMAT "%8.3" DEPOSIT ABSOLUTE /end AXIS_DESCR
/end CHARACTERISTIC
/begin CHARACTERISTIC ExhMgT_trqInrMinDesWrmUp_C "minimal desired torque for heating of catalyst (after regular catalyst heating)" VALUE 0x8056D5B2 RB_Val_Ws16 6553.500 trq_q0p1 -3276.800 3276.700 FORMAT "%8.3" /end CHARACTERISTIC
/begin CHARACTERISTIC ExhMgT_tStrtCorrnEffMin_C "minimal engine start temperature for release of consideration for correction of required worsening of engine efficiency for cold start catalyst heating in dependence of oil temperature and catalyst heat progress" VALUE 0x8056E22C RB_Val_Ws16 6553.500 Temp_Cels -3549.940 3003.560 FORMAT "%8.3" /end CHARACTERISTIC
/begin CHARACTERISTIC FETAKHKTKO "factor for reducing engine efficiency of catalyst heating in case of a cold start idue to active climate compressor" VALUE 0x8056E22E RB_Val_Wu8 1.187500 fak_ub_b2 0.804688 1.992188 FORMAT "%8.6" EXTENDED_LIMITS 0.00 1.992188 /end CHARACTERISTIC
/begin CHARACTERISTIC FETAKHLLAP "parameter for adaption of nominal engine efficiency for demonstration of a fault by idle" VALUE 0x8056E22F RB_Val_Wu8 1.992188 fak_ub_b2 0.00 1.992188 FORMAT "%8.6" /end CHARACTERISTIC
/begin CHARACTERISTIC FETAKHTLAP "parameter for adaption of nominal engine efficiency for demonstration of a fault by part load" VALUE 0x8056E230 RB_Val_Wu8 1.992188 fak_ub_b2 0.00 1.992188 FORMAT "%8.6" /end CHARACTERISTIC
/begin CHARACTERISTIC FGANGMDMN "weighting factor for correction of a desired min. torque window in dependency of engaged gear" CURVE 0x8056D5B4 RB_Curve_S8_U8_Static 3.984 fak_q0p015625 0.00 3.984 FORMAT "%5.3"
 /begin AXIS_DESCR STD_AXIS gangsist_msg dez 10 -128.0 127.0 FORMAT "%5.1" DEPOSIT ABSOLUTE /end AXIS_DESCR
/end CHARACTERISTIC
/begin CHARACTERISTIC FGANGMDMX "weighting factor for correction of a desired max. torque window in dependency of engaged gear" CURVE 0x8056D5CA RB_Curve_S8_U8_Static 3.984 fak_q0p015625 0.00 3.984 FORMAT "%5.3"
 /begin AXIS_DESCR STD_AXIS gangsist_msg dez 10 -128.0 127.0 FORMAT "%5.1" DEPOSIT ABSOLUTE /end AXIS_DESCR
/end CHARACTERISTIC
/begin CHARACTERISTIC HYANFKWPR "hysteresis value for request of a priority for catalyst heating" VALUE 0x8056D5E0 RB_Val_Wu16 1.999969 fak_uw_b2 0.00 1.999969 FORMAT "%8.6" /end CHARACTERISTIC
/begin AXIS_PTS InjSys_vcosCvo_Ax "CVO fuel viscosity group points" 0x8055850E InjSys_vcosPntCvo RB_Axis_U16 3.276750 RBPtCel_vcos_5p0em5_1 6 0.00 3.276750 FORMAT "%8.6" DEPOSIT ABSOLUTE /end AXIS_PTS
/begin CHARACTERISTIC IVGdiCtl_cntrCvoDiagDeltaTiErrCntLimBall_C "Fault count limit: overrun total dti in the ballistic area" VALUE 0x8055797C RB_Val_Wu8 254.0 dez 1.0 255.0 FORMAT "%5.1" EXTENDED_LIMITS 0.00 255.0 /end CHARACTERISTIC
/begin CHARACTERISTIC IVGdiCtl_cntrCvoDiagDeltaTiErrCntLimFull_C "Fault count limit: overrun of total dti in the full lift" VALUE 0x8055797D RB_Val_Wu8 254.0 dez 1.0 255.0 FORMAT "%5.1" EXTENDED_LIMITS 0.00 255.0 /end CHARACTERISTIC
/begin CHARACTERISTIC IVGdiCtl_cntrCvoDiagDeltaTiHealCntLimBall_C "Heal count limit: overrun total dti in the ballistic area" VALUE 0x8055797E RB_Val_Wu8 254.0 dez 1.0 255.0 FORMAT "%5.1" EXTENDED_LIMITS 0.00 255.0 /end CHARACTERISTIC
/begin CHARACTERISTIC IVGdiCtl_cntrCvoDiagDeltaTiHealCntLimFull_C "Heal count limit: overrun of total dti in the full lift" VALUE 0x8055797F RB_Val_Wu8 254.0 dez 1.0 255.0 FORMAT "%5.1" EXTENDED_LIMITS 0.00 255.0 /end CHARACTERISTIC
/begin CHARACTERISTIC IVGdiCtl_cntrCvoDiagErrCntLimCvoVlvTiDly_C "Fault count limit: measured tantot outside tolerance range to default tantot" VALUE 0x80557980 RB_Val_Wu8 254.0 dez 1.0 255.0 FORMAT "%5.1" EXTENDED_LIMITS 0.00 255.0 /end CHARACTERISTIC
/begin CHARACTERISTIC IVGdiCtl_cntrCvoDiagErrCntLimDeltaTiOpen_C "Fault count limit: measured plateau outside tolerance range" VALUE 0x80557981 RB_Val_Wu8 254.0 dez 1.0 255.0 FORMAT "%5.1" EXTENDED_LIMITS 0.00 255.0 /end CHARACTERISTIC
/begin CHARACTERISTIC IVGdiCtl_cntrCvoDiagErrLimNoTab_C "Fault count limit: no tab found" VALUE 0x80557982 RB_Val_Wu8 254.0 dez 1.0 255.0 FORMAT "%5.1" EXTENDED_LIMITS 0.00 255.0 /end CHARACTERISTIC
/begin CHARACTERISTIC IVGdiCtl_cntrCvoDiagFullTestBallInj_C "counter of fulllift injection to activate ballistiv test injection" VALUE 0x80557984 RB_Val_Wu16 65534.00 dez 1.00 65535.00 FORMAT "%8.2" EXTENDED_LIMITS 0.00 65535.00 /end CHARACTERISTIC
/begin CHARACTERISTIC IVGdiCtl_cntrCvoDiagHealLimNoTab_C "Heal count limit: no tab found" VALUE 0x80557986 RB_Val_Wu8 254.0 dez 1.0 255.0 FORMAT "%5.1" EXTENDED_LIMITS 0.00 255.0 /end CHARACTERISTIC
/begin CHARACTERISTIC IVGdiCtl_cntrCvoDiagInjSmrCdnBall_C "number of ballistic injections in similar conditions to heal DFCs" VALUE 0x80557988 RB_Val_Wu16 65535.00 dez 0.00 65535.00 FORMAT "%8.2" /end CHARACTERISTIC
/begin CHARACTERISTIC IVGdiCtl_cntrCvoDiagInjSmrCdnFull_C "number of full-Lift injections in similar conditions to heal DFCs" VALUE 0x8055798A RB_Val_Wu16 65535.00 dez 0.00 65535.00 FORMAT "%8.2" /end CHARACTERISTIC
/begin CHARACTERISTIC IVGdiCtl_cntrCvoDiagSigEvlnErr_C "counter of errors for detection a signal evaluation error" VALUE 0x8055798C RB_Val_Wu16 65534.00 dez 1.00 65535.00 FORMAT "%8.2" EXTENDED_LIMITS 0.00 65535.00 /end CHARACTERISTIC
/begin CHARACTERISTIC IVGdiCtl_cntrCvoDiagSigEvlnHeal_C "counter for correct signal evaluation for healing the error" VALUE 0x8055798E RB_Val_Wu16 65534.00 dez 1.00 65535.00 FORMAT "%8.2" EXTENDED_LIMITS 0.00 65535.00 /end CHARACTERISTIC
/begin CHARACTERISTIC IVGdiCtl_cntrCvoDiagSigEvlnMilOff_C "Counter for correct signal evaluation to switch off the Mil" VALUE 0x80557990 RB_Val_Wu8 255.0 dez 0.00 255.0 FORMAT "%5.1" /end CHARACTERISTIC
/begin CHARACTERISTIC IVGdiCtl_cntrCvoDiagSigEvlnMilOn_C "Counter for not correct signal evaluation to switch on the Mil" VALUE 0x80557991 RB_Val_Wu8 255.0 dez 0.00 255.0 FORMAT "%5.1" /end CHARACTERISTIC
/begin CHARACTERISTIC IVGdiCtl_cntrCvoDiagVlvClsTiErrCntLim_C "Fault count limit: tab outside tolerance range" VALUE 0x80557992 RB_Val_Wu8 254.0 dez 1.0 255.0 FORMAT "%5.1" EXTENDED_LIMITS 0.00 255.0 /end CHARACTERISTIC
/begin CHARACTERISTIC IVGdiCtl_cntrNewBaseAdpnByPhy_C "Number of maximal allowed base adpation" VALUE 0x80557993 RB_Val_Wu8 255.0 OneToOne 0.00 255.0 FORMAT "%5.1" /end CHARACTERISTIC
/begin CHARACTERISTIC IVGdiCtl_CvoDiag_deltaTiLimNeg_CA "Min threshold delta ti in full lift or transition area" CURVE 0x80557994 RB_Curve_U8_S16_Static 6553.500 t_q0p1_us -3276.800 3276.700 FORMAT "%8.3"
 /begin AXIS_DESCR STD_AXIS IVGdiCtl_nrCvoDiagPls dez 2 0.00 255.0 FORMAT "%5.1" DEPOSIT ABSOLUTE /end AXIS_DESCR
/end CHARACTERISTIC
/begin CHARACTERISTIC IVGdiCtl_CvoDiag_deltaTiLimPos_CA "Max threshold delta ti in full lift or transition area" CURVE 0x8055799C RB_Curve_U8_S16_Static 6553.500 t_q0p1_us -3276.800 3276.700 FORMAT "%8.3"
 /begin AXIS_DESCR STD_AXIS IVGdiCtl_nrCvoDiagPls dez 2 0.00 255.0 FORMAT "%5.1" DEPOSIT ABSOLUTE /end AXIS_DESCR
/end CHARACTERISTIC
/begin CHARACTERISTIC IVGdiCtl_CvoDiag_TiOpenUpprBal_C "Threshold of ti open time, from this to apply for a upper ballitic area." VALUE 0x805579A4 RB_Val_Wu16 65535.00 t_q1p0_us 0.00 65535.00 FORMAT "%8.2" /end CHARACTERISTIC
/begin CHARACTERISTIC IVGdiCtl_CvoDiag_tiVcosDeltaLimNegUpprBal_CA "Min threshold delta ti base on viscocity in upper ballistic area" CURVE 0x805579A6 RB_CurveGroup_S16 6553.500 t_q0p1_us -3276.800 3276.700 FORMAT "%8.3"
 /begin AXIS_DESCR COM_AXIS InjSys_vcosPntCvo RBPtCel_vcos_5p0em5_1 6 0.00 3.276750 FORMAT "%8.6" AXIS_PTS_REF InjSys_vcosCvo_Ax /end AXIS_DESCR
/end CHARACTERISTIC
/begin CHARACTERISTIC IVGdiCtl_CvoDiag_tiVcosDeltaLimNeg_CA "Min vicosity specific threshold table of delta ti" CURVE 0x805579B2 RB_CurveGroup_S16 6553.500 t_q0p1_us -3276.800 3276.700 FORMAT "%8.3"
 /begin AXIS_DESCR COM_AXIS InjSys_vcosPntCvo RBPtCel_vcos_5p0em5_1 6 0.00 3.276750 FORMAT "%8.6" AXIS_PTS_REF InjSys_vcosCvo_Ax /end AXIS_DESCR
/end CHARACTERISTIC
/begin CHARACTERISTIC IVGdiCtl_CvoDiag_tiVcosDeltaLimPosUpprBal_CA "Max threshold delta ti base on viscocity in upper ballistic area" CURVE 0x805579BE RB_CurveGroup_S16 6553.500 t_q0p1_us -3276.800 3276.700 FORMAT "%8.3"
 /begin AXIS_DESCR COM_AXIS InjSys_vcosPntCvo RBPtCel_vcos_5p0em5_1 6 0.00 3.276750 FORMAT "%8.6" AXIS_PTS_REF InjSys_vcosCvo_Ax /end AXIS_DESCR
/end CHARACTERISTIC
/begin CHARACTERISTIC IVGdiCtl_CvoDiag_tiVcosDeltaLimPos_CA "Max vicosity specific threshold table of delta ti in ballistic area" CURVE 0x805579CA RB_CurveGroup_S16 6553.500 t_q0p1_us -3276.800 3276.700 FORMAT "%8.3"
 /begin AXIS_DESCR COM_AXIS InjSys_vcosPntCvo RBPtCel_vcos_5p0em5_1 6 0.00 3.276750 FORMAT "%8.6" AXIS_PTS_REF InjSys_vcosCvo_Ax /end AXIS_DESCR
/end CHARACTERISTIC
/begin CHARACTERISTIC IVGdiCtl_CvoDiag_tiVcosNegTolrDftCvoVlvDly_CA "Min viscosity specific threshold table of tanto" CURVE 0x805579D6 RB_CurveGroup_S16 6553.500 t_q0p1_us -3276.800 3276.700 FORMAT "%8.3"
 /begin AXIS_DESCR COM_AXIS InjSys_vcosPntCvo RBPtCel_vcos_5p0em5_1 6 0.00 3.276750 FORMAT "%8.6" AXIS_PTS_REF InjSys_vcosCvo_Ax /end AXIS_DESCR
/end CHARACTERISTIC
/begin CHARACTERISTIC IVGdiCtl_CvoDiag_tiVcosPosTolrDftCvoVlvDly_CA "Max viscosity specific threshold table of tanto" CURVE 0x805579E2 RB_CurveGroup_S16 6553.500 t_q0p1_us -3276.800 3276.700 FORMAT "%8.3"
 /begin AXIS_DESCR COM_AXIS InjSys_vcosPntCvo RBPtCel_vcos_5p0em5_1 6 0.00 3.276750 FORMAT "%8.6" AXIS_PTS_REF InjSys_vcosCvo_Ax /end AXIS_DESCR
/end CHARACTERISTIC
/begin CHARACTERISTIC IVGdiCtl_CvoSigAcq_measBufOffset_C "Offset applied to the measurement buffer, which holds the acquired values." VALUE 0x80506044 KwUw 65535.00 dez 0.00 65535.00 FORMAT "%8.2" /end CHARACTERISTIC
/begin CHARACTERISTIC IVGdiCtl_CvoSigEvln_cal11_C "CVO signal evaluation cal. label" VALUE 0x8058AB40 KwUb 255.0 dez 0.00 255.0 FORMAT "%5.1" /end CHARACTERISTIC
/begin CHARACTERISTIC IVGdiCtl_CvoSigEvln_cal13_C "CVO signal evaluation cal. label" VALUE 0x8058AB42 KwUw 6553.500 t_q0p1_us 0.00 6553.500 FORMAT "%8.3" /end CHARACTERISTIC
/begin CHARACTERISTIC IVGdiCtl_CvoSigEvln_cal14_C "CVO signal evaluation cal. label" VALUE 0x8058AB44 KwUw 6553.500 t_q0p1_us 0.00 6553.500 FORMAT "%8.3" /end CHARACTERISTIC
/begin CHARACTERISTIC IVGdiCtl_CvoSigEvln_cal15_C "CVO signal evaluation cal. label" VALUE 0x8058AB46 KwUb 255.0 dez 0.00 255.0 FORMAT "%5.1" /end CHARACTERISTIC
/begin CHARACTERISTIC IVGdiCtl_CvoSigEvln_cal16_C "CVO signal evaluation cal. label" VALUE 0x8058AB47 KwUb 30.00 dez 0.00 30.00 FORMAT "%5.2" EXTENDED_LIMITS 0.00 255.0 /end CHARACTERISTIC
/begin CHARACTERISTIC IVGdiCtl_CvoSigEvln_cal27_C "CVO signal evaluation cal. label" VALUE 0x8058AB48 KwUb 255.0 dez 0.00 255.0 FORMAT "%5.1" /end CHARACTERISTIC
/begin CHARACTERISTIC IVGdiCtl_CvoSigEvln_cal36_C "CVO signal evaluation cal. label" VALUE 0x8058AB49 KwUb 255.0 dez 0.00 255.0 FORMAT "%5.1" /end CHARACTERISTIC
/begin CHARACTERISTIC IVGdiCtl_CvoSigEvln_cal37_C "CVO signal evaluation cal. label" VALUE 0x8058AB4A KwUb 255.0 dez 0.00 255.0 FORMAT "%5.1" /end CHARACTERISTIC
/begin CHARACTERISTIC IVGdiCtl_CvoSigEvln_cal38_C "CVO signal evaluation cal. label" VALUE 0x8058AB4C KwSw 6553.500 t_q0p1_us -3276.800 3276.700 FORMAT "%8.3" /end CHARACTERISTIC
/begin CHARACTERISTIC IVGdiCtl_CvoSigEvln_cal39_C "CVO signal evaluation cal. label" VALUE 0x8058AB4E KwUw 6553.500 t_q0p1_us 0.00 6553.500 FORMAT "%8.3" /end CHARACTERISTIC
/begin CHARACTERISTIC IVGdiCtl_CvoSigEvln_cal46_C "CVO signal evaluation cal. label" VALUE 0x8058AB50 KwUw 6553.500 t_q0p1_us 0.00 6553.500 FORMAT "%8.3" /end CHARACTERISTIC
/begin CHARACTERISTIC IVGdiCtl_CvoSigEvln_cal47_C "CVO signal evaluation cal. label" VALUE 0x8058AB52 KwUw 6553.500 t_q0p1_us 0.00 6553.500 FORMAT "%8.3" /end CHARACTERISTIC
/begin CHARACTERISTIC IVGdiCtl_CvoSigEvln_cal55_C "CVO signal evaluation cal. label" VALUE 0x8058AB54 KwUb 255.0 dez 0.00 255.0 FORMAT "%5.1" /end CHARACTERISTIC
/begin CHARACTERISTIC IVGdiCtl_CvoSigEvln_cal56_C "CVO signal evaluation cal. label" VAL_BLK 0x8058AB55 KwbWU8 255.0 dez 0.00 255.0 FORMAT "%5.1" NUMBER 5 /end CHARACTERISTIC
/begin CHARACTERISTIC IVGdiCtl_CvoSigEvln_cal57_C "CVO signal evaluation cal. label" MAP 0x8058AB5A KfAxU8AyU8SstxU16SstyU16WS16 1.979980 fak_sw_b1 -0.9899902 0.9899902 FORMAT "%9.7" EXTENDED_LIMITS -1.000000 0.9999695
 /begin AXIS_DESCR STD_AXIS NO_INPUT_QUANTITY dez 11 0.00 65535.00 FORMAT "%8.2" DEPOSIT ABSOLUTE /end AXIS_DESCR
 /begin AXIS_DESCR STD_AXIS NO_INPUT_QUANTITY dez 5 0.00 65535.00 FORMAT "%8.2" DEPOSIT ABSOLUTE /end AXIS_DESCR
/end CHARACTERISTIC
/begin CHARACTERISTIC IVGdiCtl_CvoSigEvln_cal58_C "CVO signal evaluation cal. label" VALUE 0x8058ABEC KwUw 65535.00 dez 0.00 65535.00 FORMAT "%8.2" /end CHARACTERISTIC
/begin CHARACTERISTIC IVGdiCtl_CvoSigEvln_cal59_C "CVO signal evaluation cal. label" VALUE 0x8058ABEE KwUw 65535.00 dez 0.00 65535.00 FORMAT "%8.2" /end CHARACTERISTIC
/begin CHARACTERISTIC IVGdiCtl_CvoSigEvln_cal60_C "CVO signal evaluation cal. label" VALUE 0x8058ABF0 KwUw 65535.00 dez 0.00 65535.00 FORMAT "%8.2" /end CHARACTERISTIC
/begin CHARACTERISTIC IVGdiCtl_CvoSigEvln_cal64_C "CVO signal evaluation cal. label" VALUE 0x8058ABF2 KwSw 65535.00 dez -32768.00 32767.00 FORMAT "%8.2" /end CHARACTERISTIC
/begin CHARACTERISTIC IVGdiCtl_CvoSigEvln_cal65_C "CVO signal evaluation cal. label" VALUE 0x8058ABF4 KwWS32 131071.999969 fak_q3p0518Em5 -65536.0000000 65535.9999695 FORMAT "%13.7" /end CHARACTERISTIC
/begin CHARACTERISTIC IVGdiCtl_CvoSigEvln_cal66_C "CVO signal evaluation cal. label" VALUE 0x8058ABF8 KwWS32 131071.999969 fak_q3p0518Em5 -65536.0000000 65535.9999695 FORMAT "%13.7" /end CHARACTERISTIC
/begin CHARACTERISTIC IVGdiCtl_CvoSigEvln_cal67_C "CVO signal evaluation cal. label" VALUE 0x8058ABFC KwWS32 131071.999969 fak_q3p0518Em5 -65536.0000000 65535.9999695 FORMAT "%13.7" /end CHARACTERISTIC
/begin CHARACTERISTIC IVGdiCtl_CvoSigEvln_cal68_C "CVO signal evaluation cal. label" VALUE 0x8058AC00 KwWS32 131071.999969 fak_q3p0518Em5 -65536.0000000 65535.9999695 FORMAT "%13.7" /end CHARACTERISTIC
/begin CHARACTERISTIC IVGdiCtl_CvoSigEvln_cal69_C "CVO signal evaluation cal. label" VALUE 0x8058AC04 KwWS32 4294967295.00 dez -2147483648.00 2147483647.00 FORMAT "%13.2" /end CHARACTERISTIC
/begin CHARACTERISTIC IVGdiCtl_CvoSigEvln_cal70_C "CVO signal evaluation cal. label" VALUE 0x8058AC08 KwUb 255.0 dez 0.00 255.0 FORMAT "%5.1" /end CHARACTERISTIC
/begin CHARACTERISTIC IVGdiCtl_CvoSigEvln_cal71_C "CVO signal evaluation cal. label" VALUE 0x8058AC0A KwSw 1023.984 fak_q0p015625 -512.0000 511.9844 FORMAT "%8.4" /end CHARACTERISTIC
/begin CHARACTERISTIC IVGdiCtl_CvoSigEvln_cal72_C "CVO signal evaluation cal. label" VALUE 0x8058AC0C KwSw 65535.00 dez -32768.00 32767.00 FORMAT "%8.2" /end CHARACTERISTIC
/begin CHARACTERISTIC IVGdiCtl_CvoSigEvln_cal73_C "CVO signal evaluation cal. label" VALUE 0x8058AC0E KwUw 0.9999847 fak_uw_b1 0.00 0.9999847 FORMAT "%9.7" /end CHARACTERISTIC
/begin CHARACTERISTIC IVGdiCtl_CvoSigEvln_cal75_C "CVO signal evaluation cal. label" VALUE 0x8058AC10 KwUb 255.0 dez 0.00 255.0 FORMAT "%5.1" /end CHARACTERISTIC
/begin CHARACTERISTIC IVGdiCtl_CvoSigEvln_cal76_C "CVO signal evaluation cal. label" VALUE 0x8058AC11 KwUb 255.0 t_q1p0_us 0.00 255.0 FORMAT "%5.1" /end CHARACTERISTIC
/begin CHARACTERISTIC IVGdiCtl_CvoSigEvln_cal77_C "CVO signal evaluation cal. label" VALUE 0x8058AC12 KwSw 6553.500 t_q0p1_us -3276.800 3276.700 FORMAT "%8.3" /end CHARACTERISTIC
/begin CHARACTERISTIC IVGdiCtl_CvoSigEvln_cal78_C "CVO signal evaluation cal. label" VALUE 0x8058AC14 KwUb 255.0 dez 0.00 255.0 FORMAT "%5.1" /end CHARACTERISTIC
/begin CHARACTERISTIC IVGdiCtl_CvoSigEvln_cal79_C "CVO signal evaluation cal. label" VAL_BLK 0x8058AC16 KwbWS16 1.999969 fak_sw_b1 -1.000000 0.999969 FORMAT "%8.6" EXTENDED_LIMITS -1.000000 0.9999695 NUMBER 16 /end CHARACTERISTIC
/begin CHARACTERISTIC IVGdiCtl_CvoSigEvln_cal80_C "CVO signal evaluation cal. label" VALUE 0x8058AC38 KwWS32 4294967295.00 tns_q1 -2147483648.00 2147483647.00 FORMAT "%13.2" /end CHARACTERISTIC
/begin CHARACTERISTIC IVGdiCtl_CvoSigEvln_cal82_C "CVO signal evaluation cal. label" VALUE 0x8058AC3C KwUw 65535.00 dez 0.00 65535.00 FORMAT "%8.2" /end CHARACTERISTIC
/begin CHARACTERISTIC IVGdiCtl_CvoSigEvln_cal83_C "CVO signal evaluation cal. label" VALUE 0x8058AC3E KwUw 65535.00 dez 0.00 65535.00 FORMAT "%8.2" /end CHARACTERISTIC
/begin CHARACTERISTIC IVGdiCtl_CvoSigEvln_cal84_C "CVO signal evaluation cal. label" VALUE 0x8058AC40 KwUw 6553.500 t_q0p1_us 0.00 6553.500 FORMAT "%8.3" /end CHARACTERISTIC
/begin CHARACTERISTIC IVGdiCtl_CvoSigEvln_cal85_C "CVO signal evaluation cal. label" VALUE 0x8058AC42 KwUw 6553.500 t_q0p1_us 0.00 6553.500 FORMAT "%8.3" /end CHARACTERISTIC
/begin CHARACTERISTIC IVGdiCtl_CvoSigEvln_Cyl_SimErr_C "cylinder where error can be simulated" VALUE 0x8058AC44 KwUb 255.0 dez 0.00 255.0 FORMAT "%5.1" /end CHARACTERISTIC
/begin CHARACTERISTIC IVGdiCtl_CvoSigEvln_NoTabDiag_SimErr_C "error simulation NoTab" VALUE 0x8058AC45 KwUb 255.0 dez 0.00 255.0 FORMAT "%5.1" /end CHARACTERISTIC
/begin CHARACTERISTIC IVGdiCtl_CvoSigEvln_PlausSigDiag_SimErr_C "error simulation PlausSig" VALUE 0x8058AC46 KwUw 65535.00 dez 0.00 65535.00 FORMAT "%8.2" /end CHARACTERISTIC
/begin CHARACTERISTIC IVGdiCtl_facCvoDiagTestBallInjMax_C "factor of maximum number of ballistic test injection" VALUE 0x805579EE RB_Val_Wu8 255.0 OneToOne 0.00 255.0 FORMAT "%5.1" /end CHARACTERISTIC
/begin CHARACTERISTIC IVGdiCtl_stCvoDiagSimrCdnEna_C "Similar Conditions enabling for cvo operations" VALUE 0x805579EF RB_Val_Wu8 255.0 dez 0.00 255.0 FORMAT "%5.1" /end CHARACTERISTIC
/begin CHARACTERISTIC IVGdiCtl_stCvoDiag_C "Enable Cvo Diagnose" VALUE 0x805579F0 RB_Val_Wu8 255.0 dez 0.00 255.0 FORMAT "%5.1" /end CHARACTERISTIC
/begin CHARACTERISTIC IVGdiCtl_tCvoDiagEnaMax_C "Enable Cvo Diagnose: Max engine temperature" VALUE 0x805579F2 RB_Val_Ws16 6553.500 Temp_Cels -3549.940 3003.560 FORMAT "%8.3" /end CHARACTERISTIC
/begin CHARACTERISTIC IVGdiCtl_tCvoDiagEnaMin_C "Enable Cvo Diagnose: Min engine temperature" VALUE 0x805579F4 RB_Val_Ws16 6553.500 Temp_Cels -3549.940 3003.560 FORMAT "%8.3" /end CHARACTERISTIC
/begin CHARACTERISTIC IVGdiCtl_tCvoDiagSmrCdn_C "engine temperture threshold for fulfillment warm up cycle" VALUE 0x805579F6 RB_Val_Wu8 255.0 temp_ub_q1_o40 -40.0 215.0 FORMAT "%5.1" /end CHARACTERISTIC
/begin CHARACTERISTIC IVGdiCtl_tiCvoDiagIdleMinAdpn_C "minimum necessary pause time for release of controller" VALUE 0x805579F8 RB_Val_Wu16 2621.400 t_q0p04_ms 0.00 2621.400 FORMAT "%8.3" /end CHARACTERISTIC
/begin CHARACTERISTIC IVGdiCtl_tiCvoDiagLimFullLftVlvClsMax_C "max threshold of full lift tab value" VALUE 0x805579FA RB_Val_Wu16 6553.500 t_q0p1_us 0.00 6553.500 FORMAT "%8.3" /end CHARACTERISTIC
/begin CHARACTERISTIC IVGdiCtl_tiCvoDiagLimFullLftVlvClsMin_C "min threshold of full lift tab value" VALUE 0x805579FC RB_Val_Wu16 6553.500 t_q0p1_us 0.00 6553.500 FORMAT "%8.3" /end CHARACTERISTIC
/begin CHARACTERISTIC IVGdiCtl_tiCvoDiagLimTranDeltaTiOpenNeg_C "negative boundary of the open time difference during transition" VALUE 0x805579FE RB_Val_Ws16 6553.500 t_q0p1_us -3276.800 3276.700 FORMAT "%8.3" /end CHARACTERISTIC
/begin CHARACTERISTIC IVGdiCtl_tiCvoDiagLimTranDeltaTiOpenPos_C "positive boundary of the open time difference during transition" VALUE 0x80557A00 RB_Val_Ws16 6553.500 t_q0p1_us -3276.800 3276.700 FORMAT "%8.3" /end CHARACTERISTIC
/begin CHARACTERISTIC IVGdiCtl_uCvoDiagBufBgnThd_C "Threshold for ADC buffer signal from CvoSigEvln" VALUE 0x80557A02 RB_Val_Wu16 65535.00 dez 0.00 65535.00 FORMAT "%8.2" /end CHARACTERISTIC
/begin CHARACTERISTIC IVGdiCtl_uCvoDiagBufEndThd_C "Threshold for ADC buffer signal from CvoSigEvln" VALUE 0x80557A04 RB_Val_Wu16 65535.00 dez 0.00 65535.00 FORMAT "%8.2" /end CHARACTERISTIC
/begin CHARACTERISTIC KFETAKHKTL "map for desired engine efficiency for catalyst heating in case of cold start by idle" MAP 0x8056E232 RB_MapGroup_U16 1.999969 fak_uw_b2 0.00 1.999969 FORMAT "%8.6"
 /begin AXIS_DESCR COM_AXIS NO_INPUT_QUANTITY rel_uw_b100 10 0.00 99.99847 FORMAT "%8.5" AXIS_PTS_REF SMG10KHUW /end AXIS_DESCR
 /begin AXIS_DESCR COM_AXIS NO_INPUT_QUANTITY EngN 8 -16384.00 16383.50 FORMAT "%8.2" AXIS_PTS_REF SNM08KHUW /end AXIS_DESCR
/end CHARACTERISTIC
/begin CHARACTERISTIC KFETAKHKTLVH "map for desired engine efficiency for catalyst heating in case of cold start by idle (big valve lift)" MAP 0x8056E2D2 RB_MapGroup_U16 1.999969 fak_uw_b2 0.00 1.999969 FORMAT "%8.6"
 /begin AXIS_DESCR COM_AXIS NO_INPUT_QUANTITY rel_uw_b100 10 0.00 99.99847 FORMAT "%8.5" AXIS_PTS_REF SMG10KHUW /end AXIS_DESCR
 /begin AXIS_DESCR COM_AXIS NO_INPUT_QUANTITY EngN 8 -16384.00 16383.50 FORMAT "%8.2" AXIS_PTS_REF SNM08KHUW /end AXIS_DESCR
/end CHARACTERISTIC
/begin CHARACTERISTIC KFETAKHKTT "map for desired engine efficiency for catalyst heating in case of cold start by part load" MAP 0x8056E372 RB_MapGroup_U16 1.999969 fak_uw_b2 0.00 1.999969 FORMAT "%8.6"
 /begin AXIS_DESCR COM_AXIS NO_INPUT_QUANTITY rel_uw_b100 10 0.00 99.99847 FORMAT "%8.5" AXIS_PTS_REF SMG10KHUW /end AXIS_DESCR
 /begin AXIS_DESCR COM_AXIS NO_INPUT_QUANTITY EngN 8 -16384.00 16383.50 FORMAT "%8.2" AXIS_PTS_REF SNM08KHUW /end AXIS_DESCR
/end CHARACTERISTIC
/begin CHARACTERISTIC KFETAKHKTTVH "map for desired engine efficiency for catalyst heating in case of cold start by part load (big valve lift)" MAP 0x8056E412 RB_MapGroup_U16 1.999969 fak_uw_b2 0.00 1.999969 FORMAT "%8.6"
 /begin AXIS_DESCR COM_AXIS NO_INPUT_QUANTITY rel_uw_b100 10 0.00 99.99847 FORMAT "%8.5" AXIS_PTS_REF SMG10KHUW /end AXIS_DESCR
 /begin AXIS_DESCR COM_AXIS NO_INPUT_QUANTITY EngN 8 -16384.00 16383.50 FORMAT "%8.2" AXIS_PTS_REF SNM08KHUW /end AXIS_DESCR
/end CHARACTERISTIC
/begin CHARACTERISTIC KFETAKTFSL "map for desired engine efficiency for catalyst heating in case of cold start with automatic gear box in drive-position" MAP 0x8056E4B2 RB_MapGroup_U16 1.999969 fak_uw_b2 0.00 1.999969 FORMAT "%8.6"
 /begin AXIS_DESCR COM_AXIS NO_INPUT_QUANTITY rel_uw_b100 10 0.00 99.99847 FORMAT "%8.5" AXIS_PTS_REF SMG10KHUW /end AXIS_DESCR
 /begin AXIS_DESCR COM_AXIS NO_INPUT_QUANTITY EngN 8 -16384.00 16383.50 FORMAT "%8.2" AXIS_PTS_REF SNM08KHUW /end AXIS_DESCR
/end CHARACTERISTIC
/begin CHARACTERISTIC KFETAKTFSLVH "map for desired engine efficiency for catalyst heating in case of cold start with automatic gear box in drive-position (big valve lift)" MAP 0x8056E552 RB_MapGroup_U16 1.999969 fak_uw_b2 0.00 1.999969 FORMAT "%8.6"
 /begin AXIS_DESCR COM_AXIS NO_INPUT_QUANTITY rel_uw_b100 10 0.00 99.99847 FORMAT "%8.5" AXIS_PTS_REF SMG10KHUW /end AXIS_DESCR
 /begin AXIS_DESCR COM_AXIS NO_INPUT_QUANTITY EngN 8 -16384.00 16383.50 FORMAT "%8.2" AXIS_PTS_REF SNM08KHUW /end AXIS_DESCR
/end CHARACTERISTIC
/begin CHARACTERISTIC KFETAKTLSF "map for desired engine efficiency during cold start in idle operation (second fuel, for instance CNG or FFV)" MAP 0x8056E5F2 RB_MapGroup_U16 1.999969 fak_uw_b2 0.00 1.999969 FORMAT "%8.6"
 /begin AXIS_DESCR COM_AXIS NO_INPUT_QUANTITY rel_uw_b100 8 0.00 99.99847 FORMAT "%8.5" AXIS_PTS_REF SMG08KHNGUW /end AXIS_DESCR
 /begin AXIS_DESCR COM_AXIS NO_INPUT_QUANTITY EngN 8 -16384.00 16383.50 FORMAT "%8.2" AXIS_PTS_REF SNM08KHUW /end AXIS_DESCR
/end CHARACTERISTIC
/begin CHARACTERISTIC KFETAKTLSFFS "map for desired engine efficiency during cold start in idle operation and gear box connected (second fuel, for instance CNG or FFV)" MAP 0x8056E672 RB_MapGroup_U16 1.999969 fak_uw_b2 0.00 1.999969 FORMAT "%8.6"
 /begin AXIS_DESCR COM_AXIS NO_INPUT_QUANTITY rel_uw_b100 8 0.00 99.99847 FORMAT "%8.5" AXIS_PTS_REF SMG08KHNGUW /end AXIS_DESCR
 /begin AXIS_DESCR COM_AXIS NO_INPUT_QUANTITY EngN 8 -16384.00 16383.50 FORMAT "%8.2" AXIS_PTS_REF SNM08KHUW /end AXIS_DESCR
/end CHARACTERISTIC
/begin CHARACTERISTIC KFETAKTLSFVH "map for desired engine efficiency during cold start in idle operation (second fuel, for instance CNG or FFV) (big valve lift)" MAP 0x8056E6F2 RB_MapGroup_U16 1.999969 fak_uw_b2 0.00 1.999969 FORMAT "%8.6"
 /begin AXIS_DESCR COM_AXIS NO_INPUT_QUANTITY rel_uw_b100 8 0.00 99.99847 FORMAT "%8.5" AXIS_PTS_REF SMG08KHNGUW /end AXIS_DESCR
 /begin AXIS_DESCR COM_AXIS NO_INPUT_QUANTITY EngN 8 -16384.00 16383.50 FORMAT "%8.2" AXIS_PTS_REF SNM08KHUW /end AXIS_DESCR
/end CHARACTERISTIC
/begin CHARACTERISTIC KFETAKTTSF "map for desired engine efficiency during cold start in part load operation (second fuel, for instance CNG or FFV)" MAP 0x8056E772 RB_MapGroup_U16 1.999969 fak_uw_b2 0.00 1.999969 FORMAT "%8.6"
 /begin AXIS_DESCR COM_AXIS NO_INPUT_QUANTITY rel_uw_b100 8 0.00 99.99847 FORMAT "%8.5" AXIS_PTS_REF SMG08KHNGUW /end AXIS_DESCR
 /begin AXIS_DESCR COM_AXIS NO_INPUT_QUANTITY EngN 8 -16384.00 16383.50 FORMAT "%8.2" AXIS_PTS_REF SNM08KHUW /end AXIS_DESCR
/end CHARACTERISTIC
/begin CHARACTERISTIC KFETAKTTSFVH "map for desired engine efficiency during cold start in part load operation (second fuel, for instance CNG or FFV) (big valve lift)" MAP 0x8056E7F2 RB_MapGroup_U16 1.999969 fak_uw_b2 0.00 1.999969 FORMAT "%8.6"
 /begin AXIS_DESCR COM_AXIS NO_INPUT_QUANTITY rel_uw_b100 8 0.00 99.99847 FORMAT "%8.5" AXIS_PTS_REF SMG08KHNGUW /end AXIS_DESCR
 /begin AXIS_DESCR COM_AXIS NO_INPUT_QUANTITY EngN 8 -16384.00 16383.50 FORMAT "%8.2" AXIS_PTS_REF SNM08KHUW /end AXIS_DESCR
/end CHARACTERISTIC
/begin CHARACTERISTIC KFFKWTIVK "characteristic map of factor for exh. gas heat flow request to warm front catalyst" MAP 0x8056E872 RB_Map_S16U16_U16 1.999969 fak_uw_b2 0.00 1.999969 FORMAT "%8.6"
 /begin AXIS_DESCR STD_AXIS ExhMgT_tCatHeatgTCatSelnActn temp_q0p1_K 6 -3276.800 3276.700 FORMAT "%8.3" DEPOSIT ABSOLUTE /end AXIS_DESCR
 /begin AXIS_DESCR STD_AXIS ExhMgT_facWghtCatAge fak_uw_b2 4 0.00 1.999969 FORMAT "%8.6" DEPOSIT ABSOLUTE /end AXIS_DESCR
/end CHARACTERISTIC
/begin CHARACTERISTIC KFFSTKTMFH "weighting factor for desired engine efficiency for catalyst heating in case of a cold start cold engine in dependence on altitudet and engine start temperature" MAP 0x8056E8BA RB_Map_S16U16_U16 1.992188 fak_ub_b2 0.00 1.992188 FORMAT "%8.6" EXTENDED_LIMITS 0.00 511.9922
 /begin AXIS_DESCR STD_AXIS ExhMgT_tEngCatHeatgFild Temp_Cels 8 -3549.940 3003.560 FORMAT "%8.3" DEPOSIT ABSOLUTE /end AXIS_DESCR
 /begin AXIS_DESCR STD_AXIS PEnv_facCorrAlti fak_uw_b4 4 0.00 3.999939 FORMAT "%8.6" DEPOSIT ABSOLUTE /end AXIS_DESCR
/end CHARACTERISTIC
/begin CHARACTERISTIC KFFSTKTMFHETH "weighting factor for desired engine efficiency for catalyst heating in case of a cold start cold engine in dependence on altitude and engine start temperature when using ethanol fuel" MAP 0x8056E916 RB_Map_S16U16_U16 1.992188 fak_ub_b2 0.00 1.992188 FORMAT "%8.6" EXTENDED_LIMITS 0.00 511.9922
 /begin AXIS_DESCR STD_AXIS ExhMgT_tEngCatHeatgFild Temp_Cels 8 -3549.940 3003.560 FORMAT "%8.3" DEPOSIT ABSOLUTE /end AXIS_DESCR
 /begin AXIS_DESCR STD_AXIS PEnv_facCorrAlti fak_uw_b4 4 0.00 3.999939 FORMAT "%8.6" DEPOSIT ABSOLUTE /end AXIS_DESCR
/end CHARACTERISTIC
/begin CHARACTERISTIC KFFSTNSTMS "weighting factor for desired engine efficiency for catalyst heating in case of a cold start in dependence on time after start and engine start temperature" MAP 0x8056E972 RB_Map_S16U16_U16 1.992188 fak_ub_b2 0.00 1.992188 FORMAT "%8.6" EXTENDED_LIMITS 0.00 511.9922
 /begin AXIS_DESCR STD_AXIS ExhMgT_tEngCatHeatgFild Temp_Cels 4 -3549.940 3003.560 FORMAT "%8.3" DEPOSIT ABSOLUTE /end AXIS_DESCR
 /begin AXIS_DESCR STD_AXIS tnse_w_msg t100msxs_uw_b6553p5 8 0.00 6553.500 FORMAT "%8.3" DEPOSIT ABSOLUTE /end AXIS_DESCR
/end CHARACTERISTIC
/begin CHARACTERISTIC KFFSTNSTMSSF "weighting factor for desired engine efficiency for catalyst heating in case of a cold start in dependence on time after start and engine start temperature (second fuel)" MAP 0x8056E9CE RB_Map_S16U16_U8 1.992188 fak_ub_b2 0.00 1.992188 FORMAT "%8.6"
 /begin AXIS_DESCR STD_AXIS ExhMgT_tEngCatHeatgFild Temp_Cels 4 -3549.940 3003.560 FORMAT "%8.3" DEPOSIT ABSOLUTE /end AXIS_DESCR
 /begin AXIS_DESCR STD_AXIS tnse_w_msg t100msxs_uw_b6553p5 8 0.00 6553.500 FORMAT "%8.3" DEPOSIT ABSOLUTE /end AXIS_DESCR
/end CHARACTERISTIC
/begin CHARACTERISTIC KFZWKHKTL "map for desired ignition-timing for catalyst heating in case of cold start by idle" MAP 0x8056EA0A RB_MapGroup_S16 191.9971 zw_q2p9297Em3_deg_KW -96.00000 95.99707 FORMAT "%8.5"
 /begin AXIS_DESCR COM_AXIS NO_INPUT_QUANTITY rel_uw_b100 10 0.00 99.99847 FORMAT "%8.5" AXIS_PTS_REF SMG10KHUW /end AXIS_DESCR
 /begin AXIS_DESCR COM_AXIS NO_INPUT_QUANTITY EngN 8 -16384.00 16383.50 FORMAT "%8.2" AXIS_PTS_REF SNM08KHUW /end AXIS_DESCR
/end CHARACTERISTIC
/begin CHARACTERISTIC KFZWKHKTLVH "map for desired ignition-timing for catalyst heating in case of cold start by idle (big valve lift)" MAP 0x8056EAAA RB_MapGroup_S16 191.9971 zw_q2p9297Em3_deg_KW -96.00000 95.99707 FORMAT "%8.5"
 /begin AXIS_DESCR COM_AXIS NO_INPUT_QUANTITY rel_uw_b100 10 0.00 99.99847 FORMAT "%8.5" AXIS_PTS_REF SMG10KHUW /end AXIS_DESCR
 /begin AXIS_DESCR COM_AXIS NO_INPUT_QUANTITY EngN 8 -16384.00 16383.50 FORMAT "%8.2" AXIS_PTS_REF SNM08KHUW /end AXIS_DESCR
/end CHARACTERISTIC
/begin CHARACTERISTIC KFZWKHKTT "map for desired ignition-timing for catalyst heating in case of cold start by part load" MAP 0x8056EB4A RB_MapGroup_S16 191.9971 zw_q2p9297Em3_deg_KW -96.00000 95.99707 FORMAT "%8.5"
 /begin AXIS_DESCR COM_AXIS NO_INPUT_QUANTITY rel_uw_b100 10 0.00 99.99847 FORMAT "%8.5" AXIS_PTS_REF SMG10KHUW /end AXIS_DESCR
 /begin AXIS_DESCR COM_AXIS NO_INPUT_QUANTITY EngN 8 -16384.00 16383.50 FORMAT "%8.2" AXIS_PTS_REF SNM08KHUW /end AXIS_DESCR
/end CHARACTERISTIC
/begin CHARACTERISTIC KFZWKHKTTVH "map for desired eignition-timing for catalyst heating in case of cold start by part load (big valve lift)" MAP 0x8056EBEA RB_MapGroup_S16 191.9971 zw_q2p9297Em3_deg_KW -96.00000 95.99707 FORMAT "%8.5"
 /begin AXIS_DESCR COM_AXIS NO_INPUT_QUANTITY rel_uw_b100 10 0.00 99.99847 FORMAT "%8.5" AXIS_PTS_REF SMG10KHUW /end AXIS_DESCR
 /begin AXIS_DESCR COM_AXIS NO_INPUT_QUANTITY EngN 8 -16384.00 16383.50 FORMAT "%8.2" AXIS_PTS_REF SNM08KHUW /end AXIS_DESCR
/end CHARACTERISTIC
/begin CHARACTERISTIC KFZWKTFSL "map for desired ignition-timing for catalyst heating in case of cold start with automatic gear box in drive-position" MAP 0x8056EC8A RB_MapGroup_S16 191.9971 zw_q2p9297Em3_deg_KW -96.00000 95.99707 FORMAT "%8.5"
 /begin AXIS_DESCR COM_AXIS NO_INPUT_QUANTITY rel_uw_b100 10 0.00 99.99847 FORMAT "%8.5" AXIS_PTS_REF SMG10KHUW /end AXIS_DESCR
 /begin AXIS_DESCR COM_AXIS NO_INPUT_QUANTITY EngN 8 -16384.00 16383.50 FORMAT "%8.2" AXIS_PTS_REF SNM08KHUW /end AXIS_DESCR
/end CHARACTERISTIC
/begin CHARACTERISTIC KFZWKTFSLVH "map for desired ignition-timing for catalyst heating in case of cold start with automatic gear box in drive-position (big valve lift)" MAP 0x8056ED2A RB_MapGroup_S16 191.9971 zw_q2p9297Em3_deg_KW -96.00000 95.99707 FORMAT "%8.5"
 /begin AXIS_DESCR COM_AXIS NO_INPUT_QUANTITY rel_uw_b100 10 0.00 99.99847 FORMAT "%8.5" AXIS_PTS_REF SMG10KHUW /end AXIS_DESCR
 /begin AXIS_DESCR COM_AXIS NO_INPUT_QUANTITY EngN 8 -16384.00 16383.50 FORMAT "%8.2" AXIS_PTS_REF SNM08KHUW /end AXIS_DESCR
/end CHARACTERISTIC
/begin CHARACTERISTIC KFZWKTSFL "map for desired ignition-timing in case of cold start in idle operation (second fuel, for instance CNG or FFV)" MAP 0x8056EDCA RB_MapGroup_S16 191.9971 zw_q2p9297Em3_deg_KW -96.00000 95.99707 FORMAT "%8.5"
 /begin AXIS_DESCR COM_AXIS NO_INPUT_QUANTITY rel_uw_b100 8 0.00 99.99847 FORMAT "%8.5" AXIS_PTS_REF SMG08KHNGUW /end AXIS_DESCR
 /begin AXIS_DESCR COM_AXIS NO_INPUT_QUANTITY EngN 8 -16384.00 16383.50 FORMAT "%8.2" AXIS_PTS_REF SNM08KHUW /end AXIS_DESCR
/end CHARACTERISTIC
/begin CHARACTERISTIC KFZWKTSFLFS "map for desired ignition-timing in case of cold start in idle operation and gear box connected (second fuel, for instance CNG or FFV)" MAP 0x8056EE4A RB_MapGroup_S16 191.9971 zw_q2p9297Em3_deg_KW -96.00000 95.99707 FORMAT "%8.5"
 /begin AXIS_DESCR COM_AXIS NO_INPUT_QUANTITY rel_uw_b100 8 0.00 99.99847 FORMAT "%8.5" AXIS_PTS_REF SMG08KHNGUW /end AXIS_DESCR
 /begin AXIS_DESCR COM_AXIS NO_INPUT_QUANTITY EngN 8 -16384.00 16383.50 FORMAT "%8.2" AXIS_PTS_REF SNM08KHUW /end AXIS_DESCR
/end CHARACTERISTIC
/begin CHARACTERISTIC KFZWKTSFLVH "map for desired ignition-timing in case of cold start in idle operation (second fuel, for instance CNG or FFV) (big valve lift)" MAP 0x8056EECA RB_MapGroup_S16 191.9971 zw_q2p9297Em3_deg_KW -96.00000 95.99707 FORMAT "%8.5"
 /begin AXIS_DESCR COM_AXIS NO_INPUT_QUANTITY rel_uw_b100 8 0.00 99.99847 FORMAT "%8.5" AXIS_PTS_REF SMG08KHNGUW /end AXIS_DESCR
 /begin AXIS_DESCR COM_AXIS NO_INPUT_QUANTITY EngN 8 -16384.00 16383.50 FORMAT "%8.2" AXIS_PTS_REF SNM08KHUW /end AXIS_DESCR
/end CHARACTERISTIC
/begin CHARACTERISTIC KFZWKTSFT "map for desired ignition-timing in case of cold start in part load operation (second fuel, for instance CNG or FFV)" MAP 0x8056EF4A RB_MapGroup_S16 191.9971 zw_q2p9297Em3_deg_KW -96.00000 95.99707 FORMAT "%8.5"
 /begin AXIS_DESCR COM_AXIS NO_INPUT_QUANTITY rel_uw_b100 8 0.00 99.99847 FORMAT "%8.5" AXIS_PTS_REF SMG08KHNGUW /end AXIS_DESCR
 /begin AXIS_DESCR COM_AXIS NO_INPUT_QUANTITY EngN 8 -16384.00 16383.50 FORMAT "%8.2" AXIS_PTS_REF SNM08KHUW /end AXIS_DESCR
/end CHARACTERISTIC
/begin CHARACTERISTIC KFZWKTSFTVH "map for desired ignition-timing in case of cold start in part load operation (second fuel, for instance CNG or FFV) (big valve lift)" MAP 0x8056EFCA RB_MapGroup_S16 191.9971 zw_q2p9297Em3_deg_KW -96.00000 95.99707 FORMAT "%8.5"
 /begin AXIS_DESCR COM_AXIS NO_INPUT_QUANTITY rel_uw_b100 8 0.00 99.99847 FORMAT "%8.5" AXIS_PTS_REF SMG08KHNGUW /end AXIS_DESCR
 /begin AXIS_DESCR COM_AXIS NO_INPUT_QUANTITY EngN 8 -16384.00 16383.50 FORMAT "%8.2" AXIS_PTS_REF SNM08KHUW /end AXIS_DESCR
/end CHARACTERISTIC
/begin CHARACTERISTIC KLDETAKH "Minimum distance to minimal spark efficiency while spark retard for cat. heat." CURVE 0x8056F04A RB_Curve_U16_U16 1.999969 fak_uw_b2 0.00 1.999969 FORMAT "%8.6"
 /begin AXIS_DESCR STD_AXIS NO_INPUT_QUANTITY fak_uw_b2 6 0.00 1.999969 FORMAT "%8.6" DEPOSIT ABSOLUTE /end AXIS_DESCR
/end CHARACTERISTIC
/begin CHARACTERISTIC KLDLUWSKH "line for weighting factor engine efficiency in case of catalyst heating by cold start in dependence on irregular running" CURVE 0x8056F064 RB_Curve_S16_U8_Static 1.992188 fak_ub_b2 0.00 1.992188 FORMAT "%8.6"
 /begin AXIS_DESCR STD_AXIS dsdluts_w_msg lu_MEx 4 -232.8306 232.8235 FORMAT "%8.4" DEPOSIT ABSOLUTE /end AXIS_DESCR
/end CHARACTERISTIC
/begin CHARACTERISTIC KLETHINTKH "line for flex fuel interpolation curve in case of catalyst heating by cold start in dependence on ethanol content factor" CURVE 0x8056F072 RB_Curve_U16_U16 1.999969 fak_uw_b2 0.00 1.999969 FORMAT "%8.6"
 /begin AXIS_DESCR STD_AXIS fethmnmx_w_msg fak_uw_b2 6 0.00 1.999969 FORMAT "%8.6" DEPOSIT ABSOLUTE /end AXIS_DESCR
/end CHARACTERISTIC
/begin CHARACTERISTIC KLFSTIMLPRSF "weighting factor for desired engine efficiency for catalyst heating by cold engine in dependence of heating progress (second fuel)" CURVE 0x8056F08C RB_Curve_U16_U8_Static 1.992188 fak_ub_b2 0.00 1.992188 FORMAT "%8.6"
 /begin AXIS_DESCR STD_AXIS ExhMgT_facCatHeatgProgs fak_uw_b1 8 0.00 0.9999847 FORMAT "%9.7" DEPOSIT ABSOLUTE /end AXIS_DESCR
/end CHARACTERISTIC
/begin CHARACTERISTIC KLFSTKTAGE "weighting factor for desired engine efficiency for catalyst heating by cold engine in dependence of catalyst ageing" CURVE 0x8056F0A6 RB_Curve_U16_U8_Static 1.992188 fak_ub_b2 0.00 1.992188 FORMAT "%8.6"
 /begin AXIS_DESCR STD_AXIS ExhMgT_facWghtCatAge fak_uw_b2 4 0.00 1.999969 FORMAT "%8.6" DEPOSIT ABSOLUTE /end AXIS_DESCR
/end CHARACTERISTIC
/begin CHARACTERISTIC KLFSTKTAGESF "weighting factor for desired engine efficiency for catalyst heating by cold engine in dependence of catalyst ageing (second fuel)" CURVE 0x8056F0B4 RB_Curve_U16_U8_Static 1.992188 fak_ub_b2 0.00 1.992188 FORMAT "%8.6"
 /begin AXIS_DESCR STD_AXIS ExhMgT_facWghtCatAge fak_uw_b2 4 0.00 1.999969 FORMAT "%8.6" DEPOSIT ABSOLUTE /end AXIS_DESCR
/end CHARACTERISTIC
/begin CHARACTERISTIC KLINTFSTETA "curve for flex fuel interpolation curve in case of catalyst heating by cold start in dependence on ethanol content factor" CURVE 0x8056F0C2 RB_Curve_U16_U16 1.999969 fak_uw_b2 0.00 1.999969 FORMAT "%8.6"
 /begin AXIS_DESCR STD_AXIS fethmnmx_w_msg fak_uw_b2 6 0.00 1.999969 FORMAT "%8.6" DEPOSIT ABSOLUTE /end AXIS_DESCR
/end CHARACTERISTIC
/begin CHARACTERISTIC KLMDKHAGE "Weighting factor for torque band in cat heating based on the cat ageing" CURVE 0x8056D5E2 RB_Curve_U16_U8_Static 1.992188 fak_ub_b2 0.00 1.992188 FORMAT "%8.6"
 /begin AXIS_DESCR STD_AXIS ExhMgT_facWghtCatAge fak_uw_b2 4 0.00 1.999969 FORMAT "%8.6" DEPOSIT ABSOLUTE /end AXIS_DESCR
/end CHARACTERISTIC
/begin CHARACTERISTIC KLMDKHTMMN "weighting factor for request of a torque window in dependency of engine temperature at beginning of catalyst heating phase" CURVE 0x8056D5F0 RB_Curve_S16_U8_Static 1.992188 fak_ub_b2 0.00 1.992188 FORMAT "%8.6"
 /begin AXIS_DESCR STD_AXIS ExhMgT_tTrqCatHeatg Temp_Cels 8 -3549.940 3003.560 FORMAT "%8.3" DEPOSIT ABSOLUTE /end AXIS_DESCR
/end CHARACTERISTIC
/begin CHARACTERISTIC KLMDKHTMMX "weighting factor for request of a torque window in dependency of engine temperature at beginning of catalyst heating phase" CURVE 0x8056D60A RB_Curve_S16_U8_Static 1.992188 fak_ub_b2 0.00 1.992188 FORMAT "%8.6"
 /begin AXIS_DESCR STD_AXIS ExhMgT_tTrqCatHeatg Temp_Cels 8 -3549.940 3003.560 FORMAT "%8.3" DEPOSIT ABSOLUTE /end AXIS_DESCR
/end CHARACTERISTIC
/begin CHARACTERISTIC KLMIMMNKTL "min. desired torque for catalyst heating (during cold start) in dependence of relative heating progress by idle load" CURVE 0x8056D624 RB_Curve_U16_U16 99.99847 rel_uw_b100 0.00 99.99847 FORMAT "%8.5"
 /begin AXIS_DESCR STD_AXIS ExhMgT_facCatHeatgProgsTqDes fak_uw_b1 6 0.00 0.9999847 FORMAT "%9.7" DEPOSIT ABSOLUTE /end AXIS_DESCR
/end CHARACTERISTIC
/begin CHARACTERISTIC KLMIMMNKTT "min. desired torque for catalyst heating (during cold start) in dependence of relative heating progress by part load" CURVE 0x8056D63E RB_Curve_U16_U16 99.99847 rel_uw_b100 0.00 99.99847 FORMAT "%8.5"
 /begin AXIS_DESCR STD_AXIS ExhMgT_facCatHeatgProgsTqDes fak_uw_b1 6 0.00 0.9999847 FORMAT "%9.7" DEPOSIT ABSOLUTE /end AXIS_DESCR
/end CHARACTERISTIC
/begin CHARACTERISTIC KLMIMMXKTL "max. desired torque for catalyst heating (during cold start) in dependence of relative heating progress by idle load" CURVE 0x8056D658 RB_Curve_U16_U16 99.99847 rel_uw_b100 0.00 99.99847 FORMAT "%8.5"
 /begin AXIS_DESCR STD_AXIS ExhMgT_facCatHeatgProgsTqDes fak_uw_b1 6 0.00 0.9999847 FORMAT "%9.7" DEPOSIT ABSOLUTE /end AXIS_DESCR
/end CHARACTERISTIC
/begin CHARACTERISTIC KLMIMMXKTT "max. desired torque for catalyst heating (during cold start) in dependence of relative heating progress by part load" CURVE 0x8056D672 RB_Curve_U16_U16 99.99847 rel_uw_b100 0.00 99.99847 FORMAT "%8.5"
 /begin AXIS_DESCR STD_AXIS ExhMgT_facCatHeatgProgsTqDes fak_uw_b1 6 0.00 0.9999847 FORMAT "%9.7" DEPOSIT ABSOLUTE /end AXIS_DESCR
/end CHARACTERISTIC
/begin CHARACTERISTIC KnDet_CalMeasWin_C "code word measurement window output via application interface" VALUE 0x805702AC RB_Val_Wu8 4.000 dez 0.00 4.000 FORMAT "%5.3" EXTENDED_LIMITS 0.00 255.0 /end CHARACTERISTIC
/begin CHARACTERISTIC KnDet_CfgRelsMeasWin_C "configuration enable check of measurement window length" VALUE 0x805702AD RB_Val_Wu8 255.0 dez 0.00 255.0 FORMAT "%5.1" /end CHARACTERISTIC
/begin CHARACTERISTIC KnDet_CoefFlt_CA "filter coefficients for signal evaluation" VAL_BLK 0x805702C4 RB_ValA_Wu16 65535.00 dez 0.00 65535.00 FORMAT "%8.2" NUMBER 292 /end CHARACTERISTIC
/begin CHARACTERISTIC KnDet_GainRng0_C "Amplification stage range 0" VALUE 0x805702AE RB_Val_Wu8 2.000 dez 0.00 2.000 FORMAT "%5.3" EXTENDED_LIMITS 0.00 255.0 /end CHARACTERISTIC
/begin CHARACTERISTIC KnDet_GainRng1_C "Amplification stage range 1" VALUE 0x805702AF RB_Val_Wu8 2.000 dez 0.00 2.000 FORMAT "%5.3" EXTENDED_LIMITS 0.00 255.0 /end CHARACTERISTIC
/begin CHARACTERISTIC KnDet_GainRng2_C "Amplification stage range 2" VALUE 0x805702B0 RB_Val_Wu8 2.000 dez 0.00 2.000 FORMAT "%5.3" EXTENDED_LIMITS 0.00 255.0 /end CHARACTERISTIC
/begin CHARACTERISTIC KnDet_NThdGainRng1_C "threshold switch of amplification stage range 1" VALUE 0x805702B2 RB_Val_Ws16 16383.50 EngN 0.00 16383.50 FORMAT "%8.2" EXTENDED_LIMITS -16384.00 16383.50 /end CHARACTERISTIC
/begin CHARACTERISTIC KnDet_NThdGainRng2_C "threshold switch of amplification stage range 2" VALUE 0x805702B4 RB_Val_Ws16 16383.50 EngN 0.00 16383.50 FORMAT "%8.2" EXTENDED_LIMITS -16384.00 16383.50 /end CHARACTERISTIC
/begin CHARACTERISTIC KnDet_SnsrMaxErr_C "upper fault threshold short circuit detection" VALUE 0x805702C0 RB_Val_Ws16 10.51926 RBPtCel_u_1p60514em4_1 -5.259711 5.259551 FORMAT "%8.6" /end CHARACTERISTIC
/begin CHARACTERISTIC KnDet_SnsrMinErr_C "lower fault threshold short circuit detection" VALUE 0x805702C2 RB_Val_Ws16 10.51926 RBPtCel_u_1p60514em4_1 -5.259711 5.259551 FORMAT "%8.6" /end CHARACTERISTIC
/begin CHARACTERISTIC KnDet_ThresNGradMeasWin_C "speed gradient threshold release of check number of measurement values" VALUE 0x805702B6 RB_Val_Ws16 5000.000 EngNGrd 0.00 5000.000 FORMAT "%8.3" EXTENDED_LIMITS -16384.00 16383.50 /end CHARACTERISTIC
/begin CHARACTERISTIC KnDet_ThresNMeasWin_C "speed threshold release of check number of measurement values" VALUE 0x805702B8 RB_Val_Ws16 16383.50 EngN 0.00 16383.50 FORMAT "%8.2" EXTENDED_LIMITS -16384.00 16383.50 /end CHARACTERISTIC
/begin CHARACTERISTIC KnDet_ThresNumMeasWin_C "Threshold for check number of measurement values" VALUE 0x805702BA RB_Val_Ws8 50.00 dez 0.00 50.00 FORMAT "%5.2" EXTENDED_LIMITS -128.0 127.0 /end CHARACTERISTIC
/begin CHARACTERISTIC KnDet_ThresTiDiffMeasWin_C "threshold minmal measurement window distance" VALUE 0x805702BC RB_Val_Wu32 20000.0000000 t_us_q1 0.00 20000.0000000 FORMAT "%13.7" EXTENDED_LIMITS 0.00 4294967295.00 /end CHARACTERISTIC
/begin AXIS_PTS SMG08KHNGUW "Distribution of breakpoints of requested torque (mifal_w) for CNG- or FFV-projects" 0x8056F0DC NO_INPUT_QUANTITY RB_Axis_U16 99.99847 rel_uw_b100 8 0.00 99.99847 FORMAT "%8.5" DEPOSIT ABSOLUTE /end AXIS_PTS
/begin AXIS_PTS SMG10KHUW "Distribution of breakpoints of reqested torque after gear protection in KHMR for OPF heating" 0x8056F0EE NO_INPUT_QUANTITY RB_Axis_U16 99.99847 rel_uw_b100 10 0.00 99.99847 FORMAT "%8.5" DEPOSIT ABSOLUTE /end AXIS_PTS
/begin AXIS_PTS SMG13KHUW "Distribution of breakpoints of reqested torque after gear protection in KHMR for OPF heating" 0x8056F104 NO_INPUT_QUANTITY RB_Axis_U16 99.99847 rel_uw_b100 13 0.00 99.99847 FORMAT "%8.5" DEPOSIT ABSOLUTE /end AXIS_PTS
/begin AXIS_PTS SNM08KHUW "Datapoint distribution for engine speed in KHMR" 0x8056F120 NO_INPUT_QUANTITY RB_Axis_S16 32767.50 EngN 8 -16384.00 16383.50 FORMAT "%8.2" DEPOSIT ABSOLUTE /end AXIS_PTS
/begin AXIS_PTS SNM12KHUW "Datapoint distribution for engine speed in KHMR for OPF heating" 0x8056F132 Epm_nEng RB_Axis_S16 32767.50 EngN 12 -16384.00 16383.50 FORMAT "%8.2" DEPOSIT ABSOLUTE /end AXIS_PTS
/begin CHARACTERISTIC TETAKHKT "time constant for filtering of engine efficency for catalyst heating as a result of a cold start" VALUE 0x8056F14C RB_Val_Wu16 655.34999985 zk10msxs_uw_b655p36 0.01000015 655.36000000 FORMAT "%12.8" EXTENDED_LIMITS 0.010000152590 655.36000000 /end CHARACTERISTIC
/begin CHARACTERISTIC TETAKHKTLL "time constant for filtering of engine efficency for catalyst heating as a result of a cold start (during part load)" VALUE 0x8056F14E RB_Val_Wu16 655.34999985 zk10msxs_uw_b655p36 0.01000015 655.36000000 FORMAT "%12.8" EXTENDED_LIMITS 0.010000152590 655.36000000 /end CHARACTERISTIC
/begin CHARACTERISTIC VFZGKHKT "vehicle velocity to switch over part load to idle load maps in case of condition Engine Idle" VALUE 0x8056F150 RB_Val_Ws16 655.3500 Vel -327.6800 327.6700 FORMAT "%8.4" /end CHARACTERISTIC
/begin CHARACTERISTIC ZKKHKTL "time constant for transition desired engine efficiency for catalyst heating from idle to part load" VALUE 0x8056F152 RB_Val_Wu16 655.34999985 zk10msxs_uw_b655p36 0.01000015 655.36000000 FORMAT "%12.8" EXTENDED_LIMITS 0.010000152590 655.36000000 /end CHARACTERISTIC
/begin CHARACTERISTIC ZKKHKTT "time constant for transition desired engine efficiency for catalyst heating from part load to idle" VALUE 0x8056F154 RB_Val_Wu16 655.34999985 zk10msxs_uw_b655p36 0.01000015 655.36000000 FORMAT "%12.8" EXTENDED_LIMITS 0.010000152590 655.36000000 /end CHARACTERISTIC
/begin MEASUREMENT B_detakhap "correction of desired engine efficiency for catalyst heating" UBYTE B_TRUE 1 100 0.00 1.00000000000 BIT_MASK 0x1 FORMAT "%13.11" ECU_ADDRESS 0x6000B7A1 /end MEASUREMENT
/begin MEASUREMENT B_koevab_msg "injection valve cutoff active by function KOEVAB" UBYTE B_TRUE 1 100 0.00 1.00000000000 BIT_MASK 0x1 FORMAT "%13.11" ECU_ADDRESS 0x70000B95 /end MEASUREMENT
/begin MEASUREMENT B_stfmf "" UBYTE B_TRUE 1 100 0.00 1.00000000000 BIT_MASK 0x1 FORMAT "%13.11" ECU_ADDRESS 0x700001BD /end MEASUREMENT
/begin MEASUREMENT B_zwetakh "desired engine efficiency for catalyst heating over ignition timing" UBYTE B_TRUE 1 100 0.00 1.00000000000 BIT_MASK 0x1 FORMAT "%13.11" ECU_ADDRESS 0x6000B7A0 /end MEASUREMENT
/begin MEASUREMENT etaaktsl_w_msg "desired engine efficiency for secondary air active diagnosis" UWORD fak_uw_b2 1 100 0.00 1.999969 FORMAT "%8.6" ECU_ADDRESS 0x60009378 /end MEASUREMENT
/begin MEASUREMENT etakhaw_w "choiced desired engine efficiency for catalyst heating" UWORD fak_uw_b2 1 100 0.00 1.999969 FORMAT "%8.6" ECU_ADDRESS 0x60007386 /end MEASUREMENT
/begin MEASUREMENT etakhbg_w "limitation of desired engine efficiency for catalyst heating in dependence of brake booster" UWORD fak_uw_b2 1 100 0.00 1.999969 FORMAT "%8.6" ECU_ADDRESS 0x60007384 /end MEASUREMENT
/begin MEASUREMENT etakhdia_w_msg "desired engine efficiency for catalyst heating (tester interface to diagnostic function)" UWORD fak_uw_b2 1 100 0.00 1.999969 FORMAT "%8.6" ECU_ADDRESS 0x60009374 /end MEASUREMENT
/begin MEASUREMENT etakhktd_w "desired engine efficiency for catalyst heating by cold start (for diagnosis)" UWORD fak_uw_b2 1 100 0.00 1.999969 FORMAT "%8.6" ECU_ADDRESS 0x60007382 /end MEASUREMENT
/begin MEASUREMENT etakhktl_w_msg "desired engine efficiency for catalyst heating by cold engine during idle speed" UWORD fak_uw_b2 1 100 0.00 1.999969 FORMAT "%8.6" ECU_ADDRESS 0x60009370 /end MEASUREMENT
/begin MEASUREMENT etakhktn_w "desired engine efficiency (nominal) for catalyst heating by cold start" UWORD fak_uw_b2 1 100 0.00 1.999969 FORMAT "%8.6" ECU_ADDRESS 0x60007380 /end MEASUREMENT
/begin MEASUREMENT etakhktt_w_msg "desired engine efficiency for catalyst heating by cold engine during part load" UWORD fak_uw_b2 1 100 0.00 1.999969 FORMAT "%8.6" ECU_ADDRESS 0x6001498A /end MEASUREMENT
/begin MEASUREMENT etakhkt_w_msg "desired engine efficiency for catalyst heating by cold start" UWORD fak_uw_b2 1 100 0.00 1.999969 FORMAT "%8.6" ECU_ADDRESS 0x60009372 /end MEASUREMENT
/begin MEASUREMENT etakhkw_w "desired engine efficiency for catalyst heating in case of catalyst warming" UWORD fak_uw_b2 1 100 0.00 1.999969 FORMAT "%8.6" ECU_ADDRESS 0x6000737E /end MEASUREMENT
/begin MEASUREMENT etakhsv_w "desired engine efficiency for catalyst heating (adaption over service tester)" UWORD fak_uw_b2 1 100 0.00 1.999969 FORMAT "%8.6" ECU_ADDRESS 0x6000737C /end MEASUREMENT
/begin MEASUREMENT etakh_w_msg "desired engine efficiency for catalyst heating" UWORD fak_uw_b2 1 100 0.00 1.999969 FORMAT "%8.6" ECU_ADDRESS 0x60009376 /end MEASUREMENT
/begin MEASUREMENT etaktlbg_w_msg "maximum allowed desired engine efficiency for catalyst heating by coldstart during idle" UWORD fak_uw_b2 1 100 0.00 1.999969 FORMAT "%8.6" ECU_ADDRESS 0x6000936E /end MEASUREMENT
/begin MEASUREMENT etakttbg_w_msg "maximum allowed desired engine efficiency for catalyst heating by coldstart during part load" UWORD fak_uw_b2 1 100 0.00 1.999969 FORMAT "%8.6" ECU_ADDRESS 0x6000936C /end MEASUREMENT
/begin MEASUREMENT etazwmnk_w "minimum ignition angle effectiveness by catalyst heating" UWORD fak_uw_b2 1 100 0.00 1.999969 FORMAT "%8.6" ECU_ADDRESS 0x6000737A /end MEASUREMENT
/begin MEASUREMENT ExhMgt_cntrIniDrvEngDgrdCatHeatg "Counter for IniDrive request for KHMR" UBYTE OneToOne 1 100 0.00 255.0 FORMAT "%5.1" ECU_ADDRESS 0x6000B79F /end MEASUREMENT
/begin MEASUREMENT ExhMgt_cntrReIniEngDgrdCatHeatg10ms "Counter for Re-Initialization request for HKMR, 10ms" UBYTE OneToOne 1 100 0.00 255.0 FORMAT "%5.1" ECU_ADDRESS 0x6000B79E /end MEASUREMENT
/begin MEASUREMENT ExhMgt_ctReIniTqReqCatHeatg "Counter for Re-Initialization request for KHANFMO" UBYTE OneToOne 1 100 0.00 255.0 FORMAT "%5.1" ECU_ADDRESS 0x6000B7A2 /end MEASUREMENT
/begin MEASUREMENT ExhMgT_effCatHeatgLim "desired engine efficiency for catalyst heating" UWORD fak_uw_b2 1 100 0.00 1.999969 FORMAT "%8.6" ECU_ADDRESS 0x60007378 /end MEASUREMENT
/begin MEASUREMENT ExhMgT_effMinDeltaCatHeatg "distance to latest allowed ignition angle efficiency" UWORD fak_uw_b2 1 100 0.00 1.999969 FORMAT "%8.6" ECU_ADDRESS 0x60007376 /end MEASUREMENT
/begin MEASUREMENT ExhMgt_etaCatHeatg "eta catalyst heating idle" UWORD fak_uw_b2 1 100 0.00 1.999969 FORMAT "%8.6" ECU_ADDRESS 0x60007374 /end MEASUREMENT
/begin MEASUREMENT ExhMgT_etaCatHeatgNomFild "desired engine efficiency (nominal and filtered) for catalyst heating in case of catalyst warming" UWORD fak_uw_b2 1 100 0.00 1.999969 FORMAT "%8.6" ECU_ADDRESS 0x60007372 /end MEASUREMENT
/begin MEASUREMENT ExhMgT_etaCatHeatgWght "desired engine efficiency (nominal and weighted) for catalyst heating in case of catalyst warming" UWORD fak_uw_b2 1 100 0.00 1.999969 FORMAT "%8.6" ECU_ADDRESS 0x60007370 /end MEASUREMENT
/begin MEASUREMENT ExhMgT_etaDesCatHeatg "desired engine efficiency for catalyst heating" UWORD fak_uw_b2 1 100 0.00 1.999969 FORMAT "%8.6" ECU_ADDRESS 0x6000736E /end MEASUREMENT
/begin MEASUREMENT ExhMgT_etaDesCatHeatgDiag "desired engine efficiency for catalyst heating (tester interface to diagnostic function)" UWORD fak_uw_b2 1 100 0.00 1.999969 FORMAT "%8.6" ECU_ADDRESS 0x6000736C /end MEASUREMENT
/begin MEASUREMENT ExhMgT_etaSpCatWrm "desired engine efficiency for catalyst heatingin case of catalyst warming" UWORD fak_uw_b2 1 100 0.00 1.999969 FORMAT "%8.6" ECU_ADDRESS 0x6000736A /end MEASUREMENT
/begin MEASUREMENT ExhMgT_etaSpCatWrmIdle "desired engine efficiency for catalyst warming in idle" UWORD fak_uw_b2 1 100 0.00 1.999969 FORMAT "%8.6" ECU_ADDRESS 0x60009496 /end MEASUREMENT
/begin MEASUREMENT ExhMgT_etaSpCatWrmPartLoad "desired engine efficiency for catalyst warming during part load" UWORD fak_uw_b2 1 100 0.00 1.999969 FORMAT "%8.6" ECU_ADDRESS 0x60009494 /end MEASUREMENT
/begin MEASUREMENT ExhMgT_ethintkh "weighted interpolation factor for ethanol content" UWORD fak_uw_b2 1 100 0.00 1.999969 FORMAT "%8.6" ECU_ADDRESS 0x60007368 /end MEASUREMENT
/begin MEASUREMENT ExhMgT_facCatHeatgAge "control factor for desired engine efficiency for catalyst heating because of a cold start because of catalyst ageing" UBYTE fak_ub_b2 1 100 0.00 1.992188 FORMAT "%8.6" ECU_ADDRESS 0x6000B79D /end MEASUREMENT
/begin MEASUREMENT ExhMgT_facCatHeatgProgsTqDes "Catalyst heating progres for requesting a desired torque range during catalyst heating" UWORD fak_uw_b1 1 100 0.00 0.9999847 FORMAT "%9.7" ECU_ADDRESS 0x600073AA /end MEASUREMENT
/begin MEASUREMENT ExhMgT_facCatWrmSeln "factor for weighting catalyst heating request for catalysator warming" UWORD fak_uw_b2 1 100 0.00 1.999969 FORMAT "%8.6" ECU_ADDRESS 0x600073A8 /end MEASUREMENT
/begin MEASUREMENT ExhMgT_facCorrnEtaEngCatHeatg "correction factor for desired engine efficiency by catalyst heating in case of cold start" UWORD fak_q0p00781 1 100 0.00 16.00000 FORMAT "%8.5" ECU_ADDRESS 0x60007366 /end MEASUREMENT
/begin MEASUREMENT ExhMgT_facEngEffCorrnIdle "factor for correction of desired engine efficiency for catalyst heating during idle from the tester" UBYTE fak_ub_b2 1 100 0.00 1.992188 FORMAT "%8.6" ECU_ADDRESS 0x6000B79C /end MEASUREMENT
/begin MEASUREMENT ExhMgT_facEngEffCorrnPartLoad "factor for correction of desired engine efficiency for catalyst heating during part load from the tester" UBYTE fak_ub_b2 1 100 0.00 1.992188 FORMAT "%8.6" ECU_ADDRESS 0x6000B79B /end MEASUREMENT
/begin MEASUREMENT ExhMgT_facEtaCatAge "weighting factor during catalyst cold start heating depending on catalyst aging" UWORD fak_q0p00781 1 100 0.00 32.00000 FORMAT "%8.5" ECU_ADDRESS 0x60007364 /end MEASUREMENT
/begin MEASUREMENT ExhMgT_facEtaCatHeatg "control factor for desired engine efficiency by catalyst heating in case of cold start" UWORD fak_q0p00781 1 100 0.00 64.00000 FORMAT "%8.5" ECU_ADDRESS 0x60007362 /end MEASUREMENT
/begin MEASUREMENT ExhMgT_facEtaCatWrmAltiT "control factor for desired engine efficiency by catalyst heating in case of catalyst warming depending on altitude and engine temperature" UBYTE fak_ub_b2 1 100 0.00 1.992188 FORMAT "%8.6" ECU_ADDRESS 0x6000FC8F /end MEASUREMENT
/begin MEASUREMENT ExhMgT_facEtaColdStrtHeatgAltiT "control factor for desired engine efficiency by catalyst heating in case of catalyst cold start depending on altitude and engine start temperature" UBYTE fak_ub_b2 1 100 0.00 1.992188 FORMAT "%8.6" ECU_ADDRESS 0x6000FC8E /end MEASUREMENT
/begin MEASUREMENT ExhMgT_facEtaEngCatHeatg "control factor for desired engine efficiency by catalyst heating in case of cold start" UBYTE fak_ub_b2 1 100 0.00 1.992188 FORMAT "%8.6" ECU_ADDRESS 0x6000FC8D /end MEASUREMENT
/begin MEASUREMENT ExhMgT_facEtaWghCatWrm "control factor for desired engine efficiency by weighting catalyst heating for catalyst warming" UBYTE fak_ub_b2 1 100 0.00 1.992188 FORMAT "%8.6" ECU_ADDRESS 0x6000FC8C /end MEASUREMENT
/begin MEASUREMENT ExhMgt_facIntrpnCatHeatgEta "Interpolation factor idle to partload" UBYTE fak_ub_b1 1 100 0.00 0.9961 ECU_ADDRESS 0x6000B79A /end MEASUREMENT
/begin MEASUREMENT ExhMgT_facWghCatWrm "factor for weighting catalyst heating requested for catalyst warming" UWORD fak_uw_b2 1 100 0.00 1.999969 FORMAT "%8.6" ECU_ADDRESS 0x60007360 /end MEASUREMENT
/begin MEASUREMENT ExhMgT_facWghCatWrmLim "weighting factor for desired engine efficiency for catalyst warming (after change limitation)" UWORD fak_uw_b2 1 100 0.00 1.999969 FORMAT "%8.6" ECU_ADDRESS 0x6000735E /end MEASUREMENT
/begin MEASUREMENT ExhMgT_facWghCatWrmTwc "factor for weighting catalyst heating requested for three way catalyst heating (via catalyst warming measurement)" UWORD fak_uw_b2 1 100 0.00 1.999969 FORMAT "%8.6" ECU_ADDRESS 0x60014862 /end MEASUREMENT
/begin MEASUREMENT ExhMgT_fetakhllfa_msg "factor for correction of desired engine efficiency for catalyst heating during idle" UBYTE fak_ub_b2 1 100 0.00 1.992188 FORMAT "%8.6" ECU_ADDRESS 0x6000FC8B /end MEASUREMENT
/begin MEASUREMENT ExhMgT_fetakhtlfa_msg "factor for correction of desired engine efficiency for catalyst heating during part load" UBYTE fak_ub_b2 1 100 0.00 1.992188 FORMAT "%8.6" ECU_ADDRESS 0x6000FC8A /end MEASUREMENT
/begin MEASUREMENT ExhMgT_flgActvAltiBasdCorrn "flag to calculate desired engine efficiency by catalyst heating in case of cold start is calculated by consideration of interpolation of high altitude and low altitude maps" UBYTE B_TRUE 1 100 0.00 1.00000000000 BIT_MASK 0x1 FORMAT "%13.11" ECU_ADDRESS 0x6000B799 /end MEASUREMENT
/begin MEASUREMENT ExhMgT_flgAvsSetIdle "specification of the value of desired engine efficiencyfrom tester during idle" UBYTE B_TRUE 1 100 0.00 1.00000000000 BIT_MASK 0x1 FORMAT "%13.11" ECU_ADDRESS 0x6000B798 /end MEASUREMENT
/begin MEASUREMENT ExhMgT_flgAvsSetPartLoad "specification of the value of desired engine efficiencyfrom tester during part load" UBYTE B_TRUE 1 100 0.00 1.00000000000 BIT_MASK 0x1 FORMAT "%13.11" ECU_ADDRESS 0x6000B797 /end MEASUREMENT
/begin MEASUREMENT ExhMgT_flgCatHeatgBreak "enabling or disbling condition based on the catalyst heating request" UBYTE B_TRUE 1 100 0.00 1.00000000000 BIT_MASK 0x1 FORMAT "%13.11" ECU_ADDRESS 0x6000B796 /end MEASUREMENT
/begin MEASUREMENT ExhMgT_flgCatHeatgRamp "factor for raising and lowering the heating measures is used for calculation of control factor for desired engine efficiency" UBYTE B_TRUE 1 100 0.00 1.00000000000 BIT_MASK 0x1 FORMAT "%13.11" ECU_ADDRESS 0x6000B795 /end MEASUREMENT
/begin MEASUREMENT ExhMgT_flgCatHeatgRstCdn "reset condition catalyst cold start heating" UBYTE B_TRUE 1 100 0.00 1.00000000000 BIT_MASK 0x1 FORMAT "%13.11" ECU_ADDRESS 0x6000B794 /end MEASUREMENT
/begin MEASUREMENT ExhMgT_flgCatWrmEngEffIa "calculation of engine efficiency worsening in dependence of ignition angle" UBYTE B_TRUE 1 100 0.00 1.00000000000 BIT_MASK 0x1 FORMAT "%13.11" ECU_ADDRESS 0x6000B793 /end MEASUREMENT
/begin MEASUREMENT ExhMgT_flgCatWrmUp "condition for heating of catalyst (after regular catalyst heating)" UBYTE B_TRUE 1 100 0.00 1.00000000000 BIT_MASK 0x1 FORMAT "%13.11" ECU_ADDRESS 0x700001C9 /end MEASUREMENT
/begin MEASUREMENT ExhMgT_flgCatWrmUpOff "condition for retraction of torque reduction at start" UBYTE B_TRUE 1 100 0.00 1.00000000000 BIT_MASK 0x1 FORMAT "%13.11" ECU_ADDRESS 0x700001C8 /end MEASUREMENT
/begin MEASUREMENT ExhMgT_flgfacWghCatWrmActv "weighting factor for desired engine efficiency for catalyst warming greater zero" UBYTE B_TRUE 1 100 0.00 1.00000000000 BIT_MASK 0x1 FORMAT "%13.11" ECU_ADDRESS 0x6000B792 /end MEASUREMENT
/begin MEASUREMENT ExhMgT_flgLoadPntShift0 "bit0 of codeword ExhMgT_stCatHeatgLoadPntShift_C" UBYTE B_TRUE 1 100 0.00 1.00000000000 BIT_MASK 0x1 FORMAT "%13.11" ECU_ADDRESS 0x700001C7 /end MEASUREMENT
/begin MEASUREMENT ExhMgT_flgLoadPntShift1 "bit1 of codeword ExhMgT_stCatHeatgLoadPntShift_C" UBYTE B_TRUE 1 100 0.00 1.00000000000 BIT_MASK 0x1 FORMAT "%13.11" ECU_ADDRESS 0x700001C6 /end MEASUREMENT
/begin MEASUREMENT ExhMgT_flgLoadPntShift2 "bit2 of codeword ExhMgT_stCatHeatgLoadPntShift_C" UBYTE B_TRUE 1 100 0.00 1.00000000000 BIT_MASK 0x1 FORMAT "%13.11" ECU_ADDRESS 0x700001C5 /end MEASUREMENT
/begin MEASUREMENT ExhMgT_flgTqInrMaxDesWrmUp "condition for request of a prio to the engine corrdinator as lang as the desired max. torque is greater than the parameter ExhMgT_trqInrMaxDesWrmUpOff_C" UBYTE B_TRUE 1 100 0.00 1.00000000000 BIT_MASK 0x1 FORMAT "%13.11" ECU_ADDRESS 0x700001C4 /end MEASUREMENT
/begin MEASUREMENT ExhMgT_iaCatWrmIdle "desired ignition-timing for catalyst warming in idle" SWORD zw_q2p9297Em3_deg_KW 1 100 -96.00000 95.99707 FORMAT "%8.5" ECU_ADDRESS 0x6000735C /end MEASUREMENT
/begin MEASUREMENT ExhMgT_iaCatWrmPartLoad "desired ignition-timing for catalyst warming during part load" SWORD zw_q2p9297Em3_deg_KW 1 100 -96.00000 95.99707 FORMAT "%8.5" ECU_ADDRESS 0x6000735A /end MEASUREMENT
/begin MEASUREMENT ExhMgT_nMaxDes "max. engine speed for catalyst heating" SWORD EngN 1 100 -16384.00 16383.50 FORMAT "%8.2" ECU_ADDRESS 0x60014864 /end MEASUREMENT
/begin MEASUREMENT ExhMgT_nMinDes "min. engine speed for catalyst heating" SWORD EngN 1 100 -16384.00 16383.50 FORMAT "%8.2" ECU_ADDRESS 0x60014866 /end MEASUREMENT
/begin MEASUREMENT ExhMgT_stOperModDmdWrmUp "request of an operation state of the power train to the hybrid coordinator (after regular catalyst heating)" UWORD dez 1 100 0.00 65535.00 FORMAT "%8.2" ECU_ADDRESS 0x60014868 /end MEASUREMENT
/begin MEASUREMENT ExhMgT_stPrioWpDmdHyb "priority of requested operating conditions for catalyst heating" UBYTE OneToOne 1 100 0.00 255.0 FORMAT "%5.1" ECU_ADDRESS 0x60014AB8 /end MEASUREMENT
/begin MEASUREMENT ExhMgT_stPrioWrmUp "priority request operation mode request for operation point for heating of catalyst (after regular catalyst heating)" UBYTE OneToOne 1 100 0.00 255.0 FORMAT "%5.1" ECU_ADDRESS 0x60014AB9 /end MEASUREMENT
/begin MEASUREMENT ExhMgT_stReqOperModDmd "request of an operation state of the power train to the hybrid coordinator" UWORD dez 1 100 0.00 65535.00 FORMAT "%8.2" ECU_ADDRESS 0x6001486A /end MEASUREMENT
/begin MEASUREMENT ExhMgT_tEngCatHeatgDif "rate of change of engine temperature" UWORD temp_q0p1_K 1 100 0.00 6553.500 FORMAT "%8.3" ECU_ADDRESS 0x60007358 /end MEASUREMENT
/begin MEASUREMENT ExhMgT_tEngCatHeatgFild "filtered engine temperature for catalyst heating" SWORD Temp_Cels 1 100 -3549.940 3003.560 FORMAT "%8.3" ECU_ADDRESS 0x6000999C /end MEASUREMENT
/begin MEASUREMENT ExhMgT_tOilMdlCatHeatg "Modelled Oil temperature at the beginning of cold start heating" SWORD Temp_Cels 1 100 -3549.940 3003.560 FORMAT "%8.3" ECU_ADDRESS 0x60007356 /end MEASUREMENT
/begin MEASUREMENT ExhMgT_tqMaxDesCatWrmIdleLoad "Maximum desired torque for catalyst heating (catalyst warming) in dependence of catalyst temperature by idle load" UWORD rel_uw_b100 1 100 0.00 99.99847 FORMAT "%8.5" ECU_ADDRESS 0x600073A6 /end MEASUREMENT
/begin MEASUREMENT ExhMgT_tqMaxDesCatWrmPtlLoad "Maximum desired torque for catalyst heating (catalyst warming) in dependence of catalyst temperature by part load" UWORD rel_uw_b100 1 100 0.00 99.99847 FORMAT "%8.5" ECU_ADDRESS 0x600073A4 /end MEASUREMENT
/begin MEASUREMENT ExhMgT_tqMinDesCatWrmIdleLoad "Minimum desired torque for catalyst heating (catalyst warming) in dependence of catalyst temperature by idle load" UWORD rel_uw_b100 1 100 0.00 99.99847 FORMAT "%8.5" ECU_ADDRESS 0x600073A2 /end MEASUREMENT
/begin MEASUREMENT ExhMgT_tqMinDesCatWrmPtlLoad "Minimum desired torque for catalyst heating (catalyst warming) in dependence of catalyst temperature by part load" UWORD rel_uw_b100 1 100 0.00 99.99847 FORMAT "%8.5" ECU_ADDRESS 0x600073A0 /end MEASUREMENT
/begin MEASUREMENT ExhMgT_trqInrDes "inner torque" SWORD Trq 1 100 -3276.800 3276.700 FORMAT "%8.3" ECU_ADDRESS 0x6000739E /end MEASUREMENT
/begin MEASUREMENT ExhMgT_trqInrMaxDes "max. torque for catalyst heating" SWORD trq_q0p1 1 100 -3276.800 3276.700 FORMAT "%8.3" ECU_ADDRESS 0x60014878 /end MEASUREMENT
/begin MEASUREMENT ExhMgT_trqInrMaxDesDiag "max. torque for catalyst heating (for diagnosis)" SWORD trq_q0p1 1 100 -3276.800 3276.700 FORMAT "%8.3" ECU_ADDRESS 0x6001487A /end MEASUREMENT
/begin MEASUREMENT ExhMgT_trqInrMaxDesWrmUp "maximal desired torque for heating of catalyst (after regular catalyst heating)" SWORD trq_q0p1 1 100 -3276.800 3276.700 FORMAT "%8.3" ECU_ADDRESS 0x6001487C /end MEASUREMENT
/begin MEASUREMENT ExhMgT_trqInrMaxDesWrmUpRaw "raw value maximal desired torque for heating of catalyst (after regular catalyst heating)" SWORD trq_q0p1 1 100 -3276.800 3276.700 FORMAT "%8.3" ECU_ADDRESS 0x6000739C /end MEASUREMENT
/begin MEASUREMENT ExhMgT_trqInrMinDes "min. torque for catalyst heating" SWORD trq_q0p1 1 100 -3276.800 3276.700 FORMAT "%8.3" ECU_ADDRESS 0x6001487E /end MEASUREMENT
/begin MEASUREMENT ExhMgT_trqInrMinDesDiag "min. torque for catalyst heating (for diagnosis)" SWORD trq_q0p1 1 100 -3276.800 3276.700 FORMAT "%8.3" ECU_ADDRESS 0x60014880 /end MEASUREMENT
/begin MEASUREMENT ExhMgT_trqInrMinDesWrmUp "minimal desired torque for heating of catalyst (after regular catalyst heating)" SWORD trq_q0p1 1 100 -3276.800 3276.700 FORMAT "%8.3" ECU_ADDRESS 0x60014882 /end MEASUREMENT
/begin MEASUREMENT ExhMgT_tTrqCatHeatg "engine temperature at beginning of catalyst heating phase" SWORD Temp_Cels 1 100 -3549.940 3003.560 FORMAT "%8.3" ECU_ADDRESS 0x6000739A /end MEASUREMENT
/begin MEASUREMENT ExhMgT_tWarmUpSeln "temperature selection durning catalyst warm up either from coolant temperature or oil temperature" SWORD Temp_Cels 1 100 -3549.940 3003.560 FORMAT "%8.3" ECU_ADDRESS 0x60007398 /end MEASUREMENT
/begin MEASUREMENT fstkttmsfh "control factor for desired engine efficiency by catalyst heating in case of cold start in dependence of engine start temperature and altitude" UBYTE fak_ub_b2 1 100 0.00 1.992188 FORMAT "%8.6" ECU_ADDRESS 0x6000B791 /end MEASUREMENT
/begin MEASUREMENT fwetakhkt_msg "weighting factor for desired engine efficiency by catalyst heating in case of cold start" UBYTE fak_ub_b1 1 100 0.00 0.9961 ECU_ADDRESS 0x6000FB42 /end MEASUREMENT
/begin MEASUREMENT fwsanfdlut_msg "weighting factor for engine efficiency in case of catalyst heating by cold start in dependence on irregular running" UBYTE fak_ub_b2 1 100 0.00 1.992188 FORMAT "%8.6" ECU_ADDRESS 0x6000FB41 /end MEASUREMENT
/begin MEASUREMENT InjSys_flgCutOffReqTyp1 "Condition full cutoff request type 1" UBYTE B_TRUE 1 100 0.00 1.00000000000 BIT_MASK 0x1 FORMAT "%13.11" ECU_ADDRESS 0x70000888 /end MEASUREMENT
/begin MEASUREMENT InjVvG_desCylMsk "demanded cylinders at coordinator for base adaption as bitmask" UWORD dez 1 100 0.00 65535.00 FORMAT "%8.2" ECU_ADDRESS 0x70001D34 /end MEASUREMENT
/begin MEASUREMENT InjVvG_desTiAry "demanded injection time at coordinator for base adaption for every cylinder" UWORD t_q0p001_ms 1 100 0.00 65.53500 FORMAT "%8.5" ARRAY_SIZE 4 ECU_ADDRESS 0x70001D2C /end MEASUREMENT
/begin MEASUREMENT IVGdiCtl_cntrCvoAllCylErr "number of cylinders in error state due to cvo diagnose (max-min errors)" UBYTE dez 1 100 0.00 255.0 FORMAT "%5.1" ECU_ADDRESS 0x700024F0 /end MEASUREMENT
/begin MEASUREMENT IVGdiCtl_cntrCvoCylMinMaxErrTstd "number of tested cylinders against min-max error (cvo diagnose)" UBYTE dez 1 100 0.00 255.0 FORMAT "%5.1" ECU_ADDRESS 0x700024EF /end MEASUREMENT
/begin MEASUREMENT IVGdiCtl_cntrCvoCylMinOrMaxErrTstd "number of tested cylinders against min or max error (cvo diagnose)" UBYTE dez 1 100 0.00 255.0 FORMAT "%5.1" ECU_ADDRESS 0x700024EE /end MEASUREMENT
/begin MEASUREMENT IVGdiCtl_cntrCvoDeltaTiOpenErrTolrMax "error counter for dTopen adaption value out of max-tolerance range" UBYTE dez 1 100 0.00 255.0 FORMAT "%5.1" ARRAY_SIZE 4 ECU_ADDRESS 0x700024EA /end MEASUREMENT
/begin MEASUREMENT IVGdiCtl_cntrCvoDeltaTiOpenErrTolrMin "error counter for dTopen adaption value out of min-tolerance range" UBYTE dez 1 100 0.00 255.0 FORMAT "%5.1" ARRAY_SIZE 4 ECU_ADDRESS 0x700024E6 /end MEASUREMENT
/begin MEASUREMENT IVGdiCtl_cntrCvoDiagCyl "CVO Diag software cylinder counter negative one" UBYTE dez 1 100 0.00 255.0 FORMAT "%5.1" ECU_ADDRESS 0x700024E5 /end MEASUREMENT
/begin MEASUREMENT IVGdiCtl_cntrCvoDiagCylTmp "CVO Diag software cylinder counter temporary" UBYTE dez 1 100 0.00 255.0 FORMAT "%5.1" ECU_ADDRESS 0x700024E4 /end MEASUREMENT
/begin MEASUREMENT IVGdiCtl_cntrCvoDiagNoTabErr "error counter for no tab found" UBYTE dez 1 100 0.00 255.0 FORMAT "%5.1" ARRAY_SIZE 4 ECU_ADDRESS 0x700024E0 /end MEASUREMENT
/begin MEASUREMENT IVGdiCtl_cntrCvoDiagNoTabHeal "heal counter for no tab found" UBYTE dez 1 100 0.00 255.0 FORMAT "%5.1" ARRAY_SIZE 4 ECU_ADDRESS 0x700024DC /end MEASUREMENT
/begin MEASUREMENT IVGdiCtl_cntrCvoInjBall "Counter: number of ballistic injections (Similar conditions range)" UWORD dez 1 100 0.00 65535.00 FORMAT "%8.2" ARRAY_SIZE 4 ECU_ADDRESS 0x700024D4 /end MEASUREMENT
/begin MEASUREMENT IVGdiCtl_cntrCvoInjFull "Counter: number of full-lift injections (Similar conditions range)" UWORD dez 1 100 0.00 65535.00 FORMAT "%8.2" ARRAY_SIZE 4 ECU_ADDRESS 0x700024CC /end MEASUREMENT
/begin MEASUREMENT IVGdiCtl_cntrCvoInjFullEnaTestBall "counter full lift injection to activate ballistic test injection" UWORD dez 1 100 0.00 65535.00 FORMAT "%8.2" ARRAY_SIZE 4 ECU_ADDRESS 0x700024C4 /end MEASUREMENT
/begin MEASUREMENT IVGdiCtl_cntrCvoInjTestBall "counter ballistic test injection" UWORD dez 1 100 0.00 65535.00 FORMAT "%8.2" ARRAY_SIZE 4 ECU_ADDRESS 0x700024BC /end MEASUREMENT
/begin MEASUREMENT IVGdiCtl_cntrCvoSigEvlnErr "error counter for signal evaluation" UWORD dez 1 100 0.00 65535.00 FORMAT "%8.2" ARRAY_SIZE 4 ECU_ADDRESS 0x700024B4 /end MEASUREMENT
/begin MEASUREMENT IVGdiCtl_cntrCvoSigEvlnErrMilOff "counter to switch off the Mil for signal evaluation" UBYTE dez 1 100 0.00 255.0 FORMAT "%5.1" ARRAY_SIZE 4 ECU_ADDRESS 0x6003928C /end MEASUREMENT
/begin MEASUREMENT IVGdiCtl_cntrCvoSigEvlnErrMilOn "counter to switch on the Mil for signal evaluation" UBYTE dez 1 100 0.00 255.0 FORMAT "%5.1" ARRAY_SIZE 4 ECU_ADDRESS 0x60039288 /end MEASUREMENT
/begin MEASUREMENT IVGdiCtl_cntrCvoSigEvlnHeal "heal counter of signal evaluation" UWORD dez 1 100 0.00 65535.00 FORMAT "%8.2" ARRAY_SIZE 4 ECU_ADDRESS 0x700024AC /end MEASUREMENT
/begin MEASUREMENT IVGdiCtl_cntrCvoVlvClsTiErrTolrMax "error counter for full lift tab out of max-tolerance boundaries" UBYTE dez 1 100 0.00 255.0 FORMAT "%5.1" ARRAY_SIZE 4 ECU_ADDRESS 0x700024A7 /end MEASUREMENT
/begin MEASUREMENT IVGdiCtl_cntrCvoVlvClsTiErrTolrMin "error counter for full lift tab out of min-tolerance boundaries" UBYTE dez 1 100 0.00 255.0 FORMAT "%5.1" ARRAY_SIZE 4 ECU_ADDRESS 0x700024A3 /end MEASUREMENT
/begin MEASUREMENT IVGdiCtl_cntrCvoVlvClsTiHealTolrMax "healing counter for full lift tab value out of max-tolerance range" UBYTE dez 1 100 0.00 255.0 FORMAT "%5.1" ARRAY_SIZE 4 ECU_ADDRESS 0x7000249F /end MEASUREMENT
/begin MEASUREMENT IVGdiCtl_cntrCvoVlvClsTiHealTolrMin "healing counter for full lift tab value out of min-tolerance range" UBYTE dez 1 100 0.00 255.0 FORMAT "%5.1" ARRAY_SIZE 4 ECU_ADDRESS 0x7000249B /end MEASUREMENT
/begin MEASUREMENT IVGdiCtl_cntrCvoVlvDlyTiErrTolrMax "Error counter: learned tantot above max-tolerance range to the default tantot successive" UBYTE dez 1 100 0.00 255.0 FORMAT "%5.1" ARRAY_SIZE 4 ECU_ADDRESS 0x70002497 /end MEASUREMENT
/begin MEASUREMENT IVGdiCtl_cntrCvoVlvDlyTiErrTolrMin "Error counter: learned tantot below min-tolerance range to the default tantot successive" UBYTE dez 1 100 0.00 255.0 FORMAT "%5.1" ARRAY_SIZE 4 ECU_ADDRESS 0x70002493 /end MEASUREMENT
/begin MEASUREMENT IVGdiCtl_cntrErrTolrRngDeltaTiBallMax "Error counter: total ballistic dti outside max tolerance range successive" UBYTE dez 1 100 0.00 255.0 FORMAT "%5.1" ARRAY_SIZE 4 ECU_ADDRESS 0x7000248F /end MEASUREMENT
/begin MEASUREMENT IVGdiCtl_cntrErrTolrRngDeltaTiBallMin "Error counter: total ballistic dti outside min tolerance range successive" UBYTE dez 1 100 0.00 255.0 FORMAT "%5.1" ARRAY_SIZE 4 ECU_ADDRESS 0x7000248B /end MEASUREMENT
/begin MEASUREMENT IVGdiCtl_cntrErrTolrRngDeltaTiFullMax "error counter for total full lift dti out of max-tolerance boundaries" UBYTE dez 1 100 0.00 255.0 FORMAT "%5.1" ARRAY_SIZE 4 ECU_ADDRESS 0x70002487 /end MEASUREMENT
/begin MEASUREMENT IVGdiCtl_cntrErrTolrRngDeltaTiFullMin "error counter for total full lift dti out of min-tolerance boundaries" UBYTE dez 1 100 0.00 255.0 FORMAT "%5.1" ARRAY_SIZE 4 ECU_ADDRESS 0x70002483 /end MEASUREMENT
/begin MEASUREMENT IVGdiCtl_cntrHealTolrRngDeltaTiBallMax "healing counter for ballistic total dti out of max-tolerance range" UBYTE dez 1 100 0.00 255.0 FORMAT "%5.1" ARRAY_SIZE 4 ECU_ADDRESS 0x7000247F /end MEASUREMENT
/begin MEASUREMENT IVGdiCtl_cntrHealTolrRngDeltaTiBallMin "healing counter for ballistic total dti out of min-tolerance range" UBYTE dez 1 100 0.00 255.0 FORMAT "%5.1" ARRAY_SIZE 4 ECU_ADDRESS 0x7000247B /end MEASUREMENT
/begin MEASUREMENT IVGdiCtl_cntrHealTolrRngDeltaTiFullMax "healing counter for full lift total dti out of max-tolerance range" UBYTE dez 1 100 0.00 255.0 FORMAT "%5.1" ARRAY_SIZE 4 ECU_ADDRESS 0x70002477 /end MEASUREMENT
/begin MEASUREMENT IVGdiCtl_cntrHealTolrRngDeltaTiFullMin "healing counter for full lift total dti out of min-tolerance range" UBYTE dez 1 100 0.00 255.0 FORMAT "%5.1" ARRAY_SIZE 4 ECU_ADDRESS 0x70002473 /end MEASUREMENT
/begin MEASUREMENT IVGdiCtl_cntrMaxCvoDiagErrMilOff "counter to switch off the Mil for the CVODiag Max monitoring" UBYTE dez 1 100 0.00 255.0 FORMAT "%5.1" ARRAY_SIZE 4 ECU_ADDRESS 0x60039284 /end MEASUREMENT
/begin MEASUREMENT IVGdiCtl_cntrMaxCvoDiagErrMilOffCopy "Counter to switch off the Mil for the CVODiag Max monitoring" UBYTE dez 1 100 0.00 255.0 FORMAT "%5.1" ARRAY_SIZE 4 ECU_ADDRESS 0x60039280 /end MEASUREMENT
/begin MEASUREMENT IVGdiCtl_cntrMaxCvoDiagErrMilOn "counter to switch on the Mil for the CVODiag Max monitoring" UBYTE dez 1 100 0.00 255.0 FORMAT "%5.1" ARRAY_SIZE 4 ECU_ADDRESS 0x6003927C /end MEASUREMENT
/begin MEASUREMENT IVGdiCtl_cntrMaxCvoDiagErrMilOnCopy "Counter to switch on the Mil for the CVODiag Max monitoring" UBYTE dez 1 100 0.00 255.0 FORMAT "%5.1" ARRAY_SIZE 4 ECU_ADDRESS 0x60039278 /end MEASUREMENT
/begin MEASUREMENT IVGdiCtl_cntrMinCvoDiagErrMilOff "counter to switch off the Mil for the CVODiag Min monitoring" UBYTE dez 1 100 0.00 255.0 FORMAT "%5.1" ARRAY_SIZE 4 ECU_ADDRESS 0x60039274 /end MEASUREMENT
/begin MEASUREMENT IVGdiCtl_cntrMinCvoDiagErrMilOffCopy "Counter to switch off the Mil for the CVODiag Min monitoring" UBYTE dez 1 100 0.00 255.0 FORMAT "%5.1" ARRAY_SIZE 4 ECU_ADDRESS 0x60039270 /end MEASUREMENT
/begin MEASUREMENT IVGdiCtl_cntrMinCvoDiagErrMilOn "counter to switch on the Mil for the CVODiag Min monitoring" UBYTE dez 1 100 0.00 255.0 FORMAT "%5.1" ARRAY_SIZE 4 ECU_ADDRESS 0x6003926C /end MEASUREMENT
/begin MEASUREMENT IVGdiCtl_cntrMinCvoDiagErrMilOnCopy "Counter to switch on the Mil for the CVODiag Min monitoring" UBYTE dez 1 100 0.00 255.0 FORMAT "%5.1" ARRAY_SIZE 4 ECU_ADDRESS 0x60039268 /end MEASUREMENT
/begin MEASUREMENT IVGdiCtl_cntrNewBaseAdpnByPhy "Number of requested base adaption" UBYTE dez 1 100 0.00 255.0 FORMAT "%5.1" ARRAY_SIZE 4 ECU_ADDRESS 0x7000246F /end MEASUREMENT
/begin MEASUREMENT IVGdiCtl_CvoDiag_ctReIni "Local counter to signal the execution of ReIni task" UBYTE OneToOne 1 100 0.00 255.0 FORMAT "%5.1" ECU_ADDRESS 0x7000246E /end MEASUREMENT
/begin MEASUREMENT IVGdiCtl_CvoDiag_currDeltaTiBall "Delta-Ti array about cylinder and pulse" SWORD t_q0p1 1 100 -3276.800 3276.700 FORMAT "%8.3" ARRAY_SIZE 16 ECU_ADDRESS 0x7000244E /end MEASUREMENT
/begin MEASUREMENT IVGdiCtl_CvoDiag_currDeltaTiFull "Delta-Ti array about cylinder and pulse" SWORD t_q0p1 1 100 -3276.800 3276.700 FORMAT "%8.3" ARRAY_SIZE 16 ECU_ADDRESS 0x7000242E /end MEASUREMENT
/begin MEASUREMENT IVGdiCtl_CvoDiag_DeltaTiOpenMax_I.IVGdiCtl_flgReqBascAdpn "Class: for Delta-TiOpen max-error reactions / delta injection open time target to actual" UBYTE B_TRUE 1 100 0.00 1.00000000000 BIT_MASK 0x1 FORMAT "%13.11" ECU_ADDRESS 0x700022C3 /end MEASUREMENT
/begin MEASUREMENT IVGdiCtl_CvoDiag_DeltaTiOpenMin_I.IVGdiCtl_flgReqBascAdpn "Class: for Delta-TiOpen min-error reactions / delta injection open time target to actual" UBYTE B_TRUE 1 100 0.00 1.00000000000 BIT_MASK 0x1 FORMAT "%13.11" ECU_ADDRESS 0x700022C2 /end MEASUREMENT
/begin MEASUREMENT IVGdiCtl_CvoDiag_desTiOpen "Desired open time Ti" UWORD t_q1p0_us 1 100 0.00 65535.00 FORMAT "%8.2" ECU_ADDRESS 0x7000242C /end MEASUREMENT
/begin MEASUREMENT IVGdiCtl_CvoDiag_DTiErrHealBalMax_I.IVGdiCtl_flgReqBascAdpn "Class: for Delta-Ti max-error reactions (ballistic) / DTI error and healing at ballistic injection" UBYTE B_TRUE 1 100 0.00 1.00000000000 BIT_MASK 0x1 FORMAT "%13.11" ECU_ADDRESS 0x700022CC /end MEASUREMENT
/begin MEASUREMENT IVGdiCtl_CvoDiag_DTiErrHealBalMax_I.IVGdiCtl_stErrSuspcDeltaTi "Class: for Delta-Ti max-error reactions (ballistic) / DTI error and healing at ballistic injection" UBYTE B_TRUE 1 100 0.00 1.00000000000 BIT_MASK 0x1 FORMAT "%13.11" ECU_ADDRESS 0x700022CD /end MEASUREMENT
/begin MEASUREMENT IVGdiCtl_CvoDiag_DTiErrHealBalMax_I.IVGdiCtl_stNewBascAdpn "Class: for Delta-Ti max-error reactions (ballistic) / Status: new base adaption requested (block ballistic injection)" UBYTE OneToOne 1 100 0.00 255.0 FORMAT "%5.1" ECU_ADDRESS 0x700022CE /end MEASUREMENT
/begin MEASUREMENT IVGdiCtl_CvoDiag_DTiErrHealBalMax_I._tmp1 "Class: for Delta-Ti max-error reactions (ballistic) / error healing balistic injection delta Ti" UBYTE B_TRUE 1 100 0.00 1.00000000000 BIT_MASK 0x1 FORMAT "%13.11" ECU_ADDRESS 0x700022CF /end MEASUREMENT
/begin MEASUREMENT IVGdiCtl_CvoDiag_DTiErrHealBalMin_I.IVGdiCtl_flgReqBascAdpn "Class: for Delta-Ti min-error reactions (ballistic) / DTI error and healing at ballistic injection" UBYTE B_TRUE 1 100 0.00 1.00000000000 BIT_MASK 0x1 FORMAT "%13.11" ECU_ADDRESS 0x700022C8 /end MEASUREMENT
/begin MEASUREMENT IVGdiCtl_CvoDiag_DTiErrHealBalMin_I.IVGdiCtl_stErrSuspcDeltaTi "Class: for Delta-Ti min-error reactions (ballistic) / DTI error and healing at ballistic injection" UBYTE B_TRUE 1 100 0.00 1.00000000000 BIT_MASK 0x1 FORMAT "%13.11" ECU_ADDRESS 0x700022C9 /end MEASUREMENT
/begin MEASUREMENT IVGdiCtl_CvoDiag_DTiErrHealBalMin_I.IVGdiCtl_stNewBascAdpn "Class: for Delta-Ti min-error reactions (ballistic) / Status: new base adaption requested (block ballistic injection)" UBYTE OneToOne 1 100 0.00 255.0 FORMAT "%5.1" ECU_ADDRESS 0x700022CA /end MEASUREMENT
/begin MEASUREMENT IVGdiCtl_CvoDiag_DTiErrHealBalMin_I._tmp1 "Class: for Delta-Ti min-error reactions (ballistic) / error healing balistic injection delta Ti" UBYTE B_TRUE 1 100 0.00 1.00000000000 BIT_MASK 0x1 FORMAT "%13.11" ECU_ADDRESS 0x700022CB /end MEASUREMENT
/begin MEASUREMENT IVGdiCtl_CvoDiag_DTiErrHealFullMax_I.IVGdiCtl_stErrSuspcDeltaTi "Class: for Delta-Ti max-error reactions (fulllift) / DTI error and healing at full lift injection" UBYTE B_TRUE 1 100 0.00 1.00000000000 BIT_MASK 0x1 FORMAT "%13.11" ECU_ADDRESS 0x700022C6 /end MEASUREMENT
/begin MEASUREMENT IVGdiCtl_CvoDiag_DTiErrHealFullMax_I.IVGdiCtl_stNewBascAdpn "Class: for Delta-Ti max-error reactions (fulllift) / Status: new base adaption requested (full lift injection)" UBYTE OneToOne 1 100 0.00 255.0 FORMAT "%5.1" ECU_ADDRESS 0x700022C7 /end MEASUREMENT
/begin MEASUREMENT IVGdiCtl_CvoDiag_DTiErrHealFullMin_I.IVGdiCtl_stErrSuspcDeltaTi "Class: for Delta-Ti min-error reactions (fulllift) / DTI error and healing at full lift injection" UBYTE B_TRUE 1 100 0.00 1.00000000000 BIT_MASK 0x1 FORMAT "%13.11" ECU_ADDRESS 0x700022C4 /end MEASUREMENT
/begin MEASUREMENT IVGdiCtl_CvoDiag_DTiErrHealFullMin_I.IVGdiCtl_stNewBascAdpn "Class: for Delta-Ti min-error reactions (fulllift) / Status: new base adaption requested (full lift injection)" UBYTE OneToOne 1 100 0.00 255.0 FORMAT "%5.1" ECU_ADDRESS 0x700022C5 /end MEASUREMENT
/begin MEASUREMENT IVGdiCtl_CvoDiag_stBallDeltaTiErrMax "Pulse individuell status mask for delta ti maximum error" UBYTE dez 1 100 0.00 255.0 FORMAT "%5.1" ARRAY_SIZE 4 ECU_ADDRESS 0x70002428 /end MEASUREMENT
/begin MEASUREMENT IVGdiCtl_CvoDiag_stBallDeltaTiErrMin "Pulse individuell status mask for delta ti maximum error" UBYTE dez 1 100 0.00 255.0 FORMAT "%5.1" ARRAY_SIZE 4 ECU_ADDRESS 0x70002424 /end MEASUREMENT
/begin MEASUREMENT IVGdiCtl_CvoDiag_stBallDeltaTiHealMax "Pulse individuell status mask for delta ti maximum heal" UBYTE dez 1 100 0.00 255.0 FORMAT "%5.1" ARRAY_SIZE 4 ECU_ADDRESS 0x70002420 /end MEASUREMENT
/begin MEASUREMENT IVGdiCtl_CvoDiag_stBallDeltaTiHealMin "Pulse individuell status mask for delta ti minimum heal" UBYTE dez 1 100 0.00 255.0 FORMAT "%5.1" ARRAY_SIZE 4 ECU_ADDRESS 0x7000241C /end MEASUREMENT
/begin MEASUREMENT IVGdiCtl_CvoDiag_stFullDeltaTiErrMax "Pulse individuell status mask for delta ti maximum error" UBYTE dez 1 100 0.00 255.0 FORMAT "%5.1" ARRAY_SIZE 4 ECU_ADDRESS 0x70002418 /end MEASUREMENT
/begin MEASUREMENT IVGdiCtl_CvoDiag_stFullDeltaTiErrMin "Pulse individuell status mask for delta ti minimum error" UBYTE dez 1 100 0.00 255.0 FORMAT "%5.1" ARRAY_SIZE 4 ECU_ADDRESS 0x70002414 /end MEASUREMENT
/begin MEASUREMENT IVGdiCtl_CvoDiag_stFullDeltaTiHealMax "Pulse individuell status mask for delta ti maximum heal" UBYTE dez 1 100 0.00 255.0 FORMAT "%5.1" ARRAY_SIZE 4 ECU_ADDRESS 0x70002410 /end MEASUREMENT
/begin MEASUREMENT IVGdiCtl_CvoDiag_stFullDeltaTiHealMin "Pulse individuell status mask for delta ti minimum heal" UBYTE dez 1 100 0.00 255.0 FORMAT "%5.1" ARRAY_SIZE 4 ECU_ADDRESS 0x7000240C /end MEASUREMENT
/begin MEASUREMENT IVGdiCtl_CvoDiag_TantotErrHealMax_I.IVGdiCtl_flgReqBascAdpn "Class: for Tantot max-error reactions / Block: error and healing of tantot" UBYTE B_TRUE 1 100 0.00 1.00000000000 BIT_MASK 0x1 FORMAT "%13.11" ECU_ADDRESS 0x700022C1 /end MEASUREMENT
/begin MEASUREMENT IVGdiCtl_CvoDiag_TantotErrHealMin_I.IVGdiCtl_flgReqBascAdpn "Class: for Tantot min-error reactions / Block: error and healing of tantot" UBYTE B_TRUE 1 100 0.00 1.00000000000 BIT_MASK 0x1 FORMAT "%13.11" ECU_ADDRESS 0x700022C0 /end MEASUREMENT
/begin MEASUREMENT IVGdiCtl_CvoDiag_tiVcosDeltaAdpnLimNeg "Min threshold delta ti base on viscocity" SWORD t_q0p1_us 1 100 -3276.800 3276.700 FORMAT "%8.3" ECU_ADDRESS 0x7000240A /end MEASUREMENT
/begin MEASUREMENT IVGdiCtl_CvoDiag_tiVcosDeltaAdpnLimPos "Max threshold delta ti based on viscocity in ballistic area" SWORD t_q0p1_us 1 100 -3276.800 3276.700 FORMAT "%8.3" ECU_ADDRESS 0x70002408 /end MEASUREMENT
/begin MEASUREMENT IVGdiCtl_CvoDiag_tiVcosNegTolrDftCvoVlvDly "Min threshold tantot based on viscosity" SWORD t_q0p1_us 1 100 -3276.800 3276.700 FORMAT "%8.3" ECU_ADDRESS 0x70002406 /end MEASUREMENT
/begin MEASUREMENT IVGdiCtl_CvoDiag_tiVcosPosTolrDftCvoVlvDly "Max threshold tantot based on viscosity" SWORD t_q0p1_us 1 100 -3276.800 3276.700 FORMAT "%8.3" ECU_ADDRESS 0x70002404 /end MEASUREMENT
/begin MEASUREMENT IVGdiCtl_CvoSigAcq_AcqCtr "Counter for executed CVO (Controlled Valve Operation) measurements" UWORD dez 1 100 0.00 65535.00 FORMAT "%8.2" ECU_ADDRESS 0x700022A6 /end MEASUREMENT
/begin MEASUREMENT IVGdiCtl_CvoSigAcq_deltaTmeasBegin "CVO measurement delay" ULONG tns_q1 1 100 0.00 4294967295.00 FORMAT "%13.2" ECU_ADDRESS 0x700022BC /end MEASUREMENT
/begin MEASUREMENT IVGdiCtl_CvoSigAcq_ErrorFlg "error flags for CVO data aquisition" UWORD dez 1 100 0.00 65535.00 FORMAT "%8.2" ECU_ADDRESS 0x700022B8 /end MEASUREMENT
/begin MEASUREMENT IVGdiCtl_CvoSigAcq_InfoFlg "Info flags about the state of the data aquisiton" UWORD dez 1 100 0.00 65535.00 FORMAT "%8.2" ECU_ADDRESS 0x700022B6 /end MEASUREMENT
/begin MEASUREMENT IVGdiCtl_CvoSigAcq_MeasChl "channel number of the CVO measurement" UBYTE dez 1 100 0.00 255.0 FORMAT "%5.1" ECU_ADDRESS 0x700022B4 /end MEASUREMENT
/begin MEASUREMENT IVGdiCtl_CvoSigAcq_MeasTi "injection time of the measurement injection" ULONG tns_q1 1 100 0.00 4294967295.00 FORMAT "%13.2" ECU_ADDRESS 0x700022B0 /end MEASUREMENT
/begin MEASUREMENT IVGdiCtl_CvoSigAcq_StartedMeasCtr "counter for started CVO measurements" UWORD dez 1 100 0.00 65535.00 FORMAT "%8.2" ECU_ADDRESS 0x700022AC /end MEASUREMENT
/begin MEASUREMENT IVGdiCtl_CvoSigAcq_tADCRed "ADC output sample rate of the CVO data aquisition" UWORD tns_q1 1 100 0.00 65535.00 FORMAT "%8.2" ECU_ADDRESS 0x700022AA /end MEASUREMENT
/begin MEASUREMENT IVGdiCtl_CvoSigAcq_tGate "gate open time for the CVO data aquisition" UWORD t_q0p4us 1 100 0.00 26214.00 FORMAT "%8.2" ECU_ADDRESS 0x700022A8 /end MEASUREMENT
/begin MEASUREMENT IVGdiCtl_CvoSigEvln_AcqCtr "counter for executed controlled valve operation (CVO) measurements from the signal evaluation module" UWORD dez 1 100 0.00 65535.00 FORMAT "%8.2" ECU_ADDRESS 0x70001D3A /end MEASUREMENT
/begin MEASUREMENT IVGdiCtl_CvoSigEvln_CsersAcqCntr "Counter counting CVO measurements during regular operation" UWORD dez 1 100 0.00 65535.00 FORMAT "%8.2" ECU_ADDRESS 0x70001D38 /end MEASUREMENT
/begin MEASUREMENT IVGdiCtl_CvoSigEvln_CsersCyl "Cylinder of last CVO measurement" UBYTE dez 1 100 0.00 255.0 FORMAT "%5.1" ECU_ADDRESS 0x70001D4D /end MEASUREMENT
/begin MEASUREMENT IVGdiCtl_CvoSigEvln_CsersPulse "number of last measured injection pulse" UBYTE dez 1 100 0.00 255.0 FORMAT "%5.1" ECU_ADDRESS 0x70001D4C /end MEASUREMENT
/begin MEASUREMENT IVGdiCtl_CvoSigEvln_CsersTab "injector closing delay of last CVO measurement" UWORD t_q0p1_us 1 100 0.00 6553.500 FORMAT "%8.3" ECU_ADDRESS 0x70001D36 /end MEASUREMENT
/begin MEASUREMENT IVGdiCtl_CvoSigEvln_Status "status of signal evaluation" UBYTE CvoSigEvln_Status_t 1 100 0.00 10.0000000000 FORMAT "%13.10" ARRAY_SIZE 4 ECU_ADDRESS 0x70001D48 /end MEASUREMENT
/begin MEASUREMENT IVGdiCtl_cylCvoDiagSigEval "current checked cylinder of the signal evaluation monitoring" UBYTE dez 1 100 0.00 255.0 FORMAT "%5.1" ECU_ADDRESS 0x70002403 /end MEASUREMENT
/begin MEASUREMENT IVGdiCtl_cylCvoDiagTab "current checked cylinder of the full lift close time monitoring" UBYTE dez 1 100 0.00 255.0 FORMAT "%5.1" ECU_ADDRESS 0x70002402 /end MEASUREMENT
/begin MEASUREMENT IVGdiCtl_cylCvoDiagTantot "current checked cylinder of the tantot plausibility monitoring" UBYTE dez 1 100 0.00 255.0 FORMAT "%5.1" ECU_ADDRESS 0x70002401 /end MEASUREMENT
/begin MEASUREMENT IVGdiCtl_flgAdpnCmpl "Flag: Controller is enabled and adaption is valid" UBYTE B_TRUE 1 100 0.00 1.00000000000 BIT_MASK 0x1 FORMAT "%13.11" ECU_ADDRESS 0x70002400 /end MEASUREMENT
/begin MEASUREMENT IVGdiCtl_flgAdpnDeltaTiErrMax "Status: Max-Error DTi if controller stable during base adaption" UBYTE B_TRUE 1 100 0.00 1.00000000000 BIT_MASK 0x1 FORMAT "%13.11" ECU_ADDRESS 0x700023FF /end MEASUREMENT
/begin MEASUREMENT IVGdiCtl_flgAdpnDeltaTiErrMin "Status: Min-Error DTi if controller stable during base adaption" UBYTE B_TRUE 1 100 0.00 1.00000000000 BIT_MASK 0x1 FORMAT "%13.11" ECU_ADDRESS 0x700023FE /end MEASUREMENT
/begin MEASUREMENT IVGdiCtl_flgAdpnDeltaTiHealMax "Status: Max-Okay DTi if controller stable during base adaption" UBYTE B_TRUE 1 100 0.00 1.00000000000 BIT_MASK 0x1 FORMAT "%13.11" ECU_ADDRESS 0x700023FD /end MEASUREMENT
/begin MEASUREMENT IVGdiCtl_flgAdpnDeltaTiHealMin "Status: Min-Okay DTi if controller stable during base adaption" UBYTE B_TRUE 1 100 0.00 1.00000000000 BIT_MASK 0x1 FORMAT "%13.11" ECU_ADDRESS 0x700023FC /end MEASUREMENT
/begin MEASUREMENT IVGdiCtl_flgBallDeltaTiErrMax "Flag: Ballistic total dti max-error" UBYTE B_TRUE 1 100 0.00 1.00000000000 BIT_MASK 0x1 FORMAT "%13.11" ECU_ADDRESS 0x700023FB /end MEASUREMENT
/begin MEASUREMENT IVGdiCtl_flgBallDeltaTiErrMin "Flag: Ballistic total dti min-error" UBYTE B_TRUE 1 100 0.00 1.00000000000 BIT_MASK 0x1 FORMAT "%13.11" ECU_ADDRESS 0x700023FA /end MEASUREMENT
/begin MEASUREMENT IVGdiCtl_flgBallDeltaTiHealMax "Flag: No Ballistic total dti max-error" UBYTE B_TRUE 1 100 0.00 1.00000000000 BIT_MASK 0x1 FORMAT "%13.11" ECU_ADDRESS 0x700023F9 /end MEASUREMENT
/begin MEASUREMENT IVGdiCtl_flgBallDeltaTiHealMin "Flag: No Ballistic total dti min-error" UBYTE B_TRUE 1 100 0.00 1.00000000000 BIT_MASK 0x1 FORMAT "%13.11" ECU_ADDRESS 0x700023F8 /end MEASUREMENT
/begin MEASUREMENT IVGdiCtl_flgBufBgnErr "Flag: Raw measurement buffer error towards buffer begin (Signal plausibility)" UBYTE B_TRUE 1 100 0.00 1.00000000000 BIT_MASK 0x1 FORMAT "%13.11" ECU_ADDRESS 0x700023F7 /end MEASUREMENT
/begin MEASUREMENT IVGdiCtl_flgBufEndErr "Flag: Raw measurement buffer error towards buffer end (Signal plausibility)" UBYTE B_TRUE 1 100 0.00 1.00000000000 BIT_MASK 0x1 FORMAT "%13.11" ECU_ADDRESS 0x700023F6 /end MEASUREMENT
/begin MEASUREMENT IVGdiCtl_flgCvoDiagBascAdpnCvo "Flag CVO basic adaption" UBYTE B_TRUE 1 100 0.00 1.00000000000 BIT_MASK 0x1 FORMAT "%13.11" ECU_ADDRESS 0x700023F5 /end MEASUREMENT
/begin MEASUREMENT IVGdiCtl_flgCvoDiagCtrlrErr "Flag: Cvo controller faulty" UBYTE B_TRUE 1 100 0.00 1.00000000000 BIT_MASK 0x1 FORMAT "%13.11" ECU_ADDRESS 0x700023F4 /end MEASUREMENT
/begin MEASUREMENT IVGdiCtl_flgCvoDiagCtrlrStab "Flag: Cvo controller stable" UBYTE B_TRUE 1 100 0.00 1.00000000000 BIT_MASK 0x1 FORMAT "%13.11" ECU_ADDRESS 0x700023F3 /end MEASUREMENT
/begin MEASUREMENT IVGdiCtl_flgCvoDiagDSMEnad "Flag: Cvo diagnose enabled based on the codeword (DFCs can be set/reset)" UBYTE B_TRUE 1 100 0.00 1.00000000000 BIT_MASK 0x1 FORMAT "%13.11" ECU_ADDRESS 0x700023F2 /end MEASUREMENT
/begin MEASUREMENT IVGdiCtl_flgCvoDiagEnad "Flag: Cvo diagnose enabled" UBYTE B_TRUE 1 100 0.00 1.00000000000 BIT_MASK 0x1 FORMAT "%13.11" ECU_ADDRESS 0x700023F1 /end MEASUREMENT
/begin MEASUREMENT IVGdiCtl_flgCvoDiagEngTOk "Flag: Cvo diagnose enabled under current engine-temperature" UBYTE B_TRUE 1 100 0.00 1.00000000000 BIT_MASK 0x1 FORMAT "%13.11" ECU_ADDRESS 0x700023F0 /end MEASUREMENT
/begin MEASUREMENT IVGdiCtl_flgCvoDiagSigEvlnChk "Flag: Cvo signal plausible" UBYTE B_TRUE 1 100 0.00 1.00000000000 BIT_MASK 0x1 FORMAT "%13.11" ECU_ADDRESS 0x700023EF /end MEASUREMENT
/begin MEASUREMENT IVGdiCtl_flgCvoDiagSmrCdnEnad "Flag: Similar conditions range is active (for DFC_IVGdiCtl_CvoDiagErrMinMax)" UBYTE B_TRUE 1 100 0.00 1.00000000000 BIT_MASK 0x1 FORMAT "%13.11" ECU_ADDRESS 0x700023EE /end MEASUREMENT
/begin MEASUREMENT IVGdiCtl_flgCvoDiagSmrCdnEnadErrSigPlaus "Flag: Similar conditions range is active (for DFC_IVGdiCtl_CvoDiagErrSigPlaus)" UBYTE B_TRUE 1 100 0.00 1.00000000000 BIT_MASK 0x1 FORMAT "%13.11" ECU_ADDRESS 0x700023ED /end MEASUREMENT
/begin MEASUREMENT IVGdiCtl_flgCvoVlvClsTiErrMax "Flag: Full lift tab value out of max-tolerance range" UBYTE B_TRUE 1 100 0.00 1.00000000000 BIT_MASK 0x1 FORMAT "%13.11" ECU_ADDRESS 0x700023EC /end MEASUREMENT
/begin MEASUREMENT IVGdiCtl_flgCvoVlvClsTiErrMin "Flag: Full lift tab value out of min-tolerance range" UBYTE B_TRUE 1 100 0.00 1.00000000000 BIT_MASK 0x1 FORMAT "%13.11" ECU_ADDRESS 0x700023EB /end MEASUREMENT
/begin MEASUREMENT IVGdiCtl_flgCvoVlvClsTiHealMax "Flag: No full lift tab max-error" UBYTE B_TRUE 1 100 0.00 1.00000000000 BIT_MASK 0x1 FORMAT "%13.11" ECU_ADDRESS 0x700023EA /end MEASUREMENT
/begin MEASUREMENT IVGdiCtl_flgCvoVlvClsTiHealMin "Flag: No full lift tab min-error" UBYTE B_TRUE 1 100 0.00 1.00000000000 BIT_MASK 0x1 FORMAT "%13.11" ECU_ADDRESS 0x700023E9 /end MEASUREMENT
/begin MEASUREMENT IVGdiCtl_flgCvoVlvDlyDetn "Status: Tantot found" UBYTE B_TRUE 1 100 0.00 1.00000000000 BIT_MASK 0x1 FORMAT "%13.11" ECU_ADDRESS 0x700023E8 /end MEASUREMENT
/begin MEASUREMENT IVGdiCtl_flgCvoVlvDlyErrMax "Flag: tantot value outside max-threshold" UBYTE B_TRUE 1 100 0.00 1.00000000000 BIT_MASK 0x1 FORMAT "%13.11" ECU_ADDRESS 0x700023E7 /end MEASUREMENT
/begin MEASUREMENT IVGdiCtl_flgCvoVlvDlyErrMin "Flag: tantot value outside min-threshold" UBYTE B_TRUE 1 100 0.00 1.00000000000 BIT_MASK 0x1 FORMAT "%13.11" ECU_ADDRESS 0x700023E6 /end MEASUREMENT
/begin MEASUREMENT IVGdiCtl_flgCvoVlvDlyHealMax "Flag: no tantot max-error" UBYTE B_TRUE 1 100 0.00 1.00000000000 BIT_MASK 0x1 FORMAT "%13.11" ECU_ADDRESS 0x700023E5 /end MEASUREMENT
/begin MEASUREMENT IVGdiCtl_flgCvoVlvDlyHealMin "Flag: no tantot min-error" UBYTE B_TRUE 1 100 0.00 1.00000000000 BIT_MASK 0x1 FORMAT "%13.11" ECU_ADDRESS 0x700023E4 /end MEASUREMENT
/begin MEASUREMENT IVGdiCtl_flgCvoVlvDlyPlaus "Flag: Current tantot value is plausible" UBYTE B_TRUE 1 100 0.00 1.00000000000 BIT_MASK 0x1 FORMAT "%13.11" ECU_ADDRESS 0x700023E3 /end MEASUREMENT
/begin MEASUREMENT IVGdiCtl_flgEngTEnadOff "Flag: Cvo diagnose is disabled due to undesired engine temperature" UBYTE B_TRUE 1 100 0.00 1.00000000000 BIT_MASK 0x1 FORMAT "%13.11" ECU_ADDRESS 0x700023E2 /end MEASUREMENT
/begin MEASUREMENT IVGdiCtl_flgErrCvoSigEvlnSmrCdn "Flag: Cvo signal not plausible" UBYTE B_TRUE 1 100 0.00 1.00000000000 BIT_MASK 0x1 FORMAT "%13.11" ECU_ADDRESS 0x700023E1 /end MEASUREMENT
/begin MEASUREMENT IVGdiCtl_flgFcmClrReq "Flag: DSM Clear requested" UBYTE B_TRUE 1 100 0.00 1.00000000000 BIT_MASK 0x1 FORMAT "%13.11" ECU_ADDRESS 0x700023E0 /end MEASUREMENT
/begin MEASUREMENT IVGdiCtl_flgFullDeltaTiErrMax "Flag: total full lift dti outside max-threshold" UBYTE B_TRUE 1 100 0.00 1.00000000000 BIT_MASK 0x1 FORMAT "%13.11" ECU_ADDRESS 0x700023DF /end MEASUREMENT
/begin MEASUREMENT IVGdiCtl_flgFullDeltaTiErrMin "Flag: total full lift dti outside min-threshold" UBYTE B_TRUE 1 100 0.00 1.00000000000 BIT_MASK 0x1 FORMAT "%13.11" ECU_ADDRESS 0x700023DE /end MEASUREMENT
/begin MEASUREMENT IVGdiCtl_flgFullDeltaTiHealMax "Flag: no total full lift dti max-error" UBYTE B_TRUE 1 100 0.00 1.00000000000 BIT_MASK 0x1 FORMAT "%13.11" ECU_ADDRESS 0x700023DD /end MEASUREMENT
/begin MEASUREMENT IVGdiCtl_flgFullDeltaTiHealMin "Flag: no total full lift dti min-error" UBYTE B_TRUE 1 100 0.00 1.00000000000 BIT_MASK 0x1 FORMAT "%13.11" ECU_ADDRESS 0x700023DC /end MEASUREMENT
/begin MEASUREMENT IVGdiCtl_flgMaxBascAdpnFinshdCylBall "Status: Adaptation completed which was requested by dti diagnosis (Max-error and ballistic injection)" UBYTE B_TRUE 1 100 0.00 1.00000000000 FORMAT "%13.11" ARRAY_SIZE 4 ECU_ADDRESS 0x700023D8 /end MEASUREMENT
/begin MEASUREMENT IVGdiCtl_flgMaxBascAdpnFinshdCylFull "Status: Adaptation completed which was requested by dti diagnosis (Max-error and fulllift injection)" UBYTE B_TRUE 1 100 0.00 1.00000000000 FORMAT "%13.11" ARRAY_SIZE 4 ECU_ADDRESS 0x700023D4 /end MEASUREMENT
/begin MEASUREMENT IVGdiCtl_flgMinBascAdpnFinshdCylBall "Status: Adaptation completed which was requested by dti diagnosis (Min-error and ballistic injection)" UBYTE B_TRUE 1 100 0.00 1.00000000000 FORMAT "%13.11" ARRAY_SIZE 4 ECU_ADDRESS 0x700023D0 /end MEASUREMENT
/begin MEASUREMENT IVGdiCtl_flgMinBascAdpnFinshdCylFull "Status: Adaptation completed which was requested by dti diagnosis (Min-error and fulllift injection)" UBYTE B_TRUE 1 100 0.00 1.00000000000 FORMAT "%13.11" ARRAY_SIZE 4 ECU_ADDRESS 0x700023CC /end MEASUREMENT
/begin MEASUREMENT IVGdiCtl_flgNoVlvClsTiSmrCdn "Flag: Full lift no-tab error (Similar conditions)" UBYTE B_TRUE 1 100 0.00 1.00000000000 BIT_MASK 0x1 FORMAT "%13.11" ECU_ADDRESS 0x700023CB /end MEASUREMENT
/begin MEASUREMENT IVGdiCtl_flgPlatSlopErrMax "Flag: measured plateau outside max-tolerance range" UBYTE B_TRUE 1 100 0.00 1.00000000000 BIT_MASK 0x1 FORMAT "%13.11" ECU_ADDRESS 0x700023CA /end MEASUREMENT
/begin MEASUREMENT IVGdiCtl_flgPlatSlopErrMin "Flag: measured plateau outside min-tolerance range" UBYTE B_TRUE 1 100 0.00 1.00000000000 BIT_MASK 0x1 FORMAT "%13.11" ECU_ADDRESS 0x700023C9 /end MEASUREMENT
/begin MEASUREMENT IVGdiCtl_flgPlatSlopHealMax "Flag: no plateau max-error" UBYTE B_TRUE 1 100 0.00 1.00000000000 BIT_MASK 0x1 FORMAT "%13.11" ECU_ADDRESS 0x700023C8 /end MEASUREMENT
/begin MEASUREMENT IVGdiCtl_flgPlatSlopHealMin "Flag: no plateau min-error" UBYTE B_TRUE 1 100 0.00 1.00000000000 BIT_MASK 0x1 FORMAT "%13.11" ECU_ADDRESS 0x700023C7 /end MEASUREMENT
/begin MEASUREMENT IVGdiCtl_flgSmrCdnDTiMaxBall "Flag: Healing enabled for ballistic total-dti max-error in similar conditions range" UBYTE B_TRUE 1 100 0.00 1.00000000000 BIT_MASK 0x1 FORMAT "%13.11" ECU_ADDRESS 0x700023C6 /end MEASUREMENT
/begin MEASUREMENT IVGdiCtl_flgSmrCdnDTiMaxFull "Flag: Healing enabled for full-lift total-dti max-error in similar conditions range" UBYTE B_TRUE 1 100 0.00 1.00000000000 BIT_MASK 0x1 FORMAT "%13.11" ECU_ADDRESS 0x700023C5 /end MEASUREMENT
/begin MEASUREMENT IVGdiCtl_flgSmrCdnDTiMinBall "Flag: Healing enabled for ballistic total-dti min-error in similar conditions range" UBYTE B_TRUE 1 100 0.00 1.00000000000 BIT_MASK 0x1 FORMAT "%13.11" ECU_ADDRESS 0x700023C4 /end MEASUREMENT
/begin MEASUREMENT IVGdiCtl_flgSmrCdnDTiMinFull "Flag: Healing enabled for full-lift total-dti min-error in similar conditions range" UBYTE B_TRUE 1 100 0.00 1.00000000000 BIT_MASK 0x1 FORMAT "%13.11" ECU_ADDRESS 0x700023C3 /end MEASUREMENT
/begin MEASUREMENT IVGdiCtl_flgSmrCdnVlvClsTiMax "Flag: Healing enabled for full-lift tab max-error in similar conditions range" UBYTE B_TRUE 1 100 0.00 1.00000000000 BIT_MASK 0x1 FORMAT "%13.11" ECU_ADDRESS 0x700023C2 /end MEASUREMENT
/begin MEASUREMENT IVGdiCtl_flgSmrCdnVlvClsTiMin "Flag: Healing enabled for full-lift tab min-error in similar conditions range" UBYTE B_TRUE 1 100 0.00 1.00000000000 BIT_MASK 0x1 FORMAT "%13.11" ECU_ADDRESS 0x700023C1 /end MEASUREMENT
/begin MEASUREMENT IVGdiCtl_nrCvoDiagPls "pulse type of current injection (ballistic or full-lift)" UBYTE dez 1 100 0.00 255.0 FORMAT "%5.1" ECU_ADDRESS 0x700023C0 /end MEASUREMENT
/begin MEASUREMENT IVGdiCtl_pCvoDiagMax "Tantot max-error detected at this pressure point" UBYTE dez 1 100 0.00 255.0 FORMAT "%5.1" ARRAY_SIZE 4 ECU_ADDRESS 0x700023BC /end MEASUREMENT
/begin MEASUREMENT IVGdiCtl_pCvoDiagMin "Tanot min-error detected at this pressure point" UBYTE dez 1 100 0.00 255.0 FORMAT "%5.1" ARRAY_SIZE 4 ECU_ADDRESS 0x700023B8 /end MEASUREMENT
/begin MEASUREMENT IVGdiCtl_stBallDeltaTiErrMax "status dti monitoring of ballistic injection error max" UBYTE dez 1 100 0.00 255.0 FORMAT "%5.1" ECU_ADDRESS 0x700023B3 /end MEASUREMENT
/begin MEASUREMENT IVGdiCtl_stBallDeltaTiErrMaxTmp "status dti monitoring of ballistic injection error max - temporary" UBYTE dez 1 100 0.00 255.0 FORMAT "%5.1" ECU_ADDRESS 0x700023B2 /end MEASUREMENT
/begin MEASUREMENT IVGdiCtl_stBallDeltaTiErrMin "status dti monitoring of ballistic injection error min" UBYTE dez 1 100 0.00 255.0 FORMAT "%5.1" ECU_ADDRESS 0x700023B1 /end MEASUREMENT
/begin MEASUREMENT IVGdiCtl_stBallDeltaTiErrMinTmp "status dti monitoring of ballistic injection error min - temporary" UBYTE dez 1 100 0.00 255.0 FORMAT "%5.1" ECU_ADDRESS 0x700023B0 /end MEASUREMENT
/begin MEASUREMENT IVGdiCtl_stBallDeltaTiHealMax "status dti monitoring of ballistic injection healing max" UBYTE dez 1 100 0.00 255.0 FORMAT "%5.1" ECU_ADDRESS 0x700023AF /end MEASUREMENT
/begin MEASUREMENT IVGdiCtl_stBallDeltaTiHealMaxTmp "status dti monitoring of ballistic injection healing max - temporary" UBYTE dez 1 100 0.00 255.0 FORMAT "%5.1" ECU_ADDRESS 0x700023AE /end MEASUREMENT
/begin MEASUREMENT IVGdiCtl_stBallDeltaTiHealMin "status dti monitoring of ballistic injection healing min" UBYTE dez 1 100 0.00 255.0 FORMAT "%5.1" ECU_ADDRESS 0x700023AD /end MEASUREMENT
/begin MEASUREMENT IVGdiCtl_stBallDeltaTiHealMinTmp "status dti monitoring of ballistic injection healing min - temporary" UBYTE dez 1 100 0.00 255.0 FORMAT "%5.1" ECU_ADDRESS 0x700023AC /end MEASUREMENT
/begin MEASUREMENT IVGdiCtl_stCvoCylErrMax "Bitmask (fault type): Cylinder with cvo max-error (lean behaviour)" UBYTE dez 1 100 0.00 255.0 FORMAT "%5.1" ARRAY_SIZE 4 ECU_ADDRESS 0x70002340 /end MEASUREMENT
/begin MEASUREMENT IVGdiCtl_stCvoCylErrMin "Bitmask (fault type): Cylinder with cvo min-error (rich behaviour)" UBYTE dez 1 100 0.00 255.0 FORMAT "%5.1" ARRAY_SIZE 4 ECU_ADDRESS 0x7000233C /end MEASUREMENT
/begin MEASUREMENT IVGdiCtl_stCvoCylHealMax "Bitmask (fault type): Cylinder without cvo max-error (lean behaviour)" UBYTE dez 1 100 0.00 255.0 FORMAT "%5.1" ARRAY_SIZE 4 ECU_ADDRESS 0x70002338 /end MEASUREMENT
/begin MEASUREMENT IVGdiCtl_stCvoCylHealMin "Bitmask (fault type): Cylinder without cvo min-error (rich behaviour)" UBYTE dez 1 100 0.00 255.0 FORMAT "%5.1" ARRAY_SIZE 4 ECU_ADDRESS 0x70002334 /end MEASUREMENT
/begin MEASUREMENT IVGdiCtl_stCvoCylLockd "Status: Locked cylinder due to cvo min/max error" UBYTE dez 1 100 0.00 255.0 FORMAT "%5.1" ECU_ADDRESS 0x700023AB /end MEASUREMENT
/begin MEASUREMENT IVGdiCtl_stCvoCylLockdEngT "Status: Locked cylinder due to cvo min/max error outside desired engine temperature range" UBYTE dez 1 100 0.00 255.0 FORMAT "%5.1" ECU_ADDRESS 0x700023AA /end MEASUREMENT
/begin MEASUREMENT IVGdiCtl_stCvoDiagEvalDeltaTiBall "Status: Release of the dti monitoring of each combustion cycle (ballistic injection)" UWORD OneToOne 1 100 0.00 65535.00 FORMAT "%8.2" ECU_ADDRESS 0x700023A8 /end MEASUREMENT
/begin MEASUREMENT IVGdiCtl_stCvoDiagEvalDeltaTiFull "Status: Release of the dti monitoring of each combustion cycle (fulllift injection)" UWORD OneToOne 1 100 0.00 65535.00 FORMAT "%8.2" ECU_ADDRESS 0x700023A6 /end MEASUREMENT
/begin MEASUREMENT IVGdiCtl_stCvoDiagMaxErrTmp "Status: MIL on due to max error" UBYTE dez 1 100 0.00 255.0 FORMAT "%5.1" ECU_ADDRESS 0x60039267 /end MEASUREMENT
/begin MEASUREMENT IVGdiCtl_stCvoDiagMinErrTmp "Status: MIL on due to min error" UBYTE dez 1 100 0.00 255.0 FORMAT "%5.1" ECU_ADDRESS 0x60039266 /end MEASUREMENT
/begin MEASUREMENT IVGdiCtl_stCvoDiagTranErr "Status: measured plateau outside max/min-tolerance range" UBYTE dez 1 100 0.00 255.0 FORMAT "%5.1" ECU_ADDRESS 0x700023A5 /end MEASUREMENT
/begin MEASUREMENT IVGdiCtl_stCvoSigEvlnErr "Status: Cvo Signal Evaluation is faulty" UBYTE dez 1 100 0.00 255.0 FORMAT "%5.1" ECU_ADDRESS 0x700023A4 /end MEASUREMENT
/begin MEASUREMENT IVGdiCtl_stCvoSigEvlnErrHealSmrCdn "Status if cylinder healed of the signal evaluation monitoring" UBYTE dez 1 100 0.00 255.0 FORMAT "%5.1" ECU_ADDRESS 0x60039265 /end MEASUREMENT
/begin MEASUREMENT IVGdiCtl_stCvoSigEvlnErrMilOfflocked "Status: If Mil healing counter is locked" UBYTE dez 1 100 0.00 255.0 FORMAT "%5.1" ECU_ADDRESS 0x700023A3 /end MEASUREMENT
/begin MEASUREMENT IVGdiCtl_stCvoSigEvlnErrMilOnlocked "Status: If Mil error counter is locked" UBYTE dez 1 100 0.00 255.0 FORMAT "%5.1" ECU_ADDRESS 0x700023A2 /end MEASUREMENT
/begin MEASUREMENT IVGdiCtl_stCvoSigEvlnErrSmrCdn "Status: Cvo Signal Evaluation is faulty (Similar conditions)" UBYTE dez 1 100 0.00 255.0 FORMAT "%5.1" ECU_ADDRESS 0x60039264 /end MEASUREMENT
/begin MEASUREMENT IVGdiCtl_stCvoSigEvlnHeal "Status: Cvo Signal Evaluation is valid" UBYTE dez 1 100 0.00 255.0 FORMAT "%5.1" ECU_ADDRESS 0x700023A1 /end MEASUREMENT
/begin MEASUREMENT IVGdiCtl_stCvoSigEvlnMil "Status: If Mil on based on the signal evaluation" UBYTE dez 1 100 0.00 255.0 FORMAT "%5.1" ECU_ADDRESS 0x60039263 /end MEASUREMENT
/begin MEASUREMENT IVGdiCtl_stCvoSigEvlnMilTmp "Temporary status: If Mil on based on the signal evaluation" UBYTE dez 1 100 0.00 255.0 FORMAT "%5.1" ECU_ADDRESS 0x700023A0 /end MEASUREMENT
/begin MEASUREMENT IVGdiCtl_stCvoTestInjBallReq "Status: Request of ballistic test injection" UWORD OneToOne 1 100 0.00 65535.00 FORMAT "%8.2" ECU_ADDRESS 0x7000396A /end MEASUREMENT
/begin MEASUREMENT IVGdiCtl_stCvoTestInjBallReqTmp "Status temporary: Request of ballistic test injection" UWORD OneToOne 1 100 0.00 65535.00 FORMAT "%8.2" ECU_ADDRESS 0x7000239E /end MEASUREMENT
/begin MEASUREMENT IVGdiCtl_stErrMaskBascAdpnSmrCdnMax "Bitmask (fault type): Max-faults during base adaption" UBYTE dez 1 100 0.00 255.0 FORMAT "%5.1" ARRAY_SIZE 4 ECU_ADDRESS 0x6003925F /end MEASUREMENT
/begin MEASUREMENT IVGdiCtl_stErrMaskBascAdpnSmrCdnMin "Bitmask (fault type): Min-faults during base adaption" UBYTE dez 1 100 0.00 255.0 FORMAT "%5.1" ARRAY_SIZE 4 ECU_ADDRESS 0x6003925B /end MEASUREMENT
/begin MEASUREMENT IVGdiCtl_stErrSuspcTolrRngDeltaTiBallMax "Bitmask (cyl): Max-error suspect regarding total dti in the ballistic area" UBYTE dez 1 100 0.00 255.0 FORMAT "%5.1" ECU_ADDRESS 0x7000239C /end MEASUREMENT
/begin MEASUREMENT IVGdiCtl_stErrSuspcTolrRngDeltaTiBallMin "Bitmask (cyl): Min-error suspect regarding total dti in the ballistic area" UBYTE dez 1 100 0.00 255.0 FORMAT "%5.1" ECU_ADDRESS 0x7000239B /end MEASUREMENT
/begin MEASUREMENT IVGdiCtl_stErrSuspcTolrRngDeltaTiFullMax "Bitmask (cyl): Max-error suspect regarding total dti in the full lift area" UBYTE dez 1 100 0.00 255.0 FORMAT "%5.1" ECU_ADDRESS 0x7000239A /end MEASUREMENT
/begin MEASUREMENT IVGdiCtl_stErrSuspcTolrRngDeltaTiFullMin "Bitmask (cyl): Min-error suspect regarding total dti in the full lift area" UBYTE dez 1 100 0.00 255.0 FORMAT "%5.1" ECU_ADDRESS 0x70002399 /end MEASUREMENT
/begin MEASUREMENT IVGdiCtl_stFcmFrzExists "Status: Freeze Frame exists for CVO monitoring" UBYTE B_TRUE 1 100 0.00 1.00000000000 BIT_MASK 0x1 FORMAT "%13.11" ECU_ADDRESS 0x6003925A /end MEASUREMENT
/begin MEASUREMENT IVGdiCtl_stFullLftDeltaTiErrMax "status dti monitoring of fulllift injection error max" UBYTE dez 1 100 0.00 255.0 FORMAT "%5.1" ECU_ADDRESS 0x70002398 /end MEASUREMENT
/begin MEASUREMENT IVGdiCtl_stFullLftDeltaTiErrMaxTmp "status dti monitoring of fulllift injection error max - temporary" UBYTE dez 1 100 0.00 255.0 FORMAT "%5.1" ECU_ADDRESS 0x70002397 /end MEASUREMENT
/begin MEASUREMENT IVGdiCtl_stFullLftDeltaTiErrMin "status dti monitoring of fulllift injection error min" UBYTE dez 1 100 0.00 255.0 FORMAT "%5.1" ECU_ADDRESS 0x70002396 /end MEASUREMENT
/begin MEASUREMENT IVGdiCtl_stFullLftDeltaTiErrMinTmp "status dti monitoring of fulllift injection error min - temporary" UBYTE dez 1 100 0.00 255.0 FORMAT "%5.1" ECU_ADDRESS 0x70002395 /end MEASUREMENT
/begin MEASUREMENT IVGdiCtl_stFullLftDeltaTiHealMax "status dti monitoring of fulllift injection healing max" UBYTE dez 1 100 0.00 255.0 FORMAT "%5.1" ECU_ADDRESS 0x70002394 /end MEASUREMENT
/begin MEASUREMENT IVGdiCtl_stFullLftDeltaTiHealMaxTmp "status dti monitoring of fulllift injection healing max - temporary" UBYTE dez 1 100 0.00 255.0 FORMAT "%5.1" ECU_ADDRESS 0x70002393 /end MEASUREMENT
/begin MEASUREMENT IVGdiCtl_stFullLftDeltaTiHealMin "status dti monitoring of fulllift injection healing min" UBYTE dez 1 100 0.00 255.0 FORMAT "%5.1" ECU_ADDRESS 0x70002392 /end MEASUREMENT
/begin MEASUREMENT IVGdiCtl_stFullLftDeltaTiHealMinTmp "tatus dti monitoring of fulllift injection healing min - temporary" UBYTE dez 1 100 0.00 255.0 FORMAT "%5.1" ECU_ADDRESS 0x70002391 /end MEASUREMENT
/begin MEASUREMENT IVGdiCtl_stMaxCtrlrErrMask "Bitmask (fault type): Max-faults during regular operation" UBYTE dez 1 100 0.00 255.0 FORMAT "%5.1" ARRAY_SIZE 4 ECU_ADDRESS 0x70002330 /end MEASUREMENT
/begin MEASUREMENT IVGdiCtl_stMaxCtrlrErrMaskCopy "Bitmask (fault type): Max-faults during regular operation" UBYTE dez 1 100 0.00 255.0 FORMAT "%5.1" ARRAY_SIZE 4 ECU_ADDRESS 0x60039256 /end MEASUREMENT
/begin MEASUREMENT IVGdiCtl_stMaxCtrlrErrMaskSmrCdn "Bitmask (fault type): Max-faults during regular operation (Similar conditions)" UBYTE dez 1 100 0.00 255.0 FORMAT "%5.1" ARRAY_SIZE 4 ECU_ADDRESS 0x60039252 /end MEASUREMENT
/begin MEASUREMENT IVGdiCtl_stMaxCtrlrHealMask "bit mask: healing state of possible max-errors during regular operation" UBYTE dez 1 100 0.00 255.0 FORMAT "%5.1" ARRAY_SIZE 4 ECU_ADDRESS 0x7000232C /end MEASUREMENT
/begin MEASUREMENT IVGdiCtl_stMaxCvoDiagDfc "Status: Error path Max tested without errors" UBYTE dez 1 100 0.00 255.0 FORMAT "%5.1" ECU_ADDRESS 0x70002390 /end MEASUREMENT
/begin MEASUREMENT IVGdiCtl_stMaxCvoDiagErrMilOfflocked "Status: If Mil healing counter is locked of Max errors" UBYTE dez 1 100 0.00 255.0 FORMAT "%5.1" ECU_ADDRESS 0x7000238F /end MEASUREMENT
/begin MEASUREMENT IVGdiCtl_stMaxCvoDiagErrMilOfflockedCopy "Status: If Mil healing counter is locked of Max errors" UBYTE dez 1 100 0.00 255.0 FORMAT "%5.1" ECU_ADDRESS 0x7000238E /end MEASUREMENT
/begin MEASUREMENT IVGdiCtl_stMaxCvoDiagErrMilOnlocked "Status: If Mil error counter is locked of Max errors" UBYTE dez 1 100 0.00 255.0 FORMAT "%5.1" ECU_ADDRESS 0x7000238D /end MEASUREMENT
/begin MEASUREMENT IVGdiCtl_stMaxCvoDiagErrMilOnlockedCopy "Status: If Mil error counter is locked of Max errors" UBYTE dez 1 100 0.00 255.0 FORMAT "%5.1" ECU_ADDRESS 0x7000238C /end MEASUREMENT
/begin MEASUREMENT IVGdiCtl_stMaxCvoDiagMil "Status: If Mil on based on a Max error" UBYTE dez 1 100 0.00 255.0 FORMAT "%5.1" ECU_ADDRESS 0x60039251 /end MEASUREMENT
/begin MEASUREMENT IVGdiCtl_stMaxCvoDiagMilTmp "Temporary status: If Mil on based on a Max error" UWORD dez 1 100 0.00 65535.00 FORMAT "%8.2" ECU_ADDRESS 0x7000238A /end MEASUREMENT
/begin MEASUREMENT IVGdiCtl_stMaxCvoDiagSimilarDfc "Status: if similar conditions active of Max errors" UBYTE dez 1 100 0.00 255.0 FORMAT "%5.1" ECU_ADDRESS 0x60039250 /end MEASUREMENT
/begin MEASUREMENT IVGdiCtl_stMaxCylAdpnReqBall "Status: Requested adaption by the dti monitoring (Max error, ballistic injection)" UBYTE OneToOne 1 100 0.00 255.0 FORMAT "%5.1" ARRAY_SIZE 4 ECU_ADDRESS 0x70002385 /end MEASUREMENT
/begin MEASUREMENT IVGdiCtl_stMaxCylAdpnReqFull "Status: Requested adaption by the dti monitoring (Max error, full lift injection)" UBYTE OneToOne 1 100 0.00 255.0 FORMAT "%5.1" ARRAY_SIZE 4 ECU_ADDRESS 0x70002381 /end MEASUREMENT
/begin MEASUREMENT IVGdiCtl_stMaxErrMaskBascAdpn "Bitmask (fault type): Max-faults during base adaption" UBYTE dez 1 100 0.00 255.0 FORMAT "%5.1" ARRAY_SIZE 20 ECU_ADDRESS 0x70002318 /end MEASUREMENT
/begin MEASUREMENT IVGdiCtl_stMaxHealMaskBascAdpn "bit mask: healing state of possible max-errors during base adaption" UBYTE dez 1 100 0.00 255.0 FORMAT "%5.1" ARRAY_SIZE 20 ECU_ADDRESS 0x70002304 /end MEASUREMENT
/begin MEASUREMENT IVGdiCtl_stMinCtrlrErrMask "Bitmask (fault type): Min-faults during regular operation (Similar conditions)" UBYTE dez 1 100 0.00 255.0 FORMAT "%5.1" ARRAY_SIZE 4 ECU_ADDRESS 0x70002300 /end MEASUREMENT
/begin MEASUREMENT IVGdiCtl_stMinCtrlrErrMaskCopy "Bitmask (fault type): Min-faults during regular operation (Similar conditions)" UBYTE dez 1 100 0.00 255.0 FORMAT "%5.1" ARRAY_SIZE 4 ECU_ADDRESS 0x6003924C /end MEASUREMENT
/begin MEASUREMENT IVGdiCtl_stMinCtrlrErrMaskSmrCdn "Bitmask (fault type): Min-faults during regular operation" UBYTE dez 1 100 0.00 255.0 FORMAT "%5.1" ARRAY_SIZE 4 ECU_ADDRESS 0x60039248 /end MEASUREMENT
/begin MEASUREMENT IVGdiCtl_stMinCtrlrHealMask "bit mask: healing state of possible min-errors during regular operation" UBYTE dez 1 100 0.00 255.0 FORMAT "%5.1" ARRAY_SIZE 4 ECU_ADDRESS 0x700022FC /end MEASUREMENT
/begin MEASUREMENT IVGdiCtl_stMinCvoDiagDfc "Status: Error path Min tested without errors" UBYTE dez 1 100 0.00 255.0 FORMAT "%5.1" ECU_ADDRESS 0x70002380 /end MEASUREMENT
/begin MEASUREMENT IVGdiCtl_stMinCvoDiagErrMilOfflocked "Status: If Mil healing counter is locked of Min errors" UBYTE dez 1 100 0.00 255.0 FORMAT "%5.1" ECU_ADDRESS 0x7000237F /end MEASUREMENT
/begin MEASUREMENT IVGdiCtl_stMinCvoDiagErrMilOfflockedCopy "Status: If Mil healing counter is locked of Min errors" UBYTE dez 1 100 0.00 255.0 FORMAT "%5.1" ECU_ADDRESS 0x7000237E /end MEASUREMENT
/begin MEASUREMENT IVGdiCtl_stMinCvoDiagErrMilOnlocked "Status: If Mil error counter is locked of Min errors" UBYTE dez 1 100 0.00 255.0 FORMAT "%5.1" ECU_ADDRESS 0x7000237D /end MEASUREMENT
/begin MEASUREMENT IVGdiCtl_stMinCvoDiagErrMilOnlockedCopy "Status: If Mil error counter is locked of Min errors" UBYTE dez 1 100 0.00 255.0 FORMAT "%5.1" ECU_ADDRESS 0x7000237C /end MEASUREMENT
/begin MEASUREMENT IVGdiCtl_stMinCvoDiagMil "Status: If Mil on based on a Min error" UBYTE dez 1 100 0.00 255.0 FORMAT "%5.1" ECU_ADDRESS 0x60039247 /end MEASUREMENT
/begin MEASUREMENT IVGdiCtl_stMinCvoDiagMilTmp "Temporary status: If Mil on based on a Min error" UWORD dez 1 100 0.00 65535.00 FORMAT "%8.2" ECU_ADDRESS 0x7000237A /end MEASUREMENT
/begin MEASUREMENT IVGdiCtl_stMinCvoDiagSimilarDfc "Status: if similar conditions active of Min errors" UBYTE dez 1 100 0.00 255.0 FORMAT "%5.1" ECU_ADDRESS 0x60039246 /end MEASUREMENT
/begin MEASUREMENT IVGdiCtl_stMinCylAdpnReqBall "Status: Requested adaption by the dti monitoring (Min error, ballistic injection)" UBYTE OneToOne 1 100 0.00 255.0 FORMAT "%5.1" ARRAY_SIZE 4 ECU_ADDRESS 0x70002375 /end MEASUREMENT
/begin MEASUREMENT IVGdiCtl_stMinCylAdpnReqFull "Status: Requested adaption by the dti monitoring (Min error, full lift injection)" UBYTE OneToOne 1 100 0.00 255.0 FORMAT "%5.1" ARRAY_SIZE 4 ECU_ADDRESS 0x70002371 /end MEASUREMENT
/begin MEASUREMENT IVGdiCtl_stMinErrMaskBascAdpn "Bitmask (fault type): Min-faults during base adaption" UBYTE dez 1 100 0.00 255.0 FORMAT "%5.1" ARRAY_SIZE 20 ECU_ADDRESS 0x700022E8 /end MEASUREMENT
/begin MEASUREMENT IVGdiCtl_stMinHealMaskBascAdpn "bit mask: healing state of possible min-errors during base adaption" UBYTE dez 1 100 0.00 255.0 FORMAT "%5.1" ARRAY_SIZE 20 ECU_ADDRESS 0x700022D4 /end MEASUREMENT
/begin MEASUREMENT IVGdiCtl_stNoClsTiErr "Bitmask (cyl): no-tab full lift error" UBYTE dez 1 100 0.00 255.0 FORMAT "%5.1" ECU_ADDRESS 0x70002370 /end MEASUREMENT
/begin MEASUREMENT IVGdiCtl_tiCurrCvoVlvCls "current tab" UWORD t_q0p1_us 1 100 0.00 6553.500 FORMAT "%8.3" ECU_ADDRESS 0x7000236E /end MEASUREMENT
/begin MEASUREMENT IVGdiCtl_tiCvoDiagBallCurrDeltaTi "current checked dti value of ballistic injection" SWORD t_q0p1_us 1 100 -3276.800 3276.700 FORMAT "%8.3" ARRAY_SIZE 4 ECU_ADDRESS 0x70002366 /end MEASUREMENT
/begin MEASUREMENT IVGdiCtl_tiCvoDiagCurrDeltaTi "current dti" SWORD t_q0p1_us 1 100 -3276.800 3276.700 FORMAT "%8.3" ECU_ADDRESS 0x70002364 /end MEASUREMENT
/begin MEASUREMENT IVGdiCtl_tiCvoDiagFullCurrDeltaTi "current checked dti value of fulllift injection" SWORD t_q0p1_us 1 100 -3276.800 3276.700 FORMAT "%8.3" ARRAY_SIZE 4 ECU_ADDRESS 0x7000235C /end MEASUREMENT
/begin MEASUREMENT IVGdiCtl_tiCvoDiagIdle "pause time" UWORD t_q0p04_ms 1 100 0.00 2621.400 FORMAT "%8.3" ECU_ADDRESS 0x7000235A /end MEASUREMENT
/begin MEASUREMENT IVGdiCtl_tiCvoDiagIntegdDeltaTi "integrated DTi value afte the controller is stable during base adaption" SWORD t_q0p1_us 1 100 -3276.800 3276.700 FORMAT "%8.3" ECU_ADDRESS 0x70002358 /end MEASUREMENT
/begin MEASUREMENT IVGdiCtl_tiCvoVlvDlyCurr "current tantot value" UWORD t_q0p1_us 1 100 0.00 6553.500 FORMAT "%8.3" ECU_ADDRESS 0x70002356 /end MEASUREMENT
/begin MEASUREMENT IVGdiCtl_tiCvoVlvDlyDft "default tantot value" UWORD t_q0p1_us 1 100 0.00 6553.500 FORMAT "%8.3" ECU_ADDRESS 0x70002354 /end MEASUREMENT
/begin MEASUREMENT IVGdiCtl_tiDeltaTiOpenCurr "current plateau value" SWORD t_q0p1_us 1 100 -3276.800 3276.700 FORMAT "%8.3" ECU_ADDRESS 0x70002352 /end MEASUREMENT
/begin MEASUREMENT IVGdiCtl_tiLimdCvoVlvCls "limited tab value" UWORD t_q0p1_us 1 100 0.00 6553.500 FORMAT "%8.3" ECU_ADDRESS 0x70002350 /end MEASUREMENT
/begin MEASUREMENT IVGdiCtl_uCvoDiagBufBgn "ADC buffer signal from CvoSigEvln" UWORD dez 1 100 0.00 65535.00 FORMAT "%8.2" ECU_ADDRESS 0x7000234E /end MEASUREMENT
/begin MEASUREMENT IVGdiCtl_uCvoDiagbufEnd "ADC buffer signal from CvoSigEvln" UWORD dez 1 100 0.00 65535.00 FORMAT "%8.2" ECU_ADDRESS 0x7000234C /end MEASUREMENT
/begin MEASUREMENT IVGdiCtl_uCvoDiagDrgPtrBufBgn "Drag indicator: ADC-Signal buffer begin" UWORD dez 1 100 0.00 65535.00 FORMAT "%8.2" ARRAY_SIZE 4 ECU_ADDRESS 0x6003923E /end MEASUREMENT
/begin MEASUREMENT IVGdiCtl_uCvoDiagDrgPtrBufEnd "Drag indicator: ADC-Signal buffer end" UWORD dez 1 100 0.00 65535.00 FORMAT "%8.2" ARRAY_SIZE 4 ECU_ADDRESS 0x60039236 /end MEASUREMENT
/begin MEASUREMENT IVGdiCtl_vcosCvoDiagMax "Tanot max-error detected at this viscosity point" UBYTE dez 1 100 0.00 255.0 FORMAT "%5.1" ARRAY_SIZE 4 ECU_ADDRESS 0x70002348 /end MEASUREMENT
/begin MEASUREMENT IVGdiCtl_vcosCvoDiagMin "Tanot min-error detected at this viscosity point" UBYTE dez 1 100 0.00 255.0 FORMAT "%5.1" ARRAY_SIZE 4 ECU_ADDRESS 0x70002344 /end MEASUREMENT
/begin MEASUREMENT KnDet_AddIntegWinEndBuf0 "integrator value at the end of the measurement window (additional measurement window) Buffer0" ULONG spg_q7p629Em7_V_ms 1 100 0.00 3276.79999924 FORMAT "%13.8" ARRAY_SIZE 3 ECU_ADDRESS 0x70002284 /end MEASUREMENT
/begin MEASUREMENT KnDet_AddIntegWinEndBuf1 "integrator value at the end of the measurement window (additional measurement window) Buffer1" ULONG spg_q7p629Em7_V_ms 1 100 0.00 3276.79999924 FORMAT "%13.8" ARRAY_SIZE 3 ECU_ADDRESS 0x70002278 /end MEASUREMENT
/begin MEASUREMENT KnDet_AddIntegWinEndBuf2 "integrator value at the end of the measurement window (additional measurement window) Buffer2" ULONG spg_q7p629Em7_V_ms 1 100 0.00 3276.79999924 FORMAT "%13.8" ARRAY_SIZE 3 ECU_ADDRESS 0x7000226C /end MEASUREMENT
/begin MEASUREMENT KnDet_bDiaDeb "diagnosis fault suspicion (debouncing active)" UBYTE B_TRUE 1 100 0.00 1.00000000000 BIT_MASK 0x1 FORMAT "%13.11" ECU_ADDRESS 0x700001BA /end MEASUREMENT
/begin MEASUREMENT KnDet_bDiFctCall "Disable read of datat" UBYTE B_TRUE 1 100 0.00 1.00000000000 BIT_MASK 0x1 FORMAT "%13.11" ECU_ADDRESS 0x700001C3 /end MEASUREMENT
/begin MEASUREMENT KnDet_bEnaSigEval "Enable of signal evaluation" UBYTE B_TRUE 1 100 0.00 1.00000000000 BIT_MASK 0x1 FORMAT "%13.11" ECU_ADDRESS 0x700001B8 /end MEASUREMENT
/begin MEASUREMENT KnDet_bNewEval "begin new signal evaluation" UBYTE B_TRUE 1 100 0.00 1.00000000000 BIT_MASK 0x1 FORMAT "%13.11" ECU_ADDRESS 0x700001B7 /end MEASUREMENT
/begin MEASUREMENT KnDet_bStMeasWin "status measuring window output" UBYTE B_TRUE 1 100 0.00 1.00000000000 BIT_MASK 0x1 FORMAT "%13.11" ECU_ADDRESS 0x700001C2 /end MEASUREMENT
/begin MEASUREMENT KnDet_ctCyl "cylinder counter KnDet" UBYTE dez 1 100 0.00 255.0 FORMAT "%5.1" ECU_ADDRESS 0x600008E5 /end MEASUREMENT
/begin MEASUREMENT KnDet_ctCylBuf0 "cylinder counter KnDet buffer 0" UBYTE dez 1 100 0.00 255.0 FORMAT "%5.1" ECU_ADDRESS 0x5000095E /end MEASUREMENT
/begin MEASUREMENT KnDet_ctCylBuf1 "cylinder counter KnDet buffer 2" UBYTE dez 1 100 0.00 255.0 FORMAT "%5.1" ECU_ADDRESS 0x5000095F /end MEASUREMENT
/begin MEASUREMENT KnDet_ctCylBuf2 "cylinder counter KnDet buffer 0" UBYTE dez 1 100 0.00 255.0 FORMAT "%5.1" ECU_ADDRESS 0x50000960 /end MEASUREMENT
/begin MEASUREMENT KnDet_ctCylTmp "KnDet: cylinder counter temporay" UBYTE dez 1 100 0.00 255.0 FORMAT "%5.1" ECU_ADDRESS 0x600008E6 /end MEASUREMENT
/begin MEASUREMENT KnDet_ctDia "diagnosis counter short circuit detection" UBYTE dez 1 100 0.00 255.0 FORMAT "%5.1" ECU_ADDRESS 0x600008E7 /end MEASUREMENT
/begin MEASUREMENT KnDet_ctIncErr "Number of error calling EPM functions" SBYTE dez 1 100 -128.0 127.0 FORMAT "%5.1" ECU_ADDRESS 0x7000225C /end MEASUREMENT
/begin MEASUREMENT KnDet_ctInctmp "teeth counter temporary" SLONG dez 1 100 -2147483648.00 2147483647.00 FORMAT "%13.2" ECU_ADDRESS 0x70002258 /end MEASUREMENT
/begin MEASUREMENT KnDet_ctInpBuf "Index write data" UBYTE dez 1 100 0.00 255.0 FORMAT "%5.1" ECU_ADDRESS 0x600008E8 /end MEASUREMENT
/begin MEASUREMENT KnDet_ctIntegRsltInvld "counter integration results not valid" UBYTE dez 1 100 0.00 255.0 FORMAT "%5.1" ECU_ADDRESS 0x600008E9 /end MEASUREMENT
/begin MEASUREMENT KnDet_ctMeasWin "counter number of measurement windows" ULONG dez 1 100 0.00 65535.0000000 FORMAT "%13.7" ECU_ADDRESS 0x50000300 /end MEASUREMENT
/begin MEASUREMENT KnDet_ctNumValAddWin "counter: number of measuring values" ULONG dez 1 100 0.00 4294967295.00 FORMAT "%13.2" ECU_ADDRESS 0x70002254 /end MEASUREMENT
/begin MEASUREMENT KnDet_ctOutpBuf "index read data" UBYTE dez 1 100 0.00 255.0 FORMAT "%5.1" ECU_ADDRESS 0x50000961 /end MEASUREMENT
/begin MEASUREMENT KnDet_DebDiagVal1 "state debouncing value 1" ULONG dez 1 100 0.00 4294967295.00 FORMAT "%13.2" ECU_ADDRESS 0x60002724 /end MEASUREMENT
/begin MEASUREMENT KnDet_DebDiagVal2 "state debouncing value 2" ULONG dez 1 100 0.00 4294967295.00 FORMAT "%13.2" ECU_ADDRESS 0x60002720 /end MEASUREMENT
/begin MEASUREMENT KnDet_DiaRes "diagnosis result" UBYTE dez 1 100 0.00 255.0 FORMAT "%5.1" ECU_ADDRESS 0x6000B78F /end MEASUREMENT
/begin MEASUREMENT KnDet_DiffMeasWinMeasd "distance between measurement wind end and begin" ULONG t_us_q1 1 100 0.00 4294967295.00 FORMAT "%13.2" ECU_ADDRESS 0x6000040C /end MEASUREMENT
/begin MEASUREMENT KnDet_facPolarityDiag "fctor polarity for line test" SBYTE dez 1 100 -128.0 127.0 FORMAT "%5.1" ECU_ADDRESS 0x600008EA /end MEASUREMENT
/begin MEASUREMENT KnDet_flgBufOvf "buffer overflow" UBYTE B_TRUE 1 100 0.00 1.00000000000 BIT_MASK 0x1 FORMAT "%13.11" ECU_ADDRESS 0x700001C1 /end MEASUREMENT
/begin MEASUREMENT KnDet_flgBufOvfTmp "buffer overflow, temp." UBYTE B_TRUE 1 100 0.00 1.00000000000 BIT_MASK 0x1 FORMAT "%13.11" ECU_ADDRESS 0x700001C0 /end MEASUREMENT
/begin MEASUREMENT KnDet_flgKnkSyncd "kncok detection synchronized" UBYTE B_TRUE 1 100 0.00 1.00000000000 BIT_MASK 0x1 FORMAT "%13.11" ECU_ADDRESS 0x700001BF /end MEASUREMENT
/begin MEASUREMENT KnDet_flgReIni "ReIni detected" UBYTE B_TRUE 1 100 0.00 1.00000000000 BIT_MASK 0x1 FORMAT "%13.11" ECU_ADDRESS 0x700001BE /end MEASUREMENT
/begin MEASUREMENT KnDet_flgScChkDiagAck "Acknowledge End of Line-Test" UBYTE B_TRUE 1 100 0.00 1.00000000000 BIT_MASK 0x1 FORMAT "%13.11" ECU_ADDRESS 0x700001B9 /end MEASUREMENT
/begin MEASUREMENT KnDet_flgSnsrMaxErr "Max error at knock sensor line" UBYTE B_TRUE 1 100 0.00 1.00000000000 BIT_MASK 0x1 FORMAT "%13.11" ECU_ADDRESS 0x700001BC /end MEASUREMENT
/begin MEASUREMENT KnDet_flgSnsrMinErr "Min error knock sensor line" UBYTE B_TRUE 1 100 0.00 1.00000000000 BIT_MASK 0x1 FORMAT "%13.11" ECU_ADDRESS 0x700001BB /end MEASUREMENT
/begin MEASUREMENT KnDet_FltNewBuf0 "filter switched buffer 0" UBYTE B_TRUE 1 100 0.00 1.00000000000 BIT_MASK 0x1 FORMAT "%13.11" ECU_ADDRESS 0x50000958 /end MEASUREMENT
/begin MEASUREMENT KnDet_FltNewBuf1 "filter switched buffer 1" UBYTE B_TRUE 1 100 0.00 1.00000000000 BIT_MASK 0x1 FORMAT "%13.11" ECU_ADDRESS 0x50000959 /end MEASUREMENT
/begin MEASUREMENT KnDet_FltNewBuf2 "filter switched buffer 2" UBYTE B_TRUE 1 100 0.00 1.00000000000 BIT_MASK 0x1 FORMAT "%13.11" ECU_ADDRESS 0x5000095A /end MEASUREMENT
/begin MEASUREMENT KnDet_GainShift "Amplification stage" UBYTE dez 1 100 0.00 255.0 FORMAT "%5.1" ECU_ADDRESS 0x600008DE /end MEASUREMENT
/begin MEASUREMENT KnDet_GainShiftTmp "Amplification stage temporary" UBYTE dez 1 100 0.00 255.0 FORMAT "%5.1" ECU_ADDRESS 0x600008DF /end MEASUREMENT
/begin MEASUREMENT KnDet_HwDiaMode "HW: configuration for diagnosis mode" UBYTE dez 1 100 0.00 255.0 FORMAT "%5.1" ECU_ADDRESS 0x600008E0 /end MEASUREMENT
/begin MEASUREMENT KnDet_idxIntegVal "indices for intermediate values" ULONG dez 1 100 0.00 4294967295.00 FORMAT "%13.2" ARRAY_SIZE 2 ECU_ADDRESS 0x7000224C /end MEASUREMENT
/begin MEASUREMENT KnDet_IntegWinEndBuf0 "integrator value at the end of the measuring window buffer0" ULONG spg_q7p629Em7_V_ms 1 100 0.00 3276.79999924 FORMAT "%13.8" ARRAY_SIZE 3 ECU_ADDRESS 0x500002C0 /end MEASUREMENT
/begin MEASUREMENT KnDet_IntegWinEndBuf1 "integrator value at the end of the measuring window buffer1" ULONG spg_q7p629Em7_V_ms 1 100 0.00 3276.79999924 FORMAT "%13.8" ARRAY_SIZE 3 ECU_ADDRESS 0x500002CC /end MEASUREMENT
/begin MEASUREMENT KnDet_IntegWinEndBuf2 "integrator value at the end of the measuring window buffer2" ULONG spg_q7p629Em7_V_ms 1 100 0.00 3276.79999924 FORMAT "%13.8" ARRAY_SIZE 3 ECU_ADDRESS 0x500002D8 /end MEASUREMENT
/begin MEASUREMENT KnDet_KnKInvldBuf0 "result for knock detection invalid buffer 0" UBYTE B_TRUE 1 100 0.00 1.00000000000 BIT_MASK 0x1 FORMAT "%13.11" ECU_ADDRESS 0x5000095B /end MEASUREMENT
/begin MEASUREMENT KnDet_KnKInvldBuf1 "result for knock detection invalid buffer 1" UBYTE B_TRUE 1 100 0.00 1.00000000000 BIT_MASK 0x1 FORMAT "%13.11" ECU_ADDRESS 0x5000095C /end MEASUREMENT
/begin MEASUREMENT KnDet_KnKInvldBuf2 "result for knock detection invalid buffer 2" UBYTE B_TRUE 1 100 0.00 1.00000000000 BIT_MASK 0x1 FORMAT "%13.11" ECU_ADDRESS 0x5000095D /end MEASUREMENT
/begin MEASUREMENT KnDet_MeasWinEndMeasd "current value measurement window end" ULONG dez 1 100 0.00 4294967295.00 FORMAT "%13.2" ECU_ADDRESS 0x60000418 /end MEASUREMENT
/begin MEASUREMENT KnDet_NewDataBuf0 "new data available buffer 0" UBYTE dez 1 100 0.00 255.0 FORMAT "%5.1" ECU_ADDRESS 0x70001CB9 /end MEASUREMENT
/begin MEASUREMENT KnDet_NewDataBuf1 "new data available buffer 1" UBYTE dez 1 100 0.00 255.0 FORMAT "%5.1" ECU_ADDRESS 0x70001CBA /end MEASUREMENT
/begin MEASUREMENT KnDet_NewDataBuf2 "new data available buffer 2" UBYTE dez 1 100 0.00 255.0 FORMAT "%5.1" ECU_ADDRESS 0x70001CBB /end MEASUREMENT
/begin MEASUREMENT KnDet_NewDiagRes "result of diagnosis evaluation" SWORD RBPtCel_u_1p60514em4_1 1 100 -5.259711 5.259551 FORMAT "%8.6" ECU_ADDRESS 0x600005A4 /end MEASUREMENT
/begin MEASUREMENT KnDet_nrDiffValMeasWinMeasdTmp "Difference number of values based on time and number of measured values" SWORD dez 1 100 -32768.00 32767.00 FORMAT "%8.2" ECU_ADDRESS 0x7000229C /end MEASUREMENT
/begin MEASUREMENT KnDet_nrValDly "number of delayed values" UWORD dez 1 100 0.00 65535.00 FORMAT "%8.2" ECU_ADDRESS 0x600005A6 /end MEASUREMENT
/begin MEASUREMENT KnDet_nrValDlyBasc "number of delayed values, basic delay" UWORD dez 1 100 0.00 65535.00 FORMAT "%8.2" ECU_ADDRESS 0x600005A8 /end MEASUREMENT
/begin MEASUREMENT KnDet_nrValMeasWinMeasd "number of values based on time" UWORD dez 1 100 0.00 65535.00 FORMAT "%8.2" ECU_ADDRESS 0x7000229A /end MEASUREMENT
/begin MEASUREMENT KnDet_numFltNew "filter selection for the next combustion" UWORD dez 1 100 0.00 65535.00 FORMAT "%8.2" ECU_ADDRESS 0x600005AA /end MEASUREMENT
/begin MEASUREMENT KnDet_numFltNewTmp "filter selection for the next combustion, temp." UWORD dez 1 100 0.00 65535.00 FORMAT "%8.2" ECU_ADDRESS 0x600005AC /end MEASUREMENT
/begin MEASUREMENT KnDet_numFltOldAry "filter selection, cylinder specific, old" UWORD dez 1 100 0.00 65535.00 FORMAT "%8.2" ARRAY_SIZE 4 ECU_ADDRESS 0x50000304 /end MEASUREMENT
/begin MEASUREMENT KnDet_numKnkSnsr "slected knock sensor" UBYTE dez 1 100 0.00 3.000 FORMAT "%5.3" ECU_ADDRESS 0x600008EB /end MEASUREMENT
/begin MEASUREMENT KnDet_numSensDia "sensor for diagnosis" UBYTE dez 1 100 0.00 255.0 FORMAT "%5.1" ECU_ADDRESS 0x600008EC /end MEASUREMENT
/begin MEASUREMENT KnDet_numValMeasWin "number of measuring values in the measuring window" ULONG dez 1 100 0.00 4294967295.00 FORMAT "%13.2" ECU_ADDRESS 0x5000030C /end MEASUREMENT
/begin MEASUREMENT KnDet_numValMeasWinEst "estimated number of measuring values in the measuring window" UWORD dez 1 100 0.00 65535.00 FORMAT "%8.2" ECU_ADDRESS 0x600005AE /end MEASUREMENT
/begin MEASUREMENT KnDet_numValMeasWinTmp "number of measuring values in the measuring window, temporay" UWORD dez 1 100 0.00 65535.00 FORMAT "%8.2" ECU_ADDRESS 0x600005B0 /end MEASUREMENT
/begin MEASUREMENT KnDet_numValTmpMeasWin "number of measuring values in the measuring window, temporary" ULONG dez 1 100 0.00 4294967295.00 FORMAT "%13.2" ECU_ADDRESS 0x50000310 /end MEASUREMENT
/begin MEASUREMENT KnDet_phiAddMeasWinEnd "angle length of measurement window (additional measurement window)" SWORD kw_sw_q0p0219 1 100 -720.0000 719.9780 FORMAT "%8.4" ECU_ADDRESS 0x7000226A /end MEASUREMENT
/begin MEASUREMENT KnDet_phiAddMeasWinEndTmp "angle length of measurement window (additional measurement window) temporary" SWORD kw_sw_q0p0219 1 100 -720.0000 719.9780 FORMAT "%8.4" ECU_ADDRESS 0x70002298 /end MEASUREMENT
/begin MEASUREMENT KnDet_phiCurrPos "angle current position" SWORD kw_sw_q0p0219 1 100 -720.0000 719.9780 FORMAT "%8.4" ECU_ADDRESS 0x70002248 /end MEASUREMENT
/begin MEASUREMENT KnDet_phiKnMeasWinBgn "angle begin of measurement window (kc measurement window)" SWORD kw_sw_q0p0219 1 100 -720.0000 719.9780 FORMAT "%8.4" ECU_ADDRESS 0x70002268 /end MEASUREMENT
/begin MEASUREMENT KnDet_phiKnMeasWinBgnTmp "angle begin of measurement window (kc measurement window) temporary" SLONG kw_sw_q0p0219 1 100 -720.000000000 719.978027344 FORMAT "%13.9" ECU_ADDRESS 0x70002294 /end MEASUREMENT
/begin MEASUREMENT KnDet_phiMeasWinBgn "angle begin of measuring window with lead" SWORD kw_sw_q0p0219 1 100 -720.0000 719.9780 FORMAT "%8.4" ECU_ADDRESS 0x600005B2 /end MEASUREMENT
/begin MEASUREMENT KnDet_phiMeasWinBgnKnk "angle knock measurement window begin" SWORD kw_sw_q0p0219 1 100 -720.0000 719.9780 FORMAT "%8.4" ECU_ADDRESS 0x600005B4 /end MEASUREMENT
/begin MEASUREMENT KnDet_phiMeasWinBgnPre "angle knock measurement window end" SWORD kw_sw_q0p0219 1 100 -720.0000 719.9780 FORMAT "%8.4" ECU_ADDRESS 0x70002292 /end MEASUREMENT
/begin MEASUREMENT KnDet_phiMeasWinLngth "angle length of measuring window with lead" SWORD kw_sw_q0p0219 1 100 -720.0000 719.9780 FORMAT "%8.4" ECU_ADDRESS 0x600005B6 /end MEASUREMENT
/begin MEASUREMENT KnDet_phiMeasWinLngthKnk "angle length of measurement window (knock measurement window)" SWORD kw_sw_q0p0219 1 100 -720.0000 719.9780 FORMAT "%8.4" ECU_ADDRESS 0x600005B8 /end MEASUREMENT
/begin MEASUREMENT KnDet_phiMeasWinLngthOld "angle length of measuring window old" SWORD kw_sw_q0p0219 1 100 -720.0000 719.9780 FORMAT "%8.4" ECU_ADDRESS 0x600005BA /end MEASUREMENT
/begin MEASUREMENT KnDet_phiMeasWinLngthPre "angle pre ignition measurement window begin" SWORD kw_sw_q0p0219 1 100 -720.0000 719.9780 FORMAT "%8.4" ECU_ADDRESS 0x70002290 /end MEASUREMENT
/begin MEASUREMENT KnDet_PreInvldBuf0 "result additional measurement window invalid buffer 0" UBYTE B_TRUE 1 100 0.00 1.00000000000 BIT_MASK 0x1 FORMAT "%13.11" ECU_ADDRESS 0x70002267 /end MEASUREMENT
/begin MEASUREMENT KnDet_PreInvldBuf1 "result additional measurement window invalid buffer 1" UBYTE B_TRUE 1 100 0.00 1.00000000000 BIT_MASK 0x1 FORMAT "%13.11" ECU_ADDRESS 0x70002266 /end MEASUREMENT
/begin MEASUREMENT KnDet_PreInvldBuf2 "result additional measurement window invalid buffer 2" UBYTE B_TRUE 1 100 0.00 1.00000000000 BIT_MASK 0x1 FORMAT "%13.11" ECU_ADDRESS 0x70002265 /end MEASUREMENT
/begin MEASUREMENT KnDet_ReqChk "line diagnosis requested" UBYTE dez 1 100 0.00 255.0 FORMAT "%5.1" ECU_ADDRESS 0x600008E1 /end MEASUREMENT
/begin MEASUREMENT KnDet_ReqSigEvalMode "KnDet: Mode for signal evaluation" UBYTE dez 1 100 0.00 255.0 FORMAT "%5.1" ECU_ADDRESS 0x600008E2 /end MEASUREMENT
/begin MEASUREMENT KnDet_RlsChkMeasWin "release measuring window plausibility check" UBYTE dez 1 100 0.00 255.0 FORMAT "%5.1" ECU_ADDRESS 0x600008E3 /end MEASUREMENT
/begin MEASUREMENT KnDet_RlsChkWinMeas "release plausibility check measurement window" UBYTE dez 1 100 0.00 255.0 FORMAT "%5.1" ECU_ADDRESS 0x6000B790 /end MEASUREMENT
/begin MEASUREMENT KnDet_SensMode "HW diagnosis mode" UBYTE dez 1 100 0.00 255.0 FORMAT "%5.1" ECU_ADDRESS 0x600008E4 /end MEASUREMENT
/begin MEASUREMENT KnDet_stCalMeasWin "state measurement window at application interface" UBYTE dez 1 100 0.00 255.0 FORMAT "%5.1" ECU_ADDRESS 0x600008ED /end MEASUREMENT
/begin MEASUREMENT KnDet_stDiaBuf0 "result KnDet internal check buffer 0" UBYTE dez 1 100 0.00 255.0 FORMAT "%5.1" ECU_ADDRESS 0x50000962 /end MEASUREMENT
/begin MEASUREMENT KnDet_stDiaBuf1 "result KnDet internal check buffer 1" UBYTE dez 1 100 0.00 255.0 FORMAT "%5.1" ECU_ADDRESS 0x50000963 /end MEASUREMENT
/begin MEASUREMENT KnDet_stDiaBuf2 "result KnDet internal check buffer 2" UBYTE dez 1 100 0.00 255.0 FORMAT "%5.1" ECU_ADDRESS 0x50000964 /end MEASUREMENT
/begin MEASUREMENT KnDet_stDiaCtl "status diagnosis control" UBYTE dez 1 100 0.00 255.0 FORMAT "%5.1" ECU_ADDRESS 0x600008EE /end MEASUREMENT
/begin MEASUREMENT KnDet_stDiaCtlBuf0 "state diagnosis control buffer 0" UBYTE dez 1 100 0.00 255.0 FORMAT "%5.1" ECU_ADDRESS 0x50000965 /end MEASUREMENT
/begin MEASUREMENT KnDet_stDiaCtlBuf1 "state diagnosis control buffer 1" UBYTE dez 1 100 0.00 255.0 FORMAT "%5.1" ECU_ADDRESS 0x50000966 /end MEASUREMENT
/begin MEASUREMENT KnDet_stDiaCtlBuf2 "state diagnosis control buffer 2" UBYTE dez 1 100 0.00 255.0 FORMAT "%5.1" ECU_ADDRESS 0x50000967 /end MEASUREMENT
/begin MEASUREMENT KnDet_stGetDigRawVal "status data acquisition" ULONG dez 1 100 0.00 4294967295.00 FORMAT "%13.2" ECU_ADDRESS 0x60000420 /end MEASUREMENT
/begin MEASUREMENT KnDet_stMeasWin "status measuring window output" UBYTE dez 1 100 0.00 255.0 FORMAT "%5.1" ECU_ADDRESS 0x600008EF /end MEASUREMENT
/begin MEASUREMENT KnDet_stRlsDiaBuf0 "relase measurement window plaus. check buffer 0" UBYTE dez 1 100 0.00 255.0 FORMAT "%5.1" ECU_ADDRESS 0x50000968 /end MEASUREMENT
/begin MEASUREMENT KnDet_stRlsDiaBuf1 "relase measurement window plaus. check buffer 1" UBYTE dez 1 100 0.00 255.0 FORMAT "%5.1" ECU_ADDRESS 0x50000969 /end MEASUREMENT
/begin MEASUREMENT KnDet_stRlsDiaBuf2 "relase measurement window plaus. check buffer 2" UBYTE dez 1 100 0.00 255.0 FORMAT "%5.1" ECU_ADDRESS 0x5000096A /end MEASUREMENT
/begin MEASUREMENT KnDet_stSigEval "status of the signal evaluation" UBYTE dez 1 100 0.00 255.0 FORMAT "%5.1" ECU_ADDRESS 0x600008F0 /end MEASUREMENT
/begin MEASUREMENT KnDet_stSigEvalCurrCmb "status Complex Driver KnDet current combustion" ULONG dez 1 100 0.00 4294967295.00 FORMAT "%13.2" ECU_ADDRESS 0x50000314 /end MEASUREMENT
/begin MEASUREMENT KnDet_stSigEvalCurrCmbAddWin "status Complex Driver KnDet current combustion (additional measurement window)" UBYTE dez 1 100 0.00 255.0 FORMAT "%5.1" ECU_ADDRESS 0x70002264 /end MEASUREMENT
/begin MEASUREMENT KnDet_stSigEvalCurrCmbLstEntry "Last reported error for the knock sensor signal evaluation" ULONG dez 1 100 0.00 4294967295.00 FORMAT "%13.2" ECU_ADDRESS 0x600004F0 /end MEASUREMENT
/begin MEASUREMENT KnDet_tiLenMeasWinMeasd "Length of measurement window, measured" ULONG t_us_q1 1 100 0.00 4294967295.00 FORMAT "%13.2" ECU_ADDRESS 0x70002260 /end MEASUREMENT
/begin MEASUREMENT KnDet_tiSeg "time for angle range" SLONG t_q0p00000005 1 100 -107.500000025 107.499999975 FORMAT "%13.9" ECU_ADDRESS 0x70002244 /end MEASUREMENT
/begin MEASUREMENT KnDet_vDiagVal "voltage for diagnosis" SWORD RBPtCel_u_1p60514em4_1 1 100 -5.259711 5.259551 FORMAT "%8.6" ECU_ADDRESS 0x6000734C /end MEASUREMENT
/begin MEASUREMENT KnDet_vNewAddIntegWinEndArr "new integrator values at the end of the measuring window (additonal measurement window)" ULONG dez 1 100 0.00 4294967295.00 FORMAT "%13.2" ARRAY_SIZE 3 ECU_ADDRESS 0x7000222C /end MEASUREMENT
/begin MEASUREMENT KnDet_vNewIntegTmp "integration intermediate values" ULONG dez 1 100 0.00 4294967295.00 FORMAT "%13.2" ARRAY_SIZE 3 ECU_ADDRESS 0x70002238 /end MEASUREMENT
/begin MEASUREMENT KnDet_vNewIntegWinEnd "new integrator value at the end of the measuring window" ULONG dez 1 100 0.00 4294967295.00 FORMAT "%13.2" ARRAY_SIZE 3 ECU_ADDRESS 0x50000318 /end MEASUREMENT
/begin MEASUREMENT KnDet_vValOffs "DC voltage offset" SWORD RBPtCel_u_1p60514em4_1 1 100 -5.259711 5.259551 FORMAT "%8.6" ECU_ADDRESS 0x600005BC /end MEASUREMENT
/begin MEASUREMENT mdmnkhkt_w "desired min. torque for operation point request for catalyst heating during cold start" UWORD rel_uw_b100 1 100 0.00 99.99847 FORMAT "%8.5" ECU_ADDRESS 0x60007396 /end MEASUREMENT
/begin MEASUREMENT mdmnkhkw_w "desired min. torque for operation point request for catalyst heating (catalyst warming)" UWORD rel_uw_b100 1 100 0.00 99.99847 FORMAT "%8.5" ECU_ADDRESS 0x60007394 /end MEASUREMENT
/begin MEASUREMENT mdmnkh_w_msg "requested operating conditions: min. torque for catalyst heating" UWORD rel_uw_b100 1 100 0.00 99.99847 FORMAT "%8.5" ECU_ADDRESS 0x600149AC /end MEASUREMENT
/begin MEASUREMENT mdmnktl_w "desired min. desired torque for operation point request for catalyst heating (during cold start) during idle speed" UWORD rel_uw_b100 1 100 0.00 99.99847 FORMAT "%8.5" ECU_ADDRESS 0x60007392 /end MEASUREMENT
/begin MEASUREMENT mdmnktt_w "desired min. desired torque for operation point request for catalyst heating (during cold start) during part load" UWORD rel_uw_b100 1 100 0.00 99.99847 FORMAT "%8.5" ECU_ADDRESS 0x60007390 /end MEASUREMENT
/begin MEASUREMENT mdmxkhkt_w "desired max. torque for operation point request for catalyst heating during cold start" UWORD rel_uw_b100 1 100 0.00 99.99847 FORMAT "%8.5" ECU_ADDRESS 0x6000738E /end MEASUREMENT
/begin MEASUREMENT mdmxkhkw_w "max. desired torque for operation point request for catalyst heating (catalyst warming)" UWORD rel_uw_b100 1 100 0.00 99.99847 FORMAT "%8.5" ECU_ADDRESS 0x6000738C /end MEASUREMENT
/begin MEASUREMENT mdmxkh_w_msg "desired maximum torque for operation point request for catalyst heating (during cold start)" UWORD rel_uw_b100 1 100 0.00 99.99847 FORMAT "%8.5" ECU_ADDRESS 0x600149AE /end MEASUREMENT
/begin MEASUREMENT mdmxktl_w "max. desired torque for operation point request for catalyst heating (during cold start) during idle speed" UWORD rel_uw_b100 1 100 0.00 99.99847 FORMAT "%8.5" ECU_ADDRESS 0x6000738A /end MEASUREMENT
/begin MEASUREMENT mdmxktt_w "max. desired torque for operation point request for catalyst heating (during cold start) during part load" UWORD rel_uw_b100 1 100 0.00 99.99847 FORMAT "%8.5" ECU_ADDRESS 0x60007388 /end MEASUREMENT
/begin MEASUREMENT mimxkhbk_w "maximum allowed desired torque of air path in case of brake booster" UWORD rel_uw_b100 1 100 0.00 99.99847 FORMAT "%8.5" ECU_ADDRESS 0x60007354 /end MEASUREMENT
/begin MEASUREMENT priobbkh_msg "priority of requested operating conditions for catalyst heating" UBYTE dez 1 100 0.00 255.0 FORMAT "%5.1" ECU_ADDRESS 0x60014AF4 /end MEASUREMENT
/begin MEASUREMENT tmstchtr_w "engine temperature at start (eng. coolant or cyl. head), local copy" SWORD Temp_Cels 1 100 -3549.940 3003.560 FORMAT "%8.3" ECU_ADDRESS 0x60007352 /end MEASUREMENT
/begin MEASUREMENT zwkhktl_w "desired ignition-timing for catalyst heating in case of cold start by idle" SWORD zw_q2p9297Em3_deg_KW 1 100 -96.00000 95.99707 FORMAT "%8.5" ECU_ADDRESS 0x60007350 /end MEASUREMENT
/begin MEASUREMENT zwkhktt_w "desired eignition-timing for catalyst heating in case of cold start by part load" SWORD zw_q2p9297Em3_deg_KW 1 100 -96.00000 95.99707 FORMAT "%8.5" ECU_ADDRESS 0x6000734E /end MEASUREMENT
/begin FUNCTION IVGdiCtl_CvoDiag "22.0.1_1.0.0Controlled valve operation diagnosis"
 /begin DEF_CHARACTERISTIC IVGdiCtl_cntrCvoDiagDeltaTiErrCntLimBall_C IVGdiCtl_cntrCvoDiagDeltaTiErrCntLimFull_C IVGdiCtl_cntrCvoDiagDeltaTiHealCntLimBall_C IVGdiCtl_cntrCvoDiagDeltaTiHealCntLimFull_C IVGdiCtl_cntrCvoDiagErrCntLimCvoVlvTiDly_C IVGdiCtl_cntrCvoDiagErrCntLimDeltaTiOpen_C IVGdiCtl_cntrCvoDiagErrLimNoTab_C IVGdiCtl_cntrCvoDiagFullTestBallInj_C IVGdiCtl_cntrCvoDiagHealLimNoTab_C IVGdiCtl_cntrCvoDiagInjSmrCdnBall_C IVGdiCtl_cntrCvoDiagInjSmrCdnFull_C IVGdiCtl_cntrCvoDiagSigEvlnErr_C IVGdiCtl_cntrCvoDiagSigEvlnHeal_C IVGdiCtl_cntrCvoDiagSigEvlnMilOff_C IVGdiCtl_cntrCvoDiagSigEvlnMilOn_C IVGdiCtl_cntrCvoDiagVlvClsTiErrCntLim_C IVGdiCtl_cntrNewBaseAdpnByPhy_C IVGdiCtl_CvoDiag_deltaTiLimNeg_CA IVGdiCtl_CvoDiag_deltaTiLimPos_CA IVGdiCtl_CvoDiag_TiOpenUpprBal_C IVGdiCtl_CvoDiag_tiVcosDeltaLimNegUpprBal_CA IVGdiCtl_CvoDiag_tiVcosDeltaLimNeg_CA IVGdiCtl_CvoDiag_tiVcosDeltaLimPosUpprBal_CA IVGdiCtl_CvoDiag_tiVcosDeltaLimPos_CA IVGdiCtl_CvoDiag_tiVcosNegTolrDftCvoVlvDly_CA IVGdiCtl_CvoDiag_tiVcosPosTolrDftCvoVlvDly_CA IVGdiCtl_facCvoDiagTestBallInjMax_C IVGdiCtl_stCvoDiagSimrCdnEna_C IVGdiCtl_stCvoDiag_C IVGdiCtl_tCvoDiagEnaMax_C IVGdiCtl_tCvoDiagEnaMin_C IVGdiCtl_tCvoDiagSmrCdn_C IVGdiCtl_tiCvoDiagIdleMinAdpn_C IVGdiCtl_tiCvoDiagLimFullLftVlvClsMax_C IVGdiCtl_tiCvoDiagLimFullLftVlvClsMin_C IVGdiCtl_tiCvoDiagLimTranDeltaTiOpenNeg_C IVGdiCtl_tiCvoDiagLimTranDeltaTiOpenPos_C IVGdiCtl_uCvoDiagBufBgnThd_C IVGdiCtl_uCvoDiagBufEndThd_C /end DEF_CHARACTERISTIC
 /begin REF_CHARACTERISTIC InjSys_idxVcosPntTran_C InjSys_vcosCvo_Ax IVGdiCtl_CvoAdpn_DrgPtrClr_C /end REF_CHARACTERISTIC
 /begin IN_MEASUREMENT CEngDsT_t Eep_EnvRamInvld Epm_ctCyl Epm_numCyl InjSys_vcosPntCvo IVGdiCtl_CvoAdpn_Bal_stCtrlRunngMask IVGdiCtl_CvoAdpn_FullLft_stCtrlRunngMask IVGdiCtl_CvoAdpn_MeasFrzFrm_t.Cyl IVGdiCtl_CvoAdpn_MeasFrzFrm_t.POper IVGdiCtl_CvoAdpn_MeasFrzFrm_t.Pls IVGdiCtl_CvoAdpn_MeasFrzFrm_t.PlsInfo IVGdiCtl_CvoAdpn_MeasFrzFrm_t.Valid IVGdiCtl_CvoAdpn_MeasFrzFrm_t.VcosOper IVGdiCtl_CvoAdpn_MeasFrzFrm_t.desTiOpen IVGdiCtl_CvoAdpn_MeasFrzFrm_t.dti IVGdiCtl_CvoAdpn_MeasFrzFrm_t.idxP IVGdiCtl_CvoAdpn_MeasFrzFrm_t.idxVcos IVGdiCtl_CvoAdpn_MeasFrzFrm_t.tiPse IVGdiCtl_CvoAdpn_PPrioAry_u8 SyC_ctDrvEnter zzylh_msg /end IN_MEASUREMENT
 /begin OUT_MEASUREMENT IVGdiCtl_stCvoCylErrMax IVGdiCtl_stCvoCylErrMin IVGdiCtl_stCvoCylHealMax IVGdiCtl_stCvoCylHealMin IVGdiCtl_stCvoTestInjBallReq IVGdiCtl_stMaxCtrlrErrMask IVGdiCtl_stMaxCtrlrHealMask IVGdiCtl_stMaxErrMaskBascAdpn IVGdiCtl_stMaxHealMaskBascAdpn IVGdiCtl_stMinCtrlrErrMask IVGdiCtl_stMinCtrlrHealMask IVGdiCtl_stMinErrMaskBascAdpn IVGdiCtl_stMinHealMaskBascAdpn /end OUT_MEASUREMENT
 /begin LOC_MEASUREMENT IVGdiCtl_cntrCvoAllCylErr IVGdiCtl_cntrCvoCylMinMaxErrTstd IVGdiCtl_cntrCvoCylMinOrMaxErrTstd IVGdiCtl_cntrCvoDeltaTiOpenErrTolrMax IVGdiCtl_cntrCvoDeltaTiOpenErrTolrMin IVGdiCtl_cntrCvoDiagCyl IVGdiCtl_cntrCvoDiagCylTmp IVGdiCtl_cntrCvoDiagNoTabErr IVGdiCtl_cntrCvoDiagNoTabHeal IVGdiCtl_cntrCvoInjBall IVGdiCtl_cntrCvoInjFull IVGdiCtl_cntrCvoInjFullEnaTestBall IVGdiCtl_cntrCvoInjTestBall IVGdiCtl_cntrCvoSigEvlnErr IVGdiCtl_cntrCvoSigEvlnErrMilOff IVGdiCtl_cntrCvoSigEvlnErrMilOn IVGdiCtl_cntrCvoSigEvlnHeal IVGdiCtl_cntrCvoVlvClsTiErrTolrMax IVGdiCtl_cntrCvoVlvClsTiErrTolrMin IVGdiCtl_cntrCvoVlvClsTiHealTolrMax IVGdiCtl_cntrCvoVlvClsTiHealTolrMin IVGdiCtl_cntrCvoVlvDlyTiErrTolrMax IVGdiCtl_cntrCvoVlvDlyTiErrTolrMin IVGdiCtl_cntrErrTolrRngDeltaTiBallMax IVGdiCtl_cntrErrTolrRngDeltaTiBallMin IVGdiCtl_cntrErrTolrRngDeltaTiFullMax IVGdiCtl_cntrErrTolrRngDeltaTiFullMin IVGdiCtl_cntrHealTolrRngDeltaTiBallMax IVGdiCtl_cntrHealTolrRngDeltaTiBallMin IVGdiCtl_cntrHealTolrRngDeltaTiFullMax IVGdiCtl_cntrHealTolrRngDeltaTiFullMin IVGdiCtl_cntrMaxCvoDiagErrMilOff IVGdiCtl_cntrMaxCvoDiagErrMilOffCopy IVGdiCtl_cntrMaxCvoDiagErrMilOn IVGdiCtl_cntrMaxCvoDiagErrMilOnCopy IVGdiCtl_cntrMinCvoDiagErrMilOff IVGdiCtl_cntrMinCvoDiagErrMilOffCopy IVGdiCtl_cntrMinCvoDiagErrMilOn IVGdiCtl_cntrMinCvoDiagErrMilOnCopy IVGdiCtl_cntrNewBaseAdpnByPhy IVGdiCtl_CvoDiag_ctReIni IVGdiCtl_CvoDiag_currDeltaTiBall IVGdiCtl_CvoDiag_currDeltaTiFull IVGdiCtl_CvoDiag_DeltaTiOpenMax_I.IVGdiCtl_flgReqBascAdpn IVGdiCtl_CvoDiag_DeltaTiOpenMin_I.IVGdiCtl_flgReqBascAdpn IVGdiCtl_CvoDiag_desTiOpen IVGdiCtl_CvoDiag_DTiErrHealBalMax_I.IVGdiCtl_flgReqBascAdpn IVGdiCtl_CvoDiag_DTiErrHealBalMax_I.IVGdiCtl_stErrSuspcDeltaTi IVGdiCtl_CvoDiag_DTiErrHealBalMax_I.IVGdiCtl_stNewBascAdpn IVGdiCtl_CvoDiag_DTiErrHealBalMax_I._tmp1 IVGdiCtl_CvoDiag_DTiErrHealBalMin_I.IVGdiCtl_flgReqBascAdpn IVGdiCtl_CvoDiag_DTiErrHealBalMin_I.IVGdiCtl_stErrSuspcDeltaTi IVGdiCtl_CvoDiag_DTiErrHealBalMin_I.IVGdiCtl_stNewBascAdpn IVGdiCtl_CvoDiag_DTiErrHealBalMin_I._tmp1 IVGdiCtl_CvoDiag_DTiErrHealFullMax_I.IVGdiCtl_stErrSuspcDeltaTi IVGdiCtl_CvoDiag_DTiErrHealFullMax_I.IVGdiCtl_stNewBascAdpn IVGdiCtl_CvoDiag_DTiErrHealFullMin_I.IVGdiCtl_stErrSuspcDeltaTi IVGdiCtl_CvoDiag_DTiErrHealFullMin_I.IVGdiCtl_stNewBascAdpn IVGdiCtl_CvoDiag_stBallDeltaTiErrMax IVGdiCtl_CvoDiag_stBallDeltaTiErrMin IVGdiCtl_CvoDiag_stBallDeltaTiHealMax IVGdiCtl_CvoDiag_stBallDeltaTiHealMin IVGdiCtl_CvoDiag_stFullDeltaTiErrMax IVGdiCtl_CvoDiag_stFullDeltaTiErrMin IVGdiCtl_CvoDiag_stFullDeltaTiHealMax IVGdiCtl_CvoDiag_stFullDeltaTiHealMin IVGdiCtl_CvoDiag_TantotErrHealMax_I.IVGdiCtl_flgReqBascAdpn IVGdiCtl_CvoDiag_TantotErrHealMin_I.IVGdiCtl_flgReqBascAdpn IVGdiCtl_CvoDiag_tiVcosDeltaAdpnLimNeg IVGdiCtl_CvoDiag_tiVcosDeltaAdpnLimPos IVGdiCtl_CvoDiag_tiVcosNegTolrDftCvoVlvDly IVGdiCtl_CvoDiag_tiVcosPosTolrDftCvoVlvDly IVGdiCtl_cylCvoDiagSigEval IVGdiCtl_cylCvoDiagTab IVGdiCtl_cylCvoDiagTantot IVGdiCtl_flgAdpnCmpl IVGdiCtl_flgAdpnDeltaTiErrMax IVGdiCtl_flgAdpnDeltaTiErrMin IVGdiCtl_flgAdpnDeltaTiHealMax IVGdiCtl_flgAdpnDeltaTiHealMin IVGdiCtl_flgBallDeltaTiErrMax IVGdiCtl_flgBallDeltaTiErrMin IVGdiCtl_flgBallDeltaTiHealMax IVGdiCtl_flgBallDeltaTiHealMin IVGdiCtl_flgBufBgnErr IVGdiCtl_flgBufEndErr IVGdiCtl_flgCvoDiagBascAdpnCvo IVGdiCtl_flgCvoDiagCtrlrErr IVGdiCtl_flgCvoDiagCtrlrStab IVGdiCtl_flgCvoDiagDSMEnad IVGdiCtl_flgCvoDiagEnad IVGdiCtl_flgCvoDiagEngTOk IVGdiCtl_flgCvoDiagSigEvlnChk IVGdiCtl_flgCvoDiagSmrCdnEnad IVGdiCtl_flgCvoDiagSmrCdnEnadErrSigPlaus IVGdiCtl_flgCvoVlvClsTiErrMax IVGdiCtl_flgCvoVlvClsTiErrMin IVGdiCtl_flgCvoVlvClsTiHealMax IVGdiCtl_flgCvoVlvClsTiHealMin IVGdiCtl_flgCvoVlvDlyDetn IVGdiCtl_flgCvoVlvDlyErrMax IVGdiCtl_flgCvoVlvDlyErrMin IVGdiCtl_flgCvoVlvDlyHealMax IVGdiCtl_flgCvoVlvDlyHealMin IVGdiCtl_flgCvoVlvDlyPlaus IVGdiCtl_flgEngTEnadOff IVGdiCtl_flgErrCvoSigEvlnSmrCdn IVGdiCtl_flgFcmClrReq IVGdiCtl_flgFullDeltaTiErrMax IVGdiCtl_flgFullDeltaTiErrMin IVGdiCtl_flgFullDeltaTiHealMax IVGdiCtl_flgFullDeltaTiHealMin IVGdiCtl_flgMaxBascAdpnFinshdCylBall IVGdiCtl_flgMaxBascAdpnFinshdCylFull IVGdiCtl_flgMinBascAdpnFinshdCylBall IVGdiCtl_flgMinBascAdpnFinshdCylFull IVGdiCtl_flgNoVlvClsTiSmrCdn IVGdiCtl_flgPlatSlopErrMax IVGdiCtl_flgPlatSlopErrMin IVGdiCtl_flgPlatSlopHealMax IVGdiCtl_flgPlatSlopHealMin IVGdiCtl_flgSmrCdnDTiMaxBall IVGdiCtl_flgSmrCdnDTiMaxFull IVGdiCtl_flgSmrCdnDTiMinBall IVGdiCtl_flgSmrCdnDTiMinFull IVGdiCtl_flgSmrCdnVlvClsTiMax IVGdiCtl_flgSmrCdnVlvClsTiMin IVGdiCtl_nrCvoDiagPls IVGdiCtl_pCvoDiagMax IVGdiCtl_pCvoDiagMin IVGdiCtl_stBallDeltaTiErrMax IVGdiCtl_stBallDeltaTiErrMaxTmp IVGdiCtl_stBallDeltaTiErrMin IVGdiCtl_stBallDeltaTiErrMinTmp IVGdiCtl_stBallDeltaTiHealMax IVGdiCtl_stBallDeltaTiHealMaxTmp IVGdiCtl_stBallDeltaTiHealMin IVGdiCtl_stBallDeltaTiHealMinTmp IVGdiCtl_stCvoCylLockd IVGdiCtl_stCvoCylLockdEngT IVGdiCtl_stCvoDiagEvalDeltaTiBall IVGdiCtl_stCvoDiagEvalDeltaTiFull IVGdiCtl_stCvoDiagMaxErrTmp IVGdiCtl_stCvoDiagMinErrTmp IVGdiCtl_stCvoDiagTranErr IVGdiCtl_stCvoSigEvlnErr IVGdiCtl_stCvoSigEvlnErrHealSmrCdn IVGdiCtl_stCvoSigEvlnErrMilOfflocked IVGdiCtl_stCvoSigEvlnErrMilOnlocked IVGdiCtl_stCvoSigEvlnErrSmrCdn IVGdiCtl_stCvoSigEvlnHeal IVGdiCtl_stCvoSigEvlnMil IVGdiCtl_stCvoSigEvlnMilTmp IVGdiCtl_stCvoTestInjBallReqTmp IVGdiCtl_stErrMaskBascAdpnSmrCdnMax IVGdiCtl_stErrMaskBascAdpnSmrCdnMin IVGdiCtl_stErrSuspcTolrRngDeltaTiBallMax IVGdiCtl_stErrSuspcTolrRngDeltaTiBallMin IVGdiCtl_stErrSuspcTolrRngDeltaTiFullMax IVGdiCtl_stErrSuspcTolrRngDeltaTiFullMin IVGdiCtl_stFcmFrzExists IVGdiCtl_stFullLftDeltaTiErrMax IVGdiCtl_stFullLftDeltaTiErrMaxTmp IVGdiCtl_stFullLftDeltaTiErrMin IVGdiCtl_stFullLftDeltaTiErrMinTmp IVGdiCtl_stFullLftDeltaTiHealMax IVGdiCtl_stFullLftDeltaTiHealMaxTmp IVGdiCtl_stFullLftDeltaTiHealMin IVGdiCtl_stFullLftDeltaTiHealMinTmp IVGdiCtl_stMaxCtrlrErrMaskCopy IVGdiCtl_stMaxCtrlrErrMaskSmrCdn IVGdiCtl_stMaxCvoDiagDfc IVGdiCtl_stMaxCvoDiagErrMilOfflocked IVGdiCtl_stMaxCvoDiagErrMilOfflockedCopy IVGdiCtl_stMaxCvoDiagErrMilOnlocked IVGdiCtl_stMaxCvoDiagErrMilOnlockedCopy IVGdiCtl_stMaxCvoDiagMil IVGdiCtl_stMaxCvoDiagMilTmp IVGdiCtl_stMaxCvoDiagSimilarDfc IVGdiCtl_stMaxCylAdpnReqBall IVGdiCtl_stMaxCylAdpnReqFull IVGdiCtl_stMinCtrlrErrMaskCopy IVGdiCtl_stMinCtrlrErrMaskSmrCdn IVGdiCtl_stMinCvoDiagDfc IVGdiCtl_stMinCvoDiagErrMilOfflocked IVGdiCtl_stMinCvoDiagErrMilOfflockedCopy IVGdiCtl_stMinCvoDiagErrMilOnlocked IVGdiCtl_stMinCvoDiagErrMilOnlockedCopy IVGdiCtl_stMinCvoDiagMil IVGdiCtl_stMinCvoDiagMilTmp IVGdiCtl_stMinCvoDiagSimilarDfc IVGdiCtl_stMinCylAdpnReqBall IVGdiCtl_stMinCylAdpnReqFull IVGdiCtl_stNoClsTiErr IVGdiCtl_tiCurrCvoVlvCls IVGdiCtl_tiCvoDiagBallCurrDeltaTi IVGdiCtl_tiCvoDiagCurrDeltaTi IVGdiCtl_tiCvoDiagFullCurrDeltaTi IVGdiCtl_tiCvoDiagIdle IVGdiCtl_tiCvoDiagIntegdDeltaTi IVGdiCtl_tiCvoVlvDlyCurr IVGdiCtl_tiCvoVlvDlyDft IVGdiCtl_tiDeltaTiOpenCurr IVGdiCtl_tiLimdCvoVlvCls IVGdiCtl_uCvoDiagBufBgn IVGdiCtl_uCvoDiagbufEnd IVGdiCtl_uCvoDiagDrgPtrBufBgn IVGdiCtl_uCvoDiagDrgPtrBufEnd IVGdiCtl_vcosCvoDiagMax IVGdiCtl_vcosCvoDiagMin /end LOC_MEASUREMENT
 FUNCTION_VERSION "22.0.1_1.0.0" /end FUNCTION
/begin FUNCTION IVGdiCtl_CvoSigAcq "20.13.0_2.0.0Hardware Driver Controlled Valve Operation, signal acquisition" /begin DEF_CHARACTERISTIC IVGdiCtl_CvoSigAcq_measBufOffset_C /end DEF_CHARACTERISTIC /begin OUT_MEASUREMENT IVGdiCtl_CvoSigAcq_AcqCtr /end OUT_MEASUREMENT
 /begin LOC_MEASUREMENT IVGdiCtl_CvoSigAcq_deltaTmeasBegin IVGdiCtl_CvoSigAcq_ErrorFlg IVGdiCtl_CvoSigAcq_InfoFlg IVGdiCtl_CvoSigAcq_MeasChl IVGdiCtl_CvoSigAcq_MeasTi IVGdiCtl_CvoSigAcq_StartedMeasCtr IVGdiCtl_CvoSigAcq_tADCRed IVGdiCtl_CvoSigAcq_tGate /end LOC_MEASUREMENT
 FUNCTION_VERSION "20.13.0_2.0.0" /end FUNCTION
/begin FUNCTION IVGdiCtl_CvoSigEvln "22.0.1    Component Driver Controlled Valve Operation, signal evaluation"
 /begin DEF_CHARACTERISTIC IVGdiCtl_CvoSigEvln_cal11_C IVGdiCtl_CvoSigEvln_cal13_C IVGdiCtl_CvoSigEvln_cal14_C IVGdiCtl_CvoSigEvln_cal15_C IVGdiCtl_CvoSigEvln_cal16_C IVGdiCtl_CvoSigEvln_cal27_C IVGdiCtl_CvoSigEvln_cal36_C IVGdiCtl_CvoSigEvln_cal37_C IVGdiCtl_CvoSigEvln_cal38_C IVGdiCtl_CvoSigEvln_cal39_C IVGdiCtl_CvoSigEvln_cal46_C IVGdiCtl_CvoSigEvln_cal47_C IVGdiCtl_CvoSigEvln_cal55_C IVGdiCtl_CvoSigEvln_cal56_C IVGdiCtl_CvoSigEvln_cal57_C IVGdiCtl_CvoSigEvln_cal58_C IVGdiCtl_CvoSigEvln_cal59_C IVGdiCtl_CvoSigEvln_cal60_C IVGdiCtl_CvoSigEvln_cal64_C IVGdiCtl_CvoSigEvln_cal65_C IVGdiCtl_CvoSigEvln_cal66_C IVGdiCtl_CvoSigEvln_cal67_C IVGdiCtl_CvoSigEvln_cal68_C IVGdiCtl_CvoSigEvln_cal69_C IVGdiCtl_CvoSigEvln_cal70_C IVGdiCtl_CvoSigEvln_cal71_C IVGdiCtl_CvoSigEvln_cal72_C IVGdiCtl_CvoSigEvln_cal73_C IVGdiCtl_CvoSigEvln_cal75_C IVGdiCtl_CvoSigEvln_cal76_C IVGdiCtl_CvoSigEvln_cal77_C IVGdiCtl_CvoSigEvln_cal78_C IVGdiCtl_CvoSigEvln_cal79_C IVGdiCtl_CvoSigEvln_cal80_C IVGdiCtl_CvoSigEvln_cal82_C IVGdiCtl_CvoSigEvln_cal83_C IVGdiCtl_CvoSigEvln_cal84_C IVGdiCtl_CvoSigEvln_cal85_C IVGdiCtl_CvoSigEvln_Cyl_SimErr_C IVGdiCtl_CvoSigEvln_NoTabDiag_SimErr_C IVGdiCtl_CvoSigEvln_PlausSigDiag_SimErr_C /end DEF_CHARACTERISTIC
 /begin IN_MEASUREMENT Epm_numCyl InjSys_flgAdpnCvo InjSys_flgBascAdpnCvo InjSys_flgCtrlCvo InjSys_flgRstBascAdpnCvo InjSys_flgSysGenRelsCvo InjSys_tiInjRefBgnTrans InjSys_tiInjRefCvo InjVvG_CvoAdpn_RmnCylMask InjVvG_CvoAdpn_Tran_RmnCylMask IVGdiCtl_CvoSigAcq_AcqCtr /end IN_MEASUREMENT
 /begin OUT_MEASUREMENT InjVvG_desCylMsk InjVvG_desTiAry IVGdiCtl_CvoSigEvln_AcqCtr IVGdiCtl_CvoSigEvln_CsersAcqCntr IVGdiCtl_CvoSigEvln_CsersCyl IVGdiCtl_CvoSigEvln_CsersPulse IVGdiCtl_CvoSigEvln_CsersTab IVGdiCtl_CvoSigEvln_Status /end OUT_MEASUREMENT
 FUNCTION_VERSION "22.0.1" /end FUNCTION
/begin FUNCTION KHANFMO "3.36.0    Request of torque for catalyst heating"
 /begin DEF_CHARACTERISTIC ANFKWPR2 DANFKWPR1 ExhMgT_facTrqInrMaxDesCorrn_C ExhMgT_facTrqInrMinDesCorrn_C ExhMgT_nMaxDesCatWrm_T ExhMgT_nMaxDesRatAirM_T ExhMgT_nMinDesCatWrm_T ExhMgT_nMinDesRatAirM_T ExhMgT_stCatHeatgLoadPntShift_C ExhMgT_stOperModCatHeatProgs_M ExhMgT_stOperModCatWrm_M ExhMgT_stOperModDmdWrmUpOff_C ExhMgT_stOperModDmdWrmUpOn_C ExhMgT_stOperModNoStopCatHeatg_C ExhMgT_stWpDmdPrioColdHeatg_C ExhMgT_stWpDmdPrioNoStopCatHeatg_C ExhMgT_stWpDmdPrioWrmHeatg1_C ExhMgT_stWpDmdPrioWrmHeatg2_C ExhMgT_stWpDmdPrioWrmUpOff_C ExhMgT_stWpDmdPrioWrmUp_C ExhMgT_tDeltaEngWrmUpMax_C ExhMgT_tDeltaOelWrmUpMax_C ExhMgT_tEngWrmUpMax_C ExhMgT_tiColdHeatgOff_C ExhMgT_tiTrqInrMaxDesWrmUpOff_C ExhMgT_tOelWrmUpMax_C ExhMgT_tqMaxDesCatWrmIdleLoad_T ExhMgT_tqMaxDesCatWrmPtlLoad_T ExhMgT_tqMinDesCatWrmIdleLoad_T ExhMgT_tqMinDesCatWrmPtlLoad_T ExhMgT_trqInrMaxDesWrmUpMax_C ExhMgT_trqInrMaxDesWrmUpMin_C ExhMgT_trqInrMaxDesWrmUpOff_C ExhMgT_trqInrMaxDesWrmUp_T ExhMgT_trqInrMinDesWrmUp_C FGANGMDMN FGANGMDMX HYANFKWPR KLMDKHAGE KLMDKHTMMN KLMDKHTMMX KLMIMMNKTL KLMIMMNKTT KLMIMMXKTL KLMIMMXKTT /end DEF_CHARACTERISTIC
 /begin REF_CHARACTERISTIC MDNORM /end REF_CHARACTERISTIC
 /begin IN_MEASUREMENT B_khakt_msg B_khakw_msg CEngDsT_t CEngDsT_tStrt ExhMgT_facWghtCatAge ExhMgT_flgCatHeatgUpActv ExhMgT_flgNoStopEngCatHeatg fanfkw_w_msg fmi2trq_w_msg fwetakhkt_msg gangsist_msg imlpr_w_msg OilSwmpT_tMdl PthSet_trqInrWoIntv SyC_ctPostDrvLeave SyC_stSub tnse_w_msg /end IN_MEASUREMENT
 /begin OUT_MEASUREMENT ExhMgT_nMaxDes ExhMgT_nMinDes ExhMgT_stOperModDmdWrmUp ExhMgT_stPrioWpDmdHyb ExhMgT_stPrioWrmUp ExhMgT_stReqOperModDmd ExhMgT_trqInrMaxDes ExhMgT_trqInrMaxDesDiag ExhMgT_trqInrMaxDesWrmUp ExhMgT_trqInrMinDes ExhMgT_trqInrMinDesDiag ExhMgT_trqInrMinDesWrmUp mdmnkh_w_msg mdmxkh_w_msg priobbkh_msg /end OUT_MEASUREMENT
 /begin LOC_MEASUREMENT ExhMgt_ctReIniTqReqCatHeatg ExhMgT_facCatHeatgProgsTqDes ExhMgT_facCatWrmSeln ExhMgT_flgCatWrmUp ExhMgT_flgCatWrmUpOff ExhMgT_flgLoadPntShift0 ExhMgT_flgLoadPntShift1 ExhMgT_flgLoadPntShift2 ExhMgT_flgTqInrMaxDesWrmUp ExhMgT_tqMaxDesCatWrmIdleLoad ExhMgT_tqMaxDesCatWrmPtlLoad ExhMgT_tqMinDesCatWrmIdleLoad ExhMgT_tqMinDesCatWrmPtlLoad ExhMgT_trqInrDes ExhMgT_trqInrMaxDesWrmUpRaw ExhMgT_tTrqCatHeatg ExhMgT_tWarmUpSeln mdmnkhkt_w mdmnkhkw_w mdmnktl_w mdmnktt_w mdmxkhkt_w mdmxkhkw_w mdmxktl_w mdmxktt_w /end LOC_MEASUREMENT
 FUNCTION_VERSION "3.36.0" /end FUNCTION
/begin FUNCTION KHMR "24.23.0_1.1.0required worsening of engine efficiency for catalyst heating"
 /begin DEF_CHARACTERISTIC CWKHMR DETAHOMKH ExhMgT_effCatHeatgLimMax_C ExhMgT_effCatHeatgLimMin_C ExhMgT_effCatHeatgVlvLftDrvgSt_M ExhMgt_etaCatHeatgIdleMod_M ExhMgt_etaCatHeatgPartLoadMod_M ExhMgT_etaCatWrmIdleGearEngd_GM ExhMgT_etaCatWrmIdle_GM ExhMgT_etaCatWrmPartLoad_GM ExhMgT_facCorrnEffOil_M ExhMgt_facEngEffEngCdn_M ExhMgT_facEngEffTStrt_M ExhMgT_facEtaCatWrmAltiT_M ExhMgT_facEtaEngCatHeatg_T ExhMgT_facEtaEngLoVlvLftAltiT_M ExhMgT_facEtaEngLoVlvLftFfv_M ExhMgT_facTEngCatHeatgFilTn_T ExhMgT_facWghCatWrmLimMax_C ExhMgT_facWghCatWrmLimMin_C ExhMgt_facWghDesEngEffAlti_T ExhMgT_iaCatHeatgVlvLftDrvgSt_M ExhMgT_iaCatWrmIdleGearEngd_GM ExhMgT_iaCatWrmIdle_GM ExhMgT_iaCatWrmPartLoad_GM ExhMgT_stEtaCatHeatg_C ExhMgt_tiCatHeatgIdle_C ExhMgt_tiCatHeatgPartLoad_C ExhMgT_tiEtaCatWrmFild_C ExhMgT_tStrtCorrnEffMin_C FETAKHKTKO FETAKHLLAP FETAKHTLAP KFETAKHKTL KFETAKHKTLVH KFETAKHKTT KFETAKHKTTVH KFETAKTFSL KFETAKTFSLVH KFETAKTLSF KFETAKTLSFFS KFETAKTLSFVH KFETAKTTSF KFETAKTTSFVH KFFKWTIVK KFFSTKTMFH KFFSTKTMFHETH KFFSTNSTMS KFFSTNSTMSSF KFZWKHKTL KFZWKHKTLVH KFZWKHKTT KFZWKHKTTVH KFZWKTFSL KFZWKTFSLVH KFZWKTSFL KFZWKTSFLFS KFZWKTSFLVH KFZWKTSFT KFZWKTSFTVH KLDETAKH KLDLUWSKH KLETHINTKH KLFSTIMLPRSF KLFSTKTAGE KLFSTKTAGESF KLINTFSTETA SMG08KHNGUW SMG10KHUW SMG13KHUW SNM08KHUW SNM12KHUW TETAKHKT TETAKHKTLL VFZGKHKT ZKKHKTL ZKKHKTT /end DEF_CHARACTERISTIC
 /begin REF_CHARACTERISTIC KFMIOP /end REF_CHARACTERISTIC
 /begin IN_MEASUREMENT AirC_stCmprAct AirMod_ratChrgAirCyl B_ethadap_msg B_ethhte_msg B_fs_msg B_hsps_msg B_khan_msg B_khmr_msg B_ll_msg B_vhegfe_msg B_vheg_msg CEngDsT_t dsdluts_w_msg EngStrt_bStrtEnd Epm_nEng etafue_w_msg etazwbm_w_msg etazwmn_w_msg ExhMgT_facCatHeatgFinshd ExhMgT_facCatHeatgProgs ExhMgT_facCatHeatgRamp ExhMgT_facWghtCatAge ExhMgT_flgCatHeatgColdStrtReq ExhMgT_flgCatHeatgUpActv ExhMgT_flgCatHeatgWrmReq ExhMgT_tCat1Seln1 ExhMgT_tCatHeatgTCatSelnActn fethmnmx_w_msg Ign_flgHspNxtCmb mifal_w_msg OilSwmpT_tMdl PEnv_facCorrAlti rlmxbkv_w_msg SyC_ctDrvEnter SyC_ctPostDrvLeave SyC_stSub tnse_w_msg VehV_v zwopt_w_msg /end IN_MEASUREMENT
 /begin OUT_MEASUREMENT etaaktsl_w_msg etakhdia_w_msg etakhktl_w_msg etakhktt_w_msg etakhkt_w_msg etakh_w_msg etaktlbg_w_msg etakttbg_w_msg ExhMgT_etaSpCatWrmIdle ExhMgT_etaSpCatWrmPartLoad ExhMgT_facEtaCatWrmAltiT ExhMgT_facEtaColdStrtHeatgAltiT ExhMgT_facEtaEngCatHeatg ExhMgT_facEtaWghCatWrm ExhMgT_facWghCatWrmTwc ExhMgT_fetakhllfa_msg ExhMgT_fetakhtlfa_msg ExhMgT_tEngCatHeatgFild fwetakhkt_msg fwsanfdlut_msg /end OUT_MEASUREMENT
 /begin LOC_MEASUREMENT B_detakhap B_zwetakh etakhaw_w etakhbg_w etakhktd_w etakhktn_w etakhkw_w etakhsv_w etazwmnk_w ExhMgt_cntrIniDrvEngDgrdCatHeatg ExhMgt_cntrReIniEngDgrdCatHeatg10ms ExhMgT_effCatHeatgLim ExhMgT_effMinDeltaCatHeatg ExhMgt_etaCatHeatg ExhMgT_etaCatHeatgNomFild ExhMgT_etaCatHeatgWght ExhMgT_etaDesCatHeatg ExhMgT_etaDesCatHeatgDiag ExhMgT_etaSpCatWrm ExhMgT_ethintkh ExhMgT_facCatHeatgAge ExhMgT_facCorrnEtaEngCatHeatg ExhMgT_facEngEffCorrnIdle ExhMgT_facEngEffCorrnPartLoad ExhMgT_facEtaCatAge ExhMgT_facEtaCatHeatg ExhMgt_facIntrpnCatHeatgEta ExhMgT_facWghCatWrm ExhMgT_facWghCatWrmLim ExhMgT_flgActvAltiBasdCorrn ExhMgT_flgAvsSetIdle ExhMgT_flgAvsSetPartLoad ExhMgT_flgCatHeatgBreak ExhMgT_flgCatHeatgRamp ExhMgT_flgCatHeatgRstCdn ExhMgT_flgCatWrmEngEffIa ExhMgT_flgfacWghCatWrmActv ExhMgT_iaCatWrmIdle ExhMgT_iaCatWrmPartLoad ExhMgT_tEngCatHeatgDif ExhMgT_tOilMdlCatHeatg fstkttmsfh mimxkhbk_w tmstchtr_w zwkhktl_w zwkhktt_w /end LOC_MEASUREMENT
 FUNCTION_VERSION "24.23.0_1.1.0" /end FUNCTION
/begin FUNCTION KnDetControl "18.13.0   MED17 Complex Driver KnDet"
 /begin DEF_CHARACTERISTIC KnDet_CalMeasWin_C KnDet_CfgRelsMeasWin_C KnDet_GainRng0_C KnDet_GainRng1_C KnDet_GainRng2_C KnDet_NThdGainRng1_C KnDet_NThdGainRng2_C KnDet_ThresNGradMeasWin_C KnDet_ThresNMeasWin_C KnDet_ThresNumMeasWin_C KnDet_ThresTiDiffMeasWin_C /end DEF_CHARACTERISTIC
 /begin IN_MEASUREMENT KnDet_IntegWinEndBuf0 KnDet_IntegWinEndBuf1 KnDet_IntegWinEndBuf2 KnDet_AddIntegWinEndBuf0 KnDet_AddIntegWinEndBuf1 KnDet_AddIntegWinEndBuf2 Epm_ctCyl Epm_dnEng Epm_nEng Epm_numCyl Epm_stOpMode Epm_stSync evz_austot_msg IKCtl_nUsdKnKSnsr KnDet_bDiaDeb KnDet_flgScChkDiagAck KnDet_numValMeasWin KnDet_numValTmpMeasWin KnDet_stSigEval KnDet_vNewAddIntegWinEndArr KnDet_vNewIntegWinEnd SyC_stSub /end IN_MEASUREMENT
 /begin OUT_MEASUREMENT B_stfmf KnDet_AddIntegWinEndBuf0 KnDet_AddIntegWinEndBuf1 KnDet_AddIntegWinEndBuf2 KnDet_bDiFctCall KnDet_bStMeasWin KnDet_ctCylBuf0 KnDet_ctCylBuf1 KnDet_ctCylBuf2 KnDet_ctDia KnDet_ctInpBuf KnDet_ctIntegRsltInvld KnDet_ctOutpBuf KnDet_DiffMeasWinMeasd KnDet_facPolarityDiag KnDet_flgBufOvf KnDet_flgBufOvfTmp KnDet_flgKnkSyncd KnDet_flgReIni KnDet_FltNewBuf0 KnDet_FltNewBuf1 KnDet_FltNewBuf2 KnDet_IntegWinEndBuf0 KnDet_IntegWinEndBuf1 KnDet_IntegWinEndBuf2 KnDet_KnKInvldBuf0 KnDet_KnKInvldBuf1 KnDet_KnKInvldBuf2 KnDet_MeasWinEndMeasd KnDet_NewDataBuf0 KnDet_NewDataBuf1 KnDet_NewDataBuf2 KnDet_numFltNew KnDet_numFltOldAry KnDet_numSensDia KnDet_phiAddMeasWinEnd KnDet_phiKnMeasWinBgn KnDet_PreInvldBuf0 KnDet_PreInvldBuf1 KnDet_PreInvldBuf2 KnDet_ReqSigEvalMode KnDet_RlsChkMeasWin KnDet_RlsChkWinMeas KnDet_SensMode KnDet_stDiaBuf0 KnDet_stDiaBuf1 KnDet_stDiaBuf2 KnDet_stDiaCtl KnDet_stDiaCtlBuf0 KnDet_stDiaCtlBuf1 KnDet_stDiaCtlBuf2 KnDet_stRlsDiaBuf0 KnDet_stRlsDiaBuf1 KnDet_stRlsDiaBuf2 KnDet_stSigEvalCurrCmb KnDet_stSigEvalCurrCmbAddWin KnDet_stSigEvalCurrCmbLstEntry KnDet_tiLenMeasWinMeasd /end OUT_MEASUREMENT
 /begin LOC_MEASUREMENT KnDet_ctCyl KnDet_ctCylTmp KnDet_ctMeasWin KnDet_GainShift KnDet_GainShiftTmp KnDet_HwDiaMode KnDet_nrDiffValMeasWinMeasdTmp KnDet_nrValMeasWinMeasd KnDet_numFltNewTmp KnDet_numKnkSnsr KnDet_numValMeasWinEst KnDet_numValMeasWinTmp KnDet_phiAddMeasWinEndTmp KnDet_phiKnMeasWinBgnTmp KnDet_phiMeasWinBgn KnDet_phiMeasWinBgnKnk KnDet_phiMeasWinBgnPre KnDet_phiMeasWinLngth KnDet_phiMeasWinLngthKnk KnDet_phiMeasWinLngthOld KnDet_phiMeasWinLngthPre KnDet_ReqChk KnDet_stCalMeasWin KnDet_stGetDigRawVal KnDet_stMeasWin /end LOC_MEASUREMENT
 FUNCTION_VERSION "18.13.0" /end FUNCTION
/begin FUNCTION KnDetLTest "18.5.0    knock sensor line diagnosis (short circuit detection)" /begin DEF_CHARACTERISTIC KnDet_SnsrMaxErr_C KnDet_SnsrMinErr_C /end DEF_CHARACTERISTIC
 /begin IN_MEASUREMENT DSM_TripChgFinshd KnDet_ctDia KnDet_facPolarityDiag KnDet_NewDiagRes KnDet_stDiaCtl SyC_stSub /end IN_MEASUREMENT
 /begin OUT_MEASUREMENT KnDet_bDiaDeb KnDet_DiaRes KnDet_flgScChkDiagAck /end OUT_MEASUREMENT
 /begin LOC_MEASUREMENT KnDet_DebDiagVal1 KnDet_DebDiagVal2 KnDet_flgSnsrMaxErr KnDet_flgSnsrMinErr KnDet_vDiagVal /end LOC_MEASUREMENT
 FUNCTION_VERSION "18.5.0" /end FUNCTION
/begin FUNCTION KnDetSigEval "18.12.0   MED17 Complex Driver KnDet" /begin DEF_CHARACTERISTIC KnDet_CoefFlt_CA /end DEF_CHARACTERISTIC
 /begin IN_MEASUREMENT KnDet_numFltNew KnDet_phiAddMeasWinEnd KnDet_phiKnMeasWinBgn KnDet_ReqSigEvalMode /end IN_MEASUREMENT
 /begin OUT_MEASUREMENT KnDet_bNewEval KnDet_NewDiagRes KnDet_numValMeasWin KnDet_numValTmpMeasWin KnDet_stSigEval KnDet_vNewAddIntegWinEndArr KnDet_vNewIntegWinEnd KnDet_vValOffs /end OUT_MEASUREMENT
 /begin LOC_MEASUREMENT KnDet_bEnaSigEval KnDet_ctIncErr KnDet_ctInctmp KnDet_ctNumValAddWin KnDet_idxIntegVal KnDet_nrValDly KnDet_nrValDlyBasc KnDet_phiCurrPos KnDet_tiSeg KnDet_vNewIntegTmp /end LOC_MEASUREMENT
 FUNCTION_VERSION "18.12.0" /end FUNCTION
/begin FUNCTION KnDet_Conf "18.3.0    KnDet Configuration" FUNCTION_VERSION "18.3.0" /end FUNCTION
/begin FUNCTION KnDet_FadcCtl "18.11.0   KnDet A-D converter control" FUNCTION_VERSION "18.11.0" /end FUNCTION
/begin FUNCTION KnDet_MeasWinCtl "18.10.1   KnDet measuring window control" FUNCTION_VERSION "18.10.1" /end FUNCTION
/begin FUNCTION KnDet_MeasWinIntrSrv "18.7.0    KnDet measuring window interrupt" FUNCTION_VERSION "18.7.0" /end FUNCTION
/begin FUNCTION KnDet_SubBlockIntrSrv "18.6.0    KnDet signal evaluation interrupt" FUNCTION_VERSION "18.6.0" /end FUNCTION
/begin FUNCTION KOEVAB "15.12.0   Coordination of injection valve cutoff" /begin IN_MEASUREMENT B_dveada_msg B_stainjen_msg B_stoevab_msg EpmRRS_bEngSwOff /end IN_MEASUREMENT /begin OUT_MEASUREMENT B_koevab_msg InjSys_flgCutOffReqTyp1 /end OUT_MEASUREMENT FUNCTION_VERSION "15.12.0" /end FUNCTION
/begin COMPU_METHOD B_TRUE "" TAB_VERB "%6.3" "" COMPU_TAB_REF B_TRUE /end COMPU_METHOD
/begin COMPU_VTAB B_TRUE "" TAB_VERB 2 0 "FALSE" 1 "TRUE" /end COMPU_VTAB
/begin COMPU_METHOD CvoSigEvln_Status_t "" TAB_VERB "%6.3" "" COMPU_TAB_REF CvoSigEvln_Status_t /end COMPU_METHOD
/begin COMPU_VTAB CvoSigEvln_Status_t "" TAB_VERB 11 0 "IDLE" 1 "REGOP_RUNNING" 2 "TAB_AVAIL" 3 "BASELEARN_TANTOT_RUNNING" 4 "BASELEARN_REFTI_RUNNING" 5 "BASELEARN_TANTOT_AVAIL" 6 "BASELEARN_REFTI_FINISHED" 7 "BASELEARN_FAILED" 8 "BASELEARN_REFTI_REPEAT" 9 "BASELEARN_TRANS_RUNNING" 10 "BASELEARN_TRANS_AVAIL" /end COMPU_VTAB
/begin COMPU_METHOD dez "" RAT_FUNC "%6.2" "" COEFFS 0 1 0 0 0 1 /end COMPU_METHOD
/begin COMPU_METHOD EngN "" RAT_FUNC "%6.3" "rpm" COEFFS 0 2 0 0 0 1 /end COMPU_METHOD
/begin COMPU_METHOD EngNGrd "" RAT_FUNC "%6.3" "rpm/s" COEFFS 0 2 0 0 0 1 /end COMPU_METHOD
/begin COMPU_METHOD fak_q0p00781 "" RAT_FUNC "%6.4" "-" COEFFS 0 128 0 0 0 1 /end COMPU_METHOD
/begin COMPU_METHOD fak_q0p015625 "" RAT_FUNC "%6.4" "-" COEFFS 0 64 0 0 0 1 /end COMPU_METHOD
/begin COMPU_METHOD fak_q3p0518Em5 "" RAT_FUNC "%7.6" "" COEFFS 0 32768 0 0 0 1 /end COMPU_METHOD
/begin COMPU_METHOD fak_sw_b1 "" RAT_FUNC "%7.6" "-" COEFFS 0 65536 0 0 0 2 /end COMPU_METHOD
/begin COMPU_METHOD fak_sw_b2 "" RAT_FUNC "%7.6" "-" COEFFS 0 65536 0 0 0 4 /end COMPU_METHOD
/begin COMPU_METHOD fak_ub_b1 "" RAT_FUNC "%6.4" "-" COEFFS 0 256 0 0 0 1 /end COMPU_METHOD
/begin COMPU_METHOD fak_ub_b2 "" RAT_FUNC "%8.5" "-" COEFFS 0 256 0 0 0 2 /end COMPU_METHOD
/begin COMPU_METHOD fak_uw_b1 "" RAT_FUNC "%7.6" "-" COEFFS 0 65536 0 0 0 1 /end COMPU_METHOD
/begin COMPU_METHOD fak_uw_b2 "" RAT_FUNC "%7.6" "-" COEFFS 0 65536 0 0 0 2 /end COMPU_METHOD
/begin COMPU_METHOD fak_uw_b4 "" RAT_FUNC "%7.6" "-" COEFFS 0 65536 0 0 0 4 /end COMPU_METHOD
/begin COMPU_METHOD kw_sw_q0p0219 "" RAT_FUNC "%6.4" "Grad KW" COEFFS 0 32768 0 0 0 720 /end COMPU_METHOD
/begin COMPU_METHOD lu_MEx "" RAT_FUNC "%6.4" "(Umdr./sec)^2" COEFFS 0 140.7374884 0 0 0 1 /end COMPU_METHOD
/begin COMPU_METHOD OneToOne "" RAT_FUNC "%6.2" "-" COEFFS 0 1 0 0 0 1 /end COMPU_METHOD
/begin COMPU_METHOD RBPtCel_u_1p60514em4_1 "" RAT_FUNC "%6.5" "V" COEFFS 0 6230 0 0 0 1 /end COMPU_METHOD
/begin COMPU_METHOD RBPtCel_vcos_5p0em5_1 "" RAT_FUNC "%7.6" "mPaSec" COEFFS 0 20000 0 0 0 1 /end COMPU_METHOD
/begin COMPU_METHOD rel_uw_b100 "" RAT_FUNC "%6.4" "%" COEFFS 0 65536 0 0 0 100 /end COMPU_METHOD
/begin COMPU_METHOD rel_uw_q0p0234 "" RAT_FUNC "%6.4" "%" COEFFS 0 32 0 0 0 0.75 /end COMPU_METHOD
/begin COMPU_METHOD spg_q7p629Em7_V_ms "" RAT_FUNC "%9.8" "V*ms" COEFFS 0 65536 0 0 0 0.05 /end COMPU_METHOD
/begin COMPU_METHOD SWAPMP_PMP1_SY_Compu "" TAB_VERB "%6.3" "" COMPU_TAB_REF SWAPMP_PMP1_SY_Compu /end COMPU_METHOD
/begin COMPU_VTAB SWAPMP_PMP1_SY_Compu "" TAB_VERB 2 0 "SWT_DISABLED" 1 "SWT_ENABLED" /end COMPU_VTAB
/begin COMPU_METHOD SWAPMP_PMP2_SY_Compu "" TAB_VERB "%6.3" "" COMPU_TAB_REF SWAPMP_PMP2_SY_Compu /end COMPU_METHOD
/begin COMPU_VTAB SWAPMP_PMP2_SY_Compu "" TAB_VERB 2 0 "SWT_DISABLED" 1 "SWT_ENABLED" /end COMPU_VTAB
/begin COMPU_METHOD SWAPMP_PMP3_SY_Compu "" TAB_VERB "%6.3" "" COMPU_TAB_REF SWAPMP_PMP3_SY_Compu /end COMPU_METHOD
/begin COMPU_VTAB SWAPMP_PMP3_SY_Compu "" TAB_VERB 2 0 "SWT_DISABLED" 1 "SWT_ENABLED" /end COMPU_VTAB
/begin COMPU_METHOD SWSVW_CHAELGDIAG_SY_Compu "" TAB_VERB "%6.3" "" COMPU_TAB_REF SWSVW_CHAELGDIAG_SY_Compu /end COMPU_METHOD
/begin COMPU_VTAB SWSVW_CHAELGDIAG_SY_Compu "" TAB_VERB 2 0 "FALSE" 1 "TRUE" /end COMPU_VTAB
/begin COMPU_METHOD SWSVW_COPSPDDRVOFF_SY_Compu "" TAB_VERB "%6.3" "" COMPU_TAB_REF SWSVW_COPSPDDRVOFF_SY_Compu /end COMPU_METHOD
/begin COMPU_VTAB SWSVW_COPSPDDRVOFF_SY_Compu "" TAB_VERB 2 0 "FALSE" 1 "TRUE" /end COMPU_VTAB
/begin COMPU_METHOD SWSVW_CS_SY_Compu "" TAB_VERB "%6.3" "" COMPU_TAB_REF SWSVW_CS_SY_Compu /end COMPU_METHOD
/begin COMPU_VTAB SWSVW_CS_SY_Compu "" TAB_VERB 2 0 "False" 1 "True" /end COMPU_VTAB
/begin COMPU_METHOD SWSVW_DTEV_SY_Compu "" TAB_VERB "%6.3" "" COMPU_TAB_REF SWSVW_DTEV_SY_Compu /end COMPU_METHOD
/begin COMPU_VTAB SWSVW_DTEV_SY_Compu "" TAB_VERB 2 0 "False" 1 "True" /end COMPU_VTAB
/begin COMPU_METHOD SWSVW_IFMBAL_SY_Compu "" TAB_VERB "%6.3" "" COMPU_TAB_REF SWSVW_IFMBAL_SY_Compu /end COMPU_METHOD
/begin COMPU_VTAB SWSVW_IFMBAL_SY_Compu "" TAB_VERB 2 0 "FALSE" 1 "TRUE" /end COMPU_VTAB
/begin COMPU_METHOD SWSVW_LWBS_SY_Compu "" TAB_VERB "%6.3" "" COMPU_TAB_REF SWSVW_LWBS_SY_Compu /end COMPU_METHOD
/begin COMPU_VTAB SWSVW_LWBS_SY_Compu "" TAB_VERB 2 0 "LWBS_NO" 1 "LWBS_V1" /end COMPU_VTAB
/begin COMPU_METHOD SWSVW_PCRMONOTURBO_SY_Compu "" TAB_VERB "%6.3" "" COMPU_TAB_REF SWSVW_PCRMONOTURBO_SY_Compu /end COMPU_METHOD
/begin COMPU_VTAB SWSVW_PCRMONOTURBO_SY_Compu "" TAB_VERB 2 0 "False" 1 "True" /end COMPU_VTAB
/begin COMPU_METHOD SWSVW_PIGPROT_SY_Compu "" TAB_VERB "%6.3" "" COMPU_TAB_REF SWSVW_PIGPROT_SY_Compu /end COMPU_METHOD
/begin COMPU_VTAB SWSVW_PIGPROT_SY_Compu "" TAB_VERB 2 0 "no SWSVW PIGPROT" 1 "SWSVW PIGPROT" /end COMPU_VTAB
/begin COMPU_METHOD SYC_AFTRUNDIAG_SC_Compu "" TAB_VERB "%6.3" "" COMPU_TAB_REF SYC_AFTRUNDIAG_SC_Compu /end COMPU_METHOD
/begin COMPU_VTAB SYC_AFTRUNDIAG_SC_Compu "" TAB_VERB 2 0 "False" 1 "True" /end COMPU_VTAB
/begin COMPU_METHOD SYC_CAL_PERMSPLYSYS_SY_Compu "" TAB_VERB "%6.3" "" COMPU_TAB_REF SYC_CAL_PERMSPLYSYS_SY_Compu /end COMPU_METHOD
/begin COMPU_VTAB SYC_CAL_PERMSPLYSYS_SY_Compu "" TAB_VERB 2 0 "False" 1 "True" /end COMPU_VTAB
/begin COMPU_METHOD SYC_CNTPOSTDRV_SC_Compu "" TAB_VERB "%6.3" "" COMPU_TAB_REF SYC_CNTPOSTDRV_SC_Compu /end COMPU_METHOD
/begin COMPU_VTAB SYC_CNTPOSTDRV_SC_Compu "" TAB_VERB 2 0 "False" 1 "True" /end COMPU_VTAB
/begin COMPU_METHOD SYC_COORD_SC_Compu "" TAB_VERB "%6.3" "" COMPU_TAB_REF SYC_COORD_SC_Compu /end COMPU_METHOD
/begin COMPU_VTAB SYC_COORD_SC_Compu "" TAB_VERB 2 0 "False" 1 "True" /end COMPU_VTAB
/begin COMPU_METHOD SYC_ENALCYPROLG_SC_Compu "" TAB_VERB "%6.3" "" COMPU_TAB_REF SYC_ENALCYPROLG_SC_Compu /end COMPU_METHOD
/begin COMPU_VTAB SYC_ENALCYPROLG_SC_Compu "" TAB_VERB 2 0 "False" 1 "True" /end COMPU_VTAB
/begin COMPU_METHOD SYC_FSTSWOFF_SY_Compu "" TAB_VERB "%6.3" "" COMPU_TAB_REF SYC_FSTSWOFF_SY_Compu /end COMPU_METHOD
/begin COMPU_VTAB SYC_FSTSWOFF_SY_Compu "" TAB_VERB 2 0 "False" 1 "True" /end COMPU_VTAB
/begin COMPU_METHOD SYC_MRLY_SC_Compu "" TAB_VERB "%6.3" "" COMPU_TAB_REF SYC_MRLY_SC_Compu /end COMPU_METHOD
/begin COMPU_VTAB SYC_MRLY_SC_Compu "" TAB_VERB 2 0 "False" 1 "True" /end COMPU_VTAB
/begin COMPU_METHOD SYC_POWERUNDERVOLTAGE_SC_Compu "" TAB_VERB "%6.3" "" COMPU_TAB_REF SYC_POWERUNDERVOLTAGE_SC_Compu /end COMPU_METHOD
/begin COMPU_VTAB SYC_POWERUNDERVOLTAGE_SC_Compu "" TAB_VERB 2 0 "False" 1 "True" /end COMPU_VTAB
/begin COMPU_METHOD SYC_POWER_SC_Compu "" TAB_VERB "%6.3" "" COMPU_TAB_REF SYC_POWER_SC_Compu /end COMPU_METHOD
/begin COMPU_VTAB SYC_POWER_SC_Compu "" TAB_VERB 2 0 "False" 1 "True" /end COMPU_VTAB
/begin COMPU_METHOD SYC_PROLGPREDRV_SC_Compu "" TAB_VERB "%6.3" "" COMPU_TAB_REF SYC_PROLGPREDRV_SC_Compu /end COMPU_METHOD
/begin COMPU_VTAB SYC_PROLGPREDRV_SC_Compu "" TAB_VERB 2 0 "False" 1 "True" /end COMPU_VTAB
/begin COMPU_METHOD SYC_SHUTDOWNSERVICES_SC_Compu "" TAB_VERB "%6.3" "" COMPU_TAB_REF SYC_SHUTDOWNSERVICES_SC_Compu /end COMPU_METHOD
/begin COMPU_VTAB SYC_SHUTDOWNSERVICES_SC_Compu "" TAB_VERB 2 0 "False" 1 "True" /end COMPU_VTAB
/begin COMPU_METHOD SYC_SYSTYP_SC_Compu "" TAB_VERB "%6.3" "" COMPU_TAB_REF SYC_SYSTYP_SC_Compu /end COMPU_METHOD
/begin COMPU_VTAB SYC_SYSTYP_SC_Compu "" TAB_VERB 2 0 "SysB" 1 "EcuCtrl" /end COMPU_VTAB
/begin COMPU_METHOD SYC_T15POSTPREDRV_SWRST_SY_Compu "" TAB_VERB "%6.3" "" COMPU_TAB_REF SYC_T15POSTPREDRV_SWRST_SY_Compu /end COMPU_METHOD
/begin COMPU_VTAB SYC_T15POSTPREDRV_SWRST_SY_Compu "" TAB_VERB 2 0 "False" 1 "True" /end COMPU_VTAB
/begin COMPU_METHOD SYC_T15RSTSIM_SY_Compu "" TAB_VERB "%6.3" "" COMPU_TAB_REF SYC_T15RSTSIM_SY_Compu /end COMPU_METHOD
/begin COMPU_VTAB SYC_T15RSTSIM_SY_Compu "" TAB_VERB 2 0 "False" 1 "True" /end COMPU_VTAB
/begin COMPU_METHOD SYC_WREEPBLK_SY_Compu "" TAB_VERB "%6.3" "" COMPU_TAB_REF SYC_WREEPBLK_SY_Compu /end COMPU_METHOD
/begin COMPU_VTAB SYC_WREEPBLK_SY_Compu "" TAB_VERB 2 0 "EEP-Block for SyC is not written" 1 "EEP-Block for SyC is written" /end COMPU_VTAB
/begin COMPU_METHOD SYC_X2ME_SC_Compu "" TAB_VERB "%6.3" "" COMPU_TAB_REF SYC_X2ME_SC_Compu /end COMPU_METHOD
/begin COMPU_VTAB SYC_X2ME_SC_Compu "" TAB_VERB 2 0 "False" 1 "True" /end COMPU_VTAB
/begin COMPU_METHOD SYSA_DSQACTVT_SC_Compu "" TAB_VERB "%6.3" "" COMPU_TAB_REF SYSA_DSQACTVT_SC_Compu /end COMPU_METHOD
/begin COMPU_VTAB SYSA_DSQACTVT_SC_Compu "" TAB_VERB 2 0 "Inactive" 1 "Active" /end COMPU_VTAB
/begin COMPU_METHOD SYSB_ENAUSER_SC_Compu "" TAB_VERB "%6.3" "" COMPU_TAB_REF SYSB_ENAUSER_SC_Compu /end COMPU_METHOD
/begin COMPU_VTAB SYSB_ENAUSER_SC_Compu "" TAB_VERB 2 0 "False" 1 "True" /end COMPU_VTAB
/begin COMPU_METHOD SYSB_PHYTERMINAL15_SC_Compu "" TAB_VERB "%6.3" "" COMPU_TAB_REF SYSB_PHYTERMINAL15_SC_Compu /end COMPU_METHOD
/begin COMPU_VTAB SYSB_PHYTERMINAL15_SC_Compu "" TAB_VERB 2 0 "False" 1 "True" /end COMPU_VTAB
/begin COMPU_METHOD SYSDIAG_EOLTESTCOORRENA_SC_Compu "" TAB_VERB "%6.3" "" COMPU_TAB_REF SYSDIAG_EOLTESTCOORRENA_SC_Compu /end COMPU_METHOD
/begin COMPU_VTAB SYSDIAG_EOLTESTCOORRENA_SC_Compu "" TAB_VERB 2 0 "False" 1 "True" /end COMPU_VTAB
/begin COMPU_METHOD SYSDIAG_NRAFTRUNCOORRARRELEM_SC_Compu "" RAT_FUNC "%6.2" "" COEFFS 0 1 0 0 0 1 /end COMPU_METHOD
/begin COMPU_METHOD SYSDIAG_NROBDOBSVRCFG_SC_Compu "" TAB_VERB "%6.3" "" COMPU_TAB_REF SYSDIAG_NROBDOBSVRCFG_SC_Compu /end COMPU_METHOD
/begin COMPU_VTAB SYSDIAG_NROBDOBSVRCFG_SC_Compu "" TAB_VERB 3 0 "0" 1 "1" 2 "2" /end COMPU_VTAB
/begin COMPU_METHOD SYSDIAG_SWTEMGYSTACTV_SC_Compu "" TAB_VERB "%6.3" "" COMPU_TAB_REF SYSDIAG_SWTEMGYSTACTV_SC_Compu /end COMPU_METHOD
/begin COMPU_VTAB SYSDIAG_SWTEMGYSTACTV_SC_Compu "" TAB_VERB 2 0 "Disable" 1 "Enable" /end COMPU_VTAB
/begin COMPU_METHOD SY_2HDP2_Compu "" TAB_VERB "%6.3" "" COMPU_TAB_REF SY_2HDP2_Compu /end COMPU_METHOD
/begin COMPU_VTAB SY_2HDP2_Compu "" TAB_VERB 2 0 "1 HDP" 1 "2 HDP" /end COMPU_VTAB
/begin COMPU_METHOD t100msxs_uw_b6553p5 "" RAT_FUNC "%6.3" "s" COEFFS 0 1 0 0 0 0.1 /end COMPU_METHOD
/begin COMPU_METHOD Temp_Cels "" RAT_FUNC "%6.1" "deg C" COEFFS 0 10 2731.4 0 0 1 /end COMPU_METHOD
/begin COMPU_METHOD temp_q0p1_K "" RAT_FUNC "%6.3" "K" COEFFS 0 10 0 0 0 1 /end COMPU_METHOD
/begin COMPU_METHOD temp_ub_q1_o40 "" RAT_FUNC "%6.2" "Grad C" COEFFS 0 1 40 0 0 1 /end COMPU_METHOD
/begin COMPU_METHOD tns_q1 "" RAT_FUNC "%6.2" "ns" COEFFS 0 1 0 0 0 1 /end COMPU_METHOD
/begin COMPU_METHOD Trq "" RAT_FUNC "%6.3" "Nm" COEFFS 0 10 0 0 0 1 /end COMPU_METHOD
/begin COMPU_METHOD trq_q0p1 "" RAT_FUNC "%6.3" "Nm" COEFFS 0 10 0 0 0 1 /end COMPU_METHOD
/begin COMPU_METHOD t_q0p00000005 "" RAT_FUNC "%10.9" "s" COEFFS 0 4294967295 0 0 0 215 /end COMPU_METHOD
/begin COMPU_METHOD t_q0p001_ms "" RAT_FUNC "%6.5" "ms" COEFFS 0 1 0 0 0 0.001 /end COMPU_METHOD
/begin COMPU_METHOD t_q0p01 "" RAT_FUNC "%6.4" "s" COEFFS 0 100 0 0 0 1 /end COMPU_METHOD
/begin COMPU_METHOD t_q0p04_ms "" RAT_FUNC "%6.4" "ms" COEFFS 0 1 0 0 0 0.04 /end COMPU_METHOD
/begin COMPU_METHOD t_q0p1 "" RAT_FUNC "%6.3" "s" COEFFS 0 10 0 0 0 1 /end COMPU_METHOD
/begin COMPU_METHOD t_q0p1_us "" RAT_FUNC "%6.3" "us" COEFFS 0 10 0 0 0 1 /end COMPU_METHOD
/begin COMPU_METHOD t_q0p4us "" RAT_FUNC "%6.3" "us" COEFFS 0 1 0 0 0 0.4 /end COMPU_METHOD
/begin COMPU_METHOD t_q1p0_us "" RAT_FUNC "%6.2" "us" COEFFS 0 1 0 0 0 1 /end COMPU_METHOD
/begin COMPU_METHOD t_us_q1 "" RAT_FUNC "%6.2" "us" COEFFS 0 1 0 0 0 1 /end COMPU_METHOD
/begin COMPU_METHOD Vel "" RAT_FUNC "%6.4" "km/h" COEFFS 0 100 0 0 0 1 /end COMPU_METHOD
/begin COMPU_METHOD zk10msxs_uw_b655p36 "" RAT_FUNC "%6.2" "s" COEFFS 0 0 65536 0 100 0 /end COMPU_METHOD
/begin COMPU_METHOD zw_q2p9297Em3_deg_KW "" RAT_FUNC "%6.4" "deg KW" COEFFS 0 1024 0 0 0 3 /end COMPU_METHOD
/begin RECORD_LAYOUT KfAxU8AyU8SstxU16SstyU16WS16 NO_AXIS_PTS_X 1 UWORD NO_AXIS_PTS_Y 2 UWORD AXIS_PTS_X 3 UWORD INDEX_INCR DIRECT AXIS_PTS_Y 4 UWORD INDEX_INCR DIRECT FNC_VALUES 5 SWORD COLUMN_DIR DIRECT /end RECORD_LAYOUT
/begin RECORD_LAYOUT KwbWS16 FNC_VALUES 1 SWORD COLUMN_DIR DIRECT /end RECORD_LAYOUT
/begin RECORD_LAYOUT KwbWU8 FNC_VALUES 1 UBYTE COLUMN_DIR DIRECT /end RECORD_LAYOUT
/begin RECORD_LAYOUT KwSw FNC_VALUES 1 SWORD COLUMN_DIR DIRECT /end RECORD_LAYOUT
/begin RECORD_LAYOUT KwUb FNC_VALUES 1 UBYTE COLUMN_DIR DIRECT /end RECORD_LAYOUT
/begin RECORD_LAYOUT KwUw FNC_VALUES 1 UWORD COLUMN_DIR DIRECT /end RECORD_LAYOUT
/begin RECORD_LAYOUT KwWS32 FNC_VALUES 1 SLONG COLUMN_DIR DIRECT /end RECORD_LAYOUT
/begin RECORD_LAYOUT RB_Axis_S16 NO_AXIS_PTS_X 1 SWORD AXIS_PTS_X 2 SWORD INDEX_INCR DIRECT /end RECORD_LAYOUT
/begin RECORD_LAYOUT RB_Axis_U16 NO_AXIS_PTS_X 1 UWORD AXIS_PTS_X 2 UWORD INDEX_INCR DIRECT /end RECORD_LAYOUT
/begin RECORD_LAYOUT RB_CurveGroup_S16 FNC_VALUES 1 SWORD COLUMN_DIR DIRECT /end RECORD_LAYOUT
/begin RECORD_LAYOUT RB_Curve_S16_S16 NO_AXIS_PTS_X 1 SWORD AXIS_PTS_X 2 SWORD INDEX_INCR DIRECT FNC_VALUES 3 SWORD COLUMN_DIR DIRECT /end RECORD_LAYOUT
/begin RECORD_LAYOUT RB_Curve_S16_U8_Static NO_AXIS_PTS_X 1 SWORD AXIS_PTS_X 2 SWORD INDEX_INCR DIRECT FNC_VALUES 3 UBYTE COLUMN_DIR DIRECT STATIC_RECORD_LAYOUT /end RECORD_LAYOUT
/begin RECORD_LAYOUT RB_Curve_S8_U8_Static NO_AXIS_PTS_X 1 SBYTE AXIS_PTS_X 2 SBYTE INDEX_INCR DIRECT FNC_VALUES 3 UBYTE COLUMN_DIR DIRECT STATIC_RECORD_LAYOUT /end RECORD_LAYOUT
/begin RECORD_LAYOUT RB_Curve_U16_S16_Static NO_AXIS_PTS_X 1 UWORD AXIS_PTS_X 2 UWORD INDEX_INCR DIRECT FNC_VALUES 3 SWORD COLUMN_DIR DIRECT STATIC_RECORD_LAYOUT /end RECORD_LAYOUT
/begin RECORD_LAYOUT RB_Curve_U16_U16 NO_AXIS_PTS_X 1 UWORD AXIS_PTS_X 2 UWORD INDEX_INCR DIRECT FNC_VALUES 3 UWORD COLUMN_DIR DIRECT /end RECORD_LAYOUT
/begin RECORD_LAYOUT RB_Curve_U16_U8_Static NO_AXIS_PTS_X 1 UWORD AXIS_PTS_X 2 UWORD INDEX_INCR DIRECT FNC_VALUES 3 UBYTE COLUMN_DIR DIRECT STATIC_RECORD_LAYOUT /end RECORD_LAYOUT
/begin RECORD_LAYOUT RB_Curve_U8_S16_Static NO_AXIS_PTS_X 1 UBYTE AXIS_PTS_X 2 UBYTE INDEX_INCR DIRECT FNC_VALUES 3 SWORD COLUMN_DIR DIRECT STATIC_RECORD_LAYOUT /end RECORD_LAYOUT
/begin RECORD_LAYOUT RB_MapGroup_S16 FNC_VALUES 1 SWORD COLUMN_DIR DIRECT /end RECORD_LAYOUT
/begin RECORD_LAYOUT RB_MapGroup_U16 FNC_VALUES 1 UWORD COLUMN_DIR DIRECT /end RECORD_LAYOUT
/begin RECORD_LAYOUT RB_Map_S16U16_U16 NO_AXIS_PTS_X 1 SWORD NO_AXIS_PTS_Y 2 SWORD AXIS_PTS_X 3 SWORD INDEX_INCR DIRECT AXIS_PTS_Y 4 UWORD INDEX_INCR DIRECT FNC_VALUES 5 UWORD ROW_DIR DIRECT /end RECORD_LAYOUT
/begin RECORD_LAYOUT RB_Map_S16U16_U8 NO_AXIS_PTS_X 1 SWORD NO_AXIS_PTS_Y 2 SWORD AXIS_PTS_X 3 SWORD INDEX_INCR DIRECT AXIS_PTS_Y 4 UWORD INDEX_INCR DIRECT FNC_VALUES 5 UBYTE ROW_DIR DIRECT /end RECORD_LAYOUT
/begin RECORD_LAYOUT RB_Map_U16S16_U16 NO_AXIS_PTS_X 1 UWORD NO_AXIS_PTS_Y 2 UWORD AXIS_PTS_X 3 UWORD INDEX_INCR DIRECT AXIS_PTS_Y 4 SWORD INDEX_INCR DIRECT FNC_VALUES 5 UWORD COLUMN_DIR DIRECT /end RECORD_LAYOUT
/begin RECORD_LAYOUT RB_ValA_Wu16 FNC_VALUES 1 UWORD COLUMN_DIR DIRECT /end RECORD_LAYOUT
/begin RECORD_LAYOUT RB_Val_Ws16 FNC_VALUES 1 SWORD COLUMN_DIR DIRECT /end RECORD_LAYOUT
/begin RECORD_LAYOUT RB_Val_Ws8 FNC_VALUES 1 SBYTE COLUMN_DIR DIRECT /end RECORD_LAYOUT
/begin RECORD_LAYOUT RB_Val_Wu16 FNC_VALUES 1 UWORD COLUMN_DIR DIRECT /end RECORD_LAYOUT
/begin RECORD_LAYOUT RB_Val_Wu32 FNC_VALUES 1 ULONG COLUMN_DIR DIRECT /end RECORD_LAYOUT
/begin RECORD_LAYOUT RB_Val_Wu8 FNC_VALUES 1 UBYTE COLUMN_DIR DIRECT /end RECORD_LAYOUT
/end MODULE
/end PROJECT
