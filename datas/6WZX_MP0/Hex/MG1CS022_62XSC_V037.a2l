ASAP2_VERSION 1 60
/begin PROJECT MG1CS022 "MG1CS022"
/begin HEADER "" VERSION "MG1CS022_62XSC_V037" PROJECT_NO MG1CS022 /end HEADER
/begin MODULE DIM ""
/begin MOD_COMMON "" BYTE_ORDER MSB_LAST ALIGNMENT_BYTE 1 ALIGNMENT_WORD 2 ALIGNMENT_LONG 4 ALIGNMENT_INT64 4 ALIGNMENT_FLOAT32_IEEE 4 ALIGNMENT_FLOAT64_IEEE 4 DATA_SIZE 32 /end MOD_COMMON
/begin CHARACTERISTIC DevLib_DigOutDbgSig_C "Calibration parameter to select the Digital out signal for which the debugging information is to be updated into the measuring points" VALUE 0x8058B5EC Val_Wu16 65535.00 OneToOne 0.00 65535.00 FORMAT "%8.2" /end CHARACTERISTIC
/begin CHARACTERISTIC Devlib_PsDisbl.facLowHysLo_C "Structure containing hysterisis limits for battery voltage correction factor / Lower hysterisis limit for battery correction factor LOW." VALUE 0x8058B5F0 Kw_Ws16 1.000000 Fact 0.00 1.000000 FORMAT "%8.6" EXTENDED_LIMITS -4.000000 3.999878 /end CHARACTERISTIC
/begin CHARACTERISTIC Devlib_PsDisbl.facLowHysHi_C "Structure containing hysterisis limits for battery voltage correction factor / Higher hysterisis limit for battery correction factor LOW." VALUE 0x8058B5F2 Kw_Ws16 1.000000 Fact 0.00 1.000000 FORMAT "%8.6" EXTENDED_LIMITS -4.000000 3.999878 /end CHARACTERISTIC
/begin CHARACTERISTIC Devlib_PsDisbl.facHighHysLo_C "Structure containing hysterisis limits for battery voltage correction factor / Lower hysterisis limit for battery correction factor HIGH." VALUE 0x8058B5F4 Kw_Ws16 2.000000 Fact 1.000000 3.000000 FORMAT "%8.6" EXTENDED_LIMITS -4.000000 3.999878 /end CHARACTERISTIC
/begin CHARACTERISTIC Devlib_PsDisbl.facHighHysHi_C "Structure containing hysterisis limits for battery voltage correction factor / Higher hysterisis limit for battery correction factor HIGH." VALUE 0x8058B5F6 Kw_Ws16 2.000000 Fact 1.000000 3.000000 FORMAT "%8.6" EXTENDED_LIMITS -4.000000 3.999878 /end CHARACTERISTIC
/begin CHARACTERISTIC DevLib_PWMOutDbgSig_C "Calibration parameter to select the PWM out signal for which the debugging information is to be updated into the measuring points" VALUE 0x8058B5EE Val_Wu16 65535.00 OneToOne 0.00 65535.00 FORMAT "%8.2" /end CHARACTERISTIC
/begin CHARACTERISTIC Devlib_PwrStg.BattLoHysLo_C "Structure containing hysterisis check for battery voltage LOW/HIGH / Lower limit for battery voltage LOW hysterisis check." VALUE 0x8058B5F8 Kw_Ws16 9000.000 Volt_Batt 3000.00 12000.00 FORMAT "%8.2" EXTENDED_LIMITS -655360.0 655340.0 /end CHARACTERISTIC
/begin CHARACTERISTIC Devlib_PwrStg.BattLoHysHi_C "Structure containing hysterisis check for battery voltage LOW/HIGH / Higher limit for battery voltage LOW hysterisis check" VALUE 0x8058B5FA Kw_Ws16 9000.000 Volt_Batt 3000.00 12000.00 FORMAT "%8.2" EXTENDED_LIMITS -655360.0 655340.0 /end CHARACTERISTIC
/begin CHARACTERISTIC Devlib_PwrStg.BattHiHysLo_C "Structure containing hysterisis check for battery voltage LOW/HIGH / Lower limit for battery voltage HIGH hysterisis check" VALUE 0x8058B5FC Kw_Ws16 24000.00 Volt_Batt 12000.00 36000.00 FORMAT "%8.2" EXTENDED_LIMITS -655360.0 655340.0 /end CHARACTERISTIC
/begin CHARACTERISTIC Devlib_PwrStg.BattHiHysHi_C "Structure containing hysterisis check for battery voltage LOW/HIGH / Upper limit for battery voltage HIGH hysterisis check" VALUE 0x8058B5FE Kw_Ws16 24000.00 Volt_Batt 12000.00 36000.00 FORMAT "%8.2" EXTENDED_LIMITS -655360.0 655340.0 /end CHARACTERISTIC
/begin CHARACTERISTIC NETHSEOSC_C "number of signal edges for detection of oscillating el. error ethanol sensor" VALUE 0x8053AECE RB_Val_Wu8 255.0 dez 0.00 255.0 FORMAT "%5.1" /end CHARACTERISTIC
/begin CHARACTERISTIC TDETHSE_C "debounce time el. error ethanol sensor" VALUE 0x8053AECF RB_Val_Wu8 51.00 t_q0p2 0.00 51.00 FORMAT "%5.2" /end CHARACTERISTIC
/begin CHARACTERISTIC TDETHSF_C "debounce time signal error frequency ethanol sensor" VALUE 0x8053AED0 RB_Val_Wu8 51.00 t_q0p2 0.00 51.00 FORMAT "%5.2" /end CHARACTERISTIC
/begin CHARACTERISTIC TDETHSPW_C "debounce time signal error negative pulse width ethanol sensor" VALUE 0x8053AED1 RB_Val_Wu8 51.00 t_q0p2 0.00 51.00 FORMAT "%5.2" /end CHARACTERISTIC
/begin CHARACTERISTIC TETHSEOSC_C "time interval for detection of oscillating el. error ethanol sensor" VALUE 0x8053AED2 RB_Val_Wu8 51.00 t_q0p2 0.00 51.00 FORMAT "%5.2" /end CHARACTERISTIC
/begin MEASUREMENT Air_tEGRClrLPDs_f "" FLOAT32_IEEE RBPtCel_t_1p0_3 1 100 -1.00000000E+037 1.00000000E+037 FORMAT "%13.3" ECU_ADDRESS 0x60003B24 /end MEASUREMENT
/begin MEASUREMENT BrkBstP_p_f "Actual physical value" FLOAT32_IEEE RBPtCel_p_1p0_1 1 100 -1.00000000E+037 1.00000000E+037 FORMAT "%13.3" ECU_ADDRESS 0x60003B20 /end MEASUREMENT
/begin MEASUREMENT B_ethseosc_msg "ethanol sensor, electrical error oscillating between min. and max. error" UBYTE B_TRUE 1 100 0.00 1.00000000000 BIT_MASK 0x1 FORMAT "%13.11" ECU_ADDRESS 0x6000F6F6 /end MEASUREMENT
/begin MEASUREMENT CEngDsT_t_f "" FLOAT32_IEEE RBPtCel_t_1p0_3 1 100 -1.00000000E+037 1.00000000E+037 FORMAT "%13.3" ECU_ADDRESS 0x50004DAC /end MEASUREMENT
/begin MEASUREMENT CEngDsT_t_f_Sq "" UBYTE SigQly_COMPU_VERB 1 100 0.00 15.0000000000 FORMAT "%13.10" ECU_ADDRESS 0x6000FFD0 /end MEASUREMENT
/begin MEASUREMENT CEngUsT_t_f "Actual physical value" FLOAT32_IEEE RBPtCel_t_1p0_3 1 100 -1.00000000E+037 1.00000000E+037 FORMAT "%13.3" ECU_ADDRESS 0x60003B1C /end MEASUREMENT
/begin MEASUREMENT DELib_idxArrSnsr "" UWORD OneToOne 1 100 0.00 65535.00 FORMAT "%8.2" ARRAY_SIZE 18 ECU_ADDRESS 0x50005CCC /end MEASUREMENT
/begin MEASUREMENT DELib_numVar_mp "SW Version variant of DELibPackage (110 = DELibPackage_1.1.0)" UWORD OneToOne 1 100 0. 65535. FORMAT "%10.0" ECU_ADDRESS 0x60009E3A /end MEASUREMENT
/begin MEASUREMENT DELib_num_mp "e_:SW Version of DELibPackage (1110 = DELibPackage.1.11.0):_e;d_:SW Version der DELibPackage 1110 = DELibPackage.1.11.0):_d" UWORD OneToOne 1 100 0. 65535. FORMAT "%10.0" ECU_ADDRESS 0x60009E38 /end MEASUREMENT
/begin MEASUREMENT DELib_stArrSnsr "e_:SW Version of DELib calibration data:_e;d_:SW Version der Applikationsdaten:_d" UBYTE OneToOne 1 100 0.00 255.0 FORMAT "%5.1" ARRAY_SIZE 18 ECU_ADDRESS 0x600100C9 /end MEASUREMENT
/begin MEASUREMENT DELib_stEepTEngOff "Status bits of Eep Read/Write Process of the Engine Temperature" UBYTE OneToOne 1 100 0.00 255.0 FORMAT "%5.1" ECU_ADDRESS 0x6001019C /end MEASUREMENT
/begin MEASUREMENT DELib_stFirstPreDrvOverCopy "" UBYTE OneToOne 1 100 0.00 255.0 FORMAT "%5.1" ECU_ADDRESS 0x600100C8 /end MEASUREMENT
/begin MEASUREMENT DELib_tEngOffEEP "" SWORD Temp_Cels 1 100 -3549.940 3003.560 FORMAT "%8.3" ECU_ADDRESS 0x60009E02 /end MEASUREMENT
/begin MEASUREMENT DELib_xArrSnsr "" FLOAT32_IEEE OneToOne 1 100 -1.00000000E+037 1.00000000E+037 FORMAT "%13.3" ARRAY_SIZE 18 ECU_ADDRESS 0x50004E10 /end MEASUREMENT
/begin MEASUREMENT Dem_disableEventStatusUpdateGroup "Bit encoded DTCGroups disabled for EventStatusUpdate" UBYTE OneToOne 1 100 0.00 255.0 FORMAT "%5.1" ECU_ADDRESS 0x70006A87 /end MEASUREMENT
/begin MEASUREMENT Dem_DTCFltForFltDetnCntr "Adapter to transform DSM interfaces to DEM interfaces" UBYTE OneToOne 1 100 0.00 255.0 FORMAT "%5.1" ARRAY_SIZE 2 ECU_ADDRESS 0x70006A8A /end MEASUREMENT
/begin MEASUREMENT Dem_DTCFltFormat "DTCFormat parameter of current Dem_SetDTCFilter() request" UBYTE OneToOne 1 100 0.00 255.0 FORMAT "%5.1" ARRAY_SIZE 2 ECU_ADDRESS 0x70006A92 /end MEASUREMENT
/begin MEASUREMENT Dem_DTCFltOrigin "DTCOrigin parameter of current Dem_SetDTCFilter() request" UWORD OneToOne 1 100 0.00 65535.00 FORMAT "%8.2" ARRAY_SIZE 2 ECU_ADDRESS 0x700057A2 /end MEASUREMENT
/begin MEASUREMENT Dem_DTCFltProcCnt "Number of DTCs found to current Dem_SetDTCFilter() request" UWORD OneToOne 1 100 0.00 65535.00 FORMAT "%8.2" ARRAY_SIZE 2 ECU_ADDRESS 0x700057AE /end MEASUREMENT
/begin MEASUREMENT Dem_DTCFltProcIdx "Loop index for asynchron Dem_SetDTCFilter() processing" UWORD OneToOne 1 100 0.00 65535.00 FORMAT "%8.2" ARRAY_SIZE 2 ECU_ADDRESS 0x700057B2 /end MEASUREMENT
/begin MEASUREMENT Dem_DTCFltRecFormat "DTCFormat parameter of current Dem_SetFreezeFrameRecordFilter() request" UBYTE OneToOne 1 100 0.00 255.0 FORMAT "%5.1" ARRAY_SIZE 2 ECU_ADDRESS 0x70006A8C /end MEASUREMENT
/begin MEASUREMENT Dem_DTCFltRecRsltIdx "Index variable for incremental GetNextFilteredRecord output" UWORD OneToOne 1 100 0.00 65535.00 FORMAT "%8.2" ARRAY_SIZE 2 ECU_ADDRESS 0x700057A6 /end MEASUREMENT
/begin MEASUREMENT Dem_DTCFltRsltIdx "Index variable for incremental GetNextFilteredDTCxxx output" UWORD OneToOne 1 100 0.00 65535.00 FORMAT "%8.2" ARRAY_SIZE 2 ECU_ADDRESS 0x700057AA /end MEASUREMENT
/begin MEASUREMENT Dem_DTCFltSeverity "DTCSeverity parameter of current Dem_SetDTCFilter() request" UBYTE OneToOne 1 100 0.00 255.0 FORMAT "%5.1" ARRAY_SIZE 2 ECU_ADDRESS 0x70006A8E /end MEASUREMENT
/begin MEASUREMENT Dem_DTCFltSt "Current state of Dem_SetDTCFilter() processing" UBYTE Dem_DTCFltSt_Verb 1 100 0.00 5.00000000000 FORMAT "%13.11" ARRAY_SIZE 2 ECU_ADDRESS 0x70006A88 /end MEASUREMENT
/begin MEASUREMENT Dem_DTCFltStatusMask "DTCStatusMask parameter of current Dem_SetDTCFilter() request" UBYTE OneToOne 1 100 0.00 255.0 FORMAT "%5.1" ARRAY_SIZE 2 ECU_ADDRESS 0x70006A94 /end MEASUREMENT
/begin MEASUREMENT Dem_DTCFltWithSev "Adapter to transform DSM interfaces to DEM interfaces" UBYTE OneToOne 1 100 0.00 255.0 FORMAT "%5.1" ARRAY_SIZE 2 ECU_ADDRESS 0x70006A90 /end MEASUREMENT
/begin MEASUREMENT DETHSDFC_ctReIni "Counter used to re-initialize the variables by removing the re-ini proc" UBYTE OneToOne 1 100 0.00 255.0 FORMAT "%5.1" ECU_ADDRESS 0x6000F071 /end MEASUREMENT
/begin MEASUREMENT DevLib_stDigOutErr_mp "Measuring point that contains the error information received from HWE for the digital out signal selected by DevLib_DigOutDbgSig_C" ULONG OneToOne 1 100 0.00 4294967295.00 FORMAT "%13.2" ECU_ADDRESS 0x70009C34 /end MEASUREMENT
/begin MEASUREMENT DevLib_stDigOutPrevTst_mp "Measuring point for the previous test result for the digital out signal selected by DevLib_DigOutDbgSig_C" UWORD OneToOne 1 100 0.00 65535.00 FORMAT "%8.2" ECU_ADDRESS 0x70009EDA /end MEASUREMENT
/begin MEASUREMENT DevLib_stDigOutTstImp_mp "Measuring point for the frequency of the test impulse sent to the digital out powerstage selected by DevLib_DigOutDbgSig_C" UBYTE OneToOne 1 100 0.00 255.0 FORMAT "%5.1" ECU_ADDRESS 0x70009FE6 /end MEASUREMENT
/begin MEASUREMENT DevLib_stPWMOutErr_mp "Measuring point that contains the error information received from HWE for the PWM out signal selected by DevLib_PWMOutDbgSig_C" ULONG OneToOne 1 100 0.00 4294967295.00 FORMAT "%13.2" ECU_ADDRESS 0x70009C30 /end MEASUREMENT
/begin MEASUREMENT DevLib_stPWMOutPrevTst_mp "Measuring point for the previous test result for the PWM out signal selected by DevLib_PWMOutDbgSig_C" UWORD OneToOne 1 100 0.00 65535.00 FORMAT "%8.2" ECU_ADDRESS 0x70009ED8 /end MEASUREMENT
/begin MEASUREMENT DevLib_stPWMOutTstImp_mp "Measuring point for the frequency of the test impulse sent to the PWM out powerstage selected by DevLib_PWMOutDbgSig_C" UBYTE OneToOne 1 100 0.00 255.0 FORMAT "%5.1" ECU_ADDRESS 0x70009FE5 /end MEASUREMENT
/begin MEASUREMENT DevLib_stPwrStgEnaCond "" UWORD OneToOne 1 100 0.00 65535.00 FORMAT "%8.2" ECU_ADDRESS 0x60009D22 /end MEASUREMENT
/begin MEASUREMENT DFC_b.TST_AAVEmax "Bit encoding / Tested bit for check DFC_AAVEmax" UBYTE DFC_OneToOne 1 100 0.00 1.000 BIT_MASK 0x8 FORMAT "%5.3" ECU_ADDRESS 0x60036EBB /end MEASUREMENT
/begin MEASUREMENT DFC_b.TST_AAVEmin "Bit encoding / Tested bit for check DFC_AAVEmin" UBYTE DFC_OneToOne 1 100 0.00 1.000 BIT_MASK 0x8 FORMAT "%5.3" ECU_ADDRESS 0x60036EBC /end MEASUREMENT
/begin MEASUREMENT DFC_b.TST_AAVEsig "Bit encoding / Tested bit for check DFC_AAVEsig" UBYTE DFC_OneToOne 1 100 0.00 1.000 BIT_MASK 0x8 FORMAT "%5.3" ECU_ADDRESS 0x60036EBD /end MEASUREMENT
/begin MEASUREMENT DFC_b.TST_AltIOACGFailr "Bit encoding / Tested bit for check DFC_AltIOACGFailr" UBYTE DFC_OneToOne 1 100 0.00 1.000 BIT_MASK 0x8 FORMAT "%5.3" ECU_ADDRESS 0x60036EBE /end MEASUREMENT
/begin MEASUREMENT DFC_b.TST_AltIOACGHiVltg "Bit encoding / Tested bit for check DFC_AltIOACGHiVltg" UBYTE DFC_OneToOne 1 100 0.00 1.000 BIT_MASK 0x8 FORMAT "%5.3" ECU_ADDRESS 0x60036EBF /end MEASUREMENT
/begin MEASUREMENT DFC_b.TST_AltIOACGLoVltg "Bit encoding / Tested bit for check DFC_AltIOACGLoVltg" UBYTE DFC_OneToOne 1 100 0.00 1.000 BIT_MASK 0x8 FORMAT "%5.3" ECU_ADDRESS 0x60036EC0 /end MEASUREMENT
/begin MEASUREMENT DFC_b.TST_AltIOACGTHi "Bit encoding / Tested bit for check DFC_AltIOACGTHi" UBYTE DFC_OneToOne 1 100 0.00 1.000 BIT_MASK 0x8 FORMAT "%5.3" ECU_ADDRESS 0x60036EC1 /end MEASUREMENT
/begin MEASUREMENT DFC_b.TST_AltIODConnACG "Bit encoding / Tested bit for check DFC_AltIODConnACG" UBYTE DFC_OneToOne 1 100 0.00 1.000 BIT_MASK 0x8 FORMAT "%5.3" ECU_ADDRESS 0x60036EC2 /end MEASUREMENT
/begin MEASUREMENT DFC_b.TST_BGOELWAF "Bit encoding / Tested bit for check DFC_BGOELWAF" UBYTE DFC_OneToOne 1 100 0.00 1.000 BIT_MASK 0x8 FORMAT "%5.3" ECU_ADDRESS 0x60036EC3 /end MEASUREMENT
/begin MEASUREMENT DFC_b.TST_BattUHiFailr "Bit encoding / Tested bit for check DFC_BattUHiFailr" UBYTE DFC_OneToOne 1 100 0.00 1.000 BIT_MASK 0x8 FORMAT "%5.3" ECU_ADDRESS 0x60036EC4 /end MEASUREMENT
/begin MEASUREMENT DFC_b.TST_BattULoFailr "Bit encoding / Tested bit for check DFC_BattULoFailr" UBYTE DFC_OneToOne 1 100 0.00 1.000 BIT_MASK 0x8 FORMAT "%5.3" ECU_ADDRESS 0x60036EC5 /end MEASUREMENT
/begin MEASUREMENT DFC_b.TST_BrkBstPDriftHiErr "Bit encoding / Tested bit for check DFC_BrkBstPDriftHiErr" UBYTE DFC_OneToOne 1 100 0.00 1.000 BIT_MASK 0x8 FORMAT "%5.3" ECU_ADDRESS 0x60036EC6 /end MEASUREMENT
/begin MEASUREMENT DFC_b.TST_BrkBstPDriftLoErr "Bit encoding / Tested bit for check DFC_BrkBstPDriftLoErr" UBYTE DFC_OneToOne 1 100 0.00 1.000 BIT_MASK 0x8 FORMAT "%5.3" ECU_ADDRESS 0x60036EC7 /end MEASUREMENT
/begin MEASUREMENT DFC_b.TST_BrkBstPSnsrStuck "Bit encoding / Tested bit for check DFC_BrkBstPSnsrStuck" UBYTE DFC_OneToOne 1 100 0.00 1.000 BIT_MASK 0x8 FORMAT "%5.3" ECU_ADDRESS 0x60036EC8 /end MEASUREMENT
/begin MEASUREMENT DFC_b.TST_BrkMnSwtContOn "Bit encoding / Tested bit for check DFC_BrkMnSwtContOn" UBYTE DFC_OneToOne 1 100 0.00 1.000 BIT_MASK 0x8 FORMAT "%5.3" ECU_ADDRESS 0x60036EC9 /end MEASUREMENT
/begin MEASUREMENT DFC_b.TST_BrkMnSwtNotStp "Bit encoding / Tested bit for check DFC_BrkMnSwtNotStp" UBYTE DFC_OneToOne 1 100 0.00 1.000 BIT_MASK 0x8 FORMAT "%5.3" ECU_ADDRESS 0x60036ECA /end MEASUREMENT
/begin MEASUREMENT DFC_b.TST_BrkNpl "Bit encoding / Tested bit for check DFC_BrkNpl" UBYTE DFC_OneToOne 1 100 0.00 1.000 BIT_MASK 0x8 FORMAT "%5.3" ECU_ADDRESS 0x60036ECB /end MEASUREMENT
/begin MEASUREMENT DFC_b.TST_BrkRdntSwtContOn "Bit encoding / Tested bit for check DFC_BrkRdntSwtContOn" UBYTE DFC_OneToOne 1 100 0.00 1.000 BIT_MASK 0x8 FORMAT "%5.3" ECU_ADDRESS 0x60036ECC /end MEASUREMENT
/begin MEASUREMENT DFC_b.TST_BrkRdntSwtNotStp "Bit encoding / Tested bit for check DFC_BrkRdntSwtNotStp" UBYTE DFC_OneToOne 1 100 0.00 1.000 BIT_MASK 0x8 FORMAT "%5.3" ECU_ADDRESS 0x60036ECD /end MEASUREMENT
/begin MEASUREMENT DFC_b.TST_Clth3ONStuck "Bit encoding / Tested bit for check DFC_Clth3ONStuck" UBYTE DFC_OneToOne 1 100 0.00 1.000 BIT_MASK 0x8 FORMAT "%5.3" ECU_ADDRESS 0x60036ECE /end MEASUREMENT
/begin MEASUREMENT DFC_b.TST_Clth4OFFStuck "Bit encoding / Tested bit for check DFC_Clth4OFFStuck" UBYTE DFC_OneToOne 1 100 0.00 1.000 BIT_MASK 0x8 FORMAT "%5.3" ECU_ADDRESS 0x60036ECF /end MEASUREMENT
/begin MEASUREMENT DFC_b.TST_ClthOFFStuck "Bit encoding / Tested bit for check DFC_ClthOFFStuck" UBYTE DFC_OneToOne 1 100 0.00 1.000 BIT_MASK 0x8 FORMAT "%5.3" ECU_ADDRESS 0x60036ED0 /end MEASUREMENT
/begin MEASUREMENT DFC_b.TST_ClthONStuck "Bit encoding / Tested bit for check DFC_ClthONStuck" UBYTE DFC_OneToOne 1 100 0.00 1.000 BIT_MASK 0x8 FORMAT "%5.3" ECU_ADDRESS 0x60036ED1 /end MEASUREMENT
/begin MEASUREMENT DFC_b.TST_ClthStkFailInfo "Bit encoding / Tested bit for check DFC_ClthStkFailInfo" UBYTE DFC_OneToOne 1 100 0.00 1.000 BIT_MASK 0x8 FORMAT "%5.3" ECU_ADDRESS 0x60036ED2 /end MEASUREMENT
/begin MEASUREMENT DFC_b.TST_ComACFailInfo "Bit encoding / Tested bit for check DFC_ComACFailInfo" UBYTE DFC_OneToOne 1 100 0.00 1.000 BIT_MASK 0x8 FORMAT "%5.3" ECU_ADDRESS 0x60036ED3 /end MEASUREMENT
/begin MEASUREMENT DFC_b.TST_ComATFTValErr "Bit encoding / Tested bit for check DFC_ComATFTValErr" UBYTE DFC_OneToOne 1 100 0.00 1.000 BIT_MASK 0x8 FORMAT "%5.3" ECU_ADDRESS 0x60036ED4 /end MEASUREMENT
/begin MEASUREMENT DFC_b.TST_ComATMILReq "Bit encoding / Tested bit for check DFC_ComATMILReq" UBYTE DFC_OneToOne 1 100 0.00 1.000 BIT_MASK 0x8 FORMAT "%5.3" ECU_ADDRESS 0x60036ED5 /end MEASUREMENT
/begin MEASUREMENT DFC_b.TST_ComAYCAChksum "Bit encoding / Tested bit for check DFC_ComAYCAChksum" UBYTE DFC_OneToOne 1 100 0.00 1.000 BIT_MASK 0x8 FORMAT "%5.3" ECU_ADDRESS 0x60036ED6 /end MEASUREMENT
/begin MEASUREMENT DFC_b.TST_ComAYCARingCnt "Bit encoding / Tested bit for check DFC_ComAYCARingCnt" UBYTE DFC_OneToOne 1 100 0.00 1.000 BIT_MASK 0x8 FORMAT "%5.3" ECU_ADDRESS 0x60036ED7 /end MEASUREMENT
/begin MEASUREMENT DFC_b.TST_ComAYCATOut "Bit encoding / Tested bit for check DFC_ComAYCATOut" UBYTE DFC_OneToOne 1 100 0.00 1.000 BIT_MASK 0x8 FORMAT "%5.3" ECU_ADDRESS 0x60036ED8 /end MEASUREMENT
/begin MEASUREMENT DFC_b.TST_ComAYCDChkSum "Bit encoding / Tested bit for check DFC_ComAYCDChkSum" UBYTE DFC_OneToOne 1 100 0.00 1.000 BIT_MASK 0x8 FORMAT "%5.3" ECU_ADDRESS 0x60036ED9 /end MEASUREMENT
/begin MEASUREMENT DFC_b.TST_ComAYCDTOut "Bit encoding / Tested bit for check DFC_ComAYCDTOut" UBYTE DFC_OneToOne 1 100 0.00 1.000 BIT_MASK 0x8 FORMAT "%5.3" ECU_ADDRESS 0x60036EDA /end MEASUREMENT
/begin MEASUREMENT DFC_b.TST_ComAYCFChksum "Bit encoding / Tested bit for check DFC_ComAYCFChksum" UBYTE DFC_OneToOne 1 100 0.00 1.000 BIT_MASK 0x8 FORMAT "%5.3" ECU_ADDRESS 0x60036EDB /end MEASUREMENT
/begin MEASUREMENT DFC_b.TST_ComAYCFRingCnt "Bit encoding / Tested bit for check DFC_ComAYCFRingCnt" UBYTE DFC_OneToOne 1 100 0.00 1.000 BIT_MASK 0x8 FORMAT "%5.3" ECU_ADDRESS 0x60036EDC /end MEASUREMENT
/begin MEASUREMENT DFC_b.TST_ComAYCFTOut "Bit encoding / Tested bit for check DFC_ComAYCFTOut" UBYTE DFC_OneToOne 1 100 0.00 1.000 BIT_MASK 0x8 FORMAT "%5.3" ECU_ADDRESS 0x60036EDD /end MEASUREMENT
/begin MEASUREMENT DFC_b.TST_ComAYCGChksum "Bit encoding / Tested bit for check DFC_ComAYCGChksum" UBYTE DFC_OneToOne 1 100 0.00 1.000 BIT_MASK 0x8 FORMAT "%5.3" ECU_ADDRESS 0x60036EDE /end MEASUREMENT
/begin MEASUREMENT DFC_b.TST_ComAYCGRingCnt "Bit encoding / Tested bit for check DFC_ComAYCGRingCnt" UBYTE DFC_OneToOne 1 100 0.00 1.000 BIT_MASK 0x8 FORMAT "%5.3" ECU_ADDRESS 0x60036EDF /end MEASUREMENT
/begin MEASUREMENT DFC_b.TST_ComAYCGTOut "Bit encoding / Tested bit for check DFC_ComAYCGTOut" UBYTE DFC_OneToOne 1 100 0.00 1.000 BIT_MASK 0x8 FORMAT "%5.3" ECU_ADDRESS 0x60036EE0 /end MEASUREMENT
/begin MEASUREMENT DFC_b.TST_ComAYCIChkSum "Bit encoding / Tested bit for check DFC_ComAYCIChkSum" UBYTE DFC_OneToOne 1 100 0.00 1.000 BIT_MASK 0x8 FORMAT "%5.3" ECU_ADDRESS 0x60036EE1 /end MEASUREMENT
/begin MEASUREMENT DFC_b.TST_ComAYCIRingCnt "Bit encoding / Tested bit for check DFC_ComAYCIRingCnt" UBYTE DFC_OneToOne 1 100 0.00 1.000 BIT_MASK 0x8 FORMAT "%5.3" ECU_ADDRESS 0x60036EE2 /end MEASUREMENT
/begin MEASUREMENT DFC_b.TST_ComAYCITOut "Bit encoding / Tested bit for check DFC_ComAYCITOut" UBYTE DFC_OneToOne 1 100 0.00 1.000 BIT_MASK 0x8 FORMAT "%5.3" ECU_ADDRESS 0x60036EE3 /end MEASUREMENT
/begin MEASUREMENT DFC_b.TST_ComBCM1ChkSum "Bit encoding / Tested bit for check DFC_ComBCM1ChkSum" UBYTE DFC_OneToOne 1 100 0.00 1.000 BIT_MASK 0x8 FORMAT "%5.3" ECU_ADDRESS 0x60036EE4 /end MEASUREMENT
/begin MEASUREMENT DFC_b.TST_ComBCM1RingCnt "Bit encoding / Tested bit for check DFC_ComBCM1RingCnt" UBYTE DFC_OneToOne 1 100 0.00 1.000 BIT_MASK 0x8 FORMAT "%5.3" ECU_ADDRESS 0x60036EE5 /end MEASUREMENT
/begin MEASUREMENT DFC_b.TST_ComBCM1TOut "Bit encoding / Tested bit for check DFC_ComBCM1TOut" UBYTE DFC_OneToOne 1 100 0.00 1.000 BIT_MASK 0x8 FORMAT "%5.3" ECU_ADDRESS 0x60036EE6 /end MEASUREMENT
/begin MEASUREMENT DFC_b.TST_ComCANABusOffErr "Bit encoding / Tested bit for check DFC_ComCANABusOffErr" UBYTE DFC_OneToOne 1 100 0.00 1.000 BIT_MASK 0x8 FORMAT "%5.3" ECU_ADDRESS 0x60036EE7 /end MEASUREMENT
/begin MEASUREMENT DFC_b.TST_ComCANBBusOffErr "Bit encoding / Tested bit for check DFC_ComCANBBusOffErr" UBYTE DFC_OneToOne 1 100 0.00 1.000 BIT_MASK 0x8 FORMAT "%5.3" ECU_ADDRESS 0x60036EE8 /end MEASUREMENT
/begin MEASUREMENT DFC_b.TST_ComCANCBusOffErr "Bit encoding / Tested bit for check DFC_ComCANCBusOffErr" UBYTE DFC_OneToOne 1 100 0.00 1.000 BIT_MASK 0x8 FORMAT "%5.3" ECU_ADDRESS 0x60036EE9 /end MEASUREMENT
/begin MEASUREMENT DFC_b.TST_ComCGW1ChkSum "Bit encoding / Tested bit for check DFC_ComCGW1ChkSum" UBYTE DFC_OneToOne 1 100 0.00 1.000 BIT_MASK 0x8 FORMAT "%5.3" ECU_ADDRESS 0x60036EEA /end MEASUREMENT
/begin MEASUREMENT DFC_b.TST_ComCGW1RingCnt "Bit encoding / Tested bit for check DFC_ComCGW1RingCnt" UBYTE DFC_OneToOne 1 100 0.00 1.000 BIT_MASK 0x8 FORMAT "%5.3" ECU_ADDRESS 0x60036EEB /end MEASUREMENT
/begin MEASUREMENT DFC_b.TST_ComCGW1TOut "Bit encoding / Tested bit for check DFC_ComCGW1TOut" UBYTE DFC_OneToOne 1 100 0.00 1.000 BIT_MASK 0x8 FORMAT "%5.3" ECU_ADDRESS 0x60036EEC /end MEASUREMENT
/begin MEASUREMENT DFC_b.TST_ComConvBoostErr "Bit encoding / Tested bit for check DFC_ComConvBoostErr" UBYTE DFC_OneToOne 1 100 0.00 1.000 BIT_MASK 0x8 FORMAT "%5.3" ECU_ADDRESS 0x60036EED /end MEASUREMENT
/begin MEASUREMENT DFC_b.TST_ComConvSlipErr "Bit encoding / Tested bit for check DFC_ComConvSlipErr" UBYTE DFC_OneToOne 1 100 0.00 1.000 BIT_MASK 0x8 FORMAT "%5.3" ECU_ADDRESS 0x60036EEE /end MEASUREMENT
/begin MEASUREMENT DFC_b.TST_ComDCDCPrfmncErr "Bit encoding / Tested bit for check DFC_ComDCDCPrfmncErr" UBYTE DFC_OneToOne 1 100 0.00 1.000 BIT_MASK 0x8 FORMAT "%5.3" ECU_ADDRESS 0x60036EEF /end MEASUREMENT
/begin MEASUREMENT DFC_b.TST_ComDCDCTempWarn "Bit encoding / Tested bit for check DFC_ComDCDCTempWarn" UBYTE DFC_OneToOne 1 100 0.00 1.000 BIT_MASK 0x8 FORMAT "%5.3" ECU_ADDRESS 0x60036EF0 /end MEASUREMENT
/begin MEASUREMENT DFC_b.TST_ComEAT10Chksum "Bit encoding / Tested bit for check DFC_ComEAT10Chksum" UBYTE DFC_OneToOne 1 100 0.00 1.000 BIT_MASK 0x8 FORMAT "%5.3" ECU_ADDRESS 0x60036EF1 /end MEASUREMENT
/begin MEASUREMENT DFC_b.TST_ComEAT10RingCnt "Bit encoding / Tested bit for check DFC_ComEAT10RingCnt" UBYTE DFC_OneToOne 1 100 0.00 1.000 BIT_MASK 0x8 FORMAT "%5.3" ECU_ADDRESS 0x60036EF2 /end MEASUREMENT
/begin MEASUREMENT DFC_b.TST_ComEAT10TOut "Bit encoding / Tested bit for check DFC_ComEAT10TOut" UBYTE DFC_OneToOne 1 100 0.00 1.000 BIT_MASK 0x8 FORMAT "%5.3" ECU_ADDRESS 0x60036EF3 /end MEASUREMENT
/begin MEASUREMENT DFC_b.TST_ComEAT11ChkSum "Bit encoding / Tested bit for check DFC_ComEAT11ChkSum" UBYTE DFC_OneToOne 1 100 0.00 1.000 BIT_MASK 0x8 FORMAT "%5.3" ECU_ADDRESS 0x60036EF4 /end MEASUREMENT
/begin MEASUREMENT DFC_b.TST_ComEAT11RingCnt "Bit encoding / Tested bit for check DFC_ComEAT11RingCnt" UBYTE DFC_OneToOne 1 100 0.00 1.000 BIT_MASK 0x8 FORMAT "%5.3" ECU_ADDRESS 0x60036EF5 /end MEASUREMENT
/begin MEASUREMENT DFC_b.TST_ComEAT11TOut "Bit encoding / Tested bit for check DFC_ComEAT11TOut" UBYTE DFC_OneToOne 1 100 0.00 1.000 BIT_MASK 0x8 FORMAT "%5.3" ECU_ADDRESS 0x60036EF6 /end MEASUREMENT
/begin MEASUREMENT DFC_b.TST_ComEAT12ChkSum "Bit encoding / Tested bit for check DFC_ComEAT12ChkSum" UBYTE DFC_OneToOne 1 100 0.00 1.000 BIT_MASK 0x8 FORMAT "%5.3" ECU_ADDRESS 0x60036EF7 /end MEASUREMENT
/begin MEASUREMENT DFC_b.TST_ComEAT12RingCnt "Bit encoding / Tested bit for check DFC_ComEAT12RingCnt" UBYTE DFC_OneToOne 1 100 0.00 1.000 BIT_MASK 0x8 FORMAT "%5.3" ECU_ADDRESS 0x60036EF8 /end MEASUREMENT
/begin MEASUREMENT DFC_b.TST_ComEAT12TOut "Bit encoding / Tested bit for check DFC_ComEAT12TOut" UBYTE DFC_OneToOne 1 100 0.00 1.000 BIT_MASK 0x8 FORMAT "%5.3" ECU_ADDRESS 0x60036EF9 /end MEASUREMENT
/begin MEASUREMENT DFC_b.TST_ComEAT13ChkSum "Bit encoding / Tested bit for check DFC_ComEAT13ChkSum" UBYTE DFC_OneToOne 1 100 0.00 1.000 BIT_MASK 0x8 FORMAT "%5.3" ECU_ADDRESS 0x60036EFA /end MEASUREMENT
/begin MEASUREMENT DFC_b.TST_ComEAT13RingCnt "Bit encoding / Tested bit for check DFC_ComEAT13RingCnt" UBYTE DFC_OneToOne 1 100 0.00 1.000 BIT_MASK 0x8 FORMAT "%5.3" ECU_ADDRESS 0x60036EFB /end MEASUREMENT
/begin MEASUREMENT DFC_b.TST_ComEAT13TOut "Bit encoding / Tested bit for check DFC_ComEAT13TOut" UBYTE DFC_OneToOne 1 100 0.00 1.000 BIT_MASK 0x8 FORMAT "%5.3" ECU_ADDRESS 0x60036EFC /end MEASUREMENT
/begin MEASUREMENT DFC_b.TST_ComEAT1Chksum "Bit encoding / Tested bit for check DFC_ComEAT1Chksum" UBYTE DFC_OneToOne 1 100 0.00 1.000 BIT_MASK 0x8 FORMAT "%5.3" ECU_ADDRESS 0x60036EFD /end MEASUREMENT
/begin MEASUREMENT DFC_b.TST_ComEAT1RingCnt "Bit encoding / Tested bit for check DFC_ComEAT1RingCnt" UBYTE DFC_OneToOne 1 100 0.00 1.000 BIT_MASK 0x8 FORMAT "%5.3" ECU_ADDRESS 0x60036EFE /end MEASUREMENT
/begin MEASUREMENT DFC_b.TST_ComEAT1TOut "Bit encoding / Tested bit for check DFC_ComEAT1TOut" UBYTE DFC_OneToOne 1 100 0.00 1.000 BIT_MASK 0x8 FORMAT "%5.3" ECU_ADDRESS 0x60036EFF /end MEASUREMENT
/begin MEASUREMENT DFC_b.TST_ComEAT2ChkSum "Bit encoding / Tested bit for check DFC_ComEAT2ChkSum" UBYTE DFC_OneToOne 1 100 0.00 1.000 BIT_MASK 0x8 FORMAT "%5.3" ECU_ADDRESS 0x60036F00 /end MEASUREMENT
/begin MEASUREMENT DFC_b.TST_ComEAT2RingCnt "Bit encoding / Tested bit for check DFC_ComEAT2RingCnt" UBYTE DFC_OneToOne 1 100 0.00 1.000 BIT_MASK 0x8 FORMAT "%5.3" ECU_ADDRESS 0x60036F01 /end MEASUREMENT
/begin MEASUREMENT DFC_b.TST_ComEAT2TOut "Bit encoding / Tested bit for check DFC_ComEAT2TOut" UBYTE DFC_OneToOne 1 100 0.00 1.000 BIT_MASK 0x8 FORMAT "%5.3" ECU_ADDRESS 0x60036F02 /end MEASUREMENT
/begin MEASUREMENT DFC_b.TST_ComEAT4ChkSum "Bit encoding / Tested bit for check DFC_ComEAT4ChkSum" UBYTE DFC_OneToOne 1 100 0.00 1.000 BIT_MASK 0x8 FORMAT "%5.3" ECU_ADDRESS 0x60036F03 /end MEASUREMENT
/begin MEASUREMENT DFC_b.TST_ComEAT4RingCnt "Bit encoding / Tested bit for check DFC_ComEAT4RingCnt" UBYTE DFC_OneToOne 1 100 0.00 1.000 BIT_MASK 0x8 FORMAT "%5.3" ECU_ADDRESS 0x60036F04 /end MEASUREMENT
/begin MEASUREMENT DFC_b.TST_ComEAT4TOut "Bit encoding / Tested bit for check DFC_ComEAT4TOut" UBYTE DFC_OneToOne 1 100 0.00 1.000 BIT_MASK 0x8 FORMAT "%5.3" ECU_ADDRESS 0x60036F05 /end MEASUREMENT
/begin MEASUREMENT DFC_b.TST_ComEAT6Chksum "Bit encoding / Tested bit for check DFC_ComEAT6Chksum" UBYTE DFC_OneToOne 1 100 0.00 1.000 BIT_MASK 0x8 FORMAT "%5.3" ECU_ADDRESS 0x60036F06 /end MEASUREMENT
/begin MEASUREMENT DFC_b.TST_ComEAT6RingCnt "Bit encoding / Tested bit for check DFC_ComEAT6RingCnt" UBYTE DFC_OneToOne 1 100 0.00 1.000 BIT_MASK 0x8 FORMAT "%5.3" ECU_ADDRESS 0x60036F07 /end MEASUREMENT
/begin MEASUREMENT DFC_b.TST_ComEAT6TOut "Bit encoding / Tested bit for check DFC_ComEAT6TOut" UBYTE DFC_OneToOne 1 100 0.00 1.000 BIT_MASK 0x8 FORMAT "%5.3" ECU_ADDRESS 0x60036F08 /end MEASUREMENT
/begin MEASUREMENT DFC_b.TST_ComEAT7Chksum "Bit encoding / Tested bit for check DFC_ComEAT7Chksum" UBYTE DFC_OneToOne 1 100 0.00 1.000 BIT_MASK 0x8 FORMAT "%5.3" ECU_ADDRESS 0x60036F09 /end MEASUREMENT
/begin MEASUREMENT DFC_b.TST_ComEAT7RingCnt "Bit encoding / Tested bit for check DFC_ComEAT7RingCnt" UBYTE DFC_OneToOne 1 100 0.00 1.000 BIT_MASK 0x8 FORMAT "%5.3" ECU_ADDRESS 0x60036F0A /end MEASUREMENT
/begin MEASUREMENT DFC_b.TST_ComEAT7TOut "Bit encoding / Tested bit for check DFC_ComEAT7TOut" UBYTE DFC_OneToOne 1 100 0.00 1.000 BIT_MASK 0x8 FORMAT "%5.3" ECU_ADDRESS 0x60036F0B /end MEASUREMENT
/begin MEASUREMENT DFC_b.TST_ComEAT8Chksum "Bit encoding / Tested bit for check DFC_ComEAT8Chksum" UBYTE DFC_OneToOne 1 100 0.00 1.000 BIT_MASK 0x8 FORMAT "%5.3" ECU_ADDRESS 0x60036F0C /end MEASUREMENT
/begin MEASUREMENT DFC_b.TST_ComEAT8RingCnt "Bit encoding / Tested bit for check DFC_ComEAT8RingCnt" UBYTE DFC_OneToOne 1 100 0.00 1.000 BIT_MASK 0x8 FORMAT "%5.3" ECU_ADDRESS 0x60036F0D /end MEASUREMENT
/begin MEASUREMENT DFC_b.TST_ComEAT8TOut "Bit encoding / Tested bit for check DFC_ComEAT8TOut" UBYTE DFC_OneToOne 1 100 0.00 1.000 BIT_MASK 0x8 FORMAT "%5.3" ECU_ADDRESS 0x60036F0E /end MEASUREMENT
/begin MEASUREMENT DFC_b.TST_ComEATAChksum "Bit encoding / Tested bit for check DFC_ComEATAChksum" UBYTE DFC_OneToOne 1 100 0.00 1.000 BIT_MASK 0x8 FORMAT "%5.3" ECU_ADDRESS 0x60036F0F /end MEASUREMENT
/begin MEASUREMENT DFC_b.TST_ComEATARingCnt "Bit encoding / Tested bit for check DFC_ComEATARingCnt" UBYTE DFC_OneToOne 1 100 0.00 1.000 BIT_MASK 0x8 FORMAT "%5.3" ECU_ADDRESS 0x60036F10 /end MEASUREMENT
/begin MEASUREMENT DFC_b.TST_ComEATATOut "Bit encoding / Tested bit for check DFC_ComEATATOut" UBYTE DFC_OneToOne 1 100 0.00 1.000 BIT_MASK 0x8 FORMAT "%5.3" ECU_ADDRESS 0x60036F11 /end MEASUREMENT
/begin MEASUREMENT DFC_b.TST_ComEATBChkSum "Bit encoding / Tested bit for check DFC_ComEATBChkSum" UBYTE DFC_OneToOne 1 100 0.00 1.000 BIT_MASK 0x8 FORMAT "%5.3" ECU_ADDRESS 0x60036F12 /end MEASUREMENT
/begin MEASUREMENT DFC_b.TST_ComEATBRingCnt "Bit encoding / Tested bit for check DFC_ComEATBRingCnt" UBYTE DFC_OneToOne 1 100 0.00 1.000 BIT_MASK 0x8 FORMAT "%5.3" ECU_ADDRESS 0x60036F13 /end MEASUREMENT
/begin MEASUREMENT DFC_b.TST_ComEATBTOut "Bit encoding / Tested bit for check DFC_ComEATBTOut" UBYTE DFC_OneToOne 1 100 0.00 1.000 BIT_MASK 0x8 FORMAT "%5.3" ECU_ADDRESS 0x60036F14 /end MEASUREMENT
/begin MEASUREMENT DFC_b.TST_ComEATCChksum "Bit encoding / Tested bit for check DFC_ComEATCChksum" UBYTE DFC_OneToOne 1 100 0.00 1.000 BIT_MASK 0x8 FORMAT "%5.3" ECU_ADDRESS 0x60036F15 /end MEASUREMENT
/begin MEASUREMENT DFC_b.TST_ComEATCRingCnt "Bit encoding / Tested bit for check DFC_ComEATCRingCnt" UBYTE DFC_OneToOne 1 100 0.00 1.000 BIT_MASK 0x8 FORMAT "%5.3" ECU_ADDRESS 0x60036F16 /end MEASUREMENT
/begin MEASUREMENT DFC_b.TST_ComEATCTOut "Bit encoding / Tested bit for check DFC_ComEATCTOut" UBYTE DFC_OneToOne 1 100 0.00 1.000 BIT_MASK 0x8 FORMAT "%5.3" ECU_ADDRESS 0x60036F17 /end MEASUREMENT
/begin MEASUREMENT DFC_b.TST_ComEPBBChkSum "Bit encoding / Tested bit for check DFC_ComEPBBChkSum" UBYTE DFC_OneToOne 1 100 0.00 1.000 BIT_MASK 0x8 FORMAT "%5.3" ECU_ADDRESS 0x60036F18 /end MEASUREMENT
/begin MEASUREMENT DFC_b.TST_ComEPBBRingCnt "Bit encoding / Tested bit for check DFC_ComEPBBRingCnt" UBYTE DFC_OneToOne 1 100 0.00 1.000 BIT_MASK 0x8 FORMAT "%5.3" ECU_ADDRESS 0x60036F19 /end MEASUREMENT
/begin MEASUREMENT DFC_b.TST_ComEPBBTOut "Bit encoding / Tested bit for check DFC_ComEPBBTOut" UBYTE DFC_OneToOne 1 100 0.00 1.000 BIT_MASK 0x8 FORMAT "%5.3" ECU_ADDRESS 0x60036F1A /end MEASUREMENT
/begin MEASUREMENT DFC_b.TST_ComEPBChksum "Bit encoding / Tested bit for check DFC_ComEPBChksum" UBYTE DFC_OneToOne 1 100 0.00 1.000 BIT_MASK 0x8 FORMAT "%5.3" ECU_ADDRESS 0x60036F1B /end MEASUREMENT
/begin MEASUREMENT DFC_b.TST_ComEPBTOut "Bit encoding / Tested bit for check DFC_ComEPBTOut" UBYTE DFC_OneToOne 1 100 0.00 1.000 BIT_MASK 0x8 FORMAT "%5.3" ECU_ADDRESS 0x60036F1C /end MEASUREMENT
/begin MEASUREMENT DFC_b.TST_ComEPBctRing "Bit encoding / Tested bit for check DFC_ComEPBctRing" UBYTE DFC_OneToOne 1 100 0.00 1.000 BIT_MASK 0x8 FORMAT "%5.3" ECU_ADDRESS 0x60036F1D /end MEASUREMENT
/begin MEASUREMENT DFC_b.TST_ComEPS1Chksum "Bit encoding / Tested bit for check DFC_ComEPS1Chksum" UBYTE DFC_OneToOne 1 100 0.00 1.000 BIT_MASK 0x8 FORMAT "%5.3" ECU_ADDRESS 0x60036F1E /end MEASUREMENT
/begin MEASUREMENT DFC_b.TST_ComEPS1RingCnt "Bit encoding / Tested bit for check DFC_ComEPS1RingCnt" UBYTE DFC_OneToOne 1 100 0.00 1.000 BIT_MASK 0x8 FORMAT "%5.3" ECU_ADDRESS 0x60036F1F /end MEASUREMENT
/begin MEASUREMENT DFC_b.TST_ComEPS1TOut "Bit encoding / Tested bit for check DFC_ComEPS1TOut" UBYTE DFC_OneToOne 1 100 0.00 1.000 BIT_MASK 0x8 FORMAT "%5.3" ECU_ADDRESS 0x60036F20 /end MEASUREMENT
/begin MEASUREMENT DFC_b.TST_ComEngCanRxErr "Bit encoding / Tested bit for check DFC_ComEngCanRxErr" UBYTE DFC_OneToOne 1 100 0.00 1.000 BIT_MASK 0x8 FORMAT "%5.3" ECU_ADDRESS 0x60036F21 /end MEASUREMENT
/begin MEASUREMENT DFC_b.TST_ComGrvySnsrErr "Bit encoding / Tested bit for check DFC_ComGrvySnsrErr" UBYTE DFC_OneToOne 1 100 0.00 1.000 BIT_MASK 0x8 FORMAT "%5.3" ECU_ADDRESS 0x60036F22 /end MEASUREMENT
/begin MEASUREMENT DFC_b.TST_ComGwIMG1ChkSum "Bit encoding / Tested bit for check DFC_ComGwIMG1ChkSum" UBYTE DFC_OneToOne 1 100 0.00 1.000 BIT_MASK 0x8 FORMAT "%5.3" ECU_ADDRESS 0x60036F23 /end MEASUREMENT
/begin MEASUREMENT DFC_b.TST_ComGwIMG1RingCnt "Bit encoding / Tested bit for check DFC_ComGwIMG1RingCnt" UBYTE DFC_OneToOne 1 100 0.00 1.000 BIT_MASK 0x8 FORMAT "%5.3" ECU_ADDRESS 0x60036F24 /end MEASUREMENT
/begin MEASUREMENT DFC_b.TST_ComGwIMG1TOut "Bit encoding / Tested bit for check DFC_ComGwIMG1TOut" UBYTE DFC_OneToOne 1 100 0.00 1.000 BIT_MASK 0x8 FORMAT "%5.3" ECU_ADDRESS 0x60036F25 /end MEASUREMENT
/begin MEASUREMENT DFC_b.TST_ComGwIMG3ChkSum "Bit encoding / Tested bit for check DFC_ComGwIMG3ChkSum" UBYTE DFC_OneToOne 1 100 0.00 1.000 BIT_MASK 0x8 FORMAT "%5.3" ECU_ADDRESS 0x60036F26 /end MEASUREMENT
/begin MEASUREMENT DFC_b.TST_ComGwIMG3RingCnt "Bit encoding / Tested bit for check DFC_ComGwIMG3RingCnt" UBYTE DFC_OneToOne 1 100 0.00 1.000 BIT_MASK 0x8 FORMAT "%5.3" ECU_ADDRESS 0x60036F27 /end MEASUREMENT
/begin MEASUREMENT DFC_b.TST_ComGwIMG3TOut "Bit encoding / Tested bit for check DFC_ComGwIMG3TOut" UBYTE DFC_OneToOne 1 100 0.00 1.000 BIT_MASK 0x8 FORMAT "%5.3" ECU_ADDRESS 0x60036F28 /end MEASUREMENT
/begin MEASUREMENT DFC_b.TST_ComGwIMG4ChkSum "Bit encoding / Tested bit for check DFC_ComGwIMG4ChkSum" UBYTE DFC_OneToOne 1 100 0.00 1.000 BIT_MASK 0x8 FORMAT "%5.3" ECU_ADDRESS 0x60036F29 /end MEASUREMENT
/begin MEASUREMENT DFC_b.TST_ComGwIMG4RingCnt "Bit encoding / Tested bit for check DFC_ComGwIMG4RingCnt" UBYTE DFC_OneToOne 1 100 0.00 1.000 BIT_MASK 0x8 FORMAT "%5.3" ECU_ADDRESS 0x60036F2A /end MEASUREMENT
/begin MEASUREMENT DFC_b.TST_ComGwIMG4TOut "Bit encoding / Tested bit for check DFC_ComGwIMG4TOut" UBYTE DFC_OneToOne 1 100 0.00 1.000 BIT_MASK 0x8 FORMAT "%5.3" ECU_ADDRESS 0x60036F2B /end MEASUREMENT
/begin MEASUREMENT DFC_b.TST_ComGwIMG5ChkSum "Bit encoding / Tested bit for check DFC_ComGwIMG5ChkSum" UBYTE DFC_OneToOne 1 100 0.00 1.000 BIT_MASK 0x8 FORMAT "%5.3" ECU_ADDRESS 0x60036F2C /end MEASUREMENT
/begin MEASUREMENT DFC_b.TST_ComGwIMG5RingCnt "Bit encoding / Tested bit for check DFC_ComGwIMG5RingCnt" UBYTE DFC_OneToOne 1 100 0.00 1.000 BIT_MASK 0x8 FORMAT "%5.3" ECU_ADDRESS 0x60036F2D /end MEASUREMENT
/begin MEASUREMENT DFC_b.TST_ComGwIMG5TOut "Bit encoding / Tested bit for check DFC_ComGwIMG5TOut" UBYTE DFC_OneToOne 1 100 0.00 1.000 BIT_MASK 0x8 FORMAT "%5.3" ECU_ADDRESS 0x60036F2E /end MEASUREMENT
/begin MEASUREMENT DFC_b.TST_ComGwIMG6ChkSum "Bit encoding / Tested bit for check DFC_ComGwIMG6ChkSum" UBYTE DFC_OneToOne 1 100 0.00 1.000 BIT_MASK 0x8 FORMAT "%5.3" ECU_ADDRESS 0x60036F2F /end MEASUREMENT
/begin MEASUREMENT DFC_b.TST_ComGwIMG6RingCnt "Bit encoding / Tested bit for check DFC_ComGwIMG6RingCnt" UBYTE DFC_OneToOne 1 100 0.00 1.000 BIT_MASK 0x8 FORMAT "%5.3" ECU_ADDRESS 0x60036F30 /end MEASUREMENT
/begin MEASUREMENT DFC_b.TST_ComGwIMG6TOut "Bit encoding / Tested bit for check DFC_ComGwIMG6TOut" UBYTE DFC_OneToOne 1 100 0.00 1.000 BIT_MASK 0x8 FORMAT "%5.3" ECU_ADDRESS 0x60036F31 /end MEASUREMENT
/begin MEASUREMENT DFC_b.TST_ComIDASBChksum "Bit encoding / Tested bit for check DFC_ComIDASBChksum" UBYTE DFC_OneToOne 1 100 0.00 1.000 BIT_MASK 0x8 FORMAT "%5.3" ECU_ADDRESS 0x60036F32 /end MEASUREMENT
/begin MEASUREMENT DFC_b.TST_ComIDASBRingCnt "Bit encoding / Tested bit for check DFC_ComIDASBRingCnt" UBYTE DFC_OneToOne 1 100 0.00 1.000 BIT_MASK 0x8 FORMAT "%5.3" ECU_ADDRESS 0x60036F33 /end MEASUREMENT
/begin MEASUREMENT DFC_b.TST_ComIDASBTOut "Bit encoding / Tested bit for check DFC_ComIDASBTOut" UBYTE DFC_OneToOne 1 100 0.00 1.000 BIT_MASK 0x8 FORMAT "%5.3" ECU_ADDRESS 0x60036F34 /end MEASUREMENT
/begin MEASUREMENT DFC_b.TST_ComIMGMILReq "Bit encoding / Tested bit for check DFC_ComIMGMILReq" UBYTE DFC_OneToOne 1 100 0.00 1.000 BIT_MASK 0x8 FORMAT "%5.3" ECU_ADDRESS 0x60036F35 /end MEASUREMENT
/begin MEASUREMENT DFC_b.TST_ComISSPrms "Bit encoding / Tested bit for check DFC_ComISSPrms" UBYTE DFC_OneToOne 1 100 0.00 1.000 BIT_MASK 0x8 FORMAT "%5.3" ECU_ADDRESS 0x60036F36 /end MEASUREMENT
/begin MEASUREMENT DFC_b.TST_ComMETAChksum "Bit encoding / Tested bit for check DFC_ComMETAChksum" UBYTE DFC_OneToOne 1 100 0.00 1.000 BIT_MASK 0x8 FORMAT "%5.3" ECU_ADDRESS 0x60036F37 /end MEASUREMENT
/begin MEASUREMENT DFC_b.TST_ComMETAChksumPstDrv "Bit encoding / Tested bit for check DFC_ComMETAChksumPstDrv" UBYTE DFC_OneToOne 1 100 0.00 1.000 BIT_MASK 0x8 FORMAT "%5.3" ECU_ADDRESS 0x60036F38 /end MEASUREMENT
/begin MEASUREMENT DFC_b.TST_ComMETARingCnt "Bit encoding / Tested bit for check DFC_ComMETARingCnt" UBYTE DFC_OneToOne 1 100 0.00 1.000 BIT_MASK 0x8 FORMAT "%5.3" ECU_ADDRESS 0x60036F39 /end MEASUREMENT
/begin MEASUREMENT DFC_b.TST_ComMETARingCntPstDrv "Bit encoding / Tested bit for check DFC_ComMETARingCntPstDrv" UBYTE DFC_OneToOne 1 100 0.00 1.000 BIT_MASK 0x8 FORMAT "%5.3" ECU_ADDRESS 0x60036F3A /end MEASUREMENT
/begin MEASUREMENT DFC_b.TST_ComMETATOut "Bit encoding / Tested bit for check DFC_ComMETATOut" UBYTE DFC_OneToOne 1 100 0.00 1.000 BIT_MASK 0x8 FORMAT "%5.3" ECU_ADDRESS 0x60036F3B /end MEASUREMENT
/begin MEASUREMENT DFC_b.TST_ComMETATOutPstDrv "Bit encoding / Tested bit for check DFC_ComMETATOutPstDrv" UBYTE DFC_OneToOne 1 100 0.00 1.000 BIT_MASK 0x8 FORMAT "%5.3" ECU_ADDRESS 0x60036F3C /end MEASUREMENT
/begin MEASUREMENT DFC_b.TST_ComMETCChksum "Bit encoding / Tested bit for check DFC_ComMETCChksum" UBYTE DFC_OneToOne 1 100 0.00 1.000 BIT_MASK 0x8 FORMAT "%5.3" ECU_ADDRESS 0x60036F3D /end MEASUREMENT
/begin MEASUREMENT DFC_b.TST_ComMETCRingCnt "Bit encoding / Tested bit for check DFC_ComMETCRingCnt" UBYTE DFC_OneToOne 1 100 0.00 1.000 BIT_MASK 0x8 FORMAT "%5.3" ECU_ADDRESS 0x60036F3E /end MEASUREMENT
/begin MEASUREMENT DFC_b.TST_ComMETCTOut "Bit encoding / Tested bit for check DFC_ComMETCTOut" UBYTE DFC_OneToOne 1 100 0.00 1.000 BIT_MASK 0x8 FORMAT "%5.3" ECU_ADDRESS 0x60036F3F /end MEASUREMENT
/begin MEASUREMENT DFC_b.TST_ComMETDChksum "Bit encoding / Tested bit for check DFC_ComMETDChksum" UBYTE DFC_OneToOne 1 100 0.00 1.000 BIT_MASK 0x8 FORMAT "%5.3" ECU_ADDRESS 0x60036F40 /end MEASUREMENT
/begin MEASUREMENT DFC_b.TST_ComMETDRingCnt "Bit encoding / Tested bit for check DFC_ComMETDRingCnt" UBYTE DFC_OneToOne 1 100 0.00 1.000 BIT_MASK 0x8 FORMAT "%5.3" ECU_ADDRESS 0x60036F41 /end MEASUREMENT
/begin MEASUREMENT DFC_b.TST_ComMETDTOut "Bit encoding / Tested bit for check DFC_ComMETDTOut" UBYTE DFC_OneToOne 1 100 0.00 1.000 BIT_MASK 0x8 FORMAT "%5.3" ECU_ADDRESS 0x60036F42 /end MEASUREMENT
/begin MEASUREMENT DFC_b.TST_ComMETE2Chksum "Bit encoding / Tested bit for check DFC_ComMETE2Chksum" UBYTE DFC_OneToOne 1 100 0.00 1.000 BIT_MASK 0x8 FORMAT "%5.3" ECU_ADDRESS 0x60036F43 /end MEASUREMENT
/begin MEASUREMENT DFC_b.TST_ComMETE2RingCnt "Bit encoding / Tested bit for check DFC_ComMETE2RingCnt" UBYTE DFC_OneToOne 1 100 0.00 1.000 BIT_MASK 0x8 FORMAT "%5.3" ECU_ADDRESS 0x60036F44 /end MEASUREMENT
/begin MEASUREMENT DFC_b.TST_ComMETE2TOut "Bit encoding / Tested bit for check DFC_ComMETE2TOut" UBYTE DFC_OneToOne 1 100 0.00 1.000 BIT_MASK 0x8 FORMAT "%5.3" ECU_ADDRESS 0x60036F45 /end MEASUREMENT
/begin MEASUREMENT DFC_b.TST_ComMETFChksum "Bit encoding / Tested bit for check DFC_ComMETFChksum" UBYTE DFC_OneToOne 1 100 0.00 1.000 BIT_MASK 0x8 FORMAT "%5.3" ECU_ADDRESS 0x60036F46 /end MEASUREMENT
/begin MEASUREMENT DFC_b.TST_ComMETFRingCnt "Bit encoding / Tested bit for check DFC_ComMETFRingCnt" UBYTE DFC_OneToOne 1 100 0.00 1.000 BIT_MASK 0x8 FORMAT "%5.3" ECU_ADDRESS 0x60036F47 /end MEASUREMENT
/begin MEASUREMENT DFC_b.TST_ComMETFTOut "Bit encoding / Tested bit for check DFC_ComMETFTOut" UBYTE DFC_OneToOne 1 100 0.00 1.000 BIT_MASK 0x8 FORMAT "%5.3" ECU_ADDRESS 0x60036F48 /end MEASUREMENT
/begin MEASUREMENT DFC_b.TST_ComMETGChksum "Bit encoding / Tested bit for check DFC_ComMETGChksum" UBYTE DFC_OneToOne 1 100 0.00 1.000 BIT_MASK 0x8 FORMAT "%5.3" ECU_ADDRESS 0x60036F49 /end MEASUREMENT
/begin MEASUREMENT DFC_b.TST_ComMETGRingCnt "Bit encoding / Tested bit for check DFC_ComMETGRingCnt" UBYTE DFC_OneToOne 1 100 0.00 1.000 BIT_MASK 0x8 FORMAT "%5.3" ECU_ADDRESS 0x60036F4A /end MEASUREMENT
/begin MEASUREMENT DFC_b.TST_ComMETGTOut "Bit encoding / Tested bit for check DFC_ComMETGTOut" UBYTE DFC_OneToOne 1 100 0.00 1.000 BIT_MASK 0x8 FORMAT "%5.3" ECU_ADDRESS 0x60036F4B /end MEASUREMENT
/begin MEASUREMENT DFC_b.TST_ComMETH2Chksum "Bit encoding / Tested bit for check DFC_ComMETH2Chksum" UBYTE DFC_OneToOne 1 100 0.00 1.000 BIT_MASK 0x8 FORMAT "%5.3" ECU_ADDRESS 0x60036F4C /end MEASUREMENT
/begin MEASUREMENT DFC_b.TST_ComMETH2RingCnt "Bit encoding / Tested bit for check DFC_ComMETH2RingCnt" UBYTE DFC_OneToOne 1 100 0.00 1.000 BIT_MASK 0x8 FORMAT "%5.3" ECU_ADDRESS 0x60036F4D /end MEASUREMENT
/begin MEASUREMENT DFC_b.TST_ComMETH2TOut "Bit encoding / Tested bit for check DFC_ComMETH2TOut" UBYTE DFC_OneToOne 1 100 0.00 1.000 BIT_MASK 0x8 FORMAT "%5.3" ECU_ADDRESS 0x60036F4E /end MEASUREMENT
/begin MEASUREMENT DFC_b.TST_ComMETHChksum "Bit encoding / Tested bit for check DFC_ComMETHChksum" UBYTE DFC_OneToOne 1 100 0.00 1.000 BIT_MASK 0x8 FORMAT "%5.3" ECU_ADDRESS 0x60036F4F /end MEASUREMENT
/begin MEASUREMENT DFC_b.TST_ComMETHRingCnt "Bit encoding / Tested bit for check DFC_ComMETHRingCnt" UBYTE DFC_OneToOne 1 100 0.00 1.000 BIT_MASK 0x8 FORMAT "%5.3" ECU_ADDRESS 0x60036F50 /end MEASUREMENT
/begin MEASUREMENT DFC_b.TST_ComMETHTOut "Bit encoding / Tested bit for check DFC_ComMETHTOut" UBYTE DFC_OneToOne 1 100 0.00 1.000 BIT_MASK 0x8 FORMAT "%5.3" ECU_ADDRESS 0x60036F51 /end MEASUREMENT
/begin MEASUREMENT DFC_b.TST_ComMETIChksum "Bit encoding / Tested bit for check DFC_ComMETIChksum" UBYTE DFC_OneToOne 1 100 0.00 1.000 BIT_MASK 0x8 FORMAT "%5.3" ECU_ADDRESS 0x60036F52 /end MEASUREMENT
/begin MEASUREMENT DFC_b.TST_ComMETIRingCnt "Bit encoding / Tested bit for check DFC_ComMETIRingCnt" UBYTE DFC_OneToOne 1 100 0.00 1.000 BIT_MASK 0x8 FORMAT "%5.3" ECU_ADDRESS 0x60036F53 /end MEASUREMENT
/begin MEASUREMENT DFC_b.TST_ComMETITOut "Bit encoding / Tested bit for check DFC_ComMETITOut" UBYTE DFC_OneToOne 1 100 0.00 1.000 BIT_MASK 0x8 FORMAT "%5.3" ECU_ADDRESS 0x60036F54 /end MEASUREMENT
/begin MEASUREMENT DFC_b.TST_ComMETKChksum "Bit encoding / Tested bit for check DFC_ComMETKChksum" UBYTE DFC_OneToOne 1 100 0.00 1.000 BIT_MASK 0x8 FORMAT "%5.3" ECU_ADDRESS 0x60036F55 /end MEASUREMENT
/begin MEASUREMENT DFC_b.TST_ComMETKRingCnt "Bit encoding / Tested bit for check DFC_ComMETKRingCnt" UBYTE DFC_OneToOne 1 100 0.00 1.000 BIT_MASK 0x8 FORMAT "%5.3" ECU_ADDRESS 0x60036F56 /end MEASUREMENT
/begin MEASUREMENT DFC_b.TST_ComMETKTOut "Bit encoding / Tested bit for check DFC_ComMETKTOut" UBYTE DFC_OneToOne 1 100 0.00 1.000 BIT_MASK 0x8 FORMAT "%5.3" ECU_ADDRESS 0x60036F57 /end MEASUREMENT
/begin MEASUREMENT DFC_b.TST_ComMETLChksum "Bit encoding / Tested bit for check DFC_ComMETLChksum" UBYTE DFC_OneToOne 1 100 0.00 1.000 BIT_MASK 0x8 FORMAT "%5.3" ECU_ADDRESS 0x60036F58 /end MEASUREMENT
/begin MEASUREMENT DFC_b.TST_ComMETLRingCnt "Bit encoding / Tested bit for check DFC_ComMETLRingCnt" UBYTE DFC_OneToOne 1 100 0.00 1.000 BIT_MASK 0x8 FORMAT "%5.3" ECU_ADDRESS 0x60036F59 /end MEASUREMENT
/begin MEASUREMENT DFC_b.TST_ComMETLTOut "Bit encoding / Tested bit for check DFC_ComMETLTOut" UBYTE DFC_OneToOne 1 100 0.00 1.000 BIT_MASK 0x8 FORMAT "%5.3" ECU_ADDRESS 0x60036F5A /end MEASUREMENT
/begin MEASUREMENT DFC_b.TST_ComMETMChksum "Bit encoding / Tested bit for check DFC_ComMETMChksum" UBYTE DFC_OneToOne 1 100 0.00 1.000 BIT_MASK 0x8 FORMAT "%5.3" ECU_ADDRESS 0x60036F5B /end MEASUREMENT
/begin MEASUREMENT DFC_b.TST_ComMETMRingCnt "Bit encoding / Tested bit for check DFC_ComMETMRingCnt" UBYTE DFC_OneToOne 1 100 0.00 1.000 BIT_MASK 0x8 FORMAT "%5.3" ECU_ADDRESS 0x60036F5C /end MEASUREMENT
/begin MEASUREMENT DFC_b.TST_ComMETMTOut "Bit encoding / Tested bit for check DFC_ComMETMTOut" UBYTE DFC_OneToOne 1 100 0.00 1.000 BIT_MASK 0x8 FORMAT "%5.3" ECU_ADDRESS 0x60036F5D /end MEASUREMENT
/begin MEASUREMENT DFC_b.TST_ComMETNChksum "Bit encoding / Tested bit for check DFC_ComMETNChksum" UBYTE DFC_OneToOne 1 100 0.00 1.000 BIT_MASK 0x8 FORMAT "%5.3" ECU_ADDRESS 0x60036F5E /end MEASUREMENT
/begin MEASUREMENT DFC_b.TST_ComMETNRingCnt "Bit encoding / Tested bit for check DFC_ComMETNRingCnt" UBYTE DFC_OneToOne 1 100 0.00 1.000 BIT_MASK 0x8 FORMAT "%5.3" ECU_ADDRESS 0x60036F5F /end MEASUREMENT
/begin MEASUREMENT DFC_b.TST_ComMETNTOut "Bit encoding / Tested bit for check DFC_ComMETNTOut" UBYTE DFC_OneToOne 1 100 0.00 1.000 BIT_MASK 0x8 FORMAT "%5.3" ECU_ADDRESS 0x60036F60 /end MEASUREMENT
/begin MEASUREMENT DFC_b.TST_ComMtrCom "Bit encoding / Tested bit for check DFC_ComMtrCom" UBYTE DFC_OneToOne 1 100 0.00 1.000 BIT_MASK 0x8 FORMAT "%5.3" ECU_ADDRESS 0x60036F61 /end MEASUREMENT
/begin MEASUREMENT DFC_b.TST_ComPCUChkSum "Bit encoding / Tested bit for check DFC_ComPCUChkSum" UBYTE DFC_OneToOne 1 100 0.00 1.000 BIT_MASK 0x8 FORMAT "%5.3" ECU_ADDRESS 0x60036F62 /end MEASUREMENT
/begin MEASUREMENT DFC_b.TST_ComPCURingCnt "Bit encoding / Tested bit for check DFC_ComPCURingCnt" UBYTE DFC_OneToOne 1 100 0.00 1.000 BIT_MASK 0x8 FORMAT "%5.3" ECU_ADDRESS 0x60036F63 /end MEASUREMENT
/begin MEASUREMENT DFC_b.TST_ComPCUTOut "Bit encoding / Tested bit for check DFC_ComPCUTOut" UBYTE DFC_OneToOne 1 100 0.00 1.000 BIT_MASK 0x8 FORMAT "%5.3" ECU_ADDRESS 0x60036F64 /end MEASUREMENT
/begin MEASUREMENT DFC_b.TST_ComSRSAChksum "Bit encoding / Tested bit for check DFC_ComSRSAChksum" UBYTE DFC_OneToOne 1 100 0.00 1.000 BIT_MASK 0x8 FORMAT "%5.3" ECU_ADDRESS 0x60036F65 /end MEASUREMENT
/begin MEASUREMENT DFC_b.TST_ComSRSARingCnt "Bit encoding / Tested bit for check DFC_ComSRSARingCnt" UBYTE DFC_OneToOne 1 100 0.00 1.000 BIT_MASK 0x8 FORMAT "%5.3" ECU_ADDRESS 0x60036F66 /end MEASUREMENT
/begin MEASUREMENT DFC_b.TST_ComSRSATOut "Bit encoding / Tested bit for check DFC_ComSRSATOut" UBYTE DFC_OneToOne 1 100 0.00 1.000 BIT_MASK 0x8 FORMAT "%5.3" ECU_ADDRESS 0x60036F67 /end MEASUREMENT
/begin MEASUREMENT DFC_b.TST_ComSRSBChksum "Bit encoding / Tested bit for check DFC_ComSRSBChksum" UBYTE DFC_OneToOne 1 100 0.00 1.000 BIT_MASK 0x8 FORMAT "%5.3" ECU_ADDRESS 0x60036F68 /end MEASUREMENT
/begin MEASUREMENT DFC_b.TST_ComSRSBRingCnt "Bit encoding / Tested bit for check DFC_ComSRSBRingCnt" UBYTE DFC_OneToOne 1 100 0.00 1.000 BIT_MASK 0x8 FORMAT "%5.3" ECU_ADDRESS 0x60036F69 /end MEASUREMENT
/begin MEASUREMENT DFC_b.TST_ComSRSBTOut "Bit encoding / Tested bit for check DFC_ComSRSBTOut" UBYTE DFC_OneToOne 1 100 0.00 1.000 BIT_MASK 0x8 FORMAT "%5.3" ECU_ADDRESS 0x60036F6A /end MEASUREMENT
/begin MEASUREMENT DFC_b.TST_ComSRSChksum "Bit encoding / Tested bit for check DFC_ComSRSChksum" UBYTE DFC_OneToOne 1 100 0.00 1.000 BIT_MASK 0x8 FORMAT "%5.3" ECU_ADDRESS 0x60036F6B /end MEASUREMENT
/begin MEASUREMENT DFC_b.TST_ComSRSErr "Bit encoding / Tested bit for check DFC_ComSRSErr" UBYTE DFC_OneToOne 1 100 0.00 1.000 BIT_MASK 0x8 FORMAT "%5.3" ECU_ADDRESS 0x60036F6C /end MEASUREMENT
/begin MEASUREMENT DFC_b.TST_ComSRSRingCnt "Bit encoding / Tested bit for check DFC_ComSRSRingCnt" UBYTE DFC_OneToOne 1 100 0.00 1.000 BIT_MASK 0x8 FORMAT "%5.3" ECU_ADDRESS 0x60036F6D /end MEASUREMENT
/begin MEASUREMENT DFC_b.TST_ComSRSTOut "Bit encoding / Tested bit for check DFC_ComSRSTOut" UBYTE DFC_OneToOne 1 100 0.00 1.000 BIT_MASK 0x8 FORMAT "%5.3" ECU_ADDRESS 0x60036F6E /end MEASUREMENT
/begin MEASUREMENT DFC_b.TST_ComVehSpdPndFltTCU "Bit encoding / Tested bit for check DFC_ComVehSpdPndFltTCU" UBYTE DFC_OneToOne 1 100 0.00 1.000 BIT_MASK 0x8 FORMAT "%5.3" ECU_ADDRESS 0x60036F6F /end MEASUREMENT
/begin MEASUREMENT DFC_b.TST_EbsChartcCurrErr "Bit encoding / Tested bit for check DFC_EbsChartcCurrErr" UBYTE DFC_OneToOne 1 100 0.00 1.000 BIT_MASK 0x8 FORMAT "%5.3" ECU_ADDRESS 0x60036F70 /end MEASUREMENT
/begin MEASUREMENT DFC_b.TST_EbsSelfDiagErr "Bit encoding / Tested bit for check DFC_EbsSelfDiagErr" UBYTE DFC_OneToOne 1 100 0.00 1.000 BIT_MASK 0x8 FORMAT "%5.3" ECU_ADDRESS 0x60036F71 /end MEASUREMENT
/begin MEASUREMENT DFC_b.TST_GEVlvPhaCsersIntkB1 "Bit encoding / Tested bit for check DFC_GEVlvPhaCsersIntkB1" UBYTE DFC_OneToOne 1 100 0.00 1.000 BIT_MASK 0x8 FORMAT "%5.3" ECU_ADDRESS 0x60036F72 /end MEASUREMENT
/begin MEASUREMENT DFC_b.TST_GEVlvPhaPsOpenLoadIntkB1 "Bit encoding / Tested bit for check DFC_GEVlvPhaPsOpenLoadIntkB1" UBYTE DFC_OneToOne 1 100 0.00 1.000 BIT_MASK 0x8 FORMAT "%5.3" ECU_ADDRESS 0x60036F73 /end MEASUREMENT
/begin MEASUREMENT DFC_b.TST_GEVlvPhaPsShoToBattIntkB1 "Bit encoding / Tested bit for check DFC_GEVlvPhaPsShoToBattIntkB1" UBYTE DFC_OneToOne 1 100 0.00 1.000 BIT_MASK 0x8 FORMAT "%5.3" ECU_ADDRESS 0x60036F74 /end MEASUREMENT
/begin MEASUREMENT DFC_b.TST_GEVlvPhaPsShoToGndIntkB1 "Bit encoding / Tested bit for check DFC_GEVlvPhaPsShoToGndIntkB1" UBYTE DFC_OneToOne 1 100 0.00 1.000 BIT_MASK 0x8 FORMAT "%5.3" ECU_ADDRESS 0x60036F75 /end MEASUREMENT
/begin MEASUREMENT DFC_b.TST_GbxCANDigPlausErr "Bit encoding / Tested bit for check DFC_GbxCANDigPlausErr" UBYTE DFC_OneToOne 1 100 0.00 1.000 BIT_MASK 0x8 FORMAT "%5.3" ECU_ADDRESS 0x60036F76 /end MEASUREMENT
/begin MEASUREMENT DFC_b.TST_GbxNPos1SRCMax "Bit encoding / Tested bit for check DFC_GbxNPos1SRCMax" UBYTE DFC_OneToOne 1 100 0.00 1.000 BIT_MASK 0x8 FORMAT "%5.3" ECU_ADDRESS 0x60036F77 /end MEASUREMENT
/begin MEASUREMENT DFC_b.TST_GbxNPos1SRCMin "Bit encoding / Tested bit for check DFC_GbxNPos1SRCMin" UBYTE DFC_OneToOne 1 100 0.00 1.000 BIT_MASK 0x8 FORMAT "%5.3" ECU_ADDRESS 0x60036F78 /end MEASUREMENT
/begin MEASUREMENT DFC_b.TST_GbxNPos2SRCMax "Bit encoding / Tested bit for check DFC_GbxNPos2SRCMax" UBYTE DFC_OneToOne 1 100 0.00 1.000 BIT_MASK 0x8 FORMAT "%5.3" ECU_ADDRESS 0x60036F79 /end MEASUREMENT
/begin MEASUREMENT DFC_b.TST_GbxNPos2SRCMin "Bit encoding / Tested bit for check DFC_GbxNPos2SRCMin" UBYTE DFC_OneToOne 1 100 0.00 1.000 BIT_MASK 0x8 FORMAT "%5.3" ECU_ADDRESS 0x60036F7A /end MEASUREMENT
/begin MEASUREMENT DFC_b.TST_GbxNPosAlvChk "Bit encoding / Tested bit for check DFC_GbxNPosAlvChk" UBYTE DFC_OneToOne 1 100 0.00 1.000 BIT_MASK 0x8 FORMAT "%5.3" ECU_ADDRESS 0x60036F7B /end MEASUREMENT
/begin MEASUREMENT DFC_b.TST_GbxNPosSyncErr "Bit encoding / Tested bit for check DFC_GbxNPosSyncErr" UBYTE DFC_OneToOne 1 100 0.00 1.000 BIT_MASK 0x8 FORMAT "%5.3" ECU_ADDRESS 0x60036F7C /end MEASUREMENT
/begin MEASUREMENT DFC_b.TST_HEGOS2B1HtrPsMax "Bit encoding / Tested bit for check DFC_HEGOS2B1HtrPsMax" UBYTE DFC_OneToOne 1 100 0.00 1.000 BIT_MASK 0x8 FORMAT "%5.3" ECU_ADDRESS 0x60036F7D /end MEASUREMENT
/begin MEASUREMENT DFC_b.TST_HEGOS2B1HtrPsMin "Bit encoding / Tested bit for check DFC_HEGOS2B1HtrPsMin" UBYTE DFC_OneToOne 1 100 0.00 1.000 BIT_MASK 0x8 FORMAT "%5.3" ECU_ADDRESS 0x60036F7E /end MEASUREMENT
/begin MEASUREMENT DFC_b.TST_HEGOS2B1HtrPsSig "Bit encoding / Tested bit for check DFC_HEGOS2B1HtrPsSig" UBYTE DFC_OneToOne 1 100 0.00 1.000 BIT_MASK 0x8 FORMAT "%5.3" ECU_ADDRESS 0x60036F7F /end MEASUREMENT
/begin MEASUREMENT DFC_b.TST_LinCSErrACG "Bit encoding / Tested bit for check DFC_LinCSErrACG" UBYTE DFC_OneToOne 1 100 0.00 1.000 BIT_MASK 0x8 FORMAT "%5.3" ECU_ADDRESS 0x60036F80 /end MEASUREMENT
/begin MEASUREMENT DFC_b.TST_LinCSErrAEV "Bit encoding / Tested bit for check DFC_LinCSErrAEV" UBYTE DFC_OneToOne 1 100 0.00 1.000 BIT_MASK 0x8 FORMAT "%5.3" ECU_ADDRESS 0x60036F81 /end MEASUREMENT
/begin MEASUREMENT DFC_b.TST_LinCSErrDCDC "Bit encoding / Tested bit for check DFC_LinCSErrDCDC" UBYTE DFC_OneToOne 1 100 0.00 1.000 BIT_MASK 0x8 FORMAT "%5.3" ECU_ADDRESS 0x60036F82 /end MEASUREMENT
/begin MEASUREMENT DFC_b.TST_LinCSErrEBS "Bit encoding / Tested bit for check DFC_LinCSErrEBS" UBYTE DFC_OneToOne 1 100 0.00 1.000 BIT_MASK 0x8 FORMAT "%5.3" ECU_ADDRESS 0x60036F83 /end MEASUREMENT
/begin MEASUREMENT DFC_b.TST_LinHdrTimeoutErrACG "Bit encoding / Tested bit for check DFC_LinHdrTimeoutErrACG" UBYTE DFC_OneToOne 1 100 0.00 1.000 BIT_MASK 0x8 FORMAT "%5.3" ECU_ADDRESS 0x60036F84 /end MEASUREMENT
/begin MEASUREMENT DFC_b.TST_LinHdrTimeoutErrAEV "Bit encoding / Tested bit for check DFC_LinHdrTimeoutErrAEV" UBYTE DFC_OneToOne 1 100 0.00 1.000 BIT_MASK 0x8 FORMAT "%5.3" ECU_ADDRESS 0x60036F85 /end MEASUREMENT
/begin MEASUREMENT DFC_b.TST_LinHdrTimeoutErrDCDC "Bit encoding / Tested bit for check DFC_LinHdrTimeoutErrDCDC" UBYTE DFC_OneToOne 1 100 0.00 1.000 BIT_MASK 0x8 FORMAT "%5.3" ECU_ADDRESS 0x60036F86 /end MEASUREMENT
/begin MEASUREMENT DFC_b.TST_LinHdrTimeoutErrEBS "Bit encoding / Tested bit for check DFC_LinHdrTimeoutErrEBS" UBYTE DFC_OneToOne 1 100 0.00 1.000 BIT_MASK 0x8 FORMAT "%5.3" ECU_ADDRESS 0x60036F87 /end MEASUREMENT
/begin MEASUREMENT DFC_b.TST_LinMsgTimeoutErrACG "Bit encoding / Tested bit for check DFC_LinMsgTimeoutErrACG" UBYTE DFC_OneToOne 1 100 0.00 1.000 BIT_MASK 0x8 FORMAT "%5.3" ECU_ADDRESS 0x60036F88 /end MEASUREMENT
/begin MEASUREMENT DFC_b.TST_LinMsgTimeoutErrAEV "Bit encoding / Tested bit for check DFC_LinMsgTimeoutErrAEV" UBYTE DFC_OneToOne 1 100 0.00 1.000 BIT_MASK 0x8 FORMAT "%5.3" ECU_ADDRESS 0x60036F89 /end MEASUREMENT
/begin MEASUREMENT DFC_b.TST_LinMsgTimeoutErrDCDC "Bit encoding / Tested bit for check DFC_LinMsgTimeoutErrDCDC" UBYTE DFC_OneToOne 1 100 0.00 1.000 BIT_MASK 0x8 FORMAT "%5.3" ECU_ADDRESS 0x60036F8A /end MEASUREMENT
/begin MEASUREMENT DFC_b.TST_LinMsgTimeoutErrEBS "Bit encoding / Tested bit for check DFC_LinMsgTimeoutErrEBS" UBYTE DFC_OneToOne 1 100 0.00 1.000 BIT_MASK 0x8 FORMAT "%5.3" ECU_ADDRESS 0x60036F8B /end MEASUREMENT
/begin MEASUREMENT DFC_b.TST_LinNoStrtComErr "Bit encoding / Tested bit for check DFC_LinNoStrtComErr" UBYTE DFC_OneToOne 1 100 0.00 1.000 BIT_MASK 0x8 FORMAT "%5.3" ECU_ADDRESS 0x60036F8C /end MEASUREMENT
/begin MEASUREMENT DFC_b.TST_LowPresOilP "Bit encoding / Tested bit for check DFC_LowPresOilP" UBYTE DFC_OneToOne 1 100 0.00 1.000 BIT_MASK 0x8 FORMAT "%5.3" ECU_ADDRESS 0x60036F8D /end MEASUREMENT
/begin MEASUREMENT DFC_b.TST_MisfDetVWhlFrntLeOORHi "Bit encoding / Tested bit for check DFC_MisfDetVWhlFrntLeOORHi" UBYTE DFC_OneToOne 1 100 0.00 1.000 BIT_MASK 0x8 FORMAT "%5.3" ECU_ADDRESS 0x60036F8E /end MEASUREMENT
/begin MEASUREMENT DFC_b.TST_MisfDetVWhlFrntLeRatyHi "Bit encoding / Tested bit for check DFC_MisfDetVWhlFrntLeRatyHi" UBYTE DFC_OneToOne 1 100 0.00 1.000 BIT_MASK 0x8 FORMAT "%5.3" ECU_ADDRESS 0x60036F8F /end MEASUREMENT
/begin MEASUREMENT DFC_b.TST_MisfDetVWhlFrntLeRatyLo "Bit encoding / Tested bit for check DFC_MisfDetVWhlFrntLeRatyLo" UBYTE DFC_OneToOne 1 100 0.00 1.000 BIT_MASK 0x8 FORMAT "%5.3" ECU_ADDRESS 0x60036F90 /end MEASUREMENT
/begin MEASUREMENT DFC_b.TST_MisfDetVWhlFrntLeStuck "Bit encoding / Tested bit for check DFC_MisfDetVWhlFrntLeStuck" UBYTE DFC_OneToOne 1 100 0.00 1.000 BIT_MASK 0x8 FORMAT "%5.3" ECU_ADDRESS 0x60036F91 /end MEASUREMENT
/begin MEASUREMENT DFC_b.TST_MisfDetVWhlFrntRiOORHi "Bit encoding / Tested bit for check DFC_MisfDetVWhlFrntRiOORHi" UBYTE DFC_OneToOne 1 100 0.00 1.000 BIT_MASK 0x8 FORMAT "%5.3" ECU_ADDRESS 0x60036F92 /end MEASUREMENT
/begin MEASUREMENT DFC_b.TST_MisfDetVWhlFrntRiRatyHi "Bit encoding / Tested bit for check DFC_MisfDetVWhlFrntRiRatyHi" UBYTE DFC_OneToOne 1 100 0.00 1.000 BIT_MASK 0x8 FORMAT "%5.3" ECU_ADDRESS 0x60036F93 /end MEASUREMENT
/begin MEASUREMENT DFC_b.TST_MisfDetVWhlFrntRiRatyLo "Bit encoding / Tested bit for check DFC_MisfDetVWhlFrntRiRatyLo" UBYTE DFC_OneToOne 1 100 0.00 1.000 BIT_MASK 0x8 FORMAT "%5.3" ECU_ADDRESS 0x60036F94 /end MEASUREMENT
/begin MEASUREMENT DFC_b.TST_MisfDetVWhlFrntRiStuck "Bit encoding / Tested bit for check DFC_MisfDetVWhlFrntRiStuck" UBYTE DFC_OneToOne 1 100 0.00 1.000 BIT_MASK 0x8 FORMAT "%5.3" ECU_ADDRESS 0x60036F95 /end MEASUREMENT
/begin MEASUREMENT DFC_b.TST_MisfDetVWhlReLeOORHi "Bit encoding / Tested bit for check DFC_MisfDetVWhlReLeOORHi" UBYTE DFC_OneToOne 1 100 0.00 1.000 BIT_MASK 0x8 FORMAT "%5.3" ECU_ADDRESS 0x60036F96 /end MEASUREMENT
/begin MEASUREMENT DFC_b.TST_MisfDetVWhlReLeRatyHi "Bit encoding / Tested bit for check DFC_MisfDetVWhlReLeRatyHi" UBYTE DFC_OneToOne 1 100 0.00 1.000 BIT_MASK 0x8 FORMAT "%5.3" ECU_ADDRESS 0x60036F97 /end MEASUREMENT
/begin MEASUREMENT DFC_b.TST_MisfDetVWhlReLeRatyLo "Bit encoding / Tested bit for check DFC_MisfDetVWhlReLeRatyLo" UBYTE DFC_OneToOne 1 100 0.00 1.000 BIT_MASK 0x8 FORMAT "%5.3" ECU_ADDRESS 0x60036F98 /end MEASUREMENT
/begin MEASUREMENT DFC_b.TST_MisfDetVWhlReLeStuck "Bit encoding / Tested bit for check DFC_MisfDetVWhlReLeStuck" UBYTE DFC_OneToOne 1 100 0.00 1.000 BIT_MASK 0x8 FORMAT "%5.3" ECU_ADDRESS 0x60036F99 /end MEASUREMENT
/begin MEASUREMENT DFC_b.TST_MisfDetVWhlReRiOORHi "Bit encoding / Tested bit for check DFC_MisfDetVWhlReRiOORHi" UBYTE DFC_OneToOne 1 100 0.00 1.000 BIT_MASK 0x8 FORMAT "%5.3" ECU_ADDRESS 0x60036F9A /end MEASUREMENT
/begin MEASUREMENT DFC_b.TST_MisfDetVWhlReRiRatyHi "Bit encoding / Tested bit for check DFC_MisfDetVWhlReRiRatyHi" UBYTE DFC_OneToOne 1 100 0.00 1.000 BIT_MASK 0x8 FORMAT "%5.3" ECU_ADDRESS 0x60036F9B /end MEASUREMENT
/begin MEASUREMENT DFC_b.TST_MisfDetVWhlReRiRatyLo "Bit encoding / Tested bit for check DFC_MisfDetVWhlReRiRatyLo" UBYTE DFC_OneToOne 1 100 0.00 1.000 BIT_MASK 0x8 FORMAT "%5.3" ECU_ADDRESS 0x60036F9C /end MEASUREMENT
/begin MEASUREMENT DFC_b.TST_MisfDetVWhlReRiStuck "Bit encoding / Tested bit for check DFC_MisfDetVWhlReRiStuck" UBYTE DFC_OneToOne 1 100 0.00 1.000 BIT_MASK 0x8 FORMAT "%5.3" ECU_ADDRESS 0x60036F9D /end MEASUREMENT
/begin MEASUREMENT DFC_b.TST_MisfDetdVWhlFrntLePlaus "Bit encoding / Tested bit for check DFC_MisfDetdVWhlFrntLePlaus" UBYTE DFC_OneToOne 1 100 0.00 1.000 BIT_MASK 0x8 FORMAT "%5.3" ECU_ADDRESS 0x60036F9E /end MEASUREMENT
/begin MEASUREMENT DFC_b.TST_MisfDetdVWhlFrntRiPlaus "Bit encoding / Tested bit for check DFC_MisfDetdVWhlFrntRiPlaus" UBYTE DFC_OneToOne 1 100 0.00 1.000 BIT_MASK 0x8 FORMAT "%5.3" ECU_ADDRESS 0x60036F9F /end MEASUREMENT
/begin MEASUREMENT DFC_b.TST_MisfDetdVWhlReLePlaus "Bit encoding / Tested bit for check DFC_MisfDetdVWhlReLePlaus" UBYTE DFC_OneToOne 1 100 0.00 1.000 BIT_MASK 0x8 FORMAT "%5.3" ECU_ADDRESS 0x60036FA0 /end MEASUREMENT
/begin MEASUREMENT DFC_b.TST_MisfDetdVWhlReRiPlaus "Bit encoding / Tested bit for check DFC_MisfDetdVWhlReRiPlaus" UBYTE DFC_OneToOne 1 100 0.00 1.000 BIT_MASK 0x8 FORMAT "%5.3" ECU_ADDRESS 0x60036FA1 /end MEASUREMENT
/begin MEASUREMENT DFC_b.TST_PEnvSigRngMax "Bit encoding / Tested bit for check DFC_PEnvSigRngMax" UBYTE DFC_OneToOne 1 100 0.00 1.000 BIT_MASK 0x8 FORMAT "%5.3" ECU_ADDRESS 0x60036FA2 /end MEASUREMENT
/begin MEASUREMENT DFC_b.TST_PEnvSigRngMin "Bit encoding / Tested bit for check DFC_PEnvSigRngMin" UBYTE DFC_OneToOne 1 100 0.00 1.000 BIT_MASK 0x8 FORMAT "%5.3" ECU_ADDRESS 0x60036FA3 /end MEASUREMENT
/begin MEASUREMENT DFC_b.TST_StmFault "Bit encoding / Tested bit for check DFC_StmFault" UBYTE DFC_OneToOne 1 100 0.00 1.000 BIT_MASK 0x8 FORMAT "%5.3" ECU_ADDRESS 0x60036FA4 /end MEASUREMENT
/begin MEASUREMENT DFC_b.TST_StrtCtOffPth "Bit encoding / Tested bit for check DFC_StrtCtOffPth" UBYTE DFC_OneToOne 1 100 0.00 1.000 BIT_MASK 0x8 FORMAT "%5.3" ECU_ADDRESS 0x60036FA5 /end MEASUREMENT
/begin MEASUREMENT DFC_b.TST_StrtCtlErr "Bit encoding / Tested bit for check DFC_StrtCtlErr" UBYTE DFC_OneToOne 1 100 0.00 1.000 BIT_MASK 0x8 FORMAT "%5.3" ECU_ADDRESS 0x60036FA6 /end MEASUREMENT
/begin MEASUREMENT DFC_b.TST_StrtFault "Bit encoding / Tested bit for check DFC_StrtFault" UBYTE DFC_OneToOne 1 100 0.00 1.000 BIT_MASK 0x8 FORMAT "%5.3" ECU_ADDRESS 0x60036FA7 /end MEASUREMENT
/begin MEASUREMENT DFC_b.TST_StrtLckJudg1 "Bit encoding / Tested bit for check DFC_StrtLckJudg1" UBYTE DFC_OneToOne 1 100 0.00 1.000 BIT_MASK 0x8 FORMAT "%5.3" ECU_ADDRESS 0x60036FA8 /end MEASUREMENT
/begin MEASUREMENT DFC_b.TST_StrtLckJudg2 "Bit encoding / Tested bit for check DFC_StrtLckJudg2" UBYTE DFC_OneToOne 1 100 0.00 1.000 BIT_MASK 0x8 FORMAT "%5.3" ECU_ADDRESS 0x60036FA9 /end MEASUREMENT
/begin MEASUREMENT DFC_b.TST_StrtOL "Bit encoding / Tested bit for check DFC_StrtOL" UBYTE DFC_OneToOne 1 100 0.00 1.000 BIT_MASK 0x8 FORMAT "%5.3" ECU_ADDRESS 0x60036FAA /end MEASUREMENT
/begin MEASUREMENT DFC_b.TST_StrtOL2 "Bit encoding / Tested bit for check DFC_StrtOL2" UBYTE DFC_OneToOne 1 100 0.00 1.000 BIT_MASK 0x8 FORMAT "%5.3" ECU_ADDRESS 0x60036FAB /end MEASUREMENT
/begin MEASUREMENT DFC_b.TST_StrtSCB "Bit encoding / Tested bit for check DFC_StrtSCB" UBYTE DFC_OneToOne 1 100 0.00 1.000 BIT_MASK 0x8 FORMAT "%5.3" ECU_ADDRESS 0x60036FAC /end MEASUREMENT
/begin MEASUREMENT DFC_b.TST_StrtSCB2 "Bit encoding / Tested bit for check DFC_StrtSCB2" UBYTE DFC_OneToOne 1 100 0.00 1.000 BIT_MASK 0x8 FORMAT "%5.3" ECU_ADDRESS 0x60036FAD /end MEASUREMENT
/begin MEASUREMENT DFC_b.TST_StrtSCG "Bit encoding / Tested bit for check DFC_StrtSCG" UBYTE DFC_OneToOne 1 100 0.00 1.000 BIT_MASK 0x8 FORMAT "%5.3" ECU_ADDRESS 0x60036FAE /end MEASUREMENT
/begin MEASUREMENT DFC_b.TST_StrtSCG2 "Bit encoding / Tested bit for check DFC_StrtSCG2" UBYTE DFC_OneToOne 1 100 0.00 1.000 BIT_MASK 0x8 FORMAT "%5.3" ECU_ADDRESS 0x60036FAF /end MEASUREMENT
/begin MEASUREMENT DFC_b.TST_StrtStkRly1 "Bit encoding / Tested bit for check DFC_StrtStkRly1" UBYTE DFC_OneToOne 1 100 0.00 1.000 BIT_MASK 0x8 FORMAT "%5.3" ECU_ADDRESS 0x60036FB0 /end MEASUREMENT
/begin MEASUREMENT DFC_b.TST_StrtStkRly2 "Bit encoding / Tested bit for check DFC_StrtStkRly2" UBYTE DFC_OneToOne 1 100 0.00 1.000 BIT_MASK 0x8 FORMAT "%5.3" ECU_ADDRESS 0x60036FB1 /end MEASUREMENT
/begin MEASUREMENT DFC_b.TST_TEVEmax "Bit encoding / Tested bit for check DFC_TEVEmax" UBYTE DFC_OneToOne 1 100 0.00 1.000 BIT_MASK 0x8 FORMAT "%5.3" ECU_ADDRESS 0x60036FB2 /end MEASUREMENT
/begin MEASUREMENT DFC_b.TST_TEVEmin "Bit encoding / Tested bit for check DFC_TEVEmin" UBYTE DFC_OneToOne 1 100 0.00 1.000 BIT_MASK 0x8 FORMAT "%5.3" ECU_ADDRESS 0x60036FB3 /end MEASUREMENT
/begin MEASUREMENT DFC_b.TST_TEVEsig "Bit encoding / Tested bit for check DFC_TEVEsig" UBYTE DFC_OneToOne 1 100 0.00 1.000 BIT_MASK 0x8 FORMAT "%5.3" ECU_ADDRESS 0x60036FB4 /end MEASUREMENT
/begin MEASUREMENT DFC_b.TST_UegoHeatrPrfmncLoS1B1 "Bit encoding / Tested bit for check DFC_UegoHeatrPrfmncLoS1B1" UBYTE DFC_OneToOne 1 100 0.00 1.000 BIT_MASK 0x8 FORMAT "%5.3" ECU_ADDRESS 0x60036FB5 /end MEASUREMENT
/begin MEASUREMENT DFC_b.TST_VehVAllPlaus "Bit encoding / Tested bit for check DFC_VehVAllPlaus" UBYTE DFC_OneToOne 1 100 0.00 1.000 BIT_MASK 0x8 FORMAT "%5.3" ECU_ADDRESS 0x60036FB6 /end MEASUREMENT
/begin MEASUREMENT DFC_b.TST_VehVNCSnsrElecFailr "Bit encoding / Tested bit for check DFC_VehVNCSnsrElecFailr" UBYTE DFC_OneToOne 1 100 0.00 1.000 BIT_MASK 0x8 FORMAT "%5.3" ECU_ADDRESS 0x60036FB7 /end MEASUREMENT
/begin MEASUREMENT DFC_b.TST_VehVPlausCan "Bit encoding / Tested bit for check DFC_VehVPlausCan" UBYTE DFC_OneToOne 1 100 0.00 1.000 BIT_MASK 0x8 FORMAT "%5.3" ECU_ADDRESS 0x60036FB8 /end MEASUREMENT
/begin MEASUREMENT DFC_b.TST_VehVPlausFco "Bit encoding / Tested bit for check DFC_VehVPlausFco" UBYTE DFC_OneToOne 1 100 0.00 1.000 BIT_MASK 0x8 FORMAT "%5.3" ECU_ADDRESS 0x60036FB9 /end MEASUREMENT
/begin MEASUREMENT DFC_b.TST_VehVPlausPwr "Bit encoding / Tested bit for check DFC_VehVPlausPwr" UBYTE DFC_OneToOne 1 100 0.00 1.000 BIT_MASK 0x8 FORMAT "%5.3" ECU_ADDRESS 0x60036FBA /end MEASUREMENT
/begin MEASUREMENT DFC_b.TST_VehVPlausV2N "Bit encoding / Tested bit for check DFC_VehVPlausV2N" UBYTE DFC_OneToOne 1 100 0.00 1.000 BIT_MASK 0x8 FORMAT "%5.3" ECU_ADDRESS 0x60036FBB /end MEASUREMENT
/begin MEASUREMENT DFC_b.TST_VehVSpdSnsrAElecFailr "Bit encoding / Tested bit for check DFC_VehVSpdSnsrAElecFailr" UBYTE DFC_OneToOne 1 100 0.00 1.000 BIT_MASK 0x8 FORMAT "%5.3" ECU_ADDRESS 0x60036FBC /end MEASUREMENT
/begin MEASUREMENT DFC_b.TST_VehVSpdSnsrBElecFailr "Bit encoding / Tested bit for check DFC_VehVSpdSnsrBElecFailr" UBYTE DFC_OneToOne 1 100 0.00 1.000 BIT_MASK 0x8 FORMAT "%5.3" ECU_ADDRESS 0x60036FBD /end MEASUREMENT
/begin MEASUREMENT DFC_b.TST_ClthMax "Bit encoding / Tested bit for check DFC_ClthMax" UBYTE DFC_OneToOne 1 100 0.00 1.000 BIT_MASK 0x8 FORMAT "%5.3" ECU_ADDRESS 0x60036FBE /end MEASUREMENT
/begin MEASUREMENT DFC_b.TST_IgnClPs_DevComErr "Bit encoding / Tested bit for check DFC_IgnClPs_DevComErr" UBYTE DFC_OneToOne 1 100 0.00 1.000 BIT_MASK 0x8 FORMAT "%5.3" ECU_ADDRESS 0x60036FBF /end MEASUREMENT
/begin MEASUREMENT DFC_b.TST_IgnClPs_LineOl_0 "Bit encoding / Tested bit for check DFC_IgnClPs_LineOl_0" UBYTE DFC_OneToOne 1 100 0.00 1.000 BIT_MASK 0x8 FORMAT "%5.3" ECU_ADDRESS 0x60036FC0 /end MEASUREMENT
/begin MEASUREMENT DFC_b.TST_IgnClPs_LineOl_1 "Bit encoding / Tested bit for check DFC_IgnClPs_LineOl_1" UBYTE DFC_OneToOne 1 100 0.00 1.000 BIT_MASK 0x8 FORMAT "%5.3" ECU_ADDRESS 0x60036FC1 /end MEASUREMENT
/begin MEASUREMENT DFC_b.TST_IgnClPs_LineOl_2 "Bit encoding / Tested bit for check DFC_IgnClPs_LineOl_2" UBYTE DFC_OneToOne 1 100 0.00 1.000 BIT_MASK 0x8 FORMAT "%5.3" ECU_ADDRESS 0x60036FC2 /end MEASUREMENT
/begin MEASUREMENT DFC_b.TST_IgnClPs_LineOl_3 "Bit encoding / Tested bit for check DFC_IgnClPs_LineOl_3" UBYTE DFC_OneToOne 1 100 0.00 1.000 BIT_MASK 0x8 FORMAT "%5.3" ECU_ADDRESS 0x60036FC3 /end MEASUREMENT
/begin MEASUREMENT DFC_b.TST_IgnClPs_LineScb_0 "Bit encoding / Tested bit for check DFC_IgnClPs_LineScb_0" UBYTE DFC_OneToOne 1 100 0.00 1.000 BIT_MASK 0x8 FORMAT "%5.3" ECU_ADDRESS 0x60036FC4 /end MEASUREMENT
/begin MEASUREMENT DFC_b.TST_IgnClPs_LineScb_1 "Bit encoding / Tested bit for check DFC_IgnClPs_LineScb_1" UBYTE DFC_OneToOne 1 100 0.00 1.000 BIT_MASK 0x8 FORMAT "%5.3" ECU_ADDRESS 0x60036FC5 /end MEASUREMENT
/begin MEASUREMENT DFC_b.TST_IgnClPs_LineScb_2 "Bit encoding / Tested bit for check DFC_IgnClPs_LineScb_2" UBYTE DFC_OneToOne 1 100 0.00 1.000 BIT_MASK 0x8 FORMAT "%5.3" ECU_ADDRESS 0x60036FC6 /end MEASUREMENT
/begin MEASUREMENT DFC_b.TST_IgnClPs_LineScb_3 "Bit encoding / Tested bit for check DFC_IgnClPs_LineScb_3" UBYTE DFC_OneToOne 1 100 0.00 1.000 BIT_MASK 0x8 FORMAT "%5.3" ECU_ADDRESS 0x60036FC7 /end MEASUREMENT
/begin MEASUREMENT DFC_b.TST_IgnClPs_LineScg_0 "Bit encoding / Tested bit for check DFC_IgnClPs_LineScg_0" UBYTE DFC_OneToOne 1 100 0.00 1.000 BIT_MASK 0x8 FORMAT "%5.3" ECU_ADDRESS 0x60036FC8 /end MEASUREMENT
/begin MEASUREMENT DFC_b.TST_IgnClPs_LineScg_1 "Bit encoding / Tested bit for check DFC_IgnClPs_LineScg_1" UBYTE DFC_OneToOne 1 100 0.00 1.000 BIT_MASK 0x8 FORMAT "%5.3" ECU_ADDRESS 0x60036FC9 /end MEASUREMENT
/begin MEASUREMENT DFC_b.TST_IgnClPs_LineScg_2 "Bit encoding / Tested bit for check DFC_IgnClPs_LineScg_2" UBYTE DFC_OneToOne 1 100 0.00 1.000 BIT_MASK 0x8 FORMAT "%5.3" ECU_ADDRESS 0x60036FCA /end MEASUREMENT
/begin MEASUREMENT DFC_b.TST_IgnClPs_LineScg_3 "Bit encoding / Tested bit for check DFC_IgnClPs_LineScg_3" UBYTE DFC_OneToOne 1 100 0.00 1.000 BIT_MASK 0x8 FORMAT "%5.3" ECU_ADDRESS 0x60036FCB /end MEASUREMENT
/begin MEASUREMENT DFC_b.TST_KRVEKOEVAB "Bit encoding / Tested bit for check DFC_KRVEKOEVAB" UBYTE DFC_OneToOne 1 100 0.00 1.000 BIT_MASK 0x8 FORMAT "%5.3" ECU_ADDRESS 0x60036FCC /end MEASUREMENT
/begin MEASUREMENT DFC_b.TST_KRVEKOEVAB0 "Bit encoding / Tested bit for check DFC_KRVEKOEVAB0" UBYTE DFC_OneToOne 1 100 0.00 1.000 BIT_MASK 0x8 FORMAT "%5.3" ECU_ADDRESS 0x60036FCD /end MEASUREMENT
/begin MEASUREMENT DFC_b.TST_KRVEKOEVAB1 "Bit encoding / Tested bit for check DFC_KRVEKOEVAB1" UBYTE DFC_OneToOne 1 100 0.00 1.000 BIT_MASK 0x8 FORMAT "%5.3" ECU_ADDRESS 0x60036FCE /end MEASUREMENT
/begin MEASUREMENT DFC_b.TST_KRVEKOEVAB2 "Bit encoding / Tested bit for check DFC_KRVEKOEVAB2" UBYTE DFC_OneToOne 1 100 0.00 1.000 BIT_MASK 0x8 FORMAT "%5.3" ECU_ADDRESS 0x60036FCF /end MEASUREMENT
/begin MEASUREMENT DFC_b.TST_KRVEKOEVAB3 "Bit encoding / Tested bit for check DFC_KRVEKOEVAB3" UBYTE DFC_OneToOne 1 100 0.00 1.000 BIT_MASK 0x8 FORMAT "%5.3" ECU_ADDRESS 0x60036FD0 /end MEASUREMENT
/begin MEASUREMENT DFC_b.TST_UegoSigEcuAsicS1B1 "Bit encoding / Tested bit for check DFC_UegoSigEcuAsicS1B1" UBYTE DFC_OneToOne 1 100 0.00 1.000 BIT_MASK 0x8 FORMAT "%5.3" ECU_ADDRESS 0x60036FD1 /end MEASUREMENT
/begin MEASUREMENT DFC_b.TST_UegoSigEcuComS1B1 "Bit encoding / Tested bit for check DFC_UegoSigEcuComS1B1" UBYTE DFC_OneToOne 1 100 0.00 1.000 BIT_MASK 0x8 FORMAT "%5.3" ECU_ADDRESS 0x60036FD2 /end MEASUREMENT
/begin MEASUREMENT DFC_b.TST_UegoSigSnsrS1B1 "Bit encoding / Tested bit for check DFC_UegoSigSnsrS1B1" UBYTE DFC_OneToOne 1 100 0.00 1.000 BIT_MASK 0x8 FORMAT "%5.3" ECU_ADDRESS 0x60036FD3 /end MEASUREMENT
/begin MEASUREMENT DFC_b.TST_UegoSigWireOlApesS1B1 "Bit encoding / Tested bit for check DFC_UegoSigWireOlApesS1B1" UBYTE DFC_OneToOne 1 100 0.00 1.000 BIT_MASK 0x8 FORMAT "%5.3" ECU_ADDRESS 0x60036FD4 /end MEASUREMENT
/begin MEASUREMENT DFC_b.TST_UegoSigWireOlIpeS1B1 "Bit encoding / Tested bit for check DFC_UegoSigWireOlIpeS1B1" UBYTE DFC_OneToOne 1 100 0.00 1.000 BIT_MASK 0x8 FORMAT "%5.3" ECU_ADDRESS 0x60036FD5 /end MEASUREMENT
/begin MEASUREMENT DFC_b.TST_UegoSigWireOlReS1B1 "Bit encoding / Tested bit for check DFC_UegoSigWireOlReS1B1" UBYTE DFC_OneToOne 1 100 0.00 1.000 BIT_MASK 0x8 FORMAT "%5.3" ECU_ADDRESS 0x60036FD6 /end MEASUREMENT
/begin MEASUREMENT DFC_b.TST_UegoSigWireRCmpS1B1 "Bit encoding / Tested bit for check DFC_UegoSigWireRCmpS1B1" UBYTE DFC_OneToOne 1 100 0.00 1.000 BIT_MASK 0x8 FORMAT "%5.3" ECU_ADDRESS 0x60036FD7 /end MEASUREMENT
/begin MEASUREMENT DFC_b.TST_UegoSigWireScbS1B1 "Bit encoding / Tested bit for check DFC_UegoSigWireScbS1B1" UBYTE DFC_OneToOne 1 100 0.00 1.000 BIT_MASK 0x8 FORMAT "%5.3" ECU_ADDRESS 0x60036FD8 /end MEASUREMENT
/begin MEASUREMENT DFC_b.TST_UegoSigWireScgS1B1 "Bit encoding / Tested bit for check DFC_UegoSigWireScgS1B1" UBYTE DFC_OneToOne 1 100 0.00 1.000 BIT_MASK 0x8 FORMAT "%5.3" ECU_ADDRESS 0x60036FD9 /end MEASUREMENT
/begin MEASUREMENT DFC_b.TST_AfsPhyRngHiB1 "Bit encoding / Tested bit for check DFC_AfsPhyRngHiB1" UBYTE DFC_OneToOne 1 100 0.00 1.000 BIT_MASK 0x8 FORMAT "%5.3" ECU_ADDRESS 0x60036FDA /end MEASUREMENT
/begin MEASUREMENT DFC_b.TST_AfsPhyRngLoB1 "Bit encoding / Tested bit for check DFC_AfsPhyRngLoB1" UBYTE DFC_OneToOne 1 100 0.00 1.000 BIT_MASK 0x8 FORMAT "%5.3" ECU_ADDRESS 0x60036FDB /end MEASUREMENT
/begin MEASUREMENT DFC_b.TST_AirCCmprOL "Bit encoding / Tested bit for check DFC_AirCCmprOL" UBYTE DFC_OneToOne 1 100 0.00 1.000 BIT_MASK 0x8 FORMAT "%5.3" ECU_ADDRESS 0x60036FDC /end MEASUREMENT
/begin MEASUREMENT DFC_b.TST_AirCCmprOvrTemp "Bit encoding / Tested bit for check DFC_AirCCmprOvrTemp" UBYTE DFC_OneToOne 1 100 0.00 1.000 BIT_MASK 0x8 FORMAT "%5.3" ECU_ADDRESS 0x60036FDD /end MEASUREMENT
/begin MEASUREMENT DFC_b.TST_AirCCmprSCB "Bit encoding / Tested bit for check DFC_AirCCmprSCB" UBYTE DFC_OneToOne 1 100 0.00 1.000 BIT_MASK 0x8 FORMAT "%5.3" ECU_ADDRESS 0x60036FDE /end MEASUREMENT
/begin MEASUREMENT DFC_b.TST_AirCCmprSCG "Bit encoding / Tested bit for check DFC_AirCCmprSCG" UBYTE DFC_OneToOne 1 100 0.00 1.000 BIT_MASK 0x8 FORMAT "%5.3" ECU_ADDRESS 0x60036FDF /end MEASUREMENT
/begin MEASUREMENT DFC_b.TST_AltErr "Bit encoding / Tested bit for check DFC_AltErr" UBYTE DFC_OneToOne 1 100 0.00 1.000 BIT_MASK 0x8 FORMAT "%5.3" ECU_ADDRESS 0x60036FE0 /end MEASUREMENT
/begin MEASUREMENT DFC_b.TST_BattUSRCMax "Bit encoding / Tested bit for check DFC_BattUSRCMax" UBYTE DFC_OneToOne 1 100 0.00 1.000 BIT_MASK 0x8 FORMAT "%5.3" ECU_ADDRESS 0x60036FE1 /end MEASUREMENT
/begin MEASUREMENT DFC_b.TST_BattUSRCMin "Bit encoding / Tested bit for check DFC_BattUSRCMin" UBYTE DFC_OneToOne 1 100 0.00 1.000 BIT_MASK 0x8 FORMAT "%5.3" ECU_ADDRESS 0x60036FE2 /end MEASUREMENT
/begin MEASUREMENT DFC_b.TST_ComChksTCU1 "Bit encoding / Tested bit for check DFC_ComChksTCU1" UBYTE DFC_OneToOne 1 100 0.00 1.000 BIT_MASK 0x8 FORMAT "%5.3" ECU_ADDRESS 0x60036FE3 /end MEASUREMENT
/begin MEASUREMENT DFC_b.TST_ComChksTCU11 "Bit encoding / Tested bit for check DFC_ComChksTCU11" UBYTE DFC_OneToOne 1 100 0.00 1.000 BIT_MASK 0x8 FORMAT "%5.3" ECU_ADDRESS 0x60036FE4 /end MEASUREMENT
/begin MEASUREMENT DFC_b.TST_ComChksTCU12 "Bit encoding / Tested bit for check DFC_ComChksTCU12" UBYTE DFC_OneToOne 1 100 0.00 1.000 BIT_MASK 0x8 FORMAT "%5.3" ECU_ADDRESS 0x60036FE5 /end MEASUREMENT
/begin MEASUREMENT DFC_b.TST_ComChksTCU13 "Bit encoding / Tested bit for check DFC_ComChksTCU13" UBYTE DFC_OneToOne 1 100 0.00 1.000 BIT_MASK 0x8 FORMAT "%5.3" ECU_ADDRESS 0x60036FE6 /end MEASUREMENT
/begin MEASUREMENT DFC_b.TST_ComChksTCU2 "Bit encoding / Tested bit for check DFC_ComChksTCU2" UBYTE DFC_OneToOne 1 100 0.00 1.000 BIT_MASK 0x8 FORMAT "%5.3" ECU_ADDRESS 0x60036FE7 /end MEASUREMENT
/begin MEASUREMENT DFC_b.TST_ComChksTCU3 "Bit encoding / Tested bit for check DFC_ComChksTCU3" UBYTE DFC_OneToOne 1 100 0.00 1.000 BIT_MASK 0x8 FORMAT "%5.3" ECU_ADDRESS 0x60036FE8 /end MEASUREMENT
/begin MEASUREMENT DFC_b.TST_ComChksTCU4 "Bit encoding / Tested bit for check DFC_ComChksTCU4" UBYTE DFC_OneToOne 1 100 0.00 1.000 BIT_MASK 0x8 FORMAT "%5.3" ECU_ADDRESS 0x60036FE9 /end MEASUREMENT
/begin MEASUREMENT DFC_b.TST_ComCntTCU1 "Bit encoding / Tested bit for check DFC_ComCntTCU1" UBYTE DFC_OneToOne 1 100 0.00 1.000 BIT_MASK 0x8 FORMAT "%5.3" ECU_ADDRESS 0x60036FEA /end MEASUREMENT
/begin MEASUREMENT DFC_b.TST_ComCntTCU11 "Bit encoding / Tested bit for check DFC_ComCntTCU11" UBYTE DFC_OneToOne 1 100 0.00 1.000 BIT_MASK 0x8 FORMAT "%5.3" ECU_ADDRESS 0x60036FEB /end MEASUREMENT
/begin MEASUREMENT DFC_b.TST_ComCntTCU12 "Bit encoding / Tested bit for check DFC_ComCntTCU12" UBYTE DFC_OneToOne 1 100 0.00 1.000 BIT_MASK 0x8 FORMAT "%5.3" ECU_ADDRESS 0x60036FEC /end MEASUREMENT
/begin MEASUREMENT DFC_b.TST_ComCntTCU13 "Bit encoding / Tested bit for check DFC_ComCntTCU13" UBYTE DFC_OneToOne 1 100 0.00 1.000 BIT_MASK 0x8 FORMAT "%5.3" ECU_ADDRESS 0x60036FED /end MEASUREMENT
/begin MEASUREMENT DFC_b.TST_ComCntTCU2 "Bit encoding / Tested bit for check DFC_ComCntTCU2" UBYTE DFC_OneToOne 1 100 0.00 1.000 BIT_MASK 0x8 FORMAT "%5.3" ECU_ADDRESS 0x60036FEE /end MEASUREMENT
/begin MEASUREMENT DFC_b.TST_ComCntTCU3 "Bit encoding / Tested bit for check DFC_ComCntTCU3" UBYTE DFC_OneToOne 1 100 0.00 1.000 BIT_MASK 0x8 FORMAT "%5.3" ECU_ADDRESS 0x60036FEF /end MEASUREMENT
/begin MEASUREMENT DFC_b.TST_ComCntTCU4 "Bit encoding / Tested bit for check DFC_ComCntTCU4" UBYTE DFC_OneToOne 1 100 0.00 1.000 BIT_MASK 0x8 FORMAT "%5.3" ECU_ADDRESS 0x60036FF0 /end MEASUREMENT
/begin MEASUREMENT DFC_b.TST_ComTOutTCU01 "Bit encoding / Tested bit for check DFC_ComTOutTCU01" UBYTE DFC_OneToOne 1 100 0.00 1.000 BIT_MASK 0x8 FORMAT "%5.3" ECU_ADDRESS 0x60036FF1 /end MEASUREMENT
/begin MEASUREMENT DFC_b.TST_ComTOutTCU02 "Bit encoding / Tested bit for check DFC_ComTOutTCU02" UBYTE DFC_OneToOne 1 100 0.00 1.000 BIT_MASK 0x8 FORMAT "%5.3" ECU_ADDRESS 0x60036FF2 /end MEASUREMENT
/begin MEASUREMENT DFC_b.TST_ComTOutTCU1 "Bit encoding / Tested bit for check DFC_ComTOutTCU1" UBYTE DFC_OneToOne 1 100 0.00 1.000 BIT_MASK 0x8 FORMAT "%5.3" ECU_ADDRESS 0x60036FF3 /end MEASUREMENT
/begin MEASUREMENT DFC_b.TST_ComTOutTCU11 "Bit encoding / Tested bit for check DFC_ComTOutTCU11" UBYTE DFC_OneToOne 1 100 0.00 1.000 BIT_MASK 0x8 FORMAT "%5.3" ECU_ADDRESS 0x60036FF4 /end MEASUREMENT
/begin MEASUREMENT DFC_b.TST_ComTOutTCU12 "Bit encoding / Tested bit for check DFC_ComTOutTCU12" UBYTE DFC_OneToOne 1 100 0.00 1.000 BIT_MASK 0x8 FORMAT "%5.3" ECU_ADDRESS 0x60036FF5 /end MEASUREMENT
/begin MEASUREMENT DFC_b.TST_ComTOutTCU13 "Bit encoding / Tested bit for check DFC_ComTOutTCU13" UBYTE DFC_OneToOne 1 100 0.00 1.000 BIT_MASK 0x8 FORMAT "%5.3" ECU_ADDRESS 0x60036FF6 /end MEASUREMENT
/begin MEASUREMENT DFC_b.TST_ComTOutTCU14 "Bit encoding / Tested bit for check DFC_ComTOutTCU14" UBYTE DFC_OneToOne 1 100 0.00 1.000 BIT_MASK 0x8 FORMAT "%5.3" ECU_ADDRESS 0x60036FF7 /end MEASUREMENT
/begin MEASUREMENT DFC_b.TST_ComTOutTCU2 "Bit encoding / Tested bit for check DFC_ComTOutTCU2" UBYTE DFC_OneToOne 1 100 0.00 1.000 BIT_MASK 0x8 FORMAT "%5.3" ECU_ADDRESS 0x60036FF8 /end MEASUREMENT
/begin MEASUREMENT DFC_b.TST_ComTOutTCU3 "Bit encoding / Tested bit for check DFC_ComTOutTCU3" UBYTE DFC_OneToOne 1 100 0.00 1.000 BIT_MASK 0x8 FORMAT "%5.3" ECU_ADDRESS 0x60036FF9 /end MEASUREMENT
/begin MEASUREMENT DFC_b.TST_ComTOutTCU4 "Bit encoding / Tested bit for check DFC_ComTOutTCU4" UBYTE DFC_OneToOne 1 100 0.00 1.000 BIT_MASK 0x8 FORMAT "%5.3" ECU_ADDRESS 0x60036FFA /end MEASUREMENT
/begin MEASUREMENT DFC_b.TST_DevLibBattUHi "Bit encoding / Tested bit for check DFC_DevLibBattUHi" UBYTE DFC_OneToOne 1 100 0.00 1.000 BIT_MASK 0x8 FORMAT "%5.3" ECU_ADDRESS 0x60036FFB /end MEASUREMENT
/begin MEASUREMENT DFC_b.TST_DevLibBattULo "Bit encoding / Tested bit for check DFC_DevLibBattULo" UBYTE DFC_OneToOne 1 100 0.00 1.000 BIT_MASK 0x8 FORMAT "%5.3" ECU_ADDRESS 0x60036FFC /end MEASUREMENT
/begin MEASUREMENT DFC_b.TST_EGRVlvFailSafeActv "Bit encoding / Tested bit for check DFC_EGRVlvFailSafeActv" UBYTE DFC_OneToOne 1 100 0.00 1.000 BIT_MASK 0x8 FORMAT "%5.3" ECU_ADDRESS 0x60036FFD /end MEASUREMENT
/begin MEASUREMENT DFC_b.TST_EGRVlvGovDvtCld "Bit encoding / Tested bit for check DFC_EGRVlvGovDvtCld" UBYTE DFC_OneToOne 1 100 0.00 1.000 BIT_MASK 0x8 FORMAT "%5.3" ECU_ADDRESS 0x60036FFE /end MEASUREMENT
/begin MEASUREMENT DFC_b.TST_EGRVlvPhysSRCMax "Bit encoding / Tested bit for check DFC_EGRVlvPhysSRCMax" UBYTE DFC_OneToOne 1 100 0.00 1.000 BIT_MASK 0x8 FORMAT "%5.3" ECU_ADDRESS 0x60036FFF /end MEASUREMENT
/begin MEASUREMENT DFC_b.TST_EGRVlvPhysSRCMin "Bit encoding / Tested bit for check DFC_EGRVlvPhysSRCMin" UBYTE DFC_OneToOne 1 100 0.00 1.000 BIT_MASK 0x8 FORMAT "%5.3" ECU_ADDRESS 0x60037000 /end MEASUREMENT
/begin MEASUREMENT DFC_b.TST_FanDIOOL_0 "Bit encoding / Tested bit for check DFC_FanDIOOL_0" UBYTE DFC_OneToOne 1 100 0.00 1.000 BIT_MASK 0x8 FORMAT "%5.3" ECU_ADDRESS 0x60037001 /end MEASUREMENT
/begin MEASUREMENT DFC_b.TST_FanDIOOL_1 "Bit encoding / Tested bit for check DFC_FanDIOOL_1" UBYTE DFC_OneToOne 1 100 0.00 1.000 BIT_MASK 0x8 FORMAT "%5.3" ECU_ADDRESS 0x60037002 /end MEASUREMENT
/begin MEASUREMENT DFC_b.TST_FanDIOOvrTemp_0 "Bit encoding / Tested bit for check DFC_FanDIOOvrTemp_0" UBYTE DFC_OneToOne 1 100 0.00 1.000 BIT_MASK 0x8 FORMAT "%5.3" ECU_ADDRESS 0x60037003 /end MEASUREMENT
/begin MEASUREMENT DFC_b.TST_FanDIOOvrTemp_1 "Bit encoding / Tested bit for check DFC_FanDIOOvrTemp_1" UBYTE DFC_OneToOne 1 100 0.00 1.000 BIT_MASK 0x8 FORMAT "%5.3" ECU_ADDRESS 0x60037004 /end MEASUREMENT
/begin MEASUREMENT DFC_b.TST_FanDIOSCB_0 "Bit encoding / Tested bit for check DFC_FanDIOSCB_0" UBYTE DFC_OneToOne 1 100 0.00 1.000 BIT_MASK 0x8 FORMAT "%5.3" ECU_ADDRESS 0x60037005 /end MEASUREMENT
/begin MEASUREMENT DFC_b.TST_FanDIOSCB_1 "Bit encoding / Tested bit for check DFC_FanDIOSCB_1" UBYTE DFC_OneToOne 1 100 0.00 1.000 BIT_MASK 0x8 FORMAT "%5.3" ECU_ADDRESS 0x60037006 /end MEASUREMENT
/begin MEASUREMENT DFC_b.TST_FanDIOSCG_0 "Bit encoding / Tested bit for check DFC_FanDIOSCG_0" UBYTE DFC_OneToOne 1 100 0.00 1.000 BIT_MASK 0x8 FORMAT "%5.3" ECU_ADDRESS 0x60037007 /end MEASUREMENT
/begin MEASUREMENT DFC_b.TST_FanDIOSCG_1 "Bit encoding / Tested bit for check DFC_FanDIOSCG_1" UBYTE DFC_OneToOne 1 100 0.00 1.000 BIT_MASK 0x8 FORMAT "%5.3" ECU_ADDRESS 0x60037008 /end MEASUREMENT
/begin MEASUREMENT DFC_b.TST_MRlyDcOL "Bit encoding / Tested bit for check DFC_MRlyDcOL" UBYTE DFC_OneToOne 1 100 0.00 1.000 BIT_MASK 0x8 FORMAT "%5.3" ECU_ADDRESS 0x60037009 /end MEASUREMENT
/begin MEASUREMENT DFC_b.TST_MRlyDcSCB "Bit encoding / Tested bit for check DFC_MRlyDcSCB" UBYTE DFC_OneToOne 1 100 0.00 1.000 BIT_MASK 0x8 FORMAT "%5.3" ECU_ADDRESS 0x6003700A /end MEASUREMENT
/begin MEASUREMENT DFC_b.TST_MRlyDcSCG "Bit encoding / Tested bit for check DFC_MRlyDcSCG" UBYTE DFC_OneToOne 1 100 0.00 1.000 BIT_MASK 0x8 FORMAT "%5.3" ECU_ADDRESS 0x6003700B /end MEASUREMENT
/begin MEASUREMENT DFC_b.TST_PSPOL "Bit encoding / Tested bit for check DFC_PSPOL" UBYTE DFC_OneToOne 1 100 0.00 1.000 BIT_MASK 0x8 FORMAT "%5.3" ECU_ADDRESS 0x6003700C /end MEASUREMENT
/begin MEASUREMENT DFC_b.TST_PSPOvrTemp "Bit encoding / Tested bit for check DFC_PSPOvrTemp" UBYTE DFC_OneToOne 1 100 0.00 1.000 BIT_MASK 0x8 FORMAT "%5.3" ECU_ADDRESS 0x6003700D /end MEASUREMENT
/begin MEASUREMENT DFC_b.TST_PSPSCB "Bit encoding / Tested bit for check DFC_PSPSCB" UBYTE DFC_OneToOne 1 100 0.00 1.000 BIT_MASK 0x8 FORMAT "%5.3" ECU_ADDRESS 0x6003700E /end MEASUREMENT
/begin MEASUREMENT DFC_b.TST_PSPSCG "Bit encoding / Tested bit for check DFC_PSPSCG" UBYTE DFC_OneToOne 1 100 0.00 1.000 BIT_MASK 0x8 FORMAT "%5.3" ECU_ADDRESS 0x6003700F /end MEASUREMENT
/begin MEASUREMENT DFC_b.TST_T50Err "Bit encoding / Tested bit for check DFC_T50Err" UBYTE DFC_OneToOne 1 100 0.00 1.000 BIT_MASK 0x8 FORMAT "%5.3" ECU_ADDRESS 0x60037010 /end MEASUREMENT
/begin MEASUREMENT DFC_b.TST_ThrVlvLoBattB1 "Bit encoding / Tested bit for check DFC_ThrVlvLoBattB1" UBYTE DFC_OneToOne 1 100 0.00 1.000 BIT_MASK 0x8 FORMAT "%5.3" ECU_ADDRESS 0x60037011 /end MEASUREMENT
/begin MEASUREMENT DFC_b.TST_UegoSigOperPlausS1B1 "Bit encoding / Tested bit for check DFC_UegoSigOperPlausS1B1" UBYTE DFC_OneToOne 1 100 0.00 1.000 BIT_MASK 0x8 FORMAT "%5.3" ECU_ADDRESS 0x60037012 /end MEASUREMENT
/begin MEASUREMENT DFC_b.TST_VehVPhysRngHi "Bit encoding / Tested bit for check DFC_VehVPhysRngHi" UBYTE DFC_OneToOne 1 100 0.00 1.000 BIT_MASK 0x8 FORMAT "%5.3" ECU_ADDRESS 0x60037013 /end MEASUREMENT
/begin MEASUREMENT DFC_b.TST_VehVSclOutOL "Bit encoding / Tested bit for check DFC_VehVSclOutOL" UBYTE DFC_OneToOne 1 100 0.00 1.000 BIT_MASK 0x8 FORMAT "%5.3" ECU_ADDRESS 0x60037014 /end MEASUREMENT
/begin MEASUREMENT DFC_b.TST_VehVSclOutOT "Bit encoding / Tested bit for check DFC_VehVSclOutOT" UBYTE DFC_OneToOne 1 100 0.00 1.000 BIT_MASK 0x8 FORMAT "%5.3" ECU_ADDRESS 0x60037015 /end MEASUREMENT
/begin MEASUREMENT DFC_b.TST_VehVSclOutSCB "Bit encoding / Tested bit for check DFC_VehVSclOutSCB" UBYTE DFC_OneToOne 1 100 0.00 1.000 BIT_MASK 0x8 FORMAT "%5.3" ECU_ADDRESS 0x60037016 /end MEASUREMENT
/begin MEASUREMENT DFC_b.TST_VehVSclOutSCG "Bit encoding / Tested bit for check DFC_VehVSclOutSCG" UBYTE DFC_OneToOne 1 100 0.00 1.000 BIT_MASK 0x8 FORMAT "%5.3" ECU_ADDRESS 0x60037017 /end MEASUREMENT
/begin MEASUREMENT DFC_b.TST_VehVSigFL "Bit encoding / Tested bit for check DFC_VehVSigFL" UBYTE DFC_OneToOne 1 100 0.00 1.000 BIT_MASK 0x8 FORMAT "%5.3" ECU_ADDRESS 0x60037018 /end MEASUREMENT
/begin MEASUREMENT DFC_b.TST_VehVSigFR "Bit encoding / Tested bit for check DFC_VehVSigFR" UBYTE DFC_OneToOne 1 100 0.00 1.000 BIT_MASK 0x8 FORMAT "%5.3" ECU_ADDRESS 0x60037019 /end MEASUREMENT
/begin MEASUREMENT DFC_b.TST_VehVSigRL "Bit encoding / Tested bit for check DFC_VehVSigRL" UBYTE DFC_OneToOne 1 100 0.00 1.000 BIT_MASK 0x8 FORMAT "%5.3" ECU_ADDRESS 0x6003701A /end MEASUREMENT
/begin MEASUREMENT DFC_b.TST_VehVSigRR "Bit encoding / Tested bit for check DFC_VehVSigRR" UBYTE DFC_OneToOne 1 100 0.00 1.000 BIT_MASK 0x8 FORMAT "%5.3" ECU_ADDRESS 0x6003701B /end MEASUREMENT
/begin MEASUREMENT DFC_b.TST_VehVSnsrARngHi "Bit encoding / Tested bit for check DFC_VehVSnsrARngHi" UBYTE DFC_OneToOne 1 100 0.00 1.000 BIT_MASK 0x8 FORMAT "%5.3" ECU_ADDRESS 0x6003701C /end MEASUREMENT
/begin MEASUREMENT DFC_b.TST_VehVSnsrBRngHi "Bit encoding / Tested bit for check DFC_VehVSnsrBRngHi" UBYTE DFC_OneToOne 1 100 0.00 1.000 BIT_MASK 0x8 FORMAT "%5.3" ECU_ADDRESS 0x6003701D /end MEASUREMENT
/begin MEASUREMENT DFC_b.TST_VehVSpdRtyDiag "Bit encoding / Tested bit for check DFC_VehVSpdRtyDiag" UBYTE DFC_OneToOne 1 100 0.00 1.000 BIT_MASK 0x8 FORMAT "%5.3" ECU_ADDRESS 0x6003701E /end MEASUREMENT
/begin MEASUREMENT DFC_b.TST_DHFHD "Bit encoding / Tested bit for check DFC_DHFHD" UBYTE DFC_OneToOne 1 100 0.00 1.000 BIT_MASK 0x8 FORMAT "%5.3" ECU_ADDRESS 0x6003701F /end MEASUREMENT
/begin MEASUREMENT DFC_b.TST_InjVlv_DI_DcDc "Bit encoding / Tested bit for check DFC_InjVlv_DI_DcDc" UBYTE DFC_OneToOne 1 100 0.00 1.000 BIT_MASK 0x8 FORMAT "%5.3" ECU_ADDRESS 0x60037020 /end MEASUREMENT
/begin MEASUREMENT DFC_b.TST_InjVlv_DI_NoLd_0 "Bit encoding / Tested bit for check DFC_InjVlv_DI_NoLd_0" UBYTE DFC_OneToOne 1 100 0.00 1.000 BIT_MASK 0x8 FORMAT "%5.3" ECU_ADDRESS 0x60037021 /end MEASUREMENT
/begin MEASUREMENT DFC_b.TST_InjVlv_DI_NoLd_1 "Bit encoding / Tested bit for check DFC_InjVlv_DI_NoLd_1" UBYTE DFC_OneToOne 1 100 0.00 1.000 BIT_MASK 0x8 FORMAT "%5.3" ECU_ADDRESS 0x60037022 /end MEASUREMENT
/begin MEASUREMENT DFC_b.TST_InjVlv_DI_NoLd_2 "Bit encoding / Tested bit for check DFC_InjVlv_DI_NoLd_2" UBYTE DFC_OneToOne 1 100 0.00 1.000 BIT_MASK 0x8 FORMAT "%5.3" ECU_ADDRESS 0x60037023 /end MEASUREMENT
/begin MEASUREMENT DFC_b.TST_InjVlv_DI_NoLd_3 "Bit encoding / Tested bit for check DFC_InjVlv_DI_NoLd_3" UBYTE DFC_OneToOne 1 100 0.00 1.000 BIT_MASK 0x8 FORMAT "%5.3" ECU_ADDRESS 0x60037024 /end MEASUREMENT
/begin MEASUREMENT DFC_b.TST_InjVlv_DI_ScBnk_0 "Bit encoding / Tested bit for check DFC_InjVlv_DI_ScBnk_0" UBYTE DFC_OneToOne 1 100 0.00 1.000 BIT_MASK 0x8 FORMAT "%5.3" ECU_ADDRESS 0x60037025 /end MEASUREMENT
/begin MEASUREMENT DFC_b.TST_InjVlv_DI_ScBnk_1 "Bit encoding / Tested bit for check DFC_InjVlv_DI_ScBnk_1" UBYTE DFC_OneToOne 1 100 0.00 1.000 BIT_MASK 0x8 FORMAT "%5.3" ECU_ADDRESS 0x60037026 /end MEASUREMENT
/begin MEASUREMENT DFC_b.TST_InjVlv_DI_ScBnk_2 "Bit encoding / Tested bit for check DFC_InjVlv_DI_ScBnk_2" UBYTE DFC_OneToOne 1 100 0.00 1.000 BIT_MASK 0x8 FORMAT "%5.3" ECU_ADDRESS 0x60037027 /end MEASUREMENT
/begin MEASUREMENT DFC_b.TST_InjVlv_DI_ScBnk_3 "Bit encoding / Tested bit for check DFC_InjVlv_DI_ScBnk_3" UBYTE DFC_OneToOne 1 100 0.00 1.000 BIT_MASK 0x8 FORMAT "%5.3" ECU_ADDRESS 0x60037028 /end MEASUREMENT
/begin MEASUREMENT DFC_b.TST_InjVlv_DI_ScCyl_0 "Bit encoding / Tested bit for check DFC_InjVlv_DI_ScCyl_0" UBYTE DFC_OneToOne 1 100 0.00 1.000 BIT_MASK 0x8 FORMAT "%5.3" ECU_ADDRESS 0x60037029 /end MEASUREMENT
/begin MEASUREMENT DFC_b.TST_InjVlv_DI_ScCyl_1 "Bit encoding / Tested bit for check DFC_InjVlv_DI_ScCyl_1" UBYTE DFC_OneToOne 1 100 0.00 1.000 BIT_MASK 0x8 FORMAT "%5.3" ECU_ADDRESS 0x6003702A /end MEASUREMENT
/begin MEASUREMENT DFC_b.TST_InjVlv_DI_ScCyl_2 "Bit encoding / Tested bit for check DFC_InjVlv_DI_ScCyl_2" UBYTE DFC_OneToOne 1 100 0.00 1.000 BIT_MASK 0x8 FORMAT "%5.3" ECU_ADDRESS 0x6003702B /end MEASUREMENT
/begin MEASUREMENT DFC_b.TST_InjVlv_DI_ScCyl_3 "Bit encoding / Tested bit for check DFC_InjVlv_DI_ScCyl_3" UBYTE DFC_OneToOne 1 100 0.00 1.000 BIT_MASK 0x8 FORMAT "%5.3" ECU_ADDRESS 0x6003702C /end MEASUREMENT
/begin MEASUREMENT DFC_b.TST_InjVlv_DI_ScHsLs_0 "Bit encoding / Tested bit for check DFC_InjVlv_DI_ScHsLs_0" UBYTE DFC_OneToOne 1 100 0.00 1.000 BIT_MASK 0x8 FORMAT "%5.3" ECU_ADDRESS 0x6003702D /end MEASUREMENT
/begin MEASUREMENT DFC_b.TST_InjVlv_DI_ScHsLs_1 "Bit encoding / Tested bit for check DFC_InjVlv_DI_ScHsLs_1" UBYTE DFC_OneToOne 1 100 0.00 1.000 BIT_MASK 0x8 FORMAT "%5.3" ECU_ADDRESS 0x6003702E /end MEASUREMENT
/begin MEASUREMENT DFC_b.TST_InjVlv_DI_ScHsLs_2 "Bit encoding / Tested bit for check DFC_InjVlv_DI_ScHsLs_2" UBYTE DFC_OneToOne 1 100 0.00 1.000 BIT_MASK 0x8 FORMAT "%5.3" ECU_ADDRESS 0x6003702F /end MEASUREMENT
/begin MEASUREMENT DFC_b.TST_InjVlv_DI_ScHsLs_3 "Bit encoding / Tested bit for check DFC_InjVlv_DI_ScHsLs_3" UBYTE DFC_OneToOne 1 100 0.00 1.000 BIT_MASK 0x8 FORMAT "%5.3" ECU_ADDRESS 0x60037030 /end MEASUREMENT
/begin MEASUREMENT DFC_b.TST_MfPsDiaOpenLoad1 "Bit encoding / Tested bit for check DFC_MfPsDiaOpenLoad1" UBYTE DFC_OneToOne 1 100 0.00 1.000 BIT_MASK 0x8 FORMAT "%5.3" ECU_ADDRESS 0x60037031 /end MEASUREMENT
/begin MEASUREMENT DFC_b.TST_MfPsDiaScHiS1 "Bit encoding / Tested bit for check DFC_MfPsDiaScHiS1" UBYTE DFC_OneToOne 1 100 0.00 1.000 BIT_MASK 0x8 FORMAT "%5.3" ECU_ADDRESS 0x60037032 /end MEASUREMENT
/begin MEASUREMENT DFC_b.TST_MfPsDiaScHiSLowS1 "Bit encoding / Tested bit for check DFC_MfPsDiaScHiSLowS1" UBYTE DFC_OneToOne 1 100 0.00 1.000 BIT_MASK 0x8 FORMAT "%5.3" ECU_ADDRESS 0x60037033 /end MEASUREMENT
/begin MEASUREMENT DFC_b.TST_MfPsDiaScLowS1 "Bit encoding / Tested bit for check DFC_MfPsDiaScLowS1" UBYTE DFC_OneToOne 1 100 0.00 1.000 BIT_MASK 0x8 FORMAT "%5.3" ECU_ADDRESS 0x60037034 /end MEASUREMENT
/begin MEASUREMENT DFC_b.TST_ACEvpTPhysRngHi "Bit encoding / Tested bit for check DFC_ACEvpTPhysRngHi" UBYTE DFC_OneToOne 1 100 0.00 1.000 BIT_MASK 0x8 FORMAT "%5.3" ECU_ADDRESS 0x60037035 /end MEASUREMENT
/begin MEASUREMENT DFC_b.TST_ACEvpTPhysRngLo "Bit encoding / Tested bit for check DFC_ACEvpTPhysRngLo" UBYTE DFC_OneToOne 1 100 0.00 1.000 BIT_MASK 0x8 FORMAT "%5.3" ECU_ADDRESS 0x60037036 /end MEASUREMENT
/begin MEASUREMENT DFC_b.TST_ACEvpTSRCMax "Bit encoding / Tested bit for check DFC_ACEvpTSRCMax" UBYTE DFC_OneToOne 1 100 0.00 1.000 BIT_MASK 0x8 FORMAT "%5.3" ECU_ADDRESS 0x60037037 /end MEASUREMENT
/begin MEASUREMENT DFC_b.TST_ACEvpTSRCMin "Bit encoding / Tested bit for check DFC_ACEvpTSRCMin" UBYTE DFC_OneToOne 1 100 0.00 1.000 BIT_MASK 0x8 FORMAT "%5.3" ECU_ADDRESS 0x60037038 /end MEASUREMENT
/begin MEASUREMENT DFC_b.TST_AfsRawSigRngHiB1 "Bit encoding / Tested bit for check DFC_AfsRawSigRngHiB1" UBYTE DFC_OneToOne 1 100 0.00 1.000 BIT_MASK 0x8 FORMAT "%5.3" ECU_ADDRESS 0x60037039 /end MEASUREMENT
/begin MEASUREMENT DFC_b.TST_AfsRawSigRngLoB1 "Bit encoding / Tested bit for check DFC_AfsRawSigRngLoB1" UBYTE DFC_OneToOne 1 100 0.00 1.000 BIT_MASK 0x8 FORMAT "%5.3" ECU_ADDRESS 0x6003703A /end MEASUREMENT
/begin MEASUREMENT DFC_b.TST_AfsSnsrErrB1 "Bit encoding / Tested bit for check DFC_AfsSnsrErrB1" UBYTE DFC_OneToOne 1 100 0.00 1.000 BIT_MASK 0x8 FORMAT "%5.3" ECU_ADDRESS 0x6003703B /end MEASUREMENT
/begin MEASUREMENT DFC_b.TST_AirCClntPAnaSRCMax "Bit encoding / Tested bit for check DFC_AirCClntPAnaSRCMax" UBYTE DFC_OneToOne 1 100 0.00 1.000 BIT_MASK 0x8 FORMAT "%5.3" ECU_ADDRESS 0x6003703C /end MEASUREMENT
/begin MEASUREMENT DFC_b.TST_AirCClntPAnaSRCMin "Bit encoding / Tested bit for check DFC_AirCClntPAnaSRCMin" UBYTE DFC_OneToOne 1 100 0.00 1.000 BIT_MASK 0x8 FORMAT "%5.3" ECU_ADDRESS 0x6003703D /end MEASUREMENT
/begin MEASUREMENT DFC_b.TST_AirCSwtNpl "Bit encoding / Tested bit for check DFC_AirCSwtNpl" UBYTE DFC_OneToOne 1 100 0.00 1.000 BIT_MASK 0x8 FORMAT "%5.3" ECU_ADDRESS 0x6003703E /end MEASUREMENT
/begin MEASUREMENT DFC_b.TST_AirCSwtSig "Bit encoding / Tested bit for check DFC_AirCSwtSig" UBYTE DFC_OneToOne 1 100 0.00 1.000 BIT_MASK 0x8 FORMAT "%5.3" ECU_ADDRESS 0x6003703F /end MEASUREMENT
/begin MEASUREMENT DFC_b.TST_Brk "Bit encoding / Tested bit for check DFC_Brk" UBYTE DFC_OneToOne 1 100 0.00 1.000 BIT_MASK 0x8 FORMAT "%5.3" ECU_ADDRESS 0x60037040 /end MEASUREMENT
/begin MEASUREMENT DFC_b.TST_BrkBstSensSCB "Bit encoding / Tested bit for check DFC_BrkBstSensSCB" UBYTE DFC_OneToOne 1 100 0.00 1.000 BIT_MASK 0x8 FORMAT "%5.3" ECU_ADDRESS 0x60037041 /end MEASUREMENT
/begin MEASUREMENT DFC_b.TST_BrkBstSensSCG "Bit encoding / Tested bit for check DFC_BrkBstSensSCG" UBYTE DFC_OneToOne 1 100 0.00 1.000 BIT_MASK 0x8 FORMAT "%5.3" ECU_ADDRESS 0x60037042 /end MEASUREMENT
/begin MEASUREMENT DFC_b.TST_BrkSig "Bit encoding / Tested bit for check DFC_BrkSig" UBYTE DFC_OneToOne 1 100 0.00 1.000 BIT_MASK 0x8 FORMAT "%5.3" ECU_ADDRESS 0x60037043 /end MEASUREMENT
/begin MEASUREMENT DFC_b.TST_ClthSig "Bit encoding / Tested bit for check DFC_ClthSig" UBYTE DFC_OneToOne 1 100 0.00 1.000 BIT_MASK 0x8 FORMAT "%5.3" ECU_ADDRESS 0x60037044 /end MEASUREMENT
/begin MEASUREMENT DFC_b.TST_EGRVlvCurrLim "Bit encoding / Tested bit for check DFC_EGRVlvCurrLim" UBYTE DFC_OneToOne 1 100 0.00 1.000 BIT_MASK 0x8 FORMAT "%5.3" ECU_ADDRESS 0x60037045 /end MEASUREMENT
/begin MEASUREMENT DFC_b.TST_EGRVlvOL "Bit encoding / Tested bit for check DFC_EGRVlvOL" UBYTE DFC_OneToOne 1 100 0.00 1.000 BIT_MASK 0x8 FORMAT "%5.3" ECU_ADDRESS 0x60037046 /end MEASUREMENT
/begin MEASUREMENT DFC_b.TST_EGRVlvOvrTemp "Bit encoding / Tested bit for check DFC_EGRVlvOvrTemp" UBYTE DFC_OneToOne 1 100 0.00 1.000 BIT_MASK 0x8 FORMAT "%5.3" ECU_ADDRESS 0x60037047 /end MEASUREMENT
/begin MEASUREMENT DFC_b.TST_EGRVlvSCB "Bit encoding / Tested bit for check DFC_EGRVlvSCB" UBYTE DFC_OneToOne 1 100 0.00 1.000 BIT_MASK 0x8 FORMAT "%5.3" ECU_ADDRESS 0x60037048 /end MEASUREMENT
/begin MEASUREMENT DFC_b.TST_EGRVlvSCG "Bit encoding / Tested bit for check DFC_EGRVlvSCG" UBYTE DFC_OneToOne 1 100 0.00 1.000 BIT_MASK 0x8 FORMAT "%5.3" ECU_ADDRESS 0x60037049 /end MEASUREMENT
/begin MEASUREMENT DFC_b.TST_EGRVlvSRCMax "Bit encoding / Tested bit for check DFC_EGRVlvSRCMax" UBYTE DFC_OneToOne 1 100 0.00 1.000 BIT_MASK 0x8 FORMAT "%5.3" ECU_ADDRESS 0x6003704A /end MEASUREMENT
/begin MEASUREMENT DFC_b.TST_EGRVlvSRCMin "Bit encoding / Tested bit for check DFC_EGRVlvSRCMin" UBYTE DFC_OneToOne 1 100 0.00 1.000 BIT_MASK 0x8 FORMAT "%5.3" ECU_ADDRESS 0x6003704B /end MEASUREMENT
/begin MEASUREMENT DFC_b.TST_HLSDemOvhtEngLim "Bit encoding / Tested bit for check DFC_HLSDemOvhtEngLim" UBYTE DFC_OneToOne 1 100 0.00 1.000 BIT_MASK 0x8 FORMAT "%5.3" ECU_ADDRESS 0x6003704C /end MEASUREMENT
/begin MEASUREMENT DFC_b.TST_OilPSwmpSRCMax "Bit encoding / Tested bit for check DFC_OilPSwmpSRCMax" UBYTE DFC_OneToOne 1 100 0.00 1.000 BIT_MASK 0x8 FORMAT "%5.3" ECU_ADDRESS 0x6003704D /end MEASUREMENT
/begin MEASUREMENT DFC_b.TST_OilPSwmpSRCMin "Bit encoding / Tested bit for check DFC_OilPSwmpSRCMin" UBYTE DFC_OneToOne 1 100 0.00 1.000 BIT_MASK 0x8 FORMAT "%5.3" ECU_ADDRESS 0x6003704E /end MEASUREMENT
/begin MEASUREMENT DFC_b.TST_PIntkVUsLineHiB1 "Bit encoding / Tested bit for check DFC_PIntkVUsLineHiB1" UBYTE DFC_OneToOne 1 100 0.00 1.000 BIT_MASK 0x8 FORMAT "%5.3" ECU_ADDRESS 0x6003704F /end MEASUREMENT
/begin MEASUREMENT DFC_b.TST_PIntkVUsLineLoB1 "Bit encoding / Tested bit for check DFC_PIntkVUsLineLoB1" UBYTE DFC_OneToOne 1 100 0.00 1.000 BIT_MASK 0x8 FORMAT "%5.3" ECU_ADDRESS 0x60037050 /end MEASUREMENT
/begin MEASUREMENT DFC_b.TST_VehVPhysRngLo "Bit encoding / Tested bit for check DFC_VehVPhysRngLo" UBYTE DFC_OneToOne 1 100 0.00 1.000 BIT_MASK 0x8 FORMAT "%5.3" ECU_ADDRESS 0x60037051 /end MEASUREMENT
/begin MEASUREMENT DFC_b.TST_VehVSigCan "Bit encoding / Tested bit for check DFC_VehVSigCan" UBYTE DFC_OneToOne 1 100 0.00 1.000 BIT_MASK 0x8 FORMAT "%5.3" ECU_ADDRESS 0x60037052 /end MEASUREMENT
/begin MEASUREMENT DFC_b.TST_VehVSigCanSafe "Bit encoding / Tested bit for check DFC_VehVSigCanSafe" UBYTE DFC_OneToOne 1 100 0.00 1.000 BIT_MASK 0x8 FORMAT "%5.3" ECU_ADDRESS 0x60037053 /end MEASUREMENT
/begin MEASUREMENT DFC_b.TST_VlvLftFbOilPSnsrIntk11SRCMax "Bit encoding / Tested bit for check DFC_VlvLftFbOilPSnsrIntk11SRCMax" UBYTE DFC_OneToOne 1 100 0.00 1.000 BIT_MASK 0x8 FORMAT "%5.3" ECU_ADDRESS 0x60037054 /end MEASUREMENT
/begin MEASUREMENT DFC_b.TST_VlvLftFbOilPSnsrIntk11SRCMin "Bit encoding / Tested bit for check DFC_VlvLftFbOilPSnsrIntk11SRCMin" UBYTE DFC_OneToOne 1 100 0.00 1.000 BIT_MASK 0x8 FORMAT "%5.3" ECU_ADDRESS 0x60037055 /end MEASUREMENT
/begin MEASUREMENT DFC_b.TST_ClthNpl "Bit encoding / Tested bit for check DFC_ClthNpl" UBYTE DFC_OneToOne 1 100 0.00 1.000 BIT_MASK 0x8 FORMAT "%5.3" ECU_ADDRESS 0x60037056 /end MEASUREMENT
/begin MEASUREMENT DFC_b.TST_GbxPNPosnDrvCdn "Bit encoding / Tested bit for check DFC_GbxPNPosnDrvCdn" UBYTE DFC_OneToOne 1 100 0.00 1.000 BIT_MASK 0x8 FORMAT "%5.3" ECU_ADDRESS 0x60037057 /end MEASUREMENT
/begin MEASUREMENT DFC_b.TST_GbxPNPosnPlausy "Bit encoding / Tested bit for check DFC_GbxPNPosnPlausy" UBYTE DFC_OneToOne 1 100 0.00 1.000 BIT_MASK 0x8 FORMAT "%5.3" ECU_ADDRESS 0x60037058 /end MEASUREMENT
/begin MEASUREMENT DFC_b.TST_AfsSigErrLineHiB1 "Bit encoding / Tested bit for check DFC_AfsSigErrLineHiB1" UBYTE DFC_OneToOne 1 100 0.00 1.000 BIT_MASK 0x8 FORMAT "%5.3" ECU_ADDRESS 0x60037059 /end MEASUREMENT
/begin MEASUREMENT DFC_b.TST_AfsSigErrLineLoB1 "Bit encoding / Tested bit for check DFC_AfsSigErrLineLoB1" UBYTE DFC_OneToOne 1 100 0.00 1.000 BIT_MASK 0x8 FORMAT "%5.3" ECU_ADDRESS 0x6003705A /end MEASUREMENT
/begin MEASUREMENT DFC_b.TST_PEnvCcMax "Bit encoding / Tested bit for check DFC_PEnvCcMax" UBYTE DFC_OneToOne 1 100 0.00 1.000 BIT_MASK 0x8 FORMAT "%5.3" ECU_ADDRESS 0x6003705B /end MEASUREMENT
/begin MEASUREMENT DFC_b.TST_PEnvCcMin "Bit encoding / Tested bit for check DFC_PEnvCcMin" UBYTE DFC_OneToOne 1 100 0.00 1.000 BIT_MASK 0x8 FORMAT "%5.3" ECU_ADDRESS 0x6003705C /end MEASUREMENT
/begin MEASUREMENT DFC_b.TST_PEnvRngChkMax "Bit encoding / Tested bit for check DFC_PEnvRngChkMax" UBYTE DFC_OneToOne 1 100 0.00 1.000 BIT_MASK 0x8 FORMAT "%5.3" ECU_ADDRESS 0x6003705D /end MEASUREMENT
/begin MEASUREMENT DFC_b.TST_PEnvRngChkMin "Bit encoding / Tested bit for check DFC_PEnvRngChkMin" UBYTE DFC_OneToOne 1 100 0.00 1.000 BIT_MASK 0x8 FORMAT "%5.3" ECU_ADDRESS 0x6003705E /end MEASUREMENT
/begin MEASUREMENT DFC_b.TST_PEnvSnsrPlaus "Bit encoding / Tested bit for check DFC_PEnvSnsrPlaus" UBYTE DFC_OneToOne 1 100 0.00 1.000 BIT_MASK 0x8 FORMAT "%5.3" ECU_ADDRESS 0x6003705F /end MEASUREMENT
/begin MEASUREMENT DFC_b.TST_UEGOHeatrRlyPsOLS1B1 "Bit encoding / Tested bit for check DFC_UEGOHeatrRlyPsOLS1B1" UBYTE DFC_OneToOne 1 100 0.00 1.000 BIT_MASK 0x8 FORMAT "%5.3" ECU_ADDRESS 0x60037060 /end MEASUREMENT
/begin MEASUREMENT DFC_b.TST_UEGOHeatrRlyPsSCBS1B1 "Bit encoding / Tested bit for check DFC_UEGOHeatrRlyPsSCBS1B1" UBYTE DFC_OneToOne 1 100 0.00 1.000 BIT_MASK 0x8 FORMAT "%5.3" ECU_ADDRESS 0x60037061 /end MEASUREMENT
/begin MEASUREMENT DFC_b.TST_UEGOHeatrRlyPsSCGS1B1 "Bit encoding / Tested bit for check DFC_UEGOHeatrRlyPsSCGS1B1" UBYTE DFC_OneToOne 1 100 0.00 1.000 BIT_MASK 0x8 FORMAT "%5.3" ECU_ADDRESS 0x60037062 /end MEASUREMENT
/begin MEASUREMENT DFC_b.TST_UegoHeatrWireOlS1B1 "Bit encoding / Tested bit for check DFC_UegoHeatrWireOlS1B1" UBYTE DFC_OneToOne 1 100 0.00 1.000 BIT_MASK 0x8 FORMAT "%5.3" ECU_ADDRESS 0x60037063 /end MEASUREMENT
/begin MEASUREMENT DFC_b.TST_UegoHeatrWireScbS1B1 "Bit encoding / Tested bit for check DFC_UegoHeatrWireScbS1B1" UBYTE DFC_OneToOne 1 100 0.00 1.000 BIT_MASK 0x8 FORMAT "%5.3" ECU_ADDRESS 0x60037064 /end MEASUREMENT
/begin MEASUREMENT DFC_b.TST_UegoHeatrWireScgS1B1 "Bit encoding / Tested bit for check DFC_UegoHeatrWireScgS1B1" UBYTE DFC_OneToOne 1 100 0.00 1.000 BIT_MASK 0x8 FORMAT "%5.3" ECU_ADDRESS 0x60037065 /end MEASUREMENT
/begin MEASUREMENT DFC_b.TST_KnDetSens1PortAMax "Bit encoding / Tested bit for check DFC_KnDetSens1PortAMax" UBYTE DFC_OneToOne 1 100 0.00 1.000 BIT_MASK 0x8 FORMAT "%5.3" ECU_ADDRESS 0x60037066 /end MEASUREMENT
/begin MEASUREMENT DFC_b.TST_KnDetSens1PortAMin "Bit encoding / Tested bit for check DFC_KnDetSens1PortAMin" UBYTE DFC_OneToOne 1 100 0.00 1.000 BIT_MASK 0x8 FORMAT "%5.3" ECU_ADDRESS 0x60037067 /end MEASUREMENT
/begin MEASUREMENT DFC_b.TST_KnDetSens1PortBMax "Bit encoding / Tested bit for check DFC_KnDetSens1PortBMax" UBYTE DFC_OneToOne 1 100 0.00 1.000 BIT_MASK 0x8 FORMAT "%5.3" ECU_ADDRESS 0x60037068 /end MEASUREMENT
/begin MEASUREMENT DFC_b.TST_KnDetSens1PortBMin "Bit encoding / Tested bit for check DFC_KnDetSens1PortBMin" UBYTE DFC_OneToOne 1 100 0.00 1.000 BIT_MASK 0x8 FORMAT "%5.3" ECU_ADDRESS 0x60037069 /end MEASUREMENT
/begin MEASUREMENT DFC_b.TST_Clth2ONStuck "Bit encoding / Tested bit for check DFC_Clth2ONStuck" UBYTE DFC_OneToOne 1 100 0.00 1.000 BIT_MASK 0x8 FORMAT "%5.3" ECU_ADDRESS 0x6003706A /end MEASUREMENT
/begin MEASUREMENT DFC_b.TST_Clth2ONStuckLdc "Bit encoding / Tested bit for check DFC_Clth2ONStuckLdc" UBYTE DFC_OneToOne 1 100 0.00 1.000 BIT_MASK 0x8 FORMAT "%5.3" ECU_ADDRESS 0x6003706B /end MEASUREMENT
/begin MEASUREMENT DFC_b.TST_Clth3ONStuckLdc "Bit encoding / Tested bit for check DFC_Clth3ONStuckLdc" UBYTE DFC_OneToOne 1 100 0.00 1.000 BIT_MASK 0x8 FORMAT "%5.3" ECU_ADDRESS 0x6003706C /end MEASUREMENT
/begin MEASUREMENT DFC_b.TST_Clth3ONStuckPostDrv "Bit encoding / Tested bit for check DFC_Clth3ONStuckPostDrv" UBYTE DFC_OneToOne 1 100 0.00 1.000 BIT_MASK 0x8 FORMAT "%5.3" ECU_ADDRESS 0x6003706D /end MEASUREMENT
/begin MEASUREMENT DFC_b.TST_Clth4ONStuck "Bit encoding / Tested bit for check DFC_Clth4ONStuck" UBYTE DFC_OneToOne 1 100 0.00 1.000 BIT_MASK 0x8 FORMAT "%5.3" ECU_ADDRESS 0x6003706E /end MEASUREMENT
/begin MEASUREMENT DFC_b.TST_Clth4ONStuckLdc "Bit encoding / Tested bit for check DFC_Clth4ONStuckLdc" UBYTE DFC_OneToOne 1 100 0.00 1.000 BIT_MASK 0x8 FORMAT "%5.3" ECU_ADDRESS 0x6003706F /end MEASUREMENT
/begin MEASUREMENT DFC_b.TST_ComBCMUnit "Bit encoding / Tested bit for check DFC_ComBCMUnit" UBYTE DFC_OneToOne 1 100 0.00 1.000 BIT_MASK 0x8 FORMAT "%5.3" ECU_ADDRESS 0x60037070 /end MEASUREMENT
/begin MEASUREMENT DFC_b.TST_ComDLCTCU01 "Bit encoding / Tested bit for check DFC_ComDLCTCU01" UBYTE DFC_OneToOne 1 100 0.00 1.000 BIT_MASK 0x8 FORMAT "%5.3" ECU_ADDRESS 0x60037071 /end MEASUREMENT
/begin MEASUREMENT DFC_b.TST_ComDLCTCU02 "Bit encoding / Tested bit for check DFC_ComDLCTCU02" UBYTE DFC_OneToOne 1 100 0.00 1.000 BIT_MASK 0x8 FORMAT "%5.3" ECU_ADDRESS 0x60037072 /end MEASUREMENT
/begin MEASUREMENT DFC_b.TST_ComDLCTCU1 "Bit encoding / Tested bit for check DFC_ComDLCTCU1" UBYTE DFC_OneToOne 1 100 0.00 1.000 BIT_MASK 0x8 FORMAT "%5.3" ECU_ADDRESS 0x60037073 /end MEASUREMENT
/begin MEASUREMENT DFC_b.TST_ComDLCTCU11 "Bit encoding / Tested bit for check DFC_ComDLCTCU11" UBYTE DFC_OneToOne 1 100 0.00 1.000 BIT_MASK 0x8 FORMAT "%5.3" ECU_ADDRESS 0x60037074 /end MEASUREMENT
/begin MEASUREMENT DFC_b.TST_ComDLCTCU12 "Bit encoding / Tested bit for check DFC_ComDLCTCU12" UBYTE DFC_OneToOne 1 100 0.00 1.000 BIT_MASK 0x8 FORMAT "%5.3" ECU_ADDRESS 0x60037075 /end MEASUREMENT
/begin MEASUREMENT DFC_b.TST_ComDLCTCU13 "Bit encoding / Tested bit for check DFC_ComDLCTCU13" UBYTE DFC_OneToOne 1 100 0.00 1.000 BIT_MASK 0x8 FORMAT "%5.3" ECU_ADDRESS 0x60037076 /end MEASUREMENT
/begin MEASUREMENT DFC_b.TST_ComDLCTCU14 "Bit encoding / Tested bit for check DFC_ComDLCTCU14" UBYTE DFC_OneToOne 1 100 0.00 1.000 BIT_MASK 0x8 FORMAT "%5.3" ECU_ADDRESS 0x60037077 /end MEASUREMENT
/begin MEASUREMENT DFC_b.TST_ComDLCTCU2 "Bit encoding / Tested bit for check DFC_ComDLCTCU2" UBYTE DFC_OneToOne 1 100 0.00 1.000 BIT_MASK 0x8 FORMAT "%5.3" ECU_ADDRESS 0x60037078 /end MEASUREMENT
/begin MEASUREMENT DFC_b.TST_ComDLCTCU3 "Bit encoding / Tested bit for check DFC_ComDLCTCU3" UBYTE DFC_OneToOne 1 100 0.00 1.000 BIT_MASK 0x8 FORMAT "%5.3" ECU_ADDRESS 0x60037079 /end MEASUREMENT
/begin MEASUREMENT DFC_b.TST_ComDLCTCU4 "Bit encoding / Tested bit for check DFC_ComDLCTCU4" UBYTE DFC_OneToOne 1 100 0.00 1.000 BIT_MASK 0x8 FORMAT "%5.3" ECU_ADDRESS 0x6003707A /end MEASUREMENT
/begin MEASUREMENT DFC_b.TST_ComEPSUnit "Bit encoding / Tested bit for check DFC_ComEPSUnit" UBYTE DFC_OneToOne 1 100 0.00 1.000 BIT_MASK 0x8 FORMAT "%5.3" ECU_ADDRESS 0x6003707B /end MEASUREMENT
/begin MEASUREMENT DFC_b.TST_ComIDASBUnit "Bit encoding / Tested bit for check DFC_ComIDASBUnit" UBYTE DFC_OneToOne 1 100 0.00 1.000 BIT_MASK 0x8 FORMAT "%5.3" ECU_ADDRESS 0x6003707C /end MEASUREMENT
/begin MEASUREMENT DFC_b.TST_ComIMGUnit "Bit encoding / Tested bit for check DFC_ComIMGUnit" UBYTE DFC_OneToOne 1 100 0.00 1.000 BIT_MASK 0x8 FORMAT "%5.3" ECU_ADDRESS 0x6003707D /end MEASUREMENT
/begin MEASUREMENT DFC_b.TST_ComMETUnit "Bit encoding / Tested bit for check DFC_ComMETUnit" UBYTE DFC_OneToOne 1 100 0.00 1.000 BIT_MASK 0x8 FORMAT "%5.3" ECU_ADDRESS 0x6003707E /end MEASUREMENT
/begin MEASUREMENT DFC_b.TST_ComSRSUnit "Bit encoding / Tested bit for check DFC_ComSRSUnit" UBYTE DFC_OneToOne 1 100 0.00 1.000 BIT_MASK 0x8 FORMAT "%5.3" ECU_ADDRESS 0x6003707F /end MEASUREMENT
/begin MEASUREMENT DFC_b.TST_ComVSAUnit "Bit encoding / Tested bit for check DFC_ComVSAUnit" UBYTE DFC_OneToOne 1 100 0.00 1.000 BIT_MASK 0x8 FORMAT "%5.3" ECU_ADDRESS 0x60037080 /end MEASUREMENT
/begin MEASUREMENT DFC_b.TST_EbsSocFlt "Bit encoding / Tested bit for check DFC_EbsSocFlt" UBYTE DFC_OneToOne 1 100 0.00 1.000 BIT_MASK 0x8 FORMAT "%5.3" ECU_ADDRESS 0x60037081 /end MEASUREMENT
/begin MEASUREMENT DFC_b.TST_I14229VINErr "Bit encoding / Tested bit for check DFC_I14229VINErr" UBYTE DFC_OneToOne 1 100 0.00 1.000 BIT_MASK 0x8 FORMAT "%5.3" ECU_ADDRESS 0x60037082 /end MEASUREMENT
/begin MEASUREMENT DFC_b.TST_InjCatHeatgErr "Bit encoding / Tested bit for check DFC_InjCatHeatgErr" UBYTE DFC_OneToOne 1 100 0.00 1.000 BIT_MASK 0x8 FORMAT "%5.3" ECU_ADDRESS 0x60037083 /end MEASUREMENT
/begin MEASUREMENT DFC_b.TST_InjSysMulInjDiagErr "Bit encoding / Tested bit for check DFC_InjSysMulInjDiagErr" UBYTE DFC_OneToOne 1 100 0.00 1.000 BIT_MASK 0x8 FORMAT "%5.3" ECU_ADDRESS 0x60037084 /end MEASUREMENT
/begin MEASUREMENT DFC_b.TST_LLRHmax "Bit encoding / Tested bit for check DFC_LLRHmax" UBYTE DFC_OneToOne 1 100 0.00 1.000 BIT_MASK 0x8 FORMAT "%5.3" ECU_ADDRESS 0x60037085 /end MEASUREMENT
/begin MEASUREMENT DFC_b.TST_LLRHmin "Bit encoding / Tested bit for check DFC_LLRHmin" UBYTE DFC_OneToOne 1 100 0.00 1.000 BIT_MASK 0x8 FORMAT "%5.3" ECU_ADDRESS 0x60037086 /end MEASUREMENT
/begin MEASUREMENT DFC_b.TST_LLRHnpl "Bit encoding / Tested bit for check DFC_LLRHnpl" UBYTE DFC_OneToOne 1 100 0.00 1.000 BIT_MASK 0x8 FORMAT "%5.3" ECU_ADDRESS 0x60037087 /end MEASUREMENT
/begin MEASUREMENT DFC_b.TST_LLRKHmax "Bit encoding / Tested bit for check DFC_LLRKHmax" UBYTE DFC_OneToOne 1 100 0.00 1.000 BIT_MASK 0x8 FORMAT "%5.3" ECU_ADDRESS 0x60037088 /end MEASUREMENT
/begin MEASUREMENT DFC_b.TST_LLRKHmin "Bit encoding / Tested bit for check DFC_LLRKHmin" UBYTE DFC_OneToOne 1 100 0.00 1.000 BIT_MASK 0x8 FORMAT "%5.3" ECU_ADDRESS 0x60037089 /end MEASUREMENT
/begin MEASUREMENT DFC_b.TST_LLRKHnpl "Bit encoding / Tested bit for check DFC_LLRKHnpl" UBYTE DFC_OneToOne 1 100 0.00 1.000 BIT_MASK 0x8 FORMAT "%5.3" ECU_ADDRESS 0x6003708A /end MEASUREMENT
/begin MEASUREMENT DFC_b.TST_LinACGUnit "Bit encoding / Tested bit for check DFC_LinACGUnit" UBYTE DFC_OneToOne 1 100 0.00 1.000 BIT_MASK 0x8 FORMAT "%5.3" ECU_ADDRESS 0x6003708B /end MEASUREMENT
/begin MEASUREMENT DFC_b.TST_LinAEVUnit "Bit encoding / Tested bit for check DFC_LinAEVUnit" UBYTE DFC_OneToOne 1 100 0.00 1.000 BIT_MASK 0x8 FORMAT "%5.3" ECU_ADDRESS 0x6003708C /end MEASUREMENT
/begin MEASUREMENT DFC_b.TST_LinEBSUnit "Bit encoding / Tested bit for check DFC_LinEBSUnit" UBYTE DFC_OneToOne 1 100 0.00 1.000 BIT_MASK 0x8 FORMAT "%5.3" ECU_ADDRESS 0x6003708D /end MEASUREMENT
/begin MEASUREMENT DFC_b.TST_RoughRoad "Bit encoding / Tested bit for check DFC_RoughRoad" UBYTE DFC_OneToOne 1 100 0.00 1.000 BIT_MASK 0x8 FORMAT "%5.3" ECU_ADDRESS 0x6003708E /end MEASUREMENT
/begin MEASUREMENT DFC_b.TST_SiaEEPRdErr "Bit encoding / Tested bit for check DFC_SiaEEPRdErr" UBYTE DFC_OneToOne 1 100 0.00 1.000 BIT_MASK 0x8 FORMAT "%5.3" ECU_ADDRESS 0x6003708F /end MEASUREMENT
/begin MEASUREMENT DFC_b.TST_SiaEEPWrngCod "Bit encoding / Tested bit for check DFC_SiaEEPWrngCod" UBYTE DFC_OneToOne 1 100 0.00 1.000 BIT_MASK 0x8 FORMAT "%5.3" ECU_ADDRESS 0x60037090 /end MEASUREMENT
/begin MEASUREMENT DFC_b.TST_UegoHeatrStrtS1B1 "Bit encoding / Tested bit for check DFC_UegoHeatrStrtS1B1" UBYTE DFC_OneToOne 1 100 0.00 1.000 BIT_MASK 0x8 FORMAT "%5.3" ECU_ADDRESS 0x60037091 /end MEASUREMENT
/begin MEASUREMENT DFC_b.TST_BusDiagCANAPPLBusOff "Bit encoding / Tested bit for check DFC_BusDiagCANAPPLBusOff" UBYTE DFC_OneToOne 1 100 0.00 1.000 BIT_MASK 0x8 FORMAT "%5.3" ECU_ADDRESS 0x60037092 /end MEASUREMENT
/begin MEASUREMENT DFC_b.TST_BusDiagCANCANCBusOff "Bit encoding / Tested bit for check DFC_BusDiagCANCANCBusOff" UBYTE DFC_OneToOne 1 100 0.00 1.000 BIT_MASK 0x8 FORMAT "%5.3" ECU_ADDRESS 0x60037093 /end MEASUREMENT
/begin MEASUREMENT DFC_b.TST_BusDiagCANVEHICLEBusOff "Bit encoding / Tested bit for check DFC_BusDiagCANVEHICLEBusOff" UBYTE DFC_OneToOne 1 100 0.00 1.000 BIT_MASK 0x8 FORMAT "%5.3" ECU_ADDRESS 0x60037094 /end MEASUREMENT
/begin MEASUREMENT DFC_b.TST_RBA_IODIAGPWR_rba_IoExtCy329_SignalVltSply_0 "Bit encoding / Tested bit for check DFC_RBA_IODIAGPWR_rba_IoExtCy329_SignalVltSply_0" UBYTE DFC_OneToOne 1 100 0.00 1.000 BIT_MASK 0x8 FORMAT "%5.3" ECU_ADDRESS 0x60037095 /end MEASUREMENT
/begin MEASUREMENT DFC_b.TST_RBA_IODIAGPWR_rba_IoExtCy329_SignalVltSply_0OT "Bit encoding / Tested bit for check DFC_RBA_IODIAGPWR_rba_IoExtCy329_SignalVltSply_0OT" UBYTE DFC_OneToOne 1 100 0.00 1.000 BIT_MASK 0x8 FORMAT "%5.3" ECU_ADDRESS 0x60037096 /end MEASUREMENT
/begin MEASUREMENT DFC_b.TST_RBA_IODIAGPWR_rba_IoExtCy329_SignalVltSply_0OV "Bit encoding / Tested bit for check DFC_RBA_IODIAGPWR_rba_IoExtCy329_SignalVltSply_0OV" UBYTE DFC_OneToOne 1 100 0.00 1.000 BIT_MASK 0x8 FORMAT "%5.3" ECU_ADDRESS 0x60037097 /end MEASUREMENT
/begin MEASUREMENT DFC_b.TST_RBA_IODIAGPWR_rba_IoExtCy329_SignalVltSply_0SCG "Bit encoding / Tested bit for check DFC_RBA_IODIAGPWR_rba_IoExtCy329_SignalVltSply_0SCG" UBYTE DFC_OneToOne 1 100 0.00 1.000 BIT_MASK 0x8 FORMAT "%5.3" ECU_ADDRESS 0x60037098 /end MEASUREMENT
/begin MEASUREMENT DFC_b.TST_RBA_IODIAGPWR_rba_IoExtCy329_SignalVltSply_0UV "Bit encoding / Tested bit for check DFC_RBA_IODIAGPWR_rba_IoExtCy329_SignalVltSply_0UV" UBYTE DFC_OneToOne 1 100 0.00 1.000 BIT_MASK 0x8 FORMAT "%5.3" ECU_ADDRESS 0x60037099 /end MEASUREMENT
/begin MEASUREMENT DFC_b.TST_RBA_IODIAGPWR_rba_IoExtCy329_SignalVltSply_1 "Bit encoding / Tested bit for check DFC_RBA_IODIAGPWR_rba_IoExtCy329_SignalVltSply_1" UBYTE DFC_OneToOne 1 100 0.00 1.000 BIT_MASK 0x8 FORMAT "%5.3" ECU_ADDRESS 0x6003709A /end MEASUREMENT
/begin MEASUREMENT DFC_b.TST_RBA_IODIAGPWR_rba_IoExtCy329_SignalVltSply_1OT "Bit encoding / Tested bit for check DFC_RBA_IODIAGPWR_rba_IoExtCy329_SignalVltSply_1OT" UBYTE DFC_OneToOne 1 100 0.00 1.000 BIT_MASK 0x8 FORMAT "%5.3" ECU_ADDRESS 0x6003709B /end MEASUREMENT
/begin MEASUREMENT DFC_b.TST_RBA_IODIAGPWR_rba_IoExtCy329_SignalVltSply_1OV "Bit encoding / Tested bit for check DFC_RBA_IODIAGPWR_rba_IoExtCy329_SignalVltSply_1OV" UBYTE DFC_OneToOne 1 100 0.00 1.000 BIT_MASK 0x8 FORMAT "%5.3" ECU_ADDRESS 0x6003709C /end MEASUREMENT
/begin MEASUREMENT DFC_b.TST_RBA_IODIAGPWR_rba_IoExtCy329_SignalVltSply_1SCG "Bit encoding / Tested bit for check DFC_RBA_IODIAGPWR_rba_IoExtCy329_SignalVltSply_1SCG" UBYTE DFC_OneToOne 1 100 0.00 1.000 BIT_MASK 0x8 FORMAT "%5.3" ECU_ADDRESS 0x6003709D /end MEASUREMENT
/begin MEASUREMENT DFC_b.TST_RBA_IODIAGPWR_rba_IoExtCy329_SignalVltSply_1UV "Bit encoding / Tested bit for check DFC_RBA_IODIAGPWR_rba_IoExtCy329_SignalVltSply_1UV" UBYTE DFC_OneToOne 1 100 0.00 1.000 BIT_MASK 0x8 FORMAT "%5.3" ECU_ADDRESS 0x6003709E /end MEASUREMENT
/begin MEASUREMENT DFC_b.TST_RBA_IODIAGPWR_rba_IoExtCy329_SignalVltSply_2 "Bit encoding / Tested bit for check DFC_RBA_IODIAGPWR_rba_IoExtCy329_SignalVltSply_2" UBYTE DFC_OneToOne 1 100 0.00 1.000 BIT_MASK 0x8 FORMAT "%5.3" ECU_ADDRESS 0x6003709F /end MEASUREMENT
/begin MEASUREMENT DFC_b.TST_RBA_IODIAGPWR_rba_IoExtCy329_SignalVltSply_2OT "Bit encoding / Tested bit for check DFC_RBA_IODIAGPWR_rba_IoExtCy329_SignalVltSply_2OT" UBYTE DFC_OneToOne 1 100 0.00 1.000 BIT_MASK 0x8 FORMAT "%5.3" ECU_ADDRESS 0x600370A0 /end MEASUREMENT
/begin MEASUREMENT DFC_b.TST_RBA_IODIAGPWR_rba_IoExtCy329_SignalVltSply_2OV "Bit encoding / Tested bit for check DFC_RBA_IODIAGPWR_rba_IoExtCy329_SignalVltSply_2OV" UBYTE DFC_OneToOne 1 100 0.00 1.000 BIT_MASK 0x8 FORMAT "%5.3" ECU_ADDRESS 0x600370A1 /end MEASUREMENT
/begin MEASUREMENT DFC_b.TST_RBA_IODIAGPWR_rba_IoExtCy329_SignalVltSply_2SCG "Bit encoding / Tested bit for check DFC_RBA_IODIAGPWR_rba_IoExtCy329_SignalVltSply_2SCG" UBYTE DFC_OneToOne 1 100 0.00 1.000 BIT_MASK 0x8 FORMAT "%5.3" ECU_ADDRESS 0x600370A2 /end MEASUREMENT
/begin MEASUREMENT DFC_b.TST_RBA_IODIAGPWR_rba_IoExtCy329_SignalVltSply_2UV "Bit encoding / Tested bit for check DFC_RBA_IODIAGPWR_rba_IoExtCy329_SignalVltSply_2UV" UBYTE DFC_OneToOne 1 100 0.00 1.000 BIT_MASK 0x8 FORMAT "%5.3" ECU_ADDRESS 0x600370A3 /end MEASUREMENT
/begin MEASUREMENT DFC_b.TST_CAN_E_TIMEOUT "Bit encoding / Tested bit for check DFC_CAN_E_TIMEOUT" UBYTE DFC_OneToOne 1 100 0.00 1.000 BIT_MASK 0x8 FORMAT "%5.3" ECU_ADDRESS 0x600370A4 /end MEASUREMENT
/begin MEASUREMENT DFC_b.TST_LIN_E_TIMEOUT "Bit encoding / Tested bit for check DFC_LIN_E_TIMEOUT" UBYTE DFC_OneToOne 1 100 0.00 1.000 BIT_MASK 0x8 FORMAT "%5.3" ECU_ADDRESS 0x600370A5 /end MEASUREMENT
/begin MEASUREMENT DFC_b.TST_MRlyOL "Bit encoding / Tested bit for check DFC_MRlyOL" UBYTE DFC_OneToOne 1 100 0.00 1.000 BIT_MASK 0x8 FORMAT "%5.3" ECU_ADDRESS 0x600370A6 /end MEASUREMENT
/begin MEASUREMENT DFC_b.TST_MRlySCB "Bit encoding / Tested bit for check DFC_MRlySCB" UBYTE DFC_OneToOne 1 100 0.00 1.000 BIT_MASK 0x8 FORMAT "%5.3" ECU_ADDRESS 0x600370A7 /end MEASUREMENT
/begin MEASUREMENT DFC_b.TST_MRlySCG "Bit encoding / Tested bit for check DFC_MRlySCG" UBYTE DFC_OneToOne 1 100 0.00 1.000 BIT_MASK 0x8 FORMAT "%5.3" ECU_ADDRESS 0x600370A8 /end MEASUREMENT
/begin MEASUREMENT DFC_b.TST_rba_MultiStackTrace_Threshold "Bit encoding / Tested bit for check DFC_rba_MultiStackTrace_Threshold" UBYTE DFC_OneToOne 1 100 0.00 1.000 BIT_MASK 0x8 FORMAT "%5.3" ECU_ADDRESS 0x600370A9 /end MEASUREMENT
/begin MEASUREMENT DFC_b.TST_BSWM_E_ACTION_FAILED "Bit encoding / Tested bit for check DFC_BSWM_E_ACTION_FAILED" UBYTE DFC_OneToOne 1 100 0.00 1.000 BIT_MASK 0x8 FORMAT "%5.3" ECU_ADDRESS 0x600370AA /end MEASUREMENT
/begin MEASUREMENT DFC_b.TST_BSWM_E_INTRPTQUEUE_FULL "Bit encoding / Tested bit for check DFC_BSWM_E_INTRPTQUEUE_FULL" UBYTE DFC_OneToOne 1 100 0.00 1.000 BIT_MASK 0x8 FORMAT "%5.3" ECU_ADDRESS 0x600370AB /end MEASUREMENT
/begin MEASUREMENT DFC_b.TST_RBA_IOEXTLIB_KEEPALIVE_DRV "Bit encoding / Tested bit for check DFC_RBA_IOEXTLIB_KEEPALIVE_DRV" UBYTE DFC_OneToOne 1 100 0.00 1.000 BIT_MASK 0x8 FORMAT "%5.3" ECU_ADDRESS 0x600370AC /end MEASUREMENT
/begin MEASUREMENT DFC_b.TST_RBA_IOEXTLIB_KEEPALIVE_INI "Bit encoding / Tested bit for check DFC_RBA_IOEXTLIB_KEEPALIVE_INI" UBYTE DFC_OneToOne 1 100 0.00 1.000 BIT_MASK 0x8 FORMAT "%5.3" ECU_ADDRESS 0x600370AD /end MEASUREMENT
/begin MEASUREMENT DFC_b.TST_rba_IoSigRtc_StopCounter "Bit encoding / Tested bit for check DFC_rba_IoSigRtc_StopCounter" UBYTE DFC_OneToOne 1 100 0.00 1.000 BIT_MASK 0x8 FORMAT "%5.3" ECU_ADDRESS 0x600370AE /end MEASUREMENT
/begin MEASUREMENT DFC_b.TST_rba_MRly_Diag_Stk_Event "Bit encoding / Tested bit for check DFC_rba_MRly_Diag_Stk_Event" UBYTE DFC_OneToOne 1 100 0.00 1.000 BIT_MASK 0x8 FORMAT "%5.3" ECU_ADDRESS 0x600370AF /end MEASUREMENT
/begin MEASUREMENT DFC_b.TST_rba_MemDiag_MemReadErr "Bit encoding / Tested bit for check DFC_rba_MemDiag_MemReadErr" UBYTE DFC_OneToOne 1 100 0.00 1.000 BIT_MASK 0x8 FORMAT "%5.3" ECU_ADDRESS 0x600370B0 /end MEASUREMENT
/begin MEASUREMENT DFC_b.TST_rba_MemDiag_MemWrErr "Bit encoding / Tested bit for check DFC_rba_MemDiag_MemWrErr" UBYTE DFC_OneToOne 1 100 0.00 1.000 BIT_MASK 0x8 FORMAT "%5.3" ECU_ADDRESS 0x600370B1 /end MEASUREMENT
/begin MEASUREMENT DFC_b.TST_rba_SyC_IrrSwOffTrigEngRun_Event "Bit encoding / Tested bit for check DFC_rba_SyC_IrrSwOffTrigEngRun_Event" UBYTE DFC_OneToOne 1 100 0.00 1.000 BIT_MASK 0x8 FORMAT "%5.3" ECU_ADDRESS 0x600370B2 /end MEASUREMENT
/begin MEASUREMENT DFC_b.TST_rba_T15_Diag_ComInVld_Event "Bit encoding / Tested bit for check DFC_rba_T15_Diag_ComInVld_Event" UBYTE DFC_OneToOne 1 100 0.00 1.000 BIT_MASK 0x8 FORMAT "%5.3" ECU_ADDRESS 0x600370B3 /end MEASUREMENT
/begin MEASUREMENT DFC_b.TST_rba_T15_Diag_ComOff_HwOn_Event "Bit encoding / Tested bit for check DFC_rba_T15_Diag_ComOff_HwOn_Event" UBYTE DFC_OneToOne 1 100 0.00 1.000 BIT_MASK 0x8 FORMAT "%5.3" ECU_ADDRESS 0x600370B4 /end MEASUREMENT
/begin MEASUREMENT DFC_b.TST_rba_T15_Diag_ComOn_HwOff_Event "Bit encoding / Tested bit for check DFC_rba_T15_Diag_ComOn_HwOff_Event" UBYTE DFC_OneToOne 1 100 0.00 1.000 BIT_MASK 0x8 FORMAT "%5.3" ECU_ADDRESS 0x600370B5 /end MEASUREMENT
/begin MEASUREMENT DFC_b.TST_AAVmin "Bit encoding / Tested bit for check DFC_AAVmin" UBYTE DFC_OneToOne 1 100 0.00 1.000 BIT_MASK 0x8 FORMAT "%5.3" ECU_ADDRESS 0x600370B6 /end MEASUREMENT
/begin MEASUREMENT DFC_b.TST_AGRSUS "Bit encoding / Tested bit for check DFC_AGRSUS" UBYTE DFC_OneToOne 1 100 0.00 1.000 BIT_MASK 0x8 FORMAT "%5.3" ECU_ADDRESS 0x600370B7 /end MEASUREMENT
/begin MEASUREMENT DFC_b.TST_AfsPlausDiagHi "Bit encoding / Tested bit for check DFC_AfsPlausDiagHi" UBYTE DFC_OneToOne 1 100 0.00 1.000 BIT_MASK 0x8 FORMAT "%5.3" ECU_ADDRESS 0x600370B8 /end MEASUREMENT
/begin MEASUREMENT DFC_b.TST_AfsPlausDiagLo "Bit encoding / Tested bit for check DFC_AfsPlausDiagLo" UBYTE DFC_OneToOne 1 100 0.00 1.000 BIT_MASK 0x8 FORMAT "%5.3" ECU_ADDRESS 0x600370B9 /end MEASUREMENT
/begin MEASUREMENT DFC_b.TST_AfsVrntDiagErrB1 "Bit encoding / Tested bit for check DFC_AfsVrntDiagErrB1" UBYTE DFC_OneToOne 1 100 0.00 1.000 BIT_MASK 0x8 FORMAT "%5.3" ECU_ADDRESS 0x600370BA /end MEASUREMENT
/begin MEASUREMENT DFC_b.TST_AppAllSnsrDfct "Bit encoding / Tested bit for check DFC_AppAllSnsrDfct" UBYTE DFC_OneToOne 1 100 0.00 1.000 BIT_MASK 0x8 FORMAT "%5.3" ECU_ADDRESS 0x600370BB /end MEASUREMENT
/begin MEASUREMENT DFC_b.TST_BBKRnldg "Bit encoding / Tested bit for check DFC_BBKRnldg" UBYTE DFC_OneToOne 1 100 0.00 1.000 BIT_MASK 0x8 FORMAT "%5.3" ECU_ADDRESS 0x600370BC /end MEASUREMENT
/begin MEASUREMENT DFC_b.TST_BBKRsyne "Bit encoding / Tested bit for check DFC_BBKRsyne" UBYTE DFC_OneToOne 1 100 0.00 1.000 BIT_MASK 0x8 FORMAT "%5.3" ECU_ADDRESS 0x600370BD /end MEASUREMENT
/begin MEASUREMENT DFC_b.TST_BattUStdbyDiaOL "Bit encoding / Tested bit for check DFC_BattUStdbyDiaOL" UBYTE DFC_OneToOne 1 100 0.00 1.000 BIT_MASK 0x8 FORMAT "%5.3" ECU_ADDRESS 0x600370BE /end MEASUREMENT
/begin MEASUREMENT DFC_b.TST_BigLeakIntkMnfldEmiInfl "Bit encoding / Tested bit for check DFC_BigLeakIntkMnfldEmiInfl" UBYTE DFC_OneToOne 1 100 0.00 1.000 BIT_MASK 0x8 FORMAT "%5.3" ECU_ADDRESS 0x600370BF /end MEASUREMENT
/begin MEASUREMENT DFC_b.TST_BlkdLineTank "Bit encoding / Tested bit for check DFC_BlkdLineTank" UBYTE DFC_OneToOne 1 100 0.00 1.000 BIT_MASK 0x8 FORMAT "%5.3" ECU_ADDRESS 0x600370C0 /end MEASUREMENT
/begin MEASUREMENT DFC_b.TST_BrkMnSwtContOnWarnLmp "Bit encoding / Tested bit for check DFC_BrkMnSwtContOnWarnLmp" UBYTE DFC_OneToOne 1 100 0.00 1.000 BIT_MASK 0x8 FORMAT "%5.3" ECU_ADDRESS 0x600370C1 /end MEASUREMENT
/begin MEASUREMENT DFC_b.TST_BrkMnSwtNotStpWarnLmp "Bit encoding / Tested bit for check DFC_BrkMnSwtNotStpWarnLmp" UBYTE DFC_OneToOne 1 100 0.00 1.000 BIT_MASK 0x8 FORMAT "%5.3" ECU_ADDRESS 0x600370C2 /end MEASUREMENT
/begin MEASUREMENT DFC_b.TST_BrkRdntSwtContOnWarnLmp "Bit encoding / Tested bit for check DFC_BrkRdntSwtContOnWarnLmp" UBYTE DFC_OneToOne 1 100 0.00 1.000 BIT_MASK 0x8 FORMAT "%5.3" ECU_ADDRESS 0x600370C3 /end MEASUREMENT
/begin MEASUREMENT DFC_b.TST_BrkRdntSwtNotStpWarnLmp "Bit encoding / Tested bit for check DFC_BrkRdntSwtNotStpWarnLmp" UBYTE DFC_OneToOne 1 100 0.00 1.000 BIT_MASK 0x8 FORMAT "%5.3" ECU_ADDRESS 0x600370C4 /end MEASUREMENT
/begin MEASUREMENT DFC_b.TST_CEngDsTColdStrtMax "Bit encoding / Tested bit for check DFC_CEngDsTColdStrtMax" UBYTE DFC_OneToOne 1 100 0.00 1.000 BIT_MASK 0x8 FORMAT "%5.3" ECU_ADDRESS 0x600370C5 /end MEASUREMENT
/begin MEASUREMENT DFC_b.TST_CEngDsTColdStrtMin "Bit encoding / Tested bit for check DFC_CEngDsTColdStrtMin" UBYTE DFC_OneToOne 1 100 0.00 1.000 BIT_MASK 0x8 FORMAT "%5.3" ECU_ADDRESS 0x600370C6 /end MEASUREMENT
/begin MEASUREMENT DFC_b.TST_CEngDsTImps "Bit encoding / Tested bit for check DFC_CEngDsTImps" UBYTE DFC_OneToOne 1 100 0.00 1.000 BIT_MASK 0x8 FORMAT "%5.3" ECU_ADDRESS 0x600370C7 /end MEASUREMENT
/begin MEASUREMENT DFC_b.TST_CEngDsTPlausHSC "Bit encoding / Tested bit for check DFC_CEngDsTPlausHSC" UBYTE DFC_OneToOne 1 100 0.00 1.000 BIT_MASK 0x8 FORMAT "%5.3" ECU_ADDRESS 0x600370C8 /end MEASUREMENT
/begin MEASUREMENT DFC_b.TST_CEngDsTPlausLSC "Bit encoding / Tested bit for check DFC_CEngDsTPlausLSC" UBYTE DFC_OneToOne 1 100 0.00 1.000 BIT_MASK 0x8 FORMAT "%5.3" ECU_ADDRESS 0x600370C9 /end MEASUREMENT
/begin MEASUREMENT DFC_b.TST_CEngDsTPlausSTC "Bit encoding / Tested bit for check DFC_CEngDsTPlausSTC" UBYTE DFC_OneToOne 1 100 0.00 1.000 BIT_MASK 0x8 FORMAT "%5.3" ECU_ADDRESS 0x600370CA /end MEASUREMENT
/begin MEASUREMENT DFC_b.TST_CEngDsTSRCMax "Bit encoding / Tested bit for check DFC_CEngDsTSRCMax" UBYTE DFC_OneToOne 1 100 0.00 1.000 BIT_MASK 0x8 FORMAT "%5.3" ECU_ADDRESS 0x600370CB /end MEASUREMENT
/begin MEASUREMENT DFC_b.TST_CEngDsTSRCMin "Bit encoding / Tested bit for check DFC_CEngDsTSRCMin" UBYTE DFC_OneToOne 1 100 0.00 1.000 BIT_MASK 0x8 FORMAT "%5.3" ECU_ADDRESS 0x600370CC /end MEASUREMENT
/begin MEASUREMENT DFC_b.TST_CEngDsTSig "Bit encoding / Tested bit for check DFC_CEngDsTSig" UBYTE DFC_OneToOne 1 100 0.00 1.000 BIT_MASK 0x8 FORMAT "%5.3" ECU_ADDRESS 0x600370CD /end MEASUREMENT
/begin MEASUREMENT DFC_b.TST_CEngUsTColdStrtMax "Bit encoding / Tested bit for check DFC_CEngUsTColdStrtMax" UBYTE DFC_OneToOne 1 100 0.00 1.000 BIT_MASK 0x8 FORMAT "%5.3" ECU_ADDRESS 0x600370CE /end MEASUREMENT
/begin MEASUREMENT DFC_b.TST_CEngUsTColdStrtMin "Bit encoding / Tested bit for check DFC_CEngUsTColdStrtMin" UBYTE DFC_OneToOne 1 100 0.00 1.000 BIT_MASK 0x8 FORMAT "%5.3" ECU_ADDRESS 0x600370CF /end MEASUREMENT
/begin MEASUREMENT DFC_b.TST_CEngUsTLooseCnctn "Bit encoding / Tested bit for check DFC_CEngUsTLooseCnctn" UBYTE DFC_OneToOne 1 100 0.00 1.000 BIT_MASK 0x8 FORMAT "%5.3" ECU_ADDRESS 0x600370D0 /end MEASUREMENT
/begin MEASUREMENT DFC_b.TST_CEngUsTSRCMax "Bit encoding / Tested bit for check DFC_CEngUsTSRCMax" UBYTE DFC_OneToOne 1 100 0.00 1.000 BIT_MASK 0x8 FORMAT "%5.3" ECU_ADDRESS 0x600370D1 /end MEASUREMENT
/begin MEASUREMENT DFC_b.TST_CEngUsTSRCMin "Bit encoding / Tested bit for check DFC_CEngUsTSRCMin" UBYTE DFC_OneToOne 1 100 0.00 1.000 BIT_MASK 0x8 FORMAT "%5.3" ECU_ADDRESS 0x600370D2 /end MEASUREMENT
/begin MEASUREMENT DFC_b.TST_ComDCDCACCFailr "Bit encoding / Tested bit for check DFC_ComDCDCACCFailr" UBYTE DFC_OneToOne 1 100 0.00 1.000 BIT_MASK 0x8 FORMAT "%5.3" ECU_ADDRESS 0x600370D3 /end MEASUREMENT
/begin MEASUREMENT DFC_b.TST_DCDCFltDet "Bit encoding / Tested bit for check DFC_DCDCFltDet" UBYTE DFC_OneToOne 1 100 0.00 1.000 BIT_MASK 0x8 FORMAT "%5.3" ECU_ADDRESS 0x600370D4 /end MEASUREMENT
/begin MEASUREMENT DFC_b.TST_DKRSA "Bit encoding / Tested bit for check DFC_DKRSA" UBYTE DFC_OneToOne 1 100 0.00 1.000 BIT_MASK 0x8 FORMAT "%5.3" ECU_ADDRESS 0x600370D5 /end MEASUREMENT
/begin MEASUREMENT DFC_b.TST_DKVSmax "Bit encoding / Tested bit for check DFC_DKVSmax" UBYTE DFC_OneToOne 1 100 0.00 1.000 BIT_MASK 0x8 FORMAT "%5.3" ECU_ADDRESS 0x600370D6 /end MEASUREMENT
/begin MEASUREMENT DFC_b.TST_DKnpl "Bit encoding / Tested bit for check DFC_DKnpl" UBYTE DFC_OneToOne 1 100 0.00 1.000 BIT_MASK 0x8 FORMAT "%5.3" ECU_ADDRESS 0x600370D7 /end MEASUREMENT
/begin MEASUREMENT DFC_b.TST_DSKVRmax "Bit encoding / Tested bit for check DFC_DSKVRmax" UBYTE DFC_OneToOne 1 100 0.00 1.000 BIT_MASK 0x8 FORMAT "%5.3" ECU_ADDRESS 0x600370D8 /end MEASUREMENT
/begin MEASUREMENT DFC_b.TST_DSKVRmin "Bit encoding / Tested bit for check DFC_DSKVRmin" UBYTE DFC_OneToOne 1 100 0.00 1.000 BIT_MASK 0x8 FORMAT "%5.3" ECU_ADDRESS 0x600370D9 /end MEASUREMENT
/begin MEASUREMENT DFC_b.TST_DSKVRnpl "Bit encoding / Tested bit for check DFC_DSKVRnpl" UBYTE DFC_OneToOne 1 100 0.00 1.000 BIT_MASK 0x8 FORMAT "%5.3" ECU_ADDRESS 0x600370DA /end MEASUREMENT
/begin MEASUREMENT DFC_b.TST_DSKVRsig "Bit encoding / Tested bit for check DFC_DSKVRsig" UBYTE DFC_OneToOne 1 100 0.00 1.000 BIT_MASK 0x8 FORMAT "%5.3" ECU_ADDRESS 0x600370DB /end MEASUREMENT
/begin MEASUREMENT DFC_b.TST_DSKVSsig "Bit encoding / Tested bit for check DFC_DSKVSsig" UBYTE DFC_OneToOne 1 100 0.00 1.000 BIT_MASK 0x8 FORMAT "%5.3" ECU_ADDRESS 0x600370DC /end MEASUREMENT
/begin MEASUREMENT DFC_b.TST_DSSmax "Bit encoding / Tested bit for check DFC_DSSmax" UBYTE DFC_OneToOne 1 100 0.00 1.000 BIT_MASK 0x8 FORMAT "%5.3" ECU_ADDRESS 0x600370DD /end MEASUREMENT
/begin MEASUREMENT DFC_b.TST_DSTDmax "Bit encoding / Tested bit for check DFC_DSTDmax" UBYTE DFC_OneToOne 1 100 0.00 1.000 BIT_MASK 0x8 FORMAT "%5.3" ECU_ADDRESS 0x600370DE /end MEASUREMENT
/begin MEASUREMENT DFC_b.TST_DSTEmax "Bit encoding / Tested bit for check DFC_DSTEmax" UBYTE DFC_OneToOne 1 100 0.00 1.000 BIT_MASK 0x8 FORMAT "%5.3" ECU_ADDRESS 0x600370DF /end MEASUREMENT
/begin MEASUREMENT DFC_b.TST_DSTEmin "Bit encoding / Tested bit for check DFC_DSTEmin" UBYTE DFC_OneToOne 1 100 0.00 1.000 BIT_MASK 0x8 FORMAT "%5.3" ECU_ADDRESS 0x600370E0 /end MEASUREMENT
/begin MEASUREMENT DFC_b.TST_DSTOFmax "Bit encoding / Tested bit for check DFC_DSTOFmax" UBYTE DFC_OneToOne 1 100 0.00 1.000 BIT_MASK 0x8 FORMAT "%5.3" ECU_ADDRESS 0x600370E1 /end MEASUREMENT
/begin MEASUREMENT DFC_b.TST_DSTRmax "Bit encoding / Tested bit for check DFC_DSTRmax" UBYTE DFC_OneToOne 1 100 0.00 1.000 BIT_MASK 0x8 FORMAT "%5.3" ECU_ADDRESS 0x600370E2 /end MEASUREMENT
/begin MEASUREMENT DFC_b.TST_DSTRmin "Bit encoding / Tested bit for check DFC_DSTRmin" UBYTE DFC_OneToOne 1 100 0.00 1.000 BIT_MASK 0x8 FORMAT "%5.3" ECU_ADDRESS 0x600370E3 /end MEASUREMENT
/begin MEASUREMENT DFC_b.TST_DSTRnpl "Bit encoding / Tested bit for check DFC_DSTRnpl" UBYTE DFC_OneToOne 1 100 0.00 1.000 BIT_MASK 0x8 FORMAT "%5.3" ECU_ADDRESS 0x600370E4 /end MEASUREMENT
/begin MEASUREMENT DFC_b.TST_DSTRsig "Bit encoding / Tested bit for check DFC_DSTRsig" UBYTE DFC_OneToOne 1 100 0.00 1.000 BIT_MASK 0x8 FORMAT "%5.3" ECU_ADDRESS 0x600370E5 /end MEASUREMENT
/begin MEASUREMENT DFC_b.TST_DSTTI "Bit encoding / Tested bit for check DFC_DSTTI" UBYTE DFC_OneToOne 1 100 0.00 1.000 BIT_MASK 0x8 FORMAT "%5.3" ECU_ADDRESS 0x600370E6 /end MEASUREMENT
/begin MEASUREMENT DFC_b.TST_DSUmax "Bit encoding / Tested bit for check DFC_DSUmax" UBYTE DFC_OneToOne 1 100 0.00 1.000 BIT_MASK 0x8 FORMAT "%5.3" ECU_ADDRESS 0x600370E7 /end MEASUREMENT
/begin MEASUREMENT DFC_b.TST_DiagCpv1DteskLoLoadStuckClsd "Bit encoding / Tested bit for check DFC_DiagCpv1DteskLoLoadStuckClsd" UBYTE DFC_OneToOne 1 100 0.00 1.000 BIT_MASK 0x8 FORMAT "%5.3" ECU_ADDRESS 0x600370E8 /end MEASUREMENT
/begin MEASUREMENT DFC_b.TST_DiagCpv1DteskLoLoadStuckOpen "Bit encoding / Tested bit for check DFC_DiagCpv1DteskLoLoadStuckOpen" UBYTE DFC_OneToOne 1 100 0.00 1.000 BIT_MASK 0x8 FORMAT "%5.3" ECU_ADDRESS 0x600370E9 /end MEASUREMENT
/begin MEASUREMENT DFC_b.TST_EGRVlvDrftClsd "Bit encoding / Tested bit for check DFC_EGRVlvDrftClsd" UBYTE DFC_OneToOne 1 100 0.00 1.000 BIT_MASK 0x8 FORMAT "%5.3" ECU_ADDRESS 0x600370EA /end MEASUREMENT
/begin MEASUREMENT DFC_b.TST_EGRVlvDrftOpn "Bit encoding / Tested bit for check DFC_EGRVlvDrftOpn" UBYTE DFC_OneToOne 1 100 0.00 1.000 BIT_MASK 0x8 FORMAT "%5.3" ECU_ADDRESS 0x600370EB /end MEASUREMENT
/begin MEASUREMENT DFC_b.TST_EGRVlvJamVlvClsd "Bit encoding / Tested bit for check DFC_EGRVlvJamVlvClsd" UBYTE DFC_OneToOne 1 100 0.00 1.000 BIT_MASK 0x8 FORMAT "%5.3" ECU_ADDRESS 0x600370EC /end MEASUREMENT
/begin MEASUREMENT DFC_b.TST_EGRVlvJamVlvOpn "Bit encoding / Tested bit for check DFC_EGRVlvJamVlvOpn" UBYTE DFC_OneToOne 1 100 0.00 1.000 BIT_MASK 0x8 FORMAT "%5.3" ECU_ADDRESS 0x600370ED /end MEASUREMENT
/begin MEASUREMENT DFC_b.TST_EGRVlvSprgBrk "Bit encoding / Tested bit for check DFC_EGRVlvSprgBrk" UBYTE DFC_OneToOne 1 100 0.00 1.000 BIT_MASK 0x8 FORMAT "%5.3" ECU_ADDRESS 0x600370EE /end MEASUREMENT
/begin MEASUREMENT DFC_b.TST_EGRVlvTempMdlEEPErr "Bit encoding / Tested bit for check DFC_EGRVlvTempMdlEEPErr" UBYTE DFC_OneToOne 1 100 0.00 1.000 BIT_MASK 0x8 FORMAT "%5.3" ECU_ADDRESS 0x600370EF /end MEASUREMENT
/begin MEASUREMENT DFC_b.TST_EGRVlvTmpErr "Bit encoding / Tested bit for check DFC_EGRVlvTmpErr" UBYTE DFC_OneToOne 1 100 0.00 1.000 BIT_MASK 0x8 FORMAT "%5.3" ECU_ADDRESS 0x600370F0 /end MEASUREMENT
/begin MEASUREMENT DFC_b.TST_EGSDUS2B1LtrDly "Bit encoding / Tested bit for check DFC_EGSDUS2B1LtrDly" UBYTE DFC_OneToOne 1 100 0.00 1.000 BIT_MASK 0x8 FORMAT "%5.3" ECU_ADDRESS 0x600370F1 /end MEASUREMENT
/begin MEASUREMENT DFC_b.TST_EGSDUS2B1LtrPT1 "Bit encoding / Tested bit for check DFC_EGSDUS2B1LtrPT1" UBYTE DFC_OneToOne 1 100 0.00 1.000 BIT_MASK 0x8 FORMAT "%5.3" ECU_ADDRESS 0x600370F2 /end MEASUREMENT
/begin MEASUREMENT DFC_b.TST_EGSDUS2B1RtlDly "Bit encoding / Tested bit for check DFC_EGSDUS2B1RtlDly" UBYTE DFC_OneToOne 1 100 0.00 1.000 BIT_MASK 0x8 FORMAT "%5.3" ECU_ADDRESS 0x600370F3 /end MEASUREMENT
/begin MEASUREMENT DFC_b.TST_EGSDUS2B1RtlPT1 "Bit encoding / Tested bit for check DFC_EGSDUS2B1RtlPT1" UBYTE DFC_OneToOne 1 100 0.00 1.000 BIT_MASK 0x8 FORMAT "%5.3" ECU_ADDRESS 0x600370F4 /end MEASUREMENT
/begin MEASUREMENT DFC_b.TST_EGSDUS2B1TarLean "Bit encoding / Tested bit for check DFC_EGSDUS2B1TarLean" UBYTE DFC_OneToOne 1 100 0.00 1.000 BIT_MASK 0x8 FORMAT "%5.3" ECU_ADDRESS 0x600370F5 /end MEASUREMENT
/begin MEASUREMENT DFC_b.TST_EGSDUS2B1TarRich "Bit encoding / Tested bit for check DFC_EGSDUS2B1TarRich" UBYTE DFC_OneToOne 1 100 0.00 1.000 BIT_MASK 0x8 FORMAT "%5.3" ECU_ADDRESS 0x600370F6 /end MEASUREMENT
/begin MEASUREMENT DFC_b.TST_EONVmax "Bit encoding / Tested bit for check DFC_EONVmax" UBYTE DFC_OneToOne 1 100 0.00 1.000 BIT_MASK 0x8 FORMAT "%5.3" ECU_ADDRESS 0x600370F7 /end MEASUREMENT
/begin MEASUREMENT DFC_b.TST_ETAKHLmax "Bit encoding / Tested bit for check DFC_ETAKHLmax" UBYTE DFC_OneToOne 1 100 0.00 1.000 BIT_MASK 0x8 FORMAT "%5.3" ECU_ADDRESS 0x600370F8 /end MEASUREMENT
/begin MEASUREMENT DFC_b.TST_ETAKHTmax "Bit encoding / Tested bit for check DFC_ETAKHTmax" UBYTE DFC_OneToOne 1 100 0.00 1.000 BIT_MASK 0x8 FORMAT "%5.3" ECU_ADDRESS 0x600370F9 /end MEASUREMENT
/begin MEASUREMENT DFC_b.TST_ETHSEmax "Bit encoding / Tested bit for check DFC_ETHSEmax" UBYTE DFC_OneToOne 1 100 0.00 1.000 BIT_MASK 0x8 FORMAT "%5.3" ECU_ADDRESS 0x600370FA /end MEASUREMENT
/begin MEASUREMENT DFC_b.TST_ETHSEmin "Bit encoding / Tested bit for check DFC_ETHSEmin" UBYTE DFC_OneToOne 1 100 0.00 1.000 BIT_MASK 0x8 FORMAT "%5.3" ECU_ADDRESS 0x600370FB /end MEASUREMENT
/begin MEASUREMENT DFC_b.TST_ETHSFmax "Bit encoding / Tested bit for check DFC_ETHSFmax" UBYTE DFC_OneToOne 1 100 0.00 1.000 BIT_MASK 0x8 FORMAT "%5.3" ECU_ADDRESS 0x600370FC /end MEASUREMENT
/begin MEASUREMENT DFC_b.TST_ETHSFmin "Bit encoding / Tested bit for check DFC_ETHSFmin" UBYTE DFC_OneToOne 1 100 0.00 1.000 BIT_MASK 0x8 FORMAT "%5.3" ECU_ADDRESS 0x600370FD /end MEASUREMENT
/begin MEASUREMENT DFC_b.TST_ETHSFsig "Bit encoding / Tested bit for check DFC_ETHSFsig" UBYTE DFC_OneToOne 1 100 0.00 1.000 BIT_MASK 0x8 FORMAT "%5.3" ECU_ADDRESS 0x600370FE /end MEASUREMENT
/begin MEASUREMENT DFC_b.TST_ETHSNPWmax "Bit encoding / Tested bit for check DFC_ETHSNPWmax" UBYTE DFC_OneToOne 1 100 0.00 1.000 BIT_MASK 0x8 FORMAT "%5.3" ECU_ADDRESS 0x600370FF /end MEASUREMENT
/begin MEASUREMENT DFC_b.TST_ETHSNPWmin "Bit encoding / Tested bit for check DFC_ETHSNPWmin" UBYTE DFC_OneToOne 1 100 0.00 1.000 BIT_MASK 0x8 FORMAT "%5.3" ECU_ADDRESS 0x60037100 /end MEASUREMENT
/begin MEASUREMENT DFC_b.TST_ETHSNPWsig "Bit encoding / Tested bit for check DFC_ETHSNPWsig" UBYTE DFC_OneToOne 1 100 0.00 1.000 BIT_MASK 0x8 FORMAT "%5.3" ECU_ADDRESS 0x60037101 /end MEASUREMENT
/begin MEASUREMENT DFC_b.TST_ETHSPLnpl "Bit encoding / Tested bit for check DFC_ETHSPLnpl" UBYTE DFC_OneToOne 1 100 0.00 1.000 BIT_MASK 0x8 FORMAT "%5.3" ECU_ADDRESS 0x60037102 /end MEASUREMENT
/begin MEASUREMENT DFC_b.TST_ETHSTPLnpl "Bit encoding / Tested bit for check DFC_ETHSTPLnpl" UBYTE DFC_OneToOne 1 100 0.00 1.000 BIT_MASK 0x8 FORMAT "%5.3" ECU_ADDRESS 0x60037103 /end MEASUREMENT
/begin MEASUREMENT DFC_b.TST_EngICO "Bit encoding / Tested bit for check DFC_EngICO" UBYTE DFC_OneToOne 1 100 0.00 1.000 BIT_MASK 0x8 FORMAT "%5.3" ECU_ADDRESS 0x60037104 /end MEASUREMENT
/begin MEASUREMENT DFC_b.TST_EngPrtOvrSpdMon "Bit encoding / Tested bit for check DFC_EngPrtOvrSpdMon" UBYTE DFC_OneToOne 1 100 0.00 1.000 BIT_MASK 0x8 FORMAT "%5.3" ECU_ADDRESS 0x60037105 /end MEASUREMENT
/begin MEASUREMENT DFC_b.TST_EpmCaSI1ErrSig "Bit encoding / Tested bit for check DFC_EpmCaSI1ErrSig" UBYTE DFC_OneToOne 1 100 0.00 1.000 BIT_MASK 0x8 FORMAT "%5.3" ECU_ADDRESS 0x60037106 /end MEASUREMENT
/begin MEASUREMENT DFC_b.TST_EpmCaSI1MntErr "Bit encoding / Tested bit for check DFC_EpmCaSI1MntErr" UBYTE DFC_OneToOne 1 100 0.00 1.000 BIT_MASK 0x8 FORMAT "%5.3" ECU_ADDRESS 0x60037107 /end MEASUREMENT
/begin MEASUREMENT DFC_b.TST_EpmCaSI1NoSigMax "Bit encoding / Tested bit for check DFC_EpmCaSI1NoSigMax" UBYTE DFC_OneToOne 1 100 0.00 1.000 BIT_MASK 0x8 FORMAT "%5.3" ECU_ADDRESS 0x60037108 /end MEASUREMENT
/begin MEASUREMENT DFC_b.TST_EpmCaSI1NoSigMin "Bit encoding / Tested bit for check DFC_EpmCaSI1NoSigMin" UBYTE DFC_OneToOne 1 100 0.00 1.000 BIT_MASK 0x8 FORMAT "%5.3" ECU_ADDRESS 0x60037109 /end MEASUREMENT
/begin MEASUREMENT DFC_b.TST_EpmCaSI1OfsErr "Bit encoding / Tested bit for check DFC_EpmCaSI1OfsErr" UBYTE DFC_OneToOne 1 100 0.00 1.000 BIT_MASK 0x8 FORMAT "%5.3" ECU_ADDRESS 0x6003710A /end MEASUREMENT
/begin MEASUREMENT DFC_b.TST_EpmCrSDGI "Bit encoding / Tested bit for check DFC_EpmCrSDGI" UBYTE DFC_OneToOne 1 100 0.00 1.000 BIT_MASK 0x8 FORMAT "%5.3" ECU_ADDRESS 0x6003710B /end MEASUREMENT
/begin MEASUREMENT DFC_b.TST_EpmCrSErrSig "Bit encoding / Tested bit for check DFC_EpmCrSErrSig" UBYTE DFC_OneToOne 1 100 0.00 1.000 BIT_MASK 0x8 FORMAT "%5.3" ECU_ADDRESS 0x6003710C /end MEASUREMENT
/begin MEASUREMENT DFC_b.TST_EpmCrSNoSig "Bit encoding / Tested bit for check DFC_EpmCrSNoSig" UBYTE DFC_OneToOne 1 100 0.00 1.000 BIT_MASK 0x8 FORMAT "%5.3" ECU_ADDRESS 0x6003710D /end MEASUREMENT
/begin MEASUREMENT DFC_b.TST_EtaEngIdleNonCsers "Bit encoding / Tested bit for check DFC_EtaEngIdleNonCsers" UBYTE DFC_OneToOne 1 100 0.00 1.000 BIT_MASK 0x8 FORMAT "%5.3" ECU_ADDRESS 0x6003710E /end MEASUREMENT
/begin MEASUREMENT DFC_b.TST_EtaEngPtlNonCsers "Bit encoding / Tested bit for check DFC_EtaEngPtlNonCsers" UBYTE DFC_OneToOne 1 100 0.00 1.000 BIT_MASK 0x8 FORMAT "%5.3" ECU_ADDRESS 0x6003710F /end MEASUREMENT
/begin MEASUREMENT DFC_b.TST_FRAmax "Bit encoding / Tested bit for check DFC_FRAmax" UBYTE DFC_OneToOne 1 100 0.00 1.000 BIT_MASK 0x8 FORMAT "%5.3" ECU_ADDRESS 0x60037110 /end MEASUREMENT
/begin MEASUREMENT DFC_b.TST_FRAmin "Bit encoding / Tested bit for check DFC_FRAmin" UBYTE DFC_OneToOne 1 100 0.00 1.000 BIT_MASK 0x8 FORMAT "%5.3" ECU_ADDRESS 0x60037111 /end MEASUREMENT
/begin MEASUREMENT DFC_b.TST_FSTEmax "Bit encoding / Tested bit for check DFC_FSTEmax" UBYTE DFC_OneToOne 1 100 0.00 1.000 BIT_MASK 0x8 FORMAT "%5.3" ECU_ADDRESS 0x60037112 /end MEASUREMENT
/begin MEASUREMENT DFC_b.TST_FSTEmin "Bit encoding / Tested bit for check DFC_FSTEmin" UBYTE DFC_OneToOne 1 100 0.00 1.000 BIT_MASK 0x8 FORMAT "%5.3" ECU_ADDRESS 0x60037113 /end MEASUREMENT
/begin MEASUREMENT DFC_b.TST_FSTRmax "Bit encoding / Tested bit for check DFC_FSTRmax" UBYTE DFC_OneToOne 1 100 0.00 1.000 BIT_MASK 0x8 FORMAT "%5.3" ECU_ADDRESS 0x60037114 /end MEASUREMENT
/begin MEASUREMENT DFC_b.TST_FSTRmin "Bit encoding / Tested bit for check DFC_FSTRmin" UBYTE DFC_OneToOne 1 100 0.00 1.000 BIT_MASK 0x8 FORMAT "%5.3" ECU_ADDRESS 0x60037115 /end MEASUREMENT
/begin MEASUREMENT DFC_b.TST_FSTRnpl "Bit encoding / Tested bit for check DFC_FSTRnpl" UBYTE DFC_OneToOne 1 100 0.00 1.000 BIT_MASK 0x8 FORMAT "%5.3" ECU_ADDRESS 0x60037116 /end MEASUREMENT
/begin MEASUREMENT DFC_b.TST_FSTmax "Bit encoding / Tested bit for check DFC_FSTmax" UBYTE DFC_OneToOne 1 100 0.00 1.000 BIT_MASK 0x8 FORMAT "%5.3" ECU_ADDRESS 0x60037117 /end MEASUREMENT
/begin MEASUREMENT DFC_b.TST_FTDLAmax "Bit encoding / Tested bit for check DFC_FTDLAmax" UBYTE DFC_OneToOne 1 100 0.00 1.000 BIT_MASK 0x8 FORMAT "%5.3" ECU_ADDRESS 0x60037118 /end MEASUREMENT
/begin MEASUREMENT DFC_b.TST_FTDLAmin "Bit encoding / Tested bit for check DFC_FTDLAmin" UBYTE DFC_OneToOne 1 100 0.00 1.000 BIT_MASK 0x8 FORMAT "%5.3" ECU_ADDRESS 0x60037119 /end MEASUREMENT
/begin MEASUREMENT DFC_b.TST_FuPHiSnsrEleclmax "Bit encoding / Tested bit for check DFC_FuPHiSnsrEleclmax" UBYTE DFC_OneToOne 1 100 0.00 1.000 BIT_MASK 0x8 FORMAT "%5.3" ECU_ADDRESS 0x6003711A /end MEASUREMENT
/begin MEASUREMENT DFC_b.TST_FuPHiSnsrEleclmin "Bit encoding / Tested bit for check DFC_FuPHiSnsrEleclmin" UBYTE DFC_OneToOne 1 100 0.00 1.000 BIT_MASK 0x8 FORMAT "%5.3" ECU_ADDRESS 0x6003711B /end MEASUREMENT
/begin MEASUREMENT DFC_b.TST_FuPHiSnsrEleclnpl "Bit encoding / Tested bit for check DFC_FuPHiSnsrEleclnpl" UBYTE DFC_OneToOne 1 100 0.00 1.000 BIT_MASK 0x8 FORMAT "%5.3" ECU_ADDRESS 0x6003711C /end MEASUREMENT
/begin MEASUREMENT DFC_b.TST_FuPHiSnsrURngMax "Bit encoding / Tested bit for check DFC_FuPHiSnsrURngMax" UBYTE DFC_OneToOne 1 100 0.00 1.000 BIT_MASK 0x8 FORMAT "%5.3" ECU_ADDRESS 0x6003711D /end MEASUREMENT
/begin MEASUREMENT DFC_b.TST_FuPHiSnsrURngMin "Bit encoding / Tested bit for check DFC_FuPHiSnsrURngMin" UBYTE DFC_OneToOne 1 100 0.00 1.000 BIT_MASK 0x8 FORMAT "%5.3" ECU_ADDRESS 0x6003711E /end MEASUREMENT
/begin MEASUREMENT DFC_b.TST_FuSnsrPhyRngMaxErr "Bit encoding / Tested bit for check DFC_FuSnsrPhyRngMaxErr" UBYTE DFC_OneToOne 1 100 0.00 1.000 BIT_MASK 0x8 FORMAT "%5.3" ECU_ADDRESS 0x6003711F /end MEASUREMENT
/begin MEASUREMENT DFC_b.TST_FuSnsrPhyRngMinErr "Bit encoding / Tested bit for check DFC_FuSnsrPhyRngMinErr" UBYTE DFC_OneToOne 1 100 0.00 1.000 BIT_MASK 0x8 FORMAT "%5.3" ECU_ADDRESS 0x60037120 /end MEASUREMENT
/begin MEASUREMENT DFC_b.TST_GEVlvLockPinDiagIntkB1 "Bit encoding / Tested bit for check DFC_GEVlvLockPinDiagIntkB1" UBYTE DFC_OneToOne 1 100 0.00 1.000 BIT_MASK 0x8 FORMAT "%5.3" ECU_ADDRESS 0x60037121 /end MEASUREMENT
/begin MEASUREMENT DFC_b.TST_GEVlvPhaSlowIntkB1 "Bit encoding / Tested bit for check DFC_GEVlvPhaSlowIntkB1" UBYTE DFC_OneToOne 1 100 0.00 1.000 BIT_MASK 0x8 FORMAT "%5.3" ECU_ADDRESS 0x60037122 /end MEASUREMENT
/begin MEASUREMENT DFC_b.TST_GEVlvPhaTargIntkB1 "Bit encoding / Tested bit for check DFC_GEVlvPhaTargIntkB1" UBYTE DFC_OneToOne 1 100 0.00 1.000 BIT_MASK 0x8 FORMAT "%5.3" ECU_ADDRESS 0x60037123 /end MEASUREMENT
/begin MEASUREMENT DFC_b.TST_GbxRvsSwtStk "Bit encoding / Tested bit for check DFC_GbxRvsSwtStk" UBYTE DFC_OneToOne 1 100 0.00 1.000 BIT_MASK 0x8 FORMAT "%5.3" ECU_ADDRESS 0x60037124 /end MEASUREMENT
/begin MEASUREMENT DFC_b.TST_HDRKHmax "Bit encoding / Tested bit for check DFC_HDRKHmax" UBYTE DFC_OneToOne 1 100 0.00 1.000 BIT_MASK 0x8 FORMAT "%5.3" ECU_ADDRESS 0x60037125 /end MEASUREMENT
/begin MEASUREMENT DFC_b.TST_HDRKHmin "Bit encoding / Tested bit for check DFC_HDRKHmin" UBYTE DFC_OneToOne 1 100 0.00 1.000 BIT_MASK 0x8 FORMAT "%5.3" ECU_ADDRESS 0x60037126 /end MEASUREMENT
/begin MEASUREMENT DFC_b.TST_HDRPLmax "Bit encoding / Tested bit for check DFC_HDRPLmax" UBYTE DFC_OneToOne 1 100 0.00 1.000 BIT_MASK 0x8 FORMAT "%5.3" ECU_ADDRESS 0x60037127 /end MEASUREMENT
/begin MEASUREMENT DFC_b.TST_HDRPLmin "Bit encoding / Tested bit for check DFC_HDRPLmin" UBYTE DFC_OneToOne 1 100 0.00 1.000 BIT_MASK 0x8 FORMAT "%5.3" ECU_ADDRESS 0x60037128 /end MEASUREMENT
/begin MEASUREMENT DFC_b.TST_HDRmax "Bit encoding / Tested bit for check DFC_HDRmax" UBYTE DFC_OneToOne 1 100 0.00 1.000 BIT_MASK 0x8 FORMAT "%5.3" ECU_ADDRESS 0x60037129 /end MEASUREMENT
/begin MEASUREMENT DFC_b.TST_HDRmin "Bit encoding / Tested bit for check DFC_HDRmin" UBYTE DFC_OneToOne 1 100 0.00 1.000 BIT_MASK 0x8 FORMAT "%5.3" ECU_ADDRESS 0x6003712A /end MEASUREMENT
/begin MEASUREMENT DFC_b.TST_HEGOS2B1ElecMax "Bit encoding / Tested bit for check DFC_HEGOS2B1ElecMax" UBYTE DFC_OneToOne 1 100 0.00 1.000 BIT_MASK 0x8 FORMAT "%5.3" ECU_ADDRESS 0x6003712B /end MEASUREMENT
/begin MEASUREMENT DFC_b.TST_HEGOS2B1ElecMin "Bit encoding / Tested bit for check DFC_HEGOS2B1ElecMin" UBYTE DFC_OneToOne 1 100 0.00 1.000 BIT_MASK 0x8 FORMAT "%5.3" ECU_ADDRESS 0x6003712C /end MEASUREMENT
/begin MEASUREMENT DFC_b.TST_HEGOS2B1ElecSig "Bit encoding / Tested bit for check DFC_HEGOS2B1ElecSig" UBYTE DFC_OneToOne 1 100 0.00 1.000 BIT_MASK 0x8 FORMAT "%5.3" ECU_ADDRESS 0x6003712D /end MEASUREMENT
/begin MEASUREMENT DFC_b.TST_HEGOS2B1HtgNpl "Bit encoding / Tested bit for check DFC_HEGOS2B1HtgNpl" UBYTE DFC_OneToOne 1 100 0.00 1.000 BIT_MASK 0x8 FORMAT "%5.3" ECU_ADDRESS 0x6003712E /end MEASUREMENT
/begin MEASUREMENT DFC_b.TST_HEV00max "Bit encoding / Tested bit for check DFC_HEV00max" UBYTE DFC_OneToOne 1 100 0.00 1.000 BIT_MASK 0x8 FORMAT "%5.3" ECU_ADDRESS 0x6003712F /end MEASUREMENT
/begin MEASUREMENT DFC_b.TST_HEV01max "Bit encoding / Tested bit for check DFC_HEV01max" UBYTE DFC_OneToOne 1 100 0.00 1.000 BIT_MASK 0x8 FORMAT "%5.3" ECU_ADDRESS 0x60037130 /end MEASUREMENT
/begin MEASUREMENT DFC_b.TST_HEV02max "Bit encoding / Tested bit for check DFC_HEV02max" UBYTE DFC_OneToOne 1 100 0.00 1.000 BIT_MASK 0x8 FORMAT "%5.3" ECU_ADDRESS 0x60037131 /end MEASUREMENT
/begin MEASUREMENT DFC_b.TST_HEV03max "Bit encoding / Tested bit for check DFC_HEV03max" UBYTE DFC_OneToOne 1 100 0.00 1.000 BIT_MASK 0x8 FORMAT "%5.3" ECU_ADDRESS 0x60037132 /end MEASUREMENT
/begin MEASUREMENT DFC_b.TST_HEVE0max "Bit encoding / Tested bit for check DFC_HEVE0max" UBYTE DFC_OneToOne 1 100 0.00 1.000 BIT_MASK 0x8 FORMAT "%5.3" ECU_ADDRESS 0x60037133 /end MEASUREMENT
/begin MEASUREMENT DFC_b.TST_HEVE1max "Bit encoding / Tested bit for check DFC_HEVE1max" UBYTE DFC_OneToOne 1 100 0.00 1.000 BIT_MASK 0x8 FORMAT "%5.3" ECU_ADDRESS 0x60037134 /end MEASUREMENT
/begin MEASUREMENT DFC_b.TST_HFMmax "Bit encoding / Tested bit for check DFC_HFMmax" UBYTE DFC_OneToOne 1 100 0.00 1.000 BIT_MASK 0x8 FORMAT "%5.3" ECU_ADDRESS 0x60037135 /end MEASUREMENT
/begin MEASUREMENT DFC_b.TST_HiPSysHiPMaxLimExcdd "Bit encoding / Tested bit for check DFC_HiPSysHiPMaxLimExcdd" UBYTE DFC_OneToOne 1 100 0.00 1.000 BIT_MASK 0x8 FORMAT "%5.3" ECU_ADDRESS 0x60037136 /end MEASUREMENT
/begin MEASUREMENT DFC_b.TST_IVGdiCtlCvoErrMax_0 "Bit encoding / Tested bit for check DFC_IVGdiCtlCvoErrMax_0" UBYTE DFC_OneToOne 1 100 0.00 1.000 BIT_MASK 0x8 FORMAT "%5.3" ECU_ADDRESS 0x60037137 /end MEASUREMENT
/begin MEASUREMENT DFC_b.TST_IVGdiCtlCvoErrMax_1 "Bit encoding / Tested bit for check DFC_IVGdiCtlCvoErrMax_1" UBYTE DFC_OneToOne 1 100 0.00 1.000 BIT_MASK 0x8 FORMAT "%5.3" ECU_ADDRESS 0x60037138 /end MEASUREMENT
/begin MEASUREMENT DFC_b.TST_IVGdiCtlCvoErrMax_2 "Bit encoding / Tested bit for check DFC_IVGdiCtlCvoErrMax_2" UBYTE DFC_OneToOne 1 100 0.00 1.000 BIT_MASK 0x8 FORMAT "%5.3" ECU_ADDRESS 0x60037139 /end MEASUREMENT
/begin MEASUREMENT DFC_b.TST_IVGdiCtlCvoErrMax_3 "Bit encoding / Tested bit for check DFC_IVGdiCtlCvoErrMax_3" UBYTE DFC_OneToOne 1 100 0.00 1.000 BIT_MASK 0x8 FORMAT "%5.3" ECU_ADDRESS 0x6003713A /end MEASUREMENT
/begin MEASUREMENT DFC_b.TST_IVGdiCtlCvoErrMin_0 "Bit encoding / Tested bit for check DFC_IVGdiCtlCvoErrMin_0" UBYTE DFC_OneToOne 1 100 0.00 1.000 BIT_MASK 0x8 FORMAT "%5.3" ECU_ADDRESS 0x6003713B /end MEASUREMENT
/begin MEASUREMENT EngDa_tEng_f "" FLOAT32_IEEE RBPtCel_t_1p0_3 1 100 -1.00000000E+037 1.00000000E+037 FORMAT "%13.3" ECU_ADDRESS 0x60003B18 /end MEASUREMENT
/begin MEASUREMENT EnvP_p_f "Actual physical value" FLOAT32_IEEE RBPtCel_p_1p0_1 1 100 -1.00000000E+037 1.00000000E+037 FORMAT "%13.3" ECU_ADDRESS 0x50004EFC /end MEASUREMENT
/begin MEASUREMENT EnvT_t_f "envt" FLOAT32_IEEE RBPtCel_t_1p0_3 1 100 -1.00000000E+037 1.00000000E+037 FORMAT "%13.3" ECU_ADDRESS 0x60003B14 /end MEASUREMENT
/begin MEASUREMENT EnvT_t_f_Sq "" UBYTE SigQly_COMPU_VERB 1 100 0.00 15.0000000000 FORMAT "%13.10" ECU_ADDRESS 0x6000FC90 /end MEASUREMENT
/begin MEASUREMENT ExhMod_pRelPfilDs_f "Modelled relative pressure downstream of particulate filter" FLOAT32_IEEE RBPtCel_p_1p0_1 1 100 -1.00000000E+037 1.00000000E+037 FORMAT "%13.3" ECU_ADDRESS 0x60003B0C /end MEASUREMENT
/begin MEASUREMENT ExhMod_tExhCat1DsB1_f "exhaust gas temperature catalyst 1 downstream" FLOAT32_IEEE RBPtCel_t_1p0_3 1 100 -1.00000000E+037 1.00000000E+037 FORMAT "%13.3" ECU_ADDRESS 0x60003B08 /end MEASUREMENT
/begin MEASUREMENT FuelT_t_f "Actual physical value" FLOAT32_IEEE RBPtCel_t_1p0_3 1 100 -1.00000000E+037 1.00000000E+037 FORMAT "%13.3" ECU_ADDRESS 0x60003B04 /end MEASUREMENT
/begin MEASUREMENT IntkAirT_t_f "Actual physical value" FLOAT32_IEEE RBPtCel_t_1p0_3 1 100 -1.00000000E+037 1.00000000E+037 FORMAT "%13.3" ECU_ADDRESS 0x60003B00 /end MEASUREMENT
/begin MEASUREMENT OilP_p_f "Actual physical value" FLOAT32_IEEE RBPtCel_p_1p0_1 1 100 -1.00000000E+037 1.00000000E+037 FORMAT "%13.3" ECU_ADDRESS 0x60003AFC /end MEASUREMENT
/begin MEASUREMENT OilSwmpT_t_f "e_:Global Function for Sensor Selection:_e;d_:Service Funktion fuer Sensorauswahl:_d" FLOAT32_IEEE RBPtCel_t_1p0_3 1 100 -1.00000000E+037 1.00000000E+037 FORMAT "%13.3" ECU_ADDRESS 0x60003AF8 /end MEASUREMENT
/begin FUNCTION DELib_DevDrvrOutpDutyCycRamp "1.1.0     Device Driver - Duty Cycle Ramp" FUNCTION_VERSION "1.1.0" /end FUNCTION
/begin FUNCTION DELib_ElecActr "26.4.0    single source library for closed loop controlled actuators" /begin OUT_MEASUREMENT DELib_stEepTEngOff DELib_tEngOffEEP /end OUT_MEASUREMENT FUNCTION_VERSION "26.4.0" /end FUNCTION
/begin FUNCTION DELib_ElecActrAdpvPosnCtrlInp "4.0.0     Function to handle the input calculation of the adaptive position governor" FUNCTION_VERSION "4.0.0" /end FUNCTION
/begin FUNCTION DELib_ElecActrAvs "2.1.0     AVS Functions for ElecActr" FUNCTION_VERSION "2.1.0" /end FUNCTION
/begin FUNCTION DELib_ElecActrCoorrLib "12.1.0    Electrical Actuator Coordinator Library" FUNCTION_VERSION "12.1.0" /end FUNCTION
/begin FUNCTION DELib_ElecactrDdSnsrReadLib "1.25.0    Library to support the Reading of Raw values from Sensor" FUNCTION_VERSION "1.25.0" /end FUNCTION
/begin FUNCTION DELib_ElecActrElecDiagLib "1.13.0    Library for Electrical diagnosis support" FUNCTION_VERSION "1.13.0" /end FUNCTION
/begin FUNCTION DELib_ElecActrGovrLib "13.0.0    Governor library for closed loop controlled actuators" FUNCTION_VERSION "13.0.0" /end FUNCTION
/begin FUNCTION DELib_ElecActrSpArbn "3.0.0     FC for actuator set-point arbitration" FUNCTION_VERSION "3.0.0" /end FUNCTION
/begin FUNCTION DELib_ElecActrVdMonLib "17.0.0    Library to support the Monitoring functions of Electrical Actuator" FUNCTION_VERSION "17.0.0" /end FUNCTION
/begin FUNCTION DELib_ElecActrVdPosnGovrInpLib "14.2.0    Library to support the Positition governor input functions" FUNCTION_VERSION "14.2.0" /end FUNCTION
/begin FUNCTION DELib_ElecActrVdPosnGovrLib "10.1.0    Library to support the Position Governor" FUNCTION_VERSION "10.1.0" /end FUNCTION
/begin FUNCTION DELib_ElecActrVdSnsrLib "13.2.0    Device Encapsulation Library - Electrical Actuators VdSnsr" FUNCTION_VERSION "13.2.0" /end FUNCTION
/begin FUNCTION DELib_Fir "1.2.0     Fir" FUNCTION_VERSION "1.2.0" /end FUNCTION
/begin FUNCTION DELib_GlbActrLimnCntr "1.1.0     Actuator Limitation Counter" FUNCTION_VERSION "1.1.0" /end FUNCTION
/begin FUNCTION DELib_GlbAdp "10.2.0    DELib Adapter"
 /begin IN_MEASUREMENT Air_tEGRClrLPDs BrkBstP_p CEngDsT_t CEngDsT_t_Sq CEngUsT_t EngDa_tEng EnvP_p EnvT_t EnvT_t_Sq ExhMod_pRelPfilDs ExhMod_tExhCat1DsB1 FuelT_t IntkAirT_t OilP_p OilSwmpT_t /end IN_MEASUREMENT
 /begin OUT_MEASUREMENT Air_tEGRClrLPDs_f BrkBstP_p_f CEngDsT_t_f CEngDsT_t_f_Sq CEngUsT_t_f EngDa_tEng_f EnvP_p_f EnvT_t_f EnvT_t_f_Sq ExhMod_pRelPfilDs_f ExhMod_tExhCat1DsB1_f FuelT_t_f IntkAirT_t_f OilP_p_f OilSwmpT_t_f /end OUT_MEASUREMENT
 FUNCTION_VERSION "10.2.0" /end FUNCTION
/begin FUNCTION DELib_GlbArAdpr "2.0.0     Adapter for global MSR to AUTOSAR interfaces" /begin IN_MEASUREMENT BattU_facCor DevLib_stPwrStgEnaCond SyC_ctPostDrvLeave /end IN_MEASUREMENT FUNCTION_VERSION "2.0.0" /end FUNCTION
/begin FUNCTION DELib_GlbDef "31.6.0    DELib_GlbDef :" FUNCTION_VERSION "31.6.0" /end FUNCTION
/begin FUNCTION DELib_GlbDefAc "15.0.0    Autocode of Global Functions of DELib" FUNCTION_VERSION "15.0.0" /end FUNCTION
/begin FUNCTION DELib_GlbSrvAdvTstrSrvRels "4.0.0     Global Function for Advanced Tester Service release" FUNCTION_VERSION "4.0.0" /end FUNCTION
/begin FUNCTION DELib_GlbSrvDdReadFil "1.14.0    Global Function for Device Library Filter read" FUNCTION_VERSION "1.14.0" /end FUNCTION
/begin FUNCTION DELib_GlbSrvDesValCntr "2.0.0     Global Service for the Desired Value Counter" FUNCTION_VERSION "2.0.0" /end FUNCTION
/begin FUNCTION DELib_GlbSrvEcuModDetn "1.2.0     Function for ECU mode detection" FUNCTION_VERSION "1.2.0" /end FUNCTION
/begin FUNCTION DELib_GlbSrvElecDd "1.8.0     Internal Library for DELib Electrical Layer driving" FUNCTION_VERSION "1.8.0" /end FUNCTION
/begin FUNCTION DELib_GlbSrvFloat "2.0.0     Global Function for Float" FUNCTION_VERSION "2.0.0" /end FUNCTION
/begin FUNCTION DELib_GlbSrvGovrOutpRamp "1.0.0     Global Service Governor Output Ramp" FUNCTION_VERSION "1.0.0" /end FUNCTION
/begin FUNCTION DELib_GlbSrvGrdtLimn "4.0.0     DELib Service Library for gradient limitation" FUNCTION_VERSION "4.0.0" /end FUNCTION
/begin FUNCTION DELib_GlbSrvHldgILimn "1.9.0     Global Function for Holding Current Limitation" FUNCTION_VERSION "1.9.0" /end FUNCTION
/begin FUNCTION DELib_GlbSrvJamHeal "3.1.0     DELib Global Service Library for jam healing" FUNCTION_VERSION "3.1.0" /end FUNCTION
/begin FUNCTION DELib_GlbSrvObd "5.0.0     Global Function for On Board Diagnosis" FUNCTION_VERSION "5.0.0" /end FUNCTION
/begin FUNCTION DELib_GlbSrvPosnChgCntr "3.0.0     Global Service for the Position Change Counter" FUNCTION_VERSION "3.0.0" /end FUNCTION
/begin FUNCTION DELib_GlbSrvSnsrSeln "8.3.0     Global Function for Sensor Selection"
 /begin IN_MEASUREMENT Air_tEGRClrLPDs_f BrkBstP_p_f CEngDsT_t_f CEngUsT_t_f DELib_idxArrSnsr DELib_stArrSnsr DELib_xArrSnsr EngDa_tEng_f EnvP_p_f EnvT_t_f ExhMod_pRelPfilDs_f ExhMod_tExhCat1DsB1_f FuelT_t_f IntkAirT_t_f OilP_p_f OilSwmpT_t_f SyC_stSub T15_st /end IN_MEASUREMENT
 /begin OUT_MEASUREMENT DELib_numVar_mp DELib_num_mp DELib_stFirstPreDrvOverCopy /end OUT_MEASUREMENT
 FUNCTION_VERSION "8.3.0" /end FUNCTION
/begin FUNCTION DELib_GlbSrvSnsrSeln_Auto "" /begin OUT_MEASUREMENT DELib_idxArrSnsr DELib_stArrSnsr DELib_xArrSnsr /end OUT_MEASUREMENT /end FUNCTION
/begin FUNCTION DELib_GlbSrvSpFil "3.0.0     DELib Global Service Library for set-point filtering" FUNCTION_VERSION "3.0.0" /end FUNCTION
/begin FUNCTION DELib_GlbTst "1.17.0    Tester functions for the actuators configured in DELib" FUNCTION_VERSION "1.17.0" /end FUNCTION
/begin FUNCTION DELib_GovrDeMonLib "4.4.0     Library for Governor Deviation Monitoring" FUNCTION_VERSION "4.4.0" /end FUNCTION
/begin FUNCTION DELib_Pll "1.1.0     PLL - Phase Locked Loop" FUNCTION_VERSION "1.1.0" /end FUNCTION
/begin FUNCTION DELib_StcFctActr "1.1.0     Statistic Functions Actuator" FUNCTION_VERSION "1.1.0" /end FUNCTION
/begin FUNCTION DELib_VrntCodSimple "1.4.0     Simple Variant Coding" FUNCTION_VERSION "1.4.0" /end FUNCTION
/begin FUNCTION DemDcmIf "30000.14.0_2.0.0Dem-Dcm Interfaces" /begin IN_MEASUREMENT DFES_stOutstate DSMAUX_ctWUC DSMRdy_xPId1 DSMRdy_xPId41 /end IN_MEASUREMENT /begin OUT_MEASUREMENT Dem_disableEventStatusUpdateGroup /end OUT_MEASUREMENT
 /begin LOC_MEASUREMENT Dem_DTCFltForFltDetnCntr Dem_DTCFltFormat Dem_DTCFltOrigin Dem_DTCFltProcCnt Dem_DTCFltProcIdx Dem_DTCFltRecFormat Dem_DTCFltRecRsltIdx Dem_DTCFltRsltIdx Dem_DTCFltSeverity Dem_DTCFltSt Dem_DTCFltStatusMask Dem_DTCFltWithSev /end LOC_MEASUREMENT
 FUNCTION_VERSION "30000.14.0_2.0.0" /end FUNCTION
/begin FUNCTION DETHSDFC "13.2.0    Diagnosis ethanol sensor connection to fault code memory" /begin DEF_CHARACTERISTIC NETHSEOSC_C TDETHSE_C TDETHSF_C TDETHSPW_C TETHSEOSC_C /end DEF_CHARACTERISTIC /begin REF_CHARACTERISTIC FfPrm_stEna_C /end REF_CHARACTERISTIC
 /begin IN_MEASUREMENT BattU_stErrDSQ B_ethsemn_msg B_ethsemx_msg B_ethsen_msg B_ethsfmn_msg B_ethsfmx_msg B_ethsfsi_msg B_ethsnpl_msg B_ethsplh_msg B_ethspwmn_msg B_ethspwmx_msg B_ethspwsi_msg B_ethstnpl_msg B_ethstplh_msg B_fvdeths_msg DSM_TripChgFinshd ETHSCP_flgErrDrvCyc SyC_ctPostDrvLeave SyC_stSub /end IN_MEASUREMENT
 /begin OUT_MEASUREMENT B_ethseosc_msg /end OUT_MEASUREMENT
 /begin LOC_MEASUREMENT DETHSDFC_ctReIni /end LOC_MEASUREMENT
 FUNCTION_VERSION "13.2.0" /end FUNCTION
/begin FUNCTION DevLib_DigOutErrHndlr "1.147.0   Digital Output Error handling module" /begin DEF_CHARACTERISTIC DevLib_DigOutDbgSig_C /end DEF_CHARACTERISTIC
 /begin LOC_MEASUREMENT DevLib_stDigOutErr_mp DevLib_stDigOutPrevTst_mp DevLib_stDigOutTstImp_mp /end LOC_MEASUREMENT
 FUNCTION_VERSION "1.147.0" /end FUNCTION
/begin FUNCTION DevLib_PhysRngChk "1.145.0   Device library for physical range check" FUNCTION_VERSION "1.145.0" /end FUNCTION
/begin FUNCTION DevLib_PsDiag "1.148.0   Common part of Digital and PWM powerstage diagnosis" FUNCTION_VERSION "1.148.0" /end FUNCTION
/begin FUNCTION DevLib_PWMOutErrHndlr "100.1.0   PWM Output error handling module" /begin DEF_CHARACTERISTIC DevLib_PWMOutDbgSig_C /end DEF_CHARACTERISTIC
 /begin LOC_MEASUREMENT DevLib_stPWMOutErr_mp DevLib_stPWMOutPrevTst_mp DevLib_stPWMOutTstImp_mp /end LOC_MEASUREMENT
 FUNCTION_VERSION "100.1.0" /end FUNCTION
/begin FUNCTION DevLib_PwrStgState "100.7.0   Power Stage State"
 /begin DEF_CHARACTERISTIC Devlib_PsDisbl.facLowHysLo_C Devlib_PsDisbl.facLowHysHi_C Devlib_PsDisbl.facHighHysLo_C Devlib_PsDisbl.facHighHysHi_C Devlib_PwrStg.BattLoHysLo_C Devlib_PwrStg.BattLoHysHi_C Devlib_PwrStg.BattHiHysLo_C Devlib_PwrStg.BattHiHysHi_C /end DEF_CHARACTERISTIC
 /begin IN_MEASUREMENT BattU_facCor BattU_u DSM_TripChgFinshd MoCSOP_stRdy MoCSOP_stRdyMsg SyC_stSub /end IN_MEASUREMENT
 /begin OUT_MEASUREMENT DevLib_stPwrStgEnaCond /end OUT_MEASUREMENT
 FUNCTION_VERSION "100.7.0" /end FUNCTION
/begin FUNCTION DevLib_SRC "1.145.0   Device Library electrical Signal Range Check" FUNCTION_VERSION "1.145.0" /end FUNCTION
/begin FUNCTION DevLib_TransStage "1.149.0   Device Library Transition Stage for sensor replacement values" FUNCTION_VERSION "1.149.0" /end FUNCTION
/begin FUNCTION DFC "30000.33.0_1.1.0Diagnostic Fault Check"
 /begin OUT_MEASUREMENT DFC_b.TST_AAVEmax DFC_b.TST_AAVEmin DFC_b.TST_AAVEsig DFC_b.TST_AltIOACGFailr DFC_b.TST_AltIOACGHiVltg DFC_b.TST_AltIOACGLoVltg DFC_b.TST_AltIOACGTHi DFC_b.TST_AltIODConnACG DFC_b.TST_BGOELWAF DFC_b.TST_BattUHiFailr DFC_b.TST_BattULoFailr DFC_b.TST_BrkBstPDriftHiErr DFC_b.TST_BrkBstPDriftLoErr DFC_b.TST_BrkBstPSnsrStuck DFC_b.TST_BrkMnSwtContOn DFC_b.TST_BrkMnSwtNotStp DFC_b.TST_BrkNpl DFC_b.TST_BrkRdntSwtContOn DFC_b.TST_BrkRdntSwtNotStp DFC_b.TST_Clth3ONStuck DFC_b.TST_Clth4OFFStuck DFC_b.TST_ClthOFFStuck DFC_b.TST_ClthONStuck DFC_b.TST_ClthStkFailInfo DFC_b.TST_ComACFailInfo DFC_b.TST_ComATFTValErr DFC_b.TST_ComATMILReq DFC_b.TST_ComAYCAChksum DFC_b.TST_ComAYCARingCnt DFC_b.TST_ComAYCATOut DFC_b.TST_ComAYCDChkSum DFC_b.TST_ComAYCDTOut DFC_b.TST_ComAYCFChksum DFC_b.TST_ComAYCFRingCnt DFC_b.TST_ComAYCFTOut DFC_b.TST_ComAYCGChksum DFC_b.TST_ComAYCGRingCnt DFC_b.TST_ComAYCGTOut DFC_b.TST_ComAYCIChkSum DFC_b.TST_ComAYCIRingCnt DFC_b.TST_ComAYCITOut DFC_b.TST_ComBCM1ChkSum DFC_b.TST_ComBCM1RingCnt DFC_b.TST_ComBCM1TOut DFC_b.TST_ComCANABusOffErr DFC_b.TST_ComCANBBusOffErr DFC_b.TST_ComCANCBusOffErr DFC_b.TST_ComCGW1ChkSum DFC_b.TST_ComCGW1RingCnt DFC_b.TST_ComCGW1TOut DFC_b.TST_ComConvBoostErr DFC_b.TST_ComConvSlipErr DFC_b.TST_ComDCDCPrfmncErr DFC_b.TST_ComDCDCTempWarn DFC_b.TST_ComEAT10Chksum DFC_b.TST_ComEAT10RingCnt DFC_b.TST_ComEAT10TOut DFC_b.TST_ComEAT11ChkSum DFC_b.TST_ComEAT11RingCnt DFC_b.TST_ComEAT11TOut DFC_b.TST_ComEAT12ChkSum DFC_b.TST_ComEAT12RingCnt DFC_b.TST_ComEAT12TOut DFC_b.TST_ComEAT13ChkSum DFC_b.TST_ComEAT13RingCnt DFC_b.TST_ComEAT13TOut DFC_b.TST_ComEAT1Chksum DFC_b.TST_ComEAT1RingCnt DFC_b.TST_ComEAT1TOut DFC_b.TST_ComEAT2ChkSum DFC_b.TST_ComEAT2RingCnt DFC_b.TST_ComEAT2TOut DFC_b.TST_ComEAT4ChkSum DFC_b.TST_ComEAT4RingCnt DFC_b.TST_ComEAT4TOut DFC_b.TST_ComEAT6Chksum DFC_b.TST_ComEAT6RingCnt DFC_b.TST_ComEAT6TOut DFC_b.TST_ComEAT7Chksum DFC_b.TST_ComEAT7RingCnt DFC_b.TST_ComEAT7TOut DFC_b.TST_ComEAT8Chksum DFC_b.TST_ComEAT8RingCnt DFC_b.TST_ComEAT8TOut DFC_b.TST_ComEATAChksum DFC_b.TST_ComEATARingCnt DFC_b.TST_ComEATATOut DFC_b.TST_ComEATBChkSum DFC_b.TST_ComEATBRingCnt DFC_b.TST_ComEATBTOut DFC_b.TST_ComEATCChksum DFC_b.TST_ComEATCRingCnt DFC_b.TST_ComEATCTOut DFC_b.TST_ComEPBBChkSum DFC_b.TST_ComEPBBRingCnt DFC_b.TST_ComEPBBTOut DFC_b.TST_ComEPBChksum DFC_b.TST_ComEPBTOut DFC_b.TST_ComEPBctRing DFC_b.TST_ComEPS1Chksum DFC_b.TST_ComEPS1RingCnt DFC_b.TST_ComEPS1TOut DFC_b.TST_ComEngCanRxErr DFC_b.TST_ComGrvySnsrErr DFC_b.TST_ComGwIMG1ChkSum DFC_b.TST_ComGwIMG1RingCnt DFC_b.TST_ComGwIMG1TOut DFC_b.TST_ComGwIMG3ChkSum DFC_b.TST_ComGwIMG3RingCnt DFC_b.TST_ComGwIMG3TOut DFC_b.TST_ComGwIMG4ChkSum DFC_b.TST_ComGwIMG4RingCnt DFC_b.TST_ComGwIMG4TOut DFC_b.TST_ComGwIMG5ChkSum DFC_b.TST_ComGwIMG5RingCnt DFC_b.TST_ComGwIMG5TOut DFC_b.TST_ComGwIMG6ChkSum DFC_b.TST_ComGwIMG6RingCnt DFC_b.TST_ComGwIMG6TOut DFC_b.TST_ComIDASBChksum DFC_b.TST_ComIDASBRingCnt DFC_b.TST_ComIDASBTOut DFC_b.TST_ComIMGMILReq DFC_b.TST_ComISSPrms DFC_b.TST_ComMETAChksum DFC_b.TST_ComMETAChksumPstDrv DFC_b.TST_ComMETARingCnt DFC_b.TST_ComMETARingCntPstDrv DFC_b.TST_ComMETATOut DFC_b.TST_ComMETATOutPstDrv DFC_b.TST_ComMETCChksum DFC_b.TST_ComMETCRingCnt DFC_b.TST_ComMETCTOut DFC_b.TST_ComMETDChksum DFC_b.TST_ComMETDRingCnt DFC_b.TST_ComMETDTOut DFC_b.TST_ComMETE2Chksum DFC_b.TST_ComMETE2RingCnt DFC_b.TST_ComMETE2TOut DFC_b.TST_ComMETFChksum DFC_b.TST_ComMETFRingCnt DFC_b.TST_ComMETFTOut DFC_b.TST_ComMETGChksum DFC_b.TST_ComMETGRingCnt DFC_b.TST_ComMETGTOut DFC_b.TST_ComMETH2Chksum DFC_b.TST_ComMETH2RingCnt DFC_b.TST_ComMETH2TOut DFC_b.TST_ComMETHChksum DFC_b.TST_ComMETHRingCnt DFC_b.TST_ComMETHTOut DFC_b.TST_ComMETIChksum DFC_b.TST_ComMETIRingCnt DFC_b.TST_ComMETITOut DFC_b.TST_ComMETKChksum DFC_b.TST_ComMETKRingCnt DFC_b.TST_ComMETKTOut DFC_b.TST_ComMETLChksum DFC_b.TST_ComMETLRingCnt DFC_b.TST_ComMETLTOut DFC_b.TST_ComMETMChksum DFC_b.TST_ComMETMRingCnt DFC_b.TST_ComMETMTOut DFC_b.TST_ComMETNChksum DFC_b.TST_ComMETNRingCnt DFC_b.TST_ComMETNTOut DFC_b.TST_ComMtrCom DFC_b.TST_ComPCUChkSum DFC_b.TST_ComPCURingCnt DFC_b.TST_ComPCUTOut DFC_b.TST_ComSRSAChksum DFC_b.TST_ComSRSARingCnt DFC_b.TST_ComSRSATOut DFC_b.TST_ComSRSBChksum DFC_b.TST_ComSRSBRingCnt DFC_b.TST_ComSRSBTOut DFC_b.TST_ComSRSChksum DFC_b.TST_ComSRSErr DFC_b.TST_ComSRSRingCnt DFC_b.TST_ComSRSTOut DFC_b.TST_ComVehSpdPndFltTCU DFC_b.TST_EbsChartcCurrErr DFC_b.TST_EbsSelfDiagErr DFC_b.TST_GEVlvPhaCsersIntkB1 DFC_b.TST_GEVlvPhaPsOpenLoadIntkB1 DFC_b.TST_GEVlvPhaPsShoToBattIntkB1 DFC_b.TST_GEVlvPhaPsShoToGndIntkB1 DFC_b.TST_GbxCANDigPlausErr DFC_b.TST_GbxNPos1SRCMax DFC_b.TST_GbxNPos1SRCMin DFC_b.TST_GbxNPos2SRCMax DFC_b.TST_GbxNPos2SRCMin DFC_b.TST_GbxNPosAlvChk DFC_b.TST_GbxNPosSyncErr DFC_b.TST_HEGOS2B1HtrPsMax DFC_b.TST_HEGOS2B1HtrPsMin DFC_b.TST_HEGOS2B1HtrPsSig DFC_b.TST_LinCSErrACG DFC_b.TST_LinCSErrAEV DFC_b.TST_LinCSErrDCDC DFC_b.TST_LinCSErrEBS DFC_b.TST_LinHdrTimeoutErrACG DFC_b.TST_LinHdrTimeoutErrAEV DFC_b.TST_LinHdrTimeoutErrDCDC DFC_b.TST_LinHdrTimeoutErrEBS DFC_b.TST_LinMsgTimeoutErrACG DFC_b.TST_LinMsgTimeoutErrAEV DFC_b.TST_LinMsgTimeoutErrDCDC DFC_b.TST_LinMsgTimeoutErrEBS DFC_b.TST_LinNoStrtComErr DFC_b.TST_LowPresOilP DFC_b.TST_MisfDetVWhlFrntLeOORHi DFC_b.TST_MisfDetVWhlFrntLeRatyHi DFC_b.TST_MisfDetVWhlFrntLeRatyLo DFC_b.TST_MisfDetVWhlFrntLeStuck DFC_b.TST_MisfDetVWhlFrntRiOORHi DFC_b.TST_MisfDetVWhlFrntRiRatyHi DFC_b.TST_MisfDetVWhlFrntRiRatyLo DFC_b.TST_MisfDetVWhlFrntRiStuck DFC_b.TST_MisfDetVWhlReLeOORHi DFC_b.TST_MisfDetVWhlReLeRatyHi DFC_b.TST_MisfDetVWhlReLeRatyLo DFC_b.TST_MisfDetVWhlReLeStuck DFC_b.TST_MisfDetVWhlReRiOORHi DFC_b.TST_MisfDetVWhlReRiRatyHi DFC_b.TST_MisfDetVWhlReRiRatyLo DFC_b.TST_MisfDetVWhlReRiStuck DFC_b.TST_MisfDetdVWhlFrntLePlaus DFC_b.TST_MisfDetdVWhlFrntRiPlaus DFC_b.TST_MisfDetdVWhlReLePlaus DFC_b.TST_MisfDetdVWhlReRiPlaus DFC_b.TST_PEnvSigRngMax DFC_b.TST_PEnvSigRngMin DFC_b.TST_StmFault DFC_b.TST_StrtCtOffPth DFC_b.TST_StrtCtlErr DFC_b.TST_StrtFault DFC_b.TST_StrtLckJudg1 DFC_b.TST_StrtLckJudg2 DFC_b.TST_StrtOL DFC_b.TST_StrtOL2 DFC_b.TST_StrtSCB DFC_b.TST_StrtSCB2 DFC_b.TST_StrtSCG DFC_b.TST_StrtSCG2 DFC_b.TST_StrtStkRly1 DFC_b.TST_StrtStkRly2 DFC_b.TST_TEVEmax DFC_b.TST_TEVEmin DFC_b.TST_TEVEsig DFC_b.TST_UegoHeatrPrfmncLoS1B1 DFC_b.TST_VehVAllPlaus DFC_b.TST_VehVNCSnsrElecFailr DFC_b.TST_VehVPlausCan DFC_b.TST_VehVPlausFco DFC_b.TST_VehVPlausPwr DFC_b.TST_VehVPlausV2N DFC_b.TST_VehVSpdSnsrAElecFailr DFC_b.TST_VehVSpdSnsrBElecFailr DFC_b.TST_ClthMax DFC_b.TST_IgnClPs_DevComErr DFC_b.TST_IgnClPs_LineOl_0 DFC_b.TST_IgnClPs_LineOl_1 DFC_b.TST_IgnClPs_LineOl_2 DFC_b.TST_IgnClPs_LineOl_3 DFC_b.TST_IgnClPs_LineScb_0 DFC_b.TST_IgnClPs_LineScb_1 DFC_b.TST_IgnClPs_LineScb_2 DFC_b.TST_IgnClPs_LineScb_3 DFC_b.TST_IgnClPs_LineScg_0 DFC_b.TST_IgnClPs_LineScg_1 DFC_b.TST_IgnClPs_LineScg_2 DFC_b.TST_IgnClPs_LineScg_3 DFC_b.TST_KRVEKOEVAB DFC_b.TST_KRVEKOEVAB0 DFC_b.TST_KRVEKOEVAB1 DFC_b.TST_KRVEKOEVAB2 DFC_b.TST_KRVEKOEVAB3 DFC_b.TST_UegoSigEcuAsicS1B1 DFC_b.TST_UegoSigEcuComS1B1 DFC_b.TST_UegoSigSnsrS1B1 DFC_b.TST_UegoSigWireOlApesS1B1 DFC_b.TST_UegoSigWireOlIpeS1B1 DFC_b.TST_UegoSigWireOlReS1B1 DFC_b.TST_UegoSigWireRCmpS1B1 DFC_b.TST_UegoSigWireScbS1B1 DFC_b.TST_UegoSigWireScgS1B1 DFC_b.TST_AfsPhyRngHiB1 DFC_b.TST_AfsPhyRngLoB1 DFC_b.TST_AirCCmprOL DFC_b.TST_AirCCmprOvrTemp DFC_b.TST_AirCCmprSCB DFC_b.TST_AirCCmprSCG DFC_b.TST_AltErr DFC_b.TST_BattUSRCMax DFC_b.TST_BattUSRCMin DFC_b.TST_ComChksTCU1 DFC_b.TST_ComChksTCU11 DFC_b.TST_ComChksTCU12 DFC_b.TST_ComChksTCU13 DFC_b.TST_ComChksTCU2 DFC_b.TST_ComChksTCU3 DFC_b.TST_ComChksTCU4 DFC_b.TST_ComCntTCU1 DFC_b.TST_ComCntTCU11 DFC_b.TST_ComCntTCU12 DFC_b.TST_ComCntTCU13 DFC_b.TST_ComCntTCU2 DFC_b.TST_ComCntTCU3 DFC_b.TST_ComCntTCU4 DFC_b.TST_ComTOutTCU01 DFC_b.TST_ComTOutTCU02 DFC_b.TST_ComTOutTCU1 DFC_b.TST_ComTOutTCU11 DFC_b.TST_ComTOutTCU12 DFC_b.TST_ComTOutTCU13 DFC_b.TST_ComTOutTCU14 DFC_b.TST_ComTOutTCU2 DFC_b.TST_ComTOutTCU3 DFC_b.TST_ComTOutTCU4 DFC_b.TST_DevLibBattUHi DFC_b.TST_DevLibBattULo DFC_b.TST_EGRVlvFailSafeActv DFC_b.TST_EGRVlvGovDvtCld DFC_b.TST_EGRVlvPhysSRCMax DFC_b.TST_EGRVlvPhysSRCMin DFC_b.TST_FanDIOOL_0 DFC_b.TST_FanDIOOL_1 DFC_b.TST_FanDIOOvrTemp_0 DFC_b.TST_FanDIOOvrTemp_1 DFC_b.TST_FanDIOSCB_0 DFC_b.TST_FanDIOSCB_1 DFC_b.TST_FanDIOSCG_0 DFC_b.TST_FanDIOSCG_1 DFC_b.TST_MRlyDcOL DFC_b.TST_MRlyDcSCB DFC_b.TST_MRlyDcSCG DFC_b.TST_PSPOL DFC_b.TST_PSPOvrTemp DFC_b.TST_PSPSCB DFC_b.TST_PSPSCG DFC_b.TST_T50Err DFC_b.TST_ThrVlvLoBattB1 DFC_b.TST_UegoSigOperPlausS1B1 DFC_b.TST_VehVPhysRngHi DFC_b.TST_VehVSclOutOL DFC_b.TST_VehVSclOutOT DFC_b.TST_VehVSclOutSCB DFC_b.TST_VehVSclOutSCG DFC_b.TST_VehVSigFL DFC_b.TST_VehVSigFR DFC_b.TST_VehVSigRL DFC_b.TST_VehVSigRR DFC_b.TST_VehVSnsrARngHi DFC_b.TST_VehVSnsrBRngHi DFC_b.TST_VehVSpdRtyDiag DFC_b.TST_DHFHD DFC_b.TST_InjVlv_DI_DcDc DFC_b.TST_InjVlv_DI_NoLd_0 DFC_b.TST_InjVlv_DI_NoLd_1 DFC_b.TST_InjVlv_DI_NoLd_2 DFC_b.TST_InjVlv_DI_NoLd_3 DFC_b.TST_InjVlv_DI_ScBnk_0 DFC_b.TST_InjVlv_DI_ScBnk_1 DFC_b.TST_InjVlv_DI_ScBnk_2 DFC_b.TST_InjVlv_DI_ScBnk_3 DFC_b.TST_InjVlv_DI_ScCyl_0 DFC_b.TST_InjVlv_DI_ScCyl_1 DFC_b.TST_InjVlv_DI_ScCyl_2 DFC_b.TST_InjVlv_DI_ScCyl_3 DFC_b.TST_InjVlv_DI_ScHsLs_0 DFC_b.TST_InjVlv_DI_ScHsLs_1 DFC_b.TST_InjVlv_DI_ScHsLs_2 DFC_b.TST_InjVlv_DI_ScHsLs_3 DFC_b.TST_MfPsDiaOpenLoad1 DFC_b.TST_MfPsDiaScHiS1 DFC_b.TST_MfPsDiaScHiSLowS1 DFC_b.TST_MfPsDiaScLowS1 DFC_b.TST_ACEvpTPhysRngHi DFC_b.TST_ACEvpTPhysRngLo DFC_b.TST_ACEvpTSRCMax DFC_b.TST_ACEvpTSRCMin DFC_b.TST_AfsRawSigRngHiB1 DFC_b.TST_AfsRawSigRngLoB1 DFC_b.TST_AfsSnsrErrB1 DFC_b.TST_AirCClntPAnaSRCMax DFC_b.TST_AirCClntPAnaSRCMin DFC_b.TST_AirCSwtNpl DFC_b.TST_AirCSwtSig DFC_b.TST_Brk DFC_b.TST_BrkBstSensSCB DFC_b.TST_BrkBstSensSCG DFC_b.TST_BrkSig DFC_b.TST_ClthSig DFC_b.TST_EGRVlvCurrLim DFC_b.TST_EGRVlvOL DFC_b.TST_EGRVlvOvrTemp DFC_b.TST_EGRVlvSCB DFC_b.TST_EGRVlvSCG DFC_b.TST_EGRVlvSRCMax DFC_b.TST_EGRVlvSRCMin DFC_b.TST_HLSDemOvhtEngLim DFC_b.TST_OilPSwmpSRCMax DFC_b.TST_OilPSwmpSRCMin DFC_b.TST_PIntkVUsLineHiB1 DFC_b.TST_PIntkVUsLineLoB1 DFC_b.TST_VehVPhysRngLo DFC_b.TST_VehVSigCan DFC_b.TST_VehVSigCanSafe DFC_b.TST_VlvLftFbOilPSnsrIntk11SRCMax DFC_b.TST_VlvLftFbOilPSnsrIntk11SRCMin DFC_b.TST_ClthNpl DFC_b.TST_GbxPNPosnDrvCdn DFC_b.TST_GbxPNPosnPlausy DFC_b.TST_AfsSigErrLineHiB1 DFC_b.TST_AfsSigErrLineLoB1 DFC_b.TST_PEnvCcMax DFC_b.TST_PEnvCcMin DFC_b.TST_PEnvRngChkMax DFC_b.TST_PEnvRngChkMin DFC_b.TST_PEnvSnsrPlaus DFC_b.TST_UEGOHeatrRlyPsOLS1B1 DFC_b.TST_UEGOHeatrRlyPsSCBS1B1 DFC_b.TST_UEGOHeatrRlyPsSCGS1B1 DFC_b.TST_UegoHeatrWireOlS1B1 DFC_b.TST_UegoHeatrWireScbS1B1 DFC_b.TST_UegoHeatrWireScgS1B1 DFC_b.TST_KnDetSens1PortAMax DFC_b.TST_KnDetSens1PortAMin DFC_b.TST_KnDetSens1PortBMax DFC_b.TST_KnDetSens1PortBMin DFC_b.TST_Clth2ONStuck DFC_b.TST_Clth2ONStuckLdc DFC_b.TST_Clth3ONStuckLdc DFC_b.TST_Clth3ONStuckPostDrv DFC_b.TST_Clth4ONStuck DFC_b.TST_Clth4ONStuckLdc DFC_b.TST_ComBCMUnit DFC_b.TST_ComDLCTCU01 DFC_b.TST_ComDLCTCU02 DFC_b.TST_ComDLCTCU1 DFC_b.TST_ComDLCTCU11 DFC_b.TST_ComDLCTCU12 DFC_b.TST_ComDLCTCU13 DFC_b.TST_ComDLCTCU14 DFC_b.TST_ComDLCTCU2 DFC_b.TST_ComDLCTCU3 DFC_b.TST_ComDLCTCU4 DFC_b.TST_ComEPSUnit DFC_b.TST_ComIDASBUnit DFC_b.TST_ComIMGUnit DFC_b.TST_ComMETUnit DFC_b.TST_ComSRSUnit DFC_b.TST_ComVSAUnit DFC_b.TST_EbsSocFlt DFC_b.TST_I14229VINErr DFC_b.TST_InjCatHeatgErr DFC_b.TST_InjSysMulInjDiagErr DFC_b.TST_LLRHmax DFC_b.TST_LLRHmin DFC_b.TST_LLRHnpl DFC_b.TST_LLRKHmax DFC_b.TST_LLRKHmin DFC_b.TST_LLRKHnpl DFC_b.TST_LinACGUnit DFC_b.TST_LinAEVUnit DFC_b.TST_LinEBSUnit DFC_b.TST_RoughRoad DFC_b.TST_SiaEEPRdErr DFC_b.TST_SiaEEPWrngCod DFC_b.TST_UegoHeatrStrtS1B1 DFC_b.TST_BusDiagCANAPPLBusOff DFC_b.TST_BusDiagCANCANCBusOff DFC_b.TST_BusDiagCANVEHICLEBusOff DFC_b.TST_RBA_IODIAGPWR_rba_IoExtCy329_SignalVltSply_0 DFC_b.TST_RBA_IODIAGPWR_rba_IoExtCy329_SignalVltSply_0OT DFC_b.TST_RBA_IODIAGPWR_rba_IoExtCy329_SignalVltSply_0OV DFC_b.TST_RBA_IODIAGPWR_rba_IoExtCy329_SignalVltSply_0SCG DFC_b.TST_RBA_IODIAGPWR_rba_IoExtCy329_SignalVltSply_0UV DFC_b.TST_RBA_IODIAGPWR_rba_IoExtCy329_SignalVltSply_1 DFC_b.TST_RBA_IODIAGPWR_rba_IoExtCy329_SignalVltSply_1OT DFC_b.TST_RBA_IODIAGPWR_rba_IoExtCy329_SignalVltSply_1OV DFC_b.TST_RBA_IODIAGPWR_rba_IoExtCy329_SignalVltSply_1SCG DFC_b.TST_RBA_IODIAGPWR_rba_IoExtCy329_SignalVltSply_1UV DFC_b.TST_RBA_IODIAGPWR_rba_IoExtCy329_SignalVltSply_2 DFC_b.TST_RBA_IODIAGPWR_rba_IoExtCy329_SignalVltSply_2OT DFC_b.TST_RBA_IODIAGPWR_rba_IoExtCy329_SignalVltSply_2OV DFC_b.TST_RBA_IODIAGPWR_rba_IoExtCy329_SignalVltSply_2SCG DFC_b.TST_RBA_IODIAGPWR_rba_IoExtCy329_SignalVltSply_2UV DFC_b.TST_CAN_E_TIMEOUT DFC_b.TST_LIN_E_TIMEOUT DFC_b.TST_MRlyOL DFC_b.TST_MRlySCB DFC_b.TST_MRlySCG DFC_b.TST_rba_MultiStackTrace_Threshold DFC_b.TST_BSWM_E_ACTION_FAILED DFC_b.TST_BSWM_E_INTRPTQUEUE_FULL DFC_b.TST_RBA_IOEXTLIB_KEEPALIVE_DRV DFC_b.TST_RBA_IOEXTLIB_KEEPALIVE_INI DFC_b.TST_rba_IoSigRtc_StopCounter DFC_b.TST_rba_MRly_Diag_Stk_Event DFC_b.TST_rba_MemDiag_MemReadErr DFC_b.TST_rba_MemDiag_MemWrErr DFC_b.TST_rba_SyC_IrrSwOffTrigEngRun_Event DFC_b.TST_rba_T15_Diag_ComInVld_Event DFC_b.TST_rba_T15_Diag_ComOff_HwOn_Event DFC_b.TST_rba_T15_Diag_ComOn_HwOff_Event DFC_b.TST_AAVmin DFC_b.TST_AGRSUS DFC_b.TST_AfsPlausDiagHi DFC_b.TST_AfsPlausDiagLo DFC_b.TST_AfsVrntDiagErrB1 DFC_b.TST_AppAllSnsrDfct DFC_b.TST_BBKRnldg DFC_b.TST_BBKRsyne DFC_b.TST_BattUStdbyDiaOL DFC_b.TST_BigLeakIntkMnfldEmiInfl DFC_b.TST_BlkdLineTank DFC_b.TST_BrkMnSwtContOnWarnLmp DFC_b.TST_BrkMnSwtNotStpWarnLmp DFC_b.TST_BrkRdntSwtContOnWarnLmp DFC_b.TST_BrkRdntSwtNotStpWarnLmp DFC_b.TST_CEngDsTColdStrtMax DFC_b.TST_CEngDsTColdStrtMin DFC_b.TST_CEngDsTImps DFC_b.TST_CEngDsTPlausHSC DFC_b.TST_CEngDsTPlausLSC DFC_b.TST_CEngDsTPlausSTC DFC_b.TST_CEngDsTSRCMax DFC_b.TST_CEngDsTSRCMin DFC_b.TST_CEngDsTSig DFC_b.TST_CEngUsTColdStrtMax DFC_b.TST_CEngUsTColdStrtMin DFC_b.TST_CEngUsTLooseCnctn DFC_b.TST_CEngUsTSRCMax DFC_b.TST_CEngUsTSRCMin DFC_b.TST_ComDCDCACCFailr DFC_b.TST_DCDCFltDet DFC_b.TST_DKRSA DFC_b.TST_DKVSmax DFC_b.TST_DKnpl DFC_b.TST_DSKVRmax DFC_b.TST_DSKVRmin DFC_b.TST_DSKVRnpl DFC_b.TST_DSKVRsig DFC_b.TST_DSKVSsig DFC_b.TST_DSSmax DFC_b.TST_DSTDmax DFC_b.TST_DSTEmax DFC_b.TST_DSTEmin DFC_b.TST_DSTOFmax DFC_b.TST_DSTRmax DFC_b.TST_DSTRmin DFC_b.TST_DSTRnpl DFC_b.TST_DSTRsig DFC_b.TST_DSTTI DFC_b.TST_DSUmax DFC_b.TST_DiagCpv1DteskLoLoadStuckClsd DFC_b.TST_DiagCpv1DteskLoLoadStuckOpen DFC_b.TST_EGRVlvDrftClsd DFC_b.TST_EGRVlvDrftOpn DFC_b.TST_EGRVlvJamVlvClsd DFC_b.TST_EGRVlvJamVlvOpn DFC_b.TST_EGRVlvSprgBrk DFC_b.TST_EGRVlvTempMdlEEPErr DFC_b.TST_EGRVlvTmpErr DFC_b.TST_EGSDUS2B1LtrDly DFC_b.TST_EGSDUS2B1LtrPT1 DFC_b.TST_EGSDUS2B1RtlDly DFC_b.TST_EGSDUS2B1RtlPT1 DFC_b.TST_EGSDUS2B1TarLean DFC_b.TST_EGSDUS2B1TarRich DFC_b.TST_EONVmax DFC_b.TST_ETAKHLmax DFC_b.TST_ETAKHTmax DFC_b.TST_ETHSEmax DFC_b.TST_ETHSEmin DFC_b.TST_ETHSFmax DFC_b.TST_ETHSFmin DFC_b.TST_ETHSFsig DFC_b.TST_ETHSNPWmax DFC_b.TST_ETHSNPWmin DFC_b.TST_ETHSNPWsig DFC_b.TST_ETHSPLnpl DFC_b.TST_ETHSTPLnpl DFC_b.TST_EngICO DFC_b.TST_EngPrtOvrSpdMon DFC_b.TST_EpmCaSI1ErrSig DFC_b.TST_EpmCaSI1MntErr DFC_b.TST_EpmCaSI1NoSigMax DFC_b.TST_EpmCaSI1NoSigMin DFC_b.TST_EpmCaSI1OfsErr DFC_b.TST_EpmCrSDGI DFC_b.TST_EpmCrSErrSig DFC_b.TST_EpmCrSNoSig DFC_b.TST_EtaEngIdleNonCsers DFC_b.TST_EtaEngPtlNonCsers DFC_b.TST_FRAmax DFC_b.TST_FRAmin DFC_b.TST_FSTEmax DFC_b.TST_FSTEmin DFC_b.TST_FSTRmax DFC_b.TST_FSTRmin DFC_b.TST_FSTRnpl DFC_b.TST_FSTmax DFC_b.TST_FTDLAmax DFC_b.TST_FTDLAmin DFC_b.TST_FuPHiSnsrEleclmax DFC_b.TST_FuPHiSnsrEleclmin DFC_b.TST_FuPHiSnsrEleclnpl DFC_b.TST_FuPHiSnsrURngMax DFC_b.TST_FuPHiSnsrURngMin DFC_b.TST_FuSnsrPhyRngMaxErr DFC_b.TST_FuSnsrPhyRngMinErr DFC_b.TST_GEVlvLockPinDiagIntkB1 DFC_b.TST_GEVlvPhaSlowIntkB1 DFC_b.TST_GEVlvPhaTargIntkB1 DFC_b.TST_GbxRvsSwtStk DFC_b.TST_HDRKHmax DFC_b.TST_HDRKHmin DFC_b.TST_HDRPLmax DFC_b.TST_HDRPLmin DFC_b.TST_HDRmax DFC_b.TST_HDRmin DFC_b.TST_HEGOS2B1ElecMax DFC_b.TST_HEGOS2B1ElecMin DFC_b.TST_HEGOS2B1ElecSig DFC_b.TST_HEGOS2B1HtgNpl DFC_b.TST_HEV00max DFC_b.TST_HEV01max DFC_b.TST_HEV02max DFC_b.TST_HEV03max DFC_b.TST_HEVE0max DFC_b.TST_HEVE1max DFC_b.TST_HFMmax DFC_b.TST_HiPSysHiPMaxLimExcdd DFC_b.TST_IVGdiCtlCvoErrMax_0 DFC_b.TST_IVGdiCtlCvoErrMax_1 DFC_b.TST_IVGdiCtlCvoErrMax_2 DFC_b.TST_IVGdiCtlCvoErrMax_3 DFC_b.TST_IVGdiCtlCvoErrMin_0 /end OUT_MEASUREMENT
 FUNCTION_VERSION "30000.33.0_1.1.0" /end FUNCTION
/begin COMPU_METHOD B_TRUE "" TAB_VERB "%6.3" "" COMPU_TAB_REF B_TRUE /end COMPU_METHOD
/begin COMPU_VTAB B_TRUE "" TAB_VERB 2 0 "FALSE" 1 "TRUE" /end COMPU_VTAB
/begin COMPU_METHOD Dem_DTCFltSt_Verb "" TAB_VERB "%6.3" "-" COMPU_TAB_REF Dem_DTCFltSt_Verb /end COMPU_METHOD
/begin COMPU_VTAB Dem_DTCFltSt_Verb "" TAB_VERB 6 0 "IDLE" 1 "UDS_ENTRIES_PENDING" 2 "UDS_DTCS_PENDING" 3 "UDS_ENTRIES_RSLT" 4 "OBD_ENTRIES_RSLT" 5 "UDS_DTCS_RSLT" /end COMPU_VTAB
/begin COMPU_METHOD dez "" RAT_FUNC "%6.2" "" COEFFS 0 1 0 0 0 1 /end COMPU_METHOD
/begin COMPU_METHOD DFC_OneToOne "" RAT_FUNC "%6.2" "-" COEFFS 0 1 0 0 0 1 /end COMPU_METHOD
/begin COMPU_METHOD ELDEV_DSQACTVT_SC_Compu "" TAB_VERB "%6.3" "" COMPU_TAB_REF ELDEV_DSQACTVT_SC_Compu /end COMPU_METHOD
/begin COMPU_VTAB ELDEV_DSQACTVT_SC_Compu "" TAB_VERB 2 0 "Inactive" 1 "Active" /end COMPU_VTAB
/begin COMPU_METHOD ELDEV_VAR_SY_Compu "" TAB_VERB "%6.3" "" COMPU_TAB_REF ELDEV_VAR_SY_Compu /end COMPU_METHOD
/begin COMPU_VTAB ELDEV_VAR_SY_Compu "" TAB_VERB 44 1 "DAI" 3 "VWW" 4 "POR" 5 "AUD" 6 "OPE" 9 "FIA" 11 "BMW" 14 "PSA" 15 "REN" 17 "ALF" 18 "SAB" 19 "VOL" 20 "NIS" 21 "GMU" 22 "FOR" 26 "IMJ" 51 "SEA" 53 "CHR" 54 "JAG" 55 "ROL" 69 "FER" 72 "TOY" 123 "MIT" 147 "HYU" 159 "HON" 160 "MAZ" 183 "CU" 190 "LRG" 204 "VVW" 214 "AVT" 242 "Iveco" 243 "DMC" 248 "SUZ" 267 "SSANGYONG" 270 "KEF" 289 "AMG" 308 "TAT" 319 "MVM" 385 "UAES" 590 "Scania" 828 "RBCD" 999 "ALL" 2887 "Nonox" 9454 "Fuso" /end COMPU_VTAB
/begin COMPU_METHOD ELECCMPRPRSNT_SC_Compu "" TAB_VERB "%6.3" "" COMPU_TAB_REF ELECCMPRPRSNT_SC_Compu /end COMPU_METHOD
/begin COMPU_VTAB ELECCMPRPRSNT_SC_Compu "" TAB_VERB 2 0 "False" 1 "True" /end COMPU_VTAB
/begin COMPU_METHOD ELECDRVENGDRG_SC_Compu "" TAB_VERB "%6.3" "" COMPU_TAB_REF ELECDRVENGDRG_SC_Compu /end COMPU_METHOD
/begin COMPU_VTAB ELECDRVENGDRG_SC_Compu "" TAB_VERB 2 0 "False" 1 "True" /end COMPU_VTAB
/begin COMPU_METHOD ELECDRVGPSBL_SC_Compu "" TAB_VERB "%6.3" "" COMPU_TAB_REF ELECDRVGPSBL_SC_Compu /end COMPU_METHOD
/begin COMPU_VTAB ELECDRVGPSBL_SC_Compu "" TAB_VERB 2 0 "False" 1 "True" /end COMPU_VTAB
/begin COMPU_METHOD ELECLDSENS_SC_Compu "" TAB_VERB "%6.3" "" COMPU_TAB_REF ELECLDSENS_SC_Compu /end COMPU_METHOD
/begin COMPU_VTAB ELECLDSENS_SC_Compu "" TAB_VERB 2 0 "False" 1 "True" /end COMPU_VTAB
/begin COMPU_METHOD ELMGOV_SC_Compu "" TAB_VERB "%6.3" "" COMPU_TAB_REF ELMGOV_SC_Compu /end COMPU_METHOD
/begin COMPU_VTAB ELMGOV_SC_Compu "" TAB_VERB 2 0 "not_available" 1 "available" /end COMPU_VTAB
/begin COMPU_METHOD EM01PRSNT_SC_Compu "" TAB_VERB "%6.3" "" COMPU_TAB_REF EM01PRSNT_SC_Compu /end COMPU_METHOD
/begin COMPU_VTAB EM01PRSNT_SC_Compu "" TAB_VERB 2 0 "False" 1 "True" /end COMPU_VTAB
/begin COMPU_METHOD EMGYSHOFFIN2_TYPAVL_SC_Compu "" TAB_VERB "%6.3" "" COMPU_TAB_REF EMGYSHOFFIN2_TYPAVL_SC_Compu /end COMPU_METHOD
/begin COMPU_VTAB EMGYSHOFFIN2_TYPAVL_SC_Compu "" TAB_VERB 2 0 "FALSE" 1 "TRUE" /end COMPU_VTAB
/begin COMPU_METHOD EMGYSTRTSWT2_TYPAVL_SC_Compu "" TAB_VERB "%6.3" "" COMPU_TAB_REF EMGYSTRTSWT2_TYPAVL_SC_Compu /end COMPU_METHOD
/begin COMPU_VTAB EMGYSTRTSWT2_TYPAVL_SC_Compu "" TAB_VERB 2 0 "False" 1 "True" /end COMPU_VTAB
/begin COMPU_METHOD EMLVTYP_SC_Compu "" TAB_VERB "%6.3" "" COMPU_TAB_REF EMLVTYP_SC_Compu /end COMPU_METHOD
/begin COMPU_VTAB EMLVTYP_SC_Compu "" TAB_VERB 3 0 "No_ElM" 1 "Valeo" 2 "Mitsubishi" /end COMPU_VTAB
/begin COMPU_METHOD EMMVTYP_SC_Compu "" TAB_VERB "%6.3" "" COMPU_TAB_REF EMMVTYP_SC_Compu /end COMPU_METHOD
/begin COMPU_VTAB EMMVTYP_SC_Compu "" TAB_VERB 4 0 "No_ElM" 1 "Bosch" 2 "Valeo" 3 "Conti" /end COMPU_VTAB
/begin COMPU_METHOD ENADATASETID_CALPAR_SC_Compu "" TAB_VERB "%6.3" "" COMPU_TAB_REF ENADATASETID_CALPAR_SC_Compu /end COMPU_METHOD
/begin COMPU_VTAB ENADATASETID_CALPAR_SC_Compu "" TAB_VERB 2 0 "False" 1 "True" /end COMPU_VTAB
/begin COMPU_METHOD Energy "" RAT_FUNC "%6.2" "kJ" COEFFS 0 1 0 0 0 1 /end COMPU_METHOD
/begin COMPU_METHOD Energy_J_HiRes "" RAT_FUNC "%6.2" "J" COEFFS 0 1 0 0 0 1 /end COMPU_METHOD
/begin COMPU_METHOD Energy_q0p0001 "" RAT_FUNC "%7.6" "kJ" COEFFS 0 10000 0 0 0 1 /end COMPU_METHOD
/begin COMPU_METHOD Energy_q0p001_COMPU "" RAT_FUNC "%6.5" "kJ" COEFFS 0 1000 0 0 0 1 /end COMPU_METHOD
/begin COMPU_METHOD ENGBRK_SC_Compu "" TAB_VERB "%6.3" "" COMPU_TAB_REF ENGBRK_SC_Compu /end COMPU_METHOD
/begin COMPU_VTAB ENGBRK_SC_Compu "" TAB_VERB 2 0 "False" 1 "True" /end COMPU_VTAB
/begin COMPU_METHOD ENGCMPTMTT_TYPAVL_SY_Compu "" TAB_VERB "%6.3" "" COMPU_TAB_REF ENGCMPTMTT_TYPAVL_SY_Compu /end COMPU_METHOD
/begin COMPU_VTAB ENGCMPTMTT_TYPAVL_SY_Compu "" TAB_VERB 2 0 "False" 1 "True" /end COMPU_VTAB
/begin COMPU_METHOD ENGCOUPLSPDPREDAVL_SC_Compu "" TAB_VERB "%6.3" "" COMPU_TAB_REF ENGCOUPLSPDPREDAVL_SC_Compu /end COMPU_METHOD
/begin COMPU_VTAB ENGCOUPLSPDPREDAVL_SC_Compu "" TAB_VERB 2 0 "False" 1 "True" /end COMPU_VTAB
/begin COMPU_METHOD ENGDA_CTFLD_NUM_Compu "" RAT_FUNC "%6.2" "" COEFFS 0 1 0 0 0 1 /end COMPU_METHOD
/begin COMPU_METHOD ENGDA_TIENGONOBD_SY_Compu "" TAB_VERB "%6.3" "" COMPU_TAB_REF ENGDA_TIENGONOBD_SY_Compu /end COMPU_METHOD
/begin COMPU_VTAB ENGDA_TIENGONOBD_SY_Compu "" TAB_VERB 2 0 "FALSE" 1 "TRUE" /end COMPU_VTAB
/begin COMPU_METHOD ENGDEMTQINC_SC_Compu "" TAB_VERB "%6.3" "" COMPU_TAB_REF ENGDEMTQINC_SC_Compu /end COMPU_METHOD
/begin COMPU_VTAB ENGDEMTQINC_SC_Compu "" TAB_VERB 2 0 "False" 1 "True" /end COMPU_VTAB
/begin COMPU_METHOD ENGDEM_OPERMODTQLIMN_SC_Compu "" TAB_VERB "%6.3" "" COMPU_TAB_REF ENGDEM_OPERMODTQLIMN_SC_Compu /end COMPU_METHOD
/begin COMPU_VTAB ENGDEM_OPERMODTQLIMN_SC_Compu "" TAB_VERB 2 0 "FALSE" 1 "TRUE" /end COMPU_VTAB
/begin COMPU_METHOD ENGDEM_VAR_SY_Compu "" TAB_VERB "%6.3" "" COMPU_TAB_REF ENGDEM_VAR_SY_Compu /end COMPU_METHOD
/begin COMPU_VTAB ENGDEM_VAR_SY_Compu "" TAB_VERB 56 0 "kein Kundenbezug" 1 "DAI" 3 "VWW" 4 "POR" 5 "AUD" 6 "OPE" 9 "FIA" 11 "BMW" 14 "PSA" 15 "REN" 17 "ALF" 18 "SAB" 19 "VOL" 20 "NIS" 21 "GMU" 22 "FOR" 26 "IMJ" 36 "MAN" 51 "SEA" 53 "CHR" 54 "JAG" 55 "ROL" 69 "FER" 72 "TOY" 123 "MIT" 147 "HYU" 159 "HON" 160 "MAZ" 183 "CU" 190 "LRG" 204 "VVW" 214 "AVT" 226 "YUCHAI_OHW" 242 "Iveco" 243 "DMC" 248 "SUZ" 267 "SSANGYONG" 270 "KEF" 289 "AMG" 308 "TAT" 319 "MVM" 328 "MM" 385 "UAES" 578 "AL" 590 "SCANIA" 746 "Naveco" 760 "WEICHAI" 828 "RBCD" 898 "MFTBC" 944 "Doosan" 966 "International" 999 "ALL" 2887 "NONOX" 9047 "No 1 Tractors China" 9347 "SDFG" 9454 "Fuso" /end COMPU_VTAB
/begin COMPU_METHOD ENGMIDT_ADCSENS_SY_Compu "" TAB_VERB "%6.3" "" COMPU_TAB_REF ENGMIDT_ADCSENS_SY_Compu /end COMPU_METHOD
/begin COMPU_VTAB ENGMIDT_ADCSENS_SY_Compu "" TAB_VERB 2 0 "False" 1 "True" /end COMPU_VTAB
/begin COMPU_METHOD ENGMIDT_COLDSTRTDIAG_SC_Compu "" TAB_VERB "%6.3" "" COMPU_TAB_REF ENGMIDT_COLDSTRTDIAG_SC_Compu /end COMPU_METHOD
/begin COMPU_VTAB ENGMIDT_COLDSTRTDIAG_SC_Compu "" TAB_VERB 2 0 "False" 1 "True" /end COMPU_VTAB
/begin COMPU_METHOD ENGMIDT_TYPAVL_SC_Compu "" TAB_VERB "%6.3" "" COMPU_TAB_REF ENGMIDT_TYPAVL_SC_Compu /end COMPU_METHOD
/begin COMPU_VTAB ENGMIDT_TYPAVL_SC_Compu "" TAB_VERB 2 0 "False" 1 "True" /end COMPU_VTAB
/begin COMPU_METHOD ENGM_OILCTRL_SC_Compu "" TAB_VERB "%6.3" "" COMPU_TAB_REF ENGM_OILCTRL_SC_Compu /end COMPU_METHOD
/begin COMPU_VTAB ENGM_OILCTRL_SC_Compu "" TAB_VERB 2 0 "NoOilCtl" 1 "ActvdOilCtl" /end COMPU_VTAB
/begin COMPU_METHOD EngNRmp_Hi "" RAT_FUNC "%6.3" "rpm" COEFFS 0 10 0 0 0 1 /end COMPU_METHOD
/begin COMPU_METHOD ENGNSP_PFAVL_SC_Compu "" TAB_VERB "%6.3" "" COMPU_TAB_REF ENGNSP_PFAVL_SC_Compu /end COMPU_METHOD
/begin COMPU_VTAB ENGNSP_PFAVL_SC_Compu "" TAB_VERB 2 0 "EngNSp_NotAvl" 1 "EngNSp_Avl" /end COMPU_VTAB
/begin COMPU_METHOD ENGNSP_PFREQACTV_SC_Compu "" TAB_VERB "%6.3" "" COMPU_TAB_REF ENGNSP_PFREQACTV_SC_Compu /end COMPU_METHOD
/begin COMPU_VTAB ENGNSP_PFREQACTV_SC_Compu "" TAB_VERB 2 0 "False" 1 "True" /end COMPU_VTAB
/begin COMPU_METHOD EngN_HiRes "" RAT_FUNC "%6.4" "rpm" COEFFS 0 32 0 0 0 1 /end COMPU_METHOD
/begin COMPU_METHOD ENGOILT_TYPAVL_SC_Compu "" TAB_VERB "%6.3" "" COMPU_TAB_REF ENGOILT_TYPAVL_SC_Compu /end COMPU_METHOD
/begin COMPU_VTAB ENGOILT_TYPAVL_SC_Compu "" TAB_VERB 2 0 "False" 1 "True" /end COMPU_VTAB
/begin COMPU_METHOD ENGOPMODE_SY_Compu "" TAB_VERB "%6.3" "" COMPU_TAB_REF ENGOPMODE_SY_Compu /end COMPU_METHOD
/begin COMPU_VTAB ENGOPMODE_SY_Compu "" TAB_VERB 2 0 "False" 1 "True" /end COMPU_VTAB
/begin COMPU_METHOD ENGRESTRT_SY_Compu "" TAB_VERB "%6.3" "" COMPU_TAB_REF ENGRESTRT_SY_Compu /end COMPU_METHOD
/begin COMPU_VTAB ENGRESTRT_SY_Compu "" TAB_VERB 2 0 "False" 1 "True" /end COMPU_VTAB
/begin COMPU_METHOD ENGRSTRTVRNT_SC_Compu "" TAB_VERB "%6.3" "" COMPU_TAB_REF ENGRSTRTVRNT_SC_Compu /end COMPU_METHOD
/begin COMPU_VTAB ENGRSTRTVRNT_SC_Compu "" TAB_VERB 3 0 "NO_RESTART" 1 "RESTART_TASK" 2 "RESTART_EVENT" /end COMPU_VTAB
/begin COMPU_METHOD ENGSPDHI_SC_Compu "" TAB_VERB "%6.3" "" COMPU_TAB_REF ENGSPDHI_SC_Compu /end COMPU_METHOD
/begin COMPU_VTAB ENGSPDHI_SC_Compu "" TAB_VERB 2 0 "False" 1 "True" /end COMPU_VTAB
/begin COMPU_METHOD ENGSPDLIMN_INHOUSE_SC_Compu "" TAB_VERB "%6.3" "" COMPU_TAB_REF ENGSPDLIMN_INHOUSE_SC_Compu /end COMPU_METHOD
/begin COMPU_VTAB ENGSPDLIMN_INHOUSE_SC_Compu "" TAB_VERB 2 0 "False" 1 "True" /end COMPU_VTAB
/begin COMPU_METHOD ENGSPDPLSENA_SC_Compu "" TAB_VERB "%6.3" "" COMPU_TAB_REF ENGSPDPLSENA_SC_Compu /end COMPU_METHOD
/begin COMPU_VTAB ENGSPDPLSENA_SC_Compu "" TAB_VERB 2 0 "False" 1 "True" /end COMPU_VTAB
/begin COMPU_METHOD ENGSPDPREDAVL_SC_Compu "" TAB_VERB "%6.3" "" COMPU_TAB_REF ENGSPDPREDAVL_SC_Compu /end COMPU_METHOD
/begin COMPU_VTAB ENGSPDPREDAVL_SC_Compu "" TAB_VERB 2 0 "False" 1 "True" /end COMPU_VTAB
/begin COMPU_METHOD ENGSPD_LIMSTRT_SY_Compu "" TAB_VERB "%6.3" "" COMPU_TAB_REF ENGSPD_LIMSTRT_SY_Compu /end COMPU_METHOD
/begin COMPU_VTAB ENGSPD_LIMSTRT_SY_Compu "" TAB_VERB 2 0 "0" 1 "1" /end COMPU_VTAB
/begin COMPU_METHOD ENGSPD_SWTENA_SY_Compu "" TAB_VERB "%6.3" "" COMPU_TAB_REF ENGSPD_SWTENA_SY_Compu /end COMPU_METHOD
/begin COMPU_VTAB ENGSPD_SWTENA_SY_Compu "" TAB_VERB 2 0 "FALSE" 1 "TRUE" /end COMPU_VTAB
/begin COMPU_METHOD ENGSTREQBYPTCOORN_SC_Compu "" TAB_VERB "%6.3" "" COMPU_TAB_REF ENGSTREQBYPTCOORN_SC_Compu /end COMPU_METHOD
/begin COMPU_VTAB ENGSTREQBYPTCOORN_SC_Compu "" TAB_VERB 2 0 "False" 1 "True" /end COMPU_VTAB
/begin COMPU_METHOD ENGSTRT_FWENGOFF_SC_Compu "" TAB_VERB "%6.3" "" COMPU_TAB_REF ENGSTRT_FWENGOFF_SC_Compu /end COMPU_METHOD
/begin COMPU_VTAB ENGSTRT_FWENGOFF_SC_Compu "" TAB_VERB 2 0 "DISABLED" 1 "ENABLED" /end COMPU_VTAB
/begin COMPU_METHOD ENGSTRT_NEWSYNCNPOSTDRV_SC_Compu "" RAT_FUNC "%6.2" "" COEFFS 0 1 0 0 0 1 /end COMPU_METHOD
/begin COMPU_METHOD ENGSTRT_STRTCOORCUST_SC_Compu "" TAB_VERB "%6.3" "" COMPU_TAB_REF ENGSTRT_STRTCOORCUST_SC_Compu /end COMPU_METHOD
/begin COMPU_VTAB ENGSTRT_STRTCOORCUST_SC_Compu "" TAB_VERB 2 0 "False" 1 "True" /end COMPU_VTAB
/begin COMPU_METHOD ENGSTRT_STRTGDEVIF_SC_Compu "" TAB_VERB "%6.3" "" COMPU_TAB_REF ENGSTRT_STRTGDEVIF_SC_Compu /end COMPU_METHOD
/begin COMPU_VTAB ENGSTRT_STRTGDEVIF_SC_Compu "" TAB_VERB 2 0 "False" 1 "True" /end COMPU_VTAB
/begin COMPU_METHOD ENGSTRT_VAR_SY_Compu "" TAB_VERB "%6.3" "" COMPU_TAB_REF ENGSTRT_VAR_SY_Compu /end COMPU_METHOD
/begin COMPU_VTAB ENGSTRT_VAR_SY_Compu "" TAB_VERB 47 1 "DAI" 3 "VWW" 4 "POR" 5 "AUD" 6 "OPE" 9 "FIA" 11 "BMW" 14 "PSA" 15 "REN" 17 "ALF" 18 "SAB" 19 "VOL" 20 "NIS" 21 "GMU" 22 "FOR" 26 "IMJ" 51 "SEA" 53 "CHR" 54 "JAG" 55 "ROL" 69 "FER" 72 "TOY" 123 "MIT" 147 "HYU" 159 "HON" 160 "MAZ" 183 "CU" 190 "LRG" 204 "VVW" 214 "AVT" 242 "Iveco" 243 "DMC" 248 "SUZ" 267 "SSANGYONG" 270 "KEF" 289 "AMG" 308 "TAT" 319 "MVM" 328 "MM" 385 "UAES" 425 "Polaris" 590 "Scania" 828 "RBCD" 898 "MFTBC" 999 "ALL" 2887 "Nonox" 9454 "Fuso" /end COMPU_VTAB
/begin COMPU_METHOD ENGSTRT_WRMUPFACSTBACTVT_SC_Compu "" TAB_VERB "%6.3" "" COMPU_TAB_REF ENGSTRT_WRMUPFACSTBACTVT_SC_Compu /end COMPU_METHOD
/begin COMPU_VTAB ENGSTRT_WRMUPFACSTBACTVT_SC_Compu "" TAB_VERB 2 0 "False" 1 "True" /end COMPU_VTAB
/begin COMPU_METHOD ENGTMR_VAR_SY_Compu "" TAB_VERB "%6.3" "" COMPU_TAB_REF ENGTMR_VAR_SY_Compu /end COMPU_METHOD
/begin COMPU_VTAB ENGTMR_VAR_SY_Compu "" TAB_VERB 44 1 "DAI" 3 "VWW" 4 "POR" 5 "AUD" 6 "OPE" 9 "FIA" 11 "BMW" 14 "PSA" 15 "REN" 17 "ALF" 18 "SAB" 19 "VOL" 20 "NIS" 21 "GMU" 22 "FOR" 26 "IMJ" 51 "SEA" 53 "CHR" 54 "JAG" 55 "ROL" 69 "FER" 72 "TOY" 123 "MIT" 147 "HYU" 159 "HON" 160 "MAZ" 183 "CU" 190 "LRG" 204 "VVW" 214 "AVT" 242 "Iveco" 243 "DMC" 248 "SUZ" 267 "SSANGYONG" 270 "KEF" 289 "AMG" 308 "TAT" 319 "MVM" 385 "UAES" 590 "Scania" 828 "RBCD" 999 "ALL" 2887 "Nonox" 9454 "Fuso" /end COMPU_VTAB
/begin COMPU_METHOD ENGTRJSTOP_SC_Compu "" RAT_FUNC "%6.2" "" COEFFS 0 1 0 0 0 1 /end COMPU_METHOD
/begin COMPU_METHOD EnrgPrMol_q0p001_COMPU "" RAT_FUNC "%6.5" "J/mol" COEFFS 0 1000 0 0 0 1 /end COMPU_METHOD
/begin COMPU_METHOD ENVP_TYPAVL_SY_Compu "" TAB_VERB "%6.3" "" COMPU_TAB_REF ENVP_TYPAVL_SY_Compu /end COMPU_METHOD
/begin COMPU_VTAB ENVP_TYPAVL_SY_Compu "" TAB_VERB 2 0 "False" 1 "True" /end COMPU_VTAB
/begin COMPU_METHOD ENVT_PHYSRNGCHK_SY_Compu "" TAB_VERB "%6.3" "" COMPU_TAB_REF ENVT_PHYSRNGCHK_SY_Compu /end COMPU_METHOD
/begin COMPU_VTAB ENVT_PHYSRNGCHK_SY_Compu "" TAB_VERB 2 0 "PHYSRNGCHK_DISBL" 1 "PHYSRNGCHK_ENA" /end COMPU_VTAB
/begin COMPU_METHOD ENVT_PLAUSDIAGCSC_SY_Compu "" TAB_VERB "%6.3" "" COMPU_TAB_REF ENVT_PLAUSDIAGCSC_SY_Compu /end COMPU_METHOD
/begin COMPU_VTAB ENVT_PLAUSDIAGCSC_SY_Compu "" TAB_VERB 2 0 "0" 1 "1" /end COMPU_VTAB
/begin COMPU_METHOD ENVT_PLAUSDIAGMBC_SY_Compu "" TAB_VERB "%6.3" "" COMPU_TAB_REF ENVT_PLAUSDIAGMBC_SY_Compu /end COMPU_METHOD
/begin COMPU_VTAB ENVT_PLAUSDIAGMBC_SY_Compu "" TAB_VERB 2 0 "0" 1 "1" /end COMPU_VTAB
/begin COMPU_METHOD ENVT_PLAUSDIAGPRC_SY_Compu "" TAB_VERB "%6.3" "" COMPU_TAB_REF ENVT_PLAUSDIAGPRC_SY_Compu /end COMPU_METHOD
/begin COMPU_VTAB ENVT_PLAUSDIAGPRC_SY_Compu "" TAB_VERB 2 0 "0" 1 "1" /end COMPU_VTAB
/begin COMPU_METHOD ENVT_SWTHWORCAN_SY_Compu "" TAB_VERB "%6.3" "" COMPU_TAB_REF ENVT_SWTHWORCAN_SY_Compu /end COMPU_METHOD
/begin COMPU_VTAB ENVT_SWTHWORCAN_SY_Compu "" TAB_VERB 3 0 "0" 1 "1" 2 "2" /end COMPU_VTAB
/begin COMPU_METHOD ENVT_TCACINTKBNK_SC_Compu "" TAB_VERB "%6.3" "" COMPU_TAB_REF ENVT_TCACINTKBNK_SC_Compu /end COMPU_METHOD
/begin COMPU_VTAB ENVT_TCACINTKBNK_SC_Compu "" TAB_VERB 3 0 "no_bank" 1 "bank_1" 2 "bank_2" /end COMPU_VTAB
/begin COMPU_METHOD ENVT_TCACINTKPOS_SC_Compu "" TAB_VERB "%6.3" "" COMPU_TAB_REF ENVT_TCACINTKPOS_SC_Compu /end COMPU_METHOD
/begin COMPU_VTAB ENVT_TCACINTKPOS_SC_Compu "" TAB_VERB 6 0 "no_position" 1 "position_1" 2 "position_2" 3 "position_3" 4 "position_4" 5 "position_5" /end COMPU_VTAB
/begin COMPU_METHOD ENVT_TMODINTKBNK_SC_Compu "" TAB_VERB "%6.3" "" COMPU_TAB_REF ENVT_TMODINTKBNK_SC_Compu /end COMPU_METHOD
/begin COMPU_VTAB ENVT_TMODINTKBNK_SC_Compu "" TAB_VERB 3 0 "no_bank" 1 "bank_1" 2 "bank_2" /end COMPU_VTAB
/begin COMPU_METHOD ENVT_TMODINTKPOS_SC_Compu "" TAB_VERB "%6.3" "" COMPU_TAB_REF ENVT_TMODINTKPOS_SC_Compu /end COMPU_METHOD
/begin COMPU_VTAB ENVT_TMODINTKPOS_SC_Compu "" TAB_VERB 6 0 "no_position" 1 "position_1" 2 "position_2" 3 "position_3" 4 "position_4" 5 "position_5" /end COMPU_VTAB
/begin COMPU_METHOD ENVT_TPLAUSMOD_SY_Compu "" TAB_VERB "%6.3" "" COMPU_TAB_REF ENVT_TPLAUSMOD_SY_Compu /end COMPU_METHOD
/begin COMPU_VTAB ENVT_TPLAUSMOD_SY_Compu "" TAB_VERB 3 0 "0" 1 "1" 2 "2" /end COMPU_VTAB
/begin COMPU_METHOD ENVT_TREPLMOD_SY_Compu "" TAB_VERB "%6.3" "" COMPU_TAB_REF ENVT_TREPLMOD_SY_Compu /end COMPU_METHOD
/begin COMPU_VTAB ENVT_TREPLMOD_SY_Compu "" TAB_VERB 3 0 "0" 1 "1" 2 "2" /end COMPU_VTAB
/begin COMPU_METHOD ENVT_TSENSADCAVL_SY_Compu "" TAB_VERB "%6.3" "" COMPU_TAB_REF ENVT_TSENSADCAVL_SY_Compu /end COMPU_METHOD
/begin COMPU_VTAB ENVT_TSENSADCAVL_SY_Compu "" TAB_VERB 2 0 "0" 1 "1" /end COMPU_VTAB
/begin COMPU_METHOD ENVT_TSENSCANAVL_SY_Compu "" TAB_VERB "%6.3" "" COMPU_TAB_REF ENVT_TSENSCANAVL_SY_Compu /end COMPU_METHOD
/begin COMPU_VTAB ENVT_TSENSCANAVL_SY_Compu "" TAB_VERB 2 0 "0" 1 "1" /end COMPU_VTAB
/begin COMPU_METHOD ENVT_TSENSMOD_SY_Compu "" TAB_VERB "%6.3" "" COMPU_TAB_REF ENVT_TSENSMOD_SY_Compu /end COMPU_METHOD
/begin COMPU_VTAB ENVT_TSENSMOD_SY_Compu "" TAB_VERB 2 0 "0" 1 "1" /end COMPU_VTAB
/begin COMPU_METHOD ENVT_TYPAVL_SY_Compu "" TAB_VERB "%6.3" "" COMPU_TAB_REF ENVT_TYPAVL_SY_Compu /end COMPU_METHOD
/begin COMPU_VTAB ENVT_TYPAVL_SY_Compu "" TAB_VERB 2 0 "False" 1 "True" /end COMPU_VTAB
/begin COMPU_METHOD EOBD5PLUS_SC_Compu "" TAB_VERB "%6.3" "" COMPU_TAB_REF EOBD5PLUS_SC_Compu /end COMPU_METHOD
/begin COMPU_VTAB EOBD5PLUS_SC_Compu "" TAB_VERB 2 0 "False" 1 "True" /end COMPU_VTAB
/begin COMPU_METHOD EOMACTVNENA_SC_Compu "" TAB_VERB "%6.3" "" COMPU_TAB_REF EOMACTVNENA_SC_Compu /end COMPU_METHOD
/begin COMPU_VTAB EOMACTVNENA_SC_Compu "" TAB_VERB 2 0 "False" 1 "True" /end COMPU_VTAB
/begin COMPU_METHOD EOMCOORNTYP_SC_Compu "" TAB_VERB "%6.3" "" COMPU_TAB_REF EOMCOORNTYP_SC_Compu /end COMPU_METHOD
/begin COMPU_VTAB EOMCOORNTYP_SC_Compu "" TAB_VERB 5 0 "0" 1 "1" 2 "2" 3 "3" 4 "4" /end COMPU_VTAB
/begin COMPU_METHOD EOMGPFLOAD_SC_Compu "" TAB_VERB "%6.3" "" COMPU_TAB_REF EOMGPFLOAD_SC_Compu /end COMPU_METHOD
/begin COMPU_VTAB EOMGPFLOAD_SC_Compu "" TAB_VERB 2 0 "NO_GPF_LOAD_AVAILABLE" 1 "EOM_GPF_LOAD_AVAILABLE" /end COMPU_VTAB
/begin COMPU_METHOD EOMMTRXSTGCFG_SC_Compu "" TAB_VERB "%6.3" "" COMPU_TAB_REF EOMMTRXSTGCFG_SC_Compu /end COMPU_METHOD
/begin COMPU_VTAB EOMMTRXSTGCFG_SC_Compu "" TAB_VERB 2 0 "physical_based_mode_gasoline" 1 "functional_based_mode_gasoline" /end COMPU_VTAB
/begin COMPU_METHOD EOMVLVLFTINMTRX_SC_Compu "" TAB_VERB "%6.3" "" COMPU_TAB_REF EOMVLVLFTINMTRX_SC_Compu /end COMPU_METHOD
/begin COMPU_VTAB EOMVLVLFTINMTRX_SC_Compu "" TAB_VERB 2 0 "NoValveLiftInMatrix" 1 "ValveLiftInMatrix" /end COMPU_VTAB
/begin COMPU_METHOD EPMBCA_FACSEGTIMEACC_CURX_SC_Compu "" RAT_FUNC "%6.2" "" COEFFS 0 1 0 0 0 1 /end COMPU_METHOD
/begin COMPU_METHOD EPMCAS_DIAGSRC2_SC_Compu "" RAT_FUNC "%6.2" "" COEFFS 0 1 0 0 0 1 /end COMPU_METHOD
/begin COMPU_METHOD EPMCAS_FACPLAUS_DSTX_SC_Compu "" RAT_FUNC "%6.2" "" COEFFS 0 1 0 0 0 1 /end COMPU_METHOD
/begin COMPU_METHOD EPMCAS_NUMSEGLEN_SC_Compu "" RAT_FUNC "%6.2" "" COEFFS 0 1 0 0 0 1 /end COMPU_METHOD
/begin COMPU_METHOD EPMCAS_NUMSEG_SC_Compu "" RAT_FUNC "%6.2" "" COEFFS 0 1 0 0 0 1 /end COMPU_METHOD
/begin COMPU_METHOD EPMCAS_OFFSAVRGFILSIZE_SC_Compu "" RAT_FUNC "%6.2" "" COEFFS 0 1 0 0 0 1 /end COMPU_METHOD
/begin COMPU_METHOD EPMCAS_OFFSDIAGDTRENA_SC_Compu "" TAB_VERB "%6.3" "" COMPU_TAB_REF EPMCAS_OFFSDIAGDTRENA_SC_Compu /end COMPU_METHOD
/begin COMPU_VTAB EPMCAS_OFFSDIAGDTRENA_SC_Compu "" TAB_VERB 2 0 "False" 1 "True" /end COMPU_VTAB
/begin COMPU_METHOD EPMCAS_PHINCOR_CURX_SC_Compu "" RAT_FUNC "%6.2" "" COEFFS 0 1 0 0 0 1 /end COMPU_METHOD
/begin COMPU_METHOD EPMCAS_PHITEMPADAPCORSIZEDSTX_SC_Compu "" RAT_FUNC "%6.2" "" COEFFS 0 1 0 0 0 1 /end COMPU_METHOD
/begin COMPU_METHOD EPMCAS_PHITEMPCOR05_DSTX_SC_Compu "" RAT_FUNC "%6.2" "" COEFFS 0 1 0 0 0 1 /end COMPU_METHOD
/begin COMPU_METHOD EPMCAS_PRODCORRNVAL_SC_Compu "" TAB_VERB "%6.3" "" COMPU_TAB_REF EPMCAS_PRODCORRNVAL_SC_Compu /end COMPU_METHOD
/begin COMPU_VTAB EPMCAS_PRODCORRNVAL_SC_Compu "" TAB_VERB 2 0 "OFF" 1 "ON" /end COMPU_VTAB
/begin COMPU_METHOD EPMCAS_REFADPNTSTRENARESP_SC_Compu "" RAT_FUNC "%6.2" "" COEFFS 0 1 0 0 0 1 /end COMPU_METHOD
/begin COMPU_METHOD EPMCAS_REFADPNTSTR_SC_Compu "" TAB_VERB "%6.3" "" COMPU_TAB_REF EPMCAS_REFADPNTSTR_SC_Compu /end COMPU_METHOD
/begin COMPU_VTAB EPMCAS_REFADPNTSTR_SC_Compu "" TAB_VERB 2 0 "False" 1 "True" /end COMPU_VTAB
/begin COMPU_METHOD EPMCAS_SELNDIAGFAILRADPN_SC_Compu "" TAB_VERB "%6.3" "" COMPU_TAB_REF EPMCAS_SELNDIAGFAILRADPN_SC_Compu /end COMPU_METHOD
/begin COMPU_VTAB EPMCAS_SELNDIAGFAILRADPN_SC_Compu "" TAB_VERB 2 0 "DISAD_DIAG_FAILRADPN" 1 "ENAD_DIAG_FAILRADPN" /end COMPU_VTAB
/begin COMPU_METHOD EPMCRS_DGIPLSCORRNACTVD_SC_Compu "" RAT_FUNC "%6.2" "" COEFFS 0 1 0 0 0 1 /end COMPU_METHOD
/begin COMPU_METHOD EPMCRS_DIAGDETAILEXTD_SC_Compu "" TAB_VERB "%6.3" "" COMPU_TAB_REF EPMCRS_DIAGDETAILEXTD_SC_Compu /end COMPU_METHOD
/begin COMPU_VTAB EPMCRS_DIAGDETAILEXTD_SC_Compu "" TAB_VERB 3 0 "DISABLE" 1 "ENABLE_SIGNAL" 2 "ENABLE_NOSIGNAL" /end COMPU_VTAB
/begin COMPU_METHOD EPMCRS_DIAGSRC_SC_Compu "" RAT_FUNC "%6.2" "" COEFFS 0 1 0 0 0 1 /end COMPU_METHOD
/begin COMPU_METHOD EPMCRS_DIAGSYNCLOST_SC_Compu "" TAB_VERB "%6.3" "" COMPU_TAB_REF EPMCRS_DIAGSYNCLOST_SC_Compu /end COMPU_METHOD
/begin COMPU_VTAB EPMCRS_DIAGSYNCLOST_SC_Compu "" TAB_VERB 2 0 "DISABLE_DIAGSYNCLOST" 1 "ENABLE_DIAGSYNCLOST" /end COMPU_VTAB
/begin COMPU_METHOD EPMCRS_ENASIGLVLDIAG_SC_Compu "" TAB_VERB "%6.3" "" COMPU_TAB_REF EPMCRS_ENASIGLVLDIAG_SC_Compu /end COMPU_METHOD
/begin COMPU_VTAB EPMCRS_ENASIGLVLDIAG_SC_Compu "" TAB_VERB 2 0 "False" 1 "True" /end COMPU_VTAB
/begin COMPU_METHOD EPMCRS_MAXAXISPNTSTIPLSCRV_SC_Compu "" RAT_FUNC "%6.2" "" COEFFS 0 1 0 0 0 1 /end COMPU_METHOD
/begin COMPU_METHOD EPMCRS_NRENGSPDSEGPLAUS_SC_Compu "" RAT_FUNC "%6.2" "" COEFFS 0 1 0 0 0 1 /end COMPU_METHOD
/begin COMPU_METHOD EPMCRS_NUMINCOUT_SC_Compu "" RAT_FUNC "%6.2" "" COEFFS 0 1 0 0 0 1 /end COMPU_METHOD
/begin COMPU_METHOD EPMCRS_PLSWIDTHAPPLACTVD_SC_Compu "" TAB_VERB "%6.3" "" COMPU_TAB_REF EPMCRS_PLSWIDTHAPPLACTVD_SC_Compu /end COMPU_METHOD
/begin COMPU_VTAB EPMCRS_PLSWIDTHAPPLACTVD_SC_Compu "" TAB_VERB 2 0 "0" 1 "1" /end COMPU_VTAB
/begin COMPU_METHOD EPMCRS_RESLTOTREV_SC_Compu "" TAB_VERB "%6.3" "" COMPU_TAB_REF EPMCRS_RESLTOTREV_SC_Compu /end COMPU_METHOD
/begin COMPU_VTAB EPMCRS_RESLTOTREV_SC_Compu "" TAB_VERB 3 0 "RESL1000" 1 "RESL100" 2 "RESL10" /end COMPU_VTAB
/begin COMPU_METHOD EPMCRS_REVSTRTCONT_SC_Compu "" TAB_VERB "%6.3" "" COMPU_TAB_REF EPMCRS_REVSTRTCONT_SC_Compu /end COMPU_METHOD
/begin COMPU_VTAB EPMCRS_REVSTRTCONT_SC_Compu "" TAB_VERB 2 0 "False" 1 "True" /end COMPU_VTAB
/begin COMPU_METHOD EPMCRS_TIINCOUTPVBL_SC_Compu "" TAB_VERB "%6.3" "" COMPU_TAB_REF EPMCRS_TIINCOUTPVBL_SC_Compu /end COMPU_METHOD
/begin COMPU_VTAB EPMCRS_TIINCOUTPVBL_SC_Compu "" TAB_VERB 3 1 "TIINC" 2 "TIINCLRES" 3 "TIINC_TIINCLRES" /end COMPU_VTAB
/begin COMPU_METHOD EPMCRS_TIINCOUT_SC_Compu "" TAB_VERB "%6.3" "" COMPU_TAB_REF EPMCRS_TIINCOUT_SC_Compu /end COMPU_METHOD
/begin COMPU_VTAB EPMCRS_TIINCOUT_SC_Compu "" TAB_VERB 2 0 "False" 1 "True" /end COMPU_VTAB
/begin COMPU_METHOD EPMERR_NRERRINFOARY_SC_Compu "" TAB_VERB "%6.3" "" COMPU_TAB_REF EPMERR_NRERRINFOARY_SC_Compu /end COMPU_METHOD
/begin COMPU_VTAB EPMERR_NRERRINFOARY_SC_Compu "" TAB_VERB 3 1 "small block size" 2 "medium block size" 3 "big block size" /end COMPU_VTAB
/begin COMPU_METHOD EPMHWE_RTM_SY_Compu "" TAB_VERB "%6.3" "" COMPU_TAB_REF EPMHWE_RTM_SY_Compu /end COMPU_METHOD
/begin COMPU_VTAB EPMHWE_RTM_SY_Compu "" TAB_VERB 2 0 "NO_RTM" 1 "RTM" /end COMPU_VTAB
/begin COMPU_METHOD EPMHWE_SWTCPU_SY_Compu "" TAB_VERB "%6.3" "" COMPU_TAB_REF EPMHWE_SWTCPU_SY_Compu /end COMPU_METHOD
/begin COMPU_VTAB EPMHWE_SWTCPU_SY_Compu "" TAB_VERB 2 0 "PCP" 1 "CPU" /end COMPU_VTAB
/begin COMPU_METHOD EPMRRS_IGNLOCKRELSIMDT_SC_Compu "" TAB_VERB "%6.3" "" COMPU_TAB_REF EPMRRS_IGNLOCKRELSIMDT_SC_Compu /end COMPU_METHOD
/begin COMPU_VTAB EPMRRS_IGNLOCKRELSIMDT_SC_Compu "" TAB_VERB 2 0 "False" 1 "True" /end COMPU_VTAB
/begin COMPU_METHOD EPMRRS_SY_Compu "" TAB_VERB "%6.3" "" COMPU_TAB_REF EPMRRS_SY_Compu /end COMPU_METHOD
/begin COMPU_VTAB EPMRRS_SY_Compu "" TAB_VERB 3 0 "NO_RRS" 1 "REV" 2 "REV_STOP" /end COMPU_VTAB
/begin COMPU_METHOD EPMRRS_TITEMP_CURX_SC_Compu "" RAT_FUNC "%6.2" "" COEFFS 0 1 0 0 0 1 /end COMPU_METHOD
/begin COMPU_METHOD EPMRVSROTYMETH_SY_Compu "" TAB_VERB "%6.3" "" COMPU_TAB_REF EPMRVSROTYMETH_SY_Compu /end COMPU_METHOD
/begin COMPU_VTAB EPMRVSROTYMETH_SY_Compu "" TAB_VERB 2 0 "TOOTHPERD" 1 "PLSTI" /end COMPU_VTAB
/begin COMPU_METHOD EPMSPD_ENAPSDIAG_SC_Compu "" TAB_VERB "%6.3" "" COMPU_TAB_REF EPMSPD_ENAPSDIAG_SC_Compu /end COMPU_METHOD
/begin COMPU_VTAB EPMSPD_ENAPSDIAG_SC_Compu "" TAB_VERB 2 0 "DIPSDIAG" 1 "ENAPSDIAG" /end COMPU_VTAB
/begin COMPU_METHOD EPMSPD_SIGGENN_SC_Compu "" TAB_VERB "%6.3" "" COMPU_TAB_REF EPMSPD_SIGGENN_SC_Compu /end COMPU_METHOD
/begin COMPU_VTAB EPMSPD_SIGGENN_SC_Compu "" TAB_VERB 5 0 "NO_SIGGENN" 1 "CRS_GENN" 2 "PWM_GENN" 3 "PWMORCRS_GENN" 4 "TWOSIG_GENN" /end COMPU_VTAB
/begin COMPU_METHOD EPMSYN_INJRLS_SC_Compu "" TAB_VERB "%6.3" "" COMPU_TAB_REF EPMSYN_INJRLS_SC_Compu /end COMPU_METHOD
/begin COMPU_VTAB EPMSYN_INJRLS_SC_Compu "" TAB_VERB 2 0 "INJRLS_ALWAYS" 1 "INJRLS_AFTERANGLE" /end COMPU_VTAB
/begin COMPU_METHOD EPMSYN_PHIINCCOR_CURX_SC_Compu "" RAT_FUNC "%6.2" "" COEFFS 0 1 0 0 0 1 /end COMPU_METHOD
/begin COMPU_METHOD EPMTDC_PRODCORRNVAL_SC_Compu "" TAB_VERB "%6.3" "" COMPU_TAB_REF EPMTDC_PRODCORRNVAL_SC_Compu /end COMPU_METHOD
/begin COMPU_VTAB EPMTDC_PRODCORRNVAL_SC_Compu "" TAB_VERB 2 0 "OFF" 1 "ON" /end COMPU_VTAB
/begin COMPU_METHOD EPM_ATS_SY_Compu "" TAB_VERB "%6.3" "" COMPU_TAB_REF EPM_ATS_SY_Compu /end COMPU_METHOD
/begin COMPU_VTAB EPM_ATS_SY_Compu "" TAB_VERB 2 0 "NO_ACCESS" 1 "ACCESS" /end COMPU_VTAB
/begin COMPU_METHOD EPM_CAMSFTSNSRDEACTVN_SC_Compu "" TAB_VERB "%6.3" "" COMPU_TAB_REF EPM_CAMSFTSNSRDEACTVN_SC_Compu /end COMPU_METHOD
/begin COMPU_VTAB EPM_CAMSFTSNSRDEACTVN_SC_Compu "" TAB_VERB 2 0 "CANNOT_DEACTIVATE" 1 "BY_CALIBRATION" /end COMPU_VTAB
/begin COMPU_METHOD EPM_CUSTADP_SC_Compu "" TAB_VERB "%6.3" "" COMPU_TAB_REF EPM_CUSTADP_SC_Compu /end COMPU_METHOD
/begin COMPU_VTAB EPM_CUSTADP_SC_Compu "" TAB_VERB 2 0 "False" 1 "True" /end COMPU_VTAB
/begin COMPU_METHOD EPM_DGIDIRCORRN_SC_Compu "" TAB_VERB "%6.3" "" COMPU_TAB_REF EPM_DGIDIRCORRN_SC_Compu /end COMPU_METHOD
/begin COMPU_VTAB EPM_DGIDIRCORRN_SC_Compu "" TAB_VERB 2 0 "DIRCORRN_OFF" 1 "DIRCORRN_ON" /end COMPU_VTAB
/begin COMPU_METHOD EPM_DGIDIRFRCD_SC_Compu "" TAB_VERB "%6.3" "" COMPU_TAB_REF EPM_DGIDIRFRCD_SC_Compu /end COMPU_METHOD
/begin COMPU_VTAB EPM_DGIDIRFRCD_SC_Compu "" TAB_VERB 2 0 "DIRFRCD_OFF" 1 "DIRFRCD_ON" /end COMPU_VTAB
/begin COMPU_METHOD EPM_DGIDYNCHG_SC_Compu "" TAB_VERB "%6.3" "" COMPU_TAB_REF EPM_DGIDYNCHG_SC_Compu /end COMPU_METHOD
/begin COMPU_VTAB EPM_DGIDYNCHG_SC_Compu "" TAB_VERB 2 0 "DYNCHG_OFF" 1 "DYNCHG_ON" /end COMPU_VTAB
/begin COMPU_METHOD EPM_DGIPLSRNG_SC_Compu "" TAB_VERB "%6.3" "" COMPU_TAB_REF EPM_DGIPLSRNG_SC_Compu /end COMPU_METHOD
/begin COMPU_VTAB EPM_DGIPLSRNG_SC_Compu "" TAB_VERB 2 0 "PLSRNG_OFF" 1 "PLSRNG_ON" /end COMPU_VTAB
/begin COMPU_METHOD Fact "" RAT_FUNC "%6.5" "-" COEFFS 0 8192 0 0 0 1 /end COMPU_METHOD
/begin COMPU_METHOD OneToOne "" RAT_FUNC "%6.2" "-" COEFFS 0 1 0 0 0 1 /end COMPU_METHOD
/begin COMPU_METHOD RBPtCel_p_1p0_1 "" RAT_FUNC "%6.2" "hPa" COEFFS 0 1 0 0 0 1 /end COMPU_METHOD
/begin COMPU_METHOD RBPtCel_t_1p0_3 "" RAT_FUNC "%6.2" "Deg C" COEFFS 0 1 0 0 0 1 /end COMPU_METHOD
/begin COMPU_METHOD SigQly_COMPU_VERB "" TAB_VERB "%6.3" "" COMPU_TAB_REF SigQly_COMPU_VERB /end COMPU_METHOD
/begin COMPU_VTAB SigQly_COMPU_VERB "" TAB_VERB 16 0 "SIGQLY_NOTCALC" 1 "SIGQLY_INIT" 2 "SIGQLY_OK" 3 "SIGQLY_MODEL" 4 "SIGQLY_REPLACEMENT" 5 "SIGQLY_FROZEN" 6 "SIGQLY_INVALID" 7 "SIGQLY_RESERVED_7" 8 "SIGQLY_RESERVED_8" 9 "SIGQLY_RESERVED_9" 10 "SIGQLY_RESERVED_10" 11 "SIGQLY_RESERVED_11" 12 "SIGQLY_RESERVED_12" 13 "SIGQLY_RESERVED_13" 14 "SIGQLY_RESERVED_14" 15 "SIGQLY_RESERVED_15" /end COMPU_VTAB
/begin COMPU_METHOD Temp_Cels "" RAT_FUNC "%6.1" "deg C" COEFFS 0 10 2731.4 0 0 1 /end COMPU_METHOD
/begin COMPU_METHOD t_q0p2 "" RAT_FUNC "%6.3" "s" COEFFS 0 10 0 0 0 2 /end COMPU_METHOD
/begin COMPU_METHOD Volt_Batt "" RAT_FUNC "%6.1" "mV" COEFFS 0 0.05 0 0 0 1 /end COMPU_METHOD
/begin RECORD_LAYOUT Kw_Ws16 FNC_VALUES 1 SWORD COLUMN_DIR DIRECT /end RECORD_LAYOUT
/begin RECORD_LAYOUT RB_Val_Wu8 FNC_VALUES 1 UBYTE COLUMN_DIR DIRECT /end RECORD_LAYOUT
/begin RECORD_LAYOUT Val_Wu16 FNC_VALUES 1 UWORD COLUMN_DIR DIRECT /end RECORD_LAYOUT
/end MODULE
/end PROJECT
