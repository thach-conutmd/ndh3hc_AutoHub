ASAP2_VERSION 1 60
/begin PROJECT MG1CS022 "MG1CS022"
/begin HEADER "" VERSION "MG1CS022_62XSC_V037" PROJECT_NO MG1CS022 /end HEADER
/begin MODULE DIM ""
/begin MOD_COMMON "" BYTE_ORDER MSB_LAST ALIGNMENT_BYTE 1 ALIGNMENT_WORD 2 ALIGNMENT_LONG 4 ALIGNMENT_INT64 4 ALIGNMENT_FLOAT32_IEEE 4 ALIGNMENT_FLOAT64_IEEE 4 DATA_SIZE 32 /end MOD_COMMON
/begin CHARACTERISTIC DFES_EnvRef.DFC_RBA_IODIAGPWR_rba_IoExtCy329_SignalVltSply_1SCG_C "used environment signals / Reference to used environment condition set for check DFC_RBA_IODIAGPWR_rba_IoExtCy329_SignalVltSply_1SCG" VALUE 0x80504B8F Val_Wu8 1.00000000000 DFES_EnvTabVerb 0.00 1.00000000000 FORMAT "%13.11" /end CHARACTERISTIC
/begin CHARACTERISTIC DFES_EnvRef.DFC_RBA_IODIAGPWR_rba_IoExtCy329_SignalVltSply_1UV_C "used environment signals / Reference to used environment condition set for check DFC_RBA_IODIAGPWR_rba_IoExtCy329_SignalVltSply_1UV" VALUE 0x80504B90 Val_Wu8 1.00000000000 DFES_EnvTabVerb 0.00 1.00000000000 FORMAT "%13.11" /end CHARACTERISTIC
/begin CHARACTERISTIC DFES_EnvRef.DFC_RBA_IODIAGPWR_rba_IoExtCy329_SignalVltSply_2_C "used environment signals / Reference to used environment condition set for check DFC_RBA_IODIAGPWR_rba_IoExtCy329_SignalVltSply_2" VALUE 0x80504B91 Val_Wu8 1.00000000000 DFES_EnvTabVerb 0.00 1.00000000000 FORMAT "%13.11" /end CHARACTERISTIC
/begin CHARACTERISTIC DFES_EnvRef.DFC_RBA_IODIAGPWR_rba_IoExtCy329_SignalVltSply_2OT_C "used environment signals / Reference to used environment condition set for check DFC_RBA_IODIAGPWR_rba_IoExtCy329_SignalVltSply_2OT" VALUE 0x80504B92 Val_Wu8 1.00000000000 DFES_EnvTabVerb 0.00 1.00000000000 FORMAT "%13.11" /end CHARACTERISTIC
/begin CHARACTERISTIC DFES_EnvRef.DFC_RBA_IODIAGPWR_rba_IoExtCy329_SignalVltSply_2OV_C "used environment signals / Reference to used environment condition set for check DFC_RBA_IODIAGPWR_rba_IoExtCy329_SignalVltSply_2OV" VALUE 0x80504B93 Val_Wu8 1.00000000000 DFES_EnvTabVerb 0.00 1.00000000000 FORMAT "%13.11" /end CHARACTERISTIC
/begin CHARACTERISTIC DFES_EnvRef.DFC_RBA_IODIAGPWR_rba_IoExtCy329_SignalVltSply_2SCG_C "used environment signals / Reference to used environment condition set for check DFC_RBA_IODIAGPWR_rba_IoExtCy329_SignalVltSply_2SCG" VALUE 0x80504B94 Val_Wu8 1.00000000000 DFES_EnvTabVerb 0.00 1.00000000000 FORMAT "%13.11" /end CHARACTERISTIC
/begin CHARACTERISTIC DFES_EnvRef.DFC_RBA_IODIAGPWR_rba_IoExtCy329_SignalVltSply_2UV_C "used environment signals / Reference to used environment condition set for check DFC_RBA_IODIAGPWR_rba_IoExtCy329_SignalVltSply_2UV" VALUE 0x80504B95 Val_Wu8 1.00000000000 DFES_EnvTabVerb 0.00 1.00000000000 FORMAT "%13.11" /end CHARACTERISTIC
/begin CHARACTERISTIC DFES_EnvRef.DFC_CAN_E_TIMEOUT_C "used environment signals / Reference to used environment condition set for check DFC_CAN_E_TIMEOUT" VALUE 0x80504B96 Val_Wu8 1.00000000000 DFES_EnvTabVerb 0.00 1.00000000000 FORMAT "%13.11" /end CHARACTERISTIC
/begin CHARACTERISTIC DFES_EnvRef.DFC_LIN_E_TIMEOUT_C "used environment signals / Reference to used environment condition set for check DFC_LIN_E_TIMEOUT" VALUE 0x80504B97 Val_Wu8 1.00000000000 DFES_EnvTabVerb 0.00 1.00000000000 FORMAT "%13.11" /end CHARACTERISTIC
/begin CHARACTERISTIC DFES_EnvRef.DFC_MRlyOL_C "used environment signals / Reference to used environment condition set for check DFC_MRlyOL" VALUE 0x80504B98 Val_Wu8 1.00000000000 DFES_EnvTabVerb 0.00 1.00000000000 FORMAT "%13.11" /end CHARACTERISTIC
/begin CHARACTERISTIC DFES_EnvRef.DFC_MRlySCB_C "used environment signals / Reference to used environment condition set for check DFC_MRlySCB" VALUE 0x80504B99 Val_Wu8 1.00000000000 DFES_EnvTabVerb 0.00 1.00000000000 FORMAT "%13.11" /end CHARACTERISTIC
/begin CHARACTERISTIC DFES_EnvRef.DFC_MRlySCG_C "used environment signals / Reference to used environment condition set for check DFC_MRlySCG" VALUE 0x80504B9A Val_Wu8 1.00000000000 DFES_EnvTabVerb 0.00 1.00000000000 FORMAT "%13.11" /end CHARACTERISTIC
/begin CHARACTERISTIC DFES_EnvRef.DFC_rba_MultiStackTrace_Threshold_C "used environment signals / Reference to used environment condition set for check DFC_rba_MultiStackTrace_Threshold" VALUE 0x80504B9B Val_Wu8 1.00000000000 DFES_EnvTabVerb 0.00 1.00000000000 FORMAT "%13.11" /end CHARACTERISTIC
/begin CHARACTERISTIC DFES_EnvRef.DFC_BSWM_E_ACTION_FAILED_C "used environment signals / Reference to used environment condition set for check DFC_BSWM_E_ACTION_FAILED" VALUE 0x80504B9C Val_Wu8 1.00000000000 DFES_EnvTabVerb 0.00 1.00000000000 FORMAT "%13.11" /end CHARACTERISTIC
/begin CHARACTERISTIC DFES_EnvRef.DFC_BSWM_E_INTRPTQUEUE_FULL_C "used environment signals / Reference to used environment condition set for check DFC_BSWM_E_INTRPTQUEUE_FULL" VALUE 0x80504B9D Val_Wu8 1.00000000000 DFES_EnvTabVerb 0.00 1.00000000000 FORMAT "%13.11" /end CHARACTERISTIC
/begin CHARACTERISTIC DFES_EnvRef.DFC_RBA_IOEXTLIB_KEEPALIVE_DRV_C "used environment signals / Reference to used environment condition set for check DFC_RBA_IOEXTLIB_KEEPALIVE_DRV" VALUE 0x80504B9E Val_Wu8 1.00000000000 DFES_EnvTabVerb 0.00 1.00000000000 FORMAT "%13.11" /end CHARACTERISTIC
/begin CHARACTERISTIC DFES_EnvRef.DFC_RBA_IOEXTLIB_KEEPALIVE_INI_C "used environment signals / Reference to used environment condition set for check DFC_RBA_IOEXTLIB_KEEPALIVE_INI" VALUE 0x80504B9F Val_Wu8 1.00000000000 DFES_EnvTabVerb 0.00 1.00000000000 FORMAT "%13.11" /end CHARACTERISTIC
/begin CHARACTERISTIC DFES_EnvRef.DFC_rba_IoSigRtc_StopCounter_C "used environment signals / Reference to used environment condition set for check DFC_rba_IoSigRtc_StopCounter" VALUE 0x80504BA0 Val_Wu8 1.00000000000 DFES_EnvTabVerb 0.00 1.00000000000 FORMAT "%13.11" /end CHARACTERISTIC
/begin CHARACTERISTIC DFES_EnvRef.DFC_rba_MRly_Diag_Stk_Event_C "used environment signals / Reference to used environment condition set for check DFC_rba_MRly_Diag_Stk_Event" VALUE 0x80504BA1 Val_Wu8 1.00000000000 DFES_EnvTabVerb 0.00 1.00000000000 FORMAT "%13.11" /end CHARACTERISTIC
/begin CHARACTERISTIC DFES_EnvRef.DFC_rba_MemDiag_MemReadErr_C "used environment signals / Reference to used environment condition set for check DFC_rba_MemDiag_MemReadErr" VALUE 0x80504BA2 Val_Wu8 1.00000000000 DFES_EnvTabVerb 0.00 1.00000000000 FORMAT "%13.11" /end CHARACTERISTIC
/begin CHARACTERISTIC DFES_EnvRef.DFC_rba_MemDiag_MemWrErr_C "used environment signals / Reference to used environment condition set for check DFC_rba_MemDiag_MemWrErr" VALUE 0x80504BA3 Val_Wu8 1.00000000000 DFES_EnvTabVerb 0.00 1.00000000000 FORMAT "%13.11" /end CHARACTERISTIC
/begin CHARACTERISTIC DFES_EnvRef.DFC_rba_SyC_IrrSwOffTrigEngRun_Event_C "used environment signals / Reference to used environment condition set for check DFC_rba_SyC_IrrSwOffTrigEngRun_Event" VALUE 0x80504BA4 Val_Wu8 1.00000000000 DFES_EnvTabVerb 0.00 1.00000000000 FORMAT "%13.11" /end CHARACTERISTIC
/begin CHARACTERISTIC DFES_EnvRef.DFC_rba_T15_Diag_ComInVld_Event_C "used environment signals / Reference to used environment condition set for check DFC_rba_T15_Diag_ComInVld_Event" VALUE 0x80504BA5 Val_Wu8 1.00000000000 DFES_EnvTabVerb 0.00 1.00000000000 FORMAT "%13.11" /end CHARACTERISTIC
/begin CHARACTERISTIC DFES_EnvRef.DFC_rba_T15_Diag_ComOff_HwOn_Event_C "used environment signals / Reference to used environment condition set for check DFC_rba_T15_Diag_ComOff_HwOn_Event" VALUE 0x80504BA6 Val_Wu8 1.00000000000 DFES_EnvTabVerb 0.00 1.00000000000 FORMAT "%13.11" /end CHARACTERISTIC
/begin CHARACTERISTIC DFES_EnvRef.DFC_rba_T15_Diag_ComOn_HwOff_Event_C "used environment signals / Reference to used environment condition set for check DFC_rba_T15_Diag_ComOn_HwOff_Event" VALUE 0x80504BA7 Val_Wu8 1.00000000000 DFES_EnvTabVerb 0.00 1.00000000000 FORMAT "%13.11" /end CHARACTERISTIC
/begin CHARACTERISTIC DFES_EnvRef.DFC_AAVmin_C "used environment signals / Reference to used environment condition set for check DFC_AAVmin" VALUE 0x80504BA8 Val_Wu8 1.00000000000 DFES_EnvTabVerb 0.00 1.00000000000 FORMAT "%13.11" /end CHARACTERISTIC
/begin CHARACTERISTIC DFES_EnvRef.DFC_AGRSUS_C "used environment signals / Reference to used environment condition set for check DFC_AGRSUS" VALUE 0x80504BA9 Val_Wu8 1.00000000000 DFES_EnvTabVerb 0.00 1.00000000000 FORMAT "%13.11" /end CHARACTERISTIC
/begin CHARACTERISTIC DFES_EnvRef.DFC_AfsPlausDiagHi_C "used environment signals / Reference to used environment condition set for check DFC_AfsPlausDiagHi" VALUE 0x80504BAA Val_Wu8 1.00000000000 DFES_EnvTabVerb 0.00 1.00000000000 FORMAT "%13.11" /end CHARACTERISTIC
/begin CHARACTERISTIC DFES_EnvRef.DFC_AfsPlausDiagLo_C "used environment signals / Reference to used environment condition set for check DFC_AfsPlausDiagLo" VALUE 0x80504BAB Val_Wu8 1.00000000000 DFES_EnvTabVerb 0.00 1.00000000000 FORMAT "%13.11" /end CHARACTERISTIC
/begin CHARACTERISTIC DFES_EnvRef.DFC_AfsVrntDiagErrB1_C "used environment signals / Reference to used environment condition set for check DFC_AfsVrntDiagErrB1" VALUE 0x80504BAC Val_Wu8 1.00000000000 DFES_EnvTabVerb 0.00 1.00000000000 FORMAT "%13.11" /end CHARACTERISTIC
/begin CHARACTERISTIC DFES_EnvRef.DFC_AppAllSnsrDfct_C "used environment signals / Reference to used environment condition set for check DFC_AppAllSnsrDfct" VALUE 0x80504BAD Val_Wu8 1.00000000000 DFES_EnvTabVerb 0.00 1.00000000000 FORMAT "%13.11" /end CHARACTERISTIC
/begin CHARACTERISTIC DFES_EnvRef.DFC_BBKRnldg_C "used environment signals / Reference to used environment condition set for check DFC_BBKRnldg" VALUE 0x80504BAE Val_Wu8 1.00000000000 DFES_EnvTabVerb 0.00 1.00000000000 FORMAT "%13.11" /end CHARACTERISTIC
/begin CHARACTERISTIC DFES_EnvRef.DFC_BBKRsyne_C "used environment signals / Reference to used environment condition set for check DFC_BBKRsyne" VALUE 0x80504BAF Val_Wu8 1.00000000000 DFES_EnvTabVerb 0.00 1.00000000000 FORMAT "%13.11" /end CHARACTERISTIC
/begin CHARACTERISTIC DFES_EnvRef.DFC_BattUStdbyDiaOL_C "used environment signals / Reference to used environment condition set for check DFC_BattUStdbyDiaOL" VALUE 0x80504BB0 Val_Wu8 1.00000000000 DFES_EnvTabVerb 0.00 1.00000000000 FORMAT "%13.11" /end CHARACTERISTIC
/begin CHARACTERISTIC DFES_EnvRef.DFC_BigLeakIntkMnfldEmiInfl_C "used environment signals / Reference to used environment condition set for check DFC_BigLeakIntkMnfldEmiInfl" VALUE 0x80504BB1 Val_Wu8 1.00000000000 DFES_EnvTabVerb 0.00 1.00000000000 FORMAT "%13.11" /end CHARACTERISTIC
/begin CHARACTERISTIC DFES_EnvRef.DFC_BlkdLineTank_C "used environment signals / Reference to used environment condition set for check DFC_BlkdLineTank" VALUE 0x80504BB2 Val_Wu8 1.00000000000 DFES_EnvTabVerb 0.00 1.00000000000 FORMAT "%13.11" /end CHARACTERISTIC
/begin CHARACTERISTIC DFES_EnvRef.DFC_BrkMnSwtContOnWarnLmp_C "used environment signals / Reference to used environment condition set for check DFC_BrkMnSwtContOnWarnLmp" VALUE 0x80504BB3 Val_Wu8 1.00000000000 DFES_EnvTabVerb 0.00 1.00000000000 FORMAT "%13.11" /end CHARACTERISTIC
/begin CHARACTERISTIC DFES_EnvRef.DFC_BrkMnSwtNotStpWarnLmp_C "used environment signals / Reference to used environment condition set for check DFC_BrkMnSwtNotStpWarnLmp" VALUE 0x80504BB4 Val_Wu8 1.00000000000 DFES_EnvTabVerb 0.00 1.00000000000 FORMAT "%13.11" /end CHARACTERISTIC
/begin CHARACTERISTIC DFES_EnvRef.DFC_BrkRdntSwtContOnWarnLmp_C "used environment signals / Reference to used environment condition set for check DFC_BrkRdntSwtContOnWarnLmp" VALUE 0x80504BB5 Val_Wu8 1.00000000000 DFES_EnvTabVerb 0.00 1.00000000000 FORMAT "%13.11" /end CHARACTERISTIC
/begin CHARACTERISTIC DFES_EnvRef.DFC_BrkRdntSwtNotStpWarnLmp_C "used environment signals / Reference to used environment condition set for check DFC_BrkRdntSwtNotStpWarnLmp" VALUE 0x80504BB6 Val_Wu8 1.00000000000 DFES_EnvTabVerb 0.00 1.00000000000 FORMAT "%13.11" /end CHARACTERISTIC
/begin CHARACTERISTIC DFES_EnvRef.DFC_CEngDsTColdStrtMax_C "used environment signals / Reference to used environment condition set for check DFC_CEngDsTColdStrtMax" VALUE 0x80504BB7 Val_Wu8 1.00000000000 DFES_EnvTabVerb 0.00 1.00000000000 FORMAT "%13.11" /end CHARACTERISTIC
/begin CHARACTERISTIC DFES_EnvRef.DFC_CEngDsTColdStrtMin_C "used environment signals / Reference to used environment condition set for check DFC_CEngDsTColdStrtMin" VALUE 0x80504BB8 Val_Wu8 1.00000000000 DFES_EnvTabVerb 0.00 1.00000000000 FORMAT "%13.11" /end CHARACTERISTIC
/begin CHARACTERISTIC DFES_EnvRef.DFC_CEngDsTImps_C "used environment signals / Reference to used environment condition set for check DFC_CEngDsTImps" VALUE 0x80504BB9 Val_Wu8 1.00000000000 DFES_EnvTabVerb 0.00 1.00000000000 FORMAT "%13.11" /end CHARACTERISTIC
/begin CHARACTERISTIC DFES_EnvRef.DFC_CEngDsTPlausHSC_C "used environment signals / Reference to used environment condition set for check DFC_CEngDsTPlausHSC" VALUE 0x80504BBA Val_Wu8 1.00000000000 DFES_EnvTabVerb 0.00 1.00000000000 FORMAT "%13.11" /end CHARACTERISTIC
/begin CHARACTERISTIC DFES_EnvRef.DFC_CEngDsTPlausLSC_C "used environment signals / Reference to used environment condition set for check DFC_CEngDsTPlausLSC" VALUE 0x80504BBB Val_Wu8 1.00000000000 DFES_EnvTabVerb 0.00 1.00000000000 FORMAT "%13.11" /end CHARACTERISTIC
/begin CHARACTERISTIC DFES_EnvRef.DFC_CEngDsTPlausSTC_C "used environment signals / Reference to used environment condition set for check DFC_CEngDsTPlausSTC" VALUE 0x80504BBC Val_Wu8 1.00000000000 DFES_EnvTabVerb 0.00 1.00000000000 FORMAT "%13.11" /end CHARACTERISTIC
/begin CHARACTERISTIC DFES_EnvRef.DFC_CEngDsTSRCMax_C "used environment signals / Reference to used environment condition set for check DFC_CEngDsTSRCMax" VALUE 0x80504BBD Val_Wu8 1.00000000000 DFES_EnvTabVerb 0.00 1.00000000000 FORMAT "%13.11" /end CHARACTERISTIC
/begin CHARACTERISTIC DFES_EnvRef.DFC_CEngDsTSRCMin_C "used environment signals / Reference to used environment condition set for check DFC_CEngDsTSRCMin" VALUE 0x80504BBE Val_Wu8 1.00000000000 DFES_EnvTabVerb 0.00 1.00000000000 FORMAT "%13.11" /end CHARACTERISTIC
/begin CHARACTERISTIC DFES_EnvRef.DFC_CEngDsTSig_C "used environment signals / Reference to used environment condition set for check DFC_CEngDsTSig" VALUE 0x80504BBF Val_Wu8 1.00000000000 DFES_EnvTabVerb 0.00 1.00000000000 FORMAT "%13.11" /end CHARACTERISTIC
/begin CHARACTERISTIC DFES_EnvRef.DFC_CEngUsTColdStrtMax_C "used environment signals / Reference to used environment condition set for check DFC_CEngUsTColdStrtMax" VALUE 0x80504BC0 Val_Wu8 1.00000000000 DFES_EnvTabVerb 0.00 1.00000000000 FORMAT "%13.11" /end CHARACTERISTIC
/begin CHARACTERISTIC DFES_EnvRef.DFC_CEngUsTColdStrtMin_C "used environment signals / Reference to used environment condition set for check DFC_CEngUsTColdStrtMin" VALUE 0x80504BC1 Val_Wu8 1.00000000000 DFES_EnvTabVerb 0.00 1.00000000000 FORMAT "%13.11" /end CHARACTERISTIC
/begin CHARACTERISTIC DFES_EnvRef.DFC_CEngUsTLooseCnctn_C "used environment signals / Reference to used environment condition set for check DFC_CEngUsTLooseCnctn" VALUE 0x80504BC2 Val_Wu8 1.00000000000 DFES_EnvTabVerb 0.00 1.00000000000 FORMAT "%13.11" /end CHARACTERISTIC
/begin CHARACTERISTIC DFES_EnvRef.DFC_CEngUsTSRCMax_C "used environment signals / Reference to used environment condition set for check DFC_CEngUsTSRCMax" VALUE 0x80504BC3 Val_Wu8 1.00000000000 DFES_EnvTabVerb 0.00 1.00000000000 FORMAT "%13.11" /end CHARACTERISTIC
/begin CHARACTERISTIC DFES_EnvRef.DFC_CEngUsTSRCMin_C "used environment signals / Reference to used environment condition set for check DFC_CEngUsTSRCMin" VALUE 0x80504BC4 Val_Wu8 1.00000000000 DFES_EnvTabVerb 0.00 1.00000000000 FORMAT "%13.11" /end CHARACTERISTIC
/begin CHARACTERISTIC DFES_EnvRef.DFC_ComDCDCACCFailr_C "used environment signals / Reference to used environment condition set for check DFC_ComDCDCACCFailr" VALUE 0x80504BC5 Val_Wu8 1.00000000000 DFES_EnvTabVerb 0.00 1.00000000000 FORMAT "%13.11" /end CHARACTERISTIC
/begin CHARACTERISTIC DFES_EnvRef.DFC_DCDCFltDet_C "used environment signals / Reference to used environment condition set for check DFC_DCDCFltDet" VALUE 0x80504BC6 Val_Wu8 1.00000000000 DFES_EnvTabVerb 0.00 1.00000000000 FORMAT "%13.11" /end CHARACTERISTIC
/begin CHARACTERISTIC DFES_EnvRef.DFC_DKRSA_C "used environment signals / Reference to used environment condition set for check DFC_DKRSA" VALUE 0x80504BC7 Val_Wu8 1.00000000000 DFES_EnvTabVerb 0.00 1.00000000000 FORMAT "%13.11" /end CHARACTERISTIC
/begin CHARACTERISTIC DFES_EnvRef.DFC_DKVSmax_C "used environment signals / Reference to used environment condition set for check DFC_DKVSmax" VALUE 0x80504BC8 Val_Wu8 1.00000000000 DFES_EnvTabVerb 0.00 1.00000000000 FORMAT "%13.11" /end CHARACTERISTIC
/begin CHARACTERISTIC DFES_EnvRef.DFC_DKnpl_C "used environment signals / Reference to used environment condition set for check DFC_DKnpl" VALUE 0x80504BC9 Val_Wu8 1.00000000000 DFES_EnvTabVerb 0.00 1.00000000000 FORMAT "%13.11" /end CHARACTERISTIC
/begin CHARACTERISTIC DFES_EnvRef.DFC_DSKVRmax_C "used environment signals / Reference to used environment condition set for check DFC_DSKVRmax" VALUE 0x80504BCA Val_Wu8 1.00000000000 DFES_EnvTabVerb 0.00 1.00000000000 FORMAT "%13.11" /end CHARACTERISTIC
/begin CHARACTERISTIC DFES_EnvRef.DFC_DSKVRmin_C "used environment signals / Reference to used environment condition set for check DFC_DSKVRmin" VALUE 0x80504BCB Val_Wu8 1.00000000000 DFES_EnvTabVerb 0.00 1.00000000000 FORMAT "%13.11" /end CHARACTERISTIC
/begin CHARACTERISTIC DFES_EnvRef.DFC_DSKVRnpl_C "used environment signals / Reference to used environment condition set for check DFC_DSKVRnpl" VALUE 0x80504BCC Val_Wu8 1.00000000000 DFES_EnvTabVerb 0.00 1.00000000000 FORMAT "%13.11" /end CHARACTERISTIC
/begin CHARACTERISTIC DFES_EnvRef.DFC_DSKVRsig_C "used environment signals / Reference to used environment condition set for check DFC_DSKVRsig" VALUE 0x80504BCD Val_Wu8 1.00000000000 DFES_EnvTabVerb 0.00 1.00000000000 FORMAT "%13.11" /end CHARACTERISTIC
/begin CHARACTERISTIC DFES_EnvRef.DFC_DSKVSsig_C "used environment signals / Reference to used environment condition set for check DFC_DSKVSsig" VALUE 0x80504BCE Val_Wu8 1.00000000000 DFES_EnvTabVerb 0.00 1.00000000000 FORMAT "%13.11" /end CHARACTERISTIC
/begin CHARACTERISTIC DFES_EnvRef.DFC_DSSmax_C "used environment signals / Reference to used environment condition set for check DFC_DSSmax" VALUE 0x80504BCF Val_Wu8 1.00000000000 DFES_EnvTabVerb 0.00 1.00000000000 FORMAT "%13.11" /end CHARACTERISTIC
/begin CHARACTERISTIC DFES_EnvRef.DFC_DSTDmax_C "used environment signals / Reference to used environment condition set for check DFC_DSTDmax" VALUE 0x80504BD0 Val_Wu8 1.00000000000 DFES_EnvTabVerb 0.00 1.00000000000 FORMAT "%13.11" /end CHARACTERISTIC
/begin CHARACTERISTIC DFES_EnvRef.DFC_DSTEmax_C "used environment signals / Reference to used environment condition set for check DFC_DSTEmax" VALUE 0x80504BD1 Val_Wu8 1.00000000000 DFES_EnvTabVerb 0.00 1.00000000000 FORMAT "%13.11" /end CHARACTERISTIC
/begin CHARACTERISTIC DFES_EnvRef.DFC_DSTEmin_C "used environment signals / Reference to used environment condition set for check DFC_DSTEmin" VALUE 0x80504BD2 Val_Wu8 1.00000000000 DFES_EnvTabVerb 0.00 1.00000000000 FORMAT "%13.11" /end CHARACTERISTIC
/begin CHARACTERISTIC DFES_EnvRef.DFC_DSTOFmax_C "used environment signals / Reference to used environment condition set for check DFC_DSTOFmax" VALUE 0x80504BD3 Val_Wu8 1.00000000000 DFES_EnvTabVerb 0.00 1.00000000000 FORMAT "%13.11" /end CHARACTERISTIC
/begin CHARACTERISTIC DFES_EnvRef.DFC_DSTRmax_C "used environment signals / Reference to used environment condition set for check DFC_DSTRmax" VALUE 0x80504BD4 Val_Wu8 1.00000000000 DFES_EnvTabVerb 0.00 1.00000000000 FORMAT "%13.11" /end CHARACTERISTIC
/begin CHARACTERISTIC DFES_EnvRef.DFC_DSTRmin_C "used environment signals / Reference to used environment condition set for check DFC_DSTRmin" VALUE 0x80504BD5 Val_Wu8 1.00000000000 DFES_EnvTabVerb 0.00 1.00000000000 FORMAT "%13.11" /end CHARACTERISTIC
/begin CHARACTERISTIC DFES_EnvRef.DFC_DSTRnpl_C "used environment signals / Reference to used environment condition set for check DFC_DSTRnpl" VALUE 0x80504BD6 Val_Wu8 1.00000000000 DFES_EnvTabVerb 0.00 1.00000000000 FORMAT "%13.11" /end CHARACTERISTIC
/begin CHARACTERISTIC DFES_EnvRef.DFC_DSTRsig_C "used environment signals / Reference to used environment condition set for check DFC_DSTRsig" VALUE 0x80504BD7 Val_Wu8 1.00000000000 DFES_EnvTabVerb 0.00 1.00000000000 FORMAT "%13.11" /end CHARACTERISTIC
/begin CHARACTERISTIC DFES_EnvRef.DFC_DSTTI_C "used environment signals / Reference to used environment condition set for check DFC_DSTTI" VALUE 0x80504BD8 Val_Wu8 1.00000000000 DFES_EnvTabVerb 0.00 1.00000000000 FORMAT "%13.11" /end CHARACTERISTIC
/begin CHARACTERISTIC DFES_EnvRef.DFC_DSUmax_C "used environment signals / Reference to used environment condition set for check DFC_DSUmax" VALUE 0x80504BD9 Val_Wu8 1.00000000000 DFES_EnvTabVerb 0.00 1.00000000000 FORMAT "%13.11" /end CHARACTERISTIC
/begin CHARACTERISTIC DFES_EnvRef.DFC_DiagCpv1DteskLoLoadStuckClsd_C "used environment signals / Reference to used environment condition set for check DFC_DiagCpv1DteskLoLoadStuckClsd" VALUE 0x80504BDA Val_Wu8 1.00000000000 DFES_EnvTabVerb 0.00 1.00000000000 FORMAT "%13.11" /end CHARACTERISTIC
/begin CHARACTERISTIC DFES_EnvRef.DFC_DiagCpv1DteskLoLoadStuckOpen_C "used environment signals / Reference to used environment condition set for check DFC_DiagCpv1DteskLoLoadStuckOpen" VALUE 0x80504BDB Val_Wu8 1.00000000000 DFES_EnvTabVerb 0.00 1.00000000000 FORMAT "%13.11" /end CHARACTERISTIC
/begin CHARACTERISTIC DFES_EnvRef.DFC_EGRVlvDrftClsd_C "used environment signals / Reference to used environment condition set for check DFC_EGRVlvDrftClsd" VALUE 0x80504BDC Val_Wu8 1.00000000000 DFES_EnvTabVerb 0.00 1.00000000000 FORMAT "%13.11" /end CHARACTERISTIC
/begin CHARACTERISTIC DFES_EnvRef.DFC_EGRVlvDrftOpn_C "used environment signals / Reference to used environment condition set for check DFC_EGRVlvDrftOpn" VALUE 0x80504BDD Val_Wu8 1.00000000000 DFES_EnvTabVerb 0.00 1.00000000000 FORMAT "%13.11" /end CHARACTERISTIC
/begin CHARACTERISTIC DFES_EnvRef.DFC_EGRVlvJamVlvClsd_C "used environment signals / Reference to used environment condition set for check DFC_EGRVlvJamVlvClsd" VALUE 0x80504BDE Val_Wu8 1.00000000000 DFES_EnvTabVerb 0.00 1.00000000000 FORMAT "%13.11" /end CHARACTERISTIC
/begin CHARACTERISTIC DFES_EnvRef.DFC_EGRVlvJamVlvOpn_C "used environment signals / Reference to used environment condition set for check DFC_EGRVlvJamVlvOpn" VALUE 0x80504BDF Val_Wu8 1.00000000000 DFES_EnvTabVerb 0.00 1.00000000000 FORMAT "%13.11" /end CHARACTERISTIC
/begin CHARACTERISTIC DFES_EnvRef.DFC_EGRVlvSprgBrk_C "used environment signals / Reference to used environment condition set for check DFC_EGRVlvSprgBrk" VALUE 0x80504BE0 Val_Wu8 1.00000000000 DFES_EnvTabVerb 0.00 1.00000000000 FORMAT "%13.11" /end CHARACTERISTIC
/begin CHARACTERISTIC DFES_EnvRef.DFC_EGRVlvTempMdlEEPErr_C "used environment signals / Reference to used environment condition set for check DFC_EGRVlvTempMdlEEPErr" VALUE 0x80504BE1 Val_Wu8 1.00000000000 DFES_EnvTabVerb 0.00 1.00000000000 FORMAT "%13.11" /end CHARACTERISTIC
/begin CHARACTERISTIC DFES_EnvRef.DFC_EGRVlvTmpErr_C "used environment signals / Reference to used environment condition set for check DFC_EGRVlvTmpErr" VALUE 0x80504BE2 Val_Wu8 1.00000000000 DFES_EnvTabVerb 0.00 1.00000000000 FORMAT "%13.11" /end CHARACTERISTIC
/begin CHARACTERISTIC DFES_EnvRef.DFC_EGSDUS2B1LtrDly_C "used environment signals / Reference to used environment condition set for check DFC_EGSDUS2B1LtrDly" VALUE 0x80504BE3 Val_Wu8 1.00000000000 DFES_EnvTabVerb 0.00 1.00000000000 FORMAT "%13.11" /end CHARACTERISTIC
/begin CHARACTERISTIC DFES_EnvRef.DFC_EGSDUS2B1LtrPT1_C "used environment signals / Reference to used environment condition set for check DFC_EGSDUS2B1LtrPT1" VALUE 0x80504BE4 Val_Wu8 1.00000000000 DFES_EnvTabVerb 0.00 1.00000000000 FORMAT "%13.11" /end CHARACTERISTIC
/begin CHARACTERISTIC DFES_EnvRef.DFC_EGSDUS2B1RtlDly_C "used environment signals / Reference to used environment condition set for check DFC_EGSDUS2B1RtlDly" VALUE 0x80504BE5 Val_Wu8 1.00000000000 DFES_EnvTabVerb 0.00 1.00000000000 FORMAT "%13.11" /end CHARACTERISTIC
/begin CHARACTERISTIC DFES_EnvRef.DFC_EGSDUS2B1RtlPT1_C "used environment signals / Reference to used environment condition set for check DFC_EGSDUS2B1RtlPT1" VALUE 0x80504BE6 Val_Wu8 1.00000000000 DFES_EnvTabVerb 0.00 1.00000000000 FORMAT "%13.11" /end CHARACTERISTIC
/begin CHARACTERISTIC DFES_EnvRef.DFC_EGSDUS2B1TarLean_C "used environment signals / Reference to used environment condition set for check DFC_EGSDUS2B1TarLean" VALUE 0x80504BE7 Val_Wu8 1.00000000000 DFES_EnvTabVerb 0.00 1.00000000000 FORMAT "%13.11" /end CHARACTERISTIC
/begin CHARACTERISTIC DFES_EnvRef.DFC_EGSDUS2B1TarRich_C "used environment signals / Reference to used environment condition set for check DFC_EGSDUS2B1TarRich" VALUE 0x80504BE8 Val_Wu8 1.00000000000 DFES_EnvTabVerb 0.00 1.00000000000 FORMAT "%13.11" /end CHARACTERISTIC
/begin CHARACTERISTIC DFES_EnvRef.DFC_EONVmax_C "used environment signals / Reference to used environment condition set for check DFC_EONVmax" VALUE 0x80504BE9 Val_Wu8 1.00000000000 DFES_EnvTabVerb 0.00 1.00000000000 FORMAT "%13.11" /end CHARACTERISTIC
/begin CHARACTERISTIC DFES_EnvRef.DFC_ETAKHLmax_C "used environment signals / Reference to used environment condition set for check DFC_ETAKHLmax" VALUE 0x80504BEA Val_Wu8 1.00000000000 DFES_EnvTabVerb 0.00 1.00000000000 FORMAT "%13.11" /end CHARACTERISTIC
/begin CHARACTERISTIC DFES_EnvRef.DFC_ETAKHTmax_C "used environment signals / Reference to used environment condition set for check DFC_ETAKHTmax" VALUE 0x80504BEB Val_Wu8 1.00000000000 DFES_EnvTabVerb 0.00 1.00000000000 FORMAT "%13.11" /end CHARACTERISTIC
/begin CHARACTERISTIC DFES_EnvRef.DFC_ETHSEmax_C "used environment signals / Reference to used environment condition set for check DFC_ETHSEmax" VALUE 0x80504BEC Val_Wu8 1.00000000000 DFES_EnvTabVerb 0.00 1.00000000000 FORMAT "%13.11" /end CHARACTERISTIC
/begin CHARACTERISTIC DFES_EnvRef.DFC_ETHSEmin_C "used environment signals / Reference to used environment condition set for check DFC_ETHSEmin" VALUE 0x80504BED Val_Wu8 1.00000000000 DFES_EnvTabVerb 0.00 1.00000000000 FORMAT "%13.11" /end CHARACTERISTIC
/begin CHARACTERISTIC DFES_EnvRef.DFC_ETHSFmax_C "used environment signals / Reference to used environment condition set for check DFC_ETHSFmax" VALUE 0x80504BEE Val_Wu8 1.00000000000 DFES_EnvTabVerb 0.00 1.00000000000 FORMAT "%13.11" /end CHARACTERISTIC
/begin CHARACTERISTIC DFES_EnvRef.DFC_ETHSFmin_C "used environment signals / Reference to used environment condition set for check DFC_ETHSFmin" VALUE 0x80504BEF Val_Wu8 1.00000000000 DFES_EnvTabVerb 0.00 1.00000000000 FORMAT "%13.11" /end CHARACTERISTIC
/begin CHARACTERISTIC DFES_EnvRef.DFC_ETHSFsig_C "used environment signals / Reference to used environment condition set for check DFC_ETHSFsig" VALUE 0x80504BF0 Val_Wu8 1.00000000000 DFES_EnvTabVerb 0.00 1.00000000000 FORMAT "%13.11" /end CHARACTERISTIC
/begin CHARACTERISTIC DFES_EnvRef.DFC_ETHSNPWmax_C "used environment signals / Reference to used environment condition set for check DFC_ETHSNPWmax" VALUE 0x80504BF1 Val_Wu8 1.00000000000 DFES_EnvTabVerb 0.00 1.00000000000 FORMAT "%13.11" /end CHARACTERISTIC
/begin CHARACTERISTIC DFES_EnvRef.DFC_ETHSNPWmin_C "used environment signals / Reference to used environment condition set for check DFC_ETHSNPWmin" VALUE 0x80504BF2 Val_Wu8 1.00000000000 DFES_EnvTabVerb 0.00 1.00000000000 FORMAT "%13.11" /end CHARACTERISTIC
/begin CHARACTERISTIC DFES_EnvRef.DFC_ETHSNPWsig_C "used environment signals / Reference to used environment condition set for check DFC_ETHSNPWsig" VALUE 0x80504BF3 Val_Wu8 1.00000000000 DFES_EnvTabVerb 0.00 1.00000000000 FORMAT "%13.11" /end CHARACTERISTIC
/begin CHARACTERISTIC DFES_EnvRef.DFC_ETHSPLnpl_C "used environment signals / Reference to used environment condition set for check DFC_ETHSPLnpl" VALUE 0x80504BF4 Val_Wu8 1.00000000000 DFES_EnvTabVerb 0.00 1.00000000000 FORMAT "%13.11" /end CHARACTERISTIC
/begin CHARACTERISTIC DFES_EnvRef.DFC_ETHSTPLnpl_C "used environment signals / Reference to used environment condition set for check DFC_ETHSTPLnpl" VALUE 0x80504BF5 Val_Wu8 1.00000000000 DFES_EnvTabVerb 0.00 1.00000000000 FORMAT "%13.11" /end CHARACTERISTIC
/begin CHARACTERISTIC DFES_EnvRef.DFC_EngICO_C "used environment signals / Reference to used environment condition set for check DFC_EngICO" VALUE 0x80504BF6 Val_Wu8 1.00000000000 DFES_EnvTabVerb 0.00 1.00000000000 FORMAT "%13.11" /end CHARACTERISTIC
/begin CHARACTERISTIC DFES_EnvRef.DFC_EngPrtOvrSpdMon_C "used environment signals / Reference to used environment condition set for check DFC_EngPrtOvrSpdMon" VALUE 0x80504BF7 Val_Wu8 1.00000000000 DFES_EnvTabVerb 0.00 1.00000000000 FORMAT "%13.11" /end CHARACTERISTIC
/begin CHARACTERISTIC DFES_EnvRef.DFC_EpmCaSI1ErrSig_C "used environment signals / Reference to used environment condition set for check DFC_EpmCaSI1ErrSig" VALUE 0x80504BF8 Val_Wu8 1.00000000000 DFES_EnvTabVerb 0.00 1.00000000000 FORMAT "%13.11" /end CHARACTERISTIC
/begin CHARACTERISTIC DFES_EnvRef.DFC_EpmCaSI1MntErr_C "used environment signals / Reference to used environment condition set for check DFC_EpmCaSI1MntErr" VALUE 0x80504BF9 Val_Wu8 1.00000000000 DFES_EnvTabVerb 0.00 1.00000000000 FORMAT "%13.11" /end CHARACTERISTIC
/begin CHARACTERISTIC DFES_EnvRef.DFC_EpmCaSI1NoSigMax_C "used environment signals / Reference to used environment condition set for check DFC_EpmCaSI1NoSigMax" VALUE 0x80504BFA Val_Wu8 1.00000000000 DFES_EnvTabVerb 0.00 1.00000000000 FORMAT "%13.11" /end CHARACTERISTIC
/begin CHARACTERISTIC DFES_EnvRef.DFC_EpmCaSI1NoSigMin_C "used environment signals / Reference to used environment condition set for check DFC_EpmCaSI1NoSigMin" VALUE 0x80504BFB Val_Wu8 1.00000000000 DFES_EnvTabVerb 0.00 1.00000000000 FORMAT "%13.11" /end CHARACTERISTIC
/begin CHARACTERISTIC DFES_EnvRef.DFC_EpmCaSI1OfsErr_C "used environment signals / Reference to used environment condition set for check DFC_EpmCaSI1OfsErr" VALUE 0x80504BFC Val_Wu8 1.00000000000 DFES_EnvTabVerb 0.00 1.00000000000 FORMAT "%13.11" /end CHARACTERISTIC
/begin CHARACTERISTIC DFES_EnvRef.DFC_EpmCrSDGI_C "used environment signals / Reference to used environment condition set for check DFC_EpmCrSDGI" VALUE 0x80504BFD Val_Wu8 1.00000000000 DFES_EnvTabVerb 0.00 1.00000000000 FORMAT "%13.11" /end CHARACTERISTIC
/begin CHARACTERISTIC DFES_EnvRef.DFC_EpmCrSErrSig_C "used environment signals / Reference to used environment condition set for check DFC_EpmCrSErrSig" VALUE 0x80504BFE Val_Wu8 1.00000000000 DFES_EnvTabVerb 0.00 1.00000000000 FORMAT "%13.11" /end CHARACTERISTIC
/begin CHARACTERISTIC DFES_EnvRef.DFC_EpmCrSNoSig_C "used environment signals / Reference to used environment condition set for check DFC_EpmCrSNoSig" VALUE 0x80504BFF Val_Wu8 1.00000000000 DFES_EnvTabVerb 0.00 1.00000000000 FORMAT "%13.11" /end CHARACTERISTIC
/begin CHARACTERISTIC DFES_EnvRef.DFC_EtaEngIdleNonCsers_C "used environment signals / Reference to used environment condition set for check DFC_EtaEngIdleNonCsers" VALUE 0x80504C00 Val_Wu8 1.00000000000 DFES_EnvTabVerb 0.00 1.00000000000 FORMAT "%13.11" /end CHARACTERISTIC
/begin CHARACTERISTIC DFES_EnvRef.DFC_EtaEngPtlNonCsers_C "used environment signals / Reference to used environment condition set for check DFC_EtaEngPtlNonCsers" VALUE 0x80504C01 Val_Wu8 1.00000000000 DFES_EnvTabVerb 0.00 1.00000000000 FORMAT "%13.11" /end CHARACTERISTIC
/begin CHARACTERISTIC DFES_EnvRef.DFC_FRAmax_C "used environment signals / Reference to used environment condition set for check DFC_FRAmax" VALUE 0x80504C02 Val_Wu8 1.00000000000 DFES_EnvTabVerb 0.00 1.00000000000 FORMAT "%13.11" /end CHARACTERISTIC
/begin CHARACTERISTIC DFES_EnvRef.DFC_FRAmin_C "used environment signals / Reference to used environment condition set for check DFC_FRAmin" VALUE 0x80504C03 Val_Wu8 1.00000000000 DFES_EnvTabVerb 0.00 1.00000000000 FORMAT "%13.11" /end CHARACTERISTIC
/begin CHARACTERISTIC DFES_EnvRef.DFC_FSTEmax_C "used environment signals / Reference to used environment condition set for check DFC_FSTEmax" VALUE 0x80504C04 Val_Wu8 1.00000000000 DFES_EnvTabVerb 0.00 1.00000000000 FORMAT "%13.11" /end CHARACTERISTIC
/begin CHARACTERISTIC DFES_EnvRef.DFC_FSTEmin_C "used environment signals / Reference to used environment condition set for check DFC_FSTEmin" VALUE 0x80504C05 Val_Wu8 1.00000000000 DFES_EnvTabVerb 0.00 1.00000000000 FORMAT "%13.11" /end CHARACTERISTIC
/begin CHARACTERISTIC DFES_EnvRef.DFC_FSTRmax_C "used environment signals / Reference to used environment condition set for check DFC_FSTRmax" VALUE 0x80504C06 Val_Wu8 1.00000000000 DFES_EnvTabVerb 0.00 1.00000000000 FORMAT "%13.11" /end CHARACTERISTIC
/begin CHARACTERISTIC DFES_EnvRef.DFC_FSTRmin_C "used environment signals / Reference to used environment condition set for check DFC_FSTRmin" VALUE 0x80504C07 Val_Wu8 1.00000000000 DFES_EnvTabVerb 0.00 1.00000000000 FORMAT "%13.11" /end CHARACTERISTIC
/begin CHARACTERISTIC DFES_EnvRef.DFC_FSTRnpl_C "used environment signals / Reference to used environment condition set for check DFC_FSTRnpl" VALUE 0x80504C08 Val_Wu8 1.00000000000 DFES_EnvTabVerb 0.00 1.00000000000 FORMAT "%13.11" /end CHARACTERISTIC
/begin CHARACTERISTIC DFES_EnvRef.DFC_FSTmax_C "used environment signals / Reference to used environment condition set for check DFC_FSTmax" VALUE 0x80504C09 Val_Wu8 1.00000000000 DFES_EnvTabVerb 0.00 1.00000000000 FORMAT "%13.11" /end CHARACTERISTIC
/begin CHARACTERISTIC DFES_EnvRef.DFC_FTDLAmax_C "used environment signals / Reference to used environment condition set for check DFC_FTDLAmax" VALUE 0x80504C0A Val_Wu8 1.00000000000 DFES_EnvTabVerb 0.00 1.00000000000 FORMAT "%13.11" /end CHARACTERISTIC
/begin CHARACTERISTIC DFES_EnvRef.DFC_FTDLAmin_C "used environment signals / Reference to used environment condition set for check DFC_FTDLAmin" VALUE 0x80504C0B Val_Wu8 1.00000000000 DFES_EnvTabVerb 0.00 1.00000000000 FORMAT "%13.11" /end CHARACTERISTIC
/begin CHARACTERISTIC DFES_EnvRef.DFC_FuPHiSnsrEleclmax_C "used environment signals / Reference to used environment condition set for check DFC_FuPHiSnsrEleclmax" VALUE 0x80504C0C Val_Wu8 1.00000000000 DFES_EnvTabVerb 0.00 1.00000000000 FORMAT "%13.11" /end CHARACTERISTIC
/begin CHARACTERISTIC DFES_EnvRef.DFC_FuPHiSnsrEleclmin_C "used environment signals / Reference to used environment condition set for check DFC_FuPHiSnsrEleclmin" VALUE 0x80504C0D Val_Wu8 1.00000000000 DFES_EnvTabVerb 0.00 1.00000000000 FORMAT "%13.11" /end CHARACTERISTIC
/begin CHARACTERISTIC DFES_EnvRef.DFC_FuPHiSnsrEleclnpl_C "used environment signals / Reference to used environment condition set for check DFC_FuPHiSnsrEleclnpl" VALUE 0x80504C0E Val_Wu8 1.00000000000 DFES_EnvTabVerb 0.00 1.00000000000 FORMAT "%13.11" /end CHARACTERISTIC
/begin CHARACTERISTIC DFES_EnvRef.DFC_FuPHiSnsrURngMax_C "used environment signals / Reference to used environment condition set for check DFC_FuPHiSnsrURngMax" VALUE 0x80504C0F Val_Wu8 1.00000000000 DFES_EnvTabVerb 0.00 1.00000000000 FORMAT "%13.11" /end CHARACTERISTIC
/begin CHARACTERISTIC DFES_EnvRef.DFC_FuPHiSnsrURngMin_C "used environment signals / Reference to used environment condition set for check DFC_FuPHiSnsrURngMin" VALUE 0x80504C10 Val_Wu8 1.00000000000 DFES_EnvTabVerb 0.00 1.00000000000 FORMAT "%13.11" /end CHARACTERISTIC
/begin CHARACTERISTIC DFES_EnvRef.DFC_FuSnsrPhyRngMaxErr_C "used environment signals / Reference to used environment condition set for check DFC_FuSnsrPhyRngMaxErr" VALUE 0x80504C11 Val_Wu8 1.00000000000 DFES_EnvTabVerb 0.00 1.00000000000 FORMAT "%13.11" /end CHARACTERISTIC
/begin CHARACTERISTIC DFES_EnvRef.DFC_FuSnsrPhyRngMinErr_C "used environment signals / Reference to used environment condition set for check DFC_FuSnsrPhyRngMinErr" VALUE 0x80504C12 Val_Wu8 1.00000000000 DFES_EnvTabVerb 0.00 1.00000000000 FORMAT "%13.11" /end CHARACTERISTIC
/begin CHARACTERISTIC DFES_EnvRef.DFC_GEVlvLockPinDiagIntkB1_C "used environment signals / Reference to used environment condition set for check DFC_GEVlvLockPinDiagIntkB1" VALUE 0x80504C13 Val_Wu8 1.00000000000 DFES_EnvTabVerb 0.00 1.00000000000 FORMAT "%13.11" /end CHARACTERISTIC
/begin CHARACTERISTIC DFES_EnvRef.DFC_GEVlvPhaSlowIntkB1_C "used environment signals / Reference to used environment condition set for check DFC_GEVlvPhaSlowIntkB1" VALUE 0x80504C14 Val_Wu8 1.00000000000 DFES_EnvTabVerb 0.00 1.00000000000 FORMAT "%13.11" /end CHARACTERISTIC
/begin CHARACTERISTIC DFES_EnvRef.DFC_GEVlvPhaTargIntkB1_C "used environment signals / Reference to used environment condition set for check DFC_GEVlvPhaTargIntkB1" VALUE 0x80504C15 Val_Wu8 1.00000000000 DFES_EnvTabVerb 0.00 1.00000000000 FORMAT "%13.11" /end CHARACTERISTIC
/begin CHARACTERISTIC DFES_EnvRef.DFC_GbxRvsSwtStk_C "used environment signals / Reference to used environment condition set for check DFC_GbxRvsSwtStk" VALUE 0x80504C16 Val_Wu8 1.00000000000 DFES_EnvTabVerb 0.00 1.00000000000 FORMAT "%13.11" /end CHARACTERISTIC
/begin CHARACTERISTIC DFES_EnvRef.DFC_HDRKHmax_C "used environment signals / Reference to used environment condition set for check DFC_HDRKHmax" VALUE 0x80504C17 Val_Wu8 1.00000000000 DFES_EnvTabVerb 0.00 1.00000000000 FORMAT "%13.11" /end CHARACTERISTIC
/begin CHARACTERISTIC DFES_EnvRef.DFC_HDRKHmin_C "used environment signals / Reference to used environment condition set for check DFC_HDRKHmin" VALUE 0x80504C18 Val_Wu8 1.00000000000 DFES_EnvTabVerb 0.00 1.00000000000 FORMAT "%13.11" /end CHARACTERISTIC
/begin CHARACTERISTIC DFES_EnvRef.DFC_HDRPLmax_C "used environment signals / Reference to used environment condition set for check DFC_HDRPLmax" VALUE 0x80504C19 Val_Wu8 1.00000000000 DFES_EnvTabVerb 0.00 1.00000000000 FORMAT "%13.11" /end CHARACTERISTIC
/begin CHARACTERISTIC DFES_EnvRef.DFC_HDRPLmin_C "used environment signals / Reference to used environment condition set for check DFC_HDRPLmin" VALUE 0x80504C1A Val_Wu8 1.00000000000 DFES_EnvTabVerb 0.00 1.00000000000 FORMAT "%13.11" /end CHARACTERISTIC
/begin CHARACTERISTIC DFES_EnvRef.DFC_HDRmax_C "used environment signals / Reference to used environment condition set for check DFC_HDRmax" VALUE 0x80504C1B Val_Wu8 1.00000000000 DFES_EnvTabVerb 0.00 1.00000000000 FORMAT "%13.11" /end CHARACTERISTIC
/begin CHARACTERISTIC DFES_EnvRef.DFC_HDRmin_C "used environment signals / Reference to used environment condition set for check DFC_HDRmin" VALUE 0x80504C1C Val_Wu8 1.00000000000 DFES_EnvTabVerb 0.00 1.00000000000 FORMAT "%13.11" /end CHARACTERISTIC
/begin CHARACTERISTIC DFES_EnvRef.DFC_HEGOS2B1ElecMax_C "used environment signals / Reference to used environment condition set for check DFC_HEGOS2B1ElecMax" VALUE 0x80504C1D Val_Wu8 1.00000000000 DFES_EnvTabVerb 0.00 1.00000000000 FORMAT "%13.11" /end CHARACTERISTIC
/begin CHARACTERISTIC DFES_EnvRef.DFC_HEGOS2B1ElecMin_C "used environment signals / Reference to used environment condition set for check DFC_HEGOS2B1ElecMin" VALUE 0x80504C1E Val_Wu8 1.00000000000 DFES_EnvTabVerb 0.00 1.00000000000 FORMAT "%13.11" /end CHARACTERISTIC
/begin CHARACTERISTIC DFES_EnvRef.DFC_HEGOS2B1ElecSig_C "used environment signals / Reference to used environment condition set for check DFC_HEGOS2B1ElecSig" VALUE 0x80504C1F Val_Wu8 1.00000000000 DFES_EnvTabVerb 0.00 1.00000000000 FORMAT "%13.11" /end CHARACTERISTIC
/begin CHARACTERISTIC DFES_EnvRef.DFC_HEGOS2B1HtgNpl_C "used environment signals / Reference to used environment condition set for check DFC_HEGOS2B1HtgNpl" VALUE 0x80504C20 Val_Wu8 1.00000000000 DFES_EnvTabVerb 0.00 1.00000000000 FORMAT "%13.11" /end CHARACTERISTIC
/begin CHARACTERISTIC DFES_EnvRef.DFC_HEV00max_C "used environment signals / Reference to used environment condition set for check DFC_HEV00max" VALUE 0x80504C21 Val_Wu8 1.00000000000 DFES_EnvTabVerb 0.00 1.00000000000 FORMAT "%13.11" /end CHARACTERISTIC
/begin CHARACTERISTIC DFES_EnvRef.DFC_HEV01max_C "used environment signals / Reference to used environment condition set for check DFC_HEV01max" VALUE 0x80504C22 Val_Wu8 1.00000000000 DFES_EnvTabVerb 0.00 1.00000000000 FORMAT "%13.11" /end CHARACTERISTIC
/begin CHARACTERISTIC DFES_EnvRef.DFC_HEV02max_C "used environment signals / Reference to used environment condition set for check DFC_HEV02max" VALUE 0x80504C23 Val_Wu8 1.00000000000 DFES_EnvTabVerb 0.00 1.00000000000 FORMAT "%13.11" /end CHARACTERISTIC
/begin CHARACTERISTIC DFES_EnvRef.DFC_HEV03max_C "used environment signals / Reference to used environment condition set for check DFC_HEV03max" VALUE 0x80504C24 Val_Wu8 1.00000000000 DFES_EnvTabVerb 0.00 1.00000000000 FORMAT "%13.11" /end CHARACTERISTIC
/begin CHARACTERISTIC DFES_EnvRef.DFC_HEVE0max_C "used environment signals / Reference to used environment condition set for check DFC_HEVE0max" VALUE 0x80504C25 Val_Wu8 1.00000000000 DFES_EnvTabVerb 0.00 1.00000000000 FORMAT "%13.11" /end CHARACTERISTIC
/begin CHARACTERISTIC DFES_EnvRef.DFC_HEVE1max_C "used environment signals / Reference to used environment condition set for check DFC_HEVE1max" VALUE 0x80504C26 Val_Wu8 1.00000000000 DFES_EnvTabVerb 0.00 1.00000000000 FORMAT "%13.11" /end CHARACTERISTIC
/begin CHARACTERISTIC DFES_EnvRef.DFC_HFMmax_C "used environment signals / Reference to used environment condition set for check DFC_HFMmax" VALUE 0x80504C27 Val_Wu8 1.00000000000 DFES_EnvTabVerb 0.00 1.00000000000 FORMAT "%13.11" /end CHARACTERISTIC
/begin CHARACTERISTIC DFES_EnvRef.DFC_HiPSysHiPMaxLimExcdd_C "used environment signals / Reference to used environment condition set for check DFC_HiPSysHiPMaxLimExcdd" VALUE 0x80504C28 Val_Wu8 1.00000000000 DFES_EnvTabVerb 0.00 1.00000000000 FORMAT "%13.11" /end CHARACTERISTIC
/begin CHARACTERISTIC DFES_EnvRef.DFC_IVGdiCtlCvoErrMax_0_C "used environment signals / Reference to used environment condition set for check DFC_IVGdiCtlCvoErrMax_0" VALUE 0x80504C29 Val_Wu8 1.00000000000 DFES_EnvTabVerb 0.00 1.00000000000 FORMAT "%13.11" /end CHARACTERISTIC
/begin CHARACTERISTIC DFES_EnvRef.DFC_IVGdiCtlCvoErrMax_1_C "used environment signals / Reference to used environment condition set for check DFC_IVGdiCtlCvoErrMax_1" VALUE 0x80504C2A Val_Wu8 1.00000000000 DFES_EnvTabVerb 0.00 1.00000000000 FORMAT "%13.11" /end CHARACTERISTIC
/begin CHARACTERISTIC DFES_EnvRef.DFC_IVGdiCtlCvoErrMax_2_C "used environment signals / Reference to used environment condition set for check DFC_IVGdiCtlCvoErrMax_2" VALUE 0x80504C2B Val_Wu8 1.00000000000 DFES_EnvTabVerb 0.00 1.00000000000 FORMAT "%13.11" /end CHARACTERISTIC
/begin CHARACTERISTIC DFES_EnvRef.DFC_IVGdiCtlCvoErrMax_3_C "used environment signals / Reference to used environment condition set for check DFC_IVGdiCtlCvoErrMax_3" VALUE 0x80504C2C Val_Wu8 1.00000000000 DFES_EnvTabVerb 0.00 1.00000000000 FORMAT "%13.11" /end CHARACTERISTIC
/begin CHARACTERISTIC DFES_EnvRef.DFC_IVGdiCtlCvoErrMin_0_C "used environment signals / Reference to used environment condition set for check DFC_IVGdiCtlCvoErrMin_0" VALUE 0x80504C2D Val_Wu8 1.00000000000 DFES_EnvTabVerb 0.00 1.00000000000 FORMAT "%13.11" /end CHARACTERISTIC
/begin CHARACTERISTIC DFES_EnvRef.DFC_IVGdiCtlCvoErrMin_1_C "used environment signals / Reference to used environment condition set for check DFC_IVGdiCtlCvoErrMin_1" VALUE 0x80504C2E Val_Wu8 1.00000000000 DFES_EnvTabVerb 0.00 1.00000000000 FORMAT "%13.11" /end CHARACTERISTIC
/begin CHARACTERISTIC DFES_EnvRef.DFC_IVGdiCtlCvoErrMin_2_C "used environment signals / Reference to used environment condition set for check DFC_IVGdiCtlCvoErrMin_2" VALUE 0x80504C2F Val_Wu8 1.00000000000 DFES_EnvTabVerb 0.00 1.00000000000 FORMAT "%13.11" /end CHARACTERISTIC
/begin CHARACTERISTIC DFES_EnvRef.DFC_IVGdiCtlCvoErrMin_3_C "used environment signals / Reference to used environment condition set for check DFC_IVGdiCtlCvoErrMin_3" VALUE 0x80504C30 Val_Wu8 1.00000000000 DFES_EnvTabVerb 0.00 1.00000000000 FORMAT "%13.11" /end CHARACTERISTIC
/begin CHARACTERISTIC DFES_EnvRef.DFC_IVGdiCtlCvoErrMinMax_C "used environment signals / Reference to used environment condition set for check DFC_IVGdiCtlCvoErrMinMax" VALUE 0x80504C31 Val_Wu8 1.00000000000 DFES_EnvTabVerb 0.00 1.00000000000 FORMAT "%13.11" /end CHARACTERISTIC
/begin CHARACTERISTIC DFES_EnvRef.DFC_IVGdiCtlCvoSigPlausErrSmrCdn_C "used environment signals / Reference to used environment condition set for check DFC_IVGdiCtlCvoSigPlausErrSmrCdn" VALUE 0x80504C32 Val_Wu8 1.00000000000 DFES_EnvTabVerb 0.00 1.00000000000 FORMAT "%13.11" /end CHARACTERISTIC
/begin CHARACTERISTIC DFES_EnvRef.DFC_IVGdiCtl_CvoErr_C "used environment signals / Reference to used environment condition set for check DFC_IVGdiCtl_CvoErr" VALUE 0x80504C33 Val_Wu8 1.00000000000 DFES_EnvTabVerb 0.00 1.00000000000 FORMAT "%13.11" /end CHARACTERISTIC
/begin CHARACTERISTIC DFES_EnvRef.DFC_IVGdiCtl_CvoSigPlaus_0_C "used environment signals / Reference to used environment condition set for check DFC_IVGdiCtl_CvoSigPlaus_0" VALUE 0x80504C34 Val_Wu8 1.00000000000 DFES_EnvTabVerb 0.00 1.00000000000 FORMAT "%13.11" /end CHARACTERISTIC
/begin CHARACTERISTIC DFES_EnvRef.DFC_IVGdiCtl_CvoSigPlaus_1_C "used environment signals / Reference to used environment condition set for check DFC_IVGdiCtl_CvoSigPlaus_1" VALUE 0x80504C35 Val_Wu8 1.00000000000 DFES_EnvTabVerb 0.00 1.00000000000 FORMAT "%13.11" /end CHARACTERISTIC
/begin CHARACTERISTIC DFES_EnvRef.DFC_IVGdiCtl_CvoSigPlaus_2_C "used environment signals / Reference to used environment condition set for check DFC_IVGdiCtl_CvoSigPlaus_2" VALUE 0x80504C36 Val_Wu8 1.00000000000 DFES_EnvTabVerb 0.00 1.00000000000 FORMAT "%13.11" /end CHARACTERISTIC
/begin CHARACTERISTIC DFES_EnvRef.DFC_IVGdiCtl_CvoSigPlaus_3_C "used environment signals / Reference to used environment condition set for check DFC_IVGdiCtl_CvoSigPlaus_3" VALUE 0x80504C37 Val_Wu8 1.00000000000 DFES_EnvTabVerb 0.00 1.00000000000 FORMAT "%13.11" /end CHARACTERISTIC
/begin CHARACTERISTIC DFES_EnvRef.DFC_IntkAirTAirFltDsCrssMax_C "used environment signals / Reference to used environment condition set for check DFC_IntkAirTAirFltDsCrssMax" VALUE 0x80504C38 Val_Wu8 1.00000000000 DFES_EnvTabVerb 0.00 1.00000000000 FORMAT "%13.11" /end CHARACTERISTIC
/begin CHARACTERISTIC DFES_EnvRef.DFC_IntkAirTAirFltDsCrssMin_C "used environment signals / Reference to used environment condition set for check DFC_IntkAirTAirFltDsCrssMin" VALUE 0x80504C39 Val_Wu8 1.00000000000 DFES_EnvTabVerb 0.00 1.00000000000 FORMAT "%13.11" /end CHARACTERISTIC
/begin CHARACTERISTIC DFES_EnvRef.DFC_IntkAirTAirFltDsHSCMax_C "used environment signals / Reference to used environment condition set for check DFC_IntkAirTAirFltDsHSCMax" VALUE 0x80504C3A Val_Wu8 1.00000000000 DFES_EnvTabVerb 0.00 1.00000000000 FORMAT "%13.11" /end CHARACTERISTIC
/begin CHARACTERISTIC DFES_EnvRef.DFC_IntkAirTAirFltDsImps_C "used environment signals / Reference to used environment condition set for check DFC_IntkAirTAirFltDsImps" VALUE 0x80504C3B Val_Wu8 1.00000000000 DFES_EnvTabVerb 0.00 1.00000000000 FORMAT "%13.11" /end CHARACTERISTIC
/begin CHARACTERISTIC DFES_EnvRef.DFC_IntkAirTAirFltDsPRCMax_C "used environment signals / Reference to used environment condition set for check DFC_IntkAirTAirFltDsPRCMax" VALUE 0x80504C3C Val_Wu8 1.00000000000 DFES_EnvTabVerb 0.00 1.00000000000 FORMAT "%13.11" /end CHARACTERISTIC
/begin CHARACTERISTIC DFES_EnvRef.DFC_IntkAirTAirFltDsPRCMin_C "used environment signals / Reference to used environment condition set for check DFC_IntkAirTAirFltDsPRCMin" VALUE 0x80504C3D Val_Wu8 1.00000000000 DFES_EnvTabVerb 0.00 1.00000000000 FORMAT "%13.11" /end CHARACTERISTIC
/begin CHARACTERISTIC DFES_EnvRef.DFC_IntkAirTAirFltDsSRCMax_C "used environment signals / Reference to used environment condition set for check DFC_IntkAirTAirFltDsSRCMax" VALUE 0x80504C3E Val_Wu8 1.00000000000 DFES_EnvTabVerb 0.00 1.00000000000 FORMAT "%13.11" /end CHARACTERISTIC
/begin CHARACTERISTIC DFES_EnvRef.DFC_IntkAirTAirFltDsSRCMin_C "used environment signals / Reference to used environment condition set for check DFC_IntkAirTAirFltDsSRCMin" VALUE 0x80504C3F Val_Wu8 1.00000000000 DFES_EnvTabVerb 0.00 1.00000000000 FORMAT "%13.11" /end CHARACTERISTIC
/begin CHARACTERISTIC DFES_EnvRef.DFC_IntkAirTAirFltDsSTC_C "used environment signals / Reference to used environment condition set for check DFC_IntkAirTAirFltDsSTC" VALUE 0x80504C40 Val_Wu8 1.00000000000 DFES_EnvTabVerb 0.00 1.00000000000 FORMAT "%13.11" /end CHARACTERISTIC
/begin CHARACTERISTIC DFES_EnvRef.DFC_IntkAirTIntkMnfldCrssMax_C "used environment signals / Reference to used environment condition set for check DFC_IntkAirTIntkMnfldCrssMax" VALUE 0x80504C41 Val_Wu8 1.00000000000 DFES_EnvTabVerb 0.00 1.00000000000 FORMAT "%13.11" /end CHARACTERISTIC
/begin CHARACTERISTIC DFES_EnvRef.DFC_IntkAirTIntkMnfldCrssMin_C "used environment signals / Reference to used environment condition set for check DFC_IntkAirTIntkMnfldCrssMin" VALUE 0x80504C42 Val_Wu8 1.00000000000 DFES_EnvTabVerb 0.00 1.00000000000 FORMAT "%13.11" /end CHARACTERISTIC
/begin CHARACTERISTIC DFES_EnvRef.DFC_IntkAirTIntkMnfldHSCMax_C "used environment signals / Reference to used environment condition set for check DFC_IntkAirTIntkMnfldHSCMax" VALUE 0x80504C43 Val_Wu8 1.00000000000 DFES_EnvTabVerb 0.00 1.00000000000 FORMAT "%13.11" /end CHARACTERISTIC
/begin CHARACTERISTIC DFES_EnvRef.DFC_IntkAirTIntkMnfldImps_C "used environment signals / Reference to used environment condition set for check DFC_IntkAirTIntkMnfldImps" VALUE 0x80504C44 Val_Wu8 1.00000000000 DFES_EnvTabVerb 0.00 1.00000000000 FORMAT "%13.11" /end CHARACTERISTIC
/begin CHARACTERISTIC DFES_EnvRef.DFC_IntkAirTIntkMnfldPRCMax_C "used environment signals / Reference to used environment condition set for check DFC_IntkAirTIntkMnfldPRCMax" VALUE 0x80504C45 Val_Wu8 1.00000000000 DFES_EnvTabVerb 0.00 1.00000000000 FORMAT "%13.11" /end CHARACTERISTIC
/begin CHARACTERISTIC DFES_EnvRef.DFC_IntkAirTIntkMnfldPRCMin_C "used environment signals / Reference to used environment condition set for check DFC_IntkAirTIntkMnfldPRCMin" VALUE 0x80504C46 Val_Wu8 1.00000000000 DFES_EnvTabVerb 0.00 1.00000000000 FORMAT "%13.11" /end CHARACTERISTIC
/begin CHARACTERISTIC DFES_EnvRef.DFC_IntkAirTIntkMnfldSRCMax_C "used environment signals / Reference to used environment condition set for check DFC_IntkAirTIntkMnfldSRCMax" VALUE 0x80504C47 Val_Wu8 1.00000000000 DFES_EnvTabVerb 0.00 1.00000000000 FORMAT "%13.11" /end CHARACTERISTIC
/begin CHARACTERISTIC DFES_EnvRef.DFC_IntkAirTIntkMnfldSRCMin_C "used environment signals / Reference to used environment condition set for check DFC_IntkAirTIntkMnfldSRCMin" VALUE 0x80504C48 Val_Wu8 1.00000000000 DFES_EnvTabVerb 0.00 1.00000000000 FORMAT "%13.11" /end CHARACTERISTIC
/begin CHARACTERISTIC DFES_EnvRef.DFC_IntkAirTIntkMnfldSTC_C "used environment signals / Reference to used environment condition set for check DFC_IntkAirTIntkMnfldSTC" VALUE 0x80504C49 Val_Wu8 1.00000000000 DFES_EnvTabVerb 0.00 1.00000000000 FORMAT "%13.11" /end CHARACTERISTIC
/begin CHARACTERISTIC DFES_EnvRef.DFC_KRREGRLMX_C "used environment signals / Reference to used environment condition set for check DFC_KRREGRLMX" VALUE 0x80504C4A Val_Wu8 1.00000000000 DFES_EnvTabVerb 0.00 1.00000000000 FORMAT "%13.11" /end CHARACTERISTIC
/begin CHARACTERISTIC DFES_EnvRef.DFC_KRVEKOCVLCI_C "used environment signals / Reference to used environment condition set for check DFC_KRVEKOCVLCI" VALUE 0x80504C4B Val_Wu8 1.00000000000 DFES_EnvTabVerb 0.00 1.00000000000 FORMAT "%13.11" /end CHARACTERISTIC
/begin CHARACTERISTIC DFES_EnvRef.DFC_KRVEKOENCHMT_C "used environment signals / Reference to used environment condition set for check DFC_KRVEKOENCHMT" VALUE 0x80504C4C Val_Wu8 1.00000000000 DFES_EnvTabVerb 0.00 1.00000000000 FORMAT "%13.11" /end CHARACTERISTIC
/begin CHARACTERISTIC DFES_EnvRef.DFC_KRVEKOENCHMT0_C "used environment signals / Reference to used environment condition set for check DFC_KRVEKOENCHMT0" VALUE 0x80504C4D Val_Wu8 1.00000000000 DFES_EnvTabVerb 0.00 1.00000000000 FORMAT "%13.11" /end CHARACTERISTIC
/begin CHARACTERISTIC DFES_EnvRef.DFC_KRVEKOENCHMT1_C "used environment signals / Reference to used environment condition set for check DFC_KRVEKOENCHMT1" VALUE 0x80504C4E Val_Wu8 1.00000000000 DFES_EnvTabVerb 0.00 1.00000000000 FORMAT "%13.11" /end CHARACTERISTIC
/begin CHARACTERISTIC DFES_EnvRef.DFC_KRVEKOENCHMT2_C "used environment signals / Reference to used environment condition set for check DFC_KRVEKOENCHMT2" VALUE 0x80504C4F Val_Wu8 1.00000000000 DFES_EnvTabVerb 0.00 1.00000000000 FORMAT "%13.11" /end CHARACTERISTIC
/begin CHARACTERISTIC DFES_EnvRef.DFC_KRVEKOENCHMT3_C "used environment signals / Reference to used environment condition set for check DFC_KRVEKOENCHMT3" VALUE 0x80504C50 Val_Wu8 1.00000000000 DFES_EnvTabVerb 0.00 1.00000000000 FORMAT "%13.11" /end CHARACTERISTIC
/begin CHARACTERISTIC DFES_EnvRef.DFC_KRVEKOENCHMT4_C "used environment signals / Reference to used environment condition set for check DFC_KRVEKOENCHMT4" VALUE 0x80504C51 Val_Wu8 1.00000000000 DFES_EnvTabVerb 0.00 1.00000000000 FORMAT "%13.11" /end CHARACTERISTIC
/begin CHARACTERISTIC DFES_EnvRef.DFC_KRVEKOENCHMT5_C "used environment signals / Reference to used environment condition set for check DFC_KRVEKOENCHMT5" VALUE 0x80504C52 Val_Wu8 1.00000000000 DFES_EnvTabVerb 0.00 1.00000000000 FORMAT "%13.11" /end CHARACTERISTIC
/begin CHARACTERISTIC DFES_EnvRef.DFC_KRVEKOENCHMT6_C "used environment signals / Reference to used environment condition set for check DFC_KRVEKOENCHMT6" VALUE 0x80504C53 Val_Wu8 1.00000000000 DFES_EnvTabVerb 0.00 1.00000000000 FORMAT "%13.11" /end CHARACTERISTIC
/begin CHARACTERISTIC DFES_EnvRef.DFC_KRVEKOENCHMT7_C "used environment signals / Reference to used environment condition set for check DFC_KRVEKOENCHMT7" VALUE 0x80504C54 Val_Wu8 1.00000000000 DFES_EnvTabVerb 0.00 1.00000000000 FORMAT "%13.11" /end CHARACTERISTIC
/begin CHARACTERISTIC DFES_EnvRef.DFC_KRVEKORLMX_C "used environment signals / Reference to used environment condition set for check DFC_KRVEKORLMX" VALUE 0x80504C55 Val_Wu8 1.00000000000 DFES_EnvTabVerb 0.00 1.00000000000 FORMAT "%13.11" /end CHARACTERISTIC
/begin CHARACTERISTIC DFES_EnvRef.DFC_KRVEKORLMXL_C "used environment signals / Reference to used environment condition set for check DFC_KRVEKORLMXL" VALUE 0x80504C56 Val_Wu8 1.00000000000 DFES_EnvTabVerb 0.00 1.00000000000 FORMAT "%13.11" /end CHARACTERISTIC
/begin CHARACTERISTIC DFES_EnvRef.DFC_KS1max_C "used environment signals / Reference to used environment condition set for check DFC_KS1max" VALUE 0x80504C57 Val_Wu8 1.00000000000 DFES_EnvTabVerb 0.00 1.00000000000 FORMAT "%13.11" /end CHARACTERISTIC
/begin CHARACTERISTIC DFES_EnvRef.DFC_KS1min_C "used environment signals / Reference to used environment condition set for check DFC_KS1min" VALUE 0x80504C58 Val_Wu8 1.00000000000 DFES_EnvTabVerb 0.00 1.00000000000 FORMAT "%13.11" /end CHARACTERISTIC
/begin CHARACTERISTIC DFES_EnvRef.DFC_LMmax_C "used environment signals / Reference to used environment condition set for check DFC_LMmax" VALUE 0x80504C59 Val_Wu8 1.00000000000 DFES_EnvTabVerb 0.00 1.00000000000 FORMAT "%13.11" /end CHARACTERISTIC
/begin CHARACTERISTIC DFES_EnvRef.DFC_LZSRnpl_C "used environment signals / Reference to used environment condition set for check DFC_LZSRnpl" VALUE 0x80504C5A Val_Wu8 1.00000000000 DFES_EnvTabVerb 0.00 1.00000000000 FORMAT "%13.11" /end CHARACTERISTIC
/begin CHARACTERISTIC DFES_EnvRef.DFC_LamDynDiagS1B1_C "used environment signals / Reference to used environment condition set for check DFC_LamDynDiagS1B1" VALUE 0x80504C5B Val_Wu8 1.00000000000 DFES_EnvTabVerb 0.00 1.00000000000 FORMAT "%13.11" /end CHARACTERISTIC
/begin CHARACTERISTIC DFES_EnvRef.DFC_LeakIntkMnfldEmiInfl_C "used environment signals / Reference to used environment condition set for check DFC_LeakIntkMnfldEmiInfl" VALUE 0x80504C5C Val_Wu8 1.00000000000 DFES_EnvTabVerb 0.00 1.00000000000 FORMAT "%13.11" /end CHARACTERISTIC
/begin CHARACTERISTIC DFES_EnvRef.DFC_LinFrameErrDCDC_C "used environment signals / Reference to used environment condition set for check DFC_LinFrameErrDCDC" VALUE 0x80504C5D Val_Wu8 1.00000000000 DFES_EnvTabVerb 0.00 1.00000000000 FORMAT "%13.11" /end CHARACTERISTIC
/begin CHARACTERISTIC DFES_EnvRef.DFC_LinOverrunErrDCDC_C "used environment signals / Reference to used environment condition set for check DFC_LinOverrunErrDCDC" VALUE 0x80504C5E Val_Wu8 1.00000000000 DFES_EnvTabVerb 0.00 1.00000000000 FORMAT "%13.11" /end CHARACTERISTIC
/begin CHARACTERISTIC DFES_EnvRef.DFC_MD00max_C "used environment signals / Reference to used environment condition set for check DFC_MD00max" VALUE 0x80504C5F Val_Wu8 1.00000000000 DFES_EnvTabVerb 0.00 1.00000000000 FORMAT "%13.11" /end CHARACTERISTIC
/begin CHARACTERISTIC DFES_EnvRef.DFC_MDBmax_C "used environment signals / Reference to used environment condition set for check DFC_MDBmax" VALUE 0x80504C60 Val_Wu8 1.00000000000 DFES_EnvTabVerb 0.00 1.00000000000 FORMAT "%13.11" /end CHARACTERISTIC
/begin CHARACTERISTIC DFES_EnvRef.DFC_MDCat_C "used environment signals / Reference to used environment condition set for check DFC_MDCat" VALUE 0x80504C61 Val_Wu8 1.00000000000 DFES_EnvTabVerb 0.00 1.00000000000 FORMAT "%13.11" /end CHARACTERISTIC
/begin CHARACTERISTIC DFES_EnvRef.DFC_MDCatCrit_C "used environment signals / Reference to used environment condition set for check DFC_MDCatCrit" VALUE 0x80504C62 Val_Wu8 1.00000000000 DFES_EnvTabVerb 0.00 1.00000000000 FORMAT "%13.11" /end CHARACTERISTIC
/begin CHARACTERISTIC DFES_EnvRef.DFC_MDCatCurr_C "used environment signals / Reference to used environment condition set for check DFC_MDCatCurr" VALUE 0x80504C63 Val_Wu8 1.00000000000 DFES_EnvTabVerb 0.00 1.00000000000 FORMAT "%13.11" /end CHARACTERISTIC
/begin CHARACTERISTIC DFES_EnvRef.DFC_MDCyl_0_C "used environment signals / Reference to used environment condition set for check DFC_MDCyl_0" VALUE 0x80504C64 Val_Wu8 1.00000000000 DFES_EnvTabVerb 0.00 1.00000000000 FORMAT "%13.11" /end CHARACTERISTIC
/begin CHARACTERISTIC DFES_EnvRef.DFC_MDCyl_1_C "used environment signals / Reference to used environment condition set for check DFC_MDCyl_1" VALUE 0x80504C65 Val_Wu8 1.00000000000 DFES_EnvTabVerb 0.00 1.00000000000 FORMAT "%13.11" /end CHARACTERISTIC
/begin CHARACTERISTIC DFES_EnvRef.DFC_MDCyl_2_C "used environment signals / Reference to used environment condition set for check DFC_MDCyl_2" VALUE 0x80504C66 Val_Wu8 1.00000000000 DFES_EnvTabVerb 0.00 1.00000000000 FORMAT "%13.11" /end CHARACTERISTIC
/begin CHARACTERISTIC DFES_EnvRef.DFC_MDCyl_3_C "used environment signals / Reference to used environment condition set for check DFC_MDCyl_3" VALUE 0x80504C67 Val_Wu8 1.00000000000 DFES_EnvTabVerb 0.00 1.00000000000 FORMAT "%13.11" /end CHARACTERISTIC
/begin CHARACTERISTIC DFES_EnvRef.DFC_MDEmi_C "used environment signals / Reference to used environment condition set for check DFC_MDEmi" VALUE 0x80504C68 Val_Wu8 1.00000000000 DFES_EnvTabVerb 0.00 1.00000000000 FORMAT "%13.11" /end CHARACTERISTIC
/begin CHARACTERISTIC DFES_EnvRef.DFC_MDEmiStrt_C "used environment signals / Reference to used environment condition set for check DFC_MDEmiStrt" VALUE 0x80504C69 Val_Wu8 1.00000000000 DFES_EnvTabVerb 0.00 1.00000000000 FORMAT "%13.11" /end CHARACTERISTIC
/begin CHARACTERISTIC DFES_EnvRef.DFC_MDFco_C "used environment signals / Reference to used environment condition set for check DFC_MDFco" VALUE 0x80504C6A Val_Wu8 1.00000000000 DFES_EnvTabVerb 0.00 1.00000000000 FORMAT "%13.11" /end CHARACTERISTIC
/begin CHARACTERISTIC DFES_EnvRef.DFC_MDMpl_C "used environment signals / Reference to used environment condition set for check DFC_MDMpl" VALUE 0x80504C6B Val_Wu8 1.00000000000 DFES_EnvTabVerb 0.00 1.00000000000 FORMAT "%13.11" /end CHARACTERISTIC
/begin CHARACTERISTIC DFES_EnvRef.DFC_MDSegTiAdpn_C "used environment signals / Reference to used environment condition set for check DFC_MDSegTiAdpn" VALUE 0x80504C6C Val_Wu8 1.00000000000 DFES_EnvTabVerb 0.00 1.00000000000 FORMAT "%13.11" /end CHARACTERISTIC
/begin CHARACTERISTIC DFES_EnvRef.DFC_MDmax_C "used environment signals / Reference to used environment condition set for check DFC_MDmax" VALUE 0x80504C6D Val_Wu8 1.00000000000 DFES_EnvTabVerb 0.00 1.00000000000 FORMAT "%13.11" /end CHARACTERISTIC
/begin CHARACTERISTIC DFES_EnvRef.DFC_MFuOilMax_C "used environment signals / Reference to used environment condition set for check DFC_MFuOilMax" VALUE 0x80504C6E Val_Wu8 1.00000000000 DFES_EnvTabVerb 0.00 1.00000000000 FORMAT "%13.11" /end CHARACTERISTIC
/begin CHARACTERISTIC DFES_EnvRef.DFC_MOXEMM_SMU_ALM0_0_C "used environment signals / Reference to used environment condition set for check DFC_MOXEMM_SMU_ALM0_0" VALUE 0x80504C6F Val_Wu8 1.00000000000 DFES_EnvTabVerb 0.00 1.00000000000 FORMAT "%13.11" /end CHARACTERISTIC
/begin CHARACTERISTIC DFES_EnvRef.DFC_MOXEMM_SMU_ALM0_1_C "used environment signals / Reference to used environment condition set for check DFC_MOXEMM_SMU_ALM0_1" VALUE 0x80504C70 Val_Wu8 1.00000000000 DFES_EnvTabVerb 0.00 1.00000000000 FORMAT "%13.11" /end CHARACTERISTIC
/begin CHARACTERISTIC DFES_EnvRef.DFC_MOXEMM_SMU_ALM0_10_C "used environment signals / Reference to used environment condition set for check DFC_MOXEMM_SMU_ALM0_10" VALUE 0x80504C71 Val_Wu8 1.00000000000 DFES_EnvTabVerb 0.00 1.00000000000 FORMAT "%13.11" /end CHARACTERISTIC
/begin CHARACTERISTIC DFES_EnvRef.DFC_MOXEMM_SMU_ALM0_11_C "used environment signals / Reference to used environment condition set for check DFC_MOXEMM_SMU_ALM0_11" VALUE 0x80504C72 Val_Wu8 1.00000000000 DFES_EnvTabVerb 0.00 1.00000000000 FORMAT "%13.11" /end CHARACTERISTIC
/begin CHARACTERISTIC DFES_EnvRef.DFC_MOXEMM_SMU_ALM0_13_C "used environment signals / Reference to used environment condition set for check DFC_MOXEMM_SMU_ALM0_13" VALUE 0x80504C73 Val_Wu8 1.00000000000 DFES_EnvTabVerb 0.00 1.00000000000 FORMAT "%13.11" /end CHARACTERISTIC
/begin CHARACTERISTIC DFES_EnvRef.DFC_MOXEMM_SMU_ALM0_14_C "used environment signals / Reference to used environment condition set for check DFC_MOXEMM_SMU_ALM0_14" VALUE 0x80504C74 Val_Wu8 1.00000000000 DFES_EnvTabVerb 0.00 1.00000000000 FORMAT "%13.11" /end CHARACTERISTIC
/begin CHARACTERISTIC DFES_EnvRef.DFC_MOXEMM_SMU_ALM0_2_C "used environment signals / Reference to used environment condition set for check DFC_MOXEMM_SMU_ALM0_2" VALUE 0x80504C75 Val_Wu8 1.00000000000 DFES_EnvTabVerb 0.00 1.00000000000 FORMAT "%13.11" /end CHARACTERISTIC
/begin CHARACTERISTIC DFES_EnvRef.DFC_MOXEMM_SMU_ALM0_22_C "used environment signals / Reference to used environment condition set for check DFC_MOXEMM_SMU_ALM0_22" VALUE 0x80504C76 Val_Wu8 1.00000000000 DFES_EnvTabVerb 0.00 1.00000000000 FORMAT "%13.11" /end CHARACTERISTIC
/begin CHARACTERISTIC DFES_EnvRef.DFC_MOXEMM_SMU_ALM0_23_C "used environment signals / Reference to used environment condition set for check DFC_MOXEMM_SMU_ALM0_23" VALUE 0x80504C77 Val_Wu8 1.00000000000 DFES_EnvTabVerb 0.00 1.00000000000 FORMAT "%13.11" /end CHARACTERISTIC
/begin CHARACTERISTIC DFES_EnvRef.DFC_MOXEMM_SMU_ALM0_4_C "used environment signals / Reference to used environment condition set for check DFC_MOXEMM_SMU_ALM0_4" VALUE 0x80504C78 Val_Wu8 1.00000000000 DFES_EnvTabVerb 0.00 1.00000000000 FORMAT "%13.11" /end CHARACTERISTIC
/begin CHARACTERISTIC DFES_EnvRef.DFC_MOXEMM_SMU_ALM0_5_C "used environment signals / Reference to used environment condition set for check DFC_MOXEMM_SMU_ALM0_5" VALUE 0x80504C79 Val_Wu8 1.00000000000 DFES_EnvTabVerb 0.00 1.00000000000 FORMAT "%13.11" /end CHARACTERISTIC
/begin CHARACTERISTIC DFES_EnvRef.DFC_MOXEMM_SMU_ALM0_7_C "used environment signals / Reference to used environment condition set for check DFC_MOXEMM_SMU_ALM0_7" VALUE 0x80504C7A Val_Wu8 1.00000000000 DFES_EnvTabVerb 0.00 1.00000000000 FORMAT "%13.11" /end CHARACTERISTIC
/begin CHARACTERISTIC DFES_EnvRef.DFC_MOXEMM_SMU_ALM0_8_C "used environment signals / Reference to used environment condition set for check DFC_MOXEMM_SMU_ALM0_8" VALUE 0x80504C7B Val_Wu8 1.00000000000 DFES_EnvTabVerb 0.00 1.00000000000 FORMAT "%13.11" /end CHARACTERISTIC
/begin CHARACTERISTIC DFES_EnvRef.DFC_MOXEMM_SMU_ALM10_16_C "used environment signals / Reference to used environment condition set for check DFC_MOXEMM_SMU_ALM10_16" VALUE 0x80504C7C Val_Wu8 1.00000000000 DFES_EnvTabVerb 0.00 1.00000000000 FORMAT "%13.11" /end CHARACTERISTIC
/begin CHARACTERISTIC DFES_EnvRef.DFC_MOXEMM_SMU_ALM10_17_C "used environment signals / Reference to used environment condition set for check DFC_MOXEMM_SMU_ALM10_17" VALUE 0x80504C7D Val_Wu8 1.00000000000 DFES_EnvTabVerb 0.00 1.00000000000 FORMAT "%13.11" /end CHARACTERISTIC
/begin CHARACTERISTIC DFES_EnvRef.DFC_MOXEMM_SMU_ALM10_21_C "used environment signals / Reference to used environment condition set for check DFC_MOXEMM_SMU_ALM10_21" VALUE 0x80504C7E Val_Wu8 1.00000000000 DFES_EnvTabVerb 0.00 1.00000000000 FORMAT "%13.11" /end CHARACTERISTIC
/begin CHARACTERISTIC DFES_EnvRef.DFC_MOXEMM_SMU_ALM11_0_C "used environment signals / Reference to used environment condition set for check DFC_MOXEMM_SMU_ALM11_0" VALUE 0x80504C7F Val_Wu8 1.00000000000 DFES_EnvTabVerb 0.00 1.00000000000 FORMAT "%13.11" /end CHARACTERISTIC
/begin CHARACTERISTIC DFES_EnvRef.DFC_MOXEMM_SMU_ALM11_1_C "used environment signals / Reference to used environment condition set for check DFC_MOXEMM_SMU_ALM11_1" VALUE 0x80504C80 Val_Wu8 1.00000000000 DFES_EnvTabVerb 0.00 1.00000000000 FORMAT "%13.11" /end CHARACTERISTIC
/begin CHARACTERISTIC DFES_EnvRef.DFC_MOXEMM_SMU_ALM11_2_C "used environment signals / Reference to used environment condition set for check DFC_MOXEMM_SMU_ALM11_2" VALUE 0x80504C81 Val_Wu8 1.00000000000 DFES_EnvTabVerb 0.00 1.00000000000 FORMAT "%13.11" /end CHARACTERISTIC
/begin CHARACTERISTIC DFES_EnvRef.DFC_MOXEMM_SMU_ALM11_3_C "used environment signals / Reference to used environment condition set for check DFC_MOXEMM_SMU_ALM11_3" VALUE 0x80504C82 Val_Wu8 1.00000000000 DFES_EnvTabVerb 0.00 1.00000000000 FORMAT "%13.11" /end CHARACTERISTIC
/begin CHARACTERISTIC DFES_EnvRef.DFC_MOXEMM_SMU_ALM11_4_C "used environment signals / Reference to used environment condition set for check DFC_MOXEMM_SMU_ALM11_4" VALUE 0x80504C83 Val_Wu8 1.00000000000 DFES_EnvTabVerb 0.00 1.00000000000 FORMAT "%13.11" /end CHARACTERISTIC
/begin CHARACTERISTIC DFES_EnvRef.DFC_MOXEMM_SMU_ALM11_5_C "used environment signals / Reference to used environment condition set for check DFC_MOXEMM_SMU_ALM11_5" VALUE 0x80504C84 Val_Wu8 1.00000000000 DFES_EnvTabVerb 0.00 1.00000000000 FORMAT "%13.11" /end CHARACTERISTIC
/begin CHARACTERISTIC DFES_EnvRef.DFC_MOXEMM_SMU_ALM11_8_C "used environment signals / Reference to used environment condition set for check DFC_MOXEMM_SMU_ALM11_8" VALUE 0x80504C85 Val_Wu8 1.00000000000 DFES_EnvTabVerb 0.00 1.00000000000 FORMAT "%13.11" /end CHARACTERISTIC
/begin CHARACTERISTIC DFES_EnvRef.DFC_MOXEMM_SMU_ALM11_9_C "used environment signals / Reference to used environment condition set for check DFC_MOXEMM_SMU_ALM11_9" VALUE 0x80504C86 Val_Wu8 1.00000000000 DFES_EnvTabVerb 0.00 1.00000000000 FORMAT "%13.11" /end CHARACTERISTIC
/begin CHARACTERISTIC DFES_EnvRef.DFC_MOXEMM_SMU_ALM1_0_C "used environment signals / Reference to used environment condition set for check DFC_MOXEMM_SMU_ALM1_0" VALUE 0x80504C87 Val_Wu8 1.00000000000 DFES_EnvTabVerb 0.00 1.00000000000 FORMAT "%13.11" /end CHARACTERISTIC
/begin CHARACTERISTIC DFES_EnvRef.DFC_MOXEMM_SMU_ALM1_1_C "used environment signals / Reference to used environment condition set for check DFC_MOXEMM_SMU_ALM1_1" VALUE 0x80504C88 Val_Wu8 1.00000000000 DFES_EnvTabVerb 0.00 1.00000000000 FORMAT "%13.11" /end CHARACTERISTIC
/begin CHARACTERISTIC DFES_EnvRef.DFC_MOXEMM_SMU_ALM1_10_C "used environment signals / Reference to used environment condition set for check DFC_MOXEMM_SMU_ALM1_10" VALUE 0x80504C89 Val_Wu8 1.00000000000 DFES_EnvTabVerb 0.00 1.00000000000 FORMAT "%13.11" /end CHARACTERISTIC
/begin CHARACTERISTIC DFES_EnvRef.DFC_MOXEMM_SMU_ALM1_11_C "used environment signals / Reference to used environment condition set for check DFC_MOXEMM_SMU_ALM1_11" VALUE 0x80504C8A Val_Wu8 1.00000000000 DFES_EnvTabVerb 0.00 1.00000000000 FORMAT "%13.11" /end CHARACTERISTIC
/begin CHARACTERISTIC DFES_EnvRef.DFC_MOXEMM_SMU_ALM1_13_C "used environment signals / Reference to used environment condition set for check DFC_MOXEMM_SMU_ALM1_13" VALUE 0x80504C8B Val_Wu8 1.00000000000 DFES_EnvTabVerb 0.00 1.00000000000 FORMAT "%13.11" /end CHARACTERISTIC
/begin CHARACTERISTIC DFES_EnvRef.DFC_MOXEMM_SMU_ALM1_14_C "used environment signals / Reference to used environment condition set for check DFC_MOXEMM_SMU_ALM1_14" VALUE 0x80504C8C Val_Wu8 1.00000000000 DFES_EnvTabVerb 0.00 1.00000000000 FORMAT "%13.11" /end CHARACTERISTIC
/begin CHARACTERISTIC DFES_EnvRef.DFC_MOXEMM_SMU_ALM1_2_C "used environment signals / Reference to used environment condition set for check DFC_MOXEMM_SMU_ALM1_2" VALUE 0x80504C8D Val_Wu8 1.00000000000 DFES_EnvTabVerb 0.00 1.00000000000 FORMAT "%13.11" /end CHARACTERISTIC
/begin CHARACTERISTIC DFES_EnvRef.DFC_MOXEMM_SMU_ALM1_22_C "used environment signals / Reference to used environment condition set for check DFC_MOXEMM_SMU_ALM1_22" VALUE 0x80504C8E Val_Wu8 1.00000000000 DFES_EnvTabVerb 0.00 1.00000000000 FORMAT "%13.11" /end CHARACTERISTIC
/begin CHARACTERISTIC DFES_EnvRef.DFC_MOXEMM_SMU_ALM1_23_C "used environment signals / Reference to used environment condition set for check DFC_MOXEMM_SMU_ALM1_23" VALUE 0x80504C8F Val_Wu8 1.00000000000 DFES_EnvTabVerb 0.00 1.00000000000 FORMAT "%13.11" /end CHARACTERISTIC
/begin CHARACTERISTIC DFES_EnvRef.DFC_MOXEMM_SMU_ALM1_4_C "used environment signals / Reference to used environment condition set for check DFC_MOXEMM_SMU_ALM1_4" VALUE 0x80504C90 Val_Wu8 1.00000000000 DFES_EnvTabVerb 0.00 1.00000000000 FORMAT "%13.11" /end CHARACTERISTIC
/begin CHARACTERISTIC DFES_EnvRef.DFC_MOXEMM_SMU_ALM1_5_C "used environment signals / Reference to used environment condition set for check DFC_MOXEMM_SMU_ALM1_5" VALUE 0x80504C91 Val_Wu8 1.00000000000 DFES_EnvTabVerb 0.00 1.00000000000 FORMAT "%13.11" /end CHARACTERISTIC
/begin CHARACTERISTIC DFES_EnvRef.DFC_MOXEMM_SMU_ALM1_7_C "used environment signals / Reference to used environment condition set for check DFC_MOXEMM_SMU_ALM1_7" VALUE 0x80504C92 Val_Wu8 1.00000000000 DFES_EnvTabVerb 0.00 1.00000000000 FORMAT "%13.11" /end CHARACTERISTIC
/begin CHARACTERISTIC DFES_EnvRef.DFC_MOXEMM_SMU_ALM1_8_C "used environment signals / Reference to used environment condition set for check DFC_MOXEMM_SMU_ALM1_8" VALUE 0x80504C93 Val_Wu8 1.00000000000 DFES_EnvTabVerb 0.00 1.00000000000 FORMAT "%13.11" /end CHARACTERISTIC
/begin CHARACTERISTIC DFES_EnvRef.DFC_MOXEMM_SMU_ALM21_0_C "used environment signals / Reference to used environment condition set for check DFC_MOXEMM_SMU_ALM21_0" VALUE 0x80504C94 Val_Wu8 1.00000000000 DFES_EnvTabVerb 0.00 1.00000000000 FORMAT "%13.11" /end CHARACTERISTIC
/begin CHARACTERISTIC DFES_EnvRef.DFC_MOXEMM_SMU_ALM21_16_C "used environment signals / Reference to used environment condition set for check DFC_MOXEMM_SMU_ALM21_16" VALUE 0x80504C95 Val_Wu8 1.00000000000 DFES_EnvTabVerb 0.00 1.00000000000 FORMAT "%13.11" /end CHARACTERISTIC
/begin CHARACTERISTIC DFES_EnvRef.DFC_MOXEMM_SMU_ALM21_3_C "used environment signals / Reference to used environment condition set for check DFC_MOXEMM_SMU_ALM21_3" VALUE 0x80504C96 Val_Wu8 1.00000000000 DFES_EnvTabVerb 0.00 1.00000000000 FORMAT "%13.11" /end CHARACTERISTIC
/begin CHARACTERISTIC DFES_EnvRef.DFC_MOXEMM_SMU_ALM2_1_C "used environment signals / Reference to used environment condition set for check DFC_MOXEMM_SMU_ALM2_1" VALUE 0x80504C97 Val_Wu8 1.00000000000 DFES_EnvTabVerb 0.00 1.00000000000 FORMAT "%13.11" /end CHARACTERISTIC
/begin CHARACTERISTIC DFES_EnvRef.DFC_MOXEMM_SMU_ALM2_10_C "used environment signals / Reference to used environment condition set for check DFC_MOXEMM_SMU_ALM2_10" VALUE 0x80504C98 Val_Wu8 1.00000000000 DFES_EnvTabVerb 0.00 1.00000000000 FORMAT "%13.11" /end CHARACTERISTIC
/begin CHARACTERISTIC DFES_EnvRef.DFC_MOXEMM_SMU_ALM2_11_C "used environment signals / Reference to used environment condition set for check DFC_MOXEMM_SMU_ALM2_11" VALUE 0x80504C99 Val_Wu8 1.00000000000 DFES_EnvTabVerb 0.00 1.00000000000 FORMAT "%13.11" /end CHARACTERISTIC
/begin CHARACTERISTIC DFES_EnvRef.DFC_MOXEMM_SMU_ALM2_13_C "used environment signals / Reference to used environment condition set for check DFC_MOXEMM_SMU_ALM2_13" VALUE 0x80504C9A Val_Wu8 1.00000000000 DFES_EnvTabVerb 0.00 1.00000000000 FORMAT "%13.11" /end CHARACTERISTIC
/begin CHARACTERISTIC DFES_EnvRef.DFC_MOXEMM_SMU_ALM2_14_C "used environment signals / Reference to used environment condition set for check DFC_MOXEMM_SMU_ALM2_14" VALUE 0x80504C9B Val_Wu8 1.00000000000 DFES_EnvTabVerb 0.00 1.00000000000 FORMAT "%13.11" /end CHARACTERISTIC
/begin CHARACTERISTIC DFES_EnvRef.DFC_MOXEMM_SMU_ALM2_22_C "used environment signals / Reference to used environment condition set for check DFC_MOXEMM_SMU_ALM2_22" VALUE 0x80504C9C Val_Wu8 1.00000000000 DFES_EnvTabVerb 0.00 1.00000000000 FORMAT "%13.11" /end CHARACTERISTIC
/begin CHARACTERISTIC DFES_EnvRef.DFC_MOXEMM_SMU_ALM2_23_C "used environment signals / Reference to used environment condition set for check DFC_MOXEMM_SMU_ALM2_23" VALUE 0x80504C9D Val_Wu8 1.00000000000 DFES_EnvTabVerb 0.00 1.00000000000 FORMAT "%13.11" /end CHARACTERISTIC
/begin CHARACTERISTIC DFES_EnvRef.DFC_MOXEMM_SMU_ALM2_4_C "used environment signals / Reference to used environment condition set for check DFC_MOXEMM_SMU_ALM2_4" VALUE 0x80504C9E Val_Wu8 1.00000000000 DFES_EnvTabVerb 0.00 1.00000000000 FORMAT "%13.11" /end CHARACTERISTIC
/begin CHARACTERISTIC DFES_EnvRef.DFC_MOXEMM_SMU_ALM2_5_C "used environment signals / Reference to used environment condition set for check DFC_MOXEMM_SMU_ALM2_5" VALUE 0x80504C9F Val_Wu8 1.00000000000 DFES_EnvTabVerb 0.00 1.00000000000 FORMAT "%13.11" /end CHARACTERISTIC
/begin CHARACTERISTIC DFES_EnvRef.DFC_MOXEMM_SMU_ALM2_7_C "used environment signals / Reference to used environment condition set for check DFC_MOXEMM_SMU_ALM2_7" VALUE 0x80504CA0 Val_Wu8 1.00000000000 DFES_EnvTabVerb 0.00 1.00000000000 FORMAT "%13.11" /end CHARACTERISTIC
/begin CHARACTERISTIC DFES_EnvRef.DFC_MOXEMM_SMU_ALM2_8_C "used environment signals / Reference to used environment condition set for check DFC_MOXEMM_SMU_ALM2_8" VALUE 0x80504CA1 Val_Wu8 1.00000000000 DFES_EnvTabVerb 0.00 1.00000000000 FORMAT "%13.11" /end CHARACTERISTIC
/begin CHARACTERISTIC DFES_EnvRef.DFC_MOXEMM_SMU_ALM6_0_C "used environment signals / Reference to used environment condition set for check DFC_MOXEMM_SMU_ALM6_0" VALUE 0x80504CA2 Val_Wu8 1.00000000000 DFES_EnvTabVerb 0.00 1.00000000000 FORMAT "%13.11" /end CHARACTERISTIC
/begin CHARACTERISTIC DFES_EnvRef.DFC_MOXEMM_SMU_ALM6_11_C "used environment signals / Reference to used environment condition set for check DFC_MOXEMM_SMU_ALM6_11" VALUE 0x80504CA3 Val_Wu8 1.00000000000 DFES_EnvTabVerb 0.00 1.00000000000 FORMAT "%13.11" /end CHARACTERISTIC
/begin CHARACTERISTIC DFES_EnvRef.DFC_MOXEMM_SMU_ALM6_12_C "used environment signals / Reference to used environment condition set for check DFC_MOXEMM_SMU_ALM6_12" VALUE 0x80504CA4 Val_Wu8 1.00000000000 DFES_EnvTabVerb 0.00 1.00000000000 FORMAT "%13.11" /end CHARACTERISTIC
/begin CHARACTERISTIC DFES_EnvRef.DFC_MOXEMM_SMU_ALM6_14_C "used environment signals / Reference to used environment condition set for check DFC_MOXEMM_SMU_ALM6_14" VALUE 0x80504CA5 Val_Wu8 1.00000000000 DFES_EnvTabVerb 0.00 1.00000000000 FORMAT "%13.11" /end CHARACTERISTIC
/begin CHARACTERISTIC DFES_EnvRef.DFC_MOXEMM_SMU_ALM6_15_C "used environment signals / Reference to used environment condition set for check DFC_MOXEMM_SMU_ALM6_15" VALUE 0x80504CA6 Val_Wu8 1.00000000000 DFES_EnvTabVerb 0.00 1.00000000000 FORMAT "%13.11" /end CHARACTERISTIC
/begin CHARACTERISTIC DFES_EnvRef.DFC_MOXEMM_SMU_ALM6_17_C "used environment signals / Reference to used environment condition set for check DFC_MOXEMM_SMU_ALM6_17" VALUE 0x80504CA7 Val_Wu8 1.00000000000 DFES_EnvTabVerb 0.00 1.00000000000 FORMAT "%13.11" /end CHARACTERISTIC
/begin CHARACTERISTIC DFES_EnvRef.DFC_MOXEMM_SMU_ALM6_18_C "used environment signals / Reference to used environment condition set for check DFC_MOXEMM_SMU_ALM6_18" VALUE 0x80504CA8 Val_Wu8 1.00000000000 DFES_EnvTabVerb 0.00 1.00000000000 FORMAT "%13.11" /end CHARACTERISTIC
/begin CHARACTERISTIC DFES_EnvRef.DFC_MOXEMM_SMU_ALM6_20_C "used environment signals / Reference to used environment condition set for check DFC_MOXEMM_SMU_ALM6_20" VALUE 0x80504CA9 Val_Wu8 1.00000000000 DFES_EnvTabVerb 0.00 1.00000000000 FORMAT "%13.11" /end CHARACTERISTIC
/begin CHARACTERISTIC DFES_EnvRef.DFC_MOXEMM_SMU_ALM6_21_C "used environment signals / Reference to used environment condition set for check DFC_MOXEMM_SMU_ALM6_21" VALUE 0x80504CAA Val_Wu8 1.00000000000 DFES_EnvTabVerb 0.00 1.00000000000 FORMAT "%13.11" /end CHARACTERISTIC
/begin CHARACTERISTIC DFES_EnvRef.DFC_MOXEMM_SMU_ALM6_25_C "used environment signals / Reference to used environment condition set for check DFC_MOXEMM_SMU_ALM6_25" VALUE 0x80504CAB Val_Wu8 1.00000000000 DFES_EnvTabVerb 0.00 1.00000000000 FORMAT "%13.11" /end CHARACTERISTIC
/begin CHARACTERISTIC DFES_EnvRef.DFC_MOXEMM_SMU_ALM6_4_C "used environment signals / Reference to used environment condition set for check DFC_MOXEMM_SMU_ALM6_4" VALUE 0x80504CAC Val_Wu8 1.00000000000 DFES_EnvTabVerb 0.00 1.00000000000 FORMAT "%13.11" /end CHARACTERISTIC
/begin CHARACTERISTIC DFES_EnvRef.DFC_MOXEMM_SMU_ALM6_5_C "used environment signals / Reference to used environment condition set for check DFC_MOXEMM_SMU_ALM6_5" VALUE 0x80504CAD Val_Wu8 1.00000000000 DFES_EnvTabVerb 0.00 1.00000000000 FORMAT "%13.11" /end CHARACTERISTIC
/begin CHARACTERISTIC DFES_EnvRef.DFC_MOXEMM_SMU_ALM6_7_C "used environment signals / Reference to used environment condition set for check DFC_MOXEMM_SMU_ALM6_7" VALUE 0x80504CAE Val_Wu8 1.00000000000 DFES_EnvTabVerb 0.00 1.00000000000 FORMAT "%13.11" /end CHARACTERISTIC
/begin CHARACTERISTIC DFES_EnvRef.DFC_MOXEMM_SMU_ALM6_8_C "used environment signals / Reference to used environment condition set for check DFC_MOXEMM_SMU_ALM6_8" VALUE 0x80504CAF Val_Wu8 1.00000000000 DFES_EnvTabVerb 0.00 1.00000000000 FORMAT "%13.11" /end CHARACTERISTIC
/begin CHARACTERISTIC DFES_EnvRef.DFC_MOXEMM_SMU_ALM7_1_C "used environment signals / Reference to used environment condition set for check DFC_MOXEMM_SMU_ALM7_1" VALUE 0x80504CB0 Val_Wu8 1.00000000000 DFES_EnvTabVerb 0.00 1.00000000000 FORMAT "%13.11" /end CHARACTERISTIC
/begin CHARACTERISTIC DFES_EnvRef.DFC_MOXEMM_SMU_ALM7_12_C "used environment signals / Reference to used environment condition set for check DFC_MOXEMM_SMU_ALM7_12" VALUE 0x80504CB1 Val_Wu8 1.00000000000 DFES_EnvTabVerb 0.00 1.00000000000 FORMAT "%13.11" /end CHARACTERISTIC
/begin CHARACTERISTIC DFES_EnvRef.DFC_MOXEMM_SMU_ALM7_13_C "used environment signals / Reference to used environment condition set for check DFC_MOXEMM_SMU_ALM7_13" VALUE 0x80504CB2 Val_Wu8 1.00000000000 DFES_EnvTabVerb 0.00 1.00000000000 FORMAT "%13.11" /end CHARACTERISTIC
/begin CHARACTERISTIC DFES_EnvRef.DFC_MOXEMM_SMU_ALM7_14_C "used environment signals / Reference to used environment condition set for check DFC_MOXEMM_SMU_ALM7_14" VALUE 0x80504CB3 Val_Wu8 1.00000000000 DFES_EnvTabVerb 0.00 1.00000000000 FORMAT "%13.11" /end CHARACTERISTIC
/begin CHARACTERISTIC DFES_EnvRef.DFC_MOXEMM_SMU_ALM7_15_C "used environment signals / Reference to used environment condition set for check DFC_MOXEMM_SMU_ALM7_15" VALUE 0x80504CB4 Val_Wu8 1.00000000000 DFES_EnvTabVerb 0.00 1.00000000000 FORMAT "%13.11" /end CHARACTERISTIC
/begin CHARACTERISTIC DFES_EnvRef.DFC_MOXEMM_SMU_ALM7_16_C "used environment signals / Reference to used environment condition set for check DFC_MOXEMM_SMU_ALM7_16" VALUE 0x80504CB5 Val_Wu8 1.00000000000 DFES_EnvTabVerb 0.00 1.00000000000 FORMAT "%13.11" /end CHARACTERISTIC
/begin CHARACTERISTIC DFES_EnvRef.DFC_MOXEMM_SMU_ALM7_17_C "used environment signals / Reference to used environment condition set for check DFC_MOXEMM_SMU_ALM7_17" VALUE 0x80504CB6 Val_Wu8 1.00000000000 DFES_EnvTabVerb 0.00 1.00000000000 FORMAT "%13.11" /end CHARACTERISTIC
/begin CHARACTERISTIC DFES_EnvRef.DFC_MOXEMM_SMU_ALM7_2_C "used environment signals / Reference to used environment condition set for check DFC_MOXEMM_SMU_ALM7_2" VALUE 0x80504CB7 Val_Wu8 1.00000000000 DFES_EnvTabVerb 0.00 1.00000000000 FORMAT "%13.11" /end CHARACTERISTIC
/begin CHARACTERISTIC DFES_EnvRef.DFC_MOXEMM_SMU_ALM7_20_C "used environment signals / Reference to used environment condition set for check DFC_MOXEMM_SMU_ALM7_20" VALUE 0x80504CB8 Val_Wu8 1.00000000000 DFES_EnvTabVerb 0.00 1.00000000000 FORMAT "%13.11" /end CHARACTERISTIC
/begin CHARACTERISTIC DFES_EnvRef.DFC_MOXEMM_SMU_ALM7_25_C "used environment signals / Reference to used environment condition set for check DFC_MOXEMM_SMU_ALM7_25" VALUE 0x80504CB9 Val_Wu8 1.00000000000 DFES_EnvTabVerb 0.00 1.00000000000 FORMAT "%13.11" /end CHARACTERISTIC
/begin CHARACTERISTIC DFES_EnvRef.DFC_MOXEMM_SMU_ALM7_26_C "used environment signals / Reference to used environment condition set for check DFC_MOXEMM_SMU_ALM7_26" VALUE 0x80504CBA Val_Wu8 1.00000000000 DFES_EnvTabVerb 0.00 1.00000000000 FORMAT "%13.11" /end CHARACTERISTIC
/begin CHARACTERISTIC DFES_EnvRef.DFC_MOXEMM_SMU_ALM7_28_C "used environment signals / Reference to used environment condition set for check DFC_MOXEMM_SMU_ALM7_28" VALUE 0x80504CBB Val_Wu8 1.00000000000 DFES_EnvTabVerb 0.00 1.00000000000 FORMAT "%13.11" /end CHARACTERISTIC
/begin CHARACTERISTIC DFES_EnvRef.DFC_MOXEMM_SMU_ALM7_29_C "used environment signals / Reference to used environment condition set for check DFC_MOXEMM_SMU_ALM7_29" VALUE 0x80504CBC Val_Wu8 1.00000000000 DFES_EnvTabVerb 0.00 1.00000000000 FORMAT "%13.11" /end CHARACTERISTIC
/begin CHARACTERISTIC DFES_EnvRef.DFC_MOXEMM_SMU_ALM7_30_C "used environment signals / Reference to used environment condition set for check DFC_MOXEMM_SMU_ALM7_30" VALUE 0x80504CBD Val_Wu8 1.00000000000 DFES_EnvTabVerb 0.00 1.00000000000 FORMAT "%13.11" /end CHARACTERISTIC
/begin CHARACTERISTIC DFES_EnvRef.DFC_MOXEMM_SMU_ALM7_31_C "used environment signals / Reference to used environment condition set for check DFC_MOXEMM_SMU_ALM7_31" VALUE 0x80504CBE Val_Wu8 1.00000000000 DFES_EnvTabVerb 0.00 1.00000000000 FORMAT "%13.11" /end CHARACTERISTIC
/begin CHARACTERISTIC DFES_EnvRef.DFC_MOXEMM_SMU_ALM8_0_C "used environment signals / Reference to used environment condition set for check DFC_MOXEMM_SMU_ALM8_0" VALUE 0x80504CBF Val_Wu8 1.00000000000 DFES_EnvTabVerb 0.00 1.00000000000 FORMAT "%13.11" /end CHARACTERISTIC
/begin CHARACTERISTIC DFES_EnvRef.DFC_MOXEMM_SMU_ALM8_1_C "used environment signals / Reference to used environment condition set for check DFC_MOXEMM_SMU_ALM8_1" VALUE 0x80504CC0 Val_Wu8 1.00000000000 DFES_EnvTabVerb 0.00 1.00000000000 FORMAT "%13.11" /end CHARACTERISTIC
/begin CHARACTERISTIC DFES_EnvRef.DFC_MOXEMM_SMU_ALM8_10_C "used environment signals / Reference to used environment condition set for check DFC_MOXEMM_SMU_ALM8_10" VALUE 0x80504CC1 Val_Wu8 1.00000000000 DFES_EnvTabVerb 0.00 1.00000000000 FORMAT "%13.11" /end CHARACTERISTIC
/begin CHARACTERISTIC DFES_EnvRef.DFC_MOXEMM_SMU_ALM8_11_C "used environment signals / Reference to used environment condition set for check DFC_MOXEMM_SMU_ALM8_11" VALUE 0x80504CC2 Val_Wu8 1.00000000000 DFES_EnvTabVerb 0.00 1.00000000000 FORMAT "%13.11" /end CHARACTERISTIC
/begin CHARACTERISTIC DFES_EnvRef.DFC_MOXEMM_SMU_ALM8_12_C "used environment signals / Reference to used environment condition set for check DFC_MOXEMM_SMU_ALM8_12" VALUE 0x80504CC3 Val_Wu8 1.00000000000 DFES_EnvTabVerb 0.00 1.00000000000 FORMAT "%13.11" /end CHARACTERISTIC
/begin CHARACTERISTIC DFES_EnvRef.DFC_MOXEMM_SMU_ALM8_16_C "used environment signals / Reference to used environment condition set for check DFC_MOXEMM_SMU_ALM8_16" VALUE 0x80504CC4 Val_Wu8 1.00000000000 DFES_EnvTabVerb 0.00 1.00000000000 FORMAT "%13.11" /end CHARACTERISTIC
/begin CHARACTERISTIC DFES_EnvRef.DFC_MOXEMM_SMU_ALM8_18_C "used environment signals / Reference to used environment condition set for check DFC_MOXEMM_SMU_ALM8_18" VALUE 0x80504CC5 Val_Wu8 1.00000000000 DFES_EnvTabVerb 0.00 1.00000000000 FORMAT "%13.11" /end CHARACTERISTIC
/begin CHARACTERISTIC DFES_EnvRef.DFC_MOXEMM_SMU_ALM8_2_C "used environment signals / Reference to used environment condition set for check DFC_MOXEMM_SMU_ALM8_2" VALUE 0x80504CC6 Val_Wu8 1.00000000000 DFES_EnvTabVerb 0.00 1.00000000000 FORMAT "%13.11" /end CHARACTERISTIC
/begin CHARACTERISTIC DFES_EnvRef.DFC_MOXEMM_SMU_ALM8_3_C "used environment signals / Reference to used environment condition set for check DFC_MOXEMM_SMU_ALM8_3" VALUE 0x80504CC7 Val_Wu8 1.00000000000 DFES_EnvTabVerb 0.00 1.00000000000 FORMAT "%13.11" /end CHARACTERISTIC
/begin CHARACTERISTIC DFES_EnvRef.DFC_MOXEMM_SMU_ALM8_31_C "used environment signals / Reference to used environment condition set for check DFC_MOXEMM_SMU_ALM8_31" VALUE 0x80504CC8 Val_Wu8 1.00000000000 DFES_EnvTabVerb 0.00 1.00000000000 FORMAT "%13.11" /end CHARACTERISTIC
/begin CHARACTERISTIC DFES_EnvRef.DFC_MOXEMM_SMU_ALM8_4_C "used environment signals / Reference to used environment condition set for check DFC_MOXEMM_SMU_ALM8_4" VALUE 0x80504CC9 Val_Wu8 1.00000000000 DFES_EnvTabVerb 0.00 1.00000000000 FORMAT "%13.11" /end CHARACTERISTIC
/begin CHARACTERISTIC DFES_EnvRef.DFC_MOXEMM_SMU_ALM9_0_C "used environment signals / Reference to used environment condition set for check DFC_MOXEMM_SMU_ALM9_0" VALUE 0x80504CCA Val_Wu8 1.00000000000 DFES_EnvTabVerb 0.00 1.00000000000 FORMAT "%13.11" /end CHARACTERISTIC
/begin CHARACTERISTIC DFES_EnvRef.DFC_MOXEMM_SMU_ALM9_15_C "used environment signals / Reference to used environment condition set for check DFC_MOXEMM_SMU_ALM9_15" VALUE 0x80504CCB Val_Wu8 1.00000000000 DFES_EnvTabVerb 0.00 1.00000000000 FORMAT "%13.11" /end CHARACTERISTIC
/begin CHARACTERISTIC DFES_EnvRef.DFC_MOXEMM_SMU_ALM9_3_C "used environment signals / Reference to used environment condition set for check DFC_MOXEMM_SMU_ALM9_3" VALUE 0x80504CCC Val_Wu8 1.00000000000 DFES_EnvTabVerb 0.00 1.00000000000 FORMAT "%13.11" /end CHARACTERISTIC
/begin CHARACTERISTIC DFES_EnvRef.DFC_MoCADCNTP_C "used environment signals / Reference to used environment condition set for check DFC_MoCADCNTP" VALUE 0x80504CCD Val_Wu8 1.00000000000 DFES_EnvTabVerb 0.00 1.00000000000 FORMAT "%13.11" /end CHARACTERISTIC
/begin CHARACTERISTIC DFES_EnvRef.DFC_MoCADCTst_C "used environment signals / Reference to used environment condition set for check DFC_MoCADCTst" VALUE 0x80504CCE Val_Wu8 1.00000000000 DFES_EnvTabVerb 0.00 1.00000000000 FORMAT "%13.11" /end CHARACTERISTIC
/begin CHARACTERISTIC DFES_EnvRef.DFC_MoCSOPICO_C "used environment signals / Reference to used environment condition set for check DFC_MoCSOPICO" VALUE 0x80504CCF Val_Wu8 1.00000000000 DFES_EnvTabVerb 0.00 1.00000000000 FORMAT "%13.11" /end CHARACTERISTIC
/begin CHARACTERISTIC DFES_EnvRef.DFC_MoFAPP_C "used environment signals / Reference to used environment condition set for check DFC_MoFAPP" VALUE 0x80504CD0 Val_Wu8 1.00000000000 DFES_EnvTabVerb 0.00 1.00000000000 FORMAT "%13.11" /end CHARACTERISTIC
/begin CHARACTERISTIC DFES_EnvRef.DFC_MoFAirFilgPrdc_C "used environment signals / Reference to used environment condition set for check DFC_MoFAirFilgPrdc" VALUE 0x80504CD1 Val_Wu8 1.00000000000 DFES_EnvTabVerb 0.00 1.00000000000 FORMAT "%13.11" /end CHARACTERISTIC
/begin CHARACTERISTIC DFES_EnvRef.DFC_MoFAirFlCtOffGdi_C "used environment signals / Reference to used environment condition set for check DFC_MoFAirFlCtOffGdi" VALUE 0x80504CD2 Val_Wu8 1.00000000000 DFES_EnvTabVerb 0.00 1.00000000000 FORMAT "%13.11" /end CHARACTERISTIC
/begin CHARACTERISTIC DFES_EnvRef.DFC_MoFAirFlCylGdi_C "used environment signals / Reference to used environment condition set for check DFC_MoFAirFlCylGdi" VALUE 0x80504CD3 Val_Wu8 1.00000000000 DFES_EnvTabVerb 0.00 1.00000000000 FORMAT "%13.11" /end CHARACTERISTIC
/begin CHARACTERISTIC DFES_EnvRef.DFC_MoFAirFlFF_C "used environment signals / Reference to used environment condition set for check DFC_MoFAirFlFF" VALUE 0x80504CD4 Val_Wu8 1.00000000000 DFES_EnvTabVerb 0.00 1.00000000000 FORMAT "%13.11" /end CHARACTERISTIC
/begin CHARACTERISTIC DFES_EnvRef.DFC_MoFAirFlIn_C "used environment signals / Reference to used environment condition set for check DFC_MoFAirFlIn" VALUE 0x80504CD5 Val_Wu8 1.00000000000 DFES_EnvTabVerb 0.00 1.00000000000 FORMAT "%13.11" /end CHARACTERISTIC
/begin CHARACTERISTIC DFES_EnvRef.DFC_MoFAirFlMixCtlGdiChkAirFl_C "used environment signals / Reference to used environment condition set for check DFC_MoFAirFlMixCtlGdiChkAirFl" VALUE 0x80504CD6 Val_Wu8 1.00000000000 DFES_EnvTabVerb 0.00 1.00000000000 FORMAT "%13.11" /end CHARACTERISTIC
/begin CHARACTERISTIC DFES_EnvRef.DFC_MoFAirFlMixCtlGdiChkCtrl_C "used environment signals / Reference to used environment condition set for check DFC_MoFAirFlMixCtlGdiChkCtrl" VALUE 0x80504CD7 Val_Wu8 1.00000000000 DFES_EnvTabVerb 0.00 1.00000000000 FORMAT "%13.11" /end CHARACTERISTIC
/begin CHARACTERISTIC DFES_EnvRef.DFC_MoFAirFlMode_C "used environment signals / Reference to used environment condition set for check DFC_MoFAirFlMode" VALUE 0x80504CD8 Val_Wu8 1.00000000000 DFES_EnvTabVerb 0.00 1.00000000000 FORMAT "%13.11" /end CHARACTERISTIC
/begin CHARACTERISTIC DFES_EnvRef.DFC_MoFESpd_C "used environment signals / Reference to used environment condition set for check DFC_MoFESpd" VALUE 0x80504CD9 Val_Wu8 1.00000000000 DFES_EnvTabVerb 0.00 1.00000000000 FORMAT "%13.11" /end CHARACTERISTIC
/begin CHARACTERISTIC DFES_EnvRef.DFC_MoFIACo_C "used environment signals / Reference to used environment condition set for check DFC_MoFIACo" VALUE 0x80504CDA Val_Wu8 1.00000000000 DFES_EnvTabVerb 0.00 1.00000000000 FORMAT "%13.11" /end CHARACTERISTIC
/begin CHARACTERISTIC DFES_EnvRef.DFC_MoFICOL1_C "used environment signals / Reference to used environment condition set for check DFC_MoFICOL1" VALUE 0x80504CDB Val_Wu8 1.00000000000 DFES_EnvTabVerb 0.00 1.00000000000 FORMAT "%13.11" /end CHARACTERISTIC
/begin CHARACTERISTIC DFES_EnvRef.DFC_MoFICOL2_C "used environment signals / Reference to used environment condition set for check DFC_MoFICOL2" VALUE 0x80504CDC Val_Wu8 1.00000000000 DFES_EnvTabVerb 0.00 1.00000000000 FORMAT "%13.11" /end CHARACTERISTIC
/begin CHARACTERISTIC DFES_EnvRef.DFC_MoFStrt_C "used environment signals / Reference to used environment condition set for check DFC_MoFStrt" VALUE 0x80504CDD Val_Wu8 1.00000000000 DFES_EnvTabVerb 0.00 1.00000000000 FORMAT "%13.11" /end CHARACTERISTIC
/begin CHARACTERISTIC DFES_EnvRef.DFC_MoFTrqCmp_C "used environment signals / Reference to used environment condition set for check DFC_MoFTrqCmp" VALUE 0x80504CDE Val_Wu8 1.00000000000 DFES_EnvTabVerb 0.00 1.00000000000 FORMAT "%13.11" /end CHARACTERISTIC
/begin CHARACTERISTIC DFES_EnvRef.DFC_MoFTrqCmpMax_C "used environment signals / Reference to used environment condition set for check DFC_MoFTrqCmpMax" VALUE 0x80504CDF Val_Wu8 1.00000000000 DFES_EnvTabVerb 0.00 1.00000000000 FORMAT "%13.11" /end CHARACTERISTIC
/begin CHARACTERISTIC DFES_EnvRef.DFC_MoFTrqCmpMin_C "used environment signals / Reference to used environment condition set for check DFC_MoFTrqCmpMin" VALUE 0x80504CE0 Val_Wu8 1.00000000000 DFES_EnvTabVerb 0.00 1.00000000000 FORMAT "%13.11" /end CHARACTERISTIC
/begin CHARACTERISTIC DFES_EnvRef.DFC_MoFVarPostBldSel_C "used environment signals / Reference to used environment condition set for check DFC_MoFVarPostBldSel" VALUE 0x80504CE1 Val_Wu8 1.00000000000 DFES_EnvTabVerb 0.00 1.00000000000 FORMAT "%13.11" /end CHARACTERISTIC
/begin CHARACTERISTIC DFES_EnvRef.DFC_MoXEMMHwLTMCUFW_C "used environment signals / Reference to used environment condition set for check DFC_MoXEMMHwLTMCUFW" VALUE 0x80504CE2 Val_Wu8 1.00000000000 DFES_EnvTabVerb 0.00 1.00000000000 FORMAT "%13.11" /end CHARACTERISTIC
/begin CHARACTERISTIC DFES_EnvRef.DFC_MoXEMMHwLTMonBIST_C "used environment signals / Reference to used environment condition set for check DFC_MoXEMMHwLTMonBIST" VALUE 0x80504CE3 Val_Wu8 1.00000000000 DFES_EnvTabVerb 0.00 1.00000000000 FORMAT "%13.11" /end CHARACTERISTIC
/begin CHARACTERISTIC DFES_EnvRef.DFC_MoXEMMHwLTRegMonTest_C "used environment signals / Reference to used environment condition set for check DFC_MoXEMMHwLTRegMonTest" VALUE 0x80504CE4 Val_Wu8 1.00000000000 DFES_EnvTabVerb 0.00 1.00000000000 FORMAT "%13.11" /end CHARACTERISTIC
/begin CHARACTERISTIC DFES_EnvRef.DFC_MoXEMMHwLTStbySMUAlvTest_C "used environment signals / Reference to used environment condition set for check DFC_MoXEMMHwLTStbySMUAlvTest" VALUE 0x80504CE5 Val_Wu8 1.00000000000 DFES_EnvTabVerb 0.00 1.00000000000 FORMAT "%13.11" /end CHARACTERISTIC
/begin CHARACTERISTIC DFES_EnvRef.DFC_MoXEMMHwLTTempSens_C "used environment signals / Reference to used environment condition set for check DFC_MoXEMMHwLTTempSens" VALUE 0x80504CE6 Val_Wu8 1.00000000000 DFES_EnvTabVerb 0.00 1.00000000000 FORMAT "%13.11" /end CHARACTERISTIC
/begin CHARACTERISTIC DFES_EnvRef.DFC_MoXEMMHwLTUCBCfg_C "used environment signals / Reference to used environment condition set for check DFC_MoXEMMHwLTUCBCfg" VALUE 0x80504CE7 Val_Wu8 1.00000000000 DFES_EnvTabVerb 0.00 1.00000000000 FORMAT "%13.11" /end CHARACTERISTIC
/begin CHARACTERISTIC DFES_EnvRef.DFC_NWSEmax_C "used environment signals / Reference to used environment condition set for check DFC_NWSEmax" VALUE 0x80504CE8 Val_Wu8 1.00000000000 DFES_EnvTabVerb 0.00 1.00000000000 FORMAT "%13.11" /end CHARACTERISTIC
/begin CHARACTERISTIC DFES_EnvRef.DFC_NWSmax_C "used environment signals / Reference to used environment condition set for check DFC_NWSmax" VALUE 0x80504CE9 Val_Wu8 1.00000000000 DFES_EnvTabVerb 0.00 1.00000000000 FORMAT "%13.11" /end CHARACTERISTIC
/begin CHARACTERISTIC DFES_EnvRef.DFC_OCWDAABEActv_C "used environment signals / Reference to used environment condition set for check DFC_OCWDAABEActv" VALUE 0x80504CEA Val_Wu8 1.00000000000 DFES_EnvTabVerb 0.00 1.00000000000 FORMAT "%13.11" /end CHARACTERISTIC
/begin CHARACTERISTIC DFES_EnvRef.DFC_OCWDACom_C "used environment signals / Reference to used environment condition set for check DFC_OCWDACom" VALUE 0x80504CEB Val_Wu8 1.00000000000 DFES_EnvTabVerb 0.00 1.00000000000 FORMAT "%13.11" /end CHARACTERISTIC
/begin CHARACTERISTIC DFES_EnvRef.DFC_OCWDAErrPin_C "used environment signals / Reference to used environment condition set for check DFC_OCWDAErrPin" VALUE 0x80504CEC Val_Wu8 1.00000000000 DFES_EnvTabVerb 0.00 1.00000000000 FORMAT "%13.11" /end CHARACTERISTIC
/begin CHARACTERISTIC DFES_EnvRef.DFC_OCWDAOvrVltg_C "used environment signals / Reference to used environment condition set for check DFC_OCWDAOvrVltg" VALUE 0x80504CED Val_Wu8 1.00000000000 DFES_EnvTabVerb 0.00 1.00000000000 FORMAT "%13.11" /end CHARACTERISTIC
/begin CHARACTERISTIC DFES_EnvRef.DFC_ORAmax_C "used environment signals / Reference to used environment condition set for check DFC_ORAmax" VALUE 0x80504CEE Val_Wu8 1.00000000000 DFES_EnvTabVerb 0.00 1.00000000000 FORMAT "%13.11" /end CHARACTERISTIC
/begin CHARACTERISTIC DFES_EnvRef.DFC_ORAmin_C "used environment signals / Reference to used environment condition set for check DFC_ORAmin" VALUE 0x80504CEF Val_Wu8 1.00000000000 DFES_EnvTabVerb 0.00 1.00000000000 FORMAT "%13.11" /end CHARACTERISTIC
/begin CHARACTERISTIC DFES_EnvRef.DFC_OilPPlaus_C "used environment signals / Reference to used environment condition set for check DFC_OilPPlaus" VALUE 0x80504CF0 Val_Wu8 1.00000000000 DFES_EnvTabVerb 0.00 1.00000000000 FORMAT "%13.11" /end CHARACTERISTIC
/begin CHARACTERISTIC DFES_EnvRef.DFC_PLLSUmax_C "used environment signals / Reference to used environment condition set for check DFC_PLLSUmax" VALUE 0x80504CF1 Val_Wu8 1.00000000000 DFES_EnvTabVerb 0.00 1.00000000000 FORMAT "%13.11" /end CHARACTERISTIC
/begin CHARACTERISTIC DFES_EnvRef.DFC_PLLSUmin_C "used environment signals / Reference to used environment condition set for check DFC_PLLSUmin" VALUE 0x80504CF2 Val_Wu8 1.00000000000 DFES_EnvTabVerb 0.00 1.00000000000 FORMAT "%13.11" /end CHARACTERISTIC
/begin CHARACTERISTIC DFES_EnvRef.DFC_PSR1max_C "used environment signals / Reference to used environment condition set for check DFC_PSR1max" VALUE 0x80504CF3 Val_Wu8 1.00000000000 DFES_EnvTabVerb 0.00 1.00000000000 FORMAT "%13.11" /end CHARACTERISTIC
/begin CHARACTERISTIC DFES_EnvRef.DFC_PSRBmax_C "used environment signals / Reference to used environment condition set for check DFC_PSRBmax" VALUE 0x80504CF4 Val_Wu8 1.00000000000 DFES_EnvTabVerb 0.00 1.00000000000 FORMAT "%13.11" /end CHARACTERISTIC
/begin CHARACTERISTIC DFES_EnvRef.DFC_PSRBmin_C "used environment signals / Reference to used environment condition set for check DFC_PSRBmin" VALUE 0x80504CF5 Val_Wu8 1.00000000000 DFES_EnvTabVerb 0.00 1.00000000000 FORMAT "%13.11" /end CHARACTERISTIC
/begin CHARACTERISTIC DFES_EnvRef.DFC_PSRPmax_C "used environment signals / Reference to used environment condition set for check DFC_PSRPmax" VALUE 0x80504CF6 Val_Wu8 1.00000000000 DFES_EnvTabVerb 0.00 1.00000000000 FORMAT "%13.11" /end CHARACTERISTIC
/begin CHARACTERISTIC DFES_EnvRef.DFC_PSRPmin_C "used environment signals / Reference to used environment condition set for check DFC_PSRPmin" VALUE 0x80504CF7 Val_Wu8 1.00000000000 DFES_EnvTabVerb 0.00 1.00000000000 FORMAT "%13.11" /end CHARACTERISTIC
/begin CHARACTERISTIC DFES_EnvRef.DFC_PSRPsig_C "used environment signals / Reference to used environment condition set for check DFC_PSRPsig" VALUE 0x80504CF8 Val_Wu8 1.00000000000 DFES_EnvTabVerb 0.00 1.00000000000 FORMAT "%13.11" /end CHARACTERISTIC
/begin CHARACTERISTIC DFES_EnvRef.DFC_PSRmax_C "used environment signals / Reference to used environment condition set for check DFC_PSRmax" VALUE 0x80504CF9 Val_Wu8 1.00000000000 DFES_EnvTabVerb 0.00 1.00000000000 FORMAT "%13.11" /end CHARACTERISTIC
/begin CHARACTERISTIC DFES_EnvRef.DFC_PUmax_C "used environment signals / Reference to used environment condition set for check DFC_PUmax" VALUE 0x80504CFA Val_Wu8 1.00000000000 DFES_EnvTabVerb 0.00 1.00000000000 FORMAT "%13.11" /end CHARACTERISTIC
/begin CHARACTERISTIC DFES_EnvRef.DFC_P_VSE11_OL_C "used environment signals / Reference to used environment condition set for check DFC_P_VSE11_OL" VALUE 0x80504CFB Val_Wu8 1.00000000000 DFES_EnvTabVerb 0.00 1.00000000000 FORMAT "%13.11" /end CHARACTERISTIC
/begin CHARACTERISTIC DFES_EnvRef.DFC_P_VSE11_SCB_C "used environment signals / Reference to used environment condition set for check DFC_P_VSE11_SCB" VALUE 0x80504CFC Val_Wu8 1.00000000000 DFES_EnvTabVerb 0.00 1.00000000000 FORMAT "%13.11" /end CHARACTERISTIC
/begin CHARACTERISTIC DFES_EnvRef.DFC_P_VSE11_SCG_C "used environment signals / Reference to used environment condition set for check DFC_P_VSE11_SCG" VALUE 0x80504CFD Val_Wu8 1.00000000000 DFES_EnvTabVerb 0.00 1.00000000000 FORMAT "%13.11" /end CHARACTERISTIC
/begin CHARACTERISTIC DFES_EnvRef.DFC_PhyHighAPP1_C "used environment signals / Reference to used environment condition set for check DFC_PhyHighAPP1" VALUE 0x80504CFE Val_Wu8 1.00000000000 DFES_EnvTabVerb 0.00 1.00000000000 FORMAT "%13.11" /end CHARACTERISTIC
/begin CHARACTERISTIC DFES_EnvRef.DFC_PhyHighAPP2_C "used environment signals / Reference to used environment condition set for check DFC_PhyHighAPP2" VALUE 0x80504CFF Val_Wu8 1.00000000000 DFES_EnvTabVerb 0.00 1.00000000000 FORMAT "%13.11" /end CHARACTERISTIC
/begin CHARACTERISTIC DFES_EnvRef.DFC_PhyLowAPP1_C "used environment signals / Reference to used environment condition set for check DFC_PhyLowAPP1" VALUE 0x80504D00 Val_Wu8 1.00000000000 DFES_EnvTabVerb 0.00 1.00000000000 FORMAT "%13.11" /end CHARACTERISTIC
/begin CHARACTERISTIC DFES_EnvRef.DFC_PhyLowAPP2_C "used environment signals / Reference to used environment condition set for check DFC_PhyLowAPP2" VALUE 0x80504D01 Val_Wu8 1.00000000000 DFES_EnvTabVerb 0.00 1.00000000000 FORMAT "%13.11" /end CHARACTERISTIC
/begin CHARACTERISTIC DFES_EnvRef.DFC_SRCHighAPP1_C "used environment signals / Reference to used environment condition set for check DFC_SRCHighAPP1" VALUE 0x80504D02 Val_Wu8 1.00000000000 DFES_EnvTabVerb 0.00 1.00000000000 FORMAT "%13.11" /end CHARACTERISTIC
/begin CHARACTERISTIC DFES_EnvRef.DFC_SRCHighAPP2_C "used environment signals / Reference to used environment condition set for check DFC_SRCHighAPP2" VALUE 0x80504D03 Val_Wu8 1.00000000000 DFES_EnvTabVerb 0.00 1.00000000000 FORMAT "%13.11" /end CHARACTERISTIC
/begin CHARACTERISTIC DFES_EnvRef.DFC_SRCLowAPP1_C "used environment signals / Reference to used environment condition set for check DFC_SRCLowAPP1" VALUE 0x80504D04 Val_Wu8 1.00000000000 DFES_EnvTabVerb 0.00 1.00000000000 FORMAT "%13.11" /end CHARACTERISTIC
/begin CHARACTERISTIC DFES_EnvRef.DFC_SRCLowAPP2_C "used environment signals / Reference to used environment condition set for check DFC_SRCLowAPP2" VALUE 0x80504D05 Val_Wu8 1.00000000000 DFES_EnvTabVerb 0.00 1.00000000000 FORMAT "%13.11" /end CHARACTERISTIC
/begin CHARACTERISTIC DFES_EnvRef.DFC_SSpMon2_C "used environment signals / Reference to used environment condition set for check DFC_SSpMon2" VALUE 0x80504D06 Val_Wu8 1.00000000000 DFES_EnvTabVerb 0.00 1.00000000000 FORMAT "%13.11" /end CHARACTERISTIC
/begin CHARACTERISTIC DFES_EnvRef.DFC_STHDRmax_C "used environment signals / Reference to used environment condition set for check DFC_STHDRmax" VALUE 0x80504D07 Val_Wu8 1.00000000000 DFES_EnvTabVerb 0.00 1.00000000000 FORMAT "%13.11" /end CHARACTERISTIC
/begin CHARACTERISTIC DFES_EnvRef.DFC_SWReset_0_C "used environment signals / Reference to used environment condition set for check DFC_SWReset_0" VALUE 0x80504D08 Val_Wu8 1.00000000000 DFES_EnvTabVerb 0.00 1.00000000000 FORMAT "%13.11" /end CHARACTERISTIC
/begin CHARACTERISTIC DFES_EnvRef.DFC_SWReset_1_C "used environment signals / Reference to used environment condition set for check DFC_SWReset_1" VALUE 0x80504D09 Val_Wu8 1.00000000000 DFES_EnvTabVerb 0.00 1.00000000000 FORMAT "%13.11" /end CHARACTERISTIC
/begin CHARACTERISTIC DFES_EnvRef.DFC_SWReset_2_C "used environment signals / Reference to used environment condition set for check DFC_SWReset_2" VALUE 0x80504D0A Val_Wu8 1.00000000000 DFES_EnvTabVerb 0.00 1.00000000000 FORMAT "%13.11" /end CHARACTERISTIC
/begin CHARACTERISTIC DFES_EnvRef.DFC_SyncAPP_C "used environment signals / Reference to used environment condition set for check DFC_SyncAPP" VALUE 0x80504D0B Val_Wu8 1.00000000000 DFES_EnvTabVerb 0.00 1.00000000000 FORMAT "%13.11" /end CHARACTERISTIC
/begin CHARACTERISTIC DFES_EnvRef.DFC_TANKLnpl_C "used environment signals / Reference to used environment condition set for check DFC_TANKLnpl" VALUE 0x80504D0C Val_Wu8 1.00000000000 DFES_EnvTabVerb 0.00 1.00000000000 FORMAT "%13.11" /end CHARACTERISTIC
/begin CHARACTERISTIC DFES_EnvRef.DFC_TAmax_Dummy_C "used environment signals / Reference to used environment condition set for check DFC_TAmax_Dummy" VALUE 0x80504D0D Val_Wu8 1.00000000000 DFES_EnvTabVerb 0.00 1.00000000000 FORMAT "%13.11" /end CHARACTERISTIC
/begin CHARACTERISTIC DFES_EnvRef.DFC_TESFmax_C "used environment signals / Reference to used environment condition set for check DFC_TESFmax" VALUE 0x80504D0E Val_Wu8 1.00000000000 DFES_EnvTabVerb 0.00 1.00000000000 FORMAT "%13.11" /end CHARACTERISTIC
/begin CHARACTERISTIC DFES_EnvRef.DFC_TESGmax_C "used environment signals / Reference to used environment condition set for check DFC_TESGmax" VALUE 0x80504D0F Val_Wu8 1.00000000000 DFES_EnvTabVerb 0.00 1.00000000000 FORMAT "%13.11" /end CHARACTERISTIC
/begin CHARACTERISTIC DFES_EnvRef.DFC_TKAEmax_C "used environment signals / Reference to used environment condition set for check DFC_TKAEmax" VALUE 0x80504D10 Val_Wu8 1.00000000000 DFES_EnvTabVerb 0.00 1.00000000000 FORMAT "%13.11" /end CHARACTERISTIC
/begin CHARACTERISTIC DFES_EnvRef.DFC_TKAEmin_C "used environment signals / Reference to used environment condition set for check DFC_TKAEmin" VALUE 0x80504D11 Val_Wu8 1.00000000000 DFES_EnvTabVerb 0.00 1.00000000000 FORMAT "%13.11" /end CHARACTERISTIC
/begin CHARACTERISTIC DFES_EnvRef.DFC_TKARmax_C "used environment signals / Reference to used environment condition set for check DFC_TKARmax" VALUE 0x80504D12 Val_Wu8 1.00000000000 DFES_EnvTabVerb 0.00 1.00000000000 FORMAT "%13.11" /end CHARACTERISTIC
/begin CHARACTERISTIC DFES_EnvRef.DFC_TKARnpl_C "used environment signals / Reference to used environment condition set for check DFC_TKARnpl" VALUE 0x80504D13 Val_Wu8 1.00000000000 DFES_EnvTabVerb 0.00 1.00000000000 FORMAT "%13.11" /end CHARACTERISTIC
/begin CHARACTERISTIC DFES_EnvRef.DFC_TMmax_Dummy_C "used environment signals / Reference to used environment condition set for check DFC_TMmax_Dummy" VALUE 0x80504D14 Val_Wu8 1.00000000000 DFES_EnvTabVerb 0.00 1.00000000000 FORMAT "%13.11" /end CHARACTERISTIC
/begin CHARACTERISTIC DFES_EnvRef.DFC_TUMmax_Dummy_C "used environment signals / Reference to used environment condition set for check DFC_TUMmax_Dummy" VALUE 0x80504D15 Val_Wu8 1.00000000000 DFES_EnvTabVerb 0.00 1.00000000000 FORMAT "%13.11" /end CHARACTERISTIC
/begin CHARACTERISTIC DFES_EnvRef.DFC_TWCDPriCatB1_C "used environment signals / Reference to used environment condition set for check DFC_TWCDPriCatB1" VALUE 0x80504D16 Val_Wu8 1.00000000000 DFES_EnvTabVerb 0.00 1.00000000000 FORMAT "%13.11" /end CHARACTERISTIC
/begin CHARACTERISTIC DFES_EnvRef.DFC_ThrVlvClsdPosnFirstOffsLrnImpoB1_C "used environment signals / Reference to used environment condition set for check DFC_ThrVlvClsdPosnFirstOffsLrnImpoB1" VALUE 0x80504D17 Val_Wu8 1.00000000000 DFES_EnvTabVerb 0.00 1.00000000000 FORMAT "%13.11" /end CHARACTERISTIC
/begin CHARACTERISTIC DFES_EnvRef.DFC_ThrVlvClsdPosnOffsLrnImpoB1_C "used environment signals / Reference to used environment condition set for check DFC_ThrVlvClsdPosnOffsLrnImpoB1" VALUE 0x80504D18 Val_Wu8 1.00000000000 DFES_EnvTabVerb 0.00 1.00000000000 FORMAT "%13.11" /end CHARACTERISTIC
/begin CHARACTERISTIC DFES_EnvRef.DFC_ThrVlvClsdPosnOffsLrnMaxB1_C "used environment signals / Reference to used environment condition set for check DFC_ThrVlvClsdPosnOffsLrnMaxB1" VALUE 0x80504D19 Val_Wu8 1.00000000000 DFES_EnvTabVerb 0.00 1.00000000000 FORMAT "%13.11" /end CHARACTERISTIC
/begin CHARACTERISTIC DFES_EnvRef.DFC_ThrVlvClsdPosnOffsLrnMinB1_C "used environment signals / Reference to used environment condition set for check DFC_ThrVlvClsdPosnOffsLrnMinB1" VALUE 0x80504D1A Val_Wu8 1.00000000000 DFES_EnvTabVerb 0.00 1.00000000000 FORMAT "%13.11" /end CHARACTERISTIC
/begin CHARACTERISTIC DFES_EnvRef.DFC_ThrVlvCtrlDeB1_C "used environment signals / Reference to used environment condition set for check DFC_ThrVlvCtrlDeB1" VALUE 0x80504D1B Val_Wu8 1.00000000000 DFES_EnvTabVerb 0.00 1.00000000000 FORMAT "%13.11" /end CHARACTERISTIC
/begin CHARACTERISTIC DFES_EnvRef.DFC_ThrVlvDycB1_C "used environment signals / Reference to used environment condition set for check DFC_ThrVlvDycB1" VALUE 0x80504D1C Val_Wu8 1.00000000000 DFES_EnvTabVerb 0.00 1.00000000000 FORMAT "%13.11" /end CHARACTERISTIC
/begin CHARACTERISTIC DFES_EnvRef.DFC_ThrVlvLimpAirPosnMaxAbsltDriftB1_C "used environment signals / Reference to used environment condition set for check DFC_ThrVlvLimpAirPosnMaxAbsltDriftB1" VALUE 0x80504D1D Val_Wu8 1.00000000000 DFES_EnvTabVerb 0.00 1.00000000000 FORMAT "%13.11" /end CHARACTERISTIC
/begin CHARACTERISTIC DFES_EnvRef.DFC_ThrVlvLimpAirPosnMaxB1_C "used environment signals / Reference to used environment condition set for check DFC_ThrVlvLimpAirPosnMaxB1" VALUE 0x80504D1E Val_Wu8 1.00000000000 DFES_EnvTabVerb 0.00 1.00000000000 FORMAT "%13.11" /end CHARACTERISTIC
/begin CHARACTERISTIC DFES_EnvRef.DFC_ThrVlvLimpAirPosnMaxRelDriftB1_C "used environment signals / Reference to used environment condition set for check DFC_ThrVlvLimpAirPosnMaxRelDriftB1" VALUE 0x80504D1F Val_Wu8 1.00000000000 DFES_EnvTabVerb 0.00 1.00000000000 FORMAT "%13.11" /end CHARACTERISTIC
/begin CHARACTERISTIC DFES_EnvRef.DFC_ThrVlvLimpAirPosnMinB1_C "used environment signals / Reference to used environment condition set for check DFC_ThrVlvLimpAirPosnMinB1" VALUE 0x80504D20 Val_Wu8 1.00000000000 DFES_EnvTabVerb 0.00 1.00000000000 FORMAT "%13.11" /end CHARACTERISTIC
/begin CHARACTERISTIC DFES_EnvRef.DFC_ThrVlvOpenLoadB1_C "used environment signals / Reference to used environment condition set for check DFC_ThrVlvOpenLoadB1" VALUE 0x80504D21 Val_Wu8 1.00000000000 DFES_EnvTabVerb 0.00 1.00000000000 FORMAT "%13.11" /end CHARACTERISTIC
/begin CHARACTERISTIC DFES_EnvRef.DFC_ThrVlvOpenSprgB1_C "used environment signals / Reference to used environment condition set for check DFC_ThrVlvOpenSprgB1" VALUE 0x80504D22 Val_Wu8 1.00000000000 DFES_EnvTabVerb 0.00 1.00000000000 FORMAT "%13.11" /end CHARACTERISTIC
/begin CHARACTERISTIC DFES_EnvRef.DFC_ThrVlvOpenSprgSprdB1_C "used environment signals / Reference to used environment condition set for check DFC_ThrVlvOpenSprgSprdB1" VALUE 0x80504D23 Val_Wu8 1.00000000000 DFES_EnvTabVerb 0.00 1.00000000000 FORMAT "%13.11" /end CHARACTERISTIC
/begin CHARACTERISTIC DFES_EnvRef.DFC_ThrVlvOpenSprgTwnB1_C "used environment signals / Reference to used environment condition set for check DFC_ThrVlvOpenSprgTwnB1" VALUE 0x80504D24 Val_Wu8 1.00000000000 DFES_EnvTabVerb 0.00 1.00000000000 FORMAT "%13.11" /end CHARACTERISTIC
/begin CHARACTERISTIC DFES_EnvRef.DFC_ThrVlvOverTB1_C "used environment signals / Reference to used environment condition set for check DFC_ThrVlvOverTB1" VALUE 0x80504D25 Val_Wu8 1.00000000000 DFES_EnvTabVerb 0.00 1.00000000000 FORMAT "%13.11" /end CHARACTERISTIC
/begin CHARACTERISTIC DFES_EnvRef.DFC_ThrVlvRetSprgB1_C "used environment signals / Reference to used environment condition set for check DFC_ThrVlvRetSprgB1" VALUE 0x80504D26 Val_Wu8 1.00000000000 DFES_EnvTabVerb 0.00 1.00000000000 FORMAT "%13.11" /end CHARACTERISTIC
/begin CHARACTERISTIC DFES_EnvRef.DFC_ThrVlvRetSprgSprdB1_C "used environment signals / Reference to used environment condition set for check DFC_ThrVlvRetSprgSprdB1" VALUE 0x80504D27 Val_Wu8 1.00000000000 DFES_EnvTabVerb 0.00 1.00000000000 FORMAT "%13.11" /end CHARACTERISTIC
/begin CHARACTERISTIC DFES_EnvRef.DFC_ThrVlvRetSprgTwnB1_C "used environment signals / Reference to used environment condition set for check DFC_ThrVlvRetSprgTwnB1" VALUE 0x80504D28 Val_Wu8 1.00000000000 DFES_EnvTabVerb 0.00 1.00000000000 FORMAT "%13.11" /end CHARACTERISTIC
/begin CHARACTERISTIC DFES_EnvRef.DFC_ThrVlvSens1MaxB1_C "used environment signals / Reference to used environment condition set for check DFC_ThrVlvSens1MaxB1" VALUE 0x80504D29 Val_Wu8 1.00000000000 DFES_EnvTabVerb 0.00 1.00000000000 FORMAT "%13.11" /end CHARACTERISTIC
/begin CHARACTERISTIC DFES_EnvRef.DFC_ThrVlvSens1NplB1_C "used environment signals / Reference to used environment condition set for check DFC_ThrVlvSens1NplB1" VALUE 0x80504D2A Val_Wu8 1.00000000000 DFES_EnvTabVerb 0.00 1.00000000000 FORMAT "%13.11" /end CHARACTERISTIC
/begin CHARACTERISTIC DFES_EnvRef.DFC_ThrVlvSens2MaxB1_C "used environment signals / Reference to used environment condition set for check DFC_ThrVlvSens2MaxB1" VALUE 0x80504D2B Val_Wu8 1.00000000000 DFES_EnvTabVerb 0.00 1.00000000000 FORMAT "%13.11" /end CHARACTERISTIC
/begin CHARACTERISTIC DFES_EnvRef.DFC_ThrVlvSens2MinB1_C "used environment signals / Reference to used environment condition set for check DFC_ThrVlvSens2MinB1" VALUE 0x80504D2C Val_Wu8 1.00000000000 DFES_EnvTabVerb 0.00 1.00000000000 FORMAT "%13.11" /end CHARACTERISTIC
/begin CHARACTERISTIC DFES_EnvRef.DFC_ThrVlvSens2NplB1_C "used environment signals / Reference to used environment condition set for check DFC_ThrVlvSens2NplB1" VALUE 0x80504D2D Val_Wu8 1.00000000000 DFES_EnvTabVerb 0.00 1.00000000000 FORMAT "%13.11" /end CHARACTERISTIC
/begin CHARACTERISTIC DFES_EnvRef.DFC_ThrVlvShoCircB1_C "used environment signals / Reference to used environment condition set for check DFC_ThrVlvShoCircB1" VALUE 0x80504D2E Val_Wu8 1.00000000000 DFES_EnvTabVerb 0.00 1.00000000000 FORMAT "%13.11" /end CHARACTERISTIC
/begin CHARACTERISTIC DFES_EnvRef.DFC_ThrVlvSpiErrB1_C "used environment signals / Reference to used environment condition set for check DFC_ThrVlvSpiErrB1" VALUE 0x80504D2F Val_Wu8 1.00000000000 DFES_EnvTabVerb 0.00 1.00000000000 FORMAT "%13.11" /end CHARACTERISTIC
/begin CHARACTERISTIC DFES_EnvRef.DFC_ThrvlvSens1MinB1_C "used environment signals / Reference to used environment condition set for check DFC_ThrvlvSens1MinB1" VALUE 0x80504D30 Val_Wu8 1.00000000000 DFES_EnvTabVerb 0.00 1.00000000000 FORMAT "%13.11" /end CHARACTERISTIC
/begin CHARACTERISTIC DFES_EnvRef.DFC_TiOffTBasdChkFast_C "used environment signals / Reference to used environment condition set for check DFC_TiOffTBasdChkFast" VALUE 0x80504D31 Val_Wu8 1.00000000000 DFES_EnvTabVerb 0.00 1.00000000000 FORMAT "%13.11" /end CHARACTERISTIC
/begin CHARACTERISTIC DFES_EnvRef.DFC_TiOffTBasdChkSlow_C "used environment signals / Reference to used environment condition set for check DFC_TiOffTBasdChkSlow" VALUE 0x80504D32 Val_Wu8 1.00000000000 DFES_EnvTabVerb 0.00 1.00000000000 FORMAT "%13.11" /end CHARACTERISTIC
/begin CHARACTERISTIC DFES_EnvRef.DFC_UEGOSnsrMntdS1B1_C "used environment signals / Reference to used environment condition set for check DFC_UEGOSnsrMntdS1B1" VALUE 0x80504D33 Val_Wu8 1.00000000000 DFES_EnvTabVerb 0.00 1.00000000000 FORMAT "%13.11" /end CHARACTERISTIC
/begin CHARACTERISTIC DFES_EnvRef.DFC_VehVSig_C "used environment signals / Reference to used environment condition set for check DFC_VehVSig" VALUE 0x80504D34 Val_Wu8 1.00000000000 DFES_EnvTabVerb 0.00 1.00000000000 FORMAT "%13.11" /end CHARACTERISTIC
/begin CHARACTERISTIC DFES_EnvRef.DFC_VlvLftFbSwtIntk11SpclFail_C "used environment signals / Reference to used environment condition set for check DFC_VlvLftFbSwtIntk11SpclFail" VALUE 0x80504D35 Val_Wu8 1.00000000000 DFES_EnvTabVerb 0.00 1.00000000000 FORMAT "%13.11" /end CHARACTERISTIC
/begin CHARACTERISTIC DFES_EnvRef.DFC_VlvLftFbSwtIntk11StdFail_C "used environment signals / Reference to used environment condition set for check DFC_VlvLftFbSwtIntk11StdFail" VALUE 0x80504D36 Val_Wu8 1.00000000000 DFES_EnvTabVerb 0.00 1.00000000000 FORMAT "%13.11" /end CHARACTERISTIC
/begin CHARACTERISTIC DFES_FaultTyp.DFC_Unused_C "assigned fault type / " VALUE 0x80504D38 Val_Wu8 255.0 DFES_OneToOne 0.00 255.0 FORMAT "%5.1" READ_ONLY /end CHARACTERISTIC
/begin CHARACTERISTIC DFES_FaultTyp.DFC_AAVEmax_C "assigned fault type / Fault type assignment for check DFC_AAVEmax" VALUE 0x80504D39 Val_Wu8 255.0 DFES_OneToOne 0.00 255.0 FORMAT "%5.1" /end CHARACTERISTIC
/begin CHARACTERISTIC DFES_FaultTyp.DFC_AAVEmin_C "assigned fault type / Fault type assignment for check DFC_AAVEmin" VALUE 0x80504D3A Val_Wu8 255.0 DFES_OneToOne 0.00 255.0 FORMAT "%5.1" /end CHARACTERISTIC
/begin CHARACTERISTIC DFES_FaultTyp.DFC_AAVEsig_C "assigned fault type / Fault type assignment for check DFC_AAVEsig" VALUE 0x80504D3B Val_Wu8 255.0 DFES_OneToOne 0.00 255.0 FORMAT "%5.1" /end CHARACTERISTIC
/begin CHARACTERISTIC DFES_FaultTyp.DFC_AltIOACGFailr_C "assigned fault type / Fault type assignment for check DFC_AltIOACGFailr" VALUE 0x80504D3C Val_Wu8 255.0 DFES_OneToOne 0.00 255.0 FORMAT "%5.1" /end CHARACTERISTIC
/begin CHARACTERISTIC DFES_FaultTyp.DFC_AltIOACGHiVltg_C "assigned fault type / Fault type assignment for check DFC_AltIOACGHiVltg" VALUE 0x80504D3D Val_Wu8 255.0 DFES_OneToOne 0.00 255.0 FORMAT "%5.1" /end CHARACTERISTIC
/begin CHARACTERISTIC DFES_FaultTyp.DFC_AltIOACGLoVltg_C "assigned fault type / Fault type assignment for check DFC_AltIOACGLoVltg" VALUE 0x80504D3E Val_Wu8 255.0 DFES_OneToOne 0.00 255.0 FORMAT "%5.1" /end CHARACTERISTIC
/begin CHARACTERISTIC DFES_FaultTyp.DFC_AltIOACGTHi_C "assigned fault type / Fault type assignment for check DFC_AltIOACGTHi" VALUE 0x80504D3F Val_Wu8 255.0 DFES_OneToOne 0.00 255.0 FORMAT "%5.1" /end CHARACTERISTIC
/begin CHARACTERISTIC DFES_FaultTyp.DFC_AltIODConnACG_C "assigned fault type / Fault type assignment for check DFC_AltIODConnACG" VALUE 0x80504D40 Val_Wu8 255.0 DFES_OneToOne 0.00 255.0 FORMAT "%5.1" /end CHARACTERISTIC
/begin CHARACTERISTIC DFES_FaultTyp.DFC_BGOELWAF_C "assigned fault type / Fault type assignment for check DFC_BGOELWAF" VALUE 0x80504D41 Val_Wu8 255.0 DFES_OneToOne 0.00 255.0 FORMAT "%5.1" /end CHARACTERISTIC
/begin CHARACTERISTIC DFES_FaultTyp.DFC_BattUHiFailr_C "assigned fault type / Fault type assignment for check DFC_BattUHiFailr" VALUE 0x80504D42 Val_Wu8 255.0 DFES_OneToOne 0.00 255.0 FORMAT "%5.1" /end CHARACTERISTIC
/begin CHARACTERISTIC DFES_FaultTyp.DFC_BattULoFailr_C "assigned fault type / Fault type assignment for check DFC_BattULoFailr" VALUE 0x80504D43 Val_Wu8 255.0 DFES_OneToOne 0.00 255.0 FORMAT "%5.1" /end CHARACTERISTIC
/begin CHARACTERISTIC DFES_FaultTyp.DFC_BrkBstPDriftHiErr_C "assigned fault type / Fault type assignment for check DFC_BrkBstPDriftHiErr" VALUE 0x80504D44 Val_Wu8 255.0 DFES_OneToOne 0.00 255.0 FORMAT "%5.1" /end CHARACTERISTIC
/begin CHARACTERISTIC DFES_FaultTyp.DFC_BrkBstPDriftLoErr_C "assigned fault type / Fault type assignment for check DFC_BrkBstPDriftLoErr" VALUE 0x80504D45 Val_Wu8 255.0 DFES_OneToOne 0.00 255.0 FORMAT "%5.1" /end CHARACTERISTIC
/begin CHARACTERISTIC DFES_FaultTyp.DFC_BrkBstPSnsrStuck_C "assigned fault type / Fault type assignment for check DFC_BrkBstPSnsrStuck" VALUE 0x80504D46 Val_Wu8 255.0 DFES_OneToOne 0.00 255.0 FORMAT "%5.1" /end CHARACTERISTIC
/begin CHARACTERISTIC DFES_FaultTyp.DFC_BrkMnSwtContOn_C "assigned fault type / Fault type assignment for check DFC_BrkMnSwtContOn" VALUE 0x80504D47 Val_Wu8 255.0 DFES_OneToOne 0.00 255.0 FORMAT "%5.1" /end CHARACTERISTIC
/begin CHARACTERISTIC DFES_FaultTyp.DFC_BrkMnSwtNotStp_C "assigned fault type / Fault type assignment for check DFC_BrkMnSwtNotStp" VALUE 0x80504D48 Val_Wu8 255.0 DFES_OneToOne 0.00 255.0 FORMAT "%5.1" /end CHARACTERISTIC
/begin CHARACTERISTIC DFES_FaultTyp.DFC_BrkNpl_C "assigned fault type / Fault type assignment for check DFC_BrkNpl" VALUE 0x80504D49 Val_Wu8 255.0 DFES_OneToOne 0.00 255.0 FORMAT "%5.1" /end CHARACTERISTIC
/begin CHARACTERISTIC DFES_FaultTyp.DFC_BrkRdntSwtContOn_C "assigned fault type / Fault type assignment for check DFC_BrkRdntSwtContOn" VALUE 0x80504D4A Val_Wu8 255.0 DFES_OneToOne 0.00 255.0 FORMAT "%5.1" /end CHARACTERISTIC
/begin CHARACTERISTIC DFES_FaultTyp.DFC_BrkRdntSwtNotStp_C "assigned fault type / Fault type assignment for check DFC_BrkRdntSwtNotStp" VALUE 0x80504D4B Val_Wu8 255.0 DFES_OneToOne 0.00 255.0 FORMAT "%5.1" /end CHARACTERISTIC
/begin CHARACTERISTIC DFES_FaultTyp.DFC_Clth3ONStuck_C "assigned fault type / Fault type assignment for check DFC_Clth3ONStuck" VALUE 0x80504D4C Val_Wu8 255.0 DFES_OneToOne 0.00 255.0 FORMAT "%5.1" /end CHARACTERISTIC
/begin CHARACTERISTIC DFES_FaultTyp.DFC_Clth4OFFStuck_C "assigned fault type / Fault type assignment for check DFC_Clth4OFFStuck" VALUE 0x80504D4D Val_Wu8 255.0 DFES_OneToOne 0.00 255.0 FORMAT "%5.1" /end CHARACTERISTIC
/begin CHARACTERISTIC DFES_FaultTyp.DFC_ClthOFFStuck_C "assigned fault type / Fault type assignment for check DFC_ClthOFFStuck" VALUE 0x80504D4E Val_Wu8 255.0 DFES_OneToOne 0.00 255.0 FORMAT "%5.1" /end CHARACTERISTIC
/begin CHARACTERISTIC DFES_FaultTyp.DFC_ClthONStuck_C "assigned fault type / Fault type assignment for check DFC_ClthONStuck" VALUE 0x80504D4F Val_Wu8 255.0 DFES_OneToOne 0.00 255.0 FORMAT "%5.1" /end CHARACTERISTIC
/begin CHARACTERISTIC DFES_FaultTyp.DFC_ClthStkFailInfo_C "assigned fault type / Fault type assignment for check DFC_ClthStkFailInfo" VALUE 0x80504D50 Val_Wu8 255.0 DFES_OneToOne 0.00 255.0 FORMAT "%5.1" /end CHARACTERISTIC
/begin CHARACTERISTIC DFES_FaultTyp.DFC_ComACFailInfo_C "assigned fault type / Fault type assignment for check DFC_ComACFailInfo" VALUE 0x80504D51 Val_Wu8 255.0 DFES_OneToOne 0.00 255.0 FORMAT "%5.1" /end CHARACTERISTIC
/begin CHARACTERISTIC DFES_FaultTyp.DFC_ComATFTValErr_C "assigned fault type / Fault type assignment for check DFC_ComATFTValErr" VALUE 0x80504D52 Val_Wu8 255.0 DFES_OneToOne 0.00 255.0 FORMAT "%5.1" /end CHARACTERISTIC
/begin CHARACTERISTIC DFES_FaultTyp.DFC_ComATMILReq_C "assigned fault type / Fault type assignment for check DFC_ComATMILReq" VALUE 0x80504D53 Val_Wu8 255.0 DFES_OneToOne 0.00 255.0 FORMAT "%5.1" /end CHARACTERISTIC
/begin CHARACTERISTIC DFES_FaultTyp.DFC_ComAYCAChksum_C "assigned fault type / Fault type assignment for check DFC_ComAYCAChksum" VALUE 0x80504D54 Val_Wu8 255.0 DFES_OneToOne 0.00 255.0 FORMAT "%5.1" /end CHARACTERISTIC
/begin CHARACTERISTIC DFES_FaultTyp.DFC_ComAYCARingCnt_C "assigned fault type / Fault type assignment for check DFC_ComAYCARingCnt" VALUE 0x80504D55 Val_Wu8 255.0 DFES_OneToOne 0.00 255.0 FORMAT "%5.1" /end CHARACTERISTIC
/begin CHARACTERISTIC DFES_FaultTyp.DFC_ComAYCATOut_C "assigned fault type / Fault type assignment for check DFC_ComAYCATOut" VALUE 0x80504D56 Val_Wu8 255.0 DFES_OneToOne 0.00 255.0 FORMAT "%5.1" /end CHARACTERISTIC
/begin CHARACTERISTIC DFES_FaultTyp.DFC_ComAYCDChkSum_C "assigned fault type / Fault type assignment for check DFC_ComAYCDChkSum" VALUE 0x80504D57 Val_Wu8 255.0 DFES_OneToOne 0.00 255.0 FORMAT "%5.1" /end CHARACTERISTIC
/begin CHARACTERISTIC DFES_FaultTyp.DFC_ComAYCDTOut_C "assigned fault type / Fault type assignment for check DFC_ComAYCDTOut" VALUE 0x80504D58 Val_Wu8 255.0 DFES_OneToOne 0.00 255.0 FORMAT "%5.1" /end CHARACTERISTIC
/begin CHARACTERISTIC DFES_FaultTyp.DFC_ComAYCFChksum_C "assigned fault type / Fault type assignment for check DFC_ComAYCFChksum" VALUE 0x80504D59 Val_Wu8 255.0 DFES_OneToOne 0.00 255.0 FORMAT "%5.1" /end CHARACTERISTIC
/begin CHARACTERISTIC DFES_FaultTyp.DFC_ComAYCFRingCnt_C "assigned fault type / Fault type assignment for check DFC_ComAYCFRingCnt" VALUE 0x80504D5A Val_Wu8 255.0 DFES_OneToOne 0.00 255.0 FORMAT "%5.1" /end CHARACTERISTIC
/begin CHARACTERISTIC DFES_FaultTyp.DFC_ComAYCFTOut_C "assigned fault type / Fault type assignment for check DFC_ComAYCFTOut" VALUE 0x80504D5B Val_Wu8 255.0 DFES_OneToOne 0.00 255.0 FORMAT "%5.1" /end CHARACTERISTIC
/begin CHARACTERISTIC DFES_FaultTyp.DFC_ComAYCGChksum_C "assigned fault type / Fault type assignment for check DFC_ComAYCGChksum" VALUE 0x80504D5C Val_Wu8 255.0 DFES_OneToOne 0.00 255.0 FORMAT "%5.1" /end CHARACTERISTIC
/begin CHARACTERISTIC DFES_FaultTyp.DFC_ComAYCGRingCnt_C "assigned fault type / Fault type assignment for check DFC_ComAYCGRingCnt" VALUE 0x80504D5D Val_Wu8 255.0 DFES_OneToOne 0.00 255.0 FORMAT "%5.1" /end CHARACTERISTIC
/begin CHARACTERISTIC DFES_FaultTyp.DFC_ComAYCGTOut_C "assigned fault type / Fault type assignment for check DFC_ComAYCGTOut" VALUE 0x80504D5E Val_Wu8 255.0 DFES_OneToOne 0.00 255.0 FORMAT "%5.1" /end CHARACTERISTIC
/begin CHARACTERISTIC DFES_FaultTyp.DFC_ComAYCIChkSum_C "assigned fault type / Fault type assignment for check DFC_ComAYCIChkSum" VALUE 0x80504D5F Val_Wu8 255.0 DFES_OneToOne 0.00 255.0 FORMAT "%5.1" /end CHARACTERISTIC
/begin CHARACTERISTIC DFES_FaultTyp.DFC_ComAYCIRingCnt_C "assigned fault type / Fault type assignment for check DFC_ComAYCIRingCnt" VALUE 0x80504D60 Val_Wu8 255.0 DFES_OneToOne 0.00 255.0 FORMAT "%5.1" /end CHARACTERISTIC
/begin CHARACTERISTIC DFES_FaultTyp.DFC_ComAYCITOut_C "assigned fault type / Fault type assignment for check DFC_ComAYCITOut" VALUE 0x80504D61 Val_Wu8 255.0 DFES_OneToOne 0.00 255.0 FORMAT "%5.1" /end CHARACTERISTIC
/begin CHARACTERISTIC DFES_FaultTyp.DFC_ComBCM1ChkSum_C "assigned fault type / Fault type assignment for check DFC_ComBCM1ChkSum" VALUE 0x80504D62 Val_Wu8 255.0 DFES_OneToOne 0.00 255.0 FORMAT "%5.1" /end CHARACTERISTIC
/begin CHARACTERISTIC DFES_FaultTyp.DFC_ComBCM1RingCnt_C "assigned fault type / Fault type assignment for check DFC_ComBCM1RingCnt" VALUE 0x80504D63 Val_Wu8 255.0 DFES_OneToOne 0.00 255.0 FORMAT "%5.1" /end CHARACTERISTIC
/begin CHARACTERISTIC DFES_FaultTyp.DFC_ComBCM1TOut_C "assigned fault type / Fault type assignment for check DFC_ComBCM1TOut" VALUE 0x80504D64 Val_Wu8 255.0 DFES_OneToOne 0.00 255.0 FORMAT "%5.1" /end CHARACTERISTIC
/begin CHARACTERISTIC DFES_FaultTyp.DFC_ComCANABusOffErr_C "assigned fault type / Fault type assignment for check DFC_ComCANABusOffErr" VALUE 0x80504D65 Val_Wu8 255.0 DFES_OneToOne 0.00 255.0 FORMAT "%5.1" /end CHARACTERISTIC
/begin CHARACTERISTIC DFES_FaultTyp.DFC_ComCANBBusOffErr_C "assigned fault type / Fault type assignment for check DFC_ComCANBBusOffErr" VALUE 0x80504D66 Val_Wu8 255.0 DFES_OneToOne 0.00 255.0 FORMAT "%5.1" /end CHARACTERISTIC
/begin CHARACTERISTIC DFES_FaultTyp.DFC_ComCANCBusOffErr_C "assigned fault type / Fault type assignment for check DFC_ComCANCBusOffErr" VALUE 0x80504D67 Val_Wu8 255.0 DFES_OneToOne 0.00 255.0 FORMAT "%5.1" /end CHARACTERISTIC
/begin CHARACTERISTIC DFES_FaultTyp.DFC_ComCGW1ChkSum_C "assigned fault type / Fault type assignment for check DFC_ComCGW1ChkSum" VALUE 0x80504D68 Val_Wu8 255.0 DFES_OneToOne 0.00 255.0 FORMAT "%5.1" /end CHARACTERISTIC
/begin CHARACTERISTIC DFES_FaultTyp.DFC_ComCGW1RingCnt_C "assigned fault type / Fault type assignment for check DFC_ComCGW1RingCnt" VALUE 0x80504D69 Val_Wu8 255.0 DFES_OneToOne 0.00 255.0 FORMAT "%5.1" /end CHARACTERISTIC
/begin CHARACTERISTIC DFES_FaultTyp.DFC_ComCGW1TOut_C "assigned fault type / Fault type assignment for check DFC_ComCGW1TOut" VALUE 0x80504D6A Val_Wu8 255.0 DFES_OneToOne 0.00 255.0 FORMAT "%5.1" /end CHARACTERISTIC
/begin CHARACTERISTIC DFES_FaultTyp.DFC_ComConvBoostErr_C "assigned fault type / Fault type assignment for check DFC_ComConvBoostErr" VALUE 0x80504D6B Val_Wu8 255.0 DFES_OneToOne 0.00 255.0 FORMAT "%5.1" /end CHARACTERISTIC
/begin CHARACTERISTIC DFES_FaultTyp.DFC_ComConvSlipErr_C "assigned fault type / Fault type assignment for check DFC_ComConvSlipErr" VALUE 0x80504D6C Val_Wu8 255.0 DFES_OneToOne 0.00 255.0 FORMAT "%5.1" /end CHARACTERISTIC
/begin CHARACTERISTIC DFES_FaultTyp.DFC_ComDCDCPrfmncErr_C "assigned fault type / Fault type assignment for check DFC_ComDCDCPrfmncErr" VALUE 0x80504D6D Val_Wu8 255.0 DFES_OneToOne 0.00 255.0 FORMAT "%5.1" /end CHARACTERISTIC
/begin CHARACTERISTIC DFES_FaultTyp.DFC_ComDCDCTempWarn_C "assigned fault type / Fault type assignment for check DFC_ComDCDCTempWarn" VALUE 0x80504D6E Val_Wu8 255.0 DFES_OneToOne 0.00 255.0 FORMAT "%5.1" /end CHARACTERISTIC
/begin CHARACTERISTIC DFES_FaultTyp.DFC_ComEAT10Chksum_C "assigned fault type / Fault type assignment for check DFC_ComEAT10Chksum" VALUE 0x80504D6F Val_Wu8 255.0 DFES_OneToOne 0.00 255.0 FORMAT "%5.1" /end CHARACTERISTIC
/begin CHARACTERISTIC DFES_FaultTyp.DFC_ComEAT10RingCnt_C "assigned fault type / Fault type assignment for check DFC_ComEAT10RingCnt" VALUE 0x80504D70 Val_Wu8 255.0 DFES_OneToOne 0.00 255.0 FORMAT "%5.1" /end CHARACTERISTIC
/begin CHARACTERISTIC DFES_FaultTyp.DFC_ComEAT10TOut_C "assigned fault type / Fault type assignment for check DFC_ComEAT10TOut" VALUE 0x80504D71 Val_Wu8 255.0 DFES_OneToOne 0.00 255.0 FORMAT "%5.1" /end CHARACTERISTIC
/begin CHARACTERISTIC DFES_FaultTyp.DFC_ComEAT11ChkSum_C "assigned fault type / Fault type assignment for check DFC_ComEAT11ChkSum" VALUE 0x80504D72 Val_Wu8 255.0 DFES_OneToOne 0.00 255.0 FORMAT "%5.1" /end CHARACTERISTIC
/begin CHARACTERISTIC DFES_FaultTyp.DFC_ComEAT11RingCnt_C "assigned fault type / Fault type assignment for check DFC_ComEAT11RingCnt" VALUE 0x80504D73 Val_Wu8 255.0 DFES_OneToOne 0.00 255.0 FORMAT "%5.1" /end CHARACTERISTIC
/begin CHARACTERISTIC DFES_FaultTyp.DFC_ComEAT11TOut_C "assigned fault type / Fault type assignment for check DFC_ComEAT11TOut" VALUE 0x80504D74 Val_Wu8 255.0 DFES_OneToOne 0.00 255.0 FORMAT "%5.1" /end CHARACTERISTIC
/begin CHARACTERISTIC DFES_FaultTyp.DFC_ComEAT12ChkSum_C "assigned fault type / Fault type assignment for check DFC_ComEAT12ChkSum" VALUE 0x80504D75 Val_Wu8 255.0 DFES_OneToOne 0.00 255.0 FORMAT "%5.1" /end CHARACTERISTIC
/begin CHARACTERISTIC DFES_FaultTyp.DFC_ComEAT12RingCnt_C "assigned fault type / Fault type assignment for check DFC_ComEAT12RingCnt" VALUE 0x80504D76 Val_Wu8 255.0 DFES_OneToOne 0.00 255.0 FORMAT "%5.1" /end CHARACTERISTIC
/begin CHARACTERISTIC DFES_FaultTyp.DFC_ComEAT12TOut_C "assigned fault type / Fault type assignment for check DFC_ComEAT12TOut" VALUE 0x80504D77 Val_Wu8 255.0 DFES_OneToOne 0.00 255.0 FORMAT "%5.1" /end CHARACTERISTIC
/begin CHARACTERISTIC DFES_FaultTyp.DFC_ComEAT13ChkSum_C "assigned fault type / Fault type assignment for check DFC_ComEAT13ChkSum" VALUE 0x80504D78 Val_Wu8 255.0 DFES_OneToOne 0.00 255.0 FORMAT "%5.1" /end CHARACTERISTIC
/begin CHARACTERISTIC DFES_FaultTyp.DFC_ComEAT13RingCnt_C "assigned fault type / Fault type assignment for check DFC_ComEAT13RingCnt" VALUE 0x80504D79 Val_Wu8 255.0 DFES_OneToOne 0.00 255.0 FORMAT "%5.1" /end CHARACTERISTIC
/begin CHARACTERISTIC DFES_FaultTyp.DFC_ComEAT13TOut_C "assigned fault type / Fault type assignment for check DFC_ComEAT13TOut" VALUE 0x80504D7A Val_Wu8 255.0 DFES_OneToOne 0.00 255.0 FORMAT "%5.1" /end CHARACTERISTIC
/begin CHARACTERISTIC DFES_FaultTyp.DFC_ComEAT1Chksum_C "assigned fault type / Fault type assignment for check DFC_ComEAT1Chksum" VALUE 0x80504D7B Val_Wu8 255.0 DFES_OneToOne 0.00 255.0 FORMAT "%5.1" /end CHARACTERISTIC
/begin CHARACTERISTIC DFES_FaultTyp.DFC_ComEAT1RingCnt_C "assigned fault type / Fault type assignment for check DFC_ComEAT1RingCnt" VALUE 0x80504D7C Val_Wu8 255.0 DFES_OneToOne 0.00 255.0 FORMAT "%5.1" /end CHARACTERISTIC
/begin CHARACTERISTIC DFES_FaultTyp.DFC_ComEAT1TOut_C "assigned fault type / Fault type assignment for check DFC_ComEAT1TOut" VALUE 0x80504D7D Val_Wu8 255.0 DFES_OneToOne 0.00 255.0 FORMAT "%5.1" /end CHARACTERISTIC
/begin CHARACTERISTIC DFES_FaultTyp.DFC_ComEAT2ChkSum_C "assigned fault type / Fault type assignment for check DFC_ComEAT2ChkSum" VALUE 0x80504D7E Val_Wu8 255.0 DFES_OneToOne 0.00 255.0 FORMAT "%5.1" /end CHARACTERISTIC
/begin CHARACTERISTIC DFES_FaultTyp.DFC_ComEAT2RingCnt_C "assigned fault type / Fault type assignment for check DFC_ComEAT2RingCnt" VALUE 0x80504D7F Val_Wu8 255.0 DFES_OneToOne 0.00 255.0 FORMAT "%5.1" /end CHARACTERISTIC
/begin CHARACTERISTIC DFES_FaultTyp.DFC_ComEAT2TOut_C "assigned fault type / Fault type assignment for check DFC_ComEAT2TOut" VALUE 0x80504D80 Val_Wu8 255.0 DFES_OneToOne 0.00 255.0 FORMAT "%5.1" /end CHARACTERISTIC
/begin CHARACTERISTIC DFES_FaultTyp.DFC_ComEAT4ChkSum_C "assigned fault type / Fault type assignment for check DFC_ComEAT4ChkSum" VALUE 0x80504D81 Val_Wu8 255.0 DFES_OneToOne 0.00 255.0 FORMAT "%5.1" /end CHARACTERISTIC
/begin CHARACTERISTIC DFES_FaultTyp.DFC_ComEAT4RingCnt_C "assigned fault type / Fault type assignment for check DFC_ComEAT4RingCnt" VALUE 0x80504D82 Val_Wu8 255.0 DFES_OneToOne 0.00 255.0 FORMAT "%5.1" /end CHARACTERISTIC
/begin CHARACTERISTIC DFES_FaultTyp.DFC_ComEAT4TOut_C "assigned fault type / Fault type assignment for check DFC_ComEAT4TOut" VALUE 0x80504D83 Val_Wu8 255.0 DFES_OneToOne 0.00 255.0 FORMAT "%5.1" /end CHARACTERISTIC
/begin CHARACTERISTIC DFES_FaultTyp.DFC_ComEAT6Chksum_C "assigned fault type / Fault type assignment for check DFC_ComEAT6Chksum" VALUE 0x80504D84 Val_Wu8 255.0 DFES_OneToOne 0.00 255.0 FORMAT "%5.1" /end CHARACTERISTIC
/begin CHARACTERISTIC DFES_FaultTyp.DFC_ComEAT6RingCnt_C "assigned fault type / Fault type assignment for check DFC_ComEAT6RingCnt" VALUE 0x80504D85 Val_Wu8 255.0 DFES_OneToOne 0.00 255.0 FORMAT "%5.1" /end CHARACTERISTIC
/begin CHARACTERISTIC DFES_FaultTyp.DFC_ComEAT6TOut_C "assigned fault type / Fault type assignment for check DFC_ComEAT6TOut" VALUE 0x80504D86 Val_Wu8 255.0 DFES_OneToOne 0.00 255.0 FORMAT "%5.1" /end CHARACTERISTIC
/begin CHARACTERISTIC DFES_FaultTyp.DFC_ComEAT7Chksum_C "assigned fault type / Fault type assignment for check DFC_ComEAT7Chksum" VALUE 0x80504D87 Val_Wu8 255.0 DFES_OneToOne 0.00 255.0 FORMAT "%5.1" /end CHARACTERISTIC
/begin CHARACTERISTIC DFES_FaultTyp.DFC_ComEAT7RingCnt_C "assigned fault type / Fault type assignment for check DFC_ComEAT7RingCnt" VALUE 0x80504D88 Val_Wu8 255.0 DFES_OneToOne 0.00 255.0 FORMAT "%5.1" /end CHARACTERISTIC
/begin CHARACTERISTIC DFES_FaultTyp.DFC_ComEAT7TOut_C "assigned fault type / Fault type assignment for check DFC_ComEAT7TOut" VALUE 0x80504D89 Val_Wu8 255.0 DFES_OneToOne 0.00 255.0 FORMAT "%5.1" /end CHARACTERISTIC
/begin CHARACTERISTIC DFES_FaultTyp.DFC_ComEAT8Chksum_C "assigned fault type / Fault type assignment for check DFC_ComEAT8Chksum" VALUE 0x80504D8A Val_Wu8 255.0 DFES_OneToOne 0.00 255.0 FORMAT "%5.1" /end CHARACTERISTIC
/begin CHARACTERISTIC DFES_FaultTyp.DFC_ComEAT8RingCnt_C "assigned fault type / Fault type assignment for check DFC_ComEAT8RingCnt" VALUE 0x80504D8B Val_Wu8 255.0 DFES_OneToOne 0.00 255.0 FORMAT "%5.1" /end CHARACTERISTIC
/begin CHARACTERISTIC DFES_FaultTyp.DFC_ComEAT8TOut_C "assigned fault type / Fault type assignment for check DFC_ComEAT8TOut" VALUE 0x80504D8C Val_Wu8 255.0 DFES_OneToOne 0.00 255.0 FORMAT "%5.1" /end CHARACTERISTIC
/begin CHARACTERISTIC DFES_FaultTyp.DFC_ComEATAChksum_C "assigned fault type / Fault type assignment for check DFC_ComEATAChksum" VALUE 0x80504D8D Val_Wu8 255.0 DFES_OneToOne 0.00 255.0 FORMAT "%5.1" /end CHARACTERISTIC
/begin CHARACTERISTIC DFES_FaultTyp.DFC_ComEATARingCnt_C "assigned fault type / Fault type assignment for check DFC_ComEATARingCnt" VALUE 0x80504D8E Val_Wu8 255.0 DFES_OneToOne 0.00 255.0 FORMAT "%5.1" /end CHARACTERISTIC
/begin CHARACTERISTIC DFES_FaultTyp.DFC_ComEATATOut_C "assigned fault type / Fault type assignment for check DFC_ComEATATOut" VALUE 0x80504D8F Val_Wu8 255.0 DFES_OneToOne 0.00 255.0 FORMAT "%5.1" /end CHARACTERISTIC
/begin CHARACTERISTIC DFES_FaultTyp.DFC_ComEATBChkSum_C "assigned fault type / Fault type assignment for check DFC_ComEATBChkSum" VALUE 0x80504D90 Val_Wu8 255.0 DFES_OneToOne 0.00 255.0 FORMAT "%5.1" /end CHARACTERISTIC
/begin CHARACTERISTIC DFES_FaultTyp.DFC_ComEATBRingCnt_C "assigned fault type / Fault type assignment for check DFC_ComEATBRingCnt" VALUE 0x80504D91 Val_Wu8 255.0 DFES_OneToOne 0.00 255.0 FORMAT "%5.1" /end CHARACTERISTIC
/begin CHARACTERISTIC DFES_FaultTyp.DFC_ComEATBTOut_C "assigned fault type / Fault type assignment for check DFC_ComEATBTOut" VALUE 0x80504D92 Val_Wu8 255.0 DFES_OneToOne 0.00 255.0 FORMAT "%5.1" /end CHARACTERISTIC
/begin CHARACTERISTIC DFES_FaultTyp.DFC_ComEATCChksum_C "assigned fault type / Fault type assignment for check DFC_ComEATCChksum" VALUE 0x80504D93 Val_Wu8 255.0 DFES_OneToOne 0.00 255.0 FORMAT "%5.1" /end CHARACTERISTIC
/begin CHARACTERISTIC DFES_FaultTyp.DFC_ComEATCRingCnt_C "assigned fault type / Fault type assignment for check DFC_ComEATCRingCnt" VALUE 0x80504D94 Val_Wu8 255.0 DFES_OneToOne 0.00 255.0 FORMAT "%5.1" /end CHARACTERISTIC
/begin CHARACTERISTIC DFES_FaultTyp.DFC_ComEATCTOut_C "assigned fault type / Fault type assignment for check DFC_ComEATCTOut" VALUE 0x80504D95 Val_Wu8 255.0 DFES_OneToOne 0.00 255.0 FORMAT "%5.1" /end CHARACTERISTIC
/begin CHARACTERISTIC DFES_FaultTyp.DFC_ComEPBBChkSum_C "assigned fault type / Fault type assignment for check DFC_ComEPBBChkSum" VALUE 0x80504D96 Val_Wu8 255.0 DFES_OneToOne 0.00 255.0 FORMAT "%5.1" /end CHARACTERISTIC
/begin CHARACTERISTIC DFES_FaultTyp.DFC_ComEPBBRingCnt_C "assigned fault type / Fault type assignment for check DFC_ComEPBBRingCnt" VALUE 0x80504D97 Val_Wu8 255.0 DFES_OneToOne 0.00 255.0 FORMAT "%5.1" /end CHARACTERISTIC
/begin CHARACTERISTIC DFES_FaultTyp.DFC_ComEPBBTOut_C "assigned fault type / Fault type assignment for check DFC_ComEPBBTOut" VALUE 0x80504D98 Val_Wu8 255.0 DFES_OneToOne 0.00 255.0 FORMAT "%5.1" /end CHARACTERISTIC
/begin CHARACTERISTIC DFES_FaultTyp.DFC_ComEPBChksum_C "assigned fault type / Fault type assignment for check DFC_ComEPBChksum" VALUE 0x80504D99 Val_Wu8 255.0 DFES_OneToOne 0.00 255.0 FORMAT "%5.1" /end CHARACTERISTIC
/begin CHARACTERISTIC DFES_FaultTyp.DFC_ComEPBTOut_C "assigned fault type / Fault type assignment for check DFC_ComEPBTOut" VALUE 0x80504D9A Val_Wu8 255.0 DFES_OneToOne 0.00 255.0 FORMAT "%5.1" /end CHARACTERISTIC
/begin CHARACTERISTIC DFES_FaultTyp.DFC_ComEPBctRing_C "assigned fault type / Fault type assignment for check DFC_ComEPBctRing" VALUE 0x80504D9B Val_Wu8 255.0 DFES_OneToOne 0.00 255.0 FORMAT "%5.1" /end CHARACTERISTIC
/begin CHARACTERISTIC DFES_FaultTyp.DFC_ComEPS1Chksum_C "assigned fault type / Fault type assignment for check DFC_ComEPS1Chksum" VALUE 0x80504D9C Val_Wu8 255.0 DFES_OneToOne 0.00 255.0 FORMAT "%5.1" /end CHARACTERISTIC
/begin CHARACTERISTIC DFES_FaultTyp.DFC_ComEPS1RingCnt_C "assigned fault type / Fault type assignment for check DFC_ComEPS1RingCnt" VALUE 0x80504D9D Val_Wu8 255.0 DFES_OneToOne 0.00 255.0 FORMAT "%5.1" /end CHARACTERISTIC
/begin CHARACTERISTIC DFES_FaultTyp.DFC_ComEPS1TOut_C "assigned fault type / Fault type assignment for check DFC_ComEPS1TOut" VALUE 0x80504D9E Val_Wu8 255.0 DFES_OneToOne 0.00 255.0 FORMAT "%5.1" /end CHARACTERISTIC
/begin CHARACTERISTIC DFES_FaultTyp.DFC_ComEngCanRxErr_C "assigned fault type / Fault type assignment for check DFC_ComEngCanRxErr" VALUE 0x80504D9F Val_Wu8 255.0 DFES_OneToOne 0.00 255.0 FORMAT "%5.1" /end CHARACTERISTIC
/begin CHARACTERISTIC DFES_FaultTyp.DFC_ComGrvySnsrErr_C "assigned fault type / Fault type assignment for check DFC_ComGrvySnsrErr" VALUE 0x80504DA0 Val_Wu8 255.0 DFES_OneToOne 0.00 255.0 FORMAT "%5.1" /end CHARACTERISTIC
/begin CHARACTERISTIC DFES_FaultTyp.DFC_ComGwIMG1ChkSum_C "assigned fault type / Fault type assignment for check DFC_ComGwIMG1ChkSum" VALUE 0x80504DA1 Val_Wu8 255.0 DFES_OneToOne 0.00 255.0 FORMAT "%5.1" /end CHARACTERISTIC
/begin CHARACTERISTIC DFES_FaultTyp.DFC_ComGwIMG1RingCnt_C "assigned fault type / Fault type assignment for check DFC_ComGwIMG1RingCnt" VALUE 0x80504DA2 Val_Wu8 255.0 DFES_OneToOne 0.00 255.0 FORMAT "%5.1" /end CHARACTERISTIC
/begin CHARACTERISTIC DFES_FaultTyp.DFC_ComGwIMG1TOut_C "assigned fault type / Fault type assignment for check DFC_ComGwIMG1TOut" VALUE 0x80504DA3 Val_Wu8 255.0 DFES_OneToOne 0.00 255.0 FORMAT "%5.1" /end CHARACTERISTIC
/begin CHARACTERISTIC DFES_FaultTyp.DFC_ComGwIMG3ChkSum_C "assigned fault type / Fault type assignment for check DFC_ComGwIMG3ChkSum" VALUE 0x80504DA4 Val_Wu8 255.0 DFES_OneToOne 0.00 255.0 FORMAT "%5.1" /end CHARACTERISTIC
/begin CHARACTERISTIC DFES_FaultTyp.DFC_ComGwIMG3RingCnt_C "assigned fault type / Fault type assignment for check DFC_ComGwIMG3RingCnt" VALUE 0x80504DA5 Val_Wu8 255.0 DFES_OneToOne 0.00 255.0 FORMAT "%5.1" /end CHARACTERISTIC
/begin CHARACTERISTIC DFES_FaultTyp.DFC_ComGwIMG3TOut_C "assigned fault type / Fault type assignment for check DFC_ComGwIMG3TOut" VALUE 0x80504DA6 Val_Wu8 255.0 DFES_OneToOne 0.00 255.0 FORMAT "%5.1" /end CHARACTERISTIC
/begin CHARACTERISTIC DFES_FaultTyp.DFC_ComGwIMG4ChkSum_C "assigned fault type / Fault type assignment for check DFC_ComGwIMG4ChkSum" VALUE 0x80504DA7 Val_Wu8 255.0 DFES_OneToOne 0.00 255.0 FORMAT "%5.1" /end CHARACTERISTIC
/begin CHARACTERISTIC DFES_FaultTyp.DFC_ComGwIMG4RingCnt_C "assigned fault type / Fault type assignment for check DFC_ComGwIMG4RingCnt" VALUE 0x80504DA8 Val_Wu8 255.0 DFES_OneToOne 0.00 255.0 FORMAT "%5.1" /end CHARACTERISTIC
/begin CHARACTERISTIC DFES_FaultTyp.DFC_ComGwIMG4TOut_C "assigned fault type / Fault type assignment for check DFC_ComGwIMG4TOut" VALUE 0x80504DA9 Val_Wu8 255.0 DFES_OneToOne 0.00 255.0 FORMAT "%5.1" /end CHARACTERISTIC
/begin CHARACTERISTIC DFES_FaultTyp.DFC_ComGwIMG5ChkSum_C "assigned fault type / Fault type assignment for check DFC_ComGwIMG5ChkSum" VALUE 0x80504DAA Val_Wu8 255.0 DFES_OneToOne 0.00 255.0 FORMAT "%5.1" /end CHARACTERISTIC
/begin CHARACTERISTIC DFES_FaultTyp.DFC_ComGwIMG5RingCnt_C "assigned fault type / Fault type assignment for check DFC_ComGwIMG5RingCnt" VALUE 0x80504DAB Val_Wu8 255.0 DFES_OneToOne 0.00 255.0 FORMAT "%5.1" /end CHARACTERISTIC
/begin CHARACTERISTIC DFES_FaultTyp.DFC_ComGwIMG5TOut_C "assigned fault type / Fault type assignment for check DFC_ComGwIMG5TOut" VALUE 0x80504DAC Val_Wu8 255.0 DFES_OneToOne 0.00 255.0 FORMAT "%5.1" /end CHARACTERISTIC
/begin CHARACTERISTIC DFES_FaultTyp.DFC_ComGwIMG6ChkSum_C "assigned fault type / Fault type assignment for check DFC_ComGwIMG6ChkSum" VALUE 0x80504DAD Val_Wu8 255.0 DFES_OneToOne 0.00 255.0 FORMAT "%5.1" /end CHARACTERISTIC
/begin CHARACTERISTIC DFES_FaultTyp.DFC_ComGwIMG6RingCnt_C "assigned fault type / Fault type assignment for check DFC_ComGwIMG6RingCnt" VALUE 0x80504DAE Val_Wu8 255.0 DFES_OneToOne 0.00 255.0 FORMAT "%5.1" /end CHARACTERISTIC
/begin CHARACTERISTIC DFES_FaultTyp.DFC_ComGwIMG6TOut_C "assigned fault type / Fault type assignment for check DFC_ComGwIMG6TOut" VALUE 0x80504DAF Val_Wu8 255.0 DFES_OneToOne 0.00 255.0 FORMAT "%5.1" /end CHARACTERISTIC
/begin CHARACTERISTIC DFES_FaultTyp.DFC_ComIDASBChksum_C "assigned fault type / Fault type assignment for check DFC_ComIDASBChksum" VALUE 0x80504DB0 Val_Wu8 255.0 DFES_OneToOne 0.00 255.0 FORMAT "%5.1" /end CHARACTERISTIC
/begin CHARACTERISTIC DFES_FaultTyp.DFC_ComIDASBRingCnt_C "assigned fault type / Fault type assignment for check DFC_ComIDASBRingCnt" VALUE 0x80504DB1 Val_Wu8 255.0 DFES_OneToOne 0.00 255.0 FORMAT "%5.1" /end CHARACTERISTIC
/begin CHARACTERISTIC DFES_FaultTyp.DFC_ComIDASBTOut_C "assigned fault type / Fault type assignment for check DFC_ComIDASBTOut" VALUE 0x80504DB2 Val_Wu8 255.0 DFES_OneToOne 0.00 255.0 FORMAT "%5.1" /end CHARACTERISTIC
/begin CHARACTERISTIC DFES_FaultTyp.DFC_ComIMGMILReq_C "assigned fault type / Fault type assignment for check DFC_ComIMGMILReq" VALUE 0x80504DB3 Val_Wu8 255.0 DFES_OneToOne 0.00 255.0 FORMAT "%5.1" /end CHARACTERISTIC
/begin CHARACTERISTIC DFES_FaultTyp.DFC_ComISSPrms_C "assigned fault type / Fault type assignment for check DFC_ComISSPrms" VALUE 0x80504DB4 Val_Wu8 255.0 DFES_OneToOne 0.00 255.0 FORMAT "%5.1" /end CHARACTERISTIC
/begin CHARACTERISTIC DFES_FaultTyp.DFC_ComMETAChksum_C "assigned fault type / Fault type assignment for check DFC_ComMETAChksum" VALUE 0x80504DB5 Val_Wu8 255.0 DFES_OneToOne 0.00 255.0 FORMAT "%5.1" /end CHARACTERISTIC
/begin CHARACTERISTIC DFES_FaultTyp.DFC_ComMETAChksumPstDrv_C "assigned fault type / Fault type assignment for check DFC_ComMETAChksumPstDrv" VALUE 0x80504DB6 Val_Wu8 255.0 DFES_OneToOne 0.00 255.0 FORMAT "%5.1" /end CHARACTERISTIC
/begin CHARACTERISTIC DFES_FaultTyp.DFC_ComMETARingCnt_C "assigned fault type / Fault type assignment for check DFC_ComMETARingCnt" VALUE 0x80504DB7 Val_Wu8 255.0 DFES_OneToOne 0.00 255.0 FORMAT "%5.1" /end CHARACTERISTIC
/begin CHARACTERISTIC DFES_FaultTyp.DFC_ComMETARingCntPstDrv_C "assigned fault type / Fault type assignment for check DFC_ComMETARingCntPstDrv" VALUE 0x80504DB8 Val_Wu8 255.0 DFES_OneToOne 0.00 255.0 FORMAT "%5.1" /end CHARACTERISTIC
/begin CHARACTERISTIC DFES_FaultTyp.DFC_ComMETATOut_C "assigned fault type / Fault type assignment for check DFC_ComMETATOut" VALUE 0x80504DB9 Val_Wu8 255.0 DFES_OneToOne 0.00 255.0 FORMAT "%5.1" /end CHARACTERISTIC
/begin CHARACTERISTIC DFES_FaultTyp.DFC_ComMETATOutPstDrv_C "assigned fault type / Fault type assignment for check DFC_ComMETATOutPstDrv" VALUE 0x80504DBA Val_Wu8 255.0 DFES_OneToOne 0.00 255.0 FORMAT "%5.1" /end CHARACTERISTIC
/begin CHARACTERISTIC DFES_FaultTyp.DFC_ComMETCChksum_C "assigned fault type / Fault type assignment for check DFC_ComMETCChksum" VALUE 0x80504DBB Val_Wu8 255.0 DFES_OneToOne 0.00 255.0 FORMAT "%5.1" /end CHARACTERISTIC
/begin CHARACTERISTIC DFES_FaultTyp.DFC_ComMETCRingCnt_C "assigned fault type / Fault type assignment for check DFC_ComMETCRingCnt" VALUE 0x80504DBC Val_Wu8 255.0 DFES_OneToOne 0.00 255.0 FORMAT "%5.1" /end CHARACTERISTIC
/begin CHARACTERISTIC DFES_FaultTyp.DFC_ComMETCTOut_C "assigned fault type / Fault type assignment for check DFC_ComMETCTOut" VALUE 0x80504DBD Val_Wu8 255.0 DFES_OneToOne 0.00 255.0 FORMAT "%5.1" /end CHARACTERISTIC
/begin CHARACTERISTIC DFES_FaultTyp.DFC_ComMETDChksum_C "assigned fault type / Fault type assignment for check DFC_ComMETDChksum" VALUE 0x80504DBE Val_Wu8 255.0 DFES_OneToOne 0.00 255.0 FORMAT "%5.1" /end CHARACTERISTIC
/begin CHARACTERISTIC DFES_FaultTyp.DFC_ComMETDRingCnt_C "assigned fault type / Fault type assignment for check DFC_ComMETDRingCnt" VALUE 0x80504DBF Val_Wu8 255.0 DFES_OneToOne 0.00 255.0 FORMAT "%5.1" /end CHARACTERISTIC
/begin CHARACTERISTIC DFES_FaultTyp.DFC_ComMETDTOut_C "assigned fault type / Fault type assignment for check DFC_ComMETDTOut" VALUE 0x80504DC0 Val_Wu8 255.0 DFES_OneToOne 0.00 255.0 FORMAT "%5.1" /end CHARACTERISTIC
/begin CHARACTERISTIC DFES_FaultTyp.DFC_ComMETE2Chksum_C "assigned fault type / Fault type assignment for check DFC_ComMETE2Chksum" VALUE 0x80504DC1 Val_Wu8 255.0 DFES_OneToOne 0.00 255.0 FORMAT "%5.1" /end CHARACTERISTIC
/begin CHARACTERISTIC DFES_FaultTyp.DFC_ComMETE2RingCnt_C "assigned fault type / Fault type assignment for check DFC_ComMETE2RingCnt" VALUE 0x80504DC2 Val_Wu8 255.0 DFES_OneToOne 0.00 255.0 FORMAT "%5.1" /end CHARACTERISTIC
/begin CHARACTERISTIC DFES_FaultTyp.DFC_ComMETE2TOut_C "assigned fault type / Fault type assignment for check DFC_ComMETE2TOut" VALUE 0x80504DC3 Val_Wu8 255.0 DFES_OneToOne 0.00 255.0 FORMAT "%5.1" /end CHARACTERISTIC
/begin CHARACTERISTIC DFES_FaultTyp.DFC_ComMETFChksum_C "assigned fault type / Fault type assignment for check DFC_ComMETFChksum" VALUE 0x80504DC4 Val_Wu8 255.0 DFES_OneToOne 0.00 255.0 FORMAT "%5.1" /end CHARACTERISTIC
/begin CHARACTERISTIC DFES_FaultTyp.DFC_ComMETFRingCnt_C "assigned fault type / Fault type assignment for check DFC_ComMETFRingCnt" VALUE 0x80504DC5 Val_Wu8 255.0 DFES_OneToOne 0.00 255.0 FORMAT "%5.1" /end CHARACTERISTIC
/begin CHARACTERISTIC DFES_FaultTyp.DFC_ComMETFTOut_C "assigned fault type / Fault type assignment for check DFC_ComMETFTOut" VALUE 0x80504DC6 Val_Wu8 255.0 DFES_OneToOne 0.00 255.0 FORMAT "%5.1" /end CHARACTERISTIC
/begin CHARACTERISTIC DFES_FaultTyp.DFC_ComMETGChksum_C "assigned fault type / Fault type assignment for check DFC_ComMETGChksum" VALUE 0x80504DC7 Val_Wu8 255.0 DFES_OneToOne 0.00 255.0 FORMAT "%5.1" /end CHARACTERISTIC
/begin CHARACTERISTIC DFES_FaultTyp.DFC_ComMETGRingCnt_C "assigned fault type / Fault type assignment for check DFC_ComMETGRingCnt" VALUE 0x80504DC8 Val_Wu8 255.0 DFES_OneToOne 0.00 255.0 FORMAT "%5.1" /end CHARACTERISTIC
/begin CHARACTERISTIC DFES_FaultTyp.DFC_ComMETGTOut_C "assigned fault type / Fault type assignment for check DFC_ComMETGTOut" VALUE 0x80504DC9 Val_Wu8 255.0 DFES_OneToOne 0.00 255.0 FORMAT "%5.1" /end CHARACTERISTIC
/begin CHARACTERISTIC DFES_FaultTyp.DFC_ComMETH2Chksum_C "assigned fault type / Fault type assignment for check DFC_ComMETH2Chksum" VALUE 0x80504DCA Val_Wu8 255.0 DFES_OneToOne 0.00 255.0 FORMAT "%5.1" /end CHARACTERISTIC
/begin CHARACTERISTIC DFES_FaultTyp.DFC_ComMETH2RingCnt_C "assigned fault type / Fault type assignment for check DFC_ComMETH2RingCnt" VALUE 0x80504DCB Val_Wu8 255.0 DFES_OneToOne 0.00 255.0 FORMAT "%5.1" /end CHARACTERISTIC
/begin CHARACTERISTIC DFES_FaultTyp.DFC_ComMETH2TOut_C "assigned fault type / Fault type assignment for check DFC_ComMETH2TOut" VALUE 0x80504DCC Val_Wu8 255.0 DFES_OneToOne 0.00 255.0 FORMAT "%5.1" /end CHARACTERISTIC
/begin CHARACTERISTIC DFES_FaultTyp.DFC_ComMETHChksum_C "assigned fault type / Fault type assignment for check DFC_ComMETHChksum" VALUE 0x80504DCD Val_Wu8 255.0 DFES_OneToOne 0.00 255.0 FORMAT "%5.1" /end CHARACTERISTIC
/begin CHARACTERISTIC DFES_FaultTyp.DFC_ComMETHRingCnt_C "assigned fault type / Fault type assignment for check DFC_ComMETHRingCnt" VALUE 0x80504DCE Val_Wu8 255.0 DFES_OneToOne 0.00 255.0 FORMAT "%5.1" /end CHARACTERISTIC
/begin CHARACTERISTIC DFES_FaultTyp.DFC_ComMETHTOut_C "assigned fault type / Fault type assignment for check DFC_ComMETHTOut" VALUE 0x80504DCF Val_Wu8 255.0 DFES_OneToOne 0.00 255.0 FORMAT "%5.1" /end CHARACTERISTIC
/begin CHARACTERISTIC DFES_FaultTyp.DFC_ComMETIChksum_C "assigned fault type / Fault type assignment for check DFC_ComMETIChksum" VALUE 0x80504DD0 Val_Wu8 255.0 DFES_OneToOne 0.00 255.0 FORMAT "%5.1" /end CHARACTERISTIC
/begin CHARACTERISTIC DFES_FaultTyp.DFC_ComMETIRingCnt_C "assigned fault type / Fault type assignment for check DFC_ComMETIRingCnt" VALUE 0x80504DD1 Val_Wu8 255.0 DFES_OneToOne 0.00 255.0 FORMAT "%5.1" /end CHARACTERISTIC
/begin CHARACTERISTIC DFES_FaultTyp.DFC_ComMETITOut_C "assigned fault type / Fault type assignment for check DFC_ComMETITOut" VALUE 0x80504DD2 Val_Wu8 255.0 DFES_OneToOne 0.00 255.0 FORMAT "%5.1" /end CHARACTERISTIC
/begin CHARACTERISTIC DFES_FaultTyp.DFC_ComMETKChksum_C "assigned fault type / Fault type assignment for check DFC_ComMETKChksum" VALUE 0x80504DD3 Val_Wu8 255.0 DFES_OneToOne 0.00 255.0 FORMAT "%5.1" /end CHARACTERISTIC
/begin CHARACTERISTIC DFES_FaultTyp.DFC_ComMETKRingCnt_C "assigned fault type / Fault type assignment for check DFC_ComMETKRingCnt" VALUE 0x80504DD4 Val_Wu8 255.0 DFES_OneToOne 0.00 255.0 FORMAT "%5.1" /end CHARACTERISTIC
/begin CHARACTERISTIC DFES_FaultTyp.DFC_ComMETKTOut_C "assigned fault type / Fault type assignment for check DFC_ComMETKTOut" VALUE 0x80504DD5 Val_Wu8 255.0 DFES_OneToOne 0.00 255.0 FORMAT "%5.1" /end CHARACTERISTIC
/begin CHARACTERISTIC DFES_FaultTyp.DFC_ComMETLChksum_C "assigned fault type / Fault type assignment for check DFC_ComMETLChksum" VALUE 0x80504DD6 Val_Wu8 255.0 DFES_OneToOne 0.00 255.0 FORMAT "%5.1" /end CHARACTERISTIC
/begin CHARACTERISTIC DFES_FaultTyp.DFC_ComMETLRingCnt_C "assigned fault type / Fault type assignment for check DFC_ComMETLRingCnt" VALUE 0x80504DD7 Val_Wu8 255.0 DFES_OneToOne 0.00 255.0 FORMAT "%5.1" /end CHARACTERISTIC
/begin CHARACTERISTIC DFES_FaultTyp.DFC_ComMETLTOut_C "assigned fault type / Fault type assignment for check DFC_ComMETLTOut" VALUE 0x80504DD8 Val_Wu8 255.0 DFES_OneToOne 0.00 255.0 FORMAT "%5.1" /end CHARACTERISTIC
/begin CHARACTERISTIC DFES_FaultTyp.DFC_ComMETMChksum_C "assigned fault type / Fault type assignment for check DFC_ComMETMChksum" VALUE 0x80504DD9 Val_Wu8 255.0 DFES_OneToOne 0.00 255.0 FORMAT "%5.1" /end CHARACTERISTIC
/begin CHARACTERISTIC DFES_FaultTyp.DFC_ComMETMRingCnt_C "assigned fault type / Fault type assignment for check DFC_ComMETMRingCnt" VALUE 0x80504DDA Val_Wu8 255.0 DFES_OneToOne 0.00 255.0 FORMAT "%5.1" /end CHARACTERISTIC
/begin CHARACTERISTIC DFES_FaultTyp.DFC_ComMETMTOut_C "assigned fault type / Fault type assignment for check DFC_ComMETMTOut" VALUE 0x80504DDB Val_Wu8 255.0 DFES_OneToOne 0.00 255.0 FORMAT "%5.1" /end CHARACTERISTIC
/begin CHARACTERISTIC DFES_FaultTyp.DFC_ComMETNChksum_C "assigned fault type / Fault type assignment for check DFC_ComMETNChksum" VALUE 0x80504DDC Val_Wu8 255.0 DFES_OneToOne 0.00 255.0 FORMAT "%5.1" /end CHARACTERISTIC
/begin CHARACTERISTIC DFES_FaultTyp.DFC_ComMETNRingCnt_C "assigned fault type / Fault type assignment for check DFC_ComMETNRingCnt" VALUE 0x80504DDD Val_Wu8 255.0 DFES_OneToOne 0.00 255.0 FORMAT "%5.1" /end CHARACTERISTIC
/begin CHARACTERISTIC DFES_FaultTyp.DFC_ComMETNTOut_C "assigned fault type / Fault type assignment for check DFC_ComMETNTOut" VALUE 0x80504DDE Val_Wu8 255.0 DFES_OneToOne 0.00 255.0 FORMAT "%5.1" /end CHARACTERISTIC
/begin CHARACTERISTIC DFES_FaultTyp.DFC_ComMtrCom_C "assigned fault type / Fault type assignment for check DFC_ComMtrCom" VALUE 0x80504DDF Val_Wu8 255.0 DFES_OneToOne 0.00 255.0 FORMAT "%5.1" /end CHARACTERISTIC
/begin CHARACTERISTIC DFES_FaultTyp.DFC_ComPCUChkSum_C "assigned fault type / Fault type assignment for check DFC_ComPCUChkSum" VALUE 0x80504DE0 Val_Wu8 255.0 DFES_OneToOne 0.00 255.0 FORMAT "%5.1" /end CHARACTERISTIC
/begin CHARACTERISTIC DFES_FaultTyp.DFC_ComPCURingCnt_C "assigned fault type / Fault type assignment for check DFC_ComPCURingCnt" VALUE 0x80504DE1 Val_Wu8 255.0 DFES_OneToOne 0.00 255.0 FORMAT "%5.1" /end CHARACTERISTIC
/begin CHARACTERISTIC DFES_FaultTyp.DFC_ComPCUTOut_C "assigned fault type / Fault type assignment for check DFC_ComPCUTOut" VALUE 0x80504DE2 Val_Wu8 255.0 DFES_OneToOne 0.00 255.0 FORMAT "%5.1" /end CHARACTERISTIC
/begin CHARACTERISTIC DFES_FaultTyp.DFC_ComSRSAChksum_C "assigned fault type / Fault type assignment for check DFC_ComSRSAChksum" VALUE 0x80504DE3 Val_Wu8 255.0 DFES_OneToOne 0.00 255.0 FORMAT "%5.1" /end CHARACTERISTIC
/begin CHARACTERISTIC DFES_FaultTyp.DFC_ComSRSARingCnt_C "assigned fault type / Fault type assignment for check DFC_ComSRSARingCnt" VALUE 0x80504DE4 Val_Wu8 255.0 DFES_OneToOne 0.00 255.0 FORMAT "%5.1" /end CHARACTERISTIC
/begin CHARACTERISTIC DFES_FaultTyp.DFC_ComSRSATOut_C "assigned fault type / Fault type assignment for check DFC_ComSRSATOut" VALUE 0x80504DE5 Val_Wu8 255.0 DFES_OneToOne 0.00 255.0 FORMAT "%5.1" /end CHARACTERISTIC
/begin CHARACTERISTIC DFES_FaultTyp.DFC_ComSRSBChksum_C "assigned fault type / Fault type assignment for check DFC_ComSRSBChksum" VALUE 0x80504DE6 Val_Wu8 255.0 DFES_OneToOne 0.00 255.0 FORMAT "%5.1" /end CHARACTERISTIC
/begin CHARACTERISTIC DFES_FaultTyp.DFC_ComSRSBRingCnt_C "assigned fault type / Fault type assignment for check DFC_ComSRSBRingCnt" VALUE 0x80504DE7 Val_Wu8 255.0 DFES_OneToOne 0.00 255.0 FORMAT "%5.1" /end CHARACTERISTIC
/begin CHARACTERISTIC DFES_FaultTyp.DFC_ComSRSBTOut_C "assigned fault type / Fault type assignment for check DFC_ComSRSBTOut" VALUE 0x80504DE8 Val_Wu8 255.0 DFES_OneToOne 0.00 255.0 FORMAT "%5.1" /end CHARACTERISTIC
/begin CHARACTERISTIC DFES_FaultTyp.DFC_ComSRSChksum_C "assigned fault type / Fault type assignment for check DFC_ComSRSChksum" VALUE 0x80504DE9 Val_Wu8 255.0 DFES_OneToOne 0.00 255.0 FORMAT "%5.1" /end CHARACTERISTIC
/begin CHARACTERISTIC DFES_FaultTyp.DFC_ComSRSErr_C "assigned fault type / Fault type assignment for check DFC_ComSRSErr" VALUE 0x80504DEA Val_Wu8 255.0 DFES_OneToOne 0.00 255.0 FORMAT "%5.1" /end CHARACTERISTIC
/begin CHARACTERISTIC DFES_FaultTyp.DFC_ComSRSRingCnt_C "assigned fault type / Fault type assignment for check DFC_ComSRSRingCnt" VALUE 0x80504DEB Val_Wu8 255.0 DFES_OneToOne 0.00 255.0 FORMAT "%5.1" /end CHARACTERISTIC
/begin CHARACTERISTIC DFES_FaultTyp.DFC_ComSRSTOut_C "assigned fault type / Fault type assignment for check DFC_ComSRSTOut" VALUE 0x80504DEC Val_Wu8 255.0 DFES_OneToOne 0.00 255.0 FORMAT "%5.1" /end CHARACTERISTIC
/begin CHARACTERISTIC DFES_FaultTyp.DFC_ComVehSpdPndFltTCU_C "assigned fault type / Fault type assignment for check DFC_ComVehSpdPndFltTCU" VALUE 0x80504DED Val_Wu8 255.0 DFES_OneToOne 0.00 255.0 FORMAT "%5.1" /end CHARACTERISTIC
/begin CHARACTERISTIC DFES_FaultTyp.DFC_EbsChartcCurrErr_C "assigned fault type / Fault type assignment for check DFC_EbsChartcCurrErr" VALUE 0x80504DEE Val_Wu8 255.0 DFES_OneToOne 0.00 255.0 FORMAT "%5.1" /end CHARACTERISTIC
/begin CHARACTERISTIC DFES_FaultTyp.DFC_EbsSelfDiagErr_C "assigned fault type / Fault type assignment for check DFC_EbsSelfDiagErr" VALUE 0x80504DEF Val_Wu8 255.0 DFES_OneToOne 0.00 255.0 FORMAT "%5.1" /end CHARACTERISTIC
/begin CHARACTERISTIC DFES_FaultTyp.DFC_GEVlvPhaCsersIntkB1_C "assigned fault type / Fault type assignment for check DFC_GEVlvPhaCsersIntkB1" VALUE 0x80504DF0 Val_Wu8 255.0 DFES_OneToOne 0.00 255.0 FORMAT "%5.1" /end CHARACTERISTIC
/begin CHARACTERISTIC DFES_FaultTyp.DFC_GEVlvPhaPsOpenLoadIntkB1_C "assigned fault type / Fault type assignment for check DFC_GEVlvPhaPsOpenLoadIntkB1" VALUE 0x80504DF1 Val_Wu8 255.0 DFES_OneToOne 0.00 255.0 FORMAT "%5.1" /end CHARACTERISTIC
/begin CHARACTERISTIC DFES_FaultTyp.DFC_GEVlvPhaPsShoToBattIntkB1_C "assigned fault type / Fault type assignment for check DFC_GEVlvPhaPsShoToBattIntkB1" VALUE 0x80504DF2 Val_Wu8 255.0 DFES_OneToOne 0.00 255.0 FORMAT "%5.1" /end CHARACTERISTIC
/begin CHARACTERISTIC DFES_FaultTyp.DFC_GEVlvPhaPsShoToGndIntkB1_C "assigned fault type / Fault type assignment for check DFC_GEVlvPhaPsShoToGndIntkB1" VALUE 0x80504DF3 Val_Wu8 255.0 DFES_OneToOne 0.00 255.0 FORMAT "%5.1" /end CHARACTERISTIC
/begin CHARACTERISTIC DFES_FaultTyp.DFC_GbxCANDigPlausErr_C "assigned fault type / Fault type assignment for check DFC_GbxCANDigPlausErr" VALUE 0x80504DF4 Val_Wu8 255.0 DFES_OneToOne 0.00 255.0 FORMAT "%5.1" /end CHARACTERISTIC
/begin CHARACTERISTIC DFES_FaultTyp.DFC_GbxNPos1SRCMax_C "assigned fault type / Fault type assignment for check DFC_GbxNPos1SRCMax" VALUE 0x80504DF5 Val_Wu8 255.0 DFES_OneToOne 0.00 255.0 FORMAT "%5.1" /end CHARACTERISTIC
/begin CHARACTERISTIC DFES_FaultTyp.DFC_GbxNPos1SRCMin_C "assigned fault type / Fault type assignment for check DFC_GbxNPos1SRCMin" VALUE 0x80504DF6 Val_Wu8 255.0 DFES_OneToOne 0.00 255.0 FORMAT "%5.1" /end CHARACTERISTIC
/begin CHARACTERISTIC DFES_FaultTyp.DFC_GbxNPos2SRCMax_C "assigned fault type / Fault type assignment for check DFC_GbxNPos2SRCMax" VALUE 0x80504DF7 Val_Wu8 255.0 DFES_OneToOne 0.00 255.0 FORMAT "%5.1" /end CHARACTERISTIC
/begin CHARACTERISTIC DFES_FaultTyp.DFC_GbxNPos2SRCMin_C "assigned fault type / Fault type assignment for check DFC_GbxNPos2SRCMin" VALUE 0x80504DF8 Val_Wu8 255.0 DFES_OneToOne 0.00 255.0 FORMAT "%5.1" /end CHARACTERISTIC
/begin CHARACTERISTIC DFES_FaultTyp.DFC_GbxNPosAlvChk_C "assigned fault type / Fault type assignment for check DFC_GbxNPosAlvChk" VALUE 0x80504DF9 Val_Wu8 255.0 DFES_OneToOne 0.00 255.0 FORMAT "%5.1" /end CHARACTERISTIC
/begin CHARACTERISTIC DFES_FaultTyp.DFC_GbxNPosSyncErr_C "assigned fault type / Fault type assignment for check DFC_GbxNPosSyncErr" VALUE 0x80504DFA Val_Wu8 255.0 DFES_OneToOne 0.00 255.0 FORMAT "%5.1" /end CHARACTERISTIC
/begin CHARACTERISTIC DFES_FaultTyp.DFC_HEGOS2B1HtrPsMax_C "assigned fault type / Fault type assignment for check DFC_HEGOS2B1HtrPsMax" VALUE 0x80504DFB Val_Wu8 255.0 DFES_OneToOne 0.00 255.0 FORMAT "%5.1" /end CHARACTERISTIC
/begin CHARACTERISTIC DFES_FaultTyp.DFC_HEGOS2B1HtrPsMin_C "assigned fault type / Fault type assignment for check DFC_HEGOS2B1HtrPsMin" VALUE 0x80504DFC Val_Wu8 255.0 DFES_OneToOne 0.00 255.0 FORMAT "%5.1" /end CHARACTERISTIC
/begin CHARACTERISTIC DFES_FaultTyp.DFC_HEGOS2B1HtrPsSig_C "assigned fault type / Fault type assignment for check DFC_HEGOS2B1HtrPsSig" VALUE 0x80504DFD Val_Wu8 255.0 DFES_OneToOne 0.00 255.0 FORMAT "%5.1" /end CHARACTERISTIC
/begin CHARACTERISTIC DFES_FaultTyp.DFC_LinCSErrACG_C "assigned fault type / Fault type assignment for check DFC_LinCSErrACG" VALUE 0x80504DFE Val_Wu8 255.0 DFES_OneToOne 0.00 255.0 FORMAT "%5.1" /end CHARACTERISTIC
/begin CHARACTERISTIC DFES_FaultTyp.DFC_LinCSErrAEV_C "assigned fault type / Fault type assignment for check DFC_LinCSErrAEV" VALUE 0x80504DFF Val_Wu8 255.0 DFES_OneToOne 0.00 255.0 FORMAT "%5.1" /end CHARACTERISTIC
/begin CHARACTERISTIC DFES_FaultTyp.DFC_LinCSErrDCDC_C "assigned fault type / Fault type assignment for check DFC_LinCSErrDCDC" VALUE 0x80504E00 Val_Wu8 255.0 DFES_OneToOne 0.00 255.0 FORMAT "%5.1" /end CHARACTERISTIC
/begin CHARACTERISTIC DFES_FaultTyp.DFC_LinCSErrEBS_C "assigned fault type / Fault type assignment for check DFC_LinCSErrEBS" VALUE 0x80504E01 Val_Wu8 255.0 DFES_OneToOne 0.00 255.0 FORMAT "%5.1" /end CHARACTERISTIC
/begin CHARACTERISTIC DFES_FaultTyp.DFC_LinHdrTimeoutErrACG_C "assigned fault type / Fault type assignment for check DFC_LinHdrTimeoutErrACG" VALUE 0x80504E02 Val_Wu8 255.0 DFES_OneToOne 0.00 255.0 FORMAT "%5.1" /end CHARACTERISTIC
/begin CHARACTERISTIC DFES_FaultTyp.DFC_LinHdrTimeoutErrAEV_C "assigned fault type / Fault type assignment for check DFC_LinHdrTimeoutErrAEV" VALUE 0x80504E03 Val_Wu8 255.0 DFES_OneToOne 0.00 255.0 FORMAT "%5.1" /end CHARACTERISTIC
/begin CHARACTERISTIC DFES_FaultTyp.DFC_LinHdrTimeoutErrDCDC_C "assigned fault type / Fault type assignment for check DFC_LinHdrTimeoutErrDCDC" VALUE 0x80504E04 Val_Wu8 255.0 DFES_OneToOne 0.00 255.0 FORMAT "%5.1" /end CHARACTERISTIC
/begin CHARACTERISTIC DFES_FaultTyp.DFC_LinHdrTimeoutErrEBS_C "assigned fault type / Fault type assignment for check DFC_LinHdrTimeoutErrEBS" VALUE 0x80504E05 Val_Wu8 255.0 DFES_OneToOne 0.00 255.0 FORMAT "%5.1" /end CHARACTERISTIC
/begin CHARACTERISTIC DFES_FaultTyp.DFC_LinMsgTimeoutErrACG_C "assigned fault type / Fault type assignment for check DFC_LinMsgTimeoutErrACG" VALUE 0x80504E06 Val_Wu8 255.0 DFES_OneToOne 0.00 255.0 FORMAT "%5.1" /end CHARACTERISTIC
/begin CHARACTERISTIC DFES_FaultTyp.DFC_LinMsgTimeoutErrAEV_C "assigned fault type / Fault type assignment for check DFC_LinMsgTimeoutErrAEV" VALUE 0x80504E07 Val_Wu8 255.0 DFES_OneToOne 0.00 255.0 FORMAT "%5.1" /end CHARACTERISTIC
/begin CHARACTERISTIC DFES_FaultTyp.DFC_LinMsgTimeoutErrDCDC_C "assigned fault type / Fault type assignment for check DFC_LinMsgTimeoutErrDCDC" VALUE 0x80504E08 Val_Wu8 255.0 DFES_OneToOne 0.00 255.0 FORMAT "%5.1" /end CHARACTERISTIC
/begin CHARACTERISTIC DFES_FaultTyp.DFC_LinMsgTimeoutErrEBS_C "assigned fault type / Fault type assignment for check DFC_LinMsgTimeoutErrEBS" VALUE 0x80504E09 Val_Wu8 255.0 DFES_OneToOne 0.00 255.0 FORMAT "%5.1" /end CHARACTERISTIC
/begin CHARACTERISTIC DFES_FaultTyp.DFC_LinNoStrtComErr_C "assigned fault type / Fault type assignment for check DFC_LinNoStrtComErr" VALUE 0x80504E0A Val_Wu8 255.0 DFES_OneToOne 0.00 255.0 FORMAT "%5.1" /end CHARACTERISTIC
/begin CHARACTERISTIC DFES_FaultTyp.DFC_LowPresOilP_C "assigned fault type / Fault type assignment for check DFC_LowPresOilP" VALUE 0x80504E0B Val_Wu8 255.0 DFES_OneToOne 0.00 255.0 FORMAT "%5.1" /end CHARACTERISTIC
/begin CHARACTERISTIC DFES_FaultTyp.DFC_MisfDetVWhlFrntLeOORHi_C "assigned fault type / Fault type assignment for check DFC_MisfDetVWhlFrntLeOORHi" VALUE 0x80504E0C Val_Wu8 255.0 DFES_OneToOne 0.00 255.0 FORMAT "%5.1" /end CHARACTERISTIC
/begin CHARACTERISTIC DFES_FaultTyp.DFC_MisfDetVWhlFrntLeRatyHi_C "assigned fault type / Fault type assignment for check DFC_MisfDetVWhlFrntLeRatyHi" VALUE 0x80504E0D Val_Wu8 255.0 DFES_OneToOne 0.00 255.0 FORMAT "%5.1" /end CHARACTERISTIC
/begin CHARACTERISTIC DFES_FaultTyp.DFC_MisfDetVWhlFrntLeRatyLo_C "assigned fault type / Fault type assignment for check DFC_MisfDetVWhlFrntLeRatyLo" VALUE 0x80504E0E Val_Wu8 255.0 DFES_OneToOne 0.00 255.0 FORMAT "%5.1" /end CHARACTERISTIC
/begin CHARACTERISTIC DFES_FaultTyp.DFC_MisfDetVWhlFrntLeStuck_C "assigned fault type / Fault type assignment for check DFC_MisfDetVWhlFrntLeStuck" VALUE 0x80504E0F Val_Wu8 255.0 DFES_OneToOne 0.00 255.0 FORMAT "%5.1" /end CHARACTERISTIC
/begin CHARACTERISTIC DFES_FaultTyp.DFC_MisfDetVWhlFrntRiOORHi_C "assigned fault type / Fault type assignment for check DFC_MisfDetVWhlFrntRiOORHi" VALUE 0x80504E10 Val_Wu8 255.0 DFES_OneToOne 0.00 255.0 FORMAT "%5.1" /end CHARACTERISTIC
/begin CHARACTERISTIC DFES_FaultTyp.DFC_MisfDetVWhlFrntRiRatyHi_C "assigned fault type / Fault type assignment for check DFC_MisfDetVWhlFrntRiRatyHi" VALUE 0x80504E11 Val_Wu8 255.0 DFES_OneToOne 0.00 255.0 FORMAT "%5.1" /end CHARACTERISTIC
/begin CHARACTERISTIC DFES_FaultTyp.DFC_MisfDetVWhlFrntRiRatyLo_C "assigned fault type / Fault type assignment for check DFC_MisfDetVWhlFrntRiRatyLo" VALUE 0x80504E12 Val_Wu8 255.0 DFES_OneToOne 0.00 255.0 FORMAT "%5.1" /end CHARACTERISTIC
/begin CHARACTERISTIC DFES_FaultTyp.DFC_MisfDetVWhlFrntRiStuck_C "assigned fault type / Fault type assignment for check DFC_MisfDetVWhlFrntRiStuck" VALUE 0x80504E13 Val_Wu8 255.0 DFES_OneToOne 0.00 255.0 FORMAT "%5.1" /end CHARACTERISTIC
/begin CHARACTERISTIC DFES_FaultTyp.DFC_MisfDetVWhlReLeOORHi_C "assigned fault type / Fault type assignment for check DFC_MisfDetVWhlReLeOORHi" VALUE 0x80504E14 Val_Wu8 255.0 DFES_OneToOne 0.00 255.0 FORMAT "%5.1" /end CHARACTERISTIC
/begin CHARACTERISTIC DFES_FaultTyp.DFC_MisfDetVWhlReLeRatyHi_C "assigned fault type / Fault type assignment for check DFC_MisfDetVWhlReLeRatyHi" VALUE 0x80504E15 Val_Wu8 255.0 DFES_OneToOne 0.00 255.0 FORMAT "%5.1" /end CHARACTERISTIC
/begin CHARACTERISTIC DFES_FaultTyp.DFC_MisfDetVWhlReLeRatyLo_C "assigned fault type / Fault type assignment for check DFC_MisfDetVWhlReLeRatyLo" VALUE 0x80504E16 Val_Wu8 255.0 DFES_OneToOne 0.00 255.0 FORMAT "%5.1" /end CHARACTERISTIC
/begin CHARACTERISTIC DFES_FaultTyp.DFC_MisfDetVWhlReLeStuck_C "assigned fault type / Fault type assignment for check DFC_MisfDetVWhlReLeStuck" VALUE 0x80504E17 Val_Wu8 255.0 DFES_OneToOne 0.00 255.0 FORMAT "%5.1" /end CHARACTERISTIC
/begin CHARACTERISTIC DFES_FaultTyp.DFC_MisfDetVWhlReRiOORHi_C "assigned fault type / Fault type assignment for check DFC_MisfDetVWhlReRiOORHi" VALUE 0x80504E18 Val_Wu8 255.0 DFES_OneToOne 0.00 255.0 FORMAT "%5.1" /end CHARACTERISTIC
/begin CHARACTERISTIC DFES_FaultTyp.DFC_MisfDetVWhlReRiRatyHi_C "assigned fault type / Fault type assignment for check DFC_MisfDetVWhlReRiRatyHi" VALUE 0x80504E19 Val_Wu8 255.0 DFES_OneToOne 0.00 255.0 FORMAT "%5.1" /end CHARACTERISTIC
/begin CHARACTERISTIC DFES_FaultTyp.DFC_MisfDetVWhlReRiRatyLo_C "assigned fault type / Fault type assignment for check DFC_MisfDetVWhlReRiRatyLo" VALUE 0x80504E1A Val_Wu8 255.0 DFES_OneToOne 0.00 255.0 FORMAT "%5.1" /end CHARACTERISTIC
/begin CHARACTERISTIC DFES_FaultTyp.DFC_MisfDetVWhlReRiStuck_C "assigned fault type / Fault type assignment for check DFC_MisfDetVWhlReRiStuck" VALUE 0x80504E1B Val_Wu8 255.0 DFES_OneToOne 0.00 255.0 FORMAT "%5.1" /end CHARACTERISTIC
/begin CHARACTERISTIC DFES_FaultTyp.DFC_MisfDetdVWhlFrntLePlaus_C "assigned fault type / Fault type assignment for check DFC_MisfDetdVWhlFrntLePlaus" VALUE 0x80504E1C Val_Wu8 255.0 DFES_OneToOne 0.00 255.0 FORMAT "%5.1" /end CHARACTERISTIC
/begin CHARACTERISTIC DFES_FaultTyp.DFC_MisfDetdVWhlFrntRiPlaus_C "assigned fault type / Fault type assignment for check DFC_MisfDetdVWhlFrntRiPlaus" VALUE 0x80504E1D Val_Wu8 255.0 DFES_OneToOne 0.00 255.0 FORMAT "%5.1" /end CHARACTERISTIC
/begin CHARACTERISTIC DFES_FaultTyp.DFC_MisfDetdVWhlReLePlaus_C "assigned fault type / Fault type assignment for check DFC_MisfDetdVWhlReLePlaus" VALUE 0x80504E1E Val_Wu8 255.0 DFES_OneToOne 0.00 255.0 FORMAT "%5.1" /end CHARACTERISTIC
/begin CHARACTERISTIC DFES_FaultTyp.DFC_MisfDetdVWhlReRiPlaus_C "assigned fault type / Fault type assignment for check DFC_MisfDetdVWhlReRiPlaus" VALUE 0x80504E1F Val_Wu8 255.0 DFES_OneToOne 0.00 255.0 FORMAT "%5.1" /end CHARACTERISTIC
/begin CHARACTERISTIC DFES_FaultTyp.DFC_PEnvSigRngMax_C "assigned fault type / Fault type assignment for check DFC_PEnvSigRngMax" VALUE 0x80504E20 Val_Wu8 255.0 DFES_OneToOne 0.00 255.0 FORMAT "%5.1" /end CHARACTERISTIC
/begin CHARACTERISTIC DFES_FaultTyp.DFC_PEnvSigRngMin_C "assigned fault type / Fault type assignment for check DFC_PEnvSigRngMin" VALUE 0x80504E21 Val_Wu8 255.0 DFES_OneToOne 0.00 255.0 FORMAT "%5.1" /end CHARACTERISTIC
/begin CHARACTERISTIC DFES_FaultTyp.DFC_StmFault_C "assigned fault type / Fault type assignment for check DFC_StmFault" VALUE 0x80504E22 Val_Wu8 255.0 DFES_OneToOne 0.00 255.0 FORMAT "%5.1" /end CHARACTERISTIC
/begin CHARACTERISTIC DFES_FaultTyp.DFC_StrtCtOffPth_C "assigned fault type / Fault type assignment for check DFC_StrtCtOffPth" VALUE 0x80504E23 Val_Wu8 255.0 DFES_OneToOne 0.00 255.0 FORMAT "%5.1" /end CHARACTERISTIC
/begin CHARACTERISTIC DFES_FaultTyp.DFC_StrtCtlErr_C "assigned fault type / Fault type assignment for check DFC_StrtCtlErr" VALUE 0x80504E24 Val_Wu8 255.0 DFES_OneToOne 0.00 255.0 FORMAT "%5.1" /end CHARACTERISTIC
/begin CHARACTERISTIC DFES_FaultTyp.DFC_StrtFault_C "assigned fault type / Fault type assignment for check DFC_StrtFault" VALUE 0x80504E25 Val_Wu8 255.0 DFES_OneToOne 0.00 255.0 FORMAT "%5.1" /end CHARACTERISTIC
/begin CHARACTERISTIC DFES_FaultTyp.DFC_StrtLckJudg1_C "assigned fault type / Fault type assignment for check DFC_StrtLckJudg1" VALUE 0x80504E26 Val_Wu8 255.0 DFES_OneToOne 0.00 255.0 FORMAT "%5.1" /end CHARACTERISTIC
/begin CHARACTERISTIC DFES_FaultTyp.DFC_StrtLckJudg2_C "assigned fault type / Fault type assignment for check DFC_StrtLckJudg2" VALUE 0x80504E27 Val_Wu8 255.0 DFES_OneToOne 0.00 255.0 FORMAT "%5.1" /end CHARACTERISTIC
/begin CHARACTERISTIC DFES_FaultTyp.DFC_StrtOL_C "assigned fault type / Fault type assignment for check DFC_StrtOL" VALUE 0x80504E28 Val_Wu8 255.0 DFES_OneToOne 0.00 255.0 FORMAT "%5.1" /end CHARACTERISTIC
/begin CHARACTERISTIC DFES_FaultTyp.DFC_StrtOL2_C "assigned fault type / Fault type assignment for check DFC_StrtOL2" VALUE 0x80504E29 Val_Wu8 255.0 DFES_OneToOne 0.00 255.0 FORMAT "%5.1" /end CHARACTERISTIC
/begin CHARACTERISTIC DFES_FaultTyp.DFC_StrtSCB_C "assigned fault type / Fault type assignment for check DFC_StrtSCB" VALUE 0x80504E2A Val_Wu8 255.0 DFES_OneToOne 0.00 255.0 FORMAT "%5.1" /end CHARACTERISTIC
/begin CHARACTERISTIC DFES_FaultTyp.DFC_StrtSCB2_C "assigned fault type / Fault type assignment for check DFC_StrtSCB2" VALUE 0x80504E2B Val_Wu8 255.0 DFES_OneToOne 0.00 255.0 FORMAT "%5.1" /end CHARACTERISTIC
/begin CHARACTERISTIC DFES_FaultTyp.DFC_StrtSCG_C "assigned fault type / Fault type assignment for check DFC_StrtSCG" VALUE 0x80504E2C Val_Wu8 255.0 DFES_OneToOne 0.00 255.0 FORMAT "%5.1" /end CHARACTERISTIC
/begin CHARACTERISTIC DFES_FaultTyp.DFC_StrtSCG2_C "assigned fault type / Fault type assignment for check DFC_StrtSCG2" VALUE 0x80504E2D Val_Wu8 255.0 DFES_OneToOne 0.00 255.0 FORMAT "%5.1" /end CHARACTERISTIC
/begin CHARACTERISTIC DFES_FaultTyp.DFC_StrtStkRly1_C "assigned fault type / Fault type assignment for check DFC_StrtStkRly1" VALUE 0x80504E2E Val_Wu8 255.0 DFES_OneToOne 0.00 255.0 FORMAT "%5.1" /end CHARACTERISTIC
/begin CHARACTERISTIC DFES_FaultTyp.DFC_StrtStkRly2_C "assigned fault type / Fault type assignment for check DFC_StrtStkRly2" VALUE 0x80504E2F Val_Wu8 255.0 DFES_OneToOne 0.00 255.0 FORMAT "%5.1" /end CHARACTERISTIC
/begin CHARACTERISTIC DFES_FaultTyp.DFC_TEVEmax_C "assigned fault type / Fault type assignment for check DFC_TEVEmax" VALUE 0x80504E30 Val_Wu8 255.0 DFES_OneToOne 0.00 255.0 FORMAT "%5.1" /end CHARACTERISTIC
/begin CHARACTERISTIC DFES_FaultTyp.DFC_TEVEmin_C "assigned fault type / Fault type assignment for check DFC_TEVEmin" VALUE 0x80504E31 Val_Wu8 255.0 DFES_OneToOne 0.00 255.0 FORMAT "%5.1" /end CHARACTERISTIC
/begin CHARACTERISTIC DFES_FaultTyp.DFC_TEVEsig_C "assigned fault type / Fault type assignment for check DFC_TEVEsig" VALUE 0x80504E32 Val_Wu8 255.0 DFES_OneToOne 0.00 255.0 FORMAT "%5.1" /end CHARACTERISTIC
/begin CHARACTERISTIC DFES_FaultTyp.DFC_UegoHeatrPrfmncLoS1B1_C "assigned fault type / Fault type assignment for check DFC_UegoHeatrPrfmncLoS1B1" VALUE 0x80504E33 Val_Wu8 255.0 DFES_OneToOne 0.00 255.0 FORMAT "%5.1" /end CHARACTERISTIC
/begin CHARACTERISTIC DFES_FaultTyp.DFC_VehVAllPlaus_C "assigned fault type / Fault type assignment for check DFC_VehVAllPlaus" VALUE 0x80504E34 Val_Wu8 255.0 DFES_OneToOne 0.00 255.0 FORMAT "%5.1" /end CHARACTERISTIC
/begin CHARACTERISTIC DFES_FaultTyp.DFC_VehVNCSnsrElecFailr_C "assigned fault type / Fault type assignment for check DFC_VehVNCSnsrElecFailr" VALUE 0x80504E35 Val_Wu8 255.0 DFES_OneToOne 0.00 255.0 FORMAT "%5.1" /end CHARACTERISTIC
/begin CHARACTERISTIC DFES_FaultTyp.DFC_VehVPlausCan_C "assigned fault type / Fault type assignment for check DFC_VehVPlausCan" VALUE 0x80504E36 Val_Wu8 255.0 DFES_OneToOne 0.00 255.0 FORMAT "%5.1" /end CHARACTERISTIC
/begin CHARACTERISTIC DFES_FaultTyp.DFC_VehVPlausFco_C "assigned fault type / Fault type assignment for check DFC_VehVPlausFco" VALUE 0x80504E37 Val_Wu8 255.0 DFES_OneToOne 0.00 255.0 FORMAT "%5.1" /end CHARACTERISTIC
/begin CHARACTERISTIC DFES_FaultTyp.DFC_VehVPlausPwr_C "assigned fault type / Fault type assignment for check DFC_VehVPlausPwr" VALUE 0x80504E38 Val_Wu8 255.0 DFES_OneToOne 0.00 255.0 FORMAT "%5.1" /end CHARACTERISTIC
/begin CHARACTERISTIC DFES_FaultTyp.DFC_VehVPlausV2N_C "assigned fault type / Fault type assignment for check DFC_VehVPlausV2N" VALUE 0x80504E39 Val_Wu8 255.0 DFES_OneToOne 0.00 255.0 FORMAT "%5.1" /end CHARACTERISTIC
/begin CHARACTERISTIC DFES_FaultTyp.DFC_VehVSpdSnsrAElecFailr_C "assigned fault type / Fault type assignment for check DFC_VehVSpdSnsrAElecFailr" VALUE 0x80504E3A Val_Wu8 255.0 DFES_OneToOne 0.00 255.0 FORMAT "%5.1" /end CHARACTERISTIC
/begin CHARACTERISTIC DFES_FaultTyp.DFC_VehVSpdSnsrBElecFailr_C "assigned fault type / Fault type assignment for check DFC_VehVSpdSnsrBElecFailr" VALUE 0x80504E3B Val_Wu8 255.0 DFES_OneToOne 0.00 255.0 FORMAT "%5.1" /end CHARACTERISTIC
/begin CHARACTERISTIC DFES_FaultTyp.DFC_ClthMax_C "assigned fault type / Fault type assignment for check DFC_ClthMax" VALUE 0x80504E3C Val_Wu8 255.0 DFES_OneToOne 0.00 255.0 FORMAT "%5.1" /end CHARACTERISTIC
/begin CHARACTERISTIC DFES_FaultTyp.DFC_IgnClPs_DevComErr_C "assigned fault type / Fault type assignment for check DFC_IgnClPs_DevComErr" VALUE 0x80504E3D Val_Wu8 255.0 DFES_OneToOne 0.00 255.0 FORMAT "%5.1" /end CHARACTERISTIC
/begin CHARACTERISTIC DFES_FaultTyp.DFC_IgnClPs_LineOl_0_C "assigned fault type / Fault type assignment for check DFC_IgnClPs_LineOl_0" VALUE 0x80504E3E Val_Wu8 255.0 DFES_OneToOne 0.00 255.0 FORMAT "%5.1" /end CHARACTERISTIC
/begin CHARACTERISTIC DFES_FaultTyp.DFC_IgnClPs_LineOl_1_C "assigned fault type / Fault type assignment for check DFC_IgnClPs_LineOl_1" VALUE 0x80504E3F Val_Wu8 255.0 DFES_OneToOne 0.00 255.0 FORMAT "%5.1" /end CHARACTERISTIC
/begin CHARACTERISTIC DFES_FaultTyp.DFC_IgnClPs_LineOl_2_C "assigned fault type / Fault type assignment for check DFC_IgnClPs_LineOl_2" VALUE 0x80504E40 Val_Wu8 255.0 DFES_OneToOne 0.00 255.0 FORMAT "%5.1" /end CHARACTERISTIC
/begin CHARACTERISTIC DFES_FaultTyp.DFC_IgnClPs_LineOl_3_C "assigned fault type / Fault type assignment for check DFC_IgnClPs_LineOl_3" VALUE 0x80504E41 Val_Wu8 255.0 DFES_OneToOne 0.00 255.0 FORMAT "%5.1" /end CHARACTERISTIC
/begin CHARACTERISTIC DFES_FaultTyp.DFC_IgnClPs_LineScb_0_C "assigned fault type / Fault type assignment for check DFC_IgnClPs_LineScb_0" VALUE 0x80504E42 Val_Wu8 255.0 DFES_OneToOne 0.00 255.0 FORMAT "%5.1" /end CHARACTERISTIC
/begin CHARACTERISTIC DFES_FaultTyp.DFC_IgnClPs_LineScb_1_C "assigned fault type / Fault type assignment for check DFC_IgnClPs_LineScb_1" VALUE 0x80504E43 Val_Wu8 255.0 DFES_OneToOne 0.00 255.0 FORMAT "%5.1" /end CHARACTERISTIC
/begin CHARACTERISTIC DFES_FaultTyp.DFC_IgnClPs_LineScb_2_C "assigned fault type / Fault type assignment for check DFC_IgnClPs_LineScb_2" VALUE 0x80504E44 Val_Wu8 255.0 DFES_OneToOne 0.00 255.0 FORMAT "%5.1" /end CHARACTERISTIC
/begin CHARACTERISTIC DFES_FaultTyp.DFC_IgnClPs_LineScb_3_C "assigned fault type / Fault type assignment for check DFC_IgnClPs_LineScb_3" VALUE 0x80504E45 Val_Wu8 255.0 DFES_OneToOne 0.00 255.0 FORMAT "%5.1" /end CHARACTERISTIC
/begin CHARACTERISTIC DFES_FaultTyp.DFC_IgnClPs_LineScg_0_C "assigned fault type / Fault type assignment for check DFC_IgnClPs_LineScg_0" VALUE 0x80504E46 Val_Wu8 255.0 DFES_OneToOne 0.00 255.0 FORMAT "%5.1" /end CHARACTERISTIC
/begin CHARACTERISTIC DFES_FaultTyp.DFC_IgnClPs_LineScg_1_C "assigned fault type / Fault type assignment for check DFC_IgnClPs_LineScg_1" VALUE 0x80504E47 Val_Wu8 255.0 DFES_OneToOne 0.00 255.0 FORMAT "%5.1" /end CHARACTERISTIC
/begin FUNCTION DFES "30000.73.0_2.0.0Diagnostic Fault Event Storage"
 /begin DEF_CHARACTERISTIC DFES_EnvRef.DFC_RBA_IODIAGPWR_rba_IoExtCy329_SignalVltSply_1SCG_C DFES_EnvRef.DFC_RBA_IODIAGPWR_rba_IoExtCy329_SignalVltSply_1UV_C DFES_EnvRef.DFC_RBA_IODIAGPWR_rba_IoExtCy329_SignalVltSply_2_C DFES_EnvRef.DFC_RBA_IODIAGPWR_rba_IoExtCy329_SignalVltSply_2OT_C DFES_EnvRef.DFC_RBA_IODIAGPWR_rba_IoExtCy329_SignalVltSply_2OV_C DFES_EnvRef.DFC_RBA_IODIAGPWR_rba_IoExtCy329_SignalVltSply_2SCG_C DFES_EnvRef.DFC_RBA_IODIAGPWR_rba_IoExtCy329_SignalVltSply_2UV_C DFES_EnvRef.DFC_CAN_E_TIMEOUT_C DFES_EnvRef.DFC_LIN_E_TIMEOUT_C DFES_EnvRef.DFC_MRlyOL_C DFES_EnvRef.DFC_MRlySCB_C DFES_EnvRef.DFC_MRlySCG_C DFES_EnvRef.DFC_rba_MultiStackTrace_Threshold_C DFES_EnvRef.DFC_BSWM_E_ACTION_FAILED_C DFES_EnvRef.DFC_BSWM_E_INTRPTQUEUE_FULL_C DFES_EnvRef.DFC_RBA_IOEXTLIB_KEEPALIVE_DRV_C DFES_EnvRef.DFC_RBA_IOEXTLIB_KEEPALIVE_INI_C DFES_EnvRef.DFC_rba_IoSigRtc_StopCounter_C DFES_EnvRef.DFC_rba_MRly_Diag_Stk_Event_C DFES_EnvRef.DFC_rba_MemDiag_MemReadErr_C DFES_EnvRef.DFC_rba_MemDiag_MemWrErr_C DFES_EnvRef.DFC_rba_SyC_IrrSwOffTrigEngRun_Event_C DFES_EnvRef.DFC_rba_T15_Diag_ComInVld_Event_C DFES_EnvRef.DFC_rba_T15_Diag_ComOff_HwOn_Event_C DFES_EnvRef.DFC_rba_T15_Diag_ComOn_HwOff_Event_C DFES_EnvRef.DFC_AAVmin_C DFES_EnvRef.DFC_AGRSUS_C DFES_EnvRef.DFC_AfsPlausDiagHi_C DFES_EnvRef.DFC_AfsPlausDiagLo_C DFES_EnvRef.DFC_AfsVrntDiagErrB1_C DFES_EnvRef.DFC_AppAllSnsrDfct_C DFES_EnvRef.DFC_BBKRnldg_C DFES_EnvRef.DFC_BBKRsyne_C DFES_EnvRef.DFC_BattUStdbyDiaOL_C DFES_EnvRef.DFC_BigLeakIntkMnfldEmiInfl_C DFES_EnvRef.DFC_BlkdLineTank_C DFES_EnvRef.DFC_BrkMnSwtContOnWarnLmp_C DFES_EnvRef.DFC_BrkMnSwtNotStpWarnLmp_C DFES_EnvRef.DFC_BrkRdntSwtContOnWarnLmp_C DFES_EnvRef.DFC_BrkRdntSwtNotStpWarnLmp_C DFES_EnvRef.DFC_CEngDsTColdStrtMax_C DFES_EnvRef.DFC_CEngDsTColdStrtMin_C DFES_EnvRef.DFC_CEngDsTImps_C DFES_EnvRef.DFC_CEngDsTPlausHSC_C DFES_EnvRef.DFC_CEngDsTPlausLSC_C DFES_EnvRef.DFC_CEngDsTPlausSTC_C DFES_EnvRef.DFC_CEngDsTSRCMax_C DFES_EnvRef.DFC_CEngDsTSRCMin_C DFES_EnvRef.DFC_CEngDsTSig_C DFES_EnvRef.DFC_CEngUsTColdStrtMax_C DFES_EnvRef.DFC_CEngUsTColdStrtMin_C DFES_EnvRef.DFC_CEngUsTLooseCnctn_C DFES_EnvRef.DFC_CEngUsTSRCMax_C DFES_EnvRef.DFC_CEngUsTSRCMin_C DFES_EnvRef.DFC_ComDCDCACCFailr_C DFES_EnvRef.DFC_DCDCFltDet_C DFES_EnvRef.DFC_DKRSA_C DFES_EnvRef.DFC_DKVSmax_C DFES_EnvRef.DFC_DKnpl_C DFES_EnvRef.DFC_DSKVRmax_C DFES_EnvRef.DFC_DSKVRmin_C DFES_EnvRef.DFC_DSKVRnpl_C DFES_EnvRef.DFC_DSKVRsig_C DFES_EnvRef.DFC_DSKVSsig_C DFES_EnvRef.DFC_DSSmax_C DFES_EnvRef.DFC_DSTDmax_C DFES_EnvRef.DFC_DSTEmax_C DFES_EnvRef.DFC_DSTEmin_C DFES_EnvRef.DFC_DSTOFmax_C DFES_EnvRef.DFC_DSTRmax_C DFES_EnvRef.DFC_DSTRmin_C DFES_EnvRef.DFC_DSTRnpl_C DFES_EnvRef.DFC_DSTRsig_C DFES_EnvRef.DFC_DSTTI_C DFES_EnvRef.DFC_DSUmax_C DFES_EnvRef.DFC_DiagCpv1DteskLoLoadStuckClsd_C DFES_EnvRef.DFC_DiagCpv1DteskLoLoadStuckOpen_C DFES_EnvRef.DFC_EGRVlvDrftClsd_C DFES_EnvRef.DFC_EGRVlvDrftOpn_C DFES_EnvRef.DFC_EGRVlvJamVlvClsd_C DFES_EnvRef.DFC_EGRVlvJamVlvOpn_C DFES_EnvRef.DFC_EGRVlvSprgBrk_C DFES_EnvRef.DFC_EGRVlvTempMdlEEPErr_C DFES_EnvRef.DFC_EGRVlvTmpErr_C DFES_EnvRef.DFC_EGSDUS2B1LtrDly_C DFES_EnvRef.DFC_EGSDUS2B1LtrPT1_C DFES_EnvRef.DFC_EGSDUS2B1RtlDly_C DFES_EnvRef.DFC_EGSDUS2B1RtlPT1_C DFES_EnvRef.DFC_EGSDUS2B1TarLean_C DFES_EnvRef.DFC_EGSDUS2B1TarRich_C DFES_EnvRef.DFC_EONVmax_C DFES_EnvRef.DFC_ETAKHLmax_C DFES_EnvRef.DFC_ETAKHTmax_C DFES_EnvRef.DFC_ETHSEmax_C DFES_EnvRef.DFC_ETHSEmin_C DFES_EnvRef.DFC_ETHSFmax_C DFES_EnvRef.DFC_ETHSFmin_C DFES_EnvRef.DFC_ETHSFsig_C DFES_EnvRef.DFC_ETHSNPWmax_C DFES_EnvRef.DFC_ETHSNPWmin_C DFES_EnvRef.DFC_ETHSNPWsig_C DFES_EnvRef.DFC_ETHSPLnpl_C DFES_EnvRef.DFC_ETHSTPLnpl_C DFES_EnvRef.DFC_EngICO_C DFES_EnvRef.DFC_EngPrtOvrSpdMon_C DFES_EnvRef.DFC_EpmCaSI1ErrSig_C DFES_EnvRef.DFC_EpmCaSI1MntErr_C DFES_EnvRef.DFC_EpmCaSI1NoSigMax_C DFES_EnvRef.DFC_EpmCaSI1NoSigMin_C DFES_EnvRef.DFC_EpmCaSI1OfsErr_C DFES_EnvRef.DFC_EpmCrSDGI_C DFES_EnvRef.DFC_EpmCrSErrSig_C DFES_EnvRef.DFC_EpmCrSNoSig_C DFES_EnvRef.DFC_EtaEngIdleNonCsers_C DFES_EnvRef.DFC_EtaEngPtlNonCsers_C DFES_EnvRef.DFC_FRAmax_C DFES_EnvRef.DFC_FRAmin_C DFES_EnvRef.DFC_FSTEmax_C DFES_EnvRef.DFC_FSTEmin_C DFES_EnvRef.DFC_FSTRmax_C DFES_EnvRef.DFC_FSTRmin_C DFES_EnvRef.DFC_FSTRnpl_C DFES_EnvRef.DFC_FSTmax_C DFES_EnvRef.DFC_FTDLAmax_C DFES_EnvRef.DFC_FTDLAmin_C DFES_EnvRef.DFC_FuPHiSnsrEleclmax_C DFES_EnvRef.DFC_FuPHiSnsrEleclmin_C DFES_EnvRef.DFC_FuPHiSnsrEleclnpl_C DFES_EnvRef.DFC_FuPHiSnsrURngMax_C DFES_EnvRef.DFC_FuPHiSnsrURngMin_C DFES_EnvRef.DFC_FuSnsrPhyRngMaxErr_C DFES_EnvRef.DFC_FuSnsrPhyRngMinErr_C DFES_EnvRef.DFC_GEVlvLockPinDiagIntkB1_C DFES_EnvRef.DFC_GEVlvPhaSlowIntkB1_C DFES_EnvRef.DFC_GEVlvPhaTargIntkB1_C DFES_EnvRef.DFC_GbxRvsSwtStk_C DFES_EnvRef.DFC_HDRKHmax_C DFES_EnvRef.DFC_HDRKHmin_C DFES_EnvRef.DFC_HDRPLmax_C DFES_EnvRef.DFC_HDRPLmin_C DFES_EnvRef.DFC_HDRmax_C DFES_EnvRef.DFC_HDRmin_C DFES_EnvRef.DFC_HEGOS2B1ElecMax_C DFES_EnvRef.DFC_HEGOS2B1ElecMin_C DFES_EnvRef.DFC_HEGOS2B1ElecSig_C DFES_EnvRef.DFC_HEGOS2B1HtgNpl_C DFES_EnvRef.DFC_HEV00max_C DFES_EnvRef.DFC_HEV01max_C DFES_EnvRef.DFC_HEV02max_C DFES_EnvRef.DFC_HEV03max_C DFES_EnvRef.DFC_HEVE0max_C DFES_EnvRef.DFC_HEVE1max_C DFES_EnvRef.DFC_HFMmax_C DFES_EnvRef.DFC_HiPSysHiPMaxLimExcdd_C DFES_EnvRef.DFC_IVGdiCtlCvoErrMax_0_C DFES_EnvRef.DFC_IVGdiCtlCvoErrMax_1_C DFES_EnvRef.DFC_IVGdiCtlCvoErrMax_2_C DFES_EnvRef.DFC_IVGdiCtlCvoErrMax_3_C DFES_EnvRef.DFC_IVGdiCtlCvoErrMin_0_C DFES_EnvRef.DFC_IVGdiCtlCvoErrMin_1_C DFES_EnvRef.DFC_IVGdiCtlCvoErrMin_2_C DFES_EnvRef.DFC_IVGdiCtlCvoErrMin_3_C DFES_EnvRef.DFC_IVGdiCtlCvoErrMinMax_C DFES_EnvRef.DFC_IVGdiCtlCvoSigPlausErrSmrCdn_C DFES_EnvRef.DFC_IVGdiCtl_CvoErr_C DFES_EnvRef.DFC_IVGdiCtl_CvoSigPlaus_0_C DFES_EnvRef.DFC_IVGdiCtl_CvoSigPlaus_1_C DFES_EnvRef.DFC_IVGdiCtl_CvoSigPlaus_2_C DFES_EnvRef.DFC_IVGdiCtl_CvoSigPlaus_3_C DFES_EnvRef.DFC_IntkAirTAirFltDsCrssMax_C DFES_EnvRef.DFC_IntkAirTAirFltDsCrssMin_C DFES_EnvRef.DFC_IntkAirTAirFltDsHSCMax_C DFES_EnvRef.DFC_IntkAirTAirFltDsImps_C DFES_EnvRef.DFC_IntkAirTAirFltDsPRCMax_C DFES_EnvRef.DFC_IntkAirTAirFltDsPRCMin_C DFES_EnvRef.DFC_IntkAirTAirFltDsSRCMax_C DFES_EnvRef.DFC_IntkAirTAirFltDsSRCMin_C DFES_EnvRef.DFC_IntkAirTAirFltDsSTC_C DFES_EnvRef.DFC_IntkAirTIntkMnfldCrssMax_C DFES_EnvRef.DFC_IntkAirTIntkMnfldCrssMin_C DFES_EnvRef.DFC_IntkAirTIntkMnfldHSCMax_C DFES_EnvRef.DFC_IntkAirTIntkMnfldImps_C DFES_EnvRef.DFC_IntkAirTIntkMnfldPRCMax_C DFES_EnvRef.DFC_IntkAirTIntkMnfldPRCMin_C DFES_EnvRef.DFC_IntkAirTIntkMnfldSRCMax_C DFES_EnvRef.DFC_IntkAirTIntkMnfldSRCMin_C DFES_EnvRef.DFC_IntkAirTIntkMnfldSTC_C DFES_EnvRef.DFC_KRREGRLMX_C DFES_EnvRef.DFC_KRVEKOCVLCI_C DFES_EnvRef.DFC_KRVEKOENCHMT_C DFES_EnvRef.DFC_KRVEKOENCHMT0_C DFES_EnvRef.DFC_KRVEKOENCHMT1_C DFES_EnvRef.DFC_KRVEKOENCHMT2_C DFES_EnvRef.DFC_KRVEKOENCHMT3_C DFES_EnvRef.DFC_KRVEKOENCHMT4_C DFES_EnvRef.DFC_KRVEKOENCHMT5_C DFES_EnvRef.DFC_KRVEKOENCHMT6_C DFES_EnvRef.DFC_KRVEKOENCHMT7_C DFES_EnvRef.DFC_KRVEKORLMX_C DFES_EnvRef.DFC_KRVEKORLMXL_C DFES_EnvRef.DFC_KS1max_C DFES_EnvRef.DFC_KS1min_C DFES_EnvRef.DFC_LMmax_C DFES_EnvRef.DFC_LZSRnpl_C DFES_EnvRef.DFC_LamDynDiagS1B1_C DFES_EnvRef.DFC_LeakIntkMnfldEmiInfl_C DFES_EnvRef.DFC_LinFrameErrDCDC_C DFES_EnvRef.DFC_LinOverrunErrDCDC_C DFES_EnvRef.DFC_MD00max_C DFES_EnvRef.DFC_MDBmax_C DFES_EnvRef.DFC_MDCat_C DFES_EnvRef.DFC_MDCatCrit_C DFES_EnvRef.DFC_MDCatCurr_C DFES_EnvRef.DFC_MDCyl_0_C DFES_EnvRef.DFC_MDCyl_1_C DFES_EnvRef.DFC_MDCyl_2_C DFES_EnvRef.DFC_MDCyl_3_C DFES_EnvRef.DFC_MDEmi_C DFES_EnvRef.DFC_MDEmiStrt_C DFES_EnvRef.DFC_MDFco_C DFES_EnvRef.DFC_MDMpl_C DFES_EnvRef.DFC_MDSegTiAdpn_C DFES_EnvRef.DFC_MDmax_C DFES_EnvRef.DFC_MFuOilMax_C DFES_EnvRef.DFC_MOXEMM_SMU_ALM0_0_C DFES_EnvRef.DFC_MOXEMM_SMU_ALM0_1_C DFES_EnvRef.DFC_MOXEMM_SMU_ALM0_10_C DFES_EnvRef.DFC_MOXEMM_SMU_ALM0_11_C DFES_EnvRef.DFC_MOXEMM_SMU_ALM0_13_C DFES_EnvRef.DFC_MOXEMM_SMU_ALM0_14_C DFES_EnvRef.DFC_MOXEMM_SMU_ALM0_2_C DFES_EnvRef.DFC_MOXEMM_SMU_ALM0_22_C DFES_EnvRef.DFC_MOXEMM_SMU_ALM0_23_C DFES_EnvRef.DFC_MOXEMM_SMU_ALM0_4_C DFES_EnvRef.DFC_MOXEMM_SMU_ALM0_5_C DFES_EnvRef.DFC_MOXEMM_SMU_ALM0_7_C DFES_EnvRef.DFC_MOXEMM_SMU_ALM0_8_C DFES_EnvRef.DFC_MOXEMM_SMU_ALM10_16_C DFES_EnvRef.DFC_MOXEMM_SMU_ALM10_17_C DFES_EnvRef.DFC_MOXEMM_SMU_ALM10_21_C DFES_EnvRef.DFC_MOXEMM_SMU_ALM11_0_C DFES_EnvRef.DFC_MOXEMM_SMU_ALM11_1_C DFES_EnvRef.DFC_MOXEMM_SMU_ALM11_2_C DFES_EnvRef.DFC_MOXEMM_SMU_ALM11_3_C DFES_EnvRef.DFC_MOXEMM_SMU_ALM11_4_C DFES_EnvRef.DFC_MOXEMM_SMU_ALM11_5_C DFES_EnvRef.DFC_MOXEMM_SMU_ALM11_8_C DFES_EnvRef.DFC_MOXEMM_SMU_ALM11_9_C DFES_EnvRef.DFC_MOXEMM_SMU_ALM1_0_C DFES_EnvRef.DFC_MOXEMM_SMU_ALM1_1_C DFES_EnvRef.DFC_MOXEMM_SMU_ALM1_10_C DFES_EnvRef.DFC_MOXEMM_SMU_ALM1_11_C DFES_EnvRef.DFC_MOXEMM_SMU_ALM1_13_C DFES_EnvRef.DFC_MOXEMM_SMU_ALM1_14_C DFES_EnvRef.DFC_MOXEMM_SMU_ALM1_2_C DFES_EnvRef.DFC_MOXEMM_SMU_ALM1_22_C DFES_EnvRef.DFC_MOXEMM_SMU_ALM1_23_C DFES_EnvRef.DFC_MOXEMM_SMU_ALM1_4_C DFES_EnvRef.DFC_MOXEMM_SMU_ALM1_5_C DFES_EnvRef.DFC_MOXEMM_SMU_ALM1_7_C DFES_EnvRef.DFC_MOXEMM_SMU_ALM1_8_C DFES_EnvRef.DFC_MOXEMM_SMU_ALM21_0_C DFES_EnvRef.DFC_MOXEMM_SMU_ALM21_16_C DFES_EnvRef.DFC_MOXEMM_SMU_ALM21_3_C DFES_EnvRef.DFC_MOXEMM_SMU_ALM2_1_C DFES_EnvRef.DFC_MOXEMM_SMU_ALM2_10_C DFES_EnvRef.DFC_MOXEMM_SMU_ALM2_11_C DFES_EnvRef.DFC_MOXEMM_SMU_ALM2_13_C DFES_EnvRef.DFC_MOXEMM_SMU_ALM2_14_C DFES_EnvRef.DFC_MOXEMM_SMU_ALM2_22_C DFES_EnvRef.DFC_MOXEMM_SMU_ALM2_23_C DFES_EnvRef.DFC_MOXEMM_SMU_ALM2_4_C DFES_EnvRef.DFC_MOXEMM_SMU_ALM2_5_C DFES_EnvRef.DFC_MOXEMM_SMU_ALM2_7_C DFES_EnvRef.DFC_MOXEMM_SMU_ALM2_8_C DFES_EnvRef.DFC_MOXEMM_SMU_ALM6_0_C DFES_EnvRef.DFC_MOXEMM_SMU_ALM6_11_C DFES_EnvRef.DFC_MOXEMM_SMU_ALM6_12_C DFES_EnvRef.DFC_MOXEMM_SMU_ALM6_14_C DFES_EnvRef.DFC_MOXEMM_SMU_ALM6_15_C DFES_EnvRef.DFC_MOXEMM_SMU_ALM6_17_C DFES_EnvRef.DFC_MOXEMM_SMU_ALM6_18_C DFES_EnvRef.DFC_MOXEMM_SMU_ALM6_20_C DFES_EnvRef.DFC_MOXEMM_SMU_ALM6_21_C DFES_EnvRef.DFC_MOXEMM_SMU_ALM6_25_C DFES_EnvRef.DFC_MOXEMM_SMU_ALM6_4_C DFES_EnvRef.DFC_MOXEMM_SMU_ALM6_5_C DFES_EnvRef.DFC_MOXEMM_SMU_ALM6_7_C DFES_EnvRef.DFC_MOXEMM_SMU_ALM6_8_C DFES_EnvRef.DFC_MOXEMM_SMU_ALM7_1_C DFES_EnvRef.DFC_MOXEMM_SMU_ALM7_12_C DFES_EnvRef.DFC_MOXEMM_SMU_ALM7_13_C DFES_EnvRef.DFC_MOXEMM_SMU_ALM7_14_C DFES_EnvRef.DFC_MOXEMM_SMU_ALM7_15_C DFES_EnvRef.DFC_MOXEMM_SMU_ALM7_16_C DFES_EnvRef.DFC_MOXEMM_SMU_ALM7_17_C DFES_EnvRef.DFC_MOXEMM_SMU_ALM7_2_C DFES_EnvRef.DFC_MOXEMM_SMU_ALM7_20_C DFES_EnvRef.DFC_MOXEMM_SMU_ALM7_25_C DFES_EnvRef.DFC_MOXEMM_SMU_ALM7_26_C DFES_EnvRef.DFC_MOXEMM_SMU_ALM7_28_C DFES_EnvRef.DFC_MOXEMM_SMU_ALM7_29_C DFES_EnvRef.DFC_MOXEMM_SMU_ALM7_30_C DFES_EnvRef.DFC_MOXEMM_SMU_ALM7_31_C DFES_EnvRef.DFC_MOXEMM_SMU_ALM8_0_C DFES_EnvRef.DFC_MOXEMM_SMU_ALM8_1_C DFES_EnvRef.DFC_MOXEMM_SMU_ALM8_10_C DFES_EnvRef.DFC_MOXEMM_SMU_ALM8_11_C DFES_EnvRef.DFC_MOXEMM_SMU_ALM8_12_C DFES_EnvRef.DFC_MOXEMM_SMU_ALM8_16_C DFES_EnvRef.DFC_MOXEMM_SMU_ALM8_18_C DFES_EnvRef.DFC_MOXEMM_SMU_ALM8_2_C DFES_EnvRef.DFC_MOXEMM_SMU_ALM8_3_C DFES_EnvRef.DFC_MOXEMM_SMU_ALM8_31_C DFES_EnvRef.DFC_MOXEMM_SMU_ALM8_4_C DFES_EnvRef.DFC_MOXEMM_SMU_ALM9_0_C DFES_EnvRef.DFC_MOXEMM_SMU_ALM9_15_C DFES_EnvRef.DFC_MOXEMM_SMU_ALM9_3_C DFES_EnvRef.DFC_MoCADCNTP_C DFES_EnvRef.DFC_MoCADCTst_C DFES_EnvRef.DFC_MoCSOPICO_C DFES_EnvRef.DFC_MoFAPP_C DFES_EnvRef.DFC_MoFAirFilgPrdc_C DFES_EnvRef.DFC_MoFAirFlCtOffGdi_C DFES_EnvRef.DFC_MoFAirFlCylGdi_C DFES_EnvRef.DFC_MoFAirFlFF_C DFES_EnvRef.DFC_MoFAirFlIn_C DFES_EnvRef.DFC_MoFAirFlMixCtlGdiChkAirFl_C DFES_EnvRef.DFC_MoFAirFlMixCtlGdiChkCtrl_C DFES_EnvRef.DFC_MoFAirFlMode_C DFES_EnvRef.DFC_MoFESpd_C DFES_EnvRef.DFC_MoFIACo_C DFES_EnvRef.DFC_MoFICOL1_C DFES_EnvRef.DFC_MoFICOL2_C DFES_EnvRef.DFC_MoFStrt_C DFES_EnvRef.DFC_MoFTrqCmp_C DFES_EnvRef.DFC_MoFTrqCmpMax_C DFES_EnvRef.DFC_MoFTrqCmpMin_C DFES_EnvRef.DFC_MoFVarPostBldSel_C DFES_EnvRef.DFC_MoXEMMHwLTMCUFW_C DFES_EnvRef.DFC_MoXEMMHwLTMonBIST_C DFES_EnvRef.DFC_MoXEMMHwLTRegMonTest_C DFES_EnvRef.DFC_MoXEMMHwLTStbySMUAlvTest_C DFES_EnvRef.DFC_MoXEMMHwLTTempSens_C DFES_EnvRef.DFC_MoXEMMHwLTUCBCfg_C DFES_EnvRef.DFC_NWSEmax_C DFES_EnvRef.DFC_NWSmax_C DFES_EnvRef.DFC_OCWDAABEActv_C DFES_EnvRef.DFC_OCWDACom_C DFES_EnvRef.DFC_OCWDAErrPin_C DFES_EnvRef.DFC_OCWDAOvrVltg_C DFES_EnvRef.DFC_ORAmax_C DFES_EnvRef.DFC_ORAmin_C DFES_EnvRef.DFC_OilPPlaus_C DFES_EnvRef.DFC_PLLSUmax_C DFES_EnvRef.DFC_PLLSUmin_C DFES_EnvRef.DFC_PSR1max_C DFES_EnvRef.DFC_PSRBmax_C DFES_EnvRef.DFC_PSRBmin_C DFES_EnvRef.DFC_PSRPmax_C DFES_EnvRef.DFC_PSRPmin_C DFES_EnvRef.DFC_PSRPsig_C DFES_EnvRef.DFC_PSRmax_C DFES_EnvRef.DFC_PUmax_C DFES_EnvRef.DFC_P_VSE11_OL_C DFES_EnvRef.DFC_P_VSE11_SCB_C DFES_EnvRef.DFC_P_VSE11_SCG_C DFES_EnvRef.DFC_PhyHighAPP1_C DFES_EnvRef.DFC_PhyHighAPP2_C DFES_EnvRef.DFC_PhyLowAPP1_C DFES_EnvRef.DFC_PhyLowAPP2_C DFES_EnvRef.DFC_SRCHighAPP1_C DFES_EnvRef.DFC_SRCHighAPP2_C DFES_EnvRef.DFC_SRCLowAPP1_C DFES_EnvRef.DFC_SRCLowAPP2_C DFES_EnvRef.DFC_SSpMon2_C DFES_EnvRef.DFC_STHDRmax_C DFES_EnvRef.DFC_SWReset_0_C DFES_EnvRef.DFC_SWReset_1_C DFES_EnvRef.DFC_SWReset_2_C DFES_EnvRef.DFC_SyncAPP_C DFES_EnvRef.DFC_TANKLnpl_C DFES_EnvRef.DFC_TAmax_Dummy_C DFES_EnvRef.DFC_TESFmax_C DFES_EnvRef.DFC_TESGmax_C DFES_EnvRef.DFC_TKAEmax_C DFES_EnvRef.DFC_TKAEmin_C DFES_EnvRef.DFC_TKARmax_C DFES_EnvRef.DFC_TKARnpl_C DFES_EnvRef.DFC_TMmax_Dummy_C DFES_EnvRef.DFC_TUMmax_Dummy_C DFES_EnvRef.DFC_TWCDPriCatB1_C DFES_EnvRef.DFC_ThrVlvClsdPosnFirstOffsLrnImpoB1_C DFES_EnvRef.DFC_ThrVlvClsdPosnOffsLrnImpoB1_C DFES_EnvRef.DFC_ThrVlvClsdPosnOffsLrnMaxB1_C DFES_EnvRef.DFC_ThrVlvClsdPosnOffsLrnMinB1_C DFES_EnvRef.DFC_ThrVlvCtrlDeB1_C DFES_EnvRef.DFC_ThrVlvDycB1_C DFES_EnvRef.DFC_ThrVlvLimpAirPosnMaxAbsltDriftB1_C DFES_EnvRef.DFC_ThrVlvLimpAirPosnMaxB1_C DFES_EnvRef.DFC_ThrVlvLimpAirPosnMaxRelDriftB1_C DFES_EnvRef.DFC_ThrVlvLimpAirPosnMinB1_C DFES_EnvRef.DFC_ThrVlvOpenLoadB1_C DFES_EnvRef.DFC_ThrVlvOpenSprgB1_C DFES_EnvRef.DFC_ThrVlvOpenSprgSprdB1_C DFES_EnvRef.DFC_ThrVlvOpenSprgTwnB1_C DFES_EnvRef.DFC_ThrVlvOverTB1_C DFES_EnvRef.DFC_ThrVlvRetSprgB1_C DFES_EnvRef.DFC_ThrVlvRetSprgSprdB1_C DFES_EnvRef.DFC_ThrVlvRetSprgTwnB1_C DFES_EnvRef.DFC_ThrVlvSens1MaxB1_C DFES_EnvRef.DFC_ThrVlvSens1NplB1_C DFES_EnvRef.DFC_ThrVlvSens2MaxB1_C DFES_EnvRef.DFC_ThrVlvSens2MinB1_C DFES_EnvRef.DFC_ThrVlvSens2NplB1_C DFES_EnvRef.DFC_ThrVlvShoCircB1_C DFES_EnvRef.DFC_ThrVlvSpiErrB1_C DFES_EnvRef.DFC_ThrvlvSens1MinB1_C DFES_EnvRef.DFC_TiOffTBasdChkFast_C DFES_EnvRef.DFC_TiOffTBasdChkSlow_C DFES_EnvRef.DFC_UEGOSnsrMntdS1B1_C DFES_EnvRef.DFC_VehVSig_C DFES_EnvRef.DFC_VlvLftFbSwtIntk11SpclFail_C DFES_EnvRef.DFC_VlvLftFbSwtIntk11StdFail_C DFES_FaultTyp.DFC_Unused_C DFES_FaultTyp.DFC_AAVEmax_C DFES_FaultTyp.DFC_AAVEmin_C DFES_FaultTyp.DFC_AAVEsig_C DFES_FaultTyp.DFC_AltIOACGFailr_C DFES_FaultTyp.DFC_AltIOACGHiVltg_C DFES_FaultTyp.DFC_AltIOACGLoVltg_C DFES_FaultTyp.DFC_AltIOACGTHi_C DFES_FaultTyp.DFC_AltIODConnACG_C DFES_FaultTyp.DFC_BGOELWAF_C DFES_FaultTyp.DFC_BattUHiFailr_C DFES_FaultTyp.DFC_BattULoFailr_C DFES_FaultTyp.DFC_BrkBstPDriftHiErr_C DFES_FaultTyp.DFC_BrkBstPDriftLoErr_C DFES_FaultTyp.DFC_BrkBstPSnsrStuck_C DFES_FaultTyp.DFC_BrkMnSwtContOn_C DFES_FaultTyp.DFC_BrkMnSwtNotStp_C DFES_FaultTyp.DFC_BrkNpl_C DFES_FaultTyp.DFC_BrkRdntSwtContOn_C DFES_FaultTyp.DFC_BrkRdntSwtNotStp_C DFES_FaultTyp.DFC_Clth3ONStuck_C DFES_FaultTyp.DFC_Clth4OFFStuck_C DFES_FaultTyp.DFC_ClthOFFStuck_C DFES_FaultTyp.DFC_ClthONStuck_C DFES_FaultTyp.DFC_ClthStkFailInfo_C DFES_FaultTyp.DFC_ComACFailInfo_C DFES_FaultTyp.DFC_ComATFTValErr_C DFES_FaultTyp.DFC_ComATMILReq_C DFES_FaultTyp.DFC_ComAYCAChksum_C DFES_FaultTyp.DFC_ComAYCARingCnt_C DFES_FaultTyp.DFC_ComAYCATOut_C DFES_FaultTyp.DFC_ComAYCDChkSum_C DFES_FaultTyp.DFC_ComAYCDTOut_C DFES_FaultTyp.DFC_ComAYCFChksum_C DFES_FaultTyp.DFC_ComAYCFRingCnt_C DFES_FaultTyp.DFC_ComAYCFTOut_C DFES_FaultTyp.DFC_ComAYCGChksum_C DFES_FaultTyp.DFC_ComAYCGRingCnt_C DFES_FaultTyp.DFC_ComAYCGTOut_C DFES_FaultTyp.DFC_ComAYCIChkSum_C DFES_FaultTyp.DFC_ComAYCIRingCnt_C DFES_FaultTyp.DFC_ComAYCITOut_C DFES_FaultTyp.DFC_ComBCM1ChkSum_C DFES_FaultTyp.DFC_ComBCM1RingCnt_C DFES_FaultTyp.DFC_ComBCM1TOut_C DFES_FaultTyp.DFC_ComCANABusOffErr_C DFES_FaultTyp.DFC_ComCANBBusOffErr_C DFES_FaultTyp.DFC_ComCANCBusOffErr_C DFES_FaultTyp.DFC_ComCGW1ChkSum_C DFES_FaultTyp.DFC_ComCGW1RingCnt_C DFES_FaultTyp.DFC_ComCGW1TOut_C DFES_FaultTyp.DFC_ComConvBoostErr_C DFES_FaultTyp.DFC_ComConvSlipErr_C DFES_FaultTyp.DFC_ComDCDCPrfmncErr_C DFES_FaultTyp.DFC_ComDCDCTempWarn_C DFES_FaultTyp.DFC_ComEAT10Chksum_C DFES_FaultTyp.DFC_ComEAT10RingCnt_C DFES_FaultTyp.DFC_ComEAT10TOut_C DFES_FaultTyp.DFC_ComEAT11ChkSum_C DFES_FaultTyp.DFC_ComEAT11RingCnt_C DFES_FaultTyp.DFC_ComEAT11TOut_C DFES_FaultTyp.DFC_ComEAT12ChkSum_C DFES_FaultTyp.DFC_ComEAT12RingCnt_C DFES_FaultTyp.DFC_ComEAT12TOut_C DFES_FaultTyp.DFC_ComEAT13ChkSum_C DFES_FaultTyp.DFC_ComEAT13RingCnt_C DFES_FaultTyp.DFC_ComEAT13TOut_C DFES_FaultTyp.DFC_ComEAT1Chksum_C DFES_FaultTyp.DFC_ComEAT1RingCnt_C DFES_FaultTyp.DFC_ComEAT1TOut_C DFES_FaultTyp.DFC_ComEAT2ChkSum_C DFES_FaultTyp.DFC_ComEAT2RingCnt_C DFES_FaultTyp.DFC_ComEAT2TOut_C DFES_FaultTyp.DFC_ComEAT4ChkSum_C DFES_FaultTyp.DFC_ComEAT4RingCnt_C DFES_FaultTyp.DFC_ComEAT4TOut_C DFES_FaultTyp.DFC_ComEAT6Chksum_C DFES_FaultTyp.DFC_ComEAT6RingCnt_C DFES_FaultTyp.DFC_ComEAT6TOut_C DFES_FaultTyp.DFC_ComEAT7Chksum_C DFES_FaultTyp.DFC_ComEAT7RingCnt_C DFES_FaultTyp.DFC_ComEAT7TOut_C DFES_FaultTyp.DFC_ComEAT8Chksum_C DFES_FaultTyp.DFC_ComEAT8RingCnt_C DFES_FaultTyp.DFC_ComEAT8TOut_C DFES_FaultTyp.DFC_ComEATAChksum_C DFES_FaultTyp.DFC_ComEATARingCnt_C DFES_FaultTyp.DFC_ComEATATOut_C DFES_FaultTyp.DFC_ComEATBChkSum_C DFES_FaultTyp.DFC_ComEATBRingCnt_C DFES_FaultTyp.DFC_ComEATBTOut_C DFES_FaultTyp.DFC_ComEATCChksum_C DFES_FaultTyp.DFC_ComEATCRingCnt_C DFES_FaultTyp.DFC_ComEATCTOut_C DFES_FaultTyp.DFC_ComEPBBChkSum_C DFES_FaultTyp.DFC_ComEPBBRingCnt_C DFES_FaultTyp.DFC_ComEPBBTOut_C DFES_FaultTyp.DFC_ComEPBChksum_C DFES_FaultTyp.DFC_ComEPBTOut_C DFES_FaultTyp.DFC_ComEPBctRing_C DFES_FaultTyp.DFC_ComEPS1Chksum_C DFES_FaultTyp.DFC_ComEPS1RingCnt_C DFES_FaultTyp.DFC_ComEPS1TOut_C DFES_FaultTyp.DFC_ComEngCanRxErr_C DFES_FaultTyp.DFC_ComGrvySnsrErr_C DFES_FaultTyp.DFC_ComGwIMG1ChkSum_C DFES_FaultTyp.DFC_ComGwIMG1RingCnt_C DFES_FaultTyp.DFC_ComGwIMG1TOut_C DFES_FaultTyp.DFC_ComGwIMG3ChkSum_C DFES_FaultTyp.DFC_ComGwIMG3RingCnt_C DFES_FaultTyp.DFC_ComGwIMG3TOut_C DFES_FaultTyp.DFC_ComGwIMG4ChkSum_C DFES_FaultTyp.DFC_ComGwIMG4RingCnt_C DFES_FaultTyp.DFC_ComGwIMG4TOut_C DFES_FaultTyp.DFC_ComGwIMG5ChkSum_C DFES_FaultTyp.DFC_ComGwIMG5RingCnt_C DFES_FaultTyp.DFC_ComGwIMG5TOut_C DFES_FaultTyp.DFC_ComGwIMG6ChkSum_C DFES_FaultTyp.DFC_ComGwIMG6RingCnt_C DFES_FaultTyp.DFC_ComGwIMG6TOut_C DFES_FaultTyp.DFC_ComIDASBChksum_C DFES_FaultTyp.DFC_ComIDASBRingCnt_C DFES_FaultTyp.DFC_ComIDASBTOut_C DFES_FaultTyp.DFC_ComIMGMILReq_C DFES_FaultTyp.DFC_ComISSPrms_C DFES_FaultTyp.DFC_ComMETAChksum_C DFES_FaultTyp.DFC_ComMETAChksumPstDrv_C DFES_FaultTyp.DFC_ComMETARingCnt_C DFES_FaultTyp.DFC_ComMETARingCntPstDrv_C DFES_FaultTyp.DFC_ComMETATOut_C DFES_FaultTyp.DFC_ComMETATOutPstDrv_C DFES_FaultTyp.DFC_ComMETCChksum_C DFES_FaultTyp.DFC_ComMETCRingCnt_C DFES_FaultTyp.DFC_ComMETCTOut_C DFES_FaultTyp.DFC_ComMETDChksum_C DFES_FaultTyp.DFC_ComMETDRingCnt_C DFES_FaultTyp.DFC_ComMETDTOut_C DFES_FaultTyp.DFC_ComMETE2Chksum_C DFES_FaultTyp.DFC_ComMETE2RingCnt_C DFES_FaultTyp.DFC_ComMETE2TOut_C DFES_FaultTyp.DFC_ComMETFChksum_C DFES_FaultTyp.DFC_ComMETFRingCnt_C DFES_FaultTyp.DFC_ComMETFTOut_C DFES_FaultTyp.DFC_ComMETGChksum_C DFES_FaultTyp.DFC_ComMETGRingCnt_C DFES_FaultTyp.DFC_ComMETGTOut_C DFES_FaultTyp.DFC_ComMETH2Chksum_C DFES_FaultTyp.DFC_ComMETH2RingCnt_C DFES_FaultTyp.DFC_ComMETH2TOut_C DFES_FaultTyp.DFC_ComMETHChksum_C DFES_FaultTyp.DFC_ComMETHRingCnt_C DFES_FaultTyp.DFC_ComMETHTOut_C DFES_FaultTyp.DFC_ComMETIChksum_C DFES_FaultTyp.DFC_ComMETIRingCnt_C DFES_FaultTyp.DFC_ComMETITOut_C DFES_FaultTyp.DFC_ComMETKChksum_C DFES_FaultTyp.DFC_ComMETKRingCnt_C DFES_FaultTyp.DFC_ComMETKTOut_C DFES_FaultTyp.DFC_ComMETLChksum_C DFES_FaultTyp.DFC_ComMETLRingCnt_C DFES_FaultTyp.DFC_ComMETLTOut_C DFES_FaultTyp.DFC_ComMETMChksum_C DFES_FaultTyp.DFC_ComMETMRingCnt_C DFES_FaultTyp.DFC_ComMETMTOut_C DFES_FaultTyp.DFC_ComMETNChksum_C DFES_FaultTyp.DFC_ComMETNRingCnt_C DFES_FaultTyp.DFC_ComMETNTOut_C DFES_FaultTyp.DFC_ComMtrCom_C DFES_FaultTyp.DFC_ComPCUChkSum_C DFES_FaultTyp.DFC_ComPCURingCnt_C DFES_FaultTyp.DFC_ComPCUTOut_C DFES_FaultTyp.DFC_ComSRSAChksum_C DFES_FaultTyp.DFC_ComSRSARingCnt_C DFES_FaultTyp.DFC_ComSRSATOut_C DFES_FaultTyp.DFC_ComSRSBChksum_C DFES_FaultTyp.DFC_ComSRSBRingCnt_C DFES_FaultTyp.DFC_ComSRSBTOut_C DFES_FaultTyp.DFC_ComSRSChksum_C DFES_FaultTyp.DFC_ComSRSErr_C DFES_FaultTyp.DFC_ComSRSRingCnt_C DFES_FaultTyp.DFC_ComSRSTOut_C DFES_FaultTyp.DFC_ComVehSpdPndFltTCU_C DFES_FaultTyp.DFC_EbsChartcCurrErr_C DFES_FaultTyp.DFC_EbsSelfDiagErr_C DFES_FaultTyp.DFC_GEVlvPhaCsersIntkB1_C DFES_FaultTyp.DFC_GEVlvPhaPsOpenLoadIntkB1_C DFES_FaultTyp.DFC_GEVlvPhaPsShoToBattIntkB1_C DFES_FaultTyp.DFC_GEVlvPhaPsShoToGndIntkB1_C DFES_FaultTyp.DFC_GbxCANDigPlausErr_C DFES_FaultTyp.DFC_GbxNPos1SRCMax_C DFES_FaultTyp.DFC_GbxNPos1SRCMin_C DFES_FaultTyp.DFC_GbxNPos2SRCMax_C DFES_FaultTyp.DFC_GbxNPos2SRCMin_C DFES_FaultTyp.DFC_GbxNPosAlvChk_C DFES_FaultTyp.DFC_GbxNPosSyncErr_C DFES_FaultTyp.DFC_HEGOS2B1HtrPsMax_C DFES_FaultTyp.DFC_HEGOS2B1HtrPsMin_C DFES_FaultTyp.DFC_HEGOS2B1HtrPsSig_C DFES_FaultTyp.DFC_LinCSErrACG_C DFES_FaultTyp.DFC_LinCSErrAEV_C DFES_FaultTyp.DFC_LinCSErrDCDC_C DFES_FaultTyp.DFC_LinCSErrEBS_C DFES_FaultTyp.DFC_LinHdrTimeoutErrACG_C DFES_FaultTyp.DFC_LinHdrTimeoutErrAEV_C DFES_FaultTyp.DFC_LinHdrTimeoutErrDCDC_C DFES_FaultTyp.DFC_LinHdrTimeoutErrEBS_C DFES_FaultTyp.DFC_LinMsgTimeoutErrACG_C DFES_FaultTyp.DFC_LinMsgTimeoutErrAEV_C DFES_FaultTyp.DFC_LinMsgTimeoutErrDCDC_C DFES_FaultTyp.DFC_LinMsgTimeoutErrEBS_C DFES_FaultTyp.DFC_LinNoStrtComErr_C DFES_FaultTyp.DFC_LowPresOilP_C DFES_FaultTyp.DFC_MisfDetVWhlFrntLeOORHi_C DFES_FaultTyp.DFC_MisfDetVWhlFrntLeRatyHi_C DFES_FaultTyp.DFC_MisfDetVWhlFrntLeRatyLo_C DFES_FaultTyp.DFC_MisfDetVWhlFrntLeStuck_C DFES_FaultTyp.DFC_MisfDetVWhlFrntRiOORHi_C DFES_FaultTyp.DFC_MisfDetVWhlFrntRiRatyHi_C DFES_FaultTyp.DFC_MisfDetVWhlFrntRiRatyLo_C DFES_FaultTyp.DFC_MisfDetVWhlFrntRiStuck_C DFES_FaultTyp.DFC_MisfDetVWhlReLeOORHi_C DFES_FaultTyp.DFC_MisfDetVWhlReLeRatyHi_C DFES_FaultTyp.DFC_MisfDetVWhlReLeRatyLo_C DFES_FaultTyp.DFC_MisfDetVWhlReLeStuck_C DFES_FaultTyp.DFC_MisfDetVWhlReRiOORHi_C DFES_FaultTyp.DFC_MisfDetVWhlReRiRatyHi_C DFES_FaultTyp.DFC_MisfDetVWhlReRiRatyLo_C DFES_FaultTyp.DFC_MisfDetVWhlReRiStuck_C DFES_FaultTyp.DFC_MisfDetdVWhlFrntLePlaus_C DFES_FaultTyp.DFC_MisfDetdVWhlFrntRiPlaus_C DFES_FaultTyp.DFC_MisfDetdVWhlReLePlaus_C DFES_FaultTyp.DFC_MisfDetdVWhlReRiPlaus_C DFES_FaultTyp.DFC_PEnvSigRngMax_C DFES_FaultTyp.DFC_PEnvSigRngMin_C DFES_FaultTyp.DFC_StmFault_C DFES_FaultTyp.DFC_StrtCtOffPth_C DFES_FaultTyp.DFC_StrtCtlErr_C DFES_FaultTyp.DFC_StrtFault_C DFES_FaultTyp.DFC_StrtLckJudg1_C DFES_FaultTyp.DFC_StrtLckJudg2_C DFES_FaultTyp.DFC_StrtOL_C DFES_FaultTyp.DFC_StrtOL2_C DFES_FaultTyp.DFC_StrtSCB_C DFES_FaultTyp.DFC_StrtSCB2_C DFES_FaultTyp.DFC_StrtSCG_C DFES_FaultTyp.DFC_StrtSCG2_C DFES_FaultTyp.DFC_StrtStkRly1_C DFES_FaultTyp.DFC_StrtStkRly2_C DFES_FaultTyp.DFC_TEVEmax_C DFES_FaultTyp.DFC_TEVEmin_C DFES_FaultTyp.DFC_TEVEsig_C DFES_FaultTyp.DFC_UegoHeatrPrfmncLoS1B1_C DFES_FaultTyp.DFC_VehVAllPlaus_C DFES_FaultTyp.DFC_VehVNCSnsrElecFailr_C DFES_FaultTyp.DFC_VehVPlausCan_C DFES_FaultTyp.DFC_VehVPlausFco_C DFES_FaultTyp.DFC_VehVPlausPwr_C DFES_FaultTyp.DFC_VehVPlausV2N_C DFES_FaultTyp.DFC_VehVSpdSnsrAElecFailr_C DFES_FaultTyp.DFC_VehVSpdSnsrBElecFailr_C DFES_FaultTyp.DFC_ClthMax_C DFES_FaultTyp.DFC_IgnClPs_DevComErr_C DFES_FaultTyp.DFC_IgnClPs_LineOl_0_C DFES_FaultTyp.DFC_IgnClPs_LineOl_1_C DFES_FaultTyp.DFC_IgnClPs_LineOl_2_C DFES_FaultTyp.DFC_IgnClPs_LineOl_3_C DFES_FaultTyp.DFC_IgnClPs_LineScb_0_C DFES_FaultTyp.DFC_IgnClPs_LineScb_1_C DFES_FaultTyp.DFC_IgnClPs_LineScb_2_C DFES_FaultTyp.DFC_IgnClPs_LineScb_3_C DFES_FaultTyp.DFC_IgnClPs_LineScg_0_C DFES_FaultTyp.DFC_IgnClPs_LineScg_1_C /end DEF_CHARACTERISTIC
 FUNCTION_VERSION "30000.73.0_2.0.0" /end FUNCTION
/begin COMPU_METHOD DFES_EnvTabVerb "" TAB_VERB "%6.3" "-" COMPU_TAB_REF DFES_EnvTabVerb /end COMPU_METHOD
/begin COMPU_VTAB DFES_EnvTabVerb "" TAB_VERB 2 0 "xSet1" 1 "xSet2" DEFAULT_VALUE "---" /end COMPU_VTAB
/begin COMPU_METHOD DFES_OneToOne "" RAT_FUNC "%6.2" "-" COEFFS 0 1 0 0 0 1 /end COMPU_METHOD
/begin RECORD_LAYOUT Val_Wu8 FNC_VALUES 1 UBYTE COLUMN_DIR DIRECT /end RECORD_LAYOUT
/end MODULE
/end PROJECT
