ASAP2_VERSION 1 60
/begin PROJECT MG1CS022 "MG1CS022"
/begin HEADER "" VERSION "MG1CS022_62XSC_V037" PROJECT_NO MG1CS022 /end HEADER
/begin MODULE DIM ""
/begin MOD_COMMON "" BYTE_ORDER MSB_LAST ALIGNMENT_BYTE 1 ALIGNMENT_WORD 2 ALIGNMENT_LONG 4 ALIGNMENT_INT64 4 ALIGNMENT_FLOAT32_IEEE 4 ALIGNMENT_FLOAT64_IEEE 4 DATA_SIZE 32 /end MOD_COMMON
/begin CHARACTERISTIC ANZEIN "trheshold for stuck check, number of injections" VALUE 0x8055540C RB_Val_Wu8 255.0 dez 0.00 255.0 FORMAT "%5.1" /end CHARACTERISTIC
/begin CHARACTERISTIC CWDSKV "Codeword to disable high pressure sensor diagnosis" VALUE 0x8055540D RB_Val_Wu8 255.0 dez 0.00 255.0 FORMAT "%5.1" /end CHARACTERISTIC
/begin CHARACTERISTIC CWGGFETH "Codeword for configuration of %GGFETH" VALUE 0x8055543E RB_Val_Wu8 255.0 dez 0.00 255.0 FORMAT "%5.1" /end CHARACTERISTIC
/begin CHARACTERISTIC CWGGFETHAP "Codeword of %GGFETH for application" VALUE 0x8055543F RB_Val_Wu8 255.0 dez 0.00 255.0 FORMAT "%5.1" /end CHARACTERISTIC
/begin CHARACTERISTIC DFETHINVAL_C "max. delta ethanol content since ethanol sensor value invalid for reinitialization" VALUE 0x80555440 RB_Val_Wu16 1.999969 fak_uw_b2 0.00 1.999969 FORMAT "%8.6" /end CHARACTERISTIC
/begin CHARACTERISTIC DVTETHIV_C "max. delta consumption since ethanol sensor value invalid for reinitialization" VALUE 0x80555442 RB_Val_Wu16 255.9961 vol_q3p90625Em3_l 0.00 255.9961 FORMAT "%8.4" /end CHARACTERISTIC
/begin CHARACTERISTIC ETHSCP_dielecEthConc_MAP "Relative permittivity search MAP from ethanol content" MAP 0x80555444 RB_Map_U16U16_U16 100.0000 rel_uw_b200 0.00 100.0000 FORMAT "%8.4" EXTENDED_LIMITS 0.00 199.9969
 /begin AXIS_DESCR STD_AXIS ETHSCP_perEthRaw rel_uw_b200 10 0.00 100.0000 FORMAT "%8.4" EXTENDED_LIMITS 0.00 199.9969 DEPOSIT ABSOLUTE /end AXIS_DESCR
 /begin AXIS_DESCR STD_AXIS ETHSCP_tFuHiRes temp_q0p1_om40 8 -40.0000 160.0000 FORMAT "%8.4" EXTENDED_LIMITS -40.00000 6513.500 DEPOSIT ABSOLUTE /end AXIS_DESCR
/end CHARACTERISTIC
/begin CHARACTERISTIC ETHSCP_facEthCmpCnvn_CUR "Ethanol content to Ethanol Factor Curve" CURVE 0x8055550C RB_Curve_U16_U16 1.999969 fak_uw_b2 0.00 1.999969 FORMAT "%8.6"
 /begin AXIS_DESCR STD_AXIS ETHSCP_perEthCmp rel_uw_b200 2 0.00 100.0000 FORMAT "%8.4" EXTENDED_LIMITS 0.00 199.9969 DEPOSIT ABSOLUTE /end AXIS_DESCR
/end CHARACTERISTIC
/begin CHARACTERISTIC ETHSCP_facEthExtdIni_C "Ethanol concentration at first initialisation of extended range" VALUE 0x80555516 RB_Val_Wu16 1.999969 fak_uw_b2 0.00 1.999969 FORMAT "%8.6" /end CHARACTERISTIC
/begin CHARACTERISTIC ETHSCP_facFuTCmp_CUR "Coefficient table for fuel temperature adjustment based on fuel flow rate." CURVE 0x80555518 RB_Curve_U16_U16 1.999969 fak_uw_b2 0.00 1.999969 FORMAT "%8.6"
 /begin AXIS_DESCR STD_AXIS InjSys_dvolFuInjr q1p1921Em6_L_DIV_s 5 0.00 0.07812381 FORMAT "%10.8" DEPOSIT ABSOLUTE /end AXIS_DESCR
/end CHARACTERISTIC
/begin CHARACTERISTIC ETHSCP_flgProdModOn_C "Calibration of Filter required for transition from Production Mode On" VALUE 0x8055552E RB_Val_Wboolean 1.00000000000 B_TRUE 0.00 1.00000000000 FORMAT "%13.11" /end CHARACTERISTIC
/begin CHARACTERISTIC ETHSCP_nEngAirDchaMin_C "Engine speed threshold for air-bleeding determination" VALUE 0x80555530 RB_Val_Ws16 16383.50 nmot_q0p5 0.00 16383.50 FORMAT "%8.2" EXTENDED_LIMITS -16384.00 16383.50 /end CHARACTERISTIC
/begin CHARACTERISTIC ETHSCP_percEthRaw_T "Raw Ethanol Percentage from Sensor" CURVE 0x80555532 RB_Curve_U16_U16 100.0000 rel_uw_b200 0.00 100.0000 FORMAT "%8.4" EXTENDED_LIMITS 0.00 199.9969
 /begin AXIS_DESCR STD_AXIS fqethsf_w_msg freq_q0p01 12 0.00 655.3500 FORMAT "%8.4" DEPOSIT ABSOLUTE /end AXIS_DESCR
/end CHARACTERISTIC
/begin CHARACTERISTIC ETHSCP_perEthConc_MAP "Ethanol content search MAP from relative permittivity" MAP 0x80555564 RB_Map_U16U16_U16 100.0000 rel_uw_b200 0.00 100.0000 FORMAT "%8.4" EXTENDED_LIMITS 0.00 199.9969
 /begin AXIS_DESCR STD_AXIS NO_INPUT_QUANTITY rel_uw_b200 14 0.00 100.0000 FORMAT "%8.4" EXTENDED_LIMITS 0.00 199.9969 DEPOSIT ABSOLUTE /end AXIS_DESCR
 /begin AXIS_DESCR STD_AXIS ETHSCP_tFuAftCmp temp_q0p1_om40 8 -40.0000 160.0000 FORMAT "%8.4" EXTENDED_LIMITS -40.00000 6513.500 DEPOSIT ABSOLUTE /end AXIS_DESCR
/end CHARACTERISTIC
/begin CHARACTERISTIC ETHSCP_pFuAirDchaMin_C "Fuel pressure threshold for air-bleeding determination" VALUE 0x80555674 RB_Val_Wu16 32.76750 p_q0p0005_MPa 0.00 32.76750 FORMAT "%8.5" /end CHARACTERISTIC
/begin CHARACTERISTIC ETHSCP_tiAirDcha_C "Air-bleeding stabilization waiting time in piping" VALUE 0x80555676 RB_Val_Wu16 6553.300 t_q0p1 0.200 6553.500 FORMAT "%8.3" EXTENDED_LIMITS 0.00 6553.500 /end CHARACTERISTIC
/begin CHARACTERISTIC ETHSCP_tiFuFlowCmp_CUR "Low pass filter coefficient time according to fuel flow rate" CURVE 0x80555678 RB_Curve_U16_U16 6553.500 t_q0p1 0.00 6553.500 FORMAT "%8.3"
 /begin AXIS_DESCR STD_AXIS InjSys_dvolFuInjr q1p1921Em6_L_DIV_s 8 0.00 0.07812381 FORMAT "%10.8" DEPOSIT ABSOLUTE /end AXIS_DESCR
/end CHARACTERISTIC
/begin CHARACTERISTIC ETHSCP_tiProdModEnd_C "Time after primal fueling finished to disable Production Mode" VALUE 0x8055569A RB_Val_Wu8 25.50 t_q0p1 0.00 25.50 FORMAT "%5.2" /end CHARACTERISTIC
/begin CHARACTERISTIC FETHEVINI_C "ethanol concentration at first initialisation" VALUE 0x8055569C RB_Val_Wu16 1.999969 fak_uw_b2 0.00 1.999969 FORMAT "%8.6" /end CHARACTERISTIC
/begin CHARACTERISTIC FQETHSFCMP1MN_C "Min value for fuel composilition error frequency -- range 1" VALUE 0x8055569E RB_Val_Wu16 655.3500 freq_q0p01 0.00 655.3500 FORMAT "%8.4" /end CHARACTERISTIC
/begin CHARACTERISTIC FQETHSFCMP1MX_C "Max value for fuel composilition error frequency -- range 1" VALUE 0x805556A0 RB_Val_Wu16 655.3500 freq_q0p01 0.00 655.3500 FORMAT "%8.4" /end CHARACTERISTIC
/begin CHARACTERISTIC FQETHSFCMP2MN_C "Min value for fuel composilition error frequency -- range 2" VALUE 0x805556A2 RB_Val_Wu16 655.3500 freq_q0p01 0.00 655.3500 FORMAT "%8.4" /end CHARACTERISTIC
/begin CHARACTERISTIC FQETHSFCMP2MX_C "Max value for fuel composilition error frequency -- range 2" VALUE 0x805556A4 RB_Val_Wu16 655.3500 freq_q0p01 0.00 655.3500 FORMAT "%8.4" /end CHARACTERISTIC
/begin CHARACTERISTIC FQETHSFMN_C "minimum limit of signal frequency for valid region" VALUE 0x805556A6 RB_Val_Wu16 655.3500 freq_q0p01 0.00 655.3500 FORMAT "%8.4" /end CHARACTERISTIC
/begin CHARACTERISTIC FQETHSFMX_C "ethanol sensor, maximum limit of signal frequency for valid region" VALUE 0x805556A8 RB_Val_Wu16 655.3500 freq_q0p01 0.00 655.3500 FORMAT "%8.4" /end CHARACTERISTIC
/begin CHARACTERISTIC FQETHSMFMN2_C "ethanol sensor measure error minimum limit - range 2" VALUE 0x805556AA RB_Val_Wu16 655.3500 freq_q0p01 0.00 655.3500 FORMAT "%8.4" /end CHARACTERISTIC
/begin CHARACTERISTIC FQETHSMFMN_C "ethanol sensor measure error minimum limit" VALUE 0x805556AC RB_Val_Wu16 655.3500 freq_q0p01 0.00 655.3500 FORMAT "%8.4" /end CHARACTERISTIC
/begin CHARACTERISTIC FQETHSMFMX2_C "ethanol sensor measure error maximum limit - range 2" VALUE 0x805556AE RB_Val_Wu16 655.3500 freq_q0p01 0.00 655.3500 FORMAT "%8.4" /end CHARACTERISTIC
/begin CHARACTERISTIC FQETHSMFMX_C "Sensor measure error signal maximum limit, ethanol factor" VALUE 0x805556B0 RB_Val_Wu16 655.3500 freq_q0p01 0.00 655.3500 FORMAT "%8.4" /end CHARACTERISTIC
/begin CHARACTERISTIC FuPHi_pMinDiagStuckChk_C "pressure threshold for stuck check" VALUE 0x8055540E RB_Val_Wu16 131.0700 RBPtCel_p_0p002_1 0.00 131.0700 FORMAT "%8.4" /end CHARACTERISTIC
/begin CHARACTERISTIC FuPHi_pTrfFuncRail_T "Characteristic line for conversion of rail-pressure sensor voltage into rail pressure" CURVE 0x80555410 RB_Curve_U16_U16 131.0700 RBPtCel_p_0p002_1 0.00 131.0700 FORMAT "%8.4"
 /begin AXIS_DESCR STD_AXIS uprm_w spg_q3p052em4 3 0.00 19.99969 FORMAT "%8.5" DEPOSIT ABSOLUTE /end AXIS_DESCR
/end CHARACTERISTIC
/begin CHARACTERISTIC FuPHi_tiDlyRailPInvld_C "Delay time for setting of rail pressure sensor value invalid" VALUE 0x8055541E RB_Val_Wu8 2.550 t_q0p01 0.00 2.550 FORMAT "%5.3" /end CHARACTERISTIC
/begin CHARACTERISTIC FuPHi_tiDlyRailPVld_C "Delay time for setting of rail pressure sensor value signal valid" VALUE 0x8055541F RB_Val_Wu8 2.550 t_q0p01 0.00 2.550 FORMAT "%5.3" /end CHARACTERISTIC
/begin CHARACTERISTIC GEVCtl_agClsdOutl_C "Angle outlet valve closes at 0.5mm lift" VALUE 0x805547CE RB_Val_Ws16 1023.984 kw_q0p0156 -512.0000 511.9844 FORMAT "%8.4" /end CHARACTERISTIC
/begin CHARACTERISTIC GEVCtl_agDeStyCdnAdpn_C "Angle deviation for the detection of the steady angle condition for the adaptation" VALUE 0x80554750 RB_Val_Wu16 1023.984 kw_q0p0156 0.00 1023.984 FORMAT "%8.3" /end CHARACTERISTIC
/begin CHARACTERISTIC GEVCtl_agLockPosnIntk_C "Angle inlet valve opened in locking position relative to TDC" VALUE 0x80554814 RB_Val_Ws16 1023.984 kw_q0p0156 -512.0000 511.9844 FORMAT "%8.4" /end CHARACTERISTIC
/begin CHARACTERISTIC GEVCtl_agLockPosnOutl_C "Angle outlet valve closed in locking position relative to TDC" VALUE 0x80554816 RB_Val_Ws16 1023.984 kw_q0p0156 -512.0000 511.9844 FORMAT "%8.4" /end CHARACTERISTIC
/begin CHARACTERISTIC GEVCtl_agMaxDeRefIntk_C "Max. perm. deviation of desired position of intake camshaft to reference pos. of fine adaptation" VALUE 0x80554752 RB_Val_Wu16 1023.984 kw_q0p0156 0.00 1023.984 FORMAT "%8.3" /end CHARACTERISTIC
/begin CHARACTERISTIC GEVCtl_agMaxDeRefLoLftIntk_C "maximum deviation of desired position of intake camshaft to reference position for fine adaptation in small cam profile" VALUE 0x80554754 RB_Val_Wu16 1023.984 kw_q0p0156 0.00 1023.984 FORMAT "%8.3" /end CHARACTERISTIC
/begin CHARACTERISTIC GEVCtl_agMaxDeRefToRelsAdpn_C "maximal delta angle to reference position to get direct adaptation release" VALUE 0x80554756 RB_Val_Ws16 1023.984 kw_q0p0156 -512.0000 511.9844 FORMAT "%8.4" /end CHARACTERISTIC
/begin CHARACTERISTIC GEVCtl_agMaxDeStyCdnAdpn_C "Maximum angle threshold for actual angle deviation for the detection of the steady angle condition for the adaptation" VALUE 0x80554758 RB_Val_Ws16 1023.984 kw_q0p0156 -512.0000 511.9844 FORMAT "%8.4" /end CHARACTERISTIC
/begin CHARACTERISTIC GEVCtl_agMaxIntk_C "max value of desired angle of inlet camshaft opens at 1mm lift" VALUE 0x80554818 RB_Val_Ws16 1023.984 kw_q0p0156 -512.0000 511.9844 FORMAT "%8.4" /end CHARACTERISTIC
/begin CHARACTERISTIC GEVCtl_agMinDeAftLstAbortAdpn_C "Minimal delta angle to be know there was a real movement of camshaft" VALUE 0x8055475A RB_Val_Ws16 1023.984 kw_q0p0156 -512.0000 511.9844 FORMAT "%8.4" /end CHARACTERISTIC
/begin CHARACTERISTIC GEVCtl_agMinDeSpAftLstAbortAdpn_C "Minimal delta angle of setpoint angle to be aspect a real movement of camshaft" VALUE 0x8055475C RB_Val_Ws16 1023.984 kw_q0p0156 -512.0000 511.9844 FORMAT "%8.4" /end CHARACTERISTIC
/begin CHARACTERISTIC GEVCtl_agMinDeToRelsAdpn_C "minimal angle delta of camshaft to detect move of came in direction" VALUE 0x8055475E RB_Val_Ws16 1023.984 kw_q0p0156 -512.0000 511.9844 FORMAT "%8.4" /end CHARACTERISTIC
/begin CHARACTERISTIC GEVCtl_agMinIntk_C "min value of desired angle of inlet camshaft opens at 1mm lift" VALUE 0x8055481A RB_Val_Ws16 1023.984 kw_q0p0156 -512.0000 511.9844 FORMAT "%8.4" /end CHARACTERISTIC
/begin CHARACTERISTIC GEVCtl_agOffsVlvOpenIntk_C "Offset of the angle system to the intake valve opening point (0.5mm lift)" VALUE 0x805547D0 RB_Val_Ws16 1023.984 kw_q0p0156 -512.0000 511.9844 FORMAT "%8.4" /end CHARACTERISTIC
/begin CHARACTERISTIC GEVCtl_agOffsVlvOpenSpclLftIntk_C "Offset of the angle system to the intake valve opening point (0.5mm lift) for the special cam profile" VALUE 0x805547D2 RB_Val_Ws16 1023.984 kw_q0p0156 -512.0000 511.9844 FORMAT "%8.4" /end CHARACTERISTIC
/begin CHARACTERISTIC GEVCtl_agRefPosnIntk_C "angle inlet valve opened at 1mm Lift in reference position relative to TDC" VALUE 0x8055481C RB_Val_Ws16 1023.984 kw_q0p0156 -512.0000 511.9844 FORMAT "%8.4" /end CHARACTERISTIC
/begin CHARACTERISTIC GEVCtl_agRefPosnOutl_C "angle outlet valve closed at 1mm Lift in reference position relative to TDC" VALUE 0x8055481E RB_Val_Ws16 1023.984 kw_q0p0156 -512.0000 511.9844 FORMAT "%8.4" /end CHARACTERISTIC
/begin CHARACTERISTIC GEVCtl_agWidthCamProfIntk_C "Width of the intake valve cam profile referred to 0.5mm lift" VALUE 0x805547D4 RB_Val_Ws16 1023.984 kw_q0p0156 -512.0000 511.9844 FORMAT "%8.4" /end CHARACTERISTIC
/begin CHARACTERISTIC GEVCtl_agWidthCamProfOutl_C "Width of the outlet valve cam profile referred to 0.5mm lift" VALUE 0x805547D6 RB_Val_Ws16 1023.984 kw_q0p0156 -512.0000 511.9844 FORMAT "%8.4" /end CHARACTERISTIC
/begin CHARACTERISTIC GEVCtl_agWidthCamProfSpclLftIntk_C "Width of the intake valve cam profile (special cam profile) referred to 0.5mm lift" VALUE 0x805547D8 RB_Val_Ws16 1023.984 kw_q0p0156 -512.0000 511.9844 FORMAT "%8.4" /end CHARACTERISTIC
/begin CHARACTERISTIC GEVCtl_cntrAdpnDiFcoCdn_C "Counter value of the adaptation counter for the disabling of the fuel cut off condition as a release condition for the fine adaptation" VALUE 0x80554760 RB_Val_Wu8 255.0 OneToOne 0.00 255.0 FORMAT "%5.1" /end CHARACTERISTIC
/begin CHARACTERISTIC GEVCtl_cntrDlyChrgDetrmIntkNegDif_C "Number of segments for shifting the trigger when the valve lift is switched for negative expected charge difference" VALUE 0x805547AE RB_Val_Ws8 255.0 OneToOne -128.0 127.0 FORMAT "%5.1" /end CHARACTERISTIC
/begin CHARACTERISTIC GEVCtl_cntrDlyChrgDetrmIntkPosDif_C "Number of segments for shifting the trigger when the valve lift is switched for positive expected charge difference." VALUE 0x805547AF RB_Val_Ws8 255.0 OneToOne -128.0 127.0 FORMAT "%5.1" /end CHARACTERISTIC
/begin CHARACTERISTIC GEVCtl_facThdWrmVlvLftEnaIntk_C "Threshold enable valve lift for Factor transition operating point coldwarm desired value intake camshaft" VALUE 0x805547B2 RB_Val_Wu8 0.9961 fak_ub_b1 0.00 0.9961 /end CHARACTERISTIC
/begin CHARACTERISTIC GEVCtl_nEngAdpnHys_C "Engine speed hysteresis for activation of camshaft adaptation" VALUE 0x80554762 RB_Val_Ws16 32767.50 EngN -16384.00 16383.50 FORMAT "%8.2" /end CHARACTERISTIC
/begin CHARACTERISTIC GEVCtl_nEngMaxFineAdpnIntk_C "max threshold engine speed for enable edge adaptation of inlet camshaft" VALUE 0x80554764 RB_Val_Ws16 32767.50 EngN -16384.00 16383.50 FORMAT "%8.2" /end CHARACTERISTIC
/begin CHARACTERISTIC GEVCtl_nEngMaxFirstAdpnIntk_C "max threshold engine speed for enable first/reference edge adaptation of inlet camshaft" VALUE 0x80554766 RB_Val_Ws16 32767.50 EngN -16384.00 16383.50 FORMAT "%8.2" /end CHARACTERISTIC
/begin CHARACTERISTIC GEVCtl_nEngMaxVlvLftEnaHys_C "Hysteresis for the engine speed threshold for cam profile switching" VALUE 0x805547B3 RB_Val_Wu8 10200. EngN_LRes 0.00 10200. FORMAT "%5.0" /end CHARACTERISTIC
/begin CHARACTERISTIC GEVCtl_nEngMaxVlvLftEna_C "Maximum permitted engine speed for cam profile switching" VALUE 0x805547B4 RB_Val_Wu8 10200. EngN_LRes 0.00 10200. FORMAT "%5.0" /end CHARACTERISTIC
/begin CHARACTERISTIC GEVCtl_nEngMinFineAdpnIntk_C "min threshold engine speed for enable edge adaptation of inlett camshaft" VALUE 0x80554768 RB_Val_Ws16 32767.50 EngN -16384.00 16383.50 FORMAT "%8.2" /end CHARACTERISTIC
/begin CHARACTERISTIC GEVCtl_nEngMinFirstAdpnIntk_C "min threshold engine speed for enable first/reference edge adaptation of inlet camshaft" VALUE 0x8055476A RB_Val_Ws16 32767.50 EngN -16384.00 16383.50 FORMAT "%8.2" /end CHARACTERISTIC
/begin CHARACTERISTIC GEVCtl_nHysAdpnTstr_C "Speed threshold hysteresis for function request flank adaption of camshaft" VALUE 0x805547A4 RB_Val_Wu8 10200. EngN_LRes 0.00 10200. FORMAT "%5.0" /end CHARACTERISTIC
/begin CHARACTERISTIC GEVCtl_nMinAdpnTstr_C "Speed threshold for function request flank adaption of camshaft" VALUE 0x805547A5 RB_Val_Wu8 10200. EngN_LRes 0.00 10200. FORMAT "%5.0" /end CHARACTERISTIC
/begin CHARACTERISTIC GEVCtl_nrMaxAdpn_C "max. number of edge adaptions on camshaft phase sensor" VALUE 0x8055476C RB_Val_Wu8 255.0 OneToOne 0.00 255.0 FORMAT "%5.1" /end CHARACTERISTIC
/begin CHARACTERISTIC GEVCtl_pOilMinVlvLftEnaHigh_C "Treshols for enable valve lift depends on oil pressure (high lift)" VALUE 0x805547B6 RB_Val_Ws16 3276.700 Pres 0.00 3276.700 FORMAT "%8.3" EXTENDED_LIMITS -3276.800 3276.700 /end CHARACTERISTIC
/begin CHARACTERISTIC GEVCtl_pOilMinVlvLftEnaLow_C "Treshols for enable valve lift depends on oil pressure (high lift)" VALUE 0x805547B8 RB_Val_Ws16 3276.700 Pres 0.00 3276.700 FORMAT "%8.3" EXTENDED_LIMITS -3276.800 3276.700 /end CHARACTERISTIC
/begin CHARACTERISTIC GEVCtl_ratLoadAdpnHys_C "Hysteresis for update of relative air charge for camshaft adaptation" VALUE 0x8055476E RB_Val_Wu16 1535.977 rel_uw_q0p0234 0.00 1535.977 FORMAT "%8.3" /end CHARACTERISTIC
/begin CHARACTERISTIC GEVCtl_ratLoadDeltaVlvLftIntkThd_C "Threshold under which a charge change after valve lift switching is considered a negative charge change." VALUE 0x805547B0 RB_Val_Ws16 1535.977 rel_q0p02344 -768.0000 767.9766 FORMAT "%8.4" /end CHARACTERISTIC
/begin CHARACTERISTIC GEVCtl_ratLoadFineAdpnAbortIntk_C "threshold charge for interrupt fine adaptation inlet" VALUE 0x80554770 RB_Val_Wu16 1535.977 rel_uw_q0p0234 0.00 1535.977 FORMAT "%8.3" /end CHARACTERISTIC
/begin CHARACTERISTIC GEVCtl_ratLoadMaxFineAdpnIntk_C "Maximum relative air mass for the fine adaptation release of the intake camshaft" VALUE 0x80554772 RB_Val_Wu16 1535.977 rel_uw_q0p0234 0.00 1535.977 FORMAT "%8.3" /end CHARACTERISTIC
/begin CHARACTERISTIC GEVCtl_ratLoadMaxFirstAdpnIntk_C "Maximum relative air mass for the first adaptation release of the intake camshaft" VALUE 0x80554774 RB_Val_Wu16 1535.977 rel_uw_q0p0234 0.00 1535.977 FORMAT "%8.3" /end CHARACTERISTIC
/begin CHARACTERISTIC GEVCtl_ratLoadMinFineAdpnIntk_C "Minimum relative air mass for the fine adaptation release of the intake camshaft" VALUE 0x80554776 RB_Val_Wu16 1535.977 rel_uw_q0p0234 0.00 1535.977 FORMAT "%8.3" /end CHARACTERISTIC
/begin CHARACTERISTIC GEVCtl_ratLoadMinFirstAdpnIntk_C "Minimum relative air mass for the first adaptation release of the intake camshaft" VALUE 0x80554778 RB_Val_Wu16 1535.977 rel_uw_q0p0234 0.00 1535.977 FORMAT "%8.3" /end CHARACTERISTIC
/begin CHARACTERISTIC GEVCtl_ratLoadThdDiFcoIntk_C "Threshold for the relative load, above which the fuel cut off condition for enabling the intake camshaft fine adaptation is reset" VALUE 0x8055477A RB_Val_Wu16 1535.977 rel_uw_q0p0234 0.00 1535.977 FORMAT "%8.3" /end CHARACTERISTIC
/begin CHARACTERISTIC GEVCtl_stReqRefAdpnTstr_C "codeword request camshaft reference adaptation without tetster demand" VALUE 0x805547A6 RB_Val_Wu8 255.0 dez 0.00 255.0 FORMAT "%5.1" /end CHARACTERISTIC
/begin CHARACTERISTIC GEVCtl_stReqRefAdpn_C "Status: Bit coded selection in function GEVCtl_ReqRefAdpn" VALUE 0x8055477C RB_Val_Wu16 65535.00 OneToOne 0.00 65535.00 FORMAT "%8.2" /end CHARACTERISTIC
/begin CHARACTERISTIC GEVCtl_stVlvLftEna_C "Codeword for the configuration of cam profile switching" VALUE 0x805547BA RB_Val_Wu8 255.0 dez 0.00 255.0 FORMAT "%5.1" /end CHARACTERISTIC
/begin CHARACTERISTIC GEVCtl_tEngDeltaNxtFineAdpnIntk_C "Delta engine temperature threshold for Next fine adaptation intake" VALUE 0x8055477E RB_Val_Ws16 6553.500 Temp_Cels -3549.940 3003.560 FORMAT "%8.3" /end CHARACTERISTIC
/begin CHARACTERISTIC GEVCtl_tEngMaxFineAdpn_C "Maximum threshold of the temperature field for fine adaption" VALUE 0x80554780 RB_Val_Ws16 6553.500 Temp_Cels -3549.940 3003.560 FORMAT "%8.3" /end CHARACTERISTIC
/begin CHARACTERISTIC GEVCtl_tEngMaxVlvLftEna_C "Maximum permitted engine temperature for the release of cam profile switching" VALUE 0x805547BC RB_Val_Ws16 6553.500 Temp_Cels -3549.940 3003.560 FORMAT "%8.3" /end CHARACTERISTIC
/begin CHARACTERISTIC GEVCtl_tEngMinFineAdpn_C "Minimum threshold of the temperature field for fine adaption" VALUE 0x80554782 RB_Val_Ws16 6553.500 Temp_Cels -3549.940 3003.560 FORMAT "%8.3" /end CHARACTERISTIC
/begin CHARACTERISTIC GEVCtl_tEngMinFirstAdpn_C "minimum engine temperature for angle adaptation camshaft" VALUE 0x80554784 RB_Val_Ws16 6553.500 Temp_Cels -3549.940 3003.560 FORMAT "%8.3" /end CHARACTERISTIC
/begin CHARACTERISTIC GEVCtl_tEngMinVlvLftEna_C "Minimum permitted engine temperature for the release of cam profile switching" VALUE 0x805547BE RB_Val_Ws16 6553.500 Temp_Cels -3549.940 3003.560 FORMAT "%8.3" /end CHARACTERISTIC
/begin CHARACTERISTIC GEVCtl_tiAgFilStyCdnAdpn_C "Filter time constant for the pt1 filter of the camshaft angle for the detection of the steady angle condition for the adaptation" VALUE 0x80554786 RB_Val_Wu16 655.3400 Time_s 0.0100 655.3500 FORMAT "%8.4" EXTENDED_LIMITS 0.00 655.3500 /end CHARACTERISTIC
/begin CHARACTERISTIC GEVCtl_tiDetStyCdnAdpn_C "Time duration for the debounce of the steady angle condition for the adaptation" VALUE 0x80554788 RB_Val_Wu16 655.3500 Time_s 0.00 655.3500 FORMAT "%8.4" /end CHARACTERISTIC
/begin CHARACTERISTIC GEVCtl_tiDiFcoCdnAftStrtIntk_C "time after enginge start for the disabling of the condition fuel cut off for fine adaptation intake camshaft" VALUE 0x8055478A RB_Val_Wu16 6553.500 t_q0p1 0.00 6553.500 FORMAT "%8.3" /end CHARACTERISTIC
/begin CHARACTERISTIC GEVCtl_tiDlyAdpnAftStrt_C "Adjustable delay time after which start end has been reached" VALUE 0x8055478C RB_Val_Wu16 655.3500 Time_s 0.00 655.3500 FORMAT "%8.4" /end CHARACTERISTIC
/begin CHARACTERISTIC GEVCtl_tiDlyNormStrtVlvLftEna_C "Delay time after normal engine start to release cam profile switching so that oil pressure is stabalised" VALUE 0x805547C0 RB_Val_Wu16 1310.700 t_q0p02 0.00 1310.700 FORMAT "%8.3" /end CHARACTERISTIC
/begin CHARACTERISTIC GEVCtl_tiMaxFineAdpn_C "max. time for one edge adaption of camshaft phase sensor (fine tuning)" VALUE 0x8055478E RB_Val_Wu16 655.3500 Time_s 0.00 655.3500 FORMAT "%8.4" /end CHARACTERISTIC
/begin CHARACTERISTIC GEVCtl_tiMaxFirstAdpn_C "max. time for one edge adaption of camshaft phase sensor" VALUE 0x80554790 RB_Val_Wu16 655.3500 Time_s 0.00 655.3500 FORMAT "%8.4" /end CHARACTERISTIC
/begin CHARACTERISTIC GEVCtl_tiMaxReqSpclRat_C "Maximal allowed time for requesting duty cycle while fuel cut off" VALUE 0x80554792 RB_Val_Wu16 655.3500 Time_s 0.00 655.3500 FORMAT "%8.4" /end CHARACTERISTIC
/begin CHARACTERISTIC GEVCtl_tiMinSpDelta_C "Minimal time, which setpoint angle need to be an delta angle away from frozen current psoition while last adaption abort to be able to detect an movement" VALUE 0x80554794 RB_Val_Wu16 655.3500 Time_s 0.00 655.3500 FORMAT "%8.4" /end CHARACTERISTIC
/begin CHARACTERISTIC GEVCtl_tiRefPosnDlyMax_C "Maximum time duration for reaching the reference position with steady angle condition" VALUE 0x80554796 RB_Val_Wu16 655.3500 Time_s 0.00 655.3500 FORMAT "%8.4" /end CHARACTERISTIC
/begin CHARACTERISTIC GEVCtl_tiRefPosnDly_T "Delay time after the inlet camshaft is in reference position with certainty" CURVE 0x80554798 RB_Curve_S16_U16_Static 655.3500 Time_s 0.00 655.3500 FORMAT "%8.4"
 /begin AXIS_DESCR STD_AXIS CEngDsT_t Temp_Cels 2 -3549.940 3003.560 FORMAT "%8.3" DEPOSIT ABSOLUTE /end AXIS_DESCR
/end CHARACTERISTIC
/begin CHARACTERISTIC GEVCtl_tOilAdpnMax_C "threshold of oil temperature to enable adaption of camshaft" VALUE 0x805547A2 RB_Val_Ws16 6553.500 Temp_Cels -3549.940 3003.560 FORMAT "%8.3" /end CHARACTERISTIC
/begin CHARACTERISTIC GEVCtl_tOilMaxAdpnTstr_C "threshold of oil temperature to enable adaption of camshaft by demand on tester" VALUE 0x805547A8 RB_Val_Ws16 6553.500 Temp_Cels -3549.940 3003.560 FORMAT "%8.3" /end CHARACTERISTIC
/begin CHARACTERISTIC GEVCtl_tOilMaxVlvLftEna_C "Maximum permitted oil temperature for the release of cam profile switching" VALUE 0x805547C2 RB_Val_Ws16 6553.500 Temp_Cels -3549.940 3003.560 FORMAT "%8.3" /end CHARACTERISTIC
/begin CHARACTERISTIC GEVCtl_tOilMinVlvLftEna_C "Minimum permitted oil temperature for the release of cam profile switching" VALUE 0x805547C4 RB_Val_Ws16 6553.500 Temp_Cels -3549.940 3003.560 FORMAT "%8.3" /end CHARACTERISTIC
/begin CHARACTERISTIC GEVCtl_tOilSwmpMaxVlvLftEna_C "Maximum temperature in Oil swamp to release the cam profile switching." VALUE 0x805547C6 RB_Val_Ws16 6553.500 Temp_Cels -3549.940 3003.560 FORMAT "%8.3" /end CHARACTERISTIC
/begin CHARACTERISTIC GEVCtl_tOilSwmpMinVlvLftEna_C "Minimum temperature in Oil swamp to release the cam profile switching." VALUE 0x805547C8 RB_Val_Ws16 6553.500 Temp_Cels -3549.940 3003.560 FORMAT "%8.3" /end CHARACTERISTIC
/begin CHARACTERISTIC GEVCtl_tWtrMaxAdpnTstr_C "maximum engine temperature for angle adaptation camshaft by demand on tester" VALUE 0x805547AA RB_Val_Ws16 6553.500 Temp_Cels -3549.940 3003.560 FORMAT "%8.3" /end CHARACTERISTIC
/begin CHARACTERISTIC GEVCtl_tWtrMinAdpnTstr_C "minimum engine temperature for angle adaptation camshaft by demand on tester" VALUE 0x805547AC RB_Val_Ws16 6553.500 Temp_Cels -3549.940 3003.560 FORMAT "%8.3" /end CHARACTERISTIC
/begin CHARACTERISTIC GEVCtl_uBattMaxVlvLftEna_C "Maximum permissible battery voltage for cam profile switching" VALUE 0x805547CA RB_Val_Ws16 1310700. Volt_Batt -655360.0 655340.0 FORMAT "%8.1" /end CHARACTERISTIC
/begin CHARACTERISTIC GEVCtl_uBattMinVlvLftEna_C "Minimum permissible battery voltage for cam profile switching" VALUE 0x805547CC RB_Val_Ws16 1310700. Volt_Batt -655360.0 655340.0 FORMAT "%8.1" /end CHARACTERISTIC
/begin CHARACTERISTIC GEVlv_agAllwdDeLockPosn_C "error threshold related to locking position" VALUE 0x805547DC RB_Val_Ws16 1023.984 kw_q0p0156 -512.0000 511.9844 FORMAT "%8.4" /end CHARACTERISTIC
/begin CHARACTERISTIC GEVlv_agDeBgnMonCycIntk_M "Angle deviation for begin monitoring cycle diagnosis phase actuator intake (MAP)" MAP 0x805548E8 RB_Map_S16S16_S16 1023.984 kw_q0p0156 -512.0000 511.9844 FORMAT "%8.4"
 /begin AXIS_DESCR STD_AXIS Epm_nEng EngN 4 -16384.00 16383.50 FORMAT "%8.2" DEPOSIT ABSOLUTE /end AXIS_DESCR
 /begin AXIS_DESCR STD_AXIS GEVCtl_tOilCylHd Temp_Cels 5 -3549.940 3003.560 FORMAT "%8.3" DEPOSIT ABSOLUTE /end AXIS_DESCR
/end CHARACTERISTIC
/begin CHARACTERISTIC GEVlv_agDeMaxAllwdPhaCsersIntk_M "Fault threshold setpoint-actual-deviation intake camshaft position CSERS" MAP 0x80554982 RB_Map_S16S16_S16 1023.984 kw_q0p0156 -512.0000 511.9844 FORMAT "%8.4"
 /begin AXIS_DESCR STD_AXIS Epm_nEng EngN 4 -16384.00 16383.50 FORMAT "%8.2" DEPOSIT ABSOLUTE /end AXIS_DESCR
 /begin AXIS_DESCR STD_AXIS GEVCtl_tOilCylHd Temp_Cels 4 -3549.940 3003.560 FORMAT "%8.3" DEPOSIT ABSOLUTE /end AXIS_DESCR
/end CHARACTERISTIC
/begin CHARACTERISTIC GEVlv_agDeSysTolrIntk_C "Angle deviation for consideration of system tolerance intake" VALUE 0x80554926 RB_Val_Ws16 1023.984 kw_q0p0156 -512.0000 511.9844 FORMAT "%8.4" /end CHARACTERISTIC
/begin CHARACTERISTIC GEVlv_agDifJitDetdIntk_C "Necessary difference between filtered and unfiltered intake camshaft angle for jitter detection" VALUE 0x80554820 RB_Val_Ws16 1023.984 kw_q0p0156 -512.0000 511.9844 FORMAT "%8.4" /end CHARACTERISTIC
/begin CHARACTERISTIC GEVlv_agMaxDiffFildPhaCsersIntk_C "Max difference between filtered and unfiltered setpoint to activate the cold start diagnosis" VALUE 0x805548DC RB_Val_Ws16 1023.984 kw_q0p0156 -512.0000 511.9844 FORMAT "%8.4" /end CHARACTERISTIC
/begin CHARACTERISTIC GEVlv_agMaxDiffFildUnFild_C "Maximum delta between unfilterd and filtered angle below the filtering of the extrapolated camshaft angle is activated" VALUE 0x80554822 RB_Val_Ws16 1023.984 kw_q0p0156 -512.0000 511.9844 FORMAT "%8.4" /end CHARACTERISTIC
/begin CHARACTERISTIC GEVlv_agMaxDiffMdnUnFildIntk_C "Maximum delta between unfilterd and filtered angle below the filtering of the extrapolated camshaft angle (intake) is activated" VALUE 0x80554824 RB_Val_Ws16 1023.984 kw_q0p0156 -512.0000 511.9844 FORMAT "%8.4" /end CHARACTERISTIC
/begin CHARACTERISTIC GEVlv_agMaxGovrDeAgFildg_C "Maximal governor deviation at which the camshaft angle is still fitlered" VALUE 0x80554826 RB_Val_Ws16 1023.984 kw_q0p0156 -512.0000 511.9844 FORMAT "%8.4" /end CHARACTERISTIC
/begin CHARACTERISTIC GEVlv_agMaxGovrDeIntkMdn_C "Maximum delta between setpoint and actual angle below the filtering of the extrapolated camshaft angle (intake) is activated" VALUE 0x80554828 RB_Val_Ws16 1023.984 kw_q0p0156 -512.0000 511.9844 FORMAT "%8.4" /end CHARACTERISTIC
/begin CHARACTERISTIC GEVlv_agMaxNormAgIntk_C "Maximal intake camshaft angle still considered normal" VALUE 0x805553FC RB_Val_Ws16 1023.984 kw_q0p0156 -512.0000 511.9844 FORMAT "%8.4" /end CHARACTERISTIC
/begin CHARACTERISTIC GEVlv_agMinNormAgIntk_C "Minimal intake camshaft angle still considered normal" VALUE 0x805553FE RB_Val_Ws16 1023.984 kw_q0p0156 -512.0000 511.9844 FORMAT "%8.4" /end CHARACTERISTIC
/begin CHARACTERISTIC GEVlv_agRngInhbHealPhaCsersIntk_C "Angle range for the previously detected fault region within which the healing is not allowed for the intake camshaft." VALUE 0x805548DE RB_Val_Ws16 1023.984 kw_q0p0156 -512.0000 511.9844 FORMAT "%8.4" /end CHARACTERISTIC
/begin CHARACTERISTIC GEVlv_agRngRefPosnIntk_C "Angle range reference position (Range1)" VALUE 0x80554928 RB_Val_Ws16 1023.984 kw_q0p0156 -512.0000 511.9844 FORMAT "%8.4" /end CHARACTERISTIC
/begin CHARACTERISTIC GEVlv_agRngRefPosnReaIntk_C "Angle range around reference position in which the camshaft is considered to be in reference position (intake)" VALUE 0x8055482A RB_Val_Ws16 1023.984 kw_q0p0156 -512.0000 511.9844 FORMAT "%8.4" /end CHARACTERISTIC
/begin CHARACTERISTIC GEVlv_agSpErrSimIntk_T "Characteristic line for setpoint-inlet-camphaser error simulation" CURVE 0x80554A3C RB_Curve_S16_S16 1023.984 kw_q0p0156 -512.0000 511.9844 FORMAT "%8.4"
 /begin AXIS_DESCR STD_AXIS NO_INPUT_QUANTITY kw_q0p0156 6 -512.0000 511.9844 FORMAT "%8.4" DEPOSIT ABSOLUTE /end AXIS_DESCR
/end CHARACTERISTIC
/begin CHARACTERISTIC GEVlv_facActIntkAgFildgSyn_M "Map for factor of recursive average filter intake camshaft angle synchronous" MAP 0x8055482C RB_Map_S16S16_U16 0.9999695 fak_uw_b1 0.0000153 0.9999847 FORMAT "%9.7" EXTENDED_LIMITS 0.00 0.9999847
 /begin AXIS_DESCR STD_AXIS Epm_nEng EngN 4 -16384.00 16383.50 FORMAT "%8.2" DEPOSIT ABSOLUTE /end AXIS_DESCR
 /begin AXIS_DESCR STD_AXIS GEVCtl_tOilCylHd Temp_Cels 4 -3549.940 3003.560 FORMAT "%8.3" DEPOSIT ABSOLUTE /end AXIS_DESCR
/end CHARACTERISTIC
/begin CHARACTERISTIC GEVlv_facCorrnShftSpd_T "Factor to correct camshaft shift speed at calculation of extrapolated actual position" CURVE 0x80554860 RB_Curve_U8_U16_Static 1.999969 fak_uw_b2 0.00 1.999969 FORMAT "%8.6"
 /begin AXIS_DESCR STD_AXIS Epm_nEngLRes EngN_LRes 5 0.00 10200. FORMAT "%5.0" DEPOSIT ABSOLUTE /end AXIS_DESCR
/end CHARACTERISTIC
/begin CHARACTERISTIC GEVlv_facJitPT1MaxIntk_C "Maximal value for the jitter factor the noise filter time constant is multiplied with in case of a jittering intake camshaft" VALUE 0x80554870 RB_Val_Ws16 14.99951 fak_q4p883Em4 1.00000 15.99951 FORMAT "%8.5" EXTENDED_LIMITS -16.00000 15.99951 /end CHARACTERISTIC
/begin CHARACTERISTIC GEVlv_facTiSumndJitIntk_T "Summand for the factor the noise filter time constant is multiplied with in case of a jittering intake camshaft" CURVE 0x80554872 RB_Curve_S16_U8_Static 1.992188 fak_ub_b2 0.00 1.992188 FORMAT "%8.6"
 /begin AXIS_DESCR STD_AXIS NO_INPUT_QUANTITY kw_q0p0156 3 -512.0000 511.9844 FORMAT "%8.4" DEPOSIT ABSOLUTE /end AXIS_DESCR
/end CHARACTERISTIC
/begin CHARACTERISTIC GEVlv_facUBattCorrn_T "Correction factor duty cycle cam phase actuator depending on battery voltage" CURVE 0x80554A56 RB_Curve_S16_U8_Static 1.992188 fak_ub_b2 0.00 1.992188 FORMAT "%8.6"
 /begin AXIS_DESCR STD_AXIS BattU_u Volt_Batt 4 -655360.0 655340.0 FORMAT "%8.1" DEPOSIT ABSOLUTE /end AXIS_DESCR
/end CHARACTERISTIC
/begin CHARACTERISTIC GEVlv_flgStrtStopLockPinDiagDfcFinal_C "Parameter to enable or disable the setting of LockPin diagnosis DFCs to final state based on availabilty of start-stop feature." VALUE 0x805547DE RB_Val_Wu8 1.00000000000 B_TRUE 0.00 1.00000000000 FORMAT "%13.11" /end CHARACTERISTIC
/begin CHARACTERISTIC GEVlv_GovrPrmIntkIF_I.agDeactDPartMax_C "Interface class for the intake camshaft governor paramters / Upper threshold until which a change in governor deviation will not trigger calculation of a d-part" VALUE 0x80554C68 RB_Val_Ws16 1023.984 kw_q0p0156 -512.0000 511.9844 FORMAT "%8.4" /end CHARACTERISTIC
/begin CHARACTERISTIC GEVlv_GovrPrmIntkIF_I.agDeactDPartMin_C "Interface class for the intake camshaft governor paramters / Lower threshold until which a change in governor deviation will not trigger calculation of a d-part" VALUE 0x80554C6A RB_Val_Ws16 1023.984 kw_q0p0156 -512.0000 511.9844 FORMAT "%8.4" /end CHARACTERISTIC
/begin CHARACTERISTIC GEVlv_GovrPrmIntkIF_I.agDeactDPartStySt_C "Interface class for the intake camshaft governor paramters / Angle threshold for detection of steady state conditions to wheight the D governor part" VALUE 0x80554C6C RB_Val_Ws16 1023.984 kw_q0p0156 -512.0000 511.9844 FORMAT "%8.4" /end CHARACTERISTIC
/begin CHARACTERISTIC GEVlv_GovrPrmIntkIF_I.agSpChgMaxStopIPart_C "Interface class for the intake camshaft governor paramters / Calibartion inputs to Turn Off Delay Variable." VALUE 0x80554C6E RB_Val_Ws16 1023.984 kw_q0p0156 -512.0000 511.9844 FORMAT "%8.4" /end CHARACTERISTIC
/begin CHARACTERISTIC GEVlv_GovrPrmIntkIF_I.agSpStopGovr_T "Interface class for the intake camshaft governor paramters / Characteristic line for stop governor depends on engine speed" CURVE 0x80554C70 RB_Curve_S16_S16 1023.984 kw_q0p0156 -512.0000 511.9844 FORMAT "%8.4"
 /begin AXIS_DESCR STD_AXIS NO_INPUT_QUANTITY EngN 4 -16384.00 16383.50 FORMAT "%8.2" DEPOSIT ABSOLUTE /end AXIS_DESCR
/end CHARACTERISTIC
/begin CHARACTERISTIC GEVlv_GovrPrmIntkIF_I.agSpStopSlowIPart_C "Interface class for the intake camshaft governor paramters / Angle difference to mechanical boundary below which the slow I-Part is deactivated" VALUE 0x80554C82 RB_Val_Ws16 1023.984 kw_q0p0156 -512.0000 511.9844 FORMAT "%8.4" /end CHARACTERISTIC
/begin CHARACTERISTIC GEVlv_GovrPrmIntkIF_I.facCorGainD_M "Interface class for the intake camshaft governor paramters / Map: correction factor of duty cycle for controller D component" MAP 0x80554C84 RB_Map_S16S16_U16 1.999969 fak_uw_b2 0.00 1.999969 FORMAT "%8.6"
 /begin AXIS_DESCR STD_AXIS GEVlv_GovrPrmIntkIF_I.agDifSpAct kw_q0p0156 9 -512.0000 511.9844 FORMAT "%8.4" DEPOSIT ABSOLUTE /end AXIS_DESCR
 /begin AXIS_DESCR STD_AXIS GEVlv_GovrPrmIntkIF_I.agDifSpActDT1 kw_q0p0156 9 -512.0000 511.9844 FORMAT "%8.4" DEPOSIT ABSOLUTE /end AXIS_DESCR
/end CHARACTERISTIC
/begin CHARACTERISTIC GEVlv_GovrPrmIntkIF_I.facCorGainI_T "Interface class for the intake camshaft governor paramters / Factor for correction of I-Part depending on actual governor deviation" CURVE 0x80554D4E RB_Curve_S16_U16_Static 1.999969 fak_uw_b2 0.00 1.999969 FORMAT "%8.6"
 /begin AXIS_DESCR STD_AXIS GEVlv_GovrPrmIntkIF_I.agDifSpAct kw_q0p0156 9 -512.0000 511.9844 FORMAT "%8.4" DEPOSIT ABSOLUTE /end AXIS_DESCR
/end CHARACTERISTIC
/begin CHARACTERISTIC GEVlv_GovrPrmIntkIF_I.facCorGainP_M "Interface class for the intake camshaft governor paramters / Interface class for the intake camshaft governor paramters Factor for correction of P-Part depending on actual governor deviation and cylinder head oil temperature" MAP 0x80554D74 RB_Map_S16S16_U16 1.999969 fak_uw_b2 0.00 1.999969 FORMAT "%8.6"
 /begin AXIS_DESCR STD_AXIS GEVlv_GovrPrmIntkIF_I.agDifSpAct kw_q0p0156 9 -512.0000 511.9844 FORMAT "%8.4" DEPOSIT ABSOLUTE /end AXIS_DESCR
 /begin AXIS_DESCR STD_AXIS NO_INPUT_QUANTITY Temp_Cels 4 -3549.940 3003.560 FORMAT "%8.3" DEPOSIT ABSOLUTE /end AXIS_DESCR
/end CHARACTERISTIC
/begin CHARACTERISTIC GEVlv_GovrPrmIntkIF_I.facDPartLoLft_GM "Interface class for the intake camshaft governor paramters / Factor for calculation of d-part for low lift" MAP 0x80554DDA RB_MapGroup_U16 99.99847 relKW_q0p0015259 0.00 99.99847 FORMAT "%8.5"
 /begin AXIS_DESCR COM_AXIS Epm_nEng EngN 8 -16384.00 16383.50 FORMAT "%8.2" AXIS_PTS_REF GEVlv_nEng_Ax /end AXIS_DESCR
 /begin AXIS_DESCR COM_AXIS GEVCtl_tOilCylHd Temp_Cels 8 -3549.940 3003.560 FORMAT "%8.3" AXIS_PTS_REF GEVlv_tOilCylHd_Ax /end AXIS_DESCR
/end CHARACTERISTIC
/begin CHARACTERISTIC GEVlv_GovrPrmIntkIF_I.facDPartOilP_T "Interface class for the intake camshaft governor paramters / Factor for D-part of camshaft governor depending on oil pressure" CURVE 0x80554E5A RB_Curve_S16_U16_Static 2.550049 fak_uw_b8 0.00 2.550049 FORMAT "%8.6" EXTENDED_LIMITS 0.00 7.999878
 /begin AXIS_DESCR STD_AXIS NO_INPUT_QUANTITY Pres_hPa 4 -32768.00 32767.00 FORMAT "%8.2" DEPOSIT ABSOLUTE /end AXIS_DESCR
/end CHARACTERISTIC
/begin CHARACTERISTIC GEVlv_GovrPrmIntkIF_I.facDPartSoft_M "Interface class for the intake camshaft governor paramters / Correction of controller part inside soft landing range" MAP 0x80554E6C RB_Map_S16S16_U16 1.999969 fak_uw_b2 0.00 1.999969 FORMAT "%8.6"
 /begin AXIS_DESCR STD_AXIS NO_INPUT_QUANTITY kw_q0p0156 6 -512.0000 511.9844 FORMAT "%8.4" DEPOSIT ABSOLUTE /end AXIS_DESCR
 /begin AXIS_DESCR STD_AXIS NO_INPUT_QUANTITY kw_q0p0156 6 -512.0000 511.9844 FORMAT "%8.4" DEPOSIT ABSOLUTE /end AXIS_DESCR
/end CHARACTERISTIC
/begin CHARACTERISTIC GEVlv_GovrPrmIntkIF_I.facDPartStySt_C "Interface class for the intake camshaft governor paramters / Wheighting the D governor part while steady state condition is fullfilled" VALUE 0x80554ED0 RB_Val_Wu16 1.999969 fak_uw_b2 0.00 1.999969 FORMAT "%8.6" /end CHARACTERISTIC
/begin CHARACTERISTIC GEVlv_GovrPrmIntkIF_I.facDPart_GM "Interface class for the intake camshaft governor paramters / Factor for calculation of d-part" MAP 0x80554ED2 RB_MapGroup_U16 99.99847 relKW_q0p0015259 0.00 99.99847 FORMAT "%8.5"
 /begin AXIS_DESCR COM_AXIS Epm_nEng EngN 8 -16384.00 16383.50 FORMAT "%8.2" AXIS_PTS_REF GEVlv_nEng_Ax /end AXIS_DESCR
 /begin AXIS_DESCR COM_AXIS GEVCtl_tOilCylHd Temp_Cels 8 -3549.940 3003.560 FORMAT "%8.3" AXIS_PTS_REF GEVlv_tOilCylHd_Ax /end AXIS_DESCR
/end CHARACTERISTIC
/begin CHARACTERISTIC GEVlv_GovrPrmIntkIF_I.facFastIPartLoLft_GM "Interface class for the intake camshaft governor paramters / Factor for calculation of fast i-part for low lift" MAP 0x80554F52 RB_MapGroup_U16 99.99847 relKW_q0p0015259 0.00 99.99847 FORMAT "%8.5"
 /begin AXIS_DESCR COM_AXIS Epm_nEng EngN 8 -16384.00 16383.50 FORMAT "%8.2" AXIS_PTS_REF GEVlv_nEng_Ax /end AXIS_DESCR
 /begin AXIS_DESCR COM_AXIS GEVCtl_tOilCylHd Temp_Cels 8 -3549.940 3003.560 FORMAT "%8.3" AXIS_PTS_REF GEVlv_tOilCylHd_Ax /end AXIS_DESCR
/end CHARACTERISTIC
/begin CHARACTERISTIC GEVlv_GovrPrmIntkIF_I.facFastIPartSoft_M "Interface class for the intake camshaft governor paramters / Correction of controller part inside soft landing range" MAP 0x80554FD2 RB_Map_S16S16_U16 1.999969 fak_uw_b2 0.00 1.999969 FORMAT "%8.6"
 /begin AXIS_DESCR STD_AXIS NO_INPUT_QUANTITY kw_q0p0156 6 -512.0000 511.9844 FORMAT "%8.4" DEPOSIT ABSOLUTE /end AXIS_DESCR
 /begin AXIS_DESCR STD_AXIS NO_INPUT_QUANTITY kw_q0p0156 6 -512.0000 511.9844 FORMAT "%8.4" DEPOSIT ABSOLUTE /end AXIS_DESCR
/end CHARACTERISTIC
/begin CHARACTERISTIC GEVlv_GovrPrmIntkIF_I.facFastIPart_GM "Interface class for the intake camshaft governor paramters / Factor for calculation of fast i-part" MAP 0x80555036 RB_MapGroup_U16 99.99847 relKW_q0p0015259 0.00 99.99847 FORMAT "%8.5"
 /begin AXIS_DESCR COM_AXIS Epm_nEng EngN 8 -16384.00 16383.50 FORMAT "%8.2" AXIS_PTS_REF GEVlv_nEng_Ax /end AXIS_DESCR
 /begin AXIS_DESCR COM_AXIS GEVCtl_tOilCylHd Temp_Cels 8 -3549.940 3003.560 FORMAT "%8.3" AXIS_PTS_REF GEVlv_tOilCylHd_Ax /end AXIS_DESCR
/end CHARACTERISTIC
/begin CHARACTERISTIC GEVlv_GovrPrmIntkIF_I.facIPartOilP_T "Interface class for the intake camshaft governor paramters / correction I-part camshaft controller depends on oil pressure" CURVE 0x805550B6 RB_Curve_S16_U8_Static 2.550 fak_uw_q0p01 0.00 2.550 FORMAT "%5.3"
 /begin AXIS_DESCR STD_AXIS NO_INPUT_QUANTITY Pres_hPa 4 -32768.00 32767.00 FORMAT "%8.2" DEPOSIT ABSOLUTE /end AXIS_DESCR
/end CHARACTERISTIC
/begin CHARACTERISTIC GEVlv_GovrPrmIntkIF_I.facPPartLoLft_GM "Interface class for the intake camshaft governor paramters / Factor for calculation of p-part for low lift" MAP 0x805550C4 RB_MapGroup_U16 99.99847 relKW_q0p0015259 0.00 99.99847 FORMAT "%8.5"
 /begin AXIS_DESCR COM_AXIS Epm_nEng EngN 8 -16384.00 16383.50 FORMAT "%8.2" AXIS_PTS_REF GEVlv_nEng_Ax /end AXIS_DESCR
 /begin AXIS_DESCR COM_AXIS GEVCtl_tOilCylHd Temp_Cels 8 -3549.940 3003.560 FORMAT "%8.3" AXIS_PTS_REF GEVlv_tOilCylHd_Ax /end AXIS_DESCR
/end CHARACTERISTIC
/begin CHARACTERISTIC GEVlv_GovrPrmIntkIF_I.facPPartOilP_T "Interface class for the intake camshaft governor paramters / Factor for P-part of camshaft governor depending on oil pressure" CURVE 0x80555144 RB_Curve_S16_U16_Static 2.550049 fak_uw_b8 0.00 2.550049 FORMAT "%8.6" EXTENDED_LIMITS 0.00 7.999878
 /begin AXIS_DESCR STD_AXIS NO_INPUT_QUANTITY Pres_hPa 4 -32768.00 32767.00 FORMAT "%8.2" DEPOSIT ABSOLUTE /end AXIS_DESCR
/end CHARACTERISTIC
/begin CHARACTERISTIC GEVlv_GovrPrmIntkIF_I.facPPartSoft_M "Interface class for the intake camshaft governor paramters / Correction of controller part inside soft landing range" MAP 0x80555156 RB_Map_S16S16_U16 1.999969 fak_uw_b2 0.00 1.999969 FORMAT "%8.6"
 /begin AXIS_DESCR STD_AXIS NO_INPUT_QUANTITY kw_q0p0156 6 -512.0000 511.9844 FORMAT "%8.4" DEPOSIT ABSOLUTE /end AXIS_DESCR
 /begin AXIS_DESCR STD_AXIS NO_INPUT_QUANTITY kw_q0p0156 6 -512.0000 511.9844 FORMAT "%8.4" DEPOSIT ABSOLUTE /end AXIS_DESCR
/end CHARACTERISTIC
/begin CHARACTERISTIC GEVlv_GovrPrmIntkIF_I.facPPart_GM "Interface class for the intake camshaft governor paramters / Factor for calculation of p-part" MAP 0x805551BA RB_MapGroup_U16 99.99847 relKW_q0p0015259 0.00 99.99847 FORMAT "%8.5"
 /begin AXIS_DESCR COM_AXIS Epm_nEng EngN 8 -16384.00 16383.50 FORMAT "%8.2" AXIS_PTS_REF GEVlv_nEng_Ax /end AXIS_DESCR
 /begin AXIS_DESCR COM_AXIS GEVCtl_tOilCylHd Temp_Cels 8 -3549.940 3003.560 FORMAT "%8.3" AXIS_PTS_REF GEVlv_tOilCylHd_Ax /end AXIS_DESCR
/end CHARACTERISTIC
/begin CHARACTERISTIC GEVlv_GovrPrmIntkIF_I.ratDeltaMaxPhaSlowIPart_C "Interface class for the intake camshaft governor paramters / max. delta for difference slow I-part camshaft controller" VALUE 0x8055523A RB_Val_Ws16 399.9939 rel_sw_b200 -200.0000 199.9939 FORMAT "%8.4" /end CHARACTERISTIC
/begin CHARACTERISTIC GEVlv_GovrPrmIntkIF_I.ratPhaFastIPartMax_C "Interface class for the intake camshaft governor paramters / Maximal value for the fast IPart of the camshaft governor" VALUE 0x8055523C RB_Val_Ws32 399.993896484 rel_sw_b200 -200.000000000 199.993896484 FORMAT "%13.9" EXTENDED_LIMITS -13107200.0000 13107199.9939 /end CHARACTERISTIC
/begin CHARACTERISTIC GEVlv_GovrPrmIntkIF_I.ratPhaFastIPartMin_C "Interface class for the intake camshaft governor paramters / Minimal value for the fast IPart of the camshaft governor" VALUE 0x80555240 RB_Val_Ws32 399.993896484 rel_sw_b200 -200.000000000 199.993896484 FORMAT "%13.9" EXTENDED_LIMITS -13107200.0000 13107199.9939 /end CHARACTERISTIC
/begin CHARACTERISTIC GEVlv_GovrPrmIntkIF_I.ratPhaMaxActvIPart_GM "Interface class for the intake camshaft governor paramters / Group map for Max active IPart" MAP 0x80555244 RB_MapGroup_S16 399.9939 rel_sw_b200 -200.0000 199.9939 FORMAT "%8.4"
 /begin AXIS_DESCR COM_AXIS Epm_nEng EngN 8 -16384.00 16383.50 FORMAT "%8.2" AXIS_PTS_REF GEVlv_nEng_Ax /end AXIS_DESCR
 /begin AXIS_DESCR COM_AXIS GEVCtl_tOilCylHd Temp_Cels 8 -3549.940 3003.560 FORMAT "%8.3" AXIS_PTS_REF GEVlv_tOilCylHd_Ax /end AXIS_DESCR
/end CHARACTERISTIC
/begin CHARACTERISTIC GEVlv_GovrPrmIntkIF_I.ratPhaMax_C "Interface class for the intake camshaft governor paramters / Maximum duty cycle" VALUE 0x805552C4 RB_Val_Ws16 199.9939 rel_sw_b200 0.00 199.9939 FORMAT "%8.4" EXTENDED_LIMITS -200.0000 199.9939 /end CHARACTERISTIC
/begin CHARACTERISTIC GEVlv_GovrPrmIntkIF_I.ratPhaMinActvIPart_GM "Interface class for the intake camshaft governor paramters / Group map for min active IPart" MAP 0x805552C6 RB_MapGroup_S16 399.9939 rel_sw_b200 -200.0000 199.9939 FORMAT "%8.4"
 /begin AXIS_DESCR COM_AXIS Epm_nEng EngN 8 -16384.00 16383.50 FORMAT "%8.2" AXIS_PTS_REF GEVlv_nEng_Ax /end AXIS_DESCR
 /begin AXIS_DESCR COM_AXIS GEVCtl_tOilCylHd Temp_Cels 8 -3549.940 3003.560 FORMAT "%8.3" AXIS_PTS_REF GEVlv_tOilCylHd_Ax /end AXIS_DESCR
/end CHARACTERISTIC
/begin CHARACTERISTIC GEVlv_GovrPrmIntkIF_I.ratPhaMin_C "Interface class for the intake camshaft governor paramters / Minimum duty cycle for camshaft actuation" VALUE 0x80555346 RB_Val_Ws16 199.9939 rel_sw_b200 0.00 199.9939 FORMAT "%8.4" EXTENDED_LIMITS -200.0000 199.9939 /end CHARACTERISTIC
/begin CHARACTERISTIC GEVlv_GovrPrmIntkIF_I.ratPhaOutLockPos_C "Interface class for the intake camshaft governor paramters / Camshaft unlocking duty cycle" VALUE 0x80555348 RB_Val_Ws16 199.9939 rel_sw_b200 0.00 199.9939 FORMAT "%8.4" EXTENDED_LIMITS -200.0000 199.9939 /end CHARACTERISTIC
/begin CHARACTERISTIC GEVlv_GovrPrmIntkIF_I.ratPhaProtn_C "Interface class for the intake camshaft governor paramters / Maximum duty cycle during limitation for component protection" VALUE 0x8055534A RB_Val_Ws16 199.9939 rel_sw_b200 0.00 199.9939 FORMAT "%8.4" EXTENDED_LIMITS -200.0000 199.9939 /end CHARACTERISTIC
/begin CHARACTERISTIC GEVlv_GovrPrmIntkIF_I.ratPhaSlowIPartMax_C "Interface class for the intake camshaft governor paramters / Maximal value for the slow IPart of the camshaft governor" VALUE 0x8055534C RB_Val_Ws32 399.993896484 rel_sw_b200 -200.000000000 199.993896484 FORMAT "%13.9" EXTENDED_LIMITS -13107200.0000 13107199.9939 /end CHARACTERISTIC
/begin CHARACTERISTIC GEVlv_GovrPrmIntkIF_I.ratPhaSlowIPartMin_C "Interface class for the intake camshaft governor paramters / Minimal value for the slow IPart of the camshaft governor" VALUE 0x80555350 RB_Val_Ws32 399.993896484 rel_sw_b200 -200.000000000 199.993896484 FORMAT "%13.9" EXTENDED_LIMITS -13107200.0000 13107199.9939 /end CHARACTERISTIC
/begin CHARACTERISTIC GEVlv_GovrPrmIntkIF_I.ratPhaToLockPos_C "Interface class for the intake camshaft governor paramters / Camshaft locking duty cycle" VALUE 0x80555354 RB_Val_Ws16 199.9939 rel_sw_b200 0.00 199.9939 FORMAT "%8.4" EXTENDED_LIMITS -200.0000 199.9939 /end CHARACTERISTIC
/begin CHARACTERISTIC GEVlv_GovrPrmIntkIF_I.tiDeactDPartStySt_C "Interface class for the intake camshaft governor paramters / Debounce time for detection of steady state conditions to wheight the D governor part" VALUE 0x80555356 RB_Val_Wu16 655.3500 t_q0p01 0.00 655.3500 FORMAT "%8.4" /end CHARACTERISTIC
/begin CHARACTERISTIC GEVlv_GovrPrmIntkIF_I.tiEnaFastIPart_M "Interface class for the intake camshaft governor paramters / Time constant map" MAP 0x80555358 RB_Map_S16S16_U16 655.3500 t_q0p01 0.00 655.3500 FORMAT "%8.4"
 /begin AXIS_DESCR STD_AXIS GEVlv_GovrPrmIntkIF_I.agDifSpAct kw_q0p0156 7 -512.0000 511.9844 FORMAT "%8.4" DEPOSIT ABSOLUTE /end AXIS_DESCR
 /begin AXIS_DESCR STD_AXIS NO_INPUT_QUANTITY Temp_Cels 5 -3549.940 3003.560 FORMAT "%8.3" DEPOSIT ABSOLUTE /end AXIS_DESCR
/end CHARACTERISTIC
/begin CHARACTERISTIC GEVlv_GovrPrmIntkIF_I.tiPhaProtn_C "Interface class for the intake camshaft governor paramters / Time constant for output max. duty cycle camshaft controller" VALUE 0x805553BA RB_Val_Wu16 655.3500 t_q0p01 0.00 655.3500 FORMAT "%8.4" /end CHARACTERISTIC
/begin CHARACTERISTIC GEVlv_GovrPrmIntkIF_I.tiPhaSlowIPartLoLft_C "Interface class for the intake camshaft governor paramters / Time constant slow I-part of camshaft controller for low cam profile" VALUE 0x805553BC RB_Val_Wu16 655.34999985 zk10msxs_uw_b655 0.01000015 655.36000000 FORMAT "%12.8" EXTENDED_LIMITS 0.010000152590 655.36000000 /end CHARACTERISTIC
/begin CHARACTERISTIC GEVlv_GovrPrmIntkIF_I.tiPhaSlowIPart_C "Interface class for the intake camshaft governor paramters / Time constant slow I-part of camshaft controller" VALUE 0x805553BE RB_Val_Wu16 655.34999985 zk10msxs_uw_b655 0.01000015 655.36000000 FORMAT "%12.8" EXTENDED_LIMITS 0.010000152590 655.36000000 /end CHARACTERISTIC
/begin CHARACTERISTIC GEVlv_nEngMaxClng_C "Engine speed threshold above which the OCV cleaning cannot be activated anymore" VALUE 0x80555400 RB_Val_Ws16 32767.50 EngN -16384.00 16383.50 FORMAT "%8.2" /end CHARACTERISTIC
/begin AXIS_PTS GEVlv_nEng_Ax "engine speed axis points governor cam phaser" 0x80554A64 Epm_nEng RB_Axis_S16 32767.50 EngN 8 -16384.00 16383.50 FORMAT "%8.2" DEPOSIT ABSOLUTE /end AXIS_PTS
/begin CHARACTERISTIC GEVlv_nMaxPhaCsersDiagIntk_T "Maximum engine speed for csers diagnosis of the intake camshaft" CURVE 0x805549B6 RB_Curve_S16_S16 32767.50 EngN -16384.00 16383.50 FORMAT "%8.2"
 /begin AXIS_DESCR STD_AXIS GEVCtl_tOilCylHd Temp_Cels 6 -3549.940 3003.560 FORMAT "%8.3" DEPOSIT ABSOLUTE /end AXIS_DESCR
/end CHARACTERISTIC
/begin CHARACTERISTIC GEVlv_nMaxPhaDiag_C "maximum engine speed for diagnosis camshaft control" VALUE 0x805549D0 RB_Val_Ws16 32767.50 EngN -16384.00 16383.50 FORMAT "%8.2" /end CHARACTERISTIC
/begin CHARACTERISTIC GEVlv_nMaxPhaExtrpn_C "Maximum engine speed for angle extrapolation" VALUE 0x8055487E RB_Val_Ws16 32767.50 EngN -16384.00 16383.50 FORMAT "%8.2" /end CHARACTERISTIC
/begin CHARACTERISTIC GEVlv_nMaxPosnFil_C "engine speed threshold for deactivation of actual angle filter" VALUE 0x80554880 RB_Val_Wu16 2621400. EngN_LRes 0.00 2621400. FORMAT "%8.0" /end CHARACTERISTIC
/begin CHARACTERISTIC GEVlv_nMinForValRes_C "Minimum engine speed threshold for error respectively healing result (DFC_GEVlvLockPinDiagxxxBx)" VALUE 0x805547DF RB_Val_Wu8 10200. EngN_LRes 0.00 10200. FORMAT "%5.0" /end CHARACTERISTIC
/begin CHARACTERISTIC GEVlv_nMinPhaCsersDiagIntk_T "Minimum engine speed for csers diagnosis of the intake camshaft" CURVE 0x805549D2 RB_Curve_S16_S16 32767.50 EngN -16384.00 16383.50 FORMAT "%8.2"
 /begin AXIS_DESCR STD_AXIS GEVCtl_tOilCylHd Temp_Cels 6 -3549.940 3003.560 FORMAT "%8.3" DEPOSIT ABSOLUTE /end AXIS_DESCR
/end CHARACTERISTIC
/begin CHARACTERISTIC GEVlv_nMinPhaDiagIntk_CUR "Characteristic line minimum engine speed for diagnosis inlet camshaft control" CURVE 0x805549EC RB_Curve_S16_S16 32767.50 EngN -16384.00 16383.50 FORMAT "%8.2"
 /begin AXIS_DESCR STD_AXIS GEVCtl_tOilCylHd Temp_Cels 6 -3549.940 3003.560 FORMAT "%8.3" DEPOSIT ABSOLUTE /end AXIS_DESCR
/end CHARACTERISTIC
/begin CHARACTERISTIC GEVlv_nMinPhaExtrpnSynFildHys_C "Hysteresis for minimal engine speed for angle extrapolation" VALUE 0x80554882 RB_Val_Ws16 32767.50 EngN -16384.00 16383.50 FORMAT "%8.2" /end CHARACTERISTIC
/begin CHARACTERISTIC GEVlv_nMinPhaExtrpnSynFild_C "Minimal engine speed for angle extrapolation" VALUE 0x80554884 RB_Val_Ws16 32767.50 EngN -16384.00 16383.50 FORMAT "%8.2" /end CHARACTERISTIC
/begin CHARACTERISTIC GEVlv_nrAgForOkResMin_C "minimal necessary number of camshaft angle samples after engine start to be able to set a go test result (sufficient number for detect a faulty system)" VALUE 0x805547E0 RB_Val_Wu8 255.0 dez 0.00 255.0 FORMAT "%5.1" /end CHARACTERISTIC
/begin CHARACTERISTIC GEVlv_nrDebErrIntk_C "Max. value for error debouncing for intake camshaft" VALUE 0x8055492A RB_Val_Wu8 255.0 dez 0.00 255.0 FORMAT "%5.1" /end CHARACTERISTIC
/begin CHARACTERISTIC GEVlv_nrExcddAgThd_C "number of alloweded overshoots for getting a go test result" VALUE 0x805547E1 RB_Val_Wu8 255.0 dez 0.00 255.0 FORMAT "%5.1" /end CHARACTERISTIC
/begin CHARACTERISTIC GEVlv_nrPsblInvldAg_C "number of invalid measured camshaft values while engine start, which will be cut-off (caused by sensor)" VALUE 0x805547E2 RB_Val_Wu8 255.0 dez 0.00 255.0 FORMAT "%5.1" /end CHARACTERISTIC
/begin CHARACTERISTIC GEVlv_nrTstPls_C "Maximum number of test impulses for diagnosis" VALUE 0x805553F4 RB_Val_Wu32 4294967295.00 OneToOne 0.00 4294967295.00 FORMAT "%13.2" /end CHARACTERISTIC
/begin AXIS_PTS GEVlv_pOil_Ax "Group axis for Oil pressure" 0x80554A76 OilP_p RB_Axis_S16 65535.00 Pres_hPa 8 -32768.00 32767.00 FORMAT "%8.2" DEPOSIT ABSOLUTE /end AXIS_PTS
/begin CHARACTERISTIC GEVlv_ratOffsCorrnHoldDutyIntkB1_M "Correction offset for the hold duty cycle based on the engine speed and oil temperature for the intake bank 1" MAP 0x80554A88 RB_Map_S16S16_U16 100.0000 rel_uw_b200 0.00 100.0000 FORMAT "%8.4" EXTENDED_LIMITS 0.00 199.9969
 /begin AXIS_DESCR STD_AXIS Epm_nEng EngN 8 -16384.00 16383.50 FORMAT "%8.2" DEPOSIT ABSOLUTE /end AXIS_DESCR
 /begin AXIS_DESCR STD_AXIS GEVCtl_tOilCylHd Temp_Cels 8 -3549.940 3003.560 FORMAT "%8.3" DEPOSIT ABSOLUTE /end AXIS_DESCR
/end CHARACTERISTIC
/begin CHARACTERISTIC GEVlv_ratPhaAbnormAgIntk_C "Duty cycle active when camshaft angle is outside normal range" VALUE 0x80555402 RB_Val_Ws16 199.9969 rel_sw_b100 -100.0000 99.9969 FORMAT "%8.4" EXTENDED_LIMITS -100.0000 99.99695 /end CHARACTERISTIC
/begin CHARACTERISTIC GEVlv_ratPhaAdjHoldIntkB1_GM "Group map for hold duty cycle for intake camshaft bank1" MAP 0x80554B2C RB_MapGroup_S16 100.0000 rel_sw_b200 0.00 100.0000 FORMAT "%8.4" EXTENDED_LIMITS -200.0000 199.9939
 /begin AXIS_DESCR COM_AXIS GEVCtl_tOilCylHd Temp_Cels 8 -3549.940 3003.560 FORMAT "%8.3" AXIS_PTS_REF GEVlv_tOilCylHd_Ax /end AXIS_DESCR
 /begin AXIS_DESCR COM_AXIS OilP_p Pres_hPa 8 -32768.00 32767.00 FORMAT "%8.2" AXIS_PTS_REF GEVlv_pOil_Ax /end AXIS_DESCR
/end CHARACTERISTIC
/begin CHARACTERISTIC GEVlv_ratPhaAdjHoldLoLftIntkB1_GM "Group map for hold duty cycle for low lift intake camshaft bank1" MAP 0x80554BAC RB_MapGroup_S16 100.0000 rel_sw_b200 0.00 100.0000 FORMAT "%8.4" EXTENDED_LIMITS -200.0000 199.9939
 /begin AXIS_DESCR COM_AXIS GEVCtl_tOilCylHd Temp_Cels 8 -3549.940 3003.560 FORMAT "%8.3" AXIS_PTS_REF GEVlv_tOilCylHd_Ax /end AXIS_DESCR
 /begin AXIS_DESCR COM_AXIS OilP_p Pres_hPa 8 -32768.00 32767.00 FORMAT "%8.2" AXIS_PTS_REF GEVlv_pOil_Ax /end AXIS_DESCR
/end CHARACTERISTIC
/begin CHARACTERISTIC GEVlv_ratPhaClngIntkB1Hi_C "Camshaft phasing governor duty cycle intake bank1 higher threshold" VALUE 0x80554C2C RB_Val_Ws16 99.99695 rel_sw_b100 0.00 99.99695 FORMAT "%8.5" EXTENDED_LIMITS -100.0000 99.99695 /end CHARACTERISTIC
/begin CHARACTERISTIC GEVlv_ratPhaClngIntkB1Lo_C "Low duty cycle value of camshaft Cleaning intake" VALUE 0x80554C2E RB_Val_Ws16 99.99695 rel_sw_b100 0.00 99.99695 FORMAT "%8.5" EXTENDED_LIMITS -100.0000 99.99695 /end CHARACTERISTIC
/begin CHARACTERISTIC GEVlv_ratPhaRmpSlopCl_C "Duty cycle to define ramp slope at cleaning functionality" VALUE 0x80554C30 RB_Val_Ws16 199.9939 rel_q0p0061 0.00 199.9939 FORMAT "%8.4" EXTENDED_LIMITS -200.0000 199.9939 /end CHARACTERISTIC
/begin CHARACTERISTIC GEVlv_ratPhaTqMinIntk_C "Duty cycle for oil control valve cleaning" VALUE 0x80555404 RB_Val_Ws16 199.9969 rel_sw_b100 -100.0000 99.9969 FORMAT "%8.4" EXTENDED_LIMITS -100.0000 99.99695 /end CHARACTERISTIC
/begin CHARACTERISTIC GEVlv_ratSpclAdpnReqIntk_C "Duty cycle to distinguish between target error and offset error" VALUE 0x80555406 RB_Val_Ws16 199.9969 rel_sw_b100 -100.0000 99.9969 FORMAT "%8.4" EXTENDED_LIMITS -100.0000 99.99695 /end CHARACTERISTIC
/begin CHARACTERISTIC GEVlv_stActAgFiltIntk_C "Configuration label for the intake camshaft actual angle filter" VALUE 0x80554886 RB_Val_Wu16 65535.00 OneToOne 0.00 65535.00 FORMAT "%8.2" /end CHARACTERISTIC
/begin CHARACTERISTIC GEVlv_stActPosnExtrpn_C "Codeword extrapolation of actual positions cam phasing" VALUE 0x80554888 RB_Val_Wu8 255.0 dez 0.00 255.0 FORMAT "%5.1" /end CHARACTERISTIC
/begin CHARACTERISTIC GEVlv_stAdapErrSim_C "Codeword to avoid prohibition of fine adaption while camshaft controller is in error simulation" VALUE 0x80554C32 RB_Val_Wu8 255.0 OneToOne 0.00 255.0 FORMAT "%5.1" /end CHARACTERISTIC
/begin CHARACTERISTIC GEVlv_stCfgGovr_C "Code word to select functionality inside camshaft governor" VALUE 0x80554C33 RB_Val_Wu8 255.0 OneToOne 0.00 255.0 FORMAT "%5.1" /end CHARACTERISTIC
/begin CHARACTERISTIC GEVlv_stPhaCsersDiag_C "Status: Bit coded feature selection in function GEVlv_PhaCsersDiag" VALUE 0x805548E0 RB_Val_Wu8 255.0 dez 0.00 255.0 FORMAT "%5.1" /end CHARACTERISTIC
/begin CHARACTERISTIC GEVlv_stPhaDiagEna_C "Codeword for conditional camshaft diagnosis enabling" VALUE 0x80554A06 RB_Val_Wu16 65535.00 OneToOne 0.00 65535.00 FORMAT "%8.2" /end CHARACTERISTIC
/begin CHARACTERISTIC GEVlv_stPhaDiag_C "codeword for the FC GEVlv_PhaDiag" VALUE 0x8055492B RB_Val_Wu8 255.0 OneToOne 0.00 255.0 FORMAT "%5.1" /end CHARACTERISTIC
/begin CHARACTERISTIC GEVlv_stPhaErrSim_C "Code word to activate error simulation cam phase actuators by governor" VALUE 0x80554C34 RB_Val_Wu8 255.0 OneToOne 0.00 255.0 FORMAT "%5.1" /end CHARACTERISTIC
/begin CHARACTERISTIC GEVlv_stPhaGovrAltv12_C "CodeWord for Camshaft phasing Governor for Alternative 12.x.x" VALUE 0x80554C35 RB_Val_Wu8 255.0 OneToOne 0.00 255.0 FORMAT "%5.1" /end CHARACTERISTIC
/begin CHARACTERISTIC GEVlv_tiAbnormAgPlsIntk_C "Duration of duty cycle pulse triggered when camshaft leaves normal control range" VALUE 0x80555408 RB_Val_Wu8 2.550 t_q0p01 0.00 2.550 FORMAT "%5.3" /end CHARACTERISTIC
/begin CHARACTERISTIC GEVlv_tiAbortLockPinDiag_C "Delay time after end of start to dissable diagnosis camshaft control DNWVPx" VALUE 0x805547E4 RB_Val_Wu16 6553.500 t_q0p1 0.00 6553.500 FORMAT "%8.3" /end CHARACTERISTIC
/begin CHARACTERISTIC GEVlv_tiAftEngStop_C "minimal switch off time for enabling lockingpin diagnosis in next engine start (engine stall detection)" VALUE 0x805547E6 RB_Val_Wu8 25.50 t_q0p1 0.00 25.50 FORMAT "%5.2" /end CHARACTERISTIC
/begin CHARACTERISTIC GEVlv_tiAgFilPT1Intk_T "Noise filter time constant for the actual filtered intake camshaft angle" CURVE 0x8055488A RB_Curve_S16_U16_Static 655.3500 t_q0p01 0.00 655.3500 FORMAT "%8.4"
 /begin AXIS_DESCR STD_AXIS NO_INPUT_QUANTITY kw_q0p0156 5 -512.0000 511.9844 FORMAT "%8.4" DEPOSIT ABSOLUTE /end AXIS_DESCR
/end CHARACTERISTIC
/begin CHARACTERISTIC GEVlv_tiBtwElecFlt_C "Time between two test pulses during electrical fault" VALUE 0x805553F8 RB_Val_Ws16 655350.0 Time_ms -327680.0 327670.0 FORMAT "%8.1" /end CHARACTERISTIC
/begin CHARACTERISTIC GEVlv_tiBtwOTFlt_C "Time between two test pulses during overtemperature fault" VALUE 0x805553FA RB_Val_Ws16 655.3500 Time_s -327.6800 327.6700 FORMAT "%8.4" /end CHARACTERISTIC
/begin CHARACTERISTIC GEVlv_tiClngMinTqActv_C "Duration of duty cycle pulse triggered when valve cleaning is requested" VALUE 0x80555409 RB_Val_Wu8 2.550 t_q0p01 0.00 2.550 FORMAT "%5.3" /end CHARACTERISTIC
/begin CHARACTERISTIC GEVlv_tiCsersSpDeIntk_C "Time constant for integratingof csers setpoint for error distinction" VALUE 0x805548E2 RB_Val_Wu16 2.540000 t_q0p01 0.010000 2.550000 FORMAT "%8.6" EXTENDED_LIMITS 0.00 655.3500 /end CHARACTERISTIC
/begin CHARACTERISTIC GEVlv_tiDebAbnormAgIntk_C "Time the camshaft angle has to be outside normal control range before countermeasures are triggered" VALUE 0x8055540A RB_Val_Wu8 2.550 t_q0p01 0.00 2.550 FORMAT "%5.3" /end CHARACTERISTIC
/begin CHARACTERISTIC GEVlv_tiDebPhaCsersIntk_C "Debounce time of a fault respectively healing result (intake camshaft during CSERS)" VALUE 0x805548E4 RB_Val_Wu16 12.50000 t_q0p01 0.00 12.50000 FORMAT "%8.5" EXTENDED_LIMITS 0.00 655.3500 /end CHARACTERISTIC
/begin CHARACTERISTIC GEVlv_tiDiagEnaAftClng_C "Time delay until diagnosis is reenabled again after cam cleaning function was active" VALUE 0x80554A08 RB_Val_Wu16 655.3500 Time_s 0.00 655.3500 FORMAT "%8.4" /end CHARACTERISTIC
/begin CHARACTERISTIC GEVlv_tiDlyRstPhaDiagEnaIntkSpstB1_C "Time delay for reset of enable condition diagnosis camshaft actuator intake at engine stop (Start-Stop) bank 1" VALUE 0x80554A0A RB_Val_Wu16 3276.750 t_q0p05 0.00 3276.750 FORMAT "%8.3" /end CHARACTERISTIC
/begin CHARACTERISTIC GEVlv_tiFilAgSpCsersIntk_C "Time constant for filtering of csers setpoint for angle dynamic deactivation" VALUE 0x805548E6 RB_Val_Wu16 2.540000 t_q0p01 0.010000 2.550000 FORMAT "%8.6" EXTENDED_LIMITS 0.00 655.3500 /end CHARACTERISTIC
/begin CHARACTERISTIC GEVlv_tiHoldDutyUnlckCtrlIntk_T "Curve for time duration of hold duty cycle for pin unlock control for intake camshaft" CURVE 0x80554C36 RB_Curve_S16_U16_Static 655.3500 t_q0p01 0.00 655.3500 FORMAT "%8.4"
 /begin AXIS_DESCR STD_AXIS GEVCtl_tOilCylHd Temp_Cels 5 -3549.940 3003.560 FORMAT "%8.3" DEPOSIT ABSOLUTE /end AXIS_DESCR
/end CHARACTERISTIC
/begin CHARACTERISTIC GEVlv_tiJitActvMinIntk_C "Delay time for deactivation of the intake camshaft jitter filter after the difference between filtered and unfiltered angle fell below the activation threshold" VALUE 0x805548A0 RB_Val_Wu16 655.3500 t_q0p01 0.00 655.3500 FORMAT "%8.4" /end CHARACTERISTIC
/begin CHARACTERISTIC GEVlv_tiJitEnaIntk_M "Time the intake camshaft jitter filter is active after the camshaft adjustment has been released for the first time in a driving cycle" MAP 0x805548A2 RB_Map_S16U8_U16 655.3500 t_q0p01 0.00 655.3500 FORMAT "%8.4"
 /begin AXIS_DESCR STD_AXIS GEVCtl_tOilCylHd Temp_Cels 5 -3549.940 3003.560 FORMAT "%8.3" DEPOSIT ABSOLUTE /end AXIS_DESCR
 /begin AXIS_DESCR STD_AXIS Epm_nEngLRes EngN_LRes 4 0.00 10200. FORMAT "%5.0" DEPOSIT ABSOLUTE /end AXIS_DESCR
/end CHARACTERISTIC
/begin CHARACTERISTIC GEVlv_tiMinEngOffLockPinDiagEna_T "Minimum engine off time for a new test of locking at startup" CURVE 0x805547E8 RB_Curve_S16_S32_Static 4294967295.00 Time_sec_q1_COMPU -2147483648.00 2147483647.00 FORMAT "%13.2"
 /begin AXIS_DESCR STD_AXIS GEVCtl_tOilCylHd Temp_Cels 7 -3549.940 3003.560 FORMAT "%8.3" DEPOSIT ABSOLUTE /end AXIS_DESCR
/end CHARACTERISTIC
/begin CHARACTERISTIC GEVlv_tiMonCycPhaDiagIntk_M "Map for Duration monitoring cycle diagnosis phase actuator intake" MAP 0x8055492C RB_Map_S16S16_U8 12.75 t_q0p05 0.00 12.75 FORMAT "%5.2"
 /begin AXIS_DESCR STD_AXIS Epm_nEng EngN 4 -16384.00 16383.50 FORMAT "%8.2" DEPOSIT ABSOLUTE /end AXIS_DESCR
 /begin AXIS_DESCR STD_AXIS GEVCtl_tOilCylHd Temp_Cels 5 -3549.940 3003.560 FORMAT "%8.3" DEPOSIT ABSOLUTE /end AXIS_DESCR
/end CHARACTERISTIC
/begin CHARACTERISTIC GEVlv_tiPerdPwm_MAP "PWM period for camshaft adjustment" MAP 0x805553C0 RB_Map_S16S16_U16 65535.00 t_us_q1 0.00 65535.00 FORMAT "%8.2"
 /begin AXIS_DESCR STD_AXIS Epm_nEng EngN 4 -16384.00 16383.50 FORMAT "%8.2" DEPOSIT ABSOLUTE /end AXIS_DESCR
 /begin AXIS_DESCR STD_AXIS GEVCtl_tOilCylHd Temp_Cels 4 -3549.940 3003.560 FORMAT "%8.3" DEPOSIT ABSOLUTE /end AXIS_DESCR
/end CHARACTERISTIC
/begin CHARACTERISTIC GEVlv_tiPhaErrSimAdvIntk_C "Time constant setpoint filter during error simulation intake for advanced shifting" VALUE 0x80554C4C RB_Val_Wu16 655.34999985 zk10msxs_uw_b655 0.01000015 655.36000000 FORMAT "%12.8" EXTENDED_LIMITS 0.010000152590 655.36000000 /end CHARACTERISTIC
/begin CHARACTERISTIC GEVlv_tiPhaErrSimRetIntk_C "Time constant setpoint filter during error simulation intake for retarded shifting" VALUE 0x80554C4E RB_Val_Wu16 655.34999985 zk10msxs_uw_b655 0.01000015 655.36000000 FORMAT "%12.8" EXTENDED_LIMITS 0.010000152590 655.36000000 /end CHARACTERISTIC
/begin CHARACTERISTIC GEVlv_tiReaSpThdPhaDiagIntk_M "Allowed time for reaching setpoint threshold diagnosis phase actuator intake (MAP)" MAP 0x80554956 RB_Map_S16S16_U8 12.75 t_q0p05 0.00 12.75 FORMAT "%5.2"
 /begin AXIS_DESCR STD_AXIS Epm_nEng EngN 4 -16384.00 16383.50 FORMAT "%8.2" DEPOSIT ABSOLUTE /end AXIS_DESCR
 /begin AXIS_DESCR STD_AXIS GEVCtl_tOilCylHd Temp_Cels 5 -3549.940 3003.560 FORMAT "%8.3" DEPOSIT ABSOLUTE /end AXIS_DESCR
/end CHARACTERISTIC
/begin CHARACTERISTIC GEVlv_tiRepMonCycPhaDiagIntk_C "Time duration for retriggering a new monitoring cycle in case of a permanent deviation" VALUE 0x80554980 RB_Val_Wu8 12.75 t_q0p05 0.00 12.75 FORMAT "%5.2" /end CHARACTERISTIC
/begin CHARACTERISTIC GEVlv_tiStrtEndTilPhaDiagEnaIntk_CUR "Characteristic delay time after end of start to enable diagnosis inlet camshaft" CURVE 0x80554A0C RB_Curve_S16_U16_Static 3276.750 t_q0p05 0.00 3276.750 FORMAT "%8.3"
 /begin AXIS_DESCR STD_AXIS CEngDsT_tStrt Temp_Cels 6 -3549.940 3003.560 FORMAT "%8.3" DEPOSIT ABSOLUTE /end AXIS_DESCR
/end CHARACTERISTIC
/begin AXIS_PTS GEVlv_tOilCylHd_Ax "oil temperature axis points governor cam phaser" 0x80554C50 GEVCtl_tOilCylHd RB_Axis_S16 6553.500 Temp_Cels 8 -3549.940 3003.560 FORMAT "%8.3" DEPOSIT ABSOLUTE /end AXIS_PTS
/begin CHARACTERISTIC GEVlv_tOilMaxPhaCsersDiagEnaIntk_C "Maximum oil temperature for csers diagnosis of the intake camshaft" VALUE 0x80554A26 RB_Val_Ws16 6553.500 Temp_Cels -3549.940 3003.560 FORMAT "%8.3" /end CHARACTERISTIC
/begin CHARACTERISTIC GEVlv_tOilMaxPhaDiagEnaIntk_C "Max oil temperature to enable diagnosis inlet camshaft control" VALUE 0x80554A28 RB_Val_Ws16 6553.500 Temp_Cels -3549.940 3003.560 FORMAT "%8.3" /end CHARACTERISTIC
/begin CHARACTERISTIC GEVlv_tOilMinPhaCsersDiagEnaIntk_C "Minimum oil temperature for csers diagnosis of the intake camshaft" VALUE 0x80554A2A RB_Val_Ws16 6553.500 Temp_Cels -3549.940 3003.560 FORMAT "%8.3" /end CHARACTERISTIC
/begin CHARACTERISTIC GEVlv_tOilMinPhaDiagEnaIntk_C "Min oil temperature to enable diagnosis inlet camshaft control" VALUE 0x80554A2C RB_Val_Ws16 6553.500 Temp_Cels -3549.940 3003.560 FORMAT "%8.3" /end CHARACTERISTIC
/begin CHARACTERISTIC GEVlv_tOilMinPhaDiagEnaOutl_C "Min oil temperature to enable diagnosis outlet camshaft control" VALUE 0x80554A2E RB_Val_Ws16 6553.500 Temp_Cels -3549.940 3003.560 FORMAT "%8.3" /end CHARACTERISTIC
/begin CHARACTERISTIC GEVlv_tOilMinSlowRespEnaIntk_C "Minimum oil temperature for slow response diagnosis of the intake camshaft" VALUE 0x80554A30 RB_Val_Ws16 6553.500 Temp_Cels -3549.940 3003.560 FORMAT "%8.3" /end CHARACTERISTIC
/begin CHARACTERISTIC GEVlv_tOilMinSlowRespEnaOutl_C "Minimum oil temperature for slow response diagnosis of the outlet camshaft" VALUE 0x80554A32 RB_Val_Ws16 6553.500 Temp_Cels -3549.940 3003.560 FORMAT "%8.3" /end CHARACTERISTIC
/begin CHARACTERISTIC GEVlv_tOilMinTarErrEnaIntk_C "Minimum oil temperature for target error diagnosis of the intake camshaft" VALUE 0x80554A34 RB_Val_Ws16 6553.500 Temp_Cels -3549.940 3003.560 FORMAT "%8.3" /end CHARACTERISTIC
/begin CHARACTERISTIC GEVlv_tOilMinTarErrEnaOutl_C "Minimum oil temperature for target error diagnosis of the outlet camshaft" VALUE 0x80554A36 RB_Val_Ws16 6553.500 Temp_Cels -3549.940 3003.560 FORMAT "%8.3" /end CHARACTERISTIC
/begin CHARACTERISTIC GEVlv_uBattMinDiag_C "Minimal Vvoltage for camshaft actuator diagnosis" VALUE 0x80554A38 RB_Val_Ws16 1310700. Volt_Batt -655360.0 655340.0 FORMAT "%8.1" /end CHARACTERISTIC
/begin CHARACTERISTIC KLFETHFQES "Curve: Filtered ethanol sensor signal frequency into ethanol content interpolation factor" CURVE 0x805556B2 RB_Curve_U16_U16 1.000000 fak_uw_b2 0.00 1.000000 FORMAT "%8.6" EXTENDED_LIMITS 0.00 1.999969
 /begin AXIS_DESCR STD_AXIS fqethsf_w_msg freq_q0p01 12 0.00 655.3500 FORMAT "%8.4" DEPOSIT ABSOLUTE /end AXIS_DESCR
/end CHARACTERISTIC
/begin CHARACTERISTIC NMMNDSKVS "max threshold for engine speed stuck check" VALUE 0x80555420 RB_Val_Wu8 10200. nmot_ub_q40 0.00 10200. FORMAT "%5.0" /end CHARACTERISTIC
/begin CHARACTERISTIC NMMXDSKVS "min threshold for engine speed stuck check" VALUE 0x80555421 RB_Val_Wu8 10200. nmot_ub_q40 0.00 10200. FORMAT "%5.0" /end CHARACTERISTIC
/begin CHARACTERISTIC PHAOCVINTKB1_CTL_ATS_ATS.LimitTypeMsk_C "Actuator test PHAOCVINTKB1_CTL_ATS_ATS / Tester demand monitoring enable mask for actuators" VALUE 0x8058AE7C Val_Wu8 255.0 OneToOne 0.00 255.0 FORMAT "%5.1" /end CHARACTERISTIC
/begin CHARACTERISTIC PHAOCVINTKB1_CTL_ATS_ATS.CnvNorm_C "Actuator test PHAOCVINTKB1_CTL_ATS_ATS / Conversion norm used for conversion to/from internal scaling" VALUE 0x8058AE7D Val_Wu8 255.0 OneToOne 0.00 255.0 FORMAT "%5.1" /end CHARACTERISTIC
/begin CHARACTERISTIC PHAOCVINTKB1_CTL_ATS_ATS.LowLim_C "Actuator test PHAOCVINTKB1_CTL_ATS_ATS / Lower limit for monitoring" VALUE 0x8058AE7E Val_Ws16 199.9969 rel_sw_b100 -100.0000 99.9969 FORMAT "%8.4" EXTENDED_LIMITS -100.0000 99.99695 /end CHARACTERISTIC
/begin CHARACTERISTIC PHAOCVINTKB1_CTL_ATS_ATS.UpLim_C "Actuator test PHAOCVINTKB1_CTL_ATS_ATS / Upper limit for monitoring" VALUE 0x8058AE80 Val_Ws16 199.9969 rel_sw_b100 -100.0000 99.9969 FORMAT "%8.4" EXTENDED_LIMITS -100.0000 99.99695 /end CHARACTERISTIC
/begin CHARACTERISTIC PHAOCVINTKB1_CTL_ATS_ATS.CnvFac_C "Actuator test PHAOCVINTKB1_CTL_ATS_ATS / Factor used for conversion to/from internal scaling" VALUE 0x8058AE84 Val_Ws32 4294967295.00 OneToOne -2147483648.00 2147483647.00 FORMAT "%13.2" /end CHARACTERISTIC
/begin CHARACTERISTIC PHAOCVINTKB1_CTL_ATS_ATS.CnvOfs_C "Actuator test PHAOCVINTKB1_CTL_ATS_ATS / Offset used for conversion to/from internal scaling" VALUE 0x8058AE88 Val_Ws16 65535.00 OneToOne -32768.00 32767.00 FORMAT "%8.2" /end CHARACTERISTIC
/begin CHARACTERISTIC PHAOCVINTKB1_CTL_ATS_ATS.DfltVal_C "Actuator test PHAOCVINTKB1_CTL_ATS_ATS / Default value for standbytest" VALUE 0x8058AE8A Val_Ws16 65535.00 OneToOne -32768.00 32767.00 FORMAT "%8.2" /end CHARACTERISTIC
/begin CHARACTERISTIC RKVDSKVS "fuel mass threshold for stuck check" VALUE 0x80555422 RB_Val_Wu16 3071.953 rel_uw_b3072 0.00 3071.953 FORMAT "%8.3" /end CHARACTERISTIC
/begin CHARACTERISTIC TETHSAEE_C "delay time for take over of ethanol sensor value after electrical error" VALUE 0x805556E4 RB_Val_Wu8 25.50 t_q0p1 0.00 25.50 FORMAT "%5.2" /end CHARACTERISTIC
/begin CHARACTERISTIC TETHSAFE_C "delay time for take over of ethanol sensor value after frequency error" VALUE 0x805556E5 RB_Val_Wu8 25.50 t_q0p1 0.00 25.50 FORMAT "%5.2" /end CHARACTERISTIC
/begin CHARACTERISTIC TETHSKL15 "delay time for take over of ethanol sensor value after ignition on" VALUE 0x805556E6 RB_Val_Wu8 25.50 t_q0p1 0.00 25.50 FORMAT "%5.2" /end CHARACTERISTIC
/begin CHARACTERISTIC TFETHEVLP_CUR "time constant LP for mixing of the ethanol content in rail" CURVE 0x805556E8 RB_Curve_U16_U16 6553.500 t_q0p1 0.00 6553.500 FORMAT "%8.3"
 /begin AXIS_DESCR STD_AXIS NO_INPUT_QUANTITY volgrd_q2p38Em6 8 0.00 0.1562476 FORMAT "%9.7" DEPOSIT ABSOLUTE /end AXIS_DESCR
/end CHARACTERISTIC
/begin CHARACTERISTIC TFQETHSTP_C "filter time constant for ethanol sensor signal filtering" VALUE 0x8055570A RB_Val_Wu16 6553.400 t_q0p1 0.100 6553.500 FORMAT "%8.3" EXTENDED_LIMITS 0.00 6553.500 /end CHARACTERISTIC
/begin CHARACTERISTIC TVDSKVH "Time constant for healing of pressure sensor error" VALUE 0x80555424 RB_Val_Wu8 25.50 t_q0p1 0.00 25.50 FORMAT "%5.2" /end CHARACTERISTIC
/begin CHARACTERISTIC TVDSKVHSRC "Time constant debounce of healing of Physical pressure sensor." VALUE 0x80555425 RB_Val_Wu8 25.50 t_q0p1 0.00 25.50 FORMAT "%5.2" /end CHARACTERISTIC
/begin CHARACTERISTIC TVDSKVMN "Time constant debounce of min error of pressure sensor." VALUE 0x80555426 RB_Val_Wu8 25.50 t_q0p1 0.00 25.50 FORMAT "%5.2" /end CHARACTERISTIC
/begin CHARACTERISTIC TVDSKVMNSRC "Time constant debounce of min error of Physical pressure sensor." VALUE 0x80555427 RB_Val_Wu8 25.50 t_q0p1 0.00 25.50 FORMAT "%5.2" /end CHARACTERISTIC
/begin CHARACTERISTIC TVDSKVMX "Time constant debounce of max error of pressure sensor." VALUE 0x80555428 RB_Val_Wu8 25.50 t_q0p1 0.00 25.50 FORMAT "%5.2" /end CHARACTERISTIC
/begin CHARACTERISTIC TVDSKVMXSRC "Time constant debounce of max error of Physical pressure sensor." VALUE 0x80555429 RB_Val_Wu8 25.50 t_q0p1 0.00 25.50 FORMAT "%5.2" /end CHARACTERISTIC
/begin CHARACTERISTIC TVDSKVPL "Debouncing time of high pressure sensor signal range check" VALUE 0x8055542A RB_Val_Wu8 25.50 t_q0p1 0.00 25.50 FORMAT "%5.2" /end CHARACTERISTIC
/begin CHARACTERISTIC TVDSKVSH "delay time for healing" VALUE 0x8055542B RB_Val_Wu8 25.50 t_q0p1 0.00 25.50 FORMAT "%5.2" /end CHARACTERISTIC
/begin CHARACTERISTIC TVDSKVSS "delay time for sig error" VALUE 0x8055542C RB_Val_Wu8 25.50 t_q0p1 0.00 25.50 FORMAT "%5.2" /end CHARACTERISTIC
/begin CHARACTERISTIC UBSQFETHMN "Minimum battery voltage for ethanol sensor enabling" VALUE 0x8055570C RB_Val_Ws16 1310700. Volt_Batt -655360.0 655340.0 FORMAT "%8.1" /end CHARACTERISTIC
/begin CHARACTERISTIC UBSQFETHMX "Maximum battery voltage for ethanol sensor enabling" VALUE 0x8055570E RB_Val_Ws16 1310700. Volt_Batt -655360.0 655340.0 FORMAT "%8.1" /end CHARACTERISTIC
/begin CHARACTERISTIC UPRDIFF "threshold for sig error, to small voltage difference" VALUE 0x8055542E RB_Val_Wu16 319.9951 spg_uw_q0p00488 0.00 319.9951 FORMAT "%8.4" /end CHARACTERISTIC
/begin CHARACTERISTIC UPRDSKVS "threshold for stuck check" VALUE 0x80555430 RB_Val_Wu16 19.99969 spg_q3p052em4 0.00 19.99969 FORMAT "%8.5" /end CHARACTERISTIC
/begin CHARACTERISTIC UPRMMNPL "minimum value for plausible uprm_w" VALUE 0x80555432 RB_Val_Wu16 19.99969 spg_q3p052em4 0.00 19.99969 FORMAT "%8.5" /end CHARACTERISTIC
/begin CHARACTERISTIC UPRMMNSRCHL "minimum value for plausible uprm_w Higher limit" VALUE 0x80555434 RB_Val_Wu16 19.99969 spg_q3p052em4 0.00 19.99969 FORMAT "%8.5" /end CHARACTERISTIC
/begin CHARACTERISTIC UPRMMNSRCLL "minimum value for plausible uprm_w lower limit" VALUE 0x80555436 RB_Val_Wu16 19.99969 spg_q3p052em4 0.00 19.99969 FORMAT "%8.5" /end CHARACTERISTIC
/begin CHARACTERISTIC UPRMMXPL "maximum value for plausible uprm_w" VALUE 0x80555438 RB_Val_Wu16 19.99969 spg_q3p052em4 0.00 19.99969 FORMAT "%8.5" /end CHARACTERISTIC
/begin CHARACTERISTIC UPRMMXSRCHL "Maximum value for plausible uprm_w Higher limit" VALUE 0x8055543A RB_Val_Wu16 19.99969 spg_q3p052em4 0.00 19.99969 FORMAT "%8.5" /end CHARACTERISTIC
/begin CHARACTERISTIC UPRMMXSRCLL "Maxmimum value for plausible uprm_w lower limit" VALUE 0x8055543C RB_Val_Wu16 19.99969 spg_q3p052em4 0.00 19.99969 FORMAT "%8.5" /end CHARACTERISTIC
/begin CHARACTERISTIC VETHSEV "dead volume between ethanol sensor and injection valve" VALUE 0x80555710 RB_Val_Wu16 1.279980 vol_q1p953Em5_l 0.00 1.279980 FORMAT "%8.6" /end CHARACTERISTIC
/begin MEASUREMENT anztiaged "number of injections in pre task" UBYTE dez 1 100 0.00 255.0 FORMAT "%5.1" ECU_ADDRESS 0x6000B831 /end MEASUREMENT
/begin MEASUREMENT anztidiff_msg "injection counter difference" UBYTE dez 1 100 0.00 255.0 FORMAT "%5.1" ECU_ADDRESS 0x6000F74D /end MEASUREMENT
/begin MEASUREMENT B_dkvsenffv_msg "Enable condition for DKVSDFRM with respect to Ethanol" UBYTE B_TRUE 1 100 0.00 1.00000000000 BIT_MASK 0x1 FORMAT "%13.11" ECU_ADDRESS 0x6000F6FE /end MEASUREMENT
/begin MEASUREMENT B_dskvsh "condition no stuck check, healing" UBYTE B_TRUE 1 100 0.00 1.00000000000 BIT_MASK 0x1 FORMAT "%13.11" ECU_ADDRESS 0x6000B830 /end MEASUREMENT
/begin MEASUREMENT B_ethevg_msg "ethanol concentration at injection valve, electrical validity" UBYTE B_TRUE 1 100 0.00 1.00000000000 BIT_MASK 0x1 FORMAT "%13.11" ECU_ADDRESS 0x6000F6F9 /end MEASUREMENT
/begin MEASUREMENT B_ethgvtlo "ethanol concentration end of old partial volume, electrical validity" UBYTE B_TRUE 1 100 0.00 1.00000000000 BIT_MASK 0x1 FORMAT "%13.11" ECU_ADDRESS 0x60039302 /end MEASUREMENT
/begin MEASUREMENT B_ethrevg_msg "ethanol concentration from raw value to injection valve, electrical validity" UBYTE B_TRUE 1 100 0.00 1.00000000000 BIT_MASK 0x1 FORMAT "%13.11" ECU_ADDRESS 0x60039853 /end MEASUREMENT
/begin MEASUREMENT B_ethrg_msg "ethanol sensor, electrical validity" UBYTE B_TRUE 1 100 0.00 1.00000000000 BIT_MASK 0x1 FORMAT "%13.11" ECU_ADDRESS 0x6000F6F8 /end MEASUREMENT
/begin MEASUREMENT B_ethsen_msg "ethanol sensor signal processing enabled" UBYTE B_TRUE 1 100 0.00 1.00000000000 BIT_MASK 0x1 FORMAT "%13.11" ECU_ADDRESS 0x6000F6F7 /end MEASUREMENT
/begin MEASUREMENT B_ethsfmn_msg "ethanol sensor, signal error min. fequency" UBYTE B_TRUE 1 100 0.00 1.00000000000 BIT_MASK 0x1 FORMAT "%13.11" ECU_ADDRESS 0x6000F6F5 /end MEASUREMENT
/begin MEASUREMENT B_ethsfmx_msg "ethanol sensor, signal error max. fequency" UBYTE B_TRUE 1 100 0.00 1.00000000000 BIT_MASK 0x1 FORMAT "%13.11" ECU_ADDRESS 0x6000F6F4 /end MEASUREMENT
/begin MEASUREMENT B_ethsfsi_msg "ethanol sensor, signal error measurement fault ethanol content (sensor internal diagnosis)" UBYTE B_TRUE 1 100 0.00 1.00000000000 BIT_MASK 0x1 FORMAT "%13.11" ECU_ADDRESS 0x6000F6F3 /end MEASUREMENT
/begin MEASUREMENT B_figgfeth "first init of %GGFETH" UBYTE B_TRUE 1 100 0.00 1.00000000000 BIT_MASK 0x1 FORMAT "%13.11" ECU_ADDRESS 0x60039301 /end MEASUREMENT
/begin MEASUREMENT B_inggfeth "%GGFETH initialized" UBYTE B_TRUE 1 100 0.00 1.00000000000 BIT_MASK 0x1 FORMAT "%13.11" ECU_ADDRESS 0x60039300 /end MEASUREMENT
/begin MEASUREMENT B_noudiff "Condition. Error in stuck check, no voltage difference" UBYTE B_TRUE 1 100 0.00 1.00000000000 BIT_MASK 0x1 FORMAT "%13.11" ECU_ADDRESS 0x6000B82F /end MEASUREMENT
/begin MEASUREMENT B_prrohrg_msg "Condition rail pressure sensor electrically plausible and without stuck signal" UBYTE B_TRUE 1 100 0.00 1.00000000000 BIT_MASK 0x1 FORMAT "%13.11" ECU_ADDRESS 0x6000F6DE /end MEASUREMENT
/begin MEASUREMENT B_reldskv "conditions stuck check" UBYTE B_TRUE 1 100 0.00 1.00000000000 BIT_MASK 0x1 FORMAT "%13.11" ECU_ADDRESS 0x6000B82E /end MEASUREMENT
/begin MEASUREMENT B_tbudiff "Condition difference voltage sensor too big" UBYTE B_TRUE 1 100 0.00 1.00000000000 BIT_MASK 0x1 FORMAT "%13.11" ECU_ADDRESS 0x60000F2D /end MEASUREMENT
/begin MEASUREMENT B_uprmnpl_msg "Condition rail pressure sensor electrically implausible" UBYTE B_TRUE 1 100 0.00 1.00000000000 BIT_MASK 0x1 FORMAT "%13.11" ECU_ADDRESS 0x6000F6D1 /end MEASUREMENT
/begin MEASUREMENT dvtethiv_w "delta consumption since ethanol sensor value invalid" UWORD vol_q3p90625Em3_l 1 100 0.00 255.9961 FORMAT "%8.4" ECU_ADDRESS 0x600392FE /end MEASUREMENT
/begin MEASUREMENT ETHSCP_aryEthVolVldy "ethanol concentration end of partial volume, electrical validity" UBYTE B_TRUE 1 100 0.00 1.00000000000 FORMAT "%13.11" ARRAY_SIZE 8 ECU_ADDRESS 0x600392F6 /end MEASUREMENT
/begin MEASUREMENT ETHSCP_cntrEthIniCalc "Counter to enable the computation of ethanol factor based on temperature response delay correction" UBYTE dez 1 100 0.00 255.0 FORMAT "%5.1" ECU_ADDRESS 0x6000B82A /end MEASUREMENT
/begin MEASUREMENT ETHSCP_facEthCmp "Ethanol factor after compensation" UWORD fak_uw_b2 1 100 0.00 1.999969 FORMAT "%8.6" ECU_ADDRESS 0x600392F4 /end MEASUREMENT
/begin MEASUREMENT ETHSCP_facEthCmpExtd "Ethanol factor after compensation for extended range" UWORD fak_uw_b2 1 100 0.00 1.999969 FORMAT "%8.6" ECU_ADDRESS 0x600392F2 /end MEASUREMENT
/begin MEASUREMENT ETHSCP_facEthExtd "ethanol concentration for extended range at injection valve" UWORD fak_uw_b2 1 100 0.00 1.999969 FORMAT "%8.6" ECU_ADDRESS 0x60039894 /end MEASUREMENT
/begin MEASUREMENT ETHSCP_facEthExtdAry "ethanol concentration end of partial volume for extended range" UWORD fak_uw_b2 1 100 0.00 1.999969 FORMAT "%8.6" ARRAY_SIZE 8 ECU_ADDRESS 0x600392E2 /end MEASUREMENT
/begin MEASUREMENT ETHSCP_facEthExtdInt "ethanol concentration at injection valve extended range, before LP" UWORD fak_uw_b2 1 100 0.00 1.999969 FORMAT "%8.6" ECU_ADDRESS 0x600392E0 /end MEASUREMENT
/begin MEASUREMENT ETHSCP_flgAirDchaCmpl "Air-bleeding determination flag" UBYTE B_TRUE 1 100 0.00 1.00000000000 BIT_MASK 0x1 FORMAT "%13.11" ECU_ADDRESS 0x60039844 /end MEASUREMENT
/begin MEASUREMENT ETHSCP_flgErrDrvCyc "Ethanol Sensor Error confirmed in current driving cycle" UBYTE B_TRUE 1 100 0.00 1.00000000000 BIT_MASK 0x1 FORMAT "%13.11" ECU_ADDRESS 0x6000F6AD /end MEASUREMENT
/begin MEASUREMENT ETHSCP_flgFuAbnorm "Ethanol Sensor, Fuel Abnormality Flag" UBYTE B_TRUE 1 100 0.00 1.00000000000 BIT_MASK 0x1 FORMAT "%13.11" ECU_ADDRESS 0x6000F6AC /end MEASUREMENT
/begin MEASUREMENT ETHSCP_flgProdMod "Ethanol Sensor Package - Production Mode" UBYTE B_TRUE 1 100 0.00 1.00000000000 BIT_MASK 0x1 FORMAT "%13.11" ECU_ADDRESS 0x60039843 /end MEASUREMENT
/begin MEASUREMENT ETHSCP_flgProdModOn "Indication of Filter required for transition from Production Mode On" UBYTE B_TRUE 1 100 0.00 1.00000000000 BIT_MASK 0x1 FORMAT "%13.11" ECU_ADDRESS 0x600392DE /end MEASUREMENT
/begin MEASUREMENT ETHSCP_perEthCmp "Ethanol content after compensation" UWORD rel_uw_b200 1 100 0.00 100.0000 FORMAT "%8.4" ECU_ADDRESS 0x600074C4 /end MEASUREMENT
/begin MEASUREMENT ETHSCP_perEthExtd "percentage ethanol concentration for extended range at injection valve" UWORD rel_uw_b200 1 100 0.00 100.0000 FORMAT "%8.4" ECU_ADDRESS 0x60039892 /end MEASUREMENT
/begin MEASUREMENT ETHSCP_perEthRaw "Ethanol content rate raw" UWORD rel_uw_b200 1 100 0.00 100.0000 FORMAT "%8.4" ECU_ADDRESS 0x60008F6A /end MEASUREMENT
/begin MEASUREMENT ETHSCP_tFuAftCmp "Temperature ethanol sensor after compensation" UWORD temp_q0p1_om40 1 100 -40.0000 160.0000 FORMAT "%8.4" ECU_ADDRESS 0x600074C2 /end MEASUREMENT
/begin MEASUREMENT ETHSCP_tFuBufAry "High resolution temperature ethanol sensor buffer value" UWORD temp_q0p1_om40 1 100 -40.0000 160.0000 FORMAT "%8.4" ARRAY_SIZE 10 ECU_ADDRESS 0x600392CA /end MEASUREMENT
/begin MEASUREMENT ETHSCP_tFuBufLst "Temperature ethanol sensor before compensation" UWORD temp_q0p1_om40 1 100 -40.0000 160.0000 FORMAT "%8.4" ECU_ADDRESS 0x600074C0 /end MEASUREMENT
/begin MEASUREMENT fethevi_w "ethanol concentration at injection valve, before LP" UWORD fak_uw_b2 1 100 0.00 1.999969 FORMAT "%8.6" ECU_ADDRESS 0x600392C8 /end MEASUREMENT
/begin MEASUREMENT fethevprod_w "Variable with initial value of ethanol content for the production mode" UWORD fak_uw_b2 1 100 0.00 1.999969 FORMAT "%8.6" ECU_ADDRESS 0x600392C6 /end MEASUREMENT
/begin MEASUREMENT fethev_w_msg "ethanol concentration at injection valve" UWORD fak_uw_b2 1 100 0.00 1.999969 FORMAT "%8.6" ECU_ADDRESS 0x6003987A /end MEASUREMENT
/begin MEASUREMENT fethr_w_msg "ethanol content interpolation factor, raw value from sensor" UWORD fak_uw_b2 1 100 0.00 1.999969 FORMAT "%8.6" ECU_ADDRESS 0x60008D84 /end MEASUREMENT
/begin MEASUREMENT fethvtl_w "ethanol concentration end of partial volume" UWORD fak_uw_b2 1 100 0.00 1.999969 FORMAT "%8.6" ARRAY_SIZE 8 ECU_ADDRESS 0x600392B6 /end MEASUREMENT
/begin MEASUREMENT fqethsf_w_msg "frequency ethanol sensor signal, filtered" UWORD freq_q0p01 1 100 0.00 655.3500 FORMAT "%8.4" ECU_ADDRESS 0x60039874 /end MEASUREMENT
/begin MEASUREMENT FuPHi_flgDSKVClr100ms "condition DSMclr for DSKV is active for 100ms raster" UBYTE B_TRUE 1 100 0.00 1.00000000000 BIT_MASK 0x1 FORMAT "%13.11" ECU_ADDRESS 0x6000F683 /end MEASUREMENT
/begin MEASUREMENT FuPHi_flgDSKVClr10ms "condition DSMclr for DSKV is active for 10ms raster" UBYTE B_TRUE 1 100 0.00 1.00000000000 BIT_MASK 0x1 FORMAT "%13.11" ECU_ADDRESS 0x6000F682 /end MEASUREMENT
/begin MEASUREMENT FuPHi_flgDSKVSClr "condition DSMclr for DSKVS is active" UBYTE B_TRUE 1 100 0.00 1.00000000000 BIT_MASK 0x1 FORMAT "%13.11" ECU_ADDRESS 0x6000F681 /end MEASUREMENT
/begin MEASUREMENT FuPHi_pRawAbslt "fuel rail pressure raw value (absolute value)" UWORD RBPtCel_p_0p002_1 1 100 0.00 131.0700 FORMAT "%8.4" ECU_ADDRESS 0x7000397A /end MEASUREMENT
/begin MEASUREMENT FuPHi_pRawAbsltInj "fuel rail pressure raw value (absolute value) in injection sync" UWORD RBPtCel_p_0p002_1 1 100 0.00 131.0700 FORMAT "%8.4" ECU_ADDRESS 0x70003978 /end MEASUREMENT
/begin MEASUREMENT FuPHi_pRawRel "fuel rail pressure raw value (relative pressure)" UWORD RBPtCel_p_0p002_1 1 100 0.00 131.0700 FORMAT "%8.4" ECU_ADDRESS 0x70003976 /end MEASUREMENT
/begin MEASUREMENT FuPHi_pRawRelInj "fuel rail pressure raw value (relative value) in injection sync" UWORD RBPtCel_p_0p002_1 1 100 0.00 131.0700 FORMAT "%8.4" ECU_ADDRESS 0x70003974 /end MEASUREMENT
/begin MEASUREMENT FuPHi_uHiResl "Voltage value of second rail pressure input with magnifier feature" UWORD spg_q1p221Em3_V 1 100 0.00 79.99878 FORMAT "%8.5" ECU_ADDRESS 0x70003972 /end MEASUREMENT
/begin MEASUREMENT GEVCtl_agClsdOutl "Message for angle outlet valve closes at 0.5mm lift" SWORD kw_q0p0156 1 100 -512.0000 511.9844 FORMAT "%8.4" ECU_ADDRESS 0x6000998E /end MEASUREMENT
/begin MEASUREMENT GEVCtl_agDifStdSpclLftClsdIntk "Angle difference between the intake valve closing points of the two cam profiles" SWORD kw_q0p0156 1 100 -512.0000 511.9844 FORMAT "%8.4" ECU_ADDRESS 0x600090A0 /end MEASUREMENT
/begin MEASUREMENT GEVCtl_agDifStdSpclLftOffsIntk "Difference gas exch. valve inlet opens on switched valve lift between standard cam and special cam profile" SWORD kw_q0p0156 1 100 -512.0000 511.9844 FORMAT "%8.4" ECU_ADDRESS 0x6000998C /end MEASUREMENT
/begin MEASUREMENT GEVCtl_agDifStdSpclLftOpenIntk "angle delta of gas intake valve inlet close on switched valve lift between standard cam and special cam profile" SWORD kw_q0p0156 1 100 -512.0000 511.9844 FORMAT "%8.4" ECU_ADDRESS 0x6000998A /end MEASUREMENT
/begin MEASUREMENT GEVCtl_agIntkClsd "Actual position intake valve closed" SWORD kw_q0p0156 1 100 -512.0000 511.9844 FORMAT "%8.4" ECU_ADDRESS 0x600148CA /end MEASUREMENT
/begin MEASUREMENT GEVCtl_agIntkClsd_a "Actual position intake valve closed (0.5 mm cylinder individuel)" SWORD kw_q0p0156 1 100 -512.0000 511.9844 FORMAT "%8.4" ARRAY_SIZE 4 ECU_ADDRESS 0x500005B4 /end MEASUREMENT
/begin MEASUREMENT GEVCtl_agIntkOpen "Actual position intake valve opening" SWORD kw_q0p0156 1 100 -512.0000 511.9844 FORMAT "%8.4" ECU_ADDRESS 0x600148CC /end MEASUREMENT
/begin MEASUREMENT GEVCtl_agIntkOpen_a "Actual position intake valve opening (0.5 mm cylinder individuel)" SWORD kw_q0p0156 1 100 -512.0000 511.9844 FORMAT "%8.4" ARRAY_SIZE 4 ECU_ADDRESS 0x500005BC /end MEASUREMENT
/begin MEASUREMENT GEVCtl_agLockPosnIntkB1 "Locking position inlet camshaft, bank1" SWORD kw_q0p0156 1 100 -512.0000 511.9844 FORMAT "%8.4" ECU_ADDRESS 0x60009988 /end MEASUREMENT
/begin MEASUREMENT GEVCtl_agMaxAdpdIntk "retarded mechanical stop position adapted by camshaft adaptation inlet" SWORD kw_q0p0156 1 100 -512.0000 511.9844 FORMAT "%8.4" ECU_ADDRESS 0x60009986 /end MEASUREMENT
/begin MEASUREMENT GEVCtl_agMaxAdpdIntkB1 "retarded mechanical stop position adapted by camshaft adaptation inlet bank 1" SWORD kw_q0p0156 1 100 -512.0000 511.9844 FORMAT "%8.4" ECU_ADDRESS 0x60009984 /end MEASUREMENT
/begin MEASUREMENT GEVCtl_agMinAdpdIntk "advanced mechanical stop position adapted by camshaft adaptation inlet" SWORD kw_q0p0156 1 100 -512.0000 511.9844 FORMAT "%8.4" ECU_ADDRESS 0x60009982 /end MEASUREMENT
/begin MEASUREMENT GEVCtl_agMinAdpdIntkB1 "advanced mechanical stop position adapted by camshaft adaptation inlet bank 1" SWORD kw_q0p0156 1 100 -512.0000 511.9844 FORMAT "%8.4" ECU_ADDRESS 0x60009980 /end MEASUREMENT
/begin MEASUREMENT GEVCtl_agOffsVlvOpenIntk "Message for offset of the angle system to the intake valve opening point (0.5mm lift)" SWORD kw_q0p0156 1 100 -512.0000 511.9844 FORMAT "%8.4" ECU_ADDRESS 0x70003BCE /end MEASUREMENT
/begin MEASUREMENT GEVCtl_agOffsVlvOpenPredIntk "Message for offset of the angle system to the predicted intake valve opening point (0.5mm lift)" SWORD kw_q0p0156 1 100 -512.0000 511.9844 FORMAT "%8.4" ECU_ADDRESS 0x70003BCC /end MEASUREMENT
/begin MEASUREMENT GEVCtl_agOutlClsd "Actual position outlet valve closed" SWORD kw_q0p0156 1 100 -512.0000 511.9844 FORMAT "%8.4" ECU_ADDRESS 0x600148CE /end MEASUREMENT
/begin MEASUREMENT GEVCtl_agOutlClsd_a "Actual position outlet valve closed (0.5 mm and cylinder individuel)" SWORD kw_q0p0156 1 100 -512.0000 511.9844 FORMAT "%8.4" ARRAY_SIZE 4 ECU_ADDRESS 0x500005C4 /end MEASUREMENT
/begin MEASUREMENT GEVCtl_agOutlOpen "Actual position outlet valve opening" SWORD kw_q0p0156 1 100 -512.0000 511.9844 FORMAT "%8.4" ECU_ADDRESS 0x600148D0 /end MEASUREMENT
/begin MEASUREMENT GEVCtl_agRefPosnDrctIntkB1 "Reference position phase actuator direct intake camshaft bank1 (currentless actuator)" SWORD kw_q0p0156 1 100 -512.0000 511.9844 FORMAT "%8.4" ECU_ADDRESS 0x6000997C /end MEASUREMENT
/begin MEASUREMENT GEVCtl_agRefPosnIntkB1 "Reference position phase actuator intake camshaft bank1 (currentless actuator)" SWORD kw_q0p0156 1 100 -512.0000 511.9844 FORMAT "%8.4" ECU_ADDRESS 0x6000997A /end MEASUREMENT
/begin MEASUREMENT GEVCtl_agSpChrgDetrmIntk "Setpoint angle intake camshaft for charge determination (incl. bank average and error handling)" SWORD kw_q0p0156 1 100 -512.0000 511.9844 FORMAT "%8.4" ECU_ADDRESS 0x600074EC /end MEASUREMENT
/begin MEASUREMENT GEVCtl_agSpHomIntkClsd "value: des. angle gas exch. valve closes intake hom.mode" SWORD kw_q0p0156 1 100 -512.0000 511.9844 FORMAT "%8.4" ECU_ADDRESS 0x6000909C /end MEASUREMENT
/begin MEASUREMENT GEVCtl_agSpHomIntkOpen "value: des. angle gas exch. valve opens intake hom.mode" SWORD kw_q0p0156 1 100 -512.0000 511.9844 FORMAT "%8.4" ECU_ADDRESS 0x6000909A /end MEASUREMENT
/begin MEASUREMENT GEVCtl_agSpHomOutlClsd "value: des. angle gas exch. valve closes exhaust hom.mode" SWORD kw_q0p0156 1 100 -512.0000 511.9844 FORMAT "%8.4" ECU_ADDRESS 0x60009096 /end MEASUREMENT
/begin MEASUREMENT GEVCtl_agSpHomOutlOpen "value: des. angle gas exch. valve opens exhaust homogen. mode" SWORD kw_q0p0156 1 100 -512.0000 511.9844 FORMAT "%8.4" ECU_ADDRESS 0x60009094 /end MEASUREMENT
/begin MEASUREMENT GEVCtl_agSpHomVlvOvl "Desired NW-overlap angle only by homogen. mode adj." SWORD kw_q0p0156 1 100 -512.0000 511.9844 FORMAT "%8.4" ECU_ADDRESS 0x60009960 /end MEASUREMENT
/begin MEASUREMENT GEVCtl_agSpHomVlvOvlBg "Desired NW-overlap angle only by homogen. mode adj. BG calculation" SWORD kw_q0p0156 1 100 -512.0000 511.9844 FORMAT "%8.4" ECU_ADDRESS 0x600074EA /end MEASUREMENT
/begin MEASUREMENT GEVCtl_agSpIntkClsd "Setpoint angle intake valve closes" SWORD kw_q0p0156 1 100 -512.0000 511.9844 FORMAT "%8.4" ECU_ADDRESS 0x600148D4 /end MEASUREMENT
/begin MEASUREMENT GEVCtl_agSpIntkHiLftIntkClsd "Desired angle inlet gas exchange valve closes for VHE big cam profile" SWORD kw_q0p0156 1 100 -512.0000 511.9844 FORMAT "%8.4" ECU_ADDRESS 0x6000995E /end MEASUREMENT
/begin MEASUREMENT GEVCtl_agSpIntkHiLftIntkOpen "Desired angle intake gas exchange valve opens for VHE big cam profile" SWORD kw_q0p0156 1 100 -512.0000 511.9844 FORMAT "%8.4" ECU_ADDRESS 0x6000995C /end MEASUREMENT
/begin MEASUREMENT GEVCtl_agSpIntkHiLftOutlClsd "Desired angle outlet gas exchange valve closes for VHE big cam profile" SWORD kw_q0p0156 1 100 -512.0000 511.9844 FORMAT "%8.4" ECU_ADDRESS 0x6000995A /end MEASUREMENT
/begin MEASUREMENT GEVCtl_agSpIntkHiLftOutlOpen "Desired angle outlet gas exchange valve opens for VHE big cam profile" SWORD kw_q0p0156 1 100 -512.0000 511.9844 FORMAT "%8.4" ECU_ADDRESS 0x60009958 /end MEASUREMENT
/begin MEASUREMENT GEVCtl_agSpIntkLoLftIntkClsd "desired angle inlet gas exchange valve closes for VHE small cam profile" SWORD kw_q0p0156 1 100 -512.0000 511.9844 FORMAT "%8.4" ECU_ADDRESS 0x60009956 /end MEASUREMENT
/begin MEASUREMENT GEVCtl_agSpIntkLoLftIntkOpen "Desired angle intake gas exchange valve opens for VHE small cam profile" SWORD kw_q0p0156 1 100 -512.0000 511.9844 FORMAT "%8.4" ECU_ADDRESS 0x60009954 /end MEASUREMENT
/begin MEASUREMENT GEVCtl_agSpIntkLoLftOutlClsd "Desired angle outlet gas exchange valve closes for VHE small cam profile" SWORD kw_q0p0156 1 100 -512.0000 511.9844 FORMAT "%8.4" ECU_ADDRESS 0x60009952 /end MEASUREMENT
/begin MEASUREMENT GEVCtl_agSpIntkLoLftOutlOpen "Desired angle outlet gas exchange valve opens for VHE small cam profile" SWORD kw_q0p0156 1 100 -512.0000 511.9844 FORMAT "%8.4" ECU_ADDRESS 0x60009950 /end MEASUREMENT
/begin MEASUREMENT GEVCtl_agSpIntkOpen "Setpoint angle intake valve opens" SWORD kw_q0p0156 1 100 -512.0000 511.9844 FORMAT "%8.4" ECU_ADDRESS 0x600148D6 /end MEASUREMENT
/begin MEASUREMENT GEVCtl_agSpMaxIntk "Maximum permitted retarded mechanical stop position of intake cam phase actuator" SWORD kw_q0p0156 1 100 -512.0000 511.9844 FORMAT "%8.4" ECU_ADDRESS 0x600148D8 /end MEASUREMENT
/begin MEASUREMENT GEVCtl_agSpMinIntk "Minimum permitted desired value advanced mechanical stop position of intake cam phase actuator" SWORD kw_q0p0156 1 100 -512.0000 511.9844 FORMAT "%8.4" ECU_ADDRESS 0x600148DA /end MEASUREMENT
/begin MEASUREMENT GEVCtl_agSpOutlClsd "Setpoint angle outlet valve closes" SWORD kw_q0p0156 1 100 -512.0000 511.9844 FORMAT "%8.4" ECU_ADDRESS 0x600148DC /end MEASUREMENT
/begin MEASUREMENT GEVCtl_agSpOutlOpen "Des. angle: gas exch. valve opens exhaust" SWORD kw_q0p0156 1 100 -512.0000 511.9844 FORMAT "%8.4" ECU_ADDRESS 0x600148DE /end MEASUREMENT
/begin MEASUREMENT GEVCtl_agSpVlvOvl "Angle set point based valve overlapping" SWORD kw_q0p0156 1 100 -512.0000 511.9844 FORMAT "%8.4" ECU_ADDRESS 0x60009944 /end MEASUREMENT
/begin MEASUREMENT GEVCtl_agWidthCamPredIntk "Message for width of the predicted intake valve cam profile referred to 0.5mm lift" SWORD kw_q0p0156 1 100 -512.0000 511.9844 FORMAT "%8.4" ECU_ADDRESS 0x70003BCA /end MEASUREMENT
/begin MEASUREMENT GEVCtl_agWidthCamProfIntk "Width of valve cam profile referred to 0.5mm lift intake" SWORD kw_q0p0156 1 100 -512.0000 511.9844 FORMAT "%8.4" ECU_ADDRESS 0x70003BC8 /end MEASUREMENT
/begin MEASUREMENT GEVCtl_agWidthCamProfOutl "Width of valve cam profile referred to 0.5mm lift outlet" SWORD kw_q0p0156 1 100 -512.0000 511.9844 FORMAT "%8.4" ECU_ADDRESS 0x60009942 /end MEASUREMENT
/begin MEASUREMENT GEVCtl_cntrAdpnIntk "counter adaptation camshaftposition to crankshaftposition inlet camshaft" UBYTE OneToOne 1 100 0.00 255.0 FORMAT "%5.1" ECU_ADDRESS 0x6000FC84 /end MEASUREMENT
/begin MEASUREMENT GEVCtl_cntrDlyChrgDetrmIntkVlvLftSwt "Counter for the number of segments after inlet valve lift was switched." SBYTE OneToOne 1 100 -128.0 127.0 FORMAT "%5.1" ECU_ADDRESS 0x50000955 /end MEASUREMENT
/begin MEASUREMENT GEVCtl_flgActAgStdLftIntk "actual angles of inlet camshaft is computed for big lobe" UBYTE B_TRUE 1 100 0.00 1.00000000000 BIT_MASK 0x1 FORMAT "%13.11" ECU_ADDRESS 0x6000F96D /end MEASUREMENT
/begin MEASUREMENT GEVCtl_flgAdpnActvdTstrIntk "camshaft edge adaptation by tester demand activated( inlet cam)" UBYTE B_TRUE 1 100 0.00 1.00000000000 BIT_MASK 0x1 FORMAT "%13.11" ECU_ADDRESS 0x7000092C /end MEASUREMENT
/begin MEASUREMENT GEVCtl_flgAdpnReqSpclRatIntkB1 "Reqeuest of duty cycle for intake camshaft bank1 while fuel cut off to detect if movements out of refrerence is possible" UBYTE B_TRUE 1 100 0.00 1.00000000000 BIT_MASK 0x1 FORMAT "%13.11" ECU_ADDRESS 0x7000092B /end MEASUREMENT
/begin MEASUREMENT GEVCtl_flgAdpnTstrFinshdIntk "Condition tester demand fine adaptationat inlet camshaft done" UBYTE B_TRUE 1 100 0.00 1.00000000000 BIT_MASK 0x1 FORMAT "%13.11" ECU_ADDRESS 0x7000092A /end MEASUREMENT
/begin MEASUREMENT GEVCtl_flgCalcSpIntkHiLft "Desired angles are computed for big cam profile intake valve lift VHE" UBYTE B_TRUE 1 100 0.00 1.00000000000 BIT_MASK 0x1 FORMAT "%13.11" ECU_ADDRESS 0x6000F96C /end MEASUREMENT
/begin MEASUREMENT GEVCtl_flgCamsftErrDstcn "Distinguish between one tooth off and camshaft actuator fault active" UBYTE B_TRUE 1 100 0.00 1.00000000000 BIT_MASK 0x1 FORMAT "%13.11" ECU_ADDRESS 0x70000929 /end MEASUREMENT
/begin MEASUREMENT GEVCtl_flgEnaRngFineAdpnIntk "Condition. Enable fine adaption inlet" UBYTE B_TRUE 1 100 0.00 1.00000000000 BIT_MASK 0x1 FORMAT "%13.11" ECU_ADDRESS 0x70000246 /end MEASUREMENT
/begin MEASUREMENT GEVCtl_flgEngStrtCdnVlvLftEna "flag to release cam profile switching after oil pressure is stabalised based on time since engine start" UBYTE B_TRUE 1 100 0.00 1.00000000000 BIT_MASK 0x1 FORMAT "%13.11" ECU_ADDRESS 0x6000B838 /end MEASUREMENT
/begin MEASUREMENT GEVCtl_flgErrDstcnFinshdIntk "Distuinguish algorithm has taken place and is informaing intake actuator diagnosis" UBYTE B_TRUE 1 100 0.00 1.00000000000 BIT_MASK 0x1 FORMAT "%13.11" ECU_ADDRESS 0x70000928 /end MEASUREMENT
/begin MEASUREMENT GEVCtl_flgInhbFineAdpnIntk "Condition fine adaptation inhibited intake camshaft" UBYTE B_TRUE 1 100 0.00 1.00000000000 BIT_MASK 0x1 FORMAT "%13.11" ECU_ADDRESS 0x70000245 /end MEASUREMENT
/begin MEASUREMENT GEVCtl_flgIntkVlvLftEna "Release condition of intake camshaft profile switching" UBYTE B_TRUE 1 100 0.00 1.00000000000 BIT_MASK 0x1 FORMAT "%13.11" ECU_ADDRESS 0x70000927 /end MEASUREMENT
/begin MEASUREMENT GEVCtl_flgOperRngFineAdpnIntk "Flank adaption request NW-phase sensor by operating range intake" UBYTE B_TRUE 1 100 0.00 1.00000000000 BIT_MASK 0x1 FORMAT "%13.11" ECU_ADDRESS 0x70000244 /end MEASUREMENT
/begin MEASUREMENT GEVCtl_flgOperRngFirstAdpnIntk "First edge adaption request camshaft phase sensor by operating range inlet" UBYTE B_TRUE 1 100 0.00 1.00000000000 BIT_MASK 0x1 FORMAT "%13.11" ECU_ADDRESS 0x70000243 /end MEASUREMENT
/begin MEASUREMENT GEVCtl_flgPhaRefPosnRea "status flag to indicate that cams are in reference position" UBYTE B_TRUE 1 100 0.00 1.00000000000 BIT_MASK 0x1 FORMAT "%13.11" ECU_ADDRESS 0x7000091A /end MEASUREMENT
/begin MEASUREMENT GEVCtl_flgPhaSpToRefPosnIntk "Condition adjust intake setpoint into reference position active" UBYTE B_TRUE 1 100 0.00 1.00000000000 BIT_MASK 0x1 FORMAT "%13.11" ECU_ADDRESS 0x70000919 /end MEASUREMENT
/begin MEASUREMENT GEVCtl_flgPhaToRefPosnIntk "Condition adjust intake camshaft into reference position active" UBYTE B_TRUE 1 100 0.00 1.00000000000 BIT_MASK 0x1 FORMAT "%13.11" ECU_ADDRESS 0x70000917 /end MEASUREMENT
/begin MEASUREMENT GEVCtl_flgPredStdVlvLft "Selection of angle for predicted valve lift" UBYTE B_TRUE 1 100 0.00 1.00000000000 BIT_MASK 0x1 FORMAT "%13.11" ECU_ADDRESS 0x6000F964 /end MEASUREMENT
/begin MEASUREMENT GEVCtl_flgRefAdpnIntk "edge adaption request camshaft phase sensor by operating range inlet" UBYTE B_TRUE 1 100 0.00 1.00000000000 BIT_MASK 0x1 FORMAT "%13.11" ECU_ADDRESS 0x70000242 /end MEASUREMENT
/begin MEASUREMENT GEVCtl_flgRefAdpnTstrIntk "condition request camshaft edge adaptation by tester demand (inlet cam)" UBYTE B_TRUE 1 100 0.00 1.00000000000 BIT_MASK 0x1 FORMAT "%13.11" ECU_ADDRESS 0x70000914 /end MEASUREMENT
/begin MEASUREMENT GEVCtl_flgRelsAdpnTstr "Condition physical enabling of adaptation through tester" UBYTE B_TRUE 1 100 0.00 1.00000000000 BIT_MASK 0x1 FORMAT "%13.11" ECU_ADDRESS 0x70000240 /end MEASUREMENT
/begin MEASUREMENT GEVCtl_flgReqErrDstcnIntk "Flag for request of error distinction intake camshaft" UBYTE B_TRUE 1 100 0.00 1.00000000000 BIT_MASK 0x1 FORMAT "%13.11" ECU_ADDRESS 0x6000F962 /end MEASUREMENT
/begin MEASUREMENT GEVCtl_flgReqFirstAdpnIntk "First/reference edge adaption request Cam-phase sensor by operating range intake" UBYTE B_TRUE 1 100 0.00 1.00000000000 BIT_MASK 0x1 FORMAT "%13.11" ECU_ADDRESS 0x70000913 /end MEASUREMENT
/begin MEASUREMENT GEVCtl_flgReqRefAdpn "Condition request camshaft reference adaptation" UBYTE B_TRUE 1 100 0.00 1.00000000000 BIT_MASK 0x1 FORMAT "%13.11" ECU_ADDRESS 0x70000912 /end MEASUREMENT
/begin MEASUREMENT GEVCtl_flgReqRefAdpnClr "Condition DSM Clear request in function ReqRefAdpn" UBYTE B_TRUE 1 100 0.00 1.00000000000 BIT_MASK 0x1 FORMAT "%13.11" ECU_ADDRESS 0x70000241 /end MEASUREMENT
/begin MEASUREMENT GEVCtl_flgReqRefAdpnIntk "Request of condition: edge adaption camshaft intake" UBYTE B_TRUE 1 100 0.00 1.00000000000 BIT_MASK 0x1 FORMAT "%13.11" ECU_ADDRESS 0x70000911 /end MEASUREMENT
/begin MEASUREMENT GEVCtl_flgStdLftChrgDetrmIntk "Intake valve lift for charge determination equals standard lift" UBYTE B_TRUE 1 100 0.00 1.00000000000 BIT_MASK 0x1 FORMAT "%13.11" ECU_ADDRESS 0x7000090D /end MEASUREMENT
/begin MEASUREMENT GEVCtl_flgStdLftHwIntk "Confirmation of hardware switching: intake valve lift equals standard lift" UBYTE B_TRUE 1 100 0.00 1.00000000000 BIT_MASK 0x1 FORMAT "%13.11" ECU_ADDRESS 0x7000090C /end MEASUREMENT
/begin MEASUREMENT GEVCtl_flgStdLftSyncIntk "Synchronization: intake valve lift equals standard lift" UBYTE B_TRUE 1 100 0.00 1.00000000000 BIT_MASK 0x1 FORMAT "%13.11" ECU_ADDRESS 0x7000090B /end MEASUREMENT
/begin MEASUREMENT GEVCtl_nEngFild "engine speed with hysteresis for Interpolation of map" SWORD EngN 1 100 -16384.00 16383.50 FORMAT "%8.2" ECU_ADDRESS 0x600074F2 /end MEASUREMENT
/begin MEASUREMENT GEVCtl_nrCylSyncVlvLftIntk "Cylinder index for first cylinder to be switched (intake)" UBYTE OneToOne 1 100 0.00 255.0 FORMAT "%5.1" ECU_ADDRESS 0x5000098B /end MEASUREMENT
/begin MEASUREMENT GEVCtl_ratLoadFild "Filtered relative air charge for camshaft adaptation release" UWORD rel_uw_q0p0234 1 100 0.00 1535.977 FORMAT "%8.3" ECU_ADDRESS 0x600074F0 /end MEASUREMENT
/begin MEASUREMENT GEVCtl_tEngRefNxtAdpnIntk "Reference Engine temperature for Intake" SWORD Temp_Cels 1 100 -3549.940 3003.560 FORMAT "%8.3" ECU_ADDRESS 0x600074EE /end MEASUREMENT
/begin MEASUREMENT GEVlv_agCurrLftIntkB1 "Actual value phase angle for actual lift 1 mm inlet bank 1" SWORD kw_q0p0156 1 100 -512.0000 511.9844 FORMAT "%8.4" ECU_ADDRESS 0x60009940 /end MEASUREMENT
/begin MEASUREMENT GEVlv_agDeBgnMonCycIntk "Angle deviation for begin monitoring cycle diagnosis phase actuator intake" SWORD kw_q0p0156 1 100 -512.0000 511.9844 FORMAT "%8.4" ECU_ADDRESS 0x600074E2 /end MEASUREMENT
/begin MEASUREMENT GEVlv_agDeMaxAllwdPhaCsersIntk "Fault threshold setpoint-actual-deviation intake camshaft position CSERS" SWORD kw_q0p0156 1 100 -512.0000 511.9844 FORMAT "%8.4" ECU_ADDRESS 0x60009090 /end MEASUREMENT
/begin MEASUREMENT GEVlv_AgDeObsIntkB1_I.agBgnMon "class for observing the setpoint-actual angle deviation of the camshaft / Actual angle position at begin monitoring cycle diagnosis phase actuator" SWORD kw_q0p0156 1 100 -512.0000 511.9844 FORMAT "%8.4" ECU_ADDRESS 0x50001860 /end MEASUREMENT
/begin MEASUREMENT GEVlv_AgDeObsIntkB1_I.agErrPosn "class for observing the setpoint-actual angle deviation of the camshaft / Jamming position camshaft at error detection" SWORD kw_q0p0156 1 100 -512.0000 511.9844 FORMAT "%8.4" ECU_ADDRESS 0x50001862 /end MEASUREMENT
/begin MEASUREMENT GEVlv_AgDeObsIntkB1_I.agMaxMon "class for observing the setpoint-actual angle deviation of the camshaft / Maximum movement of actual angle during monitoring cycle diagnosis phase actuator" SWORD kw_q0p0156 1 100 -512.0000 511.9844 FORMAT "%8.4" ECU_ADDRESS 0x50001864 /end MEASUREMENT
/begin MEASUREMENT GEVlv_AgDeObsIntkB1_I.agRngThrActvPosn "class for observing the setpoint-actual angle deviation of the camshaft / Angle threshold limiting range active position" SWORD kw_q0p0156 1 100 -512.0000 511.9844 FORMAT "%8.4" ECU_ADDRESS 0x50001866 /end MEASUREMENT
/begin MEASUREMENT GEVlv_AgDeObsIntkB1_I.agSpMaxMon "class for observing the setpoint-actual angle deviation of the camshaft / Maximum target value adjustment in Range 3" SWORD kw_q0p0156 1 100 -512.0000 511.9844 FORMAT "%8.4" ECU_ADDRESS 0x50001868 /end MEASUREMENT
/begin MEASUREMENT GEVlv_AgDeObsIntkB1_I.agSpThdMon "class for observing the setpoint-actual angle deviation of the camshaft / Target value threshold to be reached by actual angle within running monitoring cycle" SWORD kw_q0p0156 1 100 -512.0000 511.9844 FORMAT "%8.4" ECU_ADDRESS 0x5000186A /end MEASUREMENT
/begin MEASUREMENT GEVlv_AgDeObsIntkB1_I.arg_agRngThrRefPosn "class for observing the setpoint-actual angle deviation of the camshaft / Angle threshold limiting range reference position" SWORD kw_q0p0156 1 100 -512.0000 511.9844 FORMAT "%8.4" ECU_ADDRESS 0x50001876 /end MEASUREMENT
/begin MEASUREMENT GEVlv_AgDeObsIntkB1_I.arg_flgFrzFrmEntryEna "class for observing the setpoint-actual angle deviation of the camshaft / argument for enabling entry of freeze frame into DFCs via calibration" UBYTE B_TRUE 1 100 0.00 1.00000000000 BIT_MASK 0x1 FORMAT "%13.11" ECU_ADDRESS 0x5000187E /end MEASUREMENT
/begin MEASUREMENT GEVlv_AgDeObsIntkB1_I.arg_flgInhbFrzFrmEntry "class for observing the setpoint-actual angle deviation of the camshaft / argument for inhibting of freeze frame entry into DFCs" UBYTE B_TRUE 1 100 0.00 1.00000000000 BIT_MASK 0x1 FORMAT "%13.11" ECU_ADDRESS 0x5000187F /end MEASUREMENT
/begin MEASUREMENT GEVlv_AgDeObsIntkB1_I.arg_flgTargErrDi "class for observing the setpoint-actual angle deviation of the camshaft / argument target deactivated via disable mask" UBYTE B_TRUE 1 100 0.00 1.00000000000 BIT_MASK 0x1 FORMAT "%13.11" ECU_ADDRESS 0x50001883 /end MEASUREMENT
/begin MEASUREMENT GEVlv_AgDeObsIntkB1_I.flgAgSpThdRea "class for observing the setpoint-actual angle deviation of the camshaft / Condition target value threshold reached by actual angle within running monitoring cycle" UBYTE B_TRUE 1 100 0.00 1.00000000000 BIT_MASK 0x1 FORMAT "%13.11" ECU_ADDRESS 0x50001888 /end MEASUREMENT
/begin MEASUREMENT GEVlv_AgDeObsIntkB1_I.flgErrNegDe "class for observing the setpoint-actual angle deviation of the camshaft / Condition error after monitoring of negative deviation" UBYTE B_TRUE 1 100 0.00 1.00000000000 BIT_MASK 0x1 FORMAT "%13.11" ECU_ADDRESS 0x50001889 /end MEASUREMENT
/begin MEASUREMENT GEVlv_AgDeObsIntkB1_I.flgErrPosDe "class for observing the setpoint-actual angle deviation of the camshaft / Condition error after monitoring of positive deviation" UBYTE B_TRUE 1 100 0.00 1.00000000000 BIT_MASK 0x1 FORMAT "%13.11" ECU_ADDRESS 0x5000188A /end MEASUREMENT
/begin MEASUREMENT GEVlv_AgDeObsIntkB1_I.flgMonCycPhaDiagRunng "class for observing the setpoint-actual angle deviation of the camshaft / Condition monitoring cycle diagnosis phase actuator active" UBYTE B_TRUE 1 100 0.00 1.00000000000 BIT_MASK 0x1 FORMAT "%13.11" ECU_ADDRESS 0x5000188B /end MEASUREMENT
/begin MEASUREMENT GEVlv_AgDeObsIntkB1_I.flgSuffMovePhaActRng1 "class for observing the setpoint-actual angle deviation of the camshaft / Camshaft actuator moved sufficiently for good test in range 1" UBYTE B_TRUE 1 100 0.00 1.00000000000 BIT_MASK 0x1 FORMAT "%13.11" ECU_ADDRESS 0x5000188C /end MEASUREMENT
/begin MEASUREMENT GEVlv_AgDeObsIntkB1_I.flgSuffMovePhaActRng3 "class for observing the setpoint-actual angle deviation of the camshaft / Camshaft actuator moved sufficiently for good test in range 3" UBYTE B_TRUE 1 100 0.00 1.00000000000 BIT_MASK 0x1 FORMAT "%13.11" ECU_ADDRESS 0x5000188D /end MEASUREMENT
/begin MEASUREMENT GEVlv_AgDeObsIntkB1_I.out_flgCreatFrzFrmSlowRespNegDe "class for observing the setpoint-actual angle deviation of the camshaft / flag for entering SR error FF in case of negative deviation" UBYTE B_TRUE 1 100 0.00 1.00000000000 BIT_MASK 0x1 FORMAT "%13.11" ECU_ADDRESS 0x5000188E /end MEASUREMENT
/begin MEASUREMENT GEVlv_AgDeObsIntkB1_I.out_flgCreatFrzFrmSlowRespPosDe "class for observing the setpoint-actual angle deviation of the camshaft / flag for entering SR error FF in case of positive deviation" UBYTE B_TRUE 1 100 0.00 1.00000000000 BIT_MASK 0x1 FORMAT "%13.11" ECU_ADDRESS 0x5000188F /end MEASUREMENT
/begin MEASUREMENT GEVlv_AgDeObsIntkB1_I.out_flgCreatFrzFrmTargNegDe "class for observing the setpoint-actual angle deviation of the camshaft / flag for entering target error FF in case of negative deviation" UBYTE B_TRUE 1 100 0.00 1.00000000000 BIT_MASK 0x1 FORMAT "%13.11" ECU_ADDRESS 0x50001890 /end MEASUREMENT
/begin MEASUREMENT GEVlv_AgDeObsIntkB1_I.out_flgCreatFrzFrmTargPosDe "class for observing the setpoint-actual angle deviation of the camshaft / flag for entering target error FF in case of positive deviation" UBYTE B_TRUE 1 100 0.00 1.00000000000 BIT_MASK 0x1 FORMAT "%13.11" ECU_ADDRESS 0x50001891 /end MEASUREMENT
/begin MEASUREMENT GEVlv_AgDeObsIntkB1_I.out_flgPhaDiagRes "class for observing the setpoint-actual angle deviation of the camshaft / Condition next status result diagnosis phase actuator" UBYTE B_TRUE 1 100 0.00 1.00000000000 BIT_MASK 0x1 FORMAT "%13.11" ECU_ADDRESS 0x50001892 /end MEASUREMENT
/begin MEASUREMENT GEVlv_AgDeObsIntkB1_I.out_st "class for observing the setpoint-actual angle deviation of the camshaft / Active status of the state machine" UBYTE OneToOne 1 100 0.00 255.0 FORMAT "%5.1" ECU_ADDRESS 0x50001894 /end MEASUREMENT
/begin MEASUREMENT GEVlv_AgDeObsIntkB1_I.out_stPhaDiagRes "class for observing the setpoint-actual angle deviation of the camshaft / Status result diagnosis phase actuator" UBYTE OneToOne 1 100 0.00 255.0 FORMAT "%5.1" ECU_ADDRESS 0x50001895 /end MEASUREMENT
/begin MEASUREMENT GEVlv_AgDeObsIntkB1_I.out_valLowerLimRef "class for observing the setpoint-actual angle deviation of the camshaft / Min threshold Service06 output diagnosis phase actuator" SWORD kw_q0p0156 1 100 -512.0000 511.9844 FORMAT "%8.4" ECU_ADDRESS 0x50001896 /end MEASUREMENT
/begin MEASUREMENT GEVlv_AgDeObsIntkB1_I.out_valResult "class for observing the setpoint-actual angle deviation of the camshaft / Actual value Service06 output diagnosis phase actuator" SWORD kw_q0p0156 1 100 -512.0000 511.9844 FORMAT "%8.4" ECU_ADDRESS 0x50001898 /end MEASUREMENT
/begin MEASUREMENT GEVlv_AgDeObsIntkB1_I.out_valUpperLimRef "class for observing the setpoint-actual angle deviation of the camshaft / Max threshold Service06 output diagnosis phase actuator" SWORD kw_q0p0156 1 100 -512.0000 511.9844 FORMAT "%8.4" ECU_ADDRESS 0x5000189A /end MEASUREMENT
/begin MEASUREMENT GEVlv_AgDeObsIntkB1_I.sm "class for observing the setpoint-actual angle deviation of the camshaft / Internal status state machine diagnosis phase actuator" UBYTE GEVlv_AgDeObs_sm_VERB 1 100 0.00 5.00000000000 FORMAT "%13.11" ECU_ADDRESS 0x5000189C /end MEASUREMENT
/begin MEASUREMENT GEVlv_AgDeObsIntkB1_I.tiFrzMonNegDeFrzFrmEntry "class for observing the setpoint-actual angle deviation of the camshaft / time delay for entering FF in case of negative deviation" UBYTE t_q0p05 1 100 0.00 12.75 FORMAT "%5.2" ECU_ADDRESS 0x5000189F /end MEASUREMENT
/begin MEASUREMENT GEVlv_AgDeObsIntkB1_I.tiFrzMonPosDeFrzFrmEntry "class for observing the setpoint-actual angle deviation of the camshaft / time delay for entering FF in case of positive deviation" UBYTE t_q0p05 1 100 0.00 12.75 FORMAT "%5.2" ECU_ADDRESS 0x500018A0 /end MEASUREMENT
/begin MEASUREMENT GEVlv_agDePhaDiagIntkB1 "Angle deviation setpoint to actual diagnosis phase actuator intake bank1" SWORD kw_q0p0156 1 100 -512.0000 511.9844 FORMAT "%8.4" ECU_ADDRESS 0x6000993E /end MEASUREMENT
/begin MEASUREMENT GEVlv_agDifSpActDT1IntkB1 "Change of the setpoint actual angle difference with respect to the last value intake bank1" SWORD kw_q0p0156 1 100 -512.0000 511.9844 FORMAT "%8.4" ECU_ADDRESS 0x600074D6 /end MEASUREMENT
/begin MEASUREMENT GEVlv_agDifSpActIntkB1 "Difference camshaft phase bank 1 inlet between desired value and extrapolated actual value" SWORD kw_q0p0156 1 100 -512.0000 511.9844 FORMAT "%8.4" ECU_ADDRESS 0x600074D4 /end MEASUREMENT
/begin MEASUREMENT GEVlv_agDrctIntkB1 "Actual position cam phase actuator direct intake camshaft bank1" SWORD kw_q0p0156 1 100 -512.0000 511.9844 FORMAT "%8.4" ECU_ADDRESS 0x6000993C /end MEASUREMENT
/begin MEASUREMENT GEVlv_agExtrpnCurrLftIntkB1 "Extrapolated actual value phase angle for actual lift 1 mm inlet bank 1" SWORD kw_q0p0156 1 100 -512.0000 511.9844 FORMAT "%8.4" ECU_ADDRESS 0x6000993A /end MEASUREMENT
/begin MEASUREMENT GEVlv_agExtrpnIntkB1 "Actual position cam phase actuator intake camshaft bank1" SWORD kw_q0p0156 1 100 -512.0000 511.9844 FORMAT "%8.4" ECU_ADDRESS 0x60009938 /end MEASUREMENT
/begin MEASUREMENT GEVlv_agExtrpnPosnSyncIntkB1_a "Actual position cam phase actuator intake camshaft bank1 (last 5 syncro values)" SWORD kw_q0p0156 1 100 -512.0000 511.9844 FORMAT "%8.4" ARRAY_SIZE 5 ECU_ADDRESS 0x70002EA8 /end MEASUREMENT
/begin MEASUREMENT GEVlv_agExtrpnPosnSyncSrtgIntkB1_a "Actual position cam phase actuator intake camshaft bank1 (last 5 syncro values sorted)" SWORD kw_q0p0156 1 100 -512.0000 511.9844 FORMAT "%8.4" ARRAY_SIZE 5 ECU_ADDRESS 0x50000704 /end MEASUREMENT
/begin MEASUREMENT GEVlv_agExtrpnSynIntkB1 "Angle synchronous extrapolated camshaft angle intake bank1" SWORD kw_q0p0156 1 100 -512.0000 511.9844 FORMAT "%8.4" ECU_ADDRESS 0x500007E2 /end MEASUREMENT
/begin MEASUREMENT GEVlv_agFildIntkB1 "fine triggered camshaft angle inlet camshaft 1" SWORD kw_q0p0156 1 100 -512.0000 511.9844 FORMAT "%8.4" ECU_ADDRESS 0x50005DE2 /end MEASUREMENT
/begin MEASUREMENT GEVlv_agFildSynIntkB1 "Angle synchronous filtered camshaft angle intake bank1" SWORD kw_q0p0156 1 100 -512.0000 511.9844 FORMAT "%8.4" ECU_ADDRESS 0x6000059E /end MEASUREMENT
/begin MEASUREMENT GEVlv_agFrznFltRngInhbHealIntkB1 "Frozen actual angle value at the time of debounced fault detection for intake Bank1 camshaft." SWORD kw_q0p0156 1 100 -512.0000 511.9844 FORMAT "%8.4" ECU_ADDRESS 0x60039304 /end MEASUREMENT
/begin MEASUREMENT GEVlv_agIntkB1 "Actual position cam phase actuator intake camshaft bank1" SWORD kw_q0p0156 1 100 -512.0000 511.9844 FORMAT "%8.4" ECU_ADDRESS 0x50005DE4 /end MEASUREMENT
/begin MEASUREMENT GEVlv_agMaxShiftIntk "Max. perm. overlap angle by intake camshaft adjustment" SWORD kw_q0p0156 1 100 -512.0000 511.9844 FORMAT "%8.4" ECU_ADDRESS 0x60009934 /end MEASUREMENT
/begin MEASUREMENT GEVlv_agOldIntkB1 "Actual position cam phase actuator intake camshaft bank1 before latest update" SWORD kw_q0p0156 1 100 -512.0000 511.9844 FORMAT "%8.4" ECU_ADDRESS 0x600074E8 /end MEASUREMENT
/begin MEASUREMENT GEVlv_agOvlShiftB1 "Overlap angle intake and exhaust camshaft only by adjustment bank 1" SWORD kw_q0p0156 1 100 -512.0000 511.9844 FORMAT "%8.4" ECU_ADDRESS 0x60009930 /end MEASUREMENT
/begin MEASUREMENT GEVlv_agShiftIntkB1 "camshaft adjustment angle (intake bank 1)" SWORD kw_q0p0156 1 100 -512.0000 511.9844 FORMAT "%8.4" ECU_ADDRESS 0x50005DE6 /end MEASUREMENT
/begin MEASUREMENT GEVlv_agSpErrSimIntkB1 "Desired position phase actuator affected by error simulation intake camshaft bank1" SWORD kw_q0p0156 1 100 -512.0000 511.9844 FORMAT "%8.4" ECU_ADDRESS 0x600074D2 /end MEASUREMENT
/begin MEASUREMENT GEVlv_agSpStopGovrIntk "Angle difference to passive mechanical boundary below which the governor is deactivated for Intake Camshaft" SWORD kw_q0p0156 1 100 -512.0000 511.9844 FORMAT "%8.4" ECU_ADDRESS 0x600148E4 /end MEASUREMENT
/begin MEASUREMENT GEVlv_agSumSpCsersDeIntkB1 "Sum of deviation of setpoint and setpoint from csers setpoint map during fault detected for error distinction" SWORD kw_q0p0156 1 100 -512.0000 511.9844 FORMAT "%8.4" ECU_ADDRESS 0x6000992E /end MEASUREMENT
/begin MEASUREMENT GEVlv_agSynExtrpnIntkB1 "extrapolated actual intake camhsaft angle to syncro (bank 1)" SWORD kw_q0p0156 1 100 -512.0000 511.9844 FORMAT "%8.4" ECU_ADDRESS 0x70003BC6 /end MEASUREMENT
/begin MEASUREMENT GEVlv_cntrAutStrt "counter of automatic starter trigger (by vehicle key or engine start button)" UBYTE dez 1 100 0.00 255.0 FORMAT "%5.1" ECU_ADDRESS 0x60000F30 /end MEASUREMENT
/begin MEASUREMENT GEVlv_cntrLockPinDiagIntkB1_I.agOld "class for observing the number of exceedance of angle thresholdin engine start intake camshaft bank1 / Angle of last raster" SWORD kw_q0p0156 1 100 -512.0000 511.9844 FORMAT "%8.4" ECU_ADDRESS 0x50000F48 /end MEASUREMENT
/begin MEASUREMENT GEVlv_cntrLockPinDiagIntkB1_I.flgFltRes "class for observing the number of exceedance of angle thresholdin engine start intake camshaft bank1 / Condition locking pin diagnosis detected fault" UBYTE B_TRUE 1 100 0.00 1.00000000000 BIT_MASK 0x1 FORMAT "%13.11" ECU_ADDRESS 0x50000F4A /end MEASUREMENT
/begin MEASUREMENT GEVlv_cntrLockPinDiagIntkB1_I.flgNrAllwdExcdcRea "class for observing the number of exceedance of angle thresholdin engine start intake camshaft bank1 / Condition maximal allowed exceedances of angle threshold reached" UBYTE B_TRUE 1 100 0.00 1.00000000000 BIT_MASK 0x1 FORMAT "%13.11" ECU_ADDRESS 0x50000F4B /end MEASUREMENT
/begin MEASUREMENT GEVlv_cntrLockPinDiagIntkB1_I.flgOkRes "class for observing the number of exceedance of angle thresholdin engine start intake camshaft bank1 / Condition locking pin diagnosis detected no fault" UBYTE B_TRUE 1 100 0.00 1.00000000000 BIT_MASK 0x1 FORMAT "%13.11" ECU_ADDRESS 0x50000F4C /end MEASUREMENT
/begin MEASUREMENT GEVlv_cntrLockPinDiagIntkB1_I.nrCamsftSample "class for observing the number of exceedance of angle thresholdin engine start intake camshaft bank1 / Number of evaluated angles of locking pin diagnosis" UBYTE dez 1 100 0.00 255.0 FORMAT "%5.1" ECU_ADDRESS 0x50000F4D /end MEASUREMENT
/begin MEASUREMENT GEVlv_cntrLockPinDiagIntkB1_I.nrExcddAgThd "class for observing the number of exceedance of angle thresholdin engine start intake camshaft bank1 / Number of exceedances of angle threshold" UBYTE dez 1 100 0.00 255.0 FORMAT "%5.1" ECU_ADDRESS 0x50000F4E /end MEASUREMENT
/begin MEASUREMENT GEVlv_cntrSlowRespIntkB1 "Value of counter for test results slow response intake bank 1" UBYTE dez 1 100 0.00 255.0 FORMAT "%5.1" ECU_ADDRESS 0x6000FC7F /end MEASUREMENT
/begin MEASUREMENT GEVlv_cntrTarErrIntkB1 "Value of counter for test results target error intake bank 1" UBYTE dez 1 100 0.00 255.0 FORMAT "%5.1" ECU_ADDRESS 0x6000FC7E /end MEASUREMENT
/begin MEASUREMENT GEVlv_DenomCmplIntkB1_I.cntrDenom "IUMPR class forming Denominator-Complete intake camshaft bank1 / Counter for Denominator increase" UBYTE dez 1 100 0.00 255.0 FORMAT "%5.1" ECU_ADDRESS 0x500018C4 /end MEASUREMENT
/begin MEASUREMENT GEVlv_DenomCmplIntkB1_I.flgRelsDenom "IUMPR class forming Denominator-Complete intake camshaft bank1 / Condition denominator released" UBYTE B_TRUE 1 100 0.00 1.00000000000 BIT_MASK 0x1 FORMAT "%13.11" ECU_ADDRESS 0x500018C5 /end MEASUREMENT
/begin MEASUREMENT GEVlv_DetAbnormAgIntkB1_I.out_flgAgAbnormDetd ". / abnormal angle detected" UBYTE B_TRUE 1 100 0.00 1.00000000000 BIT_MASK 0x1 FORMAT "%13.11" ECU_ADDRESS 0x600074C8 /end MEASUREMENT
/begin MEASUREMENT GEVlv_facUBattCorrn "Correction factor duty cycle cam phase actuator depending on battery voltage" UBYTE fak_ub_b2 1 100 0.00 1.992188 FORMAT "%8.6" ECU_ADDRESS 0x6000B833 /end MEASUREMENT
/begin MEASUREMENT GEVlv_flgAbortDiagIntkB1 "flag for aborting the intake bank1 lockpin diagnosis" UBYTE B_TRUE 1 100 0.00 1.00000000000 BIT_MASK 0x1 FORMAT "%13.11" ECU_ADDRESS 0x600000E7 /end MEASUREMENT
/begin MEASUREMENT GEVlv_flgAdapErrSimIntk "Condition no inhibition of fine adaption while camshaft controller is in error simulation (Intake camshaft)" UBYTE B_TRUE 1 100 0.00 1.00000000000 BIT_MASK 0x1 FORMAT "%13.11" ECU_ADDRESS 0x6000F958 /end MEASUREMENT
/begin MEASUREMENT GEVlv_flgAgAbvByndIntkB1 "Condition above and beyond for camshaft intake bank 1" UBYTE B_TRUE 1 100 0.00 1.00000000000 BIT_MASK 0x1 FORMAT "%13.11" ECU_ADDRESS 0x7000023B /end MEASUREMENT
/begin MEASUREMENT GEVlv_flgCalcLockPinDiagEna "Condition calculation of locking pin diagnosis enabling condition" UBYTE B_TRUE 1 100 0.00 1.00000000000 BIT_MASK 0x1 FORMAT "%13.11" ECU_ADDRESS 0x600000E6 /end MEASUREMENT
/begin MEASUREMENT GEVlv_flgCalcnEnaIntkB1 "Calculation of locking pin diagnosis is active ( inlet camshaft bank1)" UBYTE B_TRUE 1 100 0.00 1.00000000000 BIT_MASK 0x1 FORMAT "%13.11" ECU_ADDRESS 0x600000E5 /end MEASUREMENT
/begin MEASUREMENT GEVlv_flgCatHeatgActvIntk "Condition CSERS mode active on the intake side" UBYTE B_TRUE 1 100 0.00 1.00000000000 BIT_MASK 0x1 FORMAT "%13.11" ECU_ADDRESS 0x7000023D /end MEASUREMENT
/begin MEASUREMENT GEVlv_flgClngOilCtrlVlvActv "Condition oil control valve cleaning active" UBYTE B_TRUE 1 100 0.00 1.00000000000 BIT_MASK 0x1 FORMAT "%13.11" ECU_ADDRESS 0x600000DF /end MEASUREMENT
/begin MEASUREMENT GEVlv_flgCptProtnIntkB1 "Component protection phase actuator intake camshaft bank1 activated" UBYTE B_TRUE 1 100 0.00 1.00000000000 BIT_MASK 0x1 FORMAT "%13.11" ECU_ADDRESS 0x6000B832 /end MEASUREMENT
/begin MEASUREMENT GEVlv_flgCsersDebCmplIntkB1 "Debouncing of cam phaser CSERS diagnosis complete (intake bank1)" UBYTE B_TRUE 1 100 0.00 1.00000000000 BIT_MASK 0x1 FORMAT "%13.11" ECU_ADDRESS 0x7000090A /end MEASUREMENT
/begin MEASUREMENT GEVlv_flgCsersDiagReqIntk "Condition csers diagnosis request for intake camshaft" UBYTE B_TRUE 1 100 0.00 1.00000000000 BIT_MASK 0x1 FORMAT "%13.11" ECU_ADDRESS 0x70000909 /end MEASUREMENT
/begin MEASUREMENT GEVlv_flgCsersEomActvIntk "Intake camshaft CSERS measure active" UBYTE B_TRUE 1 100 0.00 1.00000000000 BIT_MASK 0x1 FORMAT "%13.11" ECU_ADDRESS 0x70000908 /end MEASUREMENT
/begin MEASUREMENT GEVlv_flgDebCmplIntkB1 "Debouncing of cam phaser diagnosis complete (intake bank1)" UBYTE B_TRUE 1 100 0.00 1.00000000000 BIT_MASK 0x1 FORMAT "%13.11" ECU_ADDRESS 0x6000F957 /end MEASUREMENT
/begin MEASUREMENT GEVlv_flgDiagNotDiIntkB1 "Camshaft actuator diagnosis for intake bank 1 not disabled via disable mask" UBYTE B_TRUE 1 100 0.00 1.00000000000 BIT_MASK 0x1 FORMAT "%13.11" ECU_ADDRESS 0x6000F956 /end MEASUREMENT
/begin MEASUREMENT GEvlv_flgDlyDeactvnDiagEngStop "Condition deactivation of diagnosis at engine stop delayed" UBYTE B_TRUE 1 100 0.00 1.00000000000 BIT_MASK 0x1 FORMAT "%13.11" ECU_ADDRESS 0x7000023A /end MEASUREMENT
/begin MEASUREMENT GEVlv_flgDsmRstLockPinDiag "Condition for DSM Clear request for lock pin diagnosis" UBYTE B_TRUE 1 100 0.00 1.00000000000 BIT_MASK 0x1 FORMAT "%13.11" ECU_ADDRESS 0x7000023F /end MEASUREMENT
/begin MEASUREMENT GEVlv_flgDsmRstPhaCsersDiagIntkB1 "flag for DSM_Clear for the CSERS diagnosis intake Bank1 camshaft" UBYTE B_TRUE 1 100 0.00 1.00000000000 BIT_MASK 0x1 FORMAT "%13.11" ECU_ADDRESS 0x7000023C /end MEASUREMENT
/begin MEASUREMENT GEVlv_flgDsmRstPhaDiag "Condition DSM Clear request" UBYTE B_TRUE 1 100 0.00 1.00000000000 BIT_MASK 0x1 FORMAT "%13.11" ECU_ADDRESS 0x6000B837 /end MEASUREMENT
/begin MEASUREMENT GEVlv_flgElecDiagIntkB1Actv "Status of the disable mask for the electrical diagnosis of intake bank 1 camshaft" UBYTE B_TRUE 1 100 0.00 1.00000000000 BIT_MASK 0x1 FORMAT "%13.11" ECU_ADDRESS 0x600000E0 /end MEASUREMENT
/begin MEASUREMENT GEVlv_flgEngReStrtRstLockPinDiag "Condition for Engine Restart request for lock pin diagnosis" UBYTE B_TRUE 1 100 0.00 1.00000000000 BIT_MASK 0x1 FORMAT "%13.11" ECU_ADDRESS 0x7000023E /end MEASUREMENT
/begin MEASUREMENT GEVlv_flgGovrActvIntkB1 "Condition governor active intake bank 1" UBYTE B_TRUE 1 100 0.00 1.00000000000 BIT_MASK 0x1 FORMAT "%13.11" ECU_ADDRESS 0x70000239 /end MEASUREMENT
/begin MEASUREMENT GEVlv_flgInhbFrzFrmEntryIntkB1 "flag for inhibting the freeze frame entry into Intake Bank1 DFC" UBYTE B_TRUE 1 100 0.00 1.00000000000 BIT_MASK 0x1 FORMAT "%13.11" ECU_ADDRESS 0x6000B836 /end MEASUREMENT
/begin MEASUREMENT GEVlv_flgLockPinDiagEna "General release condition fulfilled" UBYTE B_TRUE 1 100 0.00 1.00000000000 BIT_MASK 0x1 FORMAT "%13.11" ECU_ADDRESS 0x600000E4 /end MEASUREMENT
/begin MEASUREMENT GEVlv_flgLockPinDiagEnaIntkB1 "active diagnosis: inlet camshaft in locking position during start bank1" UBYTE B_TRUE 1 100 0.00 1.00000000000 BIT_MASK 0x1 FORMAT "%13.11" ECU_ADDRESS 0x70000906 /end MEASUREMENT
/begin MEASUREMENT GEVlv_flgLockPinDiagResIntkB1 "Locking pin diagnosis result is calculated and reported to DSM (intake bank1)" UBYTE B_TRUE 1 100 0.00 1.00000000000 BIT_MASK 0x1 FORMAT "%13.11" ECU_ADDRESS 0x70000905 /end MEASUREMENT
/begin MEASUREMENT GEVlv_flgMinEngOffLockpinDiagEna "Condition of minimum engine off time for locking pin diagnosis while engine start" UBYTE B_TRUE 1 100 0.00 1.00000000000 BIT_MASK 0x1 FORMAT "%13.11" ECU_ADDRESS 0x600000E3 /end MEASUREMENT
/begin MEASUREMENT GEVlv_flgPhaActrErrSuspcIntkB1 "condition suspect of error camshaft actuator inlet" UBYTE B_TRUE 1 100 0.00 1.00000000000 BIT_MASK 0x1 FORMAT "%13.11" ECU_ADDRESS 0x6000F955 /end MEASUREMENT
/begin MEASUREMENT GEVlv_flgPhaAdpnVldIntk "adaption crankshaft/camshaft(inlet) performed" UBYTE B_TRUE 1 100 0.00 1.00000000000 BIT_MASK 0x1 FORMAT "%13.11" ECU_ADDRESS 0x70000903 /end MEASUREMENT
/begin MEASUREMENT GEVlv_flgPhaCsersDiagAvlIntk "Condition: none of the CSERS-camshaft actuator diagnosis DFCs (excludes the DFCs of the extended CSERS-diagnosis) is deactivated via DisableMask (intake)" UBYTE B_TRUE 1 100 0.00 1.00000000000 BIT_MASK 0x1 FORMAT "%13.11" ECU_ADDRESS 0x70000902 /end MEASUREMENT
/begin MEASUREMENT GEVlv_flgPhaCsersDiagEnaAmbIntk "Ambient conditions for cold start diagnosis intake fulfilled" UBYTE B_TRUE 1 100 0.00 1.00000000000 BIT_MASK 0x1 FORMAT "%13.11" ECU_ADDRESS 0x70000238 /end MEASUREMENT
/begin MEASUREMENT GEVlv_flgPhaCsersDiagEnaBascIntkB1 "Condition basic conditions for csers diagnosis (without above and beyond) for intake bank 1 fulfilled" UBYTE B_TRUE 1 100 0.00 1.00000000000 BIT_MASK 0x1 FORMAT "%13.11" ECU_ADDRESS 0x70000237 /end MEASUREMENT
/begin MEASUREMENT GEVlv_flgPhaCsersDiagEnaNoErrIntkB1 "Condition csers diagnosis intake bank1 not inhibited by errors" UBYTE B_TRUE 1 100 0.00 1.00000000000 BIT_MASK 0x1 FORMAT "%13.11" ECU_ADDRESS 0x70000236 /end MEASUREMENT
/begin MEASUREMENT GEVlv_flgPhaDiagDenomCondIntkB1 "Enabling condition for activation of physical Denominator of normal diagnosis of intake camshaft Bank1 fulfilled" UBYTE B_TRUE 1 100 0.00 1.00000000000 BIT_MASK 0x1 FORMAT "%13.11" ECU_ADDRESS 0x6000B834 /end MEASUREMENT
/begin MEASUREMENT GEVlv_flgPhaDiagEnaAftStrtIntk "Condition delay time after end of start to enable inlet diagnosis passed" UBYTE B_TRUE 1 100 0.00 1.00000000000 BIT_MASK 0x1 FORMAT "%13.11" ECU_ADDRESS 0x70000901 /end MEASUREMENT
/begin MEASUREMENT GEVlv_flgPhaDiagEnaAmbIntk "fct. phys. ready (diagnosis camshaft actuator inlet)" UBYTE B_TRUE 1 100 0.00 1.00000000000 BIT_MASK 0x1 FORMAT "%13.11" ECU_ADDRESS 0x70000235 /end MEASUREMENT
/begin MEASUREMENT GEVlv_flgPhaDiagEnaCsersDynIntkB1 "Active diagnosis: camshaft control intake during CSERS with dynamic deactivation" UBYTE B_TRUE 1 100 0.00 1.00000000000 BIT_MASK 0x1 FORMAT "%13.11" ECU_ADDRESS 0x70000900 /end MEASUREMENT
/begin MEASUREMENT GEVlv_flgPhaDiagEnaCsersIntkB1 "Active diagnosis: camshaft control intake during CSERS" UBYTE B_TRUE 1 100 0.00 1.00000000000 BIT_MASK 0x1 FORMAT "%13.11" ECU_ADDRESS 0x700008FF /end MEASUREMENT
/begin MEASUREMENT GEVlv_flgPhaDiagEnaIntkB1 "active diagnosis: camshaft control inlet" UBYTE B_TRUE 1 100 0.00 1.00000000000 BIT_MASK 0x1 FORMAT "%13.11" ECU_ADDRESS 0x700008FE /end MEASUREMENT
/begin MEASUREMENT GEVlv_flgPhaDiagEnaNoErrIntkB1 "Condition diagnosis intake bank1 not inhibited by errors" UBYTE B_TRUE 1 100 0.00 1.00000000000 BIT_MASK 0x1 FORMAT "%13.11" ECU_ADDRESS 0x70000234 /end MEASUREMENT
/begin MEASUREMENT GEVlv_flgPhaDiagEnaPhyIntkB1 "Physical conditions for camshaft actuator diagnosis intake fulfilled, bank 1" UBYTE B_TRUE 1 100 0.00 1.00000000000 BIT_MASK 0x1 FORMAT "%13.11" ECU_ADDRESS 0x70000233 /end MEASUREMENT
/begin MEASUREMENT GEVlv_flgPhaDiagRdyIntkB1 "camshaft diagnosis (intake bank 1) during actuator test finished; diagnosis result available" UBYTE B_TRUE 1 100 0.00 1.00000000000 BIT_MASK 0x1 FORMAT "%13.11" ECU_ADDRESS 0x6000F954 /end MEASUREMENT
/begin MEASUREMENT GEVlv_flgPhaDiagReqIntkB1 "Condition normal diagnosis requested camshaft intake bank 1" UBYTE B_TRUE 1 100 0.00 1.00000000000 BIT_MASK 0x1 FORMAT "%13.11" ECU_ADDRESS 0x700008FD /end MEASUREMENT
/begin MEASUREMENT GEVlv_flgPhaDiagResIntkB1 "Result of camshaft diagnosis intake bank 1 ready" UBYTE B_TRUE 1 100 0.00 1.00000000000 BIT_MASK 0x1 FORMAT "%13.11" ECU_ADDRESS 0x6000F953 /end MEASUREMENT
/begin MEASUREMENT GEVlv_flgPhaEnaDrvgCycIntk "Status showing whether the intake camshaft adjustment had been released during current driving cycle" UBYTE B_TRUE 1 100 0.00 1.00000000000 BIT_MASK 0x1 FORMAT "%13.11" ECU_ADDRESS 0x600000E1 /end MEASUREMENT
/begin MEASUREMENT GEVlv_flgPhaErrSimIntk "Failure simulation phase actuator intake camshaft active" UBYTE B_TRUE 1 100 0.00 1.00000000000 BIT_MASK 0x1 FORMAT "%13.11" ECU_ADDRESS 0x6000F952 /end MEASUREMENT
/begin MEASUREMENT GEVlv_flgPhyCdnLockDiagIntkB1 "fct. phys. ready (diagnosis of locked camshaft actuator inlet bank1)" UBYTE B_TRUE 1 100 0.00 1.00000000000 BIT_MASK 0x1 FORMAT "%13.11" ECU_ADDRESS 0x600000E2 /end MEASUREMENT
/begin MEASUREMENT GEVlv_flgRprtChkOkIntkB1 "Cam phaser diagnosis: report OK to DSM (intake bank 1)" UBYTE B_TRUE 1 100 0.00 1.00000000000 BIT_MASK 0x1 FORMAT "%13.11" ECU_ADDRESS 0x6000F951 /end MEASUREMENT
/begin MEASUREMENT GEVlv_flgRprtChkSlowIntkB1 "Cam phaser diagnosis: report SlowResponse to DSM (intake bank 1)" UBYTE B_TRUE 1 100 0.00 1.00000000000 BIT_MASK 0x1 FORMAT "%13.11" ECU_ADDRESS 0x6000F950 /end MEASUREMENT
/begin MEASUREMENT GEVlv_flgRprtChkTarIntkB1 "Cam phaser diagnosis: report TargetError to DSM (intake bank 1)" UBYTE B_TRUE 1 100 0.00 1.00000000000 BIT_MASK 0x1 FORMAT "%13.11" ECU_ADDRESS 0x6000F94F /end MEASUREMENT
/begin MEASUREMENT GEVlv_flgRstPhaDiagEnaEngReStrt "Flag reset in calculation of release of diagnosis camshaft actuator (in case of Engine Restart)" UBYTE B_TRUE 1 100 0.00 1.00000000000 BIT_MASK 0x1 FORMAT "%13.11" ECU_ADDRESS 0x70000232 /end MEASUREMENT
/begin MEASUREMENT GEVlv_flgSimCsersDiag "Condition simulation of csers diagnosis activated" UBYTE B_TRUE 1 100 0.00 1.00000000000 BIT_MASK 0x1 FORMAT "%13.11" ECU_ADDRESS 0x700008FC /end MEASUREMENT
/begin MEASUREMENT GEVlv_flgSlowRespMinTIntk "Condition minimal temperature for slow response diagnosis for intake camshaft reached" UBYTE B_TRUE 1 100 0.00 1.00000000000 BIT_MASK 0x1 FORMAT "%13.11" ECU_ADDRESS 0x700008FB /end MEASUREMENT
/begin MEASUREMENT GEVlv_flgSlowRespMinTOutl "Condition minimal temperature for slow response diagnosis for outlet camshaft reached" UBYTE B_TRUE 1 100 0.00 1.00000000000 BIT_MASK 0x1 FORMAT "%13.11" ECU_ADDRESS 0x700008FA /end MEASUREMENT
/begin MEASUREMENT GEVlv_flgSpclRatIntvIntkB1 "Condition special duty cycle for intake camshaft bank 1 active" UBYTE B_TRUE 1 100 0.00 1.00000000000 BIT_MASK 0x1 FORMAT "%13.11" ECU_ADDRESS 0x700008F9 /end MEASUREMENT
/begin MEASUREMENT GEVlv_flgTarErrMinTIntk "Condition minimal temperature for target error diagnosis for intake camshaft reached" UBYTE B_TRUE 1 100 0.00 1.00000000000 BIT_MASK 0x1 FORMAT "%13.11" ECU_ADDRESS 0x700008F8 /end MEASUREMENT
/begin MEASUREMENT GEVlv_flgTarErrMinTOutl "Condition minimal temperature for target error diagnosis for outlet camshaft reached" UBYTE B_TRUE 1 100 0.00 1.00000000000 BIT_MASK 0x1 FORMAT "%13.11" ECU_ADDRESS 0x700008F7 /end MEASUREMENT
/begin MEASUREMENT GEVlv_flgTargErrDiIntkB1 "flag Intake Bank1 target error deactivated via disable mask" UBYTE B_TRUE 1 100 0.00 1.00000000000 BIT_MASK 0x1 FORMAT "%13.11" ECU_ADDRESS 0x6000F94E /end MEASUREMENT
/begin MEASUREMENT GEVlv_flgTiAftEngStop "Switch off time after engine stop (inverse logic)" UBYTE B_TRUE 1 100 0.00 1.00000000000 BIT_MASK 0x1 FORMAT "%13.11" ECU_ADDRESS 0x60039306 /end MEASUREMENT
/begin MEASUREMENT GEVlv_flgTrigRstIntkB1 "Reset condition state machine diagnosis phase actuator intake bank1" UBYTE B_TRUE 1 100 0.00 1.00000000000 BIT_MASK 0x1 FORMAT "%13.11" ECU_ADDRESS 0x6000B835 /end MEASUREMENT
/begin MEASUREMENT GEVlv_flgUBattMinDiag "Condition minimal battery voltage reached for camshaft diagnosis" UBYTE B_TRUE 1 100 0.00 1.00000000000 BIT_MASK 0x1 FORMAT "%13.11" ECU_ADDRESS 0x70000231 /end MEASUREMENT
/begin MEASUREMENT GEVlv_GovrPrmIntkIF_I.agDifSpAct "Interface class for the intake camshaft governor paramters / Change in governor deviation for the calculation of the governor d-part" SWORD kw_q0p0156 1 100 -512.0000 511.9844 FORMAT "%8.4" ECU_ADDRESS 0x500018D0 /end MEASUREMENT
/begin MEASUREMENT GEVlv_GovrPrmIntkIF_I.agDifSpActDT1 "Interface class for the intake camshaft governor paramters / Deviation of setpoint angle offset" SWORD kw_q0p0156 1 100 -512.0000 511.9844 FORMAT "%8.4" ECU_ADDRESS 0x500018D2 /end MEASUREMENT
/begin MEASUREMENT GEVlv_GovrPrmIntkIF_I.agMaxDifActAdpn "Interface class for the intake camshaft governor paramters / Maximum angle difference of filter setpoint - extrapolated actual angle for adaptation" SWORD kw_q0p0156 1 100 -512.0000 511.9844 FORMAT "%8.4" ECU_ADDRESS 0x500018D4 /end MEASUREMENT
/begin MEASUREMENT GEVlv_GovrPrmIntkIF_I.facAdpnVal "Interface class for the intake camshaft governor paramters / Factor to weight adaptation values" SWORD fak_sw_b4 1 100 -4.000000 3.999878 FORMAT "%8.6" ECU_ADDRESS 0x500018D6 /end MEASUREMENT
/begin MEASUREMENT GEVlv_GovrPrmIntkIF_I.facDPart "Interface class for the intake camshaft governor paramters / Factor for calculation of d-part" UWORD relKW_q0p0015259 1 100 0.00 99.99847 FORMAT "%8.5" ECU_ADDRESS 0x500018D8 /end MEASUREMENT
/begin MEASUREMENT GEVlv_GovrPrmIntkIF_I.facDPartRgl "Interface class for the intake camshaft governor paramters / Controller part D before softlanding modification" UWORD relKW_q0p0015259 1 100 0.00 99.99847 FORMAT "%8.5" ECU_ADDRESS 0x500018DA /end MEASUREMENT
/begin MEASUREMENT GEVlv_GovrPrmIntkIF_I.facDRaprtOilP "Interface class for the intake camshaft governor paramters / Controller part D related to oil pump" UWORD fak_uw_b8 1 100 0.00 7.999878 FORMAT "%8.6" ECU_ADDRESS 0x500018DC /end MEASUREMENT
/begin MEASUREMENT GEVlv_GovrPrmIntkIF_I.facFastIPartRgl "Interface class for the intake camshaft governor paramters / Controller part I before softlanding modification" UWORD relKW_q0p0015259 1 100 0.00 99.99847 FORMAT "%8.5" ECU_ADDRESS 0x500018DE /end MEASUREMENT
/begin MEASUREMENT GEVlv_GovrPrmIntkIF_I.facIPart "Interface class for the intake camshaft governor paramters / Factor for calculation of i-part" UWORD relKW_q0p0015259 1 100 0.00 99.99847 FORMAT "%8.5" ECU_ADDRESS 0x500018E0 /end MEASUREMENT
/begin MEASUREMENT GEVlv_GovrPrmIntkIF_I.facPPart "Interface class for the intake camshaft governor paramters / Factor for calculation of p-part" UWORD relKW_q0p0015259 1 100 0.00 99.99847 FORMAT "%8.5" ECU_ADDRESS 0x500018E2 /end MEASUREMENT
/begin MEASUREMENT GEVlv_GovrPrmIntkIF_I.facPPartOilP "Interface class for the intake camshaft governor paramters / Controller part P related to oil pump" UWORD fak_uw_b8 1 100 0.00 7.999878 FORMAT "%8.6" ECU_ADDRESS 0x500018E4 /end MEASUREMENT
/begin MEASUREMENT GEVlv_GovrPrmIntkIF_I.facPPartRgl "Interface class for the intake camshaft governor paramters / Controller part P before softlanding modification" UWORD relKW_q0p0015259 1 100 0.00 99.99847 FORMAT "%8.5" ECU_ADDRESS 0x500018E6 /end MEASUREMENT
/begin MEASUREMENT GEVlv_GovrPrmIntkIF_I.idxAdpnValAry "Interface class for the intake camshaft governor paramters / Index temperature axis point for array of adaptation values" UWORD fak_uw_b8 1 100 0.00 7.000000 FORMAT "%8.6" ECU_ADDRESS 0x500018E8 /end MEASUREMENT
/begin MEASUREMENT GEVlv_GovrPrmIntkIF_I.ratPhaMaxActvIPart "Interface class for the intake camshaft governor paramters / Flag for max active IPart" SWORD rel_sw_b200 1 100 -200.0000 199.9939 FORMAT "%8.4" ECU_ADDRESS 0x500018EA /end MEASUREMENT
/begin MEASUREMENT GEVlv_GovrPrmIntkIF_I.ratPhaMinActvIPart "Interface class for the intake camshaft governor paramters / Flag for min active IPart" SWORD rel_sw_b200 1 100 -200.0000 199.9939 FORMAT "%8.4" ECU_ADDRESS 0x500018EC /end MEASUREMENT
/begin MEASUREMENT GEVlv_GovrPrmIntkIF_I.tiEnaFastIPart "Interface class for the intake camshaft governor paramters / Time constant for Turn off delay variable" UWORD t_q0p01 1 100 0.00 655.3500 FORMAT "%8.4" ECU_ADDRESS 0x500018EE /end MEASUREMENT
/begin MEASUREMENT GEVlv_GovrPrmIntkIF_I.tiPhaSlowIPartLoLft "Interface class for the intake camshaft governor paramters / Time constant slow I-part of camshaft controller for low cam profile" UWORD zk10msxs_uw_b655 1 100 0.01000015 655.36000000 FORMAT "%12.8" ECU_ADDRESS 0x500018F0 /end MEASUREMENT
/begin MEASUREMENT GEVlv_MonPhaCsersAdjmtIntkB1_I.agDeSpActVal "Csers angle deviation monitoring class / deviation between the setpoint and actual angle" SWORD kw_q0p0156 1 100 -512.0000 511.9844 FORMAT "%8.4" ECU_ADDRESS 0x600074E4 /end MEASUREMENT
/begin MEASUREMENT GEVlv_MonPhaCsersAdjmtIntkB1_I.out_flgFlt "Csers angle deviation monitoring class / flag for CSERS fault condition" UBYTE B_TRUE 1 100 0.00 1.00000000000 BIT_MASK 0x1 FORMAT "%13.11" ECU_ADDRESS 0x600074E6 /end MEASUREMENT
/begin MEASUREMENT GEVlv_MonPhaCsersAdjmtIntkB1_I.out_flgHeal "Csers angle deviation monitoring class / flag for CSERS heal condition" UBYTE B_TRUE 1 100 0.00 1.00000000000 BIT_MASK 0x1 FORMAT "%13.11" ECU_ADDRESS 0x600074E7 /end MEASUREMENT
/begin MEASUREMENT GEVlv_nrExcddLockPinDiagIntkB1 "Number of exceedances of allowed angle threshold in locking pin diagnosis for intake bank 1" UBYTE dez 1 100 0.00 255.0 FORMAT "%5.1" ECU_ADDRESS 0x6000FC7D /end MEASUREMENT
/begin MEASUREMENT GEVlv_PhaActPosnExtrpnIntkB1_I.agPhaShiftOld "Angle extrapolation / storage of actual position up to next actualization" SWORD kw_q0p0156 1 100 -512.0000 511.9844 FORMAT "%8.4" ECU_ADDRESS 0x50000264 /end MEASUREMENT
/begin MEASUREMENT GEVlv_PhaActPosnExtrpnIntkB1_I.tiDifAgPhaLstTwoEdgesOld "Angle extrapolation / Time difference between the last two angle updates old" SLONG t_q1p0_us 1 100 0.00 2147483647.00 FORMAT "%13.2" ECU_ADDRESS 0x50000268 /end MEASUREMENT
/begin MEASUREMENT GEVlv_PhaActPosnExtrpnIntkB1_I.vPhaShift "Angle extrapolation / actual shaifting speed camshaft" SWORD vnw_q0p0305 1 100 -1000.000 999.969 FORMAT "%8.3" ECU_ADDRESS 0x5000026C /end MEASUREMENT
/begin MEASUREMENT GEVlv_PhaActPosnExtrpnSynIntkB1_I.agPhaShiftOld "Angle extrapolation / storage of actual position up to next actualization" SWORD kw_q0p0156 1 100 -512.0000 511.9844 FORMAT "%8.4" ECU_ADDRESS 0x70002E9C /end MEASUREMENT
/begin MEASUREMENT GEVlv_PhaActPosnExtrpnSynIntkB1_I.tiDifAgPhaLstTwoEdgesOld "Angle extrapolation / Time difference between the last two angle updates old" SLONG t_q1p0_us 1 100 0.00 2147483647.00 FORMAT "%13.2" ECU_ADDRESS 0x70002EA0 /end MEASUREMENT
/begin MEASUREMENT GEVlv_PhaActPosnExtrpnSynIntkB1_I.vPhaShift "Angle extrapolation / actual shaifting speed camshaft" SWORD vnw_q0p0305 1 100 -1000.000 999.969 FORMAT "%8.3" ECU_ADDRESS 0x70002EA4 /end MEASUREMENT
/begin MEASUREMENT GEVlv_PhaActPosnFilGovrIntkB1_I.agAct "Angle filter / Last measured angle" SWORD kw_q0p0156 1 100 -512.0000 511.9844 FORMAT "%8.4" ECU_ADDRESS 0x50000270 /end MEASUREMENT
/begin MEASUREMENT GEVlv_PhaActPosnFilGovrIntkB1_I.agOld1 "Angle filter / Angle value 1 raster ago" SWORD kw_q0p0156 1 100 -512.0000 511.9844 FORMAT "%8.4" ECU_ADDRESS 0x50000272 /end MEASUREMENT
/begin MEASUREMENT GEVlv_PhaActPosnFilGovrIntkB1_I.agOld2 "Angle filter / Angle value 2 rasters ago" SWORD kw_q0p0156 1 100 -512.0000 511.9844 FORMAT "%8.4" ECU_ADDRESS 0x50000274 /end MEASUREMENT
/begin MEASUREMENT GEVlv_PhaActPosnFilGovrIntkB1_I.agOld3 "Angle filter / Angle value 3 rasters ago" SWORD kw_q0p0156 1 100 -512.0000 511.9844 FORMAT "%8.4" ECU_ADDRESS 0x50000276 /end MEASUREMENT
/begin MEASUREMENT GEVlv_PhaActPosnFilGovrIntkB1_I.out_agFildSyn "Angle filter / Angle synchronous filtered angle" SWORD kw_q0p0156 1 100 -512.0000 511.9844 FORMAT "%8.4" ECU_ADDRESS 0x50000278 /end MEASUREMENT
/begin MEASUREMENT GEVlv_PhaActPosnFilGovrIntkB1_I.out_agSynAvrg "Angle filter / Average angle" SWORD kw_q0p0156 1 100 -512.0000 511.9844 FORMAT "%8.4" ECU_ADDRESS 0x5000027A /end MEASUREMENT
/begin MEASUREMENT GEVlv_PhaActPosnFilIntkB1_I.agFild "Angle filtering intake bank1 / Filtered angle" SWORD kw_q0p0156 1 100 -512.0000 511.9844 FORMAT "%8.4" ECU_ADDRESS 0x60012F88 /end MEASUREMENT
/begin MEASUREMENT GEVlv_PhaActPosnFilIntkB1_I.facFilRmpDwn "Angle filtering intake bank1 / Factor to ramp down the filter time constant after filter time expired" UWORD fak_ub_b2 1 100 0.00 1.992188 FORMAT "%8.6" ECU_ADDRESS 0x60012F8A /end MEASUREMENT
/begin MEASUREMENT GEVlv_PhaActPosnFilIntkB1_I.facTiJit "Angle filtering intake bank1 / Amplification factor for the filter time constant in case of a jittering camshaft" SWORD fak_q4p883Em4 1 100 -16.00000 15.99951 FORMAT "%8.5" ECU_ADDRESS 0x60012F8C /end MEASUREMENT
/begin MEASUREMENT GEVlv_PhaActPosnFilIntkB1_I.flgFilTiElpd "Angle filtering intake bank1 / Condition filter time elapsed" UBYTE B_TRUE 1 100 0.00 1.00000000000 BIT_MASK 0x1 FORMAT "%13.11" ECU_ADDRESS 0x60012F8E /end MEASUREMENT
/begin MEASUREMENT GEVlv_PhaActPosnFilIntkB1_I.flgPhaEnaActvDrvgCyc "Angle filtering intake bank1 / Condition camshaft has been enabled in current driving cycle" UBYTE B_TRUE 1 100 0.00 1.00000000000 BIT_MASK 0x1 FORMAT "%13.11" ECU_ADDRESS 0x60012F8F /end MEASUREMENT
/begin MEASUREMENT GEVlv_PhaActPosnFilIntkB1_I.flgTiFilRampDwn "Angle filtering intake bank1 / Condition filter time constant ramped down" UBYTE B_TRUE 1 100 0.00 1.00000000000 BIT_MASK 0x1 FORMAT "%13.11" ECU_ADDRESS 0x60012F90 /end MEASUREMENT
/begin MEASUREMENT GEVlv_PhaActPosnFilIntkB1_I.tiPT1 "Angle filtering intake bank1 / Filter time constant for actual angle filtering" UWORD t_q0p01 1 100 0.0100 655.3500 FORMAT "%8.4" ECU_ADDRESS 0x60012F92 /end MEASUREMENT
/begin MEASUREMENT GEVlv_PhaCsersDynDeactvIntkB1_I.out_flgPhaDiagEnaCsers "Csers diagnosis activation class based on angle dynamic / ." UBYTE B_TRUE 1 100 0.00 1.00000000000 BIT_MASK 0x1 FORMAT "%13.11" ECU_ADDRESS 0x50001900 /end MEASUREMENT
/begin MEASUREMENT GEVlv_PhaCsersDynDeactvIntkB1_I.GEVlv_CsersDiagAgFiltLT_I.memory "Csers diagnosis activation class based on angle dynamic / . / current lowpass value" SLONG OneToOne 1 100 -2147483648.00 2147483647.00 FORMAT "%13.2" ECU_ADDRESS 0x50001904 /end MEASUREMENT
/begin MEASUREMENT GEVlv_PhaCsersErrDstcnIntkB1_I.out_agSum "Csers diagnosis error distinction class / ." SWORD kw_q0p0156 1 100 -512.0000 511.9844 FORMAT "%8.4" ECU_ADDRESS 0x5000190C /end MEASUREMENT
/begin MEASUREMENT GEVlv_PhaDiagDFCIntkB1_I.cntrOKTestOld "Class for debouncing of camshaft error information intake bank1 / counter OK monitor 1 raster old value" UBYTE dez 1 100 0.00 255.0 FORMAT "%5.1" ECU_ADDRESS 0x600074D8 /end MEASUREMENT
/begin MEASUREMENT GEVlv_PhaDiagDFCIntkB1_I.out_cntrOkTest "Class for debouncing of camshaft error information intake bank1 / Counter of debounced OK results" UBYTE dez 1 100 0.00 255.0 FORMAT "%5.1" ECU_ADDRESS 0x600074D9 /end MEASUREMENT
/begin MEASUREMENT GEVlv_PhaDiagDFCIntkB1_I.out_cntrSlowRespTest "Class for debouncing of camshaft error information intake bank1 / Counter of debounced slow response results" UBYTE dez 1 100 0.00 255.0 FORMAT "%5.1" ECU_ADDRESS 0x600074DA /end MEASUREMENT
/begin MEASUREMENT GEVlv_PhaDiagDFCIntkB1_I.out_cntrTarErrTest "Class for debouncing of camshaft error information intake bank1 / Counter of debounced target error results" UBYTE dez 1 100 0.00 255.0 FORMAT "%5.1" ECU_ADDRESS 0x600074DB /end MEASUREMENT
/begin MEASUREMENT GEVlv_PhaDiagDFCIntkB1_I.out_flgInhbFrzFrmEntry "Class for debouncing of camshaft error information intake bank1 / flag out for inhibting freeze frame entry" UBYTE B_TRUE 1 100 0.00 1.00000000000 BIT_MASK 0x1 FORMAT "%13.11" ECU_ADDRESS 0x600074DE /end MEASUREMENT
/begin MEASUREMENT GEVlv_PhaGovrPostDriveIntkB1_I.ratPha "Class instance for oil valve cleaning of intake camshaft bank1 during afterrun in camshaft governor / Duty cycle during afterrun" UWORD tv_uw_b100 1 100 0.00 99.99847 FORMAT "%8.5" ECU_ADDRESS 0x50001918 /end MEASUREMENT
/begin MEASUREMENT GEVlv_PhaPidGovrIntkB1_I.agDifSpAct "PID governor intake camshaft bank 1 / Setpoint actual angle difference" SWORD kw_q0p0156 1 100 -512.0000 511.9844 FORMAT "%8.4" ECU_ADDRESS 0x50001920 /end MEASUREMENT
/begin MEASUREMENT GEVlv_PhaPidGovrIntkB1_I.agDifSpActDT1 "PID governor intake camshaft bank 1 / Change of the setpoint actual angle difference with respect to the last value" SWORD kw_q0p0156 1 100 -512.0000 511.9844 FORMAT "%8.4" ECU_ADDRESS 0x50001922 /end MEASUREMENT
/begin MEASUREMENT GEVlv_PhaPidGovrIntkB1_I.agDifSpStopIPart "PID governor intake camshaft bank 1 / Change of setpoint angle throughout the last 3 calculation steps" SWORD kw_q0p0156 1 100 -512.0000 511.9844 FORMAT "%8.4" ECU_ADDRESS 0x50001926 /end MEASUREMENT
/begin MEASUREMENT GEVlv_PhaPidGovrIntkB1_I.agSp1 "PID governor intake camshaft bank 1 / Setpoint angle t-1" SWORD kw_q0p0156 1 100 -512.0000 511.9844 FORMAT "%8.4" ECU_ADDRESS 0x5000192A /end MEASUREMENT
/begin MEASUREMENT GEVlv_PhaPidGovrIntkB1_I.agSp2 "PID governor intake camshaft bank 1 / Setpoint angle t-2" SWORD kw_q0p0156 1 100 -512.0000 511.9844 FORMAT "%8.4" ECU_ADDRESS 0x5000192C /end MEASUREMENT
/begin MEASUREMENT GEVlv_PhaPidGovrIntkB1_I.agSp3 "PID governor intake camshaft bank 1 / Setpoint angle t-3" SWORD kw_q0p0156 1 100 -512.0000 511.9844 FORMAT "%8.4" ECU_ADDRESS 0x5000192E /end MEASUREMENT
/begin MEASUREMENT GEVlv_PhaPidGovrIntkB1_I.flgCalcSlowIPartLimCalc "PID governor intake camshaft bank 1 / Condition limitation of slow I-Part camshaft controller" UBYTE B_TRUE 1 100 0.00 1.00000000000 BIT_MASK 0x1 FORMAT "%13.11" ECU_ADDRESS 0x50001930 /end MEASUREMENT
/begin MEASUREMENT GEVlv_PhaPidGovrIntkB1_I.flgEnaFastIPart "PID governor intake camshaft bank 1 / Release fast I-part" UBYTE B_TRUE 1 100 0.00 1.00000000000 BIT_MASK 0x1 FORMAT "%13.11" ECU_ADDRESS 0x50001931 /end MEASUREMENT
/begin MEASUREMENT GEVlv_PhaPidGovrIntkB1_I.flgEnaSlowIPart "PID governor intake camshaft bank 1 / Release slow I-part" UBYTE B_TRUE 1 100 0.00 1.00000000000 BIT_MASK 0x1 FORMAT "%13.11" ECU_ADDRESS 0x50001932 /end MEASUREMENT
/begin MEASUREMENT GEVlv_PhaPidGovrIntkB1_I.ratDeltaPhaSlowIPart "PID governor intake camshaft bank 1 / delta slow I-part camshaft controller" SWORD rel_sw_b200 1 100 -200.0000 199.9939 FORMAT "%8.4" ECU_ADDRESS 0x50001934 /end MEASUREMENT
/begin MEASUREMENT GEVlv_PhaPidGovrIntkB1_I.ratPha "PID governor intake camshaft bank 1 / Duty cycle of the governor" SWORD rel_sw_b200 1 100 -200.0000 199.9939 FORMAT "%8.4" ECU_ADDRESS 0x50001936 /end MEASUREMENT
/begin MEASUREMENT GEVlv_PhaPidGovrIntkB1_I.ratPhaDPart "PID governor intake camshaft bank 1 / Duty cycle D-part" SWORD rel_sw_b200 1 100 -200.0000 199.9939 FORMAT "%8.4" ECU_ADDRESS 0x50001938 /end MEASUREMENT
/begin MEASUREMENT GEVlv_PhaPidGovrIntkB1_I.ratPhaFastIPart "PID governor intake camshaft bank 1 / Duty cycle fast I-part" SWORD rel_sw_b200 1 100 -200.0000 199.9939 FORMAT "%8.4" ECU_ADDRESS 0x5000193A /end MEASUREMENT
/begin MEASUREMENT GEVlv_PhaPidGovrIntkB1_I.ratPhaFastIPartStore "PID governor intake camshaft bank 1 / stored fast I-Part of camshaft controller" SWORD rel_sw_b200 1 100 -200.0000 199.9939 FORMAT "%8.4" ECU_ADDRESS 0x5000193C /end MEASUREMENT
/begin MEASUREMENT GEVlv_PhaPidGovrIntkB1_I.ratPhaIPart "PID governor intake camshaft bank 1 / Duty cycle I-part" SWORD rel_sw_b200 1 100 -200.0000 199.9939 FORMAT "%8.4" ECU_ADDRESS 0x5000193E /end MEASUREMENT
/begin MEASUREMENT GEVlv_PhaPidGovrIntkB1_I.ratPhaPPart "PID governor intake camshaft bank 1 / Duty cycle P-part" SWORD rel_sw_b200 1 100 -200.0000 199.9939 FORMAT "%8.4" ECU_ADDRESS 0x50001940 /end MEASUREMENT
/begin MEASUREMENT GEVlv_PhaPidGovrIntkB1_I.ratPhaSlowIPart "PID governor intake camshaft bank 1 / Duty cycle slow I-part" SWORD rel_sw_b200 1 100 -200.0000 199.9939 FORMAT "%8.4" ECU_ADDRESS 0x50001942 /end MEASUREMENT
/begin MEASUREMENT GEVlv_PhaPidGovrIntkB1_I.ratPhaSlowIPartLoLift "PID governor intake camshaft bank 1 / Duty cycle I-part for small cam profile" SWORD rel_sw_b200 1 100 -200.0000 199.9939 FORMAT "%8.4" ECU_ADDRESS 0x50001944 /end MEASUREMENT
/begin MEASUREMENT GEVlv_PhaPidGovrIntkB1_I.stFastIPart "PID governor intake camshaft bank 1 / Status of flags in Fast I Part controller component" UBYTE OneToOne 1 100 0.00 255.0 FORMAT "%5.1" ECU_ADDRESS 0x50001946 /end MEASUREMENT
/begin MEASUREMENT GEVlv_PhaPidGovrIntkB1_I.stGovr "PID governor intake camshaft bank 1 / Status of the governor" UBYTE OneToOne 1 100 0.00 255.0 FORMAT "%5.1" ECU_ADDRESS 0x50001947 /end MEASUREMENT
/begin MEASUREMENT GEVlv_ratAgShiftMaxShiftIntkB1 "Weighting factor camshaft overlap (intake bank 1)" UBYTE fak_q0p0039 1 100 0.00 0.9961 ECU_ADDRESS 0x6000FC7C /end MEASUREMENT
/begin MEASUREMENT GEVlv_ratAgShiftMaxShiftOutlB1 "Weighting factor camshaft overlap (outlet bank 1)" UBYTE fak_q0p0039 1 100 0.00 0.9961 ECU_ADDRESS 0x6000FC7B /end MEASUREMENT
/begin MEASUREMENT GEVlv_ratPhaHoldIPartIntkB1 "Hold duty cycle for camshaft intake bank 1" SWORD rel_sw_b200 1 100 0.00 199.9939 FORMAT "%8.4" ECU_ADDRESS 0x600074D0 /end MEASUREMENT
/begin MEASUREMENT GEVlv_ratPhaIntkB1 "duty cycle cam phase actuator intake bank1" SWORD rel_sw_b100 1 100 0.00 99.99695 FORMAT "%8.5" ECU_ADDRESS 0x6000992C /end MEASUREMENT
/begin MEASUREMENT GEVlv_ratPhaOutlB1 "duty cycle cam phase actuator outlet bank1" SWORD rel_sw_b100 1 100 0.00 99.99695 FORMAT "%8.5" ECU_ADDRESS 0x6000992A /end MEASUREMENT
/begin MEASUREMENT GEVlv_ratPhaSpclIntvIntkB1 "Special duty cycle for camshaft intake bank 1" SWORD rel_sw_b100 1 100 -100.0000 99.9969 FORMAT "%8.4" ECU_ADDRESS 0x600148E6 /end MEASUREMENT
/begin MEASUREMENT GEVlv_stGovrDrctIntkB1 "state governor intake camshaft bank1, direct access" UBYTE OneToOne 1 100 0.00 255.0 FORMAT "%5.1" ECU_ADDRESS 0x6000FC7A /end MEASUREMENT
/begin MEASUREMENT GEVlv_stGovrDrctOutlB1 "state governor outlet camshaft bank1, direct access" UBYTE OneToOne 1 100 0.00 255.0 FORMAT "%5.1" ECU_ADDRESS 0x6000FC79 /end MEASUREMENT
/begin MEASUREMENT GEVlv_stGovrIntkB1 "state governor intake camshaft bank1" UBYTE OneToOne 1 100 0.00 255.0 FORMAT "%5.1" ECU_ADDRESS 0x60014ABA /end MEASUREMENT
/begin MEASUREMENT GEVlv_stGovrOutlB1 "state governor outlet camshaft bank1" UBYTE OneToOne 1 100 0.00 255.0 FORMAT "%5.1" ECU_ADDRESS 0x6000FC78 /end MEASUREMENT
/begin MEASUREMENT GEVlv_stPhaDiagIntkB1 "Status of camshaft diagnosis intake bank1" UBYTE OneToOne 1 100 0.00 255.0 FORMAT "%5.1" ECU_ADDRESS 0x6000FC77 /end MEASUREMENT
/begin MEASUREMENT GEVlv_stPhaDiagResIntkB1 "Result of camshaft diagnosis intake bank 1" UBYTE OneToOne 1 100 0.00 255.0 FORMAT "%5.1" ECU_ADDRESS 0x6000FC76 /end MEASUREMENT
/begin MEASUREMENT GEVlv_tiDebPhaCsersIntk "Debounce time of a fault respectively healing result (intake camshaft during CSERS)" UWORD t_q0p01 1 100 0.00 12.50000 FORMAT "%8.5" ECU_ADDRESS 0x6000945A /end MEASUREMENT
/begin MEASUREMENT GEVlv_tiDifAgPhaLstEdgeIntkB1 "time difference betw. last equidistant phase edge and data transfer for actual position calculation intake bank 1" SLONG t_q1p0_us 1 100 0.00 2147483647.00 FORMAT "%13.2" ECU_ADDRESS 0x600003DC /end MEASUREMENT
/begin MEASUREMENT GEVlv_tiDifAgPhaLstTwoEdgesIntkB1 "time difference betw. two equidistant phase edges for actual position calculation intake bank 1" SLONG t_q1p0_us 1 100 0.00 2147483647.00 FORMAT "%13.2" ECU_ADDRESS 0x600003E0 /end MEASUREMENT
/begin MEASUREMENT GEVlv_tiMonCycPhaDiagIntk "Duration monitoring cycle diagnosis phase actuator intake" UBYTE t_q0p05 1 100 0.00 12.75 FORMAT "%5.2" ECU_ADDRESS 0x6000FC75 /end MEASUREMENT
/begin MEASUREMENT GEVlv_tiReaSpThdPhaDiagIntk "Allowed time for reaching setpoint threshold diagnosis phase actuator intake" UBYTE t_q0p05 1 100 0.00 12.75 FORMAT "%5.2" ECU_ADDRESS 0x6000FC74 /end MEASUREMENT
/begin MEASUREMENT GGDSKV_ctReIni100ms "Reini counter for GGDSKV 100ms proc" UBYTE OneToOne 1 100 0.00 255.0 FORMAT "%5.1" ECU_ADDRESS 0x6000B82D /end MEASUREMENT
/begin MEASUREMENT GGDSKV_ctReIni10ms "Reini Counter to convey Proc_Reini occured" UBYTE OneToOne 1 100 0.00 255.0 FORMAT "%5.1" ECU_ADDRESS 0x6000B82C /end MEASUREMENT
/begin MEASUREMENT GGDSKV_ctReIni1ms "Reini counter for GGDSKV 1ms proc" UBYTE OneToOne 1 100 0.00 255.0 FORMAT "%5.1" ECU_ADDRESS 0x70002E98 /end MEASUREMENT
/begin MEASUREMENT GGDSKV_flgDSMTripFinshd "trip change of DSM finished flag for FC GGDSKV" UBYTE B_TRUE 1 100 0.00 1.00000000000 BIT_MASK 0x1 FORMAT "%13.11" ECU_ADDRESS 0x6000B82B /end MEASUREMENT
/begin MEASUREMENT GGFETH_ctReIni "Counter for implementation of ReIni task removal in GGFETH" UWORD OneToOne 1 100 0.00 65535.00 FORMAT "%8.2" ECU_ADDRESS 0x600074BE /end MEASUREMENT
/begin MEASUREMENT kfethrmp_w "ramp speed for interpolation of ethanol content within partial volume" UWORD k100ms_uw_b10 1 100 0.00 9.999847 FORMAT "%8.6" ECU_ADDRESS 0x600074BC /end MEASUREMENT
/begin MEASUREMENT PhaCsersDenomComplIntkB1_I.out_flgRelsDenom "class of physical IUMPR-Denominator complete calculation intake camshaft bank1 (coldstart catheating) / flag denoiminator completion for CSERS diagnosis" UBYTE B_TRUE 1 100 0.00 1.00000000000 BIT_MASK 0x1 FORMAT "%13.11" ECU_ADDRESS 0x500057C0 /end MEASUREMENT
/begin MEASUREMENT prrohr_w_msg "Unfiltered rail pressure real value (relative pressure)" UWORD p_q0p0005 1 100 0.00 32.76750 FORMAT "%8.5" ECU_ADDRESS 0x70003776 /end MEASUREMENT
/begin MEASUREMENT prroh_w_msg "unfiltered rail pressure real value (abs.)" UWORD p_q0p0005 1 100 0.00 32.76750 FORMAT "%8.5" ECU_ADDRESS 0x70003778 /end MEASUREMENT
/begin MEASUREMENT sggfeth_msg "status byte for GGFETH" UBYTE dez 1 100 0.00 255.0 FORMAT "%5.1" ECU_ADDRESS 0x6000F71F /end MEASUREMENT
/begin MEASUREMENT upr1ms_w_msg "Voltage rail pressure sensure in 1 ms timing" UWORD spg_uw_q0p00488 1 100 0.00 319.9951 FORMAT "%8.4" ECU_ADDRESS 0x70003752 /end MEASUREMENT
/begin MEASUREMENT uprdiff_w "difference voltage between min/max over one cycle" UWORD spg_q1p221Em3_V 1 100 0.00 79.99878 FORMAT "%8.5" ECU_ADDRESS 0x600074C6 /end MEASUREMENT
/begin MEASUREMENT uprmn_w "min voltage rail pressure sensor" UWORD spg_q1p221Em3_V 1 100 0.00 79.99878 FORMAT "%8.5" ECU_ADDRESS 0x70002E96 /end MEASUREMENT
/begin MEASUREMENT uprmx_w "ma voltage rail pressure sensor" UWORD spg_q1p221Em3_V 1 100 0.00 79.99878 FORMAT "%8.5" ECU_ADDRESS 0x70002E94 /end MEASUREMENT
/begin MEASUREMENT uprm_inj_w "mean voltage rail pressure sensor injector value" UWORD spg_q3p052em4 1 100 0.00 19.99969 FORMAT "%8.5" ECU_ADDRESS 0x70002E92 /end MEASUREMENT
/begin MEASUREMENT uprm_w "mean voltage rail pressure sensor" UWORD spg_q3p052em4 1 100 0.00 19.99969 FORMAT "%8.5" ECU_ADDRESS 0x70002E90 /end MEASUREMENT
/begin MEASUREMENT uprm_w_msg "mean voltage rail pressure sensor" UWORD spg_q3p052em4 1 100 0.00 19.99969 FORMAT "%8.5" ECU_ADDRESS 0x70003750 /end MEASUREMENT
/begin MEASUREMENT vtethold_w "old-value of fuel consumption to determine duration of ethanol content invalidity" SWORD vol_q7p8125Em3_l 1 100 -256.0000 255.9922 FORMAT "%8.4" ECU_ADDRESS 0x600074BA /end MEASUREMENT
/begin MEASUREMENT vtethstl_w "integrated consumption for partial volume of dead volume between ethanol sensor and injection valve" UWORD vol_q6p1035Em7 1 100 0.00 0.03999939 FORMAT "%10.8" ECU_ADDRESS 0x600392B4 /end MEASUREMENT
/begin FUNCTION GEVCtl_ReqRefAdpn "3.13.0    Request adaption of camshaft reference position"
 /begin DEF_CHARACTERISTIC GEVCtl_agDeStyCdnAdpn_C GEVCtl_agMaxDeRefIntk_C GEVCtl_agMaxDeRefLoLftIntk_C GEVCtl_agMaxDeRefToRelsAdpn_C GEVCtl_agMaxDeStyCdnAdpn_C GEVCtl_agMinDeAftLstAbortAdpn_C GEVCtl_agMinDeSpAftLstAbortAdpn_C GEVCtl_agMinDeToRelsAdpn_C GEVCtl_cntrAdpnDiFcoCdn_C GEVCtl_nEngAdpnHys_C GEVCtl_nEngMaxFineAdpnIntk_C GEVCtl_nEngMaxFirstAdpnIntk_C GEVCtl_nEngMinFineAdpnIntk_C GEVCtl_nEngMinFirstAdpnIntk_C GEVCtl_nrMaxAdpn_C GEVCtl_ratLoadAdpnHys_C GEVCtl_ratLoadFineAdpnAbortIntk_C GEVCtl_ratLoadMaxFineAdpnIntk_C GEVCtl_ratLoadMaxFirstAdpnIntk_C GEVCtl_ratLoadMinFineAdpnIntk_C GEVCtl_ratLoadMinFirstAdpnIntk_C GEVCtl_ratLoadThdDiFcoIntk_C GEVCtl_stReqRefAdpn_C GEVCtl_tEngDeltaNxtFineAdpnIntk_C GEVCtl_tEngMaxFineAdpn_C GEVCtl_tEngMinFineAdpn_C GEVCtl_tEngMinFirstAdpn_C GEVCtl_tiAgFilStyCdnAdpn_C GEVCtl_tiDetStyCdnAdpn_C GEVCtl_tiDiFcoCdnAftStrtIntk_C GEVCtl_tiDlyAdpnAftStrt_C GEVCtl_tiMaxFineAdpn_C GEVCtl_tiMaxFirstAdpn_C GEVCtl_tiMaxReqSpclRat_C GEVCtl_tiMinSpDelta_C GEVCtl_tiRefPosnDlyMax_C GEVCtl_tiRefPosnDly_T GEVCtl_tOilAdpnMax_C /end DEF_CHARACTERISTIC
 /begin IN_MEASUREMENT B_khakt_msg B_kh_msg B_sa_msg B_vhegvse_msg B_vhenwsspe_msg CEngDsT_t CoEng_stMai Epm_nEng GEVCtl_agRefPosnIntkB1 GEVCtl_agSpDrvDmdIntk GEVCtl_agSpIntkB1 GEVCtl_agSpMaxIntk GEVCtl_flgAdpnActvdTstrIntk GEVCtl_flgPhaActrTestEnaFctIntk GEVCtl_flgPhaToRefPosnSpReaIntk GEVCtl_flgRefAdpnTstrIntk GEVCtl_flgReqErrDstcnIntk GEVCtl_ratLoad GEVCtl_tOilCylHd GEVlv_agIntkB1 GEVlv_flgAdapErrSimIntk GEVlv_flgPhaAdpnVldIntk GEVlv_flgPhaErrSimIntk rl_w_msg SyC_stSub /end IN_MEASUREMENT
 /begin OUT_MEASUREMENT GEVCtl_cntrAdpnIntk GEVCtl_flgAdpnReqSpclRatIntkB1 GEVCtl_flgAdpnTstrFinshdIntk GEVCtl_flgCamsftErrDstcn GEVCtl_flgErrDstcnFinshdIntk GEVCtl_flgPhaSpToRefPosnIntk GEVCtl_flgPhaToRefPosnIntk GEVCtl_flgReqFirstAdpnIntk GEVCtl_flgReqRefAdpnIntk /end OUT_MEASUREMENT
 /begin LOC_MEASUREMENT GEVCtl_flgEnaRngFineAdpnIntk GEVCtl_flgInhbFineAdpnIntk GEVCtl_flgOperRngFineAdpnIntk GEVCtl_flgOperRngFirstAdpnIntk GEVCtl_flgRefAdpnIntk GEVCtl_flgReqRefAdpnClr GEVCtl_nEngFild GEVCtl_ratLoadFild GEVCtl_tEngRefNxtAdpnIntk /end LOC_MEASUREMENT
 FUNCTION_VERSION "3.13.0" /end FUNCTION
/begin FUNCTION GEVCtl_ReqRefAdpnTstr "1.5.3     Request adaption of camshaft reference position by tester demand"
 /begin DEF_CHARACTERISTIC GEVCtl_nHysAdpnTstr_C GEVCtl_nMinAdpnTstr_C GEVCtl_stReqRefAdpnTstr_C GEVCtl_tOilMaxAdpnTstr_C GEVCtl_tWtrMaxAdpnTstr_C GEVCtl_tWtrMinAdpnTstr_C /end DEF_CHARACTERISTIC
 /begin IN_MEASUREMENT CEngDsT_t CoEng_stMai Epm_nEngLRes GEVCtl_flgAdpnTstrFinshdIntk GEVCtl_stCamsftFineAdpnIntk_AbrtReasonMsg GEVCtl_stCamsftFineAdpnIntk_StMsg GEVCtl_stCamsftFineAdpnIntk_StrtPermMsg GEVCtl_stCamsftRefAdpn_AbrtReasonMsg GEVCtl_stCamsftRefAdpn_StMsg GEVCtl_stCamsftRefAdpn_StrtPermMsg GEVCtl_tOilCylHd SyC_stSub /end IN_MEASUREMENT
 /begin OUT_MEASUREMENT GEVCtl_flgAdpnActvdTstrIntk GEVCtl_flgRefAdpnTstrIntk GEVCtl_flgReqRefAdpn /end OUT_MEASUREMENT
 /begin LOC_MEASUREMENT GEVCtl_flgRelsAdpnTstr /end LOC_MEASUREMENT
 FUNCTION_VERSION "1.5.3" /end FUNCTION
/begin FUNCTION GEVCtl_VlvLftCoorn "3.4.0     Coordination of Valve Lift Switching"
 /begin DEF_CHARACTERISTIC GEVCtl_cntrDlyChrgDetrmIntkNegDif_C GEVCtl_cntrDlyChrgDetrmIntkPosDif_C GEVCtl_ratLoadDeltaVlvLftIntkThd_C /end DEF_CHARACTERISTIC
 /begin REF_CHARACTERISTIC GEVCtl_stPhaAdpr_C /end REF_CHARACTERISTIC
 /begin IN_MEASUREMENT B_vhegfe_msg drldvls_w_msg VlvLft_nrCylSyncIntk_msg /end IN_MEASUREMENT
 /begin OUT_MEASUREMENT GEVCtl_flgStdLftChrgDetrmIntk GEVCtl_flgStdLftHwIntk GEVCtl_flgStdLftSyncIntk GEVCtl_nrCylSyncVlvLftIntk /end OUT_MEASUREMENT
 /begin LOC_MEASUREMENT GEVCtl_cntrDlyChrgDetrmIntkVlvLftSwt /end LOC_MEASUREMENT
 FUNCTION_VERSION "3.4.0" /end FUNCTION
/begin FUNCTION GEVCtl_VlvLftEna "1.6.0     Enable Conditions Valve Lift"
 /begin DEF_CHARACTERISTIC GEVCtl_facThdWrmVlvLftEnaIntk_C GEVCtl_nEngMaxVlvLftEnaHys_C GEVCtl_nEngMaxVlvLftEna_C GEVCtl_pOilMinVlvLftEnaHigh_C GEVCtl_pOilMinVlvLftEnaLow_C GEVCtl_stVlvLftEna_C GEVCtl_tEngMaxVlvLftEna_C GEVCtl_tEngMinVlvLftEna_C GEVCtl_tiDlyNormStrtVlvLftEna_C GEVCtl_tOilMaxVlvLftEna_C GEVCtl_tOilMinVlvLftEna_C GEVCtl_tOilSwmpMaxVlvLftEna_C GEVCtl_tOilSwmpMinVlvLftEna_C GEVCtl_uBattMaxVlvLftEna_C GEVCtl_uBattMinVlvLftEna_C /end DEF_CHARACTERISTIC
 /begin IN_MEASUREMENT BattU_u B_vheg_msg CEngDsT_t CoEng_stMai Epm_nEngLRes GEVCtl_facTranColdWrmIntk GEVCtl_flgPhaEnaIntk GEVCtl_flgPhaEnaPOil GEVCtl_tOilCylHd OilP_p OilSwmpT_t SyC_stSub /end IN_MEASUREMENT
 /begin OUT_MEASUREMENT GEVCtl_flgIntkVlvLftEna /end OUT_MEASUREMENT
 /begin LOC_MEASUREMENT GEVCtl_flgEngStrtCdnVlvLftEna /end LOC_MEASUREMENT
 FUNCTION_VERSION "1.6.0" /end FUNCTION
/begin FUNCTION GEVCtl_VlvOpenClsd "13.2.2    Calculation of the Opening and Closing Angles for the Intake and Outlet Valves"
 /begin DEF_CHARACTERISTIC GEVCtl_agClsdOutl_C GEVCtl_agOffsVlvOpenIntk_C GEVCtl_agOffsVlvOpenSpclLftIntk_C GEVCtl_agWidthCamProfIntk_C GEVCtl_agWidthCamProfOutl_C GEVCtl_agWidthCamProfSpclLftIntk_C /end DEF_CHARACTERISTIC
 /begin REF_CHARACTERISTIC GEVCtl_stPhaAdpr_C /end REF_CHARACTERISTIC
 /begin IN_MEASUREMENT B_homagrs_msg B_vhefeps_msg B_vhegs_msg GEVCtl_agSpHomHiLftIntk GEVCtl_agSpHomIntk GEVCtl_agSpHomLoLftIntk GEVCtl_agSpIntkB1 GEVCtl_agSpMaxIntk GEVCtl_flgSpSpclIntkVlvLft GEVCtl_flgStdLftChrgDetrmIntk GEVlv_agFildIntkB1 GEVlv_flgPhaActrErrSuspcIntkB1 SyC_stSub /end IN_MEASUREMENT
 /begin OUT_MEASUREMENT GEVCtl_agDifStdSpclLftClsdIntk GEVCtl_agDifStdSpclLftOffsIntk GEVCtl_agDifStdSpclLftOpenIntk GEVCtl_agIntkClsd GEVCtl_agIntkClsd_a GEVCtl_agIntkOpen GEVCtl_agIntkOpen_a GEVCtl_agOutlClsd GEVCtl_agOutlClsd_a GEVCtl_agOutlOpen GEVCtl_agSpHomIntkClsd GEVCtl_agSpHomIntkOpen GEVCtl_agSpHomOutlClsd GEVCtl_agSpHomOutlOpen GEVCtl_agSpHomVlvOvl GEVCtl_agSpIntkClsd GEVCtl_agSpIntkHiLftIntkClsd GEVCtl_agSpIntkHiLftIntkOpen GEVCtl_agSpIntkHiLftOutlClsd GEVCtl_agSpIntkHiLftOutlOpen GEVCtl_agSpIntkLoLftIntkClsd GEVCtl_agSpIntkLoLftIntkOpen GEVCtl_agSpIntkLoLftOutlClsd GEVCtl_agSpIntkLoLftOutlOpen GEVCtl_agSpIntkOpen GEVCtl_agSpOutlClsd GEVCtl_agSpOutlOpen GEVCtl_agSpVlvOvl GEVCtl_flgActAgStdLftIntk GEVCtl_flgCalcSpIntkHiLft /end OUT_MEASUREMENT
 /begin LOC_MEASUREMENT GEVCtl_agClsdOutl GEVCtl_agOffsVlvOpenIntk GEVCtl_agOffsVlvOpenPredIntk GEVCtl_agSpChrgDetrmIntk GEVCtl_agSpHomVlvOvlBg GEVCtl_agWidthCamPredIntk GEVCtl_agWidthCamProfIntk GEVCtl_agWidthCamProfOutl GEVCtl_flgPredStdVlvLft /end LOC_MEASUREMENT
 FUNCTION_VERSION "13.2.2" /end FUNCTION
/begin FUNCTION GEVlv_LockPinDiag "2.7.0     Diagnosis Camshaft Locking Position"
 /begin DEF_CHARACTERISTIC GEVlv_agAllwdDeLockPosn_C GEVlv_flgStrtStopLockPinDiagDfcFinal_C GEVlv_nMinForValRes_C GEVlv_nrAgForOkResMin_C GEVlv_nrExcddAgThd_C GEVlv_nrPsblInvldAg_C GEVlv_tiAbortLockPinDiag_C GEVlv_tiAftEngStop_C GEVlv_tiMinEngOffLockPinDiagEna_T /end DEF_CHARACTERISTIC
 /begin IN_MEASUREMENT B_sta_msg CoEng_stMai EngStrt_stRstrtRsn Epm_nEngLRes Epm_stSpd GEVCtl_agLockPosnIntkB1 GEVCtl_flgPhaEnaIntk GEVCtl_tOilCylHd GEVlv_agIntkB1 GEVlv_flgPhaAdpnVldIntk SyC_stSub TiOff_stTiStrtEndOff TiOff_tiStrtEndOff /end IN_MEASUREMENT
 /begin OUT_MEASUREMENT GEVlv_flgLockPinDiagEnaIntkB1 GEVlv_flgLockPinDiagResIntkB1 GEVlv_nrExcddLockPinDiagIntkB1 /end OUT_MEASUREMENT
 /begin LOC_MEASUREMENT GEVlv_cntrAutStrt GEVlv_cntrLockPinDiagIntkB1_I.agOld GEVlv_cntrLockPinDiagIntkB1_I.flgFltRes GEVlv_cntrLockPinDiagIntkB1_I.flgNrAllwdExcdcRea GEVlv_cntrLockPinDiagIntkB1_I.flgOkRes GEVlv_cntrLockPinDiagIntkB1_I.nrCamsftSample GEVlv_cntrLockPinDiagIntkB1_I.nrExcddAgThd GEVlv_flgAbortDiagIntkB1 GEVlv_flgCalcLockPinDiagEna GEVlv_flgCalcnEnaIntkB1 GEVlv_flgDsmRstLockPinDiag GEVlv_flgEngReStrtRstLockPinDiag GEVlv_flgLockPinDiagEna GEVlv_flgMinEngOffLockpinDiagEna GEVlv_flgPhyCdnLockDiagIntkB1 GEVlv_flgTiAftEngStop /end LOC_MEASUREMENT
 FUNCTION_VERSION "2.7.0" /end FUNCTION
/begin FUNCTION GEVlv_PhaActPosn "2.10.1    Actual positions of phase shifted camshaft"
 /begin DEF_CHARACTERISTIC GEVCtl_agLockPosnIntk_C GEVCtl_agLockPosnOutl_C GEVCtl_agMaxIntk_C GEVCtl_agMinIntk_C GEVCtl_agRefPosnIntk_C GEVCtl_agRefPosnOutl_C GEVlv_agDifJitDetdIntk_C GEVlv_agMaxDiffFildUnFild_C GEVlv_agMaxDiffMdnUnFildIntk_C GEVlv_agMaxGovrDeAgFildg_C GEVlv_agMaxGovrDeIntkMdn_C GEVlv_agRngRefPosnReaIntk_C GEVlv_facActIntkAgFildgSyn_M GEVlv_facCorrnShftSpd_T GEVlv_facJitPT1MaxIntk_C GEVlv_facTiSumndJitIntk_T GEVlv_nMaxPhaExtrpn_C GEVlv_nMaxPosnFil_C GEVlv_nMinPhaExtrpnSynFildHys_C GEVlv_nMinPhaExtrpnSynFild_C GEVlv_stActAgFiltIntk_C GEVlv_stActPosnExtrpn_C GEVlv_tiAgFilPT1Intk_T GEVlv_tiJitActvMinIntk_C GEVlv_tiJitEnaIntk_M /end DEF_CHARACTERISTIC
 /begin REF_CHARACTERISTIC GEVCtl_agOffsSpcltoStdLftIntk_C GEVCtl_stPhaAdpr_C /end REF_CHARACTERISTIC
 /begin IN_MEASUREMENT CoEng_stMai Epm_nEng Epm_nEngLRes GEVCtl_agSpIntkB1 GEVCtl_flgPhaEnaIntk GEVCtl_flgStdLftChrgDetrmIntk GEVCtl_tOilCylHd GEVlv_stGovrIntkB1 SyC_stSub /end IN_MEASUREMENT
 /begin OUT_MEASUREMENT GEVCtl_agLockPosnIntkB1 GEVCtl_agMaxAdpdIntk GEVCtl_agMaxAdpdIntkB1 GEVCtl_agMinAdpdIntk GEVCtl_agMinAdpdIntkB1 GEVCtl_agRefPosnDrctIntkB1 GEVCtl_agRefPosnIntkB1 GEVCtl_agSpMaxIntk GEVCtl_agSpMinIntk GEVCtl_flgPhaRefPosnRea GEVlv_agCurrLftIntkB1 GEVlv_agDrctIntkB1 GEVlv_agExtrpnCurrLftIntkB1 GEVlv_agExtrpnIntkB1 GEVlv_agExtrpnSynIntkB1 GEVlv_agFildIntkB1 GEVlv_agIntkB1 GEVlv_agMaxShiftIntk GEVlv_agOvlShiftB1 GEVlv_agShiftIntkB1 GEVlv_agSynExtrpnIntkB1 GEVlv_flgPhaAdpnVldIntk GEVlv_ratAgShiftMaxShiftIntkB1 GEVlv_ratAgShiftMaxShiftOutlB1 /end OUT_MEASUREMENT
 /begin LOC_MEASUREMENT GEVlv_agExtrpnPosnSyncIntkB1_a GEVlv_agExtrpnPosnSyncSrtgIntkB1_a GEVlv_agFildSynIntkB1 GEVlv_agOldIntkB1 GEVlv_flgPhaEnaDrvgCycIntk GEVlv_PhaActPosnExtrpnIntkB1_I.agPhaShiftOld GEVlv_PhaActPosnExtrpnIntkB1_I.tiDifAgPhaLstTwoEdgesOld GEVlv_PhaActPosnExtrpnIntkB1_I.vPhaShift GEVlv_PhaActPosnExtrpnSynIntkB1_I.agPhaShiftOld GEVlv_PhaActPosnExtrpnSynIntkB1_I.tiDifAgPhaLstTwoEdgesOld GEVlv_PhaActPosnExtrpnSynIntkB1_I.vPhaShift GEVlv_PhaActPosnFilGovrIntkB1_I.agAct GEVlv_PhaActPosnFilGovrIntkB1_I.agOld1 GEVlv_PhaActPosnFilGovrIntkB1_I.agOld2 GEVlv_PhaActPosnFilGovrIntkB1_I.agOld3 GEVlv_PhaActPosnFilGovrIntkB1_I.out_agFildSyn GEVlv_PhaActPosnFilGovrIntkB1_I.out_agSynAvrg GEVlv_PhaActPosnFilIntkB1_I.agFild GEVlv_PhaActPosnFilIntkB1_I.facFilRmpDwn GEVlv_PhaActPosnFilIntkB1_I.facTiJit GEVlv_PhaActPosnFilIntkB1_I.flgFilTiElpd GEVlv_PhaActPosnFilIntkB1_I.flgPhaEnaActvDrvgCyc GEVlv_PhaActPosnFilIntkB1_I.flgTiFilRampDwn GEVlv_PhaActPosnFilIntkB1_I.tiPT1 GEVlv_tiDifAgPhaLstEdgeIntkB1 GEVlv_tiDifAgPhaLstTwoEdgesIntkB1 /end LOC_MEASUREMENT
 FUNCTION_VERSION "2.10.1" /end FUNCTION
/begin FUNCTION GEVlv_PhaCsersDiag "6.5.0     Camshaft Diagnosis for CSERS (Cold Start Emission Reduction Strategy)"
 /begin DEF_CHARACTERISTIC GEVlv_agMaxDiffFildPhaCsersIntk_C GEVlv_agRngInhbHealPhaCsersIntk_C GEVlv_stPhaCsersDiag_C GEVlv_tiCsersSpDeIntk_C GEVlv_tiDebPhaCsersIntk_C GEVlv_tiFilAgSpCsersIntk_C /end DEF_CHARACTERISTIC
 /begin IN_MEASUREMENT B_khakt_msg B_kh_msg Eep_EnvRamInvld fnwkhe_msg GEVCtl_agSpCsersDiagIntk GEVCtl_agSpIntkB1 GEVCtl_agSpNonCsersIntkB1 GEVCtl_flgPhaEnaIntk GEVlv_agDeMaxAllwdPhaCsersIntk GEVlv_agIntkB1 GEVlv_flgPhaDiagEnaCsersIntkB1 /end IN_MEASUREMENT
 /begin OUT_MEASUREMENT GEVlv_agSumSpCsersDeIntkB1 GEVlv_flgCsersDebCmplIntkB1 GEVlv_flgPhaCsersDiagAvlIntk GEVlv_flgPhaDiagEnaCsersDynIntkB1 GEVlv_tiDebPhaCsersIntk /end OUT_MEASUREMENT
 /begin LOC_MEASUREMENT GEVlv_agFrznFltRngInhbHealIntkB1 GEVlv_flgCatHeatgActvIntk GEVlv_flgDsmRstPhaCsersDiagIntkB1 GEVlv_MonPhaCsersAdjmtIntkB1_I.agDeSpActVal GEVlv_MonPhaCsersAdjmtIntkB1_I.out_flgFlt GEVlv_MonPhaCsersAdjmtIntkB1_I.out_flgHeal GEVlv_PhaCsersDynDeactvIntkB1_I.out_flgPhaDiagEnaCsers GEVlv_PhaCsersDynDeactvIntkB1_I.GEVlv_CsersDiagAgFiltLT_I.memory GEVlv_PhaCsersErrDstcnIntkB1_I.out_agSum PhaCsersDenomComplIntkB1_I.out_flgRelsDenom /end LOC_MEASUREMENT
 FUNCTION_VERSION "6.5.0" /end FUNCTION
/begin FUNCTION GEVlv_PhaDiag "2.18.1    diagnosis camshaft phase shift actuator"
 /begin DEF_CHARACTERISTIC GEVlv_agDeBgnMonCycIntk_M GEVlv_agDeSysTolrIntk_C GEVlv_agRngRefPosnIntk_C GEVlv_nrDebErrIntk_C GEVlv_stPhaDiag_C GEVlv_tiMonCycPhaDiagIntk_M GEVlv_tiReaSpThdPhaDiagIntk_M GEVlv_tiRepMonCycPhaDiagIntk_C /end DEF_CHARACTERISTIC
 /begin REF_CHARACTERISTIC GEVCtl_agRefPosnIntk_C /end REF_CHARACTERISTIC
 /begin IN_MEASUREMENT Epm_nEng GEVCtl_agSpIntkB1 GEVCtl_agSpMaxIntk GEVCtl_agSpMinIntk GEVCtl_flgCamsftErrDstcn GEVCtl_flgPhaActrTestEnaIntk GEVCtl_tOilCylHd GEVlv_agIntkB1 GEVlv_agSpStopGovrIntk GEVlv_flgPhaDiagEnaIntkB1 GEVlv_flgPhaDiagReqIntkB1 GEVlv_flgSlowRespMinTIntk GEVlv_stGovrIntkB1 SyC_stSub /end IN_MEASUREMENT
 /begin OUT_MEASUREMENT GEVCtl_flgReqErrDstcnIntk GEVlv_agDePhaDiagIntkB1 GEVlv_cntrSlowRespIntkB1 GEVlv_cntrTarErrIntkB1 GEVlv_flgDebCmplIntkB1 GEVlv_flgDiagNotDiIntkB1 GEVlv_flgPhaActrErrSuspcIntkB1 GEVlv_flgPhaDiagRdyIntkB1 GEVlv_flgPhaDiagResIntkB1 GEVlv_flgRprtChkOkIntkB1 GEVlv_flgRprtChkSlowIntkB1 GEVlv_flgRprtChkTarIntkB1 GEVlv_flgTargErrDiIntkB1 GEVlv_stPhaDiagIntkB1 GEVlv_stPhaDiagResIntkB1 GEVlv_tiMonCycPhaDiagIntk GEVlv_tiReaSpThdPhaDiagIntk /end OUT_MEASUREMENT
 /begin LOC_MEASUREMENT GEVlv_agDeBgnMonCycIntk GEVlv_AgDeObsIntkB1_I.agBgnMon GEVlv_AgDeObsIntkB1_I.agErrPosn GEVlv_AgDeObsIntkB1_I.agMaxMon GEVlv_AgDeObsIntkB1_I.agRngThrActvPosn GEVlv_AgDeObsIntkB1_I.agSpMaxMon GEVlv_AgDeObsIntkB1_I.agSpThdMon GEVlv_AgDeObsIntkB1_I.arg_agRngThrRefPosn GEVlv_AgDeObsIntkB1_I.arg_flgFrzFrmEntryEna GEVlv_AgDeObsIntkB1_I.arg_flgInhbFrzFrmEntry GEVlv_AgDeObsIntkB1_I.arg_flgTargErrDi GEVlv_AgDeObsIntkB1_I.flgAgSpThdRea GEVlv_AgDeObsIntkB1_I.flgErrNegDe GEVlv_AgDeObsIntkB1_I.flgErrPosDe GEVlv_AgDeObsIntkB1_I.flgMonCycPhaDiagRunng GEVlv_AgDeObsIntkB1_I.flgSuffMovePhaActRng1 GEVlv_AgDeObsIntkB1_I.flgSuffMovePhaActRng3 GEVlv_AgDeObsIntkB1_I.out_flgCreatFrzFrmSlowRespNegDe GEVlv_AgDeObsIntkB1_I.out_flgCreatFrzFrmSlowRespPosDe GEVlv_AgDeObsIntkB1_I.out_flgCreatFrzFrmTargNegDe GEVlv_AgDeObsIntkB1_I.out_flgCreatFrzFrmTargPosDe GEVlv_AgDeObsIntkB1_I.out_flgPhaDiagRes GEVlv_AgDeObsIntkB1_I.out_st GEVlv_AgDeObsIntkB1_I.out_stPhaDiagRes GEVlv_AgDeObsIntkB1_I.out_valLowerLimRef GEVlv_AgDeObsIntkB1_I.out_valResult GEVlv_AgDeObsIntkB1_I.out_valUpperLimRef GEVlv_AgDeObsIntkB1_I.sm GEVlv_AgDeObsIntkB1_I.tiFrzMonNegDeFrzFrmEntry GEVlv_AgDeObsIntkB1_I.tiFrzMonPosDeFrzFrmEntry GEVlv_DenomCmplIntkB1_I.cntrDenom GEVlv_DenomCmplIntkB1_I.flgRelsDenom GEVlv_flgDsmRstPhaDiag GEVlv_flgInhbFrzFrmEntryIntkB1 GEVlv_flgPhaDiagDenomCondIntkB1 GEVlv_flgTrigRstIntkB1 GEVlv_PhaDiagDFCIntkB1_I.cntrOKTestOld GEVlv_PhaDiagDFCIntkB1_I.out_cntrOkTest GEVlv_PhaDiagDFCIntkB1_I.out_cntrSlowRespTest GEVlv_PhaDiagDFCIntkB1_I.out_cntrTarErrTest GEVlv_PhaDiagDFCIntkB1_I.out_flgInhbFrzFrmEntry /end LOC_MEASUREMENT
 FUNCTION_VERSION "2.18.1" /end FUNCTION
/begin FUNCTION GEVlv_PhaDiagEna "6.7.0     Enabling conditions diagnosis camshaft phase shift actuator"
 /begin DEF_CHARACTERISTIC GEVlv_agDeMaxAllwdPhaCsersIntk_M GEVlv_nMaxPhaCsersDiagIntk_T GEVlv_nMaxPhaDiag_C GEVlv_nMinPhaCsersDiagIntk_T GEVlv_nMinPhaDiagIntk_CUR GEVlv_stPhaDiagEna_C GEVlv_tiDiagEnaAftClng_C GEVlv_tiDlyRstPhaDiagEnaIntkSpstB1_C GEVlv_tiStrtEndTilPhaDiagEnaIntk_CUR GEVlv_tOilMaxPhaCsersDiagEnaIntk_C GEVlv_tOilMaxPhaDiagEnaIntk_C GEVlv_tOilMinPhaCsersDiagEnaIntk_C GEVlv_tOilMinPhaDiagEnaIntk_C GEVlv_tOilMinPhaDiagEnaOutl_C GEVlv_tOilMinSlowRespEnaIntk_C GEVlv_tOilMinSlowRespEnaOutl_C GEVlv_tOilMinTarErrEnaIntk_C GEVlv_tOilMinTarErrEnaOutl_C GEVlv_uBattMinDiag_C /end DEF_CHARACTERISTIC
 /begin IN_MEASUREMENT BattU_u B_khakt_msg B_kh_msg CEngDsT_tStrt CoEng_stMai EngStrt_stRstrtRsn Epm_nEng Epm_stSpd GEVCtl_agSpIntkB1 GEVCtl_agSpNonCsersIntkB1 GEVCtl_flgClngActvIntk GEVCtl_flgPhaActrTestEnaFctIntk GEVCtl_flgPhaActrTestEnaFctOutl GEVCtl_flgPhaEnaIntk GEVCtl_flgPhaTstrActvIntk GEVCtl_flgSpCatHeatgIntk GEVCtl_tOilCylHd GEVlv_flgPhaCsersDiagAvlIntk GEVlv_stGovrIntkB1 /end IN_MEASUREMENT
 /begin OUT_MEASUREMENT GEVlv_agDeMaxAllwdPhaCsersIntk GEVlv_flgCsersDiagReqIntk GEVlv_flgCsersEomActvIntk GEVlv_flgPhaDiagEnaAftStrtIntk GEVlv_flgPhaDiagEnaCsersIntkB1 GEVlv_flgPhaDiagEnaIntkB1 GEVlv_flgPhaDiagReqIntkB1 GEVlv_flgSimCsersDiag GEVlv_flgSlowRespMinTIntk GEVlv_flgSlowRespMinTOutl GEVlv_flgTarErrMinTIntk GEVlv_flgTarErrMinTOutl /end OUT_MEASUREMENT
 /begin LOC_MEASUREMENT GEVlv_flgAgAbvByndIntkB1 GEvlv_flgDlyDeactvnDiagEngStop GEVlv_flgGovrActvIntkB1 GEVlv_flgPhaCsersDiagEnaAmbIntk GEVlv_flgPhaCsersDiagEnaBascIntkB1 GEVlv_flgPhaCsersDiagEnaNoErrIntkB1 GEVlv_flgPhaDiagEnaAmbIntk GEVlv_flgPhaDiagEnaNoErrIntkB1 GEVlv_flgPhaDiagEnaPhyIntkB1 GEVlv_flgRstPhaDiagEnaEngReStrt GEVlv_flgUBattMinDiag /end LOC_MEASUREMENT
 FUNCTION_VERSION "6.7.0" /end FUNCTION
/begin FUNCTION GEVlv_PhaGovr "12.1.0    Governor phase shifting camshaft"
 /begin DEF_CHARACTERISTIC GEVlv_agSpErrSimIntk_T GEVlv_facUBattCorrn_T GEVlv_GovrPrmIntkIF_I.agDeactDPartMax_C GEVlv_GovrPrmIntkIF_I.agDeactDPartMin_C GEVlv_GovrPrmIntkIF_I.agDeactDPartStySt_C GEVlv_GovrPrmIntkIF_I.agSpChgMaxStopIPart_C GEVlv_GovrPrmIntkIF_I.agSpStopGovr_T GEVlv_GovrPrmIntkIF_I.agSpStopSlowIPart_C GEVlv_GovrPrmIntkIF_I.facCorGainD_M GEVlv_GovrPrmIntkIF_I.facCorGainI_T GEVlv_GovrPrmIntkIF_I.facCorGainP_M GEVlv_GovrPrmIntkIF_I.facDPartLoLft_GM GEVlv_GovrPrmIntkIF_I.facDPartOilP_T GEVlv_GovrPrmIntkIF_I.facDPartSoft_M GEVlv_GovrPrmIntkIF_I.facDPartStySt_C GEVlv_GovrPrmIntkIF_I.facDPart_GM GEVlv_GovrPrmIntkIF_I.facFastIPartLoLft_GM GEVlv_GovrPrmIntkIF_I.facFastIPartSoft_M GEVlv_GovrPrmIntkIF_I.facFastIPart_GM GEVlv_GovrPrmIntkIF_I.facIPartOilP_T GEVlv_GovrPrmIntkIF_I.facPPartLoLft_GM GEVlv_GovrPrmIntkIF_I.facPPartOilP_T GEVlv_GovrPrmIntkIF_I.facPPartSoft_M GEVlv_GovrPrmIntkIF_I.facPPart_GM GEVlv_GovrPrmIntkIF_I.ratDeltaMaxPhaSlowIPart_C GEVlv_GovrPrmIntkIF_I.ratPhaFastIPartMax_C GEVlv_GovrPrmIntkIF_I.ratPhaFastIPartMin_C GEVlv_GovrPrmIntkIF_I.ratPhaMaxActvIPart_GM GEVlv_GovrPrmIntkIF_I.ratPhaMax_C GEVlv_GovrPrmIntkIF_I.ratPhaMinActvIPart_GM GEVlv_GovrPrmIntkIF_I.ratPhaMin_C GEVlv_GovrPrmIntkIF_I.ratPhaOutLockPos_C GEVlv_GovrPrmIntkIF_I.ratPhaProtn_C GEVlv_GovrPrmIntkIF_I.ratPhaSlowIPartMax_C GEVlv_GovrPrmIntkIF_I.ratPhaSlowIPartMin_C GEVlv_GovrPrmIntkIF_I.ratPhaToLockPos_C GEVlv_GovrPrmIntkIF_I.tiDeactDPartStySt_C GEVlv_GovrPrmIntkIF_I.tiEnaFastIPart_M GEVlv_GovrPrmIntkIF_I.tiPhaProtn_C GEVlv_GovrPrmIntkIF_I.tiPhaSlowIPartLoLft_C GEVlv_GovrPrmIntkIF_I.tiPhaSlowIPart_C GEVlv_nEng_Ax GEVlv_pOil_Ax GEVlv_ratOffsCorrnHoldDutyIntkB1_M GEVlv_ratPhaAdjHoldIntkB1_GM GEVlv_ratPhaAdjHoldLoLftIntkB1_GM GEVlv_ratPhaClngIntkB1Hi_C GEVlv_ratPhaClngIntkB1Lo_C GEVlv_ratPhaRmpSlopCl_C GEVlv_stAdapErrSim_C GEVlv_stCfgGovr_C GEVlv_stPhaErrSim_C GEVlv_stPhaGovrAltv12_C GEVlv_tiHoldDutyUnlckCtrlIntk_T GEVlv_tiPhaErrSimAdvIntk_C GEVlv_tiPhaErrSimRetIntk_C GEVlv_tOilCylHd_Ax PHAOCVINTKB1_CTL_ATS_ATS.LimitTypeMsk_C PHAOCVINTKB1_CTL_ATS_ATS.CnvNorm_C PHAOCVINTKB1_CTL_ATS_ATS.LowLim_C PHAOCVINTKB1_CTL_ATS_ATS.UpLim_C PHAOCVINTKB1_CTL_ATS_ATS.CnvFac_C PHAOCVINTKB1_CTL_ATS_ATS.CnvOfs_C PHAOCVINTKB1_CTL_ATS_ATS.DfltVal_C /end DEF_CHARACTERISTIC
 /begin REF_CHARACTERISTIC GEVCtl_stPhaAdpr_C /end REF_CHARACTERISTIC
 /begin IN_MEASUREMENT BattU_u Epm_nEng Epm_stSpd GEVCtl_agMaxAdpdIntk GEVCtl_agMinAdpdIntk GEVCtl_agRefPosnIntkB1 GEVCtl_agSpIntkB1 GEVCtl_agSpMaxIntk GEVCtl_agSpMinIntk GEVCtl_agSpNonCsersIntkB1 GEVCtl_flgClngActvPostDrvIntk GEVCtl_flgClngOnIntk GEVCtl_flgEngOffClnActv GEVCtl_flgPhaEnaIntk GEVCtl_flgPhaOutLockPosnIntkB1 GEVCtl_flgPhaToLockPosnIntkB1 GEVCtl_flgPhaToRefPosnIntk GEVCtl_flgStdLftSyncIntk GEVCtl_ratLoad GEVCtl_tOilCylHd GEVlv_agExtrpnIntkB1 GEVlv_agIntkB1 GEVlv_flgPhaActrErrSuspcIntkB1 GEVlv_flgSpclRatIntvIntkB1 GEVlv_ratPhaSpclIntvIntkB1 OilP_p SyC_stSub /end IN_MEASUREMENT
 /begin OUT_MEASUREMENT GEVlv_agSpStopGovrIntk GEVlv_flgAdapErrSimIntk GEVlv_flgPhaErrSimIntk GEVlv_ratPhaIntkB1 GEVlv_ratPhaOutlB1 GEVlv_stGovrDrctIntkB1 GEVlv_stGovrDrctOutlB1 GEVlv_stGovrIntkB1 GEVlv_stGovrOutlB1 /end OUT_MEASUREMENT
 /begin LOC_MEASUREMENT GEVlv_agDifSpActDT1IntkB1 GEVlv_agDifSpActIntkB1 GEVlv_agSpErrSimIntkB1 GEVlv_facUBattCorrn GEVlv_flgCptProtnIntkB1 GEVlv_GovrPrmIntkIF_I.agDifSpAct GEVlv_GovrPrmIntkIF_I.agDifSpActDT1 GEVlv_GovrPrmIntkIF_I.agMaxDifActAdpn GEVlv_GovrPrmIntkIF_I.facAdpnVal GEVlv_GovrPrmIntkIF_I.facDPart GEVlv_GovrPrmIntkIF_I.facDPartRgl GEVlv_GovrPrmIntkIF_I.facDRaprtOilP GEVlv_GovrPrmIntkIF_I.facFastIPartRgl GEVlv_GovrPrmIntkIF_I.facIPart GEVlv_GovrPrmIntkIF_I.facPPart GEVlv_GovrPrmIntkIF_I.facPPartOilP GEVlv_GovrPrmIntkIF_I.facPPartRgl GEVlv_GovrPrmIntkIF_I.idxAdpnValAry GEVlv_GovrPrmIntkIF_I.ratPhaMaxActvIPart GEVlv_GovrPrmIntkIF_I.ratPhaMinActvIPart GEVlv_GovrPrmIntkIF_I.tiEnaFastIPart GEVlv_GovrPrmIntkIF_I.tiPhaSlowIPartLoLft GEVlv_PhaGovrPostDriveIntkB1_I.ratPha GEVlv_PhaPidGovrIntkB1_I.agDifSpAct GEVlv_PhaPidGovrIntkB1_I.agDifSpActDT1 GEVlv_PhaPidGovrIntkB1_I.agDifSpStopIPart GEVlv_PhaPidGovrIntkB1_I.agSp1 GEVlv_PhaPidGovrIntkB1_I.agSp2 GEVlv_PhaPidGovrIntkB1_I.agSp3 GEVlv_PhaPidGovrIntkB1_I.flgCalcSlowIPartLimCalc GEVlv_PhaPidGovrIntkB1_I.flgEnaFastIPart GEVlv_PhaPidGovrIntkB1_I.flgEnaSlowIPart GEVlv_PhaPidGovrIntkB1_I.ratDeltaPhaSlowIPart GEVlv_PhaPidGovrIntkB1_I.ratPha GEVlv_PhaPidGovrIntkB1_I.ratPhaDPart GEVlv_PhaPidGovrIntkB1_I.ratPhaFastIPart GEVlv_PhaPidGovrIntkB1_I.ratPhaFastIPartStore GEVlv_PhaPidGovrIntkB1_I.ratPhaIPart GEVlv_PhaPidGovrIntkB1_I.ratPhaPPart GEVlv_PhaPidGovrIntkB1_I.ratPhaSlowIPart GEVlv_PhaPidGovrIntkB1_I.ratPhaSlowIPartLoLift GEVlv_PhaPidGovrIntkB1_I.stFastIPart GEVlv_PhaPidGovrIntkB1_I.stGovr GEVlv_ratPhaHoldIPartIntkB1 /end LOC_MEASUREMENT
 FUNCTION_VERSION "12.1.0" /end FUNCTION
/begin FUNCTION GEVlv_PhaPortCfg "1.1.0     Port configuration ecu hardware phase shift actuators" /begin DEF_CHARACTERISTIC GEVlv_tiPerdPwm_MAP /end DEF_CHARACTERISTIC /begin IN_MEASUREMENT Epm_nEng GEVCtl_tOilCylHd GEVlv_ratPhaIntkB1 SyC_stSub /end IN_MEASUREMENT FUNCTION_VERSION "1.1.0" /end FUNCTION
/begin FUNCTION GEVlv_PhaPsDiag "3.3.0     Diagnosis phase shift actuator power stages" /begin DEF_CHARACTERISTIC GEVlv_nrTstPls_C GEVlv_tiBtwElecFlt_C GEVlv_tiBtwOTFlt_C /end DEF_CHARACTERISTIC /begin IN_MEASUREMENT B_desee_msg /end IN_MEASUREMENT /begin LOC_MEASUREMENT GEVlv_flgElecDiagIntkB1Actv /end LOC_MEASUREMENT FUNCTION_VERSION "3.3.0" /end FUNCTION
/begin FUNCTION GEVlv_SpclDutyCycIntv "1.2.0     Special Duty Cycle Interventions"
 /begin DEF_CHARACTERISTIC GEVlv_agMaxNormAgIntk_C GEVlv_agMinNormAgIntk_C GEVlv_nEngMaxClng_C GEVlv_ratPhaAbnormAgIntk_C GEVlv_ratPhaTqMinIntk_C GEVlv_ratSpclAdpnReqIntk_C GEVlv_tiAbnormAgPlsIntk_C GEVlv_tiClngMinTqActv_C GEVlv_tiDebAbnormAgIntk_C /end DEF_CHARACTERISTIC
 /begin IN_MEASUREMENT CoEng_stMai Epm_nEng GEVCtl_flgAdpnReqSpclRatIntkB1 GEVCtl_flgClngRels GEVCtl_flgRmnClngCycIntk GEVlv_agIntkB1 SyC_stSub /end IN_MEASUREMENT
 /begin OUT_MEASUREMENT GEVlv_flgSpclRatIntvIntkB1 GEVlv_ratPhaSpclIntvIntkB1 /end OUT_MEASUREMENT
 /begin LOC_MEASUREMENT GEVlv_DetAbnormAgIntkB1_I.out_flgAgAbnormDetd GEVlv_flgClngOilCtrlVlvActv /end LOC_MEASUREMENT
 FUNCTION_VERSION "1.2.0" /end FUNCTION
/begin FUNCTION GGDSKV "51.18.0_1.2.0Sensor signal rail pressure sensor"
 /begin DEF_CHARACTERISTIC ANZEIN CWDSKV FuPHi_pMinDiagStuckChk_C FuPHi_pTrfFuncRail_T FuPHi_tiDlyRailPInvld_C FuPHi_tiDlyRailPVld_C NMMNDSKVS NMMXDSKVS RKVDSKVS TVDSKVH TVDSKVHSRC TVDSKVMN TVDSKVMNSRC TVDSKVMX TVDSKVMXSRC TVDSKVPL TVDSKVSH TVDSKVSS UPRDIFF UPRDSKVS UPRMMNPL UPRMMNSRCHL UPRMMNSRCLL UPRMMXPL UPRMMXSRCHL UPRMMXSRCLL /end DEF_CHARACTERISTIC
 /begin IN_MEASUREMENT anzti_msg EngStrt_bStrtEnd Epm_nEngLRes PEnv_p rkvmeeff_w_msg SyC_ctPostDrvLeave SyC_stSub /end IN_MEASUREMENT
 /begin OUT_MEASUREMENT anztidiff_msg B_prrohrg_msg B_uprmnpl_msg FuPHi_pRawAbslt FuPHi_pRawAbsltInj FuPHi_pRawRel FuPHi_pRawRelInj FuPHi_uHiResl prrohr_w_msg prroh_w_msg upr1ms_w_msg uprm_w_msg /end OUT_MEASUREMENT
 /begin LOC_MEASUREMENT anztiaged B_dskvsh B_noudiff B_reldskv B_tbudiff FuPHi_flgDSKVClr100ms FuPHi_flgDSKVClr10ms FuPHi_flgDSKVSClr GGDSKV_ctReIni100ms GGDSKV_ctReIni10ms GGDSKV_ctReIni1ms GGDSKV_flgDSMTripFinshd uprdiff_w uprmn_w uprmx_w uprm_inj_w uprm_w /end LOC_MEASUREMENT
 FUNCTION_VERSION "51.18.0_1.2.0" /end FUNCTION
/begin FUNCTION GGFETH "12.2.0    Sensor signal: factor ethanol content in fuel"
 /begin DEF_CHARACTERISTIC CWGGFETH CWGGFETHAP DFETHINVAL_C DVTETHIV_C ETHSCP_dielecEthConc_MAP ETHSCP_facEthCmpCnvn_CUR ETHSCP_facEthExtdIni_C ETHSCP_facFuTCmp_CUR ETHSCP_flgProdModOn_C ETHSCP_nEngAirDchaMin_C ETHSCP_percEthRaw_T ETHSCP_perEthConc_MAP ETHSCP_pFuAirDchaMin_C ETHSCP_tiAirDcha_C ETHSCP_tiFuFlowCmp_CUR ETHSCP_tiProdModEnd_C FETHEVINI_C FQETHSFCMP1MN_C FQETHSFCMP1MX_C FQETHSFCMP2MN_C FQETHSFCMP2MX_C FQETHSFMN_C FQETHSFMX_C FQETHSMFMN2_C FQETHSMFMN_C FQETHSMFMX2_C FQETHSMFMX_C KLFETHFQES TETHSAEE_C TETHSAFE_C TETHSKL15 TFETHEVLP_CUR TFQETHSTP_C UBSQFETHMN UBSQFETHMX VETHSEV /end DEF_CHARACTERISTIC
 /begin REF_CHARACTERISTIC FfPrm_stEna_C /end REF_CHARACTERISTIC
 /begin IN_MEASUREMENT BattU_stPwrFail BattU_uFild B_ethsemn_msg B_ethsemx_msg B_kl15_msg B_tethsrg_msg B_urstsprr_msg Eep_EnvRamHist Eep_EnvRamInvld EngStrt_bStrtEnd Epm_nEng ETHSCP_tFuHiRes fqethsr_w_msg I14229_flgEthSp I14229_ratEthSp InjSys_dvolFuInjr InjSys_volFuConsDrvCyc prist_w_msg SyC_ctPostDrvLeave SyC_stSub /end IN_MEASUREMENT
 /begin OUT_MEASUREMENT B_dkvsenffv_msg B_ethevg_msg B_ethrevg_msg B_ethrg_msg B_ethsen_msg B_ethsfmn_msg B_ethsfmx_msg B_ethsfsi_msg ETHSCP_facEthExtd ETHSCP_flgAirDchaCmpl ETHSCP_flgErrDrvCyc ETHSCP_flgFuAbnorm ETHSCP_flgProdMod ETHSCP_perEthExtd ETHSCP_perEthRaw fethev_w_msg fethr_w_msg fqethsf_w_msg sggfeth_msg /end OUT_MEASUREMENT
 /begin LOC_MEASUREMENT B_ethgvtlo B_figgfeth B_inggfeth dvtethiv_w ETHSCP_aryEthVolVldy ETHSCP_cntrEthIniCalc ETHSCP_facEthCmp ETHSCP_facEthCmpExtd ETHSCP_facEthExtdAry ETHSCP_facEthExtdInt ETHSCP_flgProdModOn ETHSCP_perEthCmp ETHSCP_tFuAftCmp ETHSCP_tFuBufAry ETHSCP_tFuBufLst fethevi_w fethevprod_w fethvtl_w GGFETH_ctReIni kfethrmp_w vtethold_w vtethstl_w /end LOC_MEASUREMENT
 FUNCTION_VERSION "12.2.0" /end FUNCTION
/begin COMPU_METHOD B_TRUE "" TAB_VERB "%6.3" "" COMPU_TAB_REF B_TRUE /end COMPU_METHOD
/begin COMPU_VTAB B_TRUE "" TAB_VERB 2 0 "FALSE" 1 "TRUE" /end COMPU_VTAB
/begin COMPU_METHOD dez "" RAT_FUNC "%6.2" "" COEFFS 0 1 0 0 0 1 /end COMPU_METHOD
/begin COMPU_METHOD EngN "" RAT_FUNC "%6.3" "rpm" COEFFS 0 2 0 0 0 1 /end COMPU_METHOD
/begin COMPU_METHOD EngN_LRes "" RAT_FUNC "%6.1" "rpm" COEFFS 0 0.025 0 0 0 1 /end COMPU_METHOD
/begin COMPU_METHOD fak_q0p0039 "" RAT_FUNC "%6.4" "-" COEFFS 0 256 0 0 0 1 /end COMPU_METHOD
/begin COMPU_METHOD fak_q4p883Em4 "" RAT_FUNC "%6.5" "-" COEFFS 0 65536 0 0 0 32 /end COMPU_METHOD
/begin COMPU_METHOD fak_sw_b4 "" RAT_FUNC "%6.5" "-" COEFFS 0 65536 0 0 0 8 /end COMPU_METHOD
/begin COMPU_METHOD fak_ub_b1 "" RAT_FUNC "%6.4" "-" COEFFS 0 256 0 0 0 1 /end COMPU_METHOD
/begin COMPU_METHOD fak_ub_b2 "" RAT_FUNC "%8.5" "-" COEFFS 0 256 0 0 0 2 /end COMPU_METHOD
/begin COMPU_METHOD fak_uw_b1 "" RAT_FUNC "%7.6" "-" COEFFS 0 65536 0 0 0 1 /end COMPU_METHOD
/begin COMPU_METHOD fak_uw_b2 "" RAT_FUNC "%7.6" "-" COEFFS 0 65536 0 0 0 2 /end COMPU_METHOD
/begin COMPU_METHOD fak_uw_b8 "" RAT_FUNC "%6.5" "-" COEFFS 0 65536 0 0 0 8 /end COMPU_METHOD
/begin COMPU_METHOD fak_uw_q0p01 "" RAT_FUNC "%6.4" "-" COEFFS 0 1 0 0 0 0.01 /end COMPU_METHOD
/begin COMPU_METHOD freq_q0p01 "" RAT_FUNC "%6.4" "Hz" COEFFS 0 100 0 0 0 1 /end COMPU_METHOD
/begin COMPU_METHOD GEVlv_AgDeObs_sm_VERB "" TAB_VERB "%6.3" "" COMPU_TAB_REF GEVlv_AgDeObs_sm_VERB /end COMPU_METHOD
/begin COMPU_VTAB GEVlv_AgDeObs_sm_VERB "" TAB_VERB 6 0 "START" 1 "ActrReaRng1" 2 "ActrReaRng3" 3 "EvalNegDe" 4 "EvalPosDe" 5 "WaitForNxtCnd" /end COMPU_VTAB
/begin COMPU_METHOD k100ms_uw_b10 "" RAT_FUNC "%6.5" "1/s" COEFFS 0 65536 0 0 0 10 /end COMPU_METHOD
/begin COMPU_METHOD kw_q0p0156 "" RAT_FUNC "%6.4" "Grad KW" COEFFS 0 64 0 0 0 1 /end COMPU_METHOD
/begin COMPU_METHOD nmot_q0p5 "" RAT_FUNC "%6.3" "1/min" COEFFS 0 2 0 0 0 1 /end COMPU_METHOD
/begin COMPU_METHOD nmot_ub_q40 "" RAT_FUNC "%6.1" "1/min" COEFFS 0 1 0 0 0 40 /end COMPU_METHOD
/begin COMPU_METHOD OILPMPFRICTQ_SC_Compu "" TAB_VERB "%6.3" "" COMPU_TAB_REF OILPMPFRICTQ_SC_Compu /end COMPU_METHOD
/begin COMPU_VTAB OILPMPFRICTQ_SC_Compu "" TAB_VERB 2 0 "False" 1 "True" /end COMPU_VTAB
/begin COMPU_METHOD OILPMPTYP_SC_Compu "" TAB_VERB "%6.3" "" COMPU_TAB_REF OILPMPTYP_SC_Compu /end COMPU_METHOD
/begin COMPU_VTAB OILPMPTYP_SC_Compu "" TAB_VERB 3 0 "two-stage" 1 "a continuous oil pressure pump is available" 255 "two-stage and continuous oil pressure pump" /end COMPU_VTAB
/begin COMPU_METHOD OILPMP_CTL_SY_Compu "" TAB_VERB "%6.3" "" COMPU_TAB_REF OILPMP_CTL_SY_Compu /end COMPU_METHOD
/begin COMPU_VTAB OILPMP_CTL_SY_Compu "" TAB_VERB 2 0 "False" 1 "True" /end COMPU_VTAB
/begin COMPU_METHOD OILPMP_SC_Compu "" TAB_VERB "%6.3" "" COMPU_TAB_REF OILPMP_SC_Compu /end COMPU_METHOD
/begin COMPU_VTAB OILPMP_SC_Compu "" TAB_VERB 2 0 "False" 1 "True" /end COMPU_VTAB
/begin COMPU_METHOD OILPPSSWT_SC_Compu "" TAB_VERB "%6.3" "" COMPU_TAB_REF OILPPSSWT_SC_Compu /end COMPU_METHOD
/begin COMPU_VTAB OILPPSSWT_SC_Compu "" TAB_VERB 2 0 "False" 1 "True" /end COMPU_VTAB
/begin COMPU_METHOD OILPSEN_DRQREQ_SC_Compu "" TAB_VERB "%6.3" "" COMPU_TAB_REF OILPSEN_DRQREQ_SC_Compu /end COMPU_METHOD
/begin COMPU_VTAB OILPSEN_DRQREQ_SC_Compu "" TAB_VERB 2 0 "False" 1 "True" /end COMPU_VTAB
/begin COMPU_METHOD OILPSEN_SY_Compu "" TAB_VERB "%6.3" "" COMPU_TAB_REF OILPSEN_SY_Compu /end COMPU_METHOD
/begin COMPU_VTAB OILPSEN_SY_Compu "" TAB_VERB 2 0 "False" 1 "True" /end COMPU_VTAB
/begin COMPU_METHOD OILPSNSRTYP_SC_Compu "" TAB_VERB "%6.3" "" COMPU_TAB_REF OILPSNSRTYP_SC_Compu /end COMPU_METHOD
/begin COMPU_VTAB OILPSNSRTYP_SC_Compu "" TAB_VERB 4 0 "ANALOG" 1 "DIGITAL" 2 "SENT" 255 "SELECTABLE" /end COMPU_VTAB
/begin COMPU_METHOD OILP_TYPAVL_SY_Compu "" TAB_VERB "%6.3" "" COMPU_TAB_REF OILP_TYPAVL_SY_Compu /end COMPU_METHOD
/begin COMPU_VTAB OILP_TYPAVL_SY_Compu "" TAB_VERB 2 0 "False" 1 "True" /end COMPU_VTAB
/begin COMPU_METHOD OILSWMPT_CMBDSNSRPLAUSCC_SC_Compu "" TAB_VERB "%6.3" "" COMPU_TAB_REF OILSWMPT_CMBDSNSRPLAUSCC_SC_Compu /end COMPU_METHOD
/begin COMPU_VTAB OILSWMPT_CMBDSNSRPLAUSCC_SC_Compu "" TAB_VERB 2 0 "False" 1 "True" /end COMPU_VTAB
/begin COMPU_METHOD OILSWMPT_CMBDSNSRPLAUSMBC_SC_Compu "" TAB_VERB "%6.3" "" COMPU_TAB_REF OILSWMPT_CMBDSNSRPLAUSMBC_SC_Compu /end COMPU_METHOD
/begin COMPU_VTAB OILSWMPT_CMBDSNSRPLAUSMBC_SC_Compu "" TAB_VERB 2 0 "False" 1 "True" /end COMPU_VTAB
/begin COMPU_METHOD OILSWMPT_CMBDSNSRPLAUSPRC_SC_Compu "" TAB_VERB "%6.3" "" COMPU_TAB_REF OILSWMPT_CMBDSNSRPLAUSPRC_SC_Compu /end COMPU_METHOD
/begin COMPU_VTAB OILSWMPT_CMBDSNSRPLAUSPRC_SC_Compu "" TAB_VERB 2 0 "False" 1 "True" /end COMPU_VTAB
/begin COMPU_METHOD OILSWMPT_MDL_SC_Compu "" TAB_VERB "%6.3" "" COMPU_TAB_REF OILSWMPT_MDL_SC_Compu /end COMPU_METHOD
/begin COMPU_VTAB OILSWMPT_MDL_SC_Compu "" TAB_VERB 2 0 "False" 1 "True" /end COMPU_VTAB
/begin COMPU_METHOD OILSWMPT_PCKSELNOIL_SC_Compu "" TAB_VERB "%6.3" "" COMPU_TAB_REF OILSWMPT_PCKSELNOIL_SC_Compu /end COMPU_METHOD
/begin COMPU_VTAB OILSWMPT_PCKSELNOIL_SC_Compu "" TAB_VERB 2 0 "0" 1 "1" /end COMPU_VTAB
/begin COMPU_METHOD OILSWMPT_PLAUS_SC_Compu "" TAB_VERB "%6.3" "" COMPU_TAB_REF OILSWMPT_PLAUS_SC_Compu /end COMPU_METHOD
/begin COMPU_VTAB OILSWMPT_PLAUS_SC_Compu "" TAB_VERB 2 0 "False" 1 "True" /end COMPU_VTAB
/begin COMPU_METHOD OILSWMPT_SNSRCFG_SC_Compu "" TAB_VERB "%6.3" "" COMPU_TAB_REF OILSWMPT_SNSRCFG_SC_Compu /end COMPU_METHOD
/begin COMPU_VTAB OILSWMPT_SNSRCFG_SC_Compu "" TAB_VERB 4 0 "No_Sensor" 1 "ADC" 2 "LIN" 255 "Via_application_parameter" /end COMPU_VTAB
/begin COMPU_METHOD OILSWMPT_SNSRPRSNT_SC_Compu "" TAB_VERB "%6.3" "" COMPU_TAB_REF OILSWMPT_SNSRPRSNT_SC_Compu /end COMPU_METHOD
/begin COMPU_VTAB OILSWMPT_SNSRPRSNT_SC_Compu "" TAB_VERB 2 0 "False" 1 "True" /end COMPU_VTAB
/begin COMPU_METHOD OILSWMPT_SWMPTSNSRPLAUSCC_SC_Compu "" TAB_VERB "%6.3" "" COMPU_TAB_REF OILSWMPT_SWMPTSNSRPLAUSCC_SC_Compu /end COMPU_METHOD
/begin COMPU_VTAB OILSWMPT_SWMPTSNSRPLAUSCC_SC_Compu "" TAB_VERB 2 0 "False" 1 "True" /end COMPU_VTAB
/begin COMPU_METHOD OILSWMPT_SWMPTSNSRPLAUSMBC_SC_Compu "" TAB_VERB "%6.3" "" COMPU_TAB_REF OILSWMPT_SWMPTSNSRPLAUSMBC_SC_Compu /end COMPU_METHOD
/begin COMPU_VTAB OILSWMPT_SWMPTSNSRPLAUSMBC_SC_Compu "" TAB_VERB 2 0 "False" 1 "True" /end COMPU_VTAB
/begin COMPU_METHOD OILSWMPT_SWMPTSNSRPLAUSPRC_SC_Compu "" TAB_VERB "%6.3" "" COMPU_TAB_REF OILSWMPT_SWMPTSNSRPLAUSPRC_SC_Compu /end COMPU_METHOD
/begin COMPU_VTAB OILSWMPT_SWMPTSNSRPLAUSPRC_SC_Compu "" TAB_VERB 2 0 "False" 1 "True" /end COMPU_VTAB
/begin COMPU_METHOD OILSWMPT_TYPAVL_SC_Compu "" TAB_VERB "%6.3" "" COMPU_TAB_REF OILSWMPT_TYPAVL_SC_Compu /end COMPU_METHOD
/begin COMPU_VTAB OILSWMPT_TYPAVL_SC_Compu "" TAB_VERB 2 0 "False" 1 "True" /end COMPU_VTAB
/begin COMPU_METHOD OILTADC_SY_Compu "" TAB_VERB "%6.3" "" COMPU_TAB_REF OILTADC_SY_Compu /end COMPU_METHOD
/begin COMPU_VTAB OILTADC_SY_Compu "" TAB_VERB 2 0 "False" 1 "True" /end COMPU_VTAB
/begin COMPU_METHOD OILTPID5CCFG_SC_Compu "" TAB_VERB "%6.3" "" COMPU_TAB_REF OILTPID5CCFG_SC_Compu /end COMPU_METHOD
/begin COMPU_VTAB OILTPID5CCFG_SC_Compu "" TAB_VERB 3 0 "No sensor" 1 "OilSwmpT" 2 "OilCylHdT" /end COMPU_VTAB
/begin COMPU_METHOD OILTPULS_SY_Compu "" TAB_VERB "%6.3" "" COMPU_TAB_REF OILTPULS_SY_Compu /end COMPU_METHOD
/begin COMPU_VTAB OILTPULS_SY_Compu "" TAB_VERB 2 0 "False" 1 "True" /end COMPU_VTAB
/begin COMPU_METHOD OILT_TYPAVL_SY_Compu "" TAB_VERB "%6.3" "" COMPU_TAB_REF OILT_TYPAVL_SY_Compu /end COMPU_METHOD
/begin COMPU_VTAB OILT_TYPAVL_SY_Compu "" TAB_VERB 2 0 "False" 1 "True" /end COMPU_VTAB
/begin COMPU_METHOD OIL_DSQACTVT_SC_Compu "" TAB_VERB "%6.3" "" COMPU_TAB_REF OIL_DSQACTVT_SC_Compu /end COMPU_METHOD
/begin COMPU_VTAB OIL_DSQACTVT_SC_Compu "" TAB_VERB 2 0 "Inactive" 1 "Active" /end COMPU_VTAB
/begin COMPU_METHOD Oil_lvl_mm_q0p004 "" RAT_FUNC "%6.4" "mm" COEFFS 0 250 0 0 0 1 /end COMPU_METHOD
/begin COMPU_METHOD OIL_VAR_SY_Compu "" TAB_VERB "%6.3" "" COMPU_TAB_REF OIL_VAR_SY_Compu /end COMPU_METHOD
/begin COMPU_VTAB OIL_VAR_SY_Compu "" TAB_VERB 45 1 "DAI" 3 "VWW" 4 "POR" 5 "AUD" 6 "OPE" 9 "FIA" 11 "BMW" 14 "PSA" 15 "REN" 17 "ALF" 18 "SAB" 19 "VOL" 20 "NIS" 21 "GMU" 22 "FOR" 26 "IMJ" 51 "SEA" 53 "CHR" 54 "JAG" 55 "ROL" 69 "FER" 72 "TOY" 123 "MIT" 147 "HYU" 159 "HON" 160 "MAZ" 183 "CU" 190 "LRG" 204 "VVW" 214 "AVT" 242 "Iveco" 243 "DMC" 248 "SUZ" 267 "SSANGYONG" 270 "KEF" 289 "AMG" 308 "TAT" 319 "MVM" 385 "UAES" 590 "Scania" 828 "RBCD" 999 "ALL" 2887 "Nonox" 9454 "Fuso" 9947 "SONSTIGE" /end COMPU_VTAB
/begin COMPU_METHOD OneToOne "" RAT_FUNC "%6.2" "-" COEFFS 0 1 0 0 0 1 /end COMPU_METHOD
/begin COMPU_METHOD OPENETCFCO_SC_Compu "" TAB_VERB "%6.3" "" COMPU_TAB_REF OPENETCFCO_SC_Compu /end COMPU_METHOD
/begin COMPU_VTAB OPENETCFCO_SC_Compu "" TAB_VERB 2 0 "False" 1 "True" /end COMPU_VTAB
/begin COMPU_METHOD OTA_SC_Compu "" TAB_VERB "%6.3" "" COMPU_TAB_REF OTA_SC_Compu /end COMPU_METHOD
/begin COMPU_VTAB OTA_SC_Compu "" TAB_VERB 2 0 "False" 1 "True" /end COMPU_VTAB
/begin COMPU_METHOD OVERSPDCNTRLVL_SC_Compu "" RAT_FUNC "%6.2" "" COEFFS 0 1 0 0 0 1 /end COMPU_METHOD
/begin COMPU_METHOD OVERSPDCNTR_SC_Compu "" RAT_FUNC "%6.2" "" COEFFS 0 1 0 0 0 1 /end COMPU_METHOD
/begin COMPU_METHOD OVERSPDDIAG_SC_Compu "" RAT_FUNC "%6.2" "" COEFFS 0 1 0 0 0 1 /end COMPU_METHOD
/begin COMPU_METHOD OVERSPDTHRCLS_SC_Compu "" RAT_FUNC "%6.2" "" COEFFS 0 1 0 0 0 1 /end COMPU_METHOD
/begin COMPU_METHOD OVRRUNINHB_PT_SY_Compu "" TAB_VERB "%6.3" "" COMPU_TAB_REF OVRRUNINHB_PT_SY_Compu /end COMPU_METHOD
/begin COMPU_VTAB OVRRUNINHB_PT_SY_Compu "" TAB_VERB 2 0 "False" 1 "True" /end COMPU_VTAB
/begin COMPU_METHOD OXSENSDYNADAP_SY_Compu "" TAB_VERB "%6.3" "" COMPU_TAB_REF OXSENSDYNADAP_SY_Compu /end COMPU_METHOD
/begin COMPU_VTAB OXSENSDYNADAP_SY_Compu "" TAB_VERB 2 0 "False" 1 "True" /end COMPU_VTAB
/begin COMPU_METHOD PAIRFLTDSPRS_SY_Compu "" TAB_VERB "%6.3" "" COMPU_TAB_REF PAIRFLTDSPRS_SY_Compu /end COMPU_METHOD
/begin COMPU_VTAB PAIRFLTDSPRS_SY_Compu "" TAB_VERB 2 0 "False" 1 "True" /end COMPU_VTAB
/begin COMPU_METHOD PAIRFLTDS_SNSR2PRSNT_SC_Compu "" TAB_VERB "%6.3" "" COMPU_TAB_REF PAIRFLTDS_SNSR2PRSNT_SC_Compu /end COMPU_METHOD
/begin COMPU_VTAB PAIRFLTDS_SNSR2PRSNT_SC_Compu "" TAB_VERB 2 0 "False" 1 "True" /end COMPU_VTAB
/begin COMPU_METHOD PAIRFLTDS_TYPAVL_SY_Compu "" TAB_VERB "%6.3" "" COMPU_TAB_REF PAIRFLTDS_TYPAVL_SY_Compu /end COMPU_METHOD
/begin COMPU_VTAB PAIRFLTDS_TYPAVL_SY_Compu "" TAB_VERB 2 0 "False" 1 "True" /end COMPU_VTAB
/begin COMPU_METHOD PASSDOORRDNT_TYPAVL_SC_Compu "" TAB_VERB "%6.3" "" COMPU_TAB_REF PASSDOORRDNT_TYPAVL_SC_Compu /end COMPU_METHOD
/begin COMPU_VTAB PASSDOORRDNT_TYPAVL_SC_Compu "" TAB_VERB 2 0 "False" 1 "True" /end COMPU_VTAB
/begin COMPU_METHOD Pres "" RAT_FUNC "%6.3" "kPa" COEFFS 0 10 0 0 0 1 /end COMPU_METHOD
/begin COMPU_METHOD Pres_hPa "" RAT_FUNC "%6.2" "hPa" COEFFS 0 1 0 0 0 1 /end COMPU_METHOD
/begin COMPU_METHOD p_q0p0005 "" RAT_FUNC "%6.5" "MPa" COEFFS 0 10000 0 0 0 5 /end COMPU_METHOD
/begin COMPU_METHOD p_q0p0005_MPa "" RAT_FUNC "%6.5" "MPa" COEFFS 0 10000 0 0 0 5 /end COMPU_METHOD
/begin COMPU_METHOD q1p1921Em6_L_DIV_s "" RAT_FUNC "%8.7" "l/s" COEFFS 0 65536 0 0 0 0.078125 /end COMPU_METHOD
/begin COMPU_METHOD RBPtCel_p_0p002_1 "" RAT_FUNC "%6.4" "MPa" COEFFS 0 1000 0 0 0 2 /end COMPU_METHOD
/begin COMPU_METHOD relKW_q0p0015259 "" RAT_FUNC "%6.4" "%/Grad KW" COEFFS 0 65536 0 0 0 100 /end COMPU_METHOD
/begin COMPU_METHOD rel_q0p0061 "" RAT_FUNC "%6.4" "" COEFFS 0 65536 0 0 0 400 /end COMPU_METHOD
/begin COMPU_METHOD rel_q0p02344 "" RAT_FUNC "%6.4" "%" COEFFS 0 32 0 0 0 0.75 /end COMPU_METHOD
/begin COMPU_METHOD rel_sw_b100 "" RAT_FUNC "%6.4" "%" COEFFS 0 32768 0 0 0 100 /end COMPU_METHOD
/begin COMPU_METHOD rel_sw_b200 "" RAT_FUNC "%6.4" "%" COEFFS 0 65536 0 0 0 400 /end COMPU_METHOD
/begin COMPU_METHOD rel_uw_b200 "" RAT_FUNC "%6.4" "%" COEFFS 0 65536 0 0 0 200 /end COMPU_METHOD
/begin COMPU_METHOD rel_uw_b3072 "" RAT_FUNC "%6.4" "%" COEFFS 0 65536 0 0 0 3072 /end COMPU_METHOD
/begin COMPU_METHOD rel_uw_q0p0234 "" RAT_FUNC "%6.4" "%" COEFFS 0 32 0 0 0 0.75 /end COMPU_METHOD
/begin COMPU_METHOD spg_q1p221Em3_V "" RAT_FUNC "%6.4" "V" COEFFS 0 65536 0 0 0 80 /end COMPU_METHOD
/begin COMPU_METHOD spg_q3p052em4 "" RAT_FUNC "%6.5" "V" COEFFS 0 65536 0 0 0 20 /end COMPU_METHOD
/begin COMPU_METHOD spg_uw_q0p00488 "" RAT_FUNC "%6.4" "V" COEFFS 0 1024 0 0 0 5 /end COMPU_METHOD
/begin COMPU_METHOD Temp_Cels "" RAT_FUNC "%6.1" "deg C" COEFFS 0 10 2731.4 0 0 1 /end COMPU_METHOD
/begin COMPU_METHOD temp_q0p1_om40 "" RAT_FUNC "%6.2" "Grad C" COEFFS 0 1 40 0 0 0.1 /end COMPU_METHOD
/begin COMPU_METHOD Time_ms "" RAT_FUNC "%6.1" "ms" COEFFS 0 0.1 0 0 0 1 /end COMPU_METHOD
/begin COMPU_METHOD Time_s "" RAT_FUNC "%6.4" "s" COEFFS 0 100 0 0 0 1 /end COMPU_METHOD
/begin COMPU_METHOD Time_sec_q1_COMPU "" RAT_FUNC "%6.2" "s" COEFFS 0 1 0 0 0 1 /end COMPU_METHOD
/begin COMPU_METHOD tv_uw_b100 "" RAT_FUNC "%6.4" "%" COEFFS 0 65536 0 0 0 100 /end COMPU_METHOD
/begin COMPU_METHOD t_q0p01 "" RAT_FUNC "%6.4" "s" COEFFS 0 100 0 0 0 1 /end COMPU_METHOD
/begin COMPU_METHOD t_q0p02 "" RAT_FUNC "%6.4" "s" COEFFS 0 100 0 0 0 2 /end COMPU_METHOD
/begin COMPU_METHOD t_q0p05 "" RAT_FUNC "%6.4" "s" COEFFS 0 100 0 0 0 5 /end COMPU_METHOD
/begin COMPU_METHOD t_q0p1 "" RAT_FUNC "%6.3" "s" COEFFS 0 10 0 0 0 1 /end COMPU_METHOD
/begin COMPU_METHOD t_q1p0_us "" RAT_FUNC "%6.2" "us" COEFFS 0 1 0 0 0 1 /end COMPU_METHOD
/begin COMPU_METHOD t_us_q1 "" RAT_FUNC "%6.2" "us" COEFFS 0 1 0 0 0 1 /end COMPU_METHOD
/begin COMPU_METHOD vnw_q0p0305 "" RAT_FUNC "%6.4" "°Crs/sec" COEFFS 0 65536 0 0 0 2000 /end COMPU_METHOD
/begin COMPU_METHOD volgrd_q2p38Em6 "" RAT_FUNC "%8.7" "l/s" COEFFS 0 2097152 0 0 0 5 /end COMPU_METHOD
/begin COMPU_METHOD Volt_Batt "" RAT_FUNC "%6.1" "mV" COEFFS 0 0.05 0 0 0 1 /end COMPU_METHOD
/begin COMPU_METHOD vol_q1p953Em5_l "" RAT_FUNC "%7.6" "l" COEFFS 0 51200 0 0 0 1 /end COMPU_METHOD
/begin COMPU_METHOD vol_q3p90625Em3_l "" RAT_FUNC "%6.4" "l" COEFFS 0 65536 0 0 0 256 /end COMPU_METHOD
/begin COMPU_METHOD vol_q6p1035Em7 "" RAT_FUNC "%9.8" "L" COEFFS 0 65536 0 0 0 0.04 /end COMPU_METHOD
/begin COMPU_METHOD vol_q7p8125Em3_l "" RAT_FUNC "%6.4" "l" COEFFS 0 128 0 0 0 1 /end COMPU_METHOD
/begin COMPU_METHOD zk10msxs_uw_b655 "" RAT_FUNC "%6.2" "s" COEFFS 0 0 65536 0 100 0 /end COMPU_METHOD
/begin RECORD_LAYOUT RB_Axis_S16 NO_AXIS_PTS_X 1 SWORD AXIS_PTS_X 2 SWORD INDEX_INCR DIRECT /end RECORD_LAYOUT
/begin RECORD_LAYOUT RB_Curve_S16_S16 NO_AXIS_PTS_X 1 SWORD AXIS_PTS_X 2 SWORD INDEX_INCR DIRECT FNC_VALUES 3 SWORD COLUMN_DIR DIRECT /end RECORD_LAYOUT
/begin RECORD_LAYOUT RB_Curve_S16_S32_Static NO_AXIS_PTS_X 1 SWORD AXIS_PTS_X 2 SWORD INDEX_INCR DIRECT FNC_VALUES 3 SLONG COLUMN_DIR DIRECT STATIC_RECORD_LAYOUT /end RECORD_LAYOUT
/begin RECORD_LAYOUT RB_Curve_S16_U16_Static NO_AXIS_PTS_X 1 SWORD AXIS_PTS_X 2 SWORD INDEX_INCR DIRECT FNC_VALUES 3 UWORD COLUMN_DIR DIRECT STATIC_RECORD_LAYOUT /end RECORD_LAYOUT
/begin RECORD_LAYOUT RB_Curve_S16_U8_Static NO_AXIS_PTS_X 1 SWORD AXIS_PTS_X 2 SWORD INDEX_INCR DIRECT FNC_VALUES 3 UBYTE COLUMN_DIR DIRECT STATIC_RECORD_LAYOUT /end RECORD_LAYOUT
/begin RECORD_LAYOUT RB_Curve_U16_U16 NO_AXIS_PTS_X 1 UWORD AXIS_PTS_X 2 UWORD INDEX_INCR DIRECT FNC_VALUES 3 UWORD COLUMN_DIR DIRECT /end RECORD_LAYOUT
/begin RECORD_LAYOUT RB_Curve_U8_U16_Static NO_AXIS_PTS_X 1 UBYTE AXIS_PTS_X 2 UBYTE INDEX_INCR DIRECT FNC_VALUES 3 UWORD COLUMN_DIR DIRECT STATIC_RECORD_LAYOUT /end RECORD_LAYOUT
/begin RECORD_LAYOUT RB_MapGroup_S16 FNC_VALUES 1 SWORD COLUMN_DIR DIRECT /end RECORD_LAYOUT
/begin RECORD_LAYOUT RB_MapGroup_U16 FNC_VALUES 1 UWORD COLUMN_DIR DIRECT /end RECORD_LAYOUT
/begin RECORD_LAYOUT RB_Map_S16S16_S16 NO_AXIS_PTS_X 1 SWORD NO_AXIS_PTS_Y 2 SWORD AXIS_PTS_X 3 SWORD INDEX_INCR DIRECT AXIS_PTS_Y 4 SWORD INDEX_INCR DIRECT FNC_VALUES 5 SWORD COLUMN_DIR DIRECT /end RECORD_LAYOUT
/begin RECORD_LAYOUT RB_Map_S16S16_U16 NO_AXIS_PTS_X 1 SWORD NO_AXIS_PTS_Y 2 SWORD AXIS_PTS_X 3 SWORD INDEX_INCR DIRECT AXIS_PTS_Y 4 SWORD INDEX_INCR DIRECT FNC_VALUES 5 UWORD COLUMN_DIR DIRECT /end RECORD_LAYOUT
/begin RECORD_LAYOUT RB_Map_S16S16_U8 NO_AXIS_PTS_X 1 SWORD NO_AXIS_PTS_Y 2 SWORD AXIS_PTS_X 3 SWORD INDEX_INCR DIRECT AXIS_PTS_Y 4 SWORD INDEX_INCR DIRECT FNC_VALUES 5 UBYTE COLUMN_DIR DIRECT /end RECORD_LAYOUT
/begin RECORD_LAYOUT RB_Map_S16U8_U16 NO_AXIS_PTS_X 1 SWORD NO_AXIS_PTS_Y 2 SWORD AXIS_PTS_X 3 SWORD INDEX_INCR DIRECT AXIS_PTS_Y 4 UBYTE INDEX_INCR DIRECT FNC_VALUES 5 UWORD COLUMN_DIR DIRECT /end RECORD_LAYOUT
/begin RECORD_LAYOUT RB_Map_U16U16_U16 NO_AXIS_PTS_X 1 UWORD NO_AXIS_PTS_Y 2 UWORD AXIS_PTS_X 3 UWORD INDEX_INCR DIRECT AXIS_PTS_Y 4 UWORD INDEX_INCR DIRECT FNC_VALUES 5 UWORD COLUMN_DIR DIRECT /end RECORD_LAYOUT
/begin RECORD_LAYOUT RB_Val_Wboolean FNC_VALUES 1 UBYTE COLUMN_DIR DIRECT /end RECORD_LAYOUT
/begin RECORD_LAYOUT RB_Val_Ws16 FNC_VALUES 1 SWORD COLUMN_DIR DIRECT /end RECORD_LAYOUT
/begin RECORD_LAYOUT RB_Val_Ws32 FNC_VALUES 1 SLONG COLUMN_DIR DIRECT /end RECORD_LAYOUT
/begin RECORD_LAYOUT RB_Val_Ws8 FNC_VALUES 1 SBYTE COLUMN_DIR DIRECT /end RECORD_LAYOUT
/begin RECORD_LAYOUT RB_Val_Wu16 FNC_VALUES 1 UWORD COLUMN_DIR DIRECT /end RECORD_LAYOUT
/begin RECORD_LAYOUT RB_Val_Wu32 FNC_VALUES 1 ULONG COLUMN_DIR DIRECT /end RECORD_LAYOUT
/begin RECORD_LAYOUT RB_Val_Wu8 FNC_VALUES 1 UBYTE COLUMN_DIR DIRECT /end RECORD_LAYOUT
/begin RECORD_LAYOUT Val_Ws16 FNC_VALUES 1 SWORD COLUMN_DIR DIRECT /end RECORD_LAYOUT
/begin RECORD_LAYOUT Val_Ws32 FNC_VALUES 1 SLONG COLUMN_DIR DIRECT /end RECORD_LAYOUT
/begin RECORD_LAYOUT Val_Wu8 FNC_VALUES 1 UBYTE COLUMN_DIR DIRECT /end RECORD_LAYOUT
/end MODULE
/end PROJECT
