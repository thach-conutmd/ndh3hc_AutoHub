ASAP2_VERSION 1 60
/begin PROJECT MG1CS022 "MG1CS022"
/begin HEADER "" VERSION "MG1CS022_62XSC_V037" PROJECT_NO MG1CS022 /end HEADER
/begin MODULE DIM ""
/begin MOD_COMMON "" BYTE_ORDER MSB_LAST ALIGNMENT_BYTE 1 ALIGNMENT_WORD 2 ALIGNMENT_LONG 4 ALIGNMENT_INT64 4 ALIGNMENT_FLOAT32_IEEE 4 ALIGNMENT_FLOAT64_IEEE 4 DATA_SIZE 32 /end MOD_COMMON
/begin CHARACTERISTIC CoPT_flgFcoInhbEna_C "calibration to enable the Powertrain inhibits fuel cut-off" VALUE 0x8057DF16 RB_Val_Wu8 255.0 OneToOne 0.00 255.0 FORMAT "%5.1" /end CHARACTERISTIC
/begin CHARACTERISTIC CoPT_flgFuCutOffActvEna_C "calibration to enable the Fuel Cut Off active" VALUE 0x8057DF17 RB_Val_Wu8 255.0 OneToOne 0.00 255.0 FORMAT "%5.1" /end CHARACTERISTIC
/begin CHARACTERISTIC CoPT_nMinSysErrLim_C "Limit value for minimum speed in case of system errors" VALUE 0x8057E04E RB_Val_Ws16 32767.50 EngN -16384.00 16383.50 FORMAT "%8.2" /end CHARACTERISTIC
/begin CHARACTERISTIC Eep_ClrWrCounter_CW "Codeword to clear write counters" VALUE 0x804D8296 Val_Wu8 255.0 OneToOne 0.00 255.0 FORMAT "%5.1" /end CHARACTERISTIC
/begin CHARACTERISTIC Eep_EnFirstInit_CW "Codeword to start a first initialization in EEP" VALUE 0x804D8295 Val_Wu8 255.0 OneToOne 0.00 255.0 FORMAT "%5.1" /end CHARACTERISTIC
/begin CHARACTERISTIC Eep_EnvRamClr_CW "Codeword to clear contents of ENVRAM" VALUE 0x804D8294 Val_Wu8 255.0 OneToOne 0.00 255.0 FORMAT "%5.1" /end CHARACTERISTIC
/begin CHARACTERISTIC PT2ME_CW "CW for PT2ME" VALUE 0x8057DF18 RB_Val_Wu8 255.0 dez 0.00 255.0 FORMAT "%5.1" /end CHARACTERISTIC
/begin CHARACTERISTIC PT2ME_numGearAsgn_T "Curve to interpolate the current and the desired gear" CURVE 0x8057DF1A RB_Curve_S8_U8_Static 255.0 dez 0.00 255.0 FORMAT "%5.1"
 /begin AXIS_DESCR STD_AXIS NO_INPUT_QUANTITY dez 12 -128.0 127.0 FORMAT "%5.1" DEPOSIT ABSOLUTE /end AXIS_DESCR
/end CHARACTERISTIC
/begin CHARACTERISTIC PT2ME_tiThresAftEngSt_C "adapter parameter time threshold after engine start for evaluation of drive position B_fs" VALUE 0x8057DF34 RB_Val_Wu16 655.3500 t10msxs_uw_b655p35 0.00 655.3500 FORMAT "%8.4" /end CHARACTERISTIC
/begin CHARACTERISTIC PtCoornDyn_dtqIntvMinSpdCtrlNegSlop_C "Negative slope for ramping minimum limits when a decreasing intervention should be overwritten by the speed control demand." VALUE 0x8057E344 RB_Val_Ws32 6553599.99847 RmpTrq -3276800.00000 3276799.99847 FORMAT "%13.5" /end CHARACTERISTIC
/begin CHARACTERISTIC PtCoornDyn_dtqIntvMinSpdCtrlPosSlop_C "Positive slope for ramping minimum limits when a decreasing intervention should be overwritten by the speed control demand." VALUE 0x8057E348 RB_Val_Ws32 6553599.99847 RmpTrq -3276800.00000 3276799.99847 FORMAT "%13.5" /end CHARACTERISTIC
/begin CHARACTERISTIC PtCoornDyn_dTqRampLeadStabyIntvDecNeg_C "Negative ramp slope for decreasing stability intervention torque on lead path at clutch level" VALUE 0x8057E354 RB_Val_Ws32 6553599.99847 RmpTrq -3276800.00000 3276799.99847 FORMAT "%13.5" /end CHARACTERISTIC
/begin CHARACTERISTIC PtCoornDyn_dTqRampLeadStabyIntvDecPos_C "Positive ramp slope for decreasing stability intervention torque on lead path at clutch level" VALUE 0x8057E358 RB_Val_Ws32 6553599.99847 RmpTrq -3276800.00000 3276799.99847 FORMAT "%13.5" /end CHARACTERISTIC
/begin CHARACTERISTIC PtCoornDyn_dTqRampLeadTrsmIntvDecNeg_C "Negative ramp slope for decreasing transmission intervention torque on lead path at clutch level" VALUE 0x8057E35C RB_Val_Ws32 6553599.99847 RmpTrq -3276800.00000 3276799.99847 FORMAT "%13.5" /end CHARACTERISTIC
/begin CHARACTERISTIC PtCoornDyn_dTqRampLeadTrsmIntvDecPos_C "Positive ramp slope for decreasing transmission intervention torque on lead path at clutch level" VALUE 0x8057E360 RB_Val_Ws32 6553599.99847 RmpTrq -3276800.00000 3276799.99847 FORMAT "%13.5" /end CHARACTERISTIC
/begin CHARACTERISTIC PtCoornDyn_nIdleSpdDelta_C "Parameter to vary idle speed condition in hysteresis to avoid toggling" VALUE 0x8057E34C RB_Val_Ws16 32767.50 nmot_sw_q0p5 -16384.00 16383.50 FORMAT "%8.2" /end CHARACTERISTIC
/begin CHARACTERISTIC PtCoornDyn_nIdleSpdOffst_C "Parameter to vary idle speed offset in hysteresis" VALUE 0x8057E34E RB_Val_Ws16 32767.50 nmot_sw_q0p5 -16384.00 16383.50 FORMAT "%8.2" /end CHARACTERISTIC
/begin CHARACTERISTIC PtCoornDyn_stDesTqSetPahSwt_C "Desired torque set path switch" VALUE 0x8057E350 RB_Val_Wboolean 1.00000000000 B_TRUE 0.00 1.00000000000 FORMAT "%13.11" /end CHARACTERISTIC
/begin CHARACTERISTIC PtCoornDyn_stTqLimdLeadPahSwt_C "torque limited lead path switch" VALUE 0x8057E364 RB_Val_Wboolean 1.00000000000 B_TRUE 0.00 1.00000000000 FORMAT "%13.11" /end CHARACTERISTIC
/begin CHARACTERISTIC PtCoornDyn_tiDlyLeadStabyIntvDec_C "Delay time to discard decreasing stability intervention on lead path" VALUE 0x8057E368 RB_Val_Ws32 4294967.29500 Time_ms_DT -2147483.64800 2147483.64700 FORMAT "%13.5" /end CHARACTERISTIC
/begin CHARACTERISTIC PtCoornDyn_tiDlyLeadTrsmIntvDec_C "Delay time to discard decreasing transmission intervention on lead path" VALUE 0x8057E36C RB_Val_Ws32 4294967.29500 Time_ms_DT -2147483.64800 2147483.64700 FORMAT "%13.5" /end CHARACTERISTIC
/begin CHARACTERISTIC PTDist_flgIaRelsLeadFil_C "Flag to enable ignition angle release due to dynamic torque requirements and ignition angle release with ramping, when the Demand for torque filtering in lead path is active." VALUE 0x8057DF38 RB_Val_Wu8 1.00000000000 B_TRUE 0.00 1.00000000000 FORMAT "%13.11" /end CHARACTERISTIC
/begin CHARACTERISTIC PTDist_flgLADIaRels_C "Flag to enable the ignition angle release due to dynamic torque requirements and ignition angle release with ramping, when the Maximum torque for limitation by ASD reference filter is less than or equal to the Propulsion torque limited by stationary limi" VALUE 0x8057DF39 RB_Val_Wu8 1.00000000000 B_TRUE 0.00 1.00000000000 FORMAT "%13.11" /end CHARACTERISTIC
/begin CHARACTERISTIC PTDist_flgSwtLADInpCluSig_C "Flag to switch between two input torque signals to compare with Maximum torque for limitation by ASD reference filter" VALUE 0x8057DF3A RB_Val_Wboolean 1.00000000000 B_TRUE 0.00 1.00000000000 FORMAT "%13.11" /end CHARACTERISTIC
/begin CHARACTERISTIC PTDist_tqDiffIARlsNegACOffIdleHi_T "Dynamic Torque Difference for enabling Intervention Active(Firing ange adjustment) in case of Negative gradients and AC off with high threshold" CURVE 0x8057DF3C RB_Curve_S16_S16 6553.500 md_q0p1 -3276.800 3276.700 FORMAT "%8.3"
 /begin AXIS_DESCR STD_AXIS ActMod_trqClthWoDstC md_q0p1 5 -3276.800 3276.700 FORMAT "%8.3" DEPOSIT ABSOLUTE /end AXIS_DESCR
/end CHARACTERISTIC
/begin CHARACTERISTIC PTDist_tqDiffIARlsNegACOffIdleLo_T "Dynamic Torque Difference for enabling Intervention Active(Firing ange adjustment) in case of Negative gradients and AC off with low threshold" CURVE 0x8057DF52 RB_Curve_S16_S16 6553.500 md_q0p1 -3276.800 3276.700 FORMAT "%8.3"
 /begin AXIS_DESCR STD_AXIS ActMod_trqClthWoDstC md_q0p1 5 -3276.800 3276.700 FORMAT "%8.3" DEPOSIT ABSOLUTE /end AXIS_DESCR
/end CHARACTERISTIC
/begin CHARACTERISTIC PTDist_tqDiffIARlsNegACOnIdleHi_T "Dynamic Torque Difference for enabling Intervention Active(Firing ange adjustment) in case of Negative gradients and AC on with high threshold" CURVE 0x8057DF68 RB_Curve_S16_S16 6553.500 md_q0p1 -3276.800 3276.700 FORMAT "%8.3"
 /begin AXIS_DESCR STD_AXIS ActMod_trqClthWoDstC md_q0p1 5 -3276.800 3276.700 FORMAT "%8.3" DEPOSIT ABSOLUTE /end AXIS_DESCR
/end CHARACTERISTIC
/begin CHARACTERISTIC PTDist_tqDiffIARlsNegACOnIdleLo_T "Dynamic Torque Difference for enabling Intervention Active(Firing ange adjustment) in case of Negative gradients and AC on with low threshold" CURVE 0x8057DF7E RB_Curve_S16_S16 6553.500 md_q0p1 -3276.800 3276.700 FORMAT "%8.3"
 /begin AXIS_DESCR STD_AXIS ActMod_trqClthWoDstC md_q0p1 5 -3276.800 3276.700 FORMAT "%8.3" DEPOSIT ABSOLUTE /end AXIS_DESCR
/end CHARACTERISTIC
/begin CHARACTERISTIC PTDist_tqDiffIARlsNegACOnNonIdleHi_T "Dynamic Torque Difference for enabling Intervention Active(Firing ange adjustment) in case of Negative gradients and AC on none idle with high threshold" CURVE 0x8057DF94 RB_Curve_S16_S16 6553.500 md_q0p1 -3276.800 3276.700 FORMAT "%8.3"
 /begin AXIS_DESCR STD_AXIS ActMod_trqClthWoDstC md_q0p1 5 -3276.800 3276.700 FORMAT "%8.3" DEPOSIT ABSOLUTE /end AXIS_DESCR
/end CHARACTERISTIC
/begin CHARACTERISTIC PTDist_tqDiffIARlsNegACOnNonIdleLo_T "Dynamic Torque Difference for enabling Intervention Active(Firing ange adjustment) in case of Negative gradients and AC on none idle with low threshold" CURVE 0x8057DFAA RB_Curve_S16_S16 6553.500 md_q0p1 -3276.800 3276.700 FORMAT "%8.3"
 /begin AXIS_DESCR STD_AXIS ActMod_trqClthWoDstC md_q0p1 5 -3276.800 3276.700 FORMAT "%8.3" DEPOSIT ABSOLUTE /end AXIS_DESCR
/end CHARACTERISTIC
/begin CHARACTERISTIC PTDist_tqDiffIARlsPosACOnHi_T "Dynamic Torque Difference for enabling Intervention Active(Firing ange adjustment) in case of Positive gradients and AC on with high threshold" CURVE 0x8057DFC0 RB_Curve_S16_S16 6553.500 md_q0p1 -3276.800 3276.700 FORMAT "%8.3"
 /begin AXIS_DESCR STD_AXIS ActMod_trqClthWoDstC md_q0p1 5 -3276.800 3276.700 FORMAT "%8.3" DEPOSIT ABSOLUTE /end AXIS_DESCR
/end CHARACTERISTIC
/begin CHARACTERISTIC PTDist_tqDiffIARlsPosACOnLo_T "Dynamic Torque Difference for enabling Intervention Active(Firing ange adjustment) in case of Positive gradients and AC on with low threshold" CURVE 0x8057DFD6 RB_Curve_S16_S16 6553.500 md_q0p1 -3276.800 3276.700 FORMAT "%8.3"
 /begin AXIS_DESCR STD_AXIS ActMod_trqClthWoDstC md_q0p1 5 -3276.800 3276.700 FORMAT "%8.3" DEPOSIT ABSOLUTE /end AXIS_DESCR
/end CHARACTERISTIC
/begin CHARACTERISTIC PTDist_tqHiThdLADIaRels_C "Upper calibratable torque threshold above which if input torque goes(i.e. if Maximum torque for limitation by ASD reference filter is higher than the Propulsion torque limited by stationanry limits),the load alteration damper is not active." VALUE 0x8057DFEC RB_Val_Ws16 6553.500 Trq -3276.800 3276.700 FORMAT "%8.3" /end CHARACTERISTIC
/begin CHARACTERISTIC PTDist_tqHiThdLeadFilInactv_C "Upper calibratable torque threshold beyond which if input torque goes, ignition angle release due to dynamic torque requirements and ignition angle release with ramping is set , when the Demand for torque filtering in lead path is not active." VALUE 0x8057DFEE RB_Val_Ws16 3276.700 md_q0p1 0.00 3276.700 FORMAT "%8.3" EXTENDED_LIMITS -3276.800 3276.700 /end CHARACTERISTIC
/begin CHARACTERISTIC PTDist_tqICEMaxOffs_C "Maximum allowed Offset torque at the crankshaft level" VALUE 0x8057DFF0 RB_Val_Ws16 6553.500 Trq -3276.800 3276.700 FORMAT "%8.3" /end CHARACTERISTIC
/begin CHARACTERISTIC PTDist_tqLoThdLADIaRels_C "Lower calibratable torque threshold below which if input torque goes (i.e. if Maximum torque for limitation by ASD reference filter is equal to or lower than the Propulsion torque limited by stationanry limits) the load alteration damper is active." VALUE 0x8057DFF2 RB_Val_Ws16 6553.500 Trq -3276.800 3276.700 FORMAT "%8.3" /end CHARACTERISTIC
/begin CHARACTERISTIC PTDist_tqLoThdLeadFilInactv_C "Lower calibratable torque threshold below which if input torque goes , the ignition angle release due to dynamic torque requirements and ignition angle release with ramping is reset, when the Demand for torque filtering in lead path is not active." VALUE 0x8057DFF4 RB_Val_Ws16 6553.500 md_q0p1 -3276.800 3276.700 FORMAT "%8.3" /end CHARACTERISTIC
/begin CHARACTERISTIC PTDist_trqDiffDynIntvActvNeg_T "Dynamic Torque Difference for enabling Intervention Active (Firing angle adjustment) in case of Negative gradients" CURVE 0x8057DFF6 RB_Curve_S16_S16 3276.700 md_q0p1 0.00 3276.700 FORMAT "%8.3" EXTENDED_LIMITS -3276.800 3276.700
 /begin AXIS_DESCR STD_AXIS ActMod_trqClthWoDstC md_q0p1 5 -3276.800 3276.700 FORMAT "%8.3" DEPOSIT ABSOLUTE /end AXIS_DESCR
/end CHARACTERISTIC
/begin CHARACTERISTIC PTDist_trqDiffDynIntvActvPos_T "Dynamic Torque Difference for enabling Intervention Active (Firing angle adjustment) in case of Positive gradients" CURVE 0x8057E00C RB_Curve_S16_S16 3276.700 md_q0p1 0.00 3276.700 FORMAT "%8.3" EXTENDED_LIMITS -3276.800 3276.700
 /begin AXIS_DESCR STD_AXIS ActMod_trqClthWoDstC md_q0p1 5 -3276.800 3276.700 FORMAT "%8.3" DEPOSIT ABSOLUTE /end AXIS_DESCR
/end CHARACTERISTIC
/begin CHARACTERISTIC PTDist_trqOfsDynActvNeg_T "Dynamic offset Torque for enabling Intervention Active (Firing angle adjustment) in case of Negative gradients" CURVE 0x8057E022 RB_Curve_S16_S16 6553.500 md_q0p1 -3276.800 3276.700 FORMAT "%8.3"
 /begin AXIS_DESCR STD_AXIS ActMod_trqClthWoDstC md_q0p1 5 -3276.800 3276.700 FORMAT "%8.3" DEPOSIT ABSOLUTE /end AXIS_DESCR
/end CHARACTERISTIC
/begin CHARACTERISTIC PTDist_trqOfsDynActvPos_T "Dynamic offset Torque for enabling Intervention Active (Firing angle adjustment) in case of Positive gradients" CURVE 0x8057E038 RB_Curve_S16_S16 6553.500 md_q0p1 -3276.800 3276.700 FORMAT "%8.3"
 /begin AXIS_DESCR STD_AXIS ActMod_trqClthWoDstC md_q0p1 5 -3276.800 3276.700 FORMAT "%8.3" DEPOSIT ABSOLUTE /end AXIS_DESCR
/end CHARACTERISTIC
/begin CHARACTERISTIC PthLead_stTrqCalc_CW "Code word for configuring calculations of torque reserve in module" VALUE 0x8057E370 RB_Val_Wu8 255.0 OneToOne 0.00 255.0 FORMAT "%5.1" /end CHARACTERISTIC
/begin CHARACTERISTIC PThrVlvUs_nSwtSynCalcThd_C "engine speed threshold, above which calculation of pressure sensor value in synchro-process is possible" VALUE 0x8057E302 RB_Val_Ws16 32767.50 EngN -16384.00 16383.50 FORMAT "%8.2" /end CHARACTERISTIC
/begin CHARACTERISTIC PThrVlvUs_pDifAirFilMax_C "Maximum pressure difference over air filter for diagnosis of pressure value throttle valve upstream" VALUE 0x8057E304 RB_Val_Wu16 5119.922 p_q0p078 0.00 5119.922 FORMAT "%8.3" /end CHARACTERISTIC
/begin CHARACTERISTIC PThrVlvUs_pDifAirFilUsVehV_T "rise in pressure upstream air filter depending on vehicle speed" CURVE 0x8057E306 RB_Curve_S16_U16_Static 2559.961 p_uw_q0p039 0.00 2559.961 FORMAT "%8.3"
 /begin AXIS_DESCR STD_AXIS VehV_v Vel 4 -327.6800 327.6700 FORMAT "%8.4" DEPOSIT ABSOLUTE /end AXIS_DESCR
/end CHARACTERISTIC
/begin CHARACTERISTIC PThrVlvUs_pSnsrTolrMax_C "Maximum pressure sensor tolerance" VALUE 0x8057E318 RB_Val_Wu16 5119.922 p_q0p078 0.00 5119.922 FORMAT "%8.3" /end CHARACTERISTIC
/begin CHARACTERISTIC PThrVlvUs_pSubValMax_C "substitute value for highest possible pressure upstream of throttle valve" VALUE 0x8057E31A RB_Val_Wu16 5119.922 p_q0p078 0.00 5119.922 FORMAT "%8.3" /end CHARACTERISTIC
/begin CHARACTERISTIC PThrVlvUs_pSubValMin_C "substitute value for lowest possible pressure upstream of throttle valve" VALUE 0x8057E31C RB_Val_Wu16 5119.922 p_q0p078 0.00 5119.922 FORMAT "%8.3" /end CHARACTERISTIC
/begin CHARACTERISTIC PthSet_dTqIgnAgRlsPos_C "Derivative torque for ignition angle release positive Calibration" VALUE 0x8057E564 RB_Val_Ws32 6553599.99847 RmpTrq -3276800.00000 3276799.99847 FORMAT "%13.5" /end CHARACTERISTIC
/begin CHARACTERISTIC PthSet_dtrqIALckRmp2_C "Delta torque for change limitation at withdrawl of IA-release" VALUE 0x8057E568 RB_Val_Ws16 3276.600 Trq 0.100 3276.700 FORMAT "%8.3" EXTENDED_LIMITS -3276.800 3276.700 /end CHARACTERISTIC
/begin CHARACTERISTIC PthSet_dtrqIALckRmp_C "Delta torque for change limitation at withdrawl of IA-release" VALUE 0x8057E56A RB_Val_Ws16 32750.00 mdgrad_q10 10.00 32760.00 FORMAT "%8.2" EXTENDED_LIMITS -327680.0 327670.0 /end CHARACTERISTIC
/begin CHARACTERISTIC PthSet_dtrqIARlsRmp2_C "Delta torque for change limitation at IA-release" VALUE 0x8057E374 RB_Val_Ws32 6553599.99847 RmpTrq -3276800.00000 3276799.99847 FORMAT "%13.5" /end CHARACTERISTIC
/begin CHARACTERISTIC PthSet_dtrqIARlsRmp_MAP "MAP for Derivative torque from ignition angle release ramp" MAP 0x8057E378 RB_Map_S16S16_S32 6553599.99847 RmpTrq -3276800.00000 3276799.99847 FORMAT "%13.5"
 /begin AXIS_DESCR STD_AXIS Tra_numGear OneToOne 10 -128.0000 127.0000 FORMAT "%8.4" EXTENDED_LIMITS -32768.00 32767.00 DEPOSIT ABSOLUTE /end AXIS_DESCR
 /begin AXIS_DESCR STD_AXIS RngMod_trqInrBs md_q0p1 8 -3276.800 3276.700 FORMAT "%8.3" DEPOSIT ABSOLUTE /end AXIS_DESCR
/end CHARACTERISTIC
/begin CHARACTERISTIC PthSet_facFCOMin_C "Factor for computing torque threshold for transition into overrun fuel cutoff" VALUE 0x8057E4F0 RB_Val_Wu8 0.9961 fak_ub_b1 0.00 0.9961 /end CHARACTERISTIC
/begin CHARACTERISTIC PthSet_facMonFCOLo_C "Factor for lower hysteresis threshold for fuel cutoff due to monitoring level 1" VALUE 0x8057E56C RB_Val_Wu8 1.992188 fak_ub_b2 0.00 1.992188 FORMAT "%8.6" /end CHARACTERISTIC
/begin CHARACTERISTIC PthSet_flgEnaOvrRunHyst_C "Mask to enable torque hysteresis based cylinder fuel cut-off release" VALUE 0x8057E4F1 RB_Val_Wboolean 1.00000000000 B_TRUE 0.00 1.00000000000 FORMAT "%13.11" /end CHARACTERISTIC
/begin CHARACTERISTIC PthSet_flgInnrLimdCutOffEna_C "Condition Inner Limitation Cut Off Enable" VALUE 0x8057E56D RB_Val_Wboolean 1.00000000000 B_TRUE 0.00 1.00000000000 FORMAT "%13.11" /end CHARACTERISTIC
/begin CHARACTERISTIC PthSet_nMaxCylIndivFCO_C "Engine speed threshold for cylinder individual fuel cut-off" VALUE 0x8057E4F2 RB_Val_Ws16 16383.50 EngN 0.00 16383.50 FORMAT "%8.2" EXTENDED_LIMITS -16384.00 16383.50 /end CHARACTERISTIC
/begin CHARACTERISTIC PthSet_nOvrRunThres_C "Lower engine speed threshold for the activation of overrun fuel cut-off" VALUE 0x8057E4F4 RB_Val_Ws16 32767.50 EngN -16384.00 16383.50 FORMAT "%8.2" /end CHARACTERISTIC
/begin CHARACTERISTIC PthSet_numMaxCylCtOff_C "Maximum number of masked cylinders during cylinder individual fuel cut-off" VALUE 0x8057E4F6 RB_Val_Wu8 255.0 OneToOne 0.00 255.0 FORMAT "%5.1" /end CHARACTERISTIC
/begin CHARACTERISTIC PthSet_stIaRlsCmftMask_C "Mask to choose conditions relevant for ignition angle release with ramp" VALUE 0x8057E4E0 RB_Val_Wu16 65535.00 OneToOne 0.00 65535.00 FORMAT "%8.2" /end CHARACTERISTIC
/begin CHARACTERISTIC PthSet_stIaRlsIntvMask_C "Mask to choose conditions relevant for ignition angle release without ramp" VALUE 0x8057E4E2 RB_Val_Wu16 65535.00 OneToOne 0.00 65535.00 FORMAT "%8.2" /end CHARACTERISTIC
/begin CHARACTERISTIC PthSet_stIaRlsSlowRampMask_C "Mask to choose conditions relevant for ignition angle release with slow ramp" VALUE 0x8057E4E4 RB_Val_Wu16 65535.00 OneToOne 0.00 65535.00 FORMAT "%8.2" /end CHARACTERISTIC
/begin CHARACTERISTIC PthSet_stIaRlsWoIntvMask_C "Mask to choose conditions relevant for ignition angle release without intervention" VALUE 0x8057E4E6 RB_Val_Wu16 65535.00 OneToOne 0.00 65535.00 FORMAT "%8.2" /end CHARACTERISTIC
/begin CHARACTERISTIC PthSet_stIaRlsWoTrsmIntvMask_C "Mask to choose conditions relevant for ignition angle release without transmission intervention" VALUE 0x8057E4E8 RB_Val_Wu16 65535.00 OneToOne 0.00 65535.00 FORMAT "%8.2" /end CHARACTERISTIC
/begin CHARACTERISTIC PthSet_stOvrRun_CW "Codeword to configure cylinder individual fuel cut-off based on different conditions" VALUE 0x8057E4F7 RB_Val_Wu8 255.0 OneToOne 0.00 255.0 FORMAT "%5.1" /end CHARACTERISTIC
/begin CHARACTERISTIC PthSet_stSwtNoGripSeln_C "Switch to select no grip condition" VALUE 0x8057E4EA RB_Val_Wu8 255.0 OneToOne 0.00 255.0 FORMAT "%5.1" /end CHARACTERISTIC
/begin CHARACTERISTIC PthSet_stTrqDist_CW "Codeword to enable use of exclusive torque reserve, Slope of torque ramp after withdrawal of ignition angle release in the torque distibution path" VALUE 0x8057E56E RB_Val_Wu8 255.0 OneToOne 0.00 255.0 FORMAT "%5.1" /end CHARACTERISTIC
/begin CHARACTERISTIC PthSet_SwtFCOTqInhbn_C "A switch to deactivate the consideration of minimum combustion engine torque for Fuel cut off" VALUE 0x8057E4F8 RB_Val_Wboolean 1.00000000000 B_TRUE 0.00 1.00000000000 FORMAT "%13.11" /end CHARACTERISTIC
/begin CHARACTERISTIC PthSet_tiFcoDlyTmr_C "delay time of the timer PthSet_flgFcoReqflgT_I" VALUE 0x8057E4F9 RB_Val_Wu8 2.500 Time_s 0.00 2.500 FORMAT "%5.3" EXTENDED_LIMITS 0.00 2.550 /end CHARACTERISTIC
/begin CHARACTERISTIC PthSet_tiMaxPhRstrt_C "Maximum period of time for phase Restart after overrun cutoff" VALUE 0x8057E4FA RB_Val_Wu8 2.540 Time_s 0.010 2.550 FORMAT "%5.3" EXTENDED_LIMITS 0.00 2.550 /end CHARACTERISTIC
/begin CHARACTERISTIC PthSet_tiUpShift_CUR "used for FCO delay of the selected gear from 2 to 9" CURVE 0x8057E4FC RB_Curve_S16_U16_Static 3.000000 Time_s 0.00 3.000000 FORMAT "%8.6" EXTENDED_LIMITS 0.00 655.3500
 /begin AXIS_DESCR STD_AXIS Gbx_numGearTrgt OneToOne 8 -32768.00 32767.00 FORMAT "%8.2" DEPOSIT ABSOLUTE /end AXIS_DESCR
/end CHARACTERISTIC
/begin CHARACTERISTIC PthSet_tqIARmpOffset_C "offset torque to limit the Ignition angle release Ramp Torque" VALUE 0x8057E570 RB_Val_Ws16 3276.700 Trq 0.00 3276.700 FORMAT "%8.3" EXTENDED_LIMITS -3276.800 3276.700 /end CHARACTERISTIC
/begin CHARACTERISTIC PthSet_tqLoadBasdThdFcoOff_CUR "Threshold torque for the release of cylinder fuel cut-off disable" CURVE 0x8057E51E RB_Curve_U16_S16_Static 3276.700 Trq 0.00 3276.700 FORMAT "%8.3" EXTENDED_LIMITS -3276.800 3276.700
 /begin AXIS_DESCR STD_AXIS rl_w_msg rel_q0p0234 8 0.00 1535.977 FORMAT "%8.3" DEPOSIT ABSOLUTE /end AXIS_DESCR
/end CHARACTERISTIC
/begin CHARACTERISTIC PthSet_tqLoadBasdThdFcoOn_CUR "Threshold torque for the release of cylinder fuel cut-off enable" CURVE 0x8057E540 RB_Curve_U16_S16_Static 3276.700 Trq 0.00 3276.700 FORMAT "%8.3" EXTENDED_LIMITS -3276.800 3276.700
 /begin AXIS_DESCR STD_AXIS rl_w_msg rel_q0p0234 8 0.00 1535.977 FORMAT "%8.3" DEPOSIT ABSOLUTE /end AXIS_DESCR
/end CHARACTERISTIC
/begin CHARACTERISTIC PthSet_trqHysOvrRun_C "Torque hysteresis for decision of cylinder fuel cutoff" VALUE 0x8057E562 RB_Val_Ws16 6553.500 Trq -3276.800 3276.700 FORMAT "%8.3" /end CHARACTERISTIC
/begin CHARACTERISTIC PthSet_trqIARlsRmpActvnThd_C "torque threshold for activation of ignition angle release ramp" VALUE 0x8057E4EC RB_Val_Ws16 25.00000 md_q0p1 0.00 25.00000 FORMAT "%8.5" EXTENDED_LIMITS -3276.800 3276.700 /end CHARACTERISTIC
/begin CHARACTERISTIC PTSSE_bStrtEnaCVT_C "Engine start enable" VALUE 0x8057E050 RB_Val_Wu8 1.00000000000 B_TRUE 0.00 1.00000000000 FORMAT "%13.11" /end CHARACTERISTIC
/begin CHARACTERISTIC PTSSE_stGbxSpstReqActv_C "Active status of start stop request from Gearbox ECU via CAN" VALUE 0x8057E051 RB_Val_Wu8 2.000 OneToOne 0.00 2.000 FORMAT "%5.3" EXTENDED_LIMITS 0.00 255.0 /end CHARACTERISTIC
/begin CHARACTERISTIC PTSSE_stSpstReq_T "Curve to map the start stop request from Gearbox ECU" CURVE 0x8057E052 RB_Curve_U8_U8 255.0 OneToOne 0.00 255.0 FORMAT "%5.1"
 /begin AXIS_DESCR STD_AXIS Gbx_stSpstReq OneToOne 10 0.00 255.0 FORMAT "%5.1" DEPOSIT ABSOLUTE /end AXIS_DESCR
/end CHARACTERISTIC
/begin CHARACTERISTIC PT_cntrEngActvIgn_C "Engine active counter threshold" VALUE 0x8057E068 RB_Val_Wu8 255.0 OneToOne 0.00 255.0 FORMAT "%5.1" /end CHARACTERISTIC
/begin CHARACTERISTIC PT_dtqNegSlopSetWoIntv_M "Map value for the Delta torque for negative slope for IARls_WoIntv" MAP 0x8057E170 RB_Map_S8S16_S16 6553.500 NmPerSec -3276.800 3276.700 FORMAT "%8.3"
 /begin AXIS_DESCR STD_AXIS Tra_numGear OneToOne 10 -128.0 127.0 FORMAT "%5.1" DEPOSIT ABSOLUTE /end AXIS_DESCR
 /begin AXIS_DESCR STD_AXIS RngMod_trqInrBs md_q0p1 8 -3276.800 3276.700 FORMAT "%8.3" DEPOSIT ABSOLUTE /end AXIS_DESCR
/end CHARACTERISTIC
/begin CHARACTERISTIC PT_dtqNegSlopWoTrsmIntv_M "Map Value of the Delta torque for negative slope for IARls_WoTrsmIntv" MAP 0x8057E22C RB_Map_S8S16_S16 6553.500 NmPerSec -3276.800 3276.700 FORMAT "%8.3"
 /begin AXIS_DESCR STD_AXIS Tra_numGear OneToOne 10 -128.0 127.0 FORMAT "%5.1" DEPOSIT ABSOLUTE /end AXIS_DESCR
 /begin AXIS_DESCR STD_AXIS RngMod_trqInrBs md_q0p1 8 -3276.800 3276.700 FORMAT "%8.3" DEPOSIT ABSOLUTE /end AXIS_DESCR
/end CHARACTERISTIC
/begin CHARACTERISTIC PT_dtqPosSlopSetWoIntv_C "Delta torque for positive slope for IARls_WoIntv" VALUE 0x8057E2E8 RB_Val_Wu32 6553599.99847 RmpTrq 0.00 6553599.99847 FORMAT "%13.5" /end CHARACTERISTIC
/begin CHARACTERISTIC PT_dtqPosSlopSetWoTrsmIntv_C "Delta torque for positive slope for IARls_WoTrsmIntv" VALUE 0x8057E2EC RB_Val_Wu32 6553599.99847 RmpTrq 0.00 6553599.99847 FORMAT "%13.5" /end CHARACTERISTIC
/begin CHARACTERISTIC PT_flgIndcdLimnBascTq_C "Basic indicated torque limitaion" VALUE 0x8057E069 RB_Val_Wboolean 1.00000000000 B_TRUE 0.00 1.00000000000 FORMAT "%13.11" /end CHARACTERISTIC
/begin CHARACTERISTIC PT_flgInnrTqLimEna_C "Target engine torque under limitation enable flag" VALUE 0x8057E06A RB_Val_Wboolean 1.00000000000 B_TRUE 0.00 1.00000000000 FORMAT "%13.11" /end CHARACTERISTIC
/begin CHARACTERISTIC PT_flgNPosSnsrRdnt_C "Flag to select configuration of neutral gear switch sensor (single or redundant)" VALUE 0x8057E084 RB_Val_Wboolean 1.00000000000 B_TRUE 0.00 1.00000000000 FORMAT "%13.11" /end CHARACTERISTIC
/begin CHARACTERISTIC PT_flgSwtIntvDrvrDmdRstFco_C "Parameter to consider driver demand during intervention in resetting the FCO flags on parallel path" VALUE 0x8057E2F0 RB_Val_Wu8 1.00000000000 B_TRUE 0.00 1.00000000000 FORMAT "%13.11" /end CHARACTERISTIC
/begin CHARACTERISTIC PT_flgSwtStabyIntvIncSetOverrun_C "Parameter to consider increasing Stability intervention in resetting the FCO flags on parallel path" VALUE 0x8057E2F1 RB_Val_Wu8 1.00000000000 B_TRUE 0.00 1.00000000000 FORMAT "%13.11" /end CHARACTERISTIC
/begin CHARACTERISTIC PT_flgSwtTrsmIntvIncSetOvrRun_C "Parameter to consider increasing transmission intervention in resetting the FCO flags on parallel path" VALUE 0x8057E2F2 RB_Val_Wu8 1.00000000000 B_TRUE 0.00 1.00000000000 FORMAT "%13.11" /end CHARACTERISTIC
/begin CHARACTERISTIC PT_flgTqLimnInnr_C "Inner torque limitation" VALUE 0x8057E06B RB_Val_Wboolean 1.00000000000 B_TRUE 0.00 1.00000000000 FORMAT "%13.11" /end CHARACTERISTIC
/begin CHARACTERISTIC PT_flgTqRmpIALckDsbl_C "Parameter to disable the ignition release ramp" VALUE 0x8057E2F3 RB_Val_Wu8 1.00000000000 B_TRUE 0.00 1.00000000000 FORMAT "%13.11" /end CHARACTERISTIC
/begin CHARACTERISTIC PT_GripCfg_CW "codeword for the configuration of the function PT_Grip" VALUE 0x8057E085 RB_Val_Wu8 255.0 OneToOne 0.00 255.0 FORMAT "%5.1" /end CHARACTERISTIC
/begin CHARACTERISTIC PT_nMinAftIdle_MAP "Conditions for RPM increase and gear state following idling at the time of clutch-release judgement" MAP 0x8057E086 RB_Map_S16U16_U16 16383.75 nmot_uw_q0p25 0.00 16383.75 FORMAT "%8.2"
 /begin AXIS_DESCR STD_AXIS Tra_numGear OneToOne 8 -32768.00 32767.00 FORMAT "%8.2" DEPOSIT ABSOLUTE /end AXIS_DESCR
 /begin AXIS_DESCR STD_AXIS PT_nBgnIdle nmot_uw_q0p25 8 0.00 16383.75 FORMAT "%8.2" DEPOSIT ABSOLUTE /end AXIS_DESCR
/end CHARACTERISTIC
/begin CHARACTERISTIC PT_rClthSlipDeb_C "Analogue value for the state PT_bNoGrip = FALSE and clutch slips, debounced (manual clutch)." VALUE 0x8057E12A RB_Val_Ws16 655.3500 Fact100 -327.6800 327.6700 FORMAT "%8.4" /end CHARACTERISTIC
/begin CHARACTERISTIC PT_rClthSlip_C "Analogue value for the state PT_bNoGrip = FALSE and clutch slips (manual clutch) or clutch is in a slip state / controlled operation (automated clutch)." VALUE 0x8057E12C RB_Val_Ws16 655.3500 Fact100 -327.6800 327.6700 FORMAT "%8.4" /end CHARACTERISTIC
/begin CHARACTERISTIC PT_rConvSlipClsd_C "Analogue value for the state PT_bNoGrip = FALSE and converter lockup clutch is almost closed, little slip." VALUE 0x8057E12E RB_Val_Ws16 655.3500 Fact100 -327.6800 327.6700 FORMAT "%8.4" /end CHARACTERISTIC
/begin CHARACTERISTIC PT_rConvSlipOpn_C "Analogue value for the state PT_bNoGrip = FALSE and converter lockup clutch is open (converter in slip)." VALUE 0x8057E130 RB_Val_Ws16 655.3500 Fact100 -327.6800 327.6700 FORMAT "%8.4" /end CHARACTERISTIC
/begin CHARACTERISTIC PT_rConvSlip_C "Analogue value for the state PT_bNoGrip = FALSE and converter lockup clutch is controlled or is in controlled slip operation." VALUE 0x8057E132 RB_Val_Ws16 655.3500 Fact100 -327.6800 327.6700 FORMAT "%8.4" /end CHARACTERISTIC
/begin CHARACTERISTIC PT_rGripDfl_C "Analog value for the state where none of the single bit messages is TRUE" VALUE 0x8057E134 RB_Val_Ws16 655.3500 Fact100 -327.6800 327.6700 FORMAT "%8.4" /end CHARACTERISTIC
/begin CHARACTERISTIC PT_rGripHiThd_C "Clutch ratio high Threshold for Grip calculation" VALUE 0x8057E136 RB_Val_Ws16 255.9961 Prc_Fact256 -128.0000 127.9961 FORMAT "%8.4" /end CHARACTERISTIC
/begin CHARACTERISTIC PT_rGripLoThd_C "Clutch ratio Low Threshold for Grip calculation" VALUE 0x8057E138 RB_Val_Ws16 255.9961 Prc_Fact256 -128.0000 127.9961 FORMAT "%8.4" /end CHARACTERISTIC
/begin CHARACTERISTIC PT_rGrip_C "Analog value for the state grip is for sure present (the converter lockup clutch / the automated or manual clutch is completely closed and PT_bNoGrip = FALSE)." VALUE 0x8057E13A RB_Val_Ws16 655.3500 Fact100 -327.6800 327.6700 FORMAT "%8.4" /end CHARACTERISTIC
/begin CHARACTERISTIC PT_rMaxThrAgChg_C "Maximum change in driver requested throttle opening for deactivating detection of rpm overshoot after idling" VALUE 0x8057E13C RB_Val_Ws16 399.9939 rel_sw_b200 -200.0000 199.9939 FORMAT "%8.4" /end CHARACTERISTIC
/begin CHARACTERISTIC PT_rMinEngLd_CUR "Minimum load for activating detection of rpm overshoot after idling" CURVE 0x8057E13E RB_Curve_U16_U16 1535.977 rel_uw_q0p0234 0.00 1535.977 FORMAT "%8.3"
 /begin AXIS_DESCR STD_AXIS NO_INPUT_QUANTITY nmot_q0p25 8 0.00 16383.75 FORMAT "%8.2" DEPOSIT ABSOLUTE /end AXIS_DESCR
/end CHARACTERISTIC
/begin CHARACTERISTIC PT_rMinThrAgChg_C "Minimum change in driver requested throttle opening for activating detection of rpm overshooting after idling" VALUE 0x8057E160 RB_Val_Ws16 199.9969 rel_uw_b200 -100.0000 99.9969 FORMAT "%8.4" EXTENDED_LIMITS -100.0000 99.99695 /end CHARACTERISTIC
/begin CHARACTERISTIC PT_rNoGrip_C "Analog value for the state grip is for sure excluded" VALUE 0x8057E162 RB_Val_Ws16 655.3500 Fact100 -327.6800 327.6700 FORMAT "%8.4" /end CHARACTERISTIC
/begin CHARACTERISTIC PT_rTrqDfl_C "Default value for torque ratio" VALUE 0x8057E2FC RB_Val_Ws16 655.3500 TransR -327.6800 327.6700 FORMAT "%8.4" /end CHARACTERISTIC
/begin CHARACTERISTIC PT_stClthSensPrs_C "Calibration switch represents clutch sensor present or not" VALUE 0x8057E164 RB_Val_Wu8 255.0 OneToOne 0.00 255.0 FORMAT "%5.1" /end CHARACTERISTIC
/begin CHARACTERISTIC PT_swtClthGrip_C "The switch to choose the status of clutch in case of grip" VALUE 0x8057E165 RB_Val_Wboolean 1.00000000000 B_TRUE 0.00 1.00000000000 FORMAT "%13.11" /end CHARACTERISTIC
/begin CHARACTERISTIC PT_swtDetTypeCAN_C "Determines if value is read from CAN or not" VALUE 0x8057E2FE RB_Val_Ws8 255.0 OneToOne -128.0 127.0 FORMAT "%5.1" /end CHARACTERISTIC
/begin CHARACTERISTIC PT_swtEngTqEstimtdSeln_C "Switch engine estimated torque calibration" VALUE 0x8057E06C RB_Val_Wboolean 1.00000000000 B_TRUE 0.00 1.00000000000 FORMAT "%13.11" /end CHARACTERISTIC
/begin CHARACTERISTIC PT_swtGripInfoSrcSeln_C "Switch to select the input for Grip Information" VALUE 0x8057E166 RB_Val_Wboolean 1.00000000000 B_TRUE 0.00 1.00000000000 FORMAT "%13.11" /end CHARACTERISTIC
/begin CHARACTERISTIC PT_swtTrqRatNoFrz_C "Prevention of freeze of powertrain torque ratio." VALUE 0x8057E2FF RB_Val_Wu8 1.000 OneToOne 0.00 1.000 FORMAT "%5.3" EXTENDED_LIMITS 0.00 255.0 /end CHARACTERISTIC
/begin CHARACTERISTIC Pt_tiAcOffDetn_C "Air compressor turn off delay time" VALUE 0x8057E070 RB_Val_Ws32 4294.96729500 Time_Dt -2147.48364800 2147.48364700 FORMAT "%13.8" /end CHARACTERISTIC
/begin CHARACTERISTIC PT_tiAcOnDetn_C "Air compressor turn on delay time" VALUE 0x8057E074 RB_Val_Ws32 4294.96729500 Time_Dt -2147.48364800 2147.48364700 FORMAT "%13.8" /end CHARACTERISTIC
/begin CHARACTERISTIC PT_tiDebClthStSlip_C "Debouncing time for the formation of the state ""clutch slips, debounced"" (manual clutch)." VALUE 0x8057E168 RB_Val_Ws32 4294.96729500 Time_Dt -2147.48364800 2147.48364700 FORMAT "%13.8" /end CHARACTERISTIC
/begin CHARACTERISTIC PT_tiEngLimActvDesDly_C "Engine torque limitation active delay time" VALUE 0x8057E078 RB_Val_Ws32 4294.96729500 Time_Dt -2147.48364800 2147.48364700 FORMAT "%13.8" /end CHARACTERISTIC
/begin CHARACTERISTIC PT_tiOverrunInactvTrsmIntvDec_C "the delay time for the turn on delay for overrun inactive transmission intervention" VALUE 0x8057E2F4 RB_Val_Ws16 655.3500 Time_s -327.6800 327.6700 FORMAT "%8.4" /end CHARACTERISTIC
/begin CHARACTERISTIC PT_tiOverrunInactvWoIntv_C "the delay time for the turn on delay for overrun inactive without intervention" VALUE 0x8057E2F6 RB_Val_Ws16 655.3500 Time_s -327.6800 327.6700 FORMAT "%8.4" /end CHARACTERISTIC
/begin CHARACTERISTIC PT_tiThrOpngChg_C "Delay time for calculation of change in driver requested throttle opening" VALUE 0x8057E16C RB_Val_Wu8 2.550 t_q0p01 0.00 2.550 FORMAT "%5.3" /end CHARACTERISTIC
/begin CHARACTERISTIC PT_tqDifThdHysHiDrvDmdActv_C "Hysterisis High threshold limit to avoid tolerance issues in torque for which the difference in VMD_tqCluDes and RngMod_trqCrSMin should be greater than a calibratable threshold." VALUE 0x8057E2F8 RB_Val_Ws16 6553.500 Trq -3276.800 3276.700 FORMAT "%8.3" /end CHARACTERISTIC
/begin CHARACTERISTIC PT_tqDifThdHysLoDrvDmdActv_C "Hysterisis Low threshold limit to avoid tolerance issues in torque for which the difference in VMD_tqCluDes and RngMod_trqCrSMin should be greater than a calibratable threshold." VALUE 0x8057E2FA RB_Val_Ws16 6553.500 Trq -3276.800 3276.700 FORMAT "%8.3" /end CHARACTERISTIC
/begin CHARACTERISTIC PT_tqDrvrDmdMinThd_C "Calibration for maximum limit for Torque Demand by driver" VALUE 0x8057E07C RB_Val_Ws16 6553.500 Trq -3276.800 3276.700 FORMAT "%8.3" /end CHARACTERISTIC
/begin CHARACTERISTIC PT_trqRateLimitActvDiff_C "Torque rate limit activation differ" VALUE 0x8057E07E RB_Val_Ws16 6553.500 Trq -3276.800 3276.700 FORMAT "%8.3" /end CHARACTERISTIC
/begin CHARACTERISTIC PT_trqRateLimitActvTrqTh_C "Torque rate limit activation threshold" VALUE 0x8057E080 RB_Val_Ws16 6553.500 Trq -3276.800 3276.700 FORMAT "%8.3" /end CHARACTERISTIC
/begin CHARACTERISTIC PT_trqRateLimit_C "Torque rate limit calibration" VALUE 0x8057E082 RB_Val_Ws16 6553.500 Trq -3276.800 3276.700 FORMAT "%8.3" /end CHARACTERISTIC
/begin CHARACTERISTIC PT_vMinGrip_C "minimum vehicle speed for grip determination" VALUE 0x8057E16E RB_Val_Ws16 655.3500 Vel -327.6800 327.6700 FORMAT "%8.4" /end CHARACTERISTIC
/begin CHARACTERISTIC PT_vMinTrqRat_C "Minimum vehicle speed" VALUE 0x8057E300 RB_Val_Ws16 655.3500 Vel -327.6800 327.6700 FORMAT "%8.4" /end CHARACTERISTIC
/begin CHARACTERISTIC rba_SvbbEtk_DisableProcExec_KWB "" VAL_BLK 0xB92E00A4 ValA_Wu8 255.0 OneToOne 0.00 255.0 FORMAT "%5.1" NUMBER 9 MAX_REFRESH 3 200 /end CHARACTERISTIC
/begin CHARACTERISTIC rba_SvbbEtk_ResIdSrvPt_KWB "" VAL_BLK 0xB92E006C ValA_Wu16 8.00000000000 rba_SvbbEtk_SpName 0.00 8.00000000000 FORMAT "%13.11" NUMBER 8 MAX_REFRESH 3 200 /end CHARACTERISTIC
/begin CHARACTERISTIC rba_SvbbEtk_SrvPtEnabled_KWB "" VAL_BLK 0xB92E009C ValA_Wu8 255.0 OneToOne 0.00 255.0 FORMAT "%5.1" NUMBER 8 MAX_REFRESH 3 200 /end CHARACTERISTIC
/begin CHARACTERISTIC rba_SvbbEtk_SrvPtResId_KWB "" VAL_BLK 0xB92E00AD ValA_Wu8 255.0 OneToOne 0.00 255.0 FORMAT "%5.1" NUMBER 9 MAX_REFRESH 3 200 /end CHARACTERISTIC
/begin CHARACTERISTIC rba_SvbbEtk_TimeOutPost_KWB "" VAL_BLK 0xB92E008C ValA_Wu16 500.0000 rba_Svbb_Time_us 0.00 500.0000 FORMAT "%8.4" EXTENDED_LIMITS 0.00 655.3500 NUMBER 8 MAX_REFRESH 3 200 /end CHARACTERISTIC
/begin CHARACTERISTIC rba_SvbbEtk_TimeOutPre_KWB "" VAL_BLK 0xB92E007C ValA_Wu16 500.0000 rba_Svbb_Time_us 0.00 500.0000 FORMAT "%8.4" EXTENDED_LIMITS 0.00 655.3500 NUMBER 8 MAX_REFRESH 3 200 /end CHARACTERISTIC
/begin CHARACTERISTIC RngMod_bClth_C "state powertrain for torque adaption" VALUE 0x8057E9D4 RB_Val_Wu8 1.00000000000 B_TRUE 0.00 1.00000000000 FORMAT "%13.11" /end CHARACTERISTIC
/begin CHARACTERISTIC RngMod_deltaFacEtaWoIntv_C "ramp step for RngMod_facEtaWoIntv" VALUE 0x8057E574 RB_Val_Wu8 0.9922 fak_ub_b1 0.0039 0.9961 EXTENDED_LIMITS 0.00 0.9961 /end CHARACTERISTIC
/begin CHARACTERISTIC RngMod_deltaFacTrqOptWoIntv_C "ramp step for RngMod_facTrqOptWoIntv" VALUE 0x8057E575 RB_Val_Wu8 0.9922 fak_ub_b1 0.0039 0.9961 EXTENDED_LIMITS 0.00 0.9961 /end CHARACTERISTIC
/begin CHARACTERISTIC RngMod_facPwrDpdtFricLoss_M "Power dependent weighting factor of torque loss adaption" MAP 0x8057E9D6 RB_Map_S16S16_U8 2.000 fak_ub_q0p01 0.00 2.000 FORMAT "%5.3" EXTENDED_LIMITS 0.00 2.550
 /begin AXIS_DESCR STD_AXIS Epm_nEng nmot_q0p5 6 -16384.00 16383.50 FORMAT "%8.2" DEPOSIT ABSOLUTE /end AXIS_DESCR
 /begin AXIS_DESCR STD_AXIS ActMod_trqInr md_sw_q0p1 6 -3276.800 3276.700 FORMAT "%8.3" DEPOSIT ABSOLUTE /end AXIS_DESCR
/end CHARACTERISTIC
/begin CHARACTERISTIC RngMod_facSpd_CUR "interpolation factor base torque depending on engine speed" CURVE 0x8057EA64 RB_Curve_U16_U8_Static 0.9961 fak_ub_b1 0.00 0.9961
 /begin AXIS_DESCR STD_AXIS RngMod_nEng_LOC nmot_q0p5 6 0.00 32767.50 FORMAT "%8.2" DEPOSIT ABSOLUTE /end AXIS_DESCR
/end CHARACTERISTIC
/begin CHARACTERISTIC RngMod_facTraRat_CUR "interpolation factor base torque depending on transmission ratio" CURVE 0x8057EA78 RB_Curve_U16_U8_Static 0.9961 fak_ub_b1 0.00 0.9961
 /begin AXIS_DESCR STD_AXIS RngMod_rTrq_LOC fak_q0p01 7 0.00 655.3500 FORMAT "%8.4" DEPOSIT ABSOLUTE /end AXIS_DESCR
/end CHARACTERISTIC
/begin CHARACTERISTIC RngMod_nLIDvtMax_C "Speed threshold for adaption-stop" VALUE 0x8057EA16 RB_Val_Wu16 32767.50 nmot_q0p5 0.00 32767.50 FORMAT "%8.2" /end CHARACTERISTIC
/begin CHARACTERISTIC RngMod_nMaxDes_C "requested operating conditions: max. engine speed for torque adaption" VALUE 0x8057EA18 RB_Val_Wu16 16383.50 nmot_q0p5 0.00 16383.50 FORMAT "%8.2" EXTENDED_LIMITS 0.00 32767.50 /end CHARACTERISTIC
/begin CHARACTERISTIC RngMod_nMinDes_C "requested operating conditions: min. engine speed for torque adaption" VALUE 0x8057EA1A RB_Val_Wu16 16383.50 nmot_q0p5 0.00 16383.50 FORMAT "%8.2" EXTENDED_LIMITS 0.00 32767.50 /end CHARACTERISTIC
/begin CHARACTERISTIC RngMod_phiThrVlvThres_C "throttle value threshold for torque adaption" VALUE 0x8057EA1C RB_Val_Ws16 1599.976 rel_sw_q0p02441 -800.0000 799.9756 FORMAT "%8.4" /end CHARACTERISTIC
/begin CHARACTERISTIC RngMod_stPrio_CUR "priority of requested operating point for torque adaption" CURVE 0x8057EA1E RB_Curve_U8_U8 255.0 dez 0.00 255.0 FORMAT "%5.1"
 /begin AXIS_DESCR STD_AXIS RngMod_NumCycl dez 5 0.00 255.0 FORMAT "%5.1" DEPOSIT ABSOLUTE /end AXIS_DESCR
/end CHARACTERISTIC
/begin CHARACTERISTIC RngMod_swtTqDmdAcsy_CW "Codeword for selectively activation of torque demands from accessories" VALUE 0x8057EA2C RB_Val_Wu32 65535.0000000 OneToOne 0.00 65535.0000000 FORMAT "%13.7" EXTENDED_LIMITS 0.00 4294967295.00 /end CHARACTERISTIC
/begin CHARACTERISTIC RngMod_swtTqResv_C "Torque reserve taken into consideration when calculating engine limits" VALUE 0x8057E578 RB_Val_Wu8 1.00000000000 B_TRUE 0.00 1.00000000000 FORMAT "%13.11" /end CHARACTERISTIC
/begin CHARACTERISTIC RngMod_tAdapMin_C "minimum engine temperature for loss torque adaption" VALUE 0x8057EA30 RB_Val_Ws16 6553.500 temp_q0p1_o273 -3549.940 3003.560 FORMAT "%8.3" /end CHARACTERISTIC
/begin CHARACTERISTIC RngMod_tiDetnQly_C "threshold for quality information of torque adaption" VALUE 0x8057EA32 RB_Val_Wu16 655.3500 t_q0p01 0.00 655.3500 FORMAT "%8.4" /end CHARACTERISTIC
/begin CHARACTERISTIC RngMod_tiDmdAdpn_C "time for demand torque-adaption" VALUE 0x8057EA34 RB_Val_Wu16 655.3500 t_q0p01 0.00 655.3500 FORMAT "%8.4" /end CHARACTERISTIC
/begin CHARACTERISTIC RngMod_tiFltEtaIgnMin_C "time constant for filtering minimum spark efficiency" VALUE 0x8057E57A RB_Val_Wu16 655.34999985 zk10msxs_uw_b655p36 0.01000015 655.36000000 FORMAT "%12.8" EXTENDED_LIMITS 0.010000152590 655.36000000 /end CHARACTERISTIC
/begin CHARACTERISTIC RngMod_tiOffsRelsAdpn_C "Offset for time delay of release torque adaption" VALUE 0x8057EA36 RB_Val_Wu16 655.3500 t_q0p01 0.00 655.3500 FORMAT "%8.4" /end CHARACTERISTIC
/begin CHARACTERISTIC RngMod_tiRelsAdpn_C "debounce for adaption release" VALUE 0x8057EA38 RB_Val_Wu16 655.3500 t_q0p01 0.00 655.3500 FORMAT "%8.4" /end CHARACTERISTIC
/begin CHARACTERISTIC RngMod_tiTqAdpn_C "time constant for filtered torque adaption" VALUE 0x8057EA3A RB_Val_Wu16 655.34999985 zk10msxs_uw_b655p36 0.01000015 655.36000000 FORMAT "%12.8" EXTENDED_LIMITS 0.010000152590 655.36000000 /end CHARACTERISTIC
/begin CHARACTERISTIC RngMod_tiTqDifAdpn_C "time constant for filtered torque adaption" VALUE 0x8057EA3C RB_Val_Wu16 655.34999985 zk10msxs_uw_b655p36 0.01000015 655.36000000 FORMAT "%12.8" EXTENDED_LIMITS 0.010000152590 655.36000000 /end CHARACTERISTIC
/begin CHARACTERISTIC RngMod_TrqBsMod_CW "Codeword to control the calculation in RngMod_TrqBsMod" VALUE 0x8057E576 RB_Val_Wu8 255.0 dez 0.00 255.0 FORMAT "%5.1" /end CHARACTERISTIC
/begin CHARACTERISTIC RngMod_TrqCalc_CW "Codeword RngMod_TrqCalc" VALUE 0x8057E57C RB_Val_Wu8 255.0 dez 0.00 255.0 FORMAT "%5.1" /end CHARACTERISTIC
/begin CHARACTERISTIC RngMod_trqDef_C "default valur for nv - values of torque adaption" VALUE 0x8057EA3E RB_Val_Ws16 6553.500 md_sw_q0p1 -3276.800 3276.700 FORMAT "%8.3" /end CHARACTERISTIC
/begin CHARACTERISTIC RngMod_TrqFrcAdap_CW "Codeword torque adaption" VALUE 0x8057EA40 RB_Val_Wu16 65535.00 OneToOne 0.00 65535.00 FORMAT "%8.2" /end CHARACTERISTIC
/begin CHARACTERISTIC RngMod_trqLimMax_C "upper limit for torque adaption" VALUE 0x8057EA42 RB_Val_Ws16 6553.500 md_sw_q0p1 -3276.800 3276.700 FORMAT "%8.3" /end CHARACTERISTIC
/begin CHARACTERISTIC RngMod_trqLimMin_C "lower limit for torque adaption" VALUE 0x8057EA44 RB_Val_Ws16 6553.500 md_sw_q0p1 -3276.800 3276.700 FORMAT "%8.3" /end CHARACTERISTIC
/begin CHARACTERISTIC RngMod_trqMaxDes_C "requested operating conditions: max. torque for torque adaptation" VALUE 0x8057EA46 RB_Val_Ws16 3276.700 md_sw_q0p1 0.00 3276.700 FORMAT "%8.3" EXTENDED_LIMITS -3276.800 3276.700 /end CHARACTERISTIC
/begin CHARACTERISTIC RngMod_trqMinDes_C "requested operating conditions: min. torque for torque adaptation" VALUE 0x8057EA48 RB_Val_Ws16 3276.700 md_sw_q0p1 0.00 3276.700 FORMAT "%8.3" EXTENDED_LIMITS -3276.800 3276.700 /end CHARACTERISTIC
/begin CHARACTERISTIC RngMod_trqOfsLim_C "permitted offset for adapted torque per adaption period" VALUE 0x8057EA4A RB_Val_Ws16 6553.500 md_sw_q0p1 -3276.800 3276.700 FORMAT "%8.3" /end CHARACTERISTIC
/begin CHARACTERISTIC RngMod_trqOfsQl_C "threshold for quality information of torque adaption" VALUE 0x8057EA4C RB_Val_Ws16 6553.500 md_sw_q0p1 -3276.800 3276.700 FORMAT "%8.3" /end CHARACTERISTIC
/begin CHARACTERISTIC RngMod_vLimTrans_C "Speed threshold for reactivate the adaption" VALUE 0x8057EA4E RB_Val_Ws16 655.3500 vel_q0p01 -327.6800 327.6700 FORMAT "%8.4" /end CHARACTERISTIC
/begin CHARACTERISTIC RngMod_vLim_C "Speed threshold for demand adaption" VALUE 0x8057EA50 RB_Val_Ws16 655.3500 vel_q0p01 -327.6800 327.6700 FORMAT "%8.4" /end CHARACTERISTIC
/begin CHARACTERISTIC Sia_EnGen6Support_C "To enable or disable the Gen6 functionality." VALUE 0x8057EA92 RB_Val_Wu8 1.000 OneToOne 0.00 1.000 FORMAT "%5.3" EXTENDED_LIMITS 0.00 255.0 /end CHARACTERISTIC
/begin CHARACTERISTIC Sia_numCODE1_C "Immobilizer Code Byte 1 to be stored in EEPROM" VALUE 0x8057EA93 RB_Val_Wu8 253.0 OneToOne 1.0 254.0 FORMAT "%5.1" EXTENDED_LIMITS 0.00 255.0 /end CHARACTERISTIC
/begin CHARACTERISTIC Sia_numCODE2_C "Immobilizer Code Byte 2 to be stored in EEPROM" VALUE 0x8057EA94 RB_Val_Wu8 253.0 OneToOne 1.0 254.0 FORMAT "%5.1" EXTENDED_LIMITS 0.00 255.0 /end CHARACTERISTIC
/begin CHARACTERISTIC Sia_numCODE3_C "Immobilizer Code Byte 3 to be stored in EEPROM" VALUE 0x8057EA95 RB_Val_Wu8 253.0 OneToOne 1.0 254.0 FORMAT "%5.1" EXTENDED_LIMITS 0.00 255.0 /end CHARACTERISTIC
/begin CHARACTERISTIC Sia_numExcCod_C "Used to give direct Exc value without ICU." VALUE 0x8057EA96 RB_Val_Wu8 127.0 OneToOne 0.00 127.0 FORMAT "%5.1" EXTENDED_LIMITS 0.00 255.0 /end CHARACTERISTIC
/begin CHARACTERISTIC Sia_numExdCod_C "To give direct Exd value without ICU." VALUE 0x8057EA97 RB_Val_Wu8 127.0 OneToOne 0.00 127.0 FORMAT "%5.1" EXTENDED_LIMITS 0.00 255.0 /end CHARACTERISTIC
/begin CHARACTERISTIC Sia_numfARCal_C "Immobilizer fAR key calculation parameter" VALUE 0x8057EA90 RB_Val_Wu16 65535.00 OneToOne 0.00 65535.00 FORMAT "%8.2" /end CHARACTERISTIC
/begin CHARACTERISTIC Sia_swtCodEepUpd_C "Switch to store Calibration data in to EEPROM" VALUE 0x8057EA98 RB_Val_Wu8 1.000 OneToOne 0.00 1.000 FORMAT "%5.3" EXTENDED_LIMITS 0.00 255.0 /end CHARACTERISTIC
/begin CHARACTERISTIC Sia_swtExCodUpdt_C "To enable or disable direct Excode writing in Gen6." VALUE 0x8057EA99 RB_Val_Wu8 1.000 OneToOne 0.00 1.000 FORMAT "%5.3" EXTENDED_LIMITS 0.00 255.0 /end CHARACTERISTIC
/begin CHARACTERISTIC Sia_swtIgnLckEep_C "Immobiliser switch to determine whether to use previous learnt value of ignition status" VALUE 0x8057EA9A RB_Val_Wu8 1.000 OneToOne 0.00 1.000 FORMAT "%5.3" EXTENDED_LIMITS 0.00 255.0 /end CHARACTERISTIC
/begin CHARACTERISTIC Sia_swtImsVal_C "Switch to select type of immobilizer system" VALUE 0x8057EA9B RB_Val_Wu8 1.000 OneToOne 0.00 1.000 FORMAT "%5.3" EXTENDED_LIMITS 0.00 255.0 /end CHARACTERISTIC
/begin CHARACTERISTIC Sia_tiExRegTmrBMax_C "Max Timer to check the Excode Registration process in Gen6." VALUE 0x8057EA9C RB_Val_Ws16 32770.00 Time_ms 0.00 32770.00 FORMAT "%8.2" EXTENDED_LIMITS -327680.0 327670.0 /end CHARACTERISTIC
/begin CHARACTERISTIC Sia_tiTmrBMax_C "Timer to determine the maximum time for communication between Immobilizer and ECU" VALUE 0x8057EA9E RB_Val_Ws16 32770.00 Time_ms 0.00 32770.00 FORMAT "%8.2" EXTENDED_LIMITS -327680.0 327670.0 /end CHARACTERISTIC
/begin CHARACTERISTIC TMEAdpn_tGbxOilAdpnMin_T "Converter oil temperature threshold for torque loss adaptation release" CURVE 0x8057EA52 RB_Curve_S16_S16 6553.500 Temp_Cels -3549.940 3003.560 FORMAT "%8.3"
 /begin AXIS_DESCR STD_AXIS EnvT_t Temp_Cels 4 -3549.940 3003.560 FORMAT "%8.3" DEPOSIT ABSOLUTE /end AXIS_DESCR
/end CHARACTERISTIC
/begin CHARACTERISTIC TMELoss_swtPIntkRelAbs_C "Switch: Charge preasure absolute (FALSE) or relative to environmental preasure (TRUE)" VALUE 0x8057E57E RB_Val_Wu8 1.00000000000 B_TRUE 0.00 1.00000000000 FORMAT "%13.11" /end CHARACTERISTIC
/begin CHARACTERISTIC TMELoss_tqChrgExchIntkClsd_M "map for component dependent from inlet valve and pressure in intake manifold" MAP 0x8057E580 RB_Map_S16S16_S16 6553.500 Trq -3276.800 3276.700 FORMAT "%8.3"
 /begin AXIS_DESCR STD_AXIS TMELoss_pIntk p_q0p078 8 -2560.000 2559.922 FORMAT "%8.3" DEPOSIT ABSOLUTE /end AXIS_DESCR
 /begin AXIS_DESCR STD_AXIS GEVCtl_agIntkClsd kw_q0p0156 8 -512.0000 511.9844 FORMAT "%8.4" DEPOSIT ABSOLUTE /end AXIS_DESCR
/end CHARACTERISTIC
/begin CHARACTERISTIC TMELoss_tqChrgExchOutlOpen_M "map for component dependent from enginge speed and outlet valve" MAP 0x8057E624 RB_Map_S16S16_S16 6553.500 Trq -3276.800 3276.700 FORMAT "%8.3"
 /begin AXIS_DESCR STD_AXIS Epm_nEng EngN 12 -16384.00 16383.50 FORMAT "%8.2" DEPOSIT ABSOLUTE /end AXIS_DESCR
 /begin AXIS_DESCR STD_AXIS GEVCtl_agOutlOpen kw_q0p0156 8 -512.0000 511.9844 FORMAT "%8.4" DEPOSIT ABSOLUTE /end AXIS_DESCR
/end CHARACTERISTIC
/begin CHARACTERISTIC TMELoss_tqChrgExchOvlExh_M "Offset-Map for Charge Exchange Losses depending on valve overlap and exhaust gas pressure" MAP 0x8057E710 RB_Map_U16S16_S16 6553.500 Trq -3276.800 3276.700 FORMAT "%8.3"
 /begin AXIS_DESCR STD_AXIS NO_INPUT_QUANTITY p_uw_q0p078 12 0.00 5119.922 FORMAT "%8.3" DEPOSIT ABSOLUTE /end AXIS_DESCR
 /begin AXIS_DESCR STD_AXIS wgvum_w_Loc kw_q0p0156 8 -512.0000 511.9844 FORMAT "%8.4" DEPOSIT ABSOLUTE /end AXIS_DESCR
/end CHARACTERISTIC
/begin CHARACTERISTIC TMELoss_tqChrgExchOvl_M "Offset-Map for Charge Exchange Losses depending on valve overlap" MAP 0x8057E7FC RB_Map_S16S16_S16 6553.500 Trq -3276.800 3276.700 FORMAT "%8.3"
 /begin AXIS_DESCR STD_AXIS GEVCtl_agIntkOpen kw_q0p0156 12 -512.0000 511.9844 FORMAT "%8.4" DEPOSIT ABSOLUTE /end AXIS_DESCR
 /begin AXIS_DESCR STD_AXIS wgvum_w_Loc kw_q0p0156 8 -512.0000 511.9844 FORMAT "%8.4" DEPOSIT ABSOLUTE /end AXIS_DESCR
/end CHARACTERISTIC
/begin CHARACTERISTIC TMELoss_tqChrgExch_M "map for component dependent from enginge speed and pressure in intake manifold" MAP 0x8057E8E8 RB_Map_S16S16_S16 6553.500 Trq -3276.800 3276.700 FORMAT "%8.3"
 /begin AXIS_DESCR STD_AXIS Epm_nEng EngN 12 -16384.00 16383.50 FORMAT "%8.2" DEPOSIT ABSOLUTE /end AXIS_DESCR
 /begin AXIS_DESCR STD_AXIS TMELoss_pIntk p_q0p078 8 -2560.000 2559.922 FORMAT "%8.3" DEPOSIT ABSOLUTE /end AXIS_DESCR
/end CHARACTERISTIC
/begin CHARACTERISTIC VF2ME_DMRWAN_C "delta torque loss torque converter" VALUE 0x8057DF36 RB_Val_Wu8 99.61 rel_ub_b99p6 0.00 99.61 FORMAT "%5.2" /end CHARACTERISTIC
/begin MEASUREMENT APP_stPlaBrk "State of plausibility APP with brake" UBYTE OneToOne 1 100 0.00 255.0 FORMAT "%5.1" ECU_ADDRESS 0x6000FFEC /end MEASUREMENT
/begin MEASUREMENT B_eepwf "Condition Powerfail EEPROM" UBYTE B_TRUE 1 100 0.00 1.00000000000 BIT_MASK 0x1 FORMAT "%13.11" ECU_ADDRESS 0x7000010F /end MEASUREMENT
/begin MEASUREMENT B_estart_msg "Condition Terminal 50 ON" UBYTE B_TRUE 1 100 0.00 1.00000000000 BIT_MASK 0x1 FORMAT "%13.11" ECU_ADDRESS 0x70000BE3 /end MEASUREMENT
/begin MEASUREMENT B_fs_msg "Condition driving state (automatic gear box)" UBYTE B_TRUE 1 100 0.00 1.00000000000 BIT_MASK 0x1 FORMAT "%13.11" ECU_ADDRESS 0x70000BB9 /end MEASUREMENT
/begin MEASUREMENT B_gsch_msg "Condition gear-shift in process" UBYTE B_TRUE 1 100 0.00 1.00000000000 BIT_MASK 0x1 FORMAT "%13.11" ECU_ADDRESS 0x70000BAF /end MEASUREMENT
/begin MEASUREMENT B_gwhs_msg "Condition gear shift in case of manual gear shift lever" UBYTE B_TRUE 1 100 0.00 1.00000000000 BIT_MASK 0x1 FORMAT "%13.11" ECU_ADDRESS 0x70000BAD /end MEASUREMENT
/begin MEASUREMENT B_pvdg_msg "condition: pressure upstream throttle valve valid" UBYTE B_TRUE 1 100 0.00 1.00000000000 BIT_MASK 0x1 FORMAT "%13.11" ECU_ADDRESS 0x70000B37 /end MEASUREMENT
/begin MEASUREMENT B_pwf "condition for powerfail" UBYTE B_TRUE 1 100 0.00 1.00000000000 BIT_MASK 0x1 FORMAT "%13.11" ECU_ADDRESS 0x7000010E /end MEASUREMENT
/begin MEASUREMENT B_sta_msg "condition automatic start" UBYTE B_TRUE 1 100 0.00 1.00000000000 BIT_MASK 0x1 FORMAT "%13.11" ECU_ADDRESS 0x70000B2E /end MEASUREMENT
/begin MEASUREMENT B_wkauf_msg "Condition for open lock up clutch" UBYTE B_TRUE 1 100 0.00 1.00000000000 BIT_MASK 0x1 FORMAT "%13.11" ECU_ADDRESS 0x70000AEA /end MEASUREMENT
/begin MEASUREMENT B_wkr_msg "condition clutch controlled" UBYTE B_TRUE 1 100 0.00 1.00000000000 BIT_MASK 0x1 FORMAT "%13.11" ECU_ADDRESS 0x70000AE9 /end MEASUREMENT
/begin MEASUREMENT B_wk_msg "condition: converter lockup clutch closed" UBYTE B_TRUE 1 100 0.00 1.00000000000 BIT_MASK 0x1 FORMAT "%13.11" ECU_ADDRESS 0x70000AEB /end MEASUREMENT
/begin MEASUREMENT B_zwget_msg "Ignition angle intervention via transmission intervention" UBYTE B_TRUE 1 100 0.00 1.00000000000 BIT_MASK 0x1 FORMAT "%13.11" ECU_ADDRESS 0x70000AE2 /end MEASUREMENT
/begin MEASUREMENT CoPT_flgFuCutOffActv "Fuel Cut Off active" UBYTE B_TRUE 1 100 0.00 1.00000000000 BIT_MASK 0x1 FORMAT "%13.11" ECU_ADDRESS 0x6000F9FD /end MEASUREMENT
/begin MEASUREMENT CoPT_nASTDes "Transmission synchronisation speed" SWORD EngN 1 100 -16384.00 16383.50 FORMAT "%8.2" ECU_ADDRESS 0x70005366 /end MEASUREMENT
/begin MEASUREMENT CoPT_nMaxAcs "Application parameter for Maximum engine speed demand of accessories" SWORD EngN 1 100 -16384.00 16383.50 FORMAT "%8.2" ECU_ADDRESS 0x600147D0 /end MEASUREMENT
/begin MEASUREMENT CoPT_nMaxSysErr "Application parameter for maximum engine speed demand during a system error" SWORD EngN 1 100 -16384.00 16383.50 FORMAT "%8.2" ECU_ADDRESS 0x600147D2 /end MEASUREMENT
/begin MEASUREMENT CoPT_nMaxTra "Application parameter for Maximum engine speed demand of Transmission" SWORD EngN 1 100 -16384.00 16383.50 FORMAT "%8.2" ECU_ADDRESS 0x600147D4 /end MEASUREMENT
/begin MEASUREMENT CoPT_nMinAcs "Application parameter for Minimum engine speed demand of Accessories" SWORD EngN 1 100 -16384.00 16383.50 FORMAT "%8.2" ECU_ADDRESS 0x60009B5C /end MEASUREMENT
/begin MEASUREMENT CoPT_nMinSysErr "Application parameter for minimum engine speed demand during a system error" SWORD EngN 1 100 -16384.00 16383.50 FORMAT "%8.2" ECU_ADDRESS 0x60009B5A /end MEASUREMENT
/begin MEASUREMENT CoPT_nMinTra "Application parameter for Minimum engine speed demand of transmission" SWORD EngN 1 100 -16384.00 16383.50 FORMAT "%8.2" ECU_ADDRESS 0x60009B58 /end MEASUREMENT
/begin MEASUREMENT CoPT_stAST "Status word which defines status of transmission synchronisation speed request" UWORD OneToOne 1 100 0.00 65535.00 FORMAT "%8.2" ECU_ADDRESS 0x70005368 /end MEASUREMENT
/begin MEASUREMENT CoPT_stNSetPAcs "Application parameter for State of low idle speed request of accessories" UBYTE OneToOne 1 100 0.00 255.0 FORMAT "%5.1" ECU_ADDRESS 0x6000FF7A /end MEASUREMENT
/begin MEASUREMENT CoPT_stNSetPSysErr "Application parameter for state of low idle speed request while system error" UBYTE OneToOne 1 100 0.00 255.0 FORMAT "%5.1" ECU_ADDRESS 0x6000FF79 /end MEASUREMENT
/begin MEASUREMENT CoPT_stNSetPTra "Application parameter for State of low idle speed request of transmission" UBYTE OneToOne 1 100 0.00 255.0 FORMAT "%5.1" ECU_ADDRESS 0x6000FF78 /end MEASUREMENT
/begin MEASUREMENT CoPT_tiASTDes "Transmission synchronisation time" SWORD Time_s 1 100 -327.6800 327.6700 FORMAT "%8.4" ECU_ADDRESS 0x7000536A /end MEASUREMENT
/begin MEASUREMENT dmrwan_msg "Torque reserve for torque converter" UBYTE rel_ub_b99p6 1 100 0.00 99.61 FORMAT "%5.2" ECU_ADDRESS 0x6000F749 /end MEASUREMENT
/begin MEASUREMENT Eep_ctAbsCallWrFkt "16-bit-counter which counts the function calls to Eep_Write and Eep_Init over all driving cycles" UWORD OneToOne 1 100 0.00 65535.00 FORMAT "%8.2" ECU_ADDRESS 0x60036DC2 /end MEASUREMENT
/begin MEASUREMENT Eep_ctCallWrFkt "Counter which counts the function calls to Eep_Write and Eep_Init during one driving cycle" UWORD OneToOne 1 100 0.00 65535.00 FORMAT "%8.2" ECU_ADDRESS 0x6003566E /end MEASUREMENT
/begin MEASUREMENT Eep_ctMaxCallWrFkt "Maximum value of Eep_ctCallWrFkt" UWORD OneToOne 1 100 0.00 65535.00 FORMAT "%8.2" ECU_ADDRESS 0x60036DC4 /end MEASUREMENT
/begin MEASUREMENT Eep_EnvRamHist "History state ENVRAM" UBYTE OneToOne 1 100 0.00 255.0 FORMAT "%5.1" ECU_ADDRESS 0x6001025C /end MEASUREMENT
/begin MEASUREMENT Eep_EnvRamInvld "Invalidity state ENVRAM" UBYTE OneToOne 1 100 0.00 255.0 FORMAT "%5.1" ECU_ADDRESS 0x60014AFC /end MEASUREMENT
/begin MEASUREMENT Eep_PostdrvBlkIdx_s16 "Block Index of currently stored block" SWORD OneToOne 1 100 -32768.00 32767.00 FORMAT "%8.2" ECU_ADDRESS 0x60009EF0 /end MEASUREMENT
/begin MEASUREMENT Eep_stBlk "Status array with status of each EEP block" UWORD OneToOne 1 100 0.00 65535.00 FORMAT "%8.2" ARRAY_SIZE 92 ECU_ADDRESS 0x50005F3C /end MEASUREMENT
/begin MEASUREMENT Eep_stMain "Main state of EEP" SLONG Eep_MainStates_Verb 1 100 0.00 14.0000000000 FORMAT "%13.10" ECU_ADDRESS 0x60003B4C /end MEASUREMENT
/begin MEASUREMENT Eep_stPostDrv "Status of EEP process in PostDrive / PreDrive" UBYTE Eep_PostDrvState_Verb 1 100 0.00 4.00000000000 FORMAT "%13.11" ECU_ADDRESS 0x6001025A /end MEASUREMENT
/begin MEASUREMENT EISGov_trq "resulted output torque of EISGov controller" SWORD md_q0p1 1 100 -3276.800 3276.700 FORMAT "%8.3" ECU_ADDRESS 0x60009A08 /end MEASUREMENT
/begin MEASUREMENT etalabcg_w "Lambda efficiency without intervention referred to optimum torque at Lambda=1, w/o lambda-influence during CutOff" UWORD fak_uw_b2 1 100 0.00 1.999969 FORMAT "%8.6" ECU_ADDRESS 0x6000717E /end MEASUREMENT
/begin MEASUREMENT fpvd_w_msg "correction factor for pressure upstream throttle valve" UWORD fak_uw_b8 1 100 0.00 7.999878 FORMAT "%8.6" ECU_ADDRESS 0x600007AC /end MEASUREMENT
/begin MEASUREMENT gangist_msg "Actual gear position" UBYTE dez 1 100 0.00 255.0 FORMAT "%5.1" ECU_ADDRESS 0x700054BA /end MEASUREMENT
/begin MEASUREMENT gangi_msg "Engaged gear" UBYTE dez 1 100 0.00 255.0 FORMAT "%5.1" ECU_ADDRESS 0x6000FB40 /end MEASUREMENT
/begin MEASUREMENT gangsist_msg "Current gear" SBYTE dez 1 100 -128.0 127.0 FORMAT "%5.1" ECU_ADDRESS 0x6000FFF8 /end MEASUREMENT
/begin MEASUREMENT gangsziel_msg "desired gear" SBYTE dez 1 100 -128.0 127.0 FORMAT "%5.1" ECU_ADDRESS 0x700054BB /end MEASUREMENT
/begin MEASUREMENT InjCtl_qRaw "raw value of injection mass" UWORD rel_uw_b3072 1 100 0.00 3071.953 FORMAT "%8.3" ECU_ADDRESS 0x60009436 /end MEASUREMENT
/begin MEASUREMENT mdwan_w_msg "Torque request of the torque converter" SWORD rel_sw_b100 1 100 -100.0000 99.9969 FORMAT "%8.4" ECU_ADDRESS 0x60008FB8 /end MEASUREMENT
/begin MEASUREMENT mimaxdk_w_msg "maximum attainable indicated torque, optional limited to maximum torque at pspvdkds = 1" UWORD rel_uw_b100 1 100 0.00 99.99847 FORMAT "%8.5" ECU_ADDRESS 0x60009330 /end MEASUREMENT
/begin MEASUREMENT mioptogl_w "optimum torque without transmission interventions including influence from lambda" UWORD rel_uw_b100 1 100 0.00 99.99847 FORMAT "%8.5" ECU_ADDRESS 0x6000717C /end MEASUREMENT
/begin MEASUREMENT mioptog_w "optimum torque without transmission interventions" UWORD rel_uw_b100 1 100 0.00 99.99847 FORMAT "%8.5" ECU_ADDRESS 0x6000717A /end MEASUREMENT
/begin MEASUREMENT mioptouf_w "Unfiltered optimum torque without transmission interventions" UWORD rel_uw_b100 1 100 0.00 99.99847 FORMAT "%8.5" ECU_ADDRESS 0x60007178 /end MEASUREMENT
/begin MEASUREMENT PT2ME_numLstGear "previous gear" SBYTE OneToOne 1 100 -128.0 127.0 FORMAT "%5.1" ECU_ADDRESS 0x60014AC4 /end MEASUREMENT
/begin MEASUREMENT PtCoornDyn_flgGenericLimnActvDes "Flag for active status of generic priority limitation and limitation" UBYTE B_TRUE 1 100 0.00 1.00000000000 BIT_MASK 0x1 FORMAT "%13.11" ECU_ADDRESS 0x6000F914 /end MEASUREMENT
/begin MEASUREMENT PtCoornDyn_flgSpdCtrlDecIntvOvrd "A decreasing intervention should be overwritten by the speed control demand" UBYTE B_TRUE 1 100 0.00 1.00000000000 BIT_MASK 0x1 FORMAT "%13.11" ECU_ADDRESS 0x6000F913 /end MEASUREMENT
/begin MEASUREMENT PtCoornDyn_flgStabyIntvActvDes "Status stability interventions active" UBYTE B_TRUE 1 100 0.00 1.00000000000 BIT_MASK 0x1 FORMAT "%13.11" ECU_ADDRESS 0x6000F912 /end MEASUREMENT
/begin MEASUREMENT PtCoornDyn_flgStabyIntvDecActvDes "Status decreasing stability intervention active" UBYTE B_TRUE 1 100 0.00 1.00000000000 BIT_MASK 0x1 FORMAT "%13.11" ECU_ADDRESS 0x6000F911 /end MEASUREMENT
/begin MEASUREMENT PtCoornDyn_flgStabyIntvIncActvDes "Status increasing stability intervention active" UBYTE B_TRUE 1 100 0.00 1.00000000000 BIT_MASK 0x1 FORMAT "%13.11" ECU_ADDRESS 0x6000F910 /end MEASUREMENT
/begin MEASUREMENT PtCoornDyn_flgTrsmIntvActvDes "transmission intervention active" UBYTE B_TRUE 1 100 0.00 1.00000000000 BIT_MASK 0x1 FORMAT "%13.11" ECU_ADDRESS 0x6000F90F /end MEASUREMENT
/begin MEASUREMENT PtCoornDyn_flgTrsmIntvDecActvDes "decreasing transmission intervention active" UBYTE B_TRUE 1 100 0.00 1.00000000000 BIT_MASK 0x1 FORMAT "%13.11" ECU_ADDRESS 0x6000F90E /end MEASUREMENT
/begin MEASUREMENT PtCoornDyn_flgTrsmIntvIncActvDes "increasing transmission intervention active" UBYTE B_TRUE 1 100 0.00 1.00000000000 BIT_MASK 0x1 FORMAT "%13.11" ECU_ADDRESS 0x6000F90D /end MEASUREMENT
/begin MEASUREMENT PtCoornDyn_stIntvDecLead "Status of intervention on lead path bases on decrease transmission intervention torque" UBYTE OneToOne 1 100 0.00 255.0 FORMAT "%5.1" ECU_ADDRESS 0x6000FBB1 /end MEASUREMENT
/begin MEASUREMENT PtCoornDyn_stIntvLead "Status of intervention on lead path (consist of engine torque only)" UBYTE OneToOne 1 100 0.00 255.0 FORMAT "%5.1" ECU_ADDRESS 0x6000FBB0 /end MEASUREMENT
/begin MEASUREMENT PtCoornDyn_tqCluDecIntvMinLimn "Minimum limit for decreasing intervention" SWORD Trq 1 100 -3276.800 3276.700 FORMAT "%8.3" ECU_ADDRESS 0x600071EE /end MEASUREMENT
/begin MEASUREMENT PtCoornDyn_tqCluDecIntvMinLimnLead "minimum allowable torque for decreasing interventions" SWORD Trq 1 100 -3276.800 3276.700 FORMAT "%8.3" ECU_ADDRESS 0x600071DE /end MEASUREMENT
/begin MEASUREMENT PtCoornDyn_tqCluDes "Filtered and limited propulsion torque with all interventions for total desired torque path on clutch level" SWORD Trq 1 100 -3276.800 3276.700 FORMAT "%8.3" ECU_ADDRESS 0x60009818 /end MEASUREMENT
/begin MEASUREMENT PtCoornDyn_tqCluDesGenericLimn "generic limitation torque coordinated with minimum possible torque" SWORD Trq 1 100 -3276.800 3276.700 FORMAT "%8.3" ECU_ADDRESS 0x60009816 /end MEASUREMENT
/begin MEASUREMENT PtCoornDyn_tqCluDesWithMeclLimn "Filtered torque limited with SpdGov mechanical limits" SWORD Trq 1 100 -3276.800 3276.700 FORMAT "%8.3" ECU_ADDRESS 0x60009814 /end MEASUREMENT
/begin MEASUREMENT PtCoornDyn_tqCluDesWoIntv "Filtered and limited propulsion torque without any interventions for total desired torque path on clutch level" SWORD Trq 1 100 -3276.800 3276.700 FORMAT "%8.3" ECU_ADDRESS 0x60009812 /end MEASUREMENT
/begin MEASUREMENT PtCoornDyn_tqCluDesWoTrsmIntv "Filtered and limited propulsion torque without transmission intervention for total desired torque path on clutch level" SWORD Trq 1 100 -3276.800 3276.700 FORMAT "%8.3" ECU_ADDRESS 0x60009810 /end MEASUREMENT
/begin MEASUREMENT PtCoornDyn_tqCluLeadAftStabyIntvInc_MP "Torque at clutch level on lead path after stability increase intervention coordination" SWORD Trq 1 100 -3276.800 3276.700 FORMAT "%8.3" ECU_ADDRESS 0x7000A104 /end MEASUREMENT
/begin MEASUREMENT PtCoornDyn_tqCluLeadAftTrsmIntvDec_MP "Decrease transmission intervention torque at clutch level on lead path after ramp" SWORD Trq 1 100 -3276.800 3276.700 FORMAT "%8.3" ECU_ADDRESS 0x7000A102 /end MEASUREMENT
/begin MEASUREMENT PtCoornDyn_tqCluLeadBefIntvCoorn "Desired filitered demand torque before limitation and intervention" SWORD Trq 1 100 -3276.800 3276.700 FORMAT "%8.3" ECU_ADDRESS 0x600071DC /end MEASUREMENT
/begin MEASUREMENT PtCoornDyn_tqCluLeadDesGenericLimn "Desired generic limitation torque" SWORD Trq 1 100 -3276.800 3276.700 FORMAT "%8.3" ECU_ADDRESS 0x6000980E /end MEASUREMENT
/begin MEASUREMENT PtCoornDyn_tqCluLeadGenericLimn "Desired generic limitation torque at lead path (consist of engine torque only)" SWORD Trq 1 100 -3276.800 3276.700 FORMAT "%8.3" ECU_ADDRESS 0x6000980C /end MEASUREMENT
/begin MEASUREMENT PtCoornDyn_tqCluLeadStabyIntv "Intervention torque required at clutch level on lead path (consist of engine torque only) after considering stability intervention" SWORD Trq 1 100 -3276.800 3276.700 FORMAT "%8.3" ECU_ADDRESS 0x6000980A /end MEASUREMENT
/begin MEASUREMENT PtCoornDyn_tqCluLeadStabyIntvDecAftRamp_MP "Decrease stability intervention torque at clutch level on lead path after ramp" SWORD Trq 1 100 -3276.800 3276.700 FORMAT "%8.3" ECU_ADDRESS 0x7000A100 /end MEASUREMENT
/begin MEASUREMENT PtCoornDyn_tqCluLeadStabyIntvDec_MP "Torque at clutch level on lead path after stability decrease intervention coordination" SWORD Trq 1 100 -3276.800 3276.700 FORMAT "%8.3" ECU_ADDRESS 0x7000A0FE /end MEASUREMENT
/begin MEASUREMENT PtCoornDyn_tqCluLeadStabyIntvInc_MP "Torque at clutch level on lead path after stability increase intervention coordination" SWORD Trq 1 100 -3276.800 3276.700 FORMAT "%8.3" ECU_ADDRESS 0x7000A0FC /end MEASUREMENT
/begin MEASUREMENT PtCoornDyn_tqCluLeadTrsmIntv "Intervention torque required at clutch level on lead path after considering stability and transmission interventions" SWORD Trq 1 100 -3276.800 3276.700 FORMAT "%8.3" ECU_ADDRESS 0x60009808 /end MEASUREMENT
/begin MEASUREMENT PtCoornDyn_tqCluLeadTrsmIntvDecAftRamp_MP "Decrease Transmission intervention torque at clutch level on lead path after ramp" SWORD Trq 1 100 -3276.800 3276.700 FORMAT "%8.3" ECU_ADDRESS 0x7000A0FA /end MEASUREMENT
/begin MEASUREMENT PtCoornDyn_tqCluLeadTrsmIntvDec_MP "Decrease transmission intervention torque at clutch level on lead path after ramp coordination" SWORD Trq 1 100 -3276.800 3276.700 FORMAT "%8.3" ECU_ADDRESS 0x7000A0F8 /end MEASUREMENT
/begin MEASUREMENT PtCoornDyn_tqCluLeadTrsmIntvInc "Generic priority limitaion coordinated with transmission increasing intervention at lead path" SWORD Trq 1 100 -3276.800 3276.700 FORMAT "%8.3" ECU_ADDRESS 0x60009806 /end MEASUREMENT
/begin MEASUREMENT PtCoornDyn_tqCluLeadTrsmIntvInc_MP "Torque at clutch level on lead path after transmission increase intervention coordination" SWORD Trq 1 100 -3276.800 3276.700 FORMAT "%8.3" ECU_ADDRESS 0x7000A0F6 /end MEASUREMENT
/begin MEASUREMENT PtCoornDyn_tqCluLeadWoSpdGovr "clutch lead without speed governor" SWORD Trq 1 100 -3276.800 3276.700 FORMAT "%8.3" ECU_ADDRESS 0x600071DA /end MEASUREMENT
/begin MEASUREMENT PtCoornDyn_tqCluMax "max. total torque for increasing interventions on set path" SWORD Trq 1 100 -3276.800 3276.700 FORMAT "%8.3" ECU_ADDRESS 0x600071EC /end MEASUREMENT
/begin MEASUREMENT PtCoornDyn_tqCluMin "lower torque limit for decreasing stability and transmission interventions" SWORD Trq 1 100 -3276.800 3276.700 FORMAT "%8.3" ECU_ADDRESS 0x600071EA /end MEASUREMENT
/begin MEASUREMENT PtCoornDyn_tqCluStabyIntvDecLimDes "limited decreasing stability intervention torque including speed controller torque" SWORD Trq 1 100 -3276.800 3276.700 FORMAT "%8.3" ECU_ADDRESS 0x60009804 /end MEASUREMENT
/begin MEASUREMENT PtCoornDyn_tqCluStabyIntvInc "sum driver demand with increasing stability intervention" SWORD Trq 1 100 -3276.800 3276.700 FORMAT "%8.3" ECU_ADDRESS 0x600071E8 /end MEASUREMENT
/begin MEASUREMENT PtCoornDyn_tqCluStabyIntvIncLimDes "limited increasing stability intervention torque for des path" SWORD Trq 1 100 -3276.800 3276.700 FORMAT "%8.3" ECU_ADDRESS 0x60009802 /end MEASUREMENT
/begin MEASUREMENT PtCoornDyn_tqCluTrsmIntvDecLimDes "limited decreasing transmission intervention torque including speed controller torque" SWORD Trq 1 100 -3276.800 3276.700 FORMAT "%8.3" ECU_ADDRESS 0x60009800 /end MEASUREMENT
/begin MEASUREMENT PtCoornDyn_tqCluTrsmIntvDecLimDesWoIncStabyLimn "limited decreasing transmission intervention torque including speed controller torque without increasing stability limitation" SWORD Trq 1 100 -3276.800 3276.700 FORMAT "%8.3" ECU_ADDRESS 0x600097FE /end MEASUREMENT
/begin MEASUREMENT PtCoornDyn_tqCluTrsmIntvIncLimDes "limited increasing transmission intervention torque for des path" SWORD Trq 1 100 -3276.800 3276.700 FORMAT "%8.3" ECU_ADDRESS 0x600097FC /end MEASUREMENT
/begin MEASUREMENT PtCoornDyn_tqCrksftDecIntvMinLimn "minimum crankshaft torque limit for decreasing interventions" SWORD Trq 1 100 -3276.800 3276.700 FORMAT "%8.3" ECU_ADDRESS 0x600071E6 /end MEASUREMENT
/begin MEASUREMENT PtCoornDyn_tqCrksftLead "Coordinated propulsion torque with all interventions for lead path at crankshaft level" SWORD Trq 1 100 -3276.800 3276.700 FORMAT "%8.3" ECU_ADDRESS 0x600097FA /end MEASUREMENT
/begin MEASUREMENT PtCoornDyn_tqCrksftMin "minimum crankshaft torque of the system" SWORD Trq 1 100 -3276.800 3276.700 FORMAT "%8.3" ECU_ADDRESS 0x600071E4 /end MEASUREMENT
/begin MEASUREMENT PtCoornDyn_tqDmdFromSpdGovr "torque demand from speed governor." SWORD Trq 1 100 -3276.800 3276.700 FORMAT "%8.3" ECU_ADDRESS 0x600071E2 /end MEASUREMENT
/begin MEASUREMENT PtCoornDyn_tqDmdFromSpdGovrLead "torque demand from speed governor on lead path" SWORD Trq 1 100 -3276.800 3276.700 FORMAT "%8.3" ECU_ADDRESS 0x600071D8 /end MEASUREMENT
/begin MEASUREMENT PtCoornDyn_tqPreCalcCluDes "pre calculate clutch desired" SWORD Trq 1 100 -3276.800 3276.700 FORMAT "%8.3" ECU_ADDRESS 0x600071E0 /end MEASUREMENT
/begin MEASUREMENT PTDist_cntrReIni "ReIni counter" UBYTE OneToOne 1 100 0.00 255.0 FORMAT "%5.1" ECU_ADDRESS 0x6000B66C /end MEASUREMENT
/begin MEASUREMENT PTDist_flgIgnAgRelsDynEng "Status of powertrain demand for ignition angle release due to dynamic engine torque requirements, without external interventions" UBYTE B_TRUE 1 100 0.00 1.00000000000 BIT_MASK 0x1 FORMAT "%13.11" ECU_ADDRESS 0x6000F921 /end MEASUREMENT
/begin MEASUREMENT PTDist_flgIgnAgRelsNoRmp "Status of ignition angle release including external interventions for powertrain demand" UBYTE B_TRUE 1 100 0.00 1.00000000000 BIT_MASK 0x1 FORMAT "%13.11" ECU_ADDRESS 0x6000F920 /end MEASUREMENT
/begin MEASUREMENT PTDist_flgIgnAgRelsRmp "Status of Ignition angle release for powertrain demand" UBYTE B_TRUE 1 100 0.00 1.00000000000 BIT_MASK 0x1 FORMAT "%13.11" ECU_ADDRESS 0x6000F91F /end MEASUREMENT
/begin MEASUREMENT PTDist_flgLADIaRels "Flag that indicates that the Load Alteration Damper is active i.e. the Maximum torque for limitation by ASD reference filter is less than or equal to the Propulsion torque limited by stationanry limits" UBYTE B_TRUE 1 100 0.00 1.00000000000 BIT_MASK 0x1 FORMAT "%13.11" ECU_ADDRESS 0x6000B66B /end MEASUREMENT
/begin MEASUREMENT PTDist_flgTqICESetMax "Flag to indicate that ICE cannot provide maximum torque with current air charge during drive off with clutch pedal" UBYTE B_TRUE 1 100 0.00 1.00000000000 BIT_MASK 0x1 FORMAT "%13.11" ECU_ADDRESS 0x6000F91E /end MEASUREMENT
/begin MEASUREMENT PTDist_tqCluSetStabyIntv "torque request on set path for combustion engine with stability interventions" SWORD Trq 1 100 -3276.800 3276.700 FORMAT "%8.3" ECU_ADDRESS 0x60009866 /end MEASUREMENT
/begin MEASUREMENT PTDist_tqCluSetWoIntv "torque request on set path without interventions" SWORD Trq 1 100 -3276.800 3276.700 FORMAT "%8.3" ECU_ADDRESS 0x60009864 /end MEASUREMENT
/begin MEASUREMENT PTDist_tqCrksftSet "Filtered and limited propulsion torque with all interventions for set path on crankshaft level" SWORD Trq 1 100 -3276.800 3276.700 FORMAT "%8.3" ECU_ADDRESS 0x60009862 /end MEASUREMENT
/begin MEASUREMENT PTDist_tqHiThdLeadFilActv "Upper calibratable torque threshold beyond which if input torque goes, ignition angle release due to dynamic torque requirements and ignition angle release with ramping is set , when the Demand for torque filtering in lead path is active." SWORD md_q0p1 1 100 -3276.800 3276.700 FORMAT "%8.3" ECU_ADDRESS 0x600071D6 /end MEASUREMENT
/begin MEASUREMENT PTDist_tqIntvMin "minimum intervention torque" SWORD Trq 1 100 -3276.800 3276.700 FORMAT "%8.3" ECU_ADDRESS 0x600071D4 /end MEASUREMENT
/begin MEASUREMENT PTDist_tqLoThdLeadFilActv "Lower calibratable torque threshold below which if input torque goes , the ignition angle release due to dynamic torque requirements and ignition angle release with ramping is reset, when the Demand for torque filtering in lead path is active." SWORD md_q0p1 1 100 -3276.800 3276.700 FORMAT "%8.3" ECU_ADDRESS 0x600071D2 /end MEASUREMENT
/begin MEASUREMENT PthLead_bMonLim "Status active monitoring limitation level 1 for lead path" UBYTE B_TRUE 1 100 0.00 1.00000000000 BIT_MASK 0x1 FORMAT "%13.11" ECU_ADDRESS 0x6000B66A /end MEASUREMENT
/begin MEASUREMENT PthLead_stActvMonLim "State of monitoring limitation" UBYTE OneToOne 1 100 0.00 255.0 FORMAT "%5.1" ECU_ADDRESS 0x6000FBAF /end MEASUREMENT
/begin MEASUREMENT PthLead_stTrqResvActv "Condition: torque reserve active" UBYTE B_TRUE 1 100 0.00 1.00000000000 BIT_MASK 0x1 FORMAT "%13.11" ECU_ADDRESS 0x6000F90B /end MEASUREMENT
/begin MEASUREMENT PthLead_trqCHRef "Reference torque for the calculation of catalyser heating torque reserve" SWORD Trq 1 100 0.00 3276.700 FORMAT "%8.3" ECU_ADDRESS 0x600071D0 /end MEASUREMENT
/begin MEASUREMENT PthLead_trqDes "Torque request for the calculation of torque reserves" SWORD Trq 1 100 0.00 3276.700 FORMAT "%8.3" ECU_ADDRESS 0x600071CE /end MEASUREMENT
/begin MEASUREMENT PthLead_trqDesRef "Reference ignition torque lead path including lead part of idle-speed (pullaway) controller" SWORD Trq 1 100 0.00 3276.700 FORMAT "%8.3" ECU_ADDRESS 0x600071CC /end MEASUREMENT
/begin MEASUREMENT PthLead_trqInrLead "Inner torque lead value" SWORD Trq 1 100 0.00 3276.700 FORMAT "%8.3" ECU_ADDRESS 0x600097F8 /end MEASUREMENT
/begin MEASUREMENT PthLead_trqInrNoMon "Lead torque before monitoring level 1" SWORD Trq 1 100 0.00 3276.700 FORMAT "%8.3" ECU_ADDRESS 0x60014934 /end MEASUREMENT
/begin MEASUREMENT PthLead_trqResv "Requested torque reserve" SWORD Trq 1 100 0.00 3276.700 FORMAT "%8.3" ECU_ADDRESS 0x60014936 /end MEASUREMENT
/begin MEASUREMENT PthLead_trqResvEta "Torque reserve due to efficiency requests" SWORD Trq 1 100 0.00 3276.700 FORMAT "%8.3" ECU_ADDRESS 0x60013D96 /end MEASUREMENT
/begin MEASUREMENT PthLead_trqResvRel "Maximum relative torque reserves" SWORD Trq 1 100 0.00 3276.700 FORMAT "%8.3" ECU_ADDRESS 0x60014938 /end MEASUREMENT
/begin MEASUREMENT PthLead_trqResvRelA "relative torque reserve type A realized on engine" SWORD Trq 1 100 0.00 3276.700 FORMAT "%8.3" ECU_ADDRESS 0x600097F6 /end MEASUREMENT
/begin MEASUREMENT PthLead_trqResvRelB "relative torque reserve type B" SWORD Trq 1 100 0.00 3276.700 FORMAT "%8.3" ECU_ADDRESS 0x600097F4 /end MEASUREMENT
/begin MEASUREMENT PThrVlvUs_facNom "normalization factor pressure upstream throttle valve" UWORD fak_uw_b8 1 100 0.00 7.999878 FORMAT "%8.6" ECU_ADDRESS 0x5000086A /end MEASUREMENT
/begin MEASUREMENT PThrVlvUs_facNomB1 "normalization factor pressure upstream throttle valve bank1" UWORD fak_uw_b8 1 100 0.00 7.999878 FORMAT "%8.6" ECU_ADDRESS 0x700037FE /end MEASUREMENT
/begin MEASUREMENT PThrVlvUs_facNrmPEnv "Ratio: boost pressure upstream throttle valve to ambient pressure" UWORD fak_q0p000122 1 100 0.00 7.999878 FORMAT "%8.6" ECU_ADDRESS 0x5000086C /end MEASUREMENT
/begin MEASUREMENT PThrVlvUs_flgPVld "Pressure value valid status" UBYTE B_TRUE 1 100 0.00 1.00000000000 BIT_MASK 0x1 FORMAT "%13.11" ECU_ADDRESS 0x700007A6 /end MEASUREMENT
/begin MEASUREMENT PThrVlvUs_flgPVldB1 "Pressure value valid status bank1" UBYTE B_TRUE 1 100 0.00 1.00000000000 BIT_MASK 0x1 FORMAT "%13.11" ECU_ADDRESS 0x700007A5 /end MEASUREMENT
/begin MEASUREMENT PThrVlvUs_p "pressure upstream throttle valve, averaged value" UWORD p_q0p078 1 100 0.00 5119.922 FORMAT "%8.3" ECU_ADDRESS 0x5000086E /end MEASUREMENT
/begin MEASUREMENT PThrVlvUs_pB1 "pressure upstream throttle valve bank1" UWORD p_q0p078 1 100 0.00 5119.922 FORMAT "%8.3" ECU_ADDRESS 0x50000870 /end MEASUREMENT
/begin MEASUREMENT PThrVlvUs_pMax "maximum pressure upstream throttle valve, averaged value" UWORD p_q0p078 1 100 0.00 5119.922 FORMAT "%8.3" ECU_ADDRESS 0x50000872 /end MEASUREMENT
/begin MEASUREMENT PThrVlvUs_pMaxB1 "maximum pressure upstream throttle valve bank1" UWORD p_q0p078 1 100 0.00 5119.922 FORMAT "%8.3" ECU_ADDRESS 0x700037FC /end MEASUREMENT
/begin MEASUREMENT PThrVlvUs_pMin "minimum pressure upstream throttle valve, averaged value" UWORD p_q0p078 1 100 0.00 5119.922 FORMAT "%8.3" ECU_ADDRESS 0x700037FA /end MEASUREMENT
/begin MEASUREMENT PThrVlvUs_pMinB1 "minimum pressure upstream throttle valve bank1" UWORD p_q0p078 1 100 0.00 5119.922 FORMAT "%8.3" ECU_ADDRESS 0x700037F8 /end MEASUREMENT
/begin MEASUREMENT PthSet_bCylIndivFCOAft "Condition cylinder individual fuel cut-off at restart after overrun fuel cut-off" UBYTE B_TRUE 1 100 0.00 1.00000000000 BIT_MASK 0x1 FORMAT "%13.11" ECU_ADDRESS 0x6000F90A /end MEASUREMENT
/begin MEASUREMENT PthSet_bCylIndivFCOBef "Condition cylinder individual fuel cut-off at transition into overrun fuel cut-off" UBYTE B_TRUE 1 100 0.00 1.00000000000 BIT_MASK 0x1 FORMAT "%13.11" ECU_ADDRESS 0x6000F909 /end MEASUREMENT
/begin MEASUREMENT PthSet_bEnaCylIndivFCO "Enable cylinder individual fuel cut-off" UBYTE B_TRUE 1 100 0.00 1.00000000000 BIT_MASK 0x1 FORMAT "%13.11" ECU_ADDRESS 0x6000B669 /end MEASUREMENT
/begin MEASUREMENT PthSet_bEnaFCO "Torque threshold for cylinder individual fuel cut-off reached" UBYTE B_TRUE 1 100 0.00 1.00000000000 BIT_MASK 0x1 FORMAT "%13.11" ECU_ADDRESS 0x6000F908 /end MEASUREMENT
/begin MEASUREMENT PthSet_bEnaIndivRes "Enable cylinderindividual resume after overrun" UBYTE B_TRUE 1 100 0.00 1.00000000000 BIT_MASK 0x1 FORMAT "%13.11" ECU_ADDRESS 0x600100FF /end MEASUREMENT
/begin MEASUREMENT PthSet_bIAIntv "condition: ignition angle intervention of torque structure" UBYTE B_TRUE 1 100 0.00 1.00000000000 BIT_MASK 0x1 FORMAT "%13.11" ECU_ADDRESS 0x500060B4 /end MEASUREMENT
/begin MEASUREMENT PthSet_bIARlsMon "Ignition angle release due to monitoring level 1" UBYTE B_TRUE 1 100 0.00 1.00000000000 BIT_MASK 0x1 FORMAT "%13.11" ECU_ADDRESS 0x6000B663 /end MEASUREMENT
/begin MEASUREMENT PthSet_bIARlsNoIntv "Ignition angle release not because of intervention" UBYTE B_TRUE 1 100 0.00 1.00000000000 BIT_MASK 0x1 FORMAT "%13.11" ECU_ADDRESS 0x700007A4 /end MEASUREMENT
/begin MEASUREMENT PthSet_bIARlsNoTraIntv "IA-release excluding gear intervention" UBYTE B_TRUE 1 100 0.00 1.00000000000 BIT_MASK 0x1 FORMAT "%13.11" ECU_ADDRESS 0x700007A3 /end MEASUREMENT
/begin MEASUREMENT PthSet_bIARlsWiMon "Ignition angle release including monitoring level 1" UBYTE B_TRUE 1 100 0.00 1.00000000000 BIT_MASK 0x1 FORMAT "%13.11" ECU_ADDRESS 0x6000B662 /end MEASUREMENT
/begin MEASUREMENT PthSet_bIARlsWoDstC "Ignition angle release without disturbance control" UBYTE B_TRUE 1 100 0.00 1.00000000000 BIT_MASK 0x1 FORMAT "%13.11" ECU_ADDRESS 0x500060B5 /end MEASUREMENT
/begin MEASUREMENT PthSet_bMonLimFCO "Monitoring level 1 active on cutoff path" UBYTE B_TRUE 1 100 0.00 1.00000000000 BIT_MASK 0x1 FORMAT "%13.11" ECU_ADDRESS 0x6000B661 /end MEASUREMENT
/begin MEASUREMENT PthSet_bMonLimIA "Monitoring level 1 active on ignition path" UBYTE B_TRUE 1 100 0.00 1.00000000000 BIT_MASK 0x1 FORMAT "%13.11" ECU_ADDRESS 0x6000B660 /end MEASUREMENT
/begin MEASUREMENT PthSet_bOvrRun "Condition: overrun fuel cut-off" UBYTE B_TRUE 1 100 0.00 1.00000000000 BIT_MASK 0x1 FORMAT "%13.11" ECU_ADDRESS 0x500060B7 /end MEASUREMENT
/begin MEASUREMENT PthSet_bOvrRunCdnPrsnt "Local variable to store Over Run condition" UBYTE B_TRUE 1 100 0.00 1.00000000000 BIT_MASK 0x1 FORMAT "%13.11" ECU_ADDRESS 0x6000B668 /end MEASUREMENT
/begin MEASUREMENT PthSet_bPhCO "Phase ""overrun fuel cutoff"" active" UBYTE B_TRUE 1 100 0.00 1.00000000000 BIT_MASK 0x1 FORMAT "%13.11" ECU_ADDRESS 0x6000B667 /end MEASUREMENT
/begin MEASUREMENT PthSet_bUpShiftDly "Local variable to store Gear Up shift fuel cut off delay" UBYTE B_TRUE 1 100 0.00 1.00000000000 BIT_MASK 0x1 FORMAT "%13.11" ECU_ADDRESS 0x6000B666 /end MEASUREMENT
/begin MEASUREMENT PthSet_dtqRmpIgnAgRls "Derivative torque from ignition angle release ramp" SLONG RmpTrq 1 100 -3276800.00000 3276799.99847 FORMAT "%13.5" ECU_ADDRESS 0x50004FF4 /end MEASUREMENT
/begin MEASUREMENT PthSet_flgIgnAgRlsRmpActvn "Flag for ignition angle release ramp active" UBYTE B_TRUE 1 100 0.00 1.00000000000 BIT_MASK 0x1 FORMAT "%13.11" ECU_ADDRESS 0x500060B9 /end MEASUREMENT
/begin MEASUREMENT PthSet_stActvMonLim "State of monitoring limitation" UBYTE OneToOne 1 100 0.00 255.0 FORMAT "%5.1" ECU_ADDRESS 0x60014AC8 /end MEASUREMENT
/begin MEASUREMENT PthSet_stCylIndivCtOff "Condition: cylinder individual cut-off" UBYTE B_TRUE 1 100 0.00 1.00000000000 BIT_MASK 0x1 FORMAT "%13.11" ECU_ADDRESS 0x500060BB /end MEASUREMENT
/begin MEASUREMENT PthSet_stFcoDlyTmrtmp "used for functioning of fuel cut-off delay timer during gear shifts" UBYTE B_TRUE 1 100 0.00 1.00000000000 BIT_MASK 0x1 FORMAT "%13.11" ECU_ADDRESS 0x6000B665 /end MEASUREMENT
/begin MEASUREMENT PthSet_stIARls "condition: ignition angle release" UBYTE B_TRUE 1 100 0.00 1.00000000000 BIT_MASK 0x1 FORMAT "%13.11" ECU_ADDRESS 0x70003605 /end MEASUREMENT
/begin MEASUREMENT PthSet_stIgnAgRls "Status of Ignition angle release" UWORD OneToOne 1 100 0.00 65535.00 FORMAT "%8.2" ECU_ADDRESS 0x600093DE /end MEASUREMENT
/begin MEASUREMENT PthSet_stOvrRun "Condition: overrun fuel cut-off" UBYTE B_TRUE 1 100 0.00 1.00000000000 BIT_MASK 0x1 FORMAT "%13.11" ECU_ADDRESS 0x500060BC /end MEASUREMENT
/begin MEASUREMENT PthSet_stOvrRunEna "Condition: overrun fuel cut-off possible due to torque demand as well as other demands" UBYTE B_TRUE 1 100 0.00 1.00000000000 BIT_MASK 0x1 FORMAT "%13.11" ECU_ADDRESS 0x600100FE /end MEASUREMENT
/begin MEASUREMENT PthSet_stOvrRunPhActv "Condition: phase A or phase B active at overrun fuel cut-off" UBYTE B_TRUE 1 100 0.00 1.00000000000 BIT_MASK 0x1 FORMAT "%13.11" ECU_ADDRESS 0x600100FD /end MEASUREMENT
/begin MEASUREMENT PthSet_stRampActv "Status to indicates ramp activation" UBYTE B_TRUE 1 100 0.00 1.00000000000 BIT_MASK 0x1 FORMAT "%13.11" ECU_ADDRESS 0x70001F87 /end MEASUREMENT
/begin MEASUREMENT PthSet_stRampPosn "Status to indicate Ramp position" UBYTE B_TRUE 1 100 0.00 1.00000000000 BIT_MASK 0x1 FORMAT "%13.11" ECU_ADDRESS 0x70001F86 /end MEASUREMENT
/begin MEASUREMENT PthSet_stToffDlytmp "delayed gear upshift status introduced by fuel cut-off delay timer during gear shifts" UBYTE B_TRUE 1 100 0.00 1.00000000000 BIT_MASK 0x1 FORMAT "%13.11" ECU_ADDRESS 0x6000B664 /end MEASUREMENT
/begin MEASUREMENT PthSet_stTrgFCO "Status word to trigger the cylinder individual cut-off" UBYTE OneToOne 1 100 0.00 255.0 FORMAT "%5.1" ECU_ADDRESS 0x60014AC9 /end MEASUREMENT
/begin MEASUREMENT PthSet_tqIARIsRamp "Desire Torque on ignition angle release ramp" SWORD Trq 1 100 0.00 3276.700 FORMAT "%8.3" ECU_ADDRESS 0x70001F84 /end MEASUREMENT
/begin MEASUREMENT PthSet_tqInnrLimdRamp "Ramping factor for Desired torque for set path limited on basic limits" SWORD Trq 1 100 0.00 3276.700 FORMAT "%8.3" ECU_ADDRESS 0x70001F82 /end MEASUREMENT
/begin MEASUREMENT PthSet_trqInrBsExl "Basic torque reduced by exclusive torque range" SWORD Trq 1 100 0.00 3276.700 FORMAT "%8.3" ECU_ADDRESS 0x500057C6 /end MEASUREMENT
/begin MEASUREMENT PthSet_trqInrBsMinFCO_mp "Modified indicated basic torque, lower limit, for release of fuel cutoff" SWORD Trq 1 100 0.00 3276.700 FORMAT "%8.3" ECU_ADDRESS 0x7000A0F4 /end MEASUREMENT
/begin MEASUREMENT PthSet_trqInrCtOff "set torque for cut-off path" SWORD Trq 1 100 0.00 3276.700 FORMAT "%8.3" ECU_ADDRESS 0x6001493A /end MEASUREMENT
/begin MEASUREMENT PthSet_trqInrDes "Coordinated torque request before torque range limitation" SWORD Trq 1 100 0.00 3276.700 FORMAT "%8.3" ECU_ADDRESS 0x700053C0 /end MEASUREMENT
/begin MEASUREMENT PthSet_trqInrDes_mp "Coordinated torque request before torque range limitation in syncronous path" UWORD md_q0p1 1 100 0.00 6553.500 FORMAT "%8.3" ECU_ADDRESS 0x7000A0F2 /end MEASUREMENT
/begin MEASUREMENT PthSet_trqInrIA "Resulting set torque for ignition angle path" SWORD Trq 1 100 0.00 3276.700 FORMAT "%8.3" ECU_ADDRESS 0x6001493E /end MEASUREMENT
/begin MEASUREMENT PthSet_trqInrIABef "Resulting set torque for ignition angle path before monitoring level 1" SWORD Trq 1 100 0.00 3276.700 FORMAT "%8.3" ECU_ADDRESS 0x50005E30 /end MEASUREMENT
/begin MEASUREMENT PthSet_trqInrLim "Limited torque request for set path" SWORD Trq 1 100 0.00 3276.700 FORMAT "%8.3" ECU_ADDRESS 0x600097F2 /end MEASUREMENT
/begin MEASUREMENT PthSet_trqInrLtd "Desired torque for set path limited on basic limits" SWORD Trq 1 100 0.00 3276.700 FORMAT "%8.3" ECU_ADDRESS 0x50005E34 /end MEASUREMENT
/begin MEASUREMENT PthSet_trqInrLtdIA "Desired torque for ignition path limited on basic limits" SWORD Trq 1 100 0.00 3276.700 FORMAT "%8.3" ECU_ADDRESS 0x500057C8 /end MEASUREMENT
/begin MEASUREMENT PthSet_trqInrLtdWoDstC_mp "Inner set path torque limited on basic limits without anti-jerk intervention" SWORD md_q0p1 1 100 0.00 3276.700 FORMAT "%8.3" ECU_ADDRESS 0x7000A0F0 /end MEASUREMENT
/begin MEASUREMENT PthSet_trqInrWoDstC "Set torque without disturbance control intervention" SWORD Trq 1 100 0.00 3276.700 FORMAT "%8.3" ECU_ADDRESS 0x60014940 /end MEASUREMENT
/begin MEASUREMENT PthSet_trqInrWoDstCBef "Set torque without disturbance control intervention before monitoring level 1" SWORD Trq 1 100 0.00 3276.700 FORMAT "%8.3" ECU_ADDRESS 0x500057CA /end MEASUREMENT
/begin MEASUREMENT PthSet_trqRmpIALck "Delta torque for ramp after withdrawal of ignition angle release" SWORD Trq 1 100 0.00 3276.700 FORMAT "%8.3" ECU_ADDRESS 0x60014942 /end MEASUREMENT
/begin MEASUREMENT PT_bAutoStrtRls "Enable bit for autostart from the point of view of the grip of the powertrain." UBYTE B_TRUE 1 100 0.00 1.00000000000 BIT_MASK 0x1 FORMAT "%13.11" ECU_ADDRESS 0x6000F91D /end MEASUREMENT
/begin MEASUREMENT PT_bClthSlip "The automated clutch is in a slip state / controlled operation and PT_bNoGrip = FALSE." UBYTE B_TRUE 1 100 0.00 1.00000000000 BIT_MASK 0x1 FORMAT "%13.11" ECU_ADDRESS 0x6000F91C /end MEASUREMENT
/begin MEASUREMENT PT_bClthSlipOpn "The automated clutch is in drive-off state and PT_bNoGrip = FALSE." UBYTE B_TRUE 1 100 0.00 1.00000000000 BIT_MASK 0x1 FORMAT "%13.11" ECU_ADDRESS 0x6000F91B /end MEASUREMENT
/begin MEASUREMENT PT_bConvSlip "The converter lockup clutch is controlled or is in controlled slip operation and PT_bNoGrip = FALSE." UBYTE B_TRUE 1 100 0.00 1.00000000000 BIT_MASK 0x1 FORMAT "%13.11" ECU_ADDRESS 0x6000F91A /end MEASUREMENT
/begin MEASUREMENT PT_bConvSlipClsd "The converter lockup clutch is almost closed, little slip, and PT_bNoGrip = FALSE." UBYTE B_TRUE 1 100 0.00 1.00000000000 BIT_MASK 0x1 FORMAT "%13.11" ECU_ADDRESS 0x6000F919 /end MEASUREMENT
/begin MEASUREMENT PT_bConvSlipOpn "The converter lockup clutch is open (converter in slip) and PT_bNoGrip = FALSE." UBYTE B_TRUE 1 100 0.00 1.00000000000 BIT_MASK 0x1 FORMAT "%13.11" ECU_ADDRESS 0x6000F918 /end MEASUREMENT
/begin MEASUREMENT PT_bDrvDmdActvWoIntv "Status of driver demand based on interventions active" UBYTE B_TRUE 1 100 0.00 1.00000000000 BIT_MASK 0x1 FORMAT "%13.11" ECU_ADDRESS 0x70000119 /end MEASUREMENT
/begin MEASUREMENT PT_bDrvDmdActvWoTrsmIntv "Status of driver demand based on transmission interventions active" UBYTE B_TRUE 1 100 0.00 1.00000000000 BIT_MASK 0x1 FORMAT "%13.11" ECU_ADDRESS 0x70000118 /end MEASUREMENT
/begin MEASUREMENT PT_bEngStopEna "Engine stop request of transmission" UBYTE B_TRUE 1 100 0.00 1.00000000000 BIT_MASK 0x1 FORMAT "%13.11" ECU_ADDRESS 0x700007AA /end MEASUREMENT
/begin MEASUREMENT PT_bEngStopReq "Stop request from Drive train" UBYTE B_TRUE 1 100 0.00 1.00000000000 BIT_MASK 0x1 FORMAT "%13.11" ECU_ADDRESS 0x700007A9 /end MEASUREMENT
/begin MEASUREMENT PT_bEngStrtEna "PT enables engine start" UBYTE B_TRUE 1 100 0.00 1.00000000000 BIT_MASK 0x1 FORMAT "%13.11" ECU_ADDRESS 0x700007A8 /end MEASUREMENT
/begin MEASUREMENT PT_bEngStrtReq "Engine start request of transmission" UBYTE B_TRUE 1 100 0.00 1.00000000000 BIT_MASK 0x1 FORMAT "%13.11" ECU_ADDRESS 0x700007A7 /end MEASUREMENT
/begin MEASUREMENT PT_bGrip "grip is for sure present (the converter lockup clutch / the automated or manual clutch is completely closed and PT_bNoGrip = FALSE)." UBYTE B_TRUE 1 100 0.00 1.00000000000 BIT_MASK 0x1 FORMAT "%13.11" ECU_ADDRESS 0x6000F917 /end MEASUREMENT
/begin MEASUREMENT PT_bIdleOvrSht "Condition judgement rpm overshoot after idling" UBYTE B_TRUE 1 100 0.00 1.00000000000 BIT_MASK 0x1 FORMAT "%13.11" ECU_ADDRESS 0x6000B652 /end MEASUREMENT
/begin MEASUREMENT PT_bNoGrip "Grip is definitely ruled out" UBYTE B_TRUE 1 100 0.00 1.00000000000 BIT_MASK 0x1 FORMAT "%13.11" ECU_ADDRESS 0x6000F916 /end MEASUREMENT
/begin MEASUREMENT PT_bOvrRunInactvIntvDes "Overrun inactive status based on interventions active" UBYTE B_TRUE 1 100 0.00 1.00000000000 BIT_MASK 0x1 FORMAT "%13.11" ECU_ADDRESS 0x70000117 /end MEASUREMENT
/begin MEASUREMENT PT_bOvrRunInactvTrsmIntvDes "Overrun inactive status based on transmission interventions active" UBYTE B_TRUE 1 100 0.00 1.00000000000 BIT_MASK 0x1 FORMAT "%13.11" ECU_ADDRESS 0x70000116 /end MEASUREMENT
/begin MEASUREMENT PT_bOvrRunInactvWoIntv "Overrun inactive status for without intervention parallel path" UBYTE B_TRUE 1 100 0.00 1.00000000000 BIT_MASK 0x1 FORMAT "%13.11" ECU_ADDRESS 0x70000115 /end MEASUREMENT
/begin MEASUREMENT PT_bOvrRunInactvWoTrsmIntv "Overrun inactive status for without transmission intervention parallel path" UBYTE B_TRUE 1 100 0.00 1.00000000000 BIT_MASK 0x1 FORMAT "%13.11" ECU_ADDRESS 0x70000114 /end MEASUREMENT
/begin MEASUREMENT PT_bSetOverrunStabyIntvIncActv "Overrun inactive status based on increasing Satbility intervention" UBYTE B_TRUE 1 100 0.00 1.00000000000 BIT_MASK 0x1 FORMAT "%13.11" ECU_ADDRESS 0x70000113 /end MEASUREMENT
/begin MEASUREMENT PT_bSetOvrRunTrsmIntvIncActv "Overrun inactive status based on increasing transmission intervention" UBYTE B_TRUE 1 100 0.00 1.00000000000 BIT_MASK 0x1 FORMAT "%13.11" ECU_ADDRESS 0x70000112 /end MEASUREMENT
/begin MEASUREMENT PT_dnClth "Engine speed gradient at clutch level" SWORD EngNGrd 1 100 -16384.00 16383.50 FORMAT "%8.2" ECU_ADDRESS 0x60009860 /end MEASUREMENT
/begin MEASUREMENT PT_dtqNegSlopSetWoIntv "Delta torque for negative slope for IARls_WoIntv" ULONG RmpTrq 1 100 0.00 6553599.99847 FORMAT "%13.5" ECU_ADDRESS 0x600026AC /end MEASUREMENT
/begin MEASUREMENT PT_dtqNegSlopWoTrsmIntv "Delta torque for negative slope for IARls_WoTrsmIntv" ULONG RmpTrq 1 100 0.00 6553599.99847 FORMAT "%13.5" ECU_ADDRESS 0x600026A8 /end MEASUREMENT
/begin MEASUREMENT PT_facRedStgEff "Redudant stage effective factor" UWORD fak_uw_b2 1 100 0.00 1.999969 FORMAT "%8.6" ECU_ADDRESS 0x600071CA /end MEASUREMENT
/begin MEASUREMENT PT_facSprkEff "Sparkling effective factor" UWORD fak_uw_b2 1 100 0.00 1.999969 FORMAT "%8.6" ECU_ADDRESS 0x600071C8 /end MEASUREMENT
/begin MEASUREMENT Pt_flgAcOff "Air compressor turn off request flag" UBYTE B_TRUE 1 100 0.00 1.00000000000 BIT_MASK 0x1 FORMAT "%13.11" ECU_ADDRESS 0x6000B65F /end MEASUREMENT
/begin MEASUREMENT PT_flgAcOn "Air compressor turn on request flag" UBYTE B_TRUE 1 100 0.00 1.00000000000 BIT_MASK 0x1 FORMAT "%13.11" ECU_ADDRESS 0x6000B65E /end MEASUREMENT
/begin MEASUREMENT PT_flgAcOnOffSigPls "Air compressor turn on off pulse flag" UBYTE B_TRUE 1 100 0.00 1.00000000000 BIT_MASK 0x1 FORMAT "%13.11" ECU_ADDRESS 0x6000B65D /end MEASUREMENT
/begin MEASUREMENT PT_flgDrvDmdActv "Status driver demand is active" UBYTE B_TRUE 1 100 0.00 1.00000000000 BIT_MASK 0x1 FORMAT "%13.11" ECU_ADDRESS 0x70000111 /end MEASUREMENT
/begin MEASUREMENT PT_flgDrvrDmdHLR_I "Hysterisis for Driver demand" UBYTE B_TRUE 1 100 0.00 1.00000000000 BIT_MASK 0x1 FORMAT "%13.11" ECU_ADDRESS 0x70000110 /end MEASUREMENT
/begin MEASUREMENT PT_flgEngActv "Engine active indicator flag" UBYTE B_TRUE 1 100 0.00 1.00000000000 BIT_MASK 0x1 FORMAT "%13.11" ECU_ADDRESS 0x70001F80 /end MEASUREMENT
/begin MEASUREMENT PT_flgEngLimActvDes "Target engine limitation active flag" UBYTE B_TRUE 1 100 0.00 1.00000000000 BIT_MASK 0x1 FORMAT "%13.11" ECU_ADDRESS 0x6000B65C /end MEASUREMENT
/begin MEASUREMENT PT_flgEngLimDesCdn "Target engine limitation active conditions" UBYTE B_TRUE 1 100 0.00 1.00000000000 BIT_MASK 0x1 FORMAT "%13.11" ECU_ADDRESS 0x6000B65B /end MEASUREMENT
/begin MEASUREMENT Pt_flgFcoInhb "Powertrain inhibits fuel cut-off." UBYTE B_TRUE 1 100 0.00 1.00000000000 BIT_MASK 0x1 FORMAT "%13.11" ECU_ADDRESS 0x6000F90C /end MEASUREMENT
/begin MEASUREMENT PT_flgGripInfo "Grip Information flag" UBYTE B_TRUE 1 100 0.00 1.00000000000 BIT_MASK 0x1 FORMAT "%13.11" ECU_ADDRESS 0x6000B651 /end MEASUREMENT
/begin MEASUREMENT PT_flgHiVTLarge "Larger VT torque flag" UBYTE B_TRUE 1 100 0.00 1.00000000000 BIT_MASK 0x1 FORMAT "%13.11" ECU_ADDRESS 0x6000B65A /end MEASUREMENT
/begin MEASUREMENT PT_flgHiVTLargeSync "Larger VT torque sync flag" UBYTE B_TRUE 1 100 0.00 1.00000000000 BIT_MASK 0x1 FORMAT "%13.11" ECU_ADDRESS 0x6000B659 /end MEASUREMENT
/begin MEASUREMENT PT_flgRateLimitActv "Flag indicating rate limiter is actived" UBYTE B_TRUE 1 100 0.00 1.00000000000 BIT_MASK 0x1 FORMAT "%13.11" ECU_ADDRESS 0x70001F7F /end MEASUREMENT
/begin MEASUREMENT PT_flgRateLimitActvSync "Sync flag indicating rate limiter is actived" UBYTE B_TRUE 1 100 0.00 1.00000000000 BIT_MASK 0x1 FORMAT "%13.11" ECU_ADDRESS 0x70001F7E /end MEASUREMENT
/begin MEASUREMENT PT_flgRateLimitArea "Flag indicating rate limiter in active area" UBYTE B_TRUE 1 100 0.00 1.00000000000 BIT_MASK 0x1 FORMAT "%13.11" ECU_ADDRESS 0x6000B658 /end MEASUREMENT
/begin MEASUREMENT PT_flgRateLimitAreaSync "Sync flag indicating rate limiter in active area" UBYTE B_TRUE 1 100 0.00 1.00000000000 BIT_MASK 0x1 FORMAT "%13.11" ECU_ADDRESS 0x6000B657 /end MEASUREMENT
/begin MEASUREMENT PT_flgRateLimitTrqDiff "Rate limiter torque deviation flag" UBYTE B_TRUE 1 100 0.00 1.00000000000 BIT_MASK 0x1 FORMAT "%13.11" ECU_ADDRESS 0x70001F7D /end MEASUREMENT
/begin MEASUREMENT PT_flgRateLimitTrqDiffSync "Rate limiter torque deviation sync flag" UBYTE B_TRUE 1 100 0.00 1.00000000000 BIT_MASK 0x1 FORMAT "%13.11" ECU_ADDRESS 0x70001F7C /end MEASUREMENT
/begin MEASUREMENT PT_flgTqVTLoHiOld "Previous larger VT torque flag" UBYTE B_TRUE 1 100 0.00 1.00000000000 BIT_MASK 0x1 FORMAT "%13.11" ECU_ADDRESS 0x70001F7B /end MEASUREMENT
/begin MEASUREMENT PT_flgTqVTLoHiOldSync "Previous larger VT torque sync flag" UBYTE B_TRUE 1 100 0.00 1.00000000000 BIT_MASK 0x1 FORMAT "%13.11" ECU_ADDRESS 0x70001F7A /end MEASUREMENT
/begin MEASUREMENT PT_flgVTSwt "Hi VT and Lo VT swtiching flag" UBYTE B_TRUE 1 100 0.00 1.00000000000 BIT_MASK 0x1 FORMAT "%13.11" ECU_ADDRESS 0x70001F79 /end MEASUREMENT
/begin MEASUREMENT PT_flgVTSwtSync "Hi VT and Lo VT swtiching sync flag" UBYTE B_TRUE 1 100 0.00 1.00000000000 BIT_MASK 0x1 FORMAT "%13.11" ECU_ADDRESS 0x70001F78 /end MEASUREMENT
/begin MEASUREMENT PT_flgZeroCrs "VT torque crossing zero point flag" UBYTE B_TRUE 1 100 0.00 1.00000000000 BIT_MASK 0x1 FORMAT "%13.11" ECU_ADDRESS 0x70001F77 /end MEASUREMENT
/begin MEASUREMENT PT_flgZeroCrsSync "VT torque crossing zero point sync flag" UBYTE B_TRUE 1 100 0.00 1.00000000000 BIT_MASK 0x1 FORMAT "%13.11" ECU_ADDRESS 0x70001F76 /end MEASUREMENT
/begin MEASUREMENT PT_nBgnIdle "Engine rpm at beginning of idling" UWORD nmot_uw_q0p25 1 100 0.00 16383.75 FORMAT "%8.2" ECU_ADDRESS 0x600093EC /end MEASUREMENT
/begin MEASUREMENT PT_nClth "Speed at clutch input" SWORD EngN 1 100 -16384.00 16383.50 FORMAT "%8.2" ECU_ADDRESS 0x6000985E /end MEASUREMENT
/begin MEASUREMENT PT_nDifIdlSpd "Difference between current rpm and rpm at beginning of idling" UWORD nmot_uw_q0p25 1 100 0.00 16383.75 FORMAT "%8.2" ECU_ADDRESS 0x60007198 /end MEASUREMENT
/begin MEASUREMENT PT_rAirBasdOptTqDes "Target air based optimal torque ratio" UWORD rel_uw_b100 1 100 0.00 99.99847 FORMAT "%8.5" ECU_ADDRESS 0x600071C6 /end MEASUREMENT
/begin MEASUREMENT PT_rAirBasdOptTqDesSync "Sync target air based optimal torque ratio" UWORD rel_uw_b100 1 100 0.00 99.99847 FORMAT "%8.5" ECU_ADDRESS 0x600071C4 /end MEASUREMENT
/begin MEASUREMENT PT_rAirBasdOptTqReq "Request air based optimal torque ratio" UWORD rel_uw_b100 1 100 0.00 99.99847 FORMAT "%8.5" ECU_ADDRESS 0x600071C2 /end MEASUREMENT
/begin MEASUREMENT PT_rAirBasdOptTqReqSync "Sync request air based optimal torque ratio" UWORD rel_uw_b100 1 100 0.00 99.99847 FORMAT "%8.5" ECU_ADDRESS 0x600071C0 /end MEASUREMENT
/begin MEASUREMENT PT_rDifThrAgReq "Change in driver requisted throttle opening" SWORD rel_sw_b200 1 100 -200.0000 199.9939 FORMAT "%8.4" ECU_ADDRESS 0x60007196 /end MEASUREMENT
/begin MEASUREMENT PT_rEngTq "Engine esitmated torque ratio" UWORD rel_uw_b100 1 100 0.00 99.99847 FORMAT "%8.5" ECU_ADDRESS 0x600071BE /end MEASUREMENT
/begin MEASUREMENT PT_rGrip "Analogue value for the grip states." SWORD Fact100 1 100 -327.6800 327.6700 FORMAT "%8.4" ECU_ADDRESS 0x60014928 /end MEASUREMENT
/begin MEASUREMENT PT_rTrq "Powertrain torque ratio" SWORD TransR 1 100 -327.6800 327.6700 FORMAT "%8.4" ECU_ADDRESS 0x60009842 /end MEASUREMENT
/begin MEASUREMENT PT_rTrqTmp1_mp "Measuringpoint for intermediate result-value 1 for PT_rTrq" SWORD TransR 1 100 -327.6800 327.6700 FORMAT "%8.4" ECU_ADDRESS 0x7000A0EE /end MEASUREMENT
/begin MEASUREMENT PT_rTrqTmp2_mp "Measuringpoint for intermediate result-value 2 for PT_rTrq" SWORD TransR 1 100 -327.6800 327.6700 FORMAT "%8.4" ECU_ADDRESS 0x7000A0EC /end MEASUREMENT
/begin MEASUREMENT PT_rTrqWoConvRat "torque ratio of the power train without differential and converter torque ratio" SWORD TransR 1 100 -327.6800 327.6700 FORMAT "%8.4" ECU_ADDRESS 0x6001492C /end MEASUREMENT
/begin MEASUREMENT PT_stClth "Clutch signal output based on sensor information or rpm overshoot detection" UBYTE OneToOne 1 100 0.00 255.0 FORMAT "%5.1" ECU_ADDRESS 0x6000B650 /end MEASUREMENT
/begin MEASUREMENT PT_stClthDetd "Condition rpm overshoot after idling detected" UBYTE OneToOne 1 100 0.00 255.0 FORMAT "%5.1" ECU_ADDRESS 0x6000FBB5 /end MEASUREMENT
/begin MEASUREMENT PT_stTqDem "contains highest prior function with torque demand" UWORD OneToOne 1 100 0.00 65535.00 FORMAT "%8.2" ECU_ADDRESS 0x600093EA /end MEASUREMENT
/begin MEASUREMENT PT_tqAcsSync "Sync accessories torque" SWORD Trq 1 100 -3276.800 3276.700 FORMAT "%8.3" ECU_ADDRESS 0x60009840 /end MEASUREMENT
/begin MEASUREMENT PT_tqCluBsWoIntv "Basic torque at clutch level without interventions" SWORD Trq 1 100 -3276.800 3276.700 FORMAT "%8.3" ECU_ADDRESS 0x60007194 /end MEASUREMENT
/begin MEASUREMENT PT_tqCluBsWoTrsmIntv "Basic torque at clutch level without transmission interventions" SWORD Trq 1 100 -3276.800 3276.700 FORMAT "%8.3" ECU_ADDRESS 0x60007192 /end MEASUREMENT
/begin MEASUREMENT PT_tqCluDesCmp "Target compensation torque at clutch level" SWORD Trq 1 100 -3276.800 3276.700 FORMAT "%8.3" ECU_ADDRESS 0x600071BC /end MEASUREMENT
/begin MEASUREMENT PT_tqCluDesWoIntv "Target clutch torque without intervention" SWORD Trq 1 100 -3276.800 3276.700 FORMAT "%8.3" ECU_ADDRESS 0x600071BA /end MEASUREMENT
/begin MEASUREMENT PT_tqCluEngAllIntvExt "Driver demanded torque on engine (clutch level) with all interventions for parallel path" SWORD Trq 1 100 -3276.800 3276.700 FORMAT "%8.3" ECU_ADDRESS 0x6000983E /end MEASUREMENT
/begin MEASUREMENT PT_tqCluEngPtdSet "Limiting torque(clutch level) of setpoint path from the monitoring" SWORD md_q0p1 1 100 -3276.800 3276.700 FORMAT "%8.3" ECU_ADDRESS 0x60007190 /end MEASUREMENT
/begin MEASUREMENT PT_tqCluEngWoIntvExt "Driver demanded torque on engine (clutch level) without interventions for parallel path" SWORD Trq 1 100 -3276.800 3276.700 FORMAT "%8.3" ECU_ADDRESS 0x6000983C /end MEASUREMENT
/begin MEASUREMENT PT_tqCluEngWoTrsmIntvExt "Driver demanded torque on engine (clutch level) without transmission interventions for parallel path" SWORD Trq 1 100 -3276.800 3276.700 FORMAT "%8.3" ECU_ADDRESS 0x6000983A /end MEASUREMENT
/begin MEASUREMENT PT_tqCluMinEngWoFco "Minimum clutch torque without cutoff and without quasistationary torque of the electric motor" SWORD Trq 1 100 -3276.800 3276.700 FORMAT "%8.3" ECU_ADDRESS 0x60009838 /end MEASUREMENT
/begin MEASUREMENT PT_tqCluRmpIALckExt "Delta torque for ramp after withdrawal of ignition angle release at clutch level" SWORD Trq 1 100 -3276.800 3276.700 FORMAT "%8.3" ECU_ADDRESS 0x6000718E /end MEASUREMENT
/begin MEASUREMENT PT_tqCluSetWoIntvFcoLimd "Driver demanded torque after FCO limitation for without intervention parallel path" SWORD Trq 1 100 -3276.800 3276.700 FORMAT "%8.3" ECU_ADDRESS 0x6000718C /end MEASUREMENT
/begin MEASUREMENT PT_tqCluSetWoIntvHemLimd "Driver demanded torque after HEM limitation for without intervention parallel path" SWORD Trq 1 100 -3276.800 3276.700 FORMAT "%8.3" ECU_ADDRESS 0x6000718A /end MEASUREMENT
/begin MEASUREMENT PT_tqCluSetWoTrsmIntvFcoLimd "Driver demanded torque after FCO limitation for without transmission intervention parallel path" SWORD Trq 1 100 -3276.800 3276.700 FORMAT "%8.3" ECU_ADDRESS 0x60007188 /end MEASUREMENT
/begin MEASUREMENT PT_tqCluSetWoTrsmIntvHemLimd "Driver demanded torque after HEM limitation for without transmission intervention parallel path" SWORD Trq 1 100 -3276.800 3276.700 FORMAT "%8.3" ECU_ADDRESS 0x60007186 /end MEASUREMENT
/begin MEASUREMENT PT_tqCluTrsmWoIntv "Desired ramp output torque at cluth level without intervention" SLONG Trq 1 100 -214748364.800 214748364.700 FORMAT "%13.3" ECU_ADDRESS 0x600026A4 /end MEASUREMENT
/begin MEASUREMENT PT_tqCluTrsmWoTrsmIntv "Desired ramp output torque at cluth level without transmission intervention" SLONG Trq 1 100 -214748364.800 214748364.700 FORMAT "%13.3" ECU_ADDRESS 0x600026A0 /end MEASUREMENT
/begin MEASUREMENT PT_tqCluWoIntv "Desired torque at cluth level without intervention" SWORD Trq 1 100 -3276.800 3276.700 FORMAT "%8.3" ECU_ADDRESS 0x60007184 /end MEASUREMENT
/begin MEASUREMENT PT_tqCluWoTrsmIntv "Desired torque at cluth level without transmission intervention" SWORD Trq 1 100 -3276.800 3276.700 FORMAT "%8.3" ECU_ADDRESS 0x60007182 /end MEASUREMENT
/begin MEASUREMENT PT_tqCrksftDesOld "Previous target crankshaft torque" SWORD Trq 1 100 -3276.800 3276.700 FORMAT "%8.3" ECU_ADDRESS 0x600071B8 /end MEASUREMENT
/begin MEASUREMENT PT_tqCrksftDesOldSync "Previous sync target crankshaft torque" SWORD Trq 1 100 -3276.800 3276.700 FORMAT "%8.3" ECU_ADDRESS 0x600071B6 /end MEASUREMENT
/begin MEASUREMENT PT_tqCrksftSetWoIntv "driver demanded torque after Ignition Angle Release limitation without intervention (crankshaft level)" SWORD Trq 1 100 -3276.800 3276.700 FORMAT "%8.3" ECU_ADDRESS 0x60009830 /end MEASUREMENT
/begin MEASUREMENT PT_tqCrksftSetWoTrsmIntv "driver demanded torque after IA Release limitation without transmission intervention (crankshaft level)" SWORD Trq 1 100 -3276.800 3276.700 FORMAT "%8.3" ECU_ADDRESS 0x6000982E /end MEASUREMENT
/begin MEASUREMENT PT_tqCrSMinSync "Sync Minimum engine torque at the crankshaft level" SWORD md_q0p1 1 100 -3276.800 3276.700 FORMAT "%8.3" ECU_ADDRESS 0x60009832 /end MEASUREMENT
/begin MEASUREMENT PT_tqDesENGT1 "Target engine torque request by driver" SWORD Trq 1 100 -3276.800 3276.700 FORMAT "%8.3" ECU_ADDRESS 0x6000982C /end MEASUREMENT
/begin MEASUREMENT PT_tqDesENGT2 "Target VSA engine torque" SLONG Trq 1 100 -6553.60000000 6553.60000000 FORMAT "%13.8" ECU_ADDRESS 0x600039AC /end MEASUREMENT
/begin MEASUREMENT PT_tqEngCrksftEstimd "Engine crankshaft estimated torque" SWORD Trq 1 100 -3276.800 3276.700 FORMAT "%8.3" ECU_ADDRESS 0x600071B4 /end MEASUREMENT
/begin MEASUREMENT PT_tqEngCrksftEstimdSync "Sync engine crankshaft estimated torque" SWORD Trq 1 100 -3276.800 3276.700 FORMAT "%8.3" ECU_ADDRESS 0x600071B2 /end MEASUREMENT
/begin MEASUREMENT PT_tqEngENG16 "Target engine torque with limitation" SWORD Trq 1 100 -3276.800 3276.700 FORMAT "%8.3" ECU_ADDRESS 0x6000982A /end MEASUREMENT
/begin MEASUREMENT PT_tqEngEstimtd "Engine estimated torque" SWORD md_q0p1 1 100 -3276.800 3276.700 FORMAT "%8.3" ECU_ADDRESS 0x60009828 /end MEASUREMENT
/begin MEASUREMENT PT_tqEngEstimtdSync "Sync engine estimated torque" SWORD md_q0p1 1 100 -3276.800 3276.700 FORMAT "%8.3" ECU_ADDRESS 0x70001F74 /end MEASUREMENT
/begin MEASUREMENT PT_tqEngEstimtdTmp "Temporary engine estimated torque" SWORD md_q0p1 1 100 -3276.800 3276.700 FORMAT "%8.3" ECU_ADDRESS 0x600071B0 /end MEASUREMENT
/begin MEASUREMENT PT_tqEngPrtLimMechInnr "Inner torque limitation due to NMAX-limitation" SWORD md_sw_q0p1 1 100 -3276.800 3276.700 FORMAT "%8.3" ECU_ADDRESS 0x600071AE /end MEASUREMENT
/begin MEASUREMENT PT_tqInrSync "Sync inner torque" SWORD Trq 1 100 -3276.800 3276.700 FORMAT "%8.3" ECU_ADDRESS 0x70001F72 /end MEASUREMENT
/begin MEASUREMENT PT_tqRelAirDes "Target relative air based torque" UWORD rel_uw_b100 1 100 0.00 99.99847 FORMAT "%8.5" ECU_ADDRESS 0x600093E8 /end MEASUREMENT
/begin MEASUREMENT PT_tqRelAirDesSync "Sync target relative air based torque" UWORD rel_uw_b100 1 100 0.00 99.99847 FORMAT "%8.5" ECU_ADDRESS 0x600093E6 /end MEASUREMENT
/begin MEASUREMENT PT_tqRelAirReq "Request relative air based torque" UWORD rel_uw_b100 1 100 0.00 99.99847 FORMAT "%8.5" ECU_ADDRESS 0x600093E4 /end MEASUREMENT
/begin MEASUREMENT PT_tqRelAirReqSync "Sync request relative air based torque" UWORD rel_uw_b100 1 100 0.00 99.99847 FORMAT "%8.5" ECU_ADDRESS 0x600093E2 /end MEASUREMENT
/begin MEASUREMENT PT_tqResvEng "Combustion engine torque reserve" SWORD Trq 1 100 -3276.800 3276.700 FORMAT "%8.3" ECU_ADDRESS 0x60009826 /end MEASUREMENT
/begin MEASUREMENT PT_tqWhlMinEngWoFco "Minimum wheel torque with only internal combustion engine firing" SLONG TrqPrpHigh 1 100 -214748364.800 214748364.700 FORMAT "%13.3" ECU_ADDRESS 0x600039A8 /end MEASUREMENT
/begin MEASUREMENT PT_trqClthMax "maximum torque (engine) + dynamic maximum torque (electrical machine)" SWORD Trq 1 100 -3276.800 3276.700 FORMAT "%8.3" ECU_ADDRESS 0x60009824 /end MEASUREMENT
/begin MEASUREMENT PT_trqClthMin "Minimum clutch torque" SWORD Trq 1 100 -3276.800 3276.700 FORMAT "%8.3" ECU_ADDRESS 0x60009822 /end MEASUREMENT
/begin MEASUREMENT PT_trqCrSHiVT "Crankshaft Hi VTEC torque" SWORD Trq 1 100 -3276.800 3276.700 FORMAT "%8.3" ECU_ADDRESS 0x600071AC /end MEASUREMENT
/begin MEASUREMENT PT_trqCrSHiVTSync "Sync crankshaft Hi VTEC torque" SWORD Trq 1 100 -3276.800 3276.700 FORMAT "%8.3" ECU_ADDRESS 0x600071AA /end MEASUREMENT
/begin MEASUREMENT PT_trqCrSLoVT "Crankshaft Lo VTEC torque" SWORD Trq 1 100 -3276.800 3276.700 FORMAT "%8.3" ECU_ADDRESS 0x600071A8 /end MEASUREMENT
/begin MEASUREMENT PT_trqCrSLoVTSync "Sync crankshaft Lo VTEC torque" SWORD Trq 1 100 -3276.800 3276.700 FORMAT "%8.3" ECU_ADDRESS 0x600071A6 /end MEASUREMENT
/begin MEASUREMENT PT_trqDiff "Absolute Lo Hi VT different torque" SWORD Trq 1 100 -3276.800 3276.700 FORMAT "%8.3" ECU_ADDRESS 0x600071A4 /end MEASUREMENT
/begin MEASUREMENT PT_trqDiffSync "Sync absolute Lo Hi VT different torque" SWORD Trq 1 100 -3276.800 3276.700 FORMAT "%8.3" ECU_ADDRESS 0x600071A2 /end MEASUREMENT
/begin MEASUREMENT PT_trqEngTrqToCvt "Target engine estimated torque under rate limiter" SWORD Trq 1 100 -3276.800 3276.700 FORMAT "%8.3" ECU_ADDRESS 0x60009820 /end MEASUREMENT
/begin MEASUREMENT PT_trqEngTrqToCvtSync "Sync target engine estimated torque under rate limiter" SWORD Trq 1 100 -3276.800 3276.700 FORMAT "%8.3" ECU_ADDRESS 0x6000981E /end MEASUREMENT
/begin MEASUREMENT PT_trqLos "Parameter for Loss torque of the drive train" SWORD Trq 1 100 -3276.800 3276.700 FORMAT "%8.3" ECU_ADDRESS 0x6000981C /end MEASUREMENT
/begin MEASUREMENT PT_trqLosComp "Torque loss of the power train" SWORD Trq 1 100 -3276.800 3276.700 FORMAT "%8.3" ECU_ADDRESS 0x60014930 /end MEASUREMENT
/begin MEASUREMENT PT_trqMax "Absoluted maximum toqure between Lo Hi VT" SWORD Trq 1 100 -3276.800 3276.700 FORMAT "%8.3" ECU_ADDRESS 0x600071A0 /end MEASUREMENT
/begin MEASUREMENT PT_trqMaxSync "Sync absoluted maximum toqure between Lo Hi VT" SWORD Trq 1 100 -3276.800 3276.700 FORMAT "%8.3" ECU_ADDRESS 0x6000719E /end MEASUREMENT
/begin MEASUREMENT PT_trqResv "Request for reserve torque of the power train" SWORD Trq 1 100 -3276.800 3276.700 FORMAT "%8.3" ECU_ADDRESS 0x60014932 /end MEASUREMENT
/begin MEASUREMENT PT_trqTgtTrqCrS "Target VT crankshaft torque" SWORD Trq 1 100 -3276.800 3276.700 FORMAT "%8.3" ECU_ADDRESS 0x6000719C /end MEASUREMENT
/begin MEASUREMENT PT_trqTgtTrqCrSSync "Sync Target VT crankshaft torque" SWORD Trq 1 100 -3276.800 3276.700 FORMAT "%8.3" ECU_ADDRESS 0x6000719A /end MEASUREMENT
/begin MEASUREMENT PT_trqWhl "Wheel actual torque" SLONG TrqPrpHigh 1 100 -214748364.800 214748364.700 FORMAT "%13.3" ECU_ADDRESS 0x600039A4 /end MEASUREMENT
/begin MEASUREMENT PT_trqWhlMax "Maximum wheel torque" SLONG TrqPrpHigh 1 100 -214748364.800 214748364.700 FORMAT "%13.3" ECU_ADDRESS 0x600039A0 /end MEASUREMENT
/begin MEASUREMENT PT_trqWhlMin "Minimum wheel torque" SLONG TrqPrpHigh 1 100 -214748364.800 214748364.700 FORMAT "%13.3" ECU_ADDRESS 0x60003998 /end MEASUREMENT
/begin MEASUREMENT PT_trqWhlMinEng "Minimum wheel torque from the engine" SLONG TrqPrpHigh 1 100 -214748364.800 214748364.700 FORMAT "%13.3" ECU_ADDRESS 0x60003994 /end MEASUREMENT
/begin MEASUREMENT pvdmn_w_msg "minimum pressure upstream of the throttle valve" UWORD p_q0p078 1 100 0.00 5119.922 FORMAT "%8.3" ECU_ADDRESS 0x6000083C /end MEASUREMENT
/begin MEASUREMENT pvdmx_w_msg "maximum pressure upstream of the throttle valve" UWORD p_q0p078 1 100 0.00 5119.922 FORMAT "%8.3" ECU_ADDRESS 0x60000840 /end MEASUREMENT
/begin MEASUREMENT pvd_w_msg "pressure upstream throttle valve ( value from 0...5120hPa )" UWORD p_q0p078 1 100 0.00 5119.922 FORMAT "%8.3" ECU_ADDRESS 0x60000832 /end MEASUREMENT
/begin MEASUREMENT pvlf_w_msg "pressure upstream air filter" UWORD p_uw_q0p078 1 100 0.00 5119.922 FORMAT "%8.3" ECU_ADDRESS 0x70003768 /end MEASUREMENT
/begin MEASUREMENT rba_MemDiagExtd_nrLstReadSngErr "Block id of last occurred read error for single storage blocks" UWORD OneToOne 1 100 0.00 65535.00 FORMAT "%8.2" ECU_ADDRESS 0x600365D0 /end MEASUREMENT
/begin MEASUREMENT rba_MemDiag_flgInhbDiag "Diagnosis is inhibited" UBYTE B_TRUE 1 100 0.00 1.00000000000 BIT_MASK 0x1 FORMAT "%13.11" ECU_ADDRESS 0x7000010D /end MEASUREMENT
/begin MEASUREMENT rba_MemDiag_nrLstReadErr "Block id of last occurred read error" UWORD OneToOne 1 100 0.00 65535.00 FORMAT "%8.2" ECU_ADDRESS 0x600365CE /end MEASUREMENT
/begin MEASUREMENT rba_MemDiag_nrLstWrErr "Block id of last occurred write error" UWORD OneToOne 1 100 0.00 65535.00 FORMAT "%8.2" ECU_ADDRESS 0x600365CC /end MEASUREMENT
/begin MEASUREMENT redistar "redist array for the delay of miist_w" UBYTE dez 1 100 0.00 11.00 FORMAT "%5.2" ARRAY_SIZE 4 ECU_ADDRESS 0x6000B653 /end MEASUREMENT
/begin MEASUREMENT Reset_APP_rUnFlt "Protected copy of APP_rUnFlt for freeze frame" SWORD Prc 1 100 -400.0000 399.9878 FORMAT "%8.4" ECU_ADDRESS 0x600365CA /end MEASUREMENT
/begin MEASUREMENT Reset_BattU_u "Battery voltage" SWORD Volt_Batt 1 100 -655360.0 655340.0 FORMAT "%8.1" ECU_ADDRESS 0x600365C8 /end MEASUREMENT
/begin MEASUREMENT Reset_CoETS_rTrq "Protected copy of CoETS_rTrq for freeze frame" SWORD Prc 1 100 -400.0000 399.9878 FORMAT "%8.4" ECU_ADDRESS 0x600365C6 /end MEASUREMENT
/begin MEASUREMENT Reset_Env_ctRst "Reset counter which counts all resets" UBYTE OneToOne 1 100 0.00 255.0 FORMAT "%5.1" ECU_ADDRESS 0x6000B64F /end MEASUREMENT
/begin MEASUREMENT Reset_Env_xGrp "Reset group of last reset" UBYTE OneToOne 1 100 0.00 255.0 FORMAT "%5.1" ECU_ADDRESS 0x6000B64E /end MEASUREMENT
/begin MEASUREMENT Reset_Env_xId "Reset-ID of the last reset reason (Copy of Reset_Env.xId)" UWORD OneToOne 1 100 0.00 65535.00 FORMAT "%8.2" ECU_ADDRESS 0x60007180 /end MEASUREMENT
/begin MEASUREMENT Reset_Epm_nEng "Protected copy of Epm_nEng for freeze frame" SWORD EngN 1 100 -16384.00 16383.50 FORMAT "%8.2" ECU_ADDRESS 0x600365C4 /end MEASUREMENT
/begin MEASUREMENT Reset_GlbDa_lTotDst "total distance since first start captured at software reset" SLONG Length 1 100 -2147483648.00 2147483647.00 FORMAT "%13.2" ECU_ADDRESS 0x600365C0 /end MEASUREMENT
/begin MEASUREMENT Reset_T15_st "Protected copy of T15_st for freeze frame" UBYTE OneToOne 1 100 0.00 255.0 BIT_MASK 0x1 FORMAT "%5.1" ECU_ADDRESS 0x600365BE /end MEASUREMENT
/begin MEASUREMENT Reset_VehV_v "Protected copy of Veh_v for freeze frame" SWORD Vel 1 100 -327.6800 327.6700 FORMAT "%8.4" ECU_ADDRESS 0x600365BC /end MEASUREMENT
/begin MEASUREMENT RngMod_bClth "state powertrain for torque adaption" UBYTE B_TRUE 1 100 0.00 1.00000000000 BIT_MASK 0x1 FORMAT "%13.11" ECU_ADDRESS 0x700007A1 /end MEASUREMENT
/begin MEASUREMENT RngMod_bGenRls "release of torque adaption (generel release)" UBYTE B_TRUE 1 100 0.00 1.00000000000 BIT_MASK 0x1 FORMAT "%13.11" ECU_ADDRESS 0x7000079F /end MEASUREMENT
/begin MEASUREMENT RngMod_bRlsAdap "Switch-on condition for the torque adaption" UBYTE B_TRUE 1 100 0.00 1.00000000000 BIT_MASK 0x1 FORMAT "%13.11" ECU_ADDRESS 0x7000010C /end MEASUREMENT
/begin MEASUREMENT RngMod_bTrqBsWoIntv "condition: basic torque without intervention is calculated" UBYTE B_TRUE 1 100 0.00 1.00000000000 BIT_MASK 0x1 FORMAT "%13.11" ECU_ADDRESS 0x6000F904 /end MEASUREMENT
/begin MEASUREMENT RngMod_bTrqBsWoIntvByTra "condition: basic torque without intervention is active due to transmission intervention" UBYTE B_TRUE 1 100 0.00 1.00000000000 BIT_MASK 0x1 FORMAT "%13.11" ECU_ADDRESS 0x6000F903 /end MEASUREMENT
/begin MEASUREMENT RngMod_facEtaWoIntv "Interpolation factor for efficency w/o intervention" UBYTE fak_ub_b1 1 100 0.00 0.9961 ECU_ADDRESS 0x6000B64D /end MEASUREMENT
/begin MEASUREMENT RngMod_facTrqOptWoIntv "Interpolation factor for optimum torque w/o intervention" UBYTE fak_ub_b1 1 100 0.00 0.9961 ECU_ADDRESS 0x6000B64C /end MEASUREMENT
/begin MEASUREMENT RngMod_flgClrAdptFlt "release flag: erase adaption values" UBYTE B_TRUE 1 100 0.00 1.00000000000 BIT_MASK 0x1 FORMAT "%13.11" ECU_ADDRESS 0x7000079E /end MEASUREMENT
/begin MEASUREMENT RngMod_flgDrvStChg "Detection of vehicle operation mode change" UBYTE B_TRUE 1 100 0.00 1.00000000000 BIT_MASK 0x1 FORMAT "%13.11" ECU_ADDRESS 0x7000010B /end MEASUREMENT
/begin MEASUREMENT RngMod_nEng_LOC "engine speed" UWORD nmot_q0p5 1 100 0.00 16383.50 FORMAT "%8.2" ECU_ADDRESS 0x700052AC /end MEASUREMENT
/begin MEASUREMENT RngMod_nMaxDes "requested operating conditions: max. engine speed for torque adaption" SWORD nmot_q0p5 1 100 0.00 16383.50 FORMAT "%8.2" ECU_ADDRESS 0x700053C4 /end MEASUREMENT
/begin MEASUREMENT RngMod_nMinDes "requested operating conditions: min. engine speed for torque adaption" SWORD nmot_q0p5 1 100 0.00 16383.50 FORMAT "%8.2" ECU_ADDRESS 0x700053C6 /end MEASUREMENT
/begin MEASUREMENT RngMod_NumCycl "number of driving cycles without torque adaption" UBYTE dez 1 100 0.00 255.0 FORMAT "%5.1" ECU_ADDRESS 0x60038E16 /end MEASUREMENT
/begin MEASUREMENT RngMod_rTrq_LOC "speed ratio" UWORD fak_q0p01 1 100 0.00 327.6700 FORMAT "%8.4" ECU_ADDRESS 0x6000715E /end MEASUREMENT
/begin MEASUREMENT RngMod_stAdap "Status torque loss adaptation" UBYTE dez 1 100 0.00 255.0 FORMAT "%5.1" ECU_ADDRESS 0x6000FBAE /end MEASUREMENT
/begin MEASUREMENT RngMod_stAddRls "additional release conditions for the adaption of friction torque" UBYTE B_TRUE 1 100 0.00 1.00000000000 BIT_MASK 0x1 FORMAT "%13.11" ECU_ADDRESS 0x7000010A /end MEASUREMENT
/begin MEASUREMENT RngMod_stDrvState "Definition of torque adaption field" UBYTE dez 1 100 0.00 255.0 FORMAT "%5.1" ECU_ADDRESS 0x6000FBAD /end MEASUREMENT
/begin MEASUREMENT RngMod_stPrio "priority of requested operating point for torque adaption" UBYTE dez 1 100 0.00 255.0 FORMAT "%5.1" ECU_ADDRESS 0x700054A0 /end MEASUREMENT
/begin MEASUREMENT RngMod_tqAdpnLoss_a "Array of torque loss adaption values for several drive states in homogeneous operation mode" SWORD md_sw_q0p1 1 100 -3276.800 3276.700 FORMAT "%8.3" ARRAY_SIZE 6 ECU_ADDRESS 0x600398BA /end MEASUREMENT
/begin MEASUREMENT RngMod_tqDmdAcsy "Sum of torque demand from accessories" SWORD md_sw_q0p1 1 100 -3276.800 3276.700 FORMAT "%8.3" ECU_ADDRESS 0x700052AE /end MEASUREMENT
/begin MEASUREMENT RngMod_tqLossDif "unfiltered value of torque adaption" SWORD md_sw_q0p1 1 100 -3276.800 3276.700 FORMAT "%8.3" ECU_ADDRESS 0x700052B0 /end MEASUREMENT
/begin MEASUREMENT RngMod_trqAdapFlt "filtered value of torque adaption" SWORD md_sw_q0p1 1 100 -3276.800 3276.700 FORMAT "%8.3" ECU_ADDRESS 0x60007164 /end MEASUREMENT
/begin MEASUREMENT RngMod_trqChrgExchLoss "Charge Exchange Loss Torque of the Engine" SWORD Trq 1 100 -3276.800 3276.700 FORMAT "%8.3" ECU_ADDRESS 0x600097EE /end MEASUREMENT
/begin MEASUREMENT RngMod_trqClthMin "minimum clutch torque" SWORD md_q0p1 1 100 -3276.800 0.00 FORMAT "%8.3" ECU_ADDRESS 0x60014944 /end MEASUREMENT
/begin MEASUREMENT RngMod_trqClthMinWoCtOff "minimum accessible torque (base torque) on clutch level" SWORD md_q0p1 1 100 -3276.800 3276.700 FORMAT "%8.3" ECU_ADDRESS 0x600097EC /end MEASUREMENT
/begin MEASUREMENT RngMod_trqCrSLeadMax "Maximum engine torque at the crankshaft level on the lead path" SWORD md_q0p1 1 100 -3276.800 3276.700 FORMAT "%8.3" ECU_ADDRESS 0x600097EA /end MEASUREMENT
/begin MEASUREMENT RngMod_trqCrSLeadMaxAvl "maximum engine torque - lead path (soft limit)" SWORD md_q0p1 1 100 -3276.800 3276.700 FORMAT "%8.3" ECU_ADDRESS 0x600097E8 /end MEASUREMENT
/begin MEASUREMENT RngMod_trqCrSLimLead "limiting engine torque - lead path" SWORD md_q0p1 1 100 -3276.800 3276.700 FORMAT "%8.3" ECU_ADDRESS 0x600097E2 /end MEASUREMENT
/begin MEASUREMENT RngMod_trqCrSMin "Minimum engine torque at the crankshaft level" SWORD md_q0p1 1 100 -3276.800 0.00 FORMAT "%8.3" ECU_ADDRESS 0x60014948 /end MEASUREMENT
/begin MEASUREMENT RngMod_trqCrSMinWoCtOff "minimum accessible engine torque (base point)" SWORD md_q0p1 1 100 -3276.800 3276.700 FORMAT "%8.3" ECU_ADDRESS 0x600097E0 /end MEASUREMENT
/begin MEASUREMENT RngMod_trqCrSSetMax "Maximum engine torque at the crankshaft level on the set path" SWORD md_q0p1 1 100 -3276.800 3276.700 FORMAT "%8.3" ECU_ADDRESS 0x600097DE /end MEASUREMENT
/begin MEASUREMENT RngMod_trqCrSSetMaxAvl "maximum engine torque - set path (soft limit)" SWORD md_q0p1 1 100 -3276.800 3276.700 FORMAT "%8.3" ECU_ADDRESS 0x600097DC /end MEASUREMENT
/begin MEASUREMENT RngMod_trqCrSSetMin "minimum engine torque - set path" SWORD md_q0p1 1 100 -3276.800 3276.700 FORMAT "%8.3" ECU_ADDRESS 0x600097DA /end MEASUREMENT
/begin MEASUREMENT RngMod_trqCrSSetMinAvl "minimum engine torque - set path (soft limit)" SWORD md_q0p1 1 100 -3276.800 3276.700 FORMAT "%8.3" ECU_ADDRESS 0x600097D8 /end MEASUREMENT
/begin MEASUREMENT RngMod_trqCrSSetMinCylFCO "Minimum engine torque considering desired value for cylinder cut-off - Set path" SWORD md_q0p1 1 100 -3276.800 3276.700 FORMAT "%8.3" ECU_ADDRESS 0x600097D6 /end MEASUREMENT
/begin MEASUREMENT RngMod_trqCrSSetMinCylFCOTraIntv "Minimum engine torque considering maximum cylinder cutoff during gearshifts" SWORD md_q0p1 1 100 -3276.800 3276.700 FORMAT "%8.3" ECU_ADDRESS 0x600097D4 /end MEASUREMENT
/begin MEASUREMENT RngMod_trqDiffAdap "Adapted difference torque loss" SWORD md_sw_q0p1 1 100 -3276.800 3276.700 FORMAT "%8.3" ECU_ADDRESS 0x60000740 /end MEASUREMENT
/begin MEASUREMENT RngMod_trqDiffAdapCalc "Adapted difference torque loss, preliminary value" SWORD md_sw_q0p1 1 100 -3276.800 3276.700 FORMAT "%8.3" ECU_ADDRESS 0x50000878 /end MEASUREMENT
/begin MEASUREMENT RngMod_trqFltACGear "filtered torque for engaged gear and AC ON (HOM)" SWORD md_sw_q0p1 1 100 -3276.800 3276.700 FORMAT "%8.3" ECU_ADDRESS 0x600097D2 /end MEASUREMENT
/begin MEASUREMENT RngMod_trqFltACNoGear "filtered torque for disengaged gear and AC ON (HOM)" SWORD md_sw_q0p1 1 100 -3276.800 3276.700 FORMAT "%8.3" ECU_ADDRESS 0x600097D0 /end MEASUREMENT
/begin MEASUREMENT RngMod_trqFltHom "filtered torque for homogeneous mode" SWORD md_sw_q0p1 1 100 -3276.800 3276.700 FORMAT "%8.3" ECU_ADDRESS 0x70003A5E /end MEASUREMENT
/begin MEASUREMENT RngMod_trqFltNoACGear "filtered torque for engaged gear and AC OFF (HOM)" SWORD md_sw_q0p1 1 100 -3276.800 3276.700 FORMAT "%8.3" ECU_ADDRESS 0x600097CE /end MEASUREMENT
/begin MEASUREMENT RngMod_trqFltNoACNoGear "filtered torque for disengaged gear and AC OFF (HOM)" SWORD md_sw_q0p1 1 100 -3276.800 3276.700 FORMAT "%8.3" ECU_ADDRESS 0x600097CC /end MEASUREMENT
/begin MEASUREMENT RngMod_trqInrBsMinWoIntv "min. basic torque without interventions" SWORD md_q0p1 1 100 0.00 3276.700 FORMAT "%8.3" ECU_ADDRESS 0x600097CA /end MEASUREMENT
/begin MEASUREMENT RngMod_trqInrBsWoIntv "basic torque without interventions" SWORD md_q0p1 1 100 0.00 3276.700 FORMAT "%8.3" ECU_ADDRESS 0x600097C8 /end MEASUREMENT
/begin MEASUREMENT RngMod_trqInrMinWoCtOff "min. combustion torque" SWORD md_q0p1 1 100 0.00 3276.700 FORMAT "%8.3" ECU_ADDRESS 0x6001494C /end MEASUREMENT
/begin MEASUREMENT RngMod_trqLimMax "upper limit for torque adaption" SWORD md_sw_q0p1 1 100 -3276.800 3276.700 FORMAT "%8.3" ECU_ADDRESS 0x60007162 /end MEASUREMENT
/begin MEASUREMENT RngMod_trqLimMin "lower limit for torque adaption" SWORD md_sw_q0p1 1 100 -3276.800 3276.700 FORMAT "%8.3" ECU_ADDRESS 0x60007160 /end MEASUREMENT
/begin MEASUREMENT RngMod_trqLos "sum of all engine losses including frictional torque adaption" SWORD md_q0p1 1 100 0.00 3276.700 FORMAT "%8.3" ECU_ADDRESS 0x600097C6 /end MEASUREMENT
/begin MEASUREMENT RngMod_trqLosTot "sum of modelled torque" SWORD md_sw_q0p1 1 100 -3276.800 3276.700 FORMAT "%8.3" ECU_ADDRESS 0x60014950 /end MEASUREMENT
/begin MEASUREMENT RngMod_trqMaxDes "requested operating conditions: max. torque for torque adaptation" SWORD md_sw_q0p1 1 100 0.00 3276.700 FORMAT "%8.3" ECU_ADDRESS 0x700053CC /end MEASUREMENT
/begin MEASUREMENT RngMod_trqMinDes "requested operating conditions: min. torque for torque adaptation" SWORD md_sw_q0p1 1 100 0.00 3276.700 FORMAT "%8.3" ECU_ADDRESS 0x700053CE /end MEASUREMENT
/begin MEASUREMENT Sia_bFirstRxn "First Reception after T15 is ON" UBYTE B_TRUE 1 100 0.00 1.00000000000 BIT_MASK 0x1 FORMAT "%13.11" ECU_ADDRESS 0x700000CA /end MEASUREMENT
/begin MEASUREMENT Sia_cntrCurrRxdByt "Number of currently recieved bytes" ULONG OneToOne 1 100 0.00 4294967295.00 FORMAT "%13.2" ECU_ADDRESS 0x70001AC4 /end MEASUREMENT
/begin MEASUREMENT Sia_stfARAck_mp "Bit wise status used to generate state byte sent in response to command" UBYTE OneToOne 1 100 0.00 255.0 FORMAT "%5.1" ECU_ADDRESS 0x7000A0EB /end MEASUREMENT
/begin MEASUREMENT Sia_stHdShk "Status to represent the handshake between data acquisition proc and communication proc" UBYTE OneToOne 1 100 0.00 255.0 FORMAT "%5.1" ECU_ADDRESS 0x70001ACA /end MEASUREMENT
/begin MEASUREMENT Sia_stIgnLck "Variable for status of Injection Lock from Immo Module" UBYTE B_TRUE 1 100 0.00 1.00000000000 BIT_MASK 0x1 FORMAT "%13.11" ECU_ADDRESS 0x700000C9 /end MEASUREMENT
/begin MEASUREMENT Sia_stImsState_mp "Bit wise status to represent the current immobilizer and ECU communication status" UBYTE OneToOne 1 100 0.00 255.0 FORMAT "%5.1" ECU_ADDRESS 0x7000A0EA /end MEASUREMENT
/begin MEASUREMENT Sia_stOK "Status to represent the validity of communication so far" UBYTE OneToOne 1 100 0.00 255.0 FORMAT "%5.1" ECU_ADDRESS 0x60017F78 /end MEASUREMENT
/begin MEASUREMENT Sia_stTimeMon "Status to represent the state of state machine for time monitoring" UBYTE OneToOne 1 100 0.00 255.0 FORMAT "%5.1" ECU_ADDRESS 0x70001AC9 /end MEASUREMENT
/begin MEASUREMENT TMEAdpn_AdpnReldERNM_I.oldSignal "Edge rising for adaptation release condition / value of input signal last calculation" UBYTE B_TRUE 1 100 0.00 1.00000000000 BIT_MASK 0x1 FORMAT "%13.11" ECU_ADDRESS 0x6000B64A /end MEASUREMENT
/begin MEASUREMENT TMECmb_IfEtaIaTqAct_I.HSPActv "combustion dataset for next combustion / Combustion dataset: condition GDI-operating mode for actual ignition cylinder is homogeneous-split" UBYTE dez 1 100 0.00 255.0 FORMAT "%5.1" ECU_ADDRESS 0x5000076C /end MEASUREMENT
/begin MEASUREMENT TMECmb_IfEtaIaTqAct_I.f2kazw "combustion dataset for next combustion / combustion data set" UBYTE fak_ub_b1 1 100 0.00 0.9961 ECU_ADDRESS 0x5000076D /end MEASUREMENT
/begin MEASUREMENT TMECmb_IfEtaIaTqAct_I.flb "combustion dataset for next combustion / Combustion dataset: Factor charge-movement" UBYTE fak_ub_b1 1 100 0.00 0.9961 ECU_ADDRESS 0x5000076E /end MEASUREMENT
/begin MEASUREMENT TMECmb_IfEtaIaTqAct_I.lamsbg "combustion dataset for next combustion / lambda input for interface class" UWORD fak_uw_b16 1 100 0.00 15.99976 FORMAT "%8.5" ECU_ADDRESS 0x50000770 /end MEASUREMENT
/begin MEASUREMENT TMECmb_IfEtaIaTqAct_I.nEng "combustion dataset for next combustion / Combustion dataset: Average engine speed of one cylinder segment" UWORD nmot_uw_q0p25 1 100 0.00 16383.75 FORMAT "%8.2" ECU_ADDRESS 0x50000772 /end MEASUREMENT
/begin MEASUREMENT TMECmb_IfEtaIaTqAct_I.rl "combustion dataset for next combustion / Combustion dataset: Relative air charge" UWORD rel_uw_q0p0234 1 100 0.00 1535.977 FORMAT "%8.3" ECU_ADDRESS 0x50000774 /end MEASUREMENT
/begin MEASUREMENT TMECmb_IfEtaIaTqAct_I.rri "combustion dataset for next combustion / inert gas rate input for interface class" UWORD rel_uw_b100 1 100 0.00 99.99847 FORMAT "%8.5" ECU_ADDRESS 0x50000776 /end MEASUREMENT
/begin MEASUREMENT TMECmb_IfEtaIaTqAct_I.split2ka "combustion dataset for next combustion / Combustion dataset: Factor for splitting CNG and Gasoline" UWORD fak_uw_b2 1 100 0.00 1.000000 FORMAT "%8.6" ECU_ADDRESS 0x50000778 /end MEASUREMENT
/begin MEASUREMENT TMELoss_pIntk "Charge preasure: relative or absolute" SWORD p_sw_q0p078 1 100 -2560.000 2559.922 FORMAT "%8.3" ECU_ADDRESS 0x60007170 /end MEASUREMENT
/begin MEASUREMENT TMELoss_tqChrgExchIntkClsdMap "Output of the Map TMELoss_tqChrgExchIntkClsd_M" SWORD Trq 1 100 -3276.800 3276.700 FORMAT "%8.3" ECU_ADDRESS 0x6000716E /end MEASUREMENT
/begin MEASUREMENT TMELoss_tqChrgExchMai "Mainpart of charge exchange loss" SWORD Trq 1 100 -3276.800 3276.700 FORMAT "%8.3" ECU_ADDRESS 0x6000716C /end MEASUREMENT
/begin MEASUREMENT TMELoss_tqChrgExchOutlOpenMap "Output of the Map TMELoss_tqChrgExchOutlOpenMap" SWORD Trq 1 100 -3276.800 3276.700 FORMAT "%8.3" ECU_ADDRESS 0x6000716A /end MEASUREMENT
/begin MEASUREMENT TMELoss_tqChrgExchOvlExhMap "Output of the Map TMELoss_tqChrgExchOvlExh_M" SWORD Trq 1 100 -3276.800 3276.700 FORMAT "%8.3" ECU_ADDRESS 0x60007168 /end MEASUREMENT
/begin MEASUREMENT TMELoss_tqChrgExchOvlMap "Output of the Map TMELoss_tqChrgExchOvl_M" SWORD Trq 1 100 -3276.800 3276.700 FORMAT "%8.3" ECU_ADDRESS 0x700052B2 /end MEASUREMENT
/begin MEASUREMENT TMERng_ctDrvEntrTrqBasMod "Local driving cycle counter for transition to drive state" UBYTE OneToOne 1 100 0.00 255.0 FORMAT "%5.1" ECU_ADDRESS 0x6000B64B /end MEASUREMENT
/begin MEASUREMENT TMERng_etaCcoCurr "cylinder cutoff efficiency for current reduction stage" UWORD fak_uw_b2 1 100 0.00 1.999969 FORMAT "%8.6" ECU_ADDRESS 0x60007172 /end MEASUREMENT
/begin MEASUREMENT TMERng_facIaBasMinWoIntv "mean ignition angle effectiveness of minimum ignition angle" UWORD fak_uw_b2 1 100 0.00 1.999969 FORMAT "%8.6" ECU_ADDRESS 0x60007176 /end MEASUREMENT
/begin MEASUREMENT TMERng_facIaBasWoIntv "mean ignition angle effectiveness of basic ignition angle" UWORD fak_uw_b2 1 100 0.00 1.999969 FORMAT "%8.6" ECU_ADDRESS 0x60007174 /end MEASUREMENT
/begin MEASUREMENT TMERng_tqCrksftLeadMaxStabCdn "Maximum engine torque at the crankshaft level on the lead path with stable conditions" SWORD md_q0p1 1 100 -3276.800 3276.700 FORMAT "%8.3" ECU_ADDRESS 0x6000978E /end MEASUREMENT
/begin MEASUREMENT uevges_msg "Transmission ratio total" UBYTE fak_q0p1 1 100 0.00 25.50 FORMAT "%5.2" ECU_ADDRESS 0x700054BF /end MEASUREMENT
/begin MEASUREMENT uevges_w_msg "Transmission ratio total (Word-Variables)" UWORD fak_q0p02 1 100 0.00 1310.700 FORMAT "%8.3" ECU_ADDRESS 0x7000540E /end MEASUREMENT
/begin MEASUREMENT vpvdkpu_w_msg "Ratio: boost pressure upstream throttle to ambient pressure" UWORD fak_q0p000122 1 100 0.00 7.999878 FORMAT "%8.6" ECU_ADDRESS 0x7000374E /end MEASUREMENT
/begin MEASUREMENT wgvum_w_Loc "local wgvum_w" SWORD kw_q0p0156 1 100 -512.0000 511.9844 FORMAT "%8.4" ECU_ADDRESS 0x60007166 /end MEASUREMENT
/begin FUNCTION PT2ME "137.2.0   Interface Adapter PT to MED 7/9"
 /begin DEF_CHARACTERISTIC CoPT_flgFcoInhbEna_C CoPT_flgFuCutOffActvEna_C PT2ME_CW PT2ME_numGearAsgn_T PT2ME_tiThresAftEngSt_C VF2ME_DMRWAN_C /end DEF_CHARACTERISTIC
 /begin REF_CHARACTERISTIC MDNORM /end REF_CHARACTERISTIC
 /begin IN_MEASUREMENT APP_bPlaBrk CoEng_flgRelsFco Com_flgCvtFcoPrms Com_stHvyDecelFlg Conv_trqLd CoPT_bTraShftActvDes Gbx_stPNPos PT_bConvSlip PT_bConvSlipOpn PT_bGrip PT_bNoGrip PT_rTraGear PT_stTraShftOp PT_stTraType SpdGov_trqSet Strt_st T50_st tnst_w_msg Tra_numGear Tra_numGearDes VehMot_rTrqDfftl /end IN_MEASUREMENT
 /begin OUT_MEASUREMENT APP_stPlaBrk B_estart_msg B_fs_msg B_gsch_msg B_gwhs_msg B_sta_msg B_wkauf_msg B_wkr_msg B_wk_msg B_zwget_msg CoPT_flgFuCutOffActv dmrwan_msg EISGov_trq gangist_msg gangi_msg gangsist_msg gangsziel_msg InjCtl_qRaw mdwan_w_msg PT2ME_numLstGear Pt_flgFcoInhb uevges_msg uevges_w_msg /end OUT_MEASUREMENT
 FUNCTION_VERSION "137.2.0" /end FUNCTION
/begin FUNCTION PtCoornDyn_TqDes "140.0.0   Dynamic Coordination and Limitation - desired driver torque"
 /begin DEF_CHARACTERISTIC PtCoornDyn_dtqIntvMinSpdCtrlNegSlop_C PtCoornDyn_dtqIntvMinSpdCtrlPosSlop_C PtCoornDyn_nIdleSpdDelta_C PtCoornDyn_nIdleSpdOffst_C PtCoornDyn_stDesTqSetPahSwt_C /end DEF_CHARACTERISTIC
 /begin IN_MEASUREMENT ASDrf_trqClthFlt CoVeh_trqAcs HLSDem_nSetPLo LsComp_tqCmpActvSpdGovr LsComp_tqSwilLossNotFild PT_nClth PT_tqCluTrsmProtn RngMod_trqCrSMin RngMod_trqCrSMinWoCtOff RngMod_trqCrSSetMax SpdGov_trqClth SpdGov_trqClthLimMechDes Tra_trqDesMax Tra_trqDesMin VehMot_tqCluDesGenericLimn VehMot_tqCluDftlProtn VMSI_tqCluDesMax VMSI_tqCluMin /end IN_MEASUREMENT
 /begin OUT_MEASUREMENT PtCoornDyn_flgGenericLimnActvDes PtCoornDyn_flgSpdCtrlDecIntvOvrd PtCoornDyn_flgStabyIntvActvDes PtCoornDyn_flgStabyIntvDecActvDes PtCoornDyn_flgStabyIntvIncActvDes PtCoornDyn_flgTrsmIntvActvDes PtCoornDyn_flgTrsmIntvDecActvDes PtCoornDyn_flgTrsmIntvIncActvDes PtCoornDyn_tqCluDes PtCoornDyn_tqCluDesGenericLimn PtCoornDyn_tqCluDesWithMeclLimn PtCoornDyn_tqCluDesWoIntv PtCoornDyn_tqCluDesWoTrsmIntv PtCoornDyn_tqCluStabyIntvDecLimDes PtCoornDyn_tqCluStabyIntvIncLimDes PtCoornDyn_tqCluTrsmIntvDecLimDes PtCoornDyn_tqCluTrsmIntvDecLimDesWoIncStabyLimn PtCoornDyn_tqCluTrsmIntvIncLimDes /end OUT_MEASUREMENT
 /begin LOC_MEASUREMENT PtCoornDyn_tqCluDecIntvMinLimn PtCoornDyn_tqCluMax PtCoornDyn_tqCluMin PtCoornDyn_tqCluStabyIntvInc PtCoornDyn_tqCrksftDecIntvMinLimn PtCoornDyn_tqCrksftMin PtCoornDyn_tqDmdFromSpdGovr PtCoornDyn_tqPreCalcCluDes /end LOC_MEASUREMENT
 FUNCTION_VERSION "140.0.0" /end FUNCTION
/begin FUNCTION PtCoornDyn_TqLead "138.3.0   Dynamic Coordination and Limitation - Lead Path"
 /begin DEF_CHARACTERISTIC PtCoornDyn_dTqRampLeadStabyIntvDecNeg_C PtCoornDyn_dTqRampLeadStabyIntvDecPos_C PtCoornDyn_dTqRampLeadTrsmIntvDecNeg_C PtCoornDyn_dTqRampLeadTrsmIntvDecPos_C PtCoornDyn_stTqLimdLeadPahSwt_C PtCoornDyn_tiDlyLeadStabyIntvDec_C PtCoornDyn_tiDlyLeadTrsmIntvDec_C /end DEF_CHARACTERISTIC
 /begin IN_MEASUREMENT ASDrf_trqClthLeadEng CoVeh_trqAcs LsComp_tqCmpActvSpdGovr LsComp_tqSwilLossNotFild PtCoornDyn_flgSpdCtrlDecIntvOvrd PT_tqCluTrsmProtn RngMod_trqCrSMin RngMod_trqCrSMinWoCtOff SpdGov_trqClthLimMechLead SpdGov_trqLead StatyCoorn_flgEnaBypCmpdTq TMERng_tqCrksftLeadMaxStabCdn Tra_trqLeadMax Tra_trqLeadMin VehMot_tqCluDftlProtn VehMot_tqCluLeadGenericLimn VMSI_tqCluLeadMax VMSI_tqCluMin /end IN_MEASUREMENT
 /begin OUT_MEASUREMENT PtCoornDyn_stIntvDecLead PtCoornDyn_stIntvLead PtCoornDyn_tqCluLeadGenericLimn PtCoornDyn_tqCluLeadStabyIntv PtCoornDyn_tqCluLeadTrsmIntv PtCoornDyn_tqCrksftLead /end OUT_MEASUREMENT
 /begin LOC_MEASUREMENT PtCoornDyn_tqCluDecIntvMinLimnLead PtCoornDyn_tqCluLeadAftStabyIntvInc_MP PtCoornDyn_tqCluLeadAftTrsmIntvDec_MP PtCoornDyn_tqCluLeadBefIntvCoorn PtCoornDyn_tqCluLeadDesGenericLimn PtCoornDyn_tqCluLeadStabyIntvDecAftRamp_MP PtCoornDyn_tqCluLeadStabyIntvDec_MP PtCoornDyn_tqCluLeadStabyIntvInc_MP PtCoornDyn_tqCluLeadTrsmIntvDecAftRamp_MP PtCoornDyn_tqCluLeadTrsmIntvDec_MP PtCoornDyn_tqCluLeadTrsmIntvInc PtCoornDyn_tqCluLeadTrsmIntvInc_MP PtCoornDyn_tqCluLeadWoSpdGovr PtCoornDyn_tqDmdFromSpdGovrLead /end LOC_MEASUREMENT
 FUNCTION_VERSION "138.3.0" /end FUNCTION
/begin FUNCTION PTCOP_TrqCnv "31.6.1    Current Operating point drive train"
 /begin IN_MEASUREMENT ActMod_trqCrS CoVeh_trqAcs PT_rTrq PT_trqLos RngMod_trqCrSMax RngMod_trqCrSMin RngMod_trqCrSMinWoCtOff VehMot_rTrqDfftl /end IN_MEASUREMENT
 /begin OUT_MEASUREMENT PT_tqCluMinEngWoFco PT_tqWhlMinEngWoFco PT_trqClthMax PT_trqClthMin PT_trqWhl PT_trqWhlMax PT_trqWhlMin PT_trqWhlMinEng /end OUT_MEASUREMENT
 FUNCTION_VERSION "31.6.1" /end FUNCTION
/begin FUNCTION PTDist_Dyn "16.2.0    Dynamic Torque Distribution for Hybrid Vehicle"
 /begin DEF_CHARACTERISTIC PTDist_flgIaRelsLeadFil_C PTDist_flgLADIaRels_C PTDist_flgSwtLADInpCluSig_C PTDist_tqDiffIARlsNegACOffIdleHi_T PTDist_tqDiffIARlsNegACOffIdleLo_T PTDist_tqDiffIARlsNegACOnIdleHi_T PTDist_tqDiffIARlsNegACOnIdleLo_T PTDist_tqDiffIARlsNegACOnNonIdleHi_T PTDist_tqDiffIARlsNegACOnNonIdleLo_T PTDist_tqDiffIARlsPosACOnHi_T PTDist_tqDiffIARlsPosACOnLo_T PTDist_tqHiThdLADIaRels_C PTDist_tqHiThdLeadFilInactv_C PTDist_tqICEMaxOffs_C PTDist_tqLoThdLADIaRels_C PTDist_tqLoThdLeadFilInactv_C PTDist_trqDiffDynIntvActvNeg_T PTDist_trqDiffDynIntvActvPos_T PTDist_trqOfsDynActvNeg_T PTDist_trqOfsDynActvPos_T /end DEF_CHARACTERISTIC
 /begin IN_MEASUREMENT ActMod_trqClthWoDstC AirC_stPsCmpr ASDrf_bNoRmp ASDrf_bPosNegDes ASDrf_tqCluDemSet ASDrf_trqClthMax B_ll_msg CoETS_bFltDemLead CoVeh_trqAcs PtCoornDyn_flgStabyIntvActvDes PtCoornDyn_flgTrsmIntvActvDes PtCoornDyn_tqCluDes PtCoornDyn_tqCluDesWoIntv PtCoornDyn_tqCluDesWoTrsmIntv RngMod_trqCrSMin RngMod_trqCrSSetMax SpdGov_bNLimActv StatyCoorn_tqCluDesLimd SyC_ctPostDrvLeave Tra_trqDesMax VMSI_tqCluDesMax /end IN_MEASUREMENT
 /begin OUT_MEASUREMENT PTDist_flgIgnAgRelsDynEng PTDist_flgIgnAgRelsNoRmp PTDist_flgIgnAgRelsRmp PTDist_flgTqICESetMax PTDist_tqCluSetStabyIntv PTDist_tqCluSetWoIntv PTDist_tqCrksftSet /end OUT_MEASUREMENT
 /begin LOC_MEASUREMENT PTDist_cntrReIni PTDist_flgLADIaRels PTDist_tqHiThdLeadFilActv PTDist_tqIntvMin PTDist_tqLoThdLeadFilActv /end LOC_MEASUREMENT
 FUNCTION_VERSION "16.2.0" /end FUNCTION
/begin FUNCTION PthLead_TrqCalc "26.0.0_1.2.0PathLead Torque Calculation" /begin DEF_CHARACTERISTIC PthLead_stTrqCalc_CW /end DEF_CHARACTERISTIC
 /begin IN_MEASUREMENT ASDrf_trqClthFlt CoETS_trqInrLeadCo CoETS_trqLimLead CoPT_trqResvEng CoVeh_trqAcs EGSDCmn_tqResvParl EGSys_etaCH EngDem_trqInrLim EngReq_trqResvQckTst EngTrqPtd_trqLead InjSys_tqResvCvo InjSys_trqResvCP LsComp_tqCmpActvSpdGovr LsComp_tqSwilLossNotFild PhyMod_etaIgnBsAvrg PhyMod_etaIgnMin PtCoornDyn_flgStabyIntvActvDes PtCoornDyn_flgTrsmIntvActvDes PtCoornDyn_tqCluDes PtCoornDyn_tqCluDesWoTrsmIntv RngMod_trqCrSMin SpdGov_trqFlt SpdGov_trqLead /end IN_MEASUREMENT
 /begin OUT_MEASUREMENT PthLead_stActvMonLim PthLead_stTrqResvActv PthLead_trqInrLead PthLead_trqInrNoMon PthLead_trqResv PthLead_trqResvRel PthLead_trqResvRelA PthLead_trqResvRelB /end OUT_MEASUREMENT
 /begin LOC_MEASUREMENT PthLead_bMonLim PthLead_trqCHRef PthLead_trqDes PthLead_trqDesRef PthLead_trqResvEta /end LOC_MEASUREMENT
 FUNCTION_VERSION "26.0.0_1.2.0" /end FUNCTION
/begin FUNCTION PThrVlvUs_Vd "1.7.0     Pressure throttle valve upstream (virtual device)"
 /begin DEF_CHARACTERISTIC PThrVlvUs_nSwtSynCalcThd_C PThrVlvUs_pDifAirFilMax_C PThrVlvUs_pDifAirFilUsVehV_T PThrVlvUs_pSnsrTolrMax_C PThrVlvUs_pSubValMax_C PThrVlvUs_pSubValMin_C /end DEF_CHARACTERISTIC
 /begin IN_MEASUREMENT Epm_nEng Epm_stSync PEnv_dpAirFilThr PEnv_p PEnv_pRaw VehV_v /end IN_MEASUREMENT
 /begin OUT_MEASUREMENT B_pvdg_msg fpvd_w_msg PThrVlvUs_facNom PThrVlvUs_facNomB1 PThrVlvUs_facNrmPEnv PThrVlvUs_flgPVld PThrVlvUs_flgPVldB1 PThrVlvUs_p PThrVlvUs_pB1 PThrVlvUs_pMax PThrVlvUs_pMaxB1 PThrVlvUs_pMin PThrVlvUs_pMinB1 pvdmn_w_msg pvdmx_w_msg pvd_w_msg pvlf_w_msg vpvdkpu_w_msg /end OUT_MEASUREMENT
 FUNCTION_VERSION "1.7.0" /end FUNCTION
/begin FUNCTION PthSet_IARls "12.9.0    PathSet Ignition Angle Release"
 /begin DEF_CHARACTERISTIC PthSet_dtrqIARlsRmp2_C PthSet_dtrqIARlsRmp_MAP PthSet_stIaRlsCmftMask_C PthSet_stIaRlsIntvMask_C PthSet_stIaRlsSlowRampMask_C PthSet_stIaRlsWoIntvMask_C PthSet_stIaRlsWoTrsmIntvMask_C PthSet_stSwtNoGripSeln_C PthSet_trqIARlsRmpActvnThd_C /end DEF_CHARACTERISTIC
 /begin IN_MEASUREMENT AirSys_bTrqInflCmft CoEng_bModtr CoEng_bStrtEndIA CoEng_bStrtEndTrqStruct CoEOM_flgCvlcIgnRels CoETS_trqInrSetCo DOGov_bActv GlbDa_stTrqDem PtCoornDyn_flgStabyIntvActvDes PTDist_flgIgnAgRelsDynEng PTDist_flgIgnAgRelsNoRmp PTDist_flgIgnAgRelsRmp PthLead_stTrqResvActv PthSet_stOvrRunPhActv PT_bNoGrip RngMod_trqInrBs SpdGov_bNLimActv Tra_numGear Tra_stAST /end IN_MEASUREMENT
 /begin OUT_MEASUREMENT PthSet_bIARlsNoIntv PthSet_bIARlsNoTraIntv PthSet_bIARlsWoDstC PthSet_dtqRmpIgnAgRls PthSet_flgIgnAgRlsRmpActvn PthSet_stIgnAgRls /end OUT_MEASUREMENT
 FUNCTION_VERSION "12.9.0" /end FUNCTION
/begin FUNCTION PthSet_OvrRun "21.11.0_159.3.0PathSet OverRun"
 /begin DEF_CHARACTERISTIC PthSet_facFCOMin_C PthSet_flgEnaOvrRunHyst_C PthSet_nMaxCylIndivFCO_C PthSet_nOvrRunThres_C PthSet_numMaxCylCtOff_C PthSet_stOvrRun_CW PthSet_SwtFCOTqInhbn_C PthSet_tiFcoDlyTmr_C PthSet_tiMaxPhRstrt_C PthSet_tiUpShift_CUR PthSet_tqLoadBasdThdFcoOff_CUR PthSet_tqLoadBasdThdFcoOn_CUR PthSet_trqHysOvrRun_C /end DEF_CHARACTERISTIC
 /begin IN_MEASUREMENT AirSys_bTrqInflLimp CoEng_bCtOffConDel CoEng_bFrstStrtEnd CoEng_bStrtEndTrqStruct CoETS_bTraIntvActv CoETS_trqInrSetCo Com_flgUpshiftMod ECT_bFCOEnaCmpnPrt Epm_nEng Epm_nEng10ms Gbx_numGearTrgt GlbDa_stTrqDem InjSys_bInjVlvActv InjSys_stActRedStg LIGov_nDiff PthSet_stActvMonLim PthSet_trqInrCtOff PT_flgLimnFCOReq rl_w_msg RngMod_trqInrBsMin RngMod_trqInrMinWoCtOff SpdGov_bEngPrtLimOvrSpd TCE_flgGenericFcoReq TCE_flgGenericFcoRst TrqCnv_numRedStgDem /end IN_MEASUREMENT
 /begin OUT_MEASUREMENT PthSet_bCylIndivFCOAft PthSet_bCylIndivFCOBef PthSet_bEnaFCO PthSet_bEnaIndivRes PthSet_bOvrRun PthSet_stCylIndivCtOff PthSet_stOvrRun PthSet_stOvrRunEna PthSet_stOvrRunPhActv PthSet_stTrgFCO /end OUT_MEASUREMENT
 /begin LOC_MEASUREMENT PthSet_bEnaCylIndivFCO PthSet_bOvrRunCdnPrsnt PthSet_bPhCO PthSet_bUpShiftDly PthSet_stFcoDlyTmrtmp PthSet_stToffDlytmp PthSet_trqInrBsMinFCO_mp /end LOC_MEASUREMENT
 FUNCTION_VERSION "21.11.0_159.3.0" /end FUNCTION
/begin FUNCTION PthSet_TrqDist "11.4.1_159.2.0PathSet Torque Distribution"
 /begin DEF_CHARACTERISTIC PthSet_dTqIgnAgRlsPos_C PthSet_dtrqIALckRmp2_C PthSet_dtrqIALckRmp_C PthSet_facMonFCOLo_C PthSet_flgInnrLimdCutOffEna_C PthSet_stTrqDist_CW PthSet_tqIARmpOffset_C /end DEF_CHARACTERISTIC
 /begin IN_MEASUREMENT ASDdc_trq CoEng_bStrtEndIA CoETS_trqInrLimSet CoETS_trqInrSetCo EngDem_trqInrLimCtOff EngReq_trqRngExlAct EngTrqPtd_trqSet EpmCrS_tiSeg InjSys_bInjVlvActv PTDist_flgTqICESetMax PthSet_bIARlsWoDstC PthSet_dtqRmpIgnAgRls PthSet_flgIgnAgRlsRmpActvn RngMod_trqInrBs RngMod_trqInrBsMax RngMod_trqInrBsMin SpdGov_trqClth SpdGov_trqSet /end IN_MEASUREMENT
 /begin OUT_MEASUREMENT PthSet_bIAIntv PthSet_stActvMonLim PthSet_stIARls PthSet_trqInrCtOff PthSet_trqInrDes PthSet_trqInrIA PthSet_trqInrIABef PthSet_trqInrLim PthSet_trqInrLtd PthSet_trqInrWoDstC PthSet_trqRmpIALck /end OUT_MEASUREMENT
 /begin LOC_MEASUREMENT PthSet_bIARlsMon PthSet_bIARlsWiMon PthSet_bMonLimFCO PthSet_bMonLimIA PthSet_stRampActv PthSet_stRampPosn PthSet_tqIARIsRamp PthSet_tqInnrLimdRamp PthSet_trqInrBsExl PthSet_trqInrDes_mp PthSet_trqInrLtdIA PthSet_trqInrLtdWoDstC_mp PthSet_trqInrWoDstCBef /end LOC_MEASUREMENT
 FUNCTION_VERSION "11.4.1_159.2.0" /end FUNCTION
/begin FUNCTION PTLo_LosCalc "3.12.0    Drive train loss" /begin IN_MEASUREMENT Conv_trqLd Conv_trqResv RngMod_trqComp Tra_trqLos /end IN_MEASUREMENT /begin OUT_MEASUREMENT PT_trqLos PT_trqLosComp PT_trqResv /end OUT_MEASUREMENT FUNCTION_VERSION "3.12.0" /end FUNCTION
/begin FUNCTION PTODi_SpdCoord "31.1.0    Task distributor of the drive train - speed co-ordination" /begin DEF_CHARACTERISTIC CoPT_nMinSysErrLim_C /end DEF_CHARACTERISTIC
 /begin IN_MEASUREMENT AccPed_nMax AccPed_nMin AccPed_stNSetP CoME_nMax CoME_nMin CoME_stNSetP HiPSys_flgDeactvnFuInjInhbn Tra_nASTDes Tra_nMax Tra_nMin Tra_stAST Tra_stNSetP Tra_tiASTDes /end IN_MEASUREMENT
 /begin OUT_MEASUREMENT CoPT_nASTDes CoPT_nMaxAcs CoPT_nMaxSysErr CoPT_nMaxTra CoPT_nMinAcs CoPT_nMinSysErr CoPT_nMinTra CoPT_stAST CoPT_stNSetPAcs CoPT_stNSetPSysErr CoPT_stNSetPTra CoPT_tiASTDes /end OUT_MEASUREMENT
 FUNCTION_VERSION "31.1.0" /end FUNCTION
/begin FUNCTION PTSSE_SetData "10.0.0    PowerTrainStopStartEngine"
 /begin DEF_CHARACTERISTIC PTSSE_bStrtEnaCVT_C PTSSE_stGbxSpstReqActv_C PTSSE_stSpstReq_T /end DEF_CHARACTERISTIC
 /begin IN_MEASUREMENT Com_stPreStop Com_stTranStop Gbx_stSpstReq T15_st /end IN_MEASUREMENT
 /begin OUT_MEASUREMENT PT_bEngStopEna PT_bEngStopReq PT_bEngStrtEna PT_bEngStrtReq /end OUT_MEASUREMENT
 FUNCTION_VERSION "10.0.0" /end FUNCTION
/begin FUNCTION PT_Axispoints "59.0.0    Defines the supporting points for PT" FUNCTION_VERSION "59.0.0" /end FUNCTION
/begin FUNCTION PT_ComSigPrepn "27.0.0    Signal Preparation of powertrain Information which are communicated to other ECUs"
 /begin DEF_CHARACTERISTIC PT_cntrEngActvIgn_C PT_flgIndcdLimnBascTq_C PT_flgInnrTqLimEna_C PT_flgTqLimnInnr_C PT_swtEngTqEstimtdSeln_C Pt_tiAcOffDetn_C PT_tiAcOnDetn_C PT_tiEngLimActvDesDly_C PT_tqDrvrDmdMinThd_C PT_trqRateLimitActvDiff_C PT_trqRateLimitActvTrqTh_C PT_trqRateLimit_C /end DEF_CHARACTERISTIC
 /begin REF_CHARACTERISTIC KFMIOP MDNORM /end REF_CHARACTERISTIC
 /begin IN_MEASUREMENT ActMod_trqInr AC_trqDes AirMod_ratChrgAirCylAdv_a anztib_msg B_ll_msg B_vhegv B_vhegzw CoME_trqDesComp Com_rTrqCnvBoost Conv_trqOilPmpLoss CoVeh_trqAcs EngDem_trqInrLim Epm_nEng etazaist_w_msg etazwist_w_msg etazwsol_w_msg f2kazw_msg fethmnmx_w_msg fmi2trq_w_msg Gen_ctCylAdv Ign_flgHspNxtCmb Ign_ia_real_s8 LIGov_trq miopt_w_msg PtCoornDyn_tqCluDesWoIntv PthSet_trqInrIA PT_rTrq rlfgdsvheg_w_msg rlfgdsvhek_w_msg RngMod_trqCrSMin RngMod_trqInrBs RngMod_trqInrBsMin SpdGov_facComp SpdGov_trqEngPrtLimMech TMERng_etaChrg VehMot_rTrqDfftl VMD_tqCluDes zwopt_w_msg zzaehl_w_msg zzylzue_msg /end IN_MEASUREMENT
 /begin OUT_MEASUREMENT PT_tqAcsSync PT_tqCrSMinSync PT_tqDesENGT1 PT_tqDesENGT2 PT_tqEngENG16 PT_tqEngEstimtd PT_tqRelAirDes PT_tqRelAirDesSync PT_tqRelAirReq PT_tqRelAirReqSync PT_trqEngTrqToCvt PT_trqEngTrqToCvtSync /end OUT_MEASUREMENT
 /begin LOC_MEASUREMENT PT_facRedStgEff PT_facSprkEff Pt_flgAcOff PT_flgAcOn PT_flgAcOnOffSigPls PT_flgEngActv PT_flgEngLimActvDes PT_flgEngLimDesCdn PT_flgHiVTLarge PT_flgHiVTLargeSync PT_flgRateLimitActv PT_flgRateLimitActvSync PT_flgRateLimitArea PT_flgRateLimitAreaSync PT_flgRateLimitTrqDiff PT_flgRateLimitTrqDiffSync PT_flgTqVTLoHiOld PT_flgTqVTLoHiOldSync PT_flgVTSwt PT_flgVTSwtSync PT_flgZeroCrs PT_flgZeroCrsSync PT_rAirBasdOptTqDes PT_rAirBasdOptTqDesSync PT_rAirBasdOptTqReq PT_rAirBasdOptTqReqSync PT_rEngTq PT_tqCluDesCmp PT_tqCluDesWoIntv PT_tqCrksftDesOld PT_tqCrksftDesOldSync PT_tqEngCrksftEstimd PT_tqEngCrksftEstimdSync PT_tqEngEstimtdSync PT_tqEngEstimtdTmp PT_tqEngPrtLimMechInnr PT_tqInrSync PT_trqCrSHiVT PT_trqCrSHiVTSync PT_trqCrSLoVT PT_trqCrSLoVTSync PT_trqDiff PT_trqDiffSync PT_trqMax PT_trqMaxSync PT_trqTgtTrqCrS PT_trqTgtTrqCrSSync redistar TMECmb_IfEtaIaTqAct_I.HSPActv TMECmb_IfEtaIaTqAct_I.f2kazw TMECmb_IfEtaIaTqAct_I.flb TMECmb_IfEtaIaTqAct_I.lamsbg TMECmb_IfEtaIaTqAct_I.nEng TMECmb_IfEtaIaTqAct_I.rl TMECmb_IfEtaIaTqAct_I.rri TMECmb_IfEtaIaTqAct_I.split2ka /end LOC_MEASUREMENT
 FUNCTION_VERSION "27.0.0" /end FUNCTION
/begin FUNCTION PT_Grip "138.2.0   Drive train grip"
 /begin DEF_CHARACTERISTIC PT_flgNPosSnsrRdnt_C PT_GripCfg_CW PT_nMinAftIdle_MAP PT_rClthSlipDeb_C PT_rClthSlip_C PT_rConvSlipClsd_C PT_rConvSlipOpn_C PT_rConvSlip_C PT_rGripDfl_C PT_rGripHiThd_C PT_rGripLoThd_C PT_rGrip_C PT_rMaxThrAgChg_C PT_rMinEngLd_CUR PT_rMinThrAgChg_C PT_rNoGrip_C PT_stClthSensPrs_C PT_swtClthGrip_C PT_swtGripInfoSrcSeln_C PT_tiDebClthStSlip_C PT_tiThrOpngChg_C PT_vMinGrip_C /end DEF_CHARACTERISTIC
 /begin IN_MEASUREMENT B_ll_msg Clth3_st Clth_r Clth_st CoEng_bCtOffCon Epm_nEng Gbx_bHaltDisEgdActv Gbx_stConvClth Gbx_stPNPos mrfa_w_msg PT_stTraType rl_w_msg T50_st Tra_numGear VehV_v /end IN_MEASUREMENT
 /begin OUT_MEASUREMENT PT_bAutoStrtRls PT_bClthSlip PT_bClthSlipOpn PT_bConvSlip PT_bConvSlipClsd PT_bConvSlipOpn PT_bGrip PT_bNoGrip PT_nBgnIdle PT_rGrip PT_stClthDetd /end OUT_MEASUREMENT
 /begin LOC_MEASUREMENT PT_bIdleOvrSht PT_flgGripInfo PT_nDifIdlSpd PT_rDifThrAgReq PT_stClth /end LOC_MEASUREMENT
 FUNCTION_VERSION "138.2.0" /end FUNCTION
/begin FUNCTION PT_SetData "11.0.0    Drive train information"
 /begin IN_MEASUREMENT B_ll_msg Epm_dnEng Epm_nEng LsComp_tqResv PtCoornDyn_flgStabyIntvActvDes PtCoornDyn_flgStabyIntvDecActvDes PtCoornDyn_flgStabyIntvIncActvDes PtCoornDyn_flgTrsmIntvActvDes PtCoornDyn_flgTrsmIntvDecActvDes PtCoornDyn_flgTrsmIntvIncActvDes PtCoornDyn_tqCluDes PT_tqCluTrsmProtn SpdGov_st SpdGov_trqClthLimMechDes SpdGov_trqResvRel StatyCoorn_tqCluDesBefLimn VehMot_stPrpAccPed VehMot_stPrpCrCtl VehMot_stPrpLLim VehMot_tqCluDftlProtn /end IN_MEASUREMENT
 /begin OUT_MEASUREMENT PT_dnClth PT_nClth PT_stTqDem PT_tqResvEng /end OUT_MEASUREMENT
 FUNCTION_VERSION "11.0.0" /end FUNCTION
/begin FUNCTION PT_TqDataExt "1.7.1     Determination of relevant torque data delivered to external control units for torque interventions"
 /begin DEF_CHARACTERISTIC PT_dtqNegSlopSetWoIntv_M PT_dtqNegSlopWoTrsmIntv_M PT_dtqPosSlopSetWoIntv_C PT_dtqPosSlopSetWoTrsmIntv_C PT_flgSwtIntvDrvrDmdRstFco_C PT_flgSwtStabyIntvIncSetOverrun_C PT_flgSwtTrsmIntvIncSetOvrRun_C PT_flgTqRmpIALckDsbl_C PT_tiOverrunInactvTrsmIntvDec_C PT_tiOverrunInactvWoIntv_C PT_tqDifThdHysHiDrvDmdActv_C PT_tqDifThdHysLoDrvDmdActv_C /end DEF_CHARACTERISTIC
 /begin IN_MEASUREMENT ActMod_trqCrS ActMod_trqCrSWoIntv ActMod_trqCrSWoTraIntv CoVeh_trqAcs EngTrqPtd_trqSet InjSys_bInjVlvActv PtCoornDyn_flgStabyIntvActvDes PtCoornDyn_flgStabyIntvIncActvDes PtCoornDyn_flgTrsmIntvActvDes PtCoornDyn_flgTrsmIntvIncActvDes PTDist_tqCluSetStabyIntv PTDist_tqCluSetWoIntv PthSet_bIARlsNoIntv PthSet_bIARlsNoTraIntv PthSet_bOvrRun PthSet_trqRmpIALck RngMod_trqCrSMin RngMod_trqInrBs RngMod_trqInrBsMin RngMod_trqInrBsWoIntv Tra_numGear VMD_tqCluDes /end IN_MEASUREMENT
 /begin OUT_MEASUREMENT PT_tqCluEngAllIntvExt PT_tqCluEngWoIntvExt PT_tqCluEngWoTrsmIntvExt PT_tqCrksftSetWoIntv PT_tqCrksftSetWoTrsmIntv /end OUT_MEASUREMENT
 /begin LOC_MEASUREMENT PT_bDrvDmdActvWoIntv PT_bDrvDmdActvWoTrsmIntv PT_bOvrRunInactvIntvDes PT_bOvrRunInactvTrsmIntvDes PT_bOvrRunInactvWoIntv PT_bOvrRunInactvWoTrsmIntv PT_bSetOverrunStabyIntvIncActv PT_bSetOvrRunTrsmIntvIncActv PT_dtqNegSlopSetWoIntv PT_dtqNegSlopWoTrsmIntv PT_flgDrvDmdActv PT_flgDrvrDmdHLR_I PT_tqCluBsWoIntv PT_tqCluBsWoTrsmIntv PT_tqCluEngPtdSet PT_tqCluRmpIALckExt PT_tqCluSetWoIntvFcoLimd PT_tqCluSetWoIntvHemLimd PT_tqCluSetWoTrsmIntvFcoLimd PT_tqCluSetWoTrsmIntvHemLimd PT_tqCluTrsmWoIntv PT_tqCluTrsmWoTrsmIntv PT_tqCluWoIntv PT_tqCluWoTrsmIntv /end LOC_MEASUREMENT
 FUNCTION_VERSION "1.7.1" /end FUNCTION
/begin FUNCTION PT_TrqRat "2.6.0     Powertrain Torque Ratio"
 /begin DEF_CHARACTERISTIC PT_rTrqDfl_C PT_swtDetTypeCAN_C PT_swtTrqRatNoFrz_C PT_vMinTrqRat_C /end DEF_CHARACTERISTIC
 /begin IN_MEASUREMENT Gbx_rTrq GlbDa_vX PT_bGrip PT_bNoGrip PT_rTraGear PT_stTraType Tra_bRTraCan /end IN_MEASUREMENT
 /begin OUT_MEASUREMENT PT_rTrq PT_rTrqWoConvRat /end OUT_MEASUREMENT
 /begin LOC_MEASUREMENT PT_rTrqTmp1_mp PT_rTrqTmp2_mp /end LOC_MEASUREMENT
 FUNCTION_VERSION "2.6.0" /end FUNCTION
/begin FUNCTION rba_BypAdapt "1.44.0    Adapter to the DGS Bypass functionality"
 /begin DEF_CHARACTERISTIC rba_SvbbEtk_DisableProcExec_KWB rba_SvbbEtk_ResIdSrvPt_KWB rba_SvbbEtk_SrvPtEnabled_KWB rba_SvbbEtk_SrvPtResId_KWB rba_SvbbEtk_TimeOutPost_KWB rba_SvbbEtk_TimeOutPre_KWB /end DEF_CHARACTERISTIC
 FUNCTION_VERSION "1.44.0" /end FUNCTION
/begin FUNCTION rba_DcmCore_If "1.8.0     MSR Interface generator for Autosar DCM" FUNCTION_VERSION "1.8.0" /end FUNCTION
/begin FUNCTION rba_DiagAdapt "1.13.0    Adaption of the Diagcom Interfaces to Autosar DCM to enable usage of ComDia and DiaBas with DCM" FUNCTION_VERSION "1.13.0" /end FUNCTION
/begin FUNCTION rba_EepAdaptDGS "1.41.0    Eep adapter" /begin DEF_CHARACTERISTIC Eep_ClrWrCounter_CW Eep_EnFirstInit_CW Eep_EnvRamClr_CW /end DEF_CHARACTERISTIC /begin OUT_MEASUREMENT B_eepwf B_pwf Eep_EnvRamHist Eep_EnvRamInvld /end OUT_MEASUREMENT
 /begin LOC_MEASUREMENT Eep_ctAbsCallWrFkt Eep_ctCallWrFkt Eep_ctMaxCallWrFkt Eep_PostdrvBlkIdx_s16 Eep_stBlk Eep_stMain Eep_stPostDrv /end LOC_MEASUREMENT
 FUNCTION_VERSION "1.41.0" /end FUNCTION
/begin FUNCTION rba_MemDiag "2.9.0     OBD diagnosis for memory components"
 /begin OUT_MEASUREMENT rba_MemDiagExtd_nrLstReadSngErr rba_MemDiag_flgInhbDiag rba_MemDiag_nrLstReadErr rba_MemDiag_nrLstWrErr /end OUT_MEASUREMENT
 FUNCTION_VERSION "2.9.0" /end FUNCTION
/begin FUNCTION Reset_CallBack "8.5.0     callback function for Reset-Package"
 /begin IN_MEASUREMENT APP_rUnFlt BattU_u CoETS_rTrq Epm_nEng GlbDa_lTotDst T15_st VehV_v /end IN_MEASUREMENT
 /begin OUT_MEASUREMENT Reset_Env_ctRst Reset_Env_xGrp Reset_Env_xId /end OUT_MEASUREMENT
 /begin LOC_MEASUREMENT Reset_APP_rUnFlt Reset_BattU_u Reset_CoETS_rTrq Reset_Epm_nEng Reset_GlbDa_lTotDst Reset_T15_st Reset_VehV_v /end LOC_MEASUREMENT
 FUNCTION_VERSION "8.5.0" /end FUNCTION
/begin FUNCTION RngMod_TrqBsMod "159.0.0   Model of basic torque interface without intervention"
 /begin DEF_CHARACTERISTIC RngMod_deltaFacEtaWoIntv_C RngMod_deltaFacTrqOptWoIntv_C RngMod_TrqBsMod_CW /end DEF_CHARACTERISTIC
 /begin REF_CHARACTERISTIC DZWOLA ETALAM IgCtl_diaLamBascIa_T IgCtl_diaLamBasc_M IgCtl_facBascLamOperPnt_M IgCtl_flgOperPntDpdt_C KFMIOP /end REF_CHARACTERISTIC
 /begin IN_MEASUREMENT CoETS_bTraIntvActv CoETS_trqInrSetWoIntvWoCo CoETS_trqLimLead CoETS_trqUnFltLead CoPT_bTraPrtActvLead CoPT_bTraShftActvLead CoPT_trqDesCompEng CoVM_bSIActvDes CoVM_bSIActvLead Epm_nEng Epm_nEngLRes etafue_w_msg etalab_w_msg etazwbm_w_msg etazwmn_w_msg fmi2trq_w_msg ftrq2mi_w_msg Ign_iaBasNKC_s16 Ign_ia_LT Ign_ratChrgAirCyl IKCtl_agDynAdpnOffs_s8 IKCtl_agKnkAvrgGen_s8 InjSys_bInjVlvActv lambas_msg lambas_w_msg lams_w_msg mimax_w_msg miopt_w_msg PthLead_trqResv rldkmx_w_msg rlfgmnho_w_msg SpdGov_trqLead SyC_ctDrvEnter trlrlsol_w_msg zwopt_w_msg /end IN_MEASUREMENT
 /begin OUT_MEASUREMENT mimaxdk_w_msg RngMod_bTrqBsWoIntv RngMod_bTrqBsWoIntvByTra RngMod_trqInrBsMinWoIntv RngMod_trqInrBsWoIntv /end OUT_MEASUREMENT
 /begin LOC_MEASUREMENT etalabcg_w mioptogl_w mioptog_w mioptouf_w RngMod_facEtaWoIntv RngMod_facTrqOptWoIntv TMERng_ctDrvEntrTrqBasMod TMERng_facIaBasMinWoIntv TMERng_facIaBasWoIntv /end LOC_MEASUREMENT
 FUNCTION_VERSION "159.0.0" /end FUNCTION
/begin FUNCTION RngMod_TrqCalc "1.16.0    Calculation of Torque Ranges"
 /begin DEF_CHARACTERISTIC RngMod_swtTqResv_C RngMod_tiFltEtaIgnMin_C RngMod_TrqCalc_CW /end DEF_CHARACTERISTIC
 /begin IN_MEASUREMENT CoVeh_trqAcs EngDem_trqInrLim EngDem_trqInrLimLead EngReq_trqRngExlAct InjSys_bInjVlvActv InjSys_nrRedStgEnf PhyMod_etaIgnMin PthLead_trqResvRel RngMod_bEngActv RngMod_trqDiffAdap RngMod_trqInrBs RngMod_trqInrBsMin RngMod_trqInrBsMinAvrg RngMod_trqInrLeadMinAvl RngMod_trqInrMax RngMod_trqInrMaxAvl RngMod_trqInrOpt RngMod_trqLosEng TrqCnv_numRedStgDem /end IN_MEASUREMENT
 /begin OUT_MEASUREMENT RngMod_trqClthMin RngMod_trqCrSLeadMax RngMod_trqCrSLeadMaxAvl RngMod_trqCrSLimLead RngMod_trqCrSMin RngMod_trqCrSSetMax RngMod_trqCrSSetMaxAvl RngMod_trqCrSSetMin RngMod_trqCrSSetMinAvl RngMod_trqCrSSetMinCylFCO RngMod_trqCrSSetMinCylFCOTraIntv RngMod_trqLos TMERng_tqCrksftLeadMaxStabCdn /end OUT_MEASUREMENT
 /begin LOC_MEASUREMENT TMERng_etaCcoCurr /end LOC_MEASUREMENT
 FUNCTION_VERSION "1.16.0" /end FUNCTION
/begin FUNCTION RngMod_TrqChExchLoss "6.10.0    Torque losses by charge exchange"
 /begin DEF_CHARACTERISTIC TMELoss_swtPIntkRelAbs_C TMELoss_tqChrgExchIntkClsd_M TMELoss_tqChrgExchOutlOpen_M TMELoss_tqChrgExchOvlExh_M TMELoss_tqChrgExchOvl_M TMELoss_tqChrgExch_M /end DEF_CHARACTERISTIC
 /begin IN_MEASUREMENT Epm_nEng GEVCtl_agIntkClsd GEVCtl_agIntkOpen GEVCtl_agOutlOpen pabnav_w_msg PEnv_p psr_w_msg wgvum_w_msg /end IN_MEASUREMENT
 /begin OUT_MEASUREMENT RngMod_trqChrgExchLoss /end OUT_MEASUREMENT
 /begin LOC_MEASUREMENT TMELoss_pIntk TMELoss_tqChrgExchIntkClsdMap TMELoss_tqChrgExchMai TMELoss_tqChrgExchOutlOpenMap TMELoss_tqChrgExchOvlExhMap TMELoss_tqChrgExchOvlMap wgvum_w_Loc /end LOC_MEASUREMENT
 FUNCTION_VERSION "6.10.0" /end FUNCTION
/begin FUNCTION RngMod_TrqFrcAdpt "2.27.0    Adaption friction torque"
 /begin DEF_CHARACTERISTIC RngMod_bClth_C RngMod_facPwrDpdtFricLoss_M RngMod_nLIDvtMax_C RngMod_nMaxDes_C RngMod_nMinDes_C RngMod_phiThrVlvThres_C RngMod_stPrio_CUR RngMod_swtTqDmdAcsy_CW RngMod_tAdapMin_C RngMod_tiDetnQly_C RngMod_tiDmdAdpn_C RngMod_tiOffsRelsAdpn_C RngMod_tiRelsAdpn_C RngMod_tiTqAdpn_C RngMod_tiTqDifAdpn_C RngMod_trqDef_C RngMod_TrqFrcAdap_CW RngMod_trqLimMax_C RngMod_trqLimMin_C RngMod_trqMaxDes_C RngMod_trqMinDes_C RngMod_trqOfsLim_C RngMod_trqOfsQl_C RngMod_vLimTrans_C RngMod_vLim_C TMEAdpn_tGbxOilAdpnMin_T /end DEF_CHARACTERISTIC
 /begin IN_MEASUREMENT ACCtl_stOut ActMod_trqInr AirSys_bMinPsblIdcTrqRea AirSys_bThrVlvUnthr AirSys_rPhiThrVlv B_dtes_msg CEngDsT_t CoEng_bFrstStrtEnd CoEng_st Conv_tOil Conv_trqLd CoVeh_stEngStopOrd CoVeh_trqAcs EnvT_t Epm_nEng Gbx_stPNPos HLSDem_nSetPTrck InjSys_bMinPtdInjDurActv PT_stTraType PT_trqLos RngMod_trqLosEng SpdGov_st SyC_stSub VehV_v /end IN_MEASUREMENT
 /begin OUT_MEASUREMENT RngMod_bClth RngMod_bGenRls RngMod_nMaxDes RngMod_nMinDes RngMod_stAdap RngMod_stDrvState RngMod_stPrio RngMod_trqDiffAdap RngMod_trqFltACGear RngMod_trqFltACNoGear RngMod_trqFltNoACGear RngMod_trqFltNoACNoGear RngMod_trqLosTot RngMod_trqMaxDes RngMod_trqMinDes /end OUT_MEASUREMENT
 /begin LOC_MEASUREMENT RngMod_bRlsAdap RngMod_flgClrAdptFlt RngMod_flgDrvStChg RngMod_NumCycl RngMod_stAddRls RngMod_tqAdpnLoss_a RngMod_tqDmdAcsy RngMod_tqLossDif RngMod_trqAdapFlt RngMod_trqDiffAdapCalc RngMod_trqFltHom RngMod_trqLimMax RngMod_trqLimMin TMEAdpn_AdpnReldERNM_I.oldSignal /end LOC_MEASUREMENT
 FUNCTION_VERSION "2.27.0" /end FUNCTION
/begin FUNCTION RngMod_TrqMinCmb "1.6.0     Calculation of minimum torque with fired engine" /begin DEF_CHARACTERISTIC RngMod_facSpd_CUR RngMod_facTraRat_CUR /end DEF_CHARACTERISTIC
 /begin IN_MEASUREMENT Epm_nEng PT_rTrq RngMod_trqClthMin RngMod_trqCrSLeadMin RngMod_trqCrSLeadMinAvl RngMod_trqCrSMin /end IN_MEASUREMENT
 /begin OUT_MEASUREMENT RngMod_trqClthMinWoCtOff RngMod_trqCrSMinWoCtOff RngMod_trqInrMinWoCtOff /end OUT_MEASUREMENT
 /begin LOC_MEASUREMENT RngMod_nEng_LOC RngMod_rTrq_LOC /end LOC_MEASUREMENT
 FUNCTION_VERSION "1.6.0" /end FUNCTION
/begin FUNCTION RSSO_DySched "159.4.0_3.0.0RSSO Dysched file for MDG1 BSW" FUNCTION_VERSION "159.4.0_3.0.0" /end FUNCTION
/begin FUNCTION Rte "3.8.0     AUTOSAR Run Time Environment (RTE)" FUNCTION_VERSION "3.8.0" /end FUNCTION
/begin FUNCTION SIA_COMIFC "187.1.0   Immobilizer communication" /begin IN_MEASUREMENT Sia_bFirstRxn Sia_stHdShk /end IN_MEASUREMENT /begin OUT_MEASUREMENT Sia_stTimeMon /end OUT_MEASUREMENT /begin LOC_MEASUREMENT Sia_cntrCurrRxdByt /end LOC_MEASUREMENT FUNCTION_VERSION "187.1.0" /end FUNCTION
/begin FUNCTION SIA_Core "187.1.0   Immobilizer main module" /begin DEF_CHARACTERISTIC Sia_numfARCal_C /end DEF_CHARACTERISTIC FUNCTION_VERSION "187.1.0" /end FUNCTION
/begin FUNCTION SIA_EMSIFC "187.1.0   Immobilizer Interface"
 /begin DEF_CHARACTERISTIC Sia_EnGen6Support_C Sia_numCODE1_C Sia_numCODE2_C Sia_numCODE3_C Sia_numExcCod_C Sia_numExdCod_C Sia_swtCodEepUpd_C Sia_swtExCodUpdt_C Sia_swtIgnLckEep_C Sia_swtImsVal_C Sia_tiExRegTmrBMax_C Sia_tiTmrBMax_C /end DEF_CHARACTERISTIC
 /begin IN_MEASUREMENT CoEng_st Sia_stTimeMon SyC_stSub T15_st /end IN_MEASUREMENT
 /begin OUT_MEASUREMENT Sia_bFirstRxn Sia_stHdShk Sia_stIgnLck Sia_stOK /end OUT_MEASUREMENT
 /begin LOC_MEASUREMENT Sia_stfARAck_mp Sia_stImsState_mp /end LOC_MEASUREMENT
 FUNCTION_VERSION "187.1.0" /end FUNCTION
/begin FUNCTION SignalsExtd_Std "30000.0.0 Interface for readout of ECU internal measurement values extended" FUNCTION_VERSION "30000.0.0" /end FUNCTION
/begin COMPU_METHOD B_TRUE "" TAB_VERB "%6.3" "" COMPU_TAB_REF B_TRUE /end COMPU_METHOD
/begin COMPU_VTAB B_TRUE "" TAB_VERB 2 0 "FALSE" 1 "TRUE" /end COMPU_VTAB
/begin COMPU_METHOD dez "" RAT_FUNC "%6.2" "" COEFFS 0 1 0 0 0 1 /end COMPU_METHOD
/begin COMPU_METHOD Eep_MainStates_Verb "" TAB_VERB "%6.3" "" COMPU_TAB_REF Eep_MainStates_Verb /end COMPU_METHOD
/begin COMPU_VTAB Eep_MainStates_Verb "" TAB_VERB 15 0 "EEP_SHUTDWN_RUN" 1 "EEP_INI_RUN" 2 "EEP_MIGRATION_RUN" 3 "EEP_INI_INTERNAL" 4 "EEP_NORMAL_RUN" 5 "EEP_BEGPD_REQUEST" 6 "EEP_BEGPD_RUN" 7 "EEP_ENDPD_REQUEST" 8 "EEP_ENDPD_RUN" 9 "EEP_PREDRV_REQUEST" 10 "EEP_PREDRV_RUN" 11 "EEP_FIRSTINIT_INI" 12 "EEP_RAM_INI" 13 "EEP_ENVRAM_INI" 14 "EEP_REINIT_INI" /end COMPU_VTAB
/begin COMPU_METHOD Eep_PostDrvState_Verb "" TAB_VERB "%6.3" "" COMPU_TAB_REF Eep_PostDrvState_Verb /end COMPU_METHOD
/begin COMPU_VTAB Eep_PostDrvState_Verb "" TAB_VERB 5 0 "EEP_POSTDRV_INI" 1 "EEP_POSTDRV_SEARCHBLKIDX" 2 "EEP_POSTDRV_SAVEBLK" 3 "EEP_POSTDRV_SAVEBLK_PENDING" 4 "EEP_POSTDRV_WAIT" /end COMPU_VTAB
/begin COMPU_METHOD EngN "" RAT_FUNC "%6.3" "rpm" COEFFS 0 2 0 0 0 1 /end COMPU_METHOD
/begin COMPU_METHOD EngNGrd "" RAT_FUNC "%6.3" "rpm/s" COEFFS 0 2 0 0 0 1 /end COMPU_METHOD
/begin COMPU_METHOD Fact100 "" RAT_FUNC "%6.4" "-" COEFFS 0 100 0 0 0 1 /end COMPU_METHOD
/begin COMPU_METHOD fak_q0p000122 "" RAT_FUNC "%6.5" "1/(g*s)" COEFFS 0 65536 0 0 0 8 /end COMPU_METHOD
/begin COMPU_METHOD fak_q0p01 "" RAT_FUNC "%6.4" "" COEFFS 0 100 0 0 0 1 /end COMPU_METHOD
/begin COMPU_METHOD fak_q0p02 "" RAT_FUNC "%6.4" "" COEFFS 0 50 0 0 0 1 /end COMPU_METHOD
/begin COMPU_METHOD fak_q0p1 "" RAT_FUNC "%6.3" "-" COEFFS 0 1 0 0 0 0.1 /end COMPU_METHOD
/begin COMPU_METHOD fak_ub_b1 "" RAT_FUNC "%6.4" "-" COEFFS 0 256 0 0 0 1 /end COMPU_METHOD
/begin COMPU_METHOD fak_ub_b2 "" RAT_FUNC "%8.5" "-" COEFFS 0 256 0 0 0 2 /end COMPU_METHOD
/begin COMPU_METHOD fak_ub_q0p01 "" RAT_FUNC "%6.4" "-" COEFFS 0 1 0 0 0 0.01 /end COMPU_METHOD
/begin COMPU_METHOD fak_uw_b16 "" RAT_FUNC "%6.5" "-" COEFFS 0 65536 0 0 0 16 /end COMPU_METHOD
/begin COMPU_METHOD fak_uw_b2 "" RAT_FUNC "%7.6" "-" COEFFS 0 65536 0 0 0 2 /end COMPU_METHOD
/begin COMPU_METHOD fak_uw_b8 "" RAT_FUNC "%6.5" "-" COEFFS 0 65536 0 0 0 8 /end COMPU_METHOD
/begin COMPU_METHOD kw_q0p0156 "" RAT_FUNC "%6.4" "Grad KW" COEFFS 0 64 0 0 0 1 /end COMPU_METHOD
/begin COMPU_METHOD Length "" RAT_FUNC "%6.2" "m" COEFFS 0 1 0 0 0 1 /end COMPU_METHOD
/begin COMPU_METHOD mdgrad_q10 "" RAT_FUNC "%6.1" "Nm/s" COEFFS 0 1 0 0 0 10 /end COMPU_METHOD
/begin COMPU_METHOD md_q0p1 "" RAT_FUNC "%6.3" "Nm" COEFFS 0 10 0 0 0 1 /end COMPU_METHOD
/begin COMPU_METHOD md_sw_q0p1 "" RAT_FUNC "%6.3" "Nm" COEFFS 0 10 0 0 0 1 /end COMPU_METHOD
/begin COMPU_METHOD nmot_q0p25 "" RAT_FUNC "%6.3" "1/min" COEFFS 0 4 0 0 0 1 /end COMPU_METHOD
/begin COMPU_METHOD nmot_q0p5 "" RAT_FUNC "%6.3" "1/min" COEFFS 0 2 0 0 0 1 /end COMPU_METHOD
/begin COMPU_METHOD nmot_sw_q0p5 "" RAT_FUNC "%6.3" "1/min" COEFFS 0 2 0 0 0 1 /end COMPU_METHOD
/begin COMPU_METHOD nmot_uw_q0p25 "" RAT_FUNC "%6.3" "1/min" COEFFS 0 1 0 0 0 0.25 /end COMPU_METHOD
/begin COMPU_METHOD NmPerSec "" RAT_FUNC "%6.3" "Nm/s" COEFFS 0 10 0 0 0 1 /end COMPU_METHOD
/begin COMPU_METHOD OneToOne "" RAT_FUNC "%6.2" "-" COEFFS 0 1 0 0 0 1 /end COMPU_METHOD
/begin COMPU_METHOD Prc "" RAT_FUNC "%6.4" "%" COEFFS 0 81.92 0 0 0 1 /end COMPU_METHOD
/begin COMPU_METHOD Prc_Fact256 "" RAT_FUNC "%6.4" "%" COEFFS 0 256 0 0 0 1 /end COMPU_METHOD
/begin COMPU_METHOD p_q0p078 "" RAT_FUNC "%6.4" "hPa" COEFFS 0 64 0 0 0 5 /end COMPU_METHOD
/begin COMPU_METHOD p_sw_q0p078 "" RAT_FUNC "%6.4" "hPa" COEFFS 0 65536 0 0 0 5120 /end COMPU_METHOD
/begin COMPU_METHOD p_uw_q0p039 "" RAT_FUNC "%6.4" "hPa" COEFFS 0 256 0 0 0 10 /end COMPU_METHOD
/begin COMPU_METHOD p_uw_q0p078 "" RAT_FUNC "%6.4" "hPa" COEFFS 0 256 0 0 0 20 /end COMPU_METHOD
/begin COMPU_METHOD rba_SvbbEtk_SpName "" TAB_VERB "%6.3" "" COMPU_TAB_REF rba_SvbbEtk_SpName /end COMPU_METHOD
/begin COMPU_VTAB rba_SvbbEtk_SpName "" TAB_VERB 9 0 "Disable" 1 "rba_Svbb_DummyActivate" 2 "rba_SvbbEtk_Seg1Byp" 3 "rba_SvbbEtk_T10msByp" 4 "ReservedForEHooks_4" 5 "ReservedForEHooks_5" 6 "ReservedForEHooks_6" 7 "ReservedForEHooks_7" 8 "ReservedForEHooks_8" /end COMPU_VTAB
/begin COMPU_METHOD rba_Svbb_Time_us "" RAT_FUNC "%6.4" "" COEFFS 0 100 0 0 0 1 /end COMPU_METHOD
/begin COMPU_METHOD rel_q0p0234 "" RAT_FUNC "%6.4" "%" COEFFS 0 128 0 0 0 3 /end COMPU_METHOD
/begin COMPU_METHOD rel_sw_b100 "" RAT_FUNC "%6.4" "%" COEFFS 0 32768 0 0 0 100 /end COMPU_METHOD
/begin COMPU_METHOD rel_sw_b200 "" RAT_FUNC "%6.4" "%" COEFFS 0 65536 0 0 0 400 /end COMPU_METHOD
/begin COMPU_METHOD rel_sw_q0p02441 "" RAT_FUNC "%6.4" "%" COEFFS 0 65536 0 0 0 1600 /end COMPU_METHOD
/begin COMPU_METHOD rel_ub_b99p6 "" RAT_FUNC "%6.3" "%" COEFFS 0 256 0 0 0 100 /end COMPU_METHOD
/begin COMPU_METHOD rel_uw_b100 "" RAT_FUNC "%6.4" "%" COEFFS 0 65536 0 0 0 100 /end COMPU_METHOD
/begin COMPU_METHOD rel_uw_b200 "" RAT_FUNC "%6.4" "%" COEFFS 0 65536 0 0 0 200 /end COMPU_METHOD
/begin COMPU_METHOD rel_uw_b3072 "" RAT_FUNC "%6.4" "%" COEFFS 0 65536 0 0 0 3072 /end COMPU_METHOD
/begin COMPU_METHOD rel_uw_q0p0234 "" RAT_FUNC "%6.4" "%" COEFFS 0 32 0 0 0 0.75 /end COMPU_METHOD
/begin COMPU_METHOD RmpTrq "" RAT_FUNC "%6.4" "Nm/s" COEFFS 0 655.36 0 0 0 1 /end COMPU_METHOD
/begin COMPU_METHOD SY_TFLTKCD_Compu "" TAB_VERB "%6.3" "" COMPU_TAB_REF SY_TFLTKCD_Compu /end COMPU_METHOD
/begin COMPU_VTAB SY_TFLTKCD_Compu "" TAB_VERB 2 0 "DISABL" 1 "ENABL" /end COMPU_VTAB
/begin COMPU_METHOD SY_TFLTNK_Compu "" TAB_VERB "%6.3" "" COMPU_TAB_REF SY_TFLTNK_Compu /end COMPU_METHOD
/begin COMPU_VTAB SY_TFLTNK_Compu "" TAB_VERB 6 0 "NO_TEMP" 1 "MODEL" 2 "SENS" 3 "SENS_CAN" 4 "SENS_SENT" 255 "Customer_Object_Code" /end COMPU_VTAB
/begin COMPU_METHOD SY_TFMO_Compu "" TAB_VERB "%6.3" "" COMPU_TAB_REF SY_TFMO_Compu /end COMPU_METHOD
/begin COMPU_VTAB SY_TFMO_Compu "" TAB_VERB 2 0 "TMOT Sensor nicht als GGTFM Erstzwert" 1 "TMOT Sensor als GGTFM Erstzwert" /end COMPU_VTAB
/begin COMPU_METHOD SY_TFRK_Compu "" TAB_VERB "%6.3" "" COMPU_TAB_REF SY_TFRK_Compu /end COMPU_METHOD
/begin COMPU_VTAB SY_TFRK_Compu "" TAB_VERB 2 0 "kein Testereingriff Korrekturfaktor relative Kraft" 1 "Testereingriff Korrekturfaktor relative Kraftstoff" /end COMPU_VTAB
/begin COMPU_METHOD SY_TFSTQ_Compu "" TAB_VERB "%6.3" "" COMPU_TAB_REF SY_TFSTQ_Compu /end COMPU_METHOD
/begin COMPU_VTAB SY_TFSTQ_Compu "" TAB_VERB 3 1 "quantisation 0.1l/inc" 5 "quantisation 0.5l/inc" 10 "quantisation 1.0l/inc" /end COMPU_VTAB
/begin COMPU_METHOD SY_TFST_Compu "" TAB_VERB "%6.3" "" COMPU_TAB_REF SY_TFST_Compu /end COMPU_METHOD
/begin COMPU_VTAB SY_TFST_Compu "" TAB_VERB 2 0 "kein Testereingriff Startfaktor" 1 "Testereingriff Startfaktor" /end COMPU_VTAB
/begin COMPU_METHOD SY_TFUELCN_Compu "" TAB_VERB "%6.3" "" COMPU_TAB_REF SY_TFUELCN_Compu /end COMPU_METHOD
/begin COMPU_VTAB SY_TFUELCN_Compu "" TAB_VERB 8 0 "SY_TFUELCN = 0" 1 "SY_TFUELCN = 1" 2 "SY_TFUELCN = 2" 3 "SY_TFUELCN = 3" 4 "SY_TFUELCN = 4" 5 "SY_TFUELCN = 5" 6 "SY_TFUELCN = 6" 7 "SY_TFUELCN = 7" /end COMPU_VTAB
/begin COMPU_METHOD SY_TFUEL_Compu "" TAB_VERB "%6.3" "" COMPU_TAB_REF SY_TFUEL_Compu /end COMPU_METHOD
/begin COMPU_VTAB SY_TFUEL_Compu "" TAB_VERB 3 0 "NOTAVL" 1 "TFUELLP" 2 "TFUELLPHP" /end COMPU_VTAB
/begin COMPU_METHOD SY_TFVA_Compu "" TAB_VERB "%6.3" "" COMPU_TAB_REF SY_TFVA_Compu /end COMPU_METHOD
/begin COMPU_VTAB SY_TFVA_Compu "" TAB_VERB 2 0 "kein Testereingriff Verzögerungsabmagerung" 1 "Testereingriff Verzögerungsabmagerung" /end COMPU_VTAB
/begin COMPU_METHOD SY_TKAA_Compu "" TAB_VERB "%6.3" "" COMPU_TAB_REF SY_TKAA_Compu /end COMPU_METHOD
/begin COMPU_VTAB SY_TKAA_Compu "" TAB_VERB 2 0 "False" 1 "True" /end COMPU_VTAB
/begin COMPU_METHOD SY_TKACSD_Compu "" TAB_VERB "%6.3" "" COMPU_TAB_REF SY_TKACSD_Compu /end COMPU_METHOD
/begin COMPU_VTAB SY_TKACSD_Compu "" TAB_VERB 2 0 "False" 1 "True" /end COMPU_VTAB
/begin COMPU_METHOD SY_TKA_Compu "" TAB_VERB "%6.3" "" COMPU_TAB_REF SY_TKA_Compu /end COMPU_METHOD
/begin COMPU_VTAB SY_TKA_Compu "" TAB_VERB 2 0 "kein Kühlwassertemperatursensor am Kühleraustritt" 1 "Kühlwassertemperatursensor am Kühleraustritt" /end COMPU_VTAB
/begin COMPU_METHOD SY_TLDRMP_Compu "" TAB_VERB "%6.3" "" COMPU_TAB_REF SY_TLDRMP_Compu /end COMPU_METHOD
/begin COMPU_VTAB SY_TLDRMP_Compu "" TAB_VERB 2 0 "kein Robustheitmaßnahmenpaket" 1 "DTESK Robustheitmaßnahmenpaket" /end COMPU_VTAB
/begin COMPU_METHOD SY_TLRARES_Compu "" TAB_VERB "%6.3" "" COMPU_TAB_REF SY_TLRARES_Compu /end COMPU_METHOD
/begin COMPU_VTAB SY_TLRARES_Compu "" TAB_VERB 2 0 "FALSE" 1 "TRUE" /end COMPU_VTAB
/begin COMPU_METHOD SY_TMDR_Compu "" TAB_VERB "%6.3" "" COMPU_TAB_REF SY_TMDR_Compu /end COMPU_METHOD
/begin COMPU_VTAB SY_TMDR_Compu "" TAB_VERB 2 0 "kein Testereingriff Momentenreserve LL" 1 "Testereingriff Momentenreserve LL" /end COMPU_VTAB
/begin COMPU_METHOD SY_TMO2KA_Compu "" TAB_VERB "%6.3" "" COMPU_TAB_REF SY_TMO2KA_Compu /end COMPU_METHOD
/begin COMPU_VTAB SY_TMO2KA_Compu "" TAB_VERB 3 0 "no influence modelled" 1 "add-on calibration" 2 "independent calibration" /end COMPU_VTAB
/begin COMPU_METHOD SY_TMOHKS_Compu "" TAB_VERB "%6.3" "" COMPU_TAB_REF SY_TMOHKS_Compu /end COMPU_METHOD
/begin COMPU_VTAB SY_TMOHKS_Compu "" TAB_VERB 2 0 "no influence of HKS in torque model" 1 "consideration of HKS in torque model" /end COMPU_VTAB
/begin COMPU_METHOD SY_TMOHSST_Compu "" TAB_VERB "%6.3" "" COMPU_TAB_REF SY_TMOHSST_Compu /end COMPU_METHOD
/begin COMPU_VTAB SY_TMOHSST_Compu "" TAB_VERB 2 0 "0" 1 "1" /end COMPU_VTAB
/begin COMPU_METHOD SY_TMOLAMH_Compu "" TAB_VERB "%6.3" "" COMPU_TAB_REF SY_TMOLAMH_Compu /end COMPU_METHOD
/begin COMPU_VTAB SY_TMOLAMH_Compu "" TAB_VERB 2 0 "NO" 1 "STG1" /end COMPU_VTAB
/begin COMPU_METHOD SY_TMOLAM_Compu "" TAB_VERB "%6.3" "" COMPU_TAB_REF SY_TMOLAM_Compu /end COMPU_METHOD
/begin COMPU_VTAB SY_TMOLAM_Compu "" TAB_VERB 3 0 "no lambda influence in torque model" 1 "basic modelling" 2 "enhanced modelling" /end COMPU_VTAB
/begin COMPU_METHOD SY_TMOLB_Compu "" TAB_VERB "%6.3" "" COMPU_TAB_REF SY_TMOLB_Compu /end COMPU_METHOD
/begin COMPU_VTAB SY_TMOLB_Compu "" TAB_VERB 3 0 "torque model without charge motion" 1 "torque model with charge motion (basic)" 2 "torque model with charge motion (enhanced)" /end COMPU_VTAB
/begin COMPU_METHOD SY_TMORRI_Compu "" TAB_VERB "%6.3" "" COMPU_TAB_REF SY_TMORRI_Compu /end COMPU_METHOD
/begin COMPU_VTAB SY_TMORRI_Compu "" TAB_VERB 3 0 "torque model without residual gas rate" 1 "torque model with residual gas rate (basic)" 2 "torque model with residual gas rate (enhanced)" /end COMPU_VTAB
/begin COMPU_METHOD SY_TMSV_Compu "" TAB_VERB "%6.3" "" COMPU_TAB_REF SY_TMSV_Compu /end COMPU_METHOD
/begin COMPU_VTAB SY_TMSV_Compu "" TAB_VERB 3 0 "no_TMSV" 1 "ATS_TMSV" 2 "FAATS_TMSV" /end COMPU_VTAB
/begin COMPU_METHOD SY_TOCH_Compu "" TAB_VERB "%6.3" "" COMPU_TAB_REF SY_TOCH_Compu /end COMPU_METHOD
/begin COMPU_VTAB SY_TOCH_Compu "" TAB_VERB 3 0 "deaktivierte FG OTMTOCH" 1 "aktivierte FG OTMTOCH" 2 "aktivierte (16bit) FG OTMTOCH" /end COMPU_VTAB
/begin COMPU_METHOD SY_TOSPCN_Compu "" TAB_VERB "%6.3" "" COMPU_TAB_REF SY_TOSPCN_Compu /end COMPU_METHOD
/begin COMPU_VTAB SY_TOSPCN_Compu "" TAB_VERB 5 0 "NO_SENS" 1 "SG" 2 "CAN_VOLT" 3 "CAN_TEMP" 4 "LIN_TEMP" /end COMPU_VTAB
/begin COMPU_METHOD SY_TOSPMAI_Compu "" TAB_VERB "%6.3" "" COMPU_TAB_REF SY_TOSPMAI_Compu /end COMPU_METHOD
/begin COMPU_VTAB SY_TOSPMAI_Compu "" TAB_VERB 2 0 "DISABL" 1 "ENABL" /end COMPU_VTAB
/begin COMPU_METHOD SY_TOSP_Compu "" TAB_VERB "%6.3" "" COMPU_TAB_REF SY_TOSP_Compu /end COMPU_METHOD
/begin COMPU_VTAB SY_TOSP_Compu "" TAB_VERB 3 0 "deaktivierte FG OTMTOSPCP" 1 "aktivierte FG OTMTOSPCP" 2 "aktivierte (16bit-Wert) FG OTMTOSPCP" /end COMPU_VTAB
/begin COMPU_METHOD SY_TPEACNR_Compu "" TAB_VERB "%6.3" "" COMPU_TAB_REF SY_TPEACNR_Compu /end COMPU_METHOD
/begin COMPU_VTAB SY_TPEACNR_Compu "" TAB_VERB 2 0 "False" 1 "True" /end COMPU_VTAB
/begin COMPU_METHOD SY_TREDFCO_Compu "" TAB_VERB "%6.3" "" COMPU_TAB_REF SY_TREDFCO_Compu /end COMPU_METHOD
/begin COMPU_VTAB SY_TREDFCO_Compu "" TAB_VERB 2 0 "False" 1 "True" /end COMPU_VTAB
/begin COMPU_METHOD SY_TTEV_Compu "" TAB_VERB "%6.3" "" COMPU_TAB_REF SY_TTEV_Compu /end COMPU_METHOD
/begin COMPU_VTAB SY_TTEV_Compu "" TAB_VERB 2 0 "keine Stellglieddiagnose TEV möglich" 1 "Stellglieddiagnose TEV möglich" /end COMPU_VTAB
/begin COMPU_METHOD SY_TUMG_Compu "" TAB_VERB "%6.3" "" COMPU_TAB_REF SY_TUMG_Compu /end COMPU_METHOD
/begin COMPU_VTAB SY_TUMG_Compu "" TAB_VERB 4 0 "no source, signal not available" 1 "Sensor" 2 "tans" 3 "CAN" /end COMPU_VTAB
/begin COMPU_METHOD SY_TWDKS_Compu "" TAB_VERB "%6.3" "" COMPU_TAB_REF SY_TWDKS_Compu /end COMPU_METHOD
/begin COMPU_VTAB SY_TWDKS_Compu "" TAB_VERB 2 0 "kein Testereingriff Sollwinkel DVE aktiv" 1 "Testereingriff Sollwinkel DVE aktiv" /end COMPU_VTAB
/begin COMPU_METHOD SY_UBDEDIQ_Compu "" RAT_FUNC "%6.2" "" COEFFS 0 1 0 0 0 1 /end COMPU_METHOD
/begin COMPU_METHOD SY_UBDEDIS_Compu "" RAT_FUNC "%6.2" "" COEFFS 0 1 0 0 0 1 /end COMPU_METHOD
/begin COMPU_METHOD SY_UBDEENQ_Compu "" RAT_FUNC "%6.2" "" COEFFS 0 1 0 0 0 1 /end COMPU_METHOD
/begin COMPU_METHOD SY_UBDEEN_Compu "" RAT_FUNC "%6.2" "" COEFFS 0 1 0 0 0 1 /end COMPU_METHOD
/begin COMPU_METHOD SY_UBR_Compu "" TAB_VERB "%6.3" "" COMPU_TAB_REF SY_UBR_Compu /end COMPU_METHOD
/begin COMPU_VTAB SY_UBR_Compu "" TAB_VERB 2 0 "Signal Hauptrelaisspannung nicht vorhanden" 1 "Signal Hauptrelaisspannung vorhanden" /end COMPU_VTAB
/begin COMPU_METHOD SY_UBSQ_W_Compu "" RAT_FUNC "%6.2" "" COEFFS 0 1 0 0 0 1 /end COMPU_METHOD
/begin COMPU_METHOD SY_UKAUFL_Compu "" TAB_VERB "%6.3" "" COMPU_TAB_REF SY_UKAUFL_Compu /end COMPU_METHOD
/begin COMPU_VTAB SY_UKAUFL_Compu "" TAB_VERB 2 0 "no correction" 1 "correction depending of lamsbg_w" /end COMPU_VTAB
/begin COMPU_METHOD SY_VARCODE_Compu "" TAB_VERB "%6.3" "" COMPU_TAB_REF SY_VARCODE_Compu /end COMPU_METHOD
/begin COMPU_VTAB SY_VARCODE_Compu "" TAB_VERB 2 0 "Variantencodierung-Schnittstelle nicht freigegeben" 1 "Variantencodierung-Schnittstelle freigegeben" /end COMPU_VTAB
/begin COMPU_METHOD SY_VDEO_Compu "" TAB_VERB "%6.3" "" COMPU_TAB_REF SY_VDEO_Compu /end COMPU_METHOD
/begin COMPU_VTAB SY_VDEO_Compu "" TAB_VERB 3 0 "kein Verdichter verbaut" 1 "Verdichter vor Drosselklappe verbaut Verdichter v" 2 "Verdichter nach Drosselklappe verbaut" /end COMPU_VTAB
/begin COMPU_METHOD SY_VD_Compu "" TAB_VERB "%6.3" "" COMPU_TAB_REF SY_VD_Compu /end COMPU_METHOD
/begin COMPU_VTAB SY_VD_Compu "" TAB_VERB 4 0 "no booster" 1 "TC (ATL)" 2 "compressor" 3 "SC-E (EZV)" /end COMPU_VTAB
/begin COMPU_METHOD SY_VHAANZ_Compu "" TAB_VERB "%6.3" "" COMPU_TAB_REF SY_VHAANZ_Compu /end COMPU_METHOD
/begin COMPU_VTAB SY_VHAANZ_Compu "" TAB_VERB 5 0 "0" 1 "1" 2 "2" 3 "3" 4 "4" /end COMPU_VTAB
/begin COMPU_METHOD SY_VHA_Compu "" TAB_VERB "%6.3" "" COMPU_TAB_REF SY_VHA_Compu /end COMPU_METHOD
/begin COMPU_VTAB SY_VHA_Compu "" TAB_VERB 3 0 "0" 1 "1" 2 "2" /end COMPU_VTAB
/begin COMPU_METHOD SY_VHEANZ_Compu "" TAB_VERB "%6.3" "" COMPU_TAB_REF SY_VHEANZ_Compu /end COMPU_METHOD
/begin COMPU_VTAB SY_VHEANZ_Compu "" TAB_VERB 5 0 "0" 1 "1" 2 "2" 3 "3" 4 "4" /end COMPU_VTAB
/begin COMPU_METHOD SY_VHE_Compu "" TAB_VERB "%6.3" "" COMPU_TAB_REF SY_VHE_Compu /end COMPU_METHOD
/begin COMPU_VTAB SY_VHE_Compu "" TAB_VERB 3 0 "0" 1 "1" 2 "2" /end COMPU_VTAB
/begin COMPU_METHOD SY_VS_Compu "" TAB_VERB "%6.3" "" COMPU_TAB_REF SY_VS_Compu /end COMPU_METHOD
/begin COMPU_VTAB SY_VS_Compu "" TAB_VERB 2 0 "keine Ventilhubsteuerung vorhanden" 1 "Ventilhubsteuerung vorhanden" /end COMPU_VTAB
/begin COMPU_METHOD SY_VVT_Compu "" RAT_FUNC "%6.2" "" COEFFS 0 1 0 0 0 1 /end COMPU_METHOD
/begin COMPU_METHOD SY_WFS_Compu "" RAT_FUNC "%6.2" "" COEFFS 0 1 0 0 0 1 /end COMPU_METHOD
/begin COMPU_METHOD SY_WGPS_Compu "" TAB_VERB "%6.3" "" COMPU_TAB_REF SY_WGPS_Compu /end COMPU_METHOD
/begin COMPU_VTAB SY_WGPS_Compu "" TAB_VERB 2 0 "False" 1 "True" /end COMPU_VTAB
/begin COMPU_METHOD SY_WMIN_Compu "" RAT_FUNC "%6.2" "" COEFFS 0 1 0 0 0 1 /end COMPU_METHOD
/begin COMPU_METHOD SY_WNBM_Compu "" RAT_FUNC "%6.2" "" COEFFS 0 1 0 0 0 1 /end COMPU_METHOD
/begin COMPU_METHOD SY_WNWADM_Compu "" TAB_VERB "%6.3" "" COMPU_TAB_REF SY_WNWADM_Compu /end COMPU_METHOD
/begin COMPU_VTAB SY_WNWADM_Compu "" TAB_VERB 2 0 "Correction of camshaft angles by cam adaptation" 1 "No correction of cam angles by cam adapdaptation" /end COMPU_VTAB
/begin COMPU_METHOD SY_ZAGPATTERNMX_Compu "" RAT_FUNC "%6.2" "" COEFFS 0 1 0 0 0 1 /end COMPU_METHOD
/begin COMPU_METHOD SY_ZBLRELS_Compu "" TAB_VERB "%6.3" "" COMPU_TAB_REF SY_ZBLRELS_Compu /end COMPU_METHOD
/begin COMPU_VTAB SY_ZBLRELS_Compu "" TAB_VERB 3 0 "SY_ZBLRELS_0" 1 "SY_ZBLRELS_1" 2 "SY_ZBLRELS_2" /end COMPU_VTAB
/begin COMPU_METHOD SY_ZCSTES_Compu "" TAB_VERB "%6.3" "" COMPU_TAB_REF SY_ZCSTES_Compu /end COMPU_METHOD
/begin COMPU_VTAB SY_ZCSTES_Compu "" TAB_VERB 2 0 "False" 1 "True" /end COMPU_VTAB
/begin COMPU_METHOD SY_ZGST_Compu "" TAB_VERB "%6.3" "" COMPU_TAB_REF SY_ZGST_Compu /end COMPU_METHOD
/begin COMPU_VTAB SY_ZGST_Compu "" TAB_VERB 3 0 "SY_ZGST_0" 1 "SY_ZGST_1" 2 "SY_ZGST_2" /end COMPU_VTAB
/begin COMPU_METHOD SY_ZIZVW_Compu "" TAB_VERB "%6.3" "" COMPU_TAB_REF SY_ZIZVW_Compu /end COMPU_METHOD
/begin COMPU_VTAB SY_ZIZVW_Compu "" TAB_VERB 2 0 "keine zylinderindividuelle ZW-Verstellung möglich" 1 "zylinderindividuelle ZW-Verstellung möglich" /end COMPU_VTAB
/begin COMPU_METHOD SY_ZMS_Compu "" TAB_VERB "%6.3" "" COMPU_TAB_REF SY_ZMS_Compu /end COMPU_METHOD
/begin COMPU_VTAB SY_ZMS_Compu "" TAB_VERB 2 0 "kein Zweimassenschwungrad Schutz ist aktiv" 1 "Zweimassenschwungrad Schutz ist aktiv" /end COMPU_VTAB
/begin COMPU_METHOD SY_ZNDAUS_Compu "" TAB_VERB "%6.3" "" COMPU_TAB_REF SY_ZNDAUS_Compu /end COMPU_METHOD
/begin COMPU_VTAB SY_ZNDAUS_Compu "" TAB_VERB 4 1 "Single_ended_ignition coil" 2 "Double_ended_ignition coil" 3 "single_ended_ignition_coil_with_twinspark_ignition" 4 "calibratable_ignition_coil" /end COMPU_VTAB
/begin COMPU_METHOD SY_ZUESTA_Compu "" TAB_VERB "%6.3" "" COMPU_TAB_REF SY_ZUESTA_Compu /end COMPU_METHOD
/begin COMPU_VTAB SY_ZUESTA_Compu "" TAB_VERB 2 0 "False" 1 "True" /end COMPU_VTAB
/begin COMPU_METHOD SY_ZYLOFFH_Compu "" RAT_FUNC "%6.2" "" COEFFS 0 1 0 0 0 1 /end COMPU_METHOD
/begin COMPU_METHOD SY_ZYLOFFS_Compu "" RAT_FUNC "%6.2" "" COEFFS 0 1 0 0 0 1 /end COMPU_METHOD
/begin COMPU_METHOD SY_ZYLZA_Compu "" TAB_VERB "%6.3" "" COMPU_TAB_REF SY_ZYLZA_Compu /end COMPU_METHOD
/begin COMPU_VTAB SY_ZYLZA_Compu "" TAB_VERB 11 1 "1" 2 "2" 3 "3" 4 "4" 5 "5" 6 "6" 8 "8" 10 "10" 12 "12" 16 "16" 18 "18" /end COMPU_VTAB
/begin COMPU_METHOD SY_ZYLZG_Compu "" RAT_FUNC "%6.2" "" COEFFS 0 1 0 0 0 1 /end COMPU_METHOD
/begin COMPU_METHOD SY_ZZBANKB_Compu "" RAT_FUNC "%6.2" "" COEFFS 0 1 0 0 0 1 /end COMPU_METHOD
/begin COMPU_METHOD SY_ZZBANK_Compu "" RAT_FUNC "%6.2" "" COEFFS 0 1 0 0 0 1 /end COMPU_METHOD
/begin COMPU_METHOD SY_ZZHMB_Compu "" RAT_FUNC "%6.2" "" COEFFS 0 1 0 0 0 1 /end COMPU_METHOD
/begin COMPU_METHOD SY_ZZLAM_Compu "" TAB_VERB "%6.3" "" COMPU_TAB_REF SY_ZZLAM_Compu /end COMPU_METHOD
/begin COMPU_VTAB SY_ZZLAM_Compu "" TAB_VERB 2 0 "keine zylinderindividuelle Lambdaregelung" 1 "zylinderindividuelle Lambdaregelung vorhanden" /end COMPU_VTAB
/begin COMPU_METHOD SY_ZZMBA_Compu "" RAT_FUNC "%6.2" "" COEFFS 0 1 0 0 0 1 /end COMPU_METHOD
/begin COMPU_METHOD SY_ZZRL_Compu "" RAT_FUNC "%6.2" "" COEFFS 0 1 0 0 0 1 /end COMPU_METHOD
/begin COMPU_METHOD SY_ZZSG_Compu "" RAT_FUNC "%6.2" "" COEFFS 0 1 0 0 0 1 /end COMPU_METHOD
/begin COMPU_METHOD SY_ZZYLB1_Compu "" RAT_FUNC "%6.2" "" COEFFS 0 1 0 0 0 1 /end COMPU_METHOD
/begin COMPU_METHOD SY_ZZYLB2_Compu "" RAT_FUNC "%6.2" "" COEFFS 0 1 0 0 0 1 /end COMPU_METHOD
/begin COMPU_METHOD t10msxs_uw_b655p35 "" RAT_FUNC "%6.4" "s" COEFFS 0 1 0 0 0 0.01 /end COMPU_METHOD
/begin COMPU_METHOD T15RAWDSQENA_SC_Compu "" TAB_VERB "%6.3" "" COMPU_TAB_REF T15RAWDSQENA_SC_Compu /end COMPU_METHOD
/begin COMPU_VTAB T15RAWDSQENA_SC_Compu "" TAB_VERB 2 0 "Disabled" 1 "Enabled" /end COMPU_VTAB
/begin COMPU_METHOD T15_WKDETN_SC_Compu "" TAB_VERB "%6.3" "" COMPU_TAB_REF T15_WKDETN_SC_Compu /end COMPU_METHOD
/begin COMPU_VTAB T15_WKDETN_SC_Compu "" TAB_VERB 2 0 "False" 1 "True" /end COMPU_VTAB
/begin COMPU_METHOD T50_ATS_SY_Compu "" TAB_VERB "%6.3" "" COMPU_TAB_REF T50_ATS_SY_Compu /end COMPU_METHOD
/begin COMPU_VTAB T50_ATS_SY_Compu "" TAB_VERB 2 0 "T50_ATS_DISABLED" 1 "T50_ATS_ENABLED" /end COMPU_VTAB
/begin COMPU_METHOD T87_MON_SY_Compu "" TAB_VERB "%6.3" "" COMPU_TAB_REF T87_MON_SY_Compu /end COMPU_METHOD
/begin COMPU_VTAB T87_MON_SY_Compu "" TAB_VERB 2 0 "No Diag for Open Load" 1 "Open Load Diag active" /end COMPU_VTAB
/begin COMPU_METHOD TAIRCMPRDSMDL_SC_Compu "" TAB_VERB "%6.3" "" COMPU_TAB_REF TAIRCMPRDSMDL_SC_Compu /end COMPU_METHOD
/begin COMPU_VTAB TAIRCMPRDSMDL_SC_Compu "" TAB_VERB 2 0 "MDL_NO" 1 "MDL_OVER_CMPR" /end COMPU_VTAB
/begin COMPU_METHOD TANKLEAKDIAGATLD_SC_Compu "" TAB_VERB "%6.3" "" COMPU_TAB_REF TANKLEAKDIAGATLD_SC_Compu /end COMPU_METHOD
/begin COMPU_VTAB TANKLEAKDIAGATLD_SC_Compu "" TAB_VERB 2 0 "False" 1 "True" /end COMPU_VTAB
/begin COMPU_METHOD TANKLEAKDIAGELCM_SC_Compu "" TAB_VERB "%6.3" "" COMPU_TAB_REF TANKLEAKDIAGELCM_SC_Compu /end COMPU_METHOD
/begin COMPU_VTAB TANKLEAKDIAGELCM_SC_Compu "" TAB_VERB 2 0 "False" 1 "True" /end COMPU_VTAB
/begin COMPU_METHOD TANKPSNSRNR_SC_Compu "" TAB_VERB "%6.3" "" COMPU_TAB_REF TANKPSNSRNR_SC_Compu /end COMPU_METHOD
/begin COMPU_VTAB TANKPSNSRNR_SC_Compu "" TAB_VERB 4 0 "NO" 1 "ONE" 2 "TWO" 3 "THREE" /end COMPU_VTAB
/begin COMPU_METHOD TBLOWBYHEATR_TYPAVL_SC_Compu "" TAB_VERB "%6.3" "" COMPU_TAB_REF TBLOWBYHEATR_TYPAVL_SC_Compu /end COMPU_METHOD
/begin COMPU_VTAB TBLOWBYHEATR_TYPAVL_SC_Compu "" TAB_VERB 2 0 "False" 1 "True" /end COMPU_VTAB
/begin COMPU_METHOD TCAT2DMDL_SC_Compu "" TAB_VERB "%6.3" "" COMPU_TAB_REF TCAT2DMDL_SC_Compu /end COMPU_METHOD
/begin COMPU_VTAB TCAT2DMDL_SC_Compu "" TAB_VERB 2 0 "0" 1 "1" /end COMPU_VTAB
/begin COMPU_METHOD TCE_FCOEXTD_SC_Compu "" TAB_VERB "%6.3" "" COMPU_TAB_REF TCE_FCOEXTD_SC_Compu /end COMPU_METHOD
/begin COMPU_VTAB TCE_FCOEXTD_SC_Compu "" TAB_VERB 2 0 "False" 1 "True" /end COMPU_VTAB
/begin COMPU_METHOD TCE_VAR_SY_Compu "" TAB_VERB "%6.3" "" COMPU_TAB_REF TCE_VAR_SY_Compu /end COMPU_METHOD
/begin COMPU_VTAB TCE_VAR_SY_Compu "" TAB_VERB 49 0 "kein Kundenbezug" 1 "DAI" 3 "VWW" 4 "POR" 5 "AUD" 6 "OPE" 9 "FIA" 11 "BMW" 14 "PSA" 15 "REN" 17 "ALF" 18 "SAB" 19 "VOL" 20 "NIS" 21 "GMU" 22 "FOR" 26 "IMJ" 36 "MAN" 51 "SEA" 53 "CHR" 54 "JAG" 55 "ROL" 69 "FER" 72 "TOY" 123 "MIT" 147 "HYU" 159 "HON" 160 "MAZ" 183 "CU" 190 "LRG" 204 "VVW" 214 "AVT" 242 "Iveco" 243 "DMC" 248 "SUZ" 267 "SSANGYONG" 270 "KEF" 289 "AMG" 308 "TAT" 319 "MVM" 385 "UAES" 578 "AL" 590 "SCANIA" 760 "WEICHAI" 828 "RBCD" 966 "International" 999 "ALL" 2887 "NONOX" 9454 "Fuso" /end COMPU_VTAB
/begin COMPU_METHOD TCSOVRDSTSCINC_SY_Compu "" TAB_VERB "%6.3" "" COMPU_TAB_REF TCSOVRDSTSCINC_SY_Compu /end COMPU_METHOD
/begin COMPU_VTAB TCSOVRDSTSCINC_SY_Compu "" TAB_VERB 2 0 "incr. TSC interv. overrides TCS interv." 1 "TCS interv. overrides incr. TSC interv." /end COMPU_VTAB
/begin COMPU_METHOD TDC_ADAP_SY_Compu "" TAB_VERB "%6.3" "" COMPU_TAB_REF TDC_ADAP_SY_Compu /end COMPU_METHOD
/begin COMPU_VTAB TDC_ADAP_SY_Compu "" TAB_VERB 4 0 "NO_TDC_ADAP" 1 "TDC_ADAP" 2 "TDC_ADAP_CPP" 3 "STAT_TDC_ADAP" /end COMPU_VTAB
/begin COMPU_METHOD TDC_UNEQLGEOM_SY_Compu "" TAB_VERB "%6.3" "" COMPU_TAB_REF TDC_UNEQLGEOM_SY_Compu /end COMPU_METHOD
/begin COMPU_VTAB TDC_UNEQLGEOM_SY_Compu "" TAB_VERB 2 0 "EQL_TDC" 1 "UNEQL_TDC" /end COMPU_VTAB
/begin COMPU_METHOD TDEV_DSQACTVT_SC_Compu "" TAB_VERB "%6.3" "" COMPU_TAB_REF TDEV_DSQACTVT_SC_Compu /end COMPU_METHOD
/begin COMPU_VTAB TDEV_DSQACTVT_SC_Compu "" TAB_VERB 2 0 "Inactive" 1 "Active" /end COMPU_VTAB
/begin COMPU_METHOD Temp_Cels "" RAT_FUNC "%6.1" "deg C" COEFFS 0 10 2731.4 0 0 1 /end COMPU_METHOD
/begin COMPU_METHOD temp_q0p1_o273 "" RAT_FUNC "%6.1" "Grad C" COEFFS 0 10 2731.4 0 0 1 /end COMPU_METHOD
/begin COMPU_METHOD Time_Dt "" RAT_FUNC "%9.8" "s" COEFFS 0 1000000 0 0 0 1 /end COMPU_METHOD
/begin COMPU_METHOD Time_ms "" RAT_FUNC "%6.1" "ms" COEFFS 0 0.1 0 0 0 1 /end COMPU_METHOD
/begin COMPU_METHOD Time_ms_DT "" RAT_FUNC "%6.5" "ms" COEFFS 0 1000 0 0 0 1 /end COMPU_METHOD
/begin COMPU_METHOD Time_s "" RAT_FUNC "%6.4" "s" COEFFS 0 100 0 0 0 1 /end COMPU_METHOD
/begin COMPU_METHOD TransR "" RAT_FUNC "%6.4" "-" COEFFS 0 100 0 0 0 1 /end COMPU_METHOD
/begin COMPU_METHOD Trq "" RAT_FUNC "%6.3" "Nm" COEFFS 0 10 0 0 0 1 /end COMPU_METHOD
/begin COMPU_METHOD TrqPrpHigh "" RAT_FUNC "%6.3" "Nm" COEFFS 0 10 0 0 0 1 /end COMPU_METHOD
/begin COMPU_METHOD t_q0p01 "" RAT_FUNC "%6.4" "s" COEFFS 0 100 0 0 0 1 /end COMPU_METHOD
/begin COMPU_METHOD Vel "" RAT_FUNC "%6.4" "km/h" COEFFS 0 100 0 0 0 1 /end COMPU_METHOD
/begin COMPU_METHOD vel_q0p01 "" RAT_FUNC "%6.4" "km/h" COEFFS 0 100 0 0 0 1 /end COMPU_METHOD
/begin COMPU_METHOD Volt_Batt "" RAT_FUNC "%6.1" "mV" COEFFS 0 0.05 0 0 0 1 /end COMPU_METHOD
/begin COMPU_METHOD zk10msxs_uw_b655p36 "" RAT_FUNC "%6.2" "s" COEFFS 0 0 65536 0 100 0 /end COMPU_METHOD
/begin RECORD_LAYOUT RB_Curve_S16_S16 NO_AXIS_PTS_X 1 SWORD AXIS_PTS_X 2 SWORD INDEX_INCR DIRECT FNC_VALUES 3 SWORD COLUMN_DIR DIRECT /end RECORD_LAYOUT
/begin RECORD_LAYOUT RB_Curve_S16_U16_Static NO_AXIS_PTS_X 1 SWORD AXIS_PTS_X 2 SWORD INDEX_INCR DIRECT FNC_VALUES 3 UWORD COLUMN_DIR DIRECT STATIC_RECORD_LAYOUT /end RECORD_LAYOUT
/begin RECORD_LAYOUT RB_Curve_S8_U8_Static NO_AXIS_PTS_X 1 SBYTE AXIS_PTS_X 2 SBYTE INDEX_INCR DIRECT FNC_VALUES 3 UBYTE COLUMN_DIR DIRECT STATIC_RECORD_LAYOUT /end RECORD_LAYOUT
/begin RECORD_LAYOUT RB_Curve_U16_S16_Static NO_AXIS_PTS_X 1 UWORD AXIS_PTS_X 2 UWORD INDEX_INCR DIRECT FNC_VALUES 3 SWORD COLUMN_DIR DIRECT STATIC_RECORD_LAYOUT /end RECORD_LAYOUT
/begin RECORD_LAYOUT RB_Curve_U16_U16 NO_AXIS_PTS_X 1 UWORD AXIS_PTS_X 2 UWORD INDEX_INCR DIRECT FNC_VALUES 3 UWORD COLUMN_DIR DIRECT /end RECORD_LAYOUT
/begin RECORD_LAYOUT RB_Curve_U16_U8_Static NO_AXIS_PTS_X 1 UWORD AXIS_PTS_X 2 UWORD INDEX_INCR DIRECT FNC_VALUES 3 UBYTE COLUMN_DIR DIRECT STATIC_RECORD_LAYOUT /end RECORD_LAYOUT
/begin RECORD_LAYOUT RB_Curve_U8_U8 NO_AXIS_PTS_X 1 UBYTE AXIS_PTS_X 2 UBYTE INDEX_INCR DIRECT FNC_VALUES 3 UBYTE COLUMN_DIR DIRECT /end RECORD_LAYOUT
/begin RECORD_LAYOUT RB_Map_S16S16_S16 NO_AXIS_PTS_X 1 SWORD NO_AXIS_PTS_Y 2 SWORD AXIS_PTS_X 3 SWORD INDEX_INCR DIRECT AXIS_PTS_Y 4 SWORD INDEX_INCR DIRECT FNC_VALUES 5 SWORD COLUMN_DIR DIRECT /end RECORD_LAYOUT
/begin RECORD_LAYOUT RB_Map_S16S16_S32 NO_AXIS_PTS_X 1 SWORD NO_AXIS_PTS_Y 2 SWORD AXIS_PTS_X 3 SWORD INDEX_INCR DIRECT AXIS_PTS_Y 4 SWORD INDEX_INCR DIRECT FNC_VALUES 5 SLONG COLUMN_DIR DIRECT /end RECORD_LAYOUT
/begin RECORD_LAYOUT RB_Map_S16S16_U8 NO_AXIS_PTS_X 1 SWORD NO_AXIS_PTS_Y 2 SWORD AXIS_PTS_X 3 SWORD INDEX_INCR DIRECT AXIS_PTS_Y 4 SWORD INDEX_INCR DIRECT FNC_VALUES 5 UBYTE COLUMN_DIR DIRECT /end RECORD_LAYOUT
/begin RECORD_LAYOUT RB_Map_S16U16_U16 NO_AXIS_PTS_X 1 SWORD NO_AXIS_PTS_Y 2 SWORD AXIS_PTS_X 3 SWORD INDEX_INCR DIRECT AXIS_PTS_Y 4 UWORD INDEX_INCR DIRECT FNC_VALUES 5 UWORD ROW_DIR DIRECT /end RECORD_LAYOUT
/begin RECORD_LAYOUT RB_Map_S8S16_S16 NO_AXIS_PTS_X 1 SBYTE NO_AXIS_PTS_Y 2 SBYTE AXIS_PTS_X 3 SBYTE INDEX_INCR DIRECT AXIS_PTS_Y 4 SWORD INDEX_INCR DIRECT FNC_VALUES 5 SWORD ROW_DIR DIRECT /end RECORD_LAYOUT
/begin RECORD_LAYOUT RB_Map_U16S16_S16 NO_AXIS_PTS_X 1 UWORD NO_AXIS_PTS_Y 2 UWORD AXIS_PTS_X 3 UWORD INDEX_INCR DIRECT AXIS_PTS_Y 4 SWORD INDEX_INCR DIRECT FNC_VALUES 5 SWORD COLUMN_DIR DIRECT /end RECORD_LAYOUT
/begin RECORD_LAYOUT RB_Val_Wboolean FNC_VALUES 1 UBYTE COLUMN_DIR DIRECT /end RECORD_LAYOUT
/begin RECORD_LAYOUT RB_Val_Ws16 FNC_VALUES 1 SWORD COLUMN_DIR DIRECT /end RECORD_LAYOUT
/begin RECORD_LAYOUT RB_Val_Ws32 FNC_VALUES 1 SLONG COLUMN_DIR DIRECT /end RECORD_LAYOUT
/begin RECORD_LAYOUT RB_Val_Ws8 FNC_VALUES 1 SBYTE COLUMN_DIR DIRECT /end RECORD_LAYOUT
/begin RECORD_LAYOUT RB_Val_Wu16 FNC_VALUES 1 UWORD COLUMN_DIR DIRECT /end RECORD_LAYOUT
/begin RECORD_LAYOUT RB_Val_Wu32 FNC_VALUES 1 ULONG COLUMN_DIR DIRECT /end RECORD_LAYOUT
/begin RECORD_LAYOUT RB_Val_Wu8 FNC_VALUES 1 UBYTE COLUMN_DIR DIRECT /end RECORD_LAYOUT
/begin RECORD_LAYOUT ValA_Wu16 FNC_VALUES 1 UWORD COLUMN_DIR DIRECT /end RECORD_LAYOUT
/begin RECORD_LAYOUT ValA_Wu8 FNC_VALUES 1 UBYTE COLUMN_DIR DIRECT /end RECORD_LAYOUT
/begin RECORD_LAYOUT Val_Wu8 FNC_VALUES 1 UBYTE COLUMN_DIR DIRECT /end RECORD_LAYOUT
/end MODULE
/end PROJECT
