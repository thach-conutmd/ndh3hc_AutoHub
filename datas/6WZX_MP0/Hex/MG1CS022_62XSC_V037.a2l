ASAP2_VERSION 1 60
/begin PROJECT MG1CS022 "MG1CS022"
/begin HEADER "" VERSION "MG1CS022_62XSC_V037" PROJECT_NO MG1CS022 /end HEADER
/begin MODULE DIM ""
/begin MOD_COMMON "" BYTE_ORDER MSB_LAST ALIGNMENT_BYTE 1 ALIGNMENT_WORD 2 ALIGNMENT_LONG 4 ALIGNMENT_INT64 4 ALIGNMENT_FLOAT32_IEEE 4 ALIGNMENT_FLOAT64_IEEE 4 DATA_SIZE 32 /end MOD_COMMON
/begin CHARACTERISTIC DINH_FId.DFC_AAVEmax_CA "inhibitable FIds / FIds to be inhibited by inhibit source DFC_AAVEmax" VAL_BLK 0x804D9D92 ValA_Wu16 968.000000000 DINH_FIdVerb 0.00 968.000000000 FORMAT "%13.9" NUMBER 59 /end CHARACTERISTIC
/begin CHARACTERISTIC DINH_FId.DFC_AAVEmin_CA "inhibitable FIds / FIds to be inhibited by inhibit source DFC_AAVEmin" VAL_BLK 0x804D9E08 ValA_Wu16 968.000000000 DINH_FIdVerb 0.00 968.000000000 FORMAT "%13.9" NUMBER 60 /end CHARACTERISTIC
/begin CHARACTERISTIC DINH_FId.DFC_AAVEsig_CA "inhibitable FIds / FIds to be inhibited by inhibit source DFC_AAVEsig" VAL_BLK 0x804D9E80 ValA_Wu16 968.000000000 DINH_FIdVerb 0.00 968.000000000 FORMAT "%13.9" NUMBER 59 /end CHARACTERISTIC
/begin CHARACTERISTIC DINH_FId.DFC_AltIOACGFailr_CA "inhibitable FIds / FIds to be inhibited by inhibit source DFC_AltIOACGFailr" VAL_BLK 0x804D9EF6 ValA_Wu16 968.000000000 DINH_FIdVerb 0.00 968.000000000 FORMAT "%13.9" NUMBER 65 /end CHARACTERISTIC
/begin CHARACTERISTIC DINH_FId.DFC_AltIOACGHiVltg_CA "inhibitable FIds / FIds to be inhibited by inhibit source DFC_AltIOACGHiVltg" VAL_BLK 0x804D9F78 ValA_Wu16 968.000000000 DINH_FIdVerb 0.00 968.000000000 FORMAT "%13.9" NUMBER 65 /end CHARACTERISTIC
/begin CHARACTERISTIC DINH_FId.DFC_AltIOACGLoVltg_CA "inhibitable FIds / FIds to be inhibited by inhibit source DFC_AltIOACGLoVltg" VAL_BLK 0x804D9FFA ValA_Wu16 968.000000000 DINH_FIdVerb 0.00 968.000000000 FORMAT "%13.9" NUMBER 65 /end CHARACTERISTIC
/begin CHARACTERISTIC DINH_FId.DFC_AltIOACGTHi_CA "inhibitable FIds / FIds to be inhibited by inhibit source DFC_AltIOACGTHi" VAL_BLK 0x804DA07C ValA_Wu16 968.000000000 DINH_FIdVerb 0.00 968.000000000 FORMAT "%13.9" NUMBER 59 /end CHARACTERISTIC
/begin CHARACTERISTIC DINH_FId.DFC_AltIODConnACG_CA "inhibitable FIds / FIds to be inhibited by inhibit source DFC_AltIODConnACG" VAL_BLK 0x804DA0F2 ValA_Wu16 968.000000000 DINH_FIdVerb 0.00 968.000000000 FORMAT "%13.9" NUMBER 65 /end CHARACTERISTIC
/begin CHARACTERISTIC DINH_FId.DFC_BGOELWAF_CA "inhibitable FIds / FIds to be inhibited by inhibit source DFC_BGOELWAF" VAL_BLK 0x804DA174 ValA_Wu16 968.000000000 DINH_FIdVerb 0.00 968.000000000 FORMAT "%13.9" NUMBER 50 /end CHARACTERISTIC
/begin CHARACTERISTIC DINH_FId.DFC_BattUHiFailr_CA "inhibitable FIds / FIds to be inhibited by inhibit source DFC_BattUHiFailr" VAL_BLK 0x804DA1D8 ValA_Wu16 968.000000000 DINH_FIdVerb 0.00 968.000000000 FORMAT "%13.9" NUMBER 51 /end CHARACTERISTIC
/begin CHARACTERISTIC DINH_FId.DFC_BattULoFailr_CA "inhibitable FIds / FIds to be inhibited by inhibit source DFC_BattULoFailr" VAL_BLK 0x804DA23E ValA_Wu16 968.000000000 DINH_FIdVerb 0.00 968.000000000 FORMAT "%13.9" NUMBER 51 /end CHARACTERISTIC
/begin CHARACTERISTIC DINH_FId.DFC_BrkBstPDriftHiErr_CA "inhibitable FIds / FIds to be inhibited by inhibit source DFC_BrkBstPDriftHiErr" VAL_BLK 0x804DA2A4 ValA_Wu16 968.000000000 DINH_FIdVerb 0.00 968.000000000 FORMAT "%13.9" NUMBER 55 /end CHARACTERISTIC
/begin CHARACTERISTIC DINH_FId.DFC_BrkBstPDriftLoErr_CA "inhibitable FIds / FIds to be inhibited by inhibit source DFC_BrkBstPDriftLoErr" VAL_BLK 0x804DA312 ValA_Wu16 968.000000000 DINH_FIdVerb 0.00 968.000000000 FORMAT "%13.9" NUMBER 55 /end CHARACTERISTIC
/begin CHARACTERISTIC DINH_FId.DFC_BrkBstPSnsrStuck_CA "inhibitable FIds / FIds to be inhibited by inhibit source DFC_BrkBstPSnsrStuck" VAL_BLK 0x804DA380 ValA_Wu16 968.000000000 DINH_FIdVerb 0.00 968.000000000 FORMAT "%13.9" NUMBER 56 /end CHARACTERISTIC
/begin CHARACTERISTIC DINH_FId.DFC_BrkMnSwtContOn_CA "inhibitable FIds / FIds to be inhibited by inhibit source DFC_BrkMnSwtContOn" VAL_BLK 0x804DA3F0 ValA_Wu16 968.000000000 DINH_FIdVerb 0.00 968.000000000 FORMAT "%13.9" NUMBER 55 /end CHARACTERISTIC
/begin CHARACTERISTIC DINH_FId.DFC_BrkMnSwtNotStp_CA "inhibitable FIds / FIds to be inhibited by inhibit source DFC_BrkMnSwtNotStp" VAL_BLK 0x804DA45E ValA_Wu16 968.000000000 DINH_FIdVerb 0.00 968.000000000 FORMAT "%13.9" NUMBER 55 /end CHARACTERISTIC
/begin CHARACTERISTIC DINH_FId.DFC_BrkNpl_CA "inhibitable FIds / FIds to be inhibited by inhibit source DFC_BrkNpl" VAL_BLK 0x804DA4CC ValA_Wu16 968.000000000 DINH_FIdVerb 0.00 968.000000000 FORMAT "%13.9" NUMBER 54 /end CHARACTERISTIC
/begin CHARACTERISTIC DINH_FId.DFC_BrkRdntSwtContOn_CA "inhibitable FIds / FIds to be inhibited by inhibit source DFC_BrkRdntSwtContOn" VAL_BLK 0x804DA538 ValA_Wu16 968.000000000 DINH_FIdVerb 0.00 968.000000000 FORMAT "%13.9" NUMBER 55 /end CHARACTERISTIC
/begin CHARACTERISTIC DINH_FId.DFC_BrkRdntSwtNotStp_CA "inhibitable FIds / FIds to be inhibited by inhibit source DFC_BrkRdntSwtNotStp" VAL_BLK 0x804DA5A6 ValA_Wu16 968.000000000 DINH_FIdVerb 0.00 968.000000000 FORMAT "%13.9" NUMBER 55 /end CHARACTERISTIC
/begin CHARACTERISTIC DINH_FId.DFC_Clth3ONStuck_CA "inhibitable FIds / FIds to be inhibited by inhibit source DFC_Clth3ONStuck" VAL_BLK 0x804DA614 ValA_Wu16 968.000000000 DINH_FIdVerb 0.00 968.000000000 FORMAT "%13.9" NUMBER 63 /end CHARACTERISTIC
/begin CHARACTERISTIC DINH_FId.DFC_Clth4OFFStuck_CA "inhibitable FIds / FIds to be inhibited by inhibit source DFC_Clth4OFFStuck" VAL_BLK 0x804DA692 ValA_Wu16 968.000000000 DINH_FIdVerb 0.00 968.000000000 FORMAT "%13.9" NUMBER 59 /end CHARACTERISTIC
/begin CHARACTERISTIC DINH_FId.DFC_ClthOFFStuck_CA "inhibitable FIds / FIds to be inhibited by inhibit source DFC_ClthOFFStuck" VAL_BLK 0x804DA708 ValA_Wu16 968.000000000 DINH_FIdVerb 0.00 968.000000000 FORMAT "%13.9" NUMBER 60 /end CHARACTERISTIC
/begin CHARACTERISTIC DINH_FId.DFC_ClthONStuck_CA "inhibitable FIds / FIds to be inhibited by inhibit source DFC_ClthONStuck" VAL_BLK 0x804DA780 ValA_Wu16 968.000000000 DINH_FIdVerb 0.00 968.000000000 FORMAT "%13.9" NUMBER 60 /end CHARACTERISTIC
/begin CHARACTERISTIC DINH_FId.DFC_ClthStkFailInfo_CA "inhibitable FIds / FIds to be inhibited by inhibit source DFC_ClthStkFailInfo" VAL_BLK 0x804DA7F8 ValA_Wu16 968.000000000 DINH_FIdVerb 0.00 968.000000000 FORMAT "%13.9" NUMBER 68 /end CHARACTERISTIC
/begin CHARACTERISTIC DINH_FId.DFC_ComACFailInfo_CA "inhibitable FIds / FIds to be inhibited by inhibit source DFC_ComACFailInfo" VAL_BLK 0x804DA880 ValA_Wu16 968.000000000 DINH_FIdVerb 0.00 968.000000000 FORMAT "%13.9" NUMBER 53 /end CHARACTERISTIC
/begin CHARACTERISTIC DINH_FId.DFC_ComATFTValErr_CA "inhibitable FIds / FIds to be inhibited by inhibit source DFC_ComATFTValErr" VAL_BLK 0x804DA8EA ValA_Wu16 968.000000000 DINH_FIdVerb 0.00 968.000000000 FORMAT "%13.9" NUMBER 50 /end CHARACTERISTIC
/begin CHARACTERISTIC DINH_FId.DFC_ComATMILReq_CA "inhibitable FIds / FIds to be inhibited by inhibit source DFC_ComATMILReq" VAL_BLK 0x804DA94E ValA_Wu16 968.000000000 DINH_FIdVerb 0.00 968.000000000 FORMAT "%13.9" NUMBER 50 /end CHARACTERISTIC
/begin CHARACTERISTIC DINH_FId.DFC_ComAYCAChksum_CA "inhibitable FIds / FIds to be inhibited by inhibit source DFC_ComAYCAChksum" VAL_BLK 0x804DA9B2 ValA_Wu16 968.000000000 DINH_FIdVerb 0.00 968.000000000 FORMAT "%13.9" NUMBER 67 /end CHARACTERISTIC
/begin CHARACTERISTIC DINH_FId.DFC_ComAYCARingCnt_CA "inhibitable FIds / FIds to be inhibited by inhibit source DFC_ComAYCARingCnt" VAL_BLK 0x804DAA38 ValA_Wu16 968.000000000 DINH_FIdVerb 0.00 968.000000000 FORMAT "%13.9" NUMBER 67 /end CHARACTERISTIC
/begin CHARACTERISTIC DINH_FId.DFC_ComAYCATOut_CA "inhibitable FIds / FIds to be inhibited by inhibit source DFC_ComAYCATOut" VAL_BLK 0x804DAABE ValA_Wu16 968.000000000 DINH_FIdVerb 0.00 968.000000000 FORMAT "%13.9" NUMBER 67 /end CHARACTERISTIC
/begin CHARACTERISTIC DINH_FId.DFC_ComAYCDChkSum_CA "inhibitable FIds / FIds to be inhibited by inhibit source DFC_ComAYCDChkSum" VAL_BLK 0x804DAB44 ValA_Wu16 968.000000000 DINH_FIdVerb 0.00 968.000000000 FORMAT "%13.9" NUMBER 66 /end CHARACTERISTIC
/begin CHARACTERISTIC DINH_FId.DFC_ComAYCDTOut_CA "inhibitable FIds / FIds to be inhibited by inhibit source DFC_ComAYCDTOut" VAL_BLK 0x804DABC8 ValA_Wu16 968.000000000 DINH_FIdVerb 0.00 968.000000000 FORMAT "%13.9" NUMBER 66 /end CHARACTERISTIC
/begin CHARACTERISTIC DINH_FId.DFC_ComAYCFChksum_CA "inhibitable FIds / FIds to be inhibited by inhibit source DFC_ComAYCFChksum" VAL_BLK 0x804DAC4C ValA_Wu16 968.000000000 DINH_FIdVerb 0.00 968.000000000 FORMAT "%13.9" NUMBER 69 /end CHARACTERISTIC
/begin CHARACTERISTIC DINH_FId.DFC_ComAYCFRingCnt_CA "inhibitable FIds / FIds to be inhibited by inhibit source DFC_ComAYCFRingCnt" VAL_BLK 0x804DACD6 ValA_Wu16 968.000000000 DINH_FIdVerb 0.00 968.000000000 FORMAT "%13.9" NUMBER 69 /end CHARACTERISTIC
/begin CHARACTERISTIC DINH_FId.DFC_ComAYCFTOut_CA "inhibitable FIds / FIds to be inhibited by inhibit source DFC_ComAYCFTOut" VAL_BLK 0x804DAD60 ValA_Wu16 968.000000000 DINH_FIdVerb 0.00 968.000000000 FORMAT "%13.9" NUMBER 69 /end CHARACTERISTIC
/begin CHARACTERISTIC DINH_FId.DFC_ComAYCGChksum_CA "inhibitable FIds / FIds to be inhibited by inhibit source DFC_ComAYCGChksum" VAL_BLK 0x804DADEA ValA_Wu16 968.000000000 DINH_FIdVerb 0.00 968.000000000 FORMAT "%13.9" NUMBER 64 /end CHARACTERISTIC
/begin CHARACTERISTIC DINH_FId.DFC_ComAYCGRingCnt_CA "inhibitable FIds / FIds to be inhibited by inhibit source DFC_ComAYCGRingCnt" VAL_BLK 0x804DAE6A ValA_Wu16 968.000000000 DINH_FIdVerb 0.00 968.000000000 FORMAT "%13.9" NUMBER 64 /end CHARACTERISTIC
/begin CHARACTERISTIC DINH_FId.DFC_ComAYCGTOut_CA "inhibitable FIds / FIds to be inhibited by inhibit source DFC_ComAYCGTOut" VAL_BLK 0x804DAEEA ValA_Wu16 968.000000000 DINH_FIdVerb 0.00 968.000000000 FORMAT "%13.9" NUMBER 64 /end CHARACTERISTIC
/begin CHARACTERISTIC DINH_FId.DFC_ComAYCIChkSum_CA "inhibitable FIds / FIds to be inhibited by inhibit source DFC_ComAYCIChkSum" VAL_BLK 0x804DAF6A ValA_Wu16 968.000000000 DINH_FIdVerb 0.00 968.000000000 FORMAT "%13.9" NUMBER 58 /end CHARACTERISTIC
/begin CHARACTERISTIC DINH_FId.DFC_ComAYCIRingCnt_CA "inhibitable FIds / FIds to be inhibited by inhibit source DFC_ComAYCIRingCnt" VAL_BLK 0x804DAFDE ValA_Wu16 968.000000000 DINH_FIdVerb 0.00 968.000000000 FORMAT "%13.9" NUMBER 58 /end CHARACTERISTIC
/begin CHARACTERISTIC DINH_FId.DFC_ComAYCITOut_CA "inhibitable FIds / FIds to be inhibited by inhibit source DFC_ComAYCITOut" VAL_BLK 0x804DB052 ValA_Wu16 968.000000000 DINH_FIdVerb 0.00 968.000000000 FORMAT "%13.9" NUMBER 58 /end CHARACTERISTIC
/begin CHARACTERISTIC DINH_FId.DFC_ComBCM1ChkSum_CA "inhibitable FIds / FIds to be inhibited by inhibit source DFC_ComBCM1ChkSum" VAL_BLK 0x804DB0C6 ValA_Wu16 968.000000000 DINH_FIdVerb 0.00 968.000000000 FORMAT "%13.9" NUMBER 55 /end CHARACTERISTIC
/begin CHARACTERISTIC DINH_FId.DFC_ComBCM1RingCnt_CA "inhibitable FIds / FIds to be inhibited by inhibit source DFC_ComBCM1RingCnt" VAL_BLK 0x804DB134 ValA_Wu16 968.000000000 DINH_FIdVerb 0.00 968.000000000 FORMAT "%13.9" NUMBER 55 /end CHARACTERISTIC
/begin CHARACTERISTIC DINH_FId.DFC_ComBCM1TOut_CA "inhibitable FIds / FIds to be inhibited by inhibit source DFC_ComBCM1TOut" VAL_BLK 0x804DB1A2 ValA_Wu16 968.000000000 DINH_FIdVerb 0.00 968.000000000 FORMAT "%13.9" NUMBER 55 /end CHARACTERISTIC
/begin CHARACTERISTIC DINH_FId.DFC_ComCANABusOffErr_CA "inhibitable FIds / FIds to be inhibited by inhibit source DFC_ComCANABusOffErr" VAL_BLK 0x804DB210 ValA_Wu16 968.000000000 DINH_FIdVerb 0.00 968.000000000 FORMAT "%13.9" NUMBER 201 /end CHARACTERISTIC
/begin CHARACTERISTIC DINH_FId.DFC_ComCANBBusOffErr_CA "inhibitable FIds / FIds to be inhibited by inhibit source DFC_ComCANBBusOffErr" VAL_BLK 0x804DB3A2 ValA_Wu16 968.000000000 DINH_FIdVerb 0.00 968.000000000 FORMAT "%13.9" NUMBER 200 /end CHARACTERISTIC
/begin CHARACTERISTIC DINH_FId.DFC_ComCANCBusOffErr_CA "inhibitable FIds / FIds to be inhibited by inhibit source DFC_ComCANCBusOffErr" VAL_BLK 0x804DB532 ValA_Wu16 968.000000000 DINH_FIdVerb 0.00 968.000000000 FORMAT "%13.9" NUMBER 200 /end CHARACTERISTIC
/begin CHARACTERISTIC DINH_FId.DFC_ComCGW1ChkSum_CA "inhibitable FIds / FIds to be inhibited by inhibit source DFC_ComCGW1ChkSum" VAL_BLK 0x804DB6C2 ValA_Wu16 968.000000000 DINH_FIdVerb 0.00 968.000000000 FORMAT "%13.9" NUMBER 53 /end CHARACTERISTIC
/begin CHARACTERISTIC DINH_FId.DFC_ComCGW1RingCnt_CA "inhibitable FIds / FIds to be inhibited by inhibit source DFC_ComCGW1RingCnt" VAL_BLK 0x804DB72C ValA_Wu16 968.000000000 DINH_FIdVerb 0.00 968.000000000 FORMAT "%13.9" NUMBER 53 /end CHARACTERISTIC
/begin CHARACTERISTIC DINH_FId.DFC_ComCGW1TOut_CA "inhibitable FIds / FIds to be inhibited by inhibit source DFC_ComCGW1TOut" VAL_BLK 0x804DB796 ValA_Wu16 968.000000000 DINH_FIdVerb 0.00 968.000000000 FORMAT "%13.9" NUMBER 53 /end CHARACTERISTIC
/begin CHARACTERISTIC DINH_FId.DFC_ComConvBoostErr_CA "inhibitable FIds / FIds to be inhibited by inhibit source DFC_ComConvBoostErr" VAL_BLK 0x804DB800 ValA_Wu16 968.000000000 DINH_FIdVerb 0.00 968.000000000 FORMAT "%13.9" NUMBER 51 /end CHARACTERISTIC
/begin CHARACTERISTIC DINH_FId.DFC_ComConvSlipErr_CA "inhibitable FIds / FIds to be inhibited by inhibit source DFC_ComConvSlipErr" VAL_BLK 0x804DB866 ValA_Wu16 968.000000000 DINH_FIdVerb 0.00 968.000000000 FORMAT "%13.9" NUMBER 51 /end CHARACTERISTIC
/begin CHARACTERISTIC DINH_FId.DFC_ComDCDCPrfmncErr_CA "inhibitable FIds / FIds to be inhibited by inhibit source DFC_ComDCDCPrfmncErr" VAL_BLK 0x804DB8CC ValA_Wu16 968.000000000 DINH_FIdVerb 0.00 968.000000000 FORMAT "%13.9" NUMBER 57 /end CHARACTERISTIC
/begin CHARACTERISTIC DINH_FId.DFC_ComDCDCTempWarn_CA "inhibitable FIds / FIds to be inhibited by inhibit source DFC_ComDCDCTempWarn" VAL_BLK 0x804DB93E ValA_Wu16 968.000000000 DINH_FIdVerb 0.00 968.000000000 FORMAT "%13.9" NUMBER 54 /end CHARACTERISTIC
/begin CHARACTERISTIC DINH_FId.DFC_ComEAT10Chksum_CA "inhibitable FIds / FIds to be inhibited by inhibit source DFC_ComEAT10Chksum" VAL_BLK 0x804DB9AA ValA_Wu16 968.000000000 DINH_FIdVerb 0.00 968.000000000 FORMAT "%13.9" NUMBER 60 /end CHARACTERISTIC
/begin CHARACTERISTIC DINH_FId.DFC_ComEAT10RingCnt_CA "inhibitable FIds / FIds to be inhibited by inhibit source DFC_ComEAT10RingCnt" VAL_BLK 0x804DBA22 ValA_Wu16 968.000000000 DINH_FIdVerb 0.00 968.000000000 FORMAT "%13.9" NUMBER 60 /end CHARACTERISTIC
/begin CHARACTERISTIC DINH_FId.DFC_ComEAT10TOut_CA "inhibitable FIds / FIds to be inhibited by inhibit source DFC_ComEAT10TOut" VAL_BLK 0x804DBA9A ValA_Wu16 968.000000000 DINH_FIdVerb 0.00 968.000000000 FORMAT "%13.9" NUMBER 60 /end CHARACTERISTIC
/begin CHARACTERISTIC DINH_FId.DFC_ComEAT11ChkSum_CA "inhibitable FIds / FIds to be inhibited by inhibit source DFC_ComEAT11ChkSum" VAL_BLK 0x804DBB12 ValA_Wu16 968.000000000 DINH_FIdVerb 0.00 968.000000000 FORMAT "%13.9" NUMBER 53 /end CHARACTERISTIC
/begin CHARACTERISTIC DINH_FId.DFC_ComEAT11RingCnt_CA "inhibitable FIds / FIds to be inhibited by inhibit source DFC_ComEAT11RingCnt" VAL_BLK 0x804DBB7C ValA_Wu16 968.000000000 DINH_FIdVerb 0.00 968.000000000 FORMAT "%13.9" NUMBER 53 /end CHARACTERISTIC
/begin CHARACTERISTIC DINH_FId.DFC_ComEAT11TOut_CA "inhibitable FIds / FIds to be inhibited by inhibit source DFC_ComEAT11TOut" VAL_BLK 0x804DBBE6 ValA_Wu16 968.000000000 DINH_FIdVerb 0.00 968.000000000 FORMAT "%13.9" NUMBER 53 /end CHARACTERISTIC
/begin CHARACTERISTIC DINH_FId.DFC_ComEAT12ChkSum_CA "inhibitable FIds / FIds to be inhibited by inhibit source DFC_ComEAT12ChkSum" VAL_BLK 0x804DBC50 ValA_Wu16 968.000000000 DINH_FIdVerb 0.00 968.000000000 FORMAT "%13.9" NUMBER 53 /end CHARACTERISTIC
/begin CHARACTERISTIC DINH_FId.DFC_ComEAT12RingCnt_CA "inhibitable FIds / FIds to be inhibited by inhibit source DFC_ComEAT12RingCnt" VAL_BLK 0x804DBCBA ValA_Wu16 968.000000000 DINH_FIdVerb 0.00 968.000000000 FORMAT "%13.9" NUMBER 53 /end CHARACTERISTIC
/begin CHARACTERISTIC DINH_FId.DFC_ComEAT12TOut_CA "inhibitable FIds / FIds to be inhibited by inhibit source DFC_ComEAT12TOut" VAL_BLK 0x804DBD24 ValA_Wu16 968.000000000 DINH_FIdVerb 0.00 968.000000000 FORMAT "%13.9" NUMBER 53 /end CHARACTERISTIC
/begin CHARACTERISTIC DINH_FId.DFC_ComEAT13ChkSum_CA "inhibitable FIds / FIds to be inhibited by inhibit source DFC_ComEAT13ChkSum" VAL_BLK 0x804DBD8E ValA_Wu16 968.000000000 DINH_FIdVerb 0.00 968.000000000 FORMAT "%13.9" NUMBER 57 /end CHARACTERISTIC
/begin CHARACTERISTIC DINH_FId.DFC_ComEAT13RingCnt_CA "inhibitable FIds / FIds to be inhibited by inhibit source DFC_ComEAT13RingCnt" VAL_BLK 0x804DBE00 ValA_Wu16 968.000000000 DINH_FIdVerb 0.00 968.000000000 FORMAT "%13.9" NUMBER 57 /end CHARACTERISTIC
/begin CHARACTERISTIC DINH_FId.DFC_ComEAT13TOut_CA "inhibitable FIds / FIds to be inhibited by inhibit source DFC_ComEAT13TOut" VAL_BLK 0x804DBE72 ValA_Wu16 968.000000000 DINH_FIdVerb 0.00 968.000000000 FORMAT "%13.9" NUMBER 57 /end CHARACTERISTIC
/begin CHARACTERISTIC DINH_FId.DFC_ComEAT1Chksum_CA "inhibitable FIds / FIds to be inhibited by inhibit source DFC_ComEAT1Chksum" VAL_BLK 0x804DBEE4 ValA_Wu16 968.000000000 DINH_FIdVerb 0.00 968.000000000 FORMAT "%13.9" NUMBER 57 /end CHARACTERISTIC
/begin CHARACTERISTIC DINH_FId.DFC_ComEAT1RingCnt_CA "inhibitable FIds / FIds to be inhibited by inhibit source DFC_ComEAT1RingCnt" VAL_BLK 0x804DBF56 ValA_Wu16 968.000000000 DINH_FIdVerb 0.00 968.000000000 FORMAT "%13.9" NUMBER 57 /end CHARACTERISTIC
/begin CHARACTERISTIC DINH_FId.DFC_ComEAT1TOut_CA "inhibitable FIds / FIds to be inhibited by inhibit source DFC_ComEAT1TOut" VAL_BLK 0x804DBFC8 ValA_Wu16 968.000000000 DINH_FIdVerb 0.00 968.000000000 FORMAT "%13.9" NUMBER 57 /end CHARACTERISTIC
/begin CHARACTERISTIC DINH_FId.DFC_ComEAT2ChkSum_CA "inhibitable FIds / FIds to be inhibited by inhibit source DFC_ComEAT2ChkSum" VAL_BLK 0x804DC03A ValA_Wu16 968.000000000 DINH_FIdVerb 0.00 968.000000000 FORMAT "%13.9" NUMBER 58 /end CHARACTERISTIC
/begin CHARACTERISTIC DINH_FId.DFC_ComEAT2RingCnt_CA "inhibitable FIds / FIds to be inhibited by inhibit source DFC_ComEAT2RingCnt" VAL_BLK 0x804DC0AE ValA_Wu16 968.000000000 DINH_FIdVerb 0.00 968.000000000 FORMAT "%13.9" NUMBER 58 /end CHARACTERISTIC
/begin CHARACTERISTIC DINH_FId.DFC_ComEAT2TOut_CA "inhibitable FIds / FIds to be inhibited by inhibit source DFC_ComEAT2TOut" VAL_BLK 0x804DC122 ValA_Wu16 968.000000000 DINH_FIdVerb 0.00 968.000000000 FORMAT "%13.9" NUMBER 58 /end CHARACTERISTIC
/begin CHARACTERISTIC DINH_FId.DFC_ComEAT4ChkSum_CA "inhibitable FIds / FIds to be inhibited by inhibit source DFC_ComEAT4ChkSum" VAL_BLK 0x804DC196 ValA_Wu16 968.000000000 DINH_FIdVerb 0.00 968.000000000 FORMAT "%13.9" NUMBER 58 /end CHARACTERISTIC
/begin CHARACTERISTIC DINH_FId.DFC_ComEAT4RingCnt_CA "inhibitable FIds / FIds to be inhibited by inhibit source DFC_ComEAT4RingCnt" VAL_BLK 0x804DC20A ValA_Wu16 968.000000000 DINH_FIdVerb 0.00 968.000000000 FORMAT "%13.9" NUMBER 58 /end CHARACTERISTIC
/begin CHARACTERISTIC DINH_FId.DFC_ComEAT4TOut_CA "inhibitable FIds / FIds to be inhibited by inhibit source DFC_ComEAT4TOut" VAL_BLK 0x804DC27E ValA_Wu16 968.000000000 DINH_FIdVerb 0.00 968.000000000 FORMAT "%13.9" NUMBER 58 /end CHARACTERISTIC
/begin CHARACTERISTIC DINH_FId.DFC_ComEAT6Chksum_CA "inhibitable FIds / FIds to be inhibited by inhibit source DFC_ComEAT6Chksum" VAL_BLK 0x804DC2F2 ValA_Wu16 968.000000000 DINH_FIdVerb 0.00 968.000000000 FORMAT "%13.9" NUMBER 59 /end CHARACTERISTIC
/begin CHARACTERISTIC DINH_FId.DFC_ComEAT6RingCnt_CA "inhibitable FIds / FIds to be inhibited by inhibit source DFC_ComEAT6RingCnt" VAL_BLK 0x804DC368 ValA_Wu16 968.000000000 DINH_FIdVerb 0.00 968.000000000 FORMAT "%13.9" NUMBER 59 /end CHARACTERISTIC
/begin CHARACTERISTIC DINH_FId.DFC_ComEAT6TOut_CA "inhibitable FIds / FIds to be inhibited by inhibit source DFC_ComEAT6TOut" VAL_BLK 0x804DC3DE ValA_Wu16 968.000000000 DINH_FIdVerb 0.00 968.000000000 FORMAT "%13.9" NUMBER 59 /end CHARACTERISTIC
/begin CHARACTERISTIC DINH_FId.DFC_ComEAT7Chksum_CA "inhibitable FIds / FIds to be inhibited by inhibit source DFC_ComEAT7Chksum" VAL_BLK 0x804DC454 ValA_Wu16 968.000000000 DINH_FIdVerb 0.00 968.000000000 FORMAT "%13.9" NUMBER 58 /end CHARACTERISTIC
/begin CHARACTERISTIC DINH_FId.DFC_ComEAT7RingCnt_CA "inhibitable FIds / FIds to be inhibited by inhibit source DFC_ComEAT7RingCnt" VAL_BLK 0x804DC4C8 ValA_Wu16 968.000000000 DINH_FIdVerb 0.00 968.000000000 FORMAT "%13.9" NUMBER 58 /end CHARACTERISTIC
/begin CHARACTERISTIC DINH_FId.DFC_ComEAT7TOut_CA "inhibitable FIds / FIds to be inhibited by inhibit source DFC_ComEAT7TOut" VAL_BLK 0x804DC53C ValA_Wu16 968.000000000 DINH_FIdVerb 0.00 968.000000000 FORMAT "%13.9" NUMBER 58 /end CHARACTERISTIC
/begin CHARACTERISTIC DINH_FId.DFC_ComEAT8Chksum_CA "inhibitable FIds / FIds to be inhibited by inhibit source DFC_ComEAT8Chksum" VAL_BLK 0x804DC5B0 ValA_Wu16 968.000000000 DINH_FIdVerb 0.00 968.000000000 FORMAT "%13.9" NUMBER 59 /end CHARACTERISTIC
/begin CHARACTERISTIC DINH_FId.DFC_ComEAT8RingCnt_CA "inhibitable FIds / FIds to be inhibited by inhibit source DFC_ComEAT8RingCnt" VAL_BLK 0x804DC626 ValA_Wu16 968.000000000 DINH_FIdVerb 0.00 968.000000000 FORMAT "%13.9" NUMBER 59 /end CHARACTERISTIC
/begin CHARACTERISTIC DINH_FId.DFC_ComEAT8TOut_CA "inhibitable FIds / FIds to be inhibited by inhibit source DFC_ComEAT8TOut" VAL_BLK 0x804DC69C ValA_Wu16 968.000000000 DINH_FIdVerb 0.00 968.000000000 FORMAT "%13.9" NUMBER 59 /end CHARACTERISTIC
/begin CHARACTERISTIC DINH_FId.DFC_ComEATAChksum_CA "inhibitable FIds / FIds to be inhibited by inhibit source DFC_ComEATAChksum" VAL_BLK 0x804DC712 ValA_Wu16 968.000000000 DINH_FIdVerb 0.00 968.000000000 FORMAT "%13.9" NUMBER 59 /end CHARACTERISTIC
/begin CHARACTERISTIC DINH_FId.DFC_ComEATARingCnt_CA "inhibitable FIds / FIds to be inhibited by inhibit source DFC_ComEATARingCnt" VAL_BLK 0x804DC788 ValA_Wu16 968.000000000 DINH_FIdVerb 0.00 968.000000000 FORMAT "%13.9" NUMBER 59 /end CHARACTERISTIC
/begin CHARACTERISTIC DINH_FId.DFC_ComEATATOut_CA "inhibitable FIds / FIds to be inhibited by inhibit source DFC_ComEATATOut" VAL_BLK 0x804DC7FE ValA_Wu16 968.000000000 DINH_FIdVerb 0.00 968.000000000 FORMAT "%13.9" NUMBER 59 /end CHARACTERISTIC
/begin CHARACTERISTIC DINH_FId.DFC_ComEATBChkSum_CA "inhibitable FIds / FIds to be inhibited by inhibit source DFC_ComEATBChkSum" VAL_BLK 0x804DC874 ValA_Wu16 968.000000000 DINH_FIdVerb 0.00 968.000000000 FORMAT "%13.9" NUMBER 65 /end CHARACTERISTIC
/begin CHARACTERISTIC DINH_FId.DFC_ComEATBRingCnt_CA "inhibitable FIds / FIds to be inhibited by inhibit source DFC_ComEATBRingCnt" VAL_BLK 0x804DC8F6 ValA_Wu16 968.000000000 DINH_FIdVerb 0.00 968.000000000 FORMAT "%13.9" NUMBER 65 /end CHARACTERISTIC
/begin CHARACTERISTIC DINH_FId.DFC_ComEATBTOut_CA "inhibitable FIds / FIds to be inhibited by inhibit source DFC_ComEATBTOut" VAL_BLK 0x804DC978 ValA_Wu16 968.000000000 DINH_FIdVerb 0.00 968.000000000 FORMAT "%13.9" NUMBER 65 /end CHARACTERISTIC
/begin CHARACTERISTIC DINH_FId.DFC_ComEATCChksum_CA "inhibitable FIds / FIds to be inhibited by inhibit source DFC_ComEATCChksum" VAL_BLK 0x804DC9FA ValA_Wu16 968.000000000 DINH_FIdVerb 0.00 968.000000000 FORMAT "%13.9" NUMBER 52 /end CHARACTERISTIC
/begin CHARACTERISTIC DINH_FId.DFC_ComEATCRingCnt_CA "inhibitable FIds / FIds to be inhibited by inhibit source DFC_ComEATCRingCnt" VAL_BLK 0x804DCA62 ValA_Wu16 968.000000000 DINH_FIdVerb 0.00 968.000000000 FORMAT "%13.9" NUMBER 52 /end CHARACTERISTIC
/begin CHARACTERISTIC DINH_FId.DFC_ComEATCTOut_CA "inhibitable FIds / FIds to be inhibited by inhibit source DFC_ComEATCTOut" VAL_BLK 0x804DCACA ValA_Wu16 968.000000000 DINH_FIdVerb 0.00 968.000000000 FORMAT "%13.9" NUMBER 52 /end CHARACTERISTIC
/begin CHARACTERISTIC DINH_FId.DFC_ComEPBBChkSum_CA "inhibitable FIds / FIds to be inhibited by inhibit source DFC_ComEPBBChkSum" VAL_BLK 0x804DCB32 ValA_Wu16 968.000000000 DINH_FIdVerb 0.00 968.000000000 FORMAT "%13.9" NUMBER 53 /end CHARACTERISTIC
/begin CHARACTERISTIC DINH_FId.DFC_ComEPBBRingCnt_CA "inhibitable FIds / FIds to be inhibited by inhibit source DFC_ComEPBBRingCnt" VAL_BLK 0x804DCB9C ValA_Wu16 968.000000000 DINH_FIdVerb 0.00 968.000000000 FORMAT "%13.9" NUMBER 53 /end CHARACTERISTIC
/begin CHARACTERISTIC DINH_FId.DFC_ComEPBBTOut_CA "inhibitable FIds / FIds to be inhibited by inhibit source DFC_ComEPBBTOut" VAL_BLK 0x804DCC06 ValA_Wu16 968.000000000 DINH_FIdVerb 0.00 968.000000000 FORMAT "%13.9" NUMBER 53 /end CHARACTERISTIC
/begin CHARACTERISTIC DINH_FId.DFC_ComEPBChksum_CA "inhibitable FIds / FIds to be inhibited by inhibit source DFC_ComEPBChksum" VAL_BLK 0x804DCC70 ValA_Wu16 968.000000000 DINH_FIdVerb 0.00 968.000000000 FORMAT "%13.9" NUMBER 65 /end CHARACTERISTIC
/begin CHARACTERISTIC DINH_FId.DFC_ComEPBTOut_CA "inhibitable FIds / FIds to be inhibited by inhibit source DFC_ComEPBTOut" VAL_BLK 0x804DCCF2 ValA_Wu16 968.000000000 DINH_FIdVerb 0.00 968.000000000 FORMAT "%13.9" NUMBER 65 /end CHARACTERISTIC
/begin CHARACTERISTIC DINH_FId.DFC_ComEPBctRing_CA "inhibitable FIds / FIds to be inhibited by inhibit source DFC_ComEPBctRing" VAL_BLK 0x804DCD74 ValA_Wu16 968.000000000 DINH_FIdVerb 0.00 968.000000000 FORMAT "%13.9" NUMBER 65 /end CHARACTERISTIC
/begin CHARACTERISTIC DINH_FId.DFC_ComEPS1Chksum_CA "inhibitable FIds / FIds to be inhibited by inhibit source DFC_ComEPS1Chksum" VAL_BLK 0x804DCDF6 ValA_Wu16 968.000000000 DINH_FIdVerb 0.00 968.000000000 FORMAT "%13.9" NUMBER 59 /end CHARACTERISTIC
/begin CHARACTERISTIC DINH_FId.DFC_ComEPS1RingCnt_CA "inhibitable FIds / FIds to be inhibited by inhibit source DFC_ComEPS1RingCnt" VAL_BLK 0x804DCE6C ValA_Wu16 968.000000000 DINH_FIdVerb 0.00 968.000000000 FORMAT "%13.9" NUMBER 59 /end CHARACTERISTIC
/begin CHARACTERISTIC DINH_FId.DFC_ComEPS1TOut_CA "inhibitable FIds / FIds to be inhibited by inhibit source DFC_ComEPS1TOut" VAL_BLK 0x804DCEE2 ValA_Wu16 968.000000000 DINH_FIdVerb 0.00 968.000000000 FORMAT "%13.9" NUMBER 59 /end CHARACTERISTIC
/begin CHARACTERISTIC DINH_FId.DFC_ComEngCanRxErr_CA "inhibitable FIds / FIds to be inhibited by inhibit source DFC_ComEngCanRxErr" VAL_BLK 0x804DCF58 ValA_Wu16 968.000000000 DINH_FIdVerb 0.00 968.000000000 FORMAT "%13.9" NUMBER 53 /end CHARACTERISTIC
/begin CHARACTERISTIC DINH_FId.DFC_ComGrvySnsrErr_CA "inhibitable FIds / FIds to be inhibited by inhibit source DFC_ComGrvySnsrErr" VAL_BLK 0x804DCFC2 ValA_Wu16 968.000000000 DINH_FIdVerb 0.00 968.000000000 FORMAT "%13.9" NUMBER 50 /end CHARACTERISTIC
/begin CHARACTERISTIC DINH_FId.DFC_ComGwIMG1ChkSum_CA "inhibitable FIds / FIds to be inhibited by inhibit source DFC_ComGwIMG1ChkSum" VAL_BLK 0x804DD026 ValA_Wu16 968.000000000 DINH_FIdVerb 0.00 968.000000000 FORMAT "%13.9" NUMBER 58 /end CHARACTERISTIC
/begin CHARACTERISTIC DINH_FId.DFC_ComGwIMG1RingCnt_CA "inhibitable FIds / FIds to be inhibited by inhibit source DFC_ComGwIMG1RingCnt" VAL_BLK 0x804DD09A ValA_Wu16 968.000000000 DINH_FIdVerb 0.00 968.000000000 FORMAT "%13.9" NUMBER 58 /end CHARACTERISTIC
/begin CHARACTERISTIC DINH_FId.DFC_ComGwIMG1TOut_CA "inhibitable FIds / FIds to be inhibited by inhibit source DFC_ComGwIMG1TOut" VAL_BLK 0x804DD10E ValA_Wu16 968.000000000 DINH_FIdVerb 0.00 968.000000000 FORMAT "%13.9" NUMBER 58 /end CHARACTERISTIC
/begin CHARACTERISTIC DINH_FId.DFC_ComGwIMG3ChkSum_CA "inhibitable FIds / FIds to be inhibited by inhibit source DFC_ComGwIMG3ChkSum" VAL_BLK 0x804DD182 ValA_Wu16 968.000000000 DINH_FIdVerb 0.00 968.000000000 FORMAT "%13.9" NUMBER 60 /end CHARACTERISTIC
/begin CHARACTERISTIC DINH_FId.DFC_ComGwIMG3RingCnt_CA "inhibitable FIds / FIds to be inhibited by inhibit source DFC_ComGwIMG3RingCnt" VAL_BLK 0x804DD1FA ValA_Wu16 968.000000000 DINH_FIdVerb 0.00 968.000000000 FORMAT "%13.9" NUMBER 60 /end CHARACTERISTIC
/begin CHARACTERISTIC DINH_FId.DFC_ComGwIMG3TOut_CA "inhibitable FIds / FIds to be inhibited by inhibit source DFC_ComGwIMG3TOut" VAL_BLK 0x804DD272 ValA_Wu16 968.000000000 DINH_FIdVerb 0.00 968.000000000 FORMAT "%13.9" NUMBER 60 /end CHARACTERISTIC
/begin CHARACTERISTIC DINH_FId.DFC_ComGwIMG4ChkSum_CA "inhibitable FIds / FIds to be inhibited by inhibit source DFC_ComGwIMG4ChkSum" VAL_BLK 0x804DD2EA ValA_Wu16 968.000000000 DINH_FIdVerb 0.00 968.000000000 FORMAT "%13.9" NUMBER 58 /end CHARACTERISTIC
/begin CHARACTERISTIC DINH_FId.DFC_ComGwIMG4RingCnt_CA "inhibitable FIds / FIds to be inhibited by inhibit source DFC_ComGwIMG4RingCnt" VAL_BLK 0x804DD35E ValA_Wu16 968.000000000 DINH_FIdVerb 0.00 968.000000000 FORMAT "%13.9" NUMBER 58 /end CHARACTERISTIC
/begin CHARACTERISTIC DINH_FId.DFC_ComGwIMG4TOut_CA "inhibitable FIds / FIds to be inhibited by inhibit source DFC_ComGwIMG4TOut" VAL_BLK 0x804DD3D2 ValA_Wu16 968.000000000 DINH_FIdVerb 0.00 968.000000000 FORMAT "%13.9" NUMBER 58 /end CHARACTERISTIC
/begin CHARACTERISTIC DINH_FId.DFC_ComGwIMG5ChkSum_CA "inhibitable FIds / FIds to be inhibited by inhibit source DFC_ComGwIMG5ChkSum" VAL_BLK 0x804DD446 ValA_Wu16 968.000000000 DINH_FIdVerb 0.00 968.000000000 FORMAT "%13.9" NUMBER 57 /end CHARACTERISTIC
/begin CHARACTERISTIC DINH_FId.DFC_ComGwIMG5RingCnt_CA "inhibitable FIds / FIds to be inhibited by inhibit source DFC_ComGwIMG5RingCnt" VAL_BLK 0x804DD4B8 ValA_Wu16 968.000000000 DINH_FIdVerb 0.00 968.000000000 FORMAT "%13.9" NUMBER 57 /end CHARACTERISTIC
/begin CHARACTERISTIC DINH_FId.DFC_ComGwIMG5TOut_CA "inhibitable FIds / FIds to be inhibited by inhibit source DFC_ComGwIMG5TOut" VAL_BLK 0x804DD52A ValA_Wu16 968.000000000 DINH_FIdVerb 0.00 968.000000000 FORMAT "%13.9" NUMBER 57 /end CHARACTERISTIC
/begin CHARACTERISTIC DINH_FId.DFC_ComGwIMG6ChkSum_CA "inhibitable FIds / FIds to be inhibited by inhibit source DFC_ComGwIMG6ChkSum" VAL_BLK 0x804DD59C ValA_Wu16 968.000000000 DINH_FIdVerb 0.00 968.000000000 FORMAT "%13.9" NUMBER 52 /end CHARACTERISTIC
/begin CHARACTERISTIC DINH_FId.DFC_ComGwIMG6RingCnt_CA "inhibitable FIds / FIds to be inhibited by inhibit source DFC_ComGwIMG6RingCnt" VAL_BLK 0x804DD604 ValA_Wu16 968.000000000 DINH_FIdVerb 0.00 968.000000000 FORMAT "%13.9" NUMBER 52 /end CHARACTERISTIC
/begin CHARACTERISTIC DINH_FId.DFC_ComGwIMG6TOut_CA "inhibitable FIds / FIds to be inhibited by inhibit source DFC_ComGwIMG6TOut" VAL_BLK 0x804DD66C ValA_Wu16 968.000000000 DINH_FIdVerb 0.00 968.000000000 FORMAT "%13.9" NUMBER 52 /end CHARACTERISTIC
/begin CHARACTERISTIC DINH_FId.DFC_ComIDASBChksum_CA "inhibitable FIds / FIds to be inhibited by inhibit source DFC_ComIDASBChksum" VAL_BLK 0x804DD6D4 ValA_Wu16 968.000000000 DINH_FIdVerb 0.00 968.000000000 FORMAT "%13.9" NUMBER 54 /end CHARACTERISTIC
/begin CHARACTERISTIC DINH_FId.DFC_ComIDASBRingCnt_CA "inhibitable FIds / FIds to be inhibited by inhibit source DFC_ComIDASBRingCnt" VAL_BLK 0x804DD740 ValA_Wu16 968.000000000 DINH_FIdVerb 0.00 968.000000000 FORMAT "%13.9" NUMBER 54 /end CHARACTERISTIC
/begin CHARACTERISTIC DINH_FId.DFC_ComIDASBTOut_CA "inhibitable FIds / FIds to be inhibited by inhibit source DFC_ComIDASBTOut" VAL_BLK 0x804DD7AC ValA_Wu16 968.000000000 DINH_FIdVerb 0.00 968.000000000 FORMAT "%13.9" NUMBER 54 /end CHARACTERISTIC
/begin CHARACTERISTIC DINH_FId.DFC_ComIMGMILReq_CA "inhibitable FIds / FIds to be inhibited by inhibit source DFC_ComIMGMILReq" VAL_BLK 0x804DD818 ValA_Wu16 968.000000000 DINH_FIdVerb 0.00 968.000000000 FORMAT "%13.9" NUMBER 50 /end CHARACTERISTIC
/begin CHARACTERISTIC DINH_FId.DFC_ComISSPrms_CA "inhibitable FIds / FIds to be inhibited by inhibit source DFC_ComISSPrms" VAL_BLK 0x804DD87C ValA_Wu16 968.000000000 DINH_FIdVerb 0.00 968.000000000 FORMAT "%13.9" NUMBER 51 /end CHARACTERISTIC
/begin CHARACTERISTIC DINH_FId.DFC_ComMETAChksum_CA "inhibitable FIds / FIds to be inhibited by inhibit source DFC_ComMETAChksum" VAL_BLK 0x804DD8E2 ValA_Wu16 968.000000000 DINH_FIdVerb 0.00 968.000000000 FORMAT "%13.9" NUMBER 65 /end CHARACTERISTIC
/begin CHARACTERISTIC DINH_FId.DFC_ComMETAChksumPstDrv_CA "inhibitable FIds / FIds to be inhibited by inhibit source DFC_ComMETAChksumPstDrv" VAL_BLK 0x804DD964 ValA_Wu16 968.000000000 DINH_FIdVerb 0.00 968.000000000 FORMAT "%13.9" NUMBER 50 /end CHARACTERISTIC
/begin CHARACTERISTIC DINH_FId.DFC_ComMETARingCnt_CA "inhibitable FIds / FIds to be inhibited by inhibit source DFC_ComMETARingCnt" VAL_BLK 0x804DD9C8 ValA_Wu16 968.000000000 DINH_FIdVerb 0.00 968.000000000 FORMAT "%13.9" NUMBER 65 /end CHARACTERISTIC
/begin CHARACTERISTIC DINH_FId.DFC_ComMETARingCntPstDrv_CA "inhibitable FIds / FIds to be inhibited by inhibit source DFC_ComMETARingCntPstDrv" VAL_BLK 0x804DDA4A ValA_Wu16 968.000000000 DINH_FIdVerb 0.00 968.000000000 FORMAT "%13.9" NUMBER 50 /end CHARACTERISTIC
/begin CHARACTERISTIC DINH_FId.DFC_ComMETATOut_CA "inhibitable FIds / FIds to be inhibited by inhibit source DFC_ComMETATOut" VAL_BLK 0x804DDAAE ValA_Wu16 968.000000000 DINH_FIdVerb 0.00 968.000000000 FORMAT "%13.9" NUMBER 65 /end CHARACTERISTIC
/begin CHARACTERISTIC DINH_FId.DFC_ComMETATOutPstDrv_CA "inhibitable FIds / FIds to be inhibited by inhibit source DFC_ComMETATOutPstDrv" VAL_BLK 0x804DDB30 ValA_Wu16 968.000000000 DINH_FIdVerb 0.00 968.000000000 FORMAT "%13.9" NUMBER 50 /end CHARACTERISTIC
/begin CHARACTERISTIC DINH_FId.DFC_ComMETCChksum_CA "inhibitable FIds / FIds to be inhibited by inhibit source DFC_ComMETCChksum" VAL_BLK 0x804DDB94 ValA_Wu16 968.000000000 DINH_FIdVerb 0.00 968.000000000 FORMAT "%13.9" NUMBER 64 /end CHARACTERISTIC
/begin CHARACTERISTIC DINH_FId.DFC_ComMETCRingCnt_CA "inhibitable FIds / FIds to be inhibited by inhibit source DFC_ComMETCRingCnt" VAL_BLK 0x804DDC14 ValA_Wu16 968.000000000 DINH_FIdVerb 0.00 968.000000000 FORMAT "%13.9" NUMBER 64 /end CHARACTERISTIC
/begin CHARACTERISTIC DINH_FId.DFC_ComMETCTOut_CA "inhibitable FIds / FIds to be inhibited by inhibit source DFC_ComMETCTOut" VAL_BLK 0x804DDC94 ValA_Wu16 968.000000000 DINH_FIdVerb 0.00 968.000000000 FORMAT "%13.9" NUMBER 64 /end CHARACTERISTIC
/begin CHARACTERISTIC DINH_FId.DFC_ComMETDChksum_CA "inhibitable FIds / FIds to be inhibited by inhibit source DFC_ComMETDChksum" VAL_BLK 0x804DDD14 ValA_Wu16 968.000000000 DINH_FIdVerb 0.00 968.000000000 FORMAT "%13.9" NUMBER 63 /end CHARACTERISTIC
/begin CHARACTERISTIC DINH_FId.DFC_ComMETDRingCnt_CA "inhibitable FIds / FIds to be inhibited by inhibit source DFC_ComMETDRingCnt" VAL_BLK 0x804DDD92 ValA_Wu16 968.000000000 DINH_FIdVerb 0.00 968.000000000 FORMAT "%13.9" NUMBER 63 /end CHARACTERISTIC
/begin CHARACTERISTIC DINH_FId.DFC_ComMETDTOut_CA "inhibitable FIds / FIds to be inhibited by inhibit source DFC_ComMETDTOut" VAL_BLK 0x804DDE10 ValA_Wu16 968.000000000 DINH_FIdVerb 0.00 968.000000000 FORMAT "%13.9" NUMBER 63 /end CHARACTERISTIC
/begin CHARACTERISTIC DINH_FId.DFC_ComMETE2Chksum_CA "inhibitable FIds / FIds to be inhibited by inhibit source DFC_ComMETE2Chksum" VAL_BLK 0x804DDE8E ValA_Wu16 968.000000000 DINH_FIdVerb 0.00 968.000000000 FORMAT "%13.9" NUMBER 62 /end CHARACTERISTIC
/begin CHARACTERISTIC DINH_FId.DFC_ComMETE2RingCnt_CA "inhibitable FIds / FIds to be inhibited by inhibit source DFC_ComMETE2RingCnt" VAL_BLK 0x804DDF0A ValA_Wu16 968.000000000 DINH_FIdVerb 0.00 968.000000000 FORMAT "%13.9" NUMBER 62 /end CHARACTERISTIC
/begin CHARACTERISTIC DINH_FId.DFC_ComMETE2TOut_CA "inhibitable FIds / FIds to be inhibited by inhibit source DFC_ComMETE2TOut" VAL_BLK 0x804DDF86 ValA_Wu16 968.000000000 DINH_FIdVerb 0.00 968.000000000 FORMAT "%13.9" NUMBER 62 /end CHARACTERISTIC
/begin CHARACTERISTIC DINH_FId.DFC_ComMETFChksum_CA "inhibitable FIds / FIds to be inhibited by inhibit source DFC_ComMETFChksum" VAL_BLK 0x804DE002 ValA_Wu16 968.000000000 DINH_FIdVerb 0.00 968.000000000 FORMAT "%13.9" NUMBER 62 /end CHARACTERISTIC
/begin CHARACTERISTIC DINH_FId.DFC_ComMETFRingCnt_CA "inhibitable FIds / FIds to be inhibited by inhibit source DFC_ComMETFRingCnt" VAL_BLK 0x804DE07E ValA_Wu16 968.000000000 DINH_FIdVerb 0.00 968.000000000 FORMAT "%13.9" NUMBER 62 /end CHARACTERISTIC
/begin CHARACTERISTIC DINH_FId.DFC_ComMETFTOut_CA "inhibitable FIds / FIds to be inhibited by inhibit source DFC_ComMETFTOut" VAL_BLK 0x804DE0FA ValA_Wu16 968.000000000 DINH_FIdVerb 0.00 968.000000000 FORMAT "%13.9" NUMBER 62 /end CHARACTERISTIC
/begin CHARACTERISTIC DINH_FId.DFC_ComMETGChksum_CA "inhibitable FIds / FIds to be inhibited by inhibit source DFC_ComMETGChksum" VAL_BLK 0x804DE176 ValA_Wu16 968.000000000 DINH_FIdVerb 0.00 968.000000000 FORMAT "%13.9" NUMBER 62 /end CHARACTERISTIC
/begin CHARACTERISTIC DINH_FId.DFC_ComMETGRingCnt_CA "inhibitable FIds / FIds to be inhibited by inhibit source DFC_ComMETGRingCnt" VAL_BLK 0x804DE1F2 ValA_Wu16 968.000000000 DINH_FIdVerb 0.00 968.000000000 FORMAT "%13.9" NUMBER 62 /end CHARACTERISTIC
/begin CHARACTERISTIC DINH_FId.DFC_ComMETGTOut_CA "inhibitable FIds / FIds to be inhibited by inhibit source DFC_ComMETGTOut" VAL_BLK 0x804DE26E ValA_Wu16 968.000000000 DINH_FIdVerb 0.00 968.000000000 FORMAT "%13.9" NUMBER 62 /end CHARACTERISTIC
/begin CHARACTERISTIC DINH_FId.DFC_ComMETH2Chksum_CA "inhibitable FIds / FIds to be inhibited by inhibit source DFC_ComMETH2Chksum" VAL_BLK 0x804DE2EA ValA_Wu16 968.000000000 DINH_FIdVerb 0.00 968.000000000 FORMAT "%13.9" NUMBER 62 /end CHARACTERISTIC
/begin CHARACTERISTIC DINH_FId.DFC_ComMETH2RingCnt_CA "inhibitable FIds / FIds to be inhibited by inhibit source DFC_ComMETH2RingCnt" VAL_BLK 0x804DE366 ValA_Wu16 968.000000000 DINH_FIdVerb 0.00 968.000000000 FORMAT "%13.9" NUMBER 62 /end CHARACTERISTIC
/begin CHARACTERISTIC DINH_FId.DFC_ComMETH2TOut_CA "inhibitable FIds / FIds to be inhibited by inhibit source DFC_ComMETH2TOut" VAL_BLK 0x804DE3E2 ValA_Wu16 968.000000000 DINH_FIdVerb 0.00 968.000000000 FORMAT "%13.9" NUMBER 62 /end CHARACTERISTIC
/begin CHARACTERISTIC DINH_FId.DFC_ComMETHChksum_CA "inhibitable FIds / FIds to be inhibited by inhibit source DFC_ComMETHChksum" VAL_BLK 0x804DE45E ValA_Wu16 968.000000000 DINH_FIdVerb 0.00 968.000000000 FORMAT "%13.9" NUMBER 62 /end CHARACTERISTIC
/begin CHARACTERISTIC DINH_FId.DFC_ComMETHRingCnt_CA "inhibitable FIds / FIds to be inhibited by inhibit source DFC_ComMETHRingCnt" VAL_BLK 0x804DE4DA ValA_Wu16 968.000000000 DINH_FIdVerb 0.00 968.000000000 FORMAT "%13.9" NUMBER 62 /end CHARACTERISTIC
/begin CHARACTERISTIC DINH_FId.DFC_ComMETHTOut_CA "inhibitable FIds / FIds to be inhibited by inhibit source DFC_ComMETHTOut" VAL_BLK 0x804DE556 ValA_Wu16 968.000000000 DINH_FIdVerb 0.00 968.000000000 FORMAT "%13.9" NUMBER 62 /end CHARACTERISTIC
/begin CHARACTERISTIC DINH_FId.DFC_ComMETIChksum_CA "inhibitable FIds / FIds to be inhibited by inhibit source DFC_ComMETIChksum" VAL_BLK 0x804DE5D2 ValA_Wu16 968.000000000 DINH_FIdVerb 0.00 968.000000000 FORMAT "%13.9" NUMBER 69 /end CHARACTERISTIC
/begin CHARACTERISTIC DINH_FId.DFC_ComMETIRingCnt_CA "inhibitable FIds / FIds to be inhibited by inhibit source DFC_ComMETIRingCnt" VAL_BLK 0x804DE65C ValA_Wu16 968.000000000 DINH_FIdVerb 0.00 968.000000000 FORMAT "%13.9" NUMBER 69 /end CHARACTERISTIC
/begin CHARACTERISTIC DINH_FId.DFC_ComMETITOut_CA "inhibitable FIds / FIds to be inhibited by inhibit source DFC_ComMETITOut" VAL_BLK 0x804DE6E6 ValA_Wu16 968.000000000 DINH_FIdVerb 0.00 968.000000000 FORMAT "%13.9" NUMBER 69 /end CHARACTERISTIC
/begin CHARACTERISTIC DINH_FId.DFC_ComMETKChksum_CA "inhibitable FIds / FIds to be inhibited by inhibit source DFC_ComMETKChksum" VAL_BLK 0x804DE770 ValA_Wu16 968.000000000 DINH_FIdVerb 0.00 968.000000000 FORMAT "%13.9" NUMBER 62 /end CHARACTERISTIC
/begin CHARACTERISTIC DINH_FId.DFC_ComMETKRingCnt_CA "inhibitable FIds / FIds to be inhibited by inhibit source DFC_ComMETKRingCnt" VAL_BLK 0x804DE7EC ValA_Wu16 968.000000000 DINH_FIdVerb 0.00 968.000000000 FORMAT "%13.9" NUMBER 62 /end CHARACTERISTIC
/begin CHARACTERISTIC DINH_FId.DFC_ComMETKTOut_CA "inhibitable FIds / FIds to be inhibited by inhibit source DFC_ComMETKTOut" VAL_BLK 0x804DE868 ValA_Wu16 968.000000000 DINH_FIdVerb 0.00 968.000000000 FORMAT "%13.9" NUMBER 62 /end CHARACTERISTIC
/begin CHARACTERISTIC DINH_FId.DFC_ComMETLChksum_CA "inhibitable FIds / FIds to be inhibited by inhibit source DFC_ComMETLChksum" VAL_BLK 0x804DE8E4 ValA_Wu16 968.000000000 DINH_FIdVerb 0.00 968.000000000 FORMAT "%13.9" NUMBER 62 /end CHARACTERISTIC
/begin CHARACTERISTIC DINH_FId.DFC_ComMETLRingCnt_CA "inhibitable FIds / FIds to be inhibited by inhibit source DFC_ComMETLRingCnt" VAL_BLK 0x804DE960 ValA_Wu16 968.000000000 DINH_FIdVerb 0.00 968.000000000 FORMAT "%13.9" NUMBER 62 /end CHARACTERISTIC
/begin CHARACTERISTIC DINH_FId.DFC_ComMETLTOut_CA "inhibitable FIds / FIds to be inhibited by inhibit source DFC_ComMETLTOut" VAL_BLK 0x804DE9DC ValA_Wu16 968.000000000 DINH_FIdVerb 0.00 968.000000000 FORMAT "%13.9" NUMBER 62 /end CHARACTERISTIC
/begin CHARACTERISTIC DINH_FId.DFC_ComMETMChksum_CA "inhibitable FIds / FIds to be inhibited by inhibit source DFC_ComMETMChksum" VAL_BLK 0x804DEA58 ValA_Wu16 968.000000000 DINH_FIdVerb 0.00 968.000000000 FORMAT "%13.9" NUMBER 61 /end CHARACTERISTIC
/begin CHARACTERISTIC DINH_FId.DFC_ComMETMRingCnt_CA "inhibitable FIds / FIds to be inhibited by inhibit source DFC_ComMETMRingCnt" VAL_BLK 0x804DEAD2 ValA_Wu16 968.000000000 DINH_FIdVerb 0.00 968.000000000 FORMAT "%13.9" NUMBER 61 /end CHARACTERISTIC
/begin CHARACTERISTIC DINH_FId.DFC_ComMETMTOut_CA "inhibitable FIds / FIds to be inhibited by inhibit source DFC_ComMETMTOut" VAL_BLK 0x804DEB4C ValA_Wu16 968.000000000 DINH_FIdVerb 0.00 968.000000000 FORMAT "%13.9" NUMBER 61 /end CHARACTERISTIC
/begin CHARACTERISTIC DINH_FId.DFC_ComMETNChksum_CA "inhibitable FIds / FIds to be inhibited by inhibit source DFC_ComMETNChksum" VAL_BLK 0x804DEBC6 ValA_Wu16 968.000000000 DINH_FIdVerb 0.00 968.000000000 FORMAT "%13.9" NUMBER 62 /end CHARACTERISTIC
/begin CHARACTERISTIC DINH_FId.DFC_ComMETNRingCnt_CA "inhibitable FIds / FIds to be inhibited by inhibit source DFC_ComMETNRingCnt" VAL_BLK 0x804DEC42 ValA_Wu16 968.000000000 DINH_FIdVerb 0.00 968.000000000 FORMAT "%13.9" NUMBER 62 /end CHARACTERISTIC
/begin CHARACTERISTIC DINH_FId.DFC_ComMETNTOut_CA "inhibitable FIds / FIds to be inhibited by inhibit source DFC_ComMETNTOut" VAL_BLK 0x804DECBE ValA_Wu16 968.000000000 DINH_FIdVerb 0.00 968.000000000 FORMAT "%13.9" NUMBER 62 /end CHARACTERISTIC
/begin CHARACTERISTIC DINH_FId.DFC_ComMtrCom_CA "inhibitable FIds / FIds to be inhibited by inhibit source DFC_ComMtrCom" VAL_BLK 0x804DED3A ValA_Wu16 968.000000000 DINH_FIdVerb 0.00 968.000000000 FORMAT "%13.9" NUMBER 51 /end CHARACTERISTIC
/begin CHARACTERISTIC DINH_FId.DFC_ComPCUChkSum_CA "inhibitable FIds / FIds to be inhibited by inhibit source DFC_ComPCUChkSum" VAL_BLK 0x804DEDA0 ValA_Wu16 968.000000000 DINH_FIdVerb 0.00 968.000000000 FORMAT "%13.9" NUMBER 58 /end CHARACTERISTIC
/begin CHARACTERISTIC DINH_FId.DFC_ComPCURingCnt_CA "inhibitable FIds / FIds to be inhibited by inhibit source DFC_ComPCURingCnt" VAL_BLK 0x804DEE14 ValA_Wu16 968.000000000 DINH_FIdVerb 0.00 968.000000000 FORMAT "%13.9" NUMBER 58 /end CHARACTERISTIC
/begin CHARACTERISTIC DINH_FId.DFC_ComPCUTOut_CA "inhibitable FIds / FIds to be inhibited by inhibit source DFC_ComPCUTOut" VAL_BLK 0x804DEE88 ValA_Wu16 968.000000000 DINH_FIdVerb 0.00 968.000000000 FORMAT "%13.9" NUMBER 58 /end CHARACTERISTIC
/begin MEASUREMENT DINH_stFId.FId_ElecLdRplVal "Inhibit Status of FIds / Status of function identifier FId_ElecLdRplVal" UWORD DFC_OneToOne 1 100 0.00 65535.00 FORMAT "%8.2" ECU_ADDRESS 0x60014374 /end MEASUREMENT
/begin MEASUREMENT DINH_stFId.FId_ElecLoadEPSComErr "Inhibit Status of FIds / Status of function identifier FId_ElecLoadEPSComErr" UWORD DFC_OneToOne 1 100 0.00 65535.00 FORMAT "%8.2" ECU_ADDRESS 0x60014376 /end MEASUREMENT
/begin MEASUREMENT DINH_stFId.FId_EngBlkTWrn "Inhibit Status of FIds / Status of function identifier FId_EngBlkTWrn" UWORD DFC_OneToOne 1 100 0.00 65535.00 FORMAT "%8.2" ECU_ADDRESS 0x60014378 /end MEASUREMENT
/begin MEASUREMENT DINH_stFId.FId_EngCooltTFail "Inhibit Status of FIds / Status of function identifier FId_EngCooltTFail" UWORD DFC_OneToOne 1 100 0.00 65535.00 FORMAT "%8.2" ECU_ADDRESS 0x6001437A /end MEASUREMENT
/begin MEASUREMENT DINH_stFId.FId_EngDemTqLimnCamsftErr "Inhibit Status of FIds / Status of function identifier FId_EngDemTqLimnCamsftErr" UWORD DFC_OneToOne 1 100 0.00 65535.00 FORMAT "%8.2" ECU_ADDRESS 0x6001437C /end MEASUREMENT
/begin MEASUREMENT DINH_stFId.FId_EngDemTqLimnErrThmstHeatCtrlCirc "Inhibit Status of FIds / Status of function identifier FId_EngDemTqLimnErrThmstHeatCtrlCirc" UWORD DFC_OneToOne 1 100 0.00 65535.00 FORMAT "%8.2" ECU_ADDRESS 0x6001437E /end MEASUREMENT
/begin MEASUREMENT DINH_stFId.FId_EngDemTqLimnOilPmp "Inhibit Status of FIds / Status of function identifier FId_EngDemTqLimnOilPmp" UWORD DFC_OneToOne 1 100 0.00 65535.00 FORMAT "%8.2" ECU_ADDRESS 0x60014380 /end MEASUREMENT
/begin MEASUREMENT DINH_stFId.FId_EngDemTrqLimErrAPP "Inhibit Status of FIds / Status of function identifier FId_EngDemTrqLimErrAPP" UWORD DFC_OneToOne 1 100 0.00 65535.00 FORMAT "%8.2" ECU_ADDRESS 0x60014382 /end MEASUREMENT
/begin MEASUREMENT DINH_stFId.FId_EngIntkAirFail "Inhibit Status of FIds / Status of function identifier FId_EngIntkAirFail" UWORD DFC_OneToOne 1 100 0.00 65535.00 FORMAT "%8.2" ECU_ADDRESS 0x60014384 /end MEASUREMENT
/begin MEASUREMENT DINH_stFId.FId_EngPrtErrVehV "Inhibit Status of FIds / Status of function identifier FId_EngPrtErrVehV" UWORD DFC_OneToOne 1 100 0.00 65535.00 FORMAT "%8.2" ECU_ADDRESS 0x60014386 /end MEASUREMENT
/begin MEASUREMENT DINH_stFId.FId_EngSpd30DegFail "Inhibit Status of FIds / Status of function identifier FId_EngSpd30DegFail" UWORD DFC_OneToOne 1 100 0.00 65535.00 FORMAT "%8.2" ECU_ADDRESS 0x60014388 /end MEASUREMENT
/begin MEASUREMENT DINH_stFId.FId_EngStrtEnaEthAdap "Inhibit Status of FIds / Status of function identifier FId_EngStrtEnaEthAdap" UWORD DFC_OneToOne 1 100 0.00 65535.00 FORMAT "%8.2" ECU_ADDRESS 0x6001438A /end MEASUREMENT
/begin MEASUREMENT DINH_stFId.FId_EngStrt_EnaCep "Inhibit Status of FIds / Status of function identifier FId_EngStrt_EnaCep" UWORD DFC_OneToOne 1 100 0.00 65535.00 FORMAT "%8.2" ECU_ADDRESS 0x6001438C /end MEASUREMENT
/begin MEASUREMENT DINH_stFId.FId_EngStrt_InjProhb "Inhibit Status of FIds / Status of function identifier FId_EngStrt_InjProhb" UWORD DFC_OneToOne 1 100 0.00 65535.00 FORMAT "%8.2" ECU_ADDRESS 0x6001438E /end MEASUREMENT
/begin MEASUREMENT DINH_stFId.FId_EngStrt_VehVInhb "Inhibit Status of FIds / Status of function identifier FId_EngStrt_VehVInhb" UWORD DFC_OneToOne 1 100 0.00 65535.00 FORMAT "%8.2" ECU_ADDRESS 0x60014390 /end MEASUREMENT
/begin MEASUREMENT DINH_stFId.FId_EngTqRvsnEnaFlg "Inhibit Status of FIds / Status of function identifier FId_EngTqRvsnEnaFlg" UWORD DFC_OneToOne 1 100 0.00 65535.00 FORMAT "%8.2" ECU_ADDRESS 0x60014392 /end MEASUREMENT
/begin MEASUREMENT DINH_stFId.FId_EnvTPrimMod "Inhibit Status of FIds / Status of function identifier FId_EnvTPrimMod" UWORD DFC_OneToOne 1 100 0.00 65535.00 FORMAT "%8.2" ECU_ADDRESS 0x60014394 /end MEASUREMENT
/begin MEASUREMENT DINH_stFId.FId_EnvTPrimModIniVal "Inhibit Status of FIds / Status of function identifier FId_EnvTPrimModIniVal" UWORD DFC_OneToOne 1 100 0.00 65535.00 FORMAT "%8.2" ECU_ADDRESS 0x60014396 /end MEASUREMENT
/begin MEASUREMENT DINH_stFId.FId_EnvTSensSum "Inhibit Status of FIds / Status of function identifier FId_EnvTSensSum" UWORD DFC_OneToOne 1 100 0.00 65535.00 FORMAT "%8.2" ECU_ADDRESS 0x60014398 /end MEASUREMENT
/begin MEASUREMENT DINH_stFId.FId_EnvTtAirFltDs "Inhibit Status of FIds / Status of function identifier FId_EnvTtAirFltDs" UWORD DFC_OneToOne 1 100 0.00 65535.00 FORMAT "%8.2" ECU_ADDRESS 0x6001439A /end MEASUREMENT
/begin MEASUREMENT DINH_stFId.FId_EnvTtCEngDsT "Inhibit Status of FIds / Status of function identifier FId_EnvTtCEngDsT" UWORD DFC_OneToOne 1 100 0.00 65535.00 FORMAT "%8.2" ECU_ADDRESS 0x6001439C /end MEASUREMENT
/begin MEASUREMENT DINH_stFId.FId_EnvTtIntkMnfld "Inhibit Status of FIds / Status of function identifier FId_EnvTtIntkMnfld" UWORD DFC_OneToOne 1 100 0.00 65535.00 FORMAT "%8.2" ECU_ADDRESS 0x6001439E /end MEASUREMENT
/begin MEASUREMENT DINH_stFId.FId_EomCvoAllwd "Inhibit Status of FIds / Status of function identifier FId_EomCvoAllwd" UWORD DFC_OneToOne 1 100 0.00 65535.00 FORMAT "%8.2" ECU_ADDRESS 0x600143A0 /end MEASUREMENT
/begin MEASUREMENT DINH_stFId.FId_EpmBCr "Inhibit Status of FIds / Status of function identifier FId_EpmBCr" UWORD DFC_OneToOne 1 100 0.00 65535.00 FORMAT "%8.2" ECU_ADDRESS 0x600143A2 /end MEASUREMENT
/begin MEASUREMENT DINH_stFId.FId_EpmCaSAdapCaSI1 "Inhibit Status of FIds / Status of function identifier FId_EpmCaSAdapCaSI1" UWORD DFC_OneToOne 1 100 0.00 65535.00 FORMAT "%8.2" ECU_ADDRESS 0x600143A4 /end MEASUREMENT
/begin MEASUREMENT DINH_stFId.FId_EpmCaSAdapRstI1 "Inhibit Status of FIds / Status of function identifier FId_EpmCaSAdapRstI1" UWORD DFC_OneToOne 1 100 0.00 65535.00 FORMAT "%8.2" ECU_ADDRESS 0x600143A6 /end MEASUREMENT
/begin MEASUREMENT DINH_stFId.FId_EpmCaSDiagI1 "Inhibit Status of FIds / Status of function identifier FId_EpmCaSDiagI1" UWORD DFC_OneToOne 1 100 0.00 65535.00 FORMAT "%8.2" ECU_ADDRESS 0x600143A8 /end MEASUREMENT
/begin MEASUREMENT DINH_stFId.FId_EpmCaSErrCaSI1 "Inhibit Status of FIds / Status of function identifier FId_EpmCaSErrCaSI1" UWORD DFC_OneToOne 1 100 0.00 65535.00 FORMAT "%8.2" ECU_ADDRESS 0x600143AA /end MEASUREMENT
/begin MEASUREMENT DINH_stFId.FId_EpmCaSOfsDiagCaSI1 "Inhibit Status of FIds / Status of function identifier FId_EpmCaSOfsDiagCaSI1" UWORD DFC_OneToOne 1 100 0.00 65535.00 FORMAT "%8.2" ECU_ADDRESS 0x600143AC /end MEASUREMENT
/begin MEASUREMENT DINH_stFId.FId_EpmCaSOfsErrCaSI1 "Inhibit Status of FIds / Status of function identifier FId_EpmCaSOfsErrCaSI1" UWORD DFC_OneToOne 1 100 0.00 65535.00 FORMAT "%8.2" ECU_ADDRESS 0x600143AE /end MEASUREMENT
/begin MEASUREMENT DINH_stFId.FId_EpmCaSSegI1 "Inhibit Status of FIds / Status of function identifier FId_EpmCaSSegI1" UWORD DFC_OneToOne 1 100 0.00 65535.00 FORMAT "%8.2" ECU_ADDRESS 0x600143B0 /end MEASUREMENT
/begin MEASUREMENT DINH_stFId.FId_EpmCaSSpdPlausI1 "Inhibit Status of FIds / Status of function identifier FId_EpmCaSSpdPlausI1" UWORD DFC_OneToOne 1 100 0.00 65535.00 FORMAT "%8.2" ECU_ADDRESS 0x600143B2 /end MEASUREMENT
/begin MEASUREMENT DINH_stFId.FId_EpmCrSDiag "Inhibit Status of FIds / Status of function identifier FId_EpmCrSDiag" UWORD DFC_OneToOne 1 100 0.00 65535.00 FORMAT "%8.2" ECU_ADDRESS 0x600143B4 /end MEASUREMENT
/begin MEASUREMENT DINH_stFId.FId_EpmCrSDiagVeh "Inhibit Status of FIds / Status of function identifier FId_EpmCrSDiagVeh" UWORD DFC_OneToOne 1 100 0.00 65535.00 FORMAT "%8.2" ECU_ADDRESS 0x600143B6 /end MEASUREMENT
/begin MEASUREMENT DINH_stFId.FId_EpmCrSErr "Inhibit Status of FIds / Status of function identifier FId_EpmCrSErr" UWORD DFC_OneToOne 1 100 0.00 65535.00 FORMAT "%8.2" ECU_ADDRESS 0x600143B8 /end MEASUREMENT
/begin MEASUREMENT DINH_stFId.FId_EpmOpMode_ALELock "Inhibit Status of FIds / Status of function identifier FId_EpmOpMode_ALELock" UWORD DFC_OneToOne 1 100 0.00 65535.00 FORMAT "%8.2" ECU_ADDRESS 0x600143BA /end MEASUREMENT
/begin MEASUREMENT DINH_stFId.FId_EpmOpMode_DirStLock "Inhibit Status of FIds / Status of function identifier FId_EpmOpMode_DirStLock" UWORD DFC_OneToOne 1 100 0.00 65535.00 FORMAT "%8.2" ECU_ADDRESS 0x600143BC /end MEASUREMENT
/begin MEASUREMENT DINH_stFId.FId_EpmRRSCrSFaultCheck "Inhibit Status of FIds / Status of function identifier FId_EpmRRSCrSFaultCheck" UWORD DFC_OneToOne 1 100 0.00 65535.00 FORMAT "%8.2" ECU_ADDRESS 0x600143BE /end MEASUREMENT
/begin MEASUREMENT DINH_stFId.FId_EpmRRSDGIFaultCheck "Inhibit Status of FIds / Status of function identifier FId_EpmRRSDGIFaultCheck" UWORD DFC_OneToOne 1 100 0.00 65535.00 FORMAT "%8.2" ECU_ADDRESS 0x600143C0 /end MEASUREMENT
/begin MEASUREMENT DINH_stFId.FId_EpmRRSRdCheck "Inhibit Status of FIds / Status of function identifier FId_EpmRRSRdCheck" UWORD DFC_OneToOne 1 100 0.00 65535.00 FORMAT "%8.2" ECU_ADDRESS 0x600143C2 /end MEASUREMENT
/begin MEASUREMENT DINH_stFId.FId_EpmRRSVehVFaultChck "Inhibit Status of FIds / Status of function identifier FId_EpmRRSVehVFaultChck" UWORD DFC_OneToOne 1 100 0.00 65535.00 FORMAT "%8.2" ECU_ADDRESS 0x600143C4 /end MEASUREMENT
/begin MEASUREMENT DINH_stFId.FId_EpmSynLockCaSSync "Inhibit Status of FIds / Status of function identifier FId_EpmSynLockCaSSync" UWORD DFC_OneToOne 1 100 0.00 65535.00 FORMAT "%8.2" ECU_ADDRESS 0x600143C6 /end MEASUREMENT
/begin MEASUREMENT DINH_stFId.FId_EpmTmpSuppRvsRotCASI1 "Inhibit Status of FIds / Status of function identifier FId_EpmTmpSuppRvsRotCASI1" UWORD DFC_OneToOne 1 100 0.00 65535.00 FORMAT "%8.2" ECU_ADDRESS 0x600143C8 /end MEASUREMENT
/begin MEASUREMENT DINH_stFId.FId_EtaEngIdleNonCsers "Inhibit Status of FIds / Status of function identifier FId_EtaEngIdleNonCsers" UWORD DFC_OneToOne 1 100 0.00 65535.00 FORMAT "%8.2" ECU_ADDRESS 0x600143CA /end MEASUREMENT
/begin MEASUREMENT DINH_stFId.FId_EtaEngPtlNonCsers "Inhibit Status of FIds / Status of function identifier FId_EtaEngPtlNonCsers" UWORD DFC_OneToOne 1 100 0.00 65535.00 FORMAT "%8.2" ECU_ADDRESS 0x600143CC /end MEASUREMENT
/begin MEASUREMENT DINH_stFId.FId_EthnlSnsrErrCdn "Inhibit Status of FIds / Status of function identifier FId_EthnlSnsrErrCdn" UWORD DFC_OneToOne 1 100 0.00 65535.00 FORMAT "%8.2" ECU_ADDRESS 0x600143CE /end MEASUREMENT
/begin MEASUREMENT DINH_stFId.FId_EvapActrCcvElecDiag "Inhibit Status of FIds / Status of function identifier FId_EvapActrCcvElecDiag" UWORD DFC_OneToOne 1 100 0.00 65535.00 FORMAT "%8.2" ECU_ADDRESS 0x600143D0 /end MEASUREMENT
/begin MEASUREMENT DINH_stFId.FId_EvapPSnsrTankPhyRngChk "Inhibit Status of FIds / Status of function identifier FId_EvapPSnsrTankPhyRngChk" UWORD DFC_OneToOne 1 100 0.00 65535.00 FORMAT "%8.2" ECU_ADDRESS 0x600143D2 /end MEASUREMENT
/begin MEASUREMENT DINH_stFId.FId_FanCtlACClntP "Inhibit Status of FIds / Status of function identifier FId_FanCtlACClntP" UWORD DFC_OneToOne 1 100 0.00 65535.00 FORMAT "%8.2" ECU_ADDRESS 0x600143D4 /end MEASUREMENT
/begin MEASUREMENT DINH_stFId.FId_FanCtlACGModFail "Inhibit Status of FIds / Status of function identifier FId_FanCtlACGModFail" UWORD DFC_OneToOne 1 100 0.00 65535.00 FORMAT "%8.2" ECU_ADDRESS 0x600143D6 /end MEASUREMENT
/begin MEASUREMENT DINH_stFId.FId_FanCtlAPP1 "Inhibit Status of FIds / Status of function identifier FId_FanCtlAPP1" UWORD DFC_OneToOne 1 100 0.00 65535.00 FORMAT "%8.2" ECU_ADDRESS 0x600143D8 /end MEASUREMENT
/begin MEASUREMENT DINH_stFId.FId_FanCtlAPP2 "Inhibit Status of FIds / Status of function identifier FId_FanCtlAPP2" UWORD DFC_OneToOne 1 100 0.00 65535.00 FORMAT "%8.2" ECU_ADDRESS 0x600143DA /end MEASUREMENT
/begin MEASUREMENT DINH_stFId.FId_FanCtlAPPSync "Inhibit Status of FIds / Status of function identifier FId_FanCtlAPPSync" UWORD DFC_OneToOne 1 100 0.00 65535.00 FORMAT "%8.2" ECU_ADDRESS 0x600143DC /end MEASUREMENT
/begin MEASUREMENT DINH_stFId.FId_FanCtlBlowrU "Inhibit Status of FIds / Status of function identifier FId_FanCtlBlowrU" UWORD DFC_OneToOne 1 100 0.00 65535.00 FORMAT "%8.2" ECU_ADDRESS 0x600143DE /end MEASUREMENT
/begin MEASUREMENT DINH_stFId.FId_FanCtlCooltT "Inhibit Status of FIds / Status of function identifier FId_FanCtlCooltT" UWORD DFC_OneToOne 1 100 0.00 65535.00 FORMAT "%8.2" ECU_ADDRESS 0x600143E0 /end MEASUREMENT
/begin MEASUREMENT DINH_stFId.FId_FanCtlCooltT2 "Inhibit Status of FIds / Status of function identifier FId_FanCtlCooltT2" UWORD DFC_OneToOne 1 100 0.00 65535.00 FORMAT "%8.2" ECU_ADDRESS 0x600143E2 /end MEASUREMENT
/begin MEASUREMENT DINH_stFId.FId_FanCtlEnvT "Inhibit Status of FIds / Status of function identifier FId_FanCtlEnvT" UWORD DFC_OneToOne 1 100 0.00 65535.00 FORMAT "%8.2" ECU_ADDRESS 0x600143E4 /end MEASUREMENT
/begin MEASUREMENT DINH_stFId.FId_FanCtlLiSwtInfo "Inhibit Status of FIds / Status of function identifier FId_FanCtlLiSwtInfo" UWORD DFC_OneToOne 1 100 0.00 65535.00 FORMAT "%8.2" ECU_ADDRESS 0x600143E6 /end MEASUREMENT
/begin MEASUREMENT DINH_stFId.FId_FanCtlSpd "Inhibit Status of FIds / Status of function identifier FId_FanCtlSpd" UWORD DFC_OneToOne 1 100 0.00 65535.00 FORMAT "%8.2" ECU_ADDRESS 0x600143E8 /end MEASUREMENT
/begin MEASUREMENT DINH_stFId.FId_FanCtlTSnsrErr "Inhibit Status of FIds / Status of function identifier FId_FanCtlTSnsrErr" UWORD DFC_OneToOne 1 100 0.00 65535.00 FORMAT "%8.2" ECU_ADDRESS 0x600143EA /end MEASUREMENT
/begin MEASUREMENT DINH_stFId.FId_FanCtlThr1 "Inhibit Status of FIds / Status of function identifier FId_FanCtlThr1" UWORD DFC_OneToOne 1 100 0.00 65535.00 FORMAT "%8.2" ECU_ADDRESS 0x600143EC /end MEASUREMENT
/begin MEASUREMENT DINH_stFId.FId_FanCtlThr2 "Inhibit Status of FIds / Status of function identifier FId_FanCtlThr2" UWORD DFC_OneToOne 1 100 0.00 65535.00 FORMAT "%8.2" ECU_ADDRESS 0x600143EE /end MEASUREMENT
/begin MEASUREMENT DINH_stFId.FId_FcoReq "Inhibit Status of FIds / Status of function identifier FId_FcoReq" UWORD DFC_OneToOne 1 100 0.00 65535.00 FORMAT "%8.2" ECU_ADDRESS 0x600143F0 /end MEASUREMENT
/begin MEASUREMENT DINH_stFId.FId_FiMFID_rba_MRly_Diag_Stk "Inhibit Status of FIds / Status of function identifier FId_FiMFID_rba_MRly_Diag_Stk" UWORD DFC_OneToOne 1 100 0.00 65535.00 FORMAT "%8.2" ECU_ADDRESS 0x600143F2 /end MEASUREMENT
/begin MEASUREMENT DINH_stFId.FId_FlComErr "Inhibit Status of FIds / Status of function identifier FId_FlComErr" UWORD DFC_OneToOne 1 100 0.00 65535.00 FORMAT "%8.2" ECU_ADDRESS 0x600143F4 /end MEASUREMENT
/begin MEASUREMENT DINH_stFId.FId_FlDevPlauDiagFuSnsr "Inhibit Status of FIds / Status of function identifier FId_FlDevPlauDiagFuSnsr" UWORD DFC_OneToOne 1 100 0.00 65535.00 FORMAT "%8.2" ECU_ADDRESS 0x600143F6 /end MEASUREMENT
/begin MEASUREMENT DINH_stFId.FId_FlLvlNoSigErr "Inhibit Status of FIds / Status of function identifier FId_FlLvlNoSigErr" UWORD DFC_OneToOne 1 100 0.00 65535.00 FORMAT "%8.2" ECU_ADDRESS 0x600143F8 /end MEASUREMENT
/begin MEASUREMENT DINH_stFId.FId_FlLvlVehSpdSigErr "Inhibit Status of FIds / Status of function identifier FId_FlLvlVehSpdSigErr" UWORD DFC_OneToOne 1 100 0.00 65535.00 FORMAT "%8.2" ECU_ADDRESS 0x600143FA /end MEASUREMENT
/begin MEASUREMENT DINH_stFId.FId_FlLvlVehVErr "Inhibit Status of FIds / Status of function identifier FId_FlLvlVehVErr" UWORD DFC_OneToOne 1 100 0.00 65535.00 FORMAT "%8.2" ECU_ADDRESS 0x600143FC /end MEASUREMENT
/begin MEASUREMENT DINH_stFId.FId_FlMALamDynDiag "Inhibit Status of FIds / Status of function identifier FId_FlMALamDynDiag" UWORD DFC_OneToOne 1 100 0.00 65535.00 FORMAT "%8.2" ECU_ADDRESS 0x600143FE /end MEASUREMENT
/begin MEASUREMENT DINH_stFId.FId_FlSplGAltLin "Inhibit Status of FIds / Status of function identifier FId_FlSplGAltLin" UWORD DFC_OneToOne 1 100 0.00 65535.00 FORMAT "%8.2" ECU_ADDRESS 0x60014400 /end MEASUREMENT
/begin MEASUREMENT DINH_stFId.FId_FlTnkQnt "Inhibit Status of FIds / Status of function identifier FId_FlTnkQnt" UWORD DFC_OneToOne 1 100 0.00 65535.00 FORMAT "%8.2" ECU_ADDRESS 0x60014402 /end MEASUREMENT
/begin MEASUREMENT DINH_stFId.FId_FuMixHotFilmErr "Inhibit Status of FIds / Status of function identifier FId_FuMixHotFilmErr" UWORD DFC_OneToOne 1 100 0.00 65535.00 FORMAT "%8.2" ECU_ADDRESS 0x60014404 /end MEASUREMENT
/begin MEASUREMENT DINH_stFId.FId_FuMixUegoErrExcl "Inhibit Status of FIds / Status of function identifier FId_FuMixUegoErrExcl" UWORD DFC_OneToOne 1 100 0.00 65535.00 FORMAT "%8.2" ECU_ADDRESS 0x60014406 /end MEASUREMENT
/begin MEASUREMENT DINH_stFId.FId_FuPHiRailEthnlSnsrErr "Inhibit Status of FIds / Status of function identifier FId_FuPHiRailEthnlSnsrErr" UWORD DFC_OneToOne 1 100 0.00 65535.00 FORMAT "%8.2" ECU_ADDRESS 0x60014408 /end MEASUREMENT
/begin MEASUREMENT DINH_stFId.FId_FuPurg_TEVError "Inhibit Status of FIds / Status of function identifier FId_FuPurg_TEVError" UWORD DFC_OneToOne 1 100 0.00 65535.00 FORMAT "%8.2" ECU_ADDRESS 0x6001440A /end MEASUREMENT
/begin MEASUREMENT DINH_stFId.FId_FuSnsrPhyRngErr "Inhibit Status of FIds / Status of function identifier FId_FuSnsrPhyRngErr" UWORD DFC_OneToOne 1 100 0.00 65535.00 FORMAT "%8.2" ECU_ADDRESS 0x6001440C /end MEASUREMENT
/begin MEASUREMENT DINH_stFId.FId_GEVCtlAVCAdprCBBNWEErrIntk "Inhibit Status of FIds / Status of function identifier FId_GEVCtlAVCAdprCBBNWEErrIntk" UWORD DFC_OneToOne 1 100 0.00 65535.00 FORMAT "%8.2" ECU_ADDRESS 0x6001440E /end MEASUREMENT
/begin MEASUREMENT DINH_stFId.FId_GEVCtlAVCAdprIntkB1 "Inhibit Status of FIds / Status of function identifier FId_GEVCtlAVCAdprIntkB1" UWORD DFC_OneToOne 1 100 0.00 65535.00 FORMAT "%8.2" ECU_ADDRESS 0x60014410 /end MEASUREMENT
/begin MEASUREMENT DINH_stFId.FId_GEVCtlAVCAdprNWSEErrIntk "Inhibit Status of FIds / Status of function identifier FId_GEVCtlAVCAdprNWSEErrIntk" UWORD DFC_OneToOne 1 100 0.00 65535.00 FORMAT "%8.2" ECU_ADDRESS 0x60014412 /end MEASUREMENT
/begin MEASUREMENT DINH_stFId.FId_GEVCtlAdpnEnaIntk "Inhibit Status of FIds / Status of function identifier FId_GEVCtlAdpnEnaIntk" UWORD DFC_OneToOne 1 100 0.00 65535.00 FORMAT "%8.2" ECU_ADDRESS 0x60014414 /end MEASUREMENT
/begin MEASUREMENT DINH_stFId.FId_GEVCtlAdpnEnaShtrpActv "Inhibit Status of FIds / Status of function identifier FId_GEVCtlAdpnEnaShtrpActv" UWORD DFC_OneToOne 1 100 0.00 65535.00 FORMAT "%8.2" ECU_ADDRESS 0x60014416 /end MEASUREMENT
/begin MEASUREMENT DINH_stFId.FId_GEVCtlClngIntk "Inhibit Status of FIds / Status of function identifier FId_GEVCtlClngIntk" UWORD DFC_OneToOne 1 100 0.00 65535.00 FORMAT "%8.2" ECU_ADDRESS 0x60014418 /end MEASUREMENT
/begin MEASUREMENT DINH_stFId.FId_GEVCtlMinOvlIntk "Inhibit Status of FIds / Status of function identifier FId_GEVCtlMinOvlIntk" UWORD DFC_OneToOne 1 100 0.00 65535.00 FORMAT "%8.2" ECU_ADDRESS 0x6001441A /end MEASUREMENT
/begin MEASUREMENT DINH_stFId.FId_GEVCtlPOilSnsr "Inhibit Status of FIds / Status of function identifier FId_GEVCtlPOilSnsr" UWORD DFC_OneToOne 1 100 0.00 65535.00 FORMAT "%8.2" ECU_ADDRESS 0x6001441C /end MEASUREMENT
/begin MEASUREMENT DINH_stFId.FId_GEVCtlPhaEnaIntk "Inhibit Status of FIds / Status of function identifier FId_GEVCtlPhaEnaIntk" UWORD DFC_OneToOne 1 100 0.00 65535.00 FORMAT "%8.2" ECU_ADDRESS 0x6001441E /end MEASUREMENT
/begin MEASUREMENT DINH_stFId.FId_GEVCtlPhaSpTstrIntk "Inhibit Status of FIds / Status of function identifier FId_GEVCtlPhaSpTstrIntk" UWORD DFC_OneToOne 1 100 0.00 65535.00 FORMAT "%8.2" ECU_ADDRESS 0x60014420 /end MEASUREMENT
/begin MEASUREMENT DINH_stFId.FId_GEVCtlRefAdpnMntChck "Inhibit Status of FIds / Status of function identifier FId_GEVCtlRefAdpnMntChck" UWORD DFC_OneToOne 1 100 0.00 65535.00 FORMAT "%8.2" ECU_ADDRESS 0x60014422 /end MEASUREMENT
/begin MEASUREMENT DINH_stFId.FId_GEVCtlRefAdpnMntChckTstd "Inhibit Status of FIds / Status of function identifier FId_GEVCtlRefAdpnMntChckTstd" UWORD DFC_OneToOne 1 100 0.00 65535.00 FORMAT "%8.2" ECU_ADDRESS 0x60014424 /end MEASUREMENT
/begin MEASUREMENT DINH_stFId.FId_GEVCtlReqRefAdpnTstrIntk "Inhibit Status of FIds / Status of function identifier FId_GEVCtlReqRefAdpnTstrIntk" UWORD DFC_OneToOne 1 100 0.00 65535.00 FORMAT "%8.2" ECU_ADDRESS 0x60014426 /end MEASUREMENT
/begin MEASUREMENT DINH_stFId.FId_GEVCtlReqRefAdpnTstrIntkTstd "Inhibit Status of FIds / Status of function identifier FId_GEVCtlReqRefAdpnTstrIntkTstd" UWORD DFC_OneToOne 1 100 0.00 65535.00 FORMAT "%8.2" ECU_ADDRESS 0x60014428 /end MEASUREMENT
/begin MEASUREMENT DINH_stFId.FId_GEVCtlVlvLftEnaIntk "Inhibit Status of FIds / Status of function identifier FId_GEVCtlVlvLftEnaIntk" UWORD DFC_OneToOne 1 100 0.00 65535.00 FORMAT "%8.2" ECU_ADDRESS 0x6001442A /end MEASUREMENT
/begin MEASUREMENT DINH_stFId.FId_GEVCtlVlvOpenClsdIntkB1 "Inhibit Status of FIds / Status of function identifier FId_GEVCtlVlvOpenClsdIntkB1" UWORD DFC_OneToOne 1 100 0.00 65535.00 FORMAT "%8.2" ECU_ADDRESS 0x6001442C /end MEASUREMENT
/begin MEASUREMENT DINH_stFId.FId_GEVlvLockPinDiagIntkB1 "Inhibit Status of FIds / Status of function identifier FId_GEVlvLockPinDiagIntkB1" UWORD DFC_OneToOne 1 100 0.00 65535.00 FORMAT "%8.2" ECU_ADDRESS 0x6001442E /end MEASUREMENT
/begin MEASUREMENT DINH_stFId.FId_GEVlvPhaDiagEnaCsersIntkB1 "Inhibit Status of FIds / Status of function identifier FId_GEVlvPhaDiagEnaCsersIntkB1" UWORD DFC_OneToOne 1 100 0.00 65535.00 FORMAT "%8.2" ECU_ADDRESS 0x60014430 /end MEASUREMENT
/begin MEASUREMENT DINH_stFId.FId_GEVlvPhaDiagEnaIntkB1 "Inhibit Status of FIds / Status of function identifier FId_GEVlvPhaDiagEnaIntkB1" UWORD DFC_OneToOne 1 100 0.00 65535.00 FORMAT "%8.2" ECU_ADDRESS 0x60014432 /end MEASUREMENT
/begin MEASUREMENT DINH_stFId.FId_GEVlvPhaPsIntkB1 "Inhibit Status of FIds / Status of function identifier FId_GEVlvPhaPsIntkB1" UWORD DFC_OneToOne 1 100 0.00 65535.00 FORMAT "%8.2" ECU_ADDRESS 0x60014434 /end MEASUREMENT
/begin MEASUREMENT DINH_stFId.FId_GbxAnNeutPosnErr "Inhibit Status of FIds / Status of function identifier FId_GbxAnNeutPosnErr" UWORD DFC_OneToOne 1 100 0.00 65535.00 FORMAT "%8.2" ECU_ADDRESS 0x60014436 /end MEASUREMENT
/begin MEASUREMENT DINH_stFId.FId_GbxCANDigPlausErr "Inhibit Status of FIds / Status of function identifier FId_GbxCANDigPlausErr" UWORD DFC_OneToOne 1 100 0.00 65535.00 FORMAT "%8.2" ECU_ADDRESS 0x60014438 /end MEASUREMENT
/begin MEASUREMENT DINH_stFId.FId_GbxCANNeutSigErr "Inhibit Status of FIds / Status of function identifier FId_GbxCANNeutSigErr" UWORD DFC_OneToOne 1 100 0.00 65535.00 FORMAT "%8.2" ECU_ADDRESS 0x6001443A /end MEASUREMENT
/begin MEASUREMENT DINH_stFId.FId_GbxPNPosSig "Inhibit Status of FIds / Status of function identifier FId_GbxPNPosSig" UWORD DFC_OneToOne 1 100 0.00 65535.00 FORMAT "%8.2" ECU_ADDRESS 0x6001443C /end MEASUREMENT
/begin MEASUREMENT DINH_stFId.FId_GbxPNPosnComErr "Inhibit Status of FIds / Status of function identifier FId_GbxPNPosnComErr" UWORD DFC_OneToOne 1 100 0.00 65535.00 FORMAT "%8.2" ECU_ADDRESS 0x6001443E /end MEASUREMENT
/begin MEASUREMENT DINH_stFId.FId_GbxPNPosnDiagDrvCdnRels "Inhibit Status of FIds / Status of function identifier FId_GbxPNPosnDiagDrvCdnRels" UWORD DFC_OneToOne 1 100 0.00 65535.00 FORMAT "%8.2" ECU_ADDRESS 0x60014440 /end MEASUREMENT
/begin MEASUREMENT DINH_stFId.FId_GbxPNPosnDiagDrvCodnHealRels "Inhibit Status of FIds / Status of function identifier FId_GbxPNPosnDiagDrvCodnHealRels" UWORD DFC_OneToOne 1 100 0.00 65535.00 FORMAT "%8.2" ECU_ADDRESS 0x60014442 /end MEASUREMENT
/begin MEASUREMENT DINH_stFId.FId_GbxPNPosnDiagPlausyRels "Inhibit Status of FIds / Status of function identifier FId_GbxPNPosnDiagPlausyRels" UWORD DFC_OneToOne 1 100 0.00 65535.00 FORMAT "%8.2" ECU_ADDRESS 0x60014444 /end MEASUREMENT
/begin MEASUREMENT DINH_stFId.FId_GbxPNPosnSubsVal "Inhibit Status of FIds / Status of function identifier FId_GbxPNPosnSubsVal" UWORD DFC_OneToOne 1 100 0.00 65535.00 FORMAT "%8.2" ECU_ADDRESS 0x60014446 /end MEASUREMENT
/begin MEASUREMENT DINH_stFId.FId_GbxRvsSwtStk "Inhibit Status of FIds / Status of function identifier FId_GbxRvsSwtStk" UWORD DFC_OneToOne 1 100 0.00 65535.00 FORMAT "%8.2" ECU_ADDRESS 0x60014448 /end MEASUREMENT
/begin MEASUREMENT DINH_stFId.FId_GbxSnsrSplyUErr "Inhibit Status of FIds / Status of function identifier FId_GbxSnsrSplyUErr" UWORD DFC_OneToOne 1 100 0.00 65535.00 FORMAT "%8.2" ECU_ADDRESS 0x6001444A /end MEASUREMENT
/begin MEASUREMENT DINH_stFId.FId_GbxSpstReqOk "Inhibit Status of FIds / Status of function identifier FId_GbxSpstReqOk" UWORD DFC_OneToOne 1 100 0.00 65535.00 FORMAT "%8.2" ECU_ADDRESS 0x6001444C /end MEASUREMENT
/begin MEASUREMENT DINH_stFId.FId_GlbDaLSumvXPtd "Inhibit Status of FIds / Status of function identifier FId_GlbDaLSumvXPtd" UWORD DFC_OneToOne 1 100 0.00 65535.00 FORMAT "%8.2" ECU_ADDRESS 0x6001444E /end MEASUREMENT
/begin MEASUREMENT DINH_stFId.FId_GslThrVlvSnsrDiagB1 "Inhibit Status of FIds / Status of function identifier FId_GslThrVlvSnsrDiagB1" UWORD DFC_OneToOne 1 100 0.00 65535.00 FORMAT "%8.2" ECU_ADDRESS 0x60014450 /end MEASUREMENT
/begin MEASUREMENT DINH_stFId.FId_HEGOS2B1DElec "Inhibit Status of FIds / Status of function identifier FId_HEGOS2B1DElec" UWORD DFC_OneToOne 1 100 0.00 65535.00 FORMAT "%8.2" ECU_ADDRESS 0x60014452 /end MEASUREMENT
/begin MEASUREMENT DINH_stFId.FId_HEGOS2B1DHtg "Inhibit Status of FIds / Status of function identifier FId_HEGOS2B1DHtg" UWORD DFC_OneToOne 1 100 0.00 65535.00 FORMAT "%8.2" ECU_ADDRESS 0x60014454 /end MEASUREMENT
/begin MEASUREMENT DINH_stFId.FId_HEGOS2B1Htg "Inhibit Status of FIds / Status of function identifier FId_HEGOS2B1Htg" UWORD DFC_OneToOne 1 100 0.00 65535.00 FORMAT "%8.2" ECU_ADDRESS 0x60014456 /end MEASUREMENT
/begin MEASUREMENT DINH_stFId.FId_HEGOS2B1HtrPsSt "Inhibit Status of FIds / Status of function identifier FId_HEGOS2B1HtrPsSt" UWORD DFC_OneToOne 1 100 0.00 65535.00 FORMAT "%8.2" ECU_ADDRESS 0x60014458 /end MEASUREMENT
/begin MEASUREMENT DINH_stFId.FId_HEGOS2B1InVld "Inhibit Status of FIds / Status of function identifier FId_HEGOS2B1InVld" UWORD DFC_OneToOne 1 100 0.00 65535.00 FORMAT "%8.2" ECU_ADDRESS 0x6001445A /end MEASUREMENT
/begin MEASUREMENT DINH_stFId.FId_HEGOS2B1LSPsDiaDi "Inhibit Status of FIds / Status of function identifier FId_HEGOS2B1LSPsDiaDi" UWORD DFC_OneToOne 1 100 0.00 65535.00 FORMAT "%8.2" ECU_ADDRESS 0x6001445C /end MEASUREMENT
/begin MEASUREMENT DINH_stFId.FId_HLSDemBrkFlt "Inhibit Status of FIds / Status of function identifier FId_HLSDemBrkFlt" UWORD DFC_OneToOne 1 100 0.00 65535.00 FORMAT "%8.2" ECU_ADDRESS 0x6001445E /end MEASUREMENT
/begin MEASUREMENT DINH_stFId.FId_HLSDemErr1 "Inhibit Status of FIds / Status of function identifier FId_HLSDemErr1" UWORD DFC_OneToOne 1 100 0.00 65535.00 FORMAT "%8.2" ECU_ADDRESS 0x60014460 /end MEASUREMENT
/begin MEASUREMENT DINH_stFId.FId_HLSDemErr2 "Inhibit Status of FIds / Status of function identifier FId_HLSDemErr2" UWORD DFC_OneToOne 1 100 0.00 65535.00 FORMAT "%8.2" ECU_ADDRESS 0x60014462 /end MEASUREMENT
/begin MEASUREMENT DINH_stFId.FId_HLSDemIntkAirTemp "Inhibit Status of FIds / Status of function identifier FId_HLSDemIntkAirTemp" UWORD DFC_OneToOne 1 100 0.00 65535.00 FORMAT "%8.2" ECU_ADDRESS 0x60014464 /end MEASUREMENT
/begin MEASUREMENT DINH_stFId.FId_HLSDemMotTemp "Inhibit Status of FIds / Status of function identifier FId_HLSDemMotTemp" UWORD DFC_OneToOne 1 100 0.00 65535.00 FORMAT "%8.2" ECU_ADDRESS 0x60014466 /end MEASUREMENT
/begin MEASUREMENT DINH_stFId.FId_HLSDemMstCyldpVld "Inhibit Status of FIds / Status of function identifier FId_HLSDemMstCyldpVld" UWORD DFC_OneToOne 1 100 0.00 65535.00 FORMAT "%8.2" ECU_ADDRESS 0x60014468 /end MEASUREMENT
/begin MEASUREMENT DINH_stFId.FId_HLSDemSpdClthGearAccrSigErr "Inhibit Status of FIds / Status of function identifier FId_HLSDemSpdClthGearAccrSigErr" UWORD DFC_OneToOne 1 100 0.00 65535.00 FORMAT "%8.2" ECU_ADDRESS 0x6001446A /end MEASUREMENT
/begin MEASUREMENT DINH_stFId.FId_HLSDem_DrvOffSuprt "Inhibit Status of FIds / Status of function identifier FId_HLSDem_DrvOffSuprt" UWORD DFC_OneToOne 1 100 0.00 65535.00 FORMAT "%8.2" ECU_ADDRESS 0x6001446C /end MEASUREMENT
/begin MEASUREMENT DINH_stFId.FId_HLSDem_DrvOffSuprtBrkHldSys "Inhibit Status of FIds / Status of function identifier FId_HLSDem_DrvOffSuprtBrkHldSys" UWORD DFC_OneToOne 1 100 0.00 65535.00 FORMAT "%8.2" ECU_ADDRESS 0x6001446E /end MEASUREMENT
/begin MEASUREMENT DINH_stFId.FId_HLSDem_DrvOffSuprtLAS "Inhibit Status of FIds / Status of function identifier FId_HLSDem_DrvOffSuprtLAS" UWORD DFC_OneToOne 1 100 0.00 65535.00 FORMAT "%8.2" ECU_ADDRESS 0x60014470 /end MEASUREMENT
/begin MEASUREMENT DINH_stFId.FId_HLSDem_PModeActv "Inhibit Status of FIds / Status of function identifier FId_HLSDem_PModeActv" UWORD DFC_OneToOne 1 100 0.00 65535.00 FORMAT "%8.2" ECU_ADDRESS 0x60014472 /end MEASUREMENT
/begin MEASUREMENT DINH_stFId.FId_HLSDem_TModeActv "Inhibit Status of FIds / Status of function identifier FId_HLSDem_TModeActv" UWORD DFC_OneToOne 1 100 0.00 65535.00 FORMAT "%8.2" ECU_ADDRESS 0x60014474 /end MEASUREMENT
/begin MEASUREMENT DINH_stFId.FId_HLSDem_TraSubFcn "Inhibit Status of FIds / Status of function identifier FId_HLSDem_TraSubFcn" UWORD DFC_OneToOne 1 100 0.00 65535.00 FORMAT "%8.2" ECU_ADDRESS 0x60014476 /end MEASUREMENT
/begin MEASUREMENT DINH_stFId.FId_HLSDem_nMaxLimErr1 "Inhibit Status of FIds / Status of function identifier FId_HLSDem_nMaxLimErr1" UWORD DFC_OneToOne 1 100 0.00 65535.00 FORMAT "%8.2" ECU_ADDRESS 0x60014478 /end MEASUREMENT
/begin MEASUREMENT DINH_stFId.FId_HLSDem_nMaxLimErr2 "Inhibit Status of FIds / Status of function identifier FId_HLSDem_nMaxLimErr2" UWORD DFC_OneToOne 1 100 0.00 65535.00 FORMAT "%8.2" ECU_ADDRESS 0x6001447A /end MEASUREMENT
/begin MEASUREMENT DINH_stFId.FId_HLSDem_nMaxLimErr3 "Inhibit Status of FIds / Status of function identifier FId_HLSDem_nMaxLimErr3" UWORD DFC_OneToOne 1 100 0.00 65535.00 FORMAT "%8.2" ECU_ADDRESS 0x6001447C /end MEASUREMENT
/begin MEASUREMENT DINH_stFId.FId_HLSDem_nMaxVErr "Inhibit Status of FIds / Status of function identifier FId_HLSDem_nMaxVErr" UWORD DFC_OneToOne 1 100 0.00 65535.00 FORMAT "%8.2" ECU_ADDRESS 0x6001447E /end MEASUREMENT
/begin MEASUREMENT DINH_stFId.FId_I14229APP "Inhibit Status of FIds / Status of function identifier FId_I14229APP" UWORD DFC_OneToOne 1 100 0.00 65535.00 FORMAT "%8.2" ECU_ADDRESS 0x60014480 /end MEASUREMENT
/begin MEASUREMENT DINH_stFId.FId_I14229CANErr "Inhibit Status of FIds / Status of function identifier FId_I14229CANErr" UWORD DFC_OneToOne 1 100 0.00 65535.00 FORMAT "%8.2" ECU_ADDRESS 0x60014482 /end MEASUREMENT
/begin MEASUREMENT DINH_stFId.FId_I14229FlLvlFltComErr "Inhibit Status of FIds / Status of function identifier FId_I14229FlLvlFltComErr" UWORD DFC_OneToOne 1 100 0.00 65535.00 FORMAT "%8.2" ECU_ADDRESS 0x60014484 /end MEASUREMENT
/begin MEASUREMENT DINH_stFId.FId_I14229VTCErr "Inhibit Status of FIds / Status of function identifier FId_I14229VTCErr" UWORD DFC_OneToOne 1 100 0.00 65535.00 FORMAT "%8.2" ECU_ADDRESS 0x60014486 /end MEASUREMENT
/begin MEASUREMENT DINH_stFId.FId_IMGISABComErr "Inhibit Status of FIds / Status of function identifier FId_IMGISABComErr" UWORD DFC_OneToOne 1 100 0.00 65535.00 FORMAT "%8.2" ECU_ADDRESS 0x60014488 /end MEASUREMENT
/begin MEASUREMENT DINH_stFId.FId_InhbLamDynS1B1 "Inhibit Status of FIds / Status of function identifier FId_InhbLamDynS1B1" UWORD DFC_OneToOne 1 100 0.00 65535.00 FORMAT "%8.2" ECU_ADDRESS 0x6001448A /end MEASUREMENT
/begin MEASUREMENT DINH_stFId.FId_InhbnBlkdLineDiag "Inhibit Status of FIds / Status of function identifier FId_InhbnBlkdLineDiag" UWORD DFC_OneToOne 1 100 0.00 65535.00 FORMAT "%8.2" ECU_ADDRESS 0x6001448C /end MEASUREMENT
/begin MEASUREMENT DINH_stFId.FId_InhibitAlways "Inhibit Status of FIds / Status of function identifier FId_InhibitAlways" UWORD DFC_OneToOne 1 100 0.00 65535.00 FORMAT "%8.2" ECU_ADDRESS 0x6001448E /end MEASUREMENT
/begin MEASUREMENT DINH_stFId.FId_InhibitNever "Inhibit Status of FIds / Status of function identifier FId_InhibitNever" UWORD DFC_OneToOne 1 100 0.00 65535.00 FORMAT "%8.2" ECU_ADDRESS 0x60014490 /end MEASUREMENT
/begin MEASUREMENT DINH_stFId.FId_InjSysMulInjDiagErr "Inhibit Status of FIds / Status of function identifier FId_InjSysMulInjDiagErr" UWORD DFC_OneToOne 1 100 0.00 65535.00 FORMAT "%8.2" ECU_ADDRESS 0x60014492 /end MEASUREMENT
/begin MEASUREMENT DINH_stFId.FId_InjVlvPs_Bank1OnlyErr "Inhibit Status of FIds / Status of function identifier FId_InjVlvPs_Bank1OnlyErr" UWORD DFC_OneToOne 1 100 0.00 65535.00 FORMAT "%8.2" ECU_ADDRESS 0x60014494 /end MEASUREMENT
/begin MEASUREMENT DINH_stFId.FId_InjVlvPs_Bank1Tested "Inhibit Status of FIds / Status of function identifier FId_InjVlvPs_Bank1Tested" UWORD DFC_OneToOne 1 100 0.00 65535.00 FORMAT "%8.2" ECU_ADDRESS 0x60014496 /end MEASUREMENT
/begin MEASUREMENT DINH_stFId.FId_InjVlvPs_Bank2OnlyErr "Inhibit Status of FIds / Status of function identifier FId_InjVlvPs_Bank2OnlyErr" UWORD DFC_OneToOne 1 100 0.00 65535.00 FORMAT "%8.2" ECU_ADDRESS 0x60014498 /end MEASUREMENT
/begin MEASUREMENT DINH_stFId.FId_InjVlvPs_Bank2Tested "Inhibit Status of FIds / Status of function identifier FId_InjVlvPs_Bank2Tested" UWORD DFC_OneToOne 1 100 0.00 65535.00 FORMAT "%8.2" ECU_ADDRESS 0x6001449A /end MEASUREMENT
/begin MEASUREMENT DINH_stFId.FId_InjVlvPs_Bank3OnlyErr "Inhibit Status of FIds / Status of function identifier FId_InjVlvPs_Bank3OnlyErr" UWORD DFC_OneToOne 1 100 0.00 65535.00 FORMAT "%8.2" ECU_ADDRESS 0x6001449C /end MEASUREMENT
/begin MEASUREMENT DINH_stFId.FId_InjVlvPs_Bank3Tested "Inhibit Status of FIds / Status of function identifier FId_InjVlvPs_Bank3Tested" UWORD DFC_OneToOne 1 100 0.00 65535.00 FORMAT "%8.2" ECU_ADDRESS 0x6001449E /end MEASUREMENT
/begin MEASUREMENT DINH_stFId.FId_IntkAirTAirFltDsCrssChk "Inhibit Status of FIds / Status of function identifier FId_IntkAirTAirFltDsCrssChk" UWORD DFC_OneToOne 1 100 0.00 65535.00 FORMAT "%8.2" ECU_ADDRESS 0x600144A0 /end MEASUREMENT
/begin MEASUREMENT DINH_stFId.FId_IntkAirTAirFltDsPlausChk "Inhibit Status of FIds / Status of function identifier FId_IntkAirTAirFltDsPlausChk" UWORD DFC_OneToOne 1 100 0.00 65535.00 FORMAT "%8.2" ECU_ADDRESS 0x600144A2 /end MEASUREMENT
/begin MEASUREMENT DINH_stFId.FId_IntkAirTIntkMnfldCrssChk "Inhibit Status of FIds / Status of function identifier FId_IntkAirTIntkMnfldCrssChk" UWORD DFC_OneToOne 1 100 0.00 65535.00 FORMAT "%8.2" ECU_ADDRESS 0x600144A4 /end MEASUREMENT
/begin MEASUREMENT DINH_stFId.FId_IntkAirTIntkMnfldPlausChk "Inhibit Status of FIds / Status of function identifier FId_IntkAirTIntkMnfldPlausChk" UWORD DFC_OneToOne 1 100 0.00 65535.00 FORMAT "%8.2" ECU_ADDRESS 0x600144A6 /end MEASUREMENT
/begin MEASUREMENT DINH_stFId.FId_IntkAirTIntkMnfldRepl "Inhibit Status of FIds / Status of function identifier FId_IntkAirTIntkMnfldRepl" UWORD DFC_OneToOne 1 100 0.00 65535.00 FORMAT "%8.2" ECU_ADDRESS 0x600144A8 /end MEASUREMENT
/begin MEASUREMENT DINH_stFId.FId_IntkAirTSnsr1Elec "Inhibit Status of FIds / Status of function identifier FId_IntkAirTSnsr1Elec" UWORD DFC_OneToOne 1 100 0.00 65535.00 FORMAT "%8.2" ECU_ADDRESS 0x600144AA /end MEASUREMENT
/begin MEASUREMENT DINH_stFId.FId_IntkAirTSnsr1PRC "Inhibit Status of FIds / Status of function identifier FId_IntkAirTSnsr1PRC" UWORD DFC_OneToOne 1 100 0.00 65535.00 FORMAT "%8.2" ECU_ADDRESS 0x600144AC /end MEASUREMENT
/begin MEASUREMENT DINH_stFId.FId_IntkAirTSnsr1Sum "Inhibit Status of FIds / Status of function identifier FId_IntkAirTSnsr1Sum" UWORD DFC_OneToOne 1 100 0.00 65535.00 FORMAT "%8.2" ECU_ADDRESS 0x600144AE /end MEASUREMENT
/begin MEASUREMENT DINH_stFId.FId_IntkAirTSnsr2Elec "Inhibit Status of FIds / Status of function identifier FId_IntkAirTSnsr2Elec" UWORD DFC_OneToOne 1 100 0.00 65535.00 FORMAT "%8.2" ECU_ADDRESS 0x600144B0 /end MEASUREMENT
/begin MEASUREMENT DINH_stFId.FId_IntkAirTSnsr2PRC "Inhibit Status of FIds / Status of function identifier FId_IntkAirTSnsr2PRC" UWORD DFC_OneToOne 1 100 0.00 65535.00 FORMAT "%8.2" ECU_ADDRESS 0x600144B2 /end MEASUREMENT
/begin MEASUREMENT DINH_stFId.FId_IntkAirTSnsr2Sum "Inhibit Status of FIds / Status of function identifier FId_IntkAirTSnsr2Sum" UWORD DFC_OneToOne 1 100 0.00 65535.00 FORMAT "%8.2" ECU_ADDRESS 0x600144B4 /end MEASUREMENT
/begin MEASUREMENT DINH_stFId.FId_IntkArTempENGB "Inhibit Status of FIds / Status of function identifier FId_IntkArTempENGB" UWORD DFC_OneToOne 1 100 0.00 65535.00 FORMAT "%8.2" ECU_ADDRESS 0x600144B6 /end MEASUREMENT
/begin MEASUREMENT DINH_stFId.FId_LIGovDfrstI "Inhibit Status of FIds / Status of function identifier FId_LIGovDfrstI" UWORD DFC_OneToOne 1 100 0.00 65535.00 FORMAT "%8.2" ECU_ADDRESS 0x600144B8 /end MEASUREMENT
/begin MEASUREMENT DINH_stFId.FId_LIGovUndrBrk "Inhibit Status of FIds / Status of function identifier FId_LIGovUndrBrk" UWORD DFC_OneToOne 1 100 0.00 65535.00 FORMAT "%8.2" ECU_ADDRESS 0x600144BA /end MEASUREMENT
/begin MEASUREMENT DINH_stFId.FId_LINDCDCRxErr "Inhibit Status of FIds / Status of function identifier FId_LINDCDCRxErr" UWORD DFC_OneToOne 1 100 0.00 65535.00 FORMAT "%8.2" ECU_ADDRESS 0x600144BC /end MEASUREMENT
/begin MEASUREMENT DINH_stFId.FId_LLimAppSnsrErr "Inhibit Status of FIds / Status of function identifier FId_LLimAppSnsrErr" UWORD DFC_OneToOne 1 100 0.00 65535.00 FORMAT "%8.2" ECU_ADDRESS 0x600144BE /end MEASUREMENT
/begin MEASUREMENT DINH_stFId.FId_LLimAppSnsrSyncErr "Inhibit Status of FIds / Status of function identifier FId_LLimAppSnsrSyncErr" UWORD DFC_OneToOne 1 100 0.00 65535.00 FORMAT "%8.2" ECU_ADDRESS 0x600144C0 /end MEASUREMENT
/begin MEASUREMENT DINH_stFId.FId_LLimMTVehSpdSnsrErr "Inhibit Status of FIds / Status of function identifier FId_LLimMTVehSpdSnsrErr" UWORD DFC_OneToOne 1 100 0.00 65535.00 FORMAT "%8.2" ECU_ADDRESS 0x600144C2 /end MEASUREMENT
/begin MEASUREMENT DINH_stFId.FId_LLimShutOffEng "Inhibit Status of FIds / Status of function identifier FId_LLimShutOffEng" UWORD DFC_OneToOne 1 100 0.00 65535.00 FORMAT "%8.2" ECU_ADDRESS 0x600144C4 /end MEASUREMENT
/begin MEASUREMENT DINH_stFId.FId_LRSEBMisf "Inhibit Status of FIds / Status of function identifier FId_LRSEBMisf" UWORD DFC_OneToOne 1 100 0.00 65535.00 FORMAT "%8.2" ECU_ADDRESS 0x600144C6 /end MEASUREMENT
/begin MEASUREMENT DINH_stFId.FId_LZSR "Inhibit Status of FIds / Status of function identifier FId_LZSR" UWORD DFC_OneToOne 1 100 0.00 65535.00 FORMAT "%8.2" ECU_ADDRESS 0x600144C8 /end MEASUREMENT
/begin MEASUREMENT DINH_stFId.FId_LeakToMnfld "Inhibit Status of FIds / Status of function identifier FId_LeakToMnfld" UWORD DFC_OneToOne 1 100 0.00 65535.00 FORMAT "%8.2" ECU_ADDRESS 0x600144CA /end MEASUREMENT
/begin MEASUREMENT DINH_stFId.FId_LeakToMnfldTstd "Inhibit Status of FIds / Status of function identifier FId_LeakToMnfldTstd" UWORD DFC_OneToOne 1 100 0.00 65535.00 FORMAT "%8.2" ECU_ADDRESS 0x600144CC /end MEASUREMENT
/begin MEASUREMENT DINH_stFId.FId_LimpHomPsErrInjtr "Inhibit Status of FIds / Status of function identifier FId_LimpHomPsErrInjtr" UWORD DFC_OneToOne 1 100 0.00 65535.00 FORMAT "%8.2" ECU_ADDRESS 0x600144CE /end MEASUREMENT
/begin MEASUREMENT DINH_stFId.FId_LinACGUnitCfmdErr "Inhibit Status of FIds / Status of function identifier FId_LinACGUnitCfmdErr" UWORD DFC_OneToOne 1 100 0.00 65535.00 FORMAT "%8.2" ECU_ADDRESS 0x600144D0 /end MEASUREMENT
/begin MEASUREMENT DINH_stFId.FId_LinACGUnitNotTstd "Inhibit Status of FIds / Status of function identifier FId_LinACGUnitNotTstd" UWORD DFC_OneToOne 1 100 0.00 65535.00 FORMAT "%8.2" ECU_ADDRESS 0x600144D2 /end MEASUREMENT
/begin MEASUREMENT DINH_stFId.FId_LinAEVUnitCfmdErr "Inhibit Status of FIds / Status of function identifier FId_LinAEVUnitCfmdErr" UWORD DFC_OneToOne 1 100 0.00 65535.00 FORMAT "%8.2" ECU_ADDRESS 0x600144D4 /end MEASUREMENT
/begin MEASUREMENT DINH_stFId.FId_LinAEVUnitNotTstd "Inhibit Status of FIds / Status of function identifier FId_LinAEVUnitNotTstd" UWORD DFC_OneToOne 1 100 0.00 65535.00 FORMAT "%8.2" ECU_ADDRESS 0x600144D6 /end MEASUREMENT
/begin MEASUREMENT DINH_stFId.FId_LinEBSUnitCfmdErr "Inhibit Status of FIds / Status of function identifier FId_LinEBSUnitCfmdErr" UWORD DFC_OneToOne 1 100 0.00 65535.00 FORMAT "%8.2" ECU_ADDRESS 0x600144D8 /end MEASUREMENT
/begin MEASUREMENT DINH_stFId.FId_LinEBSUnitNotTstd "Inhibit Status of FIds / Status of function identifier FId_LinEBSUnitNotTstd" UWORD DFC_OneToOne 1 100 0.00 65535.00 FORMAT "%8.2" ECU_ADDRESS 0x600144DA /end MEASUREMENT
/begin MEASUREMENT DINH_stFId.FId_LowPresOilP "Inhibit Status of FIds / Status of function identifier FId_LowPresOilP" UWORD DFC_OneToOne 1 100 0.00 65535.00 FORMAT "%8.2" ECU_ADDRESS 0x600144DC /end MEASUREMENT
/begin MEASUREMENT DINH_stFId.FId_MFlowAirCrkcsSubVal "Inhibit Status of FIds / Status of function identifier FId_MFlowAirCrkcsSubVal" UWORD DFC_OneToOne 1 100 0.00 65535.00 FORMAT "%8.2" ECU_ADDRESS 0x600144DE /end MEASUREMENT
/begin MEASUREMENT DINH_stFId.FId_MFuOilMax "Inhibit Status of FIds / Status of function identifier FId_MFuOilMax" UWORD DFC_OneToOne 1 100 0.00 65535.00 FORMAT "%8.2" ECU_ADDRESS 0x600144E0 /end MEASUREMENT
/begin MEASUREMENT DINH_stFId.FId_MaiLoadSnsr "Inhibit Status of FIds / Status of function identifier FId_MaiLoadSnsr" UWORD DFC_OneToOne 1 100 0.00 65535.00 FORMAT "%8.2" ECU_ADDRESS 0x600144E2 /end MEASUREMENT
/begin MEASUREMENT DINH_stFId.FId_MaiShaftFailr "Inhibit Status of FIds / Status of function identifier FId_MaiShaftFailr" UWORD DFC_OneToOne 1 100 0.00 65535.00 FORMAT "%8.2" ECU_ADDRESS 0x600144E4 /end MEASUREMENT
/begin MEASUREMENT DINH_stFId.FId_MfPsDia1 "Inhibit Status of FIds / Status of function identifier FId_MfPsDia1" UWORD DFC_OneToOne 1 100 0.00 65535.00 FORMAT "%8.2" ECU_ADDRESS 0x600144E6 /end MEASUREMENT
/begin MEASUREMENT DINH_stFId.FId_MisfDetDnAdpn "Inhibit Status of FIds / Status of function identifier FId_MisfDetDnAdpn" UWORD DFC_OneToOne 1 100 0.00 65535.00 FORMAT "%8.2" ECU_ADDRESS 0x600144E8 /end MEASUREMENT
/begin MEASUREMENT DINH_stFId.FId_MisfDetDnAdpnPlaus "Inhibit Status of FIds / Status of function identifier FId_MisfDetDnAdpnPlaus" UWORD DFC_OneToOne 1 100 0.00 65535.00 FORMAT "%8.2" ECU_ADDRESS 0x600144EA /end MEASUREMENT
/begin MEASUREMENT DINH_stFId.FId_MisfDetEnvP "Inhibit Status of FIds / Status of function identifier FId_MisfDetEnvP" UWORD DFC_OneToOne 1 100 0.00 65535.00 FORMAT "%8.2" ECU_ADDRESS 0x600144EC /end MEASUREMENT
/begin MEASUREMENT DINH_stFId.FId_MisfDetSegTiAdpnFco "Inhibit Status of FIds / Status of function identifier FId_MisfDetSegTiAdpnFco" UWORD DFC_OneToOne 1 100 0.00 65535.00 FORMAT "%8.2" ECU_ADDRESS 0x600144EE /end MEASUREMENT
/begin MEASUREMENT DINH_stFId.FId_MisfDetShtrpAct "Inhibit Status of FIds / Status of function identifier FId_MisfDetShtrpAct" UWORD DFC_OneToOne 1 100 0.00 65535.00 FORMAT "%8.2" ECU_ADDRESS 0x600144F0 /end MEASUREMENT
/begin MEASUREMENT DINH_stFId.FId_MisfDetStc "Inhibit Status of FIds / Status of function identifier FId_MisfDetStc" UWORD DFC_OneToOne 1 100 0.00 65535.00 FORMAT "%8.2" ECU_ADDRESS 0x600144F2 /end MEASUREMENT
/begin MEASUREMENT DINH_stFId.FId_MisfDetV "Inhibit Status of FIds / Status of function identifier FId_MisfDetV" UWORD DFC_OneToOne 1 100 0.00 65535.00 FORMAT "%8.2" ECU_ADDRESS 0x600144F4 /end MEASUREMENT
/begin MEASUREMENT DINH_stFId.FId_MisfDetVWhlFrntLe "Inhibit Status of FIds / Status of function identifier FId_MisfDetVWhlFrntLe" UWORD DFC_OneToOne 1 100 0.00 65535.00 FORMAT "%8.2" ECU_ADDRESS 0x600144F6 /end MEASUREMENT
/begin MEASUREMENT DINH_stFId.FId_MisfDetVWhlFrntRi "Inhibit Status of FIds / Status of function identifier FId_MisfDetVWhlFrntRi" UWORD DFC_OneToOne 1 100 0.00 65535.00 FORMAT "%8.2" ECU_ADDRESS 0x600144F8 /end MEASUREMENT
/begin MEASUREMENT DINH_stFId.FId_MisfDetVWhlReLe "Inhibit Status of FIds / Status of function identifier FId_MisfDetVWhlReLe" UWORD DFC_OneToOne 1 100 0.00 65535.00 FORMAT "%8.2" ECU_ADDRESS 0x600144FA /end MEASUREMENT
/begin MEASUREMENT DINH_stFId.FId_MisfDetVWhlReRi "Inhibit Status of FIds / Status of function identifier FId_MisfDetVWhlReRi" UWORD DFC_OneToOne 1 100 0.00 65535.00 FORMAT "%8.2" ECU_ADDRESS 0x600144FC /end MEASUREMENT
/begin MEASUREMENT DINH_stFId.FId_NLimVehHalt "Inhibit Status of FIds / Status of function identifier FId_NLimVehHalt" UWORD DFC_OneToOne 1 100 0.00 65535.00 FORMAT "%8.2" ECU_ADDRESS 0x600144FE /end MEASUREMENT
/begin MEASUREMENT DINH_stFId.FId_NSHTDAmbT "Inhibit Status of FIds / Status of function identifier FId_NSHTDAmbT" UWORD DFC_OneToOne 1 100 0.00 65535.00 FORMAT "%8.2" ECU_ADDRESS 0x60014500 /end MEASUREMENT
/begin MEASUREMENT DINH_stFId.FId_NSHTDEngT "Inhibit Status of FIds / Status of function identifier FId_NSHTDEngT" UWORD DFC_OneToOne 1 100 0.00 65535.00 FORMAT "%8.2" ECU_ADDRESS 0x60014502 /end MEASUREMENT
/begin MEASUREMENT DINH_stFId.FId_NSHTILimHiAltiLoIdleSp "Inhibit Status of FIds / Status of function identifier FId_NSHTILimHiAltiLoIdleSp" UWORD DFC_OneToOne 1 100 0.00 65535.00 FORMAT "%8.2" ECU_ADDRESS 0x60014504 /end MEASUREMENT
/begin MEASUREMENT DINH_stFId.FId_NeutPosnFailr "Inhibit Status of FIds / Status of function identifier FId_NeutPosnFailr" UWORD DFC_OneToOne 1 100 0.00 65535.00 FORMAT "%8.2" ECU_ADDRESS 0x60014506 /end MEASUREMENT
/begin MEASUREMENT DINH_stFId.FId_O2StorgMdlMD "Inhibit Status of FIds / Status of function identifier FId_O2StorgMdlMD" UWORD DFC_OneToOne 1 100 0.00 65535.00 FORMAT "%8.2" ECU_ADDRESS 0x60014508 /end MEASUREMENT
/begin MEASUREMENT DINH_stFId.FId_OilCmbdSen_LvlDfctHW "Inhibit Status of FIds / Status of function identifier FId_OilCmbdSen_LvlDfctHW" UWORD DFC_OneToOne 1 100 0.00 65535.00 FORMAT "%8.2" ECU_ADDRESS 0x6001450A /end MEASUREMENT
/begin MEASUREMENT DINH_stFId.FId_OilPCtrlVlvNpl "Inhibit Status of FIds / Status of function identifier FId_OilPCtrlVlvNpl" UWORD DFC_OneToOne 1 100 0.00 65535.00 FORMAT "%8.2" ECU_ADDRESS 0x6001450C /end MEASUREMENT
/begin MEASUREMENT DINH_stFId.FId_OilPFrzVal "Inhibit Status of FIds / Status of function identifier FId_OilPFrzVal" UWORD DFC_OneToOne 1 100 0.00 65535.00 FORMAT "%8.2" ECU_ADDRESS 0x6001450E /end MEASUREMENT
/begin MEASUREMENT DINH_stFId.FId_OilPPlaus "Inhibit Status of FIds / Status of function identifier FId_OilPPlaus" UWORD DFC_OneToOne 1 100 0.00 65535.00 FORMAT "%8.2" ECU_ADDRESS 0x60014510 /end MEASUREMENT
/begin MEASUREMENT DINH_stFId.FId_OilPPlausAftRun "Inhibit Status of FIds / Status of function identifier FId_OilPPlausAftRun" UWORD DFC_OneToOne 1 100 0.00 65535.00 FORMAT "%8.2" ECU_ADDRESS 0x60014512 /end MEASUREMENT
/begin MEASUREMENT DINH_stFId.FId_OilPPlausMax "Inhibit Status of FIds / Status of function identifier FId_OilPPlausMax" UWORD DFC_OneToOne 1 100 0.00 65535.00 FORMAT "%8.2" ECU_ADDRESS 0x60014514 /end MEASUREMENT
/begin MEASUREMENT DINH_stFId.FId_OilPPlausMin "Inhibit Status of FIds / Status of function identifier FId_OilPPlausMin" UWORD DFC_OneToOne 1 100 0.00 65535.00 FORMAT "%8.2" ECU_ADDRESS 0x60014516 /end MEASUREMENT
/begin MEASUREMENT DINH_stFId.FId_OilPPlausT15 "Inhibit Status of FIds / Status of function identifier FId_OilPPlausT15" UWORD DFC_OneToOne 1 100 0.00 65535.00 FORMAT "%8.2" ECU_ADDRESS 0x60014518 /end MEASUREMENT
/begin MEASUREMENT DINH_stFId.FId_OilPRplVal "Inhibit Status of FIds / Status of function identifier FId_OilPRplVal" UWORD DFC_OneToOne 1 100 0.00 65535.00 FORMAT "%8.2" ECU_ADDRESS 0x6001451A /end MEASUREMENT
/begin MEASUREMENT DINH_stFId.FId_OilPSnsrErr "Inhibit Status of FIds / Status of function identifier FId_OilPSnsrErr" UWORD DFC_OneToOne 1 100 0.00 65535.00 FORMAT "%8.2" ECU_ADDRESS 0x6001451C /end MEASUREMENT
/begin MEASUREMENT DINH_stFId.FId_OilPSwmpSRC "Inhibit Status of FIds / Status of function identifier FId_OilPSwmpSRC" UWORD DFC_OneToOne 1 100 0.00 65535.00 FORMAT "%8.2" ECU_ADDRESS 0x6001451E /end MEASUREMENT
/begin MEASUREMENT DINH_stFId.FId_OilSwmpTCEngDsTWrmUp "Inhibit Status of FIds / Status of function identifier FId_OilSwmpTCEngDsTWrmUp" UWORD DFC_OneToOne 1 100 0.00 65535.00 FORMAT "%8.2" ECU_ADDRESS 0x60014520 /end MEASUREMENT
/begin MEASUREMENT DINH_stFId.FId_OilSwmpT_B_tospg "Inhibit Status of FIds / Status of function identifier FId_OilSwmpT_B_tospg" UWORD DFC_OneToOne 1 100 0.00 65535.00 FORMAT "%8.2" ECU_ADDRESS 0x60014522 /end MEASUREMENT
/begin MEASUREMENT DINH_stFId.FId_OilSwmpT_B_tospgg "Inhibit Status of FIds / Status of function identifier FId_OilSwmpT_B_tospgg" UWORD DFC_OneToOne 1 100 0.00 65535.00 FORMAT "%8.2" ECU_ADDRESS 0x60014524 /end MEASUREMENT
/begin MEASUREMENT DINH_stFId.FId_OilSwmpT_CmbdSnsrErr "Inhibit Status of FIds / Status of function identifier FId_OilSwmpT_CmbdSnsrErr" UWORD DFC_OneToOne 1 100 0.00 65535.00 FORMAT "%8.2" ECU_ADDRESS 0x60014526 /end MEASUREMENT
/begin MEASUREMENT DINH_stFId.FId_OilSwmpT_CmbdSnsrTiTErr "Inhibit Status of FIds / Status of function identifier FId_OilSwmpT_CmbdSnsrTiTErr" UWORD DFC_OneToOne 1 100 0.00 65535.00 FORMAT "%8.2" ECU_ADDRESS 0x60014528 /end MEASUREMENT
/begin MEASUREMENT DINH_stFId.FId_OilSwmpT_EnvT "Inhibit Status of FIds / Status of function identifier FId_OilSwmpT_EnvT" UWORD DFC_OneToOne 1 100 0.00 65535.00 FORMAT "%8.2" ECU_ADDRESS 0x6001452A /end MEASUREMENT
/begin MEASUREMENT DINH_stFId.FId_OilSwmpT_TSnsrErr "Inhibit Status of FIds / Status of function identifier FId_OilSwmpT_TSnsrErr" UWORD DFC_OneToOne 1 100 0.00 65535.00 FORMAT "%8.2" ECU_ADDRESS 0x6001452C /end MEASUREMENT
/begin MEASUREMENT DINH_stFId.FId_PEnvMeasVld "Inhibit Status of FIds / Status of function identifier FId_PEnvMeasVld" UWORD DFC_OneToOne 1 100 0.00 65535.00 FORMAT "%8.2" ECU_ADDRESS 0x6001452E /end MEASUREMENT
/begin MEASUREMENT DINH_stFId.FId_PEnvModel "Inhibit Status of FIds / Status of function identifier FId_PEnvModel" UWORD DFC_OneToOne 1 100 0.00 65535.00 FORMAT "%8.2" ECU_ADDRESS 0x60014530 /end MEASUREMENT
/begin MEASUREMENT DINH_stFId.FId_PEnvPlausDiagVDD "Inhibit Status of FIds / Status of function identifier FId_PEnvPlausDiagVDD" UWORD DFC_OneToOne 1 100 0.00 65535.00 FORMAT "%8.2" ECU_ADDRESS 0x60014532 /end MEASUREMENT
/begin MEASUREMENT DINH_stFId.FId_PEnvRawVldVDD "Inhibit Status of FIds / Status of function identifier FId_PEnvRawVldVDD" UWORD DFC_OneToOne 1 100 0.00 65535.00 FORMAT "%8.2" ECU_ADDRESS 0x60014534 /end MEASUREMENT
/begin MEASUREMENT DINH_stFId.FId_PEnvRefSnsr "Inhibit Status of FIds / Status of function identifier FId_PEnvRefSnsr" UWORD DFC_OneToOne 1 100 0.00 65535.00 FORMAT "%8.2" ECU_ADDRESS 0x60014536 /end MEASUREMENT
/begin MEASUREMENT DINH_stFId.FId_PEnvSigRngVld "Inhibit Status of FIds / Status of function identifier FId_PEnvSigRngVld" UWORD DFC_OneToOne 1 100 0.00 65535.00 FORMAT "%8.2" ECU_ADDRESS 0x60014538 /end MEASUREMENT
/begin MEASUREMENT DINH_stFId.FId_PEnvSnsrPlausVDD "Inhibit Status of FIds / Status of function identifier FId_PEnvSnsrPlausVDD" UWORD DFC_OneToOne 1 100 0.00 65535.00 FORMAT "%8.2" ECU_ADDRESS 0x6001453A /end MEASUREMENT
/begin MEASUREMENT DINH_stFId.FId_PEnvVldVDD "Inhibit Status of FIds / Status of function identifier FId_PEnvVldVDD" UWORD DFC_OneToOne 1 100 0.00 65535.00 FORMAT "%8.2" ECU_ADDRESS 0x6001453C /end MEASUREMENT
/begin MEASUREMENT DINH_stFId.FId_PIDA6SigSrcErr "Inhibit Status of FIds / Status of function identifier FId_PIDA6SigSrcErr" UWORD DFC_OneToOne 1 100 0.00 65535.00 FORMAT "%8.2" ECU_ADDRESS 0x6001453E /end MEASUREMENT
/begin MEASUREMENT DINH_stFId.FId_PIntkMnfldPlaus "Inhibit Status of FIds / Status of function identifier FId_PIntkMnfldPlaus" UWORD DFC_OneToOne 1 100 0.00 65535.00 FORMAT "%8.2" ECU_ADDRESS 0x60014540 /end MEASUREMENT
/begin MEASUREMENT DINH_stFId.FId_PIntkVUsElecDiagB1 "Inhibit Status of FIds / Status of function identifier FId_PIntkVUsElecDiagB1" UWORD DFC_OneToOne 1 100 0.00 65535.00 FORMAT "%8.2" ECU_ADDRESS 0x60014542 /end MEASUREMENT
/begin MEASUREMENT DINH_stFId.FId_PSPCtlDisbl "Inhibit Status of FIds / Status of function identifier FId_PSPCtlDisbl" UWORD DFC_OneToOne 1 100 0.00 65535.00 FORMAT "%8.2" ECU_ADDRESS 0x60014544 /end MEASUREMENT
/begin MEASUREMENT DINH_stFId.FId_PSPCtlIntkAirVapLock "Inhibit Status of FIds / Status of function identifier FId_PSPCtlIntkAirVapLock" UWORD DFC_OneToOne 1 100 0.00 65535.00 FORMAT "%8.2" ECU_ADDRESS 0x60014546 /end MEASUREMENT
/begin MEASUREMENT DINH_stFId.FId_PSPCtlPreRun "Inhibit Status of FIds / Status of function identifier FId_PSPCtlPreRun" UWORD DFC_OneToOne 1 100 0.00 65535.00 FORMAT "%8.2" ECU_ADDRESS 0x60014548 /end MEASUREMENT
/begin MEASUREMENT DINH_stFId.FId_PSPCtlVapLock "Inhibit Status of FIds / Status of function identifier FId_PSPCtlVapLock" UWORD DFC_OneToOne 1 100 0.00 65535.00 FORMAT "%8.2" ECU_ADDRESS 0x6001454A /end MEASUREMENT
/begin MEASUREMENT DINH_stFId.FId_PSPDiagDisbl "Inhibit Status of FIds / Status of function identifier FId_PSPDiagDisbl" UWORD DFC_OneToOne 1 100 0.00 65535.00 FORMAT "%8.2" ECU_ADDRESS 0x6001454C /end MEASUREMENT
/begin MEASUREMENT DINH_stFId.FId_PTGripConv "Inhibit Status of FIds / Status of function identifier FId_PTGripConv" UWORD DFC_OneToOne 1 100 0.00 65535.00 FORMAT "%8.2" ECU_ADDRESS 0x6001454E /end MEASUREMENT
/begin MEASUREMENT DINH_stFId.FId_PTGripConvStrt "Inhibit Status of FIds / Status of function identifier FId_PTGripConvStrt" UWORD DFC_OneToOne 1 100 0.00 65535.00 FORMAT "%8.2" ECU_ADDRESS 0x60014550 /end MEASUREMENT
/begin MEASUREMENT DINH_stFId.FId_PTGripMnlClth "Inhibit Status of FIds / Status of function identifier FId_PTGripMnlClth" UWORD DFC_OneToOne 1 100 0.00 65535.00 FORMAT "%8.2" ECU_ADDRESS 0x60014552 /end MEASUREMENT
/begin MEASUREMENT DINH_stFId.FId_PTGripMnlClthStrt "Inhibit Status of FIds / Status of function identifier FId_PTGripMnlClthStrt" UWORD DFC_OneToOne 1 100 0.00 65535.00 FORMAT "%8.2" ECU_ADDRESS 0x60014554 /end MEASUREMENT
/begin MEASUREMENT DINH_stFId.FId_PTTrqRatCANPtd "Inhibit Status of FIds / Status of function identifier FId_PTTrqRatCANPtd" UWORD DFC_OneToOne 1 100 0.00 65535.00 FORMAT "%8.2" ECU_ADDRESS 0x60014556 /end MEASUREMENT
/begin MEASUREMENT DINH_stFId.FId_PThrVlVUsVldB1 "Inhibit Status of FIds / Status of function identifier FId_PThrVlVUsVldB1" UWORD DFC_OneToOne 1 100 0.00 65535.00 FORMAT "%8.2" ECU_ADDRESS 0x60014558 /end MEASUREMENT
/begin MEASUREMENT DINH_stFId.FId_PThrVlvUsMeasdVldB1 "Inhibit Status of FIds / Status of function identifier FId_PThrVlvUsMeasdVldB1" UWORD DFC_OneToOne 1 100 0.00 65535.00 FORMAT "%8.2" ECU_ADDRESS 0x6001455A /end MEASUREMENT
/begin MEASUREMENT DINH_stFId.FId_P_VSE11_Diag "Inhibit Status of FIds / Status of function identifier FId_P_VSE11_Diag" UWORD DFC_OneToOne 1 100 0.00 65535.00 FORMAT "%8.2" ECU_ADDRESS 0x6001455C /end MEASUREMENT
/begin MEASUREMENT DINH_stFId.FId_PrmId03_FltRdnS1B1 "Inhibit Status of FIds / Status of function identifier FId_PrmId03_FltRdnS1B1" UWORD DFC_OneToOne 1 100 0.00 65535.00 FORMAT "%8.2" ECU_ADDRESS 0x6001455E /end MEASUREMENT
/begin MEASUREMENT DINH_stFId.FId_PrmId03_FltUegoS1B1 "Inhibit Status of FIds / Status of function identifier FId_PrmId03_FltUegoS1B1" UWORD DFC_OneToOne 1 100 0.00 65535.00 FORMAT "%8.2" ECU_ADDRESS 0x60014560 /end MEASUREMENT
/begin MEASUREMENT DINH_stFId.FId_RevLck "Inhibit Status of FIds / Status of function identifier FId_RevLck" UWORD DFC_OneToOne 1 100 0.00 65535.00 FORMAT "%8.2" ECU_ADDRESS 0x60014562 /end MEASUREMENT
/begin MEASUREMENT DINH_stFId.FId_RstAdpnPIntkMnfldAfs "Inhibit Status of FIds / Status of function identifier FId_RstAdpnPIntkMnfldAfs" UWORD DFC_OneToOne 1 100 0.00 65535.00 FORMAT "%8.2" ECU_ADDRESS 0x60014564 /end MEASUREMENT
/begin MEASUREMENT DINH_stFId.FId_RvsPosnFailr "Inhibit Status of FIds / Status of function identifier FId_RvsPosnFailr" UWORD DFC_OneToOne 1 100 0.00 65535.00 FORMAT "%8.2" ECU_ADDRESS 0x60014566 /end MEASUREMENT
/begin MEASUREMENT DINH_stFId.FId_SSEEPBRelease "Inhibit Status of FIds / Status of function identifier FId_SSEEPBRelease" UWORD DFC_OneToOne 1 100 0.00 65535.00 FORMAT "%8.2" ECU_ADDRESS 0x60014568 /end MEASUREMENT
/begin MEASUREMENT DINH_stFId.FId_SSEFCANPRelease "Inhibit Status of FIds / Status of function identifier FId_SSEFCANPRelease" UWORD DFC_OneToOne 1 100 0.00 65535.00 FORMAT "%8.2" ECU_ADDRESS 0x6001456A /end MEASUREMENT
/begin MEASUREMENT DINH_stFId.FId_SSEPTCANPRelease "Inhibit Status of FIds / Status of function identifier FId_SSEPTCANPRelease" UWORD DFC_OneToOne 1 100 0.00 65535.00 FORMAT "%8.2" ECU_ADDRESS 0x6001456C /end MEASUREMENT
/begin MEASUREMENT DINH_stFId.FId_SSEStartRelease "Inhibit Status of FIds / Status of function identifier FId_SSEStartRelease" UWORD DFC_OneToOne 1 100 0.00 65535.00 FORMAT "%8.2" ECU_ADDRESS 0x6001456E /end MEASUREMENT
/begin MEASUREMENT DINH_stFId.FId_SSEStartReleaseMTCl10 "Inhibit Status of FIds / Status of function identifier FId_SSEStartReleaseMTCl10" UWORD DFC_OneToOne 1 100 0.00 65535.00 FORMAT "%8.2" ECU_ADDRESS 0x60014570 /end MEASUREMENT
/begin MEASUREMENT DINH_stFId.FId_SSEStartReleaseMTCl100 "Inhibit Status of FIds / Status of function identifier FId_SSEStartReleaseMTCl100" UWORD DFC_OneToOne 1 100 0.00 65535.00 FORMAT "%8.2" ECU_ADDRESS 0x60014572 /end MEASUREMENT
/begin MEASUREMENT DINH_stFId.FId_SSEStartReleaseMTCl20 "Inhibit Status of FIds / Status of function identifier FId_SSEStartReleaseMTCl20" UWORD DFC_OneToOne 1 100 0.00 65535.00 FORMAT "%8.2" ECU_ADDRESS 0x60014574 /end MEASUREMENT
/begin MEASUREMENT DINH_stFId.FId_SSEStartReleaseMTCl90 "Inhibit Status of FIds / Status of function identifier FId_SSEStartReleaseMTCl90" UWORD DFC_OneToOne 1 100 0.00 65535.00 FORMAT "%8.2" ECU_ADDRESS 0x60014576 /end MEASUREMENT
/begin MEASUREMENT DINH_stFId.FId_SSEStartRequest "Inhibit Status of FIds / Status of function identifier FId_SSEStartRequest" UWORD DFC_OneToOne 1 100 0.00 65535.00 FORMAT "%8.2" ECU_ADDRESS 0x60014578 /end MEASUREMENT
/begin MEASUREMENT DINH_stFId.FId_SSEStopRelease "Inhibit Status of FIds / Status of function identifier FId_SSEStopRelease" UWORD DFC_OneToOne 1 100 0.00 65535.00 FORMAT "%8.2" ECU_ADDRESS 0x6001457A /end MEASUREMENT
/begin MEASUREMENT DINH_stFId.FId_SSEStrtStopRelease "Inhibit Status of FIds / Status of function identifier FId_SSEStrtStopRelease" UWORD DFC_OneToOne 1 100 0.00 65535.00 FORMAT "%8.2" ECU_ADDRESS 0x6001457C /end MEASUREMENT
/begin MEASUREMENT DINH_stFId.FId_SSESysOff "Inhibit Status of FIds / Status of function identifier FId_SSESysOff" UWORD DFC_OneToOne 1 100 0.00 65535.00 FORMAT "%8.2" ECU_ADDRESS 0x6001457E /end MEASUREMENT
/begin MEASUREMENT DINH_stFId.FId_SSEUI2DCSysFailr "Inhibit Status of FIds / Status of function identifier FId_SSEUI2DCSysFailr" UWORD DFC_OneToOne 1 100 0.00 65535.00 FORMAT "%8.2" ECU_ADDRESS 0x60014580 /end MEASUREMENT
/begin MEASUREMENT DINH_stFId.FId_SSEUIBCANErr "Inhibit Status of FIds / Status of function identifier FId_SSEUIBCANErr" UWORD DFC_OneToOne 1 100 0.00 65535.00 FORMAT "%8.2" ECU_ADDRESS 0x60014582 /end MEASUREMENT
/begin MEASUREMENT DINH_stFId.FId_SSEUISysFail "Inhibit Status of FIds / Status of function identifier FId_SSEUISysFail" UWORD DFC_OneToOne 1 100 0.00 65535.00 FORMAT "%8.2" ECU_ADDRESS 0x60014584 /end MEASUREMENT
/begin MEASUREMENT DINH_stFId.FId_SiaEEPErr "Inhibit Status of FIds / Status of function identifier FId_SiaEEPErr" UWORD DFC_OneToOne 1 100 0.00 65535.00 FORMAT "%8.2" ECU_ADDRESS 0x60014586 /end MEASUREMENT
/begin MEASUREMENT DINH_stFId.FId_SnglWhlErrDiagEna "Inhibit Status of FIds / Status of function identifier FId_SnglWhlErrDiagEna" UWORD DFC_OneToOne 1 100 0.00 65535.00 FORMAT "%8.2" ECU_ADDRESS 0x60014588 /end MEASUREMENT
/begin MEASUREMENT DINH_stFId.FId_StrtCtlAutoCrkModeCdn "Inhibit Status of FIds / Status of function identifier FId_StrtCtlAutoCrkModeCdn" UWORD DFC_OneToOne 1 100 0.00 65535.00 FORMAT "%8.2" ECU_ADDRESS 0x6001458A /end MEASUREMENT
/begin MEASUREMENT DINH_stFId.FId_StrtCtlComEngStrtErr "Inhibit Status of FIds / Status of function identifier FId_StrtCtlComEngStrtErr" UWORD DFC_OneToOne 1 100 0.00 65535.00 FORMAT "%8.2" ECU_ADDRESS 0x6001458C /end MEASUREMENT
/begin MEASUREMENT DINH_stFId.FId_StrtCtlNPCdnCncl "Inhibit Status of FIds / Status of function identifier FId_StrtCtlNPCdnCncl" UWORD DFC_OneToOne 1 100 0.00 65535.00 FORMAT "%8.2" ECU_ADDRESS 0x6001458E /end MEASUREMENT
/begin MEASUREMENT DINH_stFId.FId_StrtCtlNoCpuFailr "Inhibit Status of FIds / Status of function identifier FId_StrtCtlNoCpuFailr" UWORD DFC_OneToOne 1 100 0.00 65535.00 FORMAT "%8.2" ECU_ADDRESS 0x60014590 /end MEASUREMENT
/begin MEASUREMENT DINH_stFId.FId_StrtCtlNoFailCanLine "Inhibit Status of FIds / Status of function identifier FId_StrtCtlNoFailCanLine" UWORD DFC_OneToOne 1 100 0.00 65535.00 FORMAT "%8.2" ECU_ADDRESS 0x60014592 /end MEASUREMENT
/begin MEASUREMENT DINH_stFId.FId_StrtCtlNoFailPTCanLine "Inhibit Status of FIds / Status of function identifier FId_StrtCtlNoFailPTCanLine" UWORD DFC_OneToOne 1 100 0.00 65535.00 FORMAT "%8.2" ECU_ADDRESS 0x60014594 /end MEASUREMENT
/begin MEASUREMENT DINH_stFId.FId_StrtCtlPNPosnSubsVal "Inhibit Status of FIds / Status of function identifier FId_StrtCtlPNPosnSubsVal" UWORD DFC_OneToOne 1 100 0.00 65535.00 FORMAT "%8.2" ECU_ADDRESS 0x60014596 /end MEASUREMENT
/begin MEASUREMENT DINH_stFId.FId_StrtCtlSTMFailr "Inhibit Status of FIds / Status of function identifier FId_StrtCtlSTMFailr" UWORD DFC_OneToOne 1 100 0.00 65535.00 FORMAT "%8.2" ECU_ADDRESS 0x60014598 /end MEASUREMENT
/begin MEASUREMENT DINH_stFId.FId_StrtErrShaft "Inhibit Status of FIds / Status of function identifier FId_StrtErrShaft" UWORD DFC_OneToOne 1 100 0.00 65535.00 FORMAT "%8.2" ECU_ADDRESS 0x6001459A /end MEASUREMENT
/begin MEASUREMENT DINH_stFId.FId_SumErrHndlg "Inhibit Status of FIds / Status of function identifier FId_SumErrHndlg" UWORD DFC_OneToOne 1 100 0.00 65535.00 FORMAT "%8.2" ECU_ADDRESS 0x6001459C /end MEASUREMENT
/begin MEASUREMENT DINH_stFId.FId_SysDiagComErr "Inhibit Status of FIds / Status of function identifier FId_SysDiagComErr" UWORD DFC_OneToOne 1 100 0.00 65535.00 FORMAT "%8.2" ECU_ADDRESS 0x6001459E /end MEASUREMENT
/begin MEASUREMENT DINH_stFId.FId_SysDiagModInhbErr "Inhibit Status of FIds / Status of function identifier FId_SysDiagModInhbErr" UWORD DFC_OneToOne 1 100 0.00 65535.00 FORMAT "%8.2" ECU_ADDRESS 0x600145A0 /end MEASUREMENT
/begin MEASUREMENT DINH_stFId.FId_TOSPM "Inhibit Status of FIds / Status of function identifier FId_TOSPM" UWORD DFC_OneToOne 1 100 0.00 65535.00 FORMAT "%8.2" ECU_ADDRESS 0x600145A2 /end MEASUREMENT
/begin MEASUREMENT DINH_stFId.FId_TWCCILck "Inhibit Status of FIds / Status of function identifier FId_TWCCILck" UWORD DFC_OneToOne 1 100 0.00 65535.00 FORMAT "%8.2" ECU_ADDRESS 0x600145A4 /end MEASUREMENT
/begin MEASUREMENT DINH_stFId.FId_TWCCILckExtd "Inhibit Status of FIds / Status of function identifier FId_TWCCILckExtd" UWORD DFC_OneToOne 1 100 0.00 65535.00 FORMAT "%8.2" ECU_ADDRESS 0x600145A6 /end MEASUREMENT
/begin MEASUREMENT DINH_stFId.FId_TWCCIRstB1 "Inhibit Status of FIds / Status of function identifier FId_TWCCIRstB1" UWORD DFC_OneToOne 1 100 0.00 65535.00 FORMAT "%8.2" ECU_ADDRESS 0x600145A8 /end MEASUREMENT
/begin MEASUREMENT DINH_stFId.FId_TWCCIRstDSMClearB1 "Inhibit Status of FIds / Status of function identifier FId_TWCCIRstDSMClearB1" UWORD DFC_OneToOne 1 100 0.00 65535.00 FORMAT "%8.2" ECU_ADDRESS 0x600145AA /end MEASUREMENT
/begin MEASUREMENT DINH_stFId.FId_TWCCLsuB1 "Inhibit Status of FIds / Status of function identifier FId_TWCCLsuB1" UWORD DFC_OneToOne 1 100 0.00 65535.00 FORMAT "%8.2" ECU_ADDRESS 0x600145AC /end MEASUREMENT
/begin MEASUREMENT DINH_stFId.FId_TWCCLsuCyc "Inhibit Status of FIds / Status of function identifier FId_TWCCLsuCyc" UWORD DFC_OneToOne 1 100 0.00 65535.00 FORMAT "%8.2" ECU_ADDRESS 0x600145AE /end MEASUREMENT
/begin MEASUREMENT DINH_stFId.FId_TWCCLsuDynB1 "Inhibit Status of FIds / Status of function identifier FId_TWCCLsuDynB1" UWORD DFC_OneToOne 1 100 0.00 65535.00 FORMAT "%8.2" ECU_ADDRESS 0x600145B0 /end MEASUREMENT
/begin MEASUREMENT DINH_stFId.FId_TWCCMisfDetn "Inhibit Status of FIds / Status of function identifier FId_TWCCMisfDetn" UWORD DFC_OneToOne 1 100 0.00 65535.00 FORMAT "%8.2" ECU_ADDRESS 0x600145B2 /end MEASUREMENT
/begin MEASUREMENT DINH_stFId.FId_TWCDPriCatParB1 "Inhibit Status of FIds / Status of function identifier FId_TWCDPriCatParB1" UWORD DFC_OneToOne 1 100 0.00 65535.00 FORMAT "%8.2" ECU_ADDRESS 0x600145B4 /end MEASUREMENT
/begin MEASUREMENT DINH_stFId.FId_TWCDPriCatVldnB1 "Inhibit Status of FIds / Status of function identifier FId_TWCDPriCatVldnB1" UWORD DFC_OneToOne 1 100 0.00 65535.00 FORMAT "%8.2" ECU_ADDRESS 0x600145B6 /end MEASUREMENT
/begin MEASUREMENT DINH_stFId.FId_TankPCpv1DteskLoLoadStuckClsd "Inhibit Status of FIds / Status of function identifier FId_TankPCpv1DteskLoLoadStuckClsd" UWORD DFC_OneToOne 1 100 0.00 65535.00 FORMAT "%8.2" ECU_ADDRESS 0x600145B8 /end MEASUREMENT
/begin MEASUREMENT DINH_stFId.FId_TankPCpv1DteskLoLoadStuckOpen "Inhibit Status of FIds / Status of function identifier FId_TankPCpv1DteskLoLoadStuckOpen" UWORD DFC_OneToOne 1 100 0.00 65535.00 FORMAT "%8.2" ECU_ADDRESS 0x600145BA /end MEASUREMENT
/begin MEASUREMENT DINH_stFId.FId_TankPSnsrElecChkVld "Inhibit Status of FIds / Status of function identifier FId_TankPSnsrElecChkVld" UWORD DFC_OneToOne 1 100 0.00 65535.00 FORMAT "%8.2" ECU_ADDRESS 0x600145BC /end MEASUREMENT
/begin MEASUREMENT DINH_stFId.FId_ThrVlvMon "Inhibit Status of FIds / Status of function identifier FId_ThrVlvMon" UWORD DFC_OneToOne 1 100 0.00 65535.00 FORMAT "%8.2" ECU_ADDRESS 0x600145BE /end MEASUREMENT
/begin MEASUREMENT DINH_stFId.FId_ThrVlvOffsLrnPrmsB1 "Inhibit Status of FIds / Status of function identifier FId_ThrVlvOffsLrnPrmsB1" UWORD DFC_OneToOne 1 100 0.00 65535.00 FORMAT "%8.2" ECU_ADDRESS 0x600145C0 /end MEASUREMENT
/begin MEASUREMENT DINH_stFId.FId_TiOffTBasdChkFast "Inhibit Status of FIds / Status of function identifier FId_TiOffTBasdChkFast" UWORD DFC_OneToOne 1 100 0.00 65535.00 FORMAT "%8.2" ECU_ADDRESS 0x600145C2 /end MEASUREMENT
/begin MEASUREMENT DINH_stFId.FId_TiOffTBasdChkSlow "Inhibit Status of FIds / Status of function identifier FId_TiOffTBasdChkSlow" UWORD DFC_OneToOne 1 100 0.00 65535.00 FORMAT "%8.2" ECU_ADDRESS 0x600145C4 /end MEASUREMENT
/begin MEASUREMENT DINH_stFId.FId_TiOffVdClk "Inhibit Status of FIds / Status of function identifier FId_TiOffVdClk" UWORD DFC_OneToOne 1 100 0.00 65535.00 FORMAT "%8.2" ECU_ADDRESS 0x600145C6 /end MEASUREMENT
/begin MEASUREMENT DINH_stFId.FId_TqDecelOffsInhb "Inhibit Status of FIds / Status of function identifier FId_TqDecelOffsInhb" UWORD DFC_OneToOne 1 100 0.00 65535.00 FORMAT "%8.2" ECU_ADDRESS 0x600145C8 /end MEASUREMENT
/begin MEASUREMENT DINH_stFId.FId_TraAddAirCANPtd "Inhibit Status of FIds / Status of function identifier FId_TraAddAirCANPtd" UWORD DFC_OneToOne 1 100 0.00 65535.00 FORMAT "%8.2" ECU_ADDRESS 0x600145CA /end MEASUREMENT
/begin MEASUREMENT DINH_stFId.FId_TraAddClntCANPtd "Inhibit Status of FIds / Status of function identifier FId_TraAddClntCANPtd" UWORD DFC_OneToOne 1 100 0.00 65535.00 FORMAT "%8.2" ECU_ADDRESS 0x600145CC /end MEASUREMENT
/begin MEASUREMENT DINH_stFId.FId_TraFwdRvsCluInfo "Inhibit Status of FIds / Status of function identifier FId_TraFwdRvsCluInfo" UWORD DFC_OneToOne 1 100 0.00 65535.00 FORMAT "%8.2" ECU_ADDRESS 0x600145CE /end MEASUREMENT
/begin MEASUREMENT DINH_stFId.FId_TraGbxNPos "Inhibit Status of FIds / Status of function identifier FId_TraGbxNPos" UWORD DFC_OneToOne 1 100 0.00 65535.00 FORMAT "%8.2" ECU_ADDRESS 0x600145D0 /end MEASUREMENT
/begin MEASUREMENT DINH_stFId.FId_TraGearInfoCanCom "Inhibit Status of FIds / Status of function identifier FId_TraGearInfoCanCom" UWORD DFC_OneToOne 1 100 0.00 65535.00 FORMAT "%8.2" ECU_ADDRESS 0x600145D2 /end MEASUREMENT
/begin MEASUREMENT DINH_stFId.FId_TraGearInfoDet "Inhibit Status of FIds / Status of function identifier FId_TraGearInfoDet" UWORD DFC_OneToOne 1 100 0.00 65535.00 FORMAT "%8.2" ECU_ADDRESS 0x600145D4 /end MEASUREMENT
/begin MEASUREMENT DINH_stFId.FId_TraGearInfoGearShftActv "Inhibit Status of FIds / Status of function identifier FId_TraGearInfoGearShftActv" UWORD DFC_OneToOne 1 100 0.00 65535.00 FORMAT "%8.2" ECU_ADDRESS 0x600145D6 /end MEASUREMENT
/begin MEASUREMENT DINH_stFId.FId_TraGearInfoInfoCan "Inhibit Status of FIds / Status of function identifier FId_TraGearInfoInfoCan" UWORD DFC_OneToOne 1 100 0.00 65535.00 FORMAT "%8.2" ECU_ADDRESS 0x600145D8 /end MEASUREMENT
/begin MEASUREMENT DINH_stFId.FId_TraGearInfoLevPos "Inhibit Status of FIds / Status of function identifier FId_TraGearInfoLevPos" UWORD DFC_OneToOne 1 100 0.00 65535.00 FORMAT "%8.2" ECU_ADDRESS 0x600145DA /end MEASUREMENT
/begin MEASUREMENT DINH_stFId.FId_TraGearInfoLoRng "Inhibit Status of FIds / Status of function identifier FId_TraGearInfoLoRng" UWORD DFC_OneToOne 1 100 0.00 65535.00 FORMAT "%8.2" ECU_ADDRESS 0x600145DC /end MEASUREMENT
/begin MEASUREMENT DINH_stFId.FId_TraGearInfoRTra "Inhibit Status of FIds / Status of function identifier FId_TraGearInfoRTra" UWORD DFC_OneToOne 1 100 0.00 65535.00 FORMAT "%8.2" ECU_ADDRESS 0x600145DE /end MEASUREMENT
/begin MEASUREMENT DINH_stFId.FId_TraGearInfoRevGear "Inhibit Status of FIds / Status of function identifier FId_TraGearInfoRevGear" UWORD DFC_OneToOne 1 100 0.00 65535.00 FORMAT "%8.2" ECU_ADDRESS 0x600145E0 /end MEASUREMENT
/begin MEASUREMENT DINH_stFId.FId_TraGearReq "Inhibit Status of FIds / Status of function identifier FId_TraGearReq" UWORD DFC_OneToOne 1 100 0.00 65535.00 FORMAT "%8.2" ECU_ADDRESS 0x600145E2 /end MEASUREMENT
/begin MEASUREMENT DINH_stFId.FId_TraNoShftIdctr "Inhibit Status of FIds / Status of function identifier FId_TraNoShftIdctr" UWORD DFC_OneToOne 1 100 0.00 65535.00 FORMAT "%8.2" ECU_ADDRESS 0x600145E4 /end MEASUREMENT
/begin MEASUREMENT DINH_stFId.FId_TraPrtGearCANPtd "Inhibit Status of FIds / Status of function identifier FId_TraPrtGearCANPtd" UWORD DFC_OneToOne 1 100 0.00 65535.00 FORMAT "%8.2" ECU_ADDRESS 0x600145E6 /end MEASUREMENT
/begin MEASUREMENT DINH_stFId.FId_TraPrtGearIndpdtProblem "Inhibit Status of FIds / Status of function identifier FId_TraPrtGearIndpdtProblem" UWORD DFC_OneToOne 1 100 0.00 65535.00 FORMAT "%8.2" ECU_ADDRESS 0x600145E8 /end MEASUREMENT
/begin MEASUREMENT DINH_stFId.FId_TraRPosn "Inhibit Status of FIds / Status of function identifier FId_TraRPosn" UWORD DFC_OneToOne 1 100 0.00 65535.00 FORMAT "%8.2" ECU_ADDRESS 0x600145EA /end MEASUREMENT
/begin MEASUREMENT DINH_stFId.FId_TraRtnIntfcASTIntv "Inhibit Status of FIds / Status of function identifier FId_TraRtnIntfcASTIntv" UWORD DFC_OneToOne 1 100 0.00 65535.00 FORMAT "%8.2" ECU_ADDRESS 0x600145EC /end MEASUREMENT
/begin MEASUREMENT DINH_stFId.FId_TraRtnIntfcIdlSetP "Inhibit Status of FIds / Status of function identifier FId_TraRtnIntfcIdlSetP" UWORD DFC_OneToOne 1 100 0.00 65535.00 FORMAT "%8.2" ECU_ADDRESS 0x600145EE /end MEASUREMENT
/begin MEASUREMENT DINH_stFId.FId_TraRtnIntfcNMaxCan "Inhibit Status of FIds / Status of function identifier FId_TraRtnIntfcNMaxCan" UWORD DFC_OneToOne 1 100 0.00 65535.00 FORMAT "%8.2" ECU_ADDRESS 0x600145F0 /end MEASUREMENT
/begin MEASUREMENT DINH_stFId.FId_TraRtnIntfcNMaxVel "Inhibit Status of FIds / Status of function identifier FId_TraRtnIntfcNMaxVel" UWORD DFC_OneToOne 1 100 0.00 65535.00 FORMAT "%8.2" ECU_ADDRESS 0x600145F2 /end MEASUREMENT
/begin MEASUREMENT DINH_stFId.FId_TraTrqRedLmpHmeDec "Inhibit Status of FIds / Status of function identifier FId_TraTrqRedLmpHmeDec" UWORD DFC_OneToOne 1 100 0.00 65535.00 FORMAT "%8.2" ECU_ADDRESS 0x600145F4 /end MEASUREMENT
/begin MEASUREMENT DINH_stFId.FId_TraTrqRedLmpHmeInc "Inhibit Status of FIds / Status of function identifier FId_TraTrqRedLmpHmeInc" UWORD DFC_OneToOne 1 100 0.00 65535.00 FORMAT "%8.2" ECU_ADDRESS 0x600145F6 /end MEASUREMENT
/begin MEASUREMENT DINH_stFId.FId_TraTrqRedPTCanErr "Inhibit Status of FIds / Status of function identifier FId_TraTrqRedPTCanErr" UWORD DFC_OneToOne 1 100 0.00 65535.00 FORMAT "%8.2" ECU_ADDRESS 0x600145F8 /end MEASUREMENT
/begin MEASUREMENT DINH_stFId.FId_TraTrqRedTIIntvDes "Inhibit Status of FIds / Status of function identifier FId_TraTrqRedTIIntvDes" UWORD DFC_OneToOne 1 100 0.00 65535.00 FORMAT "%8.2" ECU_ADDRESS 0x600145FA /end MEASUREMENT
/begin MEASUREMENT DINH_stFId.FId_TraTrqRedTIIntvLead "Inhibit Status of FIds / Status of function identifier FId_TraTrqRedTIIntvLead" UWORD DFC_OneToOne 1 100 0.00 65535.00 FORMAT "%8.2" ECU_ADDRESS 0x600145FC /end MEASUREMENT
/begin MEASUREMENT DINH_stFId.FId_TraTrqRedTSCIntvDes "Inhibit Status of FIds / Status of function identifier FId_TraTrqRedTSCIntvDes" UWORD DFC_OneToOne 1 100 0.00 65535.00 FORMAT "%8.2" ECU_ADDRESS 0x600145FE /end MEASUREMENT
/begin MEASUREMENT DINH_stFId.FId_TraTrqRedTSCIntvLead "Inhibit Status of FIds / Status of function identifier FId_TraTrqRedTSCIntvLead" UWORD DFC_OneToOne 1 100 0.00 65535.00 FORMAT "%8.2" ECU_ADDRESS 0x60014600 /end MEASUREMENT
/begin MEASUREMENT DINH_stFId.FId_TraTrsmTypHw "Inhibit Status of FIds / Status of function identifier FId_TraTrsmTypHw" UWORD DFC_OneToOne 1 100 0.00 65535.00 FORMAT "%8.2" ECU_ADDRESS 0x60014602 /end MEASUREMENT
/begin MEASUREMENT DINH_stFId.FId_TranIdleDes "Inhibit Status of FIds / Status of function identifier FId_TranIdleDes" UWORD DFC_OneToOne 1 100 0.00 65535.00 FORMAT "%8.2" ECU_ADDRESS 0x60014604 /end MEASUREMENT
/begin MEASUREMENT DINH_stFId.FId_UEGOHeatgUpRglS1B1 "Inhibit Status of FIds / Status of function identifier FId_UEGOHeatgUpRglS1B1" UWORD DFC_OneToOne 1 100 0.00 65535.00 FORMAT "%8.2" ECU_ADDRESS 0x60014606 /end MEASUREMENT
/begin MEASUREMENT DINH_stFId.FId_UEGOHeatrCtrlS1B1 "Inhibit Status of FIds / Status of function identifier FId_UEGOHeatrCtrlS1B1" UWORD DFC_OneToOne 1 100 0.00 65535.00 FORMAT "%8.2" ECU_ADDRESS 0x60014608 /end MEASUREMENT
/begin MEASUREMENT DINH_stFId.FId_UEGOHeatrPrfmncDiagRelsS1B1 "Inhibit Status of FIds / Status of function identifier FId_UEGOHeatrPrfmncDiagRelsS1B1" UWORD DFC_OneToOne 1 100 0.00 65535.00 FORMAT "%8.2" ECU_ADDRESS 0x6001460A /end MEASUREMENT
/begin MEASUREMENT DINH_stFId.FId_UEGOHeatrPwrStgDiagRelsS1B1 "Inhibit Status of FIds / Status of function identifier FId_UEGOHeatrPwrStgDiagRelsS1B1" UWORD DFC_OneToOne 1 100 0.00 65535.00 FORMAT "%8.2" ECU_ADDRESS 0x6001460C /end MEASUREMENT
/begin MEASUREMENT DINH_stFId.FId_UEGOModCtrlRelsS1B1 "Inhibit Status of FIds / Status of function identifier FId_UEGOModCtrlRelsS1B1" UWORD DFC_OneToOne 1 100 0.00 65535.00 FORMAT "%8.2" ECU_ADDRESS 0x6001460E /end MEASUREMENT
/begin MEASUREMENT DINH_stFId.FId_UEGOStrtDiagInhRprtErrS1B1 "Inhibit Status of FIds / Status of function identifier FId_UEGOStrtDiagInhRprtErrS1B1" UWORD DFC_OneToOne 1 100 0.00 65535.00 FORMAT "%8.2" ECU_ADDRESS 0x60014610 /end MEASUREMENT
/begin MEASUREMENT DINH_stFId.FId_UEGOStrtDiagRelsS1B1 "Inhibit Status of FIds / Status of function identifier FId_UEGOStrtDiagRelsS1B1" UWORD DFC_OneToOne 1 100 0.00 65535.00 FORMAT "%8.2" ECU_ADDRESS 0x60014612 /end MEASUREMENT
/begin MEASUREMENT DINH_stFId.FId_UEGOTCeramicRelsS1B1 "Inhibit Status of FIds / Status of function identifier FId_UEGOTCeramicRelsS1B1" UWORD DFC_OneToOne 1 100 0.00 65535.00 FORMAT "%8.2" ECU_ADDRESS 0x60014614 /end MEASUREMENT
/begin MEASUREMENT DINH_stFId.FId_UegoDiagRelsBattSplyOk "Inhibit Status of FIds / Status of function identifier FId_UegoDiagRelsBattSplyOk" UWORD DFC_OneToOne 1 100 0.00 65535.00 FORMAT "%8.2" ECU_ADDRESS 0x60014616 /end MEASUREMENT
/begin MEASUREMENT DINH_stFId.FId_UegoDiagSigEcuAsicS1B1 "Inhibit Status of FIds / Status of function identifier FId_UegoDiagSigEcuAsicS1B1" UWORD DFC_OneToOne 1 100 0.00 65535.00 FORMAT "%8.2" ECU_ADDRESS 0x60014618 /end MEASUREMENT
/begin MEASUREMENT DINH_stFId.FId_UegoDiagSigEcuComS1B1 "Inhibit Status of FIds / Status of function identifier FId_UegoDiagSigEcuComS1B1" UWORD DFC_OneToOne 1 100 0.00 65535.00 FORMAT "%8.2" ECU_ADDRESS 0x6001461A /end MEASUREMENT
/begin MEASUREMENT DINH_stFId.FId_UegoDiagSigOperPlausS1B1 "Inhibit Status of FIds / Status of function identifier FId_UegoDiagSigOperPlausS1B1" UWORD DFC_OneToOne 1 100 0.00 65535.00 FORMAT "%8.2" ECU_ADDRESS 0x6001461C /end MEASUREMENT
/begin MEASUREMENT DINH_stFId.FId_UegoDiagSigSnsrS1B1 "Inhibit Status of FIds / Status of function identifier FId_UegoDiagSigSnsrS1B1" UWORD DFC_OneToOne 1 100 0.00 65535.00 FORMAT "%8.2" ECU_ADDRESS 0x6001461E /end MEASUREMENT
/begin MEASUREMENT DINH_stFId.FId_UegoDiagSigWireOlS1B1 "Inhibit Status of FIds / Status of function identifier FId_UegoDiagSigWireOlS1B1" UWORD DFC_OneToOne 1 100 0.00 65535.00 FORMAT "%8.2" ECU_ADDRESS 0x60014620 /end MEASUREMENT
/begin MEASUREMENT DINH_stFId.FId_UegoDiagSigWireScS1B1 "Inhibit Status of FIds / Status of function identifier FId_UegoDiagSigWireScS1B1" UWORD DFC_OneToOne 1 100 0.00 65535.00 FORMAT "%8.2" ECU_ADDRESS 0x60014622 /end MEASUREMENT
/begin MEASUREMENT DINH_stFId.FId_UegoDiagSigWireScTstdS1B1 "Inhibit Status of FIds / Status of function identifier FId_UegoDiagSigWireScTstdS1B1" UWORD DFC_OneToOne 1 100 0.00 65535.00 FORMAT "%8.2" ECU_ADDRESS 0x60014624 /end MEASUREMENT
/begin MEASUREMENT DINH_stFId.FId_UegoInhbOperRelsS1B1 "Inhibit Status of FIds / Status of function identifier FId_UegoInhbOperRelsS1B1" UWORD DFC_OneToOne 1 100 0.00 65535.00 FORMAT "%8.2" ECU_ADDRESS 0x60014626 /end MEASUREMENT
/begin MEASUREMENT DINH_stFId.FId_UegoO2HiPrcsnS1B1 "Inhibit Status of FIds / Status of function identifier FId_UegoO2HiPrcsnS1B1" UWORD DFC_OneToOne 1 100 0.00 65535.00 FORMAT "%8.2" ECU_ADDRESS 0x60014628 /end MEASUREMENT
/begin MEASUREMENT DINH_stFId.FId_UegoO2PlausErrS1B1 "Inhibit Status of FIds / Status of function identifier FId_UegoO2PlausErrS1B1" UWORD DFC_OneToOne 1 100 0.00 65535.00 FORMAT "%8.2" ECU_ADDRESS 0x6001462A /end MEASUREMENT
/begin MEASUREMENT DINH_stFId.FId_UegoO2VldS1B1 "Inhibit Status of FIds / Status of function identifier FId_UegoO2VldS1B1" UWORD DFC_OneToOne 1 100 0.00 65535.00 FORMAT "%8.2" ECU_ADDRESS 0x6001462C /end MEASUREMENT
/begin MEASUREMENT DINH_stFId.FId_UegoOperPlausBattSplyOk "Inhibit Status of FIds / Status of function identifier FId_UegoOperPlausBattSplyOk" UWORD DFC_OneToOne 1 100 0.00 65535.00 FORMAT "%8.2" ECU_ADDRESS 0x6001462E /end MEASUREMENT
/begin MEASUREMENT DINH_stFId.FId_UegoPlausErrHndlg "Inhibit Status of FIds / Status of function identifier FId_UegoPlausErrHndlg" UWORD DFC_OneToOne 1 100 0.00 65535.00 FORMAT "%8.2" ECU_ADDRESS 0x60014630 /end MEASUREMENT
/begin MEASUREMENT DINH_stFId.FId_VMSIDCSRmpShOff "Inhibit Status of FIds / Status of function identifier FId_VMSIDCSRmpShOff" UWORD DFC_OneToOne 1 100 0.00 65535.00 FORMAT "%8.2" ECU_ADDRESS 0x60014632 /end MEASUREMENT
/begin MEASUREMENT DINH_stFId.FId_VMSIDCSShOff "Inhibit Status of FIds / Status of function identifier FId_VMSIDCSShOff" UWORD DFC_OneToOne 1 100 0.00 65535.00 FORMAT "%8.2" ECU_ADDRESS 0x60014634 /end MEASUREMENT
/begin MEASUREMENT DINH_stFId.FId_VMSITCSRmpShOff "Inhibit Status of FIds / Status of function identifier FId_VMSITCSRmpShOff" UWORD DFC_OneToOne 1 100 0.00 65535.00 FORMAT "%8.2" ECU_ADDRESS 0x60014636 /end MEASUREMENT
/begin MEASUREMENT DINH_stFId.FId_VMSITCSShOff "Inhibit Status of FIds / Status of function identifier FId_VMSITCSShOff" UWORD DFC_OneToOne 1 100 0.00 65535.00 FORMAT "%8.2" ECU_ADDRESS 0x60014638 /end MEASUREMENT
/begin MEASUREMENT DINH_stFId.FId_VSACANErr "Inhibit Status of FIds / Status of function identifier FId_VSACANErr" UWORD DFC_OneToOne 1 100 0.00 65535.00 FORMAT "%8.2" ECU_ADDRESS 0x6001463A /end MEASUREMENT
/begin MEASUREMENT DINH_stFId.FId_VehStcACGFailr "Inhibit Status of FIds / Status of function identifier FId_VehStcACGFailr" UWORD DFC_OneToOne 1 100 0.00 65535.00 FORMAT "%8.2" ECU_ADDRESS 0x6001463C /end MEASUREMENT
/begin MEASUREMENT DINH_stFId.FId_VehStcBattMngFailr "Inhibit Status of FIds / Status of function identifier FId_VehStcBattMngFailr" UWORD DFC_OneToOne 1 100 0.00 65535.00 FORMAT "%8.2" ECU_ADDRESS 0x6001463E /end MEASUREMENT
/begin MEASUREMENT DINH_stFId.FId_VehStcDCDCFailr "Inhibit Status of FIds / Status of function identifier FId_VehStcDCDCFailr" UWORD DFC_OneToOne 1 100 0.00 65535.00 FORMAT "%8.2" ECU_ADDRESS 0x60014640 /end MEASUREMENT
/begin MEASUREMENT DINH_stFId.FId_VehStcEBSFailr "Inhibit Status of FIds / Status of function identifier FId_VehStcEBSFailr" UWORD DFC_OneToOne 1 100 0.00 65535.00 FORMAT "%8.2" ECU_ADDRESS 0x60014642 /end MEASUREMENT
/begin MEASUREMENT DINH_stFId.FId_VehStcMisf "Inhibit Status of FIds / Status of function identifier FId_VehStcMisf" UWORD DFC_OneToOne 1 100 0.00 65535.00 FORMAT "%8.2" ECU_ADDRESS 0x60014644 /end MEASUREMENT
/begin MEASUREMENT DINH_stFId.FId_VehStcMtrComFailr "Inhibit Status of FIds / Status of function identifier FId_VehStcMtrComFailr" UWORD DFC_OneToOne 1 100 0.00 65535.00 FORMAT "%8.2" ECU_ADDRESS 0x60014646 /end MEASUREMENT
/begin MEASUREMENT DINH_stFId.FId_VehStcNVMFailr "Inhibit Status of FIds / Status of function identifier FId_VehStcNVMFailr" UWORD DFC_OneToOne 1 100 0.00 65535.00 FORMAT "%8.2" ECU_ADDRESS 0x60014648 /end MEASUREMENT
/begin MEASUREMENT DINH_stFId.FId_VehVCANFrzVal "Inhibit Status of FIds / Status of function identifier FId_VehVCANFrzVal" UWORD DFC_OneToOne 1 100 0.00 65535.00 FORMAT "%8.2" ECU_ADDRESS 0x6001464A /end MEASUREMENT
/begin MEASUREMENT DINH_stFId.FId_VehVCANReplVal "Inhibit Status of FIds / Status of function identifier FId_VehVCANReplVal" UWORD DFC_OneToOne 1 100 0.00 65535.00 FORMAT "%8.2" ECU_ADDRESS 0x6001464C /end MEASUREMENT
/begin MEASUREMENT DINH_stFId.FId_VehVCanSafeFrzVal "Inhibit Status of FIds / Status of function identifier FId_VehVCanSafeFrzVal" UWORD DFC_OneToOne 1 100 0.00 65535.00 FORMAT "%8.2" ECU_ADDRESS 0x6001464E /end MEASUREMENT
/begin MEASUREMENT DINH_stFId.FId_VehVCanSafeReplVal "Inhibit Status of FIds / Status of function identifier FId_VehVCanSafeReplVal" UWORD DFC_OneToOne 1 100 0.00 65535.00 FORMAT "%8.2" ECU_ADDRESS 0x60014650 /end MEASUREMENT
/begin MEASUREMENT DINH_stFId.FId_VehVCom "Inhibit Status of FIds / Status of function identifier FId_VehVCom" UWORD DFC_OneToOne 1 100 0.00 65535.00 FORMAT "%8.2" ECU_ADDRESS 0x60014652 /end MEASUREMENT
/begin MEASUREMENT DINH_stFId.FId_VehVExcdLim "Inhibit Status of FIds / Status of function identifier FId_VehVExcdLim" UWORD DFC_OneToOne 1 100 0.00 65535.00 FORMAT "%8.2" ECU_ADDRESS 0x60014654 /end MEASUREMENT
/begin MEASUREMENT DINH_stFId.FId_VehVFrzVal "Inhibit Status of FIds / Status of function identifier FId_VehVFrzVal" UWORD DFC_OneToOne 1 100 0.00 65535.00 FORMAT "%8.2" ECU_ADDRESS 0x60014656 /end MEASUREMENT
/begin MEASUREMENT DINH_stFId.FId_VehVNCSnsrElecFailr "Inhibit Status of FIds / Status of function identifier FId_VehVNCSnsrElecFailr" UWORD DFC_OneToOne 1 100 0.00 65535.00 FORMAT "%8.2" ECU_ADDRESS 0x60014658 /end MEASUREMENT
/begin MEASUREMENT DINH_stFId.FId_VehVOBDFrzVal "Inhibit Status of FIds / Status of function identifier FId_VehVOBDFrzVal" UWORD DFC_OneToOne 1 100 0.00 65535.00 FORMAT "%8.2" ECU_ADDRESS 0x6001465A /end MEASUREMENT
/begin MEASUREMENT DINH_stFId.FId_VehVOBDReplVal "Inhibit Status of FIds / Status of function identifier FId_VehVOBDReplVal" UWORD DFC_OneToOne 1 100 0.00 65535.00 FORMAT "%8.2" ECU_ADDRESS 0x6001465C /end MEASUREMENT
/begin MEASUREMENT DINH_stFId.FId_VehVOutCanErr "Inhibit Status of FIds / Status of function identifier FId_VehVOutCanErr" UWORD DFC_OneToOne 1 100 0.00 65535.00 FORMAT "%8.2" ECU_ADDRESS 0x6001465E /end MEASUREMENT
/begin MEASUREMENT DINH_stFId.FId_VehVPWMFrzVal "Inhibit Status of FIds / Status of function identifier FId_VehVPWMFrzVal" UWORD DFC_OneToOne 1 100 0.00 65535.00 FORMAT "%8.2" ECU_ADDRESS 0x60014660 /end MEASUREMENT
/begin MEASUREMENT DINH_stFId.FId_VehVPWMReplVal "Inhibit Status of FIds / Status of function identifier FId_VehVPWMReplVal" UWORD DFC_OneToOne 1 100 0.00 65535.00 FORMAT "%8.2" ECU_ADDRESS 0x60014662 /end MEASUREMENT
/begin MEASUREMENT DINH_stFId.FId_VehVPhysRng "Inhibit Status of FIds / Status of function identifier FId_VehVPhysRng" UWORD DFC_OneToOne 1 100 0.00 65535.00 FORMAT "%8.2" ECU_ADDRESS 0x60014664 /end MEASUREMENT
/begin MEASUREMENT DINH_stFId.FId_VehVPlaus "Inhibit Status of FIds / Status of function identifier FId_VehVPlaus" UWORD DFC_OneToOne 1 100 0.00 65535.00 FORMAT "%8.2" ECU_ADDRESS 0x60014666 /end MEASUREMENT
/begin MEASUREMENT DINH_stFId.FId_VehVPlausCan "Inhibit Status of FIds / Status of function identifier FId_VehVPlausCan" UWORD DFC_OneToOne 1 100 0.00 65535.00 FORMAT "%8.2" ECU_ADDRESS 0x60014668 /end MEASUREMENT
/begin MEASUREMENT DINH_stFId.FId_VehVPlausFco "Inhibit Status of FIds / Status of function identifier FId_VehVPlausFco" UWORD DFC_OneToOne 1 100 0.00 65535.00 FORMAT "%8.2" ECU_ADDRESS 0x6001466A /end MEASUREMENT
/begin MEASUREMENT DINH_stFId.FId_VehVPlausPwr "Inhibit Status of FIds / Status of function identifier FId_VehVPlausPwr" UWORD DFC_OneToOne 1 100 0.00 65535.00 FORMAT "%8.2" ECU_ADDRESS 0x6001466C /end MEASUREMENT
/begin MEASUREMENT DINH_stFId.FId_VehVPlausV2N "Inhibit Status of FIds / Status of function identifier FId_VehVPlausV2N" UWORD DFC_OneToOne 1 100 0.00 65535.00 FORMAT "%8.2" ECU_ADDRESS 0x6001466E /end MEASUREMENT
/begin MEASUREMENT DINH_stFId.FId_VehVReplVal "Inhibit Status of FIds / Status of function identifier FId_VehVReplVal" UWORD DFC_OneToOne 1 100 0.00 65535.00 FORMAT "%8.2" ECU_ADDRESS 0x60014670 /end MEASUREMENT
/begin MEASUREMENT DINH_stFId.FId_VehVSigCan "Inhibit Status of FIds / Status of function identifier FId_VehVSigCan" UWORD DFC_OneToOne 1 100 0.00 65535.00 FORMAT "%8.2" ECU_ADDRESS 0x60014672 /end MEASUREMENT
/begin MEASUREMENT DINH_stFId.FId_VehVSigCanSafe "Inhibit Status of FIds / Status of function identifier FId_VehVSigCanSafe" UWORD DFC_OneToOne 1 100 0.00 65535.00 FORMAT "%8.2" ECU_ADDRESS 0x60014674 /end MEASUREMENT
/begin MEASUREMENT DINH_stFId.FId_VehVSngWhlCanFrzVal "Inhibit Status of FIds / Status of function identifier FId_VehVSngWhlCanFrzVal" UWORD DFC_OneToOne 1 100 0.00 65535.00 FORMAT "%8.2" ECU_ADDRESS 0x60014676 /end MEASUREMENT
/begin MEASUREMENT DINH_stFId.FId_VehVSngWhlCanReplVal "Inhibit Status of FIds / Status of function identifier FId_VehVSngWhlCanReplVal" UWORD DFC_OneToOne 1 100 0.00 65535.00 FORMAT "%8.2" ECU_ADDRESS 0x60014678 /end MEASUREMENT
/begin MEASUREMENT DINH_stFId.FId_VehVSnsrARngHi "Inhibit Status of FIds / Status of function identifier FId_VehVSnsrARngHi" UWORD DFC_OneToOne 1 100 0.00 65535.00 FORMAT "%8.2" ECU_ADDRESS 0x6001467A /end MEASUREMENT
/begin MEASUREMENT DINH_stFId.FId_VehVSnsrBRngHi "Inhibit Status of FIds / Status of function identifier FId_VehVSnsrBRngHi" UWORD DFC_OneToOne 1 100 0.00 65535.00 FORMAT "%8.2" ECU_ADDRESS 0x6001467C /end MEASUREMENT
/begin MEASUREMENT DINH_stFId.FId_VehVSpdRtyDiag "Inhibit Status of FIds / Status of function identifier FId_VehVSpdRtyDiag" UWORD DFC_OneToOne 1 100 0.00 65535.00 FORMAT "%8.2" ECU_ADDRESS 0x6001467E /end MEASUREMENT
/begin MEASUREMENT DINH_stFId.FId_VehVSpdSnsrAElecFailr "Inhibit Status of FIds / Status of function identifier FId_VehVSpdSnsrAElecFailr" UWORD DFC_OneToOne 1 100 0.00 65535.00 FORMAT "%8.2" ECU_ADDRESS 0x60014680 /end MEASUREMENT
/begin MEASUREMENT DINH_stFId.FId_VehVSpdSnsrBElecFailr "Inhibit Status of FIds / Status of function identifier FId_VehVSpdSnsrBElecFailr" UWORD DFC_OneToOne 1 100 0.00 65535.00 FORMAT "%8.2" ECU_ADDRESS 0x60014682 /end MEASUREMENT
/begin MEASUREMENT DINH_stFId.FId_VehVvFLWhlSpd "Inhibit Status of FIds / Status of function identifier FId_VehVvFLWhlSpd" UWORD DFC_OneToOne 1 100 0.00 65535.00 FORMAT "%8.2" ECU_ADDRESS 0x60014684 /end MEASUREMENT
/begin MEASUREMENT DINH_stFId.FId_VehVvFRWhlSpd "Inhibit Status of FIds / Status of function identifier FId_VehVvFRWhlSpd" UWORD DFC_OneToOne 1 100 0.00 65535.00 FORMAT "%8.2" ECU_ADDRESS 0x60014686 /end MEASUREMENT
/begin MEASUREMENT DINH_stFId.FId_VehVvRLWhlSpd "Inhibit Status of FIds / Status of function identifier FId_VehVvRLWhlSpd" UWORD DFC_OneToOne 1 100 0.00 65535.00 FORMAT "%8.2" ECU_ADDRESS 0x60014688 /end MEASUREMENT
/begin MEASUREMENT DINH_stFId.FId_VehVvRRWhlSpd "Inhibit Status of FIds / Status of function identifier FId_VehVvRRWhlSpd" UWORD DFC_OneToOne 1 100 0.00 65535.00 FORMAT "%8.2" ECU_ADDRESS 0x6001468A /end MEASUREMENT
/begin MEASUREMENT DINH_stFId.FId_VldtLamDynS1B1 "Inhibit Status of FIds / Status of function identifier FId_VldtLamDynS1B1" UWORD DFC_OneToOne 1 100 0.00 65535.00 FORMAT "%8.2" ECU_ADDRESS 0x6001468C /end MEASUREMENT
/begin MEASUREMENT DINH_stFId.FId_VlvLftFbIntkOilPSnsr11SRC "Inhibit Status of FIds / Status of function identifier FId_VlvLftFbIntkOilPSnsr11SRC" UWORD DFC_OneToOne 1 100 0.00 65535.00 FORMAT "%8.2" ECU_ADDRESS 0x6001468E /end MEASUREMENT
/begin MEASUREMENT DINH_stFId.FId_VlvLftFbSwtIntk11Diag "Inhibit Status of FIds / Status of function identifier FId_VlvLftFbSwtIntk11Diag" UWORD DFC_OneToOne 1 100 0.00 65535.00 FORMAT "%8.2" ECU_ADDRESS 0x60014690 /end MEASUREMENT
/begin MEASUREMENT DINH_stFId.FId_ZGLZSR "Inhibit Status of FIds / Status of function identifier FId_ZGLZSR" UWORD DFC_OneToOne 1 100 0.00 65535.00 FORMAT "%8.2" ECU_ADDRESS 0x60014692 /end MEASUREMENT
/begin MEASUREMENT DINH_stFId.FId_airIntkFltSnsrKnkPrtnIgn "Inhibit Status of FIds / Status of function identifier FId_airIntkFltSnsrKnkPrtnIgn" UWORD DFC_OneToOne 1 100 0.00 65535.00 FORMAT "%8.2" ECU_ADDRESS 0x60014694 /end MEASUREMENT
/begin MEASUREMENT DINH_stFId.FId_ctrladpncvo "Inhibit Status of FIds / Status of function identifier FId_ctrladpncvo" UWORD DFC_OneToOne 1 100 0.00 65535.00 FORMAT "%8.2" ECU_ADDRESS 0x60014696 /end MEASUREMENT
/begin MEASUREMENT DINH_stFId.FId_stChkChgnSys "Inhibit Status of FIds / Status of function identifier FId_stChkChgnSys" UWORD DFC_OneToOne 1 100 0.00 65535.00 FORMAT "%8.2" ECU_ADDRESS 0x60014698 /end MEASUREMENT
/begin MEASUREMENT DINH_stFId.FId_stChkChgnSys2DC "Inhibit Status of FIds / Status of function identifier FId_stChkChgnSys2DC" UWORD DFC_OneToOne 1 100 0.00 65535.00 FORMAT "%8.2" ECU_ADDRESS 0x6001469A /end MEASUREMENT
/begin MEASUREMENT DINH_stFId.FId_tFltSnsrKnkPrtnIgn "Inhibit Status of FIds / Status of function identifier FId_tFltSnsrKnkPrtnIgn" UWORD DFC_OneToOne 1 100 0.00 65535.00 FORMAT "%8.2" ECU_ADDRESS 0x6001469C /end MEASUREMENT
/begin MEASUREMENT DINH_stMod7VisyCmpl "status of the first completed calculation of mode7 visibility" UBYTE OneToOne 1 100 0.00 255.0 BIT_MASK 0x1 FORMAT "%5.1" ECU_ADDRESS 0x60011222 /end MEASUREMENT
/begin MEASUREMENT DINH_xFIDObsvInh_mp "DFCs and DSQs which inhibit the FId currently" UWORD DFCDSQ_Verb 1 100 0.00 65535.0000000 FORMAT "%13.7" ARRAY_SIZE 5 ECU_ADDRESS 0x70009D6C /end MEASUREMENT
/begin MEASUREMENT DINH_xFIDObsvRls_mp "DFCs and DSQs which don't inhibit the FId currently" UWORD DFCDSQ_Verb 1 100 0.00 65535.0000000 FORMAT "%13.7" ARRAY_SIZE 5 ECU_ADDRESS 0x70009D62 /end MEASUREMENT
/begin FUNCTION DINH "30000.27.0_1.0.0Diagnostic Inhibit Handler"
 /begin DEF_CHARACTERISTIC DINH_FId.DFC_AAVEmax_CA DINH_FId.DFC_AAVEmin_CA DINH_FId.DFC_AAVEsig_CA DINH_FId.DFC_AltIOACGFailr_CA DINH_FId.DFC_AltIOACGHiVltg_CA DINH_FId.DFC_AltIOACGLoVltg_CA DINH_FId.DFC_AltIOACGTHi_CA DINH_FId.DFC_AltIODConnACG_CA DINH_FId.DFC_BGOELWAF_CA DINH_FId.DFC_BattUHiFailr_CA DINH_FId.DFC_BattULoFailr_CA DINH_FId.DFC_BrkBstPDriftHiErr_CA DINH_FId.DFC_BrkBstPDriftLoErr_CA DINH_FId.DFC_BrkBstPSnsrStuck_CA DINH_FId.DFC_BrkMnSwtContOn_CA DINH_FId.DFC_BrkMnSwtNotStp_CA DINH_FId.DFC_BrkNpl_CA DINH_FId.DFC_BrkRdntSwtContOn_CA DINH_FId.DFC_BrkRdntSwtNotStp_CA DINH_FId.DFC_Clth3ONStuck_CA DINH_FId.DFC_Clth4OFFStuck_CA DINH_FId.DFC_ClthOFFStuck_CA DINH_FId.DFC_ClthONStuck_CA DINH_FId.DFC_ClthStkFailInfo_CA DINH_FId.DFC_ComACFailInfo_CA DINH_FId.DFC_ComATFTValErr_CA DINH_FId.DFC_ComATMILReq_CA DINH_FId.DFC_ComAYCAChksum_CA DINH_FId.DFC_ComAYCARingCnt_CA DINH_FId.DFC_ComAYCATOut_CA DINH_FId.DFC_ComAYCDChkSum_CA DINH_FId.DFC_ComAYCDTOut_CA DINH_FId.DFC_ComAYCFChksum_CA DINH_FId.DFC_ComAYCFRingCnt_CA DINH_FId.DFC_ComAYCFTOut_CA DINH_FId.DFC_ComAYCGChksum_CA DINH_FId.DFC_ComAYCGRingCnt_CA DINH_FId.DFC_ComAYCGTOut_CA DINH_FId.DFC_ComAYCIChkSum_CA DINH_FId.DFC_ComAYCIRingCnt_CA DINH_FId.DFC_ComAYCITOut_CA DINH_FId.DFC_ComBCM1ChkSum_CA DINH_FId.DFC_ComBCM1RingCnt_CA DINH_FId.DFC_ComBCM1TOut_CA DINH_FId.DFC_ComCANABusOffErr_CA DINH_FId.DFC_ComCANBBusOffErr_CA DINH_FId.DFC_ComCANCBusOffErr_CA DINH_FId.DFC_ComCGW1ChkSum_CA DINH_FId.DFC_ComCGW1RingCnt_CA DINH_FId.DFC_ComCGW1TOut_CA DINH_FId.DFC_ComConvBoostErr_CA DINH_FId.DFC_ComConvSlipErr_CA DINH_FId.DFC_ComDCDCPrfmncErr_CA DINH_FId.DFC_ComDCDCTempWarn_CA DINH_FId.DFC_ComEAT10Chksum_CA DINH_FId.DFC_ComEAT10RingCnt_CA DINH_FId.DFC_ComEAT10TOut_CA DINH_FId.DFC_ComEAT11ChkSum_CA DINH_FId.DFC_ComEAT11RingCnt_CA DINH_FId.DFC_ComEAT11TOut_CA DINH_FId.DFC_ComEAT12ChkSum_CA DINH_FId.DFC_ComEAT12RingCnt_CA DINH_FId.DFC_ComEAT12TOut_CA DINH_FId.DFC_ComEAT13ChkSum_CA DINH_FId.DFC_ComEAT13RingCnt_CA DINH_FId.DFC_ComEAT13TOut_CA DINH_FId.DFC_ComEAT1Chksum_CA DINH_FId.DFC_ComEAT1RingCnt_CA DINH_FId.DFC_ComEAT1TOut_CA DINH_FId.DFC_ComEAT2ChkSum_CA DINH_FId.DFC_ComEAT2RingCnt_CA DINH_FId.DFC_ComEAT2TOut_CA DINH_FId.DFC_ComEAT4ChkSum_CA DINH_FId.DFC_ComEAT4RingCnt_CA DINH_FId.DFC_ComEAT4TOut_CA DINH_FId.DFC_ComEAT6Chksum_CA DINH_FId.DFC_ComEAT6RingCnt_CA DINH_FId.DFC_ComEAT6TOut_CA DINH_FId.DFC_ComEAT7Chksum_CA DINH_FId.DFC_ComEAT7RingCnt_CA DINH_FId.DFC_ComEAT7TOut_CA DINH_FId.DFC_ComEAT8Chksum_CA DINH_FId.DFC_ComEAT8RingCnt_CA DINH_FId.DFC_ComEAT8TOut_CA DINH_FId.DFC_ComEATAChksum_CA DINH_FId.DFC_ComEATARingCnt_CA DINH_FId.DFC_ComEATATOut_CA DINH_FId.DFC_ComEATBChkSum_CA DINH_FId.DFC_ComEATBRingCnt_CA DINH_FId.DFC_ComEATBTOut_CA DINH_FId.DFC_ComEATCChksum_CA DINH_FId.DFC_ComEATCRingCnt_CA DINH_FId.DFC_ComEATCTOut_CA DINH_FId.DFC_ComEPBBChkSum_CA DINH_FId.DFC_ComEPBBRingCnt_CA DINH_FId.DFC_ComEPBBTOut_CA DINH_FId.DFC_ComEPBChksum_CA DINH_FId.DFC_ComEPBTOut_CA DINH_FId.DFC_ComEPBctRing_CA DINH_FId.DFC_ComEPS1Chksum_CA DINH_FId.DFC_ComEPS1RingCnt_CA DINH_FId.DFC_ComEPS1TOut_CA DINH_FId.DFC_ComEngCanRxErr_CA DINH_FId.DFC_ComGrvySnsrErr_CA DINH_FId.DFC_ComGwIMG1ChkSum_CA DINH_FId.DFC_ComGwIMG1RingCnt_CA DINH_FId.DFC_ComGwIMG1TOut_CA DINH_FId.DFC_ComGwIMG3ChkSum_CA DINH_FId.DFC_ComGwIMG3RingCnt_CA DINH_FId.DFC_ComGwIMG3TOut_CA DINH_FId.DFC_ComGwIMG4ChkSum_CA DINH_FId.DFC_ComGwIMG4RingCnt_CA DINH_FId.DFC_ComGwIMG4TOut_CA DINH_FId.DFC_ComGwIMG5ChkSum_CA DINH_FId.DFC_ComGwIMG5RingCnt_CA DINH_FId.DFC_ComGwIMG5TOut_CA DINH_FId.DFC_ComGwIMG6ChkSum_CA DINH_FId.DFC_ComGwIMG6RingCnt_CA DINH_FId.DFC_ComGwIMG6TOut_CA DINH_FId.DFC_ComIDASBChksum_CA DINH_FId.DFC_ComIDASBRingCnt_CA DINH_FId.DFC_ComIDASBTOut_CA DINH_FId.DFC_ComIMGMILReq_CA DINH_FId.DFC_ComISSPrms_CA DINH_FId.DFC_ComMETAChksum_CA DINH_FId.DFC_ComMETAChksumPstDrv_CA DINH_FId.DFC_ComMETARingCnt_CA DINH_FId.DFC_ComMETARingCntPstDrv_CA DINH_FId.DFC_ComMETATOut_CA DINH_FId.DFC_ComMETATOutPstDrv_CA DINH_FId.DFC_ComMETCChksum_CA DINH_FId.DFC_ComMETCRingCnt_CA DINH_FId.DFC_ComMETCTOut_CA DINH_FId.DFC_ComMETDChksum_CA DINH_FId.DFC_ComMETDRingCnt_CA DINH_FId.DFC_ComMETDTOut_CA DINH_FId.DFC_ComMETE2Chksum_CA DINH_FId.DFC_ComMETE2RingCnt_CA DINH_FId.DFC_ComMETE2TOut_CA DINH_FId.DFC_ComMETFChksum_CA DINH_FId.DFC_ComMETFRingCnt_CA DINH_FId.DFC_ComMETFTOut_CA DINH_FId.DFC_ComMETGChksum_CA DINH_FId.DFC_ComMETGRingCnt_CA DINH_FId.DFC_ComMETGTOut_CA DINH_FId.DFC_ComMETH2Chksum_CA DINH_FId.DFC_ComMETH2RingCnt_CA DINH_FId.DFC_ComMETH2TOut_CA DINH_FId.DFC_ComMETHChksum_CA DINH_FId.DFC_ComMETHRingCnt_CA DINH_FId.DFC_ComMETHTOut_CA DINH_FId.DFC_ComMETIChksum_CA DINH_FId.DFC_ComMETIRingCnt_CA DINH_FId.DFC_ComMETITOut_CA DINH_FId.DFC_ComMETKChksum_CA DINH_FId.DFC_ComMETKRingCnt_CA DINH_FId.DFC_ComMETKTOut_CA DINH_FId.DFC_ComMETLChksum_CA DINH_FId.DFC_ComMETLRingCnt_CA DINH_FId.DFC_ComMETLTOut_CA DINH_FId.DFC_ComMETMChksum_CA DINH_FId.DFC_ComMETMRingCnt_CA DINH_FId.DFC_ComMETMTOut_CA DINH_FId.DFC_ComMETNChksum_CA DINH_FId.DFC_ComMETNRingCnt_CA DINH_FId.DFC_ComMETNTOut_CA DINH_FId.DFC_ComMtrCom_CA DINH_FId.DFC_ComPCUChkSum_CA DINH_FId.DFC_ComPCURingCnt_CA DINH_FId.DFC_ComPCUTOut_CA /end DEF_CHARACTERISTIC
 /begin LOC_MEASUREMENT DINH_stFId.FId_ElecLdRplVal DINH_stFId.FId_ElecLoadEPSComErr DINH_stFId.FId_EngBlkTWrn DINH_stFId.FId_EngCooltTFail DINH_stFId.FId_EngDemTqLimnCamsftErr DINH_stFId.FId_EngDemTqLimnErrThmstHeatCtrlCirc DINH_stFId.FId_EngDemTqLimnOilPmp DINH_stFId.FId_EngDemTrqLimErrAPP DINH_stFId.FId_EngIntkAirFail DINH_stFId.FId_EngPrtErrVehV DINH_stFId.FId_EngSpd30DegFail DINH_stFId.FId_EngStrtEnaEthAdap DINH_stFId.FId_EngStrt_EnaCep DINH_stFId.FId_EngStrt_InjProhb DINH_stFId.FId_EngStrt_VehVInhb DINH_stFId.FId_EngTqRvsnEnaFlg DINH_stFId.FId_EnvTPrimMod DINH_stFId.FId_EnvTPrimModIniVal DINH_stFId.FId_EnvTSensSum DINH_stFId.FId_EnvTtAirFltDs DINH_stFId.FId_EnvTtCEngDsT DINH_stFId.FId_EnvTtIntkMnfld DINH_stFId.FId_EomCvoAllwd DINH_stFId.FId_EpmBCr DINH_stFId.FId_EpmCaSAdapCaSI1 DINH_stFId.FId_EpmCaSAdapRstI1 DINH_stFId.FId_EpmCaSDiagI1 DINH_stFId.FId_EpmCaSErrCaSI1 DINH_stFId.FId_EpmCaSOfsDiagCaSI1 DINH_stFId.FId_EpmCaSOfsErrCaSI1 DINH_stFId.FId_EpmCaSSegI1 DINH_stFId.FId_EpmCaSSpdPlausI1 DINH_stFId.FId_EpmCrSDiag DINH_stFId.FId_EpmCrSDiagVeh DINH_stFId.FId_EpmCrSErr DINH_stFId.FId_EpmOpMode_ALELock DINH_stFId.FId_EpmOpMode_DirStLock DINH_stFId.FId_EpmRRSCrSFaultCheck DINH_stFId.FId_EpmRRSDGIFaultCheck DINH_stFId.FId_EpmRRSRdCheck DINH_stFId.FId_EpmRRSVehVFaultChck DINH_stFId.FId_EpmSynLockCaSSync DINH_stFId.FId_EpmTmpSuppRvsRotCASI1 DINH_stFId.FId_EtaEngIdleNonCsers DINH_stFId.FId_EtaEngPtlNonCsers DINH_stFId.FId_EthnlSnsrErrCdn DINH_stFId.FId_EvapActrCcvElecDiag DINH_stFId.FId_EvapPSnsrTankPhyRngChk DINH_stFId.FId_FanCtlACClntP DINH_stFId.FId_FanCtlACGModFail DINH_stFId.FId_FanCtlAPP1 DINH_stFId.FId_FanCtlAPP2 DINH_stFId.FId_FanCtlAPPSync DINH_stFId.FId_FanCtlBlowrU DINH_stFId.FId_FanCtlCooltT DINH_stFId.FId_FanCtlCooltT2 DINH_stFId.FId_FanCtlEnvT DINH_stFId.FId_FanCtlLiSwtInfo DINH_stFId.FId_FanCtlSpd DINH_stFId.FId_FanCtlTSnsrErr DINH_stFId.FId_FanCtlThr1 DINH_stFId.FId_FanCtlThr2 DINH_stFId.FId_FcoReq DINH_stFId.FId_FiMFID_rba_MRly_Diag_Stk DINH_stFId.FId_FlComErr DINH_stFId.FId_FlDevPlauDiagFuSnsr DINH_stFId.FId_FlLvlNoSigErr DINH_stFId.FId_FlLvlVehSpdSigErr DINH_stFId.FId_FlLvlVehVErr DINH_stFId.FId_FlMALamDynDiag DINH_stFId.FId_FlSplGAltLin DINH_stFId.FId_FlTnkQnt DINH_stFId.FId_FuMixHotFilmErr DINH_stFId.FId_FuMixUegoErrExcl DINH_stFId.FId_FuPHiRailEthnlSnsrErr DINH_stFId.FId_FuPurg_TEVError DINH_stFId.FId_FuSnsrPhyRngErr DINH_stFId.FId_GEVCtlAVCAdprCBBNWEErrIntk DINH_stFId.FId_GEVCtlAVCAdprIntkB1 DINH_stFId.FId_GEVCtlAVCAdprNWSEErrIntk DINH_stFId.FId_GEVCtlAdpnEnaIntk DINH_stFId.FId_GEVCtlAdpnEnaShtrpActv DINH_stFId.FId_GEVCtlClngIntk DINH_stFId.FId_GEVCtlMinOvlIntk DINH_stFId.FId_GEVCtlPOilSnsr DINH_stFId.FId_GEVCtlPhaEnaIntk DINH_stFId.FId_GEVCtlPhaSpTstrIntk DINH_stFId.FId_GEVCtlRefAdpnMntChck DINH_stFId.FId_GEVCtlRefAdpnMntChckTstd DINH_stFId.FId_GEVCtlReqRefAdpnTstrIntk DINH_stFId.FId_GEVCtlReqRefAdpnTstrIntkTstd DINH_stFId.FId_GEVCtlVlvLftEnaIntk DINH_stFId.FId_GEVCtlVlvOpenClsdIntkB1 DINH_stFId.FId_GEVlvLockPinDiagIntkB1 DINH_stFId.FId_GEVlvPhaDiagEnaCsersIntkB1 DINH_stFId.FId_GEVlvPhaDiagEnaIntkB1 DINH_stFId.FId_GEVlvPhaPsIntkB1 DINH_stFId.FId_GbxAnNeutPosnErr DINH_stFId.FId_GbxCANDigPlausErr DINH_stFId.FId_GbxCANNeutSigErr DINH_stFId.FId_GbxPNPosSig DINH_stFId.FId_GbxPNPosnComErr DINH_stFId.FId_GbxPNPosnDiagDrvCdnRels DINH_stFId.FId_GbxPNPosnDiagDrvCodnHealRels DINH_stFId.FId_GbxPNPosnDiagPlausyRels DINH_stFId.FId_GbxPNPosnSubsVal DINH_stFId.FId_GbxRvsSwtStk DINH_stFId.FId_GbxSnsrSplyUErr DINH_stFId.FId_GbxSpstReqOk DINH_stFId.FId_GlbDaLSumvXPtd DINH_stFId.FId_GslThrVlvSnsrDiagB1 DINH_stFId.FId_HEGOS2B1DElec DINH_stFId.FId_HEGOS2B1DHtg DINH_stFId.FId_HEGOS2B1Htg DINH_stFId.FId_HEGOS2B1HtrPsSt DINH_stFId.FId_HEGOS2B1InVld DINH_stFId.FId_HEGOS2B1LSPsDiaDi DINH_stFId.FId_HLSDemBrkFlt DINH_stFId.FId_HLSDemErr1 DINH_stFId.FId_HLSDemErr2 DINH_stFId.FId_HLSDemIntkAirTemp DINH_stFId.FId_HLSDemMotTemp DINH_stFId.FId_HLSDemMstCyldpVld DINH_stFId.FId_HLSDemSpdClthGearAccrSigErr DINH_stFId.FId_HLSDem_DrvOffSuprt DINH_stFId.FId_HLSDem_DrvOffSuprtBrkHldSys DINH_stFId.FId_HLSDem_DrvOffSuprtLAS DINH_stFId.FId_HLSDem_PModeActv DINH_stFId.FId_HLSDem_TModeActv DINH_stFId.FId_HLSDem_TraSubFcn DINH_stFId.FId_HLSDem_nMaxLimErr1 DINH_stFId.FId_HLSDem_nMaxLimErr2 DINH_stFId.FId_HLSDem_nMaxLimErr3 DINH_stFId.FId_HLSDem_nMaxVErr DINH_stFId.FId_I14229APP DINH_stFId.FId_I14229CANErr DINH_stFId.FId_I14229FlLvlFltComErr DINH_stFId.FId_I14229VTCErr DINH_stFId.FId_IMGISABComErr DINH_stFId.FId_InhbLamDynS1B1 DINH_stFId.FId_InhbnBlkdLineDiag DINH_stFId.FId_InhibitAlways DINH_stFId.FId_InhibitNever DINH_stFId.FId_InjSysMulInjDiagErr DINH_stFId.FId_InjVlvPs_Bank1OnlyErr DINH_stFId.FId_InjVlvPs_Bank1Tested DINH_stFId.FId_InjVlvPs_Bank2OnlyErr DINH_stFId.FId_InjVlvPs_Bank2Tested DINH_stFId.FId_InjVlvPs_Bank3OnlyErr DINH_stFId.FId_InjVlvPs_Bank3Tested DINH_stFId.FId_IntkAirTAirFltDsCrssChk DINH_stFId.FId_IntkAirTAirFltDsPlausChk DINH_stFId.FId_IntkAirTIntkMnfldCrssChk DINH_stFId.FId_IntkAirTIntkMnfldPlausChk DINH_stFId.FId_IntkAirTIntkMnfldRepl DINH_stFId.FId_IntkAirTSnsr1Elec DINH_stFId.FId_IntkAirTSnsr1PRC DINH_stFId.FId_IntkAirTSnsr1Sum DINH_stFId.FId_IntkAirTSnsr2Elec DINH_stFId.FId_IntkAirTSnsr2PRC DINH_stFId.FId_IntkAirTSnsr2Sum DINH_stFId.FId_IntkArTempENGB DINH_stFId.FId_LIGovDfrstI DINH_stFId.FId_LIGovUndrBrk DINH_stFId.FId_LINDCDCRxErr DINH_stFId.FId_LLimAppSnsrErr DINH_stFId.FId_LLimAppSnsrSyncErr DINH_stFId.FId_LLimMTVehSpdSnsrErr DINH_stFId.FId_LLimShutOffEng DINH_stFId.FId_LRSEBMisf DINH_stFId.FId_LZSR DINH_stFId.FId_LeakToMnfld DINH_stFId.FId_LeakToMnfldTstd DINH_stFId.FId_LimpHomPsErrInjtr DINH_stFId.FId_LinACGUnitCfmdErr DINH_stFId.FId_LinACGUnitNotTstd DINH_stFId.FId_LinAEVUnitCfmdErr DINH_stFId.FId_LinAEVUnitNotTstd DINH_stFId.FId_LinEBSUnitCfmdErr DINH_stFId.FId_LinEBSUnitNotTstd DINH_stFId.FId_LowPresOilP DINH_stFId.FId_MFlowAirCrkcsSubVal DINH_stFId.FId_MFuOilMax DINH_stFId.FId_MaiLoadSnsr DINH_stFId.FId_MaiShaftFailr DINH_stFId.FId_MfPsDia1 DINH_stFId.FId_MisfDetDnAdpn DINH_stFId.FId_MisfDetDnAdpnPlaus DINH_stFId.FId_MisfDetEnvP DINH_stFId.FId_MisfDetSegTiAdpnFco DINH_stFId.FId_MisfDetShtrpAct DINH_stFId.FId_MisfDetStc DINH_stFId.FId_MisfDetV DINH_stFId.FId_MisfDetVWhlFrntLe DINH_stFId.FId_MisfDetVWhlFrntRi DINH_stFId.FId_MisfDetVWhlReLe DINH_stFId.FId_MisfDetVWhlReRi DINH_stFId.FId_NLimVehHalt DINH_stFId.FId_NSHTDAmbT DINH_stFId.FId_NSHTDEngT DINH_stFId.FId_NSHTILimHiAltiLoIdleSp DINH_stFId.FId_NeutPosnFailr DINH_stFId.FId_O2StorgMdlMD DINH_stFId.FId_OilCmbdSen_LvlDfctHW DINH_stFId.FId_OilPCtrlVlvNpl DINH_stFId.FId_OilPFrzVal DINH_stFId.FId_OilPPlaus DINH_stFId.FId_OilPPlausAftRun DINH_stFId.FId_OilPPlausMax DINH_stFId.FId_OilPPlausMin DINH_stFId.FId_OilPPlausT15 DINH_stFId.FId_OilPRplVal DINH_stFId.FId_OilPSnsrErr DINH_stFId.FId_OilPSwmpSRC DINH_stFId.FId_OilSwmpTCEngDsTWrmUp DINH_stFId.FId_OilSwmpT_B_tospg DINH_stFId.FId_OilSwmpT_B_tospgg DINH_stFId.FId_OilSwmpT_CmbdSnsrErr DINH_stFId.FId_OilSwmpT_CmbdSnsrTiTErr DINH_stFId.FId_OilSwmpT_EnvT DINH_stFId.FId_OilSwmpT_TSnsrErr DINH_stFId.FId_PEnvMeasVld DINH_stFId.FId_PEnvModel DINH_stFId.FId_PEnvPlausDiagVDD DINH_stFId.FId_PEnvRawVldVDD DINH_stFId.FId_PEnvRefSnsr DINH_stFId.FId_PEnvSigRngVld DINH_stFId.FId_PEnvSnsrPlausVDD DINH_stFId.FId_PEnvVldVDD DINH_stFId.FId_PIDA6SigSrcErr DINH_stFId.FId_PIntkMnfldPlaus DINH_stFId.FId_PIntkVUsElecDiagB1 DINH_stFId.FId_PSPCtlDisbl DINH_stFId.FId_PSPCtlIntkAirVapLock DINH_stFId.FId_PSPCtlPreRun DINH_stFId.FId_PSPCtlVapLock DINH_stFId.FId_PSPDiagDisbl DINH_stFId.FId_PTGripConv DINH_stFId.FId_PTGripConvStrt DINH_stFId.FId_PTGripMnlClth DINH_stFId.FId_PTGripMnlClthStrt DINH_stFId.FId_PTTrqRatCANPtd DINH_stFId.FId_PThrVlVUsVldB1 DINH_stFId.FId_PThrVlvUsMeasdVldB1 DINH_stFId.FId_P_VSE11_Diag DINH_stFId.FId_PrmId03_FltRdnS1B1 DINH_stFId.FId_PrmId03_FltUegoS1B1 DINH_stFId.FId_RevLck DINH_stFId.FId_RstAdpnPIntkMnfldAfs DINH_stFId.FId_RvsPosnFailr DINH_stFId.FId_SSEEPBRelease DINH_stFId.FId_SSEFCANPRelease DINH_stFId.FId_SSEPTCANPRelease DINH_stFId.FId_SSEStartRelease DINH_stFId.FId_SSEStartReleaseMTCl10 DINH_stFId.FId_SSEStartReleaseMTCl100 DINH_stFId.FId_SSEStartReleaseMTCl20 DINH_stFId.FId_SSEStartReleaseMTCl90 DINH_stFId.FId_SSEStartRequest DINH_stFId.FId_SSEStopRelease DINH_stFId.FId_SSEStrtStopRelease DINH_stFId.FId_SSESysOff DINH_stFId.FId_SSEUI2DCSysFailr DINH_stFId.FId_SSEUIBCANErr DINH_stFId.FId_SSEUISysFail DINH_stFId.FId_SiaEEPErr DINH_stFId.FId_SnglWhlErrDiagEna DINH_stFId.FId_StrtCtlAutoCrkModeCdn DINH_stFId.FId_StrtCtlComEngStrtErr DINH_stFId.FId_StrtCtlNPCdnCncl DINH_stFId.FId_StrtCtlNoCpuFailr DINH_stFId.FId_StrtCtlNoFailCanLine DINH_stFId.FId_StrtCtlNoFailPTCanLine DINH_stFId.FId_StrtCtlPNPosnSubsVal DINH_stFId.FId_StrtCtlSTMFailr DINH_stFId.FId_StrtErrShaft DINH_stFId.FId_SumErrHndlg DINH_stFId.FId_SysDiagComErr DINH_stFId.FId_SysDiagModInhbErr DINH_stFId.FId_TOSPM DINH_stFId.FId_TWCCILck DINH_stFId.FId_TWCCILckExtd DINH_stFId.FId_TWCCIRstB1 DINH_stFId.FId_TWCCIRstDSMClearB1 DINH_stFId.FId_TWCCLsuB1 DINH_stFId.FId_TWCCLsuCyc DINH_stFId.FId_TWCCLsuDynB1 DINH_stFId.FId_TWCCMisfDetn DINH_stFId.FId_TWCDPriCatParB1 DINH_stFId.FId_TWCDPriCatVldnB1 DINH_stFId.FId_TankPCpv1DteskLoLoadStuckClsd DINH_stFId.FId_TankPCpv1DteskLoLoadStuckOpen DINH_stFId.FId_TankPSnsrElecChkVld DINH_stFId.FId_ThrVlvMon DINH_stFId.FId_ThrVlvOffsLrnPrmsB1 DINH_stFId.FId_TiOffTBasdChkFast DINH_stFId.FId_TiOffTBasdChkSlow DINH_stFId.FId_TiOffVdClk DINH_stFId.FId_TqDecelOffsInhb DINH_stFId.FId_TraAddAirCANPtd DINH_stFId.FId_TraAddClntCANPtd DINH_stFId.FId_TraFwdRvsCluInfo DINH_stFId.FId_TraGbxNPos DINH_stFId.FId_TraGearInfoCanCom DINH_stFId.FId_TraGearInfoDet DINH_stFId.FId_TraGearInfoGearShftActv DINH_stFId.FId_TraGearInfoInfoCan DINH_stFId.FId_TraGearInfoLevPos DINH_stFId.FId_TraGearInfoLoRng DINH_stFId.FId_TraGearInfoRTra DINH_stFId.FId_TraGearInfoRevGear DINH_stFId.FId_TraGearReq DINH_stFId.FId_TraNoShftIdctr DINH_stFId.FId_TraPrtGearCANPtd DINH_stFId.FId_TraPrtGearIndpdtProblem DINH_stFId.FId_TraRPosn DINH_stFId.FId_TraRtnIntfcASTIntv DINH_stFId.FId_TraRtnIntfcIdlSetP DINH_stFId.FId_TraRtnIntfcNMaxCan DINH_stFId.FId_TraRtnIntfcNMaxVel DINH_stFId.FId_TraTrqRedLmpHmeDec DINH_stFId.FId_TraTrqRedLmpHmeInc DINH_stFId.FId_TraTrqRedPTCanErr DINH_stFId.FId_TraTrqRedTIIntvDes DINH_stFId.FId_TraTrqRedTIIntvLead DINH_stFId.FId_TraTrqRedTSCIntvDes DINH_stFId.FId_TraTrqRedTSCIntvLead DINH_stFId.FId_TraTrsmTypHw DINH_stFId.FId_TranIdleDes DINH_stFId.FId_UEGOHeatgUpRglS1B1 DINH_stFId.FId_UEGOHeatrCtrlS1B1 DINH_stFId.FId_UEGOHeatrPrfmncDiagRelsS1B1 DINH_stFId.FId_UEGOHeatrPwrStgDiagRelsS1B1 DINH_stFId.FId_UEGOModCtrlRelsS1B1 DINH_stFId.FId_UEGOStrtDiagInhRprtErrS1B1 DINH_stFId.FId_UEGOStrtDiagRelsS1B1 DINH_stFId.FId_UEGOTCeramicRelsS1B1 DINH_stFId.FId_UegoDiagRelsBattSplyOk DINH_stFId.FId_UegoDiagSigEcuAsicS1B1 DINH_stFId.FId_UegoDiagSigEcuComS1B1 DINH_stFId.FId_UegoDiagSigOperPlausS1B1 DINH_stFId.FId_UegoDiagSigSnsrS1B1 DINH_stFId.FId_UegoDiagSigWireOlS1B1 DINH_stFId.FId_UegoDiagSigWireScS1B1 DINH_stFId.FId_UegoDiagSigWireScTstdS1B1 DINH_stFId.FId_UegoInhbOperRelsS1B1 DINH_stFId.FId_UegoO2HiPrcsnS1B1 DINH_stFId.FId_UegoO2PlausErrS1B1 DINH_stFId.FId_UegoO2VldS1B1 DINH_stFId.FId_UegoOperPlausBattSplyOk DINH_stFId.FId_UegoPlausErrHndlg DINH_stFId.FId_VMSIDCSRmpShOff DINH_stFId.FId_VMSIDCSShOff DINH_stFId.FId_VMSITCSRmpShOff DINH_stFId.FId_VMSITCSShOff DINH_stFId.FId_VSACANErr DINH_stFId.FId_VehStcACGFailr DINH_stFId.FId_VehStcBattMngFailr DINH_stFId.FId_VehStcDCDCFailr DINH_stFId.FId_VehStcEBSFailr DINH_stFId.FId_VehStcMisf DINH_stFId.FId_VehStcMtrComFailr DINH_stFId.FId_VehStcNVMFailr DINH_stFId.FId_VehVCANFrzVal DINH_stFId.FId_VehVCANReplVal DINH_stFId.FId_VehVCanSafeFrzVal DINH_stFId.FId_VehVCanSafeReplVal DINH_stFId.FId_VehVCom DINH_stFId.FId_VehVExcdLim DINH_stFId.FId_VehVFrzVal DINH_stFId.FId_VehVNCSnsrElecFailr DINH_stFId.FId_VehVOBDFrzVal DINH_stFId.FId_VehVOBDReplVal DINH_stFId.FId_VehVOutCanErr DINH_stFId.FId_VehVPWMFrzVal DINH_stFId.FId_VehVPWMReplVal DINH_stFId.FId_VehVPhysRng DINH_stFId.FId_VehVPlaus DINH_stFId.FId_VehVPlausCan DINH_stFId.FId_VehVPlausFco DINH_stFId.FId_VehVPlausPwr DINH_stFId.FId_VehVPlausV2N DINH_stFId.FId_VehVReplVal DINH_stFId.FId_VehVSigCan DINH_stFId.FId_VehVSigCanSafe DINH_stFId.FId_VehVSngWhlCanFrzVal DINH_stFId.FId_VehVSngWhlCanReplVal DINH_stFId.FId_VehVSnsrARngHi DINH_stFId.FId_VehVSnsrBRngHi DINH_stFId.FId_VehVSpdRtyDiag DINH_stFId.FId_VehVSpdSnsrAElecFailr DINH_stFId.FId_VehVSpdSnsrBElecFailr DINH_stFId.FId_VehVvFLWhlSpd DINH_stFId.FId_VehVvFRWhlSpd DINH_stFId.FId_VehVvRLWhlSpd DINH_stFId.FId_VehVvRRWhlSpd DINH_stFId.FId_VldtLamDynS1B1 DINH_stFId.FId_VlvLftFbIntkOilPSnsr11SRC DINH_stFId.FId_VlvLftFbSwtIntk11Diag DINH_stFId.FId_ZGLZSR DINH_stFId.FId_airIntkFltSnsrKnkPrtnIgn DINH_stFId.FId_ctrladpncvo DINH_stFId.FId_stChkChgnSys DINH_stFId.FId_stChkChgnSys2DC DINH_stFId.FId_tFltSnsrKnkPrtnIgn DINH_stMod7VisyCmpl DINH_xFIDObsvInh_mp DINH_xFIDObsvRls_mp /end LOC_MEASUREMENT
 FUNCTION_VERSION "30000.27.0_1.0.0" /end FUNCTION
/begin COMPU_METHOD DFCDSQ_Verb "" TAB_VERB "%6.3" "-" COMPU_TAB_REF DFCDSQ_Verb /end COMPU_METHOD
/begin COMPU_VTAB DFCDSQ_Verb "" TAB_VERB 947 0 "NoInhibit" 1 "DFC_AAVEmax" 2 "DFC_AAVEmin" 3 "DFC_AAVEsig" 4 "DFC_AltIOACGFailr" 5 "DFC_AltIOACGHiVltg" 6 "DFC_AltIOACGLoVltg" 7 "DFC_AltIOACGTHi" 8 "DFC_AltIODConnACG" 9 "DFC_BGOELWAF" 10 "DFC_BattUHiFailr" 11 "DFC_BattULoFailr" 12 "DFC_BrkBstPDriftHiErr" 13 "DFC_BrkBstPDriftLoErr" 14 "DFC_BrkBstPSnsrStuck" 15 "DFC_BrkMnSwtContOn" 16 "DFC_BrkMnSwtNotStp" 17 "DFC_BrkNpl" 18 "DFC_BrkRdntSwtContOn" 19 "DFC_BrkRdntSwtNotStp" 20 "DFC_Clth3ONStuck" 21 "DFC_Clth4OFFStuck" 22 "DFC_ClthOFFStuck" 23 "DFC_ClthONStuck" 24 "DFC_ClthStkFailInfo" 25 "DFC_ComACFailInfo" 26 "DFC_ComATFTValErr" 27 "DFC_ComATMILReq" 28 "DFC_ComAYCAChksum" 29 "DFC_ComAYCARingCnt" 30 "DFC_ComAYCATOut" 31 "DFC_ComAYCDChkSum" 32 "DFC_ComAYCDTOut" 33 "DFC_ComAYCFChksum" 34 "DFC_ComAYCFRingCnt" 35 "DFC_ComAYCFTOut" 36 "DFC_ComAYCGChksum" 37 "DFC_ComAYCGRingCnt" 38 "DFC_ComAYCGTOut" 39 "DFC_ComAYCIChkSum" 40 "DFC_ComAYCIRingCnt" 41 "DFC_ComAYCITOut" 42 "DFC_ComBCM1ChkSum" 43 "DFC_ComBCM1RingCnt" 44 "DFC_ComBCM1TOut" 45 "DFC_ComCANABusOffErr" 46 "DFC_ComCANBBusOffErr" 47 "DFC_ComCANCBusOffErr" 48 "DFC_ComCGW1ChkSum" 49 "DFC_ComCGW1RingCnt" 50 "DFC_ComCGW1TOut" 51 "DFC_ComConvBoostErr" 52 "DFC_ComConvSlipErr" 53 "DFC_ComDCDCPrfmncErr" 54 "DFC_ComDCDCTempWarn" 55 "DFC_ComEAT10Chksum" 56 "DFC_ComEAT10RingCnt" 57 "DFC_ComEAT10TOut" 58 "DFC_ComEAT11ChkSum" 59 "DFC_ComEAT11RingCnt" 60 "DFC_ComEAT11TOut" 61 "DFC_ComEAT12ChkSum" 62 "DFC_ComEAT12RingCnt" 63 "DFC_ComEAT12TOut" 64 "DFC_ComEAT13ChkSum" 65 "DFC_ComEAT13RingCnt" 66 "DFC_ComEAT13TOut" 67 "DFC_ComEAT1Chksum" 68 "DFC_ComEAT1RingCnt" 69 "DFC_ComEAT1TOut" 70 "DFC_ComEAT2ChkSum" 71 "DFC_ComEAT2RingCnt" 72 "DFC_ComEAT2TOut" 73 "DFC_ComEAT4ChkSum" 74 "DFC_ComEAT4RingCnt" 75 "DFC_ComEAT4TOut" 76 "DFC_ComEAT6Chksum" 77 "DFC_ComEAT6RingCnt" 78 "DFC_ComEAT6TOut" 79 "DFC_ComEAT7Chksum" 80 "DFC_ComEAT7RingCnt" 81 "DFC_ComEAT7TOut" 82 "DFC_ComEAT8Chksum" 83 "DFC_ComEAT8RingCnt" 84 "DFC_ComEAT8TOut" 85 "DFC_ComEATAChksum" 86 "DFC_ComEATARingCnt" 87 "DFC_ComEATATOut" 88 "DFC_ComEATBChkSum" 89 "DFC_ComEATBRingCnt" 90 "DFC_ComEATBTOut" 91 "DFC_ComEATCChksum" 92 "DFC_ComEATCRingCnt" 93 "DFC_ComEATCTOut" 94 "DFC_ComEPBBChkSum" 95 "DFC_ComEPBBRingCnt" 96 "DFC_ComEPBBTOut" 97 "DFC_ComEPBChksum" 98 "DFC_ComEPBTOut" 99 "DFC_ComEPBctRing" 100 "DFC_ComEPS1Chksum" 101 "DFC_ComEPS1RingCnt" 102 "DFC_ComEPS1TOut" 103 "DFC_ComEngCanRxErr" 104 "DFC_ComGrvySnsrErr" 105 "DFC_ComGwIMG1ChkSum" 106 "DFC_ComGwIMG1RingCnt" 107 "DFC_ComGwIMG1TOut" 108 "DFC_ComGwIMG3ChkSum" 109 "DFC_ComGwIMG3RingCnt" 110 "DFC_ComGwIMG3TOut" 111 "DFC_ComGwIMG4ChkSum" 112 "DFC_ComGwIMG4RingCnt" 113 "DFC_ComGwIMG4TOut" 114 "DFC_ComGwIMG5ChkSum" 115 "DFC_ComGwIMG5RingCnt" 116 "DFC_ComGwIMG5TOut" 117 "DFC_ComGwIMG6ChkSum" 118 "DFC_ComGwIMG6RingCnt" 119 "DFC_ComGwIMG6TOut" 120 "DFC_ComIDASBChksum" 121 "DFC_ComIDASBRingCnt" 122 "DFC_ComIDASBTOut" 123 "DFC_ComIMGMILReq" 124 "DFC_ComISSPrms" 125 "DFC_ComMETAChksum" 126 "DFC_ComMETAChksumPstDrv" 127 "DFC_ComMETARingCnt" 128 "DFC_ComMETARingCntPstDrv" 129 "DFC_ComMETATOut" 130 "DFC_ComMETATOutPstDrv" 131 "DFC_ComMETCChksum" 132 "DFC_ComMETCRingCnt" 133 "DFC_ComMETCTOut" 134 "DFC_ComMETDChksum" 135 "DFC_ComMETDRingCnt" 136 "DFC_ComMETDTOut" 137 "DFC_ComMETE2Chksum" 138 "DFC_ComMETE2RingCnt" 139 "DFC_ComMETE2TOut" 140 "DFC_ComMETFChksum" 141 "DFC_ComMETFRingCnt" 142 "DFC_ComMETFTOut" 143 "DFC_ComMETGChksum" 144 "DFC_ComMETGRingCnt" 145 "DFC_ComMETGTOut" 146 "DFC_ComMETH2Chksum" 147 "DFC_ComMETH2RingCnt" 148 "DFC_ComMETH2TOut" 149 "DFC_ComMETHChksum" 150 "DFC_ComMETHRingCnt" 151 "DFC_ComMETHTOut" 152 "DFC_ComMETIChksum" 153 "DFC_ComMETIRingCnt" 154 "DFC_ComMETITOut" 155 "DFC_ComMETKChksum" 156 "DFC_ComMETKRingCnt" 157 "DFC_ComMETKTOut" 158 "DFC_ComMETLChksum" 159 "DFC_ComMETLRingCnt" 160 "DFC_ComMETLTOut" 161 "DFC_ComMETMChksum" 162 "DFC_ComMETMRingCnt" 163 "DFC_ComMETMTOut" 164 "DFC_ComMETNChksum" 165 "DFC_ComMETNRingCnt" 166 "DFC_ComMETNTOut" 167 "DFC_ComMtrCom" 168 "DFC_ComPCUChkSum" 169 "DFC_ComPCURingCnt" 170 "DFC_ComPCUTOut" 171 "DFC_ComSRSAChksum" 172 "DFC_ComSRSARingCnt" 173 "DFC_ComSRSATOut" 174 "DFC_ComSRSBChksum" 175 "DFC_ComSRSBRingCnt" 176 "DFC_ComSRSBTOut" 177 "DFC_ComSRSChksum" 178 "DFC_ComSRSErr" 179 "DFC_ComSRSRingCnt" 180 "DFC_ComSRSTOut" 181 "DFC_ComVehSpdPndFltTCU" 182 "DFC_EbsChartcCurrErr" 183 "DFC_EbsSelfDiagErr" 184 "DFC_GEVlvPhaCsersIntkB1" 185 "DFC_GEVlvPhaPsOpenLoadIntkB1" 186 "DFC_GEVlvPhaPsShoToBattIntkB1" 187 "DFC_GEVlvPhaPsShoToGndIntkB1" 188 "DFC_GbxCANDigPlausErr" 189 "DFC_GbxNPos1SRCMax" 190 "DFC_GbxNPos1SRCMin" 191 "DFC_GbxNPos2SRCMax" 192 "DFC_GbxNPos2SRCMin" 193 "DFC_GbxNPosAlvChk" 194 "DFC_GbxNPosSyncErr" 195 "DFC_HEGOS2B1HtrPsMax" 196 "DFC_HEGOS2B1HtrPsMin" 197 "DFC_HEGOS2B1HtrPsSig" 198 "DFC_LinCSErrACG" 199 "DFC_LinCSErrAEV" 200 "DFC_LinCSErrDCDC" 201 "DFC_LinCSErrEBS" 202 "DFC_LinHdrTimeoutErrACG" 203 "DFC_LinHdrTimeoutErrAEV" 204 "DFC_LinHdrTimeoutErrDCDC" 205 "DFC_LinHdrTimeoutErrEBS" 206 "DFC_LinMsgTimeoutErrACG" 207 "DFC_LinMsgTimeoutErrAEV" 208 "DFC_LinMsgTimeoutErrDCDC" 209 "DFC_LinMsgTimeoutErrEBS" 210 "DFC_LinNoStrtComErr" 211 "DFC_LowPresOilP" 212 "DFC_MisfDetVWhlFrntLeOORHi" 213 "DFC_MisfDetVWhlFrntLeRatyHi" 214 "DFC_MisfDetVWhlFrntLeRatyLo" 215 "DFC_MisfDetVWhlFrntLeStuck" 216 "DFC_MisfDetVWhlFrntRiOORHi" 217 "DFC_MisfDetVWhlFrntRiRatyHi" 218 "DFC_MisfDetVWhlFrntRiRatyLo" 219 "DFC_MisfDetVWhlFrntRiStuck" 220 "DFC_MisfDetVWhlReLeOORHi" 221 "DFC_MisfDetVWhlReLeRatyHi" 222 "DFC_MisfDetVWhlReLeRatyLo" 223 "DFC_MisfDetVWhlReLeStuck" 224 "DFC_MisfDetVWhlReRiOORHi" 225 "DFC_MisfDetVWhlReRiRatyHi" 226 "DFC_MisfDetVWhlReRiRatyLo" 227 "DFC_MisfDetVWhlReRiStuck" 228 "DFC_MisfDetdVWhlFrntLePlaus" 229 "DFC_MisfDetdVWhlFrntRiPlaus" 230 "DFC_MisfDetdVWhlReLePlaus" 231 "DFC_MisfDetdVWhlReRiPlaus" 232 "DFC_PEnvSigRngMax" 233 "DFC_PEnvSigRngMin" 234 "DFC_StmFault" 235 "DFC_StrtCtOffPth" 236 "DFC_StrtCtlErr" 237 "DFC_StrtFault" 238 "DFC_StrtLckJudg1" 239 "DFC_StrtLckJudg2" 240 "DFC_StrtOL" 241 "DFC_StrtOL2" 242 "DFC_StrtSCB" 243 "DFC_StrtSCB2" 244 "DFC_StrtSCG" 245 "DFC_StrtSCG2" 246 "DFC_StrtStkRly1" 247 "DFC_StrtStkRly2" 248 "DFC_TEVEmax" 249 "DFC_TEVEmin" 250 "DFC_TEVEsig" 251 "DFC_UegoHeatrPrfmncLoS1B1" 252 "DFC_VehVAllPlaus" 253 "DFC_VehVNCSnsrElecFailr" 254 "DFC_VehVPlausCan" 255 "DFC_VehVPlausFco" 256 "DFC_VehVPlausPwr" 257 "DFC_VehVPlausV2N" 258 "DFC_VehVSpdSnsrAElecFailr" 259 "DFC_VehVSpdSnsrBElecFailr" 260 "DFC_ClthMax" 261 "DFC_IgnClPs_DevComErr" 262 "DFC_IgnClPs_LineOl_0" 263 "DFC_IgnClPs_LineOl_1" 264 "DFC_IgnClPs_LineOl_2" 265 "DFC_IgnClPs_LineOl_3" 266 "DFC_IgnClPs_LineScb_0" 267 "DFC_IgnClPs_LineScb_1" 268 "DFC_IgnClPs_LineScb_2" 269 "DFC_IgnClPs_LineScb_3" 270 "DFC_IgnClPs_LineScg_0" 271 "DFC_IgnClPs_LineScg_1" 272 "DFC_IgnClPs_LineScg_2" 273 "DFC_IgnClPs_LineScg_3" 274 "DFC_KRVEKOEVAB" 275 "DFC_KRVEKOEVAB0" 276 "DFC_KRVEKOEVAB1" 277 "DFC_KRVEKOEVAB2" 278 "DFC_KRVEKOEVAB3" 279 "DFC_UegoSigEcuAsicS1B1" 280 "DFC_UegoSigEcuComS1B1" 281 "DFC_UegoSigSnsrS1B1" 282 "DFC_UegoSigWireOlApesS1B1" 283 "DFC_UegoSigWireOlIpeS1B1" 284 "DFC_UegoSigWireOlReS1B1" 285 "DFC_UegoSigWireRCmpS1B1" 286 "DFC_UegoSigWireScbS1B1" 287 "DFC_UegoSigWireScgS1B1" 288 "DFC_AfsPhyRngHiB1" 289 "DFC_AfsPhyRngLoB1" 290 "DFC_AirCCmprOL" 291 "DFC_AirCCmprOvrTemp" 292 "DFC_AirCCmprSCB" 293 "DFC_AirCCmprSCG" 294 "DFC_AltErr" 295 "DFC_BattUSRCMax" 296 "DFC_BattUSRCMin" 297 "DFC_ComChksTCU1" 298 "DFC_ComChksTCU11" 299 "DFC_ComChksTCU12" 300 "DFC_ComChksTCU13" 301 "DFC_ComChksTCU2" 302 "DFC_ComChksTCU3" 303 "DFC_ComChksTCU4" 304 "DFC_ComCntTCU1" 305 "DFC_ComCntTCU11" 306 "DFC_ComCntTCU12" 307 "DFC_ComCntTCU13" 308 "DFC_ComCntTCU2" 309 "DFC_ComCntTCU3" 310 "DFC_ComCntTCU4" 311 "DFC_ComTOutTCU01" 312 "DFC_ComTOutTCU02" 313 "DFC_ComTOutTCU1" 314 "DFC_ComTOutTCU11" 315 "DFC_ComTOutTCU12" 316 "DFC_ComTOutTCU13" 317 "DFC_ComTOutTCU14" 318 "DFC_ComTOutTCU2" 319 "DFC_ComTOutTCU3" 320 "DFC_ComTOutTCU4" 321 "DFC_DevLibBattUHi" 322 "DFC_DevLibBattULo" 323 "DFC_EGRVlvFailSafeActv" 324 "DFC_EGRVlvGovDvtCld" 325 "DFC_EGRVlvPhysSRCMax" 326 "DFC_EGRVlvPhysSRCMin" 327 "DFC_FanDIOOL_0" 328 "DFC_FanDIOOL_1" 329 "DFC_FanDIOOvrTemp_0" 330 "DFC_FanDIOOvrTemp_1" 331 "DFC_FanDIOSCB_0" 332 "DFC_FanDIOSCB_1" 333 "DFC_FanDIOSCG_0" 334 "DFC_FanDIOSCG_1" 335 "DFC_MRlyDcOL" 336 "DFC_MRlyDcSCB" 337 "DFC_MRlyDcSCG" 338 "DFC_PSPOL" 339 "DFC_PSPOvrTemp" 340 "DFC_PSPSCB" 341 "DFC_PSPSCG" 342 "DFC_T50Err" 343 "DFC_ThrVlvLoBattB1" 344 "DFC_UegoSigOperPlausS1B1" 345 "DFC_VehVPhysRngHi" 346 "DFC_VehVSclOutOL" 347 "DFC_VehVSclOutOT" 348 "DFC_VehVSclOutSCB" 349 "DFC_VehVSclOutSCG" 350 "DFC_VehVSigFL" 351 "DFC_VehVSigFR" 352 "DFC_VehVSigRL" 353 "DFC_VehVSigRR" 354 "DFC_VehVSnsrARngHi" 355 "DFC_VehVSnsrBRngHi" 356 "DFC_VehVSpdRtyDiag" 357 "DFC_DHFHD" 358 "DFC_InjVlv_DI_DcDc" 359 "DFC_InjVlv_DI_NoLd_0" 360 "DFC_InjVlv_DI_NoLd_1" 361 "DFC_InjVlv_DI_NoLd_2" 362 "DFC_InjVlv_DI_NoLd_3" 363 "DFC_InjVlv_DI_ScBnk_0" 364 "DFC_InjVlv_DI_ScBnk_1" 365 "DFC_InjVlv_DI_ScBnk_2" 366 "DFC_InjVlv_DI_ScBnk_3" 367 "DFC_InjVlv_DI_ScCyl_0" 368 "DFC_InjVlv_DI_ScCyl_1" 369 "DFC_InjVlv_DI_ScCyl_2" 370 "DFC_InjVlv_DI_ScCyl_3" 371 "DFC_InjVlv_DI_ScHsLs_0" 372 "DFC_InjVlv_DI_ScHsLs_1" 373 "DFC_InjVlv_DI_ScHsLs_2" 374 "DFC_InjVlv_DI_ScHsLs_3" 375 "DFC_MfPsDiaOpenLoad1" 376 "DFC_MfPsDiaScHiS1" 377 "DFC_MfPsDiaScHiSLowS1" 378 "DFC_MfPsDiaScLowS1" 379 "DFC_ACEvpTPhysRngHi" 380 "DFC_ACEvpTPhysRngLo" 381 "DFC_ACEvpTSRCMax" 382 "DFC_ACEvpTSRCMin" 383 "DFC_AfsRawSigRngHiB1" 384 "DFC_AfsRawSigRngLoB1" 385 "DFC_AfsSnsrErrB1" 386 "DFC_AirCClntPAnaSRCMax" 387 "DFC_AirCClntPAnaSRCMin" 388 "DFC_AirCSwtNpl" 389 "DFC_AirCSwtSig" 390 "DFC_Brk" 391 "DFC_BrkBstSensSCB" 392 "DFC_BrkBstSensSCG" 393 "DFC_BrkSig" 394 "DFC_ClthSig" 395 "DFC_EGRVlvCurrLim" 396 "DFC_EGRVlvOL" 397 "DFC_EGRVlvOvrTemp" 398 "DFC_EGRVlvSCB" 399 "DFC_EGRVlvSCG" 400 "DFC_EGRVlvSRCMax" 401 "DFC_EGRVlvSRCMin" 402 "DFC_HLSDemOvhtEngLim" 403 "DFC_OilPSwmpSRCMax" 404 "DFC_OilPSwmpSRCMin" 405 "DFC_PIntkVUsLineHiB1" 406 "DFC_PIntkVUsLineLoB1" 407 "DFC_VehVPhysRngLo" 408 "DFC_VehVSigCan" 409 "DFC_VehVSigCanSafe" 410 "DFC_VlvLftFbOilPSnsrIntk11SRCMax" 411 "DFC_VlvLftFbOilPSnsrIntk11SRCMin" 412 "DFC_ClthNpl" 413 "DFC_GbxPNPosnDrvCdn" 414 "DFC_GbxPNPosnPlausy" 415 "DFC_AfsSigErrLineHiB1" 416 "DFC_AfsSigErrLineLoB1" 417 "DFC_PEnvCcMax" 418 "DFC_PEnvCcMin" 419 "DFC_PEnvRngChkMax" 420 "DFC_PEnvRngChkMin" 421 "DFC_PEnvSnsrPlaus" 422 "DFC_UEGOHeatrRlyPsOLS1B1" 423 "DFC_UEGOHeatrRlyPsSCBS1B1" 424 "DFC_UEGOHeatrRlyPsSCGS1B1" 425 "DFC_UegoHeatrWireOlS1B1" 426 "DFC_UegoHeatrWireScbS1B1" 427 "DFC_UegoHeatrWireScgS1B1" 428 "DFC_KnDetSens1PortAMax" 429 "DFC_KnDetSens1PortAMin" 430 "DFC_KnDetSens1PortBMax" 431 "DFC_KnDetSens1PortBMin" 432 "DFC_Clth2ONStuck" 433 "DFC_Clth2ONStuckLdc" 434 "DFC_Clth3ONStuckLdc" 435 "DFC_Clth3ONStuckPostDrv" 436 "DFC_Clth4ONStuck" 437 "DFC_Clth4ONStuckLdc" 438 "DFC_ComBCMUnit" 439 "DFC_ComDLCTCU01" 440 "DFC_ComDLCTCU02" 441 "DFC_ComDLCTCU1" 442 "DFC_ComDLCTCU11" 443 "DFC_ComDLCTCU12" 444 "DFC_ComDLCTCU13" 445 "DFC_ComDLCTCU14" 446 "DFC_ComDLCTCU2" 447 "DFC_ComDLCTCU3" 448 "DFC_ComDLCTCU4" 449 "DFC_ComEPSUnit" 450 "DFC_ComIDASBUnit" 451 "DFC_ComIMGUnit" 452 "DFC_ComMETUnit" 453 "DFC_ComSRSUnit" 454 "DFC_ComVSAUnit" 455 "DFC_EbsSocFlt" 456 "DFC_I14229VINErr" 457 "DFC_InjCatHeatgErr" 458 "DFC_InjSysMulInjDiagErr" 459 "DFC_LLRHmax" 460 "DFC_LLRHmin" 461 "DFC_LLRHnpl" 462 "DFC_LLRKHmax" 463 "DFC_LLRKHmin" 464 "DFC_LLRKHnpl" 465 "DFC_LinACGUnit" 466 "DFC_LinAEVUnit" 467 "DFC_LinEBSUnit" 468 "DFC_RoughRoad" 469 "DFC_SiaEEPRdErr" 470 "DFC_SiaEEPWrngCod" 471 "DFC_UegoHeatrStrtS1B1" 472 "DFC_BusDiagCANAPPLBusOff" 473 "DFC_BusDiagCANCANCBusOff" 474 "DFC_BusDiagCANVEHICLEBusOff" 475 "DFC_RBA_IODIAGPWR_rba_IoExtCy329_SignalVltSply_0" 476 "DFC_RBA_IODIAGPWR_rba_IoExtCy329_SignalVltSply_0OT" 477 "DFC_RBA_IODIAGPWR_rba_IoExtCy329_SignalVltSply_0OV" 478 "DFC_RBA_IODIAGPWR_rba_IoExtCy329_SignalVltSply_0SCG" 479 "DFC_RBA_IODIAGPWR_rba_IoExtCy329_SignalVltSply_0UV" 480 "DFC_RBA_IODIAGPWR_rba_IoExtCy329_SignalVltSply_1" 481 "DFC_RBA_IODIAGPWR_rba_IoExtCy329_SignalVltSply_1OT" 482 "DFC_RBA_IODIAGPWR_rba_IoExtCy329_SignalVltSply_1OV" 483 "DFC_RBA_IODIAGPWR_rba_IoExtCy329_SignalVltSply_1SCG" 484 "DFC_RBA_IODIAGPWR_rba_IoExtCy329_SignalVltSply_1UV" 485 "DFC_RBA_IODIAGPWR_rba_IoExtCy329_SignalVltSply_2" 486 "DFC_RBA_IODIAGPWR_rba_IoExtCy329_SignalVltSply_2OT" 487 "DFC_RBA_IODIAGPWR_rba_IoExtCy329_SignalVltSply_2OV" 488 "DFC_RBA_IODIAGPWR_rba_IoExtCy329_SignalVltSply_2SCG" 489 "DFC_RBA_IODIAGPWR_rba_IoExtCy329_SignalVltSply_2UV" 490 "DFC_CAN_E_TIMEOUT" 491 "DFC_LIN_E_TIMEOUT" 492 "DFC_MRlyOL" 493 "DFC_MRlySCB" 494 "DFC_MRlySCG" 495 "DFC_rba_MultiStackTrace_Threshold" 496 "DFC_BSWM_E_ACTION_FAILED" 497 "DFC_BSWM_E_INTRPTQUEUE_FULL" 498 "DFC_RBA_IOEXTLIB_KEEPALIVE_DRV" 499 "DFC_RBA_IOEXTLIB_KEEPALIVE_INI" 500 "DFC_rba_IoSigRtc_StopCounter" 501 "DFC_rba_MRly_Diag_Stk_Event" 502 "DFC_rba_MemDiag_MemReadErr" 503 "DFC_rba_MemDiag_MemWrErr" 504 "DFC_rba_SyC_IrrSwOffTrigEngRun_Event" 505 "DFC_rba_T15_Diag_ComInVld_Event" 506 "DFC_rba_T15_Diag_ComOff_HwOn_Event" 507 "DFC_rba_T15_Diag_ComOn_HwOff_Event" 508 "DFC_AAVmin" 509 "DFC_AGRSUS" 510 "DFC_AfsPlausDiagHi" 511 "DFC_AfsPlausDiagLo" 512 "DFC_AfsVrntDiagErrB1" 513 "DFC_AppAllSnsrDfct" 514 "DFC_BBKRnldg" 515 "DFC_BBKRsyne" 516 "DFC_BattUStdbyDiaOL" 517 "DFC_BigLeakIntkMnfldEmiInfl" 518 "DFC_BlkdLineTank" 519 "DFC_BrkMnSwtContOnWarnLmp" 520 "DFC_BrkMnSwtNotStpWarnLmp" 521 "DFC_BrkRdntSwtContOnWarnLmp" 522 "DFC_BrkRdntSwtNotStpWarnLmp" 523 "DFC_CEngDsTColdStrtMax" 524 "DFC_CEngDsTColdStrtMin" 525 "DFC_CEngDsTImps" 526 "DFC_CEngDsTPlausHSC" 527 "DFC_CEngDsTPlausLSC" 528 "DFC_CEngDsTPlausSTC" 529 "DFC_CEngDsTSRCMax" 530 "DFC_CEngDsTSRCMin" 531 "DFC_CEngDsTSig" 532 "DFC_CEngUsTColdStrtMax" 533 "DFC_CEngUsTColdStrtMin" 534 "DFC_CEngUsTLooseCnctn" 535 "DFC_CEngUsTSRCMax" 536 "DFC_CEngUsTSRCMin" 537 "DFC_ComDCDCACCFailr" 538 "DFC_DCDCFltDet" 539 "DFC_DKRSA" 540 "DFC_DKVSmax" 541 "DFC_DKnpl" 542 "DFC_DSKVRmax" 543 "DFC_DSKVRmin" 544 "DFC_DSKVRnpl" 545 "DFC_DSKVRsig" 546 "DFC_DSKVSsig" 547 "DFC_DSSmax" 548 "DFC_DSTDmax" 549 "DFC_DSTEmax" 550 "DFC_DSTEmin" 551 "DFC_DSTOFmax" 552 "DFC_DSTRmax" 553 "DFC_DSTRmin" 554 "DFC_DSTRnpl" 555 "DFC_DSTRsig" 556 "DFC_DSTTI" 557 "DFC_DSUmax" 558 "DFC_DiagCpv1DteskLoLoadStuckClsd" 559 "DFC_DiagCpv1DteskLoLoadStuckOpen" 560 "DFC_EGRVlvDrftClsd" 561 "DFC_EGRVlvDrftOpn" 562 "DFC_EGRVlvJamVlvClsd" 563 "DFC_EGRVlvJamVlvOpn" 564 "DFC_EGRVlvSprgBrk" 565 "DFC_EGRVlvTempMdlEEPErr" 566 "DFC_EGRVlvTmpErr" 567 "DFC_EGSDUS2B1LtrDly" 568 "DFC_EGSDUS2B1LtrPT1" 569 "DFC_EGSDUS2B1RtlDly" 570 "DFC_EGSDUS2B1RtlPT1" 571 "DFC_EGSDUS2B1TarLean" 572 "DFC_EGSDUS2B1TarRich" 573 "DFC_EONVmax" 574 "DFC_ETAKHLmax" 575 "DFC_ETAKHTmax" 576 "DFC_ETHSEmax" 577 "DFC_ETHSEmin" 578 "DFC_ETHSFmax" 579 "DFC_ETHSFmin" 580 "DFC_ETHSFsig" 581 "DFC_ETHSNPWmax" 582 "DFC_ETHSNPWmin" 583 "DFC_ETHSNPWsig" 584 "DFC_ETHSPLnpl" 585 "DFC_ETHSTPLnpl" 586 "DFC_EngICO" 587 "DFC_EngPrtOvrSpdMon" 588 "DFC_EpmCaSI1ErrSig" 589 "DFC_EpmCaSI1MntErr" 590 "DFC_EpmCaSI1NoSigMax" 591 "DFC_EpmCaSI1NoSigMin" 592 "DFC_EpmCaSI1OfsErr" 593 "DFC_EpmCrSDGI" 594 "DFC_EpmCrSErrSig" 595 "DFC_EpmCrSNoSig" 596 "DFC_EtaEngIdleNonCsers" 597 "DFC_EtaEngPtlNonCsers" 598 "DFC_FRAmax" 599 "DFC_FRAmin" 600 "DFC_FSTEmax" 601 "DFC_FSTEmin" 602 "DFC_FSTRmax" 603 "DFC_FSTRmin" 604 "DFC_FSTRnpl" 605 "DFC_FSTmax" 606 "DFC_FTDLAmax" 607 "DFC_FTDLAmin" 608 "DFC_FuPHiSnsrEleclmax" 609 "DFC_FuPHiSnsrEleclmin" 610 "DFC_FuPHiSnsrEleclnpl" 611 "DFC_FuPHiSnsrURngMax" 612 "DFC_FuPHiSnsrURngMin" 613 "DFC_FuSnsrPhyRngMaxErr" 614 "DFC_FuSnsrPhyRngMinErr" 615 "DFC_GEVlvLockPinDiagIntkB1" 616 "DFC_GEVlvPhaSlowIntkB1" 617 "DFC_GEVlvPhaTargIntkB1" 618 "DFC_GbxRvsSwtStk" 619 "DFC_HDRKHmax" 620 "DFC_HDRKHmin" 621 "DFC_HDRPLmax" 622 "DFC_HDRPLmin" 623 "DFC_HDRmax" 624 "DFC_HDRmin" 625 "DFC_HEGOS2B1ElecMax" 626 "DFC_HEGOS2B1ElecMin" 627 "DFC_HEGOS2B1ElecSig" 628 "DFC_HEGOS2B1HtgNpl" 629 "DFC_HEV00max" 630 "DFC_HEV01max" 631 "DFC_HEV02max" 632 "DFC_HEV03max" 633 "DFC_HEVE0max" 634 "DFC_HEVE1max" 635 "DFC_HFMmax" 636 "DFC_HiPSysHiPMaxLimExcdd" 637 "DFC_IVGdiCtlCvoErrMax_0" 638 "DFC_IVGdiCtlCvoErrMax_1" 639 "DFC_IVGdiCtlCvoErrMax_2" 640 "DFC_IVGdiCtlCvoErrMax_3" 641 "DFC_IVGdiCtlCvoErrMin_0" 642 "DFC_IVGdiCtlCvoErrMin_1" 643 "DFC_IVGdiCtlCvoErrMin_2" 644 "DFC_IVGdiCtlCvoErrMin_3" 645 "DFC_IVGdiCtlCvoErrMinMax" 646 "DFC_IVGdiCtlCvoSigPlausErrSmrCdn" 647 "DFC_IVGdiCtl_CvoErr" 648 "DFC_IVGdiCtl_CvoSigPlaus_0" 649 "DFC_IVGdiCtl_CvoSigPlaus_1" 650 "DFC_IVGdiCtl_CvoSigPlaus_2" 651 "DFC_IVGdiCtl_CvoSigPlaus_3" 652 "DFC_IntkAirTAirFltDsCrssMax" 653 "DFC_IntkAirTAirFltDsCrssMin" 654 "DFC_IntkAirTAirFltDsHSCMax" 655 "DFC_IntkAirTAirFltDsImps" 656 "DFC_IntkAirTAirFltDsPRCMax" 657 "DFC_IntkAirTAirFltDsPRCMin" 658 "DFC_IntkAirTAirFltDsSRCMax" 659 "DFC_IntkAirTAirFltDsSRCMin" 660 "DFC_IntkAirTAirFltDsSTC" 661 "DFC_IntkAirTIntkMnfldCrssMax" 662 "DFC_IntkAirTIntkMnfldCrssMin" 663 "DFC_IntkAirTIntkMnfldHSCMax" 664 "DFC_IntkAirTIntkMnfldImps" 665 "DFC_IntkAirTIntkMnfldPRCMax" 666 "DFC_IntkAirTIntkMnfldPRCMin" 667 "DFC_IntkAirTIntkMnfldSRCMax" 668 "DFC_IntkAirTIntkMnfldSRCMin" 669 "DFC_IntkAirTIntkMnfldSTC" 670 "DFC_KRREGRLMX" 671 "DFC_KRVEKOCVLCI" 672 "DFC_KRVEKOENCHMT" 673 "DFC_KRVEKOENCHMT0" 674 "DFC_KRVEKOENCHMT1" 675 "DFC_KRVEKOENCHMT2" 676 "DFC_KRVEKOENCHMT3" 677 "DFC_KRVEKOENCHMT4" 678 "DFC_KRVEKOENCHMT5" 679 "DFC_KRVEKOENCHMT6" 680 "DFC_KRVEKOENCHMT7" 681 "DFC_KRVEKORLMX" 682 "DFC_KRVEKORLMXL" 683 "DFC_KS1max" 684 "DFC_KS1min" 685 "DFC_LMmax" 686 "DFC_LZSRnpl" 687 "DFC_LamDynDiagS1B1" 688 "DFC_LeakIntkMnfldEmiInfl" 689 "DFC_LinFrameErrDCDC" 690 "DFC_LinOverrunErrDCDC" 691 "DFC_MD00max" 692 "DFC_MDBmax" 693 "DFC_MDCat" 694 "DFC_MDCatCrit" 695 "DFC_MDCatCurr" 696 "DFC_MDCyl_0" 697 "DFC_MDCyl_1" 698 "DFC_MDCyl_2" 699 "DFC_MDCyl_3" 700 "DFC_MDEmi" 701 "DFC_MDEmiStrt" 702 "DFC_MDFco" 703 "DFC_MDMpl" 704 "DFC_MDSegTiAdpn" 705 "DFC_MDmax" 706 "DFC_MFuOilMax" 707 "DFC_MOXEMM_SMU_ALM0_0" 708 "DFC_MOXEMM_SMU_ALM0_1" 709 "DFC_MOXEMM_SMU_ALM0_10" 710 "DFC_MOXEMM_SMU_ALM0_11" 711 "DFC_MOXEMM_SMU_ALM0_13" 712 "DFC_MOXEMM_SMU_ALM0_14" 713 "DFC_MOXEMM_SMU_ALM0_2" 714 "DFC_MOXEMM_SMU_ALM0_22" 715 "DFC_MOXEMM_SMU_ALM0_23" 716 "DFC_MOXEMM_SMU_ALM0_4" 717 "DFC_MOXEMM_SMU_ALM0_5" 718 "DFC_MOXEMM_SMU_ALM0_7" 719 "DFC_MOXEMM_SMU_ALM0_8" 720 "DFC_MOXEMM_SMU_ALM10_16" 721 "DFC_MOXEMM_SMU_ALM10_17" 722 "DFC_MOXEMM_SMU_ALM10_21" 723 "DFC_MOXEMM_SMU_ALM11_0" 724 "DFC_MOXEMM_SMU_ALM11_1" 725 "DFC_MOXEMM_SMU_ALM11_2" 726 "DFC_MOXEMM_SMU_ALM11_3" 727 "DFC_MOXEMM_SMU_ALM11_4" 728 "DFC_MOXEMM_SMU_ALM11_5" 729 "DFC_MOXEMM_SMU_ALM11_8" 730 "DFC_MOXEMM_SMU_ALM11_9" 731 "DFC_MOXEMM_SMU_ALM1_0" 732 "DFC_MOXEMM_SMU_ALM1_1" 733 "DFC_MOXEMM_SMU_ALM1_10" 734 "DFC_MOXEMM_SMU_ALM1_11" 735 "DFC_MOXEMM_SMU_ALM1_13" 736 "DFC_MOXEMM_SMU_ALM1_14" 737 "DFC_MOXEMM_SMU_ALM1_2" 738 "DFC_MOXEMM_SMU_ALM1_22" 739 "DFC_MOXEMM_SMU_ALM1_23" 740 "DFC_MOXEMM_SMU_ALM1_4" 741 "DFC_MOXEMM_SMU_ALM1_5" 742 "DFC_MOXEMM_SMU_ALM1_7" 743 "DFC_MOXEMM_SMU_ALM1_8" 744 "DFC_MOXEMM_SMU_ALM21_0" 745 "DFC_MOXEMM_SMU_ALM21_16" 746 "DFC_MOXEMM_SMU_ALM21_3" 747 "DFC_MOXEMM_SMU_ALM2_1" 748 "DFC_MOXEMM_SMU_ALM2_10" 749 "DFC_MOXEMM_SMU_ALM2_11" 750 "DFC_MOXEMM_SMU_ALM2_13" 751 "DFC_MOXEMM_SMU_ALM2_14" 752 "DFC_MOXEMM_SMU_ALM2_22" 753 "DFC_MOXEMM_SMU_ALM2_23" 754 "DFC_MOXEMM_SMU_ALM2_4" 755 "DFC_MOXEMM_SMU_ALM2_5" 756 "DFC_MOXEMM_SMU_ALM2_7" 757 "DFC_MOXEMM_SMU_ALM2_8" 758 "DFC_MOXEMM_SMU_ALM6_0" 759 "DFC_MOXEMM_SMU_ALM6_11" 760 "DFC_MOXEMM_SMU_ALM6_12" 761 "DFC_MOXEMM_SMU_ALM6_14" 762 "DFC_MOXEMM_SMU_ALM6_15" 763 "DFC_MOXEMM_SMU_ALM6_17" 764 "DFC_MOXEMM_SMU_ALM6_18" 765 "DFC_MOXEMM_SMU_ALM6_20" 766 "DFC_MOXEMM_SMU_ALM6_21" 767 "DFC_MOXEMM_SMU_ALM6_25" 768 "DFC_MOXEMM_SMU_ALM6_4" 769 "DFC_MOXEMM_SMU_ALM6_5" 770 "DFC_MOXEMM_SMU_ALM6_7" 771 "DFC_MOXEMM_SMU_ALM6_8" 772 "DFC_MOXEMM_SMU_ALM7_1" 773 "DFC_MOXEMM_SMU_ALM7_12" 774 "DFC_MOXEMM_SMU_ALM7_13" 775 "DFC_MOXEMM_SMU_ALM7_14" 776 "DFC_MOXEMM_SMU_ALM7_15" 777 "DFC_MOXEMM_SMU_ALM7_16" 778 "DFC_MOXEMM_SMU_ALM7_17" 779 "DFC_MOXEMM_SMU_ALM7_2" 780 "DFC_MOXEMM_SMU_ALM7_20" 781 "DFC_MOXEMM_SMU_ALM7_25" 782 "DFC_MOXEMM_SMU_ALM7_26" 783 "DFC_MOXEMM_SMU_ALM7_28" 784 "DFC_MOXEMM_SMU_ALM7_29" 785 "DFC_MOXEMM_SMU_ALM7_30" 786 "DFC_MOXEMM_SMU_ALM7_31" 787 "DFC_MOXEMM_SMU_ALM8_0" 788 "DFC_MOXEMM_SMU_ALM8_1" 789 "DFC_MOXEMM_SMU_ALM8_10" 790 "DFC_MOXEMM_SMU_ALM8_11" 791 "DFC_MOXEMM_SMU_ALM8_12" 792 "DFC_MOXEMM_SMU_ALM8_16" 793 "DFC_MOXEMM_SMU_ALM8_18" 794 "DFC_MOXEMM_SMU_ALM8_2" 795 "DFC_MOXEMM_SMU_ALM8_3" 796 "DFC_MOXEMM_SMU_ALM8_31" 797 "DFC_MOXEMM_SMU_ALM8_4" 798 "DFC_MOXEMM_SMU_ALM9_0" 799 "DFC_MOXEMM_SMU_ALM9_15" 800 "DFC_MOXEMM_SMU_ALM9_3" 801 "DFC_MoCADCNTP" 802 "DFC_MoCADCTst" 803 "DFC_MoCSOPICO" 804 "DFC_MoFAPP" 805 "DFC_MoFAirFilgPrdc" 806 "DFC_MoFAirFlCtOffGdi" 807 "DFC_MoFAirFlCylGdi" 808 "DFC_MoFAirFlFF" 809 "DFC_MoFAirFlIn" 810 "DFC_MoFAirFlMixCtlGdiChkAirFl" 811 "DFC_MoFAirFlMixCtlGdiChkCtrl" 812 "DFC_MoFAirFlMode" 813 "DFC_MoFESpd" 814 "DFC_MoFIACo" 815 "DFC_MoFICOL1" 816 "DFC_MoFICOL2" 817 "DFC_MoFStrt" 818 "DFC_MoFTrqCmp" 819 "DFC_MoFTrqCmpMax" 820 "DFC_MoFTrqCmpMin" 821 "DFC_MoFVarPostBldSel" 822 "DFC_MoXEMMHwLTMCUFW" 823 "DFC_MoXEMMHwLTMonBIST" 824 "DFC_MoXEMMHwLTRegMonTest" 825 "DFC_MoXEMMHwLTStbySMUAlvTest" 826 "DFC_MoXEMMHwLTTempSens" 827 "DFC_MoXEMMHwLTUCBCfg" 828 "DFC_NWSEmax" 829 "DFC_NWSmax" 830 "DFC_OCWDAABEActv" 831 "DFC_OCWDACom" 832 "DFC_OCWDAErrPin" 833 "DFC_OCWDAOvrVltg" 834 "DFC_ORAmax" 835 "DFC_ORAmin" 836 "DFC_OilPPlaus" 837 "DFC_PLLSUmax" 838 "DFC_PLLSUmin" 839 "DFC_PSR1max" 840 "DFC_PSRBmax" 841 "DFC_PSRBmin" 842 "DFC_PSRPmax" 843 "DFC_PSRPmin" 844 "DFC_PSRPsig" 845 "DFC_PSRmax" 846 "DFC_PUmax" 847 "DFC_P_VSE11_OL" 848 "DFC_P_VSE11_SCB" 849 "DFC_P_VSE11_SCG" 850 "DFC_PhyHighAPP1" 851 "DFC_PhyHighAPP2" 852 "DFC_PhyLowAPP1" 853 "DFC_PhyLowAPP2" 854 "DFC_SRCHighAPP1" 855 "DFC_SRCHighAPP2" 856 "DFC_SRCLowAPP1" 857 "DFC_SRCLowAPP2" 858 "DFC_SSpMon2" 859 "DFC_STHDRmax" 860 "DFC_SWReset_0" 861 "DFC_SWReset_1" 862 "DFC_SWReset_2" 863 "DFC_SyncAPP" 864 "DFC_TANKLnpl" 865 "DFC_TAmax_Dummy" 866 "DFC_TESFmax" 867 "DFC_TESGmax" 868 "DFC_TKAEmax" 869 "DFC_TKAEmin" 870 "DFC_TKARmax" 871 "DFC_TKARnpl" 872 "DFC_TMmax_Dummy" 873 "DFC_TUMmax_Dummy" 874 "DFC_TWCDPriCatB1" 875 "DFC_ThrVlvClsdPosnFirstOffsLrnImpoB1" 876 "DFC_ThrVlvClsdPosnOffsLrnImpoB1" 877 "DFC_ThrVlvClsdPosnOffsLrnMaxB1" 878 "DFC_ThrVlvClsdPosnOffsLrnMinB1" 879 "DFC_ThrVlvCtrlDeB1" 880 "DFC_ThrVlvDycB1" 881 "DFC_ThrVlvLimpAirPosnMaxAbsltDriftB1" 882 "DFC_ThrVlvLimpAirPosnMaxB1" 883 "DFC_ThrVlvLimpAirPosnMaxRelDriftB1" 884 "DFC_ThrVlvLimpAirPosnMinB1" 885 "DFC_ThrVlvOpenLoadB1" 886 "DFC_ThrVlvOpenSprgB1" 887 "DFC_ThrVlvOpenSprgSprdB1" 888 "DFC_ThrVlvOpenSprgTwnB1" 889 "DFC_ThrVlvOverTB1" 890 "DFC_ThrVlvRetSprgB1" 891 "DFC_ThrVlvRetSprgSprdB1" 892 "DFC_ThrVlvRetSprgTwnB1" 893 "DFC_ThrVlvSens1MaxB1" 894 "DFC_ThrVlvSens1NplB1" 895 "DFC_ThrVlvSens2MaxB1" 896 "DFC_ThrVlvSens2MinB1" 897 "DFC_ThrVlvSens2NplB1" 898 "DFC_ThrVlvShoCircB1" 899 "DFC_ThrVlvSpiErrB1" 900 "DFC_ThrvlvSens1MinB1" 901 "DFC_TiOffTBasdChkFast" 902 "DFC_TiOffTBasdChkSlow" 903 "DFC_UEGOSnsrMntdS1B1" 904 "DFC_VehVSig" 905 "DFC_VlvLftFbSwtIntk11SpclFail" 906 "DFC_VlvLftFbSwtIntk11StdFail" 907 "DSQ_ACClntP" 908 "DSQ_ACEvpT" 909 "DSQ_AirCCmprActr" 910 "DSQ_BattU" 911 "DSQ_BattULo" 912 "DSQ_BrkBstPMdl" 913 "DSQ_BrkP" 914 "DSQ_BrkPSnsr" 915 "DSQ_CoVMDIDASFail" 916 "DSQ_DSMInhibitAlways" 917 "DSQ_EGRVlv_GovDesVal" 918 "DSQ_ElecLd" 919 "DSQ_EngICO" 920 "DSQ_EpmCaSSigQuality" 921 "DSQ_EpmReverseRun" 922 "DSQ_FanDIO_0" 923 "DSQ_FanDIO_1" 924 "DSQ_FuelP" 925 "DSQ_FuelT" 926 "DSQ_GEVCtlTOilCylHd" 927 "DSQ_GEVlvAgIntkB1" 928 "DSQ_GbxPNPos" 929 "DSQ_GbxPosNotPN" 930 "DSQ_InjVlv_DI_CylOk" 931 "DSQ_MRly" 932 "DSQ_OilP" 933 "DSQ_PEnvMeasVld" 934 "DSQ_PEnvVld" 935 "DSQ_PEnv_pRaw" 936 "DSQ_PRail" 937 "DSQ_PThrVlvUs" 938 "DSQ_PThrVlvUsB1" 939 "DSQ_StrtImobChk" 940 "DSQ_TDevCenColdStrt" 941 "DSQ_VehV" 942 "DSQ_VehVSens" 943 "DSQ_VehVSnsr" 944 "DSQ_stAPP" 945 "DSQ_stComEAT4" 65535 "Inhibited_Trip" DEFAULT_VALUE "---" /end COMPU_VTAB
/begin COMPU_METHOD DFC_OneToOne "" RAT_FUNC "%6.2" "-" COEFFS 0 1 0 0 0 1 /end COMPU_METHOD
/begin COMPU_METHOD DINH_FIdVerb "" TAB_VERB "%6.3" "-" COMPU_TAB_REF DINH_FIdVerb /end COMPU_METHOD
/begin COMPU_VTAB DINH_FIdVerb "" TAB_VERB 969 0 "FId_Unused" 1 "FID_AFRA" 2 "FID_AORA" 3 "FID_ATEH" 4 "FID_ATEL" 5 "FID_ATEN" 6 "FID_ATLDI" 7 "FID_ATLDO" 8 "FID_BEONV" 9 "FId_EGSDCmnSeg1B1Parl" 10 "FID_BAGRA" 11 "FID_BAGRASD" 12 "FID_BDSTOF" 13 "FID_BFVDFRM" 14 "FID_BHOM" 15 "FID_BLLRH" 16 "FID_BLLRKH" 17 "FID_BPLSU" 18 "FID_FRAMBAVMB" 19 "FId_CatHeatgColdStrtReq" 20 "FId_CatHeatgWrmReq" 21 "FId_DSMBDEPHSpOpMode" 22 "FId_EGRVlvCoord" 23 "FId_EGSDO2FuTrmB1" 24 "FId_EGSDO2SnsrMntdRelsS1B1" 25 "FId_EGSDO2_LamOffsFastS1B1" 26 "FId_MisfDetDnAdpnNv" 27 "FId_bascadpncvo" 28 "FID_AGRS" 29 "FID_BBAGR" 30 "FID_BBAGRA" 31 "FID_BGFKMS" 32 "FID_BGMSDKS" 33 "FID_CAGRSUS" 34 "FID_CBGTFUELM" 35 "FID_CBGTHDEV" 36 "FID_CDESVF" 37 "FID_CDETHS" 38 "FID_CDRCTSTRT" 39 "FID_CDSKV" 40 "FID_CDSKVRNO" 41 "FID_CDSKVRPO" 42 "FID_CDSKVRaty" 43 "FID_CDSKVRng" 44 "FID_CDSKVS" 45 "FID_CDSTR" 46 "FID_CDSTTI" 47 "FID_CETHG" 48 "FID_CETHSPLnpl" 49 "FID_CETHSTPLnpl" 50 "FID_CETKHL" 51 "FID_CETKHT" 52 "FID_CGDISTRT" 53 "FID_CGLSRDP" 54 "FID_CHDR" 55 "FID_CHDRKH" 56 "FID_CHDRPL" 57 "FID_CLLKHV" 58 "FID_CLLRHV" 59 "FID_CLZSRDP" 60 "FID_CLZSRHP" 61 "FID_CNLHP" 62 "FID_CNLHP2" 63 "FID_CNLKO2" 64 "FID_CNLKO3" 65 "FID_CNLLP" 66 "FID_CNLPL" 67 "FID_CNLPS" 68 "FID_CNSAD" 69 "FID_CNSAD2" 70 "FID_CPSRB" 71 "FID_CPSRP" 72 "FID_CSTHDR" 73 "FID_CSTRTCTL" 74 "FID_CTESF" 75 "FID_CTESG" 76 "FID_CTHIPSTRT" 77 "FID_CTKACS" 78 "FID_CTMSV" 79 "FID_CTOSP" 80 "FID_DHFERR" 81 "FID_DKRSA" 82 "FID_DLLRBandEndTst" 83 "FID_DLLRShrtTrpSpdRmp" 84 "FID_FEDKAHB" 85 "FID_FEDKAPB" 86 "FID_FEDSSB" 87 "FID_FOFSTP" 88 "FID_FONSTP" 89 "FID_FUEDK" 90 "FID_FVLRA" 91 "FID_KRREGact" 92 "FID_KRREGloc" 93 "FID_LRADLSU" 94 "FID_LRALSVErr" 95 "FID_LRAPLLSU" 96 "FID_LUSTP" 97 "FID_LnKS1" 98 "FID_PLSUV" 99 "FID_PSRMOZDG" 100 "FID_PSRMOZG" 101 "FID_STRTDIA" 102 "FID_STRTSTM" 103 "FID_TFA1CSMW" 104 "FID_TFA2CSMW" 105 "FID_TKACSMW" 106 "FID_TMCSMW" 107 "FID_TOCHOilSwmpTQly" 108 "FID_TOCHTME" 109 "FID_TOSPCSMW" 110 "FID_TSRLX" 111 "FID_UEGOHeatrRlyS1B1" 112 "FID_VehStvSSEOk" 113 "FID_VldtLamPlausMaxS1B1" 114 "FID_VldtLamPlausMinS1B1" 115 "FId_ACClntPSSPMon" 116 "FId_ACCompComCANBusOff" 117 "FId_ACCompComCANErrMtr" 118 "FId_ACComp_HiUTWSnsrErr" 119 "FId_ACComp_LoUTWSnsrErr" 120 "FId_ACComp_PDSnsrErr" 121 "FId_ACComp_VehSpdSnsrErr" 122 "FId_ACCtl_ACStrtCut" 123 "FId_ACCtl_APP1" 124 "FId_ACCtl_APP2" 125 "FId_ACCtl_APPSync" 126 "FId_ACCtl_AcOff" 127 "FId_ACCtl_Clmb" 128 "FId_ACCtl_DK1" 129 "FId_ACCtl_DK2" 130 "FId_ACCtl_DKSync" 131 "FId_ACCtl_VehSpdSnsrErr" 132 "FId_ACCtl_pAC" 133 "FId_ACEvpTCANErr" 134 "FId_ACEvpTFrzVal" 135 "FId_ACEvpTPhysRng" 136 "FId_ACEvpTRplVal" 137 "FId_AFCLFailr" 138 "FId_AFS" 139 "FId_AFSPhyRng" 140 "FId_APP1SigPath" 141 "FId_APP2SigPath" 142 "FId_APPBrkErr" 143 "FId_APPLETVldnErr" 144 "FId_APPLrn" 145 "FId_APPVehVErr" 146 "FId_AccPedDrvModComErr" 147 "FId_AccPedDrvModFailr" 148 "FId_AccPedNMaxLim" 149 "FId_AccPedNMinLim" 150 "FId_AccPedNMinLimBrkApp" 151 "FId_AccPedTrqLim" 152 "FId_AfsDdDiag" 153 "FId_AfsDiagErr" 154 "FId_AfsDiagTst" 155 "FId_AfsPlausDiag" 156 "FId_AfsVrntDiag" 157 "FId_AirCClntPFrzVal" 158 "FId_AirCClntPRplVal" 159 "FId_AirCSwt" 160 "FId_AirDvPAdpnPEnv" 161 "FId_AirDvPAdpnPIntkVUsB1" 162 "FId_AirDvPPSnsrAdpn_PModeActv" 163 "FId_AltACGFailr" 164 "FId_AltAPPErrSt" 165 "FId_AltBattMngtFailr" 166 "FId_AltBrkErrSt" 167 "FId_AltComErr" 168 "FId_AltENGB" 169 "FId_AltElecLoadErr" 170 "FId_AltEnvTErr" 171 "FId_AltFFAltLoadFast" 172 "FId_AltFFAltLoadSlow" 173 "FId_AltIOACGErr" 174 "FId_AltIOACGLinComFailr" 175 "FId_AltIOComErr" 176 "FId_AltLinErr" 177 "FId_AltPwr" 178 "FId_AltVehVErrSt" 179 "FId_AltvCluFail" 180 "FId_BGAGRTS" 181 "FId_BGFKMSEPSR" 182 "FId_BGFKMSEPU" 183 "FId_BGFKMSESumClr" 184 "FId_BGFKMSHFME" 185 "FId_BGFKMSHFMZ" 186 "FId_BGFKMSZPSR" 187 "FId_BGOSCCat1B1" 188 "FId_BGOSCCat2B1" 189 "FId_BattAltFailr" 190 "FId_BattMngtFailr" 191 "FId_BattSigPtd" 192 "FId_BattU2MEDSRC" 193 "FId_BattUDrpPrvOff" 194 "FId_BattUFrzVal" 195 "FId_BattUHiFailrEna" 196 "FId_BattUIMGTCUCANFailr" 197 "FId_BattULoFailrEna" 198 "FId_BattUReplVal" 199 "FId_BattUSRC" 200 "FId_BlwrComErr" 201 "FId_BrkBstMdl" 202 "FId_BrkBstMdlBrkP" 203 "FId_BrkBstMdlBrkSt" 204 "FId_BrkBstMdlEnvP" 205 "FId_BrkBstPDetnInhbn" 206 "FId_BrkBstPMstCylPSnsrFail" 207 "FId_BrkBstPSnsrStuckDetn" 208 "FId_BrkBstSigPath" 209 "FId_BrkBstVehVv" 210 "FId_BrkMnSwtErr" 211 "FId_BrkPFrzVal" 212 "FId_BrkPOilPres" 213 "FId_BrkPReplVal" 214 "FId_BrkPedEngStopEna" 215 "FId_BrkRdntSwtErr" 216 "FId_CAGRSDS" 217 "FId_CEngDsTColdStrt" 218 "FId_CEngDsTColdStrtErr" 219 "FId_CEngDsTHSC" 220 "FId_CEngDsTLSC" 221 "FId_CEngDsTPlausErr" 222 "FId_CEngDsTReplMdlEngStop" 223 "FId_CEngDsTSTC" 224 "FId_CEngDsTSnsrElec" 225 "FId_CEngDsTSwtReplMdl" 226 "FId_CEngUsTColdChkErr" 227 "FId_CEngUsTCrssChk" 228 "FId_CEngUsTElecErr" 229 "FId_CEngUsTSnsrElecErr" 230 "FId_CEngUsTSwtReplMdl" 231 "FId_CInjCatHeatgDiag" 232 "FId_CMSUDKSOM1" 233 "FId_CMSUDKSOM2" 234 "FId_CatHeatgEomShtrpAct" 235 "FId_ChrctlAgrsErr" 236 "FId_ChrctlAgrscf" 237 "FId_ClntTempENGB" 238 "FId_Clth" 239 "FId_Clth2" 240 "FId_Clth3StuckOn" 241 "FId_Clth4" 242 "FId_ClthCAN" 243 "FId_ClthMax" 244 "FId_ClthStk" 245 "FId_ClthStkErr" 246 "FId_ClthStkFailr" 247 "FId_ClthStkOFFStuck" 248 "FId_ClthStkONStuck" 249 "FId_ClthSwtFailr" 250 "FId_CntrShaftFailr" 251 "FId_CoEOMGdiEomErrLcy" 252 "FId_CoESSBlowrVld" 253 "FId_CoETM" 254 "FId_CoETS_StTrqLimErr1" 255 "FId_CoETS_StTrqLimErr2" 256 "FId_CoEngStopEnblStSpEngT" 257 "FId_CoEngStopEnblStSpLSU" 258 "FId_CoEngStopEnblStSpTcT" 259 "FId_CoEngStopEnblSysErr" 260 "FId_CoEngVlvLftSpIntk" 261 "FId_CoPOMStrtgDevStrtr" 262 "FId_CoPOM_FirstStrtAut" 263 "FId_CoTS_SwtOff" 264 "FId_CoVOMACCComFailr" 265 "FId_CoVOMBrkPedISABSigFailr" 266 "FId_CoVOMEngCrkAbort" 267 "FId_CoVOMEngRstrtEnaCdn" 268 "FId_CoVOMISSEng" 269 "FId_ComACRly" 270 "FId_ComAPPSensFail" 271 "FId_ComAPedl" 272 "FId_ComAYCA" 273 "FId_ComAYCAMon" 274 "FId_ComAYCD" 275 "FId_ComAYCDMon" 276 "FId_ComAYCF" 277 "FId_ComAYCFMon" 278 "FId_ComAYCG" 279 "FId_ComAYCGMon" 280 "FId_ComAYCI" 281 "FId_ComAYCIMon" 282 "FId_ComAirPThrUsSnsrErr" 283 "FId_ComAltFail" 284 "FId_ComAppVehSnsrFailr" 285 "FId_ComBCM1" 286 "FId_ComBCM1Mon" 287 "FId_ComBCMUnitCfmdErr" 288 "FId_ComBCMUnitNotTstd" 289 "FId_ComBstCtrl" 290 "FId_ComCANVEHICLEBusOff" 291 "FId_ComCGW1" 292 "FId_ComCGW1Mon" 293 "FId_ComClthSt" 294 "FId_ComConvClth" 295 "FId_ComCrCtlReq" 296 "FId_ComCrsMaiIndcnLampReq" 297 "FId_ComCrsSetIndcnLampReq" 298 "FId_ComDCDCCdn" 299 "FId_ComDCDCErr" 300 "FId_ComDesGearCurr" 301 "FId_ComDetrmAirM" 302 "FId_ComDwnShiftCtrlReq" 303 "FId_ComEAT1" 304 "FId_ComEAT10" 305 "FId_ComEAT10Mon" 306 "FId_ComEAT11" 307 "FId_ComEAT11Mon" 308 "FId_ComEAT12" 309 "FId_ComEAT12Mon" 310 "FId_ComEAT13" 311 "FId_ComEAT13Mon" 312 "FId_ComEAT1Mon" 313 "FId_ComEAT2" 314 "FId_ComEAT2Mon" 315 "FId_ComEAT4" 316 "FId_ComEAT4Mon" 317 "FId_ComEAT6" 318 "FId_ComEAT6Mon" 319 "FId_ComEAT7" 320 "FId_ComEAT7Mon" 321 "FId_ComEAT8" 322 "FId_ComEAT8Mon" 323 "FId_ComEATA" 324 "FId_ComEATAMon" 325 "FId_ComEATB" 326 "FId_ComEATBMon" 327 "FId_ComEATC" 328 "FId_ComEATCMon" 329 "FId_ComEBSSelfDiagErr" 330 "FId_ComECUHwErr" 331 "FId_ComEGRVlvErr" 332 "FId_ComEMSIntAirTemp" 333 "FId_ComEPB" 334 "FId_ComEPBB" 335 "FId_ComEPBBMon" 336 "FId_ComEPBMon" 337 "FId_ComEPS1" 338 "FId_ComEPS1Mon" 339 "FId_ComEPSUnitCfmdErr" 340 "FId_ComEPSUnitNotTstd" 341 "FId_ComEngBrkOvrdInfo" 342 "FId_ComEngBrkOvrdMtr" 343 "FId_ComEngBrkSwErr" 344 "FId_ComEngPosng" 345 "FId_ComEngRPMLim" 346 "FId_ComEngTrqLim" 347 "FId_ComEnvtlAirPSnsrErr" 348 "FId_ComEstmTqNormJdg" 349 "FId_ComEthnlSErr" 350 "FId_ComFlSply" 351 "FId_ComFuCnsBitDurgIdleStop" 352 "FId_ComGEVCntrl" 353 "FId_ComGbxNPosFail" 354 "FId_ComGbxTemp" 355 "FId_ComGwIMG1" 356 "FId_ComGwIMG1Mon" 357 "FId_ComGwIMG3" 358 "FId_ComGwIMG3Mon" 359 "FId_ComGwIMG4" 360 "FId_ComGwIMG4Mon" 361 "FId_ComGwIMG5" 362 "FId_ComGwIMG5Mon" 363 "FId_ComGwIMG6" 364 "FId_ComGwIMG6Mon" 365 "FId_ComHFMSnsrErr" 366 "FId_ComIDASB" 367 "FId_ComIDASBMon" 368 "FId_ComIDASBUnitCfmdErr" 369 "FId_ComIDASBUnitNotTstd" 370 "FId_ComIDASEngFail" 371 "FId_ComIDASEngFailMil" 372 "FId_ComIMGUnitCfmdErr" 373 "FId_ComIMGUnitNotTstd" 374 "FId_ComISG2" 375 "FId_ComIgnCtrl" 376 "FId_ComInjCtrl" 377 "FId_ComIntkAirPSnsrErr" 378 "FId_ComLamCtrl" 379 "FId_ComMETA" 380 "FId_ComMETAMon" 381 "FId_ComMETC" 382 "FId_ComMETCMon" 383 "FId_ComMETD" 384 "FId_ComMETDMon" 385 "FId_ComMETE2" 386 "FId_ComMETE2Mon" 387 "FId_ComMETF" 388 "FId_ComMETFMon" 389 "FId_ComMETG" 390 "FId_ComMETGMon" 391 "FId_ComMETH" 392 "FId_ComMETH2" 393 "FId_ComMETH2Mon" 394 "FId_ComMETHMon" 395 "FId_ComMETI" 396 "FId_ComMETIMon" 397 "FId_ComMETK" 398 "FId_ComMETKMon" 399 "FId_ComMETL" 400 "FId_ComMETLMon" 401 "FId_ComMETM" 402 "FId_ComMETMMon" 403 "FId_ComMETN" 404 "FId_ComMETNMon" 405 "FId_ComMETUnitCfmdErr" 406 "FId_ComMETUnitNotTstd" 407 "FId_ComMisf" 408 "FId_ComMon" 409 "FId_ComNTrbn" 410 "FId_ComODOff" 411 "FId_ComOilLvlLamp" 412 "FId_ComOilPWarnLamp" 413 "FId_ComPASensFail" 414 "FId_ComPBSensFail" 415 "FId_ComPCU" 416 "FId_ComPCUMon" 417 "FId_ComPosActnSpdLimrFctReq" 418 "FId_ComSRS" 419 "FId_ComSRSA" 420 "FId_ComSRSAMon" 421 "FId_ComSRSB" 422 "FId_ComSRSBMon" 423 "FId_ComSRSMon" 424 "FId_ComSRSUnitCfmdErr" 425 "FId_ComSRSUnitNotTstd" 426 "FId_ComSTFlt" 427 "FId_ComSpdLimrDevActvn" 428 "FId_ComTCU01" 429 "FId_ComTCU02" 430 "FId_ComTCU1" 431 "FId_ComTCU11" 432 "FId_ComTCU12" 433 "FId_ComTCU13" 434 "FId_ComTCU14" 435 "FId_ComTCU2" 436 "FId_ComTCU3" 437 "FId_ComTCU4" 438 "FId_ComTCUGear" 439 "FId_ComTarGearDwnShift" 440 "FId_ComTarGearUpShift" 441 "FId_ComThrPosnFail" 442 "FId_ComThrVlv" 443 "FId_ComTrboChrgnErr" 444 "FId_ComTrqAccuracySlow" 445 "FId_ComTrqReqFast" 446 "FId_ComTrqReqSlow" 447 "FId_ComVSAErr" 448 "FId_ComVSAUnitCfmdErr" 449 "FId_ComVSAUnitNotTstd" 450 "FId_ComVehSpdFlLvl" 451 "FId_ComVehSpdFltChk" 452 "FId_ComVehSpdImpsErr" 453 "FId_ComVlvLftCtrl" 454 "FId_ComvolEng" 455 "FId_ConvLdCalcLvrPos" 456 "FId_ConvLdNTrbnCan" 457 "FId_ConvLdOilCoolrPmp" 458 "FId_ConvLdOilTemp" 459 "FId_ConvLdTrqLdCan" 460 "FId_ConvLdVel" 461 "FId_CooltTVldyTMdl" 462 "FId_CptProtnCamsft" 463 "FId_CptProtnExhTempMdl" 464 "FId_CptProtnO2SnsrB1" 465 "FId_CptProtnVVeh" 466 "FId_CrCUI1EFRxErr" 467 "FId_CrCUICANRxErr" 468 "FId_CrCUIFCMRxErr" 469 "FId_CrCUIMETDRxErr" 470 "FId_CrCtlACCRxErr" 471 "FId_CrCtlAppSnsrErr" 472 "FId_CrCtlShutOffEng" 473 "FId_CstrPurgGnrlTstrReq" 474 "FId_DAGRS" 475 "FId_DELibBrkBstP" 476 "FId_DELibCEngDsT" 477 "FId_DELibCEngUsT" 478 "FId_DELibEngDatEng" 479 "FId_DELibEnvP" 480 "FId_DELibEnvT" 481 "FId_DELibFuelT" 482 "FId_DELibIntkAirT" 483 "FId_DELibNRCat" 484 "FId_DELibOilP" 485 "FId_DELibOilSwmpT" 486 "FId_DELibPRelPfilDs" 487 "FId_DELibTEGRClrLPDs" 488 "FId_DEONVEBPEnv" 489 "FId_DEONVTCCpv1DteskLoLoadStuckClsd" 490 "FId_DEONVTCCpv1DteskLoLoadStuckOpen" 491 "FId_DIUMPRCldStrtMon" 492 "FId_DIUMPREvapMon" 493 "FId_DIUMPRGenDenom1" 494 "FId_DIUMPRGenDenom1PDTC" 495 "FId_DIUMPRGenDenom2" 496 "FId_DIUMPRGenDenom3" 497 "FId_DIUMPRIgn" 498 "FId_DOGov" 499 "FId_DSMWarmUpCycle" 500 "FId_DTESKEBCpv1DteskLoLoadStuckClsd" 501 "FId_DTESKEBCpv1DteskLoLoadStuckOpen" 502 "FId_DTESKEnvCondVld" 503 "FId_DTESKFuLvlCondVld" 504 "FId_DTESKvfz" 505 "FId_DdskvFraTstd" 506 "FId_DdskvOraTstd" 507 "FId_DewDetTKAMax" 508 "FId_DiagBlkdLine" 509 "FId_DiagCpv1DteskLoLoad" 510 "FId_DkrsaEpmNoSig" 511 "FId_EBBCANErrFrzVal" 512 "FId_EBBCANErrReplVal" 513 "FId_EGLZSR" 514 "FId_EGRVlvActrOff" 515 "FId_EGRVlvCldStrt" 516 "FId_EGRVlvClnVrfy" 517 "FId_EGRVlvCtrlErr" 518 "FId_EGRVlvEngTempDef" 519 "FId_EGRVlvFailSafeActv" 520 "FId_EGRVlvFrzVal" 521 "FId_EGRVlvGovOn" 522 "FId_EGRVlvGovOnCld" 523 "FId_EGRVlvGovrOnRelsFct" 524 "FId_EGRVlvILimn" 525 "FId_EGRVlvIni" 526 "FId_EGRVlvMon" 527 "FId_EGRVlvOfsLrnInhib" 528 "FId_EGRVlvPhysRng" 529 "FId_EGRVlvPsSwtOff" 530 "FId_EGRVlvPwrStgMonDis" 531 "FId_EGRVlvRplVal" 532 "FId_EGRVlvSSpMon" 533 "FId_EGRVlvSnsrErr" 534 "FId_EGRVlvTempCmp" 535 "FId_EGRVlvTempMdlEEPErr" 536 "FId_EGRVlvTmpErrCnt" 537 "FId_EGRVlvTrlPtr" 538 "FId_EGRVlv_VehvErr" 539 "FId_EGRVlviActIEfcLimn" 540 "FId_EGRVlvpDsbcInvld" 541 "FId_EGSDO2OffsRstDsmS1B1" 542 "FId_EGSDO2_LamOffsSlowS1" 543 "FId_EGSDO2_RstFltSuspcnOffsB1" 544 "FId_EGSDUS2B1DlyEvln" 545 "FId_EGSDUS2B1LtrDly" 546 "FId_EGSDUS2B1LtrPT1" 547 "FId_EGSDUS2B1PT1Evln" 548 "FId_EGSDUS2B1RtlDly" 549 "FId_EGSDUS2B1RtlPT1" 550 "FId_EGSDUS2B1TarEvln" 551 "FId_EGSDUS2B1TarLean" 552 "FId_EGSDUS2B1TarRich" 553 "FId_EGSSigO2S1B1" 554 "FId_ELZSR" 555 "FId_EPBErr" 556 "FId_EPBFrmErr" 557 "FId_EPBFrmErrClth" 558 "FId_ETHSCPErrDrvCyc" 559 "FId_EVPComFailr" 560 "FId_EbsLinErr" 561 "FId_ElecLdComErr" 562 "FId_ElecLdFrzVal" 563 "FId_ElecLdHdLiComErr" 564 "FId_ElecLdRplVal" 565 "FId_ElecLoadEPSComErr" 566 "FId_EngBlkTWrn" 567 "FId_EngCooltTFail" 568 "FId_EngDemTqLimnCamsftErr" 569 "FId_EngDemTqLimnErrThmstHeatCtrlCirc" 570 "FId_EngDemTqLimnOilPmp" 571 "FId_EngDemTrqLimErrAPP" 572 "FId_EngIntkAirFail" 573 "FId_EngPrtErrVehV" 574 "FId_EngSpd30DegFail" 575 "FId_EngStrtEnaEthAdap" 576 "FId_EngStrt_EnaCep" 577 "FId_EngStrt_InjProhb" 578 "FId_EngStrt_VehVInhb" 579 "FId_EngTqRvsnEnaFlg" 580 "FId_EnvTPrimMod" 581 "FId_EnvTPrimModIniVal" 582 "FId_EnvTSensSum" 583 "FId_EnvTtAirFltDs" 584 "FId_EnvTtCEngDsT" 585 "FId_EnvTtIntkMnfld" 586 "FId_EomCvoAllwd" 587 "FId_EpmBCr" 588 "FId_EpmCaSAdapCaSI1" 589 "FId_EpmCaSAdapRstI1" 590 "FId_EpmCaSDiagI1" 591 "FId_EpmCaSErrCaSI1" 592 "FId_EpmCaSOfsDiagCaSI1" 593 "FId_EpmCaSOfsErrCaSI1" 594 "FId_EpmCaSSegI1" 595 "FId_EpmCaSSpdPlausI1" 596 "FId_EpmCrSDiag" 597 "FId_EpmCrSDiagVeh" 598 "FId_EpmCrSErr" 599 "FId_EpmOpMode_ALELock" 600 "FId_EpmOpMode_DirStLock" 601 "FId_EpmRRSCrSFaultCheck" 602 "FId_EpmRRSDGIFaultCheck" 603 "FId_EpmRRSRdCheck" 604 "FId_EpmRRSVehVFaultChck" 605 "FId_EpmSynLockCaSSync" 606 "FId_EpmTmpSuppRvsRotCASI1" 607 "FId_EtaEngIdleNonCsers" 608 "FId_EtaEngPtlNonCsers" 609 "FId_EthnlSnsrErrCdn" 610 "FId_EvapActrCcvElecDiag" 611 "FId_EvapPSnsrTankPhyRngChk" 612 "FId_FanCtlACClntP" 613 "FId_FanCtlACGModFail" 614 "FId_FanCtlAPP1" 615 "FId_FanCtlAPP2" 616 "FId_FanCtlAPPSync" 617 "FId_FanCtlBlowrU" 618 "FId_FanCtlCooltT" 619 "FId_FanCtlCooltT2" 620 "FId_FanCtlEnvT" 621 "FId_FanCtlLiSwtInfo" 622 "FId_FanCtlSpd" 623 "FId_FanCtlTSnsrErr" 624 "FId_FanCtlThr1" 625 "FId_FanCtlThr2" 626 "FId_FcoReq" 627 "FId_FiMFID_rba_MRly_Diag_Stk" 628 "FId_FlComErr" 629 "FId_FlDevPlauDiagFuSnsr" 630 "FId_FlLvlNoSigErr" 631 "FId_FlLvlVehSpdSigErr" 632 "FId_FlLvlVehVErr" 633 "FId_FlMALamDynDiag" 634 "FId_FlSplGAltLin" 635 "FId_FlTnkQnt" 636 "FId_FuMixHotFilmErr" 637 "FId_FuMixUegoErrExcl" 638 "FId_FuPHiRailEthnlSnsrErr" 639 "FId_FuPurg_TEVError" 640 "FId_FuSnsrPhyRngErr" 641 "FId_GEVCtlAVCAdprCBBNWEErrIntk" 642 "FId_GEVCtlAVCAdprIntkB1" 643 "FId_GEVCtlAVCAdprNWSEErrIntk" 644 "FId_GEVCtlAdpnEnaIntk" 645 "FId_GEVCtlAdpnEnaShtrpActv" 646 "FId_GEVCtlClngIntk" 647 "FId_GEVCtlMinOvlIntk" 648 "FId_GEVCtlPOilSnsr" 649 "FId_GEVCtlPhaEnaIntk" 650 "FId_GEVCtlPhaSpTstrIntk" 651 "FId_GEVCtlRefAdpnMntChck" 652 "FId_GEVCtlRefAdpnMntChckTstd" 653 "FId_GEVCtlReqRefAdpnTstrIntk" 654 "FId_GEVCtlReqRefAdpnTstrIntkTstd" 655 "FId_GEVCtlVlvLftEnaIntk" 656 "FId_GEVCtlVlvOpenClsdIntkB1" 657 "FId_GEVlvLockPinDiagIntkB1" 658 "FId_GEVlvPhaDiagEnaCsersIntkB1" 659 "FId_GEVlvPhaDiagEnaIntkB1" 660 "FId_GEVlvPhaPsIntkB1" 661 "FId_GbxAnNeutPosnErr" 662 "FId_GbxCANDigPlausErr" 663 "FId_GbxCANNeutSigErr" 664 "FId_GbxPNPosSig" 665 "FId_GbxPNPosnComErr" 666 "FId_GbxPNPosnDiagDrvCdnRels" 667 "FId_GbxPNPosnDiagDrvCodnHealRels" 668 "FId_GbxPNPosnDiagPlausyRels" 669 "FId_GbxPNPosnSubsVal" 670 "FId_GbxRvsSwtStk" 671 "FId_GbxSnsrSplyUErr" 672 "FId_GbxSpstReqOk" 673 "FId_GlbDaLSumvXPtd" 674 "FId_GslThrVlvSnsrDiagB1" 675 "FId_HEGOS2B1DElec" 676 "FId_HEGOS2B1DHtg" 677 "FId_HEGOS2B1Htg" 678 "FId_HEGOS2B1HtrPsSt" 679 "FId_HEGOS2B1InVld" 680 "FId_HEGOS2B1LSPsDiaDi" 681 "FId_HLSDemBrkFlt" 682 "FId_HLSDemErr1" 683 "FId_HLSDemErr2" 684 "FId_HLSDemIntkAirTemp" 685 "FId_HLSDemMotTemp" 686 "FId_HLSDemMstCyldpVld" 687 "FId_HLSDemSpdClthGearAccrSigErr" 688 "FId_HLSDem_DrvOffSuprt" 689 "FId_HLSDem_DrvOffSuprtBrkHldSys" 690 "FId_HLSDem_DrvOffSuprtLAS" 691 "FId_HLSDem_PModeActv" 692 "FId_HLSDem_TModeActv" 693 "FId_HLSDem_TraSubFcn" 694 "FId_HLSDem_nMaxLimErr1" 695 "FId_HLSDem_nMaxLimErr2" 696 "FId_HLSDem_nMaxLimErr3" 697 "FId_HLSDem_nMaxVErr" 698 "FId_I14229APP" 699 "FId_I14229CANErr" 700 "FId_I14229FlLvlFltComErr" 701 "FId_I14229VTCErr" 702 "FId_IMGISABComErr" 703 "FId_InhbLamDynS1B1" 704 "FId_InhbnBlkdLineDiag" 705 "FId_InhibitAlways" 706 "FId_InhibitNever" 707 "FId_InjSysMulInjDiagErr" 708 "FId_InjVlvPs_Bank1OnlyErr" 709 "FId_InjVlvPs_Bank1Tested" 710 "FId_InjVlvPs_Bank2OnlyErr" 711 "FId_InjVlvPs_Bank2Tested" 712 "FId_InjVlvPs_Bank3OnlyErr" 713 "FId_InjVlvPs_Bank3Tested" 714 "FId_IntkAirTAirFltDsCrssChk" 715 "FId_IntkAirTAirFltDsPlausChk" 716 "FId_IntkAirTIntkMnfldCrssChk" 717 "FId_IntkAirTIntkMnfldPlausChk" 718 "FId_IntkAirTIntkMnfldRepl" 719 "FId_IntkAirTSnsr1Elec" 720 "FId_IntkAirTSnsr1PRC" 721 "FId_IntkAirTSnsr1Sum" 722 "FId_IntkAirTSnsr2Elec" 723 "FId_IntkAirTSnsr2PRC" 724 "FId_IntkAirTSnsr2Sum" 725 "FId_IntkArTempENGB" 726 "FId_LIGovDfrstI" 727 "FId_LIGovUndrBrk" 728 "FId_LINDCDCRxErr" 729 "FId_LLimAppSnsrErr" 730 "FId_LLimAppSnsrSyncErr" 731 "FId_LLimMTVehSpdSnsrErr" 732 "FId_LLimShutOffEng" 733 "FId_LRSEBMisf" 734 "FId_LZSR" 735 "FId_LeakToMnfld" 736 "FId_LeakToMnfldTstd" 737 "FId_LimpHomPsErrInjtr" 738 "FId_LinACGUnitCfmdErr" 739 "FId_LinACGUnitNotTstd" 740 "FId_LinAEVUnitCfmdErr" 741 "FId_LinAEVUnitNotTstd" 742 "FId_LinEBSUnitCfmdErr" 743 "FId_LinEBSUnitNotTstd" 744 "FId_LowPresOilP" 745 "FId_MFlowAirCrkcsSubVal" 746 "FId_MFuOilMax" 747 "FId_MaiLoadSnsr" 748 "FId_MaiShaftFailr" 749 "FId_MfPsDia1" 750 "FId_MisfDetDnAdpn" 751 "FId_MisfDetDnAdpnPlaus" 752 "FId_MisfDetEnvP" 753 "FId_MisfDetSegTiAdpnFco" 754 "FId_MisfDetShtrpAct" 755 "FId_MisfDetStc" 756 "FId_MisfDetV" 757 "FId_MisfDetVWhlFrntLe" 758 "FId_MisfDetVWhlFrntRi" 759 "FId_MisfDetVWhlReLe" 760 "FId_MisfDetVWhlReRi" 761 "FId_NLimVehHalt" 762 "FId_NSHTDAmbT" 763 "FId_NSHTDEngT" 764 "FId_NSHTILimHiAltiLoIdleSp" 765 "FId_NeutPosnFailr" 766 "FId_O2StorgMdlMD" 767 "FId_OilCmbdSen_LvlDfctHW" 768 "FId_OilPCtrlVlvNpl" 769 "FId_OilPFrzVal" 770 "FId_OilPPlaus" 771 "FId_OilPPlausAftRun" 772 "FId_OilPPlausMax" 773 "FId_OilPPlausMin" 774 "FId_OilPPlausT15" 775 "FId_OilPRplVal" 776 "FId_OilPSnsrErr" 777 "FId_OilPSwmpSRC" 778 "FId_OilSwmpTCEngDsTWrmUp" 779 "FId_OilSwmpT_B_tospg" 780 "FId_OilSwmpT_B_tospgg" 781 "FId_OilSwmpT_CmbdSnsrErr" 782 "FId_OilSwmpT_CmbdSnsrTiTErr" 783 "FId_OilSwmpT_EnvT" 784 "FId_OilSwmpT_TSnsrErr" 785 "FId_PEnvMeasVld" 786 "FId_PEnvModel" 787 "FId_PEnvPlausDiagVDD" 788 "FId_PEnvRawVldVDD" 789 "FId_PEnvRefSnsr" 790 "FId_PEnvSigRngVld" 791 "FId_PEnvSnsrPlausVDD" 792 "FId_PEnvVldVDD" 793 "FId_PIDA6SigSrcErr" 794 "FId_PIntkMnfldPlaus" 795 "FId_PIntkVUsElecDiagB1" 796 "FId_PSPCtlDisbl" 797 "FId_PSPCtlIntkAirVapLock" 798 "FId_PSPCtlPreRun" 799 "FId_PSPCtlVapLock" 800 "FId_PSPDiagDisbl" 801 "FId_PTGripConv" 802 "FId_PTGripConvStrt" 803 "FId_PTGripMnlClth" 804 "FId_PTGripMnlClthStrt" 805 "FId_PTTrqRatCANPtd" 806 "FId_PThrVlVUsVldB1" 807 "FId_PThrVlvUsMeasdVldB1" 808 "FId_P_VSE11_Diag" 809 "FId_PrmId03_FltRdnS1B1" 810 "FId_PrmId03_FltUegoS1B1" 811 "FId_RevLck" 812 "FId_RstAdpnPIntkMnfldAfs" 813 "FId_RvsPosnFailr" 814 "FId_SSEEPBRelease" 815 "FId_SSEFCANPRelease" 816 "FId_SSEPTCANPRelease" 817 "FId_SSEStartRelease" 818 "FId_SSEStartReleaseMTCl10" 819 "FId_SSEStartReleaseMTCl100" 820 "FId_SSEStartReleaseMTCl20" 821 "FId_SSEStartReleaseMTCl90" 822 "FId_SSEStartRequest" 823 "FId_SSEStopRelease" 824 "FId_SSEStrtStopRelease" 825 "FId_SSESysOff" 826 "FId_SSEUI2DCSysFailr" 827 "FId_SSEUIBCANErr" 828 "FId_SSEUISysFail" 829 "FId_SiaEEPErr" 830 "FId_SnglWhlErrDiagEna" 831 "FId_StrtCtlAutoCrkModeCdn" 832 "FId_StrtCtlComEngStrtErr" 833 "FId_StrtCtlNPCdnCncl" 834 "FId_StrtCtlNoCpuFailr" 835 "FId_StrtCtlNoFailCanLine" 836 "FId_StrtCtlNoFailPTCanLine" 837 "FId_StrtCtlPNPosnSubsVal" 838 "FId_StrtCtlSTMFailr" 839 "FId_StrtErrShaft" 840 "FId_SumErrHndlg" 841 "FId_SysDiagComErr" 842 "FId_SysDiagModInhbErr" 843 "FId_TOSPM" 844 "FId_TWCCILck" 845 "FId_TWCCILckExtd" 846 "FId_TWCCIRstB1" 847 "FId_TWCCIRstDSMClearB1" 848 "FId_TWCCLsuB1" 849 "FId_TWCCLsuCyc" 850 "FId_TWCCLsuDynB1" 851 "FId_TWCCMisfDetn" 852 "FId_TWCDPriCatParB1" 853 "FId_TWCDPriCatVldnB1" 854 "FId_TankPCpv1DteskLoLoadStuckClsd" 855 "FId_TankPCpv1DteskLoLoadStuckOpen" 856 "FId_TankPSnsrElecChkVld" 857 "FId_ThrVlvMon" 858 "FId_ThrVlvOffsLrnPrmsB1" 859 "FId_TiOffTBasdChkFast" 860 "FId_TiOffTBasdChkSlow" 861 "FId_TiOffVdClk" 862 "FId_TqDecelOffsInhb" 863 "FId_TraAddAirCANPtd" 864 "FId_TraAddClntCANPtd" 865 "FId_TraFwdRvsCluInfo" 866 "FId_TraGbxNPos" 867 "FId_TraGearInfoCanCom" 868 "FId_TraGearInfoDet" 869 "FId_TraGearInfoGearShftActv" 870 "FId_TraGearInfoInfoCan" 871 "FId_TraGearInfoLevPos" 872 "FId_TraGearInfoLoRng" 873 "FId_TraGearInfoRTra" 874 "FId_TraGearInfoRevGear" 875 "FId_TraGearReq" 876 "FId_TraNoShftIdctr" 877 "FId_TraPrtGearCANPtd" 878 "FId_TraPrtGearIndpdtProblem" 879 "FId_TraRPosn" 880 "FId_TraRtnIntfcASTIntv" 881 "FId_TraRtnIntfcIdlSetP" 882 "FId_TraRtnIntfcNMaxCan" 883 "FId_TraRtnIntfcNMaxVel" 884 "FId_TraTrqRedLmpHmeDec" 885 "FId_TraTrqRedLmpHmeInc" 886 "FId_TraTrqRedPTCanErr" 887 "FId_TraTrqRedTIIntvDes" 888 "FId_TraTrqRedTIIntvLead" 889 "FId_TraTrqRedTSCIntvDes" 890 "FId_TraTrqRedTSCIntvLead" 891 "FId_TraTrsmTypHw" 892 "FId_TranIdleDes" 893 "FId_UEGOHeatgUpRglS1B1" 894 "FId_UEGOHeatrCtrlS1B1" 895 "FId_UEGOHeatrPrfmncDiagRelsS1B1" 896 "FId_UEGOHeatrPwrStgDiagRelsS1B1" 897 "FId_UEGOModCtrlRelsS1B1" 898 "FId_UEGOStrtDiagInhRprtErrS1B1" 899 "FId_UEGOStrtDiagRelsS1B1" 900 "FId_UEGOTCeramicRelsS1B1" 901 "FId_UegoDiagRelsBattSplyOk" 902 "FId_UegoDiagSigEcuAsicS1B1" 903 "FId_UegoDiagSigEcuComS1B1" 904 "FId_UegoDiagSigOperPlausS1B1" 905 "FId_UegoDiagSigSnsrS1B1" 906 "FId_UegoDiagSigWireOlS1B1" 907 "FId_UegoDiagSigWireScS1B1" 908 "FId_UegoDiagSigWireScTstdS1B1" 909 "FId_UegoInhbOperRelsS1B1" 910 "FId_UegoO2HiPrcsnS1B1" 911 "FId_UegoO2PlausErrS1B1" 912 "FId_UegoO2VldS1B1" 913 "FId_UegoOperPlausBattSplyOk" 914 "FId_UegoPlausErrHndlg" 915 "FId_VMSIDCSRmpShOff" 916 "FId_VMSIDCSShOff" 917 "FId_VMSITCSRmpShOff" 918 "FId_VMSITCSShOff" 919 "FId_VSACANErr" 920 "FId_VehStcACGFailr" 921 "FId_VehStcBattMngFailr" 922 "FId_VehStcDCDCFailr" 923 "FId_VehStcEBSFailr" 924 "FId_VehStcMisf" 925 "FId_VehStcMtrComFailr" 926 "FId_VehStcNVMFailr" 927 "FId_VehVCANFrzVal" 928 "FId_VehVCANReplVal" 929 "FId_VehVCanSafeFrzVal" 930 "FId_VehVCanSafeReplVal" 931 "FId_VehVCom" 932 "FId_VehVExcdLim" 933 "FId_VehVFrzVal" 934 "FId_VehVNCSnsrElecFailr" 935 "FId_VehVOBDFrzVal" 936 "FId_VehVOBDReplVal" 937 "FId_VehVOutCanErr" 938 "FId_VehVPWMFrzVal" 939 "FId_VehVPWMReplVal" 940 "FId_VehVPhysRng" 941 "FId_VehVPlaus" 942 "FId_VehVPlausCan" 943 "FId_VehVPlausFco" 944 "FId_VehVPlausPwr" 945 "FId_VehVPlausV2N" 946 "FId_VehVReplVal" 947 "FId_VehVSigCan" 948 "FId_VehVSigCanSafe" 949 "FId_VehVSngWhlCanFrzVal" 950 "FId_VehVSngWhlCanReplVal" 951 "FId_VehVSnsrARngHi" 952 "FId_VehVSnsrBRngHi" 953 "FId_VehVSpdRtyDiag" 954 "FId_VehVSpdSnsrAElecFailr" 955 "FId_VehVSpdSnsrBElecFailr" 956 "FId_VehVvFLWhlSpd" 957 "FId_VehVvFRWhlSpd" 958 "FId_VehVvRLWhlSpd" 959 "FId_VehVvRRWhlSpd" 960 "FId_VldtLamDynS1B1" 961 "FId_VlvLftFbIntkOilPSnsr11SRC" 962 "FId_VlvLftFbSwtIntk11Diag" 963 "FId_ZGLZSR" 964 "FId_airIntkFltSnsrKnkPrtnIgn" 965 "FId_ctrladpncvo" 966 "FId_stChkChgnSys" 967 "FId_stChkChgnSys2DC" 968 "FId_tFltSnsrKnkPrtnIgn" DEFAULT_VALUE "---" /end COMPU_VTAB
/begin COMPU_METHOD OneToOne "" RAT_FUNC "%6.2" "-" COEFFS 0 1 0 0 0 1 /end COMPU_METHOD
/begin RECORD_LAYOUT ValA_Wu16 FNC_VALUES 1 UWORD COLUMN_DIR DIRECT /end RECORD_LAYOUT
/end MODULE
/end PROJECT
