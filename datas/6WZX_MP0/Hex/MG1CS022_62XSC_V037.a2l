ASAP2_VERSION 1 60
/begin PROJECT MG1CS022 "MG1CS022"
/begin HEADER "" VERSION "MG1CS022_62XSC_V037" PROJECT_NO MG1CS022 /end HEADER
/begin MODULE DIM ""
/begin MOD_COMMON "" BYTE_ORDER MSB_LAST ALIGNMENT_BYTE 1 ALIGNMENT_WORD 2 ALIGNMENT_LONG 4 ALIGNMENT_INT64 4 ALIGNMENT_FLOAT32_IEEE 4 ALIGNMENT_FLOAT64_IEEE 4 DATA_SIZE 32 /end MOD_COMMON
/begin CHARACTERISTIC CoEOM_flgFpcDiOnlyWithTransAct_C "Demand to close the purge canister valve only with engine operating mode switches with transient phases." VALUE 0x8057AB94 RB_Val_Wu8 1.00000000000 B_TRUE 0.00 1.00000000000 FORMAT "%13.11" /end CHARACTERISTIC
/begin CHARACTERISTIC Com_dPCUMaxDiff_C "Application constant for Maximum difference for PCU frame" VALUE 0x8057DE70 RB_Val_Wu8 255.0 OneToOne 0.00 255.0 FORMAT "%5.1" /end CHARACTERISTIC
/begin CHARACTERISTIC Com_dPCUMaxPer_C "Threshold for detection of stopped message counter for CAN frame PCU" VALUE 0x8057DE71 RB_Val_Wu8 255.0 OneToOne 0.00 255.0 FORMAT "%5.1" /end CHARACTERISTIC
/begin CHARACTERISTIC Com_stPCUEngStrtInhb_C "Default value for the status of engine start inhibition flag" VALUE 0x8057DE72 RB_Val_Wu8 1.000 OneToOne 0.00 1.000 FORMAT "%5.3" EXTENDED_LIMITS 0.00 255.0 /end CHARACTERISTIC
/begin CHARACTERISTIC CWFWNWAPP "Codeword to enable factor camshaft angle from calibration value" VALUE 0x8057D2AA RB_Val_Wu8 255.0 dez 0.00 255.0 FORMAT "%5.1" /end CHARACTERISTIC
/begin CHARACTERISTIC CWNLKO "codeword for application of limp-home operation mode" VALUE 0x8057C712 RB_Val_Wu16 65535.00 dez 0.00 65535.00 FORMAT "%8.2" /end CHARACTERISTIC
/begin CHARACTERISTIC CWNSAC "Codeword for configuration of NSAC" VALUE 0x8057C716 RB_Val_Wu8 255.0 OneToOne 0.00 255.0 FORMAT "%5.1" /end CHARACTERISTIC
/begin CHARACTERISTIC CWNSKH "Codeword for idle-speed while catalyst-heating" VALUE 0x8057CC36 RB_Val_Wu16 65535.00 dez 0.00 65535.00 FORMAT "%8.2" /end CHARACTERISTIC
/begin CHARACTERISTIC CWNWFW "Codeword to enable calculation of interpolation factor based on actual and target camshaft position" VALUE 0x8057D2AB RB_Val_Wu8 255.0 dez 0.00 255.0 FORMAT "%5.1" /end CHARACTERISTIC
/begin CHARACTERISTIC CWTOSPM "code word for configuration model oil temperature in sump" VALUE 0x8057D7AC RB_Val_Wu8 255.0 dez 0.00 255.0 FORMAT "%5.1" /end CHARACTERISTIC
/begin CHARACTERISTIC CWTOSPM2 "code word 2 for configuration model oil temperature in sump" VALUE 0x8057D7AD RB_Val_Wu8 255.0 dez 0.00 255.0 FORMAT "%5.1" /end CHARACTERISTIC
/begin CHARACTERISTIC DTAHLL "Delta tans for stopping hot idling" VALUE 0x8057C8FC RB_Val_Wu8 191.3 temp_ub_b191p25 0.00 191.3 FORMAT "%5.1" /end CHARACTERISTIC
/begin CHARACTERISTIC DTMHLL "Delat tmot for stopping hot idling" VALUE 0x8057C8FD RB_Val_Wu8 191.3 temp_ub_b191p25 0.00 191.3 FORMAT "%5.1" /end CHARACTERISTIC
/begin CHARACTERISTIC DWFWNWE "delta angle for band at desired inlet camshaft position" VALUE 0x8057D2AC RB_Val_Ws16 511.9922 kw_sw_q0p0078 -256.0000 255.9922 FORMAT "%8.4" /end CHARACTERISTIC
/begin CHARACTERISTIC DWFWNWEK "Delta angle for band at desired inlet camshaft position for low valve lift" VALUE 0x8057D2AE RB_Val_Ws16 511.9922 kw_sw_q0p0078 -256.0000 255.9922 FORMAT "%8.4" /end CHARACTERISTIC
/begin CHARACTERISTIC ExhMgT_facCatWrmIdleN_M "Weighting factor for idle speed control because of Catalyst Keeping Warm request" MAP 0x8057CC38 RB_Map_S16U16_U16 3.999939 fak_uw_b4 0.00 3.999939 FORMAT "%8.6"
 /begin AXIS_DESCR STD_AXIS tmchtslo_w Temp_Cels 8 -3549.940 3003.560 FORMAT "%8.3" DEPOSIT ABSOLUTE /end AXIS_DESCR
 /begin AXIS_DESCR STD_AXIS frhokor_w_msg fak_uw_b4 4 0.00 3.999939 FORMAT "%8.6" DEPOSIT ABSOLUTE /end AXIS_DESCR
/end CHARACTERISTIC
/begin CHARACTERISTIC ExhMgT_facHeatgProgsIdleSpdCorrnDrvgPosn_M "map for control of engine idle speed during catalyst heating and engaged driving position in dependence of heating progress and catalyst start temperature" MAP 0x8057CC94 RB_Map_U16S16_U16 1.999969 fak_uw_b2 0.00 1.999969 FORMAT "%8.6"
 /begin AXIS_DESCR STD_AXIS ExhMgT_facCatHeatgProgsNIdle fak_uw_b1 8 0.00 0.9999847 FORMAT "%9.7" DEPOSIT ABSOLUTE /end AXIS_DESCR
 /begin AXIS_DESCR STD_AXIS ExhMgT_tCatColdStrtIdleSpdReq Temp_Cels 4 -3549.940 3003.560 FORMAT "%8.3" DEPOSIT ABSOLUTE /end AXIS_DESCR
/end CHARACTERISTIC
/begin CHARACTERISTIC ExhMgT_facHeatgProgsIdleSpdCorrn_M "map for control of engine idle speed during catalyst heating in dependence of heating progress and catalyst start temperature" MAP 0x8057CCF0 RB_Map_U16S16_U16 1.999969 fak_uw_b2 0.00 1.999969 FORMAT "%8.6"
 /begin AXIS_DESCR STD_AXIS ExhMgT_facCatHeatgProgsNIdle fak_uw_b1 8 0.00 0.9999847 FORMAT "%9.7" DEPOSIT ABSOLUTE /end AXIS_DESCR
 /begin AXIS_DESCR STD_AXIS ExhMgT_tCatColdStrtIdleSpdReq Temp_Cels 4 -3549.940 3003.560 FORMAT "%8.3" DEPOSIT ABSOLUTE /end AXIS_DESCR
/end CHARACTERISTIC
/begin CHARACTERISTIC ExhMgT_nIdleCatHeatgDrvgPosn_M "desired nominal idling speed during catalyst heating in dependence of engine and catalyst temperature with engaged driving position" MAP 0x8057CD4C RB_Map_S16S16_U8 2550. nmot_q10 0.00 2550. FORMAT "%5.0"
 /begin AXIS_DESCR STD_AXIS ExhMgT_tEngCatHeatgIdle Temp_Cels 8 -3549.940 3003.560 FORMAT "%8.3" DEPOSIT ABSOLUTE /end AXIS_DESCR
 /begin AXIS_DESCR STD_AXIS ExhMgT_tCatColdStrtIdleSpdReq Temp_Cels 8 -3549.940 3003.560 FORMAT "%8.3" DEPOSIT ABSOLUTE /end AXIS_DESCR
/end CHARACTERISTIC
/begin CHARACTERISTIC ExhMgT_nIdleCatHeatgFlexFuVehDrvgPosn_M "desired nominal idling speed during catalyst heating with engaged driving position in dependence of engine and catalyst temperature for Flex-Fuel vehicles (QNTSTMOT_SY=0 and FFV)" MAP 0x8057CDB0 RB_Map_S16S16_U8 2550. nmot_q10 0.00 2550. FORMAT "%5.0"
 /begin AXIS_DESCR STD_AXIS ExhMgT_tEngCatHeatgIdle Temp_Cels 8 -3549.940 3003.560 FORMAT "%8.3" DEPOSIT ABSOLUTE /end AXIS_DESCR
 /begin AXIS_DESCR STD_AXIS ExhMgT_tCatColdStrtIdleSpdReq Temp_Cels 8 -3549.940 3003.560 FORMAT "%8.3" DEPOSIT ABSOLUTE /end AXIS_DESCR
/end CHARACTERISTIC
/begin CHARACTERISTIC ExhMgT_nIdleCatHeatgFlexFuVeh_M "desired nominal idling speed during catalyst heating in dependence of engine and catalyst temperature for Flex-Fuel vehicles (QNTSTMOT_SY=0 and FFV)" MAP 0x8057CE14 RB_Map_S16S16_U8 2550. nmot_q10 0.00 2550. FORMAT "%5.0"
 /begin AXIS_DESCR STD_AXIS ExhMgT_tEngCatHeatgIdle Temp_Cels 8 -3549.940 3003.560 FORMAT "%8.3" DEPOSIT ABSOLUTE /end AXIS_DESCR
 /begin AXIS_DESCR STD_AXIS ExhMgT_tCatColdStrtIdleSpdReq Temp_Cels 8 -3549.940 3003.560 FORMAT "%8.3" DEPOSIT ABSOLUTE /end AXIS_DESCR
/end CHARACTERISTIC
/begin CHARACTERISTIC ExhMgT_nIdleCatHeatg_M "desired nominal idling speed during catalyst heating in dependence of engine and catalyst temperature" MAP 0x8057CE78 RB_Map_S16S16_U8 2550. nmot_q10 0.00 2550. FORMAT "%5.0"
 /begin AXIS_DESCR STD_AXIS ExhMgT_tEngCatHeatgIdle Temp_Cels 8 -3549.940 3003.560 FORMAT "%8.3" DEPOSIT ABSOLUTE /end AXIS_DESCR
 /begin AXIS_DESCR STD_AXIS ExhMgT_tCatColdStrtIdleSpdReq Temp_Cels 8 -3549.940 3003.560 FORMAT "%8.3" DEPOSIT ABSOLUTE /end AXIS_DESCR
/end CHARACTERISTIC
/begin CHARACTERISTIC ExhMgT_nIdleSpdCatWrmDrvgPosn_M "desired nominal idling speed during catalyst warm up mode in dependence of engine and catalyst temperature with engaged driving position" MAP 0x8057CEDC RB_Map_S16S16_U8 2550. nmot_q10 0.00 2550. FORMAT "%5.0"
 /begin AXIS_DESCR STD_AXIS ExhMgT_tEngCatHeatgIdle Temp_Cels 8 -3549.940 3003.560 FORMAT "%8.3" DEPOSIT ABSOLUTE /end AXIS_DESCR
 /begin AXIS_DESCR STD_AXIS ExhMgT_tCatWrmIdleSpdReq Temp_Cels 8 -3549.940 3003.560 FORMAT "%8.3" DEPOSIT ABSOLUTE /end AXIS_DESCR
/end CHARACTERISTIC
/begin CHARACTERISTIC ExhMgT_nIdleSpdCatWrm_M "desired nominal idling speed during catalyst warm up mode in dependence of engine and catalyst temperature" MAP 0x8057CF40 RB_Map_S16S16_U8 2550. nmot_q10 0.00 2550. FORMAT "%5.0"
 /begin AXIS_DESCR STD_AXIS ExhMgT_tEngCatHeatgIdle Temp_Cels 8 -3549.940 3003.560 FORMAT "%8.3" DEPOSIT ABSOLUTE /end AXIS_DESCR
 /begin AXIS_DESCR STD_AXIS ExhMgT_tCatWrmIdleSpdReq Temp_Cels 8 -3549.940 3003.560 FORMAT "%8.3" DEPOSIT ABSOLUTE /end AXIS_DESCR
/end CHARACTERISTIC
/begin CHARACTERISTIC ExhMgT_stIdleSpdCust_C "Codeword for customer specific features for idle-speed while catalyst-heating" VALUE 0x8057CFA4 RB_Val_Wu16 65535.00 dez 0.00 65535.00 FORMAT "%8.2" /end CHARACTERISTIC
/begin CHARACTERISTIC ExhMgT_stIdleSpeedCatHeatg2_C "Additional codeword for the activation of function features of idle speed increase for catalyst heating" VALUE 0x8057CFA6 RB_Val_Wu16 65535.00 dez 0.00 65535.00 FORMAT "%8.2" /end CHARACTERISTIC
/begin CHARACTERISTIC ExhMgT_stIdleSpeedCatHeatg_C "code word for the function idle speed calculation for catalyst heating" VALUE 0x8057CFA8 RB_Val_Wu16 65535.00 dez 0.00 65535.00 FORMAT "%8.2" /end CHARACTERISTIC
/begin CHARACTERISTIC ExhMgT_tiDlyDrvgPosnNotEngd_C "Delay time for the information, that the driving position is not engaged anymore" VALUE 0x8057CFAA RB_Val_Wu8 25.50 t_q0p1 0.00 25.50 FORMAT "%5.2" /end CHARACTERISTIC
/begin CHARACTERISTIC ExhMgT_tiIdleSpdFltCatHeatgEndDrvgPosn_C "Time constant for filtering the desired nominal idle speed during no catalyst heating while driving position is engaged" VALUE 0x8057CFAB RB_Val_Wu8 25.4996 zk100msxs_ub_b25p5 0.1004 25.6000 FORMAT "%7.4" EXTENDED_LIMITS 0.100392 25.6000 /end CHARACTERISTIC
/begin CHARACTERISTIC ExhMgT_tiIdleSpdFltCatHeatgEnd_C "Time constant for filtering the desired nominal idle speed during no catalyst heating" VALUE 0x8057CFAC RB_Val_Wu8 25.4996 zk100msxs_ub_b25p5 0.1004 25.6000 FORMAT "%7.4" EXTENDED_LIMITS 0.100392 25.6000 /end CHARACTERISTIC
/begin CHARACTERISTIC ExhMgT_tiIdleSpdFltCatHeatgStrtDrvgPosn_C "Time constant for filtering the desired nominal idle speed during catalyst heating while driving position is engaged" VALUE 0x8057CFAD RB_Val_Wu8 25.4996 zk100msxs_ub_b25p5 0.1004 25.6000 FORMAT "%7.4" EXTENDED_LIMITS 0.100392 25.6000 /end CHARACTERISTIC
/begin CHARACTERISTIC ExhMgT_tiIdleSpdFltCatHeatgStrt_C "Time constant for filtering the desired nominal idle speed during catalyst heating" VALUE 0x8057CFAE RB_Val_Wu8 25.4996 zk100msxs_ub_b25p5 0.1004 25.6000 FORMAT "%7.4" EXTENDED_LIMITS 0.100392 25.6000 /end CHARACTERISTIC
/begin CHARACTERISTIC ExhMgT_tiIdleSpdFltCatWrmDrvgPosn_C "Time constant for filtering the desired nominal idle speed during catalyst warm up mode while driving position is engaged" VALUE 0x8057CFAF RB_Val_Wu8 25.4996 zk100msxs_ub_b25p5 0.1004 25.6000 FORMAT "%7.4" EXTENDED_LIMITS 0.100392 25.6000 /end CHARACTERISTIC
/begin CHARACTERISTIC ExhMgT_tiIdleSpdFltCatWrm_C "filter time constant for filtering of desired idle speed in case of catalyst heating because of catalyst warming" VALUE 0x8057CFB0 RB_Val_Wu8 25.4996 zk100msxs_ub_b25p5 0.1004 25.6000 FORMAT "%7.4" EXTENDED_LIMITS 0.100392 25.6000 /end CHARACTERISTIC
/begin CHARACTERISTIC ExhMgt_vVehThdCatHeatg_C "velocity threshold for trigger the reset condition for decrease idling speed during catalyst heating" VALUE 0x8057CFB2 RB_Val_Ws16 655.3500 Vel -327.6800 327.6700 FORMAT "%8.4" /end CHARACTERISTIC
/begin CHARACTERISTIC FWNWEAPP "Calibration value for factor camshaft angle intake" VALUE 0x8057D2B0 RB_Val_Wu8 0.9961 fak_ub_b1 0.00 0.9961 /end CHARACTERISTIC
/begin CHARACTERISTIC GANGKHLL "gear for start of ramping down idle speed in case of set drive position" VALUE 0x8057CFB4 RB_Val_Ws8 127.0 dez 0.00 127.0 FORMAT "%5.1" EXTENDED_LIMITS -128.0 127.0 /end CHARACTERISTIC
/begin CHARACTERISTIC KFFWNWE0 "offset base point fwnwe==0" MAP 0x8057D2B2 RB_Map_U16U16_S16 255.9922 kw_sw_q0p0078 0.00 255.9922 FORMAT "%8.4" EXTENDED_LIMITS -256.0000 255.9922
 /begin AXIS_DESCR STD_AXIS NO_INPUT_QUANTITY nmot_uw_q0p25 16 0.00 8191.750 FORMAT "%8.3" EXTENDED_LIMITS 0.00 16383.75 DEPOSIT ABSOLUTE /end AXIS_DESCR
 /begin AXIS_DESCR STD_AXIS NO_INPUT_QUANTITY rel_uw_q0p0234 12 0.00 1535.977 FORMAT "%8.3" DEPOSIT ABSOLUTE /end AXIS_DESCR
/end CHARACTERISTIC
/begin CHARACTERISTIC KFFWNWE0V "offset base point fwnwe==0, low valve lift" MAP 0x8057D46E RB_Map_U16U16_S16 255.9922 kw_sw_q0p0078 0.00 255.9922 FORMAT "%8.4" EXTENDED_LIMITS -256.0000 255.9922
 /begin AXIS_DESCR STD_AXIS NO_INPUT_QUANTITY nmot_uw_q0p25 16 0.00 8191.750 FORMAT "%8.3" EXTENDED_LIMITS 0.00 16383.75 DEPOSIT ABSOLUTE /end AXIS_DESCR
 /begin AXIS_DESCR STD_AXIS NO_INPUT_QUANTITY rel_uw_q0p0234 12 0.00 1535.977 FORMAT "%8.3" DEPOSIT ABSOLUTE /end AXIS_DESCR
/end CHARACTERISTIC
/begin CHARACTERISTIC KFNLLKEB "idle speed after start for first start at end of line" CURVE 0x8057D242 RB_Curve_U8_U8 2550. nmot_ub_q10 0.00 2550. FORMAT "%5.0"
 /begin AXIS_DESCR STD_AXIS NSPTS_tnstloc t1sxs_ub_b255 4 0.00 255.0 FORMAT "%5.1" DEPOSIT ABSOLUTE /end AXIS_DESCR
/end CHARACTERISTIC
/begin CHARACTERISTIC KFNLLNST "idle speed after start" MAP 0x8057D24B RB_MapGroup_U8 2550. nmot_ub_q10 0.00 2550. FORMAT "%5.0"
 /begin AXIS_DESCR COM_AXIS NSPTS_tnstloc t1sxs_ub_b255 6 0.00 255.0 FORMAT "%5.1" AXIS_PTS_REF STN06LLUB_NSPTS /end AXIS_DESCR
 /begin AXIS_DESCR COM_AXIS NSPTS_tmotloc temp_ub_q0p75_o48 6 -24624.00 24527.25 FORMAT "%8.2" AXIS_PTS_REF STM06LLUB_NSPTS /end AXIS_DESCR
/end CHARACTERISTIC
/begin CHARACTERISTIC KFNSKHLL "map for control of idle speed during catalyst heating" MAP 0x8057CFB6 RB_Map_U16U16_U16 1.999969 fak_uw_b2 0.00 1.999969 FORMAT "%8.6"
 /begin AXIS_DESCR STD_AXIS ExhMgT_tiAftStrtCatHeatgNIdle t100msxs_uw_b6553p5 8 0.00 6553.500 FORMAT "%8.3" DEPOSIT ABSOLUTE /end AXIS_DESCR
 /begin AXIS_DESCR STD_AXIS frhokor_w_msg fak_uw_b4 4 0.00 3.999939 FORMAT "%8.6" DEPOSIT ABSOLUTE /end AXIS_DESCR
/end CHARACTERISTIC
/begin CHARACTERISTIC KFNSKHLLFS "map for control up engine during catalyst heating while the driving state is active" MAP 0x8057D012 RB_Map_U16U16_U16 1.999969 fak_uw_b2 0.00 1.999969 FORMAT "%8.6"
 /begin AXIS_DESCR STD_AXIS ExhMgT_tiAftStrtCatHeatgNIdle t100msxs_uw_b6553p5 8 0.00 6553.500 FORMAT "%8.3" DEPOSIT ABSOLUTE /end AXIS_DESCR
 /begin AXIS_DESCR STD_AXIS frhokor_w_msg fak_uw_b4 4 0.00 3.999939 FORMAT "%8.6" DEPOSIT ABSOLUTE /end AXIS_DESCR
/end CHARACTERISTIC
/begin CHARACTERISTIC KFNSKHLLFSIML "Map for speed control during catalytic converter heating" MAP 0x8057D06E RB_Map_U16U16_U16 1.999969 fak_uw_b2 0.00 1.999969 FORMAT "%8.6"
 /begin AXIS_DESCR STD_AXIS ExhMgT_facCatHeatgProgsNIdle fak_uw_b1 8 0.00 0.9999847 FORMAT "%9.7" DEPOSIT ABSOLUTE /end AXIS_DESCR
 /begin AXIS_DESCR STD_AXIS frhokor_w_msg fak_uw_b4 4 0.00 3.999939 FORMAT "%8.6" DEPOSIT ABSOLUTE /end AXIS_DESCR
/end CHARACTERISTIC
/begin CHARACTERISTIC KFNSKHLLIML "Map for speed control during catalytic converter heating" MAP 0x8057D0CA RB_Map_U16U16_U16 1.999969 fak_uw_b2 0.00 1.999969 FORMAT "%8.6"
 /begin AXIS_DESCR STD_AXIS ExhMgT_facCatHeatgProgsNIdle fak_uw_b1 8 0.00 0.9999847 FORMAT "%9.7" DEPOSIT ABSOLUTE /end AXIS_DESCR
 /begin AXIS_DESCR STD_AXIS frhokor_w_msg fak_uw_b4 4 0.00 3.999939 FORMAT "%8.6" DEPOSIT ABSOLUTE /end AXIS_DESCR
/end CHARACTERISTIC
/begin CHARACTERISTIC KFNSKHLLTM "map for control of idle speed during catalyst heating in dependence of time counter at end of start and engine temperature at start" MAP 0x8057D126 RB_Map_U16S16_U16 1.999969 fak_uw_b2 0.00 1.999969 FORMAT "%8.6"
 /begin AXIS_DESCR STD_AXIS ExhMgT_tiAftStrtCatHeatgNIdle t100msxs_uw_b6553p5 8 0.00 6553.500 FORMAT "%8.3" DEPOSIT ABSOLUTE /end AXIS_DESCR
 /begin AXIS_DESCR STD_AXIS ExhMgT_tStrtNCatHeatg Temp_Cels 5 -3549.940 3003.560 FORMAT "%8.3" DEPOSIT ABSOLUTE /end AXIS_DESCR
/end CHARACTERISTIC
/begin CHARACTERISTIC KFNSKHLLTMIML "map for control of idle speed during catalyst heating in dependence of catalyst heating progress and engine temperature at start" MAP 0x8057D194 RB_Map_U16S16_U16 1.999969 fak_uw_b2 0.00 1.999969 FORMAT "%8.6"
 /begin AXIS_DESCR STD_AXIS ExhMgT_facCatHeatgProgsNIdle fak_uw_b1 8 0.00 0.9999847 FORMAT "%9.7" DEPOSIT ABSOLUTE /end AXIS_DESCR
 /begin AXIS_DESCR STD_AXIS ExhMgT_tStrtNCatHeatg Temp_Cels 5 -3549.940 3003.560 FORMAT "%8.3" DEPOSIT ABSOLUTE /end AXIS_DESCR
/end CHARACTERISTIC
/begin CHARACTERISTIC KFNSOLHT "Desired idling speed, depending of height and temperature of the environment" MAP 0x8057C8FE RB_Map_U16S16_U8 2550. nmot_q10 0.00 2550. FORMAT "%5.0"
 /begin AXIS_DESCR STD_AXIS PEnv_facCorrAlti fak_uw_b4 4 0.00 3.999939 FORMAT "%8.6" DEPOSIT ABSOLUTE /end AXIS_DESCR
 /begin AXIS_DESCR STD_AXIS EnvT_t Temp_Cels 4 -3549.940 3003.560 FORMAT "%8.3" DEPOSIT ABSOLUTE /end AXIS_DESCR
/end CHARACTERISTIC
/begin CHARACTERISTIC KFTMHTD "Map for target idle speed, heating demand according to coolant temperature" MAP 0x8057C75E RB_Map_S16S16_U8 2550. nmot_ub_q10 0.00 2550. FORMAT "%5.0"
 /begin AXIS_DESCR STD_AXIS CEngDsT_t Temp_Cels 10 -3549.940 3003.560 FORMAT "%8.3" DEPOSIT ABSOLUTE /end AXIS_DESCR
 /begin AXIS_DESCR STD_AXIS CEngDsT_tStrt Temp_Cels 6 -3549.940 3003.560 FORMAT "%8.3" DEPOSIT ABSOLUTE /end AXIS_DESCR
/end CHARACTERISTIC
/begin CHARACTERISTIC KFTMHTDFS "Map for target idle speed, heating demand according to coolant temperature" MAP 0x8057C7BE RB_Map_S16S16_U8 2550. nmot_ub_q10 0.00 2550. FORMAT "%5.0"
 /begin AXIS_DESCR STD_AXIS CEngDsT_t Temp_Cels 10 -3549.940 3003.560 FORMAT "%8.3" DEPOSIT ABSOLUTE /end AXIS_DESCR
 /begin AXIS_DESCR STD_AXIS CEngDsT_tStrt Temp_Cels 6 -3549.940 3003.560 FORMAT "%8.3" DEPOSIT ABSOLUTE /end AXIS_DESCR
/end CHARACTERISTIC
/begin CHARACTERISTIC KFTOSPMVML "heating effect air mass flow and vehicle speed (model oil temperature in sump)" MAP 0x8057D7AE RB_Map_U16U8_S16 1.992188 fak_ub_b2 0.00 1.992188 FORMAT "%8.6" EXTENDED_LIMITS -256.0000 255.9922
 /begin AXIS_DESCR STD_AXIS mlwOilSwmpT m_uw_b6553p5 8 0.00 6553.500 FORMAT "%8.3" DEPOSIT ABSOLUTE /end AXIS_DESCR
 /begin AXIS_DESCR STD_AXIS vfzgOilSwmpT vfzg_ub_q1p25 8 0.00 318.8 FORMAT "%5.1" DEPOSIT ABSOLUTE /end AXIS_DESCR
/end CHARACTERISTIC
/begin CHARACTERISTIC KFTOSPMWC "weighting for calculation of the oil temperature out of coolant- and ambient air temperature" MAP 0x8057D84A RB_Map_U8U8_U8 1.000 fak_ub_q0p00392 0.00 1.000 FORMAT "%5.3"
 /begin AXIS_DESCR STD_AXIS tumgOilSwmpT temp_ub_q0p75_o48 8 -48.0 143.3 FORMAT "%5.1" DEPOSIT ABSOLUTE /end AXIS_DESCR
 /begin AXIS_DESCR STD_AXIS OilSwmpT_tWrmUp temp_ub_q0p75_o48 8 -48.0 143.3 FORMAT "%5.1" DEPOSIT ABSOLUTE /end AXIS_DESCR
/end CHARACTERISTIC
/begin CHARACTERISTIC KFTUMHTD "Map for target idle speed heating demand according to coolant temp and ambient temp." MAP 0x8057C81E RB_Map_S16S16_U8 2550. nmot_ub_q10 0.00 2550. FORMAT "%5.0"
 /begin AXIS_DESCR STD_AXIS CEngDsT_t Temp_Cels 10 -3549.940 3003.560 FORMAT "%8.3" DEPOSIT ABSOLUTE /end AXIS_DESCR
 /begin AXIS_DESCR STD_AXIS EnvT_t Temp_Cels 8 -3549.940 3003.560 FORMAT "%8.3" DEPOSIT ABSOLUTE /end AXIS_DESCR
/end CHARACTERISTIC
/begin CHARACTERISTIC KFTUMHTDFS "Map for target idle speed heating demand according to coolant temp and ambient temp. (B_fs = 1)" MAP 0x8057C896 RB_Map_S16S16_U8 2550. nmot_ub_q10 0.00 2550. FORMAT "%5.0"
 /begin AXIS_DESCR STD_AXIS CEngDsT_t Temp_Cels 10 -3549.940 3003.560 FORMAT "%8.3" DEPOSIT ABSOLUTE /end AXIS_DESCR
 /begin AXIS_DESCR STD_AXIS EnvT_t Temp_Cels 6 -3549.940 3003.560 FORMAT "%8.3" DEPOSIT ABSOLUTE /end AXIS_DESCR
/end CHARACTERISTIC
/begin CHARACTERISTIC KLFINTETHNK "line for flex fuel interpolation curve in case of catalyst heating for control of idle speed in dependence on ethanol content factor" CURVE 0x8057D202 RB_Curve_U16_U16 1.999969 fak_uw_b2 0.00 1.999969 FORMAT "%8.6"
 /begin AXIS_DESCR STD_AXIS fethmnmx_w_msg fak_uw_b2 6 0.00 1.999969 FORMAT "%8.6" DEPOSIT ABSOLUTE /end AXIS_DESCR
/end CHARACTERISTIC
/begin CHARACTERISTIC KLNLLKHAGE "weighting of desired nominal idling speed during catalyst heating in dependence of catalyst ageing" CURVE 0x8057D21C RB_Curve_U16_U16 1.999969 fak_uw_b2 0.00 1.999969 FORMAT "%8.6"
 /begin AXIS_DESCR STD_AXIS ExhMgT_facWghtCatAge fak_uw_b2 4 0.00 1.999969 FORMAT "%8.6" DEPOSIT ABSOLUTE /end AXIS_DESCR
/end CHARACTERISTIC
/begin CHARACTERISTIC KLNLLMGFF "desired engine speed (E100 specific)" CURVE 0x8057C732 RB_Curve_U8_U8 2550. nmot_q10 0.00 2550. FORMAT "%5.0"
 /begin AXIS_DESCR STD_AXIS NSFLX_tEng temp_ub_q0p75_o48 6 -48.0 143.3 FORMAT "%5.1" DEPOSIT ABSOLUTE /end AXIS_DESCR
/end CHARACTERISTIC
/begin CHARACTERISTIC KLNLLMGFSF "desired idle speed in Drive-mode (E100 specific)" CURVE 0x8057C73F RB_Curve_U8_U8 2550. nmot_q10 0.00 2550. FORMAT "%5.0"
 /begin AXIS_DESCR STD_AXIS NSFLX_tEng temp_ub_q0p75_o48 6 -48.0 143.3 FORMAT "%5.1" DEPOSIT ABSOLUTE /end AXIS_DESCR
/end CHARACTERISTIC
/begin CHARACTERISTIC KLNSFLX "Desired idle speed for critical evaporation (flex fuel)" CURVE 0x8057C74C RB_Curve_U16_U8_Static 2550. nmot_q10 0.00 2550. FORMAT "%5.0"
 /begin AXIS_DESCR STD_AXIS NSFLX_mFuMEngOil m_q0p02133 5 0.00 1398.080 FORMAT "%8.3" DEPOSIT ABSOLUTE /end AXIS_DESCR
/end CHARACTERISTIC
/begin CHARACTERISTIC KLTOSPM_N "heating effect engine speed (model oil temperature in sump)" CURVE 0x8057D89C RB_Curve_U8_U8 1.992188 fak_ub_b2 0.00 1.992188 FORMAT "%8.6"
 /begin AXIS_DESCR STD_AXIS nmotOilSwmpT nmot_ub_q40 7 0.00 10200. FORMAT "%5.0" DEPOSIT ABSOLUTE /end AXIS_DESCR
/end CHARACTERISTIC
/begin CHARACTERISTIC KLTOSPM_TU "heating effect ambient temperature (model oil temperature in sump)" CURVE 0x8057D8AB RB_Curve_U8_U8 1.992188 fak_ub_b2 0.00 1.992188 FORMAT "%8.6"
 /begin AXIS_DESCR STD_AXIS tumgOilSwmpT temp_ub_q0p75_o48 8 -48.0 143.3 FORMAT "%5.1" DEPOSIT ABSOLUTE /end AXIS_DESCR
/end CHARACTERISTIC
/begin CHARACTERISTIC KLTSWITCH "control of time constant (model oil temperature in sump)" CURVE 0x8057D8BC RB_Curve_U8_U8 254.0 t_q1 1.0 255.0 FORMAT "%5.1" EXTENDED_LIMITS 0.00 255.0
 /begin AXIS_DESCR STD_AXIS nmotOilSwmpT nmot_ub_q40 3 0.00 10200. FORMAT "%5.0" DEPOSIT ABSOLUTE /end AXIS_DESCR
/end CHARACTERISTIC
/begin CHARACTERISTIC KLTTOSPM1 "time constant heating (model oil temperature in sump)" CURVE 0x8057D8C4 RB_Curve_U8_S16_Static 32766.00 dez 1.00 32767.00 FORMAT "%8.2" EXTENDED_LIMITS -32768.00 32767.00
 /begin AXIS_DESCR STD_AXIS nmotOilSwmpT nmot_ub_q40 8 0.00 10200. FORMAT "%5.0" DEPOSIT ABSOLUTE /end AXIS_DESCR
/end CHARACTERISTIC
/begin CHARACTERISTIC KLTTOSPM2 "time constant cooling (model oil temperature in sump)" CURVE 0x8057D8DE RB_Curve_U8_S16_Static 32766.00 dez 1.00 32767.00 FORMAT "%8.2" EXTENDED_LIMITS -32768.00 32767.00
 /begin AXIS_DESCR STD_AXIS nmotOilSwmpT nmot_ub_q40 8 0.00 10200. FORMAT "%5.0" DEPOSIT ABSOLUTE /end AXIS_DESCR
/end CHARACTERISTIC
/begin CHARACTERISTIC NFSNLDG "Target-speed increase for speed-sensor limp-home" VALUE 0x8057D23E RB_Val_Wu8 2550. nmot_q10 0.00 2550. FORMAT "%5.0" /end CHARACTERISTIC
/begin CHARACTERISTIC NSACFSTM "desired engine speed with air conditioner on (S_AC = 1) and AT in Drive (S_fs=1)" CURVE 0x8057C717 RB_Curve_U8_U8 2550. nmot_ub_q10 0.00 2550. FORMAT "%5.0"
 /begin AXIS_DESCR STD_AXIS NSAC_tAmbAirT temp_ub_q0p75_o48 6 -48.0 143.3 FORMAT "%5.1" DEPOSIT ABSOLUTE /end AXIS_DESCR
/end CHARACTERISTIC
/begin CHARACTERISTIC NSACTM "desired engine speed with air conditioner on (S_AC = 1)" CURVE 0x8057C724 RB_Curve_U8_U8 2550. nmot_ub_q10 0.00 2550. FORMAT "%5.0"
 /begin AXIS_DESCR STD_AXIS NSAC_tAmbAirT temp_ub_q0p75_o48 6 -48.0 143.3 FORMAT "%5.1" DEPOSIT ABSOLUTE /end AXIS_DESCR
/end CHARACTERISTIC
/begin CHARACTERISTIC NSAC_stIdleSpdReqSeln_C "Calibration for idle speed request selection" VALUE 0x8057C731 RB_Val_Wu8 2.000 OneToOne 0.00 2.000 FORMAT "%5.3" EXTENDED_LIMITS 0.00 255.0 /end CHARACTERISTIC
/begin CHARACTERISTIC NSHLL "Minimal target speed for hot idling" VALUE 0x8057C922 RB_Val_Wu8 2550. nmot_q10 0.00 2550. FORMAT "%5.0" /end CHARACTERISTIC
/begin CHARACTERISTIC NSHTI_facCorrnAltiAmbTAvdNvhDrvg_M "Correction factor based on altitude and ambient temperature to avoid noise, vibration and harshness during driving." MAP 0x8057C924 RB_Map_U16S16_U16 3.999939 fak_uw_b4 0.00 3.999939 FORMAT "%8.6"
 /begin AXIS_DESCR STD_AXIS PEnv_facCorrAlti fak_uw_b4 8 0.00 3.999939 FORMAT "%8.6" DEPOSIT ABSOLUTE /end AXIS_DESCR
 /begin AXIS_DESCR STD_AXIS EnvT_t Temp_Cels 8 -3549.940 3003.560 FORMAT "%8.3" DEPOSIT ABSOLUTE /end AXIS_DESCR
/end CHARACTERISTIC
/begin CHARACTERISTIC NSHTI_facCorrnAltiAmbTAvdNvh_M "Correction factor based on altitude and ambient temperature to avoid noise, vibration and harshness when vehicle is in parking or neutral position." MAP 0x8057C9C8 RB_Map_U16S16_U16 3.999939 fak_uw_b4 0.00 3.999939 FORMAT "%8.6"
 /begin AXIS_DESCR STD_AXIS PEnv_facCorrAlti fak_uw_b4 8 0.00 3.999939 FORMAT "%8.6" DEPOSIT ABSOLUTE /end AXIS_DESCR
 /begin AXIS_DESCR STD_AXIS EnvT_t Temp_Cels 8 -3549.940 3003.560 FORMAT "%8.3" DEPOSIT ABSOLUTE /end AXIS_DESCR
/end CHARACTERISTIC
/begin CHARACTERISTIC NSHTI_facCorrnEngTAvdNvhDrvg_T "Correction factor based on engine temperature to avoid noise, vibration and harshness during driving." CURVE 0x8057CA6C RB_Curve_S16_U16_Static 3.999939 fak_uw_b4 0.00 3.999939 FORMAT "%8.6"
 /begin AXIS_DESCR STD_AXIS CEngDsT_t Temp_Cels 8 -3549.940 3003.560 FORMAT "%8.3" DEPOSIT ABSOLUTE /end AXIS_DESCR
/end CHARACTERISTIC
/begin CHARACTERISTIC NSHTI_facCorrnEngTAvdNvh_T "Correction factor based on engine temperature to avoid noise, vibration and harshness when vehicle is in parking or neutral position." CURVE 0x8057CA8E RB_Curve_S16_U16_Static 3.999939 fak_uw_b4 0.00 3.999939 FORMAT "%8.6"
 /begin AXIS_DESCR STD_AXIS CEngDsT_t Temp_Cels 8 -3549.940 3003.560 FORMAT "%8.3" DEPOSIT ABSOLUTE /end AXIS_DESCR
/end CHARACTERISTIC
/begin CHARACTERISTIC NSHTI_facCorrnOffsDrvg_C "Correction factor offset during driving" VALUE 0x8057CAB0 RB_Val_Wu16 3.999939 fak_uw_b4 0.00 3.999939 FORMAT "%8.6" /end CHARACTERISTIC
/begin CHARACTERISTIC NSHTI_facCorrnOffs_C "Correction factor offset" VALUE 0x8057CAB2 RB_Val_Wu16 3.999939 fak_uw_b4 0.00 3.999939 FORMAT "%8.6" /end CHARACTERISTIC
/begin CHARACTERISTIC NSHTI_flgStgySeln_C "Parameter for selecting filtered or unfiltered speed" VALUE 0x8057CAB4 RB_Val_Wu8 1.00000000000 B_TRUE 0.00 1.00000000000 FORMAT "%13.11" /end CHARACTERISTIC
/begin CHARACTERISTIC NSHTI_nHiAltiAvdNvhLoIdleSpDrvg_T "Low idle set point at high altitude to avoid Noise, vibration and harshness during driving which is dependent on correction factor" CURVE 0x8057CAB6 RB_Curve_U16_U16 2550.000 nmot_q10 0.00 2550.000 FORMAT "%8.3" EXTENDED_LIMITS 0.00 655350.0
 /begin AXIS_DESCR STD_AXIS NSHTI_facCorrnHiAltiAvdNvhDrvg fak_uw_b4 16 0.00 3.999939 FORMAT "%8.6" DEPOSIT ABSOLUTE /end AXIS_DESCR
/end CHARACTERISTIC
/begin CHARACTERISTIC NSHTI_nHiAltiAvdNvhLoIdleSp_T "Low idle set point at high altitude to avoid Noise, vibration and harshness when vehicle is in parking or neutral position and this is dependent on correction factor." CURVE 0x8057CAF8 RB_Curve_U16_U16 2550.000 nmot_q10 0.00 2550.000 FORMAT "%8.3" EXTENDED_LIMITS 0.00 655350.0
 /begin AXIS_DESCR STD_AXIS NSHTI_facCorrnHiAltiAvdNvh fak_uw_b4 16 0.00 3.999939 FORMAT "%8.6" DEPOSIT ABSOLUTE /end AXIS_DESCR
/end CHARACTERISTIC
/begin CHARACTERISTIC NSHTI_nLimHiAltiFwdDrvgLoIdleSp_M "Low idle set point limitation at high altitude during forward driving which is dependent on vehicle velocity and altitue factor" MAP 0x8057CB3A RB_Map_U16S16_U8 2550. nmot_ub_q10 0.00 2550. FORMAT "%5.0"
 /begin AXIS_DESCR STD_AXIS PEnv_facCorrAlti fak_uw_b4 8 0.00 3.999939 FORMAT "%8.6" DEPOSIT ABSOLUTE /end AXIS_DESCR
 /begin AXIS_DESCR STD_AXIS VehV_v Vel 8 -327.6800 327.6700 FORMAT "%8.4" DEPOSIT ABSOLUTE /end AXIS_DESCR
/end CHARACTERISTIC
/begin CHARACTERISTIC NSHTI_nLimHiAltiRvsCrpLoIdleSp_M "Low idle set point limitation at high altitude during reverse creeping which is dependent on vehicle velocity and altitue factor" MAP 0x8057CB9E RB_Map_U16S16_U8 2550. nmot_ub_q10 0.00 2550. FORMAT "%5.0"
 /begin AXIS_DESCR STD_AXIS PEnv_facCorrAlti fak_uw_b4 8 0.00 3.999939 FORMAT "%8.6" DEPOSIT ABSOLUTE /end AXIS_DESCR
 /begin AXIS_DESCR STD_AXIS VehV_v Vel 8 -327.6800 327.6700 FORMAT "%8.4" DEPOSIT ABSOLUTE /end AXIS_DESCR
/end CHARACTERISTIC
/begin CHARACTERISTIC NSNLDG "Target-speed increase for speed-sensor limp-home" VALUE 0x8057D23F RB_Val_Wu8 2550. nmot_q10 0.00 2550. FORMAT "%5.0" /end CHARACTERISTIC
/begin CHARACTERISTIC NSNOT "Target engine speed while by throtle inadequacy" VALUE 0x8057D240 RB_Val_Wu8 2550. nmot_q10 0.00 2550. FORMAT "%5.0" /end CHARACTERISTIC
/begin CHARACTERISTIC NSPTS_nIdleAftStrtDrvg_GM "idle speed after start for B_fs=1(Drive mode)" MAP 0x8057D26F RB_MapGroup_U8 2550. nmot_ub_q10 0.00 2550. FORMAT "%5.0"
 /begin AXIS_DESCR COM_AXIS NSPTS_tnstloc t1sxs_ub_b255 6 0.00 255.0 FORMAT "%5.1" AXIS_PTS_REF STN06LLUB_NSPTS /end AXIS_DESCR
 /begin AXIS_DESCR COM_AXIS NSPTS_tmotloc temp_ub_q0p75_o48 6 -24624.00 24527.25 FORMAT "%8.2" AXIS_PTS_REF STM06LLUB_NSPTS /end AXIS_DESCR
/end CHARACTERISTIC
/begin CHARACTERISTIC NSTOEL "idle speed reference: engine oil overheat" CURVE 0x8057CC02 RB_Curve_U8_U8 2550. nmot_q10 0.00 2550. FORMAT "%5.0"
 /begin AXIS_DESCR STD_AXIS toellrns temp_ub_q1_o60 8 -60.0 195.0 FORMAT "%5.1" DEPOSIT ABSOLUTE /end AXIS_DESCR
/end CHARACTERISTIC
/begin CHARACTERISTIC NTUM "Target idle RPM in case of low ambient temperature (B_fs=0)" VALUE 0x8057C8F6 RB_Val_Wu8 2550. nmot_ub_q10 0.00 2550. FORMAT "%5.0" /end CHARACTERISTIC
/begin CHARACTERISTIC NTUMFS "Target idle RPM in case of low ambient temperature (B_fs=1)" VALUE 0x8057C8F7 RB_Val_Wu8 2550. nmot_ub_q10 0.00 2550. FORMAT "%5.0" /end CHARACTERISTIC
/begin CHARACTERISTIC NZHDTL "Speed threshold for decrementing time counter for hot idling" CURVE 0x8057CC13 RB_Curve_U8_U8 10200. nmot_ub_q40 0.00 10200. FORMAT "%5.0"
 /begin AXIS_DESCR STD_AXIS NSHTI_rlloc rel_ub_q0p75 6 0.00 191.3 FORMAT "%5.1" DEPOSIT ABSOLUTE /end AXIS_DESCR
/end CHARACTERISTIC
/begin CHARACTERISTIC NZHITL "Speed threshold for incrementing time counter for hot idling" CURVE 0x8057CC20 RB_Curve_U8_U8 10200. nmot_ub_q40 0.00 10200. FORMAT "%5.0"
 /begin AXIS_DESCR STD_AXIS NSHTI_rlloc rel_ub_q0p75 6 0.00 191.3 FORMAT "%5.1" DEPOSIT ABSOLUTE /end AXIS_DESCR
/end CHARACTERISTIC
/begin CHARACTERISTIC OCWDA_ctDebActvErr_C "Debouncing time of Error active condition" VALUE 0x8057D62A RB_Val_Wu8 255.0 OneToOne 0.00 255.0 FORMAT "%5.1" /end CHARACTERISTIC
/begin CHARACTERISTIC OCWDA_ctDebOvrVltgOn_C "Debouncing time of overvoltage diagnosis" VALUE 0x8057D62C RB_Val_Wu16 65535.00 OneToOne 0.00 65535.00 FORMAT "%8.2" /end CHARACTERISTIC
/begin CHARACTERISTIC OCWDA_stErrSimn_C "Failure simulation of overvoltage, undervoltage, WDA communication errors, error pin activation (0: no error simulation active)" VALUE 0x8057D62E RB_Val_Wu8 8.00000000000 OCWDA_stErrSimn_C_compu_VERB 0.00 8.00000000000 FORMAT "%13.11" /end CHARACTERISTIC
/begin CHARACTERISTIC OCWDA_swtOffRst_C "Deactivation of error reaction (reset), if signal gets inactive once it was recognized as active." VALUE 0x8057D62F RB_Val_Wu8 1.00000000000 OCWDA_swtOffRst_C_compu_VERB 0.00 1.00000000000 FORMAT "%13.11" /end CHARACTERISTIC
/begin CHARACTERISTIC OilP_aTASPWarn_C "Limit for the absolute value of the transversal acceleration in order to enable the test of the minimum oil pressure" VALUE 0x8057D684 RB_Val_Ws16 327.6700 AccGrv 0.00 327.6700 FORMAT "%8.4" EXTENDED_LIMITS -327.6800 327.6700 /end CHARACTERISTIC
/begin CHARACTERISTIC OilP_maskLowOilPErr_C "low oil pressure error" VALUE 0x8057D686 RB_Val_Wu16 65535.00 OneToOne 0.00 65535.00 FORMAT "%8.2" /end CHARACTERISTIC
/begin CHARACTERISTIC OilP_maskPlausAftRunOilPErr_C "oil pressure error afterrun" VALUE 0x8057D688 RB_Val_Wu16 65535.00 OneToOne 0.00 65535.00 FORMAT "%8.2" /end CHARACTERISTIC
/begin CHARACTERISTIC OilP_maskPlausMaxOilPErr_C "maximum oil pressure eoor" VALUE 0x8057D68A RB_Val_Wu16 65535.00 OneToOne 0.00 65535.00 FORMAT "%8.2" /end CHARACTERISTIC
/begin CHARACTERISTIC OilP_maskPlausT15OilPErr_C "T15 oil pressure error" VALUE 0x8057D68C RB_Val_Wu16 65535.00 OneToOne 0.00 65535.00 FORMAT "%8.2" /end CHARACTERISTIC
/begin CHARACTERISTIC OilP_nEngPMaxPlaus_C "max. engine speed for oil pressure diagnosis" VALUE 0x8057D68E RB_Val_Ws16 32767.50 EngN -16384.00 16383.50 FORMAT "%8.2" /end CHARACTERISTIC
/begin CHARACTERISTIC OilP_nEngPMinPlaus_C "min. engine speed for oil pressure diagnosis" VALUE 0x8057D690 RB_Val_Ws16 32767.50 EngN -16384.00 16383.50 FORMAT "%8.2" /end CHARACTERISTIC
/begin CHARACTERISTIC OilP_pAftRunPlaus_C "max. relative oil pressure in after-run" VALUE 0x8057D692 RB_Val_Ws16 6553.500 Pres -3276.800 3276.700 FORMAT "%8.3" /end CHARACTERISTIC
/begin CHARACTERISTIC OilP_pDfl_C "default value oil pressure" VALUE 0x8057D694 RB_Val_Ws16 1638.300 Pres 0.00 1638.300 FORMAT "%8.3" EXTENDED_LIMITS -3276.800 3276.700 /end CHARACTERISTIC
/begin CHARACTERISTIC OilP_pMaxPlaus_C "max. plausible oil pressure" VALUE 0x8057D696 RB_Val_Ws16 6553.500 Pres -3276.800 3276.700 FORMAT "%8.3" /end CHARACTERISTIC
/begin CHARACTERISTIC OilP_pMinPlaus_C "min. plausible oil pressure" VALUE 0x8057D698 RB_Val_Ws16 6553.500 Pres -3276.800 3276.700 FORMAT "%8.3" /end CHARACTERISTIC
/begin CHARACTERISTIC OilP_pMin_MAP "minimal required oil pressure depending on operation point" MAP 0x8057D69A RB_Map_S16S16_S16 1638.300 Pres 0.00 1638.300 FORMAT "%8.3" EXTENDED_LIMITS -3276.800 3276.700
 /begin AXIS_DESCR STD_AXIS Epm_nEng EngN 8 -16384.00 16383.50 FORMAT "%8.2" DEPOSIT ABSOLUTE /end AXIS_DESCR
 /begin AXIS_DESCR STD_AXIS tSwmpOilP Temp_Cels 8 -3549.940 3003.560 FORMAT "%8.3" DEPOSIT ABSOLUTE /end AXIS_DESCR
/end CHARACTERISTIC
/begin CHARACTERISTIC OilP_pT15Plaus_C "max. relative oil pressure before engine start" VALUE 0x8057D73E RB_Val_Ws16 6553.500 Pres -3276.800 3276.700 FORMAT "%8.3" /end CHARACTERISTIC
/begin CHARACTERISTIC OilP_stOilPVD_C "code word for the activation of the function and determination of the ECU" VALUE 0x8057D740 RB_Val_Wu8 255.0 dez 0.00 255.0 FORMAT "%5.1" /end CHARACTERISTIC
/begin CHARACTERISTIC OilP_stSwtOilPTyp_C "Parameter to select between absolute oil pressure and relative oil pressure" VALUE 0x8057D741 RB_Val_Wboolean 1.00000000000 B_TRUE 0.00 1.00000000000 FORMAT "%13.11" /end CHARACTERISTIC
/begin CHARACTERISTIC OilP_stSwtSnsrTyp_C "Parameter to configure the oilpressure-sensortype" VALUE 0x8057D742 RB_Val_Wu8 255.0 OneToOne 0.00 255.0 FORMAT "%5.1" /end CHARACTERISTIC
/begin CHARACTERISTIC OilP_tiDebHealPlaus1_C "debounce time for healing of oil pressure error" VALUE 0x8057D743 RB_Val_Wu8 25.50 t_q0p1 0.00 25.50 FORMAT "%5.2" /end CHARACTERISTIC
/begin CHARACTERISTIC OilP_tiDebHealPlaus2_C "debounce time for healing of oil pressure error" VALUE 0x8057D744 RB_Val_Wu8 25.50 t_q0p1 0.00 25.50 FORMAT "%5.2" /end CHARACTERISTIC
/begin CHARACTERISTIC OilP_tiDebPlaus1_C "debounce time for fault detection of oil pressure" VALUE 0x8057D745 RB_Val_Wu8 25.50 t_q0p1 0.00 25.50 FORMAT "%5.2" /end CHARACTERISTIC
/begin CHARACTERISTIC OilP_tiDebPlaus2_C "debounce time for fault detection of oil pressure" VALUE 0x8057D746 RB_Val_Wu8 25.50 t_q0p1 0.00 25.50 FORMAT "%5.2" /end CHARACTERISTIC
/begin CHARACTERISTIC OilP_tiDebPWarnTASOff_C "Delay time for enabling the test of minimum oil pressure" VALUE 0x8057D747 RB_Val_Wu8 25.50 t_q0p1 0.00 25.50 FORMAT "%5.2" /end CHARACTERISTIC
/begin CHARACTERISTIC OilP_tiDebPWarnTASOn_C "Delay time for disabling the test of minimum oil pressure" VALUE 0x8057D748 RB_Val_Wu8 25.50 t_q0p1 0.00 25.50 FORMAT "%5.2" /end CHARACTERISTIC
/begin CHARACTERISTIC OilP_tiEngOffT15Plaus_C "min. engine off time for diagnosis of oil pressure" VALUE 0x8057D74C RB_Val_Ws32 4294967295.00 TimeEngOn -2147483648.00 2147483647.00 FORMAT "%13.2" /end CHARACTERISTIC
/begin CHARACTERISTIC OilP_tiMinPostDrv_C "min. engine off time for diagnosis of oil pressure" VALUE 0x8057D750 RB_Val_Wu32 42949672.9500 t_q0p01 0.00 42949672.9500 FORMAT "%13.4" /end CHARACTERISTIC
/begin CHARACTERISTIC OilP_tiNormalPMinPlaus_C "min. duration of engine operation for enabling diagnosis of oil pressure" VALUE 0x8057D754 RB_Val_Ws16 10485.60 TimeRed -5242.880 5242.720 FORMAT "%8.3" /end CHARACTERISTIC
/begin CHARACTERISTIC OilP_tiOilTPWarn_CUR "debounce time for low oil pressure warning" CURVE 0x8057D756 RB_Curve_S16_U16_Static 6553.500 t_q0p1 0.00 6553.500 FORMAT "%8.3"
 /begin AXIS_DESCR STD_AXIS tSwmpOilP Temp_Cels 4 -3549.940 3003.560 FORMAT "%8.3" DEPOSIT ABSOLUTE /end AXIS_DESCR
/end CHARACTERISTIC
/begin CHARACTERISTIC OilP_tiPPT1_C "filter time oil pressure" VALUE 0x8057D768 RB_Val_Wu16 6553.4999985 zk100msxs_uw_b6553 0.1000015 6553.6000000 FORMAT "%12.7" EXTENDED_LIMITS 0.10000152590 6553.6000000 /end CHARACTERISTIC
/begin CHARACTERISTIC OilP_tiStrtEndFin_C "Elapsed time after end of start has finished" VALUE 0x8057D76A RB_Val_Wu16 6553.500 t100msxs_uw_b6553p5 0.00 6553.500 FORMAT "%8.3" /end CHARACTERISTIC
/begin CHARACTERISTIC OilP_tMinPMaxPlaus_C "temperature threshold for enabling diagnosis of oil pressure sensor" VALUE 0x8057D76C RB_Val_Ws16 6553.500 Temp_Cels -3549.940 3003.560 FORMAT "%8.3" /end CHARACTERISTIC
/begin CHARACTERISTIC OilP_tMinPostDrv_C "temperature threshold for enabling diagnosis of oil pressure sensor in after-run" VALUE 0x8057D76E RB_Val_Ws16 6553.500 Temp_Cels -3549.940 3003.560 FORMAT "%8.3" /end CHARACTERISTIC
/begin CHARACTERISTIC OilP_tMinT15_C "temperature threshold for enabling diagnosis of oil pressure sensor before engine start" VALUE 0x8057D770 RB_Val_Ws16 6553.500 Temp_Cels -3549.940 3003.560 FORMAT "%8.3" /end CHARACTERISTIC
/begin CHARACTERISTIC OilSwmpT_dtMdlElecDrv_MAP "The characteristic field to calculate the gradient of model temperature in operating state Engine off, ECU on" MAP 0x8057D8F8 RB_Map_S16U8_S16 1535.977 temp_q0p0234 -768.0000 767.9766 FORMAT "%8.4"
 /begin AXIS_DESCR STD_AXIS OilSwmpT_tdiffElecDrv temp_q0p0234_o273 5 -273.1500 494.8266 FORMAT "%8.4" EXTENDED_LIMITS -1041.150 494.8266 DEPOSIT ABSOLUTE /end AXIS_DESCR
 /begin AXIS_DESCR STD_AXIS vfzgOilSwmpT vfzg_ub_q1p25 5 0.00 318.8 FORMAT "%5.1" DEPOSIT ABSOLUTE /end AXIS_DESCR
/end CHARACTERISTIC
/begin CHARACTERISTIC OilSwmpT_dtMdlSnsrMax_C "upper difference with comparison sensor and model value" VALUE 0x8057D780 RB_Val_Ws16 6553.500 Temp_Cels -3549.940 3003.560 FORMAT "%8.3" /end CHARACTERISTIC
/begin CHARACTERISTIC OilSwmpT_dtMdlSnsrMin_C "lower difference with comparison sensor and model value" VALUE 0x8057D782 RB_Val_Ws16 6553.500 Temp_Cels -3549.940 3003.560 FORMAT "%8.3" /end CHARACTERISTIC
/begin CHARACTERISTIC OilSwmpT_facEngOffTiCoolgCoeff_T "Factor calculated based on engine off time to calculate initial oil temperature." CURVE 0x8057DBA6 RB_Curve_U16_U16 0.9999847 fak_uw_b1 0.00 0.9999847 FORMAT "%9.7"
 /begin AXIS_DESCR STD_AXIS OilSwmpT_tiEngOffTi t_q10 10 0.00 327670.0 FORMAT "%8.1" EXTENDED_LIMITS 0.00 655350.0 DEPOSIT ABSOLUTE /end AXIS_DESCR
/end CHARACTERISTIC
/begin CHARACTERISTIC OilSwmpT_facEngSpdCoeff_T "heat release coefficient based on engine speed to calculate model value for oil temperature." CURVE 0x8057DBD0 RB_Curve_S16_S16 0.9999695 fak_q3p0518Em5 0.00 0.9999695 FORMAT "%9.7" EXTENDED_LIMITS -1.000000 0.9999695
 /begin AXIS_DESCR STD_AXIS Epm_nEng EngN 11 -16384.00 16383.50 FORMAT "%8.2" DEPOSIT ABSOLUTE /end AXIS_DESCR
/end CHARACTERISTIC
/begin CHARACTERISTIC OilSwmpT_facHeatgWrmEnvT_M "influence factor dependign on environment temperature and coolant temperature" MAP 0x8057D93E RB_Map_U8U16_U8 1.992 fak_q0p0078 0.00 1.992 FORMAT "%5.3"
 /begin AXIS_DESCR STD_AXIS tumgOilSwmpT temp_ub_q0p75_o48 8 -48.0 143.3 FORMAT "%5.1" DEPOSIT ABSOLUTE /end AXIS_DESCR
 /begin AXIS_DESCR STD_AXIS OilSwmpT_tWrmUpFild temp_ub_q0p75_o48 12 -48.0000 143.2500 FORMAT "%8.4" EXTENDED_LIMITS -48.00000 49103.25 DEPOSIT ABSOLUTE /end AXIS_DESCR
/end CHARACTERISTIC
/begin CHARACTERISTIC OilSwmpT_facIntegElecDrv_C "Factor of the integrator in operating state Engine off, ECU on" VALUE 0x8057D9C0 RB_Val_Wu16 0.9999847 fak_uw_b1 0.00 0.9999847 FORMAT "%9.7" /end CHARACTERISTIC
/begin CHARACTERISTIC OilSwmpT_facMdlElecDrv_T "factor for ambient temperature (model oil temperature in sump)" CURVE 0x8057D9C2 RB_Curve_U8_U8 1.992188 fak_ub_b2 0.00 1.992188 FORMAT "%8.6"
 /begin AXIS_DESCR STD_AXIS tumgOilSwmpT temp_ub_q0p75_o48 8 -48.0 143.3 FORMAT "%5.1" DEPOSIT ABSOLUTE /end AXIS_DESCR
/end CHARACTERISTIC
/begin CHARACTERISTIC OilSwmpT_facMdlLdVVeh_MAP "Map: Effect of the vehicle velocity and coolant heat input to the oil temperature" MAP 0x8057D9D4 RB_Map_S16U8_S16 1.992188 fak_ub_b2 0.00 1.992188 FORMAT "%8.6" EXTENDED_LIMITS -256.0000 255.9922
 /begin AXIS_DESCR STD_AXIS pwrClntEntryOilSwmpT pwr2 6 0.00 617643.4 FORMAT "%8.1" EXTENDED_LIMITS -617662.2 617643.4 DEPOSIT ABSOLUTE /end AXIS_DESCR
 /begin AXIS_DESCR STD_AXIS vfzgOilSwmpT vfzg_ub_q1p25 5 0.00 318.8 FORMAT "%5.1" DEPOSIT ABSOLUTE /end AXIS_DESCR
/end CHARACTERISTIC
/begin CHARACTERISTIC OilSwmpT_facVehSpdCoeff_T "heat release coefficient based on vehicle speed to calculate model value for oil temperature." CURVE 0x8057DBFE RB_Curve_S16_S16 0.9999695 fak_q3p0518Em5 0.00 0.9999695 FORMAT "%9.7" EXTENDED_LIMITS -1.000000 0.9999695
 /begin AXIS_DESCR STD_AXIS VehV_v Vel 12 -327.6800 327.6700 FORMAT "%8.4" DEPOSIT ABSOLUTE /end AXIS_DESCR
/end CHARACTERISTIC
/begin CHARACTERISTIC OilSwmpT_maskB_tospgg_C "calibration to indicate the signal quality mask for Oil temperature sensor" VALUE 0x8057D778 RB_Val_Wu32 4294967295.00 OneToOne 0.00 4294967295.00 FORMAT "%13.2" /end CHARACTERISTIC
/begin CHARACTERISTIC OilSwmpT_maskB_tospg_C "calibration to indicate the signal quality mask for Oil temperature sensor" VALUE 0x8057D77C RB_Val_Wu32 4294967295.00 OneToOne 0.00 4294967295.00 FORMAT "%13.2" /end CHARACTERISTIC
/begin CHARACTERISTIC OilSwmpT_maskEngTWrmUp_C "Calibration mask for oil temperature model to read the SQ-state of CEngDsT_t_Sq or CHdT_t_Sq" VALUE 0x8057DA26 RB_Val_Wu16 65535.00 OneToOne 0.00 65535.00 FORMAT "%8.2" /end CHARACTERISTIC
/begin CHARACTERISTIC OilSwmpT_maskEnvTSq_C "calibration to indicate the signal quality mask for ambient temperature sensor" VALUE 0x8057D774 RB_Val_Wu16 65535.00 OneToOne 0.00 65535.00 FORMAT "%8.2" /end CHARACTERISTIC
/begin CHARACTERISTIC OilSwmpT_swtMdl2Cfg_C "Calibration switch to select calculation method for second oil-temperature model" VALUE 0x8057DC30 RB_Val_Wu8 1.000 OneToOne 0.00 1.000 FORMAT "%5.3" EXTENDED_LIMITS 0.00 255.0 /end CHARACTERISTIC
/begin CHARACTERISTIC OilSwmpT_swtMdlPULSEna_C "release code word for model value use after sensor value comparison" VALUE 0x8057D784 RB_Val_Wu8 255.0 OneToOne 0.00 255.0 FORMAT "%5.1" /end CHARACTERISTIC
/begin CHARACTERISTIC OilSwmpT_swtMdlTAvl_C "Switch from which the status of the oil temperature model for the substitute value switch is valid" VALUE 0x8057D785 RB_Val_Wu8 1.000 OneToOne 0.00 1.000 FORMAT "%5.3" EXTENDED_LIMITS 0.00 255.0 /end CHARACTERISTIC
/begin CHARACTERISTIC OilSwmpT_swtPwrClntEntrySeln_C "Switch to select heat insertion of engine into coolant agent" VALUE 0x8057DA28 RB_Val_Wu8 255.0 OneToOne 0.00 255.0 FORMAT "%5.1" /end CHARACTERISTIC
/begin CHARACTERISTIC OilSwmpT_swtTAmbVld_C "Switch to select validity of ambient temperature" VALUE 0x8057D776 RB_Val_Wu8 1.00000000000 B_TRUE 0.00 1.00000000000 FORMAT "%13.11" /end CHARACTERISTIC
/begin CHARACTERISTIC OilSwmpT_swtTSrcADCFrzDfl_C "Selection switch: OilSwmpT_tADC is freezed or set to the replacement value OilSwmpT_tADCDfl_C, if for a longer time OilSwmpT_flgSwmpTSnsrAvl_mp = FALSE." VALUE 0x8057D786 RB_Val_Wu8 1.000 OneToOne 0.00 1.000 FORMAT "%5.3" EXTENDED_LIMITS 0.00 255.0 /end CHARACTERISTIC
/begin CHARACTERISTIC OilSwmpT_swtTSrcADC_C "Switch: Source of replacement value for OilSwmpT_tADC" VALUE 0x8057D787 RB_Val_Wu8 255.0 OneToOne 0.00 255.0 FORMAT "%5.1" /end CHARACTERISTIC
/begin CHARACTERISTIC OilSwmpT_swtTSrcDispl_C "Switch: Source for OilSwmpT_tDispl" VALUE 0x8057D788 RB_Val_Wu8 255.0 OneToOne 0.00 255.0 FORMAT "%5.1" /end CHARACTERISTIC
/begin CHARACTERISTIC OilSwmpT_swtTSrcPULSFrzDfl_C "Selection switch: OilSwmpT_tPULS is frozen or set to the substitute value OilSwmpT_tPULSDfl_C, if OilSwmpT_flgCmbdSnsrAvl_mp = FALSE for a longer time" VALUE 0x8057D789 RB_Val_Wu8 1.000 OneToOne 0.00 1.000 FORMAT "%5.3" EXTENDED_LIMITS 0.00 255.0 /end CHARACTERISTIC
/begin CHARACTERISTIC OilSwmpT_swtTSrcPULS_C "Selection switch: Source of the oil temperature replacement value for OilSwmpT_tPULS" VALUE 0x8057D78A RB_Val_Wu8 255.0 OneToOne 0.00 255.0 FORMAT "%5.1" /end CHARACTERISTIC
/begin CHARACTERISTIC OilSwmpT_swtTSrc_C "Selection switch: Source of the oil temperature for OilSwmpT_t" VALUE 0x8057D78B RB_Val_Wu8 255.0 OneToOne 0.00 255.0 FORMAT "%5.1" /end CHARACTERISTIC
/begin CHARACTERISTIC OilSwmpT_tADCDfl_C "Default Oil Temperature of sensor connected on ADC" VALUE 0x8057D78C RB_Val_Ws16 3276.700 Temp_Cels -273.140 3003.560 FORMAT "%8.3" EXTENDED_LIMITS -3549.940 3003.560 /end CHARACTERISTIC
/begin CHARACTERISTIC OilSwmpT_tAFSTBlkHeatrDetn_C "Calibration parameter to detect whether block heater is present or not." VALUE 0x8057DC32 RB_Val_Ws16 6553.500 Temp_Cels -3549.940 3003.560 FORMAT "%8.3" /end CHARACTERISTIC
/begin CHARACTERISTIC OilSwmpT_tBlkHeatrCoeff_C "Block heater coefficient Calibration parameter to detect engine off time duration" VALUE 0x8057DC34 RB_Val_Ws16 6553.500 Temp_Cels -3549.940 3003.560 FORMAT "%8.3" /end CHARACTERISTIC
/begin CHARACTERISTIC OilSwmpT_tCEngDsTBlkHeatrDetn_T "curve based on intake air temperature inorder to compare with engine coolant temperature for block heater detection." CURVE 0x8057DC36 RB_Curve_S16_S16 6553.500 Temp_Cels -3549.940 3003.560 FORMAT "%8.3"
 /begin AXIS_DESCR STD_AXIS OilSwmpt_tIntkSnsr Temp_Cels 3 -3549.940 3003.560 FORMAT "%8.3" DEPOSIT ABSOLUTE /end AXIS_DESCR
/end CHARACTERISTIC
/begin CHARACTERISTIC OilSwmpT_tDfl_C "Default Oil Temperature" VALUE 0x8057D78E RB_Val_Ws16 3276.700 Temp_Cels -273.140 3003.560 FORMAT "%8.3" EXTENDED_LIMITS -3549.940 3003.560 /end CHARACTERISTIC
/begin CHARACTERISTIC OilSwmpT_tHeatCoeff_M "Heat coefficient based on engine speed and intake air mass(Map)" MAP 0x8057DC44 RB_Map_S16S16_U16 0.9999847 RBPtCel_t_1p52588em5_1 0.00 0.9999847 FORMAT "%9.7"
 /begin AXIS_DESCR STD_AXIS Epm_nEng EngN 11 -16384.00 16383.50 FORMAT "%8.2" DEPOSIT ABSOLUTE /end AXIS_DESCR
 /begin AXIS_DESCR STD_AXIS OilLfT_mAirPerCyl AirMassPerCyl 20 -3276.800 3276.700 FORMAT "%8.3" DEPOSIT ABSOLUTE /end AXIS_DESCR
/end CHARACTERISTIC
/begin CHARACTERISTIC OilSwmpT_tiCmbdSnsrFrzMax_C "timelimit for swiching of the stat mcahin from short time to long time without a valid signal" VALUE 0x8057D790 RB_Val_Ws32 4294967295.00 Per_Dur -2147483648.00 2147483647.00 FORMAT "%13.2" /end CHARACTERISTIC
/begin CHARACTERISTIC OilSwmpT_tiElecDrv_C "Time constant of the Lowpass-Filters in operating state Engine off, ECU on" VALUE 0x8057DA2A RB_Val_Wu16 65534.00 t_q1 1.00 65535.00 FORMAT "%8.2" EXTENDED_LIMITS 0.00 65535.00 /end CHARACTERISTIC
/begin CHARACTERISTIC OilSwmpT_tiEngOffDurn_C "calibration parameter to detect egine off time is long or not." VALUE 0x8057DE3E RB_Val_Wu16 327670.0 t_q10 0.00 327670.0 FORMAT "%8.1" EXTENDED_LIMITS 0.00 655350.0 /end CHARACTERISTIC
/begin CHARACTERISTIC OilSwmpT_tiEngOff_T "curve to calculate engine off time based on engine coolant temperature" CURVE 0x8057DE40 RB_Curve_U16_U16 327670.0 t_q10 0.00 327670.0 FORMAT "%8.1" EXTENDED_LIMITS 0.00 655350.0
 /begin AXIS_DESCR STD_AXIS OilSwmpT_facEngOffTiCoeff fak_uw_b1 10 0.00 0.9999847 FORMAT "%9.7" DEPOSIT ABSOLUTE /end AXIS_DESCR
/end CHARACTERISTIC
/begin CHARACTERISTIC OilSwmpt_tIntkSnsrSeln_C "calibration parameter to select intake air temperatures." VALUE 0x8057DE6A RB_Val_Wu8 255.0 OneToOne 0.00 255.0 FORMAT "%5.1" /end CHARACTERISTIC
/begin CHARACTERISTIC OilSwmpT_tiTADCPT1_C "Filter time for the PT1_Filter for OilSwmpt_tADCFltd" VALUE 0x8057D794 RB_Val_Ws32 4294.9672940000000 TimeDelay_s 0.0000020000000 4294.9672959999998 FORMAT "%19.14" EXTENDED_LIMITS 0.000002000000001 4294.9672959999998 /end CHARACTERISTIC
/begin CHARACTERISTIC OilSwmpT_tiTDisplPT1_C "Filter time for the PT1_Filter for OilSwmpt_tDisplFltd" VALUE 0x8057D798 RB_Val_Ws32 4294.9672940000000 TimeDelay_s 0.0000020000000 4294.9672959999998 FORMAT "%19.14" EXTENDED_LIMITS 0.000002000000001 4294.9672959999998 /end CHARACTERISTIC
/begin CHARACTERISTIC OilSwmpT_tiTOSPMR_T "curve for time constant of lowpass filter, denpending on engine speed" CURVE 0x8057DA2C RB_Curve_U8_U16_Static 65534.00 t_q1 1.00 65535.00 FORMAT "%8.2" EXTENDED_LIMITS 0.00 65535.00
 /begin AXIS_DESCR STD_AXIS nmotOilSwmpT nmot_ub_q40 6 0.00 10200. FORMAT "%5.0" DEPOSIT ABSOLUTE /end AXIS_DESCR
/end CHARACTERISTIC
/begin CHARACTERISTIC OilSwmpT_tiTPT1_C "Filtering Time Constant for OilSwmpt_tFltd" VALUE 0x8057D79C RB_Val_Ws32 4294.9672940000000 TimeDelay_s 0.0000020000000 4294.9672959999998 FORMAT "%19.14" EXTENDED_LIMITS 0.000002000000001 4294.9672959999998 /end CHARACTERISTIC
/begin CHARACTERISTIC OilSwmpT_tiTPULSPT1_C "Filtertime for PT1 filter of OilSwmpt_tPULSFltd" VALUE 0x8057D7A0 RB_Val_Ws32 4294.9672940000000 TimeDelay_s 0.0000020000000 4294.9672959999998 FORMAT "%19.14" EXTENDED_LIMITS 0.000002000000001 4294.9672959999998 /end CHARACTERISTIC
/begin CHARACTERISTIC OilSwmpT_tiTSnsrFrzMax_C "max thresholdtime for switching of the state machine for the replacement handling for the oil temperature sensor in case no valid value is present" VALUE 0x8057D7A4 RB_Val_Ws32 4294967295.00 Per_Dur -2147483648.00 2147483647.00 FORMAT "%13.2" /end CHARACTERISTIC
/begin CHARACTERISTIC OilSwmpT_tiWrmUp_C "time constant of lowpass filter" VALUE 0x8057DA40 RB_Val_Wu16 65534.00 t_q1 1.00 65535.00 FORMAT "%8.2" EXTENDED_LIMITS 0.00 65535.00 /end CHARACTERISTIC
/begin CHARACTERISTIC OilSwmpT_tPULSDfl_C "Default value of Oil Temperature of the Oil-Combined-Sensor" VALUE 0x8057D7A8 RB_Val_Ws16 3276.700 Temp_Cels -273.140 3003.560 FORMAT "%8.3" EXTENDED_LIMITS -3549.940 3003.560 /end CHARACTERISTIC
/begin CHARACTERISTIC OilSwmpT_tSafeValMtrDisp_C "Alternative values during failure mode for Meter display" VALUE 0x8057DE6C RB_Val_Ws16 6553.500 Temp_Cels -3549.940 3003.560 FORMAT "%8.3" /end CHARACTERISTIC
/begin CHARACTERISTIC OilSwmpt_tSafeVal_C "Safe calibration value in case of sensor errors." VALUE 0x8057DE6E RB_Val_Ws16 6553.500 Temp_Cels -3549.940 3003.560 FORMAT "%8.3" /end CHARACTERISTIC
/begin CHARACTERISTIC OilSwmpT_tSelMdlCEngDsT_C "Threshold of the coolant temperature to select the source of oil temperature." VALUE 0x8057D7AA RB_Val_Ws16 3276.700 Temp_Cels -273.140 3003.560 FORMAT "%8.3" EXTENDED_LIMITS -3549.940 3003.560 /end CHARACTERISTIC
/begin CHARACTERISTIC OilSwmpT_tWrmUpHeatgCorrn_M "Map for temperature correction due to influence of heating" MAP 0x8057DA42 RB_Map_S16U16_U16 1535.977 temp_q0p0234_o273 -273.150 1262.827 FORMAT "%8.3"
 /begin AXIS_DESCR STD_AXIS OilSwmpT_tMdlTmp Temp_Cels 12 -273.140 3003.560 FORMAT "%8.3" EXTENDED_LIMITS -3549.940 3003.560 DEPOSIT ABSOLUTE /end AXIS_DESCR
 /begin AXIS_DESCR STD_AXIS OilSwmpT_tWrmUpFild temp_ub_q0p75_o48 12 -48.0000 143.2500 FORMAT "%8.4" EXTENDED_LIMITS -48.00000 49103.25 DEPOSIT ABSOLUTE /end AXIS_DESCR
/end CHARACTERISTIC
/begin CHARACTERISTIC Oil_pIniPSwmp_C "Initialisation value for sensed oil pressure" VALUE 0x805915BE Val_Ws16 65535.00 Pres_hPa -32768.00 32767.00 FORMAT "%8.2" /end CHARACTERISTIC
/begin CHARACTERISTIC Oil_pTransfPSwmp_CUR "Transformation curve for Oil pressure" CURVE 0x8057D630 RB_Curve_S16_S16 10500.00 Pres_hPa 0.00 10500.00 FORMAT "%8.2" EXTENDED_LIMITS -32768.00 32767.00
 /begin AXIS_DESCR STD_AXIS Oil_uRawPSwmp Volt 10 0.00 6553.000 FORMAT "%8.3" EXTENDED_LIMITS -6553.600 6553.400 DEPOSIT ABSOLUTE /end AXIS_DESCR
/end CHARACTERISTIC
/begin CHARACTERISTIC Oil_SRCPSwmp.uMin_C "Structure to hold SRC Thresholds. / Threshold for SRC -Min detection" VALUE 0x805915C0 Kw_Ws16 5000.000 Volt 0.00 5000.000 FORMAT "%8.3" EXTENDED_LIMITS -6553.600 6553.400 /end CHARACTERISTIC
/begin CHARACTERISTIC Oil_SRCPSwmp.uMax_C "Structure to hold SRC Thresholds. / Threshold for SRC -Max detection" VALUE 0x805915C2 Kw_Ws16 5000.000 Volt 0.00 5000.000 FORMAT "%8.3" EXTENDED_LIMITS -6553.600 6553.400 /end CHARACTERISTIC
/begin CHARACTERISTIC Oil_stDflPSwmp_C "Default value for Oil Pressure status" VALUE 0x805915C4 Val_Wu8 255.0 OneToOne 0.00 255.0 FORMAT "%5.1" /end CHARACTERISTIC
/begin CHARACTERISTIC Oil_stTransfPSwmp_CUR "Transformation curve for Oil pressure" CURVE 0x8057D65A RB_Curve_S16_S16 1.000000 OneToOne 0.00 1.000000 FORMAT "%8.6" EXTENDED_LIMITS -32768.00 32767.00
 /begin AXIS_DESCR STD_AXIS Oil_uRawPSwmp Volt 10 0.00 5000.000 FORMAT "%8.3" EXTENDED_LIMITS -6553.600 6553.400 DEPOSIT ABSOLUTE /end AXIS_DESCR
/end CHARACTERISTIC
/begin CHARACTERISTIC PhyMod_CalorificValueGS_C "Constant for calorific value of fuel (gasoline) with units MJKG" VALUE 0x8057E31E RB_Val_Ws16 6553.500 EnrgPerMass -3276.800 3276.700 FORMAT "%8.3" /end CHARACTERISTIC
/begin CHARACTERISTIC PhyMod_cpHeatExh_C "Specific heat capacity of the exhaust gas" VALUE 0x8057E320 RB_Val_Ws16 655350.0 Thr_Cpty_ExhGs -327680.0 327670.0 FORMAT "%8.1" /end CHARACTERISTIC
/begin CHARACTERISTIC PhyMod_facClntTrq_C "factor engine coolant entry - combustion" VALUE 0x8057E322 RB_Val_Wu8 1.992188 fak_ub_b2 0.00 1.992188 FORMAT "%8.6" /end CHARACTERISTIC
/begin CHARACTERISTIC PhyMod_jCmbEng_C "Moment of inertia of the combustion engine" VALUE 0x8057E324 RB_Val_Wu16 9.999847 j_q0p000153 0.00 9.999847 FORMAT "%8.6" /end CHARACTERISTIC
/begin CHARACTERISTIC PhyMod_tiDerEngFil_CUR "Filtering time constant for the engine speed used in calculation of moment of inertia" CURVE 0x8057E326 RB_Curve_S16_S16 10.00015 TimeDelay_s_Lin_16 -5.000153 5.000000 FORMAT "%8.6"
 /begin AXIS_DESCR STD_AXIS PhyMod_dnEngDerUnFild nmotgrd_q2 7 -65536.00 65534.00 FORMAT "%8.2" DEPOSIT ABSOLUTE /end AXIS_DESCR
/end CHARACTERISTIC
/begin CHARACTERISTIC PID51_stFuTyp_C "coding of fuel type without consideration of vehicle configuration" VALUE 0x8057DE74 RB_Val_Wu8 255.0 OneToOne 0.00 255.0 FORMAT "%5.1" /end CHARACTERISTIC
/begin CHARACTERISTIC PID51_swtVehTyp_C "configurationsswitch of vehicle type" VALUE 0x8057DE75 RB_Val_Wu8 255.0 OneToOne 0.00 255.0 FORMAT "%5.1" /end CHARACTERISTIC
/begin CHARACTERISTIC PIDA6_lDstLim_C "Traveled distance, after which value will be written into EEPROM" VALUE 0x8057DE78 RB_Val_Ws32 429496729.500 RBPtCel_dst_0p1_2 -214748364.800 214748364.700 FORMAT "%13.3" /end CHARACTERISTIC
/begin CHARACTERISTIC PIntkVUs_facCnvnSlopAdc_C "Convertion factor for raw value to physical value convertion for ADC sensor" VALUE 0x8057DE7C RB_Val_Wu16 1638.375 q0p025_hPa_DIV_V 0.00 1638.375 FORMAT "%8.3" /end CHARACTERISTIC
/begin CHARACTERISTIC PIntkVUs_nEngThresPresRawIni_C "engine threshold for raw pressure calculation during initialization" VALUE 0x8057DE7E RB_Val_Ws16 32767.50 EngN -16384.00 16383.50 FORMAT "%8.2" /end CHARACTERISTIC
/begin CHARACTERISTIC PIntkVUs_nThresSync_C "threshold to switch between time- and segment-synchronous calculation" VALUE 0x8057DE80 RB_Val_Ws16 32767.50 EngN -16384.00 16383.50 FORMAT "%8.2" /end CHARACTERISTIC
/begin CHARACTERISTIC PIntkVUs_pADCVltgTrfPresOfs_C "offset pressure for curve ADC voltage to pressure transformation" VALUE 0x8057DE82 RB_Val_Ws16 5119.922 p_q0p078 -2560.000 2559.922 FORMAT "%8.3" /end CHARACTERISTIC
/begin CHARACTERISTIC PIntkVUs_stCfg_C "Codeword for configuration of manifold pressure function" VALUE 0x8057DE84 RB_Val_Wu8 255.0 OneToOne 0.00 255.0 FORMAT "%5.1" /end CHARACTERISTIC
/begin CHARACTERISTIC PIntkVUs_tiPt1VltgSegBasdTi_T "Segment time dependent time constant for PT1 filter, voltage curve" CURVE 0x8057DE86 RB_Curve_S16_S16 32.76700 Time_s_1 0.00 32.76700 FORMAT "%8.5" EXTENDED_LIMITS -32.76800 32.76700
 /begin AXIS_DESCR STD_AXIS PIntkVUs_tiSegADCData Time_s_1 16 -32.76800 32.76700 FORMAT "%8.5" DEPOSIT ABSOLUTE /end AXIS_DESCR
/end CHARACTERISTIC
/begin CHARACTERISTIC PIntkVUs_uThresMax_C "maximum voltage threshold for electrical diagnosis" VALUE 0x8057DEC8 RB_Val_Wu16 4.999665 Volt_q0p00007629 0.00 4.999665 FORMAT "%8.6" /end CHARACTERISTIC
/begin CHARACTERISTIC PIntkVUs_uThresMin_C "minimum voltage threshold for electrical diagnosis" VALUE 0x8057DECA RB_Val_Wu16 4.999665 Volt_q0p00007629 0.00 4.999665 FORMAT "%8.6" /end CHARACTERISTIC
/begin CHARACTERISTIC PSPCtlG_CodWd "Code word to activate Cyclic activation of fuel tank low pressure pump during StartStop" VALUE 0x8057DECC RB_Val_Wu8 255.0 dez 0.00 255.0 FORMAT "%5.1" /end CHARACTERISTIC
/begin CHARACTERISTIC PSPCtl_ctEngStopPSPOnOff_C "maximum number of preruns of EKP during stop-phase" VALUE 0x8057DECD RB_Val_Wu8 255.0 dez 0.00 255.0 FORMAT "%5.1" /end CHARACTERISTIC
/begin CHARACTERISTIC PSPCtl_ctPreRunDrvMax_C "max. number of PSP pre-runs without reaching end of start" VALUE 0x8057DECE RB_Val_Wu8 255.0 OneToOne 0.00 255.0 FORMAT "%5.1" /end CHARACTERISTIC
/begin CHARACTERISTIC PSPCtl_ctPreRunPreDrvMax_C "max. number of PSP pre-runs in ecu predrive state" VALUE 0x8057DECF RB_Val_Wu8 255.0 OneToOne 0.00 255.0 FORMAT "%5.1" /end CHARACTERISTIC
/begin CHARACTERISTIC PSPCtl_cwPSPCtl_CW "codeword of function PSPCtl_Co" VALUE 0x8057DED0 RB_Val_Wu8 255.0 OneToOne 0.00 255.0 FORMAT "%5.1" /end CHARACTERISTIC
/begin CHARACTERISTIC PSPCtl_tiEngOffPreRun_C "threshold soak time for enabling PSP-pre-run" VALUE 0x8057DED2 RB_Val_Wu16 65535.00 t_q1 0.00 65535.00 FORMAT "%8.2" /end CHARACTERISTIC
/begin CHARACTERISTIC PSPCtl_tiEngStalDly_C "Prolongation time of fuel pump activity after engine stall" VALUE 0x8057DED4 RB_Val_Wu16 655.3500 t_q0p01 0.00 655.3500 FORMAT "%8.4" /end CHARACTERISTIC
/begin CHARACTERISTIC PSPCtl_tiEngStopPSPOff_C "time PSP switched OFF during engine stop phase" VALUE 0x8057DED6 RB_Val_Wu16 655.3500 t_q0p01 0.00 655.3500 FORMAT "%8.4" /end CHARACTERISTIC
/begin CHARACTERISTIC PSPCtl_tiEngStopPSPOn_C "time PSP switched ON during engine stop phase" VALUE 0x8057DED8 RB_Val_Wu16 655.3500 t_q0p01 0.00 655.3500 FORMAT "%8.4" /end CHARACTERISTIC
/begin CHARACTERISTIC PSPCtl_tiFrstFl_C "max. time for PSP control at initial fuel filling" VALUE 0x8057DEDA RB_Val_Wu16 655.3500 t_q0p01 0.00 655.3500 FORMAT "%8.4" /end CHARACTERISTIC
/begin CHARACTERISTIC PSPCtl_tiPreRunDrv_C "max. time for PSP pre-run during ECU-Drive state" VALUE 0x8057DEDC RB_Val_Wu16 655.3500 t_q0p01 0.00 655.3500 FORMAT "%8.4" /end CHARACTERISTIC
/begin CHARACTERISTIC PSPCtl_tiPreRunPreDrv_C "max. time for PSP pre-run during ECU-PreDrive state" VALUE 0x8057DEDE RB_Val_Wu16 655.3500 t_q0p01 0.00 655.3500 FORMAT "%8.4" /end CHARACTERISTIC
/begin CHARACTERISTIC PSPCtl_tiStrtDem_C "Time for fast fuel pump activation during start" VALUE 0x8057DEE0 RB_Val_Wu8 2.550 t_q0p01 0.00 2.550 FORMAT "%5.3" /end CHARACTERISTIC
/begin CHARACTERISTIC PSPCtl_tiVapSuspcStrt_C "Threshold time: vapor lock detected to disable after engine started" VALUE 0x8057DEE2 RB_Val_Wu16 10.00000 t_q0p01 0.00 10.00000 FORMAT "%8.5" EXTENDED_LIMITS 0.00 655.3500 /end CHARACTERISTIC
/begin CHARACTERISTIC PSPCtl_tiVapSuspc_C "Threshold time: time within which vapor lock cooled" VALUE 0x8057DEE4 RB_Val_Wu16 655.3500 t_q0p01 0.00 655.3500 FORMAT "%8.4" /end CHARACTERISTIC
/begin CHARACTERISTIC PSPCtl_tVapSuspcISS_T "Threshold Temperature: vapor lock detection between intake and coolant temperature during Start-Stop" CURVE 0x8057DEE6 RB_Curve_S16_S16 6553.500 Temp_Cels -3549.940 3003.560 FORMAT "%8.3"
 /begin AXIS_DESCR STD_AXIS NO_INPUT_QUANTITY Temp_Cels 5 -3549.940 3003.560 FORMAT "%8.3" DEPOSIT ABSOLUTE /end AXIS_DESCR
/end CHARACTERISTIC
/begin CHARACTERISTIC PSPCtl_tVapSuspc_T "Threshold Temperature: vapor lock detection between intake and coolant temperature" CURVE 0x8057DEFC RB_Curve_S16_S16 6553.500 Temp_Cels -3549.940 3003.560 FORMAT "%8.3"
 /begin AXIS_DESCR STD_AXIS NO_INPUT_QUANTITY Temp_Cels 5 -3549.940 3003.560 FORMAT "%8.3" DEPOSIT ABSOLUTE /end AXIS_DESCR
/end CHARACTERISTIC
/begin CHARACTERISTIC PSPDig_ATS.LimitTypeMsk_C "Actuator test PSPDig_ATS / Tester demand monitoring enable mask for actuators" VALUE 0x8058AE8C Val_Wu8 255.0 OneToOne 0.00 255.0 FORMAT "%5.1" /end CHARACTERISTIC
/begin CHARACTERISTIC PSPDig_ATS.CnvNorm_C "Actuator test PSPDig_ATS / Conversion norm used for conversion to/from internal scaling" VALUE 0x8058AE8D Val_Wu8 255.0 OneToOne 0.00 255.0 FORMAT "%5.1" /end CHARACTERISTIC
/begin CHARACTERISTIC PSPDig_ATS.LowLim_C "Actuator test PSPDig_ATS / Lower limit for monitoring" VALUE 0x8058AE8E Val_Ws16 65535.00 OneToOne -32768.00 32767.00 FORMAT "%8.2" /end CHARACTERISTIC
/begin CHARACTERISTIC PSPDig_ATS.UpLim_C "Actuator test PSPDig_ATS / Upper limit for monitoring" VALUE 0x8058AE90 Val_Ws16 65535.00 OneToOne -32768.00 32767.00 FORMAT "%8.2" /end CHARACTERISTIC
/begin CHARACTERISTIC PSPDig_ATS.CnvFac_C "Actuator test PSPDig_ATS / Factor used for conversion to/from internal scaling" VALUE 0x8058AE94 Val_Ws32 4294967295.00 OneToOne -2147483648.00 2147483647.00 FORMAT "%13.2" /end CHARACTERISTIC
/begin CHARACTERISTIC PSPDig_ATS.CnvOfs_C "Actuator test PSPDig_ATS / Offset used for conversion to/from internal scaling" VALUE 0x8058AE98 Val_Ws16 65535.00 OneToOne -32768.00 32767.00 FORMAT "%8.2" /end CHARACTERISTIC
/begin CHARACTERISTIC PSPDig_ATS.DfltVal_C "Actuator test PSPDig_ATS / Default value for standbytest" VALUE 0x8058AE9A Val_Ws16 65535.00 OneToOne -32768.00 32767.00 FORMAT "%8.2" /end CHARACTERISTIC
/begin CHARACTERISTIC PSP_DigOutp.tiBtwTstSCB_C "Structure containing parameters for digital output power stage error handling for pre-supply pump / Time between tests for SCB error" VALUE 0x805915C6 Kw_Ws16 655350.0 Time_ms -327680.0 327670.0 FORMAT "%8.1" /end CHARACTERISTIC
/begin CHARACTERISTIC PSP_DigOutp.tiBtwTstOT_C "Structure containing parameters for digital output power stage error handling for pre-supply pump / Time between tests for OT error" VALUE 0x805915C8 Kw_Ws16 655.3500 Time_s -327.6800 327.6700 FORMAT "%8.4" /end CHARACTERISTIC
/begin CHARACTERISTIC PSP_DigOutp.numTstMax_C "Structure containing parameters for digital output power stage error handling for pre-supply pump / Maximum number of tests allowed on permanent defect" VALUE 0x805915CA Kw_Wu16 65535.00 OneToOne 0.00 65535.00 FORMAT "%8.2" /end CHARACTERISTIC
/begin CHARACTERISTIC PSP_stPsDiaDisbl_C "switch for disabling the diagnosis of the pre supply pump powerstage" VALUE 0x8057DF12 RB_Val_Wu16 65535.00 OneToOne 0.00 65535.00 FORMAT "%8.2" /end CHARACTERISTIC
/begin CHARACTERISTIC PSP_stPsDisbl_C "switch for disabling the pre supply pump powerstage" VALUE 0x8057DF14 RB_Val_Wu16 65535.00 OneToOne 0.00 65535.00 FORMAT "%8.2" /end CHARACTERISTIC
/begin AXIS_PTS STM06LLUB_NSPTS "Distribution search : Engine temperature, for determination of idle speed depending on engine temperature" 0x8057D294 NSPTS_tmotloc RB_Axis_S16 49151.25 temp_ub_q0p75_o48 6 -24624.00 24527.25 FORMAT "%8.2" DEPOSIT ABSOLUTE /end AXIS_PTS
/begin AXIS_PTS STN06LLUB_NSPTS "Distribution search : for determination of idle speed depending on time after start." 0x8057D2A2 NSPTS_tnstloc RB_Axis_U8 255.0 t1sxs_ub_b255 6 0.00 255.0 FORMAT "%5.1" DEPOSIT ABSOLUTE /end AXIS_PTS
/begin CHARACTERISTIC SWTMOT "threshold selection computation model (model oil temperature in sump)" VALUE 0x8057DB96 RB_Val_Wu8 191.3 temp_ub_q0p75_o48 -48.0 143.3 FORMAT "%5.1" /end CHARACTERISTIC
/begin CHARACTERISTIC SWTOSPM "threshold selection computation model (model oil temperature in sump)" VALUE 0x8057DB98 RB_Val_Wu16 1535.977 temp_q0p0234_o273 -273.150 1262.827 FORMAT "%8.3" /end CHARACTERISTIC
/begin CHARACTERISTIC TAHLL "tans threshold for increased target speed at hot idling" VALUE 0x8057CC2D RB_Val_Wu8 191.3 temp_ub_q0p75_o48 -48.0 143.3 FORMAT "%5.1" /end CHARACTERISTIC
/begin CHARACTERISTIC TDBKVKHN "Delay time in which increased idle speed is required though B_bkvleer is set" VALUE 0x8057D22E RB_Val_Wu16 6553.500 t_q0p1 0.00 6553.500 FORMAT "%8.3" /end CHARACTERISTIC
/begin CHARACTERISTIC TDTUMG "Debouncing time for diagnosis of ambient (air) temperature" VALUE 0x8057C8F8 RB_Val_Wu16 6553.500 t100msxs_uw_q100 0.00 6553.500 FORMAT "%8.3" /end CHARACTERISTIC
/begin CHARACTERISTIC THDNSOLPTS "Threshold of desired idle speed - poststart" VALUE 0x8057D230 RB_Val_Wu8 2550. nmot_q10 0.00 2550. FORMAT "%5.0" /end CHARACTERISTIC
/begin CHARACTERISTIC TKHFSAB "delay time switching to idle speed at drive at catalyst heating" VALUE 0x8057D232 RB_Val_Wu16 6553.500 t100msxs_uw_b6553p5 0.00 6553.500 FORMAT "%8.3" /end CHARACTERISTIC
/begin CHARACTERISTIC TKHFSRG "delay time switching to idle speed at drive at catalyst heating when drive position would be engaged with rear gear" VALUE 0x8057D234 RB_Val_Wu16 6553.500 t100msxs_uw_b6553p5 0.00 6553.500 FORMAT "%8.3" /end CHARACTERISTIC
/begin CHARACTERISTIC TKHFSVZ "delay time switching to idle speed at drive at catalyst heating when drive position would be engaged (front gear)and exceed of a velocity threshold" VALUE 0x8057D236 RB_Val_Wu16 6553.500 t100msxs_uw_b6553p5 0.00 6553.500 FORMAT "%8.3" /end CHARACTERISTIC
/begin CHARACTERISTIC TKHNABBKV "time constant for filtering idle speed by catalyst heating by brake booster" VALUE 0x8057D238 RB_Val_Wu8 25.4996 zk100msxs_ub_b25p5 0.1004 25.6000 FORMAT "%7.4" EXTENDED_LIMITS 0.100392 25.6000 /end CHARACTERISTIC
/begin CHARACTERISTIC TMHLL "tmot threshold for increased target speed at hot idling" VALUE 0x8057CC2E RB_Val_Wu8 191.3 temp_ub_q0p75_o48 -48.0 143.3 FORMAT "%5.1" /end CHARACTERISTIC
/begin CHARACTERISTIC TMODNLF "delay time for tyke back of limp home mode demand" VALUE 0x8057C714 RB_Val_Wu16 3276.750 t_q0p05 0.00 3276.750 FORMAT "%8.3" /end CHARACTERISTIC
/begin CHARACTERISTIC TMRZHLL "tmot threshold for resetting the time counter for hot idling" VALUE 0x8057CC2F RB_Val_Wu8 191.3 temp_ub_q0p75_o48 -48.0 143.3 FORMAT "%5.1" /end CHARACTERISTIC
/begin CHARACTERISTIC TOLCHLLMN "lower temperature threshold for hot idling" VALUE 0x8057CC30 RB_Val_Wu8 255.0 temp_ub_q1_o60 -60.0 195.0 FORMAT "%5.1" /end CHARACTERISTIC
/begin CHARACTERISTIC TOLCHLLMX "high temperature threshold for hot idling" VALUE 0x8057CC31 RB_Val_Wu8 255.0 temp_ub_q1_o60 -60.0 195.0 FORMAT "%5.1" /end CHARACTERISTIC
/begin CHARACTERISTIC TOSPMQD "debounce time for state of oiltemperature-model (sump)" VALUE 0x8057DB9A RB_Val_Wu16 65535.00 t_q1 0.00 65535.00 FORMAT "%8.2" /end CHARACTERISTIC
/begin CHARACTERISTIC TOSPMQDS "short debounce time for state of oiltemperature-model (sump)" VALUE 0x8057DB9C RB_Val_Wu16 65535.00 t_q1 0.00 65535.00 FORMAT "%8.2" /end CHARACTERISTIC
/begin CHARACTERISTIC TOSPMQWS "threshold for state of oiltemperature-model (sump)" VALUE 0x8057DB9E RB_Val_Wu8 191.3 temp_ub_q0p75_o48 -48.0 143.3 FORMAT "%5.1" /end CHARACTERISTIC
/begin CHARACTERISTIC TOSPREPL "replacement value oil temperature (model oil temperature in sump)" VALUE 0x8057DBA0 RB_Val_Wu16 1535.977 temp_q0p0234_o273 -273.150 1262.827 FORMAT "%8.3" /end CHARACTERISTIC
/begin CHARACTERISTIC TOSPREPLI "replacement value oil temperature during ini2 (model oil temperature in sump)" VALUE 0x8057DBA2 RB_Val_Wu16 1535.977 temp_q0p0234_o273 -273.150 1262.827 FORMAT "%8.3" /end CHARACTERISTIC
/begin CHARACTERISTIC TTOSPMVLD "delay time of validity of modelled oil temperature" VALUE 0x8057DBA4 RB_Val_Wu16 65535.00 t_q1 0.00 65535.00 FORMAT "%8.2" /end CHARACTERISTIC
/begin CHARACTERISTIC TTUM "Ambient temperature threshold for target idle Resolutions Per Minute" VALUE 0x8057C8FA RB_Val_Ws16 6553.500 Temp_Cels -3549.940 3003.560 FORMAT "%8.3" /end CHARACTERISTIC
/begin CHARACTERISTIC TVHEGTESOFF "Time until canister purge is released" VALUE 0x8057AB98 RB_Val_Ws32 2147.00000000 Time_Dt 0.00 2147.00000000 FORMAT "%13.8" EXTENDED_LIMITS -2147.48364800 2147.48364700 /end CHARACTERISTIC
/begin CHARACTERISTIC VFZGGRDKH "Threshold for velocity gradient to switch over to a separate idle speed after engage gear" VALUE 0x8057D23A RB_Val_Ws16 655.3500 Vel -327.6800 327.6700 FORMAT "%8.4" /end CHARACTERISTIC
/begin CHARACTERISTIC VFZGNLLKH "minimum velocity for separate idle speed after engage gear" VALUE 0x8057D23C RB_Val_Ws16 655.3500 Vel -327.6800 327.6700 FORMAT "%8.4" /end CHARACTERISTIC
/begin CHARACTERISTIC ZHLLA "Time counter for stopping increased speed in hot idling" VALUE 0x8057CC32 RB_Val_Wu16 13107.00 t200msxs_uw_q0p2 0.00 13107.00 FORMAT "%8.2" /end CHARACTERISTIC
/begin CHARACTERISTIC ZHLLE "Time counter threshold for increased speed at hot idling" VALUE 0x8057CC34 RB_Val_Wu16 13107.00 t200msxs_uw_q0p2 0.00 13107.00 FORMAT "%8.2" /end CHARACTERISTIC
/begin MEASUREMENT bdemodnlv "GDI desired mode limp home, previous value after delay time" UBYTE dez 1 100 0.00 255.0 FORMAT "%5.1" ECU_ADDRESS 0x6000B6A5 /end MEASUREMENT
/begin MEASUREMENT bdemodnlz "GDI desired mode limp home, Intermediate value after delay time" UBYTE dez 1 100 0.00 255.0 FORMAT "%5.1" ECU_ADDRESS 0x6000B6A4 /end MEASUREMENT
/begin MEASUREMENT bdemodnl_msg "GDI desired mode limp home" UBYTE OneToOne 1 100 0.00 255.0 FORMAT "%5.1" ECU_ADDRESS 0x6000F74A /end MEASUREMENT
/begin MEASUREMENT B_bkvkhab "condition catalyst heating cut off because of not enough pressure for brake booster" UBYTE B_TRUE 1 100 0.00 1.00000000000 BIT_MASK 0x1 FORMAT "%13.11" ECU_ADDRESS 0x7000013E /end MEASUREMENT
/begin MEASUREMENT B_cwnllkh0 "evaluation Bit0 of codeword CWNSKH" UBYTE B_TRUE 1 100 0.00 1.00000000000 BIT_MASK 0x1 FORMAT "%13.11" ECU_ADDRESS 0x7000013D /end MEASUREMENT
/begin MEASUREMENT B_cwnllkh1 "evaluation Bit1 of codeword CWNSKH" UBYTE B_TRUE 1 100 0.00 1.00000000000 BIT_MASK 0x1 FORMAT "%13.11" ECU_ADDRESS 0x7000013C /end MEASUREMENT
/begin MEASUREMENT B_cwnllkh10 "evaluation Bit10 of codeword CWNSKH" UBYTE B_TRUE 1 100 0.00 1.00000000000 BIT_MASK 0x1 FORMAT "%13.11" ECU_ADDRESS 0x7000013B /end MEASUREMENT
/begin MEASUREMENT B_cwnllkh14 "evaluation Bit14 of codeword CWNSKH" UBYTE B_TRUE 1 100 0.00 1.00000000000 BIT_MASK 0x1 FORMAT "%13.11" ECU_ADDRESS 0x7000013A /end MEASUREMENT
/begin MEASUREMENT B_cwnllkh2 "evaluation Bit2 of codeword CWNSKH" UBYTE B_TRUE 1 100 0.00 1.00000000000 BIT_MASK 0x1 FORMAT "%13.11" ECU_ADDRESS 0x70000139 /end MEASUREMENT
/begin MEASUREMENT B_cwnllkh3 "evaluation Bit3 of codeword CWNSKH" UBYTE B_TRUE 1 100 0.00 1.00000000000 BIT_MASK 0x1 FORMAT "%13.11" ECU_ADDRESS 0x70000138 /end MEASUREMENT
/begin MEASUREMENT B_cwnllkh4 "evaluation Bit4 of codeword CWNSKH" UBYTE B_TRUE 1 100 0.00 1.00000000000 BIT_MASK 0x1 FORMAT "%13.11" ECU_ADDRESS 0x70000137 /end MEASUREMENT
/begin MEASUREMENT B_cwnllkh5 "evaluation Bit5 of codeword CWNSKH" UBYTE B_TRUE 1 100 0.00 1.00000000000 BIT_MASK 0x1 FORMAT "%13.11" ECU_ADDRESS 0x70000136 /end MEASUREMENT
/begin MEASUREMENT B_cwnllkh8 "evaluation Bit8 of codeword CWNSKH" UBYTE B_TRUE 1 100 0.00 1.00000000000 BIT_MASK 0x1 FORMAT "%13.11" ECU_ADDRESS 0x70000135 /end MEASUREMENT
/begin MEASUREMENT B_cwnllkh9 "evaluation Bit9 of codeword CWNSKH" UBYTE B_TRUE 1 100 0.00 1.00000000000 BIT_MASK 0x1 FORMAT "%13.11" ECU_ADDRESS 0x70000134 /end MEASUREMENT
/begin MEASUREMENT B_ekpvl_msg "condition EKP lead time" UBYTE B_TRUE 1 100 0.00 1.00000000000 BIT_MASK 0x1 FORMAT "%13.11" ECU_ADDRESS 0x60001502 /end MEASUREMENT
/begin MEASUREMENT B_hll "Condition hot idling" UBYTE B_TRUE 1 100 0.00 1.00000000000 BIT_MASK 0x1 FORMAT "%13.11" ECU_ADDRESS 0x70000140 /end MEASUREMENT
/begin MEASUREMENT B_inolu "info throttle actuator malfunction" UBYTE B_TRUE 1 100 0.00 1.00000000000 BIT_MASK 0x1 FORMAT "%13.11" ECU_ADDRESS 0x7000012D /end MEASUREMENT
/begin MEASUREMENT B_khnshp_msg "catalyst desired engine speed has a very high priority" UBYTE B_TRUE 1 100 0.00 1.00000000000 BIT_MASK 0x1 FORMAT "%13.11" ECU_ADDRESS 0x70000B98 /end MEASUREMENT
/begin MEASUREMENT B_khn_msg "condition catalyst heating idle speed" UBYTE B_TRUE 1 100 0.00 1.00000000000 BIT_MASK 0x1 FORMAT "%13.11" ECU_ADDRESS 0x70000B99 /end MEASUREMENT
/begin MEASUREMENT B_mwrlstas_msg "Trigger because of Eom changes for the desired air charge." UBYTE B_TRUE 1 100 0.00 1.00000000000 BIT_MASK 0x1 FORMAT "%13.11" ECU_ADDRESS 0x70000B62 /end MEASUREMENT
/begin MEASUREMENT B_mwtes_msg "Trigger because of Eom changes to the canister purge." UBYTE B_TRUE 1 100 0.00 1.00000000000 BIT_MASK 0x1 FORMAT "%13.11" ECU_ADDRESS 0x70000B61 /end MEASUREMENT
/begin MEASUREMENT B_nfskh "change over of desired engine speed for catalyst heating when drive position would be engaged" UBYTE B_TRUE 1 100 0.00 1.00000000000 BIT_MASK 0x1 FORMAT "%13.11" ECU_ADDRESS 0x70000133 /end MEASUREMENT
/begin MEASUREMENT B_nlh "limp home by stoichiometric operation from level 1" UBYTE B_TRUE 1 100 0.00 1.00000000000 BIT_MASK 0x1 FORMAT "%13.11" ECU_ADDRESS 0x70000143 /end MEASUREMENT
/begin MEASUREMENT B_nlh0 "limp home by stoichiometric operation from level 1" UBYTE B_TRUE 1 100 0.00 1.00000000000 BIT_MASK 0x1 FORMAT "%13.11" ECU_ADDRESS 0x70000142 /end MEASUREMENT
/begin MEASUREMENT B_nlh1 "limp home by stoichiometric operation from level 1" UBYTE B_TRUE 1 100 0.00 1.00000000000 BIT_MASK 0x1 FORMAT "%13.11" ECU_ADDRESS 0x70000141 /end MEASUREMENT
/begin MEASUREMENT B_nlhom_msg "limp home by stoichiometric operation from level 1" UBYTE B_TRUE 1 100 0.00 1.00000000000 BIT_MASK 0x1 FORMAT "%13.11" ECU_ADDRESS 0x70000B5C /end MEASUREMENT
/begin MEASUREMENT B_psinirg_msg "Validity status for raw pressure before engine starts" UBYTE B_TRUE 1 100 0.00 1.00000000000 BIT_MASK 0x1 FORMAT "%13.11" ECU_ADDRESS 0x70000B45 /end MEASUREMENT
/begin MEASUREMENT B_psrmw_msg "Condition for mean value intake manifold pressure" UBYTE B_TRUE 1 100 0.00 1.00000000000 BIT_MASK 0x1 FORMAT "%13.11" ECU_ADDRESS 0x70000B3F /end MEASUREMENT
/begin MEASUREMENT B_psrrg_msg "Condition intake manifold pressure rawvalue valid" UBYTE B_TRUE 1 100 0.00 1.00000000000 BIT_MASK 0x1 FORMAT "%13.11" ECU_ADDRESS 0x70000B3E /end MEASUREMENT
/begin MEASUREMENT B_tapcm_msg "Condition output duty cycle PCM" UBYTE B_TRUE 1 100 0.00 1.00000000000 BIT_MASK 0x1 FORMAT "%13.11" ECU_ADDRESS 0x600014E4 /end MEASUREMENT
/begin MEASUREMENT B_toeltmp "Condition idle speed increase , oil temperature" UBYTE B_TRUE 1 100 0.00 1.00000000000 BIT_MASK 0x1 FORMAT "%13.11" ECU_ADDRESS 0x70000B09 /end MEASUREMENT
/begin MEASUREMENT B_tospgg_msg "validity of sensor signal tospr (electrical and physical)" UBYTE B_TRUE 1 100 0.00 1.00000000000 BIT_MASK 0x1 FORMAT "%13.11" ECU_ADDRESS 0x70000B06 /end MEASUREMENT
/begin MEASUREMENT B_tospg_msg "validity of signal tosp" UBYTE B_TRUE 1 100 0.00 1.00000000000 BIT_MASK 0x1 FORMAT "%13.11" ECU_ADDRESS 0x70000B07 /end MEASUREMENT
/begin MEASUREMENT B_tospmadi "condition: soak time based initialisation of oil temperature model valid" UBYTE B_TRUE 1 100 0.00 1.00000000000 BIT_MASK 0x1 FORMAT "%13.11" ECU_ADDRESS 0x70000126 /end MEASUREMENT
/begin MEASUREMENT B_tospmefr "oil temperature in sump from model errorfree" UBYTE B_TRUE 1 100 0.00 1.00000000000 BIT_MASK 0x1 FORMAT "%13.11" ECU_ADDRESS 0x70000125 /end MEASUREMENT
/begin MEASUREMENT B_tospmg "oil temperature in sump from model valid" UBYTE B_TRUE 1 100 0.00 1.00000000000 BIT_MASK 0x1 FORMAT "%13.11" ECU_ADDRESS 0x70000124 /end MEASUREMENT
/begin MEASUREMENT B_tospmwst "Condition: Transition from warm-up-model to warm state model" UBYTE B_TRUE 1 100 0.00 1.00000000000 BIT_MASK 0x1 FORMAT "%13.11" ECU_ADDRESS 0x70000123 /end MEASUREMENT
/begin MEASUREMENT CoEng_bModtr "Dynamic operation during GDI-mode change" UBYTE B_TRUE 1 100 0.00 1.00000000000 BIT_MASK 0x1 FORMAT "%13.11" ECU_ADDRESS 0x70000A74 /end MEASUREMENT
/begin MEASUREMENT CoEOM_DlyReengmtFpcAdvTOFFVNM_I.Time "Delay before the re-engagement of the canister purge, independant of grid. / Internal timer value" SLONG Time_Dt 1 100 0.00 2147.48364700 FORMAT "%13.8" ECU_ADDRESS 0x600026B8 /end MEASUREMENT
/begin MEASUREMENT CoEOM_DlyRstLimpTR_I.timeCounter "Delay time counter for the switch off of the limp home run requirement. / Remaining time of the timer" UWORD t_q0p05 1 100 0.00 3276.750 FORMAT "%8.3" ECU_ADDRESS 0x60007240 /end MEASUREMENT
/begin MEASUREMENT CoEOM_flgErrFuP "Problems with the fuel pressure recognized." UBYTE B_TRUE 1 100 0.00 1.00000000000 BIT_MASK 0x1 FORMAT "%13.11" ECU_ADDRESS 0x6000B6A3 /end MEASUREMENT
/begin MEASUREMENT ExhMgT_cntrReiniIdleCatHeatg "Counter for recognizing the re-initialization of variables and parameters" UBYTE OneToOne 1 100 0.00 255.0 FORMAT "%5.1" ECU_ADDRESS 0x6000B68E /end MEASUREMENT
/begin MEASUREMENT ExhMgT_facCatHeatgProgsNIdle "Catalyst heating progress for requesting a desired engine idle speed" UWORD fak_uw_b1 1 100 0.00 0.9999847 FORMAT "%9.7" ECU_ADDRESS 0x60007238 /end MEASUREMENT
/begin MEASUREMENT ExhMgT_facCorrnIdleAlti "correction of desired idle speed for catalyst heating in dependence of air density" UWORD fak_uw_b2 1 100 0.00 1.999969 FORMAT "%8.6" ECU_ADDRESS 0x60007236 /end MEASUREMENT
/begin MEASUREMENT ExhMgT_flgCatHeatgWrmIdleSpdReq "Flag for a catalyst warm up request for requesting a desired nominal engine idle speed" UBYTE B_TRUE 1 100 0.00 1.00000000000 BIT_MASK 0x1 FORMAT "%13.11" ECU_ADDRESS 0x70000132 /end MEASUREMENT
/begin MEASUREMENT ExhMgT_flgGripClu "reduction of desired idle speed for catalyst heating in case of detected closed power train" UBYTE B_TRUE 1 100 0.00 1.00000000000 BIT_MASK 0x1 FORMAT "%13.11" ECU_ADDRESS 0x70000131 /end MEASUREMENT
/begin MEASUREMENT ExhMgT_flgIdleSpdActvnBrkP "Flag for activation of ramp time selction for idle speed calculation" UBYTE B_TRUE 1 100 0.00 1.00000000000 BIT_MASK 0x1 FORMAT "%13.11" ECU_ADDRESS 0x70000130 /end MEASUREMENT
/begin MEASUREMENT ExhMgT_flgIdleSpdCust0 "bit0 Codeword for customer specific features for idle-speed while catalyst-heating" UBYTE B_TRUE 1 100 0.00 1.00000000000 BIT_MASK 0x1 FORMAT "%13.11" ECU_ADDRESS 0x6000B68D /end MEASUREMENT
/begin MEASUREMENT ExhMgT_flgIdleSpdCust1 "bit1 Codeword for customer specific features for idle-speed while catalyst-heating" UBYTE B_TRUE 1 100 0.00 1.00000000000 BIT_MASK 0x1 FORMAT "%13.11" ECU_ADDRESS 0x6000B68C /end MEASUREMENT
/begin MEASUREMENT ExhMgT_flgIdleSpdDeactvnBrkP "Flag for deactivation of idle speed calculation when there is not enough break pressure" UBYTE B_TRUE 1 100 0.00 1.00000000000 BIT_MASK 0x1 FORMAT "%13.11" ECU_ADDRESS 0x7000012F /end MEASUREMENT
/begin MEASUREMENT ExhMgT_flgNIdleLowrV "Flag for the lower Idle velocity" UBYTE B_TRUE 1 100 0.00 1.00000000000 BIT_MASK 0x1 FORMAT "%13.11" ECU_ADDRESS 0x6000B68B /end MEASUREMENT
/begin MEASUREMENT ExhMgT_flgRepStrtNonCsersIdleSpdReq "Flag for switching the requested engine idle speed to the Non-Csers-idle speeds during catalyst heating after a repeated start" UBYTE B_TRUE 1 100 0.00 1.00000000000 BIT_MASK 0x1 FORMAT "%13.11" ECU_ADDRESS 0x70000963 /end MEASUREMENT
/begin MEASUREMENT ExhMgT_flgTondDrvgPosn "Bit with Turn on delay if driving position is engaged or not" UBYTE B_TRUE 1 100 0.00 1.00000000000 BIT_MASK 0x1 FORMAT "%13.11" ECU_ADDRESS 0x7000012E /end MEASUREMENT
/begin MEASUREMENT ExhMgT_nEngIdleCatHeat "Desired idle speed considering gear , brake pressure , vehicle speed and engine speed" UBYTE nmot_q10 1 100 0.00 2550. FORMAT "%5.0" ECU_ADDRESS 0x6000B68A /end MEASUREMENT
/begin MEASUREMENT ExhMgT_nEngMaxIdleCatHeat "Maximum engine idle speed" UBYTE nmot_q10 1 100 0.00 2550. FORMAT "%5.0" ECU_ADDRESS 0x60014AB7 /end MEASUREMENT
/begin MEASUREMENT ExhMgT_nIdleCatHeatgSp "Desired idling speed, catalyst heating" UBYTE nmot_q10 1 100 0.00 2550. FORMAT "%5.0" ECU_ADDRESS 0x6000F7E9 /end MEASUREMENT
/begin MEASUREMENT ExhMgT_nIdleInitCatHeatg "engine speed for initialisation of low pass for filtering of desired idle speed for catalyst heating" UBYTE nmot_q10 1 100 0.00 2550. FORMAT "%5.0" ECU_ADDRESS 0x6000B689 /end MEASUREMENT
/begin MEASUREMENT ExhMgT_nIdleSpCatHeatg "Desired idling speed during catalyst heating" UBYTE nmot_q10 1 100 0.00 2550. FORMAT "%5.0" ECU_ADDRESS 0x6000B688 /end MEASUREMENT
/begin MEASUREMENT ExhMgT_nIdleVirtDiagCsers "desired catalyst heating idle in case that catalyst heating is active or would be active" UBYTE nmot_q10 1 100 0.00 2550. FORMAT "%5.0" ECU_ADDRESS 0x6000F7E8 /end MEASUREMENT
/begin MEASUREMENT ExhMgT_nIdleVirtDiagNonCsers "Desired engine idle speed for virtual diagnosis during Non-Csers case" UBYTE nmot_q10 1 100 0.00 2550. FORMAT "%5.0" ECU_ADDRESS 0x6000F7E7 /end MEASUREMENT
/begin MEASUREMENT ExhMgT_tCatColdStrtIdleSpdReq "Catalyst temperature as input for requesting a nominal idle speed for catalyst heating" SWORD Temp_Cels 1 100 -3549.940 3003.560 FORMAT "%8.3" ECU_ADDRESS 0x60007234 /end MEASUREMENT
/begin MEASUREMENT ExhMgT_tCatHeatgIdleSpdReqFixd "Frozen value of the Catalyst temperature at the begin of catalyst heating for requesting a nominal idle speed for catalyst heating" SWORD Temp_Cels 1 100 -3549.940 3003.560 FORMAT "%8.3" ECU_ADDRESS 0x60007232 /end MEASUREMENT
/begin MEASUREMENT ExhMgT_tCatWrmIdleSpdReq "Catalyst temperature as input for requesting a nominal idle speed for catalyst warm up mode" SWORD Temp_Cels 1 100 -3549.940 3003.560 FORMAT "%8.3" ECU_ADDRESS 0x60007230 /end MEASUREMENT
/begin MEASUREMENT ExhMgT_tEngCatHeatgIdle "engine temperature (engine coolant or cylinder head), local copy, at the rising edge of active catalyst heating" SWORD Temp_Cels 1 100 -3549.940 3003.560 FORMAT "%8.3" ECU_ADDRESS 0x6000722E /end MEASUREMENT
/begin MEASUREMENT ExhMgT_tiAftStrtCatHeatgNIdle "Time from start-up of catalyst heating for rotational speed" UWORD t_q0p1 1 100 0.00 6553.500 FORMAT "%8.3" ECU_ADDRESS 0x6000722C /end MEASUREMENT
/begin MEASUREMENT ExhMgT_tiIdleSpdFltCatHeatg "Time constant for filtering the desired nominal idle speed during catalyst heating" UBYTE zk100msxs_ub_b25p5 1 100 0.1004 25.6000 FORMAT "%7.4" ECU_ADDRESS 0x6000B687 /end MEASUREMENT
/begin MEASUREMENT ExhMgT_tStrtNCatHeatg "engine start temperature for correction of desired idle speed for catalyst heating" SWORD Temp_Cels 1 100 -3549.940 3003.560 FORMAT "%8.3" ECU_ADDRESS 0x6000722A /end MEASUREMENT
/begin MEASUREMENT frhokor_w_msg "factor for correction of density by secondary air" UWORD fak_uw_b4 1 100 0.00 3.999939 FORMAT "%8.6" ECU_ADDRESS 0x60008D66 /end MEASUREMENT
/begin MEASUREMENT fwnwe_msg "Factor camshaft angle intake" UBYTE fak_ub_b1 1 100 0.00 0.9961 ECU_ADDRESS 0x500009BF /end MEASUREMENT
/begin MEASUREMENT mlwOilSwmpT "Intake air mass used for OilSwmpT" UWORD m_uw_b6553p5 1 100 0.00 6553.500 FORMAT "%8.3" ECU_ADDRESS 0x60007218 /end MEASUREMENT
/begin MEASUREMENT NLKO_SyCstSubOld "Old value of Syc_stSub." UBYTE ExeCon_State_02 1 100 0.00 6.00000000000 FORMAT "%13.11" ECU_ADDRESS 0x6000B6A2 /end MEASUREMENT
/begin MEASUREMENT nllkh_msg "Idling speed for catalyzer heating" UBYTE nmot_q10 1 100 0.00 2550. FORMAT "%5.0" ECU_ADDRESS 0x60014AF1 /end MEASUREMENT
/begin MEASUREMENT nmfskh "Idling speed for catalyzer heating when drive position is engaged" UBYTE nmot_q10 1 100 0.00 2550. FORMAT "%5.0" ECU_ADDRESS 0x6000B686 /end MEASUREMENT
/begin MEASUREMENT nmfskhgs "Gasoline Idling speed for catalyzer heating when drive position is engaged" UBYTE nmot_q10 1 100 0.00 2550. FORMAT "%5.0" ECU_ADDRESS 0x6000B685 /end MEASUREMENT
/begin MEASUREMENT nmllkh "Idling speed for catalyzer heating (drive position not engaged)" UBYTE nmot_q10 1 100 0.00 2550. FORMAT "%5.0" ECU_ADDRESS 0x6000B684 /end MEASUREMENT
/begin MEASUREMENT nmllkhgs "gasoline Idling speed for catalyzer heating (drive position not engaged)" UBYTE nmot_q10 1 100 0.00 2550. FORMAT "%5.0" ECU_ADDRESS 0x6000B683 /end MEASUREMENT
/begin MEASUREMENT nmotllkh "Idling speed for catalyzer heating" UBYTE nmot_q10 1 100 0.00 2550. FORMAT "%5.0" ECU_ADDRESS 0x6000B682 /end MEASUREMENT
/begin MEASUREMENT nmotOilSwmpT "Engine speed used for OilSwmpT" UBYTE nmot_ub_q40 1 100 0.00 10200. FORMAT "%5.0" ECU_ADDRESS 0x6000B67B /end MEASUREMENT
/begin MEASUREMENT NSAC_ctReIni "Re-initialization counter" UBYTE OneToOne 1 100 0.00 255.0 FORMAT "%5.1" ECU_ADDRESS 0x6000B6A1 /end MEASUREMENT
/begin MEASUREMENT NSAC_flgIdleSpdReq "Active flag for idle speed request" UBYTE B_TRUE 1 100 0.00 1.00000000000 BIT_MASK 0x1 FORMAT "%13.11" ECU_ADDRESS 0x6000B6A0 /end MEASUREMENT
/begin MEASUREMENT NSAC_tAmbAirT "Ambient air temperature" UBYTE temp_ub_q0p75_o48 1 100 -48.0 143.3 FORMAT "%5.1" ECU_ADDRESS 0x6000B69F /end MEASUREMENT
/begin MEASUREMENT NSFLX_mFuMEngOil "total fuel mass in engine oil" UWORD m_q0p02133 1 100 0.00 1398.080 FORMAT "%8.3" ECU_ADDRESS 0x6000723E /end MEASUREMENT
/begin MEASUREMENT NSFLX_tEng "Engine or coolant temperature based on MDG1MSGCNCPT_SC" UBYTE temp_ub_q0p75_o48 1 100 -48.0 143.3 FORMAT "%5.1" ECU_ADDRESS 0x6000B69E /end MEASUREMENT
/begin MEASUREMENT NSHTD_ctReIni "Re-initialization counter" UBYTE OneToOne 1 100 0.00 255.0 FORMAT "%5.1" ECU_ADDRESS 0x6000B69D /end MEASUREMENT
/begin MEASUREMENT NSHTI_B_st "condition for start" UBYTE B_TRUE 1 100 0.00 1.00000000000 BIT_MASK 0x1 FORMAT "%13.11" ECU_ADDRESS 0x7000013F /end MEASUREMENT
/begin MEASUREMENT NSHTI_ctIniDrv "counter for NSHTI initiation" UBYTE OneToOne 1 100 0.00 255.0 FORMAT "%5.1" ECU_ADDRESS 0x6000B693 /end MEASUREMENT
/begin MEASUREMENT NSHTI_facCorrnHiAltiAvdNvh "Correction factor at high altitude to avoid noise, vibration and harshness when vehicle is in parking or neutral position." UWORD fak_uw_b4 1 100 0.00 3.999939 FORMAT "%8.6" ECU_ADDRESS 0x6000723C /end MEASUREMENT
/begin MEASUREMENT NSHTI_facCorrnHiAltiAvdNvhDrvg "Correction factor at high altitude to avoid noise, vibration and harshness during driving." UWORD fak_uw_b4 1 100 0.00 3.999939 FORMAT "%8.6" ECU_ADDRESS 0x6000723A /end MEASUREMENT
/begin MEASUREMENT NSHTI_flgHiAltiLimActv "Flag to indicate high altitude limitation is active" UBYTE B_TRUE 1 100 0.00 1.00000000000 BIT_MASK 0x1 FORMAT "%13.11" ECU_ADDRESS 0x6000F929 /end MEASUREMENT
/begin MEASUREMENT NSHTI_nHiAltiAvdNvhDrvgLoc "Local low idle set point at high altitude to avoid Noise, vibration and harshness during driving" UBYTE nmot_ub_q10 1 100 0.00 2550. FORMAT "%5.0" ECU_ADDRESS 0x6000B69A /end MEASUREMENT
/begin MEASUREMENT NSHTI_nHiAltiAvdNvhDrvgTmp "Temporary low idle set point at high altitude to avoid Noise, vibration and harshness during driving" UBYTE nmot_ub_q10 1 100 0.00 2550. FORMAT "%5.0" ECU_ADDRESS 0x6000B699 /end MEASUREMENT
/begin MEASUREMENT NSHTI_nHiAltiAvdNvhIdle "Low idle set point at high altitude to avoid Noise, vibration and harshness when vehicle is in parking or neutral position" UBYTE nmot_ub_q10 1 100 0.00 2550. FORMAT "%5.0" ECU_ADDRESS 0x6000FBC3 /end MEASUREMENT
/begin MEASUREMENT NSHTI_nHiAltiAvdNvhIdleDrvg "Low idle set point at high altitude to avoid Noise, vibration and harshness during driving." UBYTE nmot_ub_q10 1 100 0.00 2550. FORMAT "%5.0" ECU_ADDRESS 0x6000FBC2 /end MEASUREMENT
/begin MEASUREMENT NSHTI_nHiAltiAvdNvhIdleLoc "Local Low idle set point at high altitude to avoid Noise, vibration and harshness when vehicle is in parking or neutral position" UBYTE nmot_ub_q10 1 100 0.00 2550. FORMAT "%5.0" ECU_ADDRESS 0x6000B698 /end MEASUREMENT
/begin MEASUREMENT NSHTI_nHiAltiAvdNvhIdleTmp "Temporary Low idle set point at high altitude to avoid Noise, vibration and harshness when vehicle is in parking or neutral position" UBYTE nmot_ub_q10 1 100 0.00 2550. FORMAT "%5.0" ECU_ADDRESS 0x6000B697 /end MEASUREMENT
/begin MEASUREMENT NSHTI_nHiAltiAvdNvhLoIdleSp "Low idle set point at high altitude to avoid Noise, vibration and harshness" UBYTE nmot_ub_q10 1 100 0.00 2550. FORMAT "%5.0" ECU_ADDRESS 0x6000FBC1 /end MEASUREMENT
/begin MEASUREMENT NSHTI_nLimHiAltiLoIdleSp "Low idle set point limitation at high altitude" UBYTE nmot_ub_q10 1 100 0.00 2550. FORMAT "%5.0" ECU_ADDRESS 0x6000FBC0 /end MEASUREMENT
/begin MEASUREMENT NSHTI_nmotloc "local variable in nshti" UBYTE nmot_ub_q40 1 100 0.00 10200. FORMAT "%5.0" ECU_ADDRESS 0x6000B692 /end MEASUREMENT
/begin MEASUREMENT NSHTI_rlloc "local variable in nshti" UBYTE rel_ub_q0p75 1 100 0.00 191.3 FORMAT "%5.1" ECU_ADDRESS 0x6000B691 /end MEASUREMENT
/begin MEASUREMENT NSHTI_tans "intake air temperature" UBYTE temp_ub_q0p75_o48 1 100 -48.0 143.3 FORMAT "%5.1" ECU_ADDRESS 0x6000B696 /end MEASUREMENT
/begin MEASUREMENT NSHTI_tmstloc "engine temperature at start" UBYTE temp_ub_q0p75_o48 1 100 -48.0 143.3 FORMAT "%5.1" ECU_ADDRESS 0x6000B695 /end MEASUREMENT
/begin MEASUREMENT NSHTI_tolc "oil temperature from combi or from COWIV" UBYTE temp_ub_q1_o60 1 100 -60.0 195.0 FORMAT "%5.1" ECU_ADDRESS 0x6000B690 /end MEASUREMENT
/begin MEASUREMENT nsmodac_msg "Mode desired idling speed, air conditioner" UBYTE OneToOne 1 100 0.00 255.0 FORMAT "%5.1" ECU_ADDRESS 0x6000FB3B /end MEASUREMENT
/begin MEASUREMENT nsmodhtd_msg "Mode desired idling speed, heating demand" UBYTE OneToOne 1 100 0.00 255.0 FORMAT "%5.1" ECU_ADDRESS 0x6000FB3A /end MEASUREMENT
/begin MEASUREMENT nsmodlph_msg "Mode desired idling speed, limp-home" UBYTE dez 1 100 0.00 255.0 FORMAT "%5.1" ECU_ADDRESS 0x6000FB39 /end MEASUREMENT
/begin MEASUREMENT nsolac_msg "Desired idling speed, air conditioner" UBYTE nmot_q10 1 100 0.00 2550. FORMAT "%5.0" ECU_ADDRESS 0x6000FB38 /end MEASUREMENT
/begin MEASUREMENT nsolcat_msg "Desired idling speed, catalyst heating" UBYTE nmot_q10 1 100 0.00 2550. FORMAT "%5.0" ECU_ADDRESS 0x60014AF3 /end MEASUREMENT
/begin MEASUREMENT nsolflx_msg "Desired idling speed, flex fuel" UBYTE nmot_q10 1 100 0.00 2550. FORMAT "%5.0" ECU_ADDRESS 0x6000FB36 /end MEASUREMENT
/begin MEASUREMENT nsolht "Desired idling speed, depending of height and temperature of the environment" UBYTE nmot_q10 1 100 0.00 2550. FORMAT "%5.0" ECU_ADDRESS 0x6000B694 /end MEASUREMENT
/begin MEASUREMENT nsolhtdtm "Desired idling speed, heating demand according to coolant temp." UBYTE nmot_ub_q10 1 100 0.00 2550. FORMAT "%5.0" ECU_ADDRESS 0x6000B69C /end MEASUREMENT
/begin MEASUREMENT nsolhtdtum "Desired idling speed, heating demand according to ambient air temp." UBYTE nmot_ub_q10 1 100 0.00 2550. FORMAT "%5.0" ECU_ADDRESS 0x6000B69B /end MEASUREMENT
/begin MEASUREMENT nsolhtd_msg "Desired idling speed, heating demand according to ambient air temperature" UBYTE nmot_ub_q10 1 100 0.00 2550. FORMAT "%5.0" ECU_ADDRESS 0x6000FB35 /end MEASUREMENT
/begin MEASUREMENT nsolhti_msg "Desired idling speed, hot idling" UBYTE nmot_q10 1 100 0.00 2550. FORMAT "%5.0" ECU_ADDRESS 0x6000FB34 /end MEASUREMENT
/begin MEASUREMENT nsollph_msg "Desired idling speed, limp-home" UBYTE nmot_q10 1 100 0.00 2550. FORMAT "%5.0" ECU_ADDRESS 0x6000FB33 /end MEASUREMENT
/begin MEASUREMENT nsolpts_msg "Desired idling speed, post start" UBYTE nmot_q10 1 100 0.00 2550. FORMAT "%5.0" ECU_ADDRESS 0x6000F727 /end MEASUREMENT
/begin MEASUREMENT NSPTS_ctIniDrv "function specific counter for detection of state change" UBYTE OneToOne 1 100 0.00 255.0 FORMAT "%5.1" ECU_ADDRESS 0x6000F796 /end MEASUREMENT
/begin MEASUREMENT NSPTS_tmotloc "engine temperature at start" SWORD temp_ub_q0p75_o48 1 100 -24624.00 24527.25 FORMAT "%8.2" ECU_ADDRESS 0x60007226 /end MEASUREMENT
/begin MEASUREMENT NSPTS_tnstloc "time after end of start" UBYTE t1sxs_ub_b255 1 100 0.00 255.0 FORMAT "%5.1" ECU_ADDRESS 0x6000B681 /end MEASUREMENT
/begin MEASUREMENT nstoel_tmp "desired idle speed , oil temperature" UBYTE nmot_ub_q10 1 100 0.00 2550. FORMAT "%5.0" ECU_ADDRESS 0x6000FB2F /end MEASUREMENT
/begin MEASUREMENT OCWDA_ctBattU "Debounce counter for stable battery voltage" UBYTE OneToOne 1 100 0.00 255.0 FORMAT "%5.1" ECU_ADDRESS 0x6000FBBF /end MEASUREMENT
/begin MEASUREMENT OCWDA_ctDebActvErr "Debounce counter for Error Pin, WDA, ABE active" UBYTE OneToOne 1 100 0.00 255.0 FORMAT "%5.1" ECU_ADDRESS 0x6000FBBE /end MEASUREMENT
/begin MEASUREMENT OCWDA_ctDebErrNotActv "Debounce counter for healing inactive Error Pin, WDA, ABE" UBYTE OneToOne 1 100 0.00 255.0 FORMAT "%5.1" ECU_ADDRESS 0x6000FBBD /end MEASUREMENT
/begin MEASUREMENT OCWDA_ctDebOvrVltgOn "Debounce counter for overvoltage on detection" UWORD OneToOne 1 100 0.00 65535.00 FORMAT "%8.2" ECU_ADDRESS 0x600093F8 /end MEASUREMENT
/begin MEASUREMENT OCWDA_ctTstOCWDA "Debounce counter for setting of test- or errorflags" UBYTE OneToOne 1 100 0.00 255.0 FORMAT "%5.1" ECU_ADDRESS 0x6000FBBC /end MEASUREMENT
/begin MEASUREMENT OCWDA_ctTstOvrVltg "Counter for setting test flag in WDA-diagnosis of the overvoltage check" UWORD OneToOne 1 100 0.00 65535.00 FORMAT "%8.2" ECU_ADDRESS 0x600093F6 /end MEASUREMENT
/begin MEASUREMENT OCWDA_flgClrDebDFC "Flag bit to indicate request to clear fault memory" UBYTE OneToOne 1 100 0.00 255.0 FORMAT "%5.1" ECU_ADDRESS 0x6000F795 /end MEASUREMENT
/begin MEASUREMENT OCWDA_stABEActv "Internal ABE status" UBYTE OneToOne 1 100 0.00 255.0 FORMAT "%5.1" ECU_ADDRESS 0x6000FBBB /end MEASUREMENT
/begin MEASUREMENT OCWDA_stCheckState "Variable contains the current state of the WDA diagnosis task" ULONG OneToOne 1 100 0.00 4294967295.00 FORMAT "%13.2" ECU_ADDRESS 0x600038F0 /end MEASUREMENT
/begin MEASUREMENT OCWDA_stErrMonPtt "Status information for diagnosis process to set failure entry" ULONG OneToOne 1 100 0.00 4294967295.00 FORMAT "%13.2" ECU_ADDRESS 0x60013B30 /end MEASUREMENT
/begin MEASUREMENT OCWDA_stErrPinActv "Internal Error Pin status" UBYTE OneToOne 1 100 0.00 255.0 FORMAT "%5.1" ECU_ADDRESS 0x6000FBBA /end MEASUREMENT
/begin MEASUREMENT OCWDA_stOvrVltgActv "Internal status of overvoltage at powerstage modul" UBYTE OneToOne 1 100 0.00 255.0 FORMAT "%5.1" ECU_ADDRESS 0x6000FBB9 /end MEASUREMENT
/begin MEASUREMENT OCWDA_stWDAActv "Internal WDA status" UBYTE OneToOne 1 100 0.00 255.0 FORMAT "%5.1" ECU_ADDRESS 0x6000FBB8 /end MEASUREMENT
/begin MEASUREMENT OilP_bPlausAftRunEnbl_mp "Measuring point for oil pressure plausibility during after run enable condition" UBYTE B_TRUE 1 100 0.00 1.00000000000 BIT_MASK 0x1 FORMAT "%13.11" ECU_ADDRESS 0x7000A118 /end MEASUREMENT
/begin MEASUREMENT OilP_bPlausMaxEnbl_mp "Measuring point for maximum oil pressure plausiblity enable condition" UBYTE B_TRUE 1 100 0.00 1.00000000000 BIT_MASK 0x1 FORMAT "%13.11" ECU_ADDRESS 0x7000A117 /end MEASUREMENT
/begin MEASUREMENT OilP_bPlausMinEnbl_mp "Measuring point for minimum oil pressure plausiblity enable condition" UBYTE B_TRUE 1 100 0.00 1.00000000000 BIT_MASK 0x1 FORMAT "%13.11" ECU_ADDRESS 0x7000A116 /end MEASUREMENT
/begin MEASUREMENT OilP_bPlausT15Enbl_mp "Measuring point for plausibility during T15 enable condition" UBYTE B_TRUE 1 100 0.00 1.00000000000 BIT_MASK 0x1 FORMAT "%13.11" ECU_ADDRESS 0x7000A115 /end MEASUREMENT
/begin MEASUREMENT OilP_flgTASPWarnEna "Status of transversal acceleration warning enable" UBYTE B_TRUE 1 100 0.00 1.00000000000 BIT_MASK 0x1 FORMAT "%13.11" ECU_ADDRESS 0x6000B680 /end MEASUREMENT
/begin MEASUREMENT OilP_flgTASPWarnEnaInit_MP "Status of transversal acceleration warning enable during Initialisation" UBYTE B_TRUE 1 100 0.00 1.00000000000 BIT_MASK 0x1 FORMAT "%13.11" ECU_ADDRESS 0x7000A114 /end MEASUREMENT
/begin MEASUREMENT OilP_pSensFilt_mp "Measuring point for filtered oil pressure" SWORD Pres 1 100 0.00 1638.300 FORMAT "%8.3" ECU_ADDRESS 0x7000A112 /end MEASUREMENT
/begin MEASUREMENT OilSwmpT_bengrot "Condition: motor is rotating" UBYTE B_TRUE 1 100 0.00 1.00000000000 BIT_MASK 0x1 FORMAT "%13.11" ECU_ADDRESS 0x700007D0 /end MEASUREMENT
/begin MEASUREMENT OilSwmpT_bgtumg "validity of ambient temperature, set if model parth is determined, valid and actual or if there is no error in the sensor value" UBYTE B_TRUE 1 100 0.00 1.00000000000 BIT_MASK 0x1 FORMAT "%13.11" ECU_ADDRESS 0x700007CF /end MEASUREMENT
/begin MEASUREMENT OilSwmpT_bsa "Fuel cut-off" UBYTE B_TRUE 1 100 0.00 1.00000000000 BIT_MASK 0x1 FORMAT "%13.11" ECU_ADDRESS 0x700007CE /end MEASUREMENT
/begin MEASUREMENT OilSwmpT_btengsr "Flag: counters of soak time are reset" UBYTE B_TRUE 1 100 0.00 1.00000000000 BIT_MASK 0x1 FORMAT "%13.11" ECU_ADDRESS 0x700007CD /end MEASUREMENT
/begin MEASUREMENT OilSwmpT_btumgg "condition: ambient air temperature sensormodel is error free" UBYTE B_TRUE 1 100 0.00 1.00000000000 BIT_MASK 0x1 FORMAT "%13.11" ECU_ADDRESS 0x700007CC /end MEASUREMENT
/begin MEASUREMENT OilSwmpT_bVldMdlENVRAM "Local variable to indicate validity of EEP elements used for model" UBYTE B_TRUE 1 100 0.00 1.00000000000 BIT_MASK 0x1 FORMAT "%13.11" ECU_ADDRESS 0x70000122 /end MEASUREMENT
/begin MEASUREMENT OilSwmpT_dtCEngDsTMdl "Difference between oil temperature model value and engine coolant temprature." SWORD Temp_Cels 1 100 -3549.940 3003.560 FORMAT "%8.3" ECU_ADDRESS 0x60000EA2 /end MEASUREMENT
/begin MEASUREMENT OilSwmpT_dtEnvTMdl "Difference between oil temperature model value and ambient temperature Model value for Oil deterioration system" SWORD Temp_Cels 1 100 -3549.940 3003.560 FORMAT "%8.3" ECU_ADDRESS 0x60000EA0 /end MEASUREMENT
/begin MEASUREMENT OilSwmpT_dtMdl2 "Difference between engine speed air mass coefficient temperature and vehicle speed coefficient temeprature." SLONG RBPtCel_t_1p52588em5_1 1 100 -32768.0000000 32767.9999847 FORMAT "%13.7" ECU_ADDRESS 0x60000E9C /end MEASUREMENT
/begin MEASUREMENT OilSwmpT_dtMdlElecDrv "gradient of model temperature in operating state Engine off, ECU on" SWORD temp_q0p0234 1 100 -768.0000 767.9766 FORMAT "%8.4" ECU_ADDRESS 0x60007216 /end MEASUREMENT
/begin MEASUREMENT OilSwmpT_facEngOffTiCoeff "Engine off time coefficient" UWORD fak_uw_b1 1 100 0.00 0.9999847 FORMAT "%9.7" ECU_ADDRESS 0x60000E9A /end MEASUREMENT
/begin MEASUREMENT OilSwmpT_facEngOffTiCoolgCoeff "Factor calculated based on engine off time to calculate initial oil temperature." UWORD fak_uw_b1 1 100 0.00 0.9999847 FORMAT "%9.7" ECU_ADDRESS 0x60000E98 /end MEASUREMENT
/begin MEASUREMENT OilSwmpT_facEngSpdCoeff "heat release coefficient based on engine speed to calculate model value for oil temperature." SWORD fak_q3p0518Em5 1 100 0.00 0.9999695 FORMAT "%9.7" ECU_ADDRESS 0x60000E96 /end MEASUREMENT
/begin MEASUREMENT OilSwmpT_facVehSpdCoeff "heat release coefficient based on vehicle speed to calculate model value for oil temperature." SWORD fak_q3p0518Em5 1 100 0.00 0.9999695 FORMAT "%9.7" ECU_ADDRESS 0x60000E94 /end MEASUREMENT
/begin MEASUREMENT OilSwmpT_flgEngStopFrz "Flag: Engine stop for the oil temperatures detected" UBYTE B_TRUE 1 100 0.00 1.00000000000 BIT_MASK 0x1 FORMAT "%13.11" ECU_ADDRESS 0x7000012C /end MEASUREMENT
/begin MEASUREMENT OilSwmpT_flgEngStrtCmpl "Oil temperature after engine start completion" UBYTE B_TRUE 1 100 0.00 1.00000000000 BIT_MASK 0x1 FORMAT "%13.11" ECU_ADDRESS 0x600000CA /end MEASUREMENT
/begin MEASUREMENT OilSwmpT_flgFinshd "Flag to indicate model value for oil temperature is completed" UBYTE B_TRUE 1 100 0.00 1.00000000000 BIT_MASK 0x1 FORMAT "%13.11" ECU_ADDRESS 0x6000F66A /end MEASUREMENT
/begin MEASUREMENT OilSwmpT_flgInit "Flag to indicate initial oil temperature is completed." UBYTE B_TRUE 1 100 0.00 1.00000000000 BIT_MASK 0x1 FORMAT "%13.11" ECU_ADDRESS 0x700007CB /end MEASUREMENT
/begin MEASUREMENT OilSwmpT_flgMdlPrs "Oil temperature model is availiable" UBYTE B_TRUE 1 100 0.00 1.00000000000 BIT_MASK 0x1 FORMAT "%13.11" ECU_ADDRESS 0x700007CA /end MEASUREMENT
/begin MEASUREMENT OilSwmpT_flgMdlRstIni "Reset flag of the Oil temperature model" UBYTE B_TRUE 1 100 0.00 1.00000000000 BIT_MASK 0x1 FORMAT "%13.11" ECU_ADDRESS 0x70000121 /end MEASUREMENT
/begin MEASUREMENT OilSwmpT_flgOilSwmpTCmbdSnsrAvl "Flag to indicalte sensor availability" UBYTE B_TRUE 1 100 0.00 1.00000000000 BIT_MASK 0x1 FORMAT "%13.11" ECU_ADDRESS 0x7000012B /end MEASUREMENT
/begin MEASUREMENT OilSwmpT_flgOilSwmpTMdlAvl "Flag: Oil temperature model available for the substitute value circuit" UBYTE B_TRUE 1 100 0.00 1.00000000000 BIT_MASK 0x1 FORMAT "%13.11" ECU_ADDRESS 0x7000012A /end MEASUREMENT
/begin MEASUREMENT OilSwmpT_flgOilSwmpTSnsrAvl "Status flag: Oil temperature sensor is present and OK" UBYTE B_TRUE 1 100 0.00 1.00000000000 BIT_MASK 0x1 FORMAT "%13.11" ECU_ADDRESS 0x70000129 /end MEASUREMENT
/begin MEASUREMENT OilSwmpT_flgOvrRunActvd "Status of fuel cut-off used for OilSwmpT" UBYTE B_TRUE 1 100 0.00 1.00000000000 BIT_MASK 0x1 FORMAT "%13.11" ECU_ADDRESS 0x70000120 /end MEASUREMENT
/begin MEASUREMENT OilSwmpT_flgOvrRun_loc "Status of fuel cut-off used for OilSwmpT" UBYTE B_TRUE 1 100 0.00 1.00000000000 BIT_MASK 0x1 FORMAT "%13.11" ECU_ADDRESS 0x7000011F /end MEASUREMENT
/begin MEASUREMENT OilSwmpT_flgPULSMdlHi "Flag model value is higher than the sensor value from combi-sensor" UBYTE B_TRUE 1 100 0.00 1.00000000000 BIT_MASK 0x1 FORMAT "%13.11" ECU_ADDRESS 0x70000128 /end MEASUREMENT
/begin MEASUREMENT OilSwmpT_flgTiEngOff_bEngRot_loc "Status of engine rotation used for OilSwmpT" UBYTE B_TRUE 1 100 0.00 1.00000000000 BIT_MASK 0x1 FORMAT "%13.11" ECU_ADDRESS 0x7000011E /end MEASUREMENT
/begin MEASUREMENT OilSwmpT_flgTiEngOff_bRst_loc "Status of B_tengsr for OilSwmpT" UBYTE B_TRUE 1 100 0.00 1.00000000000 BIT_MASK 0x1 FORMAT "%13.11" ECU_ADDRESS 0x7000011D /end MEASUREMENT
/begin MEASUREMENT OilSwmpT_flgTOSPMabVld "Flag: Engine temperature was valid at the time of the shut-off" UBYTE OneToOne 1 100 0.00 1.000 FORMAT "%5.3" ECU_ADDRESS 0x60038E29 /end MEASUREMENT
/begin MEASUREMENT OilSwmpT_flgvdMdlPrsloc "Oil temperature model is availiable" UBYTE B_TRUE 1 100 0.00 1.00000000000 BIT_MASK 0x1 FORMAT "%13.11" ECU_ADDRESS 0x70000127 /end MEASUREMENT
/begin MEASUREMENT OilSwmpT_flgVldTWrmUp "Validity of engine temperature used for Oil temperature model." UBYTE B_TRUE 1 100 0.00 1.00000000000 BIT_MASK 0x1 FORMAT "%13.11" ECU_ADDRESS 0x6000B67A /end MEASUREMENT
/begin MEASUREMENT OilSwmpT_idxTSrc "Index: source of the Oil temperature for OilSwmpT_t" UBYTE OneToOne 1 100 0.00 255.0 FORMAT "%5.1" ECU_ADDRESS 0x6000F794 /end MEASUREMENT
/begin MEASUREMENT OilSwmpT_idxTSrcADC "Index: Source of oil temperature for OilSwmpT_tADC" UBYTE OneToOne 1 100 0.00 255.0 FORMAT "%5.1" ECU_ADDRESS 0x6000B67F /end MEASUREMENT
/begin MEASUREMENT OilSwmpT_idxTSrcDispl "Index: Source of oil temperature for OilSwmpT_tDispl" UBYTE OneToOne 1 100 0.00 255.0 FORMAT "%5.1" ECU_ADDRESS 0x6000B67E /end MEASUREMENT
/begin MEASUREMENT OilSwmpT_idxTSrcPULS "Selection of the oil temperature source for OilSwmpT_tPULS" UBYTE OneToOne 1 100 0.00 255.0 FORMAT "%5.1" ECU_ADDRESS 0x6000B67D /end MEASUREMENT
/begin MEASUREMENT OilSwmpT_nmot "engine speed for the oil temperature model" UBYTE nmot_ub_q40 1 100 0.00 10200. FORMAT "%5.0" ECU_ADDRESS 0x6000F793 /end MEASUREMENT
/begin MEASUREMENT OilSwmpT_stCmbdSnsrRplVal "Status to indicate the replacement value for the oil combined sensor" UBYTE OneToOne 1 100 0.00 255.0 FORMAT "%5.1" ECU_ADDRESS 0x60038E35 /end MEASUREMENT
/begin MEASUREMENT OilSwmpT_stEepReadCEngDsTBkup "EEP Read status" UBYTE OneToOne 1 100 0.00 255.0 FORMAT "%5.1" ECU_ADDRESS 0x6000B673 /end MEASUREMENT
/begin MEASUREMENT OilSwmpT_stEepReadflgFinshd "EEP Read status" UBYTE OneToOne 1 100 0.00 255.0 FORMAT "%5.1" ECU_ADDRESS 0x6000B672 /end MEASUREMENT
/begin MEASUREMENT OilSwmpT_stEepReadMdl "EEP Read status" UBYTE OneToOne 1 100 0.00 255.0 FORMAT "%5.1" ECU_ADDRESS 0x6000B671 /end MEASUREMENT
/begin MEASUREMENT OilSwmpT_stEepReadMtrDisp "EEP Read status" UBYTE OneToOne 1 100 0.00 255.0 FORMAT "%5.1" ECU_ADDRESS 0x6000B670 /end MEASUREMENT
/begin MEASUREMENT OilSwmpT_stMdlElecDrvSaved "State of oil temperature modeling at ECU switch off" UBYTE dez 1 100 0.00 255.0 FORMAT "%5.1" ECU_ADDRESS 0x60038E28 /end MEASUREMENT
/begin MEASUREMENT OilSwmpT_stPwrOnRstTMdl "Status indicates detection of power-On Reset" UBYTE B_TRUE 1 100 0.00 1.00000000000 BIT_MASK 0x1 FORMAT "%13.11" ECU_ADDRESS 0x7000011C /end MEASUREMENT
/begin MEASUREMENT OilSwmpT_stSigT "Signal quality for OilSwmpT_t" ULONG OneToOne 1 100 0.00 4294967295.00 FORMAT "%13.2" ECU_ADDRESS 0x6000379C /end MEASUREMENT
/begin MEASUREMENT OilSwmpT_stSigTADC "Signal quality for OilSwmpT_tADC" ULONG OneToOne 1 100 0.00 4294967295.00 FORMAT "%13.2" ECU_ADDRESS 0x60003798 /end MEASUREMENT
/begin MEASUREMENT OilSwmpT_stSigTDispl "status to indicate signal quality of the sensor value." UBYTE OneToOne 1 100 0.00 255.0 FORMAT "%5.1" ECU_ADDRESS 0x6000F792 /end MEASUREMENT
/begin MEASUREMENT OilSwmpT_stSigTPULS "Signal quality for OilSwmpT_tPULS" ULONG OneToOne 1 100 0.00 4294967295.00 FORMAT "%13.2" ECU_ADDRESS 0x60003794 /end MEASUREMENT
/begin MEASUREMENT OilSwmpT_stTDisplStop "State of the oil temperature for indicating in the combi ECU at the time of engine switch-off" UBYTE OneToOne 1 100 0.00 255.0 FORMAT "%5.1" ECU_ADDRESS 0x6000F791 /end MEASUREMENT
/begin MEASUREMENT OilSwmpT_stTMdl "Status of the oil temperature model" UBYTE OneToOne 1 100 0.00 255.0 FORMAT "%5.1" ECU_ADDRESS 0x6000F78F /end MEASUREMENT
/begin MEASUREMENT OilSwmpT_stTMdl2 "Status of the oil temperature model" UBYTE OneToOne 1 100 0.00 255.0 FORMAT "%5.1" ECU_ADDRESS 0x6000F790 /end MEASUREMENT
/begin MEASUREMENT OilSwmpT_stTMdlloc "local State of the oil temperature model" UBYTE OneToOne 1 100 0.00 255.0 FORMAT "%5.1" ECU_ADDRESS 0x6000B679 /end MEASUREMENT
/begin MEASUREMENT OilSwmpT_stTSnsrRplVal "Status of the state machine of the replacement value switching for the oil-temperature-sensor" UBYTE OneToOne 1 100 0.00 255.0 FORMAT "%5.1" ECU_ADDRESS 0x60038E34 /end MEASUREMENT
/begin MEASUREMENT OilSwmpT_stvdTMdlloc "Status of the oil temperature model" UBYTE OneToOne 1 100 0.00 255.0 FORMAT "%5.1" ECU_ADDRESS 0x6000B67C /end MEASUREMENT
/begin MEASUREMENT OilSwmpT_t "Oil temperature" SWORD Temp_Cels 1 100 -273.140 3003.560 FORMAT "%8.3" ECU_ADDRESS 0x6000903E /end MEASUREMENT
/begin MEASUREMENT OilSwmpT_tADC "Oil Temperature of sensor connected on ADC" SWORD Temp_Cels 1 100 -273.140 3003.560 FORMAT "%8.3" ECU_ADDRESS 0x6000903C /end MEASUREMENT
/begin MEASUREMENT OilSwmpT_tADCFltd "filtered Oil Temperature of sensor connected on ADC" SWORD Temp_Cels 1 100 -273.140 3003.560 FORMAT "%8.3" ECU_ADDRESS 0x6000903A /end MEASUREMENT
/begin MEASUREMENT OilSwmpT_tADCFltdStop "filtered Oil Temperature of sensor connected on ADC at Engine stop" SWORD Temp_Cels 1 100 -273.140 3003.560 FORMAT "%8.3" ECU_ADDRESS 0x60009038 /end MEASUREMENT
/begin MEASUREMENT OilSwmpT_tADCFltdStop_Sq "Signal quality of filtered Oil Temperature of sensor connected on ADC at Engine stop" UBYTE SigQly_COMPU_VERB 1 100 0.00 15.0000000000 FORMAT "%13.10" ECU_ADDRESS 0x6000F78E /end MEASUREMENT
/begin MEASUREMENT OilSwmpT_tADCFltd_Sq "Signal quality of filtered Oil Temperature of sensor connected on ADC" UBYTE SigQly_COMPU_VERB 1 100 0.00 15.0000000000 FORMAT "%13.10" ECU_ADDRESS 0x6000F78D /end MEASUREMENT
/begin MEASUREMENT OilSwmpT_tADCStop "Oil Temperature of sensor connected on ADC at Engine stop" SWORD Temp_Cels 1 100 -273.140 3003.560 FORMAT "%8.3" ECU_ADDRESS 0x60009036 /end MEASUREMENT
/begin MEASUREMENT OilSwmpT_tADCStop_Sq "signal quality for oil temperature at engine stop (oil temperature sensor only)" UBYTE SigQly_COMPU_VERB 1 100 0.00 15.0000000000 FORMAT "%13.10" ECU_ADDRESS 0x6000F78C /end MEASUREMENT
/begin MEASUREMENT OilSwmpT_tADC_Sq "signal quality for oil temperature (oil temperature sensor only)" UBYTE SigQly_COMPU_VERB 1 100 0.00 15.0000000000 FORMAT "%13.10" ECU_ADDRESS 0x6000F78B /end MEASUREMENT
/begin MEASUREMENT OilSwmpT_tAdprSnsrFildLoc "filtered Oil Temperature of sensor" SWORD Temp_Cels 1 100 -273.140 3003.560 FORMAT "%8.3" ECU_ADDRESS 0x60007222 /end MEASUREMENT
/begin MEASUREMENT OilSwmpT_tAdprSnsrLoc "Sensed value of Oil Temperature" SWORD Temp_Cels 1 100 -273.140 3003.560 FORMAT "%8.3" ECU_ADDRESS 0x60007220 /end MEASUREMENT
/begin MEASUREMENT OilSwmpT_tCEngDsTBkup "Back up engine coolant temperature." SWORD Temp_Cels 1 100 -3549.940 3003.560 FORMAT "%8.3" ECU_ADDRESS 0x600071F2 /end MEASUREMENT
/begin MEASUREMENT OilSwmpT_tDifCEngDsTEnvT "Difference between engine coolant temperature and the ambient temperature model value for Oil deterioration system to calulate engine off time coefficient." SWORD Temp_Cels 1 100 -3549.940 3003.560 FORMAT "%8.3" ECU_ADDRESS 0x60000E92 /end MEASUREMENT
/begin MEASUREMENT OilSwmpT_tDifCEngDsTEnvTOld "Difference between back up coolant temperature and the ambient temperature model value for Oil deterioration system to calulate engine off time coefficient." SWORD Temp_Cels 1 100 -3549.940 3003.560 FORMAT "%8.3" ECU_ADDRESS 0x60000E90 /end MEASUREMENT
/begin MEASUREMENT OilSwmpT_tDifEngSpdAirMCoeff "Difference between heat coefficient temperature and engine speed coefficient temperature." SLONG RBPtCel_t_1p52588em5_1 1 100 -32768.0000000 32767.9999847 FORMAT "%13.7" ECU_ADDRESS 0x50000F5C /end MEASUREMENT
/begin MEASUREMENT OilSwmpT_tDifEngSpdCoeff "Engine speed coefficient temperature" SLONG RBPtCel_t_1p52588em5_1 1 100 -32768.0000000 32767.9999847 FORMAT "%13.7" ECU_ADDRESS 0x60000E8C /end MEASUREMENT
/begin MEASUREMENT OilSwmpT_tdiffElecDrv "Difference in oil sump and ambient temperature" SWORD temp_q0p0234_o273 1 100 -273.1500 494.8266 FORMAT "%8.4" ECU_ADDRESS 0x60007214 /end MEASUREMENT
/begin MEASUREMENT OilSwmpT_tDifMdl "Differnce between model value for oil temperature and the ambient temperature model value for Oil deterioration system to calculate initial oil temperature." SWORD Temp_Cels 1 100 -3549.940 3003.560 FORMAT "%8.3" ECU_ADDRESS 0x60000E88 /end MEASUREMENT
/begin MEASUREMENT OilSwmpT_tDifVehSpdCoeff "Vehicle speed coefficient temperature to calculate model value for oil temperature." SLONG RBPtCel_t_1p52588em5_1 1 100 -32768.0000000 32767.9999847 FORMAT "%13.7" ECU_ADDRESS 0x60000E84 /end MEASUREMENT
/begin MEASUREMENT OilSwmpT_tDispl "Oil Temperature for the display in the cockpit" SWORD Temp_Cels 1 100 -273.140 3003.560 FORMAT "%8.3" ECU_ADDRESS 0x60009034 /end MEASUREMENT
/begin MEASUREMENT OilSwmpT_tDisplFltd "filtered Oil Temperature for the display in the cockpit" SWORD Temp_Cels 1 100 -273.140 3003.560 FORMAT "%8.3" ECU_ADDRESS 0x60009032 /end MEASUREMENT
/begin MEASUREMENT OilSwmpT_tDisplFltdStop "filtered Oil Temperature for the display in the cockpit at engine stop" SWORD Temp_Cels 1 100 -273.140 3003.560 FORMAT "%8.3" ECU_ADDRESS 0x60009030 /end MEASUREMENT
/begin MEASUREMENT OilSwmpT_tDisplStop "Oil Temperature for the display in the cockpit at engine stop" SWORD Temp_Cels 1 100 -273.140 3003.560 FORMAT "%8.3" ECU_ADDRESS 0x6000902E /end MEASUREMENT
/begin MEASUREMENT OilSwmpT_tEngOffTiCoeff "Engine off time coefficient temperature to calculate initial oil temperature" SWORD Temp_Cels 1 100 -3549.940 3003.560 FORMAT "%8.3" ECU_ADDRESS 0x60000E80 /end MEASUREMENT
/begin MEASUREMENT OilSwmpT_tFltd "filtered Oil Temperature" SWORD Temp_Cels 1 100 -273.140 3003.560 FORMAT "%8.3" ECU_ADDRESS 0x6000902C /end MEASUREMENT
/begin MEASUREMENT OilSwmpT_tFltdStop "filtered Oil Temperature at engine stop" SWORD Temp_Cels 1 100 -273.140 3003.560 FORMAT "%8.3" ECU_ADDRESS 0x6000902A /end MEASUREMENT
/begin MEASUREMENT OilSwmpT_tFltdStop_Sq "Signal quality of filtered Oil Temperature at engine stop" UBYTE SigQly_COMPU_VERB 1 100 0.00 15.0000000000 FORMAT "%13.10" ECU_ADDRESS 0x6000F78A /end MEASUREMENT
/begin MEASUREMENT OilSwmpT_tFltd_Sq "Signal quality of filtered Oil Temperature" UBYTE SigQly_COMPU_VERB 1 100 0.00 15.0000000000 FORMAT "%13.10" ECU_ADDRESS 0x6000F789 /end MEASUREMENT
/begin MEASUREMENT OilSwmpT_tHeatCoeff "Map to claculate heat coefficient based on engine speed and intake air mass." UWORD RBPtCel_t_1p52588em5_1 1 100 0.00 0.9999847 FORMAT "%9.7" ECU_ADDRESS 0x60000E7E /end MEASUREMENT
/begin MEASUREMENT OilSwmpT_tiCmbdSnsrNoVal "Zeit für den Öl-Kombi-Sensor wenn kein gültiger Sensorwert vorliegt" SLONG Per_Dur 1 100 -2147483648.00 2147483647.00 FORMAT "%13.2" ECU_ADDRESS 0x60038E30 /end MEASUREMENT
/begin MEASUREMENT OilSwmpT_tiEcuOn "Time between the Switch-Off of Motor and the Switch-Off of ECU" SLONG t_q1 1 100 -2147483648.00 2147483647.00 FORMAT "%13.2" ECU_ADDRESS 0x60038E24 /end MEASUREMENT
/begin MEASUREMENT OilSwmpT_tiEngOff "Engine Off Time used for model of oil temperature ans plausibility checks" SLONG t_q1 1 100 0.00 2147483647.00 FORMAT "%13.2" ECU_ADDRESS 0x50004FE4 /end MEASUREMENT
/begin MEASUREMENT OilSwmpT_tiEngOffTi "Engine off time calculated based on engine coolant temperature" UWORD t_q10 1 100 0.00 327670.0 FORMAT "%8.1" ECU_ADDRESS 0x60000E7C /end MEASUREMENT
/begin MEASUREMENT OilSwmpT_tInit "Initial oil temperature for model value calculation of oil temperature" SWORD Temp_Cels 1 100 -3549.940 3003.560 FORMAT "%8.3" ECU_ADDRESS 0x60000E7A /end MEASUREMENT
/begin MEASUREMENT OilSwmpt_tIntkSnsr "selected intake air temperature" SWORD Temp_Cels 1 100 -3549.940 3003.560 FORMAT "%8.3" ECU_ADDRESS 0x60000E78 /end MEASUREMENT
/begin MEASUREMENT OilSwmpT_tiTSnsrNoVal "no valid value from the Oil temperature sensor" SLONG Per_Dur 1 100 -2147483648.00 2147483647.00 FORMAT "%13.2" ECU_ADDRESS 0x60038E2C /end MEASUREMENT
/begin MEASUREMENT OilSwmpT_tMdl "Modelled Oil temperature" SWORD Temp_Cels 1 100 -273.140 3003.560 FORMAT "%8.3" ECU_ADDRESS 0x60009026 /end MEASUREMENT
/begin MEASUREMENT OilSwmpT_tMdl2 "Model value for Oil deterioration system: Temperature of oil in sump" SWORD Temp_Cels 1 100 -3549.940 3003.560 FORMAT "%8.3" ECU_ADDRESS 0x60009028 /end MEASUREMENT
/begin MEASUREMENT OilSwmpT_tMdlElecDrv "oil temperature in sump in operating state Engine off, ECU on" UWORD temp_q0p0234_o273 1 100 -273.150 1262.827 FORMAT "%8.3" ECU_ADDRESS 0x60007212 /end MEASUREMENT
/begin MEASUREMENT OilSwmpT_tMdlElecDrvFild "oil temperature in sump in operating state Engine off, ECU on, filtered" UWORD temp_q0p0234_o273 1 100 -273.150 1262.827 FORMAT "%8.3" ECU_ADDRESS 0x60007210 /end MEASUREMENT
/begin MEASUREMENT OilSwmpT_tMdlElecDrvSaved "oil temperature in oil sump at ECU Switch-Off" UWORD temp_q0p0234_o273 1 100 -273.150 1262.827 FORMAT "%8.3" ECU_ADDRESS 0x60038E22 /end MEASUREMENT
/begin MEASUREMENT OilSwmpT_tMdlloc "Modelled Oil temperature (local copy)" SWORD Temp_Cels 1 100 -273.140 3003.560 FORMAT "%8.3" ECU_ADDRESS 0x6000720E /end MEASUREMENT
/begin MEASUREMENT OilSwmpT_tMdlStop "Modelled Oil temperature at enginge stop" SWORD Temp_Cels 1 100 -273.140 3003.560 FORMAT "%8.3" ECU_ADDRESS 0x60009024 /end MEASUREMENT
/begin MEASUREMENT OilSwmpT_tMdlTmp "Modelled Oil temperature (local variable)" SWORD Temp_Cels 1 100 -273.140 3003.560 FORMAT "%8.3" ECU_ADDRESS 0x6000720C /end MEASUREMENT
/begin MEASUREMENT OilSwmpT_tMtrDisp "Estimated oil temperature for meter display" SWORD Temp_Cels 1 100 -3549.940 3003.560 FORMAT "%8.3" ECU_ADDRESS 0x60009022 /end MEASUREMENT
/begin MEASUREMENT OilSwmpT_tospmloc "Local variable for OilSwmpT model temperature" UBYTE temp_ub_q0p75_o48 1 100 -48.0 143.3 FORMAT "%5.1" ECU_ADDRESS 0x6000B678 /end MEASUREMENT
/begin MEASUREMENT OilSwmpT_tospmloc_w "Local variable for OilSwmpT model temperature" UWORD temp_q0p0234_o273 1 100 -273.150 1262.827 FORMAT "%8.3" ECU_ADDRESS 0x6000720A /end MEASUREMENT
/begin MEASUREMENT OilSwmpT_tPid5C "PID5C Tester inteface for Oil temperature sensor" SWORD Temp_Cels 1 100 -3549.940 3003.560 FORMAT "%8.3" ECU_ADDRESS 0x60009018 /end MEASUREMENT
/begin MEASUREMENT OilSwmpT_tPistCoolgFild "The additional temperature because of the activation of the piston cooling, filtered" UWORD temp_q0p0234_o273 1 100 -273.150 1262.827 FORMAT "%8.3" ECU_ADDRESS 0x60007208 /end MEASUREMENT
/begin MEASUREMENT OilSwmpT_tPULS "Oil Temperature of the Oil-Combined-Sensor" SWORD Temp_Cels 1 100 -273.140 3003.560 FORMAT "%8.3" ECU_ADDRESS 0x60009020 /end MEASUREMENT
/begin MEASUREMENT OilSwmpT_tPULSFltd "filtered Oil Temperature of the Oil-Combined-Sensor" SWORD Temp_Cels 1 100 -273.140 3003.560 FORMAT "%8.3" ECU_ADDRESS 0x6000901E /end MEASUREMENT
/begin MEASUREMENT OilSwmpT_tPULSFltdStop "filtered Oil Temperature of the Oil-Combined-Sensor at engine stop" SWORD Temp_Cels 1 100 -273.140 3003.560 FORMAT "%8.3" ECU_ADDRESS 0x6000901C /end MEASUREMENT
/begin MEASUREMENT OilSwmpT_tPULSFltdStop_Sq "Signal quality of filtered Oil Temperature of the Oil-Combined-Sensor at engine stop" UBYTE SigQly_COMPU_VERB 1 100 0.00 15.0000000000 FORMAT "%13.10" ECU_ADDRESS 0x6000F788 /end MEASUREMENT
/begin MEASUREMENT OilSwmpT_tPULSFltd_Sq "Signal quality of filtered Oil Temperature of the Oil-Combined-Sensor" UBYTE SigQly_COMPU_VERB 1 100 0.00 15.0000000000 FORMAT "%13.10" ECU_ADDRESS 0x6000F787 /end MEASUREMENT
/begin MEASUREMENT OilSwmpT_tPULSStop "filtered Oil Temperature of the Oil-Combined-Sensor at engine stop" SWORD Temp_Cels 1 100 -273.140 3003.560 FORMAT "%8.3" ECU_ADDRESS 0x6000901A /end MEASUREMENT
/begin MEASUREMENT OilSwmpT_tPULSStop_Sq "signal quality for oil temperature at engine stop (oil combined sensor)" UBYTE SigQly_COMPU_VERB 1 100 0.00 15.0000000000 FORMAT "%13.10" ECU_ADDRESS 0x6000F786 /end MEASUREMENT
/begin MEASUREMENT OilSwmpT_tPULS_Sq "signal quality for oil temperature (oil combined sensor)" UBYTE SigQly_COMPU_VERB 1 100 0.00 15.0000000000 FORMAT "%13.10" ECU_ADDRESS 0x6000F785 /end MEASUREMENT
/begin MEASUREMENT OilSwmpT_tStop "Oil Temperature at engine stop" SWORD Temp_Cels 1 100 -273.140 3003.560 FORMAT "%8.3" ECU_ADDRESS 0x60009016 /end MEASUREMENT
/begin MEASUREMENT OilSwmpT_tStop_Sq "signal quality for oil temperature at engine stop" UBYTE SigQly_COMPU_VERB 1 100 0.00 15.0000000000 FORMAT "%13.10" ECU_ADDRESS 0x6000F784 /end MEASUREMENT
/begin MEASUREMENT OilSwmpT_tTmp "Temporary oil temperature for the model value calulation." SLONG RBPtCel_t_1p52588em5_1 1 100 -32768.0000000 32767.9999847 FORMAT "%13.7" ECU_ADDRESS 0x60000E74 /end MEASUREMENT
/begin MEASUREMENT OilSwmpT_tumg "ambient air temperature" UBYTE temp_ub_q0p75_o48 1 100 -48.0 143.3 FORMAT "%5.1" ECU_ADDRESS 0x6000F782 /end MEASUREMENT
/begin MEASUREMENT OilSwmpT_tvdCEngDsTloc "Local copy of the CEngDsT_t in the FC OilSwmpT_VD" SWORD Temp_Cels 1 100 -3549.940 3003.560 FORMAT "%8.3" ECU_ADDRESS 0x6000721C /end MEASUREMENT
/begin MEASUREMENT OilSwmpT_tvdMdlloc "Modelled Oil temperature" SWORD Temp_Cels 1 100 -273.140 3003.560 FORMAT "%8.3" ECU_ADDRESS 0x6000721A /end MEASUREMENT
/begin MEASUREMENT OilSwmpT_tWrmUp "Engine temperature used for Oil temperature model" UBYTE temp_ub_q0p75_o48 1 100 -48.0 143.3 FORMAT "%5.1" ECU_ADDRESS 0x6000B677 /end MEASUREMENT
/begin MEASUREMENT OilSwmpT_tWrmUpFild "filtered engine coolant temperature" UWORD temp_ub_q0p75_o48 1 100 -48.0000 143.2500 FORMAT "%8.4" ECU_ADDRESS 0x60007206 /end MEASUREMENT
/begin MEASUREMENT OilSwmpT_tWrmUpHeatgCorrn "temperature correction due to influence of heating" UWORD temp_q0p0234_o273 1 100 -273.150 1262.827 FORMAT "%8.3" ECU_ADDRESS 0x60007204 /end MEASUREMENT
/begin MEASUREMENT OilSwmpT_t_Sq "Signal Qualitiy of oil temperature" UBYTE SigQly_COMPU_VERB 1 100 0.00 15.0000000000 FORMAT "%13.10" ECU_ADDRESS 0x6000F783 /end MEASUREMENT
/begin MEASUREMENT OilSwmpT_vfzg "vehicle speed (kmh)" UBYTE vfzg_ub_q1p25 1 100 0.00 318.8 FORMAT "%5.1" ECU_ADDRESS 0x6000F781 /end MEASUREMENT
/begin MEASUREMENT OilT_stTSensDsplNoAvl "A temperaturesensor is availiable for the display" UBYTE OneToOne 1 100 0.00 255.0 FORMAT "%5.1" ECU_ADDRESS 0x6000F780 /end MEASUREMENT
/begin MEASUREMENT Oil_bPWarn "signal low oil pressure warning, from oil pressure switch, debounced" UBYTE B_TRUE 1 100 0.00 1.00000000000 BIT_MASK 0x1 FORMAT "%13.11" ECU_ADDRESS 0x700007C9 /end MEASUREMENT
/begin MEASUREMENT Oil_p "Oil pressure engine" SWORD Pres 1 100 -3276.800 3276.700 FORMAT "%8.3" ECU_ADDRESS 0x60009014 /end MEASUREMENT
/begin MEASUREMENT Oil_pAbs "absolute oil pressure" SWORD Pres 1 100 0.00 1638.300 FORMAT "%8.3" ECU_ADDRESS 0x60009012 /end MEASUREMENT
/begin MEASUREMENT Oil_pMin "Minimum oil pressure engine at operation point (engine speed, temperature)" SWORD Pres 1 100 0.00 1638.300 FORMAT "%8.3" ECU_ADDRESS 0x60009010 /end MEASUREMENT
/begin MEASUREMENT Oil_pRel "relative oil pressure" SWORD Pres 1 100 -409.500 1638.300 FORMAT "%8.3" ECU_ADDRESS 0x6000900E /end MEASUREMENT
/begin MEASUREMENT Oil_pSensPSwmp "Sensed value of the Oil pressure." SWORD Pres_hPa 1 100 -32768.00 32767.00 FORMAT "%8.2" ECU_ADDRESS 0x6000900C /end MEASUREMENT
/begin MEASUREMENT Oil_pSnsrSel_mp "Selected Oil pressure from sensor" SWORD Pres 1 100 0.00 1638.300 FORMAT "%8.3" ECU_ADDRESS 0x7000A110 /end MEASUREMENT
/begin MEASUREMENT Oil_p_Sq "signal quality message for oil pressure error" UBYTE SigQly_COMPU_VERB 1 100 0.00 15.0000000000 FORMAT "%13.10" ECU_ADDRESS 0x6000F77F /end MEASUREMENT
/begin MEASUREMENT Oil_stSensPSwmp "Sensed value of the oil pressure status" UBYTE OneToOne 1 100 0.00 255.0 FORMAT "%5.1" ECU_ADDRESS 0x6000F77E /end MEASUREMENT
/begin MEASUREMENT Oil_swtADCPresT "Switch information which provides if oil temperature sensor from ADC is present or not" UBYTE OneToOne 1 100 0.00 255.0 FORMAT "%5.1" ECU_ADDRESS 0x6000F77D /end MEASUREMENT
/begin MEASUREMENT Oil_swtCANPresT "Switch information which provides if oil temperature signal via CAN is present or not" UBYTE OneToOne 1 100 0.00 255.0 FORMAT "%5.1" ECU_ADDRESS 0x6000F77C /end MEASUREMENT
/begin MEASUREMENT Oil_swtSensPresT "Switch information which provides if oil temperature sensor is present or not" UBYTE OneToOne 1 100 0.00 255.0 FORMAT "%5.1" ECU_ADDRESS 0x6000F77B /end MEASUREMENT
/begin MEASUREMENT Oil_swtSigT "Switch that determines the mode of calc" UBYTE OneToOne 1 100 0.00 255.0 FORMAT "%5.1" ECU_ADDRESS 0x6000F77A /end MEASUREMENT
/begin MEASUREMENT Oil_tADC "Oil temperature from ADC" SWORD Temp_Cels 1 100 -273.140 3003.560 FORMAT "%8.3" ECU_ADDRESS 0x6000900A /end MEASUREMENT
/begin MEASUREMENT Oil_tADCGradLtd "Oil temperature from ADC with limited increase" SWORD Temp_Cels 1 100 -273.140 3003.560 FORMAT "%8.3" ECU_ADDRESS 0x60009008 /end MEASUREMENT
/begin MEASUREMENT Oil_tPULS "Oil temperature from PULS sensor" SWORD Temp_Cels 1 100 -273.140 3003.560 FORMAT "%8.3" ECU_ADDRESS 0x60009006 /end MEASUREMENT
/begin MEASUREMENT Oil_tPULSGradLtd "Oil temperature from PULS sensor with limited increase" SWORD Temp_Cels 1 100 -273.140 3003.560 FORMAT "%8.3" ECU_ADDRESS 0x60009004 /end MEASUREMENT
/begin MEASUREMENT Oil_tSensADC "Sensed value of oil temperature from ADC" SWORD Temp_Cels 1 100 -273.140 3003.560 FORMAT "%8.3" ECU_ADDRESS 0x60009002 /end MEASUREMENT
/begin MEASUREMENT Oil_tSensPULS "Sensed value of oil temperature from PULS sensor" SWORD Temp_Cels 1 100 -273.140 3003.560 FORMAT "%8.3" ECU_ADDRESS 0x60009000 /end MEASUREMENT
/begin MEASUREMENT Oil_tSensTSwmp "Sensed value of Oil Temperature" SWORD Temp_Cels 1 100 -273.140 3003.560 FORMAT "%8.3" ECU_ADDRESS 0x60008FFE /end MEASUREMENT
/begin MEASUREMENT Oil_tSwmp "Oil temperature in oil sump" SWORD Temp_Cels 1 100 -273.140 3003.560 FORMAT "%8.3" ECU_ADDRESS 0x6001491E /end MEASUREMENT
/begin MEASUREMENT Oil_tSwmpGradLtd "Oil temperature with limited increase" SWORD Temp_Cels 1 100 -273.140 3003.560 FORMAT "%8.3" ECU_ADDRESS 0x60008FFC /end MEASUREMENT
/begin MEASUREMENT Oil_uRawPSwmp "Raw value of voltage from the ADC." SWORD Volt 1 100 -6553.600 6553.400 FORMAT "%8.3" ECU_ADDRESS 0x60008FFA /end MEASUREMENT
/begin MEASUREMENT Oil_uRawTSwmp "Raw voltage of oil temperature signal from oil sump" SWORD Volt 1 100 -6553.600 6553.400 FORMAT "%8.3" ECU_ADDRESS 0x60008FF8 /end MEASUREMENT
/begin MEASUREMENT PCUECU_ctRngPCU_MP "Alive counter measurement point" UBYTE OneToOne 1 100 0.00 255.0 FORMAT "%5.1" ECU_ADDRESS 0x7000A10E /end MEASUREMENT
/begin MEASUREMENT PhyMod_ctTqJDrvEnter "Filtered enginespeed for calcualtion of moment of inertia" UBYTE OneToOne 1 100 0.00 255.0 FORMAT "%5.1" ECU_ADDRESS 0x6000FBB2 /end MEASUREMENT
/begin MEASUREMENT PhyMod_dmFuCns "Volumetric flow of fuel in kg per h" SWORD InjMassPerTime 1 100 -327.6800 327.6700 FORMAT "%8.4" ECU_ADDRESS 0x600071F0 /end MEASUREMENT
/begin MEASUREMENT PhyMod_dnEngDerFild "Filtered enginespeed for calcualtion of moment of inertia" SWORD nmotgrd_q2 1 100 -65536.00 65534.00 FORMAT "%8.2" ECU_ADDRESS 0x700052AA /end MEASUREMENT
/begin MEASUREMENT PhyMod_dnEngDerFild_mp "Filtered enginespeed for calcualtion of moment of inertia" SWORD nmotgrd_q2 1 100 -65536.00 65534.00 FORMAT "%8.2" ECU_ADDRESS 0x7000A10C /end MEASUREMENT
/begin MEASUREMENT PhyMod_dnEngDerUnFild "Unfiltered engine speed gradient" SWORD nmotgrd_q2 1 100 -65536.00 65534.00 FORMAT "%8.2" ECU_ADDRESS 0x60013D94 /end MEASUREMENT
/begin MEASUREMENT PhyMod_dnEngDerUnFild_mp "Unfiltered engine speed gradient" SWORD nmotgrd_q2 1 100 -65536.00 65534.00 FORMAT "%8.2" ECU_ADDRESS 0x7000A10A /end MEASUREMENT
/begin MEASUREMENT PhyMod_jCmbEng "Moment of inertia of the combustion engine" UWORD j_q0p000153 1 100 0.00 9.999847 FORMAT "%8.6" ECU_ADDRESS 0x700053B8 /end MEASUREMENT
/begin MEASUREMENT PhyMod_jEng "Moment of inertia" SWORD Moment_Inertia 1 100 -327.6800 327.6700 FORMAT "%8.4" ECU_ADDRESS 0x700053BA /end MEASUREMENT
/begin MEASUREMENT PhyMod_pwrClntEntry "heat insertion of engine into coolant agent" SWORD Pwr2 1 100 -617662.2 617643.4 FORMAT "%8.1" ECU_ADDRESS 0x60008FF2 /end MEASUREMENT
/begin MEASUREMENT PhyMod_pwrEgLoss "Power loss to exhaust gas" SLONG Pwr2 1 100 -40479113113.6 40479113094.7 FORMAT "%13.1" ECU_ADDRESS 0x600026B0 /end MEASUREMENT
/begin MEASUREMENT PhyMod_pwrLos "Total energy loss dissipated in the engine" SLONG Pwr2 1 100 -40479113113.6 40479113094.7 FORMAT "%13.1" ECU_ADDRESS 0x600037D4 /end MEASUREMENT
/begin MEASUREMENT PhyMod_pwrTheo "Theoretically supplied power" SLONG Pwr2 1 100 -40479113113.6 40479113094.7 FORMAT "%13.1" ECU_ADDRESS 0x600037D0 /end MEASUREMENT
/begin MEASUREMENT PhyMod_pwrTheoloc "theoretical supplied power local variable" SLONG Pwr2 1 100 -40479113113.6 40479113094.7 FORMAT "%13.1" ECU_ADDRESS 0x50001CCC /end MEASUREMENT
/begin MEASUREMENT PhyMod_tiDerEngFil_mp "Timeconstant for enginespeed filter" SWORD TimeDelay_s_Lin_16 1 100 0.000153 5.000000 FORMAT "%8.6" ECU_ADDRESS 0x7000A108 /end MEASUREMENT
/begin MEASUREMENT PhyMod_tqJEng "Resulting torque from inertia" SWORD Trq 1 100 -3276.800 3276.700 FORMAT "%8.3" ECU_ADDRESS 0x700053BC /end MEASUREMENT
/begin MEASUREMENT PID51_stFuTyp "current type of the combustion engine" UBYTE OneToOne 1 100 0.00 255.0 FORMAT "%5.1" ECU_ADDRESS 0x6000F778 /end MEASUREMENT
/begin MEASUREMENT PIDA6_lDstDrvngCyc "Distance traveled in the current driving cycle" ULONG RBPtCel_dst_0p1_2 1 100 0.00 429496729.500 FORMAT "%13.3" ECU_ADDRESS 0x50004FEC /end MEASUREMENT
/begin MEASUREMENT PIDA6_lDstStrt "Traveled distance at the start of the current driving cycle" ULONG RBPtCel_dst_0p1_2 1 100 0.00 429496729.500 FORMAT "%13.3" ECU_ADDRESS 0x60013028 /end MEASUREMENT
/begin MEASUREMENT PIDA6_lTotDst "Total travelled distance for PIDA6" ULONG RBPtCel_dst_0p1_2 1 100 0.00 429496729.500 FORMAT "%13.3" ECU_ADDRESS 0x50004FF0 /end MEASUREMENT
/begin MEASUREMENT PIDA6_lTotDstLstStored "Last value of total distance in EEP" ULONG RBPtCel_dst_0p1_2 1 100 0.00 429496729.500 FORMAT "%13.3" ECU_ADDRESS 0x600365D8 /end MEASUREMENT
/begin MEASUREMENT PIDA6_lTotDstProtd "Total travelled distance for PIDA6 in Protected Ram" ULONG RBPtCel_dst_0p1_2 1 100 0.00 429496729.500 FORMAT "%13.3" ECU_ADDRESS 0x600365D4 /end MEASUREMENT
/begin MEASUREMENT PIDA6_stEepOrder "Return value of EEP write function" UBYTE OneToOne 1 100 0.00 255.0 FORMAT "%5.1" ECU_ADDRESS 0x6000B66F /end MEASUREMENT
/begin MEASUREMENT PIDA6_stEepWrite "State machine for direct write to EEP" UBYTE OneToOne 1 100 0.00 255.0 FORMAT "%5.1" ECU_ADDRESS 0x6000B66E /end MEASUREMENT
/begin MEASUREMENT PIntkVUs_dpRaw "differential raw intake manifold pressure (gradient)" SWORD pgrd_q0p3125 1 100 -10240.00 10239.69 FORMAT "%8.2" ECU_ADDRESS 0x70003A64 /end MEASUREMENT
/begin MEASUREMENT PIntkVUs_flgIniFinshdB1 "alculation of pRawIni-raw-pressure during initialization finished, bank 1" UBYTE B_TRUE 1 100 0.00 1.00000000000 BIT_MASK 0x1 FORMAT "%13.11" ECU_ADDRESS 0x6000B66D /end MEASUREMENT
/begin MEASUREMENT PIntkVUs_flgPRawIniVldB1 "Validity status for raw pressure before engine starts - Bank 1" UBYTE B_TRUE 1 100 0.00 1.00000000000 BIT_MASK 0x1 FORMAT "%13.11" ECU_ADDRESS 0x6000F927 /end MEASUREMENT
/begin MEASUREMENT PIntkVUs_flgPRawVldB1 "validity for raw pressure of intake manifold pressure bank1" UBYTE B_TRUE 1 100 0.00 1.00000000000 BIT_MASK 0x1 FORMAT "%13.11" ECU_ADDRESS 0x700007B2 /end MEASUREMENT
/begin MEASUREMENT PIntkVUs_flgPRawVldLocSynBasdB1 "Validity of the rawsignal of manifold pressure (synchronous raster, local variable) bank1" UBYTE B_TRUE 1 100 0.00 1.00000000000 BIT_MASK 0x1 FORMAT "%13.11" ECU_ADDRESS 0x7000011B /end MEASUREMENT
/begin MEASUREMENT PIntkVUs_flgPRawVldLocTiBasdB1 "Validity of the rawsignal of manifold pressure (timebased, local variable) bank1" UBYTE B_TRUE 1 100 0.00 1.00000000000 BIT_MASK 0x1 FORMAT "%13.11" ECU_ADDRESS 0x7000011A /end MEASUREMENT
/begin MEASUREMENT PIntkVUs_flgPRawVldTiBasdB1 "Validity for raw pressure of intake manifold pressure (timebased) bank1" UBYTE B_TRUE 1 100 0.00 1.00000000000 BIT_MASK 0x1 FORMAT "%13.11" ECU_ADDRESS 0x700007B1 /end MEASUREMENT
/begin MEASUREMENT PIntkVUs_flgRngErrMaxLocSyn "raw high range signal flag(synchronous raster,local variable)" UBYTE B_TRUE 1 100 0.00 1.00000000000 BIT_MASK 0x1 FORMAT "%13.11" ECU_ADDRESS 0x6000098D /end MEASUREMENT
/begin MEASUREMENT PIntkVUs_flgRngErrMaxLocTi "raw high range signal flag (timebased, local variable)" UBYTE B_TRUE 1 100 0.00 1.00000000000 BIT_MASK 0x1 FORMAT "%13.11" ECU_ADDRESS 0x6000F926 /end MEASUREMENT
/begin MEASUREMENT PIntkVUs_flgRngErrMaxSyn "raw high range signal flag (synchronous raster)" UBYTE B_TRUE 1 100 0.00 1.00000000000 BIT_MASK 0x1 FORMAT "%13.11" ECU_ADDRESS 0x500009B3 /end MEASUREMENT
/begin MEASUREMENT PIntkVUs_flgRngErrMaxTi "raw high range signal flag (timebased)" UBYTE B_TRUE 1 100 0.00 1.00000000000 BIT_MASK 0x1 FORMAT "%13.11" ECU_ADDRESS 0x6000F925 /end MEASUREMENT
/begin MEASUREMENT PIntkVUs_flgRngErrMinLocSyn "raw low range signal flag(synchronous raster,local variable)" UBYTE B_TRUE 1 100 0.00 1.00000000000 BIT_MASK 0x1 FORMAT "%13.11" ECU_ADDRESS 0x6000098E /end MEASUREMENT
/begin MEASUREMENT PIntkVUs_flgRngErrMinLocTi "raw low range signal flag (timebased, local variable)" UBYTE B_TRUE 1 100 0.00 1.00000000000 BIT_MASK 0x1 FORMAT "%13.11" ECU_ADDRESS 0x6000F924 /end MEASUREMENT
/begin MEASUREMENT PIntkVUs_flgRngErrMinSyn "raw low range signal flag (synchronous raster)" UBYTE B_TRUE 1 100 0.00 1.00000000000 BIT_MASK 0x1 FORMAT "%13.11" ECU_ADDRESS 0x500009B4 /end MEASUREMENT
/begin MEASUREMENT PIntkVUs_flgRngErrMinTi "raw low range signal flag (timebased)" UBYTE B_TRUE 1 100 0.00 1.00000000000 BIT_MASK 0x1 FORMAT "%13.11" ECU_ADDRESS 0x6000F923 /end MEASUREMENT
/begin MEASUREMENT PIntkVUs_nrRawCnt "counter for number of raw values for averaging" ULONG OneToOne 1 100 0.00 4294967295.00 FORMAT "%13.2" ECU_ADDRESS 0x500006A8 /end MEASUREMENT
/begin MEASUREMENT PIntkVUs_nrRawCntSynBasd "counter for number of raw values for averaging (synchronous raster)" ULONG OneToOne 1 100 0.00 4294967295.00 FORMAT "%13.2" ECU_ADDRESS 0x70001F90 /end MEASUREMENT
/begin MEASUREMENT PIntkVUs_nrRawCntTiBasd "counter for number of raw values for averaging (timebased)" ULONG OneToOne 1 100 0.00 4294967295.00 FORMAT "%13.2" ECU_ADDRESS 0x6001302C /end MEASUREMENT
/begin MEASUREMENT PIntkVUs_pRaw "Intake manifold pressure rawvalue" UWORD p_q0p078 1 100 0.00 5119.922 FORMAT "%8.3" ECU_ADDRESS 0x6000072C /end MEASUREMENT
/begin MEASUREMENT PIntkVUs_pRawB1 "Intake manifold pressure rawvalue - Bank 1" UWORD p_q0p078 1 100 0.00 5119.922 FORMAT "%8.3" ECU_ADDRESS 0x70003804 /end MEASUREMENT
/begin MEASUREMENT PIntkVUs_pRawIni "Raw pressure during initialization before engine starts" UWORD p_q0p078 1 100 0.00 5119.922 FORMAT "%8.3" ECU_ADDRESS 0x600093F2 /end MEASUREMENT
/begin MEASUREMENT PIntkVUs_pRawIniB1 "Raw pressure during initialization before engine starts - Bank 1" UWORD p_q0p078 1 100 0.00 5119.922 FORMAT "%8.3" ECU_ADDRESS 0x600093F0 /end MEASUREMENT
/begin MEASUREMENT PIntkVUs_pRawLocSynBasd "raw manifold pressure (synchronous raster,local variable)" UWORD p_q0p078 1 100 0.00 5119.922 FORMAT "%8.3" ECU_ADDRESS 0x50000740 /end MEASUREMENT
/begin MEASUREMENT PIntkVUs_pRawObd "Absolute Pressure not corrected for Freeze Frame and Mode 12" UWORD p_q0p078 1 100 0.00 5119.922 FORMAT "%8.3" ECU_ADDRESS 0x70003802 /end MEASUREMENT
/begin MEASUREMENT PIntkVUs_pRawOld "value old raw manifold pressure" UWORD p_q0p078 1 100 0.00 5119.922 FORMAT "%8.3" ECU_ADDRESS 0x50000742 /end MEASUREMENT
/begin MEASUREMENT PIntkVUs_pRawTiBasdB1 "Raw pressure - Syncbased - Bank 1" UWORD p_q0p078 1 100 0.00 5119.922 FORMAT "%8.3" ECU_ADDRESS 0x600093EE /end MEASUREMENT
/begin MEASUREMENT PIntkVUs_stEdgRsChk "edge rise check status for correct calculation of pressure gradient while engine start" UBYTE B_TRUE 1 100 0.00 1.00000000000 BIT_MASK 0x1 FORMAT "%13.11" ECU_ADDRESS 0x5000096F /end MEASUREMENT
/begin MEASUREMENT PIntkVUs_stPresIniVld "Validity status for raw pressure before engine starts - Bank 1" UBYTE B_TRUE 1 100 0.00 1.00000000000 BIT_MASK 0x1 FORMAT "%13.11" ECU_ADDRESS 0x6000F922 /end MEASUREMENT
/begin MEASUREMENT PIntkVUs_stSRCVld "Signal range check valid status" UBYTE B_TRUE 1 100 0.00 1.00000000000 BIT_MASK 0x1 FORMAT "%13.11" ECU_ADDRESS 0x500009B5 /end MEASUREMENT
/begin MEASUREMENT PIntkVUs_tiSegADCData "Cylinder segment time used for addressing of curve for filtering of ADC data based voltage input" SWORD Time_s_1 1 100 -32.76800 32.76700 FORMAT "%8.5" ECU_ADDRESS 0x70001F8E /end MEASUREMENT
/begin MEASUREMENT PIntkVUs_uRawAvrgSynBasd "raw voltage average of manifold pressure sensor (synchronous raster)" UWORD Volt_q0p00007629 1 100 0.00 4.999665 FORMAT "%8.6" ECU_ADDRESS 0x50000744 /end MEASUREMENT
/begin MEASUREMENT PIntkVUs_uRawAvrgTiBasd "raw voltage average of manifold pressure sensor (timebased)" UWORD Volt_q0p00007629 1 100 0.00 4.999665 FORMAT "%8.6" ECU_ADDRESS 0x60013D92 /end MEASUREMENT
/begin MEASUREMENT PIntkVUs_uRawFlt "filtered raw voltage of manifold pressure sensor" UWORD Volt_q0p00007629 1 100 0.00 4.999665 FORMAT "%8.6" ECU_ADDRESS 0x70001F8C /end MEASUREMENT
/begin MEASUREMENT PIntkVUs_uRawSum "raw voltage sum of manifold pressure sensor" ULONG Volt_q0p00007629 1 100 0.00 327663.054936 FORMAT "%13.6" ECU_ADDRESS 0x500006AC /end MEASUREMENT
/begin MEASUREMENT PIntkVUs_uRawSumSynBasd "raw voltage sum of manifold pressure sensor (synchronous raster)" ULONG Volt_q0p00007629 1 100 0.00 327663.054936 FORMAT "%13.6" ECU_ADDRESS 0x70001F88 /end MEASUREMENT
/begin MEASUREMENT PIntkVUs_uRawSumTiBasd "raw voltage sum of manifold pressure sensor (timebased)" ULONG Volt_q0p00007629 1 100 0.00 327663.054936 FORMAT "%13.6" ECU_ADDRESS 0x70005180 /end MEASUREMENT
/begin MEASUREMENT PIntkVUs_uRawUnFlt "unfiltered raw voltage of manifold pressure sensor" UWORD Volt_q0p00007629 1 100 0.00 4.999665 FORMAT "%8.6" ECU_ADDRESS 0x70003800 /end MEASUREMENT
/begin MEASUREMENT psini_w_msg "Raw pressure before engine start in the intake manifold" UWORD p_q0p039 1 100 0.00 2559.961 FORMAT "%8.3" ECU_ADDRESS 0x600149B6 /end MEASUREMENT
/begin MEASUREMENT PSPCtlG_bEngCyclStSp "Condition to stop the Cyclic activation of EKP pump during Startstop" UBYTE B_TRUE 1 100 0.00 1.00000000000 BIT_MASK 0x1 FORMAT "%13.11" ECU_ADDRESS 0x60000E70 /end MEASUREMENT
/begin MEASUREMENT PSPCtl_bEngSpdDet "condition engine speed detected for control of the PSP" UBYTE B_TRUE 1 100 0.00 1.00000000000 BIT_MASK 0x1 FORMAT "%13.11" ECU_ADDRESS 0x60000E6F /end MEASUREMENT
/begin MEASUREMENT PSPCtl_bEngStop "condition PSP control when engine in stop phase" UBYTE B_TRUE 1 100 0.00 1.00000000000 BIT_MASK 0x1 FORMAT "%13.11" ECU_ADDRESS 0x60000E6E /end MEASUREMENT
/begin MEASUREMENT PSPCtl_bPreRun "condition PSP pre-run" UBYTE B_TRUE 1 100 0.00 1.00000000000 BIT_MASK 0x1 FORMAT "%13.11" ECU_ADDRESS 0x60000E6D /end MEASUREMENT
/begin MEASUREMENT PSPCtl_bPreRunEnbl "condition PSP pre-run enabled" UBYTE B_TRUE 1 100 0.00 1.00000000000 BIT_MASK 0x1 FORMAT "%13.11" ECU_ADDRESS 0x60000E6C /end MEASUREMENT
/begin MEASUREMENT PSPCtl_bPreRunLck "condition PSP pre-run locked" UBYTE B_TRUE 1 100 0.00 1.00000000000 BIT_MASK 0x1 FORMAT "%13.11" ECU_ADDRESS 0x60000E6B /end MEASUREMENT
/begin MEASUREMENT PSPCtl_bPSPDisbl "condition PSP control disabled" UBYTE B_TRUE 1 100 0.00 1.00000000000 BIT_MASK 0x1 FORMAT "%13.11" ECU_ADDRESS 0x60000E6A /end MEASUREMENT
/begin MEASUREMENT PSPCtl_bPSPXPostDrv "Condition: postdrive prolonged because of vapor lock" UBYTE B_TRUE 1 100 0.00 1.00000000000 BIT_MASK 0x1 FORMAT "%13.11" ECU_ADDRESS 0x60000E69 /end MEASUREMENT
/begin MEASUREMENT PSPCtl_bPSPXPreDrv "condition extend PreDrv" UBYTE B_TRUE 1 100 0.00 1.00000000000 BIT_MASK 0x1 FORMAT "%13.11" ECU_ADDRESS 0x60000E68 /end MEASUREMENT
/begin MEASUREMENT PSPCtl_bShOffPSP "condition PSP control was locked (e.g. crash)" UBYTE B_TRUE 1 100 0.00 1.00000000000 BIT_MASK 0x1 FORMAT "%13.11" ECU_ADDRESS 0x60038E1B /end MEASUREMENT
/begin MEASUREMENT PSPCtl_ctPreRun "number of PSP pre-runs without reaching end of start" UBYTE OneToOne 1 100 0.00 255.0 FORMAT "%5.1" ECU_ADDRESS 0x60038E1A /end MEASUREMENT
/begin MEASUREMENT PSPCtl_flgPwrOnRst "Power on reset" UBYTE B_TRUE 1 100 0.00 1.00000000000 BIT_MASK 0x1 FORMAT "%13.11" ECU_ADDRESS 0x60000E67 /end MEASUREMENT
/begin MEASUREMENT PSPCtl_flgRmnVapSuspc "Condition:Vapor lock suspicion detected to trigger high voltage" UBYTE B_TRUE 1 100 0.00 1.00000000000 BIT_MASK 0x1 FORMAT "%13.11" ECU_ADDRESS 0x600014DA /end MEASUREMENT
/begin MEASUREMENT PSPCtl_flgRmnVapSuspcPSP "Condition:vapor lock detected during startstop and continuosly run PSP" UBYTE B_TRUE 1 100 0.00 1.00000000000 BIT_MASK 0x1 FORMAT "%13.11" ECU_ADDRESS 0x60000E66 /end MEASUREMENT
/begin MEASUREMENT PSPCtl_tiPreRun "time of PSP pre-run" UWORD t_q0p01 1 100 0.00 655.3500 FORMAT "%8.4" ECU_ADDRESS 0x60000E64 /end MEASUREMENT
/begin MEASUREMENT PSPCtl_tiRmnVap "Timer which conveys 180ms after vapor lock detected" UWORD t_q0p01 1 100 0.00 655.3500 FORMAT "%8.4" ECU_ADDRESS 0x60038E18 /end MEASUREMENT
/begin MEASUREMENT PSP_st "Status information for activating the pre-supply pump (1=on/0=off)" UBYTE OneToOne 1 100 0.00 255.0 FORMAT "%5.1" ECU_ADDRESS 0x60001515 /end MEASUREMENT
/begin MEASUREMENT PSP_stActv_mp "Request for PSP activation" UBYTE B_TRUE 1 100 0.00 1.00000000000 BIT_MASK 0x1 FORMAT "%13.11" ECU_ADDRESS 0x7000A106 /end MEASUREMENT
/begin MEASUREMENT PSP_stDetSleep "state for detection of power on" ULONG OneToOne 1 100 0.00 4294967295.00 FORMAT "%13.2" ECU_ADDRESS 0x70039B84 /end MEASUREMENT
/begin MEASUREMENT PSP_stPs "Status signal for actuating the power stage of the electric supply pump" UBYTE OneToOne 1 100 0.00 255.0 FORMAT "%5.1" ECU_ADDRESS 0x60000D44 /end MEASUREMENT
/begin MEASUREMENT psrrff_w_msg "intake manifold pressure (absolute) not corrected for Freeze Frame and Mode $1$2" UWORD p_q0p078 1 100 0.00 5119.922 FORMAT "%8.3" ECU_ADDRESS 0x7000376C /end MEASUREMENT
/begin MEASUREMENT psrr_w_msg "intake manifold pressure (absolute) not corrected" UWORD p_q0p078 1 100 0.00 5119.922 FORMAT "%8.3" ECU_ADDRESS 0x60000828 /end MEASUREMENT
/begin MEASUREMENT pwrClntEntryOilSwmpT "Heat insertion of engine into coolant agent for OilSwmpT" SWORD pwr2 1 100 0.00 617643.4 FORMAT "%8.1" ECU_ADDRESS 0x60007202 /end MEASUREMENT
/begin MEASUREMENT stCoEngOilSwmpT "Engine status used for OilSwmpT" UWORD CoEng_stMai_VERB 1 100 0.00 16384.0000000 FORMAT "%13.7" ECU_ADDRESS 0x60007200 /end MEASUREMENT
/begin MEASUREMENT stSnsrWasOK "internal state indicating if the Sensor has send valid values (Bit0 Temperaturesensor, Bit1 Oil-Combined-Sensor)" UBYTE OneToOne 1 100 0.00 255.0 FORMAT "%5.1" ECU_ADDRESS 0x60038E2A /end MEASUREMENT
/begin MEASUREMENT tFltSensOilTSwmp "physical temperature value, which is derived from low pass filtered sensor signal tospr_w" SWORD Temp_Cels 1 100 -273.140 3003.560 FORMAT "%8.3" ECU_ADDRESS 0x6000721E /end MEASUREMENT
/begin MEASUREMENT tiEngOffOilSwmpT "Engine off time used for OilSwmpT" SLONG t_q1 1 100 -2147483648.00 2147483647.00 FORMAT "%13.2" ECU_ADDRESS 0x600026B4 /end MEASUREMENT
/begin MEASUREMENT tmchtslo_w "engine temperature (engine coolant or cylinder head), local copy, at the rising edge of active catalyst heating" SWORD Temp_Cels 1 100 -3549.940 3003.560 FORMAT "%8.3" ECU_ADDRESS 0x60007228 /end MEASUREMENT
/begin MEASUREMENT toellrns "engine oil temperature" UBYTE temp_ub_q1_o60 1 100 -60.0 195.0 FORMAT "%5.1" ECU_ADDRESS 0x6000B68F /end MEASUREMENT
/begin MEASUREMENT tospmbm_w "oil temperature in sump during basic initialisation" UWORD temp_q0p0234_o273 1 100 -273.150 1262.827 FORMAT "%8.3" ECU_ADDRESS 0x600071FE /end MEASUREMENT
/begin MEASUREMENT tospmloc_w "oil temperature in sump from model (local)" UWORD temp_q0p0234_o273 1 100 -273.150 1262.827 FORMAT "%8.3" ECU_ADDRESS 0x60038E20 /end MEASUREMENT
/begin MEASUREMENT tospmnf_w "oil temperature in sump from model (not filtered)" UWORD temp_q0p0234_o273 1 100 -273.150 1262.827 FORMAT "%8.3" ECU_ADDRESS 0x600071FC /end MEASUREMENT
/begin MEASUREMENT tospmq "state of oiltemperature-model" UBYTE dez 1 100 0.00 255.0 FORMAT "%5.1" ECU_ADDRESS 0x6000B676 /end MEASUREMENT
/begin MEASUREMENT tospmqloc "state of oiltemperature-model local" UBYTE dez 1 100 0.00 255.0 FORMAT "%5.1" ECU_ADDRESS 0x60038E1F /end MEASUREMENT
/begin MEASUREMENT tospmr_w "oil temperature in sump from model (raw value)" UWORD temp_q0p0234_o273 1 100 -273.150 1262.827 FORMAT "%8.3" ECU_ADDRESS 0x600071FA /end MEASUREMENT
/begin MEASUREMENT tospmst "State of oil temperature modeling" UBYTE dez 1 100 0.00 255.0 FORMAT "%5.1" ECU_ADDRESS 0x60038E1E /end MEASUREMENT
/begin MEASUREMENT tospmstab "State of oil temperature modeling at engine switch off" UBYTE dez 1 100 0.00 255.0 FORMAT "%5.1" ECU_ADDRESS 0x60038E1D /end MEASUREMENT
/begin MEASUREMENT tospmtdr_w "Duration of transition state in oil temperature model" UWORD t_q1 1 100 0.00 65535.00 FORMAT "%8.2" ECU_ADDRESS 0x600071F8 /end MEASUREMENT
/begin MEASUREMENT tosprf_msg "physical temperature value, which is derived from low pass filtered sensor signal tospr" UBYTE temp_ub_q0p75_o48 1 100 -48.0 143.3 FORMAT "%5.1" ECU_ADDRESS 0x6000F714 /end MEASUREMENT
/begin MEASUREMENT tosprf_w_msg "physical temperature value, which is derived from low pass filtered sensor signal tospr_w" UWORD temp_q0p0234_o273 1 100 -273.150 1262.827 FORMAT "%8.3" ECU_ADDRESS 0x60008CFE /end MEASUREMENT
/begin MEASUREMENT tosptmab "local engien oft temperature" UBYTE temp_uw_q0p75_o48 1 100 -48.0 143.3 FORMAT "%5.1" ECU_ADDRESS 0x60038E1C /end MEASUREMENT
/begin MEASUREMENT tosp_msg "Oil temperature in oil sump - measured or modeled" UBYTE temp_ub_q0p75_o48 1 100 -48.0 143.3 FORMAT "%5.1" ECU_ADDRESS 0x6000F715 /end MEASUREMENT
/begin MEASUREMENT tosp_w_msg "oil temperature in oil sump - measured or modeled" UWORD temp_q0p0234_o273 1 100 -273.150 1262.827 FORMAT "%8.3" ECU_ADDRESS 0x60008D00 /end MEASUREMENT
/begin MEASUREMENT tSwmpOilP "Oil temperature in oil sump" SWORD Temp_Cels 1 100 -3549.940 3003.560 FORMAT "%8.3" ECU_ADDRESS 0x60007224 /end MEASUREMENT
/begin MEASUREMENT ttospmr "time constant of low pass filter (model oil temperature in sump)" UWORD t_q1 1 100 1.00 65535.00 FORMAT "%8.2" ECU_ADDRESS 0x600071F6 /end MEASUREMENT
/begin MEASUREMENT ttospmrsw "Oiltemperature-Model: time-constant for switching over in warm-state" UWORD t_q0p1 1 100 0.00 25.50000 FORMAT "%8.5" ECU_ADDRESS 0x600071F4 /end MEASUREMENT
/begin MEASUREMENT tumgOilSwmpT "Ambient air temperature used for OilSwmpT" UBYTE temp_ub_q0p75_o48 1 100 -48.0 143.3 FORMAT "%5.1" ECU_ADDRESS 0x6000B675 /end MEASUREMENT
/begin MEASUREMENT vfzgOilSwmpT "Vehicle speed used for OilSwmpT" UBYTE vfzg_ub_q1p25 1 100 0.00 318.8 FORMAT "%5.1" ECU_ADDRESS 0x6000B674 /end MEASUREMENT
/begin MEASUREMENT wnwrefse_w "reference camshaft angle" SWORD kw_sw_q0p0078 1 100 -256.0000 255.9922 FORMAT "%8.4" ECU_ADDRESS 0x60000620 /end MEASUREMENT
/begin MEASUREMENT zhll_w "Time counter for hot idle" UWORD t200msxs_uw_q0p2 1 100 0.00 13107.00 FORMAT "%8.2" ECU_ADDRESS 0x60038E36 /end MEASUREMENT
/begin FUNCTION MWKO "1.16.0    Mode switch coordination" /begin DEF_CHARACTERISTIC CoEOM_flgFpcDiOnlyWithTransAct_C TVHEGTESOFF /end DEF_CHARACTERISTIC
 /begin IN_MEASUREMENT B_bderlsts_msg B_bdetes_msg B_dagrss_msg B_mwrlsta_msg B_vhegtes_msg B_vheinst_msg B_vherlsts_msg CoEOM_bTransActv Ign_flgHomNxtCmb /end IN_MEASUREMENT
 /begin OUT_MEASUREMENT B_mwrlstas_msg B_mwtes_msg CoEng_bModtr /end OUT_MEASUREMENT
 /begin LOC_MEASUREMENT CoEOM_DlyReengmtFpcAdvTOFFVNM_I.Time /end LOC_MEASUREMENT
 FUNCTION_VERSION "1.16.0" /end FUNCTION
/begin FUNCTION NLKO "1.13.0    Coordination of permitted engine modes during emergency state" /begin DEF_CHARACTERISTIC CWNLKO TMODNLF /end DEF_CHARACTERISTIC
 /begin IN_MEASUREMENT B_ausgkrit_msg B_bkvnhom_msg B_ehfm_msg B_homagrdi_msg B_prnl_msg EngStrt_bStrtEnd Epm_stOpMode SyC_stSub ThrVlv_flgLimpModeB1 ThrVlv_flgReqFuCutOffB1 ThrVlv_flgSngSensErrSuspcB1 /end IN_MEASUREMENT
 /begin OUT_MEASUREMENT bdemodnl_msg B_nlhom_msg /end OUT_MEASUREMENT
 /begin LOC_MEASUREMENT bdemodnlv bdemodnlz B_nlh B_nlh0 B_nlh1 CoEOM_DlyRstLimpTR_I.timeCounter CoEOM_flgErrFuP NLKO_SyCstSubOld /end LOC_MEASUREMENT
 FUNCTION_VERSION "1.13.0" /end FUNCTION
/begin FUNCTION NSAC "12.0.1    Desired idling speed air conditioner" /begin DEF_CHARACTERISTIC CWNSAC NSACFSTM NSACTM NSAC_stIdleSpdReqSeln_C /end DEF_CHARACTERISTIC /begin REF_CHARACTERISTIC CWNSTAT /end REF_CHARACTERISTIC
 /begin IN_MEASUREMENT ACCtl_stSwtAc B_fs_msg B_nswo1_msg Com_stAC Com_tEnvT EnvT_t SyC_ctPostDrvLeave SyC_stSub TS_nMinAC /end IN_MEASUREMENT
 /begin OUT_MEASUREMENT nsmodac_msg nsolac_msg /end OUT_MEASUREMENT
 /begin LOC_MEASUREMENT NSAC_ctReIni NSAC_flgIdleSpdReq NSAC_tAmbAirT /end LOC_MEASUREMENT
 FUNCTION_VERSION "12.0.1" /end FUNCTION
/begin FUNCTION NSFLX "1.10.0    Leerlaufsolldrehzahl für Flex-Fuel" /begin DEF_CHARACTERISTIC KLNLLMGFF KLNLLMGFSF KLNSFLX /end DEF_CHARACTERISTIC
 /begin IN_MEASUREMENT B_fs_msg B_nllerhti_msg B_nswo1_msg CEngDsT_t fethstoe_msg mkioel_w_msg nllmgfsglb_msg nllmgglb_msg PT_stTraType /end IN_MEASUREMENT
 /begin OUT_MEASUREMENT nsolflx_msg /end OUT_MEASUREMENT
 /begin LOC_MEASUREMENT NSFLX_mFuMEngOil NSFLX_tEng /end LOC_MEASUREMENT
 FUNCTION_VERSION "1.10.0" /end FUNCTION
/begin FUNCTION NSHTD "8.0.0     Desired idle speed heating demand"
 /begin DEF_CHARACTERISTIC KFTMHTD KFTMHTDFS KFTUMHTD KFTUMHTDFS NTUM NTUMFS TDTUMG TTUM /end DEF_CHARACTERISTIC
 /begin IN_MEASUREMENT B_fs_msg B_ll_msg CEngDsT_t CEngDsT_tStrt EnvT_t PT_stTraType SyC_ctPostDrvLeave /end IN_MEASUREMENT
 /begin OUT_MEASUREMENT nsmodhtd_msg nsolhtd_msg /end OUT_MEASUREMENT
 /begin LOC_MEASUREMENT NSHTD_ctReIni nsolhtdtm nsolhtdtum /end LOC_MEASUREMENT
 FUNCTION_VERSION "8.0.0" /end FUNCTION
/begin FUNCTION NSHTI "28.0.0    Increasing of engine low idle speed when engine temperature is too high"
 /begin DEF_CHARACTERISTIC DTAHLL DTMHLL KFNSOLHT NSHLL NSHTI_facCorrnAltiAmbTAvdNvhDrvg_M NSHTI_facCorrnAltiAmbTAvdNvh_M NSHTI_facCorrnEngTAvdNvhDrvg_T NSHTI_facCorrnEngTAvdNvh_T NSHTI_facCorrnOffsDrvg_C NSHTI_facCorrnOffs_C NSHTI_flgStgySeln_C NSHTI_nHiAltiAvdNvhLoIdleSpDrvg_T NSHTI_nHiAltiAvdNvhLoIdleSp_T NSHTI_nLimHiAltiFwdDrvgLoIdleSp_M NSHTI_nLimHiAltiRvsCrpLoIdleSp_M NSTOEL NZHDTL NZHITL TAHLL TMHLL TMRZHLL TOLCHLLMN TOLCHLLMX ZHLLA ZHLLE /end DEF_CHARACTERISTIC
 /begin REF_CHARACTERISTIC CNFLLRNS /end REF_CHARACTERISTIC
 /begin IN_MEASUREMENT B_ll_msg B_nswo1_msg B_tolcb_msg CEngDsT_t CEngDsT_tStrt CoVMD_flgIdleDrv EngStrt_bStrt EnvT_t Epm_nEngLRes Gbx_stGearLvr Gbx_stPNPos PEnv_facCorrAlti PT_stTraType rl_msg SyC_ctDrvEnter SyC_stSub tans_msg tolc_msg VehV_v /end IN_MEASUREMENT
 /begin OUT_MEASUREMENT NSHTI_flgHiAltiLimActv NSHTI_nHiAltiAvdNvhIdle NSHTI_nHiAltiAvdNvhIdleDrvg NSHTI_nHiAltiAvdNvhLoIdleSp NSHTI_nLimHiAltiLoIdleSp nsolhti_msg zhll_w /end OUT_MEASUREMENT
 /begin LOC_MEASUREMENT B_hll B_toeltmp NSHTI_B_st NSHTI_ctIniDrv NSHTI_facCorrnHiAltiAvdNvh NSHTI_facCorrnHiAltiAvdNvhDrvg NSHTI_nHiAltiAvdNvhDrvgLoc NSHTI_nHiAltiAvdNvhDrvgTmp NSHTI_nHiAltiAvdNvhIdleLoc NSHTI_nHiAltiAvdNvhIdleTmp NSHTI_nmotloc NSHTI_rlloc NSHTI_tans NSHTI_tmstloc NSHTI_tolc nsolht nstoel_tmp toellrns /end LOC_MEASUREMENT
 FUNCTION_VERSION "28.0.0" /end FUNCTION
/begin FUNCTION NSKH "5.38.0    specification of desired idle speed for catalyst heating"
 /begin DEF_CHARACTERISTIC CWNSKH ExhMgT_facCatWrmIdleN_M ExhMgT_facHeatgProgsIdleSpdCorrnDrvgPosn_M ExhMgT_facHeatgProgsIdleSpdCorrn_M ExhMgT_nIdleCatHeatgDrvgPosn_M ExhMgT_nIdleCatHeatgFlexFuVehDrvgPosn_M ExhMgT_nIdleCatHeatgFlexFuVeh_M ExhMgT_nIdleCatHeatg_M ExhMgT_nIdleSpdCatWrmDrvgPosn_M ExhMgT_nIdleSpdCatWrm_M ExhMgT_stIdleSpdCust_C ExhMgT_stIdleSpeedCatHeatg2_C ExhMgT_stIdleSpeedCatHeatg_C ExhMgT_tiDlyDrvgPosnNotEngd_C ExhMgT_tiIdleSpdFltCatHeatgEndDrvgPosn_C ExhMgT_tiIdleSpdFltCatHeatgEnd_C ExhMgT_tiIdleSpdFltCatHeatgStrtDrvgPosn_C ExhMgT_tiIdleSpdFltCatHeatgStrt_C ExhMgT_tiIdleSpdFltCatWrmDrvgPosn_C ExhMgT_tiIdleSpdFltCatWrm_C ExhMgt_vVehThdCatHeatg_C GANGKHLL KFNSKHLL KFNSKHLLFS KFNSKHLLFSIML KFNSKHLLIML KFNSKHLLTM KFNSKHLLTMIML KLFINTETHNK KLNLLKHAGE TDBKVKHN THDNSOLPTS TKHFSAB TKHFSRG TKHFSVZ TKHNABBKV VFZGGRDKH VFZGNLLKH /end DEF_CHARACTERISTIC
 /begin IN_MEASUREMENT Brk_st B_bkvnkhab_msg B_ethadap_msg B_ethhte_msg B_fs_msg B_khakt_msg B_khakw_msg B_khan_msg B_kha_msg B_kh_msg B_ll_msg CEngDsT_t CEngDsT_tStrt Clth_st Com_stGrip Epm_nEng Epm_stSpd ExhMgT_facCatHeatgRamp ExhMgT_facWghtCatAge ExhMgT_flgCatHeatgWrmReq ExhMod_tCat1B1 fethmnmx_w_msg frhol_w_msg gangsist_msg imlpr_w_msg nsolpts_msg PEnv_facCorrAlti SyC_ctPostDrvLeave SyC_stSub tnse_w_msg VehV_v /end IN_MEASUREMENT
 /begin OUT_MEASUREMENT B_khnshp_msg B_khn_msg ExhMgT_flgRepStrtNonCsersIdleSpdReq ExhMgT_nEngMaxIdleCatHeat ExhMgT_nIdleCatHeatgSp ExhMgT_nIdleVirtDiagCsers ExhMgT_nIdleVirtDiagNonCsers frhokor_w_msg nllkh_msg nsolcat_msg /end OUT_MEASUREMENT
 /begin LOC_MEASUREMENT B_bkvkhab B_cwnllkh0 B_cwnllkh1 B_cwnllkh10 B_cwnllkh14 B_cwnllkh2 B_cwnllkh3 B_cwnllkh4 B_cwnllkh5 B_cwnllkh8 B_cwnllkh9 B_nfskh ExhMgT_cntrReiniIdleCatHeatg ExhMgT_facCatHeatgProgsNIdle ExhMgT_facCorrnIdleAlti ExhMgT_flgCatHeatgWrmIdleSpdReq ExhMgT_flgGripClu ExhMgT_flgIdleSpdActvnBrkP ExhMgT_flgIdleSpdCust0 ExhMgT_flgIdleSpdCust1 ExhMgT_flgIdleSpdDeactvnBrkP ExhMgT_flgNIdleLowrV ExhMgT_flgTondDrvgPosn ExhMgT_nEngIdleCatHeat ExhMgT_nIdleInitCatHeatg ExhMgT_nIdleSpCatHeatg ExhMgT_tCatColdStrtIdleSpdReq ExhMgT_tCatHeatgIdleSpdReqFixd ExhMgT_tCatWrmIdleSpdReq ExhMgT_tEngCatHeatgIdle ExhMgT_tiAftStrtCatHeatgNIdle ExhMgT_tiIdleSpdFltCatHeatg ExhMgT_tStrtNCatHeatg nmfskh nmfskhgs nmllkh nmllkhgs nmotllkh tmchtslo_w /end LOC_MEASUREMENT
 FUNCTION_VERSION "5.38.0" /end FUNCTION
/begin FUNCTION NSLPH "1.7.0     Desired idling speed limp-home" /begin DEF_CHARACTERISTIC NFSNLDG NSNLDG NSNOT /end DEF_CHARACTERISTIC
 /begin IN_MEASUREMENT B_fs_msg B_nswo1_msg Epm_stOpMode ThrVlv_flgLimpModeB1 ThrVlv_flgReqFuCutOffB1 /end IN_MEASUREMENT
 /begin OUT_MEASUREMENT nsmodlph_msg nsollph_msg /end OUT_MEASUREMENT
 /begin LOC_MEASUREMENT B_inolu /end LOC_MEASUREMENT
 FUNCTION_VERSION "1.7.0" /end FUNCTION
/begin FUNCTION NSPTS "1.12.0    Desired idling speed post start"
 /begin DEF_CHARACTERISTIC KFNLLKEB KFNLLNST NSPTS_nIdleAftStrtDrvg_GM STM06LLUB_NSPTS STN06LLUB_NSPTS /end DEF_CHARACTERISTIC
 /begin IN_MEASUREMENT B_ebfmodns_msg B_fs_msg B_nswo1_msg B_teftstft_msg CEngDsT_t SyC_ctDrvEnter tnst_w_msg /end IN_MEASUREMENT
 /begin OUT_MEASUREMENT nsolpts_msg /end OUT_MEASUREMENT
 /begin LOC_MEASUREMENT NSPTS_ctIniDrv NSPTS_tmotloc NSPTS_tnstloc /end LOC_MEASUREMENT
 FUNCTION_VERSION "1.12.0" /end FUNCTION
/begin FUNCTION NWFW "1.14.0    Calculation: factor camshaft angle"
 /begin DEF_CHARACTERISTIC CWFWNWAPP CWNWFW DWFWNWE DWFWNWEK FWNWEAPP KFFWNWE0 KFFWNWE0V /end DEF_CHARACTERISTIC
 /begin REF_CHARACTERISTIC GEVCtl_agMinIntk_C GEVCtl_agRefPosnIntk_C /end REF_CHARACTERISTIC
 /begin IN_MEASUREMENT AirMod_ratChrgAirCylAdv_a Epm_nEng Gen_ctCylAdv GEVCtl_agSpHomWrmIntk GEVCtl_agSpIntkB1 GEVCtl_agSpLoLftWrmIntk GEVCtl_flgPhaEnaIntk GEVlv_agFildIntkB1 GEVlv_agIntkB1 Ign_bVlvLInNxtCmbs /end IN_MEASUREMENT
 /begin OUT_MEASUREMENT fwnwe_msg /end OUT_MEASUREMENT
 /begin LOC_MEASUREMENT wnwrefse_w /end LOC_MEASUREMENT
 FUNCTION_VERSION "1.14.0" /end FUNCTION
/begin FUNCTION OCWDA_Co "80.5.1    Extended Monitoring: Operation conditions of WDA/ABE shut off"
 /begin DEF_CHARACTERISTIC OCWDA_ctDebActvErr_C OCWDA_ctDebOvrVltgOn_C OCWDA_stErrSimn_C OCWDA_swtOffRst_C /end DEF_CHARACTERISTIC
 /begin IN_MEASUREMENT BattU_u MoCCom_ctErrFC MoCCom_ctErrMM MoCSOP_stActMsg MoCSOP_stOvl /end IN_MEASUREMENT
 /begin OUT_MEASUREMENT OCWDA_stErrMonPtt /end OUT_MEASUREMENT
 /begin LOC_MEASUREMENT OCWDA_ctBattU OCWDA_ctDebActvErr OCWDA_ctDebErrNotActv OCWDA_ctDebOvrVltgOn OCWDA_ctTstOCWDA OCWDA_ctTstOvrVltg OCWDA_flgClrDebDFC OCWDA_stABEActv OCWDA_stCheckState OCWDA_stErrPinActv OCWDA_stOvrVltgActv OCWDA_stWDAActv /end LOC_MEASUREMENT
 FUNCTION_VERSION "80.5.1" /end FUNCTION
/begin FUNCTION OilP_DD "2.24.0    Oil Pressure Sensor Device Driver"
 /begin DEF_CHARACTERISTIC Oil_pIniPSwmp_C Oil_pTransfPSwmp_CUR Oil_SRCPSwmp.uMin_C Oil_SRCPSwmp.uMax_C Oil_stDflPSwmp_C Oil_stTransfPSwmp_CUR /end DEF_CHARACTERISTIC
 /begin OUT_MEASUREMENT Oil_pSensPSwmp Oil_stSensPSwmp Oil_uRawPSwmp /end OUT_MEASUREMENT
 FUNCTION_VERSION "2.24.0" /end FUNCTION
/begin FUNCTION OilP_VD "30.8.0    Oil Pressure Sensor Virtual Device"
 /begin DEF_CHARACTERISTIC OilP_aTASPWarn_C OilP_maskLowOilPErr_C OilP_maskPlausAftRunOilPErr_C OilP_maskPlausMaxOilPErr_C OilP_maskPlausT15OilPErr_C OilP_nEngPMaxPlaus_C OilP_nEngPMinPlaus_C OilP_pAftRunPlaus_C OilP_pDfl_C OilP_pMaxPlaus_C OilP_pMinPlaus_C OilP_pMin_MAP OilP_pT15Plaus_C OilP_stOilPVD_C OilP_stSwtOilPTyp_C OilP_stSwtSnsrTyp_C OilP_tiDebHealPlaus1_C OilP_tiDebHealPlaus2_C OilP_tiDebPlaus1_C OilP_tiDebPlaus2_C OilP_tiDebPWarnTASOff_C OilP_tiDebPWarnTASOn_C OilP_tiEngOffT15Plaus_C OilP_tiMinPostDrv_C OilP_tiNormalPMinPlaus_C OilP_tiOilTPWarn_CUR OilP_tiPPT1_C OilP_tiStrtEndFin_C OilP_tMinPMaxPlaus_C OilP_tMinPostDrv_C OilP_tMinT15_C /end DEF_CHARACTERISTIC
 /begin IN_MEASUREMENT CoEng_st CoEng_tiNormalRed EngDa_tiEngOff EnvP_p Epm_nEng OilSwmpT_tFltd OilSwmpT_tFltd_Sq Oil_pSensPSwmp SyC_stSub SyC_tiPostDrv TAS_a tnse_w_msg VehMot_stPrpAccPed VehMot_stPrpCrCtl /end IN_MEASUREMENT
 /begin OUT_MEASUREMENT Oil_bPWarn Oil_p Oil_pAbs Oil_pMin Oil_pRel Oil_p_Sq /end OUT_MEASUREMENT
 /begin LOC_MEASUREMENT OilP_bPlausAftRunEnbl_mp OilP_bPlausMaxEnbl_mp OilP_bPlausMinEnbl_mp OilP_bPlausT15Enbl_mp OilP_flgTASPWarnEna OilP_flgTASPWarnEnaInit_MP OilP_pSensFilt_mp Oil_pSnsrSel_mp tSwmpOilP /end LOC_MEASUREMENT
 FUNCTION_VERSION "30.8.0" /end FUNCTION
/begin FUNCTION OilSwmpT_AdprInp "2.6.0     Interface adapter: GC oil temeprature in sump: inputs" /begin DEF_CHARACTERISTIC OilSwmpT_maskEnvTSq_C OilSwmpT_swtTAmbVld_C /end DEF_CHARACTERISTIC
 /begin IN_MEASUREMENT B_gtumg_msg B_sa_msg B_tumgg_msg EnvT_t EnvT_t_Sq Epm_nEng TiEngOff_bEngRot TiEngOff_bRst TiEngOff_ti VehV_v /end IN_MEASUREMENT
 /begin OUT_MEASUREMENT OilSwmpT_bengrot OilSwmpT_bgtumg OilSwmpT_bsa OilSwmpT_btengsr OilSwmpT_btumgg OilSwmpT_nmot OilSwmpT_tiEngOff OilSwmpT_tumg OilSwmpT_vfzg /end OUT_MEASUREMENT
 FUNCTION_VERSION "2.6.0" /end FUNCTION
/begin FUNCTION OilSwmpT_AdprOutp "1.6.0     Interface adapter: GC oil temeprature in sump: outputs" /begin DEF_CHARACTERISTIC OilSwmpT_maskB_tospgg_C OilSwmpT_maskB_tospg_C /end DEF_CHARACTERISTIC
 /begin IN_MEASUREMENT OilSwmpT_idxTSrc OilSwmpT_stSigT OilSwmpT_tADCFltd OilSwmpT_tFltd OilSwmpT_tPULSFltd /end IN_MEASUREMENT
 /begin OUT_MEASUREMENT B_tospgg_msg B_tospg_msg OilT_stTSensDsplNoAvl Oil_swtADCPresT Oil_swtCANPresT Oil_swtSensPresT Oil_swtSigT Oil_tADC Oil_tADCGradLtd Oil_tPULS Oil_tPULSGradLtd Oil_tSensADC Oil_tSensPULS Oil_tSensTSwmp Oil_tSwmp Oil_tSwmpGradLtd Oil_uRawTSwmp tosprf_msg tosprf_w_msg tosp_msg tosp_w_msg /end OUT_MEASUREMENT
 /begin LOC_MEASUREMENT OilSwmpT_tAdprSnsrFildLoc OilSwmpT_tAdprSnsrLoc tFltSensOilTSwmp /end LOC_MEASUREMENT
 FUNCTION_VERSION "1.6.0" /end FUNCTION
/begin FUNCTION OilSwmpT_VD "1.15.0    Virtual Device: Temperature of oil in sump"
 /begin DEF_CHARACTERISTIC OilSwmpT_dtMdlSnsrMax_C OilSwmpT_dtMdlSnsrMin_C OilSwmpT_swtMdlPULSEna_C OilSwmpT_swtMdlTAvl_C OilSwmpT_swtTSrcADCFrzDfl_C OilSwmpT_swtTSrcADC_C OilSwmpT_swtTSrcDispl_C OilSwmpT_swtTSrcPULSFrzDfl_C OilSwmpT_swtTSrcPULS_C OilSwmpT_swtTSrc_C OilSwmpT_tADCDfl_C OilSwmpT_tDfl_C OilSwmpT_tiCmbdSnsrFrzMax_C OilSwmpT_tiTADCPT1_C OilSwmpT_tiTDisplPT1_C OilSwmpT_tiTPT1_C OilSwmpT_tiTPULSPT1_C OilSwmpT_tiTSnsrFrzMax_C OilSwmpT_tPULSDfl_C OilSwmpT_tSelMdlCEngDsT_C /end DEF_CHARACTERISTIC
 /begin IN_MEASUREMENT CEngDsT_t Eep_EnvRamHist Eep_EnvRamInvld OilSwmpT_btengsr OilSwmpT_flgMdlPrs OilSwmpT_stTMdl OilSwmpT_tMdl /end IN_MEASUREMENT
 /begin OUT_MEASUREMENT OilSwmpT_idxTSrc OilSwmpT_stSigT OilSwmpT_stSigTADC OilSwmpT_stSigTDispl OilSwmpT_stSigTPULS OilSwmpT_stTDisplStop OilSwmpT_t OilSwmpT_tADC OilSwmpT_tADCFltd OilSwmpT_tADCFltdStop OilSwmpT_tADCFltdStop_Sq OilSwmpT_tADCFltd_Sq OilSwmpT_tADCStop OilSwmpT_tADCStop_Sq OilSwmpT_tADC_Sq OilSwmpT_tDispl OilSwmpT_tDisplFltd OilSwmpT_tDisplFltdStop OilSwmpT_tDisplStop OilSwmpT_tFltd OilSwmpT_tFltdStop OilSwmpT_tFltdStop_Sq OilSwmpT_tFltd_Sq OilSwmpT_tPid5C OilSwmpT_tPULS OilSwmpT_tPULSFltd OilSwmpT_tPULSFltdStop OilSwmpT_tPULSFltdStop_Sq OilSwmpT_tPULSFltd_Sq OilSwmpT_tPULSStop OilSwmpT_tPULSStop_Sq OilSwmpT_tPULS_Sq OilSwmpT_tStop OilSwmpT_tStop_Sq OilSwmpT_t_Sq /end OUT_MEASUREMENT
 /begin LOC_MEASUREMENT OilSwmpT_flgEngStopFrz OilSwmpT_flgOilSwmpTCmbdSnsrAvl OilSwmpT_flgOilSwmpTMdlAvl OilSwmpT_flgOilSwmpTSnsrAvl OilSwmpT_flgPULSMdlHi OilSwmpT_flgvdMdlPrsloc OilSwmpT_idxTSrcADC OilSwmpT_idxTSrcDispl OilSwmpT_idxTSrcPULS OilSwmpT_stCmbdSnsrRplVal OilSwmpT_stTSnsrRplVal OilSwmpT_stvdTMdlloc OilSwmpT_tiCmbdSnsrNoVal OilSwmpT_tiTSnsrNoVal OilSwmpT_tvdCEngDsTloc OilSwmpT_tvdMdlloc stSnsrWasOK /end LOC_MEASUREMENT
 FUNCTION_VERSION "1.15.0" /end FUNCTION
/begin FUNCTION OilSwmpT_VDMdl "1.19.0    Calculation of model value: Temperature of oil in sump"
 /begin DEF_CHARACTERISTIC CWTOSPM CWTOSPM2 KFTOSPMVML KFTOSPMWC KLTOSPM_N KLTOSPM_TU KLTSWITCH KLTTOSPM1 KLTTOSPM2 OilSwmpT_dtMdlElecDrv_MAP OilSwmpT_facHeatgWrmEnvT_M OilSwmpT_facIntegElecDrv_C OilSwmpT_facMdlElecDrv_T OilSwmpT_facMdlLdVVeh_MAP OilSwmpT_maskEngTWrmUp_C OilSwmpT_swtPwrClntEntrySeln_C OilSwmpT_tiElecDrv_C OilSwmpT_tiTOSPMR_T OilSwmpT_tiWrmUp_C OilSwmpT_tWrmUpHeatgCorrn_M SWTMOT SWTOSPM TOSPMQD TOSPMQDS TOSPMQWS TOSPREPL TOSPREPLI TTOSPMVLD /end DEF_CHARACTERISTIC
 /begin IN_MEASUREMENT CEngDsT_t CEngDsT_t_Sq CoEng_stMai Eep_EnvRamHist Eep_EnvRamInvld ml_w_msg OilSwmpT_bsa OilSwmpT_nmot OilSwmpT_tiEngOff OilSwmpT_tumg OilSwmpT_vfzg PhyMod_pwrClntEntry TiEngOff_bEngRot TiEngOff_bRst /end IN_MEASUREMENT
 /begin OUT_MEASUREMENT OilSwmpT_flgMdlPrs OilSwmpT_stTMdl OilSwmpT_tMdl OilSwmpT_tMdlStop /end OUT_MEASUREMENT
 /begin LOC_MEASUREMENT B_tospmadi B_tospmefr B_tospmg B_tospmwst mlwOilSwmpT nmotOilSwmpT OilSwmpT_bVldMdlENVRAM OilSwmpT_dtMdlElecDrv OilSwmpT_flgMdlRstIni OilSwmpT_flgOvrRunActvd OilSwmpT_flgOvrRun_loc OilSwmpT_flgTiEngOff_bEngRot_loc OilSwmpT_flgTiEngOff_bRst_loc OilSwmpT_flgTOSPMabVld OilSwmpT_flgVldTWrmUp OilSwmpT_stMdlElecDrvSaved OilSwmpT_stPwrOnRstTMdl OilSwmpT_stTMdlloc OilSwmpT_tdiffElecDrv OilSwmpT_tiEcuOn OilSwmpT_tMdlElecDrv OilSwmpT_tMdlElecDrvFild OilSwmpT_tMdlElecDrvSaved OilSwmpT_tMdlloc OilSwmpT_tMdlTmp OilSwmpT_tospmloc OilSwmpT_tospmloc_w OilSwmpT_tPistCoolgFild OilSwmpT_tWrmUp OilSwmpT_tWrmUpFild OilSwmpT_tWrmUpHeatgCorrn pwrClntEntryOilSwmpT stCoEngOilSwmpT tiEngOffOilSwmpT tospmbm_w tospmloc_w tospmnf_w tospmq tospmqloc tospmr_w tospmst tospmstab tospmtdr_w tosptmab ttospmr ttospmrsw tumgOilSwmpT vfzgOilSwmpT /end LOC_MEASUREMENT
 FUNCTION_VERSION "1.19.0" /end FUNCTION
/begin FUNCTION OilSwmpT_VdMdl2 "1.6.0     Calculation of model value for Oil deterioration system: Temperature of oil in sump"
 /begin DEF_CHARACTERISTIC OilSwmpT_facEngOffTiCoolgCoeff_T OilSwmpT_facEngSpdCoeff_T OilSwmpT_facVehSpdCoeff_T OilSwmpT_swtMdl2Cfg_C OilSwmpT_tAFSTBlkHeatrDetn_C OilSwmpT_tBlkHeatrCoeff_C OilSwmpT_tCEngDsTBlkHeatrDetn_T OilSwmpT_tHeatCoeff_M OilSwmpT_tiEngOffDurn_C OilSwmpT_tiEngOff_T OilSwmpt_tIntkSnsrSeln_C OilSwmpT_tSafeValMtrDisp_C OilSwmpt_tSafeVal_C /end DEF_CHARACTERISTIC
 /begin IN_MEASUREMENT CEngDsT_t EnvT_tMdl2 Epm_nEng IntkAirT_tAirFltDs IntkAirT_tIntkMnfld IntkAirT_tThrVlvUs OilLfT_mAirPerCyl OilLfT_stFailSafeActn VehV_v /end IN_MEASUREMENT
 /begin OUT_MEASUREMENT OilSwmpT_flgFinshd OilSwmpT_flgInit OilSwmpT_stTMdl2 OilSwmpT_tMdl2 OilSwmpT_tMtrDisp /end OUT_MEASUREMENT
 /begin LOC_MEASUREMENT OilSwmpT_dtCEngDsTMdl OilSwmpT_dtEnvTMdl OilSwmpT_dtMdl2 OilSwmpT_facEngOffTiCoeff OilSwmpT_facEngOffTiCoolgCoeff OilSwmpT_facEngSpdCoeff OilSwmpT_facVehSpdCoeff OilSwmpT_flgEngStrtCmpl OilSwmpT_stEepReadCEngDsTBkup OilSwmpT_stEepReadflgFinshd OilSwmpT_stEepReadMdl OilSwmpT_stEepReadMtrDisp OilSwmpT_tCEngDsTBkup OilSwmpT_tDifCEngDsTEnvT OilSwmpT_tDifCEngDsTEnvTOld OilSwmpT_tDifEngSpdAirMCoeff OilSwmpT_tDifEngSpdCoeff OilSwmpT_tDifMdl OilSwmpT_tDifVehSpdCoeff OilSwmpT_tEngOffTiCoeff OilSwmpT_tHeatCoeff OilSwmpT_tiEngOffTi OilSwmpT_tInit OilSwmpt_tIntkSnsr OilSwmpT_tTmp /end LOC_MEASUREMENT
 FUNCTION_VERSION "1.6.0" /end FUNCTION
/begin FUNCTION PCUECU_PCU "21.3.0_6SAACAN messages of the Power Control unit ECU (PCU)" /begin DEF_CHARACTERISTIC Com_dPCUMaxDiff_C Com_dPCUMaxPer_C Com_stPCUEngStrtInhb_C /end DEF_CHARACTERISTIC
 /begin IN_MEASUREMENT Com_ctCRingPCU Com_numCsumPCU Com_stBCANReprogm Com_stFrmRxEna Com_stMon Com_stPCUEngStrtInhb /end IN_MEASUREMENT
 /begin LOC_MEASUREMENT PCUECU_ctRngPCU_MP /end LOC_MEASUREMENT
 FUNCTION_VERSION "21.3.0_6SAA" /end FUNCTION
/begin FUNCTION PhyMod_ClntEntry "2.4.1     Heat Entry of Engine into Coolant Agent"
 /begin DEF_CHARACTERISTIC PhyMod_CalorificValueGS_C PhyMod_cpHeatExh_C PhyMod_facClntTrq_C /end DEF_CHARACTERISTIC
 /begin IN_MEASUREMENT ActMod_pwrCrksft ExhMod_dmExhMnfB1 ExhMod_tExhMnfB1 InjSys_dvolFu IntkAirT_tIntkMnfld lamsbg_w_msg /end IN_MEASUREMENT
 /begin OUT_MEASUREMENT PhyMod_pwrClntEntry PhyMod_pwrLos PhyMod_pwrTheo /end OUT_MEASUREMENT
 /begin LOC_MEASUREMENT PhyMod_dmFuCns PhyMod_pwrEgLoss PhyMod_pwrTheoloc /end LOC_MEASUREMENT
 FUNCTION_VERSION "2.4.1" /end FUNCTION
/begin FUNCTION PhyMod_TqJCalc "1.6.0     Calculation of the inertia torque of the internal combustion Engine" /begin DEF_CHARACTERISTIC PhyMod_jCmbEng_C PhyMod_tiDerEngFil_CUR /end DEF_CHARACTERISTIC /begin IN_MEASUREMENT Epm_nEng10ms SyC_ctDrvEnter /end IN_MEASUREMENT
 /begin OUT_MEASUREMENT PhyMod_ctTqJDrvEnter PhyMod_jCmbEng PhyMod_jEng PhyMod_tqJEng /end OUT_MEASUREMENT
 /begin LOC_MEASUREMENT PhyMod_dnEngDerFild PhyMod_dnEngDerFild_mp PhyMod_dnEngDerUnFild PhyMod_dnEngDerUnFild_mp PhyMod_tiDerEngFil_mp /end LOC_MEASUREMENT
 FUNCTION_VERSION "1.6.0" /end FUNCTION
/begin FUNCTION PID51_FuTyp "1.8.0     Type of fuel currently being utilized by the vehicle" /begin DEF_CHARACTERISTIC PID51_stFuTyp_C PID51_swtVehTyp_C /end DEF_CHARACTERISTIC /begin OUT_MEASUREMENT PID51_stFuTyp /end OUT_MEASUREMENT FUNCTION_VERSION "1.8.0" /end FUNCTION
/begin FUNCTION PIDA6_OdoCalc "1.2.0     Odometer Calculation for PID 0xA6" /begin DEF_CHARACTERISTIC PIDA6_lDstLim_C /end DEF_CHARACTERISTIC /begin IN_MEASUREMENT Com_lTotOdo /end IN_MEASUREMENT /begin OUT_MEASUREMENT PIDA6_lDstDrvngCyc PIDA6_lTotDst /end OUT_MEASUREMENT
 /begin LOC_MEASUREMENT PIDA6_lDstStrt PIDA6_lTotDstLstStored PIDA6_lTotDstProtd PIDA6_stEepOrder PIDA6_stEepWrite /end LOC_MEASUREMENT
 FUNCTION_VERSION "1.2.0" /end FUNCTION
/begin FUNCTION PIntkVUs_DD "16.29.1   pressure upstream inlet valve"
 /begin DEF_CHARACTERISTIC PIntkVUs_facCnvnSlopAdc_C PIntkVUs_nEngThresPresRawIni_C PIntkVUs_nThresSync_C PIntkVUs_pADCVltgTrfPresOfs_C PIntkVUs_stCfg_C PIntkVUs_tiPt1VltgSegBasdTi_T PIntkVUs_uThresMax_C PIntkVUs_uThresMin_C /end DEF_CHARACTERISTIC
 /begin IN_MEASUREMENT B_syn2fe_msg DSM_TripChgFinshd EpmCrS_tiSeg Epm_nEng Epm_nEng10ms Epm_stSync SyC_stSub /end IN_MEASUREMENT
 /begin OUT_MEASUREMENT B_psinirg_msg B_psrmw_msg B_psrrg_msg PIntkVUs_dpRaw PIntkVUs_flgPRawIniVldB1 PIntkVUs_flgPRawVldB1 PIntkVUs_flgPRawVldTiBasdB1 PIntkVUs_pRaw PIntkVUs_pRawB1 PIntkVUs_pRawIni PIntkVUs_pRawIniB1 PIntkVUs_pRawObd PIntkVUs_pRawTiBasdB1 PIntkVUs_stPresIniVld PIntkVUs_stSRCVld PIntkVUs_uRawUnFlt psini_w_msg psrrff_w_msg psrr_w_msg /end OUT_MEASUREMENT
 /begin LOC_MEASUREMENT PIntkVUs_flgIniFinshdB1 PIntkVUs_flgPRawVldLocSynBasdB1 PIntkVUs_flgPRawVldLocTiBasdB1 PIntkVUs_flgRngErrMaxLocSyn PIntkVUs_flgRngErrMaxLocTi PIntkVUs_flgRngErrMaxSyn PIntkVUs_flgRngErrMaxTi PIntkVUs_flgRngErrMinLocSyn PIntkVUs_flgRngErrMinLocTi PIntkVUs_flgRngErrMinSyn PIntkVUs_flgRngErrMinTi PIntkVUs_nrRawCnt PIntkVUs_nrRawCntSynBasd PIntkVUs_nrRawCntTiBasd PIntkVUs_pRawLocSynBasd PIntkVUs_pRawOld PIntkVUs_stEdgRsChk PIntkVUs_tiSegADCData PIntkVUs_uRawAvrgSynBasd PIntkVUs_uRawAvrgTiBasd PIntkVUs_uRawFlt PIntkVUs_uRawSum PIntkVUs_uRawSumSynBasd PIntkVUs_uRawSumTiBasd /end LOC_MEASUREMENT
 FUNCTION_VERSION "16.29.1" /end FUNCTION
/begin FUNCTION PSPCtlG_Co "52.6.0_1.3.0Operating conditions of the electric fuel pump"
 /begin DEF_CHARACTERISTIC PSPCtlG_CodWd PSPCtl_ctEngStopPSPOnOff_C PSPCtl_ctPreRunDrvMax_C PSPCtl_ctPreRunPreDrvMax_C PSPCtl_cwPSPCtl_CW PSPCtl_tiEngOffPreRun_C PSPCtl_tiEngStalDly_C PSPCtl_tiEngStopPSPOff_C PSPCtl_tiEngStopPSPOn_C PSPCtl_tiFrstFl_C PSPCtl_tiPreRunDrv_C PSPCtl_tiPreRunPreDrv_C PSPCtl_tiStrtDem_C PSPCtl_tiVapSuspcStrt_C PSPCtl_tiVapSuspc_C PSPCtl_tVapSuspcISS_T PSPCtl_tVapSuspc_T /end DEF_CHARACTERISTIC
 /begin IN_MEASUREMENT BattU_stPwrFail B_ebfmod_msg B_stopeng_msg B_urstsprr_msg CEngDsT_flgSnsrElecVld CEngDsT_t CoEng_st CoEng_stOld CoVeh_stEngStrtOrd CoVOM_bSSEEngStopPassed CoVOM_bSysOff CoVOM_stSSE EngStrt_bStrtEnd Epm_nEng IntkAirT_tAirFltDsMeasd Strt_stStaActv SyC_stSub tengsq1_w_msg TiEngOff_stTi /end IN_MEASUREMENT
 /begin OUT_MEASUREMENT B_ekpvl_msg B_tapcm_msg PSPCtl_flgRmnVapSuspc PSP_st /end OUT_MEASUREMENT
 /begin LOC_MEASUREMENT PSPCtlG_bEngCyclStSp PSPCtl_bEngSpdDet PSPCtl_bEngStop PSPCtl_bPreRun PSPCtl_bPreRunEnbl PSPCtl_bPreRunLck PSPCtl_bPSPDisbl PSPCtl_bPSPXPostDrv PSPCtl_bPSPXPreDrv PSPCtl_bShOffPSP PSPCtl_ctPreRun PSPCtl_flgPwrOnRst PSPCtl_flgRmnVapSuspcPSP PSPCtl_tiPreRun PSPCtl_tiRmnVap PSP_stDetSleep /end LOC_MEASUREMENT
 FUNCTION_VERSION "52.6.0_1.3.0" /end FUNCTION
/begin FUNCTION PSPG_DDCo "52.2.0    Device Driver of the fuel pump electronic control module"
 /begin DEF_CHARACTERISTIC PSPDig_ATS.LimitTypeMsk_C PSPDig_ATS.CnvNorm_C PSPDig_ATS.LowLim_C PSPDig_ATS.UpLim_C PSPDig_ATS.CnvFac_C PSPDig_ATS.CnvOfs_C PSPDig_ATS.DfltVal_C PSP_DigOutp.tiBtwTstSCB_C PSP_DigOutp.tiBtwTstOT_C PSP_DigOutp.numTstMax_C PSP_stPsDiaDisbl_C PSP_stPsDisbl_C /end DEF_CHARACTERISTIC
 /begin IN_MEASUREMENT DevLib_stPwrStgEnaCond MoCSOP_stActvMsg PSP_st /end IN_MEASUREMENT
 /begin OUT_MEASUREMENT PSP_stPs /end OUT_MEASUREMENT
 /begin LOC_MEASUREMENT PSP_stActv_mp /end LOC_MEASUREMENT
 FUNCTION_VERSION "52.2.0" /end FUNCTION
/begin COMPU_METHOD AccGrv "" RAT_FUNC "%6.4" "g" COEFFS 0 100 0 0 0 1 /end COMPU_METHOD
/begin COMPU_METHOD AirMassPerCyl "" RAT_FUNC "%6.3" "mg/Hub" COEFFS 0 10 0 0 0 1 /end COMPU_METHOD
/begin COMPU_METHOD B_TRUE "" TAB_VERB "%6.3" "" COMPU_TAB_REF B_TRUE /end COMPU_METHOD
/begin COMPU_VTAB B_TRUE "" TAB_VERB 2 0 "FALSE" 1 "TRUE" /end COMPU_VTAB
/begin COMPU_METHOD CoEng_stMai_VERB "" TAB_VERB "%6.3" "" COMPU_TAB_REF CoEng_stMai_VERB /end COMPU_METHOD
/begin COMPU_VTAB CoEng_stMai_VERB "" TAB_VERB 7 0 "COENG_ST_STANDBY" 4 "COENG_ST_READY" 16 "COENG_ST_STARTING" 64 "COENG_ST_AUTOSTOPPING" 1024 "COENG_ST_RUNNING" 4096 "COENG_ST_STOPPING" 16384 "COENG_ST_FINISH" /end COMPU_VTAB
/begin COMPU_METHOD dez "" RAT_FUNC "%6.2" "" COEFFS 0 1 0 0 0 1 /end COMPU_METHOD
/begin COMPU_METHOD EngN "" RAT_FUNC "%6.3" "rpm" COEFFS 0 2 0 0 0 1 /end COMPU_METHOD
/begin COMPU_METHOD EnrgPerMass "" RAT_FUNC "%6.3" "MJ/Kg" COEFFS 0 10 0 0 0 1 /end COMPU_METHOD
/begin COMPU_METHOD ExeCon_State_02 "" TAB_VERB "%6.3" "" COMPU_TAB_REF ExeCon_State_02 /end COMPU_METHOD
/begin COMPU_VTAB ExeCon_State_02 "" TAB_VERB 7 0 "SYC_INI" 1 "SYC_INISYN" 2 "SYC_INIEND" 3 "SYC_PREDRIVE" 4 "SYC_DRIVE" 5 "SYC_POSTDRIVE" 6 "SYC_POST_OS_EXIT" /end COMPU_VTAB
/begin COMPU_METHOD fak_q0p0078 "" RAT_FUNC "%6.4" "-" COEFFS 0 128 0 0 0 1 /end COMPU_METHOD
/begin COMPU_METHOD fak_q3p0518Em5 "" RAT_FUNC "%7.6" "" COEFFS 0 32768 0 0 0 1 /end COMPU_METHOD
/begin COMPU_METHOD fak_ub_b1 "" RAT_FUNC "%6.4" "-" COEFFS 0 256 0 0 0 1 /end COMPU_METHOD
/begin COMPU_METHOD fak_ub_b2 "" RAT_FUNC "%8.5" "-" COEFFS 0 256 0 0 0 2 /end COMPU_METHOD
/begin COMPU_METHOD fak_ub_q0p00392 "" RAT_FUNC "%6.4" "-" COEFFS 0 255 0 0 0 1 /end COMPU_METHOD
/begin COMPU_METHOD fak_uw_b1 "" RAT_FUNC "%7.6" "-" COEFFS 0 65536 0 0 0 1 /end COMPU_METHOD
/begin COMPU_METHOD fak_uw_b2 "" RAT_FUNC "%7.6" "-" COEFFS 0 65536 0 0 0 2 /end COMPU_METHOD
/begin COMPU_METHOD fak_uw_b4 "" RAT_FUNC "%7.6" "-" COEFFS 0 65536 0 0 0 4 /end COMPU_METHOD
/begin COMPU_METHOD InjMassPerTime "" RAT_FUNC "%6.4" "Kg/h" COEFFS 0 100 0 0 0 1 /end COMPU_METHOD
/begin COMPU_METHOD j_q0p000153 "" RAT_FUNC "%6.5" "kg m^2" COEFFS 0 65536 0 0 0 10 /end COMPU_METHOD
/begin COMPU_METHOD kw_sw_q0p0078 "" RAT_FUNC "%6.4" "Grad KW" COEFFS 0 128 0 0 0 1 /end COMPU_METHOD
/begin COMPU_METHOD Moment_Inertia "" RAT_FUNC "%6.4" "kg * m^2" COEFFS 0 100 0 0 0 1 /end COMPU_METHOD
/begin COMPU_METHOD m_q0p02133 "" RAT_FUNC "%6.4" "g" COEFFS 0 375 0 0 0 8 /end COMPU_METHOD
/begin COMPU_METHOD m_uw_b6553p5 "" RAT_FUNC "%6.3" "kg/h" COEFFS 0 1 0 0 0 0.1 /end COMPU_METHOD
/begin COMPU_METHOD nmotgrd_q2 "" RAT_FUNC "%6.2" "1/(min*s)" COEFFS 0 1 0 0 0 2 /end COMPU_METHOD
/begin COMPU_METHOD nmot_q10 "" RAT_FUNC "%6.1" "1/min" COEFFS 0 1 0 0 0 10 /end COMPU_METHOD
/begin COMPU_METHOD nmot_ub_q10 "" RAT_FUNC "%6.1" "1/min" COEFFS 0 1 0 0 0 10 /end COMPU_METHOD
/begin COMPU_METHOD nmot_ub_q40 "" RAT_FUNC "%6.1" "1/min" COEFFS 0 1 0 0 0 40 /end COMPU_METHOD
/begin COMPU_METHOD nmot_uw_q0p25 "" RAT_FUNC "%6.3" "1/min" COEFFS 0 1 0 0 0 0.25 /end COMPU_METHOD
/begin COMPU_METHOD OCWDA_stErrSimn_C_compu_VERB "" TAB_VERB "%6.3" "" COMPU_TAB_REF OCWDA_stErrSimn_C_compu_VERB /end COMPU_METHOD
/begin COMPU_VTAB OCWDA_stErrSimn_C_compu_VERB "" TAB_VERB 9 0 "OCWDA_CO_SIMN_OFF" 1 "OCWDA_CO_SIMNERRPINON" 2 "OCWDA_CO_SIMNERRPINOFF" 3 "OCWDA_CO_SIMNWDAACTV" 4 "OCWDA_CO_SIMNWDAOFF" 5 "OCWDA_CO_SIMNOVRVLTG" 6 "OCWDA_CO_SIMNNORMVLTG" 7 "OCWDA_CO_SIMNABEACTV" 8 "OCWDA_CO_SIMNABEOFF" /end COMPU_VTAB
/begin COMPU_METHOD OCWDA_swtOffRst_C_compu_VERB "" TAB_VERB "%6.3" "" COMPU_TAB_REF OCWDA_swtOffRst_C_compu_VERB /end COMPU_METHOD
/begin COMPU_VTAB OCWDA_swtOffRst_C_compu_VERB "" TAB_VERB 2 0 "OCWDA_RESET_ACTIVE" 1 "OCWDA_RESET_INACTIVE" /end COMPU_VTAB
/begin COMPU_METHOD OneToOne "" RAT_FUNC "%6.2" "-" COEFFS 0 1 0 0 0 1 /end COMPU_METHOD
/begin COMPU_METHOD Per_Dur "" RAT_FUNC "%6.2" "usec" COEFFS 0 1 0 0 0 1 /end COMPU_METHOD
/begin COMPU_METHOD pgrd_q0p3125 "" RAT_FUNC "%6.3" "hPa/s" COEFFS 0 256 0 0 0 80 /end COMPU_METHOD
/begin COMPU_METHOD Pres "" RAT_FUNC "%6.3" "kPa" COEFFS 0 10 0 0 0 1 /end COMPU_METHOD
/begin COMPU_METHOD Pres_hPa "" RAT_FUNC "%6.2" "hPa" COEFFS 0 1 0 0 0 1 /end COMPU_METHOD
/begin COMPU_METHOD Pwr2 "" RAT_FUNC "%6.1" "W" COEFFS 0 0.0530516476972949 0 0 0 1 /end COMPU_METHOD
/begin COMPU_METHOD pwr2 "" RAT_FUNC "%6.1" "W" COEFFS 0 0.0530516476972949 0 0 0 1 /end COMPU_METHOD
/begin COMPU_METHOD p_q0p039 "" RAT_FUNC "%6.4" "hPa" COEFFS 0 256 0 0 0 10 /end COMPU_METHOD
/begin COMPU_METHOD p_q0p078 "" RAT_FUNC "%6.4" "hPa" COEFFS 0 64 0 0 0 5 /end COMPU_METHOD
/begin COMPU_METHOD q0p025_hPa_DIV_V "" RAT_FUNC "%6.4" "hPa/V" COEFFS 0 40 0 0 0 1 /end COMPU_METHOD
/begin COMPU_METHOD RBPtCel_dst_0p1_2 "" RAT_FUNC "%6.3" "km" COEFFS 0 10 0 0 0 1 /end COMPU_METHOD
/begin COMPU_METHOD RBPtCel_t_1p52588em5_1 "" RAT_FUNC "%7.6" "Deg C" COEFFS 0 65536 0 0 0 1 /end COMPU_METHOD
/begin COMPU_METHOD rel_ub_q0p75 "" RAT_FUNC "%6.3" "%" COEFFS 0 1 0 0 0 0.75 /end COMPU_METHOD
/begin COMPU_METHOD rel_uw_q0p0234 "" RAT_FUNC "%6.4" "%" COEFFS 0 32 0 0 0 0.75 /end COMPU_METHOD
/begin COMPU_METHOD SigQly_COMPU_VERB "" TAB_VERB "%6.3" "" COMPU_TAB_REF SigQly_COMPU_VERB /end COMPU_METHOD
/begin COMPU_VTAB SigQly_COMPU_VERB "" TAB_VERB 16 0 "SIGQLY_NOTCALC" 1 "SIGQLY_INIT" 2 "SIGQLY_OK" 3 "SIGQLY_MODEL" 4 "SIGQLY_REPLACEMENT" 5 "SIGQLY_FROZEN" 6 "SIGQLY_INVALID" 7 "SIGQLY_RESERVED_7" 8 "SIGQLY_RESERVED_8" 9 "SIGQLY_RESERVED_9" 10 "SIGQLY_RESERVED_10" 11 "SIGQLY_RESERVED_11" 12 "SIGQLY_RESERVED_12" 13 "SIGQLY_RESERVED_13" 14 "SIGQLY_RESERVED_14" 15 "SIGQLY_RESERVED_15" /end COMPU_VTAB
/begin COMPU_METHOD SY_RLMXKV_Compu "" TAB_VERB "%6.3" "" COMPU_TAB_REF SY_RLMXKV_Compu /end COMPU_METHOD
/begin COMPU_VTAB SY_RLMXKV_Compu "" TAB_VERB 2 0 "no_rlmxkv" 1 "rlmxkv" /end COMPU_VTAB
/begin COMPU_METHOD SY_RLRK_Compu "" TAB_VERB "%6.3" "" COMPU_TAB_REF SY_RLRK_Compu /end COMPU_METHOD
/begin COMPU_VTAB SY_RLRK_Compu "" TAB_VERB 2 0 "System ohne rl/rk-Überwachung" 1 "System mit rl/rk-Überwachung" /end COMPU_VTAB
/begin COMPU_METHOD SY_RLXDZW_Compu "" TAB_VERB "%6.3" "" COMPU_TAB_REF SY_RLXDZW_Compu /end COMPU_METHOD
/begin COMPU_VTAB SY_RLXDZW_Compu "" TAB_VERB 2 0 "False" 1 "True" /end COMPU_VTAB
/begin COMPU_METHOD SY_RLXRED_Compu "" TAB_VERB "%6.3" "" COMPU_TAB_REF SY_RLXRED_Compu /end COMPU_METHOD
/begin COMPU_VTAB SY_RLXRED_Compu "" TAB_VERB 2 0 "SY_RLXRED=0" 1 "SY_RLXRED=1" /end COMPU_VTAB
/begin COMPU_METHOD SY_RLXVD_Compu "" TAB_VERB "%6.3" "" COMPU_TAB_REF SY_RLXVD_Compu /end COMPU_METHOD
/begin COMPU_VTAB SY_RLXVD_Compu "" TAB_VERB 3 0 "SY_RLXVD_0" 1 "SY_RLXVD_1" 2 "SY_RLXVD_2" /end COMPU_VTAB
/begin COMPU_METHOD SY_RQMNUGA_Compu "" TAB_VERB "%6.3" "" COMPU_TAB_REF SY_RQMNUGA_Compu /end COMPU_METHOD
/begin COMPU_VTAB SY_RQMNUGA_Compu "" TAB_VERB 2 0 "False" 1 "True" /end COMPU_VTAB
/begin COMPU_METHOD SY_RVS_Compu "" TAB_VERB "%6.3" "" COMPU_TAB_REF SY_RVS_Compu /end COMPU_METHOD
/begin COMPU_VTAB SY_RVS_Compu "" TAB_VERB 2 0 "no remote vehicle start request" 1 "remote vehicle start request" /end COMPU_VTAB
/begin COMPU_METHOD SY_RZSZ_Compu "" TAB_VERB "%6.3" "" COMPU_TAB_REF SY_RZSZ_Compu /end COMPU_METHOD
/begin COMPU_VTAB SY_RZSZ_Compu "" TAB_VERB 2 0 "OFF" 1 "ON" /end COMPU_VTAB
/begin COMPU_METHOD SY_SAGS_Compu "" TAB_VERB "%6.3" "" COMPU_TAB_REF SY_SAGS_Compu /end COMPU_METHOD
/begin COMPU_VTAB SY_SAGS_Compu "" TAB_VERB 2 0 "False" 1 "True" /end COMPU_VTAB
/begin COMPU_METHOD SY_SALSU_Compu "" TAB_VERB "%6.3" "" COMPU_TAB_REF SY_SALSU_Compu /end COMPU_METHOD
/begin COMPU_VTAB SY_SALSU_Compu "" TAB_VERB 2 0 "kein Schubabgleich" 1 "Schubabgleich vorhanden" /end COMPU_VTAB
/begin COMPU_METHOD SY_SCG_Compu "" TAB_VERB "%6.3" "" COMPU_TAB_REF SY_SCG_Compu /end COMPU_METHOD
/begin COMPU_VTAB SY_SCG_Compu "" TAB_VERB 2 0 "False" 1 "True" /end COMPU_VTAB
/begin COMPU_METHOD SY_SCHUMZW_Compu "" RAT_FUNC "%6.2" "" COEFFS 0 1 0 0 0 1 /end COMPU_METHOD
/begin COMPU_METHOD SY_SCH_Compu "" TAB_VERB "%6.3" "" COMPU_TAB_REF SY_SCH_Compu /end COMPU_METHOD
/begin COMPU_VTAB SY_SCH_Compu "" TAB_VERB 2 0 "False" 1 "True" /end COMPU_VTAB
/begin COMPU_METHOD SY_SGANZFR_Compu "" TAB_VERB "%6.3" "" COMPU_TAB_REF SY_SGANZFR_Compu /end COMPU_METHOD
/begin COMPU_VTAB SY_SGANZFR_Compu "" TAB_VERB 2 1 "1 SG 1 FR" 2 "2 SG pro Fuel Rail" /end COMPU_VTAB
/begin COMPU_METHOD SY_SGANZ_Compu "" TAB_VERB "%6.3" "" COMPU_TAB_REF SY_SGANZ_Compu /end COMPU_METHOD
/begin COMPU_VTAB SY_SGANZ_Compu "" TAB_VERB 3 1 "Ein Steuergeräte Motormanagement Konzept" 2 "Zwei Steuergeräte Motormanagement Konzept" 3 "Drei Steuergeräte Motormanagement Konzept" /end COMPU_VTAB
/begin COMPU_METHOD SY_SKH_Compu "" TAB_VERB "%6.3" "" COMPU_TAB_REF SY_SKH_Compu /end COMPU_METHOD
/begin COMPU_VTAB SY_SKH_Compu "" TAB_VERB 2 0 "False" 1 "True" /end COMPU_VTAB
/begin COMPU_METHOD SY_SKR_Compu "" TAB_VERB "%6.3" "" COMPU_TAB_REF SY_SKR_Compu /end COMPU_METHOD
/begin COMPU_VTAB SY_SKR_Compu "" TAB_VERB 2 0 "False" 1 "True" /end COMPU_VTAB
/begin COMPU_METHOD SY_SLPANZ_Compu "" TAB_VERB "%6.3" "" COMPU_TAB_REF SY_SLPANZ_Compu /end COMPU_METHOD
/begin COMPU_VTAB SY_SLPANZ_Compu "" TAB_VERB 3 0 "keine SLP" 1 "1 SLP" 2 "2 SLP" /end COMPU_VTAB
/begin COMPU_METHOD SY_SLS_Compu "" TAB_VERB "%6.3" "" COMPU_TAB_REF SY_SLS_Compu /end COMPU_METHOD
/begin COMPU_VTAB SY_SLS_Compu "" TAB_VERB 3 0 "keine Sekundärluftpumpe vorhanden" 1 "Sekundärluftpumpe vorhanden" 2 "GGSLSHFM vorhanden" /end COMPU_VTAB
/begin COMPU_METHOD SY_SLVANZ_Compu "" TAB_VERB "%6.3" "" COMPU_TAB_REF SY_SLVANZ_Compu /end COMPU_METHOD
/begin COMPU_VTAB SY_SLVANZ_Compu "" TAB_VERB 4 0 "kein SLV" 1 "1 SLV" 2 "2 SLV" 4 "4 SLV" /end COMPU_VTAB
/begin COMPU_METHOD SY_SLVEST_Compu "" TAB_VERB "%6.3" "" COMPU_TAB_REF SY_SLVEST_Compu /end COMPU_METHOD
/begin COMPU_VTAB SY_SLVEST_Compu "" TAB_VERB 3 0 "SLVEST_ZERO" 1 "SLVEST_ONE" 2 "SLVEST_TWO" /end COMPU_VTAB
/begin COMPU_METHOD SY_SOTUN_Compu "" TAB_VERB "%6.3" "" COMPU_TAB_REF SY_SOTUN_Compu /end COMPU_METHOD
/begin COMPU_VTAB SY_SOTUN_Compu "" TAB_VERB 2 0 "False" 1 "True" /end COMPU_VTAB
/begin COMPU_METHOD SY_SPRSTRT_Compu "" TAB_VERB "%6.3" "" COMPU_TAB_REF SY_SPRSTRT_Compu /end COMPU_METHOD
/begin COMPU_VTAB SY_SPRSTRT_Compu "" TAB_VERB 2 0 "False" 1 "True" /end COMPU_VTAB
/begin COMPU_METHOD SY_SSPDSKV_Compu "" TAB_VERB "%6.3" "" COMPU_TAB_REF SY_SSPDSKV_Compu /end COMPU_METHOD
/begin COMPU_VTAB SY_SSPDSKV_Compu "" TAB_VERB 4 0 "Diagnosis feature not activated" 1 "DDSKV connected to powersupply1" 2 "DDSKV connected to powersupply2" 3 "DDSKV connected to powersupply3" /end COMPU_VTAB
/begin COMPU_METHOD SY_SSPPSR_Compu "" TAB_VERB "%6.3" "" COMPU_TAB_REF SY_SSPPSR_Compu /end COMPU_METHOD
/begin COMPU_VTAB SY_SSPPSR_Compu "" TAB_VERB 6 0 "powersupply diagnosis deactivated" 1 "MAP sensor connected to powersupply1" 2 "MAP sensor connected to powersupply2" 3 "MAP sensor connected to powersupply3" 4 "MAP sensor connected to powersupply4" 5 "MAP sensor connected to powersupply5" /end COMPU_VTAB
/begin COMPU_METHOD SY_STADAP_Compu "" TAB_VERB "%6.3" "" COMPU_TAB_REF SY_STADAP_Compu /end COMPU_METHOD
/begin COMPU_VTAB SY_STADAP_Compu "" TAB_VERB 3 0 "no STADAP" 1 "STADAP inside" 2 "STADAP incl. fuel reset" /end COMPU_VTAB
/begin COMPU_METHOD SY_STAEVAB_Compu "" TAB_VERB "%6.3" "" COMPU_TAB_REF SY_STAEVAB_Compu /end COMPU_METHOD
/begin COMPU_VTAB SY_STAEVAB_Compu "" TAB_VERB 2 0 "False" 1 "True" /end COMPU_VTAB
/begin COMPU_METHOD SY_STARTDK_Compu "" TAB_VERB "%6.3" "" COMPU_TAB_REF SY_STARTDK_Compu /end COMPU_METHOD
/begin COMPU_VTAB SY_STARTDK_Compu "" TAB_VERB 3 0 "DK-Start-Winkel" 1 "DK-Start-Massenstrom" 2 "DK-Start-Massenstrom-und-Winkel" /end COMPU_VTAB
/begin COMPU_METHOD SY_STASTO_Compu "" TAB_VERB "%6.3" "" COMPU_TAB_REF SY_STASTO_Compu /end COMPU_METHOD
/begin COMPU_VTAB SY_STASTO_Compu "" TAB_VERB 2 0 "Kein Start-Stopp" 1 "Start-Stop vorhanden" /end COMPU_VTAB
/begin COMPU_METHOD SY_STA_Compu "" TAB_VERB "%6.3" "" COMPU_TAB_REF SY_STA_Compu /end COMPU_METHOD
/begin COMPU_VTAB SY_STA_Compu "" TAB_VERB 2 0 "kein Automatikstart" 1 "Automatikstart" /end COMPU_VTAB
/begin COMPU_METHOD SY_STELRHE_Compu "" TAB_VERB "%6.3" "" COMPU_TAB_REF SY_STELRHE_Compu /end COMPU_METHOD
/begin COMPU_VTAB SY_STELRHE_Compu "" TAB_VERB 2 0 "2 Punkt Lambdaregelung vorhanden" 1 "stetige Lambdaregelung mit 2-Punktsonde vorhanden" /end COMPU_VTAB
/begin COMPU_METHOD SY_STERBTS_Compu "" TAB_VERB "%6.3" "" COMPU_TAB_REF SY_STERBTS_Compu /end COMPU_METHOD
/begin COMPU_VTAB SY_STERBTS_Compu "" TAB_VERB 2 0 "kein bankselektiver Bauteileschutz" 1 "bankselektiver Bauteileschutz" /end COMPU_VTAB
/begin COMPU_METHOD SY_STERHK_Compu "" TAB_VERB "%6.3" "" COMPU_TAB_REF SY_STERHK_Compu /end COMPU_METHOD
/begin COMPU_VTAB SY_STERHK_Compu "" TAB_VERB 2 0 "Mono Lambdaregelung hinter KAT" 1 "Stereo Lambdaregelung hinter KAT" /end COMPU_VTAB
/begin COMPU_METHOD SY_STERSY_Compu "" TAB_VERB "%6.3" "" COMPU_TAB_REF SY_STERSY_Compu /end COMPU_METHOD
/begin COMPU_VTAB SY_STERSY_Compu "" TAB_VERB 2 0 "Asymmetrische Abgasanlage" 1 "Symmetrische Abgasanlage" /end COMPU_VTAB
/begin COMPU_METHOD SY_STERVK_Compu "" TAB_VERB "%6.3" "" COMPU_TAB_REF SY_STERVK_Compu /end COMPU_METHOD
/begin COMPU_VTAB SY_STERVK_Compu "" TAB_VERB 2 0 "Mono Lambdaregelung vor KAT" 1 "Stereo Lambdaregelung vor KAT" /end COMPU_VTAB
/begin COMPU_METHOD SY_STETLR_Compu "" TAB_VERB "%6.3" "" COMPU_TAB_REF SY_STETLR_Compu /end COMPU_METHOD
/begin COMPU_VTAB SY_STETLR_Compu "" TAB_VERB 2 0 "2 Punkt Lambdaregelung vorhanden" 1 "stetige Lambdaregelung vorhanden" /end COMPU_VTAB
/begin COMPU_METHOD SY_SUVTYP_Compu "" TAB_VERB "%6.3" "" COMPU_TAB_REF SY_SUVTYP_Compu /end COMPU_METHOD
/begin COMPU_VTAB SY_SUVTYP_Compu "" TAB_VERB 7 0 "SY_SUVTYP_0" 1 "SY_SUVTYP_1" 2 "SY_SUVTYP_2" 3 "SY_SUVTYP_3" 4 "SY_SUVTYP_4" 5 "SY_SUVTYP_5" 6 "SY_SUVTYP_6" /end COMPU_VTAB
/begin COMPU_METHOD SY_SUV_Compu "" TAB_VERB "%6.3" "" COMPU_TAB_REF SY_SUV_Compu /end COMPU_METHOD
/begin COMPU_VTAB SY_SUV_Compu "" TAB_VERB 2 0 "FALSE" 1 "TRUE" /end COMPU_VTAB
/begin COMPU_METHOD SY_SU_Compu "" TAB_VERB "%6.3" "" COMPU_TAB_REF SY_SU_Compu /end COMPU_METHOD
/begin COMPU_VTAB SY_SU_Compu "" TAB_VERB 3 0 "keine Saugrohrumschaltung" 1 "1 Saugrohrumschaltungsklappe" 2 "2 Saugrohrumschaltungsklappen" /end COMPU_VTAB
/begin COMPU_METHOD SY_SVBB_Compu "" TAB_VERB "%6.3" "" COMPU_TAB_REF SY_SVBB_Compu /end COMPU_METHOD
/begin COMPU_VTAB SY_SVBB_Compu "" TAB_VERB 2 0 "NOSVBB" 1 "SVBBETAS" /end COMPU_VTAB
/begin COMPU_METHOD SY_TAHEVCH_Compu "" TAB_VERB "%6.3" "" COMPU_TAB_REF SY_TAHEVCH_Compu /end COMPU_METHOD
/begin COMPU_VTAB SY_TAHEVCH_Compu "" TAB_VERB 4 0 "TAHEVCH_TMOT" 1 "TAHEVCH_CHdT_TAEV" 2 "TAHEVCH_CHdT_TEV" 3 "TAHEVCH_CHdT" /end COMPU_VTAB
/begin COMPU_METHOD SY_TAKH_Compu "" TAB_VERB "%6.3" "" COMPU_TAB_REF SY_TAKH_Compu /end COMPU_METHOD
/begin COMPU_VTAB SY_TAKH_Compu "" TAB_VERB 2 0 "False" 1 "True" /end COMPU_VTAB
/begin COMPU_METHOD SY_TANDK_Compu "" TAB_VERB "%6.3" "" COMPU_TAB_REF SY_TANDK_Compu /end COMPU_METHOD
/begin COMPU_VTAB SY_TANDK_Compu "" TAB_VERB 2 0 "False" 1 "True" /end COMPU_VTAB
/begin COMPU_METHOD SY_TANSPOS_Compu "" TAB_VERB "%6.3" "" COMPU_TAB_REF SY_TANSPOS_Compu /end COMPU_METHOD
/begin COMPU_VTAB SY_TANSPOS_Compu "" TAB_VERB 4 0 "NO_TANS" 1 "TFA1_TANS" 2 "TFA2_TANS" 3 "TFA3_TANS" /end COMPU_VTAB
/begin COMPU_METHOD SY_TASR2_Compu "" TAB_VERB "%6.3" "" COMPU_TAB_REF SY_TASR2_Compu /end COMPU_METHOD
/begin COMPU_VTAB SY_TASR2_Compu "" TAB_VERB 2 0 "False" 1 "True" /end COMPU_VTAB
/begin COMPU_METHOD SY_TASR_Compu "" TAB_VERB "%6.3" "" COMPU_TAB_REF SY_TASR_Compu /end COMPU_METHOD
/begin COMPU_VTAB SY_TASR_Compu "" TAB_VERB 2 0 "False" 1 "True" /end COMPU_VTAB
/begin COMPU_METHOD SY_TAVDK2_Compu "" TAB_VERB "%6.3" "" COMPU_TAB_REF SY_TAVDK2_Compu /end COMPU_METHOD
/begin COMPU_VTAB SY_TAVDK2_Compu "" TAB_VERB 2 0 "False" 1 "True" /end COMPU_VTAB
/begin COMPU_METHOD SY_TAVDK_Compu "" TAB_VERB "%6.3" "" COMPU_TAB_REF SY_TAVDK_Compu /end COMPU_METHOD
/begin COMPU_VTAB SY_TAVDK_Compu "" TAB_VERB 2 0 "False" 1 "True" /end COMPU_VTAB
/begin COMPU_METHOD SY_TAVVM_Compu "" TAB_VERB "%6.3" "" COMPU_TAB_REF SY_TAVVM_Compu /end COMPU_METHOD
/begin COMPU_VTAB SY_TAVVM_Compu "" TAB_VERB 6 0 "TAVVM_TUMG" 1 "TAVVM_PHYS" 2 "TAVVM_PHYS_BYPASS" 3 "TAVVM_TANLF" 4 "TAVVM_RAWSENS" 5 "TAVVM_PHYSADV_SUV" /end COMPU_VTAB
/begin COMPU_METHOD SY_TAVV_Compu "" TAB_VERB "%6.3" "" COMPU_TAB_REF SY_TAVV_Compu /end COMPU_METHOD
/begin COMPU_VTAB SY_TAVV_Compu "" TAB_VERB 2 0 "TAVV_NO" 1 "TAVV_YES" /end COMPU_VTAB
/begin COMPU_METHOD SY_TCNS_Compu "" TAB_VERB "%6.3" "" COMPU_TAB_REF SY_TCNS_Compu /end COMPU_METHOD
/begin COMPU_VTAB SY_TCNS_Compu "" TAB_VERB 2 0 "kein Testereingriff LL-Solldrehzahlumschaltung" 1 "Testereingriff LL-Solldrehzahlumschaltung" /end COMPU_VTAB
/begin COMPU_METHOD SY_TEBF_Compu "" TAB_VERB "%6.3" "" COMPU_TAB_REF SY_TEBF_Compu /end COMPU_METHOD
/begin COMPU_VTAB SY_TEBF_Compu "" TAB_VERB 3 0 "kein Erstbefüllung" 1 "Erstbefüllung ein über Tester" 2 "Erstbefüllung ein/aus über Tester" /end COMPU_VTAB
/begin COMPU_METHOD SY_TEETH_Compu "" TAB_VERB "%6.3" "" COMPU_TAB_REF SY_TEETH_Compu /end COMPU_METHOD
/begin COMPU_VTAB SY_TEETH_Compu "" TAB_VERB 5 12 "number_of_crankshaft_wheel_teeth_is_12_minus_x" 24 "number_of_crankshaft_wheel_teeth_is_24_minus_x" 30 "number_of_crankshaft_wheel_teeth_is_30_minus_x" 36 "number of crankshaft wheel teeth is 36 minus x" 60 "number of crankshaft wheel teeth is 60 minus x" /end COMPU_VTAB
/begin COMPU_METHOD SY_TEV5_Compu "" TAB_VERB "%6.3" "" COMPU_TAB_REF SY_TEV5_Compu /end COMPU_METHOD
/begin COMPU_VTAB SY_TEV5_Compu "" TAB_VERB 2 0 "TEV5 nicht verbaut" 1 "TEV5 verbaut" /end COMPU_VTAB
/begin COMPU_METHOD SY_TEVANZ_Compu "" TAB_VERB "%6.3" "" COMPU_TAB_REF SY_TEVANZ_Compu /end COMPU_METHOD
/begin COMPU_VTAB SY_TEVANZ_Compu "" TAB_VERB 2 1 "number of canister purge valves (TEVs) is 1" 2 "number of canister purge valves (TEVs) is 2" /end COMPU_VTAB
/begin COMPU_METHOD SY_TFA1GRD_Compu "" TAB_VERB "%6.3" "" COMPU_TAB_REF SY_TFA1GRD_Compu /end COMPU_METHOD
/begin COMPU_VTAB SY_TFA1GRD_Compu "" TAB_VERB 2 0 "Gradientenüberwachung nicht vorhanden" 1 "Gradientenüberwachung vorhanden" /end COMPU_VTAB
/begin COMPU_METHOD SY_TFA2GRD_Compu "" TAB_VERB "%6.3" "" COMPU_TAB_REF SY_TFA2GRD_Compu /end COMPU_METHOD
/begin COMPU_VTAB SY_TFA2GRD_Compu "" TAB_VERB 2 0 "False" 1 "True" /end COMPU_VTAB
/begin COMPU_METHOD SY_TFA2POS_Compu "" TAB_VERB "%6.3" "" COMPU_TAB_REF SY_TFA2POS_Compu /end COMPU_METHOD
/begin COMPU_VTAB SY_TFA2POS_Compu "" TAB_VERB 7 0 "no tfa2-sensor" 1 "TASR" 2 "TAVDK" 3 "TAVLLK" 4 "TAV2V" 5 "TAVV" 6 "TANLF" /end COMPU_VTAB
/begin COMPU_METHOD SY_TFA3GRD_Compu "" TAB_VERB "%6.3" "" COMPU_TAB_REF SY_TFA3GRD_Compu /end COMPU_METHOD
/begin COMPU_VTAB SY_TFA3GRD_Compu "" TAB_VERB 2 0 "False" 1 "True" /end COMPU_VTAB
/begin COMPU_METHOD SY_TFA4GRD_Compu "" TAB_VERB "%6.3" "" COMPU_TAB_REF SY_TFA4GRD_Compu /end COMPU_METHOD
/begin COMPU_VTAB SY_TFA4GRD_Compu "" TAB_VERB 2 0 "False" 1 "True" /end COMPU_VTAB
/begin COMPU_METHOD SY_TFAJEC_Compu "" TAB_VERB "%6.3" "" COMPU_TAB_REF SY_TFAJEC_Compu /end COMPU_METHOD
/begin COMPU_VTAB SY_TFAJEC_Compu "" TAB_VERB 2 0 "no Jump-Check" 1 "Jump-Check" /end COMPU_VTAB
/begin COMPU_METHOD SY_TFAKON_Compu "" TAB_VERB "%6.3" "" COMPU_TAB_REF SY_TFAKON_Compu /end COMPU_METHOD
/begin COMPU_VTAB SY_TFAKON_Compu "" TAB_VERB 2 0 "1 Sensor" 1 "2 Sensoren moeglich" /end COMPU_VTAB
/begin COMPU_METHOD SY_TFAST_Compu "" TAB_VERB "%6.3" "" COMPU_TAB_REF SY_TFAST_Compu /end COMPU_METHOD
/begin COMPU_VTAB SY_TFAST_Compu "" TAB_VERB 2 0 "False" 1 "True" /end COMPU_VTAB
/begin COMPU_METHOD SY_TFATSTR_Compu "" TAB_VERB "%6.3" "" COMPU_TAB_REF SY_TFATSTR_Compu /end COMPU_METHOD
/begin COMPU_VTAB SY_TFATSTR_Compu "" TAB_VERB 7 0 "NO SENSOR" 1 "TFA1_SCAN" 2 "TFA2_SCAN" 3 "TFA3_SCAN" 4 "TFA4_SCAN" 5 "TFA5_SCAN" 6 "TFA6_SCAN" /end COMPU_VTAB
/begin COMPU_METHOD SY_TFBA_Compu "" TAB_VERB "%6.3" "" COMPU_TAB_REF SY_TFBA_Compu /end COMPU_METHOD
/begin COMPU_VTAB SY_TFBA_Compu "" TAB_VERB 2 0 "kein Testereingriff Beschleunigungsanreicherung" 1 "Testereingriff Beschleunigungsanreicherung" /end COMPU_VTAB
/begin COMPU_METHOD t100msxs_uw_b6553p5 "" RAT_FUNC "%6.3" "s" COEFFS 0 1 0 0 0 0.1 /end COMPU_METHOD
/begin COMPU_METHOD t100msxs_uw_q100 "" RAT_FUNC "%6.3" "s" COEFFS 0 1 0 0 0 0.1 /end COMPU_METHOD
/begin COMPU_METHOD t1sxs_ub_b255 "" RAT_FUNC "%6.2" "s" COEFFS 0 1 0 0 0 1 /end COMPU_METHOD
/begin COMPU_METHOD t200msxs_uw_q0p2 "" RAT_FUNC "%6.3" "s" COEFFS 0 1 0 0 0 0.2 /end COMPU_METHOD
/begin COMPU_METHOD Temp_Cels "" RAT_FUNC "%6.1" "deg C" COEFFS 0 10 2731.4 0 0 1 /end COMPU_METHOD
/begin COMPU_METHOD temp_q0p0234 "" RAT_FUNC "%6.4" "K" COEFFS 0 256 0 0 0 6 /end COMPU_METHOD
/begin COMPU_METHOD temp_q0p0234_o273 "" RAT_FUNC "%6.1" "Grad C" COEFFS 0 1 273.15 0 0 0.0234375 /end COMPU_METHOD
/begin COMPU_METHOD temp_ub_b191p25 "" RAT_FUNC "%6.3" "Grad C" COEFFS 0 1 0 0 0 0.75 /end COMPU_METHOD
/begin COMPU_METHOD temp_ub_q0p75_o48 "" RAT_FUNC "%6.2" "Grad C" COEFFS 0 1 48 0 0 0.75 /end COMPU_METHOD
/begin COMPU_METHOD temp_ub_q1_o60 "" RAT_FUNC "%6.2" "Grad C" COEFFS 0 1 60 0 0 1 /end COMPU_METHOD
/begin COMPU_METHOD temp_uw_q0p75_o48 "" RAT_FUNC "%6.2" "Grad C" COEFFS 0 1 48 0 0 0.75 /end COMPU_METHOD
/begin COMPU_METHOD Thr_Cpty_ExhGs "" RAT_FUNC "%6.1" "J/kgK" COEFFS 0 0.1 0 0 0 1 /end COMPU_METHOD
/begin COMPU_METHOD TimeDelay_s "" RAT_FUNC "%6.1" "s" COEFFS 0 0 1 0 0.00023283064365387 0 /end COMPU_METHOD
/begin COMPU_METHOD TimeDelay_s_Lin_16 "" RAT_FUNC "%6.5" "s" COEFFS 0 6553.4 0 0 0 1 /end COMPU_METHOD
/begin COMPU_METHOD TimeEngOn "" RAT_FUNC "%6.2" "s" COEFFS 0 1 0 0 0 1 /end COMPU_METHOD
/begin COMPU_METHOD TimeRed "" RAT_FUNC "%6.3" "s" COEFFS 0 6.25 0 0 0 1 /end COMPU_METHOD
/begin COMPU_METHOD Time_Dt "" RAT_FUNC "%9.8" "s" COEFFS 0 1000000 0 0 0 1 /end COMPU_METHOD
/begin COMPU_METHOD Time_ms "" RAT_FUNC "%6.1" "ms" COEFFS 0 0.1 0 0 0 1 /end COMPU_METHOD
/begin COMPU_METHOD Time_s "" RAT_FUNC "%6.4" "s" COEFFS 0 100 0 0 0 1 /end COMPU_METHOD
/begin COMPU_METHOD Time_s_1 "" RAT_FUNC "%6.5" "" COEFFS 0 1000 0 0 0 1 /end COMPU_METHOD
/begin COMPU_METHOD Trq "" RAT_FUNC "%6.3" "Nm" COEFFS 0 10 0 0 0 1 /end COMPU_METHOD
/begin COMPU_METHOD t_q0p01 "" RAT_FUNC "%6.4" "s" COEFFS 0 100 0 0 0 1 /end COMPU_METHOD
/begin COMPU_METHOD t_q0p05 "" RAT_FUNC "%6.4" "s" COEFFS 0 100 0 0 0 5 /end COMPU_METHOD
/begin COMPU_METHOD t_q0p1 "" RAT_FUNC "%6.3" "s" COEFFS 0 10 0 0 0 1 /end COMPU_METHOD
/begin COMPU_METHOD t_q1 "" RAT_FUNC "%6.2" "s" COEFFS 0 1 0 0 0 1 /end COMPU_METHOD
/begin COMPU_METHOD t_q10 "" RAT_FUNC "%6.1" "s" COEFFS 0 1 0 0 0 10 /end COMPU_METHOD
/begin COMPU_METHOD Vel "" RAT_FUNC "%6.4" "km/h" COEFFS 0 100 0 0 0 1 /end COMPU_METHOD
/begin COMPU_METHOD vfzg_ub_q1p25 "" RAT_FUNC "%6.2" "km/h" COEFFS 0 1 0 0 0 1.25 /end COMPU_METHOD
/begin COMPU_METHOD Volt "" RAT_FUNC "%6.3" "mV" COEFFS 0 5 0 0 0 1 /end COMPU_METHOD
/begin COMPU_METHOD Volt_q0p00007629 "" RAT_FUNC "%7.6" "V" COEFFS 0 13107.8778345786 0 0 0 1 /end COMPU_METHOD
/begin COMPU_METHOD zk100msxs_ub_b25p5 "" RAT_FUNC "%6.3" "s" COEFFS 0 0 256 0 10 0 /end COMPU_METHOD
/begin COMPU_METHOD zk100msxs_uw_b6553 "" RAT_FUNC "%6.1" "s" COEFFS 0 0 65536 0 10 0 /end COMPU_METHOD
/begin RECORD_LAYOUT Kw_Ws16 FNC_VALUES 1 SWORD COLUMN_DIR DIRECT /end RECORD_LAYOUT
/begin RECORD_LAYOUT Kw_Wu16 FNC_VALUES 1 UWORD COLUMN_DIR DIRECT /end RECORD_LAYOUT
/begin RECORD_LAYOUT RB_Axis_S16 NO_AXIS_PTS_X 1 SWORD AXIS_PTS_X 2 SWORD INDEX_INCR DIRECT /end RECORD_LAYOUT
/begin RECORD_LAYOUT RB_Axis_U8 NO_AXIS_PTS_X 1 UBYTE AXIS_PTS_X 2 UBYTE INDEX_INCR DIRECT /end RECORD_LAYOUT
/begin RECORD_LAYOUT RB_Curve_S16_S16 NO_AXIS_PTS_X 1 SWORD AXIS_PTS_X 2 SWORD INDEX_INCR DIRECT FNC_VALUES 3 SWORD COLUMN_DIR DIRECT /end RECORD_LAYOUT
/begin RECORD_LAYOUT RB_Curve_S16_U16_Static NO_AXIS_PTS_X 1 SWORD AXIS_PTS_X 2 SWORD INDEX_INCR DIRECT FNC_VALUES 3 UWORD COLUMN_DIR DIRECT STATIC_RECORD_LAYOUT /end RECORD_LAYOUT
/begin RECORD_LAYOUT RB_Curve_U16_U16 NO_AXIS_PTS_X 1 UWORD AXIS_PTS_X 2 UWORD INDEX_INCR DIRECT FNC_VALUES 3 UWORD COLUMN_DIR DIRECT /end RECORD_LAYOUT
/begin RECORD_LAYOUT RB_Curve_U16_U8_Static NO_AXIS_PTS_X 1 UWORD AXIS_PTS_X 2 UWORD INDEX_INCR DIRECT FNC_VALUES 3 UBYTE COLUMN_DIR DIRECT STATIC_RECORD_LAYOUT /end RECORD_LAYOUT
/begin RECORD_LAYOUT RB_Curve_U8_S16_Static NO_AXIS_PTS_X 1 UBYTE AXIS_PTS_X 2 UBYTE INDEX_INCR DIRECT FNC_VALUES 3 SWORD COLUMN_DIR DIRECT STATIC_RECORD_LAYOUT /end RECORD_LAYOUT
/begin RECORD_LAYOUT RB_Curve_U8_U16_Static NO_AXIS_PTS_X 1 UBYTE AXIS_PTS_X 2 UBYTE INDEX_INCR DIRECT FNC_VALUES 3 UWORD COLUMN_DIR DIRECT STATIC_RECORD_LAYOUT /end RECORD_LAYOUT
/begin RECORD_LAYOUT RB_Curve_U8_U8 NO_AXIS_PTS_X 1 UBYTE AXIS_PTS_X 2 UBYTE INDEX_INCR DIRECT FNC_VALUES 3 UBYTE COLUMN_DIR DIRECT /end RECORD_LAYOUT
/begin RECORD_LAYOUT RB_MapGroup_U8 FNC_VALUES 1 UBYTE COLUMN_DIR DIRECT /end RECORD_LAYOUT
/begin RECORD_LAYOUT RB_Map_S16S16_S16 NO_AXIS_PTS_X 1 SWORD NO_AXIS_PTS_Y 2 SWORD AXIS_PTS_X 3 SWORD INDEX_INCR DIRECT AXIS_PTS_Y 4 SWORD INDEX_INCR DIRECT FNC_VALUES 5 SWORD COLUMN_DIR DIRECT /end RECORD_LAYOUT
/begin RECORD_LAYOUT RB_Map_S16S16_U16 NO_AXIS_PTS_X 1 SWORD NO_AXIS_PTS_Y 2 SWORD AXIS_PTS_X 3 SWORD INDEX_INCR DIRECT AXIS_PTS_Y 4 SWORD INDEX_INCR DIRECT FNC_VALUES 5 UWORD COLUMN_DIR DIRECT /end RECORD_LAYOUT
/begin RECORD_LAYOUT RB_Map_S16S16_U8 NO_AXIS_PTS_X 1 SWORD NO_AXIS_PTS_Y 2 SWORD AXIS_PTS_X 3 SWORD INDEX_INCR DIRECT AXIS_PTS_Y 4 SWORD INDEX_INCR DIRECT FNC_VALUES 5 UBYTE COLUMN_DIR DIRECT /end RECORD_LAYOUT
/begin RECORD_LAYOUT RB_Map_S16U16_U16 NO_AXIS_PTS_X 1 SWORD NO_AXIS_PTS_Y 2 SWORD AXIS_PTS_X 3 SWORD INDEX_INCR DIRECT AXIS_PTS_Y 4 UWORD INDEX_INCR DIRECT FNC_VALUES 5 UWORD ROW_DIR DIRECT /end RECORD_LAYOUT
/begin RECORD_LAYOUT RB_Map_S16U8_S16 NO_AXIS_PTS_X 1 SWORD NO_AXIS_PTS_Y 2 SWORD AXIS_PTS_X 3 SWORD INDEX_INCR DIRECT AXIS_PTS_Y 4 UBYTE INDEX_INCR DIRECT FNC_VALUES 5 SWORD COLUMN_DIR DIRECT /end RECORD_LAYOUT
/begin RECORD_LAYOUT RB_Map_U16S16_U16 NO_AXIS_PTS_X 1 UWORD NO_AXIS_PTS_Y 2 UWORD AXIS_PTS_X 3 UWORD INDEX_INCR DIRECT AXIS_PTS_Y 4 SWORD INDEX_INCR DIRECT FNC_VALUES 5 UWORD COLUMN_DIR DIRECT /end RECORD_LAYOUT
/begin RECORD_LAYOUT RB_Map_U16S16_U8 NO_AXIS_PTS_X 1 UWORD NO_AXIS_PTS_Y 2 UWORD AXIS_PTS_X 3 UWORD INDEX_INCR DIRECT AXIS_PTS_Y 4 SWORD INDEX_INCR DIRECT FNC_VALUES 5 UBYTE COLUMN_DIR DIRECT /end RECORD_LAYOUT
/begin RECORD_LAYOUT RB_Map_U16U16_S16 NO_AXIS_PTS_X 1 UWORD NO_AXIS_PTS_Y 2 UWORD AXIS_PTS_X 3 UWORD INDEX_INCR DIRECT AXIS_PTS_Y 4 UWORD INDEX_INCR DIRECT FNC_VALUES 5 SWORD COLUMN_DIR DIRECT /end RECORD_LAYOUT
/begin RECORD_LAYOUT RB_Map_U16U16_U16 NO_AXIS_PTS_X 1 UWORD NO_AXIS_PTS_Y 2 UWORD AXIS_PTS_X 3 UWORD INDEX_INCR DIRECT AXIS_PTS_Y 4 UWORD INDEX_INCR DIRECT FNC_VALUES 5 UWORD COLUMN_DIR DIRECT /end RECORD_LAYOUT
/begin RECORD_LAYOUT RB_Map_U16U8_S16 NO_AXIS_PTS_X 1 UWORD NO_AXIS_PTS_Y 2 UWORD AXIS_PTS_X 3 UWORD INDEX_INCR DIRECT AXIS_PTS_Y 4 UBYTE INDEX_INCR DIRECT FNC_VALUES 5 SWORD COLUMN_DIR DIRECT /end RECORD_LAYOUT
/begin RECORD_LAYOUT RB_Map_U8U16_U8 NO_AXIS_PTS_X 1 UBYTE NO_AXIS_PTS_Y 2 UBYTE AXIS_PTS_X 3 UBYTE INDEX_INCR DIRECT AXIS_PTS_Y 4 UWORD INDEX_INCR DIRECT FNC_VALUES 5 UBYTE ROW_DIR DIRECT /end RECORD_LAYOUT
/begin RECORD_LAYOUT RB_Map_U8U8_U8 NO_AXIS_PTS_X 1 UBYTE NO_AXIS_PTS_Y 2 UBYTE AXIS_PTS_X 3 UBYTE INDEX_INCR DIRECT AXIS_PTS_Y 4 UBYTE INDEX_INCR DIRECT FNC_VALUES 5 UBYTE COLUMN_DIR DIRECT /end RECORD_LAYOUT
/begin RECORD_LAYOUT RB_Val_Wboolean FNC_VALUES 1 UBYTE COLUMN_DIR DIRECT /end RECORD_LAYOUT
/begin RECORD_LAYOUT RB_Val_Ws16 FNC_VALUES 1 SWORD COLUMN_DIR DIRECT /end RECORD_LAYOUT
/begin RECORD_LAYOUT RB_Val_Ws32 FNC_VALUES 1 SLONG COLUMN_DIR DIRECT /end RECORD_LAYOUT
/begin RECORD_LAYOUT RB_Val_Ws8 FNC_VALUES 1 SBYTE COLUMN_DIR DIRECT /end RECORD_LAYOUT
/begin RECORD_LAYOUT RB_Val_Wu16 FNC_VALUES 1 UWORD COLUMN_DIR DIRECT /end RECORD_LAYOUT
/begin RECORD_LAYOUT RB_Val_Wu32 FNC_VALUES 1 ULONG COLUMN_DIR DIRECT /end RECORD_LAYOUT
/begin RECORD_LAYOUT RB_Val_Wu8 FNC_VALUES 1 UBYTE COLUMN_DIR DIRECT /end RECORD_LAYOUT
/begin RECORD_LAYOUT Val_Ws16 FNC_VALUES 1 SWORD COLUMN_DIR DIRECT /end RECORD_LAYOUT
/begin RECORD_LAYOUT Val_Ws32 FNC_VALUES 1 SLONG COLUMN_DIR DIRECT /end RECORD_LAYOUT
/begin RECORD_LAYOUT Val_Wu8 FNC_VALUES 1 UBYTE COLUMN_DIR DIRECT /end RECORD_LAYOUT
/end MODULE
/end PROJECT
