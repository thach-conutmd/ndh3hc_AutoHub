ASAP2_VERSION 1 60
/begin PROJECT MG1CS022 "MG1CS022"
/begin HEADER "" VERSION "MG1CS022_62XSC_V037" PROJECT_NO MG1CS022 /end HEADER
/begin MODULE DIM ""
/begin MOD_COMMON "" BYTE_ORDER MSB_LAST ALIGNMENT_BYTE 1 ALIGNMENT_WORD 2 ALIGNMENT_LONG 4 ALIGNMENT_INT64 4 ALIGNMENT_FLOAT32_IEEE 4 ALIGNMENT_FLOAT64_IEEE 4 DATA_SIZE 32 /end MOD_COMMON
/begin CHARACTERISTIC Conv_BrkDebP.tiHiLo_C "BrkPed Active debounce time for converter oil temperature calculation / Time for a High to Low transition" VALUE 0x8058AFFC Kw_Ws16 655350.0 TimeDeb -327680.0 327670.0 FORMAT "%8.1" /end CHARACTERISTIC
/begin CHARACTERISTIC Conv_BrkDebP.tiLoHi_C "BrkPed Active debounce time for converter oil temperature calculation / Time for a Low to High transition" VALUE 0x8058AFFE Kw_Ws16 655350.0 TimeDeb -327680.0 327670.0 FORMAT "%8.1" /end CHARACTERISTIC
/begin CHARACTERISTIC Conv_facClthClsd_GCUR "Oil temperature dependant factor closed for clutch." CURVE 0x80533818 RB_CurveGroup_S16 0.006553500 TrqToNSqr -0.003276800 0.003276700 FORMAT "%11.9"
 /begin AXIS_DESCR COM_AXIS Conv_tOilBuf Temp_Cels 14 -3549.940 3003.560 FORMAT "%8.3" AXIS_PTS_REF Conv_tPntDST_AXIS /end AXIS_DESCR
/end CHARACTERISTIC
/begin CHARACTERISTIC Conv_facClthOpnd_GCUR "Oil temperature dependant factor opened for clutch." CURVE 0x80533834 RB_CurveGroup_S16 0.006553500 TrqToNSqr -0.003276800 0.003276700 FORMAT "%11.9"
 /begin AXIS_DESCR COM_AXIS Conv_tOilBuf Temp_Cels 14 -3549.940 3003.560 FORMAT "%8.3" AXIS_PTS_REF Conv_tPntDST_AXIS /end AXIS_DESCR
/end CHARACTERISTIC
/begin CHARACTERISTIC Conv_facDfl_C "Factor for oil pump." VALUE 0x80533850 RB_Val_Ws16 0.006553500 TrqToNSqr -0.003276800 0.003276700 FORMAT "%11.9" /end CHARACTERISTIC
/begin CHARACTERISTIC Conv_rTrq_C "Parameter for converter transmission ratio." VALUE 0x80533AFA RB_Val_Ws16 655.3500 TransR -327.6800 327.6700 FORMAT "%8.4" /end CHARACTERISTIC
/begin CHARACTERISTIC Conv_stCylVrnt_C "Calibration to indicate the number of cyllinders configured in the project" VALUE 0x80533852 Val_Wu8 255.0 OneToOne 0.00 255.0 FORMAT "%5.1" /end CHARACTERISTIC
/begin CHARACTERISTIC Conv_tiDfl_C "Initial time value." VALUE 0x80533854 RB_Val_Ws16 655350.0 TimeDeb -327680.0 327670.0 FORMAT "%8.1" /end CHARACTERISTIC
/begin CHARACTERISTIC Conv_tiLvrChgDrvRvs_GCUR "Temperature dependant debounce time of gear lever shift from drive to reverse" CURVE 0x80533856 RB_CurveGroup_S16 655350.0 TimeDeb -327680.0 327670.0 FORMAT "%8.1"
 /begin AXIS_DESCR COM_AXIS Conv_tOilBuf Temp_Cels 14 -3549.940 3003.560 FORMAT "%8.3" AXIS_PTS_REF Conv_tPntDST_AXIS /end AXIS_DESCR
/end CHARACTERISTIC
/begin CHARACTERISTIC Conv_tiLvrChgRvsDrv_GCUR "Temperature dependant debounce time of gear lever shift from reverse to drive" CURVE 0x80533872 RB_CurveGroup_S16 655350.0 TimeDeb -327680.0 327670.0 FORMAT "%8.1"
 /begin AXIS_DESCR COM_AXIS Conv_tOilBuf Temp_Cels 14 -3549.940 3003.560 FORMAT "%8.3" AXIS_PTS_REF Conv_tPntDST_AXIS /end AXIS_DESCR
/end CHARACTERISTIC
/begin CHARACTERISTIC Conv_tiRevLvrOffNeut_GT "Debounce time vs temperature curve when transition from reverse gear to Neutral." CURVE 0x8053388E RB_CurveGroup_S16 655350.0 TimeDeb -327680.0 327670.0 FORMAT "%8.1"
 /begin AXIS_DESCR COM_AXIS Conv_tOilBuf Temp_Cels 14 -3549.940 3003.560 FORMAT "%8.3" AXIS_PTS_REF Conv_tPntDST_AXIS /end AXIS_DESCR
/end CHARACTERISTIC
/begin CHARACTERISTIC Conv_tiRevLvrOffPark_GT "Debounce time vs temperature curve when transition from reverse gear to Park." CURVE 0x805338AA RB_CurveGroup_S16 655350.0 TimeDeb -327680.0 327670.0 FORMAT "%8.1"
 /begin AXIS_DESCR COM_AXIS Conv_tOilBuf Temp_Cels 14 -3549.940 3003.560 FORMAT "%8.3" AXIS_PTS_REF Conv_tPntDST_AXIS /end AXIS_DESCR
/end CHARACTERISTIC
/begin CHARACTERISTIC Conv_tiRevLvrOn_GCUR "Debounce time temperature for reverse gear." CURVE 0x805338C6 RB_CurveGroup_S16 655350.0 TimeDeb -327680.0 327670.0 FORMAT "%8.1"
 /begin AXIS_DESCR COM_AXIS Conv_tOilBuf Temp_Cels 14 -3549.940 3003.560 FORMAT "%8.3" AXIS_PTS_REF Conv_tPntDST_AXIS /end AXIS_DESCR
/end CHARACTERISTIC
/begin CHARACTERISTIC Conv_tiTempDepLvrOff_GCUR "Debounce time temperature for no gear engaged." CURVE 0x805338E2 RB_CurveGroup_S16 655350.0 TimeDeb -327680.0 327670.0 FORMAT "%8.1"
 /begin AXIS_DESCR COM_AXIS Conv_tOilBuf Temp_Cels 14 -3549.940 3003.560 FORMAT "%8.3" AXIS_PTS_REF Conv_tPntDST_AXIS /end AXIS_DESCR
/end CHARACTERISTIC
/begin CHARACTERISTIC Conv_tiTempDepLvrOn2_GT "Debounce temperature gear engaged based on new gear engagement strategy" CURVE 0x805338FE RB_CurveGroup_S16 655350.0 TimeDeb -327680.0 327670.0 FORMAT "%8.1"
 /begin AXIS_DESCR COM_AXIS Conv_tOilBuf Temp_Cels 14 -3549.940 3003.560 FORMAT "%8.3" AXIS_PTS_REF Conv_tPntDST_AXIS /end AXIS_DESCR
/end CHARACTERISTIC
/begin CHARACTERISTIC Conv_tiTempDepLvrOn_GT "Debounce temperature gear engaged." CURVE 0x8053391A RB_CurveGroup_S16 655350.0 TimeDeb -327680.0 327670.0 FORMAT "%8.1"
 /begin AXIS_DESCR COM_AXIS Conv_tOilBuf Temp_Cels 14 -3549.940 3003.560 FORMAT "%8.3" AXIS_PTS_REF Conv_tPntDST_AXIS /end AXIS_DESCR
/end CHARACTERISTIC
/begin AXIS_PTS Conv_tPntDST_AXIS "Temperature distribution converter" 0x80533936 Conv_tOilBuf RB_Axis_S16 6553.500 Temp_Cels 14 -3549.940 3003.560 FORMAT "%8.3" DEPOSIT ABSOLUTE /end AXIS_PTS
/begin CHARACTERISTIC Conv_tqResvTDpdtDRACOn_GCUR "Group cur of temperature dependant reserve torque during AC on for gear lever shift from drive to reverse and vice versa" CURVE 0x80533954 RB_CurveGroup_S16 6553.500 Trq -3276.800 3276.700 FORMAT "%8.3"
 /begin AXIS_DESCR COM_AXIS Conv_tOilBuf Temp_Cels 14 -3549.940 3003.560 FORMAT "%8.3" AXIS_PTS_REF Conv_tPntDST_AXIS /end AXIS_DESCR
/end CHARACTERISTIC
/begin CHARACTERISTIC Conv_tqResvTDpdtDR_GCUR "Group cur of temperature dependant reserve torque for gear lever shift from drive to reverse and vice versa" CURVE 0x80533970 RB_CurveGroup_S16 6553.500 Trq -3276.800 3276.700 FORMAT "%8.3"
 /begin AXIS_DESCR COM_AXIS Conv_tOilBuf Temp_Cels 14 -3549.940 3003.560 FORMAT "%8.3" AXIS_PTS_REF Conv_tPntDST_AXIS /end AXIS_DESCR
/end CHARACTERISTIC
/begin CHARACTERISTIC Conv_trqDfl_C "Load torque parameter" VALUE 0x8053398C RB_Val_Ws16 6553.500 Trq -3276.800 3276.700 FORMAT "%8.3" /end CHARACTERISTIC
/begin CHARACTERISTIC Conv_trqLdActv_CW "Code word for activation of the converter." VALUE 0x8053398E RB_Val_Wu8 255.0 OneToOne 0.00 255.0 FORMAT "%5.1" /end CHARACTERISTIC
/begin CHARACTERISTIC Conv_trqLdLvrPosNeutr_GCUR "Load torque for low-idle." CURVE 0x80533990 RB_CurveGroup_S16 6553.500 Trq -3276.800 3276.700 FORMAT "%8.3"
 /begin AXIS_DESCR COM_AXIS Conv_tOilBuf Temp_Cels 14 -3549.940 3003.560 FORMAT "%8.3" AXIS_PTS_REF Conv_tPntDST_AXIS /end AXIS_DESCR
/end CHARACTERISTIC
/begin CHARACTERISTIC Conv_trqLdRevLvrPos_GCUR "Load torque for reverse gear." CURVE 0x805339AC RB_CurveGroup_S16 6553.500 Trq -3276.800 3276.700 FORMAT "%8.3"
 /begin AXIS_DESCR COM_AXIS Conv_tOilBuf Temp_Cels 14 -3549.940 3003.560 FORMAT "%8.3" AXIS_PTS_REF Conv_tPntDST_AXIS /end AXIS_DESCR
/end CHARACTERISTIC
/begin CHARACTERISTIC Conv_trqLdTempDepLim_GCUR "Temperature dependant value for the limitation of the load torque." CURVE 0x805339C8 RB_CurveGroup_S16 6553.500 Trq -3276.800 3276.700 FORMAT "%8.3"
 /begin AXIS_DESCR COM_AXIS Conv_tOilBuf Temp_Cels 14 -3549.940 3003.560 FORMAT "%8.3" AXIS_PTS_REF Conv_tPntDST_AXIS /end AXIS_DESCR
/end CHARACTERISTIC
/begin CHARACTERISTIC Conv_trqLd_CW "Code word for load torque calculation" VALUE 0x805339E4 RB_Val_Wu8 255.0 OneToOne 0.00 255.0 FORMAT "%5.1" /end CHARACTERISTIC
/begin CHARACTERISTIC Conv_trqLosDfftl_map "map for Differential torque losses" MAP 0x805339E6 RB_Map_S16S16_S16 6553.500 TrqPrpHigh -3276.800 3276.700 FORMAT "%8.3"
 /begin AXIS_DESCR STD_AXIS GlbDa_vXFlt Vel 8 -327.6800 327.6700 FORMAT "%8.4" DEPOSIT ABSOLUTE /end AXIS_DESCR
 /begin AXIS_DESCR STD_AXIS Conv_tOil Temp_Cels 8 -3549.940 3003.560 FORMAT "%8.3" DEPOSIT ABSOLUTE /end AXIS_DESCR
/end CHARACTERISTIC
/begin CHARACTERISTIC Conv_trqResvTempDep2_GT "Temperature dependant reserve torque based on new gear engagement strategy" CURVE 0x80533A8A RB_CurveGroup_S16 6553.500 Trq -3276.800 3276.700 FORMAT "%8.3"
 /begin AXIS_DESCR COM_AXIS Conv_tOilBuf Temp_Cels 14 -3549.940 3003.560 FORMAT "%8.3" AXIS_PTS_REF Conv_tPntDST_AXIS /end AXIS_DESCR
/end CHARACTERISTIC
/begin CHARACTERISTIC Conv_trqResvTempDepACOn2_GT "Temperature dependant reserve torque during AC on based on new gear engagement strategy" CURVE 0x80533AA6 RB_CurveGroup_S16 6553.500 Trq -3276.800 3276.700 FORMAT "%8.3"
 /begin AXIS_DESCR COM_AXIS Conv_tOilBuf Temp_Cels 14 -3549.940 3003.560 FORMAT "%8.3" AXIS_PTS_REF Conv_tPntDST_AXIS /end AXIS_DESCR
/end CHARACTERISTIC
/begin CHARACTERISTIC Conv_trqResvTempDepACOn_GT "Temperature dependant reserve torque during AC on" CURVE 0x80533AC2 RB_CurveGroup_S16 6553.500 Trq -3276.800 3276.700 FORMAT "%8.3"
 /begin AXIS_DESCR COM_AXIS Conv_tOilBuf Temp_Cels 14 -3549.940 3003.560 FORMAT "%8.3" AXIS_PTS_REF Conv_tPntDST_AXIS /end AXIS_DESCR
/end CHARACTERISTIC
/begin CHARACTERISTIC Conv_trqResvTempDep_GT "Temperature dependant reserve torque." CURVE 0x80533ADE RB_CurveGroup_S16 6553.500 Trq -3276.800 3276.700 FORMAT "%8.3"
 /begin AXIS_DESCR COM_AXIS Conv_tOilBuf Temp_Cels 14 -3549.940 3003.560 FORMAT "%8.3" AXIS_PTS_REF Conv_tPntDST_AXIS /end AXIS_DESCR
/end CHARACTERISTIC
/begin CHARACTERISTIC CoPOM_cntAbortStrtrLim_C "Fault start count threshold for the conventional starter, above which a different start behaviour is set based on how the driverdoes the cranking." VALUE 0x805288A0 RB_Val_Wu8 255.0 OneToOne 0.00 255.0 FORMAT "%5.1" /end CHARACTERISTIC
/begin CHARACTERISTIC CoPOM_flgPsdBrkPedlRqrdForT50Strt_C "Pressed brake pedal is required for starting the engine with T50" VALUE 0x80528898 RB_Val_Wu8 1.00000000000 B_TRUE 0.00 1.00000000000 FORMAT "%13.11" /end CHARACTERISTIC
/begin CHARACTERISTIC CoPOM_flgStrtRelsDurgT50_C "Flag to enforce drivetrain is open when T50 is requested from driver for a successful start request." VALUE 0x80528899 RB_Val_Wu8 1.00000000000 B_TRUE 0.00 1.00000000000 FORMAT "%13.11" /end CHARACTERISTIC
/begin CHARACTERISTIC CoPOM_tiDlyNxtStrtAftAbort_C "Minimum delay which needs to be elapsed before starter will be available again after an abort." VALUE 0x805288A2 RB_Val_Ws16 655.3500 t_q0p01 -327.6800 327.6700 FORMAT "%8.4" /end CHARACTERISTIC
/begin CHARACTERISTIC CoPOM_tiPanicStrtReq_C "Time threshold to indicate the that the driver is requesting a Panic start" VALUE 0x8052889A RB_Val_Ws16 655.3500 Time_s -327.6800 327.6700 FORMAT "%8.4" /end CHARACTERISTIC
/begin CHARACTERISTIC CoPOM_tiStrtrOperMaxFault_C "Maximum duration (based on Engine temperature) for which the starter can be operated, above which the start will be aborted when the number of aborted engine starts have reached a threshold," VALUE 0x805288A4 RB_Val_Ws16 655.3500 t_q0p01 -327.6800 327.6700 FORMAT "%8.4" /end CHARACTERISTIC
/begin CHARACTERISTIC CoPOM_tiStrtrOperMax_T "Maximum duration (based on Engine temperature) for which the starter can be operated, above which the start will be aborted" CURVE 0x805288A6 RB_Curve_S16_S16 655.3500 t_q0p01 -327.6800 327.6700 FORMAT "%8.4"
 /begin AXIS_DESCR STD_AXIS CEngDsT_t Temp_Cels 6 -3549.940 3003.560 FORMAT "%8.3" DEPOSIT ABSOLUTE /end AXIS_DESCR
/end CHARACTERISTIC
/begin CHARACTERISTIC CoPOM_tiT50ReqCnclDly_C "Delay time for enabling the cancellation of the memorized T50 request, based on the PT closed status." VALUE 0x8052889C RB_Val_Ws16 655.3500 Time_s -327.6800 327.6700 FORMAT "%8.4" /end CHARACTERISTIC
/begin CHARACTERISTIC CoPOM_tiT50ReqPreDrvCnclDly_C "Waiting time before a T50 request is canceled when Pre-Drive to Drive transition is delayed" VALUE 0x8052889E RB_Val_Ws16 655.3500 Time_s -327.6800 327.6700 FORMAT "%8.4" /end CHARACTERISTIC
/begin CHARACTERISTIC CoPOM_tqStrtDevStrtr_C "Available starting torque starter" VALUE 0x805288C0 RB_Val_Ws16 6553.500 Trq -3276.800 3276.700 FORMAT "%8.3" /end CHARACTERISTIC
/begin CHARACTERISTIC CoTemp_rClgDes_CUR "Curve for cooling requirement of the combustion, input engine temperature" CURVE 0x80528900 RB_Curve_S16_S16 799.9878 Prc -400.0000 399.9878 FORMAT "%8.4"
 /begin AXIS_DESCR STD_AXIS EngDa_tEng Temp_Cels 5 -3549.940 3003.560 FORMAT "%8.3" DEPOSIT ABSOLUTE /end AXIS_DESCR
/end CHARACTERISTIC
/begin CHARACTERISTIC CoTemp_tEngClntAftRunDes_C "Coolant temperature of combustion engine during afterrun" VALUE 0x80528916 RB_Val_Ws16 6553.500 Temp_Cels -3549.940 3003.560 FORMAT "%8.3" /end CHARACTERISTIC
/begin CHARACTERISTIC CoTemp_tEngClntIniDes_C "Initialisation value of Coolant temperature of combustion engine" VALUE 0x80528918 RB_Val_Ws16 6553.500 Temp_Cels -3549.940 3003.560 FORMAT "%8.3" /end CHARACTERISTIC
/begin CHARACTERISTIC CoTemp_tEngDesBaseNTrq_MAP "MAP for coolant temperature of combustion engine, based on engine speed and set torque" MAP 0x8052891A RB_Map_S16S16_S16 6553.500 Temp_Cels -3549.940 3003.560 FORMAT "%8.3"
 /begin AXIS_DESCR STD_AXIS Epm_nEng EngN 10 -16384.00 16383.50 FORMAT "%8.2" DEPOSIT ABSOLUTE /end AXIS_DESCR
 /begin AXIS_DESCR STD_AXIS PthSet_trqInrSet Trq 10 -3276.800 3276.700 FORMAT "%8.3" DEPOSIT ABSOLUTE /end AXIS_DESCR
/end CHARACTERISTIC
/begin CHARACTERISTIC CoTemp_tEngDesBaseTempVel_MAP "MAP for coolant temperature of combustion engine, based on engine temperature and vehicle speed" MAP 0x80528A0E RB_Map_S16S16_S16 6553.500 Temp_Cels -3549.940 3003.560 FORMAT "%8.3"
 /begin AXIS_DESCR STD_AXIS EnvT_t Temp_Cels 6 -3549.940 3003.560 FORMAT "%8.3" DEPOSIT ABSOLUTE /end AXIS_DESCR
 /begin AXIS_DESCR STD_AXIS VehV_v Vel 8 -327.6800 327.6700 FORMAT "%8.4" DEPOSIT ABSOLUTE /end AXIS_DESCR
/end CHARACTERISTIC
/begin CHARACTERISTIC CoTS_rhoEnvAirThresDelta_C "Air density delta treshold: Debouncing of Stop-Enable" VALUE 0x805288C2 RB_Val_Ws16 65.53500 Dens_q0p001_COMPU -32.76800 32.76700 FORMAT "%8.5" /end CHARACTERISTIC
/begin CHARACTERISTIC CoTS_rhoEnvAirThresLo_C "Air Density: Lower treshold for Stop Enable" VALUE 0x805288C4 RB_Val_Ws16 65.53500 Dens_q0p001_COMPU -32.76800 32.76700 FORMAT "%8.5" /end CHARACTERISTIC
/begin CHARACTERISTIC CoTS_rhoStopEna_MAP "Map: Calculation of air density to calculate Stop Enable" MAP 0x805288C6 RB_Map_S16S16_S16 65.53500 Dens_q0p001_COMPU -32.76800 32.76700 FORMAT "%8.5"
 /begin AXIS_DESCR STD_AXIS EnvP_p Pres_hPa 2 -32768.00 32767.00 FORMAT "%8.2" DEPOSIT ABSOLUTE /end AXIS_DESCR
 /begin AXIS_DESCR STD_AXIS EnvT_t Temp_Cels 4 -3549.940 3003.560 FORMAT "%8.3" DEPOSIT ABSOLUTE /end AXIS_DESCR
/end CHARACTERISTIC
/begin CHARACTERISTIC CoTS_tClntEngOutDes_C "Substituete value of tClntEngOutDes in case of error." VALUE 0x805288F4 RB_Val_Ws16 6553.500 Temp_Cels -3549.940 3003.560 FORMAT "%8.3" /end CHARACTERISTIC
/begin CHARACTERISTIC CoTS_tClntStopThresDelta_C "Engine temperature delta treshold: Debouncing of Stopp Enable" VALUE 0x805288E6 RB_Val_Ws16 3276.700 Temp_Cels -273.140 3003.560 FORMAT "%8.3" EXTENDED_LIMITS -3549.940 3003.560 /end CHARACTERISTIC
/begin CHARACTERISTIC CoTS_tClntStopThresHi_C "Engine temperature treshold: Upper treshold of Stop Enable" VALUE 0x805288E8 RB_Val_Ws16 3276.700 Temp_Cels -273.140 3003.560 FORMAT "%8.3" EXTENDED_LIMITS -3549.940 3003.560 /end CHARACTERISTIC
/begin CHARACTERISTIC CoTS_tClntStopThresLo_C "Engine temperature treshold: Lower treshold of Stop Enable" VALUE 0x805288EA RB_Val_Ws16 3276.700 Temp_Cels -273.140 3003.560 FORMAT "%8.3" EXTENDED_LIMITS -3549.940 3003.560 /end CHARACTERISTIC
/begin CHARACTERISTIC CoTS_tClntStrtThresDelta_C "Engine temperature delta treshold: Debouncing of Start Request" VALUE 0x805288EC RB_Val_Ws16 3276.700 Temp_Cels -273.140 3003.560 FORMAT "%8.3" EXTENDED_LIMITS -3549.940 3003.560 /end CHARACTERISTIC
/begin CHARACTERISTIC CoTS_tClntStrtThresHi_C "Engine temperature treshold: Upper treshold of Start Request" VALUE 0x805288EE RB_Val_Ws16 3276.700 Temp_Cels -273.140 3003.560 FORMAT "%8.3" EXTENDED_LIMITS -3549.940 3003.560 /end CHARACTERISTIC
/begin CHARACTERISTIC CoTS_tClntStrtThresLo_C "Engine temperature treshold: Lower treshold of Start Request" VALUE 0x805288F0 RB_Val_Ws16 3276.700 Temp_Cels -273.140 3003.560 FORMAT "%8.3" EXTENDED_LIMITS -3549.940 3003.560 /end CHARACTERISTIC
/begin CHARACTERISTIC CoTS_tiPT1Neg_C "Time constant for negative gradients of CoVeh_tClntDes." VALUE 0x805288F8 RB_Val_Ws32 4294.9672940000000 TimeDelay_s 0.0000020000000 4294.9672959999998 FORMAT "%19.14" EXTENDED_LIMITS 0.000002000000001 4294.9672959999998 /end CHARACTERISTIC
/begin CHARACTERISTIC CoTS_tiPT1Pos_C "Time constant for positive gradients of CoVeh_tClntDes." VALUE 0x805288FC RB_Val_Ws32 4294.9672940000000 TimeDelay_s 0.0000020000000 4294.9672959999998 FORMAT "%19.14" EXTENDED_LIMITS 0.000002000000001 4294.9672959999998 /end CHARACTERISTIC
/begin CHARACTERISTIC CoVMD_cntrIDASFailDetn_C "Threshold counter for IDAS failure detection" VALUE 0x80528A90 RB_Val_Wu16 65535.00 OneToOne 0.00 65535.00 FORMAT "%8.2" /end CHARACTERISTIC
/begin CHARACTERISTIC CoVMD_drIDASReqNeg_C "Negative delta ratio for IDAS Cruise Control and Speed limiter request" VALUE 0x80528A92 RB_Val_Ws16 799.9878 Prc -400.0000 399.9878 FORMAT "%8.4" /end CHARACTERISTIC
/begin CHARACTERISTIC CoVMD_drIDASReqPos_C "Possible delta ratio for IDAS Cruise Control and Speed limiter request" VALUE 0x80528A94 RB_Val_Ws16 799.9878 Prc -400.0000 399.9878 FORMAT "%8.4" /end CHARACTERISTIC
/begin CHARACTERISTIC CoVMD_facIDASFailDetn_C "Factor is used to determine the torque threshold for IDAS failure detection" VALUE 0x80528A96 RB_Val_Ws16 7.999878 Fact -4.000000 3.999878 FORMAT "%8.6" /end CHARACTERISTIC
/begin CHARACTERISTIC CoVMD_flgIDASMTCluOffEna_C "IDAS MT clutch Off calculation enable calibration" VALUE 0x80528A98 RB_Val_Wboolean 1.00000000000 B_TRUE 0.00 1.00000000000 FORMAT "%13.11" /end CHARACTERISTIC
/begin CHARACTERISTIC CoVMD_flgSwtRatSelnTqPull_C "Switch to select the ratio for desired torque after Pull behaviour" VALUE 0x80528A99 RB_Val_Wboolean 1.00000000000 B_TRUE 0.00 1.00000000000 FORMAT "%13.11" /end CHARACTERISTIC
/begin AXIS_PTS CoVMD_nAPPReqChg_AXIS "Axis for Gear Change APP request group curve." 0x80528A9A CoVMD_nDesVal RB_Axis_S16 65535.00 EngNCrCtl 6 -32768.00 32767.00 FORMAT "%8.2" DEPOSIT ABSOLUTE /end AXIS_PTS
/begin CHARACTERISTIC CoVMD_ratACCCVTMinWoRamp_C "Minimum ratio difference for activating ramping for CVT variant" VALUE 0x80528AA8 RB_Val_Ws16 799.9878 Prc -400.0000 399.9878 FORMAT "%8.4" /end CHARACTERISTIC
/begin CHARACTERISTIC CoVMD_ratACCMinWoRamp_C "Minimum ratio difference for activating ramping" VALUE 0x80528AAA RB_Val_Ws16 799.9878 Prc -400.0000 399.9878 FORMAT "%8.4" /end CHARACTERISTIC
/begin CHARACTERISTIC CoVMD_ratIDASReqLoLim_C "Low ratio limit for IDAS Cruise control and Speed limiter Request" VALUE 0x80528AAC RB_Val_Ws16 799.9878 Prc -400.0000 399.9878 FORMAT "%8.4" /end CHARACTERISTIC
/begin CHARACTERISTIC CoVMD_ratLLimCVTMinWoRamp_C "Minimum ratio difference for activating ramping for CVT variant" VALUE 0x80528AAE RB_Val_Ws16 799.9878 Prc -400.0000 399.9878 FORMAT "%8.4" /end CHARACTERISTIC
/begin CHARACTERISTIC CoVMD_ratLLimMinWoRamp_C "Minimum ratio difference for activating ramping" VALUE 0x80528AB0 RB_Val_Ws16 799.9878 Prc -400.0000 399.9878 FORMAT "%8.4" /end CHARACTERISTIC
/begin CHARACTERISTIC CoVMD_ratVirtMaxThd_C "Maximum accelerator ratio threshold for calculated IDAS ratio" VALUE 0x80528AB2 RB_Val_Ws16 799.9878 Prc -400.0000 399.9878 FORMAT "%8.4" /end CHARACTERISTIC
/begin CHARACTERISTIC CoVMD_rReqChng_GT "Curve for Gear Change APP request value" CURVE 0x80528AB4 RB_CurveGroup_S16 163.8350 APPCrCtl1 0.00 163.8350 FORMAT "%8.4" EXTENDED_LIMITS -163.8400 163.8350
 /begin AXIS_DESCR COM_AXIS CoVMD_nDesVal EngNCrCtl 6 -32768.00 32767.00 FORMAT "%8.2" AXIS_PTS_REF CoVMD_nAPPReqChg_AXIS /end AXIS_DESCR
/end CHARACTERISTIC
/begin CHARACTERISTIC CoVMD_rSptReqChng_GT "Curve for Gear Change APP request value for sport mode" CURVE 0x80528AC0 RB_CurveGroup_S16 163.8350 APPCrCtl1 0.00 163.8350 FORMAT "%8.4" EXTENDED_LIMITS -163.8400 163.8350
 /begin AXIS_DESCR COM_AXIS CoVMD_nDesVal EngNCrCtl 6 -32768.00 32767.00 FORMAT "%8.2" AXIS_PTS_REF CoVMD_nAPPReqChg_AXIS /end AXIS_DESCR
/end CHARACTERISTIC
/begin CHARACTERISTIC CoVMD_stSwtAPMapSeln_C "AP selection Switch between CVT with and without ratio" VALUE 0x80528ACC RB_Val_Wu8 255.0 OneToOne 0.00 255.0 FORMAT "%5.1" /end CHARACTERISTIC
/begin CHARACTERISTIC CoVMD_swtCCASLTrqSeln_C "Switch to select if driving assistance functions are calculated in Engine ECU" VALUE 0x80528ACD RB_Val_Wu8 255.0 OneToOne 0.00 255.0 FORMAT "%5.1" /end CHARACTERISTIC
/begin CHARACTERISTIC CoVMD_swtCCSelVal_C "Switch for Cruise Control Selection" VALUE 0x80528ACE RB_Val_Wu8 255.0 OneToOne 0.00 255.0 FORMAT "%5.1" /end CHARACTERISTIC
/begin CHARACTERISTIC CoVMD_swtCrCtlDemSel_C "Switch to Select CrCtl demand" VALUE 0x80528ACF RB_Val_Wu8 1.000 OneToOne 0.00 1.000 FORMAT "%5.3" EXTENDED_LIMITS 0.00 255.0 /end CHARACTERISTIC
/begin CHARACTERISTIC CoVMD_swtMoFSel_C "Switch for MoF selection" VALUE 0x80528AD0 RB_Val_Wu8 1.000 OneToOne 0.00 1.000 FORMAT "%5.3" EXTENDED_LIMITS 0.00 255.0 /end CHARACTERISTIC
/begin CHARACTERISTIC CoVMD_tiACCCVTRampSlop_CA "Parameter array time period within which ramping of APP raito should be finished for CVT variant" VAL_BLK 0x80528AD2 RB_ValA_Ws16 655.3500 Time_s -327.6800 327.6700 FORMAT "%8.4" NUMBER 11 /end CHARACTERISTIC
/begin CHARACTERISTIC CoVMD_tiACCRampSlop_CA "Parameter array time period within which ramping of APP raito should be finished" VAL_BLK 0x80528AE8 RB_ValA_Ws16 655.3500 Time_s -327.6800 327.6700 FORMAT "%8.4" NUMBER 11 /end CHARACTERISTIC
/begin CHARACTERISTIC CoVMD_tiBrkFailDeb_C "Threshold to determine brake is operated for IDAS failure detection" VALUE 0x80528AFE RB_Val_Wu16 655350.0 Time_ms 0.00 655350.0 FORMAT "%8.1" /end CHARACTERISTIC
/begin CHARACTERISTIC CoVMD_tiIDASFailBrkDetn_C "Delay time to determine brake is operated" VALUE 0x80528B00 RB_Val_Ws16 655350.0 Time_ms -327680.0 327670.0 FORMAT "%8.1" /end CHARACTERISTIC
/begin CHARACTERISTIC CoVMD_tiIDASReqLim_T "Application CUR to calculate time constant of PT1" CURVE 0x80528B02 RB_Curve_S16_S16 655.3500 Time_s -327.6800 327.6700 FORMAT "%8.4"
 /begin AXIS_DESCR STD_AXIS CoVMD_rVirtApp Prc 6 -400.0000 399.9878 FORMAT "%8.4" DEPOSIT ABSOLUTE /end AXIS_DESCR
/end CHARACTERISTIC
/begin CHARACTERISTIC CoVMD_tiLLimCVTRampSlop_CA "Parameter array time period within which ramping of APP raito should be finished for CVT variant" VAL_BLK 0x80528B1C RB_ValA_Ws16 655.3500 Time_s -327.6800 327.6700 FORMAT "%8.4" NUMBER 11 /end CHARACTERISTIC
/begin CHARACTERISTIC CoVMD_tiLLimRampSlop_CA "Parameter array time period within which ramping of APP raito should be finished" VAL_BLK 0x80528B32 RB_ValA_Ws16 655.3500 Time_s -327.6800 327.6700 FORMAT "%8.4" NUMBER 11 /end CHARACTERISTIC
/begin CHARACTERISTIC CoVMD_tiTqFild_T "The CUR to calculate time constant of PT1" CURVE 0x80528B48 RB_Curve_S16_S16 655.3500 Time_s -327.6800 327.6700 FORMAT "%8.4"
 /begin AXIS_DESCR STD_AXIS CoVMD_rVirtApp Prc 12 -400.0000 399.9878 FORMAT "%8.4" DEPOSIT ABSOLUTE /end AXIS_DESCR
/end CHARACTERISTIC
/begin CHARACTERISTIC CoVMD_tqCrCtlReqDft_C "Default value of cruise control torque request when cruise control is not active" VALUE 0x80528B7C RB_Val_Ws32 429496729.500 TrqPrpHigh -214748364.800 214748364.700 FORMAT "%13.3" /end CHARACTERISTIC
/begin CHARACTERISTIC CoVMD_tqCvtEcoATMod1_M "Conversion MAP 1 for AT condition in Eco Mode" MAP 0x80528B80 RB_Map_S16S16_S16 6553.500 TrqPrpHigh -3276.800 3276.700 FORMAT "%8.3"
 /begin AXIS_DESCR STD_AXIS VehV_v Vel 16 -327.6800 327.6700 FORMAT "%8.4" DEPOSIT ABSOLUTE /end AXIS_DESCR
 /begin AXIS_DESCR STD_AXIS CoVMD_ratVirtMax Prc 16 -400.0000 399.9878 FORMAT "%8.4" DEPOSIT ABSOLUTE /end AXIS_DESCR
/end CHARACTERISTIC
/begin CHARACTERISTIC CoVMD_tqCvtEcoATMod2_M "Conversion MAP 2 for AT condition in Eco Mode" MAP 0x80528DC4 RB_Map_S16S16_S16 6553.500 TrqPrpHigh -3276.800 3276.700 FORMAT "%8.3"
 /begin AXIS_DESCR STD_AXIS VehV_v Vel 16 -327.6800 327.6700 FORMAT "%8.4" DEPOSIT ABSOLUTE /end AXIS_DESCR
 /begin AXIS_DESCR STD_AXIS CoVMD_ratVirtMax Prc 16 -400.0000 399.9878 FORMAT "%8.4" DEPOSIT ABSOLUTE /end AXIS_DESCR
/end CHARACTERISTIC
/begin CHARACTERISTIC CoVMD_tqCvtEcoATMod3_M "Conversion MAP 3 for AT condition in Eco Mode" MAP 0x80529008 RB_Map_S16S16_S16 6553.500 TrqPrpHigh -3276.800 3276.700 FORMAT "%8.3"
 /begin AXIS_DESCR STD_AXIS VehV_v Vel 16 -327.6800 327.6700 FORMAT "%8.4" DEPOSIT ABSOLUTE /end AXIS_DESCR
 /begin AXIS_DESCR STD_AXIS CoVMD_ratVirtMax Prc 16 -400.0000 399.9878 FORMAT "%8.4" DEPOSIT ABSOLUTE /end AXIS_DESCR
/end CHARACTERISTIC
/begin CHARACTERISTIC CoVMD_tqCvtEcoATMod4_M "Conversion MAP 4 for AT condition in Eco Mode" MAP 0x8052924C RB_Map_S16S16_S16 6553.500 TrqPrpHigh -3276.800 3276.700 FORMAT "%8.3"
 /begin AXIS_DESCR STD_AXIS VehV_v Vel 16 -327.6800 327.6700 FORMAT "%8.4" DEPOSIT ABSOLUTE /end AXIS_DESCR
 /begin AXIS_DESCR STD_AXIS CoVMD_ratVirtMax Prc 16 -400.0000 399.9878 FORMAT "%8.4" DEPOSIT ABSOLUTE /end AXIS_DESCR
/end CHARACTERISTIC
/begin CHARACTERISTIC CoVMD_tqCvtEcoATMod5_M "Conversion MAP 5 for AT condition in Eco Mode" MAP 0x80529490 RB_Map_S16S16_S16 6553.500 TrqPrpHigh -3276.800 3276.700 FORMAT "%8.3"
 /begin AXIS_DESCR STD_AXIS VehV_v Vel 16 -327.6800 327.6700 FORMAT "%8.4" DEPOSIT ABSOLUTE /end AXIS_DESCR
 /begin AXIS_DESCR STD_AXIS CoVMD_ratVirtMax Prc 16 -400.0000 399.9878 FORMAT "%8.4" DEPOSIT ABSOLUTE /end AXIS_DESCR
/end CHARACTERISTIC
/begin CHARACTERISTIC CoVMD_tqCvtEcoATMod6_M "Conversion MAP 6 for AT condition in Eco Mode" MAP 0x805296D4 RB_Map_S16S16_S16 6553.500 TrqPrpHigh -3276.800 3276.700 FORMAT "%8.3"
 /begin AXIS_DESCR STD_AXIS VehV_v Vel 16 -327.6800 327.6700 FORMAT "%8.4" DEPOSIT ABSOLUTE /end AXIS_DESCR
 /begin AXIS_DESCR STD_AXIS CoVMD_ratVirtMax Prc 16 -400.0000 399.9878 FORMAT "%8.4" DEPOSIT ABSOLUTE /end AXIS_DESCR
/end CHARACTERISTIC
/begin CHARACTERISTIC CoVMD_tqCvtEcoATMod7_M "Conversion MAP 7 for AT condition in Eco Mode" MAP 0x80529918 RB_Map_S16S16_S16 6553.500 TrqPrpHigh -3276.800 3276.700 FORMAT "%8.3"
 /begin AXIS_DESCR STD_AXIS VehV_v Vel 16 -327.6800 327.6700 FORMAT "%8.4" DEPOSIT ABSOLUTE /end AXIS_DESCR
 /begin AXIS_DESCR STD_AXIS CoVMD_ratVirtMax Prc 16 -400.0000 399.9878 FORMAT "%8.4" DEPOSIT ABSOLUTE /end AXIS_DESCR
/end CHARACTERISTIC
/begin CHARACTERISTIC CoVMD_tqCvtEcoDwnHill1_M "Conversion MAP 1 for down-hill condition in Eco Mode" MAP 0x80529B5C RB_Map_S16S16_S16 6553.500 TrqPrpHigh -3276.800 3276.700 FORMAT "%8.3"
 /begin AXIS_DESCR STD_AXIS VehV_v Vel 16 -327.6800 327.6700 FORMAT "%8.4" DEPOSIT ABSOLUTE /end AXIS_DESCR
 /begin AXIS_DESCR STD_AXIS CoVMD_ratVirtMax Prc 16 -400.0000 399.9878 FORMAT "%8.4" DEPOSIT ABSOLUTE /end AXIS_DESCR
/end CHARACTERISTIC
/begin CHARACTERISTIC CoVMD_tqCvtEcoDwnHill2_M "Conversion MAP 2 for down-hill condition in Eco Mode" MAP 0x80529DA0 RB_Map_S16S16_S16 6553.500 TrqPrpHigh -3276.800 3276.700 FORMAT "%8.3"
 /begin AXIS_DESCR STD_AXIS VehV_v Vel 16 -327.6800 327.6700 FORMAT "%8.4" DEPOSIT ABSOLUTE /end AXIS_DESCR
 /begin AXIS_DESCR STD_AXIS CoVMD_ratVirtMax Prc 16 -400.0000 399.9878 FORMAT "%8.4" DEPOSIT ABSOLUTE /end AXIS_DESCR
/end CHARACTERISTIC
/begin CHARACTERISTIC CoVMD_tqCvtEcoDwnHill3_M "Conversion MAP 3 for down-hill condition in Eco Mode" MAP 0x80529FE4 RB_Map_S16S16_S16 6553.500 TrqPrpHigh -3276.800 3276.700 FORMAT "%8.3"
 /begin AXIS_DESCR STD_AXIS VehV_v Vel 16 -327.6800 327.6700 FORMAT "%8.4" DEPOSIT ABSOLUTE /end AXIS_DESCR
 /begin AXIS_DESCR STD_AXIS CoVMD_ratVirtMax Prc 16 -400.0000 399.9878 FORMAT "%8.4" DEPOSIT ABSOLUTE /end AXIS_DESCR
/end CHARACTERISTIC
/begin CHARACTERISTIC CoVMD_tqCvtEcoDwnHill4_M "Conversion MAP 4 for down-hill condition in Eco Mode" MAP 0x8052A228 RB_Map_S16S16_S16 6553.500 TrqPrpHigh -3276.800 3276.700 FORMAT "%8.3"
 /begin AXIS_DESCR STD_AXIS VehV_v Vel 16 -327.6800 327.6700 FORMAT "%8.4" DEPOSIT ABSOLUTE /end AXIS_DESCR
 /begin AXIS_DESCR STD_AXIS CoVMD_ratVirtMax Prc 16 -400.0000 399.9878 FORMAT "%8.4" DEPOSIT ABSOLUTE /end AXIS_DESCR
/end CHARACTERISTIC
/begin CHARACTERISTIC CoVMD_tqCvtEcoDwnHill5_M "Conversion MAP 5 for down-hill condition in Eco Mode" MAP 0x8052A46C RB_Map_S16S16_S16 6553.500 TrqPrpHigh -3276.800 3276.700 FORMAT "%8.3"
 /begin AXIS_DESCR STD_AXIS VehV_v Vel 16 -327.6800 327.6700 FORMAT "%8.4" DEPOSIT ABSOLUTE /end AXIS_DESCR
 /begin AXIS_DESCR STD_AXIS CoVMD_ratVirtMax Prc 16 -400.0000 399.9878 FORMAT "%8.4" DEPOSIT ABSOLUTE /end AXIS_DESCR
/end CHARACTERISTIC
/begin CHARACTERISTIC CoVMD_tqCvtEcoDwnHill6_M "Conversion MAP 6 for down-hill condition in Eco Mode" MAP 0x8052A6B0 RB_Map_S16S16_S16 6553.500 TrqPrpHigh -3276.800 3276.700 FORMAT "%8.3"
 /begin AXIS_DESCR STD_AXIS VehV_v Vel 16 -327.6800 327.6700 FORMAT "%8.4" DEPOSIT ABSOLUTE /end AXIS_DESCR
 /begin AXIS_DESCR STD_AXIS CoVMD_ratVirtMax Prc 16 -400.0000 399.9878 FORMAT "%8.4" DEPOSIT ABSOLUTE /end AXIS_DESCR
/end CHARACTERISTIC
/begin CHARACTERISTIC CoVMD_tqCvtEcoLModOff_M "Conversion MAP Mode-Off for L condition in Eco Mode" MAP 0x8052A8F4 RB_Map_S16S16_S16 6553.500 TrqPrpHigh -3276.800 3276.700 FORMAT "%8.3"
 /begin AXIS_DESCR STD_AXIS VehV_v Vel 16 -327.6800 327.6700 FORMAT "%8.4" DEPOSIT ABSOLUTE /end AXIS_DESCR
 /begin AXIS_DESCR STD_AXIS CoVMD_ratVirtMax Prc 16 -400.0000 399.9878 FORMAT "%8.4" DEPOSIT ABSOLUTE /end AXIS_DESCR
/end CHARACTERISTIC
/begin CHARACTERISTIC CoVMD_tqCvtEcoLModOn_M "Conversion MAP Mode-On for L condition in Eco Mode" MAP 0x8052AB38 RB_Map_S16S16_S16 6553.500 TrqPrpHigh -3276.800 3276.700 FORMAT "%8.3"
 /begin AXIS_DESCR STD_AXIS VehV_v Vel 16 -327.6800 327.6700 FORMAT "%8.4" DEPOSIT ABSOLUTE /end AXIS_DESCR
 /begin AXIS_DESCR STD_AXIS CoVMD_ratVirtMax Prc 16 -400.0000 399.9878 FORMAT "%8.4" DEPOSIT ABSOLUTE /end AXIS_DESCR
/end CHARACTERISTIC
/begin CHARACTERISTIC CoVMD_tqCvtEcoLnchD_M "Conversion MAP D for Launch condition in Eco Mode" MAP 0x8052AD7C RB_Map_S16S16_S16 6553.500 TrqPrpHigh -3276.800 3276.700 FORMAT "%8.3"
 /begin AXIS_DESCR STD_AXIS VehV_v Vel 16 -327.6800 327.6700 FORMAT "%8.4" DEPOSIT ABSOLUTE /end AXIS_DESCR
 /begin AXIS_DESCR STD_AXIS CoVMD_ratVirtMax Prc 16 -400.0000 399.9878 FORMAT "%8.4" DEPOSIT ABSOLUTE /end AXIS_DESCR
/end CHARACTERISTIC
/begin CHARACTERISTIC CoVMD_tqCvtEcoLnchE_M "Conversion MAP E for Launch condition in Eco Mode" MAP 0x8052AFC0 RB_Map_S16S16_S16 6553.500 TrqPrpHigh -3276.800 3276.700 FORMAT "%8.3"
 /begin AXIS_DESCR STD_AXIS VehV_v Vel 16 -327.6800 327.6700 FORMAT "%8.4" DEPOSIT ABSOLUTE /end AXIS_DESCR
 /begin AXIS_DESCR STD_AXIS CoVMD_ratVirtMax Prc 16 -400.0000 399.9878 FORMAT "%8.4" DEPOSIT ABSOLUTE /end AXIS_DESCR
/end CHARACTERISTIC
/begin CHARACTERISTIC CoVMD_tqCvtEcoLnchL_M "Conversion MAP L for Launch condition in Eco Mode" MAP 0x8052B204 RB_Map_S16S16_S16 6553.500 TrqPrpHigh -3276.800 3276.700 FORMAT "%8.3"
 /begin AXIS_DESCR STD_AXIS VehV_v Vel 16 -327.6800 327.6700 FORMAT "%8.4" DEPOSIT ABSOLUTE /end AXIS_DESCR
 /begin AXIS_DESCR STD_AXIS CoVMD_ratVirtMax Prc 16 -400.0000 399.9878 FORMAT "%8.4" DEPOSIT ABSOLUTE /end AXIS_DESCR
/end CHARACTERISTIC
/begin CHARACTERISTIC CoVMD_tqCvtEcoLnchS_M "Conversion MAP S for Launch condition in Eco Mode" MAP 0x8052B448 RB_Map_S16S16_S16 6553.500 TrqPrpHigh -3276.800 3276.700 FORMAT "%8.3"
 /begin AXIS_DESCR STD_AXIS VehV_v Vel 16 -327.6800 327.6700 FORMAT "%8.4" DEPOSIT ABSOLUTE /end AXIS_DESCR
 /begin AXIS_DESCR STD_AXIS CoVMD_ratVirtMax Prc 16 -400.0000 399.9878 FORMAT "%8.4" DEPOSIT ABSOLUTE /end AXIS_DESCR
/end CHARACTERISTIC
/begin CHARACTERISTIC CoVMD_tqCvtEcoNormD12_M "Conversion MAP D12 for normal condition in Eco Mode" MAP 0x8052B68C RB_Map_S16S16_S16 6553.500 TrqPrpHigh -3276.800 3276.700 FORMAT "%8.3"
 /begin AXIS_DESCR STD_AXIS VehV_v Vel 16 -327.6800 327.6700 FORMAT "%8.4" DEPOSIT ABSOLUTE /end AXIS_DESCR
 /begin AXIS_DESCR STD_AXIS CoVMD_ratVirtMax Prc 16 -400.0000 399.9878 FORMAT "%8.4" DEPOSIT ABSOLUTE /end AXIS_DESCR
/end CHARACTERISTIC
/begin CHARACTERISTIC CoVMD_tqCvtEcoNormD2_M "Conversion MAP D2 for normal condition in Eco Mode" MAP 0x8052B8D0 RB_Map_S16S16_S16 6553.500 TrqPrpHigh -3276.800 3276.700 FORMAT "%8.3"
 /begin AXIS_DESCR STD_AXIS VehV_v Vel 16 -327.6800 327.6700 FORMAT "%8.4" DEPOSIT ABSOLUTE /end AXIS_DESCR
 /begin AXIS_DESCR STD_AXIS CoVMD_ratVirtMax Prc 16 -400.0000 399.9878 FORMAT "%8.4" DEPOSIT ABSOLUTE /end AXIS_DESCR
/end CHARACTERISTIC
/begin CHARACTERISTIC CoVMD_tqCvtEcoNormD_M "Conversion MAP D for normal condition in Eco Mode" MAP 0x8052BB14 RB_Map_S16S16_S16 6553.500 TrqPrpHigh -3276.800 3276.700 FORMAT "%8.3"
 /begin AXIS_DESCR STD_AXIS VehV_v Vel 16 -327.6800 327.6700 FORMAT "%8.4" DEPOSIT ABSOLUTE /end AXIS_DESCR
 /begin AXIS_DESCR STD_AXIS CoVMD_ratVirtMax Prc 16 -400.0000 399.9878 FORMAT "%8.4" DEPOSIT ABSOLUTE /end AXIS_DESCR
/end CHARACTERISTIC
/begin CHARACTERISTIC CoVMD_tqCvtEcoNormE12_M "Conversion MAP E12 for normal condition in Eco Mode" MAP 0x8052BD58 RB_Map_S16S16_S16 6553.500 TrqPrpHigh -3276.800 3276.700 FORMAT "%8.3"
 /begin AXIS_DESCR STD_AXIS VehV_v Vel 16 -327.6800 327.6700 FORMAT "%8.4" DEPOSIT ABSOLUTE /end AXIS_DESCR
 /begin AXIS_DESCR STD_AXIS CoVMD_ratVirtMax Prc 16 -400.0000 399.9878 FORMAT "%8.4" DEPOSIT ABSOLUTE /end AXIS_DESCR
/end CHARACTERISTIC
/begin CHARACTERISTIC CoVMD_tqCvtEcoNormE1_M "Conversion MAP E1 for normal condition in Eco Mode" MAP 0x8052BF9C RB_Map_S16S16_S16 6553.500 TrqPrpHigh -3276.800 3276.700 FORMAT "%8.3"
 /begin AXIS_DESCR STD_AXIS VehV_v Vel 16 -327.6800 327.6700 FORMAT "%8.4" DEPOSIT ABSOLUTE /end AXIS_DESCR
 /begin AXIS_DESCR STD_AXIS CoVMD_ratVirtMax Prc 16 -400.0000 399.9878 FORMAT "%8.4" DEPOSIT ABSOLUTE /end AXIS_DESCR
/end CHARACTERISTIC
/begin CHARACTERISTIC CoVMD_tqCvtEcoNormE2_M "Conversion MAP E2 for normal condition in Eco Mode" MAP 0x8052C1E0 RB_Map_S16S16_S16 6553.500 TrqPrpHigh -3276.800 3276.700 FORMAT "%8.3"
 /begin AXIS_DESCR STD_AXIS VehV_v Vel 16 -327.6800 327.6700 FORMAT "%8.4" DEPOSIT ABSOLUTE /end AXIS_DESCR
 /begin AXIS_DESCR STD_AXIS CoVMD_ratVirtMax Prc 16 -400.0000 399.9878 FORMAT "%8.4" DEPOSIT ABSOLUTE /end AXIS_DESCR
/end CHARACTERISTIC
/begin CHARACTERISTIC CoVMD_tqCvtEcoNormE_M "Conversion MAP E for normal condition in Eco Mode" MAP 0x8052C424 RB_Map_S16S16_S16 6553.500 TrqPrpHigh -3276.800 3276.700 FORMAT "%8.3"
 /begin AXIS_DESCR STD_AXIS VehV_v Vel 16 -327.6800 327.6700 FORMAT "%8.4" DEPOSIT ABSOLUTE /end AXIS_DESCR
 /begin AXIS_DESCR STD_AXIS CoVMD_ratVirtMax Prc 16 -400.0000 399.9878 FORMAT "%8.4" DEPOSIT ABSOLUTE /end AXIS_DESCR
/end CHARACTERISTIC
/begin CHARACTERISTIC CoVMD_tqCvtEcoNormS0_M "Conversion MAP S0 for normal condition in Eco Mode" MAP 0x8052C668 RB_Map_S16S16_S16 6553.500 TrqPrpHigh -3276.800 3276.700 FORMAT "%8.3"
 /begin AXIS_DESCR STD_AXIS VehV_v Vel 16 -327.6800 327.6700 FORMAT "%8.4" DEPOSIT ABSOLUTE /end AXIS_DESCR
 /begin AXIS_DESCR STD_AXIS CoVMD_ratVirtMax Prc 16 -400.0000 399.9878 FORMAT "%8.4" DEPOSIT ABSOLUTE /end AXIS_DESCR
/end CHARACTERISTIC
/begin CHARACTERISTIC CoVMD_tqCvtEcoNormS1_M "Conversion MAP S1 for normal condition in Eco Mode" MAP 0x8052C8AC RB_Map_S16S16_S16 6553.500 TrqPrpHigh -3276.800 3276.700 FORMAT "%8.3"
 /begin AXIS_DESCR STD_AXIS VehV_v Vel 16 -327.6800 327.6700 FORMAT "%8.4" DEPOSIT ABSOLUTE /end AXIS_DESCR
 /begin AXIS_DESCR STD_AXIS CoVMD_ratVirtMax Prc 16 -400.0000 399.9878 FORMAT "%8.4" DEPOSIT ABSOLUTE /end AXIS_DESCR
/end CHARACTERISTIC
/begin CHARACTERISTIC CoVMD_tqCvtEcoNormS2_M "Conversion MAP S2 for normal condition in Eco Mode" MAP 0x8052CAF0 RB_Map_S16S16_S16 6553.500 TrqPrpHigh -3276.800 3276.700 FORMAT "%8.3"
 /begin AXIS_DESCR STD_AXIS VehV_v Vel 16 -327.6800 327.6700 FORMAT "%8.4" DEPOSIT ABSOLUTE /end AXIS_DESCR
 /begin AXIS_DESCR STD_AXIS CoVMD_ratVirtMax Prc 16 -400.0000 399.9878 FORMAT "%8.4" DEPOSIT ABSOLUTE /end AXIS_DESCR
/end CHARACTERISTIC
/begin CHARACTERISTIC CoVMD_tqCvtEcoNormSP_M "Conversion MAP SP for normal condition in Eco Mode" MAP 0x8052CD34 RB_Map_S16S16_S16 6553.500 TrqPrpHigh -3276.800 3276.700 FORMAT "%8.3"
 /begin AXIS_DESCR STD_AXIS VehV_v Vel 16 -327.6800 327.6700 FORMAT "%8.4" DEPOSIT ABSOLUTE /end AXIS_DESCR
 /begin AXIS_DESCR STD_AXIS CoVMD_ratVirtMax Prc 16 -400.0000 399.9878 FORMAT "%8.4" DEPOSIT ABSOLUTE /end AXIS_DESCR
/end CHARACTERISTIC
/begin CHARACTERISTIC CoVMD_tqCvtEcoTipMod1_M "Conversion MAP 1 for Tip condition in Eco Mode" MAP 0x8052CF78 RB_Map_S16S16_S16 6553.500 TrqPrpHigh -3276.800 3276.700 FORMAT "%8.3"
 /begin AXIS_DESCR STD_AXIS VehV_v Vel 16 -327.6800 327.6700 FORMAT "%8.4" DEPOSIT ABSOLUTE /end AXIS_DESCR
 /begin AXIS_DESCR STD_AXIS CoVMD_ratVirtMax Prc 16 -400.0000 399.9878 FORMAT "%8.4" DEPOSIT ABSOLUTE /end AXIS_DESCR
/end CHARACTERISTIC
/begin CHARACTERISTIC CoVMD_tqCvtEcoTipMod2_M "Conversion MAP 2 for Tip condition in Eco Mode" MAP 0x8052D1BC RB_Map_S16S16_S16 6553.500 TrqPrpHigh -3276.800 3276.700 FORMAT "%8.3"
 /begin AXIS_DESCR STD_AXIS VehV_v Vel 16 -327.6800 327.6700 FORMAT "%8.4" DEPOSIT ABSOLUTE /end AXIS_DESCR
 /begin AXIS_DESCR STD_AXIS CoVMD_ratVirtMax Prc 16 -400.0000 399.9878 FORMAT "%8.4" DEPOSIT ABSOLUTE /end AXIS_DESCR
/end CHARACTERISTIC
/begin CHARACTERISTIC CoVMD_tqCvtEcoTipMod3_M "Conversion MAP 3 for Tip condition in Eco Mode" MAP 0x8052D400 RB_Map_S16S16_S16 6553.500 TrqPrpHigh -3276.800 3276.700 FORMAT "%8.3"
 /begin AXIS_DESCR STD_AXIS VehV_v Vel 16 -327.6800 327.6700 FORMAT "%8.4" DEPOSIT ABSOLUTE /end AXIS_DESCR
 /begin AXIS_DESCR STD_AXIS CoVMD_ratVirtMax Prc 16 -400.0000 399.9878 FORMAT "%8.4" DEPOSIT ABSOLUTE /end AXIS_DESCR
/end CHARACTERISTIC
/begin CHARACTERISTIC CoVMD_tqCvtEcoTipMod4_M "Conversion MAP 4 for Tip condition in Eco Mode" MAP 0x8052D644 RB_Map_S16S16_S16 6553.500 TrqPrpHigh -3276.800 3276.700 FORMAT "%8.3"
 /begin AXIS_DESCR STD_AXIS VehV_v Vel 16 -327.6800 327.6700 FORMAT "%8.4" DEPOSIT ABSOLUTE /end AXIS_DESCR
 /begin AXIS_DESCR STD_AXIS CoVMD_ratVirtMax Prc 16 -400.0000 399.9878 FORMAT "%8.4" DEPOSIT ABSOLUTE /end AXIS_DESCR
/end CHARACTERISTIC
/begin CHARACTERISTIC CoVMD_tqCvtEcoTipMod5_M "Conversion MAP 5 for Tip condition in Eco Mode" MAP 0x8052D888 RB_Map_S16S16_S16 6553.500 TrqPrpHigh -3276.800 3276.700 FORMAT "%8.3"
 /begin AXIS_DESCR STD_AXIS VehV_v Vel 16 -327.6800 327.6700 FORMAT "%8.4" DEPOSIT ABSOLUTE /end AXIS_DESCR
 /begin AXIS_DESCR STD_AXIS CoVMD_ratVirtMax Prc 16 -400.0000 399.9878 FORMAT "%8.4" DEPOSIT ABSOLUTE /end AXIS_DESCR
/end CHARACTERISTIC
/begin CHARACTERISTIC CoVMD_tqCvtEcoTipMod6_M "Conversion MAP 6 for Tip condition in Eco Mode" MAP 0x8052DACC RB_Map_S16S16_S16 6553.500 TrqPrpHigh -3276.800 3276.700 FORMAT "%8.3"
 /begin AXIS_DESCR STD_AXIS VehV_v Vel 16 -327.6800 327.6700 FORMAT "%8.4" DEPOSIT ABSOLUTE /end AXIS_DESCR
 /begin AXIS_DESCR STD_AXIS CoVMD_ratVirtMax Prc 16 -400.0000 399.9878 FORMAT "%8.4" DEPOSIT ABSOLUTE /end AXIS_DESCR
/end CHARACTERISTIC
/begin CHARACTERISTIC CoVMD_tqCvtEcoTipMod7_M "Conversion MAP 7 for Tip condition in Eco Mode" MAP 0x8052DD10 RB_Map_S16S16_S16 6553.500 TrqPrpHigh -3276.800 3276.700 FORMAT "%8.3"
 /begin AXIS_DESCR STD_AXIS VehV_v Vel 16 -327.6800 327.6700 FORMAT "%8.4" DEPOSIT ABSOLUTE /end AXIS_DESCR
 /begin AXIS_DESCR STD_AXIS CoVMD_ratVirtMax Prc 16 -400.0000 399.9878 FORMAT "%8.4" DEPOSIT ABSOLUTE /end AXIS_DESCR
/end CHARACTERISTIC
/begin CHARACTERISTIC CoVMD_tqCvtNormATMod1_M "Conversion MAP 1 for AT condition in Normal Mode" MAP 0x8052DF54 RB_Map_S16S16_S16 6553.500 TrqPrpHigh -3276.800 3276.700 FORMAT "%8.3"
 /begin AXIS_DESCR STD_AXIS VehV_v Vel 16 -327.6800 327.6700 FORMAT "%8.4" DEPOSIT ABSOLUTE /end AXIS_DESCR
 /begin AXIS_DESCR STD_AXIS CoVMD_ratVirtMax Prc 16 -400.0000 399.9878 FORMAT "%8.4" DEPOSIT ABSOLUTE /end AXIS_DESCR
/end CHARACTERISTIC
/begin CHARACTERISTIC CoVMD_tqCvtNormATMod2_M "Conversion MAP 2 for AT condition in Normal Mode" MAP 0x8052E198 RB_Map_S16S16_S16 6553.500 TrqPrpHigh -3276.800 3276.700 FORMAT "%8.3"
 /begin AXIS_DESCR STD_AXIS VehV_v Vel 16 -327.6800 327.6700 FORMAT "%8.4" DEPOSIT ABSOLUTE /end AXIS_DESCR
 /begin AXIS_DESCR STD_AXIS CoVMD_ratVirtMax Prc 16 -400.0000 399.9878 FORMAT "%8.4" DEPOSIT ABSOLUTE /end AXIS_DESCR
/end CHARACTERISTIC
/begin CHARACTERISTIC CoVMD_tqCvtNormATMod3_M "Conversion MAP 3 for AT condition in Normal Mode" MAP 0x8052E3DC RB_Map_S16S16_S16 6553.500 TrqPrpHigh -3276.800 3276.700 FORMAT "%8.3"
 /begin AXIS_DESCR STD_AXIS VehV_v Vel 16 -327.6800 327.6700 FORMAT "%8.4" DEPOSIT ABSOLUTE /end AXIS_DESCR
 /begin AXIS_DESCR STD_AXIS CoVMD_ratVirtMax Prc 16 -400.0000 399.9878 FORMAT "%8.4" DEPOSIT ABSOLUTE /end AXIS_DESCR
/end CHARACTERISTIC
/begin CHARACTERISTIC CoVMD_tqCvtNormATMod4_M "Conversion MAP 4 for AT condition in Normal Mode" MAP 0x8052E620 RB_Map_S16S16_S16 6553.500 TrqPrpHigh -3276.800 3276.700 FORMAT "%8.3"
 /begin AXIS_DESCR STD_AXIS VehV_v Vel 16 -327.6800 327.6700 FORMAT "%8.4" DEPOSIT ABSOLUTE /end AXIS_DESCR
 /begin AXIS_DESCR STD_AXIS CoVMD_ratVirtMax Prc 16 -400.0000 399.9878 FORMAT "%8.4" DEPOSIT ABSOLUTE /end AXIS_DESCR
/end CHARACTERISTIC
/begin CHARACTERISTIC CoVMD_tqCvtNormATMod5_M "Conversion MAP 5 for AT condition in Normal Mode" MAP 0x8052E864 RB_Map_S16S16_S16 6553.500 TrqPrpHigh -3276.800 3276.700 FORMAT "%8.3"
 /begin AXIS_DESCR STD_AXIS VehV_v Vel 16 -327.6800 327.6700 FORMAT "%8.4" DEPOSIT ABSOLUTE /end AXIS_DESCR
 /begin AXIS_DESCR STD_AXIS CoVMD_ratVirtMax Prc 16 -400.0000 399.9878 FORMAT "%8.4" DEPOSIT ABSOLUTE /end AXIS_DESCR
/end CHARACTERISTIC
/begin CHARACTERISTIC CoVMD_tqCvtNormATMod6_M "Conversion MAP 6 for AT condition in Normal Mode" MAP 0x8052EAA8 RB_Map_S16S16_S16 6553.500 TrqPrpHigh -3276.800 3276.700 FORMAT "%8.3"
 /begin AXIS_DESCR STD_AXIS VehV_v Vel 16 -327.6800 327.6700 FORMAT "%8.4" DEPOSIT ABSOLUTE /end AXIS_DESCR
 /begin AXIS_DESCR STD_AXIS CoVMD_ratVirtMax Prc 16 -400.0000 399.9878 FORMAT "%8.4" DEPOSIT ABSOLUTE /end AXIS_DESCR
/end CHARACTERISTIC
/begin CHARACTERISTIC CoVMD_tqCvtNormATMod7_M "Conversion MAP 7 for AT condition in Normal Mode" MAP 0x8052ECEC RB_Map_S16S16_S16 6553.500 TrqPrpHigh -3276.800 3276.700 FORMAT "%8.3"
 /begin AXIS_DESCR STD_AXIS VehV_v Vel 16 -327.6800 327.6700 FORMAT "%8.4" DEPOSIT ABSOLUTE /end AXIS_DESCR
 /begin AXIS_DESCR STD_AXIS CoVMD_ratVirtMax Prc 16 -400.0000 399.9878 FORMAT "%8.4" DEPOSIT ABSOLUTE /end AXIS_DESCR
/end CHARACTERISTIC
/begin CHARACTERISTIC CoVMD_tqCvtNormDwnHill1_M "Conversion MAP 1 for down-hill condition in Normal Mode" MAP 0x8052EF30 RB_Map_S16S16_S16 6553.500 TrqPrpHigh -3276.800 3276.700 FORMAT "%8.3"
 /begin AXIS_DESCR STD_AXIS VehV_v Vel 16 -327.6800 327.6700 FORMAT "%8.4" DEPOSIT ABSOLUTE /end AXIS_DESCR
 /begin AXIS_DESCR STD_AXIS CoVMD_ratVirtMax Prc 16 -400.0000 399.9878 FORMAT "%8.4" DEPOSIT ABSOLUTE /end AXIS_DESCR
/end CHARACTERISTIC
/begin CHARACTERISTIC CoVMD_tqCvtNormDwnHill2_M "Conversion MAP 2 for down-hill condition in Normal Mode" MAP 0x8052F174 RB_Map_S16S16_S16 6553.500 TrqPrpHigh -3276.800 3276.700 FORMAT "%8.3"
 /begin AXIS_DESCR STD_AXIS VehV_v Vel 16 -327.6800 327.6700 FORMAT "%8.4" DEPOSIT ABSOLUTE /end AXIS_DESCR
 /begin AXIS_DESCR STD_AXIS CoVMD_ratVirtMax Prc 16 -400.0000 399.9878 FORMAT "%8.4" DEPOSIT ABSOLUTE /end AXIS_DESCR
/end CHARACTERISTIC
/begin CHARACTERISTIC CoVMD_tqCvtNormDwnHill3_M "Conversion MAP 3 for down-hill condition in Normal Mode" MAP 0x8052F3B8 RB_Map_S16S16_S16 6553.500 TrqPrpHigh -3276.800 3276.700 FORMAT "%8.3"
 /begin AXIS_DESCR STD_AXIS VehV_v Vel 16 -327.6800 327.6700 FORMAT "%8.4" DEPOSIT ABSOLUTE /end AXIS_DESCR
 /begin AXIS_DESCR STD_AXIS CoVMD_ratVirtMax Prc 16 -400.0000 399.9878 FORMAT "%8.4" DEPOSIT ABSOLUTE /end AXIS_DESCR
/end CHARACTERISTIC
/begin CHARACTERISTIC CoVMD_tqCvtNormDwnHill4_M "Conversion MAP 4 for down-hill condition in Normal Mode" MAP 0x8052F5FC RB_Map_S16S16_S16 6553.500 TrqPrpHigh -3276.800 3276.700 FORMAT "%8.3"
 /begin AXIS_DESCR STD_AXIS VehV_v Vel 16 -327.6800 327.6700 FORMAT "%8.4" DEPOSIT ABSOLUTE /end AXIS_DESCR
 /begin AXIS_DESCR STD_AXIS CoVMD_ratVirtMax Prc 16 -400.0000 399.9878 FORMAT "%8.4" DEPOSIT ABSOLUTE /end AXIS_DESCR
/end CHARACTERISTIC
/begin CHARACTERISTIC CoVMD_tqCvtNormDwnHill5_M "Conversion MAP 5 for down-hill condition in Normal Mode" MAP 0x8052F840 RB_Map_S16S16_S16 6553.500 TrqPrpHigh -3276.800 3276.700 FORMAT "%8.3"
 /begin AXIS_DESCR STD_AXIS VehV_v Vel 16 -327.6800 327.6700 FORMAT "%8.4" DEPOSIT ABSOLUTE /end AXIS_DESCR
 /begin AXIS_DESCR STD_AXIS CoVMD_ratVirtMax Prc 16 -400.0000 399.9878 FORMAT "%8.4" DEPOSIT ABSOLUTE /end AXIS_DESCR
/end CHARACTERISTIC
/begin CHARACTERISTIC CoVMD_tqCvtNormDwnHill6_M "Conversion MAP 6 for down-hill condition in Normal Mode" MAP 0x8052FA84 RB_Map_S16S16_S16 6553.500 TrqPrpHigh -3276.800 3276.700 FORMAT "%8.3"
 /begin AXIS_DESCR STD_AXIS VehV_v Vel 16 -327.6800 327.6700 FORMAT "%8.4" DEPOSIT ABSOLUTE /end AXIS_DESCR
 /begin AXIS_DESCR STD_AXIS CoVMD_ratVirtMax Prc 16 -400.0000 399.9878 FORMAT "%8.4" DEPOSIT ABSOLUTE /end AXIS_DESCR
/end CHARACTERISTIC
/begin CHARACTERISTIC CoVMD_tqCvtNormLModOff_M "Conversion MAP Mode-On for L condition in Normal Mode" MAP 0x8052FCC8 RB_Map_S16S16_S16 6553.500 TrqPrpHigh -3276.800 3276.700 FORMAT "%8.3"
 /begin AXIS_DESCR STD_AXIS VehV_v Vel 16 -327.6800 327.6700 FORMAT "%8.4" DEPOSIT ABSOLUTE /end AXIS_DESCR
 /begin AXIS_DESCR STD_AXIS CoVMD_ratVirtMax Prc 16 -400.0000 399.9878 FORMAT "%8.4" DEPOSIT ABSOLUTE /end AXIS_DESCR
/end CHARACTERISTIC
/begin CHARACTERISTIC CoVMD_tqCvtNormLModOn_M "Conversion MAP Mode-Off for L condition in Normal Mode" MAP 0x8052FF0C RB_Map_S16S16_S16 6553.500 TrqPrpHigh -3276.800 3276.700 FORMAT "%8.3"
 /begin AXIS_DESCR STD_AXIS VehV_v Vel 16 -327.6800 327.6700 FORMAT "%8.4" DEPOSIT ABSOLUTE /end AXIS_DESCR
 /begin AXIS_DESCR STD_AXIS CoVMD_ratVirtMax Prc 16 -400.0000 399.9878 FORMAT "%8.4" DEPOSIT ABSOLUTE /end AXIS_DESCR
/end CHARACTERISTIC
/begin CHARACTERISTIC CoVMD_tqCvtNormLnchD_M "Conversion MAP D for Launch condition in Normal Mode" MAP 0x80530150 RB_Map_S16S16_S16 6553.500 TrqPrpHigh -3276.800 3276.700 FORMAT "%8.3"
 /begin AXIS_DESCR STD_AXIS VehV_v Vel 16 -327.6800 327.6700 FORMAT "%8.4" DEPOSIT ABSOLUTE /end AXIS_DESCR
 /begin AXIS_DESCR STD_AXIS CoVMD_ratVirtMax Prc 16 -400.0000 399.9878 FORMAT "%8.4" DEPOSIT ABSOLUTE /end AXIS_DESCR
/end CHARACTERISTIC
/begin CHARACTERISTIC CoVMD_tqCvtNormLnchE_M "Conversion MAP E for Launch condition in Normal Mode" MAP 0x80530394 RB_Map_S16S16_S16 6553.500 TrqPrpHigh -3276.800 3276.700 FORMAT "%8.3"
 /begin AXIS_DESCR STD_AXIS VehV_v Vel 16 -327.6800 327.6700 FORMAT "%8.4" DEPOSIT ABSOLUTE /end AXIS_DESCR
 /begin AXIS_DESCR STD_AXIS CoVMD_ratVirtMax Prc 16 -400.0000 399.9878 FORMAT "%8.4" DEPOSIT ABSOLUTE /end AXIS_DESCR
/end CHARACTERISTIC
/begin CHARACTERISTIC CoVMD_tqCvtNormLnchL_M "Conversion MAP L for Launch condition in Normal Mode" MAP 0x805305D8 RB_Map_S16S16_S16 6553.500 TrqPrpHigh -3276.800 3276.700 FORMAT "%8.3"
 /begin AXIS_DESCR STD_AXIS VehV_v Vel 16 -327.6800 327.6700 FORMAT "%8.4" DEPOSIT ABSOLUTE /end AXIS_DESCR
 /begin AXIS_DESCR STD_AXIS CoVMD_ratVirtMax Prc 16 -400.0000 399.9878 FORMAT "%8.4" DEPOSIT ABSOLUTE /end AXIS_DESCR
/end CHARACTERISTIC
/begin CHARACTERISTIC CoVMD_tqCvtNormLnchS_M "Conversion MAP S for Launch condition in Normal Mode" MAP 0x8053081C RB_Map_S16S16_S16 6553.500 TrqPrpHigh -3276.800 3276.700 FORMAT "%8.3"
 /begin AXIS_DESCR STD_AXIS VehV_v Vel 16 -327.6800 327.6700 FORMAT "%8.4" DEPOSIT ABSOLUTE /end AXIS_DESCR
 /begin AXIS_DESCR STD_AXIS CoVMD_ratVirtMax Prc 16 -400.0000 399.9878 FORMAT "%8.4" DEPOSIT ABSOLUTE /end AXIS_DESCR
/end CHARACTERISTIC
/begin CHARACTERISTIC CoVMD_tqCvtNormNormD12_M "Conversion MAP D12 for normal condition in Normal Mode" MAP 0x80530A60 RB_Map_S16S16_S16 6553.500 TrqPrpHigh -3276.800 3276.700 FORMAT "%8.3"
 /begin AXIS_DESCR STD_AXIS VehV_v Vel 16 -327.6800 327.6700 FORMAT "%8.4" DEPOSIT ABSOLUTE /end AXIS_DESCR
 /begin AXIS_DESCR STD_AXIS CoVMD_ratVirtMax Prc 16 -400.0000 399.9878 FORMAT "%8.4" DEPOSIT ABSOLUTE /end AXIS_DESCR
/end CHARACTERISTIC
/begin CHARACTERISTIC CoVMD_tqCvtNormNormD2_M "Conversion MAP D2 for normal condition in Normal Mode" MAP 0x80530CA4 RB_Map_S16S16_S16 6553.500 TrqPrpHigh -3276.800 3276.700 FORMAT "%8.3"
 /begin AXIS_DESCR STD_AXIS VehV_v Vel 16 -327.6800 327.6700 FORMAT "%8.4" DEPOSIT ABSOLUTE /end AXIS_DESCR
 /begin AXIS_DESCR STD_AXIS CoVMD_ratVirtMax Prc 16 -400.0000 399.9878 FORMAT "%8.4" DEPOSIT ABSOLUTE /end AXIS_DESCR
/end CHARACTERISTIC
/begin CHARACTERISTIC CoVMD_tqCvtNormNormD_M "Conversion MAP D for normal condition in Normal Mode" MAP 0x80530EE8 RB_Map_S16S16_S16 6553.500 TrqPrpHigh -3276.800 3276.700 FORMAT "%8.3"
 /begin AXIS_DESCR STD_AXIS VehV_v Vel 16 -327.6800 327.6700 FORMAT "%8.4" DEPOSIT ABSOLUTE /end AXIS_DESCR
 /begin AXIS_DESCR STD_AXIS CoVMD_ratVirtMax Prc 16 -400.0000 399.9878 FORMAT "%8.4" DEPOSIT ABSOLUTE /end AXIS_DESCR
/end CHARACTERISTIC
/begin CHARACTERISTIC CoVMD_tqCvtNormNormE12_M "Conversion MAP E12 for normal condition in Normal Mode" MAP 0x8053112C RB_Map_S16S16_S16 6553.500 TrqPrpHigh -3276.800 3276.700 FORMAT "%8.3"
 /begin AXIS_DESCR STD_AXIS VehV_v Vel 16 -327.6800 327.6700 FORMAT "%8.4" DEPOSIT ABSOLUTE /end AXIS_DESCR
 /begin AXIS_DESCR STD_AXIS CoVMD_ratVirtMax Prc 16 -400.0000 399.9878 FORMAT "%8.4" DEPOSIT ABSOLUTE /end AXIS_DESCR
/end CHARACTERISTIC
/begin CHARACTERISTIC CoVMD_tqCvtNormNormE1_M "Conversion MAP E1 for normal condition in Normal Mode" MAP 0x80531370 RB_Map_S16S16_S16 6553.500 TrqPrpHigh -3276.800 3276.700 FORMAT "%8.3"
 /begin AXIS_DESCR STD_AXIS VehV_v Vel 16 -327.6800 327.6700 FORMAT "%8.4" DEPOSIT ABSOLUTE /end AXIS_DESCR
 /begin AXIS_DESCR STD_AXIS CoVMD_ratVirtMax Prc 16 -400.0000 399.9878 FORMAT "%8.4" DEPOSIT ABSOLUTE /end AXIS_DESCR
/end CHARACTERISTIC
/begin CHARACTERISTIC CoVMD_tqCvtNormNormE2_M "Conversion MAP E2 for normal condition in Normal Mode" MAP 0x805315B4 RB_Map_S16S16_S16 6553.500 TrqPrpHigh -3276.800 3276.700 FORMAT "%8.3"
 /begin AXIS_DESCR STD_AXIS VehV_v Vel 16 -327.6800 327.6700 FORMAT "%8.4" DEPOSIT ABSOLUTE /end AXIS_DESCR
 /begin AXIS_DESCR STD_AXIS CoVMD_ratVirtMax Prc 16 -400.0000 399.9878 FORMAT "%8.4" DEPOSIT ABSOLUTE /end AXIS_DESCR
/end CHARACTERISTIC
/begin CHARACTERISTIC CoVMD_tqCvtNormNormE_M "Conversion MAP E for normal condition in Normal Mode" MAP 0x805317F8 RB_Map_S16S16_S16 6553.500 TrqPrpHigh -3276.800 3276.700 FORMAT "%8.3"
 /begin AXIS_DESCR STD_AXIS VehV_v Vel 16 -327.6800 327.6700 FORMAT "%8.4" DEPOSIT ABSOLUTE /end AXIS_DESCR
 /begin AXIS_DESCR STD_AXIS CoVMD_ratVirtMax Prc 16 -400.0000 399.9878 FORMAT "%8.4" DEPOSIT ABSOLUTE /end AXIS_DESCR
/end CHARACTERISTIC
/begin CHARACTERISTIC CoVMD_tqCvtNormNormS0_M "Conversion MAP S0 for normal condition in Normal Mode" MAP 0x80531A3C RB_Map_S16S16_S16 6553.500 TrqPrpHigh -3276.800 3276.700 FORMAT "%8.3"
 /begin AXIS_DESCR STD_AXIS VehV_v Vel 16 -327.6800 327.6700 FORMAT "%8.4" DEPOSIT ABSOLUTE /end AXIS_DESCR
 /begin AXIS_DESCR STD_AXIS CoVMD_ratVirtMax Prc 16 -400.0000 399.9878 FORMAT "%8.4" DEPOSIT ABSOLUTE /end AXIS_DESCR
/end CHARACTERISTIC
/begin CHARACTERISTIC CoVMD_tqCvtNormNormS1_M "Conversion MAP S1 for normal condition in Normal Mode" MAP 0x80531C80 RB_Map_S16S16_S16 6553.500 TrqPrpHigh -3276.800 3276.700 FORMAT "%8.3"
 /begin AXIS_DESCR STD_AXIS VehV_v Vel 16 -327.6800 327.6700 FORMAT "%8.4" DEPOSIT ABSOLUTE /end AXIS_DESCR
 /begin AXIS_DESCR STD_AXIS CoVMD_ratVirtMax Prc 16 -400.0000 399.9878 FORMAT "%8.4" DEPOSIT ABSOLUTE /end AXIS_DESCR
/end CHARACTERISTIC
/begin CHARACTERISTIC CoVMD_tqCvtNormNormS2_M "Conversion MAP S2 for normal condition in Normal Mode" MAP 0x80531EC4 RB_Map_S16S16_S16 6553.500 TrqPrpHigh -3276.800 3276.700 FORMAT "%8.3"
 /begin AXIS_DESCR STD_AXIS VehV_v Vel 16 -327.6800 327.6700 FORMAT "%8.4" DEPOSIT ABSOLUTE /end AXIS_DESCR
 /begin AXIS_DESCR STD_AXIS CoVMD_ratVirtMax Prc 16 -400.0000 399.9878 FORMAT "%8.4" DEPOSIT ABSOLUTE /end AXIS_DESCR
/end CHARACTERISTIC
/begin CHARACTERISTIC CoVMD_tqCvtNormNormSP_M "Conversion MAP SP for normal condition in Normal Mode" MAP 0x80532108 RB_Map_S16S16_S16 6553.500 TrqPrpHigh -3276.800 3276.700 FORMAT "%8.3"
 /begin AXIS_DESCR STD_AXIS VehV_v Vel 16 -327.6800 327.6700 FORMAT "%8.4" DEPOSIT ABSOLUTE /end AXIS_DESCR
 /begin AXIS_DESCR STD_AXIS CoVMD_ratVirtMax Prc 16 -400.0000 399.9878 FORMAT "%8.4" DEPOSIT ABSOLUTE /end AXIS_DESCR
/end CHARACTERISTIC
/begin CHARACTERISTIC CoVMD_tqCvtNormTipMod1_M "Conversion MAP 1 for Tip condition in Normal Mode" MAP 0x8053234C RB_Map_S16S16_S16 6553.500 TrqPrpHigh -3276.800 3276.700 FORMAT "%8.3"
 /begin AXIS_DESCR STD_AXIS VehV_v Vel 16 -327.6800 327.6700 FORMAT "%8.4" DEPOSIT ABSOLUTE /end AXIS_DESCR
 /begin AXIS_DESCR STD_AXIS CoVMD_ratVirtMax Prc 16 -400.0000 399.9878 FORMAT "%8.4" DEPOSIT ABSOLUTE /end AXIS_DESCR
/end CHARACTERISTIC
/begin CHARACTERISTIC CoVMD_tqCvtNormTipMod2_M "Conversion MAP 2 for Tip condition in Normal Mode" MAP 0x80532590 RB_Map_S16S16_S16 6553.500 TrqPrpHigh -3276.800 3276.700 FORMAT "%8.3"
 /begin AXIS_DESCR STD_AXIS VehV_v Vel 16 -327.6800 327.6700 FORMAT "%8.4" DEPOSIT ABSOLUTE /end AXIS_DESCR
 /begin AXIS_DESCR STD_AXIS CoVMD_ratVirtMax Prc 16 -400.0000 399.9878 FORMAT "%8.4" DEPOSIT ABSOLUTE /end AXIS_DESCR
/end CHARACTERISTIC
/begin CHARACTERISTIC CoVMD_tqCvtNormTipMod3_M "Conversion MAP 3 for Tip condition in Normal Mode" MAP 0x805327D4 RB_Map_S16S16_S16 6553.500 TrqPrpHigh -3276.800 3276.700 FORMAT "%8.3"
 /begin AXIS_DESCR STD_AXIS VehV_v Vel 16 -327.6800 327.6700 FORMAT "%8.4" DEPOSIT ABSOLUTE /end AXIS_DESCR
 /begin AXIS_DESCR STD_AXIS CoVMD_ratVirtMax Prc 16 -400.0000 399.9878 FORMAT "%8.4" DEPOSIT ABSOLUTE /end AXIS_DESCR
/end CHARACTERISTIC
/begin CHARACTERISTIC CoVMD_tqCvtNormTipMod4_M "Conversion MAP 4 for Tip condition in Normal Mode" MAP 0x80532A18 RB_Map_S16S16_S16 6553.500 TrqPrpHigh -3276.800 3276.700 FORMAT "%8.3"
 /begin AXIS_DESCR STD_AXIS VehV_v Vel 16 -327.6800 327.6700 FORMAT "%8.4" DEPOSIT ABSOLUTE /end AXIS_DESCR
 /begin AXIS_DESCR STD_AXIS CoVMD_ratVirtMax Prc 16 -400.0000 399.9878 FORMAT "%8.4" DEPOSIT ABSOLUTE /end AXIS_DESCR
/end CHARACTERISTIC
/begin CHARACTERISTIC CoVMD_tqCvtNormTipMod5_M "Conversion MAP 5 for Tip condition in Normal Mode" MAP 0x80532C5C RB_Map_S16S16_S16 6553.500 TrqPrpHigh -3276.800 3276.700 FORMAT "%8.3"
 /begin AXIS_DESCR STD_AXIS VehV_v Vel 16 -327.6800 327.6700 FORMAT "%8.4" DEPOSIT ABSOLUTE /end AXIS_DESCR
 /begin AXIS_DESCR STD_AXIS CoVMD_ratVirtMax Prc 16 -400.0000 399.9878 FORMAT "%8.4" DEPOSIT ABSOLUTE /end AXIS_DESCR
/end CHARACTERISTIC
/begin CHARACTERISTIC CoVMD_tqCvtNormTipMod6_M "Conversion MAP 6 for Tip condition in Normal Mode" MAP 0x80532EA0 RB_Map_S16S16_S16 6553.500 TrqPrpHigh -3276.800 3276.700 FORMAT "%8.3"
 /begin AXIS_DESCR STD_AXIS VehV_v Vel 16 -327.6800 327.6700 FORMAT "%8.4" DEPOSIT ABSOLUTE /end AXIS_DESCR
 /begin AXIS_DESCR STD_AXIS CoVMD_ratVirtMax Prc 16 -400.0000 399.9878 FORMAT "%8.4" DEPOSIT ABSOLUTE /end AXIS_DESCR
/end CHARACTERISTIC
/begin CHARACTERISTIC CoVMD_tqCvtNormTipMod7_M "Conversion MAP 7 for Tip condition in Normal Mode" MAP 0x805330E4 RB_Map_S16S16_S16 6553.500 TrqPrpHigh -3276.800 3276.700 FORMAT "%8.3"
 /begin AXIS_DESCR STD_AXIS VehV_v Vel 16 -327.6800 327.6700 FORMAT "%8.4" DEPOSIT ABSOLUTE /end AXIS_DESCR
 /begin AXIS_DESCR STD_AXIS CoVMD_ratVirtMax Prc 16 -400.0000 399.9878 FORMAT "%8.4" DEPOSIT ABSOLUTE /end AXIS_DESCR
/end CHARACTERISTIC
/begin CHARACTERISTIC CoVMD_tqIDASFailOffs_C "Offset value is used to determine the torque threshold for IDAS failure detection" VALUE 0x80533328 RB_Val_Ws16 65535.00 RBPtCel_tq_1p0_1 -32768.00 32767.00 FORMAT "%8.2" /end CHARACTERISTIC
/begin CHARACTERISTIC CoVMD_tqIDASTarThd_C "Threshold of IDAS target torque to detect torque failure" VALUE 0x8053332A RB_Val_Ws16 65535.00 TrqPerSec -32768.00 32767.00 FORMAT "%8.2" /end CHARACTERISTIC
/begin CHARACTERISTIC CoVMD_TrqDesCoord_CW "codeword for CoVMD_TrqDesCoord" VALUE 0x80533338 RB_Val_Wu8 255.0 OneToOne 0.00 255.0 FORMAT "%5.1" /end CHARACTERISTIC
/begin CHARACTERISTIC CoVMD_trqThresCrCtlL_C "Lower threshold for CrCtl Status" VALUE 0x8053333C RB_Val_Ws32 429496729.500 TrqPrpHigh -214748364.800 214748364.700 FORMAT "%13.3" /end CHARACTERISTIC
/begin CHARACTERISTIC CoVMD_trqThresCrCtlR_C "Upper threshold for CrCtl Status" VALUE 0x80533340 RB_Val_Ws32 429496729.500 TrqPrpHigh -214748364.800 214748364.700 FORMAT "%13.3" /end CHARACTERISTIC
/begin CHARACTERISTIC CoVMD_trqThresCtOffLo_C "Lower threshold for fuel cut off" VALUE 0x8053332C RB_Val_Ws32 429496729.500 TrqPrpHigh -214748364.800 214748364.700 FORMAT "%13.3" /end CHARACTERISTIC
/begin CHARACTERISTIC CoVMD_trqThresCtOffUp_C "Upper threshold for fuel cut off" VALUE 0x80533330 RB_Val_Ws32 429496729.500 TrqPrpHigh -214748364.800 214748364.700 FORMAT "%13.3" /end CHARACTERISTIC
/begin CHARACTERISTIC CoVMD_trqThresLLimL_C "Lower threshold for LLim Status" VALUE 0x80533344 RB_Val_Ws32 429496729.500 TrqPrpHigh -214748364.800 214748364.700 FORMAT "%13.3" /end CHARACTERISTIC
/begin CHARACTERISTIC CoVMD_trqThresLLimR_C "Upper threshold for LLim Status" VALUE 0x80533348 RB_Val_Ws32 429496729.500 TrqPrpHigh -214748364.800 214748364.700 FORMAT "%13.3" /end CHARACTERISTIC
/begin CHARACTERISTIC CoVMD_vIDASFailDetn_C "Vehicle speed threshold for IDAS failure detection" VALUE 0x80533334 RB_Val_Ws16 655.3500 Vel -327.6800 327.6700 FORMAT "%8.4" /end CHARACTERISTIC
/begin CHARACTERISTIC CoVOM_agDeltaRefPosnIntk_C "Allowable cam delta angle from reference position for intake valve" VALUE 0x8053334C RB_Val_Ws16 1023.984 kw_q0p0156 -512.0000 511.9844 FORMAT "%8.4" /end CHARACTERISTIC
/begin CHARACTERISTIC CoVOM_bClthPTRls_C "0= start release condition only with engaged neutral gear 1= start release condition with pressed clutch or engaged neutral gear" VALUE 0x8053334E RB_Val_Wu8 1.00000000000 B_TRUE 0.00 1.00000000000 FORMAT "%13.11" /end CHARACTERISTIC
/begin CHARACTERISTIC CoVOM_bRstvXMaxCOM_C "Calibration parameter to decide whether the maximum reached velocity threshold should be reset in case of ""Change Of Mind""" VALUE 0x8053334F RB_Val_Wu8 1.00000000000 B_TRUE 0.00 1.00000000000 FORMAT "%13.11" /end CHARACTERISTIC
/begin CHARACTERISTIC CoVOM_bSSEEngStrtWoFrstStrt_C "Switch to allows engine start trough coordinator even if first start was not carried out" VALUE 0x80533350 RB_Val_Wu8 1.00000000000 B_TRUE 0.00 1.00000000000 FORMAT "%13.11" /end CHARACTERISTIC
/begin CHARACTERISTIC CoVOM_bSSEEngStrtWoStSp_C "Switch to allow engine start with coordinator even if the stop was not due to coordinator" VALUE 0x80533351 RB_Val_Wu8 1.00000000000 B_TRUE 0.00 1.00000000000 FORMAT "%13.11" /end CHARACTERISTIC
/begin CHARACTERISTIC CoVOM_bSSERstrtEng_C "Calibration to enable restart engine request" VALUE 0x80533352 RB_Val_Wu8 1.00000000000 B_TRUE 0.00 1.00000000000 FORMAT "%13.11" /end CHARACTERISTIC
/begin CHARACTERISTIC CoVOM_bSSEUIStrtReq_C "A deactivated Start/Stop switch should request a engine start immediately depending on this parameter." VALUE 0x80533353 RB_Val_Wu8 1.00000000000 B_TRUE 0.00 1.00000000000 FORMAT "%13.11" /end CHARACTERISTIC
/begin CHARACTERISTIC COVOM_cntTotRlyOperMax_C "Maximum number of starter relay operations permitted in order to allow start-stop operation" VALUE 0x80533354 RB_Val_Wu32 4294967295.00 OneToOne 0.00 4294967295.00 FORMAT "%13.2" /end CHARACTERISTIC
/begin CHARACTERISTIC CoVOM_ctStopEngMax_C "Maximum engine stop counter for engine stop release" VALUE 0x80533358 RB_Val_Wu32 4294967295.00 OneToOne 0.00 4294967295.00 FORMAT "%13.2" /end CHARACTERISTIC
/begin CHARACTERISTIC CoVOM_flgCoMEna_C "this is to indicate CoM enable" VALUE 0x8053335C RB_Val_Wu8 1.00000000000 B_TRUE 0.00 1.00000000000 FORMAT "%13.11" /end CHARACTERISTIC
/begin CHARACTERISTIC CoVOM_flgEngRunDetCoM_C "Flag to enable engine state detection based on change of mind status" VALUE 0x8053335D RB_Val_Wu8 1.00000000000 B_TRUE 0.00 1.00000000000 FORMAT "%13.11" /end CHARACTERISTIC
/begin CHARACTERISTIC CoVOM_flgStrtrChkDi_C "Calibration to disable crank abort during re-start only when starter is engaged" VALUE 0x8053335E RB_Val_Wu8 1.00000000000 B_TRUE 0.00 1.00000000000 FORMAT "%13.11" /end CHARACTERISTIC
/begin CHARACTERISTIC CoVOM_flgSwtBrkHldAvl_C "Calibration switch to enable Brake hold feature" VALUE 0x8053335F RB_Val_Wu8 1.00000000000 B_TRUE 0.00 1.00000000000 FORMAT "%13.11" /end CHARACTERISTIC
/begin CHARACTERISTIC CoVOM_flgSwtEngSpdChkEna_C "Switch to consider engine speed for determining engine stall condition" VALUE 0x80533360 RB_Val_Wu8 1.00000000000 B_TRUE 0.00 1.00000000000 FORMAT "%13.11" /end CHARACTERISTIC
/begin CHARACTERISTIC CoVOM_flgSwtLSFAvl_C "Calibration switch to enable LSF feature" VALUE 0x80533361 RB_Val_Wu8 1.00000000000 B_TRUE 0.00 1.00000000000 FORMAT "%13.11" /end CHARACTERISTIC
/begin CHARACTERISTIC CoVOM_flgSwtStrtReqBrkFldP_C "Switch for starter request by Brake fluid pressure" VALUE 0x80533362 RB_Val_Wu8 1.00000000000 B_TRUE 0.00 1.00000000000 FORMAT "%13.11" /end CHARACTERISTIC
/begin CHARACTERISTIC CoVOM_nEngRstrtEngStallThd_C "Engine speed threshold for determining engine stall condition" VALUE 0x80533364 RB_Val_Ws16 32767.50 EngN -16384.00 16383.50 FORMAT "%8.2" /end CHARACTERISTIC
/begin CHARACTERISTIC CoVOM_nEngStopDelta_C "Engine speed delta threshold for Idle Stop release" VALUE 0x80533366 RB_Val_Ws16 32767.50 EngN -16384.00 16383.50 FORMAT "%8.2" /end CHARACTERISTIC
/begin CHARACTERISTIC CoVOM_nEngStsDetnBefIdleSpd_C "Engine speed to detect engine status before reach to idle speed." VALUE 0x80533368 RB_Val_Ws16 32767.50 EngN -16384.00 16383.50 FORMAT "%8.2" /end CHARACTERISTIC
/begin CHARACTERISTIC CoVOM_numEngStrtAbrtMax_C "Maximum allowed number of start abortions" VALUE 0x8053336A RB_Val_Ws16 32767.00 OneToOne 0.00 32767.00 FORMAT "%8.2" EXTENDED_LIMITS -32768.00 32767.00 /end CHARACTERISTIC
/begin CHARACTERISTIC COVOM_pAtmPThdDelta_C "Delta value of threshold for enviromental pressure check for determination of high altitude condition" VALUE 0x8053336C RB_Val_Ws16 32767.00 Pres_hPa 0.00 32767.00 FORMAT "%8.2" EXTENDED_LIMITS -32768.00 32767.00 /end CHARACTERISTIC
/begin CHARACTERISTIC COVOM_pAtmPThd_C "Environmental pressure threshold for determination of high altitude condition" VALUE 0x8053336E RB_Val_Ws16 32767.00 Pres_hPa 0.00 32767.00 FORMAT "%8.2" EXTENDED_LIMITS -32768.00 32767.00 /end CHARACTERISTIC
/begin CHARACTERISTIC CoVOM_pRelChgThd_C "Offset calibration for judgment of negative pressure change in the vacuum chamber after ISAB comes into operation and give a start request" VALUE 0x80533370 RB_Val_Ws16 65535.00 Pres_hPa -32768.00 32767.00 FORMAT "%8.2" /end CHARACTERISTIC
/begin CHARACTERISTIC CoVOM_rAPPHysHi_C "Accelaration pedal position upper hystheresis threshold for a stop request" VALUE 0x80533372 RB_Val_Ws16 799.9878 Prc -400.0000 399.9878 FORMAT "%8.4" /end CHARACTERISTIC
/begin CHARACTERISTIC CoVOM_rAPPHysLo_C "Accelarator pedal position lower hystheresis threshold for a stop request." VALUE 0x80533374 RB_Val_Ws16 799.9878 Prc -400.0000 399.9878 FORMAT "%8.4" /end CHARACTERISTIC
/begin CHARACTERISTIC CoVOM_rAPPOnThres_C "Ratio from which accelerator pedal pressed is detected for indication of request for restart of starter during Level2 starter inhibition." VALUE 0x80533376 RB_Val_Ws16 799.9878 Prc -400.0000 399.9878 FORMAT "%8.4" /end CHARACTERISTIC
/begin CHARACTERISTIC CoVOM_rAPPStrtMin_C "Acceleration pedal ratio that leads to engine start" VALUE 0x80533378 RB_Val_Ws16 799.9878 Prc -400.0000 399.9878 FORMAT "%8.4" /end CHARACTERISTIC
/begin CHARACTERISTIC CoVOM_stAutoRstrtReqMsk_C "Parameter to enable status of auto restart request" VALUE 0x8053337C RB_Val_Wu32 4294967295.00 OneToOne 0.00 4294967295.00 FORMAT "%13.2" /end CHARACTERISTIC
/begin CHARACTERISTIC CoVOM_stClthSigSel_C "Clutch signal selection calibration based on the sensors present" VALUE 0x80533380 RB_Val_Wu8 1.00000000000 B_TRUE 0.00 1.00000000000 FORMAT "%13.11" /end CHARACTERISTIC
/begin CHARACTERISTIC CoVOM_stDrvMod1_C "Drive mode 1 in which idle start-stop function is disabled" VALUE 0x80533381 RB_Val_Wu8 255.0 OneToOne 0.00 255.0 FORMAT "%5.1" /end CHARACTERISTIC
/begin CHARACTERISTIC CoVOM_stDrvMod2_C "Drive mode 2 in which idle start-stop function is disabled" VALUE 0x80533382 RB_Val_Wu8 255.0 OneToOne 0.00 255.0 FORMAT "%5.1" /end CHARACTERISTIC
/begin CHARACTERISTIC CoVOM_stDrvMod3_C "Drive mode 3 in which idle start-stop function is disabled" VALUE 0x80533383 RB_Val_Wu8 255.0 OneToOne 0.00 255.0 FORMAT "%5.1" /end CHARACTERISTIC
/begin CHARACTERISTIC CoVOM_stEngStallReasMask_C "Mask for engine stall reason" VALUE 0x80533384 RB_Val_Wu8 255.0 OneToOne 0.00 255.0 FORMAT "%5.1" /end CHARACTERISTIC
/begin CHARACTERISTIC CoVOM_stIgrBrkPedStrtReq_C "Ignore Brake Pedal from Start request" VALUE 0x80533385 RB_Val_Wu8 1.00000000000 B_TRUE 0.00 1.00000000000 FORMAT "%13.11" /end CHARACTERISTIC
/begin CHARACTERISTIC CoVOM_stISGoStbMask_C "Mask for standby condition" VALUE 0x80533388 RB_Val_Wu32 4294967295.00 OneToOne 0.00 4294967295.00 FORMAT "%13.2" /end CHARACTERISTIC
/begin CHARACTERISTIC CoVOM_stStopRelsMask_C "Stop release mask" VALUE 0x8053338C RB_Val_Wu32 4294967295.00 OneToOne 0.00 4294967295.00 FORMAT "%13.2" /end CHARACTERISTIC
/begin CHARACTERISTIC CoVOM_stStopReqMask_C "Bit mask for Idle stop request condition." VALUE 0x80533390 RB_Val_Wu32 4294967295.00 OneToOne 0.00 4294967295.00 FORMAT "%13.2" /end CHARACTERISTIC
/begin CHARACTERISTIC CoVOM_stStrtEnaMask_C "Start enable mask" VALUE 0x80533394 RB_Val_Wu32 4294967295.00 OneToOne 0.00 4294967295.00 FORMAT "%13.2" /end CHARACTERISTIC
/begin CHARACTERISTIC CoVOM_stStrtReqMask_C "Start request mask" VALUE 0x80533398 RB_Val_Wu32 4294967295.00 OneToOne 0.00 4294967295.00 FORMAT "%13.2" /end CHARACTERISTIC
/begin CHARACTERISTIC CoVOM_stSysOffRelsMask_C "System off release mask" VALUE 0x8053339C RB_Val_Wu8 255.0 OneToOne 0.00 255.0 FORMAT "%5.1" /end CHARACTERISTIC
/begin CHARACTERISTIC CoVOM_stSysOffTrigMask_C "System off trigger mask calibration" VALUE 0x8053339E RB_Val_Wu16 65535.00 OneToOne 0.00 65535.00 FORMAT "%8.2" /end CHARACTERISTIC
/begin CHARACTERISTIC CoVOM_stVehMktSelSwt_C "Vehicle market selection switch" VALUE 0x805333A0 RB_Val_Wu8 1.00000000000 B_TRUE 0.00 1.00000000000 FORMAT "%13.11" /end CHARACTERISTIC
/begin CHARACTERISTIC CoVOM_swtACType_C "Calibration to select AC logic or Defogger logic." VALUE 0x805333A1 RB_Val_Wu8 1.00000000000 B_TRUE 0.00 1.00000000000 FORMAT "%13.11" /end CHARACTERISTIC
/begin CHARACTERISTIC CoVOM_swtCluBasdRstrtRels_C "Switch to select clutch based restart release" VALUE 0x805333A2 RB_Val_Wu8 1.00000000000 B_TRUE 0.00 1.00000000000 FORMAT "%13.11" /end CHARACTERISTIC
/begin CHARACTERISTIC CoVOM_swtDrvModSeln_C "Drive mode selection between variant MT and AT,CVT" VALUE 0x805333A3 RB_Val_Wu8 1.00000000000 B_TRUE 0.00 1.00000000000 FORMAT "%13.11" /end CHARACTERISTIC
/begin CHARACTERISTIC CoVOM_swtSSEEna_C "Application to enable or disable the StartStop coordinator" VALUE 0x805333A4 RB_Val_Wu8 255.0 OneToOne 0.00 255.0 FORMAT "%5.1" /end CHARACTERISTIC
/begin CHARACTERISTIC CoVOM_swtTrigCamsftRefEna_C "Calibration switch to enable the trigger camshaft to the reference position calculation" VALUE 0x805333A5 RB_Val_Wu8 1.00000000000 B_TRUE 0.00 1.00000000000 FORMAT "%13.11" /end CHARACTERISTIC
/begin CHARACTERISTIC CoVOM_tiACISSInhbReqDeb_C "Debounce Delay METER Enable." VALUE 0x805333A6 RB_Val_Ws16 655350.0 TimeDeb -327680.0 327670.0 FORMAT "%8.1" /end CHARACTERISTIC
/begin CHARACTERISTIC CoVOM_tiAPPMoF_C "Threshold value for turn off delay when APP is released" VALUE 0x805333A8 RB_Val_Ws16 655.3500 Time_s -327.6800 327.6700 FORMAT "%8.4" /end CHARACTERISTIC
/begin CHARACTERISTIC CoVOM_tiBdIntStopEnaDeb_C "Debounce time for stop release (Body Interior)" VALUE 0x805333AA RB_Val_Ws16 327670.0 TimeDeb 0.00 327670.0 FORMAT "%8.1" EXTENDED_LIMITS -327680.0 327670.0 /end CHARACTERISTIC
/begin CHARACTERISTIC CoVOM_tiBrkHldMoF_C "Threshold value for turn off delay when Brake hold is released" VALUE 0x805333AC RB_Val_Ws16 655.3500 Time_s -327.6800 327.6700 FORMAT "%8.4" /end CHARACTERISTIC
/begin CHARACTERISTIC CoVOM_tiBrkHldStbyOff_C "Delay time for brake hold system off detection" VALUE 0x805333AE RB_Val_Wu8 2550. Time_ms 0.00 2550. FORMAT "%5.0" /end CHARACTERISTIC
/begin CHARACTERISTIC CoVOM_tiBrkMaxMoF_C "Secondary Threshold value for turn off delay when brake pedal is released" VALUE 0x805333B0 RB_Val_Ws16 655.3500 Time_s -327.6800 327.6700 FORMAT "%8.4" /end CHARACTERISTIC
/begin CHARACTERISTIC CoVOM_tiBrkMoF_C "Primary Threshold value for turn off delay when brake pedal is released" VALUE 0x805333B2 RB_Val_Ws16 655.3500 Time_s -327.6800 327.6700 FORMAT "%8.4" /end CHARACTERISTIC
/begin CHARACTERISTIC CoVOM_tiBrkPedStopEnaDeb_C "Debounce time for the release condition (Brake system)" VALUE 0x805333B4 RB_Val_Ws16 327670.0 TimeDeb 0.00 327670.0 FORMAT "%8.1" EXTENDED_LIMITS -327680.0 327670.0 /end CHARACTERISTIC
/begin CHARACTERISTIC CoVOM_tiBrkRstrtAllw_C "Brake on restart delay time at P range" VALUE 0x805333B6 RB_Val_Ws16 327.6700 Time_s 0.00 327.6700 FORMAT "%8.4" EXTENDED_LIMITS -327.6800 327.6700 /end CHARACTERISTIC
/begin CHARACTERISTIC CoVOM_tiCoEngStopEnaDeb_C "Stop release debounce time engine coordinator" VALUE 0x805333B8 RB_Val_Ws16 327670.0 TimeDeb 0.00 327670.0 FORMAT "%8.1" EXTENDED_LIMITS -327680.0 327670.0 /end CHARACTERISTIC
/begin CHARACTERISTIC CoVOM_tiDrvStopReqDeb_C "Debounce time for the driver stop request" VALUE 0x805333BA RB_Val_Ws16 327670.0 TimeDeb 0.00 327670.0 FORMAT "%8.1" EXTENDED_LIMITS -327680.0 327670.0 /end CHARACTERISTIC
/begin CHARACTERISTIC CoVOM_tiEngCrkAbortThd_C "threshold time to abort the engine crank" VALUE 0x805333BC RB_Val_Ws16 327.6700 Time_s 0.00 327.6700 FORMAT "%8.4" EXTENDED_LIMITS -327.6800 327.6700 /end CHARACTERISTIC
/begin CHARACTERISTIC CoVOM_tiEngInhbReqDeb_C "Debounce Delay for MVCPA Enalbe" VALUE 0x805333BE RB_Val_Ws16 655350.0 TimeDeb -327680.0 327670.0 FORMAT "%8.1" /end CHARACTERISTIC
/begin CHARACTERISTIC CoVOM_tiEngRstrtOrdDly_C "delay time for engine restart request from engine stall" VALUE 0x805333C0 RB_Val_Wu8 2550. Time_ms 0.00 2550. FORMAT "%5.0" /end CHARACTERISTIC
/begin CHARACTERISTIC CoVOM_tiEngRstrtReqHiLo_C "debounce time for engine restart request high to low transition" VALUE 0x805333C2 RB_Val_Ws16 327670.0 TimeDeb 0.00 327670.0 FORMAT "%8.1" EXTENDED_LIMITS -327680.0 327670.0 /end CHARACTERISTIC
/begin CHARACTERISTIC CoVOM_tiEngRstrtReqLoHi_C "debounce time for engine restart request low to high transition" VALUE 0x805333C4 RB_Val_Ws16 327670.0 TimeDeb 0.00 327670.0 FORMAT "%8.1" EXTENDED_LIMITS -327680.0 327670.0 /end CHARACTERISTIC
/begin CHARACTERISTIC CoVOM_tiEngStall_C "Calibration to check Engine stall time" VALUE 0x805333C6 RB_Val_Ws16 327.6700 Time_s 0.00 327.6700 FORMAT "%8.4" EXTENDED_LIMITS -327.6800 327.6700 /end CHARACTERISTIC
/begin CHARACTERISTIC CoVOM_tiEngStrtOrdDly_C "engine start order delay" VALUE 0x805333C8 RB_Val_Wu8 150.0 Time_ms 0.00 150.0 FORMAT "%5.1" EXTENDED_LIMITS 0.00 2550. /end CHARACTERISTIC
/begin CHARACTERISTIC CoVOM_tiEPSStopReqDeb_C "Debounce time for EPS stop request" VALUE 0x805333CA RB_Val_Ws16 327670.0 TimeDeb 0.00 327670.0 FORMAT "%8.1" EXTENDED_LIMITS -327680.0 327670.0 /end CHARACTERISTIC
/begin CHARACTERISTIC CoVOM_tiESSStopEnaDeb_C "Debounce time for the stop release of electrical supply system" VALUE 0x805333CC RB_Val_Ws16 327670.0 TimeDeb 0.00 327670.0 FORMAT "%8.1" EXTENDED_LIMITS -327680.0 327670.0 /end CHARACTERISTIC
/begin CHARACTERISTIC CoVOM_tiESSStrtReqDly_C "Delay time for start request from Battery system" VALUE 0x805333CE RB_Val_Ws16 655.3500 Time_s -327.6800 327.6700 FORMAT "%8.4" /end CHARACTERISTIC
/begin CHARACTERISTIC CoVOM_tiFrntDefrstSwtDeb_C "Front Defogger Switch Debounce time for Start Request." VALUE 0x805333D0 RB_Val_Ws16 655350.0 TimeDeb -327680.0 327670.0 FORMAT "%8.1" /end CHARACTERISTIC
/begin CHARACTERISTIC CoVOM_tiFwdGearDly_C "Time delay to reset Reverse gear status when Forward gear is engaged" VALUE 0x805333D2 RB_Val_Ws16 655.3500 Time_s -327.6800 327.6700 FORMAT "%8.4" /end CHARACTERISTIC
/begin CHARACTERISTIC CoVOM_tiMaxStopReq_C "Time window in which an engine stop is possible if the stop release are given." VALUE 0x805333D4 RB_Val_Ws32 42949672950.0 Time_ms -21474836480.0 21474836470.0 FORMAT "%13.1" /end CHARACTERISTIC
/begin CHARACTERISTIC CoVOM_tiNEngStopReqDeb_C "Debounce time for stop request, if the engine speed is below than calibratable threshold" VALUE 0x805333D8 RB_Val_Ws16 327670.0 TimeDeb 0.00 327670.0 FORMAT "%8.1" EXTENDED_LIMITS -327680.0 327670.0 /end CHARACTERISTIC
/begin CHARACTERISTIC CoVOM_tiPTStopEnaDeb_C "Debounce time for the stop release of powertrain" VALUE 0x805333DA RB_Val_Ws16 655350.0 TimeDeb -327680.0 327670.0 FORMAT "%8.1" /end CHARACTERISTIC
/begin CHARACTERISTIC CoVOM_tiPTStopReqDeb_C "Debounce time for the stop request of powertrain" VALUE 0x805333DC RB_Val_Ws16 327670.0 TimeDeb 0.00 327670.0 FORMAT "%8.1" EXTENDED_LIMITS -327680.0 327670.0 /end CHARACTERISTIC
/begin CHARACTERISTIC CoVOM_tiRstrtRelsPtd_C "Restart release inhibition delay when change from Neutral" VALUE 0x805333DE RB_Val_Ws16 327.6700 Time_s 0.00 327.6700 FORMAT "%8.4" EXTENDED_LIMITS -327.6800 327.6700 /end CHARACTERISTIC
/begin CHARACTERISTIC CoVOM_tiSeatBltOffDly_C "Time delay to goto System off after seatbelt is unfastened during idle stop" VALUE 0x805333E0 RB_Val_Ws16 655.3500 Time_s -327.6800 327.6700 FORMAT "%8.4" /end CHARACTERISTIC
/begin CHARACTERISTIC CoVOM_tiStrtReq_C "Delay time for start request detection" VALUE 0x805333E2 RB_Val_Wu8 2550. Time_ms 0.00 2550. FORMAT "%5.0" /end CHARACTERISTIC
/begin CHARACTERISTIC CoVOM_tiSysOffAutRstrt_C "System off auto restart time" VALUE 0x805333E4 RB_Val_Ws16 655.3500 Time_s -327.6800 327.6700 FORMAT "%8.4" /end CHARACTERISTIC
/begin CHARACTERISTIC CoVOM_tiTraGearStopEnaDeb_C "Debounce time for the stop release condition, if the reverse gear is not engaged." VALUE 0x805333E6 RB_Val_Ws16 327670.0 TimeDeb 0.00 327670.0 FORMAT "%8.1" EXTENDED_LIMITS -327680.0 327670.0 /end CHARACTERISTIC
/begin CHARACTERISTIC CoVOM_tiTranDly_C "Transition delay time to inhibit Idle stop when brake from ACC is off" VALUE 0x805333E8 RB_Val_Ws16 327.6700 Time_s 0.00 327.6700 FORMAT "%8.4" EXTENDED_LIMITS -327.6800 327.6700 /end CHARACTERISTIC
/begin CHARACTERISTIC CoVOM_tiTranISSEngRunng_C "Delay timer to be given in only the transition from COVOM_ST_STSP_START_PROGS to COVOM_ST_STSP_ENG_RUNNG of CoVOM_stISSEng" VALUE 0x805333EA RB_Val_Wu8 2550. Time_ms 0.00 2550. FORMAT "%5.0" /end CHARACTERISTIC
/begin CHARACTERISTIC CoVOM_tiTraStopReqDeb_C "Debounce time for transmission stop request" VALUE 0x805333EC RB_Val_Ws16 327670.0 TimeDeb 0.00 327670.0 FORMAT "%8.1" EXTENDED_LIMITS -327680.0 327670.0 /end CHARACTERISTIC
/begin CHARACTERISTIC CoVOM_tiTSStopEnaDeb_C "Debounce time for the stop release of the thermal system" VALUE 0x805333EE RB_Val_Ws16 327670.0 TimeDeb 0.00 327670.0 FORMAT "%8.1" EXTENDED_LIMITS -327680.0 327670.0 /end CHARACTERISTIC
/begin CHARACTERISTIC CoVOM_tiUpDwnSpdLim_C "The continuation time for Idle Stop frequency restriction requirement judgment" VALUE 0x805333F0 RB_Val_Wu32 42949672.9500 Time_s 0.00 42949672.9500 FORMAT "%13.4" /end CHARACTERISTIC
/begin CHARACTERISTIC CoVOM_tiVehCdnStopTrigDly_C "Time delay to check Idle stop release conditions once trigger conditions are available" VALUE 0x805333F4 RB_Val_Ws16 327.6700 Time_s 0.00 327.6700 FORMAT "%8.4" EXTENDED_LIMITS -327.6800 327.6700 /end CHARACTERISTIC
/begin CHARACTERISTIC CoVOM_tiVehVCondDeb_C "Debounce the vehicle velocity for idle stop" VALUE 0x805333F6 RB_Val_Ws16 655350.0 TimeDeb -327680.0 327670.0 FORMAT "%8.1" /end CHARACTERISTIC
/begin CHARACTERISTIC CoVOM_tiVSAStopReqDeb_C "Debounce time for VSA stop request" VALUE 0x805333F8 RB_Val_Ws16 327670.0 TimeDeb 0.00 327670.0 FORMAT "%8.1" EXTENDED_LIMITS -327680.0 327670.0 /end CHARACTERISTIC
/begin CHARACTERISTIC CoVOM_tiWaitStrtAbrt_C "Time for start abortion recognition" VALUE 0x805333FA RB_Val_Ws16 655350.0 TimeDeb -327680.0 327670.0 FORMAT "%8.1" /end CHARACTERISTIC
/begin CHARACTERISTIC CoVOM_vDurgRToDTran_C "Vehicle speed threshold to clear reverse history" VALUE 0x805333FC RB_Val_Ws16 655.3500 Vel -327.6800 327.6700 FORMAT "%8.4" /end CHARACTERISTIC
/begin CHARACTERISTIC CoVOM_vISSuppSpdThd_C "Pulled up vehcile speed during idle stop suppression" VALUE 0x805333FE RB_Val_Ws16 655.3500 Vel -327.6800 327.6700 FORMAT "%8.4" /end CHARACTERISTIC
/begin CHARACTERISTIC CoVOM_vWhlSpdThresHi_C "Idling stop carriage return vehicle speed" VALUE 0x80533400 RB_Val_Ws16 655.3500 Vel -327.6800 327.6700 FORMAT "%8.4" /end CHARACTERISTIC
/begin CHARACTERISTIC CoVOM_vWhlSpdThresLo_C "Idling stop permission vehicle speed" VALUE 0x80533402 RB_Val_Ws16 655.3500 Vel -327.6800 327.6700 FORMAT "%8.4" /end CHARACTERISTIC
/begin CHARACTERISTIC CoVOM_vXMaxEngStop_C "Vehicle speed threshold that is necessary for a stop request" VALUE 0x80533404 RB_Val_Ws16 655.3500 Vel -327.6800 327.6700 FORMAT "%8.4" /end CHARACTERISTIC
/begin CHARACTERISTIC CoVOM_vXMaxSinceStrtMin_C "Minimum vehicle speed for release of engine stop that has to be reached" VALUE 0x80533406 RB_Val_Ws16 655.3500 Vel -327.6800 327.6700 FORMAT "%8.4" /end CHARACTERISTIC
/begin CHARACTERISTIC CoVOM_vXMaxSinceStrt_C "Maximum of vehicle velocity since start" VALUE 0x80533408 RB_Val_Ws16 655.3500 Vel -327.6800 327.6700 FORMAT "%8.4" /end CHARACTERISTIC
/begin CHARACTERISTIC CoVOM_vXSpdDiff_C "The Low side hysteresis width of the vehicle speed for IS frequency restriction judgment." VALUE 0x8053340A RB_Val_Ws16 655.3500 Vel -327.6800 327.6700 FORMAT "%8.4" /end CHARACTERISTIC
/begin MEASUREMENT B_staanf_msg "Condition Start Request (StartStop)" UBYTE B_TRUE 1 100 0.00 1.00000000000 BIT_MASK 0x1 FORMAT "%13.11" ECU_ADDRESS 0x6000FA68 /end MEASUREMENT
/begin MEASUREMENT B_stoanf_msg "Condition Start-Stop stop request" UBYTE B_TRUE 1 100 0.00 1.00000000000 BIT_MASK 0x1 FORMAT "%13.11" ECU_ADDRESS 0x6000FA64 /end MEASUREMENT
/begin MEASUREMENT Conv_bCalc "flag for torque reserve and torque load calculation" UBYTE OneToOne 1 100 0.00 255.0 FORMAT "%5.1" ECU_ADDRESS 0x6000F808 /end MEASUREMENT
/begin MEASUREMENT Conv_bConvActv "Flag for converter active/inactive." UBYTE OneToOne 1 100 0.00 255.0 FORMAT "%5.1" ECU_ADDRESS 0x60014A9D /end MEASUREMENT
/begin MEASUREMENT Conv_bGearOff "Flag for load torque." UBYTE OneToOne 1 100 0.00 255.0 FORMAT "%5.1" ECU_ADDRESS 0x6000F807 /end MEASUREMENT
/begin MEASUREMENT Conv_bTrbnSpdCan "Flag for turbine speed using CAN." UBYTE OneToOne 1 100 0.00 255.0 FORMAT "%5.1" ECU_ADDRESS 0x6000F806 /end MEASUREMENT
/begin MEASUREMENT Conv_bTrqLdCan "Flag for load torque using CAN." UBYTE OneToOne 1 100 0.00 255.0 FORMAT "%5.1" ECU_ADDRESS 0x6000F805 /end MEASUREMENT
/begin MEASUREMENT Conv_bTrqLdFlt "Flag for filtered load torque." UBYTE OneToOne 1 100 0.00 255.0 FORMAT "%5.1" ECU_ADDRESS 0x60014A9E /end MEASUREMENT
/begin MEASUREMENT Conv_bTrqResvBrkEnd "Flag for load reserve after braking." UBYTE OneToOne 1 100 0.00 255.0 FORMAT "%5.1" ECU_ADDRESS 0x60014A9F /end MEASUREMENT
/begin MEASUREMENT Conv_bTrqResvLvrOff "Flag for load reserve in low idle." UBYTE OneToOne 1 100 0.00 255.0 FORMAT "%5.1" ECU_ADDRESS 0x60014AA0 /end MEASUREMENT
/begin MEASUREMENT Conv_cntrPostLve "Counter checking for Post Drive Leave" UBYTE OneToOne 1 100 0.00 255.0 FORMAT "%5.1" ECU_ADDRESS 0x6000F0A8 /end MEASUREMENT
/begin MEASUREMENT Conv_facOilTempDepTrqPmp "Oil temperature dependant factor." SWORD TrqToNSqr 1 100 -0.003276800 0.003276700 FORMAT "%11.9" ECU_ADDRESS 0x6000922E /end MEASUREMENT
/begin MEASUREMENT Conv_rTrq "Converter transmission ratio." SWORD TransR 1 100 -327.6800 327.6700 FORMAT "%8.4" ECU_ADDRESS 0x600147E4 /end MEASUREMENT
/begin MEASUREMENT Conv_tiTDeptRevLvrDebNegNeut "Debounce time when transition from reverse gear to Neutral." SWORD TimeDeb 1 100 -327680.0 327670.0 FORMAT "%8.1" ECU_ADDRESS 0x6000922C /end MEASUREMENT
/begin MEASUREMENT Conv_tiTDeptRevLvrDebNegPark "Debounce time when transition from reverse gear to Park." SWORD TimeDeb 1 100 -327680.0 327670.0 FORMAT "%8.1" ECU_ADDRESS 0x6000922A /end MEASUREMENT
/begin MEASUREMENT Conv_tiTDpdtLvrDrvRevDebPos "Time debound of gear lever shift from drive to reverse" SWORD TimeDeb 1 100 -327680.0 327670.0 FORMAT "%8.1" ECU_ADDRESS 0x60009228 /end MEASUREMENT
/begin MEASUREMENT Conv_tiTDpdtLvrRevDrvDebPos "Time debound of gear lever shift from reverse to drive" SWORD TimeDeb 1 100 -327680.0 327670.0 FORMAT "%8.1" ECU_ADDRESS 0x60009226 /end MEASUREMENT
/begin MEASUREMENT Conv_tiTempDepLvrDebNeg "Debounce time temperature no gear." SWORD TimeDeb 1 100 -327680.0 327670.0 FORMAT "%8.1" ECU_ADDRESS 0x60009224 /end MEASUREMENT
/begin MEASUREMENT Conv_tiTempDepLvrDebPos "Debounce temperature gear engaged." SWORD TimeDeb 1 100 -327680.0 327670.0 FORMAT "%8.1" ECU_ADDRESS 0x60009222 /end MEASUREMENT
/begin MEASUREMENT Conv_tiTempDepRevLvrDebPos "Debounce time temperature reverse gear." SWORD TimeDeb 1 100 -327680.0 327670.0 FORMAT "%8.1" ECU_ADDRESS 0x600147E8 /end MEASUREMENT
/begin MEASUREMENT Conv_tOil "Converter Oil temperature" SWORD Temp_Cels 1 100 -3549.940 3003.560 FORMAT "%8.3" ECU_ADDRESS 0x600147E6 /end MEASUREMENT
/begin MEASUREMENT Conv_tOilBuf "Buffer for oil temperature" SWORD Temp_Cels 1 100 -3549.940 3003.560 FORMAT "%8.3" ECU_ADDRESS 0x60007ED4 /end MEASUREMENT
/begin MEASUREMENT Conv_tqResvTDeptDrvRev "Temperature dependant reserve torque of gear lever shift from drive to reverse and vice versa" SWORD Trq 1 100 -3276.800 3276.700 FORMAT "%8.3" ECU_ADDRESS 0x60009220 /end MEASUREMENT
/begin MEASUREMENT Conv_trqLdLvrPosNeutr "Load torque for no gear engaged." SWORD Trq 1 100 -3276.800 3276.700 FORMAT "%8.3" ECU_ADDRESS 0x6000921E /end MEASUREMENT
/begin MEASUREMENT Conv_trqLdRevLvrPos "Load torque for gear engaged." SWORD Trq 1 100 -3276.800 3276.700 FORMAT "%8.3" ECU_ADDRESS 0x600147F0 /end MEASUREMENT
/begin MEASUREMENT Conv_trqLdTempDepLim "Temperature dependant value for limitation of load torque." SWORD Trq 1 100 -3276.800 3276.700 FORMAT "%8.3" ECU_ADDRESS 0x6000921C /end MEASUREMENT
/begin MEASUREMENT Conv_trqLosDfftl "Differential torque losses" SWORD TrqPrpHigh 1 100 -3276.800 3276.700 FORMAT "%8.3" ECU_ADDRESS 0x6000921A /end MEASUREMENT
/begin MEASUREMENT Conv_trqResvTempDep "Temperature dependant reserve torque." SWORD Trq 1 100 -3276.800 3276.700 FORMAT "%8.3" ECU_ADDRESS 0x600147F4 /end MEASUREMENT
/begin MEASUREMENT CoPOM_AbortStrtrER_I "Class instance to detect the aborted start event" UBYTE uint8 1 100 0.00 255.0 FORMAT "%5.1" ECU_ADDRESS 0x6000F0A0 /end MEASUREMENT
/begin MEASUREMENT CoPOM_CnclStrtReqTON_I.XOld "Delay for cancellation of first start request when no new start type is present / Delay for cancellation of first start request when no new start type is present" UBYTE OneToOne 1 100 0.00 255.0 FORMAT "%5.1" ECU_ADDRESS 0x500013E8 /end MEASUREMENT
/begin MEASUREMENT CoPOM_CnclStrtReqTON_I.Timer "Delay for cancellation of first start request when no new start type is present / Delay for cancellation of first start request when no new start type is present" SLONG OneToOne 1 100 -2147483648.00 2147483647.00 FORMAT "%13.2" ECU_ADDRESS 0x500013EC /end MEASUREMENT
/begin MEASUREMENT CoPOM_cntAbortStrtr "Count of aborted start for the conventional starter." UBYTE OneToOne 1 100 0.00 255.0 FORMAT "%5.1" ECU_ADDRESS 0x6003660F /end MEASUREMENT
/begin MEASUREMENT CoPOM_cntAbortStrtrOld "Protected Count of aborted start for the conventional starter, when the driver does a quick T15 offon." UBYTE OneToOne 1 100 0.00 255.0 FORMAT "%5.1" ECU_ADDRESS 0x6003660E /end MEASUREMENT
/begin MEASUREMENT CoPOM_DrvrStrtReqRSFF_I "Class instance to memorise the driver demand" UBYTE uint8 1 100 0.00 255.0 FORMAT "%5.1" ECU_ADDRESS 0x6000F0A7 /end MEASUREMENT
/begin MEASUREMENT CoPOM_FirstStrtRelsEF_I "Class instance to detect the Closure of drivetrain" UBYTE uint8 1 100 0.00 255.0 FORMAT "%5.1" ECU_ADDRESS 0x6000F0A6 /end MEASUREMENT
/begin MEASUREMENT CoPOM_flgAbortStrtr "Flag indicating the abort conditions for the conventional starter." UBYTE B_TRUE 1 100 0.00 1.00000000000 BIT_MASK 0x1 FORMAT "%13.11" ECU_ADDRESS 0x70000389 /end MEASUREMENT
/begin MEASUREMENT CoPOM_flgAbortStrtrLimReachd "Flag to indicate the fault starts count threshold has reached, so a different start behaviour needs to be triggered." UBYTE B_TRUE 1 100 0.00 1.00000000000 BIT_MASK 0x1 FORMAT "%13.11" ECU_ADDRESS 0x70000388 /end MEASUREMENT
/begin MEASUREMENT CoPOM_flgCnclStrtReq "Flag to indicate cancellation of first start request when no new start type is present" UBYTE B_TRUE 1 100 0.00 1.00000000000 BIT_MASK 0x1 FORMAT "%13.11" ECU_ADDRESS 0x7000038E /end MEASUREMENT
/begin MEASUREMENT CoPOM_flgMemdDrvrStrtReq "Flag to indicate the memorised driver start request" UBYTE B_TRUE 1 100 0.00 1.00000000000 BIT_MASK 0x1 FORMAT "%13.11" ECU_ADDRESS 0x7000038D /end MEASUREMENT
/begin MEASUREMENT CoPOM_flgMemdDrvrStrtReqCncl "Flag to indicate cancellation of the memorised driver start request" UBYTE B_TRUE 1 100 0.00 1.00000000000 BIT_MASK 0x1 FORMAT "%13.11" ECU_ADDRESS 0x7000038C /end MEASUREMENT
/begin MEASUREMENT CoPOM_flgMemdRstStrtReq "Flag to indicate automatic restart request when there is an undervoltage reset" UBYTE B_TRUE 1 100 0.00 1.00000000000 BIT_MASK 0x1 FORMAT "%13.11" ECU_ADDRESS 0x7000038B /end MEASUREMENT
/begin MEASUREMENT CoPOM_flgPtStrtRels "Release from powertrain for starting the combustion engine" UBYTE B_TRUE 1 100 0.00 1.00000000000 BIT_MASK 0x1 FORMAT "%13.11" ECU_ADDRESS 0x7000038A /end MEASUREMENT
/begin MEASUREMENT CoPOM_flgStrtPrms "Permission for starting the combustion engine" UBYTE B_TRUE 1 100 0.00 1.00000000000 BIT_MASK 0x1 FORMAT "%13.11" ECU_ADDRESS 0x70000387 /end MEASUREMENT
/begin MEASUREMENT CoPOM_flgStrtrStrtRels "Release from the conventional starter for starting the combustion engine" UBYTE B_TRUE 1 100 0.00 1.00000000000 BIT_MASK 0x1 FORMAT "%13.11" ECU_ADDRESS 0x70000386 /end MEASUREMENT
/begin MEASUREMENT CoPOM_NxtStrtAftAbortTOFF_I.XOld "Ensuring a certain delay for allowing next start after an abort / class variable" UBYTE OneToOne 1 100 0.00 255.0 FORMAT "%5.1" ECU_ADDRESS 0x500013F0 /end MEASUREMENT
/begin MEASUREMENT CoPOM_NxtStrtAftAbortTOFF_I.Timer "Ensuring a certain delay for allowing next start after an abort / class variable" SLONG OneToOne 1 100 -2147483648.00 2147483647.00 FORMAT "%13.2" ECU_ADDRESS 0x500013F4 /end MEASUREMENT
/begin MEASUREMENT CoPOM_PanicStrtTON_I.XOld "Delay timer to debounce the crank request from driver for indicating Panic start / Delay timer to debounce the crank request from driver for indicating Panic start" UBYTE OneToOne 1 100 0.00 255.0 FORMAT "%5.1" ECU_ADDRESS 0x500013F8 /end MEASUREMENT
/begin MEASUREMENT CoPOM_PanicStrtTON_I.Timer "Delay timer to debounce the crank request from driver for indicating Panic start / Delay timer to debounce the crank request from driver for indicating Panic start" SLONG OneToOne 1 100 -2147483648.00 2147483647.00 FORMAT "%13.2" ECU_ADDRESS 0x500013FC /end MEASUREMENT
/begin MEASUREMENT CoPOM_RstStrtReqRSFF_I "Class to latch the undervoltage reset event, to trigger an automated restart." UBYTE uint8 1 100 0.00 255.0 FORMAT "%5.1" ECU_ADDRESS 0x6000F0A5 /end MEASUREMENT
/begin MEASUREMENT CoPOM_stEngFirstStrtReq "Engine First start request (via T50)" UBYTE RBPtPwrTrn_stEngReq_VERB 1 100 0.00 4.00000000000 FORMAT "%13.11" ECU_ADDRESS 0x6000FF7E /end MEASUREMENT
/begin MEASUREMENT CoPOM_stEngFirstStrtReqOld "Previous Engine First start request (via T50)" UBYTE RBPtPwrTrn_stEngReq_VERB 1 100 0.00 4.00000000000 FORMAT "%13.11" ECU_ADDRESS 0x6000F0A4 /end MEASUREMENT
/begin MEASUREMENT CoPOM_stEngSpstReq "Request to start or stop the combustion engine" UBYTE RBPtPwrTrn_stEngReq_VERB 1 100 0.00 4.00000000000 FORMAT "%13.11" ECU_ADDRESS 0x6000FF7D /end MEASUREMENT
/begin MEASUREMENT CoPOM_StrtReqCnclTOFF_I.XOld "Class for cancellation of memorized start request if start releaseis not given within specified time of T50 edge rising. / Class for cancellation of memorized start request if start release is not given within specified time of T50 edge rising." UBYTE OneToOne 1 100 0.00 255.0 FORMAT "%5.1" ECU_ADDRESS 0x50001400 /end MEASUREMENT
/begin MEASUREMENT CoPOM_StrtReqCnclTOFF_I.Timer "Class for cancellation of memorized start request if start releaseis not given within specified time of T50 edge rising. / Class for cancellation of memorized start request if start release is not given within specified time of T50 edge rising." SLONG OneToOne 1 100 -2147483648.00 2147483647.00 FORMAT "%13.2" ECU_ADDRESS 0x50001404 /end MEASUREMENT
/begin MEASUREMENT CoPOM_StrtReqPreDrvCnclTOFF_I.XOld "Class for cancellation of memorized start request if transition from Pre-Drive to Drive takes more than threshold duration during T50 request. / Class for cancellation of memorized start request if transition from Pre-Drive to Drive takes more than threshold duration during T50 request." UBYTE OneToOne 1 100 0.00 255.0 FORMAT "%5.1" ECU_ADDRESS 0x50001408 /end MEASUREMENT
/begin MEASUREMENT CoPOM_StrtReqPreDrvCnclTOFF_I.Timer "Class for cancellation of memorized start request if transition from Pre-Drive to Drive takes more than threshold duration during T50 request. / Class for cancellation of memorized start request if transition from Pre-Drive to Drive takes more than threshold duration during T50 request." SLONG OneToOne 1 100 -2147483648.00 2147483647.00 FORMAT "%13.2" ECU_ADDRESS 0x5000140C /end MEASUREMENT
/begin MEASUREMENT CoPOM_StrtrMaxAbortTON_I.XOld "Delay for checking how long the starter is enabled / class variable" UBYTE OneToOne 1 100 0.00 255.0 FORMAT "%5.1" ECU_ADDRESS 0x50001410 /end MEASUREMENT
/begin MEASUREMENT CoPOM_StrtrMaxAbortTON_I.Timer "Delay for checking how long the starter is enabled / class variable" SLONG OneToOne 1 100 -2147483648.00 2147483647.00 FORMAT "%13.2" ECU_ADDRESS 0x50001414 /end MEASUREMENT
/begin MEASUREMENT CoPOM_T50RstER_I "Class to identify the undervoltage reset (T50.Bit1)" UBYTE uint8 1 100 0.00 255.0 FORMAT "%5.1" ECU_ADDRESS 0x6000F0A3 /end MEASUREMENT
/begin MEASUREMENT CoPOM_T50St0EF_I "Class to identify the release of cranking request (T50.Bit0 = 0) from driver" UBYTE uint8 1 100 0.00 255.0 FORMAT "%5.1" ECU_ADDRESS 0x6000F0A2 /end MEASUREMENT
/begin MEASUREMENT CoPOM_T50St0ER_I "Class to identify the cranking request (T50.Bit0 = 1) from driver" UBYTE uint8 1 100 0.00 255.0 FORMAT "%5.1" ECU_ADDRESS 0x6000F0A1 /end MEASUREMENT
/begin MEASUREMENT CoPOM_tqStrtDevStrtr "Available starting torque starter" SWORD Trq 1 100 -3276.800 3276.700 FORMAT "%8.3" ECU_ADDRESS 0x60009B5E /end MEASUREMENT
/begin MEASUREMENT CoPT_rClgDes "Whole cool demand of the impulse rope for the ventilator" SWORD Prc 1 100 -400.0000 399.9878 FORMAT "%8.4" ECU_ADDRESS 0x60009242 /end MEASUREMENT
/begin MEASUREMENT CoPT_tClntDes "Desired coolant temperature of power train" SWORD Temp_Cels 1 100 -3549.940 3003.560 FORMAT "%8.3" ECU_ADDRESS 0x60009240 /end MEASUREMENT
/begin MEASUREMENT CoTemp_rClgDes "Cooling requirement of the combustion" SWORD Prc 1 100 -400.0000 399.9878 FORMAT "%8.4" ECU_ADDRESS 0x6000923A /end MEASUREMENT
/begin MEASUREMENT CoTemp_tEngDes "Coolant temperature of combustion engine" SWORD Temp_Cels 1 100 -3549.940 3003.560 FORMAT "%8.3" ECU_ADDRESS 0x60009238 /end MEASUREMENT
/begin MEASUREMENT CoTS_rClgDem "requested relative cooling performance" SWORD Prc 1 100 -400.0000 399.9878 FORMAT "%8.4" ECU_ADDRESS 0x6000923E /end MEASUREMENT
/begin MEASUREMENT CoTS_rhoAir "Air Density" SWORD Dens_q0p001_COMPU 1 100 -32.76800 32.76700 FORMAT "%8.5" ECU_ADDRESS 0x60009B54 /end MEASUREMENT
/begin MEASUREMENT CoTS_stSSEStopInhb "single bit coded 8 bit shut-off information message to provide Auto-stop inhibition information from thermal system coordinator" UBYTE OneToOne 1 100 0.00 255.0 FORMAT "%5.1" ECU_ADDRESS 0x6000FF77 /end MEASUREMENT
/begin MEASUREMENT CoTS_tClntDesFlt "Filtered value of CoVeh_tClntDes" SWORD Temp_Cels 1 100 -3549.940 3003.560 FORMAT "%8.3" ECU_ADDRESS 0x60007ED2 /end MEASUREMENT
/begin MEASUREMENT CoTS_tClntEngOutDes "desired coolant temperature" SWORD Temp_Cels 1 100 -3549.940 3003.560 FORMAT "%8.3" ECU_ADDRESS 0x6000923C /end MEASUREMENT
/begin MEASUREMENT CoTS_trqMaxAC "Switch off condition for AC" SWORD Trq 1 100 -3276.800 3276.700 FORMAT "%8.3" ECU_ADDRESS 0x600147DA /end MEASUREMENT
/begin MEASUREMENT CoVeh_rClgDes "Desired relative air mass flow" SWORD Prc 1 100 -400.0000 399.9878 FORMAT "%8.4" ECU_ADDRESS 0x60009236 /end MEASUREMENT
/begin MEASUREMENT CoVeh_stEngStopOrd "Stop order to the combustion engine" UBYTE OneToOne 1 100 0.00 255.0 FORMAT "%5.1" ECU_ADDRESS 0x6000FF70 /end MEASUREMENT
/begin MEASUREMENT CoVeh_stEngStrtOrd "Order to Eng for engine start" UBYTE OneToOne 1 100 0.00 255.0 FORMAT "%5.1" ECU_ADDRESS 0x6000FF6F /end MEASUREMENT
/begin MEASUREMENT CoVeh_tClntDes "Desired coolant temperature" SWORD Temp_Cels 1 100 -3549.940 3003.560 FORMAT "%8.3" ECU_ADDRESS 0x60009234 /end MEASUREMENT
/begin MEASUREMENT CoVMD_bCtOffPhdCrCtl "Status fuel cut off prohibited by cruise control" UBYTE B_TRUE 1 100 0.00 1.00000000000 BIT_MASK 0x1 FORMAT "%13.11" ECU_ADDRESS 0x6000F9FC /end MEASUREMENT
/begin MEASUREMENT CoVMD_bCtOffPhdLLim "Status fuel cut off prohibited by longitudinal limiter (LLim)" UBYTE B_TRUE 1 100 0.00 1.00000000000 BIT_MASK 0x1 FORMAT "%13.11" ECU_ADDRESS 0x6000F9FB /end MEASUREMENT
/begin MEASUREMENT CoVMD_cntrAryRst "Reset array counter" UBYTE OneToOne 1 100 0.00 255.0 FORMAT "%5.1" ECU_ADDRESS 0x6000F09F /end MEASUREMENT
/begin MEASUREMENT CoVMD_cntrIDASFailDetn "IDAS failure times" UWORD OneToOne 1 100 0.00 65535.00 FORMAT "%8.2" ECU_ADDRESS 0x60007ED0 /end MEASUREMENT
/begin MEASUREMENT CoVMD_cntrReIni "Local counter to signal the execution of ReIni task" UBYTE OneToOne 1 100 0.00 255.0 FORMAT "%5.1" ECU_ADDRESS 0x6000F09E /end MEASUREMENT
/begin MEASUREMENT CoVMD_facACC "Factor for ramping APP ratio for cruise control" SLONG Fact 1 100 -262144.000000 262143.999878 FORMAT "%13.6" ECU_ADDRESS 0x600030F8 /end MEASUREMENT
/begin MEASUREMENT CoVMD_facACCStep "Factor for step change in slope used for ramping" SLONG Fact 1 100 -262144.000000 262143.999878 FORMAT "%13.6" ECU_ADDRESS 0x600030F4 /end MEASUREMENT
/begin MEASUREMENT CoVMD_facAppMaxCmp "App max compensation factor" SWORD Fact 1 100 -4.000000 3.999878 FORMAT "%8.6" ECU_ADDRESS 0x60007ECE /end MEASUREMENT
/begin MEASUREMENT CoVMD_facCompAcs "Accessory compensation factor" SWORD Fact 1 100 -4.000000 3.999878 FORMAT "%8.6" ECU_ADDRESS 0x60009B52 /end MEASUREMENT
/begin MEASUREMENT CoVMD_facCompAcsCMTCLsAEB "Factor of accessory compensation by CMTC and LsAEB" SWORD Fact 1 100 -4.000000 3.999878 FORMAT "%8.6" ECU_ADDRESS 0x60009B50 /end MEASUREMENT
/begin MEASUREMENT CoVMD_facCompAcsCrCtl "Factor of accessory compensation by CrCtl" SWORD Fact 1 100 -4.000000 3.999878 FORMAT "%8.6" ECU_ADDRESS 0x60009B4E /end MEASUREMENT
/begin MEASUREMENT CoVMD_facCompAcsLLim "Factor of accessory compensation by LLim" SWORD Fact 1 100 -4.000000 3.999878 FORMAT "%8.6" ECU_ADDRESS 0x60009B4C /end MEASUREMENT
/begin MEASUREMENT CoVMD_facLLim "Factor for ramping APP ratio for Speed limiter" SLONG Fact 1 100 -262144.000000 262143.999878 FORMAT "%13.6" ECU_ADDRESS 0x600030F0 /end MEASUREMENT
/begin MEASUREMENT CoVMD_facLLimStep "Factor for step change in slope used for ramping" SLONG Fact 1 100 -262144.000000 262143.999878 FORMAT "%13.6" ECU_ADDRESS 0x600030EC /end MEASUREMENT
/begin MEASUREMENT CoVMD_facModSwt "Factor for ramping of torque value during change in drive mode" SLONG Fact 1 100 -262144.000000 262143.999878 FORMAT "%13.6" ECU_ADDRESS 0x600030E8 /end MEASUREMENT
/begin MEASUREMENT CoVMD_facModSwtStep "Factor for step change in slope used for ramping of torque during change in drive mode" SLONG Fact 1 100 -262144.000000 262143.999878 FORMAT "%13.6" ECU_ADDRESS 0x600030E4 /end MEASUREMENT
/begin MEASUREMENT CoVMD_flgACCRampActv "Status of APP ratio for cruise control ramping" UBYTE B_TRUE 1 100 0.00 1.00000000000 BIT_MASK 0x1 FORMAT "%13.11" ECU_ADDRESS 0x6000F09D /end MEASUREMENT
/begin MEASUREMENT CoVMD_flgBrkDetn "Flag indicates brake detection" UBYTE B_TRUE 1 100 0.00 1.00000000000 BIT_MASK 0x1 FORMAT "%13.11" ECU_ADDRESS 0x6000F09C /end MEASUREMENT
/begin MEASUREMENT CoVMD_flgBrkFailDeb "Flag indicates brake failure detected" UBYTE B_TRUE 1 100 0.00 1.00000000000 BIT_MASK 0x1 FORMAT "%13.11" ECU_ADDRESS 0x6000F09B /end MEASUREMENT
/begin MEASUREMENT CoVMD_flgDrvActv "Drive active status based on CoVMD_r" UBYTE B_TRUE 1 100 0.00 1.00000000000 BIT_MASK 0x1 FORMAT "%13.11" ECU_ADDRESS 0x6000F09A /end MEASUREMENT
/begin MEASUREMENT CoVMD_flgIDASCntrRst "Flag indicates counter is requested to reset" UBYTE B_TRUE 1 100 0.00 1.00000000000 BIT_MASK 0x1 FORMAT "%13.11" ECU_ADDRESS 0x6000F099 /end MEASUREMENT
/begin MEASUREMENT CoVMD_flgIDASFailBrkCdn "Flag indicates brake is pressed under certain vehicle speed condition" UBYTE B_TRUE 1 100 0.00 1.00000000000 BIT_MASK 0x1 FORMAT "%13.11" ECU_ADDRESS 0x6000F098 /end MEASUREMENT
/begin MEASUREMENT CoVMD_flgIDASFailDetn "Flag indicates IDAS faillure is detected" UBYTE B_TRUE 1 100 0.00 1.00000000000 BIT_MASK 0x1 FORMAT "%13.11" ECU_ADDRESS 0x6000F9FA /end MEASUREMENT
/begin MEASUREMENT CoVMD_flgIDASFailTqCdn "Flag indicates high torque is detected" UBYTE B_TRUE 1 100 0.00 1.00000000000 BIT_MASK 0x1 FORMAT "%13.11" ECU_ADDRESS 0x6000F097 /end MEASUREMENT
/begin MEASUREMENT CoVMD_flgIDASMTCluOffEna "IDAS MT clutch Off calculation enable flag" UBYTE B_TRUE 1 100 0.00 1.00000000000 BIT_MASK 0x1 FORMAT "%13.11" ECU_ADDRESS 0x6000F9F9 /end MEASUREMENT
/begin MEASUREMENT CoVMD_flgIdleDrv "Condition idling active" UBYTE B_TRUE 1 100 0.00 1.00000000000 BIT_MASK 0x1 FORMAT "%13.11" ECU_ADDRESS 0x6000F9F8 /end MEASUREMENT
/begin MEASUREMENT CoVMD_flgRampLLimActv "Status of APP ratio for speed limiter ramping" UBYTE B_TRUE 1 100 0.00 1.00000000000 BIT_MASK 0x1 FORMAT "%13.11" ECU_ADDRESS 0x6000F096 /end MEASUREMENT
/begin MEASUREMENT CoVMD_nDesVal "IDAS MT Clutch Off desired engine speed" SWORD EngNCrCtl 1 100 -32768.00 32767.00 FORMAT "%8.2" ECU_ADDRESS 0x60007ECC /end MEASUREMENT
/begin MEASUREMENT CoVMD_nTrqOffLimA "ACC Brake off engine speed limitation" SWORD EngNCrCtl 1 100 -32768.00 32767.00 FORMAT "%8.2" ECU_ADDRESS 0x60007ECA /end MEASUREMENT
/begin MEASUREMENT CoVMD_nTrqOffLimB "ACC Brake on engine speed limitation" UWORD EngNCrCtl 1 100 0.00 65535.00 FORMAT "%8.2" ECU_ADDRESS 0x60007EC8 /end MEASUREMENT
/begin MEASUREMENT CoVMD_r "Conversion ratio for LLim or CrCtl" SWORD Prc 1 100 -400.0000 399.9878 FORMAT "%8.4" ECU_ADDRESS 0x60009B4A /end MEASUREMENT
/begin MEASUREMENT CoVMD_ratCrsCtrlLLimIDASReq "Maximum possible IDAS Cruise control and Speed limiter ratio" SWORD Prc 1 100 -400.0000 399.9878 FORMAT "%8.4" ECU_ADDRESS 0x60009B3C /end MEASUREMENT
/begin MEASUREMENT CoVMD_ratCvtEco2 "CVT ECO 2 mode ratio" SWORD Prc 1 100 -400.0000 399.9878 FORMAT "%8.4" ECU_ADDRESS 0x60007EC6 /end MEASUREMENT
/begin MEASUREMENT CoVMD_ratIDASCVTEco "IDAS CVT ECO mode ratio" SWORD Prc 1 100 -400.0000 399.9878 FORMAT "%8.4" ECU_ADDRESS 0x60007EC4 /end MEASUREMENT
/begin MEASUREMENT CoVMD_ratIDASCVTNorm "IDAS CVT normal mode ratio" SWORD Prc 1 100 -400.0000 399.9878 FORMAT "%8.4" ECU_ADDRESS 0x60007EC2 /end MEASUREMENT
/begin MEASUREMENT CoVMD_ratIDASCvtNorm2 "IDAS CVT normal mode 2 ratio" SWORD Prc 1 100 -400.0000 399.9878 FORMAT "%8.4" ECU_ADDRESS 0x60007EC0 /end MEASUREMENT
/begin MEASUREMENT CoVMD_ratIDASMTEco "IDAS MT Eco mode ratio" SWORD Prc 1 100 -400.0000 399.9878 FORMAT "%8.4" ECU_ADDRESS 0x60007EBE /end MEASUREMENT
/begin MEASUREMENT CoVMD_ratIDASMTNorm "IDAS MT normal mode ratio" SWORD Prc 1 100 -400.0000 399.9878 FORMAT "%8.4" ECU_ADDRESS 0x60007EBC /end MEASUREMENT
/begin MEASUREMENT CoVMD_ratIDASReq "Maximum possible IDAS Cruise control and Speed limiter ratio" SWORD Prc 1 100 -400.0000 399.9878 FORMAT "%8.4" ECU_ADDRESS 0x60007EBA /end MEASUREMENT
/begin MEASUREMENT CoVMD_ratIDASReqLim "Ratio for IDAS Cruise control and Speed limiter Request" SWORD Prc 1 100 -400.0000 399.9878 FORMAT "%8.4" ECU_ADDRESS 0x60007EB8 /end MEASUREMENT
/begin MEASUREMENT CoVMD_ratIDASReqMax "Maximum IDAS request accelerator ratio" SWORD Prc 1 100 -400.0000 399.9878 FORMAT "%8.4" ECU_ADDRESS 0x60007EB6 /end MEASUREMENT
/begin MEASUREMENT CoVMD_ratIDASReqNewTmp "Temporary value of APP ratio for IDAS cruise control based on target ratio" SWORD Prc 1 100 -400.0000 399.9878 FORMAT "%8.4" ECU_ADDRESS 0x60007EB4 /end MEASUREMENT
/begin MEASUREMENT CoVMD_ratIDASReqOld "Old value of maximum possible IDAS Cruise control and Speed limiter ratio" SWORD Prc 1 100 -400.0000 399.9878 FORMAT "%8.4" ECU_ADDRESS 0x60007EB2 /end MEASUREMENT
/begin MEASUREMENT CoVMD_ratIDASReqOldTmp "Temporary value of APP ratio for IDAS cruise control based on current ratio" SWORD Prc 1 100 -400.0000 399.9878 FORMAT "%8.4" ECU_ADDRESS 0x60007EB0 /end MEASUREMENT
/begin MEASUREMENT CoVMD_ratVirtMax "Maximum virtual accelerator ratio" SWORD Prc 1 100 -400.0000 399.9878 FORMAT "%8.4" ECU_ADDRESS 0x60007EAE /end MEASUREMENT
/begin MEASUREMENT CoVMD_rCMTCLsAEBReq "Maximum possible IDAS CMTC and LsAEB ratio" SWORD Prc 1 100 -400.0000 399.9878 FORMAT "%8.4" ECU_ADDRESS 0x60009B48 /end MEASUREMENT
/begin MEASUREMENT CoVMD_rCrCtl "APP request of cruise control" SWORD Prc 1 100 -400.0000 399.9878 FORMAT "%8.4" ECU_ADDRESS 0x60009B46 /end MEASUREMENT
/begin MEASUREMENT CoVMD_rCrCtlACCReq "Acc pedal position for CC/ACC" SWORD Prc 1 100 -400.0000 399.9878 FORMAT "%8.4" ECU_ADDRESS 0x60009B44 /end MEASUREMENT
/begin MEASUREMENT CoVMD_rIDASCrsCluOffReq "IDAS MT Clutch off target ratio" SWORD APPCrCtl1 1 100 0.00 163.8350 FORMAT "%8.4" ECU_ADDRESS 0x60007EAC /end MEASUREMENT
/begin MEASUREMENT CoVMD_rIDASReqTmp "Temporary value of accelerator pedal position from IDAS" SWORD Prc 1 100 -400.0000 399.9878 FORMAT "%8.4" ECU_ADDRESS 0x60007EAA /end MEASUREMENT
/begin MEASUREMENT CoVMD_rLLimACCReq "Acc pedal position for ASL" SWORD Prc 1 100 -400.0000 399.9878 FORMAT "%8.4" ECU_ADDRESS 0x60009B42 /end MEASUREMENT
/begin MEASUREMENT CoVMD_rReqChg "Variable for Gear Change APP request value" SWORD APPCrCtl1 1 100 0.00 163.8350 FORMAT "%8.4" ECU_ADDRESS 0x60009B40 /end MEASUREMENT
/begin MEASUREMENT CoVMD_rSptReqChg "Variable for Gear Change APP request value for sport mode" SWORD APPCrCtl1 1 100 0.00 163.8350 FORMAT "%8.4" ECU_ADDRESS 0x60009B3E /end MEASUREMENT
/begin MEASUREMENT CoVMD_rTq "IDAS Filtered torque ratio" SWORD TransR 1 100 -327.6800 327.6700 FORMAT "%8.4" ECU_ADDRESS 0x60007EA8 /end MEASUREMENT
/begin MEASUREMENT CoVMD_rTqFild "Total drive train ratio of engine - wheel after filtering" SWORD TransR 1 100 -327.6800 327.6700 FORMAT "%8.4" ECU_ADDRESS 0x60007EA6 /end MEASUREMENT
/begin MEASUREMENT CoVMD_rVirtApp "Virtual App using to calculate time constant of PT1" SWORD Prc 1 100 -400.0000 399.9878 FORMAT "%8.4" ECU_ADDRESS 0x60007EA4 /end MEASUREMENT
/begin MEASUREMENT CoVMD_stLoLimActv "Low limit active status" UBYTE B_TRUE 1 100 0.00 1.00000000000 BIT_MASK 0x1 FORMAT "%13.11" ECU_ADDRESS 0x6000F9F7 /end MEASUREMENT
/begin MEASUREMENT CoVMD_stRampActv "Status of torque ramp during mode change" UBYTE B_TRUE 1 100 0.00 1.00000000000 BIT_MASK 0x1 FORMAT "%13.11" ECU_ADDRESS 0x6000F095 /end MEASUREMENT
/begin MEASUREMENT CoVMD_stReqCrCtl "Coordinated status of acceleration request." UBYTE B_TRUE 1 100 0.00 1.00000000000 BIT_MASK 0x1 FORMAT "%13.11" ECU_ADDRESS 0x6000F9F6 /end MEASUREMENT
/begin MEASUREMENT CoVMD_stSwtCCASLTqSeln "Switch to select if driving assistance functions are calculated in Engine ECU" UBYTE OneToOne 1 100 0.00 255.0 FORMAT "%5.1" ECU_ADDRESS 0x6000FF76 /end MEASUREMENT
/begin MEASUREMENT CoVMD_swtCCSel "Switch for Cruise Control Selection" UBYTE OneToOne 1 100 0.00 255.0 FORMAT "%5.1" ECU_ADDRESS 0x6000FF75 /end MEASUREMENT
/begin MEASUREMENT CoVMD_tiACCRampSlop "Time period within which ramping of APP raito should be finished" SWORD Time_s 1 100 -327.6800 327.6700 FORMAT "%8.4" ECU_ADDRESS 0x60007EA2 /end MEASUREMENT
/begin MEASUREMENT CoVMD_tiBrkFailDeb "Delay time to determine brake is operated for IDAS failure detection" UWORD t_q0p01 1 100 0.00 655.3500 FORMAT "%8.4" ECU_ADDRESS 0x60007EA0 /end MEASUREMENT
/begin MEASUREMENT CoVMD_tiIDASReqLim "Filter time constant for IDAS Cruise control and Speed Request Ratio" SWORD Time_s 1 100 -327.6800 327.6700 FORMAT "%8.4" ECU_ADDRESS 0x60007E9E /end MEASUREMENT
/begin MEASUREMENT CoVMD_tiLLimRampSlop "Time period within which ramping of APP raito should be finished" SWORD Time_s 1 100 -327.6800 327.6700 FORMAT "%8.4" ECU_ADDRESS 0x60007E9C /end MEASUREMENT
/begin MEASUREMENT CoVMD_tiTqFild "Filter time constant for drive train ratio of engine - wheel" SWORD Time_s 1 100 -327.6800 327.6700 FORMAT "%8.4" ECU_ADDRESS 0x60007E9A /end MEASUREMENT
/begin MEASUREMENT CoVMD_tqBasDif "Torque base difference" SWORD Trq 1 100 -3276.800 3276.700 FORMAT "%8.3" ECU_ADDRESS 0x60007E98 /end MEASUREMENT
/begin MEASUREMENT CoVMD_tqBasFild "Torque base filtered" SWORD Trq 1 100 -3276.800 3276.700 FORMAT "%8.3" ECU_ADDRESS 0x60007E96 /end MEASUREMENT
/begin MEASUREMENT CoVMD_tqBasMod1 "Torque base 1" SWORD Trq 1 100 -3276.800 3276.700 FORMAT "%8.3" ECU_ADDRESS 0x60007E94 /end MEASUREMENT
/begin MEASUREMENT CoVMD_tqBasMod1MT "Torque base 1 MT" SWORD Trq 1 100 -3276.800 3276.700 FORMAT "%8.3" ECU_ADDRESS 0x60007E92 /end MEASUREMENT
/begin MEASUREMENT CoVMD_tqBasMod2 "Torque base 2" SWORD Trq 1 100 -3276.800 3276.700 FORMAT "%8.3" ECU_ADDRESS 0x60007E90 /end MEASUREMENT
/begin MEASUREMENT CoVMD_tqBasModNew "Torque base new" SWORD Trq 1 100 -3276.800 3276.700 FORMAT "%8.3" ECU_ADDRESS 0x60007E8E /end MEASUREMENT
/begin MEASUREMENT CoVMD_tqBasModOld "Torque base old" SWORD Trq 1 100 -3276.800 3276.700 FORMAT "%8.3" ECU_ADDRESS 0x60007E8C /end MEASUREMENT
/begin MEASUREMENT CoVMD_tqBasPrev "Previous calculation of basic request desired torque" SWORD Trq 1 100 -3276.800 3276.700 FORMAT "%8.3" ECU_ADDRESS 0x60007E8A /end MEASUREMENT
/begin MEASUREMENT CoVMD_tqBasUnfild "Torque base unfiltered" SWORD Trq 1 100 -3276.800 3276.700 FORMAT "%8.3" ECU_ADDRESS 0x60007E88 /end MEASUREMENT
/begin MEASUREMENT CoVMD_tqCmpLossSum "Sum of compensation loss" SWORD Trq 1 100 -3276.800 3276.700 FORMAT "%8.3" ECU_ADDRESS 0x60007E86 /end MEASUREMENT
/begin MEASUREMENT CoVMD_tqCmpLossSumWoFac "Sum of compensation loss without factor" SWORD Trq 1 100 -3276.800 3276.700 FORMAT "%8.3" ECU_ADDRESS 0x60007E84 /end MEASUREMENT
/begin MEASUREMENT CoVMD_tqCmpNotSwilLoss "Loss compensated non-switchable losses" SLONG TrqPrpHigh 1 100 -214748364.800 214748364.700 FORMAT "%13.3" ECU_ADDRESS 0x600030E0 /end MEASUREMENT
/begin MEASUREMENT CoVMD_tqCmpNotSwilLossWoFac "Loss compensated non-switchable losses without factor" SLONG TrqPrpHigh 1 100 -214748364.800 214748364.700 FORMAT "%13.3" ECU_ADDRESS 0x600030DC /end MEASUREMENT
/begin MEASUREMENT CoVMD_tqCmpSwilLoss "Loss compensated switchable losses" SLONG TrqPrpHigh 1 100 -214748364.800 214748364.700 FORMAT "%13.3" ECU_ADDRESS 0x600030D8 /end MEASUREMENT
/begin MEASUREMENT CoVMD_tqCmpSwilLossWoFac "Loss compensated switchable losses without factor" SLONG Trq 1 100 -214748364.800 214748364.700 FORMAT "%13.3" ECU_ADDRESS 0x600030D4 /end MEASUREMENT
/begin MEASUREMENT CoVMD_tqCMTCLsAEB "Propulsion torque for CMTC and LsAEB" SLONG TrqPrpHigh 1 100 -214748364.800 214748364.700 FORMAT "%13.3" ECU_ADDRESS 0x60003A38 /end MEASUREMENT
/begin MEASUREMENT CoVMD_tqCrCtlACCReq "Maximum possible adjustable torque" SLONG TrqPrpHigh 1 100 -214748364.800 214748364.700 FORMAT "%13.3" ECU_ADDRESS 0x60003A34 /end MEASUREMENT
/begin MEASUREMENT CoVMD_tqCrCtlWiLimn "Cruise control torque with limitation" SLONG TrqPrpHigh 1 100 -214748364.800 214748364.700 FORMAT "%13.3" ECU_ADDRESS 0x600030D0 /end MEASUREMENT
/begin MEASUREMENT CoVMD_tqCrsCtrlIDASACCReq "Maximum possible adjustable IDAS torque of Cruise control" SWORD TrqPrpHigh 1 100 -3276.800 3276.700 FORMAT "%8.3" ECU_ADDRESS 0x60009B3A /end MEASUREMENT
/begin MEASUREMENT CoVMD_tqCvtEcoEng0 "CVT ECO mode engine torque gear 0" SWORD Trq 1 100 -3276.800 3276.700 FORMAT "%8.3" ECU_ADDRESS 0x60007E82 /end MEASUREMENT
/begin MEASUREMENT CoVMD_tqCvtEcoEng1 "CVT ECO mode engine torque gear 1" SWORD Trq 1 100 -3276.800 3276.700 FORMAT "%8.3" ECU_ADDRESS 0x60007E80 /end MEASUREMENT
/begin MEASUREMENT CoVMD_tqCvtEcoEng12 "CVT ECO mode engine torque gear 1 to 2" SWORD Trq 1 100 -3276.800 3276.700 FORMAT "%8.3" ECU_ADDRESS 0x60007E7E /end MEASUREMENT
/begin MEASUREMENT CoVMD_tqCvtEcoEng2 "CVT ECO mode engine torque gear 2" SWORD Trq 1 100 -3276.800 3276.700 FORMAT "%8.3" ECU_ADDRESS 0x60007E7C /end MEASUREMENT
/begin MEASUREMENT CoVMD_tqCvtEcoEng23 "CVT ECO mode engine torque gear 2 to 3" SWORD Trq 1 100 -3276.800 3276.700 FORMAT "%8.3" ECU_ADDRESS 0x60007E7A /end MEASUREMENT
/begin MEASUREMENT CoVMD_tqCvtEcoEng3 "CVT ECO mode engine torque gear 3" SWORD Trq 1 100 -3276.800 3276.700 FORMAT "%8.3" ECU_ADDRESS 0x60007E78 /end MEASUREMENT
/begin MEASUREMENT CoVMD_tqCvtEcoEng34 "CVT ECO mode engine torque gear 3 to 4" SWORD Trq 1 100 -3276.800 3276.700 FORMAT "%8.3" ECU_ADDRESS 0x60007E76 /end MEASUREMENT
/begin MEASUREMENT CoVMD_tqCvtEcoEng4 "CVT ECO mode engine torque gear 4" SWORD Trq 1 100 -3276.800 3276.700 FORMAT "%8.3" ECU_ADDRESS 0x60007E74 /end MEASUREMENT
/begin MEASUREMENT CoVMD_tqCvtEcoEng45 "CVT ECO mode engine torque gear 4 to 5" SWORD Trq 1 100 -3276.800 3276.700 FORMAT "%8.3" ECU_ADDRESS 0x60007E72 /end MEASUREMENT
/begin MEASUREMENT CoVMD_tqCvtEcoEng5 "CVT ECO mode engine torque gear 5" SWORD Trq 1 100 -3276.800 3276.700 FORMAT "%8.3" ECU_ADDRESS 0x60007E70 /end MEASUREMENT
/begin MEASUREMENT CoVMD_tqCvtEcoEng56 "CVT ECO mode engine torque gear 5 to 6" SWORD Trq 1 100 -3276.800 3276.700 FORMAT "%8.3" ECU_ADDRESS 0x60007E6E /end MEASUREMENT
/begin MEASUREMENT CoVMD_tqCvtEcoEng6 "CVT ECO mode engine torque gear 6" SWORD Trq 1 100 -3276.800 3276.700 FORMAT "%8.3" ECU_ADDRESS 0x60007E6C /end MEASUREMENT
/begin MEASUREMENT CoVMD_tqCvtEcoEng67 "CVT ECO mode engine torque gear 6 to 7" SWORD Trq 1 100 -3276.800 3276.700 FORMAT "%8.3" ECU_ADDRESS 0x60007E6A /end MEASUREMENT
/begin MEASUREMENT CoVMD_tqCvtEcoEng7 "CVT ECO mode engine torque gear 7" SWORD Trq 1 100 -3276.800 3276.700 FORMAT "%8.3" ECU_ADDRESS 0x60007E68 /end MEASUREMENT
/begin MEASUREMENT CoVMD_tqCvtEcoEng78 "CVT ECO mode engine torque gear 7 to 8" SWORD Trq 1 100 -3276.800 3276.700 FORMAT "%8.3" ECU_ADDRESS 0x60007E66 /end MEASUREMENT
/begin MEASUREMENT CoVMD_tqCvtEcoEng8 "CVT ECO mode engine torque gear 8" SWORD Trq 1 100 -3276.800 3276.700 FORMAT "%8.3" ECU_ADDRESS 0x60007E64 /end MEASUREMENT
/begin MEASUREMENT CoVMD_tqCVTEng0 "CVT normal mode engine torque gear 0" SWORD Trq 1 100 -3276.800 3276.700 FORMAT "%8.3" ECU_ADDRESS 0x60007E62 /end MEASUREMENT
/begin MEASUREMENT CoVMD_tqCVTEng1 "CVT normal mode engine torque gear 1" SWORD Trq 1 100 -3276.800 3276.700 FORMAT "%8.3" ECU_ADDRESS 0x60007E60 /end MEASUREMENT
/begin MEASUREMENT CoVMD_tqCVTEng12 "CVT normal mode engine torque gear 1 to 2" SWORD Trq 1 100 -3276.800 3276.700 FORMAT "%8.3" ECU_ADDRESS 0x60007E5E /end MEASUREMENT
/begin MEASUREMENT CoVMD_tqCVTEng2 "CVT normal mode engine torque gear 2" SWORD Trq 1 100 -3276.800 3276.700 FORMAT "%8.3" ECU_ADDRESS 0x60007E5C /end MEASUREMENT
/begin MEASUREMENT CoVMD_tqCVTEng23 "CVT normal mode engine torque gear 2 to 3" SWORD Trq 1 100 -3276.800 3276.700 FORMAT "%8.3" ECU_ADDRESS 0x60007E5A /end MEASUREMENT
/begin MEASUREMENT CoVMD_tqCVTEng3 "CVT normal mode engine torque gear 3" SWORD Trq 1 100 -3276.800 3276.700 FORMAT "%8.3" ECU_ADDRESS 0x60007E58 /end MEASUREMENT
/begin MEASUREMENT CoVMD_tqCVTEng34 "CVT normal mode engine torque gear 3 to 4" SWORD Trq 1 100 -3276.800 3276.700 FORMAT "%8.3" ECU_ADDRESS 0x60007E56 /end MEASUREMENT
/begin MEASUREMENT CoVMD_tqCVTEng4 "CVT normal mode engine torque gear 4" SWORD Trq 1 100 -3276.800 3276.700 FORMAT "%8.3" ECU_ADDRESS 0x60007E54 /end MEASUREMENT
/begin MEASUREMENT CoVMD_tqCVTEng45 "CVT normal mode engine torque gear 4 to 5" SWORD Trq 1 100 -3276.800 3276.700 FORMAT "%8.3" ECU_ADDRESS 0x60007E52 /end MEASUREMENT
/begin MEASUREMENT CoVMD_tqCVTEng5 "CVT normal mode engine torque gear 5" SWORD Trq 1 100 -3276.800 3276.700 FORMAT "%8.3" ECU_ADDRESS 0x60007E50 /end MEASUREMENT
/begin MEASUREMENT CoVMD_tqCVTEng56 "CVT normal mode engine torque gear 5 to 6" SWORD Trq 1 100 -3276.800 3276.700 FORMAT "%8.3" ECU_ADDRESS 0x60007E4E /end MEASUREMENT
/begin MEASUREMENT CoVMD_tqCVTEng6 "CVT normal mode engine torque gear 6" SWORD Trq 1 100 -3276.800 3276.700 FORMAT "%8.3" ECU_ADDRESS 0x60007E4C /end MEASUREMENT
/begin MEASUREMENT CoVMD_tqCVTEng67 "CVT normal mode engine torque gear 6 to 7" SWORD Trq 1 100 -3276.800 3276.700 FORMAT "%8.3" ECU_ADDRESS 0x60007E4A /end MEASUREMENT
/begin MEASUREMENT CoVMD_tqCVTEng7 "CVT normal mode engine torque gear 7" SWORD Trq 1 100 -3276.800 3276.700 FORMAT "%8.3" ECU_ADDRESS 0x60007E48 /end MEASUREMENT
/begin MEASUREMENT CoVMD_tqCVTEng78 "CVT normal mode engine torque gear 7 to 8" SWORD Trq 1 100 -3276.800 3276.700 FORMAT "%8.3" ECU_ADDRESS 0x60007E46 /end MEASUREMENT
/begin MEASUREMENT CoVMD_tqCVTEng8 "CVT normal mode engine torque gear 8" SWORD Trq 1 100 -3276.800 3276.700 FORMAT "%8.3" ECU_ADDRESS 0x60007E44 /end MEASUREMENT
/begin MEASUREMENT CoVMD_tqDesInnrWoCmp "Desired inner torque without compensation" SLONG TrqPrpHigh 1 100 -214748364.800 214748364.700 FORMAT "%13.3" ECU_ADDRESS 0x600030CC /end MEASUREMENT
/begin MEASUREMENT CoVMD_tqDesTmp "Temporary desire torque" SLONG TrqPrpHigh 1 100 -214748364.800 214748364.700 FORMAT "%13.3" ECU_ADDRESS 0x600030C8 /end MEASUREMENT
/begin MEASUREMENT CoVMD_tqDesTmpWhl "Temporary desired wheel torque" SLONG TrqPrpHigh 1 100 -214748364.800 214748364.700 FORMAT "%13.3" ECU_ADDRESS 0x600030C4 /end MEASUREMENT
/begin MEASUREMENT CoVMD_tqDesWhlWoCmp "Desured wheel torque without compensation" SLONG TrqPrpHigh 1 100 -214748364.800 214748364.700 FORMAT "%13.3" ECU_ADDRESS 0x60003A30 /end MEASUREMENT
/begin MEASUREMENT CoVMD_tqDrgWhlLvl "Drag torque at wheel level" SLONG TrqPrpHigh 1 100 -214748364.800 214748364.700 FORMAT "%13.3" ECU_ADDRESS 0x600030C0 /end MEASUREMENT
/begin MEASUREMENT CoVMD_tqEcoMaxIDAS "Maximum requested torque from IDAS unit for Eco Mode" SWORD TrqPrpHigh 1 100 -3276.800 3276.700 FORMAT "%8.3" ECU_ADDRESS 0x60007E42 /end MEASUREMENT
/begin MEASUREMENT CoVMD_tqGearDesCVT "Desired CVT gear torque" SWORD Trq 1 100 -3276.800 3276.700 FORMAT "%8.3" ECU_ADDRESS 0x60007E40 /end MEASUREMENT
/begin MEASUREMENT CoVMD_tqGearDesMT "Desired MT gear torque" SWORD Trq 1 100 -3276.800 3276.700 FORMAT "%8.3" ECU_ADDRESS 0x60007E3E /end MEASUREMENT
/begin MEASUREMENT CoVMD_tqGearMod1CVT "Mode 1 CVT gear torque" SWORD Trq 1 100 -3276.800 3276.700 FORMAT "%8.3" ECU_ADDRESS 0x60007E3C /end MEASUREMENT
/begin MEASUREMENT CoVMD_tqIDASACCReq "The torque request for CrCtl and LLim come from IDAS unit at wheel level" SLONG TrqPrpHigh 1 100 -214748364.800 214748364.700 FORMAT "%13.3" ECU_ADDRESS 0x600030BC /end MEASUREMENT
/begin MEASUREMENT CoVMD_tqIDASACCWhlWithLoss "Wheel torque with losses of Cruise control" SLONG TrqPrpHigh 1 100 -214748364.800 214748364.700 FORMAT "%13.3" ECU_ADDRESS 0x600030B8 /end MEASUREMENT
/begin MEASUREMENT CoVMD_tqIDASFailOffs1 "IDAS torque failure offset threshold" SLONG RBPtCel_tq_1p0_1 1 100 -2147483648.00 2147483647.00 FORMAT "%13.2" ECU_ADDRESS 0x600030B4 /end MEASUREMENT
/begin MEASUREMENT CoVMD_tqIDASFailThd1 "IDAS torque failure detection threshold" SLONG RBPtCel_tq_1p0_1 1 100 -2147483648.00 2147483647.00 FORMAT "%13.2" ECU_ADDRESS 0x600030B0 /end MEASUREMENT
/begin MEASUREMENT CoVMD_tqIDASFailThd2 "IDAS torque failure detection threshold" SLONG RBPtCel_tq_1p0_1 1 100 -2147483648.00 2147483647.00 FORMAT "%13.2" ECU_ADDRESS 0x600030AC /end MEASUREMENT
/begin MEASUREMENT CoVMD_tqInnrLvlIDASACCReq "IDAS torque request at Inner level of Cruise control" SLONG TrqPrpHigh 1 100 -214748364.800 214748364.700 FORMAT "%13.3" ECU_ADDRESS 0x600030A8 /end MEASUREMENT
/begin MEASUREMENT CoVMD_tqIntrpnCvt2EcoAry "New CVT2 torque interpolation array in Eco mode" SWORD TrqPrpHigh 1 100 -3276.800 3276.700 FORMAT "%8.3" ARRAY_SIZE 16 ECU_ADDRESS 0x60007E12 /end MEASUREMENT
/begin MEASUREMENT CoVMD_tqIntrpnCvt2NormAry "New CVT2 torque interpolation array in Normal mode" SWORD TrqPrpHigh 1 100 -3276.800 3276.700 FORMAT "%8.3" ARRAY_SIZE 16 ECU_ADDRESS 0x60007DF2 /end MEASUREMENT
/begin MEASUREMENT CoVMD_tqIntrpnEco1Ary "New torque interpolation array for eco mode 1" SWORD TrqPrpHigh 1 100 -3276.800 3276.700 FORMAT "%8.3" ARRAY_SIZE 16 ECU_ADDRESS 0x60007DD2 /end MEASUREMENT
/begin MEASUREMENT CoVMD_tqIntrpnEco2Ary "New torque interpolation array for eco mode 2" SWORD TrqPrpHigh 1 100 -3276.800 3276.700 FORMAT "%8.3" ARRAY_SIZE 16 ECU_ADDRESS 0x60007DB2 /end MEASUREMENT
/begin MEASUREMENT CoVMD_tqIntrpnEcoAry "Final torque interpolation array for eco mode" SWORD TrqPrpHigh 1 100 -3276.800 3276.700 FORMAT "%8.3" ARRAY_SIZE 16 ECU_ADDRESS 0x60007D92 /end MEASUREMENT
/begin MEASUREMENT CoVMD_tqIntrpnEcoMTAry "Interpolated array of torque values for MT Eco Mode" SWORD TrqPrpHigh 1 100 -3276.800 3276.700 FORMAT "%8.3" ARRAY_SIZE 16 ECU_ADDRESS 0x60007D72 /end MEASUREMENT
/begin MEASUREMENT CoVMD_tqIntrpnNorm1Ary "New torque interpolation array for normal mode 1" SWORD TrqPrpHigh 1 100 -3276.800 3276.700 FORMAT "%8.3" ARRAY_SIZE 16 ECU_ADDRESS 0x60007D52 /end MEASUREMENT
/begin MEASUREMENT CoVMD_tqIntrpnNorm2Ary "New torque interpolation array for normal mode 2" SWORD TrqPrpHigh 1 100 -3276.800 3276.700 FORMAT "%8.3" ARRAY_SIZE 16 ECU_ADDRESS 0x60007D32 /end MEASUREMENT
/begin MEASUREMENT CoVMD_tqIntrpnNormAry "Final torque interpolation array for normal mode" SWORD TrqPrpHigh 1 100 -3276.800 3276.700 FORMAT "%8.3" ARRAY_SIZE 16 ECU_ADDRESS 0x60007D12 /end MEASUREMENT
/begin MEASUREMENT CoVMD_tqIntrpnNormMTAry "Interpolated array of torque values for MT Normal Mode" SWORD TrqPrpHigh 1 100 -3276.800 3276.700 FORMAT "%8.3" ARRAY_SIZE 16 ECU_ADDRESS 0x60007CF2 /end MEASUREMENT
/begin MEASUREMENT CoVMD_tqLLim "Speed limiter torque" SLONG TrqPrpHigh 1 100 -214748364.800 214748364.700 FORMAT "%13.3" ECU_ADDRESS 0x600030A4 /end MEASUREMENT
/begin MEASUREMENT CoVMD_tqLLimACCReq "Minimum possible adjustable torque" SLONG TrqPrpHigh 1 100 -214748364.800 214748364.700 FORMAT "%13.3" ECU_ADDRESS 0x60003A2C /end MEASUREMENT
/begin MEASUREMENT CoVMD_tqLossSum "Sum of total loss torque" SLONG TrqPrpHigh 1 100 -214748364.800 214748364.700 FORMAT "%13.3" ECU_ADDRESS 0x600030A0 /end MEASUREMENT
/begin MEASUREMENT CoVMD_tqMapBasd "Based map torque" SWORD Trq 1 100 -3276.800 3276.700 FORMAT "%8.3" ECU_ADDRESS 0x60007E3A /end MEASUREMENT
/begin MEASUREMENT CoVMD_tqMaxAllwdIDAS "Maximum requested torque from IDAS unit" SLONG TrqPrpHigh 1 100 -214748364.800 214748364.700 FORMAT "%13.3" ECU_ADDRESS 0x60003A28 /end MEASUREMENT
/begin MEASUREMENT CoVMD_tqMinAbslt "Absolutely value of minimum torque" SLONG RBPtCel_tq_1p0_1 1 100 -2147483648.00 2147483647.00 FORMAT "%13.2" ECU_ADDRESS 0x6000309C /end MEASUREMENT
/begin MEASUREMENT CoVMD_tqMinAllwdIDAS "Minimum requested torque for IDAS unit" SLONG TrqPrpHigh 1 100 -214748364.800 214748364.700 FORMAT "%13.3" ECU_ADDRESS 0x60003A24 /end MEASUREMENT
/begin MEASUREMENT CoVMD_tqNewTmp "Temporary value of torque based on current drive mode" SWORD Trq 1 100 -3276.800 3276.700 FORMAT "%8.3" ECU_ADDRESS 0x60007E38 /end MEASUREMENT
/begin MEASUREMENT CoVMD_tqNormMaxIDAS "Maximum requested torque from IDAS unit for Normal Mode" SWORD TrqPrpHigh 1 100 -3276.800 3276.700 FORMAT "%8.3" ECU_ADDRESS 0x60007E36 /end MEASUREMENT
/begin MEASUREMENT CoVMD_tqNotSwilLoss "Not swapable torque loss" SLONG TrqPrpHigh 1 100 -214748364.800 214748364.700 FORMAT "%13.3" ECU_ADDRESS 0x60003098 /end MEASUREMENT
/begin MEASUREMENT CoVMD_tqOldTmp "Temporary value of torque based on previous drive mode" SWORD Trq 1 100 -3276.800 3276.700 FORMAT "%8.3" ECU_ADDRESS 0x60007E34 /end MEASUREMENT
/begin MEASUREMENT CoVMD_tqPrpnCrCtlLLim "Cruise control and Speed limiter Propulsion torque" SLONG TrqPrpHigh 1 100 -214748364.800 214748364.700 FORMAT "%13.3" ECU_ADDRESS 0x60003094 /end MEASUREMENT
/begin MEASUREMENT CoVMD_tqWhlCmpTmp "Temporary IDAS wheel torque with compensation" SLONG TrqPrpHigh 1 100 -214748364.800 214748364.700 FORMAT "%13.3" ECU_ADDRESS 0x60003090 /end MEASUREMENT
/begin MEASUREMENT CoVMD_tqWhlMax "Torque wheel max" SLONG TrqPrpHigh 1 100 -214748364.800 214748364.700 FORMAT "%13.3" ECU_ADDRESS 0x6000308C /end MEASUREMENT
/begin MEASUREMENT CoVMD_tqWhlMinEng "Torque wheel min" SLONG TrqPrpHigh 1 100 -214748364.800 214748364.700 FORMAT "%13.3" ECU_ADDRESS 0x60003088 /end MEASUREMENT
/begin MEASUREMENT CoVMD_tqWhlMinWoFco "Torque wheel min without fuel cut-off" SLONG TrqPrpHigh 1 100 -214748364.800 214748364.700 FORMAT "%13.3" ECU_ADDRESS 0x60003084 /end MEASUREMENT
/begin MEASUREMENT CoVMD_tqWoCtOff "torque without cut-off" SWORD Trq 1 100 -3276.800 3276.700 FORMAT "%8.3" ECU_ADDRESS 0x60007E32 /end MEASUREMENT
/begin MEASUREMENT CoVMD_trqCrCtl "Propulsion torque of cruise control" SLONG TrqPrpHigh 1 100 -214748364.800 214748364.700 FORMAT "%13.3" ECU_ADDRESS 0x60003A20 /end MEASUREMENT
/begin MEASUREMENT CoVMD_trqLLim "Propulsion torque of longitudinal limiter" SLONG TrqPrpHigh 1 100 -214748364.800 214748364.700 FORMAT "%13.3" ECU_ADDRESS 0x60003A1C /end MEASUREMENT
/begin MEASUREMENT CoVOM_bAbortedStopReq "A stop request will be aborted after a calibratable time, if the stop releases are not given." UBYTE B_TRUE 1 100 0.00 1.00000000000 BIT_MASK 0x1 FORMAT "%13.11" ECU_ADDRESS 0x6000F9F5 /end MEASUREMENT
/begin MEASUREMENT CoVOM_bACStopReqTimeout "AC stop request time out during idle stop" UBYTE B_TRUE 1 100 0.00 1.00000000000 BIT_MASK 0x1 FORMAT "%13.11" ECU_ADDRESS 0x70000A67 /end MEASUREMENT
/begin MEASUREMENT CoVOM_bAutoRstrtReq "Auto restart request" UBYTE B_TRUE 1 100 0.00 1.00000000000 BIT_MASK 0x1 FORMAT "%13.11" ECU_ADDRESS 0x6000F9F4 /end MEASUREMENT
/begin MEASUREMENT CoVOM_bChangeOfMind "Status which indicates that change of mind is active" UBYTE B_TRUE 1 100 0.00 1.00000000000 BIT_MASK 0x1 FORMAT "%13.11" ECU_ADDRESS 0x6000F9F1 /end MEASUREMENT
/begin MEASUREMENT CoVOM_bCVTIdleStop "Status of idle stop request" UBYTE B_TRUE 1 100 0.00 1.00000000000 BIT_MASK 0x1 FORMAT "%13.11" ECU_ADDRESS 0x6000F9F3 /end MEASUREMENT
/begin MEASUREMENT CoVOM_bCVTStopEna "Status of Preparation for Idle Stop" UBYTE B_TRUE 1 100 0.00 1.00000000000 BIT_MASK 0x1 FORMAT "%13.11" ECU_ADDRESS 0x6000F9F2 /end MEASUREMENT
/begin MEASUREMENT CoVOM_bDEFInhbReqIndcn "Status which indicates Stop Inhibition Request from Front Defogger Switch" UBYTE B_TRUE 1 100 0.00 1.00000000000 BIT_MASK 0x1 FORMAT "%13.11" ECU_ADDRESS 0x6000F9F0 /end MEASUREMENT
/begin MEASUREMENT CoVOM_bEngFrstStrtPassed "Status which indicates that the first start has occured" UBYTE B_TRUE 1 100 0.00 1.00000000000 BIT_MASK 0x1 FORMAT "%13.11" ECU_ADDRESS 0x6000F9EF /end MEASUREMENT
/begin MEASUREMENT CoVOM_bEngPreStrtOrd "Pre-order to engine for engine start" UBYTE OneToOne 1 100 0.00 255.0 FORMAT "%5.1" ECU_ADDRESS 0x6000FF74 /end MEASUREMENT
/begin MEASUREMENT CoVOM_bNeutBasdRstrt "Restart release extension when shift from Neutral" UBYTE B_TRUE 1 100 0.00 1.00000000000 BIT_MASK 0x1 FORMAT "%13.11" ECU_ADDRESS 0x6000F9EE /end MEASUREMENT
/begin MEASUREMENT CoVOM_bRvsGearTran "Flag to check the transition of reverse gear to neutral" UBYTE B_TRUE 1 100 0.00 1.00000000000 BIT_MASK 0x1 FORMAT "%13.11" ECU_ADDRESS 0x6000F094 /end MEASUREMENT
/begin MEASUREMENT CoVOM_bRvsHist "Reverse history flag" UBYTE B_TRUE 1 100 0.00 1.00000000000 BIT_MASK 0x1 FORMAT "%13.11" ECU_ADDRESS 0x6000F9ED /end MEASUREMENT
/begin MEASUREMENT CoVOM_bSeatBltBasdRstrt "Seat belt based restart release" UBYTE B_TRUE 1 100 0.00 1.00000000000 BIT_MASK 0x1 FORMAT "%13.11" ECU_ADDRESS 0x6000F093 /end MEASUREMENT
/begin MEASUREMENT CoVOM_bSSEEna "Stop Start enabled based on application parameter" UBYTE B_TRUE 1 100 0.00 1.00000000000 BIT_MASK 0x1 FORMAT "%13.11" ECU_ADDRESS 0x6000F9EC /end MEASUREMENT
/begin MEASUREMENT CoVOM_bSSEEngStopPassed "Status which indicates that the engine was stopped by the coordinator" UBYTE B_TRUE 1 100 0.00 1.00000000000 BIT_MASK 0x1 FORMAT "%13.11" ECU_ADDRESS 0x6000F9EB /end MEASUREMENT
/begin MEASUREMENT CoVOM_bSSEUIStrtReq "An engine start has been requested, because of the deactivating Start/Stop- button." UBYTE B_TRUE 1 100 0.00 1.00000000000 BIT_MASK 0x1 FORMAT "%13.11" ECU_ADDRESS 0x7000548D /end MEASUREMENT
/begin MEASUREMENT CoVOM_bStopDrvReq "Status of driver stop request" UBYTE B_TRUE 1 100 0.00 1.00000000000 BIT_MASK 0x1 FORMAT "%13.11" ECU_ADDRESS 0x6000F9EA /end MEASUREMENT
/begin MEASUREMENT CoVOM_bStopEna "An Autostop has been released." UBYTE B_TRUE 1 100 0.00 1.00000000000 BIT_MASK 0x1 FORMAT "%13.11" ECU_ADDRESS 0x70000A66 /end MEASUREMENT
/begin MEASUREMENT CoVOM_bStopReq "Stop request is given by the stop request conditions" UBYTE B_TRUE 1 100 0.00 1.00000000000 BIT_MASK 0x1 FORMAT "%13.11" ECU_ADDRESS 0x70000A65 /end MEASUREMENT
/begin MEASUREMENT CoVOM_bStopTraReq "Status of Transmission stop request" UBYTE B_TRUE 1 100 0.00 1.00000000000 BIT_MASK 0x1 FORMAT "%13.11" ECU_ADDRESS 0x6000F9E9 /end MEASUREMENT
/begin MEASUREMENT CoVOM_bStrtEna "Start release is given." UBYTE B_TRUE 1 100 0.00 1.00000000000 BIT_MASK 0x1 FORMAT "%13.11" ECU_ADDRESS 0x70000A64 /end MEASUREMENT
/begin MEASUREMENT CoVOM_bStrtReq "Start request is given by start request conditions" UBYTE B_TRUE 1 100 0.00 1.00000000000 BIT_MASK 0x1 FORMAT "%13.11" ECU_ADDRESS 0x70000A63 /end MEASUREMENT
/begin MEASUREMENT CoVOM_bSysOff "System off mode from idle stop" UBYTE B_TRUE 1 100 0.00 1.00000000000 BIT_MASK 0x1 FORMAT "%13.11" ECU_ADDRESS 0x6000F9E8 /end MEASUREMENT
/begin MEASUREMENT CoVOM_bVehCdnStopTrig "Idle Stop trigger from driver" UBYTE B_TRUE 1 100 0.00 1.00000000000 BIT_MASK 0x1 FORMAT "%13.11" ECU_ADDRESS 0x6000F9E6 /end MEASUREMENT
/begin MEASUREMENT CoVOM_bVXEngStopRea_mp "This variable indicates reached minimum velocity after the stop phase" UBYTE B_TRUE 1 100 0.00 1.00000000000 BIT_MASK 0x1 FORMAT "%13.11" ECU_ADDRESS 0x7000A76E /end MEASUREMENT
/begin MEASUREMENT CoVOM_bVXSinceStrtDeb "Vehicle velocity since start of vehicle" UBYTE B_TRUE 1 100 0.00 1.00000000000 BIT_MASK 0x1 FORMAT "%13.11" ECU_ADDRESS 0x6000F9E7 /end MEASUREMENT
/begin MEASUREMENT CoVOM_ctFirstVldChk "Count to allow IS suppression logic time check" UBYTE OneToOne 1 100 0.00 255.0 FORMAT "%5.1" ECU_ADDRESS 0x6000F092 /end MEASUREMENT
/begin MEASUREMENT CoVOM_flgAllwRstrtBrk "Flag allow restart by brake on" UBYTE B_TRUE 1 100 0.00 1.00000000000 BIT_MASK 0x1 FORMAT "%13.11" ECU_ADDRESS 0x6000F091 /end MEASUREMENT
/begin MEASUREMENT CoVOM_flgBrkHldStbyOff "Flag to indicate that the brake hold switch is turned off" UBYTE B_TRUE 1 100 0.00 1.00000000000 BIT_MASK 0x1 FORMAT "%13.11" ECU_ADDRESS 0x6000F090 /end MEASUREMENT
/begin MEASUREMENT CoVOM_flgBrkOffMoFPrmt "Flag to indicate Brake status with delayed turn off" UBYTE B_TRUE 1 100 0.00 1.00000000000 BIT_MASK 0x1 FORMAT "%13.11" ECU_ADDRESS 0x6000F9E5 /end MEASUREMENT
/begin MEASUREMENT CoVOM_flgChgOfMndReq "Flag to indicate change of mind request" UBYTE B_TRUE 1 100 0.00 1.00000000000 BIT_MASK 0x1 FORMAT "%13.11" ECU_ADDRESS 0x6000F08F /end MEASUREMENT
/begin MEASUREMENT CoVOM_flgEngRstrtInhb "Restart from idle stop inhibit condition" UBYTE B_TRUE 1 100 0.00 1.00000000000 BIT_MASK 0x1 FORMAT "%13.11" ECU_ADDRESS 0x6000F9E4 /end MEASUREMENT
/begin MEASUREMENT CoVOM_flgEngStallAftDly "Engine stall delay after 3 secs" UBYTE B_TRUE 1 100 0.00 1.00000000000 BIT_MASK 0x1 FORMAT "%13.11" ECU_ADDRESS 0x6000F9E3 /end MEASUREMENT
/begin MEASUREMENT CoVOM_flgLSFActvStrtReq_MP "Status of Start request from ACC LSF active stop" UBYTE B_TRUE 1 100 0.00 1.00000000000 BIT_MASK 0x1 FORMAT "%13.11" ECU_ADDRESS 0x7000A76D /end MEASUREMENT
/begin MEASUREMENT CoVOM_flgMoFPrmt "flag to indicate MoF permit time" UBYTE B_TRUE 1 100 0.00 1.00000000000 BIT_MASK 0x1 FORMAT "%13.11" ECU_ADDRESS 0x6000F9E2 /end MEASUREMENT
/begin MEASUREMENT CoVOM_flgRstrtReqBrkOn "Restart request flag by brake on" UBYTE B_TRUE 1 100 0.00 1.00000000000 BIT_MASK 0x1 FORMAT "%13.11" ECU_ADDRESS 0x6000F08E /end MEASUREMENT
/begin MEASUREMENT CoVOM_flgSeatBltOff "Seat belt unlatched during idle stop" UBYTE B_TRUE 1 100 0.00 1.00000000000 BIT_MASK 0x1 FORMAT "%13.11" ECU_ADDRESS 0x6000F9E1 /end MEASUREMENT
/begin MEASUREMENT CoVOM_flgStrtAbortMoF "Flag to indicate starter abort at level 2" UBYTE B_TRUE 1 100 0.00 1.00000000000 BIT_MASK 0x1 FORMAT "%13.11" ECU_ADDRESS 0x6000F9E0 /end MEASUREMENT
/begin MEASUREMENT CoVOM_flgTrigCamsftRefPosn "status flag indicating the trigger camshaft to reference position" UBYTE B_TRUE 1 100 0.00 1.00000000000 BIT_MASK 0x1 FORMAT "%13.11" ECU_ADDRESS 0x60014A9B /end MEASUREMENT
/begin MEASUREMENT CoVOM_numEngStrtAbrt "Number of start abortions" ULONG OneToOne 1 100 0.00 4294967295.00 FORMAT "%13.2" ECU_ADDRESS 0x60003930 /end MEASUREMENT
/begin MEASUREMENT CoVOM_pRelThdForStrtReq "Threshold for judgment of negative pressure change in the vacuum chamber after ISAB comes into operation and give a start request" SLONG Pres_hPa 1 100 -2147483648.00 2147483647.00 FORMAT "%13.2" ECU_ADDRESS 0x60003080 /end MEASUREMENT
/begin MEASUREMENT CoVOM_stEngCrkAbort "staus of engine crank abort" UBYTE B_TRUE 1 100 0.00 1.00000000000 BIT_MASK 0x1 FORMAT "%13.11" ECU_ADDRESS 0x6000F9DF /end MEASUREMENT
/begin MEASUREMENT CoVOM_stEngCrkAbortReqd "status of engine crank abort requested" UBYTE B_TRUE 1 100 0.00 1.00000000000 BIT_MASK 0x1 FORMAT "%13.11" ECU_ADDRESS 0x6000F08D /end MEASUREMENT
/begin MEASUREMENT CoVOM_stEngInhbReqEna "MVCPA enable status" UBYTE B_TRUE 1 100 0.00 1.00000000000 BIT_MASK 0x1 FORMAT "%13.11" ECU_ADDRESS 0x6000F08C /end MEASUREMENT
/begin MEASUREMENT CoVOM_stEngRstrtEnaCdn "status of the engine restart enable condition" UBYTE B_TRUE 1 100 0.00 1.00000000000 BIT_MASK 0x1 FORMAT "%13.11" ECU_ADDRESS 0x6000F08B /end MEASUREMENT
/begin MEASUREMENT CoVOM_stEngRstrtPreReq "Engine stall restart enable conditions" UBYTE B_TRUE 1 100 0.00 1.00000000000 BIT_MASK 0x1 FORMAT "%13.11" ECU_ADDRESS 0x70000A5F /end MEASUREMENT
/begin MEASUREMENT CoVOM_stEngRstrtReq "Engine stall restart Request" UBYTE B_TRUE 1 100 0.00 1.00000000000 BIT_MASK 0x1 FORMAT "%13.11" ECU_ADDRESS 0x6000F9DE /end MEASUREMENT
/begin MEASUREMENT CoVOM_stEngRstrtReqd "status of engine restart requested" UBYTE B_TRUE 1 100 0.00 1.00000000000 BIT_MASK 0x1 FORMAT "%13.11" ECU_ADDRESS 0x6000F08A /end MEASUREMENT
/begin MEASUREMENT CoVOM_stEngRstrtTrigReq "Engine stall restart trigger condition" UBYTE B_TRUE 1 100 0.00 1.00000000000 BIT_MASK 0x1 FORMAT "%13.11" ECU_ADDRESS 0x70000385 /end MEASUREMENT
/begin MEASUREMENT CoVOM_stEngStall "status indicating engine stall happend" UBYTE B_TRUE 1 100 0.00 1.00000000000 BIT_MASK 0x1 FORMAT "%13.11" ECU_ADDRESS 0x6000F089 /end MEASUREMENT
/begin MEASUREMENT CoVOM_stEngStopPreCdn "Engine stop pre-condition satisfied" UBYTE B_TRUE 1 100 0.00 1.00000000000 BIT_MASK 0x1 FORMAT "%13.11" ECU_ADDRESS 0x6000F9DD /end MEASUREMENT
/begin MEASUREMENT CoVOM_stEngStrtdOnce "status of the enigne started at least once" UBYTE B_TRUE 1 100 0.00 1.00000000000 BIT_MASK 0x1 FORMAT "%13.11" ECU_ADDRESS 0x6000F088 /end MEASUREMENT
/begin MEASUREMENT CoVOM_stISGoJud "Idling stop judgment" UBYTE B_TRUE 1 100 0.00 1.00000000000 BIT_MASK 0x1 FORMAT "%13.11" ECU_ADDRESS 0x6000F9DC /end MEASUREMENT
/begin MEASUREMENT CoVOM_stISGoStb "Standby conditions for IS" UBYTE B_TRUE 1 100 0.00 1.00000000000 BIT_MASK 0x1 FORMAT "%13.11" ECU_ADDRESS 0x6000F9DB /end MEASUREMENT
/begin MEASUREMENT CoVOM_stISSEng "Status of ISS for AT vehicle" UBYTE OneToOne 1 100 0.00 255.0 FORMAT "%5.1" ECU_ADDRESS 0x6000FF73 /end MEASUREMENT
/begin MEASUREMENT CoVOM_stISSEngTemp "Temp Status of ISS for AT vehicle" UBYTE OneToOne 1 100 0.00 255.0 FORMAT "%5.1" ECU_ADDRESS 0x6000F087 /end MEASUREMENT
/begin MEASUREMENT CoVOM_stISSEngTempOld "Temp Old Value of ISS Engine State" UBYTE OneToOne 1 100 0.00 255.0 FORMAT "%5.1" ECU_ADDRESS 0x6000F086 /end MEASUREMENT
/begin MEASUREMENT CoVOM_stISStopInhb "Stop Inhibit status" UBYTE B_TRUE 1 100 0.00 1.00000000000 BIT_MASK 0x1 FORMAT "%13.11" ECU_ADDRESS 0x6000F9DA /end MEASUREMENT
/begin MEASUREMENT CoVOM_stISSuppVehSpd "Is suppression based on vehicle speed" UBYTE B_TRUE 1 100 0.00 1.00000000000 BIT_MASK 0x1 FORMAT "%13.11" ECU_ADDRESS 0x6000F9D9 /end MEASUREMENT
/begin MEASUREMENT CoVOM_stMaxNrStrtOperExcdd "Number of starter operations exceeded maximum permitted" UBYTE B_TRUE 1 100 0.00 1.00000000000 BIT_MASK 0x1 FORMAT "%13.11" ECU_ADDRESS 0x6000F9D8 /end MEASUREMENT
/begin MEASUREMENT COVOM_stNotHiAlti "Status of high altitude condition" UBYTE B_TRUE 1 100 0.00 1.00000000000 BIT_MASK 0x1 FORMAT "%13.11" ECU_ADDRESS 0x6000F085 /end MEASUREMENT
/begin MEASUREMENT CoVOM_stPrkgPosn "Parking position certainly status" UBYTE B_TRUE 1 100 0.00 1.00000000000 BIT_MASK 0x1 FORMAT "%13.11" ECU_ADDRESS 0x6000F084 /end MEASUREMENT
/begin MEASUREMENT CoVOM_stRstrtReqByVehCdn "Restart request based on vehicle speed conditions" UBYTE B_TRUE 1 100 0.00 1.00000000000 BIT_MASK 0x1 FORMAT "%13.11" ECU_ADDRESS 0x6000F9D7 /end MEASUREMENT
/begin MEASUREMENT CoVOM_stSSE "Internal state of the coordinator state machine" UBYTE OneToOne 1 100 0.00 255.0 FORMAT "%5.1" ECU_ADDRESS 0x6000FF72 /end MEASUREMENT
/begin MEASUREMENT CoVOM_stStop "The kind of Autostopp" UWORD OneToOne 1 100 0.00 65535.00 FORMAT "%8.2" ECU_ADDRESS 0x60009584 /end MEASUREMENT
/begin MEASUREMENT CoVOM_stStopEnaBit8Excl "Stop Release message excluding bit 8(vehicle velocity condition)." UBYTE B_TRUE 1 100 0.00 1.00000000000 BIT_MASK 0x1 FORMAT "%13.11" ECU_ADDRESS 0x6000F9D6 /end MEASUREMENT
/begin MEASUREMENT CoVOM_stStopEnaDspl "Stop releases display message" ULONG OneToOne 1 100 0.00 4294967295.00 FORMAT "%13.2" ECU_ADDRESS 0x50004DB0 /end MEASUREMENT
/begin MEASUREMENT CoVOM_stStopEnblByVehCdn "Idle Stop enable based on vehicle speed conditions" UBYTE B_TRUE 1 100 0.00 1.00000000000 BIT_MASK 0x1 FORMAT "%13.11" ECU_ADDRESS 0x6000F9D5 /end MEASUREMENT
/begin MEASUREMENT CoVOM_stStopReqCdn "Stop request condition" ULONG OneToOne 1 100 0.00 4294967295.00 FORMAT "%13.2" ECU_ADDRESS 0x60003928 /end MEASUREMENT
/begin MEASUREMENT CoVOM_stStopReqDspl "Stop requests as a display message" ULONG OneToOne 1 100 0.00 4294967295.00 FORMAT "%13.2" ECU_ADDRESS 0x60013AB8 /end MEASUREMENT
/begin MEASUREMENT CoVOM_stStopRls "Start Stop ready lamp flag" ULONG OneToOne 1 100 0.00 4294967295.00 FORMAT "%13.2" ECU_ADDRESS 0x50004DB8 /end MEASUREMENT
/begin MEASUREMENT CoVOM_stStrt "The kind of start. Power start or comfort start" UWORD OneToOne 1 100 0.00 65535.00 FORMAT "%8.2" ECU_ADDRESS 0x60009582 /end MEASUREMENT
/begin MEASUREMENT CoVOM_stStrtAbort "Status indicating long cranking detetction used as a condition for start abortion" UBYTE B_TRUE 1 100 0.00 1.00000000000 BIT_MASK 0x1 FORMAT "%13.11" ECU_ADDRESS 0x6000F083 /end MEASUREMENT
/begin MEASUREMENT CoVOM_stStrtEnaCdn "Start enable condition" ULONG OneToOne 1 100 0.00 4294967295.00 FORMAT "%13.2" ECU_ADDRESS 0x60003920 /end MEASUREMENT
/begin MEASUREMENT CoVOM_stStrtEnaDspl "Start releases as a display message" ULONG OneToOne 1 100 0.00 4294967295.00 FORMAT "%13.2" ECU_ADDRESS 0x50004DC0 /end MEASUREMENT
/begin MEASUREMENT CoVOM_stStrtReqBefMsk "Start request before masking for start from idle stop" ULONG OneToOne 1 100 0.00 4294967295.00 FORMAT "%13.2" ECU_ADDRESS 0x6000391C /end MEASUREMENT
/begin MEASUREMENT CoVOM_stStrtReqCdn "Start request condition" ULONG OneToOne 1 100 0.00 4294967295.00 FORMAT "%13.2" ECU_ADDRESS 0x50004DC4 /end MEASUREMENT
/begin MEASUREMENT CoVOM_stStrtReqCluPosn "Start request based on clutch position" UBYTE B_TRUE 1 100 0.00 1.00000000000 BIT_MASK 0x1 FORMAT "%13.11" ECU_ADDRESS 0x6000F9D4 /end MEASUREMENT
/begin MEASUREMENT CoVOM_stStrtReqDspl "Start requests as a display messages" ULONG OneToOne 1 100 0.00 4294967295.00 FORMAT "%13.2" ECU_ADDRESS 0x50004DC8 /end MEASUREMENT
/begin MEASUREMENT CoVOM_stSysOffRelsCdn "System off release condition" UBYTE OneToOne 1 100 0.00 255.0 FORMAT "%5.1" ECU_ADDRESS 0x6000F082 /end MEASUREMENT
/begin MEASUREMENT CoVOM_stSysOffTrigAftMsk "System off trigger After Masking" UWORD OneToOne 1 100 0.00 65535.00 FORMAT "%8.2" ECU_ADDRESS 0x60009580 /end MEASUREMENT
/begin MEASUREMENT CoVOM_stSysOffTrigBefMsk "System off trigger before masking" UWORD OneToOne 1 100 0.00 65535.00 FORMAT "%8.2" ECU_ADDRESS 0x6000957E /end MEASUREMENT
/begin MEASUREMENT CoVOM_stSysOffTrigMask "System off trigger mask" UBYTE OneToOne 1 100 0.00 255.0 FORMAT "%5.1" ECU_ADDRESS 0x6000FF71 /end MEASUREMENT
/begin MEASUREMENT CoVOM_stTraStrtReq_MP "Status of Transmission start request" UBYTE OneToOne 1 100 0.00 255.0 FORMAT "%5.1" ECU_ADDRESS 0x7000A76C /end MEASUREMENT
/begin MEASUREMENT CoVOM_tiEngRstrtAbort "time since the engine restart requested when the engine stalled" SWORD Time_s 1 100 0.00 327.6700 FORMAT "%8.4" ECU_ADDRESS 0x60007CF0 /end MEASUREMENT
/begin MEASUREMENT CoVOM_tiSpdBlwChk "Time update when vehicle speed more than threshold" SLONG Time_s 1 100 -21474836.4800 21474836.4700 FORMAT "%13.4" ECU_ADDRESS 0x50001418 /end MEASUREMENT
/begin MEASUREMENT CoVOM_tiSpdBlwTmr "Timer when vehicle speed less than threshold" SLONG Time_s 1 100 -21474836.4800 21474836.4700 FORMAT "%13.4" ECU_ADDRESS 0x6000307C /end MEASUREMENT
/begin MEASUREMENT CoVOM_tiSpdExcdChk "Time update when vehicle speed less than threshold" SLONG Time_s 1 100 -21474836.4800 21474836.4700 FORMAT "%13.4" ECU_ADDRESS 0x60003078 /end MEASUREMENT
/begin MEASUREMENT CoVOM_tiSpdExcdTmr "Timer when vehicle speed more than threshold" SLONG Time_s 1 100 -21474836.4800 21474836.4700 FORMAT "%13.4" ECU_ADDRESS 0x5000141C /end MEASUREMENT
/begin MEASUREMENT CoVOM_tiStopReqWoEna_mp "Elapsed time with a stop request without stop releases" SLONG Time_ms 1 100 -21474836480.0 21474836470.0 FORMAT "%13.1" ECU_ADDRESS 0x7000A768 /end MEASUREMENT
/begin MEASUREMENT CoVOM_tiUpDwnSpdHist "Elapsed time of up and down in speed history" SLONG Time_s 1 100 -21474836.4800 21474836.4700 FORMAT "%13.4" ECU_ADDRESS 0x50001420 /end MEASUREMENT
/begin MEASUREMENT CoVOM_vISFrqRstrcnSpd "IS frequency restriction speed" SWORD Vel 1 100 -327.6800 327.6700 FORMAT "%8.4" ECU_ADDRESS 0x60007CEE /end MEASUREMENT
/begin MEASUREMENT CoVOM_vWhlSpdMax "Maximum wheel speed calculated based on the 4 wheel speeds obtained" SWORD Vel 1 100 -327.6800 327.6700 FORMAT "%8.4" ECU_ADDRESS 0x60007CEC /end MEASUREMENT
/begin MEASUREMENT CoVOM_vWhlSpdMedian "Median value of wheel speed" SWORD Vel 1 100 -327.6800 327.6700 FORMAT "%8.4" ECU_ADDRESS 0x60007CEA /end MEASUREMENT
/begin MEASUREMENT CoVOM_vWhlSpdMin "Minimum wheel speed calculated based on the 4 wheel speeds obtained" SWORD Vel 1 100 -327.6800 327.6700 FORMAT "%8.4" ECU_ADDRESS 0x60007CE8 /end MEASUREMENT
/begin MEASUREMENT CoVOM_vWhlSpdSum "Sum of the minimum and maximum wheel speeds calculated" SLONG Vel 1 100 -21474836.4800 21474836.4700 FORMAT "%13.4" ECU_ADDRESS 0x60003074 /end MEASUREMENT
/begin MEASUREMENT TS_bEngStopEna "stop release thermal system" UBYTE B_TRUE 1 100 0.00 1.00000000000 BIT_MASK 0x1 FORMAT "%13.11" ECU_ADDRESS 0x7000076B /end MEASUREMENT
/begin MEASUREMENT TS_bEngStrtReq "start request thermal system" UBYTE B_TRUE 1 100 0.00 1.00000000000 BIT_MASK 0x1 FORMAT "%13.11" ECU_ADDRESS 0x7000076A /end MEASUREMENT
/begin MEASUREMENT TS_nMax "Highest engine speed requested by the thermal system" SWORD EngN 1 100 -16384.00 16383.50 FORMAT "%8.2" ECU_ADDRESS 0x6000978C /end MEASUREMENT
/begin MEASUREMENT TS_nMin "Lowest engine speed requested by the thermal system" SWORD EngN 1 100 -16384.00 16383.50 FORMAT "%8.2" ECU_ADDRESS 0x6000978A /end MEASUREMENT
/begin MEASUREMENT TS_trqDesAcs "Desired Torque demand of the thermal system" SWORD Trq 1 100 -3276.800 3276.700 FORMAT "%8.3" ECU_ADDRESS 0x60009786 /end MEASUREMENT
/begin MEASUREMENT TS_trqResvAcs "Torque reserve of the thermal system" SWORD Trq 1 100 -3276.800 3276.700 FORMAT "%8.3" ECU_ADDRESS 0x60009784 /end MEASUREMENT
/begin MEASUREMENT VehMot_facCompAcs "Coordinated factor of accessory compensation" SWORD Fact 1 100 -4.000000 3.999878 FORMAT "%8.6" ECU_ADDRESS 0x6000962E /end MEASUREMENT
/begin MEASUREMENT VehMot_stCtOffPhd "Status fuel cut off prohibited by driving assistance functions" UBYTE B_TRUE 1 100 0.00 1.00000000000 BIT_MASK 0x1 FORMAT "%13.11" ECU_ADDRESS 0x6000F8AE /end MEASUREMENT
/begin MEASUREMENT VehMot_stPrpCrCtl "Status cruise control overrides acceleration pedal" UBYTE OneToOne 1 100 0.00 255.0 FORMAT "%5.1" ECU_ADDRESS 0x6000FB58 /end MEASUREMENT
/begin MEASUREMENT VehMot_stPrpLLim "Status longitudinal limiter controls propulsion torque" UBYTE OneToOne 1 100 0.00 255.0 FORMAT "%5.1" ECU_ADDRESS 0x6000FB57 /end MEASUREMENT
/begin MEASUREMENT VMD_tqCluDes "Propulsion torque at clutch level after driving assistance coordination" SWORD Trq 1 100 -3276.800 3276.700 FORMAT "%8.3" ECU_ADDRESS 0x60009640 /end MEASUREMENT
/begin MEASUREMENT VMD_trqDes "Propulsion torque after driving assistance coordination" SLONG TrqPrpHigh 1 100 -214748364.800 214748364.700 FORMAT "%13.3" ECU_ADDRESS 0x60003950 /end MEASUREMENT
/begin FUNCTION Conv_LdData "27.3.0    Torque converter load data"
 /begin DEF_CHARACTERISTIC Conv_BrkDebP.tiHiLo_C Conv_BrkDebP.tiLoHi_C Conv_facClthClsd_GCUR Conv_facClthOpnd_GCUR Conv_facDfl_C Conv_stCylVrnt_C Conv_tiDfl_C Conv_tiLvrChgDrvRvs_GCUR Conv_tiLvrChgRvsDrv_GCUR Conv_tiRevLvrOffNeut_GT Conv_tiRevLvrOffPark_GT Conv_tiRevLvrOn_GCUR Conv_tiTempDepLvrOff_GCUR Conv_tiTempDepLvrOn2_GT Conv_tiTempDepLvrOn_GT Conv_tPntDST_AXIS Conv_tqResvTDpdtDRACOn_GCUR Conv_tqResvTDpdtDR_GCUR Conv_trqDfl_C Conv_trqLdActv_CW Conv_trqLdLvrPosNeutr_GCUR Conv_trqLdRevLvrPos_GCUR Conv_trqLdTempDepLim_GCUR Conv_trqLd_CW Conv_trqLosDfftl_map Conv_trqResvTempDep2_GT Conv_trqResvTempDepACOn2_GT Conv_trqResvTempDepACOn_GT Conv_trqResvTempDep_GT /end DEF_CHARACTERISTIC
 /begin IN_MEASUREMENT ACCtl_stOut Com_stBCDGearEngmt Gbx_tOilConv GlbDa_vXFlt SyC_ctPostDrvLeave TS_tClntEngOut VehMot_stBrkPed /end IN_MEASUREMENT
 /begin OUT_MEASUREMENT Conv_bCalc Conv_bConvActv Conv_bGearOff Conv_bTrbnSpdCan Conv_bTrqLdCan Conv_bTrqLdFlt Conv_bTrqResvBrkEnd Conv_bTrqResvLvrOff Conv_facOilTempDepTrqPmp Conv_tiTDeptRevLvrDebNegNeut Conv_tiTDeptRevLvrDebNegPark Conv_tiTDpdtLvrDrvRevDebPos Conv_tiTDpdtLvrRevDrvDebPos Conv_tiTempDepLvrDebNeg Conv_tiTempDepLvrDebPos Conv_tiTempDepRevLvrDebPos Conv_tOil Conv_tqResvTDeptDrvRev Conv_trqLdLvrPosNeutr Conv_trqLdRevLvrPos Conv_trqLdTempDepLim Conv_trqLosDfftl Conv_trqResvTempDep /end OUT_MEASUREMENT
 /begin LOC_MEASUREMENT Conv_cntrPostLve Conv_tOilBuf /end LOC_MEASUREMENT
 FUNCTION_VERSION "27.3.0" /end FUNCTION
/begin FUNCTION Conv_TrqRat "2.11.0    Torque load converter" /begin DEF_CHARACTERISTIC Conv_rTrq_C /end DEF_CHARACTERISTIC /begin OUT_MEASUREMENT Conv_rTrq /end OUT_MEASUREMENT FUNCTION_VERSION "2.11.0" /end FUNCTION
/begin FUNCTION CoPOM_FirstStrtReq "135.3.0   Evaluation of request for first start"
 /begin DEF_CHARACTERISTIC CoPOM_flgPsdBrkPedlRqrdForT50Strt_C CoPOM_flgStrtRelsDurgT50_C CoPOM_tiPanicStrtReq_C CoPOM_tiT50ReqCnclDly_C CoPOM_tiT50ReqPreDrvCnclDly_C /end DEF_CHARACTERISTIC
 /begin IN_MEASUREMENT Brk_st CoEng_stMai EngStrt_stStrtReq PT_bAutoStrtRls PT_stTraType T50_st /end IN_MEASUREMENT
 /begin OUT_MEASUREMENT CoPOM_stEngFirstStrtReq /end OUT_MEASUREMENT
 /begin LOC_MEASUREMENT CoPOM_CnclStrtReqTON_I.XOld CoPOM_CnclStrtReqTON_I.Timer CoPOM_DrvrStrtReqRSFF_I CoPOM_FirstStrtRelsEF_I CoPOM_flgCnclStrtReq CoPOM_flgMemdDrvrStrtReq CoPOM_flgMemdDrvrStrtReqCncl CoPOM_flgMemdRstStrtReq CoPOM_flgPtStrtRels CoPOM_PanicStrtTON_I.XOld CoPOM_PanicStrtTON_I.Timer CoPOM_RstStrtReqRSFF_I CoPOM_stEngFirstStrtReqOld CoPOM_StrtReqCnclTOFF_I.XOld CoPOM_StrtReqCnclTOFF_I.Timer CoPOM_StrtReqPreDrvCnclTOFF_I.XOld CoPOM_StrtReqPreDrvCnclTOFF_I.Timer CoPOM_T50RstER_I CoPOM_T50St0EF_I CoPOM_T50St0ER_I /end LOC_MEASUREMENT
 FUNCTION_VERSION "135.3.0" /end FUNCTION
/begin FUNCTION CoPOM_StM "12.4.0    Statemachine for Hybrid Operation Mode Coordination"
 /begin IN_MEASUREMENT CoPOM_stEngFirstStrtReq CoVeh_stEngStopOrd CoVeh_stEngStrtOrd MoF_stStrtMsg /end IN_MEASUREMENT
 /begin OUT_MEASUREMENT CoPOM_stEngSpstReq /end OUT_MEASUREMENT
 FUNCTION_VERSION "12.4.0" /end FUNCTION
/begin FUNCTION CoPOM_StrtgDevCdn "2.6.0     Starting Devices Conditions"
 /begin DEF_CHARACTERISTIC CoPOM_cntAbortStrtrLim_C CoPOM_tiDlyNxtStrtAftAbort_C CoPOM_tiStrtrOperMaxFault_C CoPOM_tiStrtrOperMax_T CoPOM_tqStrtDevStrtr_C /end DEF_CHARACTERISTIC
 /begin IN_MEASUREMENT CEngDsT_t CoEng_stMai MoF_stStrtMsg Strt_st T50_st /end IN_MEASUREMENT
 /begin OUT_MEASUREMENT CoPOM_tqStrtDevStrtr /end OUT_MEASUREMENT
 /begin LOC_MEASUREMENT CoPOM_AbortStrtrER_I CoPOM_cntAbortStrtr CoPOM_cntAbortStrtrOld CoPOM_flgAbortStrtr CoPOM_flgAbortStrtrLimReachd CoPOM_flgStrtPrms CoPOM_flgStrtrStrtRels CoPOM_NxtStrtAftAbortTOFF_I.XOld CoPOM_NxtStrtAftAbortTOFF_I.Timer CoPOM_StrtrMaxAbortTON_I.XOld CoPOM_StrtrMaxAbortTON_I.Timer /end LOC_MEASUREMENT
 FUNCTION_VERSION "2.6.0" /end FUNCTION
/begin FUNCTION CoPT_ThermDem "3.9.0     Driver train co-ordinator - Co-ordination of thermal requirements" /begin IN_MEASUREMENT CoTemp_rClgDes CoTemp_tEngDes Tra_rClgDem Tra_tClntDes /end IN_MEASUREMENT /begin OUT_MEASUREMENT CoPT_rClgDes CoPT_tClntDes /end OUT_MEASUREMENT FUNCTION_VERSION "3.9.0" /end FUNCTION
/begin FUNCTION CoTemp_DmAirDesVal "2.3.0     Coordinator Temperature - calculation of air mass flow desired value for cooling" /begin DEF_CHARACTERISTIC CoTemp_rClgDes_CUR /end DEF_CHARACTERISTIC /begin IN_MEASUREMENT EngDa_tEng /end IN_MEASUREMENT /begin OUT_MEASUREMENT CoTemp_rClgDes /end OUT_MEASUREMENT FUNCTION_VERSION "2.3.0" /end FUNCTION
/begin FUNCTION CoTemp_TEngDesVal "2.2.0     Coordinator Temperature -calculation of engine coolant temperature desired value"
 /begin DEF_CHARACTERISTIC CoTemp_tEngClntAftRunDes_C CoTemp_tEngClntIniDes_C CoTemp_tEngDesBaseNTrq_MAP CoTemp_tEngDesBaseTempVel_MAP /end DEF_CHARACTERISTIC
 /begin IN_MEASUREMENT EnvT_t Epm_nEng PthSet_trqInrSet SyC_stSub VehV_v /end IN_MEASUREMENT
 /begin OUT_MEASUREMENT CoTemp_tEngDes /end OUT_MEASUREMENT
 FUNCTION_VERSION "2.2.0" /end FUNCTION
/begin FUNCTION CoTE_ThermDem "2.2.0     Coordinator Thermal Energy" /begin IN_MEASUREMENT CoPT_rClgDes CoPT_tClntDes /end IN_MEASUREMENT /begin OUT_MEASUREMENT CoVeh_rClgDes CoVeh_tClntDes /end OUT_MEASUREMENT FUNCTION_VERSION "2.2.0" /end FUNCTION
/begin FUNCTION CoTS_EnaSSE "18.0.0    Thermal System Coordinator Enable Engine Start Stop"
 /begin DEF_CHARACTERISTIC CoTS_rhoEnvAirThresDelta_C CoTS_rhoEnvAirThresLo_C CoTS_rhoStopEna_MAP CoTS_tClntStopThresDelta_C CoTS_tClntStopThresHi_C CoTS_tClntStopThresLo_C CoTS_tClntStrtThresDelta_C CoTS_tClntStrtThresHi_C CoTS_tClntStrtThresLo_C /end DEF_CHARACTERISTIC
 /begin IN_MEASUREMENT EnvP_p EnvT_t T15_st TS_tClntEngOut /end IN_MEASUREMENT
 /begin OUT_MEASUREMENT CoTS_rhoAir CoTS_stSSEStopInhb TS_bEngStopEna TS_bEngStrtReq /end OUT_MEASUREMENT
 FUNCTION_VERSION "18.0.0" /end FUNCTION
/begin FUNCTION CoTS_MechDem "2.14.0    Thermal System Coordinator Mechanical Demand" /begin IN_MEASUREMENT CTM_nMin CTM_trqDes CTM_trqResv Fans_trqCons Fans_trqResv /end IN_MEASUREMENT /begin OUT_MEASUREMENT TS_nMax TS_nMin TS_trqDesAcs TS_trqResvAcs /end OUT_MEASUREMENT FUNCTION_VERSION "2.14.0" /end FUNCTION
/begin FUNCTION CoTS_ShutOffAcs "2.12.0    Thermal System Coordinator Accessories Shut Off" /begin IN_MEASUREMENT CoVeh_trqMaxAC /end IN_MEASUREMENT /begin OUT_MEASUREMENT CoTS_trqMaxAC /end OUT_MEASUREMENT FUNCTION_VERSION "2.12.0" /end FUNCTION
/begin FUNCTION CoTS_ThermDem "1.15.0    Thermal System Coordinator Demand - Thermal demand" /begin DEF_CHARACTERISTIC CoTS_tClntEngOutDes_C CoTS_tiPT1Neg_C CoTS_tiPT1Pos_C /end DEF_CHARACTERISTIC /begin IN_MEASUREMENT CoVeh_rClgDes CoVeh_tClntDes /end IN_MEASUREMENT /begin OUT_MEASUREMENT CoTS_rClgDem CoTS_tClntEngOutDes /end OUT_MEASUREMENT /begin LOC_MEASUREMENT CoTS_tClntDesFlt /end LOC_MEASUREMENT FUNCTION_VERSION "1.15.0" /end FUNCTION
/begin FUNCTION COVEH2ME "135.1.0   Interface adapter CoVeh to MED 7/9" /begin IN_MEASUREMENT CoVeh_stEngStopOrd CoVeh_stEngStrtOrd /end IN_MEASUREMENT /begin OUT_MEASUREMENT B_staanf_msg B_stoanf_msg /end OUT_MEASUREMENT FUNCTION_VERSION "135.1.0" /end FUNCTION
/begin FUNCTION CoVMD_TrqCalc "233.2.0   Torque Calculation of Vehicle Motion Demand"
 /begin DEF_CHARACTERISTIC CoVMD_cntrIDASFailDetn_C CoVMD_drIDASReqNeg_C CoVMD_drIDASReqPos_C CoVMD_facIDASFailDetn_C CoVMD_flgIDASMTCluOffEna_C CoVMD_flgSwtRatSelnTqPull_C CoVMD_nAPPReqChg_AXIS CoVMD_ratACCCVTMinWoRamp_C CoVMD_ratACCMinWoRamp_C CoVMD_ratIDASReqLoLim_C CoVMD_ratLLimCVTMinWoRamp_C CoVMD_ratLLimMinWoRamp_C CoVMD_ratVirtMaxThd_C CoVMD_rReqChng_GT CoVMD_rSptReqChng_GT CoVMD_stSwtAPMapSeln_C CoVMD_swtCCASLTrqSeln_C CoVMD_swtCCSelVal_C CoVMD_swtCrCtlDemSel_C CoVMD_swtMoFSel_C CoVMD_tiACCCVTRampSlop_CA CoVMD_tiACCRampSlop_CA CoVMD_tiBrkFailDeb_C CoVMD_tiIDASFailBrkDetn_C CoVMD_tiIDASReqLim_T CoVMD_tiLLimCVTRampSlop_CA CoVMD_tiLLimRampSlop_CA CoVMD_tiTqFild_T CoVMD_tqCrCtlReqDft_C CoVMD_tqCvtEcoATMod1_M CoVMD_tqCvtEcoATMod2_M CoVMD_tqCvtEcoATMod3_M CoVMD_tqCvtEcoATMod4_M CoVMD_tqCvtEcoATMod5_M CoVMD_tqCvtEcoATMod6_M CoVMD_tqCvtEcoATMod7_M CoVMD_tqCvtEcoDwnHill1_M CoVMD_tqCvtEcoDwnHill2_M CoVMD_tqCvtEcoDwnHill3_M CoVMD_tqCvtEcoDwnHill4_M CoVMD_tqCvtEcoDwnHill5_M CoVMD_tqCvtEcoDwnHill6_M CoVMD_tqCvtEcoLModOff_M CoVMD_tqCvtEcoLModOn_M CoVMD_tqCvtEcoLnchD_M CoVMD_tqCvtEcoLnchE_M CoVMD_tqCvtEcoLnchL_M CoVMD_tqCvtEcoLnchS_M CoVMD_tqCvtEcoNormD12_M CoVMD_tqCvtEcoNormD2_M CoVMD_tqCvtEcoNormD_M CoVMD_tqCvtEcoNormE12_M CoVMD_tqCvtEcoNormE1_M CoVMD_tqCvtEcoNormE2_M CoVMD_tqCvtEcoNormE_M CoVMD_tqCvtEcoNormS0_M CoVMD_tqCvtEcoNormS1_M CoVMD_tqCvtEcoNormS2_M CoVMD_tqCvtEcoNormSP_M CoVMD_tqCvtEcoTipMod1_M CoVMD_tqCvtEcoTipMod2_M CoVMD_tqCvtEcoTipMod3_M CoVMD_tqCvtEcoTipMod4_M CoVMD_tqCvtEcoTipMod5_M CoVMD_tqCvtEcoTipMod6_M CoVMD_tqCvtEcoTipMod7_M CoVMD_tqCvtNormATMod1_M CoVMD_tqCvtNormATMod2_M CoVMD_tqCvtNormATMod3_M CoVMD_tqCvtNormATMod4_M CoVMD_tqCvtNormATMod5_M CoVMD_tqCvtNormATMod6_M CoVMD_tqCvtNormATMod7_M CoVMD_tqCvtNormDwnHill1_M CoVMD_tqCvtNormDwnHill2_M CoVMD_tqCvtNormDwnHill3_M CoVMD_tqCvtNormDwnHill4_M CoVMD_tqCvtNormDwnHill5_M CoVMD_tqCvtNormDwnHill6_M CoVMD_tqCvtNormLModOff_M CoVMD_tqCvtNormLModOn_M CoVMD_tqCvtNormLnchD_M CoVMD_tqCvtNormLnchE_M CoVMD_tqCvtNormLnchL_M CoVMD_tqCvtNormLnchS_M CoVMD_tqCvtNormNormD12_M CoVMD_tqCvtNormNormD2_M CoVMD_tqCvtNormNormD_M CoVMD_tqCvtNormNormE12_M CoVMD_tqCvtNormNormE1_M CoVMD_tqCvtNormNormE2_M CoVMD_tqCvtNormNormE_M CoVMD_tqCvtNormNormS0_M CoVMD_tqCvtNormNormS1_M CoVMD_tqCvtNormNormS2_M CoVMD_tqCvtNormNormSP_M CoVMD_tqCvtNormTipMod1_M CoVMD_tqCvtNormTipMod2_M CoVMD_tqCvtNormTipMod3_M CoVMD_tqCvtNormTipMod4_M CoVMD_tqCvtNormTipMod5_M CoVMD_tqCvtNormTipMod6_M CoVMD_tqCvtNormTipMod7_M CoVMD_tqIDASFailOffs_C CoVMD_tqIDASTarThd_C CoVMD_trqThresCtOffLo_C CoVMD_trqThresCtOffUp_C CoVMD_vIDASFailDetn_C /end DEF_CHARACTERISTIC
 /begin REF_CHARACTERISTIC AccPed_flgNotSwilLossCmp_C AccPed_flgSelFacCmpAcs_C AccPed_rAPPHysHi_C AccPed_rAPPHysLo_C AccPed_rThdMaxCmp_C AccPed_rThdNoCmp_C AccPed_swtFilActvn_C AccPed_tiGearFildFil_CA AccPed_tiGearFildRmp_CA AccPed_tqCvtEcoEng0_M AccPed_tqCvtEcoEng1_M AccPed_tqCvtEcoEng2_M AccPed_tqCvtEcoEng3_M AccPed_tqCvtEcoEng4_M AccPed_tqCvtEcoEng5_M AccPed_tqCvtEcoEng6_M AccPed_tqCvtEcoEng7_M AccPed_tqCvtEcoEng8_M AccPed_tqCvtEng0_M AccPed_tqCvtEng1_M AccPed_tqCvtEng2_M AccPed_tqCvtEng3_M AccPed_tqCvtEng4_M AccPed_tqCvtEng5_M AccPed_tqCvtEng6_M AccPed_tqCvtEng7_M AccPed_tqCvtEng8_M AccPed_tqFilSwtOffLim_C AccPed_tqMinWoRamp_C AccPed_tqMTGear1_M AccPed_tqMTGear2_M AccPed_tqMTGear3_M AccPed_tqMTGear4_M AccPed_tqMTGear5_M AccPed_tqMTGear6_M AccPed_trqMod1Gear1_M AccPed_trqMod1Gear2_M AccPed_trqMod1Gear3_M AccPed_trqMod1Gear4_M AccPed_trqMod1Gear5_M AccPed_trqMod1Gear6_M /end REF_CHARACTERISTIC
 /begin IN_MEASUREMENT AccPed_flgChgGearDetn AccPed_flgDrvModChg AccPed_nrGearFildTmp AccPed_rTrq AccPed_swtDrvMod ACC_bBrkReq APP_r Brk_st Brk_stEBBBrkDetn CoME_trqDesComp Com_bBrkPedON Com_numCvtGearShiftMap Com_rTrqCnvBoost Com_rVirtAPP Com_stACCActv Com_stIDASEngFail Com_stIDASInhb Com_tqIDASTar Com_trq2IDASTar CoVeh_trqAcs CrCtl_nTrqOffChkAdd CrCtl_nTrqOffReqChk CrCtl_numATType CrCtl_rACCBrkReqChg CrCtl_rDes CrCtl_rGearNo0 CrCtl_rGearNo1 CrCtl_rGearNo2 CrCtl_rGearNo3 CrCtl_stActive CrCtl_stIdasbCanErr CrCtl_tiACCInfo CrCtl_tiAutoBrkHold CrCUI_nEngSpd CrCUI_stACCClthOn CrCUI_stGearDownNo Epm_nEng LLim_aReq LLim_rDes LLim_stActive LLim_stASLIdasbCanErr LLim_stMSLActv LLim_stReq LsComp_bLossCmpActvd MoFDrAs_stPtdMsg PT_nClth PT_rTrq PT_stTraType PT_trqLos RngMod_trqComp RngMod_trqCrSMax RngMod_trqCrSMin RngMod_trqCrSMinWoCtOff RngMod_trqDiffAdap RngMod_trqInrMinWoCtOff RngMod_trqLosEng SpdGov_facComp SyC_ctPostDrvLeave T15_st Tra_rGearCVT1Hi Tra_rGearCVT1Lo Tra_rGearCVT2Hi Tra_rGearCVT2Lo Tra_rGearCVT3Hi Tra_rGearCVT3Lo Tra_rGearCVT4Hi Tra_rGearCVT4Lo Tra_rGearCVT5Hi Tra_rGearCVT5Lo Tra_rGearCVT6Hi Tra_rGearCVT6Lo Tra_rGearCVT7Hi Tra_rGearCVT7Lo Tra_trqLos VehMot_a2trq VehMot_rTrqDfftl VehMot_trqDrag VehV_v /end IN_MEASUREMENT
 /begin OUT_MEASUREMENT CoVMD_bCtOffPhdCrCtl CoVMD_bCtOffPhdLLim CoVMD_facCompAcs CoVMD_facCompAcsCMTCLsAEB CoVMD_facCompAcsCrCtl CoVMD_facCompAcsLLim CoVMD_flgIDASFailDetn CoVMD_flgIDASMTCluOffEna CoVMD_r CoVMD_ratCrsCtrlLLimIDASReq CoVMD_rCMTCLsAEBReq CoVMD_rCrCtl CoVMD_rCrCtlACCReq CoVMD_rLLimACCReq CoVMD_rReqChg CoVMD_rSptReqChg CoVMD_stLoLimActv CoVMD_stReqCrCtl CoVMD_stSwtCCASLTqSeln CoVMD_swtCCSel CoVMD_tqCMTCLsAEB CoVMD_tqCrCtlACCReq CoVMD_tqCrsCtrlIDASACCReq CoVMD_tqDesWhlWoCmp CoVMD_tqIntrpnCvt2EcoAry CoVMD_tqIntrpnCvt2NormAry CoVMD_tqIntrpnEco1Ary CoVMD_tqIntrpnEco2Ary CoVMD_tqIntrpnEcoAry CoVMD_tqIntrpnEcoMTAry CoVMD_tqIntrpnNorm1Ary CoVMD_tqIntrpnNorm2Ary CoVMD_tqIntrpnNormAry CoVMD_tqIntrpnNormMTAry CoVMD_tqLLimACCReq CoVMD_tqMaxAllwdIDAS CoVMD_tqMinAllwdIDAS CoVMD_trqCrCtl CoVMD_trqLLim /end OUT_MEASUREMENT
 /begin LOC_MEASUREMENT CoVMD_cntrAryRst CoVMD_cntrIDASFailDetn CoVMD_cntrReIni CoVMD_facACC CoVMD_facACCStep CoVMD_facAppMaxCmp CoVMD_facLLim CoVMD_facLLimStep CoVMD_facModSwt CoVMD_facModSwtStep CoVMD_flgACCRampActv CoVMD_flgBrkDetn CoVMD_flgBrkFailDeb CoVMD_flgDrvActv CoVMD_flgIDASCntrRst CoVMD_flgIDASFailBrkCdn CoVMD_flgIDASFailTqCdn CoVMD_flgRampLLimActv CoVMD_nDesVal CoVMD_nTrqOffLimA CoVMD_nTrqOffLimB CoVMD_ratCvtEco2 CoVMD_ratIDASCVTEco CoVMD_ratIDASCVTNorm CoVMD_ratIDASCvtNorm2 CoVMD_ratIDASMTEco CoVMD_ratIDASMTNorm CoVMD_ratIDASReq CoVMD_ratIDASReqLim CoVMD_ratIDASReqMax CoVMD_ratIDASReqNewTmp CoVMD_ratIDASReqOld CoVMD_ratIDASReqOldTmp CoVMD_ratVirtMax CoVMD_rIDASCrsCluOffReq CoVMD_rIDASReqTmp CoVMD_rTq CoVMD_rTqFild CoVMD_rVirtApp CoVMD_stRampActv CoVMD_tiACCRampSlop CoVMD_tiBrkFailDeb CoVMD_tiIDASReqLim CoVMD_tiLLimRampSlop CoVMD_tiTqFild CoVMD_tqBasDif CoVMD_tqBasFild CoVMD_tqBasMod1 CoVMD_tqBasMod1MT CoVMD_tqBasMod2 CoVMD_tqBasModNew CoVMD_tqBasModOld CoVMD_tqBasPrev CoVMD_tqBasUnfild CoVMD_tqCmpLossSum CoVMD_tqCmpLossSumWoFac CoVMD_tqCmpNotSwilLoss CoVMD_tqCmpNotSwilLossWoFac CoVMD_tqCmpSwilLoss CoVMD_tqCmpSwilLossWoFac CoVMD_tqCrCtlWiLimn CoVMD_tqCvtEcoEng0 CoVMD_tqCvtEcoEng1 CoVMD_tqCvtEcoEng12 CoVMD_tqCvtEcoEng2 CoVMD_tqCvtEcoEng23 CoVMD_tqCvtEcoEng3 CoVMD_tqCvtEcoEng34 CoVMD_tqCvtEcoEng4 CoVMD_tqCvtEcoEng45 CoVMD_tqCvtEcoEng5 CoVMD_tqCvtEcoEng56 CoVMD_tqCvtEcoEng6 CoVMD_tqCvtEcoEng67 CoVMD_tqCvtEcoEng7 CoVMD_tqCvtEcoEng78 CoVMD_tqCvtEcoEng8 CoVMD_tqCVTEng0 CoVMD_tqCVTEng1 CoVMD_tqCVTEng12 CoVMD_tqCVTEng2 CoVMD_tqCVTEng23 CoVMD_tqCVTEng3 CoVMD_tqCVTEng34 CoVMD_tqCVTEng4 CoVMD_tqCVTEng45 CoVMD_tqCVTEng5 CoVMD_tqCVTEng56 CoVMD_tqCVTEng6 CoVMD_tqCVTEng67 CoVMD_tqCVTEng7 CoVMD_tqCVTEng78 CoVMD_tqCVTEng8 CoVMD_tqDesInnrWoCmp CoVMD_tqDesTmp CoVMD_tqDesTmpWhl CoVMD_tqDrgWhlLvl CoVMD_tqEcoMaxIDAS CoVMD_tqGearDesCVT CoVMD_tqGearDesMT CoVMD_tqGearMod1CVT CoVMD_tqIDASACCReq CoVMD_tqIDASACCWhlWithLoss CoVMD_tqIDASFailOffs1 CoVMD_tqIDASFailThd1 CoVMD_tqIDASFailThd2 CoVMD_tqInnrLvlIDASACCReq CoVMD_tqLLim CoVMD_tqLossSum CoVMD_tqMapBasd CoVMD_tqMinAbslt CoVMD_tqNewTmp CoVMD_tqNormMaxIDAS CoVMD_tqNotSwilLoss CoVMD_tqOldTmp CoVMD_tqPrpnCrCtlLLim CoVMD_tqWhlCmpTmp CoVMD_tqWhlMax CoVMD_tqWhlMinEng CoVMD_tqWhlMinWoFco CoVMD_tqWoCtOff /end LOC_MEASUREMENT
 FUNCTION_VERSION "233.2.0" /end FUNCTION
/begin FUNCTION CoVMD_TrqDesCoord "233.1.0   Coordination of propulsion torque in vehicle motion demand"
 /begin DEF_CHARACTERISTIC CoVMD_TrqDesCoord_CW CoVMD_trqThresCrCtlL_C CoVMD_trqThresCrCtlR_C CoVMD_trqThresLLimL_C CoVMD_trqThresLLimR_C /end DEF_CHARACTERISTIC
 /begin IN_MEASUREMENT ACCI_bACCPrs AccPed_facCompAcs AccPed_rTrq AccPed_trqDes CoVMD_bCtOffPhdCrCtl CoVMD_bCtOffPhdLLim CoVMD_facCompAcs CoVMD_stLoLimActv CoVMD_stReqCrCtl CoVMD_tqCMTCLsAEB CoVMD_trqCrCtl CoVMD_trqLLim CrCtl_bCtOffPhd CrCtl_stActive LLim_stActive LLim_stReq PT_trqLos VehMot_stPrpAccPed /end IN_MEASUREMENT
 /begin OUT_MEASUREMENT CoVMD_flgIdleDrv VehMot_facCompAcs VehMot_stCtOffPhd VehMot_stPrpCrCtl VehMot_stPrpLLim VMD_tqCluDes VMD_trqDes /end OUT_MEASUREMENT
 FUNCTION_VERSION "233.1.0" /end FUNCTION
/begin FUNCTION CoVOM_SSE "65.2.0    Coordinator Vehicle Operation Mode_Stop Start Engine"
 /begin DEF_CHARACTERISTIC CoVOM_agDeltaRefPosnIntk_C CoVOM_bClthPTRls_C CoVOM_bRstvXMaxCOM_C CoVOM_bSSEEngStrtWoFrstStrt_C CoVOM_bSSEEngStrtWoStSp_C CoVOM_bSSERstrtEng_C CoVOM_bSSEUIStrtReq_C COVOM_cntTotRlyOperMax_C CoVOM_ctStopEngMax_C CoVOM_flgCoMEna_C CoVOM_flgEngRunDetCoM_C CoVOM_flgStrtrChkDi_C CoVOM_flgSwtBrkHldAvl_C CoVOM_flgSwtEngSpdChkEna_C CoVOM_flgSwtLSFAvl_C CoVOM_flgSwtStrtReqBrkFldP_C CoVOM_nEngRstrtEngStallThd_C CoVOM_nEngStopDelta_C CoVOM_nEngStsDetnBefIdleSpd_C CoVOM_numEngStrtAbrtMax_C COVOM_pAtmPThdDelta_C COVOM_pAtmPThd_C CoVOM_pRelChgThd_C CoVOM_rAPPHysHi_C CoVOM_rAPPHysLo_C CoVOM_rAPPOnThres_C CoVOM_rAPPStrtMin_C CoVOM_stAutoRstrtReqMsk_C CoVOM_stClthSigSel_C CoVOM_stDrvMod1_C CoVOM_stDrvMod2_C CoVOM_stDrvMod3_C CoVOM_stEngStallReasMask_C CoVOM_stIgrBrkPedStrtReq_C CoVOM_stISGoStbMask_C CoVOM_stStopRelsMask_C CoVOM_stStopReqMask_C CoVOM_stStrtEnaMask_C CoVOM_stStrtReqMask_C CoVOM_stSysOffRelsMask_C CoVOM_stSysOffTrigMask_C CoVOM_stVehMktSelSwt_C CoVOM_swtACType_C CoVOM_swtCluBasdRstrtRels_C CoVOM_swtDrvModSeln_C CoVOM_swtSSEEna_C CoVOM_swtTrigCamsftRefEna_C CoVOM_tiACISSInhbReqDeb_C CoVOM_tiAPPMoF_C CoVOM_tiBdIntStopEnaDeb_C CoVOM_tiBrkHldMoF_C CoVOM_tiBrkHldStbyOff_C CoVOM_tiBrkMaxMoF_C CoVOM_tiBrkMoF_C CoVOM_tiBrkPedStopEnaDeb_C CoVOM_tiBrkRstrtAllw_C CoVOM_tiCoEngStopEnaDeb_C CoVOM_tiDrvStopReqDeb_C CoVOM_tiEngCrkAbortThd_C CoVOM_tiEngInhbReqDeb_C CoVOM_tiEngRstrtOrdDly_C CoVOM_tiEngRstrtReqHiLo_C CoVOM_tiEngRstrtReqLoHi_C CoVOM_tiEngStall_C CoVOM_tiEngStrtOrdDly_C CoVOM_tiEPSStopReqDeb_C CoVOM_tiESSStopEnaDeb_C CoVOM_tiESSStrtReqDly_C CoVOM_tiFrntDefrstSwtDeb_C CoVOM_tiFwdGearDly_C CoVOM_tiMaxStopReq_C CoVOM_tiNEngStopReqDeb_C CoVOM_tiPTStopEnaDeb_C CoVOM_tiPTStopReqDeb_C CoVOM_tiRstrtRelsPtd_C CoVOM_tiSeatBltOffDly_C CoVOM_tiStrtReq_C CoVOM_tiSysOffAutRstrt_C CoVOM_tiTraGearStopEnaDeb_C CoVOM_tiTranDly_C CoVOM_tiTranISSEngRunng_C CoVOM_tiTraStopReqDeb_C CoVOM_tiTSStopEnaDeb_C CoVOM_tiUpDwnSpdLim_C CoVOM_tiVehCdnStopTrigDly_C CoVOM_tiVehVCondDeb_C CoVOM_tiVSAStopReqDeb_C CoVOM_tiWaitStrtAbrt_C CoVOM_vDurgRToDTran_C CoVOM_vISSuppSpdThd_C CoVOM_vWhlSpdThresHi_C CoVOM_vWhlSpdThresLo_C CoVOM_vXMaxEngStop_C CoVOM_vXMaxSinceStrtMin_C CoVOM_vXMaxSinceStrt_C CoVOM_vXSpdDiff_C /end DEF_CHARACTERISTIC
 /begin IN_MEASUREMENT ACC_bBrkReq APP_r BdInt_bEngStopEna BrkPed_bEngStopEna BrkPed_bEngStrtReq BrkPed_flgEBBEngSysOff BrkPed_flgISABBrkPSuffVehStill BrkPed_flgSlopeExcd BrkPed_flgSwtISABAvl BrkPed_flgVehStandStill BrkPed_pRel BrkPed_tqIMGISABIdleStop Brk_stEBBBrkDetn B_vhegfe Clth3_st Clth4_st Clth_st CoEng_bStalEng CoEng_bStopEna CoEng_bStrtDes CoEng_st CoEng_stMai CoEng_stOld CoEng_stStalEngReas Com_bBrkPedON Com_stACISSInhbReqRes Com_stBrkHldSys Com_stCfmdPPosnPTCAN Com_stCVTShiftActv Com_stDrvModSwt Com_stEngHoodOpn Com_stEngInhibReq Com_stEPBStInfo Com_stEPSISSInhbReq Com_stEPSISSRstrtReq Com_stFrntDfrstSwtInfoRes Com_stIMGISBrkHldActv Com_stIMGISBrkHldStb Com_stIMGISRlsReq Com_stIMGISRstrtInhbBrk Com_stIMGISShiftInhbBrk Com_stISABAct Com_stISABEna Com_stPCUEngStrtInhb Com_stSeatBltInfo Com_stShftInPark Com_stSptSwtDeb Com_tqBrkOper CoVeh_stIgnLckTerm15 Eep_stISSStorgDiagActv EngStrt_nEngRstrtStgy2ThdLo EnvP_p Epm_nEng10ms Epm_nEngTooth10ms ESS_bEngStopEna ESS_bEngStrtEna ESS_bEngStrtReq Gbx_stActvNPos Gbx_stGearLvr Gbx_stNPos Gbx_stPNPosnDeb Gbx_stRvsPos GEVCtl_agRefPosnIntkB1 GEVlv_agIntkB1 GlbDa_vAvrgWhlSpd GlbDa_vWhlSpdFlt GlbDa_vX HLSDem_nSetPLo I14229_stABSFailCnclActv I14229_stIdlStopCdn I14229_stIdlStopPhd MoF_stStrtMsg MoF_stStrtStopEnaMsg PT_bEngStopEna PT_bEngStopReq PT_bEngStrtEna PT_bEngStrtReq PT_stTraType SSEUI_stCANErrMask StrtCtl_stIdleSpStTiLimHist Strt_cntTotRlyOper Strt_ctStopEngTot Strt_st StSpSwt_st SysDiag_flgCModJdg T15_st Tra_numGear TS_bEngStopEna TS_bEngStrtReq VehMot_stBrkPed /end IN_MEASUREMENT
 /begin OUT_MEASUREMENT CoVeh_stEngStopOrd CoVeh_stEngStrtOrd CoVOM_bAbortedStopReq CoVOM_bACStopReqTimeout CoVOM_bAutoRstrtReq CoVOM_bChangeOfMind CoVOM_bCVTIdleStop CoVOM_bCVTStopEna CoVOM_bDEFInhbReqIndcn CoVOM_bEngFrstStrtPassed CoVOM_bEngPreStrtOrd CoVOM_bRvsHist CoVOM_bSSEEna CoVOM_bSSEEngStopPassed CoVOM_bSSEUIStrtReq CoVOM_bStopDrvReq CoVOM_bStopEna CoVOM_bStopReq CoVOM_bStopTraReq CoVOM_bStrtEna CoVOM_bStrtReq CoVOM_bSysOff CoVOM_bVehCdnStopTrig CoVOM_bVXSinceStrtDeb CoVOM_flgEngRstrtInhb CoVOM_flgEngStallAftDly CoVOM_flgSeatBltOff CoVOM_flgTrigCamsftRefPosn CoVOM_numEngStrtAbrt CoVOM_stEngCrkAbort CoVOM_stEngRstrtPreReq CoVOM_stEngRstrtReq CoVOM_stEngStopPreCdn CoVOM_stISGoJud CoVOM_stISGoStb CoVOM_stISSEng CoVOM_stISStopInhb CoVOM_stISSuppVehSpd CoVOM_stMaxNrStrtOperExcdd CoVOM_stSSE CoVOM_stStop CoVOM_stStopEnaBit8Excl CoVOM_stStopEnaDspl CoVOM_stStopEnblByVehCdn CoVOM_stStopReqCdn CoVOM_stStopReqDspl CoVOM_stStopRls CoVOM_stStrt CoVOM_stStrtEnaCdn CoVOM_stStrtEnaDspl CoVOM_stStrtReqBefMsk CoVOM_stStrtReqCdn CoVOM_stStrtReqCluPosn CoVOM_stStrtReqDspl CoVOM_stSysOffTrigAftMsk CoVOM_stSysOffTrigBefMsk CoVOM_stSysOffTrigMask /end OUT_MEASUREMENT
 /begin LOC_MEASUREMENT CoVOM_bNeutBasdRstrt CoVOM_bRvsGearTran CoVOM_bSeatBltBasdRstrt CoVOM_bVXEngStopRea_mp CoVOM_ctFirstVldChk CoVOM_flgAllwRstrtBrk CoVOM_flgBrkHldStbyOff CoVOM_flgBrkOffMoFPrmt CoVOM_flgChgOfMndReq CoVOM_flgLSFActvStrtReq_MP CoVOM_flgMoFPrmt CoVOM_flgRstrtReqBrkOn CoVOM_flgStrtAbortMoF CoVOM_pRelThdForStrtReq CoVOM_stEngCrkAbortReqd CoVOM_stEngInhbReqEna CoVOM_stEngRstrtEnaCdn CoVOM_stEngRstrtReqd CoVOM_stEngRstrtTrigReq CoVOM_stEngStall CoVOM_stEngStrtdOnce CoVOM_stISSEngTemp CoVOM_stISSEngTempOld COVOM_stNotHiAlti CoVOM_stPrkgPosn CoVOM_stRstrtReqByVehCdn CoVOM_stStrtAbort CoVOM_stSysOffRelsCdn CoVOM_stTraStrtReq_MP CoVOM_tiEngRstrtAbort CoVOM_tiSpdBlwChk CoVOM_tiSpdBlwTmr CoVOM_tiSpdExcdChk CoVOM_tiSpdExcdTmr CoVOM_tiStopReqWoEna_mp CoVOM_tiUpDwnSpdHist CoVOM_vISFrqRstrcnSpd CoVOM_vWhlSpdMax CoVOM_vWhlSpdMedian CoVOM_vWhlSpdMin CoVOM_vWhlSpdSum /end LOC_MEASUREMENT
 FUNCTION_VERSION "65.2.0" /end FUNCTION
/begin FUNCTION CrCtl_Lib "3.0.0     Cruise Control Library functions" FUNCTION_VERSION "3.0.0" /end FUNCTION
/begin COMPU_METHOD APPCrCtl1 "" RAT_FUNC "%6.4" "%" COEFFS 0 200 0 0 0 1 /end COMPU_METHOD
/begin COMPU_METHOD B_TRUE "" TAB_VERB "%6.3" "" COMPU_TAB_REF B_TRUE /end COMPU_METHOD
/begin COMPU_VTAB B_TRUE "" TAB_VERB 2 0 "FALSE" 1 "TRUE" /end COMPU_VTAB
/begin COMPU_METHOD Dens_q0p001_COMPU "" RAT_FUNC "%6.5" "kg/m^3" COEFFS 0 1000 0 0 0 1 /end COMPU_METHOD
/begin COMPU_METHOD DRVPRGLMP_NORMLAMP_SC_Compu "" TAB_VERB "%6.3" "" COMPU_TAB_REF DRVPRGLMP_NORMLAMP_SC_Compu /end COMPU_METHOD
/begin COMPU_VTAB DRVPRGLMP_NORMLAMP_SC_Compu "" TAB_VERB 2 0 "False" 1 "True" /end COMPU_VTAB
/begin COMPU_METHOD DRVPRGLMP_SPTLAMP_SC_Compu "" TAB_VERB "%6.3" "" COMPU_TAB_REF DRVPRGLMP_SPTLAMP_SC_Compu /end COMPU_METHOD
/begin COMPU_VTAB DRVPRGLMP_SPTLAMP_SC_Compu "" TAB_VERB 2 0 "False" 1 "True" /end COMPU_VTAB
/begin COMPU_METHOD DRVPRGSWT_ECOSWT_SC_Compu "" TAB_VERB "%6.3" "" COMPU_TAB_REF DRVPRGSWT_ECOSWT_SC_Compu /end COMPU_METHOD
/begin COMPU_VTAB DRVPRGSWT_ECOSWT_SC_Compu "" TAB_VERB 4 0 "ECO_mode_not_available" 1 "ECO_mode_available_via_ADC" 2 "ECO_mode_available_via_DIO" 3 "ECO_mode_available_via_CAN" /end COMPU_VTAB
/begin COMPU_METHOD DRVPRGSWT_NORMSWT_SC_Compu "" TAB_VERB "%6.3" "" COMPU_TAB_REF DRVPRGSWT_NORMSWT_SC_Compu /end COMPU_METHOD
/begin COMPU_VTAB DRVPRGSWT_NORMSWT_SC_Compu "" TAB_VERB 4 0 "Normal_mode_not_available" 1 "Normal_mode_available_via_ADC" 2 "Normal_mode_available_via_DIO" 3 "Normal_mode_available_via_CAN" /end COMPU_VTAB
/begin COMPU_METHOD DRVPRGSWT_NUMSPRT_Compu "" RAT_FUNC "%6.2" "" COEFFS 0 1 0 0 0 1 /end COMPU_METHOD
/begin COMPU_METHOD DRVPRGSWT_NUMWNTR_Compu "" RAT_FUNC "%6.2" "" COEFFS 0 1 0 0 0 1 /end COMPU_METHOD
/begin COMPU_METHOD DRVPRGSWT_RCPTSWT_SC_Compu "" TAB_VERB "%6.3" "" COMPU_TAB_REF DRVPRGSWT_RCPTSWT_SC_Compu /end COMPU_METHOD
/begin COMPU_VTAB DRVPRGSWT_RCPTSWT_SC_Compu "" TAB_VERB 4 0 "Recuperation_switch_not_available" 1 "Recuperation_switch_information_available_via_ADC" 2 "Recuperation_switch_information_available_via_DIO" 3 "Recuperation_switch_information_available_via_CAN" /end COMPU_VTAB
/begin COMPU_METHOD DRVPRGSWT_SPTSWT_SC_Compu "" TAB_VERB "%6.3" "" COMPU_TAB_REF DRVPRGSWT_SPTSWT_SC_Compu /end COMPU_METHOD
/begin COMPU_VTAB DRVPRGSWT_SPTSWT_SC_Compu "" TAB_VERB 4 0 "Sport_mode_not_available" 1 "Sport_mode_available_via_ADC" 2 "Sport_mode_available_via_DIO" 3 "Sport_mode_available_via_CAN" /end COMPU_VTAB
/begin COMPU_METHOD DRVPRG_SC_Compu "" TAB_VERB "%6.3" "" COMPU_TAB_REF DRVPRG_SC_Compu /end COMPU_METHOD
/begin COMPU_VTAB DRVPRG_SC_Compu "" TAB_VERB 2 0 "False" 1 "True" /end COMPU_VTAB
/begin COMPU_METHOD DSCHED_COEOMEXT_SC_Compu "" TAB_VERB "%6.3" "" COMPU_TAB_REF DSCHED_COEOMEXT_SC_Compu /end COMPU_METHOD
/begin COMPU_VTAB DSCHED_COEOMEXT_SC_Compu "" TAB_VERB 10 0 "Standard_Only" 1 "Extended_SubModes" 2 "Extended_Modes2" 3 "Extended_Modes3" 4 "Extended_Modes4" 5 "Extended_Modes5" 6 "Extended_Modes6" 7 "Extended_Modes7" 8 "Extended_Modes8" 9 "Extended_Modes9" /end COMPU_VTAB
/begin COMPU_METHOD DSCHED_COEOM_SY_Compu "" TAB_VERB "%6.3" "" COMPU_TAB_REF DSCHED_COEOM_SY_Compu /end COMPU_METHOD
/begin COMPU_VTAB DSCHED_COEOM_SY_Compu "" TAB_VERB 2 0 "False" 1 "True" /end COMPU_VTAB
/begin COMPU_METHOD DSCHED_FIDMAXPRIOLST_SY_Compu "" RAT_FUNC "%6.2" "" COEFFS 0 1 0 0 0 1 /end COMPU_METHOD
/begin COMPU_METHOD DSCHED_FTI_SY_Compu "" TAB_VERB "%6.3" "" COMPU_TAB_REF DSCHED_FTI_SY_Compu /end COMPU_METHOD
/begin COMPU_VTAB DSCHED_FTI_SY_Compu "" TAB_VERB 2 0 "DSCHED_FTI_DISBL" 1 "DSCHED_FTI_ENA" /end COMPU_VTAB
/begin COMPU_METHOD DSCHED_PRIOACTVJMP_SY_Compu "" TAB_VERB "%6.3" "" COMPU_TAB_REF DSCHED_PRIOACTVJMP_SY_Compu /end COMPU_METHOD
/begin COMPU_VTAB DSCHED_PRIOACTVJMP_SY_Compu "" TAB_VERB 2 0 "DSCHED_PRIOACTVJMP_DISBL" 1 "DSCHED_PRIOACTVJMP_ENA" /end COMPU_VTAB
/begin COMPU_METHOD DSCHED_PRIODFCSTLDF_SY_Compu "" TAB_VERB "%6.3" "" COMPU_TAB_REF DSCHED_PRIODFCSTLDF_SY_Compu /end COMPU_METHOD
/begin COMPU_VTAB DSCHED_PRIODFCSTLDF_SY_Compu "" TAB_VERB 3 0 "DSCHED_DFCSTLDF_DISBL" 1 "DSCHED_DFCSTLDF_ENA_UNIF" 2 "DSCHED_DFCSTLDF_ENA_INDIV" /end COMPU_VTAB
/begin COMPU_METHOD DSCHED_PRIODFCSTTST_SY_Compu "" TAB_VERB "%6.3" "" COMPU_TAB_REF DSCHED_PRIODFCSTTST_SY_Compu /end COMPU_METHOD
/begin COMPU_VTAB DSCHED_PRIODFCSTTST_SY_Compu "" TAB_VERB 3 0 "DSCHED_DFCSTTST_DISBL" 1 "DSCHED_DFCSTTST_ENA_UNIF" 2 "DSCHED_DFCSTTST_ENA_INDIV" /end COMPU_VTAB
/begin COMPU_METHOD DSCHED_PRIOPHYSURGENCY_SY_Compu "" TAB_VERB "%6.3" "" COMPU_TAB_REF DSCHED_PRIOPHYSURGENCY_SY_Compu /end COMPU_METHOD
/begin COMPU_VTAB DSCHED_PRIOPHYSURGENCY_SY_Compu "" TAB_VERB 2 0 "DSCHED_PHYSURGENCY_DISBL" 1 "DSCHED_PHYSURGENCY_ENA" /end COMPU_VTAB
/begin COMPU_METHOD DSCHED_PRIORMPCALC_SY_Compu "" TAB_VERB "%6.3" "" COMPU_TAB_REF DSCHED_PRIORMPCALC_SY_Compu /end COMPU_METHOD
/begin COMPU_VTAB DSCHED_PRIORMPCALC_SY_Compu "" TAB_VERB 2 0 "DSCHED_PRIORMPCALC_DISBL" 1 "DSCHED_PRIORMPCALC_ENA" /end COMPU_VTAB
/begin COMPU_METHOD DSCHED_RATECALC_SY_Compu "" TAB_VERB "%6.3" "" COMPU_TAB_REF DSCHED_RATECALC_SY_Compu /end COMPU_METHOD
/begin COMPU_VTAB DSCHED_RATECALC_SY_Compu "" TAB_VERB 2 0 "DSCHED_RATECALC_DISBL" 1 "DSCHED_RATECALC_ENA" /end COMPU_VTAB
/begin COMPU_METHOD DSCHED_WTT_SY_Compu "" TAB_VERB "%6.3" "" COMPU_TAB_REF DSCHED_WTT_SY_Compu /end COMPU_METHOD
/begin COMPU_VTAB DSCHED_WTT_SY_Compu "" TAB_VERB 2 0 "DSCHED_WTT_DISBL" 1 "DSCHED_WTT_ENA" /end COMPU_VTAB
/begin COMPU_METHOD DSM2AUTOSAR_ASWPF_SC_Compu "" TAB_VERB "%6.3" "" COMPU_TAB_REF DSM2AUTOSAR_ASWPF_SC_Compu /end COMPU_METHOD
/begin COMPU_VTAB DSM2AUTOSAR_ASWPF_SC_Compu "" TAB_VERB 2 0 "No_Support" 1 "Support_BAC" /end COMPU_VTAB
/begin COMPU_METHOD DSM2AUTOSAR_SC_Compu "" TAB_VERB "%6.3" "" COMPU_TAB_REF DSM2AUTOSAR_SC_Compu /end COMPU_METHOD
/begin COMPU_VTAB DSM2AUTOSAR_SC_Compu "" TAB_VERB 2 0 "False" 1 "True" /end COMPU_VTAB
/begin COMPU_METHOD DSM2AUTOSAR_SECFCM_SC_Compu "" TAB_VERB "%6.3" "" COMPU_TAB_REF DSM2AUTOSAR_SECFCM_SC_Compu /end COMPU_METHOD
/begin COMPU_VTAB DSM2AUTOSAR_SECFCM_SC_Compu "" TAB_VERB 2 0 "No_Support" 1 "Support_3_Cond" /end COMPU_VTAB
/begin COMPU_METHOD DSM2SG_DFC_SY_Compu "" TAB_VERB "%6.3" "" COMPU_TAB_REF DSM2SG_DFC_SY_Compu /end COMPU_METHOD
/begin COMPU_VTAB DSM2SG_DFC_SY_Compu "" TAB_VERB 2 0 "False" 1 "True" /end COMPU_VTAB
/begin COMPU_METHOD DSM2SG_DSQ_SY_Compu "" TAB_VERB "%6.3" "" COMPU_TAB_REF DSM2SG_DSQ_SY_Compu /end COMPU_METHOD
/begin COMPU_VTAB DSM2SG_DSQ_SY_Compu "" TAB_VERB 2 0 "False" 1 "True" /end COMPU_VTAB
/begin COMPU_METHOD DSM2SG_EXCH_SC_Compu "" TAB_VERB "%6.3" "" COMPU_TAB_REF DSM2SG_EXCH_SC_Compu /end COMPU_METHOD
/begin COMPU_VTAB DSM2SG_EXCH_SC_Compu "" TAB_VERB 2 0 "FALSE" 1 "TRUE" /end COMPU_VTAB
/begin COMPU_METHOD DSM2SG_FID_SY_Compu "" TAB_VERB "%6.3" "" COMPU_TAB_REF DSM2SG_FID_SY_Compu /end COMPU_METHOD
/begin COMPU_VTAB DSM2SG_FID_SY_Compu "" TAB_VERB 2 0 "False" 1 "True" /end COMPU_VTAB
/begin COMPU_METHOD DSMAUX_TCSORT_SY_Compu "" TAB_VERB "%6.3" "" COMPU_TAB_REF DSMAUX_TCSORT_SY_Compu /end COMPU_METHOD
/begin COMPU_VTAB DSMAUX_TCSORT_SY_Compu "" TAB_VERB 2 0 "TCSORT_disabled" 1 "TCSORT_enabled" /end COMPU_VTAB
/begin COMPU_METHOD DSMBAS_CENSUPPDIUMPR_SC_Compu "" TAB_VERB "%6.3" "" COMPU_TAB_REF DSMBAS_CENSUPPDIUMPR_SC_Compu /end COMPU_METHOD
/begin COMPU_VTAB DSMBAS_CENSUPPDIUMPR_SC_Compu "" TAB_VERB 2 0 "Disabled" 1 "Enabled" /end COMPU_VTAB
/begin COMPU_METHOD DSMBAS_CENSUPPDTR_SC_Compu "" TAB_VERB "%6.3" "" COMPU_TAB_REF DSMBAS_CENSUPPDTR_SC_Compu /end COMPU_METHOD
/begin COMPU_VTAB DSMBAS_CENSUPPDTR_SC_Compu "" TAB_VERB 2 0 "Disabled" 1 "Enabled" /end COMPU_VTAB
/begin COMPU_METHOD DSMBAS_DARCORDARYLEN_SC_Compu "" RAT_FUNC "%6.2" "" COEFFS 0 1 0 0 0 1 /end COMPU_METHOD
/begin COMPU_METHOD DSMBAS_DARCORDENA_SC_Compu "" TAB_VERB "%6.3" "" COMPU_TAB_REF DSMBAS_DARCORDENA_SC_Compu /end COMPU_METHOD
/begin COMPU_VTAB DSMBAS_DARCORDENA_SC_Compu "" TAB_VERB 2 0 "False" 1 "True" /end COMPU_VTAB
/begin COMPU_METHOD DSMBAS_ENACFMDFLTCNTR_SC_Compu "" TAB_VERB "%6.3" "" COMPU_TAB_REF DSMBAS_ENACFMDFLTCNTR_SC_Compu /end COMPU_METHOD
/begin COMPU_VTAB DSMBAS_ENACFMDFLTCNTR_SC_Compu "" TAB_VERB 2 0 "DISABLE" 1 "ENABLE" /end COMPU_VTAB
/begin COMPU_METHOD DSMBAS_ENAFRQCNTRNOTRSTSRVPND_SC_Compu "" TAB_VERB "%6.3" "" COMPU_TAB_REF DSMBAS_ENAFRQCNTRNOTRSTSRVPND_SC_Compu /end COMPU_METHOD
/begin COMPU_VTAB DSMBAS_ENAFRQCNTRNOTRSTSRVPND_SC_Compu "" TAB_VERB 2 0 "False" 1 "True" /end COMPU_VTAB
/begin COMPU_METHOD DSMBAS_ENAOPTMZDRDNFORCMPHCPT_SC_Compu "" TAB_VERB "%6.3" "" COMPU_TAB_REF DSMBAS_ENAOPTMZDRDNFORCMPHCPT_SC_Compu /end COMPU_METHOD
/begin COMPU_VTAB DSMBAS_ENAOPTMZDRDNFORCMPHCPT_SC_Compu "" TAB_VERB 2 0 "DSMRDN_STDRDN" 1 "DSMRDN_OPTMZDRDN" /end COMPU_VTAB
/begin COMPU_METHOD DSMBAS_ENAPRIOSRVHIPLUS_SC_Compu "" TAB_VERB "%6.3" "" COMPU_TAB_REF DSMBAS_ENAPRIOSRVHIPLUS_SC_Compu /end COMPU_METHOD
/begin COMPU_VTAB DSMBAS_ENAPRIOSRVHIPLUS_SC_Compu "" TAB_VERB 2 0 "False" 1 "True" /end COMPU_VTAB
/begin COMPU_METHOD DSMBAS_ENASIMRCDN_SC_Compu "" TAB_VERB "%6.3" "" COMPU_TAB_REF DSMBAS_ENASIMRCDN_SC_Compu /end COMPU_METHOD
/begin COMPU_VTAB DSMBAS_ENASIMRCDN_SC_Compu "" TAB_VERB 2 0 "False" 1 "True" /end COMPU_VTAB
/begin COMPU_METHOD DSMBAS_ENVTLBLKUPD_SC_Compu "" TAB_VERB "%6.3" "" COMPU_TAB_REF DSMBAS_ENVTLBLKUPD_SC_Compu /end COMPU_METHOD
/begin COMPU_VTAB DSMBAS_ENVTLBLKUPD_SC_Compu "" TAB_VERB 2 0 "Frequency_Count" 1 "Fail_Count" /end COMPU_VTAB
/begin COMPU_METHOD DSMBAS_IRRVFLTINHB_SC_Compu "" TAB_VERB "%6.3" "" COMPU_TAB_REF DSMBAS_IRRVFLTINHB_SC_Compu /end COMPU_METHOD
/begin COMPU_VTAB DSMBAS_IRRVFLTINHB_SC_Compu "" TAB_VERB 2 0 "False" 1 "True" /end COMPU_VTAB
/begin COMPU_METHOD DSMBAS_KEYONCYCFLCTRIG_SC_Compu "" TAB_VERB "%6.3" "" COMPU_TAB_REF DSMBAS_KEYONCYCFLCTRIG_SC_Compu /end COMPU_METHOD
/begin COMPU_VTAB DSMBAS_KEYONCYCFLCTRIG_SC_Compu "" TAB_VERB 2 0 "False" 1 "True" /end COMPU_VTAB
/begin COMPU_METHOD DSMBAS_NEWDCYCWITHFCMCLR_SC_Compu "" TAB_VERB "%6.3" "" COMPU_TAB_REF DSMBAS_NEWDCYCWITHFCMCLR_SC_Compu /end COMPU_METHOD
/begin COMPU_VTAB DSMBAS_NEWDCYCWITHFCMCLR_SC_Compu "" TAB_VERB 2 0 "False" 1 "True" /end COMPU_VTAB
/begin COMPU_METHOD DSMBAS_NODFP_SC_Compu "" TAB_VERB "%6.3" "" COMPU_TAB_REF DSMBAS_NODFP_SC_Compu /end COMPU_METHOD
/begin COMPU_VTAB DSMBAS_NODFP_SC_Compu "" TAB_VERB 2 0 "False" 1 "True" /end COMPU_VTAB
/begin COMPU_METHOD DSMBAS_NODIAGCSDL_SC_Compu "" TAB_VERB "%6.3" "" COMPU_TAB_REF DSMBAS_NODIAGCSDL_SC_Compu /end COMPU_METHOD
/begin COMPU_VTAB DSMBAS_NODIAGCSDL_SC_Compu "" TAB_VERB 2 0 "False" 1 "True" /end COMPU_VTAB
/begin COMPU_METHOD DSMBAS_NODTR_SC_Compu "" TAB_VERB "%6.3" "" COMPU_TAB_REF DSMBAS_NODTR_SC_Compu /end COMPU_METHOD
/begin COMPU_VTAB DSMBAS_NODTR_SC_Compu "" TAB_VERB 2 0 "False" 1 "True" /end COMPU_VTAB
/begin COMPU_METHOD DSMBAS_PNDRPRTMOD2_SC_Compu "" TAB_VERB "%6.3" "" COMPU_TAB_REF DSMBAS_PNDRPRTMOD2_SC_Compu /end COMPU_METHOD
/begin COMPU_VTAB DSMBAS_PNDRPRTMOD2_SC_Compu "" TAB_VERB 2 0 "CONFIRMED" 1 "PENDING" /end COMPU_VTAB
/begin COMPU_METHOD EngN "" RAT_FUNC "%6.3" "rpm" COEFFS 0 2 0 0 0 1 /end COMPU_METHOD
/begin COMPU_METHOD EngNCrCtl "" RAT_FUNC "%6.2" "rpm" COEFFS 0 1 0 0 0 1 /end COMPU_METHOD
/begin COMPU_METHOD Fact "" RAT_FUNC "%6.5" "-" COEFFS 0 8192 0 0 0 1 /end COMPU_METHOD
/begin COMPU_METHOD kw_q0p0156 "" RAT_FUNC "%6.4" "Grad KW" COEFFS 0 64 0 0 0 1 /end COMPU_METHOD
/begin COMPU_METHOD OneToOne "" RAT_FUNC "%6.2" "-" COEFFS 0 1 0 0 0 1 /end COMPU_METHOD
/begin COMPU_METHOD Prc "" RAT_FUNC "%6.4" "%" COEFFS 0 81.92 0 0 0 1 /end COMPU_METHOD
/begin COMPU_METHOD Pres_hPa "" RAT_FUNC "%6.2" "hPa" COEFFS 0 1 0 0 0 1 /end COMPU_METHOD
/begin COMPU_METHOD RBPtCel_tq_1p0_1 "" RAT_FUNC "%6.2" "Nm" COEFFS 0 1 0 0 0 1 /end COMPU_METHOD
/begin COMPU_METHOD RBPtPwrTrn_stEngReq_VERB "" TAB_VERB "%6.3" "" COMPU_TAB_REF RBPtPwrTrn_stEngReq_VERB /end COMPU_METHOD
/begin COMPU_VTAB RBPtPwrTrn_stEngReq_VERB "" TAB_VERB 5 0 "NO_REQUEST" 1 "START" 2 "STOP" 3 "PANIC_START" 4 "RESET_START" /end COMPU_VTAB
/begin COMPU_METHOD Temp_Cels "" RAT_FUNC "%6.1" "deg C" COEFFS 0 10 2731.4 0 0 1 /end COMPU_METHOD
/begin COMPU_METHOD TimeDeb "" RAT_FUNC "%6.1" "ms" COEFFS 0 0.1 0 0 0 1 /end COMPU_METHOD
/begin COMPU_METHOD TimeDelay_s "" RAT_FUNC "%6.1" "s" COEFFS 0 0 1 0 0.00023283064365387 0 /end COMPU_METHOD
/begin COMPU_METHOD Time_ms "" RAT_FUNC "%6.1" "ms" COEFFS 0 0.1 0 0 0 1 /end COMPU_METHOD
/begin COMPU_METHOD Time_s "" RAT_FUNC "%6.4" "s" COEFFS 0 100 0 0 0 1 /end COMPU_METHOD
/begin COMPU_METHOD TransR "" RAT_FUNC "%6.4" "-" COEFFS 0 100 0 0 0 1 /end COMPU_METHOD
/begin COMPU_METHOD Trq "" RAT_FUNC "%6.3" "Nm" COEFFS 0 10 0 0 0 1 /end COMPU_METHOD
/begin COMPU_METHOD TrqPerSec "" RAT_FUNC "%6.2" "Nm/s" COEFFS 0 1 0 0 0 1 /end COMPU_METHOD
/begin COMPU_METHOD TrqPrpHigh "" RAT_FUNC "%6.3" "Nm" COEFFS 0 10 0 0 0 1 /end COMPU_METHOD
/begin COMPU_METHOD TrqToNSqr "" RAT_FUNC "%10.9" "-" COEFFS 0 10000000 0 0 0 1 /end COMPU_METHOD
/begin COMPU_METHOD t_q0p01 "" RAT_FUNC "%6.4" "s" COEFFS 0 100 0 0 0 1 /end COMPU_METHOD
/begin COMPU_METHOD uint8 "" RAT_FUNC "%6.2" "-" COEFFS 0 1 0 0 0 1 /end COMPU_METHOD
/begin COMPU_METHOD Vel "" RAT_FUNC "%6.4" "km/h" COEFFS 0 100 0 0 0 1 /end COMPU_METHOD
/begin RECORD_LAYOUT Kw_Ws16 FNC_VALUES 1 SWORD COLUMN_DIR DIRECT /end RECORD_LAYOUT
/begin RECORD_LAYOUT RB_Axis_S16 NO_AXIS_PTS_X 1 SWORD AXIS_PTS_X 2 SWORD INDEX_INCR DIRECT /end RECORD_LAYOUT
/begin RECORD_LAYOUT RB_CurveGroup_S16 FNC_VALUES 1 SWORD COLUMN_DIR DIRECT /end RECORD_LAYOUT
/begin RECORD_LAYOUT RB_Curve_S16_S16 NO_AXIS_PTS_X 1 SWORD AXIS_PTS_X 2 SWORD INDEX_INCR DIRECT FNC_VALUES 3 SWORD COLUMN_DIR DIRECT /end RECORD_LAYOUT
/begin RECORD_LAYOUT RB_Map_S16S16_S16 NO_AXIS_PTS_X 1 SWORD NO_AXIS_PTS_Y 2 SWORD AXIS_PTS_X 3 SWORD INDEX_INCR DIRECT AXIS_PTS_Y 4 SWORD INDEX_INCR DIRECT FNC_VALUES 5 SWORD COLUMN_DIR DIRECT /end RECORD_LAYOUT
/begin RECORD_LAYOUT RB_ValA_Ws16 FNC_VALUES 1 SWORD COLUMN_DIR DIRECT /end RECORD_LAYOUT
/begin RECORD_LAYOUT RB_Val_Wboolean FNC_VALUES 1 UBYTE COLUMN_DIR DIRECT /end RECORD_LAYOUT
/begin RECORD_LAYOUT RB_Val_Ws16 FNC_VALUES 1 SWORD COLUMN_DIR DIRECT /end RECORD_LAYOUT
/begin RECORD_LAYOUT RB_Val_Ws32 FNC_VALUES 1 SLONG COLUMN_DIR DIRECT /end RECORD_LAYOUT
/begin RECORD_LAYOUT RB_Val_Wu16 FNC_VALUES 1 UWORD COLUMN_DIR DIRECT /end RECORD_LAYOUT
/begin RECORD_LAYOUT RB_Val_Wu32 FNC_VALUES 1 ULONG COLUMN_DIR DIRECT /end RECORD_LAYOUT
/begin RECORD_LAYOUT RB_Val_Wu8 FNC_VALUES 1 UBYTE COLUMN_DIR DIRECT /end RECORD_LAYOUT
/begin RECORD_LAYOUT Val_Wu8 FNC_VALUES 1 UBYTE COLUMN_DIR DIRECT /end RECORD_LAYOUT
/end MODULE
/end PROJECT
