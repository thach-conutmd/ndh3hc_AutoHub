ASAP2_VERSION 1 60
/begin PROJECT MG1CS022 "MG1CS022"
/begin HEADER "" VERSION "MG1CS022_62XSC_V037" PROJECT_NO MG1CS022 /end HEADER
/begin MODULE DIM ""
/begin MOD_COMMON "" BYTE_ORDER MSB_LAST ALIGNMENT_BYTE 1 ALIGNMENT_WORD 2 ALIGNMENT_LONG 4 ALIGNMENT_INT64 4 ALIGNMENT_FLOAT32_IEEE 4 ALIGNMENT_FLOAT64_IEEE 4 DATA_SIZE 32 /end MOD_COMMON
/begin CHARACTERISTIC DINH_Lim.DFC_ComDLCTCU1_CA "inhibit conditions / inhibit limit conditions for inhibit source DFC_ComDLCTCU1" VAL_BLK 0x804FC93C ValA_Wu8 17.0000000000 DINH_LimDFCVerb 0.00 17.0000000000 FORMAT "%13.10" NUMBER 55 /end CHARACTERISTIC
/begin CHARACTERISTIC DINH_Lim.DFC_ComDLCTCU11_CA "inhibit conditions / inhibit limit conditions for inhibit source DFC_ComDLCTCU11" VAL_BLK 0x804FC973 ValA_Wu8 17.0000000000 DINH_LimDFCVerb 0.00 17.0000000000 FORMAT "%13.10" NUMBER 54 /end CHARACTERISTIC
/begin CHARACTERISTIC DINH_Lim.DFC_ComDLCTCU12_CA "inhibit conditions / inhibit limit conditions for inhibit source DFC_ComDLCTCU12" VAL_BLK 0x804FC9A9 ValA_Wu8 17.0000000000 DINH_LimDFCVerb 0.00 17.0000000000 FORMAT "%13.10" NUMBER 52 /end CHARACTERISTIC
/begin CHARACTERISTIC DINH_Lim.DFC_ComDLCTCU13_CA "inhibit conditions / inhibit limit conditions for inhibit source DFC_ComDLCTCU13" VAL_BLK 0x804FC9DD ValA_Wu8 17.0000000000 DINH_LimDFCVerb 0.00 17.0000000000 FORMAT "%13.10" NUMBER 52 /end CHARACTERISTIC
/begin CHARACTERISTIC DINH_Lim.DFC_ComDLCTCU14_CA "inhibit conditions / inhibit limit conditions for inhibit source DFC_ComDLCTCU14" VAL_BLK 0x804FCA11 ValA_Wu8 17.0000000000 DINH_LimDFCVerb 0.00 17.0000000000 FORMAT "%13.10" NUMBER 51 /end CHARACTERISTIC
/begin CHARACTERISTIC DINH_Lim.DFC_ComDLCTCU2_CA "inhibit conditions / inhibit limit conditions for inhibit source DFC_ComDLCTCU2" VAL_BLK 0x804FCA44 ValA_Wu8 17.0000000000 DINH_LimDFCVerb 0.00 17.0000000000 FORMAT "%13.10" NUMBER 52 /end CHARACTERISTIC
/begin CHARACTERISTIC DINH_Lim.DFC_ComDLCTCU3_CA "inhibit conditions / inhibit limit conditions for inhibit source DFC_ComDLCTCU3" VAL_BLK 0x804FCA78 ValA_Wu8 17.0000000000 DINH_LimDFCVerb 0.00 17.0000000000 FORMAT "%13.10" NUMBER 52 /end CHARACTERISTIC
/begin CHARACTERISTIC DINH_Lim.DFC_ComDLCTCU4_CA "inhibit conditions / inhibit limit conditions for inhibit source DFC_ComDLCTCU4" VAL_BLK 0x804FCAAC ValA_Wu8 17.0000000000 DINH_LimDFCVerb 0.00 17.0000000000 FORMAT "%13.10" NUMBER 51 /end CHARACTERISTIC
/begin CHARACTERISTIC DINH_Lim.DFC_ComEPSUnit_CA "inhibit conditions / inhibit limit conditions for inhibit source DFC_ComEPSUnit" VAL_BLK 0x804FCADF ValA_Wu8 17.0000000000 DINH_LimDFCVerb 0.00 17.0000000000 FORMAT "%13.10" NUMBER 50 /end CHARACTERISTIC
/begin CHARACTERISTIC DINH_Lim.DFC_ComIDASBUnit_CA "inhibit conditions / inhibit limit conditions for inhibit source DFC_ComIDASBUnit" VAL_BLK 0x804FCB11 ValA_Wu8 17.0000000000 DINH_LimDFCVerb 0.00 17.0000000000 FORMAT "%13.10" NUMBER 50 /end CHARACTERISTIC
/begin CHARACTERISTIC DINH_Lim.DFC_ComIMGUnit_CA "inhibit conditions / inhibit limit conditions for inhibit source DFC_ComIMGUnit" VAL_BLK 0x804FCB43 ValA_Wu8 17.0000000000 DINH_LimDFCVerb 0.00 17.0000000000 FORMAT "%13.10" NUMBER 50 /end CHARACTERISTIC
/begin CHARACTERISTIC DINH_Lim.DFC_ComMETUnit_CA "inhibit conditions / inhibit limit conditions for inhibit source DFC_ComMETUnit" VAL_BLK 0x804FCB75 ValA_Wu8 17.0000000000 DINH_LimDFCVerb 0.00 17.0000000000 FORMAT "%13.10" NUMBER 50 /end CHARACTERISTIC
/begin CHARACTERISTIC DINH_Lim.DFC_ComSRSUnit_CA "inhibit conditions / inhibit limit conditions for inhibit source DFC_ComSRSUnit" VAL_BLK 0x804FCBA7 ValA_Wu8 17.0000000000 DINH_LimDFCVerb 0.00 17.0000000000 FORMAT "%13.10" NUMBER 50 /end CHARACTERISTIC
/begin CHARACTERISTIC DINH_Lim.DFC_ComVSAUnit_CA "inhibit conditions / inhibit limit conditions for inhibit source DFC_ComVSAUnit" VAL_BLK 0x804FCBD9 ValA_Wu8 17.0000000000 DINH_LimDFCVerb 0.00 17.0000000000 FORMAT "%13.10" NUMBER 50 /end CHARACTERISTIC
/begin CHARACTERISTIC DINH_Lim.DFC_EbsSocFlt_CA "inhibit conditions / inhibit limit conditions for inhibit source DFC_EbsSocFlt" VAL_BLK 0x804FCC0B ValA_Wu8 17.0000000000 DINH_LimDFCVerb 0.00 17.0000000000 FORMAT "%13.10" NUMBER 50 /end CHARACTERISTIC
/begin CHARACTERISTIC DINH_Lim.DFC_I14229VINErr_CA "inhibit conditions / inhibit limit conditions for inhibit source DFC_I14229VINErr" VAL_BLK 0x804FCC3D ValA_Wu8 17.0000000000 DINH_LimDFCVerb 0.00 17.0000000000 FORMAT "%13.10" NUMBER 50 /end CHARACTERISTIC
/begin CHARACTERISTIC DINH_Lim.DFC_InjCatHeatgErr_CA "inhibit conditions / inhibit limit conditions for inhibit source DFC_InjCatHeatgErr" VAL_BLK 0x804FCC6F ValA_Wu8 17.0000000000 DINH_LimDFCVerb 0.00 17.0000000000 FORMAT "%13.10" NUMBER 50 /end CHARACTERISTIC
/begin CHARACTERISTIC DINH_Lim.DFC_InjSysMulInjDiagErr_CA "inhibit conditions / inhibit limit conditions for inhibit source DFC_InjSysMulInjDiagErr" VAL_BLK 0x804FCCA1 ValA_Wu8 17.0000000000 DINH_LimDFCVerb 0.00 17.0000000000 FORMAT "%13.10" NUMBER 50 /end CHARACTERISTIC
/begin CHARACTERISTIC DINH_Lim.DFC_LLRHmax_CA "inhibit conditions / inhibit limit conditions for inhibit source DFC_LLRHmax" VAL_BLK 0x804FCCD3 ValA_Wu8 17.0000000000 DINH_LimDFCVerb 0.00 17.0000000000 FORMAT "%13.10" NUMBER 58 /end CHARACTERISTIC
/begin CHARACTERISTIC DINH_Lim.DFC_LLRHmin_CA "inhibit conditions / inhibit limit conditions for inhibit source DFC_LLRHmin" VAL_BLK 0x804FCD0D ValA_Wu8 17.0000000000 DINH_LimDFCVerb 0.00 17.0000000000 FORMAT "%13.10" NUMBER 58 /end CHARACTERISTIC
/begin CHARACTERISTIC DINH_Lim.DFC_LLRHnpl_CA "inhibit conditions / inhibit limit conditions for inhibit source DFC_LLRHnpl" VAL_BLK 0x804FCD47 ValA_Wu8 17.0000000000 DINH_LimDFCVerb 0.00 17.0000000000 FORMAT "%13.10" NUMBER 58 /end CHARACTERISTIC
/begin CHARACTERISTIC DINH_Lim.DFC_LLRKHmax_CA "inhibit conditions / inhibit limit conditions for inhibit source DFC_LLRKHmax" VAL_BLK 0x804FCD81 ValA_Wu8 17.0000000000 DINH_LimDFCVerb 0.00 17.0000000000 FORMAT "%13.10" NUMBER 50 /end CHARACTERISTIC
/begin CHARACTERISTIC DINH_Lim.DFC_LLRKHmin_CA "inhibit conditions / inhibit limit conditions for inhibit source DFC_LLRKHmin" VAL_BLK 0x804FCDB3 ValA_Wu8 17.0000000000 DINH_LimDFCVerb 0.00 17.0000000000 FORMAT "%13.10" NUMBER 50 /end CHARACTERISTIC
/begin CHARACTERISTIC DINH_Lim.DFC_LLRKHnpl_CA "inhibit conditions / inhibit limit conditions for inhibit source DFC_LLRKHnpl" VAL_BLK 0x804FCDE5 ValA_Wu8 17.0000000000 DINH_LimDFCVerb 0.00 17.0000000000 FORMAT "%13.10" NUMBER 50 /end CHARACTERISTIC
/begin CHARACTERISTIC DINH_Lim.DFC_LinACGUnit_CA "inhibit conditions / inhibit limit conditions for inhibit source DFC_LinACGUnit" VAL_BLK 0x804FCE17 ValA_Wu8 17.0000000000 DINH_LimDFCVerb 0.00 17.0000000000 FORMAT "%13.10" NUMBER 50 /end CHARACTERISTIC
/begin CHARACTERISTIC DINH_Lim.DFC_LinAEVUnit_CA "inhibit conditions / inhibit limit conditions for inhibit source DFC_LinAEVUnit" VAL_BLK 0x804FCE49 ValA_Wu8 17.0000000000 DINH_LimDFCVerb 0.00 17.0000000000 FORMAT "%13.10" NUMBER 50 /end CHARACTERISTIC
/begin CHARACTERISTIC DINH_Lim.DFC_LinEBSUnit_CA "inhibit conditions / inhibit limit conditions for inhibit source DFC_LinEBSUnit" VAL_BLK 0x804FCE7B ValA_Wu8 17.0000000000 DINH_LimDFCVerb 0.00 17.0000000000 FORMAT "%13.10" NUMBER 50 /end CHARACTERISTIC
/begin CHARACTERISTIC DINH_Lim.DFC_RoughRoad_CA "inhibit conditions / inhibit limit conditions for inhibit source DFC_RoughRoad" VAL_BLK 0x804FCEAD ValA_Wu8 17.0000000000 DINH_LimDFCVerb 0.00 17.0000000000 FORMAT "%13.10" NUMBER 54 /end CHARACTERISTIC
/begin CHARACTERISTIC DINH_Lim.DFC_SiaEEPRdErr_CA "inhibit conditions / inhibit limit conditions for inhibit source DFC_SiaEEPRdErr" VAL_BLK 0x804FCEE3 ValA_Wu8 17.0000000000 DINH_LimDFCVerb 0.00 17.0000000000 FORMAT "%13.10" NUMBER 51 /end CHARACTERISTIC
/begin CHARACTERISTIC DINH_Lim.DFC_SiaEEPWrngCod_CA "inhibit conditions / inhibit limit conditions for inhibit source DFC_SiaEEPWrngCod" VAL_BLK 0x804FCF16 ValA_Wu8 17.0000000000 DINH_LimDFCVerb 0.00 17.0000000000 FORMAT "%13.10" NUMBER 51 /end CHARACTERISTIC
/begin CHARACTERISTIC DINH_Lim.DFC_UegoHeatrStrtS1B1_CA "inhibit conditions / inhibit limit conditions for inhibit source DFC_UegoHeatrStrtS1B1" VAL_BLK 0x804FCF49 ValA_Wu8 17.0000000000 DINH_LimDFCVerb 0.00 17.0000000000 FORMAT "%13.10" NUMBER 53 /end CHARACTERISTIC
/begin CHARACTERISTIC DINH_Lim.DFC_BusDiagCANAPPLBusOff_CA "inhibit conditions / inhibit limit conditions for inhibit source DFC_BusDiagCANAPPLBusOff" VAL_BLK 0x804FCF7E ValA_Wu8 17.0000000000 DINH_LimDFCVerb 0.00 17.0000000000 FORMAT "%13.10" NUMBER 50 /end CHARACTERISTIC
/begin CHARACTERISTIC DINH_Lim.DFC_BusDiagCANCANCBusOff_CA "inhibit conditions / inhibit limit conditions for inhibit source DFC_BusDiagCANCANCBusOff" VAL_BLK 0x804FCFB0 ValA_Wu8 17.0000000000 DINH_LimDFCVerb 0.00 17.0000000000 FORMAT "%13.10" NUMBER 50 /end CHARACTERISTIC
/begin CHARACTERISTIC DINH_Lim.DFC_BusDiagCANVEHICLEBusOff_CA "inhibit conditions / inhibit limit conditions for inhibit source DFC_BusDiagCANVEHICLEBusOff" VAL_BLK 0x804FCFE2 ValA_Wu8 17.0000000000 DINH_LimDFCVerb 0.00 17.0000000000 FORMAT "%13.10" NUMBER 61 /end CHARACTERISTIC
/begin CHARACTERISTIC DINH_Lim.DFC_RBA_IODIAGPWR_rba_IoExtCy329_SignalVltSply_0_CA "inhibit conditions / inhibit limit conditions for inhibit source DFC_RBA_IODIAGPWR_rba_IoExtCy329_SignalVltSply_0" VAL_BLK 0x804FD01F ValA_Wu8 17.0000000000 DINH_LimDFCVerb 0.00 17.0000000000 FORMAT "%13.10" NUMBER 200 /end CHARACTERISTIC
/begin CHARACTERISTIC DINH_Lim.DFC_RBA_IODIAGPWR_rba_IoExtCy329_SignalVltSply_0OT_CA "inhibit conditions / inhibit limit conditions for inhibit source DFC_RBA_IODIAGPWR_rba_IoExtCy329_SignalVltSply_0OT" VAL_BLK 0x804FD0E7 ValA_Wu8 17.0000000000 DINH_LimDFCVerb 0.00 17.0000000000 FORMAT "%13.10" NUMBER 50 /end CHARACTERISTIC
/begin CHARACTERISTIC DINH_Lim.DFC_RBA_IODIAGPWR_rba_IoExtCy329_SignalVltSply_0OV_CA "inhibit conditions / inhibit limit conditions for inhibit source DFC_RBA_IODIAGPWR_rba_IoExtCy329_SignalVltSply_0OV" VAL_BLK 0x804FD119 ValA_Wu8 17.0000000000 DINH_LimDFCVerb 0.00 17.0000000000 FORMAT "%13.10" NUMBER 50 /end CHARACTERISTIC
/begin CHARACTERISTIC DINH_Lim.DFC_RBA_IODIAGPWR_rba_IoExtCy329_SignalVltSply_0SCG_CA "inhibit conditions / inhibit limit conditions for inhibit source DFC_RBA_IODIAGPWR_rba_IoExtCy329_SignalVltSply_0SCG" VAL_BLK 0x804FD14B ValA_Wu8 17.0000000000 DINH_LimDFCVerb 0.00 17.0000000000 FORMAT "%13.10" NUMBER 50 /end CHARACTERISTIC
/begin CHARACTERISTIC DINH_Lim.DFC_RBA_IODIAGPWR_rba_IoExtCy329_SignalVltSply_0UV_CA "inhibit conditions / inhibit limit conditions for inhibit source DFC_RBA_IODIAGPWR_rba_IoExtCy329_SignalVltSply_0UV" VAL_BLK 0x804FD17D ValA_Wu8 17.0000000000 DINH_LimDFCVerb 0.00 17.0000000000 FORMAT "%13.10" NUMBER 50 /end CHARACTERISTIC
/begin CHARACTERISTIC DINH_Lim.DFC_RBA_IODIAGPWR_rba_IoExtCy329_SignalVltSply_1_CA "inhibit conditions / inhibit limit conditions for inhibit source DFC_RBA_IODIAGPWR_rba_IoExtCy329_SignalVltSply_1" VAL_BLK 0x804FD1AF ValA_Wu8 17.0000000000 DINH_LimDFCVerb 0.00 17.0000000000 FORMAT "%13.10" NUMBER 200 /end CHARACTERISTIC
/begin CHARACTERISTIC DINH_Lim.DFC_RBA_IODIAGPWR_rba_IoExtCy329_SignalVltSply_1OT_CA "inhibit conditions / inhibit limit conditions for inhibit source DFC_RBA_IODIAGPWR_rba_IoExtCy329_SignalVltSply_1OT" VAL_BLK 0x804FD277 ValA_Wu8 17.0000000000 DINH_LimDFCVerb 0.00 17.0000000000 FORMAT "%13.10" NUMBER 50 /end CHARACTERISTIC
/begin CHARACTERISTIC DINH_Lim.DFC_RBA_IODIAGPWR_rba_IoExtCy329_SignalVltSply_1OV_CA "inhibit conditions / inhibit limit conditions for inhibit source DFC_RBA_IODIAGPWR_rba_IoExtCy329_SignalVltSply_1OV" VAL_BLK 0x804FD2A9 ValA_Wu8 17.0000000000 DINH_LimDFCVerb 0.00 17.0000000000 FORMAT "%13.10" NUMBER 50 /end CHARACTERISTIC
/begin CHARACTERISTIC DINH_Lim.DFC_RBA_IODIAGPWR_rba_IoExtCy329_SignalVltSply_1SCG_CA "inhibit conditions / inhibit limit conditions for inhibit source DFC_RBA_IODIAGPWR_rba_IoExtCy329_SignalVltSply_1SCG" VAL_BLK 0x804FD2DB ValA_Wu8 17.0000000000 DINH_LimDFCVerb 0.00 17.0000000000 FORMAT "%13.10" NUMBER 50 /end CHARACTERISTIC
/begin CHARACTERISTIC DINH_Lim.DFC_RBA_IODIAGPWR_rba_IoExtCy329_SignalVltSply_1UV_CA "inhibit conditions / inhibit limit conditions for inhibit source DFC_RBA_IODIAGPWR_rba_IoExtCy329_SignalVltSply_1UV" VAL_BLK 0x804FD30D ValA_Wu8 17.0000000000 DINH_LimDFCVerb 0.00 17.0000000000 FORMAT "%13.10" NUMBER 50 /end CHARACTERISTIC
/begin CHARACTERISTIC DINH_Lim.DFC_RBA_IODIAGPWR_rba_IoExtCy329_SignalVltSply_2_CA "inhibit conditions / inhibit limit conditions for inhibit source DFC_RBA_IODIAGPWR_rba_IoExtCy329_SignalVltSply_2" VAL_BLK 0x804FD33F ValA_Wu8 17.0000000000 DINH_LimDFCVerb 0.00 17.0000000000 FORMAT "%13.10" NUMBER 200 /end CHARACTERISTIC
/begin CHARACTERISTIC DINH_Lim.DFC_RBA_IODIAGPWR_rba_IoExtCy329_SignalVltSply_2OT_CA "inhibit conditions / inhibit limit conditions for inhibit source DFC_RBA_IODIAGPWR_rba_IoExtCy329_SignalVltSply_2OT" VAL_BLK 0x804FD407 ValA_Wu8 17.0000000000 DINH_LimDFCVerb 0.00 17.0000000000 FORMAT "%13.10" NUMBER 50 /end CHARACTERISTIC
/begin CHARACTERISTIC DINH_Lim.DFC_RBA_IODIAGPWR_rba_IoExtCy329_SignalVltSply_2OV_CA "inhibit conditions / inhibit limit conditions for inhibit source DFC_RBA_IODIAGPWR_rba_IoExtCy329_SignalVltSply_2OV" VAL_BLK 0x804FD439 ValA_Wu8 17.0000000000 DINH_LimDFCVerb 0.00 17.0000000000 FORMAT "%13.10" NUMBER 50 /end CHARACTERISTIC
/begin CHARACTERISTIC DINH_Lim.DFC_RBA_IODIAGPWR_rba_IoExtCy329_SignalVltSply_2SCG_CA "inhibit conditions / inhibit limit conditions for inhibit source DFC_RBA_IODIAGPWR_rba_IoExtCy329_SignalVltSply_2SCG" VAL_BLK 0x804FD46B ValA_Wu8 17.0000000000 DINH_LimDFCVerb 0.00 17.0000000000 FORMAT "%13.10" NUMBER 50 /end CHARACTERISTIC
/begin CHARACTERISTIC DINH_Lim.DFC_RBA_IODIAGPWR_rba_IoExtCy329_SignalVltSply_2UV_CA "inhibit conditions / inhibit limit conditions for inhibit source DFC_RBA_IODIAGPWR_rba_IoExtCy329_SignalVltSply_2UV" VAL_BLK 0x804FD49D ValA_Wu8 17.0000000000 DINH_LimDFCVerb 0.00 17.0000000000 FORMAT "%13.10" NUMBER 50 /end CHARACTERISTIC
/begin CHARACTERISTIC DINH_Lim.DFC_CAN_E_TIMEOUT_CA "inhibit conditions / inhibit limit conditions for inhibit source DFC_CAN_E_TIMEOUT" VAL_BLK 0x804FD4CF ValA_Wu8 17.0000000000 DINH_LimDFCVerb 0.00 17.0000000000 FORMAT "%13.10" NUMBER 50 /end CHARACTERISTIC
/begin CHARACTERISTIC DINH_Lim.DFC_LIN_E_TIMEOUT_CA "inhibit conditions / inhibit limit conditions for inhibit source DFC_LIN_E_TIMEOUT" VAL_BLK 0x804FD501 ValA_Wu8 17.0000000000 DINH_LimDFCVerb 0.00 17.0000000000 FORMAT "%13.10" NUMBER 50 /end CHARACTERISTIC
/begin CHARACTERISTIC DINH_Lim.DFC_MRlyOL_CA "inhibit conditions / inhibit limit conditions for inhibit source DFC_MRlyOL" VAL_BLK 0x804FD533 ValA_Wu8 17.0000000000 DINH_LimDFCVerb 0.00 17.0000000000 FORMAT "%13.10" NUMBER 50 /end CHARACTERISTIC
/begin CHARACTERISTIC DINH_Lim.DFC_MRlySCB_CA "inhibit conditions / inhibit limit conditions for inhibit source DFC_MRlySCB" VAL_BLK 0x804FD565 ValA_Wu8 17.0000000000 DINH_LimDFCVerb 0.00 17.0000000000 FORMAT "%13.10" NUMBER 50 /end CHARACTERISTIC
/begin CHARACTERISTIC DINH_Lim.DFC_MRlySCG_CA "inhibit conditions / inhibit limit conditions for inhibit source DFC_MRlySCG" VAL_BLK 0x804FD597 ValA_Wu8 17.0000000000 DINH_LimDFCVerb 0.00 17.0000000000 FORMAT "%13.10" NUMBER 51 /end CHARACTERISTIC
/begin CHARACTERISTIC DINH_Lim.DFC_rba_MultiStackTrace_Threshold_CA "inhibit conditions / inhibit limit conditions for inhibit source DFC_rba_MultiStackTrace_Threshold" VAL_BLK 0x804FD5CA ValA_Wu8 17.0000000000 DINH_LimDFCVerb 0.00 17.0000000000 FORMAT "%13.10" NUMBER 50 /end CHARACTERISTIC
/begin CHARACTERISTIC DINH_Lim.DFC_BSWM_E_ACTION_FAILED_CA "inhibit conditions / inhibit limit conditions for inhibit source DFC_BSWM_E_ACTION_FAILED" VAL_BLK 0x804FD5FC ValA_Wu8 17.0000000000 DINH_LimDFCVerb 0.00 17.0000000000 FORMAT "%13.10" NUMBER 50 /end CHARACTERISTIC
/begin CHARACTERISTIC DINH_Lim.DFC_BSWM_E_INTRPTQUEUE_FULL_CA "inhibit conditions / inhibit limit conditions for inhibit source DFC_BSWM_E_INTRPTQUEUE_FULL" VAL_BLK 0x804FD62E ValA_Wu8 17.0000000000 DINH_LimDFCVerb 0.00 17.0000000000 FORMAT "%13.10" NUMBER 50 /end CHARACTERISTIC
/begin CHARACTERISTIC DINH_Lim.DFC_RBA_IOEXTLIB_KEEPALIVE_DRV_CA "inhibit conditions / inhibit limit conditions for inhibit source DFC_RBA_IOEXTLIB_KEEPALIVE_DRV" VAL_BLK 0x804FD660 ValA_Wu8 17.0000000000 DINH_LimDFCVerb 0.00 17.0000000000 FORMAT "%13.10" NUMBER 51 /end CHARACTERISTIC
/begin CHARACTERISTIC DINH_Lim.DFC_RBA_IOEXTLIB_KEEPALIVE_INI_CA "inhibit conditions / inhibit limit conditions for inhibit source DFC_RBA_IOEXTLIB_KEEPALIVE_INI" VAL_BLK 0x804FD693 ValA_Wu8 17.0000000000 DINH_LimDFCVerb 0.00 17.0000000000 FORMAT "%13.10" NUMBER 51 /end CHARACTERISTIC
/begin CHARACTERISTIC DINH_Lim.DFC_rba_IoSigRtc_StopCounter_CA "inhibit conditions / inhibit limit conditions for inhibit source DFC_rba_IoSigRtc_StopCounter" VAL_BLK 0x804FD6C6 ValA_Wu8 17.0000000000 DINH_LimDFCVerb 0.00 17.0000000000 FORMAT "%13.10" NUMBER 57 /end CHARACTERISTIC
/begin CHARACTERISTIC DINH_Lim.DFC_rba_MRly_Diag_Stk_Event_CA "inhibit conditions / inhibit limit conditions for inhibit source DFC_rba_MRly_Diag_Stk_Event" VAL_BLK 0x804FD6FF ValA_Wu8 17.0000000000 DINH_LimDFCVerb 0.00 17.0000000000 FORMAT "%13.10" NUMBER 50 /end CHARACTERISTIC
/begin CHARACTERISTIC DINH_Lim.DFC_rba_MemDiag_MemReadErr_CA "inhibit conditions / inhibit limit conditions for inhibit source DFC_rba_MemDiag_MemReadErr" VAL_BLK 0x804FD731 ValA_Wu8 17.0000000000 DINH_LimDFCVerb 0.00 17.0000000000 FORMAT "%13.10" NUMBER 61 /end CHARACTERISTIC
/begin CHARACTERISTIC DINH_Lim.DFC_rba_MemDiag_MemWrErr_CA "inhibit conditions / inhibit limit conditions for inhibit source DFC_rba_MemDiag_MemWrErr" VAL_BLK 0x804FD76E ValA_Wu8 17.0000000000 DINH_LimDFCVerb 0.00 17.0000000000 FORMAT "%13.10" NUMBER 60 /end CHARACTERISTIC
/begin CHARACTERISTIC DINH_Lim.DFC_rba_SyC_IrrSwOffTrigEngRun_Event_CA "inhibit conditions / inhibit limit conditions for inhibit source DFC_rba_SyC_IrrSwOffTrigEngRun_Event" VAL_BLK 0x804FD7AA ValA_Wu8 17.0000000000 DINH_LimDFCVerb 0.00 17.0000000000 FORMAT "%13.10" NUMBER 50 /end CHARACTERISTIC
/begin CHARACTERISTIC DINH_Lim.DFC_rba_T15_Diag_ComInVld_Event_CA "inhibit conditions / inhibit limit conditions for inhibit source DFC_rba_T15_Diag_ComInVld_Event" VAL_BLK 0x804FD7DC ValA_Wu8 17.0000000000 DINH_LimDFCVerb 0.00 17.0000000000 FORMAT "%13.10" NUMBER 50 /end CHARACTERISTIC
/begin CHARACTERISTIC DINH_Lim.DFC_rba_T15_Diag_ComOff_HwOn_Event_CA "inhibit conditions / inhibit limit conditions for inhibit source DFC_rba_T15_Diag_ComOff_HwOn_Event" VAL_BLK 0x804FD80E ValA_Wu8 17.0000000000 DINH_LimDFCVerb 0.00 17.0000000000 FORMAT "%13.10" NUMBER 50 /end CHARACTERISTIC
/begin CHARACTERISTIC DINH_Lim.DFC_rba_T15_Diag_ComOn_HwOff_Event_CA "inhibit conditions / inhibit limit conditions for inhibit source DFC_rba_T15_Diag_ComOn_HwOff_Event" VAL_BLK 0x804FD840 ValA_Wu8 17.0000000000 DINH_LimDFCVerb 0.00 17.0000000000 FORMAT "%13.10" NUMBER 50 /end CHARACTERISTIC
/begin CHARACTERISTIC DINH_Lim.DFC_AAVmin_CA "inhibit conditions / inhibit limit conditions for inhibit source DFC_AAVmin" VAL_BLK 0x804FD872 ValA_Wu8 17.0000000000 DINH_LimDFCVerb 0.00 17.0000000000 FORMAT "%13.10" NUMBER 55 /end CHARACTERISTIC
/begin CHARACTERISTIC DINH_Lim.DFC_AGRSUS_CA "inhibit conditions / inhibit limit conditions for inhibit source DFC_AGRSUS" VAL_BLK 0x804FD8A9 ValA_Wu8 17.0000000000 DINH_LimDFCVerb 0.00 17.0000000000 FORMAT "%13.10" NUMBER 72 /end CHARACTERISTIC
/begin CHARACTERISTIC DINH_Lim.DFC_AfsPlausDiagHi_CA "inhibit conditions / inhibit limit conditions for inhibit source DFC_AfsPlausDiagHi" VAL_BLK 0x804FD8F1 ValA_Wu8 17.0000000000 DINH_LimDFCVerb 0.00 17.0000000000 FORMAT "%13.10" NUMBER 54 /end CHARACTERISTIC
/begin CHARACTERISTIC DINH_Lim.DFC_AfsPlausDiagLo_CA "inhibit conditions / inhibit limit conditions for inhibit source DFC_AfsPlausDiagLo" VAL_BLK 0x804FD927 ValA_Wu8 17.0000000000 DINH_LimDFCVerb 0.00 17.0000000000 FORMAT "%13.10" NUMBER 54 /end CHARACTERISTIC
/begin CHARACTERISTIC DINH_Lim.DFC_AfsVrntDiagErrB1_CA "inhibit conditions / inhibit limit conditions for inhibit source DFC_AfsVrntDiagErrB1" VAL_BLK 0x804FD95D ValA_Wu8 17.0000000000 DINH_LimDFCVerb 0.00 17.0000000000 FORMAT "%13.10" NUMBER 54 /end CHARACTERISTIC
/begin CHARACTERISTIC DINH_Lim.DFC_AppAllSnsrDfct_CA "inhibit conditions / inhibit limit conditions for inhibit source DFC_AppAllSnsrDfct" VAL_BLK 0x804FD993 ValA_Wu8 17.0000000000 DINH_LimDFCVerb 0.00 17.0000000000 FORMAT "%13.10" NUMBER 51 /end CHARACTERISTIC
/begin CHARACTERISTIC DINH_Lim.DFC_BBKRnldg_CA "inhibit conditions / inhibit limit conditions for inhibit source DFC_BBKRnldg" VAL_BLK 0x804FD9C6 ValA_Wu8 17.0000000000 DINH_LimDFCVerb 0.00 17.0000000000 FORMAT "%13.10" NUMBER 52 /end CHARACTERISTIC
/begin CHARACTERISTIC DINH_Lim.DFC_BBKRsyne_CA "inhibit conditions / inhibit limit conditions for inhibit source DFC_BBKRsyne" VAL_BLK 0x804FD9FA ValA_Wu8 17.0000000000 DINH_LimDFCVerb 0.00 17.0000000000 FORMAT "%13.10" NUMBER 52 /end CHARACTERISTIC
/begin CHARACTERISTIC DINH_Lim.DFC_BattUStdbyDiaOL_CA "inhibit conditions / inhibit limit conditions for inhibit source DFC_BattUStdbyDiaOL" VAL_BLK 0x804FDA2E ValA_Wu8 17.0000000000 DINH_LimDFCVerb 0.00 17.0000000000 FORMAT "%13.10" NUMBER 50 /end CHARACTERISTIC
/begin CHARACTERISTIC DINH_Lim.DFC_BigLeakIntkMnfldEmiInfl_CA "inhibit conditions / inhibit limit conditions for inhibit source DFC_BigLeakIntkMnfldEmiInfl" VAL_BLK 0x804FDA60 ValA_Wu8 17.0000000000 DINH_LimDFCVerb 0.00 17.0000000000 FORMAT "%13.10" NUMBER 54 /end CHARACTERISTIC
/begin CHARACTERISTIC DINH_Lim.DFC_BlkdLineTank_CA "inhibit conditions / inhibit limit conditions for inhibit source DFC_BlkdLineTank" VAL_BLK 0x804FDA96 ValA_Wu8 17.0000000000 DINH_LimDFCVerb 0.00 17.0000000000 FORMAT "%13.10" NUMBER 52 /end CHARACTERISTIC
/begin CHARACTERISTIC DINH_Lim.DFC_BrkMnSwtContOnWarnLmp_CA "inhibit conditions / inhibit limit conditions for inhibit source DFC_BrkMnSwtContOnWarnLmp" VAL_BLK 0x804FDACA ValA_Wu8 17.0000000000 DINH_LimDFCVerb 0.00 17.0000000000 FORMAT "%13.10" NUMBER 50 /end CHARACTERISTIC
/begin CHARACTERISTIC DINH_Lim.DFC_BrkMnSwtNotStpWarnLmp_CA "inhibit conditions / inhibit limit conditions for inhibit source DFC_BrkMnSwtNotStpWarnLmp" VAL_BLK 0x804FDAFC ValA_Wu8 17.0000000000 DINH_LimDFCVerb 0.00 17.0000000000 FORMAT "%13.10" NUMBER 50 /end CHARACTERISTIC
/begin CHARACTERISTIC DINH_Lim.DFC_BrkRdntSwtContOnWarnLmp_CA "inhibit conditions / inhibit limit conditions for inhibit source DFC_BrkRdntSwtContOnWarnLmp" VAL_BLK 0x804FDB2E ValA_Wu8 17.0000000000 DINH_LimDFCVerb 0.00 17.0000000000 FORMAT "%13.10" NUMBER 50 /end CHARACTERISTIC
/begin CHARACTERISTIC DINH_Lim.DFC_BrkRdntSwtNotStpWarnLmp_CA "inhibit conditions / inhibit limit conditions for inhibit source DFC_BrkRdntSwtNotStpWarnLmp" VAL_BLK 0x804FDB60 ValA_Wu8 17.0000000000 DINH_LimDFCVerb 0.00 17.0000000000 FORMAT "%13.10" NUMBER 50 /end CHARACTERISTIC
/begin CHARACTERISTIC DINH_Lim.DFC_CEngDsTColdStrtMax_CA "inhibit conditions / inhibit limit conditions for inhibit source DFC_CEngDsTColdStrtMax" VAL_BLK 0x804FDB92 ValA_Wu8 17.0000000000 DINH_LimDFCVerb 0.00 17.0000000000 FORMAT "%13.10" NUMBER 122 /end CHARACTERISTIC
/begin CHARACTERISTIC DINH_Lim.DFC_CEngDsTColdStrtMin_CA "inhibit conditions / inhibit limit conditions for inhibit source DFC_CEngDsTColdStrtMin" VAL_BLK 0x804FDC0C ValA_Wu8 17.0000000000 DINH_LimDFCVerb 0.00 17.0000000000 FORMAT "%13.10" NUMBER 122 /end CHARACTERISTIC
/begin CHARACTERISTIC DINH_Lim.DFC_CEngDsTImps_CA "inhibit conditions / inhibit limit conditions for inhibit source DFC_CEngDsTImps" VAL_BLK 0x804FDC86 ValA_Wu8 17.0000000000 DINH_LimDFCVerb 0.00 17.0000000000 FORMAT "%13.10" NUMBER 125 /end CHARACTERISTIC
/begin CHARACTERISTIC DINH_Lim.DFC_CEngDsTPlausHSC_CA "inhibit conditions / inhibit limit conditions for inhibit source DFC_CEngDsTPlausHSC" VAL_BLK 0x804FDD03 ValA_Wu8 17.0000000000 DINH_LimDFCVerb 0.00 17.0000000000 FORMAT "%13.10" NUMBER 121 /end CHARACTERISTIC
/begin CHARACTERISTIC DINH_Lim.DFC_CEngDsTPlausLSC_CA "inhibit conditions / inhibit limit conditions for inhibit source DFC_CEngDsTPlausLSC" VAL_BLK 0x804FDD7C ValA_Wu8 17.0000000000 DINH_LimDFCVerb 0.00 17.0000000000 FORMAT "%13.10" NUMBER 122 /end CHARACTERISTIC
/begin CHARACTERISTIC DINH_Lim.DFC_CEngDsTPlausSTC_CA "inhibit conditions / inhibit limit conditions for inhibit source DFC_CEngDsTPlausSTC" VAL_BLK 0x804FDDF6 ValA_Wu8 17.0000000000 DINH_LimDFCVerb 0.00 17.0000000000 FORMAT "%13.10" NUMBER 121 /end CHARACTERISTIC
/begin CHARACTERISTIC DINH_Lim.DFC_CEngDsTSRCMax_CA "inhibit conditions / inhibit limit conditions for inhibit source DFC_CEngDsTSRCMax" VAL_BLK 0x804FDE6F ValA_Wu8 17.0000000000 DINH_LimDFCVerb 0.00 17.0000000000 FORMAT "%13.10" NUMBER 135 /end CHARACTERISTIC
/begin CHARACTERISTIC DINH_Lim.DFC_CEngDsTSRCMin_CA "inhibit conditions / inhibit limit conditions for inhibit source DFC_CEngDsTSRCMin" VAL_BLK 0x804FDEF6 ValA_Wu8 17.0000000000 DINH_LimDFCVerb 0.00 17.0000000000 FORMAT "%13.10" NUMBER 135 /end CHARACTERISTIC
/begin CHARACTERISTIC DINH_Lim.DFC_CEngDsTSig_CA "inhibit conditions / inhibit limit conditions for inhibit source DFC_CEngDsTSig" VAL_BLK 0x804FDF7D ValA_Wu8 17.0000000000 DINH_LimDFCVerb 0.00 17.0000000000 FORMAT "%13.10" NUMBER 123 /end CHARACTERISTIC
/begin CHARACTERISTIC DINH_Lim.DFC_CEngUsTColdStrtMax_CA "inhibit conditions / inhibit limit conditions for inhibit source DFC_CEngUsTColdStrtMax" VAL_BLK 0x804FDFF8 ValA_Wu8 17.0000000000 DINH_LimDFCVerb 0.00 17.0000000000 FORMAT "%13.10" NUMBER 53 /end CHARACTERISTIC
/begin CHARACTERISTIC DINH_Lim.DFC_CEngUsTColdStrtMin_CA "inhibit conditions / inhibit limit conditions for inhibit source DFC_CEngUsTColdStrtMin" VAL_BLK 0x804FE02D ValA_Wu8 17.0000000000 DINH_LimDFCVerb 0.00 17.0000000000 FORMAT "%13.10" NUMBER 53 /end CHARACTERISTIC
/begin CHARACTERISTIC DINH_Lim.DFC_CEngUsTLooseCnctn_CA "inhibit conditions / inhibit limit conditions for inhibit source DFC_CEngUsTLooseCnctn" VAL_BLK 0x804FE062 ValA_Wu8 17.0000000000 DINH_LimDFCVerb 0.00 17.0000000000 FORMAT "%13.10" NUMBER 55 /end CHARACTERISTIC
/begin CHARACTERISTIC DINH_Lim.DFC_CEngUsTSRCMax_CA "inhibit conditions / inhibit limit conditions for inhibit source DFC_CEngUsTSRCMax" VAL_BLK 0x804FE099 ValA_Wu8 17.0000000000 DINH_LimDFCVerb 0.00 17.0000000000 FORMAT "%13.10" NUMBER 58 /end CHARACTERISTIC
/begin CHARACTERISTIC DINH_Lim.DFC_CEngUsTSRCMin_CA "inhibit conditions / inhibit limit conditions for inhibit source DFC_CEngUsTSRCMin" VAL_BLK 0x804FE0D3 ValA_Wu8 17.0000000000 DINH_LimDFCVerb 0.00 17.0000000000 FORMAT "%13.10" NUMBER 58 /end CHARACTERISTIC
/begin CHARACTERISTIC DINH_Lim.DFC_ComDCDCACCFailr_CA "inhibit conditions / inhibit limit conditions for inhibit source DFC_ComDCDCACCFailr" VAL_BLK 0x804FE10D ValA_Wu8 17.0000000000 DINH_LimDFCVerb 0.00 17.0000000000 FORMAT "%13.10" NUMBER 57 /end CHARACTERISTIC
/begin CHARACTERISTIC DINH_Lim.DFC_DCDCFltDet_CA "inhibit conditions / inhibit limit conditions for inhibit source DFC_DCDCFltDet" VAL_BLK 0x804FE146 ValA_Wu8 17.0000000000 DINH_LimDFCVerb 0.00 17.0000000000 FORMAT "%13.10" NUMBER 57 /end CHARACTERISTIC
/begin CHARACTERISTIC DINH_Lim.DFC_DKRSA_CA "inhibit conditions / inhibit limit conditions for inhibit source DFC_DKRSA" VAL_BLK 0x804FE17F ValA_Wu8 17.0000000000 DINH_LimDFCVerb 0.00 17.0000000000 FORMAT "%13.10" NUMBER 58 /end CHARACTERISTIC
/begin CHARACTERISTIC DINH_Lim.DFC_DKVSmax_CA "inhibit conditions / inhibit limit conditions for inhibit source DFC_DKVSmax" VAL_BLK 0x804FE1B9 ValA_Wu8 17.0000000000 DINH_LimDFCVerb 0.00 17.0000000000 FORMAT "%13.10" NUMBER 50 /end CHARACTERISTIC
/begin CHARACTERISTIC DINH_Lim.DFC_DKnpl_CA "inhibit conditions / inhibit limit conditions for inhibit source DFC_DKnpl" VAL_BLK 0x804FE1EB ValA_Wu8 17.0000000000 DINH_LimDFCVerb 0.00 17.0000000000 FORMAT "%13.10" NUMBER 50 /end CHARACTERISTIC
/begin CHARACTERISTIC DINH_Lim.DFC_DSKVRmax_CA "inhibit conditions / inhibit limit conditions for inhibit source DFC_DSKVRmax" VAL_BLK 0x804FE21D ValA_Wu8 17.0000000000 DINH_LimDFCVerb 0.00 17.0000000000 FORMAT "%13.10" NUMBER 66 /end CHARACTERISTIC
/begin CHARACTERISTIC DINH_Lim.DFC_DSKVRmin_CA "inhibit conditions / inhibit limit conditions for inhibit source DFC_DSKVRmin" VAL_BLK 0x804FE25F ValA_Wu8 17.0000000000 DINH_LimDFCVerb 0.00 17.0000000000 FORMAT "%13.10" NUMBER 66 /end CHARACTERISTIC
/begin CHARACTERISTIC DINH_Lim.DFC_DSKVRnpl_CA "inhibit conditions / inhibit limit conditions for inhibit source DFC_DSKVRnpl" VAL_BLK 0x804FE2A1 ValA_Wu8 17.0000000000 DINH_LimDFCVerb 0.00 17.0000000000 FORMAT "%13.10" NUMBER 62 /end CHARACTERISTIC
/begin CHARACTERISTIC DINH_Lim.DFC_DSKVRsig_CA "inhibit conditions / inhibit limit conditions for inhibit source DFC_DSKVRsig" VAL_BLK 0x804FE2DF ValA_Wu8 17.0000000000 DINH_LimDFCVerb 0.00 17.0000000000 FORMAT "%13.10" NUMBER 62 /end CHARACTERISTIC
/begin CHARACTERISTIC DINH_Lim.DFC_DSKVSsig_CA "inhibit conditions / inhibit limit conditions for inhibit source DFC_DSKVSsig" VAL_BLK 0x804FE31D ValA_Wu8 17.0000000000 DINH_LimDFCVerb 0.00 17.0000000000 FORMAT "%13.10" NUMBER 64 /end CHARACTERISTIC
/begin CHARACTERISTIC DINH_Lim.DFC_DSSmax_CA "inhibit conditions / inhibit limit conditions for inhibit source DFC_DSSmax" VAL_BLK 0x804FE35D ValA_Wu8 17.0000000000 DINH_LimDFCVerb 0.00 17.0000000000 FORMAT "%13.10" NUMBER 50 /end CHARACTERISTIC
/begin CHARACTERISTIC DINH_Lim.DFC_DSTDmax_CA "inhibit conditions / inhibit limit conditions for inhibit source DFC_DSTDmax" VAL_BLK 0x804FE38F ValA_Wu8 17.0000000000 DINH_LimDFCVerb 0.00 17.0000000000 FORMAT "%13.10" NUMBER 50 /end CHARACTERISTIC
/begin CHARACTERISTIC DINH_Lim.DFC_DSTEmax_CA "inhibit conditions / inhibit limit conditions for inhibit source DFC_DSTEmax" VAL_BLK 0x804FE3C1 ValA_Wu8 17.0000000000 DINH_LimDFCVerb 0.00 17.0000000000 FORMAT "%13.10" NUMBER 59 /end CHARACTERISTIC
/begin CHARACTERISTIC DINH_Lim.DFC_DSTEmin_CA "inhibit conditions / inhibit limit conditions for inhibit source DFC_DSTEmin" VAL_BLK 0x804FE3FC ValA_Wu8 17.0000000000 DINH_LimDFCVerb 0.00 17.0000000000 FORMAT "%13.10" NUMBER 59 /end CHARACTERISTIC
/begin CHARACTERISTIC DINH_Lim.DFC_DSTOFmax_CA "inhibit conditions / inhibit limit conditions for inhibit source DFC_DSTOFmax" VAL_BLK 0x804FE437 ValA_Wu8 17.0000000000 DINH_LimDFCVerb 0.00 17.0000000000 FORMAT "%13.10" NUMBER 56 /end CHARACTERISTIC
/begin CHARACTERISTIC DINH_Lim.DFC_DSTRmax_CA "inhibit conditions / inhibit limit conditions for inhibit source DFC_DSTRmax" VAL_BLK 0x804FE46F ValA_Wu8 17.0000000000 DINH_LimDFCVerb 0.00 17.0000000000 FORMAT "%13.10" NUMBER 57 /end CHARACTERISTIC
/begin CHARACTERISTIC DINH_Lim.DFC_DSTRmin_CA "inhibit conditions / inhibit limit conditions for inhibit source DFC_DSTRmin" VAL_BLK 0x804FE4A8 ValA_Wu8 17.0000000000 DINH_LimDFCVerb 0.00 17.0000000000 FORMAT "%13.10" NUMBER 57 /end CHARACTERISTIC
/begin CHARACTERISTIC DINH_Lim.DFC_DSTRnpl_CA "inhibit conditions / inhibit limit conditions for inhibit source DFC_DSTRnpl" VAL_BLK 0x804FE4E1 ValA_Wu8 17.0000000000 DINH_LimDFCVerb 0.00 17.0000000000 FORMAT "%13.10" NUMBER 56 /end CHARACTERISTIC
/begin CHARACTERISTIC DINH_Lim.DFC_DSTRsig_CA "inhibit conditions / inhibit limit conditions for inhibit source DFC_DSTRsig" VAL_BLK 0x804FE519 ValA_Wu8 17.0000000000 DINH_LimDFCVerb 0.00 17.0000000000 FORMAT "%13.10" NUMBER 56 /end CHARACTERISTIC
/begin CHARACTERISTIC DINH_Lim.DFC_DSTTI_CA "inhibit conditions / inhibit limit conditions for inhibit source DFC_DSTTI" VAL_BLK 0x804FE551 ValA_Wu8 17.0000000000 DINH_LimDFCVerb 0.00 17.0000000000 FORMAT "%13.10" NUMBER 51 /end CHARACTERISTIC
/begin CHARACTERISTIC DINH_Lim.DFC_DSUmax_CA "inhibit conditions / inhibit limit conditions for inhibit source DFC_DSUmax" VAL_BLK 0x804FE584 ValA_Wu8 17.0000000000 DINH_LimDFCVerb 0.00 17.0000000000 FORMAT "%13.10" NUMBER 50 /end CHARACTERISTIC
/begin CHARACTERISTIC DINH_Lim.DFC_DiagCpv1DteskLoLoadStuckClsd_CA "inhibit conditions / inhibit limit conditions for inhibit source DFC_DiagCpv1DteskLoLoadStuckClsd" VAL_BLK 0x804FE5B6 ValA_Wu8 17.0000000000 DINH_LimDFCVerb 0.00 17.0000000000 FORMAT "%13.10" NUMBER 71 /end CHARACTERISTIC
/begin CHARACTERISTIC DINH_Lim.DFC_DiagCpv1DteskLoLoadStuckOpen_CA "inhibit conditions / inhibit limit conditions for inhibit source DFC_DiagCpv1DteskLoLoadStuckOpen" VAL_BLK 0x804FE5FD ValA_Wu8 17.0000000000 DINH_LimDFCVerb 0.00 17.0000000000 FORMAT "%13.10" NUMBER 80 /end CHARACTERISTIC
/begin CHARACTERISTIC DINH_Lim.DFC_EGRVlvDrftClsd_CA "inhibit conditions / inhibit limit conditions for inhibit source DFC_EGRVlvDrftClsd" VAL_BLK 0x804FE64D ValA_Wu8 17.0000000000 DINH_LimDFCVerb 0.00 17.0000000000 FORMAT "%13.10" NUMBER 51 /end CHARACTERISTIC
/begin CHARACTERISTIC DINH_Lim.DFC_EGRVlvDrftOpn_CA "inhibit conditions / inhibit limit conditions for inhibit source DFC_EGRVlvDrftOpn" VAL_BLK 0x804FE680 ValA_Wu8 17.0000000000 DINH_LimDFCVerb 0.00 17.0000000000 FORMAT "%13.10" NUMBER 50 /end CHARACTERISTIC
/begin CHARACTERISTIC DINH_Lim.DFC_EGRVlvJamVlvClsd_CA "inhibit conditions / inhibit limit conditions for inhibit source DFC_EGRVlvJamVlvClsd" VAL_BLK 0x804FE6B2 ValA_Wu8 17.0000000000 DINH_LimDFCVerb 0.00 17.0000000000 FORMAT "%13.10" NUMBER 53 /end CHARACTERISTIC
/begin CHARACTERISTIC DINH_Lim.DFC_EGRVlvJamVlvOpn_CA "inhibit conditions / inhibit limit conditions for inhibit source DFC_EGRVlvJamVlvOpn" VAL_BLK 0x804FE6E7 ValA_Wu8 17.0000000000 DINH_LimDFCVerb 0.00 17.0000000000 FORMAT "%13.10" NUMBER 53 /end CHARACTERISTIC
/begin CHARACTERISTIC DINH_Lim.DFC_EGRVlvSprgBrk_CA "inhibit conditions / inhibit limit conditions for inhibit source DFC_EGRVlvSprgBrk" VAL_BLK 0x804FE71C ValA_Wu8 17.0000000000 DINH_LimDFCVerb 0.00 17.0000000000 FORMAT "%13.10" NUMBER 50 /end CHARACTERISTIC
/begin CHARACTERISTIC DINH_Lim.DFC_EGRVlvTempMdlEEPErr_CA "inhibit conditions / inhibit limit conditions for inhibit source DFC_EGRVlvTempMdlEEPErr" VAL_BLK 0x804FE74E ValA_Wu8 17.0000000000 DINH_LimDFCVerb 0.00 17.0000000000 FORMAT "%13.10" NUMBER 51 /end CHARACTERISTIC
/begin CHARACTERISTIC DINH_Lim.DFC_EGRVlvTmpErr_CA "inhibit conditions / inhibit limit conditions for inhibit source DFC_EGRVlvTmpErr" VAL_BLK 0x804FE781 ValA_Wu8 17.0000000000 DINH_LimDFCVerb 0.00 17.0000000000 FORMAT "%13.10" NUMBER 50 /end CHARACTERISTIC
/begin CHARACTERISTIC DINH_Lim.DFC_EGSDUS2B1LtrDly_CA "inhibit conditions / inhibit limit conditions for inhibit source DFC_EGSDUS2B1LtrDly" VAL_BLK 0x804FE7B3 ValA_Wu8 17.0000000000 DINH_LimDFCVerb 0.00 17.0000000000 FORMAT "%13.10" NUMBER 58 /end CHARACTERISTIC
/begin CHARACTERISTIC DINH_Lim.DFC_EGSDUS2B1LtrPT1_CA "inhibit conditions / inhibit limit conditions for inhibit source DFC_EGSDUS2B1LtrPT1" VAL_BLK 0x804FE7ED ValA_Wu8 17.0000000000 DINH_LimDFCVerb 0.00 17.0000000000 FORMAT "%13.10" NUMBER 58 /end CHARACTERISTIC
/begin CHARACTERISTIC DINH_Lim.DFC_EGSDUS2B1RtlDly_CA "inhibit conditions / inhibit limit conditions for inhibit source DFC_EGSDUS2B1RtlDly" VAL_BLK 0x804FE827 ValA_Wu8 17.0000000000 DINH_LimDFCVerb 0.00 17.0000000000 FORMAT "%13.10" NUMBER 58 /end CHARACTERISTIC
/begin CHARACTERISTIC DINH_Lim.DFC_EGSDUS2B1RtlPT1_CA "inhibit conditions / inhibit limit conditions for inhibit source DFC_EGSDUS2B1RtlPT1" VAL_BLK 0x804FE861 ValA_Wu8 17.0000000000 DINH_LimDFCVerb 0.00 17.0000000000 FORMAT "%13.10" NUMBER 58 /end CHARACTERISTIC
/begin CHARACTERISTIC DINH_Lim.DFC_EGSDUS2B1TarLean_CA "inhibit conditions / inhibit limit conditions for inhibit source DFC_EGSDUS2B1TarLean" VAL_BLK 0x804FE89B ValA_Wu8 17.0000000000 DINH_LimDFCVerb 0.00 17.0000000000 FORMAT "%13.10" NUMBER 69 /end CHARACTERISTIC
/begin CHARACTERISTIC DINH_Lim.DFC_EGSDUS2B1TarRich_CA "inhibit conditions / inhibit limit conditions for inhibit source DFC_EGSDUS2B1TarRich" VAL_BLK 0x804FE8E0 ValA_Wu8 17.0000000000 DINH_LimDFCVerb 0.00 17.0000000000 FORMAT "%13.10" NUMBER 69 /end CHARACTERISTIC
/begin CHARACTERISTIC DINH_Lim.DFC_EONVmax_CA "inhibit conditions / inhibit limit conditions for inhibit source DFC_EONVmax" VAL_BLK 0x804FE925 ValA_Wu8 17.0000000000 DINH_LimDFCVerb 0.00 17.0000000000 FORMAT "%13.10" NUMBER 50 /end CHARACTERISTIC
/begin CHARACTERISTIC DINH_Lim.DFC_ETAKHLmax_CA "inhibit conditions / inhibit limit conditions for inhibit source DFC_ETAKHLmax" VAL_BLK 0x804FE957 ValA_Wu8 17.0000000000 DINH_LimDFCVerb 0.00 17.0000000000 FORMAT "%13.10" NUMBER 50 /end CHARACTERISTIC
/begin CHARACTERISTIC DINH_Lim.DFC_ETAKHTmax_CA "inhibit conditions / inhibit limit conditions for inhibit source DFC_ETAKHTmax" VAL_BLK 0x804FE989 ValA_Wu8 17.0000000000 DINH_LimDFCVerb 0.00 17.0000000000 FORMAT "%13.10" NUMBER 50 /end CHARACTERISTIC
/begin CHARACTERISTIC DINH_Lim.DFC_ETHSEmax_CA "inhibit conditions / inhibit limit conditions for inhibit source DFC_ETHSEmax" VAL_BLK 0x804FE9BB ValA_Wu8 17.0000000000 DINH_LimDFCVerb 0.00 17.0000000000 FORMAT "%13.10" NUMBER 70 /end CHARACTERISTIC
/begin CHARACTERISTIC DINH_Lim.DFC_ETHSEmin_CA "inhibit conditions / inhibit limit conditions for inhibit source DFC_ETHSEmin" VAL_BLK 0x804FEA01 ValA_Wu8 17.0000000000 DINH_LimDFCVerb 0.00 17.0000000000 FORMAT "%13.10" NUMBER 70 /end CHARACTERISTIC
/begin CHARACTERISTIC DINH_Lim.DFC_ETHSFmax_CA "inhibit conditions / inhibit limit conditions for inhibit source DFC_ETHSFmax" VAL_BLK 0x804FEA47 ValA_Wu8 17.0000000000 DINH_LimDFCVerb 0.00 17.0000000000 FORMAT "%13.10" NUMBER 70 /end CHARACTERISTIC
/begin CHARACTERISTIC DINH_Lim.DFC_ETHSFmin_CA "inhibit conditions / inhibit limit conditions for inhibit source DFC_ETHSFmin" VAL_BLK 0x804FEA8D ValA_Wu8 17.0000000000 DINH_LimDFCVerb 0.00 17.0000000000 FORMAT "%13.10" NUMBER 70 /end CHARACTERISTIC
/begin CHARACTERISTIC DINH_Lim.DFC_ETHSFsig_CA "inhibit conditions / inhibit limit conditions for inhibit source DFC_ETHSFsig" VAL_BLK 0x804FEAD3 ValA_Wu8 17.0000000000 DINH_LimDFCVerb 0.00 17.0000000000 FORMAT "%13.10" NUMBER 70 /end CHARACTERISTIC
/begin CHARACTERISTIC DINH_Lim.DFC_ETHSNPWmax_CA "inhibit conditions / inhibit limit conditions for inhibit source DFC_ETHSNPWmax" VAL_BLK 0x804FEB19 ValA_Wu8 17.0000000000 DINH_LimDFCVerb 0.00 17.0000000000 FORMAT "%13.10" NUMBER 68 /end CHARACTERISTIC
/begin CHARACTERISTIC DINH_Lim.DFC_ETHSNPWmin_CA "inhibit conditions / inhibit limit conditions for inhibit source DFC_ETHSNPWmin" VAL_BLK 0x804FEB5D ValA_Wu8 17.0000000000 DINH_LimDFCVerb 0.00 17.0000000000 FORMAT "%13.10" NUMBER 68 /end CHARACTERISTIC
/begin CHARACTERISTIC DINH_Lim.DFC_ETHSNPWsig_CA "inhibit conditions / inhibit limit conditions for inhibit source DFC_ETHSNPWsig" VAL_BLK 0x804FEBA1 ValA_Wu8 17.0000000000 DINH_LimDFCVerb 0.00 17.0000000000 FORMAT "%13.10" NUMBER 68 /end CHARACTERISTIC
/begin CHARACTERISTIC DINH_Lim.DFC_ETHSPLnpl_CA "inhibit conditions / inhibit limit conditions for inhibit source DFC_ETHSPLnpl" VAL_BLK 0x804FEBE5 ValA_Wu8 17.0000000000 DINH_LimDFCVerb 0.00 17.0000000000 FORMAT "%13.10" NUMBER 66 /end CHARACTERISTIC
/begin CHARACTERISTIC DINH_Lim.DFC_ETHSTPLnpl_CA "inhibit conditions / inhibit limit conditions for inhibit source DFC_ETHSTPLnpl" VAL_BLK 0x804FEC27 ValA_Wu8 17.0000000000 DINH_LimDFCVerb 0.00 17.0000000000 FORMAT "%13.10" NUMBER 68 /end CHARACTERISTIC
/begin CHARACTERISTIC DINH_Lim.DFC_EngICO_CA "inhibit conditions / inhibit limit conditions for inhibit source DFC_EngICO" VAL_BLK 0x804FEC6B ValA_Wu8 17.0000000000 DINH_LimDFCVerb 0.00 17.0000000000 FORMAT "%13.10" NUMBER 50 /end CHARACTERISTIC
/begin CHARACTERISTIC DINH_Lim.DFC_EngPrtOvrSpdMon_CA "inhibit conditions / inhibit limit conditions for inhibit source DFC_EngPrtOvrSpdMon" VAL_BLK 0x804FEC9D ValA_Wu8 17.0000000000 DINH_LimDFCVerb 0.00 17.0000000000 FORMAT "%13.10" NUMBER 50 /end CHARACTERISTIC
/begin CHARACTERISTIC DINH_Lim.DFC_EpmCaSI1ErrSig_CA "inhibit conditions / inhibit limit conditions for inhibit source DFC_EpmCaSI1ErrSig" VAL_BLK 0x804FECCF ValA_Wu8 17.0000000000 DINH_LimDFCVerb 0.00 17.0000000000 FORMAT "%13.10" NUMBER 72 /end CHARACTERISTIC
/begin CHARACTERISTIC DINH_Lim.DFC_EpmCaSI1MntErr_CA "inhibit conditions / inhibit limit conditions for inhibit source DFC_EpmCaSI1MntErr" VAL_BLK 0x804FED17 ValA_Wu8 17.0000000000 DINH_LimDFCVerb 0.00 17.0000000000 FORMAT "%13.10" NUMBER 74 /end CHARACTERISTIC
/begin CHARACTERISTIC DINH_Lim.DFC_EpmCaSI1NoSigMax_CA "inhibit conditions / inhibit limit conditions for inhibit source DFC_EpmCaSI1NoSigMax" VAL_BLK 0x804FED61 ValA_Wu8 17.0000000000 DINH_LimDFCVerb 0.00 17.0000000000 FORMAT "%13.10" NUMBER 72 /end CHARACTERISTIC
/begin CHARACTERISTIC DINH_Lim.DFC_EpmCaSI1NoSigMin_CA "inhibit conditions / inhibit limit conditions for inhibit source DFC_EpmCaSI1NoSigMin" VAL_BLK 0x804FEDA9 ValA_Wu8 17.0000000000 DINH_LimDFCVerb 0.00 17.0000000000 FORMAT "%13.10" NUMBER 72 /end CHARACTERISTIC
/begin CHARACTERISTIC DINH_Lim.DFC_EpmCaSI1OfsErr_CA "inhibit conditions / inhibit limit conditions for inhibit source DFC_EpmCaSI1OfsErr" VAL_BLK 0x804FEDF1 ValA_Wu8 17.0000000000 DINH_LimDFCVerb 0.00 17.0000000000 FORMAT "%13.10" NUMBER 80 /end CHARACTERISTIC
/begin CHARACTERISTIC DINH_Lim.DFC_EpmCrSDGI_CA "inhibit conditions / inhibit limit conditions for inhibit source DFC_EpmCrSDGI" VAL_BLK 0x804FEE41 ValA_Wu8 17.0000000000 DINH_LimDFCVerb 0.00 17.0000000000 FORMAT "%13.10" NUMBER 61 /end CHARACTERISTIC
/begin CHARACTERISTIC DINH_Lim.DFC_EpmCrSErrSig_CA "inhibit conditions / inhibit limit conditions for inhibit source DFC_EpmCrSErrSig" VAL_BLK 0x804FEE7E ValA_Wu8 17.0000000000 DINH_LimDFCVerb 0.00 17.0000000000 FORMAT "%13.10" NUMBER 101 /end CHARACTERISTIC
/begin CHARACTERISTIC DINH_Lim.DFC_EpmCrSNoSig_CA "inhibit conditions / inhibit limit conditions for inhibit source DFC_EpmCrSNoSig" VAL_BLK 0x804FEEE3 ValA_Wu8 17.0000000000 DINH_LimDFCVerb 0.00 17.0000000000 FORMAT "%13.10" NUMBER 114 /end CHARACTERISTIC
/begin CHARACTERISTIC DINH_Lim.DFC_EtaEngIdleNonCsers_CA "inhibit conditions / inhibit limit conditions for inhibit source DFC_EtaEngIdleNonCsers" VAL_BLK 0x804FEF55 ValA_Wu8 17.0000000000 DINH_LimDFCVerb 0.00 17.0000000000 FORMAT "%13.10" NUMBER 50 /end CHARACTERISTIC
/begin CHARACTERISTIC DINH_Lim.DFC_EtaEngPtlNonCsers_CA "inhibit conditions / inhibit limit conditions for inhibit source DFC_EtaEngPtlNonCsers" VAL_BLK 0x804FEF87 ValA_Wu8 17.0000000000 DINH_LimDFCVerb 0.00 17.0000000000 FORMAT "%13.10" NUMBER 50 /end CHARACTERISTIC
/begin CHARACTERISTIC DINH_Lim.DFC_FRAmax_CA "inhibit conditions / inhibit limit conditions for inhibit source DFC_FRAmax" VAL_BLK 0x804FEFB9 ValA_Wu8 17.0000000000 DINH_LimDFCVerb 0.00 17.0000000000 FORMAT "%13.10" NUMBER 73 /end CHARACTERISTIC
/begin CHARACTERISTIC DINH_Lim.DFC_FRAmin_CA "inhibit conditions / inhibit limit conditions for inhibit source DFC_FRAmin" VAL_BLK 0x804FF002 ValA_Wu8 17.0000000000 DINH_LimDFCVerb 0.00 17.0000000000 FORMAT "%13.10" NUMBER 73 /end CHARACTERISTIC
/begin CHARACTERISTIC DINH_Lim.DFC_FSTEmax_CA "inhibit conditions / inhibit limit conditions for inhibit source DFC_FSTEmax" VAL_BLK 0x804FF04B ValA_Wu8 17.0000000000 DINH_LimDFCVerb 0.00 17.0000000000 FORMAT "%13.10" NUMBER 54 /end CHARACTERISTIC
/begin CHARACTERISTIC DINH_Lim.DFC_FSTEmin_CA "inhibit conditions / inhibit limit conditions for inhibit source DFC_FSTEmin" VAL_BLK 0x804FF081 ValA_Wu8 17.0000000000 DINH_LimDFCVerb 0.00 17.0000000000 FORMAT "%13.10" NUMBER 54 /end CHARACTERISTIC
/begin CHARACTERISTIC DINH_Lim.DFC_FSTRmax_CA "inhibit conditions / inhibit limit conditions for inhibit source DFC_FSTRmax" VAL_BLK 0x804FF0B7 ValA_Wu8 17.0000000000 DINH_LimDFCVerb 0.00 17.0000000000 FORMAT "%13.10" NUMBER 53 /end CHARACTERISTIC
/begin CHARACTERISTIC DINH_Lim.DFC_FSTRmin_CA "inhibit conditions / inhibit limit conditions for inhibit source DFC_FSTRmin" VAL_BLK 0x804FF0EC ValA_Wu8 17.0000000000 DINH_LimDFCVerb 0.00 17.0000000000 FORMAT "%13.10" NUMBER 53 /end CHARACTERISTIC
/begin CHARACTERISTIC DINH_Lim.DFC_FSTRnpl_CA "inhibit conditions / inhibit limit conditions for inhibit source DFC_FSTRnpl" VAL_BLK 0x804FF121 ValA_Wu8 17.0000000000 DINH_LimDFCVerb 0.00 17.0000000000 FORMAT "%13.10" NUMBER 53 /end CHARACTERISTIC
/begin CHARACTERISTIC DINH_Lim.DFC_FSTmax_CA "inhibit conditions / inhibit limit conditions for inhibit source DFC_FSTmax" VAL_BLK 0x804FF156 ValA_Wu8 17.0000000000 DINH_LimDFCVerb 0.00 17.0000000000 FORMAT "%13.10" NUMBER 50 /end CHARACTERISTIC
/begin CHARACTERISTIC DINH_Lim.DFC_FTDLAmax_CA "inhibit conditions / inhibit limit conditions for inhibit source DFC_FTDLAmax" VAL_BLK 0x804FF188 ValA_Wu8 17.0000000000 DINH_LimDFCVerb 0.00 17.0000000000 FORMAT "%13.10" NUMBER 67 /end CHARACTERISTIC
/begin CHARACTERISTIC DINH_Lim.DFC_FTDLAmin_CA "inhibit conditions / inhibit limit conditions for inhibit source DFC_FTDLAmin" VAL_BLK 0x804FF1CB ValA_Wu8 17.0000000000 DINH_LimDFCVerb 0.00 17.0000000000 FORMAT "%13.10" NUMBER 67 /end CHARACTERISTIC
/begin CHARACTERISTIC DINH_Lim.DFC_FuPHiSnsrEleclmax_CA "inhibit conditions / inhibit limit conditions for inhibit source DFC_FuPHiSnsrEleclmax" VAL_BLK 0x804FF20E ValA_Wu8 17.0000000000 DINH_LimDFCVerb 0.00 17.0000000000 FORMAT "%13.10" NUMBER 51 /end CHARACTERISTIC
/begin CHARACTERISTIC DINH_Lim.DFC_FuPHiSnsrEleclmin_CA "inhibit conditions / inhibit limit conditions for inhibit source DFC_FuPHiSnsrEleclmin" VAL_BLK 0x804FF241 ValA_Wu8 17.0000000000 DINH_LimDFCVerb 0.00 17.0000000000 FORMAT "%13.10" NUMBER 51 /end CHARACTERISTIC
/begin CHARACTERISTIC DINH_Lim.DFC_FuPHiSnsrEleclnpl_CA "inhibit conditions / inhibit limit conditions for inhibit source DFC_FuPHiSnsrEleclnpl" VAL_BLK 0x804FF274 ValA_Wu8 17.0000000000 DINH_LimDFCVerb 0.00 17.0000000000 FORMAT "%13.10" NUMBER 51 /end CHARACTERISTIC
/begin CHARACTERISTIC DINH_Lim.DFC_FuPHiSnsrURngMax_CA "inhibit conditions / inhibit limit conditions for inhibit source DFC_FuPHiSnsrURngMax" VAL_BLK 0x804FF2A7 ValA_Wu8 17.0000000000 DINH_LimDFCVerb 0.00 17.0000000000 FORMAT "%13.10" NUMBER 55 /end CHARACTERISTIC
/begin CHARACTERISTIC DINH_Lim.DFC_FuPHiSnsrURngMin_CA "inhibit conditions / inhibit limit conditions for inhibit source DFC_FuPHiSnsrURngMin" VAL_BLK 0x804FF2DE ValA_Wu8 17.0000000000 DINH_LimDFCVerb 0.00 17.0000000000 FORMAT "%13.10" NUMBER 55 /end CHARACTERISTIC
/begin CHARACTERISTIC DINH_Lim.DFC_FuSnsrPhyRngMaxErr_CA "inhibit conditions / inhibit limit conditions for inhibit source DFC_FuSnsrPhyRngMaxErr" VAL_BLK 0x804FF315 ValA_Wu8 17.0000000000 DINH_LimDFCVerb 0.00 17.0000000000 FORMAT "%13.10" NUMBER 53 /end CHARACTERISTIC
/begin CHARACTERISTIC DINH_Lim.DFC_FuSnsrPhyRngMinErr_CA "inhibit conditions / inhibit limit conditions for inhibit source DFC_FuSnsrPhyRngMinErr" VAL_BLK 0x804FF34A ValA_Wu8 17.0000000000 DINH_LimDFCVerb 0.00 17.0000000000 FORMAT "%13.10" NUMBER 53 /end CHARACTERISTIC
/begin CHARACTERISTIC DINH_Lim.DFC_GEVlvLockPinDiagIntkB1_CA "inhibit conditions / inhibit limit conditions for inhibit source DFC_GEVlvLockPinDiagIntkB1" VAL_BLK 0x804FF37F ValA_Wu8 17.0000000000 DINH_LimDFCVerb 0.00 17.0000000000 FORMAT "%13.10" NUMBER 51 /end CHARACTERISTIC
/begin CHARACTERISTIC DINH_Lim.DFC_GEVlvPhaSlowIntkB1_CA "inhibit conditions / inhibit limit conditions for inhibit source DFC_GEVlvPhaSlowIntkB1" VAL_BLK 0x804FF3B2 ValA_Wu8 17.0000000000 DINH_LimDFCVerb 0.00 17.0000000000 FORMAT "%13.10" NUMBER 91 /end CHARACTERISTIC
/begin CHARACTERISTIC DINH_Lim.DFC_GEVlvPhaTargIntkB1_CA "inhibit conditions / inhibit limit conditions for inhibit source DFC_GEVlvPhaTargIntkB1" VAL_BLK 0x804FF40D ValA_Wu8 17.0000000000 DINH_LimDFCVerb 0.00 17.0000000000 FORMAT "%13.10" NUMBER 91 /end CHARACTERISTIC
/begin CHARACTERISTIC DINH_Lim.DFC_GbxRvsSwtStk_CA "inhibit conditions / inhibit limit conditions for inhibit source DFC_GbxRvsSwtStk" VAL_BLK 0x804FF468 ValA_Wu8 17.0000000000 DINH_LimDFCVerb 0.00 17.0000000000 FORMAT "%13.10" NUMBER 55 /end CHARACTERISTIC
/begin CHARACTERISTIC DINH_Lim.DFC_HDRKHmax_CA "inhibit conditions / inhibit limit conditions for inhibit source DFC_HDRKHmax" VAL_BLK 0x804FF49F ValA_Wu8 17.0000000000 DINH_LimDFCVerb 0.00 17.0000000000 FORMAT "%13.10" NUMBER 52 /end CHARACTERISTIC
/begin CHARACTERISTIC DINH_Lim.DFC_HDRKHmin_CA "inhibit conditions / inhibit limit conditions for inhibit source DFC_HDRKHmin" VAL_BLK 0x804FF4D3 ValA_Wu8 17.0000000000 DINH_LimDFCVerb 0.00 17.0000000000 FORMAT "%13.10" NUMBER 52 /end CHARACTERISTIC
/begin CHARACTERISTIC DINH_Lim.DFC_HDRPLmax_CA "inhibit conditions / inhibit limit conditions for inhibit source DFC_HDRPLmax" VAL_BLK 0x804FF507 ValA_Wu8 17.0000000000 DINH_LimDFCVerb 0.00 17.0000000000 FORMAT "%13.10" NUMBER 55 /end CHARACTERISTIC
/begin CHARACTERISTIC DINH_Lim.DFC_HDRPLmin_CA "inhibit conditions / inhibit limit conditions for inhibit source DFC_HDRPLmin" VAL_BLK 0x804FF53E ValA_Wu8 17.0000000000 DINH_LimDFCVerb 0.00 17.0000000000 FORMAT "%13.10" NUMBER 55 /end CHARACTERISTIC
/begin CHARACTERISTIC DINH_Lim.DFC_HDRmax_CA "inhibit conditions / inhibit limit conditions for inhibit source DFC_HDRmax" VAL_BLK 0x804FF575 ValA_Wu8 17.0000000000 DINH_LimDFCVerb 0.00 17.0000000000 FORMAT "%13.10" NUMBER 65 /end CHARACTERISTIC
/begin CHARACTERISTIC DINH_Lim.DFC_HDRmin_CA "inhibit conditions / inhibit limit conditions for inhibit source DFC_HDRmin" VAL_BLK 0x804FF5B6 ValA_Wu8 17.0000000000 DINH_LimDFCVerb 0.00 17.0000000000 FORMAT "%13.10" NUMBER 68 /end CHARACTERISTIC
/begin CHARACTERISTIC DINH_Lim.DFC_HEGOS2B1ElecMax_CA "inhibit conditions / inhibit limit conditions for inhibit source DFC_HEGOS2B1ElecMax" VAL_BLK 0x804FF5FA ValA_Wu8 17.0000000000 DINH_LimDFCVerb 0.00 17.0000000000 FORMAT "%13.10" NUMBER 71 /end CHARACTERISTIC
/begin CHARACTERISTIC DINH_Lim.DFC_HEGOS2B1ElecMin_CA "inhibit conditions / inhibit limit conditions for inhibit source DFC_HEGOS2B1ElecMin" VAL_BLK 0x804FF641 ValA_Wu8 17.0000000000 DINH_LimDFCVerb 0.00 17.0000000000 FORMAT "%13.10" NUMBER 71 /end CHARACTERISTIC
/begin CHARACTERISTIC DINH_Lim.DFC_HEGOS2B1ElecSig_CA "inhibit conditions / inhibit limit conditions for inhibit source DFC_HEGOS2B1ElecSig" VAL_BLK 0x804FF688 ValA_Wu8 17.0000000000 DINH_LimDFCVerb 0.00 17.0000000000 FORMAT "%13.10" NUMBER 71 /end CHARACTERISTIC
/begin CHARACTERISTIC DINH_Lim.DFC_HEGOS2B1HtgNpl_CA "inhibit conditions / inhibit limit conditions for inhibit source DFC_HEGOS2B1HtgNpl" VAL_BLK 0x804FF6CF ValA_Wu8 17.0000000000 DINH_LimDFCVerb 0.00 17.0000000000 FORMAT "%13.10" NUMBER 65 /end CHARACTERISTIC
/begin CHARACTERISTIC DINH_Lim.DFC_HEV00max_CA "inhibit conditions / inhibit limit conditions for inhibit source DFC_HEV00max" VAL_BLK 0x804FF710 ValA_Wu8 17.0000000000 DINH_LimDFCVerb 0.00 17.0000000000 FORMAT "%13.10" NUMBER 51 /end CHARACTERISTIC
/begin CHARACTERISTIC DINH_Lim.DFC_HEV01max_CA "inhibit conditions / inhibit limit conditions for inhibit source DFC_HEV01max" VAL_BLK 0x804FF743 ValA_Wu8 17.0000000000 DINH_LimDFCVerb 0.00 17.0000000000 FORMAT "%13.10" NUMBER 51 /end CHARACTERISTIC
/begin CHARACTERISTIC DINH_Lim.DFC_HEV02max_CA "inhibit conditions / inhibit limit conditions for inhibit source DFC_HEV02max" VAL_BLK 0x804FF776 ValA_Wu8 17.0000000000 DINH_LimDFCVerb 0.00 17.0000000000 FORMAT "%13.10" NUMBER 51 /end CHARACTERISTIC
/begin CHARACTERISTIC DINH_Lim.DFC_HEV03max_CA "inhibit conditions / inhibit limit conditions for inhibit source DFC_HEV03max" VAL_BLK 0x804FF7A9 ValA_Wu8 17.0000000000 DINH_LimDFCVerb 0.00 17.0000000000 FORMAT "%13.10" NUMBER 51 /end CHARACTERISTIC
/begin CHARACTERISTIC DINH_Lim.DFC_HEVE0max_CA "inhibit conditions / inhibit limit conditions for inhibit source DFC_HEVE0max" VAL_BLK 0x804FF7DC ValA_Wu8 17.0000000000 DINH_LimDFCVerb 0.00 17.0000000000 FORMAT "%13.10" NUMBER 53 /end CHARACTERISTIC
/begin CHARACTERISTIC DINH_Lim.DFC_HEVE1max_CA "inhibit conditions / inhibit limit conditions for inhibit source DFC_HEVE1max" VAL_BLK 0x804FF811 ValA_Wu8 17.0000000000 DINH_LimDFCVerb 0.00 17.0000000000 FORMAT "%13.10" NUMBER 53 /end CHARACTERISTIC
/begin CHARACTERISTIC DINH_Lim.DFC_HFMmax_CA "inhibit conditions / inhibit limit conditions for inhibit source DFC_HFMmax" VAL_BLK 0x804FF846 ValA_Wu8 17.0000000000 DINH_LimDFCVerb 0.00 17.0000000000 FORMAT "%13.10" NUMBER 64 /end CHARACTERISTIC
/begin CHARACTERISTIC DINH_Lim.DFC_HiPSysHiPMaxLimExcdd_CA "inhibit conditions / inhibit limit conditions for inhibit source DFC_HiPSysHiPMaxLimExcdd" VAL_BLK 0x804FF886 ValA_Wu8 17.0000000000 DINH_LimDFCVerb 0.00 17.0000000000 FORMAT "%13.10" NUMBER 51 /end CHARACTERISTIC
/begin CHARACTERISTIC DINH_Lim.DFC_IVGdiCtlCvoErrMax_0_CA "inhibit conditions / inhibit limit conditions for inhibit source DFC_IVGdiCtlCvoErrMax_0" VAL_BLK 0x804FF8B9 ValA_Wu8 17.0000000000 DINH_LimDFCVerb 0.00 17.0000000000 FORMAT "%13.10" NUMBER 51 /end CHARACTERISTIC
/begin CHARACTERISTIC DINH_Lim.DFC_IVGdiCtlCvoErrMax_1_CA "inhibit conditions / inhibit limit conditions for inhibit source DFC_IVGdiCtlCvoErrMax_1" VAL_BLK 0x804FF8EC ValA_Wu8 17.0000000000 DINH_LimDFCVerb 0.00 17.0000000000 FORMAT "%13.10" NUMBER 51 /end CHARACTERISTIC
/begin CHARACTERISTIC DINH_Lim.DFC_IVGdiCtlCvoErrMax_2_CA "inhibit conditions / inhibit limit conditions for inhibit source DFC_IVGdiCtlCvoErrMax_2" VAL_BLK 0x804FF91F ValA_Wu8 17.0000000000 DINH_LimDFCVerb 0.00 17.0000000000 FORMAT "%13.10" NUMBER 51 /end CHARACTERISTIC
/begin CHARACTERISTIC DINH_Lim.DFC_IVGdiCtlCvoErrMax_3_CA "inhibit conditions / inhibit limit conditions for inhibit source DFC_IVGdiCtlCvoErrMax_3" VAL_BLK 0x804FF952 ValA_Wu8 17.0000000000 DINH_LimDFCVerb 0.00 17.0000000000 FORMAT "%13.10" NUMBER 51 /end CHARACTERISTIC
/begin CHARACTERISTIC DINH_Lim.DFC_IVGdiCtlCvoErrMin_0_CA "inhibit conditions / inhibit limit conditions for inhibit source DFC_IVGdiCtlCvoErrMin_0" VAL_BLK 0x804FF985 ValA_Wu8 17.0000000000 DINH_LimDFCVerb 0.00 17.0000000000 FORMAT "%13.10" NUMBER 51 /end CHARACTERISTIC
/begin CHARACTERISTIC DINH_Lim.DFC_IVGdiCtlCvoErrMin_1_CA "inhibit conditions / inhibit limit conditions for inhibit source DFC_IVGdiCtlCvoErrMin_1" VAL_BLK 0x804FF9B8 ValA_Wu8 17.0000000000 DINH_LimDFCVerb 0.00 17.0000000000 FORMAT "%13.10" NUMBER 51 /end CHARACTERISTIC
/begin CHARACTERISTIC DINH_Lim.DFC_IVGdiCtlCvoErrMin_2_CA "inhibit conditions / inhibit limit conditions for inhibit source DFC_IVGdiCtlCvoErrMin_2" VAL_BLK 0x804FF9EB ValA_Wu8 17.0000000000 DINH_LimDFCVerb 0.00 17.0000000000 FORMAT "%13.10" NUMBER 51 /end CHARACTERISTIC
/begin CHARACTERISTIC DINH_Lim.DFC_IVGdiCtlCvoErrMin_3_CA "inhibit conditions / inhibit limit conditions for inhibit source DFC_IVGdiCtlCvoErrMin_3" VAL_BLK 0x804FFA1E ValA_Wu8 17.0000000000 DINH_LimDFCVerb 0.00 17.0000000000 FORMAT "%13.10" NUMBER 51 /end CHARACTERISTIC
/begin CHARACTERISTIC DINH_Lim.DFC_IVGdiCtlCvoErrMinMax_CA "inhibit conditions / inhibit limit conditions for inhibit source DFC_IVGdiCtlCvoErrMinMax" VAL_BLK 0x804FFA51 ValA_Wu8 17.0000000000 DINH_LimDFCVerb 0.00 17.0000000000 FORMAT "%13.10" NUMBER 50 /end CHARACTERISTIC
/begin CHARACTERISTIC DINH_Lim.DFC_IVGdiCtlCvoSigPlausErrSmrCdn_CA "inhibit conditions / inhibit limit conditions for inhibit source DFC_IVGdiCtlCvoSigPlausErrSmrCdn" VAL_BLK 0x804FFA83 ValA_Wu8 17.0000000000 DINH_LimDFCVerb 0.00 17.0000000000 FORMAT "%13.10" NUMBER 50 /end CHARACTERISTIC
/begin CHARACTERISTIC DINH_Lim.DFC_IVGdiCtl_CvoErr_CA "inhibit conditions / inhibit limit conditions for inhibit source DFC_IVGdiCtl_CvoErr" VAL_BLK 0x804FFAB5 ValA_Wu8 17.0000000000 DINH_LimDFCVerb 0.00 17.0000000000 FORMAT "%13.10" NUMBER 50 /end CHARACTERISTIC
/begin CHARACTERISTIC DINH_Lim.DFC_IVGdiCtl_CvoSigPlaus_0_CA "inhibit conditions / inhibit limit conditions for inhibit source DFC_IVGdiCtl_CvoSigPlaus_0" VAL_BLK 0x804FFAE7 ValA_Wu8 17.0000000000 DINH_LimDFCVerb 0.00 17.0000000000 FORMAT "%13.10" NUMBER 51 /end CHARACTERISTIC
/begin CHARACTERISTIC DINH_Lim.DFC_IVGdiCtl_CvoSigPlaus_1_CA "inhibit conditions / inhibit limit conditions for inhibit source DFC_IVGdiCtl_CvoSigPlaus_1" VAL_BLK 0x804FFB1A ValA_Wu8 17.0000000000 DINH_LimDFCVerb 0.00 17.0000000000 FORMAT "%13.10" NUMBER 51 /end CHARACTERISTIC
/begin CHARACTERISTIC DINH_Lim.DFC_IVGdiCtl_CvoSigPlaus_2_CA "inhibit conditions / inhibit limit conditions for inhibit source DFC_IVGdiCtl_CvoSigPlaus_2" VAL_BLK 0x804FFB4D ValA_Wu8 17.0000000000 DINH_LimDFCVerb 0.00 17.0000000000 FORMAT "%13.10" NUMBER 51 /end CHARACTERISTIC
/begin CHARACTERISTIC DINH_Lim.DFC_IVGdiCtl_CvoSigPlaus_3_CA "inhibit conditions / inhibit limit conditions for inhibit source DFC_IVGdiCtl_CvoSigPlaus_3" VAL_BLK 0x804FFB80 ValA_Wu8 17.0000000000 DINH_LimDFCVerb 0.00 17.0000000000 FORMAT "%13.10" NUMBER 51 /end CHARACTERISTIC
/begin CHARACTERISTIC DINH_Lim.DFC_IntkAirTAirFltDsCrssMax_CA "inhibit conditions / inhibit limit conditions for inhibit source DFC_IntkAirTAirFltDsCrssMax" VAL_BLK 0x804FFBB3 ValA_Wu8 17.0000000000 DINH_LimDFCVerb 0.00 17.0000000000 FORMAT "%13.10" NUMBER 52 /end CHARACTERISTIC
/begin CHARACTERISTIC DINH_Lim.DFC_IntkAirTAirFltDsCrssMin_CA "inhibit conditions / inhibit limit conditions for inhibit source DFC_IntkAirTAirFltDsCrssMin" VAL_BLK 0x804FFBE7 ValA_Wu8 17.0000000000 DINH_LimDFCVerb 0.00 17.0000000000 FORMAT "%13.10" NUMBER 52 /end CHARACTERISTIC
/begin CHARACTERISTIC DINH_Lim.DFC_IntkAirTAirFltDsHSCMax_CA "inhibit conditions / inhibit limit conditions for inhibit source DFC_IntkAirTAirFltDsHSCMax" VAL_BLK 0x804FFC1B ValA_Wu8 17.0000000000 DINH_LimDFCVerb 0.00 17.0000000000 FORMAT "%13.10" NUMBER 52 /end CHARACTERISTIC
/begin CHARACTERISTIC DINH_Lim.DFC_IntkAirTAirFltDsImps_CA "inhibit conditions / inhibit limit conditions for inhibit source DFC_IntkAirTAirFltDsImps" VAL_BLK 0x804FFC4F ValA_Wu8 17.0000000000 DINH_LimDFCVerb 0.00 17.0000000000 FORMAT "%13.10" NUMBER 57 /end CHARACTERISTIC
/begin CHARACTERISTIC DINH_Lim.DFC_IntkAirTAirFltDsPRCMax_CA "inhibit conditions / inhibit limit conditions for inhibit source DFC_IntkAirTAirFltDsPRCMax" VAL_BLK 0x804FFC88 ValA_Wu8 17.0000000000 DINH_LimDFCVerb 0.00 17.0000000000 FORMAT "%13.10" NUMBER 52 /end CHARACTERISTIC
/begin CHARACTERISTIC DINH_Lim.DFC_IntkAirTAirFltDsPRCMin_CA "inhibit conditions / inhibit limit conditions for inhibit source DFC_IntkAirTAirFltDsPRCMin" VAL_BLK 0x804FFCBC ValA_Wu8 17.0000000000 DINH_LimDFCVerb 0.00 17.0000000000 FORMAT "%13.10" NUMBER 52 /end CHARACTERISTIC
/begin CHARACTERISTIC DINH_Lim.DFC_IntkAirTAirFltDsSRCMax_CA "inhibit conditions / inhibit limit conditions for inhibit source DFC_IntkAirTAirFltDsSRCMax" VAL_BLK 0x804FFCF0 ValA_Wu8 17.0000000000 DINH_LimDFCVerb 0.00 17.0000000000 FORMAT "%13.10" NUMBER 57 /end CHARACTERISTIC
/begin CHARACTERISTIC DINH_Lim.DFC_IntkAirTAirFltDsSRCMin_CA "inhibit conditions / inhibit limit conditions for inhibit source DFC_IntkAirTAirFltDsSRCMin" VAL_BLK 0x804FFD29 ValA_Wu8 17.0000000000 DINH_LimDFCVerb 0.00 17.0000000000 FORMAT "%13.10" NUMBER 57 /end CHARACTERISTIC
/begin CHARACTERISTIC DINH_Lim.DFC_IntkAirTAirFltDsSTC_CA "inhibit conditions / inhibit limit conditions for inhibit source DFC_IntkAirTAirFltDsSTC" VAL_BLK 0x804FFD62 ValA_Wu8 17.0000000000 DINH_LimDFCVerb 0.00 17.0000000000 FORMAT "%13.10" NUMBER 52 /end CHARACTERISTIC
/begin CHARACTERISTIC DINH_Lim.DFC_IntkAirTIntkMnfldCrssMax_CA "inhibit conditions / inhibit limit conditions for inhibit source DFC_IntkAirTIntkMnfldCrssMax" VAL_BLK 0x804FFD96 ValA_Wu8 17.0000000000 DINH_LimDFCVerb 0.00 17.0000000000 FORMAT "%13.10" NUMBER 90 /end CHARACTERISTIC
/begin CHARACTERISTIC DINH_Lim.DFC_IntkAirTIntkMnfldCrssMin_CA "inhibit conditions / inhibit limit conditions for inhibit source DFC_IntkAirTIntkMnfldCrssMin" VAL_BLK 0x804FFDF0 ValA_Wu8 17.0000000000 DINH_LimDFCVerb 0.00 17.0000000000 FORMAT "%13.10" NUMBER 90 /end CHARACTERISTIC
/begin CHARACTERISTIC DINH_Lim.DFC_IntkAirTIntkMnfldHSCMax_CA "inhibit conditions / inhibit limit conditions for inhibit source DFC_IntkAirTIntkMnfldHSCMax" VAL_BLK 0x804FFE4A ValA_Wu8 17.0000000000 DINH_LimDFCVerb 0.00 17.0000000000 FORMAT "%13.10" NUMBER 84 /end CHARACTERISTIC
/begin CHARACTERISTIC DINH_Lim.DFC_IntkAirTIntkMnfldImps_CA "inhibit conditions / inhibit limit conditions for inhibit source DFC_IntkAirTIntkMnfldImps" VAL_BLK 0x804FFE9E ValA_Wu8 17.0000000000 DINH_LimDFCVerb 0.00 17.0000000000 FORMAT "%13.10" NUMBER 95 /end CHARACTERISTIC
/begin CHARACTERISTIC DINH_Lim.DFC_IntkAirTIntkMnfldPRCMax_CA "inhibit conditions / inhibit limit conditions for inhibit source DFC_IntkAirTIntkMnfldPRCMax" VAL_BLK 0x804FFEFD ValA_Wu8 17.0000000000 DINH_LimDFCVerb 0.00 17.0000000000 FORMAT "%13.10" NUMBER 84 /end CHARACTERISTIC
/begin CHARACTERISTIC DINH_Lim.DFC_IntkAirTIntkMnfldPRCMin_CA "inhibit conditions / inhibit limit conditions for inhibit source DFC_IntkAirTIntkMnfldPRCMin" VAL_BLK 0x804FFF51 ValA_Wu8 17.0000000000 DINH_LimDFCVerb 0.00 17.0000000000 FORMAT "%13.10" NUMBER 84 /end CHARACTERISTIC
/begin CHARACTERISTIC DINH_Lim.DFC_IntkAirTIntkMnfldSRCMax_CA "inhibit conditions / inhibit limit conditions for inhibit source DFC_IntkAirTIntkMnfldSRCMax" VAL_BLK 0x804FFFA5 ValA_Wu8 17.0000000000 DINH_LimDFCVerb 0.00 17.0000000000 FORMAT "%13.10" NUMBER 96 /end CHARACTERISTIC
/begin CHARACTERISTIC DINH_Lim.DFC_IntkAirTIntkMnfldSRCMin_CA "inhibit conditions / inhibit limit conditions for inhibit source DFC_IntkAirTIntkMnfldSRCMin" VAL_BLK 0x80500005 ValA_Wu8 17.0000000000 DINH_LimDFCVerb 0.00 17.0000000000 FORMAT "%13.10" NUMBER 96 /end CHARACTERISTIC
/begin CHARACTERISTIC DINH_Lim.DFC_IntkAirTIntkMnfldSTC_CA "inhibit conditions / inhibit limit conditions for inhibit source DFC_IntkAirTIntkMnfldSTC" VAL_BLK 0x80500065 ValA_Wu8 17.0000000000 DINH_LimDFCVerb 0.00 17.0000000000 FORMAT "%13.10" NUMBER 84 /end CHARACTERISTIC
/begin CHARACTERISTIC DINH_Lim.DFC_KRREGRLMX_CA "inhibit conditions / inhibit limit conditions for inhibit source DFC_KRREGRLMX" VAL_BLK 0x805000B9 ValA_Wu8 17.0000000000 DINH_LimDFCVerb 0.00 17.0000000000 FORMAT "%13.10" NUMBER 50 /end CHARACTERISTIC
/begin CHARACTERISTIC DINH_Lim.DFC_KRVEKOCVLCI_CA "inhibit conditions / inhibit limit conditions for inhibit source DFC_KRVEKOCVLCI" VAL_BLK 0x805000EB ValA_Wu8 17.0000000000 DINH_LimDFCVerb 0.00 17.0000000000 FORMAT "%13.10" NUMBER 50 /end CHARACTERISTIC
/begin CHARACTERISTIC DINH_Lim.DFC_KRVEKOENCHMT_CA "inhibit conditions / inhibit limit conditions for inhibit source DFC_KRVEKOENCHMT" VAL_BLK 0x8050011D ValA_Wu8 17.0000000000 DINH_LimDFCVerb 0.00 17.0000000000 FORMAT "%13.10" NUMBER 50 /end CHARACTERISTIC
/begin CHARACTERISTIC DINH_Lim.DFC_KRVEKOENCHMT0_CA "inhibit conditions / inhibit limit conditions for inhibit source DFC_KRVEKOENCHMT0" VAL_BLK 0x8050014F ValA_Wu8 17.0000000000 DINH_LimDFCVerb 0.00 17.0000000000 FORMAT "%13.10" NUMBER 50 /end CHARACTERISTIC
/begin CHARACTERISTIC DINH_Lim.DFC_KRVEKOENCHMT1_CA "inhibit conditions / inhibit limit conditions for inhibit source DFC_KRVEKOENCHMT1" VAL_BLK 0x80500181 ValA_Wu8 17.0000000000 DINH_LimDFCVerb 0.00 17.0000000000 FORMAT "%13.10" NUMBER 50 /end CHARACTERISTIC
/begin CHARACTERISTIC DINH_Lim.DFC_KRVEKOENCHMT2_CA "inhibit conditions / inhibit limit conditions for inhibit source DFC_KRVEKOENCHMT2" VAL_BLK 0x805001B3 ValA_Wu8 17.0000000000 DINH_LimDFCVerb 0.00 17.0000000000 FORMAT "%13.10" NUMBER 50 /end CHARACTERISTIC
/begin CHARACTERISTIC DINH_Lim.DFC_KRVEKOENCHMT3_CA "inhibit conditions / inhibit limit conditions for inhibit source DFC_KRVEKOENCHMT3" VAL_BLK 0x805001E5 ValA_Wu8 17.0000000000 DINH_LimDFCVerb 0.00 17.0000000000 FORMAT "%13.10" NUMBER 50 /end CHARACTERISTIC
/begin CHARACTERISTIC DINH_Lim.DFC_KRVEKOENCHMT4_CA "inhibit conditions / inhibit limit conditions for inhibit source DFC_KRVEKOENCHMT4" VAL_BLK 0x80500217 ValA_Wu8 17.0000000000 DINH_LimDFCVerb 0.00 17.0000000000 FORMAT "%13.10" NUMBER 50 /end CHARACTERISTIC
/begin CHARACTERISTIC DINH_Lim.DFC_KRVEKOENCHMT5_CA "inhibit conditions / inhibit limit conditions for inhibit source DFC_KRVEKOENCHMT5" VAL_BLK 0x80500249 ValA_Wu8 17.0000000000 DINH_LimDFCVerb 0.00 17.0000000000 FORMAT "%13.10" NUMBER 50 /end CHARACTERISTIC
/begin CHARACTERISTIC DINH_Lim.DFC_KRVEKOENCHMT6_CA "inhibit conditions / inhibit limit conditions for inhibit source DFC_KRVEKOENCHMT6" VAL_BLK 0x8050027B ValA_Wu8 17.0000000000 DINH_LimDFCVerb 0.00 17.0000000000 FORMAT "%13.10" NUMBER 50 /end CHARACTERISTIC
/begin CHARACTERISTIC DINH_Lim.DFC_KRVEKOENCHMT7_CA "inhibit conditions / inhibit limit conditions for inhibit source DFC_KRVEKOENCHMT7" VAL_BLK 0x805002AD ValA_Wu8 17.0000000000 DINH_LimDFCVerb 0.00 17.0000000000 FORMAT "%13.10" NUMBER 50 /end CHARACTERISTIC
/begin CHARACTERISTIC DINH_Lim.DFC_KRVEKORLMX_CA "inhibit conditions / inhibit limit conditions for inhibit source DFC_KRVEKORLMX" VAL_BLK 0x805002DF ValA_Wu8 17.0000000000 DINH_LimDFCVerb 0.00 17.0000000000 FORMAT "%13.10" NUMBER 50 /end CHARACTERISTIC
/begin CHARACTERISTIC DINH_Lim.DFC_KRVEKORLMXL_CA "inhibit conditions / inhibit limit conditions for inhibit source DFC_KRVEKORLMXL" VAL_BLK 0x80500311 ValA_Wu8 17.0000000000 DINH_LimDFCVerb 0.00 17.0000000000 FORMAT "%13.10" NUMBER 50 /end CHARACTERISTIC
/begin CHARACTERISTIC DINH_Lim.DFC_KS1max_CA "inhibit conditions / inhibit limit conditions for inhibit source DFC_KS1max" VAL_BLK 0x80500343 ValA_Wu8 17.0000000000 DINH_LimDFCVerb 0.00 17.0000000000 FORMAT "%13.10" NUMBER 58 /end CHARACTERISTIC
/begin CHARACTERISTIC DINH_Lim.DFC_KS1min_CA "inhibit conditions / inhibit limit conditions for inhibit source DFC_KS1min" VAL_BLK 0x8050037D ValA_Wu8 17.0000000000 DINH_LimDFCVerb 0.00 17.0000000000 FORMAT "%13.10" NUMBER 58 /end CHARACTERISTIC
/begin CHARACTERISTIC DINH_Lim.DFC_LMmax_CA "inhibit conditions / inhibit limit conditions for inhibit source DFC_LMmax" VAL_BLK 0x805003B7 ValA_Wu8 17.0000000000 DINH_LimDFCVerb 0.00 17.0000000000 FORMAT "%13.10" NUMBER 67 /end CHARACTERISTIC
/begin CHARACTERISTIC DINH_Lim.DFC_LZSRnpl_CA "inhibit conditions / inhibit limit conditions for inhibit source DFC_LZSRnpl" VAL_BLK 0x805003FA ValA_Wu8 17.0000000000 DINH_LimDFCVerb 0.00 17.0000000000 FORMAT "%13.10" NUMBER 57 /end CHARACTERISTIC
/begin CHARACTERISTIC DINH_Lim.DFC_LamDynDiagS1B1_CA "inhibit conditions / inhibit limit conditions for inhibit source DFC_LamDynDiagS1B1" VAL_BLK 0x80500433 ValA_Wu8 17.0000000000 DINH_LimDFCVerb 0.00 17.0000000000 FORMAT "%13.10" NUMBER 78 /end CHARACTERISTIC
/begin CHARACTERISTIC DINH_Lim.DFC_LeakIntkMnfldEmiInfl_CA "inhibit conditions / inhibit limit conditions for inhibit source DFC_LeakIntkMnfldEmiInfl" VAL_BLK 0x80500481 ValA_Wu8 17.0000000000 DINH_LimDFCVerb 0.00 17.0000000000 FORMAT "%13.10" NUMBER 52 /end CHARACTERISTIC
/begin CHARACTERISTIC DINH_Lim.DFC_LinFrameErrDCDC_CA "inhibit conditions / inhibit limit conditions for inhibit source DFC_LinFrameErrDCDC" VAL_BLK 0x805004B5 ValA_Wu8 17.0000000000 DINH_LimDFCVerb 0.00 17.0000000000 FORMAT "%13.10" NUMBER 52 /end CHARACTERISTIC
/begin CHARACTERISTIC DINH_Lim.DFC_LinOverrunErrDCDC_CA "inhibit conditions / inhibit limit conditions for inhibit source DFC_LinOverrunErrDCDC" VAL_BLK 0x805004E9 ValA_Wu8 17.0000000000 DINH_LimDFCVerb 0.00 17.0000000000 FORMAT "%13.10" NUMBER 52 /end CHARACTERISTIC
/begin CHARACTERISTIC DINH_Lim.DFC_MD00max_CA "inhibit conditions / inhibit limit conditions for inhibit source DFC_MD00max" VAL_BLK 0x8050051D ValA_Wu8 17.0000000000 DINH_LimDFCVerb 0.00 17.0000000000 FORMAT "%13.10" NUMBER 50 /end CHARACTERISTIC
/begin CHARACTERISTIC DINH_Lim.DFC_MDBmax_CA "inhibit conditions / inhibit limit conditions for inhibit source DFC_MDBmax" VAL_BLK 0x8050054F ValA_Wu8 17.0000000000 DINH_LimDFCVerb 0.00 17.0000000000 FORMAT "%13.10" NUMBER 58 /end CHARACTERISTIC
/begin CHARACTERISTIC DINH_Lim.DFC_MDCat_CA "inhibit conditions / inhibit limit conditions for inhibit source DFC_MDCat" VAL_BLK 0x80500589 ValA_Wu8 17.0000000000 DINH_LimDFCVerb 0.00 17.0000000000 FORMAT "%13.10" NUMBER 56 /end CHARACTERISTIC
/begin CHARACTERISTIC DINH_Lim.DFC_MDCatCrit_CA "inhibit conditions / inhibit limit conditions for inhibit source DFC_MDCatCrit" VAL_BLK 0x805005C1 ValA_Wu8 17.0000000000 DINH_LimDFCVerb 0.00 17.0000000000 FORMAT "%13.10" NUMBER 50 /end CHARACTERISTIC
/begin CHARACTERISTIC DINH_Lim.DFC_MDCatCurr_CA "inhibit conditions / inhibit limit conditions for inhibit source DFC_MDCatCurr" VAL_BLK 0x805005F3 ValA_Wu8 17.0000000000 DINH_LimDFCVerb 0.00 17.0000000000 FORMAT "%13.10" NUMBER 53 /end CHARACTERISTIC
/begin CHARACTERISTIC DINH_Lim.DFC_MDCyl_0_CA "inhibit conditions / inhibit limit conditions for inhibit source DFC_MDCyl_0" VAL_BLK 0x80500628 ValA_Wu8 17.0000000000 DINH_LimDFCVerb 0.00 17.0000000000 FORMAT "%13.10" NUMBER 78 /end CHARACTERISTIC
/begin CHARACTERISTIC DINH_Lim.DFC_MDCyl_1_CA "inhibit conditions / inhibit limit conditions for inhibit source DFC_MDCyl_1" VAL_BLK 0x80500676 ValA_Wu8 17.0000000000 DINH_LimDFCVerb 0.00 17.0000000000 FORMAT "%13.10" NUMBER 78 /end CHARACTERISTIC
/begin CHARACTERISTIC DINH_Lim.DFC_MDCyl_2_CA "inhibit conditions / inhibit limit conditions for inhibit source DFC_MDCyl_2" VAL_BLK 0x805006C4 ValA_Wu8 17.0000000000 DINH_LimDFCVerb 0.00 17.0000000000 FORMAT "%13.10" NUMBER 78 /end CHARACTERISTIC
/begin CHARACTERISTIC DINH_Lim.DFC_MDCyl_3_CA "inhibit conditions / inhibit limit conditions for inhibit source DFC_MDCyl_3" VAL_BLK 0x80500712 ValA_Wu8 17.0000000000 DINH_LimDFCVerb 0.00 17.0000000000 FORMAT "%13.10" NUMBER 78 /end CHARACTERISTIC
/begin CHARACTERISTIC DINH_Lim.DFC_MDEmi_CA "inhibit conditions / inhibit limit conditions for inhibit source DFC_MDEmi" VAL_BLK 0x80500760 ValA_Wu8 17.0000000000 DINH_LimDFCVerb 0.00 17.0000000000 FORMAT "%13.10" NUMBER 56 /end CHARACTERISTIC
/begin CHARACTERISTIC DINH_Lim.DFC_MDEmiStrt_CA "inhibit conditions / inhibit limit conditions for inhibit source DFC_MDEmiStrt" VAL_BLK 0x80500798 ValA_Wu8 17.0000000000 DINH_LimDFCVerb 0.00 17.0000000000 FORMAT "%13.10" NUMBER 56 /end CHARACTERISTIC
/begin CHARACTERISTIC DINH_Lim.DFC_MDFco_CA "inhibit conditions / inhibit limit conditions for inhibit source DFC_MDFco" VAL_BLK 0x805007D0 ValA_Wu8 17.0000000000 DINH_LimDFCVerb 0.00 17.0000000000 FORMAT "%13.10" NUMBER 54 /end CHARACTERISTIC
/begin CHARACTERISTIC DINH_Lim.DFC_MDMpl_CA "inhibit conditions / inhibit limit conditions for inhibit source DFC_MDMpl" VAL_BLK 0x80500806 ValA_Wu8 17.0000000000 DINH_LimDFCVerb 0.00 17.0000000000 FORMAT "%13.10" NUMBER 78 /end CHARACTERISTIC
/begin CHARACTERISTIC DINH_Lim.DFC_MDSegTiAdpn_CA "inhibit conditions / inhibit limit conditions for inhibit source DFC_MDSegTiAdpn" VAL_BLK 0x80500854 ValA_Wu8 17.0000000000 DINH_LimDFCVerb 0.00 17.0000000000 FORMAT "%13.10" NUMBER 50 /end CHARACTERISTIC
/begin CHARACTERISTIC DINH_Lim.DFC_MDmax_CA "inhibit conditions / inhibit limit conditions for inhibit source DFC_MDmax" VAL_BLK 0x80500886 ValA_Wu8 17.0000000000 DINH_LimDFCVerb 0.00 17.0000000000 FORMAT "%13.10" NUMBER 50 /end CHARACTERISTIC
/begin CHARACTERISTIC DINH_Lim.DFC_MFuOilMax_CA "inhibit conditions / inhibit limit conditions for inhibit source DFC_MFuOilMax" VAL_BLK 0x805008B8 ValA_Wu8 17.0000000000 DINH_LimDFCVerb 0.00 17.0000000000 FORMAT "%13.10" NUMBER 50 /end CHARACTERISTIC
/begin CHARACTERISTIC DINH_Lim.DFC_MOXEMM_SMU_ALM0_0_CA "inhibit conditions / inhibit limit conditions for inhibit source DFC_MOXEMM_SMU_ALM0_0" VAL_BLK 0x805008EA ValA_Wu8 17.0000000000 DINH_LimDFCVerb 0.00 17.0000000000 FORMAT "%13.10" NUMBER 50 /end CHARACTERISTIC
/begin CHARACTERISTIC DINH_Lim.DFC_MOXEMM_SMU_ALM0_1_CA "inhibit conditions / inhibit limit conditions for inhibit source DFC_MOXEMM_SMU_ALM0_1" VAL_BLK 0x8050091C ValA_Wu8 17.0000000000 DINH_LimDFCVerb 0.00 17.0000000000 FORMAT "%13.10" NUMBER 50 /end CHARACTERISTIC
/begin CHARACTERISTIC DINH_Lim.DFC_MOXEMM_SMU_ALM0_10_CA "inhibit conditions / inhibit limit conditions for inhibit source DFC_MOXEMM_SMU_ALM0_10" VAL_BLK 0x8050094E ValA_Wu8 17.0000000000 DINH_LimDFCVerb 0.00 17.0000000000 FORMAT "%13.10" NUMBER 50 /end CHARACTERISTIC
/begin CHARACTERISTIC DINH_Lim.DFC_MOXEMM_SMU_ALM0_11_CA "inhibit conditions / inhibit limit conditions for inhibit source DFC_MOXEMM_SMU_ALM0_11" VAL_BLK 0x80500980 ValA_Wu8 17.0000000000 DINH_LimDFCVerb 0.00 17.0000000000 FORMAT "%13.10" NUMBER 50 /end CHARACTERISTIC
/begin CHARACTERISTIC DINH_Lim.DFC_MOXEMM_SMU_ALM0_13_CA "inhibit conditions / inhibit limit conditions for inhibit source DFC_MOXEMM_SMU_ALM0_13" VAL_BLK 0x805009B2 ValA_Wu8 17.0000000000 DINH_LimDFCVerb 0.00 17.0000000000 FORMAT "%13.10" NUMBER 50 /end CHARACTERISTIC
/begin CHARACTERISTIC DINH_Lim.DFC_MOXEMM_SMU_ALM0_14_CA "inhibit conditions / inhibit limit conditions for inhibit source DFC_MOXEMM_SMU_ALM0_14" VAL_BLK 0x805009E4 ValA_Wu8 17.0000000000 DINH_LimDFCVerb 0.00 17.0000000000 FORMAT "%13.10" NUMBER 50 /end CHARACTERISTIC
/begin CHARACTERISTIC DINH_Lim.DFC_MOXEMM_SMU_ALM0_2_CA "inhibit conditions / inhibit limit conditions for inhibit source DFC_MOXEMM_SMU_ALM0_2" VAL_BLK 0x80500A16 ValA_Wu8 17.0000000000 DINH_LimDFCVerb 0.00 17.0000000000 FORMAT "%13.10" NUMBER 50 /end CHARACTERISTIC
/begin CHARACTERISTIC DINH_Lim.DFC_MOXEMM_SMU_ALM0_22_CA "inhibit conditions / inhibit limit conditions for inhibit source DFC_MOXEMM_SMU_ALM0_22" VAL_BLK 0x80500A48 ValA_Wu8 17.0000000000 DINH_LimDFCVerb 0.00 17.0000000000 FORMAT "%13.10" NUMBER 50 /end CHARACTERISTIC
/begin CHARACTERISTIC DINH_Lim.DFC_MOXEMM_SMU_ALM0_23_CA "inhibit conditions / inhibit limit conditions for inhibit source DFC_MOXEMM_SMU_ALM0_23" VAL_BLK 0x80500A7A ValA_Wu8 17.0000000000 DINH_LimDFCVerb 0.00 17.0000000000 FORMAT "%13.10" NUMBER 50 /end CHARACTERISTIC
/begin CHARACTERISTIC DINH_Lim.DFC_MOXEMM_SMU_ALM0_4_CA "inhibit conditions / inhibit limit conditions for inhibit source DFC_MOXEMM_SMU_ALM0_4" VAL_BLK 0x80500AAC ValA_Wu8 17.0000000000 DINH_LimDFCVerb 0.00 17.0000000000 FORMAT "%13.10" NUMBER 50 /end CHARACTERISTIC
/begin CHARACTERISTIC DINH_Lim.DFC_MOXEMM_SMU_ALM0_5_CA "inhibit conditions / inhibit limit conditions for inhibit source DFC_MOXEMM_SMU_ALM0_5" VAL_BLK 0x80500ADE ValA_Wu8 17.0000000000 DINH_LimDFCVerb 0.00 17.0000000000 FORMAT "%13.10" NUMBER 50 /end CHARACTERISTIC
/begin CHARACTERISTIC DINH_Lim.DFC_MOXEMM_SMU_ALM0_7_CA "inhibit conditions / inhibit limit conditions for inhibit source DFC_MOXEMM_SMU_ALM0_7" VAL_BLK 0x80500B10 ValA_Wu8 17.0000000000 DINH_LimDFCVerb 0.00 17.0000000000 FORMAT "%13.10" NUMBER 50 /end CHARACTERISTIC
/begin CHARACTERISTIC DINH_Lim.DFC_MOXEMM_SMU_ALM0_8_CA "inhibit conditions / inhibit limit conditions for inhibit source DFC_MOXEMM_SMU_ALM0_8" VAL_BLK 0x80500B42 ValA_Wu8 17.0000000000 DINH_LimDFCVerb 0.00 17.0000000000 FORMAT "%13.10" NUMBER 50 /end CHARACTERISTIC
/begin CHARACTERISTIC DINH_Lim.DFC_MOXEMM_SMU_ALM10_16_CA "inhibit conditions / inhibit limit conditions for inhibit source DFC_MOXEMM_SMU_ALM10_16" VAL_BLK 0x80500B74 ValA_Wu8 17.0000000000 DINH_LimDFCVerb 0.00 17.0000000000 FORMAT "%13.10" NUMBER 50 /end CHARACTERISTIC
/begin CHARACTERISTIC DINH_Lim.DFC_MOXEMM_SMU_ALM10_17_CA "inhibit conditions / inhibit limit conditions for inhibit source DFC_MOXEMM_SMU_ALM10_17" VAL_BLK 0x80500BA6 ValA_Wu8 17.0000000000 DINH_LimDFCVerb 0.00 17.0000000000 FORMAT "%13.10" NUMBER 50 /end CHARACTERISTIC
/begin CHARACTERISTIC DINH_Lim.DFC_MOXEMM_SMU_ALM10_21_CA "inhibit conditions / inhibit limit conditions for inhibit source DFC_MOXEMM_SMU_ALM10_21" VAL_BLK 0x80500BD8 ValA_Wu8 17.0000000000 DINH_LimDFCVerb 0.00 17.0000000000 FORMAT "%13.10" NUMBER 50 /end CHARACTERISTIC
/begin CHARACTERISTIC DINH_Lim.DFC_MOXEMM_SMU_ALM11_0_CA "inhibit conditions / inhibit limit conditions for inhibit source DFC_MOXEMM_SMU_ALM11_0" VAL_BLK 0x80500C0A ValA_Wu8 17.0000000000 DINH_LimDFCVerb 0.00 17.0000000000 FORMAT "%13.10" NUMBER 50 /end CHARACTERISTIC
/begin CHARACTERISTIC DINH_Lim.DFC_MOXEMM_SMU_ALM11_1_CA "inhibit conditions / inhibit limit conditions for inhibit source DFC_MOXEMM_SMU_ALM11_1" VAL_BLK 0x80500C3C ValA_Wu8 17.0000000000 DINH_LimDFCVerb 0.00 17.0000000000 FORMAT "%13.10" NUMBER 50 /end CHARACTERISTIC
/begin CHARACTERISTIC DINH_Lim.DFC_MOXEMM_SMU_ALM11_2_CA "inhibit conditions / inhibit limit conditions for inhibit source DFC_MOXEMM_SMU_ALM11_2" VAL_BLK 0x80500C6E ValA_Wu8 17.0000000000 DINH_LimDFCVerb 0.00 17.0000000000 FORMAT "%13.10" NUMBER 50 /end CHARACTERISTIC
/begin CHARACTERISTIC DINH_Lim.DFC_MOXEMM_SMU_ALM11_3_CA "inhibit conditions / inhibit limit conditions for inhibit source DFC_MOXEMM_SMU_ALM11_3" VAL_BLK 0x80500CA0 ValA_Wu8 17.0000000000 DINH_LimDFCVerb 0.00 17.0000000000 FORMAT "%13.10" NUMBER 50 /end CHARACTERISTIC
/begin CHARACTERISTIC DINH_Lim.DFC_MOXEMM_SMU_ALM11_4_CA "inhibit conditions / inhibit limit conditions for inhibit source DFC_MOXEMM_SMU_ALM11_4" VAL_BLK 0x80500CD2 ValA_Wu8 17.0000000000 DINH_LimDFCVerb 0.00 17.0000000000 FORMAT "%13.10" NUMBER 50 /end CHARACTERISTIC
/begin CHARACTERISTIC DINH_Lim.DFC_MOXEMM_SMU_ALM11_5_CA "inhibit conditions / inhibit limit conditions for inhibit source DFC_MOXEMM_SMU_ALM11_5" VAL_BLK 0x80500D04 ValA_Wu8 17.0000000000 DINH_LimDFCVerb 0.00 17.0000000000 FORMAT "%13.10" NUMBER 50 /end CHARACTERISTIC
/begin CHARACTERISTIC DINH_Lim.DFC_MOXEMM_SMU_ALM11_8_CA "inhibit conditions / inhibit limit conditions for inhibit source DFC_MOXEMM_SMU_ALM11_8" VAL_BLK 0x80500D36 ValA_Wu8 17.0000000000 DINH_LimDFCVerb 0.00 17.0000000000 FORMAT "%13.10" NUMBER 50 /end CHARACTERISTIC
/begin CHARACTERISTIC DINH_Lim.DFC_MOXEMM_SMU_ALM11_9_CA "inhibit conditions / inhibit limit conditions for inhibit source DFC_MOXEMM_SMU_ALM11_9" VAL_BLK 0x80500D68 ValA_Wu8 17.0000000000 DINH_LimDFCVerb 0.00 17.0000000000 FORMAT "%13.10" NUMBER 50 /end CHARACTERISTIC
/begin CHARACTERISTIC DINH_Lim.DFC_MOXEMM_SMU_ALM1_0_CA "inhibit conditions / inhibit limit conditions for inhibit source DFC_MOXEMM_SMU_ALM1_0" VAL_BLK 0x80500D9A ValA_Wu8 17.0000000000 DINH_LimDFCVerb 0.00 17.0000000000 FORMAT "%13.10" NUMBER 50 /end CHARACTERISTIC
/begin CHARACTERISTIC DINH_Lim.DFC_MOXEMM_SMU_ALM1_1_CA "inhibit conditions / inhibit limit conditions for inhibit source DFC_MOXEMM_SMU_ALM1_1" VAL_BLK 0x80500DCC ValA_Wu8 17.0000000000 DINH_LimDFCVerb 0.00 17.0000000000 FORMAT "%13.10" NUMBER 50 /end CHARACTERISTIC
/begin CHARACTERISTIC DINH_Lim.DFC_MOXEMM_SMU_ALM1_10_CA "inhibit conditions / inhibit limit conditions for inhibit source DFC_MOXEMM_SMU_ALM1_10" VAL_BLK 0x80500DFE ValA_Wu8 17.0000000000 DINH_LimDFCVerb 0.00 17.0000000000 FORMAT "%13.10" NUMBER 50 /end CHARACTERISTIC
/begin CHARACTERISTIC DINH_Lim.DFC_MOXEMM_SMU_ALM1_11_CA "inhibit conditions / inhibit limit conditions for inhibit source DFC_MOXEMM_SMU_ALM1_11" VAL_BLK 0x80500E30 ValA_Wu8 17.0000000000 DINH_LimDFCVerb 0.00 17.0000000000 FORMAT "%13.10" NUMBER 50 /end CHARACTERISTIC
/begin CHARACTERISTIC DINH_Lim.DFC_MOXEMM_SMU_ALM1_13_CA "inhibit conditions / inhibit limit conditions for inhibit source DFC_MOXEMM_SMU_ALM1_13" VAL_BLK 0x80500E62 ValA_Wu8 17.0000000000 DINH_LimDFCVerb 0.00 17.0000000000 FORMAT "%13.10" NUMBER 50 /end CHARACTERISTIC
/begin CHARACTERISTIC DINH_Lim.DFC_MOXEMM_SMU_ALM1_14_CA "inhibit conditions / inhibit limit conditions for inhibit source DFC_MOXEMM_SMU_ALM1_14" VAL_BLK 0x80500E94 ValA_Wu8 17.0000000000 DINH_LimDFCVerb 0.00 17.0000000000 FORMAT "%13.10" NUMBER 50 /end CHARACTERISTIC
/begin CHARACTERISTIC DINH_Lim.DFC_MOXEMM_SMU_ALM1_2_CA "inhibit conditions / inhibit limit conditions for inhibit source DFC_MOXEMM_SMU_ALM1_2" VAL_BLK 0x80500EC6 ValA_Wu8 17.0000000000 DINH_LimDFCVerb 0.00 17.0000000000 FORMAT "%13.10" NUMBER 50 /end CHARACTERISTIC
/begin CHARACTERISTIC DINH_Lim.DFC_MOXEMM_SMU_ALM1_22_CA "inhibit conditions / inhibit limit conditions for inhibit source DFC_MOXEMM_SMU_ALM1_22" VAL_BLK 0x80500EF8 ValA_Wu8 17.0000000000 DINH_LimDFCVerb 0.00 17.0000000000 FORMAT "%13.10" NUMBER 50 /end CHARACTERISTIC
/begin CHARACTERISTIC DINH_Lim.DFC_MOXEMM_SMU_ALM1_23_CA "inhibit conditions / inhibit limit conditions for inhibit source DFC_MOXEMM_SMU_ALM1_23" VAL_BLK 0x80500F2A ValA_Wu8 17.0000000000 DINH_LimDFCVerb 0.00 17.0000000000 FORMAT "%13.10" NUMBER 50 /end CHARACTERISTIC
/begin CHARACTERISTIC DINH_Lim.DFC_MOXEMM_SMU_ALM1_4_CA "inhibit conditions / inhibit limit conditions for inhibit source DFC_MOXEMM_SMU_ALM1_4" VAL_BLK 0x80500F5C ValA_Wu8 17.0000000000 DINH_LimDFCVerb 0.00 17.0000000000 FORMAT "%13.10" NUMBER 50 /end CHARACTERISTIC
/begin CHARACTERISTIC DINH_Lim.DFC_MOXEMM_SMU_ALM1_5_CA "inhibit conditions / inhibit limit conditions for inhibit source DFC_MOXEMM_SMU_ALM1_5" VAL_BLK 0x80500F8E ValA_Wu8 17.0000000000 DINH_LimDFCVerb 0.00 17.0000000000 FORMAT "%13.10" NUMBER 50 /end CHARACTERISTIC
/begin CHARACTERISTIC DINH_Lim.DFC_MOXEMM_SMU_ALM1_7_CA "inhibit conditions / inhibit limit conditions for inhibit source DFC_MOXEMM_SMU_ALM1_7" VAL_BLK 0x80500FC0 ValA_Wu8 17.0000000000 DINH_LimDFCVerb 0.00 17.0000000000 FORMAT "%13.10" NUMBER 50 /end CHARACTERISTIC
/begin CHARACTERISTIC DINH_Lim.DFC_MOXEMM_SMU_ALM1_8_CA "inhibit conditions / inhibit limit conditions for inhibit source DFC_MOXEMM_SMU_ALM1_8" VAL_BLK 0x80500FF2 ValA_Wu8 17.0000000000 DINH_LimDFCVerb 0.00 17.0000000000 FORMAT "%13.10" NUMBER 50 /end CHARACTERISTIC
/begin CHARACTERISTIC DINH_Lim.DFC_MOXEMM_SMU_ALM21_0_CA "inhibit conditions / inhibit limit conditions for inhibit source DFC_MOXEMM_SMU_ALM21_0" VAL_BLK 0x80501024 ValA_Wu8 17.0000000000 DINH_LimDFCVerb 0.00 17.0000000000 FORMAT "%13.10" NUMBER 50 /end CHARACTERISTIC
/begin CHARACTERISTIC DINH_Lim.DFC_MOXEMM_SMU_ALM21_16_CA "inhibit conditions / inhibit limit conditions for inhibit source DFC_MOXEMM_SMU_ALM21_16" VAL_BLK 0x80501056 ValA_Wu8 17.0000000000 DINH_LimDFCVerb 0.00 17.0000000000 FORMAT "%13.10" NUMBER 50 /end CHARACTERISTIC
/begin CHARACTERISTIC DINH_Lim.DFC_MOXEMM_SMU_ALM21_3_CA "inhibit conditions / inhibit limit conditions for inhibit source DFC_MOXEMM_SMU_ALM21_3" VAL_BLK 0x80501088 ValA_Wu8 17.0000000000 DINH_LimDFCVerb 0.00 17.0000000000 FORMAT "%13.10" NUMBER 50 /end CHARACTERISTIC
/begin CHARACTERISTIC DINH_Lim.DFC_MOXEMM_SMU_ALM2_1_CA "inhibit conditions / inhibit limit conditions for inhibit source DFC_MOXEMM_SMU_ALM2_1" VAL_BLK 0x805010BA ValA_Wu8 17.0000000000 DINH_LimDFCVerb 0.00 17.0000000000 FORMAT "%13.10" NUMBER 50 /end CHARACTERISTIC
/begin CHARACTERISTIC DINH_Lim.DFC_MOXEMM_SMU_ALM2_10_CA "inhibit conditions / inhibit limit conditions for inhibit source DFC_MOXEMM_SMU_ALM2_10" VAL_BLK 0x805010EC ValA_Wu8 17.0000000000 DINH_LimDFCVerb 0.00 17.0000000000 FORMAT "%13.10" NUMBER 50 /end CHARACTERISTIC
/begin CHARACTERISTIC DINH_Lim.DFC_MOXEMM_SMU_ALM2_11_CA "inhibit conditions / inhibit limit conditions for inhibit source DFC_MOXEMM_SMU_ALM2_11" VAL_BLK 0x8050111E ValA_Wu8 17.0000000000 DINH_LimDFCVerb 0.00 17.0000000000 FORMAT "%13.10" NUMBER 50 /end CHARACTERISTIC
/begin CHARACTERISTIC DINH_Lim.DFC_MOXEMM_SMU_ALM2_13_CA "inhibit conditions / inhibit limit conditions for inhibit source DFC_MOXEMM_SMU_ALM2_13" VAL_BLK 0x80501150 ValA_Wu8 17.0000000000 DINH_LimDFCVerb 0.00 17.0000000000 FORMAT "%13.10" NUMBER 50 /end CHARACTERISTIC
/begin CHARACTERISTIC DINH_Lim.DFC_MOXEMM_SMU_ALM2_14_CA "inhibit conditions / inhibit limit conditions for inhibit source DFC_MOXEMM_SMU_ALM2_14" VAL_BLK 0x80501182 ValA_Wu8 17.0000000000 DINH_LimDFCVerb 0.00 17.0000000000 FORMAT "%13.10" NUMBER 50 /end CHARACTERISTIC
/begin CHARACTERISTIC DINH_Lim.DFC_MOXEMM_SMU_ALM2_22_CA "inhibit conditions / inhibit limit conditions for inhibit source DFC_MOXEMM_SMU_ALM2_22" VAL_BLK 0x805011B4 ValA_Wu8 17.0000000000 DINH_LimDFCVerb 0.00 17.0000000000 FORMAT "%13.10" NUMBER 50 /end CHARACTERISTIC
/begin CHARACTERISTIC DINH_Lim.DFC_MOXEMM_SMU_ALM2_23_CA "inhibit conditions / inhibit limit conditions for inhibit source DFC_MOXEMM_SMU_ALM2_23" VAL_BLK 0x805011E6 ValA_Wu8 17.0000000000 DINH_LimDFCVerb 0.00 17.0000000000 FORMAT "%13.10" NUMBER 50 /end CHARACTERISTIC
/begin CHARACTERISTIC DINH_Lim.DFC_MOXEMM_SMU_ALM2_4_CA "inhibit conditions / inhibit limit conditions for inhibit source DFC_MOXEMM_SMU_ALM2_4" VAL_BLK 0x80501218 ValA_Wu8 17.0000000000 DINH_LimDFCVerb 0.00 17.0000000000 FORMAT "%13.10" NUMBER 50 /end CHARACTERISTIC
/begin CHARACTERISTIC DINH_Lim.DFC_MOXEMM_SMU_ALM2_5_CA "inhibit conditions / inhibit limit conditions for inhibit source DFC_MOXEMM_SMU_ALM2_5" VAL_BLK 0x8050124A ValA_Wu8 17.0000000000 DINH_LimDFCVerb 0.00 17.0000000000 FORMAT "%13.10" NUMBER 50 /end CHARACTERISTIC
/begin CHARACTERISTIC DINH_Lim.DFC_MOXEMM_SMU_ALM2_7_CA "inhibit conditions / inhibit limit conditions for inhibit source DFC_MOXEMM_SMU_ALM2_7" VAL_BLK 0x8050127C ValA_Wu8 17.0000000000 DINH_LimDFCVerb 0.00 17.0000000000 FORMAT "%13.10" NUMBER 50 /end CHARACTERISTIC
/begin CHARACTERISTIC DINH_Lim.DFC_MOXEMM_SMU_ALM2_8_CA "inhibit conditions / inhibit limit conditions for inhibit source DFC_MOXEMM_SMU_ALM2_8" VAL_BLK 0x805012AE ValA_Wu8 17.0000000000 DINH_LimDFCVerb 0.00 17.0000000000 FORMAT "%13.10" NUMBER 50 /end CHARACTERISTIC
/begin CHARACTERISTIC DINH_Lim.DFC_MOXEMM_SMU_ALM6_0_CA "inhibit conditions / inhibit limit conditions for inhibit source DFC_MOXEMM_SMU_ALM6_0" VAL_BLK 0x805012E0 ValA_Wu8 17.0000000000 DINH_LimDFCVerb 0.00 17.0000000000 FORMAT "%13.10" NUMBER 50 /end CHARACTERISTIC
/begin CHARACTERISTIC DINH_Lim.DFC_MOXEMM_SMU_ALM6_11_CA "inhibit conditions / inhibit limit conditions for inhibit source DFC_MOXEMM_SMU_ALM6_11" VAL_BLK 0x80501312 ValA_Wu8 17.0000000000 DINH_LimDFCVerb 0.00 17.0000000000 FORMAT "%13.10" NUMBER 50 /end CHARACTERISTIC
/begin CHARACTERISTIC DINH_Lim.DFC_MOXEMM_SMU_ALM6_12_CA "inhibit conditions / inhibit limit conditions for inhibit source DFC_MOXEMM_SMU_ALM6_12" VAL_BLK 0x80501344 ValA_Wu8 17.0000000000 DINH_LimDFCVerb 0.00 17.0000000000 FORMAT "%13.10" NUMBER 50 /end CHARACTERISTIC
/begin CHARACTERISTIC DINH_Lim.DFC_MOXEMM_SMU_ALM6_14_CA "inhibit conditions / inhibit limit conditions for inhibit source DFC_MOXEMM_SMU_ALM6_14" VAL_BLK 0x80501376 ValA_Wu8 17.0000000000 DINH_LimDFCVerb 0.00 17.0000000000 FORMAT "%13.10" NUMBER 50 /end CHARACTERISTIC
/begin CHARACTERISTIC DINH_Lim.DFC_MOXEMM_SMU_ALM6_15_CA "inhibit conditions / inhibit limit conditions for inhibit source DFC_MOXEMM_SMU_ALM6_15" VAL_BLK 0x805013A8 ValA_Wu8 17.0000000000 DINH_LimDFCVerb 0.00 17.0000000000 FORMAT "%13.10" NUMBER 50 /end CHARACTERISTIC
/begin CHARACTERISTIC DINH_Lim.DFC_MOXEMM_SMU_ALM6_17_CA "inhibit conditions / inhibit limit conditions for inhibit source DFC_MOXEMM_SMU_ALM6_17" VAL_BLK 0x805013DA ValA_Wu8 17.0000000000 DINH_LimDFCVerb 0.00 17.0000000000 FORMAT "%13.10" NUMBER 50 /end CHARACTERISTIC
/begin CHARACTERISTIC DINH_Lim.DFC_MOXEMM_SMU_ALM6_18_CA "inhibit conditions / inhibit limit conditions for inhibit source DFC_MOXEMM_SMU_ALM6_18" VAL_BLK 0x8050140C ValA_Wu8 17.0000000000 DINH_LimDFCVerb 0.00 17.0000000000 FORMAT "%13.10" NUMBER 50 /end CHARACTERISTIC
/begin CHARACTERISTIC DINH_Lim.DFC_MOXEMM_SMU_ALM6_20_CA "inhibit conditions / inhibit limit conditions for inhibit source DFC_MOXEMM_SMU_ALM6_20" VAL_BLK 0x8050143E ValA_Wu8 17.0000000000 DINH_LimDFCVerb 0.00 17.0000000000 FORMAT "%13.10" NUMBER 50 /end CHARACTERISTIC
/begin CHARACTERISTIC DINH_Lim.DFC_MOXEMM_SMU_ALM6_21_CA "inhibit conditions / inhibit limit conditions for inhibit source DFC_MOXEMM_SMU_ALM6_21" VAL_BLK 0x80501470 ValA_Wu8 17.0000000000 DINH_LimDFCVerb 0.00 17.0000000000 FORMAT "%13.10" NUMBER 50 /end CHARACTERISTIC
/begin CHARACTERISTIC DINH_Lim.DFC_MOXEMM_SMU_ALM6_25_CA "inhibit conditions / inhibit limit conditions for inhibit source DFC_MOXEMM_SMU_ALM6_25" VAL_BLK 0x805014A2 ValA_Wu8 17.0000000000 DINH_LimDFCVerb 0.00 17.0000000000 FORMAT "%13.10" NUMBER 50 /end CHARACTERISTIC
/begin CHARACTERISTIC DINH_Lim.DFC_MOXEMM_SMU_ALM6_4_CA "inhibit conditions / inhibit limit conditions for inhibit source DFC_MOXEMM_SMU_ALM6_4" VAL_BLK 0x805014D4 ValA_Wu8 17.0000000000 DINH_LimDFCVerb 0.00 17.0000000000 FORMAT "%13.10" NUMBER 50 /end CHARACTERISTIC
/begin CHARACTERISTIC DINH_Lim.DFC_MOXEMM_SMU_ALM6_5_CA "inhibit conditions / inhibit limit conditions for inhibit source DFC_MOXEMM_SMU_ALM6_5" VAL_BLK 0x80501506 ValA_Wu8 17.0000000000 DINH_LimDFCVerb 0.00 17.0000000000 FORMAT "%13.10" NUMBER 50 /end CHARACTERISTIC
/begin CHARACTERISTIC DINH_Lim.DFC_MOXEMM_SMU_ALM6_7_CA "inhibit conditions / inhibit limit conditions for inhibit source DFC_MOXEMM_SMU_ALM6_7" VAL_BLK 0x80501538 ValA_Wu8 17.0000000000 DINH_LimDFCVerb 0.00 17.0000000000 FORMAT "%13.10" NUMBER 50 /end CHARACTERISTIC
/begin CHARACTERISTIC DINH_Lim.DFC_MOXEMM_SMU_ALM6_8_CA "inhibit conditions / inhibit limit conditions for inhibit source DFC_MOXEMM_SMU_ALM6_8" VAL_BLK 0x8050156A ValA_Wu8 17.0000000000 DINH_LimDFCVerb 0.00 17.0000000000 FORMAT "%13.10" NUMBER 50 /end CHARACTERISTIC
/begin CHARACTERISTIC DINH_Lim.DFC_MOXEMM_SMU_ALM7_1_CA "inhibit conditions / inhibit limit conditions for inhibit source DFC_MOXEMM_SMU_ALM7_1" VAL_BLK 0x8050159C ValA_Wu8 17.0000000000 DINH_LimDFCVerb 0.00 17.0000000000 FORMAT "%13.10" NUMBER 50 /end CHARACTERISTIC
/begin CHARACTERISTIC DINH_Lim.DFC_MOXEMM_SMU_ALM7_12_CA "inhibit conditions / inhibit limit conditions for inhibit source DFC_MOXEMM_SMU_ALM7_12" VAL_BLK 0x805015CE ValA_Wu8 17.0000000000 DINH_LimDFCVerb 0.00 17.0000000000 FORMAT "%13.10" NUMBER 50 /end CHARACTERISTIC
/begin CHARACTERISTIC DINH_Lim.DFC_MOXEMM_SMU_ALM7_13_CA "inhibit conditions / inhibit limit conditions for inhibit source DFC_MOXEMM_SMU_ALM7_13" VAL_BLK 0x80501600 ValA_Wu8 17.0000000000 DINH_LimDFCVerb 0.00 17.0000000000 FORMAT "%13.10" NUMBER 50 /end CHARACTERISTIC
/begin CHARACTERISTIC DINH_Lim.DFC_MOXEMM_SMU_ALM7_14_CA "inhibit conditions / inhibit limit conditions for inhibit source DFC_MOXEMM_SMU_ALM7_14" VAL_BLK 0x80501632 ValA_Wu8 17.0000000000 DINH_LimDFCVerb 0.00 17.0000000000 FORMAT "%13.10" NUMBER 50 /end CHARACTERISTIC
/begin CHARACTERISTIC DINH_Lim.DFC_MOXEMM_SMU_ALM7_15_CA "inhibit conditions / inhibit limit conditions for inhibit source DFC_MOXEMM_SMU_ALM7_15" VAL_BLK 0x80501664 ValA_Wu8 17.0000000000 DINH_LimDFCVerb 0.00 17.0000000000 FORMAT "%13.10" NUMBER 50 /end CHARACTERISTIC
/begin CHARACTERISTIC DINH_Lim.DFC_MOXEMM_SMU_ALM7_16_CA "inhibit conditions / inhibit limit conditions for inhibit source DFC_MOXEMM_SMU_ALM7_16" VAL_BLK 0x80501696 ValA_Wu8 17.0000000000 DINH_LimDFCVerb 0.00 17.0000000000 FORMAT "%13.10" NUMBER 50 /end CHARACTERISTIC
/begin CHARACTERISTIC DINH_Lim.DFC_MOXEMM_SMU_ALM7_17_CA "inhibit conditions / inhibit limit conditions for inhibit source DFC_MOXEMM_SMU_ALM7_17" VAL_BLK 0x805016C8 ValA_Wu8 17.0000000000 DINH_LimDFCVerb 0.00 17.0000000000 FORMAT "%13.10" NUMBER 50 /end CHARACTERISTIC
/begin CHARACTERISTIC DINH_Lim.DFC_MOXEMM_SMU_ALM7_2_CA "inhibit conditions / inhibit limit conditions for inhibit source DFC_MOXEMM_SMU_ALM7_2" VAL_BLK 0x805016FA ValA_Wu8 17.0000000000 DINH_LimDFCVerb 0.00 17.0000000000 FORMAT "%13.10" NUMBER 50 /end CHARACTERISTIC
/begin CHARACTERISTIC DINH_Lim.DFC_MOXEMM_SMU_ALM7_20_CA "inhibit conditions / inhibit limit conditions for inhibit source DFC_MOXEMM_SMU_ALM7_20" VAL_BLK 0x8050172C ValA_Wu8 17.0000000000 DINH_LimDFCVerb 0.00 17.0000000000 FORMAT "%13.10" NUMBER 50 /end CHARACTERISTIC
/begin CHARACTERISTIC DINH_Lim.DFC_MOXEMM_SMU_ALM7_25_CA "inhibit conditions / inhibit limit conditions for inhibit source DFC_MOXEMM_SMU_ALM7_25" VAL_BLK 0x8050175E ValA_Wu8 17.0000000000 DINH_LimDFCVerb 0.00 17.0000000000 FORMAT "%13.10" NUMBER 50 /end CHARACTERISTIC
/begin CHARACTERISTIC DINH_Lim.DFC_MOXEMM_SMU_ALM7_26_CA "inhibit conditions / inhibit limit conditions for inhibit source DFC_MOXEMM_SMU_ALM7_26" VAL_BLK 0x80501790 ValA_Wu8 17.0000000000 DINH_LimDFCVerb 0.00 17.0000000000 FORMAT "%13.10" NUMBER 50 /end CHARACTERISTIC
/begin CHARACTERISTIC DINH_Lim.DFC_MOXEMM_SMU_ALM7_28_CA "inhibit conditions / inhibit limit conditions for inhibit source DFC_MOXEMM_SMU_ALM7_28" VAL_BLK 0x805017C2 ValA_Wu8 17.0000000000 DINH_LimDFCVerb 0.00 17.0000000000 FORMAT "%13.10" NUMBER 50 /end CHARACTERISTIC
/begin CHARACTERISTIC DINH_Lim.DFC_MOXEMM_SMU_ALM7_29_CA "inhibit conditions / inhibit limit conditions for inhibit source DFC_MOXEMM_SMU_ALM7_29" VAL_BLK 0x805017F4 ValA_Wu8 17.0000000000 DINH_LimDFCVerb 0.00 17.0000000000 FORMAT "%13.10" NUMBER 50 /end CHARACTERISTIC
/begin CHARACTERISTIC DINH_Lim.DFC_MOXEMM_SMU_ALM7_30_CA "inhibit conditions / inhibit limit conditions for inhibit source DFC_MOXEMM_SMU_ALM7_30" VAL_BLK 0x80501826 ValA_Wu8 17.0000000000 DINH_LimDFCVerb 0.00 17.0000000000 FORMAT "%13.10" NUMBER 50 /end CHARACTERISTIC
/begin CHARACTERISTIC DINH_Lim.DFC_MOXEMM_SMU_ALM7_31_CA "inhibit conditions / inhibit limit conditions for inhibit source DFC_MOXEMM_SMU_ALM7_31" VAL_BLK 0x80501858 ValA_Wu8 17.0000000000 DINH_LimDFCVerb 0.00 17.0000000000 FORMAT "%13.10" NUMBER 50 /end CHARACTERISTIC
/begin CHARACTERISTIC DINH_Lim.DFC_MOXEMM_SMU_ALM8_0_CA "inhibit conditions / inhibit limit conditions for inhibit source DFC_MOXEMM_SMU_ALM8_0" VAL_BLK 0x8050188A ValA_Wu8 17.0000000000 DINH_LimDFCVerb 0.00 17.0000000000 FORMAT "%13.10" NUMBER 50 /end CHARACTERISTIC
/begin CHARACTERISTIC DINH_Lim.DFC_MOXEMM_SMU_ALM8_1_CA "inhibit conditions / inhibit limit conditions for inhibit source DFC_MOXEMM_SMU_ALM8_1" VAL_BLK 0x805018BC ValA_Wu8 17.0000000000 DINH_LimDFCVerb 0.00 17.0000000000 FORMAT "%13.10" NUMBER 50 /end CHARACTERISTIC
/begin CHARACTERISTIC DINH_Lim.DFC_MOXEMM_SMU_ALM8_10_CA "inhibit conditions / inhibit limit conditions for inhibit source DFC_MOXEMM_SMU_ALM8_10" VAL_BLK 0x805018EE ValA_Wu8 17.0000000000 DINH_LimDFCVerb 0.00 17.0000000000 FORMAT "%13.10" NUMBER 50 /end CHARACTERISTIC
/begin CHARACTERISTIC DINH_Lim.DFC_MOXEMM_SMU_ALM8_11_CA "inhibit conditions / inhibit limit conditions for inhibit source DFC_MOXEMM_SMU_ALM8_11" VAL_BLK 0x80501920 ValA_Wu8 17.0000000000 DINH_LimDFCVerb 0.00 17.0000000000 FORMAT "%13.10" NUMBER 50 /end CHARACTERISTIC
/begin CHARACTERISTIC DINH_Lim.DFC_MOXEMM_SMU_ALM8_12_CA "inhibit conditions / inhibit limit conditions for inhibit source DFC_MOXEMM_SMU_ALM8_12" VAL_BLK 0x80501952 ValA_Wu8 17.0000000000 DINH_LimDFCVerb 0.00 17.0000000000 FORMAT "%13.10" NUMBER 50 /end CHARACTERISTIC
/begin CHARACTERISTIC DINH_Lim.DFC_MOXEMM_SMU_ALM8_16_CA "inhibit conditions / inhibit limit conditions for inhibit source DFC_MOXEMM_SMU_ALM8_16" VAL_BLK 0x80501984 ValA_Wu8 17.0000000000 DINH_LimDFCVerb 0.00 17.0000000000 FORMAT "%13.10" NUMBER 50 /end CHARACTERISTIC
/begin CHARACTERISTIC DINH_Lim.DFC_MOXEMM_SMU_ALM8_18_CA "inhibit conditions / inhibit limit conditions for inhibit source DFC_MOXEMM_SMU_ALM8_18" VAL_BLK 0x805019B6 ValA_Wu8 17.0000000000 DINH_LimDFCVerb 0.00 17.0000000000 FORMAT "%13.10" NUMBER 50 /end CHARACTERISTIC
/begin CHARACTERISTIC DINH_Lim.DFC_MOXEMM_SMU_ALM8_2_CA "inhibit conditions / inhibit limit conditions for inhibit source DFC_MOXEMM_SMU_ALM8_2" VAL_BLK 0x805019E8 ValA_Wu8 17.0000000000 DINH_LimDFCVerb 0.00 17.0000000000 FORMAT "%13.10" NUMBER 50 /end CHARACTERISTIC
/begin CHARACTERISTIC DINH_Lim.DFC_MOXEMM_SMU_ALM8_3_CA "inhibit conditions / inhibit limit conditions for inhibit source DFC_MOXEMM_SMU_ALM8_3" VAL_BLK 0x80501A1A ValA_Wu8 17.0000000000 DINH_LimDFCVerb 0.00 17.0000000000 FORMAT "%13.10" NUMBER 50 /end CHARACTERISTIC
/begin CHARACTERISTIC DINH_Lim.DFC_MOXEMM_SMU_ALM8_31_CA "inhibit conditions / inhibit limit conditions for inhibit source DFC_MOXEMM_SMU_ALM8_31" VAL_BLK 0x80501A4C ValA_Wu8 17.0000000000 DINH_LimDFCVerb 0.00 17.0000000000 FORMAT "%13.10" NUMBER 50 /end CHARACTERISTIC
/begin CHARACTERISTIC DINH_Lim.DFC_MOXEMM_SMU_ALM8_4_CA "inhibit conditions / inhibit limit conditions for inhibit source DFC_MOXEMM_SMU_ALM8_4" VAL_BLK 0x80501A7E ValA_Wu8 17.0000000000 DINH_LimDFCVerb 0.00 17.0000000000 FORMAT "%13.10" NUMBER 50 /end CHARACTERISTIC
/begin CHARACTERISTIC DINH_Lim.DFC_MOXEMM_SMU_ALM9_0_CA "inhibit conditions / inhibit limit conditions for inhibit source DFC_MOXEMM_SMU_ALM9_0" VAL_BLK 0x80501AB0 ValA_Wu8 17.0000000000 DINH_LimDFCVerb 0.00 17.0000000000 FORMAT "%13.10" NUMBER 50 /end CHARACTERISTIC
/begin CHARACTERISTIC DINH_Lim.DFC_MOXEMM_SMU_ALM9_15_CA "inhibit conditions / inhibit limit conditions for inhibit source DFC_MOXEMM_SMU_ALM9_15" VAL_BLK 0x80501AE2 ValA_Wu8 17.0000000000 DINH_LimDFCVerb 0.00 17.0000000000 FORMAT "%13.10" NUMBER 50 /end CHARACTERISTIC
/begin CHARACTERISTIC DINH_Lim.DFC_MOXEMM_SMU_ALM9_3_CA "inhibit conditions / inhibit limit conditions for inhibit source DFC_MOXEMM_SMU_ALM9_3" VAL_BLK 0x80501B14 ValA_Wu8 17.0000000000 DINH_LimDFCVerb 0.00 17.0000000000 FORMAT "%13.10" NUMBER 50 /end CHARACTERISTIC
/begin CHARACTERISTIC DINH_Lim.DFC_MoCADCNTP_CA "inhibit conditions / inhibit limit conditions for inhibit source DFC_MoCADCNTP" VAL_BLK 0x80501B46 ValA_Wu8 17.0000000000 DINH_LimDFCVerb 0.00 17.0000000000 FORMAT "%13.10" NUMBER 66 /end CHARACTERISTIC
/begin CHARACTERISTIC DINH_Lim.DFC_MoCADCTst_CA "inhibit conditions / inhibit limit conditions for inhibit source DFC_MoCADCTst" VAL_BLK 0x80501B88 ValA_Wu8 17.0000000000 DINH_LimDFCVerb 0.00 17.0000000000 FORMAT "%13.10" NUMBER 66 /end CHARACTERISTIC
/begin CHARACTERISTIC DINH_Lim.DFC_MoCSOPICO_CA "inhibit conditions / inhibit limit conditions for inhibit source DFC_MoCSOPICO" VAL_BLK 0x80501BCA ValA_Wu8 17.0000000000 DINH_LimDFCVerb 0.00 17.0000000000 FORMAT "%13.10" NUMBER 51 /end CHARACTERISTIC
/begin CHARACTERISTIC DINH_Lim.DFC_MoFAPP_CA "inhibit conditions / inhibit limit conditions for inhibit source DFC_MoFAPP" VAL_BLK 0x80501BFD ValA_Wu8 17.0000000000 DINH_LimDFCVerb 0.00 17.0000000000 FORMAT "%13.10" NUMBER 66 /end CHARACTERISTIC
/begin CHARACTERISTIC DINH_Lim.DFC_MoFAirFilgPrdc_CA "inhibit conditions / inhibit limit conditions for inhibit source DFC_MoFAirFilgPrdc" VAL_BLK 0x80501C3F ValA_Wu8 17.0000000000 DINH_LimDFCVerb 0.00 17.0000000000 FORMAT "%13.10" NUMBER 65 /end CHARACTERISTIC
/begin CHARACTERISTIC DINH_Lim.DFC_MoFAirFlCtOffGdi_CA "inhibit conditions / inhibit limit conditions for inhibit source DFC_MoFAirFlCtOffGdi" VAL_BLK 0x80501C80 ValA_Wu8 17.0000000000 DINH_LimDFCVerb 0.00 17.0000000000 FORMAT "%13.10" NUMBER 51 /end CHARACTERISTIC
/begin CHARACTERISTIC DINH_Lim.DFC_MoFAirFlCylGdi_CA "inhibit conditions / inhibit limit conditions for inhibit source DFC_MoFAirFlCylGdi" VAL_BLK 0x80501CB3 ValA_Wu8 17.0000000000 DINH_LimDFCVerb 0.00 17.0000000000 FORMAT "%13.10" NUMBER 51 /end CHARACTERISTIC
/begin CHARACTERISTIC DINH_Lim.DFC_MoFAirFlFF_CA "inhibit conditions / inhibit limit conditions for inhibit source DFC_MoFAirFlFF" VAL_BLK 0x80501CE6 ValA_Wu8 17.0000000000 DINH_LimDFCVerb 0.00 17.0000000000 FORMAT "%13.10" NUMBER 51 /end CHARACTERISTIC
/begin CHARACTERISTIC DINH_Lim.DFC_MoFAirFlIn_CA "inhibit conditions / inhibit limit conditions for inhibit source DFC_MoFAirFlIn" VAL_BLK 0x80501D19 ValA_Wu8 17.0000000000 DINH_LimDFCVerb 0.00 17.0000000000 FORMAT "%13.10" NUMBER 51 /end CHARACTERISTIC
/begin CHARACTERISTIC DINH_Lim.DFC_MoFAirFlMixCtlGdiChkAirFl_CA "inhibit conditions / inhibit limit conditions for inhibit source DFC_MoFAirFlMixCtlGdiChkAirFl" VAL_BLK 0x80501D4C ValA_Wu8 17.0000000000 DINH_LimDFCVerb 0.00 17.0000000000 FORMAT "%13.10" NUMBER 51 /end CHARACTERISTIC
/begin CHARACTERISTIC DINH_Lim.DFC_MoFAirFlMixCtlGdiChkCtrl_CA "inhibit conditions / inhibit limit conditions for inhibit source DFC_MoFAirFlMixCtlGdiChkCtrl" VAL_BLK 0x80501D7F ValA_Wu8 17.0000000000 DINH_LimDFCVerb 0.00 17.0000000000 FORMAT "%13.10" NUMBER 51 /end CHARACTERISTIC
/begin CHARACTERISTIC DINH_Lim.DFC_MoFAirFlMode_CA "inhibit conditions / inhibit limit conditions for inhibit source DFC_MoFAirFlMode" VAL_BLK 0x80501DB2 ValA_Wu8 17.0000000000 DINH_LimDFCVerb 0.00 17.0000000000 FORMAT "%13.10" NUMBER 52 /end CHARACTERISTIC
/begin CHARACTERISTIC DINH_Lim.DFC_MoFESpd_CA "inhibit conditions / inhibit limit conditions for inhibit source DFC_MoFESpd" VAL_BLK 0x80501DE6 ValA_Wu8 17.0000000000 DINH_LimDFCVerb 0.00 17.0000000000 FORMAT "%13.10" NUMBER 66 /end CHARACTERISTIC
/begin CHARACTERISTIC DINH_Lim.DFC_MoFIACo_CA "inhibit conditions / inhibit limit conditions for inhibit source DFC_MoFIACo" VAL_BLK 0x80501E28 ValA_Wu8 17.0000000000 DINH_LimDFCVerb 0.00 17.0000000000 FORMAT "%13.10" NUMBER 52 /end CHARACTERISTIC
/begin CHARACTERISTIC DINH_Lim.DFC_MoFICOL1_CA "inhibit conditions / inhibit limit conditions for inhibit source DFC_MoFICOL1" VAL_BLK 0x80501E5C ValA_Wu8 17.0000000000 DINH_LimDFCVerb 0.00 17.0000000000 FORMAT "%13.10" NUMBER 64 /end CHARACTERISTIC
/begin CHARACTERISTIC DINH_Lim.DFC_MoFICOL2_CA "inhibit conditions / inhibit limit conditions for inhibit source DFC_MoFICOL2" VAL_BLK 0x80501E9C ValA_Wu8 17.0000000000 DINH_LimDFCVerb 0.00 17.0000000000 FORMAT "%13.10" NUMBER 60 /end CHARACTERISTIC
/begin CHARACTERISTIC DINH_Lim.DFC_MoFStrt_CA "inhibit conditions / inhibit limit conditions for inhibit source DFC_MoFStrt" VAL_BLK 0x80501ED8 ValA_Wu8 17.0000000000 DINH_LimDFCVerb 0.00 17.0000000000 FORMAT "%13.10" NUMBER 61 /end CHARACTERISTIC
/begin CHARACTERISTIC DINH_Lim.DFC_MoFTrqCmp_CA "inhibit conditions / inhibit limit conditions for inhibit source DFC_MoFTrqCmp" VAL_BLK 0x80501F15 ValA_Wu8 17.0000000000 DINH_LimDFCVerb 0.00 17.0000000000 FORMAT "%13.10" NUMBER 65 /end CHARACTERISTIC
/begin CHARACTERISTIC DINH_Lim.DFC_MoFTrqCmpMax_CA "inhibit conditions / inhibit limit conditions for inhibit source DFC_MoFTrqCmpMax" VAL_BLK 0x80501F56 ValA_Wu8 17.0000000000 DINH_LimDFCVerb 0.00 17.0000000000 FORMAT "%13.10" NUMBER 50 /end CHARACTERISTIC
/begin CHARACTERISTIC DINH_Lim.DFC_MoFTrqCmpMin_CA "inhibit conditions / inhibit limit conditions for inhibit source DFC_MoFTrqCmpMin" VAL_BLK 0x80501F88 ValA_Wu8 17.0000000000 DINH_LimDFCVerb 0.00 17.0000000000 FORMAT "%13.10" NUMBER 50 /end CHARACTERISTIC
/begin CHARACTERISTIC DINH_Lim.DFC_MoFVarPostBldSel_CA "inhibit conditions / inhibit limit conditions for inhibit source DFC_MoFVarPostBldSel" VAL_BLK 0x80501FBA ValA_Wu8 17.0000000000 DINH_LimDFCVerb 0.00 17.0000000000 FORMAT "%13.10" NUMBER 50 /end CHARACTERISTIC
/begin CHARACTERISTIC DINH_Lim.DFC_MoXEMMHwLTMCUFW_CA "inhibit conditions / inhibit limit conditions for inhibit source DFC_MoXEMMHwLTMCUFW" VAL_BLK 0x80501FEC ValA_Wu8 17.0000000000 DINH_LimDFCVerb 0.00 17.0000000000 FORMAT "%13.10" NUMBER 50 /end CHARACTERISTIC
/begin CHARACTERISTIC DINH_Lim.DFC_MoXEMMHwLTMonBIST_CA "inhibit conditions / inhibit limit conditions for inhibit source DFC_MoXEMMHwLTMonBIST" VAL_BLK 0x8050201E ValA_Wu8 17.0000000000 DINH_LimDFCVerb 0.00 17.0000000000 FORMAT "%13.10" NUMBER 50 /end CHARACTERISTIC
/begin CHARACTERISTIC DINH_Lim.DFC_MoXEMMHwLTRegMonTest_CA "inhibit conditions / inhibit limit conditions for inhibit source DFC_MoXEMMHwLTRegMonTest" VAL_BLK 0x80502050 ValA_Wu8 17.0000000000 DINH_LimDFCVerb 0.00 17.0000000000 FORMAT "%13.10" NUMBER 50 /end CHARACTERISTIC
/begin CHARACTERISTIC DINH_Lim.DFC_MoXEMMHwLTStbySMUAlvTest_CA "inhibit conditions / inhibit limit conditions for inhibit source DFC_MoXEMMHwLTStbySMUAlvTest" VAL_BLK 0x80502082 ValA_Wu8 17.0000000000 DINH_LimDFCVerb 0.00 17.0000000000 FORMAT "%13.10" NUMBER 50 /end CHARACTERISTIC
/begin CHARACTERISTIC DINH_Lim.DFC_MoXEMMHwLTTempSens_CA "inhibit conditions / inhibit limit conditions for inhibit source DFC_MoXEMMHwLTTempSens" VAL_BLK 0x805020B4 ValA_Wu8 17.0000000000 DINH_LimDFCVerb 0.00 17.0000000000 FORMAT "%13.10" NUMBER 50 /end CHARACTERISTIC
/begin CHARACTERISTIC DINH_Lim.DFC_MoXEMMHwLTUCBCfg_CA "inhibit conditions / inhibit limit conditions for inhibit source DFC_MoXEMMHwLTUCBCfg" VAL_BLK 0x805020E6 ValA_Wu8 17.0000000000 DINH_LimDFCVerb 0.00 17.0000000000 FORMAT "%13.10" NUMBER 50 /end CHARACTERISTIC
/begin CHARACTERISTIC DINH_Lim.DFC_NWSEmax_CA "inhibit conditions / inhibit limit conditions for inhibit source DFC_NWSEmax" VAL_BLK 0x80502118 ValA_Wu8 17.0000000000 DINH_LimDFCVerb 0.00 17.0000000000 FORMAT "%13.10" NUMBER 50 /end CHARACTERISTIC
/begin CHARACTERISTIC DINH_Lim.DFC_NWSmax_CA "inhibit conditions / inhibit limit conditions for inhibit source DFC_NWSmax" VAL_BLK 0x8050214A ValA_Wu8 17.0000000000 DINH_LimDFCVerb 0.00 17.0000000000 FORMAT "%13.10" NUMBER 50 /end CHARACTERISTIC
/begin CHARACTERISTIC DINH_Lim.DFC_OCWDAABEActv_CA "inhibit conditions / inhibit limit conditions for inhibit source DFC_OCWDAABEActv" VAL_BLK 0x8050217C ValA_Wu8 17.0000000000 DINH_LimDFCVerb 0.00 17.0000000000 FORMAT "%13.10" NUMBER 51 /end CHARACTERISTIC
/begin CHARACTERISTIC DINH_Lim.DFC_OCWDACom_CA "inhibit conditions / inhibit limit conditions for inhibit source DFC_OCWDACom" VAL_BLK 0x805021AF ValA_Wu8 17.0000000000 DINH_LimDFCVerb 0.00 17.0000000000 FORMAT "%13.10" NUMBER 53 /end CHARACTERISTIC
/begin CHARACTERISTIC DINH_Lim.DFC_OCWDAErrPin_CA "inhibit conditions / inhibit limit conditions for inhibit source DFC_OCWDAErrPin" VAL_BLK 0x805021E4 ValA_Wu8 17.0000000000 DINH_LimDFCVerb 0.00 17.0000000000 FORMAT "%13.10" NUMBER 51 /end CHARACTERISTIC
/begin CHARACTERISTIC DINH_Lim.DFC_OCWDAOvrVltg_CA "inhibit conditions / inhibit limit conditions for inhibit source DFC_OCWDAOvrVltg" VAL_BLK 0x80502217 ValA_Wu8 17.0000000000 DINH_LimDFCVerb 0.00 17.0000000000 FORMAT "%13.10" NUMBER 51 /end CHARACTERISTIC
/begin CHARACTERISTIC DINH_Lim.DFC_ORAmax_CA "inhibit conditions / inhibit limit conditions for inhibit source DFC_ORAmax" VAL_BLK 0x8050224A ValA_Wu8 17.0000000000 DINH_LimDFCVerb 0.00 17.0000000000 FORMAT "%13.10" NUMBER 73 /end CHARACTERISTIC
/begin CHARACTERISTIC DINH_Lim.DFC_ORAmin_CA "inhibit conditions / inhibit limit conditions for inhibit source DFC_ORAmin" VAL_BLK 0x80502293 ValA_Wu8 17.0000000000 DINH_LimDFCVerb 0.00 17.0000000000 FORMAT "%13.10" NUMBER 73 /end CHARACTERISTIC
/begin CHARACTERISTIC DINH_Lim.DFC_OilPPlaus_CA "inhibit conditions / inhibit limit conditions for inhibit source DFC_OilPPlaus" VAL_BLK 0x805022DC ValA_Wu8 17.0000000000 DINH_LimDFCVerb 0.00 17.0000000000 FORMAT "%13.10" NUMBER 52 /end CHARACTERISTIC
/begin CHARACTERISTIC DINH_Lim.DFC_PLLSUmax_CA "inhibit conditions / inhibit limit conditions for inhibit source DFC_PLLSUmax" VAL_BLK 0x80502310 ValA_Wu8 17.0000000000 DINH_LimDFCVerb 0.00 17.0000000000 FORMAT "%13.10" NUMBER 76 /end CHARACTERISTIC
/begin CHARACTERISTIC DINH_Lim.DFC_PLLSUmin_CA "inhibit conditions / inhibit limit conditions for inhibit source DFC_PLLSUmin" VAL_BLK 0x8050235C ValA_Wu8 17.0000000000 DINH_LimDFCVerb 0.00 17.0000000000 FORMAT "%13.10" NUMBER 76 /end CHARACTERISTIC
/begin CHARACTERISTIC DINH_Lim.DFC_PSR1max_CA "inhibit conditions / inhibit limit conditions for inhibit source DFC_PSR1max" VAL_BLK 0x805023A8 ValA_Wu8 17.0000000000 DINH_LimDFCVerb 0.00 17.0000000000 FORMAT "%13.10" NUMBER 50 /end CHARACTERISTIC
/begin CHARACTERISTIC DINH_Lim.DFC_PSRBmax_CA "inhibit conditions / inhibit limit conditions for inhibit source DFC_PSRBmax" VAL_BLK 0x805023DA ValA_Wu8 17.0000000000 DINH_LimDFCVerb 0.00 17.0000000000 FORMAT "%13.10" NUMBER 96 /end CHARACTERISTIC
/begin CHARACTERISTIC DINH_Lim.DFC_PSRBmin_CA "inhibit conditions / inhibit limit conditions for inhibit source DFC_PSRBmin" VAL_BLK 0x8050243A ValA_Wu8 17.0000000000 DINH_LimDFCVerb 0.00 17.0000000000 FORMAT "%13.10" NUMBER 96 /end CHARACTERISTIC
/begin CHARACTERISTIC DINH_Lim.DFC_PSRPmax_CA "inhibit conditions / inhibit limit conditions for inhibit source DFC_PSRPmax" VAL_BLK 0x8050249A ValA_Wu8 17.0000000000 DINH_LimDFCVerb 0.00 17.0000000000 FORMAT "%13.10" NUMBER 95 /end CHARACTERISTIC
/begin CHARACTERISTIC DINH_Lim.DFC_PSRPmin_CA "inhibit conditions / inhibit limit conditions for inhibit source DFC_PSRPmin" VAL_BLK 0x805024F9 ValA_Wu8 17.0000000000 DINH_LimDFCVerb 0.00 17.0000000000 FORMAT "%13.10" NUMBER 95 /end CHARACTERISTIC
/begin CHARACTERISTIC DINH_Lim.DFC_PSRPsig_CA "inhibit conditions / inhibit limit conditions for inhibit source DFC_PSRPsig" VAL_BLK 0x80502558 ValA_Wu8 17.0000000000 DINH_LimDFCVerb 0.00 17.0000000000 FORMAT "%13.10" NUMBER 89 /end CHARACTERISTIC
/begin CHARACTERISTIC DINH_Lim.DFC_PSRmax_CA "inhibit conditions / inhibit limit conditions for inhibit source DFC_PSRmax" VAL_BLK 0x805025B1 ValA_Wu8 17.0000000000 DINH_LimDFCVerb 0.00 17.0000000000 FORMAT "%13.10" NUMBER 50 /end CHARACTERISTIC
/begin CHARACTERISTIC DINH_Lim.DFC_PUmax_CA "inhibit conditions / inhibit limit conditions for inhibit source DFC_PUmax" VAL_BLK 0x805025E3 ValA_Wu8 17.0000000000 DINH_LimDFCVerb 0.00 17.0000000000 FORMAT "%13.10" NUMBER 50 /end CHARACTERISTIC
/begin CHARACTERISTIC DINH_Lim.DFC_P_VSE11_OL_CA "inhibit conditions / inhibit limit conditions for inhibit source DFC_P_VSE11_OL" VAL_BLK 0x80502615 ValA_Wu8 17.0000000000 DINH_LimDFCVerb 0.00 17.0000000000 FORMAT "%13.10" NUMBER 82 /end CHARACTERISTIC
/begin CHARACTERISTIC DINH_Lim.DFC_P_VSE11_SCB_CA "inhibit conditions / inhibit limit conditions for inhibit source DFC_P_VSE11_SCB" VAL_BLK 0x80502667 ValA_Wu8 17.0000000000 DINH_LimDFCVerb 0.00 17.0000000000 FORMAT "%13.10" NUMBER 82 /end CHARACTERISTIC
/begin CHARACTERISTIC DINH_Lim.DFC_P_VSE11_SCG_CA "inhibit conditions / inhibit limit conditions for inhibit source DFC_P_VSE11_SCG" VAL_BLK 0x805026B9 ValA_Wu8 17.0000000000 DINH_LimDFCVerb 0.00 17.0000000000 FORMAT "%13.10" NUMBER 82 /end CHARACTERISTIC
/begin CHARACTERISTIC DINH_Lim.DFC_PhyHighAPP1_CA "inhibit conditions / inhibit limit conditions for inhibit source DFC_PhyHighAPP1" VAL_BLK 0x8050270B ValA_Wu8 17.0000000000 DINH_LimDFCVerb 0.00 17.0000000000 FORMAT "%13.10" NUMBER 58 /end CHARACTERISTIC
/begin CHARACTERISTIC DINH_Lim.DFC_PhyHighAPP2_CA "inhibit conditions / inhibit limit conditions for inhibit source DFC_PhyHighAPP2" VAL_BLK 0x80502745 ValA_Wu8 17.0000000000 DINH_LimDFCVerb 0.00 17.0000000000 FORMAT "%13.10" NUMBER 57 /end CHARACTERISTIC
/begin CHARACTERISTIC DINH_Lim.DFC_PhyLowAPP1_CA "inhibit conditions / inhibit limit conditions for inhibit source DFC_PhyLowAPP1" VAL_BLK 0x8050277E ValA_Wu8 17.0000000000 DINH_LimDFCVerb 0.00 17.0000000000 FORMAT "%13.10" NUMBER 58 /end CHARACTERISTIC
/begin CHARACTERISTIC DINH_Lim.DFC_PhyLowAPP2_CA "inhibit conditions / inhibit limit conditions for inhibit source DFC_PhyLowAPP2" VAL_BLK 0x805027B8 ValA_Wu8 17.0000000000 DINH_LimDFCVerb 0.00 17.0000000000 FORMAT "%13.10" NUMBER 57 /end CHARACTERISTIC
/begin CHARACTERISTIC DINH_Lim.DFC_SRCHighAPP1_CA "inhibit conditions / inhibit limit conditions for inhibit source DFC_SRCHighAPP1" VAL_BLK 0x805027F1 ValA_Wu8 17.0000000000 DINH_LimDFCVerb 0.00 17.0000000000 FORMAT "%13.10" NUMBER 70 /end CHARACTERISTIC
/begin CHARACTERISTIC DINH_Lim.DFC_SRCHighAPP2_CA "inhibit conditions / inhibit limit conditions for inhibit source DFC_SRCHighAPP2" VAL_BLK 0x80502837 ValA_Wu8 17.0000000000 DINH_LimDFCVerb 0.00 17.0000000000 FORMAT "%13.10" NUMBER 69 /end CHARACTERISTIC
/begin CHARACTERISTIC DINH_Lim.DFC_SRCLowAPP1_CA "inhibit conditions / inhibit limit conditions for inhibit source DFC_SRCLowAPP1" VAL_BLK 0x8050287C ValA_Wu8 17.0000000000 DINH_LimDFCVerb 0.00 17.0000000000 FORMAT "%13.10" NUMBER 71 /end CHARACTERISTIC
/begin CHARACTERISTIC DINH_Lim.DFC_SRCLowAPP2_CA "inhibit conditions / inhibit limit conditions for inhibit source DFC_SRCLowAPP2" VAL_BLK 0x805028C3 ValA_Wu8 17.0000000000 DINH_LimDFCVerb 0.00 17.0000000000 FORMAT "%13.10" NUMBER 70 /end CHARACTERISTIC
/begin CHARACTERISTIC DINH_Lim.DFC_SSpMon2_CA "inhibit conditions / inhibit limit conditions for inhibit source DFC_SSpMon2" VAL_BLK 0x80502909 ValA_Wu8 17.0000000000 DINH_LimDFCVerb 0.00 17.0000000000 FORMAT "%13.10" NUMBER 79 /end CHARACTERISTIC
/begin CHARACTERISTIC DINH_Lim.DFC_STHDRmax_CA "inhibit conditions / inhibit limit conditions for inhibit source DFC_STHDRmax" VAL_BLK 0x80502958 ValA_Wu8 17.0000000000 DINH_LimDFCVerb 0.00 17.0000000000 FORMAT "%13.10" NUMBER 50 /end CHARACTERISTIC
/begin CHARACTERISTIC DINH_Lim.DFC_SWReset_0_CA "inhibit conditions / inhibit limit conditions for inhibit source DFC_SWReset_0" VAL_BLK 0x8050298A ValA_Wu8 17.0000000000 DINH_LimDFCVerb 0.00 17.0000000000 FORMAT "%13.10" NUMBER 50 /end CHARACTERISTIC
/begin CHARACTERISTIC DINH_Lim.DFC_SWReset_1_CA "inhibit conditions / inhibit limit conditions for inhibit source DFC_SWReset_1" VAL_BLK 0x805029BC ValA_Wu8 17.0000000000 DINH_LimDFCVerb 0.00 17.0000000000 FORMAT "%13.10" NUMBER 50 /end CHARACTERISTIC
/begin CHARACTERISTIC DINH_Lim.DFC_SWReset_2_CA "inhibit conditions / inhibit limit conditions for inhibit source DFC_SWReset_2" VAL_BLK 0x805029EE ValA_Wu8 17.0000000000 DINH_LimDFCVerb 0.00 17.0000000000 FORMAT "%13.10" NUMBER 50 /end CHARACTERISTIC
/begin CHARACTERISTIC DINH_Lim.DFC_SyncAPP_CA "inhibit conditions / inhibit limit conditions for inhibit source DFC_SyncAPP" VAL_BLK 0x80502A20 ValA_Wu8 17.0000000000 DINH_LimDFCVerb 0.00 17.0000000000 FORMAT "%13.10" NUMBER 74 /end CHARACTERISTIC
/begin CHARACTERISTIC DINH_Lim.DFC_TANKLnpl_CA "inhibit conditions / inhibit limit conditions for inhibit source DFC_TANKLnpl" VAL_BLK 0x80502A6A ValA_Wu8 17.0000000000 DINH_LimDFCVerb 0.00 17.0000000000 FORMAT "%13.10" NUMBER 50 /end CHARACTERISTIC
/begin CHARACTERISTIC DINH_Lim.DFC_TAmax_Dummy_CA "inhibit conditions / inhibit limit conditions for inhibit source DFC_TAmax_Dummy" VAL_BLK 0x80502A9C ValA_Wu8 17.0000000000 DINH_LimDFCVerb 0.00 17.0000000000 FORMAT "%13.10" NUMBER 50 /end CHARACTERISTIC
/begin CHARACTERISTIC DINH_Lim.DFC_TESFmax_CA "inhibit conditions / inhibit limit conditions for inhibit source DFC_TESFmax" VAL_BLK 0x80502ACE ValA_Wu8 17.0000000000 DINH_LimDFCVerb 0.00 17.0000000000 FORMAT "%13.10" NUMBER 51 /end CHARACTERISTIC
/begin CHARACTERISTIC DINH_Lim.DFC_TESGmax_CA "inhibit conditions / inhibit limit conditions for inhibit source DFC_TESGmax" VAL_BLK 0x80502B01 ValA_Wu8 17.0000000000 DINH_LimDFCVerb 0.00 17.0000000000 FORMAT "%13.10" NUMBER 53 /end CHARACTERISTIC
/begin CHARACTERISTIC DINH_Lim.DFC_TKAEmax_CA "inhibit conditions / inhibit limit conditions for inhibit source DFC_TKAEmax" VAL_BLK 0x80502B36 ValA_Wu8 17.0000000000 DINH_LimDFCVerb 0.00 17.0000000000 FORMAT "%13.10" NUMBER 51 /end CHARACTERISTIC
/begin CHARACTERISTIC DINH_Lim.DFC_TKAEmin_CA "inhibit conditions / inhibit limit conditions for inhibit source DFC_TKAEmin" VAL_BLK 0x80502B69 ValA_Wu8 17.0000000000 DINH_LimDFCVerb 0.00 17.0000000000 FORMAT "%13.10" NUMBER 51 /end CHARACTERISTIC
/begin CHARACTERISTIC DINH_Lim.DFC_TKARmax_CA "inhibit conditions / inhibit limit conditions for inhibit source DFC_TKARmax" VAL_BLK 0x80502B9C ValA_Wu8 17.0000000000 DINH_LimDFCVerb 0.00 17.0000000000 FORMAT "%13.10" NUMBER 51 /end CHARACTERISTIC
/begin CHARACTERISTIC DINH_Lim.DFC_TKARnpl_CA "inhibit conditions / inhibit limit conditions for inhibit source DFC_TKARnpl" VAL_BLK 0x80502BCF ValA_Wu8 17.0000000000 DINH_LimDFCVerb 0.00 17.0000000000 FORMAT "%13.10" NUMBER 51 /end CHARACTERISTIC
/begin CHARACTERISTIC DINH_Lim.DFC_TMmax_Dummy_CA "inhibit conditions / inhibit limit conditions for inhibit source DFC_TMmax_Dummy" VAL_BLK 0x80502C02 ValA_Wu8 17.0000000000 DINH_LimDFCVerb 0.00 17.0000000000 FORMAT "%13.10" NUMBER 50 /end CHARACTERISTIC
/begin CHARACTERISTIC DINH_Lim.DFC_TUMmax_Dummy_CA "inhibit conditions / inhibit limit conditions for inhibit source DFC_TUMmax_Dummy" VAL_BLK 0x80502C34 ValA_Wu8 17.0000000000 DINH_LimDFCVerb 0.00 17.0000000000 FORMAT "%13.10" NUMBER 50 /end CHARACTERISTIC
/begin CHARACTERISTIC DINH_Lim.DFC_TWCDPriCatB1_CA "inhibit conditions / inhibit limit conditions for inhibit source DFC_TWCDPriCatB1" VAL_BLK 0x80502C66 ValA_Wu8 17.0000000000 DINH_LimDFCVerb 0.00 17.0000000000 FORMAT "%13.10" NUMBER 54 /end CHARACTERISTIC
/begin CHARACTERISTIC DINH_Lim.DFC_ThrVlvClsdPosnFirstOffsLrnImpoB1_CA "inhibit conditions / inhibit limit conditions for inhibit source DFC_ThrVlvClsdPosnFirstOffsLrnImpoB1" VAL_BLK 0x80502C9C ValA_Wu8 17.0000000000 DINH_LimDFCVerb 0.00 17.0000000000 FORMAT "%13.10" NUMBER 75 /end CHARACTERISTIC
/begin CHARACTERISTIC DINH_Lim.DFC_ThrVlvClsdPosnOffsLrnImpoB1_CA "inhibit conditions / inhibit limit conditions for inhibit source DFC_ThrVlvClsdPosnOffsLrnImpoB1" VAL_BLK 0x80502CE7 ValA_Wu8 17.0000000000 DINH_LimDFCVerb 0.00 17.0000000000 FORMAT "%13.10" NUMBER 59 /end CHARACTERISTIC
/begin CHARACTERISTIC DINH_Lim.DFC_ThrVlvClsdPosnOffsLrnMaxB1_CA "inhibit conditions / inhibit limit conditions for inhibit source DFC_ThrVlvClsdPosnOffsLrnMaxB1" VAL_BLK 0x80502D22 ValA_Wu8 17.0000000000 DINH_LimDFCVerb 0.00 17.0000000000 FORMAT "%13.10" NUMBER 59 /end CHARACTERISTIC
/begin CHARACTERISTIC DINH_Lim.DFC_ThrVlvClsdPosnOffsLrnMinB1_CA "inhibit conditions / inhibit limit conditions for inhibit source DFC_ThrVlvClsdPosnOffsLrnMinB1" VAL_BLK 0x80502D5D ValA_Wu8 17.0000000000 DINH_LimDFCVerb 0.00 17.0000000000 FORMAT "%13.10" NUMBER 59 /end CHARACTERISTIC
/begin CHARACTERISTIC DINH_Lim.DFC_ThrVlvCtrlDeB1_CA "inhibit conditions / inhibit limit conditions for inhibit source DFC_ThrVlvCtrlDeB1" VAL_BLK 0x80502D98 ValA_Wu8 17.0000000000 DINH_LimDFCVerb 0.00 17.0000000000 FORMAT "%13.10" NUMBER 70 /end CHARACTERISTIC
/begin CHARACTERISTIC DINH_Lim.DFC_ThrVlvDycB1_CA "inhibit conditions / inhibit limit conditions for inhibit source DFC_ThrVlvDycB1" VAL_BLK 0x80502DDE ValA_Wu8 17.0000000000 DINH_LimDFCVerb 0.00 17.0000000000 FORMAT "%13.10" NUMBER 70 /end CHARACTERISTIC
/begin CHARACTERISTIC DINH_Lim.DFC_ThrVlvLimpAirPosnMaxAbsltDriftB1_CA "inhibit conditions / inhibit limit conditions for inhibit source DFC_ThrVlvLimpAirPosnMaxAbsltDriftB1" VAL_BLK 0x80502E24 ValA_Wu8 17.0000000000 DINH_LimDFCVerb 0.00 17.0000000000 FORMAT "%13.10" NUMBER 54 /end CHARACTERISTIC
/begin CHARACTERISTIC DINH_Lim.DFC_ThrVlvLimpAirPosnMaxB1_CA "inhibit conditions / inhibit limit conditions for inhibit source DFC_ThrVlvLimpAirPosnMaxB1" VAL_BLK 0x80502E5A ValA_Wu8 17.0000000000 DINH_LimDFCVerb 0.00 17.0000000000 FORMAT "%13.10" NUMBER 54 /end CHARACTERISTIC
/begin CHARACTERISTIC DINH_Lim.DFC_ThrVlvLimpAirPosnMaxRelDriftB1_CA "inhibit conditions / inhibit limit conditions for inhibit source DFC_ThrVlvLimpAirPosnMaxRelDriftB1" VAL_BLK 0x80502E90 ValA_Wu8 17.0000000000 DINH_LimDFCVerb 0.00 17.0000000000 FORMAT "%13.10" NUMBER 54 /end CHARACTERISTIC
/begin CHARACTERISTIC DINH_Lim.DFC_ThrVlvLimpAirPosnMinB1_CA "inhibit conditions / inhibit limit conditions for inhibit source DFC_ThrVlvLimpAirPosnMinB1" VAL_BLK 0x80502EC6 ValA_Wu8 17.0000000000 DINH_LimDFCVerb 0.00 17.0000000000 FORMAT "%13.10" NUMBER 54 /end CHARACTERISTIC
/begin CHARACTERISTIC DINH_Lim.DFC_ThrVlvOpenLoadB1_CA "inhibit conditions / inhibit limit conditions for inhibit source DFC_ThrVlvOpenLoadB1" VAL_BLK 0x80502EFC ValA_Wu8 17.0000000000 DINH_LimDFCVerb 0.00 17.0000000000 FORMAT "%13.10" NUMBER 67 /end CHARACTERISTIC
/begin CHARACTERISTIC DINH_Lim.DFC_ThrVlvOpenSprgB1_CA "inhibit conditions / inhibit limit conditions for inhibit source DFC_ThrVlvOpenSprgB1" VAL_BLK 0x80502F3F ValA_Wu8 17.0000000000 DINH_LimDFCVerb 0.00 17.0000000000 FORMAT "%13.10" NUMBER 65 /end CHARACTERISTIC
/begin CHARACTERISTIC DINH_Lim.DFC_ThrVlvOpenSprgSprdB1_CA "inhibit conditions / inhibit limit conditions for inhibit source DFC_ThrVlvOpenSprgSprdB1" VAL_BLK 0x80502F80 ValA_Wu8 17.0000000000 DINH_LimDFCVerb 0.00 17.0000000000 FORMAT "%13.10" NUMBER 53 /end CHARACTERISTIC
/begin CHARACTERISTIC DINH_Lim.DFC_ThrVlvOpenSprgTwnB1_CA "inhibit conditions / inhibit limit conditions for inhibit source DFC_ThrVlvOpenSprgTwnB1" VAL_BLK 0x80502FB5 ValA_Wu8 17.0000000000 DINH_LimDFCVerb 0.00 17.0000000000 FORMAT "%13.10" NUMBER 52 /end CHARACTERISTIC
/begin CHARACTERISTIC DINH_Lim.DFC_ThrVlvOverTB1_CA "inhibit conditions / inhibit limit conditions for inhibit source DFC_ThrVlvOverTB1" VAL_BLK 0x80502FE9 ValA_Wu8 17.0000000000 DINH_LimDFCVerb 0.00 17.0000000000 FORMAT "%13.10" NUMBER 67 /end CHARACTERISTIC
/begin CHARACTERISTIC DINH_Lim.DFC_ThrVlvRetSprgB1_CA "inhibit conditions / inhibit limit conditions for inhibit source DFC_ThrVlvRetSprgB1" VAL_BLK 0x8050302C ValA_Wu8 17.0000000000 DINH_LimDFCVerb 0.00 17.0000000000 FORMAT "%13.10" NUMBER 67 /end CHARACTERISTIC
/begin CHARACTERISTIC DINH_Lim.DFC_ThrVlvRetSprgSprdB1_CA "inhibit conditions / inhibit limit conditions for inhibit source DFC_ThrVlvRetSprgSprdB1" VAL_BLK 0x8050306F ValA_Wu8 17.0000000000 DINH_LimDFCVerb 0.00 17.0000000000 FORMAT "%13.10" NUMBER 53 /end CHARACTERISTIC
/begin CHARACTERISTIC DINH_Lim.DFC_ThrVlvRetSprgTwnB1_CA "inhibit conditions / inhibit limit conditions for inhibit source DFC_ThrVlvRetSprgTwnB1" VAL_BLK 0x805030A4 ValA_Wu8 17.0000000000 DINH_LimDFCVerb 0.00 17.0000000000 FORMAT "%13.10" NUMBER 52 /end CHARACTERISTIC
/begin CHARACTERISTIC DINH_Lim.DFC_ThrVlvSens1MaxB1_CA "inhibit conditions / inhibit limit conditions for inhibit source DFC_ThrVlvSens1MaxB1" VAL_BLK 0x805030D8 ValA_Wu8 17.0000000000 DINH_LimDFCVerb 0.00 17.0000000000 FORMAT "%13.10" NUMBER 96 /end CHARACTERISTIC
/begin CHARACTERISTIC DINH_Lim.DFC_ThrVlvSens1NplB1_CA "inhibit conditions / inhibit limit conditions for inhibit source DFC_ThrVlvSens1NplB1" VAL_BLK 0x80503138 ValA_Wu8 17.0000000000 DINH_LimDFCVerb 0.00 17.0000000000 FORMAT "%13.10" NUMBER 96 /end CHARACTERISTIC
/begin CHARACTERISTIC DINH_Lim.DFC_ThrVlvSens2MaxB1_CA "inhibit conditions / inhibit limit conditions for inhibit source DFC_ThrVlvSens2MaxB1" VAL_BLK 0x80503198 ValA_Wu8 17.0000000000 DINH_LimDFCVerb 0.00 17.0000000000 FORMAT "%13.10" NUMBER 96 /end CHARACTERISTIC
/begin CHARACTERISTIC DINH_Lim.DFC_ThrVlvSens2MinB1_CA "inhibit conditions / inhibit limit conditions for inhibit source DFC_ThrVlvSens2MinB1" VAL_BLK 0x805031F8 ValA_Wu8 17.0000000000 DINH_LimDFCVerb 0.00 17.0000000000 FORMAT "%13.10" NUMBER 96 /end CHARACTERISTIC
/begin CHARACTERISTIC DINH_Lim.DFC_ThrVlvSens2NplB1_CA "inhibit conditions / inhibit limit conditions for inhibit source DFC_ThrVlvSens2NplB1" VAL_BLK 0x80503258 ValA_Wu8 17.0000000000 DINH_LimDFCVerb 0.00 17.0000000000 FORMAT "%13.10" NUMBER 96 /end CHARACTERISTIC
/begin CHARACTERISTIC DINH_Lim.DFC_ThrVlvShoCircB1_CA "inhibit conditions / inhibit limit conditions for inhibit source DFC_ThrVlvShoCircB1" VAL_BLK 0x805032B8 ValA_Wu8 17.0000000000 DINH_LimDFCVerb 0.00 17.0000000000 FORMAT "%13.10" NUMBER 67 /end CHARACTERISTIC
/begin CHARACTERISTIC DINH_Lim.DFC_ThrVlvSpiErrB1_CA "inhibit conditions / inhibit limit conditions for inhibit source DFC_ThrVlvSpiErrB1" VAL_BLK 0x805032FB ValA_Wu8 17.0000000000 DINH_LimDFCVerb 0.00 17.0000000000 FORMAT "%13.10" NUMBER 67 /end CHARACTERISTIC
/begin CHARACTERISTIC DINH_Lim.DFC_ThrvlvSens1MinB1_CA "inhibit conditions / inhibit limit conditions for inhibit source DFC_ThrvlvSens1MinB1" VAL_BLK 0x8050333E ValA_Wu8 17.0000000000 DINH_LimDFCVerb 0.00 17.0000000000 FORMAT "%13.10" NUMBER 96 /end CHARACTERISTIC
/begin CHARACTERISTIC DINH_Lim.DFC_TiOffTBasdChkFast_CA "inhibit conditions / inhibit limit conditions for inhibit source DFC_TiOffTBasdChkFast" VAL_BLK 0x8050339E ValA_Wu8 17.0000000000 DINH_LimDFCVerb 0.00 17.0000000000 FORMAT "%13.10" NUMBER 55 /end CHARACTERISTIC
/begin CHARACTERISTIC DINH_Lim.DFC_TiOffTBasdChkSlow_CA "inhibit conditions / inhibit limit conditions for inhibit source DFC_TiOffTBasdChkSlow" VAL_BLK 0x805033D5 ValA_Wu8 17.0000000000 DINH_LimDFCVerb 0.00 17.0000000000 FORMAT "%13.10" NUMBER 55 /end CHARACTERISTIC
/begin CHARACTERISTIC DINH_Lim.DFC_UEGOSnsrMntdS1B1_CA "inhibit conditions / inhibit limit conditions for inhibit source DFC_UEGOSnsrMntdS1B1" VAL_BLK 0x8050340C ValA_Wu8 17.0000000000 DINH_LimDFCVerb 0.00 17.0000000000 FORMAT "%13.10" NUMBER 75 /end CHARACTERISTIC
/begin CHARACTERISTIC DINH_Lim.DFC_VehVSig_CA "inhibit conditions / inhibit limit conditions for inhibit source DFC_VehVSig" VAL_BLK 0x80503457 ValA_Wu8 17.0000000000 DINH_LimDFCVerb 0.00 17.0000000000 FORMAT "%13.10" NUMBER 92 /end CHARACTERISTIC
/begin CHARACTERISTIC DINH_Lim.DFC_VlvLftFbSwtIntk11SpclFail_CA "inhibit conditions / inhibit limit conditions for inhibit source DFC_VlvLftFbSwtIntk11SpclFail" VAL_BLK 0x805034B3 ValA_Wu8 17.0000000000 DINH_LimDFCVerb 0.00 17.0000000000 FORMAT "%13.10" NUMBER 84 /end CHARACTERISTIC
/begin CHARACTERISTIC DINH_Lim.DFC_VlvLftFbSwtIntk11StdFail_CA "inhibit conditions / inhibit limit conditions for inhibit source DFC_VlvLftFbSwtIntk11StdFail" VAL_BLK 0x80503507 ValA_Wu8 17.0000000000 DINH_LimDFCVerb 0.00 17.0000000000 FORMAT "%13.10" NUMBER 84 /end CHARACTERISTIC
/begin CHARACTERISTIC DINH_Lim.DSQ_ACClntP_CA "inhibit conditions / inhibit limit conditions for inhibit source DSQ_ACClntP" VAL_BLK 0x8050355B ValA_Wu8 16.0000000000 DINH_LimDSQVerb 0.00 16.0000000000 FORMAT "%13.10" NUMBER 50 /end CHARACTERISTIC
/begin CHARACTERISTIC DINH_Lim.DSQ_ACEvpT_CA "inhibit conditions / inhibit limit conditions for inhibit source DSQ_ACEvpT" VAL_BLK 0x8050358D ValA_Wu8 16.0000000000 DINH_LimDSQVerb 0.00 16.0000000000 FORMAT "%13.10" NUMBER 50 /end CHARACTERISTIC
/begin CHARACTERISTIC DINH_Lim.DSQ_AirCCmprActr_CA "inhibit conditions / inhibit limit conditions for inhibit source DSQ_AirCCmprActr" VAL_BLK 0x805035BF ValA_Wu8 16.0000000000 DINH_LimDSQVerb 0.00 16.0000000000 FORMAT "%13.10" NUMBER 50 /end CHARACTERISTIC
/begin CHARACTERISTIC DINH_Lim.DSQ_BattU_CA "inhibit conditions / inhibit limit conditions for inhibit source DSQ_BattU" VAL_BLK 0x805035F1 ValA_Wu8 16.0000000000 DINH_LimDSQVerb 0.00 16.0000000000 FORMAT "%13.10" NUMBER 53 /end CHARACTERISTIC
/begin CHARACTERISTIC DINH_Lim.DSQ_BattULo_CA "inhibit conditions / inhibit limit conditions for inhibit source DSQ_BattULo" VAL_BLK 0x80503626 ValA_Wu8 16.0000000000 DINH_LimDSQVerb 0.00 16.0000000000 FORMAT "%13.10" NUMBER 51 /end CHARACTERISTIC
/begin CHARACTERISTIC DINH_Lim.DSQ_BrkBstPMdl_CA "inhibit conditions / inhibit limit conditions for inhibit source DSQ_BrkBstPMdl" VAL_BLK 0x80503659 ValA_Wu8 16.0000000000 DINH_LimDSQVerb 0.00 16.0000000000 FORMAT "%13.10" NUMBER 50 /end CHARACTERISTIC
/begin CHARACTERISTIC DINH_Lim.DSQ_BrkP_CA "inhibit conditions / inhibit limit conditions for inhibit source DSQ_BrkP" VAL_BLK 0x8050368B ValA_Wu8 16.0000000000 DINH_LimDSQVerb 0.00 16.0000000000 FORMAT "%13.10" NUMBER 51 /end CHARACTERISTIC
/begin CHARACTERISTIC DINH_Lim.DSQ_BrkPSnsr_CA "inhibit conditions / inhibit limit conditions for inhibit source DSQ_BrkPSnsr" VAL_BLK 0x805036BE ValA_Wu8 16.0000000000 DINH_LimDSQVerb 0.00 16.0000000000 FORMAT "%13.10" NUMBER 52 /end CHARACTERISTIC
/begin CHARACTERISTIC DINH_Lim.DSQ_CoVMDIDASFail_CA "inhibit conditions / inhibit limit conditions for inhibit source DSQ_CoVMDIDASFail" VAL_BLK 0x805036F2 ValA_Wu8 16.0000000000 DINH_LimDSQVerb 0.00 16.0000000000 FORMAT "%13.10" NUMBER 50 /end CHARACTERISTIC
/begin CHARACTERISTIC DINH_Lim.DSQ_DSMInhibitAlways_CA "inhibit conditions / inhibit limit conditions for inhibit source DSQ_DSMInhibitAlways" VAL_BLK 0x80503724 ValA_Wu8 16.0000000000 DINH_LimDSQVerb 0.00 16.0000000000 FORMAT "%13.10" NUMBER 51 /end CHARACTERISTIC
/begin CHARACTERISTIC DINH_Lim.DSQ_EGRVlv_GovDesVal_CA "inhibit conditions / inhibit limit conditions for inhibit source DSQ_EGRVlv_GovDesVal" VAL_BLK 0x80503757 ValA_Wu8 16.0000000000 DINH_LimDSQVerb 0.00 16.0000000000 FORMAT "%13.10" NUMBER 51 /end CHARACTERISTIC
/begin CHARACTERISTIC DINH_Lim.DSQ_ElecLd_CA "inhibit conditions / inhibit limit conditions for inhibit source DSQ_ElecLd" VAL_BLK 0x8050378A ValA_Wu8 16.0000000000 DINH_LimDSQVerb 0.00 16.0000000000 FORMAT "%13.10" NUMBER 51 /end CHARACTERISTIC
/begin CHARACTERISTIC DINH_Lim.DSQ_EngICO_CA "inhibit conditions / inhibit limit conditions for inhibit source DSQ_EngICO" VAL_BLK 0x805037BD ValA_Wu8 16.0000000000 DINH_LimDSQVerb 0.00 16.0000000000 FORMAT "%13.10" NUMBER 50 /end CHARACTERISTIC
/begin CHARACTERISTIC DINH_Lim.DSQ_EpmCaSSigQuality_CA "inhibit conditions / inhibit limit conditions for inhibit source DSQ_EpmCaSSigQuality" VAL_BLK 0x805037EF ValA_Wu8 16.0000000000 DINH_LimDSQVerb 0.00 16.0000000000 FORMAT "%13.10" NUMBER 55 /end CHARACTERISTIC
/begin CHARACTERISTIC DINH_Lim.DSQ_EpmReverseRun_CA "inhibit conditions / inhibit limit conditions for inhibit source DSQ_EpmReverseRun" VAL_BLK 0x80503826 ValA_Wu8 16.0000000000 DINH_LimDSQVerb 0.00 16.0000000000 FORMAT "%13.10" NUMBER 52 /end CHARACTERISTIC
/begin CHARACTERISTIC DINH_Lim.DSQ_FanDIO_0_CA "inhibit conditions / inhibit limit conditions for inhibit source DSQ_FanDIO_0" VAL_BLK 0x8050385A ValA_Wu8 16.0000000000 DINH_LimDSQVerb 0.00 16.0000000000 FORMAT "%13.10" NUMBER 50 /end CHARACTERISTIC
/begin CHARACTERISTIC DINH_Lim.DSQ_FanDIO_1_CA "inhibit conditions / inhibit limit conditions for inhibit source DSQ_FanDIO_1" VAL_BLK 0x8050388C ValA_Wu8 16.0000000000 DINH_LimDSQVerb 0.00 16.0000000000 FORMAT "%13.10" NUMBER 50 /end CHARACTERISTIC
/begin CHARACTERISTIC DINH_Lim.DSQ_FuelP_CA "inhibit conditions / inhibit limit conditions for inhibit source DSQ_FuelP" VAL_BLK 0x805038BE ValA_Wu8 16.0000000000 DINH_LimDSQVerb 0.00 16.0000000000 FORMAT "%13.10" NUMBER 50 /end CHARACTERISTIC
/begin CHARACTERISTIC DINH_Lim.DSQ_FuelT_CA "inhibit conditions / inhibit limit conditions for inhibit source DSQ_FuelT" VAL_BLK 0x805038F0 ValA_Wu8 16.0000000000 DINH_LimDSQVerb 0.00 16.0000000000 FORMAT "%13.10" NUMBER 50 /end CHARACTERISTIC
/begin CHARACTERISTIC DINH_Lim.DSQ_GEVCtlTOilCylHd_CA "inhibit conditions / inhibit limit conditions for inhibit source DSQ_GEVCtlTOilCylHd" VAL_BLK 0x80503922 ValA_Wu8 16.0000000000 DINH_LimDSQVerb 0.00 16.0000000000 FORMAT "%13.10" NUMBER 54 /end CHARACTERISTIC
/begin CHARACTERISTIC DINH_Lim.DSQ_GEVlvAgIntkB1_CA "inhibit conditions / inhibit limit conditions for inhibit source DSQ_GEVlvAgIntkB1" VAL_BLK 0x80503958 ValA_Wu8 16.0000000000 DINH_LimDSQVerb 0.00 16.0000000000 FORMAT "%13.10" NUMBER 51 /end CHARACTERISTIC
/begin CHARACTERISTIC DINH_Lim.DSQ_GbxPNPos_CA "inhibit conditions / inhibit limit conditions for inhibit source DSQ_GbxPNPos" VAL_BLK 0x8050398B ValA_Wu8 16.0000000000 DINH_LimDSQVerb 0.00 16.0000000000 FORMAT "%13.10" NUMBER 51 /end CHARACTERISTIC
/begin CHARACTERISTIC DINH_Lim.DSQ_GbxPosNotPN_CA "inhibit conditions / inhibit limit conditions for inhibit source DSQ_GbxPosNotPN" VAL_BLK 0x805039BE ValA_Wu8 16.0000000000 DINH_LimDSQVerb 0.00 16.0000000000 FORMAT "%13.10" NUMBER 51 /end CHARACTERISTIC
/begin CHARACTERISTIC DINH_Lim.DSQ_InjVlv_DI_CylOk_CA "inhibit conditions / inhibit limit conditions for inhibit source DSQ_InjVlv_DI_CylOk" VAL_BLK 0x805039F1 ValA_Wu8 16.0000000000 DINH_LimDSQVerb 0.00 16.0000000000 FORMAT "%13.10" NUMBER 50 /end CHARACTERISTIC
/begin CHARACTERISTIC DINH_Lim.DSQ_MRly_CA "inhibit conditions / inhibit limit conditions for inhibit source DSQ_MRly" VAL_BLK 0x80503A23 ValA_Wu8 16.0000000000 DINH_LimDSQVerb 0.00 16.0000000000 FORMAT "%13.10" NUMBER 50 /end CHARACTERISTIC
/begin CHARACTERISTIC DINH_Lim.DSQ_OilP_CA "inhibit conditions / inhibit limit conditions for inhibit source DSQ_OilP" VAL_BLK 0x80503A55 ValA_Wu8 16.0000000000 DINH_LimDSQVerb 0.00 16.0000000000 FORMAT "%13.10" NUMBER 50 /end CHARACTERISTIC
/begin CHARACTERISTIC DINH_Lim.DSQ_PEnvMeasVld_CA "inhibit conditions / inhibit limit conditions for inhibit source DSQ_PEnvMeasVld" VAL_BLK 0x80503A87 ValA_Wu8 16.0000000000 DINH_LimDSQVerb 0.00 16.0000000000 FORMAT "%13.10" NUMBER 52 /end CHARACTERISTIC
/begin CHARACTERISTIC DINH_Lim.DSQ_PEnvVld_CA "inhibit conditions / inhibit limit conditions for inhibit source DSQ_PEnvVld" VAL_BLK 0x80503ABB ValA_Wu8 16.0000000000 DINH_LimDSQVerb 0.00 16.0000000000 FORMAT "%13.10" NUMBER 54 /end CHARACTERISTIC
/begin CHARACTERISTIC DINH_Lim.DSQ_PEnv_pRaw_CA "inhibit conditions / inhibit limit conditions for inhibit source DSQ_PEnv_pRaw" VAL_BLK 0x80503AF1 ValA_Wu8 16.0000000000 DINH_LimDSQVerb 0.00 16.0000000000 FORMAT "%13.10" NUMBER 51 /end CHARACTERISTIC
/begin CHARACTERISTIC DINH_Lim.DSQ_PRail_CA "inhibit conditions / inhibit limit conditions for inhibit source DSQ_PRail" VAL_BLK 0x80503B24 ValA_Wu8 16.0000000000 DINH_LimDSQVerb 0.00 16.0000000000 FORMAT "%13.10" NUMBER 50 /end CHARACTERISTIC
/begin CHARACTERISTIC DINH_Lim.DSQ_PThrVlvUs_CA "inhibit conditions / inhibit limit conditions for inhibit source DSQ_PThrVlvUs" VAL_BLK 0x80503B56 ValA_Wu8 16.0000000000 DINH_LimDSQVerb 0.00 16.0000000000 FORMAT "%13.10" NUMBER 50 /end CHARACTERISTIC
/begin CHARACTERISTIC DINH_Lim.DSQ_PThrVlvUsB1_CA "inhibit conditions / inhibit limit conditions for inhibit source DSQ_PThrVlvUsB1" VAL_BLK 0x80503B88 ValA_Wu8 16.0000000000 DINH_LimDSQVerb 0.00 16.0000000000 FORMAT "%13.10" NUMBER 50 /end CHARACTERISTIC
/begin CHARACTERISTIC DINH_Lim.DSQ_StrtImobChk_CA "inhibit conditions / inhibit limit conditions for inhibit source DSQ_StrtImobChk" VAL_BLK 0x80503BBA ValA_Wu8 16.0000000000 DINH_LimDSQVerb 0.00 16.0000000000 FORMAT "%13.10" NUMBER 50 /end CHARACTERISTIC
/begin CHARACTERISTIC DINH_Lim.DSQ_TDevCenColdStrt_CA "inhibit conditions / inhibit limit conditions for inhibit source DSQ_TDevCenColdStrt" VAL_BLK 0x80503BEC ValA_Wu8 16.0000000000 DINH_LimDSQVerb 0.00 16.0000000000 FORMAT "%13.10" NUMBER 55 /end CHARACTERISTIC
/begin CHARACTERISTIC DINH_Lim.DSQ_VehV_CA "inhibit conditions / inhibit limit conditions for inhibit source DSQ_VehV" VAL_BLK 0x80503C23 ValA_Wu8 16.0000000000 DINH_LimDSQVerb 0.00 16.0000000000 FORMAT "%13.10" NUMBER 58 /end CHARACTERISTIC
/begin CHARACTERISTIC DINH_Lim.DSQ_VehVSens_CA "inhibit conditions / inhibit limit conditions for inhibit source DSQ_VehVSens" VAL_BLK 0x80503C5D ValA_Wu8 16.0000000000 DINH_LimDSQVerb 0.00 16.0000000000 FORMAT "%13.10" NUMBER 53 /end CHARACTERISTIC
/begin CHARACTERISTIC DINH_Lim.DSQ_VehVSnsr_CA "inhibit conditions / inhibit limit conditions for inhibit source DSQ_VehVSnsr" VAL_BLK 0x80503C92 ValA_Wu8 16.0000000000 DINH_LimDSQVerb 0.00 16.0000000000 FORMAT "%13.10" NUMBER 62 /end CHARACTERISTIC
/begin CHARACTERISTIC DINH_Lim.DSQ_stAPP_CA "inhibit conditions / inhibit limit conditions for inhibit source DSQ_stAPP" VAL_BLK 0x80503CD0 ValA_Wu8 16.0000000000 DINH_LimDSQVerb 0.00 16.0000000000 FORMAT "%13.10" NUMBER 58 /end CHARACTERISTIC
/begin CHARACTERISTIC DINH_Lim.DSQ_stComEAT4_CA "inhibit conditions / inhibit limit conditions for inhibit source DSQ_stComEAT4" VAL_BLK 0x80503D0A ValA_Wu8 16.0000000000 DINH_LimDSQVerb 0.00 16.0000000000 FORMAT "%13.10" NUMBER 50 /end CHARACTERISTIC
/begin CHARACTERISTIC DINH_tiUpdObsv_C "Paging interval time of FId observer" VALUE 0x805049A8 Val_Wu16 326.6000 Time_s 1.0000 327.6000 FORMAT "%8.4" EXTENDED_LIMITS 0.00 655.3500 /end CHARACTERISTIC
/begin CHARACTERISTIC DINH_xFIDObsv_C "Function identifier to scan by FId observer" VALUE 0x805049AA Val_Wu16 968.000000000 DINH_FIdVerb 0.00 968.000000000 FORMAT "%13.9" /end CHARACTERISTIC
/begin FUNCTION DINH "30000.27.0_1.0.0Diagnostic Inhibit Handler"
 /begin DEF_CHARACTERISTIC DINH_Lim.DFC_ComDLCTCU1_CA DINH_Lim.DFC_ComDLCTCU11_CA DINH_Lim.DFC_ComDLCTCU12_CA DINH_Lim.DFC_ComDLCTCU13_CA DINH_Lim.DFC_ComDLCTCU14_CA DINH_Lim.DFC_ComDLCTCU2_CA DINH_Lim.DFC_ComDLCTCU3_CA DINH_Lim.DFC_ComDLCTCU4_CA DINH_Lim.DFC_ComEPSUnit_CA DINH_Lim.DFC_ComIDASBUnit_CA DINH_Lim.DFC_ComIMGUnit_CA DINH_Lim.DFC_ComMETUnit_CA DINH_Lim.DFC_ComSRSUnit_CA DINH_Lim.DFC_ComVSAUnit_CA DINH_Lim.DFC_EbsSocFlt_CA DINH_Lim.DFC_I14229VINErr_CA DINH_Lim.DFC_InjCatHeatgErr_CA DINH_Lim.DFC_InjSysMulInjDiagErr_CA DINH_Lim.DFC_LLRHmax_CA DINH_Lim.DFC_LLRHmin_CA DINH_Lim.DFC_LLRHnpl_CA DINH_Lim.DFC_LLRKHmax_CA DINH_Lim.DFC_LLRKHmin_CA DINH_Lim.DFC_LLRKHnpl_CA DINH_Lim.DFC_LinACGUnit_CA DINH_Lim.DFC_LinAEVUnit_CA DINH_Lim.DFC_LinEBSUnit_CA DINH_Lim.DFC_RoughRoad_CA DINH_Lim.DFC_SiaEEPRdErr_CA DINH_Lim.DFC_SiaEEPWrngCod_CA DINH_Lim.DFC_UegoHeatrStrtS1B1_CA DINH_Lim.DFC_BusDiagCANAPPLBusOff_CA DINH_Lim.DFC_BusDiagCANCANCBusOff_CA DINH_Lim.DFC_BusDiagCANVEHICLEBusOff_CA DINH_Lim.DFC_RBA_IODIAGPWR_rba_IoExtCy329_SignalVltSply_0_CA DINH_Lim.DFC_RBA_IODIAGPWR_rba_IoExtCy329_SignalVltSply_0OT_CA DINH_Lim.DFC_RBA_IODIAGPWR_rba_IoExtCy329_SignalVltSply_0OV_CA DINH_Lim.DFC_RBA_IODIAGPWR_rba_IoExtCy329_SignalVltSply_0SCG_CA DINH_Lim.DFC_RBA_IODIAGPWR_rba_IoExtCy329_SignalVltSply_0UV_CA DINH_Lim.DFC_RBA_IODIAGPWR_rba_IoExtCy329_SignalVltSply_1_CA DINH_Lim.DFC_RBA_IODIAGPWR_rba_IoExtCy329_SignalVltSply_1OT_CA DINH_Lim.DFC_RBA_IODIAGPWR_rba_IoExtCy329_SignalVltSply_1OV_CA DINH_Lim.DFC_RBA_IODIAGPWR_rba_IoExtCy329_SignalVltSply_1SCG_CA DINH_Lim.DFC_RBA_IODIAGPWR_rba_IoExtCy329_SignalVltSply_1UV_CA DINH_Lim.DFC_RBA_IODIAGPWR_rba_IoExtCy329_SignalVltSply_2_CA DINH_Lim.DFC_RBA_IODIAGPWR_rba_IoExtCy329_SignalVltSply_2OT_CA DINH_Lim.DFC_RBA_IODIAGPWR_rba_IoExtCy329_SignalVltSply_2OV_CA DINH_Lim.DFC_RBA_IODIAGPWR_rba_IoExtCy329_SignalVltSply_2SCG_CA DINH_Lim.DFC_RBA_IODIAGPWR_rba_IoExtCy329_SignalVltSply_2UV_CA DINH_Lim.DFC_CAN_E_TIMEOUT_CA DINH_Lim.DFC_LIN_E_TIMEOUT_CA DINH_Lim.DFC_MRlyOL_CA DINH_Lim.DFC_MRlySCB_CA DINH_Lim.DFC_MRlySCG_CA DINH_Lim.DFC_rba_MultiStackTrace_Threshold_CA DINH_Lim.DFC_BSWM_E_ACTION_FAILED_CA DINH_Lim.DFC_BSWM_E_INTRPTQUEUE_FULL_CA DINH_Lim.DFC_RBA_IOEXTLIB_KEEPALIVE_DRV_CA DINH_Lim.DFC_RBA_IOEXTLIB_KEEPALIVE_INI_CA DINH_Lim.DFC_rba_IoSigRtc_StopCounter_CA DINH_Lim.DFC_rba_MRly_Diag_Stk_Event_CA DINH_Lim.DFC_rba_MemDiag_MemReadErr_CA DINH_Lim.DFC_rba_MemDiag_MemWrErr_CA DINH_Lim.DFC_rba_SyC_IrrSwOffTrigEngRun_Event_CA DINH_Lim.DFC_rba_T15_Diag_ComInVld_Event_CA DINH_Lim.DFC_rba_T15_Diag_ComOff_HwOn_Event_CA DINH_Lim.DFC_rba_T15_Diag_ComOn_HwOff_Event_CA DINH_Lim.DFC_AAVmin_CA DINH_Lim.DFC_AGRSUS_CA DINH_Lim.DFC_AfsPlausDiagHi_CA DINH_Lim.DFC_AfsPlausDiagLo_CA DINH_Lim.DFC_AfsVrntDiagErrB1_CA DINH_Lim.DFC_AppAllSnsrDfct_CA DINH_Lim.DFC_BBKRnldg_CA DINH_Lim.DFC_BBKRsyne_CA DINH_Lim.DFC_BattUStdbyDiaOL_CA DINH_Lim.DFC_BigLeakIntkMnfldEmiInfl_CA DINH_Lim.DFC_BlkdLineTank_CA DINH_Lim.DFC_BrkMnSwtContOnWarnLmp_CA DINH_Lim.DFC_BrkMnSwtNotStpWarnLmp_CA DINH_Lim.DFC_BrkRdntSwtContOnWarnLmp_CA DINH_Lim.DFC_BrkRdntSwtNotStpWarnLmp_CA DINH_Lim.DFC_CEngDsTColdStrtMax_CA DINH_Lim.DFC_CEngDsTColdStrtMin_CA DINH_Lim.DFC_CEngDsTImps_CA DINH_Lim.DFC_CEngDsTPlausHSC_CA DINH_Lim.DFC_CEngDsTPlausLSC_CA DINH_Lim.DFC_CEngDsTPlausSTC_CA DINH_Lim.DFC_CEngDsTSRCMax_CA DINH_Lim.DFC_CEngDsTSRCMin_CA DINH_Lim.DFC_CEngDsTSig_CA DINH_Lim.DFC_CEngUsTColdStrtMax_CA DINH_Lim.DFC_CEngUsTColdStrtMin_CA DINH_Lim.DFC_CEngUsTLooseCnctn_CA DINH_Lim.DFC_CEngUsTSRCMax_CA DINH_Lim.DFC_CEngUsTSRCMin_CA DINH_Lim.DFC_ComDCDCACCFailr_CA DINH_Lim.DFC_DCDCFltDet_CA DINH_Lim.DFC_DKRSA_CA DINH_Lim.DFC_DKVSmax_CA DINH_Lim.DFC_DKnpl_CA DINH_Lim.DFC_DSKVRmax_CA DINH_Lim.DFC_DSKVRmin_CA DINH_Lim.DFC_DSKVRnpl_CA DINH_Lim.DFC_DSKVRsig_CA DINH_Lim.DFC_DSKVSsig_CA DINH_Lim.DFC_DSSmax_CA DINH_Lim.DFC_DSTDmax_CA DINH_Lim.DFC_DSTEmax_CA DINH_Lim.DFC_DSTEmin_CA DINH_Lim.DFC_DSTOFmax_CA DINH_Lim.DFC_DSTRmax_CA DINH_Lim.DFC_DSTRmin_CA DINH_Lim.DFC_DSTRnpl_CA DINH_Lim.DFC_DSTRsig_CA DINH_Lim.DFC_DSTTI_CA DINH_Lim.DFC_DSUmax_CA DINH_Lim.DFC_DiagCpv1DteskLoLoadStuckClsd_CA DINH_Lim.DFC_DiagCpv1DteskLoLoadStuckOpen_CA DINH_Lim.DFC_EGRVlvDrftClsd_CA DINH_Lim.DFC_EGRVlvDrftOpn_CA DINH_Lim.DFC_EGRVlvJamVlvClsd_CA DINH_Lim.DFC_EGRVlvJamVlvOpn_CA DINH_Lim.DFC_EGRVlvSprgBrk_CA DINH_Lim.DFC_EGRVlvTempMdlEEPErr_CA DINH_Lim.DFC_EGRVlvTmpErr_CA DINH_Lim.DFC_EGSDUS2B1LtrDly_CA DINH_Lim.DFC_EGSDUS2B1LtrPT1_CA DINH_Lim.DFC_EGSDUS2B1RtlDly_CA DINH_Lim.DFC_EGSDUS2B1RtlPT1_CA DINH_Lim.DFC_EGSDUS2B1TarLean_CA DINH_Lim.DFC_EGSDUS2B1TarRich_CA DINH_Lim.DFC_EONVmax_CA DINH_Lim.DFC_ETAKHLmax_CA DINH_Lim.DFC_ETAKHTmax_CA DINH_Lim.DFC_ETHSEmax_CA DINH_Lim.DFC_ETHSEmin_CA DINH_Lim.DFC_ETHSFmax_CA DINH_Lim.DFC_ETHSFmin_CA DINH_Lim.DFC_ETHSFsig_CA DINH_Lim.DFC_ETHSNPWmax_CA DINH_Lim.DFC_ETHSNPWmin_CA DINH_Lim.DFC_ETHSNPWsig_CA DINH_Lim.DFC_ETHSPLnpl_CA DINH_Lim.DFC_ETHSTPLnpl_CA DINH_Lim.DFC_EngICO_CA DINH_Lim.DFC_EngPrtOvrSpdMon_CA DINH_Lim.DFC_EpmCaSI1ErrSig_CA DINH_Lim.DFC_EpmCaSI1MntErr_CA DINH_Lim.DFC_EpmCaSI1NoSigMax_CA DINH_Lim.DFC_EpmCaSI1NoSigMin_CA DINH_Lim.DFC_EpmCaSI1OfsErr_CA DINH_Lim.DFC_EpmCrSDGI_CA DINH_Lim.DFC_EpmCrSErrSig_CA DINH_Lim.DFC_EpmCrSNoSig_CA DINH_Lim.DFC_EtaEngIdleNonCsers_CA DINH_Lim.DFC_EtaEngPtlNonCsers_CA DINH_Lim.DFC_FRAmax_CA DINH_Lim.DFC_FRAmin_CA DINH_Lim.DFC_FSTEmax_CA DINH_Lim.DFC_FSTEmin_CA DINH_Lim.DFC_FSTRmax_CA DINH_Lim.DFC_FSTRmin_CA DINH_Lim.DFC_FSTRnpl_CA DINH_Lim.DFC_FSTmax_CA DINH_Lim.DFC_FTDLAmax_CA DINH_Lim.DFC_FTDLAmin_CA DINH_Lim.DFC_FuPHiSnsrEleclmax_CA DINH_Lim.DFC_FuPHiSnsrEleclmin_CA DINH_Lim.DFC_FuPHiSnsrEleclnpl_CA DINH_Lim.DFC_FuPHiSnsrURngMax_CA DINH_Lim.DFC_FuPHiSnsrURngMin_CA DINH_Lim.DFC_FuSnsrPhyRngMaxErr_CA DINH_Lim.DFC_FuSnsrPhyRngMinErr_CA DINH_Lim.DFC_GEVlvLockPinDiagIntkB1_CA DINH_Lim.DFC_GEVlvPhaSlowIntkB1_CA DINH_Lim.DFC_GEVlvPhaTargIntkB1_CA DINH_Lim.DFC_GbxRvsSwtStk_CA DINH_Lim.DFC_HDRKHmax_CA DINH_Lim.DFC_HDRKHmin_CA DINH_Lim.DFC_HDRPLmax_CA DINH_Lim.DFC_HDRPLmin_CA DINH_Lim.DFC_HDRmax_CA DINH_Lim.DFC_HDRmin_CA DINH_Lim.DFC_HEGOS2B1ElecMax_CA DINH_Lim.DFC_HEGOS2B1ElecMin_CA DINH_Lim.DFC_HEGOS2B1ElecSig_CA DINH_Lim.DFC_HEGOS2B1HtgNpl_CA DINH_Lim.DFC_HEV00max_CA DINH_Lim.DFC_HEV01max_CA DINH_Lim.DFC_HEV02max_CA DINH_Lim.DFC_HEV03max_CA DINH_Lim.DFC_HEVE0max_CA DINH_Lim.DFC_HEVE1max_CA DINH_Lim.DFC_HFMmax_CA DINH_Lim.DFC_HiPSysHiPMaxLimExcdd_CA DINH_Lim.DFC_IVGdiCtlCvoErrMax_0_CA DINH_Lim.DFC_IVGdiCtlCvoErrMax_1_CA DINH_Lim.DFC_IVGdiCtlCvoErrMax_2_CA DINH_Lim.DFC_IVGdiCtlCvoErrMax_3_CA DINH_Lim.DFC_IVGdiCtlCvoErrMin_0_CA DINH_Lim.DFC_IVGdiCtlCvoErrMin_1_CA DINH_Lim.DFC_IVGdiCtlCvoErrMin_2_CA DINH_Lim.DFC_IVGdiCtlCvoErrMin_3_CA DINH_Lim.DFC_IVGdiCtlCvoErrMinMax_CA DINH_Lim.DFC_IVGdiCtlCvoSigPlausErrSmrCdn_CA DINH_Lim.DFC_IVGdiCtl_CvoErr_CA DINH_Lim.DFC_IVGdiCtl_CvoSigPlaus_0_CA DINH_Lim.DFC_IVGdiCtl_CvoSigPlaus_1_CA DINH_Lim.DFC_IVGdiCtl_CvoSigPlaus_2_CA DINH_Lim.DFC_IVGdiCtl_CvoSigPlaus_3_CA DINH_Lim.DFC_IntkAirTAirFltDsCrssMax_CA DINH_Lim.DFC_IntkAirTAirFltDsCrssMin_CA DINH_Lim.DFC_IntkAirTAirFltDsHSCMax_CA DINH_Lim.DFC_IntkAirTAirFltDsImps_CA DINH_Lim.DFC_IntkAirTAirFltDsPRCMax_CA DINH_Lim.DFC_IntkAirTAirFltDsPRCMin_CA DINH_Lim.DFC_IntkAirTAirFltDsSRCMax_CA DINH_Lim.DFC_IntkAirTAirFltDsSRCMin_CA DINH_Lim.DFC_IntkAirTAirFltDsSTC_CA DINH_Lim.DFC_IntkAirTIntkMnfldCrssMax_CA DINH_Lim.DFC_IntkAirTIntkMnfldCrssMin_CA DINH_Lim.DFC_IntkAirTIntkMnfldHSCMax_CA DINH_Lim.DFC_IntkAirTIntkMnfldImps_CA DINH_Lim.DFC_IntkAirTIntkMnfldPRCMax_CA DINH_Lim.DFC_IntkAirTIntkMnfldPRCMin_CA DINH_Lim.DFC_IntkAirTIntkMnfldSRCMax_CA DINH_Lim.DFC_IntkAirTIntkMnfldSRCMin_CA DINH_Lim.DFC_IntkAirTIntkMnfldSTC_CA DINH_Lim.DFC_KRREGRLMX_CA DINH_Lim.DFC_KRVEKOCVLCI_CA DINH_Lim.DFC_KRVEKOENCHMT_CA DINH_Lim.DFC_KRVEKOENCHMT0_CA DINH_Lim.DFC_KRVEKOENCHMT1_CA DINH_Lim.DFC_KRVEKOENCHMT2_CA DINH_Lim.DFC_KRVEKOENCHMT3_CA DINH_Lim.DFC_KRVEKOENCHMT4_CA DINH_Lim.DFC_KRVEKOENCHMT5_CA DINH_Lim.DFC_KRVEKOENCHMT6_CA DINH_Lim.DFC_KRVEKOENCHMT7_CA DINH_Lim.DFC_KRVEKORLMX_CA DINH_Lim.DFC_KRVEKORLMXL_CA DINH_Lim.DFC_KS1max_CA DINH_Lim.DFC_KS1min_CA DINH_Lim.DFC_LMmax_CA DINH_Lim.DFC_LZSRnpl_CA DINH_Lim.DFC_LamDynDiagS1B1_CA DINH_Lim.DFC_LeakIntkMnfldEmiInfl_CA DINH_Lim.DFC_LinFrameErrDCDC_CA DINH_Lim.DFC_LinOverrunErrDCDC_CA DINH_Lim.DFC_MD00max_CA DINH_Lim.DFC_MDBmax_CA DINH_Lim.DFC_MDCat_CA DINH_Lim.DFC_MDCatCrit_CA DINH_Lim.DFC_MDCatCurr_CA DINH_Lim.DFC_MDCyl_0_CA DINH_Lim.DFC_MDCyl_1_CA DINH_Lim.DFC_MDCyl_2_CA DINH_Lim.DFC_MDCyl_3_CA DINH_Lim.DFC_MDEmi_CA DINH_Lim.DFC_MDEmiStrt_CA DINH_Lim.DFC_MDFco_CA DINH_Lim.DFC_MDMpl_CA DINH_Lim.DFC_MDSegTiAdpn_CA DINH_Lim.DFC_MDmax_CA DINH_Lim.DFC_MFuOilMax_CA DINH_Lim.DFC_MOXEMM_SMU_ALM0_0_CA DINH_Lim.DFC_MOXEMM_SMU_ALM0_1_CA DINH_Lim.DFC_MOXEMM_SMU_ALM0_10_CA DINH_Lim.DFC_MOXEMM_SMU_ALM0_11_CA DINH_Lim.DFC_MOXEMM_SMU_ALM0_13_CA DINH_Lim.DFC_MOXEMM_SMU_ALM0_14_CA DINH_Lim.DFC_MOXEMM_SMU_ALM0_2_CA DINH_Lim.DFC_MOXEMM_SMU_ALM0_22_CA DINH_Lim.DFC_MOXEMM_SMU_ALM0_23_CA DINH_Lim.DFC_MOXEMM_SMU_ALM0_4_CA DINH_Lim.DFC_MOXEMM_SMU_ALM0_5_CA DINH_Lim.DFC_MOXEMM_SMU_ALM0_7_CA DINH_Lim.DFC_MOXEMM_SMU_ALM0_8_CA DINH_Lim.DFC_MOXEMM_SMU_ALM10_16_CA DINH_Lim.DFC_MOXEMM_SMU_ALM10_17_CA DINH_Lim.DFC_MOXEMM_SMU_ALM10_21_CA DINH_Lim.DFC_MOXEMM_SMU_ALM11_0_CA DINH_Lim.DFC_MOXEMM_SMU_ALM11_1_CA DINH_Lim.DFC_MOXEMM_SMU_ALM11_2_CA DINH_Lim.DFC_MOXEMM_SMU_ALM11_3_CA DINH_Lim.DFC_MOXEMM_SMU_ALM11_4_CA DINH_Lim.DFC_MOXEMM_SMU_ALM11_5_CA DINH_Lim.DFC_MOXEMM_SMU_ALM11_8_CA DINH_Lim.DFC_MOXEMM_SMU_ALM11_9_CA DINH_Lim.DFC_MOXEMM_SMU_ALM1_0_CA DINH_Lim.DFC_MOXEMM_SMU_ALM1_1_CA DINH_Lim.DFC_MOXEMM_SMU_ALM1_10_CA DINH_Lim.DFC_MOXEMM_SMU_ALM1_11_CA DINH_Lim.DFC_MOXEMM_SMU_ALM1_13_CA DINH_Lim.DFC_MOXEMM_SMU_ALM1_14_CA DINH_Lim.DFC_MOXEMM_SMU_ALM1_2_CA DINH_Lim.DFC_MOXEMM_SMU_ALM1_22_CA DINH_Lim.DFC_MOXEMM_SMU_ALM1_23_CA DINH_Lim.DFC_MOXEMM_SMU_ALM1_4_CA DINH_Lim.DFC_MOXEMM_SMU_ALM1_5_CA DINH_Lim.DFC_MOXEMM_SMU_ALM1_7_CA DINH_Lim.DFC_MOXEMM_SMU_ALM1_8_CA DINH_Lim.DFC_MOXEMM_SMU_ALM21_0_CA DINH_Lim.DFC_MOXEMM_SMU_ALM21_16_CA DINH_Lim.DFC_MOXEMM_SMU_ALM21_3_CA DINH_Lim.DFC_MOXEMM_SMU_ALM2_1_CA DINH_Lim.DFC_MOXEMM_SMU_ALM2_10_CA DINH_Lim.DFC_MOXEMM_SMU_ALM2_11_CA DINH_Lim.DFC_MOXEMM_SMU_ALM2_13_CA DINH_Lim.DFC_MOXEMM_SMU_ALM2_14_CA DINH_Lim.DFC_MOXEMM_SMU_ALM2_22_CA DINH_Lim.DFC_MOXEMM_SMU_ALM2_23_CA DINH_Lim.DFC_MOXEMM_SMU_ALM2_4_CA DINH_Lim.DFC_MOXEMM_SMU_ALM2_5_CA DINH_Lim.DFC_MOXEMM_SMU_ALM2_7_CA DINH_Lim.DFC_MOXEMM_SMU_ALM2_8_CA DINH_Lim.DFC_MOXEMM_SMU_ALM6_0_CA DINH_Lim.DFC_MOXEMM_SMU_ALM6_11_CA DINH_Lim.DFC_MOXEMM_SMU_ALM6_12_CA DINH_Lim.DFC_MOXEMM_SMU_ALM6_14_CA DINH_Lim.DFC_MOXEMM_SMU_ALM6_15_CA DINH_Lim.DFC_MOXEMM_SMU_ALM6_17_CA DINH_Lim.DFC_MOXEMM_SMU_ALM6_18_CA DINH_Lim.DFC_MOXEMM_SMU_ALM6_20_CA DINH_Lim.DFC_MOXEMM_SMU_ALM6_21_CA DINH_Lim.DFC_MOXEMM_SMU_ALM6_25_CA DINH_Lim.DFC_MOXEMM_SMU_ALM6_4_CA DINH_Lim.DFC_MOXEMM_SMU_ALM6_5_CA DINH_Lim.DFC_MOXEMM_SMU_ALM6_7_CA DINH_Lim.DFC_MOXEMM_SMU_ALM6_8_CA DINH_Lim.DFC_MOXEMM_SMU_ALM7_1_CA DINH_Lim.DFC_MOXEMM_SMU_ALM7_12_CA DINH_Lim.DFC_MOXEMM_SMU_ALM7_13_CA DINH_Lim.DFC_MOXEMM_SMU_ALM7_14_CA DINH_Lim.DFC_MOXEMM_SMU_ALM7_15_CA DINH_Lim.DFC_MOXEMM_SMU_ALM7_16_CA DINH_Lim.DFC_MOXEMM_SMU_ALM7_17_CA DINH_Lim.DFC_MOXEMM_SMU_ALM7_2_CA DINH_Lim.DFC_MOXEMM_SMU_ALM7_20_CA DINH_Lim.DFC_MOXEMM_SMU_ALM7_25_CA DINH_Lim.DFC_MOXEMM_SMU_ALM7_26_CA DINH_Lim.DFC_MOXEMM_SMU_ALM7_28_CA DINH_Lim.DFC_MOXEMM_SMU_ALM7_29_CA DINH_Lim.DFC_MOXEMM_SMU_ALM7_30_CA DINH_Lim.DFC_MOXEMM_SMU_ALM7_31_CA DINH_Lim.DFC_MOXEMM_SMU_ALM8_0_CA DINH_Lim.DFC_MOXEMM_SMU_ALM8_1_CA DINH_Lim.DFC_MOXEMM_SMU_ALM8_10_CA DINH_Lim.DFC_MOXEMM_SMU_ALM8_11_CA DINH_Lim.DFC_MOXEMM_SMU_ALM8_12_CA DINH_Lim.DFC_MOXEMM_SMU_ALM8_16_CA DINH_Lim.DFC_MOXEMM_SMU_ALM8_18_CA DINH_Lim.DFC_MOXEMM_SMU_ALM8_2_CA DINH_Lim.DFC_MOXEMM_SMU_ALM8_3_CA DINH_Lim.DFC_MOXEMM_SMU_ALM8_31_CA DINH_Lim.DFC_MOXEMM_SMU_ALM8_4_CA DINH_Lim.DFC_MOXEMM_SMU_ALM9_0_CA DINH_Lim.DFC_MOXEMM_SMU_ALM9_15_CA DINH_Lim.DFC_MOXEMM_SMU_ALM9_3_CA DINH_Lim.DFC_MoCADCNTP_CA DINH_Lim.DFC_MoCADCTst_CA DINH_Lim.DFC_MoCSOPICO_CA DINH_Lim.DFC_MoFAPP_CA DINH_Lim.DFC_MoFAirFilgPrdc_CA DINH_Lim.DFC_MoFAirFlCtOffGdi_CA DINH_Lim.DFC_MoFAirFlCylGdi_CA DINH_Lim.DFC_MoFAirFlFF_CA DINH_Lim.DFC_MoFAirFlIn_CA DINH_Lim.DFC_MoFAirFlMixCtlGdiChkAirFl_CA DINH_Lim.DFC_MoFAirFlMixCtlGdiChkCtrl_CA DINH_Lim.DFC_MoFAirFlMode_CA DINH_Lim.DFC_MoFESpd_CA DINH_Lim.DFC_MoFIACo_CA DINH_Lim.DFC_MoFICOL1_CA DINH_Lim.DFC_MoFICOL2_CA DINH_Lim.DFC_MoFStrt_CA DINH_Lim.DFC_MoFTrqCmp_CA DINH_Lim.DFC_MoFTrqCmpMax_CA DINH_Lim.DFC_MoFTrqCmpMin_CA DINH_Lim.DFC_MoFVarPostBldSel_CA DINH_Lim.DFC_MoXEMMHwLTMCUFW_CA DINH_Lim.DFC_MoXEMMHwLTMonBIST_CA DINH_Lim.DFC_MoXEMMHwLTRegMonTest_CA DINH_Lim.DFC_MoXEMMHwLTStbySMUAlvTest_CA DINH_Lim.DFC_MoXEMMHwLTTempSens_CA DINH_Lim.DFC_MoXEMMHwLTUCBCfg_CA DINH_Lim.DFC_NWSEmax_CA DINH_Lim.DFC_NWSmax_CA DINH_Lim.DFC_OCWDAABEActv_CA DINH_Lim.DFC_OCWDACom_CA DINH_Lim.DFC_OCWDAErrPin_CA DINH_Lim.DFC_OCWDAOvrVltg_CA DINH_Lim.DFC_ORAmax_CA DINH_Lim.DFC_ORAmin_CA DINH_Lim.DFC_OilPPlaus_CA DINH_Lim.DFC_PLLSUmax_CA DINH_Lim.DFC_PLLSUmin_CA DINH_Lim.DFC_PSR1max_CA DINH_Lim.DFC_PSRBmax_CA DINH_Lim.DFC_PSRBmin_CA DINH_Lim.DFC_PSRPmax_CA DINH_Lim.DFC_PSRPmin_CA DINH_Lim.DFC_PSRPsig_CA DINH_Lim.DFC_PSRmax_CA DINH_Lim.DFC_PUmax_CA DINH_Lim.DFC_P_VSE11_OL_CA DINH_Lim.DFC_P_VSE11_SCB_CA DINH_Lim.DFC_P_VSE11_SCG_CA DINH_Lim.DFC_PhyHighAPP1_CA DINH_Lim.DFC_PhyHighAPP2_CA DINH_Lim.DFC_PhyLowAPP1_CA DINH_Lim.DFC_PhyLowAPP2_CA DINH_Lim.DFC_SRCHighAPP1_CA DINH_Lim.DFC_SRCHighAPP2_CA DINH_Lim.DFC_SRCLowAPP1_CA DINH_Lim.DFC_SRCLowAPP2_CA DINH_Lim.DFC_SSpMon2_CA DINH_Lim.DFC_STHDRmax_CA DINH_Lim.DFC_SWReset_0_CA DINH_Lim.DFC_SWReset_1_CA DINH_Lim.DFC_SWReset_2_CA DINH_Lim.DFC_SyncAPP_CA DINH_Lim.DFC_TANKLnpl_CA DINH_Lim.DFC_TAmax_Dummy_CA DINH_Lim.DFC_TESFmax_CA DINH_Lim.DFC_TESGmax_CA DINH_Lim.DFC_TKAEmax_CA DINH_Lim.DFC_TKAEmin_CA DINH_Lim.DFC_TKARmax_CA DINH_Lim.DFC_TKARnpl_CA DINH_Lim.DFC_TMmax_Dummy_CA DINH_Lim.DFC_TUMmax_Dummy_CA DINH_Lim.DFC_TWCDPriCatB1_CA DINH_Lim.DFC_ThrVlvClsdPosnFirstOffsLrnImpoB1_CA DINH_Lim.DFC_ThrVlvClsdPosnOffsLrnImpoB1_CA DINH_Lim.DFC_ThrVlvClsdPosnOffsLrnMaxB1_CA DINH_Lim.DFC_ThrVlvClsdPosnOffsLrnMinB1_CA DINH_Lim.DFC_ThrVlvCtrlDeB1_CA DINH_Lim.DFC_ThrVlvDycB1_CA DINH_Lim.DFC_ThrVlvLimpAirPosnMaxAbsltDriftB1_CA DINH_Lim.DFC_ThrVlvLimpAirPosnMaxB1_CA DINH_Lim.DFC_ThrVlvLimpAirPosnMaxRelDriftB1_CA DINH_Lim.DFC_ThrVlvLimpAirPosnMinB1_CA DINH_Lim.DFC_ThrVlvOpenLoadB1_CA DINH_Lim.DFC_ThrVlvOpenSprgB1_CA DINH_Lim.DFC_ThrVlvOpenSprgSprdB1_CA DINH_Lim.DFC_ThrVlvOpenSprgTwnB1_CA DINH_Lim.DFC_ThrVlvOverTB1_CA DINH_Lim.DFC_ThrVlvRetSprgB1_CA DINH_Lim.DFC_ThrVlvRetSprgSprdB1_CA DINH_Lim.DFC_ThrVlvRetSprgTwnB1_CA DINH_Lim.DFC_ThrVlvSens1MaxB1_CA DINH_Lim.DFC_ThrVlvSens1NplB1_CA DINH_Lim.DFC_ThrVlvSens2MaxB1_CA DINH_Lim.DFC_ThrVlvSens2MinB1_CA DINH_Lim.DFC_ThrVlvSens2NplB1_CA DINH_Lim.DFC_ThrVlvShoCircB1_CA DINH_Lim.DFC_ThrVlvSpiErrB1_CA DINH_Lim.DFC_ThrvlvSens1MinB1_CA DINH_Lim.DFC_TiOffTBasdChkFast_CA DINH_Lim.DFC_TiOffTBasdChkSlow_CA DINH_Lim.DFC_UEGOSnsrMntdS1B1_CA DINH_Lim.DFC_VehVSig_CA DINH_Lim.DFC_VlvLftFbSwtIntk11SpclFail_CA DINH_Lim.DFC_VlvLftFbSwtIntk11StdFail_CA DINH_Lim.DSQ_ACClntP_CA DINH_Lim.DSQ_ACEvpT_CA DINH_Lim.DSQ_AirCCmprActr_CA DINH_Lim.DSQ_BattU_CA DINH_Lim.DSQ_BattULo_CA DINH_Lim.DSQ_BrkBstPMdl_CA DINH_Lim.DSQ_BrkP_CA DINH_Lim.DSQ_BrkPSnsr_CA DINH_Lim.DSQ_CoVMDIDASFail_CA DINH_Lim.DSQ_DSMInhibitAlways_CA DINH_Lim.DSQ_EGRVlv_GovDesVal_CA DINH_Lim.DSQ_ElecLd_CA DINH_Lim.DSQ_EngICO_CA DINH_Lim.DSQ_EpmCaSSigQuality_CA DINH_Lim.DSQ_EpmReverseRun_CA DINH_Lim.DSQ_FanDIO_0_CA DINH_Lim.DSQ_FanDIO_1_CA DINH_Lim.DSQ_FuelP_CA DINH_Lim.DSQ_FuelT_CA DINH_Lim.DSQ_GEVCtlTOilCylHd_CA DINH_Lim.DSQ_GEVlvAgIntkB1_CA DINH_Lim.DSQ_GbxPNPos_CA DINH_Lim.DSQ_GbxPosNotPN_CA DINH_Lim.DSQ_InjVlv_DI_CylOk_CA DINH_Lim.DSQ_MRly_CA DINH_Lim.DSQ_OilP_CA DINH_Lim.DSQ_PEnvMeasVld_CA DINH_Lim.DSQ_PEnvVld_CA DINH_Lim.DSQ_PEnv_pRaw_CA DINH_Lim.DSQ_PRail_CA DINH_Lim.DSQ_PThrVlvUs_CA DINH_Lim.DSQ_PThrVlvUsB1_CA DINH_Lim.DSQ_StrtImobChk_CA DINH_Lim.DSQ_TDevCenColdStrt_CA DINH_Lim.DSQ_VehV_CA DINH_Lim.DSQ_VehVSens_CA DINH_Lim.DSQ_VehVSnsr_CA DINH_Lim.DSQ_stAPP_CA DINH_Lim.DSQ_stComEAT4_CA DINH_tiUpdObsv_C DINH_xFIDObsv_C /end DEF_CHARACTERISTIC
 FUNCTION_VERSION "30000.27.0_1.0.0" /end FUNCTION
/begin COMPU_METHOD DINH_FIdVerb "" TAB_VERB "%6.3" "-" COMPU_TAB_REF DINH_FIdVerb /end COMPU_METHOD
/begin COMPU_VTAB DINH_FIdVerb "" TAB_VERB 969 0 "FId_Unused" 1 "FID_AFRA" 2 "FID_AORA" 3 "FID_ATEH" 4 "FID_ATEL" 5 "FID_ATEN" 6 "FID_ATLDI" 7 "FID_ATLDO" 8 "FID_BEONV" 9 "FId_EGSDCmnSeg1B1Parl" 10 "FID_BAGRA" 11 "FID_BAGRASD" 12 "FID_BDSTOF" 13 "FID_BFVDFRM" 14 "FID_BHOM" 15 "FID_BLLRH" 16 "FID_BLLRKH" 17 "FID_BPLSU" 18 "FID_FRAMBAVMB" 19 "FId_CatHeatgColdStrtReq" 20 "FId_CatHeatgWrmReq" 21 "FId_DSMBDEPHSpOpMode" 22 "FId_EGRVlvCoord" 23 "FId_EGSDO2FuTrmB1" 24 "FId_EGSDO2SnsrMntdRelsS1B1" 25 "FId_EGSDO2_LamOffsFastS1B1" 26 "FId_MisfDetDnAdpnNv" 27 "FId_bascadpncvo" 28 "FID_AGRS" 29 "FID_BBAGR" 30 "FID_BBAGRA" 31 "FID_BGFKMS" 32 "FID_BGMSDKS" 33 "FID_CAGRSUS" 34 "FID_CBGTFUELM" 35 "FID_CBGTHDEV" 36 "FID_CDESVF" 37 "FID_CDETHS" 38 "FID_CDRCTSTRT" 39 "FID_CDSKV" 40 "FID_CDSKVRNO" 41 "FID_CDSKVRPO" 42 "FID_CDSKVRaty" 43 "FID_CDSKVRng" 44 "FID_CDSKVS" 45 "FID_CDSTR" 46 "FID_CDSTTI" 47 "FID_CETHG" 48 "FID_CETHSPLnpl" 49 "FID_CETHSTPLnpl" 50 "FID_CETKHL" 51 "FID_CETKHT" 52 "FID_CGDISTRT" 53 "FID_CGLSRDP" 54 "FID_CHDR" 55 "FID_CHDRKH" 56 "FID_CHDRPL" 57 "FID_CLLKHV" 58 "FID_CLLRHV" 59 "FID_CLZSRDP" 60 "FID_CLZSRHP" 61 "FID_CNLHP" 62 "FID_CNLHP2" 63 "FID_CNLKO2" 64 "FID_CNLKO3" 65 "FID_CNLLP" 66 "FID_CNLPL" 67 "FID_CNLPS" 68 "FID_CNSAD" 69 "FID_CNSAD2" 70 "FID_CPSRB" 71 "FID_CPSRP" 72 "FID_CSTHDR" 73 "FID_CSTRTCTL" 74 "FID_CTESF" 75 "FID_CTESG" 76 "FID_CTHIPSTRT" 77 "FID_CTKACS" 78 "FID_CTMSV" 79 "FID_CTOSP" 80 "FID_DHFERR" 81 "FID_DKRSA" 82 "FID_DLLRBandEndTst" 83 "FID_DLLRShrtTrpSpdRmp" 84 "FID_FEDKAHB" 85 "FID_FEDKAPB" 86 "FID_FEDSSB" 87 "FID_FOFSTP" 88 "FID_FONSTP" 89 "FID_FUEDK" 90 "FID_FVLRA" 91 "FID_KRREGact" 92 "FID_KRREGloc" 93 "FID_LRADLSU" 94 "FID_LRALSVErr" 95 "FID_LRAPLLSU" 96 "FID_LUSTP" 97 "FID_LnKS1" 98 "FID_PLSUV" 99 "FID_PSRMOZDG" 100 "FID_PSRMOZG" 101 "FID_STRTDIA" 102 "FID_STRTSTM" 103 "FID_TFA1CSMW" 104 "FID_TFA2CSMW" 105 "FID_TKACSMW" 106 "FID_TMCSMW" 107 "FID_TOCHOilSwmpTQly" 108 "FID_TOCHTME" 109 "FID_TOSPCSMW" 110 "FID_TSRLX" 111 "FID_UEGOHeatrRlyS1B1" 112 "FID_VehStvSSEOk" 113 "FID_VldtLamPlausMaxS1B1" 114 "FID_VldtLamPlausMinS1B1" 115 "FId_ACClntPSSPMon" 116 "FId_ACCompComCANBusOff" 117 "FId_ACCompComCANErrMtr" 118 "FId_ACComp_HiUTWSnsrErr" 119 "FId_ACComp_LoUTWSnsrErr" 120 "FId_ACComp_PDSnsrErr" 121 "FId_ACComp_VehSpdSnsrErr" 122 "FId_ACCtl_ACStrtCut" 123 "FId_ACCtl_APP1" 124 "FId_ACCtl_APP2" 125 "FId_ACCtl_APPSync" 126 "FId_ACCtl_AcOff" 127 "FId_ACCtl_Clmb" 128 "FId_ACCtl_DK1" 129 "FId_ACCtl_DK2" 130 "FId_ACCtl_DKSync" 131 "FId_ACCtl_VehSpdSnsrErr" 132 "FId_ACCtl_pAC" 133 "FId_ACEvpTCANErr" 134 "FId_ACEvpTFrzVal" 135 "FId_ACEvpTPhysRng" 136 "FId_ACEvpTRplVal" 137 "FId_AFCLFailr" 138 "FId_AFS" 139 "FId_AFSPhyRng" 140 "FId_APP1SigPath" 141 "FId_APP2SigPath" 142 "FId_APPBrkErr" 143 "FId_APPLETVldnErr" 144 "FId_APPLrn" 145 "FId_APPVehVErr" 146 "FId_AccPedDrvModComErr" 147 "FId_AccPedDrvModFailr" 148 "FId_AccPedNMaxLim" 149 "FId_AccPedNMinLim" 150 "FId_AccPedNMinLimBrkApp" 151 "FId_AccPedTrqLim" 152 "FId_AfsDdDiag" 153 "FId_AfsDiagErr" 154 "FId_AfsDiagTst" 155 "FId_AfsPlausDiag" 156 "FId_AfsVrntDiag" 157 "FId_AirCClntPFrzVal" 158 "FId_AirCClntPRplVal" 159 "FId_AirCSwt" 160 "FId_AirDvPAdpnPEnv" 161 "FId_AirDvPAdpnPIntkVUsB1" 162 "FId_AirDvPPSnsrAdpn_PModeActv" 163 "FId_AltACGFailr" 164 "FId_AltAPPErrSt" 165 "FId_AltBattMngtFailr" 166 "FId_AltBrkErrSt" 167 "FId_AltComErr" 168 "FId_AltENGB" 169 "FId_AltElecLoadErr" 170 "FId_AltEnvTErr" 171 "FId_AltFFAltLoadFast" 172 "FId_AltFFAltLoadSlow" 173 "FId_AltIOACGErr" 174 "FId_AltIOACGLinComFailr" 175 "FId_AltIOComErr" 176 "FId_AltLinErr" 177 "FId_AltPwr" 178 "FId_AltVehVErrSt" 179 "FId_AltvCluFail" 180 "FId_BGAGRTS" 181 "FId_BGFKMSEPSR" 182 "FId_BGFKMSEPU" 183 "FId_BGFKMSESumClr" 184 "FId_BGFKMSHFME" 185 "FId_BGFKMSHFMZ" 186 "FId_BGFKMSZPSR" 187 "FId_BGOSCCat1B1" 188 "FId_BGOSCCat2B1" 189 "FId_BattAltFailr" 190 "FId_BattMngtFailr" 191 "FId_BattSigPtd" 192 "FId_BattU2MEDSRC" 193 "FId_BattUDrpPrvOff" 194 "FId_BattUFrzVal" 195 "FId_BattUHiFailrEna" 196 "FId_BattUIMGTCUCANFailr" 197 "FId_BattULoFailrEna" 198 "FId_BattUReplVal" 199 "FId_BattUSRC" 200 "FId_BlwrComErr" 201 "FId_BrkBstMdl" 202 "FId_BrkBstMdlBrkP" 203 "FId_BrkBstMdlBrkSt" 204 "FId_BrkBstMdlEnvP" 205 "FId_BrkBstPDetnInhbn" 206 "FId_BrkBstPMstCylPSnsrFail" 207 "FId_BrkBstPSnsrStuckDetn" 208 "FId_BrkBstSigPath" 209 "FId_BrkBstVehVv" 210 "FId_BrkMnSwtErr" 211 "FId_BrkPFrzVal" 212 "FId_BrkPOilPres" 213 "FId_BrkPReplVal" 214 "FId_BrkPedEngStopEna" 215 "FId_BrkRdntSwtErr" 216 "FId_CAGRSDS" 217 "FId_CEngDsTColdStrt" 218 "FId_CEngDsTColdStrtErr" 219 "FId_CEngDsTHSC" 220 "FId_CEngDsTLSC" 221 "FId_CEngDsTPlausErr" 222 "FId_CEngDsTReplMdlEngStop" 223 "FId_CEngDsTSTC" 224 "FId_CEngDsTSnsrElec" 225 "FId_CEngDsTSwtReplMdl" 226 "FId_CEngUsTColdChkErr" 227 "FId_CEngUsTCrssChk" 228 "FId_CEngUsTElecErr" 229 "FId_CEngUsTSnsrElecErr" 230 "FId_CEngUsTSwtReplMdl" 231 "FId_CInjCatHeatgDiag" 232 "FId_CMSUDKSOM1" 233 "FId_CMSUDKSOM2" 234 "FId_CatHeatgEomShtrpAct" 235 "FId_ChrctlAgrsErr" 236 "FId_ChrctlAgrscf" 237 "FId_ClntTempENGB" 238 "FId_Clth" 239 "FId_Clth2" 240 "FId_Clth3StuckOn" 241 "FId_Clth4" 242 "FId_ClthCAN" 243 "FId_ClthMax" 244 "FId_ClthStk" 245 "FId_ClthStkErr" 246 "FId_ClthStkFailr" 247 "FId_ClthStkOFFStuck" 248 "FId_ClthStkONStuck" 249 "FId_ClthSwtFailr" 250 "FId_CntrShaftFailr" 251 "FId_CoEOMGdiEomErrLcy" 252 "FId_CoESSBlowrVld" 253 "FId_CoETM" 254 "FId_CoETS_StTrqLimErr1" 255 "FId_CoETS_StTrqLimErr2" 256 "FId_CoEngStopEnblStSpEngT" 257 "FId_CoEngStopEnblStSpLSU" 258 "FId_CoEngStopEnblStSpTcT" 259 "FId_CoEngStopEnblSysErr" 260 "FId_CoEngVlvLftSpIntk" 261 "FId_CoPOMStrtgDevStrtr" 262 "FId_CoPOM_FirstStrtAut" 263 "FId_CoTS_SwtOff" 264 "FId_CoVOMACCComFailr" 265 "FId_CoVOMBrkPedISABSigFailr" 266 "FId_CoVOMEngCrkAbort" 267 "FId_CoVOMEngRstrtEnaCdn" 268 "FId_CoVOMISSEng" 269 "FId_ComACRly" 270 "FId_ComAPPSensFail" 271 "FId_ComAPedl" 272 "FId_ComAYCA" 273 "FId_ComAYCAMon" 274 "FId_ComAYCD" 275 "FId_ComAYCDMon" 276 "FId_ComAYCF" 277 "FId_ComAYCFMon" 278 "FId_ComAYCG" 279 "FId_ComAYCGMon" 280 "FId_ComAYCI" 281 "FId_ComAYCIMon" 282 "FId_ComAirPThrUsSnsrErr" 283 "FId_ComAltFail" 284 "FId_ComAppVehSnsrFailr" 285 "FId_ComBCM1" 286 "FId_ComBCM1Mon" 287 "FId_ComBCMUnitCfmdErr" 288 "FId_ComBCMUnitNotTstd" 289 "FId_ComBstCtrl" 290 "FId_ComCANVEHICLEBusOff" 291 "FId_ComCGW1" 292 "FId_ComCGW1Mon" 293 "FId_ComClthSt" 294 "FId_ComConvClth" 295 "FId_ComCrCtlReq" 296 "FId_ComCrsMaiIndcnLampReq" 297 "FId_ComCrsSetIndcnLampReq" 298 "FId_ComDCDCCdn" 299 "FId_ComDCDCErr" 300 "FId_ComDesGearCurr" 301 "FId_ComDetrmAirM" 302 "FId_ComDwnShiftCtrlReq" 303 "FId_ComEAT1" 304 "FId_ComEAT10" 305 "FId_ComEAT10Mon" 306 "FId_ComEAT11" 307 "FId_ComEAT11Mon" 308 "FId_ComEAT12" 309 "FId_ComEAT12Mon" 310 "FId_ComEAT13" 311 "FId_ComEAT13Mon" 312 "FId_ComEAT1Mon" 313 "FId_ComEAT2" 314 "FId_ComEAT2Mon" 315 "FId_ComEAT4" 316 "FId_ComEAT4Mon" 317 "FId_ComEAT6" 318 "FId_ComEAT6Mon" 319 "FId_ComEAT7" 320 "FId_ComEAT7Mon" 321 "FId_ComEAT8" 322 "FId_ComEAT8Mon" 323 "FId_ComEATA" 324 "FId_ComEATAMon" 325 "FId_ComEATB" 326 "FId_ComEATBMon" 327 "FId_ComEATC" 328 "FId_ComEATCMon" 329 "FId_ComEBSSelfDiagErr" 330 "FId_ComECUHwErr" 331 "FId_ComEGRVlvErr" 332 "FId_ComEMSIntAirTemp" 333 "FId_ComEPB" 334 "FId_ComEPBB" 335 "FId_ComEPBBMon" 336 "FId_ComEPBMon" 337 "FId_ComEPS1" 338 "FId_ComEPS1Mon" 339 "FId_ComEPSUnitCfmdErr" 340 "FId_ComEPSUnitNotTstd" 341 "FId_ComEngBrkOvrdInfo" 342 "FId_ComEngBrkOvrdMtr" 343 "FId_ComEngBrkSwErr" 344 "FId_ComEngPosng" 345 "FId_ComEngRPMLim" 346 "FId_ComEngTrqLim" 347 "FId_ComEnvtlAirPSnsrErr" 348 "FId_ComEstmTqNormJdg" 349 "FId_ComEthnlSErr" 350 "FId_ComFlSply" 351 "FId_ComFuCnsBitDurgIdleStop" 352 "FId_ComGEVCntrl" 353 "FId_ComGbxNPosFail" 354 "FId_ComGbxTemp" 355 "FId_ComGwIMG1" 356 "FId_ComGwIMG1Mon" 357 "FId_ComGwIMG3" 358 "FId_ComGwIMG3Mon" 359 "FId_ComGwIMG4" 360 "FId_ComGwIMG4Mon" 361 "FId_ComGwIMG5" 362 "FId_ComGwIMG5Mon" 363 "FId_ComGwIMG6" 364 "FId_ComGwIMG6Mon" 365 "FId_ComHFMSnsrErr" 366 "FId_ComIDASB" 367 "FId_ComIDASBMon" 368 "FId_ComIDASBUnitCfmdErr" 369 "FId_ComIDASBUnitNotTstd" 370 "FId_ComIDASEngFail" 371 "FId_ComIDASEngFailMil" 372 "FId_ComIMGUnitCfmdErr" 373 "FId_ComIMGUnitNotTstd" 374 "FId_ComISG2" 375 "FId_ComIgnCtrl" 376 "FId_ComInjCtrl" 377 "FId_ComIntkAirPSnsrErr" 378 "FId_ComLamCtrl" 379 "FId_ComMETA" 380 "FId_ComMETAMon" 381 "FId_ComMETC" 382 "FId_ComMETCMon" 383 "FId_ComMETD" 384 "FId_ComMETDMon" 385 "FId_ComMETE2" 386 "FId_ComMETE2Mon" 387 "FId_ComMETF" 388 "FId_ComMETFMon" 389 "FId_ComMETG" 390 "FId_ComMETGMon" 391 "FId_ComMETH" 392 "FId_ComMETH2" 393 "FId_ComMETH2Mon" 394 "FId_ComMETHMon" 395 "FId_ComMETI" 396 "FId_ComMETIMon" 397 "FId_ComMETK" 398 "FId_ComMETKMon" 399 "FId_ComMETL" 400 "FId_ComMETLMon" 401 "FId_ComMETM" 402 "FId_ComMETMMon" 403 "FId_ComMETN" 404 "FId_ComMETNMon" 405 "FId_ComMETUnitCfmdErr" 406 "FId_ComMETUnitNotTstd" 407 "FId_ComMisf" 408 "FId_ComMon" 409 "FId_ComNTrbn" 410 "FId_ComODOff" 411 "FId_ComOilLvlLamp" 412 "FId_ComOilPWarnLamp" 413 "FId_ComPASensFail" 414 "FId_ComPBSensFail" 415 "FId_ComPCU" 416 "FId_ComPCUMon" 417 "FId_ComPosActnSpdLimrFctReq" 418 "FId_ComSRS" 419 "FId_ComSRSA" 420 "FId_ComSRSAMon" 421 "FId_ComSRSB" 422 "FId_ComSRSBMon" 423 "FId_ComSRSMon" 424 "FId_ComSRSUnitCfmdErr" 425 "FId_ComSRSUnitNotTstd" 426 "FId_ComSTFlt" 427 "FId_ComSpdLimrDevActvn" 428 "FId_ComTCU01" 429 "FId_ComTCU02" 430 "FId_ComTCU1" 431 "FId_ComTCU11" 432 "FId_ComTCU12" 433 "FId_ComTCU13" 434 "FId_ComTCU14" 435 "FId_ComTCU2" 436 "FId_ComTCU3" 437 "FId_ComTCU4" 438 "FId_ComTCUGear" 439 "FId_ComTarGearDwnShift" 440 "FId_ComTarGearUpShift" 441 "FId_ComThrPosnFail" 442 "FId_ComThrVlv" 443 "FId_ComTrboChrgnErr" 444 "FId_ComTrqAccuracySlow" 445 "FId_ComTrqReqFast" 446 "FId_ComTrqReqSlow" 447 "FId_ComVSAErr" 448 "FId_ComVSAUnitCfmdErr" 449 "FId_ComVSAUnitNotTstd" 450 "FId_ComVehSpdFlLvl" 451 "FId_ComVehSpdFltChk" 452 "FId_ComVehSpdImpsErr" 453 "FId_ComVlvLftCtrl" 454 "FId_ComvolEng" 455 "FId_ConvLdCalcLvrPos" 456 "FId_ConvLdNTrbnCan" 457 "FId_ConvLdOilCoolrPmp" 458 "FId_ConvLdOilTemp" 459 "FId_ConvLdTrqLdCan" 460 "FId_ConvLdVel" 461 "FId_CooltTVldyTMdl" 462 "FId_CptProtnCamsft" 463 "FId_CptProtnExhTempMdl" 464 "FId_CptProtnO2SnsrB1" 465 "FId_CptProtnVVeh" 466 "FId_CrCUI1EFRxErr" 467 "FId_CrCUICANRxErr" 468 "FId_CrCUIFCMRxErr" 469 "FId_CrCUIMETDRxErr" 470 "FId_CrCtlACCRxErr" 471 "FId_CrCtlAppSnsrErr" 472 "FId_CrCtlShutOffEng" 473 "FId_CstrPurgGnrlTstrReq" 474 "FId_DAGRS" 475 "FId_DELibBrkBstP" 476 "FId_DELibCEngDsT" 477 "FId_DELibCEngUsT" 478 "FId_DELibEngDatEng" 479 "FId_DELibEnvP" 480 "FId_DELibEnvT" 481 "FId_DELibFuelT" 482 "FId_DELibIntkAirT" 483 "FId_DELibNRCat" 484 "FId_DELibOilP" 485 "FId_DELibOilSwmpT" 486 "FId_DELibPRelPfilDs" 487 "FId_DELibTEGRClrLPDs" 488 "FId_DEONVEBPEnv" 489 "FId_DEONVTCCpv1DteskLoLoadStuckClsd" 490 "FId_DEONVTCCpv1DteskLoLoadStuckOpen" 491 "FId_DIUMPRCldStrtMon" 492 "FId_DIUMPREvapMon" 493 "FId_DIUMPRGenDenom1" 494 "FId_DIUMPRGenDenom1PDTC" 495 "FId_DIUMPRGenDenom2" 496 "FId_DIUMPRGenDenom3" 497 "FId_DIUMPRIgn" 498 "FId_DOGov" 499 "FId_DSMWarmUpCycle" 500 "FId_DTESKEBCpv1DteskLoLoadStuckClsd" 501 "FId_DTESKEBCpv1DteskLoLoadStuckOpen" 502 "FId_DTESKEnvCondVld" 503 "FId_DTESKFuLvlCondVld" 504 "FId_DTESKvfz" 505 "FId_DdskvFraTstd" 506 "FId_DdskvOraTstd" 507 "FId_DewDetTKAMax" 508 "FId_DiagBlkdLine" 509 "FId_DiagCpv1DteskLoLoad" 510 "FId_DkrsaEpmNoSig" 511 "FId_EBBCANErrFrzVal" 512 "FId_EBBCANErrReplVal" 513 "FId_EGLZSR" 514 "FId_EGRVlvActrOff" 515 "FId_EGRVlvCldStrt" 516 "FId_EGRVlvClnVrfy" 517 "FId_EGRVlvCtrlErr" 518 "FId_EGRVlvEngTempDef" 519 "FId_EGRVlvFailSafeActv" 520 "FId_EGRVlvFrzVal" 521 "FId_EGRVlvGovOn" 522 "FId_EGRVlvGovOnCld" 523 "FId_EGRVlvGovrOnRelsFct" 524 "FId_EGRVlvILimn" 525 "FId_EGRVlvIni" 526 "FId_EGRVlvMon" 527 "FId_EGRVlvOfsLrnInhib" 528 "FId_EGRVlvPhysRng" 529 "FId_EGRVlvPsSwtOff" 530 "FId_EGRVlvPwrStgMonDis" 531 "FId_EGRVlvRplVal" 532 "FId_EGRVlvSSpMon" 533 "FId_EGRVlvSnsrErr" 534 "FId_EGRVlvTempCmp" 535 "FId_EGRVlvTempMdlEEPErr" 536 "FId_EGRVlvTmpErrCnt" 537 "FId_EGRVlvTrlPtr" 538 "FId_EGRVlv_VehvErr" 539 "FId_EGRVlviActIEfcLimn" 540 "FId_EGRVlvpDsbcInvld" 541 "FId_EGSDO2OffsRstDsmS1B1" 542 "FId_EGSDO2_LamOffsSlowS1" 543 "FId_EGSDO2_RstFltSuspcnOffsB1" 544 "FId_EGSDUS2B1DlyEvln" 545 "FId_EGSDUS2B1LtrDly" 546 "FId_EGSDUS2B1LtrPT1" 547 "FId_EGSDUS2B1PT1Evln" 548 "FId_EGSDUS2B1RtlDly" 549 "FId_EGSDUS2B1RtlPT1" 550 "FId_EGSDUS2B1TarEvln" 551 "FId_EGSDUS2B1TarLean" 552 "FId_EGSDUS2B1TarRich" 553 "FId_EGSSigO2S1B1" 554 "FId_ELZSR" 555 "FId_EPBErr" 556 "FId_EPBFrmErr" 557 "FId_EPBFrmErrClth" 558 "FId_ETHSCPErrDrvCyc" 559 "FId_EVPComFailr" 560 "FId_EbsLinErr" 561 "FId_ElecLdComErr" 562 "FId_ElecLdFrzVal" 563 "FId_ElecLdHdLiComErr" 564 "FId_ElecLdRplVal" 565 "FId_ElecLoadEPSComErr" 566 "FId_EngBlkTWrn" 567 "FId_EngCooltTFail" 568 "FId_EngDemTqLimnCamsftErr" 569 "FId_EngDemTqLimnErrThmstHeatCtrlCirc" 570 "FId_EngDemTqLimnOilPmp" 571 "FId_EngDemTrqLimErrAPP" 572 "FId_EngIntkAirFail" 573 "FId_EngPrtErrVehV" 574 "FId_EngSpd30DegFail" 575 "FId_EngStrtEnaEthAdap" 576 "FId_EngStrt_EnaCep" 577 "FId_EngStrt_InjProhb" 578 "FId_EngStrt_VehVInhb" 579 "FId_EngTqRvsnEnaFlg" 580 "FId_EnvTPrimMod" 581 "FId_EnvTPrimModIniVal" 582 "FId_EnvTSensSum" 583 "FId_EnvTtAirFltDs" 584 "FId_EnvTtCEngDsT" 585 "FId_EnvTtIntkMnfld" 586 "FId_EomCvoAllwd" 587 "FId_EpmBCr" 588 "FId_EpmCaSAdapCaSI1" 589 "FId_EpmCaSAdapRstI1" 590 "FId_EpmCaSDiagI1" 591 "FId_EpmCaSErrCaSI1" 592 "FId_EpmCaSOfsDiagCaSI1" 593 "FId_EpmCaSOfsErrCaSI1" 594 "FId_EpmCaSSegI1" 595 "FId_EpmCaSSpdPlausI1" 596 "FId_EpmCrSDiag" 597 "FId_EpmCrSDiagVeh" 598 "FId_EpmCrSErr" 599 "FId_EpmOpMode_ALELock" 600 "FId_EpmOpMode_DirStLock" 601 "FId_EpmRRSCrSFaultCheck" 602 "FId_EpmRRSDGIFaultCheck" 603 "FId_EpmRRSRdCheck" 604 "FId_EpmRRSVehVFaultChck" 605 "FId_EpmSynLockCaSSync" 606 "FId_EpmTmpSuppRvsRotCASI1" 607 "FId_EtaEngIdleNonCsers" 608 "FId_EtaEngPtlNonCsers" 609 "FId_EthnlSnsrErrCdn" 610 "FId_EvapActrCcvElecDiag" 611 "FId_EvapPSnsrTankPhyRngChk" 612 "FId_FanCtlACClntP" 613 "FId_FanCtlACGModFail" 614 "FId_FanCtlAPP1" 615 "FId_FanCtlAPP2" 616 "FId_FanCtlAPPSync" 617 "FId_FanCtlBlowrU" 618 "FId_FanCtlCooltT" 619 "FId_FanCtlCooltT2" 620 "FId_FanCtlEnvT" 621 "FId_FanCtlLiSwtInfo" 622 "FId_FanCtlSpd" 623 "FId_FanCtlTSnsrErr" 624 "FId_FanCtlThr1" 625 "FId_FanCtlThr2" 626 "FId_FcoReq" 627 "FId_FiMFID_rba_MRly_Diag_Stk" 628 "FId_FlComErr" 629 "FId_FlDevPlauDiagFuSnsr" 630 "FId_FlLvlNoSigErr" 631 "FId_FlLvlVehSpdSigErr" 632 "FId_FlLvlVehVErr" 633 "FId_FlMALamDynDiag" 634 "FId_FlSplGAltLin" 635 "FId_FlTnkQnt" 636 "FId_FuMixHotFilmErr" 637 "FId_FuMixUegoErrExcl" 638 "FId_FuPHiRailEthnlSnsrErr" 639 "FId_FuPurg_TEVError" 640 "FId_FuSnsrPhyRngErr" 641 "FId_GEVCtlAVCAdprCBBNWEErrIntk" 642 "FId_GEVCtlAVCAdprIntkB1" 643 "FId_GEVCtlAVCAdprNWSEErrIntk" 644 "FId_GEVCtlAdpnEnaIntk" 645 "FId_GEVCtlAdpnEnaShtrpActv" 646 "FId_GEVCtlClngIntk" 647 "FId_GEVCtlMinOvlIntk" 648 "FId_GEVCtlPOilSnsr" 649 "FId_GEVCtlPhaEnaIntk" 650 "FId_GEVCtlPhaSpTstrIntk" 651 "FId_GEVCtlRefAdpnMntChck" 652 "FId_GEVCtlRefAdpnMntChckTstd" 653 "FId_GEVCtlReqRefAdpnTstrIntk" 654 "FId_GEVCtlReqRefAdpnTstrIntkTstd" 655 "FId_GEVCtlVlvLftEnaIntk" 656 "FId_GEVCtlVlvOpenClsdIntkB1" 657 "FId_GEVlvLockPinDiagIntkB1" 658 "FId_GEVlvPhaDiagEnaCsersIntkB1" 659 "FId_GEVlvPhaDiagEnaIntkB1" 660 "FId_GEVlvPhaPsIntkB1" 661 "FId_GbxAnNeutPosnErr" 662 "FId_GbxCANDigPlausErr" 663 "FId_GbxCANNeutSigErr" 664 "FId_GbxPNPosSig" 665 "FId_GbxPNPosnComErr" 666 "FId_GbxPNPosnDiagDrvCdnRels" 667 "FId_GbxPNPosnDiagDrvCodnHealRels" 668 "FId_GbxPNPosnDiagPlausyRels" 669 "FId_GbxPNPosnSubsVal" 670 "FId_GbxRvsSwtStk" 671 "FId_GbxSnsrSplyUErr" 672 "FId_GbxSpstReqOk" 673 "FId_GlbDaLSumvXPtd" 674 "FId_GslThrVlvSnsrDiagB1" 675 "FId_HEGOS2B1DElec" 676 "FId_HEGOS2B1DHtg" 677 "FId_HEGOS2B1Htg" 678 "FId_HEGOS2B1HtrPsSt" 679 "FId_HEGOS2B1InVld" 680 "FId_HEGOS2B1LSPsDiaDi" 681 "FId_HLSDemBrkFlt" 682 "FId_HLSDemErr1" 683 "FId_HLSDemErr2" 684 "FId_HLSDemIntkAirTemp" 685 "FId_HLSDemMotTemp" 686 "FId_HLSDemMstCyldpVld" 687 "FId_HLSDemSpdClthGearAccrSigErr" 688 "FId_HLSDem_DrvOffSuprt" 689 "FId_HLSDem_DrvOffSuprtBrkHldSys" 690 "FId_HLSDem_DrvOffSuprtLAS" 691 "FId_HLSDem_PModeActv" 692 "FId_HLSDem_TModeActv" 693 "FId_HLSDem_TraSubFcn" 694 "FId_HLSDem_nMaxLimErr1" 695 "FId_HLSDem_nMaxLimErr2" 696 "FId_HLSDem_nMaxLimErr3" 697 "FId_HLSDem_nMaxVErr" 698 "FId_I14229APP" 699 "FId_I14229CANErr" 700 "FId_I14229FlLvlFltComErr" 701 "FId_I14229VTCErr" 702 "FId_IMGISABComErr" 703 "FId_InhbLamDynS1B1" 704 "FId_InhbnBlkdLineDiag" 705 "FId_InhibitAlways" 706 "FId_InhibitNever" 707 "FId_InjSysMulInjDiagErr" 708 "FId_InjVlvPs_Bank1OnlyErr" 709 "FId_InjVlvPs_Bank1Tested" 710 "FId_InjVlvPs_Bank2OnlyErr" 711 "FId_InjVlvPs_Bank2Tested" 712 "FId_InjVlvPs_Bank3OnlyErr" 713 "FId_InjVlvPs_Bank3Tested" 714 "FId_IntkAirTAirFltDsCrssChk" 715 "FId_IntkAirTAirFltDsPlausChk" 716 "FId_IntkAirTIntkMnfldCrssChk" 717 "FId_IntkAirTIntkMnfldPlausChk" 718 "FId_IntkAirTIntkMnfldRepl" 719 "FId_IntkAirTSnsr1Elec" 720 "FId_IntkAirTSnsr1PRC" 721 "FId_IntkAirTSnsr1Sum" 722 "FId_IntkAirTSnsr2Elec" 723 "FId_IntkAirTSnsr2PRC" 724 "FId_IntkAirTSnsr2Sum" 725 "FId_IntkArTempENGB" 726 "FId_LIGovDfrstI" 727 "FId_LIGovUndrBrk" 728 "FId_LINDCDCRxErr" 729 "FId_LLimAppSnsrErr" 730 "FId_LLimAppSnsrSyncErr" 731 "FId_LLimMTVehSpdSnsrErr" 732 "FId_LLimShutOffEng" 733 "FId_LRSEBMisf" 734 "FId_LZSR" 735 "FId_LeakToMnfld" 736 "FId_LeakToMnfldTstd" 737 "FId_LimpHomPsErrInjtr" 738 "FId_LinACGUnitCfmdErr" 739 "FId_LinACGUnitNotTstd" 740 "FId_LinAEVUnitCfmdErr" 741 "FId_LinAEVUnitNotTstd" 742 "FId_LinEBSUnitCfmdErr" 743 "FId_LinEBSUnitNotTstd" 744 "FId_LowPresOilP" 745 "FId_MFlowAirCrkcsSubVal" 746 "FId_MFuOilMax" 747 "FId_MaiLoadSnsr" 748 "FId_MaiShaftFailr" 749 "FId_MfPsDia1" 750 "FId_MisfDetDnAdpn" 751 "FId_MisfDetDnAdpnPlaus" 752 "FId_MisfDetEnvP" 753 "FId_MisfDetSegTiAdpnFco" 754 "FId_MisfDetShtrpAct" 755 "FId_MisfDetStc" 756 "FId_MisfDetV" 757 "FId_MisfDetVWhlFrntLe" 758 "FId_MisfDetVWhlFrntRi" 759 "FId_MisfDetVWhlReLe" 760 "FId_MisfDetVWhlReRi" 761 "FId_NLimVehHalt" 762 "FId_NSHTDAmbT" 763 "FId_NSHTDEngT" 764 "FId_NSHTILimHiAltiLoIdleSp" 765 "FId_NeutPosnFailr" 766 "FId_O2StorgMdlMD" 767 "FId_OilCmbdSen_LvlDfctHW" 768 "FId_OilPCtrlVlvNpl" 769 "FId_OilPFrzVal" 770 "FId_OilPPlaus" 771 "FId_OilPPlausAftRun" 772 "FId_OilPPlausMax" 773 "FId_OilPPlausMin" 774 "FId_OilPPlausT15" 775 "FId_OilPRplVal" 776 "FId_OilPSnsrErr" 777 "FId_OilPSwmpSRC" 778 "FId_OilSwmpTCEngDsTWrmUp" 779 "FId_OilSwmpT_B_tospg" 780 "FId_OilSwmpT_B_tospgg" 781 "FId_OilSwmpT_CmbdSnsrErr" 782 "FId_OilSwmpT_CmbdSnsrTiTErr" 783 "FId_OilSwmpT_EnvT" 784 "FId_OilSwmpT_TSnsrErr" 785 "FId_PEnvMeasVld" 786 "FId_PEnvModel" 787 "FId_PEnvPlausDiagVDD" 788 "FId_PEnvRawVldVDD" 789 "FId_PEnvRefSnsr" 790 "FId_PEnvSigRngVld" 791 "FId_PEnvSnsrPlausVDD" 792 "FId_PEnvVldVDD" 793 "FId_PIDA6SigSrcErr" 794 "FId_PIntkMnfldPlaus" 795 "FId_PIntkVUsElecDiagB1" 796 "FId_PSPCtlDisbl" 797 "FId_PSPCtlIntkAirVapLock" 798 "FId_PSPCtlPreRun" 799 "FId_PSPCtlVapLock" 800 "FId_PSPDiagDisbl" 801 "FId_PTGripConv" 802 "FId_PTGripConvStrt" 803 "FId_PTGripMnlClth" 804 "FId_PTGripMnlClthStrt" 805 "FId_PTTrqRatCANPtd" 806 "FId_PThrVlVUsVldB1" 807 "FId_PThrVlvUsMeasdVldB1" 808 "FId_P_VSE11_Diag" 809 "FId_PrmId03_FltRdnS1B1" 810 "FId_PrmId03_FltUegoS1B1" 811 "FId_RevLck" 812 "FId_RstAdpnPIntkMnfldAfs" 813 "FId_RvsPosnFailr" 814 "FId_SSEEPBRelease" 815 "FId_SSEFCANPRelease" 816 "FId_SSEPTCANPRelease" 817 "FId_SSEStartRelease" 818 "FId_SSEStartReleaseMTCl10" 819 "FId_SSEStartReleaseMTCl100" 820 "FId_SSEStartReleaseMTCl20" 821 "FId_SSEStartReleaseMTCl90" 822 "FId_SSEStartRequest" 823 "FId_SSEStopRelease" 824 "FId_SSEStrtStopRelease" 825 "FId_SSESysOff" 826 "FId_SSEUI2DCSysFailr" 827 "FId_SSEUIBCANErr" 828 "FId_SSEUISysFail" 829 "FId_SiaEEPErr" 830 "FId_SnglWhlErrDiagEna" 831 "FId_StrtCtlAutoCrkModeCdn" 832 "FId_StrtCtlComEngStrtErr" 833 "FId_StrtCtlNPCdnCncl" 834 "FId_StrtCtlNoCpuFailr" 835 "FId_StrtCtlNoFailCanLine" 836 "FId_StrtCtlNoFailPTCanLine" 837 "FId_StrtCtlPNPosnSubsVal" 838 "FId_StrtCtlSTMFailr" 839 "FId_StrtErrShaft" 840 "FId_SumErrHndlg" 841 "FId_SysDiagComErr" 842 "FId_SysDiagModInhbErr" 843 "FId_TOSPM" 844 "FId_TWCCILck" 845 "FId_TWCCILckExtd" 846 "FId_TWCCIRstB1" 847 "FId_TWCCIRstDSMClearB1" 848 "FId_TWCCLsuB1" 849 "FId_TWCCLsuCyc" 850 "FId_TWCCLsuDynB1" 851 "FId_TWCCMisfDetn" 852 "FId_TWCDPriCatParB1" 853 "FId_TWCDPriCatVldnB1" 854 "FId_TankPCpv1DteskLoLoadStuckClsd" 855 "FId_TankPCpv1DteskLoLoadStuckOpen" 856 "FId_TankPSnsrElecChkVld" 857 "FId_ThrVlvMon" 858 "FId_ThrVlvOffsLrnPrmsB1" 859 "FId_TiOffTBasdChkFast" 860 "FId_TiOffTBasdChkSlow" 861 "FId_TiOffVdClk" 862 "FId_TqDecelOffsInhb" 863 "FId_TraAddAirCANPtd" 864 "FId_TraAddClntCANPtd" 865 "FId_TraFwdRvsCluInfo" 866 "FId_TraGbxNPos" 867 "FId_TraGearInfoCanCom" 868 "FId_TraGearInfoDet" 869 "FId_TraGearInfoGearShftActv" 870 "FId_TraGearInfoInfoCan" 871 "FId_TraGearInfoLevPos" 872 "FId_TraGearInfoLoRng" 873 "FId_TraGearInfoRTra" 874 "FId_TraGearInfoRevGear" 875 "FId_TraGearReq" 876 "FId_TraNoShftIdctr" 877 "FId_TraPrtGearCANPtd" 878 "FId_TraPrtGearIndpdtProblem" 879 "FId_TraRPosn" 880 "FId_TraRtnIntfcASTIntv" 881 "FId_TraRtnIntfcIdlSetP" 882 "FId_TraRtnIntfcNMaxCan" 883 "FId_TraRtnIntfcNMaxVel" 884 "FId_TraTrqRedLmpHmeDec" 885 "FId_TraTrqRedLmpHmeInc" 886 "FId_TraTrqRedPTCanErr" 887 "FId_TraTrqRedTIIntvDes" 888 "FId_TraTrqRedTIIntvLead" 889 "FId_TraTrqRedTSCIntvDes" 890 "FId_TraTrqRedTSCIntvLead" 891 "FId_TraTrsmTypHw" 892 "FId_TranIdleDes" 893 "FId_UEGOHeatgUpRglS1B1" 894 "FId_UEGOHeatrCtrlS1B1" 895 "FId_UEGOHeatrPrfmncDiagRelsS1B1" 896 "FId_UEGOHeatrPwrStgDiagRelsS1B1" 897 "FId_UEGOModCtrlRelsS1B1" 898 "FId_UEGOStrtDiagInhRprtErrS1B1" 899 "FId_UEGOStrtDiagRelsS1B1" 900 "FId_UEGOTCeramicRelsS1B1" 901 "FId_UegoDiagRelsBattSplyOk" 902 "FId_UegoDiagSigEcuAsicS1B1" 903 "FId_UegoDiagSigEcuComS1B1" 904 "FId_UegoDiagSigOperPlausS1B1" 905 "FId_UegoDiagSigSnsrS1B1" 906 "FId_UegoDiagSigWireOlS1B1" 907 "FId_UegoDiagSigWireScS1B1" 908 "FId_UegoDiagSigWireScTstdS1B1" 909 "FId_UegoInhbOperRelsS1B1" 910 "FId_UegoO2HiPrcsnS1B1" 911 "FId_UegoO2PlausErrS1B1" 912 "FId_UegoO2VldS1B1" 913 "FId_UegoOperPlausBattSplyOk" 914 "FId_UegoPlausErrHndlg" 915 "FId_VMSIDCSRmpShOff" 916 "FId_VMSIDCSShOff" 917 "FId_VMSITCSRmpShOff" 918 "FId_VMSITCSShOff" 919 "FId_VSACANErr" 920 "FId_VehStcACGFailr" 921 "FId_VehStcBattMngFailr" 922 "FId_VehStcDCDCFailr" 923 "FId_VehStcEBSFailr" 924 "FId_VehStcMisf" 925 "FId_VehStcMtrComFailr" 926 "FId_VehStcNVMFailr" 927 "FId_VehVCANFrzVal" 928 "FId_VehVCANReplVal" 929 "FId_VehVCanSafeFrzVal" 930 "FId_VehVCanSafeReplVal" 931 "FId_VehVCom" 932 "FId_VehVExcdLim" 933 "FId_VehVFrzVal" 934 "FId_VehVNCSnsrElecFailr" 935 "FId_VehVOBDFrzVal" 936 "FId_VehVOBDReplVal" 937 "FId_VehVOutCanErr" 938 "FId_VehVPWMFrzVal" 939 "FId_VehVPWMReplVal" 940 "FId_VehVPhysRng" 941 "FId_VehVPlaus" 942 "FId_VehVPlausCan" 943 "FId_VehVPlausFco" 944 "FId_VehVPlausPwr" 945 "FId_VehVPlausV2N" 946 "FId_VehVReplVal" 947 "FId_VehVSigCan" 948 "FId_VehVSigCanSafe" 949 "FId_VehVSngWhlCanFrzVal" 950 "FId_VehVSngWhlCanReplVal" 951 "FId_VehVSnsrARngHi" 952 "FId_VehVSnsrBRngHi" 953 "FId_VehVSpdRtyDiag" 954 "FId_VehVSpdSnsrAElecFailr" 955 "FId_VehVSpdSnsrBElecFailr" 956 "FId_VehVvFLWhlSpd" 957 "FId_VehVvFRWhlSpd" 958 "FId_VehVvRLWhlSpd" 959 "FId_VehVvRRWhlSpd" 960 "FId_VldtLamDynS1B1" 961 "FId_VlvLftFbIntkOilPSnsr11SRC" 962 "FId_VlvLftFbSwtIntk11Diag" 963 "FId_ZGLZSR" 964 "FId_airIntkFltSnsrKnkPrtnIgn" 965 "FId_ctrladpncvo" 966 "FId_stChkChgnSys" 967 "FId_stChkChgnSys2DC" 968 "FId_tFltSnsrKnkPrtnIgn" DEFAULT_VALUE "---" /end COMPU_VTAB
/begin COMPU_METHOD DINH_LimDFCVerb "" TAB_VERB "%6.3" "-" COMPU_TAB_REF DINH_LimDFCVerb /end COMPU_METHOD
/begin COMPU_VTAB DINH_LimDFCVerb "" TAB_VERB 18 0 "No_Inhibit" 1 "Def50_Deb100" 2 "Def100_Deb100" 3 "Def50_Deb100_Tst" 4 "Def100_Deb100_Tst" 5 "Def50_Deb100_or_NTst" 6 "Def100_Deb100_or_NTst" 7 "Tested" 8 "NotTested" 9 "Def100_Deb0" 10 "Def50_Deb0" 11 "Def25_Deb0" 12 "Def0_Deb0" 13 "Def50_Deb100_Tst_Trip" 14 "Def100_Deb100_Tst_Trip" 15 "Def50_Deb100_MILOn" 16 "Def50_Deb100_Trip" 17 "Def100_Deb100_Trip" /end COMPU_VTAB
/begin COMPU_METHOD DINH_LimDSQVerb "" TAB_VERB "%6.3" "-" COMPU_TAB_REF DINH_LimDSQVerb /end COMPU_METHOD
/begin COMPU_VTAB DINH_LimDSQVerb "" TAB_VERB 17 0 "Qual_AllOk_0" 1 "Qual_1" 2 "Qual_Meas_2" 3 "Qual_PremFrozen_3" 4 "Qual_Model_4" 5 "Qual_5" 6 "Qual_6" 7 "Qual_7" 8 "Qual_Frozen_8" 9 "Qual_9" 10 "Qual_10" 11 "Qual_Tester_11" 12 "Qual_Default_12" 13 "Qual_13" 14 "Qual_14" 15 "Qual_Invalid_15" 16 "No_Inhibit" /end COMPU_VTAB
/begin COMPU_METHOD EVAPDI_VAR_SY_Compu "" TAB_VERB "%6.3" "" COMPU_TAB_REF EVAPDI_VAR_SY_Compu /end COMPU_METHOD
/begin COMPU_VTAB EVAPDI_VAR_SY_Compu "" TAB_VERB 58 0 "kein Kundenbezug" 1 "DAI" 3 "VWW" 4 "POR" 5 "AUD" 6 "OPE" 9 "FIA" 11 "BMW" 14 "PSA" 15 "REN" 17 "ALF" 18 "SAB" 19 "VOL" 20 "NIS" 21 "GMU" 22 "FOR" 26 "IMJ" 36 "MAN" 51 "SEA" 53 "CHR" 54 "JAG" 55 "ROL" 69 "FER" 72 "TOY" 73 "LAM" 123 "MIT" 147 "HYU" 159 "HON" 160 "MAZ" 183 "CU" 190 "LRG" 204 "VVW" 214 "AVT" 242 "Iveco" 243 "DMC" 248 "SUZ" 267 "SSANGYONG" 270 "KEF" 289 "AMG" 308 "TAT" 319 "MVM" 327 "OTOSAN" 328 "MM" 385 "UAES" 590 "Scania" 609 "Deutz" 720 "Greatwall" 745 "JMC Ford" 788 "Saic Motor" 828 "RBCD" 898 "MFTBC" 936 "Anhui_Quanchai" 944 "DOOSAN Infracore" 984 "FAW - Wuxi" 999 "ALL" 2887 "Nonox" 9454 "Fuso" 9707 "Hatz" /end COMPU_VTAB
/begin COMPU_METHOD EVAPPU_LOADDETRMOLC_SC_Compu "" TAB_VERB "%6.3" "" COMPU_TAB_REF EVAPPU_LOADDETRMOLC_SC_Compu /end COMPU_METHOD
/begin COMPU_VTAB EVAPPU_LOADDETRMOLC_SC_Compu "" TAB_VERB 2 0 "False" 1 "True" /end COMPU_VTAB
/begin COMPU_METHOD EVAPPU_VAR_SY_Compu "" TAB_VERB "%6.3" "" COMPU_TAB_REF EVAPPU_VAR_SY_Compu /end COMPU_METHOD
/begin COMPU_VTAB EVAPPU_VAR_SY_Compu "" TAB_VERB 58 0 "kein Kundenbezug" 1 "DAI" 3 "VWW" 4 "POR" 5 "AUD" 6 "OPE" 9 "FIA" 11 "BMW" 14 "PSA" 15 "REN" 17 "ALF" 18 "SAB" 19 "VOL" 20 "NIS" 21 "GMU" 22 "FOR" 26 "IMJ" 36 "MAN" 51 "SEA" 53 "CHR" 54 "JAG" 55 "ROL" 69 "FER" 72 "TOY" 73 "LAM" 123 "MIT" 147 "HYU" 159 "HON" 160 "MAZ" 183 "CU" 190 "LRG" 204 "VVW" 214 "AVT" 242 "Iveco" 243 "DMC" 248 "SUZ" 267 "SSANGYONG" 270 "KEF" 289 "AMG" 308 "TAT" 319 "MVM" 327 "OTOSAN" 328 "MM" 385 "UAES" 590 "Scania" 609 "Deutz" 720 "Greatwall" 745 "JMC Ford" 788 "Saic Motor" 828 "RBCD" 898 "MFTBC" 936 "Anhui_Quanchai" 944 "DOOSAN Infracore" 984 "FAW - Wuxi" 999 "ALL" 2887 "Nonox" 9454 "Fuso" 9707 "Hatz" /end COMPU_VTAB
/begin COMPU_METHOD Time_s "" RAT_FUNC "%6.4" "s" COEFFS 0 100 0 0 0 1 /end COMPU_METHOD
/begin RECORD_LAYOUT ValA_Wu8 FNC_VALUES 1 UBYTE COLUMN_DIR DIRECT /end RECORD_LAYOUT
/begin RECORD_LAYOUT Val_Wu16 FNC_VALUES 1 UWORD COLUMN_DIR DIRECT /end RECORD_LAYOUT
/end MODULE
/end PROJECT
