ASAP2_VERSION 1 60
/begin PROJECT MG1CS022 "MG1CS022"
/begin HEADER "" VERSION "MG1CS022_62XSC_V037" PROJECT_NO MG1CS022 /end HEADER
/begin MODULE DIM ""
/begin MOD_COMMON "" BYTE_ORDER MSB_LAST ALIGNMENT_BYTE 1 ALIGNMENT_WORD 2 ALIGNMENT_LONG 4 ALIGNMENT_INT64 4 ALIGNMENT_FLOAT32_IEEE 4 ALIGNMENT_FLOAT64_IEEE 4 DATA_SIZE 32 /end MOD_COMMON
/begin CHARACTERISTIC DFES_DTCO.DFC_LinHdrTimeoutErrDCDC_C "OBD specific trouble code / OBD specific diagnostic trouble code for check DFC_LinHdrTimeoutErrDCDC" VALUE 0x8050442A Val_Wu16 65535.00 DFES_OneToOne 0.00 65535.00 FORMAT "%8.2" /end CHARACTERISTIC
/begin CHARACTERISTIC DFES_DTCO.DFC_LinHdrTimeoutErrEBS_C "OBD specific trouble code / OBD specific diagnostic trouble code for check DFC_LinHdrTimeoutErrEBS" VALUE 0x8050442C Val_Wu16 65535.00 DFES_OneToOne 0.00 65535.00 FORMAT "%8.2" /end CHARACTERISTIC
/begin CHARACTERISTIC DFES_DTCO.DFC_LinMsgTimeoutErrACG_C "OBD specific trouble code / OBD specific diagnostic trouble code for check DFC_LinMsgTimeoutErrACG" VALUE 0x8050442E Val_Wu16 65535.00 DFES_OneToOne 0.00 65535.00 FORMAT "%8.2" /end CHARACTERISTIC
/begin CHARACTERISTIC DFES_DTCO.DFC_LinMsgTimeoutErrAEV_C "OBD specific trouble code / OBD specific diagnostic trouble code for check DFC_LinMsgTimeoutErrAEV" VALUE 0x80504430 Val_Wu16 65535.00 DFES_OneToOne 0.00 65535.00 FORMAT "%8.2" /end CHARACTERISTIC
/begin CHARACTERISTIC DFES_DTCO.DFC_LinMsgTimeoutErrDCDC_C "OBD specific trouble code / OBD specific diagnostic trouble code for check DFC_LinMsgTimeoutErrDCDC" VALUE 0x80504432 Val_Wu16 65535.00 DFES_OneToOne 0.00 65535.00 FORMAT "%8.2" /end CHARACTERISTIC
/begin CHARACTERISTIC DFES_DTCO.DFC_LinMsgTimeoutErrEBS_C "OBD specific trouble code / OBD specific diagnostic trouble code for check DFC_LinMsgTimeoutErrEBS" VALUE 0x80504434 Val_Wu16 65535.00 DFES_OneToOne 0.00 65535.00 FORMAT "%8.2" /end CHARACTERISTIC
/begin CHARACTERISTIC DFES_DTCO.DFC_LinNoStrtComErr_C "OBD specific trouble code / OBD specific diagnostic trouble code for check DFC_LinNoStrtComErr" VALUE 0x80504436 Val_Wu16 65535.00 DFES_OneToOne 0.00 65535.00 FORMAT "%8.2" /end CHARACTERISTIC
/begin CHARACTERISTIC DFES_DTCO.DFC_LowPresOilP_C "OBD specific trouble code / OBD specific diagnostic trouble code for check DFC_LowPresOilP" VALUE 0x80504438 Val_Wu16 65535.00 DFES_OneToOne 0.00 65535.00 FORMAT "%8.2" /end CHARACTERISTIC
/begin CHARACTERISTIC DFES_DTCO.DFC_MisfDetVWhlFrntLeOORHi_C "OBD specific trouble code / OBD specific diagnostic trouble code for check DFC_MisfDetVWhlFrntLeOORHi" VALUE 0x8050443A Val_Wu16 65535.00 DFES_OneToOne 0.00 65535.00 FORMAT "%8.2" /end CHARACTERISTIC
/begin CHARACTERISTIC DFES_DTCO.DFC_MisfDetVWhlFrntLeRatyHi_C "OBD specific trouble code / OBD specific diagnostic trouble code for check DFC_MisfDetVWhlFrntLeRatyHi" VALUE 0x8050443C Val_Wu16 65535.00 DFES_OneToOne 0.00 65535.00 FORMAT "%8.2" /end CHARACTERISTIC
/begin CHARACTERISTIC DFES_DTCO.DFC_MisfDetVWhlFrntLeRatyLo_C "OBD specific trouble code / OBD specific diagnostic trouble code for check DFC_MisfDetVWhlFrntLeRatyLo" VALUE 0x8050443E Val_Wu16 65535.00 DFES_OneToOne 0.00 65535.00 FORMAT "%8.2" /end CHARACTERISTIC
/begin CHARACTERISTIC DFES_DTCO.DFC_MisfDetVWhlFrntLeStuck_C "OBD specific trouble code / OBD specific diagnostic trouble code for check DFC_MisfDetVWhlFrntLeStuck" VALUE 0x80504440 Val_Wu16 65535.00 DFES_OneToOne 0.00 65535.00 FORMAT "%8.2" /end CHARACTERISTIC
/begin CHARACTERISTIC DFES_DTCO.DFC_MisfDetVWhlFrntRiOORHi_C "OBD specific trouble code / OBD specific diagnostic trouble code for check DFC_MisfDetVWhlFrntRiOORHi" VALUE 0x80504442 Val_Wu16 65535.00 DFES_OneToOne 0.00 65535.00 FORMAT "%8.2" /end CHARACTERISTIC
/begin CHARACTERISTIC DFES_DTCO.DFC_MisfDetVWhlFrntRiRatyHi_C "OBD specific trouble code / OBD specific diagnostic trouble code for check DFC_MisfDetVWhlFrntRiRatyHi" VALUE 0x80504444 Val_Wu16 65535.00 DFES_OneToOne 0.00 65535.00 FORMAT "%8.2" /end CHARACTERISTIC
/begin CHARACTERISTIC DFES_DTCO.DFC_MisfDetVWhlFrntRiRatyLo_C "OBD specific trouble code / OBD specific diagnostic trouble code for check DFC_MisfDetVWhlFrntRiRatyLo" VALUE 0x80504446 Val_Wu16 65535.00 DFES_OneToOne 0.00 65535.00 FORMAT "%8.2" /end CHARACTERISTIC
/begin CHARACTERISTIC DFES_DTCO.DFC_MisfDetVWhlFrntRiStuck_C "OBD specific trouble code / OBD specific diagnostic trouble code for check DFC_MisfDetVWhlFrntRiStuck" VALUE 0x80504448 Val_Wu16 65535.00 DFES_OneToOne 0.00 65535.00 FORMAT "%8.2" /end CHARACTERISTIC
/begin CHARACTERISTIC DFES_DTCO.DFC_MisfDetVWhlReLeOORHi_C "OBD specific trouble code / OBD specific diagnostic trouble code for check DFC_MisfDetVWhlReLeOORHi" VALUE 0x8050444A Val_Wu16 65535.00 DFES_OneToOne 0.00 65535.00 FORMAT "%8.2" /end CHARACTERISTIC
/begin CHARACTERISTIC DFES_DTCO.DFC_MisfDetVWhlReLeRatyHi_C "OBD specific trouble code / OBD specific diagnostic trouble code for check DFC_MisfDetVWhlReLeRatyHi" VALUE 0x8050444C Val_Wu16 65535.00 DFES_OneToOne 0.00 65535.00 FORMAT "%8.2" /end CHARACTERISTIC
/begin CHARACTERISTIC DFES_DTCO.DFC_MisfDetVWhlReLeRatyLo_C "OBD specific trouble code / OBD specific diagnostic trouble code for check DFC_MisfDetVWhlReLeRatyLo" VALUE 0x8050444E Val_Wu16 65535.00 DFES_OneToOne 0.00 65535.00 FORMAT "%8.2" /end CHARACTERISTIC
/begin CHARACTERISTIC DFES_DTCO.DFC_MisfDetVWhlReLeStuck_C "OBD specific trouble code / OBD specific diagnostic trouble code for check DFC_MisfDetVWhlReLeStuck" VALUE 0x80504450 Val_Wu16 65535.00 DFES_OneToOne 0.00 65535.00 FORMAT "%8.2" /end CHARACTERISTIC
/begin CHARACTERISTIC DFES_DTCO.DFC_MisfDetVWhlReRiOORHi_C "OBD specific trouble code / OBD specific diagnostic trouble code for check DFC_MisfDetVWhlReRiOORHi" VALUE 0x80504452 Val_Wu16 65535.00 DFES_OneToOne 0.00 65535.00 FORMAT "%8.2" /end CHARACTERISTIC
/begin CHARACTERISTIC DFES_DTCO.DFC_MisfDetVWhlReRiRatyHi_C "OBD specific trouble code / OBD specific diagnostic trouble code for check DFC_MisfDetVWhlReRiRatyHi" VALUE 0x80504454 Val_Wu16 65535.00 DFES_OneToOne 0.00 65535.00 FORMAT "%8.2" /end CHARACTERISTIC
/begin CHARACTERISTIC DFES_DTCO.DFC_MisfDetVWhlReRiRatyLo_C "OBD specific trouble code / OBD specific diagnostic trouble code for check DFC_MisfDetVWhlReRiRatyLo" VALUE 0x80504456 Val_Wu16 65535.00 DFES_OneToOne 0.00 65535.00 FORMAT "%8.2" /end CHARACTERISTIC
/begin CHARACTERISTIC DFES_DTCO.DFC_MisfDetVWhlReRiStuck_C "OBD specific trouble code / OBD specific diagnostic trouble code for check DFC_MisfDetVWhlReRiStuck" VALUE 0x80504458 Val_Wu16 65535.00 DFES_OneToOne 0.00 65535.00 FORMAT "%8.2" /end CHARACTERISTIC
/begin CHARACTERISTIC DFES_DTCO.DFC_MisfDetdVWhlFrntLePlaus_C "OBD specific trouble code / OBD specific diagnostic trouble code for check DFC_MisfDetdVWhlFrntLePlaus" VALUE 0x8050445A Val_Wu16 65535.00 DFES_OneToOne 0.00 65535.00 FORMAT "%8.2" /end CHARACTERISTIC
/begin CHARACTERISTIC DFES_DTCO.DFC_MisfDetdVWhlFrntRiPlaus_C "OBD specific trouble code / OBD specific diagnostic trouble code for check DFC_MisfDetdVWhlFrntRiPlaus" VALUE 0x8050445C Val_Wu16 65535.00 DFES_OneToOne 0.00 65535.00 FORMAT "%8.2" /end CHARACTERISTIC
/begin CHARACTERISTIC DFES_DTCO.DFC_MisfDetdVWhlReLePlaus_C "OBD specific trouble code / OBD specific diagnostic trouble code for check DFC_MisfDetdVWhlReLePlaus" VALUE 0x8050445E Val_Wu16 65535.00 DFES_OneToOne 0.00 65535.00 FORMAT "%8.2" /end CHARACTERISTIC
/begin CHARACTERISTIC DFES_DTCO.DFC_MisfDetdVWhlReRiPlaus_C "OBD specific trouble code / OBD specific diagnostic trouble code for check DFC_MisfDetdVWhlReRiPlaus" VALUE 0x80504460 Val_Wu16 65535.00 DFES_OneToOne 0.00 65535.00 FORMAT "%8.2" /end CHARACTERISTIC
/begin CHARACTERISTIC DFES_DTCO.DFC_PEnvSigRngMax_C "OBD specific trouble code / OBD specific diagnostic trouble code for check DFC_PEnvSigRngMax" VALUE 0x80504462 Val_Wu16 65535.00 DFES_OneToOne 0.00 65535.00 FORMAT "%8.2" /end CHARACTERISTIC
/begin CHARACTERISTIC DFES_DTCO.DFC_PEnvSigRngMin_C "OBD specific trouble code / OBD specific diagnostic trouble code for check DFC_PEnvSigRngMin" VALUE 0x80504464 Val_Wu16 65535.00 DFES_OneToOne 0.00 65535.00 FORMAT "%8.2" /end CHARACTERISTIC
/begin CHARACTERISTIC DFES_DTCO.DFC_StmFault_C "OBD specific trouble code / OBD specific diagnostic trouble code for check DFC_StmFault" VALUE 0x80504466 Val_Wu16 65535.00 DFES_OneToOne 0.00 65535.00 FORMAT "%8.2" /end CHARACTERISTIC
/begin CHARACTERISTIC DFES_DTCO.DFC_StrtCtOffPth_C "OBD specific trouble code / OBD specific diagnostic trouble code for check DFC_StrtCtOffPth" VALUE 0x80504468 Val_Wu16 65535.00 DFES_OneToOne 0.00 65535.00 FORMAT "%8.2" /end CHARACTERISTIC
/begin CHARACTERISTIC DFES_DTCO.DFC_StrtCtlErr_C "OBD specific trouble code / OBD specific diagnostic trouble code for check DFC_StrtCtlErr" VALUE 0x8050446A Val_Wu16 65535.00 DFES_OneToOne 0.00 65535.00 FORMAT "%8.2" /end CHARACTERISTIC
/begin CHARACTERISTIC DFES_DTCO.DFC_StrtFault_C "OBD specific trouble code / OBD specific diagnostic trouble code for check DFC_StrtFault" VALUE 0x8050446C Val_Wu16 65535.00 DFES_OneToOne 0.00 65535.00 FORMAT "%8.2" /end CHARACTERISTIC
/begin CHARACTERISTIC DFES_DTCO.DFC_StrtLckJudg1_C "OBD specific trouble code / OBD specific diagnostic trouble code for check DFC_StrtLckJudg1" VALUE 0x8050446E Val_Wu16 65535.00 DFES_OneToOne 0.00 65535.00 FORMAT "%8.2" /end CHARACTERISTIC
/begin CHARACTERISTIC DFES_DTCO.DFC_StrtLckJudg2_C "OBD specific trouble code / OBD specific diagnostic trouble code for check DFC_StrtLckJudg2" VALUE 0x80504470 Val_Wu16 65535.00 DFES_OneToOne 0.00 65535.00 FORMAT "%8.2" /end CHARACTERISTIC
/begin CHARACTERISTIC DFES_DTCO.DFC_StrtOL_C "OBD specific trouble code / OBD specific diagnostic trouble code for check DFC_StrtOL" VALUE 0x80504472 Val_Wu16 65535.00 DFES_OneToOne 0.00 65535.00 FORMAT "%8.2" /end CHARACTERISTIC
/begin CHARACTERISTIC DFES_DTCO.DFC_StrtOL2_C "OBD specific trouble code / OBD specific diagnostic trouble code for check DFC_StrtOL2" VALUE 0x80504474 Val_Wu16 65535.00 DFES_OneToOne 0.00 65535.00 FORMAT "%8.2" /end CHARACTERISTIC
/begin CHARACTERISTIC DFES_DTCO.DFC_StrtSCB_C "OBD specific trouble code / OBD specific diagnostic trouble code for check DFC_StrtSCB" VALUE 0x80504476 Val_Wu16 65535.00 DFES_OneToOne 0.00 65535.00 FORMAT "%8.2" /end CHARACTERISTIC
/begin CHARACTERISTIC DFES_DTCO.DFC_StrtSCB2_C "OBD specific trouble code / OBD specific diagnostic trouble code for check DFC_StrtSCB2" VALUE 0x80504478 Val_Wu16 65535.00 DFES_OneToOne 0.00 65535.00 FORMAT "%8.2" /end CHARACTERISTIC
/begin CHARACTERISTIC DFES_DTCO.DFC_StrtSCG_C "OBD specific trouble code / OBD specific diagnostic trouble code for check DFC_StrtSCG" VALUE 0x8050447A Val_Wu16 65535.00 DFES_OneToOne 0.00 65535.00 FORMAT "%8.2" /end CHARACTERISTIC
/begin CHARACTERISTIC DFES_DTCO.DFC_StrtSCG2_C "OBD specific trouble code / OBD specific diagnostic trouble code for check DFC_StrtSCG2" VALUE 0x8050447C Val_Wu16 65535.00 DFES_OneToOne 0.00 65535.00 FORMAT "%8.2" /end CHARACTERISTIC
/begin CHARACTERISTIC DFES_DTCO.DFC_StrtStkRly1_C "OBD specific trouble code / OBD specific diagnostic trouble code for check DFC_StrtStkRly1" VALUE 0x8050447E Val_Wu16 65535.00 DFES_OneToOne 0.00 65535.00 FORMAT "%8.2" /end CHARACTERISTIC
/begin CHARACTERISTIC DFES_DTCO.DFC_StrtStkRly2_C "OBD specific trouble code / OBD specific diagnostic trouble code for check DFC_StrtStkRly2" VALUE 0x80504480 Val_Wu16 65535.00 DFES_OneToOne 0.00 65535.00 FORMAT "%8.2" /end CHARACTERISTIC
/begin CHARACTERISTIC DFES_DTCO.DFC_TEVEmax_C "OBD specific trouble code / OBD specific diagnostic trouble code for check DFC_TEVEmax" VALUE 0x80504482 Val_Wu16 65535.00 DFES_OneToOne 0.00 65535.00 FORMAT "%8.2" /end CHARACTERISTIC
/begin CHARACTERISTIC DFES_DTCO.DFC_TEVEmin_C "OBD specific trouble code / OBD specific diagnostic trouble code for check DFC_TEVEmin" VALUE 0x80504484 Val_Wu16 65535.00 DFES_OneToOne 0.00 65535.00 FORMAT "%8.2" /end CHARACTERISTIC
/begin CHARACTERISTIC DFES_DTCO.DFC_TEVEsig_C "OBD specific trouble code / OBD specific diagnostic trouble code for check DFC_TEVEsig" VALUE 0x80504486 Val_Wu16 65535.00 DFES_OneToOne 0.00 65535.00 FORMAT "%8.2" /end CHARACTERISTIC
/begin CHARACTERISTIC DFES_DTCO.DFC_UegoHeatrPrfmncLoS1B1_C "OBD specific trouble code / OBD specific diagnostic trouble code for check DFC_UegoHeatrPrfmncLoS1B1" VALUE 0x80504488 Val_Wu16 65535.00 DFES_OneToOne 0.00 65535.00 FORMAT "%8.2" /end CHARACTERISTIC
/begin CHARACTERISTIC DFES_DTCO.DFC_VehVAllPlaus_C "OBD specific trouble code / OBD specific diagnostic trouble code for check DFC_VehVAllPlaus" VALUE 0x8050448A Val_Wu16 65535.00 DFES_OneToOne 0.00 65535.00 FORMAT "%8.2" /end CHARACTERISTIC
/begin CHARACTERISTIC DFES_DTCO.DFC_VehVNCSnsrElecFailr_C "OBD specific trouble code / OBD specific diagnostic trouble code for check DFC_VehVNCSnsrElecFailr" VALUE 0x8050448C Val_Wu16 65535.00 DFES_OneToOne 0.00 65535.00 FORMAT "%8.2" /end CHARACTERISTIC
/begin CHARACTERISTIC DFES_DTCO.DFC_VehVPlausCan_C "OBD specific trouble code / OBD specific diagnostic trouble code for check DFC_VehVPlausCan" VALUE 0x8050448E Val_Wu16 65535.00 DFES_OneToOne 0.00 65535.00 FORMAT "%8.2" /end CHARACTERISTIC
/begin CHARACTERISTIC DFES_DTCO.DFC_VehVPlausFco_C "OBD specific trouble code / OBD specific diagnostic trouble code for check DFC_VehVPlausFco" VALUE 0x80504490 Val_Wu16 65535.00 DFES_OneToOne 0.00 65535.00 FORMAT "%8.2" /end CHARACTERISTIC
/begin CHARACTERISTIC DFES_DTCO.DFC_VehVPlausPwr_C "OBD specific trouble code / OBD specific diagnostic trouble code for check DFC_VehVPlausPwr" VALUE 0x80504492 Val_Wu16 65535.00 DFES_OneToOne 0.00 65535.00 FORMAT "%8.2" /end CHARACTERISTIC
/begin CHARACTERISTIC DFES_DTCO.DFC_VehVPlausV2N_C "OBD specific trouble code / OBD specific diagnostic trouble code for check DFC_VehVPlausV2N" VALUE 0x80504494 Val_Wu16 65535.00 DFES_OneToOne 0.00 65535.00 FORMAT "%8.2" /end CHARACTERISTIC
/begin CHARACTERISTIC DFES_DTCO.DFC_VehVSpdSnsrAElecFailr_C "OBD specific trouble code / OBD specific diagnostic trouble code for check DFC_VehVSpdSnsrAElecFailr" VALUE 0x80504496 Val_Wu16 65535.00 DFES_OneToOne 0.00 65535.00 FORMAT "%8.2" /end CHARACTERISTIC
/begin CHARACTERISTIC DFES_DTCO.DFC_VehVSpdSnsrBElecFailr_C "OBD specific trouble code / OBD specific diagnostic trouble code for check DFC_VehVSpdSnsrBElecFailr" VALUE 0x80504498 Val_Wu16 65535.00 DFES_OneToOne 0.00 65535.00 FORMAT "%8.2" /end CHARACTERISTIC
/begin CHARACTERISTIC DFES_DTCO.DFC_ClthMax_C "OBD specific trouble code / OBD specific diagnostic trouble code for check DFC_ClthMax" VALUE 0x8050449A Val_Wu16 65535.00 DFES_OneToOne 0.00 65535.00 FORMAT "%8.2" /end CHARACTERISTIC
/begin CHARACTERISTIC DFES_DTCO.DFC_IgnClPs_DevComErr_C "OBD specific trouble code / OBD specific diagnostic trouble code for check DFC_IgnClPs_DevComErr" VALUE 0x8050449C Val_Wu16 65535.00 DFES_OneToOne 0.00 65535.00 FORMAT "%8.2" /end CHARACTERISTIC
/begin CHARACTERISTIC DFES_DTCO.DFC_IgnClPs_LineOl_0_C "OBD specific trouble code / OBD specific diagnostic trouble code for check DFC_IgnClPs_LineOl_0" VALUE 0x8050449E Val_Wu16 65535.00 DFES_OneToOne 0.00 65535.00 FORMAT "%8.2" /end CHARACTERISTIC
/begin CHARACTERISTIC DFES_DTCO.DFC_IgnClPs_LineOl_1_C "OBD specific trouble code / OBD specific diagnostic trouble code for check DFC_IgnClPs_LineOl_1" VALUE 0x805044A0 Val_Wu16 65535.00 DFES_OneToOne 0.00 65535.00 FORMAT "%8.2" /end CHARACTERISTIC
/begin CHARACTERISTIC DFES_DTCO.DFC_IgnClPs_LineOl_2_C "OBD specific trouble code / OBD specific diagnostic trouble code for check DFC_IgnClPs_LineOl_2" VALUE 0x805044A2 Val_Wu16 65535.00 DFES_OneToOne 0.00 65535.00 FORMAT "%8.2" /end CHARACTERISTIC
/begin CHARACTERISTIC DFES_DTCO.DFC_IgnClPs_LineOl_3_C "OBD specific trouble code / OBD specific diagnostic trouble code for check DFC_IgnClPs_LineOl_3" VALUE 0x805044A4 Val_Wu16 65535.00 DFES_OneToOne 0.00 65535.00 FORMAT "%8.2" /end CHARACTERISTIC
/begin CHARACTERISTIC DFES_DTCO.DFC_IgnClPs_LineScb_0_C "OBD specific trouble code / OBD specific diagnostic trouble code for check DFC_IgnClPs_LineScb_0" VALUE 0x805044A6 Val_Wu16 65535.00 DFES_OneToOne 0.00 65535.00 FORMAT "%8.2" /end CHARACTERISTIC
/begin CHARACTERISTIC DFES_DTCO.DFC_IgnClPs_LineScb_1_C "OBD specific trouble code / OBD specific diagnostic trouble code for check DFC_IgnClPs_LineScb_1" VALUE 0x805044A8 Val_Wu16 65535.00 DFES_OneToOne 0.00 65535.00 FORMAT "%8.2" /end CHARACTERISTIC
/begin CHARACTERISTIC DFES_DTCO.DFC_IgnClPs_LineScb_2_C "OBD specific trouble code / OBD specific diagnostic trouble code for check DFC_IgnClPs_LineScb_2" VALUE 0x805044AA Val_Wu16 65535.00 DFES_OneToOne 0.00 65535.00 FORMAT "%8.2" /end CHARACTERISTIC
/begin CHARACTERISTIC DFES_DTCO.DFC_IgnClPs_LineScb_3_C "OBD specific trouble code / OBD specific diagnostic trouble code for check DFC_IgnClPs_LineScb_3" VALUE 0x805044AC Val_Wu16 65535.00 DFES_OneToOne 0.00 65535.00 FORMAT "%8.2" /end CHARACTERISTIC
/begin CHARACTERISTIC DFES_DTCO.DFC_IgnClPs_LineScg_0_C "OBD specific trouble code / OBD specific diagnostic trouble code for check DFC_IgnClPs_LineScg_0" VALUE 0x805044AE Val_Wu16 65535.00 DFES_OneToOne 0.00 65535.00 FORMAT "%8.2" /end CHARACTERISTIC
/begin CHARACTERISTIC DFES_DTCO.DFC_IgnClPs_LineScg_1_C "OBD specific trouble code / OBD specific diagnostic trouble code for check DFC_IgnClPs_LineScg_1" VALUE 0x805044B0 Val_Wu16 65535.00 DFES_OneToOne 0.00 65535.00 FORMAT "%8.2" /end CHARACTERISTIC
/begin CHARACTERISTIC DFES_DTCO.DFC_IgnClPs_LineScg_2_C "OBD specific trouble code / OBD specific diagnostic trouble code for check DFC_IgnClPs_LineScg_2" VALUE 0x805044B2 Val_Wu16 65535.00 DFES_OneToOne 0.00 65535.00 FORMAT "%8.2" /end CHARACTERISTIC
/begin CHARACTERISTIC DFES_DTCO.DFC_IgnClPs_LineScg_3_C "OBD specific trouble code / OBD specific diagnostic trouble code for check DFC_IgnClPs_LineScg_3" VALUE 0x805044B4 Val_Wu16 65535.00 DFES_OneToOne 0.00 65535.00 FORMAT "%8.2" /end CHARACTERISTIC
/begin CHARACTERISTIC DFES_DTCO.DFC_KRVEKOEVAB_C "OBD specific trouble code / OBD specific diagnostic trouble code for check DFC_KRVEKOEVAB" VALUE 0x805044B6 Val_Wu16 65535.00 DFES_OneToOne 0.00 65535.00 FORMAT "%8.2" /end CHARACTERISTIC
/begin CHARACTERISTIC DFES_DTCO.DFC_KRVEKOEVAB0_C "OBD specific trouble code / OBD specific diagnostic trouble code for check DFC_KRVEKOEVAB0" VALUE 0x805044B8 Val_Wu16 65535.00 DFES_OneToOne 0.00 65535.00 FORMAT "%8.2" /end CHARACTERISTIC
/begin CHARACTERISTIC DFES_DTCO.DFC_KRVEKOEVAB1_C "OBD specific trouble code / OBD specific diagnostic trouble code for check DFC_KRVEKOEVAB1" VALUE 0x805044BA Val_Wu16 65535.00 DFES_OneToOne 0.00 65535.00 FORMAT "%8.2" /end CHARACTERISTIC
/begin CHARACTERISTIC DFES_DTCO.DFC_KRVEKOEVAB2_C "OBD specific trouble code / OBD specific diagnostic trouble code for check DFC_KRVEKOEVAB2" VALUE 0x805044BC Val_Wu16 65535.00 DFES_OneToOne 0.00 65535.00 FORMAT "%8.2" /end CHARACTERISTIC
/begin CHARACTERISTIC DFES_DTCO.DFC_KRVEKOEVAB3_C "OBD specific trouble code / OBD specific diagnostic trouble code for check DFC_KRVEKOEVAB3" VALUE 0x805044BE Val_Wu16 65535.00 DFES_OneToOne 0.00 65535.00 FORMAT "%8.2" /end CHARACTERISTIC
/begin CHARACTERISTIC DFES_DTCO.DFC_UegoSigEcuAsicS1B1_C "OBD specific trouble code / OBD specific diagnostic trouble code for check DFC_UegoSigEcuAsicS1B1" VALUE 0x805044C0 Val_Wu16 65535.00 DFES_OneToOne 0.00 65535.00 FORMAT "%8.2" /end CHARACTERISTIC
/begin CHARACTERISTIC DFES_DTCO.DFC_UegoSigEcuComS1B1_C "OBD specific trouble code / OBD specific diagnostic trouble code for check DFC_UegoSigEcuComS1B1" VALUE 0x805044C2 Val_Wu16 65535.00 DFES_OneToOne 0.00 65535.00 FORMAT "%8.2" /end CHARACTERISTIC
/begin CHARACTERISTIC DFES_DTCO.DFC_UegoSigSnsrS1B1_C "OBD specific trouble code / OBD specific diagnostic trouble code for check DFC_UegoSigSnsrS1B1" VALUE 0x805044C4 Val_Wu16 65535.00 DFES_OneToOne 0.00 65535.00 FORMAT "%8.2" /end CHARACTERISTIC
/begin CHARACTERISTIC DFES_DTCO.DFC_UegoSigWireOlApesS1B1_C "OBD specific trouble code / OBD specific diagnostic trouble code for check DFC_UegoSigWireOlApesS1B1" VALUE 0x805044C6 Val_Wu16 65535.00 DFES_OneToOne 0.00 65535.00 FORMAT "%8.2" /end CHARACTERISTIC
/begin CHARACTERISTIC DFES_DTCO.DFC_UegoSigWireOlIpeS1B1_C "OBD specific trouble code / OBD specific diagnostic trouble code for check DFC_UegoSigWireOlIpeS1B1" VALUE 0x805044C8 Val_Wu16 65535.00 DFES_OneToOne 0.00 65535.00 FORMAT "%8.2" /end CHARACTERISTIC
/begin CHARACTERISTIC DFES_DTCO.DFC_UegoSigWireOlReS1B1_C "OBD specific trouble code / OBD specific diagnostic trouble code for check DFC_UegoSigWireOlReS1B1" VALUE 0x805044CA Val_Wu16 65535.00 DFES_OneToOne 0.00 65535.00 FORMAT "%8.2" /end CHARACTERISTIC
/begin CHARACTERISTIC DFES_DTCO.DFC_UegoSigWireRCmpS1B1_C "OBD specific trouble code / OBD specific diagnostic trouble code for check DFC_UegoSigWireRCmpS1B1" VALUE 0x805044CC Val_Wu16 65535.00 DFES_OneToOne 0.00 65535.00 FORMAT "%8.2" /end CHARACTERISTIC
/begin CHARACTERISTIC DFES_DTCO.DFC_UegoSigWireScbS1B1_C "OBD specific trouble code / OBD specific diagnostic trouble code for check DFC_UegoSigWireScbS1B1" VALUE 0x805044CE Val_Wu16 65535.00 DFES_OneToOne 0.00 65535.00 FORMAT "%8.2" /end CHARACTERISTIC
/begin CHARACTERISTIC DFES_DTCO.DFC_UegoSigWireScgS1B1_C "OBD specific trouble code / OBD specific diagnostic trouble code for check DFC_UegoSigWireScgS1B1" VALUE 0x805044D0 Val_Wu16 65535.00 DFES_OneToOne 0.00 65535.00 FORMAT "%8.2" /end CHARACTERISTIC
/begin CHARACTERISTIC DFES_DTCO.DFC_AfsPhyRngHiB1_C "OBD specific trouble code / OBD specific diagnostic trouble code for check DFC_AfsPhyRngHiB1" VALUE 0x805044D2 Val_Wu16 65535.00 DFES_OneToOne 0.00 65535.00 FORMAT "%8.2" /end CHARACTERISTIC
/begin CHARACTERISTIC DFES_DTCO.DFC_AfsPhyRngLoB1_C "OBD specific trouble code / OBD specific diagnostic trouble code for check DFC_AfsPhyRngLoB1" VALUE 0x805044D4 Val_Wu16 65535.00 DFES_OneToOne 0.00 65535.00 FORMAT "%8.2" /end CHARACTERISTIC
/begin CHARACTERISTIC DFES_DTCO.DFC_AirCCmprOL_C "OBD specific trouble code / OBD specific diagnostic trouble code for check DFC_AirCCmprOL" VALUE 0x805044D6 Val_Wu16 65535.00 DFES_OneToOne 0.00 65535.00 FORMAT "%8.2" /end CHARACTERISTIC
/begin CHARACTERISTIC DFES_DTCO.DFC_AirCCmprOvrTemp_C "OBD specific trouble code / OBD specific diagnostic trouble code for check DFC_AirCCmprOvrTemp" VALUE 0x805044D8 Val_Wu16 65535.00 DFES_OneToOne 0.00 65535.00 FORMAT "%8.2" /end CHARACTERISTIC
/begin CHARACTERISTIC DFES_DTCO.DFC_AirCCmprSCB_C "OBD specific trouble code / OBD specific diagnostic trouble code for check DFC_AirCCmprSCB" VALUE 0x805044DA Val_Wu16 65535.00 DFES_OneToOne 0.00 65535.00 FORMAT "%8.2" /end CHARACTERISTIC
/begin CHARACTERISTIC DFES_DTCO.DFC_AirCCmprSCG_C "OBD specific trouble code / OBD specific diagnostic trouble code for check DFC_AirCCmprSCG" VALUE 0x805044DC Val_Wu16 65535.00 DFES_OneToOne 0.00 65535.00 FORMAT "%8.2" /end CHARACTERISTIC
/begin CHARACTERISTIC DFES_DTCO.DFC_AltErr_C "OBD specific trouble code / OBD specific diagnostic trouble code for check DFC_AltErr" VALUE 0x805044DE Val_Wu16 65535.00 DFES_OneToOne 0.00 65535.00 FORMAT "%8.2" /end CHARACTERISTIC
/begin CHARACTERISTIC DFES_DTCO.DFC_BattUSRCMax_C "OBD specific trouble code / OBD specific diagnostic trouble code for check DFC_BattUSRCMax" VALUE 0x805044E0 Val_Wu16 65535.00 DFES_OneToOne 0.00 65535.00 FORMAT "%8.2" /end CHARACTERISTIC
/begin CHARACTERISTIC DFES_DTCO.DFC_BattUSRCMin_C "OBD specific trouble code / OBD specific diagnostic trouble code for check DFC_BattUSRCMin" VALUE 0x805044E2 Val_Wu16 65535.00 DFES_OneToOne 0.00 65535.00 FORMAT "%8.2" /end CHARACTERISTIC
/begin CHARACTERISTIC DFES_DTCO.DFC_ComChksTCU1_C "OBD specific trouble code / OBD specific diagnostic trouble code for check DFC_ComChksTCU1" VALUE 0x805044E4 Val_Wu16 65535.00 DFES_OneToOne 0.00 65535.00 FORMAT "%8.2" /end CHARACTERISTIC
/begin CHARACTERISTIC DFES_DTCO.DFC_ComChksTCU11_C "OBD specific trouble code / OBD specific diagnostic trouble code for check DFC_ComChksTCU11" VALUE 0x805044E6 Val_Wu16 65535.00 DFES_OneToOne 0.00 65535.00 FORMAT "%8.2" /end CHARACTERISTIC
/begin CHARACTERISTIC DFES_DTCO.DFC_ComChksTCU12_C "OBD specific trouble code / OBD specific diagnostic trouble code for check DFC_ComChksTCU12" VALUE 0x805044E8 Val_Wu16 65535.00 DFES_OneToOne 0.00 65535.00 FORMAT "%8.2" /end CHARACTERISTIC
/begin CHARACTERISTIC DFES_DTCO.DFC_ComChksTCU13_C "OBD specific trouble code / OBD specific diagnostic trouble code for check DFC_ComChksTCU13" VALUE 0x805044EA Val_Wu16 65535.00 DFES_OneToOne 0.00 65535.00 FORMAT "%8.2" /end CHARACTERISTIC
/begin CHARACTERISTIC DFES_DTCO.DFC_ComChksTCU2_C "OBD specific trouble code / OBD specific diagnostic trouble code for check DFC_ComChksTCU2" VALUE 0x805044EC Val_Wu16 65535.00 DFES_OneToOne 0.00 65535.00 FORMAT "%8.2" /end CHARACTERISTIC
/begin CHARACTERISTIC DFES_DTCO.DFC_ComChksTCU3_C "OBD specific trouble code / OBD specific diagnostic trouble code for check DFC_ComChksTCU3" VALUE 0x805044EE Val_Wu16 65535.00 DFES_OneToOne 0.00 65535.00 FORMAT "%8.2" /end CHARACTERISTIC
/begin CHARACTERISTIC DFES_DTCO.DFC_ComChksTCU4_C "OBD specific trouble code / OBD specific diagnostic trouble code for check DFC_ComChksTCU4" VALUE 0x805044F0 Val_Wu16 65535.00 DFES_OneToOne 0.00 65535.00 FORMAT "%8.2" /end CHARACTERISTIC
/begin CHARACTERISTIC DFES_DTCO.DFC_ComCntTCU1_C "OBD specific trouble code / OBD specific diagnostic trouble code for check DFC_ComCntTCU1" VALUE 0x805044F2 Val_Wu16 65535.00 DFES_OneToOne 0.00 65535.00 FORMAT "%8.2" /end CHARACTERISTIC
/begin CHARACTERISTIC DFES_DTCO.DFC_ComCntTCU11_C "OBD specific trouble code / OBD specific diagnostic trouble code for check DFC_ComCntTCU11" VALUE 0x805044F4 Val_Wu16 65535.00 DFES_OneToOne 0.00 65535.00 FORMAT "%8.2" /end CHARACTERISTIC
/begin CHARACTERISTIC DFES_DTCO.DFC_ComCntTCU12_C "OBD specific trouble code / OBD specific diagnostic trouble code for check DFC_ComCntTCU12" VALUE 0x805044F6 Val_Wu16 65535.00 DFES_OneToOne 0.00 65535.00 FORMAT "%8.2" /end CHARACTERISTIC
/begin CHARACTERISTIC DFES_DTCO.DFC_ComCntTCU13_C "OBD specific trouble code / OBD specific diagnostic trouble code for check DFC_ComCntTCU13" VALUE 0x805044F8 Val_Wu16 65535.00 DFES_OneToOne 0.00 65535.00 FORMAT "%8.2" /end CHARACTERISTIC
/begin CHARACTERISTIC DFES_DTCO.DFC_ComCntTCU2_C "OBD specific trouble code / OBD specific diagnostic trouble code for check DFC_ComCntTCU2" VALUE 0x805044FA Val_Wu16 65535.00 DFES_OneToOne 0.00 65535.00 FORMAT "%8.2" /end CHARACTERISTIC
/begin CHARACTERISTIC DFES_DTCO.DFC_ComCntTCU3_C "OBD specific trouble code / OBD specific diagnostic trouble code for check DFC_ComCntTCU3" VALUE 0x805044FC Val_Wu16 65535.00 DFES_OneToOne 0.00 65535.00 FORMAT "%8.2" /end CHARACTERISTIC
/begin CHARACTERISTIC DFES_DTCO.DFC_ComCntTCU4_C "OBD specific trouble code / OBD specific diagnostic trouble code for check DFC_ComCntTCU4" VALUE 0x805044FE Val_Wu16 65535.00 DFES_OneToOne 0.00 65535.00 FORMAT "%8.2" /end CHARACTERISTIC
/begin CHARACTERISTIC DFES_DTCO.DFC_ComTOutTCU01_C "OBD specific trouble code / OBD specific diagnostic trouble code for check DFC_ComTOutTCU01" VALUE 0x80504500 Val_Wu16 65535.00 DFES_OneToOne 0.00 65535.00 FORMAT "%8.2" /end CHARACTERISTIC
/begin CHARACTERISTIC DFES_DTCO.DFC_ComTOutTCU02_C "OBD specific trouble code / OBD specific diagnostic trouble code for check DFC_ComTOutTCU02" VALUE 0x80504502 Val_Wu16 65535.00 DFES_OneToOne 0.00 65535.00 FORMAT "%8.2" /end CHARACTERISTIC
/begin CHARACTERISTIC DFES_DTCO.DFC_ComTOutTCU1_C "OBD specific trouble code / OBD specific diagnostic trouble code for check DFC_ComTOutTCU1" VALUE 0x80504504 Val_Wu16 65535.00 DFES_OneToOne 0.00 65535.00 FORMAT "%8.2" /end CHARACTERISTIC
/begin CHARACTERISTIC DFES_DTCO.DFC_ComTOutTCU11_C "OBD specific trouble code / OBD specific diagnostic trouble code for check DFC_ComTOutTCU11" VALUE 0x80504506 Val_Wu16 65535.00 DFES_OneToOne 0.00 65535.00 FORMAT "%8.2" /end CHARACTERISTIC
/begin CHARACTERISTIC DFES_DTCO.DFC_ComTOutTCU12_C "OBD specific trouble code / OBD specific diagnostic trouble code for check DFC_ComTOutTCU12" VALUE 0x80504508 Val_Wu16 65535.00 DFES_OneToOne 0.00 65535.00 FORMAT "%8.2" /end CHARACTERISTIC
/begin CHARACTERISTIC DFES_DTCO.DFC_ComTOutTCU13_C "OBD specific trouble code / OBD specific diagnostic trouble code for check DFC_ComTOutTCU13" VALUE 0x8050450A Val_Wu16 65535.00 DFES_OneToOne 0.00 65535.00 FORMAT "%8.2" /end CHARACTERISTIC
/begin CHARACTERISTIC DFES_DTCO.DFC_ComTOutTCU14_C "OBD specific trouble code / OBD specific diagnostic trouble code for check DFC_ComTOutTCU14" VALUE 0x8050450C Val_Wu16 65535.00 DFES_OneToOne 0.00 65535.00 FORMAT "%8.2" /end CHARACTERISTIC
/begin CHARACTERISTIC DFES_DTCO.DFC_ComTOutTCU2_C "OBD specific trouble code / OBD specific diagnostic trouble code for check DFC_ComTOutTCU2" VALUE 0x8050450E Val_Wu16 65535.00 DFES_OneToOne 0.00 65535.00 FORMAT "%8.2" /end CHARACTERISTIC
/begin CHARACTERISTIC DFES_DTCO.DFC_ComTOutTCU3_C "OBD specific trouble code / OBD specific diagnostic trouble code for check DFC_ComTOutTCU3" VALUE 0x80504510 Val_Wu16 65535.00 DFES_OneToOne 0.00 65535.00 FORMAT "%8.2" /end CHARACTERISTIC
/begin CHARACTERISTIC DFES_DTCO.DFC_ComTOutTCU4_C "OBD specific trouble code / OBD specific diagnostic trouble code for check DFC_ComTOutTCU4" VALUE 0x80504512 Val_Wu16 65535.00 DFES_OneToOne 0.00 65535.00 FORMAT "%8.2" /end CHARACTERISTIC
/begin CHARACTERISTIC DFES_DTCO.DFC_DevLibBattUHi_C "OBD specific trouble code / OBD specific diagnostic trouble code for check DFC_DevLibBattUHi" VALUE 0x80504514 Val_Wu16 65535.00 DFES_OneToOne 0.00 65535.00 FORMAT "%8.2" /end CHARACTERISTIC
/begin CHARACTERISTIC DFES_DTCO.DFC_DevLibBattULo_C "OBD specific trouble code / OBD specific diagnostic trouble code for check DFC_DevLibBattULo" VALUE 0x80504516 Val_Wu16 65535.00 DFES_OneToOne 0.00 65535.00 FORMAT "%8.2" /end CHARACTERISTIC
/begin CHARACTERISTIC DFES_DTCO.DFC_EGRVlvFailSafeActv_C "OBD specific trouble code / OBD specific diagnostic trouble code for check DFC_EGRVlvFailSafeActv" VALUE 0x80504518 Val_Wu16 65535.00 DFES_OneToOne 0.00 65535.00 FORMAT "%8.2" /end CHARACTERISTIC
/begin CHARACTERISTIC DFES_DTCO.DFC_EGRVlvGovDvtCld_C "OBD specific trouble code / OBD specific diagnostic trouble code for check DFC_EGRVlvGovDvtCld" VALUE 0x8050451A Val_Wu16 65535.00 DFES_OneToOne 0.00 65535.00 FORMAT "%8.2" /end CHARACTERISTIC
/begin CHARACTERISTIC DFES_DTCO.DFC_EGRVlvPhysSRCMax_C "OBD specific trouble code / OBD specific diagnostic trouble code for check DFC_EGRVlvPhysSRCMax" VALUE 0x8050451C Val_Wu16 65535.00 DFES_OneToOne 0.00 65535.00 FORMAT "%8.2" /end CHARACTERISTIC
/begin CHARACTERISTIC DFES_DTCO.DFC_EGRVlvPhysSRCMin_C "OBD specific trouble code / OBD specific diagnostic trouble code for check DFC_EGRVlvPhysSRCMin" VALUE 0x8050451E Val_Wu16 65535.00 DFES_OneToOne 0.00 65535.00 FORMAT "%8.2" /end CHARACTERISTIC
/begin CHARACTERISTIC DFES_DTCO.DFC_FanDIOOL_0_C "OBD specific trouble code / OBD specific diagnostic trouble code for check DFC_FanDIOOL_0" VALUE 0x80504520 Val_Wu16 65535.00 DFES_OneToOne 0.00 65535.00 FORMAT "%8.2" /end CHARACTERISTIC
/begin CHARACTERISTIC DFES_DTCO.DFC_FanDIOOL_1_C "OBD specific trouble code / OBD specific diagnostic trouble code for check DFC_FanDIOOL_1" VALUE 0x80504522 Val_Wu16 65535.00 DFES_OneToOne 0.00 65535.00 FORMAT "%8.2" /end CHARACTERISTIC
/begin CHARACTERISTIC DFES_DTCO.DFC_FanDIOOvrTemp_0_C "OBD specific trouble code / OBD specific diagnostic trouble code for check DFC_FanDIOOvrTemp_0" VALUE 0x80504524 Val_Wu16 65535.00 DFES_OneToOne 0.00 65535.00 FORMAT "%8.2" /end CHARACTERISTIC
/begin CHARACTERISTIC DFES_DTCO.DFC_FanDIOOvrTemp_1_C "OBD specific trouble code / OBD specific diagnostic trouble code for check DFC_FanDIOOvrTemp_1" VALUE 0x80504526 Val_Wu16 65535.00 DFES_OneToOne 0.00 65535.00 FORMAT "%8.2" /end CHARACTERISTIC
/begin CHARACTERISTIC DFES_DTCO.DFC_FanDIOSCB_0_C "OBD specific trouble code / OBD specific diagnostic trouble code for check DFC_FanDIOSCB_0" VALUE 0x80504528 Val_Wu16 65535.00 DFES_OneToOne 0.00 65535.00 FORMAT "%8.2" /end CHARACTERISTIC
/begin CHARACTERISTIC DFES_DTCO.DFC_FanDIOSCB_1_C "OBD specific trouble code / OBD specific diagnostic trouble code for check DFC_FanDIOSCB_1" VALUE 0x8050452A Val_Wu16 65535.00 DFES_OneToOne 0.00 65535.00 FORMAT "%8.2" /end CHARACTERISTIC
/begin CHARACTERISTIC DFES_DTCO.DFC_FanDIOSCG_0_C "OBD specific trouble code / OBD specific diagnostic trouble code for check DFC_FanDIOSCG_0" VALUE 0x8050452C Val_Wu16 65535.00 DFES_OneToOne 0.00 65535.00 FORMAT "%8.2" /end CHARACTERISTIC
/begin CHARACTERISTIC DFES_DTCO.DFC_FanDIOSCG_1_C "OBD specific trouble code / OBD specific diagnostic trouble code for check DFC_FanDIOSCG_1" VALUE 0x8050452E Val_Wu16 65535.00 DFES_OneToOne 0.00 65535.00 FORMAT "%8.2" /end CHARACTERISTIC
/begin CHARACTERISTIC DFES_DTCO.DFC_MRlyDcOL_C "OBD specific trouble code / OBD specific diagnostic trouble code for check DFC_MRlyDcOL" VALUE 0x80504530 Val_Wu16 65535.00 DFES_OneToOne 0.00 65535.00 FORMAT "%8.2" /end CHARACTERISTIC
/begin CHARACTERISTIC DFES_DTCO.DFC_MRlyDcSCB_C "OBD specific trouble code / OBD specific diagnostic trouble code for check DFC_MRlyDcSCB" VALUE 0x80504532 Val_Wu16 65535.00 DFES_OneToOne 0.00 65535.00 FORMAT "%8.2" /end CHARACTERISTIC
/begin CHARACTERISTIC DFES_DTCO.DFC_MRlyDcSCG_C "OBD specific trouble code / OBD specific diagnostic trouble code for check DFC_MRlyDcSCG" VALUE 0x80504534 Val_Wu16 65535.00 DFES_OneToOne 0.00 65535.00 FORMAT "%8.2" /end CHARACTERISTIC
/begin CHARACTERISTIC DFES_DTCO.DFC_PSPOL_C "OBD specific trouble code / OBD specific diagnostic trouble code for check DFC_PSPOL" VALUE 0x80504536 Val_Wu16 65535.00 DFES_OneToOne 0.00 65535.00 FORMAT "%8.2" /end CHARACTERISTIC
/begin CHARACTERISTIC DFES_DTCO.DFC_PSPOvrTemp_C "OBD specific trouble code / OBD specific diagnostic trouble code for check DFC_PSPOvrTemp" VALUE 0x80504538 Val_Wu16 65535.00 DFES_OneToOne 0.00 65535.00 FORMAT "%8.2" /end CHARACTERISTIC
/begin CHARACTERISTIC DFES_DTCO.DFC_PSPSCB_C "OBD specific trouble code / OBD specific diagnostic trouble code for check DFC_PSPSCB" VALUE 0x8050453A Val_Wu16 65535.00 DFES_OneToOne 0.00 65535.00 FORMAT "%8.2" /end CHARACTERISTIC
/begin CHARACTERISTIC DFES_DTCO.DFC_PSPSCG_C "OBD specific trouble code / OBD specific diagnostic trouble code for check DFC_PSPSCG" VALUE 0x8050453C Val_Wu16 65535.00 DFES_OneToOne 0.00 65535.00 FORMAT "%8.2" /end CHARACTERISTIC
/begin CHARACTERISTIC DFES_DTCO.DFC_T50Err_C "OBD specific trouble code / OBD specific diagnostic trouble code for check DFC_T50Err" VALUE 0x8050453E Val_Wu16 65535.00 DFES_OneToOne 0.00 65535.00 FORMAT "%8.2" /end CHARACTERISTIC
/begin CHARACTERISTIC DFES_DTCO.DFC_ThrVlvLoBattB1_C "OBD specific trouble code / OBD specific diagnostic trouble code for check DFC_ThrVlvLoBattB1" VALUE 0x80504540 Val_Wu16 65535.00 DFES_OneToOne 0.00 65535.00 FORMAT "%8.2" /end CHARACTERISTIC
/begin CHARACTERISTIC DFES_DTCO.DFC_UegoSigOperPlausS1B1_C "OBD specific trouble code / OBD specific diagnostic trouble code for check DFC_UegoSigOperPlausS1B1" VALUE 0x80504542 Val_Wu16 65535.00 DFES_OneToOne 0.00 65535.00 FORMAT "%8.2" /end CHARACTERISTIC
/begin CHARACTERISTIC DFES_DTCO.DFC_VehVPhysRngHi_C "OBD specific trouble code / OBD specific diagnostic trouble code for check DFC_VehVPhysRngHi" VALUE 0x80504544 Val_Wu16 65535.00 DFES_OneToOne 0.00 65535.00 FORMAT "%8.2" /end CHARACTERISTIC
/begin CHARACTERISTIC DFES_DTCO.DFC_VehVSclOutOL_C "OBD specific trouble code / OBD specific diagnostic trouble code for check DFC_VehVSclOutOL" VALUE 0x80504546 Val_Wu16 65535.00 DFES_OneToOne 0.00 65535.00 FORMAT "%8.2" /end CHARACTERISTIC
/begin CHARACTERISTIC DFES_DTCO.DFC_VehVSclOutOT_C "OBD specific trouble code / OBD specific diagnostic trouble code for check DFC_VehVSclOutOT" VALUE 0x80504548 Val_Wu16 65535.00 DFES_OneToOne 0.00 65535.00 FORMAT "%8.2" /end CHARACTERISTIC
/begin CHARACTERISTIC DFES_DTCO.DFC_VehVSclOutSCB_C "OBD specific trouble code / OBD specific diagnostic trouble code for check DFC_VehVSclOutSCB" VALUE 0x8050454A Val_Wu16 65535.00 DFES_OneToOne 0.00 65535.00 FORMAT "%8.2" /end CHARACTERISTIC
/begin CHARACTERISTIC DFES_DTCO.DFC_VehVSclOutSCG_C "OBD specific trouble code / OBD specific diagnostic trouble code for check DFC_VehVSclOutSCG" VALUE 0x8050454C Val_Wu16 65535.00 DFES_OneToOne 0.00 65535.00 FORMAT "%8.2" /end CHARACTERISTIC
/begin CHARACTERISTIC DFES_DTCO.DFC_VehVSigFL_C "OBD specific trouble code / OBD specific diagnostic trouble code for check DFC_VehVSigFL" VALUE 0x8050454E Val_Wu16 65535.00 DFES_OneToOne 0.00 65535.00 FORMAT "%8.2" /end CHARACTERISTIC
/begin CHARACTERISTIC DFES_DTCO.DFC_VehVSigFR_C "OBD specific trouble code / OBD specific diagnostic trouble code for check DFC_VehVSigFR" VALUE 0x80504550 Val_Wu16 65535.00 DFES_OneToOne 0.00 65535.00 FORMAT "%8.2" /end CHARACTERISTIC
/begin CHARACTERISTIC DFES_DTCO.DFC_VehVSigRL_C "OBD specific trouble code / OBD specific diagnostic trouble code for check DFC_VehVSigRL" VALUE 0x80504552 Val_Wu16 65535.00 DFES_OneToOne 0.00 65535.00 FORMAT "%8.2" /end CHARACTERISTIC
/begin CHARACTERISTIC DFES_DTCO.DFC_VehVSigRR_C "OBD specific trouble code / OBD specific diagnostic trouble code for check DFC_VehVSigRR" VALUE 0x80504554 Val_Wu16 65535.00 DFES_OneToOne 0.00 65535.00 FORMAT "%8.2" /end CHARACTERISTIC
/begin CHARACTERISTIC DFES_DTCO.DFC_VehVSnsrARngHi_C "OBD specific trouble code / OBD specific diagnostic trouble code for check DFC_VehVSnsrARngHi" VALUE 0x80504556 Val_Wu16 65535.00 DFES_OneToOne 0.00 65535.00 FORMAT "%8.2" /end CHARACTERISTIC
/begin CHARACTERISTIC DFES_DTCO.DFC_VehVSnsrBRngHi_C "OBD specific trouble code / OBD specific diagnostic trouble code for check DFC_VehVSnsrBRngHi" VALUE 0x80504558 Val_Wu16 65535.00 DFES_OneToOne 0.00 65535.00 FORMAT "%8.2" /end CHARACTERISTIC
/begin CHARACTERISTIC DFES_DTCO.DFC_VehVSpdRtyDiag_C "OBD specific trouble code / OBD specific diagnostic trouble code for check DFC_VehVSpdRtyDiag" VALUE 0x8050455A Val_Wu16 65535.00 DFES_OneToOne 0.00 65535.00 FORMAT "%8.2" /end CHARACTERISTIC
/begin CHARACTERISTIC DFES_DTCO.DFC_DHFHD_C "OBD specific trouble code / OBD specific diagnostic trouble code for check DFC_DHFHD" VALUE 0x8050455C Val_Wu16 65535.00 DFES_OneToOne 0.00 65535.00 FORMAT "%8.2" /end CHARACTERISTIC
/begin CHARACTERISTIC DFES_DTCO.DFC_InjVlv_DI_DcDc_C "OBD specific trouble code / OBD specific diagnostic trouble code for check DFC_InjVlv_DI_DcDc" VALUE 0x8050455E Val_Wu16 65535.00 DFES_OneToOne 0.00 65535.00 FORMAT "%8.2" /end CHARACTERISTIC
/begin CHARACTERISTIC DFES_DTCO.DFC_InjVlv_DI_NoLd_0_C "OBD specific trouble code / OBD specific diagnostic trouble code for check DFC_InjVlv_DI_NoLd_0" VALUE 0x80504560 Val_Wu16 65535.00 DFES_OneToOne 0.00 65535.00 FORMAT "%8.2" /end CHARACTERISTIC
/begin CHARACTERISTIC DFES_DTCO.DFC_InjVlv_DI_NoLd_1_C "OBD specific trouble code / OBD specific diagnostic trouble code for check DFC_InjVlv_DI_NoLd_1" VALUE 0x80504562 Val_Wu16 65535.00 DFES_OneToOne 0.00 65535.00 FORMAT "%8.2" /end CHARACTERISTIC
/begin CHARACTERISTIC DFES_DTCO.DFC_InjVlv_DI_NoLd_2_C "OBD specific trouble code / OBD specific diagnostic trouble code for check DFC_InjVlv_DI_NoLd_2" VALUE 0x80504564 Val_Wu16 65535.00 DFES_OneToOne 0.00 65535.00 FORMAT "%8.2" /end CHARACTERISTIC
/begin CHARACTERISTIC DFES_DTCO.DFC_InjVlv_DI_NoLd_3_C "OBD specific trouble code / OBD specific diagnostic trouble code for check DFC_InjVlv_DI_NoLd_3" VALUE 0x80504566 Val_Wu16 65535.00 DFES_OneToOne 0.00 65535.00 FORMAT "%8.2" /end CHARACTERISTIC
/begin CHARACTERISTIC DFES_DTCO.DFC_InjVlv_DI_ScBnk_0_C "OBD specific trouble code / OBD specific diagnostic trouble code for check DFC_InjVlv_DI_ScBnk_0" VALUE 0x80504568 Val_Wu16 65535.00 DFES_OneToOne 0.00 65535.00 FORMAT "%8.2" /end CHARACTERISTIC
/begin CHARACTERISTIC DFES_DTCO.DFC_InjVlv_DI_ScBnk_1_C "OBD specific trouble code / OBD specific diagnostic trouble code for check DFC_InjVlv_DI_ScBnk_1" VALUE 0x8050456A Val_Wu16 65535.00 DFES_OneToOne 0.00 65535.00 FORMAT "%8.2" /end CHARACTERISTIC
/begin CHARACTERISTIC DFES_DTCO.DFC_InjVlv_DI_ScBnk_2_C "OBD specific trouble code / OBD specific diagnostic trouble code for check DFC_InjVlv_DI_ScBnk_2" VALUE 0x8050456C Val_Wu16 65535.00 DFES_OneToOne 0.00 65535.00 FORMAT "%8.2" /end CHARACTERISTIC
/begin CHARACTERISTIC DFES_DTCO.DFC_InjVlv_DI_ScBnk_3_C "OBD specific trouble code / OBD specific diagnostic trouble code for check DFC_InjVlv_DI_ScBnk_3" VALUE 0x8050456E Val_Wu16 65535.00 DFES_OneToOne 0.00 65535.00 FORMAT "%8.2" /end CHARACTERISTIC
/begin CHARACTERISTIC DFES_DTCO.DFC_InjVlv_DI_ScCyl_0_C "OBD specific trouble code / OBD specific diagnostic trouble code for check DFC_InjVlv_DI_ScCyl_0" VALUE 0x80504570 Val_Wu16 65535.00 DFES_OneToOne 0.00 65535.00 FORMAT "%8.2" /end CHARACTERISTIC
/begin CHARACTERISTIC DFES_DTCO.DFC_InjVlv_DI_ScCyl_1_C "OBD specific trouble code / OBD specific diagnostic trouble code for check DFC_InjVlv_DI_ScCyl_1" VALUE 0x80504572 Val_Wu16 65535.00 DFES_OneToOne 0.00 65535.00 FORMAT "%8.2" /end CHARACTERISTIC
/begin CHARACTERISTIC DFES_DTCO.DFC_InjVlv_DI_ScCyl_2_C "OBD specific trouble code / OBD specific diagnostic trouble code for check DFC_InjVlv_DI_ScCyl_2" VALUE 0x80504574 Val_Wu16 65535.00 DFES_OneToOne 0.00 65535.00 FORMAT "%8.2" /end CHARACTERISTIC
/begin CHARACTERISTIC DFES_DTCO.DFC_InjVlv_DI_ScCyl_3_C "OBD specific trouble code / OBD specific diagnostic trouble code for check DFC_InjVlv_DI_ScCyl_3" VALUE 0x80504576 Val_Wu16 65535.00 DFES_OneToOne 0.00 65535.00 FORMAT "%8.2" /end CHARACTERISTIC
/begin CHARACTERISTIC DFES_DTCO.DFC_InjVlv_DI_ScHsLs_0_C "OBD specific trouble code / OBD specific diagnostic trouble code for check DFC_InjVlv_DI_ScHsLs_0" VALUE 0x80504578 Val_Wu16 65535.00 DFES_OneToOne 0.00 65535.00 FORMAT "%8.2" /end CHARACTERISTIC
/begin CHARACTERISTIC DFES_DTCO.DFC_InjVlv_DI_ScHsLs_1_C "OBD specific trouble code / OBD specific diagnostic trouble code for check DFC_InjVlv_DI_ScHsLs_1" VALUE 0x8050457A Val_Wu16 65535.00 DFES_OneToOne 0.00 65535.00 FORMAT "%8.2" /end CHARACTERISTIC
/begin CHARACTERISTIC DFES_DTCO.DFC_InjVlv_DI_ScHsLs_2_C "OBD specific trouble code / OBD specific diagnostic trouble code for check DFC_InjVlv_DI_ScHsLs_2" VALUE 0x8050457C Val_Wu16 65535.00 DFES_OneToOne 0.00 65535.00 FORMAT "%8.2" /end CHARACTERISTIC
/begin CHARACTERISTIC DFES_DTCO.DFC_InjVlv_DI_ScHsLs_3_C "OBD specific trouble code / OBD specific diagnostic trouble code for check DFC_InjVlv_DI_ScHsLs_3" VALUE 0x8050457E Val_Wu16 65535.00 DFES_OneToOne 0.00 65535.00 FORMAT "%8.2" /end CHARACTERISTIC
/begin CHARACTERISTIC DFES_DTCO.DFC_MfPsDiaOpenLoad1_C "OBD specific trouble code / OBD specific diagnostic trouble code for check DFC_MfPsDiaOpenLoad1" VALUE 0x80504580 Val_Wu16 65535.00 DFES_OneToOne 0.00 65535.00 FORMAT "%8.2" /end CHARACTERISTIC
/begin CHARACTERISTIC DFES_DTCO.DFC_MfPsDiaScHiS1_C "OBD specific trouble code / OBD specific diagnostic trouble code for check DFC_MfPsDiaScHiS1" VALUE 0x80504582 Val_Wu16 65535.00 DFES_OneToOne 0.00 65535.00 FORMAT "%8.2" /end CHARACTERISTIC
/begin CHARACTERISTIC DFES_DTCO.DFC_MfPsDiaScHiSLowS1_C "OBD specific trouble code / OBD specific diagnostic trouble code for check DFC_MfPsDiaScHiSLowS1" VALUE 0x80504584 Val_Wu16 65535.00 DFES_OneToOne 0.00 65535.00 FORMAT "%8.2" /end CHARACTERISTIC
/begin CHARACTERISTIC DFES_DTCO.DFC_MfPsDiaScLowS1_C "OBD specific trouble code / OBD specific diagnostic trouble code for check DFC_MfPsDiaScLowS1" VALUE 0x80504586 Val_Wu16 65535.00 DFES_OneToOne 0.00 65535.00 FORMAT "%8.2" /end CHARACTERISTIC
/begin CHARACTERISTIC DFES_DTCO.DFC_ACEvpTPhysRngHi_C "OBD specific trouble code / OBD specific diagnostic trouble code for check DFC_ACEvpTPhysRngHi" VALUE 0x80504588 Val_Wu16 65535.00 DFES_OneToOne 0.00 65535.00 FORMAT "%8.2" /end CHARACTERISTIC
/begin CHARACTERISTIC DFES_DTCO.DFC_ACEvpTPhysRngLo_C "OBD specific trouble code / OBD specific diagnostic trouble code for check DFC_ACEvpTPhysRngLo" VALUE 0x8050458A Val_Wu16 65535.00 DFES_OneToOne 0.00 65535.00 FORMAT "%8.2" /end CHARACTERISTIC
/begin CHARACTERISTIC DFES_DTCO.DFC_ACEvpTSRCMax_C "OBD specific trouble code / OBD specific diagnostic trouble code for check DFC_ACEvpTSRCMax" VALUE 0x8050458C Val_Wu16 65535.00 DFES_OneToOne 0.00 65535.00 FORMAT "%8.2" /end CHARACTERISTIC
/begin CHARACTERISTIC DFES_DTCO.DFC_ACEvpTSRCMin_C "OBD specific trouble code / OBD specific diagnostic trouble code for check DFC_ACEvpTSRCMin" VALUE 0x8050458E Val_Wu16 65535.00 DFES_OneToOne 0.00 65535.00 FORMAT "%8.2" /end CHARACTERISTIC
/begin CHARACTERISTIC DFES_DTCO.DFC_AfsRawSigRngHiB1_C "OBD specific trouble code / OBD specific diagnostic trouble code for check DFC_AfsRawSigRngHiB1" VALUE 0x80504590 Val_Wu16 65535.00 DFES_OneToOne 0.00 65535.00 FORMAT "%8.2" /end CHARACTERISTIC
/begin CHARACTERISTIC DFES_DTCO.DFC_AfsRawSigRngLoB1_C "OBD specific trouble code / OBD specific diagnostic trouble code for check DFC_AfsRawSigRngLoB1" VALUE 0x80504592 Val_Wu16 65535.00 DFES_OneToOne 0.00 65535.00 FORMAT "%8.2" /end CHARACTERISTIC
/begin CHARACTERISTIC DFES_DTCO.DFC_AfsSnsrErrB1_C "OBD specific trouble code / OBD specific diagnostic trouble code for check DFC_AfsSnsrErrB1" VALUE 0x80504594 Val_Wu16 65535.00 DFES_OneToOne 0.00 65535.00 FORMAT "%8.2" /end CHARACTERISTIC
/begin CHARACTERISTIC DFES_DTCO.DFC_AirCClntPAnaSRCMax_C "OBD specific trouble code / OBD specific diagnostic trouble code for check DFC_AirCClntPAnaSRCMax" VALUE 0x80504596 Val_Wu16 65535.00 DFES_OneToOne 0.00 65535.00 FORMAT "%8.2" /end CHARACTERISTIC
/begin CHARACTERISTIC DFES_DTCO.DFC_AirCClntPAnaSRCMin_C "OBD specific trouble code / OBD specific diagnostic trouble code for check DFC_AirCClntPAnaSRCMin" VALUE 0x80504598 Val_Wu16 65535.00 DFES_OneToOne 0.00 65535.00 FORMAT "%8.2" /end CHARACTERISTIC
/begin CHARACTERISTIC DFES_DTCO.DFC_AirCSwtNpl_C "OBD specific trouble code / OBD specific diagnostic trouble code for check DFC_AirCSwtNpl" VALUE 0x8050459A Val_Wu16 65535.00 DFES_OneToOne 0.00 65535.00 FORMAT "%8.2" /end CHARACTERISTIC
/begin CHARACTERISTIC DFES_DTCO.DFC_AirCSwtSig_C "OBD specific trouble code / OBD specific diagnostic trouble code for check DFC_AirCSwtSig" VALUE 0x8050459C Val_Wu16 65535.00 DFES_OneToOne 0.00 65535.00 FORMAT "%8.2" /end CHARACTERISTIC
/begin CHARACTERISTIC DFES_DTCO.DFC_Brk_C "OBD specific trouble code / OBD specific diagnostic trouble code for check DFC_Brk" VALUE 0x8050459E Val_Wu16 65535.00 DFES_OneToOne 0.00 65535.00 FORMAT "%8.2" /end CHARACTERISTIC
/begin CHARACTERISTIC DFES_DTCO.DFC_BrkBstSensSCB_C "OBD specific trouble code / OBD specific diagnostic trouble code for check DFC_BrkBstSensSCB" VALUE 0x805045A0 Val_Wu16 65535.00 DFES_OneToOne 0.00 65535.00 FORMAT "%8.2" /end CHARACTERISTIC
/begin CHARACTERISTIC DFES_DTCO.DFC_BrkBstSensSCG_C "OBD specific trouble code / OBD specific diagnostic trouble code for check DFC_BrkBstSensSCG" VALUE 0x805045A2 Val_Wu16 65535.00 DFES_OneToOne 0.00 65535.00 FORMAT "%8.2" /end CHARACTERISTIC
/begin CHARACTERISTIC DFES_DTCO.DFC_BrkSig_C "OBD specific trouble code / OBD specific diagnostic trouble code for check DFC_BrkSig" VALUE 0x805045A4 Val_Wu16 65535.00 DFES_OneToOne 0.00 65535.00 FORMAT "%8.2" /end CHARACTERISTIC
/begin CHARACTERISTIC DFES_DTCO.DFC_ClthSig_C "OBD specific trouble code / OBD specific diagnostic trouble code for check DFC_ClthSig" VALUE 0x805045A6 Val_Wu16 65535.00 DFES_OneToOne 0.00 65535.00 FORMAT "%8.2" /end CHARACTERISTIC
/begin CHARACTERISTIC DFES_DTCO.DFC_EGRVlvCurrLim_C "OBD specific trouble code / OBD specific diagnostic trouble code for check DFC_EGRVlvCurrLim" VALUE 0x805045A8 Val_Wu16 65535.00 DFES_OneToOne 0.00 65535.00 FORMAT "%8.2" /end CHARACTERISTIC
/begin CHARACTERISTIC DFES_DTCO.DFC_EGRVlvOL_C "OBD specific trouble code / OBD specific diagnostic trouble code for check DFC_EGRVlvOL" VALUE 0x805045AA Val_Wu16 65535.00 DFES_OneToOne 0.00 65535.00 FORMAT "%8.2" /end CHARACTERISTIC
/begin CHARACTERISTIC DFES_DTCO.DFC_EGRVlvOvrTemp_C "OBD specific trouble code / OBD specific diagnostic trouble code for check DFC_EGRVlvOvrTemp" VALUE 0x805045AC Val_Wu16 65535.00 DFES_OneToOne 0.00 65535.00 FORMAT "%8.2" /end CHARACTERISTIC
/begin CHARACTERISTIC DFES_DTCO.DFC_EGRVlvSCB_C "OBD specific trouble code / OBD specific diagnostic trouble code for check DFC_EGRVlvSCB" VALUE 0x805045AE Val_Wu16 65535.00 DFES_OneToOne 0.00 65535.00 FORMAT "%8.2" /end CHARACTERISTIC
/begin CHARACTERISTIC DFES_DTCO.DFC_EGRVlvSCG_C "OBD specific trouble code / OBD specific diagnostic trouble code for check DFC_EGRVlvSCG" VALUE 0x805045B0 Val_Wu16 65535.00 DFES_OneToOne 0.00 65535.00 FORMAT "%8.2" /end CHARACTERISTIC
/begin CHARACTERISTIC DFES_DTCO.DFC_EGRVlvSRCMax_C "OBD specific trouble code / OBD specific diagnostic trouble code for check DFC_EGRVlvSRCMax" VALUE 0x805045B2 Val_Wu16 65535.00 DFES_OneToOne 0.00 65535.00 FORMAT "%8.2" /end CHARACTERISTIC
/begin CHARACTERISTIC DFES_DTCO.DFC_EGRVlvSRCMin_C "OBD specific trouble code / OBD specific diagnostic trouble code for check DFC_EGRVlvSRCMin" VALUE 0x805045B4 Val_Wu16 65535.00 DFES_OneToOne 0.00 65535.00 FORMAT "%8.2" /end CHARACTERISTIC
/begin CHARACTERISTIC DFES_DTCO.DFC_HLSDemOvhtEngLim_C "OBD specific trouble code / OBD specific diagnostic trouble code for check DFC_HLSDemOvhtEngLim" VALUE 0x805045B6 Val_Wu16 65535.00 DFES_OneToOne 0.00 65535.00 FORMAT "%8.2" /end CHARACTERISTIC
/begin CHARACTERISTIC DFES_DTCO.DFC_OilPSwmpSRCMax_C "OBD specific trouble code / OBD specific diagnostic trouble code for check DFC_OilPSwmpSRCMax" VALUE 0x805045B8 Val_Wu16 65535.00 DFES_OneToOne 0.00 65535.00 FORMAT "%8.2" /end CHARACTERISTIC
/begin CHARACTERISTIC DFES_DTCO.DFC_OilPSwmpSRCMin_C "OBD specific trouble code / OBD specific diagnostic trouble code for check DFC_OilPSwmpSRCMin" VALUE 0x805045BA Val_Wu16 65535.00 DFES_OneToOne 0.00 65535.00 FORMAT "%8.2" /end CHARACTERISTIC
/begin CHARACTERISTIC DFES_DTCO.DFC_PIntkVUsLineHiB1_C "OBD specific trouble code / OBD specific diagnostic trouble code for check DFC_PIntkVUsLineHiB1" VALUE 0x805045BC Val_Wu16 65535.00 DFES_OneToOne 0.00 65535.00 FORMAT "%8.2" /end CHARACTERISTIC
/begin CHARACTERISTIC DFES_DTCO.DFC_PIntkVUsLineLoB1_C "OBD specific trouble code / OBD specific diagnostic trouble code for check DFC_PIntkVUsLineLoB1" VALUE 0x805045BE Val_Wu16 65535.00 DFES_OneToOne 0.00 65535.00 FORMAT "%8.2" /end CHARACTERISTIC
/begin CHARACTERISTIC DFES_DTCO.DFC_VehVPhysRngLo_C "OBD specific trouble code / OBD specific diagnostic trouble code for check DFC_VehVPhysRngLo" VALUE 0x805045C0 Val_Wu16 65535.00 DFES_OneToOne 0.00 65535.00 FORMAT "%8.2" /end CHARACTERISTIC
/begin CHARACTERISTIC DFES_DTCO.DFC_VehVSigCan_C "OBD specific trouble code / OBD specific diagnostic trouble code for check DFC_VehVSigCan" VALUE 0x805045C2 Val_Wu16 65535.00 DFES_OneToOne 0.00 65535.00 FORMAT "%8.2" /end CHARACTERISTIC
/begin CHARACTERISTIC DFES_DTCO.DFC_VehVSigCanSafe_C "OBD specific trouble code / OBD specific diagnostic trouble code for check DFC_VehVSigCanSafe" VALUE 0x805045C4 Val_Wu16 65535.00 DFES_OneToOne 0.00 65535.00 FORMAT "%8.2" /end CHARACTERISTIC
/begin CHARACTERISTIC DFES_DTCO.DFC_VlvLftFbOilPSnsrIntk11SRCMax_C "OBD specific trouble code / OBD specific diagnostic trouble code for check DFC_VlvLftFbOilPSnsrIntk11SRCMax" VALUE 0x805045C6 Val_Wu16 65535.00 DFES_OneToOne 0.00 65535.00 FORMAT "%8.2" /end CHARACTERISTIC
/begin CHARACTERISTIC DFES_DTCO.DFC_VlvLftFbOilPSnsrIntk11SRCMin_C "OBD specific trouble code / OBD specific diagnostic trouble code for check DFC_VlvLftFbOilPSnsrIntk11SRCMin" VALUE 0x805045C8 Val_Wu16 65535.00 DFES_OneToOne 0.00 65535.00 FORMAT "%8.2" /end CHARACTERISTIC
/begin CHARACTERISTIC DFES_DTCO.DFC_ClthNpl_C "OBD specific trouble code / OBD specific diagnostic trouble code for check DFC_ClthNpl" VALUE 0x805045CA Val_Wu16 65535.00 DFES_OneToOne 0.00 65535.00 FORMAT "%8.2" /end CHARACTERISTIC
/begin CHARACTERISTIC DFES_DTCO.DFC_GbxPNPosnDrvCdn_C "OBD specific trouble code / OBD specific diagnostic trouble code for check DFC_GbxPNPosnDrvCdn" VALUE 0x805045CC Val_Wu16 65535.00 DFES_OneToOne 0.00 65535.00 FORMAT "%8.2" /end CHARACTERISTIC
/begin CHARACTERISTIC DFES_DTCO.DFC_GbxPNPosnPlausy_C "OBD specific trouble code / OBD specific diagnostic trouble code for check DFC_GbxPNPosnPlausy" VALUE 0x805045CE Val_Wu16 65535.00 DFES_OneToOne 0.00 65535.00 FORMAT "%8.2" /end CHARACTERISTIC
/begin CHARACTERISTIC DFES_DTCO.DFC_AfsSigErrLineHiB1_C "OBD specific trouble code / OBD specific diagnostic trouble code for check DFC_AfsSigErrLineHiB1" VALUE 0x805045D0 Val_Wu16 65535.00 DFES_OneToOne 0.00 65535.00 FORMAT "%8.2" /end CHARACTERISTIC
/begin CHARACTERISTIC DFES_DTCO.DFC_AfsSigErrLineLoB1_C "OBD specific trouble code / OBD specific diagnostic trouble code for check DFC_AfsSigErrLineLoB1" VALUE 0x805045D2 Val_Wu16 65535.00 DFES_OneToOne 0.00 65535.00 FORMAT "%8.2" /end CHARACTERISTIC
/begin CHARACTERISTIC DFES_DTCO.DFC_PEnvCcMax_C "OBD specific trouble code / OBD specific diagnostic trouble code for check DFC_PEnvCcMax" VALUE 0x805045D4 Val_Wu16 65535.00 DFES_OneToOne 0.00 65535.00 FORMAT "%8.2" /end CHARACTERISTIC
/begin CHARACTERISTIC DFES_DTCO.DFC_PEnvCcMin_C "OBD specific trouble code / OBD specific diagnostic trouble code for check DFC_PEnvCcMin" VALUE 0x805045D6 Val_Wu16 65535.00 DFES_OneToOne 0.00 65535.00 FORMAT "%8.2" /end CHARACTERISTIC
/begin CHARACTERISTIC DFES_DTCO.DFC_PEnvRngChkMax_C "OBD specific trouble code / OBD specific diagnostic trouble code for check DFC_PEnvRngChkMax" VALUE 0x805045D8 Val_Wu16 65535.00 DFES_OneToOne 0.00 65535.00 FORMAT "%8.2" /end CHARACTERISTIC
/begin CHARACTERISTIC DFES_DTCO.DFC_PEnvRngChkMin_C "OBD specific trouble code / OBD specific diagnostic trouble code for check DFC_PEnvRngChkMin" VALUE 0x805045DA Val_Wu16 65535.00 DFES_OneToOne 0.00 65535.00 FORMAT "%8.2" /end CHARACTERISTIC
/begin CHARACTERISTIC DFES_DTCO.DFC_PEnvSnsrPlaus_C "OBD specific trouble code / OBD specific diagnostic trouble code for check DFC_PEnvSnsrPlaus" VALUE 0x805045DC Val_Wu16 65535.00 DFES_OneToOne 0.00 65535.00 FORMAT "%8.2" /end CHARACTERISTIC
/begin CHARACTERISTIC DFES_DTCO.DFC_UEGOHeatrRlyPsOLS1B1_C "OBD specific trouble code / OBD specific diagnostic trouble code for check DFC_UEGOHeatrRlyPsOLS1B1" VALUE 0x805045DE Val_Wu16 65535.00 DFES_OneToOne 0.00 65535.00 FORMAT "%8.2" /end CHARACTERISTIC
/begin CHARACTERISTIC DFES_DTCO.DFC_UEGOHeatrRlyPsSCBS1B1_C "OBD specific trouble code / OBD specific diagnostic trouble code for check DFC_UEGOHeatrRlyPsSCBS1B1" VALUE 0x805045E0 Val_Wu16 65535.00 DFES_OneToOne 0.00 65535.00 FORMAT "%8.2" /end CHARACTERISTIC
/begin CHARACTERISTIC DFES_DTCO.DFC_UEGOHeatrRlyPsSCGS1B1_C "OBD specific trouble code / OBD specific diagnostic trouble code for check DFC_UEGOHeatrRlyPsSCGS1B1" VALUE 0x805045E2 Val_Wu16 65535.00 DFES_OneToOne 0.00 65535.00 FORMAT "%8.2" /end CHARACTERISTIC
/begin CHARACTERISTIC DFES_DTCO.DFC_UegoHeatrWireOlS1B1_C "OBD specific trouble code / OBD specific diagnostic trouble code for check DFC_UegoHeatrWireOlS1B1" VALUE 0x805045E4 Val_Wu16 65535.00 DFES_OneToOne 0.00 65535.00 FORMAT "%8.2" /end CHARACTERISTIC
/begin CHARACTERISTIC DFES_DTCO.DFC_UegoHeatrWireScbS1B1_C "OBD specific trouble code / OBD specific diagnostic trouble code for check DFC_UegoHeatrWireScbS1B1" VALUE 0x805045E6 Val_Wu16 65535.00 DFES_OneToOne 0.00 65535.00 FORMAT "%8.2" /end CHARACTERISTIC
/begin CHARACTERISTIC DFES_DTCO.DFC_UegoHeatrWireScgS1B1_C "OBD specific trouble code / OBD specific diagnostic trouble code for check DFC_UegoHeatrWireScgS1B1" VALUE 0x805045E8 Val_Wu16 65535.00 DFES_OneToOne 0.00 65535.00 FORMAT "%8.2" /end CHARACTERISTIC
/begin CHARACTERISTIC DFES_DTCO.DFC_KnDetSens1PortAMax_C "OBD specific trouble code / OBD specific diagnostic trouble code for check DFC_KnDetSens1PortAMax" VALUE 0x805045EA Val_Wu16 65535.00 DFES_OneToOne 0.00 65535.00 FORMAT "%8.2" /end CHARACTERISTIC
/begin CHARACTERISTIC DFES_DTCO.DFC_KnDetSens1PortAMin_C "OBD specific trouble code / OBD specific diagnostic trouble code for check DFC_KnDetSens1PortAMin" VALUE 0x805045EC Val_Wu16 65535.00 DFES_OneToOne 0.00 65535.00 FORMAT "%8.2" /end CHARACTERISTIC
/begin CHARACTERISTIC DFES_DTCO.DFC_KnDetSens1PortBMax_C "OBD specific trouble code / OBD specific diagnostic trouble code for check DFC_KnDetSens1PortBMax" VALUE 0x805045EE Val_Wu16 65535.00 DFES_OneToOne 0.00 65535.00 FORMAT "%8.2" /end CHARACTERISTIC
/begin CHARACTERISTIC DFES_DTCO.DFC_KnDetSens1PortBMin_C "OBD specific trouble code / OBD specific diagnostic trouble code for check DFC_KnDetSens1PortBMin" VALUE 0x805045F0 Val_Wu16 65535.00 DFES_OneToOne 0.00 65535.00 FORMAT "%8.2" /end CHARACTERISTIC
/begin CHARACTERISTIC DFES_DTCO.DFC_Clth2ONStuck_C "OBD specific trouble code / OBD specific diagnostic trouble code for check DFC_Clth2ONStuck" VALUE 0x805045F2 Val_Wu16 65535.00 DFES_OneToOne 0.00 65535.00 FORMAT "%8.2" /end CHARACTERISTIC
/begin CHARACTERISTIC DFES_DTCO.DFC_Clth2ONStuckLdc_C "OBD specific trouble code / OBD specific diagnostic trouble code for check DFC_Clth2ONStuckLdc" VALUE 0x805045F4 Val_Wu16 65535.00 DFES_OneToOne 0.00 65535.00 FORMAT "%8.2" /end CHARACTERISTIC
/begin CHARACTERISTIC DFES_DTCO.DFC_Clth3ONStuckLdc_C "OBD specific trouble code / OBD specific diagnostic trouble code for check DFC_Clth3ONStuckLdc" VALUE 0x805045F6 Val_Wu16 65535.00 DFES_OneToOne 0.00 65535.00 FORMAT "%8.2" /end CHARACTERISTIC
/begin CHARACTERISTIC DFES_DTCO.DFC_Clth3ONStuckPostDrv_C "OBD specific trouble code / OBD specific diagnostic trouble code for check DFC_Clth3ONStuckPostDrv" VALUE 0x805045F8 Val_Wu16 65535.00 DFES_OneToOne 0.00 65535.00 FORMAT "%8.2" /end CHARACTERISTIC
/begin CHARACTERISTIC DFES_DTCO.DFC_Clth4ONStuck_C "OBD specific trouble code / OBD specific diagnostic trouble code for check DFC_Clth4ONStuck" VALUE 0x805045FA Val_Wu16 65535.00 DFES_OneToOne 0.00 65535.00 FORMAT "%8.2" /end CHARACTERISTIC
/begin CHARACTERISTIC DFES_DTCO.DFC_Clth4ONStuckLdc_C "OBD specific trouble code / OBD specific diagnostic trouble code for check DFC_Clth4ONStuckLdc" VALUE 0x805045FC Val_Wu16 65535.00 DFES_OneToOne 0.00 65535.00 FORMAT "%8.2" /end CHARACTERISTIC
/begin CHARACTERISTIC DFES_DTCO.DFC_ComBCMUnit_C "OBD specific trouble code / OBD specific diagnostic trouble code for check DFC_ComBCMUnit" VALUE 0x805045FE Val_Wu16 65535.00 DFES_OneToOne 0.00 65535.00 FORMAT "%8.2" /end CHARACTERISTIC
/begin CHARACTERISTIC DFES_DTCO.DFC_ComDLCTCU01_C "OBD specific trouble code / OBD specific diagnostic trouble code for check DFC_ComDLCTCU01" VALUE 0x80504600 Val_Wu16 65535.00 DFES_OneToOne 0.00 65535.00 FORMAT "%8.2" /end CHARACTERISTIC
/begin CHARACTERISTIC DFES_DTCO.DFC_ComDLCTCU02_C "OBD specific trouble code / OBD specific diagnostic trouble code for check DFC_ComDLCTCU02" VALUE 0x80504602 Val_Wu16 65535.00 DFES_OneToOne 0.00 65535.00 FORMAT "%8.2" /end CHARACTERISTIC
/begin CHARACTERISTIC DFES_DTCO.DFC_ComDLCTCU1_C "OBD specific trouble code / OBD specific diagnostic trouble code for check DFC_ComDLCTCU1" VALUE 0x80504604 Val_Wu16 65535.00 DFES_OneToOne 0.00 65535.00 FORMAT "%8.2" /end CHARACTERISTIC
/begin CHARACTERISTIC DFES_DTCO.DFC_ComDLCTCU11_C "OBD specific trouble code / OBD specific diagnostic trouble code for check DFC_ComDLCTCU11" VALUE 0x80504606 Val_Wu16 65535.00 DFES_OneToOne 0.00 65535.00 FORMAT "%8.2" /end CHARACTERISTIC
/begin CHARACTERISTIC DFES_DTCO.DFC_ComDLCTCU12_C "OBD specific trouble code / OBD specific diagnostic trouble code for check DFC_ComDLCTCU12" VALUE 0x80504608 Val_Wu16 65535.00 DFES_OneToOne 0.00 65535.00 FORMAT "%8.2" /end CHARACTERISTIC
/begin CHARACTERISTIC DFES_DTCO.DFC_ComDLCTCU13_C "OBD specific trouble code / OBD specific diagnostic trouble code for check DFC_ComDLCTCU13" VALUE 0x8050460A Val_Wu16 65535.00 DFES_OneToOne 0.00 65535.00 FORMAT "%8.2" /end CHARACTERISTIC
/begin CHARACTERISTIC DFES_DTCO.DFC_ComDLCTCU14_C "OBD specific trouble code / OBD specific diagnostic trouble code for check DFC_ComDLCTCU14" VALUE 0x8050460C Val_Wu16 65535.00 DFES_OneToOne 0.00 65535.00 FORMAT "%8.2" /end CHARACTERISTIC
/begin CHARACTERISTIC DFES_DTCO.DFC_ComDLCTCU2_C "OBD specific trouble code / OBD specific diagnostic trouble code for check DFC_ComDLCTCU2" VALUE 0x8050460E Val_Wu16 65535.00 DFES_OneToOne 0.00 65535.00 FORMAT "%8.2" /end CHARACTERISTIC
/begin CHARACTERISTIC DFES_DTCO.DFC_ComDLCTCU3_C "OBD specific trouble code / OBD specific diagnostic trouble code for check DFC_ComDLCTCU3" VALUE 0x80504610 Val_Wu16 65535.00 DFES_OneToOne 0.00 65535.00 FORMAT "%8.2" /end CHARACTERISTIC
/begin CHARACTERISTIC DFES_DTCO.DFC_ComDLCTCU4_C "OBD specific trouble code / OBD specific diagnostic trouble code for check DFC_ComDLCTCU4" VALUE 0x80504612 Val_Wu16 65535.00 DFES_OneToOne 0.00 65535.00 FORMAT "%8.2" /end CHARACTERISTIC
/begin CHARACTERISTIC DFES_DTCO.DFC_ComEPSUnit_C "OBD specific trouble code / OBD specific diagnostic trouble code for check DFC_ComEPSUnit" VALUE 0x80504614 Val_Wu16 65535.00 DFES_OneToOne 0.00 65535.00 FORMAT "%8.2" /end CHARACTERISTIC
/begin CHARACTERISTIC DFES_DTCO.DFC_ComIDASBUnit_C "OBD specific trouble code / OBD specific diagnostic trouble code for check DFC_ComIDASBUnit" VALUE 0x80504616 Val_Wu16 65535.00 DFES_OneToOne 0.00 65535.00 FORMAT "%8.2" /end CHARACTERISTIC
/begin CHARACTERISTIC DFES_DTCO.DFC_ComIMGUnit_C "OBD specific trouble code / OBD specific diagnostic trouble code for check DFC_ComIMGUnit" VALUE 0x80504618 Val_Wu16 65535.00 DFES_OneToOne 0.00 65535.00 FORMAT "%8.2" /end CHARACTERISTIC
/begin CHARACTERISTIC DFES_DTCO.DFC_ComMETUnit_C "OBD specific trouble code / OBD specific diagnostic trouble code for check DFC_ComMETUnit" VALUE 0x8050461A Val_Wu16 65535.00 DFES_OneToOne 0.00 65535.00 FORMAT "%8.2" /end CHARACTERISTIC
/begin CHARACTERISTIC DFES_DTCO.DFC_ComSRSUnit_C "OBD specific trouble code / OBD specific diagnostic trouble code for check DFC_ComSRSUnit" VALUE 0x8050461C Val_Wu16 65535.00 DFES_OneToOne 0.00 65535.00 FORMAT "%8.2" /end CHARACTERISTIC
/begin CHARACTERISTIC DFES_DTCO.DFC_ComVSAUnit_C "OBD specific trouble code / OBD specific diagnostic trouble code for check DFC_ComVSAUnit" VALUE 0x8050461E Val_Wu16 65535.00 DFES_OneToOne 0.00 65535.00 FORMAT "%8.2" /end CHARACTERISTIC
/begin CHARACTERISTIC DFES_DTCO.DFC_EbsSocFlt_C "OBD specific trouble code / OBD specific diagnostic trouble code for check DFC_EbsSocFlt" VALUE 0x80504620 Val_Wu16 65535.00 DFES_OneToOne 0.00 65535.00 FORMAT "%8.2" /end CHARACTERISTIC
/begin CHARACTERISTIC DFES_DTCO.DFC_I14229VINErr_C "OBD specific trouble code / OBD specific diagnostic trouble code for check DFC_I14229VINErr" VALUE 0x80504622 Val_Wu16 65535.00 DFES_OneToOne 0.00 65535.00 FORMAT "%8.2" /end CHARACTERISTIC
/begin CHARACTERISTIC DFES_DTCO.DFC_InjCatHeatgErr_C "OBD specific trouble code / OBD specific diagnostic trouble code for check DFC_InjCatHeatgErr" VALUE 0x80504624 Val_Wu16 65535.00 DFES_OneToOne 0.00 65535.00 FORMAT "%8.2" /end CHARACTERISTIC
/begin CHARACTERISTIC DFES_DTCO.DFC_InjSysMulInjDiagErr_C "OBD specific trouble code / OBD specific diagnostic trouble code for check DFC_InjSysMulInjDiagErr" VALUE 0x80504626 Val_Wu16 65535.00 DFES_OneToOne 0.00 65535.00 FORMAT "%8.2" /end CHARACTERISTIC
/begin CHARACTERISTIC DFES_DTCO.DFC_LLRHmax_C "OBD specific trouble code / OBD specific diagnostic trouble code for check DFC_LLRHmax" VALUE 0x80504628 Val_Wu16 65535.00 DFES_OneToOne 0.00 65535.00 FORMAT "%8.2" /end CHARACTERISTIC
/begin CHARACTERISTIC DFES_DTCO.DFC_LLRHmin_C "OBD specific trouble code / OBD specific diagnostic trouble code for check DFC_LLRHmin" VALUE 0x8050462A Val_Wu16 65535.00 DFES_OneToOne 0.00 65535.00 FORMAT "%8.2" /end CHARACTERISTIC
/begin CHARACTERISTIC DFES_DTCO.DFC_LLRHnpl_C "OBD specific trouble code / OBD specific diagnostic trouble code for check DFC_LLRHnpl" VALUE 0x8050462C Val_Wu16 65535.00 DFES_OneToOne 0.00 65535.00 FORMAT "%8.2" /end CHARACTERISTIC
/begin CHARACTERISTIC DFES_DTCO.DFC_LLRKHmax_C "OBD specific trouble code / OBD specific diagnostic trouble code for check DFC_LLRKHmax" VALUE 0x8050462E Val_Wu16 65535.00 DFES_OneToOne 0.00 65535.00 FORMAT "%8.2" /end CHARACTERISTIC
/begin CHARACTERISTIC DFES_DTCO.DFC_LLRKHmin_C "OBD specific trouble code / OBD specific diagnostic trouble code for check DFC_LLRKHmin" VALUE 0x80504630 Val_Wu16 65535.00 DFES_OneToOne 0.00 65535.00 FORMAT "%8.2" /end CHARACTERISTIC
/begin CHARACTERISTIC DFES_DTCO.DFC_LLRKHnpl_C "OBD specific trouble code / OBD specific diagnostic trouble code for check DFC_LLRKHnpl" VALUE 0x80504632 Val_Wu16 65535.00 DFES_OneToOne 0.00 65535.00 FORMAT "%8.2" /end CHARACTERISTIC
/begin CHARACTERISTIC DFES_DTCO.DFC_LinACGUnit_C "OBD specific trouble code / OBD specific diagnostic trouble code for check DFC_LinACGUnit" VALUE 0x80504634 Val_Wu16 65535.00 DFES_OneToOne 0.00 65535.00 FORMAT "%8.2" /end CHARACTERISTIC
/begin CHARACTERISTIC DFES_DTCO.DFC_LinAEVUnit_C "OBD specific trouble code / OBD specific diagnostic trouble code for check DFC_LinAEVUnit" VALUE 0x80504636 Val_Wu16 65535.00 DFES_OneToOne 0.00 65535.00 FORMAT "%8.2" /end CHARACTERISTIC
/begin CHARACTERISTIC DFES_DTCO.DFC_LinEBSUnit_C "OBD specific trouble code / OBD specific diagnostic trouble code for check DFC_LinEBSUnit" VALUE 0x80504638 Val_Wu16 65535.00 DFES_OneToOne 0.00 65535.00 FORMAT "%8.2" /end CHARACTERISTIC
/begin CHARACTERISTIC DFES_DTCO.DFC_RoughRoad_C "OBD specific trouble code / OBD specific diagnostic trouble code for check DFC_RoughRoad" VALUE 0x8050463A Val_Wu16 65535.00 DFES_OneToOne 0.00 65535.00 FORMAT "%8.2" /end CHARACTERISTIC
/begin CHARACTERISTIC DFES_DTCO.DFC_SiaEEPRdErr_C "OBD specific trouble code / OBD specific diagnostic trouble code for check DFC_SiaEEPRdErr" VALUE 0x8050463C Val_Wu16 65535.00 DFES_OneToOne 0.00 65535.00 FORMAT "%8.2" /end CHARACTERISTIC
/begin CHARACTERISTIC DFES_DTCO.DFC_SiaEEPWrngCod_C "OBD specific trouble code / OBD specific diagnostic trouble code for check DFC_SiaEEPWrngCod" VALUE 0x8050463E Val_Wu16 65535.00 DFES_OneToOne 0.00 65535.00 FORMAT "%8.2" /end CHARACTERISTIC
/begin CHARACTERISTIC DFES_DTCO.DFC_UegoHeatrStrtS1B1_C "OBD specific trouble code / OBD specific diagnostic trouble code for check DFC_UegoHeatrStrtS1B1" VALUE 0x80504640 Val_Wu16 65535.00 DFES_OneToOne 0.00 65535.00 FORMAT "%8.2" /end CHARACTERISTIC
/begin CHARACTERISTIC DFES_DTCO.DFC_BusDiagCANAPPLBusOff_C "OBD specific trouble code / OBD specific diagnostic trouble code for check DFC_BusDiagCANAPPLBusOff" VALUE 0x80504642 Val_Wu16 65535.00 DFES_OneToOne 0.00 65535.00 FORMAT "%8.2" /end CHARACTERISTIC
/begin CHARACTERISTIC DFES_DTCO.DFC_BusDiagCANCANCBusOff_C "OBD specific trouble code / OBD specific diagnostic trouble code for check DFC_BusDiagCANCANCBusOff" VALUE 0x80504644 Val_Wu16 65535.00 DFES_OneToOne 0.00 65535.00 FORMAT "%8.2" /end CHARACTERISTIC
/begin CHARACTERISTIC DFES_DTCO.DFC_BusDiagCANVEHICLEBusOff_C "OBD specific trouble code / OBD specific diagnostic trouble code for check DFC_BusDiagCANVEHICLEBusOff" VALUE 0x80504646 Val_Wu16 65535.00 DFES_OneToOne 0.00 65535.00 FORMAT "%8.2" /end CHARACTERISTIC
/begin CHARACTERISTIC DFES_DTCO.DFC_RBA_IODIAGPWR_rba_IoExtCy329_SignalVltSply_0_C "OBD specific trouble code / OBD specific diagnostic trouble code for check DFC_RBA_IODIAGPWR_rba_IoExtCy329_SignalVltSply_0" VALUE 0x80504648 Val_Wu16 65535.00 DFES_OneToOne 0.00 65535.00 FORMAT "%8.2" /end CHARACTERISTIC
/begin CHARACTERISTIC DFES_DTCO.DFC_RBA_IODIAGPWR_rba_IoExtCy329_SignalVltSply_0OT_C "OBD specific trouble code / OBD specific diagnostic trouble code for check DFC_RBA_IODIAGPWR_rba_IoExtCy329_SignalVltSply_0OT" VALUE 0x8050464A Val_Wu16 65535.00 DFES_OneToOne 0.00 65535.00 FORMAT "%8.2" /end CHARACTERISTIC
/begin CHARACTERISTIC DFES_DTCO.DFC_RBA_IODIAGPWR_rba_IoExtCy329_SignalVltSply_0OV_C "OBD specific trouble code / OBD specific diagnostic trouble code for check DFC_RBA_IODIAGPWR_rba_IoExtCy329_SignalVltSply_0OV" VALUE 0x8050464C Val_Wu16 65535.00 DFES_OneToOne 0.00 65535.00 FORMAT "%8.2" /end CHARACTERISTIC
/begin CHARACTERISTIC DFES_DTCO.DFC_RBA_IODIAGPWR_rba_IoExtCy329_SignalVltSply_0SCG_C "OBD specific trouble code / OBD specific diagnostic trouble code for check DFC_RBA_IODIAGPWR_rba_IoExtCy329_SignalVltSply_0SCG" VALUE 0x8050464E Val_Wu16 65535.00 DFES_OneToOne 0.00 65535.00 FORMAT "%8.2" /end CHARACTERISTIC
/begin CHARACTERISTIC DFES_DTCO.DFC_RBA_IODIAGPWR_rba_IoExtCy329_SignalVltSply_0UV_C "OBD specific trouble code / OBD specific diagnostic trouble code for check DFC_RBA_IODIAGPWR_rba_IoExtCy329_SignalVltSply_0UV" VALUE 0x80504650 Val_Wu16 65535.00 DFES_OneToOne 0.00 65535.00 FORMAT "%8.2" /end CHARACTERISTIC
/begin CHARACTERISTIC DFES_DTCO.DFC_RBA_IODIAGPWR_rba_IoExtCy329_SignalVltSply_1_C "OBD specific trouble code / OBD specific diagnostic trouble code for check DFC_RBA_IODIAGPWR_rba_IoExtCy329_SignalVltSply_1" VALUE 0x80504652 Val_Wu16 65535.00 DFES_OneToOne 0.00 65535.00 FORMAT "%8.2" /end CHARACTERISTIC
/begin CHARACTERISTIC DFES_DTCO.DFC_RBA_IODIAGPWR_rba_IoExtCy329_SignalVltSply_1OT_C "OBD specific trouble code / OBD specific diagnostic trouble code for check DFC_RBA_IODIAGPWR_rba_IoExtCy329_SignalVltSply_1OT" VALUE 0x80504654 Val_Wu16 65535.00 DFES_OneToOne 0.00 65535.00 FORMAT "%8.2" /end CHARACTERISTIC
/begin CHARACTERISTIC DFES_DTCO.DFC_RBA_IODIAGPWR_rba_IoExtCy329_SignalVltSply_1OV_C "OBD specific trouble code / OBD specific diagnostic trouble code for check DFC_RBA_IODIAGPWR_rba_IoExtCy329_SignalVltSply_1OV" VALUE 0x80504656 Val_Wu16 65535.00 DFES_OneToOne 0.00 65535.00 FORMAT "%8.2" /end CHARACTERISTIC
/begin CHARACTERISTIC DFES_DTCO.DFC_RBA_IODIAGPWR_rba_IoExtCy329_SignalVltSply_1SCG_C "OBD specific trouble code / OBD specific diagnostic trouble code for check DFC_RBA_IODIAGPWR_rba_IoExtCy329_SignalVltSply_1SCG" VALUE 0x80504658 Val_Wu16 65535.00 DFES_OneToOne 0.00 65535.00 FORMAT "%8.2" /end CHARACTERISTIC
/begin CHARACTERISTIC DFES_DTCO.DFC_RBA_IODIAGPWR_rba_IoExtCy329_SignalVltSply_1UV_C "OBD specific trouble code / OBD specific diagnostic trouble code for check DFC_RBA_IODIAGPWR_rba_IoExtCy329_SignalVltSply_1UV" VALUE 0x8050465A Val_Wu16 65535.00 DFES_OneToOne 0.00 65535.00 FORMAT "%8.2" /end CHARACTERISTIC
/begin CHARACTERISTIC DFES_DTCO.DFC_RBA_IODIAGPWR_rba_IoExtCy329_SignalVltSply_2_C "OBD specific trouble code / OBD specific diagnostic trouble code for check DFC_RBA_IODIAGPWR_rba_IoExtCy329_SignalVltSply_2" VALUE 0x8050465C Val_Wu16 65535.00 DFES_OneToOne 0.00 65535.00 FORMAT "%8.2" /end CHARACTERISTIC
/begin CHARACTERISTIC DFES_DTCO.DFC_RBA_IODIAGPWR_rba_IoExtCy329_SignalVltSply_2OT_C "OBD specific trouble code / OBD specific diagnostic trouble code for check DFC_RBA_IODIAGPWR_rba_IoExtCy329_SignalVltSply_2OT" VALUE 0x8050465E Val_Wu16 65535.00 DFES_OneToOne 0.00 65535.00 FORMAT "%8.2" /end CHARACTERISTIC
/begin CHARACTERISTIC DFES_DTCO.DFC_RBA_IODIAGPWR_rba_IoExtCy329_SignalVltSply_2OV_C "OBD specific trouble code / OBD specific diagnostic trouble code for check DFC_RBA_IODIAGPWR_rba_IoExtCy329_SignalVltSply_2OV" VALUE 0x80504660 Val_Wu16 65535.00 DFES_OneToOne 0.00 65535.00 FORMAT "%8.2" /end CHARACTERISTIC
/begin CHARACTERISTIC DFES_DTCO.DFC_RBA_IODIAGPWR_rba_IoExtCy329_SignalVltSply_2SCG_C "OBD specific trouble code / OBD specific diagnostic trouble code for check DFC_RBA_IODIAGPWR_rba_IoExtCy329_SignalVltSply_2SCG" VALUE 0x80504662 Val_Wu16 65535.00 DFES_OneToOne 0.00 65535.00 FORMAT "%8.2" /end CHARACTERISTIC
/begin CHARACTERISTIC DFES_DTCO.DFC_RBA_IODIAGPWR_rba_IoExtCy329_SignalVltSply_2UV_C "OBD specific trouble code / OBD specific diagnostic trouble code for check DFC_RBA_IODIAGPWR_rba_IoExtCy329_SignalVltSply_2UV" VALUE 0x80504664 Val_Wu16 65535.00 DFES_OneToOne 0.00 65535.00 FORMAT "%8.2" /end CHARACTERISTIC
/begin CHARACTERISTIC DFES_DTCO.DFC_CAN_E_TIMEOUT_C "OBD specific trouble code / OBD specific diagnostic trouble code for check DFC_CAN_E_TIMEOUT" VALUE 0x80504666 Val_Wu16 65535.00 DFES_OneToOne 0.00 65535.00 FORMAT "%8.2" /end CHARACTERISTIC
/begin CHARACTERISTIC DFES_DTCO.DFC_LIN_E_TIMEOUT_C "OBD specific trouble code / OBD specific diagnostic trouble code for check DFC_LIN_E_TIMEOUT" VALUE 0x80504668 Val_Wu16 65535.00 DFES_OneToOne 0.00 65535.00 FORMAT "%8.2" /end CHARACTERISTIC
/begin CHARACTERISTIC DFES_DTCO.DFC_MRlyOL_C "OBD specific trouble code / OBD specific diagnostic trouble code for check DFC_MRlyOL" VALUE 0x8050466A Val_Wu16 65535.00 DFES_OneToOne 0.00 65535.00 FORMAT "%8.2" /end CHARACTERISTIC
/begin CHARACTERISTIC DFES_DTCO.DFC_MRlySCB_C "OBD specific trouble code / OBD specific diagnostic trouble code for check DFC_MRlySCB" VALUE 0x8050466C Val_Wu16 65535.00 DFES_OneToOne 0.00 65535.00 FORMAT "%8.2" /end CHARACTERISTIC
/begin CHARACTERISTIC DFES_DTCO.DFC_MRlySCG_C "OBD specific trouble code / OBD specific diagnostic trouble code for check DFC_MRlySCG" VALUE 0x8050466E Val_Wu16 65535.00 DFES_OneToOne 0.00 65535.00 FORMAT "%8.2" /end CHARACTERISTIC
/begin CHARACTERISTIC DFES_DTCO.DFC_rba_MultiStackTrace_Threshold_C "OBD specific trouble code / OBD specific diagnostic trouble code for check DFC_rba_MultiStackTrace_Threshold" VALUE 0x80504670 Val_Wu16 65535.00 DFES_OneToOne 0.00 65535.00 FORMAT "%8.2" /end CHARACTERISTIC
/begin CHARACTERISTIC DFES_DTCO.DFC_BSWM_E_ACTION_FAILED_C "OBD specific trouble code / OBD specific diagnostic trouble code for check DFC_BSWM_E_ACTION_FAILED" VALUE 0x80504672 Val_Wu16 65535.00 DFES_OneToOne 0.00 65535.00 FORMAT "%8.2" /end CHARACTERISTIC
/begin CHARACTERISTIC DFES_DTCO.DFC_BSWM_E_INTRPTQUEUE_FULL_C "OBD specific trouble code / OBD specific diagnostic trouble code for check DFC_BSWM_E_INTRPTQUEUE_FULL" VALUE 0x80504674 Val_Wu16 65535.00 DFES_OneToOne 0.00 65535.00 FORMAT "%8.2" /end CHARACTERISTIC
/begin CHARACTERISTIC DFES_DTCO.DFC_RBA_IOEXTLIB_KEEPALIVE_DRV_C "OBD specific trouble code / OBD specific diagnostic trouble code for check DFC_RBA_IOEXTLIB_KEEPALIVE_DRV" VALUE 0x80504676 Val_Wu16 65535.00 DFES_OneToOne 0.00 65535.00 FORMAT "%8.2" /end CHARACTERISTIC
/begin CHARACTERISTIC DFES_DTCO.DFC_RBA_IOEXTLIB_KEEPALIVE_INI_C "OBD specific trouble code / OBD specific diagnostic trouble code for check DFC_RBA_IOEXTLIB_KEEPALIVE_INI" VALUE 0x80504678 Val_Wu16 65535.00 DFES_OneToOne 0.00 65535.00 FORMAT "%8.2" /end CHARACTERISTIC
/begin CHARACTERISTIC DFES_DTCO.DFC_rba_IoSigRtc_StopCounter_C "OBD specific trouble code / OBD specific diagnostic trouble code for check DFC_rba_IoSigRtc_StopCounter" VALUE 0x8050467A Val_Wu16 65535.00 DFES_OneToOne 0.00 65535.00 FORMAT "%8.2" /end CHARACTERISTIC
/begin CHARACTERISTIC DFES_DTCO.DFC_rba_MRly_Diag_Stk_Event_C "OBD specific trouble code / OBD specific diagnostic trouble code for check DFC_rba_MRly_Diag_Stk_Event" VALUE 0x8050467C Val_Wu16 65535.00 DFES_OneToOne 0.00 65535.00 FORMAT "%8.2" /end CHARACTERISTIC
/begin CHARACTERISTIC DFES_DTCO.DFC_rba_MemDiag_MemReadErr_C "OBD specific trouble code / OBD specific diagnostic trouble code for check DFC_rba_MemDiag_MemReadErr" VALUE 0x8050467E Val_Wu16 65535.00 DFES_OneToOne 0.00 65535.00 FORMAT "%8.2" /end CHARACTERISTIC
/begin CHARACTERISTIC DFES_DTCO.DFC_rba_MemDiag_MemWrErr_C "OBD specific trouble code / OBD specific diagnostic trouble code for check DFC_rba_MemDiag_MemWrErr" VALUE 0x80504680 Val_Wu16 65535.00 DFES_OneToOne 0.00 65535.00 FORMAT "%8.2" /end CHARACTERISTIC
/begin CHARACTERISTIC DFES_DTCO.DFC_rba_SyC_IrrSwOffTrigEngRun_Event_C "OBD specific trouble code / OBD specific diagnostic trouble code for check DFC_rba_SyC_IrrSwOffTrigEngRun_Event" VALUE 0x80504682 Val_Wu16 65535.00 DFES_OneToOne 0.00 65535.00 FORMAT "%8.2" /end CHARACTERISTIC
/begin CHARACTERISTIC DFES_DTCO.DFC_rba_T15_Diag_ComInVld_Event_C "OBD specific trouble code / OBD specific diagnostic trouble code for check DFC_rba_T15_Diag_ComInVld_Event" VALUE 0x80504684 Val_Wu16 65535.00 DFES_OneToOne 0.00 65535.00 FORMAT "%8.2" /end CHARACTERISTIC
/begin CHARACTERISTIC DFES_DTCO.DFC_rba_T15_Diag_ComOff_HwOn_Event_C "OBD specific trouble code / OBD specific diagnostic trouble code for check DFC_rba_T15_Diag_ComOff_HwOn_Event" VALUE 0x80504686 Val_Wu16 65535.00 DFES_OneToOne 0.00 65535.00 FORMAT "%8.2" /end CHARACTERISTIC
/begin CHARACTERISTIC DFES_DTCO.DFC_rba_T15_Diag_ComOn_HwOff_Event_C "OBD specific trouble code / OBD specific diagnostic trouble code for check DFC_rba_T15_Diag_ComOn_HwOff_Event" VALUE 0x80504688 Val_Wu16 65535.00 DFES_OneToOne 0.00 65535.00 FORMAT "%8.2" /end CHARACTERISTIC
/begin CHARACTERISTIC DFES_DTCO.DFC_AAVmin_C "OBD specific trouble code / OBD specific diagnostic trouble code for check DFC_AAVmin" VALUE 0x8050468A Val_Wu16 65535.00 DFES_OneToOne 0.00 65535.00 FORMAT "%8.2" /end CHARACTERISTIC
/begin CHARACTERISTIC DFES_DTCO.DFC_AGRSUS_C "OBD specific trouble code / OBD specific diagnostic trouble code for check DFC_AGRSUS" VALUE 0x8050468C Val_Wu16 65535.00 DFES_OneToOne 0.00 65535.00 FORMAT "%8.2" /end CHARACTERISTIC
/begin CHARACTERISTIC DFES_DTCO.DFC_AfsPlausDiagHi_C "OBD specific trouble code / OBD specific diagnostic trouble code for check DFC_AfsPlausDiagHi" VALUE 0x8050468E Val_Wu16 65535.00 DFES_OneToOne 0.00 65535.00 FORMAT "%8.2" /end CHARACTERISTIC
/begin CHARACTERISTIC DFES_DTCO.DFC_AfsPlausDiagLo_C "OBD specific trouble code / OBD specific diagnostic trouble code for check DFC_AfsPlausDiagLo" VALUE 0x80504690 Val_Wu16 65535.00 DFES_OneToOne 0.00 65535.00 FORMAT "%8.2" /end CHARACTERISTIC
/begin CHARACTERISTIC DFES_DTCO.DFC_AfsVrntDiagErrB1_C "OBD specific trouble code / OBD specific diagnostic trouble code for check DFC_AfsVrntDiagErrB1" VALUE 0x80504692 Val_Wu16 65535.00 DFES_OneToOne 0.00 65535.00 FORMAT "%8.2" /end CHARACTERISTIC
/begin CHARACTERISTIC DFES_DTCO.DFC_AppAllSnsrDfct_C "OBD specific trouble code / OBD specific diagnostic trouble code for check DFC_AppAllSnsrDfct" VALUE 0x80504694 Val_Wu16 65535.00 DFES_OneToOne 0.00 65535.00 FORMAT "%8.2" /end CHARACTERISTIC
/begin CHARACTERISTIC DFES_DTCO.DFC_BBKRnldg_C "OBD specific trouble code / OBD specific diagnostic trouble code for check DFC_BBKRnldg" VALUE 0x80504696 Val_Wu16 65535.00 DFES_OneToOne 0.00 65535.00 FORMAT "%8.2" /end CHARACTERISTIC
/begin CHARACTERISTIC DFES_DTCO.DFC_BBKRsyne_C "OBD specific trouble code / OBD specific diagnostic trouble code for check DFC_BBKRsyne" VALUE 0x80504698 Val_Wu16 65535.00 DFES_OneToOne 0.00 65535.00 FORMAT "%8.2" /end CHARACTERISTIC
/begin CHARACTERISTIC DFES_DTCO.DFC_BattUStdbyDiaOL_C "OBD specific trouble code / OBD specific diagnostic trouble code for check DFC_BattUStdbyDiaOL" VALUE 0x8050469A Val_Wu16 65535.00 DFES_OneToOne 0.00 65535.00 FORMAT "%8.2" /end CHARACTERISTIC
/begin CHARACTERISTIC DFES_DTCO.DFC_BigLeakIntkMnfldEmiInfl_C "OBD specific trouble code / OBD specific diagnostic trouble code for check DFC_BigLeakIntkMnfldEmiInfl" VALUE 0x8050469C Val_Wu16 65535.00 DFES_OneToOne 0.00 65535.00 FORMAT "%8.2" /end CHARACTERISTIC
/begin CHARACTERISTIC DFES_DTCO.DFC_BlkdLineTank_C "OBD specific trouble code / OBD specific diagnostic trouble code for check DFC_BlkdLineTank" VALUE 0x8050469E Val_Wu16 65535.00 DFES_OneToOne 0.00 65535.00 FORMAT "%8.2" /end CHARACTERISTIC
/begin CHARACTERISTIC DFES_DTCO.DFC_BrkMnSwtContOnWarnLmp_C "OBD specific trouble code / OBD specific diagnostic trouble code for check DFC_BrkMnSwtContOnWarnLmp" VALUE 0x805046A0 Val_Wu16 65535.00 DFES_OneToOne 0.00 65535.00 FORMAT "%8.2" /end CHARACTERISTIC
/begin CHARACTERISTIC DFES_DTCO.DFC_BrkMnSwtNotStpWarnLmp_C "OBD specific trouble code / OBD specific diagnostic trouble code for check DFC_BrkMnSwtNotStpWarnLmp" VALUE 0x805046A2 Val_Wu16 65535.00 DFES_OneToOne 0.00 65535.00 FORMAT "%8.2" /end CHARACTERISTIC
/begin CHARACTERISTIC DFES_DTCO.DFC_BrkRdntSwtContOnWarnLmp_C "OBD specific trouble code / OBD specific diagnostic trouble code for check DFC_BrkRdntSwtContOnWarnLmp" VALUE 0x805046A4 Val_Wu16 65535.00 DFES_OneToOne 0.00 65535.00 FORMAT "%8.2" /end CHARACTERISTIC
/begin CHARACTERISTIC DFES_DTCO.DFC_BrkRdntSwtNotStpWarnLmp_C "OBD specific trouble code / OBD specific diagnostic trouble code for check DFC_BrkRdntSwtNotStpWarnLmp" VALUE 0x805046A6 Val_Wu16 65535.00 DFES_OneToOne 0.00 65535.00 FORMAT "%8.2" /end CHARACTERISTIC
/begin CHARACTERISTIC DFES_DTCO.DFC_CEngDsTColdStrtMax_C "OBD specific trouble code / OBD specific diagnostic trouble code for check DFC_CEngDsTColdStrtMax" VALUE 0x805046A8 Val_Wu16 65535.00 DFES_OneToOne 0.00 65535.00 FORMAT "%8.2" /end CHARACTERISTIC
/begin CHARACTERISTIC DFES_DTCO.DFC_CEngDsTColdStrtMin_C "OBD specific trouble code / OBD specific diagnostic trouble code for check DFC_CEngDsTColdStrtMin" VALUE 0x805046AA Val_Wu16 65535.00 DFES_OneToOne 0.00 65535.00 FORMAT "%8.2" /end CHARACTERISTIC
/begin CHARACTERISTIC DFES_DTCO.DFC_CEngDsTImps_C "OBD specific trouble code / OBD specific diagnostic trouble code for check DFC_CEngDsTImps" VALUE 0x805046AC Val_Wu16 65535.00 DFES_OneToOne 0.00 65535.00 FORMAT "%8.2" /end CHARACTERISTIC
/begin CHARACTERISTIC DFES_DTCO.DFC_CEngDsTPlausHSC_C "OBD specific trouble code / OBD specific diagnostic trouble code for check DFC_CEngDsTPlausHSC" VALUE 0x805046AE Val_Wu16 65535.00 DFES_OneToOne 0.00 65535.00 FORMAT "%8.2" /end CHARACTERISTIC
/begin CHARACTERISTIC DFES_DTCO.DFC_CEngDsTPlausLSC_C "OBD specific trouble code / OBD specific diagnostic trouble code for check DFC_CEngDsTPlausLSC" VALUE 0x805046B0 Val_Wu16 65535.00 DFES_OneToOne 0.00 65535.00 FORMAT "%8.2" /end CHARACTERISTIC
/begin CHARACTERISTIC DFES_DTCO.DFC_CEngDsTPlausSTC_C "OBD specific trouble code / OBD specific diagnostic trouble code for check DFC_CEngDsTPlausSTC" VALUE 0x805046B2 Val_Wu16 65535.00 DFES_OneToOne 0.00 65535.00 FORMAT "%8.2" /end CHARACTERISTIC
/begin CHARACTERISTIC DFES_DTCO.DFC_CEngDsTSRCMax_C "OBD specific trouble code / OBD specific diagnostic trouble code for check DFC_CEngDsTSRCMax" VALUE 0x805046B4 Val_Wu16 65535.00 DFES_OneToOne 0.00 65535.00 FORMAT "%8.2" /end CHARACTERISTIC
/begin CHARACTERISTIC DFES_DTCO.DFC_CEngDsTSRCMin_C "OBD specific trouble code / OBD specific diagnostic trouble code for check DFC_CEngDsTSRCMin" VALUE 0x805046B6 Val_Wu16 65535.00 DFES_OneToOne 0.00 65535.00 FORMAT "%8.2" /end CHARACTERISTIC
/begin CHARACTERISTIC DFES_DTCO.DFC_CEngDsTSig_C "OBD specific trouble code / OBD specific diagnostic trouble code for check DFC_CEngDsTSig" VALUE 0x805046B8 Val_Wu16 65535.00 DFES_OneToOne 0.00 65535.00 FORMAT "%8.2" /end CHARACTERISTIC
/begin CHARACTERISTIC DFES_DTCO.DFC_CEngUsTColdStrtMax_C "OBD specific trouble code / OBD specific diagnostic trouble code for check DFC_CEngUsTColdStrtMax" VALUE 0x805046BA Val_Wu16 65535.00 DFES_OneToOne 0.00 65535.00 FORMAT "%8.2" /end CHARACTERISTIC
/begin CHARACTERISTIC DFES_DTCO.DFC_CEngUsTColdStrtMin_C "OBD specific trouble code / OBD specific diagnostic trouble code for check DFC_CEngUsTColdStrtMin" VALUE 0x805046BC Val_Wu16 65535.00 DFES_OneToOne 0.00 65535.00 FORMAT "%8.2" /end CHARACTERISTIC
/begin CHARACTERISTIC DFES_DTCO.DFC_CEngUsTLooseCnctn_C "OBD specific trouble code / OBD specific diagnostic trouble code for check DFC_CEngUsTLooseCnctn" VALUE 0x805046BE Val_Wu16 65535.00 DFES_OneToOne 0.00 65535.00 FORMAT "%8.2" /end CHARACTERISTIC
/begin CHARACTERISTIC DFES_DTCO.DFC_CEngUsTSRCMax_C "OBD specific trouble code / OBD specific diagnostic trouble code for check DFC_CEngUsTSRCMax" VALUE 0x805046C0 Val_Wu16 65535.00 DFES_OneToOne 0.00 65535.00 FORMAT "%8.2" /end CHARACTERISTIC
/begin CHARACTERISTIC DFES_DTCO.DFC_CEngUsTSRCMin_C "OBD specific trouble code / OBD specific diagnostic trouble code for check DFC_CEngUsTSRCMin" VALUE 0x805046C2 Val_Wu16 65535.00 DFES_OneToOne 0.00 65535.00 FORMAT "%8.2" /end CHARACTERISTIC
/begin CHARACTERISTIC DFES_DTCO.DFC_ComDCDCACCFailr_C "OBD specific trouble code / OBD specific diagnostic trouble code for check DFC_ComDCDCACCFailr" VALUE 0x805046C4 Val_Wu16 65535.00 DFES_OneToOne 0.00 65535.00 FORMAT "%8.2" /end CHARACTERISTIC
/begin CHARACTERISTIC DFES_DTCO.DFC_DCDCFltDet_C "OBD specific trouble code / OBD specific diagnostic trouble code for check DFC_DCDCFltDet" VALUE 0x805046C6 Val_Wu16 65535.00 DFES_OneToOne 0.00 65535.00 FORMAT "%8.2" /end CHARACTERISTIC
/begin CHARACTERISTIC DFES_DTCO.DFC_DKRSA_C "OBD specific trouble code / OBD specific diagnostic trouble code for check DFC_DKRSA" VALUE 0x805046C8 Val_Wu16 65535.00 DFES_OneToOne 0.00 65535.00 FORMAT "%8.2" /end CHARACTERISTIC
/begin CHARACTERISTIC DFES_DTCO.DFC_DKVSmax_C "OBD specific trouble code / OBD specific diagnostic trouble code for check DFC_DKVSmax" VALUE 0x805046CA Val_Wu16 65535.00 DFES_OneToOne 0.00 65535.00 FORMAT "%8.2" /end CHARACTERISTIC
/begin CHARACTERISTIC DFES_DTCO.DFC_DKnpl_C "OBD specific trouble code / OBD specific diagnostic trouble code for check DFC_DKnpl" VALUE 0x805046CC Val_Wu16 65535.00 DFES_OneToOne 0.00 65535.00 FORMAT "%8.2" /end CHARACTERISTIC
/begin CHARACTERISTIC DFES_DTCO.DFC_DSKVRmax_C "OBD specific trouble code / OBD specific diagnostic trouble code for check DFC_DSKVRmax" VALUE 0x805046CE Val_Wu16 65535.00 DFES_OneToOne 0.00 65535.00 FORMAT "%8.2" /end CHARACTERISTIC
/begin CHARACTERISTIC DFES_DTCO.DFC_DSKVRmin_C "OBD specific trouble code / OBD specific diagnostic trouble code for check DFC_DSKVRmin" VALUE 0x805046D0 Val_Wu16 65535.00 DFES_OneToOne 0.00 65535.00 FORMAT "%8.2" /end CHARACTERISTIC
/begin CHARACTERISTIC DFES_DTCO.DFC_DSKVRnpl_C "OBD specific trouble code / OBD specific diagnostic trouble code for check DFC_DSKVRnpl" VALUE 0x805046D2 Val_Wu16 65535.00 DFES_OneToOne 0.00 65535.00 FORMAT "%8.2" /end CHARACTERISTIC
/begin CHARACTERISTIC DFES_DTCO.DFC_DSKVRsig_C "OBD specific trouble code / OBD specific diagnostic trouble code for check DFC_DSKVRsig" VALUE 0x805046D4 Val_Wu16 65535.00 DFES_OneToOne 0.00 65535.00 FORMAT "%8.2" /end CHARACTERISTIC
/begin CHARACTERISTIC DFES_DTCO.DFC_DSKVSsig_C "OBD specific trouble code / OBD specific diagnostic trouble code for check DFC_DSKVSsig" VALUE 0x805046D6 Val_Wu16 65535.00 DFES_OneToOne 0.00 65535.00 FORMAT "%8.2" /end CHARACTERISTIC
/begin CHARACTERISTIC DFES_DTCO.DFC_DSSmax_C "OBD specific trouble code / OBD specific diagnostic trouble code for check DFC_DSSmax" VALUE 0x805046D8 Val_Wu16 65535.00 DFES_OneToOne 0.00 65535.00 FORMAT "%8.2" /end CHARACTERISTIC
/begin CHARACTERISTIC DFES_DTCO.DFC_DSTDmax_C "OBD specific trouble code / OBD specific diagnostic trouble code for check DFC_DSTDmax" VALUE 0x805046DA Val_Wu16 65535.00 DFES_OneToOne 0.00 65535.00 FORMAT "%8.2" /end CHARACTERISTIC
/begin CHARACTERISTIC DFES_DTCO.DFC_DSTEmax_C "OBD specific trouble code / OBD specific diagnostic trouble code for check DFC_DSTEmax" VALUE 0x805046DC Val_Wu16 65535.00 DFES_OneToOne 0.00 65535.00 FORMAT "%8.2" /end CHARACTERISTIC
/begin CHARACTERISTIC DFES_DTCO.DFC_DSTEmin_C "OBD specific trouble code / OBD specific diagnostic trouble code for check DFC_DSTEmin" VALUE 0x805046DE Val_Wu16 65535.00 DFES_OneToOne 0.00 65535.00 FORMAT "%8.2" /end CHARACTERISTIC
/begin CHARACTERISTIC DFES_DTCO.DFC_DSTOFmax_C "OBD specific trouble code / OBD specific diagnostic trouble code for check DFC_DSTOFmax" VALUE 0x805046E0 Val_Wu16 65535.00 DFES_OneToOne 0.00 65535.00 FORMAT "%8.2" /end CHARACTERISTIC
/begin CHARACTERISTIC DFES_DTCO.DFC_DSTRmax_C "OBD specific trouble code / OBD specific diagnostic trouble code for check DFC_DSTRmax" VALUE 0x805046E2 Val_Wu16 65535.00 DFES_OneToOne 0.00 65535.00 FORMAT "%8.2" /end CHARACTERISTIC
/begin CHARACTERISTIC DFES_DTCO.DFC_DSTRmin_C "OBD specific trouble code / OBD specific diagnostic trouble code for check DFC_DSTRmin" VALUE 0x805046E4 Val_Wu16 65535.00 DFES_OneToOne 0.00 65535.00 FORMAT "%8.2" /end CHARACTERISTIC
/begin CHARACTERISTIC DFES_DTCO.DFC_DSTRnpl_C "OBD specific trouble code / OBD specific diagnostic trouble code for check DFC_DSTRnpl" VALUE 0x805046E6 Val_Wu16 65535.00 DFES_OneToOne 0.00 65535.00 FORMAT "%8.2" /end CHARACTERISTIC
/begin CHARACTERISTIC DFES_DTCO.DFC_DSTRsig_C "OBD specific trouble code / OBD specific diagnostic trouble code for check DFC_DSTRsig" VALUE 0x805046E8 Val_Wu16 65535.00 DFES_OneToOne 0.00 65535.00 FORMAT "%8.2" /end CHARACTERISTIC
/begin CHARACTERISTIC DFES_DTCO.DFC_DSTTI_C "OBD specific trouble code / OBD specific diagnostic trouble code for check DFC_DSTTI" VALUE 0x805046EA Val_Wu16 65535.00 DFES_OneToOne 0.00 65535.00 FORMAT "%8.2" /end CHARACTERISTIC
/begin CHARACTERISTIC DFES_DTCO.DFC_DSUmax_C "OBD specific trouble code / OBD specific diagnostic trouble code for check DFC_DSUmax" VALUE 0x805046EC Val_Wu16 65535.00 DFES_OneToOne 0.00 65535.00 FORMAT "%8.2" /end CHARACTERISTIC
/begin CHARACTERISTIC DFES_DTCO.DFC_DiagCpv1DteskLoLoadStuckClsd_C "OBD specific trouble code / OBD specific diagnostic trouble code for check DFC_DiagCpv1DteskLoLoadStuckClsd" VALUE 0x805046EE Val_Wu16 65535.00 DFES_OneToOne 0.00 65535.00 FORMAT "%8.2" /end CHARACTERISTIC
/begin CHARACTERISTIC DFES_DTCO.DFC_DiagCpv1DteskLoLoadStuckOpen_C "OBD specific trouble code / OBD specific diagnostic trouble code for check DFC_DiagCpv1DteskLoLoadStuckOpen" VALUE 0x805046F0 Val_Wu16 65535.00 DFES_OneToOne 0.00 65535.00 FORMAT "%8.2" /end CHARACTERISTIC
/begin CHARACTERISTIC DFES_DTCO.DFC_EGRVlvDrftClsd_C "OBD specific trouble code / OBD specific diagnostic trouble code for check DFC_EGRVlvDrftClsd" VALUE 0x805046F2 Val_Wu16 65535.00 DFES_OneToOne 0.00 65535.00 FORMAT "%8.2" /end CHARACTERISTIC
/begin CHARACTERISTIC DFES_DTCO.DFC_EGRVlvDrftOpn_C "OBD specific trouble code / OBD specific diagnostic trouble code for check DFC_EGRVlvDrftOpn" VALUE 0x805046F4 Val_Wu16 65535.00 DFES_OneToOne 0.00 65535.00 FORMAT "%8.2" /end CHARACTERISTIC
/begin CHARACTERISTIC DFES_DTCO.DFC_EGRVlvJamVlvClsd_C "OBD specific trouble code / OBD specific diagnostic trouble code for check DFC_EGRVlvJamVlvClsd" VALUE 0x805046F6 Val_Wu16 65535.00 DFES_OneToOne 0.00 65535.00 FORMAT "%8.2" /end CHARACTERISTIC
/begin CHARACTERISTIC DFES_DTCO.DFC_EGRVlvJamVlvOpn_C "OBD specific trouble code / OBD specific diagnostic trouble code for check DFC_EGRVlvJamVlvOpn" VALUE 0x805046F8 Val_Wu16 65535.00 DFES_OneToOne 0.00 65535.00 FORMAT "%8.2" /end CHARACTERISTIC
/begin CHARACTERISTIC DFES_DTCO.DFC_EGRVlvSprgBrk_C "OBD specific trouble code / OBD specific diagnostic trouble code for check DFC_EGRVlvSprgBrk" VALUE 0x805046FA Val_Wu16 65535.00 DFES_OneToOne 0.00 65535.00 FORMAT "%8.2" /end CHARACTERISTIC
/begin CHARACTERISTIC DFES_DTCO.DFC_EGRVlvTempMdlEEPErr_C "OBD specific trouble code / OBD specific diagnostic trouble code for check DFC_EGRVlvTempMdlEEPErr" VALUE 0x805046FC Val_Wu16 65535.00 DFES_OneToOne 0.00 65535.00 FORMAT "%8.2" /end CHARACTERISTIC
/begin CHARACTERISTIC DFES_DTCO.DFC_EGRVlvTmpErr_C "OBD specific trouble code / OBD specific diagnostic trouble code for check DFC_EGRVlvTmpErr" VALUE 0x805046FE Val_Wu16 65535.00 DFES_OneToOne 0.00 65535.00 FORMAT "%8.2" /end CHARACTERISTIC
/begin CHARACTERISTIC DFES_DTCO.DFC_EGSDUS2B1LtrDly_C "OBD specific trouble code / OBD specific diagnostic trouble code for check DFC_EGSDUS2B1LtrDly" VALUE 0x80504700 Val_Wu16 65535.00 DFES_OneToOne 0.00 65535.00 FORMAT "%8.2" /end CHARACTERISTIC
/begin CHARACTERISTIC DFES_DTCO.DFC_EGSDUS2B1LtrPT1_C "OBD specific trouble code / OBD specific diagnostic trouble code for check DFC_EGSDUS2B1LtrPT1" VALUE 0x80504702 Val_Wu16 65535.00 DFES_OneToOne 0.00 65535.00 FORMAT "%8.2" /end CHARACTERISTIC
/begin CHARACTERISTIC DFES_DTCO.DFC_EGSDUS2B1RtlDly_C "OBD specific trouble code / OBD specific diagnostic trouble code for check DFC_EGSDUS2B1RtlDly" VALUE 0x80504704 Val_Wu16 65535.00 DFES_OneToOne 0.00 65535.00 FORMAT "%8.2" /end CHARACTERISTIC
/begin CHARACTERISTIC DFES_DTCO.DFC_EGSDUS2B1RtlPT1_C "OBD specific trouble code / OBD specific diagnostic trouble code for check DFC_EGSDUS2B1RtlPT1" VALUE 0x80504706 Val_Wu16 65535.00 DFES_OneToOne 0.00 65535.00 FORMAT "%8.2" /end CHARACTERISTIC
/begin CHARACTERISTIC DFES_DTCO.DFC_EGSDUS2B1TarLean_C "OBD specific trouble code / OBD specific diagnostic trouble code for check DFC_EGSDUS2B1TarLean" VALUE 0x80504708 Val_Wu16 65535.00 DFES_OneToOne 0.00 65535.00 FORMAT "%8.2" /end CHARACTERISTIC
/begin CHARACTERISTIC DFES_DTCO.DFC_EGSDUS2B1TarRich_C "OBD specific trouble code / OBD specific diagnostic trouble code for check DFC_EGSDUS2B1TarRich" VALUE 0x8050470A Val_Wu16 65535.00 DFES_OneToOne 0.00 65535.00 FORMAT "%8.2" /end CHARACTERISTIC
/begin CHARACTERISTIC DFES_DTCO.DFC_EONVmax_C "OBD specific trouble code / OBD specific diagnostic trouble code for check DFC_EONVmax" VALUE 0x8050470C Val_Wu16 65535.00 DFES_OneToOne 0.00 65535.00 FORMAT "%8.2" /end CHARACTERISTIC
/begin CHARACTERISTIC DFES_DTCO.DFC_ETAKHLmax_C "OBD specific trouble code / OBD specific diagnostic trouble code for check DFC_ETAKHLmax" VALUE 0x8050470E Val_Wu16 65535.00 DFES_OneToOne 0.00 65535.00 FORMAT "%8.2" /end CHARACTERISTIC
/begin CHARACTERISTIC DFES_DTCO.DFC_ETAKHTmax_C "OBD specific trouble code / OBD specific diagnostic trouble code for check DFC_ETAKHTmax" VALUE 0x80504710 Val_Wu16 65535.00 DFES_OneToOne 0.00 65535.00 FORMAT "%8.2" /end CHARACTERISTIC
/begin CHARACTERISTIC DFES_DTCO.DFC_ETHSEmax_C "OBD specific trouble code / OBD specific diagnostic trouble code for check DFC_ETHSEmax" VALUE 0x80504712 Val_Wu16 65535.00 DFES_OneToOne 0.00 65535.00 FORMAT "%8.2" /end CHARACTERISTIC
/begin CHARACTERISTIC DFES_DTCO.DFC_ETHSEmin_C "OBD specific trouble code / OBD specific diagnostic trouble code for check DFC_ETHSEmin" VALUE 0x80504714 Val_Wu16 65535.00 DFES_OneToOne 0.00 65535.00 FORMAT "%8.2" /end CHARACTERISTIC
/begin CHARACTERISTIC DFES_DTCO.DFC_ETHSFmax_C "OBD specific trouble code / OBD specific diagnostic trouble code for check DFC_ETHSFmax" VALUE 0x80504716 Val_Wu16 65535.00 DFES_OneToOne 0.00 65535.00 FORMAT "%8.2" /end CHARACTERISTIC
/begin CHARACTERISTIC DFES_DTCO.DFC_ETHSFmin_C "OBD specific trouble code / OBD specific diagnostic trouble code for check DFC_ETHSFmin" VALUE 0x80504718 Val_Wu16 65535.00 DFES_OneToOne 0.00 65535.00 FORMAT "%8.2" /end CHARACTERISTIC
/begin CHARACTERISTIC DFES_DTCO.DFC_ETHSFsig_C "OBD specific trouble code / OBD specific diagnostic trouble code for check DFC_ETHSFsig" VALUE 0x8050471A Val_Wu16 65535.00 DFES_OneToOne 0.00 65535.00 FORMAT "%8.2" /end CHARACTERISTIC
/begin CHARACTERISTIC DFES_DTCO.DFC_ETHSNPWmax_C "OBD specific trouble code / OBD specific diagnostic trouble code for check DFC_ETHSNPWmax" VALUE 0x8050471C Val_Wu16 65535.00 DFES_OneToOne 0.00 65535.00 FORMAT "%8.2" /end CHARACTERISTIC
/begin CHARACTERISTIC DFES_DTCO.DFC_ETHSNPWmin_C "OBD specific trouble code / OBD specific diagnostic trouble code for check DFC_ETHSNPWmin" VALUE 0x8050471E Val_Wu16 65535.00 DFES_OneToOne 0.00 65535.00 FORMAT "%8.2" /end CHARACTERISTIC
/begin CHARACTERISTIC DFES_DTCO.DFC_ETHSNPWsig_C "OBD specific trouble code / OBD specific diagnostic trouble code for check DFC_ETHSNPWsig" VALUE 0x80504720 Val_Wu16 65535.00 DFES_OneToOne 0.00 65535.00 FORMAT "%8.2" /end CHARACTERISTIC
/begin CHARACTERISTIC DFES_DTCO.DFC_ETHSPLnpl_C "OBD specific trouble code / OBD specific diagnostic trouble code for check DFC_ETHSPLnpl" VALUE 0x80504722 Val_Wu16 65535.00 DFES_OneToOne 0.00 65535.00 FORMAT "%8.2" /end CHARACTERISTIC
/begin CHARACTERISTIC DFES_DTCO.DFC_ETHSTPLnpl_C "OBD specific trouble code / OBD specific diagnostic trouble code for check DFC_ETHSTPLnpl" VALUE 0x80504724 Val_Wu16 65535.00 DFES_OneToOne 0.00 65535.00 FORMAT "%8.2" /end CHARACTERISTIC
/begin CHARACTERISTIC DFES_DTCO.DFC_EngICO_C "OBD specific trouble code / OBD specific diagnostic trouble code for check DFC_EngICO" VALUE 0x80504726 Val_Wu16 65535.00 DFES_OneToOne 0.00 65535.00 FORMAT "%8.2" /end CHARACTERISTIC
/begin CHARACTERISTIC DFES_DTCO.DFC_EngPrtOvrSpdMon_C "OBD specific trouble code / OBD specific diagnostic trouble code for check DFC_EngPrtOvrSpdMon" VALUE 0x80504728 Val_Wu16 65535.00 DFES_OneToOne 0.00 65535.00 FORMAT "%8.2" /end CHARACTERISTIC
/begin CHARACTERISTIC DFES_DTCO.DFC_EpmCaSI1ErrSig_C "OBD specific trouble code / OBD specific diagnostic trouble code for check DFC_EpmCaSI1ErrSig" VALUE 0x8050472A Val_Wu16 65535.00 DFES_OneToOne 0.00 65535.00 FORMAT "%8.2" /end CHARACTERISTIC
/begin CHARACTERISTIC DFES_DTCO.DFC_EpmCaSI1MntErr_C "OBD specific trouble code / OBD specific diagnostic trouble code for check DFC_EpmCaSI1MntErr" VALUE 0x8050472C Val_Wu16 65535.00 DFES_OneToOne 0.00 65535.00 FORMAT "%8.2" /end CHARACTERISTIC
/begin CHARACTERISTIC DFES_DTCO.DFC_EpmCaSI1NoSigMax_C "OBD specific trouble code / OBD specific diagnostic trouble code for check DFC_EpmCaSI1NoSigMax" VALUE 0x8050472E Val_Wu16 65535.00 DFES_OneToOne 0.00 65535.00 FORMAT "%8.2" /end CHARACTERISTIC
/begin CHARACTERISTIC DFES_DTCO.DFC_EpmCaSI1NoSigMin_C "OBD specific trouble code / OBD specific diagnostic trouble code for check DFC_EpmCaSI1NoSigMin" VALUE 0x80504730 Val_Wu16 65535.00 DFES_OneToOne 0.00 65535.00 FORMAT "%8.2" /end CHARACTERISTIC
/begin CHARACTERISTIC DFES_DTCO.DFC_EpmCaSI1OfsErr_C "OBD specific trouble code / OBD specific diagnostic trouble code for check DFC_EpmCaSI1OfsErr" VALUE 0x80504732 Val_Wu16 65535.00 DFES_OneToOne 0.00 65535.00 FORMAT "%8.2" /end CHARACTERISTIC
/begin CHARACTERISTIC DFES_DTCO.DFC_EpmCrSDGI_C "OBD specific trouble code / OBD specific diagnostic trouble code for check DFC_EpmCrSDGI" VALUE 0x80504734 Val_Wu16 65535.00 DFES_OneToOne 0.00 65535.00 FORMAT "%8.2" /end CHARACTERISTIC
/begin CHARACTERISTIC DFES_DTCO.DFC_EpmCrSErrSig_C "OBD specific trouble code / OBD specific diagnostic trouble code for check DFC_EpmCrSErrSig" VALUE 0x80504736 Val_Wu16 65535.00 DFES_OneToOne 0.00 65535.00 FORMAT "%8.2" /end CHARACTERISTIC
/begin CHARACTERISTIC DFES_DTCO.DFC_EpmCrSNoSig_C "OBD specific trouble code / OBD specific diagnostic trouble code for check DFC_EpmCrSNoSig" VALUE 0x80504738 Val_Wu16 65535.00 DFES_OneToOne 0.00 65535.00 FORMAT "%8.2" /end CHARACTERISTIC
/begin CHARACTERISTIC DFES_DTCO.DFC_EtaEngIdleNonCsers_C "OBD specific trouble code / OBD specific diagnostic trouble code for check DFC_EtaEngIdleNonCsers" VALUE 0x8050473A Val_Wu16 65535.00 DFES_OneToOne 0.00 65535.00 FORMAT "%8.2" /end CHARACTERISTIC
/begin CHARACTERISTIC DFES_DTCO.DFC_EtaEngPtlNonCsers_C "OBD specific trouble code / OBD specific diagnostic trouble code for check DFC_EtaEngPtlNonCsers" VALUE 0x8050473C Val_Wu16 65535.00 DFES_OneToOne 0.00 65535.00 FORMAT "%8.2" /end CHARACTERISTIC
/begin CHARACTERISTIC DFES_DTCO.DFC_FRAmax_C "OBD specific trouble code / OBD specific diagnostic trouble code for check DFC_FRAmax" VALUE 0x8050473E Val_Wu16 65535.00 DFES_OneToOne 0.00 65535.00 FORMAT "%8.2" /end CHARACTERISTIC
/begin CHARACTERISTIC DFES_DTCO.DFC_FRAmin_C "OBD specific trouble code / OBD specific diagnostic trouble code for check DFC_FRAmin" VALUE 0x80504740 Val_Wu16 65535.00 DFES_OneToOne 0.00 65535.00 FORMAT "%8.2" /end CHARACTERISTIC
/begin CHARACTERISTIC DFES_DTCO.DFC_FSTEmax_C "OBD specific trouble code / OBD specific diagnostic trouble code for check DFC_FSTEmax" VALUE 0x80504742 Val_Wu16 65535.00 DFES_OneToOne 0.00 65535.00 FORMAT "%8.2" /end CHARACTERISTIC
/begin CHARACTERISTIC DFES_DTCO.DFC_FSTEmin_C "OBD specific trouble code / OBD specific diagnostic trouble code for check DFC_FSTEmin" VALUE 0x80504744 Val_Wu16 65535.00 DFES_OneToOne 0.00 65535.00 FORMAT "%8.2" /end CHARACTERISTIC
/begin CHARACTERISTIC DFES_DTCO.DFC_FSTRmax_C "OBD specific trouble code / OBD specific diagnostic trouble code for check DFC_FSTRmax" VALUE 0x80504746 Val_Wu16 65535.00 DFES_OneToOne 0.00 65535.00 FORMAT "%8.2" /end CHARACTERISTIC
/begin CHARACTERISTIC DFES_DTCO.DFC_FSTRmin_C "OBD specific trouble code / OBD specific diagnostic trouble code for check DFC_FSTRmin" VALUE 0x80504748 Val_Wu16 65535.00 DFES_OneToOne 0.00 65535.00 FORMAT "%8.2" /end CHARACTERISTIC
/begin CHARACTERISTIC DFES_DTCO.DFC_FSTRnpl_C "OBD specific trouble code / OBD specific diagnostic trouble code for check DFC_FSTRnpl" VALUE 0x8050474A Val_Wu16 65535.00 DFES_OneToOne 0.00 65535.00 FORMAT "%8.2" /end CHARACTERISTIC
/begin CHARACTERISTIC DFES_DTCO.DFC_FSTmax_C "OBD specific trouble code / OBD specific diagnostic trouble code for check DFC_FSTmax" VALUE 0x8050474C Val_Wu16 65535.00 DFES_OneToOne 0.00 65535.00 FORMAT "%8.2" /end CHARACTERISTIC
/begin CHARACTERISTIC DFES_DTCO.DFC_FTDLAmax_C "OBD specific trouble code / OBD specific diagnostic trouble code for check DFC_FTDLAmax" VALUE 0x8050474E Val_Wu16 65535.00 DFES_OneToOne 0.00 65535.00 FORMAT "%8.2" /end CHARACTERISTIC
/begin CHARACTERISTIC DFES_DTCO.DFC_FTDLAmin_C "OBD specific trouble code / OBD specific diagnostic trouble code for check DFC_FTDLAmin" VALUE 0x80504750 Val_Wu16 65535.00 DFES_OneToOne 0.00 65535.00 FORMAT "%8.2" /end CHARACTERISTIC
/begin CHARACTERISTIC DFES_DTCO.DFC_FuPHiSnsrEleclmax_C "OBD specific trouble code / OBD specific diagnostic trouble code for check DFC_FuPHiSnsrEleclmax" VALUE 0x80504752 Val_Wu16 65535.00 DFES_OneToOne 0.00 65535.00 FORMAT "%8.2" /end CHARACTERISTIC
/begin CHARACTERISTIC DFES_DTCO.DFC_FuPHiSnsrEleclmin_C "OBD specific trouble code / OBD specific diagnostic trouble code for check DFC_FuPHiSnsrEleclmin" VALUE 0x80504754 Val_Wu16 65535.00 DFES_OneToOne 0.00 65535.00 FORMAT "%8.2" /end CHARACTERISTIC
/begin CHARACTERISTIC DFES_DTCO.DFC_FuPHiSnsrEleclnpl_C "OBD specific trouble code / OBD specific diagnostic trouble code for check DFC_FuPHiSnsrEleclnpl" VALUE 0x80504756 Val_Wu16 65535.00 DFES_OneToOne 0.00 65535.00 FORMAT "%8.2" /end CHARACTERISTIC
/begin CHARACTERISTIC DFES_DTCO.DFC_FuPHiSnsrURngMax_C "OBD specific trouble code / OBD specific diagnostic trouble code for check DFC_FuPHiSnsrURngMax" VALUE 0x80504758 Val_Wu16 65535.00 DFES_OneToOne 0.00 65535.00 FORMAT "%8.2" /end CHARACTERISTIC
/begin CHARACTERISTIC DFES_DTCO.DFC_FuPHiSnsrURngMin_C "OBD specific trouble code / OBD specific diagnostic trouble code for check DFC_FuPHiSnsrURngMin" VALUE 0x8050475A Val_Wu16 65535.00 DFES_OneToOne 0.00 65535.00 FORMAT "%8.2" /end CHARACTERISTIC
/begin CHARACTERISTIC DFES_DTCO.DFC_FuSnsrPhyRngMaxErr_C "OBD specific trouble code / OBD specific diagnostic trouble code for check DFC_FuSnsrPhyRngMaxErr" VALUE 0x8050475C Val_Wu16 65535.00 DFES_OneToOne 0.00 65535.00 FORMAT "%8.2" /end CHARACTERISTIC
/begin CHARACTERISTIC DFES_DTCO.DFC_FuSnsrPhyRngMinErr_C "OBD specific trouble code / OBD specific diagnostic trouble code for check DFC_FuSnsrPhyRngMinErr" VALUE 0x8050475E Val_Wu16 65535.00 DFES_OneToOne 0.00 65535.00 FORMAT "%8.2" /end CHARACTERISTIC
/begin CHARACTERISTIC DFES_DTCO.DFC_GEVlvLockPinDiagIntkB1_C "OBD specific trouble code / OBD specific diagnostic trouble code for check DFC_GEVlvLockPinDiagIntkB1" VALUE 0x80504760 Val_Wu16 65535.00 DFES_OneToOne 0.00 65535.00 FORMAT "%8.2" /end CHARACTERISTIC
/begin CHARACTERISTIC DFES_DTCO.DFC_GEVlvPhaSlowIntkB1_C "OBD specific trouble code / OBD specific diagnostic trouble code for check DFC_GEVlvPhaSlowIntkB1" VALUE 0x80504762 Val_Wu16 65535.00 DFES_OneToOne 0.00 65535.00 FORMAT "%8.2" /end CHARACTERISTIC
/begin CHARACTERISTIC DFES_DTCO.DFC_GEVlvPhaTargIntkB1_C "OBD specific trouble code / OBD specific diagnostic trouble code for check DFC_GEVlvPhaTargIntkB1" VALUE 0x80504764 Val_Wu16 65535.00 DFES_OneToOne 0.00 65535.00 FORMAT "%8.2" /end CHARACTERISTIC
/begin CHARACTERISTIC DFES_DTCO.DFC_GbxRvsSwtStk_C "OBD specific trouble code / OBD specific diagnostic trouble code for check DFC_GbxRvsSwtStk" VALUE 0x80504766 Val_Wu16 65535.00 DFES_OneToOne 0.00 65535.00 FORMAT "%8.2" /end CHARACTERISTIC
/begin CHARACTERISTIC DFES_DTCO.DFC_HDRKHmax_C "OBD specific trouble code / OBD specific diagnostic trouble code for check DFC_HDRKHmax" VALUE 0x80504768 Val_Wu16 65535.00 DFES_OneToOne 0.00 65535.00 FORMAT "%8.2" /end CHARACTERISTIC
/begin CHARACTERISTIC DFES_DTCO.DFC_HDRKHmin_C "OBD specific trouble code / OBD specific diagnostic trouble code for check DFC_HDRKHmin" VALUE 0x8050476A Val_Wu16 65535.00 DFES_OneToOne 0.00 65535.00 FORMAT "%8.2" /end CHARACTERISTIC
/begin CHARACTERISTIC DFES_DTCO.DFC_HDRPLmax_C "OBD specific trouble code / OBD specific diagnostic trouble code for check DFC_HDRPLmax" VALUE 0x8050476C Val_Wu16 65535.00 DFES_OneToOne 0.00 65535.00 FORMAT "%8.2" /end CHARACTERISTIC
/begin CHARACTERISTIC DFES_DTCO.DFC_HDRPLmin_C "OBD specific trouble code / OBD specific diagnostic trouble code for check DFC_HDRPLmin" VALUE 0x8050476E Val_Wu16 65535.00 DFES_OneToOne 0.00 65535.00 FORMAT "%8.2" /end CHARACTERISTIC
/begin CHARACTERISTIC DFES_DTCO.DFC_HDRmax_C "OBD specific trouble code / OBD specific diagnostic trouble code for check DFC_HDRmax" VALUE 0x80504770 Val_Wu16 65535.00 DFES_OneToOne 0.00 65535.00 FORMAT "%8.2" /end CHARACTERISTIC
/begin CHARACTERISTIC DFES_DTCO.DFC_HDRmin_C "OBD specific trouble code / OBD specific diagnostic trouble code for check DFC_HDRmin" VALUE 0x80504772 Val_Wu16 65535.00 DFES_OneToOne 0.00 65535.00 FORMAT "%8.2" /end CHARACTERISTIC
/begin CHARACTERISTIC DFES_DTCO.DFC_HEGOS2B1ElecMax_C "OBD specific trouble code / OBD specific diagnostic trouble code for check DFC_HEGOS2B1ElecMax" VALUE 0x80504774 Val_Wu16 65535.00 DFES_OneToOne 0.00 65535.00 FORMAT "%8.2" /end CHARACTERISTIC
/begin CHARACTERISTIC DFES_DTCO.DFC_HEGOS2B1ElecMin_C "OBD specific trouble code / OBD specific diagnostic trouble code for check DFC_HEGOS2B1ElecMin" VALUE 0x80504776 Val_Wu16 65535.00 DFES_OneToOne 0.00 65535.00 FORMAT "%8.2" /end CHARACTERISTIC
/begin CHARACTERISTIC DFES_DTCO.DFC_HEGOS2B1ElecSig_C "OBD specific trouble code / OBD specific diagnostic trouble code for check DFC_HEGOS2B1ElecSig" VALUE 0x80504778 Val_Wu16 65535.00 DFES_OneToOne 0.00 65535.00 FORMAT "%8.2" /end CHARACTERISTIC
/begin CHARACTERISTIC DFES_DTCO.DFC_HEGOS2B1HtgNpl_C "OBD specific trouble code / OBD specific diagnostic trouble code for check DFC_HEGOS2B1HtgNpl" VALUE 0x8050477A Val_Wu16 65535.00 DFES_OneToOne 0.00 65535.00 FORMAT "%8.2" /end CHARACTERISTIC
/begin CHARACTERISTIC DFES_DTCO.DFC_HEV00max_C "OBD specific trouble code / OBD specific diagnostic trouble code for check DFC_HEV00max" VALUE 0x8050477C Val_Wu16 65535.00 DFES_OneToOne 0.00 65535.00 FORMAT "%8.2" /end CHARACTERISTIC
/begin CHARACTERISTIC DFES_DTCO.DFC_HEV01max_C "OBD specific trouble code / OBD specific diagnostic trouble code for check DFC_HEV01max" VALUE 0x8050477E Val_Wu16 65535.00 DFES_OneToOne 0.00 65535.00 FORMAT "%8.2" /end CHARACTERISTIC
/begin CHARACTERISTIC DFES_DTCO.DFC_HEV02max_C "OBD specific trouble code / OBD specific diagnostic trouble code for check DFC_HEV02max" VALUE 0x80504780 Val_Wu16 65535.00 DFES_OneToOne 0.00 65535.00 FORMAT "%8.2" /end CHARACTERISTIC
/begin CHARACTERISTIC DFES_DTCO.DFC_HEV03max_C "OBD specific trouble code / OBD specific diagnostic trouble code for check DFC_HEV03max" VALUE 0x80504782 Val_Wu16 65535.00 DFES_OneToOne 0.00 65535.00 FORMAT "%8.2" /end CHARACTERISTIC
/begin CHARACTERISTIC DFES_DTCO.DFC_HEVE0max_C "OBD specific trouble code / OBD specific diagnostic trouble code for check DFC_HEVE0max" VALUE 0x80504784 Val_Wu16 65535.00 DFES_OneToOne 0.00 65535.00 FORMAT "%8.2" /end CHARACTERISTIC
/begin CHARACTERISTIC DFES_DTCO.DFC_HEVE1max_C "OBD specific trouble code / OBD specific diagnostic trouble code for check DFC_HEVE1max" VALUE 0x80504786 Val_Wu16 65535.00 DFES_OneToOne 0.00 65535.00 FORMAT "%8.2" /end CHARACTERISTIC
/begin CHARACTERISTIC DFES_DTCO.DFC_HFMmax_C "OBD specific trouble code / OBD specific diagnostic trouble code for check DFC_HFMmax" VALUE 0x80504788 Val_Wu16 65535.00 DFES_OneToOne 0.00 65535.00 FORMAT "%8.2" /end CHARACTERISTIC
/begin CHARACTERISTIC DFES_DTCO.DFC_HiPSysHiPMaxLimExcdd_C "OBD specific trouble code / OBD specific diagnostic trouble code for check DFC_HiPSysHiPMaxLimExcdd" VALUE 0x8050478A Val_Wu16 65535.00 DFES_OneToOne 0.00 65535.00 FORMAT "%8.2" /end CHARACTERISTIC
/begin CHARACTERISTIC DFES_DTCO.DFC_IVGdiCtlCvoErrMax_0_C "OBD specific trouble code / OBD specific diagnostic trouble code for check DFC_IVGdiCtlCvoErrMax_0" VALUE 0x8050478C Val_Wu16 65535.00 DFES_OneToOne 0.00 65535.00 FORMAT "%8.2" /end CHARACTERISTIC
/begin CHARACTERISTIC DFES_DTCO.DFC_IVGdiCtlCvoErrMax_1_C "OBD specific trouble code / OBD specific diagnostic trouble code for check DFC_IVGdiCtlCvoErrMax_1" VALUE 0x8050478E Val_Wu16 65535.00 DFES_OneToOne 0.00 65535.00 FORMAT "%8.2" /end CHARACTERISTIC
/begin CHARACTERISTIC DFES_DTCO.DFC_IVGdiCtlCvoErrMax_2_C "OBD specific trouble code / OBD specific diagnostic trouble code for check DFC_IVGdiCtlCvoErrMax_2" VALUE 0x80504790 Val_Wu16 65535.00 DFES_OneToOne 0.00 65535.00 FORMAT "%8.2" /end CHARACTERISTIC
/begin CHARACTERISTIC DFES_DTCO.DFC_IVGdiCtlCvoErrMax_3_C "OBD specific trouble code / OBD specific diagnostic trouble code for check DFC_IVGdiCtlCvoErrMax_3" VALUE 0x80504792 Val_Wu16 65535.00 DFES_OneToOne 0.00 65535.00 FORMAT "%8.2" /end CHARACTERISTIC
/begin CHARACTERISTIC DFES_DTCO.DFC_IVGdiCtlCvoErrMin_0_C "OBD specific trouble code / OBD specific diagnostic trouble code for check DFC_IVGdiCtlCvoErrMin_0" VALUE 0x80504794 Val_Wu16 65535.00 DFES_OneToOne 0.00 65535.00 FORMAT "%8.2" /end CHARACTERISTIC
/begin CHARACTERISTIC DFES_DTCO.DFC_IVGdiCtlCvoErrMin_1_C "OBD specific trouble code / OBD specific diagnostic trouble code for check DFC_IVGdiCtlCvoErrMin_1" VALUE 0x80504796 Val_Wu16 65535.00 DFES_OneToOne 0.00 65535.00 FORMAT "%8.2" /end CHARACTERISTIC
/begin CHARACTERISTIC DFES_DTCO.DFC_IVGdiCtlCvoErrMin_2_C "OBD specific trouble code / OBD specific diagnostic trouble code for check DFC_IVGdiCtlCvoErrMin_2" VALUE 0x80504798 Val_Wu16 65535.00 DFES_OneToOne 0.00 65535.00 FORMAT "%8.2" /end CHARACTERISTIC
/begin CHARACTERISTIC DFES_DTCO.DFC_IVGdiCtlCvoErrMin_3_C "OBD specific trouble code / OBD specific diagnostic trouble code for check DFC_IVGdiCtlCvoErrMin_3" VALUE 0x8050479A Val_Wu16 65535.00 DFES_OneToOne 0.00 65535.00 FORMAT "%8.2" /end CHARACTERISTIC
/begin CHARACTERISTIC DFES_DTCO.DFC_IVGdiCtlCvoErrMinMax_C "OBD specific trouble code / OBD specific diagnostic trouble code for check DFC_IVGdiCtlCvoErrMinMax" VALUE 0x8050479C Val_Wu16 65535.00 DFES_OneToOne 0.00 65535.00 FORMAT "%8.2" /end CHARACTERISTIC
/begin CHARACTERISTIC DFES_DTCO.DFC_IVGdiCtlCvoSigPlausErrSmrCdn_C "OBD specific trouble code / OBD specific diagnostic trouble code for check DFC_IVGdiCtlCvoSigPlausErrSmrCdn" VALUE 0x8050479E Val_Wu16 65535.00 DFES_OneToOne 0.00 65535.00 FORMAT "%8.2" /end CHARACTERISTIC
/begin CHARACTERISTIC DFES_DTCO.DFC_IVGdiCtl_CvoErr_C "OBD specific trouble code / OBD specific diagnostic trouble code for check DFC_IVGdiCtl_CvoErr" VALUE 0x805047A0 Val_Wu16 65535.00 DFES_OneToOne 0.00 65535.00 FORMAT "%8.2" /end CHARACTERISTIC
/begin CHARACTERISTIC DFES_DTCO.DFC_IVGdiCtl_CvoSigPlaus_0_C "OBD specific trouble code / OBD specific diagnostic trouble code for check DFC_IVGdiCtl_CvoSigPlaus_0" VALUE 0x805047A2 Val_Wu16 65535.00 DFES_OneToOne 0.00 65535.00 FORMAT "%8.2" /end CHARACTERISTIC
/begin CHARACTERISTIC DFES_DTCO.DFC_IVGdiCtl_CvoSigPlaus_1_C "OBD specific trouble code / OBD specific diagnostic trouble code for check DFC_IVGdiCtl_CvoSigPlaus_1" VALUE 0x805047A4 Val_Wu16 65535.00 DFES_OneToOne 0.00 65535.00 FORMAT "%8.2" /end CHARACTERISTIC
/begin CHARACTERISTIC DFES_DTCO.DFC_IVGdiCtl_CvoSigPlaus_2_C "OBD specific trouble code / OBD specific diagnostic trouble code for check DFC_IVGdiCtl_CvoSigPlaus_2" VALUE 0x805047A6 Val_Wu16 65535.00 DFES_OneToOne 0.00 65535.00 FORMAT "%8.2" /end CHARACTERISTIC
/begin CHARACTERISTIC DFES_DTCO.DFC_IVGdiCtl_CvoSigPlaus_3_C "OBD specific trouble code / OBD specific diagnostic trouble code for check DFC_IVGdiCtl_CvoSigPlaus_3" VALUE 0x805047A8 Val_Wu16 65535.00 DFES_OneToOne 0.00 65535.00 FORMAT "%8.2" /end CHARACTERISTIC
/begin CHARACTERISTIC DFES_DTCO.DFC_IntkAirTAirFltDsCrssMax_C "OBD specific trouble code / OBD specific diagnostic trouble code for check DFC_IntkAirTAirFltDsCrssMax" VALUE 0x805047AA Val_Wu16 65535.00 DFES_OneToOne 0.00 65535.00 FORMAT "%8.2" /end CHARACTERISTIC
/begin CHARACTERISTIC DFES_DTCO.DFC_IntkAirTAirFltDsCrssMin_C "OBD specific trouble code / OBD specific diagnostic trouble code for check DFC_IntkAirTAirFltDsCrssMin" VALUE 0x805047AC Val_Wu16 65535.00 DFES_OneToOne 0.00 65535.00 FORMAT "%8.2" /end CHARACTERISTIC
/begin CHARACTERISTIC DFES_DTCO.DFC_IntkAirTAirFltDsHSCMax_C "OBD specific trouble code / OBD specific diagnostic trouble code for check DFC_IntkAirTAirFltDsHSCMax" VALUE 0x805047AE Val_Wu16 65535.00 DFES_OneToOne 0.00 65535.00 FORMAT "%8.2" /end CHARACTERISTIC
/begin CHARACTERISTIC DFES_DTCO.DFC_IntkAirTAirFltDsImps_C "OBD specific trouble code / OBD specific diagnostic trouble code for check DFC_IntkAirTAirFltDsImps" VALUE 0x805047B0 Val_Wu16 65535.00 DFES_OneToOne 0.00 65535.00 FORMAT "%8.2" /end CHARACTERISTIC
/begin CHARACTERISTIC DFES_DTCO.DFC_IntkAirTAirFltDsPRCMax_C "OBD specific trouble code / OBD specific diagnostic trouble code for check DFC_IntkAirTAirFltDsPRCMax" VALUE 0x805047B2 Val_Wu16 65535.00 DFES_OneToOne 0.00 65535.00 FORMAT "%8.2" /end CHARACTERISTIC
/begin CHARACTERISTIC DFES_DTCO.DFC_IntkAirTAirFltDsPRCMin_C "OBD specific trouble code / OBD specific diagnostic trouble code for check DFC_IntkAirTAirFltDsPRCMin" VALUE 0x805047B4 Val_Wu16 65535.00 DFES_OneToOne 0.00 65535.00 FORMAT "%8.2" /end CHARACTERISTIC
/begin CHARACTERISTIC DFES_DTCO.DFC_IntkAirTAirFltDsSRCMax_C "OBD specific trouble code / OBD specific diagnostic trouble code for check DFC_IntkAirTAirFltDsSRCMax" VALUE 0x805047B6 Val_Wu16 65535.00 DFES_OneToOne 0.00 65535.00 FORMAT "%8.2" /end CHARACTERISTIC
/begin CHARACTERISTIC DFES_DTCO.DFC_IntkAirTAirFltDsSRCMin_C "OBD specific trouble code / OBD specific diagnostic trouble code for check DFC_IntkAirTAirFltDsSRCMin" VALUE 0x805047B8 Val_Wu16 65535.00 DFES_OneToOne 0.00 65535.00 FORMAT "%8.2" /end CHARACTERISTIC
/begin CHARACTERISTIC DFES_DTCO.DFC_IntkAirTAirFltDsSTC_C "OBD specific trouble code / OBD specific diagnostic trouble code for check DFC_IntkAirTAirFltDsSTC" VALUE 0x805047BA Val_Wu16 65535.00 DFES_OneToOne 0.00 65535.00 FORMAT "%8.2" /end CHARACTERISTIC
/begin CHARACTERISTIC DFES_DTCO.DFC_IntkAirTIntkMnfldCrssMax_C "OBD specific trouble code / OBD specific diagnostic trouble code for check DFC_IntkAirTIntkMnfldCrssMax" VALUE 0x805047BC Val_Wu16 65535.00 DFES_OneToOne 0.00 65535.00 FORMAT "%8.2" /end CHARACTERISTIC
/begin CHARACTERISTIC DFES_DTCO.DFC_IntkAirTIntkMnfldCrssMin_C "OBD specific trouble code / OBD specific diagnostic trouble code for check DFC_IntkAirTIntkMnfldCrssMin" VALUE 0x805047BE Val_Wu16 65535.00 DFES_OneToOne 0.00 65535.00 FORMAT "%8.2" /end CHARACTERISTIC
/begin CHARACTERISTIC DFES_DTCO.DFC_IntkAirTIntkMnfldHSCMax_C "OBD specific trouble code / OBD specific diagnostic trouble code for check DFC_IntkAirTIntkMnfldHSCMax" VALUE 0x805047C0 Val_Wu16 65535.00 DFES_OneToOne 0.00 65535.00 FORMAT "%8.2" /end CHARACTERISTIC
/begin CHARACTERISTIC DFES_DTCO.DFC_IntkAirTIntkMnfldImps_C "OBD specific trouble code / OBD specific diagnostic trouble code for check DFC_IntkAirTIntkMnfldImps" VALUE 0x805047C2 Val_Wu16 65535.00 DFES_OneToOne 0.00 65535.00 FORMAT "%8.2" /end CHARACTERISTIC
/begin CHARACTERISTIC DFES_DTCO.DFC_IntkAirTIntkMnfldPRCMax_C "OBD specific trouble code / OBD specific diagnostic trouble code for check DFC_IntkAirTIntkMnfldPRCMax" VALUE 0x805047C4 Val_Wu16 65535.00 DFES_OneToOne 0.00 65535.00 FORMAT "%8.2" /end CHARACTERISTIC
/begin CHARACTERISTIC DFES_DTCO.DFC_IntkAirTIntkMnfldPRCMin_C "OBD specific trouble code / OBD specific diagnostic trouble code for check DFC_IntkAirTIntkMnfldPRCMin" VALUE 0x805047C6 Val_Wu16 65535.00 DFES_OneToOne 0.00 65535.00 FORMAT "%8.2" /end CHARACTERISTIC
/begin CHARACTERISTIC DFES_DTCO.DFC_IntkAirTIntkMnfldSRCMax_C "OBD specific trouble code / OBD specific diagnostic trouble code for check DFC_IntkAirTIntkMnfldSRCMax" VALUE 0x805047C8 Val_Wu16 65535.00 DFES_OneToOne 0.00 65535.00 FORMAT "%8.2" /end CHARACTERISTIC
/begin CHARACTERISTIC DFES_DTCO.DFC_IntkAirTIntkMnfldSRCMin_C "OBD specific trouble code / OBD specific diagnostic trouble code for check DFC_IntkAirTIntkMnfldSRCMin" VALUE 0x805047CA Val_Wu16 65535.00 DFES_OneToOne 0.00 65535.00 FORMAT "%8.2" /end CHARACTERISTIC
/begin CHARACTERISTIC DFES_DTCO.DFC_IntkAirTIntkMnfldSTC_C "OBD specific trouble code / OBD specific diagnostic trouble code for check DFC_IntkAirTIntkMnfldSTC" VALUE 0x805047CC Val_Wu16 65535.00 DFES_OneToOne 0.00 65535.00 FORMAT "%8.2" /end CHARACTERISTIC
/begin CHARACTERISTIC DFES_DTCO.DFC_KRREGRLMX_C "OBD specific trouble code / OBD specific diagnostic trouble code for check DFC_KRREGRLMX" VALUE 0x805047CE Val_Wu16 65535.00 DFES_OneToOne 0.00 65535.00 FORMAT "%8.2" /end CHARACTERISTIC
/begin CHARACTERISTIC DFES_DTCO.DFC_KRVEKOCVLCI_C "OBD specific trouble code / OBD specific diagnostic trouble code for check DFC_KRVEKOCVLCI" VALUE 0x805047D0 Val_Wu16 65535.00 DFES_OneToOne 0.00 65535.00 FORMAT "%8.2" /end CHARACTERISTIC
/begin CHARACTERISTIC DFES_DTCO.DFC_KRVEKOENCHMT_C "OBD specific trouble code / OBD specific diagnostic trouble code for check DFC_KRVEKOENCHMT" VALUE 0x805047D2 Val_Wu16 65535.00 DFES_OneToOne 0.00 65535.00 FORMAT "%8.2" /end CHARACTERISTIC
/begin CHARACTERISTIC DFES_DTCO.DFC_KRVEKOENCHMT0_C "OBD specific trouble code / OBD specific diagnostic trouble code for check DFC_KRVEKOENCHMT0" VALUE 0x805047D4 Val_Wu16 65535.00 DFES_OneToOne 0.00 65535.00 FORMAT "%8.2" /end CHARACTERISTIC
/begin CHARACTERISTIC DFES_DTCO.DFC_KRVEKOENCHMT1_C "OBD specific trouble code / OBD specific diagnostic trouble code for check DFC_KRVEKOENCHMT1" VALUE 0x805047D6 Val_Wu16 65535.00 DFES_OneToOne 0.00 65535.00 FORMAT "%8.2" /end CHARACTERISTIC
/begin CHARACTERISTIC DFES_DTCO.DFC_KRVEKOENCHMT2_C "OBD specific trouble code / OBD specific diagnostic trouble code for check DFC_KRVEKOENCHMT2" VALUE 0x805047D8 Val_Wu16 65535.00 DFES_OneToOne 0.00 65535.00 FORMAT "%8.2" /end CHARACTERISTIC
/begin CHARACTERISTIC DFES_DTCO.DFC_KRVEKOENCHMT3_C "OBD specific trouble code / OBD specific diagnostic trouble code for check DFC_KRVEKOENCHMT3" VALUE 0x805047DA Val_Wu16 65535.00 DFES_OneToOne 0.00 65535.00 FORMAT "%8.2" /end CHARACTERISTIC
/begin CHARACTERISTIC DFES_DTCO.DFC_KRVEKOENCHMT4_C "OBD specific trouble code / OBD specific diagnostic trouble code for check DFC_KRVEKOENCHMT4" VALUE 0x805047DC Val_Wu16 65535.00 DFES_OneToOne 0.00 65535.00 FORMAT "%8.2" /end CHARACTERISTIC
/begin CHARACTERISTIC DFES_DTCO.DFC_KRVEKOENCHMT5_C "OBD specific trouble code / OBD specific diagnostic trouble code for check DFC_KRVEKOENCHMT5" VALUE 0x805047DE Val_Wu16 65535.00 DFES_OneToOne 0.00 65535.00 FORMAT "%8.2" /end CHARACTERISTIC
/begin CHARACTERISTIC DFES_DTCO.DFC_KRVEKOENCHMT6_C "OBD specific trouble code / OBD specific diagnostic trouble code for check DFC_KRVEKOENCHMT6" VALUE 0x805047E0 Val_Wu16 65535.00 DFES_OneToOne 0.00 65535.00 FORMAT "%8.2" /end CHARACTERISTIC
/begin CHARACTERISTIC DFES_DTCO.DFC_KRVEKOENCHMT7_C "OBD specific trouble code / OBD specific diagnostic trouble code for check DFC_KRVEKOENCHMT7" VALUE 0x805047E2 Val_Wu16 65535.00 DFES_OneToOne 0.00 65535.00 FORMAT "%8.2" /end CHARACTERISTIC
/begin CHARACTERISTIC DFES_DTCO.DFC_KRVEKORLMX_C "OBD specific trouble code / OBD specific diagnostic trouble code for check DFC_KRVEKORLMX" VALUE 0x805047E4 Val_Wu16 65535.00 DFES_OneToOne 0.00 65535.00 FORMAT "%8.2" /end CHARACTERISTIC
/begin CHARACTERISTIC DFES_DTCO.DFC_KRVEKORLMXL_C "OBD specific trouble code / OBD specific diagnostic trouble code for check DFC_KRVEKORLMXL" VALUE 0x805047E6 Val_Wu16 65535.00 DFES_OneToOne 0.00 65535.00 FORMAT "%8.2" /end CHARACTERISTIC
/begin CHARACTERISTIC DFES_DTCO.DFC_KS1max_C "OBD specific trouble code / OBD specific diagnostic trouble code for check DFC_KS1max" VALUE 0x805047E8 Val_Wu16 65535.00 DFES_OneToOne 0.00 65535.00 FORMAT "%8.2" /end CHARACTERISTIC
/begin CHARACTERISTIC DFES_DTCO.DFC_KS1min_C "OBD specific trouble code / OBD specific diagnostic trouble code for check DFC_KS1min" VALUE 0x805047EA Val_Wu16 65535.00 DFES_OneToOne 0.00 65535.00 FORMAT "%8.2" /end CHARACTERISTIC
/begin CHARACTERISTIC DFES_DTCO.DFC_LMmax_C "OBD specific trouble code / OBD specific diagnostic trouble code for check DFC_LMmax" VALUE 0x805047EC Val_Wu16 65535.00 DFES_OneToOne 0.00 65535.00 FORMAT "%8.2" /end CHARACTERISTIC
/begin CHARACTERISTIC DFES_DTCO.DFC_LZSRnpl_C "OBD specific trouble code / OBD specific diagnostic trouble code for check DFC_LZSRnpl" VALUE 0x805047EE Val_Wu16 65535.00 DFES_OneToOne 0.00 65535.00 FORMAT "%8.2" /end CHARACTERISTIC
/begin CHARACTERISTIC DFES_DTCO.DFC_LamDynDiagS1B1_C "OBD specific trouble code / OBD specific diagnostic trouble code for check DFC_LamDynDiagS1B1" VALUE 0x805047F0 Val_Wu16 65535.00 DFES_OneToOne 0.00 65535.00 FORMAT "%8.2" /end CHARACTERISTIC
/begin CHARACTERISTIC DFES_DTCO.DFC_LeakIntkMnfldEmiInfl_C "OBD specific trouble code / OBD specific diagnostic trouble code for check DFC_LeakIntkMnfldEmiInfl" VALUE 0x805047F2 Val_Wu16 65535.00 DFES_OneToOne 0.00 65535.00 FORMAT "%8.2" /end CHARACTERISTIC
/begin CHARACTERISTIC DFES_DTCO.DFC_LinFrameErrDCDC_C "OBD specific trouble code / OBD specific diagnostic trouble code for check DFC_LinFrameErrDCDC" VALUE 0x805047F4 Val_Wu16 65535.00 DFES_OneToOne 0.00 65535.00 FORMAT "%8.2" /end CHARACTERISTIC
/begin CHARACTERISTIC DFES_DTCO.DFC_LinOverrunErrDCDC_C "OBD specific trouble code / OBD specific diagnostic trouble code for check DFC_LinOverrunErrDCDC" VALUE 0x805047F6 Val_Wu16 65535.00 DFES_OneToOne 0.00 65535.00 FORMAT "%8.2" /end CHARACTERISTIC
/begin CHARACTERISTIC DFES_DTCO.DFC_MD00max_C "OBD specific trouble code / OBD specific diagnostic trouble code for check DFC_MD00max" VALUE 0x805047F8 Val_Wu16 65535.00 DFES_OneToOne 0.00 65535.00 FORMAT "%8.2" /end CHARACTERISTIC
/begin CHARACTERISTIC DFES_DTCO.DFC_MDBmax_C "OBD specific trouble code / OBD specific diagnostic trouble code for check DFC_MDBmax" VALUE 0x805047FA Val_Wu16 65535.00 DFES_OneToOne 0.00 65535.00 FORMAT "%8.2" /end CHARACTERISTIC
/begin CHARACTERISTIC DFES_DTCO.DFC_MDCat_C "OBD specific trouble code / OBD specific diagnostic trouble code for check DFC_MDCat" VALUE 0x805047FC Val_Wu16 65535.00 DFES_OneToOne 0.00 65535.00 FORMAT "%8.2" /end CHARACTERISTIC
/begin CHARACTERISTIC DFES_DTCO.DFC_MDCatCrit_C "OBD specific trouble code / OBD specific diagnostic trouble code for check DFC_MDCatCrit" VALUE 0x805047FE Val_Wu16 65535.00 DFES_OneToOne 0.00 65535.00 FORMAT "%8.2" /end CHARACTERISTIC
/begin CHARACTERISTIC DFES_DTCO.DFC_MDCatCurr_C "OBD specific trouble code / OBD specific diagnostic trouble code for check DFC_MDCatCurr" VALUE 0x80504800 Val_Wu16 65535.00 DFES_OneToOne 0.00 65535.00 FORMAT "%8.2" /end CHARACTERISTIC
/begin CHARACTERISTIC DFES_DTCO.DFC_MDCyl_0_C "OBD specific trouble code / OBD specific diagnostic trouble code for check DFC_MDCyl_0" VALUE 0x80504802 Val_Wu16 65535.00 DFES_OneToOne 0.00 65535.00 FORMAT "%8.2" /end CHARACTERISTIC
/begin CHARACTERISTIC DFES_DTCO.DFC_MDCyl_1_C "OBD specific trouble code / OBD specific diagnostic trouble code for check DFC_MDCyl_1" VALUE 0x80504804 Val_Wu16 65535.00 DFES_OneToOne 0.00 65535.00 FORMAT "%8.2" /end CHARACTERISTIC
/begin CHARACTERISTIC DFES_DTCO.DFC_MDCyl_2_C "OBD specific trouble code / OBD specific diagnostic trouble code for check DFC_MDCyl_2" VALUE 0x80504806 Val_Wu16 65535.00 DFES_OneToOne 0.00 65535.00 FORMAT "%8.2" /end CHARACTERISTIC
/begin CHARACTERISTIC DFES_DTCO.DFC_MDCyl_3_C "OBD specific trouble code / OBD specific diagnostic trouble code for check DFC_MDCyl_3" VALUE 0x80504808 Val_Wu16 65535.00 DFES_OneToOne 0.00 65535.00 FORMAT "%8.2" /end CHARACTERISTIC
/begin CHARACTERISTIC DFES_DTCO.DFC_MDEmi_C "OBD specific trouble code / OBD specific diagnostic trouble code for check DFC_MDEmi" VALUE 0x8050480A Val_Wu16 65535.00 DFES_OneToOne 0.00 65535.00 FORMAT "%8.2" /end CHARACTERISTIC
/begin CHARACTERISTIC DFES_DTCO.DFC_MDEmiStrt_C "OBD specific trouble code / OBD specific diagnostic trouble code for check DFC_MDEmiStrt" VALUE 0x8050480C Val_Wu16 65535.00 DFES_OneToOne 0.00 65535.00 FORMAT "%8.2" /end CHARACTERISTIC
/begin CHARACTERISTIC DFES_DTCO.DFC_MDFco_C "OBD specific trouble code / OBD specific diagnostic trouble code for check DFC_MDFco" VALUE 0x8050480E Val_Wu16 65535.00 DFES_OneToOne 0.00 65535.00 FORMAT "%8.2" /end CHARACTERISTIC
/begin CHARACTERISTIC DFES_DTCO.DFC_MDMpl_C "OBD specific trouble code / OBD specific diagnostic trouble code for check DFC_MDMpl" VALUE 0x80504810 Val_Wu16 65535.00 DFES_OneToOne 0.00 65535.00 FORMAT "%8.2" /end CHARACTERISTIC
/begin CHARACTERISTIC DFES_DTCO.DFC_MDSegTiAdpn_C "OBD specific trouble code / OBD specific diagnostic trouble code for check DFC_MDSegTiAdpn" VALUE 0x80504812 Val_Wu16 65535.00 DFES_OneToOne 0.00 65535.00 FORMAT "%8.2" /end CHARACTERISTIC
/begin CHARACTERISTIC DFES_DTCO.DFC_MDmax_C "OBD specific trouble code / OBD specific diagnostic trouble code for check DFC_MDmax" VALUE 0x80504814 Val_Wu16 65535.00 DFES_OneToOne 0.00 65535.00 FORMAT "%8.2" /end CHARACTERISTIC
/begin CHARACTERISTIC DFES_DTCO.DFC_MFuOilMax_C "OBD specific trouble code / OBD specific diagnostic trouble code for check DFC_MFuOilMax" VALUE 0x80504816 Val_Wu16 65535.00 DFES_OneToOne 0.00 65535.00 FORMAT "%8.2" /end CHARACTERISTIC
/begin CHARACTERISTIC DFES_DTCO.DFC_MOXEMM_SMU_ALM0_0_C "OBD specific trouble code / OBD specific diagnostic trouble code for check DFC_MOXEMM_SMU_ALM0_0" VALUE 0x80504818 Val_Wu16 65535.00 DFES_OneToOne 0.00 65535.00 FORMAT "%8.2" /end CHARACTERISTIC
/begin CHARACTERISTIC DFES_DTCO.DFC_MOXEMM_SMU_ALM0_1_C "OBD specific trouble code / OBD specific diagnostic trouble code for check DFC_MOXEMM_SMU_ALM0_1" VALUE 0x8050481A Val_Wu16 65535.00 DFES_OneToOne 0.00 65535.00 FORMAT "%8.2" /end CHARACTERISTIC
/begin CHARACTERISTIC DFES_DTCO.DFC_MOXEMM_SMU_ALM0_10_C "OBD specific trouble code / OBD specific diagnostic trouble code for check DFC_MOXEMM_SMU_ALM0_10" VALUE 0x8050481C Val_Wu16 65535.00 DFES_OneToOne 0.00 65535.00 FORMAT "%8.2" /end CHARACTERISTIC
/begin CHARACTERISTIC DFES_DTCO.DFC_MOXEMM_SMU_ALM0_11_C "OBD specific trouble code / OBD specific diagnostic trouble code for check DFC_MOXEMM_SMU_ALM0_11" VALUE 0x8050481E Val_Wu16 65535.00 DFES_OneToOne 0.00 65535.00 FORMAT "%8.2" /end CHARACTERISTIC
/begin CHARACTERISTIC DFES_DTCO.DFC_MOXEMM_SMU_ALM0_13_C "OBD specific trouble code / OBD specific diagnostic trouble code for check DFC_MOXEMM_SMU_ALM0_13" VALUE 0x80504820 Val_Wu16 65535.00 DFES_OneToOne 0.00 65535.00 FORMAT "%8.2" /end CHARACTERISTIC
/begin CHARACTERISTIC DFES_DTCO.DFC_MOXEMM_SMU_ALM0_14_C "OBD specific trouble code / OBD specific diagnostic trouble code for check DFC_MOXEMM_SMU_ALM0_14" VALUE 0x80504822 Val_Wu16 65535.00 DFES_OneToOne 0.00 65535.00 FORMAT "%8.2" /end CHARACTERISTIC
/begin CHARACTERISTIC DFES_DTCO.DFC_MOXEMM_SMU_ALM0_2_C "OBD specific trouble code / OBD specific diagnostic trouble code for check DFC_MOXEMM_SMU_ALM0_2" VALUE 0x80504824 Val_Wu16 65535.00 DFES_OneToOne 0.00 65535.00 FORMAT "%8.2" /end CHARACTERISTIC
/begin CHARACTERISTIC DFES_DTCO.DFC_MOXEMM_SMU_ALM0_22_C "OBD specific trouble code / OBD specific diagnostic trouble code for check DFC_MOXEMM_SMU_ALM0_22" VALUE 0x80504826 Val_Wu16 65535.00 DFES_OneToOne 0.00 65535.00 FORMAT "%8.2" /end CHARACTERISTIC
/begin CHARACTERISTIC DFES_DTCO.DFC_MOXEMM_SMU_ALM0_23_C "OBD specific trouble code / OBD specific diagnostic trouble code for check DFC_MOXEMM_SMU_ALM0_23" VALUE 0x80504828 Val_Wu16 65535.00 DFES_OneToOne 0.00 65535.00 FORMAT "%8.2" /end CHARACTERISTIC
/begin CHARACTERISTIC DFES_DTCO.DFC_MOXEMM_SMU_ALM0_4_C "OBD specific trouble code / OBD specific diagnostic trouble code for check DFC_MOXEMM_SMU_ALM0_4" VALUE 0x8050482A Val_Wu16 65535.00 DFES_OneToOne 0.00 65535.00 FORMAT "%8.2" /end CHARACTERISTIC
/begin CHARACTERISTIC DFES_DTCO.DFC_MOXEMM_SMU_ALM0_5_C "OBD specific trouble code / OBD specific diagnostic trouble code for check DFC_MOXEMM_SMU_ALM0_5" VALUE 0x8050482C Val_Wu16 65535.00 DFES_OneToOne 0.00 65535.00 FORMAT "%8.2" /end CHARACTERISTIC
/begin CHARACTERISTIC DFES_DTCO.DFC_MOXEMM_SMU_ALM0_7_C "OBD specific trouble code / OBD specific diagnostic trouble code for check DFC_MOXEMM_SMU_ALM0_7" VALUE 0x8050482E Val_Wu16 65535.00 DFES_OneToOne 0.00 65535.00 FORMAT "%8.2" /end CHARACTERISTIC
/begin CHARACTERISTIC DFES_DTCO.DFC_MOXEMM_SMU_ALM0_8_C "OBD specific trouble code / OBD specific diagnostic trouble code for check DFC_MOXEMM_SMU_ALM0_8" VALUE 0x80504830 Val_Wu16 65535.00 DFES_OneToOne 0.00 65535.00 FORMAT "%8.2" /end CHARACTERISTIC
/begin CHARACTERISTIC DFES_DTCO.DFC_MOXEMM_SMU_ALM10_16_C "OBD specific trouble code / OBD specific diagnostic trouble code for check DFC_MOXEMM_SMU_ALM10_16" VALUE 0x80504832 Val_Wu16 65535.00 DFES_OneToOne 0.00 65535.00 FORMAT "%8.2" /end CHARACTERISTIC
/begin CHARACTERISTIC DFES_DTCO.DFC_MOXEMM_SMU_ALM10_17_C "OBD specific trouble code / OBD specific diagnostic trouble code for check DFC_MOXEMM_SMU_ALM10_17" VALUE 0x80504834 Val_Wu16 65535.00 DFES_OneToOne 0.00 65535.00 FORMAT "%8.2" /end CHARACTERISTIC
/begin CHARACTERISTIC DFES_DTCO.DFC_MOXEMM_SMU_ALM10_21_C "OBD specific trouble code / OBD specific diagnostic trouble code for check DFC_MOXEMM_SMU_ALM10_21" VALUE 0x80504836 Val_Wu16 65535.00 DFES_OneToOne 0.00 65535.00 FORMAT "%8.2" /end CHARACTERISTIC
/begin CHARACTERISTIC DFES_DTCO.DFC_MOXEMM_SMU_ALM11_0_C "OBD specific trouble code / OBD specific diagnostic trouble code for check DFC_MOXEMM_SMU_ALM11_0" VALUE 0x80504838 Val_Wu16 65535.00 DFES_OneToOne 0.00 65535.00 FORMAT "%8.2" /end CHARACTERISTIC
/begin CHARACTERISTIC DFES_DTCO.DFC_MOXEMM_SMU_ALM11_1_C "OBD specific trouble code / OBD specific diagnostic trouble code for check DFC_MOXEMM_SMU_ALM11_1" VALUE 0x8050483A Val_Wu16 65535.00 DFES_OneToOne 0.00 65535.00 FORMAT "%8.2" /end CHARACTERISTIC
/begin CHARACTERISTIC DFES_DTCO.DFC_MOXEMM_SMU_ALM11_2_C "OBD specific trouble code / OBD specific diagnostic trouble code for check DFC_MOXEMM_SMU_ALM11_2" VALUE 0x8050483C Val_Wu16 65535.00 DFES_OneToOne 0.00 65535.00 FORMAT "%8.2" /end CHARACTERISTIC
/begin CHARACTERISTIC DFES_DTCO.DFC_MOXEMM_SMU_ALM11_3_C "OBD specific trouble code / OBD specific diagnostic trouble code for check DFC_MOXEMM_SMU_ALM11_3" VALUE 0x8050483E Val_Wu16 65535.00 DFES_OneToOne 0.00 65535.00 FORMAT "%8.2" /end CHARACTERISTIC
/begin CHARACTERISTIC DFES_DTCO.DFC_MOXEMM_SMU_ALM11_4_C "OBD specific trouble code / OBD specific diagnostic trouble code for check DFC_MOXEMM_SMU_ALM11_4" VALUE 0x80504840 Val_Wu16 65535.00 DFES_OneToOne 0.00 65535.00 FORMAT "%8.2" /end CHARACTERISTIC
/begin CHARACTERISTIC DFES_DTCO.DFC_MOXEMM_SMU_ALM11_5_C "OBD specific trouble code / OBD specific diagnostic trouble code for check DFC_MOXEMM_SMU_ALM11_5" VALUE 0x80504842 Val_Wu16 65535.00 DFES_OneToOne 0.00 65535.00 FORMAT "%8.2" /end CHARACTERISTIC
/begin CHARACTERISTIC DFES_DTCO.DFC_MOXEMM_SMU_ALM11_8_C "OBD specific trouble code / OBD specific diagnostic trouble code for check DFC_MOXEMM_SMU_ALM11_8" VALUE 0x80504844 Val_Wu16 65535.00 DFES_OneToOne 0.00 65535.00 FORMAT "%8.2" /end CHARACTERISTIC
/begin CHARACTERISTIC DFES_DTCO.DFC_MOXEMM_SMU_ALM11_9_C "OBD specific trouble code / OBD specific diagnostic trouble code for check DFC_MOXEMM_SMU_ALM11_9" VALUE 0x80504846 Val_Wu16 65535.00 DFES_OneToOne 0.00 65535.00 FORMAT "%8.2" /end CHARACTERISTIC
/begin CHARACTERISTIC DFES_DTCO.DFC_MOXEMM_SMU_ALM1_0_C "OBD specific trouble code / OBD specific diagnostic trouble code for check DFC_MOXEMM_SMU_ALM1_0" VALUE 0x80504848 Val_Wu16 65535.00 DFES_OneToOne 0.00 65535.00 FORMAT "%8.2" /end CHARACTERISTIC
/begin CHARACTERISTIC DFES_DTCO.DFC_MOXEMM_SMU_ALM1_1_C "OBD specific trouble code / OBD specific diagnostic trouble code for check DFC_MOXEMM_SMU_ALM1_1" VALUE 0x8050484A Val_Wu16 65535.00 DFES_OneToOne 0.00 65535.00 FORMAT "%8.2" /end CHARACTERISTIC
/begin CHARACTERISTIC DFES_DTCO.DFC_MOXEMM_SMU_ALM1_10_C "OBD specific trouble code / OBD specific diagnostic trouble code for check DFC_MOXEMM_SMU_ALM1_10" VALUE 0x8050484C Val_Wu16 65535.00 DFES_OneToOne 0.00 65535.00 FORMAT "%8.2" /end CHARACTERISTIC
/begin CHARACTERISTIC DFES_DTCO.DFC_MOXEMM_SMU_ALM1_11_C "OBD specific trouble code / OBD specific diagnostic trouble code for check DFC_MOXEMM_SMU_ALM1_11" VALUE 0x8050484E Val_Wu16 65535.00 DFES_OneToOne 0.00 65535.00 FORMAT "%8.2" /end CHARACTERISTIC
/begin CHARACTERISTIC DFES_DTCO.DFC_MOXEMM_SMU_ALM1_13_C "OBD specific trouble code / OBD specific diagnostic trouble code for check DFC_MOXEMM_SMU_ALM1_13" VALUE 0x80504850 Val_Wu16 65535.00 DFES_OneToOne 0.00 65535.00 FORMAT "%8.2" /end CHARACTERISTIC
/begin CHARACTERISTIC DFES_DTCO.DFC_MOXEMM_SMU_ALM1_14_C "OBD specific trouble code / OBD specific diagnostic trouble code for check DFC_MOXEMM_SMU_ALM1_14" VALUE 0x80504852 Val_Wu16 65535.00 DFES_OneToOne 0.00 65535.00 FORMAT "%8.2" /end CHARACTERISTIC
/begin CHARACTERISTIC DFES_DTCO.DFC_MOXEMM_SMU_ALM1_2_C "OBD specific trouble code / OBD specific diagnostic trouble code for check DFC_MOXEMM_SMU_ALM1_2" VALUE 0x80504854 Val_Wu16 65535.00 DFES_OneToOne 0.00 65535.00 FORMAT "%8.2" /end CHARACTERISTIC
/begin CHARACTERISTIC DFES_DTCO.DFC_MOXEMM_SMU_ALM1_22_C "OBD specific trouble code / OBD specific diagnostic trouble code for check DFC_MOXEMM_SMU_ALM1_22" VALUE 0x80504856 Val_Wu16 65535.00 DFES_OneToOne 0.00 65535.00 FORMAT "%8.2" /end CHARACTERISTIC
/begin CHARACTERISTIC DFES_DTCO.DFC_MOXEMM_SMU_ALM1_23_C "OBD specific trouble code / OBD specific diagnostic trouble code for check DFC_MOXEMM_SMU_ALM1_23" VALUE 0x80504858 Val_Wu16 65535.00 DFES_OneToOne 0.00 65535.00 FORMAT "%8.2" /end CHARACTERISTIC
/begin CHARACTERISTIC DFES_DTCO.DFC_MOXEMM_SMU_ALM1_4_C "OBD specific trouble code / OBD specific diagnostic trouble code for check DFC_MOXEMM_SMU_ALM1_4" VALUE 0x8050485A Val_Wu16 65535.00 DFES_OneToOne 0.00 65535.00 FORMAT "%8.2" /end CHARACTERISTIC
/begin CHARACTERISTIC DFES_DTCO.DFC_MOXEMM_SMU_ALM1_5_C "OBD specific trouble code / OBD specific diagnostic trouble code for check DFC_MOXEMM_SMU_ALM1_5" VALUE 0x8050485C Val_Wu16 65535.00 DFES_OneToOne 0.00 65535.00 FORMAT "%8.2" /end CHARACTERISTIC
/begin CHARACTERISTIC DFES_DTCO.DFC_MOXEMM_SMU_ALM1_7_C "OBD specific trouble code / OBD specific diagnostic trouble code for check DFC_MOXEMM_SMU_ALM1_7" VALUE 0x8050485E Val_Wu16 65535.00 DFES_OneToOne 0.00 65535.00 FORMAT "%8.2" /end CHARACTERISTIC
/begin CHARACTERISTIC DFES_DTCO.DFC_MOXEMM_SMU_ALM1_8_C "OBD specific trouble code / OBD specific diagnostic trouble code for check DFC_MOXEMM_SMU_ALM1_8" VALUE 0x80504860 Val_Wu16 65535.00 DFES_OneToOne 0.00 65535.00 FORMAT "%8.2" /end CHARACTERISTIC
/begin CHARACTERISTIC DFES_DTCO.DFC_MOXEMM_SMU_ALM21_0_C "OBD specific trouble code / OBD specific diagnostic trouble code for check DFC_MOXEMM_SMU_ALM21_0" VALUE 0x80504862 Val_Wu16 65535.00 DFES_OneToOne 0.00 65535.00 FORMAT "%8.2" /end CHARACTERISTIC
/begin CHARACTERISTIC DFES_DTCO.DFC_MOXEMM_SMU_ALM21_16_C "OBD specific trouble code / OBD specific diagnostic trouble code for check DFC_MOXEMM_SMU_ALM21_16" VALUE 0x80504864 Val_Wu16 65535.00 DFES_OneToOne 0.00 65535.00 FORMAT "%8.2" /end CHARACTERISTIC
/begin CHARACTERISTIC DFES_DTCO.DFC_MOXEMM_SMU_ALM21_3_C "OBD specific trouble code / OBD specific diagnostic trouble code for check DFC_MOXEMM_SMU_ALM21_3" VALUE 0x80504866 Val_Wu16 65535.00 DFES_OneToOne 0.00 65535.00 FORMAT "%8.2" /end CHARACTERISTIC
/begin CHARACTERISTIC DFES_DTCO.DFC_MOXEMM_SMU_ALM2_1_C "OBD specific trouble code / OBD specific diagnostic trouble code for check DFC_MOXEMM_SMU_ALM2_1" VALUE 0x80504868 Val_Wu16 65535.00 DFES_OneToOne 0.00 65535.00 FORMAT "%8.2" /end CHARACTERISTIC
/begin CHARACTERISTIC DFES_DTCO.DFC_MOXEMM_SMU_ALM2_10_C "OBD specific trouble code / OBD specific diagnostic trouble code for check DFC_MOXEMM_SMU_ALM2_10" VALUE 0x8050486A Val_Wu16 65535.00 DFES_OneToOne 0.00 65535.00 FORMAT "%8.2" /end CHARACTERISTIC
/begin CHARACTERISTIC DFES_DTCO.DFC_MOXEMM_SMU_ALM2_11_C "OBD specific trouble code / OBD specific diagnostic trouble code for check DFC_MOXEMM_SMU_ALM2_11" VALUE 0x8050486C Val_Wu16 65535.00 DFES_OneToOne 0.00 65535.00 FORMAT "%8.2" /end CHARACTERISTIC
/begin CHARACTERISTIC DFES_DTCO.DFC_MOXEMM_SMU_ALM2_13_C "OBD specific trouble code / OBD specific diagnostic trouble code for check DFC_MOXEMM_SMU_ALM2_13" VALUE 0x8050486E Val_Wu16 65535.00 DFES_OneToOne 0.00 65535.00 FORMAT "%8.2" /end CHARACTERISTIC
/begin CHARACTERISTIC DFES_DTCO.DFC_MOXEMM_SMU_ALM2_14_C "OBD specific trouble code / OBD specific diagnostic trouble code for check DFC_MOXEMM_SMU_ALM2_14" VALUE 0x80504870 Val_Wu16 65535.00 DFES_OneToOne 0.00 65535.00 FORMAT "%8.2" /end CHARACTERISTIC
/begin CHARACTERISTIC DFES_DTCO.DFC_MOXEMM_SMU_ALM2_22_C "OBD specific trouble code / OBD specific diagnostic trouble code for check DFC_MOXEMM_SMU_ALM2_22" VALUE 0x80504872 Val_Wu16 65535.00 DFES_OneToOne 0.00 65535.00 FORMAT "%8.2" /end CHARACTERISTIC
/begin CHARACTERISTIC DFES_DTCO.DFC_MOXEMM_SMU_ALM2_23_C "OBD specific trouble code / OBD specific diagnostic trouble code for check DFC_MOXEMM_SMU_ALM2_23" VALUE 0x80504874 Val_Wu16 65535.00 DFES_OneToOne 0.00 65535.00 FORMAT "%8.2" /end CHARACTERISTIC
/begin CHARACTERISTIC DFES_DTCO.DFC_MOXEMM_SMU_ALM2_4_C "OBD specific trouble code / OBD specific diagnostic trouble code for check DFC_MOXEMM_SMU_ALM2_4" VALUE 0x80504876 Val_Wu16 65535.00 DFES_OneToOne 0.00 65535.00 FORMAT "%8.2" /end CHARACTERISTIC
/begin CHARACTERISTIC DFES_DTCO.DFC_MOXEMM_SMU_ALM2_5_C "OBD specific trouble code / OBD specific diagnostic trouble code for check DFC_MOXEMM_SMU_ALM2_5" VALUE 0x80504878 Val_Wu16 65535.00 DFES_OneToOne 0.00 65535.00 FORMAT "%8.2" /end CHARACTERISTIC
/begin CHARACTERISTIC DFES_DTCO.DFC_MOXEMM_SMU_ALM2_7_C "OBD specific trouble code / OBD specific diagnostic trouble code for check DFC_MOXEMM_SMU_ALM2_7" VALUE 0x8050487A Val_Wu16 65535.00 DFES_OneToOne 0.00 65535.00 FORMAT "%8.2" /end CHARACTERISTIC
/begin CHARACTERISTIC DFES_DTCO.DFC_MOXEMM_SMU_ALM2_8_C "OBD specific trouble code / OBD specific diagnostic trouble code for check DFC_MOXEMM_SMU_ALM2_8" VALUE 0x8050487C Val_Wu16 65535.00 DFES_OneToOne 0.00 65535.00 FORMAT "%8.2" /end CHARACTERISTIC
/begin CHARACTERISTIC DFES_DTCO.DFC_MOXEMM_SMU_ALM6_0_C "OBD specific trouble code / OBD specific diagnostic trouble code for check DFC_MOXEMM_SMU_ALM6_0" VALUE 0x8050487E Val_Wu16 65535.00 DFES_OneToOne 0.00 65535.00 FORMAT "%8.2" /end CHARACTERISTIC
/begin CHARACTERISTIC DFES_DTCO.DFC_MOXEMM_SMU_ALM6_11_C "OBD specific trouble code / OBD specific diagnostic trouble code for check DFC_MOXEMM_SMU_ALM6_11" VALUE 0x80504880 Val_Wu16 65535.00 DFES_OneToOne 0.00 65535.00 FORMAT "%8.2" /end CHARACTERISTIC
/begin CHARACTERISTIC DFES_DTCO.DFC_MOXEMM_SMU_ALM6_12_C "OBD specific trouble code / OBD specific diagnostic trouble code for check DFC_MOXEMM_SMU_ALM6_12" VALUE 0x80504882 Val_Wu16 65535.00 DFES_OneToOne 0.00 65535.00 FORMAT "%8.2" /end CHARACTERISTIC
/begin CHARACTERISTIC DFES_DTCO.DFC_MOXEMM_SMU_ALM6_14_C "OBD specific trouble code / OBD specific diagnostic trouble code for check DFC_MOXEMM_SMU_ALM6_14" VALUE 0x80504884 Val_Wu16 65535.00 DFES_OneToOne 0.00 65535.00 FORMAT "%8.2" /end CHARACTERISTIC
/begin CHARACTERISTIC DFES_DTCO.DFC_MOXEMM_SMU_ALM6_15_C "OBD specific trouble code / OBD specific diagnostic trouble code for check DFC_MOXEMM_SMU_ALM6_15" VALUE 0x80504886 Val_Wu16 65535.00 DFES_OneToOne 0.00 65535.00 FORMAT "%8.2" /end CHARACTERISTIC
/begin CHARACTERISTIC DFES_DTCO.DFC_MOXEMM_SMU_ALM6_17_C "OBD specific trouble code / OBD specific diagnostic trouble code for check DFC_MOXEMM_SMU_ALM6_17" VALUE 0x80504888 Val_Wu16 65535.00 DFES_OneToOne 0.00 65535.00 FORMAT "%8.2" /end CHARACTERISTIC
/begin CHARACTERISTIC DFES_DTCO.DFC_MOXEMM_SMU_ALM6_18_C "OBD specific trouble code / OBD specific diagnostic trouble code for check DFC_MOXEMM_SMU_ALM6_18" VALUE 0x8050488A Val_Wu16 65535.00 DFES_OneToOne 0.00 65535.00 FORMAT "%8.2" /end CHARACTERISTIC
/begin CHARACTERISTIC DFES_DTCO.DFC_MOXEMM_SMU_ALM6_20_C "OBD specific trouble code / OBD specific diagnostic trouble code for check DFC_MOXEMM_SMU_ALM6_20" VALUE 0x8050488C Val_Wu16 65535.00 DFES_OneToOne 0.00 65535.00 FORMAT "%8.2" /end CHARACTERISTIC
/begin CHARACTERISTIC DFES_DTCO.DFC_MOXEMM_SMU_ALM6_21_C "OBD specific trouble code / OBD specific diagnostic trouble code for check DFC_MOXEMM_SMU_ALM6_21" VALUE 0x8050488E Val_Wu16 65535.00 DFES_OneToOne 0.00 65535.00 FORMAT "%8.2" /end CHARACTERISTIC
/begin CHARACTERISTIC DFES_DTCO.DFC_MOXEMM_SMU_ALM6_25_C "OBD specific trouble code / OBD specific diagnostic trouble code for check DFC_MOXEMM_SMU_ALM6_25" VALUE 0x80504890 Val_Wu16 65535.00 DFES_OneToOne 0.00 65535.00 FORMAT "%8.2" /end CHARACTERISTIC
/begin CHARACTERISTIC DFES_DTCO.DFC_MOXEMM_SMU_ALM6_4_C "OBD specific trouble code / OBD specific diagnostic trouble code for check DFC_MOXEMM_SMU_ALM6_4" VALUE 0x80504892 Val_Wu16 65535.00 DFES_OneToOne 0.00 65535.00 FORMAT "%8.2" /end CHARACTERISTIC
/begin CHARACTERISTIC DFES_DTCO.DFC_MOXEMM_SMU_ALM6_5_C "OBD specific trouble code / OBD specific diagnostic trouble code for check DFC_MOXEMM_SMU_ALM6_5" VALUE 0x80504894 Val_Wu16 65535.00 DFES_OneToOne 0.00 65535.00 FORMAT "%8.2" /end CHARACTERISTIC
/begin CHARACTERISTIC DFES_DTCO.DFC_MOXEMM_SMU_ALM6_7_C "OBD specific trouble code / OBD specific diagnostic trouble code for check DFC_MOXEMM_SMU_ALM6_7" VALUE 0x80504896 Val_Wu16 65535.00 DFES_OneToOne 0.00 65535.00 FORMAT "%8.2" /end CHARACTERISTIC
/begin CHARACTERISTIC DFES_DTCO.DFC_MOXEMM_SMU_ALM6_8_C "OBD specific trouble code / OBD specific diagnostic trouble code for check DFC_MOXEMM_SMU_ALM6_8" VALUE 0x80504898 Val_Wu16 65535.00 DFES_OneToOne 0.00 65535.00 FORMAT "%8.2" /end CHARACTERISTIC
/begin CHARACTERISTIC DFES_DTCO.DFC_MOXEMM_SMU_ALM7_1_C "OBD specific trouble code / OBD specific diagnostic trouble code for check DFC_MOXEMM_SMU_ALM7_1" VALUE 0x8050489A Val_Wu16 65535.00 DFES_OneToOne 0.00 65535.00 FORMAT "%8.2" /end CHARACTERISTIC
/begin CHARACTERISTIC DFES_DTCO.DFC_MOXEMM_SMU_ALM7_12_C "OBD specific trouble code / OBD specific diagnostic trouble code for check DFC_MOXEMM_SMU_ALM7_12" VALUE 0x8050489C Val_Wu16 65535.00 DFES_OneToOne 0.00 65535.00 FORMAT "%8.2" /end CHARACTERISTIC
/begin CHARACTERISTIC DFES_DTCO.DFC_MOXEMM_SMU_ALM7_13_C "OBD specific trouble code / OBD specific diagnostic trouble code for check DFC_MOXEMM_SMU_ALM7_13" VALUE 0x8050489E Val_Wu16 65535.00 DFES_OneToOne 0.00 65535.00 FORMAT "%8.2" /end CHARACTERISTIC
/begin CHARACTERISTIC DFES_DTCO.DFC_MOXEMM_SMU_ALM7_14_C "OBD specific trouble code / OBD specific diagnostic trouble code for check DFC_MOXEMM_SMU_ALM7_14" VALUE 0x805048A0 Val_Wu16 65535.00 DFES_OneToOne 0.00 65535.00 FORMAT "%8.2" /end CHARACTERISTIC
/begin CHARACTERISTIC DFES_DTCO.DFC_MOXEMM_SMU_ALM7_15_C "OBD specific trouble code / OBD specific diagnostic trouble code for check DFC_MOXEMM_SMU_ALM7_15" VALUE 0x805048A2 Val_Wu16 65535.00 DFES_OneToOne 0.00 65535.00 FORMAT "%8.2" /end CHARACTERISTIC
/begin CHARACTERISTIC DFES_DTCO.DFC_MOXEMM_SMU_ALM7_16_C "OBD specific trouble code / OBD specific diagnostic trouble code for check DFC_MOXEMM_SMU_ALM7_16" VALUE 0x805048A4 Val_Wu16 65535.00 DFES_OneToOne 0.00 65535.00 FORMAT "%8.2" /end CHARACTERISTIC
/begin CHARACTERISTIC DFES_DTCO.DFC_MOXEMM_SMU_ALM7_17_C "OBD specific trouble code / OBD specific diagnostic trouble code for check DFC_MOXEMM_SMU_ALM7_17" VALUE 0x805048A6 Val_Wu16 65535.00 DFES_OneToOne 0.00 65535.00 FORMAT "%8.2" /end CHARACTERISTIC
/begin CHARACTERISTIC DFES_DTCO.DFC_MOXEMM_SMU_ALM7_2_C "OBD specific trouble code / OBD specific diagnostic trouble code for check DFC_MOXEMM_SMU_ALM7_2" VALUE 0x805048A8 Val_Wu16 65535.00 DFES_OneToOne 0.00 65535.00 FORMAT "%8.2" /end CHARACTERISTIC
/begin CHARACTERISTIC DFES_DTCO.DFC_MOXEMM_SMU_ALM7_20_C "OBD specific trouble code / OBD specific diagnostic trouble code for check DFC_MOXEMM_SMU_ALM7_20" VALUE 0x805048AA Val_Wu16 65535.00 DFES_OneToOne 0.00 65535.00 FORMAT "%8.2" /end CHARACTERISTIC
/begin CHARACTERISTIC DFES_DTCO.DFC_MOXEMM_SMU_ALM7_25_C "OBD specific trouble code / OBD specific diagnostic trouble code for check DFC_MOXEMM_SMU_ALM7_25" VALUE 0x805048AC Val_Wu16 65535.00 DFES_OneToOne 0.00 65535.00 FORMAT "%8.2" /end CHARACTERISTIC
/begin CHARACTERISTIC DFES_DTCO.DFC_MOXEMM_SMU_ALM7_26_C "OBD specific trouble code / OBD specific diagnostic trouble code for check DFC_MOXEMM_SMU_ALM7_26" VALUE 0x805048AE Val_Wu16 65535.00 DFES_OneToOne 0.00 65535.00 FORMAT "%8.2" /end CHARACTERISTIC
/begin CHARACTERISTIC DFES_DTCO.DFC_MOXEMM_SMU_ALM7_28_C "OBD specific trouble code / OBD specific diagnostic trouble code for check DFC_MOXEMM_SMU_ALM7_28" VALUE 0x805048B0 Val_Wu16 65535.00 DFES_OneToOne 0.00 65535.00 FORMAT "%8.2" /end CHARACTERISTIC
/begin CHARACTERISTIC DFES_DTCO.DFC_MOXEMM_SMU_ALM7_29_C "OBD specific trouble code / OBD specific diagnostic trouble code for check DFC_MOXEMM_SMU_ALM7_29" VALUE 0x805048B2 Val_Wu16 65535.00 DFES_OneToOne 0.00 65535.00 FORMAT "%8.2" /end CHARACTERISTIC
/begin CHARACTERISTIC DFES_DTCO.DFC_MOXEMM_SMU_ALM7_30_C "OBD specific trouble code / OBD specific diagnostic trouble code for check DFC_MOXEMM_SMU_ALM7_30" VALUE 0x805048B4 Val_Wu16 65535.00 DFES_OneToOne 0.00 65535.00 FORMAT "%8.2" /end CHARACTERISTIC
/begin CHARACTERISTIC DFES_DTCO.DFC_MOXEMM_SMU_ALM7_31_C "OBD specific trouble code / OBD specific diagnostic trouble code for check DFC_MOXEMM_SMU_ALM7_31" VALUE 0x805048B6 Val_Wu16 65535.00 DFES_OneToOne 0.00 65535.00 FORMAT "%8.2" /end CHARACTERISTIC
/begin CHARACTERISTIC DFES_DTCO.DFC_MOXEMM_SMU_ALM8_0_C "OBD specific trouble code / OBD specific diagnostic trouble code for check DFC_MOXEMM_SMU_ALM8_0" VALUE 0x805048B8 Val_Wu16 65535.00 DFES_OneToOne 0.00 65535.00 FORMAT "%8.2" /end CHARACTERISTIC
/begin CHARACTERISTIC DFES_DTCO.DFC_MOXEMM_SMU_ALM8_1_C "OBD specific trouble code / OBD specific diagnostic trouble code for check DFC_MOXEMM_SMU_ALM8_1" VALUE 0x805048BA Val_Wu16 65535.00 DFES_OneToOne 0.00 65535.00 FORMAT "%8.2" /end CHARACTERISTIC
/begin CHARACTERISTIC DFES_DTCO.DFC_MOXEMM_SMU_ALM8_10_C "OBD specific trouble code / OBD specific diagnostic trouble code for check DFC_MOXEMM_SMU_ALM8_10" VALUE 0x805048BC Val_Wu16 65535.00 DFES_OneToOne 0.00 65535.00 FORMAT "%8.2" /end CHARACTERISTIC
/begin CHARACTERISTIC DFES_DTCO.DFC_MOXEMM_SMU_ALM8_11_C "OBD specific trouble code / OBD specific diagnostic trouble code for check DFC_MOXEMM_SMU_ALM8_11" VALUE 0x805048BE Val_Wu16 65535.00 DFES_OneToOne 0.00 65535.00 FORMAT "%8.2" /end CHARACTERISTIC
/begin CHARACTERISTIC DFES_DTCO.DFC_MOXEMM_SMU_ALM8_12_C "OBD specific trouble code / OBD specific diagnostic trouble code for check DFC_MOXEMM_SMU_ALM8_12" VALUE 0x805048C0 Val_Wu16 65535.00 DFES_OneToOne 0.00 65535.00 FORMAT "%8.2" /end CHARACTERISTIC
/begin CHARACTERISTIC DFES_DTCO.DFC_MOXEMM_SMU_ALM8_16_C "OBD specific trouble code / OBD specific diagnostic trouble code for check DFC_MOXEMM_SMU_ALM8_16" VALUE 0x805048C2 Val_Wu16 65535.00 DFES_OneToOne 0.00 65535.00 FORMAT "%8.2" /end CHARACTERISTIC
/begin CHARACTERISTIC DFES_DTCO.DFC_MOXEMM_SMU_ALM8_18_C "OBD specific trouble code / OBD specific diagnostic trouble code for check DFC_MOXEMM_SMU_ALM8_18" VALUE 0x805048C4 Val_Wu16 65535.00 DFES_OneToOne 0.00 65535.00 FORMAT "%8.2" /end CHARACTERISTIC
/begin CHARACTERISTIC DFES_DTCO.DFC_MOXEMM_SMU_ALM8_2_C "OBD specific trouble code / OBD specific diagnostic trouble code for check DFC_MOXEMM_SMU_ALM8_2" VALUE 0x805048C6 Val_Wu16 65535.00 DFES_OneToOne 0.00 65535.00 FORMAT "%8.2" /end CHARACTERISTIC
/begin CHARACTERISTIC DFES_DTCO.DFC_MOXEMM_SMU_ALM8_3_C "OBD specific trouble code / OBD specific diagnostic trouble code for check DFC_MOXEMM_SMU_ALM8_3" VALUE 0x805048C8 Val_Wu16 65535.00 DFES_OneToOne 0.00 65535.00 FORMAT "%8.2" /end CHARACTERISTIC
/begin CHARACTERISTIC DFES_DTCO.DFC_MOXEMM_SMU_ALM8_31_C "OBD specific trouble code / OBD specific diagnostic trouble code for check DFC_MOXEMM_SMU_ALM8_31" VALUE 0x805048CA Val_Wu16 65535.00 DFES_OneToOne 0.00 65535.00 FORMAT "%8.2" /end CHARACTERISTIC
/begin CHARACTERISTIC DFES_DTCO.DFC_MOXEMM_SMU_ALM8_4_C "OBD specific trouble code / OBD specific diagnostic trouble code for check DFC_MOXEMM_SMU_ALM8_4" VALUE 0x805048CC Val_Wu16 65535.00 DFES_OneToOne 0.00 65535.00 FORMAT "%8.2" /end CHARACTERISTIC
/begin CHARACTERISTIC DFES_DTCO.DFC_MOXEMM_SMU_ALM9_0_C "OBD specific trouble code / OBD specific diagnostic trouble code for check DFC_MOXEMM_SMU_ALM9_0" VALUE 0x805048CE Val_Wu16 65535.00 DFES_OneToOne 0.00 65535.00 FORMAT "%8.2" /end CHARACTERISTIC
/begin CHARACTERISTIC DFES_DTCO.DFC_MOXEMM_SMU_ALM9_15_C "OBD specific trouble code / OBD specific diagnostic trouble code for check DFC_MOXEMM_SMU_ALM9_15" VALUE 0x805048D0 Val_Wu16 65535.00 DFES_OneToOne 0.00 65535.00 FORMAT "%8.2" /end CHARACTERISTIC
/begin CHARACTERISTIC DFES_DTCO.DFC_MOXEMM_SMU_ALM9_3_C "OBD specific trouble code / OBD specific diagnostic trouble code for check DFC_MOXEMM_SMU_ALM9_3" VALUE 0x805048D2 Val_Wu16 65535.00 DFES_OneToOne 0.00 65535.00 FORMAT "%8.2" /end CHARACTERISTIC
/begin CHARACTERISTIC DFES_DTCO.DFC_MoCADCNTP_C "OBD specific trouble code / OBD specific diagnostic trouble code for check DFC_MoCADCNTP" VALUE 0x805048D4 Val_Wu16 65535.00 DFES_OneToOne 0.00 65535.00 FORMAT "%8.2" /end CHARACTERISTIC
/begin CHARACTERISTIC DFES_DTCO.DFC_MoCADCTst_C "OBD specific trouble code / OBD specific diagnostic trouble code for check DFC_MoCADCTst" VALUE 0x805048D6 Val_Wu16 65535.00 DFES_OneToOne 0.00 65535.00 FORMAT "%8.2" /end CHARACTERISTIC
/begin CHARACTERISTIC DFES_DTCO.DFC_MoCSOPICO_C "OBD specific trouble code / OBD specific diagnostic trouble code for check DFC_MoCSOPICO" VALUE 0x805048D8 Val_Wu16 65535.00 DFES_OneToOne 0.00 65535.00 FORMAT "%8.2" /end CHARACTERISTIC
/begin CHARACTERISTIC DFES_DTCO.DFC_MoFAPP_C "OBD specific trouble code / OBD specific diagnostic trouble code for check DFC_MoFAPP" VALUE 0x805048DA Val_Wu16 65535.00 DFES_OneToOne 0.00 65535.00 FORMAT "%8.2" /end CHARACTERISTIC
/begin CHARACTERISTIC DFES_DTCO.DFC_MoFAirFilgPrdc_C "OBD specific trouble code / OBD specific diagnostic trouble code for check DFC_MoFAirFilgPrdc" VALUE 0x805048DC Val_Wu16 65535.00 DFES_OneToOne 0.00 65535.00 FORMAT "%8.2" /end CHARACTERISTIC
/begin CHARACTERISTIC DFES_DTCO.DFC_MoFAirFlCtOffGdi_C "OBD specific trouble code / OBD specific diagnostic trouble code for check DFC_MoFAirFlCtOffGdi" VALUE 0x805048DE Val_Wu16 65535.00 DFES_OneToOne 0.00 65535.00 FORMAT "%8.2" /end CHARACTERISTIC
/begin CHARACTERISTIC DFES_DTCO.DFC_MoFAirFlCylGdi_C "OBD specific trouble code / OBD specific diagnostic trouble code for check DFC_MoFAirFlCylGdi" VALUE 0x805048E0 Val_Wu16 65535.00 DFES_OneToOne 0.00 65535.00 FORMAT "%8.2" /end CHARACTERISTIC
/begin CHARACTERISTIC DFES_DTCO.DFC_MoFAirFlFF_C "OBD specific trouble code / OBD specific diagnostic trouble code for check DFC_MoFAirFlFF" VALUE 0x805048E2 Val_Wu16 65535.00 DFES_OneToOne 0.00 65535.00 FORMAT "%8.2" /end CHARACTERISTIC
/begin CHARACTERISTIC DFES_DTCO.DFC_MoFAirFlIn_C "OBD specific trouble code / OBD specific diagnostic trouble code for check DFC_MoFAirFlIn" VALUE 0x805048E4 Val_Wu16 65535.00 DFES_OneToOne 0.00 65535.00 FORMAT "%8.2" /end CHARACTERISTIC
/begin CHARACTERISTIC DFES_DTCO.DFC_MoFAirFlMixCtlGdiChkAirFl_C "OBD specific trouble code / OBD specific diagnostic trouble code for check DFC_MoFAirFlMixCtlGdiChkAirFl" VALUE 0x805048E6 Val_Wu16 65535.00 DFES_OneToOne 0.00 65535.00 FORMAT "%8.2" /end CHARACTERISTIC
/begin CHARACTERISTIC DFES_DTCO.DFC_MoFAirFlMixCtlGdiChkCtrl_C "OBD specific trouble code / OBD specific diagnostic trouble code for check DFC_MoFAirFlMixCtlGdiChkCtrl" VALUE 0x805048E8 Val_Wu16 65535.00 DFES_OneToOne 0.00 65535.00 FORMAT "%8.2" /end CHARACTERISTIC
/begin CHARACTERISTIC DFES_DTCO.DFC_MoFAirFlMode_C "OBD specific trouble code / OBD specific diagnostic trouble code for check DFC_MoFAirFlMode" VALUE 0x805048EA Val_Wu16 65535.00 DFES_OneToOne 0.00 65535.00 FORMAT "%8.2" /end CHARACTERISTIC
/begin CHARACTERISTIC DFES_DTCO.DFC_MoFESpd_C "OBD specific trouble code / OBD specific diagnostic trouble code for check DFC_MoFESpd" VALUE 0x805048EC Val_Wu16 65535.00 DFES_OneToOne 0.00 65535.00 FORMAT "%8.2" /end CHARACTERISTIC
/begin CHARACTERISTIC DFES_DTCO.DFC_MoFIACo_C "OBD specific trouble code / OBD specific diagnostic trouble code for check DFC_MoFIACo" VALUE 0x805048EE Val_Wu16 65535.00 DFES_OneToOne 0.00 65535.00 FORMAT "%8.2" /end CHARACTERISTIC
/begin CHARACTERISTIC DFES_DTCO.DFC_MoFICOL1_C "OBD specific trouble code / OBD specific diagnostic trouble code for check DFC_MoFICOL1" VALUE 0x805048F0 Val_Wu16 65535.00 DFES_OneToOne 0.00 65535.00 FORMAT "%8.2" /end CHARACTERISTIC
/begin CHARACTERISTIC DFES_DTCO.DFC_MoFICOL2_C "OBD specific trouble code / OBD specific diagnostic trouble code for check DFC_MoFICOL2" VALUE 0x805048F2 Val_Wu16 65535.00 DFES_OneToOne 0.00 65535.00 FORMAT "%8.2" /end CHARACTERISTIC
/begin CHARACTERISTIC DFES_DTCO.DFC_MoFStrt_C "OBD specific trouble code / OBD specific diagnostic trouble code for check DFC_MoFStrt" VALUE 0x805048F4 Val_Wu16 65535.00 DFES_OneToOne 0.00 65535.00 FORMAT "%8.2" /end CHARACTERISTIC
/begin CHARACTERISTIC DFES_DTCO.DFC_MoFTrqCmp_C "OBD specific trouble code / OBD specific diagnostic trouble code for check DFC_MoFTrqCmp" VALUE 0x805048F6 Val_Wu16 65535.00 DFES_OneToOne 0.00 65535.00 FORMAT "%8.2" /end CHARACTERISTIC
/begin CHARACTERISTIC DFES_DTCO.DFC_MoFTrqCmpMax_C "OBD specific trouble code / OBD specific diagnostic trouble code for check DFC_MoFTrqCmpMax" VALUE 0x805048F8 Val_Wu16 65535.00 DFES_OneToOne 0.00 65535.00 FORMAT "%8.2" /end CHARACTERISTIC
/begin CHARACTERISTIC DFES_DTCO.DFC_MoFTrqCmpMin_C "OBD specific trouble code / OBD specific diagnostic trouble code for check DFC_MoFTrqCmpMin" VALUE 0x805048FA Val_Wu16 65535.00 DFES_OneToOne 0.00 65535.00 FORMAT "%8.2" /end CHARACTERISTIC
/begin CHARACTERISTIC DFES_DTCO.DFC_MoFVarPostBldSel_C "OBD specific trouble code / OBD specific diagnostic trouble code for check DFC_MoFVarPostBldSel" VALUE 0x805048FC Val_Wu16 65535.00 DFES_OneToOne 0.00 65535.00 FORMAT "%8.2" /end CHARACTERISTIC
/begin CHARACTERISTIC DFES_DTCO.DFC_MoXEMMHwLTMCUFW_C "OBD specific trouble code / OBD specific diagnostic trouble code for check DFC_MoXEMMHwLTMCUFW" VALUE 0x805048FE Val_Wu16 65535.00 DFES_OneToOne 0.00 65535.00 FORMAT "%8.2" /end CHARACTERISTIC
/begin CHARACTERISTIC DFES_DTCO.DFC_MoXEMMHwLTMonBIST_C "OBD specific trouble code / OBD specific diagnostic trouble code for check DFC_MoXEMMHwLTMonBIST" VALUE 0x80504900 Val_Wu16 65535.00 DFES_OneToOne 0.00 65535.00 FORMAT "%8.2" /end CHARACTERISTIC
/begin CHARACTERISTIC DFES_DTCO.DFC_MoXEMMHwLTRegMonTest_C "OBD specific trouble code / OBD specific diagnostic trouble code for check DFC_MoXEMMHwLTRegMonTest" VALUE 0x80504902 Val_Wu16 65535.00 DFES_OneToOne 0.00 65535.00 FORMAT "%8.2" /end CHARACTERISTIC
/begin CHARACTERISTIC DFES_DTCO.DFC_MoXEMMHwLTStbySMUAlvTest_C "OBD specific trouble code / OBD specific diagnostic trouble code for check DFC_MoXEMMHwLTStbySMUAlvTest" VALUE 0x80504904 Val_Wu16 65535.00 DFES_OneToOne 0.00 65535.00 FORMAT "%8.2" /end CHARACTERISTIC
/begin CHARACTERISTIC DFES_DTCO.DFC_MoXEMMHwLTTempSens_C "OBD specific trouble code / OBD specific diagnostic trouble code for check DFC_MoXEMMHwLTTempSens" VALUE 0x80504906 Val_Wu16 65535.00 DFES_OneToOne 0.00 65535.00 FORMAT "%8.2" /end CHARACTERISTIC
/begin CHARACTERISTIC DFES_DTCO.DFC_MoXEMMHwLTUCBCfg_C "OBD specific trouble code / OBD specific diagnostic trouble code for check DFC_MoXEMMHwLTUCBCfg" VALUE 0x80504908 Val_Wu16 65535.00 DFES_OneToOne 0.00 65535.00 FORMAT "%8.2" /end CHARACTERISTIC
/begin CHARACTERISTIC DFES_DTCO.DFC_NWSEmax_C "OBD specific trouble code / OBD specific diagnostic trouble code for check DFC_NWSEmax" VALUE 0x8050490A Val_Wu16 65535.00 DFES_OneToOne 0.00 65535.00 FORMAT "%8.2" /end CHARACTERISTIC
/begin CHARACTERISTIC DFES_DTCO.DFC_NWSmax_C "OBD specific trouble code / OBD specific diagnostic trouble code for check DFC_NWSmax" VALUE 0x8050490C Val_Wu16 65535.00 DFES_OneToOne 0.00 65535.00 FORMAT "%8.2" /end CHARACTERISTIC
/begin CHARACTERISTIC DFES_DTCO.DFC_OCWDAABEActv_C "OBD specific trouble code / OBD specific diagnostic trouble code for check DFC_OCWDAABEActv" VALUE 0x8050490E Val_Wu16 65535.00 DFES_OneToOne 0.00 65535.00 FORMAT "%8.2" /end CHARACTERISTIC
/begin CHARACTERISTIC DFES_DTCO.DFC_OCWDACom_C "OBD specific trouble code / OBD specific diagnostic trouble code for check DFC_OCWDACom" VALUE 0x80504910 Val_Wu16 65535.00 DFES_OneToOne 0.00 65535.00 FORMAT "%8.2" /end CHARACTERISTIC
/begin CHARACTERISTIC DFES_DTCO.DFC_OCWDAErrPin_C "OBD specific trouble code / OBD specific diagnostic trouble code for check DFC_OCWDAErrPin" VALUE 0x80504912 Val_Wu16 65535.00 DFES_OneToOne 0.00 65535.00 FORMAT "%8.2" /end CHARACTERISTIC
/begin CHARACTERISTIC DFES_DTCO.DFC_OCWDAOvrVltg_C "OBD specific trouble code / OBD specific diagnostic trouble code for check DFC_OCWDAOvrVltg" VALUE 0x80504914 Val_Wu16 65535.00 DFES_OneToOne 0.00 65535.00 FORMAT "%8.2" /end CHARACTERISTIC
/begin CHARACTERISTIC DFES_DTCO.DFC_ORAmax_C "OBD specific trouble code / OBD specific diagnostic trouble code for check DFC_ORAmax" VALUE 0x80504916 Val_Wu16 65535.00 DFES_OneToOne 0.00 65535.00 FORMAT "%8.2" /end CHARACTERISTIC
/begin CHARACTERISTIC DFES_DTCO.DFC_ORAmin_C "OBD specific trouble code / OBD specific diagnostic trouble code for check DFC_ORAmin" VALUE 0x80504918 Val_Wu16 65535.00 DFES_OneToOne 0.00 65535.00 FORMAT "%8.2" /end CHARACTERISTIC
/begin CHARACTERISTIC DFES_DTCO.DFC_OilPPlaus_C "OBD specific trouble code / OBD specific diagnostic trouble code for check DFC_OilPPlaus" VALUE 0x8050491A Val_Wu16 65535.00 DFES_OneToOne 0.00 65535.00 FORMAT "%8.2" /end CHARACTERISTIC
/begin CHARACTERISTIC DFES_DTCO.DFC_PLLSUmax_C "OBD specific trouble code / OBD specific diagnostic trouble code for check DFC_PLLSUmax" VALUE 0x8050491C Val_Wu16 65535.00 DFES_OneToOne 0.00 65535.00 FORMAT "%8.2" /end CHARACTERISTIC
/begin CHARACTERISTIC DFES_DTCO.DFC_PLLSUmin_C "OBD specific trouble code / OBD specific diagnostic trouble code for check DFC_PLLSUmin" VALUE 0x8050491E Val_Wu16 65535.00 DFES_OneToOne 0.00 65535.00 FORMAT "%8.2" /end CHARACTERISTIC
/begin CHARACTERISTIC DFES_DTCO.DFC_PSR1max_C "OBD specific trouble code / OBD specific diagnostic trouble code for check DFC_PSR1max" VALUE 0x80504920 Val_Wu16 65535.00 DFES_OneToOne 0.00 65535.00 FORMAT "%8.2" /end CHARACTERISTIC
/begin CHARACTERISTIC DFES_DTCO.DFC_PSRBmax_C "OBD specific trouble code / OBD specific diagnostic trouble code for check DFC_PSRBmax" VALUE 0x80504922 Val_Wu16 65535.00 DFES_OneToOne 0.00 65535.00 FORMAT "%8.2" /end CHARACTERISTIC
/begin CHARACTERISTIC DFES_DTCO.DFC_PSRBmin_C "OBD specific trouble code / OBD specific diagnostic trouble code for check DFC_PSRBmin" VALUE 0x80504924 Val_Wu16 65535.00 DFES_OneToOne 0.00 65535.00 FORMAT "%8.2" /end CHARACTERISTIC
/begin CHARACTERISTIC DFES_DTCO.DFC_PSRPmax_C "OBD specific trouble code / OBD specific diagnostic trouble code for check DFC_PSRPmax" VALUE 0x80504926 Val_Wu16 65535.00 DFES_OneToOne 0.00 65535.00 FORMAT "%8.2" /end CHARACTERISTIC
/begin CHARACTERISTIC DFES_DTCO.DFC_PSRPmin_C "OBD specific trouble code / OBD specific diagnostic trouble code for check DFC_PSRPmin" VALUE 0x80504928 Val_Wu16 65535.00 DFES_OneToOne 0.00 65535.00 FORMAT "%8.2" /end CHARACTERISTIC
/begin CHARACTERISTIC DFES_DTCO.DFC_PSRPsig_C "OBD specific trouble code / OBD specific diagnostic trouble code for check DFC_PSRPsig" VALUE 0x8050492A Val_Wu16 65535.00 DFES_OneToOne 0.00 65535.00 FORMAT "%8.2" /end CHARACTERISTIC
/begin CHARACTERISTIC DFES_DTCO.DFC_PSRmax_C "OBD specific trouble code / OBD specific diagnostic trouble code for check DFC_PSRmax" VALUE 0x8050492C Val_Wu16 65535.00 DFES_OneToOne 0.00 65535.00 FORMAT "%8.2" /end CHARACTERISTIC
/begin CHARACTERISTIC DFES_DTCO.DFC_PUmax_C "OBD specific trouble code / OBD specific diagnostic trouble code for check DFC_PUmax" VALUE 0x8050492E Val_Wu16 65535.00 DFES_OneToOne 0.00 65535.00 FORMAT "%8.2" /end CHARACTERISTIC
/begin CHARACTERISTIC DFES_DTCO.DFC_P_VSE11_OL_C "OBD specific trouble code / OBD specific diagnostic trouble code for check DFC_P_VSE11_OL" VALUE 0x80504930 Val_Wu16 65535.00 DFES_OneToOne 0.00 65535.00 FORMAT "%8.2" /end CHARACTERISTIC
/begin CHARACTERISTIC DFES_DTCO.DFC_P_VSE11_SCB_C "OBD specific trouble code / OBD specific diagnostic trouble code for check DFC_P_VSE11_SCB" VALUE 0x80504932 Val_Wu16 65535.00 DFES_OneToOne 0.00 65535.00 FORMAT "%8.2" /end CHARACTERISTIC
/begin CHARACTERISTIC DFES_DTCO.DFC_P_VSE11_SCG_C "OBD specific trouble code / OBD specific diagnostic trouble code for check DFC_P_VSE11_SCG" VALUE 0x80504934 Val_Wu16 65535.00 DFES_OneToOne 0.00 65535.00 FORMAT "%8.2" /end CHARACTERISTIC
/begin CHARACTERISTIC DFES_DTCO.DFC_PhyHighAPP1_C "OBD specific trouble code / OBD specific diagnostic trouble code for check DFC_PhyHighAPP1" VALUE 0x80504936 Val_Wu16 65535.00 DFES_OneToOne 0.00 65535.00 FORMAT "%8.2" /end CHARACTERISTIC
/begin CHARACTERISTIC DFES_DTCO.DFC_PhyHighAPP2_C "OBD specific trouble code / OBD specific diagnostic trouble code for check DFC_PhyHighAPP2" VALUE 0x80504938 Val_Wu16 65535.00 DFES_OneToOne 0.00 65535.00 FORMAT "%8.2" /end CHARACTERISTIC
/begin CHARACTERISTIC DFES_DTCO.DFC_PhyLowAPP1_C "OBD specific trouble code / OBD specific diagnostic trouble code for check DFC_PhyLowAPP1" VALUE 0x8050493A Val_Wu16 65535.00 DFES_OneToOne 0.00 65535.00 FORMAT "%8.2" /end CHARACTERISTIC
/begin CHARACTERISTIC DFES_DTCO.DFC_PhyLowAPP2_C "OBD specific trouble code / OBD specific diagnostic trouble code for check DFC_PhyLowAPP2" VALUE 0x8050493C Val_Wu16 65535.00 DFES_OneToOne 0.00 65535.00 FORMAT "%8.2" /end CHARACTERISTIC
/begin CHARACTERISTIC DFES_DTCO.DFC_SRCHighAPP1_C "OBD specific trouble code / OBD specific diagnostic trouble code for check DFC_SRCHighAPP1" VALUE 0x8050493E Val_Wu16 65535.00 DFES_OneToOne 0.00 65535.00 FORMAT "%8.2" /end CHARACTERISTIC
/begin CHARACTERISTIC DFES_DTCO.DFC_SRCHighAPP2_C "OBD specific trouble code / OBD specific diagnostic trouble code for check DFC_SRCHighAPP2" VALUE 0x80504940 Val_Wu16 65535.00 DFES_OneToOne 0.00 65535.00 FORMAT "%8.2" /end CHARACTERISTIC
/begin CHARACTERISTIC DFES_DTCO.DFC_SRCLowAPP1_C "OBD specific trouble code / OBD specific diagnostic trouble code for check DFC_SRCLowAPP1" VALUE 0x80504942 Val_Wu16 65535.00 DFES_OneToOne 0.00 65535.00 FORMAT "%8.2" /end CHARACTERISTIC
/begin CHARACTERISTIC DFES_DTCO.DFC_SRCLowAPP2_C "OBD specific trouble code / OBD specific diagnostic trouble code for check DFC_SRCLowAPP2" VALUE 0x80504944 Val_Wu16 65535.00 DFES_OneToOne 0.00 65535.00 FORMAT "%8.2" /end CHARACTERISTIC
/begin CHARACTERISTIC DFES_DTCO.DFC_SSpMon2_C "OBD specific trouble code / OBD specific diagnostic trouble code for check DFC_SSpMon2" VALUE 0x80504946 Val_Wu16 65535.00 DFES_OneToOne 0.00 65535.00 FORMAT "%8.2" /end CHARACTERISTIC
/begin CHARACTERISTIC DFES_DTCO.DFC_STHDRmax_C "OBD specific trouble code / OBD specific diagnostic trouble code for check DFC_STHDRmax" VALUE 0x80504948 Val_Wu16 65535.00 DFES_OneToOne 0.00 65535.00 FORMAT "%8.2" /end CHARACTERISTIC
/begin CHARACTERISTIC DFES_DTCO.DFC_SWReset_0_C "OBD specific trouble code / OBD specific diagnostic trouble code for check DFC_SWReset_0" VALUE 0x8050494A Val_Wu16 65535.00 DFES_OneToOne 0.00 65535.00 FORMAT "%8.2" /end CHARACTERISTIC
/begin CHARACTERISTIC DFES_DTCO.DFC_SWReset_1_C "OBD specific trouble code / OBD specific diagnostic trouble code for check DFC_SWReset_1" VALUE 0x8050494C Val_Wu16 65535.00 DFES_OneToOne 0.00 65535.00 FORMAT "%8.2" /end CHARACTERISTIC
/begin CHARACTERISTIC DFES_DTCO.DFC_SWReset_2_C "OBD specific trouble code / OBD specific diagnostic trouble code for check DFC_SWReset_2" VALUE 0x8050494E Val_Wu16 65535.00 DFES_OneToOne 0.00 65535.00 FORMAT "%8.2" /end CHARACTERISTIC
/begin CHARACTERISTIC DFES_DTCO.DFC_SyncAPP_C "OBD specific trouble code / OBD specific diagnostic trouble code for check DFC_SyncAPP" VALUE 0x80504950 Val_Wu16 65535.00 DFES_OneToOne 0.00 65535.00 FORMAT "%8.2" /end CHARACTERISTIC
/begin CHARACTERISTIC DFES_DTCO.DFC_TANKLnpl_C "OBD specific trouble code / OBD specific diagnostic trouble code for check DFC_TANKLnpl" VALUE 0x80504952 Val_Wu16 65535.00 DFES_OneToOne 0.00 65535.00 FORMAT "%8.2" /end CHARACTERISTIC
/begin CHARACTERISTIC DFES_DTCO.DFC_TAmax_Dummy_C "OBD specific trouble code / OBD specific diagnostic trouble code for check DFC_TAmax_Dummy" VALUE 0x80504954 Val_Wu16 65535.00 DFES_OneToOne 0.00 65535.00 FORMAT "%8.2" /end CHARACTERISTIC
/begin CHARACTERISTIC DFES_DTCO.DFC_TESFmax_C "OBD specific trouble code / OBD specific diagnostic trouble code for check DFC_TESFmax" VALUE 0x80504956 Val_Wu16 65535.00 DFES_OneToOne 0.00 65535.00 FORMAT "%8.2" /end CHARACTERISTIC
/begin CHARACTERISTIC DFES_DTCO.DFC_TESGmax_C "OBD specific trouble code / OBD specific diagnostic trouble code for check DFC_TESGmax" VALUE 0x80504958 Val_Wu16 65535.00 DFES_OneToOne 0.00 65535.00 FORMAT "%8.2" /end CHARACTERISTIC
/begin CHARACTERISTIC DFES_DTCO.DFC_TKAEmax_C "OBD specific trouble code / OBD specific diagnostic trouble code for check DFC_TKAEmax" VALUE 0x8050495A Val_Wu16 65535.00 DFES_OneToOne 0.00 65535.00 FORMAT "%8.2" /end CHARACTERISTIC
/begin CHARACTERISTIC DFES_DTCO.DFC_TKAEmin_C "OBD specific trouble code / OBD specific diagnostic trouble code for check DFC_TKAEmin" VALUE 0x8050495C Val_Wu16 65535.00 DFES_OneToOne 0.00 65535.00 FORMAT "%8.2" /end CHARACTERISTIC
/begin CHARACTERISTIC DFES_DTCO.DFC_TKARmax_C "OBD specific trouble code / OBD specific diagnostic trouble code for check DFC_TKARmax" VALUE 0x8050495E Val_Wu16 65535.00 DFES_OneToOne 0.00 65535.00 FORMAT "%8.2" /end CHARACTERISTIC
/begin CHARACTERISTIC DFES_DTCO.DFC_TKARnpl_C "OBD specific trouble code / OBD specific diagnostic trouble code for check DFC_TKARnpl" VALUE 0x80504960 Val_Wu16 65535.00 DFES_OneToOne 0.00 65535.00 FORMAT "%8.2" /end CHARACTERISTIC
/begin CHARACTERISTIC DFES_DTCO.DFC_TMmax_Dummy_C "OBD specific trouble code / OBD specific diagnostic trouble code for check DFC_TMmax_Dummy" VALUE 0x80504962 Val_Wu16 65535.00 DFES_OneToOne 0.00 65535.00 FORMAT "%8.2" /end CHARACTERISTIC
/begin CHARACTERISTIC DFES_DTCO.DFC_TUMmax_Dummy_C "OBD specific trouble code / OBD specific diagnostic trouble code for check DFC_TUMmax_Dummy" VALUE 0x80504964 Val_Wu16 65535.00 DFES_OneToOne 0.00 65535.00 FORMAT "%8.2" /end CHARACTERISTIC
/begin CHARACTERISTIC DFES_DTCO.DFC_TWCDPriCatB1_C "OBD specific trouble code / OBD specific diagnostic trouble code for check DFC_TWCDPriCatB1" VALUE 0x80504966 Val_Wu16 65535.00 DFES_OneToOne 0.00 65535.00 FORMAT "%8.2" /end CHARACTERISTIC
/begin CHARACTERISTIC DFES_DTCO.DFC_ThrVlvClsdPosnFirstOffsLrnImpoB1_C "OBD specific trouble code / OBD specific diagnostic trouble code for check DFC_ThrVlvClsdPosnFirstOffsLrnImpoB1" VALUE 0x80504968 Val_Wu16 65535.00 DFES_OneToOne 0.00 65535.00 FORMAT "%8.2" /end CHARACTERISTIC
/begin CHARACTERISTIC DFES_DTCO.DFC_ThrVlvClsdPosnOffsLrnImpoB1_C "OBD specific trouble code / OBD specific diagnostic trouble code for check DFC_ThrVlvClsdPosnOffsLrnImpoB1" VALUE 0x8050496A Val_Wu16 65535.00 DFES_OneToOne 0.00 65535.00 FORMAT "%8.2" /end CHARACTERISTIC
/begin CHARACTERISTIC DFES_DTCO.DFC_ThrVlvClsdPosnOffsLrnMaxB1_C "OBD specific trouble code / OBD specific diagnostic trouble code for check DFC_ThrVlvClsdPosnOffsLrnMaxB1" VALUE 0x8050496C Val_Wu16 65535.00 DFES_OneToOne 0.00 65535.00 FORMAT "%8.2" /end CHARACTERISTIC
/begin CHARACTERISTIC DFES_DTCO.DFC_ThrVlvClsdPosnOffsLrnMinB1_C "OBD specific trouble code / OBD specific diagnostic trouble code for check DFC_ThrVlvClsdPosnOffsLrnMinB1" VALUE 0x8050496E Val_Wu16 65535.00 DFES_OneToOne 0.00 65535.00 FORMAT "%8.2" /end CHARACTERISTIC
/begin CHARACTERISTIC DFES_DTCO.DFC_ThrVlvCtrlDeB1_C "OBD specific trouble code / OBD specific diagnostic trouble code for check DFC_ThrVlvCtrlDeB1" VALUE 0x80504970 Val_Wu16 65535.00 DFES_OneToOne 0.00 65535.00 FORMAT "%8.2" /end CHARACTERISTIC
/begin CHARACTERISTIC DFES_DTCO.DFC_ThrVlvDycB1_C "OBD specific trouble code / OBD specific diagnostic trouble code for check DFC_ThrVlvDycB1" VALUE 0x80504972 Val_Wu16 65535.00 DFES_OneToOne 0.00 65535.00 FORMAT "%8.2" /end CHARACTERISTIC
/begin CHARACTERISTIC DFES_DTCO.DFC_ThrVlvLimpAirPosnMaxAbsltDriftB1_C "OBD specific trouble code / OBD specific diagnostic trouble code for check DFC_ThrVlvLimpAirPosnMaxAbsltDriftB1" VALUE 0x80504974 Val_Wu16 65535.00 DFES_OneToOne 0.00 65535.00 FORMAT "%8.2" /end CHARACTERISTIC
/begin CHARACTERISTIC DFES_DTCO.DFC_ThrVlvLimpAirPosnMaxB1_C "OBD specific trouble code / OBD specific diagnostic trouble code for check DFC_ThrVlvLimpAirPosnMaxB1" VALUE 0x80504976 Val_Wu16 65535.00 DFES_OneToOne 0.00 65535.00 FORMAT "%8.2" /end CHARACTERISTIC
/begin CHARACTERISTIC DFES_DTCO.DFC_ThrVlvLimpAirPosnMaxRelDriftB1_C "OBD specific trouble code / OBD specific diagnostic trouble code for check DFC_ThrVlvLimpAirPosnMaxRelDriftB1" VALUE 0x80504978 Val_Wu16 65535.00 DFES_OneToOne 0.00 65535.00 FORMAT "%8.2" /end CHARACTERISTIC
/begin CHARACTERISTIC DFES_DTCO.DFC_ThrVlvLimpAirPosnMinB1_C "OBD specific trouble code / OBD specific diagnostic trouble code for check DFC_ThrVlvLimpAirPosnMinB1" VALUE 0x8050497A Val_Wu16 65535.00 DFES_OneToOne 0.00 65535.00 FORMAT "%8.2" /end CHARACTERISTIC
/begin CHARACTERISTIC DFES_DTCO.DFC_ThrVlvOpenLoadB1_C "OBD specific trouble code / OBD specific diagnostic trouble code for check DFC_ThrVlvOpenLoadB1" VALUE 0x8050497C Val_Wu16 65535.00 DFES_OneToOne 0.00 65535.00 FORMAT "%8.2" /end CHARACTERISTIC
/begin CHARACTERISTIC DFES_DTCO.DFC_ThrVlvOpenSprgB1_C "OBD specific trouble code / OBD specific diagnostic trouble code for check DFC_ThrVlvOpenSprgB1" VALUE 0x8050497E Val_Wu16 65535.00 DFES_OneToOne 0.00 65535.00 FORMAT "%8.2" /end CHARACTERISTIC
/begin CHARACTERISTIC DFES_DTCO.DFC_ThrVlvOpenSprgSprdB1_C "OBD specific trouble code / OBD specific diagnostic trouble code for check DFC_ThrVlvOpenSprgSprdB1" VALUE 0x80504980 Val_Wu16 65535.00 DFES_OneToOne 0.00 65535.00 FORMAT "%8.2" /end CHARACTERISTIC
/begin CHARACTERISTIC DFES_DTCO.DFC_ThrVlvOpenSprgTwnB1_C "OBD specific trouble code / OBD specific diagnostic trouble code for check DFC_ThrVlvOpenSprgTwnB1" VALUE 0x80504982 Val_Wu16 65535.00 DFES_OneToOne 0.00 65535.00 FORMAT "%8.2" /end CHARACTERISTIC
/begin CHARACTERISTIC DFES_DTCO.DFC_ThrVlvOverTB1_C "OBD specific trouble code / OBD specific diagnostic trouble code for check DFC_ThrVlvOverTB1" VALUE 0x80504984 Val_Wu16 65535.00 DFES_OneToOne 0.00 65535.00 FORMAT "%8.2" /end CHARACTERISTIC
/begin CHARACTERISTIC DFES_DTCO.DFC_ThrVlvRetSprgB1_C "OBD specific trouble code / OBD specific diagnostic trouble code for check DFC_ThrVlvRetSprgB1" VALUE 0x80504986 Val_Wu16 65535.00 DFES_OneToOne 0.00 65535.00 FORMAT "%8.2" /end CHARACTERISTIC
/begin CHARACTERISTIC DFES_DTCO.DFC_ThrVlvRetSprgSprdB1_C "OBD specific trouble code / OBD specific diagnostic trouble code for check DFC_ThrVlvRetSprgSprdB1" VALUE 0x80504988 Val_Wu16 65535.00 DFES_OneToOne 0.00 65535.00 FORMAT "%8.2" /end CHARACTERISTIC
/begin CHARACTERISTIC DFES_DTCO.DFC_ThrVlvRetSprgTwnB1_C "OBD specific trouble code / OBD specific diagnostic trouble code for check DFC_ThrVlvRetSprgTwnB1" VALUE 0x8050498A Val_Wu16 65535.00 DFES_OneToOne 0.00 65535.00 FORMAT "%8.2" /end CHARACTERISTIC
/begin CHARACTERISTIC DFES_DTCO.DFC_ThrVlvSens1MaxB1_C "OBD specific trouble code / OBD specific diagnostic trouble code for check DFC_ThrVlvSens1MaxB1" VALUE 0x8050498C Val_Wu16 65535.00 DFES_OneToOne 0.00 65535.00 FORMAT "%8.2" /end CHARACTERISTIC
/begin CHARACTERISTIC DFES_DTCO.DFC_ThrVlvSens1NplB1_C "OBD specific trouble code / OBD specific diagnostic trouble code for check DFC_ThrVlvSens1NplB1" VALUE 0x8050498E Val_Wu16 65535.00 DFES_OneToOne 0.00 65535.00 FORMAT "%8.2" /end CHARACTERISTIC
/begin CHARACTERISTIC DFES_DTCO.DFC_ThrVlvSens2MaxB1_C "OBD specific trouble code / OBD specific diagnostic trouble code for check DFC_ThrVlvSens2MaxB1" VALUE 0x80504990 Val_Wu16 65535.00 DFES_OneToOne 0.00 65535.00 FORMAT "%8.2" /end CHARACTERISTIC
/begin CHARACTERISTIC DFES_DTCO.DFC_ThrVlvSens2MinB1_C "OBD specific trouble code / OBD specific diagnostic trouble code for check DFC_ThrVlvSens2MinB1" VALUE 0x80504992 Val_Wu16 65535.00 DFES_OneToOne 0.00 65535.00 FORMAT "%8.2" /end CHARACTERISTIC
/begin CHARACTERISTIC DFES_DTCO.DFC_ThrVlvSens2NplB1_C "OBD specific trouble code / OBD specific diagnostic trouble code for check DFC_ThrVlvSens2NplB1" VALUE 0x80504994 Val_Wu16 65535.00 DFES_OneToOne 0.00 65535.00 FORMAT "%8.2" /end CHARACTERISTIC
/begin CHARACTERISTIC DFES_DTCO.DFC_ThrVlvShoCircB1_C "OBD specific trouble code / OBD specific diagnostic trouble code for check DFC_ThrVlvShoCircB1" VALUE 0x80504996 Val_Wu16 65535.00 DFES_OneToOne 0.00 65535.00 FORMAT "%8.2" /end CHARACTERISTIC
/begin CHARACTERISTIC DFES_DTCO.DFC_ThrVlvSpiErrB1_C "OBD specific trouble code / OBD specific diagnostic trouble code for check DFC_ThrVlvSpiErrB1" VALUE 0x80504998 Val_Wu16 65535.00 DFES_OneToOne 0.00 65535.00 FORMAT "%8.2" /end CHARACTERISTIC
/begin CHARACTERISTIC DFES_DTCO.DFC_ThrvlvSens1MinB1_C "OBD specific trouble code / OBD specific diagnostic trouble code for check DFC_ThrvlvSens1MinB1" VALUE 0x8050499A Val_Wu16 65535.00 DFES_OneToOne 0.00 65535.00 FORMAT "%8.2" /end CHARACTERISTIC
/begin CHARACTERISTIC DFES_DTCO.DFC_TiOffTBasdChkFast_C "OBD specific trouble code / OBD specific diagnostic trouble code for check DFC_TiOffTBasdChkFast" VALUE 0x8050499C Val_Wu16 65535.00 DFES_OneToOne 0.00 65535.00 FORMAT "%8.2" /end CHARACTERISTIC
/begin CHARACTERISTIC DFES_DTCO.DFC_TiOffTBasdChkSlow_C "OBD specific trouble code / OBD specific diagnostic trouble code for check DFC_TiOffTBasdChkSlow" VALUE 0x8050499E Val_Wu16 65535.00 DFES_OneToOne 0.00 65535.00 FORMAT "%8.2" /end CHARACTERISTIC
/begin CHARACTERISTIC DFES_DTCO.DFC_UEGOSnsrMntdS1B1_C "OBD specific trouble code / OBD specific diagnostic trouble code for check DFC_UEGOSnsrMntdS1B1" VALUE 0x805049A0 Val_Wu16 65535.00 DFES_OneToOne 0.00 65535.00 FORMAT "%8.2" /end CHARACTERISTIC
/begin CHARACTERISTIC DFES_DTCO.DFC_VehVSig_C "OBD specific trouble code / OBD specific diagnostic trouble code for check DFC_VehVSig" VALUE 0x805049A2 Val_Wu16 65535.00 DFES_OneToOne 0.00 65535.00 FORMAT "%8.2" /end CHARACTERISTIC
/begin CHARACTERISTIC DFES_DTCO.DFC_VlvLftFbSwtIntk11SpclFail_C "OBD specific trouble code / OBD specific diagnostic trouble code for check DFC_VlvLftFbSwtIntk11SpclFail" VALUE 0x805049A4 Val_Wu16 65535.00 DFES_OneToOne 0.00 65535.00 FORMAT "%8.2" /end CHARACTERISTIC
/begin CHARACTERISTIC DFES_DTCO.DFC_VlvLftFbSwtIntk11StdFail_C "OBD specific trouble code / OBD specific diagnostic trouble code for check DFC_VlvLftFbSwtIntk11StdFail" VALUE 0x805049A6 Val_Wu16 65535.00 DFES_OneToOne 0.00 65535.00 FORMAT "%8.2" /end CHARACTERISTIC
/begin FUNCTION DFES "30000.73.0_2.0.0Diagnostic Fault Event Storage"
 /begin DEF_CHARACTERISTIC DFES_DTCO.DFC_LinHdrTimeoutErrDCDC_C DFES_DTCO.DFC_LinHdrTimeoutErrEBS_C DFES_DTCO.DFC_LinMsgTimeoutErrACG_C DFES_DTCO.DFC_LinMsgTimeoutErrAEV_C DFES_DTCO.DFC_LinMsgTimeoutErrDCDC_C DFES_DTCO.DFC_LinMsgTimeoutErrEBS_C DFES_DTCO.DFC_LinNoStrtComErr_C DFES_DTCO.DFC_LowPresOilP_C DFES_DTCO.DFC_MisfDetVWhlFrntLeOORHi_C DFES_DTCO.DFC_MisfDetVWhlFrntLeRatyHi_C DFES_DTCO.DFC_MisfDetVWhlFrntLeRatyLo_C DFES_DTCO.DFC_MisfDetVWhlFrntLeStuck_C DFES_DTCO.DFC_MisfDetVWhlFrntRiOORHi_C DFES_DTCO.DFC_MisfDetVWhlFrntRiRatyHi_C DFES_DTCO.DFC_MisfDetVWhlFrntRiRatyLo_C DFES_DTCO.DFC_MisfDetVWhlFrntRiStuck_C DFES_DTCO.DFC_MisfDetVWhlReLeOORHi_C DFES_DTCO.DFC_MisfDetVWhlReLeRatyHi_C DFES_DTCO.DFC_MisfDetVWhlReLeRatyLo_C DFES_DTCO.DFC_MisfDetVWhlReLeStuck_C DFES_DTCO.DFC_MisfDetVWhlReRiOORHi_C DFES_DTCO.DFC_MisfDetVWhlReRiRatyHi_C DFES_DTCO.DFC_MisfDetVWhlReRiRatyLo_C DFES_DTCO.DFC_MisfDetVWhlReRiStuck_C DFES_DTCO.DFC_MisfDetdVWhlFrntLePlaus_C DFES_DTCO.DFC_MisfDetdVWhlFrntRiPlaus_C DFES_DTCO.DFC_MisfDetdVWhlReLePlaus_C DFES_DTCO.DFC_MisfDetdVWhlReRiPlaus_C DFES_DTCO.DFC_PEnvSigRngMax_C DFES_DTCO.DFC_PEnvSigRngMin_C DFES_DTCO.DFC_StmFault_C DFES_DTCO.DFC_StrtCtOffPth_C DFES_DTCO.DFC_StrtCtlErr_C DFES_DTCO.DFC_StrtFault_C DFES_DTCO.DFC_StrtLckJudg1_C DFES_DTCO.DFC_StrtLckJudg2_C DFES_DTCO.DFC_StrtOL_C DFES_DTCO.DFC_StrtOL2_C DFES_DTCO.DFC_StrtSCB_C DFES_DTCO.DFC_StrtSCB2_C DFES_DTCO.DFC_StrtSCG_C DFES_DTCO.DFC_StrtSCG2_C DFES_DTCO.DFC_StrtStkRly1_C DFES_DTCO.DFC_StrtStkRly2_C DFES_DTCO.DFC_TEVEmax_C DFES_DTCO.DFC_TEVEmin_C DFES_DTCO.DFC_TEVEsig_C DFES_DTCO.DFC_UegoHeatrPrfmncLoS1B1_C DFES_DTCO.DFC_VehVAllPlaus_C DFES_DTCO.DFC_VehVNCSnsrElecFailr_C DFES_DTCO.DFC_VehVPlausCan_C DFES_DTCO.DFC_VehVPlausFco_C DFES_DTCO.DFC_VehVPlausPwr_C DFES_DTCO.DFC_VehVPlausV2N_C DFES_DTCO.DFC_VehVSpdSnsrAElecFailr_C DFES_DTCO.DFC_VehVSpdSnsrBElecFailr_C DFES_DTCO.DFC_ClthMax_C DFES_DTCO.DFC_IgnClPs_DevComErr_C DFES_DTCO.DFC_IgnClPs_LineOl_0_C DFES_DTCO.DFC_IgnClPs_LineOl_1_C DFES_DTCO.DFC_IgnClPs_LineOl_2_C DFES_DTCO.DFC_IgnClPs_LineOl_3_C DFES_DTCO.DFC_IgnClPs_LineScb_0_C DFES_DTCO.DFC_IgnClPs_LineScb_1_C DFES_DTCO.DFC_IgnClPs_LineScb_2_C DFES_DTCO.DFC_IgnClPs_LineScb_3_C DFES_DTCO.DFC_IgnClPs_LineScg_0_C DFES_DTCO.DFC_IgnClPs_LineScg_1_C DFES_DTCO.DFC_IgnClPs_LineScg_2_C DFES_DTCO.DFC_IgnClPs_LineScg_3_C DFES_DTCO.DFC_KRVEKOEVAB_C DFES_DTCO.DFC_KRVEKOEVAB0_C DFES_DTCO.DFC_KRVEKOEVAB1_C DFES_DTCO.DFC_KRVEKOEVAB2_C DFES_DTCO.DFC_KRVEKOEVAB3_C DFES_DTCO.DFC_UegoSigEcuAsicS1B1_C DFES_DTCO.DFC_UegoSigEcuComS1B1_C DFES_DTCO.DFC_UegoSigSnsrS1B1_C DFES_DTCO.DFC_UegoSigWireOlApesS1B1_C DFES_DTCO.DFC_UegoSigWireOlIpeS1B1_C DFES_DTCO.DFC_UegoSigWireOlReS1B1_C DFES_DTCO.DFC_UegoSigWireRCmpS1B1_C DFES_DTCO.DFC_UegoSigWireScbS1B1_C DFES_DTCO.DFC_UegoSigWireScgS1B1_C DFES_DTCO.DFC_AfsPhyRngHiB1_C DFES_DTCO.DFC_AfsPhyRngLoB1_C DFES_DTCO.DFC_AirCCmprOL_C DFES_DTCO.DFC_AirCCmprOvrTemp_C DFES_DTCO.DFC_AirCCmprSCB_C DFES_DTCO.DFC_AirCCmprSCG_C DFES_DTCO.DFC_AltErr_C DFES_DTCO.DFC_BattUSRCMax_C DFES_DTCO.DFC_BattUSRCMin_C DFES_DTCO.DFC_ComChksTCU1_C DFES_DTCO.DFC_ComChksTCU11_C DFES_DTCO.DFC_ComChksTCU12_C DFES_DTCO.DFC_ComChksTCU13_C DFES_DTCO.DFC_ComChksTCU2_C DFES_DTCO.DFC_ComChksTCU3_C DFES_DTCO.DFC_ComChksTCU4_C DFES_DTCO.DFC_ComCntTCU1_C DFES_DTCO.DFC_ComCntTCU11_C DFES_DTCO.DFC_ComCntTCU12_C DFES_DTCO.DFC_ComCntTCU13_C DFES_DTCO.DFC_ComCntTCU2_C DFES_DTCO.DFC_ComCntTCU3_C DFES_DTCO.DFC_ComCntTCU4_C DFES_DTCO.DFC_ComTOutTCU01_C DFES_DTCO.DFC_ComTOutTCU02_C DFES_DTCO.DFC_ComTOutTCU1_C DFES_DTCO.DFC_ComTOutTCU11_C DFES_DTCO.DFC_ComTOutTCU12_C DFES_DTCO.DFC_ComTOutTCU13_C DFES_DTCO.DFC_ComTOutTCU14_C DFES_DTCO.DFC_ComTOutTCU2_C DFES_DTCO.DFC_ComTOutTCU3_C DFES_DTCO.DFC_ComTOutTCU4_C DFES_DTCO.DFC_DevLibBattUHi_C DFES_DTCO.DFC_DevLibBattULo_C DFES_DTCO.DFC_EGRVlvFailSafeActv_C DFES_DTCO.DFC_EGRVlvGovDvtCld_C DFES_DTCO.DFC_EGRVlvPhysSRCMax_C DFES_DTCO.DFC_EGRVlvPhysSRCMin_C DFES_DTCO.DFC_FanDIOOL_0_C DFES_DTCO.DFC_FanDIOOL_1_C DFES_DTCO.DFC_FanDIOOvrTemp_0_C DFES_DTCO.DFC_FanDIOOvrTemp_1_C DFES_DTCO.DFC_FanDIOSCB_0_C DFES_DTCO.DFC_FanDIOSCB_1_C DFES_DTCO.DFC_FanDIOSCG_0_C DFES_DTCO.DFC_FanDIOSCG_1_C DFES_DTCO.DFC_MRlyDcOL_C DFES_DTCO.DFC_MRlyDcSCB_C DFES_DTCO.DFC_MRlyDcSCG_C DFES_DTCO.DFC_PSPOL_C DFES_DTCO.DFC_PSPOvrTemp_C DFES_DTCO.DFC_PSPSCB_C DFES_DTCO.DFC_PSPSCG_C DFES_DTCO.DFC_T50Err_C DFES_DTCO.DFC_ThrVlvLoBattB1_C DFES_DTCO.DFC_UegoSigOperPlausS1B1_C DFES_DTCO.DFC_VehVPhysRngHi_C DFES_DTCO.DFC_VehVSclOutOL_C DFES_DTCO.DFC_VehVSclOutOT_C DFES_DTCO.DFC_VehVSclOutSCB_C DFES_DTCO.DFC_VehVSclOutSCG_C DFES_DTCO.DFC_VehVSigFL_C DFES_DTCO.DFC_VehVSigFR_C DFES_DTCO.DFC_VehVSigRL_C DFES_DTCO.DFC_VehVSigRR_C DFES_DTCO.DFC_VehVSnsrARngHi_C DFES_DTCO.DFC_VehVSnsrBRngHi_C DFES_DTCO.DFC_VehVSpdRtyDiag_C DFES_DTCO.DFC_DHFHD_C DFES_DTCO.DFC_InjVlv_DI_DcDc_C DFES_DTCO.DFC_InjVlv_DI_NoLd_0_C DFES_DTCO.DFC_InjVlv_DI_NoLd_1_C DFES_DTCO.DFC_InjVlv_DI_NoLd_2_C DFES_DTCO.DFC_InjVlv_DI_NoLd_3_C DFES_DTCO.DFC_InjVlv_DI_ScBnk_0_C DFES_DTCO.DFC_InjVlv_DI_ScBnk_1_C DFES_DTCO.DFC_InjVlv_DI_ScBnk_2_C DFES_DTCO.DFC_InjVlv_DI_ScBnk_3_C DFES_DTCO.DFC_InjVlv_DI_ScCyl_0_C DFES_DTCO.DFC_InjVlv_DI_ScCyl_1_C DFES_DTCO.DFC_InjVlv_DI_ScCyl_2_C DFES_DTCO.DFC_InjVlv_DI_ScCyl_3_C DFES_DTCO.DFC_InjVlv_DI_ScHsLs_0_C DFES_DTCO.DFC_InjVlv_DI_ScHsLs_1_C DFES_DTCO.DFC_InjVlv_DI_ScHsLs_2_C DFES_DTCO.DFC_InjVlv_DI_ScHsLs_3_C DFES_DTCO.DFC_MfPsDiaOpenLoad1_C DFES_DTCO.DFC_MfPsDiaScHiS1_C DFES_DTCO.DFC_MfPsDiaScHiSLowS1_C DFES_DTCO.DFC_MfPsDiaScLowS1_C DFES_DTCO.DFC_ACEvpTPhysRngHi_C DFES_DTCO.DFC_ACEvpTPhysRngLo_C DFES_DTCO.DFC_ACEvpTSRCMax_C DFES_DTCO.DFC_ACEvpTSRCMin_C DFES_DTCO.DFC_AfsRawSigRngHiB1_C DFES_DTCO.DFC_AfsRawSigRngLoB1_C DFES_DTCO.DFC_AfsSnsrErrB1_C DFES_DTCO.DFC_AirCClntPAnaSRCMax_C DFES_DTCO.DFC_AirCClntPAnaSRCMin_C DFES_DTCO.DFC_AirCSwtNpl_C DFES_DTCO.DFC_AirCSwtSig_C DFES_DTCO.DFC_Brk_C DFES_DTCO.DFC_BrkBstSensSCB_C DFES_DTCO.DFC_BrkBstSensSCG_C DFES_DTCO.DFC_BrkSig_C DFES_DTCO.DFC_ClthSig_C DFES_DTCO.DFC_EGRVlvCurrLim_C DFES_DTCO.DFC_EGRVlvOL_C DFES_DTCO.DFC_EGRVlvOvrTemp_C DFES_DTCO.DFC_EGRVlvSCB_C DFES_DTCO.DFC_EGRVlvSCG_C DFES_DTCO.DFC_EGRVlvSRCMax_C DFES_DTCO.DFC_EGRVlvSRCMin_C DFES_DTCO.DFC_HLSDemOvhtEngLim_C DFES_DTCO.DFC_OilPSwmpSRCMax_C DFES_DTCO.DFC_OilPSwmpSRCMin_C DFES_DTCO.DFC_PIntkVUsLineHiB1_C DFES_DTCO.DFC_PIntkVUsLineLoB1_C DFES_DTCO.DFC_VehVPhysRngLo_C DFES_DTCO.DFC_VehVSigCan_C DFES_DTCO.DFC_VehVSigCanSafe_C DFES_DTCO.DFC_VlvLftFbOilPSnsrIntk11SRCMax_C DFES_DTCO.DFC_VlvLftFbOilPSnsrIntk11SRCMin_C DFES_DTCO.DFC_ClthNpl_C DFES_DTCO.DFC_GbxPNPosnDrvCdn_C DFES_DTCO.DFC_GbxPNPosnPlausy_C DFES_DTCO.DFC_AfsSigErrLineHiB1_C DFES_DTCO.DFC_AfsSigErrLineLoB1_C DFES_DTCO.DFC_PEnvCcMax_C DFES_DTCO.DFC_PEnvCcMin_C DFES_DTCO.DFC_PEnvRngChkMax_C DFES_DTCO.DFC_PEnvRngChkMin_C DFES_DTCO.DFC_PEnvSnsrPlaus_C DFES_DTCO.DFC_UEGOHeatrRlyPsOLS1B1_C DFES_DTCO.DFC_UEGOHeatrRlyPsSCBS1B1_C DFES_DTCO.DFC_UEGOHeatrRlyPsSCGS1B1_C DFES_DTCO.DFC_UegoHeatrWireOlS1B1_C DFES_DTCO.DFC_UegoHeatrWireScbS1B1_C DFES_DTCO.DFC_UegoHeatrWireScgS1B1_C DFES_DTCO.DFC_KnDetSens1PortAMax_C DFES_DTCO.DFC_KnDetSens1PortAMin_C DFES_DTCO.DFC_KnDetSens1PortBMax_C DFES_DTCO.DFC_KnDetSens1PortBMin_C DFES_DTCO.DFC_Clth2ONStuck_C DFES_DTCO.DFC_Clth2ONStuckLdc_C DFES_DTCO.DFC_Clth3ONStuckLdc_C DFES_DTCO.DFC_Clth3ONStuckPostDrv_C DFES_DTCO.DFC_Clth4ONStuck_C DFES_DTCO.DFC_Clth4ONStuckLdc_C DFES_DTCO.DFC_ComBCMUnit_C DFES_DTCO.DFC_ComDLCTCU01_C DFES_DTCO.DFC_ComDLCTCU02_C DFES_DTCO.DFC_ComDLCTCU1_C DFES_DTCO.DFC_ComDLCTCU11_C DFES_DTCO.DFC_ComDLCTCU12_C DFES_DTCO.DFC_ComDLCTCU13_C DFES_DTCO.DFC_ComDLCTCU14_C DFES_DTCO.DFC_ComDLCTCU2_C DFES_DTCO.DFC_ComDLCTCU3_C DFES_DTCO.DFC_ComDLCTCU4_C DFES_DTCO.DFC_ComEPSUnit_C DFES_DTCO.DFC_ComIDASBUnit_C DFES_DTCO.DFC_ComIMGUnit_C DFES_DTCO.DFC_ComMETUnit_C DFES_DTCO.DFC_ComSRSUnit_C DFES_DTCO.DFC_ComVSAUnit_C DFES_DTCO.DFC_EbsSocFlt_C DFES_DTCO.DFC_I14229VINErr_C DFES_DTCO.DFC_InjCatHeatgErr_C DFES_DTCO.DFC_InjSysMulInjDiagErr_C DFES_DTCO.DFC_LLRHmax_C DFES_DTCO.DFC_LLRHmin_C DFES_DTCO.DFC_LLRHnpl_C DFES_DTCO.DFC_LLRKHmax_C DFES_DTCO.DFC_LLRKHmin_C DFES_DTCO.DFC_LLRKHnpl_C DFES_DTCO.DFC_LinACGUnit_C DFES_DTCO.DFC_LinAEVUnit_C DFES_DTCO.DFC_LinEBSUnit_C DFES_DTCO.DFC_RoughRoad_C DFES_DTCO.DFC_SiaEEPRdErr_C DFES_DTCO.DFC_SiaEEPWrngCod_C DFES_DTCO.DFC_UegoHeatrStrtS1B1_C DFES_DTCO.DFC_BusDiagCANAPPLBusOff_C DFES_DTCO.DFC_BusDiagCANCANCBusOff_C DFES_DTCO.DFC_BusDiagCANVEHICLEBusOff_C DFES_DTCO.DFC_RBA_IODIAGPWR_rba_IoExtCy329_SignalVltSply_0_C DFES_DTCO.DFC_RBA_IODIAGPWR_rba_IoExtCy329_SignalVltSply_0OT_C DFES_DTCO.DFC_RBA_IODIAGPWR_rba_IoExtCy329_SignalVltSply_0OV_C DFES_DTCO.DFC_RBA_IODIAGPWR_rba_IoExtCy329_SignalVltSply_0SCG_C DFES_DTCO.DFC_RBA_IODIAGPWR_rba_IoExtCy329_SignalVltSply_0UV_C DFES_DTCO.DFC_RBA_IODIAGPWR_rba_IoExtCy329_SignalVltSply_1_C DFES_DTCO.DFC_RBA_IODIAGPWR_rba_IoExtCy329_SignalVltSply_1OT_C DFES_DTCO.DFC_RBA_IODIAGPWR_rba_IoExtCy329_SignalVltSply_1OV_C DFES_DTCO.DFC_RBA_IODIAGPWR_rba_IoExtCy329_SignalVltSply_1SCG_C DFES_DTCO.DFC_RBA_IODIAGPWR_rba_IoExtCy329_SignalVltSply_1UV_C DFES_DTCO.DFC_RBA_IODIAGPWR_rba_IoExtCy329_SignalVltSply_2_C DFES_DTCO.DFC_RBA_IODIAGPWR_rba_IoExtCy329_SignalVltSply_2OT_C DFES_DTCO.DFC_RBA_IODIAGPWR_rba_IoExtCy329_SignalVltSply_2OV_C DFES_DTCO.DFC_RBA_IODIAGPWR_rba_IoExtCy329_SignalVltSply_2SCG_C DFES_DTCO.DFC_RBA_IODIAGPWR_rba_IoExtCy329_SignalVltSply_2UV_C DFES_DTCO.DFC_CAN_E_TIMEOUT_C DFES_DTCO.DFC_LIN_E_TIMEOUT_C DFES_DTCO.DFC_MRlyOL_C DFES_DTCO.DFC_MRlySCB_C DFES_DTCO.DFC_MRlySCG_C DFES_DTCO.DFC_rba_MultiStackTrace_Threshold_C DFES_DTCO.DFC_BSWM_E_ACTION_FAILED_C DFES_DTCO.DFC_BSWM_E_INTRPTQUEUE_FULL_C DFES_DTCO.DFC_RBA_IOEXTLIB_KEEPALIVE_DRV_C DFES_DTCO.DFC_RBA_IOEXTLIB_KEEPALIVE_INI_C DFES_DTCO.DFC_rba_IoSigRtc_StopCounter_C DFES_DTCO.DFC_rba_MRly_Diag_Stk_Event_C DFES_DTCO.DFC_rba_MemDiag_MemReadErr_C DFES_DTCO.DFC_rba_MemDiag_MemWrErr_C DFES_DTCO.DFC_rba_SyC_IrrSwOffTrigEngRun_Event_C DFES_DTCO.DFC_rba_T15_Diag_ComInVld_Event_C DFES_DTCO.DFC_rba_T15_Diag_ComOff_HwOn_Event_C DFES_DTCO.DFC_rba_T15_Diag_ComOn_HwOff_Event_C DFES_DTCO.DFC_AAVmin_C DFES_DTCO.DFC_AGRSUS_C DFES_DTCO.DFC_AfsPlausDiagHi_C DFES_DTCO.DFC_AfsPlausDiagLo_C DFES_DTCO.DFC_AfsVrntDiagErrB1_C DFES_DTCO.DFC_AppAllSnsrDfct_C DFES_DTCO.DFC_BBKRnldg_C DFES_DTCO.DFC_BBKRsyne_C DFES_DTCO.DFC_BattUStdbyDiaOL_C DFES_DTCO.DFC_BigLeakIntkMnfldEmiInfl_C DFES_DTCO.DFC_BlkdLineTank_C DFES_DTCO.DFC_BrkMnSwtContOnWarnLmp_C DFES_DTCO.DFC_BrkMnSwtNotStpWarnLmp_C DFES_DTCO.DFC_BrkRdntSwtContOnWarnLmp_C DFES_DTCO.DFC_BrkRdntSwtNotStpWarnLmp_C DFES_DTCO.DFC_CEngDsTColdStrtMax_C DFES_DTCO.DFC_CEngDsTColdStrtMin_C DFES_DTCO.DFC_CEngDsTImps_C DFES_DTCO.DFC_CEngDsTPlausHSC_C DFES_DTCO.DFC_CEngDsTPlausLSC_C DFES_DTCO.DFC_CEngDsTPlausSTC_C DFES_DTCO.DFC_CEngDsTSRCMax_C DFES_DTCO.DFC_CEngDsTSRCMin_C DFES_DTCO.DFC_CEngDsTSig_C DFES_DTCO.DFC_CEngUsTColdStrtMax_C DFES_DTCO.DFC_CEngUsTColdStrtMin_C DFES_DTCO.DFC_CEngUsTLooseCnctn_C DFES_DTCO.DFC_CEngUsTSRCMax_C DFES_DTCO.DFC_CEngUsTSRCMin_C DFES_DTCO.DFC_ComDCDCACCFailr_C DFES_DTCO.DFC_DCDCFltDet_C DFES_DTCO.DFC_DKRSA_C DFES_DTCO.DFC_DKVSmax_C DFES_DTCO.DFC_DKnpl_C DFES_DTCO.DFC_DSKVRmax_C DFES_DTCO.DFC_DSKVRmin_C DFES_DTCO.DFC_DSKVRnpl_C DFES_DTCO.DFC_DSKVRsig_C DFES_DTCO.DFC_DSKVSsig_C DFES_DTCO.DFC_DSSmax_C DFES_DTCO.DFC_DSTDmax_C DFES_DTCO.DFC_DSTEmax_C DFES_DTCO.DFC_DSTEmin_C DFES_DTCO.DFC_DSTOFmax_C DFES_DTCO.DFC_DSTRmax_C DFES_DTCO.DFC_DSTRmin_C DFES_DTCO.DFC_DSTRnpl_C DFES_DTCO.DFC_DSTRsig_C DFES_DTCO.DFC_DSTTI_C DFES_DTCO.DFC_DSUmax_C DFES_DTCO.DFC_DiagCpv1DteskLoLoadStuckClsd_C DFES_DTCO.DFC_DiagCpv1DteskLoLoadStuckOpen_C DFES_DTCO.DFC_EGRVlvDrftClsd_C DFES_DTCO.DFC_EGRVlvDrftOpn_C DFES_DTCO.DFC_EGRVlvJamVlvClsd_C DFES_DTCO.DFC_EGRVlvJamVlvOpn_C DFES_DTCO.DFC_EGRVlvSprgBrk_C DFES_DTCO.DFC_EGRVlvTempMdlEEPErr_C DFES_DTCO.DFC_EGRVlvTmpErr_C DFES_DTCO.DFC_EGSDUS2B1LtrDly_C DFES_DTCO.DFC_EGSDUS2B1LtrPT1_C DFES_DTCO.DFC_EGSDUS2B1RtlDly_C DFES_DTCO.DFC_EGSDUS2B1RtlPT1_C DFES_DTCO.DFC_EGSDUS2B1TarLean_C DFES_DTCO.DFC_EGSDUS2B1TarRich_C DFES_DTCO.DFC_EONVmax_C DFES_DTCO.DFC_ETAKHLmax_C DFES_DTCO.DFC_ETAKHTmax_C DFES_DTCO.DFC_ETHSEmax_C DFES_DTCO.DFC_ETHSEmin_C DFES_DTCO.DFC_ETHSFmax_C DFES_DTCO.DFC_ETHSFmin_C DFES_DTCO.DFC_ETHSFsig_C DFES_DTCO.DFC_ETHSNPWmax_C DFES_DTCO.DFC_ETHSNPWmin_C DFES_DTCO.DFC_ETHSNPWsig_C DFES_DTCO.DFC_ETHSPLnpl_C DFES_DTCO.DFC_ETHSTPLnpl_C DFES_DTCO.DFC_EngICO_C DFES_DTCO.DFC_EngPrtOvrSpdMon_C DFES_DTCO.DFC_EpmCaSI1ErrSig_C DFES_DTCO.DFC_EpmCaSI1MntErr_C DFES_DTCO.DFC_EpmCaSI1NoSigMax_C DFES_DTCO.DFC_EpmCaSI1NoSigMin_C DFES_DTCO.DFC_EpmCaSI1OfsErr_C DFES_DTCO.DFC_EpmCrSDGI_C DFES_DTCO.DFC_EpmCrSErrSig_C DFES_DTCO.DFC_EpmCrSNoSig_C DFES_DTCO.DFC_EtaEngIdleNonCsers_C DFES_DTCO.DFC_EtaEngPtlNonCsers_C DFES_DTCO.DFC_FRAmax_C DFES_DTCO.DFC_FRAmin_C DFES_DTCO.DFC_FSTEmax_C DFES_DTCO.DFC_FSTEmin_C DFES_DTCO.DFC_FSTRmax_C DFES_DTCO.DFC_FSTRmin_C DFES_DTCO.DFC_FSTRnpl_C DFES_DTCO.DFC_FSTmax_C DFES_DTCO.DFC_FTDLAmax_C DFES_DTCO.DFC_FTDLAmin_C DFES_DTCO.DFC_FuPHiSnsrEleclmax_C DFES_DTCO.DFC_FuPHiSnsrEleclmin_C DFES_DTCO.DFC_FuPHiSnsrEleclnpl_C DFES_DTCO.DFC_FuPHiSnsrURngMax_C DFES_DTCO.DFC_FuPHiSnsrURngMin_C DFES_DTCO.DFC_FuSnsrPhyRngMaxErr_C DFES_DTCO.DFC_FuSnsrPhyRngMinErr_C DFES_DTCO.DFC_GEVlvLockPinDiagIntkB1_C DFES_DTCO.DFC_GEVlvPhaSlowIntkB1_C DFES_DTCO.DFC_GEVlvPhaTargIntkB1_C DFES_DTCO.DFC_GbxRvsSwtStk_C DFES_DTCO.DFC_HDRKHmax_C DFES_DTCO.DFC_HDRKHmin_C DFES_DTCO.DFC_HDRPLmax_C DFES_DTCO.DFC_HDRPLmin_C DFES_DTCO.DFC_HDRmax_C DFES_DTCO.DFC_HDRmin_C DFES_DTCO.DFC_HEGOS2B1ElecMax_C DFES_DTCO.DFC_HEGOS2B1ElecMin_C DFES_DTCO.DFC_HEGOS2B1ElecSig_C DFES_DTCO.DFC_HEGOS2B1HtgNpl_C DFES_DTCO.DFC_HEV00max_C DFES_DTCO.DFC_HEV01max_C DFES_DTCO.DFC_HEV02max_C DFES_DTCO.DFC_HEV03max_C DFES_DTCO.DFC_HEVE0max_C DFES_DTCO.DFC_HEVE1max_C DFES_DTCO.DFC_HFMmax_C DFES_DTCO.DFC_HiPSysHiPMaxLimExcdd_C DFES_DTCO.DFC_IVGdiCtlCvoErrMax_0_C DFES_DTCO.DFC_IVGdiCtlCvoErrMax_1_C DFES_DTCO.DFC_IVGdiCtlCvoErrMax_2_C DFES_DTCO.DFC_IVGdiCtlCvoErrMax_3_C DFES_DTCO.DFC_IVGdiCtlCvoErrMin_0_C DFES_DTCO.DFC_IVGdiCtlCvoErrMin_1_C DFES_DTCO.DFC_IVGdiCtlCvoErrMin_2_C DFES_DTCO.DFC_IVGdiCtlCvoErrMin_3_C DFES_DTCO.DFC_IVGdiCtlCvoErrMinMax_C DFES_DTCO.DFC_IVGdiCtlCvoSigPlausErrSmrCdn_C DFES_DTCO.DFC_IVGdiCtl_CvoErr_C DFES_DTCO.DFC_IVGdiCtl_CvoSigPlaus_0_C DFES_DTCO.DFC_IVGdiCtl_CvoSigPlaus_1_C DFES_DTCO.DFC_IVGdiCtl_CvoSigPlaus_2_C DFES_DTCO.DFC_IVGdiCtl_CvoSigPlaus_3_C DFES_DTCO.DFC_IntkAirTAirFltDsCrssMax_C DFES_DTCO.DFC_IntkAirTAirFltDsCrssMin_C DFES_DTCO.DFC_IntkAirTAirFltDsHSCMax_C DFES_DTCO.DFC_IntkAirTAirFltDsImps_C DFES_DTCO.DFC_IntkAirTAirFltDsPRCMax_C DFES_DTCO.DFC_IntkAirTAirFltDsPRCMin_C DFES_DTCO.DFC_IntkAirTAirFltDsSRCMax_C DFES_DTCO.DFC_IntkAirTAirFltDsSRCMin_C DFES_DTCO.DFC_IntkAirTAirFltDsSTC_C DFES_DTCO.DFC_IntkAirTIntkMnfldCrssMax_C DFES_DTCO.DFC_IntkAirTIntkMnfldCrssMin_C DFES_DTCO.DFC_IntkAirTIntkMnfldHSCMax_C DFES_DTCO.DFC_IntkAirTIntkMnfldImps_C DFES_DTCO.DFC_IntkAirTIntkMnfldPRCMax_C DFES_DTCO.DFC_IntkAirTIntkMnfldPRCMin_C DFES_DTCO.DFC_IntkAirTIntkMnfldSRCMax_C DFES_DTCO.DFC_IntkAirTIntkMnfldSRCMin_C DFES_DTCO.DFC_IntkAirTIntkMnfldSTC_C DFES_DTCO.DFC_KRREGRLMX_C DFES_DTCO.DFC_KRVEKOCVLCI_C DFES_DTCO.DFC_KRVEKOENCHMT_C DFES_DTCO.DFC_KRVEKOENCHMT0_C DFES_DTCO.DFC_KRVEKOENCHMT1_C DFES_DTCO.DFC_KRVEKOENCHMT2_C DFES_DTCO.DFC_KRVEKOENCHMT3_C DFES_DTCO.DFC_KRVEKOENCHMT4_C DFES_DTCO.DFC_KRVEKOENCHMT5_C DFES_DTCO.DFC_KRVEKOENCHMT6_C DFES_DTCO.DFC_KRVEKOENCHMT7_C DFES_DTCO.DFC_KRVEKORLMX_C DFES_DTCO.DFC_KRVEKORLMXL_C DFES_DTCO.DFC_KS1max_C DFES_DTCO.DFC_KS1min_C DFES_DTCO.DFC_LMmax_C DFES_DTCO.DFC_LZSRnpl_C DFES_DTCO.DFC_LamDynDiagS1B1_C DFES_DTCO.DFC_LeakIntkMnfldEmiInfl_C DFES_DTCO.DFC_LinFrameErrDCDC_C DFES_DTCO.DFC_LinOverrunErrDCDC_C DFES_DTCO.DFC_MD00max_C DFES_DTCO.DFC_MDBmax_C DFES_DTCO.DFC_MDCat_C DFES_DTCO.DFC_MDCatCrit_C DFES_DTCO.DFC_MDCatCurr_C DFES_DTCO.DFC_MDCyl_0_C DFES_DTCO.DFC_MDCyl_1_C DFES_DTCO.DFC_MDCyl_2_C DFES_DTCO.DFC_MDCyl_3_C DFES_DTCO.DFC_MDEmi_C DFES_DTCO.DFC_MDEmiStrt_C DFES_DTCO.DFC_MDFco_C DFES_DTCO.DFC_MDMpl_C DFES_DTCO.DFC_MDSegTiAdpn_C DFES_DTCO.DFC_MDmax_C DFES_DTCO.DFC_MFuOilMax_C DFES_DTCO.DFC_MOXEMM_SMU_ALM0_0_C DFES_DTCO.DFC_MOXEMM_SMU_ALM0_1_C DFES_DTCO.DFC_MOXEMM_SMU_ALM0_10_C DFES_DTCO.DFC_MOXEMM_SMU_ALM0_11_C DFES_DTCO.DFC_MOXEMM_SMU_ALM0_13_C DFES_DTCO.DFC_MOXEMM_SMU_ALM0_14_C DFES_DTCO.DFC_MOXEMM_SMU_ALM0_2_C DFES_DTCO.DFC_MOXEMM_SMU_ALM0_22_C DFES_DTCO.DFC_MOXEMM_SMU_ALM0_23_C DFES_DTCO.DFC_MOXEMM_SMU_ALM0_4_C DFES_DTCO.DFC_MOXEMM_SMU_ALM0_5_C DFES_DTCO.DFC_MOXEMM_SMU_ALM0_7_C DFES_DTCO.DFC_MOXEMM_SMU_ALM0_8_C DFES_DTCO.DFC_MOXEMM_SMU_ALM10_16_C DFES_DTCO.DFC_MOXEMM_SMU_ALM10_17_C DFES_DTCO.DFC_MOXEMM_SMU_ALM10_21_C DFES_DTCO.DFC_MOXEMM_SMU_ALM11_0_C DFES_DTCO.DFC_MOXEMM_SMU_ALM11_1_C DFES_DTCO.DFC_MOXEMM_SMU_ALM11_2_C DFES_DTCO.DFC_MOXEMM_SMU_ALM11_3_C DFES_DTCO.DFC_MOXEMM_SMU_ALM11_4_C DFES_DTCO.DFC_MOXEMM_SMU_ALM11_5_C DFES_DTCO.DFC_MOXEMM_SMU_ALM11_8_C DFES_DTCO.DFC_MOXEMM_SMU_ALM11_9_C DFES_DTCO.DFC_MOXEMM_SMU_ALM1_0_C DFES_DTCO.DFC_MOXEMM_SMU_ALM1_1_C DFES_DTCO.DFC_MOXEMM_SMU_ALM1_10_C DFES_DTCO.DFC_MOXEMM_SMU_ALM1_11_C DFES_DTCO.DFC_MOXEMM_SMU_ALM1_13_C DFES_DTCO.DFC_MOXEMM_SMU_ALM1_14_C DFES_DTCO.DFC_MOXEMM_SMU_ALM1_2_C DFES_DTCO.DFC_MOXEMM_SMU_ALM1_22_C DFES_DTCO.DFC_MOXEMM_SMU_ALM1_23_C DFES_DTCO.DFC_MOXEMM_SMU_ALM1_4_C DFES_DTCO.DFC_MOXEMM_SMU_ALM1_5_C DFES_DTCO.DFC_MOXEMM_SMU_ALM1_7_C DFES_DTCO.DFC_MOXEMM_SMU_ALM1_8_C DFES_DTCO.DFC_MOXEMM_SMU_ALM21_0_C DFES_DTCO.DFC_MOXEMM_SMU_ALM21_16_C DFES_DTCO.DFC_MOXEMM_SMU_ALM21_3_C DFES_DTCO.DFC_MOXEMM_SMU_ALM2_1_C DFES_DTCO.DFC_MOXEMM_SMU_ALM2_10_C DFES_DTCO.DFC_MOXEMM_SMU_ALM2_11_C DFES_DTCO.DFC_MOXEMM_SMU_ALM2_13_C DFES_DTCO.DFC_MOXEMM_SMU_ALM2_14_C DFES_DTCO.DFC_MOXEMM_SMU_ALM2_22_C DFES_DTCO.DFC_MOXEMM_SMU_ALM2_23_C DFES_DTCO.DFC_MOXEMM_SMU_ALM2_4_C DFES_DTCO.DFC_MOXEMM_SMU_ALM2_5_C DFES_DTCO.DFC_MOXEMM_SMU_ALM2_7_C DFES_DTCO.DFC_MOXEMM_SMU_ALM2_8_C DFES_DTCO.DFC_MOXEMM_SMU_ALM6_0_C DFES_DTCO.DFC_MOXEMM_SMU_ALM6_11_C DFES_DTCO.DFC_MOXEMM_SMU_ALM6_12_C DFES_DTCO.DFC_MOXEMM_SMU_ALM6_14_C DFES_DTCO.DFC_MOXEMM_SMU_ALM6_15_C DFES_DTCO.DFC_MOXEMM_SMU_ALM6_17_C DFES_DTCO.DFC_MOXEMM_SMU_ALM6_18_C DFES_DTCO.DFC_MOXEMM_SMU_ALM6_20_C DFES_DTCO.DFC_MOXEMM_SMU_ALM6_21_C DFES_DTCO.DFC_MOXEMM_SMU_ALM6_25_C DFES_DTCO.DFC_MOXEMM_SMU_ALM6_4_C DFES_DTCO.DFC_MOXEMM_SMU_ALM6_5_C DFES_DTCO.DFC_MOXEMM_SMU_ALM6_7_C DFES_DTCO.DFC_MOXEMM_SMU_ALM6_8_C DFES_DTCO.DFC_MOXEMM_SMU_ALM7_1_C DFES_DTCO.DFC_MOXEMM_SMU_ALM7_12_C DFES_DTCO.DFC_MOXEMM_SMU_ALM7_13_C DFES_DTCO.DFC_MOXEMM_SMU_ALM7_14_C DFES_DTCO.DFC_MOXEMM_SMU_ALM7_15_C DFES_DTCO.DFC_MOXEMM_SMU_ALM7_16_C DFES_DTCO.DFC_MOXEMM_SMU_ALM7_17_C DFES_DTCO.DFC_MOXEMM_SMU_ALM7_2_C DFES_DTCO.DFC_MOXEMM_SMU_ALM7_20_C DFES_DTCO.DFC_MOXEMM_SMU_ALM7_25_C DFES_DTCO.DFC_MOXEMM_SMU_ALM7_26_C DFES_DTCO.DFC_MOXEMM_SMU_ALM7_28_C DFES_DTCO.DFC_MOXEMM_SMU_ALM7_29_C DFES_DTCO.DFC_MOXEMM_SMU_ALM7_30_C DFES_DTCO.DFC_MOXEMM_SMU_ALM7_31_C DFES_DTCO.DFC_MOXEMM_SMU_ALM8_0_C DFES_DTCO.DFC_MOXEMM_SMU_ALM8_1_C DFES_DTCO.DFC_MOXEMM_SMU_ALM8_10_C DFES_DTCO.DFC_MOXEMM_SMU_ALM8_11_C DFES_DTCO.DFC_MOXEMM_SMU_ALM8_12_C DFES_DTCO.DFC_MOXEMM_SMU_ALM8_16_C DFES_DTCO.DFC_MOXEMM_SMU_ALM8_18_C DFES_DTCO.DFC_MOXEMM_SMU_ALM8_2_C DFES_DTCO.DFC_MOXEMM_SMU_ALM8_3_C DFES_DTCO.DFC_MOXEMM_SMU_ALM8_31_C DFES_DTCO.DFC_MOXEMM_SMU_ALM8_4_C DFES_DTCO.DFC_MOXEMM_SMU_ALM9_0_C DFES_DTCO.DFC_MOXEMM_SMU_ALM9_15_C DFES_DTCO.DFC_MOXEMM_SMU_ALM9_3_C DFES_DTCO.DFC_MoCADCNTP_C DFES_DTCO.DFC_MoCADCTst_C DFES_DTCO.DFC_MoCSOPICO_C DFES_DTCO.DFC_MoFAPP_C DFES_DTCO.DFC_MoFAirFilgPrdc_C DFES_DTCO.DFC_MoFAirFlCtOffGdi_C DFES_DTCO.DFC_MoFAirFlCylGdi_C DFES_DTCO.DFC_MoFAirFlFF_C DFES_DTCO.DFC_MoFAirFlIn_C DFES_DTCO.DFC_MoFAirFlMixCtlGdiChkAirFl_C DFES_DTCO.DFC_MoFAirFlMixCtlGdiChkCtrl_C DFES_DTCO.DFC_MoFAirFlMode_C DFES_DTCO.DFC_MoFESpd_C DFES_DTCO.DFC_MoFIACo_C DFES_DTCO.DFC_MoFICOL1_C DFES_DTCO.DFC_MoFICOL2_C DFES_DTCO.DFC_MoFStrt_C DFES_DTCO.DFC_MoFTrqCmp_C DFES_DTCO.DFC_MoFTrqCmpMax_C DFES_DTCO.DFC_MoFTrqCmpMin_C DFES_DTCO.DFC_MoFVarPostBldSel_C DFES_DTCO.DFC_MoXEMMHwLTMCUFW_C DFES_DTCO.DFC_MoXEMMHwLTMonBIST_C DFES_DTCO.DFC_MoXEMMHwLTRegMonTest_C DFES_DTCO.DFC_MoXEMMHwLTStbySMUAlvTest_C DFES_DTCO.DFC_MoXEMMHwLTTempSens_C DFES_DTCO.DFC_MoXEMMHwLTUCBCfg_C DFES_DTCO.DFC_NWSEmax_C DFES_DTCO.DFC_NWSmax_C DFES_DTCO.DFC_OCWDAABEActv_C DFES_DTCO.DFC_OCWDACom_C DFES_DTCO.DFC_OCWDAErrPin_C DFES_DTCO.DFC_OCWDAOvrVltg_C DFES_DTCO.DFC_ORAmax_C DFES_DTCO.DFC_ORAmin_C DFES_DTCO.DFC_OilPPlaus_C DFES_DTCO.DFC_PLLSUmax_C DFES_DTCO.DFC_PLLSUmin_C DFES_DTCO.DFC_PSR1max_C DFES_DTCO.DFC_PSRBmax_C DFES_DTCO.DFC_PSRBmin_C DFES_DTCO.DFC_PSRPmax_C DFES_DTCO.DFC_PSRPmin_C DFES_DTCO.DFC_PSRPsig_C DFES_DTCO.DFC_PSRmax_C DFES_DTCO.DFC_PUmax_C DFES_DTCO.DFC_P_VSE11_OL_C DFES_DTCO.DFC_P_VSE11_SCB_C DFES_DTCO.DFC_P_VSE11_SCG_C DFES_DTCO.DFC_PhyHighAPP1_C DFES_DTCO.DFC_PhyHighAPP2_C DFES_DTCO.DFC_PhyLowAPP1_C DFES_DTCO.DFC_PhyLowAPP2_C DFES_DTCO.DFC_SRCHighAPP1_C DFES_DTCO.DFC_SRCHighAPP2_C DFES_DTCO.DFC_SRCLowAPP1_C DFES_DTCO.DFC_SRCLowAPP2_C DFES_DTCO.DFC_SSpMon2_C DFES_DTCO.DFC_STHDRmax_C DFES_DTCO.DFC_SWReset_0_C DFES_DTCO.DFC_SWReset_1_C DFES_DTCO.DFC_SWReset_2_C DFES_DTCO.DFC_SyncAPP_C DFES_DTCO.DFC_TANKLnpl_C DFES_DTCO.DFC_TAmax_Dummy_C DFES_DTCO.DFC_TESFmax_C DFES_DTCO.DFC_TESGmax_C DFES_DTCO.DFC_TKAEmax_C DFES_DTCO.DFC_TKAEmin_C DFES_DTCO.DFC_TKARmax_C DFES_DTCO.DFC_TKARnpl_C DFES_DTCO.DFC_TMmax_Dummy_C DFES_DTCO.DFC_TUMmax_Dummy_C DFES_DTCO.DFC_TWCDPriCatB1_C DFES_DTCO.DFC_ThrVlvClsdPosnFirstOffsLrnImpoB1_C DFES_DTCO.DFC_ThrVlvClsdPosnOffsLrnImpoB1_C DFES_DTCO.DFC_ThrVlvClsdPosnOffsLrnMaxB1_C DFES_DTCO.DFC_ThrVlvClsdPosnOffsLrnMinB1_C DFES_DTCO.DFC_ThrVlvCtrlDeB1_C DFES_DTCO.DFC_ThrVlvDycB1_C DFES_DTCO.DFC_ThrVlvLimpAirPosnMaxAbsltDriftB1_C DFES_DTCO.DFC_ThrVlvLimpAirPosnMaxB1_C DFES_DTCO.DFC_ThrVlvLimpAirPosnMaxRelDriftB1_C DFES_DTCO.DFC_ThrVlvLimpAirPosnMinB1_C DFES_DTCO.DFC_ThrVlvOpenLoadB1_C DFES_DTCO.DFC_ThrVlvOpenSprgB1_C DFES_DTCO.DFC_ThrVlvOpenSprgSprdB1_C DFES_DTCO.DFC_ThrVlvOpenSprgTwnB1_C DFES_DTCO.DFC_ThrVlvOverTB1_C DFES_DTCO.DFC_ThrVlvRetSprgB1_C DFES_DTCO.DFC_ThrVlvRetSprgSprdB1_C DFES_DTCO.DFC_ThrVlvRetSprgTwnB1_C DFES_DTCO.DFC_ThrVlvSens1MaxB1_C DFES_DTCO.DFC_ThrVlvSens1NplB1_C DFES_DTCO.DFC_ThrVlvSens2MaxB1_C DFES_DTCO.DFC_ThrVlvSens2MinB1_C DFES_DTCO.DFC_ThrVlvSens2NplB1_C DFES_DTCO.DFC_ThrVlvShoCircB1_C DFES_DTCO.DFC_ThrVlvSpiErrB1_C DFES_DTCO.DFC_ThrvlvSens1MinB1_C DFES_DTCO.DFC_TiOffTBasdChkFast_C DFES_DTCO.DFC_TiOffTBasdChkSlow_C DFES_DTCO.DFC_UEGOSnsrMntdS1B1_C DFES_DTCO.DFC_VehVSig_C DFES_DTCO.DFC_VlvLftFbSwtIntk11SpclFail_C DFES_DTCO.DFC_VlvLftFbSwtIntk11StdFail_C /end DEF_CHARACTERISTIC
 FUNCTION_VERSION "30000.73.0_2.0.0" /end FUNCTION
/begin COMPU_METHOD DFES_OneToOne "" RAT_FUNC "%6.2" "-" COEFFS 0 1 0 0 0 1 /end COMPU_METHOD
/begin RECORD_LAYOUT Val_Wu16 FNC_VALUES 1 UWORD COLUMN_DIR DIRECT /end RECORD_LAYOUT
/end MODULE
/end PROJECT
