ASAP2_VERSION 1 60
/begin PROJECT MG1CS022 "MG1CS022"
/begin HEADER "" VERSION "MG1CS022_62XSC_V037" PROJECT_NO MG1CS022 /end HEADER
/begin MODULE DIM ""
/begin MOD_COMMON "" BYTE_ORDER MSB_LAST ALIGNMENT_BYTE 1 ALIGNMENT_WORD 2 ALIGNMENT_LONG 4 ALIGNMENT_INT64 4 ALIGNMENT_FLOAT32_IEEE 4 ALIGNMENT_FLOAT64_IEEE 4 DATA_SIZE 32 /end MOD_COMMON
/begin CHARACTERISTIC UEGO_cntrDiagSigRamBnkSpiDeb_C "Maximum allowed number of sporadic faults caused by invalid data RAM transfer" VALUE 0x80581B70 RB_Val_Wu8 255.0 dez 0.00 255.0 FORMAT "%5.1" /end CHARACTERISTIC
/begin CHARACTERISTIC UEGO_cntrDiagSigRegBnkSpiDeb_C "Maximal allowed number of sporadic faults caused by invalid data register transfer" VALUE 0x80581B71 RB_Val_Wu8 255.0 dez 0.00 255.0 FORMAT "%5.1" /end CHARACTERISTIC
/begin CHARACTERISTIC UEGO_cntrDiagSigRegDiagSpiDeb_C "Maximal allowed number of sporadic faults caused by invalid diagnosis register transfer" VALUE 0x80581B72 RB_Val_Wu8 255.0 dez 0.00 255.0 FORMAT "%5.1" /end CHARACTERISTIC
/begin CHARACTERISTIC UEGO_DiagHeatrPrfmncS1B1_I.tHeatrStrtMin_C "Instance S1B1 of Class UEGO_DiagHeatrPrfmncClass / Minimum temperature threshold for the start diagnosis" VALUE 0x80581A74 RB_Val_Wu16 1535.977 temp_q0p0234_o273 -273.150 1262.827 FORMAT "%8.3" /end CHARACTERISTIC
/begin CHARACTERISTIC UEGO_DiagHeatrPrfmncS1B1_I.tiHldMaxStrt_C "Instance S1B1 of Class UEGO_DiagHeatrPrfmncClass / Maximum allowed total overrun duration for start diagnosis" VALUE 0x80581A76 RB_Val_Wu16 6553.500 t_q0p1 0.00 6553.500 FORMAT "%8.3" /end CHARACTERISTIC
/begin CHARACTERISTIC UEGO_DiagHeatrPrfmncS1B1_I.tiStrtDiagDurnCalcd_T "Instance S1B1 of Class UEGO_DiagHeatrPrfmncClass / Start diagnosis duration dependent on the relative mean heater power" CURVE 0x80581A78 RB_Curve_U16_U16 6553.500 t_q0p1 0.00 6553.500 FORMAT "%8.3"
 /begin AXIS_DESCR STD_AXIS UEGO_DiagHeatrPrfmncS1B1_I.ratEgyStrtDiag fak_ub_b2 5 0.00 511.9922 FORMAT "%8.4" DEPOSIT ABSOLUTE /end AXIS_DESCR
/end CHARACTERISTIC
/begin CHARACTERISTIC UEGO_facFkalFltConst_C "Filter time constant for Fcal measurement" VALUE 0x80581A44 RB_Val_Wu16 0.9999847 fak_uw_b1 0.00 0.9999847 FORMAT "%9.7" /end CHARACTERISTIC
/begin CHARACTERISTIC UEGO_nrTstPlsCntCfg_C "Configuration of the test pulse counter" VALUE 0x80581A90 RB_Val_Wu8 255.0 OneToOne 0.00 255.0 FORMAT "%5.1" /end CHARACTERISTIC
/begin CHARACTERISTIC UEGO_nrTstPls_C "Maximum number of test pulses in current driving cycle" VALUE 0x80581A94 RB_Val_Wu32 4294967295.00 OneToOne 0.00 4294967295.00 FORMAT "%13.2" /end CHARACTERISTIC
/begin CHARACTERISTIC UEGO_ratCmnModCorrn_C "Common mode correction ratio" VALUE 0x80581A46 RB_Val_Wu16 1.999939 q6p104Em5_DIV_V 0.00 1.999939 FORMAT "%8.6" EXTENDED_LIMITS 0.00 3.999939 /end CHARACTERISTIC
/begin CHARACTERISTIC UEGO_ratFkalCorrn_C "Calibration ratio for UEGO" VALUE 0x80581A48 RB_Val_Wu16 1.999939 q6p104Em5_DIV_V 0.00 1.999939 FORMAT "%8.6" EXTENDED_LIMITS 0.00 3.999939 /end CHARACTERISTIC
/begin CHARACTERISTIC UEGO_resRsgmspm_C "Switch resistance Rsga and Rspa" VALUE 0x80581A4E RB_Val_Wu16 6553.500 r_q0p1_Ohm 0.00 6553.500 FORMAT "%8.3" /end CHARACTERISTIC
/begin CHARACTERISTIC UEGO_stDiagHeatrPrfmnc_C "Status bits for UEGO_DiagHeatrPrfmnc" VALUE 0x80581A54 RB_Val_Wu8 255.0 OneToOne 0.00 255.0 FORMAT "%5.1" /end CHARACTERISTIC
/begin CHARACTERISTIC UEGO_stDiagRelsCdnMask_C "Enable mask for diagnosis release conditions" VALUE 0x80581B60 RB_Val_Wu8 255.0 OneToOne 0.00 255.0 FORMAT "%5.1" /end CHARACTERISTIC
/begin CHARACTERISTIC UEGO_stDiagSigEcuAsicReactnEna_C "Bit-by-bit deactivation of the fault report of the ASIC fault path" VALUE 0x80581B68 RB_Val_Wu16 65535.00 dez 0.00 65535.00 FORMAT "%8.2" /end CHARACTERISTIC
/begin CHARACTERISTIC UEGO_stDiagSigEcuAsicRprtEna_C "Bit-by-bit deactivation of the fault report of the ASIC fault path" VALUE 0x80581B6A RB_Val_Wu16 65535.00 dez 0.00 65535.00 FORMAT "%8.2" /end CHARACTERISTIC
/begin CHARACTERISTIC UEGO_stDiagSigEcuComReactnEna_C "Bit-by-bit activation of the fault reaction of the communication fault path." VALUE 0x80581B74 RB_Val_Wu16 65535.00 dez 0.00 65535.00 FORMAT "%8.2" /end CHARACTERISTIC
/begin CHARACTERISTIC UEGO_stDiagSigEcuComRprtEna_C "Bit-by-bit activation of the fault report of the communication fault path." VALUE 0x80581B76 RB_Val_Wu16 65535.00 dez 0.00 65535.00 FORMAT "%8.2" /end CHARACTERISTIC
/begin CHARACTERISTIC UEGO_stPwrStgFtchMask_C "Maske for validity return value LSM_Get()" VALUE 0x80581A98 RB_Val_Wu16 65535.00 OneToOne 0.00 65535.00 FORMAT "%8.2" /end CHARACTERISTIC
/begin CHARACTERISTIC UEGO_stPwrStgSysCondDeactvn_C "Codeword Deactivation Release of LSU Heater Circuit" VALUE 0x80581A9A RB_Val_Wu16 65535.00 OneToOne 0.00 65535.00 FORMAT "%8.2" /end CHARACTERISTIC
/begin CHARACTERISTIC UEGO_stTstPlsCfg_C "Code word for configuration of test pulse request" VALUE 0x80581A9C RB_Val_Wu8 255.0 OneToOne 0.00 255.0 FORMAT "%5.1" /end CHARACTERISTIC
/begin CHARACTERISTIC UEGO_SuprtPwrStgSnsrTyp_M "Matrix of supported lambdasensor and powerstage combination" MAP 0x80581A9D RB_Map_U8U8_U8 255.0 OneToOne 0.00 255.0 FORMAT "%5.1"
 /begin AXIS_DESCR STD_AXIS NO_INPUT_QUANTITY OneToOne 13 0.00 255.0 FORMAT "%5.1" DEPOSIT ABSOLUTE /end AXIS_DESCR
 /begin AXIS_DESCR STD_AXIS NO_INPUT_QUANTITY UEGO_SNSRType_COMPU_VERB 12 0.00 22.0000000000 FORMAT "%13.10" DEPOSIT ABSOLUTE /end AXIS_DESCR
/end CHARACTERISTIC
/begin CHARACTERISTIC UEGO_swtDiagWireUBattSel_C "Swith to select global release condition or local minimum battery voltage threshold" VALUE 0x80581B54 RB_Val_Wboolean 1.00000000000 B_TRUE 0.00 1.00000000000 FORMAT "%13.11" /end CHARACTERISTIC
/begin CHARACTERISTIC UEGO_swtUHeatrOlcIUMPR_C "calibratable heater voltage for IUMPR update" VALUE 0x80581A55 RB_Val_Wu8 1.00000000000 B_TRUE 0.00 1.00000000000 FORMAT "%13.11" /end CHARACTERISTIC
/begin CHARACTERISTIC UEGO_tEngStrtRels_C "Engine coolant temperature threshold for start Diagnosis error release" VALUE 0x80581A56 RB_Val_Ws16 6553.500 Temp_Cels -3549.940 3003.560 FORMAT "%8.3" /end CHARACTERISTIC
/begin CHARACTERISTIC UEGO_tHeatrPrfmncLo_C "Temperatur of the Lambda Sensor below these temperature threshold will be detect as heater power fault" VALUE 0x80581A58 RB_Val_Wu16 1535.977 temp_q0p0234_o273 -273.150 1262.827 FORMAT "%8.3" /end CHARACTERISTIC
/begin CHARACTERISTIC UEGO_tiBtwElecFlt_C "Pausetime between test pulses for electrical errors" VALUE 0x80581B56 RB_Val_Ws16 655350.0 Time_ms -327680.0 327670.0 FORMAT "%8.1" /end CHARACTERISTIC
/begin CHARACTERISTIC UEGO_tiBtwOTFlt_C "Pausetime between test pulses for overtemperature error" VALUE 0x80581B58 RB_Val_Ws16 655.3500 Time_s -327.6800 327.6700 FORMAT "%8.4" /end CHARACTERISTIC
/begin CHARACTERISTIC UEGO_tiCalib_C "cycle period for switching of CJ135 registers OFF and REF" VALUE 0x80581A4B RB_Val_Wu8 2.550 t_q0p01 0.00 2.550 FORMAT "%5.3" /end CHARACTERISTIC
/begin CHARACTERISTIC UEGO_tiDlyDiagRels_C "Time delay before diagnosis release" VALUE 0x80581B62 RB_Val_Wu16 655.3500 t_q0p01 0.00 655.3500 FORMAT "%8.4" /end CHARACTERISTIC
/begin CHARACTERISTIC UEGO_tiDlyNewPckMiss_C "Delay time to indicate a new package is missing" VALUE 0x80581A50 RB_Val_Wu16 327.6750 t_q0p005 0.00 327.6750 FORMAT "%8.4" /end CHARACTERISTIC
/begin CHARACTERISTIC UEGO_tiDlyOvrRunOff_C "Delay time no overrun" VALUE 0x80581A5A RB_Val_Wu16 6553.500 t_q0p1 0.00 6553.500 FORMAT "%8.3" /end CHARACTERISTIC
/begin CHARACTERISTIC UEGO_tiDlyOvrRunOnStrtDiag_C "start diagnosis time delay for overrun" VALUE 0x80581A5C RB_Val_Wu16 6553.500 t_q0p1 0.00 6553.500 FORMAT "%8.3" /end CHARACTERISTIC
/begin CHARACTERISTIC UEGO_tiDlyOvrRunOn_C "Delay time overrun active" VALUE 0x80581A5E RB_Val_Wu16 6553.500 t_q0p1 0.00 6553.500 FORMAT "%8.3" /end CHARACTERISTIC
/begin CHARACTERISTIC UEGO_tiDlyTstrReqStrtDiag_C "" VALUE 0x80581A60 RB_Val_Wu8 25.50 t_q0p1 0.00 25.50 FORMAT "%5.2" /end CHARACTERISTIC
/begin CHARACTERISTIC UEGO_tiHeatrOffMinStrt_C "Heater off time threshold for releasing the start diagnosis healing check" VALUE 0x80581A64 RB_Val_Wu32 85899345.9000 t_q0p02 0.00 85899345.9000 FORMAT "%13.4" /end CHARACTERISTIC
/begin CHARACTERISTIC UEGO_tiHeatrPrfmncTDropIUMPR_C "" VALUE 0x80581A68 RB_Val_Wu16 6553.500 t_q0p1 0.00 6553.500 FORMAT "%8.3" /end CHARACTERISTIC
/begin CHARACTERISTIC UEGO_tiHeatrWireRawErr_C "Filter time for power stage raw errors" VALUE 0x80581B5A RB_Val_Wu8 5.100 t_q0p02 0.00 5.100 FORMAT "%5.3" /end CHARACTERISTIC
/begin CHARACTERISTIC UEGO_tiOptLon_C "cycle period 1 for switching of register part OPT" VALUE 0x80581A4C RB_Val_Wu8 2.550 t_q0p01 0.00 2.550 FORMAT "%5.3" /end CHARACTERISTIC
/begin CHARACTERISTIC UEGO_tiOptShrt_C "cycle period 2 for switching of register part OPT" VALUE 0x80581A4D RB_Val_Wu8 2.550 t_q0p01 0.00 2.550 FORMAT "%5.3" /end CHARACTERISTIC
/begin CHARACTERISTIC UEGO_tiTestPlsBreak_C "Break time between requested test impulses" VALUE 0x80581B5C RB_Val_Wu16 655.3500 Time_s 0.00 655.3500 FORMAT "%8.4" /end CHARACTERISTIC
/begin CHARACTERISTIC UEGO_tWallStrtRels_C "Modelled exhaust wall temperature threshold for start diagnosis heal release" VALUE 0x80581A6A RB_Val_Ws16 6553.500 Temp_Cels -3549.940 3003.560 FORMAT "%8.3" /end CHARACTERISTIC
/begin CHARACTERISTIC UEGO_uBattDiagWireMin_C "Minimum battery voltage to assure that all power stage errors" VALUE 0x80581B5E RB_Val_Ws16 1310700. Volt_Batt -655360.0 655340.0 FORMAT "%8.1" /end CHARACTERISTIC
/begin CHARACTERISTIC UEGO_uGndOffCorrn_C "Ground voltage offset correctio" VALUE 0x80581A4A RB_Val_Ws8 0.08160 spg_q3p2Em4_V -0.04096 0.04064 FORMAT "%7.5" /end CHARACTERISTIC
/begin CHARACTERISTIC UEGO_uHeatrOlcIUMPR_C "calibratable heater volatage in open loop control" VALUE 0x80581A6C RB_Val_Wu16 327.6750 spg_q0p005 0.00 327.6750 FORMAT "%8.4" /end CHARACTERISTIC
/begin CHARACTERISTIC UEGO_uPwrSplyHiDiagRels_C "Higher supply voltage level to disable the diagnosis release" VALUE 0x80581B64 RB_Val_Ws16 1310700. Volt_Batt -655360.0 655340.0 FORMAT "%8.1" /end CHARACTERISTIC
/begin CHARACTERISTIC UEGO_uPwrSplyLoDiagRels_C "Lower supply voltage level to disable the diagnosis release" VALUE 0x80581B66 RB_Val_Ws16 1310700. Volt_Batt -655360.0 655340.0 FORMAT "%8.1" /end CHARACTERISTIC
/begin CHARACTERISTIC UEGO_uVCC3Max_C "Maximum allowed value of the reference voltage VCC3" VALUE 0x80581B6C RB_Val_Ws16 20.97120 spg_q3p2Em4_V -10.48576 10.48544 FORMAT "%8.5" /end CHARACTERISTIC
/begin CHARACTERISTIC UEGO_uVCC3Min_C "Minimum allowed value of the reference voltage VCC3" VALUE 0x80581B6E RB_Val_Ws16 20.97120 spg_q3p2Em4_V -10.48576 10.48544 FORMAT "%8.5" /end CHARACTERISTIC
/begin MEASUREMENT UEGO_CJ135CalcElecCorrnS1B1.flgFKal1Strtd "Class instance for ADC conversion of UEGO sensor 1 bank 1 / Display the start of calibration correction in Mode 1" UBYTE B_TRUE 1 100 0.00 1.00000000000 BIT_MASK 0x1 FORMAT "%13.11" ECU_ADDRESS 0x50002218 /end MEASUREMENT
/begin MEASUREMENT UEGO_CJ135CalcElecCorrnS1B1.flgFKal2Strtd "Class instance for ADC conversion of UEGO sensor 1 bank 1 / Display the start of calibration correction in Mode 2" UBYTE B_TRUE 1 100 0.00 1.00000000000 BIT_MASK 0x2 FORMAT "%13.11" ECU_ADDRESS 0x50002218 /end MEASUREMENT
/begin MEASUREMENT UEGO_CJ135CalcElecCorrnS1B1.flgFKal3Strtd "Class instance for ADC conversion of UEGO sensor 1 bank 1 / Display the start of calibration correction in Mode 3" UBYTE B_TRUE 1 100 0.00 1.00000000000 BIT_MASK 0x4 FORMAT "%13.11" ECU_ADDRESS 0x50002218 /end MEASUREMENT
/begin MEASUREMENT UEGO_CJ135CalcElecCorrnS1B1.flgUoffgnd1Vld "Class instance for ADC conversion of UEGO sensor 1 bank 1 / Validity of the Uoffgnd1 measurement" UBYTE B_TRUE 1 100 0.00 1.00000000000 BIT_MASK 0x1 FORMAT "%13.11" ECU_ADDRESS 0x50002219 /end MEASUREMENT
/begin MEASUREMENT UEGO_CJ135CalcElecCorrnS1B1.flgUoffgnd2Vld "Class instance for ADC conversion of UEGO sensor 1 bank 1 / Validity of the Uoffgnd2 measurement" UBYTE B_TRUE 1 100 0.00 1.00000000000 BIT_MASK 0x1 FORMAT "%13.11" ECU_ADDRESS 0x5000221A /end MEASUREMENT
/begin MEASUREMENT UEGO_CJ135CalcElecCorrnS1B1.flgUoffgnd3Vld "Class instance for ADC conversion of UEGO sensor 1 bank 1 / Validity of the Uoffgnd3 measurement" UBYTE B_TRUE 1 100 0.00 1.00000000000 BIT_MASK 0x1 FORMAT "%13.11" ECU_ADDRESS 0x5000221B /end MEASUREMENT
/begin MEASUREMENT UEGO_CJ135CalcElecCorrnS1B1.flgUoffipe1Z1Vld "Class instance for ADC conversion of UEGO sensor 1 bank 1 / Validity of the flgUoffipe1Z1Vld measurement" UBYTE B_TRUE 1 100 0.00 1.00000000000 BIT_MASK 0x1 FORMAT "%13.11" ECU_ADDRESS 0x5000221C /end MEASUREMENT
/begin MEASUREMENT UEGO_CJ135CalcElecCorrnS1B1.flgUoffipe1Z2Vld "Class instance for ADC conversion of UEGO sensor 1 bank 1 / Validity of the flgUoffipe1Z2Vld measurement" UBYTE B_TRUE 1 100 0.00 1.00000000000 BIT_MASK 0x1 FORMAT "%13.11" ECU_ADDRESS 0x5000221D /end MEASUREMENT
/begin MEASUREMENT UEGO_CJ135CalcElecCorrnS1B1.flgUoffipe2Z1Vld "Class instance for ADC conversion of UEGO sensor 1 bank 1 / Validity of the flgUoffipe2Z1Vld measurement" UBYTE B_TRUE 1 100 0.00 1.00000000000 BIT_MASK 0x1 FORMAT "%13.11" ECU_ADDRESS 0x5000221E /end MEASUREMENT
/begin MEASUREMENT UEGO_CJ135CalcElecCorrnS1B1.flgUoffipe2Z2Vld "Class instance for ADC conversion of UEGO sensor 1 bank 1 / Validity of the flgUoffipe2Z2Vld measurement" UBYTE B_TRUE 1 100 0.00 1.00000000000 BIT_MASK 0x1 FORMAT "%13.11" ECU_ADDRESS 0x5000221F /end MEASUREMENT
/begin MEASUREMENT UEGO_CJ135CalcElecCorrnS1B1.flgUoffmesVld "Class instance for ADC conversion of UEGO sensor 1 bank 1 / Validity of the flgUoffmesVld measurement" UBYTE B_TRUE 1 100 0.00 1.00000000000 BIT_MASK 0x1 FORMAT "%13.11" ECU_ADDRESS 0x50002220 /end MEASUREMENT
/begin MEASUREMENT UEGO_CJ135CalcElecCorrnS1B1.flgUoffvcc1Vld "Class instance for ADC conversion of UEGO sensor 1 bank 1 / Validity of the flgUoffvcc1Vld measurement" UBYTE B_TRUE 1 100 0.00 1.00000000000 BIT_MASK 0x1 FORMAT "%13.11" ECU_ADDRESS 0x50002221 /end MEASUREMENT
/begin MEASUREMENT UEGO_CJ135CalcElecCorrnS1B1.flgUoffvcc2Vld "Class instance for ADC conversion of UEGO sensor 1 bank 1 / Validity of the flgUoffvcc2Vld measurement" UBYTE B_TRUE 1 100 0.00 1.00000000000 BIT_MASK 0x1 FORMAT "%13.11" ECU_ADDRESS 0x50002222 /end MEASUREMENT
/begin MEASUREMENT UEGO_CJ135CalcElecCorrnS1B1.flgUoffvcc3Vld "Class instance for ADC conversion of UEGO sensor 1 bank 1 / Validity of the flgUoffvcc3Vld measurement" UBYTE B_TRUE 1 100 0.00 1.00000000000 BIT_MASK 0x1 FORMAT "%13.11" ECU_ADDRESS 0x50002223 /end MEASUREMENT
/begin MEASUREMENT UEGO_CJ135CalcElecCorrnS1B1.flgUoffvcci1Vld "Class instance for ADC conversion of UEGO sensor 1 bank 1 / Validity of the flgUoffvcci1Vld measurement" UBYTE B_TRUE 1 100 0.00 1.00000000000 BIT_MASK 0x1 FORMAT "%13.11" ECU_ADDRESS 0x50002224 /end MEASUREMENT
/begin MEASUREMENT UEGO_CJ135CalcElecCorrnS1B1.flgUoffvcci2Vld "Class instance for ADC conversion of UEGO sensor 1 bank 1 / Validity of the flgUoffvcci2Vld measurement" UBYTE B_TRUE 1 100 0.00 1.00000000000 BIT_MASK 0x1 FORMAT "%13.11" ECU_ADDRESS 0x50002225 /end MEASUREMENT
/begin MEASUREMENT UEGO_CJ135CalcElecCorrnS1B1.flgnCmnMod1Strtd "Class instance for ADC conversion of UEGO sensor 1 bank 1 / Display the start of correction in common mode" UBYTE B_TRUE 1 100 0.00 1.00000000000 BIT_MASK 0x8 FORMAT "%13.11" ECU_ADDRESS 0x50002218 /end MEASUREMENT
/begin MEASUREMENT UEGO_CJ135CalcElecCorrnS1B1.flgnCmnMod2Strtd "Class instance for ADC conversion of UEGO sensor 1 bank 1 / Display the start of correction in common mode" UBYTE B_TRUE 1 100 0.00 1.00000000000 BIT_MASK 0x10 FORMAT "%13.11" ECU_ADDRESS 0x50002218 /end MEASUREMENT
/begin MEASUREMENT UEGO_CJ135CalcElecCorrnS1B1.flgnumUref22Strtd "Class instance for ADC conversion of UEGO sensor 1 bank 1 / Display the start of correction in common mode" UBYTE B_TRUE 1 100 0.00 1.00000000000 BIT_MASK 0x20 FORMAT "%13.11" ECU_ADDRESS 0x50002218 /end MEASUREMENT
/begin MEASUREMENT UEGO_CJ135CalcElecCorrnS1B1.nrUoffgnd1 "Class instance for ADC conversion of UEGO sensor 1 bank 1 / ADC value of the offset measurement at Ground with amplifier mode 1" SWORD dez 1 100 -32768.00 32767.00 FORMAT "%8.2" ECU_ADDRESS 0x50002226 /end MEASUREMENT
/begin MEASUREMENT UEGO_CJ135CalcElecCorrnS1B1.nrUoffgnd2 "Class instance for ADC conversion of UEGO sensor 1 bank 1 / ADC value of the offset measurement at Ground with amplifier mode 2" SWORD dez 1 100 -32768.00 32767.00 FORMAT "%8.2" ECU_ADDRESS 0x50002228 /end MEASUREMENT
/begin MEASUREMENT UEGO_CJ135CalcElecCorrnS1B1.nrUoffgnd3 "Class instance for ADC conversion of UEGO sensor 1 bank 1 / ADC value of the offset measurement at Ground with amplifier mode 3" SWORD dez 1 100 -32768.00 32767.00 FORMAT "%8.2" ECU_ADDRESS 0x5000222A /end MEASUREMENT
/begin MEASUREMENT UEGO_CJ135CalcElecCorrnS1B1.nrUoffipe1Z1 "Class instance for ADC conversion of UEGO sensor 1 bank 1 / ADC value of the offset measurement of the IPEpin in the switching state Z1 with amplifier mode 1 for UEGO" SWORD dez 1 100 -32768.00 32767.00 FORMAT "%8.2" ECU_ADDRESS 0x5000222C /end MEASUREMENT
/begin MEASUREMENT UEGO_CJ135CalcElecCorrnS1B1.nrUoffipe1Z2 "Class instance for ADC conversion of UEGO sensor 1 bank 1 / ADC value of the offset measurement of the IPEpin in the switching state Z2 with amplifier mode 1 for UEGO" SWORD dez 1 100 -32768.00 32767.00 FORMAT "%8.2" ECU_ADDRESS 0x5000222E /end MEASUREMENT
/begin MEASUREMENT UEGO_CJ135CalcElecCorrnS1B1.nrUoffipe2Z1 "Class instance for ADC conversion of UEGO sensor 1 bank 1 / ADC value of the offset measurement of the IPEpin in the switching state Z1 with amplifier mode 2 for UEGO" SWORD dez 1 100 -32768.00 32767.00 FORMAT "%8.2" ECU_ADDRESS 0x50002230 /end MEASUREMENT
/begin MEASUREMENT UEGO_CJ135CalcElecCorrnS1B1.nrUoffipe2Z2 "Class instance for ADC conversion of UEGO sensor 1 bank 1 / ADC value of the offset measurement of the IPEpin in the switching state Z2 with amplifier mode 2 for UEGO" SWORD dez 1 100 -32768.00 32767.00 FORMAT "%8.2" ECU_ADDRESS 0x50002232 /end MEASUREMENT
/begin MEASUREMENT UEGO_CJ135CalcElecCorrnS1B1.nrUoffmes "Class instance for ADC conversion of UEGO sensor 1 bank 1 / ADC value of the offset measurement of the MES pin" SWORD dez 1 100 -32768.00 32767.00 FORMAT "%8.2" ECU_ADDRESS 0x50002234 /end MEASUREMENT
/begin MEASUREMENT UEGO_CJ135CalcElecCorrnS1B1.nrUoffvcc1 "Class instance for ADC conversion of UEGO sensor 1 bank 1 / ADC value of the offset measurement Uoffvcc1" SWORD dez 1 100 -32768.00 32767.00 FORMAT "%8.2" ECU_ADDRESS 0x50002236 /end MEASUREMENT
/begin MEASUREMENT UEGO_CJ135CalcElecCorrnS1B1.nrUoffvcc2 "Class instance for ADC conversion of UEGO sensor 1 bank 1 / ADC value of the offset measurement Uoffvcc2" SWORD dez 1 100 -32768.00 32767.00 FORMAT "%8.2" ECU_ADDRESS 0x50002238 /end MEASUREMENT
/begin MEASUREMENT UEGO_CJ135CalcElecCorrnS1B1.nrUoffvcc3 "Class instance for ADC conversion of UEGO sensor 1 bank 1 / ADC value of the offset measurement Uoffvcc3" SWORD dez 1 100 -32768.00 32767.00 FORMAT "%8.2" ECU_ADDRESS 0x5000223A /end MEASUREMENT
/begin MEASUREMENT UEGO_CJ135CalcElecCorrnS1B1.nrUoffvcci1 "Class instance for ADC conversion of UEGO sensor 1 bank 1 / ADC value of the offset measurement Uoffvcci1" SWORD dez 1 100 -32768.00 32767.00 FORMAT "%8.2" ECU_ADDRESS 0x5000223C /end MEASUREMENT
/begin MEASUREMENT UEGO_CJ135CalcElecCorrnS1B1.nrUoffvcci2 "Class instance for ADC conversion of UEGO sensor 1 bank 1 / ADC value of the offset measurement Uoffvcci2" SWORD dez 1 100 -32768.00 32767.00 FORMAT "%8.2" ECU_ADDRESS 0x5000223E /end MEASUREMENT
/begin MEASUREMENT UEGO_CJ135CalcElecCorrnS1B1.numUref1Corrd "Class instance for ADC conversion of UEGO sensor 1 bank 1 / Number of measured reference voltage correction" SWORD dez 1 100 -32768.00 32767.00 FORMAT "%8.2" ECU_ADDRESS 0x50002240 /end MEASUREMENT
/begin MEASUREMENT UEGO_CJ135CalcElecCorrnS1B1.numUref21Corrd "Class instance for ADC conversion of UEGO sensor 1 bank 1 / Number of measured reference voltage correction" SWORD dez 1 100 -32768.00 32767.00 FORMAT "%8.2" ECU_ADDRESS 0x50002242 /end MEASUREMENT
/begin MEASUREMENT UEGO_CJ135CalcElecCorrnS1B1.numUref22Corrd "Class instance for ADC conversion of UEGO sensor 1 bank 1 / Number of measured reference voltage correction" SWORD dez 1 100 -32768.00 32767.00 FORMAT "%8.2" ECU_ADDRESS 0x50002244 /end MEASUREMENT
/begin MEASUREMENT UEGO_CJ135CalcElecCorrnS1B1.numUref3Corrd "Class instance for ADC conversion of UEGO sensor 1 bank 1 / Number of measured reference voltage correction" SWORD dez 1 100 -32768.00 32767.00 FORMAT "%8.2" ECU_ADDRESS 0x50002246 /end MEASUREMENT
/begin MEASUREMENT UEGO_CJ135CalcElecCorrnS1B1.uCmnMod1 "Class instance for ADC conversion of UEGO sensor 1 bank 1 / Common mode voltage in mode 1" SWORD spg_q3p2Em4_V 1 100 -10.48576 10.48544 FORMAT "%8.5" ECU_ADDRESS 0x50002248 /end MEASUREMENT
/begin MEASUREMENT UEGO_CJ135CalcElecCorrnS1B1.uCmnMod2 "Class instance for ADC conversion of UEGO sensor 1 bank 1 / Common mode voltage in mode 2" SWORD spg_q3p2Em4_V 1 100 -10.48576 10.48544 FORMAT "%8.5" ECU_ADDRESS 0x5000224A /end MEASUREMENT
/begin MEASUREMENT UEGO_CJ135CalcElecCorrnS1B1.uVCC1Corrd "Class instance for ADC conversion of UEGO sensor 1 bank 1 / Corrected reference voltage VCC1" SWORD spg_q3p2Em4_V 1 100 -10.48576 10.48544 FORMAT "%8.5" ECU_ADDRESS 0x5000224C /end MEASUREMENT
/begin MEASUREMENT UEGO_CJ135CalcElecCorrnS1B1.uVCC3MeasRef "Class instance for ADC conversion of UEGO sensor 1 bank 1 / Measured Reference voltage VCC3" SWORD spg_q3p2Em4_V 1 100 -10.48576 10.48544 FORMAT "%8.5" ECU_ADDRESS 0x5000224E /end MEASUREMENT
/begin MEASUREMENT UEGO_CJ135CalcElecCorrnS1B1.uFkal1Flt_DL_I.memory "Class instance for ADC conversion of UEGO sensor 1 bank 1 / Instance forcalibration filter / current lowpass value" ULONG spg_q3p638Em12_V 1 100 0.00 0.0156249999964 FORMAT "%15.13" ECU_ADDRESS 0x50002250 /end MEASUREMENT
/begin MEASUREMENT UEGO_CJ135CalcElecCorrnS1B1.uFkal2Flt_DL_I.memory "Class instance for ADC conversion of UEGO sensor 1 bank 1 / Instance forcalibration filter / current lowpass value" ULONG spg_q3p638Em12_V 1 100 0.00 0.0156249999964 FORMAT "%15.13" ECU_ADDRESS 0x50002254 /end MEASUREMENT
/begin MEASUREMENT UEGO_CJ135CalcElecCorrnS1B1.uFkal3Flt_DL_I.memory "Class instance for ADC conversion of UEGO sensor 1 bank 1 / Instance forcalibration filter / current lowpass value" ULONG spg_q3p638Em12_V 1 100 0.00 0.0156249999964 FORMAT "%15.13" ECU_ADDRESS 0x50002258 /end MEASUREMENT
/begin MEASUREMENT UEGO_cntrDiagSigEcuAsicReiniProc10msec "EcuAsic Diagnosis Counter during post drive in proc10ms" UBYTE OneToOne 1 100 0.00 255.0 FORMAT "%5.1" ECU_ADDRESS 0x6000B5AD /end MEASUREMENT
/begin MEASUREMENT UEGO_cntrDiagSigEcuComReIniProc10msec "EcuCom Diagnosis Counter during post drive in proc10ms" UBYTE OneToOne 1 100 0.00 255.0 FORMAT "%5.1" ECU_ADDRESS 0x6000B5AC /end MEASUREMENT
/begin MEASUREMENT UEGO_DataCJ135S1B1_I.flgErrSpiRamBnk "Class instance of the functional class of FC UEGO_Data for Bank 1 Sensor 1 / SPI error of the RAM bank" UBYTE B_TRUE 1 100 0.00 1.00000000000 BIT_MASK 0x4 FORMAT "%13.11" ECU_ADDRESS 0x600024C2 /end MEASUREMENT
/begin MEASUREMENT UEGO_DataCJ135S1B1_I.flgIPmpActvd "Class instance of the functional class of FC UEGO_Data for Bank 1 Sensor 1 / Pump current activated" UBYTE B_TRUE 1 100 0.00 1.00000000000 BIT_MASK 0x8 FORMAT "%13.11" ECU_ADDRESS 0x600024C2 /end MEASUREMENT
/begin MEASUREMENT UEGO_DataCJ135S1B1_I.flgLoupeP "Class instance of the functional class of FC UEGO_Data for Bank 1 Sensor 1 / Status of LoupeP" UBYTE B_TRUE 1 100 0.00 1.00000000000 BIT_MASK 0x1 FORMAT "%13.11" ECU_ADDRESS 0x600024C1 /end MEASUREMENT
/begin MEASUREMENT UEGO_DataCJ135S1B1_I.flgLstPckAbort "Class instance of the functional class of FC UEGO_Data for Bank 1 Sensor 1 / Last packet transfer aborted" UBYTE B_TRUE 1 100 0.00 1.00000000000 BIT_MASK 0x40 FORMAT "%13.11" ECU_ADDRESS 0x600024C2 /end MEASUREMENT
/begin MEASUREMENT UEGO_DataCJ135S1B1_I.flgNewPck "Class instance of the functional class of FC UEGO_Data for Bank 1 Sensor 1 / A new packet is available" UBYTE B_TRUE 1 100 0.00 1.00000000000 BIT_MASK 0x20 FORMAT "%13.11" ECU_ADDRESS 0x600024C3 /end MEASUREMENT
/begin MEASUREMENT UEGO_DataCJ135S1B1_I.flgNewPckCstncEnd "Class instance of the functional class of FC UEGO_Data for Bank 1 Sensor 1 / Consistency of the new packet information at the beginning of data collection" UBYTE B_TRUE 1 100 0.00 1.00000000000 BIT_MASK 0x10 FORMAT "%13.11" ECU_ADDRESS 0x600024C3 /end MEASUREMENT
/begin MEASUREMENT UEGO_DataCJ135S1B1_I.flgNewPckCstncNxt "Class instance of the functional class of FC UEGO_Data for Bank 1 Sensor 1 / Consistency of the new packet information of the collecetd data for the next cycle" UBYTE B_TRUE 1 100 0.00 1.00000000000 BIT_MASK 0x80 FORMAT "%13.11" ECU_ADDRESS 0x600024C3 /end MEASUREMENT
/begin MEASUREMENT UEGO_DataCJ135S1B1_I.flgNewPckCstncStrt "Class instance of the functional class of FC UEGO_Data for Bank 1 Sensor 1 / Consistency of the new packet information at the end of data collection" UBYTE B_TRUE 1 100 0.00 1.00000000000 BIT_MASK 0x8 FORMAT "%13.11" ECU_ADDRESS 0x600024C3 /end MEASUREMENT
/begin MEASUREMENT UEGO_DataCJ135S1B1_I.flgNewPckMiss "Class instance of the functional class of FC UEGO_Data for Bank 1 Sensor 1 / A new packet was missed" UBYTE B_TRUE 1 100 0.00 1.00000000000 BIT_MASK 0x4 FORMAT "%13.11" ECU_ADDRESS 0x600024C3 /end MEASUREMENT
/begin MEASUREMENT UEGO_DataCJ135S1B1_I.flgNewPckVld "Class instance of the functional class of FC UEGO_Data for Bank 1 Sensor 1 / Validity of the new packet" UBYTE B_TRUE 1 100 0.00 1.00000000000 BIT_MASK 0x2 FORMAT "%13.11" ECU_ADDRESS 0x600024C3 /end MEASUREMENT
/begin MEASUREMENT UEGO_DataCJ135S1B1_I.flgSetCalibRegOK "Class instance of the functional class of FC UEGO_Data for Bank 1 Sensor 1 / Status to" UBYTE B_TRUE 1 100 0.00 1.00000000000 BIT_MASK 0x1 FORMAT "%13.11" ECU_ADDRESS 0x600024C4 /end MEASUREMENT
/begin MEASUREMENT UEGO_DataCJ135S1B1_I.flgSetCmnMod2 "Class instance of the functional class of FC UEGO_Data for Bank 1 Sensor 1 / Flag indicate to set common mode 2" UBYTE B_TRUE 1 100 0.00 1.00000000000 BIT_MASK 0x8 FORMAT "%13.11" ECU_ADDRESS 0x600024C1 /end MEASUREMENT
/begin MEASUREMENT UEGO_DataCJ135S1B1_I.flgSetOPTRegOk "Class instance of the functional class of FC UEGO_Data for Bank 1 Sensor 1 / Flag to indicate the successfull register set" UBYTE B_TRUE 1 100 0.00 1.00000000000 BIT_MASK 0x1 FORMAT "%13.11" ECU_ADDRESS 0x600024C5 /end MEASUREMENT
/begin MEASUREMENT UEGO_DataCJ135S1B1_I.flgSetRegCalibOK "Class instance of the functional class of FC UEGO_Data for Bank 1 Sensor 1 / Flag to indicate the successfull register set" UBYTE B_TRUE 1 100 0.00 1.00000000000 BIT_MASK 0x1 FORMAT "%13.11" ECU_ADDRESS 0x600024C6 /end MEASUREMENT
/begin MEASUREMENT UEGO_DataCJ135S1B1_I.flgSetRegOPTOk "Class instance of the functional class of FC UEGO_Data for Bank 1 Sensor 1 / Flag to indicate the successfull register set" UBYTE B_TRUE 1 100 0.00 1.00000000000 BIT_MASK 0x1 FORMAT "%13.11" ECU_ADDRESS 0x600024C7 /end MEASUREMENT
/begin MEASUREMENT UEGO_DataCJ135S1B1_I.flgUCmnMod1Vld "Class instance of the functional class of FC UEGO_Data for Bank 1 Sensor 1 / Flag indicate to set common mode 1" UBYTE B_TRUE 1 100 0.00 1.00000000000 BIT_MASK 0x4 FORMAT "%13.11" ECU_ADDRESS 0x600024C0 /end MEASUREMENT
/begin MEASUREMENT UEGO_DataCJ135S1B1_I.nrIntModSwtCalib "Class instance of the functional class of FC UEGO_Data for Bank 1 Sensor 1 / Internal mode of the to set calibiration register" UBYTE UEGO_DataCalib_COMPU_VERB 1 100 0.00 7.00000000000 FORMAT "%13.11" ECU_ADDRESS 0x600024C8 /end MEASUREMENT
/begin MEASUREMENT UEGO_DataCJ135S1B1_I.nrIntModSwtCalibOld "Class instance of the functional class of FC UEGO_Data for Bank 1 Sensor 1 / Internal mode of the to set calibiration register in the previous cycle" UBYTE UEGO_DataCalib_COMPU_VERB 1 100 0.00 7.00000000000 FORMAT "%13.11" ECU_ADDRESS 0x600024C9 /end MEASUREMENT
/begin MEASUREMENT UEGO_DataCJ135S1B1_I.nrIntModSwtOpt "Class instance of the functional class of FC UEGO_Data for Bank 1 Sensor 1 / Internal mode of the to set OPT register" UBYTE UEGO_DataOpt_COMPU_VERB 1 100 0.00 6.00000000000 FORMAT "%13.11" ECU_ADDRESS 0x600024CA /end MEASUREMENT
/begin MEASUREMENT UEGO_DataCJ135S1B1_I.nrIntModSwtOptOld "Class instance of the functional class of FC UEGO_Data for Bank 1 Sensor 1 / Internal mode of the to set OPT register in the previous cycle" UBYTE UEGO_DataOpt_COMPU_VERB 1 100 0.00 6.00000000000 FORMAT "%13.11" ECU_ADDRESS 0x600024CB /end MEASUREMENT
/begin MEASUREMENT UEGO_DataCJ135S1B1_I.nrModInt "Class instance of the functional class of FC UEGO_Data for Bank 1 Sensor 1 / Internal mode of the FC UEGO_Data" UBYTE UEGO_Data_COMPU_VERB 1 100 0.00 5.00000000000 FORMAT "%13.11" ECU_ADDRESS 0x600024CC /end MEASUREMENT
/begin MEASUREMENT UEGO_DataCJ135S1B1_I.nrModIntOld "Class instance of the functional class of FC UEGO_Data for Bank 1 Sensor 1 / Status of the Internal mode in the previous cycle of the FC UEGO_Data" UBYTE UEGO_Data_COMPU_VERB 1 100 0.00 5.00000000000 FORMAT "%13.11" ECU_ADDRESS 0x600024CD /end MEASUREMENT
/begin MEASUREMENT UEGO_DataCJ135S1B1_I.nrModMeas "Class instance of the functional class of FC UEGO_Data for Bank 1 Sensor 1 / Measured mode of the asic" UBYTE UEGO_AsicState_COMPU_VERB 1 100 0.00 7.00000000000 FORMAT "%13.11" ECU_ADDRESS 0x600024CE /end MEASUREMENT
/begin MEASUREMENT UEGO_DataCJ135S1B1_I.nrPckDataLostCntr "Class instance of the functional class of FC UEGO_Data for Bank 1 Sensor 1 / Amount of packets where data was lost" UBYTE dez 1 100 0.00 255.0 FORMAT "%5.1" ECU_ADDRESS 0x600024CF /end MEASUREMENT
/begin MEASUREMENT UEGO_DataCJ135S1B1_I.nrPckNotCmplCntr "Class instance of the functional class of FC UEGO_Data for Bank 1 Sensor 1 / Amount of packets which could not been transfered completely" UBYTE dez 1 100 0.00 255.0 FORMAT "%5.1" ECU_ADDRESS 0x600024D0 /end MEASUREMENT
/begin MEASUREMENT UEGO_DataCJ135S1B1_I.nrRamFailPosn "Class instance of the functional class of FC UEGO_Data for Bank 1 Sensor 1 / RAM position at which the ASIC has shut off in error case" UWORD dez 1 100 0.00 65535.00 FORMAT "%8.2" ECU_ADDRESS 0x600024D2 /end MEASUREMENT
/begin MEASUREMENT UEGO_DataCJ135S1B1_I.nrRamRegMod "Class instance of the functional class of FC UEGO_Data for Bank 1 Sensor 1 / Register MODE" UWORD dez 1 100 0.00 65535.00 FORMAT "%8.2" ECU_ADDRESS 0x600024D4 /end MEASUREMENT
/begin MEASUREMENT UEGO_DataCJ135S1B1_I.nrRamSts1 "Class instance of the functional class of FC UEGO_Data for Bank 1 Sensor 1 / Value of the STATUS?Word I" UWORD dez 1 100 0.00 65535.00 FORMAT "%8.2" ECU_ADDRESS 0x600024D6 /end MEASUREMENT
/begin MEASUREMENT UEGO_DataCJ135S1B1_I.nrRamSts2 "Class instance of the functional class of FC UEGO_Data for Bank 1 Sensor 1 / Value of the STATUS?Word II" UWORD dez 1 100 0.00 65535.00 FORMAT "%8.2" ECU_ADDRESS 0x600024D8 /end MEASUREMENT
/begin MEASUREMENT UEGO_DataCJ135S1B1_I.nrRamSts3 "Class instance of the functional class of FC UEGO_Data for Bank 1 Sensor 1 / Value of the STATUS?Word III" UWORD dez 1 100 0.00 65535.00 FORMAT "%8.2" ECU_ADDRESS 0x600024DA /end MEASUREMENT
/begin MEASUREMENT UEGO_DataCJ135S1B1_I.nrRegDiffCntr "Class instance of the functional class of FC UEGO_Data for Bank 1 Sensor 1 / Amount of packets where the RAM values where inconsitent to the register ones" UWORD dez 1 100 0.00 65535.00 FORMAT "%8.2" ECU_ADDRESS 0x600024DC /end MEASUREMENT
/begin MEASUREMENT UEGO_DataCJ135S1B1_I.nrRegMod "Class instance of the functional class of FC UEGO_Data for Bank 1 Sensor 1 / Register MODE" UWORD dez 1 100 0.00 65535.00 FORMAT "%8.2" ECU_ADDRESS 0x600024DE /end MEASUREMENT
/begin MEASUREMENT UEGO_DataCJ135S1B1_I.ratIPmpRaw "Class instance of the functional class of FC UEGO_Data for Bank 1 Sensor 1 / Raw value of the duty cycle of the pumping current" UWORD fak_q1p201Em4 1 100 0.00 7.872072 FORMAT "%8.6" ARRAY_SIZE 16 ECU_ADDRESS 0x600024E0 /end MEASUREMENT
/begin MEASUREMENT UEGO_DataCJ135S1B1_I.stIPmpTM2L "Class instance of the functional class of FC UEGO_Data for Bank 1 Sensor 1 / Bit header on TM2 Lean activation of the 15 individual cycles for UEGO" UWORD OneToOne 1 100 0.00 65535.00 FORMAT "%8.2" ECU_ADDRESS 0x60002500 /end MEASUREMENT
/begin MEASUREMENT UEGO_DataCJ135S1B1_I.stIPmpTM2R "Class instance of the functional class of FC UEGO_Data for Bank 1 Sensor 1 / Bit header on TM2 Rich activation of the 15 individual cycles for UEGO" UWORD OneToOne 1 100 0.00 65535.00 FORMAT "%8.2" ECU_ADDRESS 0x60002502 /end MEASUREMENT
/begin MEASUREMENT UEGO_DataCJ135S1B1_I.stLsmRetValMod "Class instance of the functional class of FC UEGO_Data for Bank 1 Sensor 1 / Return value of LSM when demanding the register MODE" ULONG dez 1 100 0.00 4294967295.00 FORMAT "%13.2" ECU_ADDRESS 0x60002504 /end MEASUREMENT
/begin MEASUREMENT UEGO_DataCJ135S1B1_I.stUriePckAry "Class instance of the functional class of FC UEGO_Data for Bank 1 Sensor 1 / Status word to display the validity field for Urie Array" UBYTE dez 1 100 0.00 255.0 FORMAT "%5.1" ECU_ADDRESS 0x60002508 /end MEASUREMENT
/begin MEASUREMENT UEGO_DataCJ135S1B1_I.stUxPckAry "Class instance of the functional class of FC UEGO_Data for Bank 1 Sensor 1 / Status word to display the validity field for measurement Array" UBYTE dez 1 100 0.00 255.0 FORMAT "%5.1" ECU_ADDRESS 0x60002509 /end MEASUREMENT
/begin MEASUREMENT UEGO_DataCJ135S1B1_I.stUyPckAry "Class instance of the functional class of FC UEGO_Data for Bank 1 Sensor 1 / Status word to display the validity field for measurement Array" UBYTE dez 1 100 0.00 255.0 FORMAT "%5.1" ECU_ADDRESS 0x6000250A /end MEASUREMENT
/begin MEASUREMENT UEGO_DataCJ135S1B1_I.tiDurnCalibWait "Class instance of the functional class of FC UEGO_Data for Bank 1 Sensor 1 / Time duration between switching of CJ135 registers OFF and REF" UBYTE t_q0p01 1 100 0.00 2.550 FORMAT "%5.3" ECU_ADDRESS 0x6000250B /end MEASUREMENT
/begin MEASUREMENT UEGO_DataCJ135S1B1_I.tiDurnOptWait "Class instance of the functional class of FC UEGO_Data for Bank 1 Sensor 1 / Time duration between switching of CJ135 registers OPT" UBYTE t_q0p01 1 100 0.00 2.550 FORMAT "%5.3" ECU_ADDRESS 0x6000250C /end MEASUREMENT
/begin MEASUREMENT UEGO_DataCJ135S1B1_I.CalibSW_I.timeCounter "Class instance of the functional class of FC UEGO_Data for Bank 1 Sensor 1 / Timer to set REF and OPT register / expired time since start" UBYTE t_q0p01 1 100 0.00 2.550 FORMAT "%5.3" ECU_ADDRESS 0x6000250D /end MEASUREMENT
/begin MEASUREMENT UEGO_DataCJ135S1B1_I.OptSW_I.timeCounter "Class instance of the functional class of FC UEGO_Data for Bank 1 Sensor 1 / Timer to set OPT register / expired time since start" UBYTE t_q0p01 1 100 0.00 2.550 FORMAT "%5.3" ECU_ADDRESS 0x6000250E /end MEASUREMENT
/begin MEASUREMENT UEGO_DataCJ135S1B1_I.flgNewPckMissTONVNM_I.time "Class instance of the functional class of FC UEGO_Data for Bank 1 Sensor 1 / Class instance for delay in New pack of measurment from the ASIC / Delay Time" UWORD t_q0p005 1 100 0.00 327.6750 FORMAT "%8.4" ECU_ADDRESS 0x60002510 /end MEASUREMENT
/begin MEASUREMENT UEGO_DataSplyClsS1B1_I.flgCj135An "Class instance of the functional class of FC UEGO_DataSplyCls for Bank 1 Sensor 1 / flgCj135An" UBYTE B_TRUE 1 100 0.00 1.00000000000 BIT_MASK 0x1 FORMAT "%13.11" ECU_ADDRESS 0x60002514 /end MEASUREMENT
/begin MEASUREMENT UEGO_DataSplyClsS1B1_I.flgDACOff "Class instance of the functional class of FC UEGO_DataSplyCls for Bank 1 Sensor 1 / Status of DAC activation" UBYTE B_TRUE 1 100 0.00 1.00000000000 BIT_MASK 0x1 FORMAT "%13.11" ECU_ADDRESS 0x6000251E /end MEASUREMENT
/begin MEASUREMENT UEGO_DataSplyClsS1B1_I.flgErrSpiRamRet "Class instance of the functional class of FC UEGO_DataSplyCls for Bank 1 Sensor 1 / SPI error of the RAM bank" UBYTE B_TRUE 1 100 0.00 1.00000000000 BIT_MASK 0x4 FORMAT "%13.11" ECU_ADDRESS 0x60002516 /end MEASUREMENT
/begin MEASUREMENT UEGO_DataSplyClsS1B1_I.flgFKal1Vld "Class instance of the functional class of FC UEGO_DataSplyCls for Bank 1 Sensor 1 / Validity of calibration correction in Mode 1" UBYTE B_TRUE 1 100 0.00 1.00000000000 BIT_MASK 0x1 FORMAT "%13.11" ECU_ADDRESS 0x60002520 /end MEASUREMENT
/begin MEASUREMENT UEGO_DataSplyClsS1B1_I.flgFKal2Vld "Class instance of the functional class of FC UEGO_DataSplyCls for Bank 1 Sensor 1 / Validity of calibration correction in Mode 2" UBYTE B_TRUE 1 100 0.00 1.00000000000 BIT_MASK 0x1 FORMAT "%13.11" ECU_ADDRESS 0x60002521 /end MEASUREMENT
/begin MEASUREMENT UEGO_DataSplyClsS1B1_I.flgFKal3Vld "Class instance of the functional class of FC UEGO_DataSplyCls for Bank 1 Sensor 1 / Validity of calibration correction in Mode 3" UBYTE B_TRUE 1 100 0.00 1.00000000000 BIT_MASK 0x1 FORMAT "%13.11" ECU_ADDRESS 0x60002522 /end MEASUREMENT
/begin MEASUREMENT UEGO_DataSplyClsS1B1_I.flgIPmpActvd "Class instance of the functional class of FC UEGO_DataSplyCls for Bank 1 Sensor 1 / Pump current activated" UBYTE B_TRUE 1 100 0.00 1.00000000000 BIT_MASK 0x1 FORMAT "%13.11" ECU_ADDRESS 0x60002519 /end MEASUREMENT
/begin MEASUREMENT UEGO_DataSplyClsS1B1_I.flgISQrA "Class instance of the functional class of FC UEGO_DataSplyCls for Bank 1 Sensor 1 / Status of extented reference pulse accross Pump cell" UBYTE B_TRUE 1 100 0.00 1.00000000000 BIT_MASK 0x20 FORMAT "%13.11" ECU_ADDRESS 0x6000251F /end MEASUREMENT
/begin MEASUREMENT UEGO_DataSplyClsS1B1_I.flgISQrE "Class instance of the functional class of FC UEGO_DataSplyCls for Bank 1 Sensor 1 / Status of extented reference pulse accross Nernst cell" UBYTE B_TRUE 1 100 0.00 1.00000000000 BIT_MASK 0x40 FORMAT "%13.11" ECU_ADDRESS 0x6000251F /end MEASUREMENT
/begin MEASUREMENT UEGO_DataSplyClsS1B1_I.flgLCURR "Class instance of the functional class of FC UEGO_DataSplyCls for Bank 1 Sensor 1 / Status of LoupeCURR" UBYTE B_TRUE 1 100 0.00 1.00000000000 BIT_MASK 0x4 FORMAT "%13.11" ECU_ADDRESS 0x6000251E /end MEASUREMENT
/begin MEASUREMENT UEGO_DataSplyClsS1B1_I.flgLNMeas "Class instance of the functional class of FC UEGO_DataSplyCls for Bank 1 Sensor 1 / Status of LoupeN" UBYTE B_TRUE 1 100 0.00 1.00000000000 BIT_MASK 0x10 FORMAT "%13.11" ECU_ADDRESS 0x60002519 /end MEASUREMENT
/begin MEASUREMENT UEGO_DataSplyClsS1B1_I.flgLPMeas "Class instance of the functional class of FC UEGO_DataSplyCls for Bank 1 Sensor 1 / Status of LoupeP" UBYTE B_TRUE 1 100 0.00 1.00000000000 BIT_MASK 0x20 FORMAT "%13.11" ECU_ADDRESS 0x60002519 /end MEASUREMENT
/begin MEASUREMENT UEGO_DataSplyClsS1B1_I.flgLoupeCAL "Class instance of the functional class of FC UEGO_DataSplyCls for Bank 1 Sensor 1 / Status of LoupeCAL" UBYTE B_TRUE 1 100 0.00 1.00000000000 BIT_MASK 0x2 FORMAT "%13.11" ECU_ADDRESS 0x6000251E /end MEASUREMENT
/begin MEASUREMENT UEGO_DataSplyClsS1B1_I.flgLoupeG0 "Class instance of the functional class of FC UEGO_DataSplyCls for Bank 1 Sensor 1 / Status of LoupeG0" UBYTE B_TRUE 1 100 0.00 1.00000000000 BIT_MASK 0x80 FORMAT "%13.11" ECU_ADDRESS 0x60002516 /end MEASUREMENT
/begin MEASUREMENT UEGO_DataSplyClsS1B1_I.flgLstPckAbort "Class instance of the functional class of FC UEGO_DataSplyCls for Bank 1 Sensor 1 / Last packet transfer aborted" UBYTE B_TRUE 1 100 0.00 1.00000000000 BIT_MASK 0x40 FORMAT "%13.11" ECU_ADDRESS 0x60002516 /end MEASUREMENT
/begin MEASUREMENT UEGO_DataSplyClsS1B1_I.flgMKA "Class instance of the functional class of FC UEGO_DataSplyCls for Bank 1 Sensor 1 / Clamping structure of the pump cell active" UBYTE B_TRUE 1 100 0.00 1.00000000000 BIT_MASK 0x10 FORMAT "%13.11" ECU_ADDRESS 0x60002516 /end MEASUREMENT
/begin MEASUREMENT UEGO_DataSplyClsS1B1_I.flgMKE "Class instance of the functional class of FC UEGO_DataSplyCls for Bank 1 Sensor 1 / Clamping structure of the nerst cell active" UBYTE B_TRUE 1 100 0.00 1.00000000000 BIT_MASK 0x8 FORMAT "%13.11" ECU_ADDRESS 0x60002516 /end MEASUREMENT
/begin MEASUREMENT UEGO_DataSplyClsS1B1_I.flgNewIPmpDacPckAry "Class instance of the functional class of FC UEGO_DataSplyCls for Bank 1 Sensor 1 / Validity of the new IP packet" UBYTE B_TRUE 1 100 0.00 1.00000000000 BIT_MASK 0x80 FORMAT "%13.11" ECU_ADDRESS 0x6000251D /end MEASUREMENT
/begin MEASUREMENT UEGO_DataSplyClsS1B1_I.flgNewIPmpOK "Class instance of the functional class of FC UEGO_DataSplyCls for Bank 1 Sensor 1 / Validity condition IPOK" UBYTE B_TRUE 1 100 0.00 1.00000000000 BIT_MASK 0x40 FORMAT "%13.11" ECU_ADDRESS 0x60002519 /end MEASUREMENT
/begin MEASUREMENT UEGO_DataSplyClsS1B1_I.flgNewIPmpPckAry "Class instance of the functional class of FC UEGO_DataSplyCls for Bank 1 Sensor 1 / Validity of the new IP packet" UBYTE B_TRUE 1 100 0.00 1.00000000000 BIT_MASK 0x80 FORMAT "%13.11" ECU_ADDRESS 0x60002519 /end MEASUREMENT
/begin MEASUREMENT UEGO_DataSplyClsS1B1_I.flgNewIPmpTM "Class instance of the functional class of FC UEGO_DataSplyCls for Bank 1 Sensor 1 / Validity condition for register IPTM" UBYTE B_TRUE 1 100 0.00 1.00000000000 BIT_MASK 0x1 FORMAT "%13.11" ECU_ADDRESS 0x6000251A /end MEASUREMENT
/begin MEASUREMENT UEGO_DataSplyClsS1B1_I.flgNewPck "Class instance of the functional class of FC UEGO_DataSplyCls for Bank 1 Sensor 1 / A new packet is available" UBYTE B_TRUE 1 100 0.00 1.00000000000 BIT_MASK 0x2 FORMAT "%13.11" ECU_ADDRESS 0x6000251A /end MEASUREMENT
/begin MEASUREMENT UEGO_DataSplyClsS1B1_I.flgNewPckCstnc "Class instance of the functional class of FC UEGO_DataSplyCls for Bank 1 Sensor 1 / Consistency of the new packet information" UBYTE B_TRUE 1 100 0.00 1.00000000000 BIT_MASK 0x20 FORMAT "%13.11" ECU_ADDRESS 0x60002516 /end MEASUREMENT
/begin MEASUREMENT UEGO_DataSplyClsS1B1_I.flgNewPckMiss "Class instance of the functional class of FC UEGO_DataSplyCls for Bank 1 Sensor 1 / A new packet was missed" UBYTE B_TRUE 1 100 0.00 1.00000000000 BIT_MASK 0x8 FORMAT "%13.11" ECU_ADDRESS 0x6000251E /end MEASUREMENT
/begin MEASUREMENT UEGO_DataSplyClsS1B1_I.flgNewPckVld "Class instance of the functional class of FC UEGO_DataSplyCls for Bank 1 Sensor 1 / Validity of the new packet" UBYTE B_TRUE 1 100 0.00 1.00000000000 BIT_MASK 0x4 FORMAT "%13.11" ECU_ADDRESS 0x6000251A /end MEASUREMENT
/begin MEASUREMENT UEGO_DataSplyClsS1B1_I.flgNewTiPck "Class instance of the functional class of FC UEGO_DataSplyCls for Bank 1 Sensor 1 / Validity condition Time stamp UEGO" UBYTE B_TRUE 1 100 0.00 1.00000000000 BIT_MASK 0x8 FORMAT "%13.11" ECU_ADDRESS 0x6000251A /end MEASUREMENT
/begin MEASUREMENT UEGO_DataSplyClsS1B1_I.flgNewURmVG4MeasAryVld "Class instance of the functional class of FC UEGO_DataSplyCls for Bank 1 Sensor 1 / Validity condition for new URmVG4" UBYTE B_TRUE 1 100 0.00 1.00000000000 BIT_MASK 0x10 FORMAT "%13.11" ECU_ADDRESS 0x6000251F /end MEASUREMENT
/begin MEASUREMENT UEGO_DataSplyClsS1B1_I.flgNewUa2Pck "Class instance of the functional class of FC UEGO_DataSplyCls for Bank 1 Sensor 1 / Validity condition for new Ua2" UBYTE B_TRUE 1 100 0.00 1.00000000000 BIT_MASK 0x10 FORMAT "%13.11" ECU_ADDRESS 0x6000251A /end MEASUREMENT
/begin MEASUREMENT UEGO_DataSplyClsS1B1_I.flgNewUa31Pck "Class instance of the functional class of FC UEGO_DataSplyCls for Bank 1 Sensor 1 / Validity condition for new Ua31" UBYTE B_TRUE 1 100 0.00 1.00000000000 BIT_MASK 0x20 FORMAT "%13.11" ECU_ADDRESS 0x6000251A /end MEASUREMENT
/begin MEASUREMENT UEGO_DataSplyClsS1B1_I.flgNewUa32Pck "Class instance of the functional class of FC UEGO_DataSplyCls for Bank 1 Sensor 1 / Validity condition for new Ua32" UBYTE B_TRUE 1 100 0.00 1.00000000000 BIT_MASK 0x40 FORMAT "%13.11" ECU_ADDRESS 0x6000251A /end MEASUREMENT
/begin MEASUREMENT UEGO_DataSplyClsS1B1_I.flgNewUa33Pck "Class instance of the functional class of FC UEGO_DataSplyCls for Bank 1 Sensor 1 / Validity condition for new Ua33" UBYTE B_TRUE 1 100 0.00 1.00000000000 BIT_MASK 0x80 FORMAT "%13.11" ECU_ADDRESS 0x6000251A /end MEASUREMENT
/begin MEASUREMENT UEGO_DataSplyClsS1B1_I.flgNewUamPck "Class instance of the functional class of FC UEGO_DataSplyCls for Bank 1 Sensor 1 / Validity condition for new Uam" UBYTE B_TRUE 1 100 0.00 1.00000000000 BIT_MASK 0x80 FORMAT "%13.11" ECU_ADDRESS 0x6000251F /end MEASUREMENT
/begin MEASUREMENT UEGO_DataSplyClsS1B1_I.flgNewUapePck "Class instance of the functional class of FC UEGO_DataSplyCls for Bank 1 Sensor 1 / Validity condition for new Uape" UBYTE B_TRUE 1 100 0.00 1.00000000000 BIT_MASK 0x1 FORMAT "%13.11" ECU_ADDRESS 0x6000251B /end MEASUREMENT
/begin MEASUREMENT UEGO_DataSplyClsS1B1_I.flgNewUcalMaxPck "Class instance of the functional class of FC UEGO_DataSplyCls for Bank 1 Sensor 1 / Validity condition for new UcalMax" UBYTE B_TRUE 1 100 0.00 1.00000000000 BIT_MASK 0x1 FORMAT "%13.11" ECU_ADDRESS 0x60002517 /end MEASUREMENT
/begin MEASUREMENT UEGO_DataSplyClsS1B1_I.flgNewUcalPck "Class instance of the functional class of FC UEGO_DataSplyCls for Bank 1 Sensor 1 / Validity condition for new Ucal" UBYTE B_TRUE 1 100 0.00 1.00000000000 BIT_MASK 0x1 FORMAT "%13.11" ECU_ADDRESS 0x60002516 /end MEASUREMENT
/begin MEASUREMENT UEGO_DataSplyClsS1B1_I.flgNewUg0Pck "Class instance of the functional class of FC UEGO_DataSplyCls for Bank 1 Sensor 1 / Validity condition for new Ug0" UBYTE B_TRUE 1 100 0.00 1.00000000000 BIT_MASK 0x2 FORMAT "%13.11" ECU_ADDRESS 0x6000251B /end MEASUREMENT
/begin MEASUREMENT UEGO_DataSplyClsS1B1_I.flgNewUg0PckAry "Class instance of the functional class of FC UEGO_DataSplyCls for Bank 1 Sensor 1 / Validity condition for new Ug0" UBYTE B_TRUE 1 100 0.00 1.00000000000 BIT_MASK 0x20 FORMAT "%13.11" ECU_ADDRESS 0x60002517 /end MEASUREMENT
/begin MEASUREMENT UEGO_DataSplyClsS1B1_I.flgNewUg0aPck "Class instance of the functional class of FC UEGO_DataSplyCls for Bank 1 Sensor 1 / Validity condition for new Ug0a" UBYTE B_TRUE 1 100 0.00 1.00000000000 BIT_MASK 0x1 FORMAT "%13.11" ECU_ADDRESS 0x6000251F /end MEASUREMENT
/begin MEASUREMENT UEGO_DataSplyClsS1B1_I.flgNewUg0ePck "Class instance of the functional class of FC UEGO_DataSplyCls for Bank 1 Sensor 1 / Validity condition for new Ug0e" UBYTE B_TRUE 1 100 0.00 1.00000000000 BIT_MASK 0x2 FORMAT "%13.11" ECU_ADDRESS 0x6000251F /end MEASUREMENT
/begin MEASUREMENT UEGO_DataSplyClsS1B1_I.flgNewUg0iPck "Class instance of the functional class of FC UEGO_DataSplyCls for Bank 1 Sensor 1 / Validity condition for new Ug0i" UBYTE B_TRUE 1 100 0.00 1.00000000000 BIT_MASK 0x2 FORMAT "%13.11" ECU_ADDRESS 0x60002514 /end MEASUREMENT
/begin MEASUREMENT UEGO_DataSplyClsS1B1_I.flgNewUg0iPckAry "Class instance of the functional class of FC UEGO_DataSplyCls for Bank 1 Sensor 1 / Validity condition for new Ug0i" UBYTE B_TRUE 1 100 0.00 1.00000000000 BIT_MASK 0x2 FORMAT "%13.11" ECU_ADDRESS 0x60002517 /end MEASUREMENT
/begin MEASUREMENT UEGO_DataSplyClsS1B1_I.flgNewUg0iaiPck "Class instance of the functional class of FC UEGO_DataSplyCls for Bank 1 Sensor 1 / Validity condition for new Ug0iei" UBYTE B_TRUE 1 100 0.00 1.00000000000 BIT_MASK 0x4 FORMAT "%13.11" ECU_ADDRESS 0x60002519 /end MEASUREMENT
/begin MEASUREMENT UEGO_DataSplyClsS1B1_I.flgNewUg0ieiPck "Class instance of the functional class of FC UEGO_DataSplyCls for Bank 1 Sensor 1 / Validity condition for new Ug0iai" UBYTE B_TRUE 1 100 0.00 1.00000000000 BIT_MASK 0x8 FORMAT "%13.11" ECU_ADDRESS 0x60002519 /end MEASUREMENT
/begin MEASUREMENT UEGO_DataSplyClsS1B1_I.flgNewUg0ix7PckAry "Class instance of the functional class of FC UEGO_DataSplyCls for Bank 1 Sensor 1 / Validity condition for new Ug0ix7" UBYTE B_TRUE 1 100 0.00 1.00000000000 BIT_MASK 0x4 FORMAT "%13.11" ECU_ADDRESS 0x60002517 /end MEASUREMENT
/begin MEASUREMENT UEGO_DataSplyClsS1B1_I.flgNewUg0ix9PckAry "Class instance of the functional class of FC UEGO_DataSplyCls for Bank 1 Sensor 1 / Validity condition for new Ug0ix9" UBYTE B_TRUE 1 100 0.00 1.00000000000 BIT_MASK 0x8 FORMAT "%13.11" ECU_ADDRESS 0x60002517 /end MEASUREMENT
/begin MEASUREMENT UEGO_DataSplyClsS1B1_I.flgNewUg0ixPckAry "Class instance of the functional class of FC UEGO_DataSplyCls for Bank 1 Sensor 1 / Validity condition for new Ug0ix" UBYTE B_TRUE 1 100 0.00 1.00000000000 BIT_MASK 0x10 FORMAT "%13.11" ECU_ADDRESS 0x60002517 /end MEASUREMENT
/begin MEASUREMENT UEGO_DataSplyClsS1B1_I.flgNewUg0mPck "Class instance of the functional class of FC UEGO_DataSplyCls for Bank 1 Sensor 1 / Validity condition for new Ug0m" UBYTE B_TRUE 1 100 0.00 1.00000000000 BIT_MASK 0x4 FORMAT "%13.11" ECU_ADDRESS 0x6000251F /end MEASUREMENT
/begin MEASUREMENT UEGO_DataSplyClsS1B1_I.flgNewUgaPck "Class instance of the functional class of FC UEGO_DataSplyCls for Bank 1 Sensor 1 / Validity condition for new Uga" UBYTE B_TRUE 1 100 0.00 1.00000000000 BIT_MASK 0x4 FORMAT "%13.11" ECU_ADDRESS 0x6000251B /end MEASUREMENT
/begin MEASUREMENT UEGO_DataSplyClsS1B1_I.flgNewUgiPckAry "Class instance of the functional class of FC UEGO_DataSplyCls for Bank 1 Sensor 1 / Validity condition for new Ugi" UBYTE B_TRUE 1 100 0.00 1.00000000000 BIT_MASK 0x8 FORMAT "%13.11" ECU_ADDRESS 0x6000251B /end MEASUREMENT
/begin MEASUREMENT UEGO_DataSplyClsS1B1_I.flgNewUgkAvrgPck "Class instance of the functional class of FC UEGO_DataSplyCls for Bank 1 Sensor 1 / Validity condition for new Ugk" UBYTE B_TRUE 1 100 0.00 1.00000000000 BIT_MASK 0x10 FORMAT "%13.11" ECU_ADDRESS 0x6000251B /end MEASUREMENT
/begin MEASUREMENT UEGO_DataSplyClsS1B1_I.flgNewUguaPck "Class instance of the functional class of FC UEGO_DataSplyCls for Bank 1 Sensor 1 / Validity condition for new Ugua" UBYTE B_TRUE 1 100 0.00 1.00000000000 BIT_MASK 0x20 FORMAT "%13.11" ECU_ADDRESS 0x6000251B /end MEASUREMENT
/begin MEASUREMENT UEGO_DataSplyClsS1B1_I.flgNewUguaZ2Pck "Class instance of the functional class of FC UEGO_DataSplyCls for Bank 1 Sensor 1 / Validity condition for new Ugua in Z2" UBYTE B_TRUE 1 100 0.00 1.00000000000 BIT_MASK 0x40 FORMAT "%13.11" ECU_ADDRESS 0x6000251B /end MEASUREMENT
/begin MEASUREMENT UEGO_DataSplyClsS1B1_I.flgNewUguiPck "Class instance of the functional class of FC UEGO_DataSplyCls for Bank 1 Sensor 1 / Validity condition for new Ugui" UBYTE B_TRUE 1 100 0.00 1.00000000000 BIT_MASK 0x80 FORMAT "%13.11" ECU_ADDRESS 0x6000251B /end MEASUREMENT
/begin MEASUREMENT UEGO_DataSplyClsS1B1_I.flgNewUguiZ1Pck "Class instance of the functional class of FC UEGO_DataSplyCls for Bank 1 Sensor 1 / Validity condition for new Ugui in Z1" UBYTE B_TRUE 1 100 0.00 1.00000000000 BIT_MASK 0x1 FORMAT "%13.11" ECU_ADDRESS 0x6000251C /end MEASUREMENT
/begin MEASUREMENT UEGO_DataSplyClsS1B1_I.flgNewUi21PckAry "Class instance of the functional class of FC UEGO_DataSplyCls for Bank 1 Sensor 1 / Validity condition for new Ui21" UBYTE B_TRUE 1 100 0.00 1.00000000000 BIT_MASK 0x2 FORMAT "%13.11" ECU_ADDRESS 0x6000251C /end MEASUREMENT
/begin MEASUREMENT UEGO_DataSplyClsS1B1_I.flgNewUi22Pck "Class instance of the functional class of FC UEGO_DataSplyCls for Bank 1 Sensor 1 / Validity condition for new Ui22" UBYTE B_TRUE 1 100 0.00 1.00000000000 BIT_MASK 0x4 FORMAT "%13.11" ECU_ADDRESS 0x6000251C /end MEASUREMENT
/begin MEASUREMENT UEGO_DataSplyClsS1B1_I.flgNewUi23Pck "Class instance of the functional class of FC UEGO_DataSplyCls for Bank 1 Sensor 1 / Validity condition for new Ui23" UBYTE B_TRUE 1 100 0.00 1.00000000000 BIT_MASK 0x8 FORMAT "%13.11" ECU_ADDRESS 0x6000251C /end MEASUREMENT
/begin MEASUREMENT UEGO_DataSplyClsS1B1_I.flgNewUi24Pck "Class instance of the functional class of FC UEGO_DataSplyCls for Bank 1 Sensor 1 / Validity condition for new Ui24" UBYTE B_TRUE 1 100 0.00 1.00000000000 BIT_MASK 0x10 FORMAT "%13.11" ECU_ADDRESS 0x6000251C /end MEASUREMENT
/begin MEASUREMENT UEGO_DataSplyClsS1B1_I.flgNewUi4Pck "Class instance of the functional class of FC UEGO_DataSplyCls for Bank 1 Sensor 1 / Validity condition for new Ui4" UBYTE B_TRUE 1 100 0.00 1.00000000000 BIT_MASK 0x20 FORMAT "%13.11" ECU_ADDRESS 0x6000251C /end MEASUREMENT
/begin MEASUREMENT UEGO_DataSplyClsS1B1_I.flgNewUi4Z2Pck "Class instance of the functional class of FC UEGO_DataSplyCls for Bank 1 Sensor 1 / Validity condition for new Ui4 in Z2" UBYTE B_TRUE 1 100 0.00 1.00000000000 BIT_MASK 0x40 FORMAT "%13.11" ECU_ADDRESS 0x6000251C /end MEASUREMENT
/begin MEASUREMENT UEGO_DataSplyClsS1B1_I.flgNewUigPckAry "Class instance of the functional class of FC UEGO_DataSplyCls for Bank 1 Sensor 1 / Validity condition for new Uig" UBYTE B_TRUE 1 100 0.00 1.00000000000 BIT_MASK 0x8 FORMAT "%13.11" ECU_ADDRESS 0x6000251F /end MEASUREMENT
/begin MEASUREMENT UEGO_DataSplyClsS1B1_I.flgNewUigmkPckAry "Class instance of the functional class of FC UEGO_DataSplyCls for Bank 1 Sensor 1 / Validity condition for new Uigmk" UBYTE B_TRUE 1 100 0.00 1.00000000000 BIT_MASK 0x8 FORMAT "%13.11" ECU_ADDRESS 0x60002514 /end MEASUREMENT
/begin MEASUREMENT UEGO_DataSplyClsS1B1_I.flgNewUipcalAvrgPck "Class instance of the functional class of FC UEGO_DataSplyCls for Bank 1 Sensor 1 / Validity condition for new Uipcal" UBYTE B_TRUE 1 100 0.00 1.00000000000 BIT_MASK 0x80 FORMAT "%13.11" ECU_ADDRESS 0x6000251C /end MEASUREMENT
/begin MEASUREMENT UEGO_DataSplyClsS1B1_I.flgNewUn0Pck "Class instance of the functional class of FC UEGO_DataSplyCls for Bank 1 Sensor 1 / Validity condition for new Un0" UBYTE B_TRUE 1 100 0.00 1.00000000000 BIT_MASK 0x1 FORMAT "%13.11" ECU_ADDRESS 0x60002518 /end MEASUREMENT
/begin MEASUREMENT UEGO_DataSplyClsS1B1_I.flgNewUn0Pck4Ary "Class instance of the functional class of FC UEGO_DataSplyCls for Bank 1 Sensor 1 / Validity condition for new Un0" UBYTE B_TRUE 1 100 0.00 1.00000000000 BIT_MASK 0x20 FORMAT "%13.11" ECU_ADDRESS 0x6000251E /end MEASUREMENT
/begin MEASUREMENT UEGO_DataSplyClsS1B1_I.flgNewUn0Pck5Ary "Class instance of the functional class of FC UEGO_DataSplyCls for Bank 1 Sensor 1 / Validity condition for new Un0" UBYTE B_TRUE 1 100 0.00 1.00000000000 BIT_MASK 0x4 FORMAT "%13.11" ECU_ADDRESS 0x60002518 /end MEASUREMENT
/begin MEASUREMENT UEGO_DataSplyClsS1B1_I.flgNewUn0PckAry "Class instance of the functional class of FC UEGO_DataSplyCls for Bank 1 Sensor 1 / Validity condition for new Un0" UBYTE B_TRUE 1 100 0.00 1.00000000000 BIT_MASK 0x1 FORMAT "%13.11" ECU_ADDRESS 0x6000251D /end MEASUREMENT
/begin MEASUREMENT UEGO_DataSplyClsS1B1_I.flgNewUnPckAry "Class instance of the functional class of FC UEGO_DataSplyCls for Bank 1 Sensor 1 / Validity condition for new Un" UBYTE B_TRUE 1 100 0.00 1.00000000000 BIT_MASK 0x40 FORMAT "%13.11" ECU_ADDRESS 0x6000251E /end MEASUREMENT
/begin MEASUREMENT UEGO_DataSplyClsS1B1_I.flgNewUnSetPck "Class instance of the functional class of FC UEGO_DataSplyCls for Bank 1 Sensor 1 / Validity condition for new UnSet" UBYTE B_TRUE 1 100 0.00 1.00000000000 BIT_MASK 0x2 FORMAT "%13.11" ECU_ADDRESS 0x60002519 /end MEASUREMENT
/begin MEASUREMENT UEGO_DataSplyClsS1B1_I.flgNewUnx3PckAry "Class instance of the functional class of FC UEGO_DataSplyCls for Bank 1 Sensor 1 / Validity condition for new Unx3" UBYTE B_TRUE 1 100 0.00 1.00000000000 BIT_MASK 0x80 FORMAT "%13.11" ECU_ADDRESS 0x6000251E /end MEASUREMENT
/begin MEASUREMENT UEGO_DataSplyClsS1B1_I.flgNewUnx4PckAry "Class instance of the functional class of FC UEGO_DataSplyCls for Bank 1 Sensor 1 / Validity condition for new Unx4" UBYTE B_TRUE 1 100 0.00 1.00000000000 BIT_MASK 0x20 FORMAT "%13.11" ECU_ADDRESS 0x6000251D /end MEASUREMENT
/begin MEASUREMENT UEGO_DataSplyClsS1B1_I.flgNewUp0Pck "Class instance of the functional class of FC UEGO_DataSplyCls for Bank 1 Sensor 1 / Validity condition for new Up0" UBYTE B_TRUE 1 100 0.00 1.00000000000 BIT_MASK 0x40 FORMAT "%13.11" ECU_ADDRESS 0x60002517 /end MEASUREMENT
/begin MEASUREMENT UEGO_DataSplyClsS1B1_I.flgNewUp0Pck4 "Class instance of the functional class of FC UEGO_DataSplyCls for Bank 1 Sensor 1 / Validity condition for new Up0" UBYTE B_TRUE 1 100 0.00 1.00000000000 BIT_MASK 0x80 FORMAT "%13.11" ECU_ADDRESS 0x60002517 /end MEASUREMENT
/begin MEASUREMENT UEGO_DataSplyClsS1B1_I.flgNewUp0Pck5Ary "Class instance of the functional class of FC UEGO_DataSplyCls for Bank 1 Sensor 1 / Validity condition for new Up0" UBYTE B_TRUE 1 100 0.00 1.00000000000 BIT_MASK 0x2 FORMAT "%13.11" ECU_ADDRESS 0x60002515 /end MEASUREMENT
/begin MEASUREMENT UEGO_DataSplyClsS1B1_I.flgNewUp0PckAry "Class instance of the functional class of FC UEGO_DataSplyCls for Bank 1 Sensor 1 / Validity condition for new Up0" UBYTE B_TRUE 1 100 0.00 1.00000000000 BIT_MASK 0x2 FORMAT "%13.11" ECU_ADDRESS 0x60002516 /end MEASUREMENT
/begin MEASUREMENT UEGO_DataSplyClsS1B1_I.flgNewUpPckAry "Class instance of the functional class of FC UEGO_DataSplyCls for Bank 1 Sensor 1 / Validity condition for new Up" UBYTE B_TRUE 1 100 0.00 1.00000000000 BIT_MASK 0x2 FORMAT "%13.11" ECU_ADDRESS 0x6000251D /end MEASUREMENT
/begin MEASUREMENT UEGO_DataSplyClsS1B1_I.flgNewUpx3PckAry "Class instance of the functional class of FC UEGO_DataSplyCls for Bank 1 Sensor 1 / Validity condition for new Upx3" UBYTE B_TRUE 1 100 0.00 1.00000000000 BIT_MASK 0x40 FORMAT "%13.11" ECU_ADDRESS 0x6000251D /end MEASUREMENT
/begin MEASUREMENT UEGO_DataSplyClsS1B1_I.flgNewUpx4PckAry "Class instance of the functional class of FC UEGO_DataSplyCls for Bank 1 Sensor 1 / Validity condition for new Upx4" UBYTE B_TRUE 1 100 0.00 1.00000000000 BIT_MASK 0x2 FORMAT "%13.11" ECU_ADDRESS 0x60002518 /end MEASUREMENT
/begin MEASUREMENT UEGO_DataSplyClsS1B1_I.flgNewUriaPckVld "Class instance of the functional class of FC UEGO_DataSplyCls for Bank 1 Sensor 1 / Validity condition for new Uria" UBYTE B_TRUE 1 100 0.00 1.00000000000 BIT_MASK 0x4 FORMAT "%13.11" ECU_ADDRESS 0x6000251D /end MEASUREMENT
/begin MEASUREMENT UEGO_DataSplyClsS1B1_I.flgNewUriePckAry "Class instance of the functional class of FC UEGO_DataSplyCls for Bank 1 Sensor 1 / Validity condition for new Urie" UBYTE B_TRUE 1 100 0.00 1.00000000000 BIT_MASK 0x8 FORMAT "%13.11" ECU_ADDRESS 0x6000251D /end MEASUREMENT
/begin MEASUREMENT UEGO_DataSplyClsS1B1_I.flgNewUx6PckAry "Class instance of the functional class of FC UEGO_DataSplyCls for Bank 1 Sensor 1 / Validity condition for new Ux6 voltage" UBYTE B_TRUE 1 100 0.00 1.00000000000 BIT_MASK 0x8 FORMAT "%13.11" ECU_ADDRESS 0x60002518 /end MEASUREMENT
/begin MEASUREMENT UEGO_DataSplyClsS1B1_I.flgNewUx7PckAry "Class instance of the functional class of FC UEGO_DataSplyCls for Bank 1 Sensor 1 / Validity condition for new Ux7 voltage" UBYTE B_TRUE 1 100 0.00 1.00000000000 BIT_MASK 0x10 FORMAT "%13.11" ECU_ADDRESS 0x60002518 /end MEASUREMENT
/begin MEASUREMENT UEGO_DataSplyClsS1B1_I.flgNewUx8PckAry "Class instance of the functional class of FC UEGO_DataSplyCls for Bank 1 Sensor 1 / Validity condition for new Ux8 voltage" UBYTE B_TRUE 1 100 0.00 1.00000000000 BIT_MASK 0x20 FORMAT "%13.11" ECU_ADDRESS 0x60002518 /end MEASUREMENT
/begin MEASUREMENT UEGO_DataSplyClsS1B1_I.flgNewUx9PckAry "Class instance of the functional class of FC UEGO_DataSplyCls for Bank 1 Sensor 1 / Validity condition for new Ux9 voltage" UBYTE B_TRUE 1 100 0.00 1.00000000000 BIT_MASK 0x40 FORMAT "%13.11" ECU_ADDRESS 0x60002518 /end MEASUREMENT
/begin MEASUREMENT UEGO_DataSplyClsS1B1_I.flgNewUxPckAry "Class instance of the functional class of FC UEGO_DataSplyCls for Bank 1 Sensor 1 / Validity condition for new Ux voltage" UBYTE B_TRUE 1 100 0.00 1.00000000000 BIT_MASK 0x80 FORMAT "%13.11" ECU_ADDRESS 0x60002518 /end MEASUREMENT
/begin MEASUREMENT UEGO_DataSplyClsS1B1_I.flgReStable "Class instance of the functional class of FC UEGO_DataSplyCls for Bank 1 Sensor 1 / Status information of the stable Re switch" UBYTE B_TRUE 1 100 0.00 1.00000000000 BIT_MASK 0x1 FORMAT "%13.11" ECU_ADDRESS 0x60002515 /end MEASUREMENT
/begin MEASUREMENT UEGO_DataSplyClsS1B1_I.flgSngCell "Class instance of the functional class of FC UEGO_DataSplyCls for Bank 1 Sensor 1 / Status of Single cell configuration" UBYTE B_TRUE 1 100 0.00 1.00000000000 BIT_MASK 0x10 FORMAT "%13.11" ECU_ADDRESS 0x6000251E /end MEASUREMENT
/begin MEASUREMENT UEGO_DataSplyClsS1B1_I.flgUical0Vld "Class instance of the functional class of FC UEGO_DataSplyCls for Bank 1 Sensor 1 / Validity of the Uical0 measurement" UBYTE B_TRUE 1 100 0.00 1.00000000000 BIT_MASK 0x4 FORMAT "%13.11" ECU_ADDRESS 0x60002515 /end MEASUREMENT
/begin MEASUREMENT UEGO_DataSplyClsS1B1_I.flgUicalVld "Class instance of the functional class of FC UEGO_DataSplyCls for Bank 1 Sensor 1 / Validity of the Uical measurement" UBYTE B_TRUE 1 100 0.00 1.00000000000 BIT_MASK 0x8 FORMAT "%13.11" ECU_ADDRESS 0x60002515 /end MEASUREMENT
/begin MEASUREMENT UEGO_DataSplyClsS1B1_I.flgUoffipe1Vld "Class instance of the functional class of FC UEGO_DataSplyCls for Bank 1 Sensor 1 / flgUoffipe1Vld" UBYTE B_TRUE 1 100 0.00 1.00000000000 BIT_MASK 0x1 FORMAT "%13.11" ECU_ADDRESS 0x60002523 /end MEASUREMENT
/begin MEASUREMENT UEGO_DataSplyClsS1B1_I.flgUoffipe2Vld "Class instance of the functional class of FC UEGO_DataSplyCls for Bank 1 Sensor 1 / flgUoffipe2Vld" UBYTE B_TRUE 1 100 0.00 1.00000000000 BIT_MASK 0x1 FORMAT "%13.11" ECU_ADDRESS 0x60002524 /end MEASUREMENT
/begin MEASUREMENT UEGO_DataSplyClsS1B1_I.flgUoffipe3Vld "Class instance of the functional class of FC UEGO_DataSplyCls for Bank 1 Sensor 1 / flgUoffipe3Vld" UBYTE B_TRUE 1 100 0.00 1.00000000000 BIT_MASK 0x1 FORMAT "%13.11" ECU_ADDRESS 0x60002525 /end MEASUREMENT
/begin MEASUREMENT UEGO_DataSplyClsS1B1_I.flgUoffvcc1Vld "Class instance of the functional class of FC UEGO_DataSplyCls for Bank 1 Sensor 1 / flgUoffvcc1Vld" UBYTE B_TRUE 1 100 0.00 1.00000000000 BIT_MASK 0x1 FORMAT "%13.11" ECU_ADDRESS 0x60002526 /end MEASUREMENT
/begin MEASUREMENT UEGO_DataSplyClsS1B1_I.flgUoffvcc2Vld "Class instance of the functional class of FC UEGO_DataSplyCls for Bank 1 Sensor 1 / Validity of the flgUoffvcc2Vld measurement" UBYTE B_TRUE 1 100 0.00 1.00000000000 BIT_MASK 0x1 FORMAT "%13.11" ECU_ADDRESS 0x60002527 /end MEASUREMENT
/begin MEASUREMENT UEGO_DataSplyClsS1B1_I.flgUoffvcc3Vld "Class instance of the functional class of FC UEGO_DataSplyCls for Bank 1 Sensor 1 / Validity of the flgUoffvcc3Vld measurement" UBYTE B_TRUE 1 100 0.00 1.00000000000 BIT_MASK 0x1 FORMAT "%13.11" ECU_ADDRESS 0x60002528 /end MEASUREMENT
/begin MEASUREMENT UEGO_DataSplyClsS1B1_I.flgUriaMeas "Class instance of the functional class of FC UEGO_DataSplyCls for Bank 1 Sensor 1 / Status of the availability Uria measurements" UBYTE B_TRUE 1 100 0.00 1.00000000000 BIT_MASK 0x10 FORMAT "%13.11" ECU_ADDRESS 0x6000251D /end MEASUREMENT
/begin MEASUREMENT UEGO_DataSplyClsS1B1_I.nrIPmpDacPckAry "Class instance of the functional class of FC UEGO_DataSplyCls for Bank 1 Sensor 1 / ADC measurement of Pump current" UBYTE dez 1 100 0.00 255.0 FORMAT "%5.1" ECU_ADDRESS 0x60002529 /end MEASUREMENT
/begin MEASUREMENT UEGO_DataSplyClsS1B1_I.nrIpPckAry "Class instance of the functional class of FC UEGO_DataSplyCls for Bank 1 Sensor 1 / Number of pump current measurements" UBYTE dez 1 100 0.00 255.0 FORMAT "%5.1" ECU_ADDRESS 0x6000252A /end MEASUREMENT
/begin MEASUREMENT UEGO_DataSplyClsS1B1_I.nrModeMeas "Class instance of the functional class of FC UEGO_DataSplyCls for Bank 1 Sensor 1 / Measured ASIC Mode" UBYTE UEGO_AsicState_COMPU_VERB 1 100 0.00 7.00000000000 FORMAT "%13.11" ECU_ADDRESS 0x6000252B /end MEASUREMENT
/begin MEASUREMENT UEGO_DataSplyClsS1B1_I.nrRamFailPosn "Class instance of the functional class of FC UEGO_DataSplyCls for Bank 1 Sensor 1 / RAM position at which the ASIC has shut off in error case" UBYTE dez 1 100 0.00 255.0 FORMAT "%5.1" ECU_ADDRESS 0x6000252C /end MEASUREMENT
/begin MEASUREMENT UEGO_DataSplyClsS1B1_I.nrRamMod "Class instance of the functional class of FC UEGO_DataSplyCls for Bank 1 Sensor 1 / Register RAM mode" UWORD dez 1 100 0.00 65535.00 FORMAT "%8.2" ECU_ADDRESS 0x6000252E /end MEASUREMENT
/begin MEASUREMENT UEGO_DataSplyClsS1B1_I.nrRamRegMod "Class instance of the functional class of FC UEGO_DataSplyCls for Bank 1 Sensor 1 / Register RAM mode" UWORD dez 1 100 0.00 65535.00 FORMAT "%8.2" ECU_ADDRESS 0x60002530 /end MEASUREMENT
/begin MEASUREMENT UEGO_DataSplyClsS1B1_I.nrRamSts1 "Class instance of the functional class of FC UEGO_DataSplyCls for Bank 1 Sensor 1 / Value of the STATUS?Word I" UWORD dez 1 100 0.00 65535.00 FORMAT "%8.2" ECU_ADDRESS 0x60002532 /end MEASUREMENT
/begin MEASUREMENT UEGO_DataSplyClsS1B1_I.nrRamSts2 "Class instance of the functional class of FC UEGO_DataSplyCls for Bank 1 Sensor 1 / Value of the STATUS?Word II" UWORD dez 1 100 0.00 65535.00 FORMAT "%8.2" ECU_ADDRESS 0x60002534 /end MEASUREMENT
/begin MEASUREMENT UEGO_DataSplyClsS1B1_I.nrRamSts3 "Class instance of the functional class of FC UEGO_DataSplyCls for Bank 1 Sensor 1 / Value of the STATUS?Word III" UWORD dez 1 100 0.00 65535.00 FORMAT "%8.2" ECU_ADDRESS 0x60002536 /end MEASUREMENT
/begin MEASUREMENT UEGO_DataSplyClsS1B1_I.nrURmVG4PckAry "Class instance of the functional class of FC UEGO_DataSplyCls for Bank 1 Sensor 1 / Number of URmVG4 measurements" UBYTE dez 1 100 0.00 255.0 FORMAT "%5.1" ECU_ADDRESS 0x60002538 /end MEASUREMENT
/begin MEASUREMENT UEGO_DataSplyClsS1B1_I.nrUa2PckAry "Class instance of the functional class of FC UEGO_DataSplyCls for Bank 1 Sensor 1 / Number of Ua2 measurements" UBYTE dez 1 100 0.00 255.0 FORMAT "%5.1" ECU_ADDRESS 0x60002539 /end MEASUREMENT
/begin MEASUREMENT UEGO_DataSplyClsS1B1_I.nrUcalMaxCorrd "Class instance of the functional class of FC UEGO_DataSplyCls for Bank 1 Sensor 1 / Number of measured UcalMax for the voltage correction" SWORD dez 1 100 -32768.00 32767.00 FORMAT "%8.2" ECU_ADDRESS 0x6000253A /end MEASUREMENT
/begin MEASUREMENT UEGO_DataSplyClsS1B1_I.nrUg0PckAry "Class instance of the functional class of FC UEGO_DataSplyCls for Bank 1 Sensor 1 / Number of Ug0 measurements" UBYTE dez 1 100 0.00 255.0 FORMAT "%5.1" ECU_ADDRESS 0x6000253C /end MEASUREMENT
/begin MEASUREMENT UEGO_DataSplyClsS1B1_I.nrUg0iPckAry "Class instance of the functional class of FC UEGO_DataSplyCls for Bank 1 Sensor 1 / Number of Ug0i measurements" UBYTE dez 1 100 0.00 255.0 FORMAT "%5.1" ECU_ADDRESS 0x6000253D /end MEASUREMENT
/begin MEASUREMENT UEGO_DataSplyClsS1B1_I.nrUg0ix7PckAry "Class instance of the functional class of FC UEGO_DataSplyCls for Bank 1 Sensor 1 / Number of Ug0ix7 measurements" UBYTE dez 1 100 0.00 255.0 FORMAT "%5.1" ECU_ADDRESS 0x6000253E /end MEASUREMENT
/begin MEASUREMENT UEGO_DataSplyClsS1B1_I.nrUg0ix9PckAry "Class instance of the functional class of FC UEGO_DataSplyCls for Bank 1 Sensor 1 / Number of Ug0ix9 measurements" UBYTE dez 1 100 0.00 255.0 FORMAT "%5.1" ECU_ADDRESS 0x6000253F /end MEASUREMENT
/begin MEASUREMENT UEGO_DataSplyClsS1B1_I.nrUg0ixPckAry "Class instance of the functional class of FC UEGO_DataSplyCls for Bank 1 Sensor 1 / Number of Ug0ix measurements" UBYTE dez 1 100 0.00 255.0 FORMAT "%5.1" ECU_ADDRESS 0x60002540 /end MEASUREMENT
/begin MEASUREMENT UEGO_DataSplyClsS1B1_I.nrUgaPckAry "Class instance of the functional class of FC UEGO_DataSplyCls for Bank 1 Sensor 1 / Number of Uga measurements" UBYTE dez 1 100 0.00 255.0 FORMAT "%5.1" ECU_ADDRESS 0x60002541 /end MEASUREMENT
/begin MEASUREMENT UEGO_DataSplyClsS1B1_I.nrUgiPckAry "Class instance of the functional class of FC UEGO_DataSplyCls for Bank 1 Sensor 1 / Number of Ugi measurements" UBYTE dez 1 100 0.00 255.0 FORMAT "%5.1" ECU_ADDRESS 0x60002542 /end MEASUREMENT
/begin MEASUREMENT UEGO_DataSplyClsS1B1_I.nrUi21PckAry "Class instance of the functional class of FC UEGO_DataSplyCls for Bank 1 Sensor 1 / Number of Ui21 measurements" UBYTE dez 1 100 0.00 255.0 FORMAT "%5.1" ECU_ADDRESS 0x60002543 /end MEASUREMENT
/begin MEASUREMENT UEGO_DataSplyClsS1B1_I.nrUical0PckCorrd "Class instance of the functional class of FC UEGO_DataSplyCls for Bank 1 Sensor 1 / Number of measured UICal0 for the voltage correction" SWORD dez 1 100 -32768.00 32767.00 FORMAT "%8.2" ECU_ADDRESS 0x60002544 /end MEASUREMENT
/begin MEASUREMENT UEGO_DataSplyClsS1B1_I.nrUicalPckCorrd "Class instance of the functional class of FC UEGO_DataSplyCls for Bank 1 Sensor 1 / Number of measured UICal for the voltage correction" SWORD dez 1 100 -32768.00 32767.00 FORMAT "%8.2" ECU_ADDRESS 0x60002546 /end MEASUREMENT
/begin MEASUREMENT UEGO_DataSplyClsS1B1_I.nrUigPckAry "Class instance of the functional class of FC UEGO_DataSplyCls for Bank 1 Sensor 1 / Number of Uig measurements" UBYTE dez 1 100 0.00 255.0 FORMAT "%5.1" ECU_ADDRESS 0x60002548 /end MEASUREMENT
/begin MEASUREMENT UEGO_DataSplyClsS1B1_I.nrUigmkPckAry "Class instance of the functional class of FC UEGO_DataSplyCls for Bank 1 Sensor 1 / Number of Uigmk measurements" UBYTE dez 1 100 0.00 255.0 FORMAT "%5.1" ECU_ADDRESS 0x60002549 /end MEASUREMENT
/begin MEASUREMENT UEGO_DataSplyClsS1B1_I.nrUn0Pck4Ary "Class instance of the functional class of FC UEGO_DataSplyCls for Bank 1 Sensor 1 / Number of Un0 measurements" UBYTE dez 1 100 0.00 255.0 FORMAT "%5.1" ECU_ADDRESS 0x6000254A /end MEASUREMENT
/begin MEASUREMENT UEGO_DataSplyClsS1B1_I.nrUn0Pck5Ary "Class instance of the functional class of FC UEGO_DataSplyCls for Bank 1 Sensor 1 / Number of Un0 measurements" UBYTE dez 1 100 0.00 255.0 FORMAT "%5.1" ECU_ADDRESS 0x6000254B /end MEASUREMENT
/begin MEASUREMENT UEGO_DataSplyClsS1B1_I.nrUn0PckAry "Class instance of the functional class of FC UEGO_DataSplyCls for Bank 1 Sensor 1 / Number of Un0 measurements" UBYTE dez 1 100 0.00 255.0 FORMAT "%5.1" ECU_ADDRESS 0x6000254C /end MEASUREMENT
/begin MEASUREMENT UEGO_DataSplyClsS1B1_I.nrUnPckAry "Class instance of the functional class of FC UEGO_DataSplyCls for Bank 1 Sensor 1 / Number of Un measurements" UBYTE dez 1 100 0.00 255.0 FORMAT "%5.1" ECU_ADDRESS 0x6000254D /end MEASUREMENT
/begin MEASUREMENT UEGO_DataSplyClsS1B1_I.nrUnx3PckAry "Class instance of the functional class of FC UEGO_DataSplyCls for Bank 1 Sensor 1 / Number of Unx3 measurements" UBYTE dez 1 100 0.00 255.0 FORMAT "%5.1" ECU_ADDRESS 0x6000254E /end MEASUREMENT
/begin MEASUREMENT UEGO_DataSplyClsS1B1_I.nrUnx4PckAry "Class instance of the functional class of FC UEGO_DataSplyCls for Bank 1 Sensor 1 / Number of Unx4 measurements" UBYTE dez 1 100 0.00 255.0 FORMAT "%5.1" ECU_ADDRESS 0x6000254F /end MEASUREMENT
/begin MEASUREMENT UEGO_DataSplyClsS1B1_I.nrUoffipe1 "Class instance of the functional class of FC UEGO_DataSplyCls for Bank 1 Sensor 1 / ADC value of the offset measurement of the IPE?pin with amplifier mode 1" SWORD dez 1 100 -32768.00 32767.00 FORMAT "%8.2" ECU_ADDRESS 0x60002550 /end MEASUREMENT
/begin MEASUREMENT UEGO_DataSplyClsS1B1_I.nrUoffipe2 "Class instance of the functional class of FC UEGO_DataSplyCls for Bank 1 Sensor 1 / ADC value of the offset measurement of the IPE?pin with amplifier mode 2" SWORD dez 1 100 -32768.00 32767.00 FORMAT "%8.2" ECU_ADDRESS 0x60002552 /end MEASUREMENT
/begin MEASUREMENT UEGO_DataSplyClsS1B1_I.nrUoffipe3 "Class instance of the functional class of FC UEGO_DataSplyCls for Bank 1 Sensor 1 / ADC value of the offset measurement of the IPE?pin with amplifier mode 3" SWORD dez 1 100 -32768.00 32767.00 FORMAT "%8.2" ECU_ADDRESS 0x60002554 /end MEASUREMENT
/begin MEASUREMENT UEGO_DataSplyClsS1B1_I.nrUoffvcc1 "Class instance of the functional class of FC UEGO_DataSplyCls for Bank 1 Sensor 1 / Data Uoffvcc1" SWORD dez 1 100 -32768.00 32767.00 FORMAT "%8.2" ECU_ADDRESS 0x60002556 /end MEASUREMENT
/begin MEASUREMENT UEGO_DataSplyClsS1B1_I.nrUoffvcc2 "Class instance of the functional class of FC UEGO_DataSplyCls for Bank 1 Sensor 1 / Data Uoffvcc2" SWORD dez 1 100 -32768.00 32767.00 FORMAT "%8.2" ECU_ADDRESS 0x60002558 /end MEASUREMENT
/begin MEASUREMENT UEGO_DataSplyClsS1B1_I.nrUoffvcc3 "Class instance of the functional class of FC UEGO_DataSplyCls for Bank 1 Sensor 1 / Data Uoffvcc3" SWORD dez 1 100 -32768.00 32767.00 FORMAT "%8.2" ECU_ADDRESS 0x6000255A /end MEASUREMENT
/begin MEASUREMENT UEGO_DataSplyClsS1B1_I.nrUp0Pck5Ary "Class instance of the functional class of FC UEGO_DataSplyCls for Bank 1 Sensor 1 / Number of Up0 measurements" UBYTE dez 1 100 0.00 255.0 FORMAT "%5.1" ECU_ADDRESS 0x6000255C /end MEASUREMENT
/begin MEASUREMENT UEGO_DataSplyClsS1B1_I.nrUp0PckAry "Class instance of the functional class of FC UEGO_DataSplyCls for Bank 1 Sensor 1 / Number of Up0 measurements" UBYTE dez 1 100 0.00 255.0 FORMAT "%5.1" ECU_ADDRESS 0x6000255D /end MEASUREMENT
/begin MEASUREMENT UEGO_DataSplyClsS1B1_I.nrUpPckAry "Class instance of the functional class of FC UEGO_DataSplyCls for Bank 1 Sensor 1 / Number of Up measurements" UBYTE dez 1 100 0.00 255.0 FORMAT "%5.1" ECU_ADDRESS 0x6000255E /end MEASUREMENT
/begin MEASUREMENT UEGO_DataSplyClsS1B1_I.nrUpx3PckAry "Class instance of the functional class of FC UEGO_DataSplyCls for Bank 1 Sensor 1 / Number of Upx3 measurements" UBYTE dez 1 100 0.00 255.0 FORMAT "%5.1" ECU_ADDRESS 0x6000255F /end MEASUREMENT
/begin MEASUREMENT UEGO_DataSplyClsS1B1_I.nrUpx4PckAry "Class instance of the functional class of FC UEGO_DataSplyCls for Bank 1 Sensor 1 / Number of Upx4 measurements" UBYTE dez 1 100 0.00 255.0 FORMAT "%5.1" ECU_ADDRESS 0x60002560 /end MEASUREMENT
/begin MEASUREMENT UEGO_DataSplyClsS1B1_I.nrUriePckAry "Class instance of the functional class of FC UEGO_DataSplyCls for Bank 1 Sensor 1 / Number of Urie measurements" UBYTE dez 1 100 0.00 255.0 FORMAT "%5.1" ECU_ADDRESS 0x60002561 /end MEASUREMENT
/begin MEASUREMENT UEGO_DataSplyClsS1B1_I.nrUx6PckAry "Class instance of the functional class of FC UEGO_DataSplyCls for Bank 1 Sensor 1 / Number of Ux6 measurements" UBYTE dez 1 100 0.00 255.0 FORMAT "%5.1" ECU_ADDRESS 0x60002562 /end MEASUREMENT
/begin MEASUREMENT UEGO_DataSplyClsS1B1_I.nrUx7PckAry "Class instance of the functional class of FC UEGO_DataSplyCls for Bank 1 Sensor 1 / Number of Ux7 measurements" UBYTE dez 1 100 0.00 255.0 FORMAT "%5.1" ECU_ADDRESS 0x60002563 /end MEASUREMENT
/begin MEASUREMENT UEGO_DataSplyClsS1B1_I.nrUx8PckAry "Class instance of the functional class of FC UEGO_DataSplyCls for Bank 1 Sensor 1 / Number of Ux8 measurements" UBYTE dez 1 100 0.00 255.0 FORMAT "%5.1" ECU_ADDRESS 0x60002564 /end MEASUREMENT
/begin MEASUREMENT UEGO_DataSplyClsS1B1_I.nrUx9PckAry "Class instance of the functional class of FC UEGO_DataSplyCls for Bank 1 Sensor 1 / Number of Ux9 measurements" UBYTE dez 1 100 0.00 255.0 FORMAT "%5.1" ECU_ADDRESS 0x60002565 /end MEASUREMENT
/begin MEASUREMENT UEGO_DataSplyClsS1B1_I.nrUxPckAry "Class instance of the functional class of FC UEGO_DataSplyCls for Bank 1 Sensor 1 / Number of Ux measurements" UBYTE dez 1 100 0.00 255.0 FORMAT "%5.1" ECU_ADDRESS 0x60002566 /end MEASUREMENT
/begin MEASUREMENT UEGO_DataSplyClsS1B1_I.stIPmpOK "Class instance of the functional class of FC UEGO_DataSplyCls for Bank 1 Sensor 1 / State of IPOK" UWORD OneToOne 1 100 0.00 65535.00 FORMAT "%8.2" ECU_ADDRESS 0x60002568 /end MEASUREMENT
/begin MEASUREMENT UEGO_DataSplyClsS1B1_I.stIPmpTM "Class instance of the functional class of FC UEGO_DataSplyCls for Bank 1 Sensor 1 / Register IPTM" UWORD OneToOne 1 100 0.00 65535.00 FORMAT "%8.2" ECU_ADDRESS 0x6000256A /end MEASUREMENT
/begin MEASUREMENT UEGO_DataSplyClsS1B1_I.stIPmpTM2L "Class instance of the functional class of FC UEGO_DataSplyCls for Bank 1 Sensor 1 / Bit header on TM2 Lean activation of the 15 individual cycles for UEGO" UWORD OneToOne 1 100 0.00 65535.00 FORMAT "%8.2" ECU_ADDRESS 0x6000256C /end MEASUREMENT
/begin MEASUREMENT UEGO_DataSplyClsS1B1_I.stIPmpTM2R "Class instance of the functional class of FC UEGO_DataSplyCls for Bank 1 Sensor 1 / Bit header on TM2 Rich activation of the 15 individual cycles for UEGO" UWORD OneToOne 1 100 0.00 65535.00 FORMAT "%8.2" ECU_ADDRESS 0x6000256E /end MEASUREMENT
/begin MEASUREMENT UEGO_DataSplyClsS1B1_I.stLsmRetValMod "Class instance of the functional class of FC UEGO_DataSplyCls for Bank 1 Sensor 1 / Return value of LSM when demanding the register MODE" ULONG dez 1 100 0.00 4294967295.00 FORMAT "%13.2" ECU_ADDRESS 0x60002570 /end MEASUREMENT
/begin MEASUREMENT UEGO_DataSplyClsS1B1_I.stMKMeas "Class instance of the functional class of FC UEGO_DataSplyCls for Bank 1 Sensor 1 / Clamping configuration of the ASIC" UBYTE dez 1 100 0.00 255.0 FORMAT "%5.1" ECU_ADDRESS 0x60002574 /end MEASUREMENT
/begin MEASUREMENT UEGO_DataSplyClsS1B1_I.stOFFMeas "Class instance of the functional class of FC UEGO_DataSplyCls for Bank 1 Sensor 1 / Setting of OFF in the register MODE" UBYTE dez 1 100 0.00 255.0 FORMAT "%5.1" ECU_ADDRESS 0x60002575 /end MEASUREMENT
/begin MEASUREMENT UEGO_DataSplyClsS1B1_I.stOPTMeas "Class instance of the functional class of FC UEGO_DataSplyCls for Bank 1 Sensor 1 / Setting of OPT in the register MODE" UBYTE dez 1 100 0.00 255.0 FORMAT "%5.1" ECU_ADDRESS 0x60002576 /end MEASUREMENT
/begin MEASUREMENT UEGO_DataSplyClsS1B1_I.stREFMeas "Class instance of the functional class of FC UEGO_DataSplyCls for Bank 1 Sensor 1 / Setting of REF in the register MODE" UBYTE dez 1 100 0.00 255.0 FORMAT "%5.1" ECU_ADDRESS 0x60002577 /end MEASUREMENT
/begin MEASUREMENT UEGO_DataSplyClsS1B1_I.stUa2PckAry "Class instance of the functional class of FC UEGO_DataSplyCls for Bank 1 Sensor 1 / Status word to display the validity field for Ua2 Array" UBYTE OneToOne 1 100 0.00 255.0 FORMAT "%5.1" ECU_ADDRESS 0x60002578 /end MEASUREMENT
/begin MEASUREMENT UEGO_DataSplyClsS1B1_I.stUa2Z1PckAry "Class instance of the functional class of FC UEGO_DataSplyCls for Bank 1 Sensor 1 / Status word to display Ua2 is measured when Z1 circuit is active" UBYTE OneToOne 1 100 0.00 255.0 FORMAT "%5.1" ECU_ADDRESS 0x60002579 /end MEASUREMENT
/begin MEASUREMENT UEGO_DataSplyClsS1B1_I.stUg0iPckAry "Class instance of the functional class of FC UEGO_DataSplyCls for Bank 1 Sensor 1 / Status word to display the validity field for Ug0i Array" UBYTE OneToOne 1 100 0.00 255.0 FORMAT "%5.1" ECU_ADDRESS 0x6000257A /end MEASUREMENT
/begin MEASUREMENT UEGO_DataSplyClsS1B1_I.stUg0ix7IActvPckAry "Class instance of the functional class of FC UEGO_DataSplyCls for Bank 1 Sensor 1 / Status word to display the reference current active in the respective for Ug0ix7 Array" UBYTE OneToOne 1 100 0.00 255.0 FORMAT "%5.1" ECU_ADDRESS 0x6000257B /end MEASUREMENT
/begin MEASUREMENT UEGO_DataSplyClsS1B1_I.stUg0ix7PmpIActvPckAry "Class instance of the functional class of FC UEGO_DataSplyCls for Bank 1 Sensor 1 / Status word to display the switch is closed across pump active in the respective for Ug0ix7 Array" UBYTE OneToOne 1 100 0.00 255.0 FORMAT "%5.1" ECU_ADDRESS 0x6000257C /end MEASUREMENT
/begin MEASUREMENT UEGO_DataSplyClsS1B1_I.stUg0ix9IActvPckAry "Class instance of the functional class of FC UEGO_DataSplyCls for Bank 1 Sensor 1 / Status word to display the reference current active in the respective for Ug0ix9 Array" UBYTE OneToOne 1 100 0.00 255.0 FORMAT "%5.1" ECU_ADDRESS 0x6000257D /end MEASUREMENT
/begin MEASUREMENT UEGO_DataSplyClsS1B1_I.stUg0ix9PmpIActvPckAry "Class instance of the functional class of FC UEGO_DataSplyCls for Bank 1 Sensor 1 / Status word to display the switch is closed across pump active in the respective for Ug0ix9 Array" UBYTE OneToOne 1 100 0.00 255.0 FORMAT "%5.1" ECU_ADDRESS 0x6000257E /end MEASUREMENT
/begin MEASUREMENT UEGO_DataSplyClsS1B1_I.stUg0ixIActvPckAry "Class instance of the functional class of FC UEGO_DataSplyCls for Bank 1 Sensor 1 / Status word to display the reference current active in the respective for Ug0ix Array" UBYTE OneToOne 1 100 0.00 255.0 FORMAT "%5.1" ECU_ADDRESS 0x6000257F /end MEASUREMENT
/begin MEASUREMENT UEGO_DataSplyClsS1B1_I.stUg0ixPmpIActvPckAry "Class instance of the functional class of FC UEGO_DataSplyCls for Bank 1 Sensor 1 / Status word to display the switch is closed across pump active in the respective for Ug0ix Array" UBYTE OneToOne 1 100 0.00 255.0 FORMAT "%5.1" ECU_ADDRESS 0x60002580 /end MEASUREMENT
/begin MEASUREMENT UEGO_DataSplyClsS1B1_I.stUi21PckAry "Class instance of the functional class of FC UEGO_DataSplyCls for Bank 1 Sensor 1 / Status word to display the validity field for Ui21 Array" UBYTE OneToOne 1 100 0.00 255.0 FORMAT "%5.1" ECU_ADDRESS 0x60002581 /end MEASUREMENT
/begin MEASUREMENT UEGO_DataSplyClsS1B1_I.stUi21Z1PckAry "Class instance of the functional class of FC UEGO_DataSplyCls for Bank 1 Sensor 1 / Status word to display Ui21 is measured when Z1 circuit is active" UBYTE OneToOne 1 100 0.00 255.0 FORMAT "%5.1" ECU_ADDRESS 0x60002582 /end MEASUREMENT
/begin MEASUREMENT UEGO_DataSplyClsS1B1_I.stUigmkNernstIActvPckAry "Class instance of the functional class of FC UEGO_DataSplyCls for Bank 1 Sensor 1 / Status word to display Uigmk is measured when current flows across Nernst cell" UBYTE OneToOne 1 100 0.00 255.0 FORMAT "%5.1" ECU_ADDRESS 0x60002583 /end MEASUREMENT
/begin MEASUREMENT UEGO_DataSplyClsS1B1_I.stUigmkPmpIActvPckAry "Class instance of the functional class of FC UEGO_DataSplyCls for Bank 1 Sensor 1 / Status word to display Uigmk is measured when current flows across Pump cell" UBYTE OneToOne 1 100 0.00 255.0 FORMAT "%5.1" ECU_ADDRESS 0x60002584 /end MEASUREMENT
/begin MEASUREMENT UEGO_DataSplyClsS1B1_I.stUn0PckAry "Class instance of the functional class of FC UEGO_DataSplyCls for Bank 1 Sensor 1 / Status word to display the validity field for Un0 Array" UWORD OneToOne 1 100 0.00 65535.00 FORMAT "%8.2" ECU_ADDRESS 0x60002586 /end MEASUREMENT
/begin MEASUREMENT UEGO_DataSplyClsS1B1_I.stUn0Z2PckAry "Class instance of the functional class of FC UEGO_DataSplyCls for Bank 1 Sensor 1 / Status word to display the validity field for Un0 Array in Z2" UWORD OneToOne 1 100 0.00 65535.00 FORMAT "%8.2" ECU_ADDRESS 0x60002588 /end MEASUREMENT
/begin MEASUREMENT UEGO_DataSplyClsS1B1_I.stUnPckAry "Class instance of the functional class of FC UEGO_DataSplyCls for Bank 1 Sensor 1 / Status word to display the validity field for Un Array" UBYTE OneToOne 1 100 0.00 255.0 FORMAT "%5.1" ECU_ADDRESS 0x6000258A /end MEASUREMENT
/begin MEASUREMENT UEGO_DataSplyClsS1B1_I.stUnx3IActvAcrsNernstCellPckAry "Class instance of the functional class of FC UEGO_DataSplyCls for Bank 1 Sensor 1 / Status word to display Unx3 is measured when current accross Nernst cell" UBYTE OneToOne 1 100 0.00 255.0 FORMAT "%5.1" ECU_ADDRESS 0x6000258B /end MEASUREMENT
/begin MEASUREMENT UEGO_DataSplyClsS1B1_I.stUnx3IActvAcrsPmpCellPckAry "Class instance of the functional class of FC UEGO_DataSplyCls for Bank 1 Sensor 1 / Status word to display Unx3 is measured when current accross Pump cell" UBYTE OneToOne 1 100 0.00 255.0 FORMAT "%5.1" ECU_ADDRESS 0x6000258C /end MEASUREMENT
/begin MEASUREMENT UEGO_DataSplyClsS1B1_I.stUnx4IActvAcrsNernstCellPckAry "Class instance of the functional class of FC UEGO_DataSplyCls for Bank 1 Sensor 1 / Status word to display Unx4 is measured when current accross Nernst cell" UBYTE OneToOne 1 100 0.00 255.0 FORMAT "%5.1" ECU_ADDRESS 0x6000258D /end MEASUREMENT
/begin MEASUREMENT UEGO_DataSplyClsS1B1_I.stUnx4IActvAcrsPmpCellPckAry "Class instance of the functional class of FC UEGO_DataSplyCls for Bank 1 Sensor 1 / Status word to display Unx4 is measured when current accross Pump cell" UBYTE OneToOne 1 100 0.00 255.0 FORMAT "%5.1" ECU_ADDRESS 0x6000258E /end MEASUREMENT
/begin MEASUREMENT UEGO_DataSplyClsS1B1_I.stUp0PckAry "Class instance of the functional class of FC UEGO_DataSplyCls for Bank 1 Sensor 1 / Status word to display the validity field for Up0 Array" UWORD OneToOne 1 100 0.00 65535.00 FORMAT "%8.2" ECU_ADDRESS 0x60002590 /end MEASUREMENT
/begin MEASUREMENT UEGO_DataSplyClsS1B1_I.stUp0Z2PckAry "Class instance of the functional class of FC UEGO_DataSplyCls for Bank 1 Sensor 1 / Status word to display the validity field for Up0 Array in Z2" UWORD OneToOne 1 100 0.00 65535.00 FORMAT "%8.2" ECU_ADDRESS 0x60002592 /end MEASUREMENT
/begin MEASUREMENT UEGO_DataSplyClsS1B1_I.stUpPckAry "Class instance of the functional class of FC UEGO_DataSplyCls for Bank 1 Sensor 1 / Status word to display the validity field for Up Array" UBYTE OneToOne 1 100 0.00 255.0 FORMAT "%5.1" ECU_ADDRESS 0x60002594 /end MEASUREMENT
/begin MEASUREMENT UEGO_DataSplyClsS1B1_I.stUpZ2PckAry "Class instance of the functional class of FC UEGO_DataSplyCls for Bank 1 Sensor 1 / Status word to display the validity field for Up Array in Z2" UBYTE OneToOne 1 100 0.00 255.0 FORMAT "%5.1" ECU_ADDRESS 0x60002595 /end MEASUREMENT
/begin MEASUREMENT UEGO_DataSplyClsS1B1_I.stUpx3IActvAcrsNernstCellPckAry "Class instance of the functional class of FC UEGO_DataSplyCls for Bank 1 Sensor 1 / Status word to display Upx3 is measured when current accross Nernst cell" UBYTE OneToOne 1 100 0.00 255.0 FORMAT "%5.1" ECU_ADDRESS 0x60002596 /end MEASUREMENT
/begin MEASUREMENT UEGO_DataSplyClsS1B1_I.stUpx3IActvAcrsPmpCellPckAry "Class instance of the functional class of FC UEGO_DataSplyCls for Bank 1 Sensor 1 / Status word to display Upx3 is measured when current accross Pump cell" UBYTE OneToOne 1 100 0.00 255.0 FORMAT "%5.1" ECU_ADDRESS 0x60002597 /end MEASUREMENT
/begin MEASUREMENT UEGO_DataSplyClsS1B1_I.stUpx4IActvAcrsNernstCellPckAry "Class instance of the functional class of FC UEGO_DataSplyCls for Bank 1 Sensor 1 / Status word to display Upx4 is measured when current accross Nernst cell" UBYTE OneToOne 1 100 0.00 255.0 FORMAT "%5.1" ECU_ADDRESS 0x60002598 /end MEASUREMENT
/begin MEASUREMENT UEGO_DataSplyClsS1B1_I.stUpx4IActvAcrsPmpCellPckAry "Class instance of the functional class of FC UEGO_DataSplyCls for Bank 1 Sensor 1 / Status word to display Upx4 is measured when current accross Pump cell" UBYTE OneToOne 1 100 0.00 255.0 FORMAT "%5.1" ECU_ADDRESS 0x60002599 /end MEASUREMENT
/begin MEASUREMENT UEGO_DataSplyClsS1B1_I.stUriePckAry "Class instance of the functional class of FC UEGO_DataSplyCls for Bank 1 Sensor 1 / Status word to display the validity field for Urie Array" UBYTE OneToOne 1 100 0.00 255.0 FORMAT "%5.1" ECU_ADDRESS 0x6000259A /end MEASUREMENT
/begin MEASUREMENT UEGO_DataSplyClsS1B1_I.stUx6IActvPckAry "Class instance of the functional class of FC UEGO_DataSplyCls for Bank 1 Sensor 1 / Status word to display Ux6 is measured when current is active" UBYTE OneToOne 1 100 0.00 255.0 FORMAT "%5.1" ECU_ADDRESS 0x6000259B /end MEASUREMENT
/begin MEASUREMENT UEGO_DataSplyClsS1B1_I.stUx6MeasAcrsPmpCellPckAry "Class instance of the functional class of FC UEGO_DataSplyCls for Bank 1 Sensor 1 / Status word to display Ux6 is measured accross pump cell" UBYTE OneToOne 1 100 0.00 255.0 FORMAT "%5.1" ECU_ADDRESS 0x6000259C /end MEASUREMENT
/begin MEASUREMENT UEGO_DataSplyClsS1B1_I.stUx7IActvPckAry "Class instance of the functional class of FC UEGO_DataSplyCls for Bank 1 Sensor 1 / Status word to display Ux7 is measured when current is active" UBYTE OneToOne 1 100 0.00 255.0 FORMAT "%5.1" ECU_ADDRESS 0x6000259D /end MEASUREMENT
/begin MEASUREMENT UEGO_DataSplyClsS1B1_I.stUx7MeasAcrsPmpCellPckAry "Class instance of the functional class of FC UEGO_DataSplyCls for Bank 1 Sensor 1 / Status word to display Ux7 is measured accross pump cell" UBYTE OneToOne 1 100 0.00 255.0 FORMAT "%5.1" ECU_ADDRESS 0x6000259E /end MEASUREMENT
/begin MEASUREMENT UEGO_DataSplyClsS1B1_I.stUx8IActvPckAry "Class instance of the functional class of FC UEGO_DataSplyCls for Bank 1 Sensor 1 / Status word to display Ux8 is measured when current is active" UBYTE OneToOne 1 100 0.00 255.0 FORMAT "%5.1" ECU_ADDRESS 0x6000259F /end MEASUREMENT
/begin MEASUREMENT UEGO_DataSplyClsS1B1_I.stUx8MeasAcrsPmpCellPckAry "Class instance of the functional class of FC UEGO_DataSplyCls for Bank 1 Sensor 1 / Status word to display Ux8 is measured accross pump cell" UBYTE OneToOne 1 100 0.00 255.0 FORMAT "%5.1" ECU_ADDRESS 0x600025A0 /end MEASUREMENT
/begin MEASUREMENT UEGO_DataSplyClsS1B1_I.stUx9IActvPckAry "Class instance of the functional class of FC UEGO_DataSplyCls for Bank 1 Sensor 1 / Status word to display Ux9 is measured when current is active" UBYTE OneToOne 1 100 0.00 255.0 FORMAT "%5.1" ECU_ADDRESS 0x600025A1 /end MEASUREMENT
/begin MEASUREMENT UEGO_DataSplyClsS1B1_I.stUx9MeasAcrsPmpCellPckAry "Class instance of the functional class of FC UEGO_DataSplyCls for Bank 1 Sensor 1 / Status word to display Ux9 is measured accross pump cell" UBYTE OneToOne 1 100 0.00 255.0 FORMAT "%5.1" ECU_ADDRESS 0x600025A2 /end MEASUREMENT
/begin MEASUREMENT UEGO_DataSplyClsS1B1_I.stUxIActvPckAry "Class instance of the functional class of FC UEGO_DataSplyCls for Bank 1 Sensor 1 / Status word to display Ux is measured when current is active" UBYTE OneToOne 1 100 0.00 255.0 FORMAT "%5.1" ECU_ADDRESS 0x600025A3 /end MEASUREMENT
/begin MEASUREMENT UEGO_DataSplyClsS1B1_I.stUxMeasAcrsPmpCell "Class instance of the functional class of FC UEGO_DataSplyCls for Bank 1 Sensor 1 / Status word to display Ux is measured accross pump cell" UBYTE OneToOne 1 100 0.00 255.0 FORMAT "%5.1" ECU_ADDRESS 0x600025A4 /end MEASUREMENT
/begin MEASUREMENT UEGO_DataSplyClsS1B1_I.tiUEGOPck "Class instance of the functional class of FC UEGO_DataSplyCls for Bank 1 Sensor 1 / Time stamp UEGO measurement pack" ULONG t_q0p000001_s 1 100 0.00 4294.96729500 FORMAT "%13.8" ECU_ADDRESS 0x600025A8 /end MEASUREMENT
/begin MEASUREMENT UEGO_DataSplyClsS1B1_I.uFkal1 "Class instance of the functional class of FC UEGO_DataSplyCls for Bank 1 Sensor 1 / Calibration correction in Mode 1" UWORD spg_q2p3842Em7_V 1 100 0.00 0.01562476 FORMAT "%10.8" ECU_ADDRESS 0x600025AC /end MEASUREMENT
/begin MEASUREMENT UEGO_DataSplyClsS1B1_I.uFkal2 "Class instance of the functional class of FC UEGO_DataSplyCls for Bank 1 Sensor 1 / Calibration correction in Mode 2" UWORD spg_q2p3842Em7_V 1 100 0.00 0.01562476 FORMAT "%10.8" ECU_ADDRESS 0x600025AE /end MEASUREMENT
/begin MEASUREMENT UEGO_DataSplyClsS1B1_I.uFkal3 "Class instance of the functional class of FC UEGO_DataSplyCls for Bank 1 Sensor 1 / Calibration correction in Mode 3" UWORD spg_q2p3842Em7_V 1 100 0.00 0.01562476 FORMAT "%10.8" ECU_ADDRESS 0x600025B0 /end MEASUREMENT
/begin MEASUREMENT UEGO_DataSplyClsS1B1_I.uUCalPck "Class instance of the functional class of FC UEGO_DataSplyCls for Bank 1 Sensor 1 / Electrically corrected voltage Ucal" SWORD spg_q3p2Em4_V 1 100 -10.48576 10.48544 FORMAT "%8.5" ECU_ADDRESS 0x600025B2 /end MEASUREMENT
/begin MEASUREMENT UEGO_DataSplyClsS1B1_I.uUa31Pck "Class instance of the functional class of FC UEGO_DataSplyCls for Bank 1 Sensor 1 / Electrically corrected voltage Ua31" SWORD spg_q3p2Em4_V 1 100 -10.48576 10.48544 FORMAT "%8.5" ECU_ADDRESS 0x600025B4 /end MEASUREMENT
/begin MEASUREMENT UEGO_DataSplyClsS1B1_I.uUa32Pck "Class instance of the functional class of FC UEGO_DataSplyCls for Bank 1 Sensor 1 / Electrically corrected voltage Ua32" SWORD spg_q3p2Em4_V 1 100 -10.48576 10.48544 FORMAT "%8.5" ECU_ADDRESS 0x600025B6 /end MEASUREMENT
/begin MEASUREMENT UEGO_DataSplyClsS1B1_I.uUa33Pck "Class instance of the functional class of FC UEGO_DataSplyCls for Bank 1 Sensor 1 / Electrically corrected voltage Ua33" SWORD spg_q3p2Em4_V 1 100 -10.48576 10.48544 FORMAT "%8.5" ECU_ADDRESS 0x600025B8 /end MEASUREMENT
/begin MEASUREMENT UEGO_DataSplyClsS1B1_I.uUamPck "Class instance of the functional class of FC UEGO_DataSplyCls for Bank 1 Sensor 1 / Electrically corrected voltage Uam" SWORD spg_q3p2Em4_V 1 100 -10.48576 10.48544 FORMAT "%8.5" ECU_ADDRESS 0x600025BA /end MEASUREMENT
/begin MEASUREMENT UEGO_DataSplyClsS1B1_I.uUapePck "Class instance of the functional class of FC UEGO_DataSplyCls for Bank 1 Sensor 1 / Electrically corrected voltage Uape" SWORD spg_q3p2Em4_V 1 100 -10.48576 10.48544 FORMAT "%8.5" ECU_ADDRESS 0x600025BC /end MEASUREMENT
/begin MEASUREMENT UEGO_DataSplyClsS1B1_I.uUcalMaxPck "Class instance of the functional class of FC UEGO_DataSplyCls for Bank 1 Sensor 1 / Electrically corrected voltage UcalMax" SWORD spg_q3p2Em4_V 1 100 -10.48576 10.48544 FORMAT "%8.5" ECU_ADDRESS 0x600025BE /end MEASUREMENT
/begin MEASUREMENT UEGO_DataSplyClsS1B1_I.uUg0Pck "Class instance of the functional class of FC UEGO_DataSplyCls for Bank 1 Sensor 1 / Electrically corrected voltage Ug0" SWORD spg_q3p2Em4_V 1 100 -10.48576 10.48544 FORMAT "%8.5" ECU_ADDRESS 0x600025C0 /end MEASUREMENT
/begin MEASUREMENT UEGO_DataSplyClsS1B1_I.uUg0aPck "Class instance of the functional class of FC UEGO_DataSplyCls for Bank 1 Sensor 1 / Electrically corrected voltage Ug0a" SWORD spg_q3p2Em4_V 1 100 -10.48576 10.48544 FORMAT "%8.5" ECU_ADDRESS 0x600025C2 /end MEASUREMENT
/begin MEASUREMENT UEGO_DataSplyClsS1B1_I.uUg0ePck "Class instance of the functional class of FC UEGO_DataSplyCls for Bank 1 Sensor 1 / Electrically corrected voltage Ug0e" SWORD spg_q3p2Em4_V 1 100 -10.48576 10.48544 FORMAT "%8.5" ECU_ADDRESS 0x600025C4 /end MEASUREMENT
/begin MEASUREMENT UEGO_DataSplyClsS1B1_I.uUg0iPck "Class instance of the functional class of FC UEGO_DataSplyCls for Bank 1 Sensor 1 / Electrically corrected voltage Ug0i" SWORD spg_q3p2Em4_V 1 100 -10.48576 10.48544 FORMAT "%8.5" ECU_ADDRESS 0x600025C6 /end MEASUREMENT
/begin MEASUREMENT UEGO_DataSplyClsS1B1_I.uUg0iaiPck "Class instance of the functional class of FC UEGO_DataSplyCls for Bank 1 Sensor 1 / Electrically corrected voltage Ug0iai" SWORD spg_q3p2Em4_V 1 100 -10.48576 10.48544 FORMAT "%8.5" ECU_ADDRESS 0x600025C8 /end MEASUREMENT
/begin MEASUREMENT UEGO_DataSplyClsS1B1_I.uUg0ieiPck "Class instance of the functional class of FC UEGO_DataSplyCls for Bank 1 Sensor 1 / Electrically corrected voltage Ug0iei" SWORD spg_q3p2Em4_V 1 100 -10.48576 10.48544 FORMAT "%8.5" ECU_ADDRESS 0x600025CA /end MEASUREMENT
/begin MEASUREMENT UEGO_DataSplyClsS1B1_I.uUg0mPck "Class instance of the functional class of FC UEGO_DataSplyCls for Bank 1 Sensor 1 / Electrically corrected voltage Ug0m" SWORD spg_q3p2Em4_V 1 100 -10.48576 10.48544 FORMAT "%8.5" ECU_ADDRESS 0x600025CC /end MEASUREMENT
/begin MEASUREMENT UEGO_DataSplyClsS1B1_I.uUgkAvrgPck "Class instance of the functional class of FC UEGO_DataSplyCls for Bank 1 Sensor 1 / Electrically corrected voltage Ugk" SWORD spg_q3p2Em4_V 1 100 -10.48576 10.48544 FORMAT "%8.5" ECU_ADDRESS 0x600025CE /end MEASUREMENT
/begin MEASUREMENT UEGO_DataSplyClsS1B1_I.uUguaPck "Class instance of the functional class of FC UEGO_DataSplyCls for Bank 1 Sensor 1 / Electrically corrected voltage Ugua" SWORD spg_q3p2Em4_V 1 100 -10.48576 10.48544 FORMAT "%8.5" ECU_ADDRESS 0x600025D0 /end MEASUREMENT
/begin MEASUREMENT UEGO_DataSplyClsS1B1_I.uUguaZ2Pck "Class instance of the functional class of FC UEGO_DataSplyCls for Bank 1 Sensor 1 / Electrically corrected voltage Ugua in Z2" SWORD spg_q3p2Em4_V 1 100 -10.48576 10.48544 FORMAT "%8.5" ECU_ADDRESS 0x600025D2 /end MEASUREMENT
/begin MEASUREMENT UEGO_DataSplyClsS1B1_I.uUguiPck "Class instance of the functional class of FC UEGO_DataSplyCls for Bank 1 Sensor 1 / Electrically corrected voltage Ugui" SWORD spg_q3p2Em4_V 1 100 -10.48576 10.48544 FORMAT "%8.5" ECU_ADDRESS 0x600025D4 /end MEASUREMENT
/begin MEASUREMENT UEGO_DataSplyClsS1B1_I.uUguiZ1Pck "Class instance of the functional class of FC UEGO_DataSplyCls for Bank 1 Sensor 1 / Electrically corrected voltage Ugui in Z1" SWORD spg_q3p2Em4_V 1 100 -10.48576 10.48544 FORMAT "%8.5" ECU_ADDRESS 0x600025D6 /end MEASUREMENT
/begin MEASUREMENT UEGO_DataSplyClsS1B1_I.uUi22Pck "Class instance of the functional class of FC UEGO_DataSplyCls for Bank 1 Sensor 1 / Electrically corrected voltage Ui22" SWORD spg_q3p2Em4_V 1 100 -10.48576 10.48544 FORMAT "%8.5" ECU_ADDRESS 0x600025D8 /end MEASUREMENT
/begin MEASUREMENT UEGO_DataSplyClsS1B1_I.uUi23Pck "Class instance of the functional class of FC UEGO_DataSplyCls for Bank 1 Sensor 1 / Electrically corrected voltage Ui23" SWORD spg_q3p2Em4_V 1 100 -10.48576 10.48544 FORMAT "%8.5" ECU_ADDRESS 0x600025DA /end MEASUREMENT
/begin MEASUREMENT UEGO_DataSplyClsS1B1_I.uUi24Pck "Class instance of the functional class of FC UEGO_DataSplyCls for Bank 1 Sensor 1 / Electrically corrected voltage Ui24" SWORD spg_q3p2Em4_V 1 100 -10.48576 10.48544 FORMAT "%8.5" ECU_ADDRESS 0x600025DC /end MEASUREMENT
/begin MEASUREMENT UEGO_DataSplyClsS1B1_I.uUi4Pck "Class instance of the functional class of FC UEGO_DataSplyCls for Bank 1 Sensor 1 / Electrically corrected voltage Ui4" SWORD spg_q3p2Em4_V 1 100 -10.48576 10.48544 FORMAT "%8.5" ECU_ADDRESS 0x600025DE /end MEASUREMENT
/begin MEASUREMENT UEGO_DataSplyClsS1B1_I.uUi4Z2Pck "Class instance of the functional class of FC UEGO_DataSplyCls for Bank 1 Sensor 1 / Electrically corrected voltage Ui4 in Z2" SWORD spg_q3p2Em4_V 1 100 -10.48576 10.48544 FORMAT "%8.5" ECU_ADDRESS 0x600025E0 /end MEASUREMENT
/begin MEASUREMENT UEGO_DataSplyClsS1B1_I.uUipcalAvrgPck "Class instance of the functional class of FC UEGO_DataSplyCls for Bank 1 Sensor 1 / Electrically corrected voltage Uipcal" SWORD spg_q3p2Em4_V 1 100 -10.48576 10.48544 FORMAT "%8.5" ECU_ADDRESS 0x600025E2 /end MEASUREMENT
/begin MEASUREMENT UEGO_DataSplyClsS1B1_I.uUn0Pck "Class instance of the functional class of FC UEGO_DataSplyCls for Bank 1 Sensor 1 / Electrically corrected voltage Un0" SWORD spg_q3p2Em4_V 1 100 -10.48576 10.48544 FORMAT "%8.5" ECU_ADDRESS 0x600025E4 /end MEASUREMENT
/begin MEASUREMENT UEGO_DataSplyClsS1B1_I.uUnSet "Class instance of the functional class of FC UEGO_DataSplyCls for Bank 1 Sensor 1 / Electrically corrected voltage UnSet" SWORD spg_q3p2Em4_V 1 100 -10.48576 10.48544 FORMAT "%8.5" ECU_ADDRESS 0x600025E6 /end MEASUREMENT
/begin MEASUREMENT UEGO_DataSplyClsS1B1_I.uUp0Pck "Class instance of the functional class of FC UEGO_DataSplyCls for Bank 1 Sensor 1 / Electrically corrected voltage Up0" SWORD spg_q3p2Em4_V 1 100 -10.48576 10.48544 FORMAT "%8.5" ECU_ADDRESS 0x600025E8 /end MEASUREMENT
/begin MEASUREMENT UEGO_DataSplyClsS1B1_I.uUp0Pck4 "Class instance of the functional class of FC UEGO_DataSplyCls for Bank 1 Sensor 1 / Electrically corrected voltage Up0" SWORD spg_q3p2Em4_V 1 100 -10.48576 10.48544 FORMAT "%8.5" ECU_ADDRESS 0x600025EA /end MEASUREMENT
/begin MEASUREMENT UEGO_DataSplyClsS1B1_I.uUriaPck "Class instance of the functional class of FC UEGO_DataSplyCls for Bank 1 Sensor 1 / Electrically corrected voltage Uria" SWORD spg_q3p2Em4_V 1 100 -10.48576 10.48544 FORMAT "%8.5" ECU_ADDRESS 0x600025EC /end MEASUREMENT
/begin MEASUREMENT UEGO_DataSplyClsS1B1_I.uVCC1Corrd "Class instance of the functional class of FC UEGO_DataSplyCls for Bank 1 Sensor 1 / uVCC1Corrd" SWORD spg_q3p2Em4_V 1 100 -10.48576 10.48544 FORMAT "%8.5" ECU_ADDRESS 0x600025EE /end MEASUREMENT
/begin MEASUREMENT UEGO_DataSplyClsS1B1_I.uVCC3Ref "Class instance of the functional class of FC UEGO_DataSplyCls for Bank 1 Sensor 1 / uVCC3Ref" SWORD spg_q3p2Em4_V 1 100 -10.48576 10.48544 FORMAT "%8.5" ECU_ADDRESS 0x600025F0 /end MEASUREMENT
/begin MEASUREMENT UEGO_DiagHeatrPrfmncS1B1_I.cntrReiniProc100ms "Instance S1B1 of Class UEGO_DiagHeatrPrfmncClass / Counter Decentral ReIni" UBYTE OneToOne 1 100 0.00 255.0 FORMAT "%5.1" ECU_ADDRESS 0x6000243C /end MEASUREMENT
/begin MEASUREMENT UEGO_DiagHeatrPrfmncS1B1_I.cntrStrtPostDrvLeaveOld "Instance S1B1 of Class UEGO_DiagHeatrPrfmncClass / Previous global drive cycle counter for Start diagnosis" UBYTE OneToOne 1 100 0.00 255.0 FORMAT "%5.1" ECU_ADDRESS 0x6000243D /end MEASUREMENT
/begin MEASUREMENT UEGO_DiagHeatrPrfmncS1B1_I.flgDSMClrReq "Instance S1B1 of Class UEGO_DiagHeatrPrfmncClass / Clear Request Fault Memory" UBYTE B_TRUE 1 100 0.00 1.00000000000 BIT_MASK 0x1 FORMAT "%13.11" ECU_ADDRESS 0x6000243E /end MEASUREMENT
/begin MEASUREMENT UEGO_DiagHeatrPrfmncS1B1_I.flgDeactvSet "Instance S1B1 of Class UEGO_DiagHeatrPrfmncClass / Flag to set the start diagnisis deactivation" UBYTE B_TRUE 1 100 0.00 1.00000000000 BIT_MASK 0x1 FORMAT "%13.11" ECU_ADDRESS 0x6000243F /end MEASUREMENT
/begin MEASUREMENT UEGO_DiagHeatrPrfmncS1B1_I.flgDiagEna "Instance S1B1 of Class UEGO_DiagHeatrPrfmncClass / Diagnosis enabled" UBYTE B_TRUE 1 100 0.00 1.00000000000 BIT_MASK 0x1 FORMAT "%13.11" ECU_ADDRESS 0x60002440 /end MEASUREMENT
/begin MEASUREMENT UEGO_DiagHeatrPrfmncS1B1_I.flgDiagRels "Instance S1B1 of Class UEGO_DiagHeatrPrfmncClass / Diagnosis released" UBYTE B_TRUE 1 100 0.00 1.00000000000 BIT_MASK 0x1 FORMAT "%13.11" ECU_ADDRESS 0x60002441 /end MEASUREMENT
/begin MEASUREMENT UEGO_DiagHeatrPrfmncS1B1_I.flgHeatrPrfmncLoErr "Instance S1B1 of Class UEGO_DiagHeatrPrfmncClass / Fault Heating Performanc too low" UBYTE B_TRUE 1 100 0.00 1.00000000000 BIT_MASK 0x1 FORMAT "%13.11" ECU_ADDRESS 0x60002442 /end MEASUREMENT
/begin MEASUREMENT UEGO_DiagHeatrPrfmncS1B1_I.flgHeatrPrfmncLoSuspc "Instance S1B1 of Class UEGO_DiagHeatrPrfmncClass / Fault Suspicion Heating Performanc too low" UBYTE B_TRUE 1 100 0.00 1.00000000000 BIT_MASK 0x1 FORMAT "%13.11" ECU_ADDRESS 0x60002443 /end MEASUREMENT
/begin MEASUREMENT UEGO_DiagHeatrPrfmncS1B1_I.flgSrv06Ena "Instance S1B1 of Class UEGO_DiagHeatrPrfmncClass / Srv06 is enabled" UBYTE B_TRUE 1 100 0.00 1.00000000000 BIT_MASK 0x1 FORMAT "%13.11" ECU_ADDRESS 0x60002444 /end MEASUREMENT
/begin MEASUREMENT UEGO_DiagHeatrPrfmncS1B1_I.flgStrtDiagDSMClr "Instance S1B1 of Class UEGO_DiagHeatrPrfmncClass / Start Diagnosis DSM clear request" UBYTE B_TRUE 1 100 0.00 1.00000000000 BIT_MASK 0x1 FORMAT "%13.11" ECU_ADDRESS 0x60002445 /end MEASUREMENT
/begin MEASUREMENT UEGO_DiagHeatrPrfmncS1B1_I.flgStrtDiagDSMRels "Instance S1B1 of Class UEGO_DiagHeatrPrfmncClass / Start Diagnosis DSM release" UBYTE B_TRUE 1 100 0.00 1.00000000000 BIT_MASK 0x1 FORMAT "%13.11" ECU_ADDRESS 0x60002446 /end MEASUREMENT
/begin MEASUREMENT UEGO_DiagHeatrPrfmncS1B1_I.flgStrtDiagEna "Instance S1B1 of Class UEGO_DiagHeatrPrfmncClass / Start diagnosis enable status" UBYTE B_TRUE 1 100 0.00 1.00000000000 BIT_MASK 0x1 FORMAT "%13.11" ECU_ADDRESS 0x60002447 /end MEASUREMENT
/begin MEASUREMENT UEGO_DiagHeatrPrfmncS1B1_I.flgStrtDiagEnvrHealRels "Instance S1B1 of Class UEGO_DiagHeatrPrfmncClass / Flag start diagnosis environenmental heal release" UBYTE B_TRUE 1 100 0.00 1.00000000000 BIT_MASK 0x1 FORMAT "%13.11" ECU_ADDRESS 0x60002448 /end MEASUREMENT
/begin MEASUREMENT UEGO_DiagHeatrPrfmncS1B1_I.flgStrtDiagErrRels "Instance S1B1 of Class UEGO_DiagHeatrPrfmncClass / Start diagnosis error release" UBYTE B_TRUE 1 100 0.00 1.00000000000 BIT_MASK 0x1 FORMAT "%13.11" ECU_ADDRESS 0x60002449 /end MEASUREMENT
/begin MEASUREMENT UEGO_DiagHeatrPrfmncS1B1_I.flgStrtDiagOLTstd "Instance S1B1 of Class UEGO_DiagHeatrPrfmncClass / Start Diagnosis Open load across Nernst Cell tested" UBYTE B_TRUE 1 100 0.00 1.00000000000 BIT_MASK 0x1 FORMAT "%13.11" ECU_ADDRESS 0x6000244A /end MEASUREMENT
/begin MEASUREMENT UEGO_DiagHeatrPrfmncS1B1_I.flgStrtDiagPID41Req "Instance S1B1 of Class UEGO_DiagHeatrPrfmncClass / Flag to request the PID41" UBYTE B_TRUE 1 100 0.00 1.00000000000 BIT_MASK 0x1 FORMAT "%13.11" ECU_ADDRESS 0x6000244B /end MEASUREMENT
/begin MEASUREMENT UEGO_DiagHeatrPrfmncS1B1_I.flgStrtDiagPID41Set "Instance S1B1 of Class UEGO_DiagHeatrPrfmncClass / Flag to set the PID41" UBYTE B_TRUE 1 100 0.00 1.00000000000 BIT_MASK 0x1 FORMAT "%13.11" ECU_ADDRESS 0x6000244C /end MEASUREMENT
/begin MEASUREMENT UEGO_DiagHeatrPrfmncS1B1_I.flgStrtDiagRStrtReq "Instance S1B1 of Class UEGO_DiagHeatrPrfmncClass / Flag start diagnosis reset request" UBYTE B_TRUE 1 100 0.00 1.00000000000 BIT_MASK 0x1 FORMAT "%13.11" ECU_ADDRESS 0x6000244D /end MEASUREMENT
/begin MEASUREMENT UEGO_DiagHeatrPrfmncS1B1_I.flgStrtDiagRels "Instance S1B1 of Class UEGO_DiagHeatrPrfmncClass / Flag for the FId release of the heater start diagnosis" UBYTE B_TRUE 1 100 0.00 1.00000000000 BIT_MASK 0x1 FORMAT "%13.11" ECU_ADDRESS 0x6000244E /end MEASUREMENT
/begin MEASUREMENT UEGO_DiagHeatrPrfmncS1B1_I.flgStrtDiagRstReq "Instance S1B1 of Class UEGO_DiagHeatrPrfmncClass / Start diagnosis reset request" UBYTE B_TRUE 1 100 0.00 1.00000000000 BIT_MASK 0x1 FORMAT "%13.11" ECU_ADDRESS 0x6000244F /end MEASUREMENT
/begin MEASUREMENT UEGO_DiagHeatrPrfmncS1B1_I.flgStrtDiagRstrt "Instance S1B1 of Class UEGO_DiagHeatrPrfmncClass / Flag start restart request" UBYTE B_TRUE 1 100 0.00 1.00000000000 BIT_MASK 0x1 FORMAT "%13.11" ECU_ADDRESS 0x60002450 /end MEASUREMENT
/begin MEASUREMENT UEGO_DiagHeatrPrfmncS1B1_I.flgStrtDiagTiHealRels "Instance S1B1 of Class UEGO_DiagHeatrPrfmncClass / Flag start diagnosis heater off time heal release" UBYTE B_TRUE 1 100 0.00 1.00000000000 BIT_MASK 0x1 FORMAT "%13.11" ECU_ADDRESS 0x60002451 /end MEASUREMENT
/begin MEASUREMENT UEGO_DiagHeatrPrfmncS1B1_I.flgStrtDiagTstrDmd "Instance S1B1 of Class UEGO_DiagHeatrPrfmncClass / Start Diagnosis Tester request" UBYTE B_TRUE 1 100 0.00 1.00000000000 BIT_MASK 0x1 FORMAT "%13.11" ECU_ADDRESS 0x60002452 /end MEASUREMENT
/begin MEASUREMENT UEGO_DiagHeatrPrfmncS1B1_I.flgStrtDiagTstrTiHealRels "Instance S1B1 of Class UEGO_DiagHeatrPrfmncClass / Flag start diagnosis heater off time heal tester release" UBYTE B_TRUE 1 100 0.00 1.00000000000 BIT_MASK 0x1 FORMAT "%13.11" ECU_ADDRESS 0x60002453 /end MEASUREMENT
/begin MEASUREMENT UEGO_DiagHeatrPrfmncS1B1_I.nrModInt "Instance S1B1 of Class UEGO_DiagHeatrPrfmncClass / Start diagnosis internal mode" UBYTE UEGO_DiagHeatrPrfmncModInt_COMPU_VERB 1 100 1.00000000000 5.00000000000 FORMAT "%13.11" ECU_ADDRESS 0x60002454 /end MEASUREMENT
/begin MEASUREMENT UEGO_DiagHeatrPrfmncS1B1_I.nrModIntOld "Instance S1B1 of Class UEGO_DiagHeatrPrfmncClass / Start diagnosis previous internal mode" UBYTE UEGO_DiagHeatrPrfmncModInt_COMPU_VERB 1 100 1.00000000000 5.00000000000 FORMAT "%13.11" ECU_ADDRESS 0x60002455 /end MEASUREMENT
/begin MEASUREMENT UEGO_DiagHeatrPrfmncS1B1_I.nrModRes "Instance S1B1 of Class UEGO_DiagHeatrPrfmncClass / Start diagnosis result mode" UBYTE UEGO_DiagHeatrPrfmncModRes_COMPU_VERB 1 100 1.00000000000 5.00000000000 FORMAT "%13.11" ECU_ADDRESS 0x60002456 /end MEASUREMENT
/begin MEASUREMENT UEGO_DiagHeatrPrfmncS1B1_I.nrModResOld "Instance S1B1 of Class UEGO_DiagHeatrPrfmncClass / Start diagnosis previous result mode" UBYTE UEGO_DiagHeatrPrfmncModRes_COMPU_VERB 1 100 1.00000000000 5.00000000000 FORMAT "%13.11" ECU_ADDRESS 0x60002457 /end MEASUREMENT
/begin MEASUREMENT UEGO_DiagHeatrPrfmncS1B1_I.nrModRprt "Instance S1B1 of Class UEGO_DiagHeatrPrfmncClass / Start diagnosis report mode" UBYTE UEGO_DiagHeatrPrfmncModRprt_COMPU_VERB 1 100 0.00 5.00000000000 FORMAT "%13.11" ECU_ADDRESS 0x60002458 /end MEASUREMENT
/begin MEASUREMENT UEGO_DiagHeatrPrfmncS1B1_I.nrModRprtOld "Instance S1B1 of Class UEGO_DiagHeatrPrfmncClass / Start diagnosis previous report mode" UBYTE UEGO_DiagHeatrPrfmncModRprt_COMPU_VERB 1 100 0.00 5.00000000000 FORMAT "%13.11" ECU_ADDRESS 0x60002459 /end MEASUREMENT
/begin MEASUREMENT UEGO_DiagHeatrPrfmncS1B1_I.nrModSel "Instance S1B1 of Class UEGO_DiagHeatrPrfmncClass / Start diagnosis mode for error or heal release" UBYTE UEGO_DiagHeatrPrfmncModSel_COMPU_VERB 1 100 1.00000000000 4.00000000000 FORMAT "%13.11" ECU_ADDRESS 0x6000245A /end MEASUREMENT
/begin MEASUREMENT UEGO_DiagHeatrPrfmncS1B1_I.ratEgyStrtDiag "Instance S1B1 of Class UEGO_DiagHeatrPrfmncClass / energy ratio for start diagnosis" UWORD fak_ub_b2 1 100 0.00 511.9922 FORMAT "%8.4" ECU_ADDRESS 0x6000245C /end MEASUREMENT
/begin MEASUREMENT UEGO_DiagHeatrPrfmncS1B1_I.ratEgyStrtDiagIUMPR "Instance S1B1 of Class UEGO_DiagHeatrPrfmncClass / energy ratio for start diagnosis of IUMPR update" UWORD fak_ub_b2 1 100 0.00 511.9922 FORMAT "%8.4" ECU_ADDRESS 0x6000245E /end MEASUREMENT
/begin MEASUREMENT UEGO_DiagHeatrPrfmncS1B1_I.tCerStrtDiagDTR "Instance S1B1 of Class UEGO_DiagHeatrPrfmncClass / Start diagnosis sensor temperature for reporting to DTR" UWORD temp_q0p0234_o273 1 100 -273.150 1262.827 FORMAT "%8.3" ECU_ADDRESS 0x60002460 /end MEASUREMENT
/begin MEASUREMENT UEGO_DiagHeatrPrfmncS1B1_I.tCerStrtDiagOBD "Instance S1B1 of Class UEGO_DiagHeatrPrfmncClass / Start diagnosis sensor temperature for reporting to OBD radar" UWORD temp_q0p0234_o273 1 100 -273.150 1262.827 FORMAT "%8.3" ECU_ADDRESS 0x60002462 /end MEASUREMENT
/begin MEASUREMENT UEGO_DiagHeatrPrfmncS1B1_I.tiDebDef "Instance S1B1 of Class UEGO_DiagHeatrPrfmncClass / Debounce Time Error Detection" ULONG OneToOne 1 100 0.00 4294967295.00 FORMAT "%13.2" ECU_ADDRESS 0x60002464 /end MEASUREMENT
/begin MEASUREMENT UEGO_DiagHeatrPrfmncS1B1_I.tiDebOK "Instance S1B1 of Class UEGO_DiagHeatrPrfmncClass / Debounce Time Healing Detection" ULONG OneToOne 1 100 0.00 4294967295.00 FORMAT "%13.2" ECU_ADDRESS 0x60002468 /end MEASUREMENT
/begin MEASUREMENT UEGO_DiagHeatrPrfmncS1B1_I.tiStrtDiagDurnThd "Instance S1B1 of Class UEGO_DiagHeatrPrfmncClass / Duration of Start Diagnosis" UWORD t_q0p1 1 100 0.00 6553.500 FORMAT "%8.3" ECU_ADDRESS 0x6000246C /end MEASUREMENT
/begin MEASUREMENT UEGO_DiagHeatrPrfmncS1B1_I.tiStrtDiagDurnThdIUMPR "Instance S1B1 of Class UEGO_DiagHeatrPrfmncClass / Duration of Start Diagnosis for IUMPR update" UWORD t_q0p1 1 100 0.00 6553.500 FORMAT "%8.3" ECU_ADDRESS 0x6000246E /end MEASUREMENT
/begin MEASUREMENT UEGO_DiagHeatrPrfmncS1B1_I.tiStrtDiagHldTmr "Instance S1B1 of Class UEGO_DiagHeatrPrfmncClass / Start Diagnosis overrun duration timer" UWORD t_q0p1 1 100 0.00 6553.500 FORMAT "%8.3" ECU_ADDRESS 0x60002470 /end MEASUREMENT
/begin MEASUREMENT UEGO_DiagHeatrPrfmncS1B1_I.tiStrtDiagTmr "Instance S1B1 of Class UEGO_DiagHeatrPrfmncClass / Start diagnosis timer" UWORD t_q0p1 1 100 0.00 6553.500 FORMAT "%8.3" ECU_ADDRESS 0x60002472 /end MEASUREMENT
/begin MEASUREMENT UEGO_DiagHeatrPrfmncS1B1_I.tiStrtDiagTmrIUMPR "Instance S1B1 of Class UEGO_DiagHeatrPrfmncClass / Start diagnosis timer for IUMPR update" UWORD t_q0p1 1 100 0.00 6553.500 FORMAT "%8.3" ECU_ADDRESS 0x60002474 /end MEASUREMENT
/begin MEASUREMENT UEGO_DiagHeatrPrfmncS1B1_I.LoErrDebDefTONV_I.outbit "Instance S1B1 of Class UEGO_DiagHeatrPrfmncClass / Debouncing Error Suspicion / return value" UBYTE B_TRUE 1 100 0.00 1.00000000000 BIT_MASK 0x1 FORMAT "%13.11" ECU_ADDRESS 0x60002476 /end MEASUREMENT
/begin MEASUREMENT UEGO_DiagHeatrPrfmncS1B1_I.LoErrDebDefTONV_I.time "Instance S1B1 of Class UEGO_DiagHeatrPrfmncClass / Debouncing Error Suspicion / expired delay time" UWORD t_q0p1 1 100 0.00 6553.500 FORMAT "%8.3" ECU_ADDRESS 0x60002478 /end MEASUREMENT
/begin MEASUREMENT UEGO_DiagHeatrPrfmncS1B1_I.LoErrDebOKTOFFV_I.outbit "Instance S1B1 of Class UEGO_DiagHeatrPrfmncClass / Debouncing Healing / Output Bit" UBYTE B_TRUE 1 100 0.00 1.00000000000 BIT_MASK 0x1 FORMAT "%13.11" ECU_ADDRESS 0x6000247A /end MEASUREMENT
/begin MEASUREMENT UEGO_DiagHeatrPrfmncS1B1_I.LoErrDebOKTOFFV_I.time "Instance S1B1 of Class UEGO_DiagHeatrPrfmncClass / Debouncing Healing / Occured Time" UWORD t_q0p1 1 100 0.00 6553.500 FORMAT "%8.3" ECU_ADDRESS 0x6000247C /end MEASUREMENT
/begin MEASUREMENT UEGO_DiagHeatrPrfmncS1B1_I.flgDiagRelsTONV_I.outbit "Instance S1B1 of Class UEGO_DiagHeatrPrfmncClass / TurnOnDelay Diagnosis released / return value" UBYTE B_TRUE 1 100 0.00 1.00000000000 BIT_MASK 0x1 FORMAT "%13.11" ECU_ADDRESS 0x6000247E /end MEASUREMENT
/begin MEASUREMENT UEGO_DiagHeatrPrfmncS1B1_I.flgDiagRelsTONV_I.time "Instance S1B1 of Class UEGO_DiagHeatrPrfmncClass / TurnOnDelay Diagnosis released / expired delay time" UWORD t_q0p1 1 100 0.00 6553.500 FORMAT "%8.3" ECU_ADDRESS 0x60002480 /end MEASUREMENT
/begin MEASUREMENT UEGO_DiagHeatrPrfmncS1B1_I.flgDiagRprtRelsTONV_I.outbit "Instance S1B1 of Class UEGO_DiagHeatrPrfmncClass / TurnOnDelay Release Diagnosis Report / return value" UBYTE B_TRUE 1 100 0.00 1.00000000000 BIT_MASK 0x1 FORMAT "%13.11" ECU_ADDRESS 0x60002482 /end MEASUREMENT
/begin MEASUREMENT UEGO_DiagHeatrPrfmncS1B1_I.flgDiagRprtRelsTONV_I.time "Instance S1B1 of Class UEGO_DiagHeatrPrfmncClass / TurnOnDelay Release Diagnosis Report / expired delay time" UWORD t_q0p1 1 100 0.00 6553.500 FORMAT "%8.3" ECU_ADDRESS 0x60002484 /end MEASUREMENT
/begin MEASUREMENT UEGO_DiagHeatrPrfmncS1B1_I.flgOvrRunStrtDiagTONV_I.outbit "Instance S1B1 of Class UEGO_DiagHeatrPrfmncClass / start diagnosis overrun turn on delay / return value" UBYTE B_TRUE 1 100 0.00 1.00000000000 BIT_MASK 0x1 FORMAT "%13.11" ECU_ADDRESS 0x60002486 /end MEASUREMENT
/begin MEASUREMENT UEGO_DiagHeatrPrfmncS1B1_I.flgOvrRunStrtDiagTONV_I.time "Instance S1B1 of Class UEGO_DiagHeatrPrfmncClass / start diagnosis overrun turn on delay / expired delay time" UWORD t_q0p1 1 100 0.00 6553.500 FORMAT "%8.3" ECU_ADDRESS 0x60002488 /end MEASUREMENT
/begin MEASUREMENT UEGO_DiagHeatrPrfmncS1B1_I.flgOvrRunTOFFV_I.outbit "Instance S1B1 of Class UEGO_DiagHeatrPrfmncClass / TurnOffDelay Overrun / Output Bit" UBYTE B_TRUE 1 100 0.00 1.00000000000 BIT_MASK 0x1 FORMAT "%13.11" ECU_ADDRESS 0x6000248A /end MEASUREMENT
/begin MEASUREMENT UEGO_DiagHeatrPrfmncS1B1_I.flgOvrRunTOFFV_I.time "Instance S1B1 of Class UEGO_DiagHeatrPrfmncClass / TurnOffDelay Overrun / Occured Time" UWORD t_q0p1 1 100 0.00 6553.500 FORMAT "%8.3" ECU_ADDRESS 0x6000248C /end MEASUREMENT
/begin MEASUREMENT UEGO_DiagHeatrPrfmncS1B1_I.flgOvrRunTONV_I.outbit "Instance S1B1 of Class UEGO_DiagHeatrPrfmncClass / TurnOnDelay Overrun / return value" UBYTE B_TRUE 1 100 0.00 1.00000000000 BIT_MASK 0x1 FORMAT "%13.11" ECU_ADDRESS 0x6000248E /end MEASUREMENT
/begin MEASUREMENT UEGO_DiagHeatrPrfmncS1B1_I.flgOvrRunTONV_I.time "Instance S1B1 of Class UEGO_DiagHeatrPrfmncClass / TurnOnDelay Overrun / expired delay time" UWORD t_q0p1 1 100 0.00 6553.500 FORMAT "%8.3" ECU_ADDRESS 0x60002490 /end MEASUREMENT
/begin MEASUREMENT UEGO_DiagHeatrPrfmncS1B1_I.flgStrtDiagRestrtReqEFNM_I.oldSignal "Instance S1B1 of Class UEGO_DiagHeatrPrfmncClass / Edge falling start diagnosis restart request / memory to detect falling edge" UBYTE B_TRUE 1 100 0.00 1.00000000000 BIT_MASK 0x1 FORMAT "%13.11" ECU_ADDRESS 0x60002492 /end MEASUREMENT
/begin MEASUREMENT UEGO_DiagHeatrPrfmncS1B1_I.flgStrtDiagTstrDmdFF_I.status "Instance S1B1 of Class UEGO_DiagHeatrPrfmncClass / Start Diagnosis Tester request flip flop / current value of RS-FF" UBYTE B_TRUE 1 100 0.00 1.00000000000 BIT_MASK 0x1 FORMAT "%13.11" ECU_ADDRESS 0x60002493 /end MEASUREMENT
/begin MEASUREMENT UEGO_DiagHeatrPrfmncS1B1_I.flgTstrReqTONV_I.outbit "Instance S1B1 of Class UEGO_DiagHeatrPrfmncClass / Start Diagnosis Tester request turn On delay / return value" UBYTE B_TRUE 1 100 0.00 1.00000000000 BIT_MASK 0x1 FORMAT "%13.11" ECU_ADDRESS 0x60002494 /end MEASUREMENT
/begin MEASUREMENT UEGO_DiagHeatrPrfmncS1B1_I.flgTstrReqTONV_I.time "Instance S1B1 of Class UEGO_DiagHeatrPrfmncClass / Start Diagnosis Tester request turn On delay / expired delay time" UBYTE t_q0p1 1 100 0.00 25.50 FORMAT "%5.2" ECU_ADDRESS 0x60002495 /end MEASUREMENT
/begin MEASUREMENT UEGO_DiagHeatrPrfmncS1B1_I.tiStrtDiagEgyRatA_I.memory "Instance S1B1 of Class UEGO_DiagHeatrPrfmncClass / Start Diagnosis energy ratio accumulator / Accumulator" SLONG spg_q0p005 1 100 -10737418.2400 10737418.2350 FORMAT "%13.4" ECU_ADDRESS 0x60002498 /end MEASUREMENT
/begin MEASUREMENT UEGO_DiagHeatrPrfmncS1B1_I.tiStrtDiagEgyRatIUMPRA_I.memory "Instance S1B1 of Class UEGO_DiagHeatrPrfmncClass / Start Diagnosis energy ratio accumulator for IUMPR calculation / Accumulator" SLONG spg_q0p005 1 100 -10737418.2400 10737418.2350 FORMAT "%13.4" ECU_ADDRESS 0x6000249C /end MEASUREMENT
/begin MEASUREMENT UEGO_DiagHeatrWireS1B1_I.cntrReiniProc20ms "Class Diagnosis Powerstage Heater LSU Sensor 1 Bank 1 / Counter for decentral initialisation" UBYTE OneToOne 1 100 0.00 255.0 FORMAT "%5.1" ECU_ADDRESS 0x600023C4 /end MEASUREMENT
/begin MEASUREMENT UEGO_DiagHeatrWireS1B1_I.flgDSMClrReq "Class Diagnosis Powerstage Heater LSU Sensor 1 Bank 1 / Clear Request Fault Memory" UBYTE B_TRUE 1 100 0.00 1.00000000000 BIT_MASK 0x1 FORMAT "%13.11" ECU_ADDRESS 0x600023C5 /end MEASUREMENT
/begin MEASUREMENT UEGO_DiagHeatrWireS1B1_I.flgDiagEna "Class Diagnosis Powerstage Heater LSU Sensor 1 Bank 1 / Release Diagnosis Wire LSU Heater" UBYTE B_TRUE 1 100 0.00 1.00000000000 BIT_MASK 0x1 FORMAT "%13.11" ECU_ADDRESS 0x600023C6 /end MEASUREMENT
/begin MEASUREMENT UEGO_DiagHeatrWireS1B1_I.flgDiagRels "Class Diagnosis Powerstage Heater LSU Sensor 1 Bank 1 / Release Power Stage Diagnosis LSU Heater" UBYTE B_TRUE 1 100 0.00 1.00000000000 BIT_MASK 0x1 FORMAT "%13.11" ECU_ADDRESS 0x600023C7 /end MEASUREMENT
/begin MEASUREMENT UEGO_DiagHeatrWireS1B1_I.flgDiagSCBRels "Class Diagnosis Powerstage Heater LSU Sensor 1 Bank 1 / Release SCB diagnosis" UBYTE B_TRUE 1 100 0.00 1.00000000000 BIT_MASK 0x1 FORMAT "%13.11" ECU_ADDRESS 0x600023C8 /end MEASUREMENT
/begin MEASUREMENT UEGO_DiagHeatrWireS1B1_I.flgDiagSCGRels "Class Diagnosis Powerstage Heater LSU Sensor 1 Bank 1 / Validity to update SCG error." UBYTE B_TRUE 1 100 0.00 1.00000000000 BIT_MASK 0x1 FORMAT "%13.11" ECU_ADDRESS 0x600023C9 /end MEASUREMENT
/begin MEASUREMENT UEGO_DiagHeatrWireS1B1_I.flgDsmErrOlRaw "Class Diagnosis Powerstage Heater LSU Sensor 1 Bank 1 / DSM open load error suspicion" UBYTE B_TRUE 1 100 0.00 1.00000000000 BIT_MASK 0x1 FORMAT "%13.11" ECU_ADDRESS 0x600023CA /end MEASUREMENT
/begin MEASUREMENT UEGO_DiagHeatrWireS1B1_I.flgDsmErrScbRaw "Class Diagnosis Powerstage Heater LSU Sensor 1 Bank 1 / DSM SCB error suspicion" UBYTE B_TRUE 1 100 0.00 1.00000000000 BIT_MASK 0x1 FORMAT "%13.11" ECU_ADDRESS 0x600023CB /end MEASUREMENT
/begin MEASUREMENT UEGO_DiagHeatrWireS1B1_I.flgDsmErrScgRaw "Class Diagnosis Powerstage Heater LSU Sensor 1 Bank 1 / DSM SCG error suspicion" UBYTE B_TRUE 1 100 0.00 1.00000000000 BIT_MASK 0x1 FORMAT "%13.11" ECU_ADDRESS 0x600023CC /end MEASUREMENT
/begin MEASUREMENT UEGO_DiagHeatrWireS1B1_I.flgDsmPwrStgErrRaw "Class Diagnosis Powerstage Heater LSU Sensor 1 Bank 1 / DSM power stage error suspicion" UBYTE B_TRUE 1 100 0.00 1.00000000000 BIT_MASK 0x1 FORMAT "%13.11" ECU_ADDRESS 0x600023CD /end MEASUREMENT
/begin MEASUREMENT UEGO_DiagHeatrWireS1B1_I.flgErrInfoOLRaw "Class Diagnosis Powerstage Heater LSU Sensor 1 Bank 1 / Error LSU Heater Circuit, Open Line (OL) Raw Value unfiltered" UBYTE B_TRUE 1 100 0.00 1.00000000000 BIT_MASK 0x1 FORMAT "%13.11" ECU_ADDRESS 0x600023CE /end MEASUREMENT
/begin MEASUREMENT UEGO_DiagHeatrWireS1B1_I.flgErrInfoSCBRaw "Class Diagnosis Powerstage Heater LSU Sensor 1 Bank 1 / Error LSU Heater Circuit, Short Circuit to Battery (SCB) Raw Value unfiltered" UBYTE B_TRUE 1 100 0.00 1.00000000000 BIT_MASK 0x1 FORMAT "%13.11" ECU_ADDRESS 0x600023CF /end MEASUREMENT
/begin MEASUREMENT UEGO_DiagHeatrWireS1B1_I.flgErrInfoSCGRaw "Class Diagnosis Powerstage Heater LSU Sensor 1 Bank 1 / Error LSU Heater Circuit, Short Circuit to Ground (SCG) Raw Value unfiltered" UBYTE B_TRUE 1 100 0.00 1.00000000000 BIT_MASK 0x1 FORMAT "%13.11" ECU_ADDRESS 0x600023D0 /end MEASUREMENT
/begin MEASUREMENT UEGO_DiagHeatrWireS1B1_I.flgErrOL "Class Diagnosis Powerstage Heater LSU Sensor 1 Bank 1 / Error LSU Heater Circuit, Open Line (OL)" UBYTE B_TRUE 1 100 0.00 1.00000000000 BIT_MASK 0x1 FORMAT "%13.11" ECU_ADDRESS 0x600023D1 /end MEASUREMENT
/begin MEASUREMENT UEGO_DiagHeatrWireS1B1_I.flgErrOLRaw "Class Diagnosis Powerstage Heater LSU Sensor 1 Bank 1 / Error LSU Heater Circuit, Open Line (OL) Raw Value" UBYTE B_TRUE 1 100 0.00 1.00000000000 BIT_MASK 0x1 FORMAT "%13.11" ECU_ADDRESS 0x600023D2 /end MEASUREMENT
/begin MEASUREMENT UEGO_DiagHeatrWireS1B1_I.flgErrSCB "Class Diagnosis Powerstage Heater LSU Sensor 1 Bank 1 / Error LSU Heater Circuit, Short Circuit to Battery (SCB)" UBYTE B_TRUE 1 100 0.00 1.00000000000 BIT_MASK 0x1 FORMAT "%13.11" ECU_ADDRESS 0x600023D3 /end MEASUREMENT
/begin MEASUREMENT UEGO_DiagHeatrWireS1B1_I.flgErrSCBRaw "Class Diagnosis Powerstage Heater LSU Sensor 1 Bank 1 / Error LSU Heater Circuit, Short Circuit to Battery (SCB) Raw Value" UBYTE B_TRUE 1 100 0.00 1.00000000000 BIT_MASK 0x1 FORMAT "%13.11" ECU_ADDRESS 0x600023D4 /end MEASUREMENT
/begin MEASUREMENT UEGO_DiagHeatrWireS1B1_I.flgErrSCG "Class Diagnosis Powerstage Heater LSU Sensor 1 Bank 1 / Error LSU Heater Circuit, Short Circuit to Ground (SCG)" UBYTE B_TRUE 1 100 0.00 1.00000000000 BIT_MASK 0x1 FORMAT "%13.11" ECU_ADDRESS 0x600023D5 /end MEASUREMENT
/begin MEASUREMENT UEGO_DiagHeatrWireS1B1_I.flgErrSCGRaw "Class Diagnosis Powerstage Heater LSU Sensor 1 Bank 1 / Error LSU Heater Circuit, Short Circuit to Ground (SCG) Raw Value" UBYTE B_TRUE 1 100 0.00 1.00000000000 BIT_MASK 0x1 FORMAT "%13.11" ECU_ADDRESS 0x600023D6 /end MEASUREMENT
/begin MEASUREMENT UEGO_DiagHeatrWireS1B1_I.flgFtchVld "Class Diagnosis Powerstage Heater LSU Sensor 1 Bank 1 / Return values of LSM_Get() are valid" UBYTE B_TRUE 1 100 0.00 1.00000000000 BIT_MASK 0x1 FORMAT "%13.11" ECU_ADDRESS 0x600023D7 /end MEASUREMENT
/begin MEASUREMENT UEGO_DiagHeatrWireS1B1_I.flgHeatrPsErr "Class Diagnosis Powerstage Heater LSU Sensor 1 Bank 1 / Error LSU Heater Circuit" UBYTE B_TRUE 1 100 0.00 1.00000000000 BIT_MASK 0x1 FORMAT "%13.11" ECU_ADDRESS 0x600023D8 /end MEASUREMENT
/begin MEASUREMENT UEGO_DiagHeatrWireS1B1_I.flgIniEnd "Class Diagnosis Powerstage Heater LSU Sensor 1 Bank 1 / Initialisation Diagnosis Power Stages LSU Heater finished" UBYTE B_TRUE 1 100 0.00 1.00000000000 BIT_MASK 0x1 FORMAT "%13.11" ECU_ADDRESS 0x600023D9 /end MEASUREMENT
/begin MEASUREMENT UEGO_DiagHeatrWireS1B1_I.flgOffIninErr "Class Diagnosis Powerstage Heater LSU Sensor 1 Bank 1 / Power stage has been switched off due to init failure of CJ135 ASIC" UBYTE B_TRUE 1 100 0.00 1.00000000000 BIT_MASK 0x1 FORMAT "%13.11" ECU_ADDRESS 0x600023DA /end MEASUREMENT
/begin MEASUREMENT UEGO_DiagHeatrWireS1B1_I.flgOffProtd "Class Diagnosis Powerstage Heater LSU Sensor 1 Bank 1 / Power stage switched off due protection function" UBYTE B_TRUE 1 100 0.00 1.00000000000 BIT_MASK 0x1 FORMAT "%13.11" ECU_ADDRESS 0x600023DB /end MEASUREMENT
/begin MEASUREMENT UEGO_DiagHeatrWireS1B1_I.flgPolarityHi "Class Diagnosis Powerstage Heater LSU Sensor 1 Bank 1 / Power stage logic is active high" UBYTE B_TRUE 1 100 0.00 1.00000000000 BIT_MASK 0x1 FORMAT "%13.11" ECU_ADDRESS 0x600023DC /end MEASUREMENT
/begin MEASUREMENT UEGO_DiagHeatrWireS1B1_I.flgPwrStgSuprt "Class Diagnosis Powerstage Heater LSU Sensor 1 Bank 1 / Combination of Lambdasensor Typ and Powerstage Typ is supported" UBYTE B_TRUE 1 100 0.00 1.00000000000 BIT_MASK 0x1 FORMAT "%13.11" ECU_ADDRESS 0x600023DD /end MEASUREMENT
/begin MEASUREMENT UEGO_DiagHeatrWireS1B1_I.flgTestPlsReqd "Class Diagnosis Powerstage Heater LSU Sensor 1 Bank 1 / Test Pulse is requested" UBYTE B_TRUE 1 100 0.00 1.00000000000 BIT_MASK 0x1 FORMAT "%13.11" ECU_ADDRESS 0x600023DE /end MEASUREMENT
/begin MEASUREMENT UEGO_DiagHeatrWireS1B1_I.flgTout "Class Diagnosis Powerstage Heater LSU Sensor 1 Bank 1 / Power stage time out" UBYTE B_TRUE 1 100 0.00 1.00000000000 BIT_MASK 0x1 FORMAT "%13.11" ECU_ADDRESS 0x600023DF /end MEASUREMENT
/begin MEASUREMENT UEGO_DiagHeatrWireS1B1_I.flgTstPlsReqScb "Class Diagnosis Powerstage Heater LSU Sensor 1 Bank 1 / Test pulse for SCB detection is required" UBYTE B_TRUE 1 100 0.00 1.00000000000 BIT_MASK 0x1 FORMAT "%13.11" ECU_ADDRESS 0x600023E0 /end MEASUREMENT
/begin MEASUREMENT UEGO_DiagHeatrWireS1B1_I.flgTstPlsReqScgOl "Class Diagnosis Powerstage Heater LSU Sensor 1 Bank 1 / Test pulse for SCG or OL detection is required" UBYTE B_TRUE 1 100 0.00 1.00000000000 BIT_MASK 0x1 FORMAT "%13.11" ECU_ADDRESS 0x600023E1 /end MEASUREMENT
/begin MEASUREMENT UEGO_DiagHeatrWireS1B1_I.ratHeatrMeasd "Class Diagnosis Powerstage Heater LSU Sensor 1 Bank 1 / Back measured duty cycle of power stage" UWORD rel_q0p003052 1 100 0.00 199.9969 FORMAT "%8.4" ECU_ADDRESS 0x600023E2 /end MEASUREMENT
/begin MEASUREMENT UEGO_DiagHeatrWireS1B1_I.stErrInfo "Class Diagnosis Powerstage Heater LSU Sensor 1 Bank 1 / Error Status Diagnosis Power Stages" ULONG OneToOne 1 100 0.00 4294967295.00 FORMAT "%13.2" ECU_ADDRESS 0x600023E4 /end MEASUREMENT
/begin MEASUREMENT UEGO_DiagHeatrWireS1B1_I.stFtchVldy "Class Diagnosis Powerstage Heater LSU Sensor 1 Bank 1 / Bit row validity of return values of LSM_Get()" UWORD OneToOne 1 100 0.00 65535.00 FORMAT "%8.2" ECU_ADDRESS 0x600023E8 /end MEASUREMENT
/begin MEASUREMENT UEGO_DiagHeatrWireS1B1_I.stInfo "Class Diagnosis Powerstage Heater LSU Sensor 1 Bank 1 / Information about the power stage" ULONG OneToOne 1 100 0.00 4294967295.00 FORMAT "%13.2" ECU_ADDRESS 0x600023EC /end MEASUREMENT
/begin MEASUREMENT UEGO_DiagHeatrWireS1B1_I.stInfoRaw "Class Diagnosis Powerstage Heater LSU Sensor 1 Bank 1 / Information about the power stage raw value" ULONG OneToOne 1 100 0.00 4294967295.00 FORMAT "%13.2" ECU_ADDRESS 0x600023F0 /end MEASUREMENT
/begin MEASUREMENT UEGO_DiagHeatrWireS1B1_I.stOffRaw "Class Diagnosis Powerstage Heater LSU Sensor 1 Bank 1 / Power stage has been switched off due to init failure of CJ135 ASIC raw value" ULONG OneToOne 1 100 0.00 4294967295.00 FORMAT "%13.2" ECU_ADDRESS 0x600023F4 /end MEASUREMENT
/begin MEASUREMENT UEGO_DiagHeatrWireS1B1_I.stPerdRaw "Class Diagnosis Powerstage Heater LSU Sensor 1 Bank 1 / Duty cycle period duration raw value" ULONG OneToOne 1 100 0.00 4294967295.00 FORMAT "%13.2" ECU_ADDRESS 0x600023F8 /end MEASUREMENT
/begin MEASUREMENT UEGO_DiagHeatrWireS1B1_I.stPlsRaw "Class Diagnosis Powerstage Heater LSU Sensor 1 Bank 1 / Duty cycle pulse duration raw value" ULONG OneToOne 1 100 0.00 4294967295.00 FORMAT "%13.2" ECU_ADDRESS 0x600023FC /end MEASUREMENT
/begin MEASUREMENT UEGO_DiagHeatrWireS1B1_I.stPolarityRaw "Class Diagnosis Powerstage Heater LSU Sensor 1 Bank 1 / Power stage active logic raw value" ULONG OneToOne 1 100 0.00 4294967295.00 FORMAT "%13.2" ECU_ADDRESS 0x60002400 /end MEASUREMENT
/begin MEASUREMENT UEGO_DiagHeatrWireS1B1_I.stProtdRaw "Class Diagnosis Powerstage Heater LSU Sensor 1 Bank 1 / Power stage switched off due protection function raw value" ULONG OneToOne 1 100 0.00 4294967295.00 FORMAT "%13.2" ECU_ADDRESS 0x60002404 /end MEASUREMENT
/begin MEASUREMENT UEGO_DiagHeatrWireS1B1_I.stPwrStgSuprt "Class Diagnosis Powerstage Heater LSU Sensor 1 Bank 1 / Combination of Power Stage Typ and Lambda Sensor Typ" UBYTE OneToOne 1 100 0.00 255.0 FORMAT "%5.1" ECU_ADDRESS 0x60002408 /end MEASUREMENT
/begin MEASUREMENT UEGO_DiagHeatrWireS1B1_I.stPwrStgTyp "Class Diagnosis Powerstage Heater LSU Sensor 1 Bank 1 / Used Power Stage Typ" UBYTE OneToOne 1 100 0.00 255.0 FORMAT "%5.1" ECU_ADDRESS 0x60002409 /end MEASUREMENT
/begin MEASUREMENT UEGO_DiagHeatrWireS1B1_I.stPwrStgTypRaw "Class Diagnosis Powerstage Heater LSU Sensor 1 Bank 1 / Used Power Stage Typ Raw Value" ULONG OneToOne 1 100 0.00 4294967295.00 FORMAT "%13.2" ECU_ADDRESS 0x6000240C /end MEASUREMENT
/begin MEASUREMENT UEGO_DiagHeatrWireS1B1_I.stTestPlsActvRaw "Class Diagnosis Powerstage Heater LSU Sensor 1 Bank 1 / Test pulse duration active raw value" ULONG OneToOne 1 100 0.00 4294967295.00 FORMAT "%13.2" ECU_ADDRESS 0x60002410 /end MEASUREMENT
/begin MEASUREMENT UEGO_DiagHeatrWireS1B1_I.stTestPlsIdleRaw "Class Diagnosis Powerstage Heater LSU Sensor 1 Bank 1 / Test pulse duration idle raw value" ULONG OneToOne 1 100 0.00 4294967295.00 FORMAT "%13.2" ECU_ADDRESS 0x60002414 /end MEASUREMENT
/begin MEASUREMENT UEGO_DiagHeatrWireS1B1_I.stToutRaw "Class Diagnosis Powerstage Heater LSU Sensor 1 Bank 1 / Power stage time out raw value" ULONG OneToOne 1 100 0.00 4294967295.00 FORMAT "%13.2" ECU_ADDRESS 0x60002418 /end MEASUREMENT
/begin MEASUREMENT UEGO_DiagHeatrWireS1B1_I.tiPerd "Class Diagnosis Powerstage Heater LSU Sensor 1 Bank 1 / Duty cycle period duration" ULONG Time_usec_q1_COMPU 1 100 0.00 4294967295.00 FORMAT "%13.2" ECU_ADDRESS 0x6000241C /end MEASUREMENT
/begin MEASUREMENT UEGO_DiagHeatrWireS1B1_I.tiPls "Class Diagnosis Powerstage Heater LSU Sensor 1 Bank 1 / Duty cycle pulse duration" ULONG Time_usec_q1_COMPU 1 100 0.00 4294967295.00 FORMAT "%13.2" ECU_ADDRESS 0x60002420 /end MEASUREMENT
/begin MEASUREMENT UEGO_DiagHeatrWireS1B1_I.tiTestPlsActv "Class Diagnosis Powerstage Heater LSU Sensor 1 Bank 1 / Test pulse duration active" ULONG Time_usec_q1_COMPU 1 100 0.00 4294967295.00 FORMAT "%13.2" ECU_ADDRESS 0x60002424 /end MEASUREMENT
/begin MEASUREMENT UEGO_DiagHeatrWireS1B1_I.tiTestPlsBreak "Class Diagnosis Powerstage Heater LSU Sensor 1 Bank 1 / Break time between the test pulses" UWORD Time_s 1 100 0.00 655.3500 FORMAT "%8.4" ECU_ADDRESS 0x60002428 /end MEASUREMENT
/begin MEASUREMENT UEGO_DiagHeatrWireS1B1_I.tiTestPlsIdle "Class Diagnosis Powerstage Heater LSU Sensor 1 Bank 1 / Test pulse duration idle" ULONG Time_usec_q1_COMPU 1 100 0.00 4294967295.00 FORMAT "%13.2" ECU_ADDRESS 0x6000242C /end MEASUREMENT
/begin MEASUREMENT UEGO_DiagHeatrWireS1B1_I.DsmPwrStgErrRawTONV_I.outbit "Class Diagnosis Powerstage Heater LSU Sensor 1 Bank 1 / Debounce time for power stage DSM error state / return value" UBYTE B_TRUE 1 100 0.00 1.00000000000 BIT_MASK 0x1 FORMAT "%13.11" ECU_ADDRESS 0x60002430 /end MEASUREMENT
/begin MEASUREMENT UEGO_DiagHeatrWireS1B1_I.DsmPwrStgErrRawTONV_I.time "Class Diagnosis Powerstage Heater LSU Sensor 1 Bank 1 / Debounce time for power stage DSM error state / expired delay time" UBYTE t_q0p02 1 100 0.00 5.100 FORMAT "%5.3" ECU_ADDRESS 0x60002431 /end MEASUREMENT
/begin MEASUREMENT UEGO_DiagHeatrWireS1B1_I.ErrOLRawTONV_I.outbit "Class Diagnosis Powerstage Heater LSU Sensor 1 Bank 1 / Filter time for OL power stage raw error / return value" UBYTE B_TRUE 1 100 0.00 1.00000000000 BIT_MASK 0x1 FORMAT "%13.11" ECU_ADDRESS 0x60002432 /end MEASUREMENT
/begin MEASUREMENT UEGO_DiagHeatrWireS1B1_I.ErrOLRawTONV_I.time "Class Diagnosis Powerstage Heater LSU Sensor 1 Bank 1 / Filter time for OL power stage raw error / expired delay time" UBYTE t_q0p02 1 100 0.00 5.100 FORMAT "%5.3" ECU_ADDRESS 0x60002433 /end MEASUREMENT
/begin MEASUREMENT UEGO_DiagHeatrWireS1B1_I.ErrSCBRawTONV_I.outbit "Class Diagnosis Powerstage Heater LSU Sensor 1 Bank 1 / Filter time for SCB power stage raw error / return value" UBYTE B_TRUE 1 100 0.00 1.00000000000 BIT_MASK 0x1 FORMAT "%13.11" ECU_ADDRESS 0x60002434 /end MEASUREMENT
/begin MEASUREMENT UEGO_DiagHeatrWireS1B1_I.ErrSCBRawTONV_I.time "Class Diagnosis Powerstage Heater LSU Sensor 1 Bank 1 / Filter time for SCB power stage raw error / expired delay time" UBYTE t_q0p02 1 100 0.00 5.100 FORMAT "%5.3" ECU_ADDRESS 0x60002435 /end MEASUREMENT
/begin MEASUREMENT UEGO_DiagHeatrWireS1B1_I.ErrSCGRawTONV_I.outbit "Class Diagnosis Powerstage Heater LSU Sensor 1 Bank 1 / Filter time for SCG power stage raw error / return value" UBYTE B_TRUE 1 100 0.00 1.00000000000 BIT_MASK 0x1 FORMAT "%13.11" ECU_ADDRESS 0x60002436 /end MEASUREMENT
/begin MEASUREMENT UEGO_DiagHeatrWireS1B1_I.ErrSCGRawTONV_I.time "Class Diagnosis Powerstage Heater LSU Sensor 1 Bank 1 / Filter time for SCG power stage raw error / expired delay time" UBYTE t_q0p02 1 100 0.00 5.100 FORMAT "%5.3" ECU_ADDRESS 0x60002437 /end MEASUREMENT
/begin MEASUREMENT UEGO_DiagHeatrWireS1B1_I.flgTestPlsReqdER_I.buffer "Class Diagnosis Powerstage Heater LSU Sensor 1 Bank 1 / Test Pulse is requested / rising edge detected" UBYTE B_TRUE 1 100 0.00 1.00000000000 BIT_MASK 0x1 FORMAT "%13.11" ECU_ADDRESS 0x60002438 /end MEASUREMENT
/begin MEASUREMENT UEGO_DiagHeatrWireS1B1_I.flgTestPlsReqdER_I.oldSignal "Class Diagnosis Powerstage Heater LSU Sensor 1 Bank 1 / Test Pulse is requested / flag rising edge" UBYTE B_TRUE 1 100 0.00 1.00000000000 BIT_MASK 0x1 FORMAT "%13.11" ECU_ADDRESS 0x60002439 /end MEASUREMENT
/begin MEASUREMENT UEGO_DiagRelsClsS1B1_I.stDiagRels "Class instance of the functional class of FC UEGO_DiagRels for Sensor 1 Bank 1 / Status bit - Release conditions for Diagnosis Report Release" UBYTE OneToOne 1 100 0.00 255.0 FORMAT "%5.1" ECU_ADDRESS 0x6000702C /end MEASUREMENT
/begin MEASUREMENT UEGO_DiagRelsClsS1B1_I.flgDiagRelsTOFFVNM_I.time "Class instance of the functional class of FC UEGO_DiagRels for Sensor 1 Bank 1 / Turn off delay for diagnose report release conditions / delay time" UWORD t_q0p01 1 100 0.00 655.3500 FORMAT "%8.4" ECU_ADDRESS 0x6000702E /end MEASUREMENT
/begin MEASUREMENT UEGO_DiagRels_cntrReiniProc10msec "Drive cycle counter that increments when system state exits Post-drive in 10ms proc" UBYTE OneToOne 1 100 0.00 255.0 FORMAT "%5.1" ECU_ADDRESS 0x6000B5AF /end MEASUREMENT
/begin MEASUREMENT UEGO_DiagSigAsicS1B1_I.flgDiagSigEcuAsicRst "Class instance of the function related with S1B1 / Reset of signals contributiing to the UEGO signal ASIC diagnosis" UBYTE B_TRUE 1 100 0.00 1.00000000000 BIT_MASK 0x1 FORMAT "%13.11" ECU_ADDRESS 0x6000701E /end MEASUREMENT
/begin MEASUREMENT UEGO_DiagSigAsicS1B1_I.flgDiagSigEcuAsicTstdOk "Class instance of the function related with S1B1 / UEGO signal ASIC diagnostic tested without fault results" UBYTE B_TRUE 1 100 0.00 1.00000000000 BIT_MASK 0x1 FORMAT "%13.11" ECU_ADDRESS 0x6000701F /end MEASUREMENT
/begin MEASUREMENT UEGO_DiagSigAsicS1B1_I.flgRstDsmClr "Class instance of the function related with S1B1 / flag for Reseting status report variable when dsm xclear is being requested" UBYTE B_TRUE 1 100 0.00 1.00000000000 BIT_MASK 0x1 FORMAT "%13.11" ECU_ADDRESS 0x60007020 /end MEASUREMENT
/begin MEASUREMENT UEGO_DiagSigAsicS1B1_I.flgRstExtReq "Class instance of the function related with S1B1 / External reset request" UBYTE B_TRUE 1 100 0.00 1.00000000000 BIT_MASK 0x1 FORMAT "%13.11" ECU_ADDRESS 0x60007021 /end MEASUREMENT
/begin MEASUREMENT UEGO_DiagSigAsicS1B1_I.stDiagSigEcuAsicCyc "Class instance of the function related with S1B1 / UEGO detailed status on signal ASIC diagnosis" UWORD dez 1 100 0.00 65535.00 FORMAT "%8.2" ECU_ADDRESS 0x60007022 /end MEASUREMENT
/begin MEASUREMENT UEGO_DiagSigAsicS1B1_I.stDiagSigEcuAsicRprt "Class instance of the function related with S1B1 / Local variable about Detailed fault status of UEGO ASIC diagnosis for sensor x on bank y in DFC_UegoSigEcuAsicSxBy" UWORD dez 1 100 0.00 65535.00 FORMAT "%8.2" ECU_ADDRESS 0x60038D9C /end MEASUREMENT
/begin MEASUREMENT UEGO_DiagSigAsicS1B1_I.UEGO_DiagSigEcuAsicResClass_I.stErr "Class instance of the function related with S1B1 / Class instance processing information for diagnosis result. / error detection status of individual fault path." UWORD dez 1 100 0.00 65535.00 FORMAT "%8.2" ECU_ADDRESS 0x60007024 /end MEASUREMENT
/begin MEASUREMENT UEGO_DiagSigAsicS1B1_I.UEGO_DiagSigEcuAsicResClass_I.stTstdCyc "Class instance of the function related with S1B1 / Class instance processing information for diagnosis result. / bitwise status of fault path tested result." UWORD dez 1 100 0.00 65535.00 FORMAT "%8.2" ECU_ADDRESS 0x60007026 /end MEASUREMENT
/begin MEASUREMENT UEGO_DiagSigAsicS1B1_I.UEGO_DiagSigEcuAsicResClass_I.stTstdCycRprt "Class instance of the function related with S1B1 / Class instance processing information for diagnosis result. / bitwise status of fault path tested result with report released." UWORD dez 1 100 0.00 65535.00 FORMAT "%8.2" ECU_ADDRESS 0x60007028 /end MEASUREMENT
/begin MEASUREMENT UEGO_DiagSigAsicS1B1_I.UEGO_flgDsmErrDebERNM_I.oldSignal "Class instance of the function related with S1B1 / DSM ECU ASIC error debounce flag / value of input signal last calculation" UBYTE B_TRUE 1 100 0.00 1.00000000000 BIT_MASK 0x1 FORMAT "%13.11" ECU_ADDRESS 0x6000702A /end MEASUREMENT
/begin MEASUREMENT UEGO_DiagSigAsicS1B1_I.UEGO_flgDsmTstERNM_I.oldSignal "Class instance of the function related with S1B1 / DSM ECU ASIC Test flag / value of input signal last calculation" UBYTE B_TRUE 1 100 0.00 1.00000000000 BIT_MASK 0x1 FORMAT "%13.11" ECU_ADDRESS 0x6000702B /end MEASUREMENT
/begin MEASUREMENT UEGO_DiagSigEcuComS1B1_I.flgDiagSigEcuComIDLEReq "Class instance of UEGO_DiagSigEcuCom for sensor 1 bank 1 / flag to require IDLE mode from diag sig" UBYTE B_TRUE 1 100 0.00 1.00000000000 BIT_MASK 0x1 FORMAT "%13.11" ECU_ADDRESS 0x60007010 /end MEASUREMENT
/begin MEASUREMENT UEGO_DiagSigEcuComS1B1_I.flgDiagSigEcuComRst "Class instance of UEGO_DiagSigEcuCom for sensor 1 bank 1 / Reset of signals contributiing to the UEGO signal communication diagnosis" UBYTE B_TRUE 1 100 0.00 1.00000000000 BIT_MASK 0x1 FORMAT "%13.11" ECU_ADDRESS 0x60007011 /end MEASUREMENT
/begin MEASUREMENT UEGO_DiagSigEcuComS1B1_I.flgDiagSigEcuComTstdOk "Class instance of UEGO_DiagSigEcuCom for sensor 1 bank 1 / UEGO signal communication diagnostic tested without fault results" UBYTE B_TRUE 1 100 0.00 1.00000000000 BIT_MASK 0x1 FORMAT "%13.11" ECU_ADDRESS 0x60007012 /end MEASUREMENT
/begin MEASUREMENT UEGO_DiagSigEcuComS1B1_I.flgRstDsmClr "Class instance of UEGO_DiagSigEcuCom for sensor 1 bank 1 / flag for Reseting status report variable when dsm xclear is being requested" UBYTE B_TRUE 1 100 0.00 1.00000000000 BIT_MASK 0x1 FORMAT "%13.11" ECU_ADDRESS 0x60007013 /end MEASUREMENT
/begin MEASUREMENT UEGO_DiagSigEcuComS1B1_I.flgRstExtReq "Class instance of UEGO_DiagSigEcuCom for sensor 1 bank 1 / External Reset Request" UBYTE B_TRUE 1 100 0.00 1.00000000000 BIT_MASK 0x1 FORMAT "%13.11" ECU_ADDRESS 0x60007014 /end MEASUREMENT
/begin MEASUREMENT UEGO_DiagSigEcuComS1B1_I.stDiagSigEcuComCyc "Class instance of UEGO_DiagSigEcuCom for sensor 1 bank 1 / UEGO detailed status on signal communication diagnosis" UBYTE dez 1 100 0.00 255.0 FORMAT "%5.1" ECU_ADDRESS 0x60007015 /end MEASUREMENT
/begin MEASUREMENT UEGO_DiagSigEcuComS1B1_I.stDiagSigEcuComRprt "Class instance of UEGO_DiagSigEcuCom for sensor 1 bank 1 / Local variable about Detailed fault status of UEGO ASIC diagnosis for sensor x on bank y in DFC_UegoSigEcuComSxBy" UWORD OneToOne 1 100 0.00 65535.00 FORMAT "%8.2" ECU_ADDRESS 0x60038D98 /end MEASUREMENT
/begin MEASUREMENT UEGO_DiagSigEcuComS1B1_I.UEGO_DiagSigEcuComResClass_I.stErr "Class instance of UEGO_DiagSigEcuCom for sensor 1 bank 1 / Public class providing diagnosis result / error detection status of individual fault path." UWORD dez 1 100 0.00 65535.00 FORMAT "%8.2" ECU_ADDRESS 0x60007016 /end MEASUREMENT
/begin MEASUREMENT UEGO_DiagSigEcuComS1B1_I.UEGO_DiagSigEcuComResClass_I.stTstdCyc "Class instance of UEGO_DiagSigEcuCom for sensor 1 bank 1 / Public class providing diagnosis result / bitwise status of fault path tested result." UWORD dez 1 100 0.00 65535.00 FORMAT "%8.2" ECU_ADDRESS 0x60007018 /end MEASUREMENT
/begin MEASUREMENT UEGO_DiagSigEcuComS1B1_I.UEGO_DiagSigEcuComResClass_I.stTstdCycRprt "Class instance of UEGO_DiagSigEcuCom for sensor 1 bank 1 / Public class providing diagnosis result / bitwise status of fault path tested result with report released." UWORD dez 1 100 0.00 65535.00 FORMAT "%8.2" ECU_ADDRESS 0x6000701A /end MEASUREMENT
/begin MEASUREMENT UEGO_DiagSigEcuComS1B1_I.UEGO_flgDsmErrDebERNM_I.oldSignal "Class instance of UEGO_DiagSigEcuCom for sensor 1 bank 1 / DSM ECU Com error Debounce flag / value of input signal last calculation" UBYTE B_TRUE 1 100 0.00 1.00000000000 BIT_MASK 0x1 FORMAT "%13.11" ECU_ADDRESS 0x6000701C /end MEASUREMENT
/begin MEASUREMENT UEGO_DiagSigEcuComS1B1_I.UEGO_flgDsmTstERNM_I.oldSignal "Class instance of UEGO_DiagSigEcuCom for sensor 1 bank 1 / DSM ECU com test flag / value of input signal last calculation" UBYTE B_TRUE 1 100 0.00 1.00000000000 BIT_MASK 0x1 FORMAT "%13.11" ECU_ADDRESS 0x6000701D /end MEASUREMENT
/begin MEASUREMENT UEGO_flgDiagRprtRelsS1B1 "Release of diagnosis report sensor 1 bank 1" UBYTE B_TRUE 1 100 0.00 1.00000000000 BIT_MASK 0x1 FORMAT "%13.11" ECU_ADDRESS 0x7000073F /end MEASUREMENT
/begin MEASUREMENT UEGO_flgDiagSigEcuAsicExtRstReq "External reset request flag for EcuAsic diagnosis" UBYTE B_TRUE 1 100 0.00 1.00000000000 BIT_MASK 0x1 FORMAT "%13.11" ECU_ADDRESS 0x700000D3 /end MEASUREMENT
/begin MEASUREMENT UEGO_flgDiagSigEcuAsicRstS1B1 "Reset of signals contributiing to the UEGO signal ASIC diagnosis for sensor 1 at bank 1" UBYTE B_TRUE 1 100 0.00 1.00000000000 BIT_MASK 0x1 FORMAT "%13.11" ECU_ADDRESS 0x7000073D /end MEASUREMENT
/begin MEASUREMENT UEGO_flgDiagSigEcuAsicTstdOkS1B1 "UEGO signal ASIC diagnostic tested without fault results for sensor 1 at bank 1" UBYTE B_TRUE 1 100 0.00 1.00000000000 BIT_MASK 0x1 FORMAT "%13.11" ECU_ADDRESS 0x7000073C /end MEASUREMENT
/begin MEASUREMENT UEGO_flgDiagSigEcuComExtRstReq "External reset request flag for EcuCom diagnosis" UBYTE B_TRUE 1 100 0.00 1.00000000000 BIT_MASK 0x1 FORMAT "%13.11" ECU_ADDRESS 0x700000D2 /end MEASUREMENT
/begin MEASUREMENT UEGO_flgDiagSigEcuComRstS1B1 "Reset flag for signals contributiing to the UEGO signal communication diagnosis for sensor 1 bank 1" UBYTE B_TRUE 1 100 0.00 1.00000000000 BIT_MASK 0x1 FORMAT "%13.11" ECU_ADDRESS 0x7000073B /end MEASUREMENT
/begin MEASUREMENT UEGO_flgDiagSigEcuComTstdOkS1B1 "UEGO signal communication diagnostic tested without fault results at sensor position 1 bank1" UBYTE B_TRUE 1 100 0.00 1.00000000000 BIT_MASK 0x1 FORMAT "%13.11" ECU_ADDRESS 0x7000073A /end MEASUREMENT
/begin MEASUREMENT UEGO_flgDsmVld "information if DFCs DTRs and FIds may be accessed or not in UEGO because of DSM ReIni" UBYTE B_TRUE 1 100 0.00 1.00000000000 BIT_MASK 0x1 FORMAT "%13.11" ECU_ADDRESS 0x7000072C /end MEASUREMENT
/begin MEASUREMENT UEGO_flgDsmVldFF_I.status "DSM validity flip flop / current value of RS-FF" UBYTE B_TRUE 1 100 0.00 1.00000000000 BIT_MASK 0x1 FORMAT "%13.11" ECU_ADDRESS 0x6000B5AE /end MEASUREMENT
/begin MEASUREMENT UEGO_flgHeatrErrOLRawS1B1 "Raw error flag for an open load error at the heater power stage" UBYTE B_TRUE 1 100 0.00 1.00000000000 BIT_MASK 0x1 FORMAT "%13.11" ECU_ADDRESS 0x6000F8C1 /end MEASUREMENT
/begin MEASUREMENT UEGO_flgHeatrErrSCBRawS1B1 "Raw error flag for a short circuit to battery error at the heater power stage" UBYTE B_TRUE 1 100 0.00 1.00000000000 BIT_MASK 0x1 FORMAT "%13.11" ECU_ADDRESS 0x6000F8C0 /end MEASUREMENT
/begin MEASUREMENT UEGO_flgHeatrErrSCGRawS1B1 "Raw error flag for a short circuit to ground error at the heater power stage" UBYTE B_TRUE 1 100 0.00 1.00000000000 BIT_MASK 0x1 FORMAT "%13.11" ECU_ADDRESS 0x6000F8BF /end MEASUREMENT
/begin MEASUREMENT UEGO_flgHeatrPrfmncLoErrS1B1 "Error Heater Lambda Sensor (LSU), Heating perfomance too low" UBYTE B_TRUE 1 100 0.00 1.00000000000 BIT_MASK 0x1 FORMAT "%13.11" ECU_ADDRESS 0x6000F660 /end MEASUREMENT
/begin MEASUREMENT UEGO_flgHeatrPsErrS1B1 "Sum Error Heater; Sensor 1, Bank 1" UBYTE B_TRUE 1 100 0.00 1.00000000000 BIT_MASK 0x1 FORMAT "%13.11" ECU_ADDRESS 0x6000F8BE /end MEASUREMENT
/begin MEASUREMENT UEGO_flgHeatrPwrStgSuprtdS1B1 "Indication, if mounted power stage is supported by software for Sensor 1 Bank 1" UBYTE B_TRUE 1 100 0.00 1.00000000000 BIT_MASK 0x1 FORMAT "%13.11" ECU_ADDRESS 0x6000F8BD /end MEASUREMENT
/begin MEASUREMENT UEGO_ratIPmpRawS1B1 "raw value of the duty cycle of the pumping current sensor1 bank 1" SWORD fak_q1p201Em4 1 100 -3.936096 3.935976 FORMAT "%8.6" ARRAY_SIZE 15 ECU_ADDRESS 0x50005E56 /end MEASUREMENT
/begin MEASUREMENT UEGO_stDiagSigEcuAsicCycS1B1 "UEGO detailed status on signal ASIC diagnosis for sensor 1 at bank 1" UWORD dez 1 100 0.00 65535.00 FORMAT "%8.2" ECU_ADDRESS 0x6000939A /end MEASUREMENT
/begin MEASUREMENT UEGO_stDiagSigEcuAsicRprtS1B1 "Detailed fault status of UEGO ASIC diagnosis for sensor 1 on bank 1 in DFC_UegoSigEcuAsicS1B1" UWORD dez 1 100 0.00 65535.00 FORMAT "%8.2" ECU_ADDRESS 0x60038D9E /end MEASUREMENT
/begin MEASUREMENT UEGO_stDiagSigEcuComCycS1B1 "UEGO detailed status on signal communication diagnosis at sensor 1 bank 1" UWORD dez 1 100 0.00 65535.00 FORMAT "%8.2" ECU_ADDRESS 0x60009398 /end MEASUREMENT
/begin MEASUREMENT UEGO_stDiagSigEcuComRprtS1B1 "Detailed fault status of UEGO sensor diagnosis for sensor 1 on bank 1 in DFC_UegoSigEcuComS1B1" UWORD OneToOne 1 100 0.00 65535.00 FORMAT "%8.2" ECU_ADDRESS 0x60038D9A /end MEASUREMENT
/begin MEASUREMENT UEGO_uUa2PckAryS1B1 "Array for electrically corrected voltage Ua2 sensor 1 bank 1" SWORD spg_q3p2Em4_V 1 100 -10.48576 10.48544 FORMAT "%8.5" ARRAY_SIZE 5 ECU_ADDRESS 0x50005E74 /end MEASUREMENT
/begin MEASUREMENT UEGO_uUgaPckAryS1B1 "Array for electrically corrected voltage Uga sensor 1 bank 1" SWORD spg_q3p2Em4_V 1 100 -10.48576 10.48544 FORMAT "%8.5" ARRAY_SIZE 5 ECU_ADDRESS 0x50005E7E /end MEASUREMENT
/begin MEASUREMENT UEGO_uUgiPckAryS1B1 "Array for electrically corrected voltage Ugi sensor 1 bank 1" SWORD spg_q3p2Em4_V 1 100 -10.48576 10.48544 FORMAT "%8.5" ARRAY_SIZE 5 ECU_ADDRESS 0x50005E88 /end MEASUREMENT
/begin MEASUREMENT UEGO_uUi21PckAryS1B1 "electrically corrected voltage Ui21 sensor 1 bank 1" SWORD spg_q3p2Em4_V 1 100 -10.48576 10.48544 FORMAT "%8.5" ARRAY_SIZE 5 ECU_ADDRESS 0x50005E92 /end MEASUREMENT
/begin MEASUREMENT UEGO_uUn0PckAryS1B1 "Array electrically corrected nernst voltage Un0 sensor 1 bank 1" SWORD spg_q3p2Em4_V 1 100 -10.48576 10.48544 FORMAT "%8.5" ARRAY_SIZE 15 ECU_ADDRESS 0x50005E9C /end MEASUREMENT
/begin MEASUREMENT UEGO_uUp0PckAryS1B1 "Array for package pump voltages of sensor 1 bank 1" SWORD spg_q3p2Em4_V 1 100 -10.48576 10.48544 FORMAT "%8.5" ARRAY_SIZE 15 ECU_ADDRESS 0x50005EBA /end MEASUREMENT
/begin MEASUREMENT UEGO_uUpPckAryS1B1 "Array for package pump voltages of sensor 1 bank 1" SWORD spg_q3p2Em4_V 1 100 -10.48576 10.48544 FORMAT "%8.5" ARRAY_SIZE 5 ECU_ADDRESS 0x50005ED8 /end MEASUREMENT
/begin MEASUREMENT UEGO_uUriePckAryS1B1 "electrically corrected voltage Urie sensor 1 bank 1" SWORD spg_q3p2Em4_V 1 100 -10.48576 10.48544 FORMAT "%8.5" ARRAY_SIZE 5 ECU_ADDRESS 0x50005EE2 /end MEASUREMENT
/begin FUNCTION UEGO_Data "1.18.0    UEGO Aquisition of Measurement Data"
 /begin DEF_CHARACTERISTIC UEGO_facFkalFltConst_C UEGO_ratCmnModCorrn_C UEGO_ratFkalCorrn_C UEGO_uGndOffCorrn_C UEGO_tiCalib_C UEGO_tiOptLon_C UEGO_tiOptShrt_C UEGO_resRsgmspm_C UEGO_tiDlyNewPckMiss_C /end DEF_CHARACTERISTIC
 /begin REF_CHARACTERISTIC UEGO_resRGnd_C UEGO_idxHWES1B1_C /end REF_CHARACTERISTIC
 /begin IN_MEASUREMENT UEGO_flgCJ135AnS1B1 UEGO_flgDiagSigEcuAsicRstS1B1 UEGO_flgIsqMeasVldS1B1 UEGO_flgSysSuprtdS1B1 UEGO_iIsqMeasS1B1 UEGO_RegGetPrmS1B1_I.flgDlyBlcknNxtPckVld UEGO_RegGetPrmS1B1_I.flgDlyBlcknVld UEGO_RegGetPrmS1B1_I.flgDspDiagDis UEGO_RegGetPrmS1B1_I.flgDspDiagDisNxtPck UEGO_RegGetPrmS1B1_I.flgDspDiagDisNxtPckVld UEGO_RegGetPrmS1B1_I.flgDspDiagDisVld UEGO_RegGetPrmS1B1_I.flgEnSpA UEGO_RegGetPrmS1B1_I.flgEnSpAVld UEGO_RegGetPrmS1B1_I.flgEnSpE UEGO_RegGetPrmS1B1_I.flgEnSpEVld UEGO_RegGetPrmS1B1_I.flgEnSpNxtPckVld UEGO_RegGetPrmS1B1_I.flgEnSpVld UEGO_RegGetPrmS1B1_I.flgIPmpBlcknNxtPckVld UEGO_RegGetPrmS1B1_I.flgIPmpBlcknVld UEGO_RegGetPrmS1B1_I.flgIPmpLimnHiVld UEGO_RegGetPrmS1B1_I.flgIPmpLimnLoVld UEGO_RegGetPrmS1B1_I.flgIPmpRst UEGO_RegGetPrmS1B1_I.flgIPmpRstNxtPck UEGO_RegGetPrmS1B1_I.flgIPmpRstNxtPckVld UEGO_RegGetPrmS1B1_I.flgIPmpRstVld UEGO_RegGetPrmS1B1_I.flgIPmpSm UEGO_RegGetPrmS1B1_I.flgIPmpSmNxtPck UEGO_RegGetPrmS1B1_I.flgIPmpSmNxtPckVld UEGO_RegGetPrmS1B1_I.flgIPmpSmVld UEGO_RegGetPrmS1B1_I.flgLCal UEGO_RegGetPrmS1B1_I.flgLCalVld UEGO_RegGetPrmS1B1_I.flgLCurr UEGO_RegGetPrmS1B1_I.flgLCurrVld UEGO_RegGetPrmS1B1_I.flgLDAC UEGO_RegGetPrmS1B1_I.flgLDACConf UEGO_RegGetPrmS1B1_I.flgLDACConfVld UEGO_RegGetPrmS1B1_I.flgLDACVld UEGO_RegGetPrmS1B1_I.flgLG0 UEGO_RegGetPrmS1B1_I.flgLG0Vld UEGO_RegGetPrmS1B1_I.flgLN UEGO_RegGetPrmS1B1_I.flgLNNxtPck UEGO_RegGetPrmS1B1_I.flgLNNxtPckVld UEGO_RegGetPrmS1B1_I.flgLNVld UEGO_RegGetPrmS1B1_I.flgLP UEGO_RegGetPrmS1B1_I.flgLPNxtPck UEGO_RegGetPrmS1B1_I.flgLPNxtPckVld UEGO_RegGetPrmS1B1_I.flgLPVld UEGO_RegGetPrmS1B1_I.flgMKA UEGO_RegGetPrmS1B1_I.flgMKAVld UEGO_RegGetPrmS1B1_I.flgMKE UEGO_RegGetPrmS1B1_I.flgMKEVld UEGO_RegGetPrmS1B1_I.flgMKNxtPckVld UEGO_RegGetPrmS1B1_I.flgMKVld UEGO_RegGetPrmS1B1_I.flgN3MeasActvNxtPck UEGO_RegGetPrmS1B1_I.flgN3MeasActvNxtPckVld UEGO_RegGetPrmS1B1_I.flgOFFNxtPckVld UEGO_RegGetPrmS1B1_I.flgOFFVld UEGO_RegGetPrmS1B1_I.flgOPTNxtPckVld UEGO_RegGetPrmS1B1_I.flgOPTVld UEGO_RegGetPrmS1B1_I.flgPatNxtPckVld UEGO_RegGetPrmS1B1_I.flgPatVld UEGO_RegGetPrmS1B1_I.flgRCmpHeatrEdgeShiftAllwd UEGO_RegGetPrmS1B1_I.flgRCmpHeatrEdgeShiftAllwdNxtPck UEGO_RegGetPrmS1B1_I.flgRCmpHeatrEdgeShiftAllwdNxtPckVld UEGO_RegGetPrmS1B1_I.flgRCmpHeatrEdgeShiftAllwdVld UEGO_RegGetPrmS1B1_I.flgReStab UEGO_RegGetPrmS1B1_I.flgReStabVld UEGO_RegGetPrmS1B1_I.flgRefNxtPckVld UEGO_RegGetPrmS1B1_I.flgRefPatChng UEGO_RegGetPrmS1B1_I.flgRefPatNxtPckVld UEGO_RegGetPrmS1B1_I.flgRefPatVld UEGO_RegGetPrmS1B1_I.flgRefVld UEGO_RegGetPrmS1B1_I.flgRegIPmpSetNxtPckVld UEGO_RegGetPrmS1B1_I.flgRegIPmpSetVld UEGO_RegGetPrmS1B1_I.flgRegIpoffChng UEGO_RegGetPrmS1B1_I.flgRegIpoffNxtPckVld UEGO_RegGetPrmS1B1_I.flgRegIpoffVld UEGO_RegGetPrmS1B1_I.flgRegModNxtPckVld UEGO_RegGetPrmS1B1_I.flgRegModVld UEGO_RegGetPrmS1B1_I.flgRegPartModNxtPckVld UEGO_RegGetPrmS1B1_I.flgRegPartModVld UEGO_RegGetPrmS1B1_I.flgRegUnsetNxtPckVld UEGO_RegGetPrmS1B1_I.flgRiaPatChng UEGO_RegGetPrmS1B1_I.flgRiaPatVld UEGO_RegGetPrmS1B1_I.flgRipVld UEGO_RegGetPrmS1B1_I.flgSngCell UEGO_RegGetPrmS1B1_I.flgSngCellVld UEGO_RegGetPrmS1B1_I.flgSteerPatChng UEGO_RegGetPrmS1B1_I.flgSteerPatNxtPckVld UEGO_RegGetPrmS1B1_I.flgSteerPatVld UEGO_RegGetPrmS1B1_I.flgSubModMeasNxtPckVld UEGO_RegGetPrmS1B1_I.flgSubModMeasVld UEGO_RegGetPrmS1B1_I.flgSwVirtGnd UEGO_RegGetPrmS1B1_I.flgSwVirtGndVld UEGO_RegGetPrmS1B1_I.flgTrimSqChng UEGO_RegGetPrmS1B1_I.flgTrimSqrCalChng UEGO_RegGetPrmS1B1_I.flgTrimSqrChng UEGO_RegGetPrmS1B1_I.flgTrmNxtPckVld UEGO_RegGetPrmS1B1_I.flgTrmSqCalOffSet UEGO_RegGetPrmS1B1_I.flgTrmSqCalVld UEGO_RegGetPrmS1B1_I.flgTrmSqOffSet UEGO_RegGetPrmS1B1_I.flgTrmSqOffSetVld UEGO_RegGetPrmS1B1_I.flgTrmSqVld UEGO_RegGetPrmS1B1_I.flgTrmSqrCalOffSet UEGO_RegGetPrmS1B1_I.flgTrmSqrCalVld UEGO_RegGetPrmS1B1_I.flgTrmSqrOffSet UEGO_RegGetPrmS1B1_I.flgTrmSqrOffSetVld UEGO_RegGetPrmS1B1_I.flgTrmSqrVld UEGO_RegGetPrmS1B1_I.flgUnsetVld UEGO_RegGetPrmS1B1_I.flgUp0LeanNxtPckVld UEGO_RegGetPrmS1B1_I.flgUp0LeanVld UEGO_RegGetPrmS1B1_I.flgUp0RichNxtPckVld UEGO_RegGetPrmS1B1_I.flgUp0RichVld UEGO_RegGetPrmS1B1_I.flgUria UEGO_RegGetPrmS1B1_I.flgUriaNxtPck UEGO_RegGetPrmS1B1_I.flgUriaNxtPckVld UEGO_RegGetPrmS1B1_I.flgUriaVld UEGO_RegGetPrmS1B1_I.flgV1BF2NxtPckVld UEGO_RegGetPrmS1B1_I.flgV1BF2Vld UEGO_RegGetPrmS1B1_I.flgV1BF3NxtPckVld UEGO_RegGetPrmS1B1_I.flgV1BIT1 UEGO_RegGetPrmS1B1_I.flgV1BIT1NxtPck UEGO_RegGetPrmS1B1_I.flgV1BIT1NxtPckVld UEGO_RegGetPrmS1B1_I.flgV1BIT1Vld UEGO_RegGetPrmS1B1_I.flgV1BIT2 UEGO_RegGetPrmS1B1_I.flgV1BIT2NxtPck UEGO_RegGetPrmS1B1_I.flgV1BIT2NxtPckVld UEGO_RegGetPrmS1B1_I.flgV1BIT2Vld UEGO_RegGetPrmS1B1_I.flgV1BIT5 UEGO_RegGetPrmS1B1_I.flgV1BIT5NxtPck UEGO_RegGetPrmS1B1_I.flgV1BIT5NxtPckVld UEGO_RegGetPrmS1B1_I.flgV1BIT5Vld UEGO_RegGetPrmS1B1_I.flgWtrEleclyActv UEGO_RegGetPrmS1B1_I.flgWtrEleclyActvNxtPck UEGO_RegGetPrmS1B1_I.flgWtrEleclyActvNxtPckVld UEGO_RegGetPrmS1B1_I.flgWtrEleclyActvVld UEGO_RegGetPrmS1B1_I.flgZIsqrA UEGO_RegGetPrmS1B1_I.flgZIsqrAVld UEGO_RegGetPrmS1B1_I.flgZIsqrE UEGO_RegGetPrmS1B1_I.flgZIsqrEVld UEGO_RegGetPrmS1B1_I.nrIPmpBlcknNxtPck UEGO_RegGetPrmS1B1_I.nrIPmpLimnHi UEGO_RegGetPrmS1B1_I.nrIPmpLimnLo UEGO_RegGetPrmS1B1_I.nrPmpBlckn UEGO_RegGetPrmS1B1_I.nrRefPatNxtPck UEGO_RegGetPrmS1B1_I.nrRegIPmpSet UEGO_RegGetPrmS1B1_I.nrRegIPmpSetNxtPck UEGO_RegGetPrmS1B1_I.nrRegIpoff UEGO_RegGetPrmS1B1_I.nrRegMod UEGO_RegGetPrmS1B1_I.nrRegModNxtPck UEGO_RegGetPrmS1B1_I.nrRegPartMod UEGO_RegGetPrmS1B1_I.nrRegPartModNxtPck UEGO_RegGetPrmS1B1_I.nrRegTrmNxtPck UEGO_RegGetPrmS1B1_I.nrRegTrmSqNxtPck UEGO_RegGetPrmS1B1_I.nrRegTrmSqrNxtPck UEGO_RegGetPrmS1B1_I.nrRip UEGO_RegGetPrmS1B1_I.nrSteerPatNxtPck UEGO_RegGetPrmS1B1_I.nrSubModMeas UEGO_RegGetPrmS1B1_I.nrSubModMeasNxtPck UEGO_RegGetPrmS1B1_I.nrTrmSq UEGO_RegGetPrmS1B1_I.nrTrmSqCal UEGO_RegGetPrmS1B1_I.nrTrmSqr UEGO_RegGetPrmS1B1_I.nrTrmSqrCal UEGO_RegGetPrmS1B1_I.nrUnset UEGO_RegGetPrmS1B1_I.nrUnsetNxtPck UEGO_RegGetPrmS1B1_I.nrUp0Lean UEGO_RegGetPrmS1B1_I.nrUp0LeanNxtPck UEGO_RegGetPrmS1B1_I.nrUp0Rich UEGO_RegGetPrmS1B1_I.nrUp0RichNxtPck UEGO_RegGetPrmS1B1_I.stDlyBlckn UEGO_RegGetPrmS1B1_I.stDlyBlcknNxtPck UEGO_RegGetPrmS1B1_I.stEnSp UEGO_RegGetPrmS1B1_I.stEnSpNxtPck UEGO_RegGetPrmS1B1_I.stMK UEGO_RegGetPrmS1B1_I.stMKNxtPck UEGO_RegGetPrmS1B1_I.stOFF UEGO_RegGetPrmS1B1_I.stOFFNxtPck UEGO_RegGetPrmS1B1_I.stOPT UEGO_RegGetPrmS1B1_I.stOPTNxtPck UEGO_RegGetPrmS1B1_I.stPat UEGO_RegGetPrmS1B1_I.stPatNxtPck UEGO_RegGetPrmS1B1_I.stRef UEGO_RegGetPrmS1B1_I.stRefNxtPck UEGO_RegGetPrmS1B1_I.stRefPat UEGO_RegGetPrmS1B1_I.stRegIpoffNxtPck UEGO_RegGetPrmS1B1_I.stRiaPat UEGO_RegGetPrmS1B1_I.stSteerPat UEGO_RegGetPrmS1B1_I.stV1BF2 UEGO_RegGetPrmS1B1_I.stV1BF2NxtPck UEGO_RegGetPrmS1B1_I.stV1BF3NxtPck UEGO_RegSetS1B1_I.cntrRegSet UEGO_RegSetS1B1_I.flgCJ135An UEGO_RegSetS1B1_I.flgConvVld UEGO_RegSetS1B1_I.flgIPmpDes UEGO_RegSetS1B1_I.flgIPmpPhyRels UEGO_RegSetS1B1_I.flgIniFinshd UEGO_RegSetS1B1_I.flgLoupeCURRDes UEGO_RegSetS1B1_I.flgLoupeDACDes UEGO_RegSetS1B1_I.flgLoupeNDes UEGO_RegSetS1B1_I.flgLoupePDes UEGO_RegSetS1B1_I.flgNewReq UEGO_RegSetS1B1_I.flgRegSetSt UEGO_RegSetS1B1_I.flgRegSetStVld UEGO_RegSetS1B1_I.flgReqAcptd UEGO_RegSetS1B1_I.flgSetRegOk UEGO_RegSetS1B1_I.flgTakeDataOk UEGO_RegSetS1B1_I.idxChp UEGO_RegSetS1B1_I.nrIdleSubMode UEGO_RegSetS1B1_I.nrModDes UEGO_RegSetS1B1_I.nrNormSubMode UEGO_RegSetS1B1_I.nrRegSet UEGO_RegSetS1B1_I.nrSubModDes UEGO_RegSetS1B1_I.nrSwtOnSubMode UEGO_RegSetS1B1_I.nrTrmSq UEGO_RegSetS1B1_I.nrWrmUpSubMode UEGO_RegSetS1B1_I.stRegSet UEGO_RegSetS1B1_I.stRegSetVld UEGO_RegSetS1B1_I.tmpVar UEGO_uVCC3RefS1B1 /end IN_MEASUREMENT
 /begin OUT_MEASUREMENT UEGO_CJ135CalcElecCorrnS1B1.flgFKal1Strtd UEGO_CJ135CalcElecCorrnS1B1.flgFKal2Strtd UEGO_CJ135CalcElecCorrnS1B1.flgFKal3Strtd UEGO_CJ135CalcElecCorrnS1B1.flgUoffgnd1Vld UEGO_CJ135CalcElecCorrnS1B1.flgUoffgnd2Vld UEGO_CJ135CalcElecCorrnS1B1.flgUoffgnd3Vld UEGO_CJ135CalcElecCorrnS1B1.flgUoffipe1Z1Vld UEGO_CJ135CalcElecCorrnS1B1.flgUoffipe1Z2Vld UEGO_CJ135CalcElecCorrnS1B1.flgUoffipe2Z1Vld UEGO_CJ135CalcElecCorrnS1B1.flgUoffipe2Z2Vld UEGO_CJ135CalcElecCorrnS1B1.flgUoffmesVld UEGO_CJ135CalcElecCorrnS1B1.flgUoffvcc1Vld UEGO_CJ135CalcElecCorrnS1B1.flgUoffvcc2Vld UEGO_CJ135CalcElecCorrnS1B1.flgUoffvcc3Vld UEGO_CJ135CalcElecCorrnS1B1.flgUoffvcci1Vld UEGO_CJ135CalcElecCorrnS1B1.flgUoffvcci2Vld UEGO_CJ135CalcElecCorrnS1B1.flgnCmnMod1Strtd UEGO_CJ135CalcElecCorrnS1B1.flgnCmnMod2Strtd UEGO_CJ135CalcElecCorrnS1B1.flgnumUref22Strtd UEGO_CJ135CalcElecCorrnS1B1.nrUoffgnd1 UEGO_CJ135CalcElecCorrnS1B1.nrUoffgnd2 UEGO_CJ135CalcElecCorrnS1B1.nrUoffgnd3 UEGO_CJ135CalcElecCorrnS1B1.nrUoffipe1Z1 UEGO_CJ135CalcElecCorrnS1B1.nrUoffipe1Z2 UEGO_CJ135CalcElecCorrnS1B1.nrUoffipe2Z1 UEGO_CJ135CalcElecCorrnS1B1.nrUoffipe2Z2 UEGO_CJ135CalcElecCorrnS1B1.nrUoffmes UEGO_CJ135CalcElecCorrnS1B1.nrUoffvcc1 UEGO_CJ135CalcElecCorrnS1B1.nrUoffvcc2 UEGO_CJ135CalcElecCorrnS1B1.nrUoffvcc3 UEGO_CJ135CalcElecCorrnS1B1.nrUoffvcci1 UEGO_CJ135CalcElecCorrnS1B1.nrUoffvcci2 UEGO_CJ135CalcElecCorrnS1B1.numUref1Corrd UEGO_CJ135CalcElecCorrnS1B1.numUref21Corrd UEGO_CJ135CalcElecCorrnS1B1.numUref22Corrd UEGO_CJ135CalcElecCorrnS1B1.numUref3Corrd UEGO_CJ135CalcElecCorrnS1B1.uCmnMod1 UEGO_CJ135CalcElecCorrnS1B1.uCmnMod2 UEGO_CJ135CalcElecCorrnS1B1.uVCC1Corrd UEGO_CJ135CalcElecCorrnS1B1.uVCC3MeasRef UEGO_CJ135CalcElecCorrnS1B1.uFkal1Flt_DL_I.memory UEGO_CJ135CalcElecCorrnS1B1.uFkal2Flt_DL_I.memory UEGO_CJ135CalcElecCorrnS1B1.uFkal3Flt_DL_I.memory UEGO_DataSplyClsS1B1_I.flgCj135An UEGO_DataSplyClsS1B1_I.flgDACOff UEGO_DataSplyClsS1B1_I.flgErrSpiRamRet UEGO_DataSplyClsS1B1_I.flgFKal1Vld UEGO_DataSplyClsS1B1_I.flgFKal2Vld UEGO_DataSplyClsS1B1_I.flgFKal3Vld UEGO_DataSplyClsS1B1_I.flgIPmpActvd UEGO_DataSplyClsS1B1_I.flgISQrA UEGO_DataSplyClsS1B1_I.flgISQrE UEGO_DataSplyClsS1B1_I.flgLCURR UEGO_DataSplyClsS1B1_I.flgLNMeas UEGO_DataSplyClsS1B1_I.flgLPMeas UEGO_DataSplyClsS1B1_I.flgLoupeCAL UEGO_DataSplyClsS1B1_I.flgLoupeG0 UEGO_DataSplyClsS1B1_I.flgLstPckAbort UEGO_DataSplyClsS1B1_I.flgMKA UEGO_DataSplyClsS1B1_I.flgMKE UEGO_DataSplyClsS1B1_I.flgNewIPmpDacPckAry UEGO_DataSplyClsS1B1_I.flgNewIPmpOK UEGO_DataSplyClsS1B1_I.flgNewIPmpPckAry UEGO_DataSplyClsS1B1_I.flgNewIPmpTM UEGO_DataSplyClsS1B1_I.flgNewPck UEGO_DataSplyClsS1B1_I.flgNewPckCstnc UEGO_DataSplyClsS1B1_I.flgNewPckMiss UEGO_DataSplyClsS1B1_I.flgNewPckVld UEGO_DataSplyClsS1B1_I.flgNewTiPck UEGO_DataSplyClsS1B1_I.flgNewURmVG4MeasAryVld UEGO_DataSplyClsS1B1_I.flgNewUa2Pck UEGO_DataSplyClsS1B1_I.flgNewUa31Pck UEGO_DataSplyClsS1B1_I.flgNewUa32Pck UEGO_DataSplyClsS1B1_I.flgNewUa33Pck UEGO_DataSplyClsS1B1_I.flgNewUamPck UEGO_DataSplyClsS1B1_I.flgNewUapePck UEGO_DataSplyClsS1B1_I.flgNewUcalMaxPck UEGO_DataSplyClsS1B1_I.flgNewUcalPck UEGO_DataSplyClsS1B1_I.flgNewUg0Pck UEGO_DataSplyClsS1B1_I.flgNewUg0PckAry UEGO_DataSplyClsS1B1_I.flgNewUg0aPck UEGO_DataSplyClsS1B1_I.flgNewUg0ePck UEGO_DataSplyClsS1B1_I.flgNewUg0iPck UEGO_DataSplyClsS1B1_I.flgNewUg0iPckAry UEGO_DataSplyClsS1B1_I.flgNewUg0iaiPck UEGO_DataSplyClsS1B1_I.flgNewUg0ieiPck UEGO_DataSplyClsS1B1_I.flgNewUg0ix7PckAry UEGO_DataSplyClsS1B1_I.flgNewUg0ix9PckAry UEGO_DataSplyClsS1B1_I.flgNewUg0ixPckAry UEGO_DataSplyClsS1B1_I.flgNewUg0mPck UEGO_DataSplyClsS1B1_I.flgNewUgaPck UEGO_DataSplyClsS1B1_I.flgNewUgiPckAry UEGO_DataSplyClsS1B1_I.flgNewUgkAvrgPck UEGO_DataSplyClsS1B1_I.flgNewUguaPck UEGO_DataSplyClsS1B1_I.flgNewUguaZ2Pck UEGO_DataSplyClsS1B1_I.flgNewUguiPck UEGO_DataSplyClsS1B1_I.flgNewUguiZ1Pck UEGO_DataSplyClsS1B1_I.flgNewUi21PckAry UEGO_DataSplyClsS1B1_I.flgNewUi22Pck UEGO_DataSplyClsS1B1_I.flgNewUi23Pck UEGO_DataSplyClsS1B1_I.flgNewUi24Pck UEGO_DataSplyClsS1B1_I.flgNewUi4Pck UEGO_DataSplyClsS1B1_I.flgNewUi4Z2Pck UEGO_DataSplyClsS1B1_I.flgNewUigPckAry UEGO_DataSplyClsS1B1_I.flgNewUigmkPckAry UEGO_DataSplyClsS1B1_I.flgNewUipcalAvrgPck UEGO_DataSplyClsS1B1_I.flgNewUn0Pck UEGO_DataSplyClsS1B1_I.flgNewUn0Pck4Ary UEGO_DataSplyClsS1B1_I.flgNewUn0Pck5Ary UEGO_DataSplyClsS1B1_I.flgNewUn0PckAry UEGO_DataSplyClsS1B1_I.flgNewUnPckAry UEGO_DataSplyClsS1B1_I.flgNewUnSetPck UEGO_DataSplyClsS1B1_I.flgNewUnx3PckAry UEGO_DataSplyClsS1B1_I.flgNewUnx4PckAry UEGO_DataSplyClsS1B1_I.flgNewUp0Pck UEGO_DataSplyClsS1B1_I.flgNewUp0Pck4 UEGO_DataSplyClsS1B1_I.flgNewUp0Pck5Ary UEGO_DataSplyClsS1B1_I.flgNewUp0PckAry UEGO_DataSplyClsS1B1_I.flgNewUpPckAry UEGO_DataSplyClsS1B1_I.flgNewUpx3PckAry UEGO_DataSplyClsS1B1_I.flgNewUpx4PckAry UEGO_DataSplyClsS1B1_I.flgNewUriaPckVld UEGO_DataSplyClsS1B1_I.flgNewUriePckAry UEGO_DataSplyClsS1B1_I.flgNewUx6PckAry UEGO_DataSplyClsS1B1_I.flgNewUx7PckAry UEGO_DataSplyClsS1B1_I.flgNewUx8PckAry UEGO_DataSplyClsS1B1_I.flgNewUx9PckAry UEGO_DataSplyClsS1B1_I.flgNewUxPckAry UEGO_DataSplyClsS1B1_I.flgReStable UEGO_DataSplyClsS1B1_I.flgSngCell UEGO_DataSplyClsS1B1_I.flgUical0Vld UEGO_DataSplyClsS1B1_I.flgUicalVld UEGO_DataSplyClsS1B1_I.flgUoffipe1Vld UEGO_DataSplyClsS1B1_I.flgUoffipe2Vld UEGO_DataSplyClsS1B1_I.flgUoffipe3Vld UEGO_DataSplyClsS1B1_I.flgUoffvcc1Vld UEGO_DataSplyClsS1B1_I.flgUoffvcc2Vld UEGO_DataSplyClsS1B1_I.flgUoffvcc3Vld UEGO_DataSplyClsS1B1_I.flgUriaMeas UEGO_DataSplyClsS1B1_I.nrIPmpDacPckAry UEGO_DataSplyClsS1B1_I.nrIpPckAry UEGO_DataSplyClsS1B1_I.nrModeMeas UEGO_DataSplyClsS1B1_I.nrRamFailPosn UEGO_DataSplyClsS1B1_I.nrRamMod UEGO_DataSplyClsS1B1_I.nrRamRegMod UEGO_DataSplyClsS1B1_I.nrRamSts1 UEGO_DataSplyClsS1B1_I.nrRamSts2 UEGO_DataSplyClsS1B1_I.nrRamSts3 UEGO_DataSplyClsS1B1_I.nrURmVG4PckAry UEGO_DataSplyClsS1B1_I.nrUa2PckAry UEGO_DataSplyClsS1B1_I.nrUcalMaxCorrd UEGO_DataSplyClsS1B1_I.nrUg0PckAry UEGO_DataSplyClsS1B1_I.nrUg0iPckAry UEGO_DataSplyClsS1B1_I.nrUg0ix7PckAry UEGO_DataSplyClsS1B1_I.nrUg0ix9PckAry UEGO_DataSplyClsS1B1_I.nrUg0ixPckAry UEGO_DataSplyClsS1B1_I.nrUgaPckAry UEGO_DataSplyClsS1B1_I.nrUgiPckAry UEGO_DataSplyClsS1B1_I.nrUi21PckAry UEGO_DataSplyClsS1B1_I.nrUical0PckCorrd UEGO_DataSplyClsS1B1_I.nrUicalPckCorrd UEGO_DataSplyClsS1B1_I.nrUigPckAry UEGO_DataSplyClsS1B1_I.nrUigmkPckAry UEGO_DataSplyClsS1B1_I.nrUn0Pck4Ary UEGO_DataSplyClsS1B1_I.nrUn0Pck5Ary UEGO_DataSplyClsS1B1_I.nrUn0PckAry UEGO_DataSplyClsS1B1_I.nrUnPckAry UEGO_DataSplyClsS1B1_I.nrUnx3PckAry UEGO_DataSplyClsS1B1_I.nrUnx4PckAry UEGO_DataSplyClsS1B1_I.nrUoffipe1 UEGO_DataSplyClsS1B1_I.nrUoffipe2 UEGO_DataSplyClsS1B1_I.nrUoffipe3 UEGO_DataSplyClsS1B1_I.nrUoffvcc1 UEGO_DataSplyClsS1B1_I.nrUoffvcc2 UEGO_DataSplyClsS1B1_I.nrUoffvcc3 UEGO_DataSplyClsS1B1_I.nrUp0Pck5Ary UEGO_DataSplyClsS1B1_I.nrUp0PckAry UEGO_DataSplyClsS1B1_I.nrUpPckAry UEGO_DataSplyClsS1B1_I.nrUpx3PckAry UEGO_DataSplyClsS1B1_I.nrUpx4PckAry UEGO_DataSplyClsS1B1_I.nrUriePckAry UEGO_DataSplyClsS1B1_I.nrUx6PckAry UEGO_DataSplyClsS1B1_I.nrUx7PckAry UEGO_DataSplyClsS1B1_I.nrUx8PckAry UEGO_DataSplyClsS1B1_I.nrUx9PckAry UEGO_DataSplyClsS1B1_I.nrUxPckAry UEGO_DataSplyClsS1B1_I.stIPmpOK UEGO_DataSplyClsS1B1_I.stIPmpTM UEGO_DataSplyClsS1B1_I.stIPmpTM2L UEGO_DataSplyClsS1B1_I.stIPmpTM2R UEGO_DataSplyClsS1B1_I.stLsmRetValMod UEGO_DataSplyClsS1B1_I.stMKMeas UEGO_DataSplyClsS1B1_I.stOFFMeas UEGO_DataSplyClsS1B1_I.stOPTMeas UEGO_DataSplyClsS1B1_I.stREFMeas UEGO_DataSplyClsS1B1_I.stUa2PckAry UEGO_DataSplyClsS1B1_I.stUa2Z1PckAry UEGO_DataSplyClsS1B1_I.stUg0iPckAry UEGO_DataSplyClsS1B1_I.stUg0ix7IActvPckAry UEGO_DataSplyClsS1B1_I.stUg0ix7PmpIActvPckAry UEGO_DataSplyClsS1B1_I.stUg0ix9IActvPckAry UEGO_DataSplyClsS1B1_I.stUg0ix9PmpIActvPckAry UEGO_DataSplyClsS1B1_I.stUg0ixIActvPckAry UEGO_DataSplyClsS1B1_I.stUg0ixPmpIActvPckAry UEGO_DataSplyClsS1B1_I.stUi21PckAry UEGO_DataSplyClsS1B1_I.stUi21Z1PckAry UEGO_DataSplyClsS1B1_I.stUigmkNernstIActvPckAry UEGO_DataSplyClsS1B1_I.stUigmkPmpIActvPckAry UEGO_DataSplyClsS1B1_I.stUn0PckAry UEGO_DataSplyClsS1B1_I.stUn0Z2PckAry UEGO_DataSplyClsS1B1_I.stUnPckAry UEGO_DataSplyClsS1B1_I.stUnx3IActvAcrsNernstCellPckAry UEGO_DataSplyClsS1B1_I.stUnx3IActvAcrsPmpCellPckAry UEGO_DataSplyClsS1B1_I.stUnx4IActvAcrsNernstCellPckAry UEGO_DataSplyClsS1B1_I.stUnx4IActvAcrsPmpCellPckAry UEGO_DataSplyClsS1B1_I.stUp0PckAry UEGO_DataSplyClsS1B1_I.stUp0Z2PckAry UEGO_DataSplyClsS1B1_I.stUpPckAry UEGO_DataSplyClsS1B1_I.stUpZ2PckAry UEGO_DataSplyClsS1B1_I.stUpx3IActvAcrsNernstCellPckAry UEGO_DataSplyClsS1B1_I.stUpx3IActvAcrsPmpCellPckAry UEGO_DataSplyClsS1B1_I.stUpx4IActvAcrsNernstCellPckAry UEGO_DataSplyClsS1B1_I.stUpx4IActvAcrsPmpCellPckAry UEGO_DataSplyClsS1B1_I.stUriePckAry UEGO_DataSplyClsS1B1_I.stUx6IActvPckAry UEGO_DataSplyClsS1B1_I.stUx6MeasAcrsPmpCellPckAry UEGO_DataSplyClsS1B1_I.stUx7IActvPckAry UEGO_DataSplyClsS1B1_I.stUx7MeasAcrsPmpCellPckAry UEGO_DataSplyClsS1B1_I.stUx8IActvPckAry UEGO_DataSplyClsS1B1_I.stUx8MeasAcrsPmpCellPckAry UEGO_DataSplyClsS1B1_I.stUx9IActvPckAry UEGO_DataSplyClsS1B1_I.stUx9MeasAcrsPmpCellPckAry UEGO_DataSplyClsS1B1_I.stUxIActvPckAry UEGO_DataSplyClsS1B1_I.stUxMeasAcrsPmpCell UEGO_DataSplyClsS1B1_I.tiUEGOPck UEGO_DataSplyClsS1B1_I.uFkal1 UEGO_DataSplyClsS1B1_I.uFkal2 UEGO_DataSplyClsS1B1_I.uFkal3 UEGO_DataSplyClsS1B1_I.uUCalPck UEGO_DataSplyClsS1B1_I.uUa31Pck UEGO_DataSplyClsS1B1_I.uUa32Pck UEGO_DataSplyClsS1B1_I.uUa33Pck UEGO_DataSplyClsS1B1_I.uUamPck UEGO_DataSplyClsS1B1_I.uUapePck UEGO_DataSplyClsS1B1_I.uUcalMaxPck UEGO_DataSplyClsS1B1_I.uUg0Pck UEGO_DataSplyClsS1B1_I.uUg0aPck UEGO_DataSplyClsS1B1_I.uUg0ePck UEGO_DataSplyClsS1B1_I.uUg0iPck UEGO_DataSplyClsS1B1_I.uUg0iaiPck UEGO_DataSplyClsS1B1_I.uUg0ieiPck UEGO_DataSplyClsS1B1_I.uUg0mPck UEGO_DataSplyClsS1B1_I.uUgkAvrgPck UEGO_DataSplyClsS1B1_I.uUguaPck UEGO_DataSplyClsS1B1_I.uUguaZ2Pck UEGO_DataSplyClsS1B1_I.uUguiPck UEGO_DataSplyClsS1B1_I.uUguiZ1Pck UEGO_DataSplyClsS1B1_I.uUi22Pck UEGO_DataSplyClsS1B1_I.uUi23Pck UEGO_DataSplyClsS1B1_I.uUi24Pck UEGO_DataSplyClsS1B1_I.uUi4Pck UEGO_DataSplyClsS1B1_I.uUi4Z2Pck UEGO_DataSplyClsS1B1_I.uUipcalAvrgPck UEGO_DataSplyClsS1B1_I.uUn0Pck UEGO_DataSplyClsS1B1_I.uUnSet UEGO_DataSplyClsS1B1_I.uUp0Pck UEGO_DataSplyClsS1B1_I.uUp0Pck4 UEGO_DataSplyClsS1B1_I.uUriaPck UEGO_DataSplyClsS1B1_I.uVCC1Corrd UEGO_DataSplyClsS1B1_I.uVCC3Ref UEGO_ratIPmpRawS1B1 UEGO_uUa2PckAryS1B1 UEGO_uUgaPckAryS1B1 UEGO_uUgiPckAryS1B1 UEGO_uUi21PckAryS1B1 UEGO_uUn0PckAryS1B1 UEGO_uUp0PckAryS1B1 UEGO_uUpPckAryS1B1 UEGO_uUriePckAryS1B1 /end OUT_MEASUREMENT
 /begin LOC_MEASUREMENT UEGO_DataCJ135S1B1_I.flgErrSpiRamBnk UEGO_DataCJ135S1B1_I.flgIPmpActvd UEGO_DataCJ135S1B1_I.flgLoupeP UEGO_DataCJ135S1B1_I.flgLstPckAbort UEGO_DataCJ135S1B1_I.flgNewPck UEGO_DataCJ135S1B1_I.flgNewPckCstncEnd UEGO_DataCJ135S1B1_I.flgNewPckCstncNxt UEGO_DataCJ135S1B1_I.flgNewPckCstncStrt UEGO_DataCJ135S1B1_I.flgNewPckMiss UEGO_DataCJ135S1B1_I.flgNewPckVld UEGO_DataCJ135S1B1_I.flgSetCalibRegOK UEGO_DataCJ135S1B1_I.flgSetCmnMod2 UEGO_DataCJ135S1B1_I.flgSetOPTRegOk UEGO_DataCJ135S1B1_I.flgSetRegCalibOK UEGO_DataCJ135S1B1_I.flgSetRegOPTOk UEGO_DataCJ135S1B1_I.flgUCmnMod1Vld UEGO_DataCJ135S1B1_I.nrIntModSwtCalib UEGO_DataCJ135S1B1_I.nrIntModSwtCalibOld UEGO_DataCJ135S1B1_I.nrIntModSwtOpt UEGO_DataCJ135S1B1_I.nrIntModSwtOptOld UEGO_DataCJ135S1B1_I.nrModInt UEGO_DataCJ135S1B1_I.nrModIntOld UEGO_DataCJ135S1B1_I.nrModMeas UEGO_DataCJ135S1B1_I.nrPckDataLostCntr UEGO_DataCJ135S1B1_I.nrPckNotCmplCntr UEGO_DataCJ135S1B1_I.nrRamFailPosn UEGO_DataCJ135S1B1_I.nrRamRegMod UEGO_DataCJ135S1B1_I.nrRamSts1 UEGO_DataCJ135S1B1_I.nrRamSts2 UEGO_DataCJ135S1B1_I.nrRamSts3 UEGO_DataCJ135S1B1_I.nrRegDiffCntr UEGO_DataCJ135S1B1_I.nrRegMod UEGO_DataCJ135S1B1_I.ratIPmpRaw UEGO_DataCJ135S1B1_I.stIPmpTM2L UEGO_DataCJ135S1B1_I.stIPmpTM2R UEGO_DataCJ135S1B1_I.stLsmRetValMod UEGO_DataCJ135S1B1_I.stUriePckAry UEGO_DataCJ135S1B1_I.stUxPckAry UEGO_DataCJ135S1B1_I.stUyPckAry UEGO_DataCJ135S1B1_I.tiDurnCalibWait UEGO_DataCJ135S1B1_I.tiDurnOptWait UEGO_DataCJ135S1B1_I.CalibSW_I.timeCounter UEGO_DataCJ135S1B1_I.OptSW_I.timeCounter UEGO_DataCJ135S1B1_I.flgNewPckMissTONVNM_I.time /end LOC_MEASUREMENT
 FUNCTION_VERSION "1.18.0" /end FUNCTION
/begin FUNCTION UEGO_DiagHeatrPrfmnc "1.18.0    UEGO Diagnosis Heater Performance"
 /begin DEF_CHARACTERISTIC UEGO_stDiagHeatrPrfmnc_C UEGO_swtUHeatrOlcIUMPR_C UEGO_tEngStrtRels_C UEGO_tHeatrPrfmncLo_C UEGO_tiDlyOvrRunOff_C UEGO_tiDlyOvrRunOnStrtDiag_C UEGO_tiDlyOvrRunOn_C UEGO_tiDlyTstrReqStrtDiag_C UEGO_tiHeatrOffMinStrt_C UEGO_tiHeatrPrfmncTDropIUMPR_C UEGO_tWallStrtRels_C UEGO_uHeatrOlcIUMPR_C UEGO_DiagHeatrPrfmncS1B1_I.tHeatrStrtMin_C UEGO_DiagHeatrPrfmncS1B1_I.tiHldMaxStrt_C UEGO_DiagHeatrPrfmncS1B1_I.tiStrtDiagDurnCalcd_T /end DEF_CHARACTERISTIC
 /begin REF_CHARACTERISTIC UEGO_uHeatrClcMax_C /end REF_CHARACTERISTIC
 /begin IN_MEASUREMENT B_fa_msg B_sa_msg CEngDsT_t CEngDsT_tStrt DSMAUX_stDsmClrActv SyC_ctPostDrvLeave UEGO_flgDiagRprtRelsS1B1 UEGO_flgDsmVld UEGO_flgEngRunng UEGO_flgHeatrClcActvS1B1 UEGO_flgHeatrCtrldModActvS1B1 UEGO_flgSysSuprtdS1B1 UEGO_flgTCeramicVldS1B1 UEGO_flgTiHeatrOffVldS1B1 UEGO_tCeramicS1B1 UEGO_tiHeatrOffS1B1 UEGO_tWallMdlS1B1 UEGO_uHeatrCtrlEfcS1B1 UEGO_uHeatrS1B1 /end IN_MEASUREMENT
 /begin OUT_MEASUREMENT UEGO_flgHeatrPrfmncLoErrS1B1 /end OUT_MEASUREMENT
 /begin LOC_MEASUREMENT UEGO_DiagHeatrPrfmncS1B1_I.cntrReiniProc100ms UEGO_DiagHeatrPrfmncS1B1_I.cntrStrtPostDrvLeaveOld UEGO_DiagHeatrPrfmncS1B1_I.flgDSMClrReq UEGO_DiagHeatrPrfmncS1B1_I.flgDeactvSet UEGO_DiagHeatrPrfmncS1B1_I.flgDiagEna UEGO_DiagHeatrPrfmncS1B1_I.flgDiagRels UEGO_DiagHeatrPrfmncS1B1_I.flgHeatrPrfmncLoErr UEGO_DiagHeatrPrfmncS1B1_I.flgHeatrPrfmncLoSuspc UEGO_DiagHeatrPrfmncS1B1_I.flgSrv06Ena UEGO_DiagHeatrPrfmncS1B1_I.flgStrtDiagDSMClr UEGO_DiagHeatrPrfmncS1B1_I.flgStrtDiagDSMRels UEGO_DiagHeatrPrfmncS1B1_I.flgStrtDiagEna UEGO_DiagHeatrPrfmncS1B1_I.flgStrtDiagEnvrHealRels UEGO_DiagHeatrPrfmncS1B1_I.flgStrtDiagErrRels UEGO_DiagHeatrPrfmncS1B1_I.flgStrtDiagOLTstd UEGO_DiagHeatrPrfmncS1B1_I.flgStrtDiagPID41Req UEGO_DiagHeatrPrfmncS1B1_I.flgStrtDiagPID41Set UEGO_DiagHeatrPrfmncS1B1_I.flgStrtDiagRStrtReq UEGO_DiagHeatrPrfmncS1B1_I.flgStrtDiagRels UEGO_DiagHeatrPrfmncS1B1_I.flgStrtDiagRstReq UEGO_DiagHeatrPrfmncS1B1_I.flgStrtDiagRstrt UEGO_DiagHeatrPrfmncS1B1_I.flgStrtDiagTiHealRels UEGO_DiagHeatrPrfmncS1B1_I.flgStrtDiagTstrDmd UEGO_DiagHeatrPrfmncS1B1_I.flgStrtDiagTstrTiHealRels UEGO_DiagHeatrPrfmncS1B1_I.nrModInt UEGO_DiagHeatrPrfmncS1B1_I.nrModIntOld UEGO_DiagHeatrPrfmncS1B1_I.nrModRes UEGO_DiagHeatrPrfmncS1B1_I.nrModResOld UEGO_DiagHeatrPrfmncS1B1_I.nrModRprt UEGO_DiagHeatrPrfmncS1B1_I.nrModRprtOld UEGO_DiagHeatrPrfmncS1B1_I.nrModSel UEGO_DiagHeatrPrfmncS1B1_I.ratEgyStrtDiag UEGO_DiagHeatrPrfmncS1B1_I.ratEgyStrtDiagIUMPR UEGO_DiagHeatrPrfmncS1B1_I.tCerStrtDiagDTR UEGO_DiagHeatrPrfmncS1B1_I.tCerStrtDiagOBD UEGO_DiagHeatrPrfmncS1B1_I.tiDebDef UEGO_DiagHeatrPrfmncS1B1_I.tiDebOK UEGO_DiagHeatrPrfmncS1B1_I.tiStrtDiagDurnThd UEGO_DiagHeatrPrfmncS1B1_I.tiStrtDiagDurnThdIUMPR UEGO_DiagHeatrPrfmncS1B1_I.tiStrtDiagHldTmr UEGO_DiagHeatrPrfmncS1B1_I.tiStrtDiagTmr UEGO_DiagHeatrPrfmncS1B1_I.tiStrtDiagTmrIUMPR UEGO_DiagHeatrPrfmncS1B1_I.LoErrDebDefTONV_I.outbit UEGO_DiagHeatrPrfmncS1B1_I.LoErrDebDefTONV_I.time UEGO_DiagHeatrPrfmncS1B1_I.LoErrDebOKTOFFV_I.outbit UEGO_DiagHeatrPrfmncS1B1_I.LoErrDebOKTOFFV_I.time UEGO_DiagHeatrPrfmncS1B1_I.flgDiagRelsTONV_I.outbit UEGO_DiagHeatrPrfmncS1B1_I.flgDiagRelsTONV_I.time UEGO_DiagHeatrPrfmncS1B1_I.flgDiagRprtRelsTONV_I.outbit UEGO_DiagHeatrPrfmncS1B1_I.flgDiagRprtRelsTONV_I.time UEGO_DiagHeatrPrfmncS1B1_I.flgOvrRunStrtDiagTONV_I.outbit UEGO_DiagHeatrPrfmncS1B1_I.flgOvrRunStrtDiagTONV_I.time UEGO_DiagHeatrPrfmncS1B1_I.flgOvrRunTOFFV_I.outbit UEGO_DiagHeatrPrfmncS1B1_I.flgOvrRunTOFFV_I.time UEGO_DiagHeatrPrfmncS1B1_I.flgOvrRunTONV_I.outbit UEGO_DiagHeatrPrfmncS1B1_I.flgOvrRunTONV_I.time UEGO_DiagHeatrPrfmncS1B1_I.flgStrtDiagRestrtReqEFNM_I.oldSignal UEGO_DiagHeatrPrfmncS1B1_I.flgStrtDiagTstrDmdFF_I.status UEGO_DiagHeatrPrfmncS1B1_I.flgTstrReqTONV_I.outbit UEGO_DiagHeatrPrfmncS1B1_I.flgTstrReqTONV_I.time UEGO_DiagHeatrPrfmncS1B1_I.tiStrtDiagEgyRatA_I.memory UEGO_DiagHeatrPrfmncS1B1_I.tiStrtDiagEgyRatIUMPRA_I.memory /end LOC_MEASUREMENT
 FUNCTION_VERSION "1.18.0" /end FUNCTION
/begin FUNCTION UEGO_DiagHeatrWire "1.12.0    UEGO Diagnosis Heater Wire"
 /begin DEF_CHARACTERISTIC UEGO_nrTstPlsCntCfg_C UEGO_nrTstPls_C UEGO_stPwrStgFtchMask_C UEGO_stPwrStgSysCondDeactvn_C UEGO_stTstPlsCfg_C UEGO_SuprtPwrStgSnsrTyp_M UEGO_swtDiagWireUBattSel_C UEGO_tiBtwElecFlt_C UEGO_tiBtwOTFlt_C UEGO_tiHeatrWireRawErr_C UEGO_tiTestPlsBreak_C UEGO_uBattDiagWireMin_C /end DEF_CHARACTERISTIC
 /begin REF_CHARACTERISTIC UEGO_idxHWES1B1_C /end REF_CHARACTERISTIC
 /begin IN_MEASUREMENT BattU_u DevLib_stPwrStgEnaCond SyC_ctPostDrvLeave UEGO_flgDiagRprtRelsS1B1 UEGO_flgDsmVld UEGO_flgHeatrCtrldModActvS1B1 UEGO_flgHeatrRlyActvS1B1 UEGO_flgSnsrMdlAmbTS1B1 UEGO_flgSysSuprtdS1B1 UEGO_idxTypS1B1 UEGO_ratHeatrPwrStgCtrlS1B1 /end IN_MEASUREMENT
 /begin OUT_MEASUREMENT UEGO_flgHeatrErrOLRawS1B1 UEGO_flgHeatrErrSCBRawS1B1 UEGO_flgHeatrErrSCGRawS1B1 UEGO_flgHeatrPsErrS1B1 UEGO_flgHeatrPwrStgSuprtdS1B1 /end OUT_MEASUREMENT
 /begin LOC_MEASUREMENT UEGO_DiagHeatrWireS1B1_I.cntrReiniProc20ms UEGO_DiagHeatrWireS1B1_I.flgDSMClrReq UEGO_DiagHeatrWireS1B1_I.flgDiagEna UEGO_DiagHeatrWireS1B1_I.flgDiagRels UEGO_DiagHeatrWireS1B1_I.flgDiagSCBRels UEGO_DiagHeatrWireS1B1_I.flgDiagSCGRels UEGO_DiagHeatrWireS1B1_I.flgDsmErrOlRaw UEGO_DiagHeatrWireS1B1_I.flgDsmErrScbRaw UEGO_DiagHeatrWireS1B1_I.flgDsmErrScgRaw UEGO_DiagHeatrWireS1B1_I.flgDsmPwrStgErrRaw UEGO_DiagHeatrWireS1B1_I.flgErrInfoOLRaw UEGO_DiagHeatrWireS1B1_I.flgErrInfoSCBRaw UEGO_DiagHeatrWireS1B1_I.flgErrInfoSCGRaw UEGO_DiagHeatrWireS1B1_I.flgErrOL UEGO_DiagHeatrWireS1B1_I.flgErrOLRaw UEGO_DiagHeatrWireS1B1_I.flgErrSCB UEGO_DiagHeatrWireS1B1_I.flgErrSCBRaw UEGO_DiagHeatrWireS1B1_I.flgErrSCG UEGO_DiagHeatrWireS1B1_I.flgErrSCGRaw UEGO_DiagHeatrWireS1B1_I.flgFtchVld UEGO_DiagHeatrWireS1B1_I.flgHeatrPsErr UEGO_DiagHeatrWireS1B1_I.flgIniEnd UEGO_DiagHeatrWireS1B1_I.flgOffIninErr UEGO_DiagHeatrWireS1B1_I.flgOffProtd UEGO_DiagHeatrWireS1B1_I.flgPolarityHi UEGO_DiagHeatrWireS1B1_I.flgPwrStgSuprt UEGO_DiagHeatrWireS1B1_I.flgTestPlsReqd UEGO_DiagHeatrWireS1B1_I.flgTout UEGO_DiagHeatrWireS1B1_I.flgTstPlsReqScb UEGO_DiagHeatrWireS1B1_I.flgTstPlsReqScgOl UEGO_DiagHeatrWireS1B1_I.ratHeatrMeasd UEGO_DiagHeatrWireS1B1_I.stErrInfo UEGO_DiagHeatrWireS1B1_I.stFtchVldy UEGO_DiagHeatrWireS1B1_I.stInfo UEGO_DiagHeatrWireS1B1_I.stInfoRaw UEGO_DiagHeatrWireS1B1_I.stOffRaw UEGO_DiagHeatrWireS1B1_I.stPerdRaw UEGO_DiagHeatrWireS1B1_I.stPlsRaw UEGO_DiagHeatrWireS1B1_I.stPolarityRaw UEGO_DiagHeatrWireS1B1_I.stProtdRaw UEGO_DiagHeatrWireS1B1_I.stPwrStgSuprt UEGO_DiagHeatrWireS1B1_I.stPwrStgTyp UEGO_DiagHeatrWireS1B1_I.stPwrStgTypRaw UEGO_DiagHeatrWireS1B1_I.stTestPlsActvRaw UEGO_DiagHeatrWireS1B1_I.stTestPlsIdleRaw UEGO_DiagHeatrWireS1B1_I.stToutRaw UEGO_DiagHeatrWireS1B1_I.tiPerd UEGO_DiagHeatrWireS1B1_I.tiPls UEGO_DiagHeatrWireS1B1_I.tiTestPlsActv UEGO_DiagHeatrWireS1B1_I.tiTestPlsBreak UEGO_DiagHeatrWireS1B1_I.tiTestPlsIdle UEGO_DiagHeatrWireS1B1_I.DsmPwrStgErrRawTONV_I.outbit UEGO_DiagHeatrWireS1B1_I.DsmPwrStgErrRawTONV_I.time UEGO_DiagHeatrWireS1B1_I.ErrOLRawTONV_I.outbit UEGO_DiagHeatrWireS1B1_I.ErrOLRawTONV_I.time UEGO_DiagHeatrWireS1B1_I.ErrSCBRawTONV_I.outbit UEGO_DiagHeatrWireS1B1_I.ErrSCBRawTONV_I.time UEGO_DiagHeatrWireS1B1_I.ErrSCGRawTONV_I.outbit UEGO_DiagHeatrWireS1B1_I.ErrSCGRawTONV_I.time UEGO_DiagHeatrWireS1B1_I.flgTestPlsReqdER_I.buffer UEGO_DiagHeatrWireS1B1_I.flgTestPlsReqdER_I.oldSignal /end LOC_MEASUREMENT
 FUNCTION_VERSION "1.12.0" /end FUNCTION
/begin FUNCTION UEGO_DiagRels "1.18.0    Operation Release for UEGO sensor diagnosis"
 /begin DEF_CHARACTERISTIC UEGO_stDiagRelsCdnMask_C UEGO_tiDlyDiagRels_C UEGO_uPwrSplyHiDiagRels_C UEGO_uPwrSplyLoDiagRels_C /end DEF_CHARACTERISTIC
 /begin IN_MEASUREMENT BattU_u DSM_TripChgFinshd SyC_ctPostDrvLeave /end IN_MEASUREMENT
 /begin OUT_MEASUREMENT UEGO_flgDiagRprtRelsS1B1 UEGO_flgDsmVld /end OUT_MEASUREMENT
 /begin LOC_MEASUREMENT UEGO_DiagRelsClsS1B1_I.stDiagRels UEGO_DiagRelsClsS1B1_I.flgDiagRelsTOFFVNM_I.time UEGO_DiagRels_cntrReiniProc10msec UEGO_flgDsmVldFF_I.status /end LOC_MEASUREMENT
 FUNCTION_VERSION "1.18.0" /end FUNCTION
/begin FUNCTION UEGO_DiagSigCoorr "1.12.0    UEGO diagnostics coordinator of the signal path" FUNCTION_VERSION "1.12.0" /end FUNCTION
/begin FUNCTION UEGO_DiagSigEcuAsic "1.20.0    UEGO diagnostics of the ASIC (module) of the signal path"
 /begin DEF_CHARACTERISTIC UEGO_stDiagSigEcuAsicReactnEna_C UEGO_stDiagSigEcuAsicRprtEna_C UEGO_uVCC3Max_C UEGO_uVCC3Min_C /end DEF_CHARACTERISTIC
 /begin IN_MEASUREMENT SyC_ctPostDrvLeave UEGO_cntrModEvlnS1B1 UEGO_flgDiagRprtRelsS1B1 UEGO_flgDiagSigEcuComTstdOkS1B1 UEGO_flgDsmVld UEGO_flgSysSuprtdS1B1 UEGO_flgVCC3RefMeasVldS1B1 UEGO_nrModVrfdS1B1 UEGO_uVCC3RefS1B1 /end IN_MEASUREMENT
 /begin OUT_MEASUREMENT UEGO_flgDiagSigEcuAsicRstS1B1 UEGO_flgDiagSigEcuAsicTstdOkS1B1 UEGO_stDiagSigEcuAsicCycS1B1 UEGO_stDiagSigEcuAsicRprtS1B1 /end OUT_MEASUREMENT
 /begin LOC_MEASUREMENT UEGO_cntrDiagSigEcuAsicReiniProc10msec UEGO_DiagSigAsicS1B1_I.flgDiagSigEcuAsicRst UEGO_DiagSigAsicS1B1_I.flgDiagSigEcuAsicTstdOk UEGO_DiagSigAsicS1B1_I.flgRstDsmClr UEGO_DiagSigAsicS1B1_I.flgRstExtReq UEGO_DiagSigAsicS1B1_I.stDiagSigEcuAsicCyc UEGO_DiagSigAsicS1B1_I.stDiagSigEcuAsicRprt UEGO_DiagSigAsicS1B1_I.UEGO_DiagSigEcuAsicResClass_I.stErr UEGO_DiagSigAsicS1B1_I.UEGO_DiagSigEcuAsicResClass_I.stTstdCyc UEGO_DiagSigAsicS1B1_I.UEGO_DiagSigEcuAsicResClass_I.stTstdCycRprt UEGO_DiagSigAsicS1B1_I.UEGO_flgDsmErrDebERNM_I.oldSignal UEGO_DiagSigAsicS1B1_I.UEGO_flgDsmTstERNM_I.oldSignal UEGO_flgDiagSigEcuAsicExtRstReq /end LOC_MEASUREMENT
 FUNCTION_VERSION "1.20.0" /end FUNCTION
/begin FUNCTION UEGO_DiagSigEcuCom "1.15.1    UEGO diagnostics of the ECU communication of the signal path"
 /begin DEF_CHARACTERISTIC UEGO_cntrDiagSigRamBnkSpiDeb_C UEGO_cntrDiagSigRegBnkSpiDeb_C UEGO_cntrDiagSigRegDiagSpiDeb_C UEGO_stDiagSigEcuComReactnEna_C UEGO_stDiagSigEcuComRprtEna_C /end DEF_CHARACTERISTIC
 /begin IN_MEASUREMENT SyC_ctPostDrvLeave UEGO_cntrDiagSigRamBnkSpiS1B1 UEGO_cntrDiagSigRegBnkSpiS1B1 UEGO_cntrDiagSigRegDiagSpiS1B1 UEGO_cntrModEvlnS1B1 UEGO_flgDiagRprtRelsS1B1 UEGO_flgDiagSigRamBnkSpiVldS1B1 UEGO_flgDiagSigRegBnkSpiVldS1B1 UEGO_flgDiagSigRegDiagSpiVldS1B1 UEGO_flgDsmVld UEGO_flgSysSuprtdS1B1 UEGO_nrModVrfdS1B1 /end IN_MEASUREMENT
 /begin OUT_MEASUREMENT UEGO_flgDiagSigEcuComRstS1B1 UEGO_flgDiagSigEcuComTstdOkS1B1 UEGO_stDiagSigEcuComCycS1B1 UEGO_stDiagSigEcuComRprtS1B1 /end OUT_MEASUREMENT
 /begin LOC_MEASUREMENT UEGO_cntrDiagSigEcuComReIniProc10msec UEGO_DiagSigEcuComS1B1_I.flgDiagSigEcuComIDLEReq UEGO_DiagSigEcuComS1B1_I.flgDiagSigEcuComRst UEGO_DiagSigEcuComS1B1_I.flgDiagSigEcuComTstdOk UEGO_DiagSigEcuComS1B1_I.flgRstDsmClr UEGO_DiagSigEcuComS1B1_I.flgRstExtReq UEGO_DiagSigEcuComS1B1_I.stDiagSigEcuComCyc UEGO_DiagSigEcuComS1B1_I.stDiagSigEcuComRprt UEGO_DiagSigEcuComS1B1_I.UEGO_DiagSigEcuComResClass_I.stErr UEGO_DiagSigEcuComS1B1_I.UEGO_DiagSigEcuComResClass_I.stTstdCyc UEGO_DiagSigEcuComS1B1_I.UEGO_DiagSigEcuComResClass_I.stTstdCycRprt UEGO_DiagSigEcuComS1B1_I.UEGO_flgDsmErrDebERNM_I.oldSignal UEGO_DiagSigEcuComS1B1_I.UEGO_flgDsmTstERNM_I.oldSignal UEGO_flgDiagSigEcuComExtRstReq /end LOC_MEASUREMENT
 FUNCTION_VERSION "1.15.1" /end FUNCTION
/begin COMPU_METHOD B_TRUE "" TAB_VERB "%6.3" "" COMPU_TAB_REF B_TRUE /end COMPU_METHOD
/begin COMPU_VTAB B_TRUE "" TAB_VERB 2 0 "FALSE" 1 "TRUE" /end COMPU_VTAB
/begin COMPU_METHOD dez "" RAT_FUNC "%6.2" "" COEFFS 0 1 0 0 0 1 /end COMPU_METHOD
/begin COMPU_METHOD fak_q1p201Em4 "" RAT_FUNC "%6.5" "-" COEFFS 0 8325 0 0 0 1 /end COMPU_METHOD
/begin COMPU_METHOD fak_ub_b2 "" RAT_FUNC "%8.5" "-" COEFFS 0 256 0 0 0 2 /end COMPU_METHOD
/begin COMPU_METHOD fak_uw_b1 "" RAT_FUNC "%7.6" "-" COEFFS 0 65536 0 0 0 1 /end COMPU_METHOD
/begin COMPU_METHOD OneToOne "" RAT_FUNC "%6.2" "-" COEFFS 0 1 0 0 0 1 /end COMPU_METHOD
/begin COMPU_METHOD q6p104Em5_DIV_V "" RAT_FUNC "%7.6" "1/V" COEFFS 0 65536 0 0 0 4 /end COMPU_METHOD
/begin COMPU_METHOD rel_q0p003052 "" RAT_FUNC "%6.4" "%" COEFFS 0 65536 0 0 0 200 /end COMPU_METHOD
/begin COMPU_METHOD r_q0p1_Ohm "" RAT_FUNC "%6.3" "Ohm" COEFFS 0 10 0 0 0 1 /end COMPU_METHOD
/begin COMPU_METHOD spg_q0p005 "" RAT_FUNC "%6.4" "V" COEFFS 0 1 0 0 0 0.005 /end COMPU_METHOD
/begin COMPU_METHOD spg_q2p3842Em7_V "" RAT_FUNC "%9.8" "V" COEFFS 0 4194304 0 0 0 1 /end COMPU_METHOD
/begin COMPU_METHOD spg_q3p2Em4_V "" RAT_FUNC "%6.5" "V" COEFFS 0 32768 0 0 0 10.48576 /end COMPU_METHOD
/begin COMPU_METHOD spg_q3p638Em12_V "" RAT_FUNC "%14.13" "V" COEFFS 0 274877906944 0 0 0 1 /end COMPU_METHOD
/begin COMPU_METHOD Temp_Cels "" RAT_FUNC "%6.1" "deg C" COEFFS 0 10 2731.4 0 0 1 /end COMPU_METHOD
/begin COMPU_METHOD temp_q0p0234_o273 "" RAT_FUNC "%6.1" "Grad C" COEFFS 0 1 273.15 0 0 0.0234375 /end COMPU_METHOD
/begin COMPU_METHOD Time_ms "" RAT_FUNC "%6.1" "ms" COEFFS 0 0.1 0 0 0 1 /end COMPU_METHOD
/begin COMPU_METHOD Time_s "" RAT_FUNC "%6.4" "s" COEFFS 0 100 0 0 0 1 /end COMPU_METHOD
/begin COMPU_METHOD Time_usec_q1_COMPU "" RAT_FUNC "%6.2" "us" COEFFS 0 1 0 0 0 1 /end COMPU_METHOD
/begin COMPU_METHOD TWCD_OSCCAT2BNK1PARL_SC_Compu "" TAB_VERB "%6.3" "" COMPU_TAB_REF TWCD_OSCCAT2BNK1PARL_SC_Compu /end COMPU_METHOD
/begin COMPU_VTAB TWCD_OSCCAT2BNK1PARL_SC_Compu "" TAB_VERB 2 0 "not_active" 1 "active" /end COMPU_VTAB
/begin COMPU_METHOD TWCD_OSCCAT2BNK2PARL_SC_Compu "" TAB_VERB "%6.3" "" COMPU_TAB_REF TWCD_OSCCAT2BNK2PARL_SC_Compu /end COMPU_METHOD
/begin COMPU_VTAB TWCD_OSCCAT2BNK2PARL_SC_Compu "" TAB_VERB 2 0 "not_active" 1 "active" /end COMPU_VTAB
/begin COMPU_METHOD TWCD_PTLMEASMTPARL_SC_Compu "" TAB_VERB "%6.3" "" COMPU_TAB_REF TWCD_PTLMEASMTPARL_SC_Compu /end COMPU_METHOD
/begin COMPU_VTAB TWCD_PTLMEASMTPARL_SC_Compu "" TAB_VERB 2 0 "False" 1 "True" /end COMPU_VTAB
/begin COMPU_METHOD TWCOR_HIRES_SC_Compu "" TAB_VERB "%6.3" "" COMPU_TAB_REF TWCOR_HIRES_SC_Compu /end COMPU_METHOD
/begin COMPU_VTAB TWCOR_HIRES_SC_Compu "" TAB_VERB 2 0 "RES_S8" 1 "RES_S16" /end COMPU_VTAB
/begin COMPU_METHOD TWC_VAR_SY_Compu "" TAB_VERB "%6.3" "" COMPU_TAB_REF TWC_VAR_SY_Compu /end COMPU_METHOD
/begin COMPU_VTAB TWC_VAR_SY_Compu "" TAB_VERB 44 1 "DAI" 3 "VWW" 4 "POR" 5 "AUD" 6 "OPE" 9 "FIA" 11 "BMW" 14 "PSA" 15 "REN" 17 "ALF" 18 "SAB" 19 "VOL" 20 "NIS" 21 "GMU" 22 "FOR" 26 "IMJ" 51 "SEA" 53 "CHR" 54 "JAG" 55 "ROL" 69 "FER" 72 "TOY" 112 "BMWMotorradAG" 123 "MIT" 147 "HYU" 159 "HON" 160 "MAZ" 183 "CU" 190 "LRG" 204 "VVW" 214 "AVT" 242 "Iveco" 243 "DMC" 248 "SUZ" 267 "SSANGYONG" 270 "KEF" 289 "AMG" 308 "TAT" 319 "MVM" 385 "UAES" 590 "Scania" 828 "RBCD" 999 "ALL" 2887 "Nonox" /end COMPU_VTAB
/begin COMPU_METHOD TWTRCOOLRDS_TYPAVL_SC_Compu "" TAB_VERB "%6.3" "" COMPU_TAB_REF TWTRCOOLRDS_TYPAVL_SC_Compu /end COMPU_METHOD
/begin COMPU_VTAB TWTRCOOLRDS_TYPAVL_SC_Compu "" TAB_VERB 2 0 "False" 1 "True" /end COMPU_VTAB
/begin COMPU_METHOD t_q0p000001_s "" RAT_FUNC "%9.8" "s" COEFFS 0 1000000 0 0 0 1 /end COMPU_METHOD
/begin COMPU_METHOD t_q0p005 "" RAT_FUNC "%6.4" "s" COEFFS 0 1000 0 0 0 5 /end COMPU_METHOD
/begin COMPU_METHOD t_q0p01 "" RAT_FUNC "%6.4" "s" COEFFS 0 100 0 0 0 1 /end COMPU_METHOD
/begin COMPU_METHOD t_q0p02 "" RAT_FUNC "%6.4" "s" COEFFS 0 100 0 0 0 2 /end COMPU_METHOD
/begin COMPU_METHOD t_q0p1 "" RAT_FUNC "%6.3" "s" COEFFS 0 10 0 0 0 1 /end COMPU_METHOD
/begin COMPU_METHOD UART_SY_Compu "" TAB_VERB "%6.3" "" COMPU_TAB_REF UART_SY_Compu /end COMPU_METHOD
/begin COMPU_VTAB UART_SY_Compu "" TAB_VERB 2 0 "UART not used" 1 "UART used" /end COMPU_VTAB
/begin COMPU_METHOD UBFAILSRC_SY_Compu "" TAB_VERB "%6.3" "" COMPU_TAB_REF UBFAILSRC_SY_Compu /end COMPU_METHOD
/begin COMPU_VTAB UBFAILSRC_SY_Compu "" TAB_VERB 2 0 "NONE" 1 "PWRSPLYCHIP" /end COMPU_VTAB
/begin COMPU_METHOD UCATDST2_TYPAVL_SC_Compu "" TAB_VERB "%6.3" "" COMPU_TAB_REF UCATDST2_TYPAVL_SC_Compu /end COMPU_METHOD
/begin COMPU_VTAB UCATDST2_TYPAVL_SC_Compu "" TAB_VERB 2 0 "False" 1 "True" /end COMPU_VTAB
/begin COMPU_METHOD UCATDST_TYPAVL_SC_Compu "" TAB_VERB "%6.3" "" COMPU_TAB_REF UCATDST_TYPAVL_SC_Compu /end COMPU_METHOD
/begin COMPU_VTAB UCATDST_TYPAVL_SC_Compu "" TAB_VERB 2 0 "False" 1 "True" /end COMPU_VTAB
/begin COMPU_METHOD UCATUST2_TYPAVL_SC_Compu "" TAB_VERB "%6.3" "" COMPU_TAB_REF UCATUST2_TYPAVL_SC_Compu /end COMPU_METHOD
/begin COMPU_VTAB UCATUST2_TYPAVL_SC_Compu "" TAB_VERB 2 0 "False" 1 "True" /end COMPU_VTAB
/begin COMPU_METHOD UCATUST_TYPAVL_SC_Compu "" TAB_VERB "%6.3" "" COMPU_TAB_REF UCATUST_TYPAVL_SC_Compu /end COMPU_METHOD
/begin COMPU_VTAB UCATUST_TYPAVL_SC_Compu "" TAB_VERB 2 0 "False" 1 "True" /end COMPU_VTAB
/begin COMPU_METHOD UEGO_24VSUPRT_SC_Compu "" TAB_VERB "%6.3" "" COMPU_TAB_REF UEGO_24VSUPRT_SC_Compu /end COMPU_METHOD
/begin COMPU_VTAB UEGO_24VSUPRT_SC_Compu "" TAB_VERB 2 0 "False" 1 "True" /end COMPU_VTAB
/begin COMPU_METHOD UEGO_AsicState_COMPU_VERB "" TAB_VERB "%6.3" "" COMPU_TAB_REF UEGO_AsicState_COMPU_VERB /end COMPU_METHOD
/begin COMPU_VTAB UEGO_AsicState_COMPU_VERB "" TAB_VERB 8 0 "RESET" 1 "IDLE" 2 "SWITCHON" 3 "NORMAL1" 4 "NORMAL2" 5 "WARMUP" 6 "NORMAL3" 7 "FAILURE" /end COMPU_VTAB
/begin COMPU_METHOD UEGO_ASICSTEP_SC_Compu "" TAB_VERB "%6.3" "" COMPU_TAB_REF UEGO_ASICSTEP_SC_Compu /end COMPU_METHOD
/begin COMPU_VTAB UEGO_ASICSTEP_SC_Compu "" TAB_VERB 5 0 "None" 1 "CJ135BA" 2 "CJ135CA" 3 "CJ135DA" 4 "CJ135EA" /end COMPU_VTAB
/begin COMPU_METHOD UEGO_CALREDN_SC_Compu "" TAB_VERB "%6.3" "" COMPU_TAB_REF UEGO_CALREDN_SC_Compu /end COMPU_METHOD
/begin COMPU_VTAB UEGO_CALREDN_SC_Compu "" TAB_VERB 2 0 "No Reduction" 1 "Reduction" /end COMPU_VTAB
/begin COMPU_METHOD UEGO_CIPEADPNENA_SC_Compu "" TAB_VERB "%6.3" "" COMPU_TAB_REF UEGO_CIPEADPNENA_SC_Compu /end COMPU_METHOD
/begin COMPU_VTAB UEGO_CIPEADPNENA_SC_Compu "" TAB_VERB 2 0 "Deactivate" 1 "Activate" /end COMPU_VTAB
/begin COMPU_METHOD UEGO_CJ135AN_SC_Compu "" TAB_VERB "%6.3" "" COMPU_TAB_REF UEGO_CJ135AN_SC_Compu /end COMPU_METHOD
/begin COMPU_VTAB UEGO_CJ135AN_SC_Compu "" TAB_VERB 2 0 "False" 1 "True" /end COMPU_VTAB
/begin COMPU_METHOD UEGO_CJ135IPMPOFFSIDN_SC_Compu "" TAB_VERB "%6.3" "" COMPU_TAB_REF UEGO_CJ135IPMPOFFSIDN_SC_Compu /end COMPU_METHOD
/begin COMPU_VTAB UEGO_CJ135IPMPOFFSIDN_SC_Compu "" TAB_VERB 2 0 "False" 1 "True" /end COMPU_VTAB
/begin COMPU_METHOD UEGO_DataCalib_COMPU_VERB "" TAB_VERB "%6.3" "" COMPU_TAB_REF UEGO_DataCalib_COMPU_VERB /end COMPU_METHOD
/begin COMPU_VTAB UEGO_DataCalib_COMPU_VERB "" TAB_VERB 8 0 "CALIB_DEFAULT" 1 "CALIB_ONE" 2 "CALIB_TWO" 3 "CALIB_THREE" 4 "CALIB_FOUR" 5 "CALIB_FIVE" 6 "CALIB_SIX" 7 "CALIB_SEVEN" /end COMPU_VTAB
/begin COMPU_METHOD UEGO_DataOpt_COMPU_VERB "" TAB_VERB "%6.3" "" COMPU_TAB_REF UEGO_DataOpt_COMPU_VERB /end COMPU_METHOD
/begin COMPU_VTAB UEGO_DataOpt_COMPU_VERB "" TAB_VERB 7 0 "OPT_ONE_DEFAULT" 1 "OPT_ZERO_SWTON" 2 "OPT_ONE_STATIC" 3 "OPT_TWO_STATIC" 4 "OPT_TWO_ACTIVE" 5 "OPT_ZERO_ACTIVE" 6 "OPT_ONE_ACTIVE" /end COMPU_VTAB
/begin COMPU_METHOD UEGO_Data_COMPU_VERB "" TAB_VERB "%6.3" "" COMPU_TAB_REF UEGO_Data_COMPU_VERB /end COMPU_METHOD
/begin COMPU_VTAB UEGO_Data_COMPU_VERB "" TAB_VERB 4 0 "UEGO_DATA_RESET" 2 "UEGO_DATA_SWITCHON" 5 "UEGO_DATA_WARMUP" 3 "UEGO_DATA_NORMAL" /end COMPU_VTAB
/begin COMPU_METHOD UEGO_DiagHeatrPrfmncModInt_COMPU_VERB "" TAB_VERB "%6.3" "" COMPU_TAB_REF UEGO_DiagHeatrPrfmncModInt_COMPU_VERB /end COMPU_METHOD
/begin COMPU_VTAB UEGO_DiagHeatrPrfmncModInt_COMPU_VERB "" TAB_VERB 5 1 "DEACTIVATED" 2 "WAITING" 3 "ACTIVE" 4 "HOLD" 5 "LOCKED" /end COMPU_VTAB
/begin COMPU_METHOD UEGO_DiagHeatrPrfmncModRes_COMPU_VERB "" TAB_VERB "%6.3" "" COMPU_TAB_REF UEGO_DiagHeatrPrfmncModRes_COMPU_VERB /end COMPU_METHOD
/begin COMPU_VTAB UEGO_DiagHeatrPrfmncModRes_COMPU_VERB "" TAB_VERB 5 1 "NO_RESULT" 2 "NO_RESULT_DIAG_DEACTIVATED" 3 "HEAL_RESULT" 4 "HEAL_RESULT_CONFIRMED" 5 "FAULT_RESULT" /end COMPU_VTAB
/begin COMPU_METHOD UEGO_DiagHeatrPrfmncModRprt_COMPU_VERB "" TAB_VERB "%6.3" "" COMPU_TAB_REF UEGO_DiagHeatrPrfmncModRprt_COMPU_VERB /end COMPU_METHOD
/begin COMPU_VTAB UEGO_DiagHeatrPrfmncModRprt_COMPU_VERB "" TAB_VERB 6 0 "NO_REPORT" 1 "HEAL_REPORT" 2 "REPORT_NOT_POSSIBLE" 3 "HEAL_REPORT_CONFIRM" 4 "FAULT_REPORT" 5 "REPORT_PID41" /end COMPU_VTAB
/begin COMPU_METHOD UEGO_DiagHeatrPrfmncModSel_COMPU_VERB "" TAB_VERB "%6.3" "" COMPU_TAB_REF UEGO_DiagHeatrPrfmncModSel_COMPU_VERB /end COMPU_METHOD
/begin COMPU_VTAB UEGO_DiagHeatrPrfmncModSel_COMPU_VERB "" TAB_VERB 4 1 "NO_RELEASE" 2 "FAULT_HEAL_RELEASE" 3 "FAULT_RELEASE" 4 "HEAL_RELEASE" /end COMPU_VTAB
/begin COMPU_METHOD UEGO_SNSRType_COMPU_VERB "" TAB_VERB "%6.3" "" COMPU_TAB_REF UEGO_SNSRType_COMPU_VERB /end COMPU_METHOD
/begin COMPU_VTAB UEGO_SNSRType_COMPU_VERB "" TAB_VERB 12 0 "Sensor not supported" 1 "LSU4.9 or LSU4.9TSP" 2 "LSU_ADV" 3 "LSU 5.1" 4 "LSU 5.2" 10 "NTKU2 or NTKU2.1 with RCmp" 11 "NTKU2 No RCmp" 12 "NTKU3 with RCmp" 13 "NTKU3 No RCmp" 20 "Denso Plus5.1" 21 "Denso Plus6.1" 22 "Denso Plus6.F" /end COMPU_VTAB
/begin COMPU_METHOD Volt_Batt "" RAT_FUNC "%6.1" "mV" COEFFS 0 0.05 0 0 0 1 /end COMPU_METHOD
/begin RECORD_LAYOUT RB_Curve_U16_U16 NO_AXIS_PTS_X 1 UWORD AXIS_PTS_X 2 UWORD INDEX_INCR DIRECT FNC_VALUES 3 UWORD COLUMN_DIR DIRECT /end RECORD_LAYOUT
/begin RECORD_LAYOUT RB_Map_U8U8_U8 NO_AXIS_PTS_X 1 UBYTE NO_AXIS_PTS_Y 2 UBYTE AXIS_PTS_X 3 UBYTE INDEX_INCR DIRECT AXIS_PTS_Y 4 UBYTE INDEX_INCR DIRECT FNC_VALUES 5 UBYTE COLUMN_DIR DIRECT /end RECORD_LAYOUT
/begin RECORD_LAYOUT RB_Val_Wboolean FNC_VALUES 1 UBYTE COLUMN_DIR DIRECT /end RECORD_LAYOUT
/begin RECORD_LAYOUT RB_Val_Ws16 FNC_VALUES 1 SWORD COLUMN_DIR DIRECT /end RECORD_LAYOUT
/begin RECORD_LAYOUT RB_Val_Ws8 FNC_VALUES 1 SBYTE COLUMN_DIR DIRECT /end RECORD_LAYOUT
/begin RECORD_LAYOUT RB_Val_Wu16 FNC_VALUES 1 UWORD COLUMN_DIR DIRECT /end RECORD_LAYOUT
/begin RECORD_LAYOUT RB_Val_Wu32 FNC_VALUES 1 ULONG COLUMN_DIR DIRECT /end RECORD_LAYOUT
/begin RECORD_LAYOUT RB_Val_Wu8 FNC_VALUES 1 UBYTE COLUMN_DIR DIRECT /end RECORD_LAYOUT
/end MODULE
/end PROJECT
