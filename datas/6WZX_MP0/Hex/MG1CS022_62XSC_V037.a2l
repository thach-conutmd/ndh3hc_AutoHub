ASAP2_VERSION 1 60
/begin PROJECT MG1CS022 "MG1CS022"
/begin HEADER "" VERSION "MG1CS022_62XSC_V037" PROJECT_NO MG1CS022 /end HEADER
/begin MODULE DIM ""
/begin MOD_COMMON "" BYTE_ORDER MSB_LAST ALIGNMENT_BYTE 1 ALIGNMENT_WORD 2 ALIGNMENT_LONG 4 ALIGNMENT_INT64 4 ALIGNMENT_FLOAT32_IEEE 4 ALIGNMENT_FLOAT64_IEEE 4 DATA_SIZE 32 /end MOD_COMMON
/begin CHARACTERISTIC Com_bDigMtrUnit_C "Default value for Speed Meter display unit in case of frame error" VALUE 0x8053BD52 Val_Wu8 1.000 OneToOne 0.00 1.000 FORMAT "%5.3" EXTENDED_LIMITS 0.00 255.0 /end CHARACTERISTIC
/begin CHARACTERISTIC Com_ctCRingMETE2_C "Default application value for Com_ctCRingMETE2 in case of defective reception" VALUE 0x8053BD48 RB_Val_Wu8 255.0 OneToOne 0.00 255.0 FORMAT "%5.1" /end CHARACTERISTIC
/begin CHARACTERISTIC Com_ctCRingMETG_C "The message counter for METG frame" VALUE 0x8053BD60 RB_Val_Wu8 3.000 OneToOne 0.00 3.000 FORMAT "%5.3" EXTENDED_LIMITS 0.00 255.0 /end CHARACTERISTIC
/begin CHARACTERISTIC Com_ctCRingMETH2_C "Default Calibration for Ring Counter of METH2 Frame" VALUE 0x8053BD6A RB_Val_Wu8 3.000 OneToOne 0.00 3.000 FORMAT "%5.3" EXTENDED_LIMITS 0.00 255.0 /end CHARACTERISTIC
/begin CHARACTERISTIC Com_ctCRingMETM_C "Default application value for Com_ctCRingMETM in case of defective reception" VALUE 0x8053BD82 RB_Val_Wu8 3.000 OneToOne 0.00 3.000 FORMAT "%5.3" EXTENDED_LIMITS 0.00 255.0 /end CHARACTERISTIC
/begin CHARACTERISTIC Com_ctCRingMETN_C "Default application value for Com_ctCRingMETN in case of defective reception" VALUE 0x8053BD88 RB_Val_Wu8 3.000 OneToOne 0.00 3.000 FORMAT "%5.3" EXTENDED_LIMITS 0.00 255.0 /end CHARACTERISTIC
/begin CHARACTERISTIC Com_dMETAMaxDiff_C "Maximum difference between 2 message counters of META for error detection" VALUE 0x8053BD36 RB_Val_Wu8 255.0 OneToOne 0.00 255.0 FORMAT "%5.1" /end CHARACTERISTIC
/begin CHARACTERISTIC Com_dMETAMaxPer_C "Maximum value of period for detection of META stopped message counter" VALUE 0x8053BD37 RB_Val_Wu8 255.0 OneToOne 0.00 255.0 FORMAT "%5.1" /end CHARACTERISTIC
/begin CHARACTERISTIC Com_dMETASigSel_C "Signal selection data for META frame" VALUE 0x8053BD38 RB_Val_Wu8 255.0 OneToOne 0.00 255.0 FORMAT "%5.1" /end CHARACTERISTIC
/begin CHARACTERISTIC Com_dMETCMaxDiff_C "Application value for the maximum allowed difference between the values of the message conter of two consecutive frames" VALUE 0x8053BD3C RB_Val_Wu8 255.0 OneToOne 0.00 255.0 FORMAT "%5.1" /end CHARACTERISTIC
/begin CHARACTERISTIC Com_dMETCMaxPer_C "Application value for the maximum number of times the same value for the message counter may be received" VALUE 0x8053BD3D RB_Val_Wu8 255.0 OneToOne 0.00 255.0 FORMAT "%5.1" /end CHARACTERISTIC
/begin CHARACTERISTIC Com_dMETCSigSel_C "Signal selection data for METC frame" VALUE 0x8053BD3E RB_Val_Wu8 255.0 OneToOne 0.00 255.0 FORMAT "%5.1" /end CHARACTERISTIC
/begin CHARACTERISTIC Com_dMETDMaxDiff_C "Application value for the maximum allowed difference between the values of the message conter of two consecutive METD frames" VALUE 0x8053BD42 RB_Val_Wu8 255.0 OneToOne 0.00 255.0 FORMAT "%5.1" /end CHARACTERISTIC
/begin CHARACTERISTIC Com_dMETDMaxPer_C "Application value for the maximum number of times the same value for the message counter may be received" VALUE 0x8053BD43 RB_Val_Wu8 255.0 OneToOne 0.00 255.0 FORMAT "%5.1" /end CHARACTERISTIC
/begin CHARACTERISTIC Com_dMETE2MaxDiff_C "Application constant for Maximum difference between the counter values for METE2 frame" VALUE 0x8053BD49 RB_Val_Wu8 255.0 OneToOne 0.00 255.0 FORMAT "%5.1" /end CHARACTERISTIC
/begin CHARACTERISTIC Com_dMETE2MaxPer_C "Period for METE2 frame." VALUE 0x8053BD4A RB_Val_Wu8 255.0 OneToOne 0.00 255.0 FORMAT "%5.1" /end CHARACTERISTIC
/begin CHARACTERISTIC Com_dMETE2SigSel_C "Signal selection data for METE2 frame" VALUE 0x8053BD4B RB_Val_Wu8 255.0 OneToOne 0.00 255.0 FORMAT "%5.1" /end CHARACTERISTIC
/begin CHARACTERISTIC Com_dMETFMaxDiff_C "Application constant for Maximum difference for METF frame" VALUE 0x8053BD53 Val_Wu8 255.0 OneToOne 0.00 255.0 FORMAT "%5.1" /end CHARACTERISTIC
/begin CHARACTERISTIC Com_dMETFMaxPer_C "Threshold for detection of stopped message counter for CAN frame METF" VALUE 0x8053BD54 Val_Wu8 255.0 OneToOne 0.00 255.0 FORMAT "%5.1" /end CHARACTERISTIC
/begin CHARACTERISTIC Com_dMETFSigSel_C "Signal selection data for METF frame" VALUE 0x8053BD55 Val_Wu8 255.0 OneToOne 0.00 255.0 FORMAT "%5.1" /end CHARACTERISTIC
/begin CHARACTERISTIC Com_dMETGMaxDiff_C "Application constant for Maximum difference for METG frame" VALUE 0x8053BD61 RB_Val_Wu8 255.0 OneToOne 0.00 255.0 FORMAT "%5.1" /end CHARACTERISTIC
/begin CHARACTERISTIC Com_dMETGMaxPer_C "Threshold for detection of stopped message counter for CAN frame METG" VALUE 0x8053BD62 RB_Val_Wu8 255.0 OneToOne 0.00 255.0 FORMAT "%5.1" /end CHARACTERISTIC
/begin CHARACTERISTIC Com_dMETH2MaxDiff_C "Application constant for Maximum difference for METH2 frame." VALUE 0x8053BD6B RB_Val_Wu8 255.0 OneToOne 0.00 255.0 FORMAT "%5.1" /end CHARACTERISTIC
/begin CHARACTERISTIC Com_dMETH2MaxPer_C "Threshold for detection of stopped message counter for CAN frame METH2" VALUE 0x8053BD6C RB_Val_Wu8 255.0 OneToOne 0.00 255.0 FORMAT "%5.1" /end CHARACTERISTIC
/begin CHARACTERISTIC Com_dMETH2SigSel_C "Signal selection data for METH2 frame" VALUE 0x8053BD6D RB_Val_Wu8 255.0 OneToOne 0.00 255.0 FORMAT "%5.1" /end CHARACTERISTIC
/begin CHARACTERISTIC Com_dMETHMaxDiff_C "Application constant for Maximum difference for METH frame." VALUE 0x8053BD66 RB_Val_Wu8 255.0 OneToOne 0.00 255.0 FORMAT "%5.1" /end CHARACTERISTIC
/begin CHARACTERISTIC Com_dMETHMaxPer_C "Threshold for detection of stopped message counter for CAN frame METH." VALUE 0x8053BD67 RB_Val_Wu8 255.0 OneToOne 0.00 255.0 FORMAT "%5.1" /end CHARACTERISTIC
/begin CHARACTERISTIC Com_dMETIMaxDiff_C "Application constant for Maximum difference between the counter values for METI frame." VALUE 0x8053BD72 RB_Val_Wu8 255.0 OneToOne 0.00 255.0 FORMAT "%5.1" /end CHARACTERISTIC
/begin CHARACTERISTIC Com_dMETIMaxPer_C "Period for METI frame." VALUE 0x8053BD73 RB_Val_Wu8 255.0 OneToOne 0.00 255.0 FORMAT "%5.1" /end CHARACTERISTIC
/begin CHARACTERISTIC Com_dMETISigSel_C "Signal selection data for METI frame" VALUE 0x8053BD74 RB_Val_Wu8 255.0 OneToOne 0.00 255.0 FORMAT "%5.1" /end CHARACTERISTIC
/begin CHARACTERISTIC Com_dMETKMaxDiff_C "Maximum difference between 2 message counters of METK for error detection" VALUE 0x8053BD78 RB_Val_Wu8 255.0 OneToOne 0.00 255.0 FORMAT "%5.1" /end CHARACTERISTIC
/begin CHARACTERISTIC Com_dMETKMaxPer_C "Maximum value of period for detection of METK stopped message counter" VALUE 0x8053BD79 RB_Val_Wu8 255.0 OneToOne 0.00 255.0 FORMAT "%5.1" /end CHARACTERISTIC
/begin CHARACTERISTIC Com_dMETKSigSel_C "Signal selection data for METK frame" VALUE 0x8053BD7A RB_Val_Wu8 255.0 OneToOne 0.00 255.0 FORMAT "%5.1" /end CHARACTERISTIC
/begin CHARACTERISTIC Com_dMETLMaxDiff_C "Maximum difference between 2 message counters of METL for error detection" VALUE 0x8053BD80 RB_Val_Wu8 255.0 OneToOne 0.00 255.0 FORMAT "%5.1" /end CHARACTERISTIC
/begin CHARACTERISTIC Com_dMETLMaxPer_C "Maximum value of period for detection of METL stopped message counter" VALUE 0x8053BD81 RB_Val_Wu8 255.0 OneToOne 0.00 255.0 FORMAT "%5.1" /end CHARACTERISTIC
/begin CHARACTERISTIC Com_dMETMMaxDiff_C "Application constant for Maximum difference between the counter values for METM frame" VALUE 0x8053BD83 RB_Val_Wu8 255.0 OneToOne 0.00 255.0 FORMAT "%5.1" /end CHARACTERISTIC
/begin CHARACTERISTIC Com_dMETMMaxPer_C "Period for METM frame" VALUE 0x8053BD84 RB_Val_Wu8 255.0 OneToOne 0.00 255.0 FORMAT "%5.1" /end CHARACTERISTIC
/begin CHARACTERISTIC Com_dMETNMaxDiff_C "Application constant for Maximum difference between the counter values for METN frame" VALUE 0x8053BD89 RB_Val_Wu8 255.0 OneToOne 0.00 255.0 FORMAT "%5.1" /end CHARACTERISTIC
/begin CHARACTERISTIC Com_dMETNMaxPer_C "Period for METN frame" VALUE 0x8053BD8A RB_Val_Wu8 255.0 OneToOne 0.00 255.0 FORMAT "%5.1" /end CHARACTERISTIC
/begin CHARACTERISTIC Com_lDstMETK_C "Calibration for Coverage distance" VALUE 0x8053BD7C RB_Val_Ws32 16777215.0000 OilMlg 0.00 16777215.0000 FORMAT "%13.4" EXTENDED_LIMITS -2147483648.00 2147483647.00 /end CHARACTERISTIC
/begin CHARACTERISTIC Com_nrActPtcActv_C "Calibartion for Actual number of activated PTC elements" VALUE 0x8053BD6E RB_Val_Wu8 15.00 OneToOne 0.00 15.00 FORMAT "%5.2" EXTENDED_LIMITS 0.00 255.0 /end CHARACTERISTIC
/begin CHARACTERISTIC Com_numCsumMETA_C "Checksum calibration for META" VALUE 0x8053BD39 RB_Val_Wu8 15.00 OneToOne 0.00 15.00 FORMAT "%5.2" EXTENDED_LIMITS 0.00 255.0 /end CHARACTERISTIC
/begin CHARACTERISTIC Com_numCsumMETD_C "Default value for Checksum message for METD frame in case of error" VALUE 0x8053BD44 RB_Val_Wu8 15.00 OneToOne 0.00 15.00 FORMAT "%5.2" EXTENDED_LIMITS 0.00 255.0 /end CHARACTERISTIC
/begin CHARACTERISTIC Com_numCsumMETE2_C "Default application value for Com_numCsumMETE2 in case of defective reception." VALUE 0x8053BD4C RB_Val_Wu8 255.0 OneToOne 0.00 255.0 FORMAT "%5.1" /end CHARACTERISTIC
/begin CHARACTERISTIC Com_numCsumMETF_C "Default value for Check sum of METF frame in case of frame error" VALUE 0x8053BD56 Val_Wu8 15.00 OneToOne 0.00 15.00 FORMAT "%5.2" EXTENDED_LIMITS 0.00 255.0 /end CHARACTERISTIC
/begin CHARACTERISTIC Com_numCsumMETG_C "Checksum calibration for METG" VALUE 0x8053BD63 RB_Val_Wu8 15.00 OneToOne 0.00 15.00 FORMAT "%5.2" EXTENDED_LIMITS 0.00 255.0 /end CHARACTERISTIC
/begin CHARACTERISTIC Com_numCsumMETH2_C "Default Calibration for Checksum of METH2 Frame" VALUE 0x8053BD6F RB_Val_Wu8 15.00 OneToOne 0.00 15.00 FORMAT "%5.2" EXTENDED_LIMITS 0.00 255.0 /end CHARACTERISTIC
/begin CHARACTERISTIC Com_numCsumMETH_C "Checksum calibration for METH frame." VALUE 0x8053BD68 RB_Val_Wu8 15.00 OneToOne 0.00 15.00 FORMAT "%5.2" EXTENDED_LIMITS 0.00 255.0 /end CHARACTERISTIC
/begin CHARACTERISTIC Com_numCsumMETM_C "Default application value for Com_numCsumMETM in case of defective reception" VALUE 0x8053BD85 RB_Val_Wu8 15.00 OneToOne 0.00 15.00 FORMAT "%5.2" EXTENDED_LIMITS 0.00 255.0 /end CHARACTERISTIC
/begin CHARACTERISTIC Com_numCsumMETN_C "Default application value for Com_numCsumMETN in case of defective reception" VALUE 0x8053BD8B RB_Val_Wu8 15.00 OneToOne 0.00 15.00 FORMAT "%5.2" EXTENDED_LIMITS 0.00 255.0 /end CHARACTERISTIC
/begin CHARACTERISTIC Com_stACCut_C "Default value for air conditioner status of METG frame in case of frame error" VALUE 0x8053BD64 RB_Val_Wu8 7.000 OneToOne 0.00 7.000 FORMAT "%5.3" EXTENDED_LIMITS 0.00 255.0 /end CHARACTERISTIC
/begin CHARACTERISTIC Com_stACGUpReq_C "Default calibration for Com_stACGUpReq" VALUE 0x8053BD70 RB_Val_Wu8 1.000 OneToOne 0.00 1.000 FORMAT "%5.3" EXTENDED_LIMITS 0.00 255.0 /end CHARACTERISTIC
/begin CHARACTERISTIC Com_stECON_C "Default value for Com_stECON , when error is reported" VALUE 0x8053BD45 RB_Val_Wu8 1.000 OneToOne 0.00 1.000 FORMAT "%5.3" EXTENDED_LIMITS 0.00 255.0 /end CHARACTERISTIC
/begin CHARACTERISTIC Com_stMtrCustDftReq_C "default value of Meter request" VALUE 0x8053BD86 RB_Val_Wu8 255.0 OneToOne 0.00 255.0 FORMAT "%5.1" /end CHARACTERISTIC
/begin CHARACTERISTIC Com_stMtrCustStReq_C "Default value Calibration parameter for Com_stMtrCustStReq message" VALUE 0x8053BD87 RB_Val_Wu8 255.0 OneToOne 0.00 255.0 FORMAT "%5.1" /end CHARACTERISTIC
/begin CHARACTERISTIC Com_stTarSpdDisp_C "Target Speed Display" VALUE 0x8053BD57 Val_Wu8 1.000 OneToOne 0.00 1.000 FORMAT "%5.3" EXTENDED_LIMITS 0.00 255.0 /end CHARACTERISTIC
/begin CHARACTERISTIC Com_swtMETAMonEna_C "META error monitoring enable switch" VALUE 0x8053BD3A RB_Val_Wboolean 255.0 OneToOne 0.00 255.0 FORMAT "%5.1" /end CHARACTERISTIC
/begin CHARACTERISTIC Com_swtMETDMonFrmSel_C "METD and METD2 frame selection switch" VALUE 0x8058B60C Val_Wu8 1.000 OneToOne 0.00 1.000 FORMAT "%5.3" EXTENDED_LIMITS 0.00 255.0 /end CHARACTERISTIC
/begin CHARACTERISTIC Com_swtMETFMonEna_C "METF error monitoring enable switch" VALUE 0x8053BD58 RB_Val_Wboolean 255.0 OneToOne 0.00 255.0 FORMAT "%5.1" /end CHARACTERISTIC
/begin CHARACTERISTIC Com_swtMETGFrmTypSel_C "Calibration Parameter for selecting METGMETG2 Frame for MY17MY12" VALUE 0x8053BD65 RB_Val_Wu8 255.0 OneToOne 0.00 255.0 FORMAT "%5.1" /end CHARACTERISTIC
/begin CHARACTERISTIC Com_swtMETHMonEna_C "METH error monitoring enable switch" VALUE 0x8053BD69 RB_Val_Wboolean 255.0 OneToOne 0.00 255.0 FORMAT "%5.1" /end CHARACTERISTIC
/begin CHARACTERISTIC Com_tACAirTOut_C "Calibration for METER_AC_Out Air Temperature" VALUE 0x8053BD71 RB_Val_Wu8 127.5 temp_q0p5_o30_degC -30.00 97.50 FORMAT "%5.2" /end CHARACTERISTIC
/begin CHARACTERISTIC Com_tACMtrEvaInfo_C "AC EVA temperature information calibration" VALUE 0x8053BD8C RB_Val_Wu8 127.5 temp_q0p5_o30_degC -30.00 97.50 FORMAT "%5.2" /end CHARACTERISTIC
/begin CHARACTERISTIC Com_tAirInsdCbn_C "Default application value for Com_tAirInsdCbn in case of defective reception." VALUE 0x8053BD4E RB_Val_Ws16 255. Com_EvaTemp_Compu -30. 225. FORMAT "%2.0" EXTENDED_LIMITS -32798. 32737. /end CHARACTERISTIC
/begin CHARACTERISTIC Com_tiISSPrms_C "Default value Idle Stop Persmission time" VALUE 0x8053BD46 RB_Val_Wu8 240.0 Time_sec_q1_COMPU 0.00 240.0 FORMAT "%5.1" EXTENDED_LIMITS 0.00 255.0 /end CHARACTERISTIC
/begin CHARACTERISTIC Com_tMETE2AirOutside_C "Default application value for Com_tMETE2AirOutside in case of defective reception." VALUE 0x8053BD50 RB_Val_Ws16 102.0000 Temp_Cels -40.04000 61.96000 FORMAT "%8.5" EXTENDED_LIMITS -3549.940 3003.560 /end CHARACTERISTIC
/begin CHARACTERISTIC Com_tOutd_C "Outside air temperature Calibration" VALUE 0x8053BD40 RB_Val_Ws16 102.0000 Temp_Cels -40.04000 61.96000 FORMAT "%8.5" EXTENDED_LIMITS -3549.940 3003.560 /end CHARACTERISTIC
/begin CHARACTERISTIC Com_vAnaVeh_C "Default value for Meter display speed in case of frame error'" VALUE 0x8053BD5A Val_Wu16 655.3500 Vel 0.00 655.3500 FORMAT "%8.4" /end CHARACTERISTIC
/begin CHARACTERISTIC Com_vDigVehRaw_C "Default value for Speed Meter display target value(Raw Value) in case of frame error'" VALUE 0x8053BD5C Val_Wu16 655.3500 Vel 0.00 655.3500 FORMAT "%8.4" /end CHARACTERISTIC
/begin CHARACTERISTIC Com_vDigVeh_C "Default value for Digital Speed Meter display target value(Hysteresis processing value for display) in case of frame error'" VALUE 0x8053BD5E Val_Wu8 255.0 OneToOne 0.00 255.0 FORMAT "%5.1" /end CHARACTERISTIC
/begin CHARACTERISTIC CWDSTHDR "code word for diagnosis start with high pressure" VALUE 0x8053B34C RB_Val_Wu8 255.0 dez 0.00 255.0 FORMAT "%5.1" /end CHARACTERISTIC
/begin CHARACTERISTIC DFES_MeterOut.DFC_MOXEMM_SMU_ALM6_12_C "project specific calibration data / Project specific calibration data for DFC_MOXEMM_SMU_ALM6_12" VALUE 0x804F596F Val_Wu8 255.0 OneToOne 0.00 255.0 FORMAT "%5.1" /end CHARACTERISTIC
/begin CHARACTERISTIC DFES_MeterOut.DFC_MOXEMM_SMU_ALM6_14_C "project specific calibration data / Project specific calibration data for DFC_MOXEMM_SMU_ALM6_14" VALUE 0x804F5970 Val_Wu8 255.0 OneToOne 0.00 255.0 FORMAT "%5.1" /end CHARACTERISTIC
/begin CHARACTERISTIC DFES_MeterOut.DFC_MOXEMM_SMU_ALM6_15_C "project specific calibration data / Project specific calibration data for DFC_MOXEMM_SMU_ALM6_15" VALUE 0x804F5971 Val_Wu8 255.0 OneToOne 0.00 255.0 FORMAT "%5.1" /end CHARACTERISTIC
/begin CHARACTERISTIC DFES_MeterOut.DFC_MOXEMM_SMU_ALM6_17_C "project specific calibration data / Project specific calibration data for DFC_MOXEMM_SMU_ALM6_17" VALUE 0x804F5972 Val_Wu8 255.0 OneToOne 0.00 255.0 FORMAT "%5.1" /end CHARACTERISTIC
/begin CHARACTERISTIC DFES_MeterOut.DFC_MOXEMM_SMU_ALM6_18_C "project specific calibration data / Project specific calibration data for DFC_MOXEMM_SMU_ALM6_18" VALUE 0x804F5973 Val_Wu8 255.0 OneToOne 0.00 255.0 FORMAT "%5.1" /end CHARACTERISTIC
/begin CHARACTERISTIC DFES_MeterOut.DFC_MOXEMM_SMU_ALM6_20_C "project specific calibration data / Project specific calibration data for DFC_MOXEMM_SMU_ALM6_20" VALUE 0x804F5974 Val_Wu8 255.0 OneToOne 0.00 255.0 FORMAT "%5.1" /end CHARACTERISTIC
/begin CHARACTERISTIC DFES_MeterOut.DFC_MOXEMM_SMU_ALM6_21_C "project specific calibration data / Project specific calibration data for DFC_MOXEMM_SMU_ALM6_21" VALUE 0x804F5975 Val_Wu8 255.0 OneToOne 0.00 255.0 FORMAT "%5.1" /end CHARACTERISTIC
/begin CHARACTERISTIC DFES_MeterOut.DFC_MOXEMM_SMU_ALM6_25_C "project specific calibration data / Project specific calibration data for DFC_MOXEMM_SMU_ALM6_25" VALUE 0x804F5976 Val_Wu8 255.0 OneToOne 0.00 255.0 FORMAT "%5.1" /end CHARACTERISTIC
/begin CHARACTERISTIC DFES_MeterOut.DFC_MOXEMM_SMU_ALM6_4_C "project specific calibration data / Project specific calibration data for DFC_MOXEMM_SMU_ALM6_4" VALUE 0x804F5977 Val_Wu8 255.0 OneToOne 0.00 255.0 FORMAT "%5.1" /end CHARACTERISTIC
/begin CHARACTERISTIC DFES_MeterOut.DFC_MOXEMM_SMU_ALM6_5_C "project specific calibration data / Project specific calibration data for DFC_MOXEMM_SMU_ALM6_5" VALUE 0x804F5978 Val_Wu8 255.0 OneToOne 0.00 255.0 FORMAT "%5.1" /end CHARACTERISTIC
/begin CHARACTERISTIC DFES_MeterOut.DFC_MOXEMM_SMU_ALM6_7_C "project specific calibration data / Project specific calibration data for DFC_MOXEMM_SMU_ALM6_7" VALUE 0x804F5979 Val_Wu8 255.0 OneToOne 0.00 255.0 FORMAT "%5.1" /end CHARACTERISTIC
/begin CHARACTERISTIC DFES_MeterOut.DFC_MOXEMM_SMU_ALM6_8_C "project specific calibration data / Project specific calibration data for DFC_MOXEMM_SMU_ALM6_8" VALUE 0x804F597A Val_Wu8 255.0 OneToOne 0.00 255.0 FORMAT "%5.1" /end CHARACTERISTIC
/begin CHARACTERISTIC DFES_MeterOut.DFC_MOXEMM_SMU_ALM7_1_C "project specific calibration data / Project specific calibration data for DFC_MOXEMM_SMU_ALM7_1" VALUE 0x804F597B Val_Wu8 255.0 OneToOne 0.00 255.0 FORMAT "%5.1" /end CHARACTERISTIC
/begin CHARACTERISTIC DFES_MeterOut.DFC_MOXEMM_SMU_ALM7_12_C "project specific calibration data / Project specific calibration data for DFC_MOXEMM_SMU_ALM7_12" VALUE 0x804F597C Val_Wu8 255.0 OneToOne 0.00 255.0 FORMAT "%5.1" /end CHARACTERISTIC
/begin CHARACTERISTIC DFES_MeterOut.DFC_MOXEMM_SMU_ALM7_13_C "project specific calibration data / Project specific calibration data for DFC_MOXEMM_SMU_ALM7_13" VALUE 0x804F597D Val_Wu8 255.0 OneToOne 0.00 255.0 FORMAT "%5.1" /end CHARACTERISTIC
/begin CHARACTERISTIC DFES_MeterOut.DFC_MOXEMM_SMU_ALM7_14_C "project specific calibration data / Project specific calibration data for DFC_MOXEMM_SMU_ALM7_14" VALUE 0x804F597E Val_Wu8 255.0 OneToOne 0.00 255.0 FORMAT "%5.1" /end CHARACTERISTIC
/begin CHARACTERISTIC DFES_MeterOut.DFC_MOXEMM_SMU_ALM7_15_C "project specific calibration data / Project specific calibration data for DFC_MOXEMM_SMU_ALM7_15" VALUE 0x804F597F Val_Wu8 255.0 OneToOne 0.00 255.0 FORMAT "%5.1" /end CHARACTERISTIC
/begin CHARACTERISTIC DFES_MeterOut.DFC_MOXEMM_SMU_ALM7_16_C "project specific calibration data / Project specific calibration data for DFC_MOXEMM_SMU_ALM7_16" VALUE 0x804F5980 Val_Wu8 255.0 OneToOne 0.00 255.0 FORMAT "%5.1" /end CHARACTERISTIC
/begin CHARACTERISTIC DFES_MeterOut.DFC_MOXEMM_SMU_ALM7_17_C "project specific calibration data / Project specific calibration data for DFC_MOXEMM_SMU_ALM7_17" VALUE 0x804F5981 Val_Wu8 255.0 OneToOne 0.00 255.0 FORMAT "%5.1" /end CHARACTERISTIC
/begin CHARACTERISTIC DFES_MeterOut.DFC_MOXEMM_SMU_ALM7_2_C "project specific calibration data / Project specific calibration data for DFC_MOXEMM_SMU_ALM7_2" VALUE 0x804F5982 Val_Wu8 255.0 OneToOne 0.00 255.0 FORMAT "%5.1" /end CHARACTERISTIC
/begin CHARACTERISTIC DFES_MeterOut.DFC_MOXEMM_SMU_ALM7_20_C "project specific calibration data / Project specific calibration data for DFC_MOXEMM_SMU_ALM7_20" VALUE 0x804F5983 Val_Wu8 255.0 OneToOne 0.00 255.0 FORMAT "%5.1" /end CHARACTERISTIC
/begin CHARACTERISTIC DFES_MeterOut.DFC_MOXEMM_SMU_ALM7_25_C "project specific calibration data / Project specific calibration data for DFC_MOXEMM_SMU_ALM7_25" VALUE 0x804F5984 Val_Wu8 255.0 OneToOne 0.00 255.0 FORMAT "%5.1" /end CHARACTERISTIC
/begin CHARACTERISTIC DFES_MeterOut.DFC_MOXEMM_SMU_ALM7_26_C "project specific calibration data / Project specific calibration data for DFC_MOXEMM_SMU_ALM7_26" VALUE 0x804F5985 Val_Wu8 255.0 OneToOne 0.00 255.0 FORMAT "%5.1" /end CHARACTERISTIC
/begin CHARACTERISTIC DFES_MeterOut.DFC_MOXEMM_SMU_ALM7_28_C "project specific calibration data / Project specific calibration data for DFC_MOXEMM_SMU_ALM7_28" VALUE 0x804F5986 Val_Wu8 255.0 OneToOne 0.00 255.0 FORMAT "%5.1" /end CHARACTERISTIC
/begin CHARACTERISTIC DFES_MeterOut.DFC_MOXEMM_SMU_ALM7_29_C "project specific calibration data / Project specific calibration data for DFC_MOXEMM_SMU_ALM7_29" VALUE 0x804F5987 Val_Wu8 255.0 OneToOne 0.00 255.0 FORMAT "%5.1" /end CHARACTERISTIC
/begin CHARACTERISTIC DFES_MeterOut.DFC_MOXEMM_SMU_ALM7_30_C "project specific calibration data / Project specific calibration data for DFC_MOXEMM_SMU_ALM7_30" VALUE 0x804F5988 Val_Wu8 255.0 OneToOne 0.00 255.0 FORMAT "%5.1" /end CHARACTERISTIC
/begin CHARACTERISTIC DFES_MeterOut.DFC_MOXEMM_SMU_ALM7_31_C "project specific calibration data / Project specific calibration data for DFC_MOXEMM_SMU_ALM7_31" VALUE 0x804F5989 Val_Wu8 255.0 OneToOne 0.00 255.0 FORMAT "%5.1" /end CHARACTERISTIC
/begin CHARACTERISTIC DFES_MeterOut.DFC_MOXEMM_SMU_ALM8_0_C "project specific calibration data / Project specific calibration data for DFC_MOXEMM_SMU_ALM8_0" VALUE 0x804F598A Val_Wu8 255.0 OneToOne 0.00 255.0 FORMAT "%5.1" /end CHARACTERISTIC
/begin CHARACTERISTIC DFES_MeterOut.DFC_MOXEMM_SMU_ALM8_1_C "project specific calibration data / Project specific calibration data for DFC_MOXEMM_SMU_ALM8_1" VALUE 0x804F598B Val_Wu8 255.0 OneToOne 0.00 255.0 FORMAT "%5.1" /end CHARACTERISTIC
/begin CHARACTERISTIC DFES_MeterOut.DFC_MOXEMM_SMU_ALM8_10_C "project specific calibration data / Project specific calibration data for DFC_MOXEMM_SMU_ALM8_10" VALUE 0x804F598C Val_Wu8 255.0 OneToOne 0.00 255.0 FORMAT "%5.1" /end CHARACTERISTIC
/begin CHARACTERISTIC DFES_MeterOut.DFC_MOXEMM_SMU_ALM8_11_C "project specific calibration data / Project specific calibration data for DFC_MOXEMM_SMU_ALM8_11" VALUE 0x804F598D Val_Wu8 255.0 OneToOne 0.00 255.0 FORMAT "%5.1" /end CHARACTERISTIC
/begin CHARACTERISTIC DFES_MeterOut.DFC_MOXEMM_SMU_ALM8_12_C "project specific calibration data / Project specific calibration data for DFC_MOXEMM_SMU_ALM8_12" VALUE 0x804F598E Val_Wu8 255.0 OneToOne 0.00 255.0 FORMAT "%5.1" /end CHARACTERISTIC
/begin CHARACTERISTIC DFES_MeterOut.DFC_MOXEMM_SMU_ALM8_16_C "project specific calibration data / Project specific calibration data for DFC_MOXEMM_SMU_ALM8_16" VALUE 0x804F598F Val_Wu8 255.0 OneToOne 0.00 255.0 FORMAT "%5.1" /end CHARACTERISTIC
/begin CHARACTERISTIC DFES_MeterOut.DFC_MOXEMM_SMU_ALM8_18_C "project specific calibration data / Project specific calibration data for DFC_MOXEMM_SMU_ALM8_18" VALUE 0x804F5990 Val_Wu8 255.0 OneToOne 0.00 255.0 FORMAT "%5.1" /end CHARACTERISTIC
/begin CHARACTERISTIC DFES_MeterOut.DFC_MOXEMM_SMU_ALM8_2_C "project specific calibration data / Project specific calibration data for DFC_MOXEMM_SMU_ALM8_2" VALUE 0x804F5991 Val_Wu8 255.0 OneToOne 0.00 255.0 FORMAT "%5.1" /end CHARACTERISTIC
/begin CHARACTERISTIC DFES_MeterOut.DFC_MOXEMM_SMU_ALM8_3_C "project specific calibration data / Project specific calibration data for DFC_MOXEMM_SMU_ALM8_3" VALUE 0x804F5992 Val_Wu8 255.0 OneToOne 0.00 255.0 FORMAT "%5.1" /end CHARACTERISTIC
/begin CHARACTERISTIC DFES_MeterOut.DFC_MOXEMM_SMU_ALM8_31_C "project specific calibration data / Project specific calibration data for DFC_MOXEMM_SMU_ALM8_31" VALUE 0x804F5993 Val_Wu8 255.0 OneToOne 0.00 255.0 FORMAT "%5.1" /end CHARACTERISTIC
/begin CHARACTERISTIC DFES_MeterOut.DFC_MOXEMM_SMU_ALM8_4_C "project specific calibration data / Project specific calibration data for DFC_MOXEMM_SMU_ALM8_4" VALUE 0x804F5994 Val_Wu8 255.0 OneToOne 0.00 255.0 FORMAT "%5.1" /end CHARACTERISTIC
/begin CHARACTERISTIC DFES_MeterOut.DFC_MOXEMM_SMU_ALM9_0_C "project specific calibration data / Project specific calibration data for DFC_MOXEMM_SMU_ALM9_0" VALUE 0x804F5995 Val_Wu8 255.0 OneToOne 0.00 255.0 FORMAT "%5.1" /end CHARACTERISTIC
/begin CHARACTERISTIC DFES_MeterOut.DFC_MOXEMM_SMU_ALM9_15_C "project specific calibration data / Project specific calibration data for DFC_MOXEMM_SMU_ALM9_15" VALUE 0x804F5996 Val_Wu8 255.0 OneToOne 0.00 255.0 FORMAT "%5.1" /end CHARACTERISTIC
/begin CHARACTERISTIC DFES_MeterOut.DFC_MOXEMM_SMU_ALM9_3_C "project specific calibration data / Project specific calibration data for DFC_MOXEMM_SMU_ALM9_3" VALUE 0x804F5997 Val_Wu8 255.0 OneToOne 0.00 255.0 FORMAT "%5.1" /end CHARACTERISTIC
/begin CHARACTERISTIC DFES_MeterOut.DFC_MoCADCNTP_C "project specific calibration data / Project specific calibration data for DFC_MoCADCNTP" VALUE 0x804F5998 Val_Wu8 255.0 OneToOne 0.00 255.0 FORMAT "%5.1" /end CHARACTERISTIC
/begin CHARACTERISTIC DFES_MeterOut.DFC_MoCADCTst_C "project specific calibration data / Project specific calibration data for DFC_MoCADCTst" VALUE 0x804F5999 Val_Wu8 255.0 OneToOne 0.00 255.0 FORMAT "%5.1" /end CHARACTERISTIC
/begin CHARACTERISTIC DFES_MeterOut.DFC_MoCSOPICO_C "project specific calibration data / Project specific calibration data for DFC_MoCSOPICO" VALUE 0x804F599A Val_Wu8 255.0 OneToOne 0.00 255.0 FORMAT "%5.1" /end CHARACTERISTIC
/begin CHARACTERISTIC DFES_MeterOut.DFC_MoFAPP_C "project specific calibration data / Project specific calibration data for DFC_MoFAPP" VALUE 0x804F599B Val_Wu8 255.0 OneToOne 0.00 255.0 FORMAT "%5.1" /end CHARACTERISTIC
/begin CHARACTERISTIC DFES_MeterOut.DFC_MoFAirFilgPrdc_C "project specific calibration data / Project specific calibration data for DFC_MoFAirFilgPrdc" VALUE 0x804F599C Val_Wu8 255.0 OneToOne 0.00 255.0 FORMAT "%5.1" /end CHARACTERISTIC
/begin CHARACTERISTIC DFES_MeterOut.DFC_MoFAirFlCtOffGdi_C "project specific calibration data / Project specific calibration data for DFC_MoFAirFlCtOffGdi" VALUE 0x804F599D Val_Wu8 255.0 OneToOne 0.00 255.0 FORMAT "%5.1" /end CHARACTERISTIC
/begin CHARACTERISTIC DFES_MeterOut.DFC_MoFAirFlCylGdi_C "project specific calibration data / Project specific calibration data for DFC_MoFAirFlCylGdi" VALUE 0x804F599E Val_Wu8 255.0 OneToOne 0.00 255.0 FORMAT "%5.1" /end CHARACTERISTIC
/begin CHARACTERISTIC DFES_MeterOut.DFC_MoFAirFlFF_C "project specific calibration data / Project specific calibration data for DFC_MoFAirFlFF" VALUE 0x804F599F Val_Wu8 255.0 OneToOne 0.00 255.0 FORMAT "%5.1" /end CHARACTERISTIC
/begin CHARACTERISTIC DFES_MeterOut.DFC_MoFAirFlIn_C "project specific calibration data / Project specific calibration data for DFC_MoFAirFlIn" VALUE 0x804F59A0 Val_Wu8 255.0 OneToOne 0.00 255.0 FORMAT "%5.1" /end CHARACTERISTIC
/begin CHARACTERISTIC DFES_MeterOut.DFC_MoFAirFlMixCtlGdiChkAirFl_C "project specific calibration data / Project specific calibration data for DFC_MoFAirFlMixCtlGdiChkAirFl" VALUE 0x804F59A1 Val_Wu8 255.0 OneToOne 0.00 255.0 FORMAT "%5.1" /end CHARACTERISTIC
/begin CHARACTERISTIC DFES_MeterOut.DFC_MoFAirFlMixCtlGdiChkCtrl_C "project specific calibration data / Project specific calibration data for DFC_MoFAirFlMixCtlGdiChkCtrl" VALUE 0x804F59A2 Val_Wu8 255.0 OneToOne 0.00 255.0 FORMAT "%5.1" /end CHARACTERISTIC
/begin CHARACTERISTIC DFES_MeterOut.DFC_MoFAirFlMode_C "project specific calibration data / Project specific calibration data for DFC_MoFAirFlMode" VALUE 0x804F59A3 Val_Wu8 255.0 OneToOne 0.00 255.0 FORMAT "%5.1" /end CHARACTERISTIC
/begin CHARACTERISTIC DFES_MeterOut.DFC_MoFESpd_C "project specific calibration data / Project specific calibration data for DFC_MoFESpd" VALUE 0x804F59A4 Val_Wu8 255.0 OneToOne 0.00 255.0 FORMAT "%5.1" /end CHARACTERISTIC
/begin CHARACTERISTIC DFES_MeterOut.DFC_MoFIACo_C "project specific calibration data / Project specific calibration data for DFC_MoFIACo" VALUE 0x804F59A5 Val_Wu8 255.0 OneToOne 0.00 255.0 FORMAT "%5.1" /end CHARACTERISTIC
/begin CHARACTERISTIC DFES_MeterOut.DFC_MoFICOL1_C "project specific calibration data / Project specific calibration data for DFC_MoFICOL1" VALUE 0x804F59A6 Val_Wu8 255.0 OneToOne 0.00 255.0 FORMAT "%5.1" /end CHARACTERISTIC
/begin CHARACTERISTIC DFES_MeterOut.DFC_MoFICOL2_C "project specific calibration data / Project specific calibration data for DFC_MoFICOL2" VALUE 0x804F59A7 Val_Wu8 255.0 OneToOne 0.00 255.0 FORMAT "%5.1" /end CHARACTERISTIC
/begin CHARACTERISTIC DFES_MeterOut.DFC_MoFStrt_C "project specific calibration data / Project specific calibration data for DFC_MoFStrt" VALUE 0x804F59A8 Val_Wu8 255.0 OneToOne 0.00 255.0 FORMAT "%5.1" /end CHARACTERISTIC
/begin CHARACTERISTIC DFES_MeterOut.DFC_MoFTrqCmp_C "project specific calibration data / Project specific calibration data for DFC_MoFTrqCmp" VALUE 0x804F59A9 Val_Wu8 255.0 OneToOne 0.00 255.0 FORMAT "%5.1" /end CHARACTERISTIC
/begin CHARACTERISTIC DFES_MeterOut.DFC_MoFTrqCmpMax_C "project specific calibration data / Project specific calibration data for DFC_MoFTrqCmpMax" VALUE 0x804F59AA Val_Wu8 255.0 OneToOne 0.00 255.0 FORMAT "%5.1" /end CHARACTERISTIC
/begin CHARACTERISTIC DFES_MeterOut.DFC_MoFTrqCmpMin_C "project specific calibration data / Project specific calibration data for DFC_MoFTrqCmpMin" VALUE 0x804F59AB Val_Wu8 255.0 OneToOne 0.00 255.0 FORMAT "%5.1" /end CHARACTERISTIC
/begin CHARACTERISTIC DFES_MeterOut.DFC_MoFVarPostBldSel_C "project specific calibration data / Project specific calibration data for DFC_MoFVarPostBldSel" VALUE 0x804F59AC Val_Wu8 255.0 OneToOne 0.00 255.0 FORMAT "%5.1" /end CHARACTERISTIC
/begin CHARACTERISTIC DFES_MeterOut.DFC_MoXEMMHwLTMCUFW_C "project specific calibration data / Project specific calibration data for DFC_MoXEMMHwLTMCUFW" VALUE 0x804F59AD Val_Wu8 255.0 OneToOne 0.00 255.0 FORMAT "%5.1" /end CHARACTERISTIC
/begin CHARACTERISTIC DFES_MeterOut.DFC_MoXEMMHwLTMonBIST_C "project specific calibration data / Project specific calibration data for DFC_MoXEMMHwLTMonBIST" VALUE 0x804F59AE Val_Wu8 255.0 OneToOne 0.00 255.0 FORMAT "%5.1" /end CHARACTERISTIC
/begin CHARACTERISTIC DFES_MeterOut.DFC_MoXEMMHwLTRegMonTest_C "project specific calibration data / Project specific calibration data for DFC_MoXEMMHwLTRegMonTest" VALUE 0x804F59AF Val_Wu8 255.0 OneToOne 0.00 255.0 FORMAT "%5.1" /end CHARACTERISTIC
/begin CHARACTERISTIC DFES_MeterOut.DFC_MoXEMMHwLTStbySMUAlvTest_C "project specific calibration data / Project specific calibration data for DFC_MoXEMMHwLTStbySMUAlvTest" VALUE 0x804F59B0 Val_Wu8 255.0 OneToOne 0.00 255.0 FORMAT "%5.1" /end CHARACTERISTIC
/begin CHARACTERISTIC DFES_MeterOut.DFC_MoXEMMHwLTTempSens_C "project specific calibration data / Project specific calibration data for DFC_MoXEMMHwLTTempSens" VALUE 0x804F59B1 Val_Wu8 255.0 OneToOne 0.00 255.0 FORMAT "%5.1" /end CHARACTERISTIC
/begin CHARACTERISTIC DFES_MeterOut.DFC_MoXEMMHwLTUCBCfg_C "project specific calibration data / Project specific calibration data for DFC_MoXEMMHwLTUCBCfg" VALUE 0x804F59B2 Val_Wu8 255.0 OneToOne 0.00 255.0 FORMAT "%5.1" /end CHARACTERISTIC
/begin CHARACTERISTIC DFES_MeterOut.DFC_NWSEmax_C "project specific calibration data / Project specific calibration data for DFC_NWSEmax" VALUE 0x804F59B3 Val_Wu8 255.0 OneToOne 0.00 255.0 FORMAT "%5.1" /end CHARACTERISTIC
/begin CHARACTERISTIC DFES_MeterOut.DFC_NWSmax_C "project specific calibration data / Project specific calibration data for DFC_NWSmax" VALUE 0x804F59B4 Val_Wu8 255.0 OneToOne 0.00 255.0 FORMAT "%5.1" /end CHARACTERISTIC
/begin CHARACTERISTIC DFES_MeterOut.DFC_OCWDAABEActv_C "project specific calibration data / Project specific calibration data for DFC_OCWDAABEActv" VALUE 0x804F59B5 Val_Wu8 255.0 OneToOne 0.00 255.0 FORMAT "%5.1" /end CHARACTERISTIC
/begin CHARACTERISTIC DFES_MeterOut.DFC_OCWDACom_C "project specific calibration data / Project specific calibration data for DFC_OCWDACom" VALUE 0x804F59B6 Val_Wu8 255.0 OneToOne 0.00 255.0 FORMAT "%5.1" /end CHARACTERISTIC
/begin CHARACTERISTIC DFES_MeterOut.DFC_OCWDAErrPin_C "project specific calibration data / Project specific calibration data for DFC_OCWDAErrPin" VALUE 0x804F59B7 Val_Wu8 255.0 OneToOne 0.00 255.0 FORMAT "%5.1" /end CHARACTERISTIC
/begin CHARACTERISTIC DFES_MeterOut.DFC_OCWDAOvrVltg_C "project specific calibration data / Project specific calibration data for DFC_OCWDAOvrVltg" VALUE 0x804F59B8 Val_Wu8 255.0 OneToOne 0.00 255.0 FORMAT "%5.1" /end CHARACTERISTIC
/begin CHARACTERISTIC DFES_MeterOut.DFC_ORAmax_C "project specific calibration data / Project specific calibration data for DFC_ORAmax" VALUE 0x804F59B9 Val_Wu8 255.0 OneToOne 0.00 255.0 FORMAT "%5.1" /end CHARACTERISTIC
/begin CHARACTERISTIC DFES_MeterOut.DFC_ORAmin_C "project specific calibration data / Project specific calibration data for DFC_ORAmin" VALUE 0x804F59BA Val_Wu8 255.0 OneToOne 0.00 255.0 FORMAT "%5.1" /end CHARACTERISTIC
/begin CHARACTERISTIC DFES_MeterOut.DFC_OilPPlaus_C "project specific calibration data / Project specific calibration data for DFC_OilPPlaus" VALUE 0x804F59BB Val_Wu8 255.0 OneToOne 0.00 255.0 FORMAT "%5.1" /end CHARACTERISTIC
/begin CHARACTERISTIC DFES_MeterOut.DFC_PLLSUmax_C "project specific calibration data / Project specific calibration data for DFC_PLLSUmax" VALUE 0x804F59BC Val_Wu8 255.0 OneToOne 0.00 255.0 FORMAT "%5.1" /end CHARACTERISTIC
/begin CHARACTERISTIC DFES_MeterOut.DFC_PLLSUmin_C "project specific calibration data / Project specific calibration data for DFC_PLLSUmin" VALUE 0x804F59BD Val_Wu8 255.0 OneToOne 0.00 255.0 FORMAT "%5.1" /end CHARACTERISTIC
/begin CHARACTERISTIC DFES_MeterOut.DFC_PSR1max_C "project specific calibration data / Project specific calibration data for DFC_PSR1max" VALUE 0x804F59BE Val_Wu8 255.0 OneToOne 0.00 255.0 FORMAT "%5.1" /end CHARACTERISTIC
/begin CHARACTERISTIC DFES_MeterOut.DFC_PSRBmax_C "project specific calibration data / Project specific calibration data for DFC_PSRBmax" VALUE 0x804F59BF Val_Wu8 255.0 OneToOne 0.00 255.0 FORMAT "%5.1" /end CHARACTERISTIC
/begin CHARACTERISTIC DFES_MeterOut.DFC_PSRBmin_C "project specific calibration data / Project specific calibration data for DFC_PSRBmin" VALUE 0x804F59C0 Val_Wu8 255.0 OneToOne 0.00 255.0 FORMAT "%5.1" /end CHARACTERISTIC
/begin CHARACTERISTIC DFES_MeterOut.DFC_PSRPmax_C "project specific calibration data / Project specific calibration data for DFC_PSRPmax" VALUE 0x804F59C1 Val_Wu8 255.0 OneToOne 0.00 255.0 FORMAT "%5.1" /end CHARACTERISTIC
/begin CHARACTERISTIC DFES_MeterOut.DFC_PSRPmin_C "project specific calibration data / Project specific calibration data for DFC_PSRPmin" VALUE 0x804F59C2 Val_Wu8 255.0 OneToOne 0.00 255.0 FORMAT "%5.1" /end CHARACTERISTIC
/begin CHARACTERISTIC DFES_MeterOut.DFC_PSRPsig_C "project specific calibration data / Project specific calibration data for DFC_PSRPsig" VALUE 0x804F59C3 Val_Wu8 255.0 OneToOne 0.00 255.0 FORMAT "%5.1" /end CHARACTERISTIC
/begin CHARACTERISTIC DFES_MeterOut.DFC_PSRmax_C "project specific calibration data / Project specific calibration data for DFC_PSRmax" VALUE 0x804F59C4 Val_Wu8 255.0 OneToOne 0.00 255.0 FORMAT "%5.1" /end CHARACTERISTIC
/begin CHARACTERISTIC DFES_MeterOut.DFC_PUmax_C "project specific calibration data / Project specific calibration data for DFC_PUmax" VALUE 0x804F59C5 Val_Wu8 255.0 OneToOne 0.00 255.0 FORMAT "%5.1" /end CHARACTERISTIC
/begin CHARACTERISTIC DFES_MeterOut.DFC_P_VSE11_OL_C "project specific calibration data / Project specific calibration data for DFC_P_VSE11_OL" VALUE 0x804F59C6 Val_Wu8 255.0 OneToOne 0.00 255.0 FORMAT "%5.1" /end CHARACTERISTIC
/begin CHARACTERISTIC DFES_MeterOut.DFC_P_VSE11_SCB_C "project specific calibration data / Project specific calibration data for DFC_P_VSE11_SCB" VALUE 0x804F59C7 Val_Wu8 255.0 OneToOne 0.00 255.0 FORMAT "%5.1" /end CHARACTERISTIC
/begin CHARACTERISTIC DFES_MeterOut.DFC_P_VSE11_SCG_C "project specific calibration data / Project specific calibration data for DFC_P_VSE11_SCG" VALUE 0x804F59C8 Val_Wu8 255.0 OneToOne 0.00 255.0 FORMAT "%5.1" /end CHARACTERISTIC
/begin CHARACTERISTIC DFES_MeterOut.DFC_PhyHighAPP1_C "project specific calibration data / Project specific calibration data for DFC_PhyHighAPP1" VALUE 0x804F59C9 Val_Wu8 255.0 OneToOne 0.00 255.0 FORMAT "%5.1" /end CHARACTERISTIC
/begin CHARACTERISTIC DFES_MeterOut.DFC_PhyHighAPP2_C "project specific calibration data / Project specific calibration data for DFC_PhyHighAPP2" VALUE 0x804F59CA Val_Wu8 255.0 OneToOne 0.00 255.0 FORMAT "%5.1" /end CHARACTERISTIC
/begin CHARACTERISTIC DFES_MeterOut.DFC_PhyLowAPP1_C "project specific calibration data / Project specific calibration data for DFC_PhyLowAPP1" VALUE 0x804F59CB Val_Wu8 255.0 OneToOne 0.00 255.0 FORMAT "%5.1" /end CHARACTERISTIC
/begin CHARACTERISTIC DFES_MeterOut.DFC_PhyLowAPP2_C "project specific calibration data / Project specific calibration data for DFC_PhyLowAPP2" VALUE 0x804F59CC Val_Wu8 255.0 OneToOne 0.00 255.0 FORMAT "%5.1" /end CHARACTERISTIC
/begin CHARACTERISTIC DFES_MeterOut.DFC_SRCHighAPP1_C "project specific calibration data / Project specific calibration data for DFC_SRCHighAPP1" VALUE 0x804F59CD Val_Wu8 255.0 OneToOne 0.00 255.0 FORMAT "%5.1" /end CHARACTERISTIC
/begin CHARACTERISTIC DFES_MeterOut.DFC_SRCHighAPP2_C "project specific calibration data / Project specific calibration data for DFC_SRCHighAPP2" VALUE 0x804F59CE Val_Wu8 255.0 OneToOne 0.00 255.0 FORMAT "%5.1" /end CHARACTERISTIC
/begin CHARACTERISTIC DFES_MeterOut.DFC_SRCLowAPP1_C "project specific calibration data / Project specific calibration data for DFC_SRCLowAPP1" VALUE 0x804F59CF Val_Wu8 255.0 OneToOne 0.00 255.0 FORMAT "%5.1" /end CHARACTERISTIC
/begin CHARACTERISTIC DFES_MeterOut.DFC_SRCLowAPP2_C "project specific calibration data / Project specific calibration data for DFC_SRCLowAPP2" VALUE 0x804F59D0 Val_Wu8 255.0 OneToOne 0.00 255.0 FORMAT "%5.1" /end CHARACTERISTIC
/begin CHARACTERISTIC DFES_MeterOut.DFC_SSpMon2_C "project specific calibration data / Project specific calibration data for DFC_SSpMon2" VALUE 0x804F59D1 Val_Wu8 255.0 OneToOne 0.00 255.0 FORMAT "%5.1" /end CHARACTERISTIC
/begin CHARACTERISTIC DFES_MeterOut.DFC_STHDRmax_C "project specific calibration data / Project specific calibration data for DFC_STHDRmax" VALUE 0x804F59D2 Val_Wu8 255.0 OneToOne 0.00 255.0 FORMAT "%5.1" /end CHARACTERISTIC
/begin CHARACTERISTIC DFES_MeterOut.DFC_SWReset_0_C "project specific calibration data / Project specific calibration data for DFC_SWReset_0" VALUE 0x804F59D3 Val_Wu8 255.0 OneToOne 0.00 255.0 FORMAT "%5.1" /end CHARACTERISTIC
/begin CHARACTERISTIC DFES_MeterOut.DFC_SWReset_1_C "project specific calibration data / Project specific calibration data for DFC_SWReset_1" VALUE 0x804F59D4 Val_Wu8 255.0 OneToOne 0.00 255.0 FORMAT "%5.1" /end CHARACTERISTIC
/begin CHARACTERISTIC DFES_MeterOut.DFC_SWReset_2_C "project specific calibration data / Project specific calibration data for DFC_SWReset_2" VALUE 0x804F59D5 Val_Wu8 255.0 OneToOne 0.00 255.0 FORMAT "%5.1" /end CHARACTERISTIC
/begin CHARACTERISTIC DFES_MeterOut.DFC_SyncAPP_C "project specific calibration data / Project specific calibration data for DFC_SyncAPP" VALUE 0x804F59D6 Val_Wu8 255.0 OneToOne 0.00 255.0 FORMAT "%5.1" /end CHARACTERISTIC
/begin CHARACTERISTIC DFES_MeterOut.DFC_TANKLnpl_C "project specific calibration data / Project specific calibration data for DFC_TANKLnpl" VALUE 0x804F59D7 Val_Wu8 255.0 OneToOne 0.00 255.0 FORMAT "%5.1" /end CHARACTERISTIC
/begin CHARACTERISTIC DFES_MeterOut.DFC_TAmax_Dummy_C "project specific calibration data / Project specific calibration data for DFC_TAmax_Dummy" VALUE 0x804F59D8 Val_Wu8 255.0 OneToOne 0.00 255.0 FORMAT "%5.1" /end CHARACTERISTIC
/begin CHARACTERISTIC DFES_MeterOut.DFC_TESFmax_C "project specific calibration data / Project specific calibration data for DFC_TESFmax" VALUE 0x804F59D9 Val_Wu8 255.0 OneToOne 0.00 255.0 FORMAT "%5.1" /end CHARACTERISTIC
/begin CHARACTERISTIC DFES_MeterOut.DFC_TESGmax_C "project specific calibration data / Project specific calibration data for DFC_TESGmax" VALUE 0x804F59DA Val_Wu8 255.0 OneToOne 0.00 255.0 FORMAT "%5.1" /end CHARACTERISTIC
/begin CHARACTERISTIC DFES_MeterOut.DFC_TKAEmax_C "project specific calibration data / Project specific calibration data for DFC_TKAEmax" VALUE 0x804F59DB Val_Wu8 255.0 OneToOne 0.00 255.0 FORMAT "%5.1" /end CHARACTERISTIC
/begin CHARACTERISTIC DFES_MeterOut.DFC_TKAEmin_C "project specific calibration data / Project specific calibration data for DFC_TKAEmin" VALUE 0x804F59DC Val_Wu8 255.0 OneToOne 0.00 255.0 FORMAT "%5.1" /end CHARACTERISTIC
/begin CHARACTERISTIC DFES_MeterOut.DFC_TKARmax_C "project specific calibration data / Project specific calibration data for DFC_TKARmax" VALUE 0x804F59DD Val_Wu8 255.0 OneToOne 0.00 255.0 FORMAT "%5.1" /end CHARACTERISTIC
/begin CHARACTERISTIC DFES_MeterOut.DFC_TKARnpl_C "project specific calibration data / Project specific calibration data for DFC_TKARnpl" VALUE 0x804F59DE Val_Wu8 255.0 OneToOne 0.00 255.0 FORMAT "%5.1" /end CHARACTERISTIC
/begin CHARACTERISTIC DFES_MeterOut.DFC_TMmax_Dummy_C "project specific calibration data / Project specific calibration data for DFC_TMmax_Dummy" VALUE 0x804F59DF Val_Wu8 255.0 OneToOne 0.00 255.0 FORMAT "%5.1" /end CHARACTERISTIC
/begin CHARACTERISTIC DFES_MeterOut.DFC_TUMmax_Dummy_C "project specific calibration data / Project specific calibration data for DFC_TUMmax_Dummy" VALUE 0x804F59E0 Val_Wu8 255.0 OneToOne 0.00 255.0 FORMAT "%5.1" /end CHARACTERISTIC
/begin CHARACTERISTIC DFES_MeterOut.DFC_TWCDPriCatB1_C "project specific calibration data / Project specific calibration data for DFC_TWCDPriCatB1" VALUE 0x804F59E1 Val_Wu8 255.0 OneToOne 0.00 255.0 FORMAT "%5.1" /end CHARACTERISTIC
/begin CHARACTERISTIC DFES_MeterOut.DFC_ThrVlvClsdPosnFirstOffsLrnImpoB1_C "project specific calibration data / Project specific calibration data for DFC_ThrVlvClsdPosnFirstOffsLrnImpoB1" VALUE 0x804F59E2 Val_Wu8 255.0 OneToOne 0.00 255.0 FORMAT "%5.1" /end CHARACTERISTIC
/begin CHARACTERISTIC DFES_MeterOut.DFC_ThrVlvClsdPosnOffsLrnImpoB1_C "project specific calibration data / Project specific calibration data for DFC_ThrVlvClsdPosnOffsLrnImpoB1" VALUE 0x804F59E3 Val_Wu8 255.0 OneToOne 0.00 255.0 FORMAT "%5.1" /end CHARACTERISTIC
/begin CHARACTERISTIC DFES_MeterOut.DFC_ThrVlvClsdPosnOffsLrnMaxB1_C "project specific calibration data / Project specific calibration data for DFC_ThrVlvClsdPosnOffsLrnMaxB1" VALUE 0x804F59E4 Val_Wu8 255.0 OneToOne 0.00 255.0 FORMAT "%5.1" /end CHARACTERISTIC
/begin CHARACTERISTIC DFES_MeterOut.DFC_ThrVlvClsdPosnOffsLrnMinB1_C "project specific calibration data / Project specific calibration data for DFC_ThrVlvClsdPosnOffsLrnMinB1" VALUE 0x804F59E5 Val_Wu8 255.0 OneToOne 0.00 255.0 FORMAT "%5.1" /end CHARACTERISTIC
/begin CHARACTERISTIC DFES_MeterOut.DFC_ThrVlvCtrlDeB1_C "project specific calibration data / Project specific calibration data for DFC_ThrVlvCtrlDeB1" VALUE 0x804F59E6 Val_Wu8 255.0 OneToOne 0.00 255.0 FORMAT "%5.1" /end CHARACTERISTIC
/begin CHARACTERISTIC DFES_MeterOut.DFC_ThrVlvDycB1_C "project specific calibration data / Project specific calibration data for DFC_ThrVlvDycB1" VALUE 0x804F59E7 Val_Wu8 255.0 OneToOne 0.00 255.0 FORMAT "%5.1" /end CHARACTERISTIC
/begin CHARACTERISTIC DFES_MeterOut.DFC_ThrVlvLimpAirPosnMaxAbsltDriftB1_C "project specific calibration data / Project specific calibration data for DFC_ThrVlvLimpAirPosnMaxAbsltDriftB1" VALUE 0x804F59E8 Val_Wu8 255.0 OneToOne 0.00 255.0 FORMAT "%5.1" /end CHARACTERISTIC
/begin CHARACTERISTIC DFES_MeterOut.DFC_ThrVlvLimpAirPosnMaxB1_C "project specific calibration data / Project specific calibration data for DFC_ThrVlvLimpAirPosnMaxB1" VALUE 0x804F59E9 Val_Wu8 255.0 OneToOne 0.00 255.0 FORMAT "%5.1" /end CHARACTERISTIC
/begin CHARACTERISTIC DFES_MeterOut.DFC_ThrVlvLimpAirPosnMaxRelDriftB1_C "project specific calibration data / Project specific calibration data for DFC_ThrVlvLimpAirPosnMaxRelDriftB1" VALUE 0x804F59EA Val_Wu8 255.0 OneToOne 0.00 255.0 FORMAT "%5.1" /end CHARACTERISTIC
/begin CHARACTERISTIC DFES_MeterOut.DFC_ThrVlvLimpAirPosnMinB1_C "project specific calibration data / Project specific calibration data for DFC_ThrVlvLimpAirPosnMinB1" VALUE 0x804F59EB Val_Wu8 255.0 OneToOne 0.00 255.0 FORMAT "%5.1" /end CHARACTERISTIC
/begin CHARACTERISTIC DFES_MeterOut.DFC_ThrVlvOpenLoadB1_C "project specific calibration data / Project specific calibration data for DFC_ThrVlvOpenLoadB1" VALUE 0x804F59EC Val_Wu8 255.0 OneToOne 0.00 255.0 FORMAT "%5.1" /end CHARACTERISTIC
/begin CHARACTERISTIC DFES_MeterOut.DFC_ThrVlvOpenSprgB1_C "project specific calibration data / Project specific calibration data for DFC_ThrVlvOpenSprgB1" VALUE 0x804F59ED Val_Wu8 255.0 OneToOne 0.00 255.0 FORMAT "%5.1" /end CHARACTERISTIC
/begin CHARACTERISTIC DFES_MeterOut.DFC_ThrVlvOpenSprgSprdB1_C "project specific calibration data / Project specific calibration data for DFC_ThrVlvOpenSprgSprdB1" VALUE 0x804F59EE Val_Wu8 255.0 OneToOne 0.00 255.0 FORMAT "%5.1" /end CHARACTERISTIC
/begin CHARACTERISTIC DFES_MeterOut.DFC_ThrVlvOpenSprgTwnB1_C "project specific calibration data / Project specific calibration data for DFC_ThrVlvOpenSprgTwnB1" VALUE 0x804F59EF Val_Wu8 255.0 OneToOne 0.00 255.0 FORMAT "%5.1" /end CHARACTERISTIC
/begin CHARACTERISTIC DFES_MeterOut.DFC_ThrVlvOverTB1_C "project specific calibration data / Project specific calibration data for DFC_ThrVlvOverTB1" VALUE 0x804F59F0 Val_Wu8 255.0 OneToOne 0.00 255.0 FORMAT "%5.1" /end CHARACTERISTIC
/begin CHARACTERISTIC DFES_MeterOut.DFC_ThrVlvRetSprgB1_C "project specific calibration data / Project specific calibration data for DFC_ThrVlvRetSprgB1" VALUE 0x804F59F1 Val_Wu8 255.0 OneToOne 0.00 255.0 FORMAT "%5.1" /end CHARACTERISTIC
/begin CHARACTERISTIC DFES_MeterOut.DFC_ThrVlvRetSprgSprdB1_C "project specific calibration data / Project specific calibration data for DFC_ThrVlvRetSprgSprdB1" VALUE 0x804F59F2 Val_Wu8 255.0 OneToOne 0.00 255.0 FORMAT "%5.1" /end CHARACTERISTIC
/begin CHARACTERISTIC DFES_MeterOut.DFC_ThrVlvRetSprgTwnB1_C "project specific calibration data / Project specific calibration data for DFC_ThrVlvRetSprgTwnB1" VALUE 0x804F59F3 Val_Wu8 255.0 OneToOne 0.00 255.0 FORMAT "%5.1" /end CHARACTERISTIC
/begin CHARACTERISTIC DFES_MeterOut.DFC_ThrVlvSens1MaxB1_C "project specific calibration data / Project specific calibration data for DFC_ThrVlvSens1MaxB1" VALUE 0x804F59F4 Val_Wu8 255.0 OneToOne 0.00 255.0 FORMAT "%5.1" /end CHARACTERISTIC
/begin CHARACTERISTIC DFES_MeterOut.DFC_ThrVlvSens1NplB1_C "project specific calibration data / Project specific calibration data for DFC_ThrVlvSens1NplB1" VALUE 0x804F59F5 Val_Wu8 255.0 OneToOne 0.00 255.0 FORMAT "%5.1" /end CHARACTERISTIC
/begin CHARACTERISTIC DFES_MeterOut.DFC_ThrVlvSens2MaxB1_C "project specific calibration data / Project specific calibration data for DFC_ThrVlvSens2MaxB1" VALUE 0x804F59F6 Val_Wu8 255.0 OneToOne 0.00 255.0 FORMAT "%5.1" /end CHARACTERISTIC
/begin CHARACTERISTIC DFES_MeterOut.DFC_ThrVlvSens2MinB1_C "project specific calibration data / Project specific calibration data for DFC_ThrVlvSens2MinB1" VALUE 0x804F59F7 Val_Wu8 255.0 OneToOne 0.00 255.0 FORMAT "%5.1" /end CHARACTERISTIC
/begin CHARACTERISTIC DFES_MeterOut.DFC_ThrVlvSens2NplB1_C "project specific calibration data / Project specific calibration data for DFC_ThrVlvSens2NplB1" VALUE 0x804F59F8 Val_Wu8 255.0 OneToOne 0.00 255.0 FORMAT "%5.1" /end CHARACTERISTIC
/begin CHARACTERISTIC DFES_MeterOut.DFC_ThrVlvShoCircB1_C "project specific calibration data / Project specific calibration data for DFC_ThrVlvShoCircB1" VALUE 0x804F59F9 Val_Wu8 255.0 OneToOne 0.00 255.0 FORMAT "%5.1" /end CHARACTERISTIC
/begin CHARACTERISTIC DFES_MeterOut.DFC_ThrVlvSpiErrB1_C "project specific calibration data / Project specific calibration data for DFC_ThrVlvSpiErrB1" VALUE 0x804F59FA Val_Wu8 255.0 OneToOne 0.00 255.0 FORMAT "%5.1" /end CHARACTERISTIC
/begin CHARACTERISTIC DFES_MeterOut.DFC_ThrvlvSens1MinB1_C "project specific calibration data / Project specific calibration data for DFC_ThrvlvSens1MinB1" VALUE 0x804F59FB Val_Wu8 255.0 OneToOne 0.00 255.0 FORMAT "%5.1" /end CHARACTERISTIC
/begin CHARACTERISTIC DFES_MeterOut.DFC_TiOffTBasdChkFast_C "project specific calibration data / Project specific calibration data for DFC_TiOffTBasdChkFast" VALUE 0x804F59FC Val_Wu8 255.0 OneToOne 0.00 255.0 FORMAT "%5.1" /end CHARACTERISTIC
/begin CHARACTERISTIC DFES_MeterOut.DFC_TiOffTBasdChkSlow_C "project specific calibration data / Project specific calibration data for DFC_TiOffTBasdChkSlow" VALUE 0x804F59FD Val_Wu8 255.0 OneToOne 0.00 255.0 FORMAT "%5.1" /end CHARACTERISTIC
/begin CHARACTERISTIC DFES_MeterOut.DFC_UEGOSnsrMntdS1B1_C "project specific calibration data / Project specific calibration data for DFC_UEGOSnsrMntdS1B1" VALUE 0x804F59FE Val_Wu8 255.0 OneToOne 0.00 255.0 FORMAT "%5.1" /end CHARACTERISTIC
/begin CHARACTERISTIC DFES_MeterOut.DFC_VehVSig_C "project specific calibration data / Project specific calibration data for DFC_VehVSig" VALUE 0x804F59FF Val_Wu8 255.0 OneToOne 0.00 255.0 FORMAT "%5.1" /end CHARACTERISTIC
/begin CHARACTERISTIC DFES_MeterOut.DFC_VlvLftFbSwtIntk11SpclFail_C "project specific calibration data / Project specific calibration data for DFC_VlvLftFbSwtIntk11SpclFail" VALUE 0x804F5A00 Val_Wu8 255.0 OneToOne 0.00 255.0 FORMAT "%5.1" /end CHARACTERISTIC
/begin CHARACTERISTIC DFES_MeterOut.DFC_VlvLftFbSwtIntk11StdFail_C "project specific calibration data / Project specific calibration data for DFC_VlvLftFbSwtIntk11StdFail" VALUE 0x804F5A01 Val_Wu8 255.0 OneToOne 0.00 255.0 FORMAT "%5.1" /end CHARACTERISTIC
/begin CHARACTERISTIC DSM_uDisblBattHiHysL_C "Left value of hysteresis threshold for resetting the voltage disable condition (high voltage)." VALUE 0x8058B4CC Val_Ws16 1310700. Volt_Batt -655360.0 655340.0 FORMAT "%8.1" /end CHARACTERISTIC
/begin CHARACTERISTIC DSM_uDisblBattHiHysR_C "Right value of hysteresis threshold for resetting the voltage disable condition (high voltage)." VALUE 0x8058B4CE Val_Ws16 1310700. Volt_Batt -655360.0 655340.0 FORMAT "%8.1" /end CHARACTERISTIC
/begin CHARACTERISTIC DSM_uDisblBattLoHysL_C "Left value of hysteresis threshold for resetting the voltage disable condition (low voltage)." VALUE 0x8058B4D0 Val_Ws16 1310700. Volt_Batt -655360.0 655340.0 FORMAT "%8.1" /end CHARACTERISTIC
/begin CHARACTERISTIC DSM_uDisblBattLoHysR_C "Right value of hysteresis threshold for resetting the voltage disable condition (low voltage)." VALUE 0x8058B4D2 Val_Ws16 1310700. Volt_Batt -655360.0 655340.0 FORMAT "%8.1" /end CHARACTERISTIC
/begin CHARACTERISTIC DTR_OBDMID.DTR_OBDMID_01_TID_DTLTR_C "" VALUE 0x804F5A02 Val_Wu8 255.0 DFC_OneToOne 0.00 255.0 FORMAT "%5.1" /end CHARACTERISTIC
/begin CHARACTERISTIC DTR_OBDMID.DTR_OBDMID_01_TID_DTRTL_C "" VALUE 0x804F5A03 Val_Wu8 255.0 DFC_OneToOne 0.00 255.0 FORMAT "%5.1" /end CHARACTERISTIC
/begin CHARACTERISTIC DTR_OBDMID.DTR_OBDMID_01_TID_OFFSN_C "" VALUE 0x804F5A04 Val_Wu8 255.0 DFC_OneToOne 0.00 255.0 FORMAT "%5.1" /end CHARACTERISTIC
/begin CHARACTERISTIC DTR_OBDMID.DTR_OBDMID_01_TID_OFFSP_C "" VALUE 0x804F5A05 Val_Wu8 255.0 DFC_OneToOne 0.00 255.0 FORMAT "%5.1" /end CHARACTERISTIC
/begin CHARACTERISTIC DTR_OBDMID.DTR_OBDMID_01_TID_SnsrMntdDiag_C "" VALUE 0x804F5A06 Val_Wu8 255.0 DFC_OneToOne 0.00 255.0 FORMAT "%5.1" /end CHARACTERISTIC
/begin CHARACTERISTIC DTR_OBDMID.DTR_OBDMID_01_TID_TCLTR_C "" VALUE 0x804F5A07 Val_Wu8 255.0 DFC_OneToOne 0.00 255.0 FORMAT "%5.1" /end CHARACTERISTIC
/begin CHARACTERISTIC DTR_OBDMID.DTR_OBDMID_01_TID_TCRTL_C "" VALUE 0x804F5A08 Val_Wu8 255.0 DFC_OneToOne 0.00 255.0 FORMAT "%5.1" /end CHARACTERISTIC
/begin CHARACTERISTIC DTR_OBDMID.DTR_OBDMID_02_TID_05_C "" VALUE 0x804F5A09 Val_Wu8 255.0 DFC_OneToOne 0.00 255.0 FORMAT "%5.1" /end CHARACTERISTIC
/begin CHARACTERISTIC DTR_OBDMID.DTR_OBDMID_02_TID_06_C "" VALUE 0x804F5A0A Val_Wu8 255.0 DFC_OneToOne 0.00 255.0 FORMAT "%5.1" /end CHARACTERISTIC
/begin CHARACTERISTIC DTR_OBDMID.DTR_OBDMID_02_TID_LtrDly_C "" VALUE 0x804F5A0B Val_Wu8 255.0 DFC_OneToOne 0.00 255.0 FORMAT "%5.1" /end CHARACTERISTIC
/begin CHARACTERISTIC DTR_OBDMID.DTR_OBDMID_02_TID_RtlDly_C "" VALUE 0x804F5A0C Val_Wu8 255.0 DFC_OneToOne 0.00 255.0 FORMAT "%5.1" /end CHARACTERISTIC
/begin CHARACTERISTIC DTR_OBDMID.DTR_OBDMID_02_TID_TarLean_C "" VALUE 0x804F5A0D Val_Wu8 255.0 DFC_OneToOne 0.00 255.0 FORMAT "%5.1" /end CHARACTERISTIC
/begin CHARACTERISTIC DTR_OBDMID.DTR_OBDMID_02_TID_TarRich_C "" VALUE 0x804F5A0E Val_Wu8 255.0 DFC_OneToOne 0.00 255.0 FORMAT "%5.1" /end CHARACTERISTIC
/begin CHARACTERISTIC DTR_OBDMID.DTR_OBDMID_21_TID_OS_C "" VALUE 0x804F5A0F Val_Wu8 255.0 DFC_OneToOne 0.00 255.0 FORMAT "%5.1" /end CHARACTERISTIC
/begin CHARACTERISTIC DTR_OBDMID.DTR_OBDMID_31_TID_AGRSUS_C "" VALUE 0x804F5A10 Val_Wu8 255.0 DFC_OneToOne 0.00 255.0 FORMAT "%5.1" /end CHARACTERISTIC
/begin CHARACTERISTIC DTR_OBDMID.DTR_OBDMID_35_TID_ICSR_C "" VALUE 0x804F5A11 Val_Wu8 255.0 DFC_OneToOne 0.00 255.0 FORMAT "%5.1" /end CHARACTERISTIC
/begin CHARACTERISTIC DTR_OBDMID.DTR_OBDMID_35_TID_ICTE_C "" VALUE 0x804F5A12 Val_Wu8 255.0 DFC_OneToOne 0.00 255.0 FORMAT "%5.1" /end CHARACTERISTIC
/begin CHARACTERISTIC DTR_OBDMID.DTR_OBDMID_35_TID_IntkVTECFbSwt11SpclLft_C "" VALUE 0x804F5A13 Val_Wu8 255.0 DFC_OneToOne 0.00 255.0 FORMAT "%5.1" /end CHARACTERISTIC
/begin CHARACTERISTIC DTR_OBDMID.DTR_OBDMID_35_TID_IntkVTECFbSwt11StdLft_C "" VALUE 0x804F5A14 Val_Wu8 255.0 DFC_OneToOne 0.00 255.0 FORMAT "%5.1" /end CHARACTERISTIC
/begin CHARACTERISTIC DTR_OBDMID.DTR_OBDMID_35_TID_LPCI_C "" VALUE 0x804F5A15 Val_Wu8 255.0 DFC_OneToOne 0.00 255.0 FORMAT "%5.1" /end CHARACTERISTIC
/begin CHARACTERISTIC DTR_OBDMID.DTR_OBDMID_39_TID_TESG_C "" VALUE 0x804F5A16 Val_Wu8 255.0 DFC_OneToOne 0.00 255.0 FORMAT "%5.1" /end CHARACTERISTIC
/begin CHARACTERISTIC DTR_OBDMID.DTR_OBDMID_3D_TID_DiagCpv1DteskLoLoadStuckClsd_C "" VALUE 0x804F5A17 Val_Wu8 255.0 DFC_OneToOne 0.00 255.0 FORMAT "%5.1" /end CHARACTERISTIC
/begin CHARACTERISTIC DTR_OBDMID.DTR_OBDMID_3D_TID_DiagCpv1DteskLoLoadStuckOpen_C "" VALUE 0x804F5A18 Val_Wu8 255.0 DFC_OneToOne 0.00 255.0 FORMAT "%5.1" /end CHARACTERISTIC
/begin CHARACTERISTIC DTR_OBDMID.DTR_OBDMID_3b_TID_TESF_C "" VALUE 0x804F5A19 Val_Wu8 255.0 DFC_OneToOne 0.00 255.0 FORMAT "%5.1" /end CHARACTERISTIC
/begin CHARACTERISTIC DTR_OBDMID.DTR_OBDMID_3c_TID_EONV_C "" VALUE 0x804F5A1A Val_Wu8 255.0 DFC_OneToOne 0.00 255.0 FORMAT "%5.1" /end CHARACTERISTIC
/begin CHARACTERISTIC DTR_OBDMID.DTR_OBDMID_3c_TID_EONVNoF_C "" VALUE 0x804F5A1B Val_Wu8 255.0 DFC_OneToOne 0.00 255.0 FORMAT "%5.1" /end CHARACTERISTIC
/begin CHARACTERISTIC DTR_OBDMID.DTR_OBDMID_3d_TID_AAV_C "" VALUE 0x804F5A1C Val_Wu8 255.0 DFC_OneToOne 0.00 255.0 FORMAT "%5.1" /end CHARACTERISTIC
/begin CHARACTERISTIC DTR_OBDMID.DTR_OBDMID_3d_TID_BLKLI_C "" VALUE 0x804F5A1D Val_Wu8 255.0 DFC_OneToOne 0.00 255.0 FORMAT "%5.1" /end CHARACTERISTIC
/begin CHARACTERISTIC DTR_OBDMID.DTR_OBDMID_41_TID_TCER_C "" VALUE 0x804F5A1E Val_Wu8 255.0 DFC_OneToOne 0.00 255.0 FORMAT "%5.1" /end CHARACTERISTIC
/begin CHARACTERISTIC DTR_OBDMID.DTR_OBDMID_41_TID_TStrt_C "" VALUE 0x804F5A1F Val_Wu8 255.0 DFC_OneToOne 0.00 255.0 FORMAT "%5.1" /end CHARACTERISTIC
/begin CHARACTERISTIC DTR_OBDMID.DTR_OBDMID_42_TID_HTR_C "" VALUE 0x804F5A20 Val_Wu8 255.0 DFC_OneToOne 0.00 255.0 FORMAT "%5.1" /end CHARACTERISTIC
/begin CHARACTERISTIC DTR_OBDMID.DTR_OBDMID_a2_TID_0b_0_C "" VALUE 0x804F5A21 Val_Wu8 255.0 DFC_OneToOne 0.00 255.0 FORMAT "%5.1" /end CHARACTERISTIC
/begin CHARACTERISTIC DTR_OBDMID.DTR_OBDMID_a2_TID_0b_1_C "" VALUE 0x804F5A22 Val_Wu8 255.0 DFC_OneToOne 0.00 255.0 FORMAT "%5.1" /end CHARACTERISTIC
/begin CHARACTERISTIC DTR_OBDMID.DTR_OBDMID_a2_TID_0b_2_C "" VALUE 0x804F5A23 Val_Wu8 255.0 DFC_OneToOne 0.00 255.0 FORMAT "%5.1" /end CHARACTERISTIC
/begin CHARACTERISTIC DTR_OBDMID.DTR_OBDMID_a2_TID_0b_3_C "" VALUE 0x804F5A24 Val_Wu8 255.0 DFC_OneToOne 0.00 255.0 FORMAT "%5.1" /end CHARACTERISTIC
/begin CHARACTERISTIC DTR_OBDMID.DTR_OBDMID_a2_TID_0c_0_C "" VALUE 0x804F5A25 Val_Wu8 255.0 DFC_OneToOne 0.00 255.0 FORMAT "%5.1" /end CHARACTERISTIC
/begin CHARACTERISTIC DTR_OBDMID.DTR_OBDMID_a2_TID_0c_1_C "" VALUE 0x804F5A26 Val_Wu8 255.0 DFC_OneToOne 0.00 255.0 FORMAT "%5.1" /end CHARACTERISTIC
/begin CHARACTERISTIC DTR_OBDMID.DTR_OBDMID_a2_TID_0c_2_C "" VALUE 0x804F5A27 Val_Wu8 255.0 DFC_OneToOne 0.00 255.0 FORMAT "%5.1" /end CHARACTERISTIC
/begin CHARACTERISTIC DTR_OBDMID.DTR_OBDMID_a2_TID_0c_3_C "" VALUE 0x804F5A28 Val_Wu8 255.0 DFC_OneToOne 0.00 255.0 FORMAT "%5.1" /end CHARACTERISTIC
/begin CHARACTERISTIC DTR_Suprt.DTR_OBDMID_01_TID_DTLTR_C "" VALUE 0x804F5A2A Val_Wu8 1.00000000000 DTR_Suprt_Compu 0.00 1.00000000000 FORMAT "%13.11" /end CHARACTERISTIC
/begin CHARACTERISTIC DTR_Suprt.DTR_OBDMID_01_TID_DTRTL_C "" VALUE 0x804F5A2B Val_Wu8 1.00000000000 DTR_Suprt_Compu 0.00 1.00000000000 FORMAT "%13.11" /end CHARACTERISTIC
/begin CHARACTERISTIC DTR_Suprt.DTR_OBDMID_01_TID_OFFSN_C "" VALUE 0x804F5A2C Val_Wu8 1.00000000000 DTR_Suprt_Compu 0.00 1.00000000000 FORMAT "%13.11" /end CHARACTERISTIC
/begin CHARACTERISTIC DTR_Suprt.DTR_OBDMID_01_TID_OFFSP_C "" VALUE 0x804F5A2D Val_Wu8 1.00000000000 DTR_Suprt_Compu 0.00 1.00000000000 FORMAT "%13.11" /end CHARACTERISTIC
/begin CHARACTERISTIC DTR_Suprt.DTR_OBDMID_01_TID_SnsrMntdDiag_C "" VALUE 0x804F5A2E Val_Wu8 1.00000000000 DTR_Suprt_Compu 0.00 1.00000000000 FORMAT "%13.11" /end CHARACTERISTIC
/begin CHARACTERISTIC DTR_Suprt.DTR_OBDMID_01_TID_TCLTR_C "" VALUE 0x804F5A2F Val_Wu8 1.00000000000 DTR_Suprt_Compu 0.00 1.00000000000 FORMAT "%13.11" /end CHARACTERISTIC
/begin CHARACTERISTIC DTR_Suprt.DTR_OBDMID_01_TID_TCRTL_C "" VALUE 0x804F5A30 Val_Wu8 1.00000000000 DTR_Suprt_Compu 0.00 1.00000000000 FORMAT "%13.11" /end CHARACTERISTIC
/begin CHARACTERISTIC DTR_Suprt.DTR_OBDMID_02_TID_05_C "" VALUE 0x804F5A31 Val_Wu8 1.00000000000 DTR_Suprt_Compu 0.00 1.00000000000 FORMAT "%13.11" /end CHARACTERISTIC
/begin CHARACTERISTIC DTR_Suprt.DTR_OBDMID_02_TID_06_C "" VALUE 0x804F5A32 Val_Wu8 1.00000000000 DTR_Suprt_Compu 0.00 1.00000000000 FORMAT "%13.11" /end CHARACTERISTIC
/begin CHARACTERISTIC DTR_Suprt.DTR_OBDMID_02_TID_LtrDly_C "" VALUE 0x804F5A33 Val_Wu8 1.00000000000 DTR_Suprt_Compu 0.00 1.00000000000 FORMAT "%13.11" /end CHARACTERISTIC
/begin CHARACTERISTIC DTR_Suprt.DTR_OBDMID_02_TID_RtlDly_C "" VALUE 0x804F5A34 Val_Wu8 1.00000000000 DTR_Suprt_Compu 0.00 1.00000000000 FORMAT "%13.11" /end CHARACTERISTIC
/begin CHARACTERISTIC DTR_Suprt.DTR_OBDMID_02_TID_TarLean_C "" VALUE 0x804F5A35 Val_Wu8 1.00000000000 DTR_Suprt_Compu 0.00 1.00000000000 FORMAT "%13.11" /end CHARACTERISTIC
/begin CHARACTERISTIC DTR_Suprt.DTR_OBDMID_02_TID_TarRich_C "" VALUE 0x804F5A36 Val_Wu8 1.00000000000 DTR_Suprt_Compu 0.00 1.00000000000 FORMAT "%13.11" /end CHARACTERISTIC
/begin CHARACTERISTIC DTR_Suprt.DTR_OBDMID_21_TID_OS_C "" VALUE 0x804F5A37 Val_Wu8 1.00000000000 DTR_Suprt_Compu 0.00 1.00000000000 FORMAT "%13.11" /end CHARACTERISTIC
/begin CHARACTERISTIC DTR_Suprt.DTR_OBDMID_31_TID_AGRSUS_C "" VALUE 0x804F5A38 Val_Wu8 1.00000000000 DTR_Suprt_Compu 0.00 1.00000000000 FORMAT "%13.11" /end CHARACTERISTIC
/begin CHARACTERISTIC DTR_Suprt.DTR_OBDMID_35_TID_ICSR_C "" VALUE 0x804F5A39 Val_Wu8 1.00000000000 DTR_Suprt_Compu 0.00 1.00000000000 FORMAT "%13.11" /end CHARACTERISTIC
/begin CHARACTERISTIC DTR_Suprt.DTR_OBDMID_35_TID_ICTE_C "" VALUE 0x804F5A3A Val_Wu8 1.00000000000 DTR_Suprt_Compu 0.00 1.00000000000 FORMAT "%13.11" /end CHARACTERISTIC
/begin CHARACTERISTIC DTR_Suprt.DTR_OBDMID_35_TID_IntkVTECFbSwt11SpclLft_C "" VALUE 0x804F5A3B Val_Wu8 1.00000000000 DTR_Suprt_Compu 0.00 1.00000000000 FORMAT "%13.11" /end CHARACTERISTIC
/begin CHARACTERISTIC DTR_Suprt.DTR_OBDMID_35_TID_IntkVTECFbSwt11StdLft_C "" VALUE 0x804F5A3C Val_Wu8 1.00000000000 DTR_Suprt_Compu 0.00 1.00000000000 FORMAT "%13.11" /end CHARACTERISTIC
/begin CHARACTERISTIC DTR_Suprt.DTR_OBDMID_35_TID_LPCI_C "" VALUE 0x804F5A3D Val_Wu8 1.00000000000 DTR_Suprt_Compu 0.00 1.00000000000 FORMAT "%13.11" /end CHARACTERISTIC
/begin CHARACTERISTIC DTR_Suprt.DTR_OBDMID_39_TID_TESG_C "" VALUE 0x804F5A3E Val_Wu8 1.00000000000 DTR_Suprt_Compu 0.00 1.00000000000 FORMAT "%13.11" /end CHARACTERISTIC
/begin CHARACTERISTIC DTR_Suprt.DTR_OBDMID_3D_TID_DiagCpv1DteskLoLoadStuckClsd_C "" VALUE 0x804F5A3F Val_Wu8 1.00000000000 DTR_Suprt_Compu 0.00 1.00000000000 FORMAT "%13.11" /end CHARACTERISTIC
/begin CHARACTERISTIC DTR_Suprt.DTR_OBDMID_3D_TID_DiagCpv1DteskLoLoadStuckOpen_C "" VALUE 0x804F5A40 Val_Wu8 1.00000000000 DTR_Suprt_Compu 0.00 1.00000000000 FORMAT "%13.11" /end CHARACTERISTIC
/begin CHARACTERISTIC DTR_Suprt.DTR_OBDMID_3b_TID_TESF_C "" VALUE 0x804F5A41 Val_Wu8 1.00000000000 DTR_Suprt_Compu 0.00 1.00000000000 FORMAT "%13.11" /end CHARACTERISTIC
/begin CHARACTERISTIC DTR_Suprt.DTR_OBDMID_3c_TID_EONV_C "" VALUE 0x804F5A42 Val_Wu8 1.00000000000 DTR_Suprt_Compu 0.00 1.00000000000 FORMAT "%13.11" /end CHARACTERISTIC
/begin CHARACTERISTIC DTR_Suprt.DTR_OBDMID_3c_TID_EONVNoF_C "" VALUE 0x804F5A43 Val_Wu8 1.00000000000 DTR_Suprt_Compu 0.00 1.00000000000 FORMAT "%13.11" /end CHARACTERISTIC
/begin CHARACTERISTIC DTR_Suprt.DTR_OBDMID_3d_TID_AAV_C "" VALUE 0x804F5A44 Val_Wu8 1.00000000000 DTR_Suprt_Compu 0.00 1.00000000000 FORMAT "%13.11" /end CHARACTERISTIC
/begin CHARACTERISTIC DTR_Suprt.DTR_OBDMID_3d_TID_BLKLI_C "" VALUE 0x804F5A45 Val_Wu8 1.00000000000 DTR_Suprt_Compu 0.00 1.00000000000 FORMAT "%13.11" /end CHARACTERISTIC
/begin CHARACTERISTIC DTR_Suprt.DTR_OBDMID_41_TID_TCER_C "" VALUE 0x804F5A46 Val_Wu8 1.00000000000 DTR_Suprt_Compu 0.00 1.00000000000 FORMAT "%13.11" /end CHARACTERISTIC
/begin CHARACTERISTIC DTR_Suprt.DTR_OBDMID_41_TID_TStrt_C "" VALUE 0x804F5A47 Val_Wu8 1.00000000000 DTR_Suprt_Compu 0.00 1.00000000000 FORMAT "%13.11" /end CHARACTERISTIC
/begin CHARACTERISTIC DTR_Suprt.DTR_OBDMID_42_TID_HTR_C "" VALUE 0x804F5A48 Val_Wu8 1.00000000000 DTR_Suprt_Compu 0.00 1.00000000000 FORMAT "%13.11" /end CHARACTERISTIC
/begin CHARACTERISTIC DTR_Suprt.DTR_OBDMID_a2_TID_0b_0_C "" VALUE 0x804F5A49 Val_Wu8 1.00000000000 DTR_Suprt_Compu 0.00 1.00000000000 FORMAT "%13.11" /end CHARACTERISTIC
/begin CHARACTERISTIC DTR_Suprt.DTR_OBDMID_a2_TID_0b_1_C "" VALUE 0x804F5A4A Val_Wu8 1.00000000000 DTR_Suprt_Compu 0.00 1.00000000000 FORMAT "%13.11" /end CHARACTERISTIC
/begin CHARACTERISTIC DTR_Suprt.DTR_OBDMID_a2_TID_0b_2_C "" VALUE 0x804F5A4B Val_Wu8 1.00000000000 DTR_Suprt_Compu 0.00 1.00000000000 FORMAT "%13.11" /end CHARACTERISTIC
/begin CHARACTERISTIC DTR_Suprt.DTR_OBDMID_a2_TID_0b_3_C "" VALUE 0x804F5A4C Val_Wu8 1.00000000000 DTR_Suprt_Compu 0.00 1.00000000000 FORMAT "%13.11" /end CHARACTERISTIC
/begin CHARACTERISTIC DTR_Suprt.DTR_OBDMID_a2_TID_0c_0_C "" VALUE 0x804F5A4D Val_Wu8 1.00000000000 DTR_Suprt_Compu 0.00 1.00000000000 FORMAT "%13.11" /end CHARACTERISTIC
/begin CHARACTERISTIC DTR_Suprt.DTR_OBDMID_a2_TID_0c_1_C "" VALUE 0x804F5A4E Val_Wu8 1.00000000000 DTR_Suprt_Compu 0.00 1.00000000000 FORMAT "%13.11" /end CHARACTERISTIC
/begin CHARACTERISTIC DTR_Suprt.DTR_OBDMID_a2_TID_0c_2_C "" VALUE 0x804F5A4F Val_Wu8 1.00000000000 DTR_Suprt_Compu 0.00 1.00000000000 FORMAT "%13.11" /end CHARACTERISTIC
/begin CHARACTERISTIC DTR_Suprt.DTR_OBDMID_a2_TID_0c_3_C "" VALUE 0x804F5A50 Val_Wu8 1.00000000000 DTR_Suprt_Compu 0.00 1.00000000000 FORMAT "%13.11" /end CHARACTERISTIC
/begin CHARACTERISTIC DTR_TID.DTR_OBDMID_01_TID_DTLTR_C "" VALUE 0x804F5A52 Val_Wu8 255.0 DFC_OneToOne 0.00 255.0 FORMAT "%5.1" /end CHARACTERISTIC
/begin CHARACTERISTIC DTR_TID.DTR_OBDMID_01_TID_DTRTL_C "" VALUE 0x804F5A53 Val_Wu8 255.0 DFC_OneToOne 0.00 255.0 FORMAT "%5.1" /end CHARACTERISTIC
/begin CHARACTERISTIC DTR_TID.DTR_OBDMID_01_TID_OFFSN_C "" VALUE 0x804F5A54 Val_Wu8 255.0 DFC_OneToOne 0.00 255.0 FORMAT "%5.1" /end CHARACTERISTIC
/begin CHARACTERISTIC DTR_TID.DTR_OBDMID_01_TID_OFFSP_C "" VALUE 0x804F5A55 Val_Wu8 255.0 DFC_OneToOne 0.00 255.0 FORMAT "%5.1" /end CHARACTERISTIC
/begin CHARACTERISTIC DTR_TID.DTR_OBDMID_01_TID_SnsrMntdDiag_C "" VALUE 0x804F5A56 Val_Wu8 255.0 DFC_OneToOne 0.00 255.0 FORMAT "%5.1" /end CHARACTERISTIC
/begin CHARACTERISTIC DTR_TID.DTR_OBDMID_01_TID_TCLTR_C "" VALUE 0x804F5A57 Val_Wu8 255.0 DFC_OneToOne 0.00 255.0 FORMAT "%5.1" /end CHARACTERISTIC
/begin CHARACTERISTIC DTR_TID.DTR_OBDMID_01_TID_TCRTL_C "" VALUE 0x804F5A58 Val_Wu8 255.0 DFC_OneToOne 0.00 255.0 FORMAT "%5.1" /end CHARACTERISTIC
/begin CHARACTERISTIC DTR_TID.DTR_OBDMID_02_TID_05_C "" VALUE 0x804F5A59 Val_Wu8 255.0 DFC_OneToOne 0.00 255.0 FORMAT "%5.1" /end CHARACTERISTIC
/begin CHARACTERISTIC DTR_TID.DTR_OBDMID_02_TID_06_C "" VALUE 0x804F5A5A Val_Wu8 255.0 DFC_OneToOne 0.00 255.0 FORMAT "%5.1" /end CHARACTERISTIC
/begin CHARACTERISTIC DTR_TID.DTR_OBDMID_02_TID_LtrDly_C "" VALUE 0x804F5A5B Val_Wu8 255.0 DFC_OneToOne 0.00 255.0 FORMAT "%5.1" /end CHARACTERISTIC
/begin CHARACTERISTIC DTR_TID.DTR_OBDMID_02_TID_RtlDly_C "" VALUE 0x804F5A5C Val_Wu8 255.0 DFC_OneToOne 0.00 255.0 FORMAT "%5.1" /end CHARACTERISTIC
/begin CHARACTERISTIC DTR_TID.DTR_OBDMID_02_TID_TarLean_C "" VALUE 0x804F5A5D Val_Wu8 255.0 DFC_OneToOne 0.00 255.0 FORMAT "%5.1" /end CHARACTERISTIC
/begin CHARACTERISTIC DTR_TID.DTR_OBDMID_02_TID_TarRich_C "" VALUE 0x804F5A5E Val_Wu8 255.0 DFC_OneToOne 0.00 255.0 FORMAT "%5.1" /end CHARACTERISTIC
/begin CHARACTERISTIC DTR_TID.DTR_OBDMID_21_TID_OS_C "" VALUE 0x804F5A5F Val_Wu8 255.0 DFC_OneToOne 0.00 255.0 FORMAT "%5.1" /end CHARACTERISTIC
/begin CHARACTERISTIC DTR_TID.DTR_OBDMID_31_TID_AGRSUS_C "" VALUE 0x804F5A60 Val_Wu8 255.0 DFC_OneToOne 0.00 255.0 FORMAT "%5.1" /end CHARACTERISTIC
/begin CHARACTERISTIC DTR_TID.DTR_OBDMID_35_TID_ICSR_C "" VALUE 0x804F5A61 Val_Wu8 255.0 DFC_OneToOne 0.00 255.0 FORMAT "%5.1" /end CHARACTERISTIC
/begin CHARACTERISTIC DTR_TID.DTR_OBDMID_35_TID_ICTE_C "" VALUE 0x804F5A62 Val_Wu8 255.0 DFC_OneToOne 0.00 255.0 FORMAT "%5.1" /end CHARACTERISTIC
/begin CHARACTERISTIC DTR_TID.DTR_OBDMID_35_TID_IntkVTECFbSwt11SpclLft_C "" VALUE 0x804F5A63 Val_Wu8 255.0 DFC_OneToOne 0.00 255.0 FORMAT "%5.1" /end CHARACTERISTIC
/begin CHARACTERISTIC DTR_TID.DTR_OBDMID_35_TID_IntkVTECFbSwt11StdLft_C "" VALUE 0x804F5A64 Val_Wu8 255.0 DFC_OneToOne 0.00 255.0 FORMAT "%5.1" /end CHARACTERISTIC
/begin CHARACTERISTIC DTR_TID.DTR_OBDMID_35_TID_LPCI_C "" VALUE 0x804F5A65 Val_Wu8 255.0 DFC_OneToOne 0.00 255.0 FORMAT "%5.1" /end CHARACTERISTIC
/begin CHARACTERISTIC DTR_TID.DTR_OBDMID_39_TID_TESG_C "" VALUE 0x804F5A66 Val_Wu8 255.0 DFC_OneToOne 0.00 255.0 FORMAT "%5.1" /end CHARACTERISTIC
/begin CHARACTERISTIC DTR_TID.DTR_OBDMID_3D_TID_DiagCpv1DteskLoLoadStuckClsd_C "" VALUE 0x804F5A67 Val_Wu8 255.0 DFC_OneToOne 0.00 255.0 FORMAT "%5.1" /end CHARACTERISTIC
/begin CHARACTERISTIC DTR_TID.DTR_OBDMID_3D_TID_DiagCpv1DteskLoLoadStuckOpen_C "" VALUE 0x804F5A68 Val_Wu8 255.0 DFC_OneToOne 0.00 255.0 FORMAT "%5.1" /end CHARACTERISTIC
/begin CHARACTERISTIC DTR_TID.DTR_OBDMID_3b_TID_TESF_C "" VALUE 0x804F5A69 Val_Wu8 255.0 DFC_OneToOne 0.00 255.0 FORMAT "%5.1" /end CHARACTERISTIC
/begin CHARACTERISTIC DTR_TID.DTR_OBDMID_3c_TID_EONV_C "" VALUE 0x804F5A6A Val_Wu8 255.0 DFC_OneToOne 0.00 255.0 FORMAT "%5.1" /end CHARACTERISTIC
/begin CHARACTERISTIC DTR_TID.DTR_OBDMID_3c_TID_EONVNoF_C "" VALUE 0x804F5A6B Val_Wu8 255.0 DFC_OneToOne 0.00 255.0 FORMAT "%5.1" /end CHARACTERISTIC
/begin CHARACTERISTIC DTR_TID.DTR_OBDMID_3d_TID_AAV_C "" VALUE 0x804F5A6C Val_Wu8 255.0 DFC_OneToOne 0.00 255.0 FORMAT "%5.1" /end CHARACTERISTIC
/begin CHARACTERISTIC DTR_TID.DTR_OBDMID_3d_TID_BLKLI_C "" VALUE 0x804F5A6D Val_Wu8 255.0 DFC_OneToOne 0.00 255.0 FORMAT "%5.1" /end CHARACTERISTIC
/begin CHARACTERISTIC DTR_TID.DTR_OBDMID_41_TID_TCER_C "" VALUE 0x804F5A6E Val_Wu8 255.0 DFC_OneToOne 0.00 255.0 FORMAT "%5.1" /end CHARACTERISTIC
/begin CHARACTERISTIC DTR_TID.DTR_OBDMID_41_TID_TStrt_C "" VALUE 0x804F5A6F Val_Wu8 255.0 DFC_OneToOne 0.00 255.0 FORMAT "%5.1" /end CHARACTERISTIC
/begin CHARACTERISTIC DTR_TID.DTR_OBDMID_42_TID_HTR_C "" VALUE 0x804F5A70 Val_Wu8 255.0 DFC_OneToOne 0.00 255.0 FORMAT "%5.1" /end CHARACTERISTIC
/begin CHARACTERISTIC DTR_TID.DTR_OBDMID_a2_TID_0b_0_C "" VALUE 0x804F5A71 Val_Wu8 255.0 DFC_OneToOne 0.00 255.0 FORMAT "%5.1" /end CHARACTERISTIC
/begin CHARACTERISTIC DTR_TID.DTR_OBDMID_a2_TID_0b_1_C "" VALUE 0x804F5A72 Val_Wu8 255.0 DFC_OneToOne 0.00 255.0 FORMAT "%5.1" /end CHARACTERISTIC
/begin CHARACTERISTIC DTR_TID.DTR_OBDMID_a2_TID_0b_2_C "" VALUE 0x804F5A73 Val_Wu8 255.0 DFC_OneToOne 0.00 255.0 FORMAT "%5.1" /end CHARACTERISTIC
/begin CHARACTERISTIC DTR_TID.DTR_OBDMID_a2_TID_0b_3_C "" VALUE 0x804F5A74 Val_Wu8 255.0 DFC_OneToOne 0.00 255.0 FORMAT "%5.1" /end CHARACTERISTIC
/begin CHARACTERISTIC DTR_TID.DTR_OBDMID_a2_TID_0c_0_C "" VALUE 0x804F5A75 Val_Wu8 255.0 DFC_OneToOne 0.00 255.0 FORMAT "%5.1" /end CHARACTERISTIC
/begin CHARACTERISTIC DTR_TID.DTR_OBDMID_a2_TID_0c_1_C "" VALUE 0x804F5A76 Val_Wu8 255.0 DFC_OneToOne 0.00 255.0 FORMAT "%5.1" /end CHARACTERISTIC
/begin CHARACTERISTIC DTR_TID.DTR_OBDMID_a2_TID_0c_2_C "" VALUE 0x804F5A77 Val_Wu8 255.0 DFC_OneToOne 0.00 255.0 FORMAT "%5.1" /end CHARACTERISTIC
/begin CHARACTERISTIC DTR_TID.DTR_OBDMID_a2_TID_0c_3_C "" VALUE 0x804F5A78 Val_Wu8 255.0 DFC_OneToOne 0.00 255.0 FORMAT "%5.1" /end CHARACTERISTIC
/begin CHARACTERISTIC Ebs_cntrDebSocFlt_C "Counter to indicate the number of times an error in SOC has to be consecutively detected" VALUE 0x80542B74 RB_Val_Wu8 255.0 OneToOne 0.00 255.0 FORMAT "%5.1" /end CHARACTERISTIC
/begin CHARACTERISTIC Ebs_facRCorrn_T "Factor for correction of internal resistance of battery based on battery temperature" CURVE 0x80542B76 RB_Curve_S16_S16 2.550000 Fact1000 0.00 2.550000 FORMAT "%8.6" EXTENDED_LIMITS -32.76800 32.76700
 /begin AXIS_DESCR STD_AXIS Ebs_tBattFild SCR_TEMP_CELS_float 6 -32768.00 32767.00 FORMAT "%8.2" DEPOSIT ABSOLUTE /end AXIS_DESCR
/end CHARACTERISTIC
/begin CHARACTERISTIC Ebs_flgSwtSOCSeln_C "Switch to select the source of SOC" VALUE 0x80542B90 RB_Val_Wu8 1.00000000000 B_TRUE 0.00 1.00000000000 FORMAT "%13.11" /end CHARACTERISTIC
/begin CHARACTERISTIC Ebs_iBattRepl_C "Replacement current value for test" VALUE 0x80542B92 RB_Val_Ws16 655.3500 Curr_A -327.6800 327.6700 FORMAT "%8.4" /end CHARACTERISTIC
/begin CHARACTERISTIC Ebs_iS16MaxLim_C "Max limit for S16 Curr_A" VALUE 0x80542B94 RB_Val_Ws32 4194303999.02 Curr_mA_q0p9765625_COMPU -2097152000.00 2097151999.02 FORMAT "%13.2" /end CHARACTERISTIC
/begin CHARACTERISTIC Ebs_iS16MinLim_C "Min limit for S16 Curr_A" VALUE 0x80542B98 RB_Val_Ws32 4194303999.02 Curr_mA_q0p9765625_COMPU -2097152000.00 2097151999.02 FORMAT "%13.2" /end CHARACTERISTIC
/begin CHARACTERISTIC Ebs_qAcmMax_C "Calibration for maximum value of battery accumulated charge and discahrge that can be received from EBS" VALUE 0x80542B9C RB_Val_Ws32 21474836.4700 q0p01_A_h_1 0.00 21474836.4700 FORMAT "%13.4" EXTENDED_LIMITS -21474836.4800 21474836.4700 /end CHARACTERISTIC
/begin CHARACTERISTIC Ebs_qBattNom_T "Nominal battery charge based on battery temperature" CURVE 0x80542BA0 RB_Curve_S16_S16 655.3500 q0p01_A_h_1 -327.6800 327.6700 FORMAT "%8.4"
 /begin AXIS_DESCR STD_AXIS Com_tBattEBS SCR_TEMP_CELS_float 6 -32768.00 32767.00 FORMAT "%8.2" DEPOSIT ABSOLUTE /end AXIS_DESCR
/end CHARACTERISTIC
/begin CHARACTERISTIC Ebs_qChrgDft_C "Default charge value to be used for initialization in case ENVRAM history is lost." VALUE 0x80542BBC RB_Val_Wu32 42949672.9500 q0p01_A_h_1 0.00 42949672.9500 FORMAT "%13.4" /end CHARACTERISTIC
/begin CHARACTERISTIC Ebs_qDchaDft_C "Default discharge value to be used for initialization in case ENVRAM history is lost" VALUE 0x80542BC0 RB_Val_Wu32 42949672.9500 q0p01_A_h_1 0.00 42949672.9500 FORMAT "%13.4" /end CHARACTERISTIC
/begin CHARACTERISTIC Ebs_qSohRepl_C "Replacement SOH value for test" VALUE 0x80542BC4 RB_Val_Ws16 8191.875 ElecChrg_Ah_q0p125_COMPU -4096.000 4095.875 FORMAT "%8.3" /end CHARACTERISTIC
/begin CHARACTERISTIC Ebs_ratDeltaSocThd1_C "Threshold limit of delta SOC for detection of fault 1" VALUE 0x80542BC6 RB_Val_Wu8 127.5 RBPtCel_Perc_0p5_1 0.00 127.5 FORMAT "%5.1" /end CHARACTERISTIC
/begin CHARACTERISTIC Ebs_ratDeltaSocThd2_C "Threshold limit of delta SOC for detection of fault 2" VALUE 0x80542BC8 RB_Val_Wu16 32767.50 RBPtCel_Perc_0p5_1 0.00 32767.50 FORMAT "%8.2" /end CHARACTERISTIC
/begin CHARACTERISTIC Ebs_ratDifThd_C "Threshold limit of SOC to detect error with respect to previous driving cycle" VALUE 0x80542BCA RB_Val_Wu8 127.5 RBPtCel_Perc_0p5_1 0.00 127.5 FORMAT "%5.1" /end CHARACTERISTIC
/begin CHARACTERISTIC Ebs_ratSocRepl_C "Replacement SOC value for test" VALUE 0x80542BCB RB_Val_Wu8 127.5 RBPtCel_Perc_0p5_1 0.00 127.5 FORMAT "%5.1" /end CHARACTERISTIC
/begin CHARACTERISTIC Ebs_ratSohRepl_C "Replacement SOH value for test" VALUE 0x80542BCC RB_Val_Ws16 799.9878 Prc -400.0000 399.9878 FORMAT "%8.4" /end CHARACTERISTIC
/begin CHARACTERISTIC Ebs_ratTarSoc_C "Target SOC for integrated current calculation" VALUE 0x80542BCE RB_Val_Wu8 127.5 RBPtCel_Perc_0p5_1 0.00 127.5 FORMAT "%5.1" /end CHARACTERISTIC
/begin CHARACTERISTIC Ebs_rBattRSRCHiThd_C "Higher threshold for battery internal resistance for calculating the error status in battery resistance signal received from EBS" VALUE 0x80542BD0 RB_Val_Ws16 0.6553500 RBPtCel_r_0p00001_1 -0.3276800 0.3276700 FORMAT "%9.7" /end CHARACTERISTIC
/begin CHARACTERISTIC Ebs_rBattRSRCLoThd_C "Lower threshold for battery internal resistance for calculating the error status in battery resistance signal received from EBS" VALUE 0x80542BD2 RB_Val_Ws16 0.6553500 RBPtCel_r_0p00001_1 -0.3276800 0.3276700 FORMAT "%9.7" /end CHARACTERISTIC
/begin CHARACTERISTIC Ebs_swtCtl_C "Switch for testing" VALUE 0x80542BD4 RB_Val_Wu16 65535.00 OneToOne 0.00 65535.00 FORMAT "%8.2" /end CHARACTERISTIC
/begin CHARACTERISTIC Ebs_tBattRepl_C "Replacement temperature value for test" VALUE 0x80542BD6 RB_Val_Ws16 65535.00 SCR_TEMP_CELS_float -32768.00 32767.00 FORMAT "%8.2" /end CHARACTERISTIC
/begin CHARACTERISTIC Ebs_tiDlyAftStrtrCut_C "Time period after cranking after which battery internal resistance is to be read" VALUE 0x80542BD8 RB_Val_Ws16 655.3500 Time_s -327.6800 327.6700 FORMAT "%8.4" /end CHARACTERISTIC
/begin CHARACTERISTIC Ebs_tiElpdSnceBattSnsrRst_C "Time elapsed since reset of battery sensor until which battery temperature will be indicated as invalid" VALUE 0x80542BDC RB_Val_Ws32 21474836.4700 Time_s 0.00 21474836.4700 FORMAT "%13.4" EXTENDED_LIMITS -21474836.4800 21474836.4700 /end CHARACTERISTIC
/begin CHARACTERISTIC Ebs_tiRatSohFild_C "T1 filter time for SOH" VALUE 0x80542BE0 RB_Val_Ws16 4294.8362200 TimeDelay_s 0.1310760 4294.9672960 FORMAT "%12.7" EXTENDED_LIMITS 0.13107600012 4294.9672960 /end CHARACTERISTIC
/begin CHARACTERISTIC Ebs_tiSocFil_C "T1 filter time for SOC" VALUE 0x80542BE2 RB_Val_Ws16 4294.8362200 TimeDelay_s 0.1310760 4294.9672960 FORMAT "%12.7" EXTENDED_LIMITS 0.13107600012 4294.9672960 /end CHARACTERISTIC
/begin CHARACTERISTIC Ebs_tiSocSohHistOnDly_C "Initial Delay when Ignition is ON whcih prevents the Soc and Soh values from filtering" VALUE 0x80542BE4 RB_Val_Wu16 655.3500 Time_s 0.00 655.3500 FORMAT "%8.4" /end CHARACTERISTIC
/begin CHARACTERISTIC Ebs_tiSohFil_C "T1 filter time for SOH" VALUE 0x80542BE6 RB_Val_Ws16 4294.8362200 TimeDelay_s 0.1310760 4294.9672960 FORMAT "%12.7" EXTENDED_LIMITS 0.13107600012 4294.9672960 /end CHARACTERISTIC
/begin CHARACTERISTIC Ebs_tiT15OnDly_C "Turn ON delay time of T15_st to evaluate battery sensor diagnosis" VALUE 0x80542BE8 RB_Val_Wu16 655.3500 Time_s 0.00 655.3500 FORMAT "%8.4" /end CHARACTERISTIC
/begin CHARACTERISTIC Ebs_tiTBattFil_C "T1 filter time for battery temperature" VALUE 0x80542BEA RB_Val_Ws16 4294.8362200 TimeDelay_s 0.1310760 4294.9672960 FORMAT "%12.7" EXTENDED_LIMITS 0.13107600012 4294.9672960 /end CHARACTERISTIC
/begin CHARACTERISTIC Ebs_tiUBattFil_C "T1 filter time for battery voltage" VALUE 0x80542BEC RB_Val_Ws16 4294.8362200 TimeDelay_s 0.1310760 4294.9672960 FORMAT "%12.7" EXTENDED_LIMITS 0.13107600012 4294.9672960 /end CHARACTERISTIC
/begin CHARACTERISTIC Ebs_tiUSofFild_C "T1 filter time for SOF" VALUE 0x80542BEE RB_Val_Ws16 4294.8362200 TimeDelay_s 0.1310760 4294.9672960 FORMAT "%12.7" EXTENDED_LIMITS 0.13107600012 4294.9672960 /end CHARACTERISTIC
/begin CHARACTERISTIC Ebs_uBattRepl_C "Replacement voltage value for test" VALUE 0x80542BF0 RB_Val_Ws16 63999.02 U_mV_q0p9765625_COMPU -32000.00 31999.02 FORMAT "%8.2" /end CHARACTERISTIC
/begin CHARACTERISTIC Ebs_uSofRepl_C "Replacement SOF value for test" VALUE 0x80542BF2 RB_Val_Ws16 4095.938 spg_q0p0625_V -2048.000 2047.938 FORMAT "%8.3" /end CHARACTERISTIC
/begin CHARACTERISTIC EngStrt_pRailMxDiagHiPStrt_C "Maximum fuel pressure for activation of diagnosis start with high fuel pressure" VALUE 0x8053B34E RB_Val_Wu16 131.0700 RBPtCel_p_0p002_1 0.00 131.0700 FORMAT "%8.4" /end CHARACTERISTIC
/begin CHARACTERISTIC P_VSE11_nrPSPTstPls_C "Number of the additional testpulses for the PSP-relay port" VALUE 0x8053B35C RB_Val_Wu32 4294967295.00 OneToOne 0.00 4294967295.00 FORMAT "%13.2" /end CHARACTERISTIC
/begin CHARACTERISTIC P_VSE11_tiBtwElecFlt_C "Time between tests in case of electrical error" VALUE 0x8053B360 RB_Val_Ws16 655350.0 Time_ms -327680.0 327670.0 FORMAT "%8.1" /end CHARACTERISTIC
/begin CHARACTERISTIC P_VSE11_tiBtwOTFlt_C "Time between tests in case of Over Temperature error" VALUE 0x8053B362 RB_Val_Ws16 655.3500 Time_s -327.6800 327.6700 FORMAT "%8.4" /end CHARACTERISTIC
/begin CHARACTERISTIC TKL15TALV "delay of B_kl15 if empty tank is not validated" VALUE 0x8053B358 RB_Val_Wu8 255.0 t_q1 0.00 255.0 FORMAT "%5.1" /end CHARACTERISTIC
/begin CHARACTERISTIC TMDSTHDROB "Upper threshold engine temperature for diagnosis start with high fuel pressure" VALUE 0x8053B350 RB_Val_Ws16 3276.700 Temp_Cels -273.140 3003.560 FORMAT "%8.3" EXTENDED_LIMITS -3549.940 3003.560 /end CHARACTERISTIC
/begin CHARACTERISTIC TMDSTHDRUN "Lower threshold engine temperature for diagnosis start with high fuel pressure" VALUE 0x8053B352 RB_Val_Ws16 3276.700 Temp_Cels -273.140 3003.560 FORMAT "%8.3" EXTENDED_LIMITS -3549.940 3003.560 /end CHARACTERISTIC
/begin CHARACTERISTIC TSTARTMX "time limit for detection of inadmissible time of engine start" VALUE 0x8053B354 RB_Val_Wu16 655.3500 t10msxs_uw_b655p35 0.00 655.3500 FORMAT "%8.4" /end CHARACTERISTIC
/begin CHARACTERISTIC TurnondelaySwtIntkExh_C "Delay for Intake and Exhaust Turn On Switch" VALUE 0x8053B364 RB_Val_Wu8 25.50 t_q0p1 0.00 25.50 FORMAT "%5.2" /end CHARACTERISTIC
/begin CHARACTERISTIC TVTANKL "Delay time for information canister empty-state terminated" VALUE 0x8053B359 RB_Val_Wu8 255.0 t_q1 0.00 255.0 FORMAT "%5.1" /end CHARACTERISTIC
/begin CHARACTERISTIC TVTLEPL "delay time for enabling of empty fuel tank diagnosis" VALUE 0x8053B35A RB_Val_Wu8 254.0 t_q1 1.0 255.0 FORMAT "%5.1" EXTENDED_LIMITS 0.00 255.0 /end CHARACTERISTIC
/begin CHARACTERISTIC VlvLft_flgFbSwtDtrDfctClrInhb_C "Inhibits further Mode06 updation once defect reported in the current driving cycle for VTEC feedback switch diagnosis." VALUE 0x8053B365 RB_Val_Wboolean 1.00000000000 B_TRUE 0.00 1.00000000000 FORMAT "%13.11" /end CHARACTERISTIC
/begin CHARACTERISTIC VlvLft_IntDbTiHiLo_C "Calibration for High to Low transition for Internal debounce used for feedback switch diagnosis in Valvelift module." VALUE 0x8053B366 RB_Val_Ws16 655350.0 Time_ms -327680.0 327670.0 FORMAT "%8.1" /end CHARACTERISTIC
/begin CHARACTERISTIC VlvLft_IntDbTiLoHi_C "Calibration for Low to High transition for Internal debounce used for feedback switch diagnosis in Valvelift module." VALUE 0x8053B368 RB_Val_Ws16 655350.0 Time_ms -327680.0 327670.0 FORMAT "%8.1" /end CHARACTERISTIC
/begin CHARACTERISTIC VlvLft_pOilHighrThd_C "Upper Threshold of hysteresis value for VTEC pressure sensor" VALUE 0x8053B36A RB_Val_Ws16 6553.500 pres -3276.800 3276.700 FORMAT "%8.3" /end CHARACTERISTIC
/begin CHARACTERISTIC VlvLft_pOilLowrThd_C "Lower Threshold of hysteresis value for VTEC pressure sensor" VALUE 0x8053B36C RB_Val_Ws16 6553.500 pres -3276.800 3276.700 FORMAT "%8.3" /end CHARACTERISTIC
/begin CHARACTERISTIC VlvLft_stFbSnsrDiagEnaIntk_C "Code word for enabling sensor diagnosis (intake)" VALUE 0x8053B36E RB_Val_Wboolean 1.00000000000 B_TRUE 0.00 1.00000000000 FORMAT "%13.11" /end CHARACTERISTIC
/begin CHARACTERISTIC VlvLft_stFbSwtDiagEnaIntk_C "Code word for feedback intake switch diagnosis enabling" VALUE 0x8053B36F RB_Val_Wu8 255.0 dez 0.00 255.0 FORMAT "%5.1" /end CHARACTERISTIC
/begin CHARACTERISTIC Vlvlft_stPsDiaDisbl_C "Codeword for deactivating the powerstage diagnosis for Valvelift" VALUE 0x8053B370 RB_Val_Wu16 65535.00 OneToOne 0.00 65535.00 FORMAT "%8.2" /end CHARACTERISTIC
/begin CHARACTERISTIC Vlvlft_stPsDiaSwitch_C "Switch to enable\disable diagnosis operation if FID set" VALUE 0x8053B372 RB_Val_Wboolean 1.00000000000 B_TRUE 0.00 1.00000000000 FORMAT "%13.11" /end CHARACTERISTIC
/begin CHARACTERISTIC VlvLft_stPwrStgDiagEnaIntkExh_C "Power Stage Diagnosis Intake Exhaust enable" VALUE 0x8053B373 RB_Val_Wu8 255.0 dez 0.00 255.0 FORMAT "%5.1" /end CHARACTERISTIC
/begin CHARACTERISTIC VlvLft_tiSpclMaxIntk_C "Maximum time acceptable for special switch intake" VALUE 0x8053B374 RB_Val_Wu16 65535.00 t_q1_ms 0.00 65535.00 FORMAT "%8.2" /end CHARACTERISTIC
/begin CHARACTERISTIC VlvLft_tiStdMaxIntk_C "Maximum time acceptable for Standard switch intake" VALUE 0x8053B376 RB_Val_Wu16 65535.00 t_q1_ms 0.00 65535.00 FORMAT "%8.2" /end CHARACTERISTIC
/begin CHARACTERISTIC VlvLft_uOilPSnsrSRCMax_C "Maximum voltage value of sensor for SRC Electrical diagnosis" VALUE 0x8053B378 RB_Val_Ws16 13107.00 Volt -6553.600 6553.400 FORMAT "%8.3" /end CHARACTERISTIC
/begin CHARACTERISTIC VlvLft_uOilPSnsrSRCMin_C "Minimum voltage value of sensor for SRC Electrical diagnosis" VALUE 0x8053B37A RB_Val_Ws16 13107.00 Volt -6553.600 6553.400 FORMAT "%8.3" /end CHARACTERISTIC
/begin CHARACTERISTIC ZTSTMX "limit of counter of wrong starts" VALUE 0x8053B356 RB_Val_Wu8 255.0 dez 0.00 255.0 FORMAT "%5.1" /end CHARACTERISTIC
/begin CHARACTERISTIC ZTSTMXOK "linit of counter of good starts" VALUE 0x8053B357 RB_Val_Wu8 255.0 dez 0.00 255.0 FORMAT "%5.1" /end CHARACTERISTIC
/begin MEASUREMENT B_asvtl_msg "error diagnosis shut-off-valve ASV detected due to empty fuel tank" UBYTE B_TRUE 1 100 0.00 1.00000000000 BIT_MASK 0x1 FORMAT "%13.11" ECU_ADDRESS 0x60036E3F /end MEASUREMENT
/begin MEASUREMENT B_bkstl_msg "error diagnosis demand control fuel system detected due to empty fuel tank" UBYTE B_TRUE 1 100 0.00 1.00000000000 BIT_MASK 0x1 FORMAT "%13.11" ECU_ADDRESS 0x60036E3E /end MEASUREMENT
/begin MEASUREMENT B_dsthdron "condition calucation of DSTHDR is active" UBYTE B_TRUE 1 100 0.00 1.00000000000 BIT_MASK 0x1 FORMAT "%13.11" ECU_ADDRESS 0x7000033E /end MEASUREMENT
/begin MEASUREMENT B_dsthdstp "Condition calculation of DSTHDR stopped" UBYTE B_TRUE 1 100 0.00 1.00000000000 BIT_MASK 0x1 FORMAT "%13.11" ECU_ADDRESS 0x7000033D /end MEASUREMENT
/begin MEASUREMENT B_dstti "condition enable diagnosis start time" UBYTE B_TRUE 1 100 0.00 1.00000000000 BIT_MASK 0x1 FORMAT "%13.11" ECU_ADDRESS 0x7000033B /end MEASUREMENT
/begin MEASUREMENT B_dsvtl_msg "error diagnosis output DSV detected due to empty fuel tank" UBYTE B_TRUE 1 100 0.00 1.00000000000 BIT_MASK 0x1 FORMAT "%13.11" ECU_ADDRESS 0x60036E38 /end MEASUREMENT
/begin MEASUREMENT B_dylsunt_msg "Condition lsu-fault detected before empty fuel-tank" UBYTE B_TRUE 1 100 0.00 1.00000000000 BIT_MASK 0x1 FORMAT "%13.11" ECU_ADDRESS 0x60036E37 /end MEASUREMENT
/begin MEASUREMENT B_dylsutl_msg "Condition lsu-fault because of an empty fuel-tank" UBYTE B_TRUE 1 100 0.00 1.00000000000 BIT_MASK 0x1 FORMAT "%13.11" ECU_ADDRESS 0x60036E36 /end MEASUREMENT
/begin MEASUREMENT B_edsthdrp "Condition rail pressure for activation of diagnosis start with high fuel pressure" UBYTE B_TRUE 1 100 0.00 1.00000000000 BIT_MASK 0x1 FORMAT "%13.11" ECU_ADDRESS 0x7000033C /end MEASUREMENT
/begin MEASUREMENT B_fidp_mp "Measurement point FID_CSTHDR permission" UBYTE B_TRUE 1 100 0.00 1.00000000000 BIT_MASK 0x1 FORMAT "%13.11" ECU_ADDRESS 0x7000A2E5 /end MEASUREMENT
/begin MEASUREMENT B_frant_msg "Condition fra-fault detected before empty fuel-tank" UBYTE B_TRUE 1 100 0.00 1.00000000000 BIT_MASK 0x1 FORMAT "%13.11" ECU_ADDRESS 0x60036E31 /end MEASUREMENT
/begin MEASUREMENT B_frapfi2tl "ERROR Diagnosis :multiplicative mixture adaptation factor for PFI(BANK 2) - detected due to empty tank" UBYTE B_TRUE 1 100 0.00 1.00000000000 BIT_MASK 0x1 FORMAT "%13.11" ECU_ADDRESS 0x60036E30 /end MEASUREMENT
/begin MEASUREMENT B_frapfitl "ERROR Diagnosis :multiplicative mixture adaptation factor for PFI - detecteddue to empty tank" UBYTE B_TRUE 1 100 0.00 1.00000000000 BIT_MASK 0x1 FORMAT "%13.11" ECU_ADDRESS 0x60036E2F /end MEASUREMENT
/begin MEASUREMENT B_fratl_msg "Condition fra-fault because of an empty fuel-tank" UBYTE B_TRUE 1 100 0.00 1.00000000000 BIT_MASK 0x1 FORMAT "%13.11" ECU_ADDRESS 0x60036E2E /end MEASUREMENT
/begin MEASUREMENT B_fraztl_msg "Error diagnosis: fault path number: multiplicative mixture adaptation factor in ZAS mode detected due to empty fuel tank" UBYTE B_TRUE 1 100 0.00 1.00000000000 BIT_MASK 0x1 FORMAT "%13.11" ECU_ADDRESS 0x60036E2D /end MEASUREMENT
/begin MEASUREMENT B_frsttl_msg "error diagnosis fuel supply system detected due to empty fuel tank" UBYTE B_TRUE 1 100 0.00 1.00000000000 BIT_MASK 0x1 FORMAT "%13.11" ECU_ADDRESS 0x60036E2C /end MEASUREMENT
/begin MEASUREMENT B_fstcanok "CAN: Condition fuel level message okay" UBYTE B_TRUE 1 100 0.00 1.00000000000 BIT_MASK 0x1 FORMAT "%13.11" ECU_ADDRESS 0x6000FAAA /end MEASUREMENT
/begin MEASUREMENT B_ftdlant_msg "Condition FTDLA-fault detected before empty fuel-tank" UBYTE B_TRUE 1 100 0.00 1.00000000000 BIT_MASK 0x1 FORMAT "%13.11" ECU_ADDRESS 0x60036E2A /end MEASUREMENT
/begin MEASUREMENT B_ftdlatl_msg "Condition FTDLA-fault because of an empty fuel-tank" UBYTE B_TRUE 1 100 0.00 1.00000000000 BIT_MASK 0x1 FORMAT "%13.11" ECU_ADDRESS 0x60036E29 /end MEASUREMENT
/begin MEASUREMENT B_hdrnt_msg "error diagnosis rail pressure control detected before empty fuel tank" UBYTE B_TRUE 1 100 0.00 1.00000000000 BIT_MASK 0x1 FORMAT "%13.11" ECU_ADDRESS 0x60036E23 /end MEASUREMENT
/begin MEASUREMENT B_hdrtl_msg "error diagnosis rail pressure control detected due to empty fuel tank" UBYTE B_TRUE 1 100 0.00 1.00000000000 BIT_MASK 0x1 FORMAT "%13.11" ECU_ADDRESS 0x60036E22 /end MEASUREMENT
/begin MEASUREMENT B_infsthdr "fcmline of DFP_STHDR exists" UBYTE B_TRUE 1 100 0.00 1.00000000000 BIT_MASK 0x1 FORMAT "%13.11" ECU_ADDRESS 0x600000F1 /end MEASUREMENT
/begin MEASUREMENT B_ldrtl_msg "error flag: boost pressure control set due to empty fuel tank" UBYTE B_TRUE 1 100 0.00 1.00000000000 BIT_MASK 0x1 FORMAT "%13.11" ECU_ADDRESS 0x60036E21 /end MEASUREMENT
/begin MEASUREMENT B_limtstok_msg "condition good start" UBYTE B_TRUE 1 100 0.00 1.00000000000 BIT_MASK 0x1 FORMAT "%13.11" ECU_ADDRESS 0x70000B86 /end MEASUREMENT
/begin MEASUREMENT B_limtst_msg "condition bad start" UBYTE B_TRUE 1 100 0.00 1.00000000000 BIT_MASK 0x1 FORMAT "%13.11" ECU_ADDRESS 0x70000B87 /end MEASUREMENT
/begin MEASUREMENT B_llrhnt_msg "Error diagnosis: idle speed control homogeneous detected before empty tank" UBYTE B_TRUE 1 100 0.00 1.00000000000 BIT_MASK 0x1 FORMAT "%13.11" ECU_ADDRESS 0x60036E20 /end MEASUREMENT
/begin MEASUREMENT B_llrhtl_msg "error diagnosis idle speed controller in homogenous mode set due to empty tank" UBYTE B_TRUE 1 100 0.00 1.00000000000 BIT_MASK 0x1 FORMAT "%13.11" ECU_ADDRESS 0x60036E1F /end MEASUREMENT
/begin MEASUREMENT B_llrtl_msg "Error idle speed control set due to empty tank" UBYTE B_TRUE 1 100 0.00 1.00000000000 BIT_MASK 0x1 FORMAT "%13.11" ECU_ADDRESS 0x60036E1E /end MEASUREMENT
/begin MEASUREMENT B_lsf2tl_msg "error lambda sensor downstream front cat bank 2 detected due to empty fuel tank" UBYTE B_TRUE 1 100 0.00 1.00000000000 BIT_MASK 0x1 FORMAT "%13.11" ECU_ADDRESS 0x60036E1D /end MEASUREMENT
/begin MEASUREMENT B_lsftl_msg "error lambda sensor downstream front cat detected due to empty fuel tank" UBYTE B_TRUE 1 100 0.00 1.00000000000 BIT_MASK 0x1 FORMAT "%13.11" ECU_ADDRESS 0x60036E1C /end MEASUREMENT
/begin MEASUREMENT B_lsh2tl_msg "error diagnosis Lambda-Sensor downstream bank2 detected due to empty fuel tank" UBYTE B_TRUE 1 100 0.00 1.00000000000 BIT_MASK 0x1 FORMAT "%13.11" ECU_ADDRESS 0x60036E1B /end MEASUREMENT
/begin MEASUREMENT B_lshnt_msg "error diagnosis lambda sensor downstream cat detected before empty fuel tank" UBYTE B_TRUE 1 100 0.00 1.00000000000 BIT_MASK 0x1 FORMAT "%13.11" ECU_ADDRESS 0x60036E1A /end MEASUREMENT
/begin MEASUREMENT B_lshtl_msg "error diagnosis lambda sensor downstream cat detected due to empty fuel tank" UBYTE B_TRUE 1 100 0.00 1.00000000000 BIT_MASK 0x1 FORMAT "%13.11" ECU_ADDRESS 0x60036E19 /end MEASUREMENT
/begin MEASUREMENT B_mdef_msg "Error diagnosis misfire (multiple) detected due to empty fuel tank" UBYTE B_TRUE 1 100 0.00 1.00000000000 BIT_MASK 0x1 FORMAT "%13.11" ECU_ADDRESS 0x60036E18 /end MEASUREMENT
/begin MEASUREMENT B_mdnt_msg "Error diagnosis misfire (multiple) detected before empty fuel tank" UBYTE B_TRUE 1 100 0.00 1.00000000000 BIT_MASK 0x1 FORMAT "%13.11" ECU_ADDRESS 0x60036E17 /end MEASUREMENT
/begin MEASUREMENT B_ntal "Condition: Leave state tank empty" UBYTE B_TRUE 1 100 0.00 1.00000000000 BIT_MASK 0x1 FORMAT "%13.11" ECU_ADDRESS 0x600000F0 /end MEASUREMENT
/begin MEASUREMENT B_orant_msg "errorflag DKVS: additive correction set before empty fuel tank" UBYTE B_TRUE 1 100 0.00 1.00000000000 BIT_MASK 0x1 FORMAT "%13.11" ECU_ADDRESS 0x60036E13 /end MEASUREMENT
/begin MEASUREMENT B_orapfi2tl "ERROR Diagnosis :Additive mixture adaptation factor for PFI in dual injection system(BANK 2) - detected due to empty tank" UBYTE B_TRUE 1 100 0.00 1.00000000000 BIT_MASK 0x1 FORMAT "%13.11" ECU_ADDRESS 0x60036E12 /end MEASUREMENT
/begin MEASUREMENT B_orapfitl "ERROR Diagnosis :Additive mixture adaptation factor for PFI in dual injection system - detected due to empty tank" UBYTE B_TRUE 1 100 0.00 1.00000000000 BIT_MASK 0x1 FORMAT "%13.11" ECU_ADDRESS 0x60036E11 /end MEASUREMENT
/begin MEASUREMENT B_oratl_msg "errorflag DKVS: additive correction set due to empty fuel tank" UBYTE B_TRUE 1 100 0.00 1.00000000000 BIT_MASK 0x1 FORMAT "%13.11" ECU_ADDRESS 0x60036E10 /end MEASUREMENT
/begin MEASUREMENT B_pllsunt_msg "Condition plausibility of LSU2 -fault detected before empty fuel-tank" UBYTE B_TRUE 1 100 0.00 1.00000000000 BIT_MASK 0x1 FORMAT "%13.11" ECU_ADDRESS 0x60036E0F /end MEASUREMENT
/begin MEASUREMENT B_pllsutl_msg "Condition plausibility of LSU2-fault because of an empty fuel-tank" UBYTE B_TRUE 1 100 0.00 1.00000000000 BIT_MASK 0x1 FORMAT "%13.11" ECU_ADDRESS 0x60036E0E /end MEASUREMENT
/begin MEASUREMENT B_staanloc "Condition start request for diagnosis of time of start" UBYTE B_TRUE 1 100 0.00 1.00000000000 BIT_MASK 0x1 FORMAT "%13.11" ECU_ADDRESS 0x7000033A /end MEASUREMENT
/begin MEASUREMENT B_sthdrnt_msg "error high-pressure start was set before tank became empty" UBYTE B_TRUE 1 100 0.00 1.00000000000 BIT_MASK 0x1 FORMAT "%13.11" ECU_ADDRESS 0x60036E0C /end MEASUREMENT
/begin MEASUREMENT B_sthdrtl_msg "error high-pressure start set because of empty tank" UBYTE B_TRUE 1 100 0.00 1.00000000000 BIT_MASK 0x1 FORMAT "%13.11" ECU_ADDRESS 0x60036E0B /end MEASUREMENT
/begin MEASUREMENT B_sttime_msg "condition start time exceeded" UBYTE B_TRUE 1 100 0.00 1.00000000000 BIT_MASK 0x1 FORMAT "%13.11" ECU_ADDRESS 0x70000B1D /end MEASUREMENT
/begin MEASUREMENT B_tal01 "changing over in state of empty fuel-tank" UBYTE B_TRUE 1 100 0.00 1.00000000000 BIT_MASK 0x1 FORMAT "%13.11" ECU_ADDRESS 0x600000EF /end MEASUREMENT
/begin MEASUREMENT B_tlbde "collected error flags for SY_BDE=1" UBYTE B_TRUE 1 100 0.00 1.00000000000 BIT_MASK 0x1 FORMAT "%13.11" ECU_ADDRESS 0x600000EE /end MEASUREMENT
/begin MEASUREMENT B_tlepl "Empty-fuel-tank diagnosis enabled due to valid and plausible fuel level" UBYTE B_TRUE 1 100 0.00 1.00000000000 BIT_MASK 0x1 FORMAT "%13.11" ECU_ADDRESS 0x600000ED /end MEASUREMENT
/begin MEASUREMENT B_tlnohk "collected error flags for SY_NOHK>0" UBYTE B_TRUE 1 100 0.00 1.00000000000 BIT_MASK 0x1 FORMAT "%13.11" ECU_ADDRESS 0x600000EC /end MEASUREMENT
/begin MEASUREMENT B_tlstervk "collected error flags for SY_STERVK>0" UBYTE B_TRUE 1 100 0.00 1.00000000000 BIT_MASK 0x1 FORMAT "%13.11" ECU_ADDRESS 0x600000EB /end MEASUREMENT
/begin MEASUREMENT Com_ctReIni10msMETA "ReInit Counter for META frame" UBYTE OneToOne 1 100 0.00 255.0 FORMAT "%5.1" ECU_ADDRESS 0x6000BA7A /end MEASUREMENT
/begin MEASUREMENT Com_ctReIni10msMETF "ReInit Counter for METF frame" UBYTE OneToOne 1 100 0.00 255.0 FORMAT "%5.1" ECU_ADDRESS 0x6000BA79 /end MEASUREMENT
/begin MEASUREMENT Com_ctReIni10msMETG "ReIni Counter METG METG2 frame" UBYTE OneToOne 1 100 0.00 255.0 FORMAT "%5.1" ECU_ADDRESS 0x6000BA78 /end MEASUREMENT
/begin MEASUREMENT Com_ctReIni10msMETK "ReInit Counter for METK frame" UBYTE OneToOne 1 100 0.00 255.0 FORMAT "%5.1" ECU_ADDRESS 0x6000BA77 /end MEASUREMENT
/begin MEASUREMENT Com_ctReIni10msMETM "ReInit Counter for METM frame" UBYTE OneToOne 1 100 0.00 255.0 FORMAT "%5.1" ECU_ADDRESS 0x6000BA75 /end MEASUREMENT
/begin MEASUREMENT Com_iACCmpr "Air Conditioner variable capacity compressor control current" UWORD i_q1_mA 1 100 0.00 65535.00 FORMAT "%8.2" ECU_ADDRESS 0x60009562 /end MEASUREMENT
/begin MEASUREMENT Com_lDst "Coverage distance received from meter" SLONG OilMlg 1 100 -2147483648.00 2147483647.00 FORMAT "%13.2" ECU_ADDRESS 0x600037F4 /end MEASUREMENT
/begin MEASUREMENT Com_lDstMETK "Coverage distance" SLONG OilMlg 1 100 -2147483648.00 2147483647.00 FORMAT "%13.2" ECU_ADDRESS 0x50004DE4 /end MEASUREMENT
/begin MEASUREMENT Com_lDstMETK1 "Coverage distance Byte1" UBYTE OneToOne 1 100 0.00 255.0 FORMAT "%5.1" ECU_ADDRESS 0x6000F841 /end MEASUREMENT
/begin MEASUREMENT Com_lDstMETK2 "Coverage distance Byte2" UBYTE OneToOne 1 100 0.00 255.0 FORMAT "%5.1" ECU_ADDRESS 0x6000F840 /end MEASUREMENT
/begin MEASUREMENT Com_lDstMETK3 "Coverage distance Byte3" UBYTE OneToOne 1 100 0.00 255.0 FORMAT "%5.1" ECU_ADDRESS 0x6000F83F /end MEASUREMENT
/begin MEASUREMENT Com_stFailCode "B_CAN failure status" UBYTE OneToOne 1 100 0.00 255.0 FORMAT "%5.1" ECU_ADDRESS 0x6000F816 /end MEASUREMENT
/begin MEASUREMENT Com_stFrzDstMETK_mp "Freeze condition for total meter distance" UBYTE OneToOne 1 100 0.00 255.0 FORMAT "%5.1" ECU_ADDRESS 0x6000BA76 /end MEASUREMENT
/begin MEASUREMENT Com_stLiSwtInfoMETI "status of headlight information received on METI frame" UBYTE OneToOne 1 100 0.00 255.0 FORMAT "%5.1" ECU_ADDRESS 0x6000F815 /end MEASUREMENT
/begin MEASUREMENT Com_stMCUUnFailCode "MCU unit failure status" UBYTE OneToOne 1 100 0.00 255.0 FORMAT "%5.1" ECU_ADDRESS 0x6000F813 /end MEASUREMENT
/begin MEASUREMENT Com_stMETAFrstRx "First reception of META Frame" UBYTE OneToOne 1 100 0.00 255.0 FORMAT "%5.1" ECU_ADDRESS 0x6000FDCC /end MEASUREMENT
/begin MEASUREMENT Com_stMETDCanErr "METD frame status" UBYTE OneToOne 1 100 0.00 255.0 FORMAT "%5.1" ECU_ADDRESS 0x6000FDCB /end MEASUREMENT
/begin MEASUREMENT Com_stMETNCanErr "METN frame status" UBYTE OneToOne 1 100 0.00 255.0 FORMAT "%5.1" ECU_ADDRESS 0x6000FDC8 /end MEASUREMENT
/begin MEASUREMENT Com_stMonMETA "Error Status Message for META Frame" UBYTE OneToOne 1 100 0.00 255.0 FORMAT "%5.1" ECU_ADDRESS 0x6000FDC1 /end MEASUREMENT
/begin MEASUREMENT Com_stMonMETF "Status of METF error monitoring" UBYTE OneToOne 1 100 0.00 255.0 FORMAT "%5.1" ECU_ADDRESS 0x600100DB /end MEASUREMENT
/begin MEASUREMENT Com_stMonMETH "Status of METH error monitoring" UBYTE OneToOne 1 100 0.00 255.0 FORMAT "%5.1" ECU_ADDRESS 0x6000FDC0 /end MEASUREMENT
/begin MEASUREMENT Com_stMonMETL "METL frame preliminary error status" UBYTE OneToOne 1 100 0.00 255.0 FORMAT "%5.1" ECU_ADDRESS 0x6000FDBF /end MEASUREMENT
/begin MEASUREMENT Com_tMETCEnvTRaw "Raw values of outside air temperature for METC Frame" UBYTE OneToOne 1 100 0.00 255.0 FORMAT "%5.1" ECU_ADDRESS 0x6000F80D /end MEASUREMENT
/begin MEASUREMENT Com_tMETEEnvTRaw "Raw values of outside air temperature for METE Frame" UBYTE OneToOne 1 100 0.00 255.0 FORMAT "%5.1" ECU_ADDRESS 0x6000FD45 /end MEASUREMENT
/begin MEASUREMENT Com_vDigVehKmph "Digital Speed Meter display target value(Hysteresis processing value for display) in kmph" UBYTE RBPtCel_v_1p0_1 1 100 0.00 255.0 FORMAT "%5.1" ECU_ADDRESS 0x6000FD40 /end MEASUREMENT
/begin MEASUREMENT Com_vDigVehMph "Digital Speed Meter display target value(Hysteresis processing value for display) in mph" UBYTE Vel_CrCtl1_MPH 1 100 0.00 255.0 FORMAT "%5.1" ECU_ADDRESS 0x6000FD3F /end MEASUREMENT
/begin MEASUREMENT DSM_SRCIntk11Max "Local variable for Intake valve electrical diagnosis result" ULONG OneToOne 1 100 0.00 4294967295.00 FORMAT "%13.2" ECU_ADDRESS 0x7000309C /end MEASUREMENT
/begin MEASUREMENT DSM_SRCIntk11Min "Local variable for Intake valve Electrical diagnosis result" ULONG OneToOne 1 100 0.00 4294967295.00 FORMAT "%13.2" ECU_ADDRESS 0x70003098 /end MEASUREMENT
/begin MEASUREMENT DsplECU_ctMETARngCnt_MP "Measurement point for received Ring counter value of metf" UBYTE OneToOne 1 100 0.00 255.0 FORMAT "%5.1" ECU_ADDRESS 0x7000A2F2 /end MEASUREMENT
/begin MEASUREMENT DsplECU_ctMETCRngCnt_MP "Alive counter measurement point" UBYTE OneToOne 1 100 0.00 255.0 FORMAT "%5.1" ECU_ADDRESS 0x7000A2F1 /end MEASUREMENT
/begin MEASUREMENT DsplECU_ctMETDRngCnt_MP "Measurement point for received Ring counter value" UBYTE OneToOne 1 100 0.00 255.0 FORMAT "%5.1" ECU_ADDRESS 0x7000A2F0 /end MEASUREMENT
/begin MEASUREMENT DsplECU_ctMETE2RngCnt_MP "Alive counter measurement point for SRSB METE2" UBYTE OneToOne 1 100 0.00 255.0 FORMAT "%5.1" ECU_ADDRESS 0x7000A2EF /end MEASUREMENT
/begin MEASUREMENT DsplECU_ctMETFRngCnt_MP "Received ring counter value of METF" UBYTE OneToOne 1 100 0.00 255.0 FORMAT "%5.1" ECU_ADDRESS 0x7000A2EE /end MEASUREMENT
/begin MEASUREMENT DsplECU_ctMETGRngCnt_MP "Alive counter measurement point" UBYTE OneToOne 1 100 0.00 255.0 FORMAT "%5.1" ECU_ADDRESS 0x7000A2ED /end MEASUREMENT
/begin MEASUREMENT DsplECU_ctMETH2RngCnt_MP "Alive counter measurement point for METH2" UBYTE OneToOne 1 100 0.00 255.0 FORMAT "%5.1" ECU_ADDRESS 0x7000A2EB /end MEASUREMENT
/begin MEASUREMENT DsplECU_ctMETHRngCnt_MP "Alive counter measurement point for SRSB METH" UBYTE OneToOne 1 100 0.00 255.0 FORMAT "%5.1" ECU_ADDRESS 0x7000A2EC /end MEASUREMENT
/begin MEASUREMENT DsplECU_ctMETLRngCnt_MP "Alive counter measurement point" UBYTE OneToOne 1 100 0.00 255.0 FORMAT "%5.1" ECU_ADDRESS 0x7000A2E8 /end MEASUREMENT
/begin MEASUREMENT DsplECU_ctMETMRngCnt_MP "Alive counter measurement point" UBYTE OneToOne 1 100 0.00 255.0 FORMAT "%5.1" ECU_ADDRESS 0x7000A2E7 /end MEASUREMENT
/begin MEASUREMENT DsplECU_ctMETNRngCnt_MP "Error couter for METN Frame" UBYTE OneToOne 1 100 0.00 255.0 FORMAT "%5.1" ECU_ADDRESS 0x7000A2E6 /end MEASUREMENT
/begin MEASUREMENT DsplECU_ctRngMETI_MP "Alive counter measurement point" UBYTE OneToOne 1 100 0.00 255.0 FORMAT "%5.1" ECU_ADDRESS 0x7000A2EA /end MEASUREMENT
/begin MEASUREMENT DsplECU_ctRngMETK_MP "Alive counter measurement point" UBYTE OneToOne 1 100 0.00 255.0 FORMAT "%5.1" ECU_ADDRESS 0x7000A2E9 /end MEASUREMENT
/begin MEASUREMENT DTR_valLoLim.DTR_OBDMID_01_TID_DTLTR "lower limits (Mode06) / lower limit of diagnostic test result DTR_OBDMID_01_TID_DTLTR" UWORD DFC_OneToOne 1 100 0.00 65535.00 FORMAT "%8.2" ECU_ADDRESS 0x600385D0 /end MEASUREMENT
/begin MEASUREMENT DTR_valLoLim.DTR_OBDMID_01_TID_DTRTL "lower limits (Mode06) / lower limit of diagnostic test result DTR_OBDMID_01_TID_DTRTL" UWORD DFC_OneToOne 1 100 0.00 65535.00 FORMAT "%8.2" ECU_ADDRESS 0x600385D2 /end MEASUREMENT
/begin MEASUREMENT DTR_valLoLim.DTR_OBDMID_01_TID_OFFSN "lower limits (Mode06) / lower limit of diagnostic test result DTR_OBDMID_01_TID_OFFSN" UWORD DFC_OneToOne 1 100 0.00 65535.00 FORMAT "%8.2" ECU_ADDRESS 0x600385D4 /end MEASUREMENT
/begin MEASUREMENT DTR_valLoLim.DTR_OBDMID_01_TID_OFFSP "lower limits (Mode06) / lower limit of diagnostic test result DTR_OBDMID_01_TID_OFFSP" UWORD DFC_OneToOne 1 100 0.00 65535.00 FORMAT "%8.2" ECU_ADDRESS 0x600385D6 /end MEASUREMENT
/begin MEASUREMENT DTR_valLoLim.DTR_OBDMID_01_TID_SnsrMntdDiag "lower limits (Mode06) / lower limit of diagnostic test result DTR_OBDMID_01_TID_SnsrMntdDiag" UWORD DFC_OneToOne 1 100 0.00 65535.00 FORMAT "%8.2" ECU_ADDRESS 0x600385D8 /end MEASUREMENT
/begin MEASUREMENT DTR_valLoLim.DTR_OBDMID_01_TID_TCLTR "lower limits (Mode06) / lower limit of diagnostic test result DTR_OBDMID_01_TID_TCLTR" UWORD DFC_OneToOne 1 100 0.00 65535.00 FORMAT "%8.2" ECU_ADDRESS 0x600385DA /end MEASUREMENT
/begin MEASUREMENT DTR_valLoLim.DTR_OBDMID_01_TID_TCRTL "lower limits (Mode06) / lower limit of diagnostic test result DTR_OBDMID_01_TID_TCRTL" UWORD DFC_OneToOne 1 100 0.00 65535.00 FORMAT "%8.2" ECU_ADDRESS 0x600385DC /end MEASUREMENT
/begin MEASUREMENT DTR_valLoLim.DTR_OBDMID_02_TID_05 "lower limits (Mode06) / lower limit of diagnostic test result DTR_OBDMID_02_TID_05" UWORD DFC_OneToOne 1 100 0.00 65535.00 FORMAT "%8.2" ECU_ADDRESS 0x600385DE /end MEASUREMENT
/begin MEASUREMENT DTR_valLoLim.DTR_OBDMID_02_TID_06 "lower limits (Mode06) / lower limit of diagnostic test result DTR_OBDMID_02_TID_06" UWORD DFC_OneToOne 1 100 0.00 65535.00 FORMAT "%8.2" ECU_ADDRESS 0x600385E0 /end MEASUREMENT
/begin MEASUREMENT DTR_valLoLim.DTR_OBDMID_02_TID_LtrDly "lower limits (Mode06) / lower limit of diagnostic test result DTR_OBDMID_02_TID_LtrDly" UWORD DFC_OneToOne 1 100 0.00 65535.00 FORMAT "%8.2" ECU_ADDRESS 0x600385E2 /end MEASUREMENT
/begin MEASUREMENT DTR_valLoLim.DTR_OBDMID_02_TID_RtlDly "lower limits (Mode06) / lower limit of diagnostic test result DTR_OBDMID_02_TID_RtlDly" UWORD DFC_OneToOne 1 100 0.00 65535.00 FORMAT "%8.2" ECU_ADDRESS 0x600385E4 /end MEASUREMENT
/begin MEASUREMENT DTR_valLoLim.DTR_OBDMID_02_TID_TarLean "lower limits (Mode06) / lower limit of diagnostic test result DTR_OBDMID_02_TID_TarLean" UWORD DFC_OneToOne 1 100 0.00 65535.00 FORMAT "%8.2" ECU_ADDRESS 0x600385E6 /end MEASUREMENT
/begin MEASUREMENT DTR_valLoLim.DTR_OBDMID_02_TID_TarRich "lower limits (Mode06) / lower limit of diagnostic test result DTR_OBDMID_02_TID_TarRich" UWORD DFC_OneToOne 1 100 0.00 65535.00 FORMAT "%8.2" ECU_ADDRESS 0x600385E8 /end MEASUREMENT
/begin MEASUREMENT DTR_valLoLim.DTR_OBDMID_21_TID_OS "lower limits (Mode06) / lower limit of diagnostic test result DTR_OBDMID_21_TID_OS" UWORD DFC_OneToOne 1 100 0.00 65535.00 FORMAT "%8.2" ECU_ADDRESS 0x600385EA /end MEASUREMENT
/begin MEASUREMENT DTR_valLoLim.DTR_OBDMID_31_TID_AGRSUS "lower limits (Mode06) / lower limit of diagnostic test result DTR_OBDMID_31_TID_AGRSUS" UWORD DFC_OneToOne 1 100 0.00 65535.00 FORMAT "%8.2" ECU_ADDRESS 0x600385EC /end MEASUREMENT
/begin MEASUREMENT DTR_valLoLim.DTR_OBDMID_35_TID_ICSR "lower limits (Mode06) / lower limit of diagnostic test result DTR_OBDMID_35_TID_ICSR" UWORD DFC_OneToOne 1 100 0.00 65535.00 FORMAT "%8.2" ECU_ADDRESS 0x600385EE /end MEASUREMENT
/begin MEASUREMENT DTR_valLoLim.DTR_OBDMID_35_TID_ICTE "lower limits (Mode06) / lower limit of diagnostic test result DTR_OBDMID_35_TID_ICTE" UWORD DFC_OneToOne 1 100 0.00 65535.00 FORMAT "%8.2" ECU_ADDRESS 0x600385F0 /end MEASUREMENT
/begin MEASUREMENT DTR_valLoLim.DTR_OBDMID_35_TID_IntkVTECFbSwt11SpclLft "lower limits (Mode06) / lower limit of diagnostic test result DTR_OBDMID_35_TID_IntkVTECFbSwt11SpclLft" UWORD DFC_OneToOne 1 100 0.00 65535.00 FORMAT "%8.2" ECU_ADDRESS 0x600385F2 /end MEASUREMENT
/begin MEASUREMENT DTR_valLoLim.DTR_OBDMID_35_TID_IntkVTECFbSwt11StdLft "lower limits (Mode06) / lower limit of diagnostic test result DTR_OBDMID_35_TID_IntkVTECFbSwt11StdLft" UWORD DFC_OneToOne 1 100 0.00 65535.00 FORMAT "%8.2" ECU_ADDRESS 0x600385F4 /end MEASUREMENT
/begin MEASUREMENT DTR_valLoLim.DTR_OBDMID_35_TID_LPCI "lower limits (Mode06) / lower limit of diagnostic test result DTR_OBDMID_35_TID_LPCI" UWORD DFC_OneToOne 1 100 0.00 65535.00 FORMAT "%8.2" ECU_ADDRESS 0x600385F6 /end MEASUREMENT
/begin MEASUREMENT DTR_valLoLim.DTR_OBDMID_39_TID_TESG "lower limits (Mode06) / lower limit of diagnostic test result DTR_OBDMID_39_TID_TESG" UWORD DFC_OneToOne 1 100 0.00 65535.00 FORMAT "%8.2" ECU_ADDRESS 0x600385F8 /end MEASUREMENT
/begin MEASUREMENT DTR_valLoLim.DTR_OBDMID_3D_TID_DiagCpv1DteskLoLoadStuckClsd "lower limits (Mode06) / lower limit of diagnostic test result DTR_OBDMID_3D_TID_DiagCpv1DteskLoLoadStuckClsd" UWORD DFC_OneToOne 1 100 0.00 65535.00 FORMAT "%8.2" ECU_ADDRESS 0x600385FA /end MEASUREMENT
/begin MEASUREMENT DTR_valLoLim.DTR_OBDMID_3D_TID_DiagCpv1DteskLoLoadStuckOpen "lower limits (Mode06) / lower limit of diagnostic test result DTR_OBDMID_3D_TID_DiagCpv1DteskLoLoadStuckOpen" UWORD DFC_OneToOne 1 100 0.00 65535.00 FORMAT "%8.2" ECU_ADDRESS 0x600385FC /end MEASUREMENT
/begin MEASUREMENT DTR_valLoLim.DTR_OBDMID_3b_TID_TESF "lower limits (Mode06) / lower limit of diagnostic test result DTR_OBDMID_3b_TID_TESF" UWORD DFC_OneToOne 1 100 0.00 65535.00 FORMAT "%8.2" ECU_ADDRESS 0x600385FE /end MEASUREMENT
/begin MEASUREMENT DTR_valLoLim.DTR_OBDMID_3c_TID_EONV "lower limits (Mode06) / lower limit of diagnostic test result DTR_OBDMID_3c_TID_EONV" UWORD DFC_OneToOne 1 100 0.00 65535.00 FORMAT "%8.2" ECU_ADDRESS 0x60038600 /end MEASUREMENT
/begin MEASUREMENT DTR_valLoLim.DTR_OBDMID_3c_TID_EONVNoF "lower limits (Mode06) / lower limit of diagnostic test result DTR_OBDMID_3c_TID_EONVNoF" UWORD DFC_OneToOne 1 100 0.00 65535.00 FORMAT "%8.2" ECU_ADDRESS 0x60038602 /end MEASUREMENT
/begin MEASUREMENT DTR_valLoLim.DTR_OBDMID_3d_TID_AAV "lower limits (Mode06) / lower limit of diagnostic test result DTR_OBDMID_3d_TID_AAV" UWORD DFC_OneToOne 1 100 0.00 65535.00 FORMAT "%8.2" ECU_ADDRESS 0x60038604 /end MEASUREMENT
/begin MEASUREMENT DTR_valLoLim.DTR_OBDMID_3d_TID_BLKLI "lower limits (Mode06) / lower limit of diagnostic test result DTR_OBDMID_3d_TID_BLKLI" UWORD DFC_OneToOne 1 100 0.00 65535.00 FORMAT "%8.2" ECU_ADDRESS 0x60038606 /end MEASUREMENT
/begin MEASUREMENT DTR_valLoLim.DTR_OBDMID_41_TID_TCER "lower limits (Mode06) / lower limit of diagnostic test result DTR_OBDMID_41_TID_TCER" UWORD DFC_OneToOne 1 100 0.00 65535.00 FORMAT "%8.2" ECU_ADDRESS 0x60038608 /end MEASUREMENT
/begin MEASUREMENT DTR_valLoLim.DTR_OBDMID_41_TID_TStrt "lower limits (Mode06) / lower limit of diagnostic test result DTR_OBDMID_41_TID_TStrt" UWORD DFC_OneToOne 1 100 0.00 65535.00 FORMAT "%8.2" ECU_ADDRESS 0x6003860A /end MEASUREMENT
/begin MEASUREMENT DTR_valLoLim.DTR_OBDMID_42_TID_HTR "lower limits (Mode06) / lower limit of diagnostic test result DTR_OBDMID_42_TID_HTR" UWORD DFC_OneToOne 1 100 0.00 65535.00 FORMAT "%8.2" ECU_ADDRESS 0x6003860C /end MEASUREMENT
/begin MEASUREMENT DTR_valLoLim.DTR_OBDMID_a2_TID_0b_0 "lower limits (Mode06) / lower limit of diagnostic test result DTR_OBDMID_a2_TID_0b_0" UWORD DFC_OneToOne 1 100 0.00 65535.00 FORMAT "%8.2" ECU_ADDRESS 0x6003860E /end MEASUREMENT
/begin MEASUREMENT DTR_valLoLim.DTR_OBDMID_a2_TID_0b_1 "lower limits (Mode06) / lower limit of diagnostic test result DTR_OBDMID_a2_TID_0b_1" UWORD DFC_OneToOne 1 100 0.00 65535.00 FORMAT "%8.2" ECU_ADDRESS 0x60038610 /end MEASUREMENT
/begin MEASUREMENT DTR_valLoLim.DTR_OBDMID_a2_TID_0b_2 "lower limits (Mode06) / lower limit of diagnostic test result DTR_OBDMID_a2_TID_0b_2" UWORD DFC_OneToOne 1 100 0.00 65535.00 FORMAT "%8.2" ECU_ADDRESS 0x60038612 /end MEASUREMENT
/begin MEASUREMENT DTR_valLoLim.DTR_OBDMID_a2_TID_0b_3 "lower limits (Mode06) / lower limit of diagnostic test result DTR_OBDMID_a2_TID_0b_3" UWORD DFC_OneToOne 1 100 0.00 65535.00 FORMAT "%8.2" ECU_ADDRESS 0x60038614 /end MEASUREMENT
/begin MEASUREMENT DTR_valLoLim.DTR_OBDMID_a2_TID_0c_0 "lower limits (Mode06) / lower limit of diagnostic test result DTR_OBDMID_a2_TID_0c_0" UWORD DFC_OneToOne 1 100 0.00 65535.00 FORMAT "%8.2" ECU_ADDRESS 0x60038616 /end MEASUREMENT
/begin MEASUREMENT DTR_valLoLim.DTR_OBDMID_a2_TID_0c_1 "lower limits (Mode06) / lower limit of diagnostic test result DTR_OBDMID_a2_TID_0c_1" UWORD DFC_OneToOne 1 100 0.00 65535.00 FORMAT "%8.2" ECU_ADDRESS 0x60038618 /end MEASUREMENT
/begin MEASUREMENT DTR_valLoLim.DTR_OBDMID_a2_TID_0c_2 "lower limits (Mode06) / lower limit of diagnostic test result DTR_OBDMID_a2_TID_0c_2" UWORD DFC_OneToOne 1 100 0.00 65535.00 FORMAT "%8.2" ECU_ADDRESS 0x6003861A /end MEASUREMENT
/begin MEASUREMENT DTR_valLoLim.DTR_OBDMID_a2_TID_0c_3 "lower limits (Mode06) / lower limit of diagnostic test result DTR_OBDMID_a2_TID_0c_3" UWORD DFC_OneToOne 1 100 0.00 65535.00 FORMAT "%8.2" ECU_ADDRESS 0x6003861C /end MEASUREMENT
/begin MEASUREMENT DTR_valTst.DTR_OBDMID_01_TID_DTLTR "last test value (Mode06) / last test result of DTR_OBDMID_01_TID_DTLTR" UWORD DFC_OneToOne 1 100 0.00 65535.00 FORMAT "%8.2" ECU_ADDRESS 0x6003866C /end MEASUREMENT
/begin MEASUREMENT DTR_valTst.DTR_OBDMID_01_TID_DTRTL "last test value (Mode06) / last test result of DTR_OBDMID_01_TID_DTRTL" UWORD DFC_OneToOne 1 100 0.00 65535.00 FORMAT "%8.2" ECU_ADDRESS 0x6003866E /end MEASUREMENT
/begin MEASUREMENT DTR_valTst.DTR_OBDMID_01_TID_OFFSN "last test value (Mode06) / last test result of DTR_OBDMID_01_TID_OFFSN" UWORD DFC_OneToOne 1 100 0.00 65535.00 FORMAT "%8.2" ECU_ADDRESS 0x60038670 /end MEASUREMENT
/begin MEASUREMENT DTR_valTst.DTR_OBDMID_01_TID_OFFSP "last test value (Mode06) / last test result of DTR_OBDMID_01_TID_OFFSP" UWORD DFC_OneToOne 1 100 0.00 65535.00 FORMAT "%8.2" ECU_ADDRESS 0x60038672 /end MEASUREMENT
/begin MEASUREMENT DTR_valTst.DTR_OBDMID_01_TID_SnsrMntdDiag "last test value (Mode06) / last test result of DTR_OBDMID_01_TID_SnsrMntdDiag" UWORD DFC_OneToOne 1 100 0.00 65535.00 FORMAT "%8.2" ECU_ADDRESS 0x60038674 /end MEASUREMENT
/begin MEASUREMENT DTR_valTst.DTR_OBDMID_01_TID_TCLTR "last test value (Mode06) / last test result of DTR_OBDMID_01_TID_TCLTR" UWORD DFC_OneToOne 1 100 0.00 65535.00 FORMAT "%8.2" ECU_ADDRESS 0x60038676 /end MEASUREMENT
/begin MEASUREMENT DTR_valTst.DTR_OBDMID_01_TID_TCRTL "last test value (Mode06) / last test result of DTR_OBDMID_01_TID_TCRTL" UWORD DFC_OneToOne 1 100 0.00 65535.00 FORMAT "%8.2" ECU_ADDRESS 0x60038678 /end MEASUREMENT
/begin MEASUREMENT DTR_valTst.DTR_OBDMID_02_TID_05 "last test value (Mode06) / last test result of DTR_OBDMID_02_TID_05" UWORD DFC_OneToOne 1 100 0.00 65535.00 FORMAT "%8.2" ECU_ADDRESS 0x6003867A /end MEASUREMENT
/begin MEASUREMENT DTR_valTst.DTR_OBDMID_02_TID_06 "last test value (Mode06) / last test result of DTR_OBDMID_02_TID_06" UWORD DFC_OneToOne 1 100 0.00 65535.00 FORMAT "%8.2" ECU_ADDRESS 0x6003867C /end MEASUREMENT
/begin MEASUREMENT DTR_valTst.DTR_OBDMID_02_TID_LtrDly "last test value (Mode06) / last test result of DTR_OBDMID_02_TID_LtrDly" UWORD DFC_OneToOne 1 100 0.00 65535.00 FORMAT "%8.2" ECU_ADDRESS 0x6003867E /end MEASUREMENT
/begin MEASUREMENT DTR_valTst.DTR_OBDMID_02_TID_RtlDly "last test value (Mode06) / last test result of DTR_OBDMID_02_TID_RtlDly" UWORD DFC_OneToOne 1 100 0.00 65535.00 FORMAT "%8.2" ECU_ADDRESS 0x60038680 /end MEASUREMENT
/begin MEASUREMENT DTR_valTst.DTR_OBDMID_02_TID_TarLean "last test value (Mode06) / last test result of DTR_OBDMID_02_TID_TarLean" UWORD DFC_OneToOne 1 100 0.00 65535.00 FORMAT "%8.2" ECU_ADDRESS 0x60038682 /end MEASUREMENT
/begin MEASUREMENT DTR_valTst.DTR_OBDMID_02_TID_TarRich "last test value (Mode06) / last test result of DTR_OBDMID_02_TID_TarRich" UWORD DFC_OneToOne 1 100 0.00 65535.00 FORMAT "%8.2" ECU_ADDRESS 0x60038684 /end MEASUREMENT
/begin MEASUREMENT DTR_valTst.DTR_OBDMID_21_TID_OS "last test value (Mode06) / last test result of DTR_OBDMID_21_TID_OS" UWORD DFC_OneToOne 1 100 0.00 65535.00 FORMAT "%8.2" ECU_ADDRESS 0x60038686 /end MEASUREMENT
/begin MEASUREMENT DTR_valTst.DTR_OBDMID_31_TID_AGRSUS "last test value (Mode06) / last test result of DTR_OBDMID_31_TID_AGRSUS" UWORD DFC_OneToOne 1 100 0.00 65535.00 FORMAT "%8.2" ECU_ADDRESS 0x60038688 /end MEASUREMENT
/begin MEASUREMENT DTR_valTst.DTR_OBDMID_35_TID_ICSR "last test value (Mode06) / last test result of DTR_OBDMID_35_TID_ICSR" UWORD DFC_OneToOne 1 100 0.00 65535.00 FORMAT "%8.2" ECU_ADDRESS 0x6003868A /end MEASUREMENT
/begin MEASUREMENT DTR_valTst.DTR_OBDMID_35_TID_ICTE "last test value (Mode06) / last test result of DTR_OBDMID_35_TID_ICTE" UWORD DFC_OneToOne 1 100 0.00 65535.00 FORMAT "%8.2" ECU_ADDRESS 0x6003868C /end MEASUREMENT
/begin MEASUREMENT DTR_valTst.DTR_OBDMID_35_TID_IntkVTECFbSwt11SpclLft "last test value (Mode06) / last test result of DTR_OBDMID_35_TID_IntkVTECFbSwt11SpclLft" UWORD DFC_OneToOne 1 100 0.00 65535.00 FORMAT "%8.2" ECU_ADDRESS 0x6003868E /end MEASUREMENT
/begin MEASUREMENT DTR_valTst.DTR_OBDMID_35_TID_IntkVTECFbSwt11StdLft "last test value (Mode06) / last test result of DTR_OBDMID_35_TID_IntkVTECFbSwt11StdLft" UWORD DFC_OneToOne 1 100 0.00 65535.00 FORMAT "%8.2" ECU_ADDRESS 0x60038690 /end MEASUREMENT
/begin MEASUREMENT DTR_valTst.DTR_OBDMID_35_TID_LPCI "last test value (Mode06) / last test result of DTR_OBDMID_35_TID_LPCI" UWORD DFC_OneToOne 1 100 0.00 65535.00 FORMAT "%8.2" ECU_ADDRESS 0x60038692 /end MEASUREMENT
/begin MEASUREMENT DTR_valTst.DTR_OBDMID_39_TID_TESG "last test value (Mode06) / last test result of DTR_OBDMID_39_TID_TESG" UWORD DFC_OneToOne 1 100 0.00 65535.00 FORMAT "%8.2" ECU_ADDRESS 0x60038694 /end MEASUREMENT
/begin MEASUREMENT DTR_valTst.DTR_OBDMID_3D_TID_DiagCpv1DteskLoLoadStuckClsd "last test value (Mode06) / last test result of DTR_OBDMID_3D_TID_DiagCpv1DteskLoLoadStuckClsd" UWORD DFC_OneToOne 1 100 0.00 65535.00 FORMAT "%8.2" ECU_ADDRESS 0x60038696 /end MEASUREMENT
/begin MEASUREMENT DTR_valTst.DTR_OBDMID_3D_TID_DiagCpv1DteskLoLoadStuckOpen "last test value (Mode06) / last test result of DTR_OBDMID_3D_TID_DiagCpv1DteskLoLoadStuckOpen" UWORD DFC_OneToOne 1 100 0.00 65535.00 FORMAT "%8.2" ECU_ADDRESS 0x60038698 /end MEASUREMENT
/begin MEASUREMENT DTR_valTst.DTR_OBDMID_3b_TID_TESF "last test value (Mode06) / last test result of DTR_OBDMID_3b_TID_TESF" UWORD DFC_OneToOne 1 100 0.00 65535.00 FORMAT "%8.2" ECU_ADDRESS 0x6003869A /end MEASUREMENT
/begin MEASUREMENT DTR_valTst.DTR_OBDMID_3c_TID_EONV "last test value (Mode06) / last test result of DTR_OBDMID_3c_TID_EONV" UWORD DFC_OneToOne 1 100 0.00 65535.00 FORMAT "%8.2" ECU_ADDRESS 0x6003869C /end MEASUREMENT
/begin MEASUREMENT DTR_valTst.DTR_OBDMID_3c_TID_EONVNoF "last test value (Mode06) / last test result of DTR_OBDMID_3c_TID_EONVNoF" UWORD DFC_OneToOne 1 100 0.00 65535.00 FORMAT "%8.2" ECU_ADDRESS 0x6003869E /end MEASUREMENT
/begin MEASUREMENT DTR_valTst.DTR_OBDMID_3d_TID_AAV "last test value (Mode06) / last test result of DTR_OBDMID_3d_TID_AAV" UWORD DFC_OneToOne 1 100 0.00 65535.00 FORMAT "%8.2" ECU_ADDRESS 0x600386A0 /end MEASUREMENT
/begin MEASUREMENT DTR_valTst.DTR_OBDMID_3d_TID_BLKLI "last test value (Mode06) / last test result of DTR_OBDMID_3d_TID_BLKLI" UWORD DFC_OneToOne 1 100 0.00 65535.00 FORMAT "%8.2" ECU_ADDRESS 0x600386A2 /end MEASUREMENT
/begin MEASUREMENT DTR_valTst.DTR_OBDMID_41_TID_TCER "last test value (Mode06) / last test result of DTR_OBDMID_41_TID_TCER" UWORD DFC_OneToOne 1 100 0.00 65535.00 FORMAT "%8.2" ECU_ADDRESS 0x600386A4 /end MEASUREMENT
/begin MEASUREMENT DTR_valTst.DTR_OBDMID_41_TID_TStrt "last test value (Mode06) / last test result of DTR_OBDMID_41_TID_TStrt" UWORD DFC_OneToOne 1 100 0.00 65535.00 FORMAT "%8.2" ECU_ADDRESS 0x600386A6 /end MEASUREMENT
/begin MEASUREMENT DTR_valTst.DTR_OBDMID_42_TID_HTR "last test value (Mode06) / last test result of DTR_OBDMID_42_TID_HTR" UWORD DFC_OneToOne 1 100 0.00 65535.00 FORMAT "%8.2" ECU_ADDRESS 0x600386A8 /end MEASUREMENT
/begin MEASUREMENT DTR_valTst.DTR_OBDMID_a2_TID_0b_0 "last test value (Mode06) / last test result of DTR_OBDMID_a2_TID_0b_0" UWORD DFC_OneToOne 1 100 0.00 65535.00 FORMAT "%8.2" ECU_ADDRESS 0x600386AA /end MEASUREMENT
/begin MEASUREMENT DTR_valTst.DTR_OBDMID_a2_TID_0b_1 "last test value (Mode06) / last test result of DTR_OBDMID_a2_TID_0b_1" UWORD DFC_OneToOne 1 100 0.00 65535.00 FORMAT "%8.2" ECU_ADDRESS 0x600386AC /end MEASUREMENT
/begin MEASUREMENT DTR_valTst.DTR_OBDMID_a2_TID_0b_2 "last test value (Mode06) / last test result of DTR_OBDMID_a2_TID_0b_2" UWORD DFC_OneToOne 1 100 0.00 65535.00 FORMAT "%8.2" ECU_ADDRESS 0x600386AE /end MEASUREMENT
/begin MEASUREMENT DTR_valTst.DTR_OBDMID_a2_TID_0b_3 "last test value (Mode06) / last test result of DTR_OBDMID_a2_TID_0b_3" UWORD DFC_OneToOne 1 100 0.00 65535.00 FORMAT "%8.2" ECU_ADDRESS 0x600386B0 /end MEASUREMENT
/begin MEASUREMENT DTR_valTst.DTR_OBDMID_a2_TID_0c_0 "last test value (Mode06) / last test result of DTR_OBDMID_a2_TID_0c_0" UWORD DFC_OneToOne 1 100 0.00 65535.00 FORMAT "%8.2" ECU_ADDRESS 0x600386B2 /end MEASUREMENT
/begin MEASUREMENT DTR_valTst.DTR_OBDMID_a2_TID_0c_1 "last test value (Mode06) / last test result of DTR_OBDMID_a2_TID_0c_1" UWORD DFC_OneToOne 1 100 0.00 65535.00 FORMAT "%8.2" ECU_ADDRESS 0x600386B4 /end MEASUREMENT
/begin MEASUREMENT DTR_valTst.DTR_OBDMID_a2_TID_0c_2 "last test value (Mode06) / last test result of DTR_OBDMID_a2_TID_0c_2" UWORD DFC_OneToOne 1 100 0.00 65535.00 FORMAT "%8.2" ECU_ADDRESS 0x600386B6 /end MEASUREMENT
/begin MEASUREMENT DTR_valTst.DTR_OBDMID_a2_TID_0c_3 "last test value (Mode06) / last test result of DTR_OBDMID_a2_TID_0c_3" UWORD DFC_OneToOne 1 100 0.00 65535.00 FORMAT "%8.2" ECU_ADDRESS 0x600386B8 /end MEASUREMENT
/begin MEASUREMENT DTR_valUpLim.DTR_OBDMID_01_TID_DTLTR "upper limits (Mode06) / upper limit of diagnostic test result DTR_OBDMID_01_TID_DTLTR" UWORD DFC_OneToOne 1 100 0.00 65535.00 FORMAT "%8.2" ECU_ADDRESS 0x6003861E /end MEASUREMENT
/begin MEASUREMENT DTR_valUpLim.DTR_OBDMID_01_TID_DTRTL "upper limits (Mode06) / upper limit of diagnostic test result DTR_OBDMID_01_TID_DTRTL" UWORD DFC_OneToOne 1 100 0.00 65535.00 FORMAT "%8.2" ECU_ADDRESS 0x60038620 /end MEASUREMENT
/begin MEASUREMENT DTR_valUpLim.DTR_OBDMID_01_TID_OFFSN "upper limits (Mode06) / upper limit of diagnostic test result DTR_OBDMID_01_TID_OFFSN" UWORD DFC_OneToOne 1 100 0.00 65535.00 FORMAT "%8.2" ECU_ADDRESS 0x60038622 /end MEASUREMENT
/begin MEASUREMENT DTR_valUpLim.DTR_OBDMID_01_TID_OFFSP "upper limits (Mode06) / upper limit of diagnostic test result DTR_OBDMID_01_TID_OFFSP" UWORD DFC_OneToOne 1 100 0.00 65535.00 FORMAT "%8.2" ECU_ADDRESS 0x60038624 /end MEASUREMENT
/begin MEASUREMENT DTR_valUpLim.DTR_OBDMID_01_TID_SnsrMntdDiag "upper limits (Mode06) / upper limit of diagnostic test result DTR_OBDMID_01_TID_SnsrMntdDiag" UWORD DFC_OneToOne 1 100 0.00 65535.00 FORMAT "%8.2" ECU_ADDRESS 0x60038626 /end MEASUREMENT
/begin MEASUREMENT DTR_valUpLim.DTR_OBDMID_01_TID_TCLTR "upper limits (Mode06) / upper limit of diagnostic test result DTR_OBDMID_01_TID_TCLTR" UWORD DFC_OneToOne 1 100 0.00 65535.00 FORMAT "%8.2" ECU_ADDRESS 0x60038628 /end MEASUREMENT
/begin MEASUREMENT DTR_valUpLim.DTR_OBDMID_01_TID_TCRTL "upper limits (Mode06) / upper limit of diagnostic test result DTR_OBDMID_01_TID_TCRTL" UWORD DFC_OneToOne 1 100 0.00 65535.00 FORMAT "%8.2" ECU_ADDRESS 0x6003862A /end MEASUREMENT
/begin MEASUREMENT DTR_valUpLim.DTR_OBDMID_02_TID_05 "upper limits (Mode06) / upper limit of diagnostic test result DTR_OBDMID_02_TID_05" UWORD DFC_OneToOne 1 100 0.00 65535.00 FORMAT "%8.2" ECU_ADDRESS 0x6003862C /end MEASUREMENT
/begin MEASUREMENT DTR_valUpLim.DTR_OBDMID_02_TID_06 "upper limits (Mode06) / upper limit of diagnostic test result DTR_OBDMID_02_TID_06" UWORD DFC_OneToOne 1 100 0.00 65535.00 FORMAT "%8.2" ECU_ADDRESS 0x6003862E /end MEASUREMENT
/begin MEASUREMENT DTR_valUpLim.DTR_OBDMID_02_TID_LtrDly "upper limits (Mode06) / upper limit of diagnostic test result DTR_OBDMID_02_TID_LtrDly" UWORD DFC_OneToOne 1 100 0.00 65535.00 FORMAT "%8.2" ECU_ADDRESS 0x60038630 /end MEASUREMENT
/begin MEASUREMENT DTR_valUpLim.DTR_OBDMID_02_TID_RtlDly "upper limits (Mode06) / upper limit of diagnostic test result DTR_OBDMID_02_TID_RtlDly" UWORD DFC_OneToOne 1 100 0.00 65535.00 FORMAT "%8.2" ECU_ADDRESS 0x60038632 /end MEASUREMENT
/begin MEASUREMENT DTR_valUpLim.DTR_OBDMID_02_TID_TarLean "upper limits (Mode06) / upper limit of diagnostic test result DTR_OBDMID_02_TID_TarLean" UWORD DFC_OneToOne 1 100 0.00 65535.00 FORMAT "%8.2" ECU_ADDRESS 0x60038634 /end MEASUREMENT
/begin MEASUREMENT DTR_valUpLim.DTR_OBDMID_02_TID_TarRich "upper limits (Mode06) / upper limit of diagnostic test result DTR_OBDMID_02_TID_TarRich" UWORD DFC_OneToOne 1 100 0.00 65535.00 FORMAT "%8.2" ECU_ADDRESS 0x60038636 /end MEASUREMENT
/begin MEASUREMENT DTR_valUpLim.DTR_OBDMID_21_TID_OS "upper limits (Mode06) / upper limit of diagnostic test result DTR_OBDMID_21_TID_OS" UWORD DFC_OneToOne 1 100 0.00 65535.00 FORMAT "%8.2" ECU_ADDRESS 0x60038638 /end MEASUREMENT
/begin MEASUREMENT DTR_valUpLim.DTR_OBDMID_31_TID_AGRSUS "upper limits (Mode06) / upper limit of diagnostic test result DTR_OBDMID_31_TID_AGRSUS" UWORD DFC_OneToOne 1 100 0.00 65535.00 FORMAT "%8.2" ECU_ADDRESS 0x6003863A /end MEASUREMENT
/begin MEASUREMENT DTR_valUpLim.DTR_OBDMID_35_TID_ICSR "upper limits (Mode06) / upper limit of diagnostic test result DTR_OBDMID_35_TID_ICSR" UWORD DFC_OneToOne 1 100 0.00 65535.00 FORMAT "%8.2" ECU_ADDRESS 0x6003863C /end MEASUREMENT
/begin MEASUREMENT DTR_valUpLim.DTR_OBDMID_35_TID_ICTE "upper limits (Mode06) / upper limit of diagnostic test result DTR_OBDMID_35_TID_ICTE" UWORD DFC_OneToOne 1 100 0.00 65535.00 FORMAT "%8.2" ECU_ADDRESS 0x6003863E /end MEASUREMENT
/begin MEASUREMENT DTR_valUpLim.DTR_OBDMID_35_TID_IntkVTECFbSwt11SpclLft "upper limits (Mode06) / upper limit of diagnostic test result DTR_OBDMID_35_TID_IntkVTECFbSwt11SpclLft" UWORD DFC_OneToOne 1 100 0.00 65535.00 FORMAT "%8.2" ECU_ADDRESS 0x60038640 /end MEASUREMENT
/begin MEASUREMENT DTR_valUpLim.DTR_OBDMID_35_TID_IntkVTECFbSwt11StdLft "upper limits (Mode06) / upper limit of diagnostic test result DTR_OBDMID_35_TID_IntkVTECFbSwt11StdLft" UWORD DFC_OneToOne 1 100 0.00 65535.00 FORMAT "%8.2" ECU_ADDRESS 0x60038642 /end MEASUREMENT
/begin MEASUREMENT DTR_valUpLim.DTR_OBDMID_35_TID_LPCI "upper limits (Mode06) / upper limit of diagnostic test result DTR_OBDMID_35_TID_LPCI" UWORD DFC_OneToOne 1 100 0.00 65535.00 FORMAT "%8.2" ECU_ADDRESS 0x60038644 /end MEASUREMENT
/begin MEASUREMENT DTR_valUpLim.DTR_OBDMID_39_TID_TESG "upper limits (Mode06) / upper limit of diagnostic test result DTR_OBDMID_39_TID_TESG" UWORD DFC_OneToOne 1 100 0.00 65535.00 FORMAT "%8.2" ECU_ADDRESS 0x60038646 /end MEASUREMENT
/begin MEASUREMENT DTR_valUpLim.DTR_OBDMID_3D_TID_DiagCpv1DteskLoLoadStuckClsd "upper limits (Mode06) / upper limit of diagnostic test result DTR_OBDMID_3D_TID_DiagCpv1DteskLoLoadStuckClsd" UWORD DFC_OneToOne 1 100 0.00 65535.00 FORMAT "%8.2" ECU_ADDRESS 0x60038648 /end MEASUREMENT
/begin MEASUREMENT DTR_valUpLim.DTR_OBDMID_3D_TID_DiagCpv1DteskLoLoadStuckOpen "upper limits (Mode06) / upper limit of diagnostic test result DTR_OBDMID_3D_TID_DiagCpv1DteskLoLoadStuckOpen" UWORD DFC_OneToOne 1 100 0.00 65535.00 FORMAT "%8.2" ECU_ADDRESS 0x6003864A /end MEASUREMENT
/begin MEASUREMENT DTR_valUpLim.DTR_OBDMID_3b_TID_TESF "upper limits (Mode06) / upper limit of diagnostic test result DTR_OBDMID_3b_TID_TESF" UWORD DFC_OneToOne 1 100 0.00 65535.00 FORMAT "%8.2" ECU_ADDRESS 0x6003864C /end MEASUREMENT
/begin MEASUREMENT DTR_valUpLim.DTR_OBDMID_3c_TID_EONV "upper limits (Mode06) / upper limit of diagnostic test result DTR_OBDMID_3c_TID_EONV" UWORD DFC_OneToOne 1 100 0.00 65535.00 FORMAT "%8.2" ECU_ADDRESS 0x6003864E /end MEASUREMENT
/begin MEASUREMENT DTR_valUpLim.DTR_OBDMID_3c_TID_EONVNoF "upper limits (Mode06) / upper limit of diagnostic test result DTR_OBDMID_3c_TID_EONVNoF" UWORD DFC_OneToOne 1 100 0.00 65535.00 FORMAT "%8.2" ECU_ADDRESS 0x60038650 /end MEASUREMENT
/begin MEASUREMENT DTR_valUpLim.DTR_OBDMID_3d_TID_AAV "upper limits (Mode06) / upper limit of diagnostic test result DTR_OBDMID_3d_TID_AAV" UWORD DFC_OneToOne 1 100 0.00 65535.00 FORMAT "%8.2" ECU_ADDRESS 0x60038652 /end MEASUREMENT
/begin MEASUREMENT DTR_valUpLim.DTR_OBDMID_3d_TID_BLKLI "upper limits (Mode06) / upper limit of diagnostic test result DTR_OBDMID_3d_TID_BLKLI" UWORD DFC_OneToOne 1 100 0.00 65535.00 FORMAT "%8.2" ECU_ADDRESS 0x60038654 /end MEASUREMENT
/begin MEASUREMENT DTR_valUpLim.DTR_OBDMID_41_TID_TCER "upper limits (Mode06) / upper limit of diagnostic test result DTR_OBDMID_41_TID_TCER" UWORD DFC_OneToOne 1 100 0.00 65535.00 FORMAT "%8.2" ECU_ADDRESS 0x60038656 /end MEASUREMENT
/begin MEASUREMENT DTR_valUpLim.DTR_OBDMID_41_TID_TStrt "upper limits (Mode06) / upper limit of diagnostic test result DTR_OBDMID_41_TID_TStrt" UWORD DFC_OneToOne 1 100 0.00 65535.00 FORMAT "%8.2" ECU_ADDRESS 0x60038658 /end MEASUREMENT
/begin MEASUREMENT DTR_valUpLim.DTR_OBDMID_42_TID_HTR "upper limits (Mode06) / upper limit of diagnostic test result DTR_OBDMID_42_TID_HTR" UWORD DFC_OneToOne 1 100 0.00 65535.00 FORMAT "%8.2" ECU_ADDRESS 0x6003865A /end MEASUREMENT
/begin MEASUREMENT DTR_valUpLim.DTR_OBDMID_a2_TID_0b_0 "upper limits (Mode06) / upper limit of diagnostic test result DTR_OBDMID_a2_TID_0b_0" UWORD DFC_OneToOne 1 100 0.00 65535.00 FORMAT "%8.2" ECU_ADDRESS 0x6003865C /end MEASUREMENT
/begin MEASUREMENT DTR_valUpLim.DTR_OBDMID_a2_TID_0b_1 "upper limits (Mode06) / upper limit of diagnostic test result DTR_OBDMID_a2_TID_0b_1" UWORD DFC_OneToOne 1 100 0.00 65535.00 FORMAT "%8.2" ECU_ADDRESS 0x6003865E /end MEASUREMENT
/begin MEASUREMENT DTR_valUpLim.DTR_OBDMID_a2_TID_0b_2 "upper limits (Mode06) / upper limit of diagnostic test result DTR_OBDMID_a2_TID_0b_2" UWORD DFC_OneToOne 1 100 0.00 65535.00 FORMAT "%8.2" ECU_ADDRESS 0x60038660 /end MEASUREMENT
/begin MEASUREMENT DTR_valUpLim.DTR_OBDMID_a2_TID_0b_3 "upper limits (Mode06) / upper limit of diagnostic test result DTR_OBDMID_a2_TID_0b_3" UWORD DFC_OneToOne 1 100 0.00 65535.00 FORMAT "%8.2" ECU_ADDRESS 0x60038662 /end MEASUREMENT
/begin MEASUREMENT DTR_valUpLim.DTR_OBDMID_a2_TID_0c_0 "upper limits (Mode06) / upper limit of diagnostic test result DTR_OBDMID_a2_TID_0c_0" UWORD DFC_OneToOne 1 100 0.00 65535.00 FORMAT "%8.2" ECU_ADDRESS 0x60038664 /end MEASUREMENT
/begin MEASUREMENT DTR_valUpLim.DTR_OBDMID_a2_TID_0c_1 "upper limits (Mode06) / upper limit of diagnostic test result DTR_OBDMID_a2_TID_0c_1" UWORD DFC_OneToOne 1 100 0.00 65535.00 FORMAT "%8.2" ECU_ADDRESS 0x60038666 /end MEASUREMENT
/begin MEASUREMENT DTR_valUpLim.DTR_OBDMID_a2_TID_0c_2 "upper limits (Mode06) / upper limit of diagnostic test result DTR_OBDMID_a2_TID_0c_2" UWORD DFC_OneToOne 1 100 0.00 65535.00 FORMAT "%8.2" ECU_ADDRESS 0x60038668 /end MEASUREMENT
/begin MEASUREMENT DTR_valUpLim.DTR_OBDMID_a2_TID_0c_3 "upper limits (Mode06) / upper limit of diagnostic test result DTR_OBDMID_a2_TID_0c_3" UWORD DFC_OneToOne 1 100 0.00 65535.00 FORMAT "%8.2" ECU_ADDRESS 0x6003866A /end MEASUREMENT
/begin MEASUREMENT Ebs_cntrAcmChrgOvf "Counter for indication of number of times overflow has occured in accumulated battery charge value received from EBS" UWORD OneToOne 1 100 0.00 65535.00 FORMAT "%8.2" ECU_ADDRESS 0x60007BA0 /end MEASUREMENT
/begin MEASUREMENT Ebs_cntrAcmDchaOvf "Counter to indicate overflow in accumulated battery discharge" UWORD OneToOne 1 100 0.00 65535.00 FORMAT "%8.2" ECU_ADDRESS 0x60007B9E /end MEASUREMENT
/begin MEASUREMENT Ebs_cntrBattEbs "Value of EBS counter for internal resistance measurement" UBYTE OneToOne 1 100 0.00 255.0 FORMAT "%5.1" ECU_ADDRESS 0x60036604 /end MEASUREMENT
/begin MEASUREMENT Ebs_cntrIntResUpdPrev "Previous value of the counter for intermal resistance measurement" UBYTE OneToOne 1 100 0.00 255.0 FORMAT "%5.1" ECU_ADDRESS 0x600394C4 /end MEASUREMENT
/begin MEASUREMENT Ebs_cntrSocFlt1 "Counter to indicate number of times SOC fault level 1 is detected" UBYTE OneToOne 1 100 0.00 255.0 FORMAT "%5.1" ECU_ADDRESS 0x6000BA6E /end MEASUREMENT
/begin MEASUREMENT Ebs_cntrSocFlt2 "Counter to indicate number of times SOC fault level 2 is detected" UBYTE OneToOne 1 100 0.00 255.0 FORMAT "%5.1" ECU_ADDRESS 0x6000BA6D /end MEASUREMENT
/begin MEASUREMENT Ebs_facRCorrn "Factor for correction of internal resistance of battery based on battery temperature" SWORD Fact1000 1 100 0.00 2.550000 FORMAT "%8.6" ECU_ADDRESS 0x600091FE /end MEASUREMENT
/begin MEASUREMENT Ebs_flgBliChrgCalcnCmpl "Flag of blind charge calculation is complete" UBYTE B_TRUE 1 100 0.00 1.00000000000 BIT_MASK 0x1 FORMAT "%13.11" ECU_ADDRESS 0x6000F6AB /end MEASUREMENT
/begin MEASUREMENT Ebs_flgRst "EBS after reset" UBYTE B_TRUE 1 100 0.00 1.00000000000 BIT_MASK 0x1 FORMAT "%13.11" ECU_ADDRESS 0x6000F6AA /end MEASUREMENT
/begin MEASUREMENT Ebs_flgSOCFlt "Flag to indicate the IBS SOC error when 1% change or no change in IBS SOC reached the threshold" UBYTE B_TRUE 1 100 0.00 1.00000000000 BIT_MASK 0x1 FORMAT "%13.11" ECU_ADDRESS 0x6000F6A9 /end MEASUREMENT
/begin MEASUREMENT Ebs_flgTestActv "Flag to indicate if SOC plausibility test is active" UBYTE B_TRUE 1 100 0.00 1.00000000000 BIT_MASK 0x1 FORMAT "%13.11" ECU_ADDRESS 0x6000BA6C /end MEASUREMENT
/begin MEASUREMENT Ebs_iBattFild "Sensor value battery current" SWORD Curr_A 1 100 -327.6800 327.6700 FORMAT "%8.4" ECU_ADDRESS 0x600091FA /end MEASUREMENT
/begin MEASUREMENT Ebs_iStbIAft0HrDcyc "The Battery current at transition to LIN off" SWORD i_q0p01_A 1 100 -327.6800 327.6700 FORMAT "%8.4" ARRAY_SIZE 5 ECU_ADDRESS 0x600394A4 /end MEASUREMENT
/begin MEASUREMENT Ebs_qBliChrg "Blind charge by battery" ULONG q0p01_A_h_1 1 100 0.00 42949672.9500 FORMAT "%13.4" ECU_ADDRESS 0x600037B4 /end MEASUREMENT
/begin MEASUREMENT Ebs_qBliDcha "Blind discharge by battery" ULONG q0p01_A_h_1 1 100 0.00 42949672.9500 FORMAT "%13.4" ECU_ADDRESS 0x50004EE8 /end MEASUREMENT
/begin MEASUREMENT Ebs_qBliDchaTot "Total blind discharge current" ULONG q0p01_A_h_1 1 100 0.00 42949672.9500 FORMAT "%13.4" ECU_ADDRESS 0x50004EEC /end MEASUREMENT
/begin MEASUREMENT Ebs_qBliDchaTotDcyc "The total discharge amount for Dark current hystory function" ULONG q0p01_A_h_1 1 100 0.00 42949672.9500 FORMAT "%13.4" ARRAY_SIZE 5 ECU_ADDRESS 0x60039490 /end MEASUREMENT
/begin MEASUREMENT Ebs_qChrgDchaDif "Difference between battery accumulated charge and discharge" ULONG q0p01_A_h_1 1 100 0.00 42949672.9500 FORMAT "%13.4" ECU_ADDRESS 0x50001754 /end MEASUREMENT
/begin MEASUREMENT Ebs_qChrgDurgT15Off "Battery charge level before last ignition off" SLONG q0p01_A_h_1 1 100 -21474836.4800 21474836.4700 FORMAT "%13.4" ECU_ADDRESS 0x600394C0 /end MEASUREMENT
/begin MEASUREMENT Ebs_qChrgDurgT15On "Battery charge level during ignition on" SLONG q0p01_A_h_1 1 100 -21474836.4800 21474836.4700 FORMAT "%13.4" ECU_ADDRESS 0x50001758 /end MEASUREMENT
/begin MEASUREMENT Ebs_qChrgPrev "Previous value of battery charge from EBS" SLONG q0p01_A_h_1 1 100 -21474836.4800 21474836.4700 FORMAT "%13.4" ECU_ADDRESS 0x5000175C /end MEASUREMENT
/begin MEASUREMENT Ebs_qChrgRef "Refernce value of battery charge" SLONG q0p01_A_h_1 1 100 -21474836.4800 21474836.4700 FORMAT "%13.4" ECU_ADDRESS 0x60002FB0 /end MEASUREMENT
/begin MEASUREMENT Ebs_qChrgSum "Accumulated battery charge received from EBS" SLONG q0p01_A_h_1 1 100 -21474836.4800 21474836.4700 FORMAT "%13.4" ECU_ADDRESS 0x60002FAC /end MEASUREMENT
/begin MEASUREMENT Ebs_qDchaDurgT15Off "Battery discharge during last ignition off" SLONG q0p01_A_h_1 1 100 -21474836.4800 21474836.4700 FORMAT "%13.4" ECU_ADDRESS 0x600394BC /end MEASUREMENT
/begin MEASUREMENT Ebs_qDchaDurgT15On "Battery discharge during ignition on" SLONG q0p01_A_h_1 1 100 -21474836.4800 21474836.4700 FORMAT "%13.4" ECU_ADDRESS 0x60002FA8 /end MEASUREMENT
/begin MEASUREMENT Ebs_qDchaPrev "Previous value of accumulated battery discharge" SLONG q0p01_A_h_1 1 100 -21474836.4800 21474836.4700 FORMAT "%13.4" ECU_ADDRESS 0x60002FA4 /end MEASUREMENT
/begin MEASUREMENT Ebs_qDchaRef "Refernce value of accumulated battery discharge" SLONG q0p01_A_h_1 1 100 -21474836.4800 21474836.4700 FORMAT "%13.4" ECU_ADDRESS 0x60002FA0 /end MEASUREMENT
/begin MEASUREMENT Ebs_qDchaSum "Accumulated battery discharge received form EBS" SLONG q0p01_A_h_1 1 100 -21474836.4800 21474836.4700 FORMAT "%13.4" ECU_ADDRESS 0x60002F9C /end MEASUREMENT
/begin MEASUREMENT Ebs_qIntegdICmp "Integrated current value for compensation" SLONG q0p01_A_h_1 1 100 -21474836.4800 21474836.4700 FORMAT "%13.4" ECU_ADDRESS 0x600037E4 /end MEASUREMENT
/begin MEASUREMENT Ebs_qSohFild "Sensor value SOH (State of health)" SWORD ElecChrg_Ah_q0p125_COMPU 1 100 -4096.000 4095.875 FORMAT "%8.3" ECU_ADDRESS 0x600091F8 /end MEASUREMENT
/begin MEASUREMENT Ebs_qSohFildHist "ENV RAM variable which stores the filtered qSoh value from COM" SWORD ElecChrg_Ah_q0p125_COMPU 1 100 -4096.000 4095.875 FORMAT "%8.3" ECU_ADDRESS 0x600394B8 /end MEASUREMENT
/begin MEASUREMENT Ebs_qStbIAft1HrDcyc "The Integrated battery current 1hr after transition to LIN off" SWORD q0p01_A_h_1 1 100 -327.6800 327.6700 FORMAT "%8.4" ARRAY_SIZE 5 ECU_ADDRESS 0x60039486 /end MEASUREMENT
/begin MEASUREMENT Ebs_qStbIAft2HrDcyc "The Integrated battery current 2hr after transition to LIN off" SWORD q0p01_A_h_1 1 100 -327.6800 327.6700 FORMAT "%8.4" ARRAY_SIZE 5 ECU_ADDRESS 0x6003947C /end MEASUREMENT
/begin MEASUREMENT Ebs_qStbILastDcyc "The Integrated battery current during last hour just before transition to LIN ON" SWORD q0p01_A_h_1 1 100 -327.6800 327.6700 FORMAT "%8.4" ARRAY_SIZE 5 ECU_ADDRESS 0x60039472 /end MEASUREMENT
/begin MEASUREMENT Ebs_qTotBliDcha "Total Blind discharge value including negative values" SLONG q0p01_A_h_1 1 100 -21474836.4800 21474836.4700 FORMAT "%13.4" ECU_ADDRESS 0x50004EF0 /end MEASUREMENT
/begin MEASUREMENT Ebs_ratEstimdDeltaSoc "Delts SOC ratio estimated based on accumulated charge and discharge of battery" UWORD RBPtCel_Perc_0p5_1 1 100 0.00 32767.50 FORMAT "%8.2" ECU_ADDRESS 0x60007B9C /end MEASUREMENT
/begin MEASUREMENT Ebs_ratSoc "Battery SOC used for plausibility check" UBYTE RBPtCel_Perc_0p5_1 1 100 0.00 127.5 FORMAT "%5.1" ECU_ADDRESS 0x6000BA6B /end MEASUREMENT
/begin MEASUREMENT Ebs_ratSocFild "Sensor value SOC (State of charge)" UBYTE RBPtCel_Perc_0p5_1 1 100 0.00 127.5 FORMAT "%5.1" ECU_ADDRESS 0x6000F7F7 /end MEASUREMENT
/begin MEASUREMENT Ebs_ratSocFildHist "ENV RAM variable which stores the filtered ratSoc form COM." UBYTE RBPtCel_Perc_0p5_1 1 100 0.00 127.5 FORMAT "%5.1" ECU_ADDRESS 0x600394B6 /end MEASUREMENT
/begin MEASUREMENT Ebs_ratSocHist "History value of SOC ratio from EBS in previous driving cycle" UBYTE RBPtCel_Perc_0p5_1 1 100 0.00 127.5 FORMAT "%5.1" ECU_ADDRESS 0x60039471 /end MEASUREMENT
/begin MEASUREMENT Ebs_ratSohFild "Sensor value SOH (State of health)" SWORD Prc 1 100 0.00 399.9878 FORMAT "%8.4" ECU_ADDRESS 0x600091F0 /end MEASUREMENT
/begin MEASUREMENT Ebs_ratSohFildHist "ENV RAM variable which stores the filtered ratSoh value from COM" SWORD Prc 1 100 -400.0000 399.9878 FORMAT "%8.4" ECU_ADDRESS 0x600394B4 /end MEASUREMENT
/begin MEASUREMENT Ebs_rBatt "Average battery resistance over driving cycles" SWORD RBPtCel_r_0p00001_1 1 100 -0.3276800 0.3276700 FORMAT "%9.7" ECU_ADDRESS 0x600091F6 /end MEASUREMENT
/begin MEASUREMENT Ebs_rBattAct "Inner resistance of battery" SWORD RBPtCel_r_0p00001_1 1 100 -0.3276800 0.3276700 FORMAT "%9.7" ECU_ADDRESS 0x600091F4 /end MEASUREMENT
/begin MEASUREMENT Ebs_rBattActSum "Sum of battery resistance measured" SLONG RBPtCel_r_0p00001_1 1 100 -21474.8364800 21474.8364700 FORMAT "%13.7" ECU_ADDRESS 0x60036600 /end MEASUREMENT
/begin MEASUREMENT Ebs_rBattMeasd "Battery resistance measured by EBS" SWORD RBPtCel_r_0p00001_1 1 100 -0.3276800 0.3276700 FORMAT "%9.7" ECU_ADDRESS 0x600091F2 /end MEASUREMENT
/begin MEASUREMENT Ebs_stBattInvld "Battery temperature invalid due to EBS reset" UBYTE B_TRUE 1 100 0.00 1.00000000000 BIT_MASK 0x1 FORMAT "%13.11" ECU_ADDRESS 0x6000F6A8 /end MEASUREMENT
/begin MEASUREMENT Ebs_stBattRVld "Status of valid measurement of battery internal resistance" UBYTE B_TRUE 1 100 0.00 1.00000000000 BIT_MASK 0x1 FORMAT "%13.11" ECU_ADDRESS 0x6000F6A7 /end MEASUREMENT
/begin MEASUREMENT Ebs_stBattTempInvld "Status to indicate if battery temperature is invalid" UBYTE B_TRUE 1 100 0.00 1.00000000000 BIT_MASK 0x1 FORMAT "%13.11" ECU_ADDRESS 0x600365FD /end MEASUREMENT
/begin MEASUREMENT Ebs_stChkSocPlausy1 "Status of check for SOC plausibility check 1" UBYTE OneToOne 1 100 0.00 255.0 FORMAT "%5.1" ECU_ADDRESS 0x6000BA6A /end MEASUREMENT
/begin MEASUREMENT Ebs_stChkSocPlausy2 "Status of check for SOC plausibility check 2" UBYTE OneToOne 1 100 0.00 255.0 FORMAT "%5.1" ECU_ADDRESS 0x6000BA69 /end MEASUREMENT
/begin MEASUREMENT Ebs_stEbsPlausyChk "Status of EBS plausibility checks" UBYTE B_TRUE 1 100 0.00 1.00000000000 BIT_MASK 0x1 FORMAT "%13.11" ECU_ADDRESS 0x6000F6A6 /end MEASUREMENT
/begin MEASUREMENT Ebs_stEngSt "Status of transition of engine state" UBYTE B_TRUE 1 100 0.00 1.00000000000 BIT_MASK 0x1 FORMAT "%13.11" ECU_ADDRESS 0x6000BA68 /end MEASUREMENT
/begin MEASUREMENT Ebs_stErr "Sensor values not valid (Initialisation, communication fault, measurement error)" UBYTE OneToOne 1 100 0.00 255.0 FORMAT "%5.1" ECU_ADDRESS 0x6000F7F6 /end MEASUREMENT
/begin MEASUREMENT Ebs_stIMonUpdEna "Status active IMON operation" UBYTE B_TRUE 1 100 0.00 1.00000000000 BIT_MASK 0x1 FORMAT "%13.11" ECU_ADDRESS 0x600365FC /end MEASUREMENT
/begin MEASUREMENT Ebs_stIMonUp_MP "Measurement point status IMON enable" UBYTE B_TRUE 1 100 0.00 1.00000000000 BIT_MASK 0x1 FORMAT "%13.11" ECU_ADDRESS 0x7000A2E4 /end MEASUREMENT
/begin MEASUREMENT Ebs_stRErr_MP "Status of error in battery resistance signal received from EBS" UBYTE B_TRUE 1 100 0.00 1.00000000000 BIT_MASK 0x1 FORMAT "%13.11" ECU_ADDRESS 0x7000A2E3 /end MEASUREMENT
/begin MEASUREMENT Ebs_stRInhbSpst "Inhibit Stop-Start functionality" UBYTE B_TRUE 1 100 0.00 1.00000000000 BIT_MASK 0x1 FORMAT "%13.11" ECU_ADDRESS 0x6000F6A5 /end MEASUREMENT
/begin MEASUREMENT Ebs_stRMsrmnt_MP "Status of error in measurement of battery resistance" UBYTE B_TRUE 1 100 0.00 1.00000000000 BIT_MASK 0x1 FORMAT "%13.11" ECU_ADDRESS 0x7000A2E2 /end MEASUREMENT
/begin MEASUREMENT Ebs_stRSumOvf "Overflow check for total battery resistance" UBYTE B_TRUE 1 100 0.00 1.00000000000 BIT_MASK 0x1 FORMAT "%13.11" ECU_ADDRESS 0x6000BA67 /end MEASUREMENT
/begin MEASUREMENT Ebs_stSelfDiagErrEna "Status of EBS self-diagnosis error" UBYTE B_TRUE 1 100 0.00 1.00000000000 BIT_MASK 0x1 FORMAT "%13.11" ECU_ADDRESS 0x6000F6A4 /end MEASUREMENT
/begin MEASUREMENT Ebs_stSocErrChk "Status of SOC error check" UBYTE OneToOne 1 100 0.00 255.0 FORMAT "%5.1" ECU_ADDRESS 0x600365F5 /end MEASUREMENT
/begin MEASUREMENT Ebs_stStbIEBSByt0 "EBSD Byte 0 Raw value for dark current hystory function" UBYTE OneToOne 1 100 0.00 255.0 FORMAT "%5.1" ARRAY_SIZE 5 ECU_ADDRESS 0x6003946C /end MEASUREMENT
/begin MEASUREMENT Ebs_stStbIEBSByt1 "EBSD Byte 1 Raw value for dark current hystory function" UBYTE OneToOne 1 100 0.00 255.0 FORMAT "%5.1" ARRAY_SIZE 5 ECU_ADDRESS 0x60039467 /end MEASUREMENT
/begin MEASUREMENT Ebs_stStbIEBSByt2 "EBSD Byte 2 Raw value for dark current hystory function" UBYTE OneToOne 1 100 0.00 255.0 FORMAT "%5.1" ARRAY_SIZE 5 ECU_ADDRESS 0x60039462 /end MEASUREMENT
/begin MEASUREMENT Ebs_stStbIEBSByt3 "EBSD Byte 3 Raw value for dark current hystory function" UBYTE OneToOne 1 100 0.00 255.0 FORMAT "%5.1" ARRAY_SIZE 5 ECU_ADDRESS 0x6003945D /end MEASUREMENT
/begin MEASUREMENT Ebs_stStbIEBSByt4 "EBSD Byte 4 Raw value for dark current hystory function" UBYTE OneToOne 1 100 0.00 255.0 FORMAT "%5.1" ARRAY_SIZE 5 ECU_ADDRESS 0x60039458 /end MEASUREMENT
/begin MEASUREMENT Ebs_stStrtRMsrmnt "Start of battery resistance measurement" UBYTE B_TRUE 1 100 0.00 1.00000000000 BIT_MASK 0x1 FORMAT "%13.11" ECU_ADDRESS 0x6000BA66 /end MEASUREMENT
/begin MEASUREMENT Ebs_stStrtTmrCond "Status of condition to start timer for resistance measurement" UBYTE B_TRUE 1 100 0.00 1.00000000000 BIT_MASK 0x1 FORMAT "%13.11" ECU_ADDRESS 0x70000339 /end MEASUREMENT
/begin MEASUREMENT Ebs_stT50 "Status of key-start detection" UBYTE B_TRUE 1 100 0.00 1.00000000000 BIT_MASK 0x1 FORMAT "%13.11" ECU_ADDRESS 0x6003568A /end MEASUREMENT
/begin MEASUREMENT Ebs_tBattFild "Temperature from battery sensor after modeling" SWORD SCR_TEMP_CELS_float 1 100 -32768.00 32767.00 FORMAT "%8.2" ECU_ADDRESS 0x600091EE /end MEASUREMENT
/begin MEASUREMENT Ebs_tiAftBattSnsrRst "Time after reset of battery sensor" SLONG Time_s 1 100 0.00 21474836.4700 FORMAT "%13.4" ECU_ADDRESS 0x600365F8 /end MEASUREMENT
/begin MEASUREMENT Ebs_tiDurnAftIgnOffDcyc "IG-OFF duration for Dark current hystory function" SLONG Time_Hr 1 100 -1073741824.00 1073741823.50 FORMAT "%13.2" ARRAY_SIZE 5 ECU_ADDRESS 0x60039444 /end MEASUREMENT
/begin MEASUREMENT Ebs_tiElpdSnceBattSnsrRst "Time elapsed since reset of battery sensor" SLONG Time_s 1 100 0.00 21474836.4700 FORMAT "%13.4" ECU_ADDRESS 0x600394B0 /end MEASUREMENT
/begin MEASUREMENT Ebs_tiT15OnDly "Turn ON delay time of T15_st to evaluate battery sensor diagnosis" UWORD Time_s 1 100 0.00 655.3500 FORMAT "%8.4" ECU_ADDRESS 0x60008F68 /end MEASUREMENT
/begin MEASUREMENT Ebs_uBattFild "Sensor value battery voltage" SWORD U_mV_q0p9765625_COMPU 1 100 -32000.00 31999.02 FORMAT "%8.2" ECU_ADDRESS 0x600091EC /end MEASUREMENT
/begin MEASUREMENT Ebs_uSofFild "Estimated supply voltage drop while cranking" SWORD spg_q0p0625_V 1 100 -2048.000 2047.938 FORMAT "%8.3" ECU_ADDRESS 0x600091EA /end MEASUREMENT
/begin MEASUREMENT EngStrt_ctReIniDsttiDrvEnter "Local Counter for tracking the entering os system state from PRE or POST DRIVE to DRIVE in DSTTI" UBYTE OneToOne 1 100 0.00 255.0 FORMAT "%5.1" ECU_ADDRESS 0x6000BA74 /end MEASUREMENT
/begin MEASUREMENT fbIntkActrErrDebSpcl11 "Feedback error debounce level for special lift actuator 11" ULONG OneToOne 1 100 0.00 65535.0000000 FORMAT "%13.7" ECU_ADDRESS 0x600004A4 /end MEASUREMENT
/begin MEASUREMENT fbIntkActrErrDebStd11 "Feedback error debounce level for standard lift actuator 11" ULONG OneToOne 1 100 0.00 65535.0000000 FORMAT "%13.7" ECU_ADDRESS 0x50000570 /end MEASUREMENT
/begin MEASUREMENT fbIntkActrErrIntDebSpcl11 "Feedback error signal from Internal debounce method for Intake Switch 11 in Special lift." UBYTE B_TRUE 1 100 0.00 1.00000000000 BIT_MASK 0x1 FORMAT "%13.11" ECU_ADDRESS 0x6000099C /end MEASUREMENT
/begin MEASUREMENT fbIntkActrErrIntDebStd11 "Feedback error signal from Internal debounce method for Intake Switch 11 in Standard lift." UBYTE B_TRUE 1 100 0.00 1.00000000000 BIT_MASK 0x1 FORMAT "%13.11" ECU_ADDRESS 0x6000099D /end MEASUREMENT
/begin MEASUREMENT sttime_w_msg "time from start request to end of start" UWORD t10msxs_uw_b655p35 1 100 0.00 655.3500 FORMAT "%8.4" ECU_ADDRESS 0x600092C2 /end MEASUREMENT
/begin MEASUREMENT tiSpclIntk11 "transition time since special switch request for intake actuator 11" UWORD dez 1 100 0.00 65535.00 FORMAT "%8.2" ECU_ADDRESS 0x60000612 /end MEASUREMENT
/begin MEASUREMENT tiStdIntk11 "transition time since standard switch request for intake actuator 11" UWORD dez 1 100 0.00 65535.00 FORMAT "%8.2" ECU_ADDRESS 0x60000614 /end MEASUREMENT
/begin MEASUREMENT Vlvlft_flgBdeseeloc "Local variable for Diagnosis power stage: entry conditions fulfilled" UBYTE B_TRUE 1 100 0.00 1.00000000000 BIT_MASK 0x1 FORMAT "%13.11" ECU_ADDRESS 0x6000BA71 /end MEASUREMENT
/begin MEASUREMENT Vlvlft_flgDSMClr "DSM Clear flag for Valvelift" UBYTE B_TRUE 1 100 0.00 1.00000000000 BIT_MASK 0x1 FORMAT "%13.11" ECU_ADDRESS 0x6000BA70 /end MEASUREMENT
/begin MEASUREMENT VlvLft_flgDSMFbSwtIntk11SpclVisible "DSM visibility check for Intake VTEC feedback switch diagnosis for actuator 11 Special lift" UBYTE B_TRUE 1 100 0.00 1.00000000000 BIT_MASK 0x1 FORMAT "%13.11" ECU_ADDRESS 0x70003094 /end MEASUREMENT
/begin MEASUREMENT VlvLft_flgDSMFbSwtIntk11StdVisible "DSM visibility check for Intake VTEC feedback switch diagnosis for actuator 11 Standard lift" UBYTE B_TRUE 1 100 0.00 1.00000000000 BIT_MASK 0x1 FORMAT "%13.11" ECU_ADDRESS 0x70003093 /end MEASUREMENT
/begin MEASUREMENT Vlvlft_flgfbIntkSpcl11Fail "Feedback signal fail for Intake Special Lift Actuator 1" UBYTE B_TRUE 1 100 0.00 1.00000000000 BIT_MASK 0x1 FORMAT "%13.11" ECU_ADDRESS 0x70003092 /end MEASUREMENT
/begin MEASUREMENT Vlvlft_flgfbIntkSpcl11Suc "Feedback signal Success for Intake Special Lift Actuator 1" UBYTE B_TRUE 1 100 0.00 1.00000000000 BIT_MASK 0x1 FORMAT "%13.11" ECU_ADDRESS 0x70003091 /end MEASUREMENT
/begin MEASUREMENT Vlvlft_flgfbIntkStd11Fail "Feedback signal fail for Intake Standard Lift Actuator 1" UBYTE B_TRUE 1 100 0.00 1.00000000000 BIT_MASK 0x1 FORMAT "%13.11" ECU_ADDRESS 0x70003090 /end MEASUREMENT
/begin MEASUREMENT Vlvlft_flgfbIntkStd11Suc "Feedback signal Success for Intake Standard Lift Actuator 1" UBYTE B_TRUE 1 100 0.00 1.00000000000 BIT_MASK 0x1 FORMAT "%13.11" ECU_ADDRESS 0x7000308F /end MEASUREMENT
/begin MEASUREMENT Vlvlft_flgIntkDebEnaSpcl11 "Debouncing Enabled Flag for Intake Specail lift Actuator 1" UBYTE B_TRUE 1 100 0.00 1.00000000000 BIT_MASK 0x1 FORMAT "%13.11" ECU_ADDRESS 0x7000308E /end MEASUREMENT
/begin MEASUREMENT Vlvlft_flgIntkDebEnaStd11 "Debouncing Enabled Flag for Intake Standard lift Actuator 1" UBYTE B_TRUE 1 100 0.00 1.00000000000 BIT_MASK 0x1 FORMAT "%13.11" ECU_ADDRESS 0x7000308D /end MEASUREMENT
/begin MEASUREMENT VlvLft_flgIntkFbSwt11SpclLftDtrRels "DTR updation release flag for Intake VTEC feedback switch diagnosis for actuator 11 Special Lift" UBYTE B_TRUE 1 100 0.00 1.00000000000 BIT_MASK 0x1 FORMAT "%13.11" ECU_ADDRESS 0x7000308C /end MEASUREMENT
/begin MEASUREMENT VlvLft_flgIntkFbSwt11StdLftDtrRels "DTR updation release flag for Intake VTEC feedback switch diagnosis for actuator 11 Standard Lift" UBYTE B_TRUE 1 100 0.00 1.00000000000 BIT_MASK 0x1 FORMAT "%13.11" ECU_ADDRESS 0x7000308B /end MEASUREMENT
/begin MEASUREMENT VlvLft_flgIntkSwt11SpclLftDfctEntry "Defect reported in the current driving cycle for Intake VTEC feedback switch diagnosis for actuator 11 Special Lift" UBYTE B_TRUE 1 100 0.00 1.00000000000 BIT_MASK 0x1 FORMAT "%13.11" ECU_ADDRESS 0x7000308A /end MEASUREMENT
/begin MEASUREMENT VlvLft_flgIntkSwt11StdLftDfctEntry "Defect reported in the current driving cycle for Intake VTEC feedback switch diagnosis for actuator 11 Standard Lift" UBYTE B_TRUE 1 100 0.00 1.00000000000 BIT_MASK 0x1 FORMAT "%13.11" ECU_ADDRESS 0x70003089 /end MEASUREMENT
/begin MEASUREMENT VlvLft_flgSwtExh11DiagNumRel "DIUMPR numerator release condition for exhaust valve 11" UBYTE dez 1 100 0.00 255.0 FORMAT "%5.1" ECU_ADDRESS 0x6000090D /end MEASUREMENT
/begin MEASUREMENT VlvLft_flgSwtIntk11DiagNumRel "DIUMPR numerator release condition for intake valve 11" UBYTE dez 1 100 0.00 255.0 FORMAT "%5.1" ECU_ADDRESS 0x6000090E /end MEASUREMENT
/begin MEASUREMENT VlvLft_stFbSnsrDiagEnaIntk "Sensor diagnosis enabled flag for Intake" UBYTE B_TRUE 1 100 0.00 1.00000000000 BIT_MASK 0x1 FORMAT "%13.11" ECU_ADDRESS 0x70003088 /end MEASUREMENT
/begin MEASUREMENT Vlvlft_stPsDiagEna "Codeword for enabling the powerstage diagnosis for Valvelift" UBYTE B_TRUE 1 100 0.00 1.00000000000 BIT_MASK 0x1 FORMAT "%13.11" ECU_ADDRESS 0x6000BA6F /end MEASUREMENT
/begin MEASUREMENT zllimtst "counter wrong starts" UBYTE dez 1 100 0.00 255.0 FORMAT "%5.1" ECU_ADDRESS 0x6000BA73 /end MEASUREMENT
/begin MEASUREMENT zllimtstok "counter good starts" UBYTE dez 1 100 0.00 255.0 FORMAT "%5.1" ECU_ADDRESS 0x6000BA72 /end MEASUREMENT
/begin FUNCTION DSM_Conf "30164.6.0 DSM Kernel configuration"
 /begin DEF_CHARACTERISTIC DFES_MeterOut.DFC_MOXEMM_SMU_ALM6_12_C DFES_MeterOut.DFC_MOXEMM_SMU_ALM6_14_C DFES_MeterOut.DFC_MOXEMM_SMU_ALM6_15_C DFES_MeterOut.DFC_MOXEMM_SMU_ALM6_17_C DFES_MeterOut.DFC_MOXEMM_SMU_ALM6_18_C DFES_MeterOut.DFC_MOXEMM_SMU_ALM6_20_C DFES_MeterOut.DFC_MOXEMM_SMU_ALM6_21_C DFES_MeterOut.DFC_MOXEMM_SMU_ALM6_25_C DFES_MeterOut.DFC_MOXEMM_SMU_ALM6_4_C DFES_MeterOut.DFC_MOXEMM_SMU_ALM6_5_C DFES_MeterOut.DFC_MOXEMM_SMU_ALM6_7_C DFES_MeterOut.DFC_MOXEMM_SMU_ALM6_8_C DFES_MeterOut.DFC_MOXEMM_SMU_ALM7_1_C DFES_MeterOut.DFC_MOXEMM_SMU_ALM7_12_C DFES_MeterOut.DFC_MOXEMM_SMU_ALM7_13_C DFES_MeterOut.DFC_MOXEMM_SMU_ALM7_14_C DFES_MeterOut.DFC_MOXEMM_SMU_ALM7_15_C DFES_MeterOut.DFC_MOXEMM_SMU_ALM7_16_C DFES_MeterOut.DFC_MOXEMM_SMU_ALM7_17_C DFES_MeterOut.DFC_MOXEMM_SMU_ALM7_2_C DFES_MeterOut.DFC_MOXEMM_SMU_ALM7_20_C DFES_MeterOut.DFC_MOXEMM_SMU_ALM7_25_C DFES_MeterOut.DFC_MOXEMM_SMU_ALM7_26_C DFES_MeterOut.DFC_MOXEMM_SMU_ALM7_28_C DFES_MeterOut.DFC_MOXEMM_SMU_ALM7_29_C DFES_MeterOut.DFC_MOXEMM_SMU_ALM7_30_C DFES_MeterOut.DFC_MOXEMM_SMU_ALM7_31_C DFES_MeterOut.DFC_MOXEMM_SMU_ALM8_0_C DFES_MeterOut.DFC_MOXEMM_SMU_ALM8_1_C DFES_MeterOut.DFC_MOXEMM_SMU_ALM8_10_C DFES_MeterOut.DFC_MOXEMM_SMU_ALM8_11_C DFES_MeterOut.DFC_MOXEMM_SMU_ALM8_12_C DFES_MeterOut.DFC_MOXEMM_SMU_ALM8_16_C DFES_MeterOut.DFC_MOXEMM_SMU_ALM8_18_C DFES_MeterOut.DFC_MOXEMM_SMU_ALM8_2_C DFES_MeterOut.DFC_MOXEMM_SMU_ALM8_3_C DFES_MeterOut.DFC_MOXEMM_SMU_ALM8_31_C DFES_MeterOut.DFC_MOXEMM_SMU_ALM8_4_C DFES_MeterOut.DFC_MOXEMM_SMU_ALM9_0_C DFES_MeterOut.DFC_MOXEMM_SMU_ALM9_15_C DFES_MeterOut.DFC_MOXEMM_SMU_ALM9_3_C DFES_MeterOut.DFC_MoCADCNTP_C DFES_MeterOut.DFC_MoCADCTst_C DFES_MeterOut.DFC_MoCSOPICO_C DFES_MeterOut.DFC_MoFAPP_C DFES_MeterOut.DFC_MoFAirFilgPrdc_C DFES_MeterOut.DFC_MoFAirFlCtOffGdi_C DFES_MeterOut.DFC_MoFAirFlCylGdi_C DFES_MeterOut.DFC_MoFAirFlFF_C DFES_MeterOut.DFC_MoFAirFlIn_C DFES_MeterOut.DFC_MoFAirFlMixCtlGdiChkAirFl_C DFES_MeterOut.DFC_MoFAirFlMixCtlGdiChkCtrl_C DFES_MeterOut.DFC_MoFAirFlMode_C DFES_MeterOut.DFC_MoFESpd_C DFES_MeterOut.DFC_MoFIACo_C DFES_MeterOut.DFC_MoFICOL1_C DFES_MeterOut.DFC_MoFICOL2_C DFES_MeterOut.DFC_MoFStrt_C DFES_MeterOut.DFC_MoFTrqCmp_C DFES_MeterOut.DFC_MoFTrqCmpMax_C DFES_MeterOut.DFC_MoFTrqCmpMin_C DFES_MeterOut.DFC_MoFVarPostBldSel_C DFES_MeterOut.DFC_MoXEMMHwLTMCUFW_C DFES_MeterOut.DFC_MoXEMMHwLTMonBIST_C DFES_MeterOut.DFC_MoXEMMHwLTRegMonTest_C DFES_MeterOut.DFC_MoXEMMHwLTStbySMUAlvTest_C DFES_MeterOut.DFC_MoXEMMHwLTTempSens_C DFES_MeterOut.DFC_MoXEMMHwLTUCBCfg_C DFES_MeterOut.DFC_NWSEmax_C DFES_MeterOut.DFC_NWSmax_C DFES_MeterOut.DFC_OCWDAABEActv_C DFES_MeterOut.DFC_OCWDACom_C DFES_MeterOut.DFC_OCWDAErrPin_C DFES_MeterOut.DFC_OCWDAOvrVltg_C DFES_MeterOut.DFC_ORAmax_C DFES_MeterOut.DFC_ORAmin_C DFES_MeterOut.DFC_OilPPlaus_C DFES_MeterOut.DFC_PLLSUmax_C DFES_MeterOut.DFC_PLLSUmin_C DFES_MeterOut.DFC_PSR1max_C DFES_MeterOut.DFC_PSRBmax_C DFES_MeterOut.DFC_PSRBmin_C DFES_MeterOut.DFC_PSRPmax_C DFES_MeterOut.DFC_PSRPmin_C DFES_MeterOut.DFC_PSRPsig_C DFES_MeterOut.DFC_PSRmax_C DFES_MeterOut.DFC_PUmax_C DFES_MeterOut.DFC_P_VSE11_OL_C DFES_MeterOut.DFC_P_VSE11_SCB_C DFES_MeterOut.DFC_P_VSE11_SCG_C DFES_MeterOut.DFC_PhyHighAPP1_C DFES_MeterOut.DFC_PhyHighAPP2_C DFES_MeterOut.DFC_PhyLowAPP1_C DFES_MeterOut.DFC_PhyLowAPP2_C DFES_MeterOut.DFC_SRCHighAPP1_C DFES_MeterOut.DFC_SRCHighAPP2_C DFES_MeterOut.DFC_SRCLowAPP1_C DFES_MeterOut.DFC_SRCLowAPP2_C DFES_MeterOut.DFC_SSpMon2_C DFES_MeterOut.DFC_STHDRmax_C DFES_MeterOut.DFC_SWReset_0_C DFES_MeterOut.DFC_SWReset_1_C DFES_MeterOut.DFC_SWReset_2_C DFES_MeterOut.DFC_SyncAPP_C DFES_MeterOut.DFC_TANKLnpl_C DFES_MeterOut.DFC_TAmax_Dummy_C DFES_MeterOut.DFC_TESFmax_C DFES_MeterOut.DFC_TESGmax_C DFES_MeterOut.DFC_TKAEmax_C DFES_MeterOut.DFC_TKAEmin_C DFES_MeterOut.DFC_TKARmax_C DFES_MeterOut.DFC_TKARnpl_C DFES_MeterOut.DFC_TMmax_Dummy_C DFES_MeterOut.DFC_TUMmax_Dummy_C DFES_MeterOut.DFC_TWCDPriCatB1_C DFES_MeterOut.DFC_ThrVlvClsdPosnFirstOffsLrnImpoB1_C DFES_MeterOut.DFC_ThrVlvClsdPosnOffsLrnImpoB1_C DFES_MeterOut.DFC_ThrVlvClsdPosnOffsLrnMaxB1_C DFES_MeterOut.DFC_ThrVlvClsdPosnOffsLrnMinB1_C DFES_MeterOut.DFC_ThrVlvCtrlDeB1_C DFES_MeterOut.DFC_ThrVlvDycB1_C DFES_MeterOut.DFC_ThrVlvLimpAirPosnMaxAbsltDriftB1_C DFES_MeterOut.DFC_ThrVlvLimpAirPosnMaxB1_C DFES_MeterOut.DFC_ThrVlvLimpAirPosnMaxRelDriftB1_C DFES_MeterOut.DFC_ThrVlvLimpAirPosnMinB1_C DFES_MeterOut.DFC_ThrVlvOpenLoadB1_C DFES_MeterOut.DFC_ThrVlvOpenSprgB1_C DFES_MeterOut.DFC_ThrVlvOpenSprgSprdB1_C DFES_MeterOut.DFC_ThrVlvOpenSprgTwnB1_C DFES_MeterOut.DFC_ThrVlvOverTB1_C DFES_MeterOut.DFC_ThrVlvRetSprgB1_C DFES_MeterOut.DFC_ThrVlvRetSprgSprdB1_C DFES_MeterOut.DFC_ThrVlvRetSprgTwnB1_C DFES_MeterOut.DFC_ThrVlvSens1MaxB1_C DFES_MeterOut.DFC_ThrVlvSens1NplB1_C DFES_MeterOut.DFC_ThrVlvSens2MaxB1_C DFES_MeterOut.DFC_ThrVlvSens2MinB1_C DFES_MeterOut.DFC_ThrVlvSens2NplB1_C DFES_MeterOut.DFC_ThrVlvShoCircB1_C DFES_MeterOut.DFC_ThrVlvSpiErrB1_C DFES_MeterOut.DFC_ThrvlvSens1MinB1_C DFES_MeterOut.DFC_TiOffTBasdChkFast_C DFES_MeterOut.DFC_TiOffTBasdChkSlow_C DFES_MeterOut.DFC_UEGOSnsrMntdS1B1_C DFES_MeterOut.DFC_VehVSig_C DFES_MeterOut.DFC_VlvLftFbSwtIntk11SpclFail_C DFES_MeterOut.DFC_VlvLftFbSwtIntk11StdFail_C DSM_uDisblBattHiHysL_C DSM_uDisblBattHiHysR_C DSM_uDisblBattLoHysL_C DSM_uDisblBattLoHysR_C /end DEF_CHARACTERISTIC
 FUNCTION_VERSION "30164.6.0" /end FUNCTION
/begin FUNCTION DSM_DTRCompu "1.25.0    DSM DTR computation methods" FUNCTION_VERSION "1.25.0" /end FUNCTION
/begin FUNCTION DsplECU_META "8.8.0     Reception process for the CAN frame META"
 /begin DEF_CHARACTERISTIC Com_dMETAMaxDiff_C Com_dMETAMaxPer_C Com_dMETASigSel_C Com_numCsumMETA_C Com_swtMETAMonEna_C /end DEF_CHARACTERISTIC
 /begin REF_CHARACTERISTIC Com_swtFlLvlMonEna_C /end REF_CHARACTERISTIC
 /begin IN_MEASUREMENT Com_ctCRingMETA Com_flgEngAwkReq Com_numCsumMETA Com_stBCANReprogm Com_stFrmRxEna Com_stMon Com_stMonitor Com_stPrkgBrkSw Com_uFlLvlRaw Dspl_stCrsMaiSwtInfo I14229_stShipModActv SyC_ctPostDrvLeave T15_st /end IN_MEASUREMENT
 /begin OUT_MEASUREMENT B_fstcanok Com_stMETAFrstRx Com_stMonMETA /end OUT_MEASUREMENT
 /begin LOC_MEASUREMENT Com_ctReIni10msMETA DsplECU_ctMETARngCnt_MP /end LOC_MEASUREMENT
 FUNCTION_VERSION "8.8.0" /end FUNCTION
/begin FUNCTION DsplECU_METC "10.4.0    Reception process for the CAN frame METC"
 /begin DEF_CHARACTERISTIC Com_dMETCMaxDiff_C Com_dMETCMaxPer_C Com_dMETCSigSel_C Com_tOutd_C /end DEF_CHARACTERISTIC
 /begin IN_MEASUREMENT Com_ctCRingMETC Com_numCsumMETC Com_stFrmRxEna Com_stFrtFog Com_stMon Com_stRrFog Com_stWiprMETC Com_tOutd /end IN_MEASUREMENT
 /begin OUT_MEASUREMENT Com_tMETCEnvTRaw /end OUT_MEASUREMENT
 /begin LOC_MEASUREMENT DsplECU_ctMETCRngCnt_MP /end LOC_MEASUREMENT
 FUNCTION_VERSION "10.4.0" /end FUNCTION
/begin FUNCTION DsplECU_METD "9.6.0     CAN messages of the Display ECU (METD)"
 /begin DEF_CHARACTERISTIC Com_dMETDMaxDiff_C Com_dMETDMaxPer_C Com_numCsumMETD_C Com_stECON_C Com_swtMETDMonFrmSel_C Com_tiISSPrms_C /end DEF_CHARACTERISTIC
 /begin IN_MEASUREMENT Com_ctCRingMETD Com_numCsumMETD Com_stECON Com_stFrmRxEna Com_stISSInhbnSwt Com_stMon Com_stSwISInhbSts Com_tiISSPrms Com_tMtrEvaMETD /end IN_MEASUREMENT
 /begin OUT_MEASUREMENT Com_stMETDCanErr /end OUT_MEASUREMENT
 /begin LOC_MEASUREMENT DsplECU_ctMETDRngCnt_MP /end LOC_MEASUREMENT
 FUNCTION_VERSION "9.6.0" /end FUNCTION
/begin FUNCTION DsplECU_METE2 "6.4.0     CAN messages of the Display ECU (METE2)"
 /begin DEF_CHARACTERISTIC Com_ctCRingMETE2_C Com_dMETE2MaxDiff_C Com_dMETE2MaxPer_C Com_dMETE2SigSel_C Com_numCsumMETE2_C Com_tAirInsdCbn_C Com_tMETE2AirOutside_C /end DEF_CHARACTERISTIC
 /begin IN_MEASUREMENT Com_ctCRingMETE2 Com_numCsumMETE2 Com_stAirCdnr Com_stFrmRxEna Com_stMETE2ACISSInhbReq Com_stMETE2FrntDfrstSwtInfo Com_stMon Com_tAirInsdCbn Com_tMETE2AirOutside /end IN_MEASUREMENT
 /begin OUT_MEASUREMENT Com_tMETEEnvTRaw /end OUT_MEASUREMENT
 /begin LOC_MEASUREMENT DsplECU_ctMETE2RngCnt_MP /end LOC_MEASUREMENT
 FUNCTION_VERSION "6.4.0" /end FUNCTION
/begin FUNCTION DsplECU_METF "6.6.0     CAN messages of the Display ECU (METF)"
 /begin DEF_CHARACTERISTIC Com_bDigMtrUnit_C Com_dMETFMaxDiff_C Com_dMETFMaxPer_C Com_dMETFSigSel_C Com_numCsumMETF_C Com_stTarSpdDisp_C Com_swtMETFMonEna_C Com_vAnaVeh_C Com_vDigVehRaw_C Com_vDigVeh_C /end DEF_CHARACTERISTIC
 /begin IN_MEASUREMENT Com_bDigMtrUnit Com_ctCRingMETF Com_flgVehSpdLimrDisp Com_numCsumMETF Com_stFrmRxEna Com_stMon Com_stTarSpdDisp Com_vAnaVeh Com_vDigVeh Com_vDigVehRaw SyC_ctPostDrvLeave T15_st /end IN_MEASUREMENT
 /begin OUT_MEASUREMENT Com_ctReIni10msMETF Com_stMonMETF Com_vDigVehKmph Com_vDigVehMph /end OUT_MEASUREMENT
 /begin LOC_MEASUREMENT DsplECU_ctMETFRngCnt_MP /end LOC_MEASUREMENT
 FUNCTION_VERSION "6.6.0" /end FUNCTION
/begin FUNCTION DsplECU_METG "7.5.0     CAN messages of the Display ECU (METG)"
 /begin DEF_CHARACTERISTIC Com_ctCRingMETG_C Com_dMETGMaxDiff_C Com_dMETGMaxPer_C Com_numCsumMETG_C Com_stACCut_C Com_swtMETGFrmTypSel_C /end DEF_CHARACTERISTIC
 /begin IN_MEASUREMENT Com_ctCRingMETG Com_numCsumMETG Com_stACCut Com_stACMETG Com_stEngHoodOpn Com_stFrmRxEna Com_stICUHoodErr Com_stKlsDoorLck Com_stMon SyC_ctPostDrvLeave T15_st /end IN_MEASUREMENT
 /begin OUT_MEASUREMENT Com_ctReIni10msMETG /end OUT_MEASUREMENT
 /begin LOC_MEASUREMENT DsplECU_ctMETGRngCnt_MP /end LOC_MEASUREMENT
 FUNCTION_VERSION "7.5.0" /end FUNCTION
/begin FUNCTION DsplECU_METH "6.3.0     CAN messages of the Display ECU (METH)"
 /begin DEF_CHARACTERISTIC Com_dMETHMaxDiff_C Com_dMETHMaxPer_C Com_numCsumMETH_C Com_swtMETHMonEna_C /end DEF_CHARACTERISTIC
 /begin IN_MEASUREMENT Com_ctCRingMETH Com_iACCmprHiByte Com_iACCmprLoByte Com_numCsumMETH Com_stFrmRxEna Com_stMon /end IN_MEASUREMENT
 /begin OUT_MEASUREMENT Com_iACCmpr Com_stMonMETH /end OUT_MEASUREMENT
 /begin LOC_MEASUREMENT DsplECU_ctMETHRngCnt_MP /end LOC_MEASUREMENT
 FUNCTION_VERSION "6.3.0" /end FUNCTION
/begin FUNCTION DsplECU_METH2 "5.4.0     CAN messages of the Display ECU (METH)"
 /begin DEF_CHARACTERISTIC Com_ctCRingMETH2_C Com_dMETH2MaxDiff_C Com_dMETH2MaxPer_C Com_dMETH2SigSel_C Com_nrActPtcActv_C Com_numCsumMETH2_C Com_stACGUpReq_C Com_tACAirTOut_C /end DEF_CHARACTERISTIC
 /begin IN_MEASUREMENT Com_ctCRingMETH2 Com_nrActPtcActv Com_numCsumMETH2 Com_stACGUpReq Com_stFrmRxEna Com_stMon Com_tACAirTOut /end IN_MEASUREMENT
 /begin LOC_MEASUREMENT DsplECU_ctMETH2RngCnt_MP /end LOC_MEASUREMENT
 FUNCTION_VERSION "5.4.0" /end FUNCTION
/begin FUNCTION DsplECU_METI "6.4.0     CAN messages of the Display ECU (METI)" /begin DEF_CHARACTERISTIC Com_dMETIMaxDiff_C Com_dMETIMaxPer_C Com_dMETISigSel_C /end DEF_CHARACTERISTIC
 /begin IN_MEASUREMENT Com_bDeIce Com_bMicuInfo Com_bReDEFOutCdn Com_bReDEFSwCdn Com_bRMDRLKCInfo Com_bRMHLHiRly Com_bRMHLLoRly Com_bRMILLSml Com_ctCRingMETI Com_numCsumMETI Com_stAcInfo Com_stFrmRxEna Com_stMon Com_stWiprActvnCdn Com_uFrntBlowrU Com_uMICUTxBlowrU Com_uRrBlowrU /end IN_MEASUREMENT
 /begin OUT_MEASUREMENT Com_stLiSwtInfoMETI /end OUT_MEASUREMENT
 /begin LOC_MEASUREMENT DsplECU_ctRngMETI_MP /end LOC_MEASUREMENT
 FUNCTION_VERSION "6.4.0" /end FUNCTION
/begin FUNCTION DsplECU_METK "7.8.0     Reception process for the CAN frame METK"
 /begin DEF_CHARACTERISTIC Com_dMETKMaxDiff_C Com_dMETKMaxPer_C Com_dMETKSigSel_C Com_lDstMETK_C /end DEF_CHARACTERISTIC
 /begin IN_MEASUREMENT CoEng_st Com_ctCRingMETK Com_lDstMETKRaw Com_numCsumMETK Com_stACFailInfo Com_stBCANInfo Com_stCombUnitFailInfo Com_stDstMETK Com_stFrmRxEna Com_stMICUInfo Com_stMon Com_stRstReq Dspl_stASLRxErr SyC_ctPostDrvLeave T15_st T50_st /end IN_MEASUREMENT
 /begin OUT_MEASUREMENT Com_lDst Com_lDstMETK Com_stFailCode Com_stMCUUnFailCode /end OUT_MEASUREMENT
 /begin LOC_MEASUREMENT Com_ctReIni10msMETK Com_lDstMETK1 Com_lDstMETK2 Com_lDstMETK3 Com_stFrzDstMETK_mp DsplECU_ctRngMETK_MP /end LOC_MEASUREMENT
 FUNCTION_VERSION "7.8.0" /end FUNCTION
/begin FUNCTION DsplECU_METL "6.4.0     Reception process for the CAN frame METL" /begin DEF_CHARACTERISTIC Com_dMETLMaxDiff_C Com_dMETLMaxPer_C /end DEF_CHARACTERISTIC
 /begin IN_MEASUREMENT Com_ctCRingMETL Com_numCsumMETL Com_stFrmRxEna Com_stMon Dspl_stACCASLSwtInfo Dspl_stCrsSwtInfo /end IN_MEASUREMENT
 /begin OUT_MEASUREMENT Com_stMonMETL /end OUT_MEASUREMENT
 /begin LOC_MEASUREMENT DsplECU_ctMETLRngCnt_MP /end LOC_MEASUREMENT
 FUNCTION_VERSION "6.4.0" /end FUNCTION
/begin FUNCTION DsplECU_METM "5.4.0     CAN messages of the Display ECU (METM)"
 /begin DEF_CHARACTERISTIC Com_ctCRingMETM_C Com_dMETMMaxDiff_C Com_dMETMMaxPer_C Com_numCsumMETM_C Com_stMtrCustDftReq_C Com_stMtrCustStReq_C /end DEF_CHARACTERISTIC
 /begin IN_MEASUREMENT Com_ctCRingMETM Com_numCsumMETM Com_stFrmRxEna Com_stMon Com_stMtrCustDftReq Com_stMtrCustStReq SyC_ctPostDrvLeave T15_st /end IN_MEASUREMENT
 /begin LOC_MEASUREMENT Com_ctReIni10msMETM DsplECU_ctMETMRngCnt_MP /end LOC_MEASUREMENT
 FUNCTION_VERSION "5.4.0" /end FUNCTION
/begin FUNCTION DsplECU_METN "5.1.0_6SAACAN messages of the Display ECU (METN)"
 /begin DEF_CHARACTERISTIC Com_ctCRingMETN_C Com_dMETNMaxDiff_C Com_dMETNMaxPer_C Com_numCsumMETN_C Com_tACMtrEvaInfo_C /end DEF_CHARACTERISTIC
 /begin IN_MEASUREMENT Com_ctCRingMETN Com_numCsumMETN Com_stFrmRxEna Com_stMon Com_tACMtrEvaInfo /end IN_MEASUREMENT
 /begin OUT_MEASUREMENT Com_stMETNCanErr /end OUT_MEASUREMENT
 /begin LOC_MEASUREMENT DsplECU_ctMETNRngCnt_MP /end LOC_MEASUREMENT
 FUNCTION_VERSION "5.1.0_6SAA" /end FUNCTION
/begin FUNCTION DSQ "30000.10.0Diagnostic Signal Quality" FUNCTION_VERSION "30000.10.0" /end FUNCTION
/begin FUNCTION DSTHDR "3.11.0    Diagnosis start with high fuel pressure"
 /begin DEF_CHARACTERISTIC CWDSTHDR EngStrt_pRailMxDiagHiPStrt_C TMDSTHDROB TMDSTHDRUN /end DEF_CHARACTERISTIC
 /begin IN_MEASUREMENT B_hst_msg B_stainjen_msg B_stendmd_msg CoEng_stMai EngStrt_flgHiPStrt EngStrt_flgHiPStrtRels EngStrt_tStrtCoor FuPHi_pRail SyC_stSub /end IN_MEASUREMENT
 /begin LOC_MEASUREMENT B_dsthdron B_dsthdstp B_edsthdrp B_fidp_mp /end LOC_MEASUREMENT
 FUNCTION_VERSION "3.11.0" /end FUNCTION
/begin FUNCTION DSTTI "4.7.0     Diagnosis start time" /begin DEF_CHARACTERISTIC TSTARTMX ZTSTMX ZTSTMXOK /end DEF_CHARACTERISTIC
 /begin IN_MEASUREMENT B_staanf_msg EngStrt_bFrstStrtEnd EngStrt_bStrtEnd SyC_ctDrvEnter SyC_stSub /end IN_MEASUREMENT
 /begin OUT_MEASUREMENT B_limtstok_msg B_limtst_msg B_sttime_msg sttime_w_msg /end OUT_MEASUREMENT
 /begin LOC_MEASUREMENT B_dstti B_staanloc EngStrt_ctReIniDsttiDrvEnter zllimtst zllimtstok /end LOC_MEASUREMENT
 FUNCTION_VERSION "4.7.0" /end FUNCTION
/begin FUNCTION DTANKL "11.4.0    Diagnosis OBDII error due to an empty canister" /begin DEF_CHARACTERISTIC TKL15TALV TVTANKL TVTLEPL /end DEF_CHARACTERISTIC /begin IN_MEASUREMENT B_cdtankl_msg B_kl15_msg B_talval_msg B_tal_msg SyC_stSub /end IN_MEASUREMENT
 /begin OUT_MEASUREMENT B_asvtl_msg B_bkstl_msg B_dsvtl_msg B_dylsunt_msg B_dylsutl_msg B_frant_msg B_frapfi2tl B_frapfitl B_fratl_msg B_fraztl_msg B_frsttl_msg B_ftdlant_msg B_ftdlatl_msg B_hdrnt_msg B_hdrtl_msg B_ldrtl_msg B_llrhnt_msg B_llrhtl_msg B_llrtl_msg B_lsf2tl_msg B_lsftl_msg B_lsh2tl_msg B_lshnt_msg B_lshtl_msg B_mdef_msg B_mdnt_msg B_orant_msg B_orapfi2tl B_orapfitl B_oratl_msg B_pllsunt_msg B_pllsutl_msg B_sthdrnt_msg B_sthdrtl_msg /end OUT_MEASUREMENT
 /begin LOC_MEASUREMENT B_infsthdr B_ntal B_tal01 B_tlbde B_tlepl B_tlnohk B_tlstervk /end LOC_MEASUREMENT
 FUNCTION_VERSION "11.4.0" /end FUNCTION
/begin FUNCTION DTR "30000.8.0 Diagnostic Test Results for Service 0x06"
 /begin DEF_CHARACTERISTIC DTR_OBDMID.DTR_OBDMID_01_TID_DTLTR_C DTR_OBDMID.DTR_OBDMID_01_TID_DTRTL_C DTR_OBDMID.DTR_OBDMID_01_TID_OFFSN_C DTR_OBDMID.DTR_OBDMID_01_TID_OFFSP_C DTR_OBDMID.DTR_OBDMID_01_TID_SnsrMntdDiag_C DTR_OBDMID.DTR_OBDMID_01_TID_TCLTR_C DTR_OBDMID.DTR_OBDMID_01_TID_TCRTL_C DTR_OBDMID.DTR_OBDMID_02_TID_05_C DTR_OBDMID.DTR_OBDMID_02_TID_06_C DTR_OBDMID.DTR_OBDMID_02_TID_LtrDly_C DTR_OBDMID.DTR_OBDMID_02_TID_RtlDly_C DTR_OBDMID.DTR_OBDMID_02_TID_TarLean_C DTR_OBDMID.DTR_OBDMID_02_TID_TarRich_C DTR_OBDMID.DTR_OBDMID_21_TID_OS_C DTR_OBDMID.DTR_OBDMID_31_TID_AGRSUS_C DTR_OBDMID.DTR_OBDMID_35_TID_ICSR_C DTR_OBDMID.DTR_OBDMID_35_TID_ICTE_C DTR_OBDMID.DTR_OBDMID_35_TID_IntkVTECFbSwt11SpclLft_C DTR_OBDMID.DTR_OBDMID_35_TID_IntkVTECFbSwt11StdLft_C DTR_OBDMID.DTR_OBDMID_35_TID_LPCI_C DTR_OBDMID.DTR_OBDMID_39_TID_TESG_C DTR_OBDMID.DTR_OBDMID_3D_TID_DiagCpv1DteskLoLoadStuckClsd_C DTR_OBDMID.DTR_OBDMID_3D_TID_DiagCpv1DteskLoLoadStuckOpen_C DTR_OBDMID.DTR_OBDMID_3b_TID_TESF_C DTR_OBDMID.DTR_OBDMID_3c_TID_EONV_C DTR_OBDMID.DTR_OBDMID_3c_TID_EONVNoF_C DTR_OBDMID.DTR_OBDMID_3d_TID_AAV_C DTR_OBDMID.DTR_OBDMID_3d_TID_BLKLI_C DTR_OBDMID.DTR_OBDMID_41_TID_TCER_C DTR_OBDMID.DTR_OBDMID_41_TID_TStrt_C DTR_OBDMID.DTR_OBDMID_42_TID_HTR_C DTR_OBDMID.DTR_OBDMID_a2_TID_0b_0_C DTR_OBDMID.DTR_OBDMID_a2_TID_0b_1_C DTR_OBDMID.DTR_OBDMID_a2_TID_0b_2_C DTR_OBDMID.DTR_OBDMID_a2_TID_0b_3_C DTR_OBDMID.DTR_OBDMID_a2_TID_0c_0_C DTR_OBDMID.DTR_OBDMID_a2_TID_0c_1_C DTR_OBDMID.DTR_OBDMID_a2_TID_0c_2_C DTR_OBDMID.DTR_OBDMID_a2_TID_0c_3_C DTR_Suprt.DTR_OBDMID_01_TID_DTLTR_C DTR_Suprt.DTR_OBDMID_01_TID_DTRTL_C DTR_Suprt.DTR_OBDMID_01_TID_OFFSN_C DTR_Suprt.DTR_OBDMID_01_TID_OFFSP_C DTR_Suprt.DTR_OBDMID_01_TID_SnsrMntdDiag_C DTR_Suprt.DTR_OBDMID_01_TID_TCLTR_C DTR_Suprt.DTR_OBDMID_01_TID_TCRTL_C DTR_Suprt.DTR_OBDMID_02_TID_05_C DTR_Suprt.DTR_OBDMID_02_TID_06_C DTR_Suprt.DTR_OBDMID_02_TID_LtrDly_C DTR_Suprt.DTR_OBDMID_02_TID_RtlDly_C DTR_Suprt.DTR_OBDMID_02_TID_TarLean_C DTR_Suprt.DTR_OBDMID_02_TID_TarRich_C DTR_Suprt.DTR_OBDMID_21_TID_OS_C DTR_Suprt.DTR_OBDMID_31_TID_AGRSUS_C DTR_Suprt.DTR_OBDMID_35_TID_ICSR_C DTR_Suprt.DTR_OBDMID_35_TID_ICTE_C DTR_Suprt.DTR_OBDMID_35_TID_IntkVTECFbSwt11SpclLft_C DTR_Suprt.DTR_OBDMID_35_TID_IntkVTECFbSwt11StdLft_C DTR_Suprt.DTR_OBDMID_35_TID_LPCI_C DTR_Suprt.DTR_OBDMID_39_TID_TESG_C DTR_Suprt.DTR_OBDMID_3D_TID_DiagCpv1DteskLoLoadStuckClsd_C DTR_Suprt.DTR_OBDMID_3D_TID_DiagCpv1DteskLoLoadStuckOpen_C DTR_Suprt.DTR_OBDMID_3b_TID_TESF_C DTR_Suprt.DTR_OBDMID_3c_TID_EONV_C DTR_Suprt.DTR_OBDMID_3c_TID_EONVNoF_C DTR_Suprt.DTR_OBDMID_3d_TID_AAV_C DTR_Suprt.DTR_OBDMID_3d_TID_BLKLI_C DTR_Suprt.DTR_OBDMID_41_TID_TCER_C DTR_Suprt.DTR_OBDMID_41_TID_TStrt_C DTR_Suprt.DTR_OBDMID_42_TID_HTR_C DTR_Suprt.DTR_OBDMID_a2_TID_0b_0_C DTR_Suprt.DTR_OBDMID_a2_TID_0b_1_C DTR_Suprt.DTR_OBDMID_a2_TID_0b_2_C DTR_Suprt.DTR_OBDMID_a2_TID_0b_3_C DTR_Suprt.DTR_OBDMID_a2_TID_0c_0_C DTR_Suprt.DTR_OBDMID_a2_TID_0c_1_C DTR_Suprt.DTR_OBDMID_a2_TID_0c_2_C DTR_Suprt.DTR_OBDMID_a2_TID_0c_3_C DTR_TID.DTR_OBDMID_01_TID_DTLTR_C DTR_TID.DTR_OBDMID_01_TID_DTRTL_C DTR_TID.DTR_OBDMID_01_TID_OFFSN_C DTR_TID.DTR_OBDMID_01_TID_OFFSP_C DTR_TID.DTR_OBDMID_01_TID_SnsrMntdDiag_C DTR_TID.DTR_OBDMID_01_TID_TCLTR_C DTR_TID.DTR_OBDMID_01_TID_TCRTL_C DTR_TID.DTR_OBDMID_02_TID_05_C DTR_TID.DTR_OBDMID_02_TID_06_C DTR_TID.DTR_OBDMID_02_TID_LtrDly_C DTR_TID.DTR_OBDMID_02_TID_RtlDly_C DTR_TID.DTR_OBDMID_02_TID_TarLean_C DTR_TID.DTR_OBDMID_02_TID_TarRich_C DTR_TID.DTR_OBDMID_21_TID_OS_C DTR_TID.DTR_OBDMID_31_TID_AGRSUS_C DTR_TID.DTR_OBDMID_35_TID_ICSR_C DTR_TID.DTR_OBDMID_35_TID_ICTE_C DTR_TID.DTR_OBDMID_35_TID_IntkVTECFbSwt11SpclLft_C DTR_TID.DTR_OBDMID_35_TID_IntkVTECFbSwt11StdLft_C DTR_TID.DTR_OBDMID_35_TID_LPCI_C DTR_TID.DTR_OBDMID_39_TID_TESG_C DTR_TID.DTR_OBDMID_3D_TID_DiagCpv1DteskLoLoadStuckClsd_C DTR_TID.DTR_OBDMID_3D_TID_DiagCpv1DteskLoLoadStuckOpen_C DTR_TID.DTR_OBDMID_3b_TID_TESF_C DTR_TID.DTR_OBDMID_3c_TID_EONV_C DTR_TID.DTR_OBDMID_3c_TID_EONVNoF_C DTR_TID.DTR_OBDMID_3d_TID_AAV_C DTR_TID.DTR_OBDMID_3d_TID_BLKLI_C DTR_TID.DTR_OBDMID_41_TID_TCER_C DTR_TID.DTR_OBDMID_41_TID_TStrt_C DTR_TID.DTR_OBDMID_42_TID_HTR_C DTR_TID.DTR_OBDMID_a2_TID_0b_0_C DTR_TID.DTR_OBDMID_a2_TID_0b_1_C DTR_TID.DTR_OBDMID_a2_TID_0b_2_C DTR_TID.DTR_OBDMID_a2_TID_0b_3_C DTR_TID.DTR_OBDMID_a2_TID_0c_0_C DTR_TID.DTR_OBDMID_a2_TID_0c_1_C DTR_TID.DTR_OBDMID_a2_TID_0c_2_C DTR_TID.DTR_OBDMID_a2_TID_0c_3_C /end DEF_CHARACTERISTIC
 /begin LOC_MEASUREMENT DTR_valLoLim.DTR_OBDMID_01_TID_DTLTR DTR_valLoLim.DTR_OBDMID_01_TID_DTRTL DTR_valLoLim.DTR_OBDMID_01_TID_OFFSN DTR_valLoLim.DTR_OBDMID_01_TID_OFFSP DTR_valLoLim.DTR_OBDMID_01_TID_SnsrMntdDiag DTR_valLoLim.DTR_OBDMID_01_TID_TCLTR DTR_valLoLim.DTR_OBDMID_01_TID_TCRTL DTR_valLoLim.DTR_OBDMID_02_TID_05 DTR_valLoLim.DTR_OBDMID_02_TID_06 DTR_valLoLim.DTR_OBDMID_02_TID_LtrDly DTR_valLoLim.DTR_OBDMID_02_TID_RtlDly DTR_valLoLim.DTR_OBDMID_02_TID_TarLean DTR_valLoLim.DTR_OBDMID_02_TID_TarRich DTR_valLoLim.DTR_OBDMID_21_TID_OS DTR_valLoLim.DTR_OBDMID_31_TID_AGRSUS DTR_valLoLim.DTR_OBDMID_35_TID_ICSR DTR_valLoLim.DTR_OBDMID_35_TID_ICTE DTR_valLoLim.DTR_OBDMID_35_TID_IntkVTECFbSwt11SpclLft DTR_valLoLim.DTR_OBDMID_35_TID_IntkVTECFbSwt11StdLft DTR_valLoLim.DTR_OBDMID_35_TID_LPCI DTR_valLoLim.DTR_OBDMID_39_TID_TESG DTR_valLoLim.DTR_OBDMID_3D_TID_DiagCpv1DteskLoLoadStuckClsd DTR_valLoLim.DTR_OBDMID_3D_TID_DiagCpv1DteskLoLoadStuckOpen DTR_valLoLim.DTR_OBDMID_3b_TID_TESF DTR_valLoLim.DTR_OBDMID_3c_TID_EONV DTR_valLoLim.DTR_OBDMID_3c_TID_EONVNoF DTR_valLoLim.DTR_OBDMID_3d_TID_AAV DTR_valLoLim.DTR_OBDMID_3d_TID_BLKLI DTR_valLoLim.DTR_OBDMID_41_TID_TCER DTR_valLoLim.DTR_OBDMID_41_TID_TStrt DTR_valLoLim.DTR_OBDMID_42_TID_HTR DTR_valLoLim.DTR_OBDMID_a2_TID_0b_0 DTR_valLoLim.DTR_OBDMID_a2_TID_0b_1 DTR_valLoLim.DTR_OBDMID_a2_TID_0b_2 DTR_valLoLim.DTR_OBDMID_a2_TID_0b_3 DTR_valLoLim.DTR_OBDMID_a2_TID_0c_0 DTR_valLoLim.DTR_OBDMID_a2_TID_0c_1 DTR_valLoLim.DTR_OBDMID_a2_TID_0c_2 DTR_valLoLim.DTR_OBDMID_a2_TID_0c_3 DTR_valTst.DTR_OBDMID_01_TID_DTLTR DTR_valTst.DTR_OBDMID_01_TID_DTRTL DTR_valTst.DTR_OBDMID_01_TID_OFFSN DTR_valTst.DTR_OBDMID_01_TID_OFFSP DTR_valTst.DTR_OBDMID_01_TID_SnsrMntdDiag DTR_valTst.DTR_OBDMID_01_TID_TCLTR DTR_valTst.DTR_OBDMID_01_TID_TCRTL DTR_valTst.DTR_OBDMID_02_TID_05 DTR_valTst.DTR_OBDMID_02_TID_06 DTR_valTst.DTR_OBDMID_02_TID_LtrDly DTR_valTst.DTR_OBDMID_02_TID_RtlDly DTR_valTst.DTR_OBDMID_02_TID_TarLean DTR_valTst.DTR_OBDMID_02_TID_TarRich DTR_valTst.DTR_OBDMID_21_TID_OS DTR_valTst.DTR_OBDMID_31_TID_AGRSUS DTR_valTst.DTR_OBDMID_35_TID_ICSR DTR_valTst.DTR_OBDMID_35_TID_ICTE DTR_valTst.DTR_OBDMID_35_TID_IntkVTECFbSwt11SpclLft DTR_valTst.DTR_OBDMID_35_TID_IntkVTECFbSwt11StdLft DTR_valTst.DTR_OBDMID_35_TID_LPCI DTR_valTst.DTR_OBDMID_39_TID_TESG DTR_valTst.DTR_OBDMID_3D_TID_DiagCpv1DteskLoLoadStuckClsd DTR_valTst.DTR_OBDMID_3D_TID_DiagCpv1DteskLoLoadStuckOpen DTR_valTst.DTR_OBDMID_3b_TID_TESF DTR_valTst.DTR_OBDMID_3c_TID_EONV DTR_valTst.DTR_OBDMID_3c_TID_EONVNoF DTR_valTst.DTR_OBDMID_3d_TID_AAV DTR_valTst.DTR_OBDMID_3d_TID_BLKLI DTR_valTst.DTR_OBDMID_41_TID_TCER DTR_valTst.DTR_OBDMID_41_TID_TStrt DTR_valTst.DTR_OBDMID_42_TID_HTR DTR_valTst.DTR_OBDMID_a2_TID_0b_0 DTR_valTst.DTR_OBDMID_a2_TID_0b_1 DTR_valTst.DTR_OBDMID_a2_TID_0b_2 DTR_valTst.DTR_OBDMID_a2_TID_0b_3 DTR_valTst.DTR_OBDMID_a2_TID_0c_0 DTR_valTst.DTR_OBDMID_a2_TID_0c_1 DTR_valTst.DTR_OBDMID_a2_TID_0c_2 DTR_valTst.DTR_OBDMID_a2_TID_0c_3 DTR_valUpLim.DTR_OBDMID_01_TID_DTLTR DTR_valUpLim.DTR_OBDMID_01_TID_DTRTL DTR_valUpLim.DTR_OBDMID_01_TID_OFFSN DTR_valUpLim.DTR_OBDMID_01_TID_OFFSP DTR_valUpLim.DTR_OBDMID_01_TID_SnsrMntdDiag DTR_valUpLim.DTR_OBDMID_01_TID_TCLTR DTR_valUpLim.DTR_OBDMID_01_TID_TCRTL DTR_valUpLim.DTR_OBDMID_02_TID_05 DTR_valUpLim.DTR_OBDMID_02_TID_06 DTR_valUpLim.DTR_OBDMID_02_TID_LtrDly DTR_valUpLim.DTR_OBDMID_02_TID_RtlDly DTR_valUpLim.DTR_OBDMID_02_TID_TarLean DTR_valUpLim.DTR_OBDMID_02_TID_TarRich DTR_valUpLim.DTR_OBDMID_21_TID_OS DTR_valUpLim.DTR_OBDMID_31_TID_AGRSUS DTR_valUpLim.DTR_OBDMID_35_TID_ICSR DTR_valUpLim.DTR_OBDMID_35_TID_ICTE DTR_valUpLim.DTR_OBDMID_35_TID_IntkVTECFbSwt11SpclLft DTR_valUpLim.DTR_OBDMID_35_TID_IntkVTECFbSwt11StdLft DTR_valUpLim.DTR_OBDMID_35_TID_LPCI DTR_valUpLim.DTR_OBDMID_39_TID_TESG DTR_valUpLim.DTR_OBDMID_3D_TID_DiagCpv1DteskLoLoadStuckClsd DTR_valUpLim.DTR_OBDMID_3D_TID_DiagCpv1DteskLoLoadStuckOpen DTR_valUpLim.DTR_OBDMID_3b_TID_TESF DTR_valUpLim.DTR_OBDMID_3c_TID_EONV DTR_valUpLim.DTR_OBDMID_3c_TID_EONVNoF DTR_valUpLim.DTR_OBDMID_3d_TID_AAV DTR_valUpLim.DTR_OBDMID_3d_TID_BLKLI DTR_valUpLim.DTR_OBDMID_41_TID_TCER DTR_valUpLim.DTR_OBDMID_41_TID_TStrt DTR_valUpLim.DTR_OBDMID_42_TID_HTR DTR_valUpLim.DTR_OBDMID_a2_TID_0b_0 DTR_valUpLim.DTR_OBDMID_a2_TID_0b_1 DTR_valUpLim.DTR_OBDMID_a2_TID_0b_2 DTR_valUpLim.DTR_OBDMID_a2_TID_0b_3 DTR_valUpLim.DTR_OBDMID_a2_TID_0c_0 DTR_valUpLim.DTR_OBDMID_a2_TID_0c_1 DTR_valUpLim.DTR_OBDMID_a2_TID_0c_2 DTR_valUpLim.DTR_OBDMID_a2_TID_0c_3 /end LOC_MEASUREMENT
 FUNCTION_VERSION "30000.8.0" /end FUNCTION
/begin FUNCTION DVHEE "14.6.0    Electrical Diagnosis Powerstage Valve Lift Control"
 /begin DEF_CHARACTERISTIC P_VSE11_nrPSPTstPls_C P_VSE11_tiBtwElecFlt_C P_VSE11_tiBtwOTFlt_C TurnondelaySwtIntkExh_C VlvLft_flgFbSwtDtrDfctClrInhb_C VlvLft_IntDbTiHiLo_C VlvLft_IntDbTiLoHi_C VlvLft_pOilHighrThd_C VlvLft_pOilLowrThd_C VlvLft_stFbSnsrDiagEnaIntk_C VlvLft_stFbSwtDiagEnaIntk_C Vlvlft_stPsDiaDisbl_C Vlvlft_stPsDiaSwitch_C VlvLft_stPwrStgDiagEnaIntkExh_C VlvLft_tiSpclMaxIntk_C VlvLft_tiStdMaxIntk_C VlvLft_uOilPSnsrSRCMax_C VlvLft_uOilPSnsrSRCMin_C /end DEF_CHARACTERISTIC
 /begin IN_MEASUREMENT B_desee_msg DevLib_stPwrStgEnaCond GEVCtl_flgIntkVlvLftEna SyC_stSub VlvLft_fbIntkSwtOutp11 VlvLft_flgCtrlActrIntk1 VlvLft_flgEnerBgnAdpnIntk VlvLft_pSnsrIntk VlvLft_stFbSnsrActvIntk Vlvlft_stFbSwtActvIntk VlvLft_uRawPSnsrIntk /end IN_MEASUREMENT
 /begin LOC_MEASUREMENT DSM_SRCIntk11Max DSM_SRCIntk11Min fbIntkActrErrDebSpcl11 fbIntkActrErrDebStd11 fbIntkActrErrIntDebSpcl11 fbIntkActrErrIntDebStd11 tiSpclIntk11 tiStdIntk11 Vlvlft_flgBdeseeloc Vlvlft_flgDSMClr VlvLft_flgDSMFbSwtIntk11SpclVisible VlvLft_flgDSMFbSwtIntk11StdVisible Vlvlft_flgfbIntkSpcl11Fail Vlvlft_flgfbIntkSpcl11Suc Vlvlft_flgfbIntkStd11Fail Vlvlft_flgfbIntkStd11Suc Vlvlft_flgIntkDebEnaSpcl11 Vlvlft_flgIntkDebEnaStd11 VlvLft_flgIntkFbSwt11SpclLftDtrRels VlvLft_flgIntkFbSwt11StdLftDtrRels VlvLft_flgIntkSwt11SpclLftDfctEntry VlvLft_flgIntkSwt11StdLftDfctEntry VlvLft_flgSwtExh11DiagNumRel VlvLft_flgSwtIntk11DiagNumRel VlvLft_stFbSnsrDiagEnaIntk Vlvlft_stPsDiagEna /end LOC_MEASUREMENT
 FUNCTION_VERSION "14.6.0" /end FUNCTION
/begin FUNCTION Ebs_VD "27.0.0    virtual driver Electrical Battery Sensor"
 /begin DEF_CHARACTERISTIC Ebs_cntrDebSocFlt_C Ebs_facRCorrn_T Ebs_flgSwtSOCSeln_C Ebs_iBattRepl_C Ebs_iS16MaxLim_C Ebs_iS16MinLim_C Ebs_qAcmMax_C Ebs_qBattNom_T Ebs_qChrgDft_C Ebs_qDchaDft_C Ebs_qSohRepl_C Ebs_ratDeltaSocThd1_C Ebs_ratDeltaSocThd2_C Ebs_ratDifThd_C Ebs_ratSocRepl_C Ebs_ratSohRepl_C Ebs_ratTarSoc_C Ebs_rBattRSRCHiThd_C Ebs_rBattRSRCLoThd_C Ebs_swtCtl_C Ebs_tBattRepl_C Ebs_tiDlyAftStrtrCut_C Ebs_tiElpdSnceBattSnsrRst_C Ebs_tiRatSohFild_C Ebs_tiSocFil_C Ebs_tiSocSohHistOnDly_C Ebs_tiSohFil_C Ebs_tiT15OnDly_C Ebs_tiTBattFil_C Ebs_tiUBattFil_C Ebs_tiUSofFild_C Ebs_uBattRepl_C Ebs_uSofRepl_C /end DEF_CHARACTERISTIC
 /begin IN_MEASUREMENT Batt_ratSOCCalc CoEng_stMai CoEng_stMaiOld Com_bBliChrg Com_cntrIntResUpd Com_dEBSDByt0 Com_dEBSDByt1 Com_dEBSDByt2 Com_dEBSDByt3 Com_dEBSDByt4 Com_flgEbsRst Com_iBattEBS Com_iStbIAft0Hr Com_qChrg Com_qDisChrg Com_qSoh Com_qStbIAft1Hr Com_qStbIAft2Hr Com_qStbILast Com_ratSoc Com_ratSoh Com_rMeasdBattREbs Com_stBattDchaVltgPrdnSig Com_stBattDgrtSig Com_stCharErr Com_stMon Com_stSensErr Com_stSoc Com_tBattEBS Com_tiDurnAftIgnOff Com_uBattEBS Com_uPeak Eep_EnvRamInvld Strt_st SyC_tiEcuOff T15_st T50_st /end IN_MEASUREMENT
 /begin OUT_MEASUREMENT Ebs_facRCorrn Ebs_flgBliChrgCalcnCmpl Ebs_flgRst Ebs_flgSOCFlt Ebs_iBattFild Ebs_iStbIAft0HrDcyc Ebs_qBliChrg Ebs_qBliDcha Ebs_qBliDchaTot Ebs_qBliDchaTotDcyc Ebs_qIntegdICmp Ebs_qSohFild Ebs_qStbIAft1HrDcyc Ebs_qStbIAft2HrDcyc Ebs_qStbILastDcyc Ebs_qTotBliDcha Ebs_ratSocFild Ebs_ratSocHist Ebs_ratSohFild Ebs_rBatt Ebs_rBattAct Ebs_rBattMeasd Ebs_stBattInvld Ebs_stBattRVld Ebs_stEbsPlausyChk Ebs_stErr Ebs_stRInhbSpst Ebs_stSelfDiagErrEna Ebs_stSocErrChk Ebs_stStbIEBSByt0 Ebs_stStbIEBSByt1 Ebs_stStbIEBSByt2 Ebs_stStbIEBSByt3 Ebs_stStbIEBSByt4 Ebs_tBattFild Ebs_tiDurnAftIgnOffDcyc Ebs_tiT15OnDly Ebs_uBattFild Ebs_uSofFild /end OUT_MEASUREMENT
 /begin LOC_MEASUREMENT Ebs_cntrAcmChrgOvf Ebs_cntrAcmDchaOvf Ebs_cntrBattEbs Ebs_cntrIntResUpdPrev Ebs_cntrSocFlt1 Ebs_cntrSocFlt2 Ebs_flgTestActv Ebs_qChrgDchaDif Ebs_qChrgDurgT15Off Ebs_qChrgDurgT15On Ebs_qChrgPrev Ebs_qChrgRef Ebs_qChrgSum Ebs_qDchaDurgT15Off Ebs_qDchaDurgT15On Ebs_qDchaPrev Ebs_qDchaRef Ebs_qDchaSum Ebs_qSohFildHist Ebs_ratEstimdDeltaSoc Ebs_ratSoc Ebs_ratSocFildHist Ebs_ratSohFildHist Ebs_rBattActSum Ebs_stBattTempInvld Ebs_stChkSocPlausy1 Ebs_stChkSocPlausy2 Ebs_stEngSt Ebs_stIMonUpdEna Ebs_stIMonUp_MP Ebs_stRErr_MP Ebs_stRMsrmnt_MP Ebs_stRSumOvf Ebs_stStrtRMsrmnt Ebs_stStrtTmrCond Ebs_stT50 Ebs_tiAftBattSnsrRst Ebs_tiElpdSnceBattSnsrRst /end LOC_MEASUREMENT
 FUNCTION_VERSION "27.0.0" /end FUNCTION
/begin COMPU_METHOD B_TRUE "" TAB_VERB "%6.3" "" COMPU_TAB_REF B_TRUE /end COMPU_METHOD
/begin COMPU_VTAB B_TRUE "" TAB_VERB 2 0 "FALSE" 1 "TRUE" /end COMPU_VTAB
/begin COMPU_METHOD Com_EvaTemp_Compu "" RAT_FUNC "%1.0" "" COEFFS 0 1 30 0 0 1 /end COMPU_METHOD
/begin COMPU_METHOD Curr_A "" RAT_FUNC "%6.4" "A" COEFFS 0 100 0 0 0 1 /end COMPU_METHOD
/begin COMPU_METHOD Curr_mA_q0p9765625_COMPU "" RAT_FUNC "%6.2" "mA" COEFFS 0 1.024 0 0 0 1 /end COMPU_METHOD
/begin COMPU_METHOD dez "" RAT_FUNC "%6.2" "" COEFFS 0 1 0 0 0 1 /end COMPU_METHOD
/begin COMPU_METHOD DFC_OneToOne "" RAT_FUNC "%6.2" "-" COEFFS 0 1 0 0 0 1 /end COMPU_METHOD
/begin COMPU_METHOD DTR_Suprt_Compu "" TAB_VERB "%6.3" "-" COMPU_TAB_REF DTR_Suprt_Compu /end COMPU_METHOD
/begin COMPU_VTAB DTR_Suprt_Compu "" TAB_VERB 2 0 "Not supported" 1 "Supported" /end COMPU_VTAB
/begin COMPU_METHOD ElecChrg_Ah_q0p125_COMPU "" RAT_FUNC "%6.3" "Ah" COEFFS 0 8 0 0 0 1 /end COMPU_METHOD
/begin COMPU_METHOD EXHMGT_SEPPCLAMCAT_SC_Compu "" TAB_VERB "%6.3" "" COMPU_TAB_REF EXHMGT_SEPPCLAMCAT_SC_Compu /end COMPU_METHOD
/begin COMPU_VTAB EXHMGT_SEPPCLAMCAT_SC_Compu "" TAB_VERB 2 0 "False" 1 "True" /end COMPU_VTAB
/begin COMPU_METHOD EXHMGT_STGYCATHEATGEEDCLD_SC_Compu "" TAB_VERB "%6.3" "" COMPU_TAB_REF EXHMGT_STGYCATHEATGEEDCLD_SC_Compu /end COMPU_METHOD
/begin COMPU_VTAB EXHMGT_STGYCATHEATGEEDCLD_SC_Compu "" TAB_VERB 2 0 "False" 1 "True" /end COMPU_VTAB
/begin COMPU_METHOD EXHMGT_SWTENGSTRTDLYACTV_SC_Compu "" TAB_VERB "%6.3" "" COMPU_TAB_REF EXHMGT_SWTENGSTRTDLYACTV_SC_Compu /end COMPU_METHOD
/begin COMPU_VTAB EXHMGT_SWTENGSTRTDLYACTV_SC_Compu "" TAB_VERB 2 0 "False" 1 "True" /end COMPU_VTAB
/begin COMPU_METHOD EXHMGT_TCATSELNHEATGREQ_SC_Compu "" TAB_VERB "%6.3" "" COMPU_TAB_REF EXHMGT_TCATSELNHEATGREQ_SC_Compu /end COMPU_METHOD
/begin COMPU_VTAB EXHMGT_TCATSELNHEATGREQ_SC_Compu "" TAB_VERB 2 0 "TCATBRICK" 1 "TEXH" /end COMPU_VTAB
/begin COMPU_METHOD EXHMGT_TEXHGOVRRGNGPF_SC_Compu "" TAB_VERB "%6.3" "" COMPU_TAB_REF EXHMGT_TEXHGOVRRGNGPF_SC_Compu /end COMPU_METHOD
/begin COMPU_VTAB EXHMGT_TEXHGOVRRGNGPF_SC_Compu "" TAB_VERB 2 0 "False" 1 "True" /end COMPU_VTAB
/begin COMPU_METHOD EXHMGT_TGRDTBASDCATWRMREQRST_SC_Compu "" TAB_VERB "%6.3" "" COMPU_TAB_REF EXHMGT_TGRDTBASDCATWRMREQRST_SC_Compu /end COMPU_METHOD
/begin COMPU_VTAB EXHMGT_TGRDTBASDCATWRMREQRST_SC_Compu "" TAB_VERB 2 0 "FALSE" 1 "TRUE" /end COMPU_VTAB
/begin COMPU_METHOD EXHMGT_TRBALTICPTPROTN_SC_Compu "" TAB_VERB "%6.3" "" COMPU_TAB_REF EXHMGT_TRBALTICPTPROTN_SC_Compu /end COMPU_METHOD
/begin COMPU_VTAB EXHMGT_TRBALTICPTPROTN_SC_Compu "" TAB_VERB 2 0 "False" 1 "True" /end COMPU_VTAB
/begin COMPU_METHOD EXHMGT_TRSMEXHSYSWRMUPSELN_SC_Compu "" TAB_VERB "%6.3" "" COMPU_TAB_REF EXHMGT_TRSMEXHSYSWRMUPSELN_SC_Compu /end COMPU_METHOD
/begin COMPU_VTAB EXHMGT_TRSMEXHSYSWRMUPSELN_SC_Compu "" TAB_VERB 3 0 "FC_DISAD" 1 "ENAD_MINENG_CATT" 2 "ENAD_MINENG_SCRT" /end COMPU_VTAB
/begin COMPU_METHOD EXHMGT_VAR_SY_Compu "" TAB_VERB "%6.3" "" COMPU_TAB_REF EXHMGT_VAR_SY_Compu /end COMPU_METHOD
/begin COMPU_VTAB EXHMGT_VAR_SY_Compu "" TAB_VERB 48 1 "DAI" 3 "VWW" 4 "POR" 5 "AUD" 6 "OPE" 9 "FIA" 11 "BMW" 14 "PSA" 15 "REN" 17 "ALF" 18 "SAB" 19 "VOL" 20 "NIS" 21 "GMU" 22 "FOR" 26 "IMJ" 36 "MAN" 51 "SEA" 53 "CHR" 54 "JAG" 55 "ROL" 69 "FER" 72 "TOY" 123 "MIT" 147 "HYU" 159 "HON" 160 "MAZ" 183 "CU" 190 "LRG" 204 "VVW" 214 "AVT" 242 "Iveco" 243 "DMC" 248 "SUZ" 267 "SSANGYONG" 270 "KEF" 289 "AMG" 308 "TAT" 319 "MVM" 385 "UAES" 425 "Polaris" 590 "Scania" 609 "Deutz" 828 "RBCD" 898 "MFTBC" 999 "ALL" 2887 "Nonox" 9454 "Fuso" /end COMPU_VTAB
/begin COMPU_METHOD EXHMOD_ACTVTTSTRCOM_SC_Compu "" TAB_VERB "%6.3" "" COMPU_TAB_REF EXHMOD_ACTVTTSTRCOM_SC_Compu /end COMPU_METHOD
/begin COMPU_VTAB EXHMOD_ACTVTTSTRCOM_SC_Compu "" TAB_VERB 2 0 "False" 1 "True" /end COMPU_VTAB
/begin COMPU_METHOD EXHMOD_ADPNCOOLGCRV_SC_Compu "" TAB_VERB "%6.3" "" COMPU_TAB_REF EXHMOD_ADPNCOOLGCRV_SC_Compu /end COMPU_METHOD
/begin COMPU_VTAB EXHMOD_ADPNCOOLGCRV_SC_Compu "" TAB_VERB 2 0 "DISABLE" 1 "ENABLE" /end COMPU_VTAB
/begin COMPU_METHOD EXHMOD_APPL_SC_Compu "" TAB_VERB "%6.3" "" COMPU_TAB_REF EXHMOD_APPL_SC_Compu /end COMPU_METHOD
/begin COMPU_VTAB EXHMOD_APPL_SC_Compu "" TAB_VERB 2 0 "0" 1 "1" /end COMPU_VTAB
/begin COMPU_METHOD EXHMOD_B1B2SYM_SC_Compu "" TAB_VERB "%6.3" "" COMPU_TAB_REF EXHMOD_B1B2SYM_SC_Compu /end COMPU_METHOD
/begin COMPU_VTAB EXHMOD_B1B2SYM_SC_Compu "" TAB_VERB 2 0 "False" 1 "True" /end COMPU_VTAB
/begin COMPU_METHOD EXHMOD_BASCONLY_SC_Compu "" TAB_VERB "%6.3" "" COMPU_TAB_REF EXHMOD_BASCONLY_SC_Compu /end COMPU_METHOD
/begin COMPU_VTAB EXHMOD_BASCONLY_SC_Compu "" TAB_VERB 2 0 "False" 1 "True" /end COMPU_VTAB
/begin COMPU_METHOD EXHMOD_CALCPCOUPLDDSLSTCAT_SC_Compu "" TAB_VERB "%6.3" "" COMPU_TAB_REF EXHMOD_CALCPCOUPLDDSLSTCAT_SC_Compu /end COMPU_METHOD
/begin COMPU_VTAB EXHMOD_CALCPCOUPLDDSLSTCAT_SC_Compu "" TAB_VERB 2 0 "False" 1 "True" /end COMPU_VTAB
/begin COMPU_METHOD EXHMOD_CALCPSILBYP_SC_Compu "" TAB_VERB "%6.3" "" COMPU_TAB_REF EXHMOD_CALCPSILBYP_SC_Compu /end COMPU_METHOD
/begin COMPU_VTAB EXHMOD_CALCPSILBYP_SC_Compu "" TAB_VERB 2 0 "False" 1 "True" /end COMPU_VTAB
/begin COMPU_METHOD EXHMOD_CALCREACTNSELN_SC_Compu "" TAB_VERB "%6.3" "" COMPU_TAB_REF EXHMOD_CALCREACTNSELN_SC_Compu /end COMPU_METHOD
/begin COMPU_VTAB EXHMOD_CALCREACTNSELN_SC_Compu "" TAB_VERB 5 0 "0" 1 "1" 2 "2" 3 "3" 4 "4" /end COMPU_VTAB
/begin COMPU_METHOD EXHMOD_CATCNVNCPBYTLIOFF_SC_Compu "" TAB_VERB "%6.3" "" COMPU_TAB_REF EXHMOD_CATCNVNCPBYTLIOFF_SC_Compu /end COMPU_METHOD
/begin COMPU_VTAB EXHMOD_CATCNVNCPBYTLIOFF_SC_Compu "" TAB_VERB 2 0 "False" 1 "True" /end COMPU_VTAB
/begin COMPU_METHOD EXHMOD_CATPURG_SC_Compu "" TAB_VERB "%6.3" "" COMPU_TAB_REF EXHMOD_CATPURG_SC_Compu /end COMPU_METHOD
/begin COMPU_VTAB EXHMOD_CATPURG_SC_Compu "" TAB_VERB 2 0 "False" 1 "True" /end COMPU_VTAB
/begin COMPU_METHOD EXHMOD_DSQACTVT_SC_Compu "" TAB_VERB "%6.3" "" COMPU_TAB_REF EXHMOD_DSQACTVT_SC_Compu /end COMPU_METHOD
/begin COMPU_VTAB EXHMOD_DSQACTVT_SC_Compu "" TAB_VERB 2 0 "Inactive" 1 "Active" /end COMPU_VTAB
/begin COMPU_METHOD EXHMOD_EGPLSSTRTDEW_SC_Compu "" TAB_VERB "%6.3" "" COMPU_TAB_REF EXHMOD_EGPLSSTRTDEW_SC_Compu /end COMPU_METHOD
/begin COMPU_VTAB EXHMOD_EGPLSSTRTDEW_SC_Compu "" TAB_VERB 2 0 "False" 1 "True" /end COMPU_VTAB
/begin COMPU_METHOD EXHMOD_EGYRELSLSDIAG_SC_Compu "" TAB_VERB "%6.3" "" COMPU_TAB_REF EXHMOD_EGYRELSLSDIAG_SC_Compu /end COMPU_METHOD
/begin COMPU_VTAB EXHMOD_EGYRELSLSDIAG_SC_Compu "" TAB_VERB 2 0 "False" 1 "True" /end COMPU_VTAB
/begin COMPU_METHOD EXHMOD_ENACOEOMBASDSTGY_SC_Compu "" TAB_VERB "%6.3" "" COMPU_TAB_REF EXHMOD_ENACOEOMBASDSTGY_SC_Compu /end COMPU_METHOD
/begin COMPU_VTAB EXHMOD_ENACOEOMBASDSTGY_SC_Compu "" TAB_VERB 2 0 "False" 1 "True" /end COMPU_VTAB
/begin COMPU_METHOD EXHMOD_ENGSTOPPHDO2STR_SC_Compu "" TAB_VERB "%6.3" "" COMPU_TAB_REF EXHMOD_ENGSTOPPHDO2STR_SC_Compu /end COMPU_METHOD
/begin COMPU_VTAB EXHMOD_ENGSTOPPHDO2STR_SC_Compu "" TAB_VERB 2 0 "0" 1 "1" /end COMPU_VTAB
/begin COMPU_METHOD EXHMOD_EXO_SC_Compu "" TAB_VERB "%6.3" "" COMPU_TAB_REF EXHMOD_EXO_SC_Compu /end COMPU_METHOD
/begin COMPU_VTAB EXHMOD_EXO_SC_Compu "" TAB_VERB 3 0 "no_state_emission" 1 "state_emission" 2 "only_state_emission" /end COMPU_VTAB
/begin COMPU_METHOD EXHMOD_FCOEXO_SC_Compu "" TAB_VERB "%6.3" "" COMPU_TAB_REF EXHMOD_FCOEXO_SC_Compu /end COMPU_METHOD
/begin COMPU_VTAB EXHMOD_FCOEXO_SC_Compu "" TAB_VERB 2 0 "False" 1 "True" /end COMPU_VTAB
/begin COMPU_METHOD EXHMOD_MFCORRNCATHEATG_SC_Compu "" TAB_VERB "%6.3" "" COMPU_TAB_REF EXHMOD_MFCORRNCATHEATG_SC_Compu /end COMPU_METHOD
/begin COMPU_VTAB EXHMOD_MFCORRNCATHEATG_SC_Compu "" TAB_VERB 2 0 "False" 1 "True" /end COMPU_VTAB
/begin COMPU_METHOD EXHMOD_NRCATB1_SC_Compu "" RAT_FUNC "%6.2" "" COEFFS 0 1 0 0 0 1 /end COMPU_METHOD
/begin COMPU_METHOD EXHMOD_NRCATB2_SC_Compu "" RAT_FUNC "%6.2" "" COEFFS 0 1 0 0 0 1 /end COMPU_METHOD
/begin COMPU_METHOD EXHMOD_NRCATBYP_SC_Compu "" RAT_FUNC "%6.2" "" COEFFS 0 1 0 0 0 1 /end COMPU_METHOD
/begin COMPU_METHOD EXHMOD_NRCATUSS2B1_SC_Compu "" RAT_FUNC "%6.2" "" COEFFS 0 1 0 0 0 1 /end COMPU_METHOD
/begin COMPU_METHOD EXHMOD_NRCATUSS2B2_SC_Compu "" RAT_FUNC "%6.2" "" COEFFS 0 1 0 0 0 1 /end COMPU_METHOD
/begin COMPU_METHOD EXHMOD_NRCATUSS3B1_SC_Compu "" RAT_FUNC "%6.2" "" COEFFS 0 1 0 0 0 1 /end COMPU_METHOD
/begin COMPU_METHOD EXHMOD_NRCATUSS3B2_SC_Compu "" RAT_FUNC "%6.2" "" COEFFS 0 1 0 0 0 1 /end COMPU_METHOD
/begin COMPU_METHOD EXHMOD_NRCATUSS4B1_SC_Compu "" RAT_FUNC "%6.2" "" COEFFS 0 1 0 0 0 1 /end COMPU_METHOD
/begin COMPU_METHOD EXHMOD_NRCATUSS4B2_SC_Compu "" RAT_FUNC "%6.2" "" COEFFS 0 1 0 0 0 1 /end COMPU_METHOD
/begin COMPU_METHOD EXHMOD_NRCATUSYSPLIT_SC_Compu "" RAT_FUNC "%6.2" "" COEFFS 0 1 0 0 0 1 /end COMPU_METHOD
/begin COMPU_METHOD EXHMOD_NRININSCTN_SC_Compu "" RAT_FUNC "%6.2" "" COEFFS 0 1 0 0 0 1 /end COMPU_METHOD
/begin COMPU_METHOD EXHMOD_NRMAXBRICKB1_SC_Compu "" RAT_FUNC "%6.2" "" COEFFS 0 1 0 0 0 1 /end COMPU_METHOD
/begin COMPU_METHOD EXHMOD_NRMAXBRICKB2_SC_Compu "" RAT_FUNC "%6.2" "" COEFFS 0 1 0 0 0 1 /end COMPU_METHOD
/begin COMPU_METHOD EXHMOD_NRMAXPIPB1_SC_Compu "" RAT_FUNC "%6.2" "" COEFFS 0 1 0 0 0 1 /end COMPU_METHOD
/begin COMPU_METHOD EXHMOD_NRMAXPIPB2_SC_Compu "" RAT_FUNC "%6.2" "" COEFFS 0 1 0 0 0 1 /end COMPU_METHOD
/begin COMPU_METHOD EXHMOD_NRMAXSTRUCTELMB1_SC_Compu "" RAT_FUNC "%6.2" "" COEFFS 0 1 0 0 0 1 /end COMPU_METHOD
/begin COMPU_METHOD EXHMOD_NRMAXSTRUCTELMB2_SC_Compu "" RAT_FUNC "%6.2" "" COEFFS 0 1 0 0 0 1 /end COMPU_METHOD
/begin COMPU_METHOD EXHMOD_NRMPLBRICKCATB1_SC_Compu "" RAT_FUNC "%6.2" "" COEFFS 0 1 0 0 0 1 /end COMPU_METHOD
/begin COMPU_METHOD EXHMOD_NRMPLBRICKCATB2_SC_Compu "" RAT_FUNC "%6.2" "" COEFFS 0 1 0 0 0 1 /end COMPU_METHOD
/begin COMPU_METHOD EXHMOD_NRPNTSMAPCOOLGCRV_SC_Compu "" RAT_FUNC "%6.2" "" COEFFS 0 1 0 0 0 1 /end COMPU_METHOD
/begin COMPU_METHOD EXHMOD_NRPNTSMAPX_SC_Compu "" RAT_FUNC "%6.2" "" COEFFS 0 1 0 0 0 1 /end COMPU_METHOD
/begin COMPU_METHOD EXHMOD_NRPNTSMAPY_SC_Compu "" RAT_FUNC "%6.2" "" COEFFS 0 1 0 0 0 1 /end COMPU_METHOD
/begin COMPU_METHOD EXHMOD_NRSNSRB1_SC_Compu "" RAT_FUNC "%6.2" "" COEFFS 0 1 0 0 0 1 /end COMPU_METHOD
/begin COMPU_METHOD EXHMOD_NRSNSRB2_SC_Compu "" RAT_FUNC "%6.2" "" COEFFS 0 1 0 0 0 1 /end COMPU_METHOD
/begin COMPU_METHOD EXHMOD_NRTSNSRB1_SC_Compu "" RAT_FUNC "%6.2" "" COEFFS 0 1 0 0 0 1 /end COMPU_METHOD
/begin COMPU_METHOD EXHMOD_NRTSNSRB2_SC_Compu "" RAT_FUNC "%6.2" "" COEFFS 0 1 0 0 0 1 /end COMPU_METHOD
/begin COMPU_METHOD EXHMOD_PEXHMDLCFG_SC_Compu "" TAB_VERB "%6.3" "" COMPU_TAB_REF EXHMOD_PEXHMDLCFG_SC_Compu /end COMPU_METHOD
/begin COMPU_VTAB EXHMOD_PEXHMDLCFG_SC_Compu "" TAB_VERB 4 0 "0" 1 "1" 2 "2" 3 "3" /end COMPU_VTAB
/begin COMPU_METHOD EXHMOD_POSNCATGPF_SC_Compu "" TAB_VERB "%6.3" "" COMPU_TAB_REF EXHMOD_POSNCATGPF_SC_Compu /end COMPU_METHOD
/begin COMPU_VTAB EXHMOD_POSNCATGPF_SC_Compu "" TAB_VERB 6 0 "GPF_NO" 1 "GPF_CAT1" 2 "GPF_CAT2" 3 "GPF_CAT3" 4 "GPF_CAT4" 5 "GPF_CAT5" /end COMPU_VTAB
/begin COMPU_METHOD Fact1000 "" RAT_FUNC "%6.5" "-" COEFFS 0 1000 0 0 0 1 /end COMPU_METHOD
/begin COMPU_METHOD i_q0p01_A "" RAT_FUNC "%6.4" "A" COEFFS 0 1 0 0 0 0.01 /end COMPU_METHOD
/begin COMPU_METHOD i_q1_mA "" RAT_FUNC "%6.2" "mA" COEFFS 0 1 0 0 0 1 /end COMPU_METHOD
/begin COMPU_METHOD OilMlg "" RAT_FUNC "%6.2" "km" COEFFS 0 1 0 0 0 1 /end COMPU_METHOD
/begin COMPU_METHOD OneToOne "" RAT_FUNC "%6.2" "-" COEFFS 0 1 0 0 0 1 /end COMPU_METHOD
/begin COMPU_METHOD Prc "" RAT_FUNC "%6.4" "%" COEFFS 0 81.92 0 0 0 1 /end COMPU_METHOD
/begin COMPU_METHOD pres "" RAT_FUNC "%6.3" "kPa" COEFFS 0 10 0 0 0 1 /end COMPU_METHOD
/begin COMPU_METHOD q0p01_A_h_1 "" RAT_FUNC "%6.4" "Ah" COEFFS 0 100 0 0 0 1 /end COMPU_METHOD
/begin COMPU_METHOD RBPtCel_Perc_0p5_1 "" RAT_FUNC "%6.3" "%" COEFFS 0 2 0 0 0 1 /end COMPU_METHOD
/begin COMPU_METHOD RBPtCel_p_0p002_1 "" RAT_FUNC "%6.4" "MPa" COEFFS 0 1000 0 0 0 2 /end COMPU_METHOD
/begin COMPU_METHOD RBPtCel_r_0p00001_1 "" RAT_FUNC "%8.7" "Ohm" COEFFS 0 100000 0 0 0 1 /end COMPU_METHOD
/begin COMPU_METHOD RBPtCel_v_1p0_1 "" RAT_FUNC "%6.2" "km/h" COEFFS 0 1 0 0 0 1 /end COMPU_METHOD
/begin COMPU_METHOD SCR_TEMP_CELS_float "" RAT_FUNC "%6.2" "deg C" COEFFS 0 1 0 0 0 1 /end COMPU_METHOD
/begin COMPU_METHOD spg_q0p0625_V "" RAT_FUNC "%6.4" "V" COEFFS 0 16 0 0 0 1 /end COMPU_METHOD
/begin COMPU_METHOD t10msxs_uw_b655p35 "" RAT_FUNC "%6.4" "s" COEFFS 0 1 0 0 0 0.01 /end COMPU_METHOD
/begin COMPU_METHOD Temp_Cels "" RAT_FUNC "%6.1" "deg C" COEFFS 0 10 2731.4 0 0 1 /end COMPU_METHOD
/begin COMPU_METHOD temp_q0p5_o30_degC "" RAT_FUNC "%6.2" "deg C" COEFFS 0 2 60 0 0 1 /end COMPU_METHOD
/begin COMPU_METHOD TimeDelay_s "" RAT_FUNC "%6.1" "s" COEFFS 0 0 1 0 0.00023283064365387 0 /end COMPU_METHOD
/begin COMPU_METHOD Time_Hr "" RAT_FUNC "%6.3" "h" COEFFS 0 2 0 0 0 1 /end COMPU_METHOD
/begin COMPU_METHOD Time_ms "" RAT_FUNC "%6.1" "ms" COEFFS 0 0.1 0 0 0 1 /end COMPU_METHOD
/begin COMPU_METHOD Time_s "" RAT_FUNC "%6.4" "s" COEFFS 0 100 0 0 0 1 /end COMPU_METHOD
/begin COMPU_METHOD Time_sec_q1_COMPU "" RAT_FUNC "%6.2" "s" COEFFS 0 1 0 0 0 1 /end COMPU_METHOD
/begin COMPU_METHOD t_q0p1 "" RAT_FUNC "%6.3" "s" COEFFS 0 10 0 0 0 1 /end COMPU_METHOD
/begin COMPU_METHOD t_q1 "" RAT_FUNC "%6.2" "s" COEFFS 0 1 0 0 0 1 /end COMPU_METHOD
/begin COMPU_METHOD t_q1_ms "" RAT_FUNC "%6.2" "ms" COEFFS 0 1 0 0 0 1 /end COMPU_METHOD
/begin COMPU_METHOD U_mV_q0p9765625_COMPU "" RAT_FUNC "%6.2" "mV" COEFFS 0 1.024 0 0 0 1 /end COMPU_METHOD
/begin COMPU_METHOD Vel "" RAT_FUNC "%6.4" "km/h" COEFFS 0 100 0 0 0 1 /end COMPU_METHOD
/begin COMPU_METHOD Vel_CrCtl1_MPH "" RAT_FUNC "%6.2" "MPH" COEFFS 0 1 0 0 0 1 /end COMPU_METHOD
/begin COMPU_METHOD Volt "" RAT_FUNC "%6.3" "mV" COEFFS 0 5 0 0 0 1 /end COMPU_METHOD
/begin COMPU_METHOD Volt_Batt "" RAT_FUNC "%6.1" "mV" COEFFS 0 0.05 0 0 0 1 /end COMPU_METHOD
/begin RECORD_LAYOUT RB_Curve_S16_S16 NO_AXIS_PTS_X 1 SWORD AXIS_PTS_X 2 SWORD INDEX_INCR DIRECT FNC_VALUES 3 SWORD COLUMN_DIR DIRECT /end RECORD_LAYOUT
/begin RECORD_LAYOUT RB_Val_Wboolean FNC_VALUES 1 UBYTE COLUMN_DIR DIRECT /end RECORD_LAYOUT
/begin RECORD_LAYOUT RB_Val_Ws16 FNC_VALUES 1 SWORD COLUMN_DIR DIRECT /end RECORD_LAYOUT
/begin RECORD_LAYOUT RB_Val_Ws32 FNC_VALUES 1 SLONG COLUMN_DIR DIRECT /end RECORD_LAYOUT
/begin RECORD_LAYOUT RB_Val_Wu16 FNC_VALUES 1 UWORD COLUMN_DIR DIRECT /end RECORD_LAYOUT
/begin RECORD_LAYOUT RB_Val_Wu32 FNC_VALUES 1 ULONG COLUMN_DIR DIRECT /end RECORD_LAYOUT
/begin RECORD_LAYOUT RB_Val_Wu8 FNC_VALUES 1 UBYTE COLUMN_DIR DIRECT /end RECORD_LAYOUT
/begin RECORD_LAYOUT Val_Ws16 FNC_VALUES 1 SWORD COLUMN_DIR DIRECT /end RECORD_LAYOUT
/begin RECORD_LAYOUT Val_Wu16 FNC_VALUES 1 UWORD COLUMN_DIR DIRECT /end RECORD_LAYOUT
/begin RECORD_LAYOUT Val_Wu8 FNC_VALUES 1 UBYTE COLUMN_DIR DIRECT /end RECORD_LAYOUT
/end MODULE
/end PROJECT
