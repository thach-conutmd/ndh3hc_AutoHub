ASAP2_VERSION 1 60
/begin PROJECT MG1CS022 "MG1CS022"
/begin HEADER "" VERSION "MG1CS022_62XSC_V037" PROJECT_NO MG1CS022 /end HEADER
/begin MODULE DIM ""
/begin MOD_COMMON "" BYTE_ORDER MSB_LAST ALIGNMENT_BYTE 1 ALIGNMENT_WORD 2 ALIGNMENT_LONG 4 ALIGNMENT_INT64 4 ALIGNMENT_FLOAT32_IEEE 4 ALIGNMENT_FLOAT64_IEEE 4 DATA_SIZE 32 /end MOD_COMMON
/begin CHARACTERISTIC DFC_DisblMsk.DFC_AltIOACGFailr_C "disable mask / Disable masks of check DFC_AltIOACGFailr" VALUE 0x804F5B0A Val_Wu16 65535.00 DFES_OneToOne 0.00 65535.00 FORMAT "%8.2" /end CHARACTERISTIC
/begin CHARACTERISTIC DFC_DisblMsk.DFC_AltIOACGHiVltg_C "disable mask / Disable masks of check DFC_AltIOACGHiVltg" VALUE 0x804F5B0C Val_Wu16 65535.00 DFES_OneToOne 0.00 65535.00 FORMAT "%8.2" /end CHARACTERISTIC
/begin CHARACTERISTIC DFC_DisblMsk.DFC_AltIOACGLoVltg_C "disable mask / Disable masks of check DFC_AltIOACGLoVltg" VALUE 0x804F5B0E Val_Wu16 65535.00 DFES_OneToOne 0.00 65535.00 FORMAT "%8.2" /end CHARACTERISTIC
/begin CHARACTERISTIC DFC_DisblMsk.DFC_AltIOACGTHi_C "disable mask / Disable masks of check DFC_AltIOACGTHi" VALUE 0x804F5B10 Val_Wu16 65535.00 DFES_OneToOne 0.00 65535.00 FORMAT "%8.2" /end CHARACTERISTIC
/begin CHARACTERISTIC DFC_DisblMsk.DFC_AltIODConnACG_C "disable mask / Disable masks of check DFC_AltIODConnACG" VALUE 0x804F5B12 Val_Wu16 65535.00 DFES_OneToOne 0.00 65535.00 FORMAT "%8.2" /end CHARACTERISTIC
/begin CHARACTERISTIC DFC_DisblMsk.DFC_BGOELWAF_C "disable mask / Disable masks of check DFC_BGOELWAF" VALUE 0x804F5B14 Val_Wu16 65535.00 DFES_OneToOne 0.00 65535.00 FORMAT "%8.2" /end CHARACTERISTIC
/begin CHARACTERISTIC DFC_DisblMsk.DFC_BattUHiFailr_C "disable mask / Disable masks of check DFC_BattUHiFailr" VALUE 0x804F5B16 Val_Wu16 65535.00 DFES_OneToOne 0.00 65535.00 FORMAT "%8.2" /end CHARACTERISTIC
/begin CHARACTERISTIC DFC_DisblMsk.DFC_BattULoFailr_C "disable mask / Disable masks of check DFC_BattULoFailr" VALUE 0x804F5B18 Val_Wu16 65535.00 DFES_OneToOne 0.00 65535.00 FORMAT "%8.2" /end CHARACTERISTIC
/begin CHARACTERISTIC DFC_DisblMsk.DFC_BrkBstPDriftHiErr_C "disable mask / Disable masks of check DFC_BrkBstPDriftHiErr" VALUE 0x804F5B1A Val_Wu16 65535.00 DFES_OneToOne 0.00 65535.00 FORMAT "%8.2" /end CHARACTERISTIC
/begin CHARACTERISTIC DFC_DisblMsk.DFC_BrkBstPDriftLoErr_C "disable mask / Disable masks of check DFC_BrkBstPDriftLoErr" VALUE 0x804F5B1C Val_Wu16 65535.00 DFES_OneToOne 0.00 65535.00 FORMAT "%8.2" /end CHARACTERISTIC
/begin CHARACTERISTIC DFC_DisblMsk.DFC_BrkBstPSnsrStuck_C "disable mask / Disable masks of check DFC_BrkBstPSnsrStuck" VALUE 0x804F5B1E Val_Wu16 65535.00 DFES_OneToOne 0.00 65535.00 FORMAT "%8.2" /end CHARACTERISTIC
/begin CHARACTERISTIC DFC_DisblMsk.DFC_BrkMnSwtContOn_C "disable mask / Disable masks of check DFC_BrkMnSwtContOn" VALUE 0x804F5B20 Val_Wu16 65535.00 DFES_OneToOne 0.00 65535.00 FORMAT "%8.2" /end CHARACTERISTIC
/begin CHARACTERISTIC DFC_DisblMsk.DFC_BrkMnSwtNotStp_C "disable mask / Disable masks of check DFC_BrkMnSwtNotStp" VALUE 0x804F5B22 Val_Wu16 65535.00 DFES_OneToOne 0.00 65535.00 FORMAT "%8.2" /end CHARACTERISTIC
/begin CHARACTERISTIC DFC_DisblMsk.DFC_BrkNpl_C "disable mask / Disable masks of check DFC_BrkNpl" VALUE 0x804F5B24 Val_Wu16 65535.00 DFES_OneToOne 0.00 65535.00 FORMAT "%8.2" /end CHARACTERISTIC
/begin CHARACTERISTIC DFC_DisblMsk.DFC_BrkRdntSwtContOn_C "disable mask / Disable masks of check DFC_BrkRdntSwtContOn" VALUE 0x804F5B26 Val_Wu16 65535.00 DFES_OneToOne 0.00 65535.00 FORMAT "%8.2" /end CHARACTERISTIC
/begin CHARACTERISTIC DFC_DisblMsk.DFC_BrkRdntSwtNotStp_C "disable mask / Disable masks of check DFC_BrkRdntSwtNotStp" VALUE 0x804F5B28 Val_Wu16 65535.00 DFES_OneToOne 0.00 65535.00 FORMAT "%8.2" /end CHARACTERISTIC
/begin CHARACTERISTIC DFC_DisblMsk.DFC_Clth3ONStuck_C "disable mask / Disable masks of check DFC_Clth3ONStuck" VALUE 0x804F5B2A Val_Wu16 65535.00 DFES_OneToOne 0.00 65535.00 FORMAT "%8.2" /end CHARACTERISTIC
/begin CHARACTERISTIC DFC_DisblMsk.DFC_Clth4OFFStuck_C "disable mask / Disable masks of check DFC_Clth4OFFStuck" VALUE 0x804F5B2C Val_Wu16 65535.00 DFES_OneToOne 0.00 65535.00 FORMAT "%8.2" /end CHARACTERISTIC
/begin CHARACTERISTIC DFC_DisblMsk.DFC_ClthOFFStuck_C "disable mask / Disable masks of check DFC_ClthOFFStuck" VALUE 0x804F5B2E Val_Wu16 65535.00 DFES_OneToOne 0.00 65535.00 FORMAT "%8.2" /end CHARACTERISTIC
/begin CHARACTERISTIC DFC_DisblMsk.DFC_ClthONStuck_C "disable mask / Disable masks of check DFC_ClthONStuck" VALUE 0x804F5B30 Val_Wu16 65535.00 DFES_OneToOne 0.00 65535.00 FORMAT "%8.2" /end CHARACTERISTIC
/begin CHARACTERISTIC DFC_DisblMsk.DFC_ClthStkFailInfo_C "disable mask / Disable masks of check DFC_ClthStkFailInfo" VALUE 0x804F5B32 Val_Wu16 65535.00 DFES_OneToOne 0.00 65535.00 FORMAT "%8.2" /end CHARACTERISTIC
/begin CHARACTERISTIC DFC_DisblMsk.DFC_ComACFailInfo_C "disable mask / Disable masks of check DFC_ComACFailInfo" VALUE 0x804F5B34 Val_Wu16 65535.00 DFES_OneToOne 0.00 65535.00 FORMAT "%8.2" /end CHARACTERISTIC
/begin CHARACTERISTIC DFC_DisblMsk.DFC_ComATFTValErr_C "disable mask / Disable masks of check DFC_ComATFTValErr" VALUE 0x804F5B36 Val_Wu16 65535.00 DFES_OneToOne 0.00 65535.00 FORMAT "%8.2" /end CHARACTERISTIC
/begin CHARACTERISTIC DFC_DisblMsk.DFC_ComATMILReq_C "disable mask / Disable masks of check DFC_ComATMILReq" VALUE 0x804F5B38 Val_Wu16 65535.00 DFES_OneToOne 0.00 65535.00 FORMAT "%8.2" /end CHARACTERISTIC
/begin CHARACTERISTIC DFC_DisblMsk.DFC_ComAYCAChksum_C "disable mask / Disable masks of check DFC_ComAYCAChksum" VALUE 0x804F5B3A Val_Wu16 65535.00 DFES_OneToOne 0.00 65535.00 FORMAT "%8.2" /end CHARACTERISTIC
/begin CHARACTERISTIC DFC_DisblMsk.DFC_ComAYCARingCnt_C "disable mask / Disable masks of check DFC_ComAYCARingCnt" VALUE 0x804F5B3C Val_Wu16 65535.00 DFES_OneToOne 0.00 65535.00 FORMAT "%8.2" /end CHARACTERISTIC
/begin CHARACTERISTIC DFC_DisblMsk.DFC_ComAYCATOut_C "disable mask / Disable masks of check DFC_ComAYCATOut" VALUE 0x804F5B3E Val_Wu16 65535.00 DFES_OneToOne 0.00 65535.00 FORMAT "%8.2" /end CHARACTERISTIC
/begin CHARACTERISTIC DFC_DisblMsk.DFC_ComAYCDChkSum_C "disable mask / Disable masks of check DFC_ComAYCDChkSum" VALUE 0x804F5B40 Val_Wu16 65535.00 DFES_OneToOne 0.00 65535.00 FORMAT "%8.2" /end CHARACTERISTIC
/begin CHARACTERISTIC DFC_DisblMsk.DFC_ComAYCDTOut_C "disable mask / Disable masks of check DFC_ComAYCDTOut" VALUE 0x804F5B42 Val_Wu16 65535.00 DFES_OneToOne 0.00 65535.00 FORMAT "%8.2" /end CHARACTERISTIC
/begin CHARACTERISTIC DFC_DisblMsk.DFC_ComAYCFChksum_C "disable mask / Disable masks of check DFC_ComAYCFChksum" VALUE 0x804F5B44 Val_Wu16 65535.00 DFES_OneToOne 0.00 65535.00 FORMAT "%8.2" /end CHARACTERISTIC
/begin CHARACTERISTIC DFC_DisblMsk.DFC_ComAYCFRingCnt_C "disable mask / Disable masks of check DFC_ComAYCFRingCnt" VALUE 0x804F5B46 Val_Wu16 65535.00 DFES_OneToOne 0.00 65535.00 FORMAT "%8.2" /end CHARACTERISTIC
/begin CHARACTERISTIC DFC_DisblMsk.DFC_ComAYCFTOut_C "disable mask / Disable masks of check DFC_ComAYCFTOut" VALUE 0x804F5B48 Val_Wu16 65535.00 DFES_OneToOne 0.00 65535.00 FORMAT "%8.2" /end CHARACTERISTIC
/begin CHARACTERISTIC DFC_DisblMsk.DFC_ComAYCGChksum_C "disable mask / Disable masks of check DFC_ComAYCGChksum" VALUE 0x804F5B4A Val_Wu16 65535.00 DFES_OneToOne 0.00 65535.00 FORMAT "%8.2" /end CHARACTERISTIC
/begin CHARACTERISTIC DFC_DisblMsk.DFC_ComAYCGRingCnt_C "disable mask / Disable masks of check DFC_ComAYCGRingCnt" VALUE 0x804F5B4C Val_Wu16 65535.00 DFES_OneToOne 0.00 65535.00 FORMAT "%8.2" /end CHARACTERISTIC
/begin CHARACTERISTIC DFC_DisblMsk.DFC_ComAYCGTOut_C "disable mask / Disable masks of check DFC_ComAYCGTOut" VALUE 0x804F5B4E Val_Wu16 65535.00 DFES_OneToOne 0.00 65535.00 FORMAT "%8.2" /end CHARACTERISTIC
/begin CHARACTERISTIC DFC_DisblMsk.DFC_ComAYCIChkSum_C "disable mask / Disable masks of check DFC_ComAYCIChkSum" VALUE 0x804F5B50 Val_Wu16 65535.00 DFES_OneToOne 0.00 65535.00 FORMAT "%8.2" /end CHARACTERISTIC
/begin CHARACTERISTIC DFC_DisblMsk.DFC_ComAYCIRingCnt_C "disable mask / Disable masks of check DFC_ComAYCIRingCnt" VALUE 0x804F5B52 Val_Wu16 65535.00 DFES_OneToOne 0.00 65535.00 FORMAT "%8.2" /end CHARACTERISTIC
/begin CHARACTERISTIC DFC_DisblMsk.DFC_ComAYCITOut_C "disable mask / Disable masks of check DFC_ComAYCITOut" VALUE 0x804F5B54 Val_Wu16 65535.00 DFES_OneToOne 0.00 65535.00 FORMAT "%8.2" /end CHARACTERISTIC
/begin CHARACTERISTIC DFC_DisblMsk.DFC_ComBCM1ChkSum_C "disable mask / Disable masks of check DFC_ComBCM1ChkSum" VALUE 0x804F5B56 Val_Wu16 65535.00 DFES_OneToOne 0.00 65535.00 FORMAT "%8.2" /end CHARACTERISTIC
/begin CHARACTERISTIC DFC_DisblMsk.DFC_ComBCM1RingCnt_C "disable mask / Disable masks of check DFC_ComBCM1RingCnt" VALUE 0x804F5B58 Val_Wu16 65535.00 DFES_OneToOne 0.00 65535.00 FORMAT "%8.2" /end CHARACTERISTIC
/begin CHARACTERISTIC DFC_DisblMsk.DFC_ComBCM1TOut_C "disable mask / Disable masks of check DFC_ComBCM1TOut" VALUE 0x804F5B5A Val_Wu16 65535.00 DFES_OneToOne 0.00 65535.00 FORMAT "%8.2" /end CHARACTERISTIC
/begin CHARACTERISTIC DFC_DisblMsk.DFC_ComCANABusOffErr_C "disable mask / Disable masks of check DFC_ComCANABusOffErr" VALUE 0x804F5B5C Val_Wu16 65535.00 DFES_OneToOne 0.00 65535.00 FORMAT "%8.2" /end CHARACTERISTIC
/begin CHARACTERISTIC DFC_DisblMsk.DFC_ComCANBBusOffErr_C "disable mask / Disable masks of check DFC_ComCANBBusOffErr" VALUE 0x804F5B5E Val_Wu16 65535.00 DFES_OneToOne 0.00 65535.00 FORMAT "%8.2" /end CHARACTERISTIC
/begin CHARACTERISTIC DFC_DisblMsk.DFC_ComCANCBusOffErr_C "disable mask / Disable masks of check DFC_ComCANCBusOffErr" VALUE 0x804F5B60 Val_Wu16 65535.00 DFES_OneToOne 0.00 65535.00 FORMAT "%8.2" /end CHARACTERISTIC
/begin CHARACTERISTIC DFC_DisblMsk.DFC_ComCGW1ChkSum_C "disable mask / Disable masks of check DFC_ComCGW1ChkSum" VALUE 0x804F5B62 Val_Wu16 65535.00 DFES_OneToOne 0.00 65535.00 FORMAT "%8.2" /end CHARACTERISTIC
/begin CHARACTERISTIC DFC_DisblMsk.DFC_ComCGW1RingCnt_C "disable mask / Disable masks of check DFC_ComCGW1RingCnt" VALUE 0x804F5B64 Val_Wu16 65535.00 DFES_OneToOne 0.00 65535.00 FORMAT "%8.2" /end CHARACTERISTIC
/begin CHARACTERISTIC DFC_DisblMsk.DFC_ComCGW1TOut_C "disable mask / Disable masks of check DFC_ComCGW1TOut" VALUE 0x804F5B66 Val_Wu16 65535.00 DFES_OneToOne 0.00 65535.00 FORMAT "%8.2" /end CHARACTERISTIC
/begin CHARACTERISTIC DFC_DisblMsk.DFC_ComConvBoostErr_C "disable mask / Disable masks of check DFC_ComConvBoostErr" VALUE 0x804F5B68 Val_Wu16 65535.00 DFES_OneToOne 0.00 65535.00 FORMAT "%8.2" /end CHARACTERISTIC
/begin CHARACTERISTIC DFC_DisblMsk.DFC_ComConvSlipErr_C "disable mask / Disable masks of check DFC_ComConvSlipErr" VALUE 0x804F5B6A Val_Wu16 65535.00 DFES_OneToOne 0.00 65535.00 FORMAT "%8.2" /end CHARACTERISTIC
/begin CHARACTERISTIC DFC_DisblMsk.DFC_ComDCDCPrfmncErr_C "disable mask / Disable masks of check DFC_ComDCDCPrfmncErr" VALUE 0x804F5B6C Val_Wu16 65535.00 DFES_OneToOne 0.00 65535.00 FORMAT "%8.2" /end CHARACTERISTIC
/begin CHARACTERISTIC DFC_DisblMsk.DFC_ComDCDCTempWarn_C "disable mask / Disable masks of check DFC_ComDCDCTempWarn" VALUE 0x804F5B6E Val_Wu16 65535.00 DFES_OneToOne 0.00 65535.00 FORMAT "%8.2" /end CHARACTERISTIC
/begin CHARACTERISTIC DFC_DisblMsk.DFC_ComEAT10Chksum_C "disable mask / Disable masks of check DFC_ComEAT10Chksum" VALUE 0x804F5B70 Val_Wu16 65535.00 DFES_OneToOne 0.00 65535.00 FORMAT "%8.2" /end CHARACTERISTIC
/begin CHARACTERISTIC DFC_DisblMsk.DFC_ComEAT10RingCnt_C "disable mask / Disable masks of check DFC_ComEAT10RingCnt" VALUE 0x804F5B72 Val_Wu16 65535.00 DFES_OneToOne 0.00 65535.00 FORMAT "%8.2" /end CHARACTERISTIC
/begin CHARACTERISTIC DFC_DisblMsk.DFC_ComEAT10TOut_C "disable mask / Disable masks of check DFC_ComEAT10TOut" VALUE 0x804F5B74 Val_Wu16 65535.00 DFES_OneToOne 0.00 65535.00 FORMAT "%8.2" /end CHARACTERISTIC
/begin CHARACTERISTIC DFC_DisblMsk.DFC_ComEAT11ChkSum_C "disable mask / Disable masks of check DFC_ComEAT11ChkSum" VALUE 0x804F5B76 Val_Wu16 65535.00 DFES_OneToOne 0.00 65535.00 FORMAT "%8.2" /end CHARACTERISTIC
/begin CHARACTERISTIC DFC_DisblMsk.DFC_ComEAT11RingCnt_C "disable mask / Disable masks of check DFC_ComEAT11RingCnt" VALUE 0x804F5B78 Val_Wu16 65535.00 DFES_OneToOne 0.00 65535.00 FORMAT "%8.2" /end CHARACTERISTIC
/begin CHARACTERISTIC DFC_DisblMsk.DFC_ComEAT11TOut_C "disable mask / Disable masks of check DFC_ComEAT11TOut" VALUE 0x804F5B7A Val_Wu16 65535.00 DFES_OneToOne 0.00 65535.00 FORMAT "%8.2" /end CHARACTERISTIC
/begin CHARACTERISTIC DFC_DisblMsk.DFC_ComEAT12ChkSum_C "disable mask / Disable masks of check DFC_ComEAT12ChkSum" VALUE 0x804F5B7C Val_Wu16 65535.00 DFES_OneToOne 0.00 65535.00 FORMAT "%8.2" /end CHARACTERISTIC
/begin CHARACTERISTIC DFC_DisblMsk.DFC_ComEAT12RingCnt_C "disable mask / Disable masks of check DFC_ComEAT12RingCnt" VALUE 0x804F5B7E Val_Wu16 65535.00 DFES_OneToOne 0.00 65535.00 FORMAT "%8.2" /end CHARACTERISTIC
/begin CHARACTERISTIC DFC_DisblMsk.DFC_ComEAT12TOut_C "disable mask / Disable masks of check DFC_ComEAT12TOut" VALUE 0x804F5B80 Val_Wu16 65535.00 DFES_OneToOne 0.00 65535.00 FORMAT "%8.2" /end CHARACTERISTIC
/begin CHARACTERISTIC DFC_DisblMsk.DFC_ComEAT13ChkSum_C "disable mask / Disable masks of check DFC_ComEAT13ChkSum" VALUE 0x804F5B82 Val_Wu16 65535.00 DFES_OneToOne 0.00 65535.00 FORMAT "%8.2" /end CHARACTERISTIC
/begin CHARACTERISTIC DFC_DisblMsk.DFC_ComEAT13RingCnt_C "disable mask / Disable masks of check DFC_ComEAT13RingCnt" VALUE 0x804F5B84 Val_Wu16 65535.00 DFES_OneToOne 0.00 65535.00 FORMAT "%8.2" /end CHARACTERISTIC
/begin CHARACTERISTIC DFC_DisblMsk.DFC_ComEAT13TOut_C "disable mask / Disable masks of check DFC_ComEAT13TOut" VALUE 0x804F5B86 Val_Wu16 65535.00 DFES_OneToOne 0.00 65535.00 FORMAT "%8.2" /end CHARACTERISTIC
/begin CHARACTERISTIC DFC_DisblMsk.DFC_ComEAT1Chksum_C "disable mask / Disable masks of check DFC_ComEAT1Chksum" VALUE 0x804F5B88 Val_Wu16 65535.00 DFES_OneToOne 0.00 65535.00 FORMAT "%8.2" /end CHARACTERISTIC
/begin CHARACTERISTIC DFC_DisblMsk.DFC_ComEAT1RingCnt_C "disable mask / Disable masks of check DFC_ComEAT1RingCnt" VALUE 0x804F5B8A Val_Wu16 65535.00 DFES_OneToOne 0.00 65535.00 FORMAT "%8.2" /end CHARACTERISTIC
/begin CHARACTERISTIC DFC_DisblMsk.DFC_ComEAT1TOut_C "disable mask / Disable masks of check DFC_ComEAT1TOut" VALUE 0x804F5B8C Val_Wu16 65535.00 DFES_OneToOne 0.00 65535.00 FORMAT "%8.2" /end CHARACTERISTIC
/begin CHARACTERISTIC DFC_DisblMsk.DFC_ComEAT2ChkSum_C "disable mask / Disable masks of check DFC_ComEAT2ChkSum" VALUE 0x804F5B8E Val_Wu16 65535.00 DFES_OneToOne 0.00 65535.00 FORMAT "%8.2" /end CHARACTERISTIC
/begin CHARACTERISTIC DFC_DisblMsk.DFC_ComEAT2RingCnt_C "disable mask / Disable masks of check DFC_ComEAT2RingCnt" VALUE 0x804F5B90 Val_Wu16 65535.00 DFES_OneToOne 0.00 65535.00 FORMAT "%8.2" /end CHARACTERISTIC
/begin CHARACTERISTIC DFC_DisblMsk.DFC_ComEAT2TOut_C "disable mask / Disable masks of check DFC_ComEAT2TOut" VALUE 0x804F5B92 Val_Wu16 65535.00 DFES_OneToOne 0.00 65535.00 FORMAT "%8.2" /end CHARACTERISTIC
/begin CHARACTERISTIC DFC_DisblMsk.DFC_ComEAT4ChkSum_C "disable mask / Disable masks of check DFC_ComEAT4ChkSum" VALUE 0x804F5B94 Val_Wu16 65535.00 DFES_OneToOne 0.00 65535.00 FORMAT "%8.2" /end CHARACTERISTIC
/begin CHARACTERISTIC DFC_DisblMsk.DFC_ComEAT4RingCnt_C "disable mask / Disable masks of check DFC_ComEAT4RingCnt" VALUE 0x804F5B96 Val_Wu16 65535.00 DFES_OneToOne 0.00 65535.00 FORMAT "%8.2" /end CHARACTERISTIC
/begin CHARACTERISTIC DFC_DisblMsk.DFC_ComEAT4TOut_C "disable mask / Disable masks of check DFC_ComEAT4TOut" VALUE 0x804F5B98 Val_Wu16 65535.00 DFES_OneToOne 0.00 65535.00 FORMAT "%8.2" /end CHARACTERISTIC
/begin CHARACTERISTIC DFC_DisblMsk.DFC_ComEAT6Chksum_C "disable mask / Disable masks of check DFC_ComEAT6Chksum" VALUE 0x804F5B9A Val_Wu16 65535.00 DFES_OneToOne 0.00 65535.00 FORMAT "%8.2" /end CHARACTERISTIC
/begin CHARACTERISTIC DFC_DisblMsk.DFC_ComEAT6RingCnt_C "disable mask / Disable masks of check DFC_ComEAT6RingCnt" VALUE 0x804F5B9C Val_Wu16 65535.00 DFES_OneToOne 0.00 65535.00 FORMAT "%8.2" /end CHARACTERISTIC
/begin CHARACTERISTIC DFC_DisblMsk.DFC_ComEAT6TOut_C "disable mask / Disable masks of check DFC_ComEAT6TOut" VALUE 0x804F5B9E Val_Wu16 65535.00 DFES_OneToOne 0.00 65535.00 FORMAT "%8.2" /end CHARACTERISTIC
/begin CHARACTERISTIC DFC_DisblMsk.DFC_ComEAT7Chksum_C "disable mask / Disable masks of check DFC_ComEAT7Chksum" VALUE 0x804F5BA0 Val_Wu16 65535.00 DFES_OneToOne 0.00 65535.00 FORMAT "%8.2" /end CHARACTERISTIC
/begin CHARACTERISTIC DFC_DisblMsk.DFC_ComEAT7RingCnt_C "disable mask / Disable masks of check DFC_ComEAT7RingCnt" VALUE 0x804F5BA2 Val_Wu16 65535.00 DFES_OneToOne 0.00 65535.00 FORMAT "%8.2" /end CHARACTERISTIC
/begin CHARACTERISTIC DFC_DisblMsk.DFC_ComEAT7TOut_C "disable mask / Disable masks of check DFC_ComEAT7TOut" VALUE 0x804F5BA4 Val_Wu16 65535.00 DFES_OneToOne 0.00 65535.00 FORMAT "%8.2" /end CHARACTERISTIC
/begin CHARACTERISTIC DFC_DisblMsk.DFC_ComEAT8Chksum_C "disable mask / Disable masks of check DFC_ComEAT8Chksum" VALUE 0x804F5BA6 Val_Wu16 65535.00 DFES_OneToOne 0.00 65535.00 FORMAT "%8.2" /end CHARACTERISTIC
/begin CHARACTERISTIC DFC_DisblMsk.DFC_ComEAT8RingCnt_C "disable mask / Disable masks of check DFC_ComEAT8RingCnt" VALUE 0x804F5BA8 Val_Wu16 65535.00 DFES_OneToOne 0.00 65535.00 FORMAT "%8.2" /end CHARACTERISTIC
/begin CHARACTERISTIC DFC_DisblMsk.DFC_ComEAT8TOut_C "disable mask / Disable masks of check DFC_ComEAT8TOut" VALUE 0x804F5BAA Val_Wu16 65535.00 DFES_OneToOne 0.00 65535.00 FORMAT "%8.2" /end CHARACTERISTIC
/begin CHARACTERISTIC DFC_DisblMsk.DFC_ComEATAChksum_C "disable mask / Disable masks of check DFC_ComEATAChksum" VALUE 0x804F5BAC Val_Wu16 65535.00 DFES_OneToOne 0.00 65535.00 FORMAT "%8.2" /end CHARACTERISTIC
/begin CHARACTERISTIC DFC_DisblMsk.DFC_ComEATARingCnt_C "disable mask / Disable masks of check DFC_ComEATARingCnt" VALUE 0x804F5BAE Val_Wu16 65535.00 DFES_OneToOne 0.00 65535.00 FORMAT "%8.2" /end CHARACTERISTIC
/begin CHARACTERISTIC DFC_DisblMsk.DFC_ComEATATOut_C "disable mask / Disable masks of check DFC_ComEATATOut" VALUE 0x804F5BB0 Val_Wu16 65535.00 DFES_OneToOne 0.00 65535.00 FORMAT "%8.2" /end CHARACTERISTIC
/begin CHARACTERISTIC DFC_DisblMsk.DFC_ComEATBChkSum_C "disable mask / Disable masks of check DFC_ComEATBChkSum" VALUE 0x804F5BB2 Val_Wu16 65535.00 DFES_OneToOne 0.00 65535.00 FORMAT "%8.2" /end CHARACTERISTIC
/begin CHARACTERISTIC DFC_DisblMsk.DFC_ComEATBRingCnt_C "disable mask / Disable masks of check DFC_ComEATBRingCnt" VALUE 0x804F5BB4 Val_Wu16 65535.00 DFES_OneToOne 0.00 65535.00 FORMAT "%8.2" /end CHARACTERISTIC
/begin CHARACTERISTIC DFC_DisblMsk.DFC_ComEATBTOut_C "disable mask / Disable masks of check DFC_ComEATBTOut" VALUE 0x804F5BB6 Val_Wu16 65535.00 DFES_OneToOne 0.00 65535.00 FORMAT "%8.2" /end CHARACTERISTIC
/begin CHARACTERISTIC DFC_DisblMsk.DFC_ComEATCChksum_C "disable mask / Disable masks of check DFC_ComEATCChksum" VALUE 0x804F5BB8 Val_Wu16 65535.00 DFES_OneToOne 0.00 65535.00 FORMAT "%8.2" /end CHARACTERISTIC
/begin CHARACTERISTIC DFC_DisblMsk.DFC_ComEATCRingCnt_C "disable mask / Disable masks of check DFC_ComEATCRingCnt" VALUE 0x804F5BBA Val_Wu16 65535.00 DFES_OneToOne 0.00 65535.00 FORMAT "%8.2" /end CHARACTERISTIC
/begin CHARACTERISTIC DFC_DisblMsk.DFC_ComEATCTOut_C "disable mask / Disable masks of check DFC_ComEATCTOut" VALUE 0x804F5BBC Val_Wu16 65535.00 DFES_OneToOne 0.00 65535.00 FORMAT "%8.2" /end CHARACTERISTIC
/begin CHARACTERISTIC DFC_DisblMsk.DFC_ComEPBBChkSum_C "disable mask / Disable masks of check DFC_ComEPBBChkSum" VALUE 0x804F5BBE Val_Wu16 65535.00 DFES_OneToOne 0.00 65535.00 FORMAT "%8.2" /end CHARACTERISTIC
/begin CHARACTERISTIC DFC_DisblMsk.DFC_ComEPBBRingCnt_C "disable mask / Disable masks of check DFC_ComEPBBRingCnt" VALUE 0x804F5BC0 Val_Wu16 65535.00 DFES_OneToOne 0.00 65535.00 FORMAT "%8.2" /end CHARACTERISTIC
/begin CHARACTERISTIC DFC_DisblMsk.DFC_ComEPBBTOut_C "disable mask / Disable masks of check DFC_ComEPBBTOut" VALUE 0x804F5BC2 Val_Wu16 65535.00 DFES_OneToOne 0.00 65535.00 FORMAT "%8.2" /end CHARACTERISTIC
/begin CHARACTERISTIC DFC_DisblMsk.DFC_ComEPBChksum_C "disable mask / Disable masks of check DFC_ComEPBChksum" VALUE 0x804F5BC4 Val_Wu16 65535.00 DFES_OneToOne 0.00 65535.00 FORMAT "%8.2" /end CHARACTERISTIC
/begin CHARACTERISTIC DFC_DisblMsk.DFC_ComEPBTOut_C "disable mask / Disable masks of check DFC_ComEPBTOut" VALUE 0x804F5BC6 Val_Wu16 65535.00 DFES_OneToOne 0.00 65535.00 FORMAT "%8.2" /end CHARACTERISTIC
/begin CHARACTERISTIC DFC_DisblMsk.DFC_ComEPBctRing_C "disable mask / Disable masks of check DFC_ComEPBctRing" VALUE 0x804F5BC8 Val_Wu16 65535.00 DFES_OneToOne 0.00 65535.00 FORMAT "%8.2" /end CHARACTERISTIC
/begin CHARACTERISTIC DFC_DisblMsk.DFC_ComEPS1Chksum_C "disable mask / Disable masks of check DFC_ComEPS1Chksum" VALUE 0x804F5BCA Val_Wu16 65535.00 DFES_OneToOne 0.00 65535.00 FORMAT "%8.2" /end CHARACTERISTIC
/begin CHARACTERISTIC DFC_DisblMsk.DFC_ComEPS1RingCnt_C "disable mask / Disable masks of check DFC_ComEPS1RingCnt" VALUE 0x804F5BCC Val_Wu16 65535.00 DFES_OneToOne 0.00 65535.00 FORMAT "%8.2" /end CHARACTERISTIC
/begin CHARACTERISTIC DFC_DisblMsk.DFC_ComEPS1TOut_C "disable mask / Disable masks of check DFC_ComEPS1TOut" VALUE 0x804F5BCE Val_Wu16 65535.00 DFES_OneToOne 0.00 65535.00 FORMAT "%8.2" /end CHARACTERISTIC
/begin CHARACTERISTIC DFC_DisblMsk.DFC_ComEngCanRxErr_C "disable mask / Disable masks of check DFC_ComEngCanRxErr" VALUE 0x804F5BD0 Val_Wu16 65535.00 DFES_OneToOne 0.00 65535.00 FORMAT "%8.2" /end CHARACTERISTIC
/begin CHARACTERISTIC DFC_DisblMsk.DFC_ComGrvySnsrErr_C "disable mask / Disable masks of check DFC_ComGrvySnsrErr" VALUE 0x804F5BD2 Val_Wu16 65535.00 DFES_OneToOne 0.00 65535.00 FORMAT "%8.2" /end CHARACTERISTIC
/begin CHARACTERISTIC DFC_DisblMsk.DFC_ComGwIMG1ChkSum_C "disable mask / Disable masks of check DFC_ComGwIMG1ChkSum" VALUE 0x804F5BD4 Val_Wu16 65535.00 DFES_OneToOne 0.00 65535.00 FORMAT "%8.2" /end CHARACTERISTIC
/begin CHARACTERISTIC DFC_DisblMsk.DFC_ComGwIMG1RingCnt_C "disable mask / Disable masks of check DFC_ComGwIMG1RingCnt" VALUE 0x804F5BD6 Val_Wu16 65535.00 DFES_OneToOne 0.00 65535.00 FORMAT "%8.2" /end CHARACTERISTIC
/begin CHARACTERISTIC DFC_DisblMsk.DFC_ComGwIMG1TOut_C "disable mask / Disable masks of check DFC_ComGwIMG1TOut" VALUE 0x804F5BD8 Val_Wu16 65535.00 DFES_OneToOne 0.00 65535.00 FORMAT "%8.2" /end CHARACTERISTIC
/begin CHARACTERISTIC DFC_DisblMsk.DFC_ComGwIMG3ChkSum_C "disable mask / Disable masks of check DFC_ComGwIMG3ChkSum" VALUE 0x804F5BDA Val_Wu16 65535.00 DFES_OneToOne 0.00 65535.00 FORMAT "%8.2" /end CHARACTERISTIC
/begin CHARACTERISTIC DFC_DisblMsk.DFC_ComGwIMG3RingCnt_C "disable mask / Disable masks of check DFC_ComGwIMG3RingCnt" VALUE 0x804F5BDC Val_Wu16 65535.00 DFES_OneToOne 0.00 65535.00 FORMAT "%8.2" /end CHARACTERISTIC
/begin CHARACTERISTIC DFC_DisblMsk.DFC_ComGwIMG3TOut_C "disable mask / Disable masks of check DFC_ComGwIMG3TOut" VALUE 0x804F5BDE Val_Wu16 65535.00 DFES_OneToOne 0.00 65535.00 FORMAT "%8.2" /end CHARACTERISTIC
/begin CHARACTERISTIC DFC_DisblMsk.DFC_ComGwIMG4ChkSum_C "disable mask / Disable masks of check DFC_ComGwIMG4ChkSum" VALUE 0x804F5BE0 Val_Wu16 65535.00 DFES_OneToOne 0.00 65535.00 FORMAT "%8.2" /end CHARACTERISTIC
/begin CHARACTERISTIC DFC_DisblMsk.DFC_ComGwIMG4RingCnt_C "disable mask / Disable masks of check DFC_ComGwIMG4RingCnt" VALUE 0x804F5BE2 Val_Wu16 65535.00 DFES_OneToOne 0.00 65535.00 FORMAT "%8.2" /end CHARACTERISTIC
/begin CHARACTERISTIC DFC_DisblMsk.DFC_ComGwIMG4TOut_C "disable mask / Disable masks of check DFC_ComGwIMG4TOut" VALUE 0x804F5BE4 Val_Wu16 65535.00 DFES_OneToOne 0.00 65535.00 FORMAT "%8.2" /end CHARACTERISTIC
/begin CHARACTERISTIC DFC_DisblMsk.DFC_ComGwIMG5ChkSum_C "disable mask / Disable masks of check DFC_ComGwIMG5ChkSum" VALUE 0x804F5BE6 Val_Wu16 65535.00 DFES_OneToOne 0.00 65535.00 FORMAT "%8.2" /end CHARACTERISTIC
/begin CHARACTERISTIC DFC_DisblMsk.DFC_ComGwIMG5RingCnt_C "disable mask / Disable masks of check DFC_ComGwIMG5RingCnt" VALUE 0x804F5BE8 Val_Wu16 65535.00 DFES_OneToOne 0.00 65535.00 FORMAT "%8.2" /end CHARACTERISTIC
/begin CHARACTERISTIC DFC_DisblMsk.DFC_ComGwIMG5TOut_C "disable mask / Disable masks of check DFC_ComGwIMG5TOut" VALUE 0x804F5BEA Val_Wu16 65535.00 DFES_OneToOne 0.00 65535.00 FORMAT "%8.2" /end CHARACTERISTIC
/begin CHARACTERISTIC DFC_DisblMsk.DFC_ComGwIMG6ChkSum_C "disable mask / Disable masks of check DFC_ComGwIMG6ChkSum" VALUE 0x804F5BEC Val_Wu16 65535.00 DFES_OneToOne 0.00 65535.00 FORMAT "%8.2" /end CHARACTERISTIC
/begin CHARACTERISTIC DFC_DisblMsk.DFC_ComGwIMG6RingCnt_C "disable mask / Disable masks of check DFC_ComGwIMG6RingCnt" VALUE 0x804F5BEE Val_Wu16 65535.00 DFES_OneToOne 0.00 65535.00 FORMAT "%8.2" /end CHARACTERISTIC
/begin CHARACTERISTIC DFC_DisblMsk.DFC_ComGwIMG6TOut_C "disable mask / Disable masks of check DFC_ComGwIMG6TOut" VALUE 0x804F5BF0 Val_Wu16 65535.00 DFES_OneToOne 0.00 65535.00 FORMAT "%8.2" /end CHARACTERISTIC
/begin CHARACTERISTIC DFC_DisblMsk.DFC_ComIDASBChksum_C "disable mask / Disable masks of check DFC_ComIDASBChksum" VALUE 0x804F5BF2 Val_Wu16 65535.00 DFES_OneToOne 0.00 65535.00 FORMAT "%8.2" /end CHARACTERISTIC
/begin CHARACTERISTIC DFC_DisblMsk.DFC_ComIDASBRingCnt_C "disable mask / Disable masks of check DFC_ComIDASBRingCnt" VALUE 0x804F5BF4 Val_Wu16 65535.00 DFES_OneToOne 0.00 65535.00 FORMAT "%8.2" /end CHARACTERISTIC
/begin CHARACTERISTIC DFC_DisblMsk.DFC_ComIDASBTOut_C "disable mask / Disable masks of check DFC_ComIDASBTOut" VALUE 0x804F5BF6 Val_Wu16 65535.00 DFES_OneToOne 0.00 65535.00 FORMAT "%8.2" /end CHARACTERISTIC
/begin CHARACTERISTIC DFC_DisblMsk.DFC_ComIMGMILReq_C "disable mask / Disable masks of check DFC_ComIMGMILReq" VALUE 0x804F5BF8 Val_Wu16 65535.00 DFES_OneToOne 0.00 65535.00 FORMAT "%8.2" /end CHARACTERISTIC
/begin CHARACTERISTIC DFC_DisblMsk.DFC_ComISSPrms_C "disable mask / Disable masks of check DFC_ComISSPrms" VALUE 0x804F5BFA Val_Wu16 65535.00 DFES_OneToOne 0.00 65535.00 FORMAT "%8.2" /end CHARACTERISTIC
/begin CHARACTERISTIC DFC_DisblMsk.DFC_ComMETAChksum_C "disable mask / Disable masks of check DFC_ComMETAChksum" VALUE 0x804F5BFC Val_Wu16 65535.00 DFES_OneToOne 0.00 65535.00 FORMAT "%8.2" /end CHARACTERISTIC
/begin CHARACTERISTIC DFC_DisblMsk.DFC_ComMETAChksumPstDrv_C "disable mask / Disable masks of check DFC_ComMETAChksumPstDrv" VALUE 0x804F5BFE Val_Wu16 65535.00 DFES_OneToOne 0.00 65535.00 FORMAT "%8.2" /end CHARACTERISTIC
/begin CHARACTERISTIC DFC_DisblMsk.DFC_ComMETARingCnt_C "disable mask / Disable masks of check DFC_ComMETARingCnt" VALUE 0x804F5C00 Val_Wu16 65535.00 DFES_OneToOne 0.00 65535.00 FORMAT "%8.2" /end CHARACTERISTIC
/begin CHARACTERISTIC DFC_DisblMsk.DFC_ComMETARingCntPstDrv_C "disable mask / Disable masks of check DFC_ComMETARingCntPstDrv" VALUE 0x804F5C02 Val_Wu16 65535.00 DFES_OneToOne 0.00 65535.00 FORMAT "%8.2" /end CHARACTERISTIC
/begin CHARACTERISTIC DFC_DisblMsk.DFC_ComMETATOut_C "disable mask / Disable masks of check DFC_ComMETATOut" VALUE 0x804F5C04 Val_Wu16 65535.00 DFES_OneToOne 0.00 65535.00 FORMAT "%8.2" /end CHARACTERISTIC
/begin CHARACTERISTIC DFC_DisblMsk.DFC_ComMETATOutPstDrv_C "disable mask / Disable masks of check DFC_ComMETATOutPstDrv" VALUE 0x804F5C06 Val_Wu16 65535.00 DFES_OneToOne 0.00 65535.00 FORMAT "%8.2" /end CHARACTERISTIC
/begin CHARACTERISTIC DFC_DisblMsk.DFC_ComMETCChksum_C "disable mask / Disable masks of check DFC_ComMETCChksum" VALUE 0x804F5C08 Val_Wu16 65535.00 DFES_OneToOne 0.00 65535.00 FORMAT "%8.2" /end CHARACTERISTIC
/begin CHARACTERISTIC DFC_DisblMsk.DFC_ComMETCRingCnt_C "disable mask / Disable masks of check DFC_ComMETCRingCnt" VALUE 0x804F5C0A Val_Wu16 65535.00 DFES_OneToOne 0.00 65535.00 FORMAT "%8.2" /end CHARACTERISTIC
/begin CHARACTERISTIC DFC_DisblMsk.DFC_ComMETCTOut_C "disable mask / Disable masks of check DFC_ComMETCTOut" VALUE 0x804F5C0C Val_Wu16 65535.00 DFES_OneToOne 0.00 65535.00 FORMAT "%8.2" /end CHARACTERISTIC
/begin CHARACTERISTIC DFC_DisblMsk.DFC_ComMETDChksum_C "disable mask / Disable masks of check DFC_ComMETDChksum" VALUE 0x804F5C0E Val_Wu16 65535.00 DFES_OneToOne 0.00 65535.00 FORMAT "%8.2" /end CHARACTERISTIC
/begin CHARACTERISTIC DFC_DisblMsk.DFC_ComMETDRingCnt_C "disable mask / Disable masks of check DFC_ComMETDRingCnt" VALUE 0x804F5C10 Val_Wu16 65535.00 DFES_OneToOne 0.00 65535.00 FORMAT "%8.2" /end CHARACTERISTIC
/begin CHARACTERISTIC DFC_DisblMsk.DFC_ComMETDTOut_C "disable mask / Disable masks of check DFC_ComMETDTOut" VALUE 0x804F5C12 Val_Wu16 65535.00 DFES_OneToOne 0.00 65535.00 FORMAT "%8.2" /end CHARACTERISTIC
/begin CHARACTERISTIC DFC_DisblMsk.DFC_ComMETE2Chksum_C "disable mask / Disable masks of check DFC_ComMETE2Chksum" VALUE 0x804F5C14 Val_Wu16 65535.00 DFES_OneToOne 0.00 65535.00 FORMAT "%8.2" /end CHARACTERISTIC
/begin CHARACTERISTIC DFC_DisblMsk.DFC_ComMETE2RingCnt_C "disable mask / Disable masks of check DFC_ComMETE2RingCnt" VALUE 0x804F5C16 Val_Wu16 65535.00 DFES_OneToOne 0.00 65535.00 FORMAT "%8.2" /end CHARACTERISTIC
/begin CHARACTERISTIC DFC_DisblMsk.DFC_ComMETE2TOut_C "disable mask / Disable masks of check DFC_ComMETE2TOut" VALUE 0x804F5C18 Val_Wu16 65535.00 DFES_OneToOne 0.00 65535.00 FORMAT "%8.2" /end CHARACTERISTIC
/begin CHARACTERISTIC DFC_DisblMsk.DFC_ComMETFChksum_C "disable mask / Disable masks of check DFC_ComMETFChksum" VALUE 0x804F5C1A Val_Wu16 65535.00 DFES_OneToOne 0.00 65535.00 FORMAT "%8.2" /end CHARACTERISTIC
/begin CHARACTERISTIC DFC_DisblMsk.DFC_ComMETFRingCnt_C "disable mask / Disable masks of check DFC_ComMETFRingCnt" VALUE 0x804F5C1C Val_Wu16 65535.00 DFES_OneToOne 0.00 65535.00 FORMAT "%8.2" /end CHARACTERISTIC
/begin CHARACTERISTIC DFC_DisblMsk.DFC_ComMETFTOut_C "disable mask / Disable masks of check DFC_ComMETFTOut" VALUE 0x804F5C1E Val_Wu16 65535.00 DFES_OneToOne 0.00 65535.00 FORMAT "%8.2" /end CHARACTERISTIC
/begin CHARACTERISTIC DFC_DisblMsk.DFC_ComMETGChksum_C "disable mask / Disable masks of check DFC_ComMETGChksum" VALUE 0x804F5C20 Val_Wu16 65535.00 DFES_OneToOne 0.00 65535.00 FORMAT "%8.2" /end CHARACTERISTIC
/begin CHARACTERISTIC DFC_DisblMsk.DFC_ComMETGRingCnt_C "disable mask / Disable masks of check DFC_ComMETGRingCnt" VALUE 0x804F5C22 Val_Wu16 65535.00 DFES_OneToOne 0.00 65535.00 FORMAT "%8.2" /end CHARACTERISTIC
/begin CHARACTERISTIC DFC_DisblMsk.DFC_ComMETGTOut_C "disable mask / Disable masks of check DFC_ComMETGTOut" VALUE 0x804F5C24 Val_Wu16 65535.00 DFES_OneToOne 0.00 65535.00 FORMAT "%8.2" /end CHARACTERISTIC
/begin CHARACTERISTIC DFC_DisblMsk.DFC_ComMETH2Chksum_C "disable mask / Disable masks of check DFC_ComMETH2Chksum" VALUE 0x804F5C26 Val_Wu16 65535.00 DFES_OneToOne 0.00 65535.00 FORMAT "%8.2" /end CHARACTERISTIC
/begin CHARACTERISTIC DFC_DisblMsk.DFC_ComMETH2RingCnt_C "disable mask / Disable masks of check DFC_ComMETH2RingCnt" VALUE 0x804F5C28 Val_Wu16 65535.00 DFES_OneToOne 0.00 65535.00 FORMAT "%8.2" /end CHARACTERISTIC
/begin CHARACTERISTIC DFC_DisblMsk.DFC_ComMETH2TOut_C "disable mask / Disable masks of check DFC_ComMETH2TOut" VALUE 0x804F5C2A Val_Wu16 65535.00 DFES_OneToOne 0.00 65535.00 FORMAT "%8.2" /end CHARACTERISTIC
/begin CHARACTERISTIC DFC_DisblMsk.DFC_ComMETHChksum_C "disable mask / Disable masks of check DFC_ComMETHChksum" VALUE 0x804F5C2C Val_Wu16 65535.00 DFES_OneToOne 0.00 65535.00 FORMAT "%8.2" /end CHARACTERISTIC
/begin CHARACTERISTIC DFC_DisblMsk.DFC_ComMETHRingCnt_C "disable mask / Disable masks of check DFC_ComMETHRingCnt" VALUE 0x804F5C2E Val_Wu16 65535.00 DFES_OneToOne 0.00 65535.00 FORMAT "%8.2" /end CHARACTERISTIC
/begin CHARACTERISTIC DFC_DisblMsk.DFC_ComMETHTOut_C "disable mask / Disable masks of check DFC_ComMETHTOut" VALUE 0x804F5C30 Val_Wu16 65535.00 DFES_OneToOne 0.00 65535.00 FORMAT "%8.2" /end CHARACTERISTIC
/begin CHARACTERISTIC DFC_DisblMsk.DFC_ComMETIChksum_C "disable mask / Disable masks of check DFC_ComMETIChksum" VALUE 0x804F5C32 Val_Wu16 65535.00 DFES_OneToOne 0.00 65535.00 FORMAT "%8.2" /end CHARACTERISTIC
/begin CHARACTERISTIC DFC_DisblMsk.DFC_ComMETIRingCnt_C "disable mask / Disable masks of check DFC_ComMETIRingCnt" VALUE 0x804F5C34 Val_Wu16 65535.00 DFES_OneToOne 0.00 65535.00 FORMAT "%8.2" /end CHARACTERISTIC
/begin CHARACTERISTIC DFC_DisblMsk.DFC_ComMETITOut_C "disable mask / Disable masks of check DFC_ComMETITOut" VALUE 0x804F5C36 Val_Wu16 65535.00 DFES_OneToOne 0.00 65535.00 FORMAT "%8.2" /end CHARACTERISTIC
/begin CHARACTERISTIC DFC_DisblMsk.DFC_ComMETKChksum_C "disable mask / Disable masks of check DFC_ComMETKChksum" VALUE 0x804F5C38 Val_Wu16 65535.00 DFES_OneToOne 0.00 65535.00 FORMAT "%8.2" /end CHARACTERISTIC
/begin CHARACTERISTIC DFC_DisblMsk.DFC_ComMETKRingCnt_C "disable mask / Disable masks of check DFC_ComMETKRingCnt" VALUE 0x804F5C3A Val_Wu16 65535.00 DFES_OneToOne 0.00 65535.00 FORMAT "%8.2" /end CHARACTERISTIC
/begin CHARACTERISTIC DFC_DisblMsk.DFC_ComMETKTOut_C "disable mask / Disable masks of check DFC_ComMETKTOut" VALUE 0x804F5C3C Val_Wu16 65535.00 DFES_OneToOne 0.00 65535.00 FORMAT "%8.2" /end CHARACTERISTIC
/begin CHARACTERISTIC DFC_DisblMsk.DFC_ComMETLChksum_C "disable mask / Disable masks of check DFC_ComMETLChksum" VALUE 0x804F5C3E Val_Wu16 65535.00 DFES_OneToOne 0.00 65535.00 FORMAT "%8.2" /end CHARACTERISTIC
/begin CHARACTERISTIC DFC_DisblMsk.DFC_ComMETLRingCnt_C "disable mask / Disable masks of check DFC_ComMETLRingCnt" VALUE 0x804F5C40 Val_Wu16 65535.00 DFES_OneToOne 0.00 65535.00 FORMAT "%8.2" /end CHARACTERISTIC
/begin CHARACTERISTIC DFC_DisblMsk.DFC_ComMETLTOut_C "disable mask / Disable masks of check DFC_ComMETLTOut" VALUE 0x804F5C42 Val_Wu16 65535.00 DFES_OneToOne 0.00 65535.00 FORMAT "%8.2" /end CHARACTERISTIC
/begin CHARACTERISTIC DFC_DisblMsk.DFC_ComMETMChksum_C "disable mask / Disable masks of check DFC_ComMETMChksum" VALUE 0x804F5C44 Val_Wu16 65535.00 DFES_OneToOne 0.00 65535.00 FORMAT "%8.2" /end CHARACTERISTIC
/begin CHARACTERISTIC DFC_DisblMsk.DFC_ComMETMRingCnt_C "disable mask / Disable masks of check DFC_ComMETMRingCnt" VALUE 0x804F5C46 Val_Wu16 65535.00 DFES_OneToOne 0.00 65535.00 FORMAT "%8.2" /end CHARACTERISTIC
/begin CHARACTERISTIC DFC_DisblMsk.DFC_ComMETMTOut_C "disable mask / Disable masks of check DFC_ComMETMTOut" VALUE 0x804F5C48 Val_Wu16 65535.00 DFES_OneToOne 0.00 65535.00 FORMAT "%8.2" /end CHARACTERISTIC
/begin CHARACTERISTIC DFC_DisblMsk.DFC_ComMETNChksum_C "disable mask / Disable masks of check DFC_ComMETNChksum" VALUE 0x804F5C4A Val_Wu16 65535.00 DFES_OneToOne 0.00 65535.00 FORMAT "%8.2" /end CHARACTERISTIC
/begin CHARACTERISTIC DFC_DisblMsk.DFC_ComMETNRingCnt_C "disable mask / Disable masks of check DFC_ComMETNRingCnt" VALUE 0x804F5C4C Val_Wu16 65535.00 DFES_OneToOne 0.00 65535.00 FORMAT "%8.2" /end CHARACTERISTIC
/begin CHARACTERISTIC DFC_DisblMsk.DFC_ComMETNTOut_C "disable mask / Disable masks of check DFC_ComMETNTOut" VALUE 0x804F5C4E Val_Wu16 65535.00 DFES_OneToOne 0.00 65535.00 FORMAT "%8.2" /end CHARACTERISTIC
/begin CHARACTERISTIC DFC_DisblMsk.DFC_ComMtrCom_C "disable mask / Disable masks of check DFC_ComMtrCom" VALUE 0x804F5C50 Val_Wu16 65535.00 DFES_OneToOne 0.00 65535.00 FORMAT "%8.2" /end CHARACTERISTIC
/begin CHARACTERISTIC DFC_DisblMsk.DFC_ComPCUChkSum_C "disable mask / Disable masks of check DFC_ComPCUChkSum" VALUE 0x804F5C52 Val_Wu16 65535.00 DFES_OneToOne 0.00 65535.00 FORMAT "%8.2" /end CHARACTERISTIC
/begin CHARACTERISTIC DFC_DisblMsk.DFC_ComPCURingCnt_C "disable mask / Disable masks of check DFC_ComPCURingCnt" VALUE 0x804F5C54 Val_Wu16 65535.00 DFES_OneToOne 0.00 65535.00 FORMAT "%8.2" /end CHARACTERISTIC
/begin CHARACTERISTIC DFC_DisblMsk.DFC_ComPCUTOut_C "disable mask / Disable masks of check DFC_ComPCUTOut" VALUE 0x804F5C56 Val_Wu16 65535.00 DFES_OneToOne 0.00 65535.00 FORMAT "%8.2" /end CHARACTERISTIC
/begin CHARACTERISTIC DFC_DisblMsk.DFC_ComSRSAChksum_C "disable mask / Disable masks of check DFC_ComSRSAChksum" VALUE 0x804F5C58 Val_Wu16 65535.00 DFES_OneToOne 0.00 65535.00 FORMAT "%8.2" /end CHARACTERISTIC
/begin CHARACTERISTIC DFC_DisblMsk.DFC_ComSRSARingCnt_C "disable mask / Disable masks of check DFC_ComSRSARingCnt" VALUE 0x804F5C5A Val_Wu16 65535.00 DFES_OneToOne 0.00 65535.00 FORMAT "%8.2" /end CHARACTERISTIC
/begin CHARACTERISTIC DFC_DisblMsk.DFC_ComSRSATOut_C "disable mask / Disable masks of check DFC_ComSRSATOut" VALUE 0x804F5C5C Val_Wu16 65535.00 DFES_OneToOne 0.00 65535.00 FORMAT "%8.2" /end CHARACTERISTIC
/begin CHARACTERISTIC DFC_DisblMsk.DFC_ComSRSBChksum_C "disable mask / Disable masks of check DFC_ComSRSBChksum" VALUE 0x804F5C5E Val_Wu16 65535.00 DFES_OneToOne 0.00 65535.00 FORMAT "%8.2" /end CHARACTERISTIC
/begin CHARACTERISTIC DFC_DisblMsk.DFC_ComSRSBRingCnt_C "disable mask / Disable masks of check DFC_ComSRSBRingCnt" VALUE 0x804F5C60 Val_Wu16 65535.00 DFES_OneToOne 0.00 65535.00 FORMAT "%8.2" /end CHARACTERISTIC
/begin CHARACTERISTIC DFC_DisblMsk.DFC_ComSRSBTOut_C "disable mask / Disable masks of check DFC_ComSRSBTOut" VALUE 0x804F5C62 Val_Wu16 65535.00 DFES_OneToOne 0.00 65535.00 FORMAT "%8.2" /end CHARACTERISTIC
/begin CHARACTERISTIC DFC_DisblMsk.DFC_ComSRSChksum_C "disable mask / Disable masks of check DFC_ComSRSChksum" VALUE 0x804F5C64 Val_Wu16 65535.00 DFES_OneToOne 0.00 65535.00 FORMAT "%8.2" /end CHARACTERISTIC
/begin CHARACTERISTIC DFC_DisblMsk.DFC_ComSRSErr_C "disable mask / Disable masks of check DFC_ComSRSErr" VALUE 0x804F5C66 Val_Wu16 65535.00 DFES_OneToOne 0.00 65535.00 FORMAT "%8.2" /end CHARACTERISTIC
/begin CHARACTERISTIC DFC_DisblMsk.DFC_ComSRSRingCnt_C "disable mask / Disable masks of check DFC_ComSRSRingCnt" VALUE 0x804F5C68 Val_Wu16 65535.00 DFES_OneToOne 0.00 65535.00 FORMAT "%8.2" /end CHARACTERISTIC
/begin CHARACTERISTIC DFC_DisblMsk.DFC_ComSRSTOut_C "disable mask / Disable masks of check DFC_ComSRSTOut" VALUE 0x804F5C6A Val_Wu16 65535.00 DFES_OneToOne 0.00 65535.00 FORMAT "%8.2" /end CHARACTERISTIC
/begin CHARACTERISTIC DFC_DisblMsk.DFC_ComVehSpdPndFltTCU_C "disable mask / Disable masks of check DFC_ComVehSpdPndFltTCU" VALUE 0x804F5C6C Val_Wu16 65535.00 DFES_OneToOne 0.00 65535.00 FORMAT "%8.2" /end CHARACTERISTIC
/begin CHARACTERISTIC DFC_DisblMsk.DFC_EbsChartcCurrErr_C "disable mask / Disable masks of check DFC_EbsChartcCurrErr" VALUE 0x804F5C6E Val_Wu16 65535.00 DFES_OneToOne 0.00 65535.00 FORMAT "%8.2" /end CHARACTERISTIC
/begin CHARACTERISTIC DFC_DisblMsk.DFC_EbsSelfDiagErr_C "disable mask / Disable masks of check DFC_EbsSelfDiagErr" VALUE 0x804F5C70 Val_Wu16 65535.00 DFES_OneToOne 0.00 65535.00 FORMAT "%8.2" /end CHARACTERISTIC
/begin CHARACTERISTIC DFC_DisblMsk.DFC_GEVlvPhaCsersIntkB1_C "disable mask / Disable masks of check DFC_GEVlvPhaCsersIntkB1" VALUE 0x804F5C72 Val_Wu16 65535.00 DFES_OneToOne 0.00 65535.00 FORMAT "%8.2" /end CHARACTERISTIC
/begin CHARACTERISTIC DFC_DisblMsk.DFC_GEVlvPhaPsOpenLoadIntkB1_C "disable mask / Disable masks of check DFC_GEVlvPhaPsOpenLoadIntkB1" VALUE 0x804F5C74 Val_Wu16 65535.00 DFES_OneToOne 0.00 65535.00 FORMAT "%8.2" /end CHARACTERISTIC
/begin CHARACTERISTIC DFC_DisblMsk.DFC_GEVlvPhaPsShoToBattIntkB1_C "disable mask / Disable masks of check DFC_GEVlvPhaPsShoToBattIntkB1" VALUE 0x804F5C76 Val_Wu16 65535.00 DFES_OneToOne 0.00 65535.00 FORMAT "%8.2" /end CHARACTERISTIC
/begin CHARACTERISTIC DFC_DisblMsk.DFC_GEVlvPhaPsShoToGndIntkB1_C "disable mask / Disable masks of check DFC_GEVlvPhaPsShoToGndIntkB1" VALUE 0x804F5C78 Val_Wu16 65535.00 DFES_OneToOne 0.00 65535.00 FORMAT "%8.2" /end CHARACTERISTIC
/begin CHARACTERISTIC DFC_DisblMsk.DFC_GbxCANDigPlausErr_C "disable mask / Disable masks of check DFC_GbxCANDigPlausErr" VALUE 0x804F5C7A Val_Wu16 65535.00 DFES_OneToOne 0.00 65535.00 FORMAT "%8.2" /end CHARACTERISTIC
/begin CHARACTERISTIC DFC_DisblMsk.DFC_GbxNPos1SRCMax_C "disable mask / Disable masks of check DFC_GbxNPos1SRCMax" VALUE 0x804F5C7C Val_Wu16 65535.00 DFES_OneToOne 0.00 65535.00 FORMAT "%8.2" /end CHARACTERISTIC
/begin CHARACTERISTIC DFC_DisblMsk.DFC_GbxNPos1SRCMin_C "disable mask / Disable masks of check DFC_GbxNPos1SRCMin" VALUE 0x804F5C7E Val_Wu16 65535.00 DFES_OneToOne 0.00 65535.00 FORMAT "%8.2" /end CHARACTERISTIC
/begin CHARACTERISTIC DFC_DisblMsk.DFC_GbxNPos2SRCMax_C "disable mask / Disable masks of check DFC_GbxNPos2SRCMax" VALUE 0x804F5C80 Val_Wu16 65535.00 DFES_OneToOne 0.00 65535.00 FORMAT "%8.2" /end CHARACTERISTIC
/begin CHARACTERISTIC DFC_DisblMsk.DFC_GbxNPos2SRCMin_C "disable mask / Disable masks of check DFC_GbxNPos2SRCMin" VALUE 0x804F5C82 Val_Wu16 65535.00 DFES_OneToOne 0.00 65535.00 FORMAT "%8.2" /end CHARACTERISTIC
/begin CHARACTERISTIC DFC_DisblMsk.DFC_GbxNPosAlvChk_C "disable mask / Disable masks of check DFC_GbxNPosAlvChk" VALUE 0x804F5C84 Val_Wu16 65535.00 DFES_OneToOne 0.00 65535.00 FORMAT "%8.2" /end CHARACTERISTIC
/begin CHARACTERISTIC DFC_DisblMsk.DFC_GbxNPosSyncErr_C "disable mask / Disable masks of check DFC_GbxNPosSyncErr" VALUE 0x804F5C86 Val_Wu16 65535.00 DFES_OneToOne 0.00 65535.00 FORMAT "%8.2" /end CHARACTERISTIC
/begin CHARACTERISTIC DFC_DisblMsk.DFC_HEGOS2B1HtrPsMax_C "disable mask / Disable masks of check DFC_HEGOS2B1HtrPsMax" VALUE 0x804F5C88 Val_Wu16 65535.00 DFES_OneToOne 0.00 65535.00 FORMAT "%8.2" /end CHARACTERISTIC
/begin CHARACTERISTIC DFC_DisblMsk.DFC_HEGOS2B1HtrPsMin_C "disable mask / Disable masks of check DFC_HEGOS2B1HtrPsMin" VALUE 0x804F5C8A Val_Wu16 65535.00 DFES_OneToOne 0.00 65535.00 FORMAT "%8.2" /end CHARACTERISTIC
/begin CHARACTERISTIC DFC_DisblMsk.DFC_HEGOS2B1HtrPsSig_C "disable mask / Disable masks of check DFC_HEGOS2B1HtrPsSig" VALUE 0x804F5C8C Val_Wu16 65535.00 DFES_OneToOne 0.00 65535.00 FORMAT "%8.2" /end CHARACTERISTIC
/begin CHARACTERISTIC DFC_DisblMsk.DFC_LinCSErrACG_C "disable mask / Disable masks of check DFC_LinCSErrACG" VALUE 0x804F5C8E Val_Wu16 65535.00 DFES_OneToOne 0.00 65535.00 FORMAT "%8.2" /end CHARACTERISTIC
/begin CHARACTERISTIC DFC_DisblMsk.DFC_LinCSErrAEV_C "disable mask / Disable masks of check DFC_LinCSErrAEV" VALUE 0x804F5C90 Val_Wu16 65535.00 DFES_OneToOne 0.00 65535.00 FORMAT "%8.2" /end CHARACTERISTIC
/begin CHARACTERISTIC DFC_DisblMsk.DFC_LinCSErrDCDC_C "disable mask / Disable masks of check DFC_LinCSErrDCDC" VALUE 0x804F5C92 Val_Wu16 65535.00 DFES_OneToOne 0.00 65535.00 FORMAT "%8.2" /end CHARACTERISTIC
/begin CHARACTERISTIC DFC_DisblMsk.DFC_LinCSErrEBS_C "disable mask / Disable masks of check DFC_LinCSErrEBS" VALUE 0x804F5C94 Val_Wu16 65535.00 DFES_OneToOne 0.00 65535.00 FORMAT "%8.2" /end CHARACTERISTIC
/begin CHARACTERISTIC DFC_DisblMsk.DFC_LinHdrTimeoutErrACG_C "disable mask / Disable masks of check DFC_LinHdrTimeoutErrACG" VALUE 0x804F5C96 Val_Wu16 65535.00 DFES_OneToOne 0.00 65535.00 FORMAT "%8.2" /end CHARACTERISTIC
/begin CHARACTERISTIC DFC_DisblMsk.DFC_LinHdrTimeoutErrAEV_C "disable mask / Disable masks of check DFC_LinHdrTimeoutErrAEV" VALUE 0x804F5C98 Val_Wu16 65535.00 DFES_OneToOne 0.00 65535.00 FORMAT "%8.2" /end CHARACTERISTIC
/begin CHARACTERISTIC DFC_DisblMsk.DFC_LinHdrTimeoutErrDCDC_C "disable mask / Disable masks of check DFC_LinHdrTimeoutErrDCDC" VALUE 0x804F5C9A Val_Wu16 65535.00 DFES_OneToOne 0.00 65535.00 FORMAT "%8.2" /end CHARACTERISTIC
/begin CHARACTERISTIC DFC_DisblMsk.DFC_LinHdrTimeoutErrEBS_C "disable mask / Disable masks of check DFC_LinHdrTimeoutErrEBS" VALUE 0x804F5C9C Val_Wu16 65535.00 DFES_OneToOne 0.00 65535.00 FORMAT "%8.2" /end CHARACTERISTIC
/begin CHARACTERISTIC DFC_DisblMsk.DFC_LinMsgTimeoutErrACG_C "disable mask / Disable masks of check DFC_LinMsgTimeoutErrACG" VALUE 0x804F5C9E Val_Wu16 65535.00 DFES_OneToOne 0.00 65535.00 FORMAT "%8.2" /end CHARACTERISTIC
/begin CHARACTERISTIC DFC_DisblMsk.DFC_LinMsgTimeoutErrAEV_C "disable mask / Disable masks of check DFC_LinMsgTimeoutErrAEV" VALUE 0x804F5CA0 Val_Wu16 65535.00 DFES_OneToOne 0.00 65535.00 FORMAT "%8.2" /end CHARACTERISTIC
/begin CHARACTERISTIC DFC_DisblMsk.DFC_LinMsgTimeoutErrDCDC_C "disable mask / Disable masks of check DFC_LinMsgTimeoutErrDCDC" VALUE 0x804F5CA2 Val_Wu16 65535.00 DFES_OneToOne 0.00 65535.00 FORMAT "%8.2" /end CHARACTERISTIC
/begin CHARACTERISTIC DFC_DisblMsk.DFC_LinMsgTimeoutErrEBS_C "disable mask / Disable masks of check DFC_LinMsgTimeoutErrEBS" VALUE 0x804F5CA4 Val_Wu16 65535.00 DFES_OneToOne 0.00 65535.00 FORMAT "%8.2" /end CHARACTERISTIC
/begin CHARACTERISTIC DFC_DisblMsk.DFC_LinNoStrtComErr_C "disable mask / Disable masks of check DFC_LinNoStrtComErr" VALUE 0x804F5CA6 Val_Wu16 65535.00 DFES_OneToOne 0.00 65535.00 FORMAT "%8.2" /end CHARACTERISTIC
/begin CHARACTERISTIC DFC_DisblMsk.DFC_LowPresOilP_C "disable mask / Disable masks of check DFC_LowPresOilP" VALUE 0x804F5CA8 Val_Wu16 65535.00 DFES_OneToOne 0.00 65535.00 FORMAT "%8.2" /end CHARACTERISTIC
/begin CHARACTERISTIC DFC_DisblMsk.DFC_MisfDetVWhlFrntLeOORHi_C "disable mask / Disable masks of check DFC_MisfDetVWhlFrntLeOORHi" VALUE 0x804F5CAA Val_Wu16 65535.00 DFES_OneToOne 0.00 65535.00 FORMAT "%8.2" /end CHARACTERISTIC
/begin CHARACTERISTIC DFC_DisblMsk.DFC_MisfDetVWhlFrntLeRatyHi_C "disable mask / Disable masks of check DFC_MisfDetVWhlFrntLeRatyHi" VALUE 0x804F5CAC Val_Wu16 65535.00 DFES_OneToOne 0.00 65535.00 FORMAT "%8.2" /end CHARACTERISTIC
/begin CHARACTERISTIC DFC_DisblMsk.DFC_MisfDetVWhlFrntLeRatyLo_C "disable mask / Disable masks of check DFC_MisfDetVWhlFrntLeRatyLo" VALUE 0x804F5CAE Val_Wu16 65535.00 DFES_OneToOne 0.00 65535.00 FORMAT "%8.2" /end CHARACTERISTIC
/begin CHARACTERISTIC DFC_DisblMsk.DFC_MisfDetVWhlFrntLeStuck_C "disable mask / Disable masks of check DFC_MisfDetVWhlFrntLeStuck" VALUE 0x804F5CB0 Val_Wu16 65535.00 DFES_OneToOne 0.00 65535.00 FORMAT "%8.2" /end CHARACTERISTIC
/begin CHARACTERISTIC DFC_DisblMsk.DFC_MisfDetVWhlFrntRiOORHi_C "disable mask / Disable masks of check DFC_MisfDetVWhlFrntRiOORHi" VALUE 0x804F5CB2 Val_Wu16 65535.00 DFES_OneToOne 0.00 65535.00 FORMAT "%8.2" /end CHARACTERISTIC
/begin CHARACTERISTIC DFC_DisblMsk.DFC_MisfDetVWhlFrntRiRatyHi_C "disable mask / Disable masks of check DFC_MisfDetVWhlFrntRiRatyHi" VALUE 0x804F5CB4 Val_Wu16 65535.00 DFES_OneToOne 0.00 65535.00 FORMAT "%8.2" /end CHARACTERISTIC
/begin CHARACTERISTIC DFC_DisblMsk.DFC_MisfDetVWhlFrntRiRatyLo_C "disable mask / Disable masks of check DFC_MisfDetVWhlFrntRiRatyLo" VALUE 0x804F5CB6 Val_Wu16 65535.00 DFES_OneToOne 0.00 65535.00 FORMAT "%8.2" /end CHARACTERISTIC
/begin CHARACTERISTIC DFC_DisblMsk.DFC_MisfDetVWhlFrntRiStuck_C "disable mask / Disable masks of check DFC_MisfDetVWhlFrntRiStuck" VALUE 0x804F5CB8 Val_Wu16 65535.00 DFES_OneToOne 0.00 65535.00 FORMAT "%8.2" /end CHARACTERISTIC
/begin CHARACTERISTIC DFC_DisblMsk.DFC_MisfDetVWhlReLeOORHi_C "disable mask / Disable masks of check DFC_MisfDetVWhlReLeOORHi" VALUE 0x804F5CBA Val_Wu16 65535.00 DFES_OneToOne 0.00 65535.00 FORMAT "%8.2" /end CHARACTERISTIC
/begin CHARACTERISTIC DFC_DisblMsk.DFC_MisfDetVWhlReLeRatyHi_C "disable mask / Disable masks of check DFC_MisfDetVWhlReLeRatyHi" VALUE 0x804F5CBC Val_Wu16 65535.00 DFES_OneToOne 0.00 65535.00 FORMAT "%8.2" /end CHARACTERISTIC
/begin CHARACTERISTIC DFC_DisblMsk.DFC_MisfDetVWhlReLeRatyLo_C "disable mask / Disable masks of check DFC_MisfDetVWhlReLeRatyLo" VALUE 0x804F5CBE Val_Wu16 65535.00 DFES_OneToOne 0.00 65535.00 FORMAT "%8.2" /end CHARACTERISTIC
/begin CHARACTERISTIC DFC_DisblMsk.DFC_MisfDetVWhlReLeStuck_C "disable mask / Disable masks of check DFC_MisfDetVWhlReLeStuck" VALUE 0x804F5CC0 Val_Wu16 65535.00 DFES_OneToOne 0.00 65535.00 FORMAT "%8.2" /end CHARACTERISTIC
/begin CHARACTERISTIC DFC_DisblMsk.DFC_MisfDetVWhlReRiOORHi_C "disable mask / Disable masks of check DFC_MisfDetVWhlReRiOORHi" VALUE 0x804F5CC2 Val_Wu16 65535.00 DFES_OneToOne 0.00 65535.00 FORMAT "%8.2" /end CHARACTERISTIC
/begin CHARACTERISTIC DFC_DisblMsk.DFC_MisfDetVWhlReRiRatyHi_C "disable mask / Disable masks of check DFC_MisfDetVWhlReRiRatyHi" VALUE 0x804F5CC4 Val_Wu16 65535.00 DFES_OneToOne 0.00 65535.00 FORMAT "%8.2" /end CHARACTERISTIC
/begin CHARACTERISTIC DFC_DisblMsk.DFC_MisfDetVWhlReRiRatyLo_C "disable mask / Disable masks of check DFC_MisfDetVWhlReRiRatyLo" VALUE 0x804F5CC6 Val_Wu16 65535.00 DFES_OneToOne 0.00 65535.00 FORMAT "%8.2" /end CHARACTERISTIC
/begin CHARACTERISTIC DFC_DisblMsk.DFC_MisfDetVWhlReRiStuck_C "disable mask / Disable masks of check DFC_MisfDetVWhlReRiStuck" VALUE 0x804F5CC8 Val_Wu16 65535.00 DFES_OneToOne 0.00 65535.00 FORMAT "%8.2" /end CHARACTERISTIC
/begin CHARACTERISTIC DFC_DisblMsk.DFC_MisfDetdVWhlFrntLePlaus_C "disable mask / Disable masks of check DFC_MisfDetdVWhlFrntLePlaus" VALUE 0x804F5CCA Val_Wu16 65535.00 DFES_OneToOne 0.00 65535.00 FORMAT "%8.2" /end CHARACTERISTIC
/begin CHARACTERISTIC DFC_DisblMsk.DFC_MisfDetdVWhlFrntRiPlaus_C "disable mask / Disable masks of check DFC_MisfDetdVWhlFrntRiPlaus" VALUE 0x804F5CCC Val_Wu16 65535.00 DFES_OneToOne 0.00 65535.00 FORMAT "%8.2" /end CHARACTERISTIC
/begin CHARACTERISTIC DFC_DisblMsk.DFC_MisfDetdVWhlReLePlaus_C "disable mask / Disable masks of check DFC_MisfDetdVWhlReLePlaus" VALUE 0x804F5CCE Val_Wu16 65535.00 DFES_OneToOne 0.00 65535.00 FORMAT "%8.2" /end CHARACTERISTIC
/begin CHARACTERISTIC DFC_DisblMsk.DFC_MisfDetdVWhlReRiPlaus_C "disable mask / Disable masks of check DFC_MisfDetdVWhlReRiPlaus" VALUE 0x804F5CD0 Val_Wu16 65535.00 DFES_OneToOne 0.00 65535.00 FORMAT "%8.2" /end CHARACTERISTIC
/begin CHARACTERISTIC DFC_DisblMsk.DFC_PEnvSigRngMax_C "disable mask / Disable masks of check DFC_PEnvSigRngMax" VALUE 0x804F5CD2 Val_Wu16 65535.00 DFES_OneToOne 0.00 65535.00 FORMAT "%8.2" /end CHARACTERISTIC
/begin CHARACTERISTIC DFC_DisblMsk.DFC_PEnvSigRngMin_C "disable mask / Disable masks of check DFC_PEnvSigRngMin" VALUE 0x804F5CD4 Val_Wu16 65535.00 DFES_OneToOne 0.00 65535.00 FORMAT "%8.2" /end CHARACTERISTIC
/begin CHARACTERISTIC DFC_DisblMsk.DFC_StmFault_C "disable mask / Disable masks of check DFC_StmFault" VALUE 0x804F5CD6 Val_Wu16 65535.00 DFES_OneToOne 0.00 65535.00 FORMAT "%8.2" /end CHARACTERISTIC
/begin CHARACTERISTIC DFC_DisblMsk.DFC_StrtCtOffPth_C "disable mask / Disable masks of check DFC_StrtCtOffPth" VALUE 0x804F5CD8 Val_Wu16 65535.00 DFES_OneToOne 0.00 65535.00 FORMAT "%8.2" /end CHARACTERISTIC
/begin CHARACTERISTIC DFC_DisblMsk.DFC_StrtCtlErr_C "disable mask / Disable masks of check DFC_StrtCtlErr" VALUE 0x804F5CDA Val_Wu16 65535.00 DFES_OneToOne 0.00 65535.00 FORMAT "%8.2" /end CHARACTERISTIC
/begin CHARACTERISTIC DFC_DisblMsk.DFC_StrtFault_C "disable mask / Disable masks of check DFC_StrtFault" VALUE 0x804F5CDC Val_Wu16 65535.00 DFES_OneToOne 0.00 65535.00 FORMAT "%8.2" /end CHARACTERISTIC
/begin CHARACTERISTIC DFC_DisblMsk.DFC_StrtLckJudg1_C "disable mask / Disable masks of check DFC_StrtLckJudg1" VALUE 0x804F5CDE Val_Wu16 65535.00 DFES_OneToOne 0.00 65535.00 FORMAT "%8.2" /end CHARACTERISTIC
/begin CHARACTERISTIC DFC_DisblMsk.DFC_StrtLckJudg2_C "disable mask / Disable masks of check DFC_StrtLckJudg2" VALUE 0x804F5CE0 Val_Wu16 65535.00 DFES_OneToOne 0.00 65535.00 FORMAT "%8.2" /end CHARACTERISTIC
/begin CHARACTERISTIC DFC_DisblMsk.DFC_StrtOL_C "disable mask / Disable masks of check DFC_StrtOL" VALUE 0x804F5CE2 Val_Wu16 65535.00 DFES_OneToOne 0.00 65535.00 FORMAT "%8.2" /end CHARACTERISTIC
/begin CHARACTERISTIC DFC_DisblMsk.DFC_StrtOL2_C "disable mask / Disable masks of check DFC_StrtOL2" VALUE 0x804F5CE4 Val_Wu16 65535.00 DFES_OneToOne 0.00 65535.00 FORMAT "%8.2" /end CHARACTERISTIC
/begin CHARACTERISTIC DFC_DisblMsk.DFC_StrtSCB_C "disable mask / Disable masks of check DFC_StrtSCB" VALUE 0x804F5CE6 Val_Wu16 65535.00 DFES_OneToOne 0.00 65535.00 FORMAT "%8.2" /end CHARACTERISTIC
/begin CHARACTERISTIC DFC_DisblMsk.DFC_StrtSCB2_C "disable mask / Disable masks of check DFC_StrtSCB2" VALUE 0x804F5CE8 Val_Wu16 65535.00 DFES_OneToOne 0.00 65535.00 FORMAT "%8.2" /end CHARACTERISTIC
/begin CHARACTERISTIC DFC_DisblMsk.DFC_StrtSCG_C "disable mask / Disable masks of check DFC_StrtSCG" VALUE 0x804F5CEA Val_Wu16 65535.00 DFES_OneToOne 0.00 65535.00 FORMAT "%8.2" /end CHARACTERISTIC
/begin CHARACTERISTIC DFC_DisblMsk.DFC_StrtSCG2_C "disable mask / Disable masks of check DFC_StrtSCG2" VALUE 0x804F5CEC Val_Wu16 65535.00 DFES_OneToOne 0.00 65535.00 FORMAT "%8.2" /end CHARACTERISTIC
/begin CHARACTERISTIC DFC_DisblMsk.DFC_StrtStkRly1_C "disable mask / Disable masks of check DFC_StrtStkRly1" VALUE 0x804F5CEE Val_Wu16 65535.00 DFES_OneToOne 0.00 65535.00 FORMAT "%8.2" /end CHARACTERISTIC
/begin CHARACTERISTIC DFC_DisblMsk.DFC_StrtStkRly2_C "disable mask / Disable masks of check DFC_StrtStkRly2" VALUE 0x804F5CF0 Val_Wu16 65535.00 DFES_OneToOne 0.00 65535.00 FORMAT "%8.2" /end CHARACTERISTIC
/begin CHARACTERISTIC DFC_DisblMsk.DFC_TEVEmax_C "disable mask / Disable masks of check DFC_TEVEmax" VALUE 0x804F5CF2 Val_Wu16 65535.00 DFES_OneToOne 0.00 65535.00 FORMAT "%8.2" /end CHARACTERISTIC
/begin CHARACTERISTIC DFC_DisblMsk.DFC_TEVEmin_C "disable mask / Disable masks of check DFC_TEVEmin" VALUE 0x804F5CF4 Val_Wu16 65535.00 DFES_OneToOne 0.00 65535.00 FORMAT "%8.2" /end CHARACTERISTIC
/begin CHARACTERISTIC DFC_DisblMsk.DFC_TEVEsig_C "disable mask / Disable masks of check DFC_TEVEsig" VALUE 0x804F5CF6 Val_Wu16 65535.00 DFES_OneToOne 0.00 65535.00 FORMAT "%8.2" /end CHARACTERISTIC
/begin CHARACTERISTIC DFC_DisblMsk.DFC_UegoHeatrPrfmncLoS1B1_C "disable mask / Disable masks of check DFC_UegoHeatrPrfmncLoS1B1" VALUE 0x804F5CF8 Val_Wu16 65535.00 DFES_OneToOne 0.00 65535.00 FORMAT "%8.2" /end CHARACTERISTIC
/begin CHARACTERISTIC DFC_DisblMsk.DFC_VehVAllPlaus_C "disable mask / Disable masks of check DFC_VehVAllPlaus" VALUE 0x804F5CFA Val_Wu16 65535.00 DFES_OneToOne 0.00 65535.00 FORMAT "%8.2" /end CHARACTERISTIC
/begin CHARACTERISTIC DFC_DisblMsk.DFC_VehVNCSnsrElecFailr_C "disable mask / Disable masks of check DFC_VehVNCSnsrElecFailr" VALUE 0x804F5CFC Val_Wu16 65535.00 DFES_OneToOne 0.00 65535.00 FORMAT "%8.2" /end CHARACTERISTIC
/begin CHARACTERISTIC DFC_DisblMsk.DFC_VehVPlausCan_C "disable mask / Disable masks of check DFC_VehVPlausCan" VALUE 0x804F5CFE Val_Wu16 65535.00 DFES_OneToOne 0.00 65535.00 FORMAT "%8.2" /end CHARACTERISTIC
/begin CHARACTERISTIC DFC_DisblMsk.DFC_VehVPlausFco_C "disable mask / Disable masks of check DFC_VehVPlausFco" VALUE 0x804F5D00 Val_Wu16 65535.00 DFES_OneToOne 0.00 65535.00 FORMAT "%8.2" /end CHARACTERISTIC
/begin CHARACTERISTIC DFC_DisblMsk.DFC_VehVPlausPwr_C "disable mask / Disable masks of check DFC_VehVPlausPwr" VALUE 0x804F5D02 Val_Wu16 65535.00 DFES_OneToOne 0.00 65535.00 FORMAT "%8.2" /end CHARACTERISTIC
/begin CHARACTERISTIC DFC_DisblMsk.DFC_VehVPlausV2N_C "disable mask / Disable masks of check DFC_VehVPlausV2N" VALUE 0x804F5D04 Val_Wu16 65535.00 DFES_OneToOne 0.00 65535.00 FORMAT "%8.2" /end CHARACTERISTIC
/begin CHARACTERISTIC DFC_DisblMsk.DFC_VehVSpdSnsrAElecFailr_C "disable mask / Disable masks of check DFC_VehVSpdSnsrAElecFailr" VALUE 0x804F5D06 Val_Wu16 65535.00 DFES_OneToOne 0.00 65535.00 FORMAT "%8.2" /end CHARACTERISTIC
/begin CHARACTERISTIC DFC_DisblMsk.DFC_VehVSpdSnsrBElecFailr_C "disable mask / Disable masks of check DFC_VehVSpdSnsrBElecFailr" VALUE 0x804F5D08 Val_Wu16 65535.00 DFES_OneToOne 0.00 65535.00 FORMAT "%8.2" /end CHARACTERISTIC
/begin CHARACTERISTIC DFC_DisblMsk.DFC_ClthMax_C "disable mask / Disable masks of check DFC_ClthMax" VALUE 0x804F5D0A Val_Wu16 65535.00 DFES_OneToOne 0.00 65535.00 FORMAT "%8.2" /end CHARACTERISTIC
/begin CHARACTERISTIC DFC_DisblMsk.DFC_IgnClPs_DevComErr_C "disable mask / Disable masks of check DFC_IgnClPs_DevComErr" VALUE 0x804F5D0C Val_Wu16 65535.00 DFES_OneToOne 0.00 65535.00 FORMAT "%8.2" /end CHARACTERISTIC
/begin CHARACTERISTIC DFC_DisblMsk.DFC_IgnClPs_LineOl_0_C "disable mask / Disable masks of check DFC_IgnClPs_LineOl_0" VALUE 0x804F5D0E Val_Wu16 65535.00 DFES_OneToOne 0.00 65535.00 FORMAT "%8.2" /end CHARACTERISTIC
/begin CHARACTERISTIC DFC_DisblMsk.DFC_IgnClPs_LineOl_1_C "disable mask / Disable masks of check DFC_IgnClPs_LineOl_1" VALUE 0x804F5D10 Val_Wu16 65535.00 DFES_OneToOne 0.00 65535.00 FORMAT "%8.2" /end CHARACTERISTIC
/begin CHARACTERISTIC DFC_DisblMsk.DFC_IgnClPs_LineOl_2_C "disable mask / Disable masks of check DFC_IgnClPs_LineOl_2" VALUE 0x804F5D12 Val_Wu16 65535.00 DFES_OneToOne 0.00 65535.00 FORMAT "%8.2" /end CHARACTERISTIC
/begin CHARACTERISTIC DFC_DisblMsk.DFC_IgnClPs_LineOl_3_C "disable mask / Disable masks of check DFC_IgnClPs_LineOl_3" VALUE 0x804F5D14 Val_Wu16 65535.00 DFES_OneToOne 0.00 65535.00 FORMAT "%8.2" /end CHARACTERISTIC
/begin CHARACTERISTIC DFC_DisblMsk.DFC_IgnClPs_LineScb_0_C "disable mask / Disable masks of check DFC_IgnClPs_LineScb_0" VALUE 0x804F5D16 Val_Wu16 65535.00 DFES_OneToOne 0.00 65535.00 FORMAT "%8.2" /end CHARACTERISTIC
/begin CHARACTERISTIC DFC_DisblMsk.DFC_IgnClPs_LineScb_1_C "disable mask / Disable masks of check DFC_IgnClPs_LineScb_1" VALUE 0x804F5D18 Val_Wu16 65535.00 DFES_OneToOne 0.00 65535.00 FORMAT "%8.2" /end CHARACTERISTIC
/begin CHARACTERISTIC DFC_DisblMsk.DFC_IgnClPs_LineScb_2_C "disable mask / Disable masks of check DFC_IgnClPs_LineScb_2" VALUE 0x804F5D1A Val_Wu16 65535.00 DFES_OneToOne 0.00 65535.00 FORMAT "%8.2" /end CHARACTERISTIC
/begin CHARACTERISTIC DFC_DisblMsk.DFC_IgnClPs_LineScb_3_C "disable mask / Disable masks of check DFC_IgnClPs_LineScb_3" VALUE 0x804F5D1C Val_Wu16 65535.00 DFES_OneToOne 0.00 65535.00 FORMAT "%8.2" /end CHARACTERISTIC
/begin CHARACTERISTIC DFC_DisblMsk.DFC_IgnClPs_LineScg_0_C "disable mask / Disable masks of check DFC_IgnClPs_LineScg_0" VALUE 0x804F5D1E Val_Wu16 65535.00 DFES_OneToOne 0.00 65535.00 FORMAT "%8.2" /end CHARACTERISTIC
/begin CHARACTERISTIC DFC_DisblMsk.DFC_IgnClPs_LineScg_1_C "disable mask / Disable masks of check DFC_IgnClPs_LineScg_1" VALUE 0x804F5D20 Val_Wu16 65535.00 DFES_OneToOne 0.00 65535.00 FORMAT "%8.2" /end CHARACTERISTIC
/begin CHARACTERISTIC DFC_DisblMsk.DFC_IgnClPs_LineScg_2_C "disable mask / Disable masks of check DFC_IgnClPs_LineScg_2" VALUE 0x804F5D22 Val_Wu16 65535.00 DFES_OneToOne 0.00 65535.00 FORMAT "%8.2" /end CHARACTERISTIC
/begin CHARACTERISTIC DFC_DisblMsk.DFC_IgnClPs_LineScg_3_C "disable mask / Disable masks of check DFC_IgnClPs_LineScg_3" VALUE 0x804F5D24 Val_Wu16 65535.00 DFES_OneToOne 0.00 65535.00 FORMAT "%8.2" /end CHARACTERISTIC
/begin CHARACTERISTIC DFC_DisblMsk.DFC_KRVEKOEVAB_C "disable mask / Disable masks of check DFC_KRVEKOEVAB" VALUE 0x804F5D26 Val_Wu16 65535.00 DFES_OneToOne 0.00 65535.00 FORMAT "%8.2" /end CHARACTERISTIC
/begin CHARACTERISTIC DFC_DisblMsk.DFC_KRVEKOEVAB0_C "disable mask / Disable masks of check DFC_KRVEKOEVAB0" VALUE 0x804F5D28 Val_Wu16 65535.00 DFES_OneToOne 0.00 65535.00 FORMAT "%8.2" /end CHARACTERISTIC
/begin CHARACTERISTIC DFC_DisblMsk.DFC_KRVEKOEVAB1_C "disable mask / Disable masks of check DFC_KRVEKOEVAB1" VALUE 0x804F5D2A Val_Wu16 65535.00 DFES_OneToOne 0.00 65535.00 FORMAT "%8.2" /end CHARACTERISTIC
/begin CHARACTERISTIC DFC_DisblMsk.DFC_KRVEKOEVAB2_C "disable mask / Disable masks of check DFC_KRVEKOEVAB2" VALUE 0x804F5D2C Val_Wu16 65535.00 DFES_OneToOne 0.00 65535.00 FORMAT "%8.2" /end CHARACTERISTIC
/begin CHARACTERISTIC DFC_DisblMsk.DFC_KRVEKOEVAB3_C "disable mask / Disable masks of check DFC_KRVEKOEVAB3" VALUE 0x804F5D2E Val_Wu16 65535.00 DFES_OneToOne 0.00 65535.00 FORMAT "%8.2" /end CHARACTERISTIC
/begin CHARACTERISTIC DFC_DisblMsk.DFC_UegoSigEcuAsicS1B1_C "disable mask / Disable masks of check DFC_UegoSigEcuAsicS1B1" VALUE 0x804F5D30 Val_Wu16 65535.00 DFES_OneToOne 0.00 65535.00 FORMAT "%8.2" /end CHARACTERISTIC
/begin CHARACTERISTIC DFC_DisblMsk.DFC_UegoSigEcuComS1B1_C "disable mask / Disable masks of check DFC_UegoSigEcuComS1B1" VALUE 0x804F5D32 Val_Wu16 65535.00 DFES_OneToOne 0.00 65535.00 FORMAT "%8.2" /end CHARACTERISTIC
/begin CHARACTERISTIC DFC_DisblMsk.DFC_UegoSigSnsrS1B1_C "disable mask / Disable masks of check DFC_UegoSigSnsrS1B1" VALUE 0x804F5D34 Val_Wu16 65535.00 DFES_OneToOne 0.00 65535.00 FORMAT "%8.2" /end CHARACTERISTIC
/begin CHARACTERISTIC DFC_DisblMsk.DFC_UegoSigWireOlApesS1B1_C "disable mask / Disable masks of check DFC_UegoSigWireOlApesS1B1" VALUE 0x804F5D36 Val_Wu16 65535.00 DFES_OneToOne 0.00 65535.00 FORMAT "%8.2" /end CHARACTERISTIC
/begin CHARACTERISTIC DFC_DisblMsk.DFC_UegoSigWireOlIpeS1B1_C "disable mask / Disable masks of check DFC_UegoSigWireOlIpeS1B1" VALUE 0x804F5D38 Val_Wu16 65535.00 DFES_OneToOne 0.00 65535.00 FORMAT "%8.2" /end CHARACTERISTIC
/begin CHARACTERISTIC DFC_DisblMsk.DFC_UegoSigWireOlReS1B1_C "disable mask / Disable masks of check DFC_UegoSigWireOlReS1B1" VALUE 0x804F5D3A Val_Wu16 65535.00 DFES_OneToOne 0.00 65535.00 FORMAT "%8.2" /end CHARACTERISTIC
/begin CHARACTERISTIC DFC_DisblMsk.DFC_UegoSigWireRCmpS1B1_C "disable mask / Disable masks of check DFC_UegoSigWireRCmpS1B1" VALUE 0x804F5D3C Val_Wu16 65535.00 DFES_OneToOne 0.00 65535.00 FORMAT "%8.2" /end CHARACTERISTIC
/begin CHARACTERISTIC DFC_DisblMsk.DFC_UegoSigWireScbS1B1_C "disable mask / Disable masks of check DFC_UegoSigWireScbS1B1" VALUE 0x804F5D3E Val_Wu16 65535.00 DFES_OneToOne 0.00 65535.00 FORMAT "%8.2" /end CHARACTERISTIC
/begin CHARACTERISTIC DFC_DisblMsk.DFC_UegoSigWireScgS1B1_C "disable mask / Disable masks of check DFC_UegoSigWireScgS1B1" VALUE 0x804F5D40 Val_Wu16 65535.00 DFES_OneToOne 0.00 65535.00 FORMAT "%8.2" /end CHARACTERISTIC
/begin CHARACTERISTIC DFC_DisblMsk.DFC_AfsPhyRngHiB1_C "disable mask / Disable masks of check DFC_AfsPhyRngHiB1" VALUE 0x804F5D42 Val_Wu16 65535.00 DFES_OneToOne 0.00 65535.00 FORMAT "%8.2" /end CHARACTERISTIC
/begin CHARACTERISTIC DFC_DisblMsk.DFC_AfsPhyRngLoB1_C "disable mask / Disable masks of check DFC_AfsPhyRngLoB1" VALUE 0x804F5D44 Val_Wu16 65535.00 DFES_OneToOne 0.00 65535.00 FORMAT "%8.2" /end CHARACTERISTIC
/begin CHARACTERISTIC DFC_DisblMsk.DFC_AirCCmprOL_C "disable mask / Disable masks of check DFC_AirCCmprOL" VALUE 0x804F5D46 Val_Wu16 65535.00 DFES_OneToOne 0.00 65535.00 FORMAT "%8.2" /end CHARACTERISTIC
/begin CHARACTERISTIC DFC_DisblMsk.DFC_AirCCmprOvrTemp_C "disable mask / Disable masks of check DFC_AirCCmprOvrTemp" VALUE 0x804F5D48 Val_Wu16 65535.00 DFES_OneToOne 0.00 65535.00 FORMAT "%8.2" /end CHARACTERISTIC
/begin CHARACTERISTIC DFC_DisblMsk.DFC_AirCCmprSCB_C "disable mask / Disable masks of check DFC_AirCCmprSCB" VALUE 0x804F5D4A Val_Wu16 65535.00 DFES_OneToOne 0.00 65535.00 FORMAT "%8.2" /end CHARACTERISTIC
/begin CHARACTERISTIC DFC_DisblMsk.DFC_AirCCmprSCG_C "disable mask / Disable masks of check DFC_AirCCmprSCG" VALUE 0x804F5D4C Val_Wu16 65535.00 DFES_OneToOne 0.00 65535.00 FORMAT "%8.2" /end CHARACTERISTIC
/begin CHARACTERISTIC DFC_DisblMsk.DFC_AltErr_C "disable mask / Disable masks of check DFC_AltErr" VALUE 0x804F5D4E Val_Wu16 65535.00 DFES_OneToOne 0.00 65535.00 FORMAT "%8.2" /end CHARACTERISTIC
/begin CHARACTERISTIC DFC_DisblMsk.DFC_BattUSRCMax_C "disable mask / Disable masks of check DFC_BattUSRCMax" VALUE 0x804F5D50 Val_Wu16 65535.00 DFES_OneToOne 0.00 65535.00 FORMAT "%8.2" /end CHARACTERISTIC
/begin CHARACTERISTIC DFC_DisblMsk.DFC_BattUSRCMin_C "disable mask / Disable masks of check DFC_BattUSRCMin" VALUE 0x804F5D52 Val_Wu16 65535.00 DFES_OneToOne 0.00 65535.00 FORMAT "%8.2" /end CHARACTERISTIC
/begin CHARACTERISTIC DFC_DisblMsk.DFC_ComChksTCU1_C "disable mask / Disable masks of check DFC_ComChksTCU1" VALUE 0x804F5D54 Val_Wu16 65535.00 DFES_OneToOne 0.00 65535.00 FORMAT "%8.2" /end CHARACTERISTIC
/begin CHARACTERISTIC DFC_DisblMsk.DFC_ComChksTCU11_C "disable mask / Disable masks of check DFC_ComChksTCU11" VALUE 0x804F5D56 Val_Wu16 65535.00 DFES_OneToOne 0.00 65535.00 FORMAT "%8.2" /end CHARACTERISTIC
/begin CHARACTERISTIC DFC_DisblMsk.DFC_ComChksTCU12_C "disable mask / Disable masks of check DFC_ComChksTCU12" VALUE 0x804F5D58 Val_Wu16 65535.00 DFES_OneToOne 0.00 65535.00 FORMAT "%8.2" /end CHARACTERISTIC
/begin CHARACTERISTIC DFC_DisblMsk.DFC_ComChksTCU13_C "disable mask / Disable masks of check DFC_ComChksTCU13" VALUE 0x804F5D5A Val_Wu16 65535.00 DFES_OneToOne 0.00 65535.00 FORMAT "%8.2" /end CHARACTERISTIC
/begin CHARACTERISTIC DFC_DisblMsk.DFC_ComChksTCU2_C "disable mask / Disable masks of check DFC_ComChksTCU2" VALUE 0x804F5D5C Val_Wu16 65535.00 DFES_OneToOne 0.00 65535.00 FORMAT "%8.2" /end CHARACTERISTIC
/begin CHARACTERISTIC DFC_DisblMsk.DFC_ComChksTCU3_C "disable mask / Disable masks of check DFC_ComChksTCU3" VALUE 0x804F5D5E Val_Wu16 65535.00 DFES_OneToOne 0.00 65535.00 FORMAT "%8.2" /end CHARACTERISTIC
/begin CHARACTERISTIC DFC_DisblMsk.DFC_ComChksTCU4_C "disable mask / Disable masks of check DFC_ComChksTCU4" VALUE 0x804F5D60 Val_Wu16 65535.00 DFES_OneToOne 0.00 65535.00 FORMAT "%8.2" /end CHARACTERISTIC
/begin CHARACTERISTIC DFC_DisblMsk.DFC_ComCntTCU1_C "disable mask / Disable masks of check DFC_ComCntTCU1" VALUE 0x804F5D62 Val_Wu16 65535.00 DFES_OneToOne 0.00 65535.00 FORMAT "%8.2" /end CHARACTERISTIC
/begin CHARACTERISTIC DFC_DisblMsk.DFC_ComCntTCU11_C "disable mask / Disable masks of check DFC_ComCntTCU11" VALUE 0x804F5D64 Val_Wu16 65535.00 DFES_OneToOne 0.00 65535.00 FORMAT "%8.2" /end CHARACTERISTIC
/begin CHARACTERISTIC DFC_DisblMsk.DFC_ComCntTCU12_C "disable mask / Disable masks of check DFC_ComCntTCU12" VALUE 0x804F5D66 Val_Wu16 65535.00 DFES_OneToOne 0.00 65535.00 FORMAT "%8.2" /end CHARACTERISTIC
/begin CHARACTERISTIC DFC_DisblMsk.DFC_ComCntTCU13_C "disable mask / Disable masks of check DFC_ComCntTCU13" VALUE 0x804F5D68 Val_Wu16 65535.00 DFES_OneToOne 0.00 65535.00 FORMAT "%8.2" /end CHARACTERISTIC
/begin CHARACTERISTIC DFC_DisblMsk.DFC_ComCntTCU2_C "disable mask / Disable masks of check DFC_ComCntTCU2" VALUE 0x804F5D6A Val_Wu16 65535.00 DFES_OneToOne 0.00 65535.00 FORMAT "%8.2" /end CHARACTERISTIC
/begin CHARACTERISTIC DFC_DisblMsk.DFC_ComCntTCU3_C "disable mask / Disable masks of check DFC_ComCntTCU3" VALUE 0x804F5D6C Val_Wu16 65535.00 DFES_OneToOne 0.00 65535.00 FORMAT "%8.2" /end CHARACTERISTIC
/begin CHARACTERISTIC DFC_DisblMsk.DFC_ComCntTCU4_C "disable mask / Disable masks of check DFC_ComCntTCU4" VALUE 0x804F5D6E Val_Wu16 65535.00 DFES_OneToOne 0.00 65535.00 FORMAT "%8.2" /end CHARACTERISTIC
/begin CHARACTERISTIC DFC_DisblMsk.DFC_ComTOutTCU01_C "disable mask / Disable masks of check DFC_ComTOutTCU01" VALUE 0x804F5D70 Val_Wu16 65535.00 DFES_OneToOne 0.00 65535.00 FORMAT "%8.2" /end CHARACTERISTIC
/begin CHARACTERISTIC DFC_DisblMsk.DFC_ComTOutTCU02_C "disable mask / Disable masks of check DFC_ComTOutTCU02" VALUE 0x804F5D72 Val_Wu16 65535.00 DFES_OneToOne 0.00 65535.00 FORMAT "%8.2" /end CHARACTERISTIC
/begin CHARACTERISTIC DFC_DisblMsk.DFC_ComTOutTCU1_C "disable mask / Disable masks of check DFC_ComTOutTCU1" VALUE 0x804F5D74 Val_Wu16 65535.00 DFES_OneToOne 0.00 65535.00 FORMAT "%8.2" /end CHARACTERISTIC
/begin CHARACTERISTIC DFC_DisblMsk.DFC_ComTOutTCU11_C "disable mask / Disable masks of check DFC_ComTOutTCU11" VALUE 0x804F5D76 Val_Wu16 65535.00 DFES_OneToOne 0.00 65535.00 FORMAT "%8.2" /end CHARACTERISTIC
/begin CHARACTERISTIC DFC_DisblMsk.DFC_ComTOutTCU12_C "disable mask / Disable masks of check DFC_ComTOutTCU12" VALUE 0x804F5D78 Val_Wu16 65535.00 DFES_OneToOne 0.00 65535.00 FORMAT "%8.2" /end CHARACTERISTIC
/begin CHARACTERISTIC DFC_DisblMsk.DFC_ComTOutTCU13_C "disable mask / Disable masks of check DFC_ComTOutTCU13" VALUE 0x804F5D7A Val_Wu16 65535.00 DFES_OneToOne 0.00 65535.00 FORMAT "%8.2" /end CHARACTERISTIC
/begin CHARACTERISTIC DFC_DisblMsk.DFC_ComTOutTCU14_C "disable mask / Disable masks of check DFC_ComTOutTCU14" VALUE 0x804F5D7C Val_Wu16 65535.00 DFES_OneToOne 0.00 65535.00 FORMAT "%8.2" /end CHARACTERISTIC
/begin CHARACTERISTIC DFC_DisblMsk.DFC_ComTOutTCU2_C "disable mask / Disable masks of check DFC_ComTOutTCU2" VALUE 0x804F5D7E Val_Wu16 65535.00 DFES_OneToOne 0.00 65535.00 FORMAT "%8.2" /end CHARACTERISTIC
/begin CHARACTERISTIC DFC_DisblMsk.DFC_ComTOutTCU3_C "disable mask / Disable masks of check DFC_ComTOutTCU3" VALUE 0x804F5D80 Val_Wu16 65535.00 DFES_OneToOne 0.00 65535.00 FORMAT "%8.2" /end CHARACTERISTIC
/begin CHARACTERISTIC DFC_DisblMsk.DFC_ComTOutTCU4_C "disable mask / Disable masks of check DFC_ComTOutTCU4" VALUE 0x804F5D82 Val_Wu16 65535.00 DFES_OneToOne 0.00 65535.00 FORMAT "%8.2" /end CHARACTERISTIC
/begin CHARACTERISTIC DFC_DisblMsk.DFC_DevLibBattUHi_C "disable mask / Disable masks of check DFC_DevLibBattUHi" VALUE 0x804F5D84 Val_Wu16 65535.00 DFES_OneToOne 0.00 65535.00 FORMAT "%8.2" /end CHARACTERISTIC
/begin CHARACTERISTIC DFC_DisblMsk.DFC_DevLibBattULo_C "disable mask / Disable masks of check DFC_DevLibBattULo" VALUE 0x804F5D86 Val_Wu16 65535.00 DFES_OneToOne 0.00 65535.00 FORMAT "%8.2" /end CHARACTERISTIC
/begin CHARACTERISTIC DFC_DisblMsk.DFC_EGRVlvFailSafeActv_C "disable mask / Disable masks of check DFC_EGRVlvFailSafeActv" VALUE 0x804F5D88 Val_Wu16 65535.00 DFES_OneToOne 0.00 65535.00 FORMAT "%8.2" /end CHARACTERISTIC
/begin CHARACTERISTIC DFC_DisblMsk.DFC_EGRVlvGovDvtCld_C "disable mask / Disable masks of check DFC_EGRVlvGovDvtCld" VALUE 0x804F5D8A Val_Wu16 65535.00 DFES_OneToOne 0.00 65535.00 FORMAT "%8.2" /end CHARACTERISTIC
/begin CHARACTERISTIC DFC_DisblMsk.DFC_EGRVlvPhysSRCMax_C "disable mask / Disable masks of check DFC_EGRVlvPhysSRCMax" VALUE 0x804F5D8C Val_Wu16 65535.00 DFES_OneToOne 0.00 65535.00 FORMAT "%8.2" /end CHARACTERISTIC
/begin CHARACTERISTIC DFC_DisblMsk.DFC_EGRVlvPhysSRCMin_C "disable mask / Disable masks of check DFC_EGRVlvPhysSRCMin" VALUE 0x804F5D8E Val_Wu16 65535.00 DFES_OneToOne 0.00 65535.00 FORMAT "%8.2" /end CHARACTERISTIC
/begin CHARACTERISTIC DFC_DisblMsk.DFC_FanDIOOL_0_C "disable mask / Disable masks of check DFC_FanDIOOL_0" VALUE 0x804F5D90 Val_Wu16 65535.00 DFES_OneToOne 0.00 65535.00 FORMAT "%8.2" /end CHARACTERISTIC
/begin CHARACTERISTIC DFC_DisblMsk.DFC_FanDIOOL_1_C "disable mask / Disable masks of check DFC_FanDIOOL_1" VALUE 0x804F5D92 Val_Wu16 65535.00 DFES_OneToOne 0.00 65535.00 FORMAT "%8.2" /end CHARACTERISTIC
/begin CHARACTERISTIC DFC_DisblMsk.DFC_FanDIOOvrTemp_0_C "disable mask / Disable masks of check DFC_FanDIOOvrTemp_0" VALUE 0x804F5D94 Val_Wu16 65535.00 DFES_OneToOne 0.00 65535.00 FORMAT "%8.2" /end CHARACTERISTIC
/begin CHARACTERISTIC DFC_DisblMsk.DFC_FanDIOOvrTemp_1_C "disable mask / Disable masks of check DFC_FanDIOOvrTemp_1" VALUE 0x804F5D96 Val_Wu16 65535.00 DFES_OneToOne 0.00 65535.00 FORMAT "%8.2" /end CHARACTERISTIC
/begin CHARACTERISTIC DFC_DisblMsk.DFC_FanDIOSCB_0_C "disable mask / Disable masks of check DFC_FanDIOSCB_0" VALUE 0x804F5D98 Val_Wu16 65535.00 DFES_OneToOne 0.00 65535.00 FORMAT "%8.2" /end CHARACTERISTIC
/begin CHARACTERISTIC DFC_DisblMsk.DFC_FanDIOSCB_1_C "disable mask / Disable masks of check DFC_FanDIOSCB_1" VALUE 0x804F5D9A Val_Wu16 65535.00 DFES_OneToOne 0.00 65535.00 FORMAT "%8.2" /end CHARACTERISTIC
/begin CHARACTERISTIC DFC_DisblMsk.DFC_FanDIOSCG_0_C "disable mask / Disable masks of check DFC_FanDIOSCG_0" VALUE 0x804F5D9C Val_Wu16 65535.00 DFES_OneToOne 0.00 65535.00 FORMAT "%8.2" /end CHARACTERISTIC
/begin CHARACTERISTIC DFC_DisblMsk.DFC_FanDIOSCG_1_C "disable mask / Disable masks of check DFC_FanDIOSCG_1" VALUE 0x804F5D9E Val_Wu16 65535.00 DFES_OneToOne 0.00 65535.00 FORMAT "%8.2" /end CHARACTERISTIC
/begin CHARACTERISTIC DFC_DisblMsk.DFC_MRlyDcOL_C "disable mask / Disable masks of check DFC_MRlyDcOL" VALUE 0x804F5DA0 Val_Wu16 65535.00 DFES_OneToOne 0.00 65535.00 FORMAT "%8.2" /end CHARACTERISTIC
/begin CHARACTERISTIC DFC_DisblMsk.DFC_MRlyDcSCB_C "disable mask / Disable masks of check DFC_MRlyDcSCB" VALUE 0x804F5DA2 Val_Wu16 65535.00 DFES_OneToOne 0.00 65535.00 FORMAT "%8.2" /end CHARACTERISTIC
/begin CHARACTERISTIC DFC_DisblMsk.DFC_MRlyDcSCG_C "disable mask / Disable masks of check DFC_MRlyDcSCG" VALUE 0x804F5DA4 Val_Wu16 65535.00 DFES_OneToOne 0.00 65535.00 FORMAT "%8.2" /end CHARACTERISTIC
/begin CHARACTERISTIC DFC_DisblMsk.DFC_PSPOL_C "disable mask / Disable masks of check DFC_PSPOL" VALUE 0x804F5DA6 Val_Wu16 65535.00 DFES_OneToOne 0.00 65535.00 FORMAT "%8.2" /end CHARACTERISTIC
/begin CHARACTERISTIC DFC_DisblMsk.DFC_PSPOvrTemp_C "disable mask / Disable masks of check DFC_PSPOvrTemp" VALUE 0x804F5DA8 Val_Wu16 65535.00 DFES_OneToOne 0.00 65535.00 FORMAT "%8.2" /end CHARACTERISTIC
/begin CHARACTERISTIC DFC_DisblMsk.DFC_PSPSCB_C "disable mask / Disable masks of check DFC_PSPSCB" VALUE 0x804F5DAA Val_Wu16 65535.00 DFES_OneToOne 0.00 65535.00 FORMAT "%8.2" /end CHARACTERISTIC
/begin CHARACTERISTIC DFC_DisblMsk.DFC_PSPSCG_C "disable mask / Disable masks of check DFC_PSPSCG" VALUE 0x804F5DAC Val_Wu16 65535.00 DFES_OneToOne 0.00 65535.00 FORMAT "%8.2" /end CHARACTERISTIC
/begin CHARACTERISTIC DFC_DisblMsk.DFC_T50Err_C "disable mask / Disable masks of check DFC_T50Err" VALUE 0x804F5DAE Val_Wu16 65535.00 DFES_OneToOne 0.00 65535.00 FORMAT "%8.2" /end CHARACTERISTIC
/begin CHARACTERISTIC DFC_DisblMsk.DFC_ThrVlvLoBattB1_C "disable mask / Disable masks of check DFC_ThrVlvLoBattB1" VALUE 0x804F5DB0 Val_Wu16 65535.00 DFES_OneToOne 0.00 65535.00 FORMAT "%8.2" /end CHARACTERISTIC
/begin CHARACTERISTIC DFC_DisblMsk.DFC_UegoSigOperPlausS1B1_C "disable mask / Disable masks of check DFC_UegoSigOperPlausS1B1" VALUE 0x804F5DB2 Val_Wu16 65535.00 DFES_OneToOne 0.00 65535.00 FORMAT "%8.2" /end CHARACTERISTIC
/begin CHARACTERISTIC DFC_DisblMsk.DFC_VehVPhysRngHi_C "disable mask / Disable masks of check DFC_VehVPhysRngHi" VALUE 0x804F5DB4 Val_Wu16 65535.00 DFES_OneToOne 0.00 65535.00 FORMAT "%8.2" /end CHARACTERISTIC
/begin CHARACTERISTIC DFC_DisblMsk.DFC_VehVSclOutOL_C "disable mask / Disable masks of check DFC_VehVSclOutOL" VALUE 0x804F5DB6 Val_Wu16 65535.00 DFES_OneToOne 0.00 65535.00 FORMAT "%8.2" /end CHARACTERISTIC
/begin CHARACTERISTIC DFC_DisblMsk.DFC_VehVSclOutOT_C "disable mask / Disable masks of check DFC_VehVSclOutOT" VALUE 0x804F5DB8 Val_Wu16 65535.00 DFES_OneToOne 0.00 65535.00 FORMAT "%8.2" /end CHARACTERISTIC
/begin CHARACTERISTIC DFC_DisblMsk.DFC_VehVSclOutSCB_C "disable mask / Disable masks of check DFC_VehVSclOutSCB" VALUE 0x804F5DBA Val_Wu16 65535.00 DFES_OneToOne 0.00 65535.00 FORMAT "%8.2" /end CHARACTERISTIC
/begin CHARACTERISTIC DFC_DisblMsk.DFC_VehVSclOutSCG_C "disable mask / Disable masks of check DFC_VehVSclOutSCG" VALUE 0x804F5DBC Val_Wu16 65535.00 DFES_OneToOne 0.00 65535.00 FORMAT "%8.2" /end CHARACTERISTIC
/begin CHARACTERISTIC DFC_DisblMsk.DFC_VehVSigFL_C "disable mask / Disable masks of check DFC_VehVSigFL" VALUE 0x804F5DBE Val_Wu16 65535.00 DFES_OneToOne 0.00 65535.00 FORMAT "%8.2" /end CHARACTERISTIC
/begin CHARACTERISTIC DFC_DisblMsk.DFC_VehVSigFR_C "disable mask / Disable masks of check DFC_VehVSigFR" VALUE 0x804F5DC0 Val_Wu16 65535.00 DFES_OneToOne 0.00 65535.00 FORMAT "%8.2" /end CHARACTERISTIC
/begin CHARACTERISTIC DFC_DisblMsk.DFC_VehVSigRL_C "disable mask / Disable masks of check DFC_VehVSigRL" VALUE 0x804F5DC2 Val_Wu16 65535.00 DFES_OneToOne 0.00 65535.00 FORMAT "%8.2" /end CHARACTERISTIC
/begin CHARACTERISTIC DFC_DisblMsk.DFC_VehVSigRR_C "disable mask / Disable masks of check DFC_VehVSigRR" VALUE 0x804F5DC4 Val_Wu16 65535.00 DFES_OneToOne 0.00 65535.00 FORMAT "%8.2" /end CHARACTERISTIC
/begin CHARACTERISTIC DFC_DisblMsk.DFC_VehVSnsrARngHi_C "disable mask / Disable masks of check DFC_VehVSnsrARngHi" VALUE 0x804F5DC6 Val_Wu16 65535.00 DFES_OneToOne 0.00 65535.00 FORMAT "%8.2" /end CHARACTERISTIC
/begin CHARACTERISTIC DFC_DisblMsk.DFC_VehVSnsrBRngHi_C "disable mask / Disable masks of check DFC_VehVSnsrBRngHi" VALUE 0x804F5DC8 Val_Wu16 65535.00 DFES_OneToOne 0.00 65535.00 FORMAT "%8.2" /end CHARACTERISTIC
/begin CHARACTERISTIC DFC_DisblMsk.DFC_VehVSpdRtyDiag_C "disable mask / Disable masks of check DFC_VehVSpdRtyDiag" VALUE 0x804F5DCA Val_Wu16 65535.00 DFES_OneToOne 0.00 65535.00 FORMAT "%8.2" /end CHARACTERISTIC
/begin CHARACTERISTIC DFC_DisblMsk.DFC_DHFHD_C "disable mask / Disable masks of check DFC_DHFHD" VALUE 0x804F5DCC Val_Wu16 65535.00 DFES_OneToOne 0.00 65535.00 FORMAT "%8.2" /end CHARACTERISTIC
/begin CHARACTERISTIC DFC_DisblMsk.DFC_InjVlv_DI_DcDc_C "disable mask / Disable masks of check DFC_InjVlv_DI_DcDc" VALUE 0x804F5DCE Val_Wu16 65535.00 DFES_OneToOne 0.00 65535.00 FORMAT "%8.2" /end CHARACTERISTIC
/begin CHARACTERISTIC DFC_DisblMsk.DFC_InjVlv_DI_NoLd_0_C "disable mask / Disable masks of check DFC_InjVlv_DI_NoLd_0" VALUE 0x804F5DD0 Val_Wu16 65535.00 DFES_OneToOne 0.00 65535.00 FORMAT "%8.2" /end CHARACTERISTIC
/begin CHARACTERISTIC DFC_DisblMsk.DFC_InjVlv_DI_NoLd_1_C "disable mask / Disable masks of check DFC_InjVlv_DI_NoLd_1" VALUE 0x804F5DD2 Val_Wu16 65535.00 DFES_OneToOne 0.00 65535.00 FORMAT "%8.2" /end CHARACTERISTIC
/begin CHARACTERISTIC DFC_DisblMsk.DFC_InjVlv_DI_NoLd_2_C "disable mask / Disable masks of check DFC_InjVlv_DI_NoLd_2" VALUE 0x804F5DD4 Val_Wu16 65535.00 DFES_OneToOne 0.00 65535.00 FORMAT "%8.2" /end CHARACTERISTIC
/begin CHARACTERISTIC DFC_DisblMsk.DFC_InjVlv_DI_NoLd_3_C "disable mask / Disable masks of check DFC_InjVlv_DI_NoLd_3" VALUE 0x804F5DD6 Val_Wu16 65535.00 DFES_OneToOne 0.00 65535.00 FORMAT "%8.2" /end CHARACTERISTIC
/begin CHARACTERISTIC DFC_DisblMsk.DFC_InjVlv_DI_ScBnk_0_C "disable mask / Disable masks of check DFC_InjVlv_DI_ScBnk_0" VALUE 0x804F5DD8 Val_Wu16 65535.00 DFES_OneToOne 0.00 65535.00 FORMAT "%8.2" /end CHARACTERISTIC
/begin CHARACTERISTIC DFC_DisblMsk.DFC_InjVlv_DI_ScBnk_1_C "disable mask / Disable masks of check DFC_InjVlv_DI_ScBnk_1" VALUE 0x804F5DDA Val_Wu16 65535.00 DFES_OneToOne 0.00 65535.00 FORMAT "%8.2" /end CHARACTERISTIC
/begin CHARACTERISTIC DFC_DisblMsk.DFC_InjVlv_DI_ScBnk_2_C "disable mask / Disable masks of check DFC_InjVlv_DI_ScBnk_2" VALUE 0x804F5DDC Val_Wu16 65535.00 DFES_OneToOne 0.00 65535.00 FORMAT "%8.2" /end CHARACTERISTIC
/begin CHARACTERISTIC DFC_DisblMsk.DFC_InjVlv_DI_ScBnk_3_C "disable mask / Disable masks of check DFC_InjVlv_DI_ScBnk_3" VALUE 0x804F5DDE Val_Wu16 65535.00 DFES_OneToOne 0.00 65535.00 FORMAT "%8.2" /end CHARACTERISTIC
/begin CHARACTERISTIC DFC_DisblMsk.DFC_InjVlv_DI_ScCyl_0_C "disable mask / Disable masks of check DFC_InjVlv_DI_ScCyl_0" VALUE 0x804F5DE0 Val_Wu16 65535.00 DFES_OneToOne 0.00 65535.00 FORMAT "%8.2" /end CHARACTERISTIC
/begin CHARACTERISTIC DFC_DisblMsk.DFC_InjVlv_DI_ScCyl_1_C "disable mask / Disable masks of check DFC_InjVlv_DI_ScCyl_1" VALUE 0x804F5DE2 Val_Wu16 65535.00 DFES_OneToOne 0.00 65535.00 FORMAT "%8.2" /end CHARACTERISTIC
/begin CHARACTERISTIC DFC_DisblMsk.DFC_InjVlv_DI_ScCyl_2_C "disable mask / Disable masks of check DFC_InjVlv_DI_ScCyl_2" VALUE 0x804F5DE4 Val_Wu16 65535.00 DFES_OneToOne 0.00 65535.00 FORMAT "%8.2" /end CHARACTERISTIC
/begin CHARACTERISTIC DFC_DisblMsk.DFC_InjVlv_DI_ScCyl_3_C "disable mask / Disable masks of check DFC_InjVlv_DI_ScCyl_3" VALUE 0x804F5DE6 Val_Wu16 65535.00 DFES_OneToOne 0.00 65535.00 FORMAT "%8.2" /end CHARACTERISTIC
/begin CHARACTERISTIC DFC_DisblMsk.DFC_InjVlv_DI_ScHsLs_0_C "disable mask / Disable masks of check DFC_InjVlv_DI_ScHsLs_0" VALUE 0x804F5DE8 Val_Wu16 65535.00 DFES_OneToOne 0.00 65535.00 FORMAT "%8.2" /end CHARACTERISTIC
/begin CHARACTERISTIC DFC_DisblMsk.DFC_InjVlv_DI_ScHsLs_1_C "disable mask / Disable masks of check DFC_InjVlv_DI_ScHsLs_1" VALUE 0x804F5DEA Val_Wu16 65535.00 DFES_OneToOne 0.00 65535.00 FORMAT "%8.2" /end CHARACTERISTIC
/begin CHARACTERISTIC DFC_DisblMsk.DFC_InjVlv_DI_ScHsLs_2_C "disable mask / Disable masks of check DFC_InjVlv_DI_ScHsLs_2" VALUE 0x804F5DEC Val_Wu16 65535.00 DFES_OneToOne 0.00 65535.00 FORMAT "%8.2" /end CHARACTERISTIC
/begin CHARACTERISTIC DFC_DisblMsk.DFC_InjVlv_DI_ScHsLs_3_C "disable mask / Disable masks of check DFC_InjVlv_DI_ScHsLs_3" VALUE 0x804F5DEE Val_Wu16 65535.00 DFES_OneToOne 0.00 65535.00 FORMAT "%8.2" /end CHARACTERISTIC
/begin CHARACTERISTIC DFC_DisblMsk.DFC_MfPsDiaOpenLoad1_C "disable mask / Disable masks of check DFC_MfPsDiaOpenLoad1" VALUE 0x804F5DF0 Val_Wu16 65535.00 DFES_OneToOne 0.00 65535.00 FORMAT "%8.2" /end CHARACTERISTIC
/begin CHARACTERISTIC DFC_DisblMsk.DFC_MfPsDiaScHiS1_C "disable mask / Disable masks of check DFC_MfPsDiaScHiS1" VALUE 0x804F5DF2 Val_Wu16 65535.00 DFES_OneToOne 0.00 65535.00 FORMAT "%8.2" /end CHARACTERISTIC
/begin CHARACTERISTIC DFC_DisblMsk.DFC_MfPsDiaScHiSLowS1_C "disable mask / Disable masks of check DFC_MfPsDiaScHiSLowS1" VALUE 0x804F5DF4 Val_Wu16 65535.00 DFES_OneToOne 0.00 65535.00 FORMAT "%8.2" /end CHARACTERISTIC
/begin CHARACTERISTIC DFC_DisblMsk.DFC_MfPsDiaScLowS1_C "disable mask / Disable masks of check DFC_MfPsDiaScLowS1" VALUE 0x804F5DF6 Val_Wu16 65535.00 DFES_OneToOne 0.00 65535.00 FORMAT "%8.2" /end CHARACTERISTIC
/begin CHARACTERISTIC DFC_DisblMsk.DFC_ACEvpTPhysRngHi_C "disable mask / Disable masks of check DFC_ACEvpTPhysRngHi" VALUE 0x804F5DF8 Val_Wu16 65535.00 DFES_OneToOne 0.00 65535.00 FORMAT "%8.2" /end CHARACTERISTIC
/begin CHARACTERISTIC DFC_DisblMsk.DFC_ACEvpTPhysRngLo_C "disable mask / Disable masks of check DFC_ACEvpTPhysRngLo" VALUE 0x804F5DFA Val_Wu16 65535.00 DFES_OneToOne 0.00 65535.00 FORMAT "%8.2" /end CHARACTERISTIC
/begin CHARACTERISTIC DFC_DisblMsk.DFC_ACEvpTSRCMax_C "disable mask / Disable masks of check DFC_ACEvpTSRCMax" VALUE 0x804F5DFC Val_Wu16 65535.00 DFES_OneToOne 0.00 65535.00 FORMAT "%8.2" /end CHARACTERISTIC
/begin CHARACTERISTIC DFC_DisblMsk.DFC_ACEvpTSRCMin_C "disable mask / Disable masks of check DFC_ACEvpTSRCMin" VALUE 0x804F5DFE Val_Wu16 65535.00 DFES_OneToOne 0.00 65535.00 FORMAT "%8.2" /end CHARACTERISTIC
/begin CHARACTERISTIC DFC_DisblMsk.DFC_AfsRawSigRngHiB1_C "disable mask / Disable masks of check DFC_AfsRawSigRngHiB1" VALUE 0x804F5E00 Val_Wu16 65535.00 DFES_OneToOne 0.00 65535.00 FORMAT "%8.2" /end CHARACTERISTIC
/begin CHARACTERISTIC DFC_DisblMsk.DFC_AfsRawSigRngLoB1_C "disable mask / Disable masks of check DFC_AfsRawSigRngLoB1" VALUE 0x804F5E02 Val_Wu16 65535.00 DFES_OneToOne 0.00 65535.00 FORMAT "%8.2" /end CHARACTERISTIC
/begin CHARACTERISTIC DFC_DisblMsk.DFC_AfsSnsrErrB1_C "disable mask / Disable masks of check DFC_AfsSnsrErrB1" VALUE 0x804F5E04 Val_Wu16 65535.00 DFES_OneToOne 0.00 65535.00 FORMAT "%8.2" /end CHARACTERISTIC
/begin CHARACTERISTIC DFC_DisblMsk.DFC_AirCClntPAnaSRCMax_C "disable mask / Disable masks of check DFC_AirCClntPAnaSRCMax" VALUE 0x804F5E06 Val_Wu16 65535.00 DFES_OneToOne 0.00 65535.00 FORMAT "%8.2" /end CHARACTERISTIC
/begin CHARACTERISTIC DFC_DisblMsk.DFC_AirCClntPAnaSRCMin_C "disable mask / Disable masks of check DFC_AirCClntPAnaSRCMin" VALUE 0x804F5E08 Val_Wu16 65535.00 DFES_OneToOne 0.00 65535.00 FORMAT "%8.2" /end CHARACTERISTIC
/begin CHARACTERISTIC DFC_DisblMsk.DFC_AirCSwtNpl_C "disable mask / Disable masks of check DFC_AirCSwtNpl" VALUE 0x804F5E0A Val_Wu16 65535.00 DFES_OneToOne 0.00 65535.00 FORMAT "%8.2" /end CHARACTERISTIC
/begin CHARACTERISTIC DFC_DisblMsk.DFC_AirCSwtSig_C "disable mask / Disable masks of check DFC_AirCSwtSig" VALUE 0x804F5E0C Val_Wu16 65535.00 DFES_OneToOne 0.00 65535.00 FORMAT "%8.2" /end CHARACTERISTIC
/begin CHARACTERISTIC DFC_DisblMsk.DFC_Brk_C "disable mask / Disable masks of check DFC_Brk" VALUE 0x804F5E0E Val_Wu16 65535.00 DFES_OneToOne 0.00 65535.00 FORMAT "%8.2" /end CHARACTERISTIC
/begin CHARACTERISTIC DFC_DisblMsk.DFC_BrkBstSensSCB_C "disable mask / Disable masks of check DFC_BrkBstSensSCB" VALUE 0x804F5E10 Val_Wu16 65535.00 DFES_OneToOne 0.00 65535.00 FORMAT "%8.2" /end CHARACTERISTIC
/begin CHARACTERISTIC DFC_DisblMsk.DFC_BrkBstSensSCG_C "disable mask / Disable masks of check DFC_BrkBstSensSCG" VALUE 0x804F5E12 Val_Wu16 65535.00 DFES_OneToOne 0.00 65535.00 FORMAT "%8.2" /end CHARACTERISTIC
/begin CHARACTERISTIC DFC_DisblMsk.DFC_BrkSig_C "disable mask / Disable masks of check DFC_BrkSig" VALUE 0x804F5E14 Val_Wu16 65535.00 DFES_OneToOne 0.00 65535.00 FORMAT "%8.2" /end CHARACTERISTIC
/begin CHARACTERISTIC DFC_DisblMsk.DFC_ClthSig_C "disable mask / Disable masks of check DFC_ClthSig" VALUE 0x804F5E16 Val_Wu16 65535.00 DFES_OneToOne 0.00 65535.00 FORMAT "%8.2" /end CHARACTERISTIC
/begin CHARACTERISTIC DFC_DisblMsk.DFC_EGRVlvCurrLim_C "disable mask / Disable masks of check DFC_EGRVlvCurrLim" VALUE 0x804F5E18 Val_Wu16 65535.00 DFES_OneToOne 0.00 65535.00 FORMAT "%8.2" /end CHARACTERISTIC
/begin CHARACTERISTIC DFC_DisblMsk.DFC_EGRVlvOL_C "disable mask / Disable masks of check DFC_EGRVlvOL" VALUE 0x804F5E1A Val_Wu16 65535.00 DFES_OneToOne 0.00 65535.00 FORMAT "%8.2" /end CHARACTERISTIC
/begin CHARACTERISTIC DFC_DisblMsk.DFC_EGRVlvOvrTemp_C "disable mask / Disable masks of check DFC_EGRVlvOvrTemp" VALUE 0x804F5E1C Val_Wu16 65535.00 DFES_OneToOne 0.00 65535.00 FORMAT "%8.2" /end CHARACTERISTIC
/begin CHARACTERISTIC DFC_DisblMsk.DFC_EGRVlvSCB_C "disable mask / Disable masks of check DFC_EGRVlvSCB" VALUE 0x804F5E1E Val_Wu16 65535.00 DFES_OneToOne 0.00 65535.00 FORMAT "%8.2" /end CHARACTERISTIC
/begin CHARACTERISTIC DFC_DisblMsk.DFC_EGRVlvSCG_C "disable mask / Disable masks of check DFC_EGRVlvSCG" VALUE 0x804F5E20 Val_Wu16 65535.00 DFES_OneToOne 0.00 65535.00 FORMAT "%8.2" /end CHARACTERISTIC
/begin CHARACTERISTIC DFC_DisblMsk.DFC_EGRVlvSRCMax_C "disable mask / Disable masks of check DFC_EGRVlvSRCMax" VALUE 0x804F5E22 Val_Wu16 65535.00 DFES_OneToOne 0.00 65535.00 FORMAT "%8.2" /end CHARACTERISTIC
/begin CHARACTERISTIC DFC_DisblMsk.DFC_EGRVlvSRCMin_C "disable mask / Disable masks of check DFC_EGRVlvSRCMin" VALUE 0x804F5E24 Val_Wu16 65535.00 DFES_OneToOne 0.00 65535.00 FORMAT "%8.2" /end CHARACTERISTIC
/begin CHARACTERISTIC DFC_DisblMsk.DFC_HLSDemOvhtEngLim_C "disable mask / Disable masks of check DFC_HLSDemOvhtEngLim" VALUE 0x804F5E26 Val_Wu16 65535.00 DFES_OneToOne 0.00 65535.00 FORMAT "%8.2" /end CHARACTERISTIC
/begin CHARACTERISTIC DFC_DisblMsk.DFC_OilPSwmpSRCMax_C "disable mask / Disable masks of check DFC_OilPSwmpSRCMax" VALUE 0x804F5E28 Val_Wu16 65535.00 DFES_OneToOne 0.00 65535.00 FORMAT "%8.2" /end CHARACTERISTIC
/begin CHARACTERISTIC DFC_DisblMsk.DFC_OilPSwmpSRCMin_C "disable mask / Disable masks of check DFC_OilPSwmpSRCMin" VALUE 0x804F5E2A Val_Wu16 65535.00 DFES_OneToOne 0.00 65535.00 FORMAT "%8.2" /end CHARACTERISTIC
/begin CHARACTERISTIC DFC_DisblMsk.DFC_PIntkVUsLineHiB1_C "disable mask / Disable masks of check DFC_PIntkVUsLineHiB1" VALUE 0x804F5E2C Val_Wu16 65535.00 DFES_OneToOne 0.00 65535.00 FORMAT "%8.2" /end CHARACTERISTIC
/begin CHARACTERISTIC DFC_DisblMsk.DFC_PIntkVUsLineLoB1_C "disable mask / Disable masks of check DFC_PIntkVUsLineLoB1" VALUE 0x804F5E2E Val_Wu16 65535.00 DFES_OneToOne 0.00 65535.00 FORMAT "%8.2" /end CHARACTERISTIC
/begin CHARACTERISTIC DFC_DisblMsk.DFC_VehVPhysRngLo_C "disable mask / Disable masks of check DFC_VehVPhysRngLo" VALUE 0x804F5E30 Val_Wu16 65535.00 DFES_OneToOne 0.00 65535.00 FORMAT "%8.2" /end CHARACTERISTIC
/begin CHARACTERISTIC DFC_DisblMsk.DFC_VehVSigCan_C "disable mask / Disable masks of check DFC_VehVSigCan" VALUE 0x804F5E32 Val_Wu16 65535.00 DFES_OneToOne 0.00 65535.00 FORMAT "%8.2" /end CHARACTERISTIC
/begin CHARACTERISTIC DFC_DisblMsk.DFC_VehVSigCanSafe_C "disable mask / Disable masks of check DFC_VehVSigCanSafe" VALUE 0x804F5E34 Val_Wu16 65535.00 DFES_OneToOne 0.00 65535.00 FORMAT "%8.2" /end CHARACTERISTIC
/begin CHARACTERISTIC DFC_DisblMsk.DFC_VlvLftFbOilPSnsrIntk11SRCMax_C "disable mask / Disable masks of check DFC_VlvLftFbOilPSnsrIntk11SRCMax" VALUE 0x804F5E36 Val_Wu16 65535.00 DFES_OneToOne 0.00 65535.00 FORMAT "%8.2" /end CHARACTERISTIC
/begin CHARACTERISTIC DFC_DisblMsk.DFC_VlvLftFbOilPSnsrIntk11SRCMin_C "disable mask / Disable masks of check DFC_VlvLftFbOilPSnsrIntk11SRCMin" VALUE 0x804F5E38 Val_Wu16 65535.00 DFES_OneToOne 0.00 65535.00 FORMAT "%8.2" /end CHARACTERISTIC
/begin CHARACTERISTIC DFC_DisblMsk.DFC_ClthNpl_C "disable mask / Disable masks of check DFC_ClthNpl" VALUE 0x804F5E3A Val_Wu16 65535.00 DFES_OneToOne 0.00 65535.00 FORMAT "%8.2" /end CHARACTERISTIC
/begin CHARACTERISTIC DFC_DisblMsk.DFC_GbxPNPosnDrvCdn_C "disable mask / Disable masks of check DFC_GbxPNPosnDrvCdn" VALUE 0x804F5E3C Val_Wu16 65535.00 DFES_OneToOne 0.00 65535.00 FORMAT "%8.2" /end CHARACTERISTIC
/begin CHARACTERISTIC DFC_DisblMsk.DFC_GbxPNPosnPlausy_C "disable mask / Disable masks of check DFC_GbxPNPosnPlausy" VALUE 0x804F5E3E Val_Wu16 65535.00 DFES_OneToOne 0.00 65535.00 FORMAT "%8.2" /end CHARACTERISTIC
/begin CHARACTERISTIC DFC_DisblMsk.DFC_AfsSigErrLineHiB1_C "disable mask / Disable masks of check DFC_AfsSigErrLineHiB1" VALUE 0x804F5E40 Val_Wu16 65535.00 DFES_OneToOne 0.00 65535.00 FORMAT "%8.2" /end CHARACTERISTIC
/begin CHARACTERISTIC DFC_DisblMsk.DFC_AfsSigErrLineLoB1_C "disable mask / Disable masks of check DFC_AfsSigErrLineLoB1" VALUE 0x804F5E42 Val_Wu16 65535.00 DFES_OneToOne 0.00 65535.00 FORMAT "%8.2" /end CHARACTERISTIC
/begin CHARACTERISTIC DFC_DisblMsk.DFC_PEnvCcMax_C "disable mask / Disable masks of check DFC_PEnvCcMax" VALUE 0x804F5E44 Val_Wu16 65535.00 DFES_OneToOne 0.00 65535.00 FORMAT "%8.2" /end CHARACTERISTIC
/begin CHARACTERISTIC DFC_DisblMsk.DFC_PEnvCcMin_C "disable mask / Disable masks of check DFC_PEnvCcMin" VALUE 0x804F5E46 Val_Wu16 65535.00 DFES_OneToOne 0.00 65535.00 FORMAT "%8.2" /end CHARACTERISTIC
/begin CHARACTERISTIC DFC_DisblMsk.DFC_PEnvRngChkMax_C "disable mask / Disable masks of check DFC_PEnvRngChkMax" VALUE 0x804F5E48 Val_Wu16 65535.00 DFES_OneToOne 0.00 65535.00 FORMAT "%8.2" /end CHARACTERISTIC
/begin CHARACTERISTIC DFC_DisblMsk.DFC_PEnvRngChkMin_C "disable mask / Disable masks of check DFC_PEnvRngChkMin" VALUE 0x804F5E4A Val_Wu16 65535.00 DFES_OneToOne 0.00 65535.00 FORMAT "%8.2" /end CHARACTERISTIC
/begin CHARACTERISTIC DFC_DisblMsk.DFC_PEnvSnsrPlaus_C "disable mask / Disable masks of check DFC_PEnvSnsrPlaus" VALUE 0x804F5E4C Val_Wu16 65535.00 DFES_OneToOne 0.00 65535.00 FORMAT "%8.2" /end CHARACTERISTIC
/begin CHARACTERISTIC DFC_DisblMsk.DFC_UEGOHeatrRlyPsOLS1B1_C "disable mask / Disable masks of check DFC_UEGOHeatrRlyPsOLS1B1" VALUE 0x804F5E4E Val_Wu16 65535.00 DFES_OneToOne 0.00 65535.00 FORMAT "%8.2" /end CHARACTERISTIC
/begin CHARACTERISTIC DFC_DisblMsk.DFC_UEGOHeatrRlyPsSCBS1B1_C "disable mask / Disable masks of check DFC_UEGOHeatrRlyPsSCBS1B1" VALUE 0x804F5E50 Val_Wu16 65535.00 DFES_OneToOne 0.00 65535.00 FORMAT "%8.2" /end CHARACTERISTIC
/begin CHARACTERISTIC DFC_DisblMsk.DFC_UEGOHeatrRlyPsSCGS1B1_C "disable mask / Disable masks of check DFC_UEGOHeatrRlyPsSCGS1B1" VALUE 0x804F5E52 Val_Wu16 65535.00 DFES_OneToOne 0.00 65535.00 FORMAT "%8.2" /end CHARACTERISTIC
/begin CHARACTERISTIC DFC_DisblMsk.DFC_UegoHeatrWireOlS1B1_C "disable mask / Disable masks of check DFC_UegoHeatrWireOlS1B1" VALUE 0x804F5E54 Val_Wu16 65535.00 DFES_OneToOne 0.00 65535.00 FORMAT "%8.2" /end CHARACTERISTIC
/begin CHARACTERISTIC DFC_DisblMsk.DFC_UegoHeatrWireScbS1B1_C "disable mask / Disable masks of check DFC_UegoHeatrWireScbS1B1" VALUE 0x804F5E56 Val_Wu16 65535.00 DFES_OneToOne 0.00 65535.00 FORMAT "%8.2" /end CHARACTERISTIC
/begin CHARACTERISTIC DFC_DisblMsk.DFC_UegoHeatrWireScgS1B1_C "disable mask / Disable masks of check DFC_UegoHeatrWireScgS1B1" VALUE 0x804F5E58 Val_Wu16 65535.00 DFES_OneToOne 0.00 65535.00 FORMAT "%8.2" /end CHARACTERISTIC
/begin CHARACTERISTIC DFC_DisblMsk.DFC_KnDetSens1PortAMax_C "disable mask / Disable masks of check DFC_KnDetSens1PortAMax" VALUE 0x804F5E5A Val_Wu16 65535.00 DFES_OneToOne 0.00 65535.00 FORMAT "%8.2" /end CHARACTERISTIC
/begin CHARACTERISTIC DFC_DisblMsk.DFC_KnDetSens1PortAMin_C "disable mask / Disable masks of check DFC_KnDetSens1PortAMin" VALUE 0x804F5E5C Val_Wu16 65535.00 DFES_OneToOne 0.00 65535.00 FORMAT "%8.2" /end CHARACTERISTIC
/begin CHARACTERISTIC DFC_DisblMsk.DFC_KnDetSens1PortBMax_C "disable mask / Disable masks of check DFC_KnDetSens1PortBMax" VALUE 0x804F5E5E Val_Wu16 65535.00 DFES_OneToOne 0.00 65535.00 FORMAT "%8.2" /end CHARACTERISTIC
/begin CHARACTERISTIC DFC_DisblMsk.DFC_KnDetSens1PortBMin_C "disable mask / Disable masks of check DFC_KnDetSens1PortBMin" VALUE 0x804F5E60 Val_Wu16 65535.00 DFES_OneToOne 0.00 65535.00 FORMAT "%8.2" /end CHARACTERISTIC
/begin CHARACTERISTIC DFC_DisblMsk.DFC_Clth2ONStuck_C "disable mask / Disable masks of check DFC_Clth2ONStuck" VALUE 0x804F5E62 Val_Wu16 65535.00 DFES_OneToOne 0.00 65535.00 FORMAT "%8.2" /end CHARACTERISTIC
/begin CHARACTERISTIC DFC_DisblMsk.DFC_Clth2ONStuckLdc_C "disable mask / Disable masks of check DFC_Clth2ONStuckLdc" VALUE 0x804F5E64 Val_Wu16 65535.00 DFES_OneToOne 0.00 65535.00 FORMAT "%8.2" /end CHARACTERISTIC
/begin CHARACTERISTIC DFC_DisblMsk.DFC_Clth3ONStuckLdc_C "disable mask / Disable masks of check DFC_Clth3ONStuckLdc" VALUE 0x804F5E66 Val_Wu16 65535.00 DFES_OneToOne 0.00 65535.00 FORMAT "%8.2" /end CHARACTERISTIC
/begin CHARACTERISTIC DFC_DisblMsk.DFC_Clth3ONStuckPostDrv_C "disable mask / Disable masks of check DFC_Clth3ONStuckPostDrv" VALUE 0x804F5E68 Val_Wu16 65535.00 DFES_OneToOne 0.00 65535.00 FORMAT "%8.2" /end CHARACTERISTIC
/begin CHARACTERISTIC DFC_DisblMsk.DFC_Clth4ONStuck_C "disable mask / Disable masks of check DFC_Clth4ONStuck" VALUE 0x804F5E6A Val_Wu16 65535.00 DFES_OneToOne 0.00 65535.00 FORMAT "%8.2" /end CHARACTERISTIC
/begin CHARACTERISTIC DFC_DisblMsk.DFC_Clth4ONStuckLdc_C "disable mask / Disable masks of check DFC_Clth4ONStuckLdc" VALUE 0x804F5E6C Val_Wu16 65535.00 DFES_OneToOne 0.00 65535.00 FORMAT "%8.2" /end CHARACTERISTIC
/begin CHARACTERISTIC DFC_DisblMsk.DFC_ComBCMUnit_C "disable mask / Disable masks of check DFC_ComBCMUnit" VALUE 0x804F5E6E Val_Wu16 65535.00 DFES_OneToOne 0.00 65535.00 FORMAT "%8.2" /end CHARACTERISTIC
/begin CHARACTERISTIC DFC_DisblMsk.DFC_ComDLCTCU01_C "disable mask / Disable masks of check DFC_ComDLCTCU01" VALUE 0x804F5E70 Val_Wu16 65535.00 DFES_OneToOne 0.00 65535.00 FORMAT "%8.2" /end CHARACTERISTIC
/begin CHARACTERISTIC DFC_DisblMsk.DFC_ComDLCTCU02_C "disable mask / Disable masks of check DFC_ComDLCTCU02" VALUE 0x804F5E72 Val_Wu16 65535.00 DFES_OneToOne 0.00 65535.00 FORMAT "%8.2" /end CHARACTERISTIC
/begin CHARACTERISTIC DFC_DisblMsk.DFC_ComDLCTCU1_C "disable mask / Disable masks of check DFC_ComDLCTCU1" VALUE 0x804F5E74 Val_Wu16 65535.00 DFES_OneToOne 0.00 65535.00 FORMAT "%8.2" /end CHARACTERISTIC
/begin CHARACTERISTIC DFC_DisblMsk.DFC_ComDLCTCU11_C "disable mask / Disable masks of check DFC_ComDLCTCU11" VALUE 0x804F5E76 Val_Wu16 65535.00 DFES_OneToOne 0.00 65535.00 FORMAT "%8.2" /end CHARACTERISTIC
/begin CHARACTERISTIC DFC_DisblMsk.DFC_ComDLCTCU12_C "disable mask / Disable masks of check DFC_ComDLCTCU12" VALUE 0x804F5E78 Val_Wu16 65535.00 DFES_OneToOne 0.00 65535.00 FORMAT "%8.2" /end CHARACTERISTIC
/begin CHARACTERISTIC DFC_DisblMsk.DFC_ComDLCTCU13_C "disable mask / Disable masks of check DFC_ComDLCTCU13" VALUE 0x804F5E7A Val_Wu16 65535.00 DFES_OneToOne 0.00 65535.00 FORMAT "%8.2" /end CHARACTERISTIC
/begin CHARACTERISTIC DFC_DisblMsk.DFC_ComDLCTCU14_C "disable mask / Disable masks of check DFC_ComDLCTCU14" VALUE 0x804F5E7C Val_Wu16 65535.00 DFES_OneToOne 0.00 65535.00 FORMAT "%8.2" /end CHARACTERISTIC
/begin CHARACTERISTIC DFC_DisblMsk.DFC_ComDLCTCU2_C "disable mask / Disable masks of check DFC_ComDLCTCU2" VALUE 0x804F5E7E Val_Wu16 65535.00 DFES_OneToOne 0.00 65535.00 FORMAT "%8.2" /end CHARACTERISTIC
/begin CHARACTERISTIC DFC_DisblMsk.DFC_ComDLCTCU3_C "disable mask / Disable masks of check DFC_ComDLCTCU3" VALUE 0x804F5E80 Val_Wu16 65535.00 DFES_OneToOne 0.00 65535.00 FORMAT "%8.2" /end CHARACTERISTIC
/begin CHARACTERISTIC DFC_DisblMsk.DFC_ComDLCTCU4_C "disable mask / Disable masks of check DFC_ComDLCTCU4" VALUE 0x804F5E82 Val_Wu16 65535.00 DFES_OneToOne 0.00 65535.00 FORMAT "%8.2" /end CHARACTERISTIC
/begin CHARACTERISTIC DFC_DisblMsk.DFC_ComEPSUnit_C "disable mask / Disable masks of check DFC_ComEPSUnit" VALUE 0x804F5E84 Val_Wu16 65535.00 DFES_OneToOne 0.00 65535.00 FORMAT "%8.2" /end CHARACTERISTIC
/begin CHARACTERISTIC DFC_DisblMsk.DFC_ComIDASBUnit_C "disable mask / Disable masks of check DFC_ComIDASBUnit" VALUE 0x804F5E86 Val_Wu16 65535.00 DFES_OneToOne 0.00 65535.00 FORMAT "%8.2" /end CHARACTERISTIC
/begin CHARACTERISTIC DFC_DisblMsk.DFC_ComIMGUnit_C "disable mask / Disable masks of check DFC_ComIMGUnit" VALUE 0x804F5E88 Val_Wu16 65535.00 DFES_OneToOne 0.00 65535.00 FORMAT "%8.2" /end CHARACTERISTIC
/begin CHARACTERISTIC DFC_DisblMsk.DFC_ComMETUnit_C "disable mask / Disable masks of check DFC_ComMETUnit" VALUE 0x804F5E8A Val_Wu16 65535.00 DFES_OneToOne 0.00 65535.00 FORMAT "%8.2" /end CHARACTERISTIC
/begin CHARACTERISTIC DFC_DisblMsk.DFC_ComSRSUnit_C "disable mask / Disable masks of check DFC_ComSRSUnit" VALUE 0x804F5E8C Val_Wu16 65535.00 DFES_OneToOne 0.00 65535.00 FORMAT "%8.2" /end CHARACTERISTIC
/begin CHARACTERISTIC DFC_DisblMsk.DFC_ComVSAUnit_C "disable mask / Disable masks of check DFC_ComVSAUnit" VALUE 0x804F5E8E Val_Wu16 65535.00 DFES_OneToOne 0.00 65535.00 FORMAT "%8.2" /end CHARACTERISTIC
/begin CHARACTERISTIC DFC_DisblMsk.DFC_EbsSocFlt_C "disable mask / Disable masks of check DFC_EbsSocFlt" VALUE 0x804F5E90 Val_Wu16 65535.00 DFES_OneToOne 0.00 65535.00 FORMAT "%8.2" /end CHARACTERISTIC
/begin CHARACTERISTIC DFC_DisblMsk.DFC_I14229VINErr_C "disable mask / Disable masks of check DFC_I14229VINErr" VALUE 0x804F5E92 Val_Wu16 65535.00 DFES_OneToOne 0.00 65535.00 FORMAT "%8.2" /end CHARACTERISTIC
/begin CHARACTERISTIC DFC_DisblMsk.DFC_InjCatHeatgErr_C "disable mask / Disable masks of check DFC_InjCatHeatgErr" VALUE 0x804F5E94 Val_Wu16 65535.00 DFES_OneToOne 0.00 65535.00 FORMAT "%8.2" /end CHARACTERISTIC
/begin CHARACTERISTIC DFC_DisblMsk.DFC_InjSysMulInjDiagErr_C "disable mask / Disable masks of check DFC_InjSysMulInjDiagErr" VALUE 0x804F5E96 Val_Wu16 65535.00 DFES_OneToOne 0.00 65535.00 FORMAT "%8.2" /end CHARACTERISTIC
/begin CHARACTERISTIC DFC_DisblMsk.DFC_LLRHmax_C "disable mask / Disable masks of check DFC_LLRHmax" VALUE 0x804F5E98 Val_Wu16 65535.00 DFES_OneToOne 0.00 65535.00 FORMAT "%8.2" /end CHARACTERISTIC
/begin CHARACTERISTIC DFC_DisblMsk.DFC_LLRHmin_C "disable mask / Disable masks of check DFC_LLRHmin" VALUE 0x804F5E9A Val_Wu16 65535.00 DFES_OneToOne 0.00 65535.00 FORMAT "%8.2" /end CHARACTERISTIC
/begin CHARACTERISTIC DFC_DisblMsk.DFC_LLRHnpl_C "disable mask / Disable masks of check DFC_LLRHnpl" VALUE 0x804F5E9C Val_Wu16 65535.00 DFES_OneToOne 0.00 65535.00 FORMAT "%8.2" /end CHARACTERISTIC
/begin CHARACTERISTIC DFC_DisblMsk.DFC_LLRKHmax_C "disable mask / Disable masks of check DFC_LLRKHmax" VALUE 0x804F5E9E Val_Wu16 65535.00 DFES_OneToOne 0.00 65535.00 FORMAT "%8.2" /end CHARACTERISTIC
/begin CHARACTERISTIC DFC_DisblMsk.DFC_LLRKHmin_C "disable mask / Disable masks of check DFC_LLRKHmin" VALUE 0x804F5EA0 Val_Wu16 65535.00 DFES_OneToOne 0.00 65535.00 FORMAT "%8.2" /end CHARACTERISTIC
/begin CHARACTERISTIC DFC_DisblMsk.DFC_LLRKHnpl_C "disable mask / Disable masks of check DFC_LLRKHnpl" VALUE 0x804F5EA2 Val_Wu16 65535.00 DFES_OneToOne 0.00 65535.00 FORMAT "%8.2" /end CHARACTERISTIC
/begin CHARACTERISTIC DFC_DisblMsk.DFC_LinACGUnit_C "disable mask / Disable masks of check DFC_LinACGUnit" VALUE 0x804F5EA4 Val_Wu16 65535.00 DFES_OneToOne 0.00 65535.00 FORMAT "%8.2" /end CHARACTERISTIC
/begin CHARACTERISTIC DFC_DisblMsk.DFC_LinAEVUnit_C "disable mask / Disable masks of check DFC_LinAEVUnit" VALUE 0x804F5EA6 Val_Wu16 65535.00 DFES_OneToOne 0.00 65535.00 FORMAT "%8.2" /end CHARACTERISTIC
/begin CHARACTERISTIC DFC_DisblMsk.DFC_LinEBSUnit_C "disable mask / Disable masks of check DFC_LinEBSUnit" VALUE 0x804F5EA8 Val_Wu16 65535.00 DFES_OneToOne 0.00 65535.00 FORMAT "%8.2" /end CHARACTERISTIC
/begin CHARACTERISTIC DFC_DisblMsk.DFC_RoughRoad_C "disable mask / Disable masks of check DFC_RoughRoad" VALUE 0x804F5EAA Val_Wu16 65535.00 DFES_OneToOne 0.00 65535.00 FORMAT "%8.2" /end CHARACTERISTIC
/begin CHARACTERISTIC DFC_DisblMsk.DFC_SiaEEPRdErr_C "disable mask / Disable masks of check DFC_SiaEEPRdErr" VALUE 0x804F5EAC Val_Wu16 65535.00 DFES_OneToOne 0.00 65535.00 FORMAT "%8.2" /end CHARACTERISTIC
/begin CHARACTERISTIC DFC_DisblMsk.DFC_SiaEEPWrngCod_C "disable mask / Disable masks of check DFC_SiaEEPWrngCod" VALUE 0x804F5EAE Val_Wu16 65535.00 DFES_OneToOne 0.00 65535.00 FORMAT "%8.2" /end CHARACTERISTIC
/begin CHARACTERISTIC DFC_DisblMsk.DFC_UegoHeatrStrtS1B1_C "disable mask / Disable masks of check DFC_UegoHeatrStrtS1B1" VALUE 0x804F5EB0 Val_Wu16 65535.00 DFES_OneToOne 0.00 65535.00 FORMAT "%8.2" /end CHARACTERISTIC
/begin CHARACTERISTIC DFC_DisblMsk.DFC_BusDiagCANAPPLBusOff_C "disable mask / Disable masks of check DFC_BusDiagCANAPPLBusOff" VALUE 0x804F5EB2 Val_Wu16 65535.00 DFES_OneToOne 0.00 65535.00 FORMAT "%8.2" /end CHARACTERISTIC
/begin CHARACTERISTIC DFC_DisblMsk.DFC_BusDiagCANCANCBusOff_C "disable mask / Disable masks of check DFC_BusDiagCANCANCBusOff" VALUE 0x804F5EB4 Val_Wu16 65535.00 DFES_OneToOne 0.00 65535.00 FORMAT "%8.2" /end CHARACTERISTIC
/begin CHARACTERISTIC DFC_DisblMsk.DFC_BusDiagCANVEHICLEBusOff_C "disable mask / Disable masks of check DFC_BusDiagCANVEHICLEBusOff" VALUE 0x804F5EB6 Val_Wu16 65535.00 DFES_OneToOne 0.00 65535.00 FORMAT "%8.2" /end CHARACTERISTIC
/begin CHARACTERISTIC DFC_DisblMsk.DFC_RBA_IODIAGPWR_rba_IoExtCy329_SignalVltSply_0_C "disable mask / Disable masks of check DFC_RBA_IODIAGPWR_rba_IoExtCy329_SignalVltSply_0" VALUE 0x804F5EB8 Val_Wu16 65535.00 DFES_OneToOne 0.00 65535.00 FORMAT "%8.2" /end CHARACTERISTIC
/begin CHARACTERISTIC DFC_DisblMsk.DFC_RBA_IODIAGPWR_rba_IoExtCy329_SignalVltSply_0OT_C "disable mask / Disable masks of check DFC_RBA_IODIAGPWR_rba_IoExtCy329_SignalVltSply_0OT" VALUE 0x804F5EBA Val_Wu16 65535.00 DFES_OneToOne 0.00 65535.00 FORMAT "%8.2" /end CHARACTERISTIC
/begin CHARACTERISTIC DFC_DisblMsk.DFC_RBA_IODIAGPWR_rba_IoExtCy329_SignalVltSply_0OV_C "disable mask / Disable masks of check DFC_RBA_IODIAGPWR_rba_IoExtCy329_SignalVltSply_0OV" VALUE 0x804F5EBC Val_Wu16 65535.00 DFES_OneToOne 0.00 65535.00 FORMAT "%8.2" /end CHARACTERISTIC
/begin CHARACTERISTIC DFC_DisblMsk.DFC_RBA_IODIAGPWR_rba_IoExtCy329_SignalVltSply_0SCG_C "disable mask / Disable masks of check DFC_RBA_IODIAGPWR_rba_IoExtCy329_SignalVltSply_0SCG" VALUE 0x804F5EBE Val_Wu16 65535.00 DFES_OneToOne 0.00 65535.00 FORMAT "%8.2" /end CHARACTERISTIC
/begin CHARACTERISTIC DFC_DisblMsk.DFC_RBA_IODIAGPWR_rba_IoExtCy329_SignalVltSply_0UV_C "disable mask / Disable masks of check DFC_RBA_IODIAGPWR_rba_IoExtCy329_SignalVltSply_0UV" VALUE 0x804F5EC0 Val_Wu16 65535.00 DFES_OneToOne 0.00 65535.00 FORMAT "%8.2" /end CHARACTERISTIC
/begin CHARACTERISTIC DFC_DisblMsk.DFC_RBA_IODIAGPWR_rba_IoExtCy329_SignalVltSply_1_C "disable mask / Disable masks of check DFC_RBA_IODIAGPWR_rba_IoExtCy329_SignalVltSply_1" VALUE 0x804F5EC2 Val_Wu16 65535.00 DFES_OneToOne 0.00 65535.00 FORMAT "%8.2" /end CHARACTERISTIC
/begin CHARACTERISTIC DFC_DisblMsk.DFC_RBA_IODIAGPWR_rba_IoExtCy329_SignalVltSply_1OT_C "disable mask / Disable masks of check DFC_RBA_IODIAGPWR_rba_IoExtCy329_SignalVltSply_1OT" VALUE 0x804F5EC4 Val_Wu16 65535.00 DFES_OneToOne 0.00 65535.00 FORMAT "%8.2" /end CHARACTERISTIC
/begin CHARACTERISTIC DFC_DisblMsk.DFC_RBA_IODIAGPWR_rba_IoExtCy329_SignalVltSply_1OV_C "disable mask / Disable masks of check DFC_RBA_IODIAGPWR_rba_IoExtCy329_SignalVltSply_1OV" VALUE 0x804F5EC6 Val_Wu16 65535.00 DFES_OneToOne 0.00 65535.00 FORMAT "%8.2" /end CHARACTERISTIC
/begin CHARACTERISTIC DFC_DisblMsk.DFC_RBA_IODIAGPWR_rba_IoExtCy329_SignalVltSply_1SCG_C "disable mask / Disable masks of check DFC_RBA_IODIAGPWR_rba_IoExtCy329_SignalVltSply_1SCG" VALUE 0x804F5EC8 Val_Wu16 65535.00 DFES_OneToOne 0.00 65535.00 FORMAT "%8.2" /end CHARACTERISTIC
/begin CHARACTERISTIC DFC_DisblMsk.DFC_RBA_IODIAGPWR_rba_IoExtCy329_SignalVltSply_1UV_C "disable mask / Disable masks of check DFC_RBA_IODIAGPWR_rba_IoExtCy329_SignalVltSply_1UV" VALUE 0x804F5ECA Val_Wu16 65535.00 DFES_OneToOne 0.00 65535.00 FORMAT "%8.2" /end CHARACTERISTIC
/begin CHARACTERISTIC DFC_DisblMsk.DFC_RBA_IODIAGPWR_rba_IoExtCy329_SignalVltSply_2_C "disable mask / Disable masks of check DFC_RBA_IODIAGPWR_rba_IoExtCy329_SignalVltSply_2" VALUE 0x804F5ECC Val_Wu16 65535.00 DFES_OneToOne 0.00 65535.00 FORMAT "%8.2" /end CHARACTERISTIC
/begin CHARACTERISTIC DFC_DisblMsk.DFC_RBA_IODIAGPWR_rba_IoExtCy329_SignalVltSply_2OT_C "disable mask / Disable masks of check DFC_RBA_IODIAGPWR_rba_IoExtCy329_SignalVltSply_2OT" VALUE 0x804F5ECE Val_Wu16 65535.00 DFES_OneToOne 0.00 65535.00 FORMAT "%8.2" /end CHARACTERISTIC
/begin CHARACTERISTIC DFC_DisblMsk.DFC_RBA_IODIAGPWR_rba_IoExtCy329_SignalVltSply_2OV_C "disable mask / Disable masks of check DFC_RBA_IODIAGPWR_rba_IoExtCy329_SignalVltSply_2OV" VALUE 0x804F5ED0 Val_Wu16 65535.00 DFES_OneToOne 0.00 65535.00 FORMAT "%8.2" /end CHARACTERISTIC
/begin CHARACTERISTIC DFC_DisblMsk.DFC_RBA_IODIAGPWR_rba_IoExtCy329_SignalVltSply_2SCG_C "disable mask / Disable masks of check DFC_RBA_IODIAGPWR_rba_IoExtCy329_SignalVltSply_2SCG" VALUE 0x804F5ED2 Val_Wu16 65535.00 DFES_OneToOne 0.00 65535.00 FORMAT "%8.2" /end CHARACTERISTIC
/begin CHARACTERISTIC DFC_DisblMsk.DFC_RBA_IODIAGPWR_rba_IoExtCy329_SignalVltSply_2UV_C "disable mask / Disable masks of check DFC_RBA_IODIAGPWR_rba_IoExtCy329_SignalVltSply_2UV" VALUE 0x804F5ED4 Val_Wu16 65535.00 DFES_OneToOne 0.00 65535.00 FORMAT "%8.2" /end CHARACTERISTIC
/begin CHARACTERISTIC DFC_DisblMsk.DFC_CAN_E_TIMEOUT_C "disable mask / Disable masks of check DFC_CAN_E_TIMEOUT" VALUE 0x804F5ED6 Val_Wu16 65535.00 DFES_OneToOne 0.00 65535.00 FORMAT "%8.2" /end CHARACTERISTIC
/begin CHARACTERISTIC DFC_DisblMsk.DFC_LIN_E_TIMEOUT_C "disable mask / Disable masks of check DFC_LIN_E_TIMEOUT" VALUE 0x804F5ED8 Val_Wu16 65535.00 DFES_OneToOne 0.00 65535.00 FORMAT "%8.2" /end CHARACTERISTIC
/begin CHARACTERISTIC DFC_DisblMsk.DFC_MRlyOL_C "disable mask / Disable masks of check DFC_MRlyOL" VALUE 0x804F5EDA Val_Wu16 65535.00 DFES_OneToOne 0.00 65535.00 FORMAT "%8.2" /end CHARACTERISTIC
/begin CHARACTERISTIC DFC_DisblMsk.DFC_MRlySCB_C "disable mask / Disable masks of check DFC_MRlySCB" VALUE 0x804F5EDC Val_Wu16 65535.00 DFES_OneToOne 0.00 65535.00 FORMAT "%8.2" /end CHARACTERISTIC
/begin CHARACTERISTIC DFC_DisblMsk.DFC_MRlySCG_C "disable mask / Disable masks of check DFC_MRlySCG" VALUE 0x804F5EDE Val_Wu16 65535.00 DFES_OneToOne 0.00 65535.00 FORMAT "%8.2" /end CHARACTERISTIC
/begin CHARACTERISTIC DFC_DisblMsk.DFC_rba_MultiStackTrace_Threshold_C "disable mask / Disable masks of check DFC_rba_MultiStackTrace_Threshold" VALUE 0x804F5EE0 Val_Wu16 65535.00 DFES_OneToOne 0.00 65535.00 FORMAT "%8.2" /end CHARACTERISTIC
/begin CHARACTERISTIC DFC_DisblMsk.DFC_BSWM_E_ACTION_FAILED_C "disable mask / Disable masks of check DFC_BSWM_E_ACTION_FAILED" VALUE 0x804F5EE2 Val_Wu16 65535.00 DFES_OneToOne 0.00 65535.00 FORMAT "%8.2" /end CHARACTERISTIC
/begin CHARACTERISTIC DFC_DisblMsk.DFC_BSWM_E_INTRPTQUEUE_FULL_C "disable mask / Disable masks of check DFC_BSWM_E_INTRPTQUEUE_FULL" VALUE 0x804F5EE4 Val_Wu16 65535.00 DFES_OneToOne 0.00 65535.00 FORMAT "%8.2" /end CHARACTERISTIC
/begin CHARACTERISTIC DFC_DisblMsk.DFC_RBA_IOEXTLIB_KEEPALIVE_DRV_C "disable mask / Disable masks of check DFC_RBA_IOEXTLIB_KEEPALIVE_DRV" VALUE 0x804F5EE6 Val_Wu16 65535.00 DFES_OneToOne 0.00 65535.00 FORMAT "%8.2" /end CHARACTERISTIC
/begin CHARACTERISTIC DFC_DisblMsk.DFC_RBA_IOEXTLIB_KEEPALIVE_INI_C "disable mask / Disable masks of check DFC_RBA_IOEXTLIB_KEEPALIVE_INI" VALUE 0x804F5EE8 Val_Wu16 65535.00 DFES_OneToOne 0.00 65535.00 FORMAT "%8.2" /end CHARACTERISTIC
/begin CHARACTERISTIC DFC_DisblMsk.DFC_rba_IoSigRtc_StopCounter_C "disable mask / Disable masks of check DFC_rba_IoSigRtc_StopCounter" VALUE 0x804F5EEA Val_Wu16 65535.00 DFES_OneToOne 0.00 65535.00 FORMAT "%8.2" /end CHARACTERISTIC
/begin CHARACTERISTIC DFC_DisblMsk.DFC_rba_MRly_Diag_Stk_Event_C "disable mask / Disable masks of check DFC_rba_MRly_Diag_Stk_Event" VALUE 0x804F5EEC Val_Wu16 65535.00 DFES_OneToOne 0.00 65535.00 FORMAT "%8.2" /end CHARACTERISTIC
/begin CHARACTERISTIC DFC_DisblMsk.DFC_rba_MemDiag_MemReadErr_C "disable mask / Disable masks of check DFC_rba_MemDiag_MemReadErr" VALUE 0x804F5EEE Val_Wu16 65535.00 DFES_OneToOne 0.00 65535.00 FORMAT "%8.2" /end CHARACTERISTIC
/begin CHARACTERISTIC DFC_DisblMsk.DFC_rba_MemDiag_MemWrErr_C "disable mask / Disable masks of check DFC_rba_MemDiag_MemWrErr" VALUE 0x804F5EF0 Val_Wu16 65535.00 DFES_OneToOne 0.00 65535.00 FORMAT "%8.2" /end CHARACTERISTIC
/begin CHARACTERISTIC DFC_DisblMsk.DFC_rba_SyC_IrrSwOffTrigEngRun_Event_C "disable mask / Disable masks of check DFC_rba_SyC_IrrSwOffTrigEngRun_Event" VALUE 0x804F5EF2 Val_Wu16 65535.00 DFES_OneToOne 0.00 65535.00 FORMAT "%8.2" /end CHARACTERISTIC
/begin CHARACTERISTIC DFC_DisblMsk.DFC_rba_T15_Diag_ComInVld_Event_C "disable mask / Disable masks of check DFC_rba_T15_Diag_ComInVld_Event" VALUE 0x804F5EF4 Val_Wu16 65535.00 DFES_OneToOne 0.00 65535.00 FORMAT "%8.2" /end CHARACTERISTIC
/begin CHARACTERISTIC DFC_DisblMsk.DFC_rba_T15_Diag_ComOff_HwOn_Event_C "disable mask / Disable masks of check DFC_rba_T15_Diag_ComOff_HwOn_Event" VALUE 0x804F5EF6 Val_Wu16 65535.00 DFES_OneToOne 0.00 65535.00 FORMAT "%8.2" /end CHARACTERISTIC
/begin CHARACTERISTIC DFC_DisblMsk.DFC_rba_T15_Diag_ComOn_HwOff_Event_C "disable mask / Disable masks of check DFC_rba_T15_Diag_ComOn_HwOff_Event" VALUE 0x804F5EF8 Val_Wu16 65535.00 DFES_OneToOne 0.00 65535.00 FORMAT "%8.2" /end CHARACTERISTIC
/begin CHARACTERISTIC DFC_DisblMsk.DFC_AAVmin_C "disable mask / Disable masks of check DFC_AAVmin" VALUE 0x804F5EFA Val_Wu16 65535.00 DFES_OneToOne 0.00 65535.00 FORMAT "%8.2" /end CHARACTERISTIC
/begin CHARACTERISTIC DFC_DisblMsk.DFC_AGRSUS_C "disable mask / Disable masks of check DFC_AGRSUS" VALUE 0x804F5EFC Val_Wu16 65535.00 DFES_OneToOne 0.00 65535.00 FORMAT "%8.2" /end CHARACTERISTIC
/begin CHARACTERISTIC DFC_DisblMsk.DFC_AfsPlausDiagHi_C "disable mask / Disable masks of check DFC_AfsPlausDiagHi" VALUE 0x804F5EFE Val_Wu16 65535.00 DFES_OneToOne 0.00 65535.00 FORMAT "%8.2" /end CHARACTERISTIC
/begin CHARACTERISTIC DFC_DisblMsk.DFC_AfsPlausDiagLo_C "disable mask / Disable masks of check DFC_AfsPlausDiagLo" VALUE 0x804F5F00 Val_Wu16 65535.00 DFES_OneToOne 0.00 65535.00 FORMAT "%8.2" /end CHARACTERISTIC
/begin CHARACTERISTIC DFC_DisblMsk.DFC_AfsVrntDiagErrB1_C "disable mask / Disable masks of check DFC_AfsVrntDiagErrB1" VALUE 0x804F5F02 Val_Wu16 65535.00 DFES_OneToOne 0.00 65535.00 FORMAT "%8.2" /end CHARACTERISTIC
/begin CHARACTERISTIC DFC_DisblMsk.DFC_AppAllSnsrDfct_C "disable mask / Disable masks of check DFC_AppAllSnsrDfct" VALUE 0x804F5F04 Val_Wu16 65535.00 DFES_OneToOne 0.00 65535.00 FORMAT "%8.2" /end CHARACTERISTIC
/begin CHARACTERISTIC DFC_DisblMsk.DFC_BBKRnldg_C "disable mask / Disable masks of check DFC_BBKRnldg" VALUE 0x804F5F06 Val_Wu16 65535.00 DFES_OneToOne 0.00 65535.00 FORMAT "%8.2" /end CHARACTERISTIC
/begin CHARACTERISTIC DFC_DisblMsk.DFC_BBKRsyne_C "disable mask / Disable masks of check DFC_BBKRsyne" VALUE 0x804F5F08 Val_Wu16 65535.00 DFES_OneToOne 0.00 65535.00 FORMAT "%8.2" /end CHARACTERISTIC
/begin CHARACTERISTIC DFC_DisblMsk.DFC_BattUStdbyDiaOL_C "disable mask / Disable masks of check DFC_BattUStdbyDiaOL" VALUE 0x804F5F0A Val_Wu16 65535.00 DFES_OneToOne 0.00 65535.00 FORMAT "%8.2" /end CHARACTERISTIC
/begin CHARACTERISTIC DFC_DisblMsk.DFC_BigLeakIntkMnfldEmiInfl_C "disable mask / Disable masks of check DFC_BigLeakIntkMnfldEmiInfl" VALUE 0x804F5F0C Val_Wu16 65535.00 DFES_OneToOne 0.00 65535.00 FORMAT "%8.2" /end CHARACTERISTIC
/begin CHARACTERISTIC DFC_DisblMsk.DFC_BlkdLineTank_C "disable mask / Disable masks of check DFC_BlkdLineTank" VALUE 0x804F5F0E Val_Wu16 65535.00 DFES_OneToOne 0.00 65535.00 FORMAT "%8.2" /end CHARACTERISTIC
/begin CHARACTERISTIC DFC_DisblMsk.DFC_BrkMnSwtContOnWarnLmp_C "disable mask / Disable masks of check DFC_BrkMnSwtContOnWarnLmp" VALUE 0x804F5F10 Val_Wu16 65535.00 DFES_OneToOne 0.00 65535.00 FORMAT "%8.2" /end CHARACTERISTIC
/begin CHARACTERISTIC DFC_DisblMsk.DFC_BrkMnSwtNotStpWarnLmp_C "disable mask / Disable masks of check DFC_BrkMnSwtNotStpWarnLmp" VALUE 0x804F5F12 Val_Wu16 65535.00 DFES_OneToOne 0.00 65535.00 FORMAT "%8.2" /end CHARACTERISTIC
/begin CHARACTERISTIC DFC_DisblMsk.DFC_BrkRdntSwtContOnWarnLmp_C "disable mask / Disable masks of check DFC_BrkRdntSwtContOnWarnLmp" VALUE 0x804F5F14 Val_Wu16 65535.00 DFES_OneToOne 0.00 65535.00 FORMAT "%8.2" /end CHARACTERISTIC
/begin CHARACTERISTIC DFC_DisblMsk.DFC_BrkRdntSwtNotStpWarnLmp_C "disable mask / Disable masks of check DFC_BrkRdntSwtNotStpWarnLmp" VALUE 0x804F5F16 Val_Wu16 65535.00 DFES_OneToOne 0.00 65535.00 FORMAT "%8.2" /end CHARACTERISTIC
/begin CHARACTERISTIC DFC_DisblMsk.DFC_CEngDsTColdStrtMax_C "disable mask / Disable masks of check DFC_CEngDsTColdStrtMax" VALUE 0x804F5F18 Val_Wu16 65535.00 DFES_OneToOne 0.00 65535.00 FORMAT "%8.2" /end CHARACTERISTIC
/begin CHARACTERISTIC DFC_DisblMsk.DFC_CEngDsTColdStrtMin_C "disable mask / Disable masks of check DFC_CEngDsTColdStrtMin" VALUE 0x804F5F1A Val_Wu16 65535.00 DFES_OneToOne 0.00 65535.00 FORMAT "%8.2" /end CHARACTERISTIC
/begin CHARACTERISTIC DFC_DisblMsk.DFC_CEngDsTImps_C "disable mask / Disable masks of check DFC_CEngDsTImps" VALUE 0x804F5F1C Val_Wu16 65535.00 DFES_OneToOne 0.00 65535.00 FORMAT "%8.2" /end CHARACTERISTIC
/begin CHARACTERISTIC DFC_DisblMsk.DFC_CEngDsTPlausHSC_C "disable mask / Disable masks of check DFC_CEngDsTPlausHSC" VALUE 0x804F5F1E Val_Wu16 65535.00 DFES_OneToOne 0.00 65535.00 FORMAT "%8.2" /end CHARACTERISTIC
/begin CHARACTERISTIC DFC_DisblMsk.DFC_CEngDsTPlausLSC_C "disable mask / Disable masks of check DFC_CEngDsTPlausLSC" VALUE 0x804F5F20 Val_Wu16 65535.00 DFES_OneToOne 0.00 65535.00 FORMAT "%8.2" /end CHARACTERISTIC
/begin CHARACTERISTIC DFC_DisblMsk.DFC_CEngDsTPlausSTC_C "disable mask / Disable masks of check DFC_CEngDsTPlausSTC" VALUE 0x804F5F22 Val_Wu16 65535.00 DFES_OneToOne 0.00 65535.00 FORMAT "%8.2" /end CHARACTERISTIC
/begin CHARACTERISTIC DFC_DisblMsk.DFC_CEngDsTSRCMax_C "disable mask / Disable masks of check DFC_CEngDsTSRCMax" VALUE 0x804F5F24 Val_Wu16 65535.00 DFES_OneToOne 0.00 65535.00 FORMAT "%8.2" /end CHARACTERISTIC
/begin CHARACTERISTIC DFC_DisblMsk.DFC_CEngDsTSRCMin_C "disable mask / Disable masks of check DFC_CEngDsTSRCMin" VALUE 0x804F5F26 Val_Wu16 65535.00 DFES_OneToOne 0.00 65535.00 FORMAT "%8.2" /end CHARACTERISTIC
/begin CHARACTERISTIC DFC_DisblMsk.DFC_CEngDsTSig_C "disable mask / Disable masks of check DFC_CEngDsTSig" VALUE 0x804F5F28 Val_Wu16 65535.00 DFES_OneToOne 0.00 65535.00 FORMAT "%8.2" /end CHARACTERISTIC
/begin CHARACTERISTIC DFC_DisblMsk.DFC_CEngUsTColdStrtMax_C "disable mask / Disable masks of check DFC_CEngUsTColdStrtMax" VALUE 0x804F5F2A Val_Wu16 65535.00 DFES_OneToOne 0.00 65535.00 FORMAT "%8.2" /end CHARACTERISTIC
/begin CHARACTERISTIC DFC_DisblMsk.DFC_CEngUsTColdStrtMin_C "disable mask / Disable masks of check DFC_CEngUsTColdStrtMin" VALUE 0x804F5F2C Val_Wu16 65535.00 DFES_OneToOne 0.00 65535.00 FORMAT "%8.2" /end CHARACTERISTIC
/begin CHARACTERISTIC DFC_DisblMsk.DFC_CEngUsTLooseCnctn_C "disable mask / Disable masks of check DFC_CEngUsTLooseCnctn" VALUE 0x804F5F2E Val_Wu16 65535.00 DFES_OneToOne 0.00 65535.00 FORMAT "%8.2" /end CHARACTERISTIC
/begin CHARACTERISTIC DFC_DisblMsk.DFC_CEngUsTSRCMax_C "disable mask / Disable masks of check DFC_CEngUsTSRCMax" VALUE 0x804F5F30 Val_Wu16 65535.00 DFES_OneToOne 0.00 65535.00 FORMAT "%8.2" /end CHARACTERISTIC
/begin CHARACTERISTIC DFC_DisblMsk.DFC_CEngUsTSRCMin_C "disable mask / Disable masks of check DFC_CEngUsTSRCMin" VALUE 0x804F5F32 Val_Wu16 65535.00 DFES_OneToOne 0.00 65535.00 FORMAT "%8.2" /end CHARACTERISTIC
/begin CHARACTERISTIC DFC_DisblMsk.DFC_ComDCDCACCFailr_C "disable mask / Disable masks of check DFC_ComDCDCACCFailr" VALUE 0x804F5F34 Val_Wu16 65535.00 DFES_OneToOne 0.00 65535.00 FORMAT "%8.2" /end CHARACTERISTIC
/begin CHARACTERISTIC DFC_DisblMsk.DFC_DCDCFltDet_C "disable mask / Disable masks of check DFC_DCDCFltDet" VALUE 0x804F5F36 Val_Wu16 65535.00 DFES_OneToOne 0.00 65535.00 FORMAT "%8.2" /end CHARACTERISTIC
/begin CHARACTERISTIC DFC_DisblMsk.DFC_DKRSA_C "disable mask / Disable masks of check DFC_DKRSA" VALUE 0x804F5F38 Val_Wu16 65535.00 DFES_OneToOne 0.00 65535.00 FORMAT "%8.2" /end CHARACTERISTIC
/begin CHARACTERISTIC DFC_DisblMsk.DFC_DKVSmax_C "disable mask / Disable masks of check DFC_DKVSmax" VALUE 0x804F5F3A Val_Wu16 65535.00 DFES_OneToOne 0.00 65535.00 FORMAT "%8.2" /end CHARACTERISTIC
/begin CHARACTERISTIC DFC_DisblMsk.DFC_DKnpl_C "disable mask / Disable masks of check DFC_DKnpl" VALUE 0x804F5F3C Val_Wu16 65535.00 DFES_OneToOne 0.00 65535.00 FORMAT "%8.2" /end CHARACTERISTIC
/begin CHARACTERISTIC DFC_DisblMsk.DFC_DSKVRmax_C "disable mask / Disable masks of check DFC_DSKVRmax" VALUE 0x804F5F3E Val_Wu16 65535.00 DFES_OneToOne 0.00 65535.00 FORMAT "%8.2" /end CHARACTERISTIC
/begin CHARACTERISTIC DFC_DisblMsk.DFC_DSKVRmin_C "disable mask / Disable masks of check DFC_DSKVRmin" VALUE 0x804F5F40 Val_Wu16 65535.00 DFES_OneToOne 0.00 65535.00 FORMAT "%8.2" /end CHARACTERISTIC
/begin CHARACTERISTIC DFC_DisblMsk.DFC_DSKVRnpl_C "disable mask / Disable masks of check DFC_DSKVRnpl" VALUE 0x804F5F42 Val_Wu16 65535.00 DFES_OneToOne 0.00 65535.00 FORMAT "%8.2" /end CHARACTERISTIC
/begin CHARACTERISTIC DFC_DisblMsk.DFC_DSKVRsig_C "disable mask / Disable masks of check DFC_DSKVRsig" VALUE 0x804F5F44 Val_Wu16 65535.00 DFES_OneToOne 0.00 65535.00 FORMAT "%8.2" /end CHARACTERISTIC
/begin CHARACTERISTIC DFC_DisblMsk.DFC_DSKVSsig_C "disable mask / Disable masks of check DFC_DSKVSsig" VALUE 0x804F5F46 Val_Wu16 65535.00 DFES_OneToOne 0.00 65535.00 FORMAT "%8.2" /end CHARACTERISTIC
/begin CHARACTERISTIC DFC_DisblMsk.DFC_DSSmax_C "disable mask / Disable masks of check DFC_DSSmax" VALUE 0x804F5F48 Val_Wu16 65535.00 DFES_OneToOne 0.00 65535.00 FORMAT "%8.2" /end CHARACTERISTIC
/begin CHARACTERISTIC DFC_DisblMsk.DFC_DSTDmax_C "disable mask / Disable masks of check DFC_DSTDmax" VALUE 0x804F5F4A Val_Wu16 65535.00 DFES_OneToOne 0.00 65535.00 FORMAT "%8.2" /end CHARACTERISTIC
/begin CHARACTERISTIC DFC_DisblMsk.DFC_DSTEmax_C "disable mask / Disable masks of check DFC_DSTEmax" VALUE 0x804F5F4C Val_Wu16 65535.00 DFES_OneToOne 0.00 65535.00 FORMAT "%8.2" /end CHARACTERISTIC
/begin CHARACTERISTIC DFC_DisblMsk.DFC_DSTEmin_C "disable mask / Disable masks of check DFC_DSTEmin" VALUE 0x804F5F4E Val_Wu16 65535.00 DFES_OneToOne 0.00 65535.00 FORMAT "%8.2" /end CHARACTERISTIC
/begin CHARACTERISTIC DFC_DisblMsk.DFC_DSTOFmax_C "disable mask / Disable masks of check DFC_DSTOFmax" VALUE 0x804F5F50 Val_Wu16 65535.00 DFES_OneToOne 0.00 65535.00 FORMAT "%8.2" /end CHARACTERISTIC
/begin CHARACTERISTIC DFC_DisblMsk.DFC_DSTRmax_C "disable mask / Disable masks of check DFC_DSTRmax" VALUE 0x804F5F52 Val_Wu16 65535.00 DFES_OneToOne 0.00 65535.00 FORMAT "%8.2" /end CHARACTERISTIC
/begin CHARACTERISTIC DFC_DisblMsk.DFC_DSTRmin_C "disable mask / Disable masks of check DFC_DSTRmin" VALUE 0x804F5F54 Val_Wu16 65535.00 DFES_OneToOne 0.00 65535.00 FORMAT "%8.2" /end CHARACTERISTIC
/begin CHARACTERISTIC DFC_DisblMsk.DFC_DSTRnpl_C "disable mask / Disable masks of check DFC_DSTRnpl" VALUE 0x804F5F56 Val_Wu16 65535.00 DFES_OneToOne 0.00 65535.00 FORMAT "%8.2" /end CHARACTERISTIC
/begin CHARACTERISTIC DFC_DisblMsk.DFC_DSTRsig_C "disable mask / Disable masks of check DFC_DSTRsig" VALUE 0x804F5F58 Val_Wu16 65535.00 DFES_OneToOne 0.00 65535.00 FORMAT "%8.2" /end CHARACTERISTIC
/begin CHARACTERISTIC DFC_DisblMsk.DFC_DSTTI_C "disable mask / Disable masks of check DFC_DSTTI" VALUE 0x804F5F5A Val_Wu16 65535.00 DFES_OneToOne 0.00 65535.00 FORMAT "%8.2" /end CHARACTERISTIC
/begin CHARACTERISTIC DFC_DisblMsk.DFC_DSUmax_C "disable mask / Disable masks of check DFC_DSUmax" VALUE 0x804F5F5C Val_Wu16 65535.00 DFES_OneToOne 0.00 65535.00 FORMAT "%8.2" /end CHARACTERISTIC
/begin CHARACTERISTIC DFC_DisblMsk.DFC_DiagCpv1DteskLoLoadStuckClsd_C "disable mask / Disable masks of check DFC_DiagCpv1DteskLoLoadStuckClsd" VALUE 0x804F5F5E Val_Wu16 65535.00 DFES_OneToOne 0.00 65535.00 FORMAT "%8.2" /end CHARACTERISTIC
/begin CHARACTERISTIC DFC_DisblMsk.DFC_DiagCpv1DteskLoLoadStuckOpen_C "disable mask / Disable masks of check DFC_DiagCpv1DteskLoLoadStuckOpen" VALUE 0x804F5F60 Val_Wu16 65535.00 DFES_OneToOne 0.00 65535.00 FORMAT "%8.2" /end CHARACTERISTIC
/begin CHARACTERISTIC DFC_DisblMsk.DFC_EGRVlvDrftClsd_C "disable mask / Disable masks of check DFC_EGRVlvDrftClsd" VALUE 0x804F5F62 Val_Wu16 65535.00 DFES_OneToOne 0.00 65535.00 FORMAT "%8.2" /end CHARACTERISTIC
/begin CHARACTERISTIC DFC_DisblMsk.DFC_EGRVlvDrftOpn_C "disable mask / Disable masks of check DFC_EGRVlvDrftOpn" VALUE 0x804F5F64 Val_Wu16 65535.00 DFES_OneToOne 0.00 65535.00 FORMAT "%8.2" /end CHARACTERISTIC
/begin CHARACTERISTIC DFC_DisblMsk.DFC_EGRVlvJamVlvClsd_C "disable mask / Disable masks of check DFC_EGRVlvJamVlvClsd" VALUE 0x804F5F66 Val_Wu16 65535.00 DFES_OneToOne 0.00 65535.00 FORMAT "%8.2" /end CHARACTERISTIC
/begin CHARACTERISTIC DFC_DisblMsk.DFC_EGRVlvJamVlvOpn_C "disable mask / Disable masks of check DFC_EGRVlvJamVlvOpn" VALUE 0x804F5F68 Val_Wu16 65535.00 DFES_OneToOne 0.00 65535.00 FORMAT "%8.2" /end CHARACTERISTIC
/begin CHARACTERISTIC DFC_DisblMsk.DFC_EGRVlvSprgBrk_C "disable mask / Disable masks of check DFC_EGRVlvSprgBrk" VALUE 0x804F5F6A Val_Wu16 65535.00 DFES_OneToOne 0.00 65535.00 FORMAT "%8.2" /end CHARACTERISTIC
/begin CHARACTERISTIC DFC_DisblMsk.DFC_EGRVlvTempMdlEEPErr_C "disable mask / Disable masks of check DFC_EGRVlvTempMdlEEPErr" VALUE 0x804F5F6C Val_Wu16 65535.00 DFES_OneToOne 0.00 65535.00 FORMAT "%8.2" /end CHARACTERISTIC
/begin CHARACTERISTIC DFC_DisblMsk.DFC_EGRVlvTmpErr_C "disable mask / Disable masks of check DFC_EGRVlvTmpErr" VALUE 0x804F5F6E Val_Wu16 65535.00 DFES_OneToOne 0.00 65535.00 FORMAT "%8.2" /end CHARACTERISTIC
/begin CHARACTERISTIC DFC_DisblMsk.DFC_EGSDUS2B1LtrDly_C "disable mask / Disable masks of check DFC_EGSDUS2B1LtrDly" VALUE 0x804F5F70 Val_Wu16 65535.00 DFES_OneToOne 0.00 65535.00 FORMAT "%8.2" /end CHARACTERISTIC
/begin CHARACTERISTIC DFC_DisblMsk.DFC_EGSDUS2B1LtrPT1_C "disable mask / Disable masks of check DFC_EGSDUS2B1LtrPT1" VALUE 0x804F5F72 Val_Wu16 65535.00 DFES_OneToOne 0.00 65535.00 FORMAT "%8.2" /end CHARACTERISTIC
/begin CHARACTERISTIC DFC_DisblMsk.DFC_EGSDUS2B1RtlDly_C "disable mask / Disable masks of check DFC_EGSDUS2B1RtlDly" VALUE 0x804F5F74 Val_Wu16 65535.00 DFES_OneToOne 0.00 65535.00 FORMAT "%8.2" /end CHARACTERISTIC
/begin CHARACTERISTIC DFC_DisblMsk.DFC_EGSDUS2B1RtlPT1_C "disable mask / Disable masks of check DFC_EGSDUS2B1RtlPT1" VALUE 0x804F5F76 Val_Wu16 65535.00 DFES_OneToOne 0.00 65535.00 FORMAT "%8.2" /end CHARACTERISTIC
/begin CHARACTERISTIC DFC_DisblMsk.DFC_EGSDUS2B1TarLean_C "disable mask / Disable masks of check DFC_EGSDUS2B1TarLean" VALUE 0x804F5F78 Val_Wu16 65535.00 DFES_OneToOne 0.00 65535.00 FORMAT "%8.2" /end CHARACTERISTIC
/begin CHARACTERISTIC DFC_DisblMsk.DFC_EGSDUS2B1TarRich_C "disable mask / Disable masks of check DFC_EGSDUS2B1TarRich" VALUE 0x804F5F7A Val_Wu16 65535.00 DFES_OneToOne 0.00 65535.00 FORMAT "%8.2" /end CHARACTERISTIC
/begin CHARACTERISTIC DFC_DisblMsk.DFC_EONVmax_C "disable mask / Disable masks of check DFC_EONVmax" VALUE 0x804F5F7C Val_Wu16 65535.00 DFES_OneToOne 0.00 65535.00 FORMAT "%8.2" /end CHARACTERISTIC
/begin CHARACTERISTIC DFC_DisblMsk.DFC_ETAKHLmax_C "disable mask / Disable masks of check DFC_ETAKHLmax" VALUE 0x804F5F7E Val_Wu16 65535.00 DFES_OneToOne 0.00 65535.00 FORMAT "%8.2" /end CHARACTERISTIC
/begin CHARACTERISTIC DFC_DisblMsk.DFC_ETAKHTmax_C "disable mask / Disable masks of check DFC_ETAKHTmax" VALUE 0x804F5F80 Val_Wu16 65535.00 DFES_OneToOne 0.00 65535.00 FORMAT "%8.2" /end CHARACTERISTIC
/begin CHARACTERISTIC DFC_DisblMsk.DFC_ETHSEmax_C "disable mask / Disable masks of check DFC_ETHSEmax" VALUE 0x804F5F82 Val_Wu16 65535.00 DFES_OneToOne 0.00 65535.00 FORMAT "%8.2" /end CHARACTERISTIC
/begin CHARACTERISTIC DFC_DisblMsk.DFC_ETHSEmin_C "disable mask / Disable masks of check DFC_ETHSEmin" VALUE 0x804F5F84 Val_Wu16 65535.00 DFES_OneToOne 0.00 65535.00 FORMAT "%8.2" /end CHARACTERISTIC
/begin CHARACTERISTIC DFC_DisblMsk.DFC_ETHSFmax_C "disable mask / Disable masks of check DFC_ETHSFmax" VALUE 0x804F5F86 Val_Wu16 65535.00 DFES_OneToOne 0.00 65535.00 FORMAT "%8.2" /end CHARACTERISTIC
/begin CHARACTERISTIC DFC_DisblMsk.DFC_ETHSFmin_C "disable mask / Disable masks of check DFC_ETHSFmin" VALUE 0x804F5F88 Val_Wu16 65535.00 DFES_OneToOne 0.00 65535.00 FORMAT "%8.2" /end CHARACTERISTIC
/begin CHARACTERISTIC DFC_DisblMsk.DFC_ETHSFsig_C "disable mask / Disable masks of check DFC_ETHSFsig" VALUE 0x804F5F8A Val_Wu16 65535.00 DFES_OneToOne 0.00 65535.00 FORMAT "%8.2" /end CHARACTERISTIC
/begin CHARACTERISTIC DFC_DisblMsk.DFC_ETHSNPWmax_C "disable mask / Disable masks of check DFC_ETHSNPWmax" VALUE 0x804F5F8C Val_Wu16 65535.00 DFES_OneToOne 0.00 65535.00 FORMAT "%8.2" /end CHARACTERISTIC
/begin CHARACTERISTIC DFC_DisblMsk.DFC_ETHSNPWmin_C "disable mask / Disable masks of check DFC_ETHSNPWmin" VALUE 0x804F5F8E Val_Wu16 65535.00 DFES_OneToOne 0.00 65535.00 FORMAT "%8.2" /end CHARACTERISTIC
/begin CHARACTERISTIC DFC_DisblMsk.DFC_ETHSNPWsig_C "disable mask / Disable masks of check DFC_ETHSNPWsig" VALUE 0x804F5F90 Val_Wu16 65535.00 DFES_OneToOne 0.00 65535.00 FORMAT "%8.2" /end CHARACTERISTIC
/begin CHARACTERISTIC DFC_DisblMsk.DFC_ETHSPLnpl_C "disable mask / Disable masks of check DFC_ETHSPLnpl" VALUE 0x804F5F92 Val_Wu16 65535.00 DFES_OneToOne 0.00 65535.00 FORMAT "%8.2" /end CHARACTERISTIC
/begin CHARACTERISTIC DFC_DisblMsk.DFC_ETHSTPLnpl_C "disable mask / Disable masks of check DFC_ETHSTPLnpl" VALUE 0x804F5F94 Val_Wu16 65535.00 DFES_OneToOne 0.00 65535.00 FORMAT "%8.2" /end CHARACTERISTIC
/begin CHARACTERISTIC DFC_DisblMsk.DFC_EngICO_C "disable mask / Disable masks of check DFC_EngICO" VALUE 0x804F5F96 Val_Wu16 65535.00 DFES_OneToOne 0.00 65535.00 FORMAT "%8.2" /end CHARACTERISTIC
/begin CHARACTERISTIC DFC_DisblMsk.DFC_EngPrtOvrSpdMon_C "disable mask / Disable masks of check DFC_EngPrtOvrSpdMon" VALUE 0x804F5F98 Val_Wu16 65535.00 DFES_OneToOne 0.00 65535.00 FORMAT "%8.2" /end CHARACTERISTIC
/begin CHARACTERISTIC DFC_DisblMsk.DFC_EpmCaSI1ErrSig_C "disable mask / Disable masks of check DFC_EpmCaSI1ErrSig" VALUE 0x804F5F9A Val_Wu16 65535.00 DFES_OneToOne 0.00 65535.00 FORMAT "%8.2" /end CHARACTERISTIC
/begin CHARACTERISTIC DFC_DisblMsk.DFC_EpmCaSI1MntErr_C "disable mask / Disable masks of check DFC_EpmCaSI1MntErr" VALUE 0x804F5F9C Val_Wu16 65535.00 DFES_OneToOne 0.00 65535.00 FORMAT "%8.2" /end CHARACTERISTIC
/begin CHARACTERISTIC DFC_DisblMsk.DFC_EpmCaSI1NoSigMax_C "disable mask / Disable masks of check DFC_EpmCaSI1NoSigMax" VALUE 0x804F5F9E Val_Wu16 65535.00 DFES_OneToOne 0.00 65535.00 FORMAT "%8.2" /end CHARACTERISTIC
/begin CHARACTERISTIC DFC_DisblMsk.DFC_EpmCaSI1NoSigMin_C "disable mask / Disable masks of check DFC_EpmCaSI1NoSigMin" VALUE 0x804F5FA0 Val_Wu16 65535.00 DFES_OneToOne 0.00 65535.00 FORMAT "%8.2" /end CHARACTERISTIC
/begin CHARACTERISTIC DFC_DisblMsk.DFC_EpmCaSI1OfsErr_C "disable mask / Disable masks of check DFC_EpmCaSI1OfsErr" VALUE 0x804F5FA2 Val_Wu16 65535.00 DFES_OneToOne 0.00 65535.00 FORMAT "%8.2" /end CHARACTERISTIC
/begin CHARACTERISTIC DFC_DisblMsk.DFC_EpmCrSDGI_C "disable mask / Disable masks of check DFC_EpmCrSDGI" VALUE 0x804F5FA4 Val_Wu16 65535.00 DFES_OneToOne 0.00 65535.00 FORMAT "%8.2" /end CHARACTERISTIC
/begin CHARACTERISTIC DFC_DisblMsk.DFC_EpmCrSErrSig_C "disable mask / Disable masks of check DFC_EpmCrSErrSig" VALUE 0x804F5FA6 Val_Wu16 65535.00 DFES_OneToOne 0.00 65535.00 FORMAT "%8.2" /end CHARACTERISTIC
/begin CHARACTERISTIC DFC_DisblMsk.DFC_EpmCrSNoSig_C "disable mask / Disable masks of check DFC_EpmCrSNoSig" VALUE 0x804F5FA8 Val_Wu16 65535.00 DFES_OneToOne 0.00 65535.00 FORMAT "%8.2" /end CHARACTERISTIC
/begin CHARACTERISTIC DFC_DisblMsk.DFC_EtaEngIdleNonCsers_C "disable mask / Disable masks of check DFC_EtaEngIdleNonCsers" VALUE 0x804F5FAA Val_Wu16 65535.00 DFES_OneToOne 0.00 65535.00 FORMAT "%8.2" /end CHARACTERISTIC
/begin CHARACTERISTIC DFC_DisblMsk.DFC_EtaEngPtlNonCsers_C "disable mask / Disable masks of check DFC_EtaEngPtlNonCsers" VALUE 0x804F5FAC Val_Wu16 65535.00 DFES_OneToOne 0.00 65535.00 FORMAT "%8.2" /end CHARACTERISTIC
/begin CHARACTERISTIC DFC_DisblMsk.DFC_FRAmax_C "disable mask / Disable masks of check DFC_FRAmax" VALUE 0x804F5FAE Val_Wu16 65535.00 DFES_OneToOne 0.00 65535.00 FORMAT "%8.2" /end CHARACTERISTIC
/begin CHARACTERISTIC DFC_DisblMsk.DFC_FRAmin_C "disable mask / Disable masks of check DFC_FRAmin" VALUE 0x804F5FB0 Val_Wu16 65535.00 DFES_OneToOne 0.00 65535.00 FORMAT "%8.2" /end CHARACTERISTIC
/begin CHARACTERISTIC DFC_DisblMsk.DFC_FSTEmax_C "disable mask / Disable masks of check DFC_FSTEmax" VALUE 0x804F5FB2 Val_Wu16 65535.00 DFES_OneToOne 0.00 65535.00 FORMAT "%8.2" /end CHARACTERISTIC
/begin CHARACTERISTIC DFC_DisblMsk.DFC_FSTEmin_C "disable mask / Disable masks of check DFC_FSTEmin" VALUE 0x804F5FB4 Val_Wu16 65535.00 DFES_OneToOne 0.00 65535.00 FORMAT "%8.2" /end CHARACTERISTIC
/begin CHARACTERISTIC DFC_DisblMsk.DFC_FSTRmax_C "disable mask / Disable masks of check DFC_FSTRmax" VALUE 0x804F5FB6 Val_Wu16 65535.00 DFES_OneToOne 0.00 65535.00 FORMAT "%8.2" /end CHARACTERISTIC
/begin CHARACTERISTIC DFC_DisblMsk.DFC_FSTRmin_C "disable mask / Disable masks of check DFC_FSTRmin" VALUE 0x804F5FB8 Val_Wu16 65535.00 DFES_OneToOne 0.00 65535.00 FORMAT "%8.2" /end CHARACTERISTIC
/begin CHARACTERISTIC DFC_DisblMsk.DFC_FSTRnpl_C "disable mask / Disable masks of check DFC_FSTRnpl" VALUE 0x804F5FBA Val_Wu16 65535.00 DFES_OneToOne 0.00 65535.00 FORMAT "%8.2" /end CHARACTERISTIC
/begin CHARACTERISTIC DFC_DisblMsk.DFC_FSTmax_C "disable mask / Disable masks of check DFC_FSTmax" VALUE 0x804F5FBC Val_Wu16 65535.00 DFES_OneToOne 0.00 65535.00 FORMAT "%8.2" /end CHARACTERISTIC
/begin CHARACTERISTIC DFC_DisblMsk.DFC_FTDLAmax_C "disable mask / Disable masks of check DFC_FTDLAmax" VALUE 0x804F5FBE Val_Wu16 65535.00 DFES_OneToOne 0.00 65535.00 FORMAT "%8.2" /end CHARACTERISTIC
/begin CHARACTERISTIC DFC_DisblMsk.DFC_FTDLAmin_C "disable mask / Disable masks of check DFC_FTDLAmin" VALUE 0x804F5FC0 Val_Wu16 65535.00 DFES_OneToOne 0.00 65535.00 FORMAT "%8.2" /end CHARACTERISTIC
/begin CHARACTERISTIC DFC_DisblMsk.DFC_FuPHiSnsrEleclmax_C "disable mask / Disable masks of check DFC_FuPHiSnsrEleclmax" VALUE 0x804F5FC2 Val_Wu16 65535.00 DFES_OneToOne 0.00 65535.00 FORMAT "%8.2" /end CHARACTERISTIC
/begin CHARACTERISTIC DFC_DisblMsk.DFC_FuPHiSnsrEleclmin_C "disable mask / Disable masks of check DFC_FuPHiSnsrEleclmin" VALUE 0x804F5FC4 Val_Wu16 65535.00 DFES_OneToOne 0.00 65535.00 FORMAT "%8.2" /end CHARACTERISTIC
/begin CHARACTERISTIC DFC_DisblMsk.DFC_FuPHiSnsrEleclnpl_C "disable mask / Disable masks of check DFC_FuPHiSnsrEleclnpl" VALUE 0x804F5FC6 Val_Wu16 65535.00 DFES_OneToOne 0.00 65535.00 FORMAT "%8.2" /end CHARACTERISTIC
/begin CHARACTERISTIC DFC_DisblMsk.DFC_FuPHiSnsrURngMax_C "disable mask / Disable masks of check DFC_FuPHiSnsrURngMax" VALUE 0x804F5FC8 Val_Wu16 65535.00 DFES_OneToOne 0.00 65535.00 FORMAT "%8.2" /end CHARACTERISTIC
/begin CHARACTERISTIC DFC_DisblMsk.DFC_FuPHiSnsrURngMin_C "disable mask / Disable masks of check DFC_FuPHiSnsrURngMin" VALUE 0x804F5FCA Val_Wu16 65535.00 DFES_OneToOne 0.00 65535.00 FORMAT "%8.2" /end CHARACTERISTIC
/begin CHARACTERISTIC DFC_DisblMsk.DFC_FuSnsrPhyRngMaxErr_C "disable mask / Disable masks of check DFC_FuSnsrPhyRngMaxErr" VALUE 0x804F5FCC Val_Wu16 65535.00 DFES_OneToOne 0.00 65535.00 FORMAT "%8.2" /end CHARACTERISTIC
/begin CHARACTERISTIC DFC_DisblMsk.DFC_FuSnsrPhyRngMinErr_C "disable mask / Disable masks of check DFC_FuSnsrPhyRngMinErr" VALUE 0x804F5FCE Val_Wu16 65535.00 DFES_OneToOne 0.00 65535.00 FORMAT "%8.2" /end CHARACTERISTIC
/begin CHARACTERISTIC DFC_DisblMsk.DFC_GEVlvLockPinDiagIntkB1_C "disable mask / Disable masks of check DFC_GEVlvLockPinDiagIntkB1" VALUE 0x804F5FD0 Val_Wu16 65535.00 DFES_OneToOne 0.00 65535.00 FORMAT "%8.2" /end CHARACTERISTIC
/begin CHARACTERISTIC DFC_DisblMsk.DFC_GEVlvPhaSlowIntkB1_C "disable mask / Disable masks of check DFC_GEVlvPhaSlowIntkB1" VALUE 0x804F5FD2 Val_Wu16 65535.00 DFES_OneToOne 0.00 65535.00 FORMAT "%8.2" /end CHARACTERISTIC
/begin CHARACTERISTIC DFC_DisblMsk.DFC_GEVlvPhaTargIntkB1_C "disable mask / Disable masks of check DFC_GEVlvPhaTargIntkB1" VALUE 0x804F5FD4 Val_Wu16 65535.00 DFES_OneToOne 0.00 65535.00 FORMAT "%8.2" /end CHARACTERISTIC
/begin CHARACTERISTIC DFC_DisblMsk.DFC_GbxRvsSwtStk_C "disable mask / Disable masks of check DFC_GbxRvsSwtStk" VALUE 0x804F5FD6 Val_Wu16 65535.00 DFES_OneToOne 0.00 65535.00 FORMAT "%8.2" /end CHARACTERISTIC
/begin CHARACTERISTIC DFC_DisblMsk.DFC_HDRKHmax_C "disable mask / Disable masks of check DFC_HDRKHmax" VALUE 0x804F5FD8 Val_Wu16 65535.00 DFES_OneToOne 0.00 65535.00 FORMAT "%8.2" /end CHARACTERISTIC
/begin CHARACTERISTIC DFC_DisblMsk.DFC_HDRKHmin_C "disable mask / Disable masks of check DFC_HDRKHmin" VALUE 0x804F5FDA Val_Wu16 65535.00 DFES_OneToOne 0.00 65535.00 FORMAT "%8.2" /end CHARACTERISTIC
/begin CHARACTERISTIC DFC_DisblMsk.DFC_HDRPLmax_C "disable mask / Disable masks of check DFC_HDRPLmax" VALUE 0x804F5FDC Val_Wu16 65535.00 DFES_OneToOne 0.00 65535.00 FORMAT "%8.2" /end CHARACTERISTIC
/begin CHARACTERISTIC DFC_DisblMsk.DFC_HDRPLmin_C "disable mask / Disable masks of check DFC_HDRPLmin" VALUE 0x804F5FDE Val_Wu16 65535.00 DFES_OneToOne 0.00 65535.00 FORMAT "%8.2" /end CHARACTERISTIC
/begin CHARACTERISTIC DFC_DisblMsk.DFC_HDRmax_C "disable mask / Disable masks of check DFC_HDRmax" VALUE 0x804F5FE0 Val_Wu16 65535.00 DFES_OneToOne 0.00 65535.00 FORMAT "%8.2" /end CHARACTERISTIC
/begin CHARACTERISTIC DFC_DisblMsk.DFC_HDRmin_C "disable mask / Disable masks of check DFC_HDRmin" VALUE 0x804F5FE2 Val_Wu16 65535.00 DFES_OneToOne 0.00 65535.00 FORMAT "%8.2" /end CHARACTERISTIC
/begin CHARACTERISTIC DFC_DisblMsk.DFC_HEGOS2B1ElecMax_C "disable mask / Disable masks of check DFC_HEGOS2B1ElecMax" VALUE 0x804F5FE4 Val_Wu16 65535.00 DFES_OneToOne 0.00 65535.00 FORMAT "%8.2" /end CHARACTERISTIC
/begin CHARACTERISTIC DFC_DisblMsk.DFC_HEGOS2B1ElecMin_C "disable mask / Disable masks of check DFC_HEGOS2B1ElecMin" VALUE 0x804F5FE6 Val_Wu16 65535.00 DFES_OneToOne 0.00 65535.00 FORMAT "%8.2" /end CHARACTERISTIC
/begin CHARACTERISTIC DFC_DisblMsk.DFC_HEGOS2B1ElecSig_C "disable mask / Disable masks of check DFC_HEGOS2B1ElecSig" VALUE 0x804F5FE8 Val_Wu16 65535.00 DFES_OneToOne 0.00 65535.00 FORMAT "%8.2" /end CHARACTERISTIC
/begin CHARACTERISTIC DFC_DisblMsk.DFC_HEGOS2B1HtgNpl_C "disable mask / Disable masks of check DFC_HEGOS2B1HtgNpl" VALUE 0x804F5FEA Val_Wu16 65535.00 DFES_OneToOne 0.00 65535.00 FORMAT "%8.2" /end CHARACTERISTIC
/begin CHARACTERISTIC DFC_DisblMsk.DFC_HEV00max_C "disable mask / Disable masks of check DFC_HEV00max" VALUE 0x804F5FEC Val_Wu16 65535.00 DFES_OneToOne 0.00 65535.00 FORMAT "%8.2" /end CHARACTERISTIC
/begin CHARACTERISTIC DFC_DisblMsk.DFC_HEV01max_C "disable mask / Disable masks of check DFC_HEV01max" VALUE 0x804F5FEE Val_Wu16 65535.00 DFES_OneToOne 0.00 65535.00 FORMAT "%8.2" /end CHARACTERISTIC
/begin CHARACTERISTIC DFC_DisblMsk.DFC_HEV02max_C "disable mask / Disable masks of check DFC_HEV02max" VALUE 0x804F5FF0 Val_Wu16 65535.00 DFES_OneToOne 0.00 65535.00 FORMAT "%8.2" /end CHARACTERISTIC
/begin CHARACTERISTIC DFC_DisblMsk.DFC_HEV03max_C "disable mask / Disable masks of check DFC_HEV03max" VALUE 0x804F5FF2 Val_Wu16 65535.00 DFES_OneToOne 0.00 65535.00 FORMAT "%8.2" /end CHARACTERISTIC
/begin CHARACTERISTIC DFC_DisblMsk.DFC_HEVE0max_C "disable mask / Disable masks of check DFC_HEVE0max" VALUE 0x804F5FF4 Val_Wu16 65535.00 DFES_OneToOne 0.00 65535.00 FORMAT "%8.2" /end CHARACTERISTIC
/begin CHARACTERISTIC DFC_DisblMsk.DFC_HEVE1max_C "disable mask / Disable masks of check DFC_HEVE1max" VALUE 0x804F5FF6 Val_Wu16 65535.00 DFES_OneToOne 0.00 65535.00 FORMAT "%8.2" /end CHARACTERISTIC
/begin CHARACTERISTIC DFC_DisblMsk.DFC_HFMmax_C "disable mask / Disable masks of check DFC_HFMmax" VALUE 0x804F5FF8 Val_Wu16 65535.00 DFES_OneToOne 0.00 65535.00 FORMAT "%8.2" /end CHARACTERISTIC
/begin CHARACTERISTIC DFC_DisblMsk.DFC_HiPSysHiPMaxLimExcdd_C "disable mask / Disable masks of check DFC_HiPSysHiPMaxLimExcdd" VALUE 0x804F5FFA Val_Wu16 65535.00 DFES_OneToOne 0.00 65535.00 FORMAT "%8.2" /end CHARACTERISTIC
/begin CHARACTERISTIC DFC_DisblMsk.DFC_IVGdiCtlCvoErrMax_0_C "disable mask / Disable masks of check DFC_IVGdiCtlCvoErrMax_0" VALUE 0x804F5FFC Val_Wu16 65535.00 DFES_OneToOne 0.00 65535.00 FORMAT "%8.2" /end CHARACTERISTIC
/begin CHARACTERISTIC DFC_DisblMsk.DFC_IVGdiCtlCvoErrMax_1_C "disable mask / Disable masks of check DFC_IVGdiCtlCvoErrMax_1" VALUE 0x804F5FFE Val_Wu16 65535.00 DFES_OneToOne 0.00 65535.00 FORMAT "%8.2" /end CHARACTERISTIC
/begin CHARACTERISTIC DFC_DisblMsk.DFC_IVGdiCtlCvoErrMax_2_C "disable mask / Disable masks of check DFC_IVGdiCtlCvoErrMax_2" VALUE 0x804F6000 Val_Wu16 65535.00 DFES_OneToOne 0.00 65535.00 FORMAT "%8.2" /end CHARACTERISTIC
/begin CHARACTERISTIC DFC_DisblMsk.DFC_IVGdiCtlCvoErrMax_3_C "disable mask / Disable masks of check DFC_IVGdiCtlCvoErrMax_3" VALUE 0x804F6002 Val_Wu16 65535.00 DFES_OneToOne 0.00 65535.00 FORMAT "%8.2" /end CHARACTERISTIC
/begin CHARACTERISTIC DFC_DisblMsk.DFC_IVGdiCtlCvoErrMin_0_C "disable mask / Disable masks of check DFC_IVGdiCtlCvoErrMin_0" VALUE 0x804F6004 Val_Wu16 65535.00 DFES_OneToOne 0.00 65535.00 FORMAT "%8.2" /end CHARACTERISTIC
/begin CHARACTERISTIC DFC_DisblMsk.DFC_IVGdiCtlCvoErrMin_1_C "disable mask / Disable masks of check DFC_IVGdiCtlCvoErrMin_1" VALUE 0x804F6006 Val_Wu16 65535.00 DFES_OneToOne 0.00 65535.00 FORMAT "%8.2" /end CHARACTERISTIC
/begin CHARACTERISTIC DFC_DisblMsk.DFC_IVGdiCtlCvoErrMin_2_C "disable mask / Disable masks of check DFC_IVGdiCtlCvoErrMin_2" VALUE 0x804F6008 Val_Wu16 65535.00 DFES_OneToOne 0.00 65535.00 FORMAT "%8.2" /end CHARACTERISTIC
/begin CHARACTERISTIC DFC_DisblMsk.DFC_IVGdiCtlCvoErrMin_3_C "disable mask / Disable masks of check DFC_IVGdiCtlCvoErrMin_3" VALUE 0x804F600A Val_Wu16 65535.00 DFES_OneToOne 0.00 65535.00 FORMAT "%8.2" /end CHARACTERISTIC
/begin CHARACTERISTIC DFC_DisblMsk.DFC_IVGdiCtlCvoErrMinMax_C "disable mask / Disable masks of check DFC_IVGdiCtlCvoErrMinMax" VALUE 0x804F600C Val_Wu16 65535.00 DFES_OneToOne 0.00 65535.00 FORMAT "%8.2" /end CHARACTERISTIC
/begin CHARACTERISTIC DFC_DisblMsk.DFC_IVGdiCtlCvoSigPlausErrSmrCdn_C "disable mask / Disable masks of check DFC_IVGdiCtlCvoSigPlausErrSmrCdn" VALUE 0x804F600E Val_Wu16 65535.00 DFES_OneToOne 0.00 65535.00 FORMAT "%8.2" /end CHARACTERISTIC
/begin CHARACTERISTIC DFC_DisblMsk.DFC_IVGdiCtl_CvoErr_C "disable mask / Disable masks of check DFC_IVGdiCtl_CvoErr" VALUE 0x804F6010 Val_Wu16 65535.00 DFES_OneToOne 0.00 65535.00 FORMAT "%8.2" /end CHARACTERISTIC
/begin CHARACTERISTIC DFC_DisblMsk.DFC_IVGdiCtl_CvoSigPlaus_0_C "disable mask / Disable masks of check DFC_IVGdiCtl_CvoSigPlaus_0" VALUE 0x804F6012 Val_Wu16 65535.00 DFES_OneToOne 0.00 65535.00 FORMAT "%8.2" /end CHARACTERISTIC
/begin CHARACTERISTIC DFC_DisblMsk.DFC_IVGdiCtl_CvoSigPlaus_1_C "disable mask / Disable masks of check DFC_IVGdiCtl_CvoSigPlaus_1" VALUE 0x804F6014 Val_Wu16 65535.00 DFES_OneToOne 0.00 65535.00 FORMAT "%8.2" /end CHARACTERISTIC
/begin CHARACTERISTIC DFC_DisblMsk.DFC_IVGdiCtl_CvoSigPlaus_2_C "disable mask / Disable masks of check DFC_IVGdiCtl_CvoSigPlaus_2" VALUE 0x804F6016 Val_Wu16 65535.00 DFES_OneToOne 0.00 65535.00 FORMAT "%8.2" /end CHARACTERISTIC
/begin CHARACTERISTIC DFC_DisblMsk.DFC_IVGdiCtl_CvoSigPlaus_3_C "disable mask / Disable masks of check DFC_IVGdiCtl_CvoSigPlaus_3" VALUE 0x804F6018 Val_Wu16 65535.00 DFES_OneToOne 0.00 65535.00 FORMAT "%8.2" /end CHARACTERISTIC
/begin CHARACTERISTIC DFC_DisblMsk.DFC_IntkAirTAirFltDsCrssMax_C "disable mask / Disable masks of check DFC_IntkAirTAirFltDsCrssMax" VALUE 0x804F601A Val_Wu16 65535.00 DFES_OneToOne 0.00 65535.00 FORMAT "%8.2" /end CHARACTERISTIC
/begin CHARACTERISTIC DFC_DisblMsk.DFC_IntkAirTAirFltDsCrssMin_C "disable mask / Disable masks of check DFC_IntkAirTAirFltDsCrssMin" VALUE 0x804F601C Val_Wu16 65535.00 DFES_OneToOne 0.00 65535.00 FORMAT "%8.2" /end CHARACTERISTIC
/begin CHARACTERISTIC DFC_DisblMsk.DFC_IntkAirTAirFltDsHSCMax_C "disable mask / Disable masks of check DFC_IntkAirTAirFltDsHSCMax" VALUE 0x804F601E Val_Wu16 65535.00 DFES_OneToOne 0.00 65535.00 FORMAT "%8.2" /end CHARACTERISTIC
/begin CHARACTERISTIC DFC_DisblMsk.DFC_IntkAirTAirFltDsImps_C "disable mask / Disable masks of check DFC_IntkAirTAirFltDsImps" VALUE 0x804F6020 Val_Wu16 65535.00 DFES_OneToOne 0.00 65535.00 FORMAT "%8.2" /end CHARACTERISTIC
/begin CHARACTERISTIC DFC_DisblMsk.DFC_IntkAirTAirFltDsPRCMax_C "disable mask / Disable masks of check DFC_IntkAirTAirFltDsPRCMax" VALUE 0x804F6022 Val_Wu16 65535.00 DFES_OneToOne 0.00 65535.00 FORMAT "%8.2" /end CHARACTERISTIC
/begin CHARACTERISTIC DFC_DisblMsk.DFC_IntkAirTAirFltDsPRCMin_C "disable mask / Disable masks of check DFC_IntkAirTAirFltDsPRCMin" VALUE 0x804F6024 Val_Wu16 65535.00 DFES_OneToOne 0.00 65535.00 FORMAT "%8.2" /end CHARACTERISTIC
/begin CHARACTERISTIC DFC_DisblMsk.DFC_IntkAirTAirFltDsSRCMax_C "disable mask / Disable masks of check DFC_IntkAirTAirFltDsSRCMax" VALUE 0x804F6026 Val_Wu16 65535.00 DFES_OneToOne 0.00 65535.00 FORMAT "%8.2" /end CHARACTERISTIC
/begin CHARACTERISTIC DFC_DisblMsk.DFC_IntkAirTAirFltDsSRCMin_C "disable mask / Disable masks of check DFC_IntkAirTAirFltDsSRCMin" VALUE 0x804F6028 Val_Wu16 65535.00 DFES_OneToOne 0.00 65535.00 FORMAT "%8.2" /end CHARACTERISTIC
/begin CHARACTERISTIC DFC_DisblMsk.DFC_IntkAirTAirFltDsSTC_C "disable mask / Disable masks of check DFC_IntkAirTAirFltDsSTC" VALUE 0x804F602A Val_Wu16 65535.00 DFES_OneToOne 0.00 65535.00 FORMAT "%8.2" /end CHARACTERISTIC
/begin CHARACTERISTIC DFC_DisblMsk.DFC_IntkAirTIntkMnfldCrssMax_C "disable mask / Disable masks of check DFC_IntkAirTIntkMnfldCrssMax" VALUE 0x804F602C Val_Wu16 65535.00 DFES_OneToOne 0.00 65535.00 FORMAT "%8.2" /end CHARACTERISTIC
/begin CHARACTERISTIC DFC_DisblMsk.DFC_IntkAirTIntkMnfldCrssMin_C "disable mask / Disable masks of check DFC_IntkAirTIntkMnfldCrssMin" VALUE 0x804F602E Val_Wu16 65535.00 DFES_OneToOne 0.00 65535.00 FORMAT "%8.2" /end CHARACTERISTIC
/begin CHARACTERISTIC DFC_DisblMsk.DFC_IntkAirTIntkMnfldHSCMax_C "disable mask / Disable masks of check DFC_IntkAirTIntkMnfldHSCMax" VALUE 0x804F6030 Val_Wu16 65535.00 DFES_OneToOne 0.00 65535.00 FORMAT "%8.2" /end CHARACTERISTIC
/begin CHARACTERISTIC DFC_DisblMsk.DFC_IntkAirTIntkMnfldImps_C "disable mask / Disable masks of check DFC_IntkAirTIntkMnfldImps" VALUE 0x804F6032 Val_Wu16 65535.00 DFES_OneToOne 0.00 65535.00 FORMAT "%8.2" /end CHARACTERISTIC
/begin CHARACTERISTIC DFC_DisblMsk.DFC_IntkAirTIntkMnfldPRCMax_C "disable mask / Disable masks of check DFC_IntkAirTIntkMnfldPRCMax" VALUE 0x804F6034 Val_Wu16 65535.00 DFES_OneToOne 0.00 65535.00 FORMAT "%8.2" /end CHARACTERISTIC
/begin CHARACTERISTIC DFC_DisblMsk.DFC_IntkAirTIntkMnfldPRCMin_C "disable mask / Disable masks of check DFC_IntkAirTIntkMnfldPRCMin" VALUE 0x804F6036 Val_Wu16 65535.00 DFES_OneToOne 0.00 65535.00 FORMAT "%8.2" /end CHARACTERISTIC
/begin CHARACTERISTIC DFC_DisblMsk.DFC_IntkAirTIntkMnfldSRCMax_C "disable mask / Disable masks of check DFC_IntkAirTIntkMnfldSRCMax" VALUE 0x804F6038 Val_Wu16 65535.00 DFES_OneToOne 0.00 65535.00 FORMAT "%8.2" /end CHARACTERISTIC
/begin CHARACTERISTIC DFC_DisblMsk.DFC_IntkAirTIntkMnfldSRCMin_C "disable mask / Disable masks of check DFC_IntkAirTIntkMnfldSRCMin" VALUE 0x804F603A Val_Wu16 65535.00 DFES_OneToOne 0.00 65535.00 FORMAT "%8.2" /end CHARACTERISTIC
/begin CHARACTERISTIC DFC_DisblMsk.DFC_IntkAirTIntkMnfldSTC_C "disable mask / Disable masks of check DFC_IntkAirTIntkMnfldSTC" VALUE 0x804F603C Val_Wu16 65535.00 DFES_OneToOne 0.00 65535.00 FORMAT "%8.2" /end CHARACTERISTIC
/begin CHARACTERISTIC DFC_DisblMsk.DFC_KRREGRLMX_C "disable mask / Disable masks of check DFC_KRREGRLMX" VALUE 0x804F603E Val_Wu16 65535.00 DFES_OneToOne 0.00 65535.00 FORMAT "%8.2" /end CHARACTERISTIC
/begin CHARACTERISTIC DFC_DisblMsk.DFC_KRVEKOCVLCI_C "disable mask / Disable masks of check DFC_KRVEKOCVLCI" VALUE 0x804F6040 Val_Wu16 65535.00 DFES_OneToOne 0.00 65535.00 FORMAT "%8.2" /end CHARACTERISTIC
/begin CHARACTERISTIC DFC_DisblMsk.DFC_KRVEKOENCHMT_C "disable mask / Disable masks of check DFC_KRVEKOENCHMT" VALUE 0x804F6042 Val_Wu16 65535.00 DFES_OneToOne 0.00 65535.00 FORMAT "%8.2" /end CHARACTERISTIC
/begin CHARACTERISTIC DFC_DisblMsk.DFC_KRVEKOENCHMT0_C "disable mask / Disable masks of check DFC_KRVEKOENCHMT0" VALUE 0x804F6044 Val_Wu16 65535.00 DFES_OneToOne 0.00 65535.00 FORMAT "%8.2" /end CHARACTERISTIC
/begin CHARACTERISTIC DFC_DisblMsk.DFC_KRVEKOENCHMT1_C "disable mask / Disable masks of check DFC_KRVEKOENCHMT1" VALUE 0x804F6046 Val_Wu16 65535.00 DFES_OneToOne 0.00 65535.00 FORMAT "%8.2" /end CHARACTERISTIC
/begin CHARACTERISTIC DFC_DisblMsk.DFC_KRVEKOENCHMT2_C "disable mask / Disable masks of check DFC_KRVEKOENCHMT2" VALUE 0x804F6048 Val_Wu16 65535.00 DFES_OneToOne 0.00 65535.00 FORMAT "%8.2" /end CHARACTERISTIC
/begin CHARACTERISTIC DFC_DisblMsk.DFC_KRVEKOENCHMT3_C "disable mask / Disable masks of check DFC_KRVEKOENCHMT3" VALUE 0x804F604A Val_Wu16 65535.00 DFES_OneToOne 0.00 65535.00 FORMAT "%8.2" /end CHARACTERISTIC
/begin CHARACTERISTIC DFC_DisblMsk.DFC_KRVEKOENCHMT4_C "disable mask / Disable masks of check DFC_KRVEKOENCHMT4" VALUE 0x804F604C Val_Wu16 65535.00 DFES_OneToOne 0.00 65535.00 FORMAT "%8.2" /end CHARACTERISTIC
/begin CHARACTERISTIC DFC_DisblMsk.DFC_KRVEKOENCHMT5_C "disable mask / Disable masks of check DFC_KRVEKOENCHMT5" VALUE 0x804F604E Val_Wu16 65535.00 DFES_OneToOne 0.00 65535.00 FORMAT "%8.2" /end CHARACTERISTIC
/begin CHARACTERISTIC DFC_DisblMsk.DFC_KRVEKOENCHMT6_C "disable mask / Disable masks of check DFC_KRVEKOENCHMT6" VALUE 0x804F6050 Val_Wu16 65535.00 DFES_OneToOne 0.00 65535.00 FORMAT "%8.2" /end CHARACTERISTIC
/begin CHARACTERISTIC DFC_DisblMsk.DFC_KRVEKOENCHMT7_C "disable mask / Disable masks of check DFC_KRVEKOENCHMT7" VALUE 0x804F6052 Val_Wu16 65535.00 DFES_OneToOne 0.00 65535.00 FORMAT "%8.2" /end CHARACTERISTIC
/begin CHARACTERISTIC DFC_DisblMsk.DFC_KRVEKORLMX_C "disable mask / Disable masks of check DFC_KRVEKORLMX" VALUE 0x804F6054 Val_Wu16 65535.00 DFES_OneToOne 0.00 65535.00 FORMAT "%8.2" /end CHARACTERISTIC
/begin CHARACTERISTIC DFC_DisblMsk.DFC_KRVEKORLMXL_C "disable mask / Disable masks of check DFC_KRVEKORLMXL" VALUE 0x804F6056 Val_Wu16 65535.00 DFES_OneToOne 0.00 65535.00 FORMAT "%8.2" /end CHARACTERISTIC
/begin CHARACTERISTIC DFC_DisblMsk.DFC_KS1max_C "disable mask / Disable masks of check DFC_KS1max" VALUE 0x804F6058 Val_Wu16 65535.00 DFES_OneToOne 0.00 65535.00 FORMAT "%8.2" /end CHARACTERISTIC
/begin CHARACTERISTIC DFC_DisblMsk.DFC_KS1min_C "disable mask / Disable masks of check DFC_KS1min" VALUE 0x804F605A Val_Wu16 65535.00 DFES_OneToOne 0.00 65535.00 FORMAT "%8.2" /end CHARACTERISTIC
/begin CHARACTERISTIC DFC_DisblMsk.DFC_LMmax_C "disable mask / Disable masks of check DFC_LMmax" VALUE 0x804F605C Val_Wu16 65535.00 DFES_OneToOne 0.00 65535.00 FORMAT "%8.2" /end CHARACTERISTIC
/begin CHARACTERISTIC DFC_DisblMsk.DFC_LZSRnpl_C "disable mask / Disable masks of check DFC_LZSRnpl" VALUE 0x804F605E Val_Wu16 65535.00 DFES_OneToOne 0.00 65535.00 FORMAT "%8.2" /end CHARACTERISTIC
/begin CHARACTERISTIC DFC_DisblMsk.DFC_LamDynDiagS1B1_C "disable mask / Disable masks of check DFC_LamDynDiagS1B1" VALUE 0x804F6060 Val_Wu16 65535.00 DFES_OneToOne 0.00 65535.00 FORMAT "%8.2" /end CHARACTERISTIC
/begin CHARACTERISTIC DFC_DisblMsk.DFC_LeakIntkMnfldEmiInfl_C "disable mask / Disable masks of check DFC_LeakIntkMnfldEmiInfl" VALUE 0x804F6062 Val_Wu16 65535.00 DFES_OneToOne 0.00 65535.00 FORMAT "%8.2" /end CHARACTERISTIC
/begin CHARACTERISTIC DFC_DisblMsk.DFC_LinFrameErrDCDC_C "disable mask / Disable masks of check DFC_LinFrameErrDCDC" VALUE 0x804F6064 Val_Wu16 65535.00 DFES_OneToOne 0.00 65535.00 FORMAT "%8.2" /end CHARACTERISTIC
/begin CHARACTERISTIC DFC_DisblMsk.DFC_LinOverrunErrDCDC_C "disable mask / Disable masks of check DFC_LinOverrunErrDCDC" VALUE 0x804F6066 Val_Wu16 65535.00 DFES_OneToOne 0.00 65535.00 FORMAT "%8.2" /end CHARACTERISTIC
/begin CHARACTERISTIC DFC_DisblMsk.DFC_MD00max_C "disable mask / Disable masks of check DFC_MD00max" VALUE 0x804F6068 Val_Wu16 65535.00 DFES_OneToOne 0.00 65535.00 FORMAT "%8.2" /end CHARACTERISTIC
/begin CHARACTERISTIC DFC_DisblMsk.DFC_MDBmax_C "disable mask / Disable masks of check DFC_MDBmax" VALUE 0x804F606A Val_Wu16 65535.00 DFES_OneToOne 0.00 65535.00 FORMAT "%8.2" /end CHARACTERISTIC
/begin CHARACTERISTIC DFC_DisblMsk.DFC_MDCat_C "disable mask / Disable masks of check DFC_MDCat" VALUE 0x804F606C Val_Wu16 65535.00 DFES_OneToOne 0.00 65535.00 FORMAT "%8.2" /end CHARACTERISTIC
/begin CHARACTERISTIC DFC_DisblMsk.DFC_MDCatCrit_C "disable mask / Disable masks of check DFC_MDCatCrit" VALUE 0x804F606E Val_Wu16 65535.00 DFES_OneToOne 0.00 65535.00 FORMAT "%8.2" /end CHARACTERISTIC
/begin CHARACTERISTIC DFC_DisblMsk.DFC_MDCatCurr_C "disable mask / Disable masks of check DFC_MDCatCurr" VALUE 0x804F6070 Val_Wu16 65535.00 DFES_OneToOne 0.00 65535.00 FORMAT "%8.2" /end CHARACTERISTIC
/begin CHARACTERISTIC DFC_DisblMsk.DFC_MDCyl_0_C "disable mask / Disable masks of check DFC_MDCyl_0" VALUE 0x804F6072 Val_Wu16 65535.00 DFES_OneToOne 0.00 65535.00 FORMAT "%8.2" /end CHARACTERISTIC
/begin CHARACTERISTIC DFC_DisblMsk.DFC_MDCyl_1_C "disable mask / Disable masks of check DFC_MDCyl_1" VALUE 0x804F6074 Val_Wu16 65535.00 DFES_OneToOne 0.00 65535.00 FORMAT "%8.2" /end CHARACTERISTIC
/begin CHARACTERISTIC DFC_DisblMsk.DFC_MDCyl_2_C "disable mask / Disable masks of check DFC_MDCyl_2" VALUE 0x804F6076 Val_Wu16 65535.00 DFES_OneToOne 0.00 65535.00 FORMAT "%8.2" /end CHARACTERISTIC
/begin CHARACTERISTIC DFC_DisblMsk.DFC_MDCyl_3_C "disable mask / Disable masks of check DFC_MDCyl_3" VALUE 0x804F6078 Val_Wu16 65535.00 DFES_OneToOne 0.00 65535.00 FORMAT "%8.2" /end CHARACTERISTIC
/begin CHARACTERISTIC DFC_DisblMsk.DFC_MDEmi_C "disable mask / Disable masks of check DFC_MDEmi" VALUE 0x804F607A Val_Wu16 65535.00 DFES_OneToOne 0.00 65535.00 FORMAT "%8.2" /end CHARACTERISTIC
/begin CHARACTERISTIC DFC_DisblMsk.DFC_MDEmiStrt_C "disable mask / Disable masks of check DFC_MDEmiStrt" VALUE 0x804F607C Val_Wu16 65535.00 DFES_OneToOne 0.00 65535.00 FORMAT "%8.2" /end CHARACTERISTIC
/begin CHARACTERISTIC DFC_DisblMsk.DFC_MDFco_C "disable mask / Disable masks of check DFC_MDFco" VALUE 0x804F607E Val_Wu16 65535.00 DFES_OneToOne 0.00 65535.00 FORMAT "%8.2" /end CHARACTERISTIC
/begin CHARACTERISTIC DFC_DisblMsk.DFC_MDMpl_C "disable mask / Disable masks of check DFC_MDMpl" VALUE 0x804F6080 Val_Wu16 65535.00 DFES_OneToOne 0.00 65535.00 FORMAT "%8.2" /end CHARACTERISTIC
/begin CHARACTERISTIC DFC_DisblMsk.DFC_MDSegTiAdpn_C "disable mask / Disable masks of check DFC_MDSegTiAdpn" VALUE 0x804F6082 Val_Wu16 65535.00 DFES_OneToOne 0.00 65535.00 FORMAT "%8.2" /end CHARACTERISTIC
/begin CHARACTERISTIC DFC_DisblMsk.DFC_MDmax_C "disable mask / Disable masks of check DFC_MDmax" VALUE 0x804F6084 Val_Wu16 65535.00 DFES_OneToOne 0.00 65535.00 FORMAT "%8.2" /end CHARACTERISTIC
/begin CHARACTERISTIC DFC_DisblMsk.DFC_MFuOilMax_C "disable mask / Disable masks of check DFC_MFuOilMax" VALUE 0x804F6086 Val_Wu16 65535.00 DFES_OneToOne 0.00 65535.00 FORMAT "%8.2" /end CHARACTERISTIC
/begin CHARACTERISTIC DFC_DisblMsk.DFC_MOXEMM_SMU_ALM0_0_C "disable mask / Disable masks of check DFC_MOXEMM_SMU_ALM0_0" VALUE 0x804F6088 Val_Wu16 65535.00 DFES_OneToOne 0.00 65535.00 FORMAT "%8.2" /end CHARACTERISTIC
/begin CHARACTERISTIC DFC_DisblMsk.DFC_MOXEMM_SMU_ALM0_1_C "disable mask / Disable masks of check DFC_MOXEMM_SMU_ALM0_1" VALUE 0x804F608A Val_Wu16 65535.00 DFES_OneToOne 0.00 65535.00 FORMAT "%8.2" /end CHARACTERISTIC
/begin CHARACTERISTIC DFC_DisblMsk.DFC_MOXEMM_SMU_ALM0_10_C "disable mask / Disable masks of check DFC_MOXEMM_SMU_ALM0_10" VALUE 0x804F608C Val_Wu16 65535.00 DFES_OneToOne 0.00 65535.00 FORMAT "%8.2" /end CHARACTERISTIC
/begin CHARACTERISTIC DFC_DisblMsk.DFC_MOXEMM_SMU_ALM0_11_C "disable mask / Disable masks of check DFC_MOXEMM_SMU_ALM0_11" VALUE 0x804F608E Val_Wu16 65535.00 DFES_OneToOne 0.00 65535.00 FORMAT "%8.2" /end CHARACTERISTIC
/begin CHARACTERISTIC DFC_DisblMsk.DFC_MOXEMM_SMU_ALM0_13_C "disable mask / Disable masks of check DFC_MOXEMM_SMU_ALM0_13" VALUE 0x804F6090 Val_Wu16 65535.00 DFES_OneToOne 0.00 65535.00 FORMAT "%8.2" /end CHARACTERISTIC
/begin CHARACTERISTIC DFC_DisblMsk.DFC_MOXEMM_SMU_ALM0_14_C "disable mask / Disable masks of check DFC_MOXEMM_SMU_ALM0_14" VALUE 0x804F6092 Val_Wu16 65535.00 DFES_OneToOne 0.00 65535.00 FORMAT "%8.2" /end CHARACTERISTIC
/begin CHARACTERISTIC DFC_DisblMsk.DFC_MOXEMM_SMU_ALM0_2_C "disable mask / Disable masks of check DFC_MOXEMM_SMU_ALM0_2" VALUE 0x804F6094 Val_Wu16 65535.00 DFES_OneToOne 0.00 65535.00 FORMAT "%8.2" /end CHARACTERISTIC
/begin CHARACTERISTIC DFC_DisblMsk.DFC_MOXEMM_SMU_ALM0_22_C "disable mask / Disable masks of check DFC_MOXEMM_SMU_ALM0_22" VALUE 0x804F6096 Val_Wu16 65535.00 DFES_OneToOne 0.00 65535.00 FORMAT "%8.2" /end CHARACTERISTIC
/begin CHARACTERISTIC DFC_DisblMsk.DFC_MOXEMM_SMU_ALM0_23_C "disable mask / Disable masks of check DFC_MOXEMM_SMU_ALM0_23" VALUE 0x804F6098 Val_Wu16 65535.00 DFES_OneToOne 0.00 65535.00 FORMAT "%8.2" /end CHARACTERISTIC
/begin CHARACTERISTIC DFC_DisblMsk.DFC_MOXEMM_SMU_ALM0_4_C "disable mask / Disable masks of check DFC_MOXEMM_SMU_ALM0_4" VALUE 0x804F609A Val_Wu16 65535.00 DFES_OneToOne 0.00 65535.00 FORMAT "%8.2" /end CHARACTERISTIC
/begin CHARACTERISTIC DFC_DisblMsk.DFC_MOXEMM_SMU_ALM0_5_C "disable mask / Disable masks of check DFC_MOXEMM_SMU_ALM0_5" VALUE 0x804F609C Val_Wu16 65535.00 DFES_OneToOne 0.00 65535.00 FORMAT "%8.2" /end CHARACTERISTIC
/begin CHARACTERISTIC DFC_DisblMsk.DFC_MOXEMM_SMU_ALM0_7_C "disable mask / Disable masks of check DFC_MOXEMM_SMU_ALM0_7" VALUE 0x804F609E Val_Wu16 65535.00 DFES_OneToOne 0.00 65535.00 FORMAT "%8.2" /end CHARACTERISTIC
/begin CHARACTERISTIC DFC_DisblMsk.DFC_MOXEMM_SMU_ALM0_8_C "disable mask / Disable masks of check DFC_MOXEMM_SMU_ALM0_8" VALUE 0x804F60A0 Val_Wu16 65535.00 DFES_OneToOne 0.00 65535.00 FORMAT "%8.2" /end CHARACTERISTIC
/begin CHARACTERISTIC DFC_DisblMsk.DFC_MOXEMM_SMU_ALM10_16_C "disable mask / Disable masks of check DFC_MOXEMM_SMU_ALM10_16" VALUE 0x804F60A2 Val_Wu16 65535.00 DFES_OneToOne 0.00 65535.00 FORMAT "%8.2" /end CHARACTERISTIC
/begin CHARACTERISTIC DFC_DisblMsk.DFC_MOXEMM_SMU_ALM10_17_C "disable mask / Disable masks of check DFC_MOXEMM_SMU_ALM10_17" VALUE 0x804F60A4 Val_Wu16 65535.00 DFES_OneToOne 0.00 65535.00 FORMAT "%8.2" /end CHARACTERISTIC
/begin CHARACTERISTIC DFC_DisblMsk.DFC_MOXEMM_SMU_ALM10_21_C "disable mask / Disable masks of check DFC_MOXEMM_SMU_ALM10_21" VALUE 0x804F60A6 Val_Wu16 65535.00 DFES_OneToOne 0.00 65535.00 FORMAT "%8.2" /end CHARACTERISTIC
/begin CHARACTERISTIC DFC_DisblMsk.DFC_MOXEMM_SMU_ALM11_0_C "disable mask / Disable masks of check DFC_MOXEMM_SMU_ALM11_0" VALUE 0x804F60A8 Val_Wu16 65535.00 DFES_OneToOne 0.00 65535.00 FORMAT "%8.2" /end CHARACTERISTIC
/begin CHARACTERISTIC DFC_DisblMsk.DFC_MOXEMM_SMU_ALM11_1_C "disable mask / Disable masks of check DFC_MOXEMM_SMU_ALM11_1" VALUE 0x804F60AA Val_Wu16 65535.00 DFES_OneToOne 0.00 65535.00 FORMAT "%8.2" /end CHARACTERISTIC
/begin CHARACTERISTIC DFC_DisblMsk.DFC_MOXEMM_SMU_ALM11_2_C "disable mask / Disable masks of check DFC_MOXEMM_SMU_ALM11_2" VALUE 0x804F60AC Val_Wu16 65535.00 DFES_OneToOne 0.00 65535.00 FORMAT "%8.2" /end CHARACTERISTIC
/begin CHARACTERISTIC DFC_DisblMsk.DFC_MOXEMM_SMU_ALM11_3_C "disable mask / Disable masks of check DFC_MOXEMM_SMU_ALM11_3" VALUE 0x804F60AE Val_Wu16 65535.00 DFES_OneToOne 0.00 65535.00 FORMAT "%8.2" /end CHARACTERISTIC
/begin CHARACTERISTIC DFC_DisblMsk.DFC_MOXEMM_SMU_ALM11_4_C "disable mask / Disable masks of check DFC_MOXEMM_SMU_ALM11_4" VALUE 0x804F60B0 Val_Wu16 65535.00 DFES_OneToOne 0.00 65535.00 FORMAT "%8.2" /end CHARACTERISTIC
/begin CHARACTERISTIC DFC_DisblMsk.DFC_MOXEMM_SMU_ALM11_5_C "disable mask / Disable masks of check DFC_MOXEMM_SMU_ALM11_5" VALUE 0x804F60B2 Val_Wu16 65535.00 DFES_OneToOne 0.00 65535.00 FORMAT "%8.2" /end CHARACTERISTIC
/begin CHARACTERISTIC DFC_DisblMsk.DFC_MOXEMM_SMU_ALM11_8_C "disable mask / Disable masks of check DFC_MOXEMM_SMU_ALM11_8" VALUE 0x804F60B4 Val_Wu16 65535.00 DFES_OneToOne 0.00 65535.00 FORMAT "%8.2" /end CHARACTERISTIC
/begin CHARACTERISTIC DFC_DisblMsk.DFC_MOXEMM_SMU_ALM11_9_C "disable mask / Disable masks of check DFC_MOXEMM_SMU_ALM11_9" VALUE 0x804F60B6 Val_Wu16 65535.00 DFES_OneToOne 0.00 65535.00 FORMAT "%8.2" /end CHARACTERISTIC
/begin CHARACTERISTIC DFC_DisblMsk.DFC_MOXEMM_SMU_ALM1_0_C "disable mask / Disable masks of check DFC_MOXEMM_SMU_ALM1_0" VALUE 0x804F60B8 Val_Wu16 65535.00 DFES_OneToOne 0.00 65535.00 FORMAT "%8.2" /end CHARACTERISTIC
/begin CHARACTERISTIC DFC_DisblMsk.DFC_MOXEMM_SMU_ALM1_1_C "disable mask / Disable masks of check DFC_MOXEMM_SMU_ALM1_1" VALUE 0x804F60BA Val_Wu16 65535.00 DFES_OneToOne 0.00 65535.00 FORMAT "%8.2" /end CHARACTERISTIC
/begin CHARACTERISTIC DFC_DisblMsk.DFC_MOXEMM_SMU_ALM1_10_C "disable mask / Disable masks of check DFC_MOXEMM_SMU_ALM1_10" VALUE 0x804F60BC Val_Wu16 65535.00 DFES_OneToOne 0.00 65535.00 FORMAT "%8.2" /end CHARACTERISTIC
/begin CHARACTERISTIC DFC_DisblMsk.DFC_MOXEMM_SMU_ALM1_11_C "disable mask / Disable masks of check DFC_MOXEMM_SMU_ALM1_11" VALUE 0x804F60BE Val_Wu16 65535.00 DFES_OneToOne 0.00 65535.00 FORMAT "%8.2" /end CHARACTERISTIC
/begin CHARACTERISTIC DFC_DisblMsk.DFC_MOXEMM_SMU_ALM1_13_C "disable mask / Disable masks of check DFC_MOXEMM_SMU_ALM1_13" VALUE 0x804F60C0 Val_Wu16 65535.00 DFES_OneToOne 0.00 65535.00 FORMAT "%8.2" /end CHARACTERISTIC
/begin CHARACTERISTIC DFC_DisblMsk.DFC_MOXEMM_SMU_ALM1_14_C "disable mask / Disable masks of check DFC_MOXEMM_SMU_ALM1_14" VALUE 0x804F60C2 Val_Wu16 65535.00 DFES_OneToOne 0.00 65535.00 FORMAT "%8.2" /end CHARACTERISTIC
/begin CHARACTERISTIC DFC_DisblMsk.DFC_MOXEMM_SMU_ALM1_2_C "disable mask / Disable masks of check DFC_MOXEMM_SMU_ALM1_2" VALUE 0x804F60C4 Val_Wu16 65535.00 DFES_OneToOne 0.00 65535.00 FORMAT "%8.2" /end CHARACTERISTIC
/begin CHARACTERISTIC DFC_DisblMsk.DFC_MOXEMM_SMU_ALM1_22_C "disable mask / Disable masks of check DFC_MOXEMM_SMU_ALM1_22" VALUE 0x804F60C6 Val_Wu16 65535.00 DFES_OneToOne 0.00 65535.00 FORMAT "%8.2" /end CHARACTERISTIC
/begin CHARACTERISTIC DFC_DisblMsk.DFC_MOXEMM_SMU_ALM1_23_C "disable mask / Disable masks of check DFC_MOXEMM_SMU_ALM1_23" VALUE 0x804F60C8 Val_Wu16 65535.00 DFES_OneToOne 0.00 65535.00 FORMAT "%8.2" /end CHARACTERISTIC
/begin CHARACTERISTIC DFC_DisblMsk.DFC_MOXEMM_SMU_ALM1_4_C "disable mask / Disable masks of check DFC_MOXEMM_SMU_ALM1_4" VALUE 0x804F60CA Val_Wu16 65535.00 DFES_OneToOne 0.00 65535.00 FORMAT "%8.2" /end CHARACTERISTIC
/begin CHARACTERISTIC DFC_DisblMsk.DFC_MOXEMM_SMU_ALM1_5_C "disable mask / Disable masks of check DFC_MOXEMM_SMU_ALM1_5" VALUE 0x804F60CC Val_Wu16 65535.00 DFES_OneToOne 0.00 65535.00 FORMAT "%8.2" /end CHARACTERISTIC
/begin CHARACTERISTIC DFC_DisblMsk.DFC_MOXEMM_SMU_ALM1_7_C "disable mask / Disable masks of check DFC_MOXEMM_SMU_ALM1_7" VALUE 0x804F60CE Val_Wu16 65535.00 DFES_OneToOne 0.00 65535.00 FORMAT "%8.2" /end CHARACTERISTIC
/begin CHARACTERISTIC DFC_DisblMsk.DFC_MOXEMM_SMU_ALM1_8_C "disable mask / Disable masks of check DFC_MOXEMM_SMU_ALM1_8" VALUE 0x804F60D0 Val_Wu16 65535.00 DFES_OneToOne 0.00 65535.00 FORMAT "%8.2" /end CHARACTERISTIC
/begin CHARACTERISTIC DFC_DisblMsk.DFC_MOXEMM_SMU_ALM21_0_C "disable mask / Disable masks of check DFC_MOXEMM_SMU_ALM21_0" VALUE 0x804F60D2 Val_Wu16 65535.00 DFES_OneToOne 0.00 65535.00 FORMAT "%8.2" /end CHARACTERISTIC
/begin CHARACTERISTIC DFC_DisblMsk.DFC_MOXEMM_SMU_ALM21_16_C "disable mask / Disable masks of check DFC_MOXEMM_SMU_ALM21_16" VALUE 0x804F60D4 Val_Wu16 65535.00 DFES_OneToOne 0.00 65535.00 FORMAT "%8.2" /end CHARACTERISTIC
/begin CHARACTERISTIC DFC_DisblMsk.DFC_MOXEMM_SMU_ALM21_3_C "disable mask / Disable masks of check DFC_MOXEMM_SMU_ALM21_3" VALUE 0x804F60D6 Val_Wu16 65535.00 DFES_OneToOne 0.00 65535.00 FORMAT "%8.2" /end CHARACTERISTIC
/begin CHARACTERISTIC DFC_DisblMsk.DFC_MOXEMM_SMU_ALM2_1_C "disable mask / Disable masks of check DFC_MOXEMM_SMU_ALM2_1" VALUE 0x804F60D8 Val_Wu16 65535.00 DFES_OneToOne 0.00 65535.00 FORMAT "%8.2" /end CHARACTERISTIC
/begin CHARACTERISTIC DFC_DisblMsk.DFC_MOXEMM_SMU_ALM2_10_C "disable mask / Disable masks of check DFC_MOXEMM_SMU_ALM2_10" VALUE 0x804F60DA Val_Wu16 65535.00 DFES_OneToOne 0.00 65535.00 FORMAT "%8.2" /end CHARACTERISTIC
/begin CHARACTERISTIC DFC_DisblMsk.DFC_MOXEMM_SMU_ALM2_11_C "disable mask / Disable masks of check DFC_MOXEMM_SMU_ALM2_11" VALUE 0x804F60DC Val_Wu16 65535.00 DFES_OneToOne 0.00 65535.00 FORMAT "%8.2" /end CHARACTERISTIC
/begin CHARACTERISTIC DFC_DisblMsk.DFC_MOXEMM_SMU_ALM2_13_C "disable mask / Disable masks of check DFC_MOXEMM_SMU_ALM2_13" VALUE 0x804F60DE Val_Wu16 65535.00 DFES_OneToOne 0.00 65535.00 FORMAT "%8.2" /end CHARACTERISTIC
/begin CHARACTERISTIC DFC_DisblMsk.DFC_MOXEMM_SMU_ALM2_14_C "disable mask / Disable masks of check DFC_MOXEMM_SMU_ALM2_14" VALUE 0x804F60E0 Val_Wu16 65535.00 DFES_OneToOne 0.00 65535.00 FORMAT "%8.2" /end CHARACTERISTIC
/begin CHARACTERISTIC DFC_DisblMsk.DFC_MOXEMM_SMU_ALM2_22_C "disable mask / Disable masks of check DFC_MOXEMM_SMU_ALM2_22" VALUE 0x804F60E2 Val_Wu16 65535.00 DFES_OneToOne 0.00 65535.00 FORMAT "%8.2" /end CHARACTERISTIC
/begin CHARACTERISTIC DFC_DisblMsk.DFC_MOXEMM_SMU_ALM2_23_C "disable mask / Disable masks of check DFC_MOXEMM_SMU_ALM2_23" VALUE 0x804F60E4 Val_Wu16 65535.00 DFES_OneToOne 0.00 65535.00 FORMAT "%8.2" /end CHARACTERISTIC
/begin CHARACTERISTIC DFC_DisblMsk.DFC_MOXEMM_SMU_ALM2_4_C "disable mask / Disable masks of check DFC_MOXEMM_SMU_ALM2_4" VALUE 0x804F60E6 Val_Wu16 65535.00 DFES_OneToOne 0.00 65535.00 FORMAT "%8.2" /end CHARACTERISTIC
/begin CHARACTERISTIC DFC_DisblMsk.DFC_MOXEMM_SMU_ALM2_5_C "disable mask / Disable masks of check DFC_MOXEMM_SMU_ALM2_5" VALUE 0x804F60E8 Val_Wu16 65535.00 DFES_OneToOne 0.00 65535.00 FORMAT "%8.2" /end CHARACTERISTIC
/begin CHARACTERISTIC DFC_DisblMsk.DFC_MOXEMM_SMU_ALM2_7_C "disable mask / Disable masks of check DFC_MOXEMM_SMU_ALM2_7" VALUE 0x804F60EA Val_Wu16 65535.00 DFES_OneToOne 0.00 65535.00 FORMAT "%8.2" /end CHARACTERISTIC
/begin CHARACTERISTIC DFC_DisblMsk.DFC_MOXEMM_SMU_ALM2_8_C "disable mask / Disable masks of check DFC_MOXEMM_SMU_ALM2_8" VALUE 0x804F60EC Val_Wu16 65535.00 DFES_OneToOne 0.00 65535.00 FORMAT "%8.2" /end CHARACTERISTIC
/begin CHARACTERISTIC DFC_DisblMsk.DFC_MOXEMM_SMU_ALM6_0_C "disable mask / Disable masks of check DFC_MOXEMM_SMU_ALM6_0" VALUE 0x804F60EE Val_Wu16 65535.00 DFES_OneToOne 0.00 65535.00 FORMAT "%8.2" /end CHARACTERISTIC
/begin CHARACTERISTIC DFC_DisblMsk.DFC_MOXEMM_SMU_ALM6_11_C "disable mask / Disable masks of check DFC_MOXEMM_SMU_ALM6_11" VALUE 0x804F60F0 Val_Wu16 65535.00 DFES_OneToOne 0.00 65535.00 FORMAT "%8.2" /end CHARACTERISTIC
/begin CHARACTERISTIC DFC_DisblMsk.DFC_MOXEMM_SMU_ALM6_12_C "disable mask / Disable masks of check DFC_MOXEMM_SMU_ALM6_12" VALUE 0x804F60F2 Val_Wu16 65535.00 DFES_OneToOne 0.00 65535.00 FORMAT "%8.2" /end CHARACTERISTIC
/begin CHARACTERISTIC DFC_DisblMsk.DFC_MOXEMM_SMU_ALM6_14_C "disable mask / Disable masks of check DFC_MOXEMM_SMU_ALM6_14" VALUE 0x804F60F4 Val_Wu16 65535.00 DFES_OneToOne 0.00 65535.00 FORMAT "%8.2" /end CHARACTERISTIC
/begin CHARACTERISTIC DFC_DisblMsk.DFC_MOXEMM_SMU_ALM6_15_C "disable mask / Disable masks of check DFC_MOXEMM_SMU_ALM6_15" VALUE 0x804F60F6 Val_Wu16 65535.00 DFES_OneToOne 0.00 65535.00 FORMAT "%8.2" /end CHARACTERISTIC
/begin CHARACTERISTIC DFC_DisblMsk.DFC_MOXEMM_SMU_ALM6_17_C "disable mask / Disable masks of check DFC_MOXEMM_SMU_ALM6_17" VALUE 0x804F60F8 Val_Wu16 65535.00 DFES_OneToOne 0.00 65535.00 FORMAT "%8.2" /end CHARACTERISTIC
/begin CHARACTERISTIC DFC_DisblMsk.DFC_MOXEMM_SMU_ALM6_18_C "disable mask / Disable masks of check DFC_MOXEMM_SMU_ALM6_18" VALUE 0x804F60FA Val_Wu16 65535.00 DFES_OneToOne 0.00 65535.00 FORMAT "%8.2" /end CHARACTERISTIC
/begin CHARACTERISTIC DFC_DisblMsk.DFC_MOXEMM_SMU_ALM6_20_C "disable mask / Disable masks of check DFC_MOXEMM_SMU_ALM6_20" VALUE 0x804F60FC Val_Wu16 65535.00 DFES_OneToOne 0.00 65535.00 FORMAT "%8.2" /end CHARACTERISTIC
/begin CHARACTERISTIC DFC_DisblMsk.DFC_MOXEMM_SMU_ALM6_21_C "disable mask / Disable masks of check DFC_MOXEMM_SMU_ALM6_21" VALUE 0x804F60FE Val_Wu16 65535.00 DFES_OneToOne 0.00 65535.00 FORMAT "%8.2" /end CHARACTERISTIC
/begin CHARACTERISTIC DFC_DisblMsk.DFC_MOXEMM_SMU_ALM6_25_C "disable mask / Disable masks of check DFC_MOXEMM_SMU_ALM6_25" VALUE 0x804F6100 Val_Wu16 65535.00 DFES_OneToOne 0.00 65535.00 FORMAT "%8.2" /end CHARACTERISTIC
/begin CHARACTERISTIC DFC_DisblMsk.DFC_MOXEMM_SMU_ALM6_4_C "disable mask / Disable masks of check DFC_MOXEMM_SMU_ALM6_4" VALUE 0x804F6102 Val_Wu16 65535.00 DFES_OneToOne 0.00 65535.00 FORMAT "%8.2" /end CHARACTERISTIC
/begin CHARACTERISTIC DFC_DisblMsk.DFC_MOXEMM_SMU_ALM6_5_C "disable mask / Disable masks of check DFC_MOXEMM_SMU_ALM6_5" VALUE 0x804F6104 Val_Wu16 65535.00 DFES_OneToOne 0.00 65535.00 FORMAT "%8.2" /end CHARACTERISTIC
/begin CHARACTERISTIC DFC_DisblMsk.DFC_MOXEMM_SMU_ALM6_7_C "disable mask / Disable masks of check DFC_MOXEMM_SMU_ALM6_7" VALUE 0x804F6106 Val_Wu16 65535.00 DFES_OneToOne 0.00 65535.00 FORMAT "%8.2" /end CHARACTERISTIC
/begin CHARACTERISTIC DFC_DisblMsk.DFC_MOXEMM_SMU_ALM6_8_C "disable mask / Disable masks of check DFC_MOXEMM_SMU_ALM6_8" VALUE 0x804F6108 Val_Wu16 65535.00 DFES_OneToOne 0.00 65535.00 FORMAT "%8.2" /end CHARACTERISTIC
/begin CHARACTERISTIC DFC_DisblMsk.DFC_MOXEMM_SMU_ALM7_1_C "disable mask / Disable masks of check DFC_MOXEMM_SMU_ALM7_1" VALUE 0x804F610A Val_Wu16 65535.00 DFES_OneToOne 0.00 65535.00 FORMAT "%8.2" /end CHARACTERISTIC
/begin CHARACTERISTIC DFC_DisblMsk.DFC_MOXEMM_SMU_ALM7_12_C "disable mask / Disable masks of check DFC_MOXEMM_SMU_ALM7_12" VALUE 0x804F610C Val_Wu16 65535.00 DFES_OneToOne 0.00 65535.00 FORMAT "%8.2" /end CHARACTERISTIC
/begin CHARACTERISTIC DFC_DisblMsk.DFC_MOXEMM_SMU_ALM7_13_C "disable mask / Disable masks of check DFC_MOXEMM_SMU_ALM7_13" VALUE 0x804F610E Val_Wu16 65535.00 DFES_OneToOne 0.00 65535.00 FORMAT "%8.2" /end CHARACTERISTIC
/begin CHARACTERISTIC DFC_DisblMsk.DFC_MOXEMM_SMU_ALM7_14_C "disable mask / Disable masks of check DFC_MOXEMM_SMU_ALM7_14" VALUE 0x804F6110 Val_Wu16 65535.00 DFES_OneToOne 0.00 65535.00 FORMAT "%8.2" /end CHARACTERISTIC
/begin CHARACTERISTIC DFC_DisblMsk.DFC_MOXEMM_SMU_ALM7_15_C "disable mask / Disable masks of check DFC_MOXEMM_SMU_ALM7_15" VALUE 0x804F6112 Val_Wu16 65535.00 DFES_OneToOne 0.00 65535.00 FORMAT "%8.2" /end CHARACTERISTIC
/begin CHARACTERISTIC DFC_DisblMsk.DFC_MOXEMM_SMU_ALM7_16_C "disable mask / Disable masks of check DFC_MOXEMM_SMU_ALM7_16" VALUE 0x804F6114 Val_Wu16 65535.00 DFES_OneToOne 0.00 65535.00 FORMAT "%8.2" /end CHARACTERISTIC
/begin CHARACTERISTIC DFC_DisblMsk.DFC_MOXEMM_SMU_ALM7_17_C "disable mask / Disable masks of check DFC_MOXEMM_SMU_ALM7_17" VALUE 0x804F6116 Val_Wu16 65535.00 DFES_OneToOne 0.00 65535.00 FORMAT "%8.2" /end CHARACTERISTIC
/begin CHARACTERISTIC DFC_DisblMsk.DFC_MOXEMM_SMU_ALM7_2_C "disable mask / Disable masks of check DFC_MOXEMM_SMU_ALM7_2" VALUE 0x804F6118 Val_Wu16 65535.00 DFES_OneToOne 0.00 65535.00 FORMAT "%8.2" /end CHARACTERISTIC
/begin CHARACTERISTIC DFC_DisblMsk.DFC_MOXEMM_SMU_ALM7_20_C "disable mask / Disable masks of check DFC_MOXEMM_SMU_ALM7_20" VALUE 0x804F611A Val_Wu16 65535.00 DFES_OneToOne 0.00 65535.00 FORMAT "%8.2" /end CHARACTERISTIC
/begin CHARACTERISTIC DFC_DisblMsk.DFC_MOXEMM_SMU_ALM7_25_C "disable mask / Disable masks of check DFC_MOXEMM_SMU_ALM7_25" VALUE 0x804F611C Val_Wu16 65535.00 DFES_OneToOne 0.00 65535.00 FORMAT "%8.2" /end CHARACTERISTIC
/begin CHARACTERISTIC DFC_DisblMsk.DFC_MOXEMM_SMU_ALM7_26_C "disable mask / Disable masks of check DFC_MOXEMM_SMU_ALM7_26" VALUE 0x804F611E Val_Wu16 65535.00 DFES_OneToOne 0.00 65535.00 FORMAT "%8.2" /end CHARACTERISTIC
/begin CHARACTERISTIC DFC_DisblMsk.DFC_MOXEMM_SMU_ALM7_28_C "disable mask / Disable masks of check DFC_MOXEMM_SMU_ALM7_28" VALUE 0x804F6120 Val_Wu16 65535.00 DFES_OneToOne 0.00 65535.00 FORMAT "%8.2" /end CHARACTERISTIC
/begin CHARACTERISTIC DFC_DisblMsk.DFC_MOXEMM_SMU_ALM7_29_C "disable mask / Disable masks of check DFC_MOXEMM_SMU_ALM7_29" VALUE 0x804F6122 Val_Wu16 65535.00 DFES_OneToOne 0.00 65535.00 FORMAT "%8.2" /end CHARACTERISTIC
/begin CHARACTERISTIC DFC_DisblMsk.DFC_MOXEMM_SMU_ALM7_30_C "disable mask / Disable masks of check DFC_MOXEMM_SMU_ALM7_30" VALUE 0x804F6124 Val_Wu16 65535.00 DFES_OneToOne 0.00 65535.00 FORMAT "%8.2" /end CHARACTERISTIC
/begin CHARACTERISTIC DFC_DisblMsk.DFC_MOXEMM_SMU_ALM7_31_C "disable mask / Disable masks of check DFC_MOXEMM_SMU_ALM7_31" VALUE 0x804F6126 Val_Wu16 65535.00 DFES_OneToOne 0.00 65535.00 FORMAT "%8.2" /end CHARACTERISTIC
/begin CHARACTERISTIC DFC_DisblMsk.DFC_MOXEMM_SMU_ALM8_0_C "disable mask / Disable masks of check DFC_MOXEMM_SMU_ALM8_0" VALUE 0x804F6128 Val_Wu16 65535.00 DFES_OneToOne 0.00 65535.00 FORMAT "%8.2" /end CHARACTERISTIC
/begin CHARACTERISTIC DFC_DisblMsk.DFC_MOXEMM_SMU_ALM8_1_C "disable mask / Disable masks of check DFC_MOXEMM_SMU_ALM8_1" VALUE 0x804F612A Val_Wu16 65535.00 DFES_OneToOne 0.00 65535.00 FORMAT "%8.2" /end CHARACTERISTIC
/begin CHARACTERISTIC DFC_DisblMsk.DFC_MOXEMM_SMU_ALM8_10_C "disable mask / Disable masks of check DFC_MOXEMM_SMU_ALM8_10" VALUE 0x804F612C Val_Wu16 65535.00 DFES_OneToOne 0.00 65535.00 FORMAT "%8.2" /end CHARACTERISTIC
/begin CHARACTERISTIC DFC_DisblMsk.DFC_MOXEMM_SMU_ALM8_11_C "disable mask / Disable masks of check DFC_MOXEMM_SMU_ALM8_11" VALUE 0x804F612E Val_Wu16 65535.00 DFES_OneToOne 0.00 65535.00 FORMAT "%8.2" /end CHARACTERISTIC
/begin CHARACTERISTIC DFC_DisblMsk.DFC_MOXEMM_SMU_ALM8_12_C "disable mask / Disable masks of check DFC_MOXEMM_SMU_ALM8_12" VALUE 0x804F6130 Val_Wu16 65535.00 DFES_OneToOne 0.00 65535.00 FORMAT "%8.2" /end CHARACTERISTIC
/begin CHARACTERISTIC DFC_DisblMsk.DFC_MOXEMM_SMU_ALM8_16_C "disable mask / Disable masks of check DFC_MOXEMM_SMU_ALM8_16" VALUE 0x804F6132 Val_Wu16 65535.00 DFES_OneToOne 0.00 65535.00 FORMAT "%8.2" /end CHARACTERISTIC
/begin CHARACTERISTIC DFC_DisblMsk.DFC_MOXEMM_SMU_ALM8_18_C "disable mask / Disable masks of check DFC_MOXEMM_SMU_ALM8_18" VALUE 0x804F6134 Val_Wu16 65535.00 DFES_OneToOne 0.00 65535.00 FORMAT "%8.2" /end CHARACTERISTIC
/begin CHARACTERISTIC DFC_DisblMsk.DFC_MOXEMM_SMU_ALM8_2_C "disable mask / Disable masks of check DFC_MOXEMM_SMU_ALM8_2" VALUE 0x804F6136 Val_Wu16 65535.00 DFES_OneToOne 0.00 65535.00 FORMAT "%8.2" /end CHARACTERISTIC
/begin CHARACTERISTIC DFC_DisblMsk.DFC_MOXEMM_SMU_ALM8_3_C "disable mask / Disable masks of check DFC_MOXEMM_SMU_ALM8_3" VALUE 0x804F6138 Val_Wu16 65535.00 DFES_OneToOne 0.00 65535.00 FORMAT "%8.2" /end CHARACTERISTIC
/begin CHARACTERISTIC DFC_DisblMsk.DFC_MOXEMM_SMU_ALM8_31_C "disable mask / Disable masks of check DFC_MOXEMM_SMU_ALM8_31" VALUE 0x804F613A Val_Wu16 65535.00 DFES_OneToOne 0.00 65535.00 FORMAT "%8.2" /end CHARACTERISTIC
/begin CHARACTERISTIC DFC_DisblMsk.DFC_MOXEMM_SMU_ALM8_4_C "disable mask / Disable masks of check DFC_MOXEMM_SMU_ALM8_4" VALUE 0x804F613C Val_Wu16 65535.00 DFES_OneToOne 0.00 65535.00 FORMAT "%8.2" /end CHARACTERISTIC
/begin CHARACTERISTIC DFC_DisblMsk.DFC_MOXEMM_SMU_ALM9_0_C "disable mask / Disable masks of check DFC_MOXEMM_SMU_ALM9_0" VALUE 0x804F613E Val_Wu16 65535.00 DFES_OneToOne 0.00 65535.00 FORMAT "%8.2" /end CHARACTERISTIC
/begin CHARACTERISTIC DFC_DisblMsk.DFC_MOXEMM_SMU_ALM9_15_C "disable mask / Disable masks of check DFC_MOXEMM_SMU_ALM9_15" VALUE 0x804F6140 Val_Wu16 65535.00 DFES_OneToOne 0.00 65535.00 FORMAT "%8.2" /end CHARACTERISTIC
/begin CHARACTERISTIC DFC_DisblMsk.DFC_MOXEMM_SMU_ALM9_3_C "disable mask / Disable masks of check DFC_MOXEMM_SMU_ALM9_3" VALUE 0x804F6142 Val_Wu16 65535.00 DFES_OneToOne 0.00 65535.00 FORMAT "%8.2" /end CHARACTERISTIC
/begin CHARACTERISTIC DFC_DisblMsk.DFC_MoCADCNTP_C "disable mask / Disable masks of check DFC_MoCADCNTP" VALUE 0x804F6144 Val_Wu16 65535.00 DFES_OneToOne 0.00 65535.00 FORMAT "%8.2" /end CHARACTERISTIC
/begin CHARACTERISTIC DFC_DisblMsk.DFC_MoCADCTst_C "disable mask / Disable masks of check DFC_MoCADCTst" VALUE 0x804F6146 Val_Wu16 65535.00 DFES_OneToOne 0.00 65535.00 FORMAT "%8.2" /end CHARACTERISTIC
/begin FUNCTION DFC "30000.33.0_1.1.0Diagnostic Fault Check"
 /begin DEF_CHARACTERISTIC DFC_DisblMsk.DFC_AltIOACGFailr_C DFC_DisblMsk.DFC_AltIOACGHiVltg_C DFC_DisblMsk.DFC_AltIOACGLoVltg_C DFC_DisblMsk.DFC_AltIOACGTHi_C DFC_DisblMsk.DFC_AltIODConnACG_C DFC_DisblMsk.DFC_BGOELWAF_C DFC_DisblMsk.DFC_BattUHiFailr_C DFC_DisblMsk.DFC_BattULoFailr_C DFC_DisblMsk.DFC_BrkBstPDriftHiErr_C DFC_DisblMsk.DFC_BrkBstPDriftLoErr_C DFC_DisblMsk.DFC_BrkBstPSnsrStuck_C DFC_DisblMsk.DFC_BrkMnSwtContOn_C DFC_DisblMsk.DFC_BrkMnSwtNotStp_C DFC_DisblMsk.DFC_BrkNpl_C DFC_DisblMsk.DFC_BrkRdntSwtContOn_C DFC_DisblMsk.DFC_BrkRdntSwtNotStp_C DFC_DisblMsk.DFC_Clth3ONStuck_C DFC_DisblMsk.DFC_Clth4OFFStuck_C DFC_DisblMsk.DFC_ClthOFFStuck_C DFC_DisblMsk.DFC_ClthONStuck_C DFC_DisblMsk.DFC_ClthStkFailInfo_C DFC_DisblMsk.DFC_ComACFailInfo_C DFC_DisblMsk.DFC_ComATFTValErr_C DFC_DisblMsk.DFC_ComATMILReq_C DFC_DisblMsk.DFC_ComAYCAChksum_C DFC_DisblMsk.DFC_ComAYCARingCnt_C DFC_DisblMsk.DFC_ComAYCATOut_C DFC_DisblMsk.DFC_ComAYCDChkSum_C DFC_DisblMsk.DFC_ComAYCDTOut_C DFC_DisblMsk.DFC_ComAYCFChksum_C DFC_DisblMsk.DFC_ComAYCFRingCnt_C DFC_DisblMsk.DFC_ComAYCFTOut_C DFC_DisblMsk.DFC_ComAYCGChksum_C DFC_DisblMsk.DFC_ComAYCGRingCnt_C DFC_DisblMsk.DFC_ComAYCGTOut_C DFC_DisblMsk.DFC_ComAYCIChkSum_C DFC_DisblMsk.DFC_ComAYCIRingCnt_C DFC_DisblMsk.DFC_ComAYCITOut_C DFC_DisblMsk.DFC_ComBCM1ChkSum_C DFC_DisblMsk.DFC_ComBCM1RingCnt_C DFC_DisblMsk.DFC_ComBCM1TOut_C DFC_DisblMsk.DFC_ComCANABusOffErr_C DFC_DisblMsk.DFC_ComCANBBusOffErr_C DFC_DisblMsk.DFC_ComCANCBusOffErr_C DFC_DisblMsk.DFC_ComCGW1ChkSum_C DFC_DisblMsk.DFC_ComCGW1RingCnt_C DFC_DisblMsk.DFC_ComCGW1TOut_C DFC_DisblMsk.DFC_ComConvBoostErr_C DFC_DisblMsk.DFC_ComConvSlipErr_C DFC_DisblMsk.DFC_ComDCDCPrfmncErr_C DFC_DisblMsk.DFC_ComDCDCTempWarn_C DFC_DisblMsk.DFC_ComEAT10Chksum_C DFC_DisblMsk.DFC_ComEAT10RingCnt_C DFC_DisblMsk.DFC_ComEAT10TOut_C DFC_DisblMsk.DFC_ComEAT11ChkSum_C DFC_DisblMsk.DFC_ComEAT11RingCnt_C DFC_DisblMsk.DFC_ComEAT11TOut_C DFC_DisblMsk.DFC_ComEAT12ChkSum_C DFC_DisblMsk.DFC_ComEAT12RingCnt_C DFC_DisblMsk.DFC_ComEAT12TOut_C DFC_DisblMsk.DFC_ComEAT13ChkSum_C DFC_DisblMsk.DFC_ComEAT13RingCnt_C DFC_DisblMsk.DFC_ComEAT13TOut_C DFC_DisblMsk.DFC_ComEAT1Chksum_C DFC_DisblMsk.DFC_ComEAT1RingCnt_C DFC_DisblMsk.DFC_ComEAT1TOut_C DFC_DisblMsk.DFC_ComEAT2ChkSum_C DFC_DisblMsk.DFC_ComEAT2RingCnt_C DFC_DisblMsk.DFC_ComEAT2TOut_C DFC_DisblMsk.DFC_ComEAT4ChkSum_C DFC_DisblMsk.DFC_ComEAT4RingCnt_C DFC_DisblMsk.DFC_ComEAT4TOut_C DFC_DisblMsk.DFC_ComEAT6Chksum_C DFC_DisblMsk.DFC_ComEAT6RingCnt_C DFC_DisblMsk.DFC_ComEAT6TOut_C DFC_DisblMsk.DFC_ComEAT7Chksum_C DFC_DisblMsk.DFC_ComEAT7RingCnt_C DFC_DisblMsk.DFC_ComEAT7TOut_C DFC_DisblMsk.DFC_ComEAT8Chksum_C DFC_DisblMsk.DFC_ComEAT8RingCnt_C DFC_DisblMsk.DFC_ComEAT8TOut_C DFC_DisblMsk.DFC_ComEATAChksum_C DFC_DisblMsk.DFC_ComEATARingCnt_C DFC_DisblMsk.DFC_ComEATATOut_C DFC_DisblMsk.DFC_ComEATBChkSum_C DFC_DisblMsk.DFC_ComEATBRingCnt_C DFC_DisblMsk.DFC_ComEATBTOut_C DFC_DisblMsk.DFC_ComEATCChksum_C DFC_DisblMsk.DFC_ComEATCRingCnt_C DFC_DisblMsk.DFC_ComEATCTOut_C DFC_DisblMsk.DFC_ComEPBBChkSum_C DFC_DisblMsk.DFC_ComEPBBRingCnt_C DFC_DisblMsk.DFC_ComEPBBTOut_C DFC_DisblMsk.DFC_ComEPBChksum_C DFC_DisblMsk.DFC_ComEPBTOut_C DFC_DisblMsk.DFC_ComEPBctRing_C DFC_DisblMsk.DFC_ComEPS1Chksum_C DFC_DisblMsk.DFC_ComEPS1RingCnt_C DFC_DisblMsk.DFC_ComEPS1TOut_C DFC_DisblMsk.DFC_ComEngCanRxErr_C DFC_DisblMsk.DFC_ComGrvySnsrErr_C DFC_DisblMsk.DFC_ComGwIMG1ChkSum_C DFC_DisblMsk.DFC_ComGwIMG1RingCnt_C DFC_DisblMsk.DFC_ComGwIMG1TOut_C DFC_DisblMsk.DFC_ComGwIMG3ChkSum_C DFC_DisblMsk.DFC_ComGwIMG3RingCnt_C DFC_DisblMsk.DFC_ComGwIMG3TOut_C DFC_DisblMsk.DFC_ComGwIMG4ChkSum_C DFC_DisblMsk.DFC_ComGwIMG4RingCnt_C DFC_DisblMsk.DFC_ComGwIMG4TOut_C DFC_DisblMsk.DFC_ComGwIMG5ChkSum_C DFC_DisblMsk.DFC_ComGwIMG5RingCnt_C DFC_DisblMsk.DFC_ComGwIMG5TOut_C DFC_DisblMsk.DFC_ComGwIMG6ChkSum_C DFC_DisblMsk.DFC_ComGwIMG6RingCnt_C DFC_DisblMsk.DFC_ComGwIMG6TOut_C DFC_DisblMsk.DFC_ComIDASBChksum_C DFC_DisblMsk.DFC_ComIDASBRingCnt_C DFC_DisblMsk.DFC_ComIDASBTOut_C DFC_DisblMsk.DFC_ComIMGMILReq_C DFC_DisblMsk.DFC_ComISSPrms_C DFC_DisblMsk.DFC_ComMETAChksum_C DFC_DisblMsk.DFC_ComMETAChksumPstDrv_C DFC_DisblMsk.DFC_ComMETARingCnt_C DFC_DisblMsk.DFC_ComMETARingCntPstDrv_C DFC_DisblMsk.DFC_ComMETATOut_C DFC_DisblMsk.DFC_ComMETATOutPstDrv_C DFC_DisblMsk.DFC_ComMETCChksum_C DFC_DisblMsk.DFC_ComMETCRingCnt_C DFC_DisblMsk.DFC_ComMETCTOut_C DFC_DisblMsk.DFC_ComMETDChksum_C DFC_DisblMsk.DFC_ComMETDRingCnt_C DFC_DisblMsk.DFC_ComMETDTOut_C DFC_DisblMsk.DFC_ComMETE2Chksum_C DFC_DisblMsk.DFC_ComMETE2RingCnt_C DFC_DisblMsk.DFC_ComMETE2TOut_C DFC_DisblMsk.DFC_ComMETFChksum_C DFC_DisblMsk.DFC_ComMETFRingCnt_C DFC_DisblMsk.DFC_ComMETFTOut_C DFC_DisblMsk.DFC_ComMETGChksum_C DFC_DisblMsk.DFC_ComMETGRingCnt_C DFC_DisblMsk.DFC_ComMETGTOut_C DFC_DisblMsk.DFC_ComMETH2Chksum_C DFC_DisblMsk.DFC_ComMETH2RingCnt_C DFC_DisblMsk.DFC_ComMETH2TOut_C DFC_DisblMsk.DFC_ComMETHChksum_C DFC_DisblMsk.DFC_ComMETHRingCnt_C DFC_DisblMsk.DFC_ComMETHTOut_C DFC_DisblMsk.DFC_ComMETIChksum_C DFC_DisblMsk.DFC_ComMETIRingCnt_C DFC_DisblMsk.DFC_ComMETITOut_C DFC_DisblMsk.DFC_ComMETKChksum_C DFC_DisblMsk.DFC_ComMETKRingCnt_C DFC_DisblMsk.DFC_ComMETKTOut_C DFC_DisblMsk.DFC_ComMETLChksum_C DFC_DisblMsk.DFC_ComMETLRingCnt_C DFC_DisblMsk.DFC_ComMETLTOut_C DFC_DisblMsk.DFC_ComMETMChksum_C DFC_DisblMsk.DFC_ComMETMRingCnt_C DFC_DisblMsk.DFC_ComMETMTOut_C DFC_DisblMsk.DFC_ComMETNChksum_C DFC_DisblMsk.DFC_ComMETNRingCnt_C DFC_DisblMsk.DFC_ComMETNTOut_C DFC_DisblMsk.DFC_ComMtrCom_C DFC_DisblMsk.DFC_ComPCUChkSum_C DFC_DisblMsk.DFC_ComPCURingCnt_C DFC_DisblMsk.DFC_ComPCUTOut_C DFC_DisblMsk.DFC_ComSRSAChksum_C DFC_DisblMsk.DFC_ComSRSARingCnt_C DFC_DisblMsk.DFC_ComSRSATOut_C DFC_DisblMsk.DFC_ComSRSBChksum_C DFC_DisblMsk.DFC_ComSRSBRingCnt_C DFC_DisblMsk.DFC_ComSRSBTOut_C DFC_DisblMsk.DFC_ComSRSChksum_C DFC_DisblMsk.DFC_ComSRSErr_C DFC_DisblMsk.DFC_ComSRSRingCnt_C DFC_DisblMsk.DFC_ComSRSTOut_C DFC_DisblMsk.DFC_ComVehSpdPndFltTCU_C DFC_DisblMsk.DFC_EbsChartcCurrErr_C DFC_DisblMsk.DFC_EbsSelfDiagErr_C DFC_DisblMsk.DFC_GEVlvPhaCsersIntkB1_C DFC_DisblMsk.DFC_GEVlvPhaPsOpenLoadIntkB1_C DFC_DisblMsk.DFC_GEVlvPhaPsShoToBattIntkB1_C DFC_DisblMsk.DFC_GEVlvPhaPsShoToGndIntkB1_C DFC_DisblMsk.DFC_GbxCANDigPlausErr_C DFC_DisblMsk.DFC_GbxNPos1SRCMax_C DFC_DisblMsk.DFC_GbxNPos1SRCMin_C DFC_DisblMsk.DFC_GbxNPos2SRCMax_C DFC_DisblMsk.DFC_GbxNPos2SRCMin_C DFC_DisblMsk.DFC_GbxNPosAlvChk_C DFC_DisblMsk.DFC_GbxNPosSyncErr_C DFC_DisblMsk.DFC_HEGOS2B1HtrPsMax_C DFC_DisblMsk.DFC_HEGOS2B1HtrPsMin_C DFC_DisblMsk.DFC_HEGOS2B1HtrPsSig_C DFC_DisblMsk.DFC_LinCSErrACG_C DFC_DisblMsk.DFC_LinCSErrAEV_C DFC_DisblMsk.DFC_LinCSErrDCDC_C DFC_DisblMsk.DFC_LinCSErrEBS_C DFC_DisblMsk.DFC_LinHdrTimeoutErrACG_C DFC_DisblMsk.DFC_LinHdrTimeoutErrAEV_C DFC_DisblMsk.DFC_LinHdrTimeoutErrDCDC_C DFC_DisblMsk.DFC_LinHdrTimeoutErrEBS_C DFC_DisblMsk.DFC_LinMsgTimeoutErrACG_C DFC_DisblMsk.DFC_LinMsgTimeoutErrAEV_C DFC_DisblMsk.DFC_LinMsgTimeoutErrDCDC_C DFC_DisblMsk.DFC_LinMsgTimeoutErrEBS_C DFC_DisblMsk.DFC_LinNoStrtComErr_C DFC_DisblMsk.DFC_LowPresOilP_C DFC_DisblMsk.DFC_MisfDetVWhlFrntLeOORHi_C DFC_DisblMsk.DFC_MisfDetVWhlFrntLeRatyHi_C DFC_DisblMsk.DFC_MisfDetVWhlFrntLeRatyLo_C DFC_DisblMsk.DFC_MisfDetVWhlFrntLeStuck_C DFC_DisblMsk.DFC_MisfDetVWhlFrntRiOORHi_C DFC_DisblMsk.DFC_MisfDetVWhlFrntRiRatyHi_C DFC_DisblMsk.DFC_MisfDetVWhlFrntRiRatyLo_C DFC_DisblMsk.DFC_MisfDetVWhlFrntRiStuck_C DFC_DisblMsk.DFC_MisfDetVWhlReLeOORHi_C DFC_DisblMsk.DFC_MisfDetVWhlReLeRatyHi_C DFC_DisblMsk.DFC_MisfDetVWhlReLeRatyLo_C DFC_DisblMsk.DFC_MisfDetVWhlReLeStuck_C DFC_DisblMsk.DFC_MisfDetVWhlReRiOORHi_C DFC_DisblMsk.DFC_MisfDetVWhlReRiRatyHi_C DFC_DisblMsk.DFC_MisfDetVWhlReRiRatyLo_C DFC_DisblMsk.DFC_MisfDetVWhlReRiStuck_C DFC_DisblMsk.DFC_MisfDetdVWhlFrntLePlaus_C DFC_DisblMsk.DFC_MisfDetdVWhlFrntRiPlaus_C DFC_DisblMsk.DFC_MisfDetdVWhlReLePlaus_C DFC_DisblMsk.DFC_MisfDetdVWhlReRiPlaus_C DFC_DisblMsk.DFC_PEnvSigRngMax_C DFC_DisblMsk.DFC_PEnvSigRngMin_C DFC_DisblMsk.DFC_StmFault_C DFC_DisblMsk.DFC_StrtCtOffPth_C DFC_DisblMsk.DFC_StrtCtlErr_C DFC_DisblMsk.DFC_StrtFault_C DFC_DisblMsk.DFC_StrtLckJudg1_C DFC_DisblMsk.DFC_StrtLckJudg2_C DFC_DisblMsk.DFC_StrtOL_C DFC_DisblMsk.DFC_StrtOL2_C DFC_DisblMsk.DFC_StrtSCB_C DFC_DisblMsk.DFC_StrtSCB2_C DFC_DisblMsk.DFC_StrtSCG_C DFC_DisblMsk.DFC_StrtSCG2_C DFC_DisblMsk.DFC_StrtStkRly1_C DFC_DisblMsk.DFC_StrtStkRly2_C DFC_DisblMsk.DFC_TEVEmax_C DFC_DisblMsk.DFC_TEVEmin_C DFC_DisblMsk.DFC_TEVEsig_C DFC_DisblMsk.DFC_UegoHeatrPrfmncLoS1B1_C DFC_DisblMsk.DFC_VehVAllPlaus_C DFC_DisblMsk.DFC_VehVNCSnsrElecFailr_C DFC_DisblMsk.DFC_VehVPlausCan_C DFC_DisblMsk.DFC_VehVPlausFco_C DFC_DisblMsk.DFC_VehVPlausPwr_C DFC_DisblMsk.DFC_VehVPlausV2N_C DFC_DisblMsk.DFC_VehVSpdSnsrAElecFailr_C DFC_DisblMsk.DFC_VehVSpdSnsrBElecFailr_C DFC_DisblMsk.DFC_ClthMax_C DFC_DisblMsk.DFC_IgnClPs_DevComErr_C DFC_DisblMsk.DFC_IgnClPs_LineOl_0_C DFC_DisblMsk.DFC_IgnClPs_LineOl_1_C DFC_DisblMsk.DFC_IgnClPs_LineOl_2_C DFC_DisblMsk.DFC_IgnClPs_LineOl_3_C DFC_DisblMsk.DFC_IgnClPs_LineScb_0_C DFC_DisblMsk.DFC_IgnClPs_LineScb_1_C DFC_DisblMsk.DFC_IgnClPs_LineScb_2_C DFC_DisblMsk.DFC_IgnClPs_LineScb_3_C DFC_DisblMsk.DFC_IgnClPs_LineScg_0_C DFC_DisblMsk.DFC_IgnClPs_LineScg_1_C DFC_DisblMsk.DFC_IgnClPs_LineScg_2_C DFC_DisblMsk.DFC_IgnClPs_LineScg_3_C DFC_DisblMsk.DFC_KRVEKOEVAB_C DFC_DisblMsk.DFC_KRVEKOEVAB0_C DFC_DisblMsk.DFC_KRVEKOEVAB1_C DFC_DisblMsk.DFC_KRVEKOEVAB2_C DFC_DisblMsk.DFC_KRVEKOEVAB3_C DFC_DisblMsk.DFC_UegoSigEcuAsicS1B1_C DFC_DisblMsk.DFC_UegoSigEcuComS1B1_C DFC_DisblMsk.DFC_UegoSigSnsrS1B1_C DFC_DisblMsk.DFC_UegoSigWireOlApesS1B1_C DFC_DisblMsk.DFC_UegoSigWireOlIpeS1B1_C DFC_DisblMsk.DFC_UegoSigWireOlReS1B1_C DFC_DisblMsk.DFC_UegoSigWireRCmpS1B1_C DFC_DisblMsk.DFC_UegoSigWireScbS1B1_C DFC_DisblMsk.DFC_UegoSigWireScgS1B1_C DFC_DisblMsk.DFC_AfsPhyRngHiB1_C DFC_DisblMsk.DFC_AfsPhyRngLoB1_C DFC_DisblMsk.DFC_AirCCmprOL_C DFC_DisblMsk.DFC_AirCCmprOvrTemp_C DFC_DisblMsk.DFC_AirCCmprSCB_C DFC_DisblMsk.DFC_AirCCmprSCG_C DFC_DisblMsk.DFC_AltErr_C DFC_DisblMsk.DFC_BattUSRCMax_C DFC_DisblMsk.DFC_BattUSRCMin_C DFC_DisblMsk.DFC_ComChksTCU1_C DFC_DisblMsk.DFC_ComChksTCU11_C DFC_DisblMsk.DFC_ComChksTCU12_C DFC_DisblMsk.DFC_ComChksTCU13_C DFC_DisblMsk.DFC_ComChksTCU2_C DFC_DisblMsk.DFC_ComChksTCU3_C DFC_DisblMsk.DFC_ComChksTCU4_C DFC_DisblMsk.DFC_ComCntTCU1_C DFC_DisblMsk.DFC_ComCntTCU11_C DFC_DisblMsk.DFC_ComCntTCU12_C DFC_DisblMsk.DFC_ComCntTCU13_C DFC_DisblMsk.DFC_ComCntTCU2_C DFC_DisblMsk.DFC_ComCntTCU3_C DFC_DisblMsk.DFC_ComCntTCU4_C DFC_DisblMsk.DFC_ComTOutTCU01_C DFC_DisblMsk.DFC_ComTOutTCU02_C DFC_DisblMsk.DFC_ComTOutTCU1_C DFC_DisblMsk.DFC_ComTOutTCU11_C DFC_DisblMsk.DFC_ComTOutTCU12_C DFC_DisblMsk.DFC_ComTOutTCU13_C DFC_DisblMsk.DFC_ComTOutTCU14_C DFC_DisblMsk.DFC_ComTOutTCU2_C DFC_DisblMsk.DFC_ComTOutTCU3_C DFC_DisblMsk.DFC_ComTOutTCU4_C DFC_DisblMsk.DFC_DevLibBattUHi_C DFC_DisblMsk.DFC_DevLibBattULo_C DFC_DisblMsk.DFC_EGRVlvFailSafeActv_C DFC_DisblMsk.DFC_EGRVlvGovDvtCld_C DFC_DisblMsk.DFC_EGRVlvPhysSRCMax_C DFC_DisblMsk.DFC_EGRVlvPhysSRCMin_C DFC_DisblMsk.DFC_FanDIOOL_0_C DFC_DisblMsk.DFC_FanDIOOL_1_C DFC_DisblMsk.DFC_FanDIOOvrTemp_0_C DFC_DisblMsk.DFC_FanDIOOvrTemp_1_C DFC_DisblMsk.DFC_FanDIOSCB_0_C DFC_DisblMsk.DFC_FanDIOSCB_1_C DFC_DisblMsk.DFC_FanDIOSCG_0_C DFC_DisblMsk.DFC_FanDIOSCG_1_C DFC_DisblMsk.DFC_MRlyDcOL_C DFC_DisblMsk.DFC_MRlyDcSCB_C DFC_DisblMsk.DFC_MRlyDcSCG_C DFC_DisblMsk.DFC_PSPOL_C DFC_DisblMsk.DFC_PSPOvrTemp_C DFC_DisblMsk.DFC_PSPSCB_C DFC_DisblMsk.DFC_PSPSCG_C DFC_DisblMsk.DFC_T50Err_C DFC_DisblMsk.DFC_ThrVlvLoBattB1_C DFC_DisblMsk.DFC_UegoSigOperPlausS1B1_C DFC_DisblMsk.DFC_VehVPhysRngHi_C DFC_DisblMsk.DFC_VehVSclOutOL_C DFC_DisblMsk.DFC_VehVSclOutOT_C DFC_DisblMsk.DFC_VehVSclOutSCB_C DFC_DisblMsk.DFC_VehVSclOutSCG_C DFC_DisblMsk.DFC_VehVSigFL_C DFC_DisblMsk.DFC_VehVSigFR_C DFC_DisblMsk.DFC_VehVSigRL_C DFC_DisblMsk.DFC_VehVSigRR_C DFC_DisblMsk.DFC_VehVSnsrARngHi_C DFC_DisblMsk.DFC_VehVSnsrBRngHi_C DFC_DisblMsk.DFC_VehVSpdRtyDiag_C DFC_DisblMsk.DFC_DHFHD_C DFC_DisblMsk.DFC_InjVlv_DI_DcDc_C DFC_DisblMsk.DFC_InjVlv_DI_NoLd_0_C DFC_DisblMsk.DFC_InjVlv_DI_NoLd_1_C DFC_DisblMsk.DFC_InjVlv_DI_NoLd_2_C DFC_DisblMsk.DFC_InjVlv_DI_NoLd_3_C DFC_DisblMsk.DFC_InjVlv_DI_ScBnk_0_C DFC_DisblMsk.DFC_InjVlv_DI_ScBnk_1_C DFC_DisblMsk.DFC_InjVlv_DI_ScBnk_2_C DFC_DisblMsk.DFC_InjVlv_DI_ScBnk_3_C DFC_DisblMsk.DFC_InjVlv_DI_ScCyl_0_C DFC_DisblMsk.DFC_InjVlv_DI_ScCyl_1_C DFC_DisblMsk.DFC_InjVlv_DI_ScCyl_2_C DFC_DisblMsk.DFC_InjVlv_DI_ScCyl_3_C DFC_DisblMsk.DFC_InjVlv_DI_ScHsLs_0_C DFC_DisblMsk.DFC_InjVlv_DI_ScHsLs_1_C DFC_DisblMsk.DFC_InjVlv_DI_ScHsLs_2_C DFC_DisblMsk.DFC_InjVlv_DI_ScHsLs_3_C DFC_DisblMsk.DFC_MfPsDiaOpenLoad1_C DFC_DisblMsk.DFC_MfPsDiaScHiS1_C DFC_DisblMsk.DFC_MfPsDiaScHiSLowS1_C DFC_DisblMsk.DFC_MfPsDiaScLowS1_C DFC_DisblMsk.DFC_ACEvpTPhysRngHi_C DFC_DisblMsk.DFC_ACEvpTPhysRngLo_C DFC_DisblMsk.DFC_ACEvpTSRCMax_C DFC_DisblMsk.DFC_ACEvpTSRCMin_C DFC_DisblMsk.DFC_AfsRawSigRngHiB1_C DFC_DisblMsk.DFC_AfsRawSigRngLoB1_C DFC_DisblMsk.DFC_AfsSnsrErrB1_C DFC_DisblMsk.DFC_AirCClntPAnaSRCMax_C DFC_DisblMsk.DFC_AirCClntPAnaSRCMin_C DFC_DisblMsk.DFC_AirCSwtNpl_C DFC_DisblMsk.DFC_AirCSwtSig_C DFC_DisblMsk.DFC_Brk_C DFC_DisblMsk.DFC_BrkBstSensSCB_C DFC_DisblMsk.DFC_BrkBstSensSCG_C DFC_DisblMsk.DFC_BrkSig_C DFC_DisblMsk.DFC_ClthSig_C DFC_DisblMsk.DFC_EGRVlvCurrLim_C DFC_DisblMsk.DFC_EGRVlvOL_C DFC_DisblMsk.DFC_EGRVlvOvrTemp_C DFC_DisblMsk.DFC_EGRVlvSCB_C DFC_DisblMsk.DFC_EGRVlvSCG_C DFC_DisblMsk.DFC_EGRVlvSRCMax_C DFC_DisblMsk.DFC_EGRVlvSRCMin_C DFC_DisblMsk.DFC_HLSDemOvhtEngLim_C DFC_DisblMsk.DFC_OilPSwmpSRCMax_C DFC_DisblMsk.DFC_OilPSwmpSRCMin_C DFC_DisblMsk.DFC_PIntkVUsLineHiB1_C DFC_DisblMsk.DFC_PIntkVUsLineLoB1_C DFC_DisblMsk.DFC_VehVPhysRngLo_C DFC_DisblMsk.DFC_VehVSigCan_C DFC_DisblMsk.DFC_VehVSigCanSafe_C DFC_DisblMsk.DFC_VlvLftFbOilPSnsrIntk11SRCMax_C DFC_DisblMsk.DFC_VlvLftFbOilPSnsrIntk11SRCMin_C DFC_DisblMsk.DFC_ClthNpl_C DFC_DisblMsk.DFC_GbxPNPosnDrvCdn_C DFC_DisblMsk.DFC_GbxPNPosnPlausy_C DFC_DisblMsk.DFC_AfsSigErrLineHiB1_C DFC_DisblMsk.DFC_AfsSigErrLineLoB1_C DFC_DisblMsk.DFC_PEnvCcMax_C DFC_DisblMsk.DFC_PEnvCcMin_C DFC_DisblMsk.DFC_PEnvRngChkMax_C DFC_DisblMsk.DFC_PEnvRngChkMin_C DFC_DisblMsk.DFC_PEnvSnsrPlaus_C DFC_DisblMsk.DFC_UEGOHeatrRlyPsOLS1B1_C DFC_DisblMsk.DFC_UEGOHeatrRlyPsSCBS1B1_C DFC_DisblMsk.DFC_UEGOHeatrRlyPsSCGS1B1_C DFC_DisblMsk.DFC_UegoHeatrWireOlS1B1_C DFC_DisblMsk.DFC_UegoHeatrWireScbS1B1_C DFC_DisblMsk.DFC_UegoHeatrWireScgS1B1_C DFC_DisblMsk.DFC_KnDetSens1PortAMax_C DFC_DisblMsk.DFC_KnDetSens1PortAMin_C DFC_DisblMsk.DFC_KnDetSens1PortBMax_C DFC_DisblMsk.DFC_KnDetSens1PortBMin_C DFC_DisblMsk.DFC_Clth2ONStuck_C DFC_DisblMsk.DFC_Clth2ONStuckLdc_C DFC_DisblMsk.DFC_Clth3ONStuckLdc_C DFC_DisblMsk.DFC_Clth3ONStuckPostDrv_C DFC_DisblMsk.DFC_Clth4ONStuck_C DFC_DisblMsk.DFC_Clth4ONStuckLdc_C DFC_DisblMsk.DFC_ComBCMUnit_C DFC_DisblMsk.DFC_ComDLCTCU01_C DFC_DisblMsk.DFC_ComDLCTCU02_C DFC_DisblMsk.DFC_ComDLCTCU1_C DFC_DisblMsk.DFC_ComDLCTCU11_C DFC_DisblMsk.DFC_ComDLCTCU12_C DFC_DisblMsk.DFC_ComDLCTCU13_C DFC_DisblMsk.DFC_ComDLCTCU14_C DFC_DisblMsk.DFC_ComDLCTCU2_C DFC_DisblMsk.DFC_ComDLCTCU3_C DFC_DisblMsk.DFC_ComDLCTCU4_C DFC_DisblMsk.DFC_ComEPSUnit_C DFC_DisblMsk.DFC_ComIDASBUnit_C DFC_DisblMsk.DFC_ComIMGUnit_C DFC_DisblMsk.DFC_ComMETUnit_C DFC_DisblMsk.DFC_ComSRSUnit_C DFC_DisblMsk.DFC_ComVSAUnit_C DFC_DisblMsk.DFC_EbsSocFlt_C DFC_DisblMsk.DFC_I14229VINErr_C DFC_DisblMsk.DFC_InjCatHeatgErr_C DFC_DisblMsk.DFC_InjSysMulInjDiagErr_C DFC_DisblMsk.DFC_LLRHmax_C DFC_DisblMsk.DFC_LLRHmin_C DFC_DisblMsk.DFC_LLRHnpl_C DFC_DisblMsk.DFC_LLRKHmax_C DFC_DisblMsk.DFC_LLRKHmin_C DFC_DisblMsk.DFC_LLRKHnpl_C DFC_DisblMsk.DFC_LinACGUnit_C DFC_DisblMsk.DFC_LinAEVUnit_C DFC_DisblMsk.DFC_LinEBSUnit_C DFC_DisblMsk.DFC_RoughRoad_C DFC_DisblMsk.DFC_SiaEEPRdErr_C DFC_DisblMsk.DFC_SiaEEPWrngCod_C DFC_DisblMsk.DFC_UegoHeatrStrtS1B1_C DFC_DisblMsk.DFC_BusDiagCANAPPLBusOff_C DFC_DisblMsk.DFC_BusDiagCANCANCBusOff_C DFC_DisblMsk.DFC_BusDiagCANVEHICLEBusOff_C DFC_DisblMsk.DFC_RBA_IODIAGPWR_rba_IoExtCy329_SignalVltSply_0_C DFC_DisblMsk.DFC_RBA_IODIAGPWR_rba_IoExtCy329_SignalVltSply_0OT_C DFC_DisblMsk.DFC_RBA_IODIAGPWR_rba_IoExtCy329_SignalVltSply_0OV_C DFC_DisblMsk.DFC_RBA_IODIAGPWR_rba_IoExtCy329_SignalVltSply_0SCG_C DFC_DisblMsk.DFC_RBA_IODIAGPWR_rba_IoExtCy329_SignalVltSply_0UV_C DFC_DisblMsk.DFC_RBA_IODIAGPWR_rba_IoExtCy329_SignalVltSply_1_C DFC_DisblMsk.DFC_RBA_IODIAGPWR_rba_IoExtCy329_SignalVltSply_1OT_C DFC_DisblMsk.DFC_RBA_IODIAGPWR_rba_IoExtCy329_SignalVltSply_1OV_C DFC_DisblMsk.DFC_RBA_IODIAGPWR_rba_IoExtCy329_SignalVltSply_1SCG_C DFC_DisblMsk.DFC_RBA_IODIAGPWR_rba_IoExtCy329_SignalVltSply_1UV_C DFC_DisblMsk.DFC_RBA_IODIAGPWR_rba_IoExtCy329_SignalVltSply_2_C DFC_DisblMsk.DFC_RBA_IODIAGPWR_rba_IoExtCy329_SignalVltSply_2OT_C DFC_DisblMsk.DFC_RBA_IODIAGPWR_rba_IoExtCy329_SignalVltSply_2OV_C DFC_DisblMsk.DFC_RBA_IODIAGPWR_rba_IoExtCy329_SignalVltSply_2SCG_C DFC_DisblMsk.DFC_RBA_IODIAGPWR_rba_IoExtCy329_SignalVltSply_2UV_C DFC_DisblMsk.DFC_CAN_E_TIMEOUT_C DFC_DisblMsk.DFC_LIN_E_TIMEOUT_C DFC_DisblMsk.DFC_MRlyOL_C DFC_DisblMsk.DFC_MRlySCB_C DFC_DisblMsk.DFC_MRlySCG_C DFC_DisblMsk.DFC_rba_MultiStackTrace_Threshold_C DFC_DisblMsk.DFC_BSWM_E_ACTION_FAILED_C DFC_DisblMsk.DFC_BSWM_E_INTRPTQUEUE_FULL_C DFC_DisblMsk.DFC_RBA_IOEXTLIB_KEEPALIVE_DRV_C DFC_DisblMsk.DFC_RBA_IOEXTLIB_KEEPALIVE_INI_C DFC_DisblMsk.DFC_rba_IoSigRtc_StopCounter_C DFC_DisblMsk.DFC_rba_MRly_Diag_Stk_Event_C DFC_DisblMsk.DFC_rba_MemDiag_MemReadErr_C DFC_DisblMsk.DFC_rba_MemDiag_MemWrErr_C DFC_DisblMsk.DFC_rba_SyC_IrrSwOffTrigEngRun_Event_C DFC_DisblMsk.DFC_rba_T15_Diag_ComInVld_Event_C DFC_DisblMsk.DFC_rba_T15_Diag_ComOff_HwOn_Event_C DFC_DisblMsk.DFC_rba_T15_Diag_ComOn_HwOff_Event_C DFC_DisblMsk.DFC_AAVmin_C DFC_DisblMsk.DFC_AGRSUS_C DFC_DisblMsk.DFC_AfsPlausDiagHi_C DFC_DisblMsk.DFC_AfsPlausDiagLo_C DFC_DisblMsk.DFC_AfsVrntDiagErrB1_C DFC_DisblMsk.DFC_AppAllSnsrDfct_C DFC_DisblMsk.DFC_BBKRnldg_C DFC_DisblMsk.DFC_BBKRsyne_C DFC_DisblMsk.DFC_BattUStdbyDiaOL_C DFC_DisblMsk.DFC_BigLeakIntkMnfldEmiInfl_C DFC_DisblMsk.DFC_BlkdLineTank_C DFC_DisblMsk.DFC_BrkMnSwtContOnWarnLmp_C DFC_DisblMsk.DFC_BrkMnSwtNotStpWarnLmp_C DFC_DisblMsk.DFC_BrkRdntSwtContOnWarnLmp_C DFC_DisblMsk.DFC_BrkRdntSwtNotStpWarnLmp_C DFC_DisblMsk.DFC_CEngDsTColdStrtMax_C DFC_DisblMsk.DFC_CEngDsTColdStrtMin_C DFC_DisblMsk.DFC_CEngDsTImps_C DFC_DisblMsk.DFC_CEngDsTPlausHSC_C DFC_DisblMsk.DFC_CEngDsTPlausLSC_C DFC_DisblMsk.DFC_CEngDsTPlausSTC_C DFC_DisblMsk.DFC_CEngDsTSRCMax_C DFC_DisblMsk.DFC_CEngDsTSRCMin_C DFC_DisblMsk.DFC_CEngDsTSig_C DFC_DisblMsk.DFC_CEngUsTColdStrtMax_C DFC_DisblMsk.DFC_CEngUsTColdStrtMin_C DFC_DisblMsk.DFC_CEngUsTLooseCnctn_C DFC_DisblMsk.DFC_CEngUsTSRCMax_C DFC_DisblMsk.DFC_CEngUsTSRCMin_C DFC_DisblMsk.DFC_ComDCDCACCFailr_C DFC_DisblMsk.DFC_DCDCFltDet_C DFC_DisblMsk.DFC_DKRSA_C DFC_DisblMsk.DFC_DKVSmax_C DFC_DisblMsk.DFC_DKnpl_C DFC_DisblMsk.DFC_DSKVRmax_C DFC_DisblMsk.DFC_DSKVRmin_C DFC_DisblMsk.DFC_DSKVRnpl_C DFC_DisblMsk.DFC_DSKVRsig_C DFC_DisblMsk.DFC_DSKVSsig_C DFC_DisblMsk.DFC_DSSmax_C DFC_DisblMsk.DFC_DSTDmax_C DFC_DisblMsk.DFC_DSTEmax_C DFC_DisblMsk.DFC_DSTEmin_C DFC_DisblMsk.DFC_DSTOFmax_C DFC_DisblMsk.DFC_DSTRmax_C DFC_DisblMsk.DFC_DSTRmin_C DFC_DisblMsk.DFC_DSTRnpl_C DFC_DisblMsk.DFC_DSTRsig_C DFC_DisblMsk.DFC_DSTTI_C DFC_DisblMsk.DFC_DSUmax_C DFC_DisblMsk.DFC_DiagCpv1DteskLoLoadStuckClsd_C DFC_DisblMsk.DFC_DiagCpv1DteskLoLoadStuckOpen_C DFC_DisblMsk.DFC_EGRVlvDrftClsd_C DFC_DisblMsk.DFC_EGRVlvDrftOpn_C DFC_DisblMsk.DFC_EGRVlvJamVlvClsd_C DFC_DisblMsk.DFC_EGRVlvJamVlvOpn_C DFC_DisblMsk.DFC_EGRVlvSprgBrk_C DFC_DisblMsk.DFC_EGRVlvTempMdlEEPErr_C DFC_DisblMsk.DFC_EGRVlvTmpErr_C DFC_DisblMsk.DFC_EGSDUS2B1LtrDly_C DFC_DisblMsk.DFC_EGSDUS2B1LtrPT1_C DFC_DisblMsk.DFC_EGSDUS2B1RtlDly_C DFC_DisblMsk.DFC_EGSDUS2B1RtlPT1_C DFC_DisblMsk.DFC_EGSDUS2B1TarLean_C DFC_DisblMsk.DFC_EGSDUS2B1TarRich_C DFC_DisblMsk.DFC_EONVmax_C DFC_DisblMsk.DFC_ETAKHLmax_C DFC_DisblMsk.DFC_ETAKHTmax_C DFC_DisblMsk.DFC_ETHSEmax_C DFC_DisblMsk.DFC_ETHSEmin_C DFC_DisblMsk.DFC_ETHSFmax_C DFC_DisblMsk.DFC_ETHSFmin_C DFC_DisblMsk.DFC_ETHSFsig_C DFC_DisblMsk.DFC_ETHSNPWmax_C DFC_DisblMsk.DFC_ETHSNPWmin_C DFC_DisblMsk.DFC_ETHSNPWsig_C DFC_DisblMsk.DFC_ETHSPLnpl_C DFC_DisblMsk.DFC_ETHSTPLnpl_C DFC_DisblMsk.DFC_EngICO_C DFC_DisblMsk.DFC_EngPrtOvrSpdMon_C DFC_DisblMsk.DFC_EpmCaSI1ErrSig_C DFC_DisblMsk.DFC_EpmCaSI1MntErr_C DFC_DisblMsk.DFC_EpmCaSI1NoSigMax_C DFC_DisblMsk.DFC_EpmCaSI1NoSigMin_C DFC_DisblMsk.DFC_EpmCaSI1OfsErr_C DFC_DisblMsk.DFC_EpmCrSDGI_C DFC_DisblMsk.DFC_EpmCrSErrSig_C DFC_DisblMsk.DFC_EpmCrSNoSig_C DFC_DisblMsk.DFC_EtaEngIdleNonCsers_C DFC_DisblMsk.DFC_EtaEngPtlNonCsers_C DFC_DisblMsk.DFC_FRAmax_C DFC_DisblMsk.DFC_FRAmin_C DFC_DisblMsk.DFC_FSTEmax_C DFC_DisblMsk.DFC_FSTEmin_C DFC_DisblMsk.DFC_FSTRmax_C DFC_DisblMsk.DFC_FSTRmin_C DFC_DisblMsk.DFC_FSTRnpl_C DFC_DisblMsk.DFC_FSTmax_C DFC_DisblMsk.DFC_FTDLAmax_C DFC_DisblMsk.DFC_FTDLAmin_C DFC_DisblMsk.DFC_FuPHiSnsrEleclmax_C DFC_DisblMsk.DFC_FuPHiSnsrEleclmin_C DFC_DisblMsk.DFC_FuPHiSnsrEleclnpl_C DFC_DisblMsk.DFC_FuPHiSnsrURngMax_C DFC_DisblMsk.DFC_FuPHiSnsrURngMin_C DFC_DisblMsk.DFC_FuSnsrPhyRngMaxErr_C DFC_DisblMsk.DFC_FuSnsrPhyRngMinErr_C DFC_DisblMsk.DFC_GEVlvLockPinDiagIntkB1_C DFC_DisblMsk.DFC_GEVlvPhaSlowIntkB1_C DFC_DisblMsk.DFC_GEVlvPhaTargIntkB1_C DFC_DisblMsk.DFC_GbxRvsSwtStk_C DFC_DisblMsk.DFC_HDRKHmax_C DFC_DisblMsk.DFC_HDRKHmin_C DFC_DisblMsk.DFC_HDRPLmax_C DFC_DisblMsk.DFC_HDRPLmin_C DFC_DisblMsk.DFC_HDRmax_C DFC_DisblMsk.DFC_HDRmin_C DFC_DisblMsk.DFC_HEGOS2B1ElecMax_C DFC_DisblMsk.DFC_HEGOS2B1ElecMin_C DFC_DisblMsk.DFC_HEGOS2B1ElecSig_C DFC_DisblMsk.DFC_HEGOS2B1HtgNpl_C DFC_DisblMsk.DFC_HEV00max_C DFC_DisblMsk.DFC_HEV01max_C DFC_DisblMsk.DFC_HEV02max_C DFC_DisblMsk.DFC_HEV03max_C DFC_DisblMsk.DFC_HEVE0max_C DFC_DisblMsk.DFC_HEVE1max_C DFC_DisblMsk.DFC_HFMmax_C DFC_DisblMsk.DFC_HiPSysHiPMaxLimExcdd_C DFC_DisblMsk.DFC_IVGdiCtlCvoErrMax_0_C DFC_DisblMsk.DFC_IVGdiCtlCvoErrMax_1_C DFC_DisblMsk.DFC_IVGdiCtlCvoErrMax_2_C DFC_DisblMsk.DFC_IVGdiCtlCvoErrMax_3_C DFC_DisblMsk.DFC_IVGdiCtlCvoErrMin_0_C DFC_DisblMsk.DFC_IVGdiCtlCvoErrMin_1_C DFC_DisblMsk.DFC_IVGdiCtlCvoErrMin_2_C DFC_DisblMsk.DFC_IVGdiCtlCvoErrMin_3_C DFC_DisblMsk.DFC_IVGdiCtlCvoErrMinMax_C DFC_DisblMsk.DFC_IVGdiCtlCvoSigPlausErrSmrCdn_C DFC_DisblMsk.DFC_IVGdiCtl_CvoErr_C DFC_DisblMsk.DFC_IVGdiCtl_CvoSigPlaus_0_C DFC_DisblMsk.DFC_IVGdiCtl_CvoSigPlaus_1_C DFC_DisblMsk.DFC_IVGdiCtl_CvoSigPlaus_2_C DFC_DisblMsk.DFC_IVGdiCtl_CvoSigPlaus_3_C DFC_DisblMsk.DFC_IntkAirTAirFltDsCrssMax_C DFC_DisblMsk.DFC_IntkAirTAirFltDsCrssMin_C DFC_DisblMsk.DFC_IntkAirTAirFltDsHSCMax_C DFC_DisblMsk.DFC_IntkAirTAirFltDsImps_C DFC_DisblMsk.DFC_IntkAirTAirFltDsPRCMax_C DFC_DisblMsk.DFC_IntkAirTAirFltDsPRCMin_C DFC_DisblMsk.DFC_IntkAirTAirFltDsSRCMax_C DFC_DisblMsk.DFC_IntkAirTAirFltDsSRCMin_C DFC_DisblMsk.DFC_IntkAirTAirFltDsSTC_C DFC_DisblMsk.DFC_IntkAirTIntkMnfldCrssMax_C DFC_DisblMsk.DFC_IntkAirTIntkMnfldCrssMin_C DFC_DisblMsk.DFC_IntkAirTIntkMnfldHSCMax_C DFC_DisblMsk.DFC_IntkAirTIntkMnfldImps_C DFC_DisblMsk.DFC_IntkAirTIntkMnfldPRCMax_C DFC_DisblMsk.DFC_IntkAirTIntkMnfldPRCMin_C DFC_DisblMsk.DFC_IntkAirTIntkMnfldSRCMax_C DFC_DisblMsk.DFC_IntkAirTIntkMnfldSRCMin_C DFC_DisblMsk.DFC_IntkAirTIntkMnfldSTC_C DFC_DisblMsk.DFC_KRREGRLMX_C DFC_DisblMsk.DFC_KRVEKOCVLCI_C DFC_DisblMsk.DFC_KRVEKOENCHMT_C DFC_DisblMsk.DFC_KRVEKOENCHMT0_C DFC_DisblMsk.DFC_KRVEKOENCHMT1_C DFC_DisblMsk.DFC_KRVEKOENCHMT2_C DFC_DisblMsk.DFC_KRVEKOENCHMT3_C DFC_DisblMsk.DFC_KRVEKOENCHMT4_C DFC_DisblMsk.DFC_KRVEKOENCHMT5_C DFC_DisblMsk.DFC_KRVEKOENCHMT6_C DFC_DisblMsk.DFC_KRVEKOENCHMT7_C DFC_DisblMsk.DFC_KRVEKORLMX_C DFC_DisblMsk.DFC_KRVEKORLMXL_C DFC_DisblMsk.DFC_KS1max_C DFC_DisblMsk.DFC_KS1min_C DFC_DisblMsk.DFC_LMmax_C DFC_DisblMsk.DFC_LZSRnpl_C DFC_DisblMsk.DFC_LamDynDiagS1B1_C DFC_DisblMsk.DFC_LeakIntkMnfldEmiInfl_C DFC_DisblMsk.DFC_LinFrameErrDCDC_C DFC_DisblMsk.DFC_LinOverrunErrDCDC_C DFC_DisblMsk.DFC_MD00max_C DFC_DisblMsk.DFC_MDBmax_C DFC_DisblMsk.DFC_MDCat_C DFC_DisblMsk.DFC_MDCatCrit_C DFC_DisblMsk.DFC_MDCatCurr_C DFC_DisblMsk.DFC_MDCyl_0_C DFC_DisblMsk.DFC_MDCyl_1_C DFC_DisblMsk.DFC_MDCyl_2_C DFC_DisblMsk.DFC_MDCyl_3_C DFC_DisblMsk.DFC_MDEmi_C DFC_DisblMsk.DFC_MDEmiStrt_C DFC_DisblMsk.DFC_MDFco_C DFC_DisblMsk.DFC_MDMpl_C DFC_DisblMsk.DFC_MDSegTiAdpn_C DFC_DisblMsk.DFC_MDmax_C DFC_DisblMsk.DFC_MFuOilMax_C DFC_DisblMsk.DFC_MOXEMM_SMU_ALM0_0_C DFC_DisblMsk.DFC_MOXEMM_SMU_ALM0_1_C DFC_DisblMsk.DFC_MOXEMM_SMU_ALM0_10_C DFC_DisblMsk.DFC_MOXEMM_SMU_ALM0_11_C DFC_DisblMsk.DFC_MOXEMM_SMU_ALM0_13_C DFC_DisblMsk.DFC_MOXEMM_SMU_ALM0_14_C DFC_DisblMsk.DFC_MOXEMM_SMU_ALM0_2_C DFC_DisblMsk.DFC_MOXEMM_SMU_ALM0_22_C DFC_DisblMsk.DFC_MOXEMM_SMU_ALM0_23_C DFC_DisblMsk.DFC_MOXEMM_SMU_ALM0_4_C DFC_DisblMsk.DFC_MOXEMM_SMU_ALM0_5_C DFC_DisblMsk.DFC_MOXEMM_SMU_ALM0_7_C DFC_DisblMsk.DFC_MOXEMM_SMU_ALM0_8_C DFC_DisblMsk.DFC_MOXEMM_SMU_ALM10_16_C DFC_DisblMsk.DFC_MOXEMM_SMU_ALM10_17_C DFC_DisblMsk.DFC_MOXEMM_SMU_ALM10_21_C DFC_DisblMsk.DFC_MOXEMM_SMU_ALM11_0_C DFC_DisblMsk.DFC_MOXEMM_SMU_ALM11_1_C DFC_DisblMsk.DFC_MOXEMM_SMU_ALM11_2_C DFC_DisblMsk.DFC_MOXEMM_SMU_ALM11_3_C DFC_DisblMsk.DFC_MOXEMM_SMU_ALM11_4_C DFC_DisblMsk.DFC_MOXEMM_SMU_ALM11_5_C DFC_DisblMsk.DFC_MOXEMM_SMU_ALM11_8_C DFC_DisblMsk.DFC_MOXEMM_SMU_ALM11_9_C DFC_DisblMsk.DFC_MOXEMM_SMU_ALM1_0_C DFC_DisblMsk.DFC_MOXEMM_SMU_ALM1_1_C DFC_DisblMsk.DFC_MOXEMM_SMU_ALM1_10_C DFC_DisblMsk.DFC_MOXEMM_SMU_ALM1_11_C DFC_DisblMsk.DFC_MOXEMM_SMU_ALM1_13_C DFC_DisblMsk.DFC_MOXEMM_SMU_ALM1_14_C DFC_DisblMsk.DFC_MOXEMM_SMU_ALM1_2_C DFC_DisblMsk.DFC_MOXEMM_SMU_ALM1_22_C DFC_DisblMsk.DFC_MOXEMM_SMU_ALM1_23_C DFC_DisblMsk.DFC_MOXEMM_SMU_ALM1_4_C DFC_DisblMsk.DFC_MOXEMM_SMU_ALM1_5_C DFC_DisblMsk.DFC_MOXEMM_SMU_ALM1_7_C DFC_DisblMsk.DFC_MOXEMM_SMU_ALM1_8_C DFC_DisblMsk.DFC_MOXEMM_SMU_ALM21_0_C DFC_DisblMsk.DFC_MOXEMM_SMU_ALM21_16_C DFC_DisblMsk.DFC_MOXEMM_SMU_ALM21_3_C DFC_DisblMsk.DFC_MOXEMM_SMU_ALM2_1_C DFC_DisblMsk.DFC_MOXEMM_SMU_ALM2_10_C DFC_DisblMsk.DFC_MOXEMM_SMU_ALM2_11_C DFC_DisblMsk.DFC_MOXEMM_SMU_ALM2_13_C DFC_DisblMsk.DFC_MOXEMM_SMU_ALM2_14_C DFC_DisblMsk.DFC_MOXEMM_SMU_ALM2_22_C DFC_DisblMsk.DFC_MOXEMM_SMU_ALM2_23_C DFC_DisblMsk.DFC_MOXEMM_SMU_ALM2_4_C DFC_DisblMsk.DFC_MOXEMM_SMU_ALM2_5_C DFC_DisblMsk.DFC_MOXEMM_SMU_ALM2_7_C DFC_DisblMsk.DFC_MOXEMM_SMU_ALM2_8_C DFC_DisblMsk.DFC_MOXEMM_SMU_ALM6_0_C DFC_DisblMsk.DFC_MOXEMM_SMU_ALM6_11_C DFC_DisblMsk.DFC_MOXEMM_SMU_ALM6_12_C DFC_DisblMsk.DFC_MOXEMM_SMU_ALM6_14_C DFC_DisblMsk.DFC_MOXEMM_SMU_ALM6_15_C DFC_DisblMsk.DFC_MOXEMM_SMU_ALM6_17_C DFC_DisblMsk.DFC_MOXEMM_SMU_ALM6_18_C DFC_DisblMsk.DFC_MOXEMM_SMU_ALM6_20_C DFC_DisblMsk.DFC_MOXEMM_SMU_ALM6_21_C DFC_DisblMsk.DFC_MOXEMM_SMU_ALM6_25_C DFC_DisblMsk.DFC_MOXEMM_SMU_ALM6_4_C DFC_DisblMsk.DFC_MOXEMM_SMU_ALM6_5_C DFC_DisblMsk.DFC_MOXEMM_SMU_ALM6_7_C DFC_DisblMsk.DFC_MOXEMM_SMU_ALM6_8_C DFC_DisblMsk.DFC_MOXEMM_SMU_ALM7_1_C DFC_DisblMsk.DFC_MOXEMM_SMU_ALM7_12_C DFC_DisblMsk.DFC_MOXEMM_SMU_ALM7_13_C DFC_DisblMsk.DFC_MOXEMM_SMU_ALM7_14_C DFC_DisblMsk.DFC_MOXEMM_SMU_ALM7_15_C DFC_DisblMsk.DFC_MOXEMM_SMU_ALM7_16_C DFC_DisblMsk.DFC_MOXEMM_SMU_ALM7_17_C DFC_DisblMsk.DFC_MOXEMM_SMU_ALM7_2_C DFC_DisblMsk.DFC_MOXEMM_SMU_ALM7_20_C DFC_DisblMsk.DFC_MOXEMM_SMU_ALM7_25_C DFC_DisblMsk.DFC_MOXEMM_SMU_ALM7_26_C DFC_DisblMsk.DFC_MOXEMM_SMU_ALM7_28_C DFC_DisblMsk.DFC_MOXEMM_SMU_ALM7_29_C DFC_DisblMsk.DFC_MOXEMM_SMU_ALM7_30_C DFC_DisblMsk.DFC_MOXEMM_SMU_ALM7_31_C DFC_DisblMsk.DFC_MOXEMM_SMU_ALM8_0_C DFC_DisblMsk.DFC_MOXEMM_SMU_ALM8_1_C DFC_DisblMsk.DFC_MOXEMM_SMU_ALM8_10_C DFC_DisblMsk.DFC_MOXEMM_SMU_ALM8_11_C DFC_DisblMsk.DFC_MOXEMM_SMU_ALM8_12_C DFC_DisblMsk.DFC_MOXEMM_SMU_ALM8_16_C DFC_DisblMsk.DFC_MOXEMM_SMU_ALM8_18_C DFC_DisblMsk.DFC_MOXEMM_SMU_ALM8_2_C DFC_DisblMsk.DFC_MOXEMM_SMU_ALM8_3_C DFC_DisblMsk.DFC_MOXEMM_SMU_ALM8_31_C DFC_DisblMsk.DFC_MOXEMM_SMU_ALM8_4_C DFC_DisblMsk.DFC_MOXEMM_SMU_ALM9_0_C DFC_DisblMsk.DFC_MOXEMM_SMU_ALM9_15_C DFC_DisblMsk.DFC_MOXEMM_SMU_ALM9_3_C DFC_DisblMsk.DFC_MoCADCNTP_C DFC_DisblMsk.DFC_MoCADCTst_C /end DEF_CHARACTERISTIC
 FUNCTION_VERSION "30000.33.0_1.1.0" /end FUNCTION
/begin COMPU_METHOD DFES_OneToOne "" RAT_FUNC "%6.2" "-" COEFFS 0 1 0 0 0 1 /end COMPU_METHOD
/begin RECORD_LAYOUT Val_Wu16 FNC_VALUES 1 UWORD COLUMN_DIR DIRECT /end RECORD_LAYOUT
/end MODULE
/end PROJECT
