ASAP2_VERSION 1 60
/begin PROJECT MG1CS022 "MG1CS022"
/begin HEADER "" VERSION "MG1CS022_62XSC_V037" PROJECT_NO MG1CS022 /end HEADER
/begin MODULE DIM ""
/begin MOD_COMMON "" BYTE_ORDER MSB_LAST ALIGNMENT_BYTE 1 ALIGNMENT_WORD 2 ALIGNMENT_LONG 4 ALIGNMENT_INT64 4 ALIGNMENT_FLOAT32_IEEE 4 ALIGNMENT_FLOAT64_IEEE 4 DATA_SIZE 32 /end MOD_COMMON
/begin CHARACTERISTIC EGSDCmn_flgMultiChkParl_C "Code word to activate Feature of Multiple Parallelization Executions" VALUE 0x8053EC32 RB_Val_Wu8 1.00000000000 B_TRUE 0.00 1.00000000000 FORMAT "%13.11" /end CHARACTERISTIC
/begin CHARACTERISTIC EGSDCmn_flgShtrpTstOnlyParl_CW "Shorttrip will be local requested for the purpose of calibration" VALUE 0x8053EC33 RB_Val_Wu8 1.00000000000 B_TRUE 0.00 1.00000000000 FORMAT "%13.11" /end CHARACTERISTIC
/begin CHARACTERISTIC EGSDCmn_nrUGrdt_C "number of time rasters (step size) for gradient creation" VALUE 0x8053EC36 RB_Val_Wu8 9.000 OneToOne 1.00 10.00 FORMAT "%5.2" EXTENDED_LIMITS 0.00 255.0 /end CHARACTERISTIC
/begin CHARACTERISTIC EGSDCmn_ratS1OffsLeanParl_C "maximum assumable mixture deviation in a fault free system" VALUE 0x8053EC38 RB_Val_Ws16 15.99976 fak_uw_b16 -8.000000 7.999756 FORMAT "%8.6" /end CHARACTERISTIC
/begin CHARACTERISTIC EGSDCmn_ratS1OffsRichParl_C "maximum assumable mixture deviation in a fault free system (negative)" VALUE 0x8053EC3A RB_Val_Ws16 15.99976 fak_uw_b16 -8.000000 7.999756 FORMAT "%8.6" /end CHARACTERISTIC
/begin CHARACTERISTIC EGSDCmn_swtCatT_C "Switch-parameter to select the catalyst temperature used for release condition of exhaust gas sensor dynamic diagnosis and catalyst diagnosis of parallelization" VALUE 0x8053EC3C RB_Val_Wu8 255.0 OneToOne 0.00 255.0 FORMAT "%5.1" /end CHARACTERISTIC
/begin CHARACTERISTIC EGSDCmn_tiMinMultiChkRstEvlnParl_C "TIme for reset of the diagnoses for multiple check of the parallelization" VALUE 0x8053EC34 RB_Val_Wu16 6553.500 t_q0p1 0.00 6553.500 FORMAT "%8.3" /end CHARACTERISTIC
/begin CHARACTERISTIC EGSDCmn_tiUInpFltParl_C "low pass filter time constant of binary sensor voltage for parallelization" VALUE 0x8053EC3E RB_Val_Wu16 655.3500 t_q0p01 0.00 655.3500 FORMAT "%8.4" /end CHARACTERISTIC
/begin CHARACTERISTIC EGSDCmn_tiUInpFltTWCD_C "Filter Time Constant for low pass filter of Sensor voltage for TWC Operations" VALUE 0x8053EC40 RB_Val_Wu16 655.3500 t_q0p01 0.00 655.3500 FORMAT "%8.4" /end CHARACTERISTIC
/begin CHARACTERISTIC EGSDO2_dmExhEnaIdn_C "Maximal allowed exhaust mass flow to enable identification" VALUE 0x8053EC58 RB_Val_Wu16 6553.500 m_uw_b6553p5 0.00 6553.500 FORMAT "%8.3" /end CHARACTERISTIC
/begin CHARACTERISTIC EGSDO2_dmfExhIdnMax_C "Maximal gradient of the exhaust mass flow to enable identification" VALUE 0x8053EC5A RB_Val_Ws16 6553.500 m_sw_b3276p8 -3276.800 3276.700 FORMAT "%8.3" /end CHARACTERISTIC
/begin CHARACTERISTIC EGSDO2_dmfExhIdnMin_C "Minimal gradient of the exhaust mass flow to enable identification" VALUE 0x8053EC5C RB_Val_Ws16 6553.500 m_sw_b3276p8 -3276.800 3276.700 FORMAT "%8.3" /end CHARACTERISTIC
/begin CHARACTERISTIC EGSDO2_dmFpcDynEnaMax_C "Maximal allowed purge mass flow to enable identification" VALUE 0x8053EC5E RB_Val_Wu16 25.59961 m_uw_b25p6 0.00 25.59961 FORMAT "%8.5" /end CHARACTERISTIC
/begin CHARACTERISTIC EGSDO2_dratFillgThd_C "Maximal allowed change of filling" VALUE 0x8053EC60 RB_Val_Wu16 1535.977 rel_uw_q0p0234 0.00 1535.977 FORMAT "%8.3" /end CHARACTERISTIC
/begin CHARACTERISTIC EGSDO2_facBndToErrEvln_C "Factor for limitation of measured delay or transition time relative to fault threshold" VALUE 0x8053ECBA RB_Val_Wu16 6.499878 fak_uw_b8 1.500000 7.999878 FORMAT "%8.6" EXTENDED_LIMITS 0.00 7.999878 /end CHARACTERISTIC
/begin CHARACTERISTIC EGSDO2_facDeltaStepEnd_C "Fraction of step height to end step response measurement" VALUE 0x8053ECC4 RB_Val_Wu16 0.9999847 fak_uw_b1 0.00 0.9999847 FORMAT "%9.7" /end CHARACTERISTIC
/begin CHARACTERISTIC EGSDO2_facDlyEquiv_T "Factor to calculate equivalent delay time" CURVE 0x8053ECC6 RB_Curve_U16_U16 0.9999847 fak_uw_b1 0.00 0.9999847 FORMAT "%9.7" READ_ONLY
 /begin AXIS_DESCR STD_AXIS NO_INPUT_QUANTITY fak_uw_b32 19 0.00 31.99951 FORMAT "%8.5" DEPOSIT ABSOLUTE /end AXIS_DESCR
/end CHARACTERISTIC
/begin CHARACTERISTIC EGSDO2_facEwmaCodClr_C "EWMA Filter Coefficient in Code clear mode( After ECU Flash or clearing of error memory)" VALUE 0x8053ED6A RB_Val_Wu16 0.9999847 fak_uw_b1 0.00 0.9999847 FORMAT "%9.7" /end CHARACTERISTIC
/begin CHARACTERISTIC EGSDO2_facEwmaNorm_C "EWMA Filter Coefficient in Normal Mode" VALUE 0x8053ED6C RB_Val_Wu16 0.9999847 fak_uw_b1 0.00 0.9999847 FORMAT "%9.7" /end CHARACTERISTIC
/begin CHARACTERISTIC EGSDO2_facEwmaStepChg_C "EWMA Filter Coefficient in Step Change Mode" VALUE 0x8053ED6E RB_Val_Wu16 0.9999847 fak_uw_b1 0.00 0.9999847 FORMAT "%9.7" /end CHARACTERISTIC
/begin CHARACTERISTIC EGSDO2_facIdnGainDly_C "Identification gain for delay time" VALUE 0x8053ECA6 RB_Val_Wu16 4095.938 t_q0p0625 0.00 4095.938 FORMAT "%8.3" /end CHARACTERISTIC
/begin CHARACTERISTIC EGSDO2_facIdnGainTran_C "Identification gain for transition time" VALUE 0x8053ECA8 RB_Val_Wu16 4095.938 t_q0p0625 0.00 4095.938 FORMAT "%8.3" /end CHARACTERISTIC
/begin CHARACTERISTIC EGSDO2_facMdlNrmSumMin_C "Threshold for calculation of the loss function" VALUE 0x8053ECAC RB_Val_Wu32 65535.9999847 fak_uw_b1 0.00 65535.9999847 FORMAT "%13.7" /end CHARACTERISTIC
/begin CHARACTERISTIC EGSDO2_facQlyDeFltSuspc_C "Threshold for the detection, that the error model is better than the nominal model" VALUE 0x8053ECB0 RB_Val_Wu16 127.9980 fak_uw_b128 0.00 127.9980 FORMAT "%8.4" /end CHARACTERISTIC
/begin CHARACTERISTIC EGSDO2_facQlyDeOKThd_C "Threshold that the error model is good enough" VALUE 0x8053ECB2 RB_Val_Wu16 127.9980 fak_uw_b128 0.00 127.9980 FORMAT "%8.4" /end CHARACTERISTIC
/begin CHARACTERISTIC EGSDO2_facQlyDeRstThd_C "Threshold for the detection, that the nominal model is better than the error model" VALUE 0x8053ECB4 RB_Val_Wu16 127.9980 fak_uw_b128 0.00 127.9980 FORMAT "%8.4" /end CHARACTERISTIC
/begin CHARACTERISTIC EGSDO2_facQlyFltSuspc_C "Threshold that the nominal model is not good enough" VALUE 0x8053ECB6 RB_Val_Wu16 127.9980 fak_uw_b128 0.00 127.9980 FORMAT "%8.4" /end CHARACTERISTIC
/begin CHARACTERISTIC EGSDO2_facTarLtrLamDyn_C "Lambda dynamic target lean rich" VALUE 0x8053ED14 RB_Val_Wu16 1.999969 fak_uw_b2 0.00 1.999969 FORMAT "%8.6" /end CHARACTERISTIC
/begin CHARACTERISTIC EGSDO2_facTarRtlLamDyn_C "Lambda dynamic target rich lean" VALUE 0x8053ED16 RB_Val_Wu16 1.999969 fak_uw_b2 0.00 1.999969 FORMAT "%8.6" /end CHARACTERISTIC
/begin CHARACTERISTIC EGSDO2_facTiTranTout_C "Factor for transition time at time-out criterion" VALUE 0x8053ED18 RB_Val_Wu16 7.999878 fak_uw_b8 0.00 7.999878 FORMAT "%8.6" /end CHARACTERISTIC
/begin CHARACTERISTIC EGSDO2_flgEvlnDynDurgEnaIdn_CW "Dynamic excitation evaluated after bank specific enable conditions (identification) are set." VALUE 0x8053EC62 RB_Val_Wu8 1.00000000000 B_TRUE 0.00 1.00000000000 FORMAT "%13.11" /end CHARACTERISTIC
/begin CHARACTERISTIC EGSDO2_flgIdnDurgCatPurg_C "online identification during catpurge allow" VALUE 0x8053EC63 RB_Val_Wu8 1.00000000000 B_TRUE 0.00 1.00000000000 FORMAT "%13.11" /end CHARACTERISTIC
/begin CHARACTERISTIC EGSDO2_flgIdnDurgParl_CW "Codebit: identification only runs in case of active parallelization" VALUE 0x8053EC64 RB_Val_Wu8 1.00000000000 B_TRUE 0.00 1.00000000000 FORMAT "%13.11" /end CHARACTERISTIC
/begin CHARACTERISTIC EGSDO2_flgLamSpDyn_C "Selection of lambda setpoint input for dynamic diagnosis" VALUE 0x8053ED70 RB_Val_Wu8 1.00000000000 B_TRUE 0.00 1.00000000000 FORMAT "%13.11" /end CHARACTERISTIC
/begin CHARACTERISTIC EGSDO2_flgSeqDyn_C "Activation of the sequential sequence" VALUE 0x8053EC65 RB_Val_Wu8 1.00000000000 B_TRUE 0.00 1.00000000000 FORMAT "%13.11" /end CHARACTERISTIC
/begin CHARACTERISTIC EGSDO2_flgStepBgnReal_C "using of lambda reciprocal from the beginning of the step" VALUE 0x8053ED1A RB_Val_Wu8 1.00000000000 B_TRUE 0.00 1.00000000000 FORMAT "%13.11" /end CHARACTERISTIC
/begin CHARACTERISTIC EGSDO2_flgStepEndReal_C "using of lambda reciprocal from the end of the step" VALUE 0x8053ED1B RB_Val_Wu8 1.00000000000 B_TRUE 0.00 1.00000000000 FORMAT "%13.11" /end CHARACTERISTIC
/begin CHARACTERISTIC EGSDO2_flgSymcDynStepRtl_C "Symmetric dynamic diagnosis of the universal exhaust gas oxygen sensor, step response in direction rich to lean only" VALUE 0x8053ED71 RB_Val_Wu8 1.00000000000 B_TRUE 0.00 1.00000000000 FORMAT "%13.11" /end CHARACTERISTIC
/begin CHARACTERISTIC EGSDO2_mfFpcIdnEna_C "current purge mass flow limit to enable identification" VALUE 0x8053EC66 RB_Val_Wu16 25.59961 m_uw_b25p6 0.00 25.59961 FORMAT "%8.5" /end CHARACTERISTIC
/begin CHARACTERISTIC EGSDO2_mFpcDynEnaMin_C "Minimal integrated purge mass of fuel purge control to enable identification" VALUE 0x8053EC68 RB_Val_Wu8 11.32 m_ub_q0p0444 0.00 11.32 FORMAT "%5.2" /end CHARACTERISTIC
/begin CHARACTERISTIC EGSDO2_nrMeasFltCfmCodClr_C "Number of Measurements needed for EWMA filter in Code Clear Mode ( After ECU Flash or clearing of error memory)" VALUE 0x8053ED72 RB_Val_Wu8 255.0 OneToOne 0.00 255.0 FORMAT "%5.1" /end CHARACTERISTIC
/begin CHARACTERISTIC EGSDO2_nrMeasFltCfmStepChg_C "Number of Measurements needed for EWMA filter in Step Change Mode." VALUE 0x8053ED73 RB_Val_Wu8 255.0 OneToOne 0.00 255.0 FORMAT "%5.1" /end CHARACTERISTIC
/begin CHARACTERISTIC EGSDO2_nrMeasFltCfm_C "Necessary number of measurements for fault-confirmation" VALUE 0x8053EC42 RB_Val_Wu8 255.0 OneToOne 0.00 255.0 FORMAT "%5.1" /end CHARACTERISTIC
/begin CHARACTERISTIC EGSDO2_nrMeasShtrp_C "Number of step response measurements for short trip" VALUE 0x8053EC43 RB_Val_Wu8 255.0 dez 0.00 255.0 FORMAT "%5.1" /end CHARACTERISTIC
/begin CHARACTERISTIC EGSDO2_nrMeasTripCodClr_C "Number measurements allowed during Code clear mode of EWMA filtering in a driving cycle" VALUE 0x8053EC44 RB_Val_Wu8 255.0 OneToOne 0.00 255.0 FORMAT "%5.1" /end CHARACTERISTIC
/begin CHARACTERISTIC EGSDO2_nrMeasTripStepChg_C "Number measurements allowed during Step change mode of EWMA filtering in a driving cycle" VALUE 0x8053EC45 RB_Val_Wu8 255.0 OneToOne 0.00 255.0 FORMAT "%5.1" /end CHARACTERISTIC
/begin CHARACTERISTIC EGSDO2_ratFillgMinIdnEna_T "Minimal relative filling to enable identification" CURVE 0x8053EC6A RB_Curve_S16_U16_Static 1535.977 rel_uw_q0p0234 0.00 1535.977 FORMAT "%8.3"
 /begin AXIS_DESCR STD_AXIS Epm_nEng EngN 4 -16384.00 16383.50 FORMAT "%8.2" DEPOSIT ABSOLUTE /end AXIS_DESCR
/end CHARACTERISTIC
/begin CHARACTERISTIC EGSDO2_ratLamEnaThd_C "Minimal change in modelled lambda necessary to enable identification" VALUE 0x8053EC7C RB_Val_Wu16 1.999969 fak_q3p0518Em5 0.00 1.999969 FORMAT "%8.6" /end CHARACTERISTIC
/begin CHARACTERISTIC EGSDO2_ratTranDlyTiDeadLtr_C "Threshold of the sum ratio of transition and delay time, lean to rich error" VALUE 0x8053EDA6 RB_Val_Wu16 655.3500 fak_q0p01 0.00 655.3500 FORMAT "%8.4" /end CHARACTERISTIC
/begin CHARACTERISTIC EGSDO2_ratTranDlyTiDeadRtl_C "Threshold of the sum ratio of transition and delay time, rich to lean error" VALUE 0x8053EDA8 RB_Val_Wu16 655.3500 fak_q0p01 0.00 655.3500 FORMAT "%8.4" /end CHARACTERISTIC
/begin CHARACTERISTIC EGSDO2_ratTranDlyTiDeadSym_C "Threshold of the sum ratio of transition and delay time, symmetrical error" VALUE 0x8053EDAA RB_Val_Wu16 655.3500 fak_q0p01 0.00 655.3500 FORMAT "%8.4" /end CHARACTERISTIC
/begin CHARACTERISTIC EGSDO2_ratTran_T "Transition time ratio for step response measurement" CURVE 0x8053ED1C RB_Curve_U16_U16 31.99951 fak_uw_b32 0.00 31.99951 FORMAT "%8.5" READ_ONLY
 /begin AXIS_DESCR STD_AXIS NO_INPUT_QUANTITY fak_uw_b1 19 0.00 0.9999847 FORMAT "%9.7" DEPOSIT ABSOLUTE /end AXIS_DESCR
/end CHARACTERISTIC
/begin CHARACTERISTIC EGSDO2_stLamDyn_C "Code word of lambda-based dynamics diagnosis of a wide-band sensor" VALUE 0x8053ED74 RB_Val_Wu8 255.0 OneToOne 0.00 255.0 FORMAT "%5.1" /end CHARACTERISTIC
/begin CHARACTERISTIC EGSDO2_tiAdpnPrmFil_C "Filter time constant for the filtering of the dynamik adaption time" VALUE 0x8053EDA4 RB_Val_Wu16 6553.400 t_q0p1 0.100 6553.500 FORMAT "%8.3" EXTENDED_LIMITS 0.00 6553.500 /end CHARACTERISTIC
/begin CHARACTERISTIC EGSDO2_tiDlyAdpnThd_C "Threshold for the adaption of the delay time symmetrical" VALUE 0x8053EDAC RB_Val_Wu16 655.3500 t_q0p01 0.00 655.3500 FORMAT "%8.4" /end CHARACTERISTIC
/begin CHARACTERISTIC EGSDO2_tiDlyBpu_C "Delay time of best part unacceptable" VALUE 0x8053EC46 RB_Val_Wu16 655.3500 t_q0p01 0.00 655.3500 FORMAT "%8.4" /end CHARACTERISTIC
/begin CHARACTERISTIC EGSDO2_tiDlyDeltaAdpnThd_C "Minimal necessary delay difference lean-rich to rich-lean for a adaption lean to rich" VALUE 0x8053EDAE RB_Val_Wu16 655.3500 t_q0p01 0.00 655.3500 FORMAT "%8.4" /end CHARACTERISTIC
/begin CHARACTERISTIC EGSDO2_tiDlyDeltaStepAdpn_C "Threshold for the adaption of the new delay value with the old delay value" VALUE 0x8053EDB0 RB_Val_Wu16 655.3500 t_q0p01 0.00 655.3500 FORMAT "%8.4" /end CHARACTERISTIC
/begin CHARACTERISTIC EGSDO2_tiDlyIdnFltThd_C "Threshold for detection of delay time fault by identification" VALUE 0x8053EC48 RB_Val_Wu16 655.3500 t_q0p01 0.00 655.3500 FORMAT "%8.4" /end CHARACTERISTIC
/begin CHARACTERISTIC EGSDO2_tiDlyLtrStepFltThdShtrp_C "Fault threshold of delay time (step response, lean to rich) during short trip" VALUE 0x8053EC4A RB_Val_Wu16 655.3500 t_q0p01 0.00 655.3500 FORMAT "%8.4" /end CHARACTERISTIC
/begin CHARACTERISTIC EGSDO2_tiDlyLtrStepFltThd_C "Fault threshold of delay time (step response, lean to rich)" VALUE 0x8053ED76 RB_Val_Wu16 655.3500 t_q0p01 0.00 655.3500 FORMAT "%8.4" /end CHARACTERISTIC
/begin CHARACTERISTIC EGSDO2_tiDlyRtlStepFltThdShtrp_C "Fault threshold of delay time (step response, rich to lean) during short trip" VALUE 0x8053EC4C RB_Val_Wu16 655.3500 t_q0p01 0.00 655.3500 FORMAT "%8.4" /end CHARACTERISTIC
/begin CHARACTERISTIC EGSDO2_tiDlyRtlStepFltThd_C "Fault threshold of delay time (step response, rich to lean)" VALUE 0x8053ED78 RB_Val_Wu16 655.3500 t_q0p01 0.00 655.3500 FORMAT "%8.4" /end CHARACTERISTIC
/begin CHARACTERISTIC EGSDO2_tiDlyStepChgCfm_C "Delay time difference for confirmation of step change" VALUE 0x8053ECBC RB_Val_Wu16 655.3500 t_q0p01 0.00 655.3500 FORMAT "%8.4" /end CHARACTERISTIC
/begin CHARACTERISTIC EGSDO2_tiDlyStepChgSuspc_C "Delay time difference for step change suspicion" VALUE 0x8053ECBE RB_Val_Wu16 655.3500 t_q0p01 0.00 655.3500 FORMAT "%8.4" /end CHARACTERISTIC
/begin CHARACTERISTIC EGSDO2_tiEnaIdnMFlow_C "Turn-on delay for identification after instationary exhaust mass flow" VALUE 0x8053EC7E RB_Val_Wu16 655.3400 t_q0p01 0.0100 655.3500 FORMAT "%8.4" EXTENDED_LIMITS 0.00 655.3500 /end CHARACTERISTIC
/begin CHARACTERISTIC EGSDO2_tiEvlnIdnFirst_C "Debounce time for the first online identification adaption" VALUE 0x8053EDB2 RB_Val_Wu16 6553.500 t_q0p1 0.00 6553.500 FORMAT "%8.3" /end CHARACTERISTIC
/begin CHARACTERISTIC EGSDO2_tiEvlnIdnMax_C "Maximum debounce time for the adaption with online identification" VALUE 0x8053EDB4 RB_Val_Wu16 6553.500 t_q0p1 0.00 6553.500 FORMAT "%8.3" /end CHARACTERISTIC
/begin CHARACTERISTIC EGSDO2_tiEvlnIdn_C "Debounce time for the followed online identification adaption" VALUE 0x8053EDB6 RB_Val_Wu16 6553.500 t_q0p1 0.00 6553.500 FORMAT "%8.3" /end CHARACTERISTIC
/begin CHARACTERISTIC EGSDO2_tiFilExhMFlowIdn_C "Filter time constant for gradient calculation of exhaust mass flow for enabling of identification" VALUE 0x8053EC80 RB_Val_Wu16 655.34999985 zk10msxs_uw_b655p36 0.01000015 655.36000000 FORMAT "%12.8" EXTENDED_LIMITS 0.010000152590 655.36000000 /end CHARACTERISTIC
/begin CHARACTERISTIC EGSDO2_tiGearShift_C "debounce time param for Gear Shift." VALUE 0x8053EC82 RB_Val_Wu8 2.550 t_q0p01 0.00 2.550 FORMAT "%5.3" /end CHARACTERISTIC
/begin CHARACTERISTIC EGSDO2_tiGrdtTmrThd_C "Time threshold to abort gradient-based dynamic diagnosis" VALUE 0x8053ED7A RB_Val_Wu16 655.3500 t_q0p01 0.00 655.3500 FORMAT "%8.4" /end CHARACTERISTIC
/begin CHARACTERISTIC EGSDO2_tiLamMonOkVirtThd_C "Time threshold above which virtual lambda monitoring is okay" VALUE 0x8053ECA4 RB_Val_Wu16 655.3500 t_q0p01 0.00 655.3500 FORMAT "%8.4" /end CHARACTERISTIC
/begin CHARACTERISTIC EGSDO2_tiLossTmrThd_C "Time threshold to evaluate loss function" VALUE 0x8053ECB8 RB_Val_Wu16 655.3500 t_q0p01 0.00 655.3500 FORMAT "%8.4" /end CHARACTERISTIC
/begin CHARACTERISTIC EGSDO2_tiPt1RatFillgEna_C "Differential time constant for relative filling to enable identification" VALUE 0x8053EC84 RB_Val_Wu16 655.34999985 zk10msxs_uw_b655p36 0.01000015 655.36000000 FORMAT "%12.8" EXTENDED_LIMITS 0.010000152590 655.36000000 /end CHARACTERISTIC
/begin CHARACTERISTIC EGSDO2_tiSumAdpnThd_C "Error suspicion threshold of the dynamic time of the sum of delay and transition for each direction" VALUE 0x8053ED7C RB_Val_Wu16 655.3500 t_q0p01 0.00 655.3500 FORMAT "%8.4" /end CHARACTERISTIC
/begin CHARACTERISTIC EGSDO2_tiSumDeltaAdpnThd_C "Error suspicion threshold of the difference of the sums of delay and transition" VALUE 0x8053ED7E RB_Val_Ws16 655.3500 t_q0p01 -327.6800 327.6700 FORMAT "%8.4" /end CHARACTERISTIC
/begin CHARACTERISTIC EGSDO2_tiSumIdnFltThd_C "Fault threshold for sum time from identification" VALUE 0x8053EC4E RB_Val_Wu16 655.3500 t_q0p01 0.00 655.3500 FORMAT "%8.4" /end CHARACTERISTIC
/begin CHARACTERISTIC EGSDO2_tiTiConNomEnaIdnShtrp_C "Maximal nominal plant time constant to enable identification during short trip" VALUE 0x8053EC86 RB_Val_Wu16 655.3400 t_q0p01 0.0100 655.3500 FORMAT "%8.4" EXTENDED_LIMITS 0.00 655.3500 /end CHARACTERISTIC
/begin CHARACTERISTIC EGSDO2_tiTiConNomEnaIdn_C "Maximal nominal plant time constant to enable identification" VALUE 0x8053EC88 RB_Val_Wu16 655.3400 t_q0p01 0.0100 655.3500 FORMAT "%8.4" EXTENDED_LIMITS 0.00 655.3500 /end CHARACTERISTIC
/begin CHARACTERISTIC EGSDO2_tiTranAdpnThd_C "Threshold for the adaption of the transition time symmetrical" VALUE 0x8053EDB8 RB_Val_Wu16 655.3500 t_q0p01 0.00 655.3500 FORMAT "%8.4" /end CHARACTERISTIC
/begin CHARACTERISTIC EGSDO2_tiTranBpu_C "Transition time of best part unacceptable" VALUE 0x8053EC50 RB_Val_Wu16 655.3500 t_q0p01 0.00 655.3500 FORMAT "%8.4" /end CHARACTERISTIC
/begin CHARACTERISTIC EGSDO2_tiTranDeltaAdpnThd_C "Minimal necessary transition difference lean-rich to rich-lean for a adaption lean to rich" VALUE 0x8053EDBA RB_Val_Wu16 655.3500 t_q0p01 0.00 655.3500 FORMAT "%8.4" /end CHARACTERISTIC
/begin CHARACTERISTIC EGSDO2_tiTranDeltaStepAdpn_C "Threshold for the adaption of the new transition value with the old delay value" VALUE 0x8053EDBC RB_Val_Wu16 655.3500 t_q0p01 0.00 655.3500 FORMAT "%8.4" /end CHARACTERISTIC
/begin CHARACTERISTIC EGSDO2_tiTranIdnFltThd_C "Threshold for detection of transition time fault by identification" VALUE 0x8053EC52 RB_Val_Wu16 655.3500 t_q0p01 0.00 655.3500 FORMAT "%8.4" /end CHARACTERISTIC
/begin CHARACTERISTIC EGSDO2_tiTranLtrStepFltThdShtrp_C "Fault threshold of transition time (step response, lean to rich) during short trip" VALUE 0x8053EC54 RB_Val_Wu16 655.3500 t_q0p01 0.00 655.3500 FORMAT "%8.4" /end CHARACTERISTIC
/begin CHARACTERISTIC EGSDO2_tiTranLtrStepFltThd_C "Fault threshold of transition time (step response, lean to rich)" VALUE 0x8053ED80 RB_Val_Wu16 655.3500 t_q0p01 0.00 655.3500 FORMAT "%8.4" /end CHARACTERISTIC
/begin CHARACTERISTIC EGSDO2_tiTranRtlStepFltThdShtrp_C "Fault threshold of transition time (step response, rich to lean) during short trip" VALUE 0x8053EC56 RB_Val_Wu16 655.3500 t_q0p01 0.00 655.3500 FORMAT "%8.4" /end CHARACTERISTIC
/begin CHARACTERISTIC EGSDO2_tiTranRtlStepFltThd_C "Fault threshold of transition time (step response, rich to lean)" VALUE 0x8053ED82 RB_Val_Wu16 655.3500 t_q0p01 0.00 655.3500 FORMAT "%8.4" /end CHARACTERISTIC
/begin CHARACTERISTIC EGSDO2_tiTranStepChgCfm_C "Transition time difference for confirmation of step change" VALUE 0x8053ECC0 RB_Val_Wu16 655.3500 t_q0p01 0.00 655.3500 FORMAT "%8.4" /end CHARACTERISTIC
/begin CHARACTERISTIC EGSDO2_tiTranStepChgSuspc_C "Transition time difference for step change suspicion" VALUE 0x8053ECC2 RB_Val_Wu16 655.3500 t_q0p01 0.00 655.3500 FORMAT "%8.4" /end CHARACTERISTIC
/begin CHARACTERISTIC EGSDO2_tiTurnOffExct_C "Turn off delay at unsufficient dynamic excitation" VALUE 0x8053EC8A RB_Val_Wu16 655.3500 t_q0p01 0.00 655.3500 FORMAT "%8.4" /end CHARACTERISTIC
/begin CHARACTERISTIC EGSDO2_tiTurnOffIdnLamMon_C "Turn off delay when lambda stability criterion is not fulfilled" VALUE 0x8053EC8C RB_Val_Wu16 655.3500 t_q0p01 0.00 655.3500 FORMAT "%8.4" /end CHARACTERISTIC
/begin CHARACTERISTIC EGSDO2_tiTurnOffVlvLft_C "Turn-on delay after change in valve lift" VALUE 0x8053EC8E RB_Val_Wu16 655.3400 t_q0p01 0.0100 655.3500 FORMAT "%8.4" EXTENDED_LIMITS 0.00 655.3500 /end CHARACTERISTIC
/begin CHARACTERISTIC EGSDO2_tiTurnOnBpChg_C "Turn-on delay after switching bandpass" VALUE 0x8053EC90 RB_Val_Wu16 655.3500 t_q0p01 0.00 655.3500 FORMAT "%8.4" /end CHARACTERISTIC
/begin CHARACTERISTIC EGSDO2_tiTurnOnEna_C "Turn on delay of identification after release of controller" VALUE 0x8053EC92 RB_Val_Wu16 655.3500 t_q0p01 0.00 655.3500 FORMAT "%8.4" /end CHARACTERISTIC
/begin CHARACTERISTIC EGSDO2_tiTurnOnFcoFltSuspc_C "Turn-on delay after fuel cut-off at fault suspicion" VALUE 0x8053EC94 RB_Val_Wu16 655.3500 t_q0p01 0.00 655.3500 FORMAT "%8.4" /end CHARACTERISTIC
/begin CHARACTERISTIC EGSDO2_tiTurnOnFco_C "Turn-on delay after fuel cut-off" VALUE 0x8053EC96 RB_Val_Wu16 655.3500 t_q0p01 0.00 655.3500 FORMAT "%8.4" /end CHARACTERISTIC
/begin CHARACTERISTIC EGSDO2_tiTurnOnFillgGrdtFltSuspc_C "Turn-on delay after large filling gradient at fault suspicion" VALUE 0x8053EC98 RB_Val_Wu16 655.3500 t_q0p01 0.00 655.3500 FORMAT "%8.4" /end CHARACTERISTIC
/begin CHARACTERISTIC EGSDO2_tiTurnOnFillgGrdt_C "Turn-on delay after large filling gradient" VALUE 0x8053EC9A RB_Val_Wu16 655.3500 t_q0p01 0.00 655.3500 FORMAT "%8.4" /end CHARACTERISTIC
/begin CHARACTERISTIC EGSDO2_tiTurnOnFillg_C "Turn-on delay after sufficiently large filling" VALUE 0x8053EC9C RB_Val_Wu16 655.3500 t_q0p01 0.00 655.3500 FORMAT "%8.4" /end CHARACTERISTIC
/begin CHARACTERISTIC EGSDO2_tiTurnOnSnsrRdn_C "Turn on delay of identification after sensor readiness" VALUE 0x8053EC9E RB_Val_Wu16 655.3500 t_q0p01 0.00 655.3500 FORMAT "%8.4" /end CHARACTERISTIC
/begin CHARACTERISTIC EGSDO2_tiTurnOnStrt_C "Turn-on delay after end of start" VALUE 0x8053ECA0 RB_Val_Wu16 655.3500 t_q0p01 0.00 655.3500 FORMAT "%8.4" /end CHARACTERISTIC
/begin CHARACTERISTIC ResFilLtrB1_I.tiDlyIni_C "Class instance for result filtering in lean-rich direction for lambda-based dynamics diagnosis of a wideband-sensor (bank 1) / Initialization value for delay time filter" VALUE 0x8053ED90 RB_Val_Ws16 327.6700 t_q0p01 0.00 327.6700 FORMAT "%8.4" EXTENDED_LIMITS -327.6800 327.6700 /end CHARACTERISTIC
/begin CHARACTERISTIC ResFilLtrB1_I.tiTranIni_C "Class instance for result filtering in lean-rich direction for lambda-based dynamics diagnosis of a wideband-sensor (bank 1) / Initialization value for transient time filter" VALUE 0x8053ED92 RB_Val_Ws16 327.6700 t_q0p01 0.00 327.6700 FORMAT "%8.4" EXTENDED_LIMITS -327.6800 327.6700 /end CHARACTERISTIC
/begin CHARACTERISTIC ResFilRtlB1_I.tiDlyIni_C "Class instance for result filtering in rich-lean direction for lambda-based dynamics diagnosis of a wideband-sensor (bank 1) / Initialization value for delay time filter" VALUE 0x8053EDA0 RB_Val_Ws16 327.6700 t_q0p01 0.00 327.6700 FORMAT "%8.4" EXTENDED_LIMITS -327.6800 327.6700 /end CHARACTERISTIC
/begin CHARACTERISTIC ResFilRtlB1_I.tiTranIni_C "Class instance for result filtering in rich-lean direction for lambda-based dynamics diagnosis of a wideband-sensor (bank 1) / Initialization value for transient time filter" VALUE 0x8053EDA2 RB_Val_Ws16 327.6700 t_q0p01 0.00 327.6700 FORMAT "%8.4" EXTENDED_LIMITS -327.6800 327.6700 /end CHARACTERISTIC
/begin MEASUREMENT DiumprB1_I.cntrStepLtrTripVirt "Class instance for IUMPR calculation for lambda-based dynamics diagnosis of a wideband-sensor (bank 1) / Number of virtual step response measurements in lean-rich direction of driving cycle" UBYTE dez 1 100 0.00 255.0 FORMAT "%5.1" ECU_ADDRESS 0x60007B0E /end MEASUREMENT
/begin MEASUREMENT DiumprB1_I.cntrStepRtlTripVirt "Class instance for IUMPR calculation for lambda-based dynamics diagnosis of a wideband-sensor (bank 1) / Number of virtual step response measurements in rich-lean direction of driving cycle" UBYTE dez 1 100 0.00 255.0 FORMAT "%5.1" ECU_ADDRESS 0x60007B0F /end MEASUREMENT
/begin MEASUREMENT DiumprB1_I.flgLamMonOkVirt "Class instance for IUMPR calculation for lambda-based dynamics diagnosis of a wideband-sensor (bank 1) / Virtual lambda monitoring okay (bank 1)" UBYTE B_TRUE 1 100 0.00 1.00000000000 BIT_MASK 0x1 FORMAT "%13.11" ECU_ADDRESS 0x60007B10 /end MEASUREMENT
/begin MEASUREMENT DiumprB1_I.flgStepVirtDne "Class instance for IUMPR calculation for lambda-based dynamics diagnosis of a wideband-sensor (bank 1) / Virtual step response measurement done" UBYTE B_TRUE 1 100 0.00 1.00000000000 BIT_MASK 0x1 FORMAT "%13.11" ECU_ADDRESS 0x60007B11 /end MEASUREMENT
/begin MEASUREMENT DiumprB1_I.tiEnaIdnVirt "Class instance for IUMPR calculation for lambda-based dynamics diagnosis of a wideband-sensor (bank 1) / Timer for enabled virtual identification" UWORD t_q0p01 1 100 0.00 655.3500 FORMAT "%8.4" ECU_ADDRESS 0x60007B14 /end MEASUREMENT
/begin MEASUREMENT DiumprB1_I.tiStepTmrVirt "Class instance for IUMPR calculation for lambda-based dynamics diagnosis of a wideband-sensor (bank 1) / Time after virtual step" UWORD t_q0p01 1 100 0.00 655.3500 FORMAT "%8.4" ECU_ADDRESS 0x60007B12 /end MEASUREMENT
/begin MEASUREMENT DiumprB1_I.EGSDO2_StepVirtDneERNM_I.oldSignal "Class instance for IUMPR calculation for lambda-based dynamics diagnosis of a wideband-sensor (bank 1) / Virtual step done / value of input signal last calculation" UBYTE B_TRUE 1 100 0.00 1.00000000000 BIT_MASK 0x1 FORMAT "%13.11" ECU_ADDRESS 0x60007B16 /end MEASUREMENT
/begin MEASUREMENT DiumprB1_I.EGSDO2_StepVirtLtrFF_I.status "Class instance for IUMPR calculation for lambda-based dynamics diagnosis of a wideband-sensor (bank 1) / Virtual Step Ltr / current value of RS-FF" UBYTE B_TRUE 1 100 0.00 1.00000000000 BIT_MASK 0x1 FORMAT "%13.11" ECU_ADDRESS 0x60007B17 /end MEASUREMENT
/begin MEASUREMENT DiumprB1_I.EGSDO2_StepVirtRtlFF_I.status "Class instance for IUMPR calculation for lambda-based dynamics diagnosis of a wideband-sensor (bank 1) / Virtual Step Rtl / current value of RS-FF" UBYTE B_TRUE 1 100 0.00 1.00000000000 BIT_MASK 0x1 FORMAT "%13.11" ECU_ADDRESS 0x60007B18 /end MEASUREMENT
/begin MEASUREMENT DiumprB1_I.StepStateVirt_I.flgDynStepLtrReset "Class instance for IUMPR calculation for lambda-based dynamics diagnosis of a wideband-sensor (bank 1) / virtual calculation of the step states / Reset of Step Measurment Ltr" UBYTE B_TRUE 1 100 0.00 1.00000000000 BIT_MASK 0x1 FORMAT "%13.11" ECU_ADDRESS 0x60007B1A /end MEASUREMENT
/begin MEASUREMENT DiumprB1_I.StepStateVirt_I.flgDynStepLtrSet "Class instance for IUMPR calculation for lambda-based dynamics diagnosis of a wideband-sensor (bank 1) / virtual calculation of the step states / start of Measurement Rtl" UBYTE B_TRUE 1 100 0.00 1.00000000000 BIT_MASK 0x1 FORMAT "%13.11" ECU_ADDRESS 0x60007B1B /end MEASUREMENT
/begin MEASUREMENT DiumprB1_I.StepStateVirt_I.flgDynStepRtlReset "Class instance for IUMPR calculation for lambda-based dynamics diagnosis of a wideband-sensor (bank 1) / virtual calculation of the step states / Reset of Step Measurment Rtl" UBYTE B_TRUE 1 100 0.00 1.00000000000 BIT_MASK 0x1 FORMAT "%13.11" ECU_ADDRESS 0x60007B1C /end MEASUREMENT
/begin MEASUREMENT DiumprB1_I.StepStateVirt_I.flgDynStepRtlSet "Class instance for IUMPR calculation for lambda-based dynamics diagnosis of a wideband-sensor (bank 1) / virtual calculation of the step states / start of Measurement Rtl" UBYTE B_TRUE 1 100 0.00 1.00000000000 BIT_MASK 0x1 FORMAT "%13.11" ECU_ADDRESS 0x60007B1D /end MEASUREMENT
/begin MEASUREMENT EGSDCmn_cntrRstEvlnParl "Counter for Feature of Multiple Parallelization Executions" UWORD dez 1 100 0.00 65535.00 FORMAT "%8.2" ECU_ADDRESS 0x60008F94 /end MEASUREMENT
/begin MEASUREMENT EGSDCmn_cntrRstEvlnParlCTR_I.counter "Counter for Feature of Multiple Parallelization Executions / current counter value" UWORD dez 1 100 0.00 65535.00 FORMAT "%8.2" ECU_ADDRESS 0x60007B4C /end MEASUREMENT
/begin MEASUREMENT EGSDCmn_ctReIniShoTrip "ReIni counter" UBYTE OneToOne 1 100 0.00 255.0 FORMAT "%5.1" ECU_ADDRESS 0x60014A2D /end MEASUREMENT
/begin MEASUREMENT EGSDCmn_dmO2Cat1B1Parl "Oxygen Gas Mass flow into catalyst 1 , Bank 1" SWORD m_q0p1_mgs 1 100 -3276.800 3276.700 FORMAT "%8.3" ECU_ADDRESS 0x600147FA /end MEASUREMENT
/begin MEASUREMENT EGSDCmn_dmSeg1B1O2Parl "Oxygen mass flow in catalyst 1 (considers maximum possible mixture deviation in a fault free system)" UWORD m_q0p1_mgs 1 100 0.00 6553.500 FORMAT "%8.3" ECU_ADDRESS 0x600147FC /end MEASUREMENT
/begin MEASUREMENT EGSDCmn_dmSeg1B1RichParl "Rich gas mass flow in catalyst 1 (considers maximum possible mixture deviation in a fault free system)" UWORD m_q0p1_mgs 1 100 0.00 6553.500 FORMAT "%8.3" ECU_ADDRESS 0x600147FE /end MEASUREMENT
/begin MEASUREMENT EGSDCmn_dmSeg1B1VirtO2Parl "Virtual Oxygen mass flow in catalyst 1 (considers maximum possible mixture deviation in a fault free system)" UWORD m_q0p1_mgs 1 100 0.00 6553.500 FORMAT "%8.3" ECU_ADDRESS 0x60014800 /end MEASUREMENT
/begin MEASUREMENT EGSDCmn_dmSeg1B1VirtRichParl "Virtual Rich gas mass flow in catalyst 1 (considers maximum possible mixture deviation in a fault free system)" UWORD m_q0p1_mgs 1 100 0.00 6553.500 FORMAT "%8.3" ECU_ADDRESS 0x60014802 /end MEASUREMENT
/begin MEASUREMENT EGSDCmn_duS2B1Parl "gradient of filtered sensor voltage of sensor 2, bank 1, used in diagnosis" SWORD RBPtCel_du_7p62939em4_1 1 100 -25.00000 24.99924 FORMAT "%8.5" ECU_ADDRESS 0x60009A2C /end MEASUREMENT
/begin MEASUREMENT EGSDCmn_flgInhbProdModParl "Flag to inhibit Parallelization when the vehicle is in Production mode." UBYTE B_TRUE 1 100 0.00 1.00000000000 BIT_MASK 0x1 FORMAT "%13.11" ECU_ADDRESS 0x70000A37 /end MEASUREMENT
/begin MEASUREMENT EGSDCmn_flgProdModParl "Flag: Production Mode to be considered for Exhaust gas sensor diagnosis" UBYTE B_TRUE 1 100 0.00 1.00000000000 BIT_MASK 0x1 FORMAT "%13.11" ECU_ADDRESS 0x70000A2F /end MEASUREMENT
/begin MEASUREMENT EGSDCmn_flgRmnProdModParl "flag which indicates the production residue presence for exhaust system diagnoses" UBYTE B_TRUE 1 100 0.00 1.00000000000 BIT_MASK 0x1 FORMAT "%13.11" ECU_ADDRESS 0x70000A2C /end MEASUREMENT
/begin MEASUREMENT EGSDCmn_flgRstEvlnParlER_I.buffer "reset trigger / rising edge detected" UBYTE B_TRUE 1 100 0.00 1.00000000000 BIT_MASK 0x1 FORMAT "%13.11" ECU_ADDRESS 0x60007B4A /end MEASUREMENT
/begin MEASUREMENT EGSDCmn_flgRstEvlnParlER_I.oldSignal "reset trigger / flag rising edge" UBYTE B_TRUE 1 100 0.00 1.00000000000 BIT_MASK 0x1 FORMAT "%13.11" ECU_ADDRESS 0x60007B4B /end MEASUREMENT
/begin MEASUREMENT EGSDCmn_flgS1B1VldParl "Sensor on position 1 is valid" UBYTE B_TRUE 1 100 0.00 1.00000000000 BIT_MASK 0x1 FORMAT "%13.11" ECU_ADDRESS 0x70000A29 /end MEASUREMENT
/begin MEASUREMENT EGSDCmn_flgS2B1VldParl "sensor 2 is ready for operation, bank 1" UBYTE B_TRUE 1 100 0.00 1.00000000000 BIT_MASK 0x1 FORMAT "%13.11" ECU_ADDRESS 0x70000A1E /end MEASUREMENT
/begin MEASUREMENT EGSDCmn_flgShtrpParl "short trip request for parallelization" UBYTE B_TRUE 1 100 0.00 1.00000000000 BIT_MASK 0x1 FORMAT "%13.11" ECU_ADDRESS 0x70000A0E /end MEASUREMENT
/begin MEASUREMENT EGSDCmn_idxGrdtAryInp "input index of array for gradient creation" UBYTE OneToOne 1 100 0.00 10.00 FORMAT "%5.2" ECU_ADDRESS 0x6000BA51 /end MEASUREMENT
/begin MEASUREMENT EGSDCmn_idxGrdtAryOutp "output index of array for gradient creation" UBYTE OneToOne 1 100 0.00 255.0 FORMAT "%5.1" ECU_ADDRESS 0x6000BA50 /end MEASUREMENT
/begin MEASUREMENT EGSDCmn_mfEgCat1B1Parl "Exhaust gas mass flow into catalyst 1, bank 1" UWORD m_q0p1 1 100 0.00 6553.500 FORMAT "%8.3" ECU_ADDRESS 0x600094DE /end MEASUREMENT
/begin MEASUREMENT EGSDCmn_mfEgCat1B1WoFu "Mass flow exhaust gas minus fuel part upstream of catalyst 1" UWORD m_q0p1 1 100 0.00 6553.500 FORMAT "%8.3" ECU_ADDRESS 0x60014806 /end MEASUREMENT
/begin MEASUREMENT EGSDCmn_mfEgCat1B1WoFuParl "Exhaust gas mass flow minus fuel part into catalyst 1, bank 1" UWORD m_q0p1 1 100 0.00 6553.500 FORMAT "%8.3" ECU_ADDRESS 0x60013CAA /end MEASUREMENT
/begin MEASUREMENT EGSDCmn_mfO2Cat1B1Parl "Oxygen mass flow, input of catalyst 1, bank 1" FLOAT32_IEEE mgrad_q1_mgdivs 1 100 -50000.0000 50000.0000 FORMAT "%10.4" ECU_ADDRESS 0x60013B04 /end MEASUREMENT
/begin MEASUREMENT EGSDCmn_mfSeg1B1O2Parl "Oxygen mass flow in catalyst 1 (considers maximum possible mixture deviation in a fault free system)" FLOAT32_IEEE mgrad_q1_mgdivs 1 100 0.00 50000.0000 FORMAT "%10.4" ECU_ADDRESS 0x60003A8C /end MEASUREMENT
/begin MEASUREMENT EGSDCmn_mfSeg1B1RichParl "Rich gas mass flow in catalyst 1 (considers maximum possible mixture deviation in a fault free system)" FLOAT32_IEEE mgrad_q1_mgdivs 1 100 0.00 50000.0000 FORMAT "%10.4" ECU_ADDRESS 0x60003A88 /end MEASUREMENT
/begin MEASUREMENT EGSDCmn_mfSeg1B1VirtO2Parl "Virtual Oxygen mass flow in catalyst 1 (considers maximum possible mixture deviation in a fault free system)" FLOAT32_IEEE mgrad_q1_mgdivs 1 100 0.00 50000.0000 FORMAT "%10.4" ECU_ADDRESS 0x600038C8 /end MEASUREMENT
/begin MEASUREMENT EGSDCmn_mfSeg1B1VirtRichParl "Virtual Rich gas mass flow in catalyst 1 (considers maximum possible mixture deviation in a fault free system)" FLOAT32_IEEE mgrad_q1_mgdivs 1 100 0.00 50000.0000 FORMAT "%10.4" ECU_ADDRESS 0x50004EE4 /end MEASUREMENT
/begin MEASUREMENT EGSDCmn_ratLamActS1B1 "Lambda actual value for parallelization, bank 1" UWORD fak_uw_b16 1 100 0.00 15.99976 FORMAT "%8.5" ECU_ADDRESS 0x600094DC /end MEASUREMENT
/begin MEASUREMENT EGSDCmn_S2B1UInpParlLT_I.memory "Low pass filter of binary sensor voltage for parallelization, sensor 2, bank 1 / current lowpass value" ULONG spg_q1p8626Em8_V 1 100 0.00 4.99999998137 FORMAT "%13.11" ECU_ADDRESS 0x60002D8C /end MEASUREMENT
/begin MEASUREMENT EGSDCmn_S2B1UInpTWCDLT_I.memory "Filter Class Instance for HEGOS2B1 Signal for TWC Operations / current lowpass value" ULONG spg_q1p8626Em8_V 1 100 0.00 4.99999998137 FORMAT "%13.11" ECU_ADDRESS 0x60002D88 /end MEASUREMENT
/begin MEASUREMENT EGSDCmn_Seg1B1mfParl_I.mfO2 "caculation of oxygen mass flow, corrected by maximum possible mixture deviation in a fault free system / oxygen mass flow" UWORD m_q0p1_mgs 1 100 0.00 6553.500 FORMAT "%8.3" ECU_ADDRESS 0x60013CA6 /end MEASUREMENT
/begin MEASUREMENT EGSDCmn_Seg1B1mfParl_I.mfRich "caculation of oxygen mass flow, corrected by maximum possible mixture deviation in a fault free system / rich gas mass flow" UWORD m_q0p1_mgs 1 100 0.00 6553.500 FORMAT "%8.3" ECU_ADDRESS 0x60013CA8 /end MEASUREMENT
/begin MEASUREMENT EGSDCmn_Seg1B1mfVirtParl_I.mfO2 "caculation of virtual oxygen mass flow, corrected by maximum possible mixture deviation in a fault free system / oxygen mass flow" UWORD m_q0p1_mgs 1 100 0.00 6553.500 FORMAT "%8.3" ECU_ADDRESS 0x60007B44 /end MEASUREMENT
/begin MEASUREMENT EGSDCmn_Seg1B1mfVirtParl_I.mfRich "caculation of virtual oxygen mass flow, corrected by maximum possible mixture deviation in a fault free system / rich gas mass flow" UWORD m_q0p1_mgs 1 100 0.00 6553.500 FORMAT "%8.3" ECU_ADDRESS 0x60007B46 /end MEASUREMENT
/begin MEASUREMENT EGSDCmn_tCat1B1MaxParl "maximum temperature catalyst 1" SWORD Temp_Cels 1 100 -3549.940 3003.560 FORMAT "%8.3" ECU_ADDRESS 0x6000920E /end MEASUREMENT
/begin MEASUREMENT EGSDCmn_tCat1B1MinParl "minimum temperature catalyst 1" SWORD Temp_Cels 1 100 -3549.940 3003.560 FORMAT "%8.3" ECU_ADDRESS 0x6000920C /end MEASUREMENT
/begin MEASUREMENT EGSDCmn_tCat1B1Parl "Bed temperature of main catalyst 1, modelled, bank 1" UWORD temp_q0p0234_o273 1 100 -273.150 1262.827 FORMAT "%8.3" ECU_ADDRESS 0x60008F92 /end MEASUREMENT
/begin MEASUREMENT EGSDCmn_tCat1B1VirtParl "Virtual modelled catalyst temperature (only for EGSDia)" UWORD temp_q0p0234_o273 1 100 -273.150 1262.827 FORMAT "%8.3" ECU_ADDRESS 0x60008F90 /end MEASUREMENT
/begin MEASUREMENT EGSDCmn_tiRstEvlnParlSW_I.timeCounter "Debouncing timer for reset of parallelization for multi check measurements (only for testing phase) / expired time since start" UWORD t_q0p1 1 100 0.00 6553.500 FORMAT "%8.3" ECU_ADDRESS 0x60007B48 /end MEASUREMENT
/begin MEASUREMENT EGSDCmn_tiUInpFltParl "Low pass filter time for downstream sensor voltage for parallelization" UWORD zk10msxs_uw_b655 1 100 0.01000015 655.36000000 FORMAT "%12.8" ECU_ADDRESS 0x60013CB0 /end MEASUREMENT
/begin MEASUREMENT EGSDCmn_tS2B1SensParl "exhaust gas temperature at oxygen sensor 2, bank 1" UWORD temp_q0p0234_o273 1 100 -273.150 1262.827 FORMAT "%8.3" ECU_ADDRESS 0x60008F8E /end MEASUREMENT
/begin MEASUREMENT EGSDCmn_uS2B1FildParl "filtered sensor voltage of sensor 2, bank 1" UWORD spg_q1p221Em3_V 1 100 0.00 4.998779 FORMAT "%8.6" ECU_ADDRESS 0x600094C6 /end MEASUREMENT
/begin MEASUREMENT EGSDCmn_uS2B1FildTWCD "filtered sensor voltage of sensor 2, bank 1, to be used in TWC Operations" UWORD spg_q1p221Em3_V 1 100 0.00 4.998779 FORMAT "%8.6" ECU_ADDRESS 0x600094C4 /end MEASUREMENT
/begin MEASUREMENT EGSDCmn_uS2B1Old_a "array of old sensor voltage values of gradient creation of sensor 2, bank 1" UWORD spg_q1p221Em3_V 1 100 0.00 4.998779 FORMAT "%8.6" ARRAY_SIZE 11 ECU_ADDRESS 0x60013CB2 /end MEASUREMENT
/begin MEASUREMENT EGSDO2_BpChgB1TONV_I.outbit "Turn-on delay after bandpass change (bank 1) / return value" UBYTE B_TRUE 1 100 0.00 1.00000000000 BIT_MASK 0x1 FORMAT "%13.11" ECU_ADDRESS 0x60007B40 /end MEASUREMENT
/begin MEASUREMENT EGSDO2_BpChgB1TONV_I.time "Turn-on delay after bandpass change (bank 1) / expired delay time" UWORD t_q0p01 1 100 0.00 655.3500 FORMAT "%8.4" ECU_ADDRESS 0x60007B42 /end MEASUREMENT
/begin MEASUREMENT EGSDO2_cntrStepLtrS1B1 "Number of evaluated steps in lean-rich direction (sensor 1, bank 1)" UBYTE dez 1 100 0.00 255.0 FORMAT "%5.1" ECU_ADDRESS 0x60014AA6 /end MEASUREMENT
/begin MEASUREMENT EGSDO2_cntrStepLtrTripVirtS1B1 "Amount of virtual step response measurements in lean-rich direction of driving cycle" UBYTE dez 1 100 0.00 255.0 FORMAT "%5.1" ECU_ADDRESS 0x6000F7FC /end MEASUREMENT
/begin MEASUREMENT EGSDO2_cntrStepRtlS1B1 "Number of evaluated steps in rich-lean direction (sensor 1, bank 1)" UBYTE dez 1 100 0.00 255.0 FORMAT "%5.1" ECU_ADDRESS 0x60014AA7 /end MEASUREMENT
/begin MEASUREMENT EGSDO2_cntrStepRtlTripVirtS1B1 "Amount of virtual step response measurements in rich-lean direction of driving cycle" UBYTE dez 1 100 0.00 255.0 FORMAT "%5.1" ECU_ADDRESS 0x6000F7FB /end MEASUREMENT
/begin MEASUREMENT EGSDO2_ctReini100msEvln "counter reini" UBYTE dez 1 100 0.00 255.0 FORMAT "%5.1" ECU_ADDRESS 0x6000BA4F /end MEASUREMENT
/begin MEASUREMENT EGSDO2_ctReini100msLamDyn "Local counter in LamDyn for number of driving cycles (leave postdrive) to enable reinitialization 100ms" UBYTE dez 1 100 0.00 255.0 FORMAT "%5.1" ECU_ADDRESS 0x60014A2F /end MEASUREMENT
/begin MEASUREMENT EGSDO2_ctReini100msLamDynAdpn "Local counter in LamDynAdpn) for number of driving cycles (leave postdrive) to enable reinitialization 100ms" UBYTE dez 1 100 0.00 255.0 FORMAT "%5.1" ECU_ADDRESS 0x6000BA41 /end MEASUREMENT
/begin MEASUREMENT EGSDO2_ctReIni10msIdnEna "Counter for reinitialization" UBYTE OneToOne 1 100 0.00 255.0 FORMAT "%5.1" ECU_ADDRESS 0x6000BA4E /end MEASUREMENT
/begin MEASUREMENT EGSDO2_ctReIni10msLamDyn "Local counter in LamDyn for number of driving cycles (leave postdrive) to enable reinitialization 10ms" UBYTE dez 1 100 0.00 255.0 FORMAT "%5.1" ECU_ADDRESS 0x6000BA4B /end MEASUREMENT
/begin MEASUREMENT EGSDO2_DerExhMFlowB1TONV_I.outbit "Turn-on delay for derivative of exhaust mass flow (bank 1) / return value" UBYTE B_TRUE 1 100 0.00 1.00000000000 BIT_MASK 0x1 FORMAT "%13.11" ECU_ADDRESS 0x60007B3C /end MEASUREMENT
/begin MEASUREMENT EGSDO2_DerExhMFlowB1TONV_I.time "Turn-on delay for derivative of exhaust mass flow (bank 1) / expired delay time" UWORD t_q0p01 1 100 0.00 655.3500 FORMAT "%8.4" ECU_ADDRESS 0x60007B3E /end MEASUREMENT
/begin MEASUREMENT EGSDO2_dmfExhDynB1 "Time derivation of mass flow" SWORD m_sw_b3276p8 1 100 -3276.800 3276.700 FORMAT "%8.3" ECU_ADDRESS 0x60013CD8 /end MEASUREMENT
/begin MEASUREMENT EGSDO2_dratFillgAbslt "Absolute value of filling gradient" UWORD rel_uw_q0p0234 1 100 0.00 1535.977 FORMAT "%8.3" ECU_ADDRESS 0x60013CDA /end MEASUREMENT
/begin MEASUREMENT EGSDO2_DynStepExptLtrFF_I.status "Flip-Flop for expected step response in lean-rich direction / current value of RS-FF" UBYTE B_TRUE 1 100 0.00 1.00000000000 BIT_MASK 0x1 FORMAT "%13.11" ECU_ADDRESS 0x6000BA4A /end MEASUREMENT
/begin MEASUREMENT EGSDO2_DynStepExptRtlFF_I.status "Flip-Flop for expected step response in rich-lean direction / current value of RS-FF" UBYTE B_TRUE 1 100 0.00 1.00000000000 BIT_MASK 0x1 FORMAT "%13.11" ECU_ADDRESS 0x6000BA49 /end MEASUREMENT
/begin MEASUREMENT EGSDO2_DynStepLtrFF_I.status "Flip-Flop for step response in lean-lean direction / current value of RS-FF" UBYTE B_TRUE 1 100 0.00 1.00000000000 BIT_MASK 0x1 FORMAT "%13.11" ECU_ADDRESS 0x6000BA48 /end MEASUREMENT
/begin MEASUREMENT EGSDO2_DynStepRtlFF_I.status "Flip-Flop for step response in rich-lean direction / current value of RS-FF" UBYTE B_TRUE 1 100 0.00 1.00000000000 BIT_MASK 0x1 FORMAT "%13.11" ECU_ADDRESS 0x6000BA47 /end MEASUREMENT
/begin MEASUREMENT EGSDO2_EnaB1TONV_I.outbit "Turn-on delay after controller enable (bank 1) / return value" UBYTE B_TRUE 1 100 0.00 1.00000000000 BIT_MASK 0x1 FORMAT "%13.11" ECU_ADDRESS 0x50005536 /end MEASUREMENT
/begin MEASUREMENT EGSDO2_EnaB1TONV_I.time "Turn-on delay after controller enable (bank 1) / expired delay time" UWORD t_q0p01 1 100 0.00 655.3500 FORMAT "%8.4" ECU_ADDRESS 0x50005538 /end MEASUREMENT
/begin MEASUREMENT EGSDO2_EnaIdnLamMonB1TOFFV_I.outbit "Turn-off delay of identification at unsufficient dynamic excitation (bank 1) / Output Bit" UBYTE B_TRUE 1 100 0.00 1.00000000000 BIT_MASK 0x1 FORMAT "%13.11" ECU_ADDRESS 0x60007B38 /end MEASUREMENT
/begin MEASUREMENT EGSDO2_EnaIdnLamMonB1TOFFV_I.time "Turn-off delay of identification at unsufficient dynamic excitation (bank 1) / Occured Time" UWORD t_q0p01 1 100 0.00 655.3500 FORMAT "%8.4" ECU_ADDRESS 0x60007B3A /end MEASUREMENT
/begin MEASUREMENT EGSDO2_EnaIdnVlvLftTOFFV_I.outbit "Turn-on delay after change in valve lift / Output Bit" UBYTE B_TRUE 1 100 0.00 1.00000000000 BIT_MASK 0x1 FORMAT "%13.11" ECU_ADDRESS 0x60007B34 /end MEASUREMENT
/begin MEASUREMENT EGSDO2_EnaIdnVlvLftTOFFV_I.time "Turn-on delay after change in valve lift / Occured Time" UWORD t_q0p01 1 100 0.00 655.3500 FORMAT "%8.4" ECU_ADDRESS 0x60007B36 /end MEASUREMENT
/begin MEASUREMENT EGSDO2_EnaSnsrRdnB1TONV_I.outbit "Turn-on delay after sensor readiness (bank 1) / return value" UBYTE B_TRUE 1 100 0.00 1.00000000000 BIT_MASK 0x1 FORMAT "%13.11" ECU_ADDRESS 0x60007B30 /end MEASUREMENT
/begin MEASUREMENT EGSDO2_EnaSnsrRdnB1TONV_I.time "Turn-on delay after sensor readiness (bank 1) / expired delay time" UWORD t_q0p01 1 100 0.00 655.3500 FORMAT "%8.4" ECU_ADDRESS 0x60007B32 /end MEASUREMENT
/begin MEASUREMENT EGSDO2_EvlnActvEnaIdnB1FF_I.status "Evaluation of dynamic excitation when enable conditions of identification active, bank 1 / current value of RS-FF" UBYTE B_TRUE 1 100 0.00 1.00000000000 BIT_MASK 0x1 FORMAT "%13.11" ECU_ADDRESS 0x6000BA4D /end MEASUREMENT
/begin MEASUREMENT EGSDO2_EvlnActvEnaIdnDurgParlB1FF_I.status "Evaluation of dynamic excitation when enable conditions of identification (active identification) active, bank 1 / current value of RS-FF" UBYTE B_TRUE 1 100 0.00 1.00000000000 BIT_MASK 0x1 FORMAT "%13.11" ECU_ADDRESS 0x6000BA4C /end MEASUREMENT
/begin MEASUREMENT EGSDO2_ExctLtrB1TOFFV_I.outbit "Turn-off delay after dynamic excitation in lean-rich direction (bank 1) / Output Bit" UBYTE B_TRUE 1 100 0.00 1.00000000000 BIT_MASK 0x1 FORMAT "%13.11" ECU_ADDRESS 0x60007B2C /end MEASUREMENT
/begin MEASUREMENT EGSDO2_ExctLtrB1TOFFV_I.time "Turn-off delay after dynamic excitation in lean-rich direction (bank 1) / Occured Time" UWORD t_q0p01 1 100 0.00 655.3500 FORMAT "%8.4" ECU_ADDRESS 0x60007B2E /end MEASUREMENT
/begin MEASUREMENT EGSDO2_ExctRtlB1TOFFV_I.outbit "Turn-off delay after dynamic excitation in rich-lean direction (bank 1) / Output Bit" UBYTE B_TRUE 1 100 0.00 1.00000000000 BIT_MASK 0x1 FORMAT "%13.11" ECU_ADDRESS 0x5000553A /end MEASUREMENT
/begin MEASUREMENT EGSDO2_ExctRtlB1TOFFV_I.time "Turn-off delay after dynamic excitation in rich-lean direction (bank 1) / Occured Time" UWORD t_q0p01 1 100 0.00 655.3500 FORMAT "%8.4" ECU_ADDRESS 0x5000553C /end MEASUREMENT
/begin MEASUREMENT EGSDO2_facMdlDeEvlnDiffMaxB1 "Maximum of difference between nominal model and fault model deviation, bank1" SWORD fak_uw_b128 1 100 -64.00000 63.99805 FORMAT "%8.5" ECU_ADDRESS 0x6003942C /end MEASUREMENT
/begin MEASUREMENT EGSDO2_facMdlDeEvlnDiffMinB1 "Minimum of difference between nominal model and fault model deviation, bank1" SWORD fak_uw_b128 1 100 -64.00000 63.99805 FORMAT "%8.5" ECU_ADDRESS 0x6003942A /end MEASUREMENT
/begin MEASUREMENT EGSDO2_facMdlFltDeEvlnB1 "Fault model deviation, Bank1" UWORD fak_uw_b128 1 100 0.00 127.9980 FORMAT "%8.4" ECU_ADDRESS 0x60014812 /end MEASUREMENT
/begin MEASUREMENT EGSDO2_facMdlFltDeEvlnMaxB1 "Maximum Fault model deviation, bank1" UWORD fak_uw_b128 1 100 0.00 127.9980 FORMAT "%8.4" ECU_ADDRESS 0x60039428 /end MEASUREMENT
/begin MEASUREMENT EGSDO2_facMdlNomDeEvlnB1 "nominal model deviation, Bank1" UWORD fak_uw_b128 1 100 0.00 127.9980 FORMAT "%8.4" ECU_ADDRESS 0x60014814 /end MEASUREMENT
/begin MEASUREMENT EGSDO2_facMdlNomDeEvlnMaxB1 "Maximum nominal model deviation, bank1" UWORD fak_uw_b128 1 100 0.00 127.9980 FORMAT "%8.4" ECU_ADDRESS 0x60039426 /end MEASUREMENT
/begin MEASUREMENT EGSDO2_FcoB1TONV_I.outbit "Turn-on delay after Inj. valve cut off on Bank1 / return value" UBYTE B_TRUE 1 100 0.00 1.00000000000 BIT_MASK 0x1 FORMAT "%13.11" ECU_ADDRESS 0x60007B28 /end MEASUREMENT
/begin MEASUREMENT EGSDO2_FcoB1TONV_I.time "Turn-on delay after Inj. valve cut off on Bank1 / expired delay time" UWORD t_q0p01 1 100 0.00 655.3500 FORMAT "%8.4" ECU_ADDRESS 0x60007B2A /end MEASUREMENT
/begin MEASUREMENT EGSDO2_FillgGrdtTONV_I.outbit "Turn-on delay after too large gradient in filling / return value" UBYTE B_TRUE 1 100 0.00 1.00000000000 BIT_MASK 0x1 FORMAT "%13.11" ECU_ADDRESS 0x60007B24 /end MEASUREMENT
/begin MEASUREMENT EGSDO2_FillgGrdtTONV_I.time "Turn-on delay after too large gradient in filling / expired delay time" UWORD t_q0p01 1 100 0.00 655.3500 FORMAT "%8.4" ECU_ADDRESS 0x60007B26 /end MEASUREMENT
/begin MEASUREMENT EGSDO2_FillgTONV_I.outbit "Turn-on delay after sufficiently large filling / return value" UBYTE B_TRUE 1 100 0.00 1.00000000000 BIT_MASK 0x1 FORMAT "%13.11" ECU_ADDRESS 0x5000553E /end MEASUREMENT
/begin MEASUREMENT EGSDO2_FillgTONV_I.time "Turn-on delay after sufficiently large filling / expired delay time" UWORD t_q0p01 1 100 0.00 655.3500 FORMAT "%8.4" ECU_ADDRESS 0x50005540 /end MEASUREMENT
/begin MEASUREMENT EGSDO2_flgArithFiltg "Arithmetic filtering of the sensor upstream active" UBYTE B_TRUE 1 100 0.00 1.00000000000 BIT_MASK 0x1 FORMAT "%13.11" ECU_ADDRESS 0x70000A06 /end MEASUREMENT
/begin MEASUREMENT EGSDO2_flgClrLamDyn100msB1 "Reset of local variables" UBYTE B_TRUE 1 100 0.00 1.00000000000 BIT_MASK 0x1 FORMAT "%13.11" ECU_ADDRESS 0x70000A04 /end MEASUREMENT
/begin MEASUREMENT EGSDO2_flgClrLamDyn10msB1 "Reset of local variables" UBYTE B_TRUE 1 100 0.00 1.00000000000 BIT_MASK 0x1 FORMAT "%13.11" ECU_ADDRESS 0x70000A03 /end MEASUREMENT
/begin MEASUREMENT EGSDO2_flgDlyStepFltLtrB1 "Dynamic error delay lean to rich is detected" UBYTE B_TRUE 1 100 0.00 1.00000000000 BIT_MASK 0x1 FORMAT "%13.11" ECU_ADDRESS 0x70000318 /end MEASUREMENT
/begin MEASUREMENT EGSDO2_flgDlyStepFltRtlB1 "Dynamic error delay rich to lean is detected" UBYTE B_TRUE 1 100 0.00 1.00000000000 BIT_MASK 0x1 FORMAT "%13.11" ECU_ADDRESS 0x70000317 /end MEASUREMENT
/begin MEASUREMENT EGSDO2_flgDSMClrAdpnParlB1 "Indication of clearing of error memory" UBYTE B_TRUE 1 100 0.00 1.00000000000 BIT_MASK 0x1 FORMAT "%13.11" ECU_ADDRESS 0x70000303 /end MEASUREMENT
/begin MEASUREMENT EGSDO2_flgDSMClrEvlnB1 "Indication of clearing of error memory of the EGSDO2_Evln" UBYTE B_TRUE 1 100 0.00 1.00000000000 BIT_MASK 0x1 FORMAT "%13.11" ECU_ADDRESS 0x70000A02 /end MEASUREMENT
/begin MEASUREMENT EGSDO2_flgDSMClrEvlnReqdB1 "Indication of clearing of error memory internally triggered" UBYTE B_TRUE 1 100 0.00 1.00000000000 BIT_MASK 0x1 FORMAT "%13.11" ECU_ADDRESS 0x70000316 /end MEASUREMENT
/begin MEASUREMENT EGSDO2_flgDSMClrIdnEna "DSMClear is requested" UBYTE B_TRUE 1 100 0.00 1.00000000000 BIT_MASK 0x1 FORMAT "%13.11" ECU_ADDRESS 0x7000030C /end MEASUREMENT
/begin MEASUREMENT EGSDO2_flgDynAdpnLtrS1B1 "Dynamic adaptation in lean-rich direction (sensor 1, bank 1)" UBYTE B_TRUE 1 100 0.00 1.00000000000 BIT_MASK 0x1 FORMAT "%13.11" ECU_ADDRESS 0x700009FD /end MEASUREMENT
/begin MEASUREMENT EGSDO2_flgDynAdpnRtlS1B1 "Dynamic adaptation in rich-lean direction (sensor 1, bank 1)" UBYTE B_TRUE 1 100 0.00 1.00000000000 BIT_MASK 0x1 FORMAT "%13.11" ECU_ADDRESS 0x700009FC /end MEASUREMENT
/begin MEASUREMENT EGSDO2_flgDynErrSuspcS1B1 "Error suspicion from dynamic diagnosis (sensor 1, bank 1)" UBYTE B_TRUE 1 100 0.00 1.00000000000 BIT_MASK 0x1 FORMAT "%13.11" ECU_ADDRESS 0x700009FB /end MEASUREMENT
/begin MEASUREMENT EGSDO2_flgDynLtrTripDneS1B1 "Number of step response measurements in lean-rich direction for driving cycle reached (sensor 1, bank 1)" UBYTE B_TRUE 1 100 0.00 1.00000000000 BIT_MASK 0x1 FORMAT "%13.11" ECU_ADDRESS 0x700009FA /end MEASUREMENT
/begin MEASUREMENT EGSDO2_flgDynLtrTripDneVirtS1B1 "Number of virtual step response measurements in lean-rich direction for driving cycle reached (sensor 1, bank 1)" UBYTE B_TRUE 1 100 0.00 1.00000000000 BIT_MASK 0x1 FORMAT "%13.11" ECU_ADDRESS 0x700009F9 /end MEASUREMENT
/begin MEASUREMENT EGSDO2_flgDynRtlTripDneS1B1 "Number of step response measurements in rich-lean direction for driving cycle reached (sensor 1, bank 1)" UBYTE B_TRUE 1 100 0.00 1.00000000000 BIT_MASK 0x1 FORMAT "%13.11" ECU_ADDRESS 0x700009F8 /end MEASUREMENT
/begin MEASUREMENT EGSDO2_flgDynRtlTripDneVirtS1B1 "Number of virtual step response measurements in rich-lean direction for driving cycle reached (sensor 1, bank 1)" UBYTE B_TRUE 1 100 0.00 1.00000000000 BIT_MASK 0x1 FORMAT "%13.11" ECU_ADDRESS 0x700009F7 /end MEASUREMENT
/begin MEASUREMENT EGSDO2_flgDynStepLtrB1 "Step in lean-rich direction" UBYTE B_TRUE 1 100 0.00 1.00000000000 BIT_MASK 0x1 FORMAT "%13.11" ECU_ADDRESS 0x700009F6 /end MEASUREMENT
/begin MEASUREMENT EGSDO2_flgDynStepRtlB1 "Step in rich-lean direction" UBYTE B_TRUE 1 100 0.00 1.00000000000 BIT_MASK 0x1 FORMAT "%13.11" ECU_ADDRESS 0x700009F5 /end MEASUREMENT
/begin MEASUREMENT EGSDO2_flgEnaCmnIdn "Common enabling condition of identification" UBYTE B_TRUE 1 100 0.00 1.00000000000 BIT_MASK 0x1 FORMAT "%13.11" ECU_ADDRESS 0x7000030B /end MEASUREMENT
/begin MEASUREMENT EGSDO2_flgEnaCmnPrjUnSpcIdn "Common Non Project specific Engine operating Condition for online identification Diagnosis." UBYTE B_TRUE 1 100 0.00 1.00000000000 BIT_MASK 0x1 FORMAT "%13.11" ECU_ADDRESS 0x7000030A /end MEASUREMENT
/begin MEASUREMENT EGSDO2_flgEnaIdnB1 "Enabling condition of identification (bank 1)" UBYTE B_TRUE 1 100 0.00 1.00000000000 BIT_MASK 0x1 FORMAT "%13.11" ECU_ADDRESS 0x700009F1 /end MEASUREMENT
/begin MEASUREMENT EGSDO2_flgEnaIdnLtrB1 "Enabling condition of identification in lean-rich direction (bank 1)" UBYTE B_TRUE 1 100 0.00 1.00000000000 BIT_MASK 0x1 FORMAT "%13.11" ECU_ADDRESS 0x700009F0 /end MEASUREMENT
/begin MEASUREMENT EGSDO2_flgEnaIdnRtlB1 "Enabling condition of identification in rich-lean direction (bank 1)" UBYTE B_TRUE 1 100 0.00 1.00000000000 BIT_MASK 0x1 FORMAT "%13.11" ECU_ADDRESS 0x700009EF /end MEASUREMENT
/begin MEASUREMENT EGSDO2_flgEnaLossB1 "Enable conditions of the loss function" UBYTE B_TRUE 1 100 0.00 1.00000000000 BIT_MASK 0x1 FORMAT "%13.11" ECU_ADDRESS 0x700009EE /end MEASUREMENT
/begin MEASUREMENT EGSDO2_flgEnaPrjUnSpcIdnB1 "Common Non Project specific Exhaust Condition for online identification Diagnosis, Bank1" UBYTE B_TRUE 1 100 0.00 1.00000000000 BIT_MASK 0x1 FORMAT "%13.11" ECU_ADDRESS 0x70000309 /end MEASUREMENT
/begin MEASUREMENT EGSDO2_flgFltEvlnB1 "Dynamic error is detected" UBYTE B_TRUE 1 100 0.00 1.00000000000 BIT_MASK 0x1 FORMAT "%13.11" ECU_ADDRESS 0x70000315 /end MEASUREMENT
/begin MEASUREMENT EGSDO2_flgIdnFinshdS1B1 "Identification finished (sensor 1, bank 1)" UBYTE B_TRUE 1 100 0.00 1.00000000000 BIT_MASK 0x1 FORMAT "%13.11" ECU_ADDRESS 0x700009EC /end MEASUREMENT
/begin MEASUREMENT EGSDO2_flgIdnFltS1B1 "Failure in the dynamics of the UEGO O2 signal, detected by online identification" UBYTE B_TRUE 1 100 0.00 1.00000000000 BIT_MASK 0x1 FORMAT "%13.11" ECU_ADDRESS 0x700009EB /end MEASUREMENT
/begin MEASUREMENT EGSDO2_flgIdnFltSuspcDeltaS1B1 "Error suspicion if the deviation of lean to rich and rich to lean is high enough" UBYTE B_TRUE 1 100 0.00 1.00000000000 BIT_MASK 0x1 FORMAT "%13.11" ECU_ADDRESS 0x700009EA /end MEASUREMENT
/begin MEASUREMENT EGSDO2_flgIdnFltSuspcLtrS1B1 "Error suspicion if lean to rich direction value is high enough" UBYTE B_TRUE 1 100 0.00 1.00000000000 BIT_MASK 0x1 FORMAT "%13.11" ECU_ADDRESS 0x700009E9 /end MEASUREMENT
/begin MEASUREMENT EGSDO2_flgIdnFltSuspcRtlS1B1 "Error suspicion if rich to lean direction value is high enough" UBYTE B_TRUE 1 100 0.00 1.00000000000 BIT_MASK 0x1 FORMAT "%13.11" ECU_ADDRESS 0x700009E8 /end MEASUREMENT
/begin MEASUREMENT EGSDO2_flgIdnFltSuspcS1B1 "error suspicion of the online identification" UBYTE B_TRUE 1 100 0.00 1.00000000000 BIT_MASK 0x1 FORMAT "%13.11" ECU_ADDRESS 0x700009E7 /end MEASUREMENT
/begin MEASUREMENT EGSDO2_flgInhbLamDynB1 "Reset of the permission of FId to inhibit lambda-based dynamic diagnosis (sensor 1, bank 1)" UBYTE B_TRUE 1 100 0.00 1.00000000000 BIT_MASK 0x1 FORMAT "%13.11" ECU_ADDRESS 0x70000314 /end MEASUREMENT
/begin MEASUREMENT EGSDO2_flgLamDynDFCErrB1 "Lambda dynamic error path tested with error" UBYTE B_TRUE 1 100 0.00 1.00000000000 BIT_MASK 0x1 FORMAT "%13.11" ECU_ADDRESS 0x700009E6 /end MEASUREMENT
/begin MEASUREMENT EGSDO2_flgLamDynDFCTstdB1 "Lambda dynamic error pathes tested" UBYTE B_TRUE 1 100 0.00 1.00000000000 BIT_MASK 0x1 FORMAT "%13.11" ECU_ADDRESS 0x700009E5 /end MEASUREMENT
/begin MEASUREMENT EGSDO2_flgLamMonOkVirtB1 "Virtual lambda monitoring okay (bank 1)" UBYTE B_TRUE 1 100 0.00 1.00000000000 BIT_MASK 0x1 FORMAT "%13.11" ECU_ADDRESS 0x700009E4 /end MEASUREMENT
/begin MEASUREMENT EGSDO2_flgLossEvlnDneB1 "LossFunction is evaluated" UBYTE B_TRUE 1 100 0.00 1.00000000000 BIT_MASK 0x1 FORMAT "%13.11" ECU_ADDRESS 0x700009DB /end MEASUREMENT
/begin MEASUREMENT EGSDO2_flgLossEvlnRlsStepB1 "Release for special step response measurement for lambda dynamic diagnosis, bank1" UBYTE B_TRUE 1 100 0.00 1.00000000000 BIT_MASK 0x1 FORMAT "%13.11" ECU_ADDRESS 0x70000307 /end MEASUREMENT
/begin MEASUREMENT EGSDO2_flgLtrErrEwmaQckFailS1B1 "Flag denoting Error detection by Quick fail logic in Lean to Rich direction of Lambda dynamic diagnosis during EWMA filtering for Bank1" UBYTE B_TRUE 1 100 0.00 1.00000000000 BIT_MASK 0x1 FORMAT "%13.11" ECU_ADDRESS 0x6000F6B1 /end MEASUREMENT
/begin MEASUREMENT EGSDO2_flgLtrStepChgS1B1 "Sudden deterioration detected (so called step change)" UBYTE B_TRUE 1 100 0.00 1.00000000000 BIT_MASK 0x1 FORMAT "%13.11" ECU_ADDRESS 0x700009DA /end MEASUREMENT
/begin MEASUREMENT EGSDO2_flgQlyDeFltSuspcB1 "Fault suspicious based on loss function calculation, bank1" UBYTE B_TRUE 1 100 0.00 1.00000000000 BIT_MASK 0x1 FORMAT "%13.11" ECU_ADDRESS 0x700009D9 /end MEASUREMENT
/begin MEASUREMENT EGSDO2_flgRstAdpnDynB1 "Reset of the adaption and evaluation values" UBYTE B_TRUE 1 100 0.00 1.00000000000 BIT_MASK 0x1 FORMAT "%13.11" ECU_ADDRESS 0x700009D8 /end MEASUREMENT
/begin MEASUREMENT EGSDO2_flgRstEvlnParl "Reset of local elements (Feature Mutliple Parallelization Executins)" UBYTE B_TRUE 1 100 0.00 1.00000000000 BIT_MASK 0x1 FORMAT "%13.11" ECU_ADDRESS 0x70000313 /end MEASUREMENT
/begin MEASUREMENT EGSDO2_flgRstIdnEnaParl "reset of local variables (Feature of multiple parallelization executions)" UBYTE B_TRUE 1 100 0.00 1.00000000000 BIT_MASK 0x1 FORMAT "%13.11" ECU_ADDRESS 0x70000308 /end MEASUREMENT
/begin MEASUREMENT EGSDO2_flgRstLamDynParl100ms "Reset of local variables" UBYTE B_TRUE 1 100 0.00 1.00000000000 BIT_MASK 0x1 FORMAT "%13.11" ECU_ADDRESS 0x70000306 /end MEASUREMENT
/begin MEASUREMENT EGSDO2_flgRstLamDynParl10ms "Reset of local variables" UBYTE B_TRUE 1 100 0.00 1.00000000000 BIT_MASK 0x1 FORMAT "%13.11" ECU_ADDRESS 0x70000305 /end MEASUREMENT
/begin MEASUREMENT EGSDO2_flgRtlErrEwmaQckFailS1B1 "Flag denoting Error detection by Quick fail logic in Rich to Lean direction of Lambda dynamic diagnosis during EWMA filtering for Bank1" UBYTE B_TRUE 1 100 0.00 1.00000000000 BIT_MASK 0x1 FORMAT "%13.11" ECU_ADDRESS 0x6000F6B0 /end MEASUREMENT
/begin MEASUREMENT EGSDO2_flgRtlStepChgS1B1 "Sudden deterioration detected (so called step change)" UBYTE B_TRUE 1 100 0.00 1.00000000000 BIT_MASK 0x1 FORMAT "%13.11" ECU_ADDRESS 0x700009D7 /end MEASUREMENT
/begin MEASUREMENT EGSDO2_flgSrv06OutpFltEvlnB1 "Service 6 trigger for fault" UBYTE B_TRUE 1 100 0.00 1.00000000000 BIT_MASK 0x1 FORMAT "%13.11" ECU_ADDRESS 0x70000312 /end MEASUREMENT
/begin MEASUREMENT EGSDO2_flgSrv06OutpHealEvlnB1 "Service 6 trigger for healing" UBYTE B_TRUE 1 100 0.00 1.00000000000 BIT_MASK 0x1 FORMAT "%13.11" ECU_ADDRESS 0x70000311 /end MEASUREMENT
/begin MEASUREMENT EGSDO2_flgStepFltB1 "Dynamic error from stepmeasurement is detected" UBYTE B_TRUE 1 100 0.00 1.00000000000 BIT_MASK 0x1 FORMAT "%13.11" ECU_ADDRESS 0x70000310 /end MEASUREMENT
/begin MEASUREMENT EGSDO2_flgStepLtrEvlnS1B1 "Step response measurement in lean-rich direction evaluated (sensor 1, bank 1)" UBYTE B_TRUE 1 100 0.00 1.00000000000 BIT_MASK 0x1 FORMAT "%13.11" ECU_ADDRESS 0x700009D6 /end MEASUREMENT
/begin MEASUREMENT EGSDO2_flgStepRtlEvlnS1B1 "Step response measurement in rich-lean direction evaluated (sensor 1, bank 1)" UBYTE B_TRUE 1 100 0.00 1.00000000000 BIT_MASK 0x1 FORMAT "%13.11" ECU_ADDRESS 0x700009D5 /end MEASUREMENT
/begin MEASUREMENT EGSDO2_flgSymTranOnly "Lambda dynamics diagnosis with symmetric transition time only (1 error pattern)" UBYTE B_TRUE 1 100 0.00 1.00000000000 BIT_MASK 0x1 FORMAT "%13.11" ECU_ADDRESS 0x700009D4 /end MEASUREMENT
/begin MEASUREMENT EGSDO2_flgTranSlowB1 "Transition time unequal to 0 detected in Lambda signal, bank1" UBYTE B_TRUE 1 100 0.00 1.00000000000 BIT_MASK 0x1 FORMAT "%13.11" ECU_ADDRESS 0x70000304 /end MEASUREMENT
/begin MEASUREMENT EGSDO2_flgTranStepFltLtrB1 "Dynamic error from stepmeasurement transition lean to rich is detected" UBYTE B_TRUE 1 100 0.00 1.00000000000 BIT_MASK 0x1 FORMAT "%13.11" ECU_ADDRESS 0x7000030F /end MEASUREMENT
/begin MEASUREMENT EGSDO2_flgTranStepFltRtlB1 "Dynamic error from stepmeasurement transition rich to lean is detected" UBYTE B_TRUE 1 100 0.00 1.00000000000 BIT_MASK 0x1 FORMAT "%13.11" ECU_ADDRESS 0x7000030E /end MEASUREMENT
/begin MEASUREMENT EGSDO2_flgVldEvlnB1 "Validation for the dynamic fault evaluation is done" UBYTE B_TRUE 1 100 0.00 1.00000000000 BIT_MASK 0x1 FORMAT "%13.11" ECU_ADDRESS 0x7000030D /end MEASUREMENT
/begin MEASUREMENT EGSDO2_flgVlvLftEB_I.buffer "High valve lift / EdgeBi.buffer" UBYTE B_TRUE 1 100 0.00 1.00000000000 BIT_MASK 0x1 FORMAT "%13.11" ECU_ADDRESS 0x60007B20 /end MEASUREMENT
/begin MEASUREMENT EGSDO2_flgVlvLftEB_I.oldSignal "High valve lift / EdgeBi.odlSignal" UBYTE B_TRUE 1 100 0.00 1.00000000000 BIT_MASK 0x1 FORMAT "%13.11" ECU_ADDRESS 0x60007B21 /end MEASUREMENT
/begin MEASUREMENT EGSDO2_FltDetnB1_I.cntrStepLtrVirt "Class instance for the evaluation of the dynamic faults of the UEGO sensor / Result counter" UBYTE dez 1 100 0.00 255.0 FORMAT "%5.1" ECU_ADDRESS 0x60039420 /end MEASUREMENT
/begin MEASUREMENT EGSDO2_FltDetnB1_I.cntrStepRtlVirt "Class instance for the evaluation of the dynamic faults of the UEGO sensor / Result counter" UBYTE dez 1 100 0.00 255.0 FORMAT "%5.1" ECU_ADDRESS 0x60039421 /end MEASUREMENT
/begin MEASUREMENT EGSDO2_FltDetnB1_I.flgDlyIdnFltLtr "Class instance for the evaluation of the dynamic faults of the UEGO sensor / Delay time error lean to rich, detected by online identification" UBYTE B_TRUE 1 100 0.00 1.00000000000 BIT_MASK 0x1 FORMAT "%13.11" ECU_ADDRESS 0x50005542 /end MEASUREMENT
/begin MEASUREMENT EGSDO2_FltDetnB1_I.flgDlyIdnFltRtl "Class instance for the evaluation of the dynamic faults of the UEGO sensor / Delay time error rich to lean, detected by online identification" UBYTE B_TRUE 1 100 0.00 1.00000000000 BIT_MASK 0x1 FORMAT "%13.11" ECU_ADDRESS 0x50005543 /end MEASUREMENT
/begin MEASUREMENT EGSDO2_FltDetnB1_I.flgDynLtrDne "Class instance for the evaluation of the dynamic faults of the UEGO sensor / Dynamic diagnosis in lean-rich direction done" UBYTE B_TRUE 1 100 0.00 1.00000000000 BIT_MASK 0x1 FORMAT "%13.11" ECU_ADDRESS 0x50005544 /end MEASUREMENT
/begin MEASUREMENT EGSDO2_FltDetnB1_I.flgDynLtrDneVirt "Class instance for the evaluation of the dynamic faults of the UEGO sensor / Evaluation of the virtual dynamic fault done" UBYTE B_TRUE 1 100 0.00 1.00000000000 BIT_MASK 0x1 FORMAT "%13.11" ECU_ADDRESS 0x50005545 /end MEASUREMENT
/begin MEASUREMENT EGSDO2_FltDetnB1_I.flgDynLtrTripDne "Class instance for the evaluation of the dynamic faults of the UEGO sensor / Dynamic diagnosis in lean-rich direction in current trip done" UBYTE B_TRUE 1 100 0.00 1.00000000000 BIT_MASK 0x1 FORMAT "%13.11" ECU_ADDRESS 0x50005546 /end MEASUREMENT
/begin MEASUREMENT EGSDO2_FltDetnB1_I.flgDynLtrTripDneVirt "Class instance for the evaluation of the dynamic faults of the UEGO sensor / Evaluation of the virtual dynamic fault during trip done" UBYTE B_TRUE 1 100 0.00 1.00000000000 BIT_MASK 0x1 FORMAT "%13.11" ECU_ADDRESS 0x50005547 /end MEASUREMENT
/begin MEASUREMENT EGSDO2_FltDetnB1_I.flgDynRtlDne "Class instance for the evaluation of the dynamic faults of the UEGO sensor / Dynamic diagnosis in rich-lean direction done" UBYTE B_TRUE 1 100 0.00 1.00000000000 BIT_MASK 0x1 FORMAT "%13.11" ECU_ADDRESS 0x50005548 /end MEASUREMENT
/begin MEASUREMENT EGSDO2_FltDetnB1_I.flgDynRtlDneVirt "Class instance for the evaluation of the dynamic faults of the UEGO sensor / Evaluation of the virtual dynamic fault done" UBYTE B_TRUE 1 100 0.00 1.00000000000 BIT_MASK 0x1 FORMAT "%13.11" ECU_ADDRESS 0x50005549 /end MEASUREMENT
/begin MEASUREMENT EGSDO2_FltDetnB1_I.flgDynRtlTripDne "Class instance for the evaluation of the dynamic faults of the UEGO sensor / Dynamic diagnosis in rich-lean direction in current trip done" UBYTE B_TRUE 1 100 0.00 1.00000000000 BIT_MASK 0x1 FORMAT "%13.11" ECU_ADDRESS 0x5000554A /end MEASUREMENT
/begin MEASUREMENT EGSDO2_FltDetnB1_I.flgDynRtlTripDneVirt "Class instance for the evaluation of the dynamic faults of the UEGO sensor / Evaluation of the virtual dynamic fault during trip done" UBYTE B_TRUE 1 100 0.00 1.00000000000 BIT_MASK 0x1 FORMAT "%13.11" ECU_ADDRESS 0x5000554B /end MEASUREMENT
/begin MEASUREMENT EGSDO2_FltDetnB1_I.flgIdnFlt "Class instance for the evaluation of the dynamic faults of the UEGO sensor / Fault detected from identification" UBYTE B_TRUE 1 100 0.00 1.00000000000 BIT_MASK 0x1 FORMAT "%13.11" ECU_ADDRESS 0x5000554C /end MEASUREMENT
/begin MEASUREMENT EGSDO2_FltDetnB1_I.flgInitER "Class instance for the evaluation of the dynamic faults of the UEGO sensor / Class containing the fault detection algorithm" UBYTE B_TRUE 1 100 0.00 1.00000000000 BIT_MASK 0x1 FORMAT "%13.11" ECU_ADDRESS 0x50005551 /end MEASUREMENT
/begin MEASUREMENT EGSDO2_FltDetnB1_I.flgQckPassdFaildLtr "Class instance for the evaluation of the dynamic faults of the UEGO sensor / Quick pass check failed in lean-rich direction" UBYTE B_TRUE 1 100 0.00 1.00000000000 BIT_MASK 0x1 FORMAT "%13.11" ECU_ADDRESS 0x5000554D /end MEASUREMENT
/begin MEASUREMENT EGSDO2_FltDetnB1_I.flgQckPassdFaildRtl "Class instance for the evaluation of the dynamic faults of the UEGO sensor / Quick pass check failed in rich-lean direction" UBYTE B_TRUE 1 100 0.00 1.00000000000 BIT_MASK 0x1 FORMAT "%13.11" ECU_ADDRESS 0x5000554E /end MEASUREMENT
/begin MEASUREMENT EGSDO2_FltDetnB1_I.flgQckPassdLtr "Class instance for the evaluation of the dynamic faults of the UEGO sensor / ." UBYTE B_TRUE 1 100 0.00 1.00000000000 BIT_MASK 0x2 FORMAT "%13.11" ECU_ADDRESS 0x50005551 /end MEASUREMENT
/begin MEASUREMENT EGSDO2_FltDetnB1_I.flgQckPassdRtl "Class instance for the evaluation of the dynamic faults of the UEGO sensor / ." UBYTE B_TRUE 1 100 0.00 1.00000000000 BIT_MASK 0x4 FORMAT "%13.11" ECU_ADDRESS 0x50005551 /end MEASUREMENT
/begin MEASUREMENT EGSDO2_FltDetnB1_I.flgTranIdnFltLtr "Class instance for the evaluation of the dynamic faults of the UEGO sensor / Time constant error lean to rich, detected by online identification" UBYTE B_TRUE 1 100 0.00 1.00000000000 BIT_MASK 0x1 FORMAT "%13.11" ECU_ADDRESS 0x5000554F /end MEASUREMENT
/begin MEASUREMENT EGSDO2_FltDetnB1_I.flgTranIdnFltRtl "Class instance for the evaluation of the dynamic faults of the UEGO sensor / Time constant error rich to lean, detected by online identification" UBYTE B_TRUE 1 100 0.00 1.00000000000 BIT_MASK 0x1 FORMAT "%13.11" ECU_ADDRESS 0x50005550 /end MEASUREMENT
/begin MEASUREMENT EGSDO2_FltDetnB1_I.stEwmaVirtModLtr "Class instance for the evaluation of the dynamic faults of the UEGO sensor / Current mode of EWMA filter for IUMPR Simulation" UBYTE OneToOne 1 100 0.00 2.000 FORMAT "%5.3" ECU_ADDRESS 0x60039422 /end MEASUREMENT
/begin MEASUREMENT EGSDO2_FltDetnB1_I.stEwmaVirtModLtrEnum "Class instance for the evaluation of the dynamic faults of the UEGO sensor / Enumeration Variable denoting the EWMA Status for IUMPR Simulation in Lean to Rich direction of LSU Dynamic diagnosis" UBYTE EGSDO2_Evln_Enum_VERB 1 100 0.00 2.00000000000 FORMAT "%13.11" ECU_ADDRESS 0x60039423 /end MEASUREMENT
/begin MEASUREMENT EGSDO2_FltDetnB1_I.stEwmaVirtModRtl "Class instance for the evaluation of the dynamic faults of the UEGO sensor / Current mode of EWMA filter for IUMPR Simulation" UBYTE OneToOne 1 100 0.00 2.000 FORMAT "%5.3" ECU_ADDRESS 0x60039424 /end MEASUREMENT
/begin MEASUREMENT EGSDO2_FltDetnB1_I.stEwmaVirtModRtlEnum "Class instance for the evaluation of the dynamic faults of the UEGO sensor / Enumeration Variable denoting the EWMA Status for IUMPR Simulation in Rich to Lean direction of LSU Dynamic diagnosis" UBYTE EGSDO2_Evln_Enum_VERB 1 100 0.00 2.00000000000 FORMAT "%13.11" ECU_ADDRESS 0x60039425 /end MEASUREMENT
/begin MEASUREMENT EGSDO2_FltDetnB1_I.tiDlyIdnLtrFlt "Class instance for the evaluation of the dynamic faults of the UEGO sensor / Delay time from identifikation lean to rich" UWORD t_q0p01 1 100 0.00 655.3500 FORMAT "%8.4" ECU_ADDRESS 0x50005552 /end MEASUREMENT
/begin MEASUREMENT EGSDO2_FltDetnB1_I.tiDlyIdnRtlFlt "Class instance for the evaluation of the dynamic faults of the UEGO sensor / Delay time from identifikation rich to lean" UWORD t_q0p01 1 100 0.00 655.3500 FORMAT "%8.4" ECU_ADDRESS 0x50005554 /end MEASUREMENT
/begin MEASUREMENT EGSDO2_FltDetnB1_I.tiSumIdnLtr "Class instance for the evaluation of the dynamic faults of the UEGO sensor / Summed time of identification in lean-rich direction" UWORD t_q0p01 1 100 0.00 655.3500 FORMAT "%8.4" ECU_ADDRESS 0x50005556 /end MEASUREMENT
/begin MEASUREMENT EGSDO2_FltDetnB1_I.tiSumIdnRtl "Class instance for the evaluation of the dynamic faults of the UEGO sensor / Summed time of identification in rich-lean direction" UWORD t_q0p01 1 100 0.00 655.3500 FORMAT "%8.4" ECU_ADDRESS 0x50005558 /end MEASUREMENT
/begin MEASUREMENT EGSDO2_FltDetnB1_I.tiTranIdnLtrFlt "Class instance for the evaluation of the dynamic faults of the UEGO sensor / Transition time from identifikation lean to rich" UWORD t_q0p01 1 100 0.00 655.3500 FORMAT "%8.4" ECU_ADDRESS 0x5000555A /end MEASUREMENT
/begin MEASUREMENT EGSDO2_FltDetnB1_I.tiTranIdnRtlFlt "Class instance for the evaluation of the dynamic faults of the UEGO sensor / Transition time from identifikation rich to lean" UWORD t_q0p01 1 100 0.00 655.3500 FORMAT "%8.4" ECU_ADDRESS 0x5000555C /end MEASUREMENT
/begin MEASUREMENT EGSDO2_FltDetnB1_I.LamDynQckPassdDlyLtr_I.flgQckPassdFaild "Class instance for the evaluation of the dynamic faults of the UEGO sensor / Class for quick-pass for lambda-based dynamics diagnosis of a wideband-sensor, delay error in lean-rich direction / Quick pass failed" UBYTE B_TRUE 1 100 0.00 1.00000000000 BIT_MASK 0x1 FORMAT "%13.11" ECU_ADDRESS 0x5000555E /end MEASUREMENT
/begin MEASUREMENT EGSDO2_FltDetnB1_I.LamDynQckPassdDlyRtl_I.flgQckPassdFaild "Class instance for the evaluation of the dynamic faults of the UEGO sensor / Class for quick-pass for lambda-based dynamics diagnosis of a wideband-sensor, delay error in rich-lean direction / Quick pass failed" UBYTE B_TRUE 1 100 0.00 1.00000000000 BIT_MASK 0x1 FORMAT "%13.11" ECU_ADDRESS 0x5000555F /end MEASUREMENT
/begin MEASUREMENT EGSDO2_FltDetnB1_I.LamDynQckPassdTranLtr_I.flgQckPassdFaild "Class instance for the evaluation of the dynamic faults of the UEGO sensor / Class for quick-pass for lambda-based dynamics diagnosis of a wideband-sensor, transition error in lean-rich direction / Quick pass failed" UBYTE B_TRUE 1 100 0.00 1.00000000000 BIT_MASK 0x1 FORMAT "%13.11" ECU_ADDRESS 0x50005560 /end MEASUREMENT
/begin MEASUREMENT EGSDO2_FltDetnB1_I.LamDynQckPassdTranRtl_I.flgQckPassdFaild "Class instance for the evaluation of the dynamic faults of the UEGO sensor / Class for quick-pass for lambda-based dynamics diagnosis of a wideband-sensor, transition error in rich-lean direction / Quick pass failed" UBYTE B_TRUE 1 100 0.00 1.00000000000 BIT_MASK 0x1 FORMAT "%13.11" ECU_ADDRESS 0x50005561 /end MEASUREMENT
/begin MEASUREMENT EGSDO2_FltDetnB1_I.cntrStepLtrTripVirtDOS_I.buffer "Class instance for the evaluation of the dynamic faults of the UEGO sensor / Resultcounter counts / Buffer element for deltaonestep" SWORD OneToOne 1 100 -32768.00 32767.00 FORMAT "%8.2" ECU_ADDRESS 0x50005566 /end MEASUREMENT
/begin MEASUREMENT EGSDO2_FltDetnB1_I.cntrStepLtrTripVirtDOS_I.oldValue "Class instance for the evaluation of the dynamic faults of the UEGO sensor / Resultcounter counts / Describes the input value one time step ahead of the current time" SWORD OneToOne 1 100 -32768.00 32767.00 FORMAT "%8.2" ECU_ADDRESS 0x50005568 /end MEASUREMENT
/begin MEASUREMENT EGSDO2_FltDetnB1_I.cntrStepRtlTripVirtDOS_I.buffer "Class instance for the evaluation of the dynamic faults of the UEGO sensor / Resultcounter counts / Buffer element for deltaonestep" SWORD OneToOne 1 100 -32768.00 32767.00 FORMAT "%8.2" ECU_ADDRESS 0x5000556A /end MEASUREMENT
/begin MEASUREMENT EGSDO2_FltDetnB1_I.cntrStepRtlTripVirtDOS_I.oldValue "Class instance for the evaluation of the dynamic faults of the UEGO sensor / Resultcounter counts / Describes the input value one time step ahead of the current time" SWORD OneToOne 1 100 -32768.00 32767.00 FORMAT "%8.2" ECU_ADDRESS 0x5000556C /end MEASUREMENT
/begin MEASUREMENT EGSDO2_LamDynAdpnCalcB1_I.flgDynLtr "Class for the calculation of the plant parameter / Adaption in lean to rich direction" UBYTE B_TRUE 1 100 0.00 1.00000000000 BIT_MASK 0x1 FORMAT "%13.11" ECU_ADDRESS 0x60039400 /end MEASUREMENT
/begin MEASUREMENT EGSDO2_LamDynAdpnCalcB1_I.flgDynRtl "Class for the calculation of the plant parameter / Adaption in rich to lean direction" UBYTE B_TRUE 1 100 0.00 1.00000000000 BIT_MASK 0x1 FORMAT "%13.11" ECU_ADDRESS 0x60039401 /end MEASUREMENT
/begin MEASUREMENT EGSDO2_LamDynAdpnCalcB1_I.flgIdnDne "Class for the calculation of the plant parameter / Online identification adaption done" UBYTE B_TRUE 1 100 0.00 1.00000000000 BIT_MASK 0x1 FORMAT "%13.11" ECU_ADDRESS 0x50001738 /end MEASUREMENT
/begin MEASUREMENT EGSDO2_LamDynAdpnCalcB1_I.flgIdnEvln "Class for the calculation of the plant parameter / Evaluate online identification adaption" UBYTE B_TRUE 1 100 0.00 1.00000000000 BIT_MASK 0x1 FORMAT "%13.11" ECU_ADDRESS 0x5000173D /end MEASUREMENT
/begin MEASUREMENT EGSDO2_LamDynAdpnCalcB1_I.flgIdnFirstDne "Class for the calculation of the plant parameter / first online identification adaption evaluation done" UBYTE B_TRUE 1 100 0.00 1.00000000000 BIT_MASK 0x1 FORMAT "%13.11" ECU_ADDRESS 0x50001739 /end MEASUREMENT
/begin MEASUREMENT EGSDO2_LamDynAdpnCalcB1_I.flgIdnMax "Class for the calculation of the plant parameter / Maximum adaption time for the online identification reached" UBYTE B_TRUE 1 100 0.00 1.00000000000 BIT_MASK 0x2 FORMAT "%13.11" ECU_ADDRESS 0x5000173D /end MEASUREMENT
/begin MEASUREMENT EGSDO2_LamDynAdpnCalcB1_I.flgStepDlyLtr "Class for the calculation of the plant parameter / Trigger for the delay time lean to rich" UBYTE B_TRUE 1 100 0.00 1.00000000000 BIT_MASK 0x4 FORMAT "%13.11" ECU_ADDRESS 0x5000173D /end MEASUREMENT
/begin MEASUREMENT EGSDO2_LamDynAdpnCalcB1_I.flgStepDlyRtl "Class for the calculation of the plant parameter / Trigger for the delay time rich to lean" UBYTE B_TRUE 1 100 0.00 1.00000000000 BIT_MASK 0x8 FORMAT "%13.11" ECU_ADDRESS 0x5000173D /end MEASUREMENT
/begin MEASUREMENT EGSDO2_LamDynAdpnCalcB1_I.flgStepDlySym "Class for the calculation of the plant parameter / Trigger for the delay time symmetrical" UBYTE B_TRUE 1 100 0.00 1.00000000000 BIT_MASK 0x10 FORMAT "%13.11" ECU_ADDRESS 0x5000173D /end MEASUREMENT
/begin MEASUREMENT EGSDO2_LamDynAdpnCalcB1_I.flgStepEvln "Class for the calculation of the plant parameter / Step adaption evaluate" UBYTE B_TRUE 1 100 0.00 1.00000000000 BIT_MASK 0x20 FORMAT "%13.11" ECU_ADDRESS 0x5000173D /end MEASUREMENT
/begin MEASUREMENT EGSDO2_LamDynAdpnCalcB1_I.flgStepLtr "Class for the calculation of the plant parameter / Step adaption lean to rich" UBYTE B_TRUE 1 100 0.00 1.00000000000 BIT_MASK 0x40 FORMAT "%13.11" ECU_ADDRESS 0x5000173D /end MEASUREMENT
/begin MEASUREMENT EGSDO2_LamDynAdpnCalcB1_I.flgStepLtrDne "Class for the calculation of the plant parameter / Step adaption rich to lean evaluate" UBYTE B_TRUE 1 100 0.00 1.00000000000 BIT_MASK 0x1 FORMAT "%13.11" ECU_ADDRESS 0x5000173A /end MEASUREMENT
/begin MEASUREMENT EGSDO2_LamDynAdpnCalcB1_I.flgStepRtl "Class for the calculation of the plant parameter / Step adaption rich to lean" UBYTE B_TRUE 1 100 0.00 1.00000000000 BIT_MASK 0x80 FORMAT "%13.11" ECU_ADDRESS 0x5000173D /end MEASUREMENT
/begin MEASUREMENT EGSDO2_LamDynAdpnCalcB1_I.flgStepRtlDne "Class for the calculation of the plant parameter / Step adaption rich to lean evaluate" UBYTE B_TRUE 1 100 0.00 1.00000000000 BIT_MASK 0x1 FORMAT "%13.11" ECU_ADDRESS 0x5000173B /end MEASUREMENT
/begin MEASUREMENT EGSDO2_LamDynAdpnCalcB1_I.flgStepSym "Class for the calculation of the plant parameter / Step adaption symmetrical" UBYTE B_TRUE 1 100 0.00 1.00000000000 BIT_MASK 0x1 FORMAT "%13.11" ECU_ADDRESS 0x5000173C /end MEASUREMENT
/begin MEASUREMENT EGSDO2_LamDynAdpnCalcB1_I.stStep "Class for the calculation of the plant parameter / Detected error pattern" UBYTE dez 1 100 0.00 255.0 FORMAT "%5.1" ECU_ADDRESS 0x5000173E /end MEASUREMENT
/begin MEASUREMENT EGSDO2_LamDynAdpnCalcB1_I.tiDly "Class for the calculation of the plant parameter / Delay time" UWORD t_q0p01 1 100 0.00 655.3500 FORMAT "%8.4" ECU_ADDRESS 0x60039402 /end MEASUREMENT
/begin MEASUREMENT EGSDO2_LamDynAdpnCalcB1_I.tiDlyNotFild "Class for the calculation of the plant parameter / Delay time unfiltered" UWORD t_q0p01 1 100 0.00 655.3500 FORMAT "%8.4" ECU_ADDRESS 0x50001740 /end MEASUREMENT
/begin MEASUREMENT EGSDO2_LamDynAdpnCalcB1_I.tiSumTran "Class for the calculation of the plant parameter / Symmetrical transition time" UWORD t_q0p01 1 100 0.00 655.3500 FORMAT "%8.4" ECU_ADDRESS 0x50001742 /end MEASUREMENT
/begin MEASUREMENT EGSDO2_LamDynAdpnCalcB1_I.tiTran "Class for the calculation of the plant parameter / Transition time for adaptation" UWORD t_q0p01 1 100 0.00 655.3500 FORMAT "%8.4" ECU_ADDRESS 0x60039404 /end MEASUREMENT
/begin MEASUREMENT EGSDO2_LamDynAdpnCalcB1_I.tiTranNotFild "Class for the calculation of the plant parameter / Transition time for adaptation unfiltered" UWORD t_q0p01 1 100 0.00 655.3500 FORMAT "%8.4" ECU_ADDRESS 0x50001744 /end MEASUREMENT
/begin MEASUREMENT EGSDO2_LamDynAdpnCalcB1_I.AdpnFilDlyLT_I.memory "Class for the calculation of the plant parameter / Filter of the delay adaption time / current lowpass value" ULONG q1p5259Em7_s 1 100 0.00 655.359999847 FORMAT "%13.9" ECU_ADDRESS 0x50001748 /end MEASUREMENT
/begin MEASUREMENT EGSDO2_LamDynAdpnCalcB1_I.AdpnFilTranLT_I.memory "Class for the calculation of the plant parameter / Filter of the transition adaption time / current lowpass value" ULONG q1p5259Em7_s 1 100 0.00 655.359999847 FORMAT "%13.9" ECU_ADDRESS 0x5000174C /end MEASUREMENT
/begin MEASUREMENT EGSDO2_LamDynAdpnCalcB1_I.tiEnaIdnLtrSWE_I.timeCounter "Class for the calculation of the plant parameter / Time of the necessary adaption time of the online identification lean to rich / Elapsed time since start" UWORD t_q0p1 1 100 0.00 6553.500 FORMAT "%8.3" ECU_ADDRESS 0x50001750 /end MEASUREMENT
/begin MEASUREMENT EGSDO2_LamDynAdpnCalcB1_I.tiEnaIdnRtlSWE_I.timeCounter "Class for the calculation of the plant parameter / Time of the necessary adaption time of the online identification rich to lean / Elapsed time since start" UWORD t_q0p1 1 100 0.00 6553.500 FORMAT "%8.3" ECU_ADDRESS 0x50001752 /end MEASUREMENT
/begin MEASUREMENT EGSDO2_LamDynAdpnInhbS1B1ER_I.buffer "Trigger adaption inhibition / rising edge detected" UBYTE B_TRUE 1 100 0.00 1.00000000000 BIT_MASK 0x1 FORMAT "%13.11" ECU_ADDRESS 0x60007B04 /end MEASUREMENT
/begin MEASUREMENT EGSDO2_LamDynAdpnInhbS1B1ER_I.oldSignal "Trigger adaption inhibition / flag rising edge" UBYTE B_TRUE 1 100 0.00 1.00000000000 BIT_MASK 0x1 FORMAT "%13.11" ECU_ADDRESS 0x60007B05 /end MEASUREMENT
/begin MEASUREMENT EGSDO2_LamDynNoInhb100msS1B1EFNM_I.oldSignal "DSM inhibit of lambda based dynamics diagnostic revoked (edge falling, 100ms task) (sensor 1, bank 1) / memory to detect falling edge" UBYTE B_TRUE 1 100 0.00 1.00000000000 BIT_MASK 0x1 FORMAT "%13.11" ECU_ADDRESS 0x6000BA46 /end MEASUREMENT
/begin MEASUREMENT EGSDO2_LamDynNoInhbS1B1EF_I.buffer "DSM inhibit of lambda based dynamics diagnostic revoked (edge falling) (sensor 1, bank 1) / memory to detect falling edge" UBYTE B_TRUE 1 100 0.00 1.00000000000 BIT_MASK 0x1 FORMAT "%13.11" ECU_ADDRESS 0x60007B0C /end MEASUREMENT
/begin MEASUREMENT EGSDO2_LamDynNoInhbS1B1EF_I.oldSignal "DSM inhibit of lambda based dynamics diagnostic revoked (edge falling) (sensor 1, bank 1) / memory to detect falling edge" UBYTE B_TRUE 1 100 0.00 1.00000000000 BIT_MASK 0x1 FORMAT "%13.11" ECU_ADDRESS 0x60007B0D /end MEASUREMENT
/begin MEASUREMENT EGSDO2_mfExhFilB1LT_I.memory "Filter for calculation of exhaust mass flow derivative (bank 1) / current lowpass value" ULONG m_q1p526Em6_g 1 100 0.00 6553.59999847 FORMAT "%13.8" ECU_ADDRESS 0x60002D84 /end MEASUREMENT
/begin MEASUREMENT EGSDO2_nrMeasLtrTrpS1B1 "Number of step response measurements in lean-rich direction for driving cycle (sensor 1, bank 1)" UBYTE dez 1 100 0.00 255.0 FORMAT "%5.1" ECU_ADDRESS 0x60014AA8 /end MEASUREMENT
/begin MEASUREMENT EGSDO2_nrMeasRtlTrpS1B1 "Number of step response measurements in rich-lean direction for driving cycle (sensor 1, bank 1)" UBYTE dez 1 100 0.00 255.0 FORMAT "%5.1" ECU_ADDRESS 0x60014AA9 /end MEASUREMENT
/begin MEASUREMENT EGSDO2_QlyDeFltSuspcB1FF_I.status "Error suspicion of the loss function / current value of RS-FF" UBYTE B_TRUE 1 100 0.00 1.00000000000 BIT_MASK 0x1 FORMAT "%13.11" ECU_ADDRESS 0x6000BA45 /end MEASUREMENT
/begin MEASUREMENT EGSDO2_ratFillgPredDt1LT_I.memory "Filter for relative filling to calculate gradient (DT1) / current lowpass value" ULONG rel_q3p5763Em7 1 100 0.00 1535.99999964 FORMAT "%13.8" ECU_ADDRESS 0x60002D80 /end MEASUREMENT
/begin MEASUREMENT EGSDO2_ratLamRecprStepHeiB1 "Step height in reciprocal lambda, bank1" UWORD fak_uw_b2 1 100 0.00 1.999969 FORMAT "%8.6" ECU_ADDRESS 0x60013CDE /end MEASUREMENT
/begin MEASUREMENT EGSDO2_RstAdpnDynB1FF_I.status "Reset of the adaption and evaluation values / current value of RS-FF" UBYTE B_TRUE 1 100 0.00 1.00000000000 BIT_MASK 0x1 FORMAT "%13.11" ECU_ADDRESS 0x6000BA44 /end MEASUREMENT
/begin MEASUREMENT EGSDO2_ShiftTONV_I.outbit "Turn-on delay after gear shift / return value" UBYTE B_TRUE 1 100 0.00 1.00000000000 BIT_MASK 0x1 FORMAT "%13.11" ECU_ADDRESS 0x60007B22 /end MEASUREMENT
/begin MEASUREMENT EGSDO2_ShiftTONV_I.time "Turn-on delay after gear shift / expired delay time" UBYTE t_q0p01 1 100 0.00 2.550 FORMAT "%5.3" ECU_ADDRESS 0x60007B23 /end MEASUREMENT
/begin MEASUREMENT EGSDO2_StepIf.dratLamRecprFild "class instance for step resond measurement signals / Temporary variable in interface class" SWORD freq_q9p1553Em5 1 100 -3.000000 2.999908 FORMAT "%8.6" ECU_ADDRESS 0x60013CC8 /end MEASUREMENT
/begin MEASUREMENT EGSDO2_StepIf.flgTranSlow "class instance for step resond measurement signals / LSU Dynamic transition error is recognized" UBYTE B_TRUE 1 100 0.00 1.00000000000 BIT_MASK 0x1 FORMAT "%13.11" ECU_ADDRESS 0x60013CCA /end MEASUREMENT
/begin MEASUREMENT EGSDO2_StepIf.lamsbg_w "class instance for step resond measurement signals / Temporary variable in interface class" UWORD fak_uw_b16 1 100 0.00 15.99976 FORMAT "%8.5" ECU_ADDRESS 0x60013CCC /end MEASUREMENT
/begin MEASUREMENT EGSDO2_StepIf.ratLamRecprFild "class instance for step resond measurement signals / Temporary variable in interface class" UWORD fak_uw_b2 1 100 0.00 1.999969 FORMAT "%8.6" ECU_ADDRESS 0x60013CCE /end MEASUREMENT
/begin MEASUREMENT EGSDO2_StepIf.ratLamRecprStepHei "class instance for step resond measurement signals / Step height in reciprocal lambda" UWORD fak_uw_b2 1 100 0.00 1.999969 FORMAT "%8.6" ECU_ADDRESS 0x60013CD0 /end MEASUREMENT
/begin MEASUREMENT EGSDO2_StepIf.stLamGenrParl "class instance for step resond measurement signals / Temporary variable in interface class" UBYTE OneToOne 1 100 0.00 255.0 FORMAT "%5.1" ECU_ADDRESS 0x60013CD2 /end MEASUREMENT
/begin MEASUREMENT EGSDO2_StepIf.tlrslb_w "class instance for step resond measurement signals / Temporary variable in interface class" UWORD t_q0p01 1 100 0.0100 655.3500 FORMAT "%8.4" ECU_ADDRESS 0x60013CD4 /end MEASUREMENT
/begin MEASUREMENT EGSDO2_StepIf.zlrslb_w "class instance for step resond measurement signals / Temporary variable in interface class" UWORD t_q0p01 1 100 0.0100 655.3500 FORMAT "%8.4" ECU_ADDRESS 0x60013CD6 /end MEASUREMENT
/begin MEASUREMENT EGSDO2_StepStateB1_I.flgDynStepLtrReset "Calculation in which State the step measurement should be calulate / Reset of Step Measurment Ltr" UBYTE B_TRUE 1 100 0.00 1.00000000000 BIT_MASK 0x1 FORMAT "%13.11" ECU_ADDRESS 0x60007B06 /end MEASUREMENT
/begin MEASUREMENT EGSDO2_StepStateB1_I.flgDynStepLtrSet "Calculation in which State the step measurement should be calulate / start of Measurement Rtl" UBYTE B_TRUE 1 100 0.00 1.00000000000 BIT_MASK 0x1 FORMAT "%13.11" ECU_ADDRESS 0x60007B07 /end MEASUREMENT
/begin MEASUREMENT EGSDO2_StepStateB1_I.flgDynStepRtlReset "Calculation in which State the step measurement should be calulate / Reset of Step Measurment Rtl" UBYTE B_TRUE 1 100 0.00 1.00000000000 BIT_MASK 0x1 FORMAT "%13.11" ECU_ADDRESS 0x60007B08 /end MEASUREMENT
/begin MEASUREMENT EGSDO2_StepStateB1_I.flgDynStepRtlSet "Calculation in which State the step measurement should be calulate / start of Measurement Rtl" UBYTE B_TRUE 1 100 0.00 1.00000000000 BIT_MASK 0x1 FORMAT "%13.11" ECU_ADDRESS 0x60007B09 /end MEASUREMENT
/begin MEASUREMENT EGSDO2_stEwmaModLtrS1B1 "Status of EWMA filter in Lean to Rich Direction for Sensor 1 Bank1" UBYTE OneToOne 1 100 0.00 2.000 FORMAT "%5.3" ECU_ADDRESS 0x6000F7FA /end MEASUREMENT
/begin MEASUREMENT EGSDO2_stEwmaModRtlS1B1 "Status of EWMA filter in Rich to Lean Direction for Sensor 1 Bank1" UBYTE OneToOne 1 100 0.00 2.000 FORMAT "%5.3" ECU_ADDRESS 0x6000F7F9 /end MEASUREMENT
/begin MEASUREMENT EGSDO2_StrtTONV_I.outbit "Turn-on delay after end of engine start / return value" UBYTE B_TRUE 1 100 0.00 1.00000000000 BIT_MASK 0x1 FORMAT "%13.11" ECU_ADDRESS 0x5000556E /end MEASUREMENT
/begin MEASUREMENT EGSDO2_StrtTONV_I.time "Turn-on delay after end of engine start / expired delay time" UWORD t_q0p01 1 100 0.00 655.3500 FORMAT "%8.4" ECU_ADDRESS 0x50005570 /end MEASUREMENT
/begin MEASUREMENT EGSDO2_stStepB1 "Status of step response measurement (detected pattern, bank 1)" UBYTE OneToOne 1 100 0.00 255.0 FORMAT "%5.1" ECU_ADDRESS 0x6000F7F8 /end MEASUREMENT
/begin MEASUREMENT EGSDO2_stStepNVB1 "Status of the pattern detection" UBYTE OneToOne 1 100 0.00 255.0 FORMAT "%5.1" ECU_ADDRESS 0x60039406 /end MEASUREMENT
/begin MEASUREMENT EGSDO2_tiDlyAdpnS1B1 "Upstream sensor delay time used for dynamics adaptation (sensor 1, bank 1)" UWORD t_q0p01 1 100 0.00 655.3500 FORMAT "%8.4" ECU_ADDRESS 0x60008F8C /end MEASUREMENT
/begin MEASUREMENT EGSDO2_tiDlyEwmaLtrS1B1 "EWMA filtered Delay time Lean-to-rich UEGO S1 Bank 1" UWORD t_q0p01 1 100 0.00 655.3500 FORMAT "%8.4" ECU_ADDRESS 0x60008F8A /end MEASUREMENT
/begin MEASUREMENT EGSDO2_tiDlyEwmaRtlS1B1 "EWMA filtered Delay time Rich-to-Lean UEGO S1 Bank 1" UWORD t_q0p01 1 100 0.00 655.3500 FORMAT "%8.4" ECU_ADDRESS 0x60008F88 /end MEASUREMENT
/begin MEASUREMENT EGSDO2_tiDlyIdnLtrB1 "Identified delay time in lean-rich direction (bank 1)" UWORD t_q0p01 1 100 0.00 655.3500 FORMAT "%8.4" ECU_ADDRESS 0x600094B6 /end MEASUREMENT
/begin MEASUREMENT EGSDO2_tiDlyIdnRtlB1 "Identified delay time in rich-lean direction (bank 1)" UWORD t_q0p01 1 100 0.00 655.3500 FORMAT "%8.4" ECU_ADDRESS 0x600094B4 /end MEASUREMENT
/begin MEASUREMENT EGSDO2_tiDlyLtrS1B1 "Delay time from step response measurement in lean-rich direction (sensor 1, bank 1)" UWORD t_q0p01 1 100 0.00 655.3500 FORMAT "%8.4" ECU_ADDRESS 0x6001481E /end MEASUREMENT
/begin MEASUREMENT EGSDO2_tiDlyLtrStepS1B1 "Delay time from current step response measurement in lean-lean direction (sensor 1, bank 1)" SWORD t_q0p01 1 100 -327.6800 327.6700 FORMAT "%8.4" ECU_ADDRESS 0x60009208 /end MEASUREMENT
/begin MEASUREMENT EGSDO2_tiDlyRtlS1B1 "Delay time from step response measurement in rich-lean direction (sensor 1, bank 1)" UWORD t_q0p01 1 100 0.00 655.3500 FORMAT "%8.4" ECU_ADDRESS 0x60014820 /end MEASUREMENT
/begin MEASUREMENT EGSDO2_tiDlyRtlStepS1B1 "Delay time from current step response measurement in rich-lean direction (sensor 1, bank 1)" SWORD t_q0p01 1 100 -327.6800 327.6700 FORMAT "%8.4" ECU_ADDRESS 0x60009206 /end MEASUREMENT
/begin MEASUREMENT EGSDO2_tiSumDeltaAdapS1B1 "Sum error difference of delay and transition between lean-rich and rich-lean" SWORD t_q0p01 1 100 -327.6800 327.6700 FORMAT "%8.4" ECU_ADDRESS 0x60009A22 /end MEASUREMENT
/begin MEASUREMENT EGSDO2_tiSumIdnLtrS1B1 "Sum time of identification in lean-rich direction (sensor 1, bank 1)" UWORD t_q0p01 1 100 0.00 655.3500 FORMAT "%8.4" ECU_ADDRESS 0x60008F86 /end MEASUREMENT
/begin MEASUREMENT EGSDO2_tiSumIdnRtlS1B1 "Sum time of identification in rich-lean direction (sensor 1, bank 1)" UWORD t_q0p01 1 100 0.00 655.3500 FORMAT "%8.4" ECU_ADDRESS 0x60008F84 /end MEASUREMENT
/begin MEASUREMENT EGSDO2_tiTranAdpnS1B1 "Upstream sensor transition time used for dynamics adaptation (sensor 1, bank 1)" UWORD t_q0p01 1 100 0.00 655.3500 FORMAT "%8.4" ECU_ADDRESS 0x60008F82 /end MEASUREMENT
/begin MEASUREMENT EGSDO2_tiTranEwmaLtrS1B1 "EWMA filtered Transient time Lean-to-rich UEGO S1 Bank 1" UWORD t_q0p01 1 100 0.00 655.3500 FORMAT "%8.4" ECU_ADDRESS 0x60008F80 /end MEASUREMENT
/begin MEASUREMENT EGSDO2_tiTranEwmaRtlS1B1 "EWMA filtered Transient time Rich-to-Lean UEGO S1 Bank 1" UWORD t_q0p01 1 100 0.00 655.3500 FORMAT "%8.4" ECU_ADDRESS 0x60008F7E /end MEASUREMENT
/begin MEASUREMENT EGSDO2_tiTranIdnFltMaxB1 "Maximum transition time from identifikation, bank 1" UWORD t_q0p01 1 100 0.00 655.3500 FORMAT "%8.4" ECU_ADDRESS 0x60008F7C /end MEASUREMENT
/begin MEASUREMENT EGSDO2_tiTranIdnLtrB1 "Identified transition time in lean-rich direction (bank 1)" UWORD t_q0p01 1 100 0.00 655.3500 FORMAT "%8.4" ECU_ADDRESS 0x600094B2 /end MEASUREMENT
/begin MEASUREMENT EGSDO2_tiTranIdnRtlB1 "Identified transition time in rich-lean direction (bank 1)" UWORD t_q0p01 1 100 0.00 655.3500 FORMAT "%8.4" ECU_ADDRESS 0x600094B0 /end MEASUREMENT
/begin MEASUREMENT EGSDO2_tiTranLtrS1B1 "Transition time from step response measurement in lean-rich direction (sensor 1, bank 1)" UWORD t_q0p01 1 100 0.00 655.3500 FORMAT "%8.4" ECU_ADDRESS 0x60014822 /end MEASUREMENT
/begin MEASUREMENT EGSDO2_tiTranLtrStepS1B1 "Transition time from current step response measurement in lean-lean direction (sensor 1, bank 1)" SWORD t_q0p01 1 100 -327.6800 327.6700 FORMAT "%8.4" ECU_ADDRESS 0x60009204 /end MEASUREMENT
/begin MEASUREMENT EGSDO2_tiTranRtlS1B1 "Transition time from step response measurement in rich-lean direction (sensor 1, bank 1)" UWORD t_q0p01 1 100 0.00 655.3500 FORMAT "%8.4" ECU_ADDRESS 0x60014824 /end MEASUREMENT
/begin MEASUREMENT EGSDO2_tiTranRtlStepS1B1 "Transition time from current step response measurement in rich-lean direction (sensor 1, bank 1)" SWORD t_q0p01 1 100 -327.6800 327.6700 FORMAT "%8.4" ECU_ADDRESS 0x60009202 /end MEASUREMENT
/begin MEASUREMENT IdnLossB1_I.facMdlFltDe "Class instance for loss function of identification for lambda-based dynamics diagnosis of a wideband-sensor (bank 1) / error model deviation" UWORD fak_uw_b4 1 100 0.00 3.999939 FORMAT "%8.6" ECU_ADDRESS 0x60012FCC /end MEASUREMENT
/begin MEASUREMENT IdnLossB1_I.facMdlFltDeAvrg "Class instance for loss function of identification for lambda-based dynamics diagnosis of a wideband-sensor (bank 1) / average error model deviation" UWORD fak_uw_b128 1 100 0.00 127.9980 FORMAT "%8.4" ECU_ADDRESS 0x60012FCE /end MEASUREMENT
/begin MEASUREMENT IdnLossB1_I.facMdlFltDeEvln "Class instance for loss function of identification for lambda-based dynamics diagnosis of a wideband-sensor (bank 1) / Fault model deviation" UWORD fak_uw_b128 1 100 0.00 127.9980 FORMAT "%8.4" ECU_ADDRESS 0x60012FD0 /end MEASUREMENT
/begin MEASUREMENT IdnLossB1_I.facMdlFltQlySum "Class instance for loss function of identification for lambda-based dynamics diagnosis of a wideband-sensor (bank 1) / kumulated error model deviation" ULONG fak_uw_b4 1 100 0.00 262143.999939 FORMAT "%13.6" ECU_ADDRESS 0x60012FD4 /end MEASUREMENT
/begin MEASUREMENT IdnLossB1_I.facMdlNom "Class instance for loss function of identification for lambda-based dynamics diagnosis of a wideband-sensor (bank 1) / squared nominal model factor" ULONG fak_q4p6566Em10 1 100 0.00 0.999999999534339 FORMAT "%18.16" ECU_ADDRESS 0x60012FD8 /end MEASUREMENT
/begin MEASUREMENT IdnLossB1_I.facMdlNomBasSum "Class instance for loss function of identification for lambda-based dynamics diagnosis of a wideband-sensor (bank 1) / kumulated squared nominal model factor" ULONG fak_uw_b1 1 100 0.00 65535.9999847 FORMAT "%13.7" ECU_ADDRESS 0x60012FDC /end MEASUREMENT
/begin MEASUREMENT IdnLossB1_I.facMdlNomDe "Class instance for loss function of identification for lambda-based dynamics diagnosis of a wideband-sensor (bank 1) / nominal model deviation" UWORD fak_uw_b4 1 100 0.00 3.999939 FORMAT "%8.6" ECU_ADDRESS 0x60012FE0 /end MEASUREMENT
/begin MEASUREMENT IdnLossB1_I.facMdlNomDeAvrg "Class instance for loss function of identification for lambda-based dynamics diagnosis of a wideband-sensor (bank 1) / average nominal model deviation" UWORD fak_uw_b128 1 100 0.00 127.9980 FORMAT "%8.4" ECU_ADDRESS 0x60012FE2 /end MEASUREMENT
/begin MEASUREMENT IdnLossB1_I.facMdlNomDeEvln "Class instance for loss function of identification for lambda-based dynamics diagnosis of a wideband-sensor (bank 1) / nominal model deviation" UWORD fak_uw_b128 1 100 0.00 127.9980 FORMAT "%8.4" ECU_ADDRESS 0x60012FE4 /end MEASUREMENT
/begin MEASUREMENT IdnLossB1_I.facMdlNomQlySum "Class instance for loss function of identification for lambda-based dynamics diagnosis of a wideband-sensor (bank 1) / kumulated nominal model deviation" ULONG fak_uw_b4 1 100 0.00 262143.999939 FORMAT "%13.6" ECU_ADDRESS 0x60012FE8 /end MEASUREMENT
/begin MEASUREMENT IdnLossB1_I.flgFltSuspc "Class instance for loss function of identification for lambda-based dynamics diagnosis of a wideband-sensor (bank 1) / Fault suspicious based on loss function calculation" UBYTE B_TRUE 1 100 0.00 1.00000000000 BIT_MASK 0x1 FORMAT "%13.11" ECU_ADDRESS 0x60012FEC /end MEASUREMENT
/begin MEASUREMENT IdnLossB1_I.flgLossEvlnDne "Class instance for loss function of identification for lambda-based dynamics diagnosis of a wideband-sensor (bank 1) / Evaluation of loss functions done" UBYTE B_TRUE 1 100 0.00 1.00000000000 BIT_MASK 0x1 FORMAT "%13.11" ECU_ADDRESS 0x60012FED /end MEASUREMENT
/begin MEASUREMENT IdnLossB1_I.flgRlsStep "Class instance for loss function of identification for lambda-based dynamics diagnosis of a wideband-sensor (bank 1) / Release of the step measurement" UBYTE B_TRUE 1 100 0.00 1.00000000000 BIT_MASK 0x1 FORMAT "%13.11" ECU_ADDRESS 0x60012FEE /end MEASUREMENT
/begin MEASUREMENT IdnLossB1_I.flgRstAdpn "Class instance for loss function of identification for lambda-based dynamics diagnosis of a wideband-sensor (bank 1) / Reset of adaptation and identification values" UBYTE B_TRUE 1 100 0.00 1.00000000000 BIT_MASK 0x1 FORMAT "%13.11" ECU_ADDRESS 0x60012FEF /end MEASUREMENT
/begin MEASUREMENT IdnLossB1_I.tiLossTmr "Class instance for loss function of identification for lambda-based dynamics diagnosis of a wideband-sensor (bank 1) / Timer of loss function calculation" UWORD t_q0p01 1 100 0.00 655.3500 FORMAT "%8.4" ECU_ADDRESS 0x60012FF0 /end MEASUREMENT
/begin MEASUREMENT IdnLtrB1_I.dratLamDly "Class instance for identification in lean-rich direction for lambda-based dynamics diagnosis of a wideband-sensor (bank 1) / Derivative of reciprocal modelled lambda with fault model with respect to delay time" SWORD freq_q1p22Em4 1 100 -4.000000 3.999878 FORMAT "%8.6" ECU_ADDRESS 0x50001A58 /end MEASUREMENT
/begin MEASUREMENT IdnLtrB1_I.dratLamTran "Class instance for identification in lean-rich direction for lambda-based dynamics diagnosis of a wideband-sensor (bank 1) / Derivative of reciprocal modelled lambda with fault model with respect to transition time" SWORD freq_q1p22Em4 1 100 -4.000000 3.999878 FORMAT "%8.6" ECU_ADDRESS 0x50001A5A /end MEASUREMENT
/begin MEASUREMENT IdnLtrB1_I.ratLamErrNrm "Class instance for identification in lean-rich direction for lambda-based dynamics diagnosis of a wideband-sensor (bank 1) / Normalized modell error" SWORD fak_q3p0518Em5 1 100 -1.000000 0.999969 FORMAT "%8.6" ECU_ADDRESS 0x50001A5C /end MEASUREMENT
/begin MEASUREMENT IdnLtrB1_I.ratLamRecprMdlBpFild "Class instance for identification in lean-rich direction for lambda-based dynamics diagnosis of a wideband-sensor (bank 1) / Reciprocal modelled lambda (bandpass filtered, filter value)" ULONG fak_q4p6566Em10 1 100 0.00 1.999999999534339 FORMAT "%17.15" ECU_ADDRESS 0x50001A60 /end MEASUREMENT
/begin MEASUREMENT IdnLtrB1_I.ratLamRecprMdlFltBpFild "Class instance for identification in lean-rich direction for lambda-based dynamics diagnosis of a wideband-sensor (bank 1) / Reciprocal modelled lambda with fault model (bandpass filtered, filter value)" ULONG fak_q4p6566Em10 1 100 0.00 1.999999999534339 FORMAT "%17.15" ECU_ADDRESS 0x50001A68 /end MEASUREMENT
/begin MEASUREMENT IdnLtrB1_I.tiDlyIdn "Class instance for identification in lean-rich direction for lambda-based dynamics diagnosis of a wideband-sensor (bank 1) / Identified delay time" UWORD t_q0p01 1 100 0.00 655.3500 FORMAT "%8.4" ECU_ADDRESS 0x50001A70 /end MEASUREMENT
/begin MEASUREMENT IdnLtrB1_I.tiTranIdn "Class instance for identification in lean-rich direction for lambda-based dynamics diagnosis of a wideband-sensor (bank 1) / Identified transition time" UWORD t_q0p01 1 100 0.00 655.3500 FORMAT "%8.4" ECU_ADDRESS 0x50001A72 /end MEASUREMENT
/begin MEASUREMENT IdnLtrB1_I.DerDlyDTTtopt_I.buffer "Class instance for identification in lean-rich direction for lambda-based dynamics diagnosis of a wideband-sensor (bank 1) / Dead time element for derivative with respect to dead time / buffer" SWORD freq_q1p22Em4 1 100 -4.000000 3.999878 FORMAT "%8.6" ARRAY_SIZE 21 ECU_ADDRESS 0x50001A74 /end MEASUREMENT
/begin MEASUREMENT IdnLtrB1_I.DerDlyDTTtopt_I.counter "Class instance for identification in lean-rich direction for lambda-based dynamics diagnosis of a wideband-sensor (bank 1) / Dead time element for derivative with respect to dead time / counter" UWORD fak_uw_b2 1 100 0.00 1.000000 FORMAT "%8.6" ECU_ADDRESS 0x50001A9E /end MEASUREMENT
/begin MEASUREMENT IdnLtrB1_I.DerDlyDTTtopt_I.pointer "Class instance for identification in lean-rich direction for lambda-based dynamics diagnosis of a wideband-sensor (bank 1) / Dead time element for derivative with respect to dead time / pointer" UBYTE dez 1 100 0.00 255.0 FORMAT "%5.1" ECU_ADDRESS 0x50001AA0 /end MEASUREMENT
/begin MEASUREMENT IdnLtrB1_I.EGSDO2_DlyIdnIK_I.memory "Class instance for identification in lean-rich direction for lambda-based dynamics diagnosis of a wideband-sensor (bank 1) / Delay of the identification / current integrator value" ULONG q1p5259Em7_s 1 100 0.00 655.359999847 FORMAT "%13.9" ECU_ADDRESS 0x50001AA4 /end MEASUREMENT
/begin MEASUREMENT IdnLtrB1_I.EGSDO2_TranIdnIK_I.memory "Class instance for identification in lean-rich direction for lambda-based dynamics diagnosis of a wideband-sensor (bank 1) / Transition of the identification / current integrator value" ULONG q1p5259Em7_s 1 100 0.00 655.359999847 FORMAT "%13.9" ECU_ADDRESS 0x50001AA8 /end MEASUREMENT
/begin MEASUREMENT IdnRtlB1_I.dratLamDly "Class instance for identification in rich-lean direction for lambda-based dynamics diagnosis of a wideband-sensor (bank 1) / Derivative of reciprocal modelled lambda with fault model with respect to delay time" SWORD freq_q1p22Em4 1 100 -4.000000 3.999878 FORMAT "%8.6" ECU_ADDRESS 0x50001AAC /end MEASUREMENT
/begin MEASUREMENT IdnRtlB1_I.dratLamTran "Class instance for identification in rich-lean direction for lambda-based dynamics diagnosis of a wideband-sensor (bank 1) / Derivative of reciprocal modelled lambda with fault model with respect to transition time" SWORD freq_q1p22Em4 1 100 -4.000000 3.999878 FORMAT "%8.6" ECU_ADDRESS 0x50001AAE /end MEASUREMENT
/begin MEASUREMENT IdnRtlB1_I.ratLamErrNrm "Class instance for identification in rich-lean direction for lambda-based dynamics diagnosis of a wideband-sensor (bank 1) / Normalized modell error" SWORD fak_q3p0518Em5 1 100 -1.000000 0.999969 FORMAT "%8.6" ECU_ADDRESS 0x50001AB0 /end MEASUREMENT
/begin MEASUREMENT IdnRtlB1_I.ratLamRecprMdlBpFild "Class instance for identification in rich-lean direction for lambda-based dynamics diagnosis of a wideband-sensor (bank 1) / Reciprocal modelled lambda (bandpass filtered, filter value)" ULONG fak_q4p6566Em10 1 100 0.00 1.999999999534339 FORMAT "%17.15" ECU_ADDRESS 0x50001AB4 /end MEASUREMENT
/begin MEASUREMENT IdnRtlB1_I.ratLamRecprMdlFltBpFild "Class instance for identification in rich-lean direction for lambda-based dynamics diagnosis of a wideband-sensor (bank 1) / Reciprocal modelled lambda with fault model (bandpass filtered, filter value)" ULONG fak_q4p6566Em10 1 100 0.00 1.999999999534339 FORMAT "%17.15" ECU_ADDRESS 0x50001ABC /end MEASUREMENT
/begin MEASUREMENT IdnRtlB1_I.tiDlyIdn "Class instance for identification in rich-lean direction for lambda-based dynamics diagnosis of a wideband-sensor (bank 1) / Identified delay time" UWORD t_q0p01 1 100 0.00 655.3500 FORMAT "%8.4" ECU_ADDRESS 0x50001AC4 /end MEASUREMENT
/begin MEASUREMENT IdnRtlB1_I.tiTranIdn "Class instance for identification in rich-lean direction for lambda-based dynamics diagnosis of a wideband-sensor (bank 1) / Identified transition time" UWORD t_q0p01 1 100 0.00 655.3500 FORMAT "%8.4" ECU_ADDRESS 0x50001AC6 /end MEASUREMENT
/begin MEASUREMENT IdnRtlB1_I.DerDlyDTTtopt_I.buffer "Class instance for identification in rich-lean direction for lambda-based dynamics diagnosis of a wideband-sensor (bank 1) / Dead time element for derivative with respect to dead time / buffer" SWORD freq_q1p22Em4 1 100 -4.000000 3.999878 FORMAT "%8.6" ARRAY_SIZE 21 ECU_ADDRESS 0x50001AC8 /end MEASUREMENT
/begin MEASUREMENT IdnRtlB1_I.DerDlyDTTtopt_I.counter "Class instance for identification in rich-lean direction for lambda-based dynamics diagnosis of a wideband-sensor (bank 1) / Dead time element for derivative with respect to dead time / counter" UWORD fak_uw_b2 1 100 0.00 1.000000 FORMAT "%8.6" ECU_ADDRESS 0x50001AF2 /end MEASUREMENT
/begin MEASUREMENT IdnRtlB1_I.DerDlyDTTtopt_I.pointer "Class instance for identification in rich-lean direction for lambda-based dynamics diagnosis of a wideband-sensor (bank 1) / Dead time element for derivative with respect to dead time / pointer" UBYTE dez 1 100 0.00 255.0 FORMAT "%5.1" ECU_ADDRESS 0x50001AF4 /end MEASUREMENT
/begin MEASUREMENT IdnRtlB1_I.EGSDO2_DlyIdnIK_I.memory "Class instance for identification in rich-lean direction for lambda-based dynamics diagnosis of a wideband-sensor (bank 1) / Delay of the identification / current integrator value" ULONG q1p5259Em7_s 1 100 0.00 655.359999847 FORMAT "%13.9" ECU_ADDRESS 0x50001AF8 /end MEASUREMENT
/begin MEASUREMENT IdnRtlB1_I.EGSDO2_TranIdnIK_I.memory "Class instance for identification in rich-lean direction for lambda-based dynamics diagnosis of a wideband-sensor (bank 1) / Transition of the identification / current integrator value" ULONG q1p5259Em7_s 1 100 0.00 655.359999847 FORMAT "%13.9" ECU_ADDRESS 0x50001AFC /end MEASUREMENT
/begin MEASUREMENT ResFilLtrB1_I.cntrStep "Class instance for result filtering in lean-rich direction for lambda-based dynamics diagnosis of a wideband-sensor (bank 1) / Counter of step responses" UBYTE dez 1 100 0.00 255.0 FORMAT "%5.1" ECU_ADDRESS 0x60039414 /end MEASUREMENT
/begin MEASUREMENT ResFilLtrB1_I.cntrStepShtrp "Class instance for result filtering in lean-rich direction for lambda-based dynamics diagnosis of a wideband-sensor (bank 1) / Counter of step responses during short trip" UBYTE dez 1 100 0.00 255.0 FORMAT "%5.1" ECU_ADDRESS 0x50001CD0 /end MEASUREMENT
/begin MEASUREMENT ResFilLtrB1_I.flgArith "Class instance for result filtering in lean-rich direction for lambda-based dynamics diagnosis of a wideband-sensor (bank 1) / Arithmetic filtering active" UBYTE B_TRUE 1 100 0.00 1.00000000000 BIT_MASK 0x1 FORMAT "%13.11" ECU_ADDRESS 0x50001CD1 /end MEASUREMENT
/begin MEASUREMENT ResFilLtrB1_I.flgErrEwmaQckFail "Class instance for result filtering in lean-rich direction for lambda-based dynamics diagnosis of a wideband-sensor (bank 1) / UEGO dynamic error check with Quick-Fail approach" UBYTE B_TRUE 1 100 0.00 1.00000000000 BIT_MASK 0x1 FORMAT "%13.11" ECU_ADDRESS 0x500057CC /end MEASUREMENT
/begin MEASUREMENT ResFilLtrB1_I.flgProdModParl "Class instance for result filtering in lean-rich direction for lambda-based dynamics diagnosis of a wideband-sensor (bank 1) / Production mode needs to be considered for parallel diagnosis of exhaust gas system" UBYTE B_TRUE 1 100 0.00 1.00000000000 BIT_MASK 0x1 FORMAT "%13.11" ECU_ADDRESS 0x500057CD /end MEASUREMENT
/begin MEASUREMENT ResFilLtrB1_I.flgShtrpParl "Class instance for result filtering in lean-rich direction for lambda-based dynamics diagnosis of a wideband-sensor (bank 1) / Short trip request from parallelization" UBYTE B_TRUE 1 100 0.00 1.00000000000 BIT_MASK 0x1 FORMAT "%13.11" ECU_ADDRESS 0x500057CE /end MEASUREMENT
/begin MEASUREMENT ResFilLtrB1_I.flgStepChg "Class instance for result filtering in lean-rich direction for lambda-based dynamics diagnosis of a wideband-sensor (bank 1) / Step change active" UBYTE B_TRUE 1 100 0.00 1.00000000000 BIT_MASK 0x1 FORMAT "%13.11" ECU_ADDRESS 0x60039415 /end MEASUREMENT
/begin MEASUREMENT ResFilLtrB1_I.nrMeasTrip "Class instance for result filtering in lean-rich direction for lambda-based dynamics diagnosis of a wideband-sensor (bank 1) / Number of measurements in current trip" UBYTE dez 1 100 0.00 255.0 FORMAT "%5.1" ECU_ADDRESS 0x500057CF /end MEASUREMENT
/begin MEASUREMENT ResFilLtrB1_I.stEwmaMod "Class instance for result filtering in lean-rich direction for lambda-based dynamics diagnosis of a wideband-sensor (bank 1) / Current mode of EWMA filter" UBYTE OneToOne 1 100 0.00 2.000 FORMAT "%5.3" ECU_ADDRESS 0x60039416 /end MEASUREMENT
/begin MEASUREMENT ResFilLtrB1_I.stEwmaModEnum "Class instance for result filtering in lean-rich direction for lambda-based dynamics diagnosis of a wideband-sensor (bank 1) / Enumeration Variable denoting the status of EWMA filtering modes" UBYTE EGSDO2_LamDyn_Enum_tab_verb 1 100 0.00 2.00000000000 FORMAT "%13.11" ECU_ADDRESS 0x60039417 /end MEASUREMENT
/begin MEASUREMENT ResFilLtrB1_I.tiDlyAvrg "Class instance for result filtering in lean-rich direction for lambda-based dynamics diagnosis of a wideband-sensor (bank 1) / Averaged delay time" UWORD t_q0p01 1 100 0.00 655.3500 FORMAT "%8.4" ECU_ADDRESS 0x60039418 /end MEASUREMENT
/begin MEASUREMENT ResFilLtrB1_I.tiDlyEwma "Class instance for result filtering in lean-rich direction for lambda-based dynamics diagnosis of a wideband-sensor (bank 1) / Exponentially weigthed moving average (EWMA) of delay time" UWORD t_q0p01 1 100 0.00 655.3500 FORMAT "%8.4" ECU_ADDRESS 0x6003941A /end MEASUREMENT
/begin MEASUREMENT ResFilLtrB1_I.tiDlyStepRaw "Class instance for result filtering in lean-rich direction for lambda-based dynamics diagnosis of a wideband-sensor (bank 1) / Raw signal of delay time (unfiltered)" SWORD t_q0p01 1 100 -327.6800 327.6700 FORMAT "%8.4" ECU_ADDRESS 0x500057D0 /end MEASUREMENT
/begin MEASUREMENT ResFilLtrB1_I.tiTranAvrg "Class instance for result filtering in lean-rich direction for lambda-based dynamics diagnosis of a wideband-sensor (bank 1) / Averaged transition time" UWORD t_q0p01 1 100 0.00 655.3500 FORMAT "%8.4" ECU_ADDRESS 0x6003941C /end MEASUREMENT
/begin MEASUREMENT ResFilLtrB1_I.tiTranEwma "Class instance for result filtering in lean-rich direction for lambda-based dynamics diagnosis of a wideband-sensor (bank 1) / Exponentially weigthed moving average (EWMA) of transition time" UWORD t_q0p01 1 100 0.00 655.3500 FORMAT "%8.4" ECU_ADDRESS 0x6003941E /end MEASUREMENT
/begin MEASUREMENT ResFilLtrB1_I.tiTranStepRaw "Class instance for result filtering in lean-rich direction for lambda-based dynamics diagnosis of a wideband-sensor (bank 1) / Raw signal of transition time (unfiltered)" SWORD t_q0p01 1 100 -327.6800 327.6700 FORMAT "%8.4" ECU_ADDRESS 0x500057D2 /end MEASUREMENT
/begin MEASUREMENT ResFilLtrB1_I.EGSDO2_tiDlyAvrgDL_I.memory "Class instance for result filtering in lean-rich direction for lambda-based dynamics diagnosis of a wideband-sensor (bank 1) / Average calculation / current lowpass value" SLONG q1p5259Em7_s 1 100 -327.680000000 327.679999847 FORMAT "%13.9" ECU_ADDRESS 0x50001CD4 /end MEASUREMENT
/begin MEASUREMENT ResFilLtrB1_I.EGSDO2_tiDlyAvrgShtrpDL_I.memory "Class instance for result filtering in lean-rich direction for lambda-based dynamics diagnosis of a wideband-sensor (bank 1) / Average calculation / current lowpass value" SLONG q1p5259Em7_s 1 100 -327.680000000 327.679999847 FORMAT "%13.9" ECU_ADDRESS 0x50001CD8 /end MEASUREMENT
/begin MEASUREMENT ResFilLtrB1_I.EGSDO2_tiDlyEwmaDL_I.memory "Class instance for result filtering in lean-rich direction for lambda-based dynamics diagnosis of a wideband-sensor (bank 1) / EWMA Filter / current lowpass value" SLONG q1p5259Em7_s 1 100 -327.680000000 327.679999847 FORMAT "%13.9" ECU_ADDRESS 0x50001CDC /end MEASUREMENT
/begin MEASUREMENT ResFilLtrB1_I.EGSDO2_tiTranAvrgDL_I.memory "Class instance for result filtering in lean-rich direction for lambda-based dynamics diagnosis of a wideband-sensor (bank 1) / Arithmethischer Filter / current lowpass value" SLONG q1p5259Em7_s 1 100 -327.680000000 327.679999847 FORMAT "%13.9" ECU_ADDRESS 0x50001CE0 /end MEASUREMENT
/begin MEASUREMENT ResFilLtrB1_I.EGSDO2_tiTranAvrgShtrpDL_I.memory "Class instance for result filtering in lean-rich direction for lambda-based dynamics diagnosis of a wideband-sensor (bank 1) / Arithmethischer Filter / current lowpass value" SLONG q1p5259Em7_s 1 100 -327.680000000 327.679999847 FORMAT "%13.9" ECU_ADDRESS 0x50001CE4 /end MEASUREMENT
/begin MEASUREMENT ResFilLtrB1_I.EGSDO2_tiTranEwmaDL_I.memory "Class instance for result filtering in lean-rich direction for lambda-based dynamics diagnosis of a wideband-sensor (bank 1) / EWMA Filter / current lowpass value" SLONG q1p5259Em7_s 1 100 -327.680000000 327.679999847 FORMAT "%13.9" ECU_ADDRESS 0x50001CE8 /end MEASUREMENT
/begin MEASUREMENT ResFilRtlB1_I.cntrStep "Class instance for result filtering in rich-lean direction for lambda-based dynamics diagnosis of a wideband-sensor (bank 1) / Counter of step responses" UBYTE dez 1 100 0.00 255.0 FORMAT "%5.1" ECU_ADDRESS 0x60039408 /end MEASUREMENT
/begin MEASUREMENT ResFilRtlB1_I.cntrStepShtrp "Class instance for result filtering in rich-lean direction for lambda-based dynamics diagnosis of a wideband-sensor (bank 1) / Counter of step responses during short trip" UBYTE dez 1 100 0.00 255.0 FORMAT "%5.1" ECU_ADDRESS 0x50001CEC /end MEASUREMENT
/begin MEASUREMENT ResFilRtlB1_I.flgArith "Class instance for result filtering in rich-lean direction for lambda-based dynamics diagnosis of a wideband-sensor (bank 1) / Arithmetic filtering active" UBYTE B_TRUE 1 100 0.00 1.00000000000 BIT_MASK 0x1 FORMAT "%13.11" ECU_ADDRESS 0x50001CED /end MEASUREMENT
/begin MEASUREMENT ResFilRtlB1_I.flgErrEwmaQckFail "Class instance for result filtering in rich-lean direction for lambda-based dynamics diagnosis of a wideband-sensor (bank 1) / UEGO dynamic error check with Quick-Fail approach" UBYTE B_TRUE 1 100 0.00 1.00000000000 BIT_MASK 0x1 FORMAT "%13.11" ECU_ADDRESS 0x500057D4 /end MEASUREMENT
/begin MEASUREMENT ResFilRtlB1_I.flgProdModParl "Class instance for result filtering in rich-lean direction for lambda-based dynamics diagnosis of a wideband-sensor (bank 1) / Production mode needs to be considered for parallel diagnosis of exhaust gas system" UBYTE B_TRUE 1 100 0.00 1.00000000000 BIT_MASK 0x1 FORMAT "%13.11" ECU_ADDRESS 0x500057D5 /end MEASUREMENT
/begin MEASUREMENT ResFilRtlB1_I.flgShtrpParl "Class instance for result filtering in rich-lean direction for lambda-based dynamics diagnosis of a wideband-sensor (bank 1) / Short trip request from parallelization" UBYTE B_TRUE 1 100 0.00 1.00000000000 BIT_MASK 0x1 FORMAT "%13.11" ECU_ADDRESS 0x500057D6 /end MEASUREMENT
/begin MEASUREMENT ResFilRtlB1_I.flgStepChg "Class instance for result filtering in rich-lean direction for lambda-based dynamics diagnosis of a wideband-sensor (bank 1) / Step change active" UBYTE B_TRUE 1 100 0.00 1.00000000000 BIT_MASK 0x1 FORMAT "%13.11" ECU_ADDRESS 0x60039409 /end MEASUREMENT
/begin MEASUREMENT ResFilRtlB1_I.nrMeasTrip "Class instance for result filtering in rich-lean direction for lambda-based dynamics diagnosis of a wideband-sensor (bank 1) / Number of measurements in current trip" UBYTE dez 1 100 0.00 255.0 FORMAT "%5.1" ECU_ADDRESS 0x500057D7 /end MEASUREMENT
/begin MEASUREMENT ResFilRtlB1_I.stEwmaMod "Class instance for result filtering in rich-lean direction for lambda-based dynamics diagnosis of a wideband-sensor (bank 1) / Current mode of EWMA filter" UBYTE OneToOne 1 100 0.00 2.000 FORMAT "%5.3" ECU_ADDRESS 0x6003940A /end MEASUREMENT
/begin MEASUREMENT ResFilRtlB1_I.stEwmaModEnum "Class instance for result filtering in rich-lean direction for lambda-based dynamics diagnosis of a wideband-sensor (bank 1) / Enumeration Variable denoting the status of EWMA filtering modes" UBYTE EGSDO2_LamDyn_Enum_tab_verb 1 100 0.00 2.00000000000 FORMAT "%13.11" ECU_ADDRESS 0x6003940B /end MEASUREMENT
/begin MEASUREMENT ResFilRtlB1_I.tiDlyAvrg "Class instance for result filtering in rich-lean direction for lambda-based dynamics diagnosis of a wideband-sensor (bank 1) / Averaged delay time" UWORD t_q0p01 1 100 0.00 655.3500 FORMAT "%8.4" ECU_ADDRESS 0x6003940C /end MEASUREMENT
/begin MEASUREMENT ResFilRtlB1_I.tiDlyEwma "Class instance for result filtering in rich-lean direction for lambda-based dynamics diagnosis of a wideband-sensor (bank 1) / Exponentially weigthed moving average (EWMA) of delay time" UWORD t_q0p01 1 100 0.00 655.3500 FORMAT "%8.4" ECU_ADDRESS 0x6003940E /end MEASUREMENT
/begin MEASUREMENT ResFilRtlB1_I.tiDlyStepRaw "Class instance for result filtering in rich-lean direction for lambda-based dynamics diagnosis of a wideband-sensor (bank 1) / Raw signal of delay time (unfiltered)" SWORD t_q0p01 1 100 -327.6800 327.6700 FORMAT "%8.4" ECU_ADDRESS 0x500057D8 /end MEASUREMENT
/begin MEASUREMENT ResFilRtlB1_I.tiTranAvrg "Class instance for result filtering in rich-lean direction for lambda-based dynamics diagnosis of a wideband-sensor (bank 1) / Averaged transition time" UWORD t_q0p01 1 100 0.00 655.3500 FORMAT "%8.4" ECU_ADDRESS 0x60039410 /end MEASUREMENT
/begin MEASUREMENT ResFilRtlB1_I.tiTranEwma "Class instance for result filtering in rich-lean direction for lambda-based dynamics diagnosis of a wideband-sensor (bank 1) / Exponentially weigthed moving average (EWMA) of transition time" UWORD t_q0p01 1 100 0.00 655.3500 FORMAT "%8.4" ECU_ADDRESS 0x60039412 /end MEASUREMENT
/begin MEASUREMENT ResFilRtlB1_I.tiTranStepRaw "Class instance for result filtering in rich-lean direction for lambda-based dynamics diagnosis of a wideband-sensor (bank 1) / Raw signal of transition time (unfiltered)" SWORD t_q0p01 1 100 -327.6800 327.6700 FORMAT "%8.4" ECU_ADDRESS 0x500057DA /end MEASUREMENT
/begin MEASUREMENT ResFilRtlB1_I.EGSDO2_tiDlyAvrgDL_I.memory "Class instance for result filtering in rich-lean direction for lambda-based dynamics diagnosis of a wideband-sensor (bank 1) / Average calculation / current lowpass value" SLONG q1p5259Em7_s 1 100 -327.680000000 327.679999847 FORMAT "%13.9" ECU_ADDRESS 0x50001CF0 /end MEASUREMENT
/begin MEASUREMENT ResFilRtlB1_I.EGSDO2_tiDlyAvrgShtrpDL_I.memory "Class instance for result filtering in rich-lean direction for lambda-based dynamics diagnosis of a wideband-sensor (bank 1) / Average calculation / current lowpass value" SLONG q1p5259Em7_s 1 100 -327.680000000 327.679999847 FORMAT "%13.9" ECU_ADDRESS 0x50001CF4 /end MEASUREMENT
/begin MEASUREMENT ResFilRtlB1_I.EGSDO2_tiDlyEwmaDL_I.memory "Class instance for result filtering in rich-lean direction for lambda-based dynamics diagnosis of a wideband-sensor (bank 1) / EWMA Filter / current lowpass value" SLONG q1p5259Em7_s 1 100 -327.680000000 327.679999847 FORMAT "%13.9" ECU_ADDRESS 0x50001CF8 /end MEASUREMENT
/begin MEASUREMENT ResFilRtlB1_I.EGSDO2_tiTranAvrgDL_I.memory "Class instance for result filtering in rich-lean direction for lambda-based dynamics diagnosis of a wideband-sensor (bank 1) / Arithmethischer Filter / current lowpass value" SLONG q1p5259Em7_s 1 100 -327.680000000 327.679999847 FORMAT "%13.9" ECU_ADDRESS 0x50001CFC /end MEASUREMENT
/begin MEASUREMENT ResFilRtlB1_I.EGSDO2_tiTranAvrgShtrpDL_I.memory "Class instance for result filtering in rich-lean direction for lambda-based dynamics diagnosis of a wideband-sensor (bank 1) / Arithmethischer Filter / current lowpass value" SLONG q1p5259Em7_s 1 100 -327.680000000 327.679999847 FORMAT "%13.9" ECU_ADDRESS 0x50001D00 /end MEASUREMENT
/begin MEASUREMENT ResFilRtlB1_I.EGSDO2_tiTranEwmaDL_I.memory "Class instance for result filtering in rich-lean direction for lambda-based dynamics diagnosis of a wideband-sensor (bank 1) / EWMA Filter / current lowpass value" SLONG q1p5259Em7_s 1 100 -327.680000000 327.679999847 FORMAT "%13.9" ECU_ADDRESS 0x50001D04 /end MEASUREMENT
/begin MEASUREMENT StepLtrB1_I.cntrStepEvln "Class instance for step response measurement for lambda-based dynamics diagnosis of a wideband-sensor in lean-lean direction (bank 1) / Counter of measurement data during step response measurement" UWORD dez 1 100 0.00 65535.00 FORMAT "%8.2" ECU_ADDRESS 0x60013032 /end MEASUREMENT
/begin MEASUREMENT StepLtrB1_I.dratLamRecprLow "Class instance for step response measurement for lambda-based dynamics diagnosis of a wideband-sensor in lean-lean direction (bank 1) / lambda dynamic low" SWORD freq_q9p1553Em5 1 100 -3.000000 2.999908 FORMAT "%8.6" ECU_ADDRESS 0x60013034 /end MEASUREMENT
/begin MEASUREMENT StepLtrB1_I.dratLamRecprPeak "Class instance for step response measurement for lambda-based dynamics diagnosis of a wideband-sensor in lean-lean direction (bank 1) / Maximal or minimal gradient of reciprocal lambda" SWORD freq_q9p1553Em5 1 100 -3.000000 2.999908 FORMAT "%8.6" ECU_ADDRESS 0x60013036 /end MEASUREMENT
/begin MEASUREMENT StepLtrB1_I.dratLamRecprPeakNrm "Class instance for step response measurement for lambda-based dynamics diagnosis of a wideband-sensor in lean-lean direction (bank 1) / Maximal or minimal gradient of reciprocal lambda (normalized)" UWORD fak_uw_b1 1 100 0.00 0.9999847 FORMAT "%9.7" ECU_ADDRESS 0x60013038 /end MEASUREMENT
/begin MEASUREMENT StepLtrB1_I.flgStepEvln "Class instance for step response measurement for lambda-based dynamics diagnosis of a wideband-sensor in lean-lean direction (bank 1) / Evaluation of step response measurement active" UBYTE B_TRUE 1 100 0.00 1.00000000000 BIT_MASK 0x1 FORMAT "%13.11" ECU_ADDRESS 0x60013030 /end MEASUREMENT
/begin MEASUREMENT StepLtrB1_I.flgStepEvlnRes "Class instance for step response measurement for lambda-based dynamics diagnosis of a wideband-sensor in lean-lean direction (bank 1) / Step evaluated" UBYTE B_TRUE 1 100 0.00 1.00000000000 BIT_MASK 0x1 FORMAT "%13.11" ECU_ADDRESS 0x6000BA43 /end MEASUREMENT
/begin MEASUREMENT StepLtrB1_I.flgStepEvlnSuc "Class instance for step response measurement for lambda-based dynamics diagnosis of a wideband-sensor in lean-lean direction (bank 1) / Evaluation of step response measurement successful" UBYTE B_TRUE 1 100 0.00 1.00000000000 BIT_MASK 0x4 FORMAT "%13.11" ECU_ADDRESS 0x60013030 /end MEASUREMENT
/begin MEASUREMENT StepLtrB1_I.flgStepGrdt "Class instance for step response measurement for lambda-based dynamics diagnosis of a wideband-sensor in lean-lean direction (bank 1) / stepchange high enough" UBYTE B_TRUE 1 100 0.00 1.00000000000 BIT_MASK 0x8 FORMAT "%13.11" ECU_ADDRESS 0x60013030 /end MEASUREMENT
/begin MEASUREMENT StepLtrB1_I.ratLamRecprFildPeak "Class instance for step response measurement for lambda-based dynamics diagnosis of a wideband-sensor in lean-lean direction (bank 1) / Minimal or maximal value of reciprocal lambda after step" UWORD fak_q3p0518Em5 1 100 0.00 1.999969 FORMAT "%8.6" ECU_ADDRESS 0x6001303A /end MEASUREMENT
/begin MEASUREMENT StepLtrB1_I.ratLamRecprGrdtPeak "Class instance for step response measurement for lambda-based dynamics diagnosis of a wideband-sensor in lean-lean direction (bank 1) / Reciprocal lambda at maximal or minimal gradient" UWORD fak_q3p0518Em5 1 100 0.00 1.999969 FORMAT "%8.6" ECU_ADDRESS 0x6001303C /end MEASUREMENT
/begin MEASUREMENT StepLtrB1_I.ratLamRecprMax "Class instance for step response measurement for lambda-based dynamics diagnosis of a wideband-sensor in lean-lean direction (bank 1) / maximum reciprocal lambda" UWORD fak_uw_b2 1 100 0.00 1.999969 FORMAT "%8.6" ECU_ADDRESS 0x6001303E /end MEASUREMENT
/begin MEASUREMENT StepLtrB1_I.ratLamRecprMin "Class instance for step response measurement for lambda-based dynamics diagnosis of a wideband-sensor in lean-lean direction (bank 1) / minumum reciprocal lambda" UWORD fak_uw_b2 1 100 0.00 1.999969 FORMAT "%8.6" ECU_ADDRESS 0x60013040 /end MEASUREMENT
/begin MEASUREMENT StepLtrB1_I.ratLamRecprStepHeiBgnReal "Class instance for step response measurement for lambda-based dynamics diagnosis of a wideband-sensor in lean-lean direction (bank 1) / reciprocal lambda at the beginning of a step" UWORD fak_uw_b2 1 100 0.00 1.999969 FORMAT "%8.6" ECU_ADDRESS 0x60013042 /end MEASUREMENT
/begin MEASUREMENT StepLtrB1_I.ratLamRecprStepHeiReal "Class instance for step response measurement for lambda-based dynamics diagnosis of a wideband-sensor in lean-lean direction (bank 1) / reciprocal lambda" UWORD fak_uw_b2 1 100 0.00 1.999969 FORMAT "%8.6" ECU_ADDRESS 0x60013044 /end MEASUREMENT
/begin MEASUREMENT StepLtrB1_I.ratTran "Class instance for step response measurement for lambda-based dynamics diagnosis of a wideband-sensor in lean-lean direction (bank 1) / Ratio of transition times (sensor fault to nominal)" UWORD fak_uw_b32 1 100 0.00 31.99951 FORMAT "%8.5" ECU_ADDRESS 0x60013046 /end MEASUREMENT
/begin MEASUREMENT StepLtrB1_I.tiDly "Class instance for step response measurement for lambda-based dynamics diagnosis of a wideband-sensor in lean-lean direction (bank 1) / Detected delay time" SWORD t_q0p01 1 100 -327.6800 327.6700 FORMAT "%8.4" ECU_ADDRESS 0x60013048 /end MEASUREMENT
/begin MEASUREMENT StepLtrB1_I.tiDlyBasc "Class instance for step response measurement for lambda-based dynamics diagnosis of a wideband-sensor in lean-lean direction (bank 1) / Detected delay time (basic value)" SWORD t_q0p01 1 100 -327.6800 327.6700 FORMAT "%8.4" ECU_ADDRESS 0x6001304A /end MEASUREMENT
/begin MEASUREMENT StepLtrB1_I.tiDlyEquiv "Class instance for step response measurement for lambda-based dynamics diagnosis of a wideband-sensor in lean-lean direction (bank 1) / Equivalent delay time" UWORD t_q0p01 1 100 0.00 655.3500 FORMAT "%8.4" ECU_ADDRESS 0x6001304C /end MEASUREMENT
/begin MEASUREMENT StepLtrB1_I.tiGrdtPeak "Class instance for step response measurement for lambda-based dynamics diagnosis of a wideband-sensor in lean-lean direction (bank 1) / Time of maximal or minimal gradient" UWORD t_q0p01 1 100 0.00 655.3500 FORMAT "%8.4" ECU_ADDRESS 0x6001304E /end MEASUREMENT
/begin MEASUREMENT StepLtrB1_I.tiStepTmr "Class instance for step response measurement for lambda-based dynamics diagnosis of a wideband-sensor in lean-lean direction (bank 1) / Time after step" UWORD t_q0p01 1 100 0.00 655.3500 FORMAT "%8.4" ECU_ADDRESS 0x60013050 /end MEASUREMENT
/begin MEASUREMENT StepLtrB1_I.tiTran "Class instance for step response measurement for lambda-based dynamics diagnosis of a wideband-sensor in lean-lean direction (bank 1) / Detected transition time" SWORD t_q0p01 1 100 -327.6800 327.6700 FORMAT "%8.4" ECU_ADDRESS 0x60013052 /end MEASUREMENT
/begin MEASUREMENT StepLtrB1_I.EGSDO2_StepEvlnERNM_I.oldSignal "Class instance for step response measurement for lambda-based dynamics diagnosis of a wideband-sensor in lean-lean direction (bank 1) / Evaluation Step / value of input signal last calculation" UBYTE B_TRUE 1 100 0.00 1.00000000000 BIT_MASK 0x1 FORMAT "%13.11" ECU_ADDRESS 0x60013054 /end MEASUREMENT
/begin MEASUREMENT StepLtrB1_I.EGSDO2_StepEvlnFF_I.status "Class instance for step response measurement for lambda-based dynamics diagnosis of a wideband-sensor in lean-lean direction (bank 1) / Evaluation Step / current value of RS-FF" UBYTE B_TRUE 1 100 0.00 1.00000000000 BIT_MASK 0x1 FORMAT "%13.11" ECU_ADDRESS 0x60013055 /end MEASUREMENT
/begin MEASUREMENT StepLtrB1_I.EGSDO2_StepEvlnSucER_I.buffer "Class instance for step response measurement for lambda-based dynamics diagnosis of a wideband-sensor in lean-lean direction (bank 1) / Evaluation successfull / rising edge detected" UBYTE B_TRUE 1 100 0.00 1.00000000000 BIT_MASK 0x1 FORMAT "%13.11" ECU_ADDRESS 0x60013056 /end MEASUREMENT
/begin MEASUREMENT StepLtrB1_I.EGSDO2_StepEvlnSucER_I.oldSignal "Class instance for step response measurement for lambda-based dynamics diagnosis of a wideband-sensor in lean-lean direction (bank 1) / Evaluation successfull / flag rising edge" UBYTE B_TRUE 1 100 0.00 1.00000000000 BIT_MASK 0x1 FORMAT "%13.11" ECU_ADDRESS 0x60013057 /end MEASUREMENT
/begin MEASUREMENT StepLtrB1_I.EGSDO2_StepEvlnTONV_I.outbit "Class instance for step response measurement for lambda-based dynamics diagnosis of a wideband-sensor in lean-lean direction (bank 1) / Stepdebouncing / return value" UBYTE B_TRUE 1 100 0.00 1.00000000000 BIT_MASK 0x1 FORMAT "%13.11" ECU_ADDRESS 0x60013058 /end MEASUREMENT
/begin MEASUREMENT StepLtrB1_I.EGSDO2_StepEvlnTONV_I.time "Class instance for step response measurement for lambda-based dynamics diagnosis of a wideband-sensor in lean-lean direction (bank 1) / Stepdebouncing / expired delay time" UWORD t_q0p01 1 100 0.00 655.3500 FORMAT "%8.4" ECU_ADDRESS 0x6001305A /end MEASUREMENT
/begin MEASUREMENT StepLtrB1_I.EGSDO2_TarDneER_I.buffer "Class instance for step response measurement for lambda-based dynamics diagnosis of a wideband-sensor in lean-lean direction (bank 1) / Target done / rising edge detected" UBYTE B_TRUE 1 100 0.00 1.00000000000 BIT_MASK 0x1 FORMAT "%13.11" ECU_ADDRESS 0x6001305C /end MEASUREMENT
/begin MEASUREMENT StepLtrB1_I.EGSDO2_TarDneER_I.oldSignal "Class instance for step response measurement for lambda-based dynamics diagnosis of a wideband-sensor in lean-lean direction (bank 1) / Target done / flag rising edge" UBYTE B_TRUE 1 100 0.00 1.00000000000 BIT_MASK 0x1 FORMAT "%13.11" ECU_ADDRESS 0x6001305D /end MEASUREMENT
/begin MEASUREMENT StepLtrB1_I.EGSDO2_TarDneFF_I.status "Class instance for step response measurement for lambda-based dynamics diagnosis of a wideband-sensor in lean-lean direction (bank 1) / Target done / current value of RS-FF" UBYTE B_TRUE 1 100 0.00 1.00000000000 BIT_MASK 0x1 FORMAT "%13.11" ECU_ADDRESS 0x6001305E /end MEASUREMENT
/begin MEASUREMENT StepLtrB1_I.EGSDO2_flgStepEF_I.buffer "Class instance for step response measurement for lambda-based dynamics diagnosis of a wideband-sensor in lean-lean direction (bank 1) / Step detected / memory to detect falling edge" UBYTE B_TRUE 1 100 0.00 1.00000000000 BIT_MASK 0x1 FORMAT "%13.11" ECU_ADDRESS 0x60013060 /end MEASUREMENT
/begin MEASUREMENT StepLtrB1_I.EGSDO2_flgStepEF_I.oldSignal "Class instance for step response measurement for lambda-based dynamics diagnosis of a wideband-sensor in lean-lean direction (bank 1) / Step detected / memory to detect falling edge" UBYTE B_TRUE 1 100 0.00 1.00000000000 BIT_MASK 0x1 FORMAT "%13.11" ECU_ADDRESS 0x60013061 /end MEASUREMENT
/begin MEASUREMENT StepLtrB1_I.EGSDO2_tiDeadTiNomAvrgDL_I.memory "Class instance for step response measurement for lambda-based dynamics diagnosis of a wideband-sensor in lean-lean direction (bank 1) / Dead time filtering / current lowpass value" ULONG q1p5259Em7_s 1 100 0.00 655.359999847 FORMAT "%13.9" ECU_ADDRESS 0x60013064 /end MEASUREMENT
/begin MEASUREMENT StepLtrB1_I.EGSDO2_tiTiConNomAvrgDL_I.memory "Class instance for step response measurement for lambda-based dynamics diagnosis of a wideband-sensor in lean-lean direction (bank 1) / Control time filtering / current lowpass value" ULONG q1p5259Em7_s 1 100 0.00 655.359999847 FORMAT "%13.9" ECU_ADDRESS 0x60013068 /end MEASUREMENT
/begin MEASUREMENT StepRtlB1_I.cntrStepEvln "Class instance for step response measurement for lambda-based dynamics diagnosis of a wideband-sensor in rich-lean direction (bank 1) / Counter of measurement data during step response measurement" UWORD dez 1 100 0.00 65535.00 FORMAT "%8.2" ECU_ADDRESS 0x6001306E /end MEASUREMENT
/begin MEASUREMENT StepRtlB1_I.dratLamRecprLow "Class instance for step response measurement for lambda-based dynamics diagnosis of a wideband-sensor in rich-lean direction (bank 1) / lambda dynamic low" SWORD freq_q9p1553Em5 1 100 -3.000000 2.999908 FORMAT "%8.6" ECU_ADDRESS 0x60013070 /end MEASUREMENT
/begin MEASUREMENT StepRtlB1_I.dratLamRecprPeak "Class instance for step response measurement for lambda-based dynamics diagnosis of a wideband-sensor in rich-lean direction (bank 1) / Maximal or minimal gradient of reciprocal lambda" SWORD freq_q9p1553Em5 1 100 -3.000000 2.999908 FORMAT "%8.6" ECU_ADDRESS 0x60013072 /end MEASUREMENT
/begin MEASUREMENT StepRtlB1_I.dratLamRecprPeakNrm "Class instance for step response measurement for lambda-based dynamics diagnosis of a wideband-sensor in rich-lean direction (bank 1) / Maximal or minimal gradient of reciprocal lambda (normalized)" UWORD fak_uw_b1 1 100 0.00 0.9999847 FORMAT "%9.7" ECU_ADDRESS 0x60013074 /end MEASUREMENT
/begin MEASUREMENT StepRtlB1_I.flgStepEvln "Class instance for step response measurement for lambda-based dynamics diagnosis of a wideband-sensor in rich-lean direction (bank 1) / Evaluation of step response measurement active" UBYTE B_TRUE 1 100 0.00 1.00000000000 BIT_MASK 0x1 FORMAT "%13.11" ECU_ADDRESS 0x6001306C /end MEASUREMENT
/begin MEASUREMENT StepRtlB1_I.flgStepEvlnRes "Class instance for step response measurement for lambda-based dynamics diagnosis of a wideband-sensor in rich-lean direction (bank 1) / Step evaluated" UBYTE B_TRUE 1 100 0.00 1.00000000000 BIT_MASK 0x1 FORMAT "%13.11" ECU_ADDRESS 0x6000BA42 /end MEASUREMENT
/begin MEASUREMENT StepRtlB1_I.flgStepEvlnSuc "Class instance for step response measurement for lambda-based dynamics diagnosis of a wideband-sensor in rich-lean direction (bank 1) / Evaluation of step response measurement successful" UBYTE B_TRUE 1 100 0.00 1.00000000000 BIT_MASK 0x4 FORMAT "%13.11" ECU_ADDRESS 0x6001306C /end MEASUREMENT
/begin MEASUREMENT StepRtlB1_I.flgStepGrdt "Class instance for step response measurement for lambda-based dynamics diagnosis of a wideband-sensor in rich-lean direction (bank 1) / stepchange high enough" UBYTE B_TRUE 1 100 0.00 1.00000000000 BIT_MASK 0x8 FORMAT "%13.11" ECU_ADDRESS 0x6001306C /end MEASUREMENT
/begin MEASUREMENT StepRtlB1_I.ratLamRecprFildPeak "Class instance for step response measurement for lambda-based dynamics diagnosis of a wideband-sensor in rich-lean direction (bank 1) / Minimal or maximal value of reciprocal lambda after step" UWORD fak_q3p0518Em5 1 100 0.00 1.999969 FORMAT "%8.6" ECU_ADDRESS 0x60013076 /end MEASUREMENT
/begin MEASUREMENT StepRtlB1_I.ratLamRecprGrdtPeak "Class instance for step response measurement for lambda-based dynamics diagnosis of a wideband-sensor in rich-lean direction (bank 1) / Reciprocal lambda at maximal or minimal gradient" UWORD fak_q3p0518Em5 1 100 0.00 1.999969 FORMAT "%8.6" ECU_ADDRESS 0x60013078 /end MEASUREMENT
/begin MEASUREMENT StepRtlB1_I.ratLamRecprMax "Class instance for step response measurement for lambda-based dynamics diagnosis of a wideband-sensor in rich-lean direction (bank 1) / maximum reciprocal lambda" UWORD fak_uw_b2 1 100 0.00 1.999969 FORMAT "%8.6" ECU_ADDRESS 0x6001307A /end MEASUREMENT
/begin MEASUREMENT StepRtlB1_I.ratLamRecprMin "Class instance for step response measurement for lambda-based dynamics diagnosis of a wideband-sensor in rich-lean direction (bank 1) / minumum reciprocal lambda" UWORD fak_uw_b2 1 100 0.00 1.999969 FORMAT "%8.6" ECU_ADDRESS 0x6001307C /end MEASUREMENT
/begin MEASUREMENT StepRtlB1_I.ratLamRecprStepHeiBgnReal "Class instance for step response measurement for lambda-based dynamics diagnosis of a wideband-sensor in rich-lean direction (bank 1) / reciprocal lambda at the beginning of a step" UWORD fak_uw_b2 1 100 0.00 1.999969 FORMAT "%8.6" ECU_ADDRESS 0x6001307E /end MEASUREMENT
/begin MEASUREMENT StepRtlB1_I.ratLamRecprStepHeiReal "Class instance for step response measurement for lambda-based dynamics diagnosis of a wideband-sensor in rich-lean direction (bank 1) / reciprocal lambda" UWORD fak_uw_b2 1 100 0.00 1.999969 FORMAT "%8.6" ECU_ADDRESS 0x60013080 /end MEASUREMENT
/begin MEASUREMENT StepRtlB1_I.ratTran "Class instance for step response measurement for lambda-based dynamics diagnosis of a wideband-sensor in rich-lean direction (bank 1) / Ratio of transition times (sensor fault to nominal)" UWORD fak_uw_b32 1 100 0.00 31.99951 FORMAT "%8.5" ECU_ADDRESS 0x60013082 /end MEASUREMENT
/begin MEASUREMENT StepRtlB1_I.tiDly "Class instance for step response measurement for lambda-based dynamics diagnosis of a wideband-sensor in rich-lean direction (bank 1) / Detected delay time" SWORD t_q0p01 1 100 -327.6800 327.6700 FORMAT "%8.4" ECU_ADDRESS 0x60013084 /end MEASUREMENT
/begin MEASUREMENT StepRtlB1_I.tiDlyBasc "Class instance for step response measurement for lambda-based dynamics diagnosis of a wideband-sensor in rich-lean direction (bank 1) / Detected delay time (basic value)" SWORD t_q0p01 1 100 -327.6800 327.6700 FORMAT "%8.4" ECU_ADDRESS 0x60013086 /end MEASUREMENT
/begin MEASUREMENT StepRtlB1_I.tiDlyEquiv "Class instance for step response measurement for lambda-based dynamics diagnosis of a wideband-sensor in rich-lean direction (bank 1) / Equivalent delay time" UWORD t_q0p01 1 100 0.00 655.3500 FORMAT "%8.4" ECU_ADDRESS 0x60013088 /end MEASUREMENT
/begin MEASUREMENT StepRtlB1_I.tiGrdtPeak "Class instance for step response measurement for lambda-based dynamics diagnosis of a wideband-sensor in rich-lean direction (bank 1) / Time of maximal or minimal gradient" UWORD t_q0p01 1 100 0.00 655.3500 FORMAT "%8.4" ECU_ADDRESS 0x6001308A /end MEASUREMENT
/begin MEASUREMENT StepRtlB1_I.tiStepTmr "Class instance for step response measurement for lambda-based dynamics diagnosis of a wideband-sensor in rich-lean direction (bank 1) / Time after step" UWORD t_q0p01 1 100 0.00 655.3500 FORMAT "%8.4" ECU_ADDRESS 0x6001308C /end MEASUREMENT
/begin MEASUREMENT StepRtlB1_I.tiTran "Class instance for step response measurement for lambda-based dynamics diagnosis of a wideband-sensor in rich-lean direction (bank 1) / Detected transition time" SWORD t_q0p01 1 100 -327.6800 327.6700 FORMAT "%8.4" ECU_ADDRESS 0x6001308E /end MEASUREMENT
/begin MEASUREMENT StepRtlB1_I.EGSDO2_StepEvlnERNM_I.oldSignal "Class instance for step response measurement for lambda-based dynamics diagnosis of a wideband-sensor in rich-lean direction (bank 1) / Evaluation Step / value of input signal last calculation" UBYTE B_TRUE 1 100 0.00 1.00000000000 BIT_MASK 0x1 FORMAT "%13.11" ECU_ADDRESS 0x60013090 /end MEASUREMENT
/begin MEASUREMENT StepRtlB1_I.EGSDO2_StepEvlnFF_I.status "Class instance for step response measurement for lambda-based dynamics diagnosis of a wideband-sensor in rich-lean direction (bank 1) / Evaluation Step / current value of RS-FF" UBYTE B_TRUE 1 100 0.00 1.00000000000 BIT_MASK 0x1 FORMAT "%13.11" ECU_ADDRESS 0x60013091 /end MEASUREMENT
/begin MEASUREMENT StepRtlB1_I.EGSDO2_StepEvlnSucER_I.buffer "Class instance for step response measurement for lambda-based dynamics diagnosis of a wideband-sensor in rich-lean direction (bank 1) / Evaluation successfull / rising edge detected" UBYTE B_TRUE 1 100 0.00 1.00000000000 BIT_MASK 0x1 FORMAT "%13.11" ECU_ADDRESS 0x60013092 /end MEASUREMENT
/begin MEASUREMENT StepRtlB1_I.EGSDO2_StepEvlnSucER_I.oldSignal "Class instance for step response measurement for lambda-based dynamics diagnosis of a wideband-sensor in rich-lean direction (bank 1) / Evaluation successfull / flag rising edge" UBYTE B_TRUE 1 100 0.00 1.00000000000 BIT_MASK 0x1 FORMAT "%13.11" ECU_ADDRESS 0x60013093 /end MEASUREMENT
/begin MEASUREMENT StepRtlB1_I.EGSDO2_StepEvlnTONV_I.outbit "Class instance for step response measurement for lambda-based dynamics diagnosis of a wideband-sensor in rich-lean direction (bank 1) / Stepdebouncing / return value" UBYTE B_TRUE 1 100 0.00 1.00000000000 BIT_MASK 0x1 FORMAT "%13.11" ECU_ADDRESS 0x60013094 /end MEASUREMENT
/begin MEASUREMENT StepRtlB1_I.EGSDO2_StepEvlnTONV_I.time "Class instance for step response measurement for lambda-based dynamics diagnosis of a wideband-sensor in rich-lean direction (bank 1) / Stepdebouncing / expired delay time" UWORD t_q0p01 1 100 0.00 655.3500 FORMAT "%8.4" ECU_ADDRESS 0x60013096 /end MEASUREMENT
/begin MEASUREMENT StepRtlB1_I.EGSDO2_TarDneER_I.buffer "Class instance for step response measurement for lambda-based dynamics diagnosis of a wideband-sensor in rich-lean direction (bank 1) / Target done / rising edge detected" UBYTE B_TRUE 1 100 0.00 1.00000000000 BIT_MASK 0x1 FORMAT "%13.11" ECU_ADDRESS 0x60013098 /end MEASUREMENT
/begin MEASUREMENT StepRtlB1_I.EGSDO2_TarDneER_I.oldSignal "Class instance for step response measurement for lambda-based dynamics diagnosis of a wideband-sensor in rich-lean direction (bank 1) / Target done / flag rising edge" UBYTE B_TRUE 1 100 0.00 1.00000000000 BIT_MASK 0x1 FORMAT "%13.11" ECU_ADDRESS 0x60013099 /end MEASUREMENT
/begin MEASUREMENT StepRtlB1_I.EGSDO2_TarDneFF_I.status "Class instance for step response measurement for lambda-based dynamics diagnosis of a wideband-sensor in rich-lean direction (bank 1) / Target done / current value of RS-FF" UBYTE B_TRUE 1 100 0.00 1.00000000000 BIT_MASK 0x1 FORMAT "%13.11" ECU_ADDRESS 0x6001309A /end MEASUREMENT
/begin MEASUREMENT StepRtlB1_I.EGSDO2_flgStepEF_I.buffer "Class instance for step response measurement for lambda-based dynamics diagnosis of a wideband-sensor in rich-lean direction (bank 1) / Step detected / memory to detect falling edge" UBYTE B_TRUE 1 100 0.00 1.00000000000 BIT_MASK 0x1 FORMAT "%13.11" ECU_ADDRESS 0x6001309C /end MEASUREMENT
/begin MEASUREMENT StepRtlB1_I.EGSDO2_flgStepEF_I.oldSignal "Class instance for step response measurement for lambda-based dynamics diagnosis of a wideband-sensor in rich-lean direction (bank 1) / Step detected / memory to detect falling edge" UBYTE B_TRUE 1 100 0.00 1.00000000000 BIT_MASK 0x1 FORMAT "%13.11" ECU_ADDRESS 0x6001309D /end MEASUREMENT
/begin MEASUREMENT StepRtlB1_I.EGSDO2_tiDeadTiNomAvrgDL_I.memory "Class instance for step response measurement for lambda-based dynamics diagnosis of a wideband-sensor in rich-lean direction (bank 1) / Dead time filtering / current lowpass value" ULONG q1p5259Em7_s 1 100 0.00 655.359999847 FORMAT "%13.9" ECU_ADDRESS 0x600130A0 /end MEASUREMENT
/begin MEASUREMENT StepRtlB1_I.EGSDO2_tiTiConNomAvrgDL_I.memory "Class instance for step response measurement for lambda-based dynamics diagnosis of a wideband-sensor in rich-lean direction (bank 1) / Control time filtering / current lowpass value" ULONG q1p5259Em7_s 1 100 0.00 655.359999847 FORMAT "%13.9" ECU_ADDRESS 0x600130A4 /end MEASUREMENT
/begin FUNCTION EGSDCmn_CoorrParlShoTrip "1.8.1     Coordinator of short trip requests for parallelization of active exhaust gas sensor and catalyst diagnosis"
 /begin DEF_CHARACTERISTIC EGSDCmn_flgMultiChkParl_C EGSDCmn_flgShtrpTstOnlyParl_CW EGSDCmn_tiMinMultiChkRstEvlnParl_C /end DEF_CHARACTERISTIC
 /begin IN_MEASUREMENT EGSDCmn_flgSeg1B1ActvRqrdParl SyC_ctPostDrvLeave /end IN_MEASUREMENT
 /begin OUT_MEASUREMENT EGSDCmn_cntrRstEvlnParl EGSDCmn_flgInhbProdModParl EGSDCmn_flgProdModParl EGSDCmn_flgRmnProdModParl EGSDCmn_flgShtrpParl /end OUT_MEASUREMENT
 /begin LOC_MEASUREMENT EGSDCmn_cntrRstEvlnParlCTR_I.counter EGSDCmn_ctReIniShoTrip EGSDCmn_flgRstEvlnParlER_I.buffer EGSDCmn_flgRstEvlnParlER_I.oldSignal EGSDCmn_tiRstEvlnParlSW_I.timeCounter /end LOC_MEASUREMENT
 FUNCTION_VERSION "1.8.1" /end FUNCTION
/begin FUNCTION EGSDCmn_ObdStc "1.18.0    Output statistic data for OBD sensor diagnosis of EGSDia" /begin IN_MEASUREMENT EGSDO2_facMdlFltDeEvlnB1 EGSDO2_facMdlNomDeEvlnB1 /end IN_MEASUREMENT
 /begin OUT_MEASUREMENT EGSDO2_facMdlDeEvlnDiffMaxB1 EGSDO2_facMdlDeEvlnDiffMinB1 EGSDO2_facMdlFltDeEvlnMaxB1 EGSDO2_facMdlNomDeEvlnMaxB1 /end OUT_MEASUREMENT
 FUNCTION_VERSION "1.18.0" /end FUNCTION
/begin FUNCTION EGSDCmn_SigPrepn "1.9.1     Signal preparation of parallelization of active exhaust gas sensor dynamic diagnosis and catalyst diagnosis"
 /begin DEF_CHARACTERISTIC EGSDCmn_nrUGrdt_C EGSDCmn_ratS1OffsLeanParl_C EGSDCmn_ratS1OffsRichParl_C EGSDCmn_swtCatT_C EGSDCmn_tiUInpFltParl_C EGSDCmn_tiUInpFltTWCD_C /end DEF_CHARACTERISTIC
 /begin REF_CHARACTERISTIC EGSDCmn_ratLamLeanParl_C EGSDCmn_ratLamRichParl_C /end REF_CHARACTERISTIC
 /begin IN_MEASUREMENT EGSSig_flgO2RelsS1B1 EGSSig_ratLamS1B1 ExhMgT_tCat1SelnRst ExhMod_dmExhCat1B1 ExhMod_dmExhWoFuUsCat1B1 ExhMod_dmO2Cat1B1 ExhMod_mfO2Cat1B1 ExhMod_tCat1AvrgB1 ExhMod_tCat1B1 ExhMod_tCat1EndB1 ExhMod_tCat1InB1 ExhMod_tCat1MaxB1 ExhMod_tCat1MinB1 ExhMod_tExhS2B1 HEGO_bS2B1Vld HEGO_uS2B1WiH2HiRes SyC_stSub /end IN_MEASUREMENT
 /begin OUT_MEASUREMENT EGSDCmn_dmO2Cat1B1Parl EGSDCmn_dmSeg1B1O2Parl EGSDCmn_dmSeg1B1RichParl EGSDCmn_dmSeg1B1VirtO2Parl EGSDCmn_dmSeg1B1VirtRichParl EGSDCmn_duS2B1Parl EGSDCmn_flgS1B1VldParl EGSDCmn_flgS2B1VldParl EGSDCmn_mfEgCat1B1Parl EGSDCmn_mfO2Cat1B1Parl EGSDCmn_mfSeg1B1O2Parl EGSDCmn_mfSeg1B1RichParl EGSDCmn_mfSeg1B1VirtO2Parl EGSDCmn_mfSeg1B1VirtRichParl EGSDCmn_ratLamActS1B1 EGSDCmn_tCat1B1MaxParl EGSDCmn_tCat1B1MinParl EGSDCmn_tCat1B1Parl EGSDCmn_tCat1B1VirtParl EGSDCmn_tS2B1SensParl EGSDCmn_uS2B1FildParl EGSDCmn_uS2B1FildTWCD /end OUT_MEASUREMENT
 /begin LOC_MEASUREMENT EGSDCmn_idxGrdtAryInp EGSDCmn_idxGrdtAryOutp EGSDCmn_mfEgCat1B1WoFu EGSDCmn_mfEgCat1B1WoFuParl EGSDCmn_S2B1UInpParlLT_I.memory EGSDCmn_S2B1UInpTWCDLT_I.memory EGSDCmn_Seg1B1mfParl_I.mfO2 EGSDCmn_Seg1B1mfParl_I.mfRich EGSDCmn_Seg1B1mfVirtParl_I.mfO2 EGSDCmn_Seg1B1mfVirtParl_I.mfRich EGSDCmn_tiUInpFltParl EGSDCmn_uS2B1Old_a /end LOC_MEASUREMENT
 FUNCTION_VERSION "1.9.1" /end FUNCTION
/begin FUNCTION EGSDO2_Evln "1.10.0    Evaluation of dynamic diagnostics of UEGO sensor based on O2 signal"
 /begin DEF_CHARACTERISTIC EGSDO2_nrMeasFltCfm_C EGSDO2_nrMeasShtrp_C EGSDO2_nrMeasTripCodClr_C EGSDO2_nrMeasTripStepChg_C EGSDO2_tiDlyBpu_C EGSDO2_tiDlyIdnFltThd_C EGSDO2_tiDlyLtrStepFltThdShtrp_C EGSDO2_tiDlyRtlStepFltThdShtrp_C EGSDO2_tiSumIdnFltThd_C EGSDO2_tiTranBpu_C EGSDO2_tiTranIdnFltThd_C EGSDO2_tiTranLtrStepFltThdShtrp_C EGSDO2_tiTranRtlStepFltThdShtrp_C /end DEF_CHARACTERISTIC
 /begin REF_CHARACTERISTIC EGSDO2_nrMeasFltCfmCodClr_C EGSDO2_nrMeasFltCfmStepChg_C EGSDO2_tiDlyLtrStepFltThd_C EGSDO2_tiDlyRtlStepFltThd_C EGSDO2_tiTranLtrStepFltThd_C EGSDO2_tiTranRtlStepFltThd_C EGSDO2_flgSymcDynStepRtl_C /end REF_CHARACTERISTIC
 /begin IN_MEASUREMENT DSMAUX_stDsmClrActv EGSDCmn_cntrRstEvlnParl EGSDCmn_flgEnvtlDiPID41Parl EGSDCmn_flgProdModParl EGSDCmn_flgShtrpParl EGSDO2_cntrStepLtrS1B1 EGSDO2_cntrStepLtrTripVirtS1B1 EGSDO2_cntrStepRtlS1B1 EGSDO2_cntrStepRtlTripVirtS1B1 EGSDO2_flgArithFiltg EGSDO2_flgIdnFinshdS1B1 EGSDO2_flgIdnFltSuspcS1B1 EGSDO2_flgLossEvlnDneB1 EGSDO2_flgLtrErrEwmaQckFailS1B1 EGSDO2_flgLtrStepChgS1B1 EGSDO2_flgQlyDeFltSuspcB1 EGSDO2_flgRtlErrEwmaQckFailS1B1 EGSDO2_flgRtlStepChgS1B1 EGSDO2_flgStepLtrEvlnS1B1 EGSDO2_flgStepRtlEvlnS1B1 EGSDO2_flgSymTranOnly EGSDO2_nrMeasLtrTrpS1B1 EGSDO2_nrMeasRtlTrpS1B1 EGSDO2_stEwmaModLtrS1B1 EGSDO2_stEwmaModRtlS1B1 EGSDO2_stStepB1 EGSDO2_tiDlyEwmaLtrS1B1 EGSDO2_tiDlyEwmaRtlS1B1 EGSDO2_tiDlyIdnLtrB1 EGSDO2_tiDlyIdnRtlB1 EGSDO2_tiDlyLtrS1B1 EGSDO2_tiDlyRtlS1B1 EGSDO2_tiTranEwmaLtrS1B1 EGSDO2_tiTranEwmaRtlS1B1 EGSDO2_tiTranIdnLtrB1 EGSDO2_tiTranIdnRtlB1 EGSDO2_tiTranLtrS1B1 EGSDO2_tiTranRtlS1B1 SyC_ctPostDrvLeave SyC_stSub /end IN_MEASUREMENT
 /begin OUT_MEASUREMENT EGSDO2_flgDSMClrEvlnB1 EGSDO2_flgDynErrSuspcS1B1 EGSDO2_flgDynLtrTripDneS1B1 EGSDO2_flgDynLtrTripDneVirtS1B1 EGSDO2_flgDynRtlTripDneS1B1 EGSDO2_flgDynRtlTripDneVirtS1B1 EGSDO2_flgIdnFltS1B1 EGSDO2_flgLamDynDFCErrB1 EGSDO2_flgLamDynDFCTstdB1 EGSDO2_tiSumIdnLtrS1B1 EGSDO2_tiSumIdnRtlS1B1 /end OUT_MEASUREMENT
 /begin LOC_MEASUREMENT EGSDO2_ctReini100msEvln EGSDO2_flgDlyStepFltLtrB1 EGSDO2_flgDlyStepFltRtlB1 EGSDO2_flgDSMClrEvlnReqdB1 EGSDO2_flgFltEvlnB1 EGSDO2_flgInhbLamDynB1 EGSDO2_flgRstEvlnParl EGSDO2_flgSrv06OutpFltEvlnB1 EGSDO2_flgSrv06OutpHealEvlnB1 EGSDO2_flgStepFltB1 EGSDO2_flgTranStepFltLtrB1 EGSDO2_flgTranStepFltRtlB1 EGSDO2_flgVldEvlnB1 EGSDO2_FltDetnB1_I.cntrStepLtrVirt EGSDO2_FltDetnB1_I.cntrStepRtlVirt EGSDO2_FltDetnB1_I.flgDlyIdnFltLtr EGSDO2_FltDetnB1_I.flgDlyIdnFltRtl EGSDO2_FltDetnB1_I.flgDynLtrDne EGSDO2_FltDetnB1_I.flgDynLtrDneVirt EGSDO2_FltDetnB1_I.flgDynLtrTripDne EGSDO2_FltDetnB1_I.flgDynLtrTripDneVirt EGSDO2_FltDetnB1_I.flgDynRtlDne EGSDO2_FltDetnB1_I.flgDynRtlDneVirt EGSDO2_FltDetnB1_I.flgDynRtlTripDne EGSDO2_FltDetnB1_I.flgDynRtlTripDneVirt EGSDO2_FltDetnB1_I.flgIdnFlt EGSDO2_FltDetnB1_I.flgInitER EGSDO2_FltDetnB1_I.flgQckPassdFaildLtr EGSDO2_FltDetnB1_I.flgQckPassdFaildRtl EGSDO2_FltDetnB1_I.flgQckPassdLtr EGSDO2_FltDetnB1_I.flgQckPassdRtl EGSDO2_FltDetnB1_I.flgTranIdnFltLtr EGSDO2_FltDetnB1_I.flgTranIdnFltRtl EGSDO2_FltDetnB1_I.stEwmaVirtModLtr EGSDO2_FltDetnB1_I.stEwmaVirtModLtrEnum EGSDO2_FltDetnB1_I.stEwmaVirtModRtl EGSDO2_FltDetnB1_I.stEwmaVirtModRtlEnum EGSDO2_FltDetnB1_I.tiDlyIdnLtrFlt EGSDO2_FltDetnB1_I.tiDlyIdnRtlFlt EGSDO2_FltDetnB1_I.tiSumIdnLtr EGSDO2_FltDetnB1_I.tiSumIdnRtl EGSDO2_FltDetnB1_I.tiTranIdnLtrFlt EGSDO2_FltDetnB1_I.tiTranIdnRtlFlt EGSDO2_FltDetnB1_I.LamDynQckPassdDlyLtr_I.flgQckPassdFaild EGSDO2_FltDetnB1_I.LamDynQckPassdDlyRtl_I.flgQckPassdFaild EGSDO2_FltDetnB1_I.LamDynQckPassdTranLtr_I.flgQckPassdFaild EGSDO2_FltDetnB1_I.LamDynQckPassdTranRtl_I.flgQckPassdFaild EGSDO2_FltDetnB1_I.cntrStepLtrTripVirtDOS_I.buffer EGSDO2_FltDetnB1_I.cntrStepLtrTripVirtDOS_I.oldValue EGSDO2_FltDetnB1_I.cntrStepRtlTripVirtDOS_I.buffer EGSDO2_FltDetnB1_I.cntrStepRtlTripVirtDOS_I.oldValue EGSDO2_tiTranIdnFltMaxB1 /end LOC_MEASUREMENT
 FUNCTION_VERSION "1.10.0" /end FUNCTION
/begin FUNCTION EGSDO2_IdnEna "1.9.0     Enable conditions for the continuous UEGO sensor dynamics identification"
 /begin DEF_CHARACTERISTIC EGSDO2_dmExhEnaIdn_C EGSDO2_dmfExhIdnMax_C EGSDO2_dmfExhIdnMin_C EGSDO2_dmFpcDynEnaMax_C EGSDO2_dratFillgThd_C EGSDO2_flgEvlnDynDurgEnaIdn_CW EGSDO2_flgIdnDurgCatPurg_C EGSDO2_flgIdnDurgParl_CW EGSDO2_flgSeqDyn_C EGSDO2_mfFpcIdnEna_C EGSDO2_mFpcDynEnaMin_C EGSDO2_ratFillgMinIdnEna_T EGSDO2_ratLamEnaThd_C EGSDO2_tiEnaIdnMFlow_C EGSDO2_tiFilExhMFlowIdn_C EGSDO2_tiGearShift_C EGSDO2_tiPt1RatFillgEna_C EGSDO2_tiTiConNomEnaIdnShtrp_C EGSDO2_tiTiConNomEnaIdn_C EGSDO2_tiTurnOffExct_C EGSDO2_tiTurnOffIdnLamMon_C EGSDO2_tiTurnOffVlvLft_C EGSDO2_tiTurnOnBpChg_C EGSDO2_tiTurnOnEna_C EGSDO2_tiTurnOnFcoFltSuspc_C EGSDO2_tiTurnOnFco_C EGSDO2_tiTurnOnFillgGrdtFltSuspc_C EGSDO2_tiTurnOnFillgGrdt_C EGSDO2_tiTurnOnFillg_C EGSDO2_tiTurnOnSnsrRdn_C EGSDO2_tiTurnOnStrt_C /end DEF_CHARACTERISTIC
 /begin REF_CHARACTERISTIC EGSDCmn_facFpcAdpnMaxParl_C /end REF_CHARACTERISTIC
 /begin IN_MEASUREMENT B_bevab_msg B_gsch_msg B_lambts_msg B_lrs_msg B_vhegfe_msg EGSDCmn_cntrRstEvlnParl EGSDCmn_flgEnaEthParl EGSDCmn_flgLamMonOkParlB1 EGSDCmn_flgS1B1VldParl EGSDCmn_flgSeg1B1PhyEnaParl EGSDCmn_flgSeg1B1ReldFinalParl EGSDCmn_flgShtrpParl EGSDCmn_mfEgCat1B1Parl EGSDO2_flgBpWideS1B1 EGSDO2_flgIdnFltS1B1 EGSDO2_flgIdnFltSuspcS1B1 EGSDO2_ratLamRecprMdlBpLtrS1B1 EGSDO2_ratLamRecprMdlBpRtlS1B1 EGSDO2_tiDlyIdnLtrB1 EGSDO2_tiDlyIdnRtlB1 EngStrt_bStrtEnd Epm_nEng ftead_w_msg imsteini_msg mstedte_w_msg rl_w_msg SyC_ctPostDrvLeave TWCC_bEnaRichPurgB1 zlamko_msg zlrslb_w_msg /end IN_MEASUREMENT
 /begin OUT_MEASUREMENT EGSDO2_flgEnaIdnB1 EGSDO2_flgEnaIdnLtrB1 EGSDO2_flgEnaIdnRtlB1 EGSDO2_flgEnaLossB1 /end OUT_MEASUREMENT
 /begin LOC_MEASUREMENT EGSDO2_BpChgB1TONV_I.outbit EGSDO2_BpChgB1TONV_I.time EGSDO2_ctReIni10msIdnEna EGSDO2_DerExhMFlowB1TONV_I.outbit EGSDO2_DerExhMFlowB1TONV_I.time EGSDO2_dmfExhDynB1 EGSDO2_dratFillgAbslt EGSDO2_EnaB1TONV_I.outbit EGSDO2_EnaB1TONV_I.time EGSDO2_EnaIdnLamMonB1TOFFV_I.outbit EGSDO2_EnaIdnLamMonB1TOFFV_I.time EGSDO2_EnaIdnVlvLftTOFFV_I.outbit EGSDO2_EnaIdnVlvLftTOFFV_I.time EGSDO2_EnaSnsrRdnB1TONV_I.outbit EGSDO2_EnaSnsrRdnB1TONV_I.time EGSDO2_EvlnActvEnaIdnB1FF_I.status EGSDO2_EvlnActvEnaIdnDurgParlB1FF_I.status EGSDO2_ExctLtrB1TOFFV_I.outbit EGSDO2_ExctLtrB1TOFFV_I.time EGSDO2_ExctRtlB1TOFFV_I.outbit EGSDO2_ExctRtlB1TOFFV_I.time EGSDO2_FcoB1TONV_I.outbit EGSDO2_FcoB1TONV_I.time EGSDO2_FillgGrdtTONV_I.outbit EGSDO2_FillgGrdtTONV_I.time EGSDO2_FillgTONV_I.outbit EGSDO2_FillgTONV_I.time EGSDO2_flgDSMClrIdnEna EGSDO2_flgEnaCmnIdn EGSDO2_flgEnaCmnPrjUnSpcIdn EGSDO2_flgEnaPrjUnSpcIdnB1 EGSDO2_flgRstIdnEnaParl EGSDO2_flgVlvLftEB_I.buffer EGSDO2_flgVlvLftEB_I.oldSignal EGSDO2_mfExhFilB1LT_I.memory EGSDO2_ratFillgPredDt1LT_I.memory EGSDO2_ShiftTONV_I.outbit EGSDO2_ShiftTONV_I.time EGSDO2_StrtTONV_I.outbit EGSDO2_StrtTONV_I.time /end LOC_MEASUREMENT
 FUNCTION_VERSION "1.9.0" /end FUNCTION
/begin FUNCTION EGSDO2_LamDyn "1.44.1    Lambda based dynamic diagnosis of a wideband sensor"
 /begin DEF_CHARACTERISTIC EGSDO2_tiLamMonOkVirtThd_C EGSDO2_facIdnGainDly_C EGSDO2_facIdnGainTran_C EGSDO2_facMdlNrmSumMin_C EGSDO2_facQlyDeFltSuspc_C EGSDO2_facQlyDeOKThd_C EGSDO2_facQlyDeRstThd_C EGSDO2_facQlyFltSuspc_C EGSDO2_tiLossTmrThd_C EGSDO2_facBndToErrEvln_C EGSDO2_tiDlyStepChgCfm_C EGSDO2_tiDlyStepChgSuspc_C EGSDO2_tiTranStepChgCfm_C EGSDO2_tiTranStepChgSuspc_C EGSDO2_facDeltaStepEnd_C EGSDO2_facDlyEquiv_T EGSDO2_facTarLtrLamDyn_C EGSDO2_facTarRtlLamDyn_C EGSDO2_facTiTranTout_C EGSDO2_flgStepBgnReal_C EGSDO2_flgStepEndReal_C EGSDO2_ratTran_T EGSDO2_facEwmaCodClr_C EGSDO2_facEwmaNorm_C EGSDO2_facEwmaStepChg_C EGSDO2_flgLamSpDyn_C EGSDO2_flgSymcDynStepRtl_C EGSDO2_nrMeasFltCfmCodClr_C EGSDO2_nrMeasFltCfmStepChg_C EGSDO2_stLamDyn_C EGSDO2_tiDlyLtrStepFltThd_C EGSDO2_tiDlyRtlStepFltThd_C EGSDO2_tiGrdtTmrThd_C EGSDO2_tiSumAdpnThd_C EGSDO2_tiSumDeltaAdpnThd_C EGSDO2_tiTranLtrStepFltThd_C EGSDO2_tiTranRtlStepFltThd_C ResFilLtrB1_I.tiDlyIni_C ResFilLtrB1_I.tiTranIni_C ResFilRtlB1_I.tiDlyIni_C ResFilRtlB1_I.tiTranIni_C /end DEF_CHARACTERISTIC
 /begin REF_CHARACTERISTIC EGSDO2_flgIdnDurgParl_CW EGSDO2_flgSeqDyn_C EGSDCmn_flgSymTranOnly_CW EGSDO2_numGrdtPnt_C EGSDO2_tiPt1LamDerS1_C /end REF_CHARACTERISTIC
 /begin IN_MEASUREMENT Eep_EnvRamInvld EGSDCmn_cntrRstEvlnParl EGSDCmn_flgIdnAdpnEndParlS1B1 EGSDCmn_flgIdnAdpnEndVirtParlS1B1 EGSDCmn_flgProdModParl EGSDCmn_flgSeg1B1VirtReldFinalParl EGSDCmn_flgShtrpParl EGSDCmn_stLamGenrParlB1 EGSDCmn_stVirtLamDynParlB1 EGSDO2_dratLamRecprFildS1B1 EGSDO2_flgDSMClrEvlnB1 EGSDO2_flgDynAdpnLtrS1B1 EGSDO2_flgDynAdpnRtlS1B1 EGSDO2_flgEnaIdnB1 EGSDO2_flgEnaIdnLtrB1 EGSDO2_flgEnaIdnRtlB1 EGSDO2_flgEnaLossB1 EGSDO2_flgLamDynDFCErrB1 EGSDO2_flgLamDynDFCTstdB1 EGSDO2_ratLamRecprBpLtrS1B1 EGSDO2_ratLamRecprBpRtlS1B1 EGSDO2_ratLamRecprBpS1B1 EGSDO2_ratLamRecprFildS1B1 EGSDO2_ratLamRecprMdlBpLtrS1B1 EGSDO2_ratLamRecprMdlBpRtlS1B1 EGSDO2_ratLamRecprMdlBpS1B1 EGSDO2_ratLamRecprMdlFltBpLtrS1B1 EGSDO2_ratLamRecprMdlFltBpRtlS1B1 EGSDO2_ratLamRecprMdlFltBpS1B1 EGSDO2_stStepB1 EGSDO2_tiDlyAdpnS1B1 EGSDO2_tiTranAdpnS1B1 LamCtrl_ratLamSpNoDynS1B1 lamsbg_w_msg SyC_ctPostDrvLeave tlrslb_w_msg zlrslb_w_msg /end IN_MEASUREMENT
 /begin OUT_MEASUREMENT EGSDO2_cntrStepLtrS1B1 EGSDO2_cntrStepLtrTripVirtS1B1 EGSDO2_cntrStepRtlS1B1 EGSDO2_cntrStepRtlTripVirtS1B1 EGSDO2_facMdlFltDeEvlnB1 EGSDO2_facMdlNomDeEvlnB1 EGSDO2_flgArithFiltg EGSDO2_flgDynStepLtrB1 EGSDO2_flgDynStepRtlB1 EGSDO2_flgIdnFinshdS1B1 EGSDO2_flgIdnFltSuspcDeltaS1B1 EGSDO2_flgIdnFltSuspcLtrS1B1 EGSDO2_flgIdnFltSuspcRtlS1B1 EGSDO2_flgIdnFltSuspcS1B1 EGSDO2_flgLamMonOkVirtB1 EGSDO2_flgLossEvlnDneB1 EGSDO2_flgLtrErrEwmaQckFailS1B1 EGSDO2_flgLtrStepChgS1B1 EGSDO2_flgQlyDeFltSuspcB1 EGSDO2_flgRstAdpnDynB1 EGSDO2_flgRtlErrEwmaQckFailS1B1 EGSDO2_flgRtlStepChgS1B1 EGSDO2_flgStepLtrEvlnS1B1 EGSDO2_flgStepRtlEvlnS1B1 EGSDO2_flgSymTranOnly EGSDO2_nrMeasLtrTrpS1B1 EGSDO2_nrMeasRtlTrpS1B1 EGSDO2_stEwmaModLtrS1B1 EGSDO2_stEwmaModRtlS1B1 EGSDO2_tiDlyEwmaLtrS1B1 EGSDO2_tiDlyEwmaRtlS1B1 EGSDO2_tiDlyIdnLtrB1 EGSDO2_tiDlyIdnRtlB1 EGSDO2_tiDlyLtrS1B1 EGSDO2_tiDlyLtrStepS1B1 EGSDO2_tiDlyRtlS1B1 EGSDO2_tiDlyRtlStepS1B1 EGSDO2_tiSumDeltaAdapS1B1 EGSDO2_tiTranEwmaLtrS1B1 EGSDO2_tiTranEwmaRtlS1B1 EGSDO2_tiTranIdnLtrB1 EGSDO2_tiTranIdnRtlB1 EGSDO2_tiTranLtrS1B1 EGSDO2_tiTranLtrStepS1B1 EGSDO2_tiTranRtlS1B1 EGSDO2_tiTranRtlStepS1B1 /end OUT_MEASUREMENT
 /begin LOC_MEASUREMENT DiumprB1_I.cntrStepLtrTripVirt DiumprB1_I.cntrStepRtlTripVirt DiumprB1_I.flgLamMonOkVirt DiumprB1_I.flgStepVirtDne DiumprB1_I.tiEnaIdnVirt DiumprB1_I.tiStepTmrVirt DiumprB1_I.EGSDO2_StepVirtDneERNM_I.oldSignal DiumprB1_I.EGSDO2_StepVirtLtrFF_I.status DiumprB1_I.EGSDO2_StepVirtRtlFF_I.status DiumprB1_I.StepStateVirt_I.flgDynStepLtrReset DiumprB1_I.StepStateVirt_I.flgDynStepLtrSet DiumprB1_I.StepStateVirt_I.flgDynStepRtlReset DiumprB1_I.StepStateVirt_I.flgDynStepRtlSet EGSDO2_ctReini100msLamDyn EGSDO2_ctReIni10msLamDyn EGSDO2_DynStepExptLtrFF_I.status EGSDO2_DynStepExptRtlFF_I.status EGSDO2_DynStepLtrFF_I.status EGSDO2_DynStepRtlFF_I.status EGSDO2_flgClrLamDyn100msB1 EGSDO2_flgClrLamDyn10msB1 EGSDO2_flgLossEvlnRlsStepB1 EGSDO2_flgRstLamDynParl100ms EGSDO2_flgRstLamDynParl10ms EGSDO2_flgTranSlowB1 EGSDO2_LamDynNoInhb100msS1B1EFNM_I.oldSignal EGSDO2_LamDynNoInhbS1B1EF_I.buffer EGSDO2_LamDynNoInhbS1B1EF_I.oldSignal EGSDO2_QlyDeFltSuspcB1FF_I.status EGSDO2_ratLamRecprStepHeiB1 EGSDO2_RstAdpnDynB1FF_I.status EGSDO2_StepIf.dratLamRecprFild EGSDO2_StepIf.flgTranSlow EGSDO2_StepIf.lamsbg_w EGSDO2_StepIf.ratLamRecprFild EGSDO2_StepIf.ratLamRecprStepHei EGSDO2_StepIf.stLamGenrParl EGSDO2_StepIf.tlrslb_w EGSDO2_StepIf.zlrslb_w EGSDO2_StepStateB1_I.flgDynStepLtrReset EGSDO2_StepStateB1_I.flgDynStepLtrSet EGSDO2_StepStateB1_I.flgDynStepRtlReset EGSDO2_StepStateB1_I.flgDynStepRtlSet IdnLossB1_I.facMdlFltDe IdnLossB1_I.facMdlFltDeAvrg IdnLossB1_I.facMdlFltDeEvln IdnLossB1_I.facMdlFltQlySum IdnLossB1_I.facMdlNom IdnLossB1_I.facMdlNomBasSum IdnLossB1_I.facMdlNomDe IdnLossB1_I.facMdlNomDeAvrg IdnLossB1_I.facMdlNomDeEvln IdnLossB1_I.facMdlNomQlySum IdnLossB1_I.flgFltSuspc IdnLossB1_I.flgLossEvlnDne IdnLossB1_I.flgRlsStep IdnLossB1_I.flgRstAdpn IdnLossB1_I.tiLossTmr IdnLtrB1_I.dratLamDly IdnLtrB1_I.dratLamTran IdnLtrB1_I.ratLamErrNrm IdnLtrB1_I.ratLamRecprMdlBpFild IdnLtrB1_I.ratLamRecprMdlFltBpFild IdnLtrB1_I.tiDlyIdn IdnLtrB1_I.tiTranIdn IdnLtrB1_I.DerDlyDTTtopt_I.buffer IdnLtrB1_I.DerDlyDTTtopt_I.counter IdnLtrB1_I.DerDlyDTTtopt_I.pointer IdnLtrB1_I.EGSDO2_DlyIdnIK_I.memory IdnLtrB1_I.EGSDO2_TranIdnIK_I.memory IdnRtlB1_I.dratLamDly IdnRtlB1_I.dratLamTran IdnRtlB1_I.ratLamErrNrm IdnRtlB1_I.ratLamRecprMdlBpFild IdnRtlB1_I.ratLamRecprMdlFltBpFild IdnRtlB1_I.tiDlyIdn IdnRtlB1_I.tiTranIdn IdnRtlB1_I.DerDlyDTTtopt_I.buffer IdnRtlB1_I.DerDlyDTTtopt_I.counter IdnRtlB1_I.DerDlyDTTtopt_I.pointer IdnRtlB1_I.EGSDO2_DlyIdnIK_I.memory IdnRtlB1_I.EGSDO2_TranIdnIK_I.memory ResFilLtrB1_I.cntrStep ResFilLtrB1_I.cntrStepShtrp ResFilLtrB1_I.flgArith ResFilLtrB1_I.flgErrEwmaQckFail ResFilLtrB1_I.flgProdModParl ResFilLtrB1_I.flgShtrpParl ResFilLtrB1_I.flgStepChg ResFilLtrB1_I.nrMeasTrip ResFilLtrB1_I.stEwmaMod ResFilLtrB1_I.stEwmaModEnum ResFilLtrB1_I.tiDlyAvrg ResFilLtrB1_I.tiDlyEwma ResFilLtrB1_I.tiDlyStepRaw ResFilLtrB1_I.tiTranAvrg ResFilLtrB1_I.tiTranEwma ResFilLtrB1_I.tiTranStepRaw ResFilLtrB1_I.EGSDO2_tiDlyAvrgDL_I.memory ResFilLtrB1_I.EGSDO2_tiDlyAvrgShtrpDL_I.memory ResFilLtrB1_I.EGSDO2_tiDlyEwmaDL_I.memory ResFilLtrB1_I.EGSDO2_tiTranAvrgDL_I.memory ResFilLtrB1_I.EGSDO2_tiTranAvrgShtrpDL_I.memory ResFilLtrB1_I.EGSDO2_tiTranEwmaDL_I.memory ResFilRtlB1_I.cntrStep ResFilRtlB1_I.cntrStepShtrp ResFilRtlB1_I.flgArith ResFilRtlB1_I.flgErrEwmaQckFail ResFilRtlB1_I.flgProdModParl ResFilRtlB1_I.flgShtrpParl ResFilRtlB1_I.flgStepChg ResFilRtlB1_I.nrMeasTrip ResFilRtlB1_I.stEwmaMod ResFilRtlB1_I.stEwmaModEnum ResFilRtlB1_I.tiDlyAvrg ResFilRtlB1_I.tiDlyEwma ResFilRtlB1_I.tiDlyStepRaw ResFilRtlB1_I.tiTranAvrg ResFilRtlB1_I.tiTranEwma ResFilRtlB1_I.tiTranStepRaw ResFilRtlB1_I.EGSDO2_tiDlyAvrgDL_I.memory ResFilRtlB1_I.EGSDO2_tiDlyAvrgShtrpDL_I.memory ResFilRtlB1_I.EGSDO2_tiDlyEwmaDL_I.memory ResFilRtlB1_I.EGSDO2_tiTranAvrgDL_I.memory ResFilRtlB1_I.EGSDO2_tiTranAvrgShtrpDL_I.memory ResFilRtlB1_I.EGSDO2_tiTranEwmaDL_I.memory StepLtrB1_I.cntrStepEvln StepLtrB1_I.dratLamRecprLow StepLtrB1_I.dratLamRecprPeak StepLtrB1_I.dratLamRecprPeakNrm StepLtrB1_I.flgStepEvln StepLtrB1_I.flgStepEvlnRes StepLtrB1_I.flgStepEvlnSuc StepLtrB1_I.flgStepGrdt StepLtrB1_I.ratLamRecprFildPeak StepLtrB1_I.ratLamRecprGrdtPeak StepLtrB1_I.ratLamRecprMax StepLtrB1_I.ratLamRecprMin StepLtrB1_I.ratLamRecprStepHeiBgnReal StepLtrB1_I.ratLamRecprStepHeiReal StepLtrB1_I.ratTran StepLtrB1_I.tiDly StepLtrB1_I.tiDlyBasc StepLtrB1_I.tiDlyEquiv StepLtrB1_I.tiGrdtPeak StepLtrB1_I.tiStepTmr StepLtrB1_I.tiTran StepLtrB1_I.EGSDO2_StepEvlnERNM_I.oldSignal StepLtrB1_I.EGSDO2_StepEvlnFF_I.status StepLtrB1_I.EGSDO2_StepEvlnSucER_I.buffer StepLtrB1_I.EGSDO2_StepEvlnSucER_I.oldSignal StepLtrB1_I.EGSDO2_StepEvlnTONV_I.outbit StepLtrB1_I.EGSDO2_StepEvlnTONV_I.time StepLtrB1_I.EGSDO2_TarDneER_I.buffer StepLtrB1_I.EGSDO2_TarDneER_I.oldSignal StepLtrB1_I.EGSDO2_TarDneFF_I.status StepLtrB1_I.EGSDO2_flgStepEF_I.buffer StepLtrB1_I.EGSDO2_flgStepEF_I.oldSignal StepLtrB1_I.EGSDO2_tiDeadTiNomAvrgDL_I.memory StepLtrB1_I.EGSDO2_tiTiConNomAvrgDL_I.memory StepRtlB1_I.cntrStepEvln StepRtlB1_I.dratLamRecprLow StepRtlB1_I.dratLamRecprPeak StepRtlB1_I.dratLamRecprPeakNrm StepRtlB1_I.flgStepEvln StepRtlB1_I.flgStepEvlnRes StepRtlB1_I.flgStepEvlnSuc StepRtlB1_I.flgStepGrdt StepRtlB1_I.ratLamRecprFildPeak StepRtlB1_I.ratLamRecprGrdtPeak StepRtlB1_I.ratLamRecprMax StepRtlB1_I.ratLamRecprMin StepRtlB1_I.ratLamRecprStepHeiBgnReal StepRtlB1_I.ratLamRecprStepHeiReal StepRtlB1_I.ratTran StepRtlB1_I.tiDly StepRtlB1_I.tiDlyBasc StepRtlB1_I.tiDlyEquiv StepRtlB1_I.tiGrdtPeak StepRtlB1_I.tiStepTmr StepRtlB1_I.tiTran StepRtlB1_I.EGSDO2_StepEvlnERNM_I.oldSignal StepRtlB1_I.EGSDO2_StepEvlnFF_I.status StepRtlB1_I.EGSDO2_StepEvlnSucER_I.buffer StepRtlB1_I.EGSDO2_StepEvlnSucER_I.oldSignal StepRtlB1_I.EGSDO2_StepEvlnTONV_I.outbit StepRtlB1_I.EGSDO2_StepEvlnTONV_I.time StepRtlB1_I.EGSDO2_TarDneER_I.buffer StepRtlB1_I.EGSDO2_TarDneER_I.oldSignal StepRtlB1_I.EGSDO2_TarDneFF_I.status StepRtlB1_I.EGSDO2_flgStepEF_I.buffer StepRtlB1_I.EGSDO2_flgStepEF_I.oldSignal StepRtlB1_I.EGSDO2_tiDeadTiNomAvrgDL_I.memory StepRtlB1_I.EGSDO2_tiTiConNomAvrgDL_I.memory /end LOC_MEASUREMENT
 FUNCTION_VERSION "1.44.1" /end FUNCTION
/begin FUNCTION EGSDO2_LamDynAdpn "1.2.0     Calculation of the Dynamic Values for Adaptation of the Lambda Signal"
 /begin DEF_CHARACTERISTIC EGSDO2_tiAdpnPrmFil_C EGSDO2_ratTranDlyTiDeadLtr_C EGSDO2_ratTranDlyTiDeadRtl_C EGSDO2_ratTranDlyTiDeadSym_C EGSDO2_tiDlyAdpnThd_C EGSDO2_tiDlyDeltaAdpnThd_C EGSDO2_tiDlyDeltaStepAdpn_C EGSDO2_tiEvlnIdnFirst_C EGSDO2_tiEvlnIdnMax_C EGSDO2_tiEvlnIdn_C EGSDO2_tiTranAdpnThd_C EGSDO2_tiTranDeltaAdpnThd_C EGSDO2_tiTranDeltaStepAdpn_C /end DEF_CHARACTERISTIC
 /begin REF_CHARACTERISTIC EGSDO2_flgSymcDynStepRtl_C EGSDO2_tiSumDeltaAdpnThd_C /end REF_CHARACTERISTIC
 /begin IN_MEASUREMENT EGSDO2_flgEnaIdnLtrB1 EGSDO2_flgEnaIdnRtlB1 EGSDO2_flgIdnFinshdS1B1 EGSDO2_flgIdnFltSuspcDeltaS1B1 EGSDO2_flgIdnFltSuspcLtrS1B1 EGSDO2_flgIdnFltSuspcRtlS1B1 EGSDO2_flgIdnFltSuspcS1B1 EGSDO2_flgRstAdpnDynB1 EGSDO2_flgStepLtrEvlnS1B1 EGSDO2_flgStepRtlEvlnS1B1 EGSDO2_flgSymTranOnly EGSDO2_tiDlyIdnLtrB1 EGSDO2_tiDlyIdnRtlB1 EGSDO2_tiDlyLtrS1B1 EGSDO2_tiDlyRtlS1B1 EGSDO2_tiSumDeltaAdapS1B1 EGSDO2_tiTranIdnLtrB1 EGSDO2_tiTranIdnRtlB1 EGSDO2_tiTranLtrS1B1 EGSDO2_tiTranRtlS1B1 SyC_ctPostDrvLeave /end IN_MEASUREMENT
 /begin OUT_MEASUREMENT EGSDO2_flgDynAdpnLtrS1B1 EGSDO2_flgDynAdpnRtlS1B1 EGSDO2_stStepB1 EGSDO2_tiDlyAdpnS1B1 EGSDO2_tiTranAdpnS1B1 /end OUT_MEASUREMENT
 /begin LOC_MEASUREMENT EGSDO2_ctReini100msLamDynAdpn EGSDO2_flgDSMClrAdpnParlB1 EGSDO2_LamDynAdpnCalcB1_I.flgDynLtr EGSDO2_LamDynAdpnCalcB1_I.flgDynRtl EGSDO2_LamDynAdpnCalcB1_I.flgIdnDne EGSDO2_LamDynAdpnCalcB1_I.flgIdnEvln EGSDO2_LamDynAdpnCalcB1_I.flgIdnFirstDne EGSDO2_LamDynAdpnCalcB1_I.flgIdnMax EGSDO2_LamDynAdpnCalcB1_I.flgStepDlyLtr EGSDO2_LamDynAdpnCalcB1_I.flgStepDlyRtl EGSDO2_LamDynAdpnCalcB1_I.flgStepDlySym EGSDO2_LamDynAdpnCalcB1_I.flgStepEvln EGSDO2_LamDynAdpnCalcB1_I.flgStepLtr EGSDO2_LamDynAdpnCalcB1_I.flgStepLtrDne EGSDO2_LamDynAdpnCalcB1_I.flgStepRtl EGSDO2_LamDynAdpnCalcB1_I.flgStepRtlDne EGSDO2_LamDynAdpnCalcB1_I.flgStepSym EGSDO2_LamDynAdpnCalcB1_I.stStep EGSDO2_LamDynAdpnCalcB1_I.tiDly EGSDO2_LamDynAdpnCalcB1_I.tiDlyNotFild EGSDO2_LamDynAdpnCalcB1_I.tiSumTran EGSDO2_LamDynAdpnCalcB1_I.tiTran EGSDO2_LamDynAdpnCalcB1_I.tiTranNotFild EGSDO2_LamDynAdpnCalcB1_I.AdpnFilDlyLT_I.memory EGSDO2_LamDynAdpnCalcB1_I.AdpnFilTranLT_I.memory EGSDO2_LamDynAdpnCalcB1_I.tiEnaIdnLtrSWE_I.timeCounter EGSDO2_LamDynAdpnCalcB1_I.tiEnaIdnRtlSWE_I.timeCounter EGSDO2_LamDynAdpnInhbS1B1ER_I.buffer EGSDO2_LamDynAdpnInhbS1B1ER_I.oldSignal EGSDO2_stStepNVB1 /end LOC_MEASUREMENT
 FUNCTION_VERSION "1.2.0" /end FUNCTION
/begin COMPU_METHOD B_TRUE "" TAB_VERB "%6.3" "" COMPU_TAB_REF B_TRUE /end COMPU_METHOD
/begin COMPU_VTAB B_TRUE "" TAB_VERB 2 0 "FALSE" 1 "TRUE" /end COMPU_VTAB
/begin COMPU_METHOD dez "" RAT_FUNC "%6.2" "" COEFFS 0 1 0 0 0 1 /end COMPU_METHOD
/begin COMPU_METHOD EGSDO2_Evln_Enum_VERB "" TAB_VERB "%6.3" "" COMPU_TAB_REF EGSDO2_Evln_Enum_VERB /end COMPU_METHOD
/begin COMPU_VTAB EGSDO2_Evln_Enum_VERB "" TAB_VERB 3 0 "CODCLR_MODE" 1 "STPCHNG_MODE" 2 "NORM_MODE" /end COMPU_VTAB
/begin COMPU_METHOD EGSDO2_LamDyn_Enum_tab_verb "" TAB_VERB "%6.3" "" COMPU_TAB_REF EGSDO2_LamDyn_Enum_tab_verb /end COMPU_METHOD
/begin COMPU_VTAB EGSDO2_LamDyn_Enum_tab_verb "" TAB_VERB 3 0 "CODCLR_MODE" 1 "STPCHNG_MODE" 2 "NORM_MODE" /end COMPU_VTAB
/begin COMPU_METHOD EngN "" RAT_FUNC "%6.3" "rpm" COEFFS 0 2 0 0 0 1 /end COMPU_METHOD
/begin COMPU_METHOD fak_q0p01 "" RAT_FUNC "%6.4" "" COEFFS 0 100 0 0 0 1 /end COMPU_METHOD
/begin COMPU_METHOD fak_q3p0518Em5 "" RAT_FUNC "%7.6" "" COEFFS 0 32768 0 0 0 1 /end COMPU_METHOD
/begin COMPU_METHOD fak_q4p6566Em10 "" RAT_FUNC "%18.17" "" COEFFS 0 2147483648 0 0 0 1 /end COMPU_METHOD
/begin COMPU_METHOD fak_uw_b1 "" RAT_FUNC "%7.6" "-" COEFFS 0 65536 0 0 0 1 /end COMPU_METHOD
/begin COMPU_METHOD fak_uw_b128 "" RAT_FUNC "%6.4" "-" COEFFS 0 65536 0 0 0 128 /end COMPU_METHOD
/begin COMPU_METHOD fak_uw_b16 "" RAT_FUNC "%6.5" "-" COEFFS 0 65536 0 0 0 16 /end COMPU_METHOD
/begin COMPU_METHOD fak_uw_b2 "" RAT_FUNC "%7.6" "-" COEFFS 0 65536 0 0 0 2 /end COMPU_METHOD
/begin COMPU_METHOD fak_uw_b32 "" RAT_FUNC "%6.5" "-" COEFFS 0 65536 0 0 0 32 /end COMPU_METHOD
/begin COMPU_METHOD fak_uw_b4 "" RAT_FUNC "%7.6" "-" COEFFS 0 65536 0 0 0 4 /end COMPU_METHOD
/begin COMPU_METHOD fak_uw_b8 "" RAT_FUNC "%6.5" "-" COEFFS 0 65536 0 0 0 8 /end COMPU_METHOD
/begin COMPU_METHOD FLDEV_VAR_SY_Compu "" TAB_VERB "%6.3" "" COMPU_TAB_REF FLDEV_VAR_SY_Compu /end COMPU_METHOD
/begin COMPU_VTAB FLDEV_VAR_SY_Compu "" TAB_VERB 43 1 "DAI" 3 "VWW" 4 "POR" 5 "AUD" 6 "OPE" 9 "FIA" 11 "BMW" 14 "PSA" 15 "REN" 17 "ALF" 18 "SAB" 19 "VOL" 20 "NIS" 21 "GMU" 22 "FOR" 26 "IMJ" 51 "SEA" 53 "CHR" 54 "JAG" 55 "ROL" 57 "FORD" 69 "FER" 72 "TOY" 123 "MIT" 147 "HYU" 159 "HON" 160 "MAZ" 183 "CU" 190 "LRG" 204 "VVW" 214 "AVT" 242 "Iveco" 243 "DMC" 248 "SUZ" 267 "SSANGYONG" 270 "KEF" 289 "AMG" 308 "TAT" 319 "MVM" 385 "UAES" 828 "RBCD" 999 "ALL" 9454 "Fuso" /end COMPU_VTAB
/begin COMPU_METHOD FLEXPSCTRLRNR_SC_Compu "" TAB_VERB "%6.3" "" COMPU_TAB_REF FLEXPSCTRLRNR_SC_Compu /end COMPU_METHOD
/begin COMPU_VTAB FLEXPSCTRLRNR_SC_Compu "" TAB_VERB 2 0 "0" 1 "1" /end COMPU_VTAB
/begin COMPU_METHOD FLFLTDSP_TYPAVL_SC_Compu "" TAB_VERB "%6.3" "" COMPU_TAB_REF FLFLTDSP_TYPAVL_SC_Compu /end COMPU_METHOD
/begin COMPU_VTAB FLFLTDSP_TYPAVL_SC_Compu "" TAB_VERB 2 0 "False" 1 "True" /end COMPU_VTAB
/begin COMPU_METHOD FLMA_BASCONLY_SC_Compu "" TAB_VERB "%6.3" "" COMPU_TAB_REF FLMA_BASCONLY_SC_Compu /end COMPU_METHOD
/begin COMPU_VTAB FLMA_BASCONLY_SC_Compu "" TAB_VERB 2 0 "False" 1 "True" /end COMPU_VTAB
/begin COMPU_METHOD FLMA_LEASTSQ_SC_Compu "" TAB_VERB "%6.3" "" COMPU_TAB_REF FLMA_LEASTSQ_SC_Compu /end COMPU_METHOD
/begin COMPU_VTAB FLMA_LEASTSQ_SC_Compu "" TAB_VERB 2 0 "NO_SQFIT" 1 "SQFIT_ADPN" /end COMPU_VTAB
/begin COMPU_METHOD FLMA_OPERMODDPDTSUMERR_SC_Compu "" TAB_VERB "%6.3" "" COMPU_TAB_REF FLMA_OPERMODDPDTSUMERR_SC_Compu /end COMPU_METHOD
/begin COMPU_VTAB FLMA_OPERMODDPDTSUMERR_SC_Compu "" TAB_VERB 2 0 "False" 1 "True" /end COMPU_VTAB
/begin COMPU_METHOD FLMA_TTCLDIAG_SC_Compu "" TAB_VERB "%6.3" "" COMPU_TAB_REF FLMA_TTCLDIAG_SC_Compu /end COMPU_METHOD
/begin COMPU_VTAB FLMA_TTCLDIAG_SC_Compu "" TAB_VERB 2 0 "No_TTCL_Diag" 1 "TTCL_Diag" /end COMPU_VTAB
/begin COMPU_METHOD FLMA_VAR_SY_Compu "" TAB_VERB "%6.3" "" COMPU_TAB_REF FLMA_VAR_SY_Compu /end COMPU_METHOD
/begin COMPU_VTAB FLMA_VAR_SY_Compu "" TAB_VERB 44 1 "DAI" 3 "VWW" 4 "POR" 5 "AUD" 6 "OPE" 9 "FIA" 11 "BMW" 14 "PSA" 15 "REN" 17 "ALF" 18 "SAB" 19 "VOL" 20 "NIS" 21 "GMU" 22 "FOR" 26 "IMJ" 38 "UAES" 51 "SEA" 53 "CHR" 54 "JAG" 55 "ROL" 69 "FER" 72 "TOY" 123 "MIT" 147 "HYU" 159 "HON" 160 "MAZ" 183 "CU" 190 "LRG" 204 "VVW" 214 "AVT" 242 "Iveco" 243 "DMC" 248 "SUZ" 267 "SSANGYONG" 270 "KEF" 289 "AMG" 308 "TAT" 319 "MVM" 590 "Scania" 828 "RBCD" 999 "ALL" 2887 "Nonox" 9454 "Fuso" /end COMPU_VTAB
/begin COMPU_METHOD FLOATIFRESLSELN_SC_Compu "" TAB_VERB "%6.3" "" COMPU_TAB_REF FLOATIFRESLSELN_SC_Compu /end COMPU_METHOD
/begin COMPU_VTAB FLOATIFRESLSELN_SC_Compu "" TAB_VERB 2 0 "Integer_calculation" 1 "Floating_point_calculation" /end COMPU_VTAB
/begin COMPU_METHOD FLSPLG_FUPHIHIRESL_SC_Compu "" TAB_VERB "%6.3" "" COMPU_TAB_REF FLSPLG_FUPHIHIRESL_SC_Compu /end COMPU_METHOD
/begin COMPU_VTAB FLSPLG_FUPHIHIRESL_SC_Compu "" TAB_VERB 5 0 "NO_HIRES" 1 "FAST_SCAN" 2 "HIRES" 3 "FAST_SCAN_HIRES" 4 "FAST_SCAN_NO_HIRES" /end COMPU_VTAB
/begin COMPU_METHOD FLSPLG_FUTMDLSELNCUST_SC_Compu "" TAB_VERB "%6.3" "" COMPU_TAB_REF FLSPLG_FUTMDLSELNCUST_SC_Compu /end COMPU_METHOD
/begin COMPU_VTAB FLSPLG_FUTMDLSELNCUST_SC_Compu "" TAB_VERB 2 0 "False" 1 "True" /end COMPU_VTAB
/begin COMPU_METHOD FLSPLG_INTKAIRTSNSRSELN_SC_Compu "" TAB_VERB "%6.3" "" COMPU_TAB_REF FLSPLG_INTKAIRTSNSRSELN_SC_Compu /end COMPU_METHOD
/begin COMPU_VTAB FLSPLG_INTKAIRTSNSRSELN_SC_Compu "" TAB_VERB 6 0 "inactive" 1 "Use_IntkAirT_tIntkMnfld" 2 "Use_IntkAirT_tMnfldIcoDs" 3 "Use_IntkAirT_tThrVlvUs" 4 "Use_IntkAirT_tCmprDs" 5 "Use_IntkAirT_tAirFltDs" /end COMPU_VTAB
/begin COMPU_METHOD FLSPLG_LIMPHP_SC_Compu "" TAB_VERB "%6.3" "" COMPU_TAB_REF FLSPLG_LIMPHP_SC_Compu /end COMPU_METHOD
/begin COMPU_VTAB FLSPLG_LIMPHP_SC_Compu "" TAB_VERB 2 0 "LimpHPInactive" 1 "LimpHPActive" /end COMPU_VTAB
/begin COMPU_METHOD FLSPLG_PRAILINJ_SC_Compu "" TAB_VERB "%6.3" "" COMPU_TAB_REF FLSPLG_PRAILINJ_SC_Compu /end COMPU_METHOD
/begin COMPU_VTAB FLSPLG_PRAILINJ_SC_Compu "" TAB_VERB 3 0 "NO_INJ_P" 1 "INJ_SYNCD" 2 "INJ_SYN_PRED" /end COMPU_VTAB
/begin COMPU_METHOD FLSPLG_SENTENA_SC_Compu "" TAB_VERB "%6.3" "" COMPU_TAB_REF FLSPLG_SENTENA_SC_Compu /end COMPU_METHOD
/begin COMPU_VTAB FLSPLG_SENTENA_SC_Compu "" TAB_VERB 2 0 "False" 1 "True" /end COMPU_VTAB
/begin COMPU_METHOD FLSPLG_SENTSNSRTYP_SC_Compu "" TAB_VERB "%6.3" "" COMPU_TAB_REF FLSPLG_SENTSNSRTYP_SC_Compu /end COMPU_METHOD
/begin COMPU_VTAB FLSPLG_SENTSNSRTYP_SC_Compu "" TAB_VERB 4 1 "BOSCH_HPS5" 2 "SENSATA" 3 "HPS5_DUAL_P/T" 4 "HPS5_DUAL_P/P" /end COMPU_VTAB
/begin COMPU_METHOD FLSPLG_VAR_SY_Compu "" TAB_VERB "%6.3" "" COMPU_TAB_REF FLSPLG_VAR_SY_Compu /end COMPU_METHOD
/begin COMPU_VTAB FLSPLG_VAR_SY_Compu "" TAB_VERB 42 1 "DAI" 3 "VWW" 4 "POR" 5 "AUD" 6 "OPE" 9 "FIA" 11 "BMW" 14 "PSA" 15 "REN" 17 "ALF" 18 "SAB" 19 "VOL" 20 "NIS" 21 "GMU" 22 "FOR" 26 "IMJ" 51 "SEA" 53 "CHR" 54 "JAG" 55 "ROL" 69 "FER" 72 "TOY" 123 "MIT" 147 "HYU" 159 "HON" 160 "MAZ" 183 "CU" 190 "LRG" 204 "VVW" 214 "AVT" 242 "Iveco" 243 "DMC" 248 "SUZ" 267 "SSANGYONG" 270 "KEF" 289 "AMG" 308 "TAT" 319 "MVM" 385 "UAES" 828 "RBCD" 999 "ALL" 9454 "Fuso" /end COMPU_VTAB
/begin COMPU_METHOD FLSPLSYSTST_SC_Compu "" TAB_VERB "%6.3" "" COMPU_TAB_REF FLSPLSYSTST_SC_Compu /end COMPU_METHOD
/begin COMPU_VTAB FLSPLSYSTST_SC_Compu "" TAB_VERB 3 0 "0" 1 "1" 2 "2" /end COMPU_VTAB
/begin COMPU_METHOD freq_q1p22Em4 "" RAT_FUNC "%6.5" "1/s" COEFFS 0 8192 0 0 0 1 /end COMPU_METHOD
/begin COMPU_METHOD freq_q9p1553Em5 "" RAT_FUNC "%7.6" "1/s" COEFFS 0 65536 0 0 0 6 /end COMPU_METHOD
/begin COMPU_METHOD mgrad_q1_mgdivs "" RAT_FUNC "%6.2" "mg/s" COEFFS 0 1 0 0 0 1 /end COMPU_METHOD
/begin COMPU_METHOD m_q0p1 "" RAT_FUNC "%6.3" "kg/h" COEFFS 0 10 0 0 0 1 /end COMPU_METHOD
/begin COMPU_METHOD m_q0p1_mgs "" RAT_FUNC "%6.3" "mg/s" COEFFS 0 1 0 0 0 0.1 /end COMPU_METHOD
/begin COMPU_METHOD m_q1p526Em6_g "" RAT_FUNC "%8.7" "g" COEFFS 0 655360 0 0 0 1 /end COMPU_METHOD
/begin COMPU_METHOD m_sw_b3276p8 "" RAT_FUNC "%6.3" "kg/h" COEFFS 0 1 0 0 0 0.1 /end COMPU_METHOD
/begin COMPU_METHOD m_ub_q0p0444 "" RAT_FUNC "%6.4" "g" COEFFS 0 1 0 0 0 0.0444 /end COMPU_METHOD
/begin COMPU_METHOD m_uw_b25p6 "" RAT_FUNC "%6.5" "kg/h" COEFFS 0 65536 0 0 0 25.6 /end COMPU_METHOD
/begin COMPU_METHOD m_uw_b6553p5 "" RAT_FUNC "%6.3" "kg/h" COEFFS 0 1 0 0 0 0.1 /end COMPU_METHOD
/begin COMPU_METHOD OneToOne "" RAT_FUNC "%6.2" "-" COEFFS 0 1 0 0 0 1 /end COMPU_METHOD
/begin COMPU_METHOD q1p5259Em7_s "" RAT_FUNC "%9.8" "s" COEFFS 0 65536 0 0 0 0.01 /end COMPU_METHOD
/begin COMPU_METHOD RBPtCel_du_7p62939em4_1 "" RAT_FUNC "%6.5" "V/s" COEFFS 0 65536 0 0 0 50 /end COMPU_METHOD
/begin COMPU_METHOD rel_q3p5763Em7 "" RAT_FUNC "%9.8" "%" COEFFS 0 2097152 0 0 0 0.75 /end COMPU_METHOD
/begin COMPU_METHOD rel_uw_q0p0234 "" RAT_FUNC "%6.4" "%" COEFFS 0 32 0 0 0 0.75 /end COMPU_METHOD
/begin COMPU_METHOD spg_q1p221Em3_V "" RAT_FUNC "%6.4" "V" COEFFS 0 65536 0 0 0 80 /end COMPU_METHOD
/begin COMPU_METHOD spg_q1p8626Em8_V "" RAT_FUNC "%10.9" "V" COEFFS 0 268435456 0 0 0 5 /end COMPU_METHOD
/begin COMPU_METHOD Temp_Cels "" RAT_FUNC "%6.1" "deg C" COEFFS 0 10 2731.4 0 0 1 /end COMPU_METHOD
/begin COMPU_METHOD temp_q0p0234_o273 "" RAT_FUNC "%6.1" "Grad C" COEFFS 0 1 273.15 0 0 0.0234375 /end COMPU_METHOD
/begin COMPU_METHOD t_q0p01 "" RAT_FUNC "%6.4" "s" COEFFS 0 100 0 0 0 1 /end COMPU_METHOD
/begin COMPU_METHOD t_q0p0625 "" RAT_FUNC "%6.4" "s" COEFFS 0 16 0 0 0 1 /end COMPU_METHOD
/begin COMPU_METHOD t_q0p1 "" RAT_FUNC "%6.3" "s" COEFFS 0 10 0 0 0 1 /end COMPU_METHOD
/begin COMPU_METHOD zk10msxs_uw_b655 "" RAT_FUNC "%6.2" "s" COEFFS 0 0 65536 0 100 0 /end COMPU_METHOD
/begin COMPU_METHOD zk10msxs_uw_b655p36 "" RAT_FUNC "%6.2" "s" COEFFS 0 0 65536 0 100 0 /end COMPU_METHOD
/begin RECORD_LAYOUT RB_Curve_S16_U16_Static NO_AXIS_PTS_X 1 SWORD AXIS_PTS_X 2 SWORD INDEX_INCR DIRECT FNC_VALUES 3 UWORD COLUMN_DIR DIRECT STATIC_RECORD_LAYOUT /end RECORD_LAYOUT
/begin RECORD_LAYOUT RB_Curve_U16_U16 NO_AXIS_PTS_X 1 UWORD AXIS_PTS_X 2 UWORD INDEX_INCR DIRECT FNC_VALUES 3 UWORD COLUMN_DIR DIRECT /end RECORD_LAYOUT
/begin RECORD_LAYOUT RB_Val_Ws16 FNC_VALUES 1 SWORD COLUMN_DIR DIRECT /end RECORD_LAYOUT
/begin RECORD_LAYOUT RB_Val_Wu16 FNC_VALUES 1 UWORD COLUMN_DIR DIRECT /end RECORD_LAYOUT
/begin RECORD_LAYOUT RB_Val_Wu32 FNC_VALUES 1 ULONG COLUMN_DIR DIRECT /end RECORD_LAYOUT
/begin RECORD_LAYOUT RB_Val_Wu8 FNC_VALUES 1 UBYTE COLUMN_DIR DIRECT /end RECORD_LAYOUT
/end MODULE
/end PROJECT
