ASAP2_VERSION 1 60
/begin PROJECT MG1CS022 "MG1CS022"
/begin HEADER "" VERSION "MG1CS022_62XSC_V037" PROJECT_NO MG1CS022 /end HEADER
/begin MODULE DIM ""
/begin MOD_COMMON "" BYTE_ORDER MSB_LAST ALIGNMENT_BYTE 1 ALIGNMENT_WORD 2 ALIGNMENT_LONG 4 ALIGNMENT_INT64 4 ALIGNMENT_FLOAT32_IEEE 4 ALIGNMENT_FLOAT64_IEEE 4 DATA_SIZE 32 /end MOD_COMMON
/*********** End of merged CHARACTERISTIC blocks ***********/
/begin CHARACTERISTIC ABMM4 "Injection Cutoff Pattern for Torque Reduction (4 Cylinde Engine)" VAL_BLK 0x80506D1C RB_ValA_Wu8 255.0 dez 0.00 255.0 FORMAT "%5.1" NUMBER 4 /end CHARACTERISTIC
/begin CHARACTERISTIC ACCtl_facACCtrlCurrCorrVal_C "AC compressor control current correction value" VALUE 0x80506AFC RB_Val_Ws32 429496.729500 Fact_10000 -214748.364800 214748.364700 FORMAT "%13.6" /end CHARACTERISTIC
/begin CHARACTERISTIC ACCtl_facACtrDwnCtrlVal_C "AC torque down control value correction factor" VALUE 0x80506B00 RB_Val_Ws32 4294967.29500 Fact1000 -2147483.64800 2147483.64700 FORMAT "%13.5" /end CHARACTERISTIC
/begin CHARACTERISTIC ACCtl_flgACTqDwnReqDisad_C "AC Torque down request logic disable" VALUE 0x80506B04 RB_Val_Wboolean 1.00000000000 B_TRUE 0.00 1.00000000000 FORMAT "%13.11" /end CHARACTERISTIC
/begin CHARACTERISTIC ACCtl_flgEngSpdCdnSel_C "Enabling engine speed condition for AC cut condition" VALUE 0x80506B05 RB_Val_Wboolean 1.00000000000 B_TRUE 0.00 1.00000000000 FORMAT "%13.11" /end CHARACTERISTIC
/begin CHARACTERISTIC ACCtl_flgSwtAcAndCutCdn_C "AC switch status and AC shut off condition for AC control mask" VALUE 0x80506B06 RB_Val_Wu16 65535.00 OneToOne 0.00 65535.00 FORMAT "%8.2" /end CHARACTERISTIC
/begin CHARACTERISTIC ACCtl_flgSwtAcTq_C "Calibration for switch AC torque" VALUE 0x80506B08 RB_Val_Wboolean 1.00000000000 B_TRUE 0.00 1.00000000000 FORMAT "%13.11" /end CHARACTERISTIC
/begin CHARACTERISTIC ACCtl_iACCtrlCurrUpprVal_C "AC Compressor control current upper value" VALUE 0x80506B0A RB_Val_Ws16 6553.500 RBPtCel_Curr_mA_q0p01 -3276.800 3276.700 FORMAT "%8.3" /end CHARACTERISTIC
/begin CHARACTERISTIC ACCtl_nCmprMax_C "Max speed of AC compressor" VALUE 0x80506B0C RB_Val_Ws16 32767.50 EngN -16384.00 16383.50 FORMAT "%8.2" /end CHARACTERISTIC
/begin CHARACTERISTIC ACCtl_nEngACCutThd_C "High Engine speed AC cut threshold" VALUE 0x80506B0E RB_Val_Ws16 32767.50 EngN -16384.00 16383.50 FORMAT "%8.2" /end CHARACTERISTIC
/begin CHARACTERISTIC ACCtl_nEngHiCoolgPrf_C "Engine speed threshold high for high engine temperature AC shut off" VALUE 0x80506B10 RB_Val_Ws16 32767.50 EngN -16384.00 16383.50 FORMAT "%8.2" /end CHARACTERISTIC
/begin CHARACTERISTIC ACCtl_nEngHiShtOff_T "Low engine speed AC shut off deactivation threshold" CURVE 0x80506B12 RB_Curve_S16_S16 32767.50 EngN -16384.00 16383.50 FORMAT "%8.2"
 /begin AXIS_DESCR STD_AXIS HLSDem_nSetPLo nmot_sw_q0p5 5 -16384.00 16383.50 FORMAT "%8.2" DEPOSIT ABSOLUTE /end AXIS_DESCR
/end CHARACTERISTIC
/begin CHARACTERISTIC ACCtl_nEngHiTow_C "Engine speed threshold high for towing AC shut off" VALUE 0x80506B28 RB_Val_Ws16 32767.50 EngN -16384.00 16383.50 FORMAT "%8.2" /end CHARACTERISTIC
/begin CHARACTERISTIC ACCtl_nEngLoCoolgPrf_C "Engine speed threshold low for high engine temperature AC shut off" VALUE 0x80506B2A RB_Val_Ws16 32767.50 EngN -16384.00 16383.50 FORMAT "%8.2" /end CHARACTERISTIC
/begin CHARACTERISTIC ACCtl_nEngLoShtOff_T "Low engine speed AC shut off activation threshold" CURVE 0x80506B2C RB_Curve_S16_S16 32767.50 EngN -16384.00 16383.50 FORMAT "%8.2"
 /begin AXIS_DESCR STD_AXIS HLSDem_nSetPLo nmot_sw_q0p5 5 -16384.00 16383.50 FORMAT "%8.2" DEPOSIT ABSOLUTE /end AXIS_DESCR
/end CHARACTERISTIC
/begin CHARACTERISTIC ACCtl_nEngLoTow_C "Engine speed threshold low for towing AC shut off" VALUE 0x80506B42 RB_Val_Ws16 32767.50 EngN -16384.00 16383.50 FORMAT "%8.2" /end CHARACTERISTIC
/begin CHARACTERISTIC ACCtl_nMin_C "Idle speed request" VALUE 0x80506B44 RB_Val_Ws16 32767.50 EngN -16384.00 16383.50 FORMAT "%8.2" /end CHARACTERISTIC
/begin CHARACTERISTIC ACCtl_nrACCutPrmsECONOff_T "Curve for converting the status of AC cut to AC cut permission count at the time of ECON OFF" CURVE 0x80506B46 RB_Curve_S16_S16 65535.00 OneToOne -32768.00 32767.00 FORMAT "%8.2"
 /begin AXIS_DESCR STD_AXIS ACCtl_stACCut OneToOne 9 -32768.00 32767.00 FORMAT "%8.2" DEPOSIT ABSOLUTE /end AXIS_DESCR
/end CHARACTERISTIC
/begin CHARACTERISTIC ACCtl_nrACCutPrmsECONOn_T "Curve for converting the status of AC cut to AC cut permission count at the time of ECON ON" CURVE 0x80506B6C RB_Curve_S16_S16 65535.00 OneToOne -32768.00 32767.00 FORMAT "%8.2"
 /begin AXIS_DESCR STD_AXIS ACCtl_stACCut OneToOne 9 -32768.00 32767.00 FORMAT "%8.2" DEPOSIT ABSOLUTE /end AXIS_DESCR
/end CHARACTERISTIC
/begin CHARACTERISTIC ACCtl_pACMaxHi_C "upper threshold for maximum AC coolant pressure to disengage immediately" VALUE 0x80506B92 RB_Val_Ws16 131070.0 PresAC_hPa -65536.00 65534.00 FORMAT "%8.2" /end CHARACTERISTIC
/begin CHARACTERISTIC ACCtl_pACMaxLo_C "lower threshold for maximum AC coolant pressure to disengage immediately" VALUE 0x80506B94 RB_Val_Ws16 131070.0 PresAC_hPa -65536.00 65534.00 FORMAT "%8.2" /end CHARACTERISTIC
/begin CHARACTERISTIC ACCtl_pACMinHi_C "upper threshold for minimum AC coolant pressure to disengage immediately" VALUE 0x80506B96 RB_Val_Ws16 131070.0 PresAC_hPa -65536.00 65534.00 FORMAT "%8.2" /end CHARACTERISTIC
/begin CHARACTERISTIC ACCtl_pACMinLo_C "lower threshold for minimum AC coolant pressure to disengage immediately the AC compressor" VALUE 0x80506B98 RB_Val_Ws16 131070.0 PresAC_hPa -65536.00 65534.00 FORMAT "%8.2" /end CHARACTERISTIC
/begin CHARACTERISTIC ACCtl_pACPDwnCorrVal_C "AC torque down pressure correction value" VALUE 0x80506B9C RB_Val_Ws32 4294967295.00 RBPtCel_p_1p0_1 -2147483648.00 2147483647.00 FORMAT "%13.2" /end CHARACTERISTIC
/begin CHARACTERISTIC ACCtl_pACTqDwnPCorrVal_C "AC pressure down correction value" VALUE 0x80506BA0 RB_Val_Ws32 4294967295.00 RBPtCel_p_1p0_1 -2147483648.00 2147483647.00 FORMAT "%13.2" /end CHARACTERISTIC
/begin CHARACTERISTIC ACCtl_pClntTmr_CUR "AC shut off time threshold calculated by AC pressure" CURVE 0x80506BA4 RB_Curve_S16_S16 655.3500 t_q0p01 -327.6800 327.6700 FORMAT "%8.4"
 /begin AXIS_DESCR STD_AXIS AirC_pClnt PresAC_hPa 3 -65536.00 65534.00 FORMAT "%8.2" DEPOSIT ABSOLUTE /end AXIS_DESCR
/end CHARACTERISTIC
/begin CHARACTERISTIC ACCtl_rACCpAccrPedlOpngDetrm_C "Ratio to determain AC capacity druing the Accelerator pedel opening" VALUE 0x80506BB2 RB_Val_Ws16 799.9878 Prc -400.0000 399.9878 FORMAT "%8.4" /end CHARACTERISTIC
/begin CHARACTERISTIC ACCtl_rACCpDwnAccrPedlThd_C "Ratio Accelerator pedel down threshold for AC capactiy" VALUE 0x80506BB4 RB_Val_Ws16 799.9878 Prc -400.0000 399.9878 FORMAT "%8.4" /end CHARACTERISTIC
/begin CHARACTERISTIC ACCtl_rAccPedClmbHi_C "Acceleration pedal position threshold high for hill climbing AC shut off condition" VALUE 0x80506BB6 RB_Val_Ws16 799.9878 Prc -400.0000 399.9878 FORMAT "%8.4" /end CHARACTERISTIC
/begin CHARACTERISTIC ACCtl_rAccPedClmbLo_C "Acceleration pedal position threshold low for hill climbing AC shut off condition" VALUE 0x80506BB8 RB_Val_Ws16 799.9878 Prc -400.0000 399.9878 FORMAT "%8.4" /end CHARACTERISTIC
/begin CHARACTERISTIC ACCtl_rAccPedHi_CUR "Acceleration pedal threshold high for Vehicle start AC shut off" CURVE 0x80506BBA RB_Curve_S16_S16 799.9878 Prc -400.0000 399.9878 FORMAT "%8.4"
 /begin AXIS_DESCR STD_AXIS ACCtl_drAccPedStrtCut Prc 3 -400.0000 399.9878 FORMAT "%8.4" DEPOSIT ABSOLUTE /end AXIS_DESCR
/end CHARACTERISTIC
/begin CHARACTERISTIC ACCtl_rAccPedLo_C "lower threshold pedal position" VALUE 0x80506BC8 RB_Val_Ws16 799.9878 Prc -400.0000 399.9878 FORMAT "%8.4" /end CHARACTERISTIC
/begin CHARACTERISTIC ACCtl_rAccPedMid_CUR "Acceleration pedal threshold middle for Vehicle start AC shut off" CURVE 0x80506BCA RB_Curve_S16_S16 799.9878 Prc -400.0000 399.9878 FORMAT "%8.4"
 /begin AXIS_DESCR STD_AXIS ACCtl_drAccPedStrtCut Prc 3 -400.0000 399.9878 FORMAT "%8.4" DEPOSIT ABSOLUTE /end AXIS_DESCR
/end CHARACTERISTIC
/begin CHARACTERISTIC ACCtl_rACCpTmrRstAccrPedlThd_C "Ratio of Accelerator pedel threshold to reset the timer" VALUE 0x80506BD8 RB_Val_Ws16 799.9878 Prc -400.0000 399.9878 FORMAT "%8.4" /end CHARACTERISTIC
/begin CHARACTERISTIC ACCtl_rCmprPlly_C "Ratio of Crank pulley diameter to compressor pulley diameter" VALUE 0x80506BDA RB_Val_Wu8 2.540 Fact100 0.010 2.550 FORMAT "%5.3" EXTENDED_LIMITS 0.00 2.550 /end CHARACTERISTIC
/begin CHARACTERISTIC ACCtl_stAcShOffCdn_C "AC cut off condition mask" VALUE 0x80506BDC RB_Val_Wu16 65535.00 OneToOne 0.00 65535.00 FORMAT "%8.2" /end CHARACTERISTIC
/begin CHARACTERISTIC ACCtl_stDecelACCtrlSwt_C "Deceleration AC control changeover switch" VALUE 0x80506BDE RB_Val_Wboolean 1.00000000000 B_TRUE 0.00 1.00000000000 FORMAT "%13.11" /end CHARACTERISTIC
/begin CHARACTERISTIC ACCtl_stSwtAcCdn_C "AC switch state for AC control mask" VALUE 0x80506BE0 RB_Val_Wu16 65535.00 OneToOne 0.00 65535.00 FORMAT "%8.2" /end CHARACTERISTIC
/begin CHARACTERISTIC ACCtl_stSwtTrqResvSec_C "Acctl state switch trouqereseverdsection" VALUE 0x80506BE2 RB_Val_Wboolean 1.00000000000 B_TRUE 0.00 1.00000000000 FORMAT "%13.11" /end CHARACTERISTIC
/begin CHARACTERISTIC ACCtl_swtAcECU_C "Codeword: Compressor without ECU / Compressor with ECU" VALUE 0x80506BE3 RB_Val_Wboolean 1.00000000000 B_TRUE 0.00 1.00000000000 FORMAT "%13.11" /end CHARACTERISTIC
/begin CHARACTERISTIC ACCtl_swtHeatrCorePrsnt_C "HTRCORE software switch." VALUE 0x80506BE4 RB_Val_Wboolean 1.00000000000 B_TRUE 0.00 1.00000000000 FORMAT "%13.11" /end CHARACTERISTIC
/begin CHARACTERISTIC ACCtl_swtResv_C "Switch: Activation of AC torque reserve" VALUE 0x80506BE5 RB_Val_Wboolean 1.00000000000 B_TRUE 0.00 1.00000000000 FORMAT "%13.11" /end CHARACTERISTIC
/begin CHARACTERISTIC ACCtl_tEngHiCoolgPrf_C "Engine temperature threshold high for high engine temperature AC shut off" VALUE 0x80506BE6 RB_Val_Ws16 6553.500 Temp_Cels -3549.940 3003.560 FORMAT "%8.3" /end CHARACTERISTIC
/begin CHARACTERISTIC ACCtl_tEngHiTow_C "Engine temperature threshold high for towing AC shut off" VALUE 0x80506BE8 RB_Val_Ws16 6553.500 Temp_Cels -3549.940 3003.560 FORMAT "%8.3" /end CHARACTERISTIC
/begin CHARACTERISTIC ACCtl_tEngLoCoolgPrf_C "Engine temperature threshold high for low engine temperature AC shut off" VALUE 0x80506BEA RB_Val_Ws16 6553.500 Temp_Cels -3549.940 3003.560 FORMAT "%8.3" /end CHARACTERISTIC
/begin CHARACTERISTIC ACCtl_tEngLoTow_C "Engine temperature threshold low for towing AC shut off" VALUE 0x80506BEC RB_Val_Ws16 6553.500 Temp_Cels -3549.940 3003.560 FORMAT "%8.3" /end CHARACTERISTIC
/begin CHARACTERISTIC ACCtl_tEvapACCutHi_T "curve for converting the AC dial input to high side AC temperature." CURVE 0x80506BEE RB_Curve_S16_S16 6553.500 Temp_Cels -3549.940 3003.560 FORMAT "%8.3"
 /begin AXIS_DESCR STD_AXIS wtacvol_w spg_uw_q0p00488 13 -160.0000 159.9951 FORMAT "%8.4" DEPOSIT ABSOLUTE /end AXIS_DESCR
/end CHARACTERISTIC
/begin CHARACTERISTIC ACCtl_tEvapACCutLo_T "curve for converting the AC dial input to low side AC temperature." CURVE 0x80506C24 RB_Curve_S16_S16 6553.500 Temp_Cels -3549.940 3003.560 FORMAT "%8.3"
 /begin AXIS_DESCR STD_AXIS wtacvol_w spg_uw_q0p00488 13 -160.0000 159.9951 FORMAT "%8.4" DEPOSIT ABSOLUTE /end AXIS_DESCR
/end CHARACTERISTIC
/begin CHARACTERISTIC ACCtl_tEvapMinHi_C "Evaporator temperature threshold high for AC shut off" VALUE 0x80506C5A RB_Val_Ws16 6553.500 Temp_Cels -3549.940 3003.560 FORMAT "%8.3" /end CHARACTERISTIC
/begin CHARACTERISTIC ACCtl_tEvapMinLo_C "Evaporator temperature threshold low for AC shut off" VALUE 0x80506C5C RB_Val_Ws16 6553.500 Temp_Cels -3549.940 3003.560 FORMAT "%8.3" /end CHARACTERISTIC
/begin CHARACTERISTIC ACCtl_tEvaSnsrErr_C "Evaporator sensor short temperature" VALUE 0x80506C5E RB_Val_Ws16 6553.500 Temp_Cels -3549.940 3003.560 FORMAT "%8.3" /end CHARACTERISTIC
/begin CHARACTERISTIC ACCtl_tiACCmprTqReqTi_T "AC compressor Torque Request time" CURVE 0x80506C60 RB_Curve_S16_S16 655.3500 Time_s -327.6800 327.6700 FORMAT "%8.4"
 /begin AXIS_DESCR STD_AXIS Com_stACCut OneToOne 8 0.00 255.0000 FORMAT "%8.4" EXTENDED_LIMITS -32768.00 32767.00 DEPOSIT ABSOLUTE /end AXIS_DESCR
/end CHARACTERISTIC
/begin CHARACTERISTIC ACCtl_tiACCpDwnImplTi_C "AC capacity down implemetion timer" VALUE 0x80506C82 RB_Val_Ws16 655.3500 Time_s -327.6800 327.6700 FORMAT "%8.4" /end CHARACTERISTIC
/begin CHARACTERISTIC ACCtl_tiAccPedBuf_C "Buffer time for acceleration pedal position calculation" VALUE 0x80506C84 RB_Val_Wu16 655.3500 t_q0p01 0.00 655.3500 FORMAT "%8.4" /end CHARACTERISTIC
/begin CHARACTERISTIC ACCtl_tiACCpTqReqTmrMax_C "Maximum AC torque reduction time for Engine torque down request torque" VALUE 0x80506C88 RB_Val_Ws32 42949672.9500 Time_s -21474836.4800 21474836.4700 FORMAT "%13.4" /end CHARACTERISTIC
/begin CHARACTERISTIC ACCtl_tiAcCutDebThdHiLo_C "Uphill AC CUT non-operating time" VALUE 0x80506C8C RB_Val_Ws16 327.6700 t_q0p01 0.00 327.6700 FORMAT "%8.4" EXTENDED_LIMITS -327.6800 327.6700 /end CHARACTERISTIC
/begin CHARACTERISTIC ACCtl_tiAcCutDebThdLoHi_C "Uphill AC CUT operating time" VALUE 0x80506C8E RB_Val_Ws16 327.6700 t_q0p01 0.00 327.6700 FORMAT "%8.4" EXTENDED_LIMITS -327.6800 327.6700 /end CHARACTERISTIC
/begin CHARACTERISTIC ACCtl_tiAcCutOperRepDly_C "Uphill AC cut then operatrepeating delay time threshold" VALUE 0x80506C90 RB_Val_Ws16 327.6700 t_q0p01 0.00 327.6700 FORMAT "%8.4" EXTENDED_LIMITS -327.6800 327.6700 /end CHARACTERISTIC
/begin CHARACTERISTIC ACCtl_tiACPOffDly_C "AC pressure off delay" VALUE 0x80506C92 RB_Val_Wu16 655.3500 t_q0p01 0.00 655.3500 FORMAT "%8.4" /end CHARACTERISTIC
/begin CHARACTERISTIC ACCtl_tiACTond_C "AC turn On delay time for AC turn Off torque reserve" VALUE 0x80506C94 RB_Val_Wu16 655.3500 t_q0p01 0.00 655.3500 FORMAT "%8.4" /end CHARACTERISTIC
/begin CHARACTERISTIC ACCtl_tiACTrqDlyImdt_C "Delay time for AC torque when the immediately AC shut off" VALUE 0x80506C96 RB_Val_Wu16 655.3500 t_q0p01 0.00 655.3500 FORMAT "%8.4" /end CHARACTERISTIC
/begin CHARACTERISTIC ACCtl_tiACTrqDly_C "AC off for setting the delay time for ACCtl_trqMaxAC used application" VALUE 0x80506C98 RB_Val_Wu16 655.3500 t_q0p01 0.00 655.3500 FORMAT "%8.4" /end CHARACTERISTIC
/begin CHARACTERISTIC ACCtl_tiClmbSpdThdDly_C "Uphill AC cut base on vehicle speed delay time threshold" VALUE 0x80506C9A RB_Val_Ws16 327.6700 t_q0p01 0.00 327.6700 FORMAT "%8.4" EXTENDED_LIMITS -327.6800 327.6700 /end CHARACTERISTIC
/begin CHARACTERISTIC ACCtl_tiDebIdlSpdOnDly_C "Delay time for idle up start" VALUE 0x80506C9C RB_Val_Wu16 655.3500 t_q0p01 0.00 655.3500 FORMAT "%8.4" /end CHARACTERISTIC
/begin CHARACTERISTIC ACCtl_tiDebIdlSpdSec_C "debounce time for idle speed request" VALUE 0x80506C9E RB_Val_Wu16 655.3500 t_q0p01 0.00 655.3500 FORMAT "%8.4" /end CHARACTERISTIC
/begin CHARACTERISTIC ACCtl_tiDlyAcOn_C "Time delay for AC ON" VALUE 0x80506CA0 RB_Val_Wu16 655.3500 t_q0p01 0.00 655.3500 FORMAT "%8.4" /end CHARACTERISTIC
/begin CHARACTERISTIC ACCtl_tiDlyClmbOn_C "Hill climbing AC shut off activation delay time" VALUE 0x80506CA2 RB_Val_Wu16 655.3500 t_q0p01 0.00 655.3500 FORMAT "%8.4" /end CHARACTERISTIC
/begin CHARACTERISTIC ACCtl_tiDlyCrkNotCmpl_C "AC shut off time after engine start" VALUE 0x80506CA4 RB_Val_Wu16 655.3500 t_q0p01 0.00 655.3500 FORMAT "%8.4" /end CHARACTERISTIC
/begin CHARACTERISTIC ACCtl_tiDlyEngNOn_C "Low engine speed AC shut off recovery delay time" VALUE 0x80506CA6 RB_Val_Wu16 655.3500 t_q0p01 0.00 655.3500 FORMAT "%8.4" /end CHARACTERISTIC
/begin CHARACTERISTIC ACCtl_tiDlyEvaErrOff_C "AC clutch on delay time at evaporator sensor short" VALUE 0x80506CA8 RB_Val_Wu8 25.50 t_q0p1 0.00 25.50 FORMAT "%5.2" /end CHARACTERISTIC
/begin CHARACTERISTIC ACCtl_tiDlyEvaErrOn_C "AC clutch off delay time at evaporator sensor short" VALUE 0x80506CA9 RB_Val_Wu8 25.50 t_q0p1 0.00 25.50 FORMAT "%5.2" /end CHARACTERISTIC
/begin CHARACTERISTIC ACCtl_tiInhbACCutPrmsACOn_C "AC cut permission inhibit time at the time of AC ON." VALUE 0x80506CAA RB_Val_Wu16 655.3500 t_q0p01 0.00 655.3500 FORMAT "%8.4" /end CHARACTERISTIC
/begin CHARACTERISTIC ACCtl_tiInhbACCutPrms_C "AC cut permission inhibit time" VALUE 0x80506CAC RB_Val_Wu16 655.3500 t_q0p01 0.00 655.3500 FORMAT "%8.4" /end CHARACTERISTIC
/begin CHARACTERISTIC ACCtl_tiOutDlyImdt_C "Delay time for ACCtl_bOut when the immediately AC shut off" VALUE 0x80506CAE RB_Val_Wu16 655.3500 t_q0p01 0.00 655.3500 FORMAT "%8.4" /end CHARACTERISTIC
/begin CHARACTERISTIC ACCtl_tiOutDly_C "Delay time for ACCtl_bOut" VALUE 0x80506CB0 RB_Val_Wu16 655.3500 t_q0p01 0.00 655.3500 FORMAT "%8.4" /end CHARACTERISTIC
/begin CHARACTERISTIC ACCtl_tiStrtCutTmrCdn_C "AC On delay time for vehicle start AC cut off condition" VALUE 0x80506CB2 RB_Val_Ws16 655.3500 t_q0p01 -327.6800 327.6700 FORMAT "%8.4" /end CHARACTERISTIC
/begin CHARACTERISTIC ACCtl_tiStrtCutTmrHi_C "Vehicle start AC shut off time for high acceleration" VALUE 0x80506CB4 RB_Val_Ws16 655.3500 t_q0p01 -327.6800 327.6700 FORMAT "%8.4" /end CHARACTERISTIC
/begin CHARACTERISTIC ACCtl_tiStrtCutTmrMid_C "Vehicle start AC shut off time for middle acceleration" VALUE 0x80506CB6 RB_Val_Ws16 655.3500 t_q0p01 -327.6800 327.6700 FORMAT "%8.4" /end CHARACTERISTIC
/begin CHARACTERISTIC ACCtl_tiSwOffResv_C "AC Off torque reserve time" VALUE 0x80506CB8 RB_Val_Wu16 655.3500 t_q0p01 0.00 655.3500 FORMAT "%8.4" /end CHARACTERISTIC
/begin CHARACTERISTIC ACCtl_tiTrqResvSec_C "delay time for torque reserve build up before AC compressor engagement" VALUE 0x80506CBA RB_Val_Wu16 655.3500 t_q0p01 0.00 655.3500 FORMAT "%8.4" /end CHARACTERISTIC
/begin CHARACTERISTIC ACCtl_tqACCmprTqReqDurgAPOpng_T "AC compressor request torque during Accelerator pedel opening" CURVE 0x80506CBC RB_Curve_S16_S16 6553.500 Trq -3276.800 3276.700 FORMAT "%8.3"
 /begin AXIS_DESCR STD_AXIS ACCtl_rAppSig Prc 10 -400.0000 399.9878 FORMAT "%8.4" DEPOSIT ABSOLUTE /end AXIS_DESCR
/end CHARACTERISTIC
/begin CHARACTERISTIC ACCtl_tqDwnDurgDecel_C "AC torque down value during deceleration" VALUE 0x80506CE6 RB_Val_Ws16 6553.500 Trq -3276.800 3276.700 FORMAT "%8.3" /end CHARACTERISTIC
/begin CHARACTERISTIC ACCtl_tqMaxAcLim_C "AC torque limit for shutoff condition" VALUE 0x80506CE8 RB_Val_Ws16 6553.500 Trq -3276.800 3276.700 FORMAT "%8.3" /end CHARACTERISTIC
/begin CHARACTERISTIC ACCtl_tqMaxTqCrksftEngSpdEnd_C "AC Maximum torque cranshaft during engine speed end" VALUE 0x80506CEA RB_Val_Ws16 6553.500 Trq -3276.800 3276.700 FORMAT "%8.3" /end CHARACTERISTIC
/begin CHARACTERISTIC ACCtl_trqMaxAC_C "maximal torque default for AC disposition" VALUE 0x80506CEC RB_Val_Ws16 6553.500 Trq -3276.800 3276.700 FORMAT "%8.3" /end CHARACTERISTIC
/begin CHARACTERISTIC ACCtl_vACCpLowrVehSpdThd_C "Lower vehicle speed theshold for AC capactiy" VALUE 0x80506CEE RB_Val_Ws16 655.3500 Vel -327.6800 327.6700 FORMAT "%8.4" /end CHARACTERISTIC
/begin CHARACTERISTIC ACCtl_vACCpUpprVehSpdThd_C "Upper vehicle speed theshold for AC capactiy" VALUE 0x80506CF0 RB_Val_Ws16 655.3500 Vel -327.6800 327.6700 FORMAT "%8.4" /end CHARACTERISTIC
/begin CHARACTERISTIC ACCtl_vACTrqDecHiThd_C "Higher threshold for vehicle speed for AC cut condition" VALUE 0x80506CF2 RB_Val_Ws16 655.3500 Vel -327.6800 327.6700 FORMAT "%8.4" /end CHARACTERISTIC
/begin CHARACTERISTIC ACCtl_vACTrqDecLoThd_C "Lower threshold for vehicle speed for AC cut condition" VALUE 0x80506CF4 RB_Val_Ws16 655.3500 Vel -327.6800 327.6700 FORMAT "%8.4" /end CHARACTERISTIC
/begin CHARACTERISTIC ACCtl_vVehAcCutOnThd_C "Vehicle speed possible threshold for AC on" VALUE 0x80506CF6 RB_Val_Ws16 655.3500 Vel -327.6800 327.6700 FORMAT "%8.4" /end CHARACTERISTIC
/begin CHARACTERISTIC ACCtl_vVehChkHiThd_C "Vehicle speed low threshold checking uphill for AC cut" VALUE 0x80506CF8 RB_Val_Ws16 655.3500 Vel -327.6800 327.6700 FORMAT "%8.4" /end CHARACTERISTIC
/begin CHARACTERISTIC ACCtl_vVehChkLoThd_C "Vehicle speed high threshold checking uphill for AC on" VALUE 0x80506CFA RB_Val_Ws16 655.3500 Vel -327.6800 327.6700 FORMAT "%8.4" /end CHARACTERISTIC
/begin CHARACTERISTIC ACCtl_vVehClmbHi_C "Vehicle speed threshold high for hill climbing AC shut off condition" VALUE 0x80506CFC RB_Val_Ws16 655.3500 Vel -327.6800 327.6700 FORMAT "%8.4" /end CHARACTERISTIC
/begin CHARACTERISTIC ACCtl_vVehClmbLo_C "Vehicle speed threshold low for hill climbing AC shut off condition" VALUE 0x80506CFE RB_Val_Ws16 655.3500 Vel -327.6800 327.6700 FORMAT "%8.4" /end CHARACTERISTIC
/begin CHARACTERISTIC ACCtl_vVehHiCoolgPrf_C "Vehicle speed threshold high for high engine temperature AC shut off" VALUE 0x80506D00 RB_Val_Ws16 655.3500 Vel -327.6800 327.6700 FORMAT "%8.4" /end CHARACTERISTIC
/begin CHARACTERISTIC ACCtl_vVehLoCoolgPrf_C "Vehicle speed threshold low for high engine temperature AC shut off" VALUE 0x80506D02 RB_Val_Ws16 655.3500 Vel -327.6800 327.6700 FORMAT "%8.4" /end CHARACTERISTIC
/begin CHARACTERISTIC ACCtl_vVehStrtCutInhbHi_C "Vehicle speed threshold high for vehicle start AC shut off inhibit condition" VALUE 0x80506D04 RB_Val_Ws16 655.3500 Vel -327.6800 327.6700 FORMAT "%8.4" /end CHARACTERISTIC
/begin CHARACTERISTIC ACCtl_vVehStrtCutInhbLo_C "Vehicle speed threshold low for vehicle start AC shut off inhibit condition" VALUE 0x80506D06 RB_Val_Ws16 655.3500 Vel -327.6800 327.6700 FORMAT "%8.4" /end CHARACTERISTIC
/begin CHARACTERISTIC ACEvpT_PhysRng.Min_C "Structure for Physical Range Check for AC Evaporator temperature / Minimum threshold for the Sensed value." VALUE 0x8058AC5C Val_Ws16 6553.500 Temp_Cels -3549.940 3003.560 FORMAT "%8.3" /end CHARACTERISTIC
/begin CHARACTERISTIC ACEvpT_PhysRng.Max_C "Structure for Physical Range Check for AC Evaporator temperature / Maximum threshold for the Sensed value." VALUE 0x8058AC5E Val_Ws16 6553.500 Temp_Cels -3549.940 3003.560 FORMAT "%8.3" /end CHARACTERISTIC
/begin CHARACTERISTIC ACEvpT_SRC.uMin_C "Structure to hold the SRC thresholds / Threshold for SRC -Min detection" VALUE 0x8058AC60 Kw_Ws16 5200.000 Volt 0.00 5200.000 FORMAT "%8.3" EXTENDED_LIMITS -6553.600 6553.400 /end CHARACTERISTIC
/begin CHARACTERISTIC ACEvpT_SRC.uMax_C "Structure to hold the SRC thresholds / Threshold for SRC -Max detection" VALUE 0x8058AC62 Kw_Ws16 5200.000 Volt 0.00 5200.000 FORMAT "%8.3" EXTENDED_LIMITS -6553.600 6553.400 /end CHARACTERISTIC
/begin CHARACTERISTIC ACEvpT_stCodMsk_C "Calibration variable:To get the particular bit position value of the BasSvrAppl_swtCodAC variable" VALUE 0x8058AC64 Val_Wu8 255.0 OneToOne 0.00 255.0 FORMAT "%5.1" /end CHARACTERISTIC
/begin CHARACTERISTIC ACEvpT_swtSensPres_C "Switch to check whether the ac Evaporator temperature sensor is present or not" VALUE 0x8058AC65 Val_Wu8 1.000 OneToOne 0.00 1.000 FORMAT "%5.3" EXTENDED_LIMITS 0.00 255.0 /end CHARACTERISTIC
/begin CHARACTERISTIC ACEvpT_swtSig_C "Signal Selection (ADC or CAN) in the presence of the sensor" VALUE 0x8058AC66 Val_Wu8 255.0 OneToOne 0.00 255.0 FORMAT "%5.1" /end CHARACTERISTIC
/begin CHARACTERISTIC ACEvpT_tBCANErr_C "Calibration to check BCAN errors" VALUE 0x8058AC68 Val_Ws16 6553.500 Temp_Cels -3549.940 3003.560 FORMAT "%8.3" /end CHARACTERISTIC
/begin CHARACTERISTIC ACEvpT_tCANErrDftVal_C "Default Calibration in case of CAN errors" VALUE 0x8058AC6A Val_Ws16 6553.500 Temp_Cels -3549.940 3003.560 FORMAT "%8.3" /end CHARACTERISTIC
/begin CHARACTERISTIC ACEvpT_tDfl_C "Default ac Evaporator temperature when there is sensor error" VALUE 0x8058AC6C Val_Ws16 250.0000 Temp_Cels -50.0400 199.9600 FORMAT "%8.4" EXTENDED_LIMITS -3549.940 3003.560 /end CHARACTERISTIC
/begin CHARACTERISTIC ACEvpT_tFCANErr_C "Calibration to check FCAN errors" VALUE 0x8058AC6E Val_Ws16 6553.500 Temp_Cels -3549.940 3003.560 FORMAT "%8.3" /end CHARACTERISTIC
/begin CHARACTERISTIC ACEvpT_tiCANDly_C "Turn on Delay time to receive CAN signal" VALUE 0x8058AC70 Val_Ws32 42949672950.0 Time_ms -21474836480.0 21474836470.0 FORMAT "%13.1" /end CHARACTERISTIC
/begin CHARACTERISTIC ACEvpT_tTransf_CUR "Transformation curve for AC evaporator sensor voltage to temperature" CURVE 0x8058AC74 Cur_Xs16Ws16 250.0000 Temp_Cels -50.0400 199.9600 FORMAT "%8.4" EXTENDED_LIMITS -3549.940 3003.560
 /begin AXIS_DESCR STD_AXIS ACEvpT_uRaw Volt 10 0.00 5200.000 FORMAT "%8.3" EXTENDED_LIMITS -6553.600 6553.400 DEPOSIT ABSOLUTE /end AXIS_DESCR
/end CHARACTERISTIC
/begin CHARACTERISTIC ACEvpT_uRawDfl_C "Default value for the raw voltage of ACEvpT when the sensor is not present" VALUE 0x8058AC9E Val_Ws16 5200.000 Volt 0.00 5200.000 FORMAT "%8.3" EXTENDED_LIMITS -6553.600 6553.400 /end CHARACTERISTIC
/begin CHARACTERISTIC ACSwt_stMnSwtDebEna_C "AC switch debounce enable parameter" VALUE 0x80506D08 RB_Val_Wu8 255.0 OneToOne 0.00 255.0 FORMAT "%5.1" /end CHARACTERISTIC
/begin CHARACTERISTIC ACSwt_tiSwtDebHiLo_C "High to low debounce time for AC switch status" VALUE 0x80506D0A RB_Val_Ws16 655350.0 TimeDeb -327680.0 327670.0 FORMAT "%8.1" /end CHARACTERISTIC
/begin CHARACTERISTIC ACSwt_tiSwtDebLoHi_C "Low to high debounce time for AC switch status" VALUE 0x80506D0C RB_Val_Ws16 655350.0 TimeDeb -327680.0 327670.0 FORMAT "%8.1" /end CHARACTERISTIC
/begin CHARACTERISTIC AFS_cntrCrkshtRev_C "Minimum crankshaft revolution since switch off start for release of physical HFM range check" VALUE 0x80506F6C RB_Val_Ws16 65535.00 OneToOne -32768.00 32767.00 FORMAT "%8.2" /end CHARACTERISTIC
/begin CHARACTERISTIC AFS_facPlstCorrnDev123_MAP "Pulsation characteristic map for adjustment element 1,2,3" MAP 0x80506F98 RB_Map_S16S16_U16 3.999939 fak_uw_b4 0.00 3.999939 FORMAT "%8.6"
 /begin AXIS_DESCR STD_AXIS AFS_nEngTCorrd EngN 18 -16384.00 16383.50 FORMAT "%8.2" DEPOSIT ABSOLUTE /end AXIS_DESCR
 /begin AXIS_DESCR STD_AXIS ThrVlv_ratActPosnLoc rel_q0p0078125 14 -256.0000 255.9922 FORMAT "%8.4" DEPOSIT ABSOLUTE /end AXIS_DESCR
/end CHARACTERISTIC
/begin CHARACTERISTIC AFS_facPlstCorrnDev12_MAP "Pulsation characteristic map for adjustment element 1,2" MAP 0x805071D4 RB_Map_S16S16_U16 3.999939 fak_uw_b4 0.00 3.999939 FORMAT "%8.6"
 /begin AXIS_DESCR STD_AXIS AFS_nEngTCorrd EngN 18 -16384.00 16383.50 FORMAT "%8.2" DEPOSIT ABSOLUTE /end AXIS_DESCR
 /begin AXIS_DESCR STD_AXIS ThrVlv_ratActPosnLoc rel_q0p0078125 14 -256.0000 255.9922 FORMAT "%8.4" DEPOSIT ABSOLUTE /end AXIS_DESCR
/end CHARACTERISTIC
/begin CHARACTERISTIC AFS_facPlstCorrnDev13_MAP "Pulsation characteristic map for adjustment element 1,3" MAP 0x80507410 RB_Map_S16S16_U16 3.999939 fak_uw_b4 0.00 3.999939 FORMAT "%8.6"
 /begin AXIS_DESCR STD_AXIS AFS_nEngTCorrd EngN 18 -16384.00 16383.50 FORMAT "%8.2" DEPOSIT ABSOLUTE /end AXIS_DESCR
 /begin AXIS_DESCR STD_AXIS ThrVlv_ratActPosnLoc rel_q0p0078125 14 -256.0000 255.9922 FORMAT "%8.4" DEPOSIT ABSOLUTE /end AXIS_DESCR
/end CHARACTERISTIC
/begin CHARACTERISTIC AFS_facPlstCorrnDev1_MAP "Pulsation characteristic map for adjustment element 1" MAP 0x8050764C RB_Map_S16S16_U16 3.999939 fak_uw_b4 0.00 3.999939 FORMAT "%8.6"
 /begin AXIS_DESCR STD_AXIS AFS_nEngTCorrd EngN 18 -16384.00 16383.50 FORMAT "%8.2" DEPOSIT ABSOLUTE /end AXIS_DESCR
 /begin AXIS_DESCR STD_AXIS ThrVlv_ratActPosnLoc rel_q0p0078125 14 -256.0000 255.9922 FORMAT "%8.4" DEPOSIT ABSOLUTE /end AXIS_DESCR
/end CHARACTERISTIC
/begin CHARACTERISTIC AFS_facPlstCorrnDev23_MAP "Pulsation characteristic map for adjustment element 2,3" MAP 0x80507888 RB_Map_S16S16_U16 3.999939 fak_uw_b4 0.00 3.999939 FORMAT "%8.6"
 /begin AXIS_DESCR STD_AXIS AFS_nEngTCorrd EngN 18 -16384.00 16383.50 FORMAT "%8.2" DEPOSIT ABSOLUTE /end AXIS_DESCR
 /begin AXIS_DESCR STD_AXIS ThrVlv_ratActPosnLoc rel_q0p0078125 14 -256.0000 255.9922 FORMAT "%8.4" DEPOSIT ABSOLUTE /end AXIS_DESCR
/end CHARACTERISTIC
/begin CHARACTERISTIC AFS_facPlstCorrnDev2_MAP "Pulsation characteristic map for adjustment element 2" MAP 0x80507AC4 RB_Map_S16S16_U16 3.999939 fak_uw_b4 0.00 3.999939 FORMAT "%8.6"
 /begin AXIS_DESCR STD_AXIS AFS_nEngTCorrd EngN 18 -16384.00 16383.50 FORMAT "%8.2" DEPOSIT ABSOLUTE /end AXIS_DESCR
 /begin AXIS_DESCR STD_AXIS ThrVlv_ratActPosnLoc rel_q0p0078125 14 -256.0000 255.9922 FORMAT "%8.4" DEPOSIT ABSOLUTE /end AXIS_DESCR
/end CHARACTERISTIC
/begin CHARACTERISTIC AFS_facPlstCorrnDev3_MAP "Pulsation characteristic map for adjustment element 3" MAP 0x80507D00 RB_Map_S16S16_U16 3.999939 fak_uw_b4 0.00 3.999939 FORMAT "%8.6"
 /begin AXIS_DESCR STD_AXIS AFS_nEngTCorrd EngN 18 -16384.00 16383.50 FORMAT "%8.2" DEPOSIT ABSOLUTE /end AXIS_DESCR
 /begin AXIS_DESCR STD_AXIS ThrVlv_ratActPosnLoc rel_q0p0078125 14 -256.0000 255.9922 FORMAT "%8.4" DEPOSIT ABSOLUTE /end AXIS_DESCR
/end CHARACTERISTIC
/begin CHARACTERISTIC AFS_facPlstCorrnDevCold_MAP "Pulsation characteristic map cold condition" MAP 0x80507F3C RB_Map_S16S16_U16 3.999939 fak_uw_b4 0.00 3.999939 FORMAT "%8.6"
 /begin AXIS_DESCR STD_AXIS AFS_nEngTCorrd EngN 18 -16384.00 16383.50 FORMAT "%8.2" DEPOSIT ABSOLUTE /end AXIS_DESCR
 /begin AXIS_DESCR STD_AXIS ThrVlv_ratActPosnLoc rel_q0p0078125 14 -256.0000 255.9922 FORMAT "%8.4" DEPOSIT ABSOLUTE /end AXIS_DESCR
/end CHARACTERISTIC
/begin CHARACTERISTIC AFS_facPlstCorrn_MAP "Pulsation characteristic map basis" MAP 0x80508178 RB_Map_S16S16_U16 3.999939 fak_uw_b4 0.00 3.999939 FORMAT "%8.6"
 /begin AXIS_DESCR STD_AXIS AFS_nEngTCorrd EngN 18 -16384.00 16383.50 FORMAT "%8.2" DEPOSIT ABSOLUTE /end AXIS_DESCR
 /begin AXIS_DESCR STD_AXIS ThrVlv_ratActPosnLoc rel_q0p0078125 14 -256.0000 255.9922 FORMAT "%8.4" DEPOSIT ABSOLUTE /end AXIS_DESCR
/end CHARACTERISTIC
/begin CHARACTERISTIC AFS_facTInflPlstCorrn_CUR "Pulsation correction depending on intake manifold temperature" CURVE 0x805083B4 RB_Curve_U8_U8 1.992188 fak_ub_b2 0.00 1.992188 FORMAT "%8.6"
 /begin AXIS_DESCR STD_AXIS NO_INPUT_QUANTITY temp_ub_q0p75_o48 8 -48.0 143.3 FORMAT "%5.1" DEPOSIT ABSOLUTE /end AXIS_DESCR
/end CHARACTERISTIC
/begin CHARACTERISTIC AFS_LowrSwtPntPlstCorrnDev1_C "Lower switching point pulsation correction for adjustment element 1" VALUE 0x805083C5 RB_Val_Wu8 0.9961 fak_ub_b1 0.00 0.9961 /end CHARACTERISTIC
/begin CHARACTERISTIC AFS_LowrSwtPntPlstCorrnDev2_C "Lower switching point pulsation correction for adjustment element 2" VALUE 0x805083C6 RB_Val_Wu8 0.9961 fak_ub_b1 0.00 0.9961 /end CHARACTERISTIC
/begin CHARACTERISTIC AFS_LowrSwtPntPlstCorrnDev3_C "Lower switching point pulsation correction for adjustment element 3" VALUE 0x805083C7 RB_Val_Wu8 0.9961 fak_ub_b1 0.00 0.9961 /end CHARACTERISTIC
/begin CHARACTERISTIC AFS_mfPhyRngHiB1_C "Upper threshold of the physical HFM range check" VALUE 0x80506F6E RB_Val_Ws16 6553.500 m_q0p1 -3276.800 3276.700 FORMAT "%8.3" /end CHARACTERISTIC
/begin CHARACTERISTIC AFS_mfPhyRngLoB1_C "Lower threshold of the physical HFM range check" VALUE 0x80506F70 RB_Val_Ws16 6553.500 m_q0p1 -3276.800 3276.700 FORMAT "%8.3" /end CHARACTERISTIC
/begin CHARACTERISTIC AFS_mfThdFilActv_C "Lower threshold of the air mass flow over the throttle valve to activate the stationary filter of the HFM air mass signal" VALUE 0x80506D24 RB_Val_Wu16 6553.500 m_q0p1 0.00 6553.500 FORMAT "%8.3" /end CHARACTERISTIC
/begin CHARACTERISTIC AFS_mfThdMinB1_C "Lower threshold of HFM air mass flow to set validity information" VALUE 0x80506F72 RB_Val_Ws16 6553.500 m_q0p1 -3276.800 3276.700 FORMAT "%8.3" /end CHARACTERISTIC
/begin CHARACTERISTIC AFS_mfTrafoAnB1_T "HFM sensor curve for the Analog interface" CURVE 0x80506D26 RB_Curve_S16_S16 6553.500 m_q0p1 -3276.800 3276.700 FORMAT "%8.3"
 /begin AXIS_DESCR STD_AXIS AFS_uSnsrRawB1 Volt 129 -6553.600 6553.400 FORMAT "%8.3" DEPOSIT ABSOLUTE /end AXIS_DESCR
/end CHARACTERISTIC
/begin CHARACTERISTIC AFS_nEngMinPhyRngDiag_C "Lower threshold for engine speed for release of physical HFM range check" VALUE 0x80506F74 RB_Val_Ws16 32767.50 EngN -16384.00 16383.50 FORMAT "%8.2" /end CHARACTERISTIC
/begin CHARACTERISTIC AFS_nEngRunngMin_C "Minimum threshold for the engine speed synchronus air mass flow calculation" VALUE 0x80506F2C RB_Val_Ws16 32767.50 EngN -16384.00 16383.50 FORMAT "%8.2" /end CHARACTERISTIC
/begin CHARACTERISTIC AFS_nrSegSldgAvrg_C "Number of full segments which are used for the sliding average calculation" VALUE 0x80506F2E RB_Val_Wu8 23.00 OneToOne 1.00 24.00 FORMAT "%5.2" EXTENDED_LIMITS 0.00 255.0 /end CHARACTERISTIC
/begin CHARACTERISTIC AFS_nThdMaxFilActv_C "Upper threshold of the engine speed to activate the stationary filter of the HFM air mass signal" VALUE 0x80506F30 RB_Val_Ws16 32767.50 EngN -16384.00 16383.50 FORMAT "%8.2" /end CHARACTERISTIC
/begin CHARACTERISTIC AFS_nThdMinFilActv_C "Lower threshold of the engine speed to activate the stationary filter of the HFM air mass signal" VALUE 0x80506F32 RB_Val_Ws16 32767.50 EngN -16384.00 16383.50 FORMAT "%8.2" /end CHARACTERISTIC
/begin CHARACTERISTIC AFS_stSelnDev1_C "Selection of adjustment element 1 for pulsation correction" VALUE 0x805083C8 RB_Val_Wu8 255.0 dez 0.00 255.0 FORMAT "%5.1" /end CHARACTERISTIC
/begin CHARACTERISTIC AFS_stSelnDev2_C "Selection of adjustment element 2 for pulsation correction" VALUE 0x805083C9 RB_Val_Wu8 255.0 dez 0.00 255.0 FORMAT "%5.1" /end CHARACTERISTIC
/begin CHARACTERISTIC AFS_stSelnDev3_C "Selection of adjustment element 3 for pulsation correction" VALUE 0x805083CA RB_Val_Wu8 255.0 dez 0.00 255.0 FORMAT "%5.1" /end CHARACTERISTIC
/begin CHARACTERISTIC AFS_stSelnHomOperModMask_C "calibration mask select different homogeneous operation modes" VALUE 0x805083CB RB_Val_Wu8 255.0 OneToOne 0.00 255.0 FORMAT "%5.1" /end CHARACTERISTIC
/begin CHARACTERISTIC AFS_stSwtEnaSldgAvrg_C "Switch to activate the sliding average calculation over multiple full segments" VALUE 0x80506F34 RB_Val_Wu8 1.00000000000 B_TRUE 0.00 1.00000000000 FORMAT "%13.11" /end CHARACTERISTIC
/begin CHARACTERISTIC AFS_stSwtNrSegAvrgB1_C "Switch to activate the sliding average calculation over two full segments (FALSE: Averaging over one full segment; TRUE: Sliding averaging over zwo full segments)" VALUE 0x80506F35 RB_Val_Wu8 1.00000000000 B_TRUE 0.00 1.00000000000 FORMAT "%13.11" /end CHARACTERISTIC
/begin CHARACTERISTIC AFS_stSwtRelsEngRunng_C "Switch to consider status engine running in release condition for diagnosis" VALUE 0x80506F36 RB_Val_Wu8 1.00000000000 B_TRUE 0.00 1.00000000000 FORMAT "%13.11" /end CHARACTERISTIC
/begin CHARACTERISTIC AFS_stSwtResiCalcn_C "Switch to activate the residual error calculation during averaging of air mass flow calculation" VALUE 0x80506F37 RB_Val_Wu8 1.00000000000 B_TRUE 0.00 1.00000000000 FORMAT "%13.11" /end CHARACTERISTIC
/begin CHARACTERISTIC AFS_tiDebBattVcc_C "Debouncing time for the battery voltage check for the release of the HFM diagnosis" VALUE 0x80506F38 RB_Val_Ws16 65535.00 Time_msec_q1_COMPU -32768.00 32767.00 FORMAT "%8.2" /end CHARACTERISTIC
/begin CHARACTERISTIC AFS_tiDebEngRunng_C "Debouncing time for engine running check" VALUE 0x80506F3A RB_Val_Ws16 65535.00 Time_msec_q1_COMPU -32768.00 32767.00 FORMAT "%8.2" /end CHARACTERISTIC
/begin CHARACTERISTIC AFS_tiEgrDiagRelsDeb_C "Debounce time after EGR diagnosis" VALUE 0x80506F76 RB_Val_Ws16 65535.00 Time_msec_q1_COMPU -32768.00 32767.00 FORMAT "%8.2" /end CHARACTERISTIC
/begin CHARACTERISTIC AFS_tiPt1B1_T "Time constant for PT1 filtering of HFM air mass flow signal depending on segment length" CURVE 0x80506F3C RB_Curve_S16_S16 65535.00 Time_msec_q1_COMPU -32768.00 32767.00 FORMAT "%8.2"
 /begin AXIS_DESCR STD_AXIS AFS_tiSeg Time_msec_q1_COMPU 4 -32768.00 32767.00 FORMAT "%8.2" DEPOSIT ABSOLUTE /end AXIS_DESCR
/end CHARACTERISTIC
/begin CHARACTERISTIC AFS_tiPt1MFlowThrVlv_C "Time constant for the PT1 filtering of the air mass flow over throttle valve" VALUE 0x80506F50 RB_Val_Ws32 4294967.3 TimeDelay_ms 0.0 4294967.3 FORMAT "%12.1" /end CHARACTERISTIC
/begin CHARACTERISTIC AFS_tiPt1PhyRngDiagB1_C "Time constant for PT1 filtering of HFM air mass flow" VALUE 0x80506F78 RB_Val_Ws32 4294.9672940000000 TimeDelay_s 0.0000020000000 4294.9672959999998 FORMAT "%19.14" EXTENDED_LIMITS 0.000002000000001 4294.9672959999998 /end CHARACTERISTIC
/begin CHARACTERISTIC AFS_tiPt1StatyFil_T "PT1 time constant of the stationary filter in the air mass flow signal path depending on the gradient rate of the air mass flow over the throttle valve" CURVE 0x80506F54 RB_Curve_U16_S16_Static 65535.00 Time_msec_q1_COMPU -32768.00 32767.00 FORMAT "%8.2"
 /begin AXIS_DESCR STD_AXIS AFS_facDeltaMFlowThrVlv fak_uw_b2 3 0.00 1.999969 FORMAT "%8.6" DEPOSIT ABSOLUTE /end AXIS_DESCR
/end CHARACTERISTIC
/begin CHARACTERISTIC AFS_uBattThdHi_C "Upper threshold for the battery voltage for the release of the diagnosis of the HFM sensor" VALUE 0x80506F62 RB_Val_Ws16 1310700. Volt_Batt -655360.0 655340.0 FORMAT "%8.1" /end CHARACTERISTIC
/begin CHARACTERISTIC AFS_uBattThdLo_C "Lower threshold for the battery voltage for the release of the diagnosis of the HFM sensor" VALUE 0x80506F64 RB_Val_Ws16 1310700. Volt_Batt -655360.0 655340.0 FORMAT "%8.1" /end CHARACTERISTIC
/begin CHARACTERISTIC AFS_UpprSwtPntPlstCorrnDev1_C "Upper switching point pulsation correction for adjustment element 1" VALUE 0x805083CC RB_Val_Wu8 0.9961 fak_ub_b1 0.00 0.9961 /end CHARACTERISTIC
/begin CHARACTERISTIC AFS_UpprSwtPntPlstCorrnDev2_C "Upper switching point pulsation correction for adjustment element 2" VALUE 0x805083CD RB_Val_Wu8 0.9961 fak_ub_b1 0.00 0.9961 /end CHARACTERISTIC
/begin CHARACTERISTIC AFS_UpprSwtPntPlstCorrnDev3_C "Upper switching point pulsation correction for adjustment element 3" VALUE 0x805083CE RB_Val_Wu8 0.9961 fak_ub_b1 0.00 0.9961 /end CHARACTERISTIC
/begin CHARACTERISTIC AFS_uRawSrcMaxThd_C "Upper threshold for the transmitted voltage of the HFM sensor to detect an out-of-range error." VALUE 0x80506F66 RB_Val_Ws16 13107.00 Volt -6553.600 6553.400 FORMAT "%8.3" /end CHARACTERISTIC
/begin CHARACTERISTIC AFS_uRawSrcMinThd_C "Lower threshold for the transmitted voltage of the HFM sensor to detect an out-of-range error." VALUE 0x80506F68 RB_Val_Ws16 13107.00 Volt -6553.600 6553.400 FORMAT "%8.3" /end CHARACTERISTIC
/begin CHARACTERISTIC AirC_stSwtDfl_C "Default value for AC switch in case of errors" VALUE 0x80506D0E RB_Val_Wu8 255.0 OneToOne 0.00 255.0 FORMAT "%5.1" /end CHARACTERISTIC
/begin CHARACTERISTIC AirDvP_flgAddEnaDly_C "Switch for delay of enableing condition engine stopped" VALUE 0x8051BA80 RB_Val_Wu8 1.00000000000 B_TRUE 0.00 1.00000000000 FORMAT "%13.11" /end CHARACTERISTIC
/begin CHARACTERISTIC AirDvP_pEngStrtMax_C "Max pressure for diagnosis of pressure sensors during startup" VALUE 0x8051BA82 RB_Val_Wu16 5119.922 p_q0p078 0.00 5119.922 FORMAT "%8.3" /end CHARACTERISTIC
/begin CHARACTERISTIC AirDvP_pEnvSpcSnsrTolr_C "One side tolerance ambient air pressure sensor" VALUE 0x8051BA84 RB_Val_Ws16 1279.961 p_q0p039 0.00 1279.961 FORMAT "%8.3" EXTENDED_LIMITS -1280.000 1279.961 /end CHARACTERISTIC
/begin CHARACTERISTIC AirDvP_pIntkVUsSpcSnsrTolr_C "One side tolerance manifold pressure sensor" VALUE 0x8051BA86 RB_Val_Ws16 1279.961 p_q0p039 0.00 1279.961 FORMAT "%8.3" EXTENDED_LIMITS -1280.000 1279.961 /end CHARACTERISTIC
/begin CHARACTERISTIC AirDvP_tiDlyAftEngStop_C "time after engine stop for pressure balance in the air system" VALUE 0x8051BA88 RB_Val_Wu16 6553.500 t_q0p1 0.00 6553.500 FORMAT "%8.3" /end CHARACTERISTIC
/begin CHARACTERISTIC AirDvP_tiFilDifPEnv_C "Time constant of filter of difference between ambient air pressure and other air pressures" VALUE 0x8051BA8A RB_Val_Wu16 6553.400 t_q0p1 0.100 6553.500 FORMAT "%8.3" EXTENDED_LIMITS 0.00 6553.500 /end CHARACTERISTIC
/begin CHARACTERISTIC AirDvP_tiMaxSnsrAdpn_C "maximum time duration for the pressure sensor offset adaptation" VALUE 0x8051BA8C RB_Val_Wu16 6553.500 t_q0p1 0.00 6553.500 FORMAT "%8.3" /end CHARACTERISTIC
/begin CHARACTERISTIC AirMod_agWidthCamProfIntk_C "Width of the intake valve cam profile referred to 0.5mm lift for BC AirMod" VALUE 0x8051BA8E RB_Val_Ws16 1023.984 kw_q0p0156 -512.0000 511.9844 FORMAT "%8.4" /end CHARACTERISTIC
/begin CHARACTERISTIC AirMod_agWidthCamProfLoLftIntk_C "Width of the intake valve cam profile (low cam profile) referred to 0.5mm lift for BC AirMod" VALUE 0x8051BA90 RB_Val_Ws16 1023.984 kw_q0p0156 -512.0000 511.9844 FORMAT "%8.4" /end CHARACTERISTIC
/begin CHARACTERISTIC AirMod_cntrDlyVlvLftLftIntk_C "Parameter for counter to delay the flag B_vhefeps" VALUE 0x8051BA92 RB_Val_Wu8 255.0 OneToOne 0.00 255.0 FORMAT "%5.1" /end CHARACTERISTIC
/begin CHARACTERISTIC AirMod_flgVlvLftIntkStrt_C "Init value for B_vhegabgn" VALUE 0x8051BA93 RB_Val_Wboolean 1.00000000000 B_TRUE 0.00 1.00000000000 FORMAT "%13.11" /end CHARACTERISTIC
/begin CHARACTERISTIC AirMod_ratChrgDeltaVlvLftIntkThres_C "Threshold for the charge delta to delay the B_vhefeps" VALUE 0x8051BA94 RB_Val_Ws16 1535.977 rel_q0p0234 -768.0000 767.9766 FORMAT "%8.4" /end CHARACTERISTIC
/begin CHARACTERISTIC AltIO_ATS.LimitTypeMsk_C "Actuator test AltIO_ATS / Tester demand monitoring enable mask for actuators" VALUE 0x8058ACF0 Val_Wu8 255.0 OneToOne 0.00 255.0 FORMAT "%5.1" /end CHARACTERISTIC
/begin CHARACTERISTIC AltIO_ATS.CnvNorm_C "Actuator test AltIO_ATS / Conversion norm used for conversion to/from internal scaling" VALUE 0x8058ACF1 Val_Wu8 255.0 OneToOne 0.00 255.0 FORMAT "%5.1" /end CHARACTERISTIC
/begin CHARACTERISTIC AltIO_ATS.LowLim_C "Actuator test AltIO_ATS / Lower limit for monitoring" VALUE 0x8058ACF2 Val_Ws16 65535.00 OneToOne -32768.00 32767.00 FORMAT "%8.2" /end CHARACTERISTIC
/begin CHARACTERISTIC AltIO_ATS.UpLim_C "Actuator test AltIO_ATS / Upper limit for monitoring" VALUE 0x8058ACF4 Val_Ws16 65535.00 OneToOne -32768.00 32767.00 FORMAT "%8.2" /end CHARACTERISTIC
/begin CHARACTERISTIC AltIO_ATS.CnvFac_C "Actuator test AltIO_ATS / Factor used for conversion to/from internal scaling" VALUE 0x8058ACF8 Val_Ws32 4294967295.00 OneToOne -2147483648.00 2147483647.00 FORMAT "%13.2" /end CHARACTERISTIC
/begin CHARACTERISTIC AltIO_ATS.CnvOfs_C "Actuator test AltIO_ATS / Offset used for conversion to/from internal scaling" VALUE 0x8058ACFC Val_Ws16 65535.00 OneToOne -32768.00 32767.00 FORMAT "%8.2" /end CHARACTERISTIC
/begin CHARACTERISTIC AltIO_ATS.DfltVal_C "Actuator test AltIO_ATS / Default value for standbytest" VALUE 0x8058ACFE Val_Ws16 65535.00 OneToOne -32768.00 32767.00 FORMAT "%8.2" /end CHARACTERISTIC
/begin CHARACTERISTIC AltIO_nEngACGVltg_C "Threshold for engine speed for diagnosis for ACG system voltage Low,High" VALUE 0x8051BAA8 RB_Val_Ws16 32767.50 EngN -16384.00 16383.50 FORMAT "%8.2" /end CHARACTERISTIC
/begin CHARACTERISTIC AltIO_nEngHiThdACGDiscnct_C "Higher Threshold value for engine speed in detecting ACG disconnection." VALUE 0x8051BAAA RB_Val_Ws16 32767.50 EngN -16384.00 16383.50 FORMAT "%8.2" /end CHARACTERISTIC
/begin CHARACTERISTIC AltIO_nEngThdACGDConn_C "Threshold value for engine speed in detecting ACG disconnection" VALUE 0x8051BAAC RB_Val_Ws16 32767.50 EngN -16384.00 16383.50 FORMAT "%8.2" /end CHARACTERISTIC
/begin CHARACTERISTIC AltIO_nEngThdACGFailrLo_C "Engine thresold ACG failure for LSP Hysteresis" VALUE 0x8051BAAE RB_Val_Ws16 32767.50 EngN -16384.00 16383.50 FORMAT "%8.2" READ_ONLY /end CHARACTERISTIC
/begin CHARACTERISTIC AltIO_nEngThdACGFailr_C "Threshold value for engine speed in detecting ACG electric or mechanical fault" VALUE 0x8051BAB0 RB_Val_Ws16 32767.50 EngN -16384.00 16383.50 FORMAT "%8.2" /end CHARACTERISTIC
/begin CHARACTERISTIC AltIO_nEngThdACGTHi_C "Threshold value for engine speed in detecting ACG high temperature fault" VALUE 0x8051BAB2 RB_Val_Ws16 32767.50 EngN -16384.00 16383.50 FORMAT "%8.2" /end CHARACTERISTIC
/begin CHARACTERISTIC AltIO_rACGFieDutyHi_C "Higher threshold for filtered value of ACG field duty cycle" VALUE 0x8051BAB4 RB_Val_Ws16 655.3500 DtyCyc -327.6800 327.6700 FORMAT "%8.4" /end CHARACTERISTIC
/begin CHARACTERISTIC AltIO_rACGFieDutyLo_C "Lower threshold for filtered value of ACG field duty cycle" VALUE 0x8051BAB6 RB_Val_Ws16 655.3500 DtyCyc -327.6800 327.6700 FORMAT "%8.4" /end CHARACTERISTIC
/begin CHARACTERISTIC AltIO_rAltMdl_CUR "Model of alternator load" CURVE 0x805057DE Cur_Xs16Ws16 799.9878 Prc -400.0000 399.9878 FORMAT "%8.4"
 /begin AXIS_DESCR STD_AXIS Epm_nEng EngN 4 -16384.00 16383.50 FORMAT "%8.2" DEPOSIT ABSOLUTE /end AXIS_DESCR
/end CHARACTERISTIC
/begin CHARACTERISTIC AltIO_rErrSgn_C "Error sign of communication channel" VALUE 0x805057F0 Val_Ws16 799.9878 Prc -400.0000 399.9878 FORMAT "%8.4" READ_ONLY /end CHARACTERISTIC
/begin CHARACTERISTIC AltIO_tiACGFieDuty_C "Filter time constant for Alternator Duty cycle ACG generation" VALUE 0x8051BAB8 RB_Val_Ws32 4294.9672940000000 TimeDelay_s 0.0000020000000 4294.9672959999998 FORMAT "%19.14" EXTENDED_LIMITS 0.000002000000001 4294.9672959999998 /end CHARACTERISTIC
/begin CHARACTERISTIC AltIO_tiBattChrgLampOff_C "Delay time to turn off battery charge lamp after no error in ACG." VALUE 0x8051BABC RB_Val_Wu16 655.3500 Time_s 0.00 655.3500 FORMAT "%8.4" /end CHARACTERISTIC
/begin CHARACTERISTIC AltIO_tiISLampOffDly_C "Caliberation for IS lamp turn off delay" VALUE 0x8051BABE RB_Val_Wu16 655.3500 Time_s 0.00 655.3500 FORMAT "%8.4" /end CHARACTERISTIC
/begin CHARACTERISTIC AltIO_tThdACGTHi_C "Threshold temperature for detecting ACG High Temperature." VALUE 0x8051BAC0 RB_Val_Ws16 6553.500 Temp_Cels -3549.940 3003.560 FORMAT "%8.3" /end CHARACTERISTIC
/begin CHARACTERISTIC AltIO_uACGHealHiU_C "Threshold voltage for Healing System voltage High detection fault ." VALUE 0x8051BAC2 RB_Val_Ws16 1310700. Volt_Batt -655360.0 655340.0 FORMAT "%8.1" /end CHARACTERISTIC
/begin CHARACTERISTIC AltIO_uACGHealLoU_C "Threshold voltage for healing System voltage Low detection fault" VALUE 0x8051BAC4 RB_Val_Ws16 1310700. Volt_Batt -655360.0 655340.0 FORMAT "%8.1" /end CHARACTERISTIC
/begin CHARACTERISTIC AltIO_uACGHiVltg_C "Threshold voltage for System voltage High detection" VALUE 0x8051BAC6 RB_Val_Ws16 1310700. Volt_Batt -655360.0 655340.0 FORMAT "%8.1" /end CHARACTERISTIC
/begin CHARACTERISTIC AltIO_uACGLoVltg_C "Threshold voltage for System voltage Low detection" VALUE 0x8051BAC8 RB_Val_Ws16 1310700. Volt_Batt -655360.0 655340.0 FORMAT "%8.1" /end CHARACTERISTIC
/begin CHARACTERISTIC AltIO_uDconnACGThdLo_C "Lower threshold for ECU Voltage in detecting ACG disconnection" VALUE 0x8051BACA RB_Val_Ws16 1310700. Volt_Batt -655360.0 655340.0 FORMAT "%8.1" /end CHARACTERISTIC
/begin CHARACTERISTIC AltIO_uDesDconnACGThd_C "Threshold for ACG Output control request voltage in detecting ACG disconnection" VALUE 0x8051BACC RB_Val_Ws16 1310700. Volt_Batt -655360.0 655340.0 FORMAT "%8.1" /end CHARACTERISTIC
/begin CHARACTERISTIC AltIO_uDiscnctACGThdOk_C "Threshold value for battery voltage in healing ACG disconnection fault." VALUE 0x8051BACE RB_Val_Ws16 1310700. Volt_Batt -655360.0 655340.0 FORMAT "%8.1" /end CHARACTERISTIC
/begin CHARACTERISTIC ComAlt_iExctCrntOfs_C "Alternator excitation current offset" VALUE 0x8051BA96 RB_Val_Ws16 0.00 Curr 0.00 0.00 FORMAT "%8.2" EXTENDED_LIMITS -32768.00 32767.00 /end CHARACTERISTIC
/begin CHARACTERISTIC ComAlt_iExctCrntSlp_C "Alternator Excitation current slope" VALUE 0x8051BA98 RB_Val_Ws16 85.00000 OneToOne 40.0000 125.0000 FORMAT "%8.4" EXTENDED_LIMITS -32768.00 32767.00 /end CHARACTERISTIC
/begin CHARACTERISTIC ComAlt_rAltDycOfs_C "Alternator Duty cycle offset" VALUE 0x8051BA9A RB_Val_Ws16 0.00 Prc 0.00 0.00 FORMAT "%8.2" EXTENDED_LIMITS -400.0000 399.9878 /end CHARACTERISTIC
/begin CHARACTERISTIC ComAlt_rAltDycSlp_C "Alternator Duty cycle slope" VALUE 0x8051BA9C RB_Val_Ws16 8192.000 OneToOne 0.00 8192.000 FORMAT "%8.3" EXTENDED_LIMITS -32768.00 32767.00 /end CHARACTERISTIC
/begin CHARACTERISTIC ComAlt_tACGTempOfs_C "ACG temperature offset" VALUE 0x8051BA9E RB_Val_Ws16 0.00 TempDiff_Cels -40.00000 -40.00000 FORMAT "%8.5" EXTENDED_LIMITS -3276.800 3276.700 /end CHARACTERISTIC
/begin CHARACTERISTIC ComAlt_tACGTempSlp_C "ACG temperature slope" VALUE 0x8051BAA0 RB_Val_Ws16 0.00 OneToOne 1.000000 1.000000 FORMAT "%8.6" EXTENDED_LIMITS -32768.00 32767.00 /end CHARACTERISTIC
/begin CHARACTERISTIC ComAlt_tACGTempTypBMax_C "Maximum ACG temperature type B" VALUE 0x8051BAA2 RB_Val_Ws16 240.0000 Temp_Cels -40.0400 199.9600 FORMAT "%8.4" EXTENDED_LIMITS -3549.940 3003.560 /end CHARACTERISTIC
/begin CHARACTERISTIC ComAlt_tACGTempTypBMin_C "Minimum ACG temperature type B" VALUE 0x8051BAA4 RB_Val_Ws16 240.0000 Temp_Cels -40.0400 199.9600 FORMAT "%8.4" EXTENDED_LIMITS -3549.940 3003.560 /end CHARACTERISTIC
/begin CHARACTERISTIC CWAGRPSOL "code word of %AGRPSOL" VALUE 0x805083D0 RB_Val_Wu16 65535.00 dez 0.00 65535.00 FORMAT "%8.2" /end CHARACTERISTIC
/begin CHARACTERISTIC CWEVAB "codeword injection valve cutoff" VALUE 0x80506D20 RB_Val_Wu8 255.0 dez 0.00 255.0 FORMAT "%5.1" /end CHARACTERISTIC
/begin CHARACTERISTIC CWHFMPL "Codeword for deactivating the plausibility diagnosis of the AFS Sensor" VALUE 0x80506F7C RB_Val_Wu8 255.0 dez 0.00 255.0 FORMAT "%5.1" /end CHARACTERISTIC
/begin CHARACTERISTIC DENRRIESF "Diff. rate for release of desired value filt. of ext. residual exhaust gas rate" VALUE 0x805083D2 RB_Val_Ws16 199.9969 rel_sw_b100 -100.0000 99.9969 FORMAT "%8.4" EXTENDED_LIMITS -100.0000 99.99695 /end CHARACTERISTIC
/begin CHARACTERISTIC DMSHFM "Delta Massflow for MAF signal variation check" VALUE 0x80506F7E RB_Val_Ws16 6553.500 m_q0p1 -3276.800 3276.700 FORMAT "%8.3" /end CHARACTERISTIC
/begin CHARACTERISTIC FDMSHFMM "Factor difference of modeled HFM air mass flows" VALUE 0x80506F80 RB_Val_Wu16 1.999969 fak_uw_b2 0.00 1.999969 FORMAT "%8.6" /end CHARACTERISTIC
/begin CHARACTERISTIC FDMSHFMMFA "Factor difference of modeled HFM air mass flows for Condition function request" VALUE 0x80506F82 RB_Val_Wu16 1.999969 fak_uw_b2 0.00 1.999969 FORMAT "%8.6" /end CHARACTERISTIC
/begin CHARACTERISTIC FDMSHFMMH "Factor difference of modeled HFM air mass flows fo rHealing" VALUE 0x80506F84 RB_Val_Wu16 1.999969 fak_uw_b2 0.00 1.999969 FORMAT "%8.6" /end CHARACTERISTIC
/begin CHARACTERISTIC FDVAGR "factor temperature for flow through EGR valve" CURVE 0x805083D4 RB_Curve_U8_U8 1.992 fak_q0p0078 0.00 1.992 FORMAT "%5.3" READ_ONLY
 /begin AXIS_DESCR STD_AXIS tgagrv_msg temp_q6_o273 8 -273. 1257. FORMAT "%5.0" EXTENDED_LIMITS -273.1 1257. DEPOSIT ABSOLUTE /end AXIS_DESCR
/end CHARACTERISTIC
/begin CHARACTERISTIC FHFMTOLN "factor HFM tolerance for min value" VALUE 0x80506F86 RB_Val_Wu16 1.000000 fak_uw_b2 0.00 1.000000 FORMAT "%8.6" EXTENDED_LIMITS 0.00 1.999969 /end CHARACTERISTIC
/begin CHARACTERISTIC FHFMTOLX "factor HFM tolerance for max value" VALUE 0x80506F88 RB_Val_Wu16 0.9999695 fak_uw_b2 1.000000 1.999969 FORMAT "%8.6" EXTENDED_LIMITS 0.00 1.999969 /end CHARACTERISTIC
/begin CHARACTERISTIC FKBLAGRA "factor correction egr mass flow line - calibration value" VALUE 0x805083E5 RB_Val_Wu8 1.992188 fak_ub_b2 0.00 1.992188 FORMAT "%8.6" /end CHARACTERISTIC
/begin CHARACTERISTIC FKGMSAGRPV "weighting factor of egr mass flow for calculation of pressure downstream valve" VALUE 0x805083E6 RB_Val_Wu8 0.9961 fak_q0p0039 0.00 0.9961 /end CHARACTERISTIC
/begin CHARACTERISTIC IMG_CHFMR "IUMPR-group of HFM-rationality-monitor" VALUE 0x80506F8A RB_Val_Wu8 64.0000000000 iumpr_img_verbal 0.00 64.0000000000 FORMAT "%13.10" /end CHARACTERISTIC
/begin CHARACTERISTIC InjSys_FcoCylInd_ATS_ATS.LimitTypeMsk_C "Actuator test InjSys_FcoCylInd_ATS_ATS / Tester demand monitoring enable mask for actuators" VALUE 0x8058AE4C Val_Wu8 255.0 OneToOne 0.00 255.0 FORMAT "%5.1" /end CHARACTERISTIC
/begin CHARACTERISTIC InjSys_FcoCylInd_ATS_ATS.CnvNorm_C "Actuator test InjSys_FcoCylInd_ATS_ATS / Conversion norm used for conversion to/from internal scaling" VALUE 0x8058AE4D Val_Wu8 255.0 OneToOne 0.00 255.0 FORMAT "%5.1" /end CHARACTERISTIC
/begin CHARACTERISTIC InjSys_FcoCylInd_ATS_ATS.LowLim_C "Actuator test InjSys_FcoCylInd_ATS_ATS / Lower limit for monitoring" VALUE 0x8058AE4E Val_Ws16 65535.00 dez -32768.00 32767.00 FORMAT "%8.2" /end CHARACTERISTIC
/begin CHARACTERISTIC InjSys_FcoCylInd_ATS_ATS.UpLim_C "Actuator test InjSys_FcoCylInd_ATS_ATS / Upper limit for monitoring" VALUE 0x8058AE50 Val_Ws16 65535.00 dez -32768.00 32767.00 FORMAT "%8.2" /end CHARACTERISTIC
/begin CHARACTERISTIC InjSys_FcoCylInd_ATS_ATS.CnvFac_C "Actuator test InjSys_FcoCylInd_ATS_ATS / Factor used for conversion to/from internal scaling" VALUE 0x8058AE54 Val_Ws32 4294967295.00 OneToOne -2147483648.00 2147483647.00 FORMAT "%13.2" /end CHARACTERISTIC
/begin CHARACTERISTIC InjSys_FcoCylInd_ATS_ATS.CnvOfs_C "Actuator test InjSys_FcoCylInd_ATS_ATS / Offset used for conversion to/from internal scaling" VALUE 0x8058AE58 Val_Ws16 65535.00 OneToOne -32768.00 32767.00 FORMAT "%8.2" /end CHARACTERISTIC
/begin CHARACTERISTIC InjSys_FcoCylInd_ATS_ATS.DfltVal_C "Actuator test InjSys_FcoCylInd_ATS_ATS / Default value for standbytest" VALUE 0x8058AE5A Val_Ws16 65535.00 OneToOne -32768.00 32767.00 FORMAT "%8.2" /end CHARACTERISTIC
/begin CHARACTERISTIC KFAPMSNVP "Map EGR mass flow via valve opening" MAP 0x805083E8 RB_Map_U16U16_U16 99.99847 rel_uw_b100 0.00 99.99847 FORMAT "%8.5"
 /begin AXIS_DESCR STD_AXIS msnagrs_w_msg m_q0p1 15 0.00 6553.500 FORMAT "%8.3" DEPOSIT ABSOLUTE /end AXIS_DESCR
 /begin AXIS_DESCR STD_AXIS vpsvagb_w_msg fak_q3p0518Em5 4 0.00 1.999969 FORMAT "%8.6" DEPOSIT ABSOLUTE /end AXIS_DESCR
/end CHARACTERISTIC
/begin CHARACTERISTIC KFVPVASRMX "max. pressure ratio between man. pressure and exhaust pressure" MAP 0x8050848A RB_Map_S16U16_U16 1.999969 fak_q3p0518Em5 0.00 1.999969 FORMAT "%8.6"
 /begin AXIS_DESCR STD_AXIS Epm_nEng EngN 8 -16384.00 16383.50 FORMAT "%8.2" DEPOSIT ABSOLUTE /end AXIS_DESCR
 /begin AXIS_DESCR STD_AXIS miglsol_w_msg rel_uw_b100 8 0.00 99.99847 FORMAT "%8.5" DEPOSIT ABSOLUTE /end AXIS_DESCR
/end CHARACTERISTIC
/begin CHARACTERISTIC KLWBLAGR "characteristic line mass flow resistance egr" CURVE 0x8050852E RB_Curve_U16_U16 31.99951 fak_uw_b32 0.00 31.99951 FORMAT "%8.5"
 /begin AXIS_DESCR STD_AXIS fkblagrz_w fak_uw_b2 8 0.00 1.999969 FORMAT "%8.6" DEPOSIT ABSOLUTE /end AXIS_DESCR
/end CHARACTERISTIC
/begin CHARACTERISTIC NHFMSVMN "engine speed threshold for minimal MAF air flow" VALUE 0x80506F8C RB_Val_Ws16 32767.50 EngN -16384.00 16383.50 FORMAT "%8.2" /end CHARACTERISTIC
/begin CHARACTERISTIC NHFMSVMX "engine speed threshold for maximal MAF air flow" VALUE 0x80506F8E RB_Val_Ws16 32767.50 EngN -16384.00 16383.50 FORMAT "%8.2" /end CHARACTERISTIC
/begin CHARACTERISTIC RLRDAGRS "Relative des. charge by external AGR for diagnosis" VALUE 0x80508550 RB_Val_Wu16 1535.977 rel_uw_q0p0234 0.00 1535.977 FORMAT "%8.3" /end CHARACTERISTIC
/begin CHARACTERISTIC SF_DSS "Sum Fault DSS" VAL_BLK 0x80506D10 RB_ValA_Wu16 82.0000000000 dfp_verbal 0.00 82.0000000000 FORMAT "%13.10" READ_ONLY NUMBER 3 /end CHARACTERISTIC
/begin CHARACTERISTIC SF_DSU "Sum Fault ambient pressure sensor (DSU)" VAL_BLK 0x80506D16 RB_ValA_Wu16 82.0000000000 dfp_verbal 0.00 82.0000000000 FORMAT "%13.10" READ_ONLY NUMBER 3 /end CHARACTERISTIC
/begin CHARACTERISTIC TDEHFMPL "debounce time for plausibility fault detection air-mass meter" VALUE 0x80506F90 RB_Val_Wu8 25.50 t_q0p1 0.00 25.50 FORMAT "%5.2" /end CHARACTERISTIC
/begin CHARACTERISTIC TDMLHFM "Delay time for setting the bit B_hfm" VALUE 0x80506F92 RB_Val_Wu16 1310.700 t_q0p02 0.00 1310.700 FORMAT "%8.3" /end CHARACTERISTIC
/begin CHARACTERISTIC WDKHFMSVMN "throttle angle threshold for minimal MAF air flow" VALUE 0x80506F94 RB_Val_Ws16 511.9922 rel_q0p0078125 -256.0000 255.9922 FORMAT "%8.4" /end CHARACTERISTIC
/begin CHARACTERISTIC WDKHFMSVMX "throttle angle threshold for maximal MAF air flow" VALUE 0x80506F96 RB_Val_Ws16 511.9922 rel_q0p0078125 -256.0000 255.9922 FORMAT "%8.4" /end CHARACTERISTIC
/begin CHARACTERISTIC ZKRRIEHSF "Time constant.:desired value filter. external residual exhaust gas rate/HOM-mode" VALUE 0x80508552 RB_Val_Wu16 655.34999985 zk10msxs_uw_b655p36 0.01000015 655.36000000 FORMAT "%12.8" EXTENDED_LIMITS 0.010000152590 655.36000000 /end CHARACTERISTIC
/*********** End of merged MEASUREMENT blocks ***********/
/begin MEASUREMENT abmf_msg "injection cut off pattern at fixed position" UBYTE dez 1 100 0.00 255.0 FORMAT "%5.1" ECU_ADDRESS 0x7000366A /end MEASUREMENT
/begin MEASUREMENT abmm "Injection Cutoff pattern for Torque Reduction" UBYTE dez 1 100 0.00 255.0 FORMAT "%5.1" ECU_ADDRESS 0x70003271 /end MEASUREMENT
/begin MEASUREMENT ACCtl_drAccPedStrtCut "Acceleration pedal position deviation for AC shut off at vehicle start condition" SWORD Prc 1 100 -400.0000 399.9878 FORMAT "%8.4" ECU_ADDRESS 0x60008290 /end MEASUREMENT
/begin MEASUREMENT ACCtl_facACLoPDwnCorrVal_MP "AC compressor control current correction value" SLONG Fact1000 1 100 -2147483.64800 2147483.64700 FORMAT "%13.5" ECU_ADDRESS 0x7000A8C4 /end MEASUREMENT
/begin MEASUREMENT ACCtl_facACTqDwnCorrVal_MP "AC torque down control value correction factor" SLONG RBPtCel_Tq2Fact_q0p001 1 100 -2147483.64800 2147483.64700 FORMAT "%13.5" ECU_ADDRESS 0x7000A8C0 /end MEASUREMENT
/begin MEASUREMENT ACCtl_flgACCutEnaCdn "AC cut Enable condition flag" UBYTE B_TRUE 1 100 0.00 1.00000000000 BIT_MASK 0x1 FORMAT "%13.11" ECU_ADDRESS 0x6000F22B /end MEASUREMENT
/begin MEASUREMENT Acctl_flgACCutEnaSts "flag for AC cut enable status" UBYTE B_TRUE 1 100 0.00 1.00000000000 BIT_MASK 0x1 FORMAT "%13.11" ECU_ADDRESS 0x6000F22A /end MEASUREMENT
/begin MEASUREMENT ACCtl_flgACCutExe "AC cut execution flag" UBYTE B_TRUE 1 100 0.00 1.00000000000 BIT_MASK 0x1 FORMAT "%13.11" ECU_ADDRESS 0x6000F229 /end MEASUREMENT
/begin MEASUREMENT ACCtl_flgAcCutOperRep "Flag indicate AC cut and operate repeat during uphill" UBYTE B_TRUE 1 100 0.00 1.00000000000 BIT_MASK 0x1 FORMAT "%13.11" ECU_ADDRESS 0x6000F228 /end MEASUREMENT
/begin MEASUREMENT ACCtl_flgACCutPrms "AC cut permission judgement flag" UBYTE B_TRUE 1 100 0.00 1.00000000000 BIT_MASK 0x1 FORMAT "%13.11" ECU_ADDRESS 0x6000FB0F /end MEASUREMENT
/begin MEASUREMENT ACCtl_flgAcCutStep2Prfm "AC cut during hill climbing step 2 aquisition" UBYTE B_TRUE 1 100 0.00 1.00000000000 BIT_MASK 0x1 FORMAT "%13.11" ECU_ADDRESS 0x6000F227 /end MEASUREMENT
/begin MEASUREMENT ACCtl_flgACDwnExe "AC Torque down execution flag" UBYTE B_TRUE 1 100 0.00 1.00000000000 BIT_MASK 0x1 FORMAT "%13.11" ECU_ADDRESS 0x6000FB0E /end MEASUREMENT
/begin MEASUREMENT ACCtl_flgACOnCdnTCU "AC On Condition to TCU" UBYTE B_TRUE 1 100 0.00 1.00000000000 BIT_MASK 0x1 FORMAT "%13.11" ECU_ADDRESS 0x6000FB0D /end MEASUREMENT
/begin MEASUREMENT ACCtl_flgACReq "Status flag for AC Request." UBYTE B_TRUE 1 100 0.00 1.00000000000 BIT_MASK 0x1 FORMAT "%13.11" ECU_ADDRESS 0x70000C58 /end MEASUREMENT
/begin MEASUREMENT ACCtl_flgAcShOffImdt "AC forcibly shut off condition" UBYTE B_TRUE 1 100 0.00 1.00000000000 BIT_MASK 0x1 FORMAT "%13.11" ECU_ADDRESS 0x6000F226 /end MEASUREMENT
/begin MEASUREMENT ACCtl_flgClmbAcCut "Hill climbing AC shut off condition" UBYTE B_TRUE 1 100 0.00 1.00000000000 BIT_MASK 0x1 FORMAT "%13.11" ECU_ADDRESS 0x6000F225 /end MEASUREMENT
/begin MEASUREMENT ACCtl_flgClr "FCM clear flag for acctl_demand" UBYTE B_TRUE 1 100 0.00 1.00000000000 BIT_MASK 0x1 FORMAT "%13.11" ECU_ADDRESS 0x6000F70F /end MEASUREMENT
/begin MEASUREMENT ACCtl_flgDecelACCut "Deceleration AC CUT enforcement" UBYTE B_TRUE 1 100 0.00 1.00000000000 BIT_MASK 0x1 FORMAT "%13.11" ECU_ADDRESS 0x6000FB0C /end MEASUREMENT
/begin MEASUREMENT ACCtl_flgEngTqDwnReq "Enigne Torque Down request flag" UBYTE B_TRUE 1 100 0.00 1.00000000000 BIT_MASK 0x1 FORMAT "%13.11" ECU_ADDRESS 0x6000FB0B /end MEASUREMENT
/begin MEASUREMENT ACCtl_flgEngTqDwnReqEna "Engine Torque down request enable flag" UBYTE B_TRUE 1 100 0.00 1.00000000000 BIT_MASK 0x1 FORMAT "%13.11" ECU_ADDRESS 0x6000F224 /end MEASUREMENT
/begin MEASUREMENT ACCtl_flgGearShiftDetd "AC ON delay requirement flag when detect gear shifting" UBYTE B_TRUE 1 100 0.00 1.00000000000 BIT_MASK 0x1 FORMAT "%13.11" ECU_ADDRESS 0x6000F223 /end MEASUREMENT
/begin MEASUREMENT ACCtl_flgGearShiftDetdLst "The last value of ACCtl_flgGearShiftDetd" UBYTE B_TRUE 1 100 0.00 1.00000000000 BIT_MASK 0x1 FORMAT "%13.11" ECU_ADDRESS 0x6000FB0A /end MEASUREMENT
/begin MEASUREMENT ACCtl_flgHillClmbDet "AC cut during hill climbing step 1 aquisition" UBYTE B_TRUE 1 100 0.00 1.00000000000 BIT_MASK 0x1 FORMAT "%13.11" ECU_ADDRESS 0x6000F222 /end MEASUREMENT
/begin MEASUREMENT ACCtl_flgLoEngNShOff "AC shut off condition at low engine speed" UBYTE B_TRUE 1 100 0.00 1.00000000000 BIT_MASK 0x1 FORMAT "%13.11" ECU_ADDRESS 0x6000F221 /end MEASUREMENT
/begin MEASUREMENT ACCtl_flgMgcOn "Magnet clutch relay on request flag" UBYTE B_TRUE 1 100 0.00 1.00000000000 BIT_MASK 0x1 FORMAT "%13.11" ECU_ADDRESS 0x6000FB09 /end MEASUREMENT
/begin MEASUREMENT ACCtl_flgMgcOnDly "Magnet clutch relay delay on request flag" UBYTE B_TRUE 1 100 0.00 1.00000000000 BIT_MASK 0x1 FORMAT "%13.11" ECU_ADDRESS 0x6000F220 /end MEASUREMENT
/begin MEASUREMENT ACCtl_flgSnsrErrStrtCut "AC shut off at vehicle start inhibit condition at sensor defect" UBYTE B_TRUE 1 100 0.00 1.00000000000 BIT_MASK 0x1 FORMAT "%13.11" ECU_ADDRESS 0x6000FB08 /end MEASUREMENT
/begin MEASUREMENT ACCtl_flgStrtCut "AC shut off condition at vehicle start" UBYTE B_TRUE 1 100 0.00 1.00000000000 BIT_MASK 0x1 FORMAT "%13.11" ECU_ADDRESS 0x6000F21F /end MEASUREMENT
/begin MEASUREMENT ACCtl_flgStrtCutHi "AC shut off at vehicle start condition activation state in the case of large acceleration pedal position" UBYTE B_TRUE 1 100 0.00 1.00000000000 BIT_MASK 0x1 FORMAT "%13.11" ECU_ADDRESS 0x6000F21E /end MEASUREMENT
/begin MEASUREMENT ACCtl_flgStrtCutInhb "AC shut off at vehicle start inhibit condition by vehicle speed condition" UBYTE B_TRUE 1 100 0.00 1.00000000000 BIT_MASK 0x1 FORMAT "%13.11" ECU_ADDRESS 0x6000F21D /end MEASUREMENT
/begin MEASUREMENT ACCtl_flgStrtgCpDwnAccrPedl "Accelerator pedel Starting capacity down flag" UBYTE B_TRUE 1 100 0.00 1.00000000000 BIT_MASK 0x1 FORMAT "%13.11" ECU_ADDRESS 0x6000F21C /end MEASUREMENT
/begin MEASUREMENT ACCtl_flgSwOffResv "Flag of AC off torque reserve" UBYTE B_TRUE 1 100 0.00 1.00000000000 BIT_MASK 0x1 FORMAT "%13.11" ECU_ADDRESS 0x6000FB07 /end MEASUREMENT
/begin MEASUREMENT ACCtl_flgSwtAcAndCutCdn "AC switch status and AC shut off condition for AC control" UBYTE B_TRUE 1 100 0.00 1.00000000000 BIT_MASK 0x1 FORMAT "%13.11" ECU_ADDRESS 0x6000FB06 /end MEASUREMENT
/begin MEASUREMENT ACCtl_flgVehSpdAcCut "Driving conditions for hill climbing AC cut" UBYTE B_TRUE 1 100 0.00 1.00000000000 BIT_MASK 0x1 FORMAT "%13.11" ECU_ADDRESS 0x6000F21B /end MEASUREMENT
/begin MEASUREMENT ACCtl_flgVehSpdDetClmb "Detection of hill climb base on vehicle speed." UBYTE B_TRUE 1 100 0.00 1.00000000000 BIT_MASK 0x1 FORMAT "%13.11" ECU_ADDRESS 0x6000F21A /end MEASUREMENT
/begin MEASUREMENT ACCtl_iCmprDwnIReq "AC compressor down current request" UBYTE RBPtCel_Curr_A_q0p005 1 100 0.00 1.275 FORMAT "%5.3" ECU_ADDRESS 0x6000FFF0 /end MEASUREMENT
/begin MEASUREMENT ACCtl_iCmprDwnIReqVal "AC compressor down current request value" SWORD RBPtCel_Curr_mA_q0p01 1 100 -3276.800 3276.700 FORMAT "%8.3" ECU_ADDRESS 0x6000828E /end MEASUREMENT
/begin MEASUREMENT ACCtl_nrAccPedSt "Acceleration pedal state for vehicle start AC shut off condition" UBYTE OneToOne 1 100 0.00 255.0 FORMAT "%5.1" ECU_ADDRESS 0x6000F219 /end MEASUREMENT
/begin MEASUREMENT ACCtl_nrACCutPrms "AC cut permission count" SWORD OneToOne 1 100 -32768.00 32767.00 FORMAT "%8.2" ECU_ADDRESS 0x60009C7C /end MEASUREMENT
/begin MEASUREMENT ACCtl_pACLoPDwnCorrVal_MP "AC low pressure down correction value" SLONG RBPtCel_p_1p0_1 1 100 -2147483648.00 2147483647.00 FORMAT "%13.2" ECU_ADDRESS 0x7000A8BC /end MEASUREMENT
/begin MEASUREMENT ACCtl_pACLoPFinalVal_MP "AC low pressure final value" SLONG RBPtCel_p_1p0_1 1 100 -2147483648.00 2147483647.00 FORMAT "%13.2" ECU_ADDRESS 0x7000A8B8 /end MEASUREMENT
/begin MEASUREMENT ACCtl_pTqDwnLoPVal "AC low pressure value during torque down" SWORD RBPtCel_p_1p0_1 1 100 -32768.00 32767.00 FORMAT "%8.2" ECU_ADDRESS 0x6000828C /end MEASUREMENT
/begin MEASUREMENT ACCtl_rAppSig "accelerator pedal value after switch" SWORD Prc 1 100 -400.0000 399.9878 FORMAT "%8.4" ECU_ADDRESS 0x60009C7A /end MEASUREMENT
/begin MEASUREMENT ACCtl_stACCut "Status of Air Conditioner Cut." SWORD OneToOne 1 100 -32768.00 32767.00 FORMAT "%8.2" ECU_ADDRESS 0x60009C78 /end MEASUREMENT
/begin MEASUREMENT ACCtl_stDecelACCutDmdRst "Deceleration AC CUT demand reset value" UBYTE B_TRUE 1 100 0.00 1.00000000000 BIT_MASK 0x1 FORMAT "%13.11" ECU_ADDRESS 0x6000F218 /end MEASUREMENT
/begin MEASUREMENT ACCtl_stDecelACCutPrms "Deceleration AC CUT permission time" UBYTE B_TRUE 1 100 0.00 1.00000000000 BIT_MASK 0x1 FORMAT "%13.11" ECU_ADDRESS 0x6000F217 /end MEASUREMENT
/begin MEASUREMENT ACCtl_stEngFullOpenSts "Engine full open status" UBYTE B_TRUE 1 100 0.00 1.00000000000 BIT_MASK 0x1 FORMAT "%13.11" ECU_ADDRESS 0x6000F216 /end MEASUREMENT
/begin MEASUREMENT ACCtl_stEvapTACShOff_mp "Measuring point indicating the status of Evaporator Temperature AC shut off condition" UBYTE B_TRUE 1 100 0.00 1.00000000000 BIT_MASK 0x1 FORMAT "%13.11" ECU_ADDRESS 0x7000A8B6 /end MEASUREMENT
/begin MEASUREMENT ACCtl_stFinshdACCutEnf "Finishing status of the Deceleration AC CUT enforcement" UBYTE B_TRUE 1 100 0.00 1.00000000000 BIT_MASK 0x1 FORMAT "%13.11" ECU_ADDRESS 0x6000F215 /end MEASUREMENT
/begin MEASUREMENT ACCtl_stInhbACCutPrms "AC cut premission inhibit status" UBYTE B_TRUE 1 100 0.00 1.00000000000 BIT_MASK 0x1 FORMAT "%13.11" ECU_ADDRESS 0x6000F214 /end MEASUREMENT
/begin MEASUREMENT ACCtl_stInhbACCutPrmsACOn "AC cut premission on inhibit status" UBYTE B_TRUE 1 100 0.00 1.00000000000 BIT_MASK 0x1 FORMAT "%13.11" ECU_ADDRESS 0x6000F213 /end MEASUREMENT
/begin MEASUREMENT ACCtl_stMagCluFall "Magnet clutch falling edge status" UBYTE B_TRUE 1 100 0.00 1.00000000000 BIT_MASK 0x1 FORMAT "%13.11" ECU_ADDRESS 0x6000F212 /end MEASUREMENT
/begin MEASUREMENT ACCtl_stOut "Air condition Compressor status" UBYTE OneToOne 1 100 0.00 255.0 FORMAT "%5.1" ECU_ADDRESS 0x50006064 /end MEASUREMENT
/begin MEASUREMENT ACCtl_stOut_tmp "Temporary bit of application parameter for Air condition status" UBYTE B_TRUE 1 100 0.00 1.00000000000 BIT_MASK 0x1 FORMAT "%13.11" ECU_ADDRESS 0x6000F211 /end MEASUREMENT
/begin MEASUREMENT ACCtl_stShOffCdn "AC cut off condition" UWORD OneToOne 1 100 0.00 65535.00 FORMAT "%8.2" ECU_ADDRESS 0x6000828A /end MEASUREMENT
/begin MEASUREMENT ACCtl_stShOffCdnSlow "AC cut off condition 100ms task" UWORD OneToOne 1 100 0.00 65535.00 FORMAT "%8.2" ECU_ADDRESS 0x60008FAA /end MEASUREMENT
/begin MEASUREMENT ACCtl_stSwtAc "AC switch state for AC control" UBYTE OneToOne 1 100 0.00 255.0 FORMAT "%5.1" ECU_ADDRESS 0x6000FFEF /end MEASUREMENT
/begin MEASUREMENT ACCtl_stSwtACRisng "AC switch rising edge status" UBYTE B_TRUE 1 100 0.00 1.00000000000 BIT_MASK 0x1 FORMAT "%13.11" ECU_ADDRESS 0x6000F210 /end MEASUREMENT
/begin MEASUREMENT ACCtl_stTrqResv "Status of Air Condition reserve torque calculation request" UBYTE OneToOne 1 100 0.00 255.0 FORMAT "%5.1" ECU_ADDRESS 0x6000FFEE /end MEASUREMENT
/begin MEASUREMENT ACCtl_stTrqResv_tmp "Temporary bit for status of AC reserve torque calculation request" UBYTE B_TRUE 1 100 0.00 1.00000000000 BIT_MASK 0x1 FORMAT "%13.11" ECU_ADDRESS 0x6000F20F /end MEASUREMENT
/begin MEASUREMENT ACCtl_tEvapACCutHi_MP "Measurement Point to check the high side AC temperature." SWORD Temp_Cels 1 100 -3549.940 3003.560 FORMAT "%8.3" ECU_ADDRESS 0x7000A8B4 /end MEASUREMENT
/begin MEASUREMENT ACCtl_tEvapACCutLo_MP "Measurement Point to check the low side AC temperature." SWORD Temp_Cels 1 100 -3549.940 3003.560 FORMAT "%8.3" ECU_ADDRESS 0x7000A8B2 /end MEASUREMENT
/begin MEASUREMENT ACCtl_tiACCmprTqReqTi "AC compressor Torque Request time" SWORD Time_s 1 100 -327.6800 327.6700 FORMAT "%8.4" ECU_ADDRESS 0x60008288 /end MEASUREMENT
/begin MEASUREMENT ACCtl_tiACCpTqReqTmr "AC capactiy torque request timer" SLONG Time_s 1 100 -21474836.4800 21474836.4700 FORMAT "%13.4" ECU_ADDRESS 0x60003248 /end MEASUREMENT
/begin MEASUREMENT ACCtl_tiAcCutOperRepDly "Uphill AC cut then operate repeating delay time" SWORD t_q0p01 1 100 0.00 327.6700 FORMAT "%8.4" ECU_ADDRESS 0x60008286 /end MEASUREMENT
/begin MEASUREMENT ACCtl_tiClmbSpdThdDly "Uphill AC cut base on vehicle speed delay time" SWORD t_q0p01 1 100 0.00 327.6700 FORMAT "%8.4" ECU_ADDRESS 0x60008284 /end MEASUREMENT
/begin MEASUREMENT ACCtl_tiClntTmr "Vehicle start AC shut off time threshold calculated by AC pressure" SWORD t_q0p01 1 100 -327.6800 327.6700 FORMAT "%8.4" ECU_ADDRESS 0x60008282 /end MEASUREMENT
/begin MEASUREMENT ACCtl_tiDecelACCutEnf "time for Deceleration AC cut Enforcement" UWORD t_q0p01 1 100 0.00 655.3500 FORMAT "%8.4" ECU_ADDRESS 0x60008280 /end MEASUREMENT
/begin MEASUREMENT ACCtl_tiStrtCutTmr "ACCtl_tiStrtCutTmr" UWORD t_q0p01 1 100 0.00 655.3500 FORMAT "%8.4" ECU_ADDRESS 0x6000827E /end MEASUREMENT
/begin MEASUREMENT ACCtl_tiStrtCutTmrCdn "Vehicle start AC shut off time threshold" SWORD t_q0p01 1 100 -327.6800 327.6700 FORMAT "%8.4" ECU_ADDRESS 0x6000827C /end MEASUREMENT
/begin MEASUREMENT ACCtl_tiStrtCutTmrCdnTmp "Temporary variable for Vehicle start AC shut off time threshold" SWORD t_q0p01 1 100 -327.6800 327.6700 FORMAT "%8.4" ECU_ADDRESS 0x6000827A /end MEASUREMENT
/begin MEASUREMENT ACCtl_tqACCmprReqTqAPOpng "AC compressor request torque during Accelerator pedel opening" SWORD Trq 1 100 -3276.800 3276.700 FORMAT "%8.3" ECU_ADDRESS 0x60008278 /end MEASUREMENT
/begin MEASUREMENT ACCtl_tqACDecelReq "AC torque request during deceleration" SWORD Trq 1 100 -3276.800 3276.700 FORMAT "%8.3" ECU_ADDRESS 0x60008276 /end MEASUREMENT
/begin MEASUREMENT ACCtl_tqACDecelReqVal "AC torque request value during deceleration" SWORD Trq 1 100 -3276.800 3276.700 FORMAT "%8.3" ECU_ADDRESS 0x60009C76 /end MEASUREMENT
/begin MEASUREMENT ACCtl_tqACDwnDurgStrt "AC torque down during engine start" SWORD Trq 1 100 -3276.800 3276.700 FORMAT "%8.3" ECU_ADDRESS 0x60009C74 /end MEASUREMENT
/begin MEASUREMENT ACCtl_tqDwnDurgDecel "AC torque down during deceleration" SWORD Trq 1 100 -3276.800 3276.700 FORMAT "%8.3" ECU_ADDRESS 0x60009C72 /end MEASUREMENT
/begin MEASUREMENT ACEvpT_t "AC Evaporator temperature" SWORD Temp_Cels 1 100 -3549.940 3003.560 FORMAT "%8.3" ECU_ADDRESS 0x60009E16 /end MEASUREMENT
/begin MEASUREMENT ACEvpT_tAvg "Average AC Evaporator tem-perature" SWORD Temp_Cels 1 100 -3549.940 3003.560 FORMAT "%8.3" ECU_ADDRESS 0x60009E14 /end MEASUREMENT
/begin MEASUREMENT ACEvpT_uRaw "Raw ADC value of AC Evaporator temperature sensor signal" SWORD Volt 1 100 -6553.600 6553.400 FORMAT "%8.3" ECU_ADDRESS 0x60009E12 /end MEASUREMENT
/begin MEASUREMENT ACSwt_ValSwtflg_MP "Val switch flag measuring point" UBYTE OneToOne 1 100 0.00 255.0 FORMAT "%5.1" ECU_ADDRESS 0x7000A8B0 /end MEASUREMENT
/begin MEASUREMENT ActMod_pwrCrksft "Actual engine power at crankshaft level" SWORD Pwr2 1 100 -617662.2 617643.4 FORMAT "%8.1" ECU_ADDRESS 0x60014770 /end MEASUREMENT
/begin MEASUREMENT ActMod_pwrInr "Actual internal engine power" SWORD Pwr2 1 100 -617662.2 617643.4 FORMAT "%8.1" ECU_ADDRESS 0x60014772 /end MEASUREMENT
/begin MEASUREMENT ActMod_stTrgFCO10_2 "Statusword to trigger the cylinder individual cut-off" UWORD OneToOne 1 100 0.00 65535.00 FORMAT "%8.2" ECU_ADDRESS 0x50005C8E /end MEASUREMENT
/begin MEASUREMENT ActMod_stTrgFCO10_3 "Statusword to trigger the cylinder individual cut-off" UWORD OneToOne 1 100 0.00 65535.00 FORMAT "%8.2" ECU_ADDRESS 0x60014774 /end MEASUREMENT
/begin MEASUREMENT ActMod_stTrgFCOsyn "Statusword to trigger the cylinder individual cut-off" UWORD OneToOne 1 100 0.00 65535.00 FORMAT "%8.2" ECU_ADDRESS 0x60000636 /end MEASUREMENT
/begin MEASUREMENT ActMod_stTrgFCOsyns "Statusword to trigger the cylinder individual cut-off" UWORD OneToOne 1 100 0.00 65535.00 FORMAT "%8.2" ECU_ADDRESS 0x60000638 /end MEASUREMENT
/begin MEASUREMENT ActMod_trqClthWoDstC "actual engine torque without anti-jerk intervention - clutch torque" SWORD md_q0p1 1 100 -3276.800 3276.700 FORMAT "%8.3" ECU_ADDRESS 0x50005C90 /end MEASUREMENT
/begin MEASUREMENT ActMod_trqClthWoIntv "actual engine torque without interventions - clutch torque level" SWORD md_q0p1 1 100 -3276.800 3276.700 FORMAT "%8.3" ECU_ADDRESS 0x7000535A /end MEASUREMENT
/begin MEASUREMENT ActMod_trqClthWoTraIntv "actual engine torque without transmission interventions - clutch torque" SWORD md_q0p1 1 100 -3276.800 3276.700 FORMAT "%8.3" ECU_ADDRESS 0x60009C00 /end MEASUREMENT
/begin MEASUREMENT ActMod_trqCrSWoDstC "actual engine torque without anti-jerk intervention - crankshaft torque" SWORD md_q0p1 1 100 -3276.800 3276.700 FORMAT "%8.3" ECU_ADDRESS 0x60009BFE /end MEASUREMENT
/begin MEASUREMENT ActMod_trqCrSWoIntv "Crankshaft torque without interventions" SWORD md_q0p1 1 100 -3276.800 3276.700 FORMAT "%8.3" ECU_ADDRESS 0x60014776 /end MEASUREMENT
/begin MEASUREMENT ActMod_trqCrSWoTraIntv "actual engine torque without transmission interventions - crankshaft torque" SWORD md_q0p1 1 100 -3276.800 3276.700 FORMAT "%8.3" ECU_ADDRESS 0x60014778 /end MEASUREMENT
/begin MEASUREMENT ActMod_trqInrWoDstC "actual engine torque without anti-jerk Intervention - inner torque" SWORD md_q0p1 1 100 0.00 3276.700 FORMAT "%8.3" ECU_ADDRESS 0x6001477A /end MEASUREMENT
/begin MEASUREMENT ActMod_trqInrWoIntv "actual engine torque without external interventions - inner torque" SWORD md_q0p1 1 100 0.00 3276.700 FORMAT "%8.3" ECU_ADDRESS 0x60009BFC /end MEASUREMENT
/begin MEASUREMENT ActMod_trqInrWoTraIntv "Engine torque without torque intervention - inner torque" SWORD md_q0p1 1 100 0.00 3276.700 FORMAT "%8.3" ECU_ADDRESS 0x60009BFA /end MEASUREMENT
/begin MEASUREMENT AC_trqMaxAC "Application parameter for Allowed compressor torque load" SWORD Trq 1 100 -3276.800 3276.700 FORMAT "%8.3" ECU_ADDRESS 0x60009C70 /end MEASUREMENT
/begin MEASUREMENT AFS_cntRawSmplB1 "Counter for the averaging in the HFM signal processing" UWORD OneToOne 1 100 0.00 65535.00 FORMAT "%8.2" ECU_ADDRESS 0x500006DC /end MEASUREMENT
/begin MEASUREMENT AFS_cntrReIniDiag100ms "Counter value for reini of 100ms" UBYTE OneToOne 1 100 0.00 255.0 FORMAT "%5.1" ECU_ADDRESS 0x6000F89F /end MEASUREMENT
/begin MEASUREMENT AFS_cntrReIniDiag20ms "Counter value for reini of 20ms" UBYTE OneToOne 1 100 0.00 255.0 FORMAT "%5.1" ECU_ADDRESS 0x6000F20C /end MEASUREMENT
/begin MEASUREMENT AFS_cntSigErrB1 "Rolling error counter incremented in case HFM signal is invalid" UWORD OneToOne 1 100 0.00 65535.00 FORMAT "%8.2" ECU_ADDRESS 0x500006DE /end MEASUREMENT
/begin MEASUREMENT AFS_facDeltaMFlowThrVlv "Gradient of the air mass flow over the throttle valve" UWORD fak_uw_b2 1 100 0.00 1.999969 FORMAT "%8.6" ECU_ADDRESS 0x60000564 /end MEASUREMENT
/begin MEASUREMENT AFS_facPlstCorrn "HFM pulsation correction factor" UWORD fak_q6p1035Em5 1 100 0.00 3.999939 FORMAT "%8.6" ECU_ADDRESS 0x60014768 /end MEASUREMENT
/begin MEASUREMENT AFS_facPlstCorrnCold_MP "Measurement point HFM pulsation correction factor cold conditions" UWORD fak_uw_b4 1 100 0.00 3.999939 FORMAT "%8.6" ECU_ADDRESS 0x7000A8AE /end MEASUREMENT
/begin MEASUREMENT AFS_facPlstCorrn_MP "Measurement point HFM pulsation correction factor" UWORD fak_uw_b4 1 100 0.00 3.999939 FORMAT "%8.6" ECU_ADDRESS 0x7000A8AC /end MEASUREMENT
/begin MEASUREMENT AFS_facPlstInflDev1 "Factor pulsation influence of adjustment element 1" UBYTE fak_ub_b1 1 100 0.00 0.9961 ECU_ADDRESS 0x6000F20B /end MEASUREMENT
/begin MEASUREMENT AFS_facPlstInflDev2 "Factor pulsation influence of adjustment element 2" UBYTE fak_ub_b1 1 100 0.00 0.9961 ECU_ADDRESS 0x6000F20A /end MEASUREMENT
/begin MEASUREMENT AFS_facPlstInflDev3 "Factor pulsation influence of adjustment element 3" UBYTE fak_ub_b1 1 100 0.00 0.9961 ECU_ADDRESS 0x6000F209 /end MEASUREMENT
/begin MEASUREMENT AFS_facPlstIntrpn_MP "Measurement point HFM pulsation correction factor from Interpolation" UWORD fak_uw_b4 1 100 0.00 3.999939 FORMAT "%8.6" ECU_ADDRESS 0x7000A8AA /end MEASUREMENT
/begin MEASUREMENT AFS_facTInflPlstCorrn "Pulsation correction depending on intake manifold temperature" UBYTE fak_ub_b2 1 100 0.00 1.992188 FORMAT "%8.6" ECU_ADDRESS 0x6000F208 /end MEASUREMENT
/begin MEASUREMENT AFS_facTranColdWrmIntkLoc "Factor transition operating point coldwarm desired value intake camshaft" UBYTE fak_ub_b1 1 100 0.00 0.9961 ECU_ADDRESS 0x6000F207 /end MEASUREMENT
/begin MEASUREMENT AFS_flgEnaPlausDiag "Condition enable HFM plausible diagnosis" UBYTE B_TRUE 1 100 0.00 1.00000000000 BIT_MASK 0x1 FORMAT "%13.11" ECU_ADDRESS 0x70000421 /end MEASUREMENT
/begin MEASUREMENT AFS_flgEnaVrntDiag "Condition enable MAF signal variation check" UBYTE B_TRUE 1 100 0.00 1.00000000000 BIT_MASK 0x1 FORMAT "%13.11" ECU_ADDRESS 0x70000420 /end MEASUREMENT
/begin MEASUREMENT AFS_flgEngRunng "Minimum threshold for the engine speed synchronus air mass flow calculation reached" UBYTE B_TRUE 1 100 0.00 1.00000000000 BIT_MASK 0x1 FORMAT "%13.11" ECU_ADDRESS 0x70000C56 /end MEASUREMENT
/begin MEASUREMENT AFS_flgInhbnPlausDiag "local IUMPR-Denominator inhibit condition for HFM-Rationality-Diagnosis" UBYTE B_TRUE 1 100 0.00 1.00000000000 BIT_MASK 0x1 FORMAT "%13.11" ECU_ADDRESS 0x7000041F /end MEASUREMENT
/begin MEASUREMENT AFS_flgInhbnVrntDiag "local IUMPR-Denominator inhibit condition for HFM-Variation-Diagnosis" UBYTE B_TRUE 1 100 0.00 1.00000000000 BIT_MASK 0x1 FORMAT "%13.11" ECU_ADDRESS 0x7000041E /end MEASUREMENT
/begin MEASUREMENT AFS_flgLoPrcRelsB1 "Release of physical HFM range low check of bank 1" UBYTE B_TRUE 1 100 0.00 1.00000000000 BIT_MASK 0x1 FORMAT "%13.11" ECU_ADDRESS 0x70000428 /end MEASUREMENT
/begin MEASUREMENT AFS_flgPhyRngDiagEnad "diagnostics for physical range check enabled" UBYTE B_TRUE 1 100 0.00 1.00000000000 BIT_MASK 0x1 FORMAT "%13.11" ECU_ADDRESS 0x70000427 /end MEASUREMENT
/begin MEASUREMENT AFS_flgPhyRngDiagRelsB1 "Release of physical HFM range check in bank 1" UBYTE B_TRUE 1 100 0.00 1.00000000000 BIT_MASK 0x1 FORMAT "%13.11" ECU_ADDRESS 0x70000426 /end MEASUREMENT
/begin MEASUREMENT AFS_flgPhyRngErrB1 "Flag to display a physical HFM range error" UBYTE B_TRUE 1 100 0.00 1.00000000000 BIT_MASK 0x1 FORMAT "%13.11" ECU_ADDRESS 0x70000425 /end MEASUREMENT
/begin MEASUREMENT AFS_flgPlausDiagErr "Flag Plausible Diagnosis Error" UBYTE B_TRUE 1 100 0.00 1.00000000000 BIT_MASK 0x1 FORMAT "%13.11" ECU_ADDRESS 0x70000C55 /end MEASUREMENT
/begin MEASUREMENT AFS_flgPlausDiagErrHi "Error flag of the upper plausibility check of the HFM air mass flow" UBYTE B_TRUE 1 100 0.00 1.00000000000 BIT_MASK 0x1 FORMAT "%13.11" ECU_ADDRESS 0x7000041D /end MEASUREMENT
/begin MEASUREMENT AFS_flgPlausDiagErrLo "Error flag of the lower plausibility check of the HFM air mass flow" UBYTE B_TRUE 1 100 0.00 1.00000000000 BIT_MASK 0x1 FORMAT "%13.11" ECU_ADDRESS 0x7000041C /end MEASUREMENT
/begin MEASUREMENT AFS_flgPlstIntrpnSwt "flag denoting if homogenous operation mode is active" UBYTE B_TRUE 1 100 0.00 1.00000000000 BIT_MASK 0x1 FORMAT "%13.11" ECU_ADDRESS 0x6000F206 /end MEASUREMENT
/begin MEASUREMENT AFS_flgRawSigRngHiB1 "Flag of the upper out-of-range check of the HFM raw signal" UBYTE B_TRUE 1 100 0.00 1.00000000000 BIT_MASK 0x1 FORMAT "%13.11" ECU_ADDRESS 0x70000432 /end MEASUREMENT
/begin MEASUREMENT AFS_flgRawSigRngLoB1 "Flag of the lower out-of-range check of the HFM raw signal" UBYTE B_TRUE 1 100 0.00 1.00000000000 BIT_MASK 0x1 FORMAT "%13.11" ECU_ADDRESS 0x70000431 /end MEASUREMENT
/begin MEASUREMENT AFS_flgRstDsmPlausDiag "Condition DSM Clear Request for DHFMR" UBYTE B_TRUE 1 100 0.00 1.00000000000 BIT_MASK 0x1 FORMAT "%13.11" ECU_ADDRESS 0x7000041B /end MEASUREMENT
/begin MEASUREMENT AFS_flgSegNotCompl "Flag to inhibit update in case of no sync" UBYTE B_TRUE 1 100 0.00 1.00000000000 BIT_MASK 0x1 FORMAT "%13.11" ECU_ADDRESS 0x70000424 /end MEASUREMENT
/begin MEASUREMENT AFS_flgSentCommErrB1 "Flag to display a communication error of the SENT interface of the HFM sensor" UBYTE B_TRUE 1 100 0.00 1.00000000000 BIT_MASK 0x1 FORMAT "%13.11" ECU_ADDRESS 0x70000430 /end MEASUREMENT
/begin MEASUREMENT AFS_flgSigDiagRels "Release of the HFM diagnosis of the electrical signal" UBYTE B_TRUE 1 100 0.00 1.00000000000 BIT_MASK 0x1 FORMAT "%13.11" ECU_ADDRESS 0x70000C54 /end MEASUREMENT
/begin MEASUREMENT AFS_flgSigErrLineHiB1 "Flag to display an electrical line hi error of the HFM sensor (e.g. shortcircuit to battery of open load)" UBYTE B_TRUE 1 100 0.00 1.00000000000 BIT_MASK 0x1 FORMAT "%13.11" ECU_ADDRESS 0x7000042F /end MEASUREMENT
/begin MEASUREMENT AFS_flgSigErrLineHiDiagB1 "Exported flag to display an electrical line high error of the HFM sensor (e.g. shortcircuit to battery) on Bank1" UBYTE B_TRUE 1 100 0.00 1.00000000000 BIT_MASK 0x1 FORMAT "%13.11" ECU_ADDRESS 0x70000C53 /end MEASUREMENT
/begin MEASUREMENT AFS_flgSigErrLineLoB1 "Flag to display an electrical line low error of the HFM sensor (e.g. shortcircuit to ground)" UBYTE B_TRUE 1 100 0.00 1.00000000000 BIT_MASK 0x1 FORMAT "%13.11" ECU_ADDRESS 0x7000042E /end MEASUREMENT
/begin MEASUREMENT AFS_flgSigErrLineLoDiagB1 "Exported flag to display an electrical line low error of the HFM sensor (e.g. shortcircuit to ground) on Bank1" UBYTE B_TRUE 1 100 0.00 1.00000000000 BIT_MASK 0x1 FORMAT "%13.11" ECU_ADDRESS 0x70000C52 /end MEASUREMENT
/begin MEASUREMENT AFS_flgSigInvldB1 "Flag Signal Invalid bank 1" UBYTE B_TRUE 1 100 0.00 1.00000000000 BIT_MASK 0x1 FORMAT "%13.11" ECU_ADDRESS 0x7000042D /end MEASUREMENT
/begin MEASUREMENT AFS_flgSigInvldRawB1 "Flag raw signal Invalid bank 1" UBYTE B_TRUE 1 100 0.00 1.00000000000 BIT_MASK 0x1 FORMAT "%13.11" ECU_ADDRESS 0x7000326C /end MEASUREMENT
/begin MEASUREMENT AFS_flgSigInvldUnDebB1 "Undebounced validity flag of the air mass flow sensor signal for the current segment (TRUE: Signal invalid; FALSE: Signal valid) for bank 1" UBYTE B_TRUE 1 100 0.00 1.00000000000 BIT_MASK 0x1 FORMAT "%13.11" ECU_ADDRESS 0x7000042C /end MEASUREMENT
/begin MEASUREMENT AFS_flgSnsrErrB1 "Flag to display a detected HFM error of the sensor self diagnosis" UBYTE B_TRUE 1 100 0.00 1.00000000000 BIT_MASK 0x1 FORMAT "%13.11" ECU_ADDRESS 0x7000042B /end MEASUREMENT
/begin MEASUREMENT AFS_flgSnsrInitB1 "HFM sensor is in init state (in case of SENT interface)" UBYTE B_TRUE 1 100 0.00 1.00000000000 BIT_MASK 0x1 FORMAT "%13.11" ECU_ADDRESS 0x7000042A /end MEASUREMENT
/begin MEASUREMENT AFS_flgSnsrSigInvldB1 "Validity flag of the measured air mass flow sensor signal (TRUE: Signal invalid; FALSE: Signal valid)" UBYTE B_TRUE 1 100 0.00 1.00000000000 BIT_MASK 0x1 FORMAT "%13.11" ECU_ADDRESS 0x70000C51 /end MEASUREMENT
/begin MEASUREMENT AFS_flgSnsrVccAvl "Flag of the battery voltage check and status of supply voltage monitor inside the HFM component driver" UBYTE B_TRUE 1 100 0.00 1.00000000000 BIT_MASK 0x1 FORMAT "%13.11" ECU_ADDRESS 0x70000C50 /end MEASUREMENT
/begin MEASUREMENT AFS_flgStatyFilActv "Activation of PT1 filter in stationary conditions of HFM air mass flow signal" UBYTE B_TRUE 1 100 0.00 1.00000000000 BIT_MASK 0x1 FORMAT "%13.11" ECU_ADDRESS 0x70000429 /end MEASUREMENT
/begin MEASUREMENT AFS_flgVrntDiagErrB1 "Flag Variant Diagnosis Error bank 1" UBYTE B_TRUE 1 100 0.00 1.00000000000 BIT_MASK 0x1 FORMAT "%13.11" ECU_ADDRESS 0x70000C4F /end MEASUREMENT
/begin MEASUREMENT AFS_idxWriteAnB1 "Write index for consistent access to the data buffer of the analog interface of the HFM sensor in bank 1" UBYTE OneToOne 1 100 0.00 255.0 FORMAT "%5.1" ECU_ADDRESS 0x70003734 /end MEASUREMENT
/begin MEASUREMENT AFS_mfAvrgCurrSegB1 "Averaged air mass flow signal in the current segment" SWORD m_q0p1 1 100 -3276.800 3276.700 FORMAT "%8.3" ECU_ADDRESS 0x7000326A /end MEASUREMENT
/begin MEASUREMENT AFS_mfAvrgPrevSegB1 "Averaged air mass flow signal in the current segment" SWORD m_q0p1 1 100 -3276.800 3276.700 FORMAT "%8.3" ECU_ADDRESS 0x70003268 /end MEASUREMENT
/begin MEASUREMENT AFS_mfB1 "HFM air mass flow" SWORD m_q0p1 1 100 -3276.800 3276.700 FORMAT "%8.3" ECU_ADDRESS 0x500007BE /end MEASUREMENT
/begin MEASUREMENT AFS_mfFildB1 "Filtered HFM air mass flow in bank 1" SWORD m_q0p1 1 100 -3276.800 3276.700 FORMAT "%8.3" ECU_ADDRESS 0x60000566 /end MEASUREMENT
/begin MEASUREMENT AFS_mfFirstValCurrSegB1 "First air mass flow value in current segment used in residual error calcuation" SWORD m_q0p1 1 100 -3276.800 3276.700 FORMAT "%8.3" ECU_ADDRESS 0x500006E0 /end MEASUREMENT
/begin MEASUREMENT AFS_mfLastValPrevSegB1 "Last air mass flow value in last segment used in residual error calcuation" SWORD m_q0p1 1 100 -3276.800 3276.700 FORMAT "%8.3" ECU_ADDRESS 0x500006E2 /end MEASUREMENT
/begin MEASUREMENT AFS_mfMeasB1 "Sensed air flow signal value for AFS on Bank1" SWORD m_q0p1 1 100 -3276.800 3276.700 FORMAT "%8.3" ECU_ADDRESS 0x60000628 /end MEASUREMENT
/begin MEASUREMENT AFS_mfPrevSegB1 "Last or first air mass flow value in last or current segment respectively, used in residual error calcuation" SWORD m_q0p1 1 100 -3276.800 3276.700 FORMAT "%8.3" ECU_ADDRESS 0x500006E4 /end MEASUREMENT
/begin MEASUREMENT AFS_mfRawAvrgB1 "Mass-flow Raw Average bank 1" SWORD m_q0p1 1 100 -3276.800 3276.700 FORMAT "%8.3" ECU_ADDRESS 0x500006E6 /end MEASUREMENT
/begin MEASUREMENT AFS_mfRawAvrgFildB1 "Averaged and via the stationary filter filtered air mass flow signal" SWORD m_q0p1 1 100 -3276.800 3276.700 FORMAT "%8.3" ECU_ADDRESS 0x70003266 /end MEASUREMENT
/begin MEASUREMENT AFS_mfRawB1 "Raw value of air mass flow signal of the HFM sensor" SWORD m_q0p1 1 100 -3276.800 3276.700 FORMAT "%8.3" ECU_ADDRESS 0x6000062A /end MEASUREMENT
/begin MEASUREMENT AFS_mfRawFildB1 "PT1 filtered raw value of air mass flow signal of the HFM sensor of bank 1" SWORD m_q0p1 1 100 -3276.800 3276.700 FORMAT "%8.3" ECU_ADDRESS 0x70003264 /end MEASUREMENT
/begin MEASUREMENT AFS_mfRawSumB1 "Sum of the HFM air mass flow values within a segment as input value of the average calculation" SLONG m_q0p1 1 100 -214748364.800 214748364.700 FORMAT "%13.3" ECU_ADDRESS 0x50000128 /end MEASUREMENT
/begin MEASUREMENT AFS_mfSldAvrgFil "Sliding air mass flow signal of HFM sensor averaged over multiple full segments" SWORD m_q0p1 1 100 -3276.800 3276.700 FORMAT "%8.3" ECU_ADDRESS 0x500006E8 /end MEASUREMENT
/begin MEASUREMENT AFS_mfSnsrB1 "Processed air mass flow signal of the HFM sensor" SWORD m_q0p1 1 100 -3276.800 3276.700 FORMAT "%8.3" ECU_ADDRESS 0x6000062E /end MEASUREMENT
/begin MEASUREMENT AFS_mfSnsrPid "Processed fresh air mass flow signal for PID output" SWORD m_q0p1 1 100 -3276.800 3276.700 FORMAT "%8.3" ECU_ADDRESS 0x70005350 /end MEASUREMENT
/begin MEASUREMENT AFS_mfThrVlvFild "Filtered air mass flow over the throttle valve" SWORD m_q0p1 1 100 -3276.800 3276.700 FORMAT "%8.3" ECU_ADDRESS 0x60000568 /end MEASUREMENT
/begin MEASUREMENT AFS_mRawAvrgBufB1 "Array for the air mass values of the sliding average calculation over multiple segments" SLONG OneToOne 1 100 -2147483648.00 2147483647.00 FORMAT "%13.2" ARRAY_SIZE 24 ECU_ADDRESS 0x500000C8 /end MEASUREMENT
/begin MEASUREMENT AFS_nEngTCorrd "Engine speed temperature corrected (for pulsation correction)" SWORD EngN 1 100 -16384.00 16383.50 FORMAT "%8.2" ECU_ADDRESS 0x6000826C /end MEASUREMENT
/begin MEASUREMENT AFS_nrCurrPlstCorrnMap "Number of current pulsation correction map" UBYTE dez 1 100 0.00 255.0 FORMAT "%5.1" ECU_ADDRESS 0x6000F205 /end MEASUREMENT
/begin MEASUREMENT AFS_stHomOperMod "status denoting homeogenous operating mode" UBYTE OneToOne 1 100 0.00 255.0 FORMAT "%5.1" ECU_ADDRESS 0x6000F204 /end MEASUREMENT
/begin MEASUREMENT AFS_tiDeltaPrevSegB1 "Time based weighting factor for residual error calculation during averaging of air mass flow calculation" SLONG Per_Dur 1 100 -2147483648.00 2147483647.00 FORMAT "%13.2" ECU_ADDRESS 0x5000012C /end MEASUREMENT
/begin MEASUREMENT AFS_tiDeltaSegB1 "Time difference of segment length and time based weighted sum of air mass flow values for residual error calculation during averaging of air mass flow calculation" SLONG Per_Dur 1 100 -2147483648.00 2147483647.00 FORMAT "%13.2" ECU_ADDRESS 0x70003260 /end MEASUREMENT
/begin MEASUREMENT AFS_tiPt1B1 "Time constant for PT1 filtering of HFM air mass flow signal" SLONG Per_Dur 1 100 -2147483648.00 2147483647.00 FORMAT "%13.2" ECU_ADDRESS 0x7000325C /end MEASUREMENT
/begin MEASUREMENT AFS_tiPt1StatyFil "PT1 time constant of the stationary filter in the air mass flow signal path" SWORD Time_msec_q1_COMPU 1 100 -32768.00 32767.00 FORMAT "%8.2" ECU_ADDRESS 0x500006EA /end MEASUREMENT
/begin MEASUREMENT AFS_tiSeg "Segment length" SWORD Time_msec_q1_COMPU 1 100 -32768.00 32767.00 FORMAT "%8.2" ECU_ADDRESS 0x70003258 /end MEASUREMENT
/begin MEASUREMENT AFS_tiSegBufB1 "Array for the segment length of the sliding average calculation over multiple segments" SLONG Per_Dur 1 100 -2147483648.00 2147483647.00 FORMAT "%13.2" ARRAY_SIZE 24 ECU_ADDRESS 0x50000130 /end MEASUREMENT
/begin MEASUREMENT AFS_tiSigInvldDebB1 "Debounce time for the HFM signal validity flag to ensure PT1 in steady state" SLONG Per_Dur 1 100 -2147483648.00 2147483647.00 FORMAT "%13.2" ECU_ADDRESS 0x70003254 /end MEASUREMENT
/begin MEASUREMENT AFS_tiSmplTime "Update rate of HFM sensor signal" UWORD Per_Dur 1 100 0.00 65535.00 FORMAT "%8.2" ECU_ADDRESS 0x500006EC /end MEASUREMENT
/begin MEASUREMENT AFS_uBufAirMFlowSnsrB1 "Array to store time period values of analog interface of HFM sensor in bank 1" SWORD Volt 1 100 -6553.600 6553.400 FORMAT "%8.3" ARRAY_SIZE 16 ECU_ADDRESS 0x70003232 /end MEASUREMENT
/begin MEASUREMENT AFS_uSnsrRawB1 "Raw value of voltage transmitted by HFM sensor" SWORD Volt 1 100 -6553.600 6553.400 FORMAT "%8.3" ECU_ADDRESS 0x70003C12 /end MEASUREMENT
/begin MEASUREMENT agrvpsb_w "calculated desired value egr valve position" UWORD rel_uw_b100 1 100 0.00 99.99847 FORMAT "%8.5" ECU_ADDRESS 0x60001614 /end MEASUREMENT
/begin MEASUREMENT agrvps_w_msg "Setpoint value egr valve position, 16-bit" UWORD rel_uw_b100 1 100 0.00 99.99847 FORMAT "%8.5" ECU_ADDRESS 0x60000CC0 /end MEASUREMENT
/begin MEASUREMENT agrvugdi_w_msg "egr valve position unthrottled using the actual EGR rate" UWORD rel_uw_b100 1 100 0.00 99.99847 FORMAT "%8.5" ECU_ADDRESS 0x60008D94 /end MEASUREMENT
/begin MEASUREMENT agrvugd_w_msg "egr valve position unthrottled" UWORD rel_uw_b100 1 100 0.00 99.99847 FORMAT "%8.5" ECU_ADDRESS 0x60001612 /end MEASUREMENT
/begin MEASUREMENT AirC_stCmprAct_tmp "Temporary bit of actual AC compressor state" UBYTE B_TRUE 1 100 0.00 1.00000000000 BIT_MASK 0x1 FORMAT "%13.11" ECU_ADDRESS 0x6000F20E /end MEASUREMENT
/begin MEASUREMENT AirC_stSwt "Status of Air Condition switch" UBYTE OneToOne 1 100 0.00 255.0 FORMAT "%5.1" ECU_ADDRESS 0x6000FFE1 /end MEASUREMENT
/begin MEASUREMENT AirC_stSwtDeb "Debounced status of AC switch" UBYTE OneToOne 1 100 0.00 255.0 FORMAT "%5.1" ECU_ADDRESS 0x6000FFE0 /end MEASUREMENT
/begin MEASUREMENT AirC_stSwtPrsnt "AC switch Present status" UBYTE B_TRUE 1 100 0.00 1.00000000000 BIT_MASK 0x1 FORMAT "%13.11" ECU_ADDRESS 0x6000FADA /end MEASUREMENT
/begin MEASUREMENT AirC_stSwtRaw "Raw value of AC-switch read from the sensor" UBYTE OneToOne 1 100 0.00 255.0 FORMAT "%5.1" ECU_ADDRESS 0x6000FFDE /end MEASUREMENT
/begin MEASUREMENT AirDvP_flgEnaPMod "P-mode active" UBYTE B_TRUE 1 100 0.00 1.00000000000 BIT_MASK 0x1 FORMAT "%13.11" ECU_ADDRESS 0x70000414 /end MEASUREMENT
/begin MEASUREMENT AirDvP_flgEnaScc "Condition enable pressure sensor coparison during start" UBYTE B_TRUE 1 100 0.00 1.00000000000 BIT_MASK 0x1 FORMAT "%13.11" ECU_ADDRESS 0x70000C4A /end MEASUREMENT
/begin MEASUREMENT AirDvP_flgEnaSccPEnv "Condition Intake manifold pressure at nmot=0 equal to ambient pressure" UBYTE B_TRUE 1 100 0.00 1.00000000000 BIT_MASK 0x1 FORMAT "%13.11" ECU_ADDRESS 0x600397D2 /end MEASUREMENT
/begin MEASUREMENT AirDvP_flgPIntkVUsStrtRngErrB1 "Condition failure map lost grounding bank 1" UBYTE B_TRUE 1 100 0.00 1.00000000000 BIT_MASK 0x1 FORMAT "%13.11" ECU_ADDRESS 0x70000C49 /end MEASUREMENT
/begin MEASUREMENT AirDvP_flgPIntkVUsStrtRngHealB1 "Condition healing failure map lost grounding bank 1" UBYTE B_TRUE 1 100 0.00 1.00000000000 BIT_MASK 0x1 FORMAT "%13.11" ECU_ADDRESS 0x70000C48 /end MEASUREMENT
/begin MEASUREMENT AirDvP_PEnvMax "max. pos ambient air pressure correction" SWORD p_q0p039 1 100 -1280.000 1279.961 FORMAT "%8.3" ECU_ADDRESS 0x60008266 /end MEASUREMENT
/begin MEASUREMENT AirDvP_PEnvMin "max. neg. ambient air pressure correction" SWORD p_q0p039 1 100 -1280.000 1279.961 FORMAT "%8.3" ECU_ADDRESS 0x60008264 /end MEASUREMENT
/begin MEASUREMENT AirDvP_pEnvOffs "Calculated pressure offset of the ambient pressure sensor" SWORD p_q0p039 1 100 -1280.000 1279.961 FORMAT "%8.3" ECU_ADDRESS 0x60009282 /end MEASUREMENT
/begin MEASUREMENT AirDvP_pIntkVUsLdcB1 "Manifold air pressure last DC bank 1" UWORD p_q0p078 1 100 0.00 5119.922 FORMAT "%8.3" ECU_ADDRESS 0x60008FA8 /end MEASUREMENT
/begin MEASUREMENT AirDvP_pIntkVUsOffsB1 "Offset pressure sensor manifold pressure bank 1" SWORD p_q0p039 1 100 -1280.000 1279.961 FORMAT "%8.3" ECU_ADDRESS 0x60009280 /end MEASUREMENT
/begin MEASUREMENT AirDvP_pIntkVUsOffsBndlsB1 "Offset pressure sensor manifold pressure, unlimited bank 1" SWORD p_q0p039 1 100 -1280.000 1279.961 FORMAT "%8.3" ECU_ADDRESS 0x600397D0 /end MEASUREMENT
/begin MEASUREMENT AirMod_cntrDlyPredVlvLftIntk "Counter for delay of the flag B_vhefeps" UBYTE OneToOne 1 100 0.00 255.0 FORMAT "%5.1" ECU_ADDRESS 0x7000322C /end MEASUREMENT
/begin MEASUREMENT AirMod_flgCoVlvLft "Air modelling coordiniert valve lift swith" UBYTE B_TRUE 1 100 0.00 1.00000000000 BIT_MASK 0x1 FORMAT "%13.11" ECU_ADDRESS 0x70003647 /end MEASUREMENT
/begin MEASUREMENT AltIO_flgACGHiU "System Voltage High status flag" UBYTE B_TRUE 1 100 0.00 1.00000000000 BIT_MASK 0x1 FORMAT "%13.11" ECU_ADDRESS 0x6000F201 /end MEASUREMENT
/begin MEASUREMENT AltIO_flgACGLoU "System voltage Low status flag" UBYTE B_TRUE 1 100 0.00 1.00000000000 BIT_MASK 0x1 FORMAT "%13.11" ECU_ADDRESS 0x6000F200 /end MEASUREMENT
/begin MEASUREMENT AltIO_nEngThdACGFailr "Threshold value for engine speed in detecting ACG electric or mechanical fault" SWORD EngN 1 100 -16384.00 16383.50 FORMAT "%8.2" ECU_ADDRESS 0x60009BF2 /end MEASUREMENT
/begin MEASUREMENT AltIO_rACGFieDuty "Filtered value of ACG field duty cycle" SWORD DtyCyc 1 100 -327.6800 327.6700 FORMAT "%8.4" ECU_ADDRESS 0x6000056A /end MEASUREMENT
/begin MEASUREMENT AltIO_rAlt "Raw load on the Alternator" SWORD Prc 1 100 -400.0000 399.9878 FORMAT "%8.4" ECU_ADDRESS 0x60009E0E /end MEASUREMENT
/begin MEASUREMENT AltIO_rAltLoad "Raw load on the Alternator" SWORD DtyCyc 1 100 -327.6800 327.6700 FORMAT "%8.4" ECU_ADDRESS 0x60009BF0 /end MEASUREMENT
/begin MEASUREMENT AltIO_stCon "Debounced value of the alternator condition input" UBYTE OneToOne 1 100 0.00 255.0 FORMAT "%5.1" ECU_ADDRESS 0x6000FFDD /end MEASUREMENT
/begin MEASUREMENT AltIO_stQ "Quality of input signal" UBYTE OneToOne 1 100 0.00 255.0 FORMAT "%5.1" ECU_ADDRESS 0x600100F4 /end MEASUREMENT
/begin MEASUREMENT AltIO_tiLRAlt "Load Response time" SWORD Time_s 1 100 -327.6800 327.6700 FORMAT "%8.4" ECU_ADDRESS 0x60009BEE /end MEASUREMENT
/begin MEASUREMENT AltIO_uAltDes "Alternator setpoint voltage" SWORD Volt_Batt 1 100 -655360.0 655340.0 FORMAT "%8.1" ECU_ADDRESS 0x60009BEC /end MEASUREMENT
/begin MEASUREMENT Alt_uFinalDes "Desired voltage for alternator operation" SWORD Volt_Batt 1 100 -655360.0 655340.0 FORMAT "%8.1" ECU_ADDRESS 0x60009BE6 /end MEASUREMENT
/begin MEASUREMENT anzsyn "No. of remaing synchro's in the wait state" UBYTE dez 1 100 0.00 255.0 FORMAT "%5.1" ECU_ADDRESS 0x70003270 /end MEASUREMENT
/begin MEASUREMENT asegvsyn "No.of segments delay of the faster correcting element at valve lift switch-over" UBYTE OneToOne 1 100 0.00 255.0 FORMAT "%5.1" ECU_ADDRESS 0x60000917 /end MEASUREMENT
/begin MEASUREMENT B_agron_msg "Condition egr-valve on" UBYTE B_TRUE 1 100 0.00 1.00000000000 BIT_MASK 0x1 FORMAT "%13.11" ECU_ADDRESS 0x6000150B /end MEASUREMENT
/begin MEASUREMENT B_cutoffEFNM "Cutoff bit for Edge falling - local" UBYTE B_TRUE 1 100 0.00 1.00000000000 BIT_MASK 0x1 FORMAT "%13.11" ECU_ADDRESS 0x6000F20D /end MEASUREMENT
/begin MEASUREMENT B_dmdevab "Condition Injection Cutoff pattern for Misfire Detection" UBYTE B_TRUE 1 100 0.00 1.00000000000 BIT_MASK 0x1 FORMAT "%13.11" ECU_ADDRESS 0x70000437 /end MEASUREMENT
/begin MEASUREMENT B_dmdstnew_msg "injection valve cutoff active -- diagnosis misfire detecction stopped" UBYTE B_TRUE 1 100 0.00 1.00000000000 BIT_MASK 0x1 FORMAT "%13.11" ECU_ADDRESS 0x70000C04 /end MEASUREMENT
/begin MEASUREMENT B_dssakt_msg "condition MAPS is main sensor in the air charge determination" UBYTE B_TRUE 1 100 0.00 1.00000000000 BIT_MASK 0x1 FORMAT "%13.11" ECU_ADDRESS 0x70000C03 /end MEASUREMENT
/begin MEASUREMENT B_ehfm "condition: HFM error (without debounce)" UBYTE B_TRUE 1 100 0.00 1.00000000000 BIT_MASK 0x1 FORMAT "%13.11" ECU_ADDRESS 0x70000423 /end MEASUREMENT
/begin MEASUREMENT B_ehfm_msg "condition: HFM error (without debounce)" UBYTE B_TRUE 1 100 0.00 1.00000000000 BIT_MASK 0x1 FORMAT "%13.11" ECU_ADDRESS 0x70000BF3 /end MEASUREMENT
/begin MEASUREMENT B_epsrsg_msg "Condition failure map lost grounding" UBYTE B_TRUE 1 100 0.00 1.00000000000 BIT_MASK 0x1 FORMAT "%13.11" ECU_ADDRESS 0x70000BE6 /end MEASUREMENT
/begin MEASUREMENT B_evasldel_msg "Condition no injection cutoff request active and all injections are ignited" UBYTE B_TRUE 1 100 0.00 1.00000000000 BIT_MASK 0x1 FORMAT "%13.11" ECU_ADDRESS 0x70000BD4 /end MEASUREMENT
/begin MEASUREMENT B_fevab "Condition Injection valves or Ignition Coil Error" UBYTE B_TRUE 1 100 0.00 1.00000000000 BIT_MASK 0x1 FORMAT "%13.11" ECU_ADDRESS 0x70000436 /end MEASUREMENT
/begin MEASUREMENT B_fgfnpps_msg "Condition enable pressure sensor coparison during start" UBYTE B_TRUE 1 100 0.00 1.00000000000 BIT_MASK 0x1 FORMAT "%13.11" ECU_ADDRESS 0x70000BC4 /end MEASUREMENT
/begin MEASUREMENT B_hepsrsg_msg "Condition healing failure map lost grounding" UBYTE B_TRUE 1 100 0.00 1.00000000000 BIT_MASK 0x1 FORMAT "%13.11" ECU_ADDRESS 0x70000BAA /end MEASUREMENT
/begin MEASUREMENT B_hfmsvmn "Condition MAF signal variation check lower operation point reached" UBYTE B_TRUE 1 100 0.00 1.00000000000 BIT_MASK 0x1 FORMAT "%13.11" ECU_ADDRESS 0x7000041A /end MEASUREMENT
/begin MEASUREMENT B_hfmsvmni "Condition MAF signal variation check lower operation point was reached" UBYTE B_TRUE 1 100 0.00 1.00000000000 BIT_MASK 0x1 FORMAT "%13.11" ECU_ADDRESS 0x70000419 /end MEASUREMENT
/begin MEASUREMENT B_hfmsvmx "Condition MAF signal variation check upper operation point reached" UBYTE B_TRUE 1 100 0.00 1.00000000000 BIT_MASK 0x1 FORMAT "%13.11" ECU_ADDRESS 0x70000418 /end MEASUREMENT
/begin MEASUREMENT B_hfmsvmxi "Condition MAF signal variation check upper operation point was reached" UBYTE B_TRUE 1 100 0.00 1.00000000000 BIT_MASK 0x1 FORMAT "%13.11" ECU_ADDRESS 0x70000417 /end MEASUREMENT
/begin MEASUREMENT B_hfmsvt "Condition MAF signal variation check temporary" UBYTE B_TRUE 1 100 0.00 1.00000000000 BIT_MASK 0x1 FORMAT "%13.11" ECU_ADDRESS 0x70000416 /end MEASUREMENT
/begin MEASUREMENT B_hfm_msg "Condition: HFM ready to measure" UBYTE B_TRUE 1 100 0.00 1.00000000000 BIT_MASK 0x1 FORMAT "%13.11" ECU_ADDRESS 0x70000BA9 /end MEASUREMENT
/begin MEASUREMENT B_msagrsb_msg "Condition: EGR desired value mass flow limited" UBYTE B_TRUE 1 100 0.00 1.00000000000 BIT_MASK 0x1 FORMAT "%13.11" ECU_ADDRESS 0x600014F3 /end MEASUREMENT
/begin MEASUREMENT B_mshfmgg "Condition: mass flow from MAF measured valid (HFM ready to measure)" UBYTE B_TRUE 1 100 0.00 1.00000000000 BIT_MASK 0x1 FORMAT "%13.11" ECU_ADDRESS 0x70000422 /end MEASUREMENT
/begin MEASUREMENT B_mshfmgg_msg "Condition: mass flow from MAF measured valid (HFM ready to measure)" UBYTE B_TRUE 1 100 0.00 1.00000000000 BIT_MASK 0x1 FORMAT "%13.11" ECU_ADDRESS 0x70000B65 /end MEASUREMENT
/begin MEASUREMENT B_nchfmr "condition numerator complete for rationality diagnostic HFM" UBYTE B_TRUE 1 100 0.00 1.00000000000 BIT_MASK 0x1 FORMAT "%13.11" ECU_ADDRESS 0x70000415 /end MEASUREMENT
/begin MEASUREMENT B_redsol "Condition Torque Reduction request" UBYTE B_TRUE 1 100 0.00 1.00000000000 BIT_MASK 0x1 FORMAT "%13.11" ECU_ADDRESS 0x70000435 /end MEASUREMENT
/begin MEASUREMENT B_vhefepsloc "TempFlag Charge Prediction Desired Valve Lift" UBYTE B_TRUE 1 100 0.00 1.00000000000 BIT_MASK 0x1 FORMAT "%13.11" ECU_ADDRESS 0x7000322B /end MEASUREMENT
/begin MEASUREMENT B_vhefeps_msg "Calculation of predicted air charge with desired valve lift" UBYTE B_TRUE 1 100 0.00 1.00000000000 BIT_MASK 0x1 FORMAT "%13.11" ECU_ADDRESS 0x70003635 /end MEASUREMENT
/begin MEASUREMENT B_vhegabgn_msg "Condition begin of switching variable cam lift inlet to high cam profile" UBYTE B_TRUE 1 100 0.00 1.00000000000 BIT_MASK 0x1 FORMAT "%13.11" ECU_ADDRESS 0x70003634 /end MEASUREMENT
/begin MEASUREMENT B_vhesynon "Synchronization variable valve lift, predicted air charge active" UBYTE B_TRUE 1 100 0.00 1.00000000000 BIT_MASK 0x1 FORMAT "%13.11" ECU_ADDRESS 0x7000322A /end MEASUREMENT
/begin MEASUREMENT B_zhfmpl_msg "Condition: Error HFM from plausbility check valid" UBYTE B_TRUE 1 100 0.00 1.00000000000 BIT_MASK 0x1 FORMAT "%13.11" ECU_ADDRESS 0x70000AE5 /end MEASUREMENT
/begin MEASUREMENT ComAlt_iExctCrnt "Alternator Excitation current" SWORD Curr 1 100 -32768.00 32767.00 FORMAT "%8.2" ECU_ADDRESS 0x60009B32 /end MEASUREMENT
/begin MEASUREMENT ComAlt_iExctCrntTypB "Excitation current for ACG regulator type B frame" SWORD Curr 1 100 -32768.00 32767.00 FORMAT "%8.2" ECU_ADDRESS 0x60009B30 /end MEASUREMENT
/begin MEASUREMENT ComAlt_nrDbgInfo "Debug information" UBYTE OneToOne 1 100 0.00 255.0 FORMAT "%5.1" ECU_ADDRESS 0x6000FF6C /end MEASUREMENT
/begin MEASUREMENT ComAlt_nrDbgInfoTypB "Debug information type B" UBYTE OneToOne 1 100 0.00 255.0 FORMAT "%5.1" ECU_ADDRESS 0x6000FF6B /end MEASUREMENT
/begin MEASUREMENT ComAlt_rAltDyc "Alternator duty cycle" SWORD Prc 1 100 -400.0000 399.9878 FORMAT "%8.4" ECU_ADDRESS 0x60009B2E /end MEASUREMENT
/begin MEASUREMENT ComAlt_rAltDycTypB "Alternator duty cycle for ACG regulator type B frame" SWORD Prc 1 100 -400.0000 399.9878 FORMAT "%8.4" ECU_ADDRESS 0x60009B2C /end MEASUREMENT
/begin MEASUREMENT ComAlt_stCom "Communication status for ACG" UBYTE OneToOne 1 100 0.00 255.0 FORMAT "%5.1" ECU_ADDRESS 0x6000FF6A /end MEASUREMENT
/begin MEASUREMENT ComAlt_stComTOut "Communication timeout for ACG" UBYTE OneToOne 1 100 0.00 255.0 FORMAT "%5.1" ECU_ADDRESS 0x6000FF69 /end MEASUREMENT
/begin MEASUREMENT ComAlt_stComTOutTypB "Communication time out status for ACG regulator type B frame" UBYTE OneToOne 1 100 0.00 255.0 FORMAT "%5.1" ECU_ADDRESS 0x6000FF68 /end MEASUREMENT
/begin MEASUREMENT ComAlt_stComTypB "Communication error status for ACG regulator type B frame" UBYTE OneToOne 1 100 0.00 255.0 FORMAT "%5.1" ECU_ADDRESS 0x6000FF67 /end MEASUREMENT
/begin MEASUREMENT ComAlt_stElec "Electrical status for ACG" UBYTE OneToOne 1 100 0.00 255.0 FORMAT "%5.1" ECU_ADDRESS 0x6000FF66 /end MEASUREMENT
/begin MEASUREMENT ComAlt_stElecTypB "Electrical fault status for ACG regulator type B frame" UBYTE OneToOne 1 100 0.00 255.0 FORMAT "%5.1" ECU_ADDRESS 0x6000FF65 /end MEASUREMENT
/begin MEASUREMENT ComAlt_stHiTemp "High Temperature for ACG" UBYTE OneToOne 1 100 0.00 255.0 FORMAT "%5.1" ECU_ADDRESS 0x6000FF64 /end MEASUREMENT
/begin MEASUREMENT ComAlt_stHiTempTypB "High temperature fault status for ACG regulator type B frame" UBYTE OneToOne 1 100 0.00 255.0 FORMAT "%5.1" ECU_ADDRESS 0x6000FF63 /end MEASUREMENT
/begin MEASUREMENT ComAlt_stMchn "Machine status for ACG" UBYTE OneToOne 1 100 0.00 255.0 FORMAT "%5.1" ECU_ADDRESS 0x6000FF62 /end MEASUREMENT
/begin MEASUREMENT ComAlt_stMchnTypB "Machine fault status for ACG regulator type B frame" UBYTE OneToOne 1 100 0.00 255.0 FORMAT "%5.1" ECU_ADDRESS 0x6000FF61 /end MEASUREMENT
/begin MEASUREMENT ComAlt_tACGTemp "ACG temperature for ACG regulator" SWORD Temp_Cels 1 100 -3549.940 3003.560 FORMAT "%8.3" ECU_ADDRESS 0x60009B2A /end MEASUREMENT
/begin MEASUREMENT ComAlt_tACGTempTypB "ACG temperature for ACG regulator type B frame" SWORD Temp_Cels 1 100 -3549.940 3003.560 FORMAT "%8.3" ECU_ADDRESS 0x60009B28 /end MEASUREMENT
/begin MEASUREMENT Com_bALTErr "Communication status with alternator regulator (Flag Communication error)" UBYTE B_TRUE 1 100 0.00 1.00000000000 BIT_MASK 0x1 FORMAT "%13.11" ECU_ADDRESS 0x6000F9D1 /end MEASUREMENT
/begin MEASUREMENT Com_bDern "Generator High temperature cut-off" UBYTE B_TRUE 1 100 0.00 1.00000000000 BIT_MASK 0x1 FORMAT "%13.11" ECU_ADDRESS 0x6000F9CE /end MEASUREMENT
/begin MEASUREMENT Com_bElec "Electrical status (Flag Electrical error)" UBYTE B_TRUE 1 100 0.00 1.00000000000 BIT_MASK 0x1 FORMAT "%13.11" ECU_ADDRESS 0x6000F9CD /end MEASUREMENT
/begin MEASUREMENT Com_bMec "Machine status (Flag Mechanical status)" UBYTE B_TRUE 1 100 0.00 1.00000000000 BIT_MASK 0x1 FORMAT "%13.11" ECU_ADDRESS 0x6000F9CC /end MEASUREMENT
/begin MEASUREMENT Com_bTO "Communication timeout status (Flag Timeout)" UBYTE B_TRUE 1 100 0.00 1.00000000000 BIT_MASK 0x1 FORMAT "%13.11" ECU_ADDRESS 0x6000F9CB /end MEASUREMENT
/begin MEASUREMENT Com_ctReIni10msAltECU "Temporary variable to store number of ReIni" UBYTE OneToOne 1 100 0.00 255.0 FORMAT "%5.1" ECU_ADDRESS 0x6000F203 /end MEASUREMENT
/begin MEASUREMENT Com_ratDyc "Alternator duty cycle" SWORD DtyCyc 1 100 -327.6800 327.6700 FORMAT "%8.4" ECU_ADDRESS 0x60009AC6 /end MEASUREMENT
/begin MEASUREMENT dmdevab "inject. valve cutoff pattern of misfire detection for the aktual ecu" UBYTE dez 1 100 0.00 255.0 FORMAT "%5.1" ECU_ADDRESS 0x7000326F /end MEASUREMENT
/begin MEASUREMENT dpsfg_w_msg "delta fresh air partial pressure in manifold" SWORD p_sw_q0p039 1 100 -1280.000 1279.961 FORMAT "%8.3" ECU_ADDRESS 0x70003A1E /end MEASUREMENT
/begin MEASUREMENT eevx_msg "Injection valve Errorbyte" UBYTE dez 1 100 0.00 255.0 FORMAT "%5.1" ECU_ADDRESS 0x500060CA /end MEASUREMENT
/begin MEASUREMENT evrbgn_one_msg "ev.nr. -1 at begin of cylinder cut-off for REDABM" UBYTE dez 1 100 0.00 255.0 FORMAT "%5.1" ECU_ADDRESS 0x70003662 /end MEASUREMENT
/begin MEASUREMENT evz_auscpl_msg "complement of injection cut off pattern total" UBYTE dez 1 100 0.00 255.0 FORMAT "%5.1" ECU_ADDRESS 0x70003661 /end MEASUREMENT
/begin MEASUREMENT evz_austot_msg "injection cut off pattern total" UBYTE dez 1 100 0.00 255.0 FORMAT "%5.1" ECU_ADDRESS 0x6000099A /end MEASUREMENT
/begin MEASUREMENT evz_aus_msg "injection cut off pattern" UBYTE dez 1 100 0.00 255.0 FORMAT "%5.1" ECU_ADDRESS 0x500009BA /end MEASUREMENT
/begin MEASUREMENT fdmshfmmthd_w "Limitfactor difference of modeled HFM air mass flows" UWORD fak_uw_b2 1 100 0.00 1.999969 FORMAT "%8.6" ECU_ADDRESS 0x60008270 /end MEASUREMENT
/begin MEASUREMENT fdmshfmm_w "Factor difference of modeled HFM air mass flows" UWORD fak_uw_b2 1 100 0.00 1.999969 FORMAT "%8.6" ECU_ADDRESS 0x6000826E /end MEASUREMENT
/begin MEASUREMENT fevab_msg "fixed pattern injection-valve cutoff" UBYTE dez 1 100 0.00 255.0 FORMAT "%5.1" ECU_ADDRESS 0x7000365E /end MEASUREMENT
/begin MEASUREMENT fkblagrz_w "correction of egr line profile calculation vlaue" UWORD fak_uw_b2 1 100 0.00 1.999969 FORMAT "%8.6" ECU_ADDRESS 0x600011DE /end MEASUREMENT
/begin MEASUREMENT fkklaf_w "Correction factor by pressure ratio (KLAF)" UWORD fak_uw_b2 1 100 0.00 1.999969 FORMAT "%8.6" ECU_ADDRESS 0x600011EE /end MEASUREMENT
/begin MEASUREMENT fktpbagrds_w_msg "factor correction egr aperture, egr downstream (temperature and pressure)" UWORD fak_q6p1035Em5 1 100 0.00 3.999939 FORMAT "%8.6" ECU_ADDRESS 0x600015FE /end MEASUREMENT
/begin MEASUREMENT fktpbagr_w_msg "factor correction egr aperture (temperature and pressure)" UWORD fak_q6p1035Em5 1 100 0.00 3.999939 FORMAT "%8.6" ECU_ADDRESS 0x60001600 /end MEASUREMENT
/begin MEASUREMENT ftmagr_msg "correction factor by temperature tagrv (EGR valve)" UBYTE fak_ub_b2 1 100 0.00 1.992188 FORMAT "%8.6" ECU_ADDRESS 0x60001415 /end MEASUREMENT
/begin MEASUREMENT ftpavag_w "factor correction air density for EGR valve flow f(gas temp.,altit.)" UWORD fak_uw_b2 1 100 0.00 1.999969 FORMAT "%8.6" ECU_ADDRESS 0x600015F0 /end MEASUREMENT
/begin MEASUREMENT ftvdk_msg "correction factor for temperature upstream of throttle valve" UBYTE fak_ub_b2 1 100 0.00 1.992188 FORMAT "%8.6" ECU_ADDRESS 0x60001413 /end MEASUREMENT
/begin MEASUREMENT fvisrm_w_msg "integrator amplifier factor intake manifold modell" UWORD p_uw_b32 1 100 0.00 31.99951 FORMAT "%8.5" ECU_ADDRESS 0x60000CEE /end MEASUREMENT
/begin MEASUREMENT InjSys_bFcoCylIndTstr "condition cylinder individual cut-off is active by tester" UBYTE B_TRUE 1 100 0.00 1.00000000000 BIT_MASK 0x1 FORMAT "%13.11" ECU_ADDRESS 0x70000434 /end MEASUREMENT
/begin MEASUREMENT InjSys_ctCylOld "Former value of cylider counter Epm_ctCyl" UBYTE OneToOne 1 100 0.00 255.0 FORMAT "%5.1" ECU_ADDRESS 0x7000326E /end MEASUREMENT
/begin MEASUREMENT InjSys_FcoCylIndTstr "cylinder individual cut-off pattern by ATS" UBYTE dez 1 100 0.00 255.0 FORMAT "%5.1" ECU_ADDRESS 0x7000326D /end MEASUREMENT
/begin MEASUREMENT InjSys_flgCutOffReqTyp2 "Condition full cutoff request type 2" UBYTE B_TRUE 1 100 0.00 1.00000000000 BIT_MASK 0x1 FORMAT "%13.11" ECU_ADDRESS 0x70000887 /end MEASUREMENT
/begin MEASUREMENT InjSys_flgNoDlyMisfDetTrig "condition no delay for trigger to misfire detection" UBYTE B_TRUE 1 100 0.00 1.00000000000 BIT_MASK 0x1 FORMAT "%13.11" ECU_ADDRESS 0x70000871 /end MEASUREMENT
/begin MEASUREMENT InjSys_flgNoInjReq "condition: injection cutoff active for next cylinder in ZOT" UBYTE B_TRUE 1 100 0.00 1.00000000000 BIT_MASK 0x1 FORMAT "%13.11" ECU_ADDRESS 0x70000870 /end MEASUREMENT
/begin MEASUREMENT InjSys_flgNoInjReq_GDI "condition: injection cutoff active for next cylinder in ZOT for GDI" UBYTE B_TRUE 1 100 0.00 1.00000000000 BIT_MASK 0x1 FORMAT "%13.11" ECU_ADDRESS 0x70000433 /end MEASUREMENT
/begin MEASUREMENT InjSys_stDlyNoInjReq "status delay for condition no injection requested" UBYTE dez 1 100 0.00 255.0 FORMAT "%5.1" ECU_ADDRESS 0x7000369A /end MEASUREMENT
/begin MEASUREMENT kldfpwm "generator signale as PWM-signale filtrated" UBYTE rel_ub_b100 1 100 0.00 99.61 FORMAT "%5.2" ECU_ADDRESS 0x6000F202 /end MEASUREMENT
/begin MEASUREMENT msagrbli_w "iterative egr massflow over fault aperture" UWORD m_q0p1 1 100 0.00 6553.500 FORMAT "%8.3" ECU_ADDRESS 0x600011EC /end MEASUREMENT
/begin MEASUREMENT msagrbs_w_msg "EGR mass flow into manifold, desired value limited" UWORD m_q0p1 1 100 0.00 6553.500 FORMAT "%8.3" ECU_ADDRESS 0x600015E4 /end MEASUREMENT
/begin MEASUREMENT msagrmxi_w_msg "maximum possible egr mass flow (unthrottled) with the actual EGR-Rate" UWORD m_q0p1 1 100 0.00 6553.500 FORMAT "%8.3" ECU_ADDRESS 0x60008D46 /end MEASUREMENT
/begin MEASUREMENT msagrmx_w_msg "maximum possible egr mass flow (unthrottled)" UWORD m_q0p1 1 100 0.00 6553.500 FORMAT "%8.3" ECU_ADDRESS 0x600015E2 /end MEASUREMENT
/begin MEASUREMENT msagrs2_w_msg "target value extern egr mass flow, valve2" UWORD m_q0p1 1 100 0.00 6553.500 FORMAT "%8.3" ECU_ADDRESS 0x600015E0 /end MEASUREMENT
/begin MEASUREMENT msagrsrs_w_msg "EGR mass flow into manifold, desired value" UWORD m_q0p1 1 100 0.00 6553.500 FORMAT "%8.3" ECU_ADDRESS 0x60000CF4 /end MEASUREMENT
/begin MEASUREMENT msagrs_w_msg "target value extern egr mass flow" UWORD m_q0p1 1 100 0.00 6553.500 FORMAT "%8.3" ECU_ADDRESS 0x600015DE /end MEASUREMENT
/begin MEASUREMENT msagrugdi_w_msg "calculated egr mass flow unthrottled with the actual EGR-Rate" UWORD m_q0p1 1 100 0.00 6553.500 FORMAT "%8.3" ECU_ADDRESS 0x60008D44 /end MEASUREMENT
/begin MEASUREMENT msagrugd_w_msg "calculated egr mass flow unthrottled" UWORD m_q0p1 1 100 0.00 6553.500 FORMAT "%8.3" ECU_ADDRESS 0x600015DC /end MEASUREMENT
/begin MEASUREMENT msagruvi_w "actual egr mass flow to calculate egr valve position unthrottled with the actual EGR-Rate" UWORD m_q0p1 1 100 0.00 6553.500 FORMAT "%8.3" ECU_ADDRESS 0x60008268 /end MEASUREMENT
/begin MEASUREMENT msagruv_w "actual egr mass flow to calculate egr valve position unthrottled" UWORD m_q0p1 1 100 0.00 6553.500 FORMAT "%8.3" ECU_ADDRESS 0x600011EA /end MEASUREMENT
/begin MEASUREMENT msagsrsg_w_msg "EGR mass flow into manifold, desired value valid" UWORD m_q0p1 1 100 0.00 6553.500 FORMAT "%8.3" ECU_ADDRESS 0x600015DA /end MEASUREMENT
/begin MEASUREMENT msastats_w_msg "desired value extern egr mass flow under stationary conditions" UWORD m_q0p1 1 100 0.00 6553.500 FORMAT "%8.3" ECU_ADDRESS 0x600015D8 /end MEASUREMENT
/begin MEASUREMENT mshfmmn_w "Minimal MAF air mass flow" SWORD m_q0p1 1 100 -3276.800 3276.700 FORMAT "%8.3" ECU_ADDRESS 0x60008274 /end MEASUREMENT
/begin MEASUREMENT mshfmmx_w "Maximal MAF air mass flow" SWORD m_q0p1 1 100 -3276.800 3276.700 FORMAT "%8.3" ECU_ADDRESS 0x60008272 /end MEASUREMENT
/begin MEASUREMENT mshfms_w "air mass flow HFM (signed)" SWORD m_q0p1 1 100 -3276.800 3276.700 FORMAT "%8.3" ECU_ADDRESS 0x70003230 /end MEASUREMENT
/begin MEASUREMENT mshfms_w_msg "air mass flow HFM (signed)" SWORD m_q0p1 1 100 -3276.800 3276.700 FORMAT "%8.3" ECU_ADDRESS 0x500008FC /end MEASUREMENT
/begin MEASUREMENT mshfmtn_w "min. model. air mass flow (at MAF position) based on MAF" UWORD m_q0p1 1 100 0.00 6553.500 FORMAT "%8.3" ECU_ADDRESS 0x60013DF8 /end MEASUREMENT
/begin MEASUREMENT mshfmtx_w "max. model. air mass flow (at MAF position) based on MAF" UWORD m_q0p1 1 100 0.00 6553.500 FORMAT "%8.3" ECU_ADDRESS 0x60013DFA /end MEASUREMENT
/begin MEASUREMENT mshfm_w "air-mass flow HFM" UWORD m_q0p1 1 100 0.00 6553.500 FORMAT "%8.3" ECU_ADDRESS 0x7000322E /end MEASUREMENT
/begin MEASUREMENT mshfm_w_msg "air-mass flow HFM" UWORD m_q0p1 1 100 0.00 6553.500 FORMAT "%8.3" ECU_ADDRESS 0x600007FE /end MEASUREMENT
/begin MEASUREMENT msnagrs2_w_msg "target value extern egr mass flow (standardized), valve2" UWORD m_q0p1 1 100 0.00 6553.500 FORMAT "%8.3" ECU_ADDRESS 0x600015C8 /end MEASUREMENT
/begin MEASUREMENT msnagrs_w_msg "target value extern egr mass flow (standardized)" UWORD m_q0p1 1 100 0.00 6553.500 FORMAT "%8.3" ECU_ADDRESS 0x600015C6 /end MEASUREMENT
/begin MEASUREMENT ofpsr_w_msg "Offset Voltage pressure sensor manifold pressure (word)" SWORD p_q0p039 1 100 -1280.000 1279.961 FORMAT "%8.3" ECU_ADDRESS 0x50005F0C /end MEASUREMENT
/begin MEASUREMENT ofpu_w "Offset-voltage for ambient pressure sensor" SWORD p_q0p039 1 100 -1280.000 1279.961 FORMAT "%8.3" ECU_ADDRESS 0x60008FB6 /end MEASUREMENT
/begin MEASUREMENT ofpu_w_msg "Offset-voltage for ambient pressure sensor" SWORD p_q0p039 1 100 -1280.000 1279.961 FORMAT "%8.3" ECU_ADDRESS 0x60008FB4 /end MEASUREMENT
/begin MEASUREMENT pdblagri_w "Iterative pressure difference caused by egr mass flow line resistance" UWORD p_uw_q0p039 1 100 0.00 2559.961 FORMAT "%8.3" ECU_ADDRESS 0x600011E8 /end MEASUREMENT
/begin MEASUREMENT pdblagr_w "pressure difference caused by egr mass flow line resistance" UWORD p_uw_q0p039 1 100 0.00 2559.961 FORMAT "%8.3" ECU_ADDRESS 0x600011E6 /end MEASUREMENT
/begin MEASUREMENT pmvagrv_w "min. pressure of valve1 and 2" UWORD p_q0p078 1 100 0.00 5119.922 FORMAT "%8.3" ECU_ADDRESS 0x600011E4 /end MEASUREMENT
/begin MEASUREMENT PNAGRVFBA_CL_I.pnagrvX_w "Class instance for somputing pressure downstream EGR valve / pressure downstream of EGR valve" UWORD p_q0p078 1 100 0.00 5119.922 FORMAT "%8.3" ECU_ADDRESS 0x600011DC /end MEASUREMENT
/begin MEASUREMENT pnagrvm_w_msg "model based pressure downtream of egr valve" UWORD p_q0p078 1 100 0.00 5119.922 FORMAT "%8.3" ECU_ADDRESS 0x600015BA /end MEASUREMENT
/begin MEASUREMENT pnagrv_w_msg "pressure downtream of egr valve" UWORD p_q0p078 1 100 0.00 5119.922 FORMAT "%8.3" ECU_ADDRESS 0x600015BC /end MEASUREMENT
/begin MEASUREMENT psagrmx_w_msg "max. manifold pressure caused by egr" UWORD p_uw_q0p078 1 100 0.00 5119.922 FORMAT "%8.3" ECU_ADDRESS 0x600015B8 /end MEASUREMENT
/begin MEASUREMENT psagrugb_w_msg "max. manifold pressure caused by egr (unthrottled) limited" UWORD p_uw_q0p078 1 100 0.00 5119.922 FORMAT "%8.3" ECU_ADDRESS 0x600015B6 /end MEASUREMENT
/begin MEASUREMENT psagrugd_w_msg "Manifold pressure by EGR unthrottled" UWORD p_uw_q0p078 1 100 0.00 5119.922 FORMAT "%8.3" ECU_ADDRESS 0x600015B4 /end MEASUREMENT
/begin MEASUREMENT psfglm_w_msg "Fresh-air partial pressure in intake manifold), HFM-based + int. residual gas" UWORD p_uw_q0p039 1 100 0.00 2559.961 FORMAT "%8.3" ECU_ADDRESS 0x70003774 /end MEASUREMENT
/begin MEASUREMENT psrrexts_w_msg "target value: egr pressure (burned gas + air) in manifold caused by extern egr" UWORD p_uw_q0p078 1 100 0.00 5119.922 FORMAT "%8.3" ECU_ADDRESS 0x600015A6 /end MEASUREMENT
/begin MEASUREMENT psrrldc_w_msg "Manifold air pressure last DC" UWORD p_q0p078 1 100 0.00 5119.922 FORMAT "%8.3" ECU_ADDRESS 0x60008D2E /end MEASUREMENT
/begin MEASUREMENT ps_w_msg "intake manifold pressure (absolute) (Word)" UWORD p_uw_q0p039 1 100 0.00 2559.961 FORMAT "%8.3" ECU_ADDRESS 0x60000808 /end MEASUREMENT
/begin MEASUREMENT pus_w_msg "Ambient pressure without substitution on sensor error" UWORD p_uw_q0p039 1 100 0.00 2559.961 FORMAT "%8.3" ECU_ADDRESS 0x60001444 /end MEASUREMENT
/begin MEASUREMENT pvagrvi_w "iterative pressure upstream of egr valve" UWORD p_uw_q0p078 1 100 0.00 5119.922 FORMAT "%8.3" ECU_ADDRESS 0x600011E2 /end MEASUREMENT
/begin MEASUREMENT pvagrvm_w_msg "model based pressure upwntream of egr valve" UWORD p_uw_q0p039 1 100 0.00 2559.961 FORMAT "%8.3" ECU_ADDRESS 0x6000159A /end MEASUREMENT
/begin MEASUREMENT pvagrv_w_msg "pressure upstream of egr valve" UWORD p_uw_q0p039 1 100 0.00 2559.961 FORMAT "%8.3" ECU_ADDRESS 0x6000159C /end MEASUREMENT
/begin MEASUREMENT pvblzsr_w_msg "pressure upstream of blind before intake manifold" UWORD p_q0p078 1 100 0.00 5119.922 FORMAT "%8.3" ECU_ADDRESS 0x60001598 /end MEASUREMENT
/begin MEASUREMENT pvdkds_w_msg "Pressure in front of throttle valve of pressure sensor (word)" UWORD p_uw_q0p039 1 100 0.00 2559.961 FORMAT "%8.3" ECU_ADDRESS 0x7000376A /end MEASUREMENT
/begin MEASUREMENT rfoirext_w_msg "Relative charge without the inert-restgas from external EGR" UWORD rel_q0p02344 1 100 0.00 1535.977 FORMAT "%8.3" ECU_ADDRESS 0x60001594 /end MEASUREMENT
/begin MEASUREMENT rfrextfs_w_msg "rel.desired charge(int.gas+air) egr filtered" UWORD rel_uw_q0p0234 1 100 0.00 1535.977 FORMAT "%8.3" ECU_ADDRESS 0x60000D28 /end MEASUREMENT
/begin MEASUREMENT rfrexts_w_msg "rel.desired charge(int.gas+air) egr" UWORD rel_uw_q0p0234 1 100 0.00 1535.977 FORMAT "%8.3" ECU_ADDRESS 0x60001590 /end MEASUREMENT
/begin MEASUREMENT rireugds_w "relative desired inertgas charge at EGR at pressure ratio 0.95" UWORD rel_uw_q0p0234 1 100 0.00 1535.977 FORMAT "%8.3" ECU_ADDRESS 0x600011E0 /end MEASUREMENT
/begin MEASUREMENT rirexofs_w_msg "relative burned residual gas extern without egr-release in desired mode" UWORD rel_q0p02344 1 100 0.00 1535.977 FORMAT "%8.3" ECU_ADDRESS 0x6000157E /end MEASUREMENT
/begin MEASUREMENT rirextfs_w_msg "desired relative inertgas charge from ext. EGR filtered" UWORD rel_uw_q0p0234 1 100 0.00 1535.977 FORMAT "%8.3" ECU_ADDRESS 0x700050AE /end MEASUREMENT
/begin MEASUREMENT rirextsg_w_msg "desired valid relative inertgas charge from ext. EGR" UWORD rel_uw_q0p0234 1 100 0.00 1535.977 FORMAT "%8.3" ECU_ADDRESS 0x6000157A /end MEASUREMENT
/begin MEASUREMENT rirexts_w_msg "desired relative inertgas charge from ext. EGR" UWORD rel_q0p02344 1 100 0.00 1535.977 FORMAT "%8.3" ECU_ADDRESS 0x6000157C /end MEASUREMENT
/begin MEASUREMENT rlrextfs_w_msg "desired relative air charge from ext. EGR filtered" UWORD rel_uw_q0p0234 1 100 0.00 1535.977 FORMAT "%8.3" ECU_ADDRESS 0x60001566 /end MEASUREMENT
/begin MEASUREMENT rlrextsg_w_msg "desired valid air charge from external EGR" UWORD rel_uw_q0p0234 1 100 0.00 1535.977 FORMAT "%8.3" ECU_ADDRESS 0x60001562 /end MEASUREMENT
/begin MEASUREMENT rlrexts_w_msg "desired air charge ratio ext. egr" UWORD rel_uw_q0p0234 1 100 0.00 1535.977 FORMAT "%8.3" ECU_ADDRESS 0x60001564 /end MEASUREMENT
/begin MEASUREMENT rriextfs_w_msg "ratio of burned residual gas form extern egr filtered" UWORD rel_uw_b100 1 100 0.00 99.99847 FORMAT "%8.5" ECU_ADDRESS 0x6000154A /end MEASUREMENT
/begin MEASUREMENT stateaevab_msg "No. of the active state in AEVAB" UBYTE dez 1 100 0.00 255.0 FORMAT "%5.1" ECU_ADDRESS 0x600009A4 /end MEASUREMENT
/begin MEASUREMENT ThrVlv_ratActPosnLoc "Autosar named Actuatorposition" SWORD rel_q0p0078125 1 100 -256.0000 255.9922 FORMAT "%8.4" ECU_ADDRESS 0x6000826A /end MEASUREMENT
/begin MEASUREMENT TS_nMinAC "idle speed request" SWORD EngN 1 100 -16384.00 16383.50 FORMAT "%8.2" ECU_ADDRESS 0x60009788 /end MEASUREMENT
/begin MEASUREMENT ummsnma_w_msg "Conversion of standardized mass flow into mass flow at EGR valve" UWORD fak_uw_b8 1 100 0.00 7.999878 FORMAT "%8.6" ECU_ADDRESS 0x60001538 /end MEASUREMENT
/begin MEASUREMENT umsnmsa_w_msg "Conversion of standardized mass flow into mass flow at EGR valve" UWORD fak_uw_b4 1 100 0.00 3.999939 FORMAT "%8.6" ECU_ADDRESS 0x60001536 /end MEASUREMENT
/begin MEASUREMENT vpsvagb_w_msg "quotient: int.manif.pressure divided by pressure upstream of egr valve" UWORD fak_q3p0518Em5 1 100 0.00 1.999969 FORMAT "%8.6" ECU_ADDRESS 0x60001530 /end MEASUREMENT
/begin MEASUREMENT vpsvag_w "pressure ratio at EGR valve" UWORD fak_q3p0518Em5 1 100 0.00 1.999969 FORMAT "%8.6" ECU_ADDRESS 0x60001532 /end MEASUREMENT
/begin MEASUREMENT wblagr_w "resistance of egr mass flow line" UWORD fak_uw_b32 1 100 0.00 31.99951 FORMAT "%8.5" ECU_ADDRESS 0x6000152C /end MEASUREMENT
/begin MEASUREMENT wsevslef "wait state for B_evasldel, from moment no cutoff activ" UBYTE dez 1 100 0.00 255.0 FORMAT "%5.1" ECU_ADDRESS 0x5000097B /end MEASUREMENT
/begin MEASUREMENT zkrriehx_w "Time constant.:desired value filter. external residual exhaust gas rate" UWORD zk10msxs_uw_b655p36 1 100 0.01000015 655.36000000 FORMAT "%12.8" ECU_ADDRESS 0x6000151A /end MEASUREMENT
/begin FUNCTION ACCtl_Demand "71.4.0    Air Condition Compressor Control"
 /begin DEF_CHARACTERISTIC ACCtl_facACCtrlCurrCorrVal_C ACCtl_facACtrDwnCtrlVal_C ACCtl_flgACTqDwnReqDisad_C ACCtl_flgEngSpdCdnSel_C ACCtl_flgSwtAcAndCutCdn_C ACCtl_flgSwtAcTq_C ACCtl_iACCtrlCurrUpprVal_C ACCtl_nCmprMax_C ACCtl_nEngACCutThd_C ACCtl_nEngHiCoolgPrf_C ACCtl_nEngHiShtOff_T ACCtl_nEngHiTow_C ACCtl_nEngLoCoolgPrf_C ACCtl_nEngLoShtOff_T ACCtl_nEngLoTow_C ACCtl_nMin_C ACCtl_nrACCutPrmsECONOff_T ACCtl_nrACCutPrmsECONOn_T ACCtl_pACMaxHi_C ACCtl_pACMaxLo_C ACCtl_pACMinHi_C ACCtl_pACMinLo_C ACCtl_pACPDwnCorrVal_C ACCtl_pACTqDwnPCorrVal_C ACCtl_pClntTmr_CUR ACCtl_rACCpAccrPedlOpngDetrm_C ACCtl_rACCpDwnAccrPedlThd_C ACCtl_rAccPedClmbHi_C ACCtl_rAccPedClmbLo_C ACCtl_rAccPedHi_CUR ACCtl_rAccPedLo_C ACCtl_rAccPedMid_CUR ACCtl_rACCpTmrRstAccrPedlThd_C ACCtl_rCmprPlly_C ACCtl_stAcShOffCdn_C ACCtl_stDecelACCtrlSwt_C ACCtl_stSwtAcCdn_C ACCtl_stSwtTrqResvSec_C ACCtl_swtAcECU_C ACCtl_swtHeatrCorePrsnt_C ACCtl_swtResv_C ACCtl_tEngHiCoolgPrf_C ACCtl_tEngHiTow_C ACCtl_tEngLoCoolgPrf_C ACCtl_tEngLoTow_C ACCtl_tEvapACCutHi_T ACCtl_tEvapACCutLo_T ACCtl_tEvapMinHi_C ACCtl_tEvapMinLo_C ACCtl_tEvaSnsrErr_C ACCtl_tiACCmprTqReqTi_T ACCtl_tiACCpDwnImplTi_C ACCtl_tiAccPedBuf_C ACCtl_tiACCpTqReqTmrMax_C ACCtl_tiAcCutDebThdHiLo_C ACCtl_tiAcCutDebThdLoHi_C ACCtl_tiAcCutOperRepDly_C ACCtl_tiACPOffDly_C ACCtl_tiACTond_C ACCtl_tiACTrqDlyImdt_C ACCtl_tiACTrqDly_C ACCtl_tiClmbSpdThdDly_C ACCtl_tiDebIdlSpdOnDly_C ACCtl_tiDebIdlSpdSec_C ACCtl_tiDlyAcOn_C ACCtl_tiDlyClmbOn_C ACCtl_tiDlyCrkNotCmpl_C ACCtl_tiDlyEngNOn_C ACCtl_tiDlyEvaErrOff_C ACCtl_tiDlyEvaErrOn_C ACCtl_tiInhbACCutPrmsACOn_C ACCtl_tiInhbACCutPrms_C ACCtl_tiOutDlyImdt_C ACCtl_tiOutDly_C ACCtl_tiStrtCutTmrCdn_C ACCtl_tiStrtCutTmrHi_C ACCtl_tiStrtCutTmrMid_C ACCtl_tiSwOffResv_C ACCtl_tiTrqResvSec_C ACCtl_tqACCmprTqReqDurgAPOpng_T ACCtl_tqDwnDurgDecel_C ACCtl_tqMaxAcLim_C ACCtl_tqMaxTqCrksftEngSpdEnd_C ACCtl_trqMaxAC_C ACCtl_vACCpLowrVehSpdThd_C ACCtl_vACCpUpprVehSpdThd_C ACCtl_vACTrqDecHiThd_C ACCtl_vACTrqDecLoThd_C ACCtl_vVehAcCutOnThd_C ACCtl_vVehChkHiThd_C ACCtl_vVehChkLoThd_C ACCtl_vVehClmbHi_C ACCtl_vVehClmbLo_C ACCtl_vVehHiCoolgPrf_C ACCtl_vVehLoCoolgPrf_C ACCtl_vVehStrtCutInhbHi_C ACCtl_vVehStrtCutInhbLo_C /end DEF_CHARACTERISTIC
 /begin IN_MEASUREMENT ACComp_pLoPVal ACComp_trqStat AccPed_flgIDSFctAvl AccPed_swtDrvMod ACCtl_stDecelACCutDmd ACEvpT_t AirC_pClnt AirC_stCmprAct B_dknotb B_ll CoEng_nFco CoEng_st Com_flgACCutDurgAtCvt Com_iACCmpr Com_stACCut Com_stIMGIDSDrvMod CoTS_trqMaxAC CoVeh_tqDrvOff2MaxAC CoVeh_tqIdleMaxAC EngDa_tEng EngPrt_bOvhtEngLim Epm_nEng Epm_nEng10ms HLSDem_nSetPLo I14229_stACCompDeActvOn PthSet_trqInrCtOff PT_stTraType RngMod_trqInrBs T15_st Tra_numGear Tra_stCrkNotCmpl TS_stMnSwtAC VehMot_rAccPedFlt VehV_v VMD_rVirtAPP wtacvol_w /end IN_MEASUREMENT
 /begin OUT_MEASUREMENT ACCtl_flgACCutPrms ACCtl_flgACDwnExe ACCtl_flgACOnCdnTCU ACCtl_flgACReq ACCtl_flgClr ACCtl_flgDecelACCut ACCtl_flgEngTqDwnReq ACCtl_flgGearShiftDetdLst ACCtl_flgMgcOn ACCtl_flgSnsrErrStrtCut ACCtl_flgSwOffResv ACCtl_flgSwtAcAndCutCdn ACCtl_iCmprDwnIReq ACCtl_nrACCutPrms ACCtl_stACCut ACCtl_stOut ACCtl_stShOffCdnSlow ACCtl_stSwtAc ACCtl_stTrqResv ACCtl_tqACDecelReqVal ACCtl_tqACDwnDurgStrt ACCtl_tqDwnDurgDecel AC_trqMaxAC TS_nMinAC /end OUT_MEASUREMENT
 /begin LOC_MEASUREMENT ACCtl_drAccPedStrtCut ACCtl_facACLoPDwnCorrVal_MP ACCtl_facACTqDwnCorrVal_MP ACCtl_flgACCutEnaCdn Acctl_flgACCutEnaSts ACCtl_flgACCutExe ACCtl_flgAcCutOperRep ACCtl_flgAcCutStep2Prfm ACCtl_flgAcShOffImdt ACCtl_flgClmbAcCut ACCtl_flgEngTqDwnReqEna ACCtl_flgGearShiftDetd ACCtl_flgHillClmbDet ACCtl_flgLoEngNShOff ACCtl_flgMgcOnDly ACCtl_flgStrtCut ACCtl_flgStrtCutHi ACCtl_flgStrtCutInhb ACCtl_flgStrtgCpDwnAccrPedl ACCtl_flgVehSpdAcCut ACCtl_flgVehSpdDetClmb ACCtl_iCmprDwnIReqVal ACCtl_nrAccPedSt ACCtl_pACLoPDwnCorrVal_MP ACCtl_pACLoPFinalVal_MP ACCtl_pTqDwnLoPVal ACCtl_rAppSig ACCtl_stDecelACCutDmdRst ACCtl_stDecelACCutPrms ACCtl_stEngFullOpenSts ACCtl_stEvapTACShOff_mp ACCtl_stFinshdACCutEnf ACCtl_stInhbACCutPrms ACCtl_stInhbACCutPrmsACOn ACCtl_stMagCluFall ACCtl_stOut_tmp ACCtl_stShOffCdn ACCtl_stSwtACRisng ACCtl_stTrqResv_tmp ACCtl_tEvapACCutHi_MP ACCtl_tEvapACCutLo_MP ACCtl_tiACCmprTqReqTi ACCtl_tiACCpTqReqTmr ACCtl_tiAcCutOperRepDly ACCtl_tiClmbSpdThdDly ACCtl_tiClntTmr ACCtl_tiDecelACCutEnf ACCtl_tiStrtCutTmr ACCtl_tiStrtCutTmrCdn ACCtl_tiStrtCutTmrCdnTmp ACCtl_tqACCmprReqTqAPOpng ACCtl_tqACDecelReq AirC_stCmprAct_tmp /end LOC_MEASUREMENT
 FUNCTION_VERSION "71.4.0" /end FUNCTION
/begin FUNCTION ACEvpT_DD "5.1.0     AC Evaporator Temperature Sensor"
 /begin DEF_CHARACTERISTIC ACEvpT_PhysRng.Min_C ACEvpT_PhysRng.Max_C ACEvpT_SRC.uMin_C ACEvpT_SRC.uMax_C ACEvpT_stCodMsk_C ACEvpT_swtSensPres_C ACEvpT_swtSig_C ACEvpT_tBCANErr_C ACEvpT_tCANErrDftVal_C ACEvpT_tDfl_C ACEvpT_tFCANErr_C ACEvpT_tiCANDly_C ACEvpT_tTransf_CUR ACEvpT_uRawDfl_C /end DEF_CHARACTERISTIC
 /begin IN_MEASUREMENT Com_tMtrEva /end IN_MEASUREMENT
 /begin OUT_MEASUREMENT ACEvpT_t ACEvpT_tAvg ACEvpT_uRaw /end OUT_MEASUREMENT
 FUNCTION_VERSION "5.1.0" /end FUNCTION
/begin FUNCTION ACSwt_DD "2.4.0     AC Switch Device Driver" /begin IN_MEASUREMENT Com_stAC ThDev_flgACMaiSwtCodVal ThDev_stMaiSwtACSig /end IN_MEASUREMENT /begin OUT_MEASUREMENT AirC_stSwtRaw /end OUT_MEASUREMENT FUNCTION_VERSION "2.4.0" /end FUNCTION
/begin FUNCTION ACSwt_VD "29.0.0    AC Switch Virtual Device"
 /begin DEF_CHARACTERISTIC ACSwt_stMnSwtDebEna_C ACSwt_tiSwtDebHiLo_C ACSwt_tiSwtDebLoHi_C AirC_stSwtDfl_C /end DEF_CHARACTERISTIC
 /begin IN_MEASUREMENT ACClntP_bCodAvl AirC_stSwtRaw Com_stAC T15_st ThDev_stMaiSwtACSig /end IN_MEASUREMENT
 /begin OUT_MEASUREMENT AirC_stSwt AirC_stSwtDeb AirC_stSwtPrsnt /end OUT_MEASUREMENT
 /begin LOC_MEASUREMENT ACSwt_ValSwtflg_MP /end LOC_MEASUREMENT
 FUNCTION_VERSION "29.0.0" /end FUNCTION
/begin FUNCTION ActMod_PwrCalc "1.2.0     Calculation of current engine power" /begin IN_MEASUREMENT ActMod_trqCrS ActMod_trqInr Epm_nEng /end IN_MEASUREMENT /begin OUT_MEASUREMENT ActMod_pwrCrksft ActMod_pwrInr /end OUT_MEASUREMENT FUNCTION_VERSION "1.2.0" /end FUNCTION
/begin FUNCTION ActMod_TrqCalc "2.9.0     Computation of actual engine torques"
 /begin IN_MEASUREMENT ActMod_bEngActv InjSys_stActRedStg PthSet_stTrgFCO PthSet_trqInrWoDstC PT_tqCrksftSetWoIntv PT_tqCrksftSetWoTrsmIntv RngMod_trqClthMin RngMod_trqCrSMin RngMod_trqInrBs /end IN_MEASUREMENT
 /begin OUT_MEASUREMENT ActMod_trqClthWoDstC ActMod_trqClthWoIntv ActMod_trqClthWoTraIntv ActMod_trqCrSWoDstC ActMod_trqCrSWoIntv ActMod_trqCrSWoTraIntv ActMod_trqInrWoDstC ActMod_trqInrWoIntv ActMod_trqInrWoTraIntv /end OUT_MEASUREMENT
 /begin LOC_MEASUREMENT ActMod_stTrgFCO10_2 ActMod_stTrgFCO10_3 ActMod_stTrgFCOsyn ActMod_stTrgFCOsyns /end LOC_MEASUREMENT
 FUNCTION_VERSION "2.9.0" /end FUNCTION
/begin FUNCTION ADCADAP "4.3.0     software adapter of MF ADC" /begin DEF_CHARACTERISTIC SF_DSS SF_DSU /end DEF_CHARACTERISTIC
 /begin IN_MEASUREMENT B_fedssb_msg B_msdkhfmg_msg ChrCtl_flgChrgCalcnTiBasd dpsrfg_w_msg fisrm_w_msg ftvdk_w_msg PEnv_pRaw psrfgmh_w_msg psr_w_msg pvd_w_msg SyC_stSub /end IN_MEASUREMENT
 /begin OUT_MEASUREMENT B_dssakt_msg B_hfm_msg dpsfg_w_msg ftvdk_msg fvisrm_w_msg psfglm_w_msg ps_w_msg pus_w_msg pvdkds_w_msg /end OUT_MEASUREMENT
 FUNCTION_VERSION "4.3.0" /end FUNCTION
/begin FUNCTION AEVAB "17.10.0   Output injection valve cut off"
 /begin DEF_CHARACTERISTIC ABMM4 CWEVAB InjSys_FcoCylInd_ATS_ATS.LimitTypeMsk_C InjSys_FcoCylInd_ATS_ATS.CnvNorm_C InjSys_FcoCylInd_ATS_ATS.LowLim_C InjSys_FcoCylInd_ATS_ATS.UpLim_C InjSys_FcoCylInd_ATS_ATS.CnvFac_C InjSys_FcoCylInd_ATS_ATS.CnvOfs_C InjSys_FcoCylInd_ATS_ATS.DfltVal_C /end DEF_CHARACTERISTIC
 /begin IN_MEASUREMENT abmhdev_msg abmznd_msg B_basch_msg B_faevz_msg devoff_msg EpmBCa_stInjMask Epm_ctCyl IKCtl_stReqInjD_b8 MisfDet_stCatDmgFcoCyl TrqCnv_numRedStgDem zzylh_msg zzyls_msg /end IN_MEASUREMENT
 /begin OUT_MEASUREMENT abmf_msg B_dmdstnew_msg eevx_msg evrbgn_one_msg evz_aus_msg fevab_msg stateaevab_msg /end OUT_MEASUREMENT
 /begin LOC_MEASUREMENT abmm anzsyn B_dmdevab B_fevab B_redsol dmdevab InjSys_bFcoCylIndTstr InjSys_ctCylOld InjSys_FcoCylIndTstr /end LOC_MEASUREMENT
 FUNCTION_VERSION "17.10.0" /end FUNCTION
/begin FUNCTION AEVABZK "7.12.0    Output injection-valve cut-off %MDRED + total shutdown by monitioring functions"
 /begin IN_MEASUREMENT B_dmdstnew_msg B_evabu_msg B_koevab_msg B_noinjdst_msg B_stendes_msg B_stendmd_msg Epm_ctCyl evz_aus_msg InjSys_ofsCylCntrHom InjSys_ofsCylCntrStrat InjSys_stInjTmng MoCSOP_stActvMsg OCWDA_stErrMonPtt SyC_stSub ThrVlv_flgLimpModeB1 ThrVlv_flgReqFuCutOffB1 zzylh_msg zzyls_msg /end IN_MEASUREMENT
 /begin OUT_MEASUREMENT B_evasldel_msg evz_auscpl_msg evz_austot_msg InjSys_flgCutOffReqTyp2 InjSys_flgNoDlyMisfDetTrig InjSys_flgNoInjReq InjSys_stDlyNoInjReq /end OUT_MEASUREMENT
 /begin LOC_MEASUREMENT B_cutoffEFNM InjSys_flgNoInjReq_GDI wsevslef /end LOC_MEASUREMENT
 FUNCTION_VERSION "7.12.0" /end FUNCTION
/begin FUNCTION AFS_DD "33.25.0   Device driver for air flow sensor"
 /begin DEF_CHARACTERISTIC AFS_mfThdFilActv_C AFS_mfTrafoAnB1_T AFS_nEngRunngMin_C AFS_nrSegSldgAvrg_C AFS_nThdMaxFilActv_C AFS_nThdMinFilActv_C AFS_stSwtEnaSldgAvrg_C AFS_stSwtNrSegAvrgB1_C AFS_stSwtRelsEngRunng_C AFS_stSwtResiCalcn_C AFS_tiDebBattVcc_C AFS_tiDebEngRunng_C AFS_tiPt1B1_T AFS_tiPt1MFlowThrVlv_C AFS_tiPt1StatyFil_T AFS_uBattThdHi_C AFS_uBattThdLo_C AFS_uRawSrcMaxThd_C AFS_uRawSrcMinThd_C /end DEF_CHARACTERISTIC
 /begin IN_MEASUREMENT AFS_uSnsrRawB1 BattU_u EpmCrS_tiSeg Epm_nEng Epm_nEng10ms Epm_stSpd msdk_w_msg T15_st /end IN_MEASUREMENT
 /begin OUT_MEASUREMENT AFS_flgEngRunng AFS_flgSigDiagRels AFS_flgSigErrLineHiDiagB1 AFS_flgSigErrLineLoDiagB1 AFS_flgSnsrSigInvldB1 AFS_flgSnsrVccAvl AFS_mfMeasB1 AFS_mfRawB1 AFS_mfSnsrPid /end OUT_MEASUREMENT
 /begin LOC_MEASUREMENT AFS_cntRawSmplB1 AFS_cntSigErrB1 AFS_facDeltaMFlowThrVlv AFS_flgRawSigRngHiB1 AFS_flgRawSigRngLoB1 AFS_flgSentCommErrB1 AFS_flgSigErrLineHiB1 AFS_flgSigErrLineLoB1 AFS_flgSigInvldB1 AFS_flgSigInvldRawB1 AFS_flgSigInvldUnDebB1 AFS_flgSnsrErrB1 AFS_flgSnsrInitB1 AFS_flgStatyFilActv AFS_mfAvrgCurrSegB1 AFS_mfAvrgPrevSegB1 AFS_mfFirstValCurrSegB1 AFS_mfLastValPrevSegB1 AFS_mfPrevSegB1 AFS_mfRawAvrgB1 AFS_mfRawAvrgFildB1 AFS_mfRawFildB1 AFS_mfRawSumB1 AFS_mfSldAvrgFil AFS_mfThrVlvFild AFS_mRawAvrgBufB1 AFS_tiDeltaPrevSegB1 AFS_tiDeltaSegB1 AFS_tiPt1B1 AFS_tiPt1StatyFil AFS_tiSeg AFS_tiSegBufB1 AFS_tiSigInvldDebB1 AFS_tiSmplTime /end LOC_MEASUREMENT
 FUNCTION_VERSION "33.25.0" /end FUNCTION
/begin FUNCTION AFS_SnsrIf "1.17.0    Sensor Interface of Air Flow Sensor (AFS)" /begin OUT_MEASUREMENT AFS_idxWriteAnB1 AFS_uBufAirMFlowSnsrB1 AFS_uSnsrRawB1 /end OUT_MEASUREMENT FUNCTION_VERSION "1.17.0" /end FUNCTION
/begin FUNCTION AFS_VD "33.24.0   Virtual driver for air flow sensor"
 /begin DEF_CHARACTERISTIC AFS_cntrCrkshtRev_C AFS_mfPhyRngHiB1_C AFS_mfPhyRngLoB1_C AFS_mfThdMinB1_C AFS_nEngMinPhyRngDiag_C AFS_tiEgrDiagRelsDeb_C AFS_tiPt1PhyRngDiagB1_C /end DEF_CHARACTERISTIC
 /begin IN_MEASUREMENT AFS_facPlstCorrn AFS_flgEngRunng AFS_flgPlausDiagErr AFS_flgSigDiagRels AFS_flgSnsrSigInvldB1 AFS_flgVrntDiagErrB1 AFS_mfMeasB1 B_dagrss_msg EpmCrS_ctRevStrt Epm_nEng Epm_stSpd SyC_stSub /end IN_MEASUREMENT
 /begin OUT_MEASUREMENT AFS_mfB1 AFS_mfSnsrB1 B_ehfm B_ehfm_msg B_mshfmgg B_mshfmgg_msg mshfms_w mshfms_w_msg mshfm_w mshfm_w_msg /end OUT_MEASUREMENT
 /begin LOC_MEASUREMENT AFS_flgLoPrcRelsB1 AFS_flgPhyRngDiagEnad AFS_flgPhyRngDiagRelsB1 AFS_flgPhyRngErrB1 AFS_flgSegNotCompl AFS_mfFildB1 /end LOC_MEASUREMENT
 FUNCTION_VERSION "33.24.0" /end FUNCTION
/begin FUNCTION AFS_VDPlaus "19.15.0   Plausibility check for air flow sensor"
 /begin DEF_CHARACTERISTIC CWHFMPL DMSHFM FDMSHFMM FDMSHFMMFA FDMSHFMMH FHFMTOLN FHFMTOLX IMG_CHFMR NHFMSVMN NHFMSVMX TDEHFMPL TDMLHFM WDKHFMSVMN WDKHFMSVMX /end DEF_CHARACTERISTIC
 /begin IN_MEASUREMENT AFS_flgSigDiagRels AFS_flgSnsrSigInvldB1 AFS_mfRawB1 AFS_mfSnsrB1 B_cdehfm_msg B_dmshfmdg_msg B_fahfm_msg B_msdkhnxg_msg EpmRRS_stRotDir Epm_nEng mshmdkmn_w_msg mshmdkmx_w_msg SyC_ctPostDrvLeave ThrVlv_flgSngSensErrSuspcB1 ThrVlv_ratActPosnB1 /end IN_MEASUREMENT
 /begin OUT_MEASUREMENT AFS_flgPlausDiagErr AFS_flgVrntDiagErrB1 B_zhfmpl_msg /end OUT_MEASUREMENT
 /begin LOC_MEASUREMENT AFS_cntrReIniDiag100ms AFS_cntrReIniDiag20ms AFS_flgEnaPlausDiag AFS_flgEnaVrntDiag AFS_flgInhbnPlausDiag AFS_flgInhbnVrntDiag AFS_flgPlausDiagErrHi AFS_flgPlausDiagErrLo AFS_flgRstDsmPlausDiag B_hfmsvmn B_hfmsvmni B_hfmsvmx B_hfmsvmxi B_hfmsvt B_nchfmr fdmshfmmthd_w fdmshfmm_w mshfmmn_w mshfmmx_w mshfmtn_w mshfmtx_w /end LOC_MEASUREMENT
 FUNCTION_VERSION "19.15.0" /end FUNCTION
/begin FUNCTION AFS_VDPlsCorr "8.11.1    AFS pulsation correction VD"
 /begin DEF_CHARACTERISTIC AFS_facPlstCorrnDev123_MAP AFS_facPlstCorrnDev12_MAP AFS_facPlstCorrnDev13_MAP AFS_facPlstCorrnDev1_MAP AFS_facPlstCorrnDev23_MAP AFS_facPlstCorrnDev2_MAP AFS_facPlstCorrnDev3_MAP AFS_facPlstCorrnDevCold_MAP AFS_facPlstCorrn_MAP AFS_facTInflPlstCorrn_CUR AFS_LowrSwtPntPlstCorrnDev1_C AFS_LowrSwtPntPlstCorrnDev2_C AFS_LowrSwtPntPlstCorrnDev3_C AFS_stSelnDev1_C AFS_stSelnDev2_C AFS_stSelnDev3_C AFS_stSelnHomOperModMask_C AFS_UpprSwtPntPlstCorrnDev1_C AFS_UpprSwtPntPlstCorrnDev2_C AFS_UpprSwtPntPlstCorrnDev3_C /end DEF_CHARACTERISTIC
 /begin IN_MEASUREMENT B_agrvo_msg B_vheg_msg Epm_nEng fnwue_msg GEVCtl_facTranColdWrmIntk GEVCtl_stGslSpIntk tans_msg ThrVlv_ratActPosnB1 /end IN_MEASUREMENT
 /begin OUT_MEASUREMENT AFS_facPlstCorrn /end OUT_MEASUREMENT
 /begin LOC_MEASUREMENT AFS_facPlstCorrnCold_MP AFS_facPlstCorrn_MP AFS_facPlstInflDev1 AFS_facPlstInflDev2 AFS_facPlstInflDev3 AFS_facPlstIntrpn_MP AFS_facTInflPlstCorrn AFS_facTranColdWrmIntkLoc AFS_flgPlstIntrpnSwt AFS_nEngTCorrd AFS_nrCurrPlstCorrnMap AFS_stHomOperMod ThrVlv_ratActPosnLoc /end LOC_MEASUREMENT
 FUNCTION_VERSION "8.11.1" /end FUNCTION
/begin FUNCTION AGRPSOL "15.1.0    EGR value position - desired value"
 /begin DEF_CHARACTERISTIC CWAGRPSOL DENRRIESF FDVAGR FKBLAGRA FKGMSAGRPV KFAPMSNVP KFVPVASRMX KLWBLAGR RLRDAGRS ZKRRIEHSF /end DEF_CHARACTERISTIC
 /begin REF_CHARACTERISTIC FKVDVP FKLAFUGD VPSRVDUGD /end REF_CHARACTERISTIC
 /begin IN_MEASUREMENT B_agrfsg_msg B_cdagr_msg B_dagrss_msg B_eagrv_msg B_sa_msg Epm_nEng fkblagr_w_msg fkmsagrs_w_msg miglsol_w_msg msagrsr_w_msg msagrvmx_w_msg msagr_w_msg ofvpagr_w_msg pagreo_w_msg psrs_w_msg psr_w_msg reclagre_w_msg rfextmxi_w_msg rfextmx_w_msg rfextugdi_w_msg rfextugd_w_msg rfreugds_w_msg rirext_w_msg rirints_w_msg rlrext_w_msg rlsolg_w_msg rriexofs_w_msg rriexts_w_msg rrsexts_w_msg SyC_stSub tgagrv_msg tgnagrv_w_msg tgvagrv_w_msg umsrlnk_w_msg /end IN_MEASUREMENT
 /begin OUT_MEASUREMENT agrvps_w_msg agrvugdi_w_msg agrvugd_w_msg B_agron_msg B_msagrsb_msg fktpbagrds_w_msg fktpbagr_w_msg ftmagr_msg msagrbs_w_msg msagrmxi_w_msg msagrmx_w_msg msagrs2_w_msg msagrsrs_w_msg msagrs_w_msg msagrugdi_w_msg msagrugd_w_msg msagsrsg_w_msg msastats_w_msg msnagrs2_w_msg msnagrs_w_msg pnagrvm_w_msg pnagrv_w_msg psagrmx_w_msg psagrugb_w_msg psagrugd_w_msg psrrexts_w_msg pvagrvm_w_msg pvagrv_w_msg pvblzsr_w_msg rfoirext_w_msg rfrextfs_w_msg rfrexts_w_msg rirexofs_w_msg rirextfs_w_msg rirextsg_w_msg rirexts_w_msg rlrextfs_w_msg rlrextsg_w_msg rlrexts_w_msg rriextfs_w_msg ummsnma_w_msg umsnmsa_w_msg vpsvagb_w_msg /end OUT_MEASUREMENT
 /begin LOC_MEASUREMENT agrvpsb_w fkblagrz_w fkklaf_w ftpavag_w msagrbli_w msagruvi_w msagruv_w pdblagri_w pdblagr_w pmvagrv_w PNAGRVFBA_CL_I.pnagrvX_w pvagrvi_w rireugds_w vpsvag_w wblagr_w zkrriehx_w /end LOC_MEASUREMENT
 FUNCTION_VERSION "15.1.0" /end FUNCTION
/begin FUNCTION AirActr_OffsLrn "1.39.1    Adaptation of mechanical characteristic values" FUNCTION_VERSION "1.39.1" /end FUNCTION
/begin FUNCTION AirActr_PosnCtrl "1.36.0    Position Controller" FUNCTION_VERSION "1.36.0" /end FUNCTION
/begin FUNCTION AirActr_Sens "1.18.0    Position Sensor Evaluation" FUNCTION_VERSION "1.18.0" /end FUNCTION
/begin FUNCTION AirDvP_PSnsrAdpn "2.4.1     Calculation of offset values for pressure sensors"
 /begin DEF_CHARACTERISTIC AirDvP_flgAddEnaDly_C AirDvP_pEngStrtMax_C AirDvP_pEnvSpcSnsrTolr_C AirDvP_pIntkVUsSpcSnsrTolr_C AirDvP_tiDlyAftEngStop_C AirDvP_tiFilDifPEnv_C AirDvP_tiMaxSnsrAdpn_C /end DEF_CHARACTERISTIC
 /begin IN_MEASUREMENT B_psrgg_msg B_pugg_msg B_purg_msg Eep_EnvRamInvld Epm_stSpd PEnv_pRaw PIntkVUs_flgPRawVldB1 PIntkVUs_pRaw PIntkVUs_pRawIni PIntkVUs_stPresIniVld SyC_ctPostDrvLeave SyC_stSub /end IN_MEASUREMENT
 /begin OUT_MEASUREMENT AirDvP_flgEnaScc AirDvP_flgPIntkVUsStrtRngErrB1 AirDvP_flgPIntkVUsStrtRngHealB1 AirDvP_pEnvOffs AirDvP_pIntkVUsLdcB1 AirDvP_pIntkVUsOffsB1 B_epsrsg_msg B_fgfnpps_msg B_hepsrsg_msg ofpsr_w_msg ofpu_w ofpu_w_msg psrrldc_w_msg /end OUT_MEASUREMENT
 /begin LOC_MEASUREMENT AirDvP_flgEnaPMod AirDvP_flgEnaSccPEnv AirDvP_PEnvMax AirDvP_PEnvMin AirDvP_pIntkVUsOffsBndlsB1 /end LOC_MEASUREMENT
 FUNCTION_VERSION "2.4.1" /end FUNCTION
/begin FUNCTION AirMod_VlvLftCoorn "4.3.0     Coordination timing predicted aircharge and switching variable valve"
 /begin DEF_CHARACTERISTIC AirMod_agWidthCamProfIntk_C AirMod_agWidthCamProfLoLftIntk_C AirMod_cntrDlyVlvLftLftIntk_C AirMod_flgVlvLftIntkStrt_C AirMod_ratChrgDeltaVlvLftIntkThres_C /end DEF_CHARACTERISTIC
 /begin IN_MEASUREMENT B_fupivheg_msg B_rlvheg_msg B_vhegvss_msg CoEOM_bHOM drldvls_w_msg wprhom_w_msg wvhesd_w_msg /end IN_MEASUREMENT
 /begin OUT_MEASUREMENT AirMod_flgCoVlvLft B_vhefeps_msg B_vhegabgn_msg /end OUT_MEASUREMENT
 /begin LOC_MEASUREMENT AirMod_cntrDlyPredVlvLftIntk asegvsyn B_vhefepsloc B_vhesynon /end LOC_MEASUREMENT
 FUNCTION_VERSION "4.3.0" /end FUNCTION
/begin FUNCTION AltECU_Lin "27.7.0    LIN-Communikation for GEN-ECU"
 /begin DEF_CHARACTERISTIC ComAlt_iExctCrntOfs_C ComAlt_iExctCrntSlp_C ComAlt_rAltDycOfs_C ComAlt_rAltDycSlp_C ComAlt_tACGTempOfs_C ComAlt_tACGTempSlp_C ComAlt_tACGTempTypBMax_C ComAlt_tACGTempTypBMin_C /end DEF_CHARACTERISTIC
 /begin IN_MEASUREMENT Lin_Alt_B_Signal_ACG_Temp_8_r_msg Lin_Alt_B_Signal_ComTOut_1_r_msg Lin_Alt_B_Signal_Com_1_r_msg Lin_Alt_B_Signal_Dyc_5_r_msg Lin_Alt_B_Signal_Elec_1_r_msg Lin_Alt_B_Signal_ExctCrnt_8_r_msg Lin_Alt_B_Signal_HiTemp_1_r_msg Lin_Alt_B_Signal_Mchn_1_r_msg SyC_ctPostDrvLeave /end IN_MEASUREMENT
 /begin OUT_MEASUREMENT ComAlt_iExctCrnt ComAlt_iExctCrntTypB ComAlt_rAltDyc ComAlt_rAltDycTypB ComAlt_stCom ComAlt_stComTOut ComAlt_stComTOutTypB ComAlt_stComTypB ComAlt_stElec ComAlt_stElecTypB ComAlt_stHiTemp ComAlt_stHiTempTypB ComAlt_stMchn ComAlt_stMchnTypB ComAlt_tACGTemp ComAlt_tACGTempTypB Com_bALTErr Com_bDern Com_bElec Com_bMec Com_bTO Com_ctReIni10msAltECU Com_ratDyc /end OUT_MEASUREMENT
 /begin LOC_MEASUREMENT ComAlt_nrDbgInfo ComAlt_nrDbgInfoTypB /end LOC_MEASUREMENT
 FUNCTION_VERSION "27.7.0" /end FUNCTION
/begin FUNCTION AltIO2MED "1.2.0     adapter for %AltIO_VD to map DE-variables to MED-world" /begin IN_MEASUREMENT AltIO_rAltLoad SyC_stSub /end IN_MEASUREMENT /begin OUT_MEASUREMENT kldfpwm /end OUT_MEASUREMENT FUNCTION_VERSION "1.2.0" /end FUNCTION
/begin FUNCTION AltIO_DD "9.1.2     Alternator Device Driver" /begin DEF_CHARACTERISTIC AltIO_rAltMdl_CUR AltIO_rErrSgn_C /end DEF_CHARACTERISTIC /begin IN_MEASUREMENT Com_rAltLoad Epm_nEng /end IN_MEASUREMENT /begin OUT_MEASUREMENT AltIO_rAlt AltIO_stQ /end OUT_MEASUREMENT FUNCTION_VERSION "9.1.2" /end FUNCTION
/begin FUNCTION AltIO_VD "17.12.0   Alternator Virtual Device"
 /begin DEF_CHARACTERISTIC AltIO_ATS.LimitTypeMsk_C AltIO_ATS.CnvNorm_C AltIO_ATS.LowLim_C AltIO_ATS.UpLim_C AltIO_ATS.CnvFac_C AltIO_ATS.CnvOfs_C AltIO_ATS.DfltVal_C AltIO_nEngACGVltg_C AltIO_nEngHiThdACGDiscnct_C AltIO_nEngThdACGDConn_C AltIO_nEngThdACGFailrLo_C AltIO_nEngThdACGFailr_C AltIO_nEngThdACGTHi_C AltIO_rACGFieDutyHi_C AltIO_rACGFieDutyLo_C AltIO_tiACGFieDuty_C AltIO_tiBattChrgLampOff_C AltIO_tiISLampOffDly_C AltIO_tThdACGTHi_C AltIO_uACGHealHiU_C AltIO_uACGHealLoU_C AltIO_uACGHiVltg_C AltIO_uACGLoVltg_C AltIO_uDconnACGThdLo_C AltIO_uDesDconnACGThd_C AltIO_uDiscnctACGThdOk_C /end DEF_CHARACTERISTIC
 /begin IN_MEASUREMENT Alt_uDes BattU_u ComAlt_rAltDyc ComAlt_tACGTempTypB Com_bElec Com_bMec Com_ratDyc CoVOM_bSSEEngStopPassed CoVOM_bSysOff CoVOM_stSSE Epm_nEng T15_st /end IN_MEASUREMENT
 /begin OUT_MEASUREMENT AltIO_nEngThdACGFailr AltIO_rAltLoad AltIO_stCon AltIO_tiLRAlt AltIO_uAltDes Alt_uFinalDes /end OUT_MEASUREMENT
 /begin LOC_MEASUREMENT AltIO_flgACGHiU AltIO_flgACGLoU AltIO_rACGFieDuty /end LOC_MEASUREMENT
 FUNCTION_VERSION "17.12.0" /end FUNCTION
/begin COMPU_METHOD APP_ATSENA_SC_Compu "" TAB_VERB "%6.3" "" COMPU_TAB_REF APP_ATSENA_SC_Compu /end COMPU_METHOD
/begin COMPU_VTAB APP_ATSENA_SC_Compu "" TAB_VERB 2 0 "False" 1 "True" /end COMPU_VTAB
/begin COMPU_METHOD APP_CHN1_SSPMONNUM_SY_Compu "" TAB_VERB "%6.3" "" COMPU_TAB_REF APP_CHN1_SSPMONNUM_SY_Compu /end COMPU_METHOD
/begin COMPU_VTAB APP_CHN1_SSPMONNUM_SY_Compu "" TAB_VERB 4 0 "NOTUSED" 1 "SSpMon1" 2 "SSpMon2" 3 "SSpMon3" /end COMPU_VTAB
/begin COMPU_METHOD APP_CHN2_SSPMONNUM_SY_Compu "" TAB_VERB "%6.3" "" COMPU_TAB_REF APP_CHN2_SSPMONNUM_SY_Compu /end COMPU_METHOD
/begin COMPU_VTAB APP_CHN2_SSPMONNUM_SY_Compu "" TAB_VERB 4 0 "NOTUSED" 1 "SSpMon1" 2 "SSpMon2" 3 "SSpMon3" /end COMPU_VTAB
/begin COMPU_METHOD APP_ENADFCPLAUSBRK_SY_Compu "" TAB_VERB "%6.3" "" COMPU_TAB_REF APP_ENADFCPLAUSBRK_SY_Compu /end COMPU_METHOD
/begin COMPU_VTAB APP_ENADFCPLAUSBRK_SY_Compu "" TAB_VERB 2 0 "0" 1 "1" /end COMPU_VTAB
/begin COMPU_METHOD APP_ENAFLT_SY_Compu "" TAB_VERB "%6.3" "" COMPU_TAB_REF APP_ENAFLT_SY_Compu /end COMPU_METHOD
/begin COMPU_VTAB APP_ENAFLT_SY_Compu "" TAB_VERB 2 0 "0" 1 "1" /end COMPU_VTAB
/begin COMPU_METHOD APP_ENAOSCNDETN_SC_Compu "" TAB_VERB "%6.3" "" COMPU_TAB_REF APP_ENAOSCNDETN_SC_Compu /end COMPU_METHOD
/begin COMPU_VTAB APP_ENAOSCNDETN_SC_Compu "" TAB_VERB 2 0 "False" 1 "True" /end COMPU_VTAB
/begin COMPU_METHOD APP_ENAUNJIT_SY_Compu "" TAB_VERB "%6.3" "" COMPU_TAB_REF APP_ENAUNJIT_SY_Compu /end COMPU_METHOD
/begin COMPU_VTAB APP_ENAUNJIT_SY_Compu "" TAB_VERB 2 0 "0" 1 "1" /end COMPU_VTAB
/begin COMPU_METHOD APP_LEARNFULLLD_SY_Compu "" TAB_VERB "%6.3" "" COMPU_TAB_REF APP_LEARNFULLLD_SY_Compu /end COMPU_METHOD
/begin COMPU_VTAB APP_LEARNFULLLD_SY_Compu "" TAB_VERB 2 0 "0" 1 "1" /end COMPU_VTAB
/begin COMPU_METHOD APP_PLAUSBRKMONAVL_SC_Compu "" TAB_VERB "%6.3" "" COMPU_TAB_REF APP_PLAUSBRKMONAVL_SC_Compu /end COMPU_METHOD
/begin COMPU_VTAB APP_PLAUSBRKMONAVL_SC_Compu "" TAB_VERB 2 0 "False" 1 "True" /end COMPU_VTAB
/begin COMPU_METHOD APP_PWMOUT_SC_Compu "" TAB_VERB "%6.3" "" COMPU_TAB_REF APP_PWMOUT_SC_Compu /end COMPU_METHOD
/begin COMPU_VTAB APP_PWMOUT_SC_Compu "" TAB_VERB 2 0 "False" 1 "True" /end COMPU_VTAB
/begin COMPU_METHOD APP_SC_Compu "" RAT_FUNC "%6.2" "" COEFFS 0 1 0 0 0 1 /end COMPU_METHOD
/begin COMPU_METHOD APP_SIGREADINGSRC_SC_Compu "" TAB_VERB "%6.3" "" COMPU_TAB_REF APP_SIGREADINGSRC_SC_Compu /end COMPU_METHOD
/begin COMPU_VTAB APP_SIGREADINGSRC_SC_Compu "" TAB_VERB 3 0 "ADC" 1 "SENT" 2 "ADC_SENT" /end COMPU_VTAB
/begin COMPU_METHOD APP_SWTPLAUSBRKSRC_SC_Compu "" TAB_VERB "%6.3" "" COMPU_TAB_REF APP_SWTPLAUSBRKSRC_SC_Compu /end COMPU_METHOD
/begin COMPU_VTAB APP_SWTPLAUSBRKSRC_SC_Compu "" TAB_VERB 2 0 "0" 1 "1" /end COMPU_VTAB
/begin COMPU_METHOD ARBLD_SC_Compu "" TAB_VERB "%6.3" "" COMPU_TAB_REF ARBLD_SC_Compu /end COMPU_METHOD
/begin COMPU_VTAB ARBLD_SC_Compu "" TAB_VERB 4 0 "NonAR" 1 "PCLT" 2 "PBL" 3 "PBS" /end COMPU_VTAB
/begin COMPU_METHOD Area2EffGrad "" RAT_FUNC "%6.4" "1/(cm^2*s)" COEFFS 0 100 0 0 0 1 /end COMPU_METHOD
/begin COMPU_METHOD Area_cm2 "" RAT_FUNC "%6.5" "cm*cm" COEFFS 0 1000 0 0 0 1 /end COMPU_METHOD
/begin COMPU_METHOD Area_cm2_float "" RAT_FUNC "%6.2" "cm*cm" COEFFS 0 1 0 0 0 1 /end COMPU_METHOD
/begin COMPU_METHOD Area_cm2_Low "" RAT_FUNC "%6.4" "cm*cm" COEFFS 0 250 0 0 0 1 /end COMPU_METHOD
/begin COMPU_METHOD ARVERS_SC_Compu "" TAB_VERB "%6.3" "" COMPU_TAB_REF ARVERS_SC_Compu /end COMPU_METHOD
/begin COMPU_VTAB ARVERS_SC_Compu "" TAB_VERB 3 0 "0" 1 "1" 2 "2" /end COMPU_VTAB
/begin COMPU_METHOD ASCET_33 "" RAT_FUNC "%6.2" "J/Ks" COEFFS 0 1 0 0 0 1 /end COMPU_METHOD
/begin COMPU_METHOD ASCET_mem_Integ "" RAT_FUNC "%12.11" "" COEFFS 0 2147483648 0 0 0 1 /end COMPU_METHOD
/begin COMPU_METHOD ASCET_q2p328Em8 "" RAT_FUNC "%6.2" "" COEFFS 0 1 0 0 0 1 /end COMPU_METHOD
/begin COMPU_METHOD ASDCTL_NRGEARTRSM_SC_Compu "" TAB_VERB "%6.3" "" COMPU_TAB_REF ASDCTL_NRGEARTRSM_SC_Compu /end COMPU_METHOD
/begin COMPU_VTAB ASDCTL_NRGEARTRSM_SC_Compu "" TAB_VERB 2 0 "False" 1 "True" /end COMPU_VTAB
/begin COMPU_METHOD ASDCTL_TQLVL_SC_Compu "" TAB_VERB "%6.3" "" COMPU_TAB_REF ASDCTL_TQLVL_SC_Compu /end COMPU_METHOD
/begin COMPU_VTAB ASDCTL_TQLVL_SC_Compu "" TAB_VERB 2 0 "0" 1 "1" /end COMPU_VTAB
/begin COMPU_METHOD ASDCTL_VAR_SY_Compu "" TAB_VERB "%6.3" "" COMPU_TAB_REF ASDCTL_VAR_SY_Compu /end COMPU_METHOD
/begin COMPU_VTAB ASDCTL_VAR_SY_Compu "" TAB_VERB 47 1 "DAI" 3 "VWW" 4 "POR" 5 "AUD" 6 "OPE" 9 "FIA" 11 "BMW" 14 "PSA" 15 "REN" 17 "ALF" 18 "SAB" 19 "VOL" 20 "NIS" 21 "GMU" 22 "FOR" 26 "ISZ" 51 "SEA" 53 "CHR" 54 "JAG" 55 "ROL" 69 "FER" 72 "TOY" 123 "MIT" 147 "HYU" 159 "HON" 160 "MAZ" 183 "CU" 190 "LRG" 204 "VVW" 214 "AVT" 242 "Iveco" 243 "DMC" 248 "SUZ" 267 "SSANGYONG" 270 "KEF" 289 "AMG" 308 "TAT" 319 "MVM" 328 "MM" 385 "UAES" 590 "Scania" 828 "RBCD" 898 "MFTBC" 999 "ALL" 2887 "Nonox" 9454 "Fuso" 9744 "McLaren" /end COMPU_VTAB
/begin COMPU_METHOD ASDDC_CONTTRQINC_SY_Compu "" TAB_VERB "%6.3" "" COMPU_TAB_REF ASDDC_CONTTRQINC_SY_Compu /end COMPU_METHOD
/begin COMPU_VTAB ASDDC_CONTTRQINC_SY_Compu "" TAB_VERB 2 0 "0" 1 "1" /end COMPU_VTAB
/begin COMPU_METHOD ASDDC_GEARNRMAXSIZE_SC_Compu "" RAT_FUNC "%6.2" "" COEFFS 0 1 0 0 0 1 /end COMPU_METHOD
/begin COMPU_METHOD ASDDC_NENGSIZE_SY_Compu "" RAT_FUNC "%6.2" "" COEFFS 0 1 0 0 0 1 /end COMPU_METHOD
/begin COMPU_METHOD ASDDC_NRNG_SY_Compu "" TAB_VERB "%6.3" "" COMPU_TAB_REF ASDDC_NRNG_SY_Compu /end COMPU_METHOD
/begin COMPU_VTAB ASDDC_NRNG_SY_Compu "" TAB_VERB 2 0 "0" 1 "1" /end COMPU_VTAB
/begin COMPU_METHOD ASDDC_STY_SY_Compu "" TAB_VERB "%6.3" "" COMPU_TAB_REF ASDDC_STY_SY_Compu /end COMPU_METHOD
/begin COMPU_VTAB ASDDC_STY_SY_Compu "" TAB_VERB 2 0 "0" 1 "1" /end COMPU_VTAB
/begin COMPU_METHOD ASDRF_ENA_SC_Compu "" TAB_VERB "%6.3" "" COMPU_TAB_REF ASDRF_ENA_SC_Compu /end COMPU_METHOD
/begin COMPU_VTAB ASDRF_ENA_SC_Compu "" TAB_VERB 2 0 "0" 1 "1" /end COMPU_VTAB
/begin COMPU_METHOD ASDRF_FACDESDYNSIZE_SY_Compu "" RAT_FUNC "%6.2" "" COEFFS 0 1 0 0 0 1 /end COMPU_METHOD
/begin COMPU_METHOD ASDRF_FCOPAR_SY_Compu "" TAB_VERB "%6.3" "" COMPU_TAB_REF ASDRF_FCOPAR_SY_Compu /end COMPU_METHOD
/begin COMPU_VTAB ASDRF_FCOPAR_SY_Compu "" TAB_VERB 2 0 "False" 1 "True" /end COMPU_VTAB
/begin COMPU_METHOD ASDRF_GEARNRMAXSIZE_SC_Compu "" RAT_FUNC "%6.2" "" COEFFS 0 1 0 0 0 1 /end COMPU_METHOD
/begin COMPU_METHOD ASDRF_GRDTLIM_SC_Compu "" TAB_VERB "%6.3" "" COMPU_TAB_REF ASDRF_GRDTLIM_SC_Compu /end COMPU_METHOD
/begin COMPU_VTAB ASDRF_GRDTLIM_SC_Compu "" TAB_VERB 2 0 "False" 1 "True" /end COMPU_VTAB
/begin COMPU_METHOD ASDRF_NENGSIZE_SY_Compu "" RAT_FUNC "%6.2" "" COEFFS 0 1 0 0 0 1 /end COMPU_METHOD
/begin COMPU_METHOD ASDRF_NOGRIPPAR_SY_Compu "" TAB_VERB "%6.3" "" COMPU_TAB_REF ASDRF_NOGRIPPAR_SY_Compu /end COMPU_METHOD
/begin COMPU_VTAB ASDRF_NOGRIPPAR_SY_Compu "" TAB_VERB 2 0 "False" 1 "True" /end COMPU_VTAB
/begin COMPU_METHOD ASDRF_RGRIP_SY_Compu "" TAB_VERB "%6.3" "" COMPU_TAB_REF ASDRF_RGRIP_SY_Compu /end COMPU_METHOD
/begin COMPU_VTAB ASDRF_RGRIP_SY_Compu "" TAB_VERB 2 0 "False" 1 "True" /end COMPU_VTAB
/begin COMPU_METHOD ASDRF_RTRQSIZE_SY_Compu "" RAT_FUNC "%6.2" "" COEFFS 0 1 0 0 0 1 /end COMPU_METHOD
/begin COMPU_METHOD ASDRF_STDCALPRMRECHEV_SC_Compu "" TAB_VERB "%6.3" "" COMPU_TAB_REF ASDRF_STDCALPRMRECHEV_SC_Compu /end COMPU_METHOD
/begin COMPU_VTAB ASDRF_STDCALPRMRECHEV_SC_Compu "" TAB_VERB 2 0 "False" 1 "True" /end COMPU_VTAB
/begin COMPU_METHOD AshEGMassPerTime "" RAT_FUNC "%6.5" "mg/s" COEFFS 0 2000 0 0 0 1 /end COMPU_METHOD
/begin COMPU_METHOD AshMassPerTime "" RAT_FUNC "%6.4" "mg/s" COEFFS 0 100 0 0 0 1 /end COMPU_METHOD
/begin COMPU_METHOD AshMs_g_p0q1_COMPU "" RAT_FUNC "%6.3" "g" COEFFS 0 10 0 0 0 1 /end COMPU_METHOD
/begin COMPU_METHOD AshMs_mg_p0q0016_COMPU "" RAT_FUNC "%6.4" "mg" COEFFS 0 625 0 0 0 1 /end COMPU_METHOD
/begin COMPU_METHOD ASModPrcPerSec_COMPU "" RAT_FUNC "%6.3" "%/s" COEFFS 0 1.6384 0 0 0 1 /end COMPU_METHOD
/begin COMPU_METHOD ASMOD_CT_PIPESLW_Compu "" RAT_FUNC "%6.2" "" COEFFS 0 1 0 0 0 1 /end COMPU_METHOD
/begin COMPU_METHOD ASMOD_CT_PIPE_Compu "" RAT_FUNC "%6.2" "" COEFFS 0 1 0 0 0 1 /end COMPU_METHOD
/begin COMPU_METHOD ATSENA_SC_Compu "" TAB_VERB "%6.3" "" COMPU_TAB_REF ATSENA_SC_Compu /end COMPU_METHOD
/begin COMPU_VTAB ATSENA_SC_Compu "" TAB_VERB 2 0 "False" 1 "True" /end COMPU_VTAB
/begin COMPU_METHOD ATS_BRK_APP_SC_Compu "" TAB_VERB "%6.3" "" COMPU_TAB_REF ATS_BRK_APP_SC_Compu /end COMPU_METHOD
/begin COMPU_VTAB ATS_BRK_APP_SC_Compu "" TAB_VERB 2 0 "False" 1 "True" /end COMPU_VTAB
/begin COMPU_METHOD AUTOSTRT_SY_Compu "" TAB_VERB "%6.3" "" COMPU_TAB_REF AUTOSTRT_SY_Compu /end COMPU_METHOD
/begin COMPU_VTAB AUTOSTRT_SY_Compu "" TAB_VERB 2 0 "no automatic start functionality" 1 "with automatic start functionality" /end COMPU_VTAB
/begin COMPU_METHOD AUTSHRTTRP_SY_Compu "" TAB_VERB "%6.3" "" COMPU_TAB_REF AUTSHRTTRP_SY_Compu /end COMPU_METHOD
/begin COMPU_VTAB AUTSHRTTRP_SY_Compu "" TAB_VERB 2 0 "False" 1 "True" /end COMPU_VTAB
/begin COMPU_METHOD AUXPWRRLY_TYPAVL_SC_Compu "" TAB_VERB "%6.3" "" COMPU_TAB_REF AUXPWRRLY_TYPAVL_SC_Compu /end COMPU_METHOD
/begin COMPU_VTAB AUXPWRRLY_TYPAVL_SC_Compu "" TAB_VERB 2 0 "False" 1 "True" /end COMPU_VTAB
/begin COMPU_METHOD AVSVLEX_SY_Compu "" TAB_VERB "%6.3" "" COMPU_TAB_REF AVSVLEX_SY_Compu /end COMPU_METHOD
/begin COMPU_VTAB AVSVLEX_SY_Compu "" TAB_VERB 2 0 "False" 1 "True" /end COMPU_VTAB
/begin COMPU_METHOD AVSVLIN_SY_Compu "" TAB_VERB "%6.3" "" COMPU_TAB_REF AVSVLIN_SY_Compu /end COMPU_METHOD
/begin COMPU_VTAB AVSVLIN_SY_Compu "" TAB_VERB 2 0 "False" 1 "True" /end COMPU_VTAB
/begin COMPU_METHOD AVSVL_INHOUSE_SC_Compu "" TAB_VERB "%6.3" "" COMPU_TAB_REF AVSVL_INHOUSE_SC_Compu /end COMPU_METHOD
/begin COMPU_VTAB AVSVL_INHOUSE_SC_Compu "" TAB_VERB 2 0 "False" 1 "True" /end COMPU_VTAB
/begin COMPU_METHOD AWD_SY_Compu "" TAB_VERB "%6.3" "" COMPU_TAB_REF AWD_SY_Compu /end COMPU_METHOD
/begin COMPU_VTAB AWD_SY_Compu "" TAB_VERB 3 0 "0" 1 "1" 2 "2" /end COMPU_VTAB
/begin COMPU_METHOD BASSVRAPPL_EXTSTIIFENA_SC_Compu "" TAB_VERB "%6.3" "" COMPU_TAB_REF BASSVRAPPL_EXTSTIIFENA_SC_Compu /end COMPU_METHOD
/begin COMPU_VTAB BASSVRAPPL_EXTSTIIFENA_SC_Compu "" TAB_VERB 2 0 "EXTSTIIF_DISABLE" 1 "EXTSTIIF_ENABLEV1" /end COMPU_VTAB
/begin COMPU_METHOD BATTDETERNDETNTYP_SC_Compu "" TAB_VERB "%6.3" "" COMPU_TAB_REF BATTDETERNDETNTYP_SC_Compu /end COMPU_METHOD
/begin COMPU_VTAB BATTDETERNDETNTYP_SC_Compu "" TAB_VERB 2 0 "NO_AGING_0" 1 "DETERN_1" /end COMPU_VTAB
/begin COMPU_METHOD BATTSENS_SY_Compu "" TAB_VERB "%6.3" "" COMPU_TAB_REF BATTSENS_SY_Compu /end COMPU_METHOD
/begin COMPU_VTAB BATTSENS_SY_Compu "" TAB_VERB 2 0 "False" 1 "True" /end COMPU_VTAB
/begin COMPU_METHOD BATTUDIAGRIPPLEACTV_SC_Compu "" TAB_VERB "%6.3" "" COMPU_TAB_REF BATTUDIAGRIPPLEACTV_SC_Compu /end COMPU_METHOD
/begin COMPU_VTAB BATTUDIAGRIPPLEACTV_SC_Compu "" TAB_VERB 2 0 "False" 1 "True" /end COMPU_VTAB
/begin COMPU_METHOD B_TRUE "" TAB_VERB "%6.3" "" COMPU_TAB_REF B_TRUE /end COMPU_METHOD
/begin COMPU_VTAB B_TRUE "" TAB_VERB 2 0 "FALSE" 1 "TRUE" /end COMPU_VTAB
/begin COMPU_METHOD Curr "" RAT_FUNC "%6.2" "mA" COEFFS 0 1 0 0 0 1 /end COMPU_METHOD
/begin COMPU_METHOD dez "" RAT_FUNC "%6.2" "" COEFFS 0 1 0 0 0 1 /end COMPU_METHOD
/begin COMPU_METHOD dfp_verbal "" TAB_VERB "%6.3" "-" COMPU_TAB_REF dfp_verbal /end COMPU_METHOD
/begin COMPU_VTAB dfp_verbal "" TAB_VERB 83 0 "DFP_AAA" 1 "DFP_AAV" 2 "DFP_AAVE" 3 "DFP_AGRE" 4 "DFP_AGRS" 5 "DFP_DHFHD" 6 "DFP_DK" 7 "DFP_DK1P" 8 "DFP_DK2P" 9 "DFP_DKVS" 10 "DFP_DSKV" 11 "DFP_DSKVR" 12 "DFP_DSKVS" 13 "DFP_DSS" 14 "DFP_DSU" 15 "DFP_DVEE" 16 "DFP_DVEF" 17 "DFP_DVEFO" 18 "DFP_DVEL" 19 "DFP_DVEN" 20 "DFP_DVER" 21 "DFP_DVEU" 22 "DFP_DVEUB" 23 "DFP_DVEUW" 24 "DFP_DYLSU" 25 "DFP_ENWCS" 26 "DFP_ENWS" 27 "DFP_ENWSE" 28 "DFP_EONV" 29 "DFP_FP1P" 30 "DFP_FP2P" 31 "DFP_FRA" 32 "DFP_FST" 33 "DFP_FSTE" 34 "DFP_FSTR" 35 "DFP_FTDLA" 36 "DFP_HDR" 37 "DFP_HDRKH" 38 "DFP_HDRPL" 39 "DFP_HFM" 40 "DFP_HSH" 41 "DFP_HSHE" 42 "DFP_KAT" 43 "DFP_KPE" 44 "DFP_KS1" 45 "DFP_LLRH" 46 "DFP_LLRKH" 47 "DFP_LM" 48 "DFP_LSH" 49 "DFP_LZSR" 50 "DFP_MD" 51 "DFP_NWS" 52 "DFP_NWSE" 53 "DFP_ORA" 54 "DFP_PLLSU" 55 "DFP_PSR" 56 "DFP_PSR1" 57 "DFP_PSRB" 58 "DFP_PSRE" 59 "DFP_PSRP" 60 "DFP_PU" 61 "DFP_PUE" 62 "DFP_PUPL" 63 "DFP_PUR" 64 "DFP_STHDR" 65 "DFP_TA" 66 "DFP_TANKL" 67 "DFP_TANLCS" 68 "DFP_TANLPRC" 69 "DFP_TANLR" 70 "DFP_TASRCS" 71 "DFP_TASRE" 72 "DFP_TASRPRC" 73 "DFP_TASRR" 74 "DFP_TESF" 75 "DFP_TESG" 76 "DFP_TM" 77 "DFP_TMCS" 78 "DFP_TME" 79 "DFP_TMP" 80 "DFP_UB" 81 "DFP_VFZ" 82 "DFP_ZZZ" DEFAULT_VALUE "---" /end COMPU_VTAB
/begin COMPU_METHOD DtyCyc "" RAT_FUNC "%6.4" "%" COEFFS 0 100 0 0 0 1 /end COMPU_METHOD
/begin COMPU_METHOD EngN "" RAT_FUNC "%6.3" "rpm" COEFFS 0 2 0 0 0 1 /end COMPU_METHOD
/begin COMPU_METHOD Fact100 "" RAT_FUNC "%6.4" "-" COEFFS 0 100 0 0 0 1 /end COMPU_METHOD
/begin COMPU_METHOD Fact1000 "" RAT_FUNC "%6.5" "-" COEFFS 0 1000 0 0 0 1 /end COMPU_METHOD
/begin COMPU_METHOD Fact_10000 "" RAT_FUNC "%7.6" "-" COEFFS 0 10000 0 0 0 1 /end COMPU_METHOD
/begin COMPU_METHOD fak_q0p0039 "" RAT_FUNC "%6.4" "-" COEFFS 0 256 0 0 0 1 /end COMPU_METHOD
/begin COMPU_METHOD fak_q0p0078 "" RAT_FUNC "%6.4" "-" COEFFS 0 128 0 0 0 1 /end COMPU_METHOD
/begin COMPU_METHOD fak_q3p0518Em5 "" RAT_FUNC "%7.6" "" COEFFS 0 32768 0 0 0 1 /end COMPU_METHOD
/begin COMPU_METHOD fak_q6p1035Em5 "" RAT_FUNC "%7.6" "-" COEFFS 0 65536 0 0 0 4 /end COMPU_METHOD
/begin COMPU_METHOD fak_ub_b1 "" RAT_FUNC "%6.4" "-" COEFFS 0 256 0 0 0 1 /end COMPU_METHOD
/begin COMPU_METHOD fak_ub_b2 "" RAT_FUNC "%8.5" "-" COEFFS 0 256 0 0 0 2 /end COMPU_METHOD
/begin COMPU_METHOD fak_uw_b2 "" RAT_FUNC "%7.6" "-" COEFFS 0 65536 0 0 0 2 /end COMPU_METHOD
/begin COMPU_METHOD fak_uw_b32 "" RAT_FUNC "%6.5" "-" COEFFS 0 65536 0 0 0 32 /end COMPU_METHOD
/begin COMPU_METHOD fak_uw_b4 "" RAT_FUNC "%7.6" "-" COEFFS 0 65536 0 0 0 4 /end COMPU_METHOD
/begin COMPU_METHOD fak_uw_b8 "" RAT_FUNC "%6.5" "-" COEFFS 0 65536 0 0 0 8 /end COMPU_METHOD
/begin COMPU_METHOD iumpr_img_verbal "" TAB_VERB "%6.3" "" COMPU_TAB_REF iumpr_img_verbal /end COMPU_METHOD
/begin COMPU_VTAB iumpr_img_verbal "" TAB_VERB 8 0 "NONE" 1 "CAT1" 2 "CAT2" 4 "OXS1" 8 "OXS2" 16 "EVAP" 32 "EGR" 64 "SAIR" /end COMPU_VTAB
/begin COMPU_METHOD kw_q0p0156 "" RAT_FUNC "%6.4" "Grad KW" COEFFS 0 64 0 0 0 1 /end COMPU_METHOD
/begin COMPU_METHOD md_q0p1 "" RAT_FUNC "%6.3" "Nm" COEFFS 0 10 0 0 0 1 /end COMPU_METHOD
/begin COMPU_METHOD m_q0p1 "" RAT_FUNC "%6.3" "kg/h" COEFFS 0 10 0 0 0 1 /end COMPU_METHOD
/begin COMPU_METHOD nmot_sw_q0p5 "" RAT_FUNC "%6.3" "1/min" COEFFS 0 2 0 0 0 1 /end COMPU_METHOD
/begin COMPU_METHOD OneToOne "" RAT_FUNC "%6.2" "-" COEFFS 0 1 0 0 0 1 /end COMPU_METHOD
/begin COMPU_METHOD Per_Dur "" RAT_FUNC "%6.2" "usec" COEFFS 0 1 0 0 0 1 /end COMPU_METHOD
/begin COMPU_METHOD Prc "" RAT_FUNC "%6.4" "%" COEFFS 0 81.92 0 0 0 1 /end COMPU_METHOD
/begin COMPU_METHOD PresAC_hPa "" RAT_FUNC "%6.2" "hPa" COEFFS 0 0.5 0 0 0 1 /end COMPU_METHOD
/begin COMPU_METHOD Pwr2 "" RAT_FUNC "%6.1" "W" COEFFS 0 0.0530516476972949 0 0 0 1 /end COMPU_METHOD
/begin COMPU_METHOD p_q0p039 "" RAT_FUNC "%6.4" "hPa" COEFFS 0 256 0 0 0 10 /end COMPU_METHOD
/begin COMPU_METHOD p_q0p078 "" RAT_FUNC "%6.4" "hPa" COEFFS 0 64 0 0 0 5 /end COMPU_METHOD
/begin COMPU_METHOD p_sw_q0p039 "" RAT_FUNC "%6.4" "hPa" COEFFS 0 256 0 0 0 10 /end COMPU_METHOD
/begin COMPU_METHOD p_uw_b32 "" RAT_FUNC "%6.5" "hPa/%" COEFFS 0 65536 0 0 0 32 /end COMPU_METHOD
/begin COMPU_METHOD p_uw_q0p039 "" RAT_FUNC "%6.4" "hPa" COEFFS 0 256 0 0 0 10 /end COMPU_METHOD
/begin COMPU_METHOD p_uw_q0p078 "" RAT_FUNC "%6.4" "hPa" COEFFS 0 256 0 0 0 20 /end COMPU_METHOD
/begin COMPU_METHOD RBPtCel_Curr_A_q0p005 "" RAT_FUNC "%6.4" "A" COEFFS 0 200 0 0 0 1 /end COMPU_METHOD
/begin COMPU_METHOD RBPtCel_Curr_mA_q0p01 "" RAT_FUNC "%6.3" "mA" COEFFS 0 10 0 0 0 1 /end COMPU_METHOD
/begin COMPU_METHOD RBPtCel_p_1p0_1 "" RAT_FUNC "%6.2" "hPa" COEFFS 0 1 0 0 0 1 /end COMPU_METHOD
/begin COMPU_METHOD RBPtCel_Tq2Fact_q0p001 "" RAT_FUNC "%6.5" "1/Nm" COEFFS 0 1000 0 0 0 1 /end COMPU_METHOD
/begin COMPU_METHOD rel_q0p0078125 "" RAT_FUNC "%6.4" "%" COEFFS 0 128 0 0 0 1 /end COMPU_METHOD
/begin COMPU_METHOD rel_q0p0234 "" RAT_FUNC "%6.4" "%" COEFFS 0 128 0 0 0 3 /end COMPU_METHOD
/begin COMPU_METHOD rel_q0p02344 "" RAT_FUNC "%6.4" "%" COEFFS 0 32 0 0 0 0.75 /end COMPU_METHOD
/begin COMPU_METHOD rel_sw_b100 "" RAT_FUNC "%6.4" "%" COEFFS 0 32768 0 0 0 100 /end COMPU_METHOD
/begin COMPU_METHOD rel_ub_b100 "" RAT_FUNC "%6.3" "%" COEFFS 0 256 0 0 0 100 /end COMPU_METHOD
/begin COMPU_METHOD rel_uw_b100 "" RAT_FUNC "%6.4" "%" COEFFS 0 65536 0 0 0 100 /end COMPU_METHOD
/begin COMPU_METHOD rel_uw_q0p0234 "" RAT_FUNC "%6.4" "%" COEFFS 0 32 0 0 0 0.75 /end COMPU_METHOD
/begin COMPU_METHOD spg_uw_q0p00488 "" RAT_FUNC "%6.4" "V" COEFFS 0 1024 0 0 0 5 /end COMPU_METHOD
/begin COMPU_METHOD TempDiff_Cels "" RAT_FUNC "%6.3" "deg C" COEFFS 0 10 0 0 0 1 /end COMPU_METHOD
/begin COMPU_METHOD Temp_Cels "" RAT_FUNC "%6.1" "deg C" COEFFS 0 10 2731.4 0 0 1 /end COMPU_METHOD
/begin COMPU_METHOD temp_q6_o273 "" RAT_FUNC "%6.1" "Grad C" COEFFS 0 1 273.15 0 0 6 /end COMPU_METHOD
/begin COMPU_METHOD temp_ub_q0p75_o48 "" RAT_FUNC "%6.2" "Grad C" COEFFS 0 1 48 0 0 0.75 /end COMPU_METHOD
/begin COMPU_METHOD TimeDeb "" RAT_FUNC "%6.1" "ms" COEFFS 0 0.1 0 0 0 1 /end COMPU_METHOD
/begin COMPU_METHOD TimeDelay_ms "" RAT_FUNC "%13.2" "ms" COEFFS 0 0 1 0 2.3283064365387e-007 0 /end COMPU_METHOD
/begin COMPU_METHOD TimeDelay_s "" RAT_FUNC "%6.1" "s" COEFFS 0 0 1 0 0.00023283064365387 0 /end COMPU_METHOD
/begin COMPU_METHOD Time_ms "" RAT_FUNC "%6.1" "ms" COEFFS 0 0.1 0 0 0 1 /end COMPU_METHOD
/begin COMPU_METHOD Time_msec_q1_COMPU "" RAT_FUNC "%6.2" "ms" COEFFS 0 1 0 0 0 1 /end COMPU_METHOD
/begin COMPU_METHOD Time_s "" RAT_FUNC "%6.4" "s" COEFFS 0 100 0 0 0 1 /end COMPU_METHOD
/begin COMPU_METHOD Trq "" RAT_FUNC "%6.3" "Nm" COEFFS 0 10 0 0 0 1 /end COMPU_METHOD
/begin COMPU_METHOD t_q0p01 "" RAT_FUNC "%6.4" "s" COEFFS 0 100 0 0 0 1 /end COMPU_METHOD
/begin COMPU_METHOD t_q0p02 "" RAT_FUNC "%6.4" "s" COEFFS 0 100 0 0 0 2 /end COMPU_METHOD
/begin COMPU_METHOD t_q0p1 "" RAT_FUNC "%6.3" "s" COEFFS 0 10 0 0 0 1 /end COMPU_METHOD
/begin COMPU_METHOD Vel "" RAT_FUNC "%6.4" "km/h" COEFFS 0 100 0 0 0 1 /end COMPU_METHOD
/begin COMPU_METHOD Volt "" RAT_FUNC "%6.3" "mV" COEFFS 0 5 0 0 0 1 /end COMPU_METHOD
/begin COMPU_METHOD Volt_Batt "" RAT_FUNC "%6.1" "mV" COEFFS 0 0.05 0 0 0 1 /end COMPU_METHOD
/begin COMPU_METHOD zk10msxs_uw_b655p36 "" RAT_FUNC "%6.2" "s" COEFFS 0 0 65536 0 100 0 /end COMPU_METHOD
/begin RECORD_LAYOUT Cur_Xs16Ws16 NO_AXIS_PTS_X 1 SWORD AXIS_PTS_X 2 SWORD INDEX_INCR DIRECT FNC_VALUES 3 SWORD COLUMN_DIR DIRECT /end RECORD_LAYOUT
/begin RECORD_LAYOUT Kw_Ws16 FNC_VALUES 1 SWORD COLUMN_DIR DIRECT /end RECORD_LAYOUT
/begin RECORD_LAYOUT RB_Curve_S16_S16 NO_AXIS_PTS_X 1 SWORD AXIS_PTS_X 2 SWORD INDEX_INCR DIRECT FNC_VALUES 3 SWORD COLUMN_DIR DIRECT /end RECORD_LAYOUT
/begin RECORD_LAYOUT RB_Curve_U16_S16_Static NO_AXIS_PTS_X 1 UWORD AXIS_PTS_X 2 UWORD INDEX_INCR DIRECT FNC_VALUES 3 SWORD COLUMN_DIR DIRECT STATIC_RECORD_LAYOUT /end RECORD_LAYOUT
/begin RECORD_LAYOUT RB_Curve_U16_U16 NO_AXIS_PTS_X 1 UWORD AXIS_PTS_X 2 UWORD INDEX_INCR DIRECT FNC_VALUES 3 UWORD COLUMN_DIR DIRECT /end RECORD_LAYOUT
/begin RECORD_LAYOUT RB_Curve_U8_U8 NO_AXIS_PTS_X 1 UBYTE AXIS_PTS_X 2 UBYTE INDEX_INCR DIRECT FNC_VALUES 3 UBYTE COLUMN_DIR DIRECT /end RECORD_LAYOUT
/begin RECORD_LAYOUT RB_Map_S16S16_U16 NO_AXIS_PTS_X 1 SWORD NO_AXIS_PTS_Y 2 SWORD AXIS_PTS_X 3 SWORD INDEX_INCR DIRECT AXIS_PTS_Y 4 SWORD INDEX_INCR DIRECT FNC_VALUES 5 UWORD COLUMN_DIR DIRECT /end RECORD_LAYOUT
/begin RECORD_LAYOUT RB_Map_S16U16_U16 NO_AXIS_PTS_X 1 SWORD NO_AXIS_PTS_Y 2 SWORD AXIS_PTS_X 3 SWORD INDEX_INCR DIRECT AXIS_PTS_Y 4 UWORD INDEX_INCR DIRECT FNC_VALUES 5 UWORD ROW_DIR DIRECT /end RECORD_LAYOUT
/begin RECORD_LAYOUT RB_Map_U16U16_U16 NO_AXIS_PTS_X 1 UWORD NO_AXIS_PTS_Y 2 UWORD AXIS_PTS_X 3 UWORD INDEX_INCR DIRECT AXIS_PTS_Y 4 UWORD INDEX_INCR DIRECT FNC_VALUES 5 UWORD COLUMN_DIR DIRECT /end RECORD_LAYOUT
/begin RECORD_LAYOUT RB_ValA_Wu16 FNC_VALUES 1 UWORD COLUMN_DIR DIRECT /end RECORD_LAYOUT
/begin RECORD_LAYOUT RB_ValA_Wu8 FNC_VALUES 1 UBYTE COLUMN_DIR DIRECT /end RECORD_LAYOUT
/begin RECORD_LAYOUT RB_Val_Wboolean FNC_VALUES 1 UBYTE COLUMN_DIR DIRECT /end RECORD_LAYOUT
/begin RECORD_LAYOUT RB_Val_Ws16 FNC_VALUES 1 SWORD COLUMN_DIR DIRECT /end RECORD_LAYOUT
/begin RECORD_LAYOUT RB_Val_Ws32 FNC_VALUES 1 SLONG COLUMN_DIR DIRECT /end RECORD_LAYOUT
/begin RECORD_LAYOUT RB_Val_Wu16 FNC_VALUES 1 UWORD COLUMN_DIR DIRECT /end RECORD_LAYOUT
/begin RECORD_LAYOUT RB_Val_Wu8 FNC_VALUES 1 UBYTE COLUMN_DIR DIRECT /end RECORD_LAYOUT
/begin RECORD_LAYOUT Val_Ws16 FNC_VALUES 1 SWORD COLUMN_DIR DIRECT /end RECORD_LAYOUT
/begin RECORD_LAYOUT Val_Ws32 FNC_VALUES 1 SLONG COLUMN_DIR DIRECT /end RECORD_LAYOUT
/begin RECORD_LAYOUT Val_Wu8 FNC_VALUES 1 UBYTE COLUMN_DIR DIRECT /end RECORD_LAYOUT
/end MODULE
/end PROJECT
