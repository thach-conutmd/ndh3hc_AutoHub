ASAP2_VERSION 1 60
/begin PROJECT MG1CS022 "MG1CS022"
/begin HEADER "" VERSION "MG1CS022_62XSC_V037" PROJECT_NO MG1CS022 /end HEADER
/begin MODULE DIM ""
/begin MOD_COMMON "" BYTE_ORDER MSB_LAST ALIGNMENT_BYTE 1 ALIGNMENT_WORD 2 ALIGNMENT_LONG 4 ALIGNMENT_INT64 4 ALIGNMENT_FLOAT32_IEEE 4 ALIGNMENT_FLOAT64_IEEE 4 DATA_SIZE 32 /end MOD_COMMON
/begin CHARACTERISTIC CoEng_facThdAirmCatHeatg_C "Threshold for relative amount of integrated airmass at catalyst heating to release VTEC." VALUE 0x80527F20 RB_Val_Wu16 0.9999847 fak_uw_b1 0.00 0.9999847 FORMAT "%9.7" /end CHARACTERISTIC
/begin CHARACTERISTIC CoEng_fakCorrnAltiCvlci_T "Map for altitude and temperature correction of intake valve lift shift" CURVE 0x80527F22 RB_Curve_U16_U16 1.999969 fak_uw_b2 0.00 1.999969 FORMAT "%8.6"
 /begin AXIS_DESCR STD_AXIS CoEng_fakCorrnAltiCvlciXVal fak_uw_b2 5 0.00 1.999969 FORMAT "%8.6" DEPOSIT ABSOLUTE /end AXIS_DESCR
/end CHARACTERISTIC
/begin CHARACTERISTIC CoEng_idxExhModTSelVlvLftIntk_C "Index to select modelled exhaust temperature for inhibition of the FC CoEng_VlvLftSpIntk" VALUE 0x80527F38 RB_Val_Wu8 11.00 OneToOne 0.00 11.00 FORMAT "%5.2" EXTENDED_LIMITS 0.00 255.0 /end CHARACTERISTIC
/begin CHARACTERISTIC CoEng_nCorrnGearCvlci_T "Map for gear dependent correction of intake valve lift shift" CURVE 0x80527F39 RB_Curve_S8_S8 12750. EngN_short -6400. 6350. FORMAT "%5.0"
 /begin AXIS_DESCR STD_AXIS Tra_numGear OneToOne 10 -128.0 127.0 FORMAT "%5.1" DEPOSIT ABSOLUTE /end AXIS_DESCR
/end CHARACTERISTIC
/begin CHARACTERISTIC CoEng_nEngShiftLimCvlci_T "Gear dependent engine speed limit for intake valve lift shift" CURVE 0x80527F4E RB_Curve_S16_S16 16383.50 EngN 0.00 16383.50 FORMAT "%8.2" EXTENDED_LIMITS -16384.00 16383.50
 /begin AXIS_DESCR STD_AXIS Tra_numGear OneToOne 10 -128.0000 127.0000 FORMAT "%8.4" EXTENDED_LIMITS -32768.00 32767.00 DEPOSIT ABSOLUTE /end AXIS_DESCR
/end CHARACTERISTIC
/begin CHARACTERISTIC CoEng_nOffsLimMaxCvlci_C "Upper offset limit for engine speed" VALUE 0x80527F78 RB_Val_Ws16 32767.50 EngN -16384.00 16383.50 FORMAT "%8.2" /end CHARACTERISTIC
/begin CHARACTERISTIC CoEng_nOffsLimMaxFCOCvlci_C "Upper offset limit for engine speed at FCO" VALUE 0x80527F7A RB_Val_Ws16 32767.50 EngN -16384.00 16383.50 FORMAT "%8.2" /end CHARACTERISTIC
/begin CHARACTERISTIC CoEng_nOffsLimMinCvlci_C "Lower offset limit for engine speed" VALUE 0x80527F7C RB_Val_Ws16 32767.50 EngN -16384.00 16383.50 FORMAT "%8.2" /end CHARACTERISTIC
/begin CHARACTERISTIC CoEng_nOffsLimMinFCOCvlci_C "Lower offset limit for engine speed at FCO" VALUE 0x80527F7E RB_Val_Ws16 32767.50 EngN -16384.00 16383.50 FORMAT "%8.2" /end CHARACTERISTIC
/begin CHARACTERISTIC CoEng_nrCamsftRotShiftCvlci_C "Number of needed camshaft rotations for a complete valve lift shift on intake side" VALUE 0x80527F80 RB_Val_Wu8 255.0 OneToOne 0.00 255.0 FORMAT "%5.1" /end CHARACTERISTIC
/begin CHARACTERISTIC CoEng_numGearLo_CA "Low gears in the context of valve lift" VAL_BLK 0x80527F81 RB_ValA_Wu8 1.00000000000 B_TRUE 0.00 1.00000000000 FORMAT "%13.11" NUMBER 10 /end CHARACTERISTIC
/begin CHARACTERISTIC CoEng_ratEngLoadTest_C "Test value for the map input" VALUE 0x80527F8C RB_Val_Ws16 399.9878 Prc 0.00 399.9878 FORMAT "%8.4" EXTENDED_LIMITS -400.0000 399.9878 /end CHARACTERISTIC
/begin CHARACTERISTIC CoEng_ratLoadFCORstrtCvlci_C "Minimum engine load to activate valve lift shift after fuel cut off" VALUE 0x80527F8E RB_Val_Ws16 399.9878 Prc 0.00 399.9878 FORMAT "%8.4" EXTENDED_LIMITS -400.0000 399.9878 /end CHARACTERISTIC
/begin CHARACTERISTIC CoEng_stCaseCvlci_CA "Choise of the use cases for the valve lift strategy on intake side" VAL_BLK 0x80527F90 RB_ValA_Wu8 254.000000000 CoEng_CaseCvlci_COMPU_VERB 1.000000000 255.000000000 FORMAT "%13.9" NUMBER 29 /end CHARACTERISTIC
/begin CHARACTERISTIC CoEng_stCaseStgyDftCvlci_C "Default intake valve lift strategy" VALUE 0x80527FAD RB_Val_Wu8 255.000000000 CoEng_VlvLftStgyCvlci_COMPU_VERB 0.00 255.000000000 FORMAT "%13.9" /end CHARACTERISTIC
/begin CHARACTERISTIC CoEng_stEomCvlciAllwd1ModVlvLft0_C "Inhibit mode at CoEng_stSpVlvLftIntk == 0" VALUE 0x80527FB0 RB_Val_Wu32 4294967295.00 OneToOne 0.00 4294967295.00 FORMAT "%13.2" /end CHARACTERISTIC
/begin CHARACTERISTIC CoEng_stEomCvlciAllwd1ModVlvLft1_C "Inhibit mode at CoEng_stSpVlvLftIntk == 1" VALUE 0x80527FB4 RB_Val_Wu32 4294967295.00 OneToOne 0.00 4294967295.00 FORMAT "%13.2" /end CHARACTERISTIC
/begin CHARACTERISTIC CoEng_stEomCvlciAllwd1ModVlvLft2_C "Inhibit mode at CoEng_stSpVlvLftIntk == 2" VALUE 0x80527FB8 RB_Val_Wu32 4294967295.00 OneToOne 0.00 4294967295.00 FORMAT "%13.2" /end CHARACTERISTIC
/begin CHARACTERISTIC CoEng_stEomCvlciAllwd1ModVlvLft3_C "Inhibit mode at CoEng_stSpVlvLftIntk == 3" VALUE 0x80527FBC RB_Val_Wu32 4294967295.00 OneToOne 0.00 4294967295.00 FORMAT "%13.2" /end CHARACTERISTIC
/begin CHARACTERISTIC CoEng_stEomCvlciAllwd1ModVlvLft4_C "Inhibit mode at CoEng_stSpVlvLftIntk == 4" VALUE 0x80527FC0 RB_Val_Wu32 4294967295.00 OneToOne 0.00 4294967295.00 FORMAT "%13.2" /end CHARACTERISTIC
/begin CHARACTERISTIC CoEng_stEomCvlciAllwd1ModVlvLft5_C "Inhibit mode at CoEng_stSpVlvLftIntk == 5" VALUE 0x80527FC4 RB_Val_Wu32 4294967295.00 OneToOne 0.00 4294967295.00 FORMAT "%13.2" /end CHARACTERISTIC
/begin CHARACTERISTIC CoEng_stEomCvlciAllwd1ModVlvLft6_C "Inhibit mode at CoEng_stSpVlvLftIntk == 6" VALUE 0x80527FC8 RB_Val_Wu32 4294967295.00 OneToOne 0.00 4294967295.00 FORMAT "%13.2" /end CHARACTERISTIC
/begin CHARACTERISTIC CoEng_stEomCvlciAllwd1ModVlvLft7_C "Inhibit mode at CoEng_stSpVlvLftIntk == 7" VALUE 0x80527FCC RB_Val_Wu32 4294967295.00 OneToOne 0.00 4294967295.00 FORMAT "%13.2" /end CHARACTERISTIC
/begin CHARACTERISTIC CoEng_stEomCvlciAllwd1ModVlvLft8_C "Inhibit mode at CoEng_stSpVlvLftIntk == 8" VALUE 0x80527FD0 RB_Val_Wu32 4294967295.00 OneToOne 0.00 4294967295.00 FORMAT "%13.2" /end CHARACTERISTIC
/begin CHARACTERISTIC CoEng_stEomCvlciAllwd1ModVlvLft9_C "Inhibit mode at CoEng_stSpVlvLftIntk == 9" VALUE 0x80527FD4 RB_Val_Wu32 4294967295.00 OneToOne 0.00 4294967295.00 FORMAT "%13.2" /end CHARACTERISTIC
/begin CHARACTERISTIC CoEng_stEomCvlciAllwd1Prio_T "Curve to map the former values of CoEng_stSpVlvLftIntk to the priority of the CoEOM inhibit interface 1" CURVE 0x80527FD8 RB_Curve_U8_U8 255.0 OneToOne 0.00 255.0 FORMAT "%5.1"
 /begin AXIS_DESCR STD_AXIS CoEng_stSpVlvLftIntkLoc OneToOne 10 0.00 255.0 FORMAT "%5.1" DEPOSIT ABSOLUTE /end AXIS_DESCR
/end CHARACTERISTIC
/begin CHARACTERISTIC CoEng_stEomCvlciAllwd1Stg_T "Curve to map the former values of CoEng_stSpVlvLftIntk to the stage of the CoEOM inhibit interface 1" CURVE 0x80527FEE RB_Curve_U8_U16_Static 65535.00 OneToOne 0.00 65535.00 FORMAT "%8.2"
 /begin AXIS_DESCR STD_AXIS CoEng_stSpVlvLftIntkLoc OneToOne 10 0.00 255.0 FORMAT "%5.1" DEPOSIT ABSOLUTE /end AXIS_DESCR
/end CHARACTERISTIC
/begin CHARACTERISTIC CoEng_stEomCvlciAllwd2ModVlvLft0_C "Inhibit mode at CoEng_stSpVlvLftIntk == 0" VALUE 0x80528010 RB_Val_Wu32 4294967295.00 OneToOne 0.00 4294967295.00 FORMAT "%13.2" /end CHARACTERISTIC
/begin CHARACTERISTIC CoEng_stEomCvlciAllwd2ModVlvLft1_C "Inhibit mode at CoEng_stSpVlvLftIntk == 1" VALUE 0x80528014 RB_Val_Wu32 4294967295.00 OneToOne 0.00 4294967295.00 FORMAT "%13.2" /end CHARACTERISTIC
/begin CHARACTERISTIC CoEng_stEomCvlciAllwd2ModVlvLft2_C "Inhibit mode at CoEng_stSpVlvLftIntk == 2" VALUE 0x80528018 RB_Val_Wu32 4294967295.00 OneToOne 0.00 4294967295.00 FORMAT "%13.2" /end CHARACTERISTIC
/begin CHARACTERISTIC CoEng_stEomCvlciAllwd2ModVlvLft3_C "Inhibit mode at CoEng_stSpVlvLftIntk == 3" VALUE 0x8052801C RB_Val_Wu32 4294967295.00 OneToOne 0.00 4294967295.00 FORMAT "%13.2" /end CHARACTERISTIC
/begin CHARACTERISTIC CoEng_stEomCvlciAllwd2ModVlvLft4_C "Inhibit mode at CoEng_stSpVlvLftIntk == 4" VALUE 0x80528020 RB_Val_Wu32 4294967295.00 OneToOne 0.00 4294967295.00 FORMAT "%13.2" /end CHARACTERISTIC
/begin CHARACTERISTIC CoEng_stEomCvlciAllwd2ModVlvLft5_C "Inhibit mode at CoEng_stSpVlvLftIntk == 5" VALUE 0x80528024 RB_Val_Wu32 4294967295.00 OneToOne 0.00 4294967295.00 FORMAT "%13.2" /end CHARACTERISTIC
/begin CHARACTERISTIC CoEng_stEomCvlciAllwd2ModVlvLft6_C "Inhibit mode at CoEng_stSpVlvLftIntk == 6" VALUE 0x80528028 RB_Val_Wu32 4294967295.00 OneToOne 0.00 4294967295.00 FORMAT "%13.2" /end CHARACTERISTIC
/begin CHARACTERISTIC CoEng_stEomCvlciAllwd2ModVlvLft7_C "Inhibit mode at CoEng_stSpVlvLftIntk == 7" VALUE 0x8052802C RB_Val_Wu32 4294967295.00 OneToOne 0.00 4294967295.00 FORMAT "%13.2" /end CHARACTERISTIC
/begin CHARACTERISTIC CoEng_stEomCvlciAllwd2ModVlvLft8_C "Inhibit mode at CoEng_stSpVlvLftIntk == 8" VALUE 0x80528030 RB_Val_Wu32 4294967295.00 OneToOne 0.00 4294967295.00 FORMAT "%13.2" /end CHARACTERISTIC
/begin CHARACTERISTIC CoEng_stEomCvlciAllwd2ModVlvLft9_C "Inhibit mode at CoEng_stSpVlvLftIntk == 9" VALUE 0x80528034 RB_Val_Wu32 4294967295.00 OneToOne 0.00 4294967295.00 FORMAT "%13.2" /end CHARACTERISTIC
/begin CHARACTERISTIC CoEng_stEomCvlciAllwd2Prio_T "Curve to map the former values of CoEng_stSpVlvLftIntk to the priority of the CoEOM inhibit interface 2" CURVE 0x80528038 RB_Curve_U8_U8 255.0 OneToOne 0.00 255.0 FORMAT "%5.1"
 /begin AXIS_DESCR STD_AXIS CoEng_stSpVlvLftIntkLoc OneToOne 10 0.00 255.0 FORMAT "%5.1" DEPOSIT ABSOLUTE /end AXIS_DESCR
/end CHARACTERISTIC
/begin CHARACTERISTIC CoEng_stEomCvlciAllwd2Stg_T "Curve to map the former values of CoEng_stSpVlvLftIntk to the stage of the CoEOM inhibit interface 2" CURVE 0x8052804E RB_Curve_U8_U16_Static 65535.00 OneToOne 0.00 65535.00 FORMAT "%8.2"
 /begin AXIS_DESCR STD_AXIS CoEng_stSpVlvLftIntkLoc OneToOne 10 0.00 255.0 FORMAT "%5.1" DEPOSIT ABSOLUTE /end AXIS_DESCR
/end CHARACTERISTIC
/begin CHARACTERISTIC CoEng_stEomCvlciDmdModVlvLft0_C "Mode demand at CoEng_stSpVlvLftIntk == 0" VALUE 0x80528070 RB_Val_Wu32 4294967295.00 OneToOne 0.00 4294967295.00 FORMAT "%13.2" /end CHARACTERISTIC
/begin CHARACTERISTIC CoEng_stEomCvlciDmdModVlvLft1_C "Mode demand at CoEng_stSpVlvLftIntk == 1" VALUE 0x80528074 RB_Val_Wu32 4294967295.00 OneToOne 0.00 4294967295.00 FORMAT "%13.2" /end CHARACTERISTIC
/begin CHARACTERISTIC CoEng_stEomCvlciDmdModVlvLft2_C "Mode demand at CoEng_stSpVlvLftIntk == 2" VALUE 0x80528078 RB_Val_Wu32 4294967295.00 OneToOne 0.00 4294967295.00 FORMAT "%13.2" /end CHARACTERISTIC
/begin CHARACTERISTIC CoEng_stEomCvlciDmdModVlvLft3_C "Mode demand at CoEng_stSpVlvLftIntk == 3" VALUE 0x8052807C RB_Val_Wu32 4294967295.00 OneToOne 0.00 4294967295.00 FORMAT "%13.2" /end CHARACTERISTIC
/begin CHARACTERISTIC CoEng_stEomCvlciDmdModVlvLft4_C "Mode demand at CoEng_stSpVlvLftIntk == 4" VALUE 0x80528080 RB_Val_Wu32 4294967295.00 OneToOne 0.00 4294967295.00 FORMAT "%13.2" /end CHARACTERISTIC
/begin CHARACTERISTIC CoEng_stEomCvlciDmdModVlvLft5_C "Mode demand at CoEng_stSpVlvLftIntk == 5" VALUE 0x80528084 RB_Val_Wu32 4294967295.00 OneToOne 0.00 4294967295.00 FORMAT "%13.2" /end CHARACTERISTIC
/begin CHARACTERISTIC CoEng_stEomCvlciDmdModVlvLft6_C "Mode demand at CoEng_stSpVlvLftIntk == 6" VALUE 0x80528088 RB_Val_Wu32 4294967295.00 OneToOne 0.00 4294967295.00 FORMAT "%13.2" /end CHARACTERISTIC
/begin CHARACTERISTIC CoEng_stEomCvlciDmdModVlvLft7_C "Mode demand at CoEng_stSpVlvLftIntk == 7" VALUE 0x8052808C RB_Val_Wu32 4294967295.00 OneToOne 0.00 4294967295.00 FORMAT "%13.2" /end CHARACTERISTIC
/begin CHARACTERISTIC CoEng_stEomCvlciDmdModVlvLft8_C "Mode demand at CoEng_stSpVlvLftIntk == 8" VALUE 0x80528090 RB_Val_Wu32 4294967295.00 OneToOne 0.00 4294967295.00 FORMAT "%13.2" /end CHARACTERISTIC
/begin CHARACTERISTIC CoEng_stEomCvlciDmdModVlvLft9_C "Mode demand at CoEng_stSpVlvLftIntk == 9" VALUE 0x80528094 RB_Val_Wu32 4294967295.00 OneToOne 0.00 4294967295.00 FORMAT "%13.2" /end CHARACTERISTIC
/begin CHARACTERISTIC CoEng_stEomCvlciDmdPrio_T "Curve to map the former values of CoEng_stSpVlvLftIntk to the priority of the CoEOM demand interface" CURVE 0x80528098 RB_Curve_U8_U8 255.0 OneToOne 0.00 255.0 FORMAT "%5.1"
 /begin AXIS_DESCR STD_AXIS CoEng_stSpVlvLftIntkLoc OneToOne 10 0.00 255.0 FORMAT "%5.1" DEPOSIT ABSOLUTE /end AXIS_DESCR
/end CHARACTERISTIC
/begin CHARACTERISTIC CoEng_stEomCvlciDmdStg_T "Curve to map the former values of CoEng_stSpVlvLftIntk to the new CoEOM demand" CURVE 0x805280AE RB_Curve_U8_U16_Static 65535.00 OneToOne 0.00 65535.00 FORMAT "%8.2"
 /begin AXIS_DESCR STD_AXIS CoEng_stSpVlvLftIntkLoc OneToOne 10 0.00 255.0 FORMAT "%5.1" DEPOSIT ABSOLUTE /end AXIS_DESCR
/end CHARACTERISTIC
/begin CHARACTERISTIC CoEng_stExtVlvLftDmdDftCvlci_C "Default for external valve lift demand on intake side" VALUE 0x805280CE RB_Val_Wu8 255.0 OneToOne 0.00 255.0 FORMAT "%5.1" /end CHARACTERISTIC
/begin CHARACTERISTIC CoEng_stMapInpSel_C "Input selector for the valve lift setpoint map" VALUE 0x805280CF RB_Val_Wu8 255.0 OneToOne 0.00 255.0 FORMAT "%5.1" /end CHARACTERISTIC
/begin CHARACTERISTIC CoEng_stMpgLimpVlvLftDmd_T "Curve to map the limp home valve lift demand to the definition of the function CoEng_VlvLftSpIntk" CURVE 0x805280D0 RB_Curve_U16_U8_Static 255.000000000 CoEng_VlvLftStgyFixCvlci_COMPU_VERB 0.00 255.000000000 FORMAT "%13.9"
 /begin AXIS_DESCR STD_AXIS CoEng_stMpgLimpVlvLftDmdXVal OneToOne 10 0.00 65535.00 FORMAT "%8.2" DEPOSIT ABSOLUTE /end AXIS_DESCR
/end CHARACTERISTIC
/begin CHARACTERISTIC CoEng_stMpgStdLftHwIntk_T "Curve to map the valve lift demand from GevCtl to the definition of the function CoEng_VlvLftSpIntk" CURVE 0x805280F0 RB_Curve_U8_U8 255.000000000 CoEng_VlvLftStgyFixCvlci_COMPU_VERB 0.00 255.000000000 FORMAT "%13.9"
 /begin AXIS_DESCR STD_AXIS CoEng_stMpgStdLftHwIntkXVal OneToOne 2 0.00 255.0 FORMAT "%5.1" DEPOSIT ABSOLUTE /end AXIS_DESCR
/end CHARACTERISTIC
/begin CHARACTERISTIC CoEng_stShiftDlyCvlci_CA "Choise of the shift delay strategy according to the calibrated use cases" VAL_BLK 0x805280F5 RB_ValA_Wu8 1.00000000000 CoEng_ShiftDlyCvlci_COMPU_VERB 0.00 1.00000000000 FORMAT "%13.11" NUMBER 29 /end CHARACTERISTIC
/begin CHARACTERISTIC CoEng_stShiftDlyDftCvlci_C "Choise of the shift delay for default strategy" VALUE 0x80528112 RB_Val_Wu8 1.00000000000 CoEng_ShiftDlyCvlci_COMPU_VERB 0.00 1.00000000000 FORMAT "%13.11" /end CHARACTERISTIC
/begin CHARACTERISTIC CoEng_stSpVlvLftIntkMax_C "Highest permitted value for state setpoint of intake valve lift" VALUE 0x80528113 RB_Val_Wu8 255.0 OneToOne 0.00 255.0 FORMAT "%5.1" /end CHARACTERISTIC
/begin CHARACTERISTIC CoEng_stTrqDemMaskCvlci_C "Bit mask for shift-lock of intake valve lift shift during torque demand intervention" VALUE 0x80528114 RB_Val_Wu16 65535.00 OneToOne 0.00 65535.00 FORMAT "%8.2" /end CHARACTERISTIC
/begin CHARACTERISTIC CoEng_stVlvLftDmdAppl1Cvlci_C "Calibration parameter 1 for manual valve lift demand" VALUE 0x80528116 RB_Val_Wu8 255.000000000 CoEng_VlvLftStgyFixCvlci_COMPU_VERB 0.00 255.000000000 FORMAT "%13.9" /end CHARACTERISTIC
/begin CHARACTERISTIC CoEng_stVlvLftDmdAppl2Cvlci_C "Calibration parameter 2 for manual valve lift demand" VALUE 0x80528117 RB_Val_Wu8 255.000000000 CoEng_VlvLftStgyFixCvlci_COMPU_VERB 0.00 255.000000000 FORMAT "%13.9" /end CHARACTERISTIC
/begin CHARACTERISTIC CoEng_stVlvLftStgyCvlci_CA "Choise of the intake valve lift strategy according to the calibrated use cases" VAL_BLK 0x80528118 RB_ValA_Wu8 255.000000000 CoEng_VlvLftStgyCvlci_COMPU_VERB 0.00 255.000000000 FORMAT "%13.9" NUMBER 29 /end CHARACTERISTIC
/begin CHARACTERISTIC CoEng_swtThdAirmCatHeatg_C "Threshold for relative amount of integrated airmass at catalyst heating to release VTEC." VALUE 0x80528135 RB_Val_Wu8 255.0 OneToOne 0.00 255.0 FORMAT "%5.1" /end CHARACTERISTIC
/begin CHARACTERISTIC CoEng_tEngVlvLftIntkHi_C "Maximum engine temperature for the intake valve lift" VALUE 0x80528136 RB_Val_Ws16 6553.500 Temp_Cels -3549.940 3003.560 FORMAT "%8.3" /end CHARACTERISTIC
/begin CHARACTERISTIC CoEng_tEngVlvLftIntkLo_C "Minimum engine temperature for the intake valve lift" VALUE 0x80528138 RB_Val_Ws16 6553.500 Temp_Cels -3549.940 3003.560 FORMAT "%8.3" /end CHARACTERISTIC
/begin CHARACTERISTIC CoEng_tExhVlvLftIntkHi_C "Maximum exhaust temperature for the intake valve lift" VALUE 0x8052813A RB_Val_Ws16 6553.500 Temp_Cels -3549.940 3003.560 FORMAT "%8.3" /end CHARACTERISTIC
/begin CHARACTERISTIC CoEng_tExhVlvLftIntkLo_C "Minimum exhaust temperature for the intake valve lift" VALUE 0x8052813C RB_Val_Ws16 6553.500 Temp_Cels -3549.940 3003.560 FORMAT "%8.3" /end CHARACTERISTIC
/begin CHARACTERISTIC CoEng_tiDlyFrzAftChgCvlci_M "Map to calibrate the delay of the different intake valve lift switches" MAP 0x8052813E RB_Map_U8U8_U8 2.550 Time_s 0.00 2.550 FORMAT "%5.3"
 /begin AXIS_DESCR STD_AXIS NO_INPUT_QUANTITY OneToOne 10 0.00 255.0 FORMAT "%5.1" DEPOSIT ABSOLUTE /end AXIS_DESCR
 /begin AXIS_DESCR STD_AXIS CoEng_stSpVlvLftIntkLoc OneToOne 10 0.00 255.0 FORMAT "%5.1" DEPOSIT ABSOLUTE /end AXIS_DESCR
/end CHARACTERISTIC
/begin CHARACTERISTIC CoEng_tiNEngHiHysCvlci_C "Time delay to release the Valve lift shift after high engine speed" VALUE 0x805281B8 RB_Val_Ws32 4294.96729500 Time_Dt -2147.48364800 2147.48364700 FORMAT "%13.8" /end CHARACTERISTIC
/begin CHARACTERISTIC CoEng_tIntkAirMax_C "Upper limit for intake air temperature" VALUE 0x805281BC RB_Val_Ws16 6553.500 Temp_Cels -3549.940 3003.560 FORMAT "%8.3" /end CHARACTERISTIC
/begin CHARACTERISTIC CoEng_tiShiftOffsCvlci_C "Offset for calculation of shift time of a valve lift shift" VALUE 0x805281BE RB_Val_Ws8 2.550 Time_s -1.280 1.270 FORMAT "%5.3" /end CHARACTERISTIC
/begin CHARACTERISTIC CoEng_tiSpChgAftStrt_C "Minimum time after start end before changing the valve lift setpoint" VALUE 0x805281C0 RB_Val_Wu16 10.00000 Time_s 0.00 10.00000 FORMAT "%8.5" EXTENDED_LIMITS 0.00 655.3500 /end CHARACTERISTIC
/begin CHARACTERISTIC CoEng_tiSpdGrdFlt_C "Filtertime for PT1-Filtermodule to calculate additional filtered enginespeed-gradient" VALUE 0x805281C4 RB_Val_Ws32 4294.9672940000000 TimeDelay_s 0.0000020000000 4294.9672959999998 FORMAT "%19.14" EXTENDED_LIMITS 0.000002000000001 4294.9672959999998 /end CHARACTERISTIC
/begin CHARACTERISTIC CoEng_tiVlvLftDmdAppl1Tog_C "Time using parameter 1 on manual valve lift demand on toggle mode" VALUE 0x805281C8 RB_Val_Ws16 327.6700 Time_s 0.00 327.6700 FORMAT "%8.4" EXTENDED_LIMITS -327.6800 327.6700 /end CHARACTERISTIC
/begin CHARACTERISTIC CoEng_tiVlvLftDmdAppl2Tog_C "Time using parameter 2 on manual valve lift demand on toggle mode" VALUE 0x805281CA RB_Val_Ws16 327.6700 Time_s 0.00 327.6700 FORMAT "%8.4" EXTENDED_LIMITS -327.6800 327.6700 /end CHARACTERISTIC
/begin CHARACTERISTIC CoEng_VlvLftMapCvlci_I.stLoadNRngCvlci_M "Class for valve lift setpoint maps / Map to define load engine speed range fior intake valve lift" MAP 0x805281D0 RB_Map_S16S16_S16 20.0000000000 CoEng_EngWpCvlci_COMPU_VERB 0.00 20.0000000000 FORMAT "%13.10"
 /begin AXIS_DESCR STD_AXIS NO_INPUT_QUANTITY EngN 20 -16384.00 16383.50 FORMAT "%8.2" DEPOSIT ABSOLUTE /end AXIS_DESCR
 /begin AXIS_DESCR STD_AXIS NO_INPUT_QUANTITY Prc 21 -400.0000 399.9878 FORMAT "%8.4" DEPOSIT ABSOLUTE /end AXIS_DESCR
/end CHARACTERISTIC
/begin CHARACTERISTIC CoEng_VlvLftMapCvlci_I.stSpCvlci_M "Class for valve lift setpoint maps / Map to define intake valve lift set point" MAP 0x8052856E RB_Map_S16S16_S16 255.000000000 CoEng_VlvLftStgyFixCvlci_COMPU_VERB 0.00 255.000000000 FORMAT "%13.9"
 /begin AXIS_DESCR STD_AXIS NO_INPUT_QUANTITY CoEng_EngWpCvlci_COMPU_VERB 20 0.00 20.0000000000 FORMAT "%13.10" DEPOSIT ABSOLUTE /end AXIS_DESCR
 /begin AXIS_DESCR STD_AXIS NO_INPUT_QUANTITY CoEng_VlvLftStgyMapCvlci_COMPU_VERB 15 100.000000000 114.000000000 FORMAT "%13.9" DEPOSIT ABSOLUTE /end AXIS_DESCR
/end CHARACTERISTIC
/begin CHARACTERISTIC CoEng_vVehMinCvlciDeltaHys_C "Delta hysteresis value for use-case: Low vehicle speed" VALUE 0x805281CC RB_Val_Ws16 327.6700 Vel 0.00 327.6700 FORMAT "%8.4" EXTENDED_LIMITS -327.6800 327.6700 /end CHARACTERISTIC
/begin CHARACTERISTIC CoEng_vVehMinCvlci_C "Minimum vehicle velocity for activation of inlet valve lift" VALUE 0x805281CE RB_Val_Ws16 655.3500 Vel -327.6800 327.6700 FORMAT "%8.4" /end CHARACTERISTIC
/begin CHARACTERISTIC CoEOM_BdeLcyMpg_I.OperMod2Idx_M "Mapping of a 16-bit mode of operation to the classic 8-bit GDI mode of operation. / Mapping-Table for the conversion of the operation-mode-information in an other format" MAP 0x80527AD6 RB_Map_U8U8_U8 255.0 OneToOne 0.00 255.0 FORMAT "%5.1"
 /begin AXIS_DESCR STD_AXIS NO_INPUT_QUANTITY CoEOM_idxOperModCfgd_VERB 4 0.00 3.00000000000 FORMAT "%13.11" DEPOSIT ABSOLUTE /end AXIS_DESCR
 /begin AXIS_DESCR STD_AXIS NO_INPUT_QUANTITY CoEOM_idxOperModStgTot_VERB 8 0.00 15.0000000000 FORMAT "%13.10" DEPOSIT ABSOLUTE /end AXIS_DESCR
/end CHARACTERISTIC
/begin CHARACTERISTIC CoEOM_dmCvlc_C "Delta air mass threshold that decides that a coordinated torque neutral switch is necessary" VALUE 0x80527984 RB_Val_Ws16 1535.977 rel_q0p02344 -768.0000 767.9766 FORMAT "%8.4" /end CHARACTERISTIC
/begin CHARACTERISTIC CoEOM_DmdLstSort.CoEOM_ThdConsdrPrio_C "the sort algorithm off the requests according to their priority / Threshold of priority, up to which the engine operation mode will be considered as no request" VALUE 0x80527038 RB_Val_Wu16 65535.00 OneToOne 0.00 65535.00 FORMAT "%8.2" /end CHARACTERISTIC
/begin CHARACTERISTIC CoEOM_EomBas1Hys_I.idxSt_MAP "hysteresis to select the first unique engine operating mode request / Look-Up-Table of the Two-D Hystereses-Look-Up-Table (Uint16)" MAP 0x805272B0 RB_Map_U16U16_U16 65535.00 OneToOne 0.00 65535.00 FORMAT "%8.2"
 /begin AXIS_DESCR STD_AXIS NO_INPUT_QUANTITY EngN 16 0.00 32767.50 FORMAT "%8.2" DEPOSIT ABSOLUTE /end AXIS_DESCR
 /begin AXIS_DESCR STD_AXIS NO_INPUT_QUANTITY rel_uw_q0p0234 16 0.00 1535.977 FORMAT "%8.3" DEPOSIT ABSOLUTE /end AXIS_DESCR
/end CHARACTERISTIC
/begin CHARACTERISTIC CoEOM_EomBas2Hys_I.idxSt_MAP "hysteresis to select the second unique engine operating mode request / Look-Up-Table of the Two-D Hystereses-Look-Up-Table (Uint16)" MAP 0x805274F8 RB_Map_U16U16_U16 65535.00 OneToOne 0.00 65535.00 FORMAT "%8.2"
 /begin AXIS_DESCR STD_AXIS NO_INPUT_QUANTITY EngN 16 0.00 32767.50 FORMAT "%8.2" DEPOSIT ABSOLUTE /end AXIS_DESCR
 /begin AXIS_DESCR STD_AXIS NO_INPUT_QUANTITY rel_uw_q0p0234 16 0.00 1535.977 FORMAT "%8.3" DEPOSIT ABSOLUTE /end AXIS_DESCR
/end CHARACTERISTIC
/begin CHARACTERISTIC CoEOM_EomBasAllwdHys_I.idxSt_MAP "EOM characteristic field with all allowed modes of operation / Look-Up-Table of the Two-D Hystereses-Look-Up-Table (Uint16)" MAP 0x80527740 RB_Map_U16U16_U16 65535.00 OneToOne 0.00 65535.00 FORMAT "%8.2"
 /begin AXIS_DESCR STD_AXIS NO_INPUT_QUANTITY EngN 16 0.00 32767.50 FORMAT "%8.2" DEPOSIT ABSOLUTE /end AXIS_DESCR
 /begin AXIS_DESCR STD_AXIS NO_INPUT_QUANTITY rel_uw_q0p0234 16 0.00 1535.977 FORMAT "%8.3" DEPOSIT ABSOLUTE /end AXIS_DESCR
/end CHARACTERISTIC
/begin CHARACTERISTIC CoEOM_EomInhbd_I.stOperModPrio_C "Inhibition-Startbitmask to suppress some eninge operating modes from the selection. / Priority-parameter of the operation mode-parameter structs" VALUE 0x8052703C RB_Val_Wu8 255.0 OneToOne 0.00 255.0 FORMAT "%5.1" /end CHARACTERISTIC
/begin CHARACTERISTIC CoEOM_EomInhbd_I.stOperModStg_C "Inhibition-Startbitmask to suppress some eninge operating modes from the selection. / Stage-parameter of the operation mode-parameter structs" VALUE 0x8052703E RB_Val_Wu16 65535.00 OneToOne 0.00 65535.00 FORMAT "%8.2" /end CHARACTERISTIC
/begin CHARACTERISTIC CoEOM_EomInhbd_I.stOperMod_C "Inhibition-Startbitmask to suppress some eninge operating modes from the selection. / Operation-mode-parameter of the operation mode-parameter structs" VALUE 0x80527040 RB_Val_Wu32 4294967295.00 OneToOne 0.00 4294967295.00 FORMAT "%13.2" /end CHARACTERISTIC
/begin CHARACTERISTIC CoEOM_EomMtrx_M "" MAP 0x8058AF8A Map_Xu8Yu8Ws16 7951.00000000 CoEOM_stEomStgTot_VERB 0.00 7951.00000000 FORMAT "%13.8" READ_ONLY
 /begin AXIS_DESCR STD_AXIS CoEOM_idxEomAct CoEOM_idxOperModTot_VERB 4 0.00 31.0000000000 FORMAT "%13.10" DEPOSIT ABSOLUTE /end AXIS_DESCR
 /begin AXIS_DESCR STD_AXIS CoEOM_idxEomStgAct CoEOM_idxOperModStgTot_VERB 8 0.00 15.0000000000 FORMAT "%13.10" DEPOSIT ABSOLUTE /end AXIS_DESCR
/end CHARACTERISTIC
/begin CHARACTERISTIC CoEOM_EomTest2_I.stOperModPrio_C "Second test interface to realize toggeling between two test labels in CoEOM / Priority-parameter of the operation mode-parameter structs" VALUE 0x80527044 RB_Val_Wu8 255.0 OneToOne 0.00 255.0 FORMAT "%5.1" /end CHARACTERISTIC
/begin CHARACTERISTIC CoEOM_EomTest2_I.stOperModStg_C "Second test interface to realize toggeling between two test labels in CoEOM / Stage-parameter of the operation mode-parameter structs" VALUE 0x80527046 RB_Val_Wu16 65535.00 OneToOne 0.00 65535.00 FORMAT "%8.2" /end CHARACTERISTIC
/begin CHARACTERISTIC CoEOM_EomTest2_I.stOperMod_C "Second test interface to realize toggeling between two test labels in CoEOM / Operation-mode-parameter of the operation mode-parameter structs" VALUE 0x80527048 RB_Val_Wu32 4294967295.00 OneToOne 0.00 4294967295.00 FORMAT "%13.2" /end CHARACTERISTIC
/begin CHARACTERISTIC CoEOM_EOMTestSpl_C "simple test interface in engine operation mode coordination" VALUE 0x80526F3C RB_Val_Wu16 772.000000000 CoEOM_stEomStgCfgdExtn_VERB 0.00 772.000000000 FORMAT "%13.9" /end CHARACTERISTIC
/begin CHARACTERISTIC CoEOM_EomTest_I.stOperModPrio_C "Manual selection of an engine operation mode for testing. / Priority-parameter of the operation mode-parameter structs" VALUE 0x8052704C RB_Val_Wu8 255.0 OneToOne 0.00 255.0 FORMAT "%5.1" /end CHARACTERISTIC
/begin CHARACTERISTIC CoEOM_EomTest_I.stOperModStg_C "Manual selection of an engine operation mode for testing. / Stage-parameter of the operation mode-parameter structs" VALUE 0x8052704E RB_Val_Wu16 65535.00 OneToOne 0.00 65535.00 FORMAT "%8.2" /end CHARACTERISTIC
/begin CHARACTERISTIC CoEOM_EomTest_I.stOperMod_C "Manual selection of an engine operation mode for testing. / Operation-mode-parameter of the operation mode-parameter structs" VALUE 0x80527050 RB_Val_Wu32 4294967295.00 OneToOne 0.00 4294967295.00 FORMAT "%13.2" /end CHARACTERISTIC
/begin CHARACTERISTIC CoEOM_flgActvdEomSwtIniStrt_C "Parameter for activation of initialization to CoEOM_stEOMIni_C at start request" VALUE 0x80527986 RB_Val_Wboolean 1.00000000000 B_TRUE 0.00 1.00000000000 FORMAT "%13.11" /end CHARACTERISTIC
/begin CHARACTERISTIC CoEOM_flgEGSDCmnEnaParl_C "Parameter to determin, if the parallel coordination is necessary for EGSDCmn" VALUE 0x80526F3E RB_Val_Wu8 1.00000000000 B_TRUE 0.00 1.00000000000 FORMAT "%13.11" /end CHARACTERISTIC
/begin CHARACTERISTIC CoEOM_flgEnblSwtStgyStrt_C "Activation of shift strategy 1 at CoEng_stMai == COENG_ST_STARTING" VALUE 0x80527987 RB_Val_Wboolean 1.00000000000 B_TRUE 0.00 1.00000000000 FORMAT "%13.11" /end CHARACTERISTIC
/begin CHARACTERISTIC CoEOM_flgEomInterHosPln_C "Only for testing: determination of CoEOM_flgEomInterHosPln (0 -- false)." VALUE 0x80527AC4 RB_Val_Wu8 255.0 OneToOne 0.00 255.0 FORMAT "%5.1" /end CHARACTERISTIC
/begin CHARACTERISTIC CoEOM_flgSwtOnEomDmdCSERS_FT "Switch-List for activating or deactivation of some operation mode requestors in parallel coordiation (for CSERS)" CURVE 0x80526F3F RB_FixCurve_U8_U8 1.000 OneToOne 0.00 1.000 FORMAT "%5.3" EXTENDED_LIMITS 0.00 255.0
 /begin AXIS_DESCR FIX_AXIS NO_INPUT_QUANTITY CoEOM_OperMod_Set_COMPU_VERB 25 0.00 24.0000000000 FORMAT "%13.10" FIX_AXIS_PAR 0 0 25 /end AXIS_DESCR
/end CHARACTERISTIC
/begin CHARACTERISTIC CoEOM_flgSwtOnEomDmdParlDiagPsbl_FT "Switch list to activate or deactivate operating mode requestor in parallel coordination" CURVE 0x80526F58 RB_FixCurve_U8_U8 1.000 OneToOne 0.00 1.000 FORMAT "%5.3" EXTENDED_LIMITS 0.00 255.0
 /begin AXIS_DESCR FIX_AXIS NO_INPUT_QUANTITY CoEOM_OperMod_Set_COMPU_VERB 25 0.00 24.0000000000 FORMAT "%13.10" FIX_AXIS_PAR 0 0 25 /end AXIS_DESCR
/end CHARACTERISTIC
/begin CHARACTERISTIC CoEOM_flgSwtOnEomDmd_FT "Switch-List for activatingdeactivation of some Operation modes." CURVE 0x80526F71 RB_FixCurve_U8_U8 1.000 OneToOne 0.00 1.000 FORMAT "%5.3" EXTENDED_LIMITS 0.00 255.0
 /begin AXIS_DESCR FIX_AXIS NO_INPUT_QUANTITY CoEOM_OperMod_Set_COMPU_VERB 25 0.00 24.0000000000 FORMAT "%13.10" FIX_AXIS_PAR 0 0 25 /end AXIS_DESCR
/end CHARACTERISTIC
/begin CHARACTERISTIC CoEOM_idxEGSDCmnVirtDmd_C "Index of virtual operating mode requestor of EGSDCmn_CoorParlAssc" VALUE 0x80526F8A RB_Val_Wu8 24.0000000000 CoEOM_OperMod_Set_COMPU_VERB 0.00 24.0000000000 FORMAT "%13.10" /end CHARACTERISTIC
/begin CHARACTERISTIC CoEOM_idxSwtStgySeld_M "Map to define the shift strategy dependent on the EOM" MAP 0x80527988 RB_Map_U8U8_U8 255.0 OneToOne 0.00 255.0 FORMAT "%5.1"
 /begin AXIS_DESCR STD_AXIS CoEOM_idxGroupEomActv OneToOne 7 0.00 255.0 FORMAT "%5.1" DEPOSIT ABSOLUTE /end AXIS_DESCR
 /begin AXIS_DESCR STD_AXIS CoEOM_idxGroupEomDes OneToOne 7 0.00 255.0 FORMAT "%5.1" DEPOSIT ABSOLUTE /end AXIS_DESCR
/end CHARACTERISTIC
/begin CHARACTERISTIC CoEOM_InbnMatModi_a "Inhibit matrix, in which only configured operating modes and stages can be selected" VAL_BLK 0x805279CA RB_ValA_Wu16 65535.00 OneToOne 0.00 65535.00 FORMAT "%8.2" READ_ONLY NUMBER 32 /end CHARACTERISTIC
/begin CHARACTERISTIC CoEOM_NegExclsnAlg.CoEOM_ThdHardInhbnPrio_C "selection of the desired engine operation mode / Threshold of priority, from which the inhibition of engine operation mode will be considered as hard inhibition" VALUE 0x80527058 RB_Val_Wu8 255.0 OneToOne 0.00 255.0 FORMAT "%5.1" /end CHARACTERISTIC
/begin CHARACTERISTIC CoEOM_NegExclsnAlgParDiagPsbl.CoEOM_ThdHardInhbnPrio_C "Coordination for ParDiagPsb / Threshold of priority, from which the inhibition of engine operation mode will be considered as hard inhibition" VALUE 0x80527060 RB_Val_Wu8 255.0 OneToOne 0.00 255.0 FORMAT "%5.1" /end CHARACTERISTIC
/begin CHARACTERISTIC CoEOM_nHysDeltaEomBasis_C "Speed Hysterese for the EOM characteristic field." VALUE 0x80527290 RB_Val_Ws16 32767.50 EngN -16384.00 16383.50 FORMAT "%8.2" /end CHARACTERISTIC
/begin CHARACTERISTIC CoEOM_nrFlg2TypMpg_M "Priorty 2-map to get a unique Priortiy-order" MAP 0x80526F8B RB_Map_U8U8_U8 255.0 OneToOne 0.00 255.0 FORMAT "%5.1" READ_ONLY
 /begin AXIS_DESCR STD_AXIS NO_INPUT_QUANTITY OneToOne 5 0.00 255.0 FORMAT "%5.1" DEPOSIT ABSOLUTE /end AXIS_DESCR
 /begin AXIS_DESCR STD_AXIS NO_INPUT_QUANTITY OneToOne 5 0.00 255.0 FORMAT "%5.1" DEPOSIT ABSOLUTE /end AXIS_DESCR
/end CHARACTERISTIC
/begin CHARACTERISTIC CoEOM_OperMod2DftEOM_M "Mapping matrix for default engine operation mode" MAP 0x80526FB0 RB_Map_U8U8_U16 772.000000000 CoEOM_stEomStgCfgd_VERB 0.00 772.000000000 FORMAT "%13.9"
 /begin AXIS_DESCR STD_AXIS NO_INPUT_QUANTITY CoEOM_idxOperModCfgd_VERB 4 0.00 3.00000000000 FORMAT "%13.11" DEPOSIT ABSOLUTE /end AXIS_DESCR
 /begin AXIS_DESCR STD_AXIS NO_INPUT_QUANTITY CoEOM_idxOperModStgTot_VERB 8 0.00 15.0000000000 FORMAT "%13.10" DEPOSIT ABSOLUTE /end AXIS_DESCR
/end CHARACTERISTIC
/begin CHARACTERISTIC CoEOM_ratEngLoadReqTest_C "Fixed default value of the troque for EOM characteristic field, choice by CoEOM_stOperModInpSel_C = 3." VALUE 0x80527292 RB_Val_Wu16 99.99847 rel_uw_b100 0.00 99.99847 FORMAT "%8.5" /end CHARACTERISTIC
/begin CHARACTERISTIC CoEOM_ratHysDelta_C "Hysteresis of the desirable torque for the EOM characteristic field." VALUE 0x80527294 RB_Val_Wu16 1535.977 rel_uw_q0p0234 0.00 1535.977 FORMAT "%8.3" /end CHARACTERISTIC
/begin CHARACTERISTIC CoEOM_stBasis3_C "Default homogeneous engine operation mode" VALUE 0x80527296 RB_Val_Wu16 65535.00 OneToOne 0.00 65535.00 FORMAT "%8.2" /end CHARACTERISTIC
/begin CHARACTERISTIC CoEOM_stCatHeatgFinshd_C "Adapter label to select neutral value of former bdemodkh" VALUE 0x8052719C RB_Val_Wu8 255.0 OneToOne 0.00 255.0 FORMAT "%5.1" /end CHARACTERISTIC
/begin CHARACTERISTIC CoEOM_stCmb_M "" MAP 0x80527064 RB_Map_U8U8_U16 128.000000000 CoEOM_stEomCmb_VERB 0.00 128.000000000 FORMAT "%13.9" READ_ONLY
 /begin AXIS_DESCR STD_AXIS CoEOM_idxEomAct CoEOM_idxOperModTot_VERB 4 0.00 31.0000000000 FORMAT "%13.10" DEPOSIT ABSOLUTE /end AXIS_DESCR
 /begin AXIS_DESCR STD_AXIS CoEOM_idxEomStgAct CoEOM_idxOperModStgTot_VERB 8 0.00 15.0000000000 FORMAT "%13.10" DEPOSIT ABSOLUTE /end AXIS_DESCR
/end CHARACTERISTIC
/begin CHARACTERISTIC CoEOM_stDftOperModPrio_C "Priority of defalut engine operation mode" VALUE 0x80526FFE RB_Val_Wu8 255.0 OneToOne 0.00 255.0 FORMAT "%5.1" /end CHARACTERISTIC
/begin CHARACTERISTIC CoEOM_stDiagMgr_C "Adapter label to select neutral value of former bdemoddm" VALUE 0x8052719D RB_Val_Wu8 255.0 OneToOne 0.00 255.0 FORMAT "%5.1" /end CHARACTERISTIC
/begin CHARACTERISTIC CoEOM_stEnblEomSwt_C "Bit coded parameter to select, in which conditions of CoEng_stMai a new engine operation mode is accepted" VALUE 0x80527A0A RB_Val_Wu16 65535.00 OneToOne 0.00 65535.00 FORMAT "%8.2" /end CHARACTERISTIC
/begin AXIS_PTS CoEOM_stEomActv_AX "" 0x80527A0C NO_INPUT_QUANTITY RB_Axis_U16 7951.00000000 CoEOM_stEomStgTot_VERB 26 0.00 7951.00000000 FORMAT "%13.8" DEPOSIT ABSOLUTE /end AXIS_PTS
/begin CHARACTERISTIC CoEOM_stEomAllwdPrio_C "Calibrated priority for inhibiting certain engine operation mode" VALUE 0x80527298 RB_Val_Wu8 255.0 OneToOne 0.00 255.0 FORMAT "%5.1" /end CHARACTERISTIC
/begin CHARACTERISTIC CoEOM_stEomAllwd_C "Allowed engine operating mode" VALUE 0x8052729C RB_Val_Wu32 4294967295.00 OneToOne 0.00 4294967295.00 FORMAT "%13.2" /end CHARACTERISTIC
/begin CHARACTERISTIC CoEOM_stEomBasis1Prio_C "first calibrated priority for homogeneous engine operation mode" VALUE 0x805272A0 RB_Val_Wu8 255.0 OneToOne 0.00 255.0 FORMAT "%5.1" /end CHARACTERISTIC
/begin CHARACTERISTIC CoEOM_stEomBasis2Prio_C "second calibrated priority for homogeneous engine operation mode" VALUE 0x805272A1 RB_Val_Wu8 255.0 OneToOne 0.00 255.0 FORMAT "%5.1" /end CHARACTERISTIC
/begin CHARACTERISTIC CoEOM_stEomBasis3Prio_C "third calibrated priority for homogeneous engine operation mode" VALUE 0x805272A2 RB_Val_Wu8 255.0 OneToOne 0.00 255.0 FORMAT "%5.1" /end CHARACTERISTIC
/begin CHARACTERISTIC CoEOM_stEomBasis_C "Base mode of operation warm engine." VALUE 0x805272A4 RB_Val_Wu32 4294967295.00 OneToOne 0.00 4294967295.00 FORMAT "%13.2" /end CHARACTERISTIC
/begin CHARACTERISTIC CoEOM_stEomCatHeatg_C "Adapter label to map new Eom out of bdemodkh" VALUE 0x805271A0 RB_Val_Wu32 4294967295.00 OneToOne 0.00 4294967295.00 FORMAT "%13.2" /end CHARACTERISTIC
/begin AXIS_PTS CoEOM_stEomDesReqd_AX "distribution for requested mode of operation - interpolation of group axis allowed only in synchro task" 0x80527A42 NO_INPUT_QUANTITY RB_Axis_U16 7951.00000000 CoEOM_stEomStgTot_VERB 26 0.00 7951.00000000 FORMAT "%13.8" DEPOSIT ABSOLUTE /end AXIS_PTS
/begin CHARACTERISTIC CoEOM_stEomDiagMgr_C "Adapter label to map new Eom out of bdemoddm" VALUE 0x805271A4 RB_Val_Wu32 4294967295.00 OneToOne 0.00 4294967295.00 FORMAT "%13.2" /end CHARACTERISTIC
/begin CHARACTERISTIC CoEOM_stEOMIni_C "Initialization value of operating mode" VALUE 0x80527A78 RB_Val_Wu16 7951.00000000 CoEOM_stEomStgTot_VERB 0.00 7951.00000000 FORMAT "%13.8" /end CHARACTERISTIC
/begin CHARACTERISTIC CoEOM_stEomLimp_C "Adapter label to map new Eom out of bdemodnl" VALUE 0x805271A8 RB_Val_Wu32 4294967295.00 OneToOne 0.00 4294967295.00 FORMAT "%13.2" /end CHARACTERISTIC
/begin CHARACTERISTIC CoEOM_stEomStgyIgnRels_C "Bitmask to control the ignition angle release dependent on the switch strategy" VALUE 0x80527A7A RB_Val_Wu8 255.0 OneToOne 0.00 255.0 FORMAT "%5.1" /end CHARACTERISTIC
/begin CHARACTERISTIC CoEOM_stEomVldLcySwt_C "Engine operation Mode Valid legacy switch" VALUE 0x80527AC5 RB_Val_Wu8 255.0 OneToOne 0.00 255.0 FORMAT "%5.1" /end CHARACTERISTIC
/begin CHARACTERISTIC CoEOM_stEomWrmUp_C "Adapter label to map new Eom out of bdemodst" VALUE 0x805271AC RB_Val_Wu32 4294967295.00 OneToOne 0.00 4294967295.00 FORMAT "%13.2" /end CHARACTERISTIC
/begin CHARACTERISTIC CoEOM_stGDIStgHSP_I.OperMod2Idx_M "Mapping of a 16-bit mode of operation to the classic HSP stages / Mapping-Table for the conversion of the operation-mode-information in an other format" MAP 0x80527B32 RB_Map_U8U8_U8 255.0 OneToOne 0.00 255.0 FORMAT "%5.1"
 /begin AXIS_DESCR STD_AXIS NO_INPUT_QUANTITY CoEOM_idxOperModCfgd_VERB 4 0.00 3.00000000000 FORMAT "%13.11" DEPOSIT ABSOLUTE /end AXIS_DESCR
 /begin AXIS_DESCR STD_AXIS NO_INPUT_QUANTITY CoEOM_idxOperModStgTot_VERB 8 0.00 15.0000000000 FORMAT "%13.10" DEPOSIT ABSOLUTE /end AXIS_DESCR
/end CHARACTERISTIC
/begin CHARACTERISTIC CoEOM_stInjr_M "" MAP 0x805270B2 RB_Map_U8U8_U16 32.0000000000 CoEOM_stEomInjr_VERB 0.00 32.0000000000 FORMAT "%13.10" READ_ONLY
 /begin AXIS_DESCR STD_AXIS CoEOM_idxEomAct CoEOM_idxOperModTot_VERB 4 0.00 31.0000000000 FORMAT "%13.10" DEPOSIT ABSOLUTE /end AXIS_DESCR
 /begin AXIS_DESCR STD_AXIS CoEOM_idxEomStgAct CoEOM_idxOperModStgTot_VERB 8 0.00 15.0000000000 FORMAT "%13.10" DEPOSIT ABSOLUTE /end AXIS_DESCR
/end CHARACTERISTIC
/begin CHARACTERISTIC CoEOM_stLimp_C "Adapter label to select neutral value of former bdemodnl" VALUE 0x805271B0 RB_Val_Wu8 255.0 OneToOne 0.00 255.0 FORMAT "%5.1" /end CHARACTERISTIC
/begin CHARACTERISTIC CoEOM_stOperModInpSel_C "Switch for the choice of the desired troque for the EOM characteristic fields." VALUE 0x805272A8 RB_Val_Wu8 3.000 OneToOne 0.00 3.000 FORMAT "%5.3" EXTENDED_LIMITS 0.00 255.0 /end CHARACTERISTIC
/begin CHARACTERISTIC CoEOM_stOpSt_M "" MAP 0x80527100 RB_Map_U8U8_U16 32.0000000000 CoEOM_stEomOpSt_VERB 0.00 32.0000000000 FORMAT "%13.10" READ_ONLY
 /begin AXIS_DESCR STD_AXIS CoEOM_idxEomAct CoEOM_idxOperModTot_VERB 4 0.00 31.0000000000 FORMAT "%13.10" DEPOSIT ABSOLUTE /end AXIS_DESCR
 /begin AXIS_DESCR STD_AXIS CoEOM_idxEomStgAct CoEOM_idxOperModStgTot_VERB 8 0.00 15.0000000000 FORMAT "%13.10" DEPOSIT ABSOLUTE /end AXIS_DESCR
/end CHARACTERISTIC
/begin CHARACTERISTIC CoEOM_stPhaEomIgnRels_C "Phase of operation mode to request a ignition angle release." VALUE 0x80527A7B RB_Val_Wu8 255.0 OneToOne 0.00 255.0 FORMAT "%5.1" /end CHARACTERISTIC
/begin CHARACTERISTIC CoEOM_stPhaEomShift2_C "Threshold phase of the mode of operation change-over" VALUE 0x80527AC6 RB_Val_Wu8 255.0 OneToOne 0.00 255.0 FORMAT "%5.1" /end CHARACTERISTIC
/begin CHARACTERISTIC CoEOM_stPhaEomShift_C "Threshold phase of the mode of operation change-over" VALUE 0x80527AC7 RB_Val_Wu8 255.0 OneToOne 0.00 255.0 FORMAT "%5.1" /end CHARACTERISTIC
/begin CHARACTERISTIC CoEOM_stPrioCatHeatg_C "Adapter label to select the new priority of catalyst heating" VALUE 0x805271B1 RB_Val_Wu8 255.0 OneToOne 0.00 255.0 FORMAT "%5.1" /end CHARACTERISTIC
/begin CHARACTERISTIC CoEOM_stPrioDiagMgr_C "Adapter label to select the new priority of Diagnose Manager" VALUE 0x805271B2 RB_Val_Wu8 255.0 OneToOne 0.00 255.0 FORMAT "%5.1" /end CHARACTERISTIC
/begin CHARACTERISTIC CoEOM_stPrioEomDmd_T "Static priorities of operating mode requests" CURVE 0x80526FFF RB_Curve_U8_U8 24.0000000000 CoEOM_OperMod_Set_COMPU_VERB 0.00 24.0000000000 FORMAT "%13.10"
 /begin AXIS_DESCR STD_AXIS NO_INPUT_QUANTITY OneToOne 25 0.00 255.0 FORMAT "%5.1" DEPOSIT ABSOLUTE /end AXIS_DESCR
/end CHARACTERISTIC
/begin CHARACTERISTIC CoEOM_stPrioLimp_C "Adapter label to select the new priority of Limp mode" VALUE 0x805271B3 RB_Val_Wu8 255.0 OneToOne 0.00 255.0 FORMAT "%5.1" /end CHARACTERISTIC
/begin CHARACTERISTIC CoEOM_stPrioWrmUp_C "To calibrate the priority of WarmUp Eom" VALUE 0x805271B4 RB_Val_Wu8 255.0 OneToOne 0.00 255.0 FORMAT "%5.1" /end CHARACTERISTIC
/begin CHARACTERISTIC CoEOM_stStatPrio_C "If the sorting of engine operating mode request is to be executed based on the static priority" VALUE 0x80527032 RB_Val_Wu8 255.0 OneToOne 0.00 255.0 FORMAT "%5.1" /end CHARACTERISTIC
/begin CHARACTERISTIC CoEOM_stStgCatHeatg_T "Curve to map the former values of bdemodkh to the new CoEOM values" CURVE 0x805271B6 RB_Curve_U8_U16_Static 65535.00 OneToOne 0.00 65535.00 FORMAT "%8.2"
 /begin AXIS_DESCR STD_AXIS CoEOM_stEomCatHeatSrcLcyToVld OneToOne 16 0.00 255.0 FORMAT "%5.1" DEPOSIT ABSOLUTE /end AXIS_DESCR
/end CHARACTERISTIC
/begin CHARACTERISTIC CoEOM_stStgDiagMgr_T "Curve to map the former values of bdemoddm to the new CoEOM values" CURVE 0x805271E8 RB_Curve_U16_U16 65535.00 OneToOne 0.00 65535.00 FORMAT "%8.2"
 /begin AXIS_DESCR STD_AXIS DSM_stOpMDes OneToOne 16 0.00 65535.00 FORMAT "%8.2" DEPOSIT ABSOLUTE /end AXIS_DESCR
/end CHARACTERISTIC
/begin CHARACTERISTIC CoEOM_stStgLimp_T "Curve to map the former values of bdemodnl to the new CoEOM values" CURVE 0x8052722A RB_Curve_U8_U16_Static 65535.00 OneToOne 0.00 65535.00 FORMAT "%8.2"
 /begin AXIS_DESCR STD_AXIS CoEOM_stEomLimpSrcLcyToVld OneToOne 16 0.00 255.0 FORMAT "%5.1" DEPOSIT ABSOLUTE /end AXIS_DESCR
/end CHARACTERISTIC
/begin CHARACTERISTIC CoEOM_stStgWrmUp_T "To calibrate the stage mapping for warm up Eom" CURVE 0x8052725C RB_Curve_U8_U16_Static 65535.00 OneToOne 0.00 65535.00 FORMAT "%8.2"
 /begin AXIS_DESCR STD_AXIS CoEOM_stEomStrtSrcLcyToVld OneToOne 16 0.00 255.0 FORMAT "%5.1" DEPOSIT ABSOLUTE /end AXIS_DESCR
/end CHARACTERISTIC
/begin CHARACTERISTIC CoEOM_stTestSplOperModPrio_C "Priority of simple test interface in engine operation mode coordination" VALUE 0x80527033 RB_Val_Wu8 255.0 OneToOne 0.00 255.0 FORMAT "%5.1" /end CHARACTERISTIC
/begin CHARACTERISTIC CoEOM_stThdPhaEomShiftMax_C "A range of switching states is protected to be interrupted. This is the maximum threshold of the protected area" VALUE 0x80527A7C RB_Val_Wu8 255.0 OneToOne 0.00 255.0 FORMAT "%5.1" /end CHARACTERISTIC
/begin CHARACTERISTIC CoEOM_stThdPhaEomShiftMin_C "A range of switching states is protected to be interrupted. This is the minimum threshold of the protected area" VALUE 0x80527A7D RB_Val_Wu8 255.0 OneToOne 0.00 255.0 FORMAT "%5.1" /end CHARACTERISTIC
/begin CHARACTERISTIC CoEOM_stVlvLft_M "" MAP 0x8052714E RB_Map_U8U8_U16 32804.0000000 CoEOM_stEomVlvLftIntk_VERB 0.00 32804.0000000 FORMAT "%13.7" READ_ONLY
 /begin AXIS_DESCR STD_AXIS CoEOM_idxEomAct CoEOM_idxOperModTot_VERB 4 0.00 31.0000000000 FORMAT "%13.10" DEPOSIT ABSOLUTE /end AXIS_DESCR
 /begin AXIS_DESCR STD_AXIS CoEOM_idxEomStgAct CoEOM_idxOperModStgTot_VERB 8 0.00 15.0000000000 FORMAT "%13.10" DEPOSIT ABSOLUTE /end AXIS_DESCR
/end CHARACTERISTIC
/begin CHARACTERISTIC CoEOM_stWrmUpFinshd_C "Adapter label to select neutral value of former bdemodst" VALUE 0x8052728E RB_Val_Wu8 255.0 OneToOne 0.00 255.0 FORMAT "%5.1" /end CHARACTERISTIC
/begin CHARACTERISTIC CoEOM_SwtStgy1.stTrigAftSwt_C "Switching strategy of eom switches that operates without trigger / Needed actuators at the end of a switch" VALUE 0x80527A80 RB_Val_Wu16 65535.00 OneToOne 0.00 65535.00 FORMAT "%8.2" /end CHARACTERISTIC
/begin CHARACTERISTIC CoEOM_SwtStgy1.tiMaxAirStaty_C "Switching strategy of eom switches that operates without trigger / Time-out label for AirSys feedback" VALUE 0x80527A82 RB_Val_Ws16 655.3500 Time_s -327.6800 327.6700 FORMAT "%8.4" /end CHARACTERISTIC
/begin CHARACTERISTIC CoEOM_SwtStgy2.stTrigAftSwt_C "Switching strategy of eom switches that operates with triggers and filling preparation / Needed actuators at the end of a switch" VALUE 0x80527A84 RB_Val_Wu16 65535.00 OneToOne 0.00 65535.00 FORMAT "%8.2" /end CHARACTERISTIC
/begin CHARACTERISTIC CoEOM_SwtStgy2.stTrig_C "Switching strategy of eom switches that operates with triggers and filling preparation / Label to calibrate the desired preparation trigger" VALUE 0x80527A86 RB_Val_Wu16 65535.00 OneToOne 0.00 65535.00 FORMAT "%8.2" /end CHARACTERISTIC
/begin CHARACTERISTIC CoEOM_SwtStgy2.tiMaxAirPrep_C "Switching strategy of eom switches that operates with triggers and filling preparation / Maximal time of filling preparation" VALUE 0x80527A88 RB_Val_Ws16 655.3500 Time_s -327.6800 327.6700 FORMAT "%8.4" /end CHARACTERISTIC
/begin CHARACTERISTIC CoEOM_SwtStgy2.tiMaxAirStaty_C "Switching strategy of eom switches that operates with triggers and filling preparation / Time-out label for AirSys feedback" VALUE 0x80527A8A RB_Val_Ws16 655.3500 Time_s -327.6800 327.6700 FORMAT "%8.4" /end CHARACTERISTIC
/begin CHARACTERISTIC CoEOM_SwtStgy2.tiMaxTrigAckd_C "Switching strategy of eom switches that operates with triggers and filling preparation / Time-out label for trigger feedback" VALUE 0x80527A8C RB_Val_Ws16 655.3500 Time_s -327.6800 327.6700 FORMAT "%8.4" /end CHARACTERISTIC
/begin CHARACTERISTIC CoEOM_SwtStgy5.stTrigAftSwt_C "Switch strategy for triggered valve lift switch / Label to calibrate the desired triggers (new stationary values) after a switch" VALUE 0x80527A8E RB_Val_Wu16 65535.00 OneToOne 0.00 65535.00 FORMAT "%8.2" /end CHARACTERISTIC
/begin CHARACTERISTIC CoEOM_SwtStgy5.stTrig_C "Switch strategy for triggered valve lift switch / Label to calibrate the desired preparation trigger" VALUE 0x80527A90 RB_Val_Wu16 65535.00 OneToOne 0.00 65535.00 FORMAT "%8.2" /end CHARACTERISTIC
/begin CHARACTERISTIC CoEOM_SwtStgy5.tiMaxAirStaty_C "Switch strategy for triggered valve lift switch / Time-out label for AirSys feedback" VALUE 0x80527A92 RB_Val_Ws16 655.3500 Time_s -327.6800 327.6700 FORMAT "%8.4" /end CHARACTERISTIC
/begin CHARACTERISTIC CoEOM_SwtStgy5.tiMaxTrigAckd_C "Switch strategy for triggered valve lift switch / Time-out label for trigger feedback" VALUE 0x80527A94 RB_Val_Ws16 655.3500 Time_s -327.6800 327.6700 FORMAT "%8.4" /end CHARACTERISTIC
/begin CHARACTERISTIC CoEOM_SwtStgy_I.OperMod2Idx_M "Map to select the desired switching strategy: Here, groups of eoms and stages can be made / Mapping-Table for the conversion of the operation-mode-information in an other format" MAP 0x80527A96 RB_Map_U8U8_U8 255.0 OneToOne 0.00 255.0 FORMAT "%5.1"
 /begin AXIS_DESCR STD_AXIS NO_INPUT_QUANTITY CoEOM_idxOperModCfgd_VERB 4 0.00 3.00000000000 FORMAT "%13.11" DEPOSIT ABSOLUTE /end AXIS_DESCR
 /begin AXIS_DESCR STD_AXIS NO_INPUT_QUANTITY CoEOM_idxOperModStgTot_VERB 8 0.00 15.0000000000 FORMAT "%13.10" DEPOSIT ABSOLUTE /end AXIS_DESCR
/end CHARACTERISTIC
/begin CHARACTERISTIC CoEOM_tiTogTest1_C "Toggle time parameter to calibrate the delay time between CoEOM_EomTest1_I and CoEOM_EomTest2_I" VALUE 0x80527034 RB_Val_Ws16 327670.0 Time_ms 0.00 327670.0 FORMAT "%8.1" EXTENDED_LIMITS -327680.0 327670.0 /end CHARACTERISTIC
/begin CHARACTERISTIC CoEOM_tiTogTest2_C "Toggle time parameter to calibrate the delay time between CoEOM_EomTest2_I and CoEOM_EomTest1_I" VALUE 0x80527036 RB_Val_Ws16 327670.0 Time_ms 0.00 327670.0 FORMAT "%8.1" EXTENDED_LIMITS -327680.0 327670.0 /end CHARACTERISTIC
/begin CHARACTERISTIC CoEOM_trqInrLimDelta_C "Delta for limited torque request for set path" VALUE 0x80527A7E RB_Val_Ws16 6553.500 md_q0p1 -3276.800 3276.700 FORMAT "%8.3" /end CHARACTERISTIC
/begin CHARACTERISTIC CoEOM_VheLcyMpg_I.OperMod2Idx_M "Mapping of a 16-bit mode of operation to the valve lift. / Mapping-Table for the conversion of the operation-mode-information in an other format" MAP 0x80527B04 RB_Map_U8U8_U8 255.0 OneToOne 0.00 255.0 FORMAT "%5.1"
 /begin AXIS_DESCR STD_AXIS NO_INPUT_QUANTITY CoEOM_idxOperModCfgd_VERB 4 0.00 3.00000000000 FORMAT "%13.11" DEPOSIT ABSOLUTE /end AXIS_DESCR
 /begin AXIS_DESCR STD_AXIS NO_INPUT_QUANTITY CoEOM_idxOperModStgTot_VERB 8 0.00 15.0000000000 FORMAT "%13.10" DEPOSIT ABSOLUTE /end AXIS_DESCR
/end CHARACTERISTIC
/begin CHARACTERISTIC CoESS_iElecLdRstLe_C "Electric Load Current Lower threshold" VALUE 0x80527B60 RB_Val_Ws16 655.3500 Curr_A -327.6800 327.6700 FORMAT "%8.4" /end CHARACTERISTIC
/begin CHARACTERISTIC CoESS_iElecLdRstRht_C "Electric load current high threshold" VALUE 0x80527B62 RB_Val_Ws16 655.3500 Curr_A -327.6800 327.6700 FORMAT "%8.4" /end CHARACTERISTIC
/begin CHARACTERISTIC CoESS_iElecLdThres_C "Threshold value of electrical load" VALUE 0x80527B64 RB_Val_Ws16 655.3500 Curr_A -327.6800 327.6700 FORMAT "%8.4" /end CHARACTERISTIC
/begin CHARACTERISTIC CoESS_iEPSLdLe1_C "EPS Load Lower threshold 1" VALUE 0x80527B66 RB_Val_Ws16 655.3500 Curr_A -327.6800 327.6700 FORMAT "%8.4" /end CHARACTERISTIC
/begin CHARACTERISTIC CoESS_iEPSLdLe2_C "EPS Load current Load 2" VALUE 0x80527B68 RB_Val_Ws16 655.3500 Curr_A -327.6800 327.6700 FORMAT "%8.4" /end CHARACTERISTIC
/begin CHARACTERISTIC CoESS_iEPSLdRht1_C "EPS Load current lower threshold 2" VALUE 0x80527B6A RB_Val_Ws16 655.3500 Curr_A -327.6800 327.6700 FORMAT "%8.4" /end CHARACTERISTIC
/begin CHARACTERISTIC CoESS_iEPSLdRht2_C "EPS current load higher threshold" VALUE 0x80527B6C RB_Val_Ws16 655.3500 Curr_A -327.6800 327.6700 FORMAT "%8.4" /end CHARACTERISTIC
/begin CHARACTERISTIC CoESS_nIdlBattThres_C "Speed threshold value for set condition" VALUE 0x80527B6E RB_Val_Ws16 32767.50 EngN -16384.00 16383.50 FORMAT "%8.2" /end CHARACTERISTIC
/begin CHARACTERISTIC CoESS_nMax_C "Max. engine speed limitation request from Electrical Supply System" VALUE 0x80527B70 RB_Val_Ws16 32767.50 EngN -16384.00 16383.50 FORMAT "%8.2" /end CHARACTERISTIC
/begin CHARACTERISTIC CoESS_nMin1Batt_C "Minimum engine speed request 1" VALUE 0x80527B72 RB_Val_Ws16 32767.50 EngN -16384.00 16383.50 FORMAT "%8.2" /end CHARACTERISTIC
/begin CHARACTERISTIC CoESS_nMin2Batt_C "Minimum engine speed request 2" VALUE 0x80527B74 RB_Val_Ws16 32767.50 EngN -16384.00 16383.50 FORMAT "%8.2" /end CHARACTERISTIC
/begin CHARACTERISTIC CoESS_nMin3Batt_C "Minimum engine speed request 3" VALUE 0x80527B76 RB_Val_Ws16 32767.50 EngN -16384.00 16383.50 FORMAT "%8.2" /end CHARACTERISTIC
/begin CHARACTERISTIC CoESS_nMin4Batt_C "Minimum Engine speed Request4" VALUE 0x80527B78 RB_Val_Ws16 32767.50 EngN -16384.00 16383.50 FORMAT "%8.2" /end CHARACTERISTIC
/begin CHARACTERISTIC CoESS_nMin5Batt_C "Minimum Engine speed Request 5" VALUE 0x80527B7A RB_Val_Ws16 32767.50 EngN -16384.00 16383.50 FORMAT "%8.2" /end CHARACTERISTIC
/begin CHARACTERISTIC CoESS_nMinAltLoad_C "Minimum alternator idle up speed" VALUE 0x80527B7C RB_Val_Ws16 32767.50 EngN -16384.00 16383.50 FORMAT "%8.2" /end CHARACTERISTIC
/begin CHARACTERISTIC CoESS_nMinThres_C "Basic threshold value for set condition" VALUE 0x80527B7E RB_Val_Ws16 32767.50 EngN -16384.00 16383.50 FORMAT "%8.2" /end CHARACTERISTIC
/begin CHARACTERISTIC CoESS_stRampDeActv_C "Switch to deactivate ramping function for blower fan minimum voltage request" VALUE 0x80527B9C RB_Val_Wboolean 1.00000000000 B_TRUE 0.00 1.00000000000 FORMAT "%13.11" /end CHARACTERISTIC
/begin CHARACTERISTIC CoESS_swtElecLdSel_C "Calibration parameter to select electrical load" VALUE 0x80527B80 RB_Val_Wu8 1.000 OneToOne 0.00 1.000 FORMAT "%5.3" EXTENDED_LIMITS 0.00 255.0 /end CHARACTERISTIC
/begin CHARACTERISTIC CoESS_tiAltIdleUp_C "Filter time for alternator idle up speed request" VALUE 0x80527B84 RB_Val_Ws32 4294.9672940000000 TimeDelay_s 0.0000020000000 4294.9672959999998 FORMAT "%19.14" EXTENDED_LIMITS 0.000002000000001 4294.9672959999998 /end CHARACTERISTIC
/begin CHARACTERISTIC CoESS_tiBlowrRampInvld_C "Blower voltage ramp time in case invalid diagnosis" VALUE 0x80527B9E RB_Val_Ws16 655.3500 Time_s -327.6800 327.6700 FORMAT "%8.4" /end CHARACTERISTIC
/begin CHARACTERISTIC CoESS_tiFilUACGUpReq_C "Time for filtering of ACG output minimum voltage required from AC ECU." VALUE 0x80527BA0 RB_Val_Ws32 4294.9672940000000 TimeDelay_s 0.0000020000000 4294.9672959999998 FORMAT "%19.14" EXTENDED_LIMITS 0.000002000000001 4294.9672959999998 /end CHARACTERISTIC
/begin CHARACTERISTIC CoESS_tiFrntBlowrRamp_T "CURVE for Front Blower voltage ramp time" CURVE 0x80527BA4 RB_Curve_S16_S16 655.3500 Time_s -327.6800 327.6700 FORMAT "%8.4"
 /begin AXIS_DESCR STD_AXIS NO_INPUT_QUANTITY Volt_Batt 6 -655360.0 655340.0 FORMAT "%8.1" DEPOSIT ABSOLUTE /end AXIS_DESCR
/end CHARACTERISTIC
/begin CHARACTERISTIC CoESS_tiHiLoBattRst_C "High to low debounce time for battery voltage getting greater than threshold to set the default selection for ESS engine speed" VALUE 0x80527B88 RB_Val_Ws16 655350.0 TimeDeb -327680.0 327670.0 FORMAT "%8.1" /end CHARACTERISTIC
/begin CHARACTERISTIC CoESS_tiHiLoBattSet_C "High to low debounce time for battery voltage getting greater than threshold to set the calibration selection for ESS engine speed" VALUE 0x80527B8A RB_Val_Ws16 655350.0 TimeDeb -327680.0 327670.0 FORMAT "%8.1" /end CHARACTERISTIC
/begin CHARACTERISTIC CoESS_tiHiLoEngSet_C "High to low debounce time for engine speed getting greater than threshold to set the calibration selection for ESS engine speed" VALUE 0x80527B8C RB_Val_Ws16 655350.0 TimeDeb -327680.0 327670.0 FORMAT "%8.1" /end CHARACTERISTIC
/begin CHARACTERISTIC CoESS_tiLoHiBattRst_C "Low to high debounce time for battery voltage getting greater than threshold to set the default selection for ESS engine speed" VALUE 0x80527B8E RB_Val_Ws16 655350.0 TimeDeb -327680.0 327670.0 FORMAT "%8.1" /end CHARACTERISTIC
/begin CHARACTERISTIC CoESS_tiLoHiBattSet_C "Low to high debounce time for battery voltage getting greater than threshold to set the calibration selection for ESS engine speed" VALUE 0x80527B90 RB_Val_Ws16 655350.0 TimeDeb -327680.0 327670.0 FORMAT "%8.1" /end CHARACTERISTIC
/begin CHARACTERISTIC CoESS_tiLoHiEngSet_C "Low to high debounce time for engine speed getting greater than threshold to set the calibration selection for ESS engine speed" VALUE 0x80527B92 RB_Val_Ws16 655350.0 TimeDeb -327680.0 327670.0 FORMAT "%8.1" /end CHARACTERISTIC
/begin CHARACTERISTIC CoESS_tiMICUTxBlowrRamp_T "CURVE for MICU blower voltage ramp time" CURVE 0x80527BBE RB_Curve_S16_S16 655.3500 Time_s -327.6800 327.6700 FORMAT "%8.4"
 /begin AXIS_DESCR STD_AXIS NO_INPUT_QUANTITY Volt_Batt 6 -655360.0 655340.0 FORMAT "%8.1" DEPOSIT ABSOLUTE /end AXIS_DESCR
/end CHARACTERISTIC
/begin CHARACTERISTIC CoESS_tiRrBlowrRamp_T "CURVE for Rear Blower voltage ramp time" CURVE 0x80527BD8 RB_Curve_S16_S16 655.3500 Time_s -327.6800 327.6700 FORMAT "%8.4"
 /begin AXIS_DESCR STD_AXIS NO_INPUT_QUANTITY Volt_Batt 6 -655360.0 655340.0 FORMAT "%8.1" DEPOSIT ABSOLUTE /end AXIS_DESCR
/end CHARACTERISTIC
/begin CHARACTERISTIC CoESS_uACGUpNoReq_C "The default minimum voltage when there is no request from AC ECU" VALUE 0x80527BF2 RB_Val_Ws16 1310700. Volt_Batt -655360.0 655340.0 FORMAT "%8.1" /end CHARACTERISTIC
/begin CHARACTERISTIC CoESS_uACGUpReq_C "The ACG output minimum voltage is required from AC ECU." VALUE 0x80527BF4 RB_Val_Ws16 1310700. Volt_Batt -655360.0 655340.0 FORMAT "%8.1" /end CHARACTERISTIC
/begin CHARACTERISTIC CoESS_uBlowrFanHysHi_C "The high limit of blower fan target voltage for slope ramp calculation" VALUE 0x80527BF6 RB_Val_Ws16 1310700. Volt_Batt -655360.0 655340.0 FORMAT "%8.1" /end CHARACTERISTIC
/begin CHARACTERISTIC CoESS_uBlowrFanHysLo_C "The low limit of blower fan target voltage for slope ramp calculation" VALUE 0x80527BF8 RB_Val_Ws16 1310700. Volt_Batt -655360.0 655340.0 FORMAT "%8.1" /end CHARACTERISTIC
/begin CHARACTERISTIC CoESS_uBlowrFanManHi_C "The high limit of Manual AC blower fan target voltage for slope ramp calculation" VALUE 0x80527BFA RB_Val_Ws16 1310700. Volt_Batt -655360.0 655340.0 FORMAT "%8.1" /end CHARACTERISTIC
/begin CHARACTERISTIC CoESS_uBlowrFanManLo_C "The low limit of Manual AC blower fan target voltage for slope ramp calculation" VALUE 0x80527BFC RB_Val_Ws16 1310700. Volt_Batt -655360.0 655340.0 FORMAT "%8.1" /end CHARACTERISTIC
/begin CHARACTERISTIC CoESS_uBlowrTarManLowr_C "The Lower limit of Manual AC blower target voltage" VALUE 0x80527BFE RB_Val_Ws16 1310700. Volt_Batt -655360.0 655340.0 FORMAT "%8.1" /end CHARACTERISTIC
/begin CHARACTERISTIC CoESS_uBlowrTarManUppr_C "The Upper limit of Manual AC blower target voltage" VALUE 0x80527C00 RB_Val_Ws16 1310700. Volt_Batt -655360.0 655340.0 FORMAT "%8.1" /end CHARACTERISTIC
/begin CHARACTERISTIC CoESS_uBlowrTarUHysLowr_C "The Lower limit of blower target voltage" VALUE 0x80527C02 RB_Val_Ws16 1310700. Volt_Batt -655360.0 655340.0 FORMAT "%8.1" /end CHARACTERISTIC
/begin CHARACTERISTIC CoESS_uBlowrTarUHysUppr_C "The Upper limit of blower target voltage" VALUE 0x80527C04 RB_Val_Ws16 1310700. Volt_Batt -655360.0 655340.0 FORMAT "%8.1" /end CHARACTERISTIC
/begin CHARACTERISTIC CoESS_uFrntBlowrDes_T "CURVE for Desired front Blower voltage" CURVE 0x80527C06 RB_Curve_S16_S16 1310700. Volt_Batt -655360.0 655340.0 FORMAT "%8.1"
 /begin AXIS_DESCR STD_AXIS NO_INPUT_QUANTITY Volt_Batt 6 -655360.0 655340.0 FORMAT "%8.1" DEPOSIT ABSOLUTE /end AXIS_DESCR
/end CHARACTERISTIC
/begin CHARACTERISTIC CoESS_uIdlBattThresRst_C "Battery voltage threshold value for reset condition" VALUE 0x80527B94 RB_Val_Ws16 1310700. Volt_Batt -655360.0 655340.0 FORMAT "%8.1" /end CHARACTERISTIC
/begin CHARACTERISTIC CoESS_uIdlBattThresSet_C "Battery voltage threshold value for set condition" VALUE 0x80527B96 RB_Val_Ws16 1310700. Volt_Batt -655360.0 655340.0 FORMAT "%8.1" /end CHARACTERISTIC
/begin CHARACTERISTIC CoESS_uMICUTxBlowrDes_T "CURVE for Desired MICU Tx blower voltage" CURVE 0x80527C20 RB_Curve_S16_S16 1310700. Volt_Batt -655360.0 655340.0 FORMAT "%8.1"
 /begin AXIS_DESCR STD_AXIS NO_INPUT_QUANTITY Volt_Batt 6 -655360.0 655340.0 FORMAT "%8.1" DEPOSIT ABSOLUTE /end AXIS_DESCR
/end CHARACTERISTIC
/begin CHARACTERISTIC CoESS_uMinPsp_M "minimum supply voltage for IGC" MAP 0x80527C3A RB_Map_U8S16_S16 1310700. Volt_Batt -655360.0 655340.0 FORMAT "%8.1"
 /begin AXIS_DESCR STD_AXIS tfuelsq temp_ub_q0p75_o48 3 -48.0 143.3 FORMAT "%5.1" DEPOSIT ABSOLUTE /end AXIS_DESCR
 /begin AXIS_DESCR STD_AXIS Epm_nEng EngN 3 -16384.00 16383.50 FORMAT "%8.2" DEPOSIT ABSOLUTE /end AXIS_DESCR
/end CHARACTERISTIC
/begin CHARACTERISTIC CoESS_uRrBlowrDes_T "CURVE for Desired rear Blower voltage" CURVE 0x80527C58 RB_Curve_S16_S16 1310700. Volt_Batt -655360.0 655340.0 FORMAT "%8.1"
 /begin AXIS_DESCR STD_AXIS NO_INPUT_QUANTITY Volt_Batt 6 -655360.0 655340.0 FORMAT "%8.1" DEPOSIT ABSOLUTE /end AXIS_DESCR
/end CHARACTERISTIC
/begin CHARACTERISTIC CoESS_vMinThres_C "Velocity threshold value for set condition" VALUE 0x80527B98 RB_Val_Ws16 655.3500 Vel -327.6800 327.6700 FORMAT "%8.4" /end CHARACTERISTIC
/begin CHARACTERISTIC CWBDESTHSP "Code word for BDESTHSP" VALUE 0x80527AC8 RB_Val_Wu8 255.0 dez 0.00 255.0 FORMAT "%5.1" /end CHARACTERISTIC
/begin CHARACTERISTIC KLBDEMTAFC "Temperature correction factor for air charge" CURVE 0x80527AC9 RB_Curve_U8_U8 1.992188 fak_ub_b2 0.00 1.992188 FORMAT "%8.6"
 /begin AXIS_DESCR STD_AXIS tanrm fak_ub_b2 6 0.00 1.992188 FORMAT "%8.6" DEPOSIT ABSOLUTE /end AXIS_DESCR
/end CHARACTERISTIC
/begin CHARACTERISTIC VLVLFT_SPINTK_ATS.LimitTypeMsk_C "Actuator test VLVLFT_SPINTK_ATS / Tester demand monitoring enable mask for actuators" VALUE 0x8058AEAC Val_Wu8 255.0 OneToOne 0.00 255.0 FORMAT "%5.1" /end CHARACTERISTIC
/begin CHARACTERISTIC VLVLFT_SPINTK_ATS.CnvNorm_C "Actuator test VLVLFT_SPINTK_ATS / Conversion norm used for conversion to/from internal scaling" VALUE 0x8058AEAD Val_Wu8 255.0 OneToOne 0.00 255.0 FORMAT "%5.1" /end CHARACTERISTIC
/begin CHARACTERISTIC VLVLFT_SPINTK_ATS.LowLim_C "Actuator test VLVLFT_SPINTK_ATS / Lower limit for monitoring" VALUE 0x8058AEAE Val_Wu16 65535.00 OneToOne 0.00 65535.00 FORMAT "%8.2" /end CHARACTERISTIC
/begin CHARACTERISTIC VLVLFT_SPINTK_ATS.UpLim_C "Actuator test VLVLFT_SPINTK_ATS / Upper limit for monitoring" VALUE 0x8058AEB0 Val_Wu16 65535.00 OneToOne 0.00 65535.00 FORMAT "%8.2" /end CHARACTERISTIC
/begin CHARACTERISTIC VLVLFT_SPINTK_ATS.CnvFac_C "Actuator test VLVLFT_SPINTK_ATS / Factor used for conversion to/from internal scaling" VALUE 0x8058AEB4 Val_Ws32 4294967295.00 OneToOne -2147483648.00 2147483647.00 FORMAT "%13.2" /end CHARACTERISTIC
/begin CHARACTERISTIC VLVLFT_SPINTK_ATS.CnvOfs_C "Actuator test VLVLFT_SPINTK_ATS / Offset used for conversion to/from internal scaling" VALUE 0x8058AEB8 Val_Ws16 65535.00 OneToOne -32768.00 32767.00 FORMAT "%8.2" /end CHARACTERISTIC
/begin CHARACTERISTIC VLVLFT_SPINTK_ATS.DfltVal_C "Actuator test VLVLFT_SPINTK_ATS / Default value for standbytest" VALUE 0x8058AEBA Val_Wu16 65535.00 OneToOne 0.00 65535.00 FORMAT "%8.2" /end CHARACTERISTIC
/begin MEASUREMENT bdehspstf_msg "GDI HSP mode stage" UBYTE dez 1 100 0.00 255.0 FORMAT "%5.1" ECU_ADDRESS 0x6000FB4E /end MEASUREMENT
/begin MEASUREMENT bdehspstf_tmp "Intermediate value for internal purposes." UBYTE dez 1 100 0.00 255.0 FORMAT "%5.1" ECU_ADDRESS 0x6000F0C1 /end MEASUREMENT
/begin MEASUREMENT bdemagrs "GDI desired mode for EGR" UBYTE OneToOne 1 100 0.00 255.0 FORMAT "%5.1" ECU_ADDRESS 0x6000F0BB /end MEASUREMENT
/begin MEASUREMENT bdemagrs_msg "GDI desired mode for EGR" UBYTE OneToOne 1 100 0.00 255.0 FORMAT "%5.1" ECU_ADDRESS 0x60014AD7 /end MEASUREMENT
/begin MEASUREMENT bdemfes_msg "GDI desired mode for filling interventions" UBYTE OneToOne 1 100 0.00 255.0 FORMAT "%5.1" ECU_ADDRESS 0x60014AD8 /end MEASUREMENT
/begin MEASUREMENT bdemlbks "GDI desired mode for swirl control" UBYTE OneToOne 1 100 0.00 255.0 FORMAT "%5.1" ECU_ADDRESS 0x6000F0BA /end MEASUREMENT
/begin MEASUREMENT bdemodbv_msg "GDI-mode byte of burning conditions" UBYTE dez 1 100 0.00 255.0 FORMAT "%5.1" ECU_ADDRESS 0x60014ADA /end MEASUREMENT
/begin MEASUREMENT bdemodfaOld_msg "GDI desired mode driver in the last computing time slot." UBYTE OneToOne 1 100 0.00 255.0 FORMAT "%5.1" ECU_ADDRESS 0x60014ADB /end MEASUREMENT
/begin MEASUREMENT bdemodfa_msg "GDI desired mode driver." UBYTE OneToOne 1 100 0.00 255.0 FORMAT "%5.1" ECU_ADDRESS 0x60014ADC /end MEASUREMENT
/begin MEASUREMENT bdemodfa_tmp "Intermediate value for internal purposes." UBYTE OneToOne 1 100 0.00 255.0 FORMAT "%5.1" ECU_ADDRESS 0x6000F0C0 /end MEASUREMENT
/begin MEASUREMENT bdemodmd_msg "GDI desired mode torque control." UBYTE OneToOne 1 100 0.00 255.0 FORMAT "%5.1" ECU_ADDRESS 0x60014ADD /end MEASUREMENT
/begin MEASUREMENT bdemodrdnt_msg "Redundancy for GDI mode" UBYTE OneToOne 1 100 0.00 255.0 FORMAT "%5.1" ECU_ADDRESS 0x60014ADE /end MEASUREMENT
/begin MEASUREMENT bdemods_msg "GDI desired mode" UBYTE dez 1 100 0.00 255.0 FORMAT "%5.1" ECU_ADDRESS 0x60014ADF /end MEASUREMENT
/begin MEASUREMENT bdemods_tmp "Intermediate value for internal purposes." UBYTE dez 1 100 0.00 255.0 FORMAT "%5.1" ECU_ADDRESS 0x6000F0BF /end MEASUREMENT
/begin MEASUREMENT bdemods_w_msg "GDI desired mode (low byte) + states (high byte)." UWORD dez 1 100 0.00 65535.00 FORMAT "%8.2" ECU_ADDRESS 0x60014974 /end MEASUREMENT
/begin MEASUREMENT bdemods_w_tmp "Intermediate value for internal purposes." UWORD dez 1 100 0.00 65535.00 FORMAT "%8.2" ECU_ADDRESS 0x60007F1A /end MEASUREMENT
/begin MEASUREMENT bdemodvkh_msg "GDI possible modes before catalyst heating." UBYTE dez 1 100 0.00 255.0 FORMAT "%5.1" ECU_ADDRESS 0x60014AE0 /end MEASUREMENT
/begin MEASUREMENT bdemodvrbt_msg "Definite forbidden operating modes." UBYTE OneToOne 1 100 0.00 255.0 FORMAT "%5.1" ECU_ADDRESS 0x60014AE1 /end MEASUREMENT
/begin MEASUREMENT bdemodz_msg "GDI target EOM." UBYTE OneToOne 1 100 0.00 255.0 FORMAT "%5.1" ECU_ADDRESS 0x6000FB4B /end MEASUREMENT
/begin MEASUREMENT bdemodz_tmp "Intermediate value for internal purposes." UBYTE OneToOne 1 100 0.00 255.0 FORMAT "%5.1" ECU_ADDRESS 0x6000F0BE /end MEASUREMENT
/begin MEASUREMENT bdemod_msg "operating mode of gasoline direct injection" UBYTE OneToOne 1 100 0.00 255.0 FORMAT "%5.1" ECU_ADDRESS 0x60014AD9 /end MEASUREMENT
/begin MEASUREMENT bdemsus "GDI desired mode for variable intake manifold" UBYTE OneToOne 1 100 0.00 255.0 FORMAT "%5.1" ECU_ADDRESS 0x6000F0B9 /end MEASUREMENT
/begin MEASUREMENT B_baschs_msg "GDI desired mode stratified (B_schs, B_skhs)" UBYTE B_TRUE 1 100 0.00 1.00000000000 BIT_MASK 0x1 FORMAT "%13.11" ECU_ADDRESS 0x6000FACC /end MEASUREMENT
/begin MEASUREMENT B_basch_msg "stratified operating mode active (stratified or stratified catalyst heating)" UBYTE B_TRUE 1 100 0.00 1.00000000000 BIT_MASK 0x1 FORMAT "%13.11" ECU_ADDRESS 0x6000FACD /end MEASUREMENT
/begin MEASUREMENT B_bdeminst_tmp "Intermediate value for internal purposes." UBYTE B_TRUE 1 100 0.00 1.00000000000 BIT_MASK 0x1 FORMAT "%13.11" ECU_ADDRESS 0x6000F0BD /end MEASUREMENT
/begin MEASUREMENT B_bdemodfa_msg "The desired driver mode will become the target operating mode." UBYTE B_TRUE 1 100 0.00 1.00000000000 BIT_MASK 0x1 FORMAT "%13.11" ECU_ADDRESS 0x6000FACB /end MEASUREMENT
/begin MEASUREMENT B_bdemz_msg "GDI-mode dynamic state" UBYTE B_TRUE 1 100 0.00 1.00000000000 BIT_MASK 0x1 FORMAT "%13.11" ECU_ADDRESS 0x6000FACA /end MEASUREMENT
/begin MEASUREMENT B_bderlsts_msg "Trigger because of Eom changes to the air mass control (input in collector function)." UBYTE B_TRUE 1 100 0.00 1.00000000000 BIT_MASK 0x1 FORMAT "%13.11" ECU_ADDRESS 0x6000FAC9 /end MEASUREMENT
/begin MEASUREMENT B_bdetes_msg "Trigger because of Eom changes to the canister purge (input in collector function)." UBYTE B_TRUE 1 100 0.00 1.00000000000 BIT_MASK 0x1 FORMAT "%13.11" ECU_ADDRESS 0x6000FAC8 /end MEASUREMENT
/begin MEASUREMENT B_berhom_msg "calculate homogeneous mode" UBYTE B_TRUE 1 100 0.00 1.00000000000 BIT_MASK 0x1 FORMAT "%13.11" ECU_ADDRESS 0x6000FAC7 /end MEASUREMENT
/begin MEASUREMENT B_bersch_msg "calculate stratified charge mode" UBYTE B_TRUE 1 100 0.00 1.00000000000 BIT_MASK 0x1 FORMAT "%13.11" ECU_ADDRESS 0x6000FAC6 /end MEASUREMENT
/begin MEASUREMENT B_berskh_msg "calculate stratified catalyst heating mode" UBYTE B_TRUE 1 100 0.00 1.00000000000 BIT_MASK 0x1 FORMAT "%13.11" ECU_ADDRESS 0x6000FAC5 /end MEASUREMENT
/begin MEASUREMENT B_eahoms_msg "GDI desired injection mode homogeneous (B_homs, B_hmms, B_hoss, B_hsps)." UBYTE B_TRUE 1 100 0.00 1.00000000000 BIT_MASK 0x1 FORMAT "%13.11" ECU_ADDRESS 0x6000FAB9 /end MEASUREMENT
/begin MEASUREMENT B_eahom_msg "GDI injection mode homogeneous (B_hom, B_hmm, B_hos)" UBYTE B_TRUE 1 100 0.00 1.00000000000 BIT_MASK 0x1 FORMAT "%13.11" ECU_ADDRESS 0x6000FABA /end MEASUREMENT
/begin MEASUREMENT B_easchs_msg "GDI desired injection mode stratified (B_schs, B_hoss, B_skhs)." UBYTE B_TRUE 1 100 0.00 1.00000000000 BIT_MASK 0x1 FORMAT "%13.11" ECU_ADDRESS 0x6000FAB7 /end MEASUREMENT
/begin MEASUREMENT B_easch_msg "GDI injection mode stratified (B_sch, B_hos, B_skh)" UBYTE B_TRUE 1 100 0.00 1.00000000000 BIT_MASK 0x1 FORMAT "%13.11" ECU_ADDRESS 0x6000FAB8 /end MEASUREMENT
/begin MEASUREMENT B_hksab_msg "homogeneous-knocking protection mode permitted by exit function" UBYTE B_TRUE 1 100 0.00 1.00000000000 BIT_MASK 0x1 FORMAT "%13.11" ECU_ADDRESS 0x6000FAA9 /end MEASUREMENT
/begin MEASUREMENT B_hksagrs_msg "GDI-desired mode homogeneous-knocking protection for EGR" UBYTE B_TRUE 1 100 0.00 1.00000000000 BIT_MASK 0x1 FORMAT "%13.11" ECU_ADDRESS 0x6000FAA8 /end MEASUREMENT
/begin MEASUREMENT B_hksen_msg "condition: homogeneous knocking prevention mode possible" UBYTE B_TRUE 1 100 0.00 1.00000000000 BIT_MASK 0x1 FORMAT "%13.11" ECU_ADDRESS 0x6000FAA7 /end MEASUREMENT
/begin MEASUREMENT B_hksfes_msg "GDI desired mode homogeneous-knocking protection for air mass control" UBYTE B_TRUE 1 100 0.00 1.00000000000 BIT_MASK 0x1 FORMAT "%13.11" ECU_ADDRESS 0x6000FAA6 /end MEASUREMENT
/begin MEASUREMENT B_hkss_msg "GDI desired mode homogeneous knocking prevention." UBYTE B_TRUE 1 100 0.00 1.00000000000 BIT_MASK 0x1 FORMAT "%13.11" ECU_ADDRESS 0x6000FAA5 /end MEASUREMENT
/begin MEASUREMENT B_hksz_msg "GDI target mode homogeneous knocking prevention" UBYTE B_TRUE 1 100 0.00 1.00000000000 BIT_MASK 0x1 FORMAT "%13.11" ECU_ADDRESS 0x6000FAA4 /end MEASUREMENT
/begin MEASUREMENT B_hmmagrs_msg "GDI-desired mode homogeneous lean for EGR" UBYTE B_TRUE 1 100 0.00 1.00000000000 BIT_MASK 0x1 FORMAT "%13.11" ECU_ADDRESS 0x6000FAA3 /end MEASUREMENT
/begin MEASUREMENT B_hmmen_msg "condition: homogeneous lean mode possible" UBYTE B_TRUE 1 100 0.00 1.00000000000 BIT_MASK 0x1 FORMAT "%13.11" ECU_ADDRESS 0x6000FAA2 /end MEASUREMENT
/begin MEASUREMENT B_hmmfes_msg "GDI desired mode homogeneous lean for air mass control" UBYTE B_TRUE 1 100 0.00 1.00000000000 BIT_MASK 0x1 FORMAT "%13.11" ECU_ADDRESS 0x6000FAA1 /end MEASUREMENT
/begin MEASUREMENT B_hmms_msg "GDI desired mode homogeneous lean" UBYTE B_TRUE 1 100 0.00 1.00000000000 BIT_MASK 0x1 FORMAT "%13.11" ECU_ADDRESS 0x6000FAA0 /end MEASUREMENT
/begin MEASUREMENT B_hmmz_msg "GDI target mode homogeneous lean" UBYTE B_TRUE 1 100 0.00 1.00000000000 BIT_MASK 0x1 FORMAT "%13.11" ECU_ADDRESS 0x6000FA9F /end MEASUREMENT
/begin MEASUREMENT B_homagrs_msg "GDI-desired mode homogeneous for EGR." UBYTE B_TRUE 1 100 0.00 1.00000000000 BIT_MASK 0x1 FORMAT "%13.11" ECU_ADDRESS 0x6000FA9E /end MEASUREMENT
/begin MEASUREMENT B_homen_msg "condition: homogeneous mode possible" UBYTE B_TRUE 1 100 0.00 1.00000000000 BIT_MASK 0x1 FORMAT "%13.11" ECU_ADDRESS 0x6000FA9D /end MEASUREMENT
/begin MEASUREMENT B_homfes_msg "GDI desired mode homogeneous for air mass control" UBYTE B_TRUE 1 100 0.00 1.00000000000 BIT_MASK 0x1 FORMAT "%13.11" ECU_ADDRESS 0x6000FA9C /end MEASUREMENT
/begin MEASUREMENT B_homs_msg "GDI desired mode homogeneous" UBYTE B_TRUE 1 100 0.00 1.00000000000 BIT_MASK 0x1 FORMAT "%13.11" ECU_ADDRESS 0x6000FA9B /end MEASUREMENT
/begin MEASUREMENT B_homz_msg "GDI target mode homogeneous" UBYTE B_TRUE 1 100 0.00 1.00000000000 BIT_MASK 0x1 FORMAT "%13.11" ECU_ADDRESS 0x6000FA9A /end MEASUREMENT
/begin MEASUREMENT B_hosagrs_msg "GDI-desired mode homogeneous-stratified for EGR" UBYTE B_TRUE 1 100 0.00 1.00000000000 BIT_MASK 0x1 FORMAT "%13.11" ECU_ADDRESS 0x6000FA98 /end MEASUREMENT
/begin MEASUREMENT B_hosen_msg "condition: semi-stratified mode possible" UBYTE B_TRUE 1 100 0.00 1.00000000000 BIT_MASK 0x1 FORMAT "%13.11" ECU_ADDRESS 0x6000FA97 /end MEASUREMENT
/begin MEASUREMENT B_hosfes_msg "GDI desired mode homogeneous/stratified for air mass control" UBYTE B_TRUE 1 100 0.00 1.00000000000 BIT_MASK 0x1 FORMAT "%13.11" ECU_ADDRESS 0x6000FA96 /end MEASUREMENT
/begin MEASUREMENT B_hoss_msg "GDI desired mode homogeneous/stratified (double injection)" UBYTE B_TRUE 1 100 0.00 1.00000000000 BIT_MASK 0x1 FORMAT "%13.11" ECU_ADDRESS 0x6000FA95 /end MEASUREMENT
/begin MEASUREMENT B_hosz_msg "GDI target mode homogeneousstratified (double injection)" UBYTE B_TRUE 1 100 0.00 1.00000000000 BIT_MASK 0x1 FORMAT "%13.11" ECU_ADDRESS 0x6000FA94 /end MEASUREMENT
/begin MEASUREMENT B_hos_msg "GDI mode homogeneous/stratified (double injection)" UBYTE B_TRUE 1 100 0.00 1.00000000000 BIT_MASK 0x1 FORMAT "%13.11" ECU_ADDRESS 0x6000FA99 /end MEASUREMENT
/begin MEASUREMENT B_hsgm_msg "condition operation mode HOS throttled possible" UBYTE B_TRUE 1 100 0.00 1.00000000000 BIT_MASK 0x1 FORMAT "%13.11" ECU_ADDRESS 0x6000FA93 /end MEASUREMENT
/begin MEASUREMENT B_hspagrs_msg "Condition homogeneous split as target operating mode for EGR" UBYTE B_TRUE 1 100 0.00 1.00000000000 BIT_MASK 0x1 FORMAT "%13.11" ECU_ADDRESS 0x6000FA92 /end MEASUREMENT
/begin MEASUREMENT B_hspen_msg "Homogeneous-split EOM possible." UBYTE B_TRUE 1 100 0.00 1.00000000000 BIT_MASK 0x1 FORMAT "%13.11" ECU_ADDRESS 0x6000FA91 /end MEASUREMENT
/begin MEASUREMENT B_hspfes_msg "GDI desired mode homogeneous-split for air mass control" UBYTE B_TRUE 1 100 0.00 1.00000000000 BIT_MASK 0x1 FORMAT "%13.11" ECU_ADDRESS 0x6000FA90 /end MEASUREMENT
/begin MEASUREMENT B_hspnwss_msg "Condition: homogeneous split as target operating mode for camshaft control" UBYTE B_TRUE 1 100 0.00 1.00000000000 BIT_MASK 0x1 FORMAT "%13.11" ECU_ADDRESS 0x70000BA6 /end MEASUREMENT
/begin MEASUREMENT B_hsps_msg "Short-term target operating mode homogeneous split." UBYTE B_TRUE 1 100 0.00 1.00000000000 BIT_MASK 0x1 FORMAT "%13.11" ECU_ADDRESS 0x6000FA8F /end MEASUREMENT
/begin MEASUREMENT B_hspz_msg "Condition long-term target operating mode homogeneous split" UBYTE B_TRUE 1 100 0.00 1.00000000000 BIT_MASK 0x1 FORMAT "%13.11" ECU_ADDRESS 0x6000FA8E /end MEASUREMENT
/begin MEASUREMENT B_mwab_msg "GDI-mode change: exit current operation mode" UBYTE B_TRUE 1 100 0.00 1.00000000000 BIT_MASK 0x1 FORMAT "%13.11" ECU_ADDRESS 0x6000FA85 /end MEASUREMENT
/begin MEASUREMENT B_mwagrs_msg "GDI mode change egr control (trigger)" UBYTE B_TRUE 1 100 0.00 1.00000000000 BIT_MASK 0x1 FORMAT "%13.11" ECU_ADDRESS 0x6000FA84 /end MEASUREMENT
/begin MEASUREMENT B_mwnwss_msg "Trigger of a mode change of the camshaft control." UBYTE B_TRUE 1 100 0.00 1.00000000000 BIT_MASK 0x1 FORMAT "%13.11" ECU_ADDRESS 0x6000FA83 /end MEASUREMENT
/begin MEASUREMENT B_mwuss_msg "GDI mode change switchover (trigger)" UBYTE B_TRUE 1 100 0.00 1.00000000000 BIT_MASK 0x1 FORMAT "%13.11" ECU_ADDRESS 0x6000FA81 /end MEASUREMENT
/begin MEASUREMENT B_nobdem_msg "Switch GDI mode switching at high engine speed." UBYTE B_TRUE 1 100 0.00 1.00000000000 BIT_MASK 0x1 FORMAT "%13.11" ECU_ADDRESS 0x6000FA7E /end MEASUREMENT
/begin MEASUREMENT B_scgm_msg "condition operation mode SCH throttled possible" UBYTE B_TRUE 1 100 0.00 1.00000000000 BIT_MASK 0x1 FORMAT "%13.11" ECU_ADDRESS 0x6000FA72 /end MEASUREMENT
/begin MEASUREMENT B_schagrs_msg "GDI-desired mode stratified for EGR" UBYTE B_TRUE 1 100 0.00 1.00000000000 BIT_MASK 0x1 FORMAT "%13.11" ECU_ADDRESS 0x6000FA71 /end MEASUREMENT
/begin MEASUREMENT B_schen_msg "condition: stratified mode possible" UBYTE B_TRUE 1 100 0.00 1.00000000000 BIT_MASK 0x1 FORMAT "%13.11" ECU_ADDRESS 0x6000FA70 /end MEASUREMENT
/begin MEASUREMENT B_schfes_msg "GDI desired mode stratified for air mass control" UBYTE B_TRUE 1 100 0.00 1.00000000000 BIT_MASK 0x1 FORMAT "%13.11" ECU_ADDRESS 0x6000FA6F /end MEASUREMENT
/begin MEASUREMENT B_schs_msg "GDI desired mode stratified" UBYTE B_TRUE 1 100 0.00 1.00000000000 BIT_MASK 0x1 FORMAT "%13.11" ECU_ADDRESS 0x6000FA6E /end MEASUREMENT
/begin MEASUREMENT B_schz_msg "GDI target mode stratified" UBYTE B_TRUE 1 100 0.00 1.00000000000 BIT_MASK 0x1 FORMAT "%13.11" ECU_ADDRESS 0x6000FA6D /end MEASUREMENT
/begin MEASUREMENT B_skhagrs_msg "GDI-desired mode stratified-catalyst heating for EGR" UBYTE B_TRUE 1 100 0.00 1.00000000000 BIT_MASK 0x1 FORMAT "%13.11" ECU_ADDRESS 0x6000FA6C /end MEASUREMENT
/begin MEASUREMENT B_skhfes_msg "GDI desired mode stratified/catalyst heating for air mass control" UBYTE B_TRUE 1 100 0.00 1.00000000000 BIT_MASK 0x1 FORMAT "%13.11" ECU_ADDRESS 0x6000FA6B /end MEASUREMENT
/begin MEASUREMENT B_skhs "GDI desired mode stratified/catalyst heating (double injection)" UBYTE B_TRUE 1 100 0.00 1.00000000000 BIT_MASK 0x1 FORMAT "%13.11" ECU_ADDRESS 0x6000F0B8 /end MEASUREMENT
/begin MEASUREMENT B_skhs_msg "GDI desired mode stratified/catalyst heating (double injection)" UBYTE B_TRUE 1 100 0.00 1.00000000000 BIT_MASK 0x1 FORMAT "%13.11" ECU_ADDRESS 0x6000FA6A /end MEASUREMENT
/begin MEASUREMENT B_skhz_msg "GDI target mode stratified catalyst heating" UBYTE B_TRUE 1 100 0.00 1.00000000000 BIT_MASK 0x1 FORMAT "%13.11" ECU_ADDRESS 0x6000FA69 /end MEASUREMENT
/begin MEASUREMENT B_ubaov_msg "Change of operating mode without delay." UBYTE B_TRUE 1 100 0.00 1.00000000000 BIT_MASK 0x1 FORMAT "%13.11" ECU_ADDRESS 0x6000FA5E /end MEASUREMENT
/begin MEASUREMENT B_umhomsch_msg "2-stage switching from HOM to SCH" UBYTE B_TRUE 1 100 0.00 1.00000000000 BIT_MASK 0x1 FORMAT "%13.11" ECU_ADDRESS 0x6000FA5D /end MEASUREMENT
/begin MEASUREMENT B_umschhom_msg "2-stage switching from SCH to HOM" UBYTE B_TRUE 1 100 0.00 1.00000000000 BIT_MASK 0x1 FORMAT "%13.11" ECU_ADDRESS 0x6000FA5C /end MEASUREMENT
/begin MEASUREMENT B_vhegfes_msg "Condition valve lift variation for charge control" UBYTE B_TRUE 1 100 0.00 1.00000000000 BIT_MASK 0x1 FORMAT "%13.11" ECU_ADDRESS 0x6000FA59 /end MEASUREMENT
/begin MEASUREMENT B_vhegs_msg "desired mode on high valve lift" UBYTE B_TRUE 1 100 0.00 1.00000000000 BIT_MASK 0x1 FORMAT "%13.11" ECU_ADDRESS 0x6000FA57 /end MEASUREMENT
/begin MEASUREMENT B_vhegtes_msg "Condition valve lift variation switching canister purge (trigger)." UBYTE B_TRUE 1 100 0.00 1.00000000000 BIT_MASK 0x1 FORMAT "%13.11" ECU_ADDRESS 0x6000FA56 /end MEASUREMENT
/begin MEASUREMENT B_vhegvse_msg "Request desired positions for phase shift intake camshaft for big or small cam profile" UBYTE B_TRUE 1 100 0.00 1.00000000000 BIT_MASK 0x1 FORMAT "%13.11" ECU_ADDRESS 0x6000FA55 /end MEASUREMENT
/begin MEASUREMENT B_vhegvss_msg "Condition valve lift variation switching camshaft control (trigger)" UBYTE B_TRUE 1 100 0.00 1.00000000000 BIT_MASK 0x1 FORMAT "%13.11" ECU_ADDRESS 0x6000FA54 /end MEASUREMENT
/begin MEASUREMENT B_vheg_msg "Condition high valve lift active" UBYTE B_TRUE 1 100 0.00 1.00000000000 BIT_MASK 0x1 FORMAT "%13.11" ECU_ADDRESS 0x6000FA5A /end MEASUREMENT
/begin MEASUREMENT B_vheinst_msg "Condition instationary state during valve lift variation." UBYTE B_TRUE 1 100 0.00 1.00000000000 BIT_MASK 0x1 FORMAT "%13.11" ECU_ADDRESS 0x6000FA53 /end MEASUREMENT
/begin MEASUREMENT B_vhenwsspe_msg "Request shifting to retarded mechanical stop position intake camshaft at cam profile switching" UBYTE B_TRUE 1 100 0.00 1.00000000000 BIT_MASK 0x1 FORMAT "%13.11" ECU_ADDRESS 0x6000FA51 /end MEASUREMENT
/begin MEASUREMENT B_vherlsts_msg "Condition valve lift switching stationary charge (trigger)." UBYTE B_TRUE 1 100 0.00 1.00000000000 BIT_MASK 0x1 FORMAT "%13.11" ECU_ADDRESS 0x6000FA4F /end MEASUREMENT
/begin MEASUREMENT B_zwschfes_msg "GDI desired mode stratified for air mass control" UBYTE B_TRUE 1 100 0.00 1.00000000000 BIT_MASK 0x1 FORMAT "%13.11" ECU_ADDRESS 0x6000FA4B /end MEASUREMENT
/begin MEASUREMENT B_zwschs_msg "condition desired GDI operating mode with ignition angle for stratified mode" UBYTE B_TRUE 1 100 0.00 1.00000000000 BIT_MASK 0x1 FORMAT "%13.11" ECU_ADDRESS 0x6000FA4A /end MEASUREMENT
/begin MEASUREMENT CoEng_dnEngFltLoc "Measurement point for filtered engine speed gradient in CoEng_VlvLftSpIntk" SWORD EngN 1 100 -16384.00 16383.50 FORMAT "%8.2" ECU_ADDRESS 0x60007F36 /end MEASUREMENT
/begin MEASUREMENT CoEng_EomCvlciAllwd1_I.stOperMod "CoEom inhibit interface 1 for intake valve lift / Priority-element of the operation mode structure" ULONG OneToOne 1 100 0.00 4294967295.00 FORMAT "%13.2" ECU_ADDRESS 0x600002D8 /end MEASUREMENT
/begin MEASUREMENT CoEng_EomCvlciAllwd1_I.stOperModPrio "CoEom inhibit interface 1 for intake valve lift / Stage-element of the operation mode structure" UBYTE OneToOne 1 100 0.00 255.0 FORMAT "%5.1" ECU_ADDRESS 0x600002DC /end MEASUREMENT
/begin MEASUREMENT CoEng_EomCvlciAllwd1_I.stOperModStg "CoEom inhibit interface 1 for intake valve lift / Operation-mode element of the operation mode structure" UWORD OneToOne 1 100 0.00 65535.00 FORMAT "%8.2" ECU_ADDRESS 0x600002DE /end MEASUREMENT
/begin MEASUREMENT CoEng_EomCvlciAllwd2_I.stOperMod "CoEom inhibit interface 2 for intake valve lift / Priority-element of the operation mode structure" ULONG OneToOne 1 100 0.00 4294967295.00 FORMAT "%13.2" ECU_ADDRESS 0x600002E0 /end MEASUREMENT
/begin MEASUREMENT CoEng_EomCvlciAllwd2_I.stOperModPrio "CoEom inhibit interface 2 for intake valve lift / Stage-element of the operation mode structure" UBYTE OneToOne 1 100 0.00 255.0 FORMAT "%5.1" ECU_ADDRESS 0x600002E4 /end MEASUREMENT
/begin MEASUREMENT CoEng_EomCvlciAllwd2_I.stOperModStg "CoEom inhibit interface 2 for intake valve lift / Operation-mode element of the operation mode structure" UWORD OneToOne 1 100 0.00 65535.00 FORMAT "%8.2" ECU_ADDRESS 0x600002E6 /end MEASUREMENT
/begin MEASUREMENT CoEng_EomCvlciDmd_I.stOperMod "CoEom interface for intake valve lift demand / Priority-element of the operation mode structure" ULONG OneToOne 1 100 0.00 4294967295.00 FORMAT "%13.2" ECU_ADDRESS 0x600002E8 /end MEASUREMENT
/begin MEASUREMENT CoEng_EomCvlciDmd_I.stOperModPrio "CoEom interface for intake valve lift demand / Stage-element of the operation mode structure" UBYTE OneToOne 1 100 0.00 255.0 FORMAT "%5.1" ECU_ADDRESS 0x600002EC /end MEASUREMENT
/begin MEASUREMENT CoEng_EomCvlciDmd_I.stOperModStg "CoEom interface for intake valve lift demand / Operation-mode element of the operation mode structure" UWORD OneToOne 1 100 0.00 65535.00 FORMAT "%8.2" ECU_ADDRESS 0x600002EE /end MEASUREMENT
/begin MEASUREMENT CoEng_facTq2Perc "Identically with ftrq2mi_w." UWORD fak_q2p384Em4_pc_DIV_Nm 1 100 0.00 15.62476 FORMAT "%8.5" ECU_ADDRESS 0x6000058C /end MEASUREMENT
/begin MEASUREMENT CoEng_fakCorrnAltiCvlciXVal "X value for CoEng_fakCorrnAltiCvlci_T" UWORD fak_uw_b2 1 100 0.00 1.999969 FORMAT "%8.6" ECU_ADDRESS 0x60007F34 /end MEASUREMENT
/begin MEASUREMENT CoEng_flgDesEomDsm "Flag: desired engine mode of operation is determined by Diagnostic System Management." UBYTE B_TRUE 1 100 0.00 1.00000000000 BIT_MASK 0x1 FORMAT "%13.11" ECU_ADDRESS 0x6000FA15 /end MEASUREMENT
/begin MEASUREMENT CoEng_flgDesEomLimp "Flag: desired engine mode of operation is determined by limp home function." UBYTE B_TRUE 1 100 0.00 1.00000000000 BIT_MASK 0x1 FORMAT "%13.11" ECU_ADDRESS 0x6000FA14 /end MEASUREMENT
/begin MEASUREMENT CoEng_flgDesEomNsc "Flag: desired engine mode of operation is determined by NOx storage catalyst function." UBYTE B_TRUE 1 100 0.00 1.00000000000 BIT_MASK 0x1 FORMAT "%13.11" ECU_ADDRESS 0x6000FA13 /end MEASUREMENT
/begin MEASUREMENT CoEng_flgEngTempHi "Measurement point: high engine temperature" UBYTE B_TRUE 1 100 0.00 1.00000000000 BIT_MASK 0x1 FORMAT "%13.11" ECU_ADDRESS 0x6000F0DE /end MEASUREMENT
/begin MEASUREMENT CoEng_flgErrCvlci "Valve lift for error case active" UBYTE B_TRUE 1 100 0.00 1.00000000000 BIT_MASK 0x1 FORMAT "%13.11" ECU_ADDRESS 0x6000F0DD /end MEASUREMENT
/begin MEASUREMENT CoEng_flgFrzSpVlvLftIntk "Condition for freezing the last valve lift setpoint" UBYTE B_TRUE 1 100 0.00 1.00000000000 BIT_MASK 0x1 FORMAT "%13.11" ECU_ADDRESS 0x6000F0DC /end MEASUREMENT
/begin MEASUREMENT CoEng_flgGearLoCvlci "Measurement point: low gear is used" UBYTE B_TRUE 1 100 0.00 1.00000000000 BIT_MASK 0x1 FORMAT "%13.11" ECU_ADDRESS 0x6000F0DB /end MEASUREMENT
/begin MEASUREMENT CoEng_flgGevCtlDisadCvlci "Disabled valve lift shift by GevCtl" UBYTE B_TRUE 1 100 0.00 1.00000000000 BIT_MASK 0x1 FORMAT "%13.11" ECU_ADDRESS 0x6000F0DA /end MEASUREMENT
/begin MEASUREMENT CoEng_flgIntkAirTempHiCvlci "Measurement point: intake air temperature high" UBYTE B_TRUE 1 100 0.00 1.00000000000 BIT_MASK 0x1 FORMAT "%13.11" ECU_ADDRESS 0x6000F0D9 /end MEASUREMENT
/begin MEASUREMENT CoEng_flgLimpCvlci "Measurement point: Limp home mode active" UBYTE B_TRUE 1 100 0.00 1.00000000000 BIT_MASK 0x1 FORMAT "%13.11" ECU_ADDRESS 0x6000F0D8 /end MEASUREMENT
/begin MEASUREMENT CoEng_flgManVlvLftDmdCvlci "Manual valve lift demand active" UBYTE B_TRUE 1 100 0.00 1.00000000000 BIT_MASK 0x1 FORMAT "%13.11" ECU_ADDRESS 0x6000F0D7 /end MEASUREMENT
/begin MEASUREMENT CoEng_flgNEngHiCvlci "Valve lift for high engine speed acitive" UBYTE B_TRUE 1 100 0.00 1.00000000000 BIT_MASK 0x1 FORMAT "%13.11" ECU_ADDRESS 0x6000F0D6 /end MEASUREMENT
/begin MEASUREMENT CoEng_flgThrVlvPotiDfctCvlci "Measurement point for defect throttle valve poti" UBYTE B_TRUE 1 100 0.00 1.00000000000 BIT_MASK 0x1 FORMAT "%13.11" ECU_ADDRESS 0x6000F0D5 /end MEASUREMENT
/begin MEASUREMENT CoEng_flgTrqDemCvlci "Measurement point: torque intervention active" UBYTE B_TRUE 1 100 0.00 1.00000000000 BIT_MASK 0x1 FORMAT "%13.11" ECU_ADDRESS 0x6000F0D4 /end MEASUREMENT
/begin MEASUREMENT CoEng_flgVehVMinCvlciHLD_I.hysterese "Hysteresis for use-case: Low vehicle speed / Current value of the hysteresis" UBYTE B_TRUE 1 100 0.00 1.00000000000 BIT_MASK 0x1 FORMAT "%13.11" ECU_ADDRESS 0x6000F0C9 /end MEASUREMENT
/begin MEASUREMENT CoEng_idxCaseActvCvlci "Index of the array CoEng_stCaseCvlci_CA with the currently activated use case on intake side" UBYTE OneToOne 1 100 0.00 255.0 FORMAT "%5.1" ECU_ADDRESS 0x6000F0D3 /end MEASUREMENT
/begin MEASUREMENT CoEng_nEngCorrdCvlci "Measurement point for corrected engine speed signal" SWORD EngN 1 100 -16384.00 16383.50 FORMAT "%8.2" ECU_ADDRESS 0x60007F32 /end MEASUREMENT
/begin MEASUREMENT CoEng_nEngDelta "Predicted delta of the engine speed during a valve lift shift" SWORD EngN 1 100 -16384.00 16383.50 FORMAT "%8.2" ECU_ADDRESS 0x60007F30 /end MEASUREMENT
/begin MEASUREMENT CoEng_nEngOffsCvlci "Measurement point for engine speed offset" SWORD EngN 1 100 0.00 16383.50 FORMAT "%8.2" ECU_ADDRESS 0x60007F2E /end MEASUREMENT
/begin MEASUREMENT CoEng_nEngShiftLimCvlci "Measurement point for maximum engine speed to switch valve lift" SWORD EngN 1 100 -16384.00 16383.50 FORMAT "%8.2" ECU_ADDRESS 0x60007F2C /end MEASUREMENT
/begin MEASUREMENT CoEng_ratEngLoad "Basis for the engine map (selectable)" SWORD Prc 1 100 0.00 399.9878 FORMAT "%8.4" ECU_ADDRESS 0x60007F2A /end MEASUREMENT
/begin MEASUREMENT CoEng_ratEngLoadCorrdCvlci "Measurement point for correted engine load signal" SWORD Prc 1 100 0.00 399.9878 FORMAT "%8.4" ECU_ADDRESS 0x60007F28 /end MEASUREMENT
/begin MEASUREMENT CoEng_stCaseCvlci "Current use cases for valve lift strategy on intake side" UBYTE CoEng_CaseCvlci_COMPU_VERB 1 100 1.000000000 255.000000000 FORMAT "%13.9" ECU_ADDRESS 0x6000F0D2 /end MEASUREMENT
/begin MEASUREMENT CoEng_stExtVlvLftDmdCvlci "Current intake valve lift on external demand" UBYTE OneToOne 1 100 0.00 255.0 FORMAT "%5.1" ECU_ADDRESS 0x6000F0D1 /end MEASUREMENT
/begin MEASUREMENT CoEng_stMpgLimpVlvLftDmdXVal "X values for table CoEng_stMpgLimpVlvLftDmd_T" UWORD OneToOne 1 100 0.00 65535.00 FORMAT "%8.2" ECU_ADDRESS 0x60007F26 /end MEASUREMENT
/begin MEASUREMENT CoEng_stMpgStdLftHwIntkXVal "X values for table CoEng_stMpgStdLftHwIntk_T" UBYTE OneToOne 1 100 0.00 255.0 FORMAT "%5.1" ECU_ADDRESS 0x6000F0D0 /end MEASUREMENT
/begin MEASUREMENT CoEng_stShftDlyCvlci "Current shift delay strategy on intake side" UBYTE CoEng_ShiftDlyCvlci_COMPU_VERB 1 100 0.00 1.00000000000 FORMAT "%13.11" ECU_ADDRESS 0x6000F0CF /end MEASUREMENT
/begin MEASUREMENT CoEng_stSpVlvLftIntk "Setpoint for status of lift position for inlet valve lift" UBYTE OneToOne 1 100 0.00 255.0 FORMAT "%5.1" ECU_ADDRESS 0x6000FF83 /end MEASUREMENT
/begin MEASUREMENT CoEng_stSpVlvLftIntkBefRels "Setpoint valve lift intake before release" UBYTE OneToOne 1 100 0.00 255.0 FORMAT "%5.1" ECU_ADDRESS 0x6000F0CE /end MEASUREMENT
/begin MEASUREMENT CoEng_stSpVlvLftIntkBefTstr "Setpoint valve lift intake before tester intervention" UBYTE OneToOne 1 100 0.00 255.0 FORMAT "%5.1" ECU_ADDRESS 0x6000F0CD /end MEASUREMENT
/begin MEASUREMENT CoEng_stSpVlvLftIntkLoc "Setpoint for status of lift position for inlet valve lift (local variable)" UBYTE OneToOne 1 100 0.00 255.0 FORMAT "%5.1" ECU_ADDRESS 0x6000F0CC /end MEASUREMENT
/begin MEASUREMENT CoEng_stVlvLftDmdApplCvlci "Manual valve lift demand" UBYTE CoEng_VlvLftStgyFixCvlci_COMPU_VERB 1 100 0.00 255.000000000 FORMAT "%13.9" ECU_ADDRESS 0x6000F0CB /end MEASUREMENT
/begin MEASUREMENT CoEng_stVlvLftStgyActvCvlci "Current valve lift strategy on intake side" UBYTE CoEng_VlvLftStgyCvlci_COMPU_VERB 1 100 0.00 255.000000000 FORMAT "%13.9" ECU_ADDRESS 0x6000F0CA /end MEASUREMENT
/begin MEASUREMENT CoEng_tExhFldVlvLftIntk "Exhaust temperature from temperature field" SWORD Temp_Cels 1 100 -3549.940 3003.560 FORMAT "%8.3" ECU_ADDRESS 0x60007F24 /end MEASUREMENT
/begin MEASUREMENT CoEng_tiShiftCvlci "Predicted time for one valve lift shift" SWORD Time_s 1 100 -327.6800 327.6700 FORMAT "%8.4" ECU_ADDRESS 0x60007F22 /end MEASUREMENT
/begin MEASUREMENT CoEng_tiVlvLftSpApplTog "Time counter for periodical switch-over via application interface (VHE)" SWORD Time_s 1 100 -0.0100 327.6700 FORMAT "%8.4" ECU_ADDRESS 0x60007F20 /end MEASUREMENT
/begin MEASUREMENT CoEOM_bHLN "Condition GDI mode homogeneous lean" UBYTE B_TRUE 1 100 0.00 1.00000000000 BIT_MASK 0x1 FORMAT "%13.11" ECU_ADDRESS 0x6000FA27 /end MEASUREMENT
/begin MEASUREMENT CoEOM_bHOM "Homogeneous operating mode of gasoline direct injection" UBYTE B_TRUE 1 100 0.00 1.00000000000 BIT_MASK 0x1 FORMAT "%13.11" ECU_ADDRESS 0x6000FA26 /end MEASUREMENT
/begin MEASUREMENT CoEOM_bIASTF "Condition ignition angle for stratified operating mode active" UBYTE B_TRUE 1 100 0.00 1.00000000000 BIT_MASK 0x1 FORMAT "%13.11" ECU_ADDRESS 0x6000FA25 /end MEASUREMENT
/begin MEASUREMENT CoEOM_bSPC "Condition GDI operation mode stratified post injection for catalyst heating (SPC)" UBYTE B_TRUE 1 100 0.00 1.00000000000 BIT_MASK 0x1 FORMAT "%13.11" ECU_ADDRESS 0x6000FA24 /end MEASUREMENT
/begin MEASUREMENT CoEOM_bTransActv "Status if an operation mode change is active" UBYTE B_TRUE 1 100 0.00 1.00000000000 BIT_MASK 0x1 FORMAT "%13.11" ECU_ADDRESS 0x6000FA23 /end MEASUREMENT
/begin MEASUREMENT CoEOM_ctCylAdv "Cylinder counter for updating coeom array" UBYTE OneToOne 1 100 0.00 255.0 FORMAT "%5.1" ECU_ADDRESS 0x5000094C /end MEASUREMENT
/begin MEASUREMENT CoEOM_ctCylAdvTmng "Calculated cylinder index for CoEOM_flgTmngFinshed (local variable, do not use as import)" UBYTE OneToOne 1 100 0.00 255.0 FORMAT "%5.1" ECU_ADDRESS 0x5000094D /end MEASUREMENT
/begin MEASUREMENT CoEOM_EomBas1Hys_I.idxDistbnXOld "hysteresis to select the first unique engine operating mode request / Old X-Axis-position-index of the Two-D Hystereses-Look-Up-Table (Uint16)" UBYTE OneToOne 1 100 0.00 255.0 FORMAT "%5.1" ECU_ADDRESS 0x6000056E /end MEASUREMENT
/begin MEASUREMENT CoEOM_EomBas1Hys_I.idxDistbnYOld "hysteresis to select the first unique engine operating mode request / Old Y-Axis-position-index of the Two-D Hystereses-Look-Up-Table (Uint16)" UBYTE OneToOne 1 100 0.00 255.0 FORMAT "%5.1" ECU_ADDRESS 0x6000056F /end MEASUREMENT
/begin MEASUREMENT CoEOM_EomBas2Hys_I.idxDistbnXOld "hysteresis to select the second unique engine operating mode request / Old X-Axis-position-index of the Two-D Hystereses-Look-Up-Table (Uint16)" UBYTE OneToOne 1 100 0.00 255.0 FORMAT "%5.1" ECU_ADDRESS 0x60000570 /end MEASUREMENT
/begin MEASUREMENT CoEOM_EomBas2Hys_I.idxDistbnYOld "hysteresis to select the second unique engine operating mode request / Old Y-Axis-position-index of the Two-D Hystereses-Look-Up-Table (Uint16)" UBYTE OneToOne 1 100 0.00 255.0 FORMAT "%5.1" ECU_ADDRESS 0x60000571 /end MEASUREMENT
/begin MEASUREMENT CoEOM_EomBasAllwdHys_I.idxDistbnXOld "EOM characteristic field with all allowed modes of operation / Old X-Axis-position-index of the Two-D Hystereses-Look-Up-Table (Uint16)" UBYTE OneToOne 1 100 0.00 255.0 FORMAT "%5.1" ECU_ADDRESS 0x60000572 /end MEASUREMENT
/begin MEASUREMENT CoEOM_EomBasAllwdHys_I.idxDistbnYOld "EOM characteristic field with all allowed modes of operation / Old Y-Axis-position-index of the Two-D Hystereses-Look-Up-Table (Uint16)" UBYTE OneToOne 1 100 0.00 255.0 FORMAT "%5.1" ECU_ADDRESS 0x60000573 /end MEASUREMENT
/begin MEASUREMENT CoEOM_EomBasis1_I.stOperMod "class to send the result of the first unique engine operating mode request to CoEOM_Co / Priority-element of the operation mode structure" ULONG OneToOne 1 100 0.00 4294967295.00 FORMAT "%13.2" ECU_ADDRESS 0x500001CC /end MEASUREMENT
/begin MEASUREMENT CoEOM_EomBasis1_I.stOperModPrio "class to send the result of the first unique engine operating mode request to CoEOM_Co / Stage-element of the operation mode structure" UBYTE OneToOne 1 100 0.00 255.0 FORMAT "%5.1" ECU_ADDRESS 0x500001D0 /end MEASUREMENT
/begin MEASUREMENT CoEOM_EomBasis1_I.stOperModStg "class to send the result of the first unique engine operating mode request to CoEOM_Co / Operation-mode element of the operation mode structure" UWORD OneToOne 1 100 0.00 65535.00 FORMAT "%8.2" ECU_ADDRESS 0x500001D2 /end MEASUREMENT
/begin MEASUREMENT CoEOM_EomBasis2_I.stOperMod "class to send the result of the second unique engine operating mode request to CoEOM_Co / Priority-element of the operation mode structure" ULONG OneToOne 1 100 0.00 4294967295.00 FORMAT "%13.2" ECU_ADDRESS 0x700030F0 /end MEASUREMENT
/begin MEASUREMENT CoEOM_EomBasis2_I.stOperModPrio "class to send the result of the second unique engine operating mode request to CoEOM_Co / Stage-element of the operation mode structure" UBYTE OneToOne 1 100 0.00 255.0 FORMAT "%5.1" ECU_ADDRESS 0x700030F4 /end MEASUREMENT
/begin MEASUREMENT CoEOM_EomBasis2_I.stOperModStg "class to send the result of the second unique engine operating mode request to CoEOM_Co / Operation-mode element of the operation mode structure" UWORD OneToOne 1 100 0.00 65535.00 FORMAT "%8.2" ECU_ADDRESS 0x700030F6 /end MEASUREMENT
/begin MEASUREMENT CoEOM_EomBasis3_I.stOperMod "class to send the result of the third unique engine operating mode request to CoEOM_Co / Priority-element of the operation mode structure" ULONG OneToOne 1 100 0.00 4294967295.00 FORMAT "%13.2" ECU_ADDRESS 0x700030E8 /end MEASUREMENT
/begin MEASUREMENT CoEOM_EomBasis3_I.stOperModPrio "class to send the result of the third unique engine operating mode request to CoEOM_Co / Stage-element of the operation mode structure" UBYTE OneToOne 1 100 0.00 255.0 FORMAT "%5.1" ECU_ADDRESS 0x700030EC /end MEASUREMENT
/begin MEASUREMENT CoEOM_EomBasis3_I.stOperModStg "class to send the result of the third unique engine operating mode request to CoEOM_Co / Operation-mode element of the operation mode structure" UWORD OneToOne 1 100 0.00 65535.00 FORMAT "%8.2" ECU_ADDRESS 0x700030EE /end MEASUREMENT
/begin MEASUREMENT CoEOM_EomBasisAllwd_I.stOperMod "class to send the result of the allowed engine operating mode to CoEOM_Co / Priority-element of the operation mode structure" ULONG OneToOne 1 100 0.00 4294967295.00 FORMAT "%13.2" ECU_ADDRESS 0x700030E0 /end MEASUREMENT
/begin MEASUREMENT CoEOM_EomBasisAllwd_I.stOperModPrio "class to send the result of the allowed engine operating mode to CoEOM_Co / Stage-element of the operation mode structure" UBYTE OneToOne 1 100 0.00 255.0 FORMAT "%5.1" ECU_ADDRESS 0x700030E4 /end MEASUREMENT
/begin MEASUREMENT CoEOM_EomBasisAllwd_I.stOperModStg "class to send the result of the allowed engine operating mode to CoEOM_Co / Operation-mode element of the operation mode structure" UWORD OneToOne 1 100 0.00 65535.00 FORMAT "%8.2" ECU_ADDRESS 0x700030E6 /end MEASUREMENT
/begin MEASUREMENT CoEOM_EomCatHeatgAdpr_I.stOperMod "Adapter interface for catalyst heating for new CoEOM / Priority-element of the operation mode structure" ULONG OneToOne 1 100 0.00 4294967295.00 FORMAT "%13.2" ECU_ADDRESS 0x70003110 /end MEASUREMENT
/begin MEASUREMENT CoEOM_EomCatHeatgAdpr_I.stOperModPrio "Adapter interface for catalyst heating for new CoEOM / Stage-element of the operation mode structure" UBYTE OneToOne 1 100 0.00 255.0 FORMAT "%5.1" ECU_ADDRESS 0x70003114 /end MEASUREMENT
/begin MEASUREMENT CoEOM_EomCatHeatgAdpr_I.stOperModStg "Adapter interface for catalyst heating for new CoEOM / Operation-mode element of the operation mode structure" UWORD OneToOne 1 100 0.00 65535.00 FORMAT "%8.2" ECU_ADDRESS 0x70003116 /end MEASUREMENT
/begin MEASUREMENT CoEOM_EomDiagMgr_I.stOperMod "Adapter interface for Diagnose manager for new CoEOM / Priority-element of the operation mode structure" ULONG OneToOne 1 100 0.00 4294967295.00 FORMAT "%13.2" ECU_ADDRESS 0x70003108 /end MEASUREMENT
/begin MEASUREMENT CoEOM_EomDiagMgr_I.stOperModPrio "Adapter interface for Diagnose manager for new CoEOM / Stage-element of the operation mode structure" UBYTE OneToOne 1 100 0.00 255.0 FORMAT "%5.1" ECU_ADDRESS 0x7000310C /end MEASUREMENT
/begin MEASUREMENT CoEOM_EomDiagMgr_I.stOperModStg "Adapter interface for Diagnose manager for new CoEOM / Operation-mode element of the operation mode structure" UWORD OneToOne 1 100 0.00 65535.00 FORMAT "%8.2" ECU_ADDRESS 0x7000310E /end MEASUREMENT
/begin MEASUREMENT CoEOM_EomDmdLstSortCSERS_I.idx_a "Sorted list of EOM requestors with deactivated catheating / Index of the Operation-modes-requester in the sorted Operation-modes-requester-list." UBYTE CoEOM_OperMod_Set_COMPU_VERB 1 100 0.00 24.0000000000 FORMAT "%13.10" ARRAY_SIZE 25 ECU_ADDRESS 0x500010EC /end MEASUREMENT
/begin MEASUREMENT CoEOM_EomDmdLstSortCSERS_I.nrPrio_a "Sorted list of EOM requestors with deactivated catheating / Calculated Priority of the Operation-modes-requester in the sorted Operation-modes-requester-list." UWORD OneToOne 1 100 0.00 65535.00 FORMAT "%8.2" ARRAY_SIZE 25 ECU_ADDRESS 0x50001106 /end MEASUREMENT
/begin MEASUREMENT CoEOM_EomDmdLstSortCSERS_I.stEom_a "Sorted list of EOM requestors with deactivated catheating / Requested Operation-mode of the Operation-modes-requester in the sorted Operation-modes-requester-list." ULONG OneToOne 1 100 0.00 4294967295.00 FORMAT "%13.2" ARRAY_SIZE 25 ECU_ADDRESS 0x50001138 /end MEASUREMENT
/begin MEASUREMENT CoEOM_EomDmdLstSortCSERS_I.stStg_a "Sorted list of EOM requestors with deactivated catheating / Requested Stage of the Operation-modes-requester in the sorted Operation-modes-requester-list." UWORD OneToOne 1 100 0.00 65535.00 FORMAT "%8.2" ARRAY_SIZE 25 ECU_ADDRESS 0x5000119C /end MEASUREMENT
/begin MEASUREMENT CoEOM_EomDmdLstSortCSERS_I.typDescr_a "Sorted list of EOM requestors with deactivated catheating / Typ of the request of the Operation-modes-requester in the sorted Operation-modes-requester-list." UBYTE CoEOM_TypDescr_VERB 1 100 0.00 48.0000000000 FORMAT "%13.10" ARRAY_SIZE 25 ECU_ADDRESS 0x500011CE /end MEASUREMENT
/begin MEASUREMENT CoEOM_EomDmdLstSortParDiagPsbl_I.idx_a "Sorted list of operating mode requestors in parallel coordination / Index of the Operation-modes-requester in the sorted Operation-modes-requester-list." UBYTE CoEOM_OperMod_Set_COMPU_VERB 1 100 0.00 24.0000000000 FORMAT "%13.10" ARRAY_SIZE 25 ECU_ADDRESS 0x500011E8 /end MEASUREMENT
/begin MEASUREMENT CoEOM_EomDmdLstSortParDiagPsbl_I.nrPrio_a "Sorted list of operating mode requestors in parallel coordination / Calculated Priority of the Operation-modes-requester in the sorted Operation-modes-requester-list." UWORD OneToOne 1 100 0.00 65535.00 FORMAT "%8.2" ARRAY_SIZE 25 ECU_ADDRESS 0x50001202 /end MEASUREMENT
/begin MEASUREMENT CoEOM_EomDmdLstSortParDiagPsbl_I.stEom_a "Sorted list of operating mode requestors in parallel coordination / Requested Operation-mode of the Operation-modes-requester in the sorted Operation-modes-requester-list." ULONG OneToOne 1 100 0.00 4294967295.00 FORMAT "%13.2" ARRAY_SIZE 25 ECU_ADDRESS 0x50001234 /end MEASUREMENT
/begin MEASUREMENT CoEOM_EomDmdLstSortParDiagPsbl_I.stStg_a "Sorted list of operating mode requestors in parallel coordination / Requested Stage of the Operation-modes-requester in the sorted Operation-modes-requester-list." UWORD OneToOne 1 100 0.00 65535.00 FORMAT "%8.2" ARRAY_SIZE 25 ECU_ADDRESS 0x50001298 /end MEASUREMENT
/begin MEASUREMENT CoEOM_EomDmdLstSortParDiagPsbl_I.typDescr_a "Sorted list of operating mode requestors in parallel coordination / Typ of the request of the Operation-modes-requester in the sorted Operation-modes-requester-list." UBYTE CoEOM_TypDescr_VERB 1 100 0.00 48.0000000000 FORMAT "%13.10" ARRAY_SIZE 25 ECU_ADDRESS 0x500012CA /end MEASUREMENT
/begin MEASUREMENT CoEOM_EomDmdLstSort_I.idx_a "Requester-list sorted by the priority. The requesters are verbal coded. / Index of the Operation-modes-requester in the sorted Operation-modes-requester-list." UBYTE CoEOM_OperMod_Set_COMPU_VERB 1 100 0.00 24.0000000000 FORMAT "%13.10" ARRAY_SIZE 25 ECU_ADDRESS 0x500012E4 /end MEASUREMENT
/begin MEASUREMENT CoEOM_EomDmdLstSort_I.nrPrio_a "Requester-list sorted by the priority. The requesters are verbal coded. / Calculated Priority of the Operation-modes-requester in the sorted Operation-modes-requester-list." UWORD OneToOne 1 100 0.00 65535.00 FORMAT "%8.2" ARRAY_SIZE 25 ECU_ADDRESS 0x500012FE /end MEASUREMENT
/begin MEASUREMENT CoEOM_EomDmdLstSort_I.stEom_a "Requester-list sorted by the priority. The requesters are verbal coded. / Requested Operation-mode of the Operation-modes-requester in the sorted Operation-modes-requester-list." ULONG OneToOne 1 100 0.00 4294967295.00 FORMAT "%13.2" ARRAY_SIZE 25 ECU_ADDRESS 0x50001330 /end MEASUREMENT
/begin MEASUREMENT CoEOM_EomDmdLstSort_I.stStg_a "Requester-list sorted by the priority. The requesters are verbal coded. / Requested Stage of the Operation-modes-requester in the sorted Operation-modes-requester-list." UWORD OneToOne 1 100 0.00 65535.00 FORMAT "%8.2" ARRAY_SIZE 25 ECU_ADDRESS 0x50001394 /end MEASUREMENT
/begin MEASUREMENT CoEOM_EomDmdLstSort_I.typDescr_a "Requester-list sorted by the priority. The requesters are verbal coded. / Typ of the request of the Operation-modes-requester in the sorted Operation-modes-requester-list." UBYTE CoEOM_TypDescr_VERB 1 100 0.00 48.0000000000 FORMAT "%13.10" ARRAY_SIZE 25 ECU_ADDRESS 0x500013C6 /end MEASUREMENT
/begin MEASUREMENT CoEOM_EomLimp_I.stOperMod "Adapter interface for Limp mode for new CoEOM / Priority-element of the operation mode structure" ULONG OneToOne 1 100 0.00 4294967295.00 FORMAT "%13.2" ECU_ADDRESS 0x70003100 /end MEASUREMENT
/begin MEASUREMENT CoEOM_EomLimp_I.stOperModPrio "Adapter interface for Limp mode for new CoEOM / Stage-element of the operation mode structure" UBYTE OneToOne 1 100 0.00 255.0 FORMAT "%5.1" ECU_ADDRESS 0x70003104 /end MEASUREMENT
/begin MEASUREMENT CoEOM_EomLimp_I.stOperModStg "Adapter interface for Limp mode for new CoEOM / Operation-mode element of the operation mode structure" UWORD OneToOne 1 100 0.00 65535.00 FORMAT "%8.2" ECU_ADDRESS 0x70003106 /end MEASUREMENT
/begin MEASUREMENT CoEOM_EomWrmUpAdpr_I.stOperMod "Adapter interface for startmode for new CoEOM / Priority-element of the operation mode structure" ULONG OneToOne 1 100 0.00 4294967295.00 FORMAT "%13.2" ECU_ADDRESS 0x700030F8 /end MEASUREMENT
/begin MEASUREMENT CoEOM_EomWrmUpAdpr_I.stOperModPrio "Adapter interface for startmode for new CoEOM / Stage-element of the operation mode structure" UBYTE OneToOne 1 100 0.00 255.0 FORMAT "%5.1" ECU_ADDRESS 0x700030FC /end MEASUREMENT
/begin MEASUREMENT CoEOM_EomWrmUpAdpr_I.stOperModStg "Adapter interface for startmode for new CoEOM / Operation-mode element of the operation mode structure" UWORD OneToOne 1 100 0.00 65535.00 FORMAT "%8.2" ECU_ADDRESS 0x700030FE /end MEASUREMENT
/begin MEASUREMENT CoEOM_flgCsersActv "CSERS measures are active" UBYTE B_TRUE 1 100 0.00 1.00000000000 BIT_MASK 0x1 FORMAT "%13.11" ECU_ADDRESS 0x6000F0C8 /end MEASUREMENT
/begin MEASUREMENT CoEOM_flgCylAdvCalcd "Cylinder for switching to new EOM selected" UBYTE B_TRUE 1 100 0.00 1.00000000000 BIT_MASK 0x1 FORMAT "%13.11" ECU_ADDRESS 0x700030DE /end MEASUREMENT
/begin MEASUREMENT CoEOM_flgCylAdvCalcdTmng "Cylinder for leaving Timing selected" UBYTE B_TRUE 1 100 0.00 1.00000000000 BIT_MASK 0x1 FORMAT "%13.11" ECU_ADDRESS 0x70003630 /end MEASUREMENT
/begin MEASUREMENT CoEOM_flgDesEomAbort "Flag: desired engine mode of operation is determined by exit function." UBYTE B_TRUE 1 100 0.00 1.00000000000 BIT_MASK 0x1 FORMAT "%13.11" ECU_ADDRESS 0x6000FA22 /end MEASUREMENT
/begin MEASUREMENT CoEOM_flgDesTqAdjmt "Flag: desired engine mode of operation is determined by engine torque adjustment." UBYTE B_TRUE 1 100 0.00 1.00000000000 BIT_MASK 0x1 FORMAT "%13.11" ECU_ADDRESS 0x6000FA21 /end MEASUREMENT
/begin MEASUREMENT CoEOM_flgEGSDCmnVirtDmdActv "Virtual request from system diagnosis of exhaust gas sensors selected in parallel coordination" UBYTE B_TRUE 1 100 0.00 1.00000000000 BIT_MASK 0x1 FORMAT "%13.11" ECU_ADDRESS 0x60014A96 /end MEASUREMENT
/begin MEASUREMENT CoEOM_flgEnbEomSwtOld "Flag to enable EOM switch" UBYTE B_TRUE 1 100 0.00 1.00000000000 BIT_MASK 0x1 FORMAT "%13.11" ECU_ADDRESS 0x700030DD /end MEASUREMENT
/begin MEASUREMENT CoEOM_flgEomActvInhb "The current mode of operation is not allowed any longer and must be left quickest possible." UBYTE B_TRUE 1 100 0.00 1.00000000000 BIT_MASK 0x1 FORMAT "%13.11" ECU_ADDRESS 0x70000A79 /end MEASUREMENT
/begin MEASUREMENT CoEOM_flgEomIgnRels "The mode of operation change-over requests ignition angle release." UBYTE B_TRUE 1 100 0.00 1.00000000000 BIT_MASK 0x1 FORMAT "%13.11" ECU_ADDRESS 0x7000362F /end MEASUREMENT
/begin MEASUREMENT CoEOM_flgEomInterHosPln "Flag: the intermediate operating mode HOS is planned." UBYTE B_TRUE 1 100 0.00 1.00000000000 BIT_MASK 0x1 FORMAT "%13.11" ECU_ADDRESS 0x6000FA20 /end MEASUREMENT
/begin MEASUREMENT CoEOM_flgEomSwtActv "Switching of engine operating mode active" UBYTE B_TRUE 1 100 0.00 1.00000000000 BIT_MASK 0x1 FORMAT "%13.11" ECU_ADDRESS 0x7000362E /end MEASUREMENT
/begin MEASUREMENT CoEOM_flgEomSwtDes "Signals for a computing time slot the start of a mode of operation change-over." UBYTE B_TRUE 1 100 0.00 1.00000000000 BIT_MASK 0x1 FORMAT "%13.11" ECU_ADDRESS 0x7000362D /end MEASUREMENT
/begin MEASUREMENT CoEOM_flgEomSwtIniDesLoc "Local bit so switch the desired Value to the initial value CoEOM_stEOMIni_C" UBYTE B_TRUE 1 100 0.00 1.00000000000 BIT_MASK 0x1 FORMAT "%13.11" ECU_ADDRESS 0x7000362C /end MEASUREMENT
/begin MEASUREMENT CoEOM_flgEomSwtIniLoc "Local tigger for initialisation at start request" UBYTE B_TRUE 1 100 0.00 1.00000000000 BIT_MASK 0x1 FORMAT "%13.11" ECU_ADDRESS 0x7000362B /end MEASUREMENT
/begin MEASUREMENT CoEOM_flgEomTrigAirStaty "Demand to the air system to adjust the stationary air filling." UBYTE B_TRUE 1 100 0.00 1.00000000000 BIT_MASK 0x1 FORMAT "%13.11" ECU_ADDRESS 0x7000362A /end MEASUREMENT
/begin MEASUREMENT CoEOM_flgHkp "Flag: The engine operation mode HKP (homogeneous knocking prevention) is active." UBYTE B_TRUE 1 100 0.00 1.00000000000 BIT_MASK 0x1 FORMAT "%13.11" ECU_ADDRESS 0x6000FA1F /end MEASUREMENT
/begin MEASUREMENT CoEOM_flgHosAllwdExcpn "Flag: The intermediate operating mode Hos is allowed exceptionally because it is forbidden only by B_hoslldi." UBYTE B_TRUE 1 100 0.00 1.00000000000 BIT_MASK 0x1 FORMAT "%13.11" ECU_ADDRESS 0x6000FA1E /end MEASUREMENT
/begin MEASUREMENT CoEOM_flgHsp "Flag: The engine operation mode HSP (homogeneous-split) is active." UBYTE B_TRUE 1 100 0.00 1.00000000000 BIT_MASK 0x1 FORMAT "%13.11" ECU_ADDRESS 0x6000FA1D /end MEASUREMENT
/begin MEASUREMENT CoEOM_flgNxtCylCalcnTrig "Calculation of next switchable cylinder will be executed (triggered)" UBYTE B_TRUE 1 100 0.00 1.00000000000 BIT_MASK 0x1 FORMAT "%13.11" ECU_ADDRESS 0x700030DC /end MEASUREMENT
/begin MEASUREMENT CoEOM_flgProlgSlip "Slip expansion for automatic transmission is active." UBYTE B_TRUE 1 100 0.00 1.00000000000 BIT_MASK 0x1 FORMAT "%13.11" ECU_ADDRESS 0x6000FA1C /end MEASUREMENT
/begin MEASUREMENT CoEOM_flgRelAirStatyEomChg "After a change of the mode of operation the charge is settled stationarily." UBYTE B_TRUE 1 100 0.00 1.00000000000 BIT_MASK 0x1 FORMAT "%13.11" ECU_ADDRESS 0x70000A78 /end MEASUREMENT
/begin MEASUREMENT CoEOM_flgStrat "stratified operating mode of gasoline direct injection" UBYTE B_TRUE 1 100 0.00 1.00000000000 BIT_MASK 0x1 FORMAT "%13.11" ECU_ADDRESS 0x6000FA1B /end MEASUREMENT
/begin MEASUREMENT CoEOM_flgTmngExeSync "Bit, if state A_TMNG_STGY is activated in sync-raster" UBYTE B_TRUE 1 100 0.00 1.00000000000 BIT_MASK 0x1 FORMAT "%13.11" ECU_ADDRESS 0x70003629 /end MEASUREMENT
/begin MEASUREMENT CoEOM_flgTmngFinshed "Eom Swt timing finished. Next cylinder will burn in new Eom" UBYTE B_TRUE 1 100 0.00 1.00000000000 BIT_MASK 0x1 FORMAT "%13.11" ECU_ADDRESS 0x70003628 /end MEASUREMENT
/begin MEASUREMENT CoEOM_flgTogValLoc "Flag that indicates that toggeling between two calibration inputs in CoEOM is activ" UBYTE B_TRUE 1 100 0.00 1.00000000000 BIT_MASK 0x1 FORMAT "%13.11" ECU_ADDRESS 0x7000038F /end MEASUREMENT
/begin MEASUREMENT CoEOM_flgTqCalcnReqd "The torque calculation for the mode of operation change-over is requested." UBYTE B_TRUE 1 100 0.00 1.00000000000 BIT_MASK 0x1 FORMAT "%13.11" ECU_ADDRESS 0x70003627 /end MEASUREMENT
/begin MEASUREMENT CoEOM_flgUnstyShftPred "Flag: a mode of operation change-over with unsteady phase is expected." UBYTE B_TRUE 1 100 0.00 1.00000000000 BIT_MASK 0x1 FORMAT "%13.11" ECU_ADDRESS 0x6000FA1A /end MEASUREMENT
/begin MEASUREMENT CoEOM_idxEomAct "Index of the actual EOM." UBYTE CoEOM_idxOperModTot_VERB 1 100 0.00 31.0000000000 FORMAT "%13.10" ECU_ADDRESS 0x60014A97 /end MEASUREMENT
/begin MEASUREMENT CoEOM_idxEomDmdSeld "Index of winner of operating mode coordinator" UBYTE OneToOne 1 100 0.00 255.0 FORMAT "%5.1" ECU_ADDRESS 0x6000FFBA /end MEASUREMENT
/begin MEASUREMENT CoEOM_idxEomDmdSeldLoc "Index of selected EOM-requester" UBYTE OneToOne 1 100 0.00 255.0 FORMAT "%5.1" ECU_ADDRESS 0x6000F0C7 /end MEASUREMENT
/begin MEASUREMENT CoEOM_idxEomSeldLoc "Index of selected EOM" UBYTE OneToOne 1 100 0.00 255.0 FORMAT "%5.1" ECU_ADDRESS 0x6000F0C6 /end MEASUREMENT
/begin MEASUREMENT CoEOM_idxEomStgAct "Index of the actual stage of the EOM." UBYTE CoEOM_idxOperModStgTot_VERB 1 100 0.00 15.0000000000 FORMAT "%13.10" ECU_ADDRESS 0x60014A98 /end MEASUREMENT
/begin MEASUREMENT CoEOM_idxEomStgSeldLoc "Index of the selected stage of a EOM" UBYTE OneToOne 1 100 0.00 255.0 FORMAT "%5.1" ECU_ADDRESS 0x6000F0C5 /end MEASUREMENT
/begin MEASUREMENT CoEOM_idxGroupEomActv "Index of the mode of operation group of the active mode of operation." UBYTE OneToOne 1 100 0.00 255.0 FORMAT "%5.1" ECU_ADDRESS 0x600008B0 /end MEASUREMENT
/begin MEASUREMENT CoEOM_idxGroupEomDes "Index of the mode of operation group of the desired mode of operation." UBYTE OneToOne 1 100 0.00 255.0 FORMAT "%5.1" ECU_ADDRESS 0x600008B1 /end MEASUREMENT
/begin MEASUREMENT CoEOM_idxSwtStgyM "Local interims value for desired switch strategy out of calibration MAP" UBYTE OneToOne 1 100 0.00 255.0 FORMAT "%5.1" ECU_ADDRESS 0x600008B2 /end MEASUREMENT
/begin MEASUREMENT CoEOM_idxSwtStgySeld "The number of the chosen strategy for switching the EOM." UBYTE OneToOne 1 100 0.00 255.0 FORMAT "%5.1" ECU_ADDRESS 0x60000935 /end MEASUREMENT
/begin MEASUREMENT CoEOM_idxSwtStgySeldLoc "Local copy of CoEOM_idxSwtStgySeld" UBYTE OneToOne 1 100 0.00 255.0 FORMAT "%5.1" ECU_ADDRESS 0x600008B3 /end MEASUREMENT
/begin MEASUREMENT CoEOM_nrPrdnHoz "Length of the array CoEOM_stEomCylAdv_a for the extended prediction horizon" UBYTE OneToOne 1 100 1.0 255.0 FORMAT "%5.1" ECU_ADDRESS 0x50000988 /end MEASUREMENT
/begin MEASUREMENT CoEOM_nrPrioSeldLoc "Priority of the selected EOM" UWORD OneToOne 1 100 0.00 65535.00 FORMAT "%8.2" ECU_ADDRESS 0x60007F1E /end MEASUREMENT
/begin MEASUREMENT CoEOM_percEngLoad "Desired torque, selected by the switch for the choice of the desired torque for the Engine Operating Mode characteristic curves" UWORD rel_uw_b100 1 100 0.00 99.99847 FORMAT "%8.5" ECU_ADDRESS 0x60000660 /end MEASUREMENT
/begin MEASUREMENT CoEOM_ratInpHyst "Torque input for the Hysterese" UWORD rel_uw_q0p0234 1 100 0.00 1535.977 FORMAT "%8.3" ECU_ADDRESS 0x60000574 /end MEASUREMENT
/begin MEASUREMENT CoEOM_stDeadlck "Status that a deadlock has happend during the operation mode selection" UBYTE OneToOne 1 100 0.00 255.0 FORMAT "%5.1" ECU_ADDRESS 0x6000FFB9 /end MEASUREMENT
/begin MEASUREMENT CoEOM_stEom "Current engine operation mode (single value)" UWORD CoEOM_stEomStgTot_VERB 1 100 0.00 7951.00000000 FORMAT "%13.8" ECU_ADDRESS 0x60000662 /end MEASUREMENT
/begin MEASUREMENT CoEOM_stEomActv "Current mode of operation of the internal-combustion engine" UWORD CoEOM_stEomStgTot_VERB 1 100 0.00 7951.00000000 FORMAT "%13.8" ECU_ADDRESS 0x60000664 /end MEASUREMENT
/begin MEASUREMENT CoEOM_stEomActvLoc "Local copy of CoEOM_stEomActv" UWORD CoEOM_stEomStgTot_VERB 1 100 0.00 7951.00000000 FORMAT "%13.8" ECU_ADDRESS 0x60000576 /end MEASUREMENT
/begin MEASUREMENT CoEOM_stEomActvTmng "current mode of operation of the internal-combustion engine after timing condition" UWORD CoEOM_stEomStgTot_VERB 1 100 0.00 7951.00000000 FORMAT "%13.8" ECU_ADDRESS 0x60000666 /end MEASUREMENT
/begin MEASUREMENT CoEOM_stEomActvTmngLoc "Local copy of CoEOM_stEomActvTmng" UWORD CoEOM_stEomStgTot_VERB 1 100 0.00 7951.00000000 FORMAT "%13.8" ECU_ADDRESS 0x60000578 /end MEASUREMENT
/begin MEASUREMENT CoEOM_stEomBasis1 "first selected unique engine operating mode at a definite speed and torque" UWORD OneToOne 1 100 0.00 65535.00 FORMAT "%8.2" ECU_ADDRESS 0x6000057A /end MEASUREMENT
/begin MEASUREMENT CoEOM_stEomBasis2 "Second selected unique engine operating mode at a definite speed and torque" UWORD OneToOne 1 100 0.00 65535.00 FORMAT "%8.2" ECU_ADDRESS 0x6000057C /end MEASUREMENT
/begin MEASUREMENT CoEOM_stEomBasisAllwd "Allowed engine operating modes at a definite speed and torque" ULONG OneToOne 1 100 0.00 4294967295.00 FORMAT "%13.2" ECU_ADDRESS 0x500001F8 /end MEASUREMENT
/begin MEASUREMENT CoEOM_stEomCatHeatSrcLcyToVld "Characteristic curve source for mode of operation wish catalyst heating in function CoEOM_Lcy2Vld." UBYTE OneToOne 1 100 0.00 255.0 FORMAT "%5.1" ECU_ADDRESS 0x6000F0C4 /end MEASUREMENT
/begin MEASUREMENT CoEOM_stEomCylAdv_a "Array with target eoms for each cylinder. Prediction done with new cylinder counter Gen_ctCylAdv" UWORD CoEOM_stEomStgTot_VERB 1 100 0.00 7951.00000000 FORMAT "%13.8" ARRAY_SIZE 4 ECU_ADDRESS 0x500005A4 /end MEASUREMENT
/begin MEASUREMENT CoEOM_stEomDes "Desired engine operation mode." UWORD CoEOM_stEomStgTot_VERB 1 100 0.00 7951.00000000 FORMAT "%13.8" ECU_ADDRESS 0x60014792 /end MEASUREMENT
/begin MEASUREMENT CoEOM_stEOMDesNonCsers "Engine Operation Mode in case CSERS would not have been requested" UWORD CoEOM_stEomStgTot_VERB 1 100 0.00 7951.00000000 FORMAT "%13.8" ECU_ADDRESS 0x6000958A /end MEASUREMENT
/begin MEASUREMENT CoEOM_stEomDesReqdLoc "Local copy of the requested mode of operation." UWORD CoEOM_stEomStgTot_VERB 1 100 0.00 7951.00000000 FORMAT "%13.8" ECU_ADDRESS 0x60000668 /end MEASUREMENT
/begin MEASUREMENT CoEOM_stEomDest "Target engine operation mode" UWORD CoEOM_stEomStgTot_VERB 1 100 0.00 7951.00000000 FORMAT "%13.8" ECU_ADDRESS 0x60014794 /end MEASUREMENT
/begin MEASUREMENT CoEOM_stEomLimpSrcLcyToVld "Characteristic curve source for mode of operation wish emergency run coordination in function CoEOM_Lcy2Vld." UBYTE OneToOne 1 100 0.00 255.0 FORMAT "%5.1" ECU_ADDRESS 0x6000F0C3 /end MEASUREMENT
/begin MEASUREMENT CoEOM_stEomLoc "Local copy of CoEOM_stEom" UWORD CoEOM_stEomStgTot_VERB 1 100 0.00 7951.00000000 FORMAT "%13.8" ECU_ADDRESS 0x50000702 /end MEASUREMENT
/begin MEASUREMENT CoEOM_stEomStrtSrcLcyToVld "Characteristic curve source for mode of operation wish start in function CoEOM_Lcy2Vld." UBYTE OneToOne 1 100 0.00 255.0 FORMAT "%5.1" ECU_ADDRESS 0x6000F0C2 /end MEASUREMENT
/begin MEASUREMENT CoEOM_stEomTar "Target mode of operation." UWORD CoEOM_stEomStgTot_VERB 1 100 0.00 7951.00000000 FORMAT "%13.8" ECU_ADDRESS 0x6000066A /end MEASUREMENT
/begin MEASUREMENT CoEOM_stEomTarActr "Engine operation mode for actuators." UWORD CoEOM_stEomStgTot_VERB 1 100 0.00 7951.00000000 FORMAT "%13.8" ECU_ADDRESS 0x6000066C /end MEASUREMENT
/begin MEASUREMENT CoEOM_stEomTarActrLoc "Local copy of CoEOM_stEomTarActr" UWORD CoEOM_stEomStgTot_VERB 1 100 0.00 7951.00000000 FORMAT "%13.8" ECU_ADDRESS 0x6000057E /end MEASUREMENT
/begin MEASUREMENT CoEOM_stEomTarAirSys "The mode of operation default for the air system." UWORD CoEOM_stEomStgTot_VERB 1 100 0.00 7951.00000000 FORMAT "%13.8" ECU_ADDRESS 0x6000066E /end MEASUREMENT
/begin MEASUREMENT CoEOM_stEomTarAirSysLoc "Local copy of CoEOM_stEomTarAirSys" UWORD CoEOM_stEomStgTot_VERB 1 100 0.00 7951.00000000 FORMAT "%13.8" ECU_ADDRESS 0x60000580 /end MEASUREMENT
/begin MEASUREMENT CoEOM_stEomTarHw "Target eom for hardware actuator (e.g. valve lift)" UWORD CoEOM_stEomStgTot_VERB 1 100 0.00 7951.00000000 FORMAT "%13.8" ECU_ADDRESS 0x60000670 /end MEASUREMENT
/begin MEASUREMENT CoEOM_stEomTarHwLoc "Local copy of CoEOM_stEomTarHw" UWORD CoEOM_stEomStgTot_VERB 1 100 0.00 7951.00000000 FORMAT "%13.8" ECU_ADDRESS 0x60000672 /end MEASUREMENT
/begin MEASUREMENT CoEOM_stEomTarInj "Engine operation mode for the injection system." UWORD CoEOM_stEomStgTot_VERB 1 100 0.00 7951.00000000 FORMAT "%13.8" ECU_ADDRESS 0x60000676 /end MEASUREMENT
/begin MEASUREMENT CoEOM_stEomTarInjLoc "Local copy of CoEOM_stEomTarInj" UWORD CoEOM_stEomStgTot_VERB 1 100 0.00 7951.00000000 FORMAT "%13.8" ECU_ADDRESS 0x60000582 /end MEASUREMENT
/begin MEASUREMENT CoEOM_stEomTarLbk "Engine operation mode for LBK" UWORD CoEOM_stEomStgTot_VERB 1 100 0.00 7951.00000000 FORMAT "%13.8" ECU_ADDRESS 0x6000067A /end MEASUREMENT
/begin MEASUREMENT CoEOM_stEomTarLbkLoc "Local copy of CoEOM_stEomTarLbk" UWORD CoEOM_stEomStgTot_VERB 1 100 0.00 7951.00000000 FORMAT "%13.8" ECU_ADDRESS 0x60000584 /end MEASUREMENT
/begin MEASUREMENT CoEOM_stEomTarLoc "Local copy of CoEOM_stEomTar" UWORD CoEOM_stEomStgTot_VERB 1 100 0.00 7951.00000000 FORMAT "%13.8" ECU_ADDRESS 0x6000067C /end MEASUREMENT
/begin MEASUREMENT CoEOM_stEomTarPostProlgSlip "Target mode of operation after slip expansion (changes later than bdemodz)." UBYTE OneToOne 1 100 0.00 255.0 FORMAT "%5.1" ECU_ADDRESS 0x60014A99 /end MEASUREMENT
/begin MEASUREMENT CoEOM_stEomTarPrev "Previous target engine operating mode for switch" UWORD CoEOM_stEomStgTot_VERB 1 100 0.00 7951.00000000 FORMAT "%13.8" ECU_ADDRESS 0x6000067E /end MEASUREMENT
/begin MEASUREMENT CoEOM_stInhbnSeldLoc "Inhibited EOMs" UWORD OneToOne 1 100 0.00 65535.00 FORMAT "%8.2" ECU_ADDRESS 0x60007F1C /end MEASUREMENT
/begin MEASUREMENT CoEOM_stOperModDft "Operating mode (column) info for the defalut engine operating mode" ULONG OneToOne 1 100 0.00 4294967295.00 FORMAT "%13.2" ECU_ADDRESS 0x60003120 /end MEASUREMENT
/begin MEASUREMENT CoEOM_stOpMAct "Active operation mode" UWORD OneToOne 1 100 0.00 65535.00 FORMAT "%8.2" ECU_ADDRESS 0x50005C9A /end MEASUREMENT
/begin MEASUREMENT CoEOM_stOpMPos "Bit mask of the possible operation modes for the DSM-Scheduler" UBYTE dez 1 100 0.00 255.0 FORMAT "%5.1" ECU_ADDRESS 0x6000FFB8 /end MEASUREMENT
/begin MEASUREMENT CoEOM_stPhaEomShift "Phase of the mode of operation change-over." UBYTE OneToOne 1 100 0.00 255.0 FORMAT "%5.1" ECU_ADDRESS 0x60000936 /end MEASUREMENT
/begin MEASUREMENT CoEOM_stPhaEomShiftLoc "Local copy of CoEOM_stPhaEomShift" UBYTE OneToOne 1 100 0.00 255.0 FORMAT "%5.1" ECU_ADDRESS 0x60000937 /end MEASUREMENT
/begin MEASUREMENT CoEOM_stTrigAckd "Receipts of the systems by appropriate demand because of a mode of operation change." UWORD OneToOne 1 100 0.00 65535.00 FORMAT "%8.2" ECU_ADDRESS 0x60000682 /end MEASUREMENT
/begin MEASUREMENT CoEOM_stTrigActvt "Demand of the mode of operation control to the actuators to prepare itself for a change-over." UWORD OneToOne 1 100 0.00 65535.00 FORMAT "%8.2" ECU_ADDRESS 0x60000684 /end MEASUREMENT
/begin MEASUREMENT CoEOM_stTrigActvtLoc "Local copy of CoEOM_stTrigActvt" UWORD OneToOne 1 100 0.00 65535.00 FORMAT "%8.2" ECU_ADDRESS 0x60000586 /end MEASUREMENT
/begin MEASUREMENT CoEOM_SwtStgy1.flgEomSwtDes "Switching strategy of eom switches that operates without trigger / Signals for a computing time slot the start of a mode of operation change-over" UBYTE OneToOne 1 100 0.00 255.0 FORMAT "%5.1" ECU_ADDRESS 0x500001D4 /end MEASUREMENT
/begin MEASUREMENT CoEOM_SwtStgy1.flgRelAirStatyEomChg "Switching strategy of eom switches that operates without trigger / After a change of the mode of operation the charge is settled stationarily" UBYTE OneToOne 1 100 0.00 255.0 FORMAT "%5.1" ECU_ADDRESS 0x500001D5 /end MEASUREMENT
/begin MEASUREMENT CoEOM_SwtStgy1.flgTmngFinshed "Switching strategy of eom switches that operates without trigger / sturcture variable: cylinder will burn in new eom" UBYTE OneToOne 1 100 0.00 255.0 FORMAT "%5.1" ECU_ADDRESS 0x500001D6 /end MEASUREMENT
/begin MEASUREMENT CoEOM_SwtStgy1.flgWrStEomActv "Switching strategy of eom switches that operates without trigger / Triggerflag to write the CoEOM_stEomActv values" UBYTE B_TRUE 1 100 0.00 1.00000000000 BIT_MASK 0x1 FORMAT "%13.11" ECU_ADDRESS 0x500001D7 /end MEASUREMENT
/begin MEASUREMENT CoEOM_SwtStgy1.flgWrStEomActvTmng "Switching strategy of eom switches that operates without trigger / Triggerflag to write the CoEOM_stEomActvTmng values" UBYTE B_TRUE 1 100 0.00 1.00000000000 BIT_MASK 0x1 FORMAT "%13.11" ECU_ADDRESS 0x500001D8 /end MEASUREMENT
/begin MEASUREMENT CoEOM_SwtStgy1.flgWrStEomTarActr "Switching strategy of eom switches that operates without trigger / Triggerflag to write the CoEOM_stEomTarActr values" UBYTE B_TRUE 1 100 0.00 1.00000000000 BIT_MASK 0x1 FORMAT "%13.11" ECU_ADDRESS 0x500001D9 /end MEASUREMENT
/begin MEASUREMENT CoEOM_SwtStgy1.flgWrStEomTarAirSys "Switching strategy of eom switches that operates without trigger / Triggerflag to write the CoEOM_stEomTarAirSys values" UBYTE B_TRUE 1 100 0.00 1.00000000000 BIT_MASK 0x1 FORMAT "%13.11" ECU_ADDRESS 0x500001DA /end MEASUREMENT
/begin MEASUREMENT CoEOM_SwtStgy1.flgWrStEomTarHw "Switching strategy of eom switches that operates without trigger / Triggerflag to write the CoEOM_stEomTarHw values" UBYTE B_TRUE 1 100 0.00 1.00000000000 BIT_MASK 0x1 FORMAT "%13.11" ECU_ADDRESS 0x500001DB /end MEASUREMENT
/begin MEASUREMENT CoEOM_SwtStgy1.flgWrStEomTarInj "Switching strategy of eom switches that operates without trigger / Triggerflag to write the CoEOM_stEomTarInj values" UBYTE B_TRUE 1 100 0.00 1.00000000000 BIT_MASK 0x1 FORMAT "%13.11" ECU_ADDRESS 0x500001DC /end MEASUREMENT
/begin MEASUREMENT CoEOM_SwtStgy1.flgWrStEomTarLbk "Switching strategy of eom switches that operates without trigger / Triggerflag to write the CoEOM_stEomTarLbk values" UBYTE B_TRUE 1 100 0.00 1.00000000000 BIT_MASK 0x1 FORMAT "%13.11" ECU_ADDRESS 0x500001DD /end MEASUREMENT
/begin MEASUREMENT CoEOM_SwtStgy1.sm "Switching strategy of eom switches that operates without trigger / Current state of state machine" UBYTE CoEOM_SwtStgy1_sm_VERB 1 100 0.00 2.00000000000 FORMAT "%13.11" ECU_ADDRESS 0x500001DE /end MEASUREMENT
/begin MEASUREMENT CoEOM_SwtStgy1.stPhaEomShift "Switching strategy of eom switches that operates without trigger / Phase of the mode of operation change-over" UBYTE OneToOne 1 100 0.00 255.0 FORMAT "%5.1" ECU_ADDRESS 0x500001DF /end MEASUREMENT
/begin MEASUREMENT CoEOM_SwtStgy1.stTrigActvt "Switching strategy of eom switches that operates without trigger / Demand of the mode of operation control to the actuators to prepare itself for a change-over" UWORD OneToOne 1 100 0.00 65535.00 FORMAT "%8.2" ECU_ADDRESS 0x500001E0 /end MEASUREMENT
/begin MEASUREMENT CoEOM_SwtStgy1.tiSwt "Switching strategy of eom switches that operates without trigger / Ex-time in the respective condition of the mode of operation change-over" SWORD Time_s 1 100 -327.6800 327.6700 FORMAT "%8.4" ECU_ADDRESS 0x500001E2 /end MEASUREMENT
/begin MEASUREMENT CoEOM_SwtStgy2.flgEomSwtDes "Switching strategy of eom switches that operates with triggers and filling preparation / Ignition system switches over to a new mode of operation" UBYTE OneToOne 1 100 0.00 255.0 FORMAT "%5.1" ECU_ADDRESS 0x500001E4 /end MEASUREMENT
/begin MEASUREMENT CoEOM_SwtStgy2.flgRelAirStatyEomChg "Switching strategy of eom switches that operates with triggers and filling preparation / After a change of the mode of operation the charge is settled stationarily" UBYTE OneToOne 1 100 0.00 255.0 FORMAT "%5.1" ECU_ADDRESS 0x500001E5 /end MEASUREMENT
/begin MEASUREMENT CoEOM_SwtStgy2.flgTmngFinshed "Switching strategy of eom switches that operates with triggers and filling preparation / sturcture variable: cylinder will burn in new eom" UBYTE OneToOne 1 100 0.00 255.0 FORMAT "%5.1" ECU_ADDRESS 0x500001E6 /end MEASUREMENT
/begin MEASUREMENT CoEOM_SwtStgy2.flgTqCalcnAckd "Switching strategy of eom switches that operates with triggers and filling preparation / predicted torque matches target torque" UBYTE OneToOne 1 100 0.00 255.0 FORMAT "%5.1" ECU_ADDRESS 0x500001E7 /end MEASUREMENT
/begin MEASUREMENT CoEOM_SwtStgy2.flgWrStEomActv "Switching strategy of eom switches that operates with triggers and filling preparation / Triggerflag to write the CoEOM_stEomActv values" UBYTE B_TRUE 1 100 0.00 1.00000000000 BIT_MASK 0x1 FORMAT "%13.11" ECU_ADDRESS 0x500001E8 /end MEASUREMENT
/begin MEASUREMENT CoEOM_SwtStgy2.flgWrStEomActvTmng "Switching strategy of eom switches that operates with triggers and filling preparation / Triggerflag to write the CoEOM_stEomActvTmng values" UBYTE B_TRUE 1 100 0.00 1.00000000000 BIT_MASK 0x1 FORMAT "%13.11" ECU_ADDRESS 0x500001E9 /end MEASUREMENT
/begin MEASUREMENT CoEOM_SwtStgy2.flgWrStEomTarActr "Switching strategy of eom switches that operates with triggers and filling preparation / Triggerflag to write the CoEOM_stEomTarActr values" UBYTE B_TRUE 1 100 0.00 1.00000000000 BIT_MASK 0x1 FORMAT "%13.11" ECU_ADDRESS 0x500001EA /end MEASUREMENT
/begin MEASUREMENT CoEOM_SwtStgy2.flgWrStEomTarAirSys "Switching strategy of eom switches that operates with triggers and filling preparation / Triggerflag to write the CoEOM_stEomTarAirSys values" UBYTE B_TRUE 1 100 0.00 1.00000000000 BIT_MASK 0x1 FORMAT "%13.11" ECU_ADDRESS 0x500001EB /end MEASUREMENT
/begin MEASUREMENT CoEOM_SwtStgy2.flgWrStEomTarHw "Switching strategy of eom switches that operates with triggers and filling preparation / Triggerflag to write the CoEOM_stEomTarHw values" UBYTE B_TRUE 1 100 0.00 1.00000000000 BIT_MASK 0x1 FORMAT "%13.11" ECU_ADDRESS 0x500001EC /end MEASUREMENT
/begin MEASUREMENT CoEOM_SwtStgy2.flgWrStEomTarInj "Switching strategy of eom switches that operates with triggers and filling preparation / Triggerflag to write the CoEOM_stEomTarInj values" UBYTE B_TRUE 1 100 0.00 1.00000000000 BIT_MASK 0x1 FORMAT "%13.11" ECU_ADDRESS 0x500001ED /end MEASUREMENT
/begin MEASUREMENT CoEOM_SwtStgy2.flgWrStEomTarLbk "Switching strategy of eom switches that operates with triggers and filling preparation / Triggerflag to write the CoEOM_stEomTarLbk values" UBYTE B_TRUE 1 100 0.00 1.00000000000 BIT_MASK 0x1 FORMAT "%13.11" ECU_ADDRESS 0x500001EE /end MEASUREMENT
/begin MEASUREMENT CoEOM_SwtStgy2.sm "Switching strategy of eom switches that operates with triggers and filling preparation / Current state of state machine" UBYTE CoEOM_SwtStgy2_sm_VERB 1 100 0.00 4.00000000000 FORMAT "%13.11" ECU_ADDRESS 0x500001EF /end MEASUREMENT
/begin MEASUREMENT CoEOM_SwtStgy2.stPhaEomShift "Switching strategy of eom switches that operates with triggers and filling preparation / Phase of the mode of operation change-over" UBYTE OneToOne 1 100 0.00 255.0 FORMAT "%5.1" ECU_ADDRESS 0x500001F0 /end MEASUREMENT
/begin MEASUREMENT CoEOM_SwtStgy2.stTrigAckd "Switching strategy of eom switches that operates with triggers and filling preparation / Receipts of the systems by appropriate demand because of a mode of operation change" UWORD OneToOne 1 100 0.00 65535.00 FORMAT "%8.2" ECU_ADDRESS 0x500001F2 /end MEASUREMENT
/begin MEASUREMENT CoEOM_SwtStgy2.stTrigActvt "Switching strategy of eom switches that operates with triggers and filling preparation / Demand of the mode of operation control to the actuators to prepare itself for a change-over" UWORD OneToOne 1 100 0.00 65535.00 FORMAT "%8.2" ECU_ADDRESS 0x500001F4 /end MEASUREMENT
/begin MEASUREMENT CoEOM_SwtStgy2.tiSwt "Switching strategy of eom switches that operates with triggers and filling preparation / Ex-time in the respective condition of the mode of operation change-over" SWORD Time_s 1 100 -327.6800 327.6700 FORMAT "%8.4" ECU_ADDRESS 0x500001F6 /end MEASUREMENT
/begin MEASUREMENT CoEOM_SwtStgy5.flgEomSwtDes "Switch strategy for triggered valve lift switch / Internal variable to see that a switch is desired" UBYTE OneToOne 1 100 0.00 255.0 FORMAT "%5.1" ECU_ADDRESS 0x500006F0 /end MEASUREMENT
/begin MEASUREMENT CoEOM_SwtStgy5.flgRelAirStatyEomChg "Switch strategy for triggered valve lift switch / Internal variable to see that the AirSys has a stable relative air calculation" UBYTE OneToOne 1 100 0.00 255.0 FORMAT "%5.1" ECU_ADDRESS 0x500006F1 /end MEASUREMENT
/begin MEASUREMENT CoEOM_SwtStgy5.flgTmngFinshed "Switch strategy for triggered valve lift switch / Internal variable to see if the timing calculation of the switch (next cylinder will burn in new eom) is finished" UBYTE OneToOne 1 100 0.00 255.0 FORMAT "%5.1" ECU_ADDRESS 0x500006F2 /end MEASUREMENT
/begin MEASUREMENT CoEOM_SwtStgy5.flgWrStEomActv "Switch strategy for triggered valve lift switch / Triggerflag to write the CoEOM_stEomActv values" UBYTE B_TRUE 1 100 0.00 1.00000000000 BIT_MASK 0x1 FORMAT "%13.11" ECU_ADDRESS 0x500006F3 /end MEASUREMENT
/begin MEASUREMENT CoEOM_SwtStgy5.flgWrStEomActvTmng "Switch strategy for triggered valve lift switch / Triggerflag to write the CoEOM_stEomActvTmng values" UBYTE B_TRUE 1 100 0.00 1.00000000000 BIT_MASK 0x1 FORMAT "%13.11" ECU_ADDRESS 0x500006F4 /end MEASUREMENT
/begin MEASUREMENT CoEOM_SwtStgy5.flgWrStEomTarActr "Switch strategy for triggered valve lift switch / Triggerflag to write the CoEOM_stEomTarActr values" UBYTE B_TRUE 1 100 0.00 1.00000000000 BIT_MASK 0x1 FORMAT "%13.11" ECU_ADDRESS 0x500006F5 /end MEASUREMENT
/begin MEASUREMENT CoEOM_SwtStgy5.flgWrStEomTarAirSys "Switch strategy for triggered valve lift switch / Triggerflag to write the CoEOM_stEomTarAirSys values" UBYTE B_TRUE 1 100 0.00 1.00000000000 BIT_MASK 0x1 FORMAT "%13.11" ECU_ADDRESS 0x500006F6 /end MEASUREMENT
/begin MEASUREMENT CoEOM_SwtStgy5.flgWrStEomTarHw "Switch strategy for triggered valve lift switch / Triggerflag to write the CoEOM_stEomTarHw values" UBYTE B_TRUE 1 100 0.00 1.00000000000 BIT_MASK 0x1 FORMAT "%13.11" ECU_ADDRESS 0x500006F7 /end MEASUREMENT
/begin MEASUREMENT CoEOM_SwtStgy5.flgWrStEomTarInj "Switch strategy for triggered valve lift switch / Triggerflag to write the CoEOM_stEomTarInj values" UBYTE B_TRUE 1 100 0.00 1.00000000000 BIT_MASK 0x1 FORMAT "%13.11" ECU_ADDRESS 0x500006F8 /end MEASUREMENT
/begin MEASUREMENT CoEOM_SwtStgy5.flgWrStEomTarLbk "Switch strategy for triggered valve lift switch / Triggerflag to write the CoEOM_stEomTarLbk values" UBYTE B_TRUE 1 100 0.00 1.00000000000 BIT_MASK 0x1 FORMAT "%13.11" ECU_ADDRESS 0x500006F9 /end MEASUREMENT
/begin MEASUREMENT CoEOM_SwtStgy5.sm "Switch strategy for triggered valve lift switch / Internal variable to see the verbal state of the switch" UBYTE CoEOM_SwtStgy5_sm_VERB 1 100 0.00 3.00000000000 FORMAT "%13.11" ECU_ADDRESS 0x500006FA /end MEASUREMENT
/begin MEASUREMENT CoEOM_SwtStgy5.stPhaEomShift "Switch strategy for triggered valve lift switch / Internal variable to see the current state of the switch" UBYTE OneToOne 1 100 0.00 255.0 FORMAT "%5.1" ECU_ADDRESS 0x500006FB /end MEASUREMENT
/begin MEASUREMENT CoEOM_SwtStgy5.stTrigAckd "Switch strategy for triggered valve lift switch / Internal variable to see the recieved feedbacks" UWORD OneToOne 1 100 0.00 65535.00 FORMAT "%8.2" ECU_ADDRESS 0x500006FC /end MEASUREMENT
/begin MEASUREMENT CoEOM_SwtStgy5.stTrigActvt "Switch strategy for triggered valve lift switch / Internal variable to see the choosen actuators" UWORD OneToOne 1 100 0.00 65535.00 FORMAT "%8.2" ECU_ADDRESS 0x500006FE /end MEASUREMENT
/begin MEASUREMENT CoEOM_SwtStgy5.tiSwt "Switch strategy for triggered valve lift switch / Time in state" SWORD Time_s 1 100 -327.6800 327.6700 FORMAT "%8.4" ECU_ADDRESS 0x50000700 /end MEASUREMENT
/begin MEASUREMENT CoEOM_tAirMnfldUsThrAdpr "Air temperature upstream throttle." UWORD temp_q0p0234 1 100 0.00 1535.977 FORMAT "%8.3" ECU_ADDRESS 0x60007F18 /end MEASUREMENT
/begin MEASUREMENT CoEOM_tiSwt "Ex-time in the respective condition of the mode of operation change-over." SWORD Time_s 1 100 -327.6800 327.6700 FORMAT "%8.4" ECU_ADDRESS 0x60000588 /end MEASUREMENT
/begin MEASUREMENT CoEOM_tiSwtSWT_I.tiStrd "Time of engine operating mode switch / Sum value" SWORD Time_s 1 100 -327.6800 327.6700 FORMAT "%8.4" ECU_ADDRESS 0x6000058A /end MEASUREMENT
/begin MEASUREMENT CoEOM_typCoornCSERS_a "Coordination results for CSERS" UBYTE CoEOM_TypCoorn_VERB 1 100 0.00 5.00000000000 FORMAT "%13.11" ARRAY_SIZE 25 ECU_ADDRESS 0x6000FF9F /end MEASUREMENT
/begin MEASUREMENT CoEOM_typCoornParDiagPsbl_a "ParDiagPsbl-coordination results" UBYTE CoEOM_TypCoorn_VERB 1 100 0.00 5.00000000000 FORMAT "%13.11" ARRAY_SIZE 25 ECU_ADDRESS 0x6000F878 /end MEASUREMENT
/begin MEASUREMENT CoEOM_typCoorn_a "Coordination results for main coordination" UBYTE CoEOM_TypCoorn_VERB 1 100 0.00 5.00000000000 FORMAT "%13.11" ARRAY_SIZE 25 ECU_ADDRESS 0x6000FF86 /end MEASUREMENT
/begin MEASUREMENT CoESS_cntrReIni "counter for state re-initialization" UBYTE OneToOne 1 100 0.00 255.0 FORMAT "%5.1" ECU_ADDRESS 0x6000F0B7 /end MEASUREMENT
/begin MEASUREMENT CoESS_flgBlowrFanSlopReq "Blower Fan voltage request" UBYTE B_TRUE 1 100 0.00 1.00000000000 BIT_MASK 0x1 FORMAT "%13.11" ECU_ADDRESS 0x6000F0B6 /end MEASUREMENT
/begin MEASUREMENT CoESS_flgUReq "Flag to indicate blower fan voltage request is set" UBYTE B_TRUE 1 100 0.00 1.00000000000 BIT_MASK 0x1 FORMAT "%13.11" ECU_ADDRESS 0x6000F6C5 /end MEASUREMENT
/begin MEASUREMENT CoESS_nMinAltIdleUp "Minimum alternator idle up speed request" SWORD EngN 1 100 -16384.00 16383.50 FORMAT "%8.2" ECU_ADDRESS 0x60007F16 /end MEASUREMENT
/begin MEASUREMENT CoESS_stAlt "Engage request to alternator from Mechanical Energy Coordinator" UBYTE OneToOne 1 100 0.00 255.0 FORMAT "%5.1" ECU_ADDRESS 0x60014A9A /end MEASUREMENT
/begin MEASUREMENT CoESS_tiBlowrRampVal "Ramp time value for blower fan minimum voltage request" SWORD Time_s 1 100 -327.6800 327.6700 FORMAT "%8.4" ECU_ADDRESS 0x60007F14 /end MEASUREMENT
/begin MEASUREMENT CoESS_tiFrntBlowrRamp "Front Blower voltage ramp time" SWORD Time_s 1 100 -327.6800 327.6700 FORMAT "%8.4" ECU_ADDRESS 0x60007F12 /end MEASUREMENT
/begin MEASUREMENT CoESS_tiMICUTxBlowrRamp "MICU blower voltage ramp time" SWORD Time_s 1 100 -327.6800 327.6700 FORMAT "%8.4" ECU_ADDRESS 0x60007F10 /end MEASUREMENT
/begin MEASUREMENT CoESS_tiRrBlowrRamp "Rear Blower voltage ramp time" SWORD Time_s 1 100 -327.6800 327.6700 FORMAT "%8.4" ECU_ADDRESS 0x60007F0E /end MEASUREMENT
/begin MEASUREMENT CoESS_uACGUpMinReq "The filtered ACG output minimum voltage is required from AC ECU." SWORD Volt_Batt 1 100 -655360.0 655340.0 FORMAT "%8.1" ECU_ADDRESS 0x60007F0C /end MEASUREMENT
/begin MEASUREMENT CoESS_uBlowrUMinReq "Blower fan minimum voltage request" SWORD Volt_Batt 1 100 -655360.0 655340.0 FORMAT "%8.1" ECU_ADDRESS 0x6000924C /end MEASUREMENT
/begin MEASUREMENT CoESS_uBlowrUUnRampUnfild "Blower fan unfiltered unramped volatge" SWORD Volt_Batt 1 100 -655360.0 655340.0 FORMAT "%8.1" ECU_ADDRESS 0x6000924A /end MEASUREMENT
/begin MEASUREMENT CoESS_uFrntBlowrDes "Desired front Blower voltage" SWORD Volt_Batt 1 100 -655360.0 655340.0 FORMAT "%8.1" ECU_ADDRESS 0x60007F0A /end MEASUREMENT
/begin MEASUREMENT CoESS_uFuPmpMinReq "Fuel pump minimum voltage request" SWORD Volt_Batt 1 100 -655360.0 655340.0 FORMAT "%8.1" ECU_ADDRESS 0x60009248 /end MEASUREMENT
/begin MEASUREMENT CoESS_uMaxBlowrDes "Maximum Desired voltage between front and rear" SWORD Volt_Batt 1 100 -655360.0 655340.0 FORMAT "%8.1" ECU_ADDRESS 0x60007F08 /end MEASUREMENT
/begin MEASUREMENT CoESS_uMICUTxBlowrDes "Desired MICU Tx blower voltage" SWORD Volt_Batt 1 100 -655360.0 655340.0 FORMAT "%8.1" ECU_ADDRESS 0x60007F06 /end MEASUREMENT
/begin MEASUREMENT CoESS_uMinReq "minimum supply voltage for IGC" SWORD Volt_Batt 1 100 -655360.0 655340.0 FORMAT "%8.1" ECU_ADDRESS 0x60009246 /end MEASUREMENT
/begin MEASUREMENT CoESS_uRrBlowrDes "Desired rear Blower voltage" SWORD Volt_Batt 1 100 -655360.0 655340.0 FORMAT "%8.1" ECU_ADDRESS 0x60007F04 /end MEASUREMENT
/begin MEASUREMENT CoESS_uSlopRampVal "Ramp slope value for blower fan minimum voltage request" SWORD RmpVoltBatt 1 100 -10000.00 9999.69 FORMAT "%8.2" ECU_ADDRESS 0x60009244 /end MEASUREMENT
/begin MEASUREMENT dmiagk_w_msg "Torque gradient set point." SWORD rel_q0p003052_pc_DIV_s 1 100 -100.0000 99.9969 FORMAT "%8.4" ECU_ADDRESS 0x60014980 /end MEASUREMENT
/begin MEASUREMENT ESS_bEngStopEna "stop release electrical supply system" UBYTE B_TRUE 1 100 0.00 1.00000000000 BIT_MASK 0x1 FORMAT "%13.11" ECU_ADDRESS 0x700009AE /end MEASUREMENT
/begin MEASUREMENT ESS_bEngStrtReq "Electrical supply system require motor start" UBYTE B_TRUE 1 100 0.00 1.00000000000 BIT_MASK 0x1 FORMAT "%13.11" ECU_ADDRESS 0x700009AC /end MEASUREMENT
/begin MEASUREMENT ESS_nMax "Max. engine speed request from Electrical Supply System" SWORD EngN 1 100 -16384.00 16383.50 FORMAT "%8.2" ECU_ADDRESS 0x60009A04 /end MEASUREMENT
/begin MEASUREMENT ESS_nMin "Min. engine speed request from Electrical Supply System" SWORD EngN 1 100 -16384.00 16383.50 FORMAT "%8.2" ECU_ADDRESS 0x60009A02 /end MEASUREMENT
/begin MEASUREMENT ESS_trqDesAcs "Torque request from Electrical Supply System" SWORD Trq 1 100 -3276.800 3276.700 FORMAT "%8.3" ECU_ADDRESS 0x600099FE /end MEASUREMENT
/begin MEASUREMENT ESS_trqResvAcs "Torque reserve request from Electrical Supply System" SWORD Trq 1 100 -3276.800 3276.700 FORMAT "%8.3" ECU_ADDRESS 0x600099FC /end MEASUREMENT
/begin MEASUREMENT hymbdefa_msg "hysteresis for desire torque from driver for determination of bdemodfa" UBYTE rel_ub_b100 1 100 0.00 99.61 FORMAT "%5.2" ECU_ADDRESS 0x60014AEE /end MEASUREMENT
/begin MEASUREMENT misobdembv_msg "engine torque for hysteresis of mode map KFBDEMBV" UBYTE rel_ub_b100 1 100 0.00 99.61 FORMAT "%5.2" ECU_ADDRESS 0x60014AF0 /end MEASUREMENT
/begin MEASUREMENT misobdestracc_msg "misobdestracc_msg" UBYTE rel_ub_b100 1 100 0.00 99.61 FORMAT "%5.2" ECU_ADDRESS 0x6000FB3D /end MEASUREMENT
/begin MEASUREMENT nmotbdembv_msg "engine speed for hysteresis of mode map KFBDEMBV" UBYTE nmot_ub_q40 1 100 0.00 10200. FORMAT "%5.0" ECU_ADDRESS 0x60014AF2 /end MEASUREMENT
/begin MEASUREMENT prioko_msg "Coordinated priority GDI desired mode." UBYTE OneToOne 1 100 0.00 255.0 FORMAT "%5.1" ECU_ADDRESS 0x60014AF5 /end MEASUREMENT
/begin MEASUREMENT tanrm "Normalization factor for intake or air temperature" UBYTE fak_ub_b2 1 100 0.00 1.992188 FORMAT "%8.6" ECU_ADDRESS 0x6000F0BC /end MEASUREMENT
/begin FUNCTION CoEng_VlvLftSpIntk "2.31.0_1.4.0Setpoint Valve Lift Intake"
 /begin DEF_CHARACTERISTIC CoEng_facThdAirmCatHeatg_C CoEng_fakCorrnAltiCvlci_T CoEng_idxExhModTSelVlvLftIntk_C CoEng_nCorrnGearCvlci_T CoEng_nEngShiftLimCvlci_T CoEng_nOffsLimMaxCvlci_C CoEng_nOffsLimMaxFCOCvlci_C CoEng_nOffsLimMinCvlci_C CoEng_nOffsLimMinFCOCvlci_C CoEng_nrCamsftRotShiftCvlci_C CoEng_numGearLo_CA CoEng_ratEngLoadTest_C CoEng_ratLoadFCORstrtCvlci_C CoEng_stCaseCvlci_CA CoEng_stCaseStgyDftCvlci_C CoEng_stEomCvlciAllwd1ModVlvLft0_C CoEng_stEomCvlciAllwd1ModVlvLft1_C CoEng_stEomCvlciAllwd1ModVlvLft2_C CoEng_stEomCvlciAllwd1ModVlvLft3_C CoEng_stEomCvlciAllwd1ModVlvLft4_C CoEng_stEomCvlciAllwd1ModVlvLft5_C CoEng_stEomCvlciAllwd1ModVlvLft6_C CoEng_stEomCvlciAllwd1ModVlvLft7_C CoEng_stEomCvlciAllwd1ModVlvLft8_C CoEng_stEomCvlciAllwd1ModVlvLft9_C CoEng_stEomCvlciAllwd1Prio_T CoEng_stEomCvlciAllwd1Stg_T CoEng_stEomCvlciAllwd2ModVlvLft0_C CoEng_stEomCvlciAllwd2ModVlvLft1_C CoEng_stEomCvlciAllwd2ModVlvLft2_C CoEng_stEomCvlciAllwd2ModVlvLft3_C CoEng_stEomCvlciAllwd2ModVlvLft4_C CoEng_stEomCvlciAllwd2ModVlvLft5_C CoEng_stEomCvlciAllwd2ModVlvLft6_C CoEng_stEomCvlciAllwd2ModVlvLft7_C CoEng_stEomCvlciAllwd2ModVlvLft8_C CoEng_stEomCvlciAllwd2ModVlvLft9_C CoEng_stEomCvlciAllwd2Prio_T CoEng_stEomCvlciAllwd2Stg_T CoEng_stEomCvlciDmdModVlvLft0_C CoEng_stEomCvlciDmdModVlvLft1_C CoEng_stEomCvlciDmdModVlvLft2_C CoEng_stEomCvlciDmdModVlvLft3_C CoEng_stEomCvlciDmdModVlvLft4_C CoEng_stEomCvlciDmdModVlvLft5_C CoEng_stEomCvlciDmdModVlvLft6_C CoEng_stEomCvlciDmdModVlvLft7_C CoEng_stEomCvlciDmdModVlvLft8_C CoEng_stEomCvlciDmdModVlvLft9_C CoEng_stEomCvlciDmdPrio_T CoEng_stEomCvlciDmdStg_T CoEng_stExtVlvLftDmdDftCvlci_C CoEng_stMapInpSel_C CoEng_stMpgLimpVlvLftDmd_T CoEng_stMpgStdLftHwIntk_T CoEng_stShiftDlyCvlci_CA CoEng_stShiftDlyDftCvlci_C CoEng_stSpVlvLftIntkMax_C CoEng_stTrqDemMaskCvlci_C CoEng_stVlvLftDmdAppl1Cvlci_C CoEng_stVlvLftDmdAppl2Cvlci_C CoEng_stVlvLftStgyCvlci_CA CoEng_swtThdAirmCatHeatg_C CoEng_tEngVlvLftIntkHi_C CoEng_tEngVlvLftIntkLo_C CoEng_tExhVlvLftIntkHi_C CoEng_tExhVlvLftIntkLo_C CoEng_tiDlyFrzAftChgCvlci_M CoEng_tiNEngHiHysCvlci_C CoEng_tIntkAirMax_C CoEng_tiShiftOffsCvlci_C CoEng_tiSpChgAftStrt_C CoEng_tiSpdGrdFlt_C CoEng_tiVlvLftDmdAppl1Tog_C CoEng_tiVlvLftDmdAppl2Tog_C CoEng_VlvLftMapCvlci_I.stLoadNRngCvlci_M CoEng_VlvLftMapCvlci_I.stSpCvlci_M CoEng_vVehMinCvlciDeltaHys_C CoEng_vVehMinCvlci_C VLVLFT_SPINTK_ATS.LimitTypeMsk_C VLVLFT_SPINTK_ATS.CnvNorm_C VLVLFT_SPINTK_ATS.LowLim_C VLVLFT_SPINTK_ATS.UpLim_C VLVLFT_SPINTK_ATS.CnvFac_C VLVLFT_SPINTK_ATS.CnvOfs_C VLVLFT_SPINTK_ATS.DfltVal_C /end DEF_CHARACTERISTIC
 /begin REF_CHARACTERISTIC MDNORM /end REF_CHARACTERISTIC
 /begin IN_MEASUREMENT AirMod_ratChrgAirCyl B_fnsoff_msg B_fwloff_msg B_kh_msg B_ldsua_msg CEngDsT_t CoEng_nRstrt CoEng_stMai CoEng_tiStMai_a CoETS_trqInrDetMode DrvPrgSwt_bSprt Epm_dnEngAvgFlt Epm_nEng ExhMgT_facCatHeatgProgs ExhMod_tExhAryB1 frhol_w_msg FuPurg_flgReqVlvFullLftIntk GEVCtl_flgIntkVlvLftEna GEVCtl_flgStdLftHwIntk GlbDa_stTrqDem IntkAirT_tIntkMnfld rlsol_w_msg ThrVlv_flgSngSensErrB1 Tra_nPrdcInpN Tra_numGear VehV_v /end IN_MEASUREMENT
 /begin OUT_MEASUREMENT CoEng_EomCvlciAllwd1_I.stOperMod CoEng_EomCvlciAllwd1_I.stOperModPrio CoEng_EomCvlciAllwd1_I.stOperModStg CoEng_EomCvlciAllwd2_I.stOperMod CoEng_EomCvlciAllwd2_I.stOperModPrio CoEng_EomCvlciAllwd2_I.stOperModStg CoEng_EomCvlciDmd_I.stOperMod CoEng_EomCvlciDmd_I.stOperModPrio CoEng_EomCvlciDmd_I.stOperModStg CoEng_stSpVlvLftIntk /end OUT_MEASUREMENT
 /begin LOC_MEASUREMENT CoEng_dnEngFltLoc CoEng_fakCorrnAltiCvlciXVal CoEng_flgEngTempHi CoEng_flgErrCvlci CoEng_flgFrzSpVlvLftIntk CoEng_flgGearLoCvlci CoEng_flgGevCtlDisadCvlci CoEng_flgIntkAirTempHiCvlci CoEng_flgLimpCvlci CoEng_flgManVlvLftDmdCvlci CoEng_flgNEngHiCvlci CoEng_flgThrVlvPotiDfctCvlci CoEng_flgTrqDemCvlci CoEng_flgVehVMinCvlciHLD_I.hysterese CoEng_idxCaseActvCvlci CoEng_nEngCorrdCvlci CoEng_nEngDelta CoEng_nEngOffsCvlci CoEng_nEngShiftLimCvlci CoEng_ratEngLoad CoEng_ratEngLoadCorrdCvlci CoEng_stCaseCvlci CoEng_stExtVlvLftDmdCvlci CoEng_stMpgLimpVlvLftDmdXVal CoEng_stMpgStdLftHwIntkXVal CoEng_stShftDlyCvlci CoEng_stSpVlvLftIntkBefRels CoEng_stSpVlvLftIntkBefTstr CoEng_stSpVlvLftIntkLoc CoEng_stVlvLftDmdApplCvlci CoEng_stVlvLftStgyActvCvlci CoEng_tExhFldVlvLftIntk CoEng_tiShiftCvlci CoEng_tiVlvLftSpApplTog /end LOC_MEASUREMENT
 FUNCTION_VERSION "2.31.0_1.4.0" /end FUNCTION
/begin FUNCTION CoEOM_Co "100.18.0  Coordinator Engine Operating Modes"
 /begin DEF_CHARACTERISTIC CoEOM_DmdLstSort.CoEOM_ThdConsdrPrio_C CoEOM_EomInhbd_I.stOperModPrio_C CoEOM_EomInhbd_I.stOperModStg_C CoEOM_EomInhbd_I.stOperMod_C CoEOM_EomTest2_I.stOperModPrio_C CoEOM_EomTest2_I.stOperModStg_C CoEOM_EomTest2_I.stOperMod_C CoEOM_EOMTestSpl_C CoEOM_EomTest_I.stOperModPrio_C CoEOM_EomTest_I.stOperModStg_C CoEOM_EomTest_I.stOperMod_C CoEOM_flgEGSDCmnEnaParl_C CoEOM_flgSwtOnEomDmdCSERS_FT CoEOM_flgSwtOnEomDmdParlDiagPsbl_FT CoEOM_flgSwtOnEomDmd_FT CoEOM_idxEGSDCmnVirtDmd_C CoEOM_NegExclsnAlg.CoEOM_ThdHardInhbnPrio_C CoEOM_NegExclsnAlgParDiagPsbl.CoEOM_ThdHardInhbnPrio_C CoEOM_nrFlg2TypMpg_M CoEOM_OperMod2DftEOM_M CoEOM_stDftOperModPrio_C CoEOM_stPrioEomDmd_T CoEOM_stStatPrio_C CoEOM_stTestSplOperModPrio_C CoEOM_tiTogTest1_C CoEOM_tiTogTest2_C /end DEF_CHARACTERISTIC
 /begin REF_CHARACTERISTIC CoEOM_InbnMatModi_a /end REF_CHARACTERISTIC
 /begin IN_MEASUREMENT CoEng_EomCvlciAllwd1_I.stOperMod CoEng_EomCvlciAllwd1_I.stOperModPrio CoEng_EomCvlciAllwd1_I.stOperModStg CoEng_EomCvlciAllwd2_I.stOperMod CoEng_EomCvlciAllwd2_I.stOperModPrio CoEng_EomCvlciAllwd2_I.stOperModStg CoEng_EomCvlciDmd_I.stOperMod CoEng_EomCvlciDmd_I.stOperModPrio CoEng_EomCvlciDmd_I.stOperModStg CoEOM_EomBasis1_I.stOperMod CoEOM_EomBasis1_I.stOperModPrio CoEOM_EomBasis1_I.stOperModStg CoEOM_EomBasis2_I.stOperMod CoEOM_EomBasis2_I.stOperModPrio CoEOM_EomBasis2_I.stOperModStg CoEOM_EomBasis3_I.stOperMod CoEOM_EomBasis3_I.stOperModPrio CoEOM_EomBasis3_I.stOperModStg CoEOM_EomBasisAllwd_I.stOperMod CoEOM_EomBasisAllwd_I.stOperModPrio CoEOM_EomBasisAllwd_I.stOperModStg CoEOM_EomCatHeatgAdpr_I.stOperMod CoEOM_EomCatHeatgAdpr_I.stOperModPrio CoEOM_EomCatHeatgAdpr_I.stOperModStg CoEOM_EomDiagMgr_I.stOperMod CoEOM_EomDiagMgr_I.stOperModPrio CoEOM_EomDiagMgr_I.stOperModStg CoEOM_EomLimp_I.stOperMod CoEOM_EomLimp_I.stOperModPrio CoEOM_EomLimp_I.stOperModStg CoEOM_stEomActvTmng EGSDCmn_EomDmd_I.stOperMod EGSDCmn_EomDmd_I.stOperModPrio EGSDCmn_EomDmd_I.stOperModStg EGSDCmn_flgVirtReqEomParl EGSDCmn_VirtEomDmd_I.stOperMod EGSDCmn_VirtEomDmd_I.stOperModPrio EGSDCmn_VirtEomDmd_I.stOperModStg EngStrt_EomStrt_I.stOperMod EngStrt_EomStrt_I.stOperModPrio EngStrt_EomStrt_I.stOperModStg EngStrt_EomWrmUp1_I.stOperMod EngStrt_EomWrmUp1_I.stOperModPrio EngStrt_EomWrmUp1_I.stOperModStg EngStrt_EomWrmUp2_I.stOperMod EngStrt_EomWrmUp2_I.stOperModPrio EngStrt_EomWrmUp2_I.stOperModStg EngStrt_EomWrmUp3_I.stOperMod EngStrt_EomWrmUp3_I.stOperModPrio EngStrt_EomWrmUp3_I.stOperModStg ExhMgT_CatHeatg1_I.stOperMod ExhMgT_CatHeatg1_I.stOperModPrio ExhMgT_CatHeatg1_I.stOperModStg ExhMgT_CatHeatg2_I.stOperMod ExhMgT_CatHeatg2_I.stOperModPrio ExhMgT_CatHeatg2_I.stOperModStg ExhMgT_CatHeatg3_I.stOperMod ExhMgT_CatHeatg3_I.stOperModPrio ExhMgT_CatHeatg3_I.stOperModStg ExhMgT_flgCatHeatgCsers FuPHi_EomHiPSnsrDiag_I.stOperMod FuPHi_EomHiPSnsrDiag_I.stOperModPrio FuPHi_EomHiPSnsrDiag_I.stOperModStg InjSys_EomCvoAllwd_I.stOperMod InjSys_EomCvoAllwd_I.stOperModPrio InjSys_EomCvoAllwd_I.stOperModStg /end IN_MEASUREMENT
 /begin OUT_MEASUREMENT CoEOM_flgEGSDCmnVirtDmdActv CoEOM_flgEomActvInhb CoEOM_idxEomAct CoEOM_idxEomDmdSeld CoEOM_idxEomStgAct CoEOM_stDeadlck CoEOM_stEomDes CoEOM_stEOMDesNonCsers CoEOM_stEomDest CoEOM_typCoornCSERS_a CoEOM_typCoornParDiagPsbl_a CoEOM_typCoorn_a /end OUT_MEASUREMENT
 /begin LOC_MEASUREMENT CoEOM_EomDmdLstSortCSERS_I.idx_a CoEOM_EomDmdLstSortCSERS_I.nrPrio_a CoEOM_EomDmdLstSortCSERS_I.stEom_a CoEOM_EomDmdLstSortCSERS_I.stStg_a CoEOM_EomDmdLstSortCSERS_I.typDescr_a CoEOM_EomDmdLstSortParDiagPsbl_I.idx_a CoEOM_EomDmdLstSortParDiagPsbl_I.nrPrio_a CoEOM_EomDmdLstSortParDiagPsbl_I.stEom_a CoEOM_EomDmdLstSortParDiagPsbl_I.stStg_a CoEOM_EomDmdLstSortParDiagPsbl_I.typDescr_a CoEOM_EomDmdLstSort_I.idx_a CoEOM_EomDmdLstSort_I.nrPrio_a CoEOM_EomDmdLstSort_I.stEom_a CoEOM_EomDmdLstSort_I.stStg_a CoEOM_EomDmdLstSort_I.typDescr_a CoEOM_flgCsersActv CoEOM_flgTogValLoc CoEOM_idxEomDmdSeldLoc CoEOM_idxEomSeldLoc CoEOM_idxEomStgSeldLoc CoEOM_nrPrioSeldLoc CoEOM_stInhbnSeldLoc CoEOM_stOperModDft /end LOC_MEASUREMENT
 FUNCTION_VERSION "100.18.0" /end FUNCTION
/begin FUNCTION CoEOM_Conf "103.2.0_1.3.0Configuration CoEOM"
 /begin DEF_CHARACTERISTIC CoEOM_EomMtrx_M CoEOM_stCmb_M CoEOM_stInjr_M CoEOM_stOpSt_M CoEOM_stVlvLft_M /end DEF_CHARACTERISTIC
 /begin IN_MEASUREMENT CoEOM_idxEomAct CoEOM_idxEomStgAct /end IN_MEASUREMENT
 FUNCTION_VERSION "103.2.0_1.3.0" /end FUNCTION
/begin FUNCTION CoEOM_Lcy2Vld "1.20.0    SW Adapter Coordinator Engine Operating Modes : Mapping Legacy to Valid Interface Elements"
 /begin DEF_CHARACTERISTIC CoEOM_stCatHeatgFinshd_C CoEOM_stDiagMgr_C CoEOM_stEomCatHeatg_C CoEOM_stEomDiagMgr_C CoEOM_stEomLimp_C CoEOM_stEomWrmUp_C CoEOM_stLimp_C CoEOM_stPrioCatHeatg_C CoEOM_stPrioDiagMgr_C CoEOM_stPrioLimp_C CoEOM_stPrioWrmUp_C CoEOM_stStgCatHeatg_T CoEOM_stStgDiagMgr_T CoEOM_stStgLimp_T CoEOM_stStgWrmUp_T CoEOM_stWrmUpFinshd_C /end DEF_CHARACTERISTIC
 /begin IN_MEASUREMENT bdemodkh_msg bdemodnl_msg bdemodst_msg B_mwagr_msg B_mwrlsta_msg B_mwte_msg B_vhenwspe_msg DSM_stOpMDes /end IN_MEASUREMENT
 /begin OUT_MEASUREMENT CoEOM_EomCatHeatgAdpr_I.stOperMod CoEOM_EomCatHeatgAdpr_I.stOperModPrio CoEOM_EomCatHeatgAdpr_I.stOperModStg CoEOM_EomDiagMgr_I.stOperMod CoEOM_EomDiagMgr_I.stOperModPrio CoEOM_EomDiagMgr_I.stOperModStg CoEOM_EomLimp_I.stOperMod CoEOM_EomLimp_I.stOperModPrio CoEOM_EomLimp_I.stOperModStg CoEOM_EomWrmUpAdpr_I.stOperMod CoEOM_EomWrmUpAdpr_I.stOperModPrio CoEOM_EomWrmUpAdpr_I.stOperModStg CoEOM_flgRelAirStatyEomChg CoEOM_stTrigAckd /end OUT_MEASUREMENT
 /begin LOC_MEASUREMENT CoEOM_stEomCatHeatSrcLcyToVld CoEOM_stEomLimpSrcLcyToVld CoEOM_stEomStrtSrcLcyToVld /end LOC_MEASUREMENT
 FUNCTION_VERSION "1.20.0" /end FUNCTION
/begin FUNCTION CoEOM_OperModReq "100.18.0  Function for requesting Engine Operating Modes"
 /begin DEF_CHARACTERISTIC CoEOM_EomBas1Hys_I.idxSt_MAP CoEOM_EomBas2Hys_I.idxSt_MAP CoEOM_EomBasAllwdHys_I.idxSt_MAP CoEOM_nHysDeltaEomBasis_C CoEOM_ratEngLoadReqTest_C CoEOM_ratHysDelta_C CoEOM_stBasis3_C CoEOM_stEomAllwdPrio_C CoEOM_stEomAllwd_C CoEOM_stEomBasis1Prio_C CoEOM_stEomBasis2Prio_C CoEOM_stEomBasis3Prio_C CoEOM_stEomBasis_C CoEOM_stOperModInpSel_C /end DEF_CHARACTERISTIC
 /begin REF_CHARACTERISTIC MDNORM /end REF_CHARACTERISTIC
 /begin IN_MEASUREMENT CoETS_trqInrDetMode CoETS_trqInrDetModeFild Epm_nEng /end IN_MEASUREMENT
 /begin OUT_MEASUREMENT CoEOM_EomBasis1_I.stOperMod CoEOM_EomBasis1_I.stOperModPrio CoEOM_EomBasis1_I.stOperModStg CoEOM_EomBasis2_I.stOperMod CoEOM_EomBasis2_I.stOperModPrio CoEOM_EomBasis2_I.stOperModStg CoEOM_EomBasis3_I.stOperMod CoEOM_EomBasis3_I.stOperModPrio CoEOM_EomBasis3_I.stOperModStg CoEOM_EomBasisAllwd_I.stOperMod CoEOM_EomBasisAllwd_I.stOperModPrio CoEOM_EomBasisAllwd_I.stOperModStg CoEOM_percEngLoad /end OUT_MEASUREMENT
 /begin LOC_MEASUREMENT CoEng_facTq2Perc CoEOM_EomBas1Hys_I.idxDistbnXOld CoEOM_EomBas1Hys_I.idxDistbnYOld CoEOM_EomBas2Hys_I.idxDistbnXOld CoEOM_EomBas2Hys_I.idxDistbnYOld CoEOM_EomBasAllwdHys_I.idxDistbnXOld CoEOM_EomBasAllwdHys_I.idxDistbnYOld CoEOM_ratInpHyst CoEOM_stEomBasis1 CoEOM_stEomBasis2 CoEOM_stEomBasisAllwd /end LOC_MEASUREMENT
 FUNCTION_VERSION "100.18.0" /end FUNCTION
/begin FUNCTION CoEOM_Srv "1.12.0    Services and Library elements for the new EOM structure" /begin REF_CHARACTERISTIC CoEOM_stEomDesReqd_AX /end REF_CHARACTERISTIC FUNCTION_VERSION "1.12.0" /end FUNCTION
/begin FUNCTION CoEOM_Swt "2.13.0_1.1.0ICE Mode Control: Coordination of the Switch-over"
 /begin DEF_CHARACTERISTIC CoEOM_dmCvlc_C CoEOM_flgActvdEomSwtIniStrt_C CoEOM_flgEnblSwtStgyStrt_C CoEOM_idxSwtStgySeld_M CoEOM_InbnMatModi_a CoEOM_stEnblEomSwt_C CoEOM_stEomActv_AX CoEOM_stEomDesReqd_AX CoEOM_stEOMIni_C CoEOM_stEomStgyIgnRels_C CoEOM_stPhaEomIgnRels_C CoEOM_stThdPhaEomShiftMax_C CoEOM_stThdPhaEomShiftMin_C CoEOM_SwtStgy1.stTrigAftSwt_C CoEOM_SwtStgy1.tiMaxAirStaty_C CoEOM_SwtStgy2.stTrigAftSwt_C CoEOM_SwtStgy2.stTrig_C CoEOM_SwtStgy2.tiMaxAirPrep_C CoEOM_SwtStgy2.tiMaxAirStaty_C CoEOM_SwtStgy2.tiMaxTrigAckd_C CoEOM_SwtStgy5.stTrigAftSwt_C CoEOM_SwtStgy5.stTrig_C CoEOM_SwtStgy5.tiMaxAirStaty_C CoEOM_SwtStgy5.tiMaxTrigAckd_C CoEOM_SwtStgy_I.OperMod2Idx_M CoEOM_trqInrLimDelta_C /end DEF_CHARACTERISTIC
 /begin IN_MEASUREMENT AirMod_ratChrgDeltaSwtAirSys CoEng_stMai CoEOM_flgRelAirStatyEomChg CoEOM_stEomDes CoEOM_stTrigAckd Epm_stSync fmi2trq_w_msg Gen_ctCylAdv GEVCtl_nrCylSyncVlvLftIntk InjSys_idxNxtCylAdv PthSet_trqInrLim TMERng_ratTqBascPred Veh_flgDyn /end IN_MEASUREMENT
 /begin OUT_MEASUREMENT CoEOM_flgEomIgnRels CoEOM_flgEomSwtActv CoEOM_flgEomTrigAirStaty CoEOM_flgTqCalcnReqd CoEOM_idxSwtStgySeld CoEOM_stEom CoEOM_stEomActv CoEOM_stEomActvTmng CoEOM_stEomCylAdv_a CoEOM_stEomTar CoEOM_stEomTarActr CoEOM_stEomTarAirSys CoEOM_stEomTarHw CoEOM_stEomTarInj CoEOM_stEomTarLbk CoEOM_stPhaEomShift CoEOM_stTrigActvt /end OUT_MEASUREMENT
 /begin LOC_MEASUREMENT CoEOM_ctCylAdv CoEOM_ctCylAdvTmng CoEOM_flgCylAdvCalcd CoEOM_flgCylAdvCalcdTmng CoEOM_flgEnbEomSwtOld CoEOM_flgEomSwtDes CoEOM_flgEomSwtIniDesLoc CoEOM_flgEomSwtIniLoc CoEOM_flgNxtCylCalcnTrig CoEOM_flgTmngExeSync CoEOM_flgTmngFinshed CoEOM_idxGroupEomActv CoEOM_idxGroupEomDes CoEOM_idxSwtStgyM CoEOM_idxSwtStgySeldLoc CoEOM_nrPrdnHoz CoEOM_stEomActvLoc CoEOM_stEomActvTmngLoc CoEOM_stEomDesReqdLoc CoEOM_stEomLoc CoEOM_stEomTarActrLoc CoEOM_stEomTarAirSysLoc CoEOM_stEomTarHwLoc CoEOM_stEomTarInjLoc CoEOM_stEomTarLbkLoc CoEOM_stEomTarLoc CoEOM_stEomTarPrev CoEOM_stPhaEomShiftLoc CoEOM_stTrigActvtLoc CoEOM_SwtStgy1.flgEomSwtDes CoEOM_SwtStgy1.flgRelAirStatyEomChg CoEOM_SwtStgy1.flgTmngFinshed CoEOM_SwtStgy1.flgWrStEomActv CoEOM_SwtStgy1.flgWrStEomActvTmng CoEOM_SwtStgy1.flgWrStEomTarActr CoEOM_SwtStgy1.flgWrStEomTarAirSys CoEOM_SwtStgy1.flgWrStEomTarHw CoEOM_SwtStgy1.flgWrStEomTarInj CoEOM_SwtStgy1.flgWrStEomTarLbk CoEOM_SwtStgy1.sm CoEOM_SwtStgy1.stPhaEomShift CoEOM_SwtStgy1.stTrigActvt CoEOM_SwtStgy1.tiSwt CoEOM_SwtStgy2.flgEomSwtDes CoEOM_SwtStgy2.flgRelAirStatyEomChg CoEOM_SwtStgy2.flgTmngFinshed CoEOM_SwtStgy2.flgTqCalcnAckd CoEOM_SwtStgy2.flgWrStEomActv CoEOM_SwtStgy2.flgWrStEomActvTmng CoEOM_SwtStgy2.flgWrStEomTarActr CoEOM_SwtStgy2.flgWrStEomTarAirSys CoEOM_SwtStgy2.flgWrStEomTarHw CoEOM_SwtStgy2.flgWrStEomTarInj CoEOM_SwtStgy2.flgWrStEomTarLbk CoEOM_SwtStgy2.sm CoEOM_SwtStgy2.stPhaEomShift CoEOM_SwtStgy2.stTrigAckd CoEOM_SwtStgy2.stTrigActvt CoEOM_SwtStgy2.tiSwt CoEOM_SwtStgy5.flgEomSwtDes CoEOM_SwtStgy5.flgRelAirStatyEomChg CoEOM_SwtStgy5.flgTmngFinshed CoEOM_SwtStgy5.flgWrStEomActv CoEOM_SwtStgy5.flgWrStEomActvTmng CoEOM_SwtStgy5.flgWrStEomTarActr CoEOM_SwtStgy5.flgWrStEomTarAirSys CoEOM_SwtStgy5.flgWrStEomTarHw CoEOM_SwtStgy5.flgWrStEomTarInj CoEOM_SwtStgy5.flgWrStEomTarLbk CoEOM_SwtStgy5.sm CoEOM_SwtStgy5.stPhaEomShift CoEOM_SwtStgy5.stTrigAckd CoEOM_SwtStgy5.stTrigActvt CoEOM_SwtStgy5.tiSwt CoEOM_tiSwt CoEOM_tiSwtSWT_I.tiStrd /end LOC_MEASUREMENT
 FUNCTION_VERSION "2.13.0_1.1.0" /end FUNCTION
/begin FUNCTION CoEOM_SwtTSync "11.0.0    time synchron task of coordination engine operation modes" /begin IN_MEASUREMENT CoEOM_flgHsp /end IN_MEASUREMENT /begin OUT_MEASUREMENT B_hspnwss_msg /end OUT_MEASUREMENT FUNCTION_VERSION "11.0.0" /end FUNCTION
/begin FUNCTION CoEOM_Vld2Lcy "100.18.0_1.1.0Interface adapter MC CoEOM to old software"
 /begin DEF_CHARACTERISTIC CoEOM_BdeLcyMpg_I.OperMod2Idx_M CoEOM_flgEomInterHosPln_C CoEOM_stEomVldLcySwt_C CoEOM_stGDIStgHSP_I.OperMod2Idx_M CoEOM_stPhaEomShift2_C CoEOM_stPhaEomShift_C CoEOM_VheLcyMpg_I.OperMod2Idx_M CWBDESTHSP KLBDEMTAFC /end DEF_CHARACTERISTIC
 /begin IN_MEASUREMENT B_rlvheg_msg CoEOM_EomBasis1_I.stOperMod CoEOM_EomBasis1_I.stOperModPrio CoEOM_EomBasis1_I.stOperModStg CoEOM_flgEomActvInhb CoEOM_flgEomIgnRels CoEOM_flgEomTrigAirStaty CoEOM_flgRelAirStatyEomChg CoEOM_flgTqCalcnReqd CoEOM_idxSwtStgySeld CoEOM_stEom CoEOM_stEomActv CoEOM_stEomCylAdv_a CoEOM_stEomDest CoEOM_stEomTar CoEOM_stEomTarActr CoEOM_stEomTarAirSys CoEOM_stEomTarHw CoEOM_stEomTarInj CoEOM_stPhaEomShift CoEOM_stTrigActvt Epm_nEng GEVCtl_flgStdLftSyncIntk GEVCtl_nrCylSyncVlvLftIntk IntkAirT_tThrVlvUs mivbeb_w_msg /end IN_MEASUREMENT
 /begin OUT_MEASUREMENT bdehspstf_msg bdemagrs bdemagrs_msg bdemfes_msg bdemlbks bdemodbv_msg bdemodfaOld_msg bdemodfa_msg bdemodmd_msg bdemodrdnt_msg bdemods_msg bdemods_w_msg bdemodvkh_msg bdemodvrbt_msg bdemodz_msg bdemod_msg bdemsus B_baschs_msg B_basch_msg B_bdemodfa_msg B_bdemz_msg B_bderlsts_msg B_bdetes_msg B_berhom_msg B_bersch_msg B_berskh_msg B_eahoms_msg B_eahom_msg B_easchs_msg B_easch_msg B_hksab_msg B_hksagrs_msg B_hksen_msg B_hksfes_msg B_hkss_msg B_hksz_msg B_hmmagrs_msg B_hmmen_msg B_hmmfes_msg B_hmms_msg B_hmmz_msg B_homagrs_msg B_homen_msg B_homfes_msg B_homs_msg B_homz_msg B_hosagrs_msg B_hosen_msg B_hosfes_msg B_hoss_msg B_hosz_msg B_hos_msg B_hsgm_msg B_hspagrs_msg B_hspen_msg B_hspfes_msg B_hsps_msg B_hspz_msg B_mwab_msg B_mwagrs_msg B_mwnwss_msg B_mwuss_msg B_nobdem_msg B_scgm_msg B_schagrs_msg B_schen_msg B_schfes_msg B_schs_msg B_schz_msg B_skhagrs_msg B_skhfes_msg B_skhs B_skhs_msg B_skhz_msg B_ubaov_msg B_umhomsch_msg B_umschhom_msg B_vhegfes_msg B_vhegs_msg B_vhegtes_msg B_vhegvse_msg B_vhegvss_msg B_vheg_msg B_vheinst_msg B_vhenwsspe_msg B_vherlsts_msg B_zwschfes_msg B_zwschs_msg CoEng_flgDesEomDsm CoEng_flgDesEomLimp CoEng_flgDesEomNsc CoEOM_bHLN CoEOM_bHOM CoEOM_bIASTF CoEOM_bSPC CoEOM_bTransActv CoEOM_flgDesEomAbort CoEOM_flgDesTqAdjmt CoEOM_flgEomInterHosPln CoEOM_flgHkp CoEOM_flgHosAllwdExcpn CoEOM_flgHsp CoEOM_flgProlgSlip CoEOM_flgStrat CoEOM_flgUnstyShftPred CoEOM_stEomTarPostProlgSlip CoEOM_stOpMAct CoEOM_stOpMPos dmiagk_w_msg hymbdefa_msg misobdembv_msg misobdestracc_msg nmotbdembv_msg prioko_msg /end OUT_MEASUREMENT
 /begin LOC_MEASUREMENT bdehspstf_tmp bdemodfa_tmp bdemods_tmp bdemods_w_tmp bdemodz_tmp B_bdeminst_tmp CoEOM_tAirMnfldUsThrAdpr tanrm /end LOC_MEASUREMENT
 FUNCTION_VERSION "100.18.0_1.1.0" /end FUNCTION
/begin FUNCTION CoESS_Dem "52.0.0    Coordinator of electrical supply system"
 /begin DEF_CHARACTERISTIC CoESS_iElecLdRstLe_C CoESS_iElecLdRstRht_C CoESS_iElecLdThres_C CoESS_iEPSLdLe1_C CoESS_iEPSLdLe2_C CoESS_iEPSLdRht1_C CoESS_iEPSLdRht2_C CoESS_nIdlBattThres_C CoESS_nMax_C CoESS_nMin1Batt_C CoESS_nMin2Batt_C CoESS_nMin3Batt_C CoESS_nMin4Batt_C CoESS_nMin5Batt_C CoESS_nMinAltLoad_C CoESS_nMinThres_C CoESS_swtElecLdSel_C CoESS_tiAltIdleUp_C CoESS_tiHiLoBattRst_C CoESS_tiHiLoBattSet_C CoESS_tiHiLoEngSet_C CoESS_tiLoHiBattRst_C CoESS_tiLoHiBattSet_C CoESS_tiLoHiEngSet_C CoESS_uIdlBattThresRst_C CoESS_uIdlBattThresSet_C CoESS_vMinThres_C /end DEF_CHARACTERISTIC
 /begin IN_MEASUREMENT Alt_flgAltLoadIdleUpReq Alt_stDchaAltUpprLimStk Alt_trqDes Alt_trqResv Batt_bEngStopEna Batt_bEngStrtReq CoEng_st ElecLd_iEPSLd ElecLd_iLd Epm_nEng ESS_uBatt GlbDa_vX HLSDem_nSetPLo PT_bNoGrip PT_stTraType SpdGov_nSetPLo SyC_ctPostDrvLeave Tra_flgNeutPrkg /end IN_MEASUREMENT
 /begin OUT_MEASUREMENT ESS_bEngStopEna ESS_bEngStrtReq ESS_nMax ESS_nMin ESS_trqDesAcs ESS_trqResvAcs /end OUT_MEASUREMENT
 /begin LOC_MEASUREMENT CoESS_cntrReIni CoESS_nMinAltIdleUp /end LOC_MEASUREMENT
 FUNCTION_VERSION "52.0.0" /end FUNCTION
/begin FUNCTION CoESS_Ord "2.9.0     Order of the electrical supply system coordinator" /begin IN_MEASUREMENT CoVeh_stAlt /end IN_MEASUREMENT /begin OUT_MEASUREMENT CoESS_stAlt /end OUT_MEASUREMENT FUNCTION_VERSION "2.9.0" /end FUNCTION
/begin FUNCTION CoESS_RecupUReq "7.0.0     Minimum Voltage Request for 12V Recuperation"
 /begin DEF_CHARACTERISTIC CoESS_stRampDeActv_C CoESS_tiBlowrRampInvld_C CoESS_tiFilUACGUpReq_C CoESS_tiFrntBlowrRamp_T CoESS_tiMICUTxBlowrRamp_T CoESS_tiRrBlowrRamp_T CoESS_uACGUpNoReq_C CoESS_uACGUpReq_C CoESS_uBlowrFanHysHi_C CoESS_uBlowrFanHysLo_C CoESS_uBlowrFanManHi_C CoESS_uBlowrFanManLo_C CoESS_uBlowrTarManLowr_C CoESS_uBlowrTarManUppr_C CoESS_uBlowrTarUHysLowr_C CoESS_uBlowrTarUHysUppr_C CoESS_uFrntBlowrDes_T CoESS_uMICUTxBlowrDes_T CoESS_uMinPsp_M CoESS_uRrBlowrDes_T /end DEF_CHARACTERISTIC
 /begin IN_MEASUREMENT Alt_uDes Blwr_uVoltReq Com_stACGUpReq Com_uFrntBlowrU Com_uMICUTxBlowrU Com_uRrBlowrU ElecLd_stAutoAC Epm_nEng T15_st tfuelsq /end IN_MEASUREMENT
 /begin OUT_MEASUREMENT CoESS_flgUReq CoESS_uBlowrUMinReq CoESS_uBlowrUUnRampUnfild CoESS_uFuPmpMinReq CoESS_uMinReq CoESS_uSlopRampVal /end OUT_MEASUREMENT
 /begin LOC_MEASUREMENT CoESS_flgBlowrFanSlopReq CoESS_tiBlowrRampVal CoESS_tiFrntBlowrRamp CoESS_tiMICUTxBlowrRamp CoESS_tiRrBlowrRamp CoESS_uACGUpMinReq CoESS_uFrntBlowrDes CoESS_uMaxBlowrDes CoESS_uMICUTxBlowrDes CoESS_uRrBlowrDes /end LOC_MEASUREMENT
 FUNCTION_VERSION "7.0.0" /end FUNCTION
/begin COMPU_METHOD B_TRUE "" TAB_VERB "%6.3" "" COMPU_TAB_REF B_TRUE /end COMPU_METHOD
/begin COMPU_VTAB B_TRUE "" TAB_VERB 2 0 "FALSE" 1 "TRUE" /end COMPU_VTAB
/begin COMPU_METHOD CoEng_CaseCvlci_COMPU_VERB "" TAB_VERB "%6.3" "" COMPU_TAB_REF CoEng_CaseCvlci_COMPU_VERB /end COMPU_METHOD
/begin COMPU_VTAB CoEng_CaseCvlci_COMPU_VERB "" TAB_VERB 30 1 "FId_CoEngVlvLftSpIntk" 2 "LimpHome" 3 "VlvLftDisad" 4 "EngStrtCold" 5 "EngSpdHi" 6 "EngStop" 7 "CmshftAdpn" 8 "OperMode" 9 "Scavenging" 10 "ExhTempHi" 11 "EngTempHi" 12 "WarmUp" 13 "CatHeat" 14 "SportMode" 15 "EcoMode" 16 "EngFuelCutOff" 17 "VehSpdLo" 18 "n/a" 19 "FuelPurge" 20 "TrqDem" 21 "EngStrt" 255 "Unused" 22 "EngOff" 23 "ManVlvLft" 24 "GearLo" 25 "IntkAirTempHi" 26 "GearShiftActv" 27 "GpfRgn" 28 "ThrVlvPotiDfct" 29 "NVH" /end COMPU_VTAB
/begin COMPU_METHOD CoEng_EngWpCvlci_COMPU_VERB "" TAB_VERB "%6.3" "" COMPU_TAB_REF CoEng_EngWpCvlci_COMPU_VERB /end COMPU_METHOD
/begin COMPU_VTAB CoEng_EngWpCvlci_COMPU_VERB "" TAB_VERB 21 0 "Rng_0" 1 "Rng_1" 2 "Rng_2" 3 "Rng_3" 4 "Rng_4" 5 "Rng_5" 6 "Rng_6" 7 "Rng_7" 8 "Rng_8" 9 "Rng_9" 10 "Rng_10" 11 "Rng_11" 12 "Rng_12" 13 "Rng_13" 14 "Rng_14" 15 "Rng_15" 16 "Rng_16" 17 "Rng_17" 18 "Rng_18" 19 "Rng_19" 20 "Rng_20" /end COMPU_VTAB
/begin COMPU_METHOD CoEng_ShiftDlyCvlci_COMPU_VERB "" TAB_VERB "%6.3" "" COMPU_TAB_REF CoEng_ShiftDlyCvlci_COMPU_VERB /end COMPU_METHOD
/begin COMPU_VTAB CoEng_ShiftDlyCvlci_COMPU_VERB "" TAB_VERB 2 0 "NoShiftDly" 1 "ShiftDly" /end COMPU_VTAB
/begin COMPU_METHOD CoEng_VlvLftStgyCvlci_COMPU_VERB "" TAB_VERB "%6.3" "" COMPU_TAB_REF CoEng_VlvLftStgyCvlci_COMPU_VERB /end COMPU_METHOD
/begin COMPU_VTAB CoEng_VlvLftStgyCvlci_COMPU_VERB "" TAB_VERB 27 100 "MapStgy_0" 101 "MapStgy_1" 102 "MapStgy_2" 103 "MapStgy_3" 104 "MapStgy_4" 105 "MapStgy_5" 106 "MapStgy_6" 107 "MapStgy_7" 108 "MapStgy_8" 109 "MapStgy_9" 110 "MapStgy_10" 111 "MapStgy_11" 112 "MapStgy_12" 113 "MapStgy_13" 114 "MapStgy_14" 0 "FixLft_0" 1 "FixLft_1" 2 "FixLft_2" 3 "FixLft_3" 4 "FixLft_4" 5 "FixLft_5" 6 "FixLft_6" 7 "FixLft_7" 8 "FixLft_8" 9 "FixLft_9" 254 "ExtDmd" 255 "NoShift" /end COMPU_VTAB
/begin COMPU_METHOD CoEng_VlvLftStgyFixCvlci_COMPU_VERB "" TAB_VERB "%6.3" "" COMPU_TAB_REF CoEng_VlvLftStgyFixCvlci_COMPU_VERB /end COMPU_METHOD
/begin COMPU_VTAB CoEng_VlvLftStgyFixCvlci_COMPU_VERB "" TAB_VERB 11 0 "FixLft_0" 1 "FixLft_1" 2 "FixLft_2" 3 "FixLft_3" 4 "FixLft_4" 5 "FixLft_5" 6 "FixLft_6" 7 "FixLft_7" 8 "FixLft_8" 9 "FixLft_9" 255 "NoShift" /end COMPU_VTAB
/begin COMPU_METHOD CoEng_VlvLftStgyMapCvlci_COMPU_VERB "" TAB_VERB "%6.3" "" COMPU_TAB_REF CoEng_VlvLftStgyMapCvlci_COMPU_VERB /end COMPU_METHOD
/begin COMPU_VTAB CoEng_VlvLftStgyMapCvlci_COMPU_VERB "" TAB_VERB 15 100 "MapStgy_0" 101 "MapStgy_1" 102 "MapStgy_2" 103 "MapStgy_3" 104 "MapStgy_4" 105 "MapStgy_5" 106 "MapStgy_6" 107 "MapStgy_7" 108 "MapStgy_8" 109 "MapStgy_9" 110 "MapStgy_10" 111 "MapStgy_11" 112 "MapStgy_12" 113 "MapStgy_13" 114 "MapStgy_14" /end COMPU_VTAB
/begin COMPU_METHOD CoEOM_idxOperModCfgd_VERB "" TAB_VERB "%6.3" "-" COMPU_TAB_REF CoEOM_idxOperModCfgd_VERB /end COMPU_METHOD
/begin COMPU_VTAB CoEOM_idxOperModCfgd_VERB "" TAB_VERB 4 0 "Base" 1 "WarmUp" 2 "CatHtg" 3 "Start" /end COMPU_VTAB
/begin COMPU_METHOD CoEOM_idxOperModStgTot_VERB "" TAB_VERB "%6.3" "-" COMPU_TAB_REF CoEOM_idxOperModStgTot_VERB /end COMPU_METHOD
/begin COMPU_VTAB CoEOM_idxOperModStgTot_VERB "" TAB_VERB 16 0 "HOM-SNGL_FullLft" 1 "HOM_FullLft" 2 "HSP_FullLft" 3 "HSPIC_FullLft" 4 "HOM-SNGL_EIVC" 5 "HOM_EIVC" 6 "HSP_EIVC" 7 "HSPIC_EIVC" 8 "Stage 8" 9 "Stage 9" 10 "Stage 10" 11 "Stage 11" 12 "Stage 12" 13 "Stage 13" 14 "Stage 14" 15 "Stage 15" /end COMPU_VTAB
/begin COMPU_METHOD CoEOM_idxOperModTot_VERB "" TAB_VERB "%6.3" "-" COMPU_TAB_REF CoEOM_idxOperModTot_VERB /end COMPU_METHOD
/begin COMPU_VTAB CoEOM_idxOperModTot_VERB "" TAB_VERB 32 0 "Base" 1 "WarmUp" 2 "CatHtg" 3 "Start" 4 "n/a (4)" 5 "n/a (5)" 6 "n/a (6)" 7 "n/a (7)" 8 "n/a (8)" 9 "n/a (9)" 10 "n/a (10)" 11 "n/a (11)" 12 "n/a (12)" 13 "n/a (13)" 14 "n/a (14)" 15 "n/a (15)" 16 "n/a (16)" 17 "n/a (17)" 18 "n/a (18)" 19 "n/a (19)" 20 "n/a (20)" 21 "n/a (21)" 22 "n/a (22)" 23 "n/a (23)" 24 "n/a (24)" 25 "n/a (25)" 26 "n/a (26)" 27 "n/a (27)" 28 "n/a (28)" 29 "n/a (29)" 30 "n/a (30)" 31 "n/a (31)" /end COMPU_VTAB
/begin COMPU_METHOD CoEOM_OperMod_Set_COMPU_VERB "" TAB_VERB "%6.3" "-" COMPU_TAB_REF CoEOM_OperMod_Set_COMPU_VERB /end COMPU_METHOD
/begin COMPU_VTAB CoEOM_OperMod_Set_COMPU_VERB "" TAB_VERB 25 0 "CoEOM_EomDft_I" 1 "CoEOM_EomBasis3_I" 2 "CoEOM_EomBasis2_I" 3 "CoEOM_EomBasis1_I" 4 "EGSDCmn_VirtEomDmd_I" 5 "EGSDCmn_EomDmd_I" 6 "FuPHi_EomHiPSnsrDiag_I" 7 "CoEOM_EomDiagMgr_I" 8 "EngStrt_EomWrmUp3_I" 9 "EngStrt_EomWrmUp2_I" 10 "EngStrt_EomWrmUp1_I" 11 "CoEOM_EomCatHeatgAdpr_I" 12 "ExhMgT_CatHeatg3_I" 13 "ExhMgT_CatHeatg2_I" 14 "ExhMgT_CatHeatg1_I" 15 "CoEng_EomCvlciDmd_I" 16 "InjSys_EomCvoAllwd_I" 17 "CoEOM_EomBasisAllwd_I" 18 "CoEng_EomCvlciAllwd2_I" 19 "CoEng_EomCvlciAllwd1_I" 20 "CoEOM_EomLimp_I" 21 "CoEOM_EomTestSpl_I" 22 "CoEOM_EomTest_I" 23 "EngStrt_EomStrt_I" 24 "CoEOM_EomInhbd_I" /end COMPU_VTAB
/begin COMPU_METHOD CoEOM_stEomCmb_VERB "" TAB_VERB "%6.3" "" COMPU_TAB_REF CoEOM_stEomCmb_VERB /end COMPU_METHOD
/begin COMPU_VTAB CoEOM_stEomCmb_VERB "" TAB_VERB 9 0 "n/a [0]" 1 "HOM" 2 "HMM" 4 "HOS" 8 "SCH" 16 "SKH" 32 "n/a [6]" 64 "HSP" 128 "HKS" /end COMPU_VTAB
/begin COMPU_METHOD CoEOM_stEomInjr_VERB "" TAB_VERB "%6.3" "" COMPU_TAB_REF CoEOM_stEomInjr_VERB /end COMPU_METHOD
/begin COMPU_VTAB CoEOM_stEomInjr_VERB "" TAB_VERB 7 0 "n/a [0]" 1 "GDI" 4 "PFI" 8 "CNG" 16 "LPG" 32 "n/a [5]" 2 "PDI" /end COMPU_VTAB
/begin COMPU_METHOD CoEOM_stEomOpSt_VERB "" TAB_VERB "%6.3" "" COMPU_TAB_REF CoEOM_stEomOpSt_VERB /end COMPU_METHOD
/begin COMPU_VTAB CoEOM_stEomOpSt_VERB "" TAB_VERB 7 0 "n/a[0]" 1 "Base" 2 "WrmUp" 4 "CatHtg" 8 "Start" 16 "GPFRgn" 32 "Limp" /end COMPU_VTAB
/begin COMPU_METHOD CoEOM_stEomStgCfgdExtn_VERB "" TAB_VERB "%6.3" "-" COMPU_TAB_REF CoEOM_stEomStgCfgdExtn_VERB /end COMPU_METHOD
/begin COMPU_VTAB CoEOM_stEomStgCfgdExtn_VERB "" TAB_VERB 27 0 "Base_HOM-SNGL_FullLft" 1 "Base_HOM_FullLft" 2 "Base_HSP_FullLft" 3 "Base_HSPIC_FullLft" 4 "Base_HOM-SNGL_EIVC" 5 "Base_HOM_EIVC" 6 "Base_HSP_EIVC" 7 "Base_HSPIC_EIVC" 255 "No_Demand" 256 "WarmUp_HOM-SNGL_FullLft" 257 "WarmUp_HOM_FullLft" 258 "WarmUp_HSP_FullLft" 259 "WarmUp_HSPIC_FullLft" 260 "WarmUp_HOM-SNGL_EIVC" 261 "WarmUp_HOM_EIVC" 262 "WarmUp_HSP_EIVC" 263 "WarmUp_HSPIC_EIVC" 512 "CatHtg_HOM-SNGL_FullLft" 513 "CatHtg_HOM_FullLft" 514 "CatHtg_HSP_FullLft" 515 "CatHtg_HSPIC_FullLft" 516 "CatHtg_HOM-SNGL_EIVC" 517 "CatHtg_HOM_EIVC" 518 "CatHtg_HSP_EIVC" 519 "CatHtg_HSPIC_EIVC" 768 "Start_FullLft" 772 "Start_EIVC" /end COMPU_VTAB
/begin COMPU_METHOD CoEOM_stEomStgCfgd_VERB "" TAB_VERB "%6.3" "-" COMPU_TAB_REF CoEOM_stEomStgCfgd_VERB /end COMPU_METHOD
/begin COMPU_VTAB CoEOM_stEomStgCfgd_VERB "" TAB_VERB 26 0 "Base_HOM-SNGL_FullLft" 1 "Base_HOM_FullLft" 2 "Base_HSP_FullLft" 3 "Base_HSPIC_FullLft" 4 "Base_HOM-SNGL_EIVC" 5 "Base_HOM_EIVC" 6 "Base_HSP_EIVC" 7 "Base_HSPIC_EIVC" 256 "WarmUp_HOM-SNGL_FullLft" 257 "WarmUp_HOM_FullLft" 258 "WarmUp_HSP_FullLft" 259 "WarmUp_HSPIC_FullLft" 260 "WarmUp_HOM-SNGL_EIVC" 261 "WarmUp_HOM_EIVC" 262 "WarmUp_HSP_EIVC" 263 "WarmUp_HSPIC_EIVC" 512 "CatHtg_HOM-SNGL_FullLft" 513 "CatHtg_HOM_FullLft" 514 "CatHtg_HSP_FullLft" 515 "CatHtg_HSPIC_FullLft" 516 "CatHtg_HOM-SNGL_EIVC" 517 "CatHtg_HOM_EIVC" 518 "CatHtg_HSP_EIVC" 519 "CatHtg_HSPIC_EIVC" 768 "Start_FullLft" 772 "Start_EIVC" /end COMPU_VTAB
/begin COMPU_METHOD CoEOM_stEomStgTot_VERB "" TAB_VERB "%6.3" "-" COMPU_TAB_REF CoEOM_stEomStgTot_VERB /end COMPU_METHOD
/begin COMPU_VTAB CoEOM_stEomStgTot_VERB "" TAB_VERB 513 0 "Base_HOM-SNGL_FullLft" 1 "Base_HOM_FullLft" 2 "Base_HSP_FullLft" 3 "Base_HSPIC_FullLft" 4 "Base_HOM-SNGL_EIVC" 5 "Base_HOM_EIVC" 6 "Base_HSP_EIVC" 7 "Base_HSPIC_EIVC" 8 "n/a [00;08]" 9 "n/a [00;09]" 10 "n/a [00;10]" 11 "n/a [00;11]" 12 "n/a [00;12]" 13 "n/a [00;13]" 14 "n/a [00;14]" 15 "n/a [00;15]" 255 "No_Demand" 256 "WarmUp_HOM-SNGL_FullLft" 257 "WarmUp_HOM_FullLft" 258 "WarmUp_HSP_FullLft" 259 "WarmUp_HSPIC_FullLft" 260 "WarmUp_HOM-SNGL_EIVC" 261 "WarmUp_HOM_EIVC" 262 "WarmUp_HSP_EIVC" 263 "WarmUp_HSPIC_EIVC" 264 "n/a [01;08]" 265 "n/a [01;09]" 266 "n/a [01;10]" 267 "n/a [01;11]" 268 "n/a [01;12]" 269 "n/a [01;13]" 270 "n/a [01;14]" 271 "n/a [01;15]" 512 "CatHtg_HOM-SNGL_FullLft" 513 "CatHtg_HOM_FullLft" 514 "CatHtg_HSP_FullLft" 515 "CatHtg_HSPIC_FullLft" 516 "CatHtg_HOM-SNGL_EIVC" 517 "CatHtg_HOM_EIVC" 518 "CatHtg_HSP_EIVC" 519 "CatHtg_HSPIC_EIVC" 520 "n/a [02;08]" 521 "n/a [02;09]" 522 "n/a [02;10]" 523 "n/a [02;11]" 524 "n/a [02;12]" 525 "n/a [02;13]" 526 "n/a [02;14]" 527 "n/a [02;15]" 768 "Start_FullLft" 769 "n/a [03;01]" 770 "n/a [03;02]" 771 "n/a [03;03]" 772 "Start_EIVC" 773 "n/a [03;05]" 774 "n/a [03;06]" 775 "n/a [03;07]" 776 "n/a [03;08]" 777 "n/a [03;09]" 778 "n/a [03;10]" 779 "n/a [03;11]" 780 "n/a [03;12]" 781 "n/a [03;13]" 782 "n/a [03;14]" 783 "n/a [03;15]" 1024 "n/a [04;00]" 1025 "n/a [04;01]" 1026 "n/a [04;02]" 1027 "n/a [04;03]" 1028 "n/a [04;04]" 1029 "n/a [04;05]" 1030 "n/a [04;06]" 1031 "n/a [04;07]" 1032 "n/a [04;08]" 1033 "n/a [04;09]" 1034 "n/a [04;10]" 1035 "n/a [04;11]" 1036 "n/a [04;12]" 1037 "n/a [04;13]" 1038 "n/a [04;14]" 1039 "n/a [04;15]" 1280 "n/a [05;00]" 1281 "n/a [05;01]" 1282 "n/a [05;02]" 1283 "n/a [05;03]" 1284 "n/a [05;04]" 1285 "n/a [05;05]" 1286 "n/a [05;06]" 1287 "n/a [05;07]" 1288 "n/a [05;08]" 1289 "n/a [05;09]" 1290 "n/a [05;10]" 1291 "n/a [05;11]" 1292 "n/a [05;12]" 1293 "n/a [05;13]" 1294 "n/a [05;14]" 1295 "n/a [05;15]" 1536 "n/a [06;00]" 1537 "n/a [06;01]" 1538 "n/a [06;02]" 1539 "n/a [06;03]" 1540 "n/a [06;04]" 1541 "n/a [06;05]" 1542 "n/a [06;06]" 1543 "n/a [06;07]" 1544 "n/a [06;08]" 1545 "n/a [06;09]" 1546 "n/a [06;10]" 1547 "n/a [06;11]" 1548 "n/a [06;12]" 1549 "n/a [06;13]" 1550 "n/a [06;14]" 1551 "n/a [06;15]" 1792 "n/a [07;00]" 1793 "n/a [07;01]" 1794 "n/a [07;02]" 1795 "n/a [07;03]" 1796 "n/a [07;04]" 1797 "n/a [07;05]" 1798 "n/a [07;06]" 1799 "n/a [07;07]" 1800 "n/a [07;08]" 1801 "n/a [07;09]" 1802 "n/a [07;10]" 1803 "n/a [07;11]" 1804 "n/a [07;12]" 1805 "n/a [07;13]" 1806 "n/a [07;14]" 1807 "n/a [07;15]" 2048 "n/a [08;00]" 2049 "n/a [08;01]" 2050 "n/a [08;02]" 2051 "n/a [08;03]" 2052 "n/a [08;04]" 2053 "n/a [08;05]" 2054 "n/a [08;06]" 2055 "n/a [08;07]" 2056 "n/a [08;08]" 2057 "n/a [08;09]" 2058 "n/a [08;10]" 2059 "n/a [08;11]" 2060 "n/a [08;12]" 2061 "n/a [08;13]" 2062 "n/a [08;14]" 2063 "n/a [08;15]" 2304 "n/a [09;00]" 2305 "n/a [09;01]" 2306 "n/a [09;02]" 2307 "n/a [09;03]" 2308 "n/a [09;04]" 2309 "n/a [09;05]" 2310 "n/a [09;06]" 2311 "n/a [09;07]" 2312 "n/a [09;08]" 2313 "n/a [09;09]" 2314 "n/a [09;10]" 2315 "n/a [09;11]" 2316 "n/a [09;12]" 2317 "n/a [09;13]" 2318 "n/a [09;14]" 2319 "n/a [09;15]" 2560 "n/a [10;00]" 2561 "n/a [10;01]" 2562 "n/a [10;02]" 2563 "n/a [10;03]" 2564 "n/a [10;04]" 2565 "n/a [10;05]" 2566 "n/a [10;06]" 2567 "n/a [10;07]" 2568 "n/a [10;08]" 2569 "n/a [10;09]" 2570 "n/a [10;10]" 2571 "n/a [10;11]" 2572 "n/a [10;12]" 2573 "n/a [10;13]" 2574 "n/a [10;14]" 2575 "n/a [10;15]" 2816 "n/a [11;00]" 2817 "n/a [11;01]" 2818 "n/a [11;02]" 2819 "n/a [11;03]" 2820 "n/a [11;04]" 2821 "n/a [11;05]" 2822 "n/a [11;06]" 2823 "n/a [11;07]" 2824 "n/a [11;08]" 2825 "n/a [11;09]" 2826 "n/a [11;10]" 2827 "n/a [11;11]" 2828 "n/a [11;12]" 2829 "n/a [11;13]" 2830 "n/a [11;14]" 2831 "n/a [11;15]" 3072 "n/a [12;00]" 3073 "n/a [12;01]" 3074 "n/a [12;02]" 3075 "n/a [12;03]" 3076 "n/a [12;04]" 3077 "n/a [12;05]" 3078 "n/a [12;06]" 3079 "n/a [12;07]" 3080 "n/a [12;08]" 3081 "n/a [12;09]" 3082 "n/a [12;10]" 3083 "n/a [12;11]" 3084 "n/a [12;12]" 3085 "n/a [12;13]" 3086 "n/a [12;14]" 3087 "n/a [12;15]" 3328 "n/a [13;00]" 3329 "n/a [13;01]" 3330 "n/a [13;02]" 3331 "n/a [13;03]" 3332 "n/a [13;04]" 3333 "n/a [13;05]" 3334 "n/a [13;06]" 3335 "n/a [13;07]" 3336 "n/a [13;08]" 3337 "n/a [13;09]" 3338 "n/a [13;10]" 3339 "n/a [13;11]" 3340 "n/a [13;12]" 3341 "n/a [13;13]" 3342 "n/a [13;14]" 3343 "n/a [13;15]" 3584 "n/a [14;00]" 3585 "n/a [14;01]" 3586 "n/a [14;02]" 3587 "n/a [14;03]" 3588 "n/a [14;04]" 3589 "n/a [14;05]" 3590 "n/a [14;06]" 3591 "n/a [14;07]" 3592 "n/a [14;08]" 3593 "n/a [14;09]" 3594 "n/a [14;10]" 3595 "n/a [14;11]" 3596 "n/a [14;12]" 3597 "n/a [14;13]" 3598 "n/a [14;14]" 3599 "n/a [14;15]" 3840 "n/a [15;00]" 3841 "n/a [15;01]" 3842 "n/a [15;02]" 3843 "n/a [15;03]" 3844 "n/a [15;04]" 3845 "n/a [15;05]" 3846 "n/a [15;06]" 3847 "n/a [15;07]" 3848 "n/a [15;08]" 3849 "n/a [15;09]" 3850 "n/a [15;10]" 3851 "n/a [15;11]" 3852 "n/a [15;12]" 3853 "n/a [15;13]" 3854 "n/a [15;14]" 3855 "n/a [15;15]" 4096 "n/a [16;00]" 4097 "n/a [16;01]" 4098 "n/a [16;02]" 4099 "n/a [16;03]" 4100 "n/a [16;04]" 4101 "n/a [16;05]" 4102 "n/a [16;06]" 4103 "n/a [16;07]" 4104 "n/a [16;08]" 4105 "n/a [16;09]" 4106 "n/a [16;10]" 4107 "n/a [16;11]" 4108 "n/a [16;12]" 4109 "n/a [16;13]" 4110 "n/a [16;14]" 4111 "n/a [16;15]" 4352 "n/a [17;00]" 4353 "n/a [17;01]" 4354 "n/a [17;02]" 4355 "n/a [17;03]" 4356 "n/a [17;04]" 4357 "n/a [17;05]" 4358 "n/a [17;06]" 4359 "n/a [17;07]" 4360 "n/a [17;08]" 4361 "n/a [17;09]" 4362 "n/a [17;10]" 4363 "n/a [17;11]" 4364 "n/a [17;12]" 4365 "n/a [17;13]" 4366 "n/a [17;14]" 4367 "n/a [17;15]" 4608 "n/a [18;00]" 4609 "n/a [18;01]" 4610 "n/a [18;02]" 4611 "n/a [18;03]" 4612 "n/a [18;04]" 4613 "n/a [18;05]" 4614 "n/a [18;06]" 4615 "n/a [18;07]" 4616 "n/a [18;08]" 4617 "n/a [18;09]" 4618 "n/a [18;10]" 4619 "n/a [18;11]" 4620 "n/a [18;12]" 4621 "n/a [18;13]" 4622 "n/a [18;14]" 4623 "n/a [18;15]" 4864 "n/a [19;00]" 4865 "n/a [19;01]" 4866 "n/a [19;02]" 4867 "n/a [19;03]" 4868 "n/a [19;04]" 4869 "n/a [19;05]" 4870 "n/a [19;06]" 4871 "n/a [19;07]" 4872 "n/a [19;08]" 4873 "n/a [19;09]" 4874 "n/a [19;10]" 4875 "n/a [19;11]" 4876 "n/a [19;12]" 4877 "n/a [19;13]" 4878 "n/a [19;14]" 4879 "n/a [19;15]" 5120 "n/a [20;00]" 5121 "n/a [20;01]" 5122 "n/a [20;02]" 5123 "n/a [20;03]" 5124 "n/a [20;04]" 5125 "n/a [20;05]" 5126 "n/a [20;06]" 5127 "n/a [20;07]" 5128 "n/a [20;08]" 5129 "n/a [20;09]" 5130 "n/a [20;10]" 5131 "n/a [20;11]" 5132 "n/a [20;12]" 5133 "n/a [20;13]" 5134 "n/a [20;14]" 5135 "n/a [20;15]" 5376 "n/a [21;00]" 5377 "n/a [21;01]" 5378 "n/a [21;02]" 5379 "n/a [21;03]" 5380 "n/a [21;04]" 5381 "n/a [21;05]" 5382 "n/a [21;06]" 5383 "n/a [21;07]" 5384 "n/a [21;08]" 5385 "n/a [21;09]" 5386 "n/a [21;10]" 5387 "n/a [21;11]" 5388 "n/a [21;12]" 5389 "n/a [21;13]" 5390 "n/a [21;14]" 5391 "n/a [21;15]" 5632 "n/a [22;00]" 5633 "n/a [22;01]" 5634 "n/a [22;02]" 5635 "n/a [22;03]" 5636 "n/a [22;04]" 5637 "n/a [22;05]" 5638 "n/a [22;06]" 5639 "n/a [22;07]" 5640 "n/a [22;08]" 5641 "n/a [22;09]" 5642 "n/a [22;10]" 5643 "n/a [22;11]" 5644 "n/a [22;12]" 5645 "n/a [22;13]" 5646 "n/a [22;14]" 5647 "n/a [22;15]" 5888 "n/a [23;00]" 5889 "n/a [23;01]" 5890 "n/a [23;02]" 5891 "n/a [23;03]" 5892 "n/a [23;04]" 5893 "n/a [23;05]" 5894 "n/a [23;06]" 5895 "n/a [23;07]" 5896 "n/a [23;08]" 5897 "n/a [23;09]" 5898 "n/a [23;10]" 5899 "n/a [23;11]" 5900 "n/a [23;12]" 5901 "n/a [23;13]" 5902 "n/a [23;14]" 5903 "n/a [23;15]" 6144 "n/a [24;00]" 6145 "n/a [24;01]" 6146 "n/a [24;02]" 6147 "n/a [24;03]" 6148 "n/a [24;04]" 6149 "n/a [24;05]" 6150 "n/a [24;06]" 6151 "n/a [24;07]" 6152 "n/a [24;08]" 6153 "n/a [24;09]" 6154 "n/a [24;10]" 6155 "n/a [24;11]" 6156 "n/a [24;12]" 6157 "n/a [24;13]" 6158 "n/a [24;14]" 6159 "n/a [24;15]" 6400 "n/a [25;00]" 6401 "n/a [25;01]" 6402 "n/a [25;02]" 6403 "n/a [25;03]" 6404 "n/a [25;04]" 6405 "n/a [25;05]" 6406 "n/a [25;06]" 6407 "n/a [25;07]" 6408 "n/a [25;08]" 6409 "n/a [25;09]" 6410 "n/a [25;10]" 6411 "n/a [25;11]" 6412 "n/a [25;12]" 6413 "n/a [25;13]" 6414 "n/a [25;14]" 6415 "n/a [25;15]" 6656 "n/a [26;00]" 6657 "n/a [26;01]" 6658 "n/a [26;02]" 6659 "n/a [26;03]" 6660 "n/a [26;04]" 6661 "n/a [26;05]" 6662 "n/a [26;06]" 6663 "n/a [26;07]" 6664 "n/a [26;08]" 6665 "n/a [26;09]" 6666 "n/a [26;10]" 6667 "n/a [26;11]" 6668 "n/a [26;12]" 6669 "n/a [26;13]" 6670 "n/a [26;14]" 6671 "n/a [26;15]" 6912 "n/a [27;00]" 6913 "n/a [27;01]" 6914 "n/a [27;02]" 6915 "n/a [27;03]" 6916 "n/a [27;04]" 6917 "n/a [27;05]" 6918 "n/a [27;06]" 6919 "n/a [27;07]" 6920 "n/a [27;08]" 6921 "n/a [27;09]" 6922 "n/a [27;10]" 6923 "n/a [27;11]" 6924 "n/a [27;12]" 6925 "n/a [27;13]" 6926 "n/a [27;14]" 6927 "n/a [27;15]" 7168 "n/a [28;00]" 7169 "n/a [28;01]" 7170 "n/a [28;02]" 7171 "n/a [28;03]" 7172 "n/a [28;04]" 7173 "n/a [28;05]" 7174 "n/a [28;06]" 7175 "n/a [28;07]" 7176 "n/a [28;08]" 7177 "n/a [28;09]" 7178 "n/a [28;10]" 7179 "n/a [28;11]" 7180 "n/a [28;12]" 7181 "n/a [28;13]" 7182 "n/a [28;14]" 7183 "n/a [28;15]" 7424 "n/a [29;00]" 7425 "n/a [29;01]" 7426 "n/a [29;02]" 7427 "n/a [29;03]" 7428 "n/a [29;04]" 7429 "n/a [29;05]" 7430 "n/a [29;06]" 7431 "n/a [29;07]" 7432 "n/a [29;08]" 7433 "n/a [29;09]" 7434 "n/a [29;10]" 7435 "n/a [29;11]" 7436 "n/a [29;12]" 7437 "n/a [29;13]" 7438 "n/a [29;14]" 7439 "n/a [29;15]" 7680 "n/a [30;00]" 7681 "n/a [30;01]" 7682 "n/a [30;02]" 7683 "n/a [30;03]" 7684 "n/a [30;04]" 7685 "n/a [30;05]" 7686 "n/a [30;06]" 7687 "n/a [30;07]" 7688 "n/a [30;08]" 7689 "n/a [30;09]" 7690 "n/a [30;10]" 7691 "n/a [30;11]" 7692 "n/a [30;12]" 7693 "n/a [30;13]" 7694 "n/a [30;14]" 7695 "n/a [30;15]" 7936 "n/a [31;00]" 7937 "n/a [31;01]" 7938 "n/a [31;02]" 7939 "n/a [31;03]" 7940 "n/a [31;04]" 7941 "n/a [31;05]" 7942 "n/a [31;06]" 7943 "n/a [31;07]" 7944 "n/a [31;08]" 7945 "n/a [31;09]" 7946 "n/a [31;10]" 7947 "n/a [31;11]" 7948 "n/a [31;12]" 7949 "n/a [31;13]" 7950 "n/a [31;14]" 7951 "n/a [31;15]" /end COMPU_VTAB
/begin COMPU_METHOD CoEOM_stEomVlvLftIntk_VERB "" TAB_VERB "%6.3" "" COMPU_TAB_REF CoEOM_stEomVlvLftIntk_VERB /end COMPU_METHOD
/begin COMPU_VTAB CoEOM_stEomVlvLftIntk_VERB "" TAB_VERB 15 0 "n/a [0]" 1 "No Lift" 2 "Full Lift" 4 "EIVC" 8 "LIVO" 16 "EIVO" 32 "LIVC" 64 "Cold Lift" 32772 "EIVC-Vbl" 32776 "LIVO-Vbl" 32784 "EIVO-Vbl" 32800 "LIVC-Vbl" 128 "ZAV" 36 "LivcOrEivc" 32804 "LivcOrEivc-Vbl" /end COMPU_VTAB
/begin COMPU_METHOD CoEOM_SwtStgy1_sm_VERB "" TAB_VERB "%6.3" "" COMPU_TAB_REF CoEOM_SwtStgy1_sm_VERB /end COMPU_METHOD
/begin COMPU_VTAB CoEOM_SwtStgy1_sm_VERB "" TAB_VERB 3 0 "A_INACTV_STGY1" 1 "A_TMNG_STGY1" 2 "A_WAIT_STGY1" /end COMPU_VTAB
/begin COMPU_METHOD CoEOM_SwtStgy2_sm_VERB "" TAB_VERB "%6.3" "" COMPU_TAB_REF CoEOM_SwtStgy2_sm_VERB /end COMPU_METHOD
/begin COMPU_VTAB CoEOM_SwtStgy2_sm_VERB "" TAB_VERB 5 0 "A_INACTV_STGY2" 1 "A_FILLGPREPN_STGY2" 2 "A_TMNG_STGY2" 3 "A_TRIG_STGY2" 4 "A_WAIT_STGY2" /end COMPU_VTAB
/begin COMPU_METHOD CoEOM_SwtStgy5_sm_VERB "" TAB_VERB "%6.3" "" COMPU_TAB_REF CoEOM_SwtStgy5_sm_VERB /end COMPU_METHOD
/begin COMPU_VTAB CoEOM_SwtStgy5_sm_VERB "" TAB_VERB 4 0 "A_INACTV_STGY5" 1 "A_TMNG_STGY5" 2 "A_TRIG_STGY5" 3 "A_WAIT_STGY5" /end COMPU_VTAB
/begin COMPU_METHOD CoEOM_TypCoorn_VERB "" TAB_VERB "%6.3" "" COMPU_TAB_REF CoEOM_TypCoorn_VERB /end COMPU_METHOD
/begin COMPU_VTAB CoEOM_TypCoorn_VERB "" TAB_VERB 6 0 "UNUSED" 1 "HARD_INHBN_CONSDR" 2 "WEAK_INHBN_IGNORED" 3 "WEAK_INHBN_CONSDR" 4 "DMD_CONSDR" 5 "DMD_NOT_POSSIBLE" /end COMPU_VTAB
/begin COMPU_METHOD CoEOM_TypDescr_VERB "" TAB_VERB "%6.3" "" COMPU_TAB_REF CoEOM_TypDescr_VERB /end COMPU_METHOD
/begin COMPU_VTAB CoEOM_TypDescr_VERB "" TAB_VERB 8 0 "NO_REQ" 15 "INACTV_CAL" 16 "COMPL_INHIBIT" 17 "PART_INHIBIT" 18 "COMPL_ROW_INHIBIT" 32 "SINGLE_DEMAND" 33 "MULT_DEMAND" 48 "INVALID" /end COMPU_VTAB
/begin COMPU_METHOD Curr_A "" RAT_FUNC "%6.4" "A" COEFFS 0 100 0 0 0 1 /end COMPU_METHOD
/begin COMPU_METHOD dez "" RAT_FUNC "%6.2" "" COEFFS 0 1 0 0 0 1 /end COMPU_METHOD
/begin COMPU_METHOD DFES_EXTDFLT_SY_Compu "" TAB_VERB "%6.3" "" COMPU_TAB_REF DFES_EXTDFLT_SY_Compu /end COMPU_METHOD
/begin COMPU_VTAB DFES_EXTDFLT_SY_Compu "" TAB_VERB 2 0 "DISABLED" 1 "ENABLED" /end COMPU_VTAB
/begin COMPU_METHOD DFES_IMDTNVSTORG_SC_Compu "" TAB_VERB "%6.3" "" COMPU_TAB_REF DFES_IMDTNVSTORG_SC_Compu /end COMPU_METHOD
/begin COMPU_VTAB DFES_IMDTNVSTORG_SC_Compu "" TAB_VERB 2 0 "False" 1 "True" /end COMPU_VTAB
/begin COMPU_METHOD DFES_IRV_SY_Compu "" TAB_VERB "%6.3" "" COMPU_TAB_REF DFES_IRV_SY_Compu /end COMPU_METHOD
/begin COMPU_VTAB DFES_IRV_SY_Compu "" TAB_VERB 2 0 "DFES_IRV_DISBL" 1 "DFES_IRV_ENA" /end COMPU_VTAB
/begin COMPU_METHOD DFES_PDTC_SY_Compu "" TAB_VERB "%6.3" "" COMPU_TAB_REF DFES_PDTC_SY_Compu /end COMPU_METHOD
/begin COMPU_VTAB DFES_PDTC_SY_Compu "" TAB_VERB 2 0 "False" 1 "True" /end COMPU_VTAB
/begin COMPU_METHOD DFES_VIS_BUF_SY_Compu "" TAB_VERB "%6.3" "" COMPU_TAB_REF DFES_VIS_BUF_SY_Compu /end COMPU_METHOD
/begin COMPU_VTAB DFES_VIS_BUF_SY_Compu "" TAB_VERB 2 0 "0" 1 "1" /end COMPU_VTAB
/begin COMPU_METHOD DFFTLPRTOVRDSTSCINC_SY_Compu "" TAB_VERB "%6.3" "" COMPU_TAB_REF DFFTLPRTOVRDSTSCINC_SY_Compu /end COMPU_METHOD
/begin COMPU_VTAB DFFTLPRTOVRDSTSCINC_SY_Compu "" TAB_VERB 2 0 "FALSE" 1 "TRUE" /end COMPU_VTAB
/begin COMPU_METHOD DFFV_SY_Compu "" TAB_VERB "%6.3" "" COMPU_TAB_REF DFFV_SY_Compu /end COMPU_METHOD
/begin COMPU_VTAB DFFV_SY_Compu "" TAB_VERB 2 0 "False" 1 "True" /end COMPU_VTAB
/begin COMPU_METHOD dFlConsum "" RAT_FUNC "%6.4" "l/h/s" COEFFS 0 100 0 0 0 1 /end COMPU_METHOD
/begin COMPU_METHOD DFSTT_SY_Compu "" TAB_VERB "%6.3" "" COMPU_TAB_REF DFSTT_SY_Compu /end COMPU_METHOD
/begin COMPU_VTAB DFSTT_SY_Compu "" TAB_VERB 2 0 "False" 1 "True" /end COMPU_VTAB
/begin COMPU_METHOD DIAACTR_ELECCTRLLINEDIAGCPTENA_SC_Compu "" TAB_VERB "%6.3" "" COMPU_TAB_REF DIAACTR_ELECCTRLLINEDIAGCPTENA_SC_Compu /end COMPU_METHOD
/begin COMPU_VTAB DIAACTR_ELECCTRLLINEDIAGCPTENA_SC_Compu "" TAB_VERB 2 0 "False" 1 "True" /end COMPU_VTAB
/begin COMPU_METHOD DIAACTR_ELECHBRDGDIAGENA_SC_Compu "" TAB_VERB "%6.3" "" COMPU_TAB_REF DIAACTR_ELECHBRDGDIAGENA_SC_Compu /end COMPU_METHOD
/begin COMPU_VTAB DIAACTR_ELECHBRDGDIAGENA_SC_Compu "" TAB_VERB 2 0 "False" 1 "True" /end COMPU_VTAB
/begin COMPU_METHOD DIAACTR_ELECPSDIAGCMPNENA_SC_Compu "" TAB_VERB "%6.3" "" COMPU_TAB_REF DIAACTR_ELECPSDIAGCMPNENA_SC_Compu /end COMPU_METHOD
/begin COMPU_VTAB DIAACTR_ELECPSDIAGCMPNENA_SC_Compu "" TAB_VERB 2 0 "False" 1 "True" /end COMPU_VTAB
/begin COMPU_METHOD DIAACTR_ELECPSDIAGERRINFO_SC_Compu "" TAB_VERB "%6.3" "" COMPU_TAB_REF DIAACTR_ELECPSDIAGERRINFO_SC_Compu /end COMPU_METHOD
/begin COMPU_VTAB DIAACTR_ELECPSDIAGERRINFO_SC_Compu "" TAB_VERB 2 0 "LSTRAWINFO" 1 "LSTTESTRSLT" /end COMPU_VTAB
/begin COMPU_METHOD DIABAS_ATSLRGIDSUPRT_SC_Compu "" TAB_VERB "%6.3" "" COMPU_TAB_REF DIABAS_ATSLRGIDSUPRT_SC_Compu /end COMPU_METHOD
/begin COMPU_VTAB DIABAS_ATSLRGIDSUPRT_SC_Compu "" TAB_VERB 2 0 "DISABLE" 1 "ENABLE" /end COMPU_VTAB
/begin COMPU_METHOD DIABAS_ATSSUSP_SC_Compu "" TAB_VERB "%6.3" "" COMPU_TAB_REF DIABAS_ATSSUSP_SC_Compu /end COMPU_METHOD
/begin COMPU_VTAB DIABAS_ATSSUSP_SC_Compu "" TAB_VERB 2 1 "Temporary" 2 "Permanent" /end COMPU_VTAB
/begin COMPU_METHOD DIABAS_ATS_SC_Compu "" TAB_VERB "%6.3" "" COMPU_TAB_REF DIABAS_ATS_SC_Compu /end COMPU_METHOD
/begin COMPU_VTAB DIABAS_ATS_SC_Compu "" TAB_VERB 2 0 "ATS inactive" 1 "ATS active" /end COMPU_VTAB
/begin COMPU_METHOD DIABAS_AVS_SY_Compu "" TAB_VERB "%6.3" "" COMPU_TAB_REF DIABAS_AVS_SY_Compu /end COMPU_METHOD
/begin COMPU_VTAB DIABAS_AVS_SY_Compu "" TAB_VERB 2 0 "False" 1 "True" /end COMPU_VTAB
/begin COMPU_METHOD DIABAS_BSWVERS_SC_Compu "" TAB_VERB "%6.3" "" COMPU_TAB_REF DIABAS_BSWVERS_SC_Compu /end COMPU_METHOD
/begin COMPU_VTAB DIABAS_BSWVERS_SC_Compu "" TAB_VERB 20 10 "BSW_1703" 11 "BSW_1706" 12 "BSW_1709" 13 "BSW_1712" 20 "BSW_1803" 21 "BSW_1806" 22 "BSW_1809" 23 "BSW_1812" 30 "BSW_1903" 31 "BSW_1906" 32 "BSW_1909" 33 "BSW_1912" 40 "BSW_2003" 41 "BSW_2006" 42 "BSW_2009" 43 "BSW_2012" 50 "BSW_2103" 51 "BSW_2106" 52 "BSW_2109" 53 "BSW_2112" /end COMPU_VTAB
/begin COMPU_METHOD DIABAS_CALIDCVNCTRL_SC_Compu "" TAB_VERB "%6.3" "" COMPU_TAB_REF DIABAS_CALIDCVNCTRL_SC_Compu /end COMPU_METHOD
/begin COMPU_VTAB DIABAS_CALIDCVNCTRL_SC_Compu "" TAB_VERB 3 0 "CALIDCVN_LEG" 1 "CALIDCVN_MIX" 2 "CALIDCVN_AUTO" /end COMPU_VTAB
/begin COMPU_METHOD DIABAS_CALIDCVNLENSEQ_SC_Compu "" RAT_FUNC "%6.2" "" COEFFS 0 1 0 0 0 1 /end COMPU_METHOD
/begin COMPU_METHOD DIABAS_CRCTAB_SY_Compu "" TAB_VERB "%6.3" "" COMPU_TAB_REF DIABAS_CRCTAB_SY_Compu /end COMPU_METHOD
/begin COMPU_VTAB DIABAS_CRCTAB_SY_Compu "" TAB_VERB 2 0 "False" 1 "True" /end COMPU_VTAB
/begin COMPU_METHOD DIABAS_DTCFILVERS_SC_Compu "" RAT_FUNC "%6.2" "" COEFFS 0 1 0 0 0 1 /end COMPU_METHOD
/begin COMPU_METHOD DIABAS_ETCINTSTATE_SC_Compu "" TAB_VERB "%6.3" "" COMPU_TAB_REF DIABAS_ETCINTSTATE_SC_Compu /end COMPU_METHOD
/begin COMPU_VTAB DIABAS_ETCINTSTATE_SC_Compu "" TAB_VERB 2 0 "False" 1 "True" /end COMPU_VTAB
/begin COMPU_METHOD DIABAS_IFFLOATSIG_SC_Compu "" TAB_VERB "%6.3" "" COMPU_TAB_REF DIABAS_IFFLOATSIG_SC_Compu /end COMPU_METHOD
/begin COMPU_VTAB DIABAS_IFFLOATSIG_SC_Compu "" TAB_VERB 2 0 "False" 1 "True" /end COMPU_VTAB
/begin COMPU_METHOD DIABAS_PNDRPRTMOD2_SC_Compu "" TAB_VERB "%6.3" "" COMPU_TAB_REF DIABAS_PNDRPRTMOD2_SC_Compu /end COMPU_METHOD
/begin COMPU_VTAB DIABAS_PNDRPRTMOD2_SC_Compu "" TAB_VERB 2 0 "False" 1 "True" /end COMPU_VTAB
/begin COMPU_METHOD DIABAS_PRMIDAUTVIEW_SC_Compu "" TAB_VERB "%6.3" "" COMPU_TAB_REF DIABAS_PRMIDAUTVIEW_SC_Compu /end COMPU_METHOD
/begin COMPU_VTAB DIABAS_PRMIDAUTVIEW_SC_Compu "" TAB_VERB 2 0 "False" 1 "True" /end COMPU_VTAB
/begin COMPU_METHOD DIABAS_SCRCTL_RCNT_RESET_SY_Compu "" TAB_VERB "%6.3" "" COMPU_TAB_REF DIABAS_SCRCTL_RCNT_RESET_SY_Compu /end COMPU_METHOD
/begin COMPU_VTAB DIABAS_SCRCTL_RCNT_RESET_SY_Compu "" TAB_VERB 2 0 "False" 1 "True" /end COMPU_VTAB
/begin COMPU_METHOD DIABAS_SRV8_SC_Compu "" RAT_FUNC "%6.2" "" COEFFS 0 1 0 0 0 1 /end COMPU_METHOD
/begin COMPU_METHOD DIABAS_VAR_SY_Compu "" TAB_VERB "%6.3" "" COMPU_TAB_REF DIABAS_VAR_SY_Compu /end COMPU_METHOD
/begin COMPU_VTAB DIABAS_VAR_SY_Compu "" TAB_VERB 53 0 "kein Kundenbezug" 1 "DAI" 3 "VWW" 4 "POR" 5 "AUD" 6 "OPE" 9 "FIA" 11 "BMW" 14 "PSA" 15 "REN" 17 "ALF" 18 "SAB" 19 "VOL" 20 "NIS" 21 "GMU" 22 "FOR" 26 "IMJ" 36 "MAN" 51 "SEA" 53 "CHR" 54 "JAG" 55 "ROL" 57 "FORD_EU_Diesel" 69 "FER" 72 "TOY" 123 "MIT" 147 "HYU" 159 "HON" 160 "MAZ" 183 "CU" 190 "LRG" 204 "VVW" 214 "AVT" 242 "Iveco" 243 "DMC" 248 "SUZ" 267 "SSANGYONG" 270 "KEF" 289 "AMG" 308 "TAT" 319 "MVM" 328 "MM" 339 "AML" 385 "UAES" 578 "AL" 590 "SCANIA" 658 "Isuzu" 760 "WEICHAI" 828 "RBCD" 898 "MFTBC" 999 "ALL" 2887 "Nonox" 9454 "Fuso" /end COMPU_VTAB
/begin COMPU_METHOD DIADEM_SY_Compu "" TAB_VERB "%6.3" "" COMPU_TAB_REF DIADEM_SY_Compu /end COMPU_METHOD
/begin COMPU_VTAB DIADEM_SY_Compu "" TAB_VERB 2 0 "False" 1 "True" /end COMPU_VTAB
/begin COMPU_METHOD DIAGADAPT_SC_Compu "" TAB_VERB "%6.3" "" COMPU_TAB_REF DIAGADAPT_SC_Compu /end COMPU_METHOD
/begin COMPU_VTAB DIAGADAPT_SC_Compu "" TAB_VERB 2 0 "False" 1 "True" /end COMPU_VTAB
/begin COMPU_METHOD EngN "" RAT_FUNC "%6.3" "rpm" COEFFS 0 2 0 0 0 1 /end COMPU_METHOD
/begin COMPU_METHOD EngN_short "" RAT_FUNC "%6.1" "rpm" COEFFS 0 1 0 0 0 50 /end COMPU_METHOD
/begin COMPU_METHOD fak_q2p384Em4_pc_DIV_Nm "" RAT_FUNC "%6.5" "%/Nm" COEFFS 0 1048576 0 0 0 250 /end COMPU_METHOD
/begin COMPU_METHOD fak_ub_b2 "" RAT_FUNC "%8.5" "-" COEFFS 0 256 0 0 0 2 /end COMPU_METHOD
/begin COMPU_METHOD fak_uw_b1 "" RAT_FUNC "%7.6" "-" COEFFS 0 65536 0 0 0 1 /end COMPU_METHOD
/begin COMPU_METHOD fak_uw_b2 "" RAT_FUNC "%7.6" "-" COEFFS 0 65536 0 0 0 2 /end COMPU_METHOD
/begin COMPU_METHOD md_q0p1 "" RAT_FUNC "%6.3" "Nm" COEFFS 0 10 0 0 0 1 /end COMPU_METHOD
/begin COMPU_METHOD nmot_ub_q40 "" RAT_FUNC "%6.1" "1/min" COEFFS 0 1 0 0 0 40 /end COMPU_METHOD
/begin COMPU_METHOD OneToOne "" RAT_FUNC "%6.2" "-" COEFFS 0 1 0 0 0 1 /end COMPU_METHOD
/begin COMPU_METHOD Prc "" RAT_FUNC "%6.4" "%" COEFFS 0 81.92 0 0 0 1 /end COMPU_METHOD
/begin COMPU_METHOD rel_q0p003052_pc_DIV_s "" RAT_FUNC "%6.4" "%/s" COEFFS 0 65536 0 0 0 200 /end COMPU_METHOD
/begin COMPU_METHOD rel_q0p02344 "" RAT_FUNC "%6.4" "%" COEFFS 0 32 0 0 0 0.75 /end COMPU_METHOD
/begin COMPU_METHOD rel_ub_b100 "" RAT_FUNC "%6.3" "%" COEFFS 0 256 0 0 0 100 /end COMPU_METHOD
/begin COMPU_METHOD rel_uw_b100 "" RAT_FUNC "%6.4" "%" COEFFS 0 65536 0 0 0 100 /end COMPU_METHOD
/begin COMPU_METHOD rel_uw_q0p0234 "" RAT_FUNC "%6.4" "%" COEFFS 0 32 0 0 0 0.75 /end COMPU_METHOD
/begin COMPU_METHOD RmpVoltBatt "" RAT_FUNC "%6.3" "mV/s" COEFFS 0 3.2768 0 0 0 1 /end COMPU_METHOD
/begin COMPU_METHOD Temp_Cels "" RAT_FUNC "%6.1" "deg C" COEFFS 0 10 2731.4 0 0 1 /end COMPU_METHOD
/begin COMPU_METHOD temp_q0p0234 "" RAT_FUNC "%6.4" "K" COEFFS 0 256 0 0 0 6 /end COMPU_METHOD
/begin COMPU_METHOD temp_ub_q0p75_o48 "" RAT_FUNC "%6.2" "Grad C" COEFFS 0 1 48 0 0 0.75 /end COMPU_METHOD
/begin COMPU_METHOD TimeDeb "" RAT_FUNC "%6.1" "ms" COEFFS 0 0.1 0 0 0 1 /end COMPU_METHOD
/begin COMPU_METHOD TimeDelay_s "" RAT_FUNC "%6.1" "s" COEFFS 0 0 1 0 0.00023283064365387 0 /end COMPU_METHOD
/begin COMPU_METHOD Time_Dt "" RAT_FUNC "%9.8" "s" COEFFS 0 1000000 0 0 0 1 /end COMPU_METHOD
/begin COMPU_METHOD Time_ms "" RAT_FUNC "%6.1" "ms" COEFFS 0 0.1 0 0 0 1 /end COMPU_METHOD
/begin COMPU_METHOD Time_s "" RAT_FUNC "%6.4" "s" COEFFS 0 100 0 0 0 1 /end COMPU_METHOD
/begin COMPU_METHOD Trq "" RAT_FUNC "%6.3" "Nm" COEFFS 0 10 0 0 0 1 /end COMPU_METHOD
/begin COMPU_METHOD Vel "" RAT_FUNC "%6.4" "km/h" COEFFS 0 100 0 0 0 1 /end COMPU_METHOD
/begin COMPU_METHOD Volt_Batt "" RAT_FUNC "%6.1" "mV" COEFFS 0 0.05 0 0 0 1 /end COMPU_METHOD
/begin RECORD_LAYOUT Map_Xu8Yu8Ws16 NO_AXIS_PTS_X 1 UBYTE NO_AXIS_PTS_Y 2 UBYTE AXIS_PTS_X 3 UBYTE INDEX_INCR DIRECT AXIS_PTS_Y 4 UBYTE INDEX_INCR DIRECT FNC_VALUES 5 SWORD COLUMN_DIR DIRECT /end RECORD_LAYOUT
/begin RECORD_LAYOUT RB_Axis_U16 NO_AXIS_PTS_X 1 UWORD AXIS_PTS_X 2 UWORD INDEX_INCR DIRECT /end RECORD_LAYOUT
/begin RECORD_LAYOUT RB_Curve_S16_S16 NO_AXIS_PTS_X 1 SWORD AXIS_PTS_X 2 SWORD INDEX_INCR DIRECT FNC_VALUES 3 SWORD COLUMN_DIR DIRECT /end RECORD_LAYOUT
/begin RECORD_LAYOUT RB_Curve_S8_S8 NO_AXIS_PTS_X 1 SBYTE AXIS_PTS_X 2 SBYTE INDEX_INCR DIRECT FNC_VALUES 3 SBYTE COLUMN_DIR DIRECT /end RECORD_LAYOUT
/begin RECORD_LAYOUT RB_Curve_U16_U16 NO_AXIS_PTS_X 1 UWORD AXIS_PTS_X 2 UWORD INDEX_INCR DIRECT FNC_VALUES 3 UWORD COLUMN_DIR DIRECT /end RECORD_LAYOUT
/begin RECORD_LAYOUT RB_Curve_U16_U8_Static NO_AXIS_PTS_X 1 UWORD AXIS_PTS_X 2 UWORD INDEX_INCR DIRECT FNC_VALUES 3 UBYTE COLUMN_DIR DIRECT STATIC_RECORD_LAYOUT /end RECORD_LAYOUT
/begin RECORD_LAYOUT RB_Curve_U8_U16_Static NO_AXIS_PTS_X 1 UBYTE AXIS_PTS_X 2 UBYTE INDEX_INCR DIRECT FNC_VALUES 3 UWORD COLUMN_DIR DIRECT STATIC_RECORD_LAYOUT /end RECORD_LAYOUT
/begin RECORD_LAYOUT RB_Curve_U8_U8 NO_AXIS_PTS_X 1 UBYTE AXIS_PTS_X 2 UBYTE INDEX_INCR DIRECT FNC_VALUES 3 UBYTE COLUMN_DIR DIRECT /end RECORD_LAYOUT
/begin RECORD_LAYOUT RB_FixCurve_U8_U8 FNC_VALUES 1 UBYTE COLUMN_DIR DIRECT /end RECORD_LAYOUT
/begin RECORD_LAYOUT RB_Map_S16S16_S16 NO_AXIS_PTS_X 1 SWORD NO_AXIS_PTS_Y 2 SWORD AXIS_PTS_X 3 SWORD INDEX_INCR DIRECT AXIS_PTS_Y 4 SWORD INDEX_INCR DIRECT FNC_VALUES 5 SWORD COLUMN_DIR DIRECT /end RECORD_LAYOUT
/begin RECORD_LAYOUT RB_Map_U16U16_U16 NO_AXIS_PTS_X 1 UWORD NO_AXIS_PTS_Y 2 UWORD AXIS_PTS_X 3 UWORD INDEX_INCR DIRECT AXIS_PTS_Y 4 UWORD INDEX_INCR DIRECT FNC_VALUES 5 UWORD COLUMN_DIR DIRECT /end RECORD_LAYOUT
/begin RECORD_LAYOUT RB_Map_U8S16_S16 NO_AXIS_PTS_X 1 UBYTE NO_AXIS_PTS_Y 2 UBYTE AXIS_PTS_X 3 UBYTE INDEX_INCR DIRECT AXIS_PTS_Y 4 SWORD INDEX_INCR DIRECT FNC_VALUES 5 SWORD ROW_DIR DIRECT /end RECORD_LAYOUT
/begin RECORD_LAYOUT RB_Map_U8U8_U16 NO_AXIS_PTS_X 1 UBYTE NO_AXIS_PTS_Y 2 UBYTE AXIS_PTS_X 3 UBYTE INDEX_INCR DIRECT AXIS_PTS_Y 4 UBYTE INDEX_INCR DIRECT FNC_VALUES 5 UWORD COLUMN_DIR DIRECT /end RECORD_LAYOUT
/begin RECORD_LAYOUT RB_Map_U8U8_U8 NO_AXIS_PTS_X 1 UBYTE NO_AXIS_PTS_Y 2 UBYTE AXIS_PTS_X 3 UBYTE INDEX_INCR DIRECT AXIS_PTS_Y 4 UBYTE INDEX_INCR DIRECT FNC_VALUES 5 UBYTE COLUMN_DIR DIRECT /end RECORD_LAYOUT
/begin RECORD_LAYOUT RB_ValA_Wu16 FNC_VALUES 1 UWORD COLUMN_DIR DIRECT /end RECORD_LAYOUT
/begin RECORD_LAYOUT RB_ValA_Wu8 FNC_VALUES 1 UBYTE COLUMN_DIR DIRECT /end RECORD_LAYOUT
/begin RECORD_LAYOUT RB_Val_Wboolean FNC_VALUES 1 UBYTE COLUMN_DIR DIRECT /end RECORD_LAYOUT
/begin RECORD_LAYOUT RB_Val_Ws16 FNC_VALUES 1 SWORD COLUMN_DIR DIRECT /end RECORD_LAYOUT
/begin RECORD_LAYOUT RB_Val_Ws32 FNC_VALUES 1 SLONG COLUMN_DIR DIRECT /end RECORD_LAYOUT
/begin RECORD_LAYOUT RB_Val_Ws8 FNC_VALUES 1 SBYTE COLUMN_DIR DIRECT /end RECORD_LAYOUT
/begin RECORD_LAYOUT RB_Val_Wu16 FNC_VALUES 1 UWORD COLUMN_DIR DIRECT /end RECORD_LAYOUT
/begin RECORD_LAYOUT RB_Val_Wu32 FNC_VALUES 1 ULONG COLUMN_DIR DIRECT /end RECORD_LAYOUT
/begin RECORD_LAYOUT RB_Val_Wu8 FNC_VALUES 1 UBYTE COLUMN_DIR DIRECT /end RECORD_LAYOUT
/begin RECORD_LAYOUT Val_Ws16 FNC_VALUES 1 SWORD COLUMN_DIR DIRECT /end RECORD_LAYOUT
/begin RECORD_LAYOUT Val_Ws32 FNC_VALUES 1 SLONG COLUMN_DIR DIRECT /end RECORD_LAYOUT
/begin RECORD_LAYOUT Val_Wu16 FNC_VALUES 1 UWORD COLUMN_DIR DIRECT /end RECORD_LAYOUT
/begin RECORD_LAYOUT Val_Wu8 FNC_VALUES 1 UBYTE COLUMN_DIR DIRECT /end RECORD_LAYOUT
/end MODULE
/end PROJECT
