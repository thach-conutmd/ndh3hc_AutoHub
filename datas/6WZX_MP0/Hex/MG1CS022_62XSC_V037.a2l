ASAP2_VERSION 1 60
/begin PROJECT MG1CS022 "MG1CS022"
/begin HEADER "" VERSION "MG1CS022_62XSC_V037" PROJECT_NO MG1CS022 /end HEADER
/begin MODULE DIM ""
/begin MOD_COMMON "" BYTE_ORDER MSB_LAST ALIGNMENT_BYTE 1 ALIGNMENT_WORD 2 ALIGNMENT_LONG 4 ALIGNMENT_INT64 4 ALIGNMENT_FLOAT32_IEEE 4 ALIGNMENT_FLOAT64_IEEE 4 DATA_SIZE 32 /end MOD_COMMON
/begin CHARACTERISTIC DFES_Env.xSet1_CA "set of signals per environment data / Signal selection for environment dataset 1" VAL_BLK 0x805050C4 ValA_Wu16 1168.00000000 Signals_IntSigNumVerb 0.00 1168.00000000 FORMAT "%13.8" NUMBER 1 /end CHARACTERISTIC
/begin CHARACTERISTIC DFES_Env.xSet2_CA "set of signals per environment data / Signal selection for environment dataset 2" VAL_BLK 0x805050C6 ValA_Wu16 1168.00000000 Signals_IntSigNumVerb 0.00 1168.00000000 FORMAT "%13.8" NUMBER 1 /end CHARACTERISTIC
/begin CHARACTERISTIC DFES_EnvRef.DFC_Unused_C "used environment signals / " VALUE 0x805049AC Val_Wu8 1.00000000000 DFES_EnvTabVerb 0.00 1.00000000000 FORMAT "%13.11" READ_ONLY /end CHARACTERISTIC
/begin CHARACTERISTIC DFES_EnvRef.DFC_AAVEmax_C "used environment signals / Reference to used environment condition set for check DFC_AAVEmax" VALUE 0x805049AD Val_Wu8 1.00000000000 DFES_EnvTabVerb 0.00 1.00000000000 FORMAT "%13.11" /end CHARACTERISTIC
/begin CHARACTERISTIC DFES_EnvRef.DFC_AAVEmin_C "used environment signals / Reference to used environment condition set for check DFC_AAVEmin" VALUE 0x805049AE Val_Wu8 1.00000000000 DFES_EnvTabVerb 0.00 1.00000000000 FORMAT "%13.11" /end CHARACTERISTIC
/begin CHARACTERISTIC DFES_EnvRef.DFC_AAVEsig_C "used environment signals / Reference to used environment condition set for check DFC_AAVEsig" VALUE 0x805049AF Val_Wu8 1.00000000000 DFES_EnvTabVerb 0.00 1.00000000000 FORMAT "%13.11" /end CHARACTERISTIC
/begin CHARACTERISTIC DFES_EnvRef.DFC_AltIOACGFailr_C "used environment signals / Reference to used environment condition set for check DFC_AltIOACGFailr" VALUE 0x805049B0 Val_Wu8 1.00000000000 DFES_EnvTabVerb 0.00 1.00000000000 FORMAT "%13.11" /end CHARACTERISTIC
/begin CHARACTERISTIC DFES_EnvRef.DFC_AltIOACGHiVltg_C "used environment signals / Reference to used environment condition set for check DFC_AltIOACGHiVltg" VALUE 0x805049B1 Val_Wu8 1.00000000000 DFES_EnvTabVerb 0.00 1.00000000000 FORMAT "%13.11" /end CHARACTERISTIC
/begin CHARACTERISTIC DFES_EnvRef.DFC_AltIOACGLoVltg_C "used environment signals / Reference to used environment condition set for check DFC_AltIOACGLoVltg" VALUE 0x805049B2 Val_Wu8 1.00000000000 DFES_EnvTabVerb 0.00 1.00000000000 FORMAT "%13.11" /end CHARACTERISTIC
/begin CHARACTERISTIC DFES_EnvRef.DFC_AltIOACGTHi_C "used environment signals / Reference to used environment condition set for check DFC_AltIOACGTHi" VALUE 0x805049B3 Val_Wu8 1.00000000000 DFES_EnvTabVerb 0.00 1.00000000000 FORMAT "%13.11" /end CHARACTERISTIC
/begin CHARACTERISTIC DFES_EnvRef.DFC_AltIODConnACG_C "used environment signals / Reference to used environment condition set for check DFC_AltIODConnACG" VALUE 0x805049B4 Val_Wu8 1.00000000000 DFES_EnvTabVerb 0.00 1.00000000000 FORMAT "%13.11" /end CHARACTERISTIC
/begin CHARACTERISTIC DFES_EnvRef.DFC_BGOELWAF_C "used environment signals / Reference to used environment condition set for check DFC_BGOELWAF" VALUE 0x805049B5 Val_Wu8 1.00000000000 DFES_EnvTabVerb 0.00 1.00000000000 FORMAT "%13.11" /end CHARACTERISTIC
/begin CHARACTERISTIC DFES_EnvRef.DFC_BattUHiFailr_C "used environment signals / Reference to used environment condition set for check DFC_BattUHiFailr" VALUE 0x805049B6 Val_Wu8 1.00000000000 DFES_EnvTabVerb 0.00 1.00000000000 FORMAT "%13.11" /end CHARACTERISTIC
/begin CHARACTERISTIC DFES_EnvRef.DFC_BattULoFailr_C "used environment signals / Reference to used environment condition set for check DFC_BattULoFailr" VALUE 0x805049B7 Val_Wu8 1.00000000000 DFES_EnvTabVerb 0.00 1.00000000000 FORMAT "%13.11" /end CHARACTERISTIC
/begin CHARACTERISTIC DFES_EnvRef.DFC_BrkBstPDriftHiErr_C "used environment signals / Reference to used environment condition set for check DFC_BrkBstPDriftHiErr" VALUE 0x805049B8 Val_Wu8 1.00000000000 DFES_EnvTabVerb 0.00 1.00000000000 FORMAT "%13.11" /end CHARACTERISTIC
/begin CHARACTERISTIC DFES_EnvRef.DFC_BrkBstPDriftLoErr_C "used environment signals / Reference to used environment condition set for check DFC_BrkBstPDriftLoErr" VALUE 0x805049B9 Val_Wu8 1.00000000000 DFES_EnvTabVerb 0.00 1.00000000000 FORMAT "%13.11" /end CHARACTERISTIC
/begin CHARACTERISTIC DFES_EnvRef.DFC_BrkBstPSnsrStuck_C "used environment signals / Reference to used environment condition set for check DFC_BrkBstPSnsrStuck" VALUE 0x805049BA Val_Wu8 1.00000000000 DFES_EnvTabVerb 0.00 1.00000000000 FORMAT "%13.11" /end CHARACTERISTIC
/begin CHARACTERISTIC DFES_EnvRef.DFC_BrkMnSwtContOn_C "used environment signals / Reference to used environment condition set for check DFC_BrkMnSwtContOn" VALUE 0x805049BB Val_Wu8 1.00000000000 DFES_EnvTabVerb 0.00 1.00000000000 FORMAT "%13.11" /end CHARACTERISTIC
/begin CHARACTERISTIC DFES_EnvRef.DFC_BrkMnSwtNotStp_C "used environment signals / Reference to used environment condition set for check DFC_BrkMnSwtNotStp" VALUE 0x805049BC Val_Wu8 1.00000000000 DFES_EnvTabVerb 0.00 1.00000000000 FORMAT "%13.11" /end CHARACTERISTIC
/begin CHARACTERISTIC DFES_EnvRef.DFC_BrkNpl_C "used environment signals / Reference to used environment condition set for check DFC_BrkNpl" VALUE 0x805049BD Val_Wu8 1.00000000000 DFES_EnvTabVerb 0.00 1.00000000000 FORMAT "%13.11" /end CHARACTERISTIC
/begin CHARACTERISTIC DFES_EnvRef.DFC_BrkRdntSwtContOn_C "used environment signals / Reference to used environment condition set for check DFC_BrkRdntSwtContOn" VALUE 0x805049BE Val_Wu8 1.00000000000 DFES_EnvTabVerb 0.00 1.00000000000 FORMAT "%13.11" /end CHARACTERISTIC
/begin CHARACTERISTIC DFES_EnvRef.DFC_BrkRdntSwtNotStp_C "used environment signals / Reference to used environment condition set for check DFC_BrkRdntSwtNotStp" VALUE 0x805049BF Val_Wu8 1.00000000000 DFES_EnvTabVerb 0.00 1.00000000000 FORMAT "%13.11" /end CHARACTERISTIC
/begin CHARACTERISTIC DFES_EnvRef.DFC_Clth3ONStuck_C "used environment signals / Reference to used environment condition set for check DFC_Clth3ONStuck" VALUE 0x805049C0 Val_Wu8 1.00000000000 DFES_EnvTabVerb 0.00 1.00000000000 FORMAT "%13.11" /end CHARACTERISTIC
/begin CHARACTERISTIC DFES_EnvRef.DFC_Clth4OFFStuck_C "used environment signals / Reference to used environment condition set for check DFC_Clth4OFFStuck" VALUE 0x805049C1 Val_Wu8 1.00000000000 DFES_EnvTabVerb 0.00 1.00000000000 FORMAT "%13.11" /end CHARACTERISTIC
/begin CHARACTERISTIC DFES_EnvRef.DFC_ClthOFFStuck_C "used environment signals / Reference to used environment condition set for check DFC_ClthOFFStuck" VALUE 0x805049C2 Val_Wu8 1.00000000000 DFES_EnvTabVerb 0.00 1.00000000000 FORMAT "%13.11" /end CHARACTERISTIC
/begin CHARACTERISTIC DFES_EnvRef.DFC_ClthONStuck_C "used environment signals / Reference to used environment condition set for check DFC_ClthONStuck" VALUE 0x805049C3 Val_Wu8 1.00000000000 DFES_EnvTabVerb 0.00 1.00000000000 FORMAT "%13.11" /end CHARACTERISTIC
/begin CHARACTERISTIC DFES_EnvRef.DFC_ClthStkFailInfo_C "used environment signals / Reference to used environment condition set for check DFC_ClthStkFailInfo" VALUE 0x805049C4 Val_Wu8 1.00000000000 DFES_EnvTabVerb 0.00 1.00000000000 FORMAT "%13.11" /end CHARACTERISTIC
/begin CHARACTERISTIC DFES_EnvRef.DFC_ComACFailInfo_C "used environment signals / Reference to used environment condition set for check DFC_ComACFailInfo" VALUE 0x805049C5 Val_Wu8 1.00000000000 DFES_EnvTabVerb 0.00 1.00000000000 FORMAT "%13.11" /end CHARACTERISTIC
/begin CHARACTERISTIC DFES_EnvRef.DFC_ComATFTValErr_C "used environment signals / Reference to used environment condition set for check DFC_ComATFTValErr" VALUE 0x805049C6 Val_Wu8 1.00000000000 DFES_EnvTabVerb 0.00 1.00000000000 FORMAT "%13.11" /end CHARACTERISTIC
/begin CHARACTERISTIC DFES_EnvRef.DFC_ComATMILReq_C "used environment signals / Reference to used environment condition set for check DFC_ComATMILReq" VALUE 0x805049C7 Val_Wu8 1.00000000000 DFES_EnvTabVerb 0.00 1.00000000000 FORMAT "%13.11" /end CHARACTERISTIC
/begin CHARACTERISTIC DFES_EnvRef.DFC_ComAYCAChksum_C "used environment signals / Reference to used environment condition set for check DFC_ComAYCAChksum" VALUE 0x805049C8 Val_Wu8 1.00000000000 DFES_EnvTabVerb 0.00 1.00000000000 FORMAT "%13.11" /end CHARACTERISTIC
/begin CHARACTERISTIC DFES_EnvRef.DFC_ComAYCARingCnt_C "used environment signals / Reference to used environment condition set for check DFC_ComAYCARingCnt" VALUE 0x805049C9 Val_Wu8 1.00000000000 DFES_EnvTabVerb 0.00 1.00000000000 FORMAT "%13.11" /end CHARACTERISTIC
/begin CHARACTERISTIC DFES_EnvRef.DFC_ComAYCATOut_C "used environment signals / Reference to used environment condition set for check DFC_ComAYCATOut" VALUE 0x805049CA Val_Wu8 1.00000000000 DFES_EnvTabVerb 0.00 1.00000000000 FORMAT "%13.11" /end CHARACTERISTIC
/begin CHARACTERISTIC DFES_EnvRef.DFC_ComAYCDChkSum_C "used environment signals / Reference to used environment condition set for check DFC_ComAYCDChkSum" VALUE 0x805049CB Val_Wu8 1.00000000000 DFES_EnvTabVerb 0.00 1.00000000000 FORMAT "%13.11" /end CHARACTERISTIC
/begin CHARACTERISTIC DFES_EnvRef.DFC_ComAYCDTOut_C "used environment signals / Reference to used environment condition set for check DFC_ComAYCDTOut" VALUE 0x805049CC Val_Wu8 1.00000000000 DFES_EnvTabVerb 0.00 1.00000000000 FORMAT "%13.11" /end CHARACTERISTIC
/begin CHARACTERISTIC DFES_EnvRef.DFC_ComAYCFChksum_C "used environment signals / Reference to used environment condition set for check DFC_ComAYCFChksum" VALUE 0x805049CD Val_Wu8 1.00000000000 DFES_EnvTabVerb 0.00 1.00000000000 FORMAT "%13.11" /end CHARACTERISTIC
/begin CHARACTERISTIC DFES_EnvRef.DFC_ComAYCFRingCnt_C "used environment signals / Reference to used environment condition set for check DFC_ComAYCFRingCnt" VALUE 0x805049CE Val_Wu8 1.00000000000 DFES_EnvTabVerb 0.00 1.00000000000 FORMAT "%13.11" /end CHARACTERISTIC
/begin CHARACTERISTIC DFES_EnvRef.DFC_ComAYCFTOut_C "used environment signals / Reference to used environment condition set for check DFC_ComAYCFTOut" VALUE 0x805049CF Val_Wu8 1.00000000000 DFES_EnvTabVerb 0.00 1.00000000000 FORMAT "%13.11" /end CHARACTERISTIC
/begin CHARACTERISTIC DFES_EnvRef.DFC_ComAYCGChksum_C "used environment signals / Reference to used environment condition set for check DFC_ComAYCGChksum" VALUE 0x805049D0 Val_Wu8 1.00000000000 DFES_EnvTabVerb 0.00 1.00000000000 FORMAT "%13.11" /end CHARACTERISTIC
/begin CHARACTERISTIC DFES_EnvRef.DFC_ComAYCGRingCnt_C "used environment signals / Reference to used environment condition set for check DFC_ComAYCGRingCnt" VALUE 0x805049D1 Val_Wu8 1.00000000000 DFES_EnvTabVerb 0.00 1.00000000000 FORMAT "%13.11" /end CHARACTERISTIC
/begin CHARACTERISTIC DFES_EnvRef.DFC_ComAYCGTOut_C "used environment signals / Reference to used environment condition set for check DFC_ComAYCGTOut" VALUE 0x805049D2 Val_Wu8 1.00000000000 DFES_EnvTabVerb 0.00 1.00000000000 FORMAT "%13.11" /end CHARACTERISTIC
/begin CHARACTERISTIC DFES_EnvRef.DFC_ComAYCIChkSum_C "used environment signals / Reference to used environment condition set for check DFC_ComAYCIChkSum" VALUE 0x805049D3 Val_Wu8 1.00000000000 DFES_EnvTabVerb 0.00 1.00000000000 FORMAT "%13.11" /end CHARACTERISTIC
/begin CHARACTERISTIC DFES_EnvRef.DFC_ComAYCIRingCnt_C "used environment signals / Reference to used environment condition set for check DFC_ComAYCIRingCnt" VALUE 0x805049D4 Val_Wu8 1.00000000000 DFES_EnvTabVerb 0.00 1.00000000000 FORMAT "%13.11" /end CHARACTERISTIC
/begin CHARACTERISTIC DFES_EnvRef.DFC_ComAYCITOut_C "used environment signals / Reference to used environment condition set for check DFC_ComAYCITOut" VALUE 0x805049D5 Val_Wu8 1.00000000000 DFES_EnvTabVerb 0.00 1.00000000000 FORMAT "%13.11" /end CHARACTERISTIC
/begin CHARACTERISTIC DFES_EnvRef.DFC_ComBCM1ChkSum_C "used environment signals / Reference to used environment condition set for check DFC_ComBCM1ChkSum" VALUE 0x805049D6 Val_Wu8 1.00000000000 DFES_EnvTabVerb 0.00 1.00000000000 FORMAT "%13.11" /end CHARACTERISTIC
/begin CHARACTERISTIC DFES_EnvRef.DFC_ComBCM1RingCnt_C "used environment signals / Reference to used environment condition set for check DFC_ComBCM1RingCnt" VALUE 0x805049D7 Val_Wu8 1.00000000000 DFES_EnvTabVerb 0.00 1.00000000000 FORMAT "%13.11" /end CHARACTERISTIC
/begin CHARACTERISTIC DFES_EnvRef.DFC_ComBCM1TOut_C "used environment signals / Reference to used environment condition set for check DFC_ComBCM1TOut" VALUE 0x805049D8 Val_Wu8 1.00000000000 DFES_EnvTabVerb 0.00 1.00000000000 FORMAT "%13.11" /end CHARACTERISTIC
/begin CHARACTERISTIC DFES_EnvRef.DFC_ComCANABusOffErr_C "used environment signals / Reference to used environment condition set for check DFC_ComCANABusOffErr" VALUE 0x805049D9 Val_Wu8 1.00000000000 DFES_EnvTabVerb 0.00 1.00000000000 FORMAT "%13.11" /end CHARACTERISTIC
/begin CHARACTERISTIC DFES_EnvRef.DFC_ComCANBBusOffErr_C "used environment signals / Reference to used environment condition set for check DFC_ComCANBBusOffErr" VALUE 0x805049DA Val_Wu8 1.00000000000 DFES_EnvTabVerb 0.00 1.00000000000 FORMAT "%13.11" /end CHARACTERISTIC
/begin CHARACTERISTIC DFES_EnvRef.DFC_ComCANCBusOffErr_C "used environment signals / Reference to used environment condition set for check DFC_ComCANCBusOffErr" VALUE 0x805049DB Val_Wu8 1.00000000000 DFES_EnvTabVerb 0.00 1.00000000000 FORMAT "%13.11" /end CHARACTERISTIC
/begin CHARACTERISTIC DFES_EnvRef.DFC_ComCGW1ChkSum_C "used environment signals / Reference to used environment condition set for check DFC_ComCGW1ChkSum" VALUE 0x805049DC Val_Wu8 1.00000000000 DFES_EnvTabVerb 0.00 1.00000000000 FORMAT "%13.11" /end CHARACTERISTIC
/begin CHARACTERISTIC DFES_EnvRef.DFC_ComCGW1RingCnt_C "used environment signals / Reference to used environment condition set for check DFC_ComCGW1RingCnt" VALUE 0x805049DD Val_Wu8 1.00000000000 DFES_EnvTabVerb 0.00 1.00000000000 FORMAT "%13.11" /end CHARACTERISTIC
/begin CHARACTERISTIC DFES_EnvRef.DFC_ComCGW1TOut_C "used environment signals / Reference to used environment condition set for check DFC_ComCGW1TOut" VALUE 0x805049DE Val_Wu8 1.00000000000 DFES_EnvTabVerb 0.00 1.00000000000 FORMAT "%13.11" /end CHARACTERISTIC
/begin CHARACTERISTIC DFES_EnvRef.DFC_ComConvBoostErr_C "used environment signals / Reference to used environment condition set for check DFC_ComConvBoostErr" VALUE 0x805049DF Val_Wu8 1.00000000000 DFES_EnvTabVerb 0.00 1.00000000000 FORMAT "%13.11" /end CHARACTERISTIC
/begin CHARACTERISTIC DFES_EnvRef.DFC_ComConvSlipErr_C "used environment signals / Reference to used environment condition set for check DFC_ComConvSlipErr" VALUE 0x805049E0 Val_Wu8 1.00000000000 DFES_EnvTabVerb 0.00 1.00000000000 FORMAT "%13.11" /end CHARACTERISTIC
/begin CHARACTERISTIC DFES_EnvRef.DFC_ComDCDCPrfmncErr_C "used environment signals / Reference to used environment condition set for check DFC_ComDCDCPrfmncErr" VALUE 0x805049E1 Val_Wu8 1.00000000000 DFES_EnvTabVerb 0.00 1.00000000000 FORMAT "%13.11" /end CHARACTERISTIC
/begin CHARACTERISTIC DFES_EnvRef.DFC_ComDCDCTempWarn_C "used environment signals / Reference to used environment condition set for check DFC_ComDCDCTempWarn" VALUE 0x805049E2 Val_Wu8 1.00000000000 DFES_EnvTabVerb 0.00 1.00000000000 FORMAT "%13.11" /end CHARACTERISTIC
/begin CHARACTERISTIC DFES_EnvRef.DFC_ComEAT10Chksum_C "used environment signals / Reference to used environment condition set for check DFC_ComEAT10Chksum" VALUE 0x805049E3 Val_Wu8 1.00000000000 DFES_EnvTabVerb 0.00 1.00000000000 FORMAT "%13.11" /end CHARACTERISTIC
/begin CHARACTERISTIC DFES_EnvRef.DFC_ComEAT10RingCnt_C "used environment signals / Reference to used environment condition set for check DFC_ComEAT10RingCnt" VALUE 0x805049E4 Val_Wu8 1.00000000000 DFES_EnvTabVerb 0.00 1.00000000000 FORMAT "%13.11" /end CHARACTERISTIC
/begin CHARACTERISTIC DFES_EnvRef.DFC_ComEAT10TOut_C "used environment signals / Reference to used environment condition set for check DFC_ComEAT10TOut" VALUE 0x805049E5 Val_Wu8 1.00000000000 DFES_EnvTabVerb 0.00 1.00000000000 FORMAT "%13.11" /end CHARACTERISTIC
/begin CHARACTERISTIC DFES_EnvRef.DFC_ComEAT11ChkSum_C "used environment signals / Reference to used environment condition set for check DFC_ComEAT11ChkSum" VALUE 0x805049E6 Val_Wu8 1.00000000000 DFES_EnvTabVerb 0.00 1.00000000000 FORMAT "%13.11" /end CHARACTERISTIC
/begin CHARACTERISTIC DFES_EnvRef.DFC_ComEAT11RingCnt_C "used environment signals / Reference to used environment condition set for check DFC_ComEAT11RingCnt" VALUE 0x805049E7 Val_Wu8 1.00000000000 DFES_EnvTabVerb 0.00 1.00000000000 FORMAT "%13.11" /end CHARACTERISTIC
/begin CHARACTERISTIC DFES_EnvRef.DFC_ComEAT11TOut_C "used environment signals / Reference to used environment condition set for check DFC_ComEAT11TOut" VALUE 0x805049E8 Val_Wu8 1.00000000000 DFES_EnvTabVerb 0.00 1.00000000000 FORMAT "%13.11" /end CHARACTERISTIC
/begin CHARACTERISTIC DFES_EnvRef.DFC_ComEAT12ChkSum_C "used environment signals / Reference to used environment condition set for check DFC_ComEAT12ChkSum" VALUE 0x805049E9 Val_Wu8 1.00000000000 DFES_EnvTabVerb 0.00 1.00000000000 FORMAT "%13.11" /end CHARACTERISTIC
/begin CHARACTERISTIC DFES_EnvRef.DFC_ComEAT12RingCnt_C "used environment signals / Reference to used environment condition set for check DFC_ComEAT12RingCnt" VALUE 0x805049EA Val_Wu8 1.00000000000 DFES_EnvTabVerb 0.00 1.00000000000 FORMAT "%13.11" /end CHARACTERISTIC
/begin CHARACTERISTIC DFES_EnvRef.DFC_ComEAT12TOut_C "used environment signals / Reference to used environment condition set for check DFC_ComEAT12TOut" VALUE 0x805049EB Val_Wu8 1.00000000000 DFES_EnvTabVerb 0.00 1.00000000000 FORMAT "%13.11" /end CHARACTERISTIC
/begin CHARACTERISTIC DFES_EnvRef.DFC_ComEAT13ChkSum_C "used environment signals / Reference to used environment condition set for check DFC_ComEAT13ChkSum" VALUE 0x805049EC Val_Wu8 1.00000000000 DFES_EnvTabVerb 0.00 1.00000000000 FORMAT "%13.11" /end CHARACTERISTIC
/begin CHARACTERISTIC DFES_EnvRef.DFC_ComEAT13RingCnt_C "used environment signals / Reference to used environment condition set for check DFC_ComEAT13RingCnt" VALUE 0x805049ED Val_Wu8 1.00000000000 DFES_EnvTabVerb 0.00 1.00000000000 FORMAT "%13.11" /end CHARACTERISTIC
/begin CHARACTERISTIC DFES_EnvRef.DFC_ComEAT13TOut_C "used environment signals / Reference to used environment condition set for check DFC_ComEAT13TOut" VALUE 0x805049EE Val_Wu8 1.00000000000 DFES_EnvTabVerb 0.00 1.00000000000 FORMAT "%13.11" /end CHARACTERISTIC
/begin CHARACTERISTIC DFES_EnvRef.DFC_ComEAT1Chksum_C "used environment signals / Reference to used environment condition set for check DFC_ComEAT1Chksum" VALUE 0x805049EF Val_Wu8 1.00000000000 DFES_EnvTabVerb 0.00 1.00000000000 FORMAT "%13.11" /end CHARACTERISTIC
/begin CHARACTERISTIC DFES_EnvRef.DFC_ComEAT1RingCnt_C "used environment signals / Reference to used environment condition set for check DFC_ComEAT1RingCnt" VALUE 0x805049F0 Val_Wu8 1.00000000000 DFES_EnvTabVerb 0.00 1.00000000000 FORMAT "%13.11" /end CHARACTERISTIC
/begin CHARACTERISTIC DFES_EnvRef.DFC_ComEAT1TOut_C "used environment signals / Reference to used environment condition set for check DFC_ComEAT1TOut" VALUE 0x805049F1 Val_Wu8 1.00000000000 DFES_EnvTabVerb 0.00 1.00000000000 FORMAT "%13.11" /end CHARACTERISTIC
/begin CHARACTERISTIC DFES_EnvRef.DFC_ComEAT2ChkSum_C "used environment signals / Reference to used environment condition set for check DFC_ComEAT2ChkSum" VALUE 0x805049F2 Val_Wu8 1.00000000000 DFES_EnvTabVerb 0.00 1.00000000000 FORMAT "%13.11" /end CHARACTERISTIC
/begin CHARACTERISTIC DFES_EnvRef.DFC_ComEAT2RingCnt_C "used environment signals / Reference to used environment condition set for check DFC_ComEAT2RingCnt" VALUE 0x805049F3 Val_Wu8 1.00000000000 DFES_EnvTabVerb 0.00 1.00000000000 FORMAT "%13.11" /end CHARACTERISTIC
/begin CHARACTERISTIC DFES_EnvRef.DFC_ComEAT2TOut_C "used environment signals / Reference to used environment condition set for check DFC_ComEAT2TOut" VALUE 0x805049F4 Val_Wu8 1.00000000000 DFES_EnvTabVerb 0.00 1.00000000000 FORMAT "%13.11" /end CHARACTERISTIC
/begin CHARACTERISTIC DFES_EnvRef.DFC_ComEAT4ChkSum_C "used environment signals / Reference to used environment condition set for check DFC_ComEAT4ChkSum" VALUE 0x805049F5 Val_Wu8 1.00000000000 DFES_EnvTabVerb 0.00 1.00000000000 FORMAT "%13.11" /end CHARACTERISTIC
/begin CHARACTERISTIC DFES_EnvRef.DFC_ComEAT4RingCnt_C "used environment signals / Reference to used environment condition set for check DFC_ComEAT4RingCnt" VALUE 0x805049F6 Val_Wu8 1.00000000000 DFES_EnvTabVerb 0.00 1.00000000000 FORMAT "%13.11" /end CHARACTERISTIC
/begin CHARACTERISTIC DFES_EnvRef.DFC_ComEAT4TOut_C "used environment signals / Reference to used environment condition set for check DFC_ComEAT4TOut" VALUE 0x805049F7 Val_Wu8 1.00000000000 DFES_EnvTabVerb 0.00 1.00000000000 FORMAT "%13.11" /end CHARACTERISTIC
/begin CHARACTERISTIC DFES_EnvRef.DFC_ComEAT6Chksum_C "used environment signals / Reference to used environment condition set for check DFC_ComEAT6Chksum" VALUE 0x805049F8 Val_Wu8 1.00000000000 DFES_EnvTabVerb 0.00 1.00000000000 FORMAT "%13.11" /end CHARACTERISTIC
/begin CHARACTERISTIC DFES_EnvRef.DFC_ComEAT6RingCnt_C "used environment signals / Reference to used environment condition set for check DFC_ComEAT6RingCnt" VALUE 0x805049F9 Val_Wu8 1.00000000000 DFES_EnvTabVerb 0.00 1.00000000000 FORMAT "%13.11" /end CHARACTERISTIC
/begin CHARACTERISTIC DFES_EnvRef.DFC_ComEAT6TOut_C "used environment signals / Reference to used environment condition set for check DFC_ComEAT6TOut" VALUE 0x805049FA Val_Wu8 1.00000000000 DFES_EnvTabVerb 0.00 1.00000000000 FORMAT "%13.11" /end CHARACTERISTIC
/begin CHARACTERISTIC DFES_EnvRef.DFC_ComEAT7Chksum_C "used environment signals / Reference to used environment condition set for check DFC_ComEAT7Chksum" VALUE 0x805049FB Val_Wu8 1.00000000000 DFES_EnvTabVerb 0.00 1.00000000000 FORMAT "%13.11" /end CHARACTERISTIC
/begin CHARACTERISTIC DFES_EnvRef.DFC_ComEAT7RingCnt_C "used environment signals / Reference to used environment condition set for check DFC_ComEAT7RingCnt" VALUE 0x805049FC Val_Wu8 1.00000000000 DFES_EnvTabVerb 0.00 1.00000000000 FORMAT "%13.11" /end CHARACTERISTIC
/begin CHARACTERISTIC DFES_EnvRef.DFC_ComEAT7TOut_C "used environment signals / Reference to used environment condition set for check DFC_ComEAT7TOut" VALUE 0x805049FD Val_Wu8 1.00000000000 DFES_EnvTabVerb 0.00 1.00000000000 FORMAT "%13.11" /end CHARACTERISTIC
/begin CHARACTERISTIC DFES_EnvRef.DFC_ComEAT8Chksum_C "used environment signals / Reference to used environment condition set for check DFC_ComEAT8Chksum" VALUE 0x805049FE Val_Wu8 1.00000000000 DFES_EnvTabVerb 0.00 1.00000000000 FORMAT "%13.11" /end CHARACTERISTIC
/begin CHARACTERISTIC DFES_EnvRef.DFC_ComEAT8RingCnt_C "used environment signals / Reference to used environment condition set for check DFC_ComEAT8RingCnt" VALUE 0x805049FF Val_Wu8 1.00000000000 DFES_EnvTabVerb 0.00 1.00000000000 FORMAT "%13.11" /end CHARACTERISTIC
/begin CHARACTERISTIC DFES_EnvRef.DFC_ComEAT8TOut_C "used environment signals / Reference to used environment condition set for check DFC_ComEAT8TOut" VALUE 0x80504A00 Val_Wu8 1.00000000000 DFES_EnvTabVerb 0.00 1.00000000000 FORMAT "%13.11" /end CHARACTERISTIC
/begin CHARACTERISTIC DFES_EnvRef.DFC_ComEATAChksum_C "used environment signals / Reference to used environment condition set for check DFC_ComEATAChksum" VALUE 0x80504A01 Val_Wu8 1.00000000000 DFES_EnvTabVerb 0.00 1.00000000000 FORMAT "%13.11" /end CHARACTERISTIC
/begin CHARACTERISTIC DFES_EnvRef.DFC_ComEATARingCnt_C "used environment signals / Reference to used environment condition set for check DFC_ComEATARingCnt" VALUE 0x80504A02 Val_Wu8 1.00000000000 DFES_EnvTabVerb 0.00 1.00000000000 FORMAT "%13.11" /end CHARACTERISTIC
/begin CHARACTERISTIC DFES_EnvRef.DFC_ComEATATOut_C "used environment signals / Reference to used environment condition set for check DFC_ComEATATOut" VALUE 0x80504A03 Val_Wu8 1.00000000000 DFES_EnvTabVerb 0.00 1.00000000000 FORMAT "%13.11" /end CHARACTERISTIC
/begin CHARACTERISTIC DFES_EnvRef.DFC_ComEATBChkSum_C "used environment signals / Reference to used environment condition set for check DFC_ComEATBChkSum" VALUE 0x80504A04 Val_Wu8 1.00000000000 DFES_EnvTabVerb 0.00 1.00000000000 FORMAT "%13.11" /end CHARACTERISTIC
/begin CHARACTERISTIC DFES_EnvRef.DFC_ComEATBRingCnt_C "used environment signals / Reference to used environment condition set for check DFC_ComEATBRingCnt" VALUE 0x80504A05 Val_Wu8 1.00000000000 DFES_EnvTabVerb 0.00 1.00000000000 FORMAT "%13.11" /end CHARACTERISTIC
/begin CHARACTERISTIC DFES_EnvRef.DFC_ComEATBTOut_C "used environment signals / Reference to used environment condition set for check DFC_ComEATBTOut" VALUE 0x80504A06 Val_Wu8 1.00000000000 DFES_EnvTabVerb 0.00 1.00000000000 FORMAT "%13.11" /end CHARACTERISTIC
/begin CHARACTERISTIC DFES_EnvRef.DFC_ComEATCChksum_C "used environment signals / Reference to used environment condition set for check DFC_ComEATCChksum" VALUE 0x80504A07 Val_Wu8 1.00000000000 DFES_EnvTabVerb 0.00 1.00000000000 FORMAT "%13.11" /end CHARACTERISTIC
/begin CHARACTERISTIC DFES_EnvRef.DFC_ComEATCRingCnt_C "used environment signals / Reference to used environment condition set for check DFC_ComEATCRingCnt" VALUE 0x80504A08 Val_Wu8 1.00000000000 DFES_EnvTabVerb 0.00 1.00000000000 FORMAT "%13.11" /end CHARACTERISTIC
/begin CHARACTERISTIC DFES_EnvRef.DFC_ComEATCTOut_C "used environment signals / Reference to used environment condition set for check DFC_ComEATCTOut" VALUE 0x80504A09 Val_Wu8 1.00000000000 DFES_EnvTabVerb 0.00 1.00000000000 FORMAT "%13.11" /end CHARACTERISTIC
/begin CHARACTERISTIC DFES_EnvRef.DFC_ComEPBBChkSum_C "used environment signals / Reference to used environment condition set for check DFC_ComEPBBChkSum" VALUE 0x80504A0A Val_Wu8 1.00000000000 DFES_EnvTabVerb 0.00 1.00000000000 FORMAT "%13.11" /end CHARACTERISTIC
/begin CHARACTERISTIC DFES_EnvRef.DFC_ComEPBBRingCnt_C "used environment signals / Reference to used environment condition set for check DFC_ComEPBBRingCnt" VALUE 0x80504A0B Val_Wu8 1.00000000000 DFES_EnvTabVerb 0.00 1.00000000000 FORMAT "%13.11" /end CHARACTERISTIC
/begin CHARACTERISTIC DFES_EnvRef.DFC_ComEPBBTOut_C "used environment signals / Reference to used environment condition set for check DFC_ComEPBBTOut" VALUE 0x80504A0C Val_Wu8 1.00000000000 DFES_EnvTabVerb 0.00 1.00000000000 FORMAT "%13.11" /end CHARACTERISTIC
/begin CHARACTERISTIC DFES_EnvRef.DFC_ComEPBChksum_C "used environment signals / Reference to used environment condition set for check DFC_ComEPBChksum" VALUE 0x80504A0D Val_Wu8 1.00000000000 DFES_EnvTabVerb 0.00 1.00000000000 FORMAT "%13.11" /end CHARACTERISTIC
/begin CHARACTERISTIC DFES_EnvRef.DFC_ComEPBTOut_C "used environment signals / Reference to used environment condition set for check DFC_ComEPBTOut" VALUE 0x80504A0E Val_Wu8 1.00000000000 DFES_EnvTabVerb 0.00 1.00000000000 FORMAT "%13.11" /end CHARACTERISTIC
/begin CHARACTERISTIC DFES_EnvRef.DFC_ComEPBctRing_C "used environment signals / Reference to used environment condition set for check DFC_ComEPBctRing" VALUE 0x80504A0F Val_Wu8 1.00000000000 DFES_EnvTabVerb 0.00 1.00000000000 FORMAT "%13.11" /end CHARACTERISTIC
/begin CHARACTERISTIC DFES_EnvRef.DFC_ComEPS1Chksum_C "used environment signals / Reference to used environment condition set for check DFC_ComEPS1Chksum" VALUE 0x80504A10 Val_Wu8 1.00000000000 DFES_EnvTabVerb 0.00 1.00000000000 FORMAT "%13.11" /end CHARACTERISTIC
/begin CHARACTERISTIC DFES_EnvRef.DFC_ComEPS1RingCnt_C "used environment signals / Reference to used environment condition set for check DFC_ComEPS1RingCnt" VALUE 0x80504A11 Val_Wu8 1.00000000000 DFES_EnvTabVerb 0.00 1.00000000000 FORMAT "%13.11" /end CHARACTERISTIC
/begin CHARACTERISTIC DFES_EnvRef.DFC_ComEPS1TOut_C "used environment signals / Reference to used environment condition set for check DFC_ComEPS1TOut" VALUE 0x80504A12 Val_Wu8 1.00000000000 DFES_EnvTabVerb 0.00 1.00000000000 FORMAT "%13.11" /end CHARACTERISTIC
/begin CHARACTERISTIC DFES_EnvRef.DFC_ComEngCanRxErr_C "used environment signals / Reference to used environment condition set for check DFC_ComEngCanRxErr" VALUE 0x80504A13 Val_Wu8 1.00000000000 DFES_EnvTabVerb 0.00 1.00000000000 FORMAT "%13.11" /end CHARACTERISTIC
/begin CHARACTERISTIC DFES_EnvRef.DFC_ComGrvySnsrErr_C "used environment signals / Reference to used environment condition set for check DFC_ComGrvySnsrErr" VALUE 0x80504A14 Val_Wu8 1.00000000000 DFES_EnvTabVerb 0.00 1.00000000000 FORMAT "%13.11" /end CHARACTERISTIC
/begin CHARACTERISTIC DFES_EnvRef.DFC_ComGwIMG1ChkSum_C "used environment signals / Reference to used environment condition set for check DFC_ComGwIMG1ChkSum" VALUE 0x80504A15 Val_Wu8 1.00000000000 DFES_EnvTabVerb 0.00 1.00000000000 FORMAT "%13.11" /end CHARACTERISTIC
/begin CHARACTERISTIC DFES_EnvRef.DFC_ComGwIMG1RingCnt_C "used environment signals / Reference to used environment condition set for check DFC_ComGwIMG1RingCnt" VALUE 0x80504A16 Val_Wu8 1.00000000000 DFES_EnvTabVerb 0.00 1.00000000000 FORMAT "%13.11" /end CHARACTERISTIC
/begin CHARACTERISTIC DFES_EnvRef.DFC_ComGwIMG1TOut_C "used environment signals / Reference to used environment condition set for check DFC_ComGwIMG1TOut" VALUE 0x80504A17 Val_Wu8 1.00000000000 DFES_EnvTabVerb 0.00 1.00000000000 FORMAT "%13.11" /end CHARACTERISTIC
/begin CHARACTERISTIC DFES_EnvRef.DFC_ComGwIMG3ChkSum_C "used environment signals / Reference to used environment condition set for check DFC_ComGwIMG3ChkSum" VALUE 0x80504A18 Val_Wu8 1.00000000000 DFES_EnvTabVerb 0.00 1.00000000000 FORMAT "%13.11" /end CHARACTERISTIC
/begin CHARACTERISTIC DFES_EnvRef.DFC_ComGwIMG3RingCnt_C "used environment signals / Reference to used environment condition set for check DFC_ComGwIMG3RingCnt" VALUE 0x80504A19 Val_Wu8 1.00000000000 DFES_EnvTabVerb 0.00 1.00000000000 FORMAT "%13.11" /end CHARACTERISTIC
/begin CHARACTERISTIC DFES_EnvRef.DFC_ComGwIMG3TOut_C "used environment signals / Reference to used environment condition set for check DFC_ComGwIMG3TOut" VALUE 0x80504A1A Val_Wu8 1.00000000000 DFES_EnvTabVerb 0.00 1.00000000000 FORMAT "%13.11" /end CHARACTERISTIC
/begin CHARACTERISTIC DFES_EnvRef.DFC_ComGwIMG4ChkSum_C "used environment signals / Reference to used environment condition set for check DFC_ComGwIMG4ChkSum" VALUE 0x80504A1B Val_Wu8 1.00000000000 DFES_EnvTabVerb 0.00 1.00000000000 FORMAT "%13.11" /end CHARACTERISTIC
/begin CHARACTERISTIC DFES_EnvRef.DFC_ComGwIMG4RingCnt_C "used environment signals / Reference to used environment condition set for check DFC_ComGwIMG4RingCnt" VALUE 0x80504A1C Val_Wu8 1.00000000000 DFES_EnvTabVerb 0.00 1.00000000000 FORMAT "%13.11" /end CHARACTERISTIC
/begin CHARACTERISTIC DFES_EnvRef.DFC_ComGwIMG4TOut_C "used environment signals / Reference to used environment condition set for check DFC_ComGwIMG4TOut" VALUE 0x80504A1D Val_Wu8 1.00000000000 DFES_EnvTabVerb 0.00 1.00000000000 FORMAT "%13.11" /end CHARACTERISTIC
/begin CHARACTERISTIC DFES_EnvRef.DFC_ComGwIMG5ChkSum_C "used environment signals / Reference to used environment condition set for check DFC_ComGwIMG5ChkSum" VALUE 0x80504A1E Val_Wu8 1.00000000000 DFES_EnvTabVerb 0.00 1.00000000000 FORMAT "%13.11" /end CHARACTERISTIC
/begin CHARACTERISTIC DFES_EnvRef.DFC_ComGwIMG5RingCnt_C "used environment signals / Reference to used environment condition set for check DFC_ComGwIMG5RingCnt" VALUE 0x80504A1F Val_Wu8 1.00000000000 DFES_EnvTabVerb 0.00 1.00000000000 FORMAT "%13.11" /end CHARACTERISTIC
/begin CHARACTERISTIC DFES_EnvRef.DFC_ComGwIMG5TOut_C "used environment signals / Reference to used environment condition set for check DFC_ComGwIMG5TOut" VALUE 0x80504A20 Val_Wu8 1.00000000000 DFES_EnvTabVerb 0.00 1.00000000000 FORMAT "%13.11" /end CHARACTERISTIC
/begin CHARACTERISTIC DFES_EnvRef.DFC_ComGwIMG6ChkSum_C "used environment signals / Reference to used environment condition set for check DFC_ComGwIMG6ChkSum" VALUE 0x80504A21 Val_Wu8 1.00000000000 DFES_EnvTabVerb 0.00 1.00000000000 FORMAT "%13.11" /end CHARACTERISTIC
/begin CHARACTERISTIC DFES_EnvRef.DFC_ComGwIMG6RingCnt_C "used environment signals / Reference to used environment condition set for check DFC_ComGwIMG6RingCnt" VALUE 0x80504A22 Val_Wu8 1.00000000000 DFES_EnvTabVerb 0.00 1.00000000000 FORMAT "%13.11" /end CHARACTERISTIC
/begin CHARACTERISTIC DFES_EnvRef.DFC_ComGwIMG6TOut_C "used environment signals / Reference to used environment condition set for check DFC_ComGwIMG6TOut" VALUE 0x80504A23 Val_Wu8 1.00000000000 DFES_EnvTabVerb 0.00 1.00000000000 FORMAT "%13.11" /end CHARACTERISTIC
/begin CHARACTERISTIC DFES_EnvRef.DFC_ComIDASBChksum_C "used environment signals / Reference to used environment condition set for check DFC_ComIDASBChksum" VALUE 0x80504A24 Val_Wu8 1.00000000000 DFES_EnvTabVerb 0.00 1.00000000000 FORMAT "%13.11" /end CHARACTERISTIC
/begin CHARACTERISTIC DFES_EnvRef.DFC_ComIDASBRingCnt_C "used environment signals / Reference to used environment condition set for check DFC_ComIDASBRingCnt" VALUE 0x80504A25 Val_Wu8 1.00000000000 DFES_EnvTabVerb 0.00 1.00000000000 FORMAT "%13.11" /end CHARACTERISTIC
/begin CHARACTERISTIC DFES_EnvRef.DFC_ComIDASBTOut_C "used environment signals / Reference to used environment condition set for check DFC_ComIDASBTOut" VALUE 0x80504A26 Val_Wu8 1.00000000000 DFES_EnvTabVerb 0.00 1.00000000000 FORMAT "%13.11" /end CHARACTERISTIC
/begin CHARACTERISTIC DFES_EnvRef.DFC_ComIMGMILReq_C "used environment signals / Reference to used environment condition set for check DFC_ComIMGMILReq" VALUE 0x80504A27 Val_Wu8 1.00000000000 DFES_EnvTabVerb 0.00 1.00000000000 FORMAT "%13.11" /end CHARACTERISTIC
/begin CHARACTERISTIC DFES_EnvRef.DFC_ComISSPrms_C "used environment signals / Reference to used environment condition set for check DFC_ComISSPrms" VALUE 0x80504A28 Val_Wu8 1.00000000000 DFES_EnvTabVerb 0.00 1.00000000000 FORMAT "%13.11" /end CHARACTERISTIC
/begin CHARACTERISTIC DFES_EnvRef.DFC_ComMETAChksum_C "used environment signals / Reference to used environment condition set for check DFC_ComMETAChksum" VALUE 0x80504A29 Val_Wu8 1.00000000000 DFES_EnvTabVerb 0.00 1.00000000000 FORMAT "%13.11" /end CHARACTERISTIC
/begin CHARACTERISTIC DFES_EnvRef.DFC_ComMETAChksumPstDrv_C "used environment signals / Reference to used environment condition set for check DFC_ComMETAChksumPstDrv" VALUE 0x80504A2A Val_Wu8 1.00000000000 DFES_EnvTabVerb 0.00 1.00000000000 FORMAT "%13.11" /end CHARACTERISTIC
/begin CHARACTERISTIC DFES_EnvRef.DFC_ComMETARingCnt_C "used environment signals / Reference to used environment condition set for check DFC_ComMETARingCnt" VALUE 0x80504A2B Val_Wu8 1.00000000000 DFES_EnvTabVerb 0.00 1.00000000000 FORMAT "%13.11" /end CHARACTERISTIC
/begin CHARACTERISTIC DFES_EnvRef.DFC_ComMETARingCntPstDrv_C "used environment signals / Reference to used environment condition set for check DFC_ComMETARingCntPstDrv" VALUE 0x80504A2C Val_Wu8 1.00000000000 DFES_EnvTabVerb 0.00 1.00000000000 FORMAT "%13.11" /end CHARACTERISTIC
/begin CHARACTERISTIC DFES_EnvRef.DFC_ComMETATOut_C "used environment signals / Reference to used environment condition set for check DFC_ComMETATOut" VALUE 0x80504A2D Val_Wu8 1.00000000000 DFES_EnvTabVerb 0.00 1.00000000000 FORMAT "%13.11" /end CHARACTERISTIC
/begin CHARACTERISTIC DFES_EnvRef.DFC_ComMETATOutPstDrv_C "used environment signals / Reference to used environment condition set for check DFC_ComMETATOutPstDrv" VALUE 0x80504A2E Val_Wu8 1.00000000000 DFES_EnvTabVerb 0.00 1.00000000000 FORMAT "%13.11" /end CHARACTERISTIC
/begin CHARACTERISTIC DFES_EnvRef.DFC_ComMETCChksum_C "used environment signals / Reference to used environment condition set for check DFC_ComMETCChksum" VALUE 0x80504A2F Val_Wu8 1.00000000000 DFES_EnvTabVerb 0.00 1.00000000000 FORMAT "%13.11" /end CHARACTERISTIC
/begin CHARACTERISTIC DFES_EnvRef.DFC_ComMETCRingCnt_C "used environment signals / Reference to used environment condition set for check DFC_ComMETCRingCnt" VALUE 0x80504A30 Val_Wu8 1.00000000000 DFES_EnvTabVerb 0.00 1.00000000000 FORMAT "%13.11" /end CHARACTERISTIC
/begin CHARACTERISTIC DFES_EnvRef.DFC_ComMETCTOut_C "used environment signals / Reference to used environment condition set for check DFC_ComMETCTOut" VALUE 0x80504A31 Val_Wu8 1.00000000000 DFES_EnvTabVerb 0.00 1.00000000000 FORMAT "%13.11" /end CHARACTERISTIC
/begin CHARACTERISTIC DFES_EnvRef.DFC_ComMETDChksum_C "used environment signals / Reference to used environment condition set for check DFC_ComMETDChksum" VALUE 0x80504A32 Val_Wu8 1.00000000000 DFES_EnvTabVerb 0.00 1.00000000000 FORMAT "%13.11" /end CHARACTERISTIC
/begin CHARACTERISTIC DFES_EnvRef.DFC_ComMETDRingCnt_C "used environment signals / Reference to used environment condition set for check DFC_ComMETDRingCnt" VALUE 0x80504A33 Val_Wu8 1.00000000000 DFES_EnvTabVerb 0.00 1.00000000000 FORMAT "%13.11" /end CHARACTERISTIC
/begin CHARACTERISTIC DFES_EnvRef.DFC_ComMETDTOut_C "used environment signals / Reference to used environment condition set for check DFC_ComMETDTOut" VALUE 0x80504A34 Val_Wu8 1.00000000000 DFES_EnvTabVerb 0.00 1.00000000000 FORMAT "%13.11" /end CHARACTERISTIC
/begin CHARACTERISTIC DFES_EnvRef.DFC_ComMETE2Chksum_C "used environment signals / Reference to used environment condition set for check DFC_ComMETE2Chksum" VALUE 0x80504A35 Val_Wu8 1.00000000000 DFES_EnvTabVerb 0.00 1.00000000000 FORMAT "%13.11" /end CHARACTERISTIC
/begin CHARACTERISTIC DFES_EnvRef.DFC_ComMETE2RingCnt_C "used environment signals / Reference to used environment condition set for check DFC_ComMETE2RingCnt" VALUE 0x80504A36 Val_Wu8 1.00000000000 DFES_EnvTabVerb 0.00 1.00000000000 FORMAT "%13.11" /end CHARACTERISTIC
/begin CHARACTERISTIC DFES_EnvRef.DFC_ComMETE2TOut_C "used environment signals / Reference to used environment condition set for check DFC_ComMETE2TOut" VALUE 0x80504A37 Val_Wu8 1.00000000000 DFES_EnvTabVerb 0.00 1.00000000000 FORMAT "%13.11" /end CHARACTERISTIC
/begin CHARACTERISTIC DFES_EnvRef.DFC_ComMETFChksum_C "used environment signals / Reference to used environment condition set for check DFC_ComMETFChksum" VALUE 0x80504A38 Val_Wu8 1.00000000000 DFES_EnvTabVerb 0.00 1.00000000000 FORMAT "%13.11" /end CHARACTERISTIC
/begin CHARACTERISTIC DFES_EnvRef.DFC_ComMETFRingCnt_C "used environment signals / Reference to used environment condition set for check DFC_ComMETFRingCnt" VALUE 0x80504A39 Val_Wu8 1.00000000000 DFES_EnvTabVerb 0.00 1.00000000000 FORMAT "%13.11" /end CHARACTERISTIC
/begin CHARACTERISTIC DFES_EnvRef.DFC_ComMETFTOut_C "used environment signals / Reference to used environment condition set for check DFC_ComMETFTOut" VALUE 0x80504A3A Val_Wu8 1.00000000000 DFES_EnvTabVerb 0.00 1.00000000000 FORMAT "%13.11" /end CHARACTERISTIC
/begin CHARACTERISTIC DFES_EnvRef.DFC_ComMETGChksum_C "used environment signals / Reference to used environment condition set for check DFC_ComMETGChksum" VALUE 0x80504A3B Val_Wu8 1.00000000000 DFES_EnvTabVerb 0.00 1.00000000000 FORMAT "%13.11" /end CHARACTERISTIC
/begin CHARACTERISTIC DFES_EnvRef.DFC_ComMETGRingCnt_C "used environment signals / Reference to used environment condition set for check DFC_ComMETGRingCnt" VALUE 0x80504A3C Val_Wu8 1.00000000000 DFES_EnvTabVerb 0.00 1.00000000000 FORMAT "%13.11" /end CHARACTERISTIC
/begin CHARACTERISTIC DFES_EnvRef.DFC_ComMETGTOut_C "used environment signals / Reference to used environment condition set for check DFC_ComMETGTOut" VALUE 0x80504A3D Val_Wu8 1.00000000000 DFES_EnvTabVerb 0.00 1.00000000000 FORMAT "%13.11" /end CHARACTERISTIC
/begin CHARACTERISTIC DFES_EnvRef.DFC_ComMETH2Chksum_C "used environment signals / Reference to used environment condition set for check DFC_ComMETH2Chksum" VALUE 0x80504A3E Val_Wu8 1.00000000000 DFES_EnvTabVerb 0.00 1.00000000000 FORMAT "%13.11" /end CHARACTERISTIC
/begin CHARACTERISTIC DFES_EnvRef.DFC_ComMETH2RingCnt_C "used environment signals / Reference to used environment condition set for check DFC_ComMETH2RingCnt" VALUE 0x80504A3F Val_Wu8 1.00000000000 DFES_EnvTabVerb 0.00 1.00000000000 FORMAT "%13.11" /end CHARACTERISTIC
/begin CHARACTERISTIC DFES_EnvRef.DFC_ComMETH2TOut_C "used environment signals / Reference to used environment condition set for check DFC_ComMETH2TOut" VALUE 0x80504A40 Val_Wu8 1.00000000000 DFES_EnvTabVerb 0.00 1.00000000000 FORMAT "%13.11" /end CHARACTERISTIC
/begin CHARACTERISTIC DFES_EnvRef.DFC_ComMETHChksum_C "used environment signals / Reference to used environment condition set for check DFC_ComMETHChksum" VALUE 0x80504A41 Val_Wu8 1.00000000000 DFES_EnvTabVerb 0.00 1.00000000000 FORMAT "%13.11" /end CHARACTERISTIC
/begin CHARACTERISTIC DFES_EnvRef.DFC_ComMETHRingCnt_C "used environment signals / Reference to used environment condition set for check DFC_ComMETHRingCnt" VALUE 0x80504A42 Val_Wu8 1.00000000000 DFES_EnvTabVerb 0.00 1.00000000000 FORMAT "%13.11" /end CHARACTERISTIC
/begin CHARACTERISTIC DFES_EnvRef.DFC_ComMETHTOut_C "used environment signals / Reference to used environment condition set for check DFC_ComMETHTOut" VALUE 0x80504A43 Val_Wu8 1.00000000000 DFES_EnvTabVerb 0.00 1.00000000000 FORMAT "%13.11" /end CHARACTERISTIC
/begin CHARACTERISTIC DFES_EnvRef.DFC_ComMETIChksum_C "used environment signals / Reference to used environment condition set for check DFC_ComMETIChksum" VALUE 0x80504A44 Val_Wu8 1.00000000000 DFES_EnvTabVerb 0.00 1.00000000000 FORMAT "%13.11" /end CHARACTERISTIC
/begin CHARACTERISTIC DFES_EnvRef.DFC_ComMETIRingCnt_C "used environment signals / Reference to used environment condition set for check DFC_ComMETIRingCnt" VALUE 0x80504A45 Val_Wu8 1.00000000000 DFES_EnvTabVerb 0.00 1.00000000000 FORMAT "%13.11" /end CHARACTERISTIC
/begin CHARACTERISTIC DFES_EnvRef.DFC_ComMETITOut_C "used environment signals / Reference to used environment condition set for check DFC_ComMETITOut" VALUE 0x80504A46 Val_Wu8 1.00000000000 DFES_EnvTabVerb 0.00 1.00000000000 FORMAT "%13.11" /end CHARACTERISTIC
/begin CHARACTERISTIC DFES_EnvRef.DFC_ComMETKChksum_C "used environment signals / Reference to used environment condition set for check DFC_ComMETKChksum" VALUE 0x80504A47 Val_Wu8 1.00000000000 DFES_EnvTabVerb 0.00 1.00000000000 FORMAT "%13.11" /end CHARACTERISTIC
/begin CHARACTERISTIC DFES_EnvRef.DFC_ComMETKRingCnt_C "used environment signals / Reference to used environment condition set for check DFC_ComMETKRingCnt" VALUE 0x80504A48 Val_Wu8 1.00000000000 DFES_EnvTabVerb 0.00 1.00000000000 FORMAT "%13.11" /end CHARACTERISTIC
/begin CHARACTERISTIC DFES_EnvRef.DFC_ComMETKTOut_C "used environment signals / Reference to used environment condition set for check DFC_ComMETKTOut" VALUE 0x80504A49 Val_Wu8 1.00000000000 DFES_EnvTabVerb 0.00 1.00000000000 FORMAT "%13.11" /end CHARACTERISTIC
/begin CHARACTERISTIC DFES_EnvRef.DFC_ComMETLChksum_C "used environment signals / Reference to used environment condition set for check DFC_ComMETLChksum" VALUE 0x80504A4A Val_Wu8 1.00000000000 DFES_EnvTabVerb 0.00 1.00000000000 FORMAT "%13.11" /end CHARACTERISTIC
/begin CHARACTERISTIC DFES_EnvRef.DFC_ComMETLRingCnt_C "used environment signals / Reference to used environment condition set for check DFC_ComMETLRingCnt" VALUE 0x80504A4B Val_Wu8 1.00000000000 DFES_EnvTabVerb 0.00 1.00000000000 FORMAT "%13.11" /end CHARACTERISTIC
/begin CHARACTERISTIC DFES_EnvRef.DFC_ComMETLTOut_C "used environment signals / Reference to used environment condition set for check DFC_ComMETLTOut" VALUE 0x80504A4C Val_Wu8 1.00000000000 DFES_EnvTabVerb 0.00 1.00000000000 FORMAT "%13.11" /end CHARACTERISTIC
/begin CHARACTERISTIC DFES_EnvRef.DFC_ComMETMChksum_C "used environment signals / Reference to used environment condition set for check DFC_ComMETMChksum" VALUE 0x80504A4D Val_Wu8 1.00000000000 DFES_EnvTabVerb 0.00 1.00000000000 FORMAT "%13.11" /end CHARACTERISTIC
/begin CHARACTERISTIC DFES_EnvRef.DFC_ComMETMRingCnt_C "used environment signals / Reference to used environment condition set for check DFC_ComMETMRingCnt" VALUE 0x80504A4E Val_Wu8 1.00000000000 DFES_EnvTabVerb 0.00 1.00000000000 FORMAT "%13.11" /end CHARACTERISTIC
/begin CHARACTERISTIC DFES_EnvRef.DFC_ComMETMTOut_C "used environment signals / Reference to used environment condition set for check DFC_ComMETMTOut" VALUE 0x80504A4F Val_Wu8 1.00000000000 DFES_EnvTabVerb 0.00 1.00000000000 FORMAT "%13.11" /end CHARACTERISTIC
/begin CHARACTERISTIC DFES_EnvRef.DFC_ComMETNChksum_C "used environment signals / Reference to used environment condition set for check DFC_ComMETNChksum" VALUE 0x80504A50 Val_Wu8 1.00000000000 DFES_EnvTabVerb 0.00 1.00000000000 FORMAT "%13.11" /end CHARACTERISTIC
/begin CHARACTERISTIC DFES_EnvRef.DFC_ComMETNRingCnt_C "used environment signals / Reference to used environment condition set for check DFC_ComMETNRingCnt" VALUE 0x80504A51 Val_Wu8 1.00000000000 DFES_EnvTabVerb 0.00 1.00000000000 FORMAT "%13.11" /end CHARACTERISTIC
/begin CHARACTERISTIC DFES_EnvRef.DFC_ComMETNTOut_C "used environment signals / Reference to used environment condition set for check DFC_ComMETNTOut" VALUE 0x80504A52 Val_Wu8 1.00000000000 DFES_EnvTabVerb 0.00 1.00000000000 FORMAT "%13.11" /end CHARACTERISTIC
/begin CHARACTERISTIC DFES_EnvRef.DFC_ComMtrCom_C "used environment signals / Reference to used environment condition set for check DFC_ComMtrCom" VALUE 0x80504A53 Val_Wu8 1.00000000000 DFES_EnvTabVerb 0.00 1.00000000000 FORMAT "%13.11" /end CHARACTERISTIC
/begin CHARACTERISTIC DFES_EnvRef.DFC_ComPCUChkSum_C "used environment signals / Reference to used environment condition set for check DFC_ComPCUChkSum" VALUE 0x80504A54 Val_Wu8 1.00000000000 DFES_EnvTabVerb 0.00 1.00000000000 FORMAT "%13.11" /end CHARACTERISTIC
/begin CHARACTERISTIC DFES_EnvRef.DFC_ComPCURingCnt_C "used environment signals / Reference to used environment condition set for check DFC_ComPCURingCnt" VALUE 0x80504A55 Val_Wu8 1.00000000000 DFES_EnvTabVerb 0.00 1.00000000000 FORMAT "%13.11" /end CHARACTERISTIC
/begin CHARACTERISTIC DFES_EnvRef.DFC_ComPCUTOut_C "used environment signals / Reference to used environment condition set for check DFC_ComPCUTOut" VALUE 0x80504A56 Val_Wu8 1.00000000000 DFES_EnvTabVerb 0.00 1.00000000000 FORMAT "%13.11" /end CHARACTERISTIC
/begin CHARACTERISTIC DFES_EnvRef.DFC_ComSRSAChksum_C "used environment signals / Reference to used environment condition set for check DFC_ComSRSAChksum" VALUE 0x80504A57 Val_Wu8 1.00000000000 DFES_EnvTabVerb 0.00 1.00000000000 FORMAT "%13.11" /end CHARACTERISTIC
/begin CHARACTERISTIC DFES_EnvRef.DFC_ComSRSARingCnt_C "used environment signals / Reference to used environment condition set for check DFC_ComSRSARingCnt" VALUE 0x80504A58 Val_Wu8 1.00000000000 DFES_EnvTabVerb 0.00 1.00000000000 FORMAT "%13.11" /end CHARACTERISTIC
/begin CHARACTERISTIC DFES_EnvRef.DFC_ComSRSATOut_C "used environment signals / Reference to used environment condition set for check DFC_ComSRSATOut" VALUE 0x80504A59 Val_Wu8 1.00000000000 DFES_EnvTabVerb 0.00 1.00000000000 FORMAT "%13.11" /end CHARACTERISTIC
/begin CHARACTERISTIC DFES_EnvRef.DFC_ComSRSBChksum_C "used environment signals / Reference to used environment condition set for check DFC_ComSRSBChksum" VALUE 0x80504A5A Val_Wu8 1.00000000000 DFES_EnvTabVerb 0.00 1.00000000000 FORMAT "%13.11" /end CHARACTERISTIC
/begin CHARACTERISTIC DFES_EnvRef.DFC_ComSRSBRingCnt_C "used environment signals / Reference to used environment condition set for check DFC_ComSRSBRingCnt" VALUE 0x80504A5B Val_Wu8 1.00000000000 DFES_EnvTabVerb 0.00 1.00000000000 FORMAT "%13.11" /end CHARACTERISTIC
/begin CHARACTERISTIC DFES_EnvRef.DFC_ComSRSBTOut_C "used environment signals / Reference to used environment condition set for check DFC_ComSRSBTOut" VALUE 0x80504A5C Val_Wu8 1.00000000000 DFES_EnvTabVerb 0.00 1.00000000000 FORMAT "%13.11" /end CHARACTERISTIC
/begin CHARACTERISTIC DFES_EnvRef.DFC_ComSRSChksum_C "used environment signals / Reference to used environment condition set for check DFC_ComSRSChksum" VALUE 0x80504A5D Val_Wu8 1.00000000000 DFES_EnvTabVerb 0.00 1.00000000000 FORMAT "%13.11" /end CHARACTERISTIC
/begin CHARACTERISTIC DFES_EnvRef.DFC_ComSRSErr_C "used environment signals / Reference to used environment condition set for check DFC_ComSRSErr" VALUE 0x80504A5E Val_Wu8 1.00000000000 DFES_EnvTabVerb 0.00 1.00000000000 FORMAT "%13.11" /end CHARACTERISTIC
/begin CHARACTERISTIC DFES_EnvRef.DFC_ComSRSRingCnt_C "used environment signals / Reference to used environment condition set for check DFC_ComSRSRingCnt" VALUE 0x80504A5F Val_Wu8 1.00000000000 DFES_EnvTabVerb 0.00 1.00000000000 FORMAT "%13.11" /end CHARACTERISTIC
/begin CHARACTERISTIC DFES_EnvRef.DFC_ComSRSTOut_C "used environment signals / Reference to used environment condition set for check DFC_ComSRSTOut" VALUE 0x80504A60 Val_Wu8 1.00000000000 DFES_EnvTabVerb 0.00 1.00000000000 FORMAT "%13.11" /end CHARACTERISTIC
/begin CHARACTERISTIC DFES_EnvRef.DFC_ComVehSpdPndFltTCU_C "used environment signals / Reference to used environment condition set for check DFC_ComVehSpdPndFltTCU" VALUE 0x80504A61 Val_Wu8 1.00000000000 DFES_EnvTabVerb 0.00 1.00000000000 FORMAT "%13.11" /end CHARACTERISTIC
/begin CHARACTERISTIC DFES_EnvRef.DFC_EbsChartcCurrErr_C "used environment signals / Reference to used environment condition set for check DFC_EbsChartcCurrErr" VALUE 0x80504A62 Val_Wu8 1.00000000000 DFES_EnvTabVerb 0.00 1.00000000000 FORMAT "%13.11" /end CHARACTERISTIC
/begin CHARACTERISTIC DFES_EnvRef.DFC_EbsSelfDiagErr_C "used environment signals / Reference to used environment condition set for check DFC_EbsSelfDiagErr" VALUE 0x80504A63 Val_Wu8 1.00000000000 DFES_EnvTabVerb 0.00 1.00000000000 FORMAT "%13.11" /end CHARACTERISTIC
/begin CHARACTERISTIC DFES_EnvRef.DFC_GEVlvPhaCsersIntkB1_C "used environment signals / Reference to used environment condition set for check DFC_GEVlvPhaCsersIntkB1" VALUE 0x80504A64 Val_Wu8 1.00000000000 DFES_EnvTabVerb 0.00 1.00000000000 FORMAT "%13.11" /end CHARACTERISTIC
/begin CHARACTERISTIC DFES_EnvRef.DFC_GEVlvPhaPsOpenLoadIntkB1_C "used environment signals / Reference to used environment condition set for check DFC_GEVlvPhaPsOpenLoadIntkB1" VALUE 0x80504A65 Val_Wu8 1.00000000000 DFES_EnvTabVerb 0.00 1.00000000000 FORMAT "%13.11" /end CHARACTERISTIC
/begin CHARACTERISTIC DFES_EnvRef.DFC_GEVlvPhaPsShoToBattIntkB1_C "used environment signals / Reference to used environment condition set for check DFC_GEVlvPhaPsShoToBattIntkB1" VALUE 0x80504A66 Val_Wu8 1.00000000000 DFES_EnvTabVerb 0.00 1.00000000000 FORMAT "%13.11" /end CHARACTERISTIC
/begin CHARACTERISTIC DFES_EnvRef.DFC_GEVlvPhaPsShoToGndIntkB1_C "used environment signals / Reference to used environment condition set for check DFC_GEVlvPhaPsShoToGndIntkB1" VALUE 0x80504A67 Val_Wu8 1.00000000000 DFES_EnvTabVerb 0.00 1.00000000000 FORMAT "%13.11" /end CHARACTERISTIC
/begin CHARACTERISTIC DFES_EnvRef.DFC_GbxCANDigPlausErr_C "used environment signals / Reference to used environment condition set for check DFC_GbxCANDigPlausErr" VALUE 0x80504A68 Val_Wu8 1.00000000000 DFES_EnvTabVerb 0.00 1.00000000000 FORMAT "%13.11" /end CHARACTERISTIC
/begin CHARACTERISTIC DFES_EnvRef.DFC_GbxNPos1SRCMax_C "used environment signals / Reference to used environment condition set for check DFC_GbxNPos1SRCMax" VALUE 0x80504A69 Val_Wu8 1.00000000000 DFES_EnvTabVerb 0.00 1.00000000000 FORMAT "%13.11" /end CHARACTERISTIC
/begin CHARACTERISTIC DFES_EnvRef.DFC_GbxNPos1SRCMin_C "used environment signals / Reference to used environment condition set for check DFC_GbxNPos1SRCMin" VALUE 0x80504A6A Val_Wu8 1.00000000000 DFES_EnvTabVerb 0.00 1.00000000000 FORMAT "%13.11" /end CHARACTERISTIC
/begin CHARACTERISTIC DFES_EnvRef.DFC_GbxNPos2SRCMax_C "used environment signals / Reference to used environment condition set for check DFC_GbxNPos2SRCMax" VALUE 0x80504A6B Val_Wu8 1.00000000000 DFES_EnvTabVerb 0.00 1.00000000000 FORMAT "%13.11" /end CHARACTERISTIC
/begin CHARACTERISTIC DFES_EnvRef.DFC_GbxNPos2SRCMin_C "used environment signals / Reference to used environment condition set for check DFC_GbxNPos2SRCMin" VALUE 0x80504A6C Val_Wu8 1.00000000000 DFES_EnvTabVerb 0.00 1.00000000000 FORMAT "%13.11" /end CHARACTERISTIC
/begin CHARACTERISTIC DFES_EnvRef.DFC_GbxNPosAlvChk_C "used environment signals / Reference to used environment condition set for check DFC_GbxNPosAlvChk" VALUE 0x80504A6D Val_Wu8 1.00000000000 DFES_EnvTabVerb 0.00 1.00000000000 FORMAT "%13.11" /end CHARACTERISTIC
/begin CHARACTERISTIC DFES_EnvRef.DFC_GbxNPosSyncErr_C "used environment signals / Reference to used environment condition set for check DFC_GbxNPosSyncErr" VALUE 0x80504A6E Val_Wu8 1.00000000000 DFES_EnvTabVerb 0.00 1.00000000000 FORMAT "%13.11" /end CHARACTERISTIC
/begin CHARACTERISTIC DFES_EnvRef.DFC_HEGOS2B1HtrPsMax_C "used environment signals / Reference to used environment condition set for check DFC_HEGOS2B1HtrPsMax" VALUE 0x80504A6F Val_Wu8 1.00000000000 DFES_EnvTabVerb 0.00 1.00000000000 FORMAT "%13.11" /end CHARACTERISTIC
/begin CHARACTERISTIC DFES_EnvRef.DFC_HEGOS2B1HtrPsMin_C "used environment signals / Reference to used environment condition set for check DFC_HEGOS2B1HtrPsMin" VALUE 0x80504A70 Val_Wu8 1.00000000000 DFES_EnvTabVerb 0.00 1.00000000000 FORMAT "%13.11" /end CHARACTERISTIC
/begin CHARACTERISTIC DFES_EnvRef.DFC_HEGOS2B1HtrPsSig_C "used environment signals / Reference to used environment condition set for check DFC_HEGOS2B1HtrPsSig" VALUE 0x80504A71 Val_Wu8 1.00000000000 DFES_EnvTabVerb 0.00 1.00000000000 FORMAT "%13.11" /end CHARACTERISTIC
/begin CHARACTERISTIC DFES_EnvRef.DFC_LinCSErrACG_C "used environment signals / Reference to used environment condition set for check DFC_LinCSErrACG" VALUE 0x80504A72 Val_Wu8 1.00000000000 DFES_EnvTabVerb 0.00 1.00000000000 FORMAT "%13.11" /end CHARACTERISTIC
/begin CHARACTERISTIC DFES_EnvRef.DFC_LinCSErrAEV_C "used environment signals / Reference to used environment condition set for check DFC_LinCSErrAEV" VALUE 0x80504A73 Val_Wu8 1.00000000000 DFES_EnvTabVerb 0.00 1.00000000000 FORMAT "%13.11" /end CHARACTERISTIC
/begin CHARACTERISTIC DFES_EnvRef.DFC_LinCSErrDCDC_C "used environment signals / Reference to used environment condition set for check DFC_LinCSErrDCDC" VALUE 0x80504A74 Val_Wu8 1.00000000000 DFES_EnvTabVerb 0.00 1.00000000000 FORMAT "%13.11" /end CHARACTERISTIC
/begin CHARACTERISTIC DFES_EnvRef.DFC_LinCSErrEBS_C "used environment signals / Reference to used environment condition set for check DFC_LinCSErrEBS" VALUE 0x80504A75 Val_Wu8 1.00000000000 DFES_EnvTabVerb 0.00 1.00000000000 FORMAT "%13.11" /end CHARACTERISTIC
/begin CHARACTERISTIC DFES_EnvRef.DFC_LinHdrTimeoutErrACG_C "used environment signals / Reference to used environment condition set for check DFC_LinHdrTimeoutErrACG" VALUE 0x80504A76 Val_Wu8 1.00000000000 DFES_EnvTabVerb 0.00 1.00000000000 FORMAT "%13.11" /end CHARACTERISTIC
/begin CHARACTERISTIC DFES_EnvRef.DFC_LinHdrTimeoutErrAEV_C "used environment signals / Reference to used environment condition set for check DFC_LinHdrTimeoutErrAEV" VALUE 0x80504A77 Val_Wu8 1.00000000000 DFES_EnvTabVerb 0.00 1.00000000000 FORMAT "%13.11" /end CHARACTERISTIC
/begin CHARACTERISTIC DFES_EnvRef.DFC_LinHdrTimeoutErrDCDC_C "used environment signals / Reference to used environment condition set for check DFC_LinHdrTimeoutErrDCDC" VALUE 0x80504A78 Val_Wu8 1.00000000000 DFES_EnvTabVerb 0.00 1.00000000000 FORMAT "%13.11" /end CHARACTERISTIC
/begin CHARACTERISTIC DFES_EnvRef.DFC_LinHdrTimeoutErrEBS_C "used environment signals / Reference to used environment condition set for check DFC_LinHdrTimeoutErrEBS" VALUE 0x80504A79 Val_Wu8 1.00000000000 DFES_EnvTabVerb 0.00 1.00000000000 FORMAT "%13.11" /end CHARACTERISTIC
/begin CHARACTERISTIC DFES_EnvRef.DFC_LinMsgTimeoutErrACG_C "used environment signals / Reference to used environment condition set for check DFC_LinMsgTimeoutErrACG" VALUE 0x80504A7A Val_Wu8 1.00000000000 DFES_EnvTabVerb 0.00 1.00000000000 FORMAT "%13.11" /end CHARACTERISTIC
/begin CHARACTERISTIC DFES_EnvRef.DFC_LinMsgTimeoutErrAEV_C "used environment signals / Reference to used environment condition set for check DFC_LinMsgTimeoutErrAEV" VALUE 0x80504A7B Val_Wu8 1.00000000000 DFES_EnvTabVerb 0.00 1.00000000000 FORMAT "%13.11" /end CHARACTERISTIC
/begin CHARACTERISTIC DFES_EnvRef.DFC_LinMsgTimeoutErrDCDC_C "used environment signals / Reference to used environment condition set for check DFC_LinMsgTimeoutErrDCDC" VALUE 0x80504A7C Val_Wu8 1.00000000000 DFES_EnvTabVerb 0.00 1.00000000000 FORMAT "%13.11" /end CHARACTERISTIC
/begin CHARACTERISTIC DFES_EnvRef.DFC_LinMsgTimeoutErrEBS_C "used environment signals / Reference to used environment condition set for check DFC_LinMsgTimeoutErrEBS" VALUE 0x80504A7D Val_Wu8 1.00000000000 DFES_EnvTabVerb 0.00 1.00000000000 FORMAT "%13.11" /end CHARACTERISTIC
/begin CHARACTERISTIC DFES_EnvRef.DFC_LinNoStrtComErr_C "used environment signals / Reference to used environment condition set for check DFC_LinNoStrtComErr" VALUE 0x80504A7E Val_Wu8 1.00000000000 DFES_EnvTabVerb 0.00 1.00000000000 FORMAT "%13.11" /end CHARACTERISTIC
/begin CHARACTERISTIC DFES_EnvRef.DFC_LowPresOilP_C "used environment signals / Reference to used environment condition set for check DFC_LowPresOilP" VALUE 0x80504A7F Val_Wu8 1.00000000000 DFES_EnvTabVerb 0.00 1.00000000000 FORMAT "%13.11" /end CHARACTERISTIC
/begin CHARACTERISTIC DFES_EnvRef.DFC_MisfDetVWhlFrntLeOORHi_C "used environment signals / Reference to used environment condition set for check DFC_MisfDetVWhlFrntLeOORHi" VALUE 0x80504A80 Val_Wu8 1.00000000000 DFES_EnvTabVerb 0.00 1.00000000000 FORMAT "%13.11" /end CHARACTERISTIC
/begin CHARACTERISTIC DFES_EnvRef.DFC_MisfDetVWhlFrntLeRatyHi_C "used environment signals / Reference to used environment condition set for check DFC_MisfDetVWhlFrntLeRatyHi" VALUE 0x80504A81 Val_Wu8 1.00000000000 DFES_EnvTabVerb 0.00 1.00000000000 FORMAT "%13.11" /end CHARACTERISTIC
/begin CHARACTERISTIC DFES_EnvRef.DFC_MisfDetVWhlFrntLeRatyLo_C "used environment signals / Reference to used environment condition set for check DFC_MisfDetVWhlFrntLeRatyLo" VALUE 0x80504A82 Val_Wu8 1.00000000000 DFES_EnvTabVerb 0.00 1.00000000000 FORMAT "%13.11" /end CHARACTERISTIC
/begin CHARACTERISTIC DFES_EnvRef.DFC_MisfDetVWhlFrntLeStuck_C "used environment signals / Reference to used environment condition set for check DFC_MisfDetVWhlFrntLeStuck" VALUE 0x80504A83 Val_Wu8 1.00000000000 DFES_EnvTabVerb 0.00 1.00000000000 FORMAT "%13.11" /end CHARACTERISTIC
/begin CHARACTERISTIC DFES_EnvRef.DFC_MisfDetVWhlFrntRiOORHi_C "used environment signals / Reference to used environment condition set for check DFC_MisfDetVWhlFrntRiOORHi" VALUE 0x80504A84 Val_Wu8 1.00000000000 DFES_EnvTabVerb 0.00 1.00000000000 FORMAT "%13.11" /end CHARACTERISTIC
/begin CHARACTERISTIC DFES_EnvRef.DFC_MisfDetVWhlFrntRiRatyHi_C "used environment signals / Reference to used environment condition set for check DFC_MisfDetVWhlFrntRiRatyHi" VALUE 0x80504A85 Val_Wu8 1.00000000000 DFES_EnvTabVerb 0.00 1.00000000000 FORMAT "%13.11" /end CHARACTERISTIC
/begin CHARACTERISTIC DFES_EnvRef.DFC_MisfDetVWhlFrntRiRatyLo_C "used environment signals / Reference to used environment condition set for check DFC_MisfDetVWhlFrntRiRatyLo" VALUE 0x80504A86 Val_Wu8 1.00000000000 DFES_EnvTabVerb 0.00 1.00000000000 FORMAT "%13.11" /end CHARACTERISTIC
/begin CHARACTERISTIC DFES_EnvRef.DFC_MisfDetVWhlFrntRiStuck_C "used environment signals / Reference to used environment condition set for check DFC_MisfDetVWhlFrntRiStuck" VALUE 0x80504A87 Val_Wu8 1.00000000000 DFES_EnvTabVerb 0.00 1.00000000000 FORMAT "%13.11" /end CHARACTERISTIC
/begin CHARACTERISTIC DFES_EnvRef.DFC_MisfDetVWhlReLeOORHi_C "used environment signals / Reference to used environment condition set for check DFC_MisfDetVWhlReLeOORHi" VALUE 0x80504A88 Val_Wu8 1.00000000000 DFES_EnvTabVerb 0.00 1.00000000000 FORMAT "%13.11" /end CHARACTERISTIC
/begin CHARACTERISTIC DFES_EnvRef.DFC_MisfDetVWhlReLeRatyHi_C "used environment signals / Reference to used environment condition set for check DFC_MisfDetVWhlReLeRatyHi" VALUE 0x80504A89 Val_Wu8 1.00000000000 DFES_EnvTabVerb 0.00 1.00000000000 FORMAT "%13.11" /end CHARACTERISTIC
/begin CHARACTERISTIC DFES_EnvRef.DFC_MisfDetVWhlReLeRatyLo_C "used environment signals / Reference to used environment condition set for check DFC_MisfDetVWhlReLeRatyLo" VALUE 0x80504A8A Val_Wu8 1.00000000000 DFES_EnvTabVerb 0.00 1.00000000000 FORMAT "%13.11" /end CHARACTERISTIC
/begin CHARACTERISTIC DFES_EnvRef.DFC_MisfDetVWhlReLeStuck_C "used environment signals / Reference to used environment condition set for check DFC_MisfDetVWhlReLeStuck" VALUE 0x80504A8B Val_Wu8 1.00000000000 DFES_EnvTabVerb 0.00 1.00000000000 FORMAT "%13.11" /end CHARACTERISTIC
/begin CHARACTERISTIC DFES_EnvRef.DFC_MisfDetVWhlReRiOORHi_C "used environment signals / Reference to used environment condition set for check DFC_MisfDetVWhlReRiOORHi" VALUE 0x80504A8C Val_Wu8 1.00000000000 DFES_EnvTabVerb 0.00 1.00000000000 FORMAT "%13.11" /end CHARACTERISTIC
/begin CHARACTERISTIC DFES_EnvRef.DFC_MisfDetVWhlReRiRatyHi_C "used environment signals / Reference to used environment condition set for check DFC_MisfDetVWhlReRiRatyHi" VALUE 0x80504A8D Val_Wu8 1.00000000000 DFES_EnvTabVerb 0.00 1.00000000000 FORMAT "%13.11" /end CHARACTERISTIC
/begin CHARACTERISTIC DFES_EnvRef.DFC_MisfDetVWhlReRiRatyLo_C "used environment signals / Reference to used environment condition set for check DFC_MisfDetVWhlReRiRatyLo" VALUE 0x80504A8E Val_Wu8 1.00000000000 DFES_EnvTabVerb 0.00 1.00000000000 FORMAT "%13.11" /end CHARACTERISTIC
/begin CHARACTERISTIC DFES_EnvRef.DFC_MisfDetVWhlReRiStuck_C "used environment signals / Reference to used environment condition set for check DFC_MisfDetVWhlReRiStuck" VALUE 0x80504A8F Val_Wu8 1.00000000000 DFES_EnvTabVerb 0.00 1.00000000000 FORMAT "%13.11" /end CHARACTERISTIC
/begin CHARACTERISTIC DFES_EnvRef.DFC_MisfDetdVWhlFrntLePlaus_C "used environment signals / Reference to used environment condition set for check DFC_MisfDetdVWhlFrntLePlaus" VALUE 0x80504A90 Val_Wu8 1.00000000000 DFES_EnvTabVerb 0.00 1.00000000000 FORMAT "%13.11" /end CHARACTERISTIC
/begin CHARACTERISTIC DFES_EnvRef.DFC_MisfDetdVWhlFrntRiPlaus_C "used environment signals / Reference to used environment condition set for check DFC_MisfDetdVWhlFrntRiPlaus" VALUE 0x80504A91 Val_Wu8 1.00000000000 DFES_EnvTabVerb 0.00 1.00000000000 FORMAT "%13.11" /end CHARACTERISTIC
/begin CHARACTERISTIC DFES_EnvRef.DFC_MisfDetdVWhlReLePlaus_C "used environment signals / Reference to used environment condition set for check DFC_MisfDetdVWhlReLePlaus" VALUE 0x80504A92 Val_Wu8 1.00000000000 DFES_EnvTabVerb 0.00 1.00000000000 FORMAT "%13.11" /end CHARACTERISTIC
/begin CHARACTERISTIC DFES_EnvRef.DFC_MisfDetdVWhlReRiPlaus_C "used environment signals / Reference to used environment condition set for check DFC_MisfDetdVWhlReRiPlaus" VALUE 0x80504A93 Val_Wu8 1.00000000000 DFES_EnvTabVerb 0.00 1.00000000000 FORMAT "%13.11" /end CHARACTERISTIC
/begin CHARACTERISTIC DFES_EnvRef.DFC_PEnvSigRngMax_C "used environment signals / Reference to used environment condition set for check DFC_PEnvSigRngMax" VALUE 0x80504A94 Val_Wu8 1.00000000000 DFES_EnvTabVerb 0.00 1.00000000000 FORMAT "%13.11" /end CHARACTERISTIC
/begin CHARACTERISTIC DFES_EnvRef.DFC_PEnvSigRngMin_C "used environment signals / Reference to used environment condition set for check DFC_PEnvSigRngMin" VALUE 0x80504A95 Val_Wu8 1.00000000000 DFES_EnvTabVerb 0.00 1.00000000000 FORMAT "%13.11" /end CHARACTERISTIC
/begin CHARACTERISTIC DFES_EnvRef.DFC_StmFault_C "used environment signals / Reference to used environment condition set for check DFC_StmFault" VALUE 0x80504A96 Val_Wu8 1.00000000000 DFES_EnvTabVerb 0.00 1.00000000000 FORMAT "%13.11" /end CHARACTERISTIC
/begin CHARACTERISTIC DFES_EnvRef.DFC_StrtCtOffPth_C "used environment signals / Reference to used environment condition set for check DFC_StrtCtOffPth" VALUE 0x80504A97 Val_Wu8 1.00000000000 DFES_EnvTabVerb 0.00 1.00000000000 FORMAT "%13.11" /end CHARACTERISTIC
/begin CHARACTERISTIC DFES_EnvRef.DFC_StrtCtlErr_C "used environment signals / Reference to used environment condition set for check DFC_StrtCtlErr" VALUE 0x80504A98 Val_Wu8 1.00000000000 DFES_EnvTabVerb 0.00 1.00000000000 FORMAT "%13.11" /end CHARACTERISTIC
/begin CHARACTERISTIC DFES_EnvRef.DFC_StrtFault_C "used environment signals / Reference to used environment condition set for check DFC_StrtFault" VALUE 0x80504A99 Val_Wu8 1.00000000000 DFES_EnvTabVerb 0.00 1.00000000000 FORMAT "%13.11" /end CHARACTERISTIC
/begin CHARACTERISTIC DFES_EnvRef.DFC_StrtLckJudg1_C "used environment signals / Reference to used environment condition set for check DFC_StrtLckJudg1" VALUE 0x80504A9A Val_Wu8 1.00000000000 DFES_EnvTabVerb 0.00 1.00000000000 FORMAT "%13.11" /end CHARACTERISTIC
/begin CHARACTERISTIC DFES_EnvRef.DFC_StrtLckJudg2_C "used environment signals / Reference to used environment condition set for check DFC_StrtLckJudg2" VALUE 0x80504A9B Val_Wu8 1.00000000000 DFES_EnvTabVerb 0.00 1.00000000000 FORMAT "%13.11" /end CHARACTERISTIC
/begin CHARACTERISTIC DFES_EnvRef.DFC_StrtOL_C "used environment signals / Reference to used environment condition set for check DFC_StrtOL" VALUE 0x80504A9C Val_Wu8 1.00000000000 DFES_EnvTabVerb 0.00 1.00000000000 FORMAT "%13.11" /end CHARACTERISTIC
/begin CHARACTERISTIC DFES_EnvRef.DFC_StrtOL2_C "used environment signals / Reference to used environment condition set for check DFC_StrtOL2" VALUE 0x80504A9D Val_Wu8 1.00000000000 DFES_EnvTabVerb 0.00 1.00000000000 FORMAT "%13.11" /end CHARACTERISTIC
/begin CHARACTERISTIC DFES_EnvRef.DFC_StrtSCB_C "used environment signals / Reference to used environment condition set for check DFC_StrtSCB" VALUE 0x80504A9E Val_Wu8 1.00000000000 DFES_EnvTabVerb 0.00 1.00000000000 FORMAT "%13.11" /end CHARACTERISTIC
/begin CHARACTERISTIC DFES_EnvRef.DFC_StrtSCB2_C "used environment signals / Reference to used environment condition set for check DFC_StrtSCB2" VALUE 0x80504A9F Val_Wu8 1.00000000000 DFES_EnvTabVerb 0.00 1.00000000000 FORMAT "%13.11" /end CHARACTERISTIC
/begin CHARACTERISTIC DFES_EnvRef.DFC_StrtSCG_C "used environment signals / Reference to used environment condition set for check DFC_StrtSCG" VALUE 0x80504AA0 Val_Wu8 1.00000000000 DFES_EnvTabVerb 0.00 1.00000000000 FORMAT "%13.11" /end CHARACTERISTIC
/begin CHARACTERISTIC DFES_EnvRef.DFC_StrtSCG2_C "used environment signals / Reference to used environment condition set for check DFC_StrtSCG2" VALUE 0x80504AA1 Val_Wu8 1.00000000000 DFES_EnvTabVerb 0.00 1.00000000000 FORMAT "%13.11" /end CHARACTERISTIC
/begin CHARACTERISTIC DFES_EnvRef.DFC_StrtStkRly1_C "used environment signals / Reference to used environment condition set for check DFC_StrtStkRly1" VALUE 0x80504AA2 Val_Wu8 1.00000000000 DFES_EnvTabVerb 0.00 1.00000000000 FORMAT "%13.11" /end CHARACTERISTIC
/begin CHARACTERISTIC DFES_EnvRef.DFC_StrtStkRly2_C "used environment signals / Reference to used environment condition set for check DFC_StrtStkRly2" VALUE 0x80504AA3 Val_Wu8 1.00000000000 DFES_EnvTabVerb 0.00 1.00000000000 FORMAT "%13.11" /end CHARACTERISTIC
/begin CHARACTERISTIC DFES_EnvRef.DFC_TEVEmax_C "used environment signals / Reference to used environment condition set for check DFC_TEVEmax" VALUE 0x80504AA4 Val_Wu8 1.00000000000 DFES_EnvTabVerb 0.00 1.00000000000 FORMAT "%13.11" /end CHARACTERISTIC
/begin CHARACTERISTIC DFES_EnvRef.DFC_TEVEmin_C "used environment signals / Reference to used environment condition set for check DFC_TEVEmin" VALUE 0x80504AA5 Val_Wu8 1.00000000000 DFES_EnvTabVerb 0.00 1.00000000000 FORMAT "%13.11" /end CHARACTERISTIC
/begin CHARACTERISTIC DFES_EnvRef.DFC_TEVEsig_C "used environment signals / Reference to used environment condition set for check DFC_TEVEsig" VALUE 0x80504AA6 Val_Wu8 1.00000000000 DFES_EnvTabVerb 0.00 1.00000000000 FORMAT "%13.11" /end CHARACTERISTIC
/begin CHARACTERISTIC DFES_EnvRef.DFC_UegoHeatrPrfmncLoS1B1_C "used environment signals / Reference to used environment condition set for check DFC_UegoHeatrPrfmncLoS1B1" VALUE 0x80504AA7 Val_Wu8 1.00000000000 DFES_EnvTabVerb 0.00 1.00000000000 FORMAT "%13.11" /end CHARACTERISTIC
/begin CHARACTERISTIC DFES_EnvRef.DFC_VehVAllPlaus_C "used environment signals / Reference to used environment condition set for check DFC_VehVAllPlaus" VALUE 0x80504AA8 Val_Wu8 1.00000000000 DFES_EnvTabVerb 0.00 1.00000000000 FORMAT "%13.11" /end CHARACTERISTIC
/begin CHARACTERISTIC DFES_EnvRef.DFC_VehVNCSnsrElecFailr_C "used environment signals / Reference to used environment condition set for check DFC_VehVNCSnsrElecFailr" VALUE 0x80504AA9 Val_Wu8 1.00000000000 DFES_EnvTabVerb 0.00 1.00000000000 FORMAT "%13.11" /end CHARACTERISTIC
/begin CHARACTERISTIC DFES_EnvRef.DFC_VehVPlausCan_C "used environment signals / Reference to used environment condition set for check DFC_VehVPlausCan" VALUE 0x80504AAA Val_Wu8 1.00000000000 DFES_EnvTabVerb 0.00 1.00000000000 FORMAT "%13.11" /end CHARACTERISTIC
/begin CHARACTERISTIC DFES_EnvRef.DFC_VehVPlausFco_C "used environment signals / Reference to used environment condition set for check DFC_VehVPlausFco" VALUE 0x80504AAB Val_Wu8 1.00000000000 DFES_EnvTabVerb 0.00 1.00000000000 FORMAT "%13.11" /end CHARACTERISTIC
/begin CHARACTERISTIC DFES_EnvRef.DFC_VehVPlausPwr_C "used environment signals / Reference to used environment condition set for check DFC_VehVPlausPwr" VALUE 0x80504AAC Val_Wu8 1.00000000000 DFES_EnvTabVerb 0.00 1.00000000000 FORMAT "%13.11" /end CHARACTERISTIC
/begin CHARACTERISTIC DFES_EnvRef.DFC_VehVPlausV2N_C "used environment signals / Reference to used environment condition set for check DFC_VehVPlausV2N" VALUE 0x80504AAD Val_Wu8 1.00000000000 DFES_EnvTabVerb 0.00 1.00000000000 FORMAT "%13.11" /end CHARACTERISTIC
/begin CHARACTERISTIC DFES_EnvRef.DFC_VehVSpdSnsrAElecFailr_C "used environment signals / Reference to used environment condition set for check DFC_VehVSpdSnsrAElecFailr" VALUE 0x80504AAE Val_Wu8 1.00000000000 DFES_EnvTabVerb 0.00 1.00000000000 FORMAT "%13.11" /end CHARACTERISTIC
/begin CHARACTERISTIC DFES_EnvRef.DFC_VehVSpdSnsrBElecFailr_C "used environment signals / Reference to used environment condition set for check DFC_VehVSpdSnsrBElecFailr" VALUE 0x80504AAF Val_Wu8 1.00000000000 DFES_EnvTabVerb 0.00 1.00000000000 FORMAT "%13.11" /end CHARACTERISTIC
/begin CHARACTERISTIC DFES_EnvRef.DFC_ClthMax_C "used environment signals / Reference to used environment condition set for check DFC_ClthMax" VALUE 0x80504AB0 Val_Wu8 1.00000000000 DFES_EnvTabVerb 0.00 1.00000000000 FORMAT "%13.11" /end CHARACTERISTIC
/begin CHARACTERISTIC DFES_EnvRef.DFC_IgnClPs_DevComErr_C "used environment signals / Reference to used environment condition set for check DFC_IgnClPs_DevComErr" VALUE 0x80504AB1 Val_Wu8 1.00000000000 DFES_EnvTabVerb 0.00 1.00000000000 FORMAT "%13.11" /end CHARACTERISTIC
/begin CHARACTERISTIC DFES_EnvRef.DFC_IgnClPs_LineOl_0_C "used environment signals / Reference to used environment condition set for check DFC_IgnClPs_LineOl_0" VALUE 0x80504AB2 Val_Wu8 1.00000000000 DFES_EnvTabVerb 0.00 1.00000000000 FORMAT "%13.11" /end CHARACTERISTIC
/begin CHARACTERISTIC DFES_EnvRef.DFC_IgnClPs_LineOl_1_C "used environment signals / Reference to used environment condition set for check DFC_IgnClPs_LineOl_1" VALUE 0x80504AB3 Val_Wu8 1.00000000000 DFES_EnvTabVerb 0.00 1.00000000000 FORMAT "%13.11" /end CHARACTERISTIC
/begin CHARACTERISTIC DFES_EnvRef.DFC_IgnClPs_LineOl_2_C "used environment signals / Reference to used environment condition set for check DFC_IgnClPs_LineOl_2" VALUE 0x80504AB4 Val_Wu8 1.00000000000 DFES_EnvTabVerb 0.00 1.00000000000 FORMAT "%13.11" /end CHARACTERISTIC
/begin CHARACTERISTIC DFES_EnvRef.DFC_IgnClPs_LineOl_3_C "used environment signals / Reference to used environment condition set for check DFC_IgnClPs_LineOl_3" VALUE 0x80504AB5 Val_Wu8 1.00000000000 DFES_EnvTabVerb 0.00 1.00000000000 FORMAT "%13.11" /end CHARACTERISTIC
/begin CHARACTERISTIC DFES_EnvRef.DFC_IgnClPs_LineScb_0_C "used environment signals / Reference to used environment condition set for check DFC_IgnClPs_LineScb_0" VALUE 0x80504AB6 Val_Wu8 1.00000000000 DFES_EnvTabVerb 0.00 1.00000000000 FORMAT "%13.11" /end CHARACTERISTIC
/begin CHARACTERISTIC DFES_EnvRef.DFC_IgnClPs_LineScb_1_C "used environment signals / Reference to used environment condition set for check DFC_IgnClPs_LineScb_1" VALUE 0x80504AB7 Val_Wu8 1.00000000000 DFES_EnvTabVerb 0.00 1.00000000000 FORMAT "%13.11" /end CHARACTERISTIC
/begin CHARACTERISTIC DFES_EnvRef.DFC_IgnClPs_LineScb_2_C "used environment signals / Reference to used environment condition set for check DFC_IgnClPs_LineScb_2" VALUE 0x80504AB8 Val_Wu8 1.00000000000 DFES_EnvTabVerb 0.00 1.00000000000 FORMAT "%13.11" /end CHARACTERISTIC
/begin CHARACTERISTIC DFES_EnvRef.DFC_IgnClPs_LineScb_3_C "used environment signals / Reference to used environment condition set for check DFC_IgnClPs_LineScb_3" VALUE 0x80504AB9 Val_Wu8 1.00000000000 DFES_EnvTabVerb 0.00 1.00000000000 FORMAT "%13.11" /end CHARACTERISTIC
/begin CHARACTERISTIC DFES_EnvRef.DFC_IgnClPs_LineScg_0_C "used environment signals / Reference to used environment condition set for check DFC_IgnClPs_LineScg_0" VALUE 0x80504ABA Val_Wu8 1.00000000000 DFES_EnvTabVerb 0.00 1.00000000000 FORMAT "%13.11" /end CHARACTERISTIC
/begin CHARACTERISTIC DFES_EnvRef.DFC_IgnClPs_LineScg_1_C "used environment signals / Reference to used environment condition set for check DFC_IgnClPs_LineScg_1" VALUE 0x80504ABB Val_Wu8 1.00000000000 DFES_EnvTabVerb 0.00 1.00000000000 FORMAT "%13.11" /end CHARACTERISTIC
/begin CHARACTERISTIC DFES_EnvRef.DFC_IgnClPs_LineScg_2_C "used environment signals / Reference to used environment condition set for check DFC_IgnClPs_LineScg_2" VALUE 0x80504ABC Val_Wu8 1.00000000000 DFES_EnvTabVerb 0.00 1.00000000000 FORMAT "%13.11" /end CHARACTERISTIC
/begin CHARACTERISTIC DFES_EnvRef.DFC_IgnClPs_LineScg_3_C "used environment signals / Reference to used environment condition set for check DFC_IgnClPs_LineScg_3" VALUE 0x80504ABD Val_Wu8 1.00000000000 DFES_EnvTabVerb 0.00 1.00000000000 FORMAT "%13.11" /end CHARACTERISTIC
/begin CHARACTERISTIC DFES_EnvRef.DFC_KRVEKOEVAB_C "used environment signals / Reference to used environment condition set for check DFC_KRVEKOEVAB" VALUE 0x80504ABE Val_Wu8 1.00000000000 DFES_EnvTabVerb 0.00 1.00000000000 FORMAT "%13.11" /end CHARACTERISTIC
/begin CHARACTERISTIC DFES_EnvRef.DFC_KRVEKOEVAB0_C "used environment signals / Reference to used environment condition set for check DFC_KRVEKOEVAB0" VALUE 0x80504ABF Val_Wu8 1.00000000000 DFES_EnvTabVerb 0.00 1.00000000000 FORMAT "%13.11" /end CHARACTERISTIC
/begin CHARACTERISTIC DFES_EnvRef.DFC_KRVEKOEVAB1_C "used environment signals / Reference to used environment condition set for check DFC_KRVEKOEVAB1" VALUE 0x80504AC0 Val_Wu8 1.00000000000 DFES_EnvTabVerb 0.00 1.00000000000 FORMAT "%13.11" /end CHARACTERISTIC
/begin CHARACTERISTIC DFES_EnvRef.DFC_KRVEKOEVAB2_C "used environment signals / Reference to used environment condition set for check DFC_KRVEKOEVAB2" VALUE 0x80504AC1 Val_Wu8 1.00000000000 DFES_EnvTabVerb 0.00 1.00000000000 FORMAT "%13.11" /end CHARACTERISTIC
/begin CHARACTERISTIC DFES_EnvRef.DFC_KRVEKOEVAB3_C "used environment signals / Reference to used environment condition set for check DFC_KRVEKOEVAB3" VALUE 0x80504AC2 Val_Wu8 1.00000000000 DFES_EnvTabVerb 0.00 1.00000000000 FORMAT "%13.11" /end CHARACTERISTIC
/begin CHARACTERISTIC DFES_EnvRef.DFC_UegoSigEcuAsicS1B1_C "used environment signals / Reference to used environment condition set for check DFC_UegoSigEcuAsicS1B1" VALUE 0x80504AC3 Val_Wu8 1.00000000000 DFES_EnvTabVerb 0.00 1.00000000000 FORMAT "%13.11" /end CHARACTERISTIC
/begin CHARACTERISTIC DFES_EnvRef.DFC_UegoSigEcuComS1B1_C "used environment signals / Reference to used environment condition set for check DFC_UegoSigEcuComS1B1" VALUE 0x80504AC4 Val_Wu8 1.00000000000 DFES_EnvTabVerb 0.00 1.00000000000 FORMAT "%13.11" /end CHARACTERISTIC
/begin CHARACTERISTIC DFES_EnvRef.DFC_UegoSigSnsrS1B1_C "used environment signals / Reference to used environment condition set for check DFC_UegoSigSnsrS1B1" VALUE 0x80504AC5 Val_Wu8 1.00000000000 DFES_EnvTabVerb 0.00 1.00000000000 FORMAT "%13.11" /end CHARACTERISTIC
/begin CHARACTERISTIC DFES_EnvRef.DFC_UegoSigWireOlApesS1B1_C "used environment signals / Reference to used environment condition set for check DFC_UegoSigWireOlApesS1B1" VALUE 0x80504AC6 Val_Wu8 1.00000000000 DFES_EnvTabVerb 0.00 1.00000000000 FORMAT "%13.11" /end CHARACTERISTIC
/begin CHARACTERISTIC DFES_EnvRef.DFC_UegoSigWireOlIpeS1B1_C "used environment signals / Reference to used environment condition set for check DFC_UegoSigWireOlIpeS1B1" VALUE 0x80504AC7 Val_Wu8 1.00000000000 DFES_EnvTabVerb 0.00 1.00000000000 FORMAT "%13.11" /end CHARACTERISTIC
/begin CHARACTERISTIC DFES_EnvRef.DFC_UegoSigWireOlReS1B1_C "used environment signals / Reference to used environment condition set for check DFC_UegoSigWireOlReS1B1" VALUE 0x80504AC8 Val_Wu8 1.00000000000 DFES_EnvTabVerb 0.00 1.00000000000 FORMAT "%13.11" /end CHARACTERISTIC
/begin CHARACTERISTIC DFES_EnvRef.DFC_UegoSigWireRCmpS1B1_C "used environment signals / Reference to used environment condition set for check DFC_UegoSigWireRCmpS1B1" VALUE 0x80504AC9 Val_Wu8 1.00000000000 DFES_EnvTabVerb 0.00 1.00000000000 FORMAT "%13.11" /end CHARACTERISTIC
/begin CHARACTERISTIC DFES_EnvRef.DFC_UegoSigWireScbS1B1_C "used environment signals / Reference to used environment condition set for check DFC_UegoSigWireScbS1B1" VALUE 0x80504ACA Val_Wu8 1.00000000000 DFES_EnvTabVerb 0.00 1.00000000000 FORMAT "%13.11" /end CHARACTERISTIC
/begin CHARACTERISTIC DFES_EnvRef.DFC_UegoSigWireScgS1B1_C "used environment signals / Reference to used environment condition set for check DFC_UegoSigWireScgS1B1" VALUE 0x80504ACB Val_Wu8 1.00000000000 DFES_EnvTabVerb 0.00 1.00000000000 FORMAT "%13.11" /end CHARACTERISTIC
/begin CHARACTERISTIC DFES_EnvRef.DFC_AfsPhyRngHiB1_C "used environment signals / Reference to used environment condition set for check DFC_AfsPhyRngHiB1" VALUE 0x80504ACC Val_Wu8 1.00000000000 DFES_EnvTabVerb 0.00 1.00000000000 FORMAT "%13.11" /end CHARACTERISTIC
/begin CHARACTERISTIC DFES_EnvRef.DFC_AfsPhyRngLoB1_C "used environment signals / Reference to used environment condition set for check DFC_AfsPhyRngLoB1" VALUE 0x80504ACD Val_Wu8 1.00000000000 DFES_EnvTabVerb 0.00 1.00000000000 FORMAT "%13.11" /end CHARACTERISTIC
/begin CHARACTERISTIC DFES_EnvRef.DFC_AirCCmprOL_C "used environment signals / Reference to used environment condition set for check DFC_AirCCmprOL" VALUE 0x80504ACE Val_Wu8 1.00000000000 DFES_EnvTabVerb 0.00 1.00000000000 FORMAT "%13.11" /end CHARACTERISTIC
/begin CHARACTERISTIC DFES_EnvRef.DFC_AirCCmprOvrTemp_C "used environment signals / Reference to used environment condition set for check DFC_AirCCmprOvrTemp" VALUE 0x80504ACF Val_Wu8 1.00000000000 DFES_EnvTabVerb 0.00 1.00000000000 FORMAT "%13.11" /end CHARACTERISTIC
/begin CHARACTERISTIC DFES_EnvRef.DFC_AirCCmprSCB_C "used environment signals / Reference to used environment condition set for check DFC_AirCCmprSCB" VALUE 0x80504AD0 Val_Wu8 1.00000000000 DFES_EnvTabVerb 0.00 1.00000000000 FORMAT "%13.11" /end CHARACTERISTIC
/begin CHARACTERISTIC DFES_EnvRef.DFC_AirCCmprSCG_C "used environment signals / Reference to used environment condition set for check DFC_AirCCmprSCG" VALUE 0x80504AD1 Val_Wu8 1.00000000000 DFES_EnvTabVerb 0.00 1.00000000000 FORMAT "%13.11" /end CHARACTERISTIC
/begin CHARACTERISTIC DFES_EnvRef.DFC_AltErr_C "used environment signals / Reference to used environment condition set for check DFC_AltErr" VALUE 0x80504AD2 Val_Wu8 1.00000000000 DFES_EnvTabVerb 0.00 1.00000000000 FORMAT "%13.11" /end CHARACTERISTIC
/begin CHARACTERISTIC DFES_EnvRef.DFC_BattUSRCMax_C "used environment signals / Reference to used environment condition set for check DFC_BattUSRCMax" VALUE 0x80504AD3 Val_Wu8 1.00000000000 DFES_EnvTabVerb 0.00 1.00000000000 FORMAT "%13.11" /end CHARACTERISTIC
/begin CHARACTERISTIC DFES_EnvRef.DFC_BattUSRCMin_C "used environment signals / Reference to used environment condition set for check DFC_BattUSRCMin" VALUE 0x80504AD4 Val_Wu8 1.00000000000 DFES_EnvTabVerb 0.00 1.00000000000 FORMAT "%13.11" /end CHARACTERISTIC
/begin CHARACTERISTIC DFES_EnvRef.DFC_ComChksTCU1_C "used environment signals / Reference to used environment condition set for check DFC_ComChksTCU1" VALUE 0x80504AD5 Val_Wu8 1.00000000000 DFES_EnvTabVerb 0.00 1.00000000000 FORMAT "%13.11" /end CHARACTERISTIC
/begin CHARACTERISTIC DFES_EnvRef.DFC_ComChksTCU11_C "used environment signals / Reference to used environment condition set for check DFC_ComChksTCU11" VALUE 0x80504AD6 Val_Wu8 1.00000000000 DFES_EnvTabVerb 0.00 1.00000000000 FORMAT "%13.11" /end CHARACTERISTIC
/begin CHARACTERISTIC DFES_EnvRef.DFC_ComChksTCU12_C "used environment signals / Reference to used environment condition set for check DFC_ComChksTCU12" VALUE 0x80504AD7 Val_Wu8 1.00000000000 DFES_EnvTabVerb 0.00 1.00000000000 FORMAT "%13.11" /end CHARACTERISTIC
/begin CHARACTERISTIC DFES_EnvRef.DFC_ComChksTCU13_C "used environment signals / Reference to used environment condition set for check DFC_ComChksTCU13" VALUE 0x80504AD8 Val_Wu8 1.00000000000 DFES_EnvTabVerb 0.00 1.00000000000 FORMAT "%13.11" /end CHARACTERISTIC
/begin CHARACTERISTIC DFES_EnvRef.DFC_ComChksTCU2_C "used environment signals / Reference to used environment condition set for check DFC_ComChksTCU2" VALUE 0x80504AD9 Val_Wu8 1.00000000000 DFES_EnvTabVerb 0.00 1.00000000000 FORMAT "%13.11" /end CHARACTERISTIC
/begin CHARACTERISTIC DFES_EnvRef.DFC_ComChksTCU3_C "used environment signals / Reference to used environment condition set for check DFC_ComChksTCU3" VALUE 0x80504ADA Val_Wu8 1.00000000000 DFES_EnvTabVerb 0.00 1.00000000000 FORMAT "%13.11" /end CHARACTERISTIC
/begin CHARACTERISTIC DFES_EnvRef.DFC_ComChksTCU4_C "used environment signals / Reference to used environment condition set for check DFC_ComChksTCU4" VALUE 0x80504ADB Val_Wu8 1.00000000000 DFES_EnvTabVerb 0.00 1.00000000000 FORMAT "%13.11" /end CHARACTERISTIC
/begin CHARACTERISTIC DFES_EnvRef.DFC_ComCntTCU1_C "used environment signals / Reference to used environment condition set for check DFC_ComCntTCU1" VALUE 0x80504ADC Val_Wu8 1.00000000000 DFES_EnvTabVerb 0.00 1.00000000000 FORMAT "%13.11" /end CHARACTERISTIC
/begin CHARACTERISTIC DFES_EnvRef.DFC_ComCntTCU11_C "used environment signals / Reference to used environment condition set for check DFC_ComCntTCU11" VALUE 0x80504ADD Val_Wu8 1.00000000000 DFES_EnvTabVerb 0.00 1.00000000000 FORMAT "%13.11" /end CHARACTERISTIC
/begin CHARACTERISTIC DFES_EnvRef.DFC_ComCntTCU12_C "used environment signals / Reference to used environment condition set for check DFC_ComCntTCU12" VALUE 0x80504ADE Val_Wu8 1.00000000000 DFES_EnvTabVerb 0.00 1.00000000000 FORMAT "%13.11" /end CHARACTERISTIC
/begin CHARACTERISTIC DFES_EnvRef.DFC_ComCntTCU13_C "used environment signals / Reference to used environment condition set for check DFC_ComCntTCU13" VALUE 0x80504ADF Val_Wu8 1.00000000000 DFES_EnvTabVerb 0.00 1.00000000000 FORMAT "%13.11" /end CHARACTERISTIC
/begin CHARACTERISTIC DFES_EnvRef.DFC_ComCntTCU2_C "used environment signals / Reference to used environment condition set for check DFC_ComCntTCU2" VALUE 0x80504AE0 Val_Wu8 1.00000000000 DFES_EnvTabVerb 0.00 1.00000000000 FORMAT "%13.11" /end CHARACTERISTIC
/begin CHARACTERISTIC DFES_EnvRef.DFC_ComCntTCU3_C "used environment signals / Reference to used environment condition set for check DFC_ComCntTCU3" VALUE 0x80504AE1 Val_Wu8 1.00000000000 DFES_EnvTabVerb 0.00 1.00000000000 FORMAT "%13.11" /end CHARACTERISTIC
/begin CHARACTERISTIC DFES_EnvRef.DFC_ComCntTCU4_C "used environment signals / Reference to used environment condition set for check DFC_ComCntTCU4" VALUE 0x80504AE2 Val_Wu8 1.00000000000 DFES_EnvTabVerb 0.00 1.00000000000 FORMAT "%13.11" /end CHARACTERISTIC
/begin CHARACTERISTIC DFES_EnvRef.DFC_ComTOutTCU01_C "used environment signals / Reference to used environment condition set for check DFC_ComTOutTCU01" VALUE 0x80504AE3 Val_Wu8 1.00000000000 DFES_EnvTabVerb 0.00 1.00000000000 FORMAT "%13.11" /end CHARACTERISTIC
/begin CHARACTERISTIC DFES_EnvRef.DFC_ComTOutTCU02_C "used environment signals / Reference to used environment condition set for check DFC_ComTOutTCU02" VALUE 0x80504AE4 Val_Wu8 1.00000000000 DFES_EnvTabVerb 0.00 1.00000000000 FORMAT "%13.11" /end CHARACTERISTIC
/begin CHARACTERISTIC DFES_EnvRef.DFC_ComTOutTCU1_C "used environment signals / Reference to used environment condition set for check DFC_ComTOutTCU1" VALUE 0x80504AE5 Val_Wu8 1.00000000000 DFES_EnvTabVerb 0.00 1.00000000000 FORMAT "%13.11" /end CHARACTERISTIC
/begin CHARACTERISTIC DFES_EnvRef.DFC_ComTOutTCU11_C "used environment signals / Reference to used environment condition set for check DFC_ComTOutTCU11" VALUE 0x80504AE6 Val_Wu8 1.00000000000 DFES_EnvTabVerb 0.00 1.00000000000 FORMAT "%13.11" /end CHARACTERISTIC
/begin CHARACTERISTIC DFES_EnvRef.DFC_ComTOutTCU12_C "used environment signals / Reference to used environment condition set for check DFC_ComTOutTCU12" VALUE 0x80504AE7 Val_Wu8 1.00000000000 DFES_EnvTabVerb 0.00 1.00000000000 FORMAT "%13.11" /end CHARACTERISTIC
/begin CHARACTERISTIC DFES_EnvRef.DFC_ComTOutTCU13_C "used environment signals / Reference to used environment condition set for check DFC_ComTOutTCU13" VALUE 0x80504AE8 Val_Wu8 1.00000000000 DFES_EnvTabVerb 0.00 1.00000000000 FORMAT "%13.11" /end CHARACTERISTIC
/begin CHARACTERISTIC DFES_EnvRef.DFC_ComTOutTCU14_C "used environment signals / Reference to used environment condition set for check DFC_ComTOutTCU14" VALUE 0x80504AE9 Val_Wu8 1.00000000000 DFES_EnvTabVerb 0.00 1.00000000000 FORMAT "%13.11" /end CHARACTERISTIC
/begin CHARACTERISTIC DFES_EnvRef.DFC_ComTOutTCU2_C "used environment signals / Reference to used environment condition set for check DFC_ComTOutTCU2" VALUE 0x80504AEA Val_Wu8 1.00000000000 DFES_EnvTabVerb 0.00 1.00000000000 FORMAT "%13.11" /end CHARACTERISTIC
/begin CHARACTERISTIC DFES_EnvRef.DFC_ComTOutTCU3_C "used environment signals / Reference to used environment condition set for check DFC_ComTOutTCU3" VALUE 0x80504AEB Val_Wu8 1.00000000000 DFES_EnvTabVerb 0.00 1.00000000000 FORMAT "%13.11" /end CHARACTERISTIC
/begin CHARACTERISTIC DFES_EnvRef.DFC_ComTOutTCU4_C "used environment signals / Reference to used environment condition set for check DFC_ComTOutTCU4" VALUE 0x80504AEC Val_Wu8 1.00000000000 DFES_EnvTabVerb 0.00 1.00000000000 FORMAT "%13.11" /end CHARACTERISTIC
/begin CHARACTERISTIC DFES_EnvRef.DFC_DevLibBattUHi_C "used environment signals / Reference to used environment condition set for check DFC_DevLibBattUHi" VALUE 0x80504AED Val_Wu8 1.00000000000 DFES_EnvTabVerb 0.00 1.00000000000 FORMAT "%13.11" /end CHARACTERISTIC
/begin CHARACTERISTIC DFES_EnvRef.DFC_DevLibBattULo_C "used environment signals / Reference to used environment condition set for check DFC_DevLibBattULo" VALUE 0x80504AEE Val_Wu8 1.00000000000 DFES_EnvTabVerb 0.00 1.00000000000 FORMAT "%13.11" /end CHARACTERISTIC
/begin CHARACTERISTIC DFES_EnvRef.DFC_EGRVlvFailSafeActv_C "used environment signals / Reference to used environment condition set for check DFC_EGRVlvFailSafeActv" VALUE 0x80504AEF Val_Wu8 1.00000000000 DFES_EnvTabVerb 0.00 1.00000000000 FORMAT "%13.11" /end CHARACTERISTIC
/begin CHARACTERISTIC DFES_EnvRef.DFC_EGRVlvGovDvtCld_C "used environment signals / Reference to used environment condition set for check DFC_EGRVlvGovDvtCld" VALUE 0x80504AF0 Val_Wu8 1.00000000000 DFES_EnvTabVerb 0.00 1.00000000000 FORMAT "%13.11" /end CHARACTERISTIC
/begin CHARACTERISTIC DFES_EnvRef.DFC_EGRVlvPhysSRCMax_C "used environment signals / Reference to used environment condition set for check DFC_EGRVlvPhysSRCMax" VALUE 0x80504AF1 Val_Wu8 1.00000000000 DFES_EnvTabVerb 0.00 1.00000000000 FORMAT "%13.11" /end CHARACTERISTIC
/begin CHARACTERISTIC DFES_EnvRef.DFC_EGRVlvPhysSRCMin_C "used environment signals / Reference to used environment condition set for check DFC_EGRVlvPhysSRCMin" VALUE 0x80504AF2 Val_Wu8 1.00000000000 DFES_EnvTabVerb 0.00 1.00000000000 FORMAT "%13.11" /end CHARACTERISTIC
/begin CHARACTERISTIC DFES_EnvRef.DFC_FanDIOOL_0_C "used environment signals / Reference to used environment condition set for check DFC_FanDIOOL_0" VALUE 0x80504AF3 Val_Wu8 1.00000000000 DFES_EnvTabVerb 0.00 1.00000000000 FORMAT "%13.11" /end CHARACTERISTIC
/begin CHARACTERISTIC DFES_EnvRef.DFC_FanDIOOL_1_C "used environment signals / Reference to used environment condition set for check DFC_FanDIOOL_1" VALUE 0x80504AF4 Val_Wu8 1.00000000000 DFES_EnvTabVerb 0.00 1.00000000000 FORMAT "%13.11" /end CHARACTERISTIC
/begin CHARACTERISTIC DFES_EnvRef.DFC_FanDIOOvrTemp_0_C "used environment signals / Reference to used environment condition set for check DFC_FanDIOOvrTemp_0" VALUE 0x80504AF5 Val_Wu8 1.00000000000 DFES_EnvTabVerb 0.00 1.00000000000 FORMAT "%13.11" /end CHARACTERISTIC
/begin CHARACTERISTIC DFES_EnvRef.DFC_FanDIOOvrTemp_1_C "used environment signals / Reference to used environment condition set for check DFC_FanDIOOvrTemp_1" VALUE 0x80504AF6 Val_Wu8 1.00000000000 DFES_EnvTabVerb 0.00 1.00000000000 FORMAT "%13.11" /end CHARACTERISTIC
/begin CHARACTERISTIC DFES_EnvRef.DFC_FanDIOSCB_0_C "used environment signals / Reference to used environment condition set for check DFC_FanDIOSCB_0" VALUE 0x80504AF7 Val_Wu8 1.00000000000 DFES_EnvTabVerb 0.00 1.00000000000 FORMAT "%13.11" /end CHARACTERISTIC
/begin CHARACTERISTIC DFES_EnvRef.DFC_FanDIOSCB_1_C "used environment signals / Reference to used environment condition set for check DFC_FanDIOSCB_1" VALUE 0x80504AF8 Val_Wu8 1.00000000000 DFES_EnvTabVerb 0.00 1.00000000000 FORMAT "%13.11" /end CHARACTERISTIC
/begin CHARACTERISTIC DFES_EnvRef.DFC_FanDIOSCG_0_C "used environment signals / Reference to used environment condition set for check DFC_FanDIOSCG_0" VALUE 0x80504AF9 Val_Wu8 1.00000000000 DFES_EnvTabVerb 0.00 1.00000000000 FORMAT "%13.11" /end CHARACTERISTIC
/begin CHARACTERISTIC DFES_EnvRef.DFC_FanDIOSCG_1_C "used environment signals / Reference to used environment condition set for check DFC_FanDIOSCG_1" VALUE 0x80504AFA Val_Wu8 1.00000000000 DFES_EnvTabVerb 0.00 1.00000000000 FORMAT "%13.11" /end CHARACTERISTIC
/begin CHARACTERISTIC DFES_EnvRef.DFC_MRlyDcOL_C "used environment signals / Reference to used environment condition set for check DFC_MRlyDcOL" VALUE 0x80504AFB Val_Wu8 1.00000000000 DFES_EnvTabVerb 0.00 1.00000000000 FORMAT "%13.11" /end CHARACTERISTIC
/begin CHARACTERISTIC DFES_EnvRef.DFC_MRlyDcSCB_C "used environment signals / Reference to used environment condition set for check DFC_MRlyDcSCB" VALUE 0x80504AFC Val_Wu8 1.00000000000 DFES_EnvTabVerb 0.00 1.00000000000 FORMAT "%13.11" /end CHARACTERISTIC
/begin CHARACTERISTIC DFES_EnvRef.DFC_MRlyDcSCG_C "used environment signals / Reference to used environment condition set for check DFC_MRlyDcSCG" VALUE 0x80504AFD Val_Wu8 1.00000000000 DFES_EnvTabVerb 0.00 1.00000000000 FORMAT "%13.11" /end CHARACTERISTIC
/begin CHARACTERISTIC DFES_EnvRef.DFC_PSPOL_C "used environment signals / Reference to used environment condition set for check DFC_PSPOL" VALUE 0x80504AFE Val_Wu8 1.00000000000 DFES_EnvTabVerb 0.00 1.00000000000 FORMAT "%13.11" /end CHARACTERISTIC
/begin CHARACTERISTIC DFES_EnvRef.DFC_PSPOvrTemp_C "used environment signals / Reference to used environment condition set for check DFC_PSPOvrTemp" VALUE 0x80504AFF Val_Wu8 1.00000000000 DFES_EnvTabVerb 0.00 1.00000000000 FORMAT "%13.11" /end CHARACTERISTIC
/begin CHARACTERISTIC DFES_EnvRef.DFC_PSPSCB_C "used environment signals / Reference to used environment condition set for check DFC_PSPSCB" VALUE 0x80504B00 Val_Wu8 1.00000000000 DFES_EnvTabVerb 0.00 1.00000000000 FORMAT "%13.11" /end CHARACTERISTIC
/begin CHARACTERISTIC DFES_EnvRef.DFC_PSPSCG_C "used environment signals / Reference to used environment condition set for check DFC_PSPSCG" VALUE 0x80504B01 Val_Wu8 1.00000000000 DFES_EnvTabVerb 0.00 1.00000000000 FORMAT "%13.11" /end CHARACTERISTIC
/begin CHARACTERISTIC DFES_EnvRef.DFC_T50Err_C "used environment signals / Reference to used environment condition set for check DFC_T50Err" VALUE 0x80504B02 Val_Wu8 1.00000000000 DFES_EnvTabVerb 0.00 1.00000000000 FORMAT "%13.11" /end CHARACTERISTIC
/begin CHARACTERISTIC DFES_EnvRef.DFC_ThrVlvLoBattB1_C "used environment signals / Reference to used environment condition set for check DFC_ThrVlvLoBattB1" VALUE 0x80504B03 Val_Wu8 1.00000000000 DFES_EnvTabVerb 0.00 1.00000000000 FORMAT "%13.11" /end CHARACTERISTIC
/begin CHARACTERISTIC DFES_EnvRef.DFC_UegoSigOperPlausS1B1_C "used environment signals / Reference to used environment condition set for check DFC_UegoSigOperPlausS1B1" VALUE 0x80504B04 Val_Wu8 1.00000000000 DFES_EnvTabVerb 0.00 1.00000000000 FORMAT "%13.11" /end CHARACTERISTIC
/begin CHARACTERISTIC DFES_EnvRef.DFC_VehVPhysRngHi_C "used environment signals / Reference to used environment condition set for check DFC_VehVPhysRngHi" VALUE 0x80504B05 Val_Wu8 1.00000000000 DFES_EnvTabVerb 0.00 1.00000000000 FORMAT "%13.11" /end CHARACTERISTIC
/begin CHARACTERISTIC DFES_EnvRef.DFC_VehVSclOutOL_C "used environment signals / Reference to used environment condition set for check DFC_VehVSclOutOL" VALUE 0x80504B06 Val_Wu8 1.00000000000 DFES_EnvTabVerb 0.00 1.00000000000 FORMAT "%13.11" /end CHARACTERISTIC
/begin CHARACTERISTIC DFES_EnvRef.DFC_VehVSclOutOT_C "used environment signals / Reference to used environment condition set for check DFC_VehVSclOutOT" VALUE 0x80504B07 Val_Wu8 1.00000000000 DFES_EnvTabVerb 0.00 1.00000000000 FORMAT "%13.11" /end CHARACTERISTIC
/begin CHARACTERISTIC DFES_EnvRef.DFC_VehVSclOutSCB_C "used environment signals / Reference to used environment condition set for check DFC_VehVSclOutSCB" VALUE 0x80504B08 Val_Wu8 1.00000000000 DFES_EnvTabVerb 0.00 1.00000000000 FORMAT "%13.11" /end CHARACTERISTIC
/begin CHARACTERISTIC DFES_EnvRef.DFC_VehVSclOutSCG_C "used environment signals / Reference to used environment condition set for check DFC_VehVSclOutSCG" VALUE 0x80504B09 Val_Wu8 1.00000000000 DFES_EnvTabVerb 0.00 1.00000000000 FORMAT "%13.11" /end CHARACTERISTIC
/begin CHARACTERISTIC DFES_EnvRef.DFC_VehVSigFL_C "used environment signals / Reference to used environment condition set for check DFC_VehVSigFL" VALUE 0x80504B0A Val_Wu8 1.00000000000 DFES_EnvTabVerb 0.00 1.00000000000 FORMAT "%13.11" /end CHARACTERISTIC
/begin CHARACTERISTIC DFES_EnvRef.DFC_VehVSigFR_C "used environment signals / Reference to used environment condition set for check DFC_VehVSigFR" VALUE 0x80504B0B Val_Wu8 1.00000000000 DFES_EnvTabVerb 0.00 1.00000000000 FORMAT "%13.11" /end CHARACTERISTIC
/begin CHARACTERISTIC DFES_EnvRef.DFC_VehVSigRL_C "used environment signals / Reference to used environment condition set for check DFC_VehVSigRL" VALUE 0x80504B0C Val_Wu8 1.00000000000 DFES_EnvTabVerb 0.00 1.00000000000 FORMAT "%13.11" /end CHARACTERISTIC
/begin CHARACTERISTIC DFES_EnvRef.DFC_VehVSigRR_C "used environment signals / Reference to used environment condition set for check DFC_VehVSigRR" VALUE 0x80504B0D Val_Wu8 1.00000000000 DFES_EnvTabVerb 0.00 1.00000000000 FORMAT "%13.11" /end CHARACTERISTIC
/begin CHARACTERISTIC DFES_EnvRef.DFC_VehVSnsrARngHi_C "used environment signals / Reference to used environment condition set for check DFC_VehVSnsrARngHi" VALUE 0x80504B0E Val_Wu8 1.00000000000 DFES_EnvTabVerb 0.00 1.00000000000 FORMAT "%13.11" /end CHARACTERISTIC
/begin CHARACTERISTIC DFES_EnvRef.DFC_VehVSnsrBRngHi_C "used environment signals / Reference to used environment condition set for check DFC_VehVSnsrBRngHi" VALUE 0x80504B0F Val_Wu8 1.00000000000 DFES_EnvTabVerb 0.00 1.00000000000 FORMAT "%13.11" /end CHARACTERISTIC
/begin CHARACTERISTIC DFES_EnvRef.DFC_VehVSpdRtyDiag_C "used environment signals / Reference to used environment condition set for check DFC_VehVSpdRtyDiag" VALUE 0x80504B10 Val_Wu8 1.00000000000 DFES_EnvTabVerb 0.00 1.00000000000 FORMAT "%13.11" /end CHARACTERISTIC
/begin CHARACTERISTIC DFES_EnvRef.DFC_DHFHD_C "used environment signals / Reference to used environment condition set for check DFC_DHFHD" VALUE 0x80504B11 Val_Wu8 1.00000000000 DFES_EnvTabVerb 0.00 1.00000000000 FORMAT "%13.11" /end CHARACTERISTIC
/begin CHARACTERISTIC DFES_EnvRef.DFC_InjVlv_DI_DcDc_C "used environment signals / Reference to used environment condition set for check DFC_InjVlv_DI_DcDc" VALUE 0x80504B12 Val_Wu8 1.00000000000 DFES_EnvTabVerb 0.00 1.00000000000 FORMAT "%13.11" /end CHARACTERISTIC
/begin CHARACTERISTIC DFES_EnvRef.DFC_InjVlv_DI_NoLd_0_C "used environment signals / Reference to used environment condition set for check DFC_InjVlv_DI_NoLd_0" VALUE 0x80504B13 Val_Wu8 1.00000000000 DFES_EnvTabVerb 0.00 1.00000000000 FORMAT "%13.11" /end CHARACTERISTIC
/begin CHARACTERISTIC DFES_EnvRef.DFC_InjVlv_DI_NoLd_1_C "used environment signals / Reference to used environment condition set for check DFC_InjVlv_DI_NoLd_1" VALUE 0x80504B14 Val_Wu8 1.00000000000 DFES_EnvTabVerb 0.00 1.00000000000 FORMAT "%13.11" /end CHARACTERISTIC
/begin CHARACTERISTIC DFES_EnvRef.DFC_InjVlv_DI_NoLd_2_C "used environment signals / Reference to used environment condition set for check DFC_InjVlv_DI_NoLd_2" VALUE 0x80504B15 Val_Wu8 1.00000000000 DFES_EnvTabVerb 0.00 1.00000000000 FORMAT "%13.11" /end CHARACTERISTIC
/begin CHARACTERISTIC DFES_EnvRef.DFC_InjVlv_DI_NoLd_3_C "used environment signals / Reference to used environment condition set for check DFC_InjVlv_DI_NoLd_3" VALUE 0x80504B16 Val_Wu8 1.00000000000 DFES_EnvTabVerb 0.00 1.00000000000 FORMAT "%13.11" /end CHARACTERISTIC
/begin CHARACTERISTIC DFES_EnvRef.DFC_InjVlv_DI_ScBnk_0_C "used environment signals / Reference to used environment condition set for check DFC_InjVlv_DI_ScBnk_0" VALUE 0x80504B17 Val_Wu8 1.00000000000 DFES_EnvTabVerb 0.00 1.00000000000 FORMAT "%13.11" /end CHARACTERISTIC
/begin CHARACTERISTIC DFES_EnvRef.DFC_InjVlv_DI_ScBnk_1_C "used environment signals / Reference to used environment condition set for check DFC_InjVlv_DI_ScBnk_1" VALUE 0x80504B18 Val_Wu8 1.00000000000 DFES_EnvTabVerb 0.00 1.00000000000 FORMAT "%13.11" /end CHARACTERISTIC
/begin CHARACTERISTIC DFES_EnvRef.DFC_InjVlv_DI_ScBnk_2_C "used environment signals / Reference to used environment condition set for check DFC_InjVlv_DI_ScBnk_2" VALUE 0x80504B19 Val_Wu8 1.00000000000 DFES_EnvTabVerb 0.00 1.00000000000 FORMAT "%13.11" /end CHARACTERISTIC
/begin CHARACTERISTIC DFES_EnvRef.DFC_InjVlv_DI_ScBnk_3_C "used environment signals / Reference to used environment condition set for check DFC_InjVlv_DI_ScBnk_3" VALUE 0x80504B1A Val_Wu8 1.00000000000 DFES_EnvTabVerb 0.00 1.00000000000 FORMAT "%13.11" /end CHARACTERISTIC
/begin CHARACTERISTIC DFES_EnvRef.DFC_InjVlv_DI_ScCyl_0_C "used environment signals / Reference to used environment condition set for check DFC_InjVlv_DI_ScCyl_0" VALUE 0x80504B1B Val_Wu8 1.00000000000 DFES_EnvTabVerb 0.00 1.00000000000 FORMAT "%13.11" /end CHARACTERISTIC
/begin CHARACTERISTIC DFES_EnvRef.DFC_InjVlv_DI_ScCyl_1_C "used environment signals / Reference to used environment condition set for check DFC_InjVlv_DI_ScCyl_1" VALUE 0x80504B1C Val_Wu8 1.00000000000 DFES_EnvTabVerb 0.00 1.00000000000 FORMAT "%13.11" /end CHARACTERISTIC
/begin CHARACTERISTIC DFES_EnvRef.DFC_InjVlv_DI_ScCyl_2_C "used environment signals / Reference to used environment condition set for check DFC_InjVlv_DI_ScCyl_2" VALUE 0x80504B1D Val_Wu8 1.00000000000 DFES_EnvTabVerb 0.00 1.00000000000 FORMAT "%13.11" /end CHARACTERISTIC
/begin CHARACTERISTIC DFES_EnvRef.DFC_InjVlv_DI_ScCyl_3_C "used environment signals / Reference to used environment condition set for check DFC_InjVlv_DI_ScCyl_3" VALUE 0x80504B1E Val_Wu8 1.00000000000 DFES_EnvTabVerb 0.00 1.00000000000 FORMAT "%13.11" /end CHARACTERISTIC
/begin CHARACTERISTIC DFES_EnvRef.DFC_InjVlv_DI_ScHsLs_0_C "used environment signals / Reference to used environment condition set for check DFC_InjVlv_DI_ScHsLs_0" VALUE 0x80504B1F Val_Wu8 1.00000000000 DFES_EnvTabVerb 0.00 1.00000000000 FORMAT "%13.11" /end CHARACTERISTIC
/begin CHARACTERISTIC DFES_EnvRef.DFC_InjVlv_DI_ScHsLs_1_C "used environment signals / Reference to used environment condition set for check DFC_InjVlv_DI_ScHsLs_1" VALUE 0x80504B20 Val_Wu8 1.00000000000 DFES_EnvTabVerb 0.00 1.00000000000 FORMAT "%13.11" /end CHARACTERISTIC
/begin CHARACTERISTIC DFES_EnvRef.DFC_InjVlv_DI_ScHsLs_2_C "used environment signals / Reference to used environment condition set for check DFC_InjVlv_DI_ScHsLs_2" VALUE 0x80504B21 Val_Wu8 1.00000000000 DFES_EnvTabVerb 0.00 1.00000000000 FORMAT "%13.11" /end CHARACTERISTIC
/begin CHARACTERISTIC DFES_EnvRef.DFC_InjVlv_DI_ScHsLs_3_C "used environment signals / Reference to used environment condition set for check DFC_InjVlv_DI_ScHsLs_3" VALUE 0x80504B22 Val_Wu8 1.00000000000 DFES_EnvTabVerb 0.00 1.00000000000 FORMAT "%13.11" /end CHARACTERISTIC
/begin CHARACTERISTIC DFES_EnvRef.DFC_MfPsDiaOpenLoad1_C "used environment signals / Reference to used environment condition set for check DFC_MfPsDiaOpenLoad1" VALUE 0x80504B23 Val_Wu8 1.00000000000 DFES_EnvTabVerb 0.00 1.00000000000 FORMAT "%13.11" /end CHARACTERISTIC
/begin CHARACTERISTIC DFES_EnvRef.DFC_MfPsDiaScHiS1_C "used environment signals / Reference to used environment condition set for check DFC_MfPsDiaScHiS1" VALUE 0x80504B24 Val_Wu8 1.00000000000 DFES_EnvTabVerb 0.00 1.00000000000 FORMAT "%13.11" /end CHARACTERISTIC
/begin CHARACTERISTIC DFES_EnvRef.DFC_MfPsDiaScHiSLowS1_C "used environment signals / Reference to used environment condition set for check DFC_MfPsDiaScHiSLowS1" VALUE 0x80504B25 Val_Wu8 1.00000000000 DFES_EnvTabVerb 0.00 1.00000000000 FORMAT "%13.11" /end CHARACTERISTIC
/begin CHARACTERISTIC DFES_EnvRef.DFC_MfPsDiaScLowS1_C "used environment signals / Reference to used environment condition set for check DFC_MfPsDiaScLowS1" VALUE 0x80504B26 Val_Wu8 1.00000000000 DFES_EnvTabVerb 0.00 1.00000000000 FORMAT "%13.11" /end CHARACTERISTIC
/begin CHARACTERISTIC DFES_EnvRef.DFC_ACEvpTPhysRngHi_C "used environment signals / Reference to used environment condition set for check DFC_ACEvpTPhysRngHi" VALUE 0x80504B27 Val_Wu8 1.00000000000 DFES_EnvTabVerb 0.00 1.00000000000 FORMAT "%13.11" /end CHARACTERISTIC
/begin CHARACTERISTIC DFES_EnvRef.DFC_ACEvpTPhysRngLo_C "used environment signals / Reference to used environment condition set for check DFC_ACEvpTPhysRngLo" VALUE 0x80504B28 Val_Wu8 1.00000000000 DFES_EnvTabVerb 0.00 1.00000000000 FORMAT "%13.11" /end CHARACTERISTIC
/begin CHARACTERISTIC DFES_EnvRef.DFC_ACEvpTSRCMax_C "used environment signals / Reference to used environment condition set for check DFC_ACEvpTSRCMax" VALUE 0x80504B29 Val_Wu8 1.00000000000 DFES_EnvTabVerb 0.00 1.00000000000 FORMAT "%13.11" /end CHARACTERISTIC
/begin CHARACTERISTIC DFES_EnvRef.DFC_ACEvpTSRCMin_C "used environment signals / Reference to used environment condition set for check DFC_ACEvpTSRCMin" VALUE 0x80504B2A Val_Wu8 1.00000000000 DFES_EnvTabVerb 0.00 1.00000000000 FORMAT "%13.11" /end CHARACTERISTIC
/begin CHARACTERISTIC DFES_EnvRef.DFC_AfsRawSigRngHiB1_C "used environment signals / Reference to used environment condition set for check DFC_AfsRawSigRngHiB1" VALUE 0x80504B2B Val_Wu8 1.00000000000 DFES_EnvTabVerb 0.00 1.00000000000 FORMAT "%13.11" /end CHARACTERISTIC
/begin CHARACTERISTIC DFES_EnvRef.DFC_AfsRawSigRngLoB1_C "used environment signals / Reference to used environment condition set for check DFC_AfsRawSigRngLoB1" VALUE 0x80504B2C Val_Wu8 1.00000000000 DFES_EnvTabVerb 0.00 1.00000000000 FORMAT "%13.11" /end CHARACTERISTIC
/begin CHARACTERISTIC DFES_EnvRef.DFC_AfsSnsrErrB1_C "used environment signals / Reference to used environment condition set for check DFC_AfsSnsrErrB1" VALUE 0x80504B2D Val_Wu8 1.00000000000 DFES_EnvTabVerb 0.00 1.00000000000 FORMAT "%13.11" /end CHARACTERISTIC
/begin CHARACTERISTIC DFES_EnvRef.DFC_AirCClntPAnaSRCMax_C "used environment signals / Reference to used environment condition set for check DFC_AirCClntPAnaSRCMax" VALUE 0x80504B2E Val_Wu8 1.00000000000 DFES_EnvTabVerb 0.00 1.00000000000 FORMAT "%13.11" /end CHARACTERISTIC
/begin CHARACTERISTIC DFES_EnvRef.DFC_AirCClntPAnaSRCMin_C "used environment signals / Reference to used environment condition set for check DFC_AirCClntPAnaSRCMin" VALUE 0x80504B2F Val_Wu8 1.00000000000 DFES_EnvTabVerb 0.00 1.00000000000 FORMAT "%13.11" /end CHARACTERISTIC
/begin CHARACTERISTIC DFES_EnvRef.DFC_AirCSwtNpl_C "used environment signals / Reference to used environment condition set for check DFC_AirCSwtNpl" VALUE 0x80504B30 Val_Wu8 1.00000000000 DFES_EnvTabVerb 0.00 1.00000000000 FORMAT "%13.11" /end CHARACTERISTIC
/begin CHARACTERISTIC DFES_EnvRef.DFC_AirCSwtSig_C "used environment signals / Reference to used environment condition set for check DFC_AirCSwtSig" VALUE 0x80504B31 Val_Wu8 1.00000000000 DFES_EnvTabVerb 0.00 1.00000000000 FORMAT "%13.11" /end CHARACTERISTIC
/begin CHARACTERISTIC DFES_EnvRef.DFC_Brk_C "used environment signals / Reference to used environment condition set for check DFC_Brk" VALUE 0x80504B32 Val_Wu8 1.00000000000 DFES_EnvTabVerb 0.00 1.00000000000 FORMAT "%13.11" /end CHARACTERISTIC
/begin CHARACTERISTIC DFES_EnvRef.DFC_BrkBstSensSCB_C "used environment signals / Reference to used environment condition set for check DFC_BrkBstSensSCB" VALUE 0x80504B33 Val_Wu8 1.00000000000 DFES_EnvTabVerb 0.00 1.00000000000 FORMAT "%13.11" /end CHARACTERISTIC
/begin CHARACTERISTIC DFES_EnvRef.DFC_BrkBstSensSCG_C "used environment signals / Reference to used environment condition set for check DFC_BrkBstSensSCG" VALUE 0x80504B34 Val_Wu8 1.00000000000 DFES_EnvTabVerb 0.00 1.00000000000 FORMAT "%13.11" /end CHARACTERISTIC
/begin CHARACTERISTIC DFES_EnvRef.DFC_BrkSig_C "used environment signals / Reference to used environment condition set for check DFC_BrkSig" VALUE 0x80504B35 Val_Wu8 1.00000000000 DFES_EnvTabVerb 0.00 1.00000000000 FORMAT "%13.11" /end CHARACTERISTIC
/begin CHARACTERISTIC DFES_EnvRef.DFC_ClthSig_C "used environment signals / Reference to used environment condition set for check DFC_ClthSig" VALUE 0x80504B36 Val_Wu8 1.00000000000 DFES_EnvTabVerb 0.00 1.00000000000 FORMAT "%13.11" /end CHARACTERISTIC
/begin CHARACTERISTIC DFES_EnvRef.DFC_EGRVlvCurrLim_C "used environment signals / Reference to used environment condition set for check DFC_EGRVlvCurrLim" VALUE 0x80504B37 Val_Wu8 1.00000000000 DFES_EnvTabVerb 0.00 1.00000000000 FORMAT "%13.11" /end CHARACTERISTIC
/begin CHARACTERISTIC DFES_EnvRef.DFC_EGRVlvOL_C "used environment signals / Reference to used environment condition set for check DFC_EGRVlvOL" VALUE 0x80504B38 Val_Wu8 1.00000000000 DFES_EnvTabVerb 0.00 1.00000000000 FORMAT "%13.11" /end CHARACTERISTIC
/begin CHARACTERISTIC DFES_EnvRef.DFC_EGRVlvOvrTemp_C "used environment signals / Reference to used environment condition set for check DFC_EGRVlvOvrTemp" VALUE 0x80504B39 Val_Wu8 1.00000000000 DFES_EnvTabVerb 0.00 1.00000000000 FORMAT "%13.11" /end CHARACTERISTIC
/begin CHARACTERISTIC DFES_EnvRef.DFC_EGRVlvSCB_C "used environment signals / Reference to used environment condition set for check DFC_EGRVlvSCB" VALUE 0x80504B3A Val_Wu8 1.00000000000 DFES_EnvTabVerb 0.00 1.00000000000 FORMAT "%13.11" /end CHARACTERISTIC
/begin CHARACTERISTIC DFES_EnvRef.DFC_EGRVlvSCG_C "used environment signals / Reference to used environment condition set for check DFC_EGRVlvSCG" VALUE 0x80504B3B Val_Wu8 1.00000000000 DFES_EnvTabVerb 0.00 1.00000000000 FORMAT "%13.11" /end CHARACTERISTIC
/begin CHARACTERISTIC DFES_EnvRef.DFC_EGRVlvSRCMax_C "used environment signals / Reference to used environment condition set for check DFC_EGRVlvSRCMax" VALUE 0x80504B3C Val_Wu8 1.00000000000 DFES_EnvTabVerb 0.00 1.00000000000 FORMAT "%13.11" /end CHARACTERISTIC
/begin CHARACTERISTIC DFES_EnvRef.DFC_EGRVlvSRCMin_C "used environment signals / Reference to used environment condition set for check DFC_EGRVlvSRCMin" VALUE 0x80504B3D Val_Wu8 1.00000000000 DFES_EnvTabVerb 0.00 1.00000000000 FORMAT "%13.11" /end CHARACTERISTIC
/begin CHARACTERISTIC DFES_EnvRef.DFC_HLSDemOvhtEngLim_C "used environment signals / Reference to used environment condition set for check DFC_HLSDemOvhtEngLim" VALUE 0x80504B3E Val_Wu8 1.00000000000 DFES_EnvTabVerb 0.00 1.00000000000 FORMAT "%13.11" /end CHARACTERISTIC
/begin CHARACTERISTIC DFES_EnvRef.DFC_OilPSwmpSRCMax_C "used environment signals / Reference to used environment condition set for check DFC_OilPSwmpSRCMax" VALUE 0x80504B3F Val_Wu8 1.00000000000 DFES_EnvTabVerb 0.00 1.00000000000 FORMAT "%13.11" /end CHARACTERISTIC
/begin CHARACTERISTIC DFES_EnvRef.DFC_OilPSwmpSRCMin_C "used environment signals / Reference to used environment condition set for check DFC_OilPSwmpSRCMin" VALUE 0x80504B40 Val_Wu8 1.00000000000 DFES_EnvTabVerb 0.00 1.00000000000 FORMAT "%13.11" /end CHARACTERISTIC
/begin CHARACTERISTIC DFES_EnvRef.DFC_PIntkVUsLineHiB1_C "used environment signals / Reference to used environment condition set for check DFC_PIntkVUsLineHiB1" VALUE 0x80504B41 Val_Wu8 1.00000000000 DFES_EnvTabVerb 0.00 1.00000000000 FORMAT "%13.11" /end CHARACTERISTIC
/begin CHARACTERISTIC DFES_EnvRef.DFC_PIntkVUsLineLoB1_C "used environment signals / Reference to used environment condition set for check DFC_PIntkVUsLineLoB1" VALUE 0x80504B42 Val_Wu8 1.00000000000 DFES_EnvTabVerb 0.00 1.00000000000 FORMAT "%13.11" /end CHARACTERISTIC
/begin CHARACTERISTIC DFES_EnvRef.DFC_VehVPhysRngLo_C "used environment signals / Reference to used environment condition set for check DFC_VehVPhysRngLo" VALUE 0x80504B43 Val_Wu8 1.00000000000 DFES_EnvTabVerb 0.00 1.00000000000 FORMAT "%13.11" /end CHARACTERISTIC
/begin CHARACTERISTIC DFES_EnvRef.DFC_VehVSigCan_C "used environment signals / Reference to used environment condition set for check DFC_VehVSigCan" VALUE 0x80504B44 Val_Wu8 1.00000000000 DFES_EnvTabVerb 0.00 1.00000000000 FORMAT "%13.11" /end CHARACTERISTIC
/begin CHARACTERISTIC DFES_EnvRef.DFC_VehVSigCanSafe_C "used environment signals / Reference to used environment condition set for check DFC_VehVSigCanSafe" VALUE 0x80504B45 Val_Wu8 1.00000000000 DFES_EnvTabVerb 0.00 1.00000000000 FORMAT "%13.11" /end CHARACTERISTIC
/begin CHARACTERISTIC DFES_EnvRef.DFC_VlvLftFbOilPSnsrIntk11SRCMax_C "used environment signals / Reference to used environment condition set for check DFC_VlvLftFbOilPSnsrIntk11SRCMax" VALUE 0x80504B46 Val_Wu8 1.00000000000 DFES_EnvTabVerb 0.00 1.00000000000 FORMAT "%13.11" /end CHARACTERISTIC
/begin CHARACTERISTIC DFES_EnvRef.DFC_VlvLftFbOilPSnsrIntk11SRCMin_C "used environment signals / Reference to used environment condition set for check DFC_VlvLftFbOilPSnsrIntk11SRCMin" VALUE 0x80504B47 Val_Wu8 1.00000000000 DFES_EnvTabVerb 0.00 1.00000000000 FORMAT "%13.11" /end CHARACTERISTIC
/begin CHARACTERISTIC DFES_EnvRef.DFC_ClthNpl_C "used environment signals / Reference to used environment condition set for check DFC_ClthNpl" VALUE 0x80504B48 Val_Wu8 1.00000000000 DFES_EnvTabVerb 0.00 1.00000000000 FORMAT "%13.11" /end CHARACTERISTIC
/begin CHARACTERISTIC DFES_EnvRef.DFC_GbxPNPosnDrvCdn_C "used environment signals / Reference to used environment condition set for check DFC_GbxPNPosnDrvCdn" VALUE 0x80504B49 Val_Wu8 1.00000000000 DFES_EnvTabVerb 0.00 1.00000000000 FORMAT "%13.11" /end CHARACTERISTIC
/begin CHARACTERISTIC DFES_EnvRef.DFC_GbxPNPosnPlausy_C "used environment signals / Reference to used environment condition set for check DFC_GbxPNPosnPlausy" VALUE 0x80504B4A Val_Wu8 1.00000000000 DFES_EnvTabVerb 0.00 1.00000000000 FORMAT "%13.11" /end CHARACTERISTIC
/begin CHARACTERISTIC DFES_EnvRef.DFC_AfsSigErrLineHiB1_C "used environment signals / Reference to used environment condition set for check DFC_AfsSigErrLineHiB1" VALUE 0x80504B4B Val_Wu8 1.00000000000 DFES_EnvTabVerb 0.00 1.00000000000 FORMAT "%13.11" /end CHARACTERISTIC
/begin CHARACTERISTIC DFES_EnvRef.DFC_AfsSigErrLineLoB1_C "used environment signals / Reference to used environment condition set for check DFC_AfsSigErrLineLoB1" VALUE 0x80504B4C Val_Wu8 1.00000000000 DFES_EnvTabVerb 0.00 1.00000000000 FORMAT "%13.11" /end CHARACTERISTIC
/begin CHARACTERISTIC DFES_EnvRef.DFC_PEnvCcMax_C "used environment signals / Reference to used environment condition set for check DFC_PEnvCcMax" VALUE 0x80504B4D Val_Wu8 1.00000000000 DFES_EnvTabVerb 0.00 1.00000000000 FORMAT "%13.11" /end CHARACTERISTIC
/begin CHARACTERISTIC DFES_EnvRef.DFC_PEnvCcMin_C "used environment signals / Reference to used environment condition set for check DFC_PEnvCcMin" VALUE 0x80504B4E Val_Wu8 1.00000000000 DFES_EnvTabVerb 0.00 1.00000000000 FORMAT "%13.11" /end CHARACTERISTIC
/begin CHARACTERISTIC DFES_EnvRef.DFC_PEnvRngChkMax_C "used environment signals / Reference to used environment condition set for check DFC_PEnvRngChkMax" VALUE 0x80504B4F Val_Wu8 1.00000000000 DFES_EnvTabVerb 0.00 1.00000000000 FORMAT "%13.11" /end CHARACTERISTIC
/begin CHARACTERISTIC DFES_EnvRef.DFC_PEnvRngChkMin_C "used environment signals / Reference to used environment condition set for check DFC_PEnvRngChkMin" VALUE 0x80504B50 Val_Wu8 1.00000000000 DFES_EnvTabVerb 0.00 1.00000000000 FORMAT "%13.11" /end CHARACTERISTIC
/begin CHARACTERISTIC DFES_EnvRef.DFC_PEnvSnsrPlaus_C "used environment signals / Reference to used environment condition set for check DFC_PEnvSnsrPlaus" VALUE 0x80504B51 Val_Wu8 1.00000000000 DFES_EnvTabVerb 0.00 1.00000000000 FORMAT "%13.11" /end CHARACTERISTIC
/begin CHARACTERISTIC DFES_EnvRef.DFC_UEGOHeatrRlyPsOLS1B1_C "used environment signals / Reference to used environment condition set for check DFC_UEGOHeatrRlyPsOLS1B1" VALUE 0x80504B52 Val_Wu8 1.00000000000 DFES_EnvTabVerb 0.00 1.00000000000 FORMAT "%13.11" /end CHARACTERISTIC
/begin CHARACTERISTIC DFES_EnvRef.DFC_UEGOHeatrRlyPsSCBS1B1_C "used environment signals / Reference to used environment condition set for check DFC_UEGOHeatrRlyPsSCBS1B1" VALUE 0x80504B53 Val_Wu8 1.00000000000 DFES_EnvTabVerb 0.00 1.00000000000 FORMAT "%13.11" /end CHARACTERISTIC
/begin CHARACTERISTIC DFES_EnvRef.DFC_UEGOHeatrRlyPsSCGS1B1_C "used environment signals / Reference to used environment condition set for check DFC_UEGOHeatrRlyPsSCGS1B1" VALUE 0x80504B54 Val_Wu8 1.00000000000 DFES_EnvTabVerb 0.00 1.00000000000 FORMAT "%13.11" /end CHARACTERISTIC
/begin CHARACTERISTIC DFES_EnvRef.DFC_UegoHeatrWireOlS1B1_C "used environment signals / Reference to used environment condition set for check DFC_UegoHeatrWireOlS1B1" VALUE 0x80504B55 Val_Wu8 1.00000000000 DFES_EnvTabVerb 0.00 1.00000000000 FORMAT "%13.11" /end CHARACTERISTIC
/begin CHARACTERISTIC DFES_EnvRef.DFC_UegoHeatrWireScbS1B1_C "used environment signals / Reference to used environment condition set for check DFC_UegoHeatrWireScbS1B1" VALUE 0x80504B56 Val_Wu8 1.00000000000 DFES_EnvTabVerb 0.00 1.00000000000 FORMAT "%13.11" /end CHARACTERISTIC
/begin CHARACTERISTIC DFES_EnvRef.DFC_UegoHeatrWireScgS1B1_C "used environment signals / Reference to used environment condition set for check DFC_UegoHeatrWireScgS1B1" VALUE 0x80504B57 Val_Wu8 1.00000000000 DFES_EnvTabVerb 0.00 1.00000000000 FORMAT "%13.11" /end CHARACTERISTIC
/begin CHARACTERISTIC DFES_EnvRef.DFC_KnDetSens1PortAMax_C "used environment signals / Reference to used environment condition set for check DFC_KnDetSens1PortAMax" VALUE 0x80504B58 Val_Wu8 1.00000000000 DFES_EnvTabVerb 0.00 1.00000000000 FORMAT "%13.11" /end CHARACTERISTIC
/begin CHARACTERISTIC DFES_EnvRef.DFC_KnDetSens1PortAMin_C "used environment signals / Reference to used environment condition set for check DFC_KnDetSens1PortAMin" VALUE 0x80504B59 Val_Wu8 1.00000000000 DFES_EnvTabVerb 0.00 1.00000000000 FORMAT "%13.11" /end CHARACTERISTIC
/begin CHARACTERISTIC DFES_EnvRef.DFC_KnDetSens1PortBMax_C "used environment signals / Reference to used environment condition set for check DFC_KnDetSens1PortBMax" VALUE 0x80504B5A Val_Wu8 1.00000000000 DFES_EnvTabVerb 0.00 1.00000000000 FORMAT "%13.11" /end CHARACTERISTIC
/begin CHARACTERISTIC DFES_EnvRef.DFC_KnDetSens1PortBMin_C "used environment signals / Reference to used environment condition set for check DFC_KnDetSens1PortBMin" VALUE 0x80504B5B Val_Wu8 1.00000000000 DFES_EnvTabVerb 0.00 1.00000000000 FORMAT "%13.11" /end CHARACTERISTIC
/begin CHARACTERISTIC DFES_EnvRef.DFC_Clth2ONStuck_C "used environment signals / Reference to used environment condition set for check DFC_Clth2ONStuck" VALUE 0x80504B5C Val_Wu8 1.00000000000 DFES_EnvTabVerb 0.00 1.00000000000 FORMAT "%13.11" /end CHARACTERISTIC
/begin CHARACTERISTIC DFES_EnvRef.DFC_Clth2ONStuckLdc_C "used environment signals / Reference to used environment condition set for check DFC_Clth2ONStuckLdc" VALUE 0x80504B5D Val_Wu8 1.00000000000 DFES_EnvTabVerb 0.00 1.00000000000 FORMAT "%13.11" /end CHARACTERISTIC
/begin CHARACTERISTIC DFES_EnvRef.DFC_Clth3ONStuckLdc_C "used environment signals / Reference to used environment condition set for check DFC_Clth3ONStuckLdc" VALUE 0x80504B5E Val_Wu8 1.00000000000 DFES_EnvTabVerb 0.00 1.00000000000 FORMAT "%13.11" /end CHARACTERISTIC
/begin CHARACTERISTIC DFES_EnvRef.DFC_Clth3ONStuckPostDrv_C "used environment signals / Reference to used environment condition set for check DFC_Clth3ONStuckPostDrv" VALUE 0x80504B5F Val_Wu8 1.00000000000 DFES_EnvTabVerb 0.00 1.00000000000 FORMAT "%13.11" /end CHARACTERISTIC
/begin CHARACTERISTIC DFES_EnvRef.DFC_Clth4ONStuck_C "used environment signals / Reference to used environment condition set for check DFC_Clth4ONStuck" VALUE 0x80504B60 Val_Wu8 1.00000000000 DFES_EnvTabVerb 0.00 1.00000000000 FORMAT "%13.11" /end CHARACTERISTIC
/begin CHARACTERISTIC DFES_EnvRef.DFC_Clth4ONStuckLdc_C "used environment signals / Reference to used environment condition set for check DFC_Clth4ONStuckLdc" VALUE 0x80504B61 Val_Wu8 1.00000000000 DFES_EnvTabVerb 0.00 1.00000000000 FORMAT "%13.11" /end CHARACTERISTIC
/begin CHARACTERISTIC DFES_EnvRef.DFC_ComBCMUnit_C "used environment signals / Reference to used environment condition set for check DFC_ComBCMUnit" VALUE 0x80504B62 Val_Wu8 1.00000000000 DFES_EnvTabVerb 0.00 1.00000000000 FORMAT "%13.11" /end CHARACTERISTIC
/begin CHARACTERISTIC DFES_EnvRef.DFC_ComDLCTCU01_C "used environment signals / Reference to used environment condition set for check DFC_ComDLCTCU01" VALUE 0x80504B63 Val_Wu8 1.00000000000 DFES_EnvTabVerb 0.00 1.00000000000 FORMAT "%13.11" /end CHARACTERISTIC
/begin CHARACTERISTIC DFES_EnvRef.DFC_ComDLCTCU02_C "used environment signals / Reference to used environment condition set for check DFC_ComDLCTCU02" VALUE 0x80504B64 Val_Wu8 1.00000000000 DFES_EnvTabVerb 0.00 1.00000000000 FORMAT "%13.11" /end CHARACTERISTIC
/begin CHARACTERISTIC DFES_EnvRef.DFC_ComDLCTCU1_C "used environment signals / Reference to used environment condition set for check DFC_ComDLCTCU1" VALUE 0x80504B65 Val_Wu8 1.00000000000 DFES_EnvTabVerb 0.00 1.00000000000 FORMAT "%13.11" /end CHARACTERISTIC
/begin CHARACTERISTIC DFES_EnvRef.DFC_ComDLCTCU11_C "used environment signals / Reference to used environment condition set for check DFC_ComDLCTCU11" VALUE 0x80504B66 Val_Wu8 1.00000000000 DFES_EnvTabVerb 0.00 1.00000000000 FORMAT "%13.11" /end CHARACTERISTIC
/begin CHARACTERISTIC DFES_EnvRef.DFC_ComDLCTCU12_C "used environment signals / Reference to used environment condition set for check DFC_ComDLCTCU12" VALUE 0x80504B67 Val_Wu8 1.00000000000 DFES_EnvTabVerb 0.00 1.00000000000 FORMAT "%13.11" /end CHARACTERISTIC
/begin CHARACTERISTIC DFES_EnvRef.DFC_ComDLCTCU13_C "used environment signals / Reference to used environment condition set for check DFC_ComDLCTCU13" VALUE 0x80504B68 Val_Wu8 1.00000000000 DFES_EnvTabVerb 0.00 1.00000000000 FORMAT "%13.11" /end CHARACTERISTIC
/begin CHARACTERISTIC DFES_EnvRef.DFC_ComDLCTCU14_C "used environment signals / Reference to used environment condition set for check DFC_ComDLCTCU14" VALUE 0x80504B69 Val_Wu8 1.00000000000 DFES_EnvTabVerb 0.00 1.00000000000 FORMAT "%13.11" /end CHARACTERISTIC
/begin CHARACTERISTIC DFES_EnvRef.DFC_ComDLCTCU2_C "used environment signals / Reference to used environment condition set for check DFC_ComDLCTCU2" VALUE 0x80504B6A Val_Wu8 1.00000000000 DFES_EnvTabVerb 0.00 1.00000000000 FORMAT "%13.11" /end CHARACTERISTIC
/begin CHARACTERISTIC DFES_EnvRef.DFC_ComDLCTCU3_C "used environment signals / Reference to used environment condition set for check DFC_ComDLCTCU3" VALUE 0x80504B6B Val_Wu8 1.00000000000 DFES_EnvTabVerb 0.00 1.00000000000 FORMAT "%13.11" /end CHARACTERISTIC
/begin CHARACTERISTIC DFES_EnvRef.DFC_ComDLCTCU4_C "used environment signals / Reference to used environment condition set for check DFC_ComDLCTCU4" VALUE 0x80504B6C Val_Wu8 1.00000000000 DFES_EnvTabVerb 0.00 1.00000000000 FORMAT "%13.11" /end CHARACTERISTIC
/begin CHARACTERISTIC DFES_EnvRef.DFC_ComEPSUnit_C "used environment signals / Reference to used environment condition set for check DFC_ComEPSUnit" VALUE 0x80504B6D Val_Wu8 1.00000000000 DFES_EnvTabVerb 0.00 1.00000000000 FORMAT "%13.11" /end CHARACTERISTIC
/begin CHARACTERISTIC DFES_EnvRef.DFC_ComIDASBUnit_C "used environment signals / Reference to used environment condition set for check DFC_ComIDASBUnit" VALUE 0x80504B6E Val_Wu8 1.00000000000 DFES_EnvTabVerb 0.00 1.00000000000 FORMAT "%13.11" /end CHARACTERISTIC
/begin CHARACTERISTIC DFES_EnvRef.DFC_ComIMGUnit_C "used environment signals / Reference to used environment condition set for check DFC_ComIMGUnit" VALUE 0x80504B6F Val_Wu8 1.00000000000 DFES_EnvTabVerb 0.00 1.00000000000 FORMAT "%13.11" /end CHARACTERISTIC
/begin CHARACTERISTIC DFES_EnvRef.DFC_ComMETUnit_C "used environment signals / Reference to used environment condition set for check DFC_ComMETUnit" VALUE 0x80504B70 Val_Wu8 1.00000000000 DFES_EnvTabVerb 0.00 1.00000000000 FORMAT "%13.11" /end CHARACTERISTIC
/begin CHARACTERISTIC DFES_EnvRef.DFC_ComSRSUnit_C "used environment signals / Reference to used environment condition set for check DFC_ComSRSUnit" VALUE 0x80504B71 Val_Wu8 1.00000000000 DFES_EnvTabVerb 0.00 1.00000000000 FORMAT "%13.11" /end CHARACTERISTIC
/begin CHARACTERISTIC DFES_EnvRef.DFC_ComVSAUnit_C "used environment signals / Reference to used environment condition set for check DFC_ComVSAUnit" VALUE 0x80504B72 Val_Wu8 1.00000000000 DFES_EnvTabVerb 0.00 1.00000000000 FORMAT "%13.11" /end CHARACTERISTIC
/begin CHARACTERISTIC DFES_EnvRef.DFC_EbsSocFlt_C "used environment signals / Reference to used environment condition set for check DFC_EbsSocFlt" VALUE 0x80504B73 Val_Wu8 1.00000000000 DFES_EnvTabVerb 0.00 1.00000000000 FORMAT "%13.11" /end CHARACTERISTIC
/begin CHARACTERISTIC DFES_EnvRef.DFC_I14229VINErr_C "used environment signals / Reference to used environment condition set for check DFC_I14229VINErr" VALUE 0x80504B74 Val_Wu8 1.00000000000 DFES_EnvTabVerb 0.00 1.00000000000 FORMAT "%13.11" /end CHARACTERISTIC
/begin CHARACTERISTIC DFES_EnvRef.DFC_InjCatHeatgErr_C "used environment signals / Reference to used environment condition set for check DFC_InjCatHeatgErr" VALUE 0x80504B75 Val_Wu8 1.00000000000 DFES_EnvTabVerb 0.00 1.00000000000 FORMAT "%13.11" /end CHARACTERISTIC
/begin CHARACTERISTIC DFES_EnvRef.DFC_InjSysMulInjDiagErr_C "used environment signals / Reference to used environment condition set for check DFC_InjSysMulInjDiagErr" VALUE 0x80504B76 Val_Wu8 1.00000000000 DFES_EnvTabVerb 0.00 1.00000000000 FORMAT "%13.11" /end CHARACTERISTIC
/begin CHARACTERISTIC DFES_EnvRef.DFC_LLRHmax_C "used environment signals / Reference to used environment condition set for check DFC_LLRHmax" VALUE 0x80504B77 Val_Wu8 1.00000000000 DFES_EnvTabVerb 0.00 1.00000000000 FORMAT "%13.11" /end CHARACTERISTIC
/begin CHARACTERISTIC DFES_EnvRef.DFC_LLRHmin_C "used environment signals / Reference to used environment condition set for check DFC_LLRHmin" VALUE 0x80504B78 Val_Wu8 1.00000000000 DFES_EnvTabVerb 0.00 1.00000000000 FORMAT "%13.11" /end CHARACTERISTIC
/begin CHARACTERISTIC DFES_EnvRef.DFC_LLRHnpl_C "used environment signals / Reference to used environment condition set for check DFC_LLRHnpl" VALUE 0x80504B79 Val_Wu8 1.00000000000 DFES_EnvTabVerb 0.00 1.00000000000 FORMAT "%13.11" /end CHARACTERISTIC
/begin CHARACTERISTIC DFES_EnvRef.DFC_LLRKHmax_C "used environment signals / Reference to used environment condition set for check DFC_LLRKHmax" VALUE 0x80504B7A Val_Wu8 1.00000000000 DFES_EnvTabVerb 0.00 1.00000000000 FORMAT "%13.11" /end CHARACTERISTIC
/begin CHARACTERISTIC DFES_EnvRef.DFC_LLRKHmin_C "used environment signals / Reference to used environment condition set for check DFC_LLRKHmin" VALUE 0x80504B7B Val_Wu8 1.00000000000 DFES_EnvTabVerb 0.00 1.00000000000 FORMAT "%13.11" /end CHARACTERISTIC
/begin CHARACTERISTIC DFES_EnvRef.DFC_LLRKHnpl_C "used environment signals / Reference to used environment condition set for check DFC_LLRKHnpl" VALUE 0x80504B7C Val_Wu8 1.00000000000 DFES_EnvTabVerb 0.00 1.00000000000 FORMAT "%13.11" /end CHARACTERISTIC
/begin CHARACTERISTIC DFES_EnvRef.DFC_LinACGUnit_C "used environment signals / Reference to used environment condition set for check DFC_LinACGUnit" VALUE 0x80504B7D Val_Wu8 1.00000000000 DFES_EnvTabVerb 0.00 1.00000000000 FORMAT "%13.11" /end CHARACTERISTIC
/begin CHARACTERISTIC DFES_EnvRef.DFC_LinAEVUnit_C "used environment signals / Reference to used environment condition set for check DFC_LinAEVUnit" VALUE 0x80504B7E Val_Wu8 1.00000000000 DFES_EnvTabVerb 0.00 1.00000000000 FORMAT "%13.11" /end CHARACTERISTIC
/begin CHARACTERISTIC DFES_EnvRef.DFC_LinEBSUnit_C "used environment signals / Reference to used environment condition set for check DFC_LinEBSUnit" VALUE 0x80504B7F Val_Wu8 1.00000000000 DFES_EnvTabVerb 0.00 1.00000000000 FORMAT "%13.11" /end CHARACTERISTIC
/begin CHARACTERISTIC DFES_EnvRef.DFC_RoughRoad_C "used environment signals / Reference to used environment condition set for check DFC_RoughRoad" VALUE 0x80504B80 Val_Wu8 1.00000000000 DFES_EnvTabVerb 0.00 1.00000000000 FORMAT "%13.11" /end CHARACTERISTIC
/begin CHARACTERISTIC DFES_EnvRef.DFC_SiaEEPRdErr_C "used environment signals / Reference to used environment condition set for check DFC_SiaEEPRdErr" VALUE 0x80504B81 Val_Wu8 1.00000000000 DFES_EnvTabVerb 0.00 1.00000000000 FORMAT "%13.11" /end CHARACTERISTIC
/begin CHARACTERISTIC DFES_EnvRef.DFC_SiaEEPWrngCod_C "used environment signals / Reference to used environment condition set for check DFC_SiaEEPWrngCod" VALUE 0x80504B82 Val_Wu8 1.00000000000 DFES_EnvTabVerb 0.00 1.00000000000 FORMAT "%13.11" /end CHARACTERISTIC
/begin CHARACTERISTIC DFES_EnvRef.DFC_UegoHeatrStrtS1B1_C "used environment signals / Reference to used environment condition set for check DFC_UegoHeatrStrtS1B1" VALUE 0x80504B83 Val_Wu8 1.00000000000 DFES_EnvTabVerb 0.00 1.00000000000 FORMAT "%13.11" /end CHARACTERISTIC
/begin CHARACTERISTIC DFES_EnvRef.DFC_BusDiagCANAPPLBusOff_C "used environment signals / Reference to used environment condition set for check DFC_BusDiagCANAPPLBusOff" VALUE 0x80504B84 Val_Wu8 1.00000000000 DFES_EnvTabVerb 0.00 1.00000000000 FORMAT "%13.11" /end CHARACTERISTIC
/begin CHARACTERISTIC DFES_EnvRef.DFC_BusDiagCANCANCBusOff_C "used environment signals / Reference to used environment condition set for check DFC_BusDiagCANCANCBusOff" VALUE 0x80504B85 Val_Wu8 1.00000000000 DFES_EnvTabVerb 0.00 1.00000000000 FORMAT "%13.11" /end CHARACTERISTIC
/begin CHARACTERISTIC DFES_EnvRef.DFC_BusDiagCANVEHICLEBusOff_C "used environment signals / Reference to used environment condition set for check DFC_BusDiagCANVEHICLEBusOff" VALUE 0x80504B86 Val_Wu8 1.00000000000 DFES_EnvTabVerb 0.00 1.00000000000 FORMAT "%13.11" /end CHARACTERISTIC
/begin CHARACTERISTIC DFES_EnvRef.DFC_RBA_IODIAGPWR_rba_IoExtCy329_SignalVltSply_0_C "used environment signals / Reference to used environment condition set for check DFC_RBA_IODIAGPWR_rba_IoExtCy329_SignalVltSply_0" VALUE 0x80504B87 Val_Wu8 1.00000000000 DFES_EnvTabVerb 0.00 1.00000000000 FORMAT "%13.11" /end CHARACTERISTIC
/begin CHARACTERISTIC DFES_EnvRef.DFC_RBA_IODIAGPWR_rba_IoExtCy329_SignalVltSply_0OT_C "used environment signals / Reference to used environment condition set for check DFC_RBA_IODIAGPWR_rba_IoExtCy329_SignalVltSply_0OT" VALUE 0x80504B88 Val_Wu8 1.00000000000 DFES_EnvTabVerb 0.00 1.00000000000 FORMAT "%13.11" /end CHARACTERISTIC
/begin CHARACTERISTIC DFES_EnvRef.DFC_RBA_IODIAGPWR_rba_IoExtCy329_SignalVltSply_0OV_C "used environment signals / Reference to used environment condition set for check DFC_RBA_IODIAGPWR_rba_IoExtCy329_SignalVltSply_0OV" VALUE 0x80504B89 Val_Wu8 1.00000000000 DFES_EnvTabVerb 0.00 1.00000000000 FORMAT "%13.11" /end CHARACTERISTIC
/begin CHARACTERISTIC DFES_EnvRef.DFC_RBA_IODIAGPWR_rba_IoExtCy329_SignalVltSply_0SCG_C "used environment signals / Reference to used environment condition set for check DFC_RBA_IODIAGPWR_rba_IoExtCy329_SignalVltSply_0SCG" VALUE 0x80504B8A Val_Wu8 1.00000000000 DFES_EnvTabVerb 0.00 1.00000000000 FORMAT "%13.11" /end CHARACTERISTIC
/begin CHARACTERISTIC DFES_EnvRef.DFC_RBA_IODIAGPWR_rba_IoExtCy329_SignalVltSply_0UV_C "used environment signals / Reference to used environment condition set for check DFC_RBA_IODIAGPWR_rba_IoExtCy329_SignalVltSply_0UV" VALUE 0x80504B8B Val_Wu8 1.00000000000 DFES_EnvTabVerb 0.00 1.00000000000 FORMAT "%13.11" /end CHARACTERISTIC
/begin CHARACTERISTIC DFES_EnvRef.DFC_RBA_IODIAGPWR_rba_IoExtCy329_SignalVltSply_1_C "used environment signals / Reference to used environment condition set for check DFC_RBA_IODIAGPWR_rba_IoExtCy329_SignalVltSply_1" VALUE 0x80504B8C Val_Wu8 1.00000000000 DFES_EnvTabVerb 0.00 1.00000000000 FORMAT "%13.11" /end CHARACTERISTIC
/begin CHARACTERISTIC DFES_EnvRef.DFC_RBA_IODIAGPWR_rba_IoExtCy329_SignalVltSply_1OT_C "used environment signals / Reference to used environment condition set for check DFC_RBA_IODIAGPWR_rba_IoExtCy329_SignalVltSply_1OT" VALUE 0x80504B8D Val_Wu8 1.00000000000 DFES_EnvTabVerb 0.00 1.00000000000 FORMAT "%13.11" /end CHARACTERISTIC
/begin CHARACTERISTIC DFES_EnvRef.DFC_RBA_IODIAGPWR_rba_IoExtCy329_SignalVltSply_1OV_C "used environment signals / Reference to used environment condition set for check DFC_RBA_IODIAGPWR_rba_IoExtCy329_SignalVltSply_1OV" VALUE 0x80504B8E Val_Wu8 1.00000000000 DFES_EnvTabVerb 0.00 1.00000000000 FORMAT "%13.11" /end CHARACTERISTIC
/begin FUNCTION DFES "30000.73.0_2.0.0Diagnostic Fault Event Storage"
 /begin DEF_CHARACTERISTIC DFES_Env.xSet1_CA DFES_Env.xSet2_CA DFES_EnvRef.DFC_Unused_C DFES_EnvRef.DFC_AAVEmax_C DFES_EnvRef.DFC_AAVEmin_C DFES_EnvRef.DFC_AAVEsig_C DFES_EnvRef.DFC_AltIOACGFailr_C DFES_EnvRef.DFC_AltIOACGHiVltg_C DFES_EnvRef.DFC_AltIOACGLoVltg_C DFES_EnvRef.DFC_AltIOACGTHi_C DFES_EnvRef.DFC_AltIODConnACG_C DFES_EnvRef.DFC_BGOELWAF_C DFES_EnvRef.DFC_BattUHiFailr_C DFES_EnvRef.DFC_BattULoFailr_C DFES_EnvRef.DFC_BrkBstPDriftHiErr_C DFES_EnvRef.DFC_BrkBstPDriftLoErr_C DFES_EnvRef.DFC_BrkBstPSnsrStuck_C DFES_EnvRef.DFC_BrkMnSwtContOn_C DFES_EnvRef.DFC_BrkMnSwtNotStp_C DFES_EnvRef.DFC_BrkNpl_C DFES_EnvRef.DFC_BrkRdntSwtContOn_C DFES_EnvRef.DFC_BrkRdntSwtNotStp_C DFES_EnvRef.DFC_Clth3ONStuck_C DFES_EnvRef.DFC_Clth4OFFStuck_C DFES_EnvRef.DFC_ClthOFFStuck_C DFES_EnvRef.DFC_ClthONStuck_C DFES_EnvRef.DFC_ClthStkFailInfo_C DFES_EnvRef.DFC_ComACFailInfo_C DFES_EnvRef.DFC_ComATFTValErr_C DFES_EnvRef.DFC_ComATMILReq_C DFES_EnvRef.DFC_ComAYCAChksum_C DFES_EnvRef.DFC_ComAYCARingCnt_C DFES_EnvRef.DFC_ComAYCATOut_C DFES_EnvRef.DFC_ComAYCDChkSum_C DFES_EnvRef.DFC_ComAYCDTOut_C DFES_EnvRef.DFC_ComAYCFChksum_C DFES_EnvRef.DFC_ComAYCFRingCnt_C DFES_EnvRef.DFC_ComAYCFTOut_C DFES_EnvRef.DFC_ComAYCGChksum_C DFES_EnvRef.DFC_ComAYCGRingCnt_C DFES_EnvRef.DFC_ComAYCGTOut_C DFES_EnvRef.DFC_ComAYCIChkSum_C DFES_EnvRef.DFC_ComAYCIRingCnt_C DFES_EnvRef.DFC_ComAYCITOut_C DFES_EnvRef.DFC_ComBCM1ChkSum_C DFES_EnvRef.DFC_ComBCM1RingCnt_C DFES_EnvRef.DFC_ComBCM1TOut_C DFES_EnvRef.DFC_ComCANABusOffErr_C DFES_EnvRef.DFC_ComCANBBusOffErr_C DFES_EnvRef.DFC_ComCANCBusOffErr_C DFES_EnvRef.DFC_ComCGW1ChkSum_C DFES_EnvRef.DFC_ComCGW1RingCnt_C DFES_EnvRef.DFC_ComCGW1TOut_C DFES_EnvRef.DFC_ComConvBoostErr_C DFES_EnvRef.DFC_ComConvSlipErr_C DFES_EnvRef.DFC_ComDCDCPrfmncErr_C DFES_EnvRef.DFC_ComDCDCTempWarn_C DFES_EnvRef.DFC_ComEAT10Chksum_C DFES_EnvRef.DFC_ComEAT10RingCnt_C DFES_EnvRef.DFC_ComEAT10TOut_C DFES_EnvRef.DFC_ComEAT11ChkSum_C DFES_EnvRef.DFC_ComEAT11RingCnt_C DFES_EnvRef.DFC_ComEAT11TOut_C DFES_EnvRef.DFC_ComEAT12ChkSum_C DFES_EnvRef.DFC_ComEAT12RingCnt_C DFES_EnvRef.DFC_ComEAT12TOut_C DFES_EnvRef.DFC_ComEAT13ChkSum_C DFES_EnvRef.DFC_ComEAT13RingCnt_C DFES_EnvRef.DFC_ComEAT13TOut_C DFES_EnvRef.DFC_ComEAT1Chksum_C DFES_EnvRef.DFC_ComEAT1RingCnt_C DFES_EnvRef.DFC_ComEAT1TOut_C DFES_EnvRef.DFC_ComEAT2ChkSum_C DFES_EnvRef.DFC_ComEAT2RingCnt_C DFES_EnvRef.DFC_ComEAT2TOut_C DFES_EnvRef.DFC_ComEAT4ChkSum_C DFES_EnvRef.DFC_ComEAT4RingCnt_C DFES_EnvRef.DFC_ComEAT4TOut_C DFES_EnvRef.DFC_ComEAT6Chksum_C DFES_EnvRef.DFC_ComEAT6RingCnt_C DFES_EnvRef.DFC_ComEAT6TOut_C DFES_EnvRef.DFC_ComEAT7Chksum_C DFES_EnvRef.DFC_ComEAT7RingCnt_C DFES_EnvRef.DFC_ComEAT7TOut_C DFES_EnvRef.DFC_ComEAT8Chksum_C DFES_EnvRef.DFC_ComEAT8RingCnt_C DFES_EnvRef.DFC_ComEAT8TOut_C DFES_EnvRef.DFC_ComEATAChksum_C DFES_EnvRef.DFC_ComEATARingCnt_C DFES_EnvRef.DFC_ComEATATOut_C DFES_EnvRef.DFC_ComEATBChkSum_C DFES_EnvRef.DFC_ComEATBRingCnt_C DFES_EnvRef.DFC_ComEATBTOut_C DFES_EnvRef.DFC_ComEATCChksum_C DFES_EnvRef.DFC_ComEATCRingCnt_C DFES_EnvRef.DFC_ComEATCTOut_C DFES_EnvRef.DFC_ComEPBBChkSum_C DFES_EnvRef.DFC_ComEPBBRingCnt_C DFES_EnvRef.DFC_ComEPBBTOut_C DFES_EnvRef.DFC_ComEPBChksum_C DFES_EnvRef.DFC_ComEPBTOut_C DFES_EnvRef.DFC_ComEPBctRing_C DFES_EnvRef.DFC_ComEPS1Chksum_C DFES_EnvRef.DFC_ComEPS1RingCnt_C DFES_EnvRef.DFC_ComEPS1TOut_C DFES_EnvRef.DFC_ComEngCanRxErr_C DFES_EnvRef.DFC_ComGrvySnsrErr_C DFES_EnvRef.DFC_ComGwIMG1ChkSum_C DFES_EnvRef.DFC_ComGwIMG1RingCnt_C DFES_EnvRef.DFC_ComGwIMG1TOut_C DFES_EnvRef.DFC_ComGwIMG3ChkSum_C DFES_EnvRef.DFC_ComGwIMG3RingCnt_C DFES_EnvRef.DFC_ComGwIMG3TOut_C DFES_EnvRef.DFC_ComGwIMG4ChkSum_C DFES_EnvRef.DFC_ComGwIMG4RingCnt_C DFES_EnvRef.DFC_ComGwIMG4TOut_C DFES_EnvRef.DFC_ComGwIMG5ChkSum_C DFES_EnvRef.DFC_ComGwIMG5RingCnt_C DFES_EnvRef.DFC_ComGwIMG5TOut_C DFES_EnvRef.DFC_ComGwIMG6ChkSum_C DFES_EnvRef.DFC_ComGwIMG6RingCnt_C DFES_EnvRef.DFC_ComGwIMG6TOut_C DFES_EnvRef.DFC_ComIDASBChksum_C DFES_EnvRef.DFC_ComIDASBRingCnt_C DFES_EnvRef.DFC_ComIDASBTOut_C DFES_EnvRef.DFC_ComIMGMILReq_C DFES_EnvRef.DFC_ComISSPrms_C DFES_EnvRef.DFC_ComMETAChksum_C DFES_EnvRef.DFC_ComMETAChksumPstDrv_C DFES_EnvRef.DFC_ComMETARingCnt_C DFES_EnvRef.DFC_ComMETARingCntPstDrv_C DFES_EnvRef.DFC_ComMETATOut_C DFES_EnvRef.DFC_ComMETATOutPstDrv_C DFES_EnvRef.DFC_ComMETCChksum_C DFES_EnvRef.DFC_ComMETCRingCnt_C DFES_EnvRef.DFC_ComMETCTOut_C DFES_EnvRef.DFC_ComMETDChksum_C DFES_EnvRef.DFC_ComMETDRingCnt_C DFES_EnvRef.DFC_ComMETDTOut_C DFES_EnvRef.DFC_ComMETE2Chksum_C DFES_EnvRef.DFC_ComMETE2RingCnt_C DFES_EnvRef.DFC_ComMETE2TOut_C DFES_EnvRef.DFC_ComMETFChksum_C DFES_EnvRef.DFC_ComMETFRingCnt_C DFES_EnvRef.DFC_ComMETFTOut_C DFES_EnvRef.DFC_ComMETGChksum_C DFES_EnvRef.DFC_ComMETGRingCnt_C DFES_EnvRef.DFC_ComMETGTOut_C DFES_EnvRef.DFC_ComMETH2Chksum_C DFES_EnvRef.DFC_ComMETH2RingCnt_C DFES_EnvRef.DFC_ComMETH2TOut_C DFES_EnvRef.DFC_ComMETHChksum_C DFES_EnvRef.DFC_ComMETHRingCnt_C DFES_EnvRef.DFC_ComMETHTOut_C DFES_EnvRef.DFC_ComMETIChksum_C DFES_EnvRef.DFC_ComMETIRingCnt_C DFES_EnvRef.DFC_ComMETITOut_C DFES_EnvRef.DFC_ComMETKChksum_C DFES_EnvRef.DFC_ComMETKRingCnt_C DFES_EnvRef.DFC_ComMETKTOut_C DFES_EnvRef.DFC_ComMETLChksum_C DFES_EnvRef.DFC_ComMETLRingCnt_C DFES_EnvRef.DFC_ComMETLTOut_C DFES_EnvRef.DFC_ComMETMChksum_C DFES_EnvRef.DFC_ComMETMRingCnt_C DFES_EnvRef.DFC_ComMETMTOut_C DFES_EnvRef.DFC_ComMETNChksum_C DFES_EnvRef.DFC_ComMETNRingCnt_C DFES_EnvRef.DFC_ComMETNTOut_C DFES_EnvRef.DFC_ComMtrCom_C DFES_EnvRef.DFC_ComPCUChkSum_C DFES_EnvRef.DFC_ComPCURingCnt_C DFES_EnvRef.DFC_ComPCUTOut_C DFES_EnvRef.DFC_ComSRSAChksum_C DFES_EnvRef.DFC_ComSRSARingCnt_C DFES_EnvRef.DFC_ComSRSATOut_C DFES_EnvRef.DFC_ComSRSBChksum_C DFES_EnvRef.DFC_ComSRSBRingCnt_C DFES_EnvRef.DFC_ComSRSBTOut_C DFES_EnvRef.DFC_ComSRSChksum_C DFES_EnvRef.DFC_ComSRSErr_C DFES_EnvRef.DFC_ComSRSRingCnt_C DFES_EnvRef.DFC_ComSRSTOut_C DFES_EnvRef.DFC_ComVehSpdPndFltTCU_C DFES_EnvRef.DFC_EbsChartcCurrErr_C DFES_EnvRef.DFC_EbsSelfDiagErr_C DFES_EnvRef.DFC_GEVlvPhaCsersIntkB1_C DFES_EnvRef.DFC_GEVlvPhaPsOpenLoadIntkB1_C DFES_EnvRef.DFC_GEVlvPhaPsShoToBattIntkB1_C DFES_EnvRef.DFC_GEVlvPhaPsShoToGndIntkB1_C DFES_EnvRef.DFC_GbxCANDigPlausErr_C DFES_EnvRef.DFC_GbxNPos1SRCMax_C DFES_EnvRef.DFC_GbxNPos1SRCMin_C DFES_EnvRef.DFC_GbxNPos2SRCMax_C DFES_EnvRef.DFC_GbxNPos2SRCMin_C DFES_EnvRef.DFC_GbxNPosAlvChk_C DFES_EnvRef.DFC_GbxNPosSyncErr_C DFES_EnvRef.DFC_HEGOS2B1HtrPsMax_C DFES_EnvRef.DFC_HEGOS2B1HtrPsMin_C DFES_EnvRef.DFC_HEGOS2B1HtrPsSig_C DFES_EnvRef.DFC_LinCSErrACG_C DFES_EnvRef.DFC_LinCSErrAEV_C DFES_EnvRef.DFC_LinCSErrDCDC_C DFES_EnvRef.DFC_LinCSErrEBS_C DFES_EnvRef.DFC_LinHdrTimeoutErrACG_C DFES_EnvRef.DFC_LinHdrTimeoutErrAEV_C DFES_EnvRef.DFC_LinHdrTimeoutErrDCDC_C DFES_EnvRef.DFC_LinHdrTimeoutErrEBS_C DFES_EnvRef.DFC_LinMsgTimeoutErrACG_C DFES_EnvRef.DFC_LinMsgTimeoutErrAEV_C DFES_EnvRef.DFC_LinMsgTimeoutErrDCDC_C DFES_EnvRef.DFC_LinMsgTimeoutErrEBS_C DFES_EnvRef.DFC_LinNoStrtComErr_C DFES_EnvRef.DFC_LowPresOilP_C DFES_EnvRef.DFC_MisfDetVWhlFrntLeOORHi_C DFES_EnvRef.DFC_MisfDetVWhlFrntLeRatyHi_C DFES_EnvRef.DFC_MisfDetVWhlFrntLeRatyLo_C DFES_EnvRef.DFC_MisfDetVWhlFrntLeStuck_C DFES_EnvRef.DFC_MisfDetVWhlFrntRiOORHi_C DFES_EnvRef.DFC_MisfDetVWhlFrntRiRatyHi_C DFES_EnvRef.DFC_MisfDetVWhlFrntRiRatyLo_C DFES_EnvRef.DFC_MisfDetVWhlFrntRiStuck_C DFES_EnvRef.DFC_MisfDetVWhlReLeOORHi_C DFES_EnvRef.DFC_MisfDetVWhlReLeRatyHi_C DFES_EnvRef.DFC_MisfDetVWhlReLeRatyLo_C DFES_EnvRef.DFC_MisfDetVWhlReLeStuck_C DFES_EnvRef.DFC_MisfDetVWhlReRiOORHi_C DFES_EnvRef.DFC_MisfDetVWhlReRiRatyHi_C DFES_EnvRef.DFC_MisfDetVWhlReRiRatyLo_C DFES_EnvRef.DFC_MisfDetVWhlReRiStuck_C DFES_EnvRef.DFC_MisfDetdVWhlFrntLePlaus_C DFES_EnvRef.DFC_MisfDetdVWhlFrntRiPlaus_C DFES_EnvRef.DFC_MisfDetdVWhlReLePlaus_C DFES_EnvRef.DFC_MisfDetdVWhlReRiPlaus_C DFES_EnvRef.DFC_PEnvSigRngMax_C DFES_EnvRef.DFC_PEnvSigRngMin_C DFES_EnvRef.DFC_StmFault_C DFES_EnvRef.DFC_StrtCtOffPth_C DFES_EnvRef.DFC_StrtCtlErr_C DFES_EnvRef.DFC_StrtFault_C DFES_EnvRef.DFC_StrtLckJudg1_C DFES_EnvRef.DFC_StrtLckJudg2_C DFES_EnvRef.DFC_StrtOL_C DFES_EnvRef.DFC_StrtOL2_C DFES_EnvRef.DFC_StrtSCB_C DFES_EnvRef.DFC_StrtSCB2_C DFES_EnvRef.DFC_StrtSCG_C DFES_EnvRef.DFC_StrtSCG2_C DFES_EnvRef.DFC_StrtStkRly1_C DFES_EnvRef.DFC_StrtStkRly2_C DFES_EnvRef.DFC_TEVEmax_C DFES_EnvRef.DFC_TEVEmin_C DFES_EnvRef.DFC_TEVEsig_C DFES_EnvRef.DFC_UegoHeatrPrfmncLoS1B1_C DFES_EnvRef.DFC_VehVAllPlaus_C DFES_EnvRef.DFC_VehVNCSnsrElecFailr_C DFES_EnvRef.DFC_VehVPlausCan_C DFES_EnvRef.DFC_VehVPlausFco_C DFES_EnvRef.DFC_VehVPlausPwr_C DFES_EnvRef.DFC_VehVPlausV2N_C DFES_EnvRef.DFC_VehVSpdSnsrAElecFailr_C DFES_EnvRef.DFC_VehVSpdSnsrBElecFailr_C DFES_EnvRef.DFC_ClthMax_C DFES_EnvRef.DFC_IgnClPs_DevComErr_C DFES_EnvRef.DFC_IgnClPs_LineOl_0_C DFES_EnvRef.DFC_IgnClPs_LineOl_1_C DFES_EnvRef.DFC_IgnClPs_LineOl_2_C DFES_EnvRef.DFC_IgnClPs_LineOl_3_C DFES_EnvRef.DFC_IgnClPs_LineScb_0_C DFES_EnvRef.DFC_IgnClPs_LineScb_1_C DFES_EnvRef.DFC_IgnClPs_LineScb_2_C DFES_EnvRef.DFC_IgnClPs_LineScb_3_C DFES_EnvRef.DFC_IgnClPs_LineScg_0_C DFES_EnvRef.DFC_IgnClPs_LineScg_1_C DFES_EnvRef.DFC_IgnClPs_LineScg_2_C DFES_EnvRef.DFC_IgnClPs_LineScg_3_C DFES_EnvRef.DFC_KRVEKOEVAB_C DFES_EnvRef.DFC_KRVEKOEVAB0_C DFES_EnvRef.DFC_KRVEKOEVAB1_C DFES_EnvRef.DFC_KRVEKOEVAB2_C DFES_EnvRef.DFC_KRVEKOEVAB3_C DFES_EnvRef.DFC_UegoSigEcuAsicS1B1_C DFES_EnvRef.DFC_UegoSigEcuComS1B1_C DFES_EnvRef.DFC_UegoSigSnsrS1B1_C DFES_EnvRef.DFC_UegoSigWireOlApesS1B1_C DFES_EnvRef.DFC_UegoSigWireOlIpeS1B1_C DFES_EnvRef.DFC_UegoSigWireOlReS1B1_C DFES_EnvRef.DFC_UegoSigWireRCmpS1B1_C DFES_EnvRef.DFC_UegoSigWireScbS1B1_C DFES_EnvRef.DFC_UegoSigWireScgS1B1_C DFES_EnvRef.DFC_AfsPhyRngHiB1_C DFES_EnvRef.DFC_AfsPhyRngLoB1_C DFES_EnvRef.DFC_AirCCmprOL_C DFES_EnvRef.DFC_AirCCmprOvrTemp_C DFES_EnvRef.DFC_AirCCmprSCB_C DFES_EnvRef.DFC_AirCCmprSCG_C DFES_EnvRef.DFC_AltErr_C DFES_EnvRef.DFC_BattUSRCMax_C DFES_EnvRef.DFC_BattUSRCMin_C DFES_EnvRef.DFC_ComChksTCU1_C DFES_EnvRef.DFC_ComChksTCU11_C DFES_EnvRef.DFC_ComChksTCU12_C DFES_EnvRef.DFC_ComChksTCU13_C DFES_EnvRef.DFC_ComChksTCU2_C DFES_EnvRef.DFC_ComChksTCU3_C DFES_EnvRef.DFC_ComChksTCU4_C DFES_EnvRef.DFC_ComCntTCU1_C DFES_EnvRef.DFC_ComCntTCU11_C DFES_EnvRef.DFC_ComCntTCU12_C DFES_EnvRef.DFC_ComCntTCU13_C DFES_EnvRef.DFC_ComCntTCU2_C DFES_EnvRef.DFC_ComCntTCU3_C DFES_EnvRef.DFC_ComCntTCU4_C DFES_EnvRef.DFC_ComTOutTCU01_C DFES_EnvRef.DFC_ComTOutTCU02_C DFES_EnvRef.DFC_ComTOutTCU1_C DFES_EnvRef.DFC_ComTOutTCU11_C DFES_EnvRef.DFC_ComTOutTCU12_C DFES_EnvRef.DFC_ComTOutTCU13_C DFES_EnvRef.DFC_ComTOutTCU14_C DFES_EnvRef.DFC_ComTOutTCU2_C DFES_EnvRef.DFC_ComTOutTCU3_C DFES_EnvRef.DFC_ComTOutTCU4_C DFES_EnvRef.DFC_DevLibBattUHi_C DFES_EnvRef.DFC_DevLibBattULo_C DFES_EnvRef.DFC_EGRVlvFailSafeActv_C DFES_EnvRef.DFC_EGRVlvGovDvtCld_C DFES_EnvRef.DFC_EGRVlvPhysSRCMax_C DFES_EnvRef.DFC_EGRVlvPhysSRCMin_C DFES_EnvRef.DFC_FanDIOOL_0_C DFES_EnvRef.DFC_FanDIOOL_1_C DFES_EnvRef.DFC_FanDIOOvrTemp_0_C DFES_EnvRef.DFC_FanDIOOvrTemp_1_C DFES_EnvRef.DFC_FanDIOSCB_0_C DFES_EnvRef.DFC_FanDIOSCB_1_C DFES_EnvRef.DFC_FanDIOSCG_0_C DFES_EnvRef.DFC_FanDIOSCG_1_C DFES_EnvRef.DFC_MRlyDcOL_C DFES_EnvRef.DFC_MRlyDcSCB_C DFES_EnvRef.DFC_MRlyDcSCG_C DFES_EnvRef.DFC_PSPOL_C DFES_EnvRef.DFC_PSPOvrTemp_C DFES_EnvRef.DFC_PSPSCB_C DFES_EnvRef.DFC_PSPSCG_C DFES_EnvRef.DFC_T50Err_C DFES_EnvRef.DFC_ThrVlvLoBattB1_C DFES_EnvRef.DFC_UegoSigOperPlausS1B1_C DFES_EnvRef.DFC_VehVPhysRngHi_C DFES_EnvRef.DFC_VehVSclOutOL_C DFES_EnvRef.DFC_VehVSclOutOT_C DFES_EnvRef.DFC_VehVSclOutSCB_C DFES_EnvRef.DFC_VehVSclOutSCG_C DFES_EnvRef.DFC_VehVSigFL_C DFES_EnvRef.DFC_VehVSigFR_C DFES_EnvRef.DFC_VehVSigRL_C DFES_EnvRef.DFC_VehVSigRR_C DFES_EnvRef.DFC_VehVSnsrARngHi_C DFES_EnvRef.DFC_VehVSnsrBRngHi_C DFES_EnvRef.DFC_VehVSpdRtyDiag_C DFES_EnvRef.DFC_DHFHD_C DFES_EnvRef.DFC_InjVlv_DI_DcDc_C DFES_EnvRef.DFC_InjVlv_DI_NoLd_0_C DFES_EnvRef.DFC_InjVlv_DI_NoLd_1_C DFES_EnvRef.DFC_InjVlv_DI_NoLd_2_C DFES_EnvRef.DFC_InjVlv_DI_NoLd_3_C DFES_EnvRef.DFC_InjVlv_DI_ScBnk_0_C DFES_EnvRef.DFC_InjVlv_DI_ScBnk_1_C DFES_EnvRef.DFC_InjVlv_DI_ScBnk_2_C DFES_EnvRef.DFC_InjVlv_DI_ScBnk_3_C DFES_EnvRef.DFC_InjVlv_DI_ScCyl_0_C DFES_EnvRef.DFC_InjVlv_DI_ScCyl_1_C DFES_EnvRef.DFC_InjVlv_DI_ScCyl_2_C DFES_EnvRef.DFC_InjVlv_DI_ScCyl_3_C DFES_EnvRef.DFC_InjVlv_DI_ScHsLs_0_C DFES_EnvRef.DFC_InjVlv_DI_ScHsLs_1_C DFES_EnvRef.DFC_InjVlv_DI_ScHsLs_2_C DFES_EnvRef.DFC_InjVlv_DI_ScHsLs_3_C DFES_EnvRef.DFC_MfPsDiaOpenLoad1_C DFES_EnvRef.DFC_MfPsDiaScHiS1_C DFES_EnvRef.DFC_MfPsDiaScHiSLowS1_C DFES_EnvRef.DFC_MfPsDiaScLowS1_C DFES_EnvRef.DFC_ACEvpTPhysRngHi_C DFES_EnvRef.DFC_ACEvpTPhysRngLo_C DFES_EnvRef.DFC_ACEvpTSRCMax_C DFES_EnvRef.DFC_ACEvpTSRCMin_C DFES_EnvRef.DFC_AfsRawSigRngHiB1_C DFES_EnvRef.DFC_AfsRawSigRngLoB1_C DFES_EnvRef.DFC_AfsSnsrErrB1_C DFES_EnvRef.DFC_AirCClntPAnaSRCMax_C DFES_EnvRef.DFC_AirCClntPAnaSRCMin_C DFES_EnvRef.DFC_AirCSwtNpl_C DFES_EnvRef.DFC_AirCSwtSig_C DFES_EnvRef.DFC_Brk_C DFES_EnvRef.DFC_BrkBstSensSCB_C DFES_EnvRef.DFC_BrkBstSensSCG_C DFES_EnvRef.DFC_BrkSig_C DFES_EnvRef.DFC_ClthSig_C DFES_EnvRef.DFC_EGRVlvCurrLim_C DFES_EnvRef.DFC_EGRVlvOL_C DFES_EnvRef.DFC_EGRVlvOvrTemp_C DFES_EnvRef.DFC_EGRVlvSCB_C DFES_EnvRef.DFC_EGRVlvSCG_C DFES_EnvRef.DFC_EGRVlvSRCMax_C DFES_EnvRef.DFC_EGRVlvSRCMin_C DFES_EnvRef.DFC_HLSDemOvhtEngLim_C DFES_EnvRef.DFC_OilPSwmpSRCMax_C DFES_EnvRef.DFC_OilPSwmpSRCMin_C DFES_EnvRef.DFC_PIntkVUsLineHiB1_C DFES_EnvRef.DFC_PIntkVUsLineLoB1_C DFES_EnvRef.DFC_VehVPhysRngLo_C DFES_EnvRef.DFC_VehVSigCan_C DFES_EnvRef.DFC_VehVSigCanSafe_C DFES_EnvRef.DFC_VlvLftFbOilPSnsrIntk11SRCMax_C DFES_EnvRef.DFC_VlvLftFbOilPSnsrIntk11SRCMin_C DFES_EnvRef.DFC_ClthNpl_C DFES_EnvRef.DFC_GbxPNPosnDrvCdn_C DFES_EnvRef.DFC_GbxPNPosnPlausy_C DFES_EnvRef.DFC_AfsSigErrLineHiB1_C DFES_EnvRef.DFC_AfsSigErrLineLoB1_C DFES_EnvRef.DFC_PEnvCcMax_C DFES_EnvRef.DFC_PEnvCcMin_C DFES_EnvRef.DFC_PEnvRngChkMax_C DFES_EnvRef.DFC_PEnvRngChkMin_C DFES_EnvRef.DFC_PEnvSnsrPlaus_C DFES_EnvRef.DFC_UEGOHeatrRlyPsOLS1B1_C DFES_EnvRef.DFC_UEGOHeatrRlyPsSCBS1B1_C DFES_EnvRef.DFC_UEGOHeatrRlyPsSCGS1B1_C DFES_EnvRef.DFC_UegoHeatrWireOlS1B1_C DFES_EnvRef.DFC_UegoHeatrWireScbS1B1_C DFES_EnvRef.DFC_UegoHeatrWireScgS1B1_C DFES_EnvRef.DFC_KnDetSens1PortAMax_C DFES_EnvRef.DFC_KnDetSens1PortAMin_C DFES_EnvRef.DFC_KnDetSens1PortBMax_C DFES_EnvRef.DFC_KnDetSens1PortBMin_C DFES_EnvRef.DFC_Clth2ONStuck_C DFES_EnvRef.DFC_Clth2ONStuckLdc_C DFES_EnvRef.DFC_Clth3ONStuckLdc_C DFES_EnvRef.DFC_Clth3ONStuckPostDrv_C DFES_EnvRef.DFC_Clth4ONStuck_C DFES_EnvRef.DFC_Clth4ONStuckLdc_C DFES_EnvRef.DFC_ComBCMUnit_C DFES_EnvRef.DFC_ComDLCTCU01_C DFES_EnvRef.DFC_ComDLCTCU02_C DFES_EnvRef.DFC_ComDLCTCU1_C DFES_EnvRef.DFC_ComDLCTCU11_C DFES_EnvRef.DFC_ComDLCTCU12_C DFES_EnvRef.DFC_ComDLCTCU13_C DFES_EnvRef.DFC_ComDLCTCU14_C DFES_EnvRef.DFC_ComDLCTCU2_C DFES_EnvRef.DFC_ComDLCTCU3_C DFES_EnvRef.DFC_ComDLCTCU4_C DFES_EnvRef.DFC_ComEPSUnit_C DFES_EnvRef.DFC_ComIDASBUnit_C DFES_EnvRef.DFC_ComIMGUnit_C DFES_EnvRef.DFC_ComMETUnit_C DFES_EnvRef.DFC_ComSRSUnit_C DFES_EnvRef.DFC_ComVSAUnit_C DFES_EnvRef.DFC_EbsSocFlt_C DFES_EnvRef.DFC_I14229VINErr_C DFES_EnvRef.DFC_InjCatHeatgErr_C DFES_EnvRef.DFC_InjSysMulInjDiagErr_C DFES_EnvRef.DFC_LLRHmax_C DFES_EnvRef.DFC_LLRHmin_C DFES_EnvRef.DFC_LLRHnpl_C DFES_EnvRef.DFC_LLRKHmax_C DFES_EnvRef.DFC_LLRKHmin_C DFES_EnvRef.DFC_LLRKHnpl_C DFES_EnvRef.DFC_LinACGUnit_C DFES_EnvRef.DFC_LinAEVUnit_C DFES_EnvRef.DFC_LinEBSUnit_C DFES_EnvRef.DFC_RoughRoad_C DFES_EnvRef.DFC_SiaEEPRdErr_C DFES_EnvRef.DFC_SiaEEPWrngCod_C DFES_EnvRef.DFC_UegoHeatrStrtS1B1_C DFES_EnvRef.DFC_BusDiagCANAPPLBusOff_C DFES_EnvRef.DFC_BusDiagCANCANCBusOff_C DFES_EnvRef.DFC_BusDiagCANVEHICLEBusOff_C DFES_EnvRef.DFC_RBA_IODIAGPWR_rba_IoExtCy329_SignalVltSply_0_C DFES_EnvRef.DFC_RBA_IODIAGPWR_rba_IoExtCy329_SignalVltSply_0OT_C DFES_EnvRef.DFC_RBA_IODIAGPWR_rba_IoExtCy329_SignalVltSply_0OV_C DFES_EnvRef.DFC_RBA_IODIAGPWR_rba_IoExtCy329_SignalVltSply_0SCG_C DFES_EnvRef.DFC_RBA_IODIAGPWR_rba_IoExtCy329_SignalVltSply_0UV_C DFES_EnvRef.DFC_RBA_IODIAGPWR_rba_IoExtCy329_SignalVltSply_1_C DFES_EnvRef.DFC_RBA_IODIAGPWR_rba_IoExtCy329_SignalVltSply_1OT_C DFES_EnvRef.DFC_RBA_IODIAGPWR_rba_IoExtCy329_SignalVltSply_1OV_C /end DEF_CHARACTERISTIC
 FUNCTION_VERSION "30000.73.0_2.0.0" /end FUNCTION
/begin COMPU_METHOD DFES_EnvTabVerb "" TAB_VERB "%6.3" "-" COMPU_TAB_REF DFES_EnvTabVerb /end COMPU_METHOD
/begin COMPU_VTAB DFES_EnvTabVerb "" TAB_VERB 2 0 "xSet1" 1 "xSet2" DEFAULT_VALUE "---" /end COMPU_VTAB
/begin COMPU_METHOD Signals_IntSigNumVerb "" TAB_VERB "%6.3" "" COMPU_TAB_REF Signals_IntSigNumVerb /end COMPU_METHOD
/begin COMPU_VTAB Signals_IntSigNumVerb "" TAB_VERB 1169 0 "SIGNALS_Signals_Default" 1 "SIGNALS_APP_rUnFlt" 2 "SIGNALS_APP_r_sig" 3 "SIGNALS_APP_r_signal" 4 "SIGNALS_APP_uRaw1_signal" 5 "SIGNALS_APP_uRaw2_signal" 6 "SIGNALS_AbsLdCom8Bit_PID43h" 7 "SIGNALS_AccPed_tqMapBasd_BENG_signal" 8 "SIGNALS_AccPed_tqMapBasd_TRQB_signal" 9 "SIGNALS_ActMod_trqInr_signal" 10 "SIGNALS_AirC_uAnaRawClnt_signal" 11 "SIGNALS_Alt_iExctLim_signal" 12 "SIGNALS_Alt_rAltExct_signal" 13 "SIGNALS_Alt_uFinalDes_signal" 14 "SIGNALS_BattU_u" 15 "SIGNALS_BattU_uSens1_signal" 16 "SIGNALS_BattU_uSens2_s" 17 "SIGNALS_BattU_uSens_signal" 18 "SIGNALS_Batt_lMaxCnsChk_signal" 19 "SIGNALS_Batt_lMinCnsChk_signal" 20 "SIGNALS_Batt_qCnsChkAH_signal" 21 "SIGNALS_Brk_st" 22 "SIGNALS_Brk_stRed" 23 "SIGNALS_CEngDsT_uRaw_s" 24 "SIGNALS_CEngDsT_uRaw_signal" 25 "SIGNALS_CEngUsT_t_signal" 26 "SIGNALS_CEngUsT_uSnsr_s" 27 "SIGNALS_CoEng_tiCranking_signal" 28 "SIGNALS_CoVeh_trqAcs_s" 29 "SIGNALS_ComEBS_BattID_signal" 30 "SIGNALS_ComEBS_rBattSensCh_signal" 31 "SIGNALS_ComEBS_rBattStrat_signal" 32 "SIGNALS_ComEBS_uBattSens_signal" 33 "SIGNALS_ComEBS_uBattUCO_signal" 34 "SIGNALS_Com_iBattEBS_signal" 35 "SIGNALS_Com_lDst_signal" 36 "SIGNALS_Com_rMeasdBattREbs_signal" 37 "SIGNALS_Com_stI_signal" 38 "SIGNALS_Com_stT_signal" 39 "SIGNALS_Com_stU_signal" 40 "SIGNALS_Com_tBattEBS_signal" 41 "SIGNALS_Com_trqAYCFDes_signal" 42 "SIGNALS_Com_uPeak_signal" 43 "SIGNALS_CrCtl_stShutOffCode0_signal" 44 "SIGNALS_CrCtl_stShutOffCode1_signal" 45 "SIGNALS_CrCtl_stShutOffCode2_signal" 46 "SIGNALS_CrCtl_stShutOffCode3_signal" 47 "SIGNALS_CrCtl_stShutOffCode4_signal" 48 "SIGNALS_CrCtl_stShutOffCode5_signal" 49 "SIGNALS_CrCtl_stShutOffCode6_signal" 50 "SIGNALS_CrCtl_stShutOffCode7_signal" 51 "SIGNALS_CrCtl_stShutOffCode8_signal" 52 "SIGNALS_CrCtl_stShutOffCode9_signal" 53 "SIGNALS_DIUMPR_ctGenDenom_signal" 54 "SIGNALS_DIUMPR_ctIgn_signal" 55 "SIGNALS_DRIVE_numDTCFrz_s" 56 "SIGNALS_DRIVE_stCurTrgMode_signal" 57 "SIGNALS_DRIVE_stHardToStrt_s" 58 "SIGNALS_DSM_tiMICumCont" 59 "SIGNALS_DcmDspUDS_rdbi_2612Byte10_signal" 60 "SIGNALS_DcmDspUDS_rdbi_2612Byte11_signal" 61 "SIGNALS_DcmDspUDS_rdbi_fixed_signal" 62 "SIGNALS_DcmDspUDS_rdbi_reserved0_signal_s" 63 "SIGNALS_DcmDspUDS_rdbi_reserved0_signal_w_s" 64 "SIGNALS_DcmDspUDS_rdbi_reserved1_signal" 65 "SIGNALS_Dspl_stCrsSwtInfo_signal" 66 "SIGNALS_Ebs_qBliChrg_signal" 67 "SIGNALS_Ebs_qBliDchaTotDcyc_0_signal" 68 "SIGNALS_Ebs_qBliDchaTotDcyc_1_signal" 69 "SIGNALS_Ebs_qBliDchaTotDcyc_2_signal" 70 "SIGNALS_Ebs_qBliDchaTotDcyc_3_signal" 71 "SIGNALS_Ebs_qBliDchaTotDcyc_4_signal" 72 "SIGNALS_Ebs_qBliDcha_signal" 73 "SIGNALS_Ebs_stStbIEBSByt0_0_signal" 74 "SIGNALS_Ebs_stStbIEBSByt0_1_signal" 75 "SIGNALS_Ebs_stStbIEBSByt0_2_signal" 76 "SIGNALS_Ebs_stStbIEBSByt0_3_signal" 77 "SIGNALS_Ebs_stStbIEBSByt0_4_signal" 78 "SIGNALS_Ebs_stStbIEBSByt1_0_signal" 79 "SIGNALS_Ebs_stStbIEBSByt1_1_signal" 80 "SIGNALS_Ebs_stStbIEBSByt1_2_signal" 81 "SIGNALS_Ebs_stStbIEBSByt1_3_signal" 82 "SIGNALS_Ebs_stStbIEBSByt1_4_signal" 83 "SIGNALS_Ebs_stStbIEBSByt2_0_signal" 84 "SIGNALS_Ebs_stStbIEBSByt2_1_signal" 85 "SIGNALS_Ebs_stStbIEBSByt2_2_signal" 86 "SIGNALS_Ebs_stStbIEBSByt2_3_signal" 87 "SIGNALS_Ebs_stStbIEBSByt2_4_signal" 88 "SIGNALS_Ebs_stStbIEBSByt3_0_signal" 89 "SIGNALS_Ebs_stStbIEBSByt3_1_signal" 90 "SIGNALS_Ebs_stStbIEBSByt3_2_signal" 91 "SIGNALS_Ebs_stStbIEBSByt3_3_signal" 92 "SIGNALS_Ebs_stStbIEBSByt3_4_signal" 93 "SIGNALS_Ebs_stStbIEBSByt4_0_signal" 94 "SIGNALS_Ebs_stStbIEBSByt4_1_signal" 95 "SIGNALS_Ebs_stStbIEBSByt4_2_signal" 96 "SIGNALS_Ebs_stStbIEBSByt4_3_signal" 97 "SIGNALS_Ebs_stStbIEBSByt4_4_signal" 98 "SIGNALS_EngTrqPtd_trqLead_s" 99 "SIGNALS_EngTrqPtd_trqLead_signal" 100 "SIGNALS_EngTrqPtd_trqSet_s" 101 "SIGNALS_EngTrqPtd_trqSet_signal" 102 "SIGNALS_EpmCaS_ctErrSig_signal" 103 "SIGNALS_EpmCaS_ctNoSig_signal" 104 "SIGNALS_EpmCaS_phiDiffCal2AdapEqAvg_0" 105 "SIGNALS_EpmCaS_phiOfsCorr" 106 "SIGNALS_Epm_nEngAct" 107 "SIGNALS_Epm_nEngRaw_s" 108 "SIGNALS_Epm_nEngRaw_signal" 109 "SIGNALS_Epm_stOpMode" 110 "SIGNALS_Epm_stSync" 111 "SIGNALS_FuPHi_uHiResl_signal" 112 "SIGNALS_GEVlv_ratPhaIntkB1_signal" 113 "SIGNALS_GlbDa_lenTotDstDcycHiResl_signal" 114 "SIGNALS_HEGO_uS2B1Extd_s" 115 "SIGNALS_HEGO_uS2B1HiRes_signal" 116 "SIGNALS_I14229CoEng_tiNormalOBDPrevDcyc_s" 117 "SIGNALS_I14229EpmCaS_ctErrSig1_signal" 118 "SIGNALS_I14229EpmCaS_ctNoSig1_signal" 119 "SIGNALS_I14229GlbDa_lTotDstDCHiReslPrevDcyc_s" 120 "SIGNALS_I14229IntkAirT_tSnsrTstrMax_s" 121 "SIGNALS_I14229IntkAirT_tSnsrTstrMin_s" 122 "SIGNALS_I14229RDBI_nOvrSpd_signal" 123 "SIGNALS_I14229RDBI_tiOvrSpd_signal" 124 "SIGNALS_I14229_AirC_pAnaClnt_signal" 125 "SIGNALS_I14229_ElecLd_iEPSLoadOnly_signal" 126 "SIGNALS_I14229_EpmCaS_ctErrSig2_signal" 127 "SIGNALS_I14229_EpmCaS_ctNoSig2_signal" 128 "SIGNALS_I14229_EpmCrS_ctCaSRev_signal" 129 "SIGNALS_I14229_EpmCrS_ctErrSig_signal" 130 "SIGNALS_I14229_GEVCtl_agMaxAdpdIntk_signal" 131 "SIGNALS_I14229_Gbx_uAna1NPosRaw_signal" 132 "SIGNALS_I14229_Gbx_uAna2NPosRaw_signal" 133 "SIGNALS_I14229_ivzabg_w_signal" 134 "SIGNALS_I14229_lDst_signal" 135 "SIGNALS_I14229_nstat_signal" 136 "SIGNALS_I14229_numDTCFrzFrmHi_signal" 137 "SIGNALS_I14229_numDTCFrzFrmLo_signal" 138 "SIGNALS_I14229_numDTCFrzFrmMid_signal" 139 "SIGNALS_I14229_ps_w_signal" 140 "SIGNALS_I14229_rTrqPT_signal" 141 "SIGNALS_I14229_stTURBODV_signal" 142 "SIGNALS_I14229_tSnsrFild1_signal" 143 "SIGNALS_I14229_tiInj1On_signal" 144 "SIGNALS_I14229_tiOilFlowCompl_signal" 145 "SIGNALS_I14229_tiSia_signal" 146 "SIGNALS_I14229_tkaMax_s" 147 "SIGNALS_I14229_tkaMin_s" 148 "SIGNALS_I14229_tka_signal" 149 "SIGNALS_I14229_tmotMaxCurrDcyc_s" 150 "SIGNALS_I14229_tmotMaxPrevDcyc_s" 151 "SIGNALS_I14229_tmotMinCurrDcyc_s" 152 "SIGNALS_I14229_tmotMinPrevDcyc_s" 153 "SIGNALS_I14229_ubsq_signal" 154 "SIGNALS_I14229_umsrln_w_signal" 155 "SIGNALS_I14229_wdks_w_signal" 156 "SIGNALS_I14229_wped1_signal" 157 "SIGNALS_I14229_wped2_signal" 158 "SIGNALS_I14229_zwist_signal" 159 "SIGNALS_I14229iocpMDA_numABV_signal" 160 "SIGNALS_I14229iocpMDA_numACGC_signal" 161 "SIGNALS_I14229iocpMDA_numAPS_signal" 162 "SIGNALS_I14229iocpMDA_numPSC_signal" 163 "SIGNALS_I14229iocpMDA_numRFAN_signal" 164 "SIGNALS_I14229iocpMDA_numRvsLck_signal" 165 "SIGNALS_I14229iocpMDA_numVTEC_signal" 166 "SIGNALS_I14229iocp_numCtlSt_s" 167 "SIGNALS_I14229iocp_numEXE_signal" 168 "SIGNALS_I14229iocp_numREQ_s" 169 "SIGNALS_I14229iocp_stSFTRJC_s" 170 "SIGNALS_I15031_PID1Dh" 171 "SIGNALS_I15031_PID65Ah" 172 "SIGNALS_I15031_PID66Ah" 173 "SIGNALS_I15031_PID69Ah" 174 "SIGNALS_I15031_PID6AAh" 175 "SIGNALS_I15031_PID6BAh" 176 "SIGNALS_I15031_PID6CAh" 177 "SIGNALS_I15031_PID6DAh" 178 "SIGNALS_I15031_PID6EAh" 179 "SIGNALS_I15031_PID6FAh" 180 "SIGNALS_I15031_PID70Ah" 181 "SIGNALS_I15031_PID71Ah" 182 "SIGNALS_I15031_PID72Ah" 183 "SIGNALS_I15031_PID73Ah" 184 "SIGNALS_I15031_PID74Ah" 185 "SIGNALS_I15031_PID75Ah" 186 "SIGNALS_I15031_PID76Ah" 187 "SIGNALS_I15031_PID77Ah" 188 "SIGNALS_I15031_PID78Ah" 189 "SIGNALS_I15031_PID79Ah" 190 "SIGNALS_I15031_PID7AAh" 191 "SIGNALS_I15031_PID7BAh" 192 "SIGNALS_I15031_PID7CAh" 193 "SIGNALS_I15031_PID7FAh" 194 "SIGNALS_I15031_PID81Ah" 195 "SIGNALS_I15031_PID82Ah" 196 "SIGNALS_I15031_PID85Ah" 197 "SIGNALS_I15031_PID86Ah" 198 "SIGNALS_I15031_PID87Ah" 199 "SIGNALS_I15031_PID89Ah" 200 "SIGNALS_I15031_PID8AAh" 201 "SIGNALS_I15031_PID8FAh" 202 "SIGNALS_I15031_PID92Ah" 203 "SIGNALS_I15031_PID93Ah" 204 "SIGNALS_I15031_PID94Ah" 205 "SIGNALS_I15031_PID98Ah" 206 "SIGNALS_I15031_PID99Ah" 207 "SIGNALS_I15031_PID9CAh" 208 "SIGNALS_I15031_PIDA3Ah" 209 "SIGNALS_I15031_PIDA4Ah" 210 "SIGNALS_I15031_PIDA5Ah" 211 "SIGNALS_I15031_PIDA9Ah" 212 "SIGNALS_I15031_PIDACAh" 213 "SIGNALS_IKCtl_agKnkAvrg_s8_signal" 214 "SIGNALS_InjSys_volFuConsDrvCycCAN_s" 215 "SIGNALS_IntkAirT_tSnsr2_signal" 216 "SIGNALS_IntkAirT_uSnsr1Exprt_signal" 217 "SIGNALS_IntkAirT_uSnsr3CrssSwtLoc_s" 218 "SIGNALS_MoF_rTrqInrAct_s" 219 "SIGNALS_MoF_rTrqPtdFlt_s" 220 "SIGNALS_OBD_ITID_InjSys_volFuConsDrvgCycTstrSrv" 221 "SIGNALS_OilSwmpT_uSnsrRaw_s" 222 "SIGNALS_Oil_pSensPSwmp_signal" 223 "SIGNALS_Oil_uRawPSwmp_signal" 224 "SIGNALS_PID01h" 225 "SIGNALS_PID03h_0" 226 "SIGNALS_PID03h_1" 227 "SIGNALS_PID04h" 228 "SIGNALS_PID05h" 229 "SIGNALS_PID06h_0" 230 "SIGNALS_PID07h_0" 231 "SIGNALS_PID0Ch_Epm_nEng" 232 "SIGNALS_PID0D_VehV_vSens" 233 "SIGNALS_PID0Eh" 234 "SIGNALS_PID0Fh" 235 "SIGNALS_PID0bh_PIntkVUs_pRawObd" 236 "SIGNALS_PID10h" 237 "SIGNALS_PID11h_ThrVlv_ratActSens1AbsltB1_u8" 238 "SIGNALS_PID13h" 239 "SIGNALS_PID15h_0" 240 "SIGNALS_PID15h_1" 241 "SIGNALS_PID1Ch" 242 "SIGNALS_PID1Fh_TiScneEngStrt" 243 "SIGNALS_PID21h" 244 "SIGNALS_PID23h" 245 "SIGNALS_PID2Ch_EGRVlv_rCmdNrm" 246 "SIGNALS_PID2Dh_EGRVlv_rGovDvtNrm" 247 "SIGNALS_PID2Eh" 248 "SIGNALS_PID2Fh" 249 "SIGNALS_PID30h" 250 "SIGNALS_PID31h" 251 "SIGNALS_PID33h_PEnv_pRaw" 252 "SIGNALS_PID34h_0" 253 "SIGNALS_PID34h_1" 254 "SIGNALS_PID3Ch" 255 "SIGNALS_PID41h" 256 "SIGNALS_PID42_BattU_uSens" 257 "SIGNALS_PID43h" 258 "SIGNALS_PID44h" 259 "SIGNALS_PID45h_ThrVlv_ratActSens1RelB1_u8" 260 "SIGNALS_PID46h" 261 "SIGNALS_PID47h_ThrVlv_ratActSens2AbsltB1_u8" 262 "SIGNALS_PID49_APP_uRaw1unLim" 263 "SIGNALS_PID4A_APP_uRaw2unLim" 264 "SIGNALS_PID4Ch_wdks_msg" 265 "SIGNALS_PID4FAh" 266 "SIGNALS_PID4FBh" 267 "SIGNALS_PID4FCh" 268 "SIGNALS_PID4FDh" 269 "SIGNALS_PID50Ah" 270 "SIGNALS_PID50Bh" 271 "SIGNALS_PID50Ch" 272 "SIGNALS_PID50Dh" 273 "SIGNALS_PID51h_PID51_stFuTyp" 274 "SIGNALS_PID52h" 275 "SIGNALS_PID56h_0" 276 "SIGNALS_PID5A_APP_rOBDPID5A" 277 "SIGNALS_PID5Eh_InjSys_volEngFuCnsPerHr" 278 "SIGNALS_PID5Fh" 279 "SIGNALS_PID62h_TME_ratActEngPercTqPrmIdH62" 280 "SIGNALS_IntFloat_PID63h_TqEngRef" 281 "SIGNALS_PID67h_ects2sva_msg" 282 "SIGNALS_PID67h_ects2svb_msg" 283 "SIGNALS_PID67h_ects2svc_msg" 284 "SIGNALS_PID68h_iats2sva" 285 "SIGNALS_PID68h_iats2svb" 286 "SIGNALS_PID68h_iats2svc" 287 "SIGNALS_PID68h_iats2svd" 288 "SIGNALS_PID68h_iats2sve" 289 "SIGNALS_PID68h_iats2svf" 290 "SIGNALS_PID68h_iats2svg" 291 "SIGNALS_PID69h_EGRVlv_rActNrm" 292 "SIGNALS_PID69h_EGRVlv_rCmdNrm" 293 "SIGNALS_PID69h_EGRVlv_rGovDvtNrm" 294 "SIGNALS_PID7Fh_RTId_TotRt" 295 "SIGNALS_PID7Fh_RtId_TotIdleRt" 296 "SIGNALS_PID7Fh_RtId_TotPtoRt" 297 "SIGNALS_PID87h_PIntkVUs_pRawObd" 298 "SIGNALS_PID8BAh" 299 "SIGNALS_PID8CAh" 300 "SIGNALS_PID8Eh_TME_ratEngFricPercTqPrmIdH8E" 301 "SIGNALS_PID93BCh" 302 "SIGNALS_PID9AAh" 303 "SIGNALS_PID9Dh_InjSys_mfEngFuRate" 304 "SIGNALS_PID9Dh_InjSys_mfVehFuRate" 305 "SIGNALS_PID9FAh" 306 "SIGNALS_PIDA6h_lTotDst" 307 "SIGNALS_PID_FILLSIG_1BIT" 308 "SIGNALS_PID_FILLSIG_1BITNZ" 309 "SIGNALS_PID_FILLSIG_1BYTE" 310 "SIGNALS_PID_FILLSIG_1BYTENZ" 311 "SIGNALS_PID_FILLSIG_2BIT" 312 "SIGNALS_PID_FILLSIG_2BITNZ" 313 "SIGNALS_PID_FILLSIG_2BYTE" 314 "SIGNALS_PID_FILLSIG_2BYTENZ" 315 "SIGNALS_PID_FILLSIG_3BIT" 316 "SIGNALS_PID_FILLSIG_3BITNZ" 317 "SIGNALS_PID_FILLSIG_4BIT" 318 "SIGNALS_PID_FILLSIG_4BITNZ" 319 "SIGNALS_PID_FILLSIG_4BYTE" 320 "SIGNALS_PID_FILLSIG_4BYTENZ" 321 "SIGNALS_PID_FILLSIG_5BIT" 322 "SIGNALS_PID_FILLSIG_5BITNZ" 323 "SIGNALS_PID_FILLSIG_6BIT" 324 "SIGNALS_PID_FILLSIG_6BITNZ" 325 "SIGNALS_PID_FILLSIG_7BIT" 326 "SIGNALS_PID_FILLSIG_7BITNZ" 327 "SIGNALS_PIntkVUs_uRawUnFlt_signal" 328 "SIGNALS_PT_rGrip_signal" 329 "SIGNALS_PT_trqLos_signal" 330 "SIGNALS_PThrVlvUs_uRawB1_signal" 331 "SIGNALS_PthLead_trqInrNoMon_s" 332 "SIGNALS_PthLead_trqInrNoMon_signal" 333 "SIGNALS_PthSet_trqInrIABef_s" 334 "SIGNALS_PthSet_trqInrLtd_s" 335 "SIGNALS_RngMod_trqDiffAdap_signal" 336 "SIGNALS_RngMod_trqDiffAdap_signal_s" 337 "SIGNALS_RngMod_trqInrBs_s" 338 "SIGNALS_SIGNAL_GEVlv_agSumSpCsersDeIntkB1" 339 "SIGNALS_Strt_uStrtMonDia_signal" 340 "SIGNALS_TWCD_numMeasB1_s" 341 "SIGNALS_TWCD_rOSCAvrgPriB1_s" 342 "SIGNALS_TWCD_rOSCAvrgPriB1_signal" 343 "SIGNALS_ThrVlv_uRawSens1B1_signal" 344 "SIGNALS_ThrVlv_uRawSens2B1_signal" 345 "SIGNALS_TiEngOff_ti_s" 346 "SIGNALS_VehStc_lDstCityEco_signal" 347 "SIGNALS_VehStc_lDstCity_signal" 348 "SIGNALS_VehStc_lDstHighWayEco_signal" 349 "SIGNALS_VehStc_lDstHighWay_signal" 350 "SIGNALS_VehStc_numFuDiagRecA_0_s" 351 "SIGNALS_VehStc_numFuDiagRecA_10_s" 352 "SIGNALS_VehStc_numFuDiagRecA_11_s" 353 "SIGNALS_VehStc_numFuDiagRecA_12_s" 354 "SIGNALS_VehStc_numFuDiagRecA_13_s" 355 "SIGNALS_VehStc_numFuDiagRecA_14_s" 356 "SIGNALS_VehStc_numFuDiagRecA_15_s" 357 "SIGNALS_VehStc_numFuDiagRecA_16_s" 358 "SIGNALS_VehStc_numFuDiagRecA_17_s" 359 "SIGNALS_VehStc_numFuDiagRecA_18_s" 360 "SIGNALS_VehStc_numFuDiagRecA_19_s" 361 "SIGNALS_VehStc_numFuDiagRecA_1_s" 362 "SIGNALS_VehStc_numFuDiagRecA_20_s" 363 "SIGNALS_VehStc_numFuDiagRecA_2_s" 364 "SIGNALS_VehStc_numFuDiagRecA_3_s" 365 "SIGNALS_VehStc_numFuDiagRecA_4_s" 366 "SIGNALS_VehStc_numFuDiagRecA_5_s" 367 "SIGNALS_VehStc_numFuDiagRecA_6_s" 368 "SIGNALS_VehStc_numFuDiagRecA_7_s" 369 "SIGNALS_VehStc_numFuDiagRecA_8_s" 370 "SIGNALS_VehStc_numFuDiagRecA_9_s" 371 "SIGNALS_VehStc_numMisfDetnHiEctA_0_s" 372 "SIGNALS_VehStc_numMisfDetnHiEctA_10_s" 373 "SIGNALS_VehStc_numMisfDetnHiEctA_11_s" 374 "SIGNALS_VehStc_numMisfDetnHiEctA_12_s" 375 "SIGNALS_VehStc_numMisfDetnHiEctA_13_s" 376 "SIGNALS_VehStc_numMisfDetnHiEctA_14_s" 377 "SIGNALS_VehStc_numMisfDetnHiEctA_15_s" 378 "SIGNALS_VehStc_numMisfDetnHiEctA_16_s" 379 "SIGNALS_VehStc_numMisfDetnHiEctA_17_s" 380 "SIGNALS_VehStc_numMisfDetnHiEctA_18_s" 381 "SIGNALS_VehStc_numMisfDetnHiEctA_19_s" 382 "SIGNALS_VehStc_numMisfDetnHiEctA_1_s" 383 "SIGNALS_VehStc_numMisfDetnHiEctA_20_s" 384 "SIGNALS_VehStc_numMisfDetnHiEctA_2_s" 385 "SIGNALS_VehStc_numMisfDetnHiEctA_3_s" 386 "SIGNALS_VehStc_numMisfDetnHiEctA_4_s" 387 "SIGNALS_VehStc_numMisfDetnHiEctA_5_s" 388 "SIGNALS_VehStc_numMisfDetnHiEctA_6_s" 389 "SIGNALS_VehStc_numMisfDetnHiEctA_7_s" 390 "SIGNALS_VehStc_numMisfDetnHiEctA_8_s" 391 "SIGNALS_VehStc_numMisfDetnHiEctA_9_s" 392 "SIGNALS_VehStc_numMisfDetnLoEctA_0_s" 393 "SIGNALS_VehStc_numMisfDetnLoEctA_10_s" 394 "SIGNALS_VehStc_numMisfDetnLoEctA_11_s" 395 "SIGNALS_VehStc_numMisfDetnLoEctA_12_s" 396 "SIGNALS_VehStc_numMisfDetnLoEctA_13_s" 397 "SIGNALS_VehStc_numMisfDetnLoEctA_14_s" 398 "SIGNALS_VehStc_numMisfDetnLoEctA_15_s" 399 "SIGNALS_VehStc_numMisfDetnLoEctA_16_s" 400 "SIGNALS_VehStc_numMisfDetnLoEctA_17_s" 401 "SIGNALS_VehStc_numMisfDetnLoEctA_18_s" 402 "SIGNALS_VehStc_numMisfDetnLoEctA_19_s" 403 "SIGNALS_VehStc_numMisfDetnLoEctA_1_s" 404 "SIGNALS_VehStc_numMisfDetnLoEctA_20_s" 405 "SIGNALS_VehStc_numMisfDetnLoEctA_2_s" 406 "SIGNALS_VehStc_numMisfDetnLoEctA_3_s" 407 "SIGNALS_VehStc_numMisfDetnLoEctA_4_s" 408 "SIGNALS_VehStc_numMisfDetnLoEctA_5_s" 409 "SIGNALS_VehStc_numMisfDetnLoEctA_6_s" 410 "SIGNALS_VehStc_numMisfDetnLoEctA_7_s" 411 "SIGNALS_VehStc_numMisfDetnLoEctA_8_s" 412 "SIGNALS_VehStc_numMisfDetnLoEctA_9_s" 413 "SIGNALS_VehStc_numMisfDetnNormA_0_s" 414 "SIGNALS_VehStc_numMisfDetnNormA_10_s" 415 "SIGNALS_VehStc_numMisfDetnNormA_11_s" 416 "SIGNALS_VehStc_numMisfDetnNormA_12_s" 417 "SIGNALS_VehStc_numMisfDetnNormA_13_s" 418 "SIGNALS_VehStc_numMisfDetnNormA_14_s" 419 "SIGNALS_VehStc_numMisfDetnNormA_15_s" 420 "SIGNALS_VehStc_numMisfDetnNormA_16_s" 421 "SIGNALS_VehStc_numMisfDetnNormA_17_s" 422 "SIGNALS_VehStc_numMisfDetnNormA_18_s" 423 "SIGNALS_VehStc_numMisfDetnNormA_19_s" 424 "SIGNALS_VehStc_numMisfDetnNormA_1_s" 425 "SIGNALS_VehStc_numMisfDetnNormA_20_s" 426 "SIGNALS_VehStc_numMisfDetnNormA_2_s" 427 "SIGNALS_VehStc_numMisfDetnNormA_3_s" 428 "SIGNALS_VehStc_numMisfDetnNormA_4_s" 429 "SIGNALS_VehStc_numMisfDetnNormA_5_s" 430 "SIGNALS_VehStc_numMisfDetnNormA_6_s" 431 "SIGNALS_VehStc_numMisfDetnNormA_7_s" 432 "SIGNALS_VehStc_numMisfDetnNormA_8_s" 433 "SIGNALS_VehStc_numMisfDetnNormA_9_s" 434 "SIGNALS_VehStc_rDiagRsltB1A_0_s" 435 "SIGNALS_VehStc_rDiagRsltB1A_1_s" 436 "SIGNALS_VehStc_rDiagRsltB1A_2_s" 437 "SIGNALS_VehStc_rDiagRsltB1A_3_s" 438 "SIGNALS_VehStc_rDiagRsltB1A_4_s" 439 "SIGNALS_VehStc_tiRtCityEco_signal" 440 "SIGNALS_VehStc_tiRtCity_signal" 441 "SIGNALS_VehStc_tiRtHighWayEco_signal" 442 "SIGNALS_VehStc_tiRtHighWay_signal" 443 "SIGNALS_VehStc_tiRtStop_signal" 444 "SIGNALS_VehStc_volCnsCityDcyc_signal" 445 "SIGNALS_VehStc_volCnsCityEcoDcyc_signal" 446 "SIGNALS_VehStc_volCnsHighWayDcyc_signal" 447 "SIGNALS_VehStc_volCnsHighWayEcoDcyc_signal" 448 "SIGNALS_VehStc_volCnsStopDcyc_signal" 449 "SIGNALS_VehV_a" 450 "SIGNALS_VehV_v" 451 "SIGNALS_VehV_vSens_signal" 452 "SIGNALS_fra_w_msg_signal" 453 "SIGNALS_fra_w_s" 454 "SIGNALS_ftead_w_msg_s" 455 "SIGNALS_ftead_w_si" 456 "SIGNALS_ftead_w_signal" 457 "SIGNALS_i14229_agIntkB1GEVlv_2Byte_signal" 458 "SIGNALS_i14229_agIntkB1GEVlv_signal" 459 "SIGNALS_i14229_agSpIntkB1GevCtl_2Byte_signal" 460 "SIGNALS_i14229_agSpIntkB1GevCtl_signal" 461 "SIGNALS_lutskzyl_w_0_signal" 462 "SIGNALS_lutskzyl_w_1_signal" 463 "SIGNALS_lutskzyl_w_2_signal" 464 "SIGNALS_lutskzyl_w_3_signal" 465 "SIGNALS_lutskzyl_w_msg_0_signal" 466 "SIGNALS_mshfmst_w_signal" 467 "SIGNALS_ofmsndkh1_w_msg_signal" 468 "SIGNALS_ofmsndkh2_w_msg_signal" 469 "SIGNALS_prsoll_w_msg_s" 470 "SIGNALS_tateout_w_signal" 471 "SIGNALS_tatesoll_w_msg_signal" 472 "SIGNALS_thdev_msg_signal" 473 "SIGNALS_tmst_signal" 474 "SIGNALS_wkratst_signal" 475 "SIGNALS_PID83h_A_BitCombineSignal" 476 "SIGNALS_PID9Bh_A_BitCombineSignal" 477 "SIGNALS_PIDA1h_A_BitCombineSignal" 478 "SIGNALS_PIDA7h_A_BitCombineSignal" 479 "SIGNALS_PIDA8h_A_BitCombineSignal" 480 "SIGNALS_Virtual_DcmDspUDS_2600Byte06_signal" 481 "SIGNALS_Virtual_DcmDspUDS_2610Byte00_signal" 482 "SIGNALS_Virtual_DcmDspUDS_2610Byte01_signal" 483 "SIGNALS_Virtual_DcmDspUDS_2610Byte02_signal" 484 "SIGNALS_Virtual_DcmDspUDS_2610Byte03_signal" 485 "SIGNALS_Virtual_DcmDspUDS_2610Byte04_signal" 486 "SIGNALS_Virtual_DcmDspUDS_2610Byte05_signal" 487 "SIGNALS_Virtual_DcmDspUDS_2610Byte0D_signal" 488 "SIGNALS_Virtual_DcmDspUDS_2610Byte0F_signal" 489 "SIGNALS_Virtual_DcmDspUDS_2610Byte10_signal" 490 "SIGNALS_Virtual_DcmDspUDS_2610Byte1A_signal" 491 "SIGNALS_Virtual_DcmDspUDS_2610Byte1B_signal" 492 "SIGNALS_Virtual_DcmDspUDS_2610Byte1C_signal" 493 "SIGNALS_Virtual_DcmDspUDS_2610Byte1D_signal" 494 "SIGNALS_Virtual_DcmDspUDS_2610Byte1F_signal" 495 "SIGNALS_Virtual_DcmDspUDS_2610Byte20_signal" 496 "SIGNALS_Virtual_DcmDspUDS_2610Byte21_signal" 497 "SIGNALS_Virtual_DcmDspUDS_2610Byte22to23_signal" 498 "SIGNALS_Virtual_DcmDspUDS_2610Byte29_signal" 499 "SIGNALS_Virtual_DcmDspUDS_2610Byte2A_signal" 500 "SIGNALS_Virtual_DcmDspUDS_2611Byte00_signal" 501 "SIGNALS_Virtual_DcmDspUDS_2611Byte01_signal" 502 "SIGNALS_Virtual_DcmDspUDS_2611Byte02_signal" 503 "SIGNALS_Virtual_DcmDspUDS_2611Byte03_signal" 504 "SIGNALS_Virtual_DcmDspUDS_2611Byte04_signal" 505 "SIGNALS_Virtual_DcmDspUDS_2611Byte05_signal" 506 "SIGNALS_Virtual_DcmDspUDS_2611Byte06_07_signal" 507 "SIGNALS_Virtual_DcmDspUDS_2611Byte08to09_signal" 508 "SIGNALS_Virtual_DcmDspUDS_2611Byte0A_signal" 509 "SIGNALS_Virtual_DcmDspUDS_2611Byte0B_signal" 510 "SIGNALS_Virtual_DcmDspUDS_2611Byte0Cto0D_signal" 511 "SIGNALS_Virtual_DcmDspUDS_2611Byte0E_signal" 512 "SIGNALS_Virtual_DcmDspUDS_2611Byte2A_signal" 513 "SIGNALS_Virtual_DcmDspUDS_2611Byte2B_signal" 514 "SIGNALS_Virtual_DcmDspUDS_2611Byte30_signal" 515 "SIGNALS_Virtual_DcmDspUDS_2611Byte31_signal" 516 "SIGNALS_Virtual_DcmDspUDS_2611Byte32_signal" 517 "SIGNALS_Virtual_DcmDspUDS_2611Byte33_signal" 518 "SIGNALS_Virtual_DcmDspUDS_2612Byte00_signal" 519 "SIGNALS_Virtual_DcmDspUDS_2612Byte01_signal" 520 "SIGNALS_Virtual_DcmDspUDS_2612Byte02_signal" 521 "SIGNALS_Virtual_DcmDspUDS_2612Byte03_signal" 522 "SIGNALS_Virtual_DcmDspUDS_2612Byte04_signal" 523 "SIGNALS_Virtual_DcmDspUDS_2612Byte05_signal" 524 "SIGNALS_Virtual_DcmDspUDS_2612Byte0B_0C_signal" 525 "SIGNALS_Virtual_DcmDspUDS_2612Byte14_signal" 526 "SIGNALS_Virtual_DcmDspUDS_2612Byte15_signal" 527 "SIGNALS_Virtual_DcmDspUDS_2612Byte16_signal" 528 "SIGNALS_Virtual_DcmDspUDS_2612Byte17_signal" 529 "SIGNALS_Virtual_DcmDspUDS_2612Byte1F_signal" 530 "SIGNALS_Virtual_DcmDspUDS_2612Byte20_signal" 531 "SIGNALS_Virtual_DcmDspUDS_2612Byte2A_signal" 532 "SIGNALS_Virtual_DcmDspUDS_2612Byte2B_signal" 533 "SIGNALS_Virtual_DcmDspUDS_2613Byte00_signal" 534 "SIGNALS_Virtual_DcmDspUDS_2613Byte01_signal" 535 "SIGNALS_Virtual_DcmDspUDS_2613Byte02_signal" 536 "SIGNALS_Virtual_DcmDspUDS_2613Byte03_signal" 537 "SIGNALS_Virtual_DcmDspUDS_2613Byte04_signal" 538 "SIGNALS_Virtual_DcmDspUDS_2613Byte05_signal" 539 "SIGNALS_Virtual_DcmDspUDS_2613Byte08_signal" 540 "SIGNALS_Virtual_DcmDspUDS_2613Byte09_signal" 541 "SIGNALS_Virtual_DcmDspUDS_2615Byte00_signal" 542 "SIGNALS_Virtual_DcmDspUDS_2615Byte01_signal" 543 "SIGNALS_Virtual_DcmDspUDS_2615Byte02_signal" 544 "SIGNALS_Virtual_DcmDspUDS_2615Byte03_signal" 545 "SIGNALS_Virtual_DcmDspUDS_2615Byte04_signal" 546 "SIGNALS_Virtual_DcmDspUDS_2615Byte05_signal" 547 "SIGNALS_Virtual_DcmDspUDS_2615Byte10_signal" 548 "SIGNALS_Virtual_DcmDspUDS_2615Byte26_signal" 549 "SIGNALS_Virtual_DcmDspUDS_2615Byte27_signal" 550 "SIGNALS_Virtual_DcmDspUDS_2617Byte00_signal" 551 "SIGNALS_Virtual_DcmDspUDS_2617Byte01_signal" 552 "SIGNALS_Virtual_DcmDspUDS_2617Byte02_signal" 553 "SIGNALS_Virtual_DcmDspUDS_2617Byte03_signal" 554 "SIGNALS_Virtual_DcmDspUDS_2617Byte04_signal" 555 "SIGNALS_Virtual_DcmDspUDS_2617Byte05_signal" 556 "SIGNALS_Virtual_DcmDspUDS_261AByte00_signal" 557 "SIGNALS_Virtual_DcmDspUDS_261AByte01_signal" 558 "SIGNALS_Virtual_DcmDspUDS_261AByte02_signal" 559 "SIGNALS_Virtual_DcmDspUDS_261AByte03_signal" 560 "SIGNALS_Virtual_DcmDspUDS_261AByte04_signal" 561 "SIGNALS_Virtual_DcmDspUDS_261AByte05_signal" 562 "SIGNALS_Virtual_DcmDspUDS_261AByte07_signal" 563 "SIGNALS_Virtual_DcmDspUDS_261AByte0A_signal" 564 "SIGNALS_Virtual_DcmDspUDS_261AByte0B_signal" 565 "SIGNALS_Virtual_DcmDspUDS_261AByte0C_signal" 566 "SIGNALS_Virtual_DcmDspUDS_261AByte0D_signal" 567 "SIGNALS_Virtual_DcmDspUDS_261AByte0E_signal" 568 "SIGNALS_Virtual_DcmDspUDS_2620Byte00_signal" 569 "SIGNALS_Virtual_DcmDspUDS_2620Byte01_signal" 570 "SIGNALS_Virtual_DcmDspUDS_2620Byte02_signal" 571 "SIGNALS_Virtual_DcmDspUDS_2620Byte03_signal" 572 "SIGNALS_Virtual_DcmDspUDS_2620Byte04_signal" 573 "SIGNALS_Virtual_DcmDspUDS_2620Byte05_signal" 574 "SIGNALS_Virtual_DcmDspUDS_2621Byte00_signal" 575 "SIGNALS_Virtual_DcmDspUDS_2621Byte01_signal" 576 "SIGNALS_Virtual_DcmDspUDS_2621Byte02_signal" 577 "SIGNALS_Virtual_DcmDspUDS_2621Byte03_signal" 578 "SIGNALS_Virtual_DcmDspUDS_2621Byte04_signal" 579 "SIGNALS_Virtual_DcmDspUDS_2621Byte05_signal" 580 "SIGNALS_Virtual_DcmDspUDS_2622Byte00_signal" 581 "SIGNALS_Virtual_DcmDspUDS_2622Byte01_signal" 582 "SIGNALS_Virtual_DcmDspUDS_2622Byte02_signal" 583 "SIGNALS_Virtual_DcmDspUDS_2622Byte03_signal" 584 "SIGNALS_Virtual_DcmDspUDS_2622Byte04_signal" 585 "SIGNALS_Virtual_DcmDspUDS_2622Byte05_signal" 586 "SIGNALS_Virtual_DcmDspUDS_2623Byte00_signal" 587 "SIGNALS_Virtual_DcmDspUDS_2623Byte01_signal" 588 "SIGNALS_Virtual_DcmDspUDS_2623Byte02_signal" 589 "SIGNALS_Virtual_DcmDspUDS_2623Byte03_signal" 590 "SIGNALS_Virtual_DcmDspUDS_2623Byte04_signal" 591 "SIGNALS_Virtual_DcmDspUDS_2623Byte05_signal" 592 "SIGNALS_Virtual_DcmDspUDS_2625Byte00_signal" 593 "SIGNALS_Virtual_DcmDspUDS_2625Byte01_signal" 594 "SIGNALS_Virtual_DcmDspUDS_2625Byte02_signal" 595 "SIGNALS_Virtual_DcmDspUDS_2625Byte03_signal" 596 "SIGNALS_Virtual_DcmDspUDS_2625Byte04_signal" 597 "SIGNALS_Virtual_DcmDspUDS_2625Byte05_signal" 598 "SIGNALS_Virtual_DcmDspUDS_2627Byte00_signal" 599 "SIGNALS_Virtual_DcmDspUDS_2627Byte01_signal" 600 "SIGNALS_Virtual_DcmDspUDS_2627Byte02_signal" 601 "SIGNALS_Virtual_DcmDspUDS_2627Byte03_signal" 602 "SIGNALS_Virtual_DcmDspUDS_2627Byte04_signal" 603 "SIGNALS_Virtual_DcmDspUDS_2627Byte05_signal" 604 "SIGNALS_Virtual_DcmDspUDS_262AByte00_signal" 605 "SIGNALS_Virtual_DcmDspUDS_262AByte01_signal" 606 "SIGNALS_Virtual_DcmDspUDS_262AByte02_signal" 607 "SIGNALS_Virtual_DcmDspUDS_262AByte03_signal" 608 "SIGNALS_Virtual_DcmDspUDS_262AByte04_signal" 609 "SIGNALS_Virtual_DcmDspUDS_262AByte05_signal" 610 "SIGNALS_Virtual_DcmDspUDS_2660Byte0_signal" 611 "SIGNALS_Virtual_DcmDspUDS_2660Byte11to12_signal" 612 "SIGNALS_Virtual_DcmDspUDS_2660Byte13to14_signal" 613 "SIGNALS_Virtual_DcmDspUDS_2660Byte15_signal" 614 "SIGNALS_Virtual_DcmDspUDS_2660Byte16_signal" 615 "SIGNALS_Virtual_DcmDspUDS_2660Byte17_signal" 616 "SIGNALS_Virtual_DcmDspUDS_2660Byte18_signal" 617 "SIGNALS_Virtual_DcmDspUDS_2660Byte19_signal" 618 "SIGNALS_Virtual_DcmDspUDS_2660Byte1A_signal" 619 "SIGNALS_Virtual_DcmDspUDS_2660Byte1B_signal" 620 "SIGNALS_Virtual_DcmDspUDS_2660Byte1C_signal" 621 "SIGNALS_Virtual_DcmDspUDS_2660Byte1D_signal" 622 "SIGNALS_Virtual_DcmDspUDS_2660Byte1E_signal" 623 "SIGNALS_Virtual_DcmDspUDS_2660Byte1_signal" 624 "SIGNALS_Virtual_DcmDspUDS_2660Byte26to27_signal" 625 "SIGNALS_Virtual_DcmDspUDS_2660Byte2A_signal" 626 "SIGNALS_Virtual_DcmDspUDS_2660Byte2Eto2F_signal" 627 "SIGNALS_Virtual_DcmDspUDS_2660Byte2_signal" 628 "SIGNALS_Virtual_DcmDspUDS_2660Byte3_signal" 629 "SIGNALS_Virtual_DcmDspUDS_2660Byte4_signal" 630 "SIGNALS_Virtual_DcmDspUDS_2660Byte5_signal" 631 "SIGNALS_Virtual_DcmDspUDS_2660Byte6_signal" 632 "SIGNALS_Virtual_DcmDspUDS_2661Byte0A_signal" 633 "SIGNALS_Virtual_DcmDspUDS_2661Byte0B_signal" 634 "SIGNALS_Virtual_DcmDspUDS_2661Byte0C_signal" 635 "SIGNALS_Virtual_DcmDspUDS_2661Byte0D_signal" 636 "SIGNALS_Virtual_DcmDspUDS_2661Byte0E_signal" 637 "SIGNALS_Virtual_DcmDspUDS_2661Byte0F_signal" 638 "SIGNALS_Virtual_DcmDspUDS_2661Byte0_signal" 639 "SIGNALS_Virtual_DcmDspUDS_2661Byte1_signal" 640 "SIGNALS_Virtual_DcmDspUDS_2661Byte2D_signal" 641 "SIGNALS_Virtual_DcmDspUDS_2661Byte2E_signal" 642 "SIGNALS_Virtual_DcmDspUDS_2661Byte2F_signal" 643 "SIGNALS_Virtual_DcmDspUDS_2661Byte2_signal" 644 "SIGNALS_Virtual_DcmDspUDS_2661Byte30_signal" 645 "SIGNALS_Virtual_DcmDspUDS_2661Byte31_signal" 646 "SIGNALS_Virtual_DcmDspUDS_2661Byte32_signal" 647 "SIGNALS_Virtual_DcmDspUDS_2661Byte3_signal" 648 "SIGNALS_Virtual_DcmDspUDS_2661Byte4_signal" 649 "SIGNALS_Virtual_DcmDspUDS_2661Byte5_signal" 650 "SIGNALS_Virtual_DcmDspUDS_2661Byte6_signal" 651 "SIGNALS_Virtual_DcmDspUDS_2661Byte7_signal" 652 "SIGNALS_Virtual_DcmDspUDS_2661Byte8_signal" 653 "SIGNALS_Virtual_DcmDspUDS_2661Byte9_signal" 654 "SIGNALS_Virtual_DcmDspUDS_2662Byte0Cto0D_signal" 655 "SIGNALS_Virtual_DcmDspUDS_2662Byte0_signal" 656 "SIGNALS_Virtual_DcmDspUDS_2662Byte18_signal" 657 "SIGNALS_Virtual_DcmDspUDS_2662Byte19_signal" 658 "SIGNALS_Virtual_DcmDspUDS_2662Byte1_signal" 659 "SIGNALS_Virtual_DcmDspUDS_2662Byte2_signal" 660 "SIGNALS_Virtual_DcmDspUDS_2662Byte3_signal" 661 "SIGNALS_Virtual_DcmDspUDS_2662Byte4_signal" 662 "SIGNALS_Virtual_DcmDspUDS_2662Byte5_signal" 663 "SIGNALS_Virtual_DcmDspUDS_2663Byte0_signal" 664 "SIGNALS_Virtual_DcmDspUDS_2663Byte14Byte15_signal" 665 "SIGNALS_Virtual_DcmDspUDS_2663Byte16Byte17_signal" 666 "SIGNALS_Virtual_DcmDspUDS_2663Byte18Byte19_signal" 667 "SIGNALS_Virtual_DcmDspUDS_2663Byte1AByte1B_signal" 668 "SIGNALS_Virtual_DcmDspUDS_2663Byte1_signal" 669 "SIGNALS_Virtual_DcmDspUDS_2663Byte2_signal" 670 "SIGNALS_Virtual_DcmDspUDS_2663Byte3_signal" 671 "SIGNALS_Virtual_DcmDspUDS_2663Byte4_signal" 672 "SIGNALS_Virtual_DcmDspUDS_2663Byte5_signal" 673 "SIGNALS_Virtual_DcmDspUDS_2664Byte0_signal" 674 "SIGNALS_Virtual_DcmDspUDS_2664Byte1_signal" 675 "SIGNALS_Virtual_DcmDspUDS_2664Byte25_signal" 676 "SIGNALS_Virtual_DcmDspUDS_2664Byte26_signal" 677 "SIGNALS_Virtual_DcmDspUDS_2664Byte2_signal" 678 "SIGNALS_Virtual_DcmDspUDS_2664Byte3_signal" 679 "SIGNALS_Virtual_DcmDspUDS_2664Byte4_signal" 680 "SIGNALS_Virtual_DcmDspUDS_2664Byte5_signal" 681 "SIGNALS_Virtual_DcmDspUDS_2664Byte6_signal" 682 "SIGNALS_Virtual_DcmDspUDS_2664Byte7_signal" 683 "SIGNALS_Virtual_DcmDspUDS_2665Byte0_signal" 684 "SIGNALS_Virtual_DcmDspUDS_2665Byte1_signal" 685 "SIGNALS_Virtual_DcmDspUDS_2665Byte2_signal" 686 "SIGNALS_Virtual_DcmDspUDS_2665Byte3_signal" 687 "SIGNALS_Virtual_DcmDspUDS_2665Byte4_signal" 688 "SIGNALS_Virtual_DcmDspUDS_2665Byte5_signal" 689 "SIGNALS_Virtual_DcmDspUDS_2666Byte0_signal" 690 "SIGNALS_Virtual_DcmDspUDS_2666Byte1_signal" 691 "SIGNALS_Virtual_DcmDspUDS_2666Byte2_signal" 692 "SIGNALS_Virtual_DcmDspUDS_2666Byte3_signal" 693 "SIGNALS_Virtual_DcmDspUDS_2666Byte4_signal" 694 "SIGNALS_Virtual_DcmDspUDS_2666Byte5_signal" 695 "SIGNALS_Virtual_DcmDspUDS_2668Byte0_signal" 696 "SIGNALS_Virtual_DcmDspUDS_2668Byte1_signal" 697 "SIGNALS_Virtual_DcmDspUDS_2668Byte2_signal" 698 "SIGNALS_Virtual_DcmDspUDS_2668Byte3_signal" 699 "SIGNALS_Virtual_DcmDspUDS_2668Byte4_signal" 700 "SIGNALS_Virtual_DcmDspUDS_2668Byte5_signal" 701 "SIGNALS_Virtual_DcmDspUDS_266CByte0_signal" 702 "SIGNALS_Virtual_DcmDspUDS_266CByte1_signal" 703 "SIGNALS_Virtual_DcmDspUDS_266CByte26_signal" 704 "SIGNALS_Virtual_DcmDspUDS_266CByte27_signal" 705 "SIGNALS_Virtual_DcmDspUDS_266CByte2_signal" 706 "SIGNALS_Virtual_DcmDspUDS_266CByte3_signal" 707 "SIGNALS_Virtual_DcmDspUDS_266CByte4_signal" 708 "SIGNALS_Virtual_DcmDspUDS_266CByte5_signal" 709 "SIGNALS_Virtual_DcmDspUDS_266CByte6_signal" 710 "SIGNALS_Virtual_DcmDspUDS_266CByte7_signal" 711 "SIGNALS_Virtual_DcmDspUDS_266CByte8_signal" 712 "SIGNALS_Virtual_DcmDspUDS_266CByte9_signal" 713 "SIGNALS_Virtual_DcmDspUDS_266DByte0_signal" 714 "SIGNALS_Virtual_DcmDspUDS_266DByte1_signal" 715 "SIGNALS_Virtual_DcmDspUDS_266DByte2_signal" 716 "SIGNALS_Virtual_DcmDspUDS_266DByte3_signal" 717 "SIGNALS_Virtual_DcmDspUDS_266DByte4_signal" 718 "SIGNALS_Virtual_DcmDspUDS_266DByte5_signal" 719 "SIGNALS_Virtual_DcmDspUDS_266FByte0_signal" 720 "SIGNALS_Virtual_DcmDspUDS_266FByte1_signal" 721 "SIGNALS_Virtual_DcmDspUDS_266FByte2_signal" 722 "SIGNALS_Virtual_DcmDspUDS_266FByte3_signal" 723 "SIGNALS_Virtual_DcmDspUDS_2673Byte0A_signal" 724 "SIGNALS_Virtual_DcmDspUDS_2673Byte0B_signal" 725 "SIGNALS_Virtual_DcmDspUDS_2673Byte0_signal" 726 "SIGNALS_Virtual_DcmDspUDS_2673Byte12_signal" 727 "SIGNALS_Virtual_DcmDspUDS_2673Byte13_signal" 728 "SIGNALS_Virtual_DcmDspUDS_2673Byte16_signal" 729 "SIGNALS_Virtual_DcmDspUDS_2673Byte17_signal" 730 "SIGNALS_Virtual_DcmDspUDS_2673Byte1E_signal" 731 "SIGNALS_Virtual_DcmDspUDS_2673Byte1F_signal" 732 "SIGNALS_Virtual_DcmDspUDS_2673Byte1_signal" 733 "SIGNALS_Virtual_DcmDspUDS_2673Byte2_signal" 734 "SIGNALS_Virtual_DcmDspUDS_2673Byte3_signal" 735 "SIGNALS_Virtual_DcmDspUDS_2673Byte4_signal" 736 "SIGNALS_Virtual_DcmDspUDS_2673Byte5_signal" 737 "SIGNALS_Virtual_DcmDspUDS_2673Byte6_signal" 738 "SIGNALS_Virtual_DcmDspUDS_2673Byte7_signal" 739 "SIGNALS_Virtual_DcmDspUDS_2676Byte0_signal" 740 "SIGNALS_Virtual_DcmDspUDS_2676Byte1_signal" 741 "SIGNALS_Virtual_DcmDspUDS_2676Byte2E_signal" 742 "SIGNALS_Virtual_DcmDspUDS_2676Byte2F_signal" 743 "SIGNALS_Virtual_DcmDspUDS_2676Byte2_signal" 744 "SIGNALS_Virtual_DcmDspUDS_2676Byte3_signal" 745 "SIGNALS_Virtual_DcmDspUDS_2676Byte4_signal" 746 "SIGNALS_Virtual_DcmDspUDS_2676Byte5_signal" 747 "SIGNALS_Virtual_DcmDspUDS_2676Byte6_signal" 748 "SIGNALS_Virtual_DcmDspUDS_2676Byte7_signal" 749 "SIGNALS_Virtual_DcmDspUDS_267BByte0_signal" 750 "SIGNALS_Virtual_DcmDspUDS_267BByte1_signal" 751 "SIGNALS_Virtual_DcmDspUDS_267BByte2_signal" 752 "SIGNALS_Virtual_DcmDspUDS_267BByte3_signal" 753 "SIGNALS_Virtual_DcmDspUDS_267BByte4_signal" 754 "SIGNALS_Virtual_DcmDspUDS_267BByte5_signal" 755 "SIGNALS_Virtual_DcmDspUDS_267EByte0_signal" 756 "SIGNALS_Virtual_DcmDspUDS_267EByte1_signal" 757 "SIGNALS_Virtual_DcmDspUDS_267EByte22_signal" 758 "SIGNALS_Virtual_DcmDspUDS_267EByte2_signal" 759 "SIGNALS_Virtual_DcmDspUDS_2680Byte00_signal" 760 "SIGNALS_Virtual_DcmDspUDS_2680Byte01_signal" 761 "SIGNALS_Virtual_DcmDspUDS_2680Byte02_signal" 762 "SIGNALS_Virtual_DcmDspUDS_2680Byte03_signal" 763 "SIGNALS_Virtual_DcmDspUDS_2680Byte04_signal" 764 "SIGNALS_Virtual_DcmDspUDS_2680Byte05_signal" 765 "SIGNALS_Virtual_DcmDspUDS_2680Byte08_signal" 766 "SIGNALS_Virtual_DcmDspUDS_2680Byte09_signal" 767 "SIGNALS_Virtual_DcmDspUDS_2680Byte0E_signal" 768 "SIGNALS_Virtual_DcmDspUDS_2680Byte0F_signal" 769 "SIGNALS_Virtual_DcmDspUDS_2681Byte00_signal" 770 "SIGNALS_Virtual_DcmDspUDS_2681Byte01_signal" 771 "SIGNALS_Virtual_DcmDspUDS_2681Byte02_signal" 772 "SIGNALS_Virtual_DcmDspUDS_2681Byte03_signal" 773 "SIGNALS_Virtual_DcmDspUDS_2681Byte04_signal" 774 "SIGNALS_Virtual_DcmDspUDS_2681Byte05_signal" 775 "SIGNALS_Virtual_DcmDspUDS_2681Byte0F_signal" 776 "SIGNALS_Virtual_DcmDspUDS_2681Byte10_signal" 777 "SIGNALS_Virtual_DcmDspUDS_2681Byte13_signal" 778 "SIGNALS_Virtual_DcmDspUDS_2681Byte14_signal" 779 "SIGNALS_Virtual_DcmDspUDS_2681Byte1D_signal" 780 "SIGNALS_Virtual_DcmDspUDS_2681Byte1E_signal" 781 "SIGNALS_Virtual_DcmDspUDS_2682Byte00_signal" 782 "SIGNALS_Virtual_DcmDspUDS_2682Byte01_signal" 783 "SIGNALS_Virtual_DcmDspUDS_2682Byte02_signal" 784 "SIGNALS_Virtual_DcmDspUDS_2682Byte03_signal" 785 "SIGNALS_Virtual_DcmDspUDS_2682Byte04_signal" 786 "SIGNALS_Virtual_DcmDspUDS_2682Byte05_signal" 787 "SIGNALS_Virtual_DcmDspUDS_2682Byte06_07_signal" 788 "SIGNALS_Virtual_DcmDspUDS_2682Byte08_09_signal" 789 "SIGNALS_Virtual_DcmDspUDS_2682Byte0E_signal" 790 "SIGNALS_Virtual_DcmDspUDS_2682Byte11_12_signal" 791 "SIGNALS_Virtual_DcmDspUDS_2682Byte13_14_signal" 792 "SIGNALS_Virtual_DcmDspUDS_2682Byte15_16_signal" 793 "SIGNALS_Virtual_DcmDspUDS_2682Byte18_19_signal" 794 "SIGNALS_Virtual_DcmDspUDS_2682Byte1B_signal" 795 "SIGNALS_Virtual_DcmDspUDS_2682Byte1C_signal" 796 "SIGNALS_Virtual_DcmDspUDS_2683Byte00_signal" 797 "SIGNALS_Virtual_DcmDspUDS_2683Byte01_signal" 798 "SIGNALS_Virtual_DcmDspUDS_2683Byte02_signal" 799 "SIGNALS_Virtual_DcmDspUDS_2683Byte03_signal" 800 "SIGNALS_Virtual_DcmDspUDS_2683Byte04_signal" 801 "SIGNALS_Virtual_DcmDspUDS_2683Byte05_signal" 802 "SIGNALS_Virtual_DcmDspUDS_2684Byte00_signal" 803 "SIGNALS_Virtual_DcmDspUDS_2684Byte01_signal" 804 "SIGNALS_Virtual_DcmDspUDS_2684Byte02_signal" 805 "SIGNALS_Virtual_DcmDspUDS_2684Byte03_signal" 806 "SIGNALS_Virtual_DcmDspUDS_2684Byte04_signal" 807 "SIGNALS_Virtual_DcmDspUDS_2684Byte05_signal" 808 "SIGNALS_Virtual_DcmDspUDS_2688Byte00_signal" 809 "SIGNALS_Virtual_DcmDspUDS_2688Byte01_signal" 810 "SIGNALS_Virtual_DcmDspUDS_2688Byte02_signal" 811 "SIGNALS_Virtual_DcmDspUDS_2688Byte03_signal" 812 "SIGNALS_Virtual_DcmDspUDS_2688Byte04_signal" 813 "SIGNALS_Virtual_DcmDspUDS_2688Byte05_signal" 814 "SIGNALS_Virtual_DcmDspUDS_2689Byte00_signal" 815 "SIGNALS_Virtual_DcmDspUDS_2689Byte01_signal" 816 "SIGNALS_Virtual_DcmDspUDS_2689Byte02_signal" 817 "SIGNALS_Virtual_DcmDspUDS_2689Byte03_signal" 818 "SIGNALS_Virtual_DcmDspUDS_2689Byte04_signal" 819 "SIGNALS_Virtual_DcmDspUDS_2689Byte05_signal" 820 "SIGNALS_Virtual_DcmDspUDS_2689Byte06to09_signal" 821 "SIGNALS_Virtual_DcmDspUDS_2689Byte0Eto11_signal" 822 "SIGNALS_Virtual_DcmDspUDS_2689Byte12to15_signal" 823 "SIGNALS_Virtual_DcmDspUDS_2689Byte16to19_signal" 824 "SIGNALS_Virtual_DcmDspUDS_2689Byte1Ato1D_signal" 825 "SIGNALS_Virtual_DcmDspUDS_2689Byte1Eto21_signal" 826 "SIGNALS_Virtual_DcmDspUDS_2689Byte22to25_signal" 827 "SIGNALS_Virtual_DcmDspUDS_2689Byte26to29_signal" 828 "SIGNALS_Virtual_DcmDspUDS_2689Byte2Ato2D_signal" 829 "SIGNALS_Virtual_DcmDspUDS_2689Byte2Eto31_signal" 830 "SIGNALS_Virtual_DcmDspUDS_268BByte00_signal" 831 "SIGNALS_Virtual_DcmDspUDS_268BByte01_signal" 832 "SIGNALS_Virtual_DcmDspUDS_268BByte02_signal" 833 "SIGNALS_Virtual_DcmDspUDS_268BByte03_signal" 834 "SIGNALS_Virtual_DcmDspUDS_268BByte04_signal" 835 "SIGNALS_Virtual_DcmDspUDS_268BByte05_signal" 836 "SIGNALS_Virtual_DcmDspUDS_268BByte06_signal" 837 "SIGNALS_Virtual_DcmDspUDS_268BByte07_signal" 838 "SIGNALS_Virtual_DcmDspUDS_268BByte08_signal" 839 "SIGNALS_Virtual_DcmDspUDS_268BByte09_signal" 840 "SIGNALS_Virtual_DcmDspUDS_268BByte0A_signal" 841 "SIGNALS_Virtual_DcmDspUDS_268BByte0B_signal" 842 "SIGNALS_Virtual_DcmDspUDS_268BByte0C_signal" 843 "SIGNALS_Virtual_DcmDspUDS_268BByte0D_signal" 844 "SIGNALS_Virtual_DcmDspUDS_268CByte00_signal" 845 "SIGNALS_Virtual_DcmDspUDS_268CByte01_signal" 846 "SIGNALS_Virtual_DcmDspUDS_268CByte02_signal" 847 "SIGNALS_Virtual_DcmDspUDS_268CByte03_signal" 848 "SIGNALS_Virtual_DcmDspUDS_268CByte04_signal" 849 "SIGNALS_Virtual_DcmDspUDS_268CByte05_signal" 850 "SIGNALS_Virtual_DcmDspUDS_268CByte06_signal" 851 "SIGNALS_Virtual_DcmDspUDS_268CByte07_signal" 852 "SIGNALS_Virtual_DcmDspUDS_268CByte08_signal" 853 "SIGNALS_Virtual_DcmDspUDS_268CByte09_signal" 854 "SIGNALS_Virtual_DcmDspUDS_268CByte0A_signal" 855 "SIGNALS_Virtual_DcmDspUDS_268CByte2E_signal" 856 "SIGNALS_Virtual_DcmDspUDS_268CByte2F_signal" 857 "SIGNALS_Virtual_DcmDspUDS_268CByte30_signal" 858 "SIGNALS_Virtual_DcmDspUDS_268CByte31_signal" 859 "SIGNALS_Virtual_DcmDspUDS_268CByte32_signal" 860 "SIGNALS_Virtual_DcmDspUDS_268CByte33_signal" 861 "SIGNALS_Virtual_DcmDspUDS_268EByte00_signal" 862 "SIGNALS_Virtual_DcmDspUDS_268EByte01_signal" 863 "SIGNALS_Virtual_DcmDspUDS_268EByte02_signal" 864 "SIGNALS_Virtual_DcmDspUDS_268EByte03_signal" 865 "SIGNALS_Virtual_DcmDspUDS_268EByte04_signal" 866 "SIGNALS_Virtual_DcmDspUDS_268EByte05_signal" 867 "SIGNALS_Virtual_DcmDspUDS_268EByte08to09_signal" 868 "SIGNALS_Virtual_DcmDspUDS_268EByte0A_signal" 869 "SIGNALS_Virtual_DcmDspUDS_268EByte0B_signal" 870 "SIGNALS_Virtual_DcmDspUDS_268FByte00_signal" 871 "SIGNALS_Virtual_DcmDspUDS_268FByte01_signal" 872 "SIGNALS_Virtual_DcmDspUDS_268FByte02_signal" 873 "SIGNALS_Virtual_DcmDspUDS_268FByte03_signal" 874 "SIGNALS_Virtual_DcmDspUDS_268FByte04_signal" 875 "SIGNALS_Virtual_DcmDspUDS_268FByte05_signal" 876 "SIGNALS_Virtual_DcmDspUDS_268FByte0A_signal" 877 "SIGNALS_Virtual_DcmDspUDS_268FByte0B_signal" 878 "SIGNALS_Virtual_DcmDspUDS_268FByte16_17_signal" 879 "SIGNALS_Virtual_DcmDspUDS_268FByte18_19_signal" 880 "SIGNALS_Virtual_DcmDspUDS_268FByte1A_1B_signal" 881 "SIGNALS_Virtual_DcmDspUDS_2699Byte00_signal" 882 "SIGNALS_Virtual_DcmDspUDS_2699Byte01_signal" 883 "SIGNALS_Virtual_DcmDspUDS_2699Byte02_signal" 884 "SIGNALS_Virtual_DcmDspUDS_2699Byte03_signal" 885 "SIGNALS_Virtual_DcmDspUDS_2699Byte04_signal" 886 "SIGNALS_Virtual_DcmDspUDS_2699Byte05_signal" 887 "SIGNALS_Virtual_DcmDspUDS_2699Byte06_signal" 888 "SIGNALS_Virtual_DcmDspUDS_2699Byte07_signal" 889 "SIGNALS_Virtual_DcmDspUDS_2699Byte0B_0C_signal" 890 "SIGNALS_Virtual_DcmDspUDS_2699Byte16_signal" 891 "SIGNALS_Virtual_DcmDspUDS_2699Byte17_signal" 892 "SIGNALS_Virtual_DcmDspUDS_2699Byte26_27_signal" 893 "SIGNALS_Virtual_DcmDspUDS_2699Byte28_29_signal" 894 "SIGNALS_Virtual_DcmDspUDS_2699Byte2A_2B_signal" 895 "SIGNALS_Virtual_DcmDspUDS_2699Byte2E_signal" 896 "SIGNALS_Virtual_DcmDspUDS_2699Byte2F_30_signal" 897 "SIGNALS_Virtual_DcmDspUDS_269AByte00_signal" 898 "SIGNALS_Virtual_DcmDspUDS_269AByte01_signal" 899 "SIGNALS_Virtual_DcmDspUDS_269AByte02_signal" 900 "SIGNALS_Virtual_DcmDspUDS_269AByte03_signal" 901 "SIGNALS_Virtual_DcmDspUDS_269AByte04_signal" 902 "SIGNALS_Virtual_DcmDspUDS_269AByte05_signal" 903 "SIGNALS_Virtual_DcmDspUDS_269BByte00_signal" 904 "SIGNALS_Virtual_DcmDspUDS_269BByte01_signal" 905 "SIGNALS_Virtual_DcmDspUDS_269BByte02_signal" 906 "SIGNALS_Virtual_DcmDspUDS_269BByte03_signal" 907 "SIGNALS_Virtual_DcmDspUDS_269BByte04_signal" 908 "SIGNALS_Virtual_DcmDspUDS_269BByte05_signal" 909 "SIGNALS_Virtual_DcmDspUDS_269EByte00_signal" 910 "SIGNALS_Virtual_DcmDspUDS_269EByte01_signal" 911 "SIGNALS_Virtual_DcmDspUDS_269EByte02_signal" 912 "SIGNALS_Virtual_DcmDspUDS_269EByte03_signal" 913 "SIGNALS_Virtual_DcmDspUDS_269EByte04_signal" 914 "SIGNALS_Virtual_DcmDspUDS_269EByte05_signal" 915 "SIGNALS_Virtual_DcmDspUDS_26A0Byte00_signal" 916 "SIGNALS_Virtual_DcmDspUDS_26A0Byte01_signal" 917 "SIGNALS_Virtual_DcmDspUDS_26A0Byte02_signal" 918 "SIGNALS_Virtual_DcmDspUDS_26A0Byte03_signal" 919 "SIGNALS_Virtual_DcmDspUDS_26A0Byte04_signal" 920 "SIGNALS_Virtual_DcmDspUDS_26A0Byte05_signal" 921 "SIGNALS_Virtual_DcmDspUDS_26A0Byte06_signal" 922 "SIGNALS_Virtual_DcmDspUDS_26A0Byte07_signal" 923 "SIGNALS_Virtual_DcmDspUDS_26A0Byte08_signal" 924 "SIGNALS_Virtual_DcmDspUDS_26A0Byte09_signal" 925 "SIGNALS_Virtual_DcmDspUDS_26A0Byte0A_signal" 926 "SIGNALS_Virtual_DcmDspUDS_26A0Byte0B_signal" 927 "SIGNALS_Virtual_DcmDspUDS_26A0Byte0C_signal" 928 "SIGNALS_Virtual_DcmDspUDS_26A0Byte0D_signal" 929 "SIGNALS_Virtual_DcmDspUDS_26A0Byte0E_signal" 930 "SIGNALS_Virtual_DcmDspUDS_26A0Byte0F_signal" 931 "SIGNALS_Virtual_DcmDspUDS_26A0Byte10_signal" 932 "SIGNALS_Virtual_DcmDspUDS_26A0Byte11_signal" 933 "SIGNALS_Virtual_DcmDspUDS_26A0Byte12_signal" 934 "SIGNALS_Virtual_DcmDspUDS_26A0Byte13_signal" 935 "SIGNALS_Virtual_DcmDspUDS_26A0Byte14_signal" 936 "SIGNALS_Virtual_DcmDspUDS_26A0Byte15_signal" 937 "SIGNALS_Virtual_DcmDspUDS_26A0Byte16_signal" 938 "SIGNALS_Virtual_DcmDspUDS_26A0Byte17_signal" 939 "SIGNALS_Virtual_DcmDspUDS_26A0Byte18_signal" 940 "SIGNALS_Virtual_DcmDspUDS_26A0Byte19_signal" 941 "SIGNALS_Virtual_DcmDspUDS_26A0Byte1A_signal" 942 "SIGNALS_Virtual_DcmDspUDS_26A0Byte4E_signal" 943 "SIGNALS_Virtual_DcmDspUDS_26A0Byte52_53_signal" 944 "SIGNALS_Virtual_DcmDspUDS_26A0Byte54_55_signal" 945 "SIGNALS_Virtual_DcmDspUDS_26A0Byte56_57_signal" 946 "SIGNALS_Virtual_DcmDspUDS_26A0Byte66_signal" 947 "SIGNALS_Virtual_DcmDspUDS_26A0Byte67_signal" 948 "SIGNALS_Virtual_DcmDspUDS_26A0Byte68_signal" 949 "SIGNALS_Virtual_DcmDspUDS_26A0Byte69_signal" 950 "SIGNALS_Virtual_DcmDspUDS_26A0Byte6A_signal" 951 "SIGNALS_Virtual_DcmDspUDS_26A0Byte6B_signal" 952 "SIGNALS_Virtual_DcmDspUDS_26A0Byte6C_signal" 953 "SIGNALS_Virtual_DcmDspUDS_26A0Byte6D_signal" 954 "SIGNALS_Virtual_DcmDspUDS_26A0Byte7F_80_signal" 955 "SIGNALS_Virtual_DcmDspUDS_26A0Byte81_82_signal" 956 "SIGNALS_Virtual_DcmDspUDS_26A0Byte83_84_signal" 957 "SIGNALS_Virtual_DcmDspUDS_26A0Byte85_86_signal" 958 "SIGNALS_Virtual_DcmDspUDS_26A0Byte87_88_signal" 959 "SIGNALS_Virtual_DcmDspUDS_26A0Byte89_8A_signal" 960 "SIGNALS_Virtual_DcmDspUDS_26A0Byte8B_8C_signal" 961 "SIGNALS_Virtual_DcmDspUDS_26A0Byte8D_8E_signal" 962 "SIGNALS_Virtual_DcmDspUDS_26A0Byte8F_90_signal" 963 "SIGNALS_Virtual_DcmDspUDS_26A0Byte91_92_signal" 964 "SIGNALS_Virtual_DcmDspUDS_26A0Byte93_94_signal" 965 "SIGNALS_Virtual_DcmDspUDS_26A0Byte95_96_signal" 966 "SIGNALS_Virtual_DcmDspUDS_26A0Byte97_98_signal" 967 "SIGNALS_Virtual_DcmDspUDS_26A0Byte99_9A_signal" 968 "SIGNALS_Virtual_DcmDspUDS_26A0Byte9B_9C_signal" 969 "SIGNALS_Virtual_DcmDspUDS_26A0Byte9D_9E_signal" 970 "SIGNALS_Virtual_DcmDspUDS_26A0Byte9F_A0_signal" 971 "SIGNALS_Virtual_DcmDspUDS_26A0ByteA1_A2_signal" 972 "SIGNALS_Virtual_DcmDspUDS_26A0ByteA3_A4_signal" 973 "SIGNALS_Virtual_DcmDspUDS_26A0ByteA5_A6_signal" 974 "SIGNALS_Virtual_DcmDspUDS_26A0ByteA7_A8_signal" 975 "SIGNALS_Virtual_DcmDspUDS_26A0ByteA9_AA_signal" 976 "SIGNALS_Virtual_DcmDspUDS_26A0ByteAB_AC_signal" 977 "SIGNALS_Virtual_DcmDspUDS_26A0ByteAD_AE_signal" 978 "SIGNALS_Virtual_DcmDspUDS_26A0ByteAF_B0_signal" 979 "SIGNALS_Virtual_DcmDspUDS_26A0ByteB1_B2_signal" 980 "SIGNALS_Virtual_DcmDspUDS_26A0ByteB3_B4_signal" 981 "SIGNALS_Virtual_DcmDspUDS_26A0ByteB5_B6_signal" 982 "SIGNALS_Virtual_DcmDspUDS_26A0ByteB7_B8_signal" 983 "SIGNALS_Virtual_DcmDspUDS_26A0ByteB9_BA_signal" 984 "SIGNALS_Virtual_DcmDspUDS_26A0ByteBB_BC_signal" 985 "SIGNALS_Virtual_DcmDspUDS_26A0ByteBD_BE_signal" 986 "SIGNALS_Virtual_DcmDspUDS_26A0ByteBF_C0_signal" 987 "SIGNALS_Virtual_DcmDspUDS_26A0ByteC1_C2_signal" 988 "SIGNALS_Virtual_DcmDspUDS_26A0ByteC3_C4_signal" 989 "SIGNALS_Virtual_DcmDspUDS_26A0ByteC5_C6_signal" 990 "SIGNALS_Virtual_DcmDspUDS_26A0ByteC7_C8_signal" 991 "SIGNALS_Virtual_DcmDspUDS_26A0ByteC9_CA_signal" 992 "SIGNALS_Virtual_DcmDspUDS_26A0ByteCB_CC_signal" 993 "SIGNALS_Virtual_DcmDspUDS_26A0ByteCD_CE_signal" 994 "SIGNALS_Virtual_DcmDspUDS_26A0ByteCF_D0_signal" 995 "SIGNALS_Virtual_DcmDspUDS_26A0ByteD1_D2_signal" 996 "SIGNALS_Virtual_DcmDspUDS_26A0ByteD3_D4_signal" 997 "SIGNALS_Virtual_DcmDspUDS_26A0ByteD5_D6_signal" 998 "SIGNALS_Virtual_DcmDspUDS_26A0ByteD7_D8_signal" 999 "SIGNALS_Virtual_DcmDspUDS_26A0ByteD9_DA_signal" 1000 "SIGNALS_Virtual_DcmDspUDS_26A0ByteDB_DC_signal" 1001 "SIGNALS_Virtual_DcmDspUDS_26A0ByteDD_DE_signal" 1002 "SIGNALS_Virtual_DcmDspUDS_26A0ByteDF_E0_signal" 1003 "SIGNALS_Virtual_DcmDspUDS_26A0ByteE1_E2_signal" 1004 "SIGNALS_Virtual_DcmDspUDS_26A0ByteE3_E4_signal" 1005 "SIGNALS_Virtual_DcmDspUDS_26A0ByteE5_E6_signal" 1006 "SIGNALS_Virtual_DcmDspUDS_26A0ByteE7_E8_signal" 1007 "SIGNALS_Virtual_DcmDspUDS_26A0ByteE9_EA_signal" 1008 "SIGNALS_Virtual_DcmDspUDS_26A0ByteEB_EC_signal" 1009 "SIGNALS_Virtual_DcmDspUDS_26A0ByteED_EE_signal" 1010 "SIGNALS_Virtual_DcmDspUDS_26A0ByteEF_F0_signal" 1011 "SIGNALS_Virtual_DcmDspUDS_26A0ByteF1_F2_signal" 1012 "SIGNALS_Virtual_DcmDspUDS_26A1Byte00_signal" 1013 "SIGNALS_Virtual_DcmDspUDS_26A1Byte01_signal" 1014 "SIGNALS_Virtual_DcmDspUDS_26A1Byte02_signal" 1015 "SIGNALS_Virtual_DcmDspUDS_26A1Byte03_signal" 1016 "SIGNALS_Virtual_DcmDspUDS_26A1Byte04_signal" 1017 "SIGNALS_Virtual_DcmDspUDS_26A1Byte05_signal" 1018 "SIGNALS_Virtual_DcmDspUDS_26A1Byte06_signal" 1019 "SIGNALS_Virtual_DcmDspUDS_26A1Byte07_signal" 1020 "SIGNALS_Virtual_DcmDspUDS_26A1Byte08_signal" 1021 "SIGNALS_Virtual_DcmDspUDS_26A1Byte09_signal" 1022 "SIGNALS_Virtual_DcmDspUDS_26A1Byte0A_signal" 1023 "SIGNALS_Virtual_DcmDspUDS_26A1Byte0B_signal" 1024 "SIGNALS_Virtual_DcmDspUDS_26A1Byte0C_signal" 1025 "SIGNALS_Virtual_DcmDspUDS_26A1Byte0D_signal" 1026 "SIGNALS_Virtual_DcmDspUDS_26A1Byte0E_signal" 1027 "SIGNALS_Virtual_DcmDspUDS_26A1Byte0F_signal" 1028 "SIGNALS_Virtual_DcmDspUDS_26A1Byte10_signal" 1029 "SIGNALS_Virtual_DcmDspUDS_26A1Byte11_signal" 1030 "SIGNALS_Virtual_DcmDspUDS_26A1Byte12_signal" 1031 "SIGNALS_Virtual_DcmDspUDS_26A1Byte13_signal" 1032 "SIGNALS_Virtual_DcmDspUDS_26A1Byte14_signal" 1033 "SIGNALS_Virtual_DcmDspUDS_26A1Byte15_signal" 1034 "SIGNALS_Virtual_DcmDspUDS_26A1Byte16_signal" 1035 "SIGNALS_Virtual_DcmDspUDS_26A1Byte17_signal" 1036 "SIGNALS_Virtual_DcmDspUDS_26A1Byte18_signal" 1037 "SIGNALS_Virtual_DcmDspUDS_26A1Byte19_signal" 1038 "SIGNALS_Virtual_DcmDspUDS_26A1Byte1A_signal" 1039 "SIGNALS_Virtual_DcmDspUDS_26A1Byte1B_1C_signal" 1040 "SIGNALS_Virtual_DcmDspUDS_26A1Byte1D_1E_signal" 1041 "SIGNALS_Virtual_DcmDspUDS_26A1Byte1F_20_signal" 1042 "SIGNALS_Virtual_DcmDspUDS_26A1Byte21_22_signal" 1043 "SIGNALS_Virtual_DcmDspUDS_26A1Byte23_24_signal" 1044 "SIGNALS_Virtual_DcmDspUDS_26A1Byte25_signal" 1045 "SIGNALS_Virtual_DcmDspUDS_26A1Byte26_signal" 1046 "SIGNALS_Virtual_DcmDspUDS_26A1Byte27_signal" 1047 "SIGNALS_Virtual_DcmDspUDS_26A1Byte28_signal" 1048 "SIGNALS_Virtual_DcmDspUDS_26A1Byte29_signal" 1049 "SIGNALS_Virtual_DcmDspUDS_26A1Byte2A_signal" 1050 "SIGNALS_Virtual_DcmDspUDS_26A1Byte2B_signal" 1051 "SIGNALS_Virtual_DcmDspUDS_26A1Byte2C_signal" 1052 "SIGNALS_Virtual_DcmDspUDS_26A1Byte2D_signal" 1053 "SIGNALS_Virtual_DcmDspUDS_26A1Byte2E_signal" 1054 "SIGNALS_Virtual_DcmDspUDS_26A1Byte2F_signal" 1055 "SIGNALS_Virtual_DcmDspUDS_26A1Byte30_signal" 1056 "SIGNALS_Virtual_DcmDspUDS_26A1Byte31_signal" 1057 "SIGNALS_Virtual_DcmDspUDS_26A1Byte32_signal" 1058 "SIGNALS_Virtual_DcmDspUDS_26A1Byte33_signal" 1059 "SIGNALS_Virtual_DcmDspUDS_26A1Byte34_signal" 1060 "SIGNALS_Virtual_DcmDspUDS_26A1Byte35_signal" 1061 "SIGNALS_Virtual_DcmDspUDS_26A1Byte36_signal" 1062 "SIGNALS_Virtual_DcmDspUDS_26A1Byte37_signal" 1063 "SIGNALS_Virtual_DcmDspUDS_26A1Byte38_signal" 1064 "SIGNALS_Virtual_DcmDspUDS_26A1Byte39_signal" 1065 "SIGNALS_Virtual_DcmDspUDS_26A1Byte6F_70_signal" 1066 "SIGNALS_Virtual_DcmDspUDS_26A1Byte71_72_signal" 1067 "SIGNALS_Virtual_DcmDspUDS_26A1Byte73_74_signal" 1068 "SIGNALS_Virtual_DcmDspUDS_26A1Byte75_76_signal" 1069 "SIGNALS_Virtual_DcmDspUDS_26A1Byte77_78_signal" 1070 "SIGNALS_Virtual_DcmDspUDS_26A1Byte79_signal" 1071 "SIGNALS_Virtual_DcmDspUDS_26A1Byte7B_signal" 1072 "SIGNALS_Virtual_DcmDspUDS_26A2Byte00_signal" 1073 "SIGNALS_Virtual_DcmDspUDS_26A2Byte01_signal" 1074 "SIGNALS_Virtual_DcmDspUDS_26A2Byte02_signal" 1075 "SIGNALS_Virtual_DcmDspUDS_26A2Byte03_signal" 1076 "SIGNALS_Virtual_DcmDspUDS_26A2Byte04_signal" 1077 "SIGNALS_Virtual_DcmDspUDS_26A2Byte05_signal" 1078 "SIGNALS_Virtual_DcmDspUDS_26A2Byte12_13_signal" 1079 "SIGNALS_Virtual_DcmDspUDS_26A2Byte1C_signal" 1080 "SIGNALS_Virtual_DcmDspUDS_26A2Byte1D_signal" 1081 "SIGNALS_Virtual_DcmDspUDS_26A2Byte21_signal" 1082 "SIGNALS_Virtual_DcmDspUDS_26A2Byte22_signal" 1083 "SIGNALS_Virtual_DcmDspUDS_Acm_fzabgs_w_signal" 1084 "SIGNALS_Virtual_DcmDspUDS_DID_2613Byte2Eto2F_signal_VirtFunc_s" 1085 "SIGNALS_Virtual_DcmDspUDS_DID_261AByte08_signal" 1086 "SIGNALS_Virtual_DcmDspUDS_DID_261AByte09_signal" 1087 "SIGNALS_Virtual_DcmDspUDS_DID_E402Byte00_signal" 1088 "SIGNALS_Virtual_DcmDspUDS_DID_E402Byte01_signal" 1089 "SIGNALS_Virtual_DcmDspUDS_DID_E402Byte07to08_signal" 1090 "SIGNALS_Virtual_DcmDspUDS_DID_E402Byte10to11_signal" 1091 "SIGNALS_Virtual_DcmDspUDS_DID_E402Byte19to1A_signal" 1092 "SIGNALS_Virtual_DcmDspUDS_DID_E402Byte22to23_signal" 1093 "SIGNALS_Virtual_DcmDspUDS_DID_E402Byte2Bto2C_signal" 1094 "SIGNALS_Virtual_DcmDspUDS_DID_F110Byte0_3_signal" 1095 "SIGNALS_Virtual_DcmDspUDS_DID_F110Byte12_15_signal" 1096 "SIGNALS_Virtual_DcmDspUDS_DID_F110Byte16_signal" 1097 "SIGNALS_Virtual_DcmDspUDS_DID_F110Byte4_7_signal" 1098 "SIGNALS_Virtual_DcmDspUDS_DID_F110Byte8_11_signal" 1099 "SIGNALS_Virtual_DcmDspUDS_DID_F112Byte0_3_signal" 1100 "SIGNALS_Virtual_DcmDspUDS_DID_F112Byte12_15_signal" 1101 "SIGNALS_Virtual_DcmDspUDS_DID_F112Byte16_19_signal" 1102 "SIGNALS_Virtual_DcmDspUDS_DID_F112Byte20_23_signal" 1103 "SIGNALS_Virtual_DcmDspUDS_DID_F112Byte24_27_signal" 1104 "SIGNALS_Virtual_DcmDspUDS_DID_F112Byte28_29_signal" 1105 "SIGNALS_Virtual_DcmDspUDS_DID_F112Byte30_signal" 1106 "SIGNALS_Virtual_DcmDspUDS_DID_F112Byte4_7_signal" 1107 "SIGNALS_Virtual_DcmDspUDS_DID_F112Byte8_11_signal" 1108 "SIGNALS_Virtual_DcmDspUDS_E602Byte2_signal" 1109 "SIGNALS_Virtual_DcmDspUDS_F181Byte0_3_signal" 1110 "SIGNALS_Virtual_DcmDspUDS_F181Byte12_15_signal" 1111 "SIGNALS_Virtual_DcmDspUDS_F181Byte4_7_signal" 1112 "SIGNALS_Virtual_DcmDspUDS_F181Byte8_11_signal" 1113 "SIGNALS_Virtual_DcmDspUDS_fzabgs_w_signal" 1114 "SIGNALS_Virtual_DcmDspUDS_numReWrECUID1_signal" 1115 "SIGNALS_Virtual_DcmDspUDS_numReWrECUID2_signal" 1116 "SIGNALS_Virtual_I14229B9_0490_FrNo09_signal" 1117 "SIGNALS_Virtual_I14229B9_0490_FrNo10_signal" 1118 "SIGNALS_Virtual_I14229B9_04B1_FrNo16_signal" 1119 "SIGNALS_Virtual_I14229B9_04B1_FrNo17_signal" 1120 "SIGNALS_Virtual_I14229B9_04B1_FrNo20_signal" 1121 "SIGNALS_Virtual_I14229B9_04B1_FrNo21_signal" 1122 "SIGNALS_Virtual_I14229B9_04B1_FrNo22_signal" 1123 "SIGNALS_Virtual_I14229B9_04B1_FrNo23_signal" 1124 "SIGNALS_Virtual_I14229B9_04C2_FrNo2021_signal" 1125 "SIGNALS_Virtual_I14229B9_04D2_FrNo24_signal" 1126 "SIGNALS_Virtual_I14229B9_04D2_FrNo25_signal" 1127 "SIGNALS_Virtual_I14229B9_0520_FrNo15_signal" 1128 "SIGNALS_Virtual_I14229B9_0520_FrNo16_signal" 1129 "SIGNALS_Virtual_I14229B9_0523_FrNo42_signal" 1130 "SIGNALS_Virtual_I14229B9_0523_FrNo43_signal" 1131 "SIGNALS_Virtual_I14229B9_0524_FrNo09_signal" 1132 "SIGNALS_Virtual_I14229B9_0524_FrNo10_signal" 1133 "SIGNALS_Virtual_I14229B9_0550_FrNo09_signal" 1134 "SIGNALS_Virtual_I14229B9_0550_FrNo10_signal" 1135 "SIGNALS_Virtual_I14229B9_0553_FrNo13_signal" 1136 "SIGNALS_Virtual_I14229B9_0553_FrNo14_signal" 1137 "SIGNALS_Virtual_I14229B9_056A_FrNo8_signal" 1138 "SIGNALS_Virtual_I14229B9_056A_FrNo9_signal" 1139 "SIGNALS_Virtual_I14229B9_0588_FrNo15_signal" 1140 "SIGNALS_Virtual_I14229B9_0588_FrNo16_signal" 1141 "SIGNALS_Virtual_I14229B9_05A0_FrNo40_signal" 1142 "SIGNALS_Virtual_I14229B9_05A0_FrNo41_signal" 1143 "SIGNALS_Virtual_I14229B9_05B0_FrNo13_signal" 1144 "SIGNALS_Virtual_I14229B9_05B0_FrNo14_signal" 1145 "SIGNALS_Virtual_I14229B9_05C0_FrNo12_signal" 1146 "SIGNALS_Virtual_I14229B9_05C0_FrNo13_signal" 1147 "SIGNALS_Virtual_I14229B9_05E0_FrNo19_signal" 1148 "SIGNALS_Virtual_I14229B9_05E0_FrNo20_signal" 1149 "SIGNALS_Virtual_I14229B9_05E0_FrNo21_signal" 1150 "SIGNALS_Virtual_I14229B9_05E0_FrNo22_signal" 1151 "SIGNALS_Virtual_I14229B9_05E0_FrNo23_signal" 1152 "SIGNALS_Virtual_I14229B9_05E0_FrNo24_signal" 1153 "SIGNALS_Virtual_I14229B9_1208_FrNo34_signal" 1154 "SIGNALS_Virtual_I14229B9_1208_FrNo35_signal" 1155 "SIGNALS_Virtual_I14229B9_1208_FrNo36_signal" 1156 "SIGNALS_Virtual_I14229B9_1208_FrNo37_signal" 1157 "SIGNALS_Virtual_I14229B9_120A_FrNo09_signal" 1158 "SIGNALS_Virtual_I14229B9_120A_FrNo10_signal" 1159 "SIGNALS_Virtual_I14229B9_120B_FrNo09_signal" 1160 "SIGNALS_Virtual_I14229B9_120B_FrNo10_signal" 1161 "SIGNALS_Virtual_I14229_Com_aLgtG_signal" 1162 "SIGNALS_Virtual_I14229_pEngSrtMin_signal" 1163 "SIGNALS_Virtual_IKCtl_agAdpnCurr_s16_signal" 1164 "SIGNALS_Virtual_IKCtl_wIntgRef_au32_0__s" 1165 "SIGNALS_Virtual_PtCoornDyn_tqCluDes_signal" 1166 "SIGNALS_Virtual_PtCoornDyn_tqCluLeadTrsmIntv_signal" 1167 "SIGNALS_Virtual_Tra_numGear_signal" 1168 "SIGNALS_Virtual_i14229_agIntkB1GEVlvSig_signal" /end COMPU_VTAB
/begin RECORD_LAYOUT ValA_Wu16 FNC_VALUES 1 UWORD COLUMN_DIR DIRECT /end RECORD_LAYOUT
/begin RECORD_LAYOUT Val_Wu8 FNC_VALUES 1 UBYTE COLUMN_DIR DIRECT /end RECORD_LAYOUT
/end MODULE
/end PROJECT
