ASAP2_VERSION 1 60
/begin PROJECT MG1CS022 "MG1CS022"
/begin HEADER "" VERSION "MG1CS022_62XSC_V037" PROJECT_NO MG1CS022 /end HEADER
/begin MODULE DIM ""
/begin MOD_COMMON "" BYTE_ORDER MSB_LAST ALIGNMENT_BYTE 1 ALIGNMENT_WORD 2 ALIGNMENT_LONG 4 ALIGNMENT_INT64 4 ALIGNMENT_FLOAT32_IEEE 4 ALIGNMENT_FLOAT64_IEEE 4 DATA_SIZE 32 /end MOD_COMMON
/begin CHARACTERISTIC CWDSKVR "Codeword to disable high pressure sensor diagnosis" VALUE 0x8053AE78 RB_Val_Wu8 255.0 dez 0.00 255.0 FORMAT "%5.1" /end CHARACTERISTIC
/begin CHARACTERISTIC CWDSKVR1 "Codeword for high pressure sensor diagnosis" VALUE 0x8053AE79 RB_Val_Wu8 255.0 dez 0.00 255.0 FORMAT "%5.1" /end CHARACTERISTIC
/begin CHARACTERISTIC DDRCObsvr_Check_CA "Calibration array to choose DDRCObsvr records" VAL_BLK 0x80503F94 ValA_Wu16 431.000000000 DDRCObsvr_DebDFCVerb 0.00 431.000000000 FORMAT "%13.9" NUMBER 255 /end CHARACTERISTIC
/begin CHARACTERISTIC DDRCObsvr_Intl.DebStcLim0_CA "" VAL_BLK 0x804D8CC0 ValA_Wu8 127.5 DDRCObsvr_Prc_Half 0.00 127.5 FORMAT "%5.1" NUMBER 3 /end CHARACTERISTIC
/begin CHARACTERISTIC DDRCObsvr_Intl.DebStcLim1_CA "" VAL_BLK 0x804D8CC3 ValA_Wu8 127.5 DDRCObsvr_Prc_Half 0.00 127.5 FORMAT "%5.1" NUMBER 3 /end CHARACTERISTIC
/begin CHARACTERISTIC DDRCObsvr_Intl.DebStcLim2_CA "" VAL_BLK 0x804D8CC6 ValA_Wu8 127.5 DDRCObsvr_Prc_Half 0.00 127.5 FORMAT "%5.1" NUMBER 3 /end CHARACTERISTIC
/begin CHARACTERISTIC DDRCObsvr_Intl.DebStcLim3_CA "" VAL_BLK 0x804D8CC9 ValA_Wu8 127.5 DDRCObsvr_Prc_Half 0.00 127.5 FORMAT "%5.1" NUMBER 3 /end CHARACTERISTIC
/begin CHARACTERISTIC DDRCObsvr_Intl.DebStcLim4_CA "" VAL_BLK 0x804D8CCC ValA_Wu8 127.5 DDRCObsvr_Prc_Half 0.00 127.5 FORMAT "%5.1" NUMBER 3 /end CHARACTERISTIC
/begin CHARACTERISTIC DDRCObsvr_Intl.DebStcLim5_CA "" VAL_BLK 0x804D8CCF ValA_Wu8 127.5 DDRCObsvr_Prc_Half 0.00 127.5 FORMAT "%5.1" NUMBER 3 /end CHARACTERISTIC
/begin CHARACTERISTIC DDRCObsvr_Intl.DebStcLim6_CA "" VAL_BLK 0x804D8CD2 ValA_Wu8 127.5 DDRCObsvr_Prc_Half 0.00 127.5 FORMAT "%5.1" NUMBER 3 /end CHARACTERISTIC
/begin CHARACTERISTIC DDRCObsvr_Intl.DebStcLim7_CA "" VAL_BLK 0x804D8CD5 ValA_Wu8 127.5 DDRCObsvr_Prc_Half 0.00 127.5 FORMAT "%5.1" NUMBER 3 /end CHARACTERISTIC
/begin CHARACTERISTIC DDRCObsvr_Intl.DebStcLim8_CA "" VAL_BLK 0x804D8CD8 ValA_Wu8 127.5 DDRCObsvr_Prc_Half 0.00 127.5 FORMAT "%5.1" NUMBER 3 /end CHARACTERISTIC
/begin CHARACTERISTIC DDRCObsvr_Intl.DebStcLim9_CA "" VAL_BLK 0x804D8CDB ValA_Wu8 127.5 DDRCObsvr_Prc_Half 0.00 127.5 FORMAT "%5.1" NUMBER 3 /end CHARACTERISTIC
/begin CHARACTERISTIC DDRCObsvr_Intl.DebStcLim10_CA "" VAL_BLK 0x804D8CDE ValA_Wu8 127.5 DDRCObsvr_Prc_Half 0.00 127.5 FORMAT "%5.1" NUMBER 3 /end CHARACTERISTIC
/begin CHARACTERISTIC DDRCObsvr_Intl.DebStcLim11_CA "" VAL_BLK 0x804D8CE1 ValA_Wu8 127.5 DDRCObsvr_Prc_Half 0.00 127.5 FORMAT "%5.1" NUMBER 3 /end CHARACTERISTIC
/begin CHARACTERISTIC DDRCObsvr_Intl.DebStcLim12_CA "" VAL_BLK 0x804D8CE4 ValA_Wu8 127.5 DDRCObsvr_Prc_Half 0.00 127.5 FORMAT "%5.1" NUMBER 3 /end CHARACTERISTIC
/begin CHARACTERISTIC DDRCObsvr_Intl.DebStcLim13_CA "" VAL_BLK 0x804D8CE7 ValA_Wu8 127.5 DDRCObsvr_Prc_Half 0.00 127.5 FORMAT "%5.1" NUMBER 3 /end CHARACTERISTIC
/begin CHARACTERISTIC DDRCObsvr_Intl.DebStcLim14_CA "" VAL_BLK 0x804D8CEA ValA_Wu8 127.5 DDRCObsvr_Prc_Half 0.00 127.5 FORMAT "%5.1" NUMBER 3 /end CHARACTERISTIC
/begin CHARACTERISTIC DDRCObsvr_Intl.DebStcLim15_CA "" VAL_BLK 0x804D8CED ValA_Wu8 127.5 DDRCObsvr_Prc_Half 0.00 127.5 FORMAT "%5.1" NUMBER 3 /end CHARACTERISTIC
/begin CHARACTERISTIC DDRCObsvr_Intl.DebStcLim16_CA "" VAL_BLK 0x804D8CF0 ValA_Wu8 127.5 DDRCObsvr_Prc_Half 0.00 127.5 FORMAT "%5.1" NUMBER 3 /end CHARACTERISTIC
/begin CHARACTERISTIC DDRCObsvr_Intl.DebStcLim17_CA "" VAL_BLK 0x804D8CF3 ValA_Wu8 127.5 DDRCObsvr_Prc_Half 0.00 127.5 FORMAT "%5.1" NUMBER 3 /end CHARACTERISTIC
/begin CHARACTERISTIC DDRCObsvr_Intl.DebStcLim18_CA "" VAL_BLK 0x804D8CF6 ValA_Wu8 127.5 DDRCObsvr_Prc_Half 0.00 127.5 FORMAT "%5.1" NUMBER 3 /end CHARACTERISTIC
/begin CHARACTERISTIC DDRCObsvr_Intl.DebStcLim19_CA "" VAL_BLK 0x804D8CF9 ValA_Wu8 127.5 DDRCObsvr_Prc_Half 0.00 127.5 FORMAT "%5.1" NUMBER 3 /end CHARACTERISTIC
/begin CHARACTERISTIC DDRCObsvr_Intl.DebStcLim20_CA "" VAL_BLK 0x804D8CFC ValA_Wu8 127.5 DDRCObsvr_Prc_Half 0.00 127.5 FORMAT "%5.1" NUMBER 3 /end CHARACTERISTIC
/begin CHARACTERISTIC DDRCObsvr_Intl.DebStcLim21_CA "" VAL_BLK 0x804D8CFF ValA_Wu8 127.5 DDRCObsvr_Prc_Half 0.00 127.5 FORMAT "%5.1" NUMBER 3 /end CHARACTERISTIC
/begin CHARACTERISTIC DDRCObsvr_Intl.DebStcLim22_CA "" VAL_BLK 0x804D8D02 ValA_Wu8 127.5 DDRCObsvr_Prc_Half 0.00 127.5 FORMAT "%5.1" NUMBER 3 /end CHARACTERISTIC
/begin CHARACTERISTIC DDRCObsvr_Intl.DebStcLim23_CA "" VAL_BLK 0x804D8D05 ValA_Wu8 127.5 DDRCObsvr_Prc_Half 0.00 127.5 FORMAT "%5.1" NUMBER 3 /end CHARACTERISTIC
/begin CHARACTERISTIC DDRCObsvr_Intl.DebStcLim24_CA "" VAL_BLK 0x804D8D08 ValA_Wu8 127.5 DDRCObsvr_Prc_Half 0.00 127.5 FORMAT "%5.1" NUMBER 3 /end CHARACTERISTIC
/begin CHARACTERISTIC DDRCObsvr_Intl.DebStcLim25_CA "" VAL_BLK 0x804D8D0B ValA_Wu8 127.5 DDRCObsvr_Prc_Half 0.00 127.5 FORMAT "%5.1" NUMBER 3 /end CHARACTERISTIC
/begin CHARACTERISTIC DDRCObsvr_Intl.DebStcLim26_CA "" VAL_BLK 0x804D8D0E ValA_Wu8 127.5 DDRCObsvr_Prc_Half 0.00 127.5 FORMAT "%5.1" NUMBER 3 /end CHARACTERISTIC
/begin CHARACTERISTIC DDRCObsvr_Intl.DebStcLim27_CA "" VAL_BLK 0x804D8D11 ValA_Wu8 127.5 DDRCObsvr_Prc_Half 0.00 127.5 FORMAT "%5.1" NUMBER 3 /end CHARACTERISTIC
/begin CHARACTERISTIC DDRCObsvr_Intl.DebStcLim28_CA "" VAL_BLK 0x804D8D14 ValA_Wu8 127.5 DDRCObsvr_Prc_Half 0.00 127.5 FORMAT "%5.1" NUMBER 3 /end CHARACTERISTIC
/begin CHARACTERISTIC DDRCObsvr_Intl.DebStcLim29_CA "" VAL_BLK 0x804D8D17 ValA_Wu8 127.5 DDRCObsvr_Prc_Half 0.00 127.5 FORMAT "%5.1" NUMBER 3 /end CHARACTERISTIC
/begin CHARACTERISTIC DDRCObsvr_Intl.DebStcLim30_CA "" VAL_BLK 0x804D8D1A ValA_Wu8 127.5 DDRCObsvr_Prc_Half 0.00 127.5 FORMAT "%5.1" NUMBER 3 /end CHARACTERISTIC
/begin CHARACTERISTIC DDRCObsvr_Intl.DebStcLim31_CA "" VAL_BLK 0x804D8D1D ValA_Wu8 127.5 DDRCObsvr_Prc_Half 0.00 127.5 FORMAT "%5.1" NUMBER 3 /end CHARACTERISTIC
/begin CHARACTERISTIC DDRCObsvr_Intl.DebStcLim32_CA "" VAL_BLK 0x804D8D20 ValA_Wu8 127.5 DDRCObsvr_Prc_Half 0.00 127.5 FORMAT "%5.1" NUMBER 3 /end CHARACTERISTIC
/begin CHARACTERISTIC DDRCObsvr_Intl.DebStcLim33_CA "" VAL_BLK 0x804D8D23 ValA_Wu8 127.5 DDRCObsvr_Prc_Half 0.00 127.5 FORMAT "%5.1" NUMBER 3 /end CHARACTERISTIC
/begin CHARACTERISTIC DDRCObsvr_Intl.DebStcLim34_CA "" VAL_BLK 0x804D8D26 ValA_Wu8 127.5 DDRCObsvr_Prc_Half 0.00 127.5 FORMAT "%5.1" NUMBER 3 /end CHARACTERISTIC
/begin CHARACTERISTIC DDRCObsvr_Intl.DebStcLim35_CA "" VAL_BLK 0x804D8D29 ValA_Wu8 127.5 DDRCObsvr_Prc_Half 0.00 127.5 FORMAT "%5.1" NUMBER 3 /end CHARACTERISTIC
/begin CHARACTERISTIC DDRCObsvr_Intl.DebStcLim36_CA "" VAL_BLK 0x804D8D2C ValA_Wu8 127.5 DDRCObsvr_Prc_Half 0.00 127.5 FORMAT "%5.1" NUMBER 3 /end CHARACTERISTIC
/begin CHARACTERISTIC DDRCObsvr_Intl.DebStcLim37_CA "" VAL_BLK 0x804D8D2F ValA_Wu8 127.5 DDRCObsvr_Prc_Half 0.00 127.5 FORMAT "%5.1" NUMBER 3 /end CHARACTERISTIC
/begin CHARACTERISTIC DDRCObsvr_Intl.DebStcLim38_CA "" VAL_BLK 0x804D8D32 ValA_Wu8 127.5 DDRCObsvr_Prc_Half 0.00 127.5 FORMAT "%5.1" NUMBER 3 /end CHARACTERISTIC
/begin CHARACTERISTIC DDRCObsvr_Intl.DebStcLim39_CA "" VAL_BLK 0x804D8D35 ValA_Wu8 127.5 DDRCObsvr_Prc_Half 0.00 127.5 FORMAT "%5.1" NUMBER 3 /end CHARACTERISTIC
/begin CHARACTERISTIC DDRCObsvr_Intl.DebStcLim40_CA "" VAL_BLK 0x804D8D38 ValA_Wu8 127.5 DDRCObsvr_Prc_Half 0.00 127.5 FORMAT "%5.1" NUMBER 3 /end CHARACTERISTIC
/begin CHARACTERISTIC DDRCObsvr_Intl.DebStcLim41_CA "" VAL_BLK 0x804D8D3B ValA_Wu8 127.5 DDRCObsvr_Prc_Half 0.00 127.5 FORMAT "%5.1" NUMBER 3 /end CHARACTERISTIC
/begin CHARACTERISTIC DDRCObsvr_Intl.DebStcLim42_CA "" VAL_BLK 0x804D8D3E ValA_Wu8 127.5 DDRCObsvr_Prc_Half 0.00 127.5 FORMAT "%5.1" NUMBER 3 /end CHARACTERISTIC
/begin CHARACTERISTIC DDRCObsvr_Intl.DebStcLim43_CA "" VAL_BLK 0x804D8D41 ValA_Wu8 127.5 DDRCObsvr_Prc_Half 0.00 127.5 FORMAT "%5.1" NUMBER 3 /end CHARACTERISTIC
/begin CHARACTERISTIC DDRCObsvr_Intl.DebStcLim44_CA "" VAL_BLK 0x804D8D44 ValA_Wu8 127.5 DDRCObsvr_Prc_Half 0.00 127.5 FORMAT "%5.1" NUMBER 3 /end CHARACTERISTIC
/begin CHARACTERISTIC DDRCObsvr_Intl.DebStcLim45_CA "" VAL_BLK 0x804D8D47 ValA_Wu8 127.5 DDRCObsvr_Prc_Half 0.00 127.5 FORMAT "%5.1" NUMBER 3 /end CHARACTERISTIC
/begin CHARACTERISTIC DDRCObsvr_Intl.DebStcLim46_CA "" VAL_BLK 0x804D8D4A ValA_Wu8 127.5 DDRCObsvr_Prc_Half 0.00 127.5 FORMAT "%5.1" NUMBER 3 /end CHARACTERISTIC
/begin CHARACTERISTIC DDRCObsvr_Intl.DebStcLim47_CA "" VAL_BLK 0x804D8D4D ValA_Wu8 127.5 DDRCObsvr_Prc_Half 0.00 127.5 FORMAT "%5.1" NUMBER 3 /end CHARACTERISTIC
/begin CHARACTERISTIC DDRCObsvr_Intl.DebStcLim48_CA "" VAL_BLK 0x804D8D50 ValA_Wu8 127.5 DDRCObsvr_Prc_Half 0.00 127.5 FORMAT "%5.1" NUMBER 3 /end CHARACTERISTIC
/begin CHARACTERISTIC DDRCObsvr_Intl.DebStcLim49_CA "" VAL_BLK 0x804D8D53 ValA_Wu8 127.5 DDRCObsvr_Prc_Half 0.00 127.5 FORMAT "%5.1" NUMBER 3 /end CHARACTERISTIC
/begin CHARACTERISTIC DDRCObsvr_Intl.DebStcLim50_CA "" VAL_BLK 0x804D8D56 ValA_Wu8 127.5 DDRCObsvr_Prc_Half 0.00 127.5 FORMAT "%5.1" NUMBER 3 /end CHARACTERISTIC
/begin CHARACTERISTIC DDRCObsvr_Intl.DebStcLim51_CA "" VAL_BLK 0x804D8D59 ValA_Wu8 127.5 DDRCObsvr_Prc_Half 0.00 127.5 FORMAT "%5.1" NUMBER 3 /end CHARACTERISTIC
/begin CHARACTERISTIC DDRCObsvr_Intl.DebStcLim52_CA "" VAL_BLK 0x804D8D5C ValA_Wu8 127.5 DDRCObsvr_Prc_Half 0.00 127.5 FORMAT "%5.1" NUMBER 3 /end CHARACTERISTIC
/begin CHARACTERISTIC DDRCObsvr_Intl.DebStcLim53_CA "" VAL_BLK 0x804D8D5F ValA_Wu8 127.5 DDRCObsvr_Prc_Half 0.00 127.5 FORMAT "%5.1" NUMBER 3 /end CHARACTERISTIC
/begin CHARACTERISTIC DDRCObsvr_Intl.DebStcLim54_CA "" VAL_BLK 0x804D8D62 ValA_Wu8 127.5 DDRCObsvr_Prc_Half 0.00 127.5 FORMAT "%5.1" NUMBER 3 /end CHARACTERISTIC
/begin CHARACTERISTIC DDRCObsvr_Intl.DebStcLim55_CA "" VAL_BLK 0x804D8D65 ValA_Wu8 127.5 DDRCObsvr_Prc_Half 0.00 127.5 FORMAT "%5.1" NUMBER 3 /end CHARACTERISTIC
/begin CHARACTERISTIC DDRCObsvr_Intl.DebStcLim56_CA "" VAL_BLK 0x804D8D68 ValA_Wu8 127.5 DDRCObsvr_Prc_Half 0.00 127.5 FORMAT "%5.1" NUMBER 3 /end CHARACTERISTIC
/begin CHARACTERISTIC DDRCObsvr_Intl.DebStcLim57_CA "" VAL_BLK 0x804D8D6B ValA_Wu8 127.5 DDRCObsvr_Prc_Half 0.00 127.5 FORMAT "%5.1" NUMBER 3 /end CHARACTERISTIC
/begin CHARACTERISTIC DDRCObsvr_Intl.DebStcLim58_CA "" VAL_BLK 0x804D8D6E ValA_Wu8 127.5 DDRCObsvr_Prc_Half 0.00 127.5 FORMAT "%5.1" NUMBER 3 /end CHARACTERISTIC
/begin CHARACTERISTIC DDRCObsvr_Intl.DebStcLim59_CA "" VAL_BLK 0x804D8D71 ValA_Wu8 127.5 DDRCObsvr_Prc_Half 0.00 127.5 FORMAT "%5.1" NUMBER 3 /end CHARACTERISTIC
/begin CHARACTERISTIC DDRCObsvr_Intl.DebStcLim60_CA "" VAL_BLK 0x804D8D74 ValA_Wu8 127.5 DDRCObsvr_Prc_Half 0.00 127.5 FORMAT "%5.1" NUMBER 3 /end CHARACTERISTIC
/begin CHARACTERISTIC DDRCObsvr_Intl.DebStcLim61_CA "" VAL_BLK 0x804D8D77 ValA_Wu8 127.5 DDRCObsvr_Prc_Half 0.00 127.5 FORMAT "%5.1" NUMBER 3 /end CHARACTERISTIC
/begin CHARACTERISTIC DDRCObsvr_Intl.DebStcLim62_CA "" VAL_BLK 0x804D8D7A ValA_Wu8 127.5 DDRCObsvr_Prc_Half 0.00 127.5 FORMAT "%5.1" NUMBER 3 /end CHARACTERISTIC
/begin CHARACTERISTIC DDRCObsvr_Intl.DebStcLim63_CA "" VAL_BLK 0x804D8D7D ValA_Wu8 127.5 DDRCObsvr_Prc_Half 0.00 127.5 FORMAT "%5.1" NUMBER 3 /end CHARACTERISTIC
/begin CHARACTERISTIC DDRCObsvr_Intl.DebStcLim64_CA "" VAL_BLK 0x804D8D80 ValA_Wu8 127.5 DDRCObsvr_Prc_Half 0.00 127.5 FORMAT "%5.1" NUMBER 3 /end CHARACTERISTIC
/begin CHARACTERISTIC DDRCObsvr_Intl.DebStcLim65_CA "" VAL_BLK 0x804D8D83 ValA_Wu8 127.5 DDRCObsvr_Prc_Half 0.00 127.5 FORMAT "%5.1" NUMBER 3 /end CHARACTERISTIC
/begin CHARACTERISTIC DDRCObsvr_Intl.DebStcLim66_CA "" VAL_BLK 0x804D8D86 ValA_Wu8 127.5 DDRCObsvr_Prc_Half 0.00 127.5 FORMAT "%5.1" NUMBER 3 /end CHARACTERISTIC
/begin CHARACTERISTIC DDRCObsvr_Intl.DebStcLim67_CA "" VAL_BLK 0x804D8D89 ValA_Wu8 127.5 DDRCObsvr_Prc_Half 0.00 127.5 FORMAT "%5.1" NUMBER 3 /end CHARACTERISTIC
/begin CHARACTERISTIC DDRCObsvr_Intl.DebStcLim68_CA "" VAL_BLK 0x804D8D8C ValA_Wu8 127.5 DDRCObsvr_Prc_Half 0.00 127.5 FORMAT "%5.1" NUMBER 3 /end CHARACTERISTIC
/begin CHARACTERISTIC DDRCObsvr_Intl.DebStcLim69_CA "" VAL_BLK 0x804D8D8F ValA_Wu8 127.5 DDRCObsvr_Prc_Half 0.00 127.5 FORMAT "%5.1" NUMBER 3 /end CHARACTERISTIC
/begin CHARACTERISTIC DDRCObsvr_Intl.DebStcLim70_CA "" VAL_BLK 0x804D8D92 ValA_Wu8 127.5 DDRCObsvr_Prc_Half 0.00 127.5 FORMAT "%5.1" NUMBER 3 /end CHARACTERISTIC
/begin CHARACTERISTIC DDRCObsvr_Intl.DebStcLim71_CA "" VAL_BLK 0x804D8D95 ValA_Wu8 127.5 DDRCObsvr_Prc_Half 0.00 127.5 FORMAT "%5.1" NUMBER 3 /end CHARACTERISTIC
/begin CHARACTERISTIC DDRCObsvr_Intl.DebStcLim72_CA "" VAL_BLK 0x804D8D98 ValA_Wu8 127.5 DDRCObsvr_Prc_Half 0.00 127.5 FORMAT "%5.1" NUMBER 3 /end CHARACTERISTIC
/begin CHARACTERISTIC DDRCObsvr_Intl.DebStcLim73_CA "" VAL_BLK 0x804D8D9B ValA_Wu8 127.5 DDRCObsvr_Prc_Half 0.00 127.5 FORMAT "%5.1" NUMBER 3 /end CHARACTERISTIC
/begin CHARACTERISTIC DDRCObsvr_Intl.DebStcLim74_CA "" VAL_BLK 0x804D8D9E ValA_Wu8 127.5 DDRCObsvr_Prc_Half 0.00 127.5 FORMAT "%5.1" NUMBER 3 /end CHARACTERISTIC
/begin CHARACTERISTIC DDRCObsvr_Intl.DebStcLim75_CA "" VAL_BLK 0x804D8DA1 ValA_Wu8 127.5 DDRCObsvr_Prc_Half 0.00 127.5 FORMAT "%5.1" NUMBER 3 /end CHARACTERISTIC
/begin CHARACTERISTIC DDRCObsvr_Intl.DebStcLim76_CA "" VAL_BLK 0x804D8DA4 ValA_Wu8 127.5 DDRCObsvr_Prc_Half 0.00 127.5 FORMAT "%5.1" NUMBER 3 /end CHARACTERISTIC
/begin CHARACTERISTIC DDRCObsvr_Intl.DebStcLim77_CA "" VAL_BLK 0x804D8DA7 ValA_Wu8 127.5 DDRCObsvr_Prc_Half 0.00 127.5 FORMAT "%5.1" NUMBER 3 /end CHARACTERISTIC
/begin CHARACTERISTIC DDRCObsvr_Intl.DebStcLim78_CA "" VAL_BLK 0x804D8DAA ValA_Wu8 127.5 DDRCObsvr_Prc_Half 0.00 127.5 FORMAT "%5.1" NUMBER 3 /end CHARACTERISTIC
/begin CHARACTERISTIC DDRCObsvr_Intl.DebStcLim79_CA "" VAL_BLK 0x804D8DAD ValA_Wu8 127.5 DDRCObsvr_Prc_Half 0.00 127.5 FORMAT "%5.1" NUMBER 3 /end CHARACTERISTIC
/begin CHARACTERISTIC DDRCObsvr_Intl.DebStcLim80_CA "" VAL_BLK 0x804D8DB0 ValA_Wu8 127.5 DDRCObsvr_Prc_Half 0.00 127.5 FORMAT "%5.1" NUMBER 3 /end CHARACTERISTIC
/begin CHARACTERISTIC DDRCObsvr_Intl.DebStcLim81_CA "" VAL_BLK 0x804D8DB3 ValA_Wu8 127.5 DDRCObsvr_Prc_Half 0.00 127.5 FORMAT "%5.1" NUMBER 3 /end CHARACTERISTIC
/begin CHARACTERISTIC DDRCObsvr_Intl.DebStcLim82_CA "" VAL_BLK 0x804D8DB6 ValA_Wu8 127.5 DDRCObsvr_Prc_Half 0.00 127.5 FORMAT "%5.1" NUMBER 3 /end CHARACTERISTIC
/begin CHARACTERISTIC DDRCObsvr_Intl.DebStcLim83_CA "" VAL_BLK 0x804D8DB9 ValA_Wu8 127.5 DDRCObsvr_Prc_Half 0.00 127.5 FORMAT "%5.1" NUMBER 3 /end CHARACTERISTIC
/begin CHARACTERISTIC DDRCObsvr_Intl.DebStcLim84_CA "" VAL_BLK 0x804D8DBC ValA_Wu8 127.5 DDRCObsvr_Prc_Half 0.00 127.5 FORMAT "%5.1" NUMBER 3 /end CHARACTERISTIC
/begin CHARACTERISTIC DDRCObsvr_Intl.DebStcLim85_CA "" VAL_BLK 0x804D8DBF ValA_Wu8 127.5 DDRCObsvr_Prc_Half 0.00 127.5 FORMAT "%5.1" NUMBER 3 /end CHARACTERISTIC
/begin CHARACTERISTIC DDRCObsvr_Intl.DebStcLim86_CA "" VAL_BLK 0x804D8DC2 ValA_Wu8 127.5 DDRCObsvr_Prc_Half 0.00 127.5 FORMAT "%5.1" NUMBER 3 /end CHARACTERISTIC
/begin CHARACTERISTIC DDRCObsvr_Intl.DebStcLim87_CA "" VAL_BLK 0x804D8DC5 ValA_Wu8 127.5 DDRCObsvr_Prc_Half 0.00 127.5 FORMAT "%5.1" NUMBER 3 /end CHARACTERISTIC
/begin CHARACTERISTIC DDRCObsvr_Intl.DebStcLim88_CA "" VAL_BLK 0x804D8DC8 ValA_Wu8 127.5 DDRCObsvr_Prc_Half 0.00 127.5 FORMAT "%5.1" NUMBER 3 /end CHARACTERISTIC
/begin CHARACTERISTIC DDRCObsvr_Intl.DebStcLim89_CA "" VAL_BLK 0x804D8DCB ValA_Wu8 127.5 DDRCObsvr_Prc_Half 0.00 127.5 FORMAT "%5.1" NUMBER 3 /end CHARACTERISTIC
/begin CHARACTERISTIC DDRCObsvr_Intl.DebStcLim90_CA "" VAL_BLK 0x804D8DCE ValA_Wu8 127.5 DDRCObsvr_Prc_Half 0.00 127.5 FORMAT "%5.1" NUMBER 3 /end CHARACTERISTIC
/begin CHARACTERISTIC DDRCObsvr_Intl.DebStcLim91_CA "" VAL_BLK 0x804D8DD1 ValA_Wu8 127.5 DDRCObsvr_Prc_Half 0.00 127.5 FORMAT "%5.1" NUMBER 3 /end CHARACTERISTIC
/begin CHARACTERISTIC DDRCObsvr_Intl.DebStcLim92_CA "" VAL_BLK 0x804D8DD4 ValA_Wu8 127.5 DDRCObsvr_Prc_Half 0.00 127.5 FORMAT "%5.1" NUMBER 3 /end CHARACTERISTIC
/begin CHARACTERISTIC DDRCObsvr_Intl.DebStcLim93_CA "" VAL_BLK 0x804D8DD7 ValA_Wu8 127.5 DDRCObsvr_Prc_Half 0.00 127.5 FORMAT "%5.1" NUMBER 3 /end CHARACTERISTIC
/begin CHARACTERISTIC DDRCObsvr_Intl.DebStcLim94_CA "" VAL_BLK 0x804D8DDA ValA_Wu8 127.5 DDRCObsvr_Prc_Half 0.00 127.5 FORMAT "%5.1" NUMBER 3 /end CHARACTERISTIC
/begin CHARACTERISTIC DDRCObsvr_Intl.DebStcLim95_CA "" VAL_BLK 0x804D8DDD ValA_Wu8 127.5 DDRCObsvr_Prc_Half 0.00 127.5 FORMAT "%5.1" NUMBER 3 /end CHARACTERISTIC
/begin CHARACTERISTIC DDRCObsvr_Intl.DebStcLim96_CA "" VAL_BLK 0x804D8DE0 ValA_Wu8 127.5 DDRCObsvr_Prc_Half 0.00 127.5 FORMAT "%5.1" NUMBER 3 /end CHARACTERISTIC
/begin CHARACTERISTIC DDRCObsvr_Intl.DebStcLim97_CA "" VAL_BLK 0x804D8DE3 ValA_Wu8 127.5 DDRCObsvr_Prc_Half 0.00 127.5 FORMAT "%5.1" NUMBER 3 /end CHARACTERISTIC
/begin CHARACTERISTIC DDRCObsvr_Intl.DebStcLim98_CA "" VAL_BLK 0x804D8DE6 ValA_Wu8 127.5 DDRCObsvr_Prc_Half 0.00 127.5 FORMAT "%5.1" NUMBER 3 /end CHARACTERISTIC
/begin CHARACTERISTIC DDRCObsvr_Intl.DebStcLim99_CA "" VAL_BLK 0x804D8DE9 ValA_Wu8 127.5 DDRCObsvr_Prc_Half 0.00 127.5 FORMAT "%5.1" NUMBER 3 /end CHARACTERISTIC
/begin CHARACTERISTIC DDRCObsvr_Intl.DebStcLim100_CA "" VAL_BLK 0x804D8DEC ValA_Wu8 127.5 DDRCObsvr_Prc_Half 0.00 127.5 FORMAT "%5.1" NUMBER 3 /end CHARACTERISTIC
/begin CHARACTERISTIC DDRCObsvr_Intl.DebStcLim101_CA "" VAL_BLK 0x804D8DEF ValA_Wu8 127.5 DDRCObsvr_Prc_Half 0.00 127.5 FORMAT "%5.1" NUMBER 3 /end CHARACTERISTIC
/begin CHARACTERISTIC DDRCObsvr_Intl.DebStcLim102_CA "" VAL_BLK 0x804D8DF2 ValA_Wu8 127.5 DDRCObsvr_Prc_Half 0.00 127.5 FORMAT "%5.1" NUMBER 3 /end CHARACTERISTIC
/begin CHARACTERISTIC DDRCObsvr_Intl.DebStcLim103_CA "" VAL_BLK 0x804D8DF5 ValA_Wu8 127.5 DDRCObsvr_Prc_Half 0.00 127.5 FORMAT "%5.1" NUMBER 3 /end CHARACTERISTIC
/begin CHARACTERISTIC DDRCObsvr_Intl.DebStcLim104_CA "" VAL_BLK 0x804D8DF8 ValA_Wu8 127.5 DDRCObsvr_Prc_Half 0.00 127.5 FORMAT "%5.1" NUMBER 3 /end CHARACTERISTIC
/begin CHARACTERISTIC DDRCObsvr_Intl.DebStcLim105_CA "" VAL_BLK 0x804D8DFB ValA_Wu8 127.5 DDRCObsvr_Prc_Half 0.00 127.5 FORMAT "%5.1" NUMBER 3 /end CHARACTERISTIC
/begin CHARACTERISTIC DDRCObsvr_Intl.DebStcLim106_CA "" VAL_BLK 0x804D8DFE ValA_Wu8 127.5 DDRCObsvr_Prc_Half 0.00 127.5 FORMAT "%5.1" NUMBER 3 /end CHARACTERISTIC
/begin CHARACTERISTIC DDRCObsvr_Intl.DebStcLim107_CA "" VAL_BLK 0x804D8E01 ValA_Wu8 127.5 DDRCObsvr_Prc_Half 0.00 127.5 FORMAT "%5.1" NUMBER 3 /end CHARACTERISTIC
/begin CHARACTERISTIC DDRCObsvr_Intl.DebStcLim108_CA "" VAL_BLK 0x804D8E04 ValA_Wu8 127.5 DDRCObsvr_Prc_Half 0.00 127.5 FORMAT "%5.1" NUMBER 3 /end CHARACTERISTIC
/begin CHARACTERISTIC DDRCObsvr_Intl.DebStcLim109_CA "" VAL_BLK 0x804D8E07 ValA_Wu8 127.5 DDRCObsvr_Prc_Half 0.00 127.5 FORMAT "%5.1" NUMBER 3 /end CHARACTERISTIC
/begin CHARACTERISTIC DDRCObsvr_Intl.DebStcLim110_CA "" VAL_BLK 0x804D8E0A ValA_Wu8 127.5 DDRCObsvr_Prc_Half 0.00 127.5 FORMAT "%5.1" NUMBER 3 /end CHARACTERISTIC
/begin CHARACTERISTIC DDRCObsvr_Intl.DebStcLim111_CA "" VAL_BLK 0x804D8E0D ValA_Wu8 127.5 DDRCObsvr_Prc_Half 0.00 127.5 FORMAT "%5.1" NUMBER 3 /end CHARACTERISTIC
/begin CHARACTERISTIC DDRCObsvr_Intl.DebStcLim112_CA "" VAL_BLK 0x804D8E10 ValA_Wu8 127.5 DDRCObsvr_Prc_Half 0.00 127.5 FORMAT "%5.1" NUMBER 3 /end CHARACTERISTIC
/begin CHARACTERISTIC DDRCObsvr_Intl.DebStcLim113_CA "" VAL_BLK 0x804D8E13 ValA_Wu8 127.5 DDRCObsvr_Prc_Half 0.00 127.5 FORMAT "%5.1" NUMBER 3 /end CHARACTERISTIC
/begin CHARACTERISTIC DDRCObsvr_Intl.DebStcLim114_CA "" VAL_BLK 0x804D8E16 ValA_Wu8 127.5 DDRCObsvr_Prc_Half 0.00 127.5 FORMAT "%5.1" NUMBER 3 /end CHARACTERISTIC
/begin CHARACTERISTIC DDRCObsvr_Intl.DebStcLim115_CA "" VAL_BLK 0x804D8E19 ValA_Wu8 127.5 DDRCObsvr_Prc_Half 0.00 127.5 FORMAT "%5.1" NUMBER 3 /end CHARACTERISTIC
/begin CHARACTERISTIC DDRCObsvr_Intl.DebStcLim116_CA "" VAL_BLK 0x804D8E1C ValA_Wu8 127.5 DDRCObsvr_Prc_Half 0.00 127.5 FORMAT "%5.1" NUMBER 3 /end CHARACTERISTIC
/begin CHARACTERISTIC DDRCObsvr_Intl.DebStcLim117_CA "" VAL_BLK 0x804D8E1F ValA_Wu8 127.5 DDRCObsvr_Prc_Half 0.00 127.5 FORMAT "%5.1" NUMBER 3 /end CHARACTERISTIC
/begin CHARACTERISTIC DDRCObsvr_Intl.DebStcLim118_CA "" VAL_BLK 0x804D8E22 ValA_Wu8 127.5 DDRCObsvr_Prc_Half 0.00 127.5 FORMAT "%5.1" NUMBER 3 /end CHARACTERISTIC
/begin CHARACTERISTIC DDRCObsvr_Intl.DebStcLim119_CA "" VAL_BLK 0x804D8E25 ValA_Wu8 127.5 DDRCObsvr_Prc_Half 0.00 127.5 FORMAT "%5.1" NUMBER 3 /end CHARACTERISTIC
/begin CHARACTERISTIC DDRCObsvr_Intl.DebStcLim120_CA "" VAL_BLK 0x804D8E28 ValA_Wu8 127.5 DDRCObsvr_Prc_Half 0.00 127.5 FORMAT "%5.1" NUMBER 3 /end CHARACTERISTIC
/begin CHARACTERISTIC DDRCObsvr_Intl.DebStcLim121_CA "" VAL_BLK 0x804D8E2B ValA_Wu8 127.5 DDRCObsvr_Prc_Half 0.00 127.5 FORMAT "%5.1" NUMBER 3 /end CHARACTERISTIC
/begin CHARACTERISTIC DDRCObsvr_Intl.DebStcLim122_CA "" VAL_BLK 0x804D8E2E ValA_Wu8 127.5 DDRCObsvr_Prc_Half 0.00 127.5 FORMAT "%5.1" NUMBER 3 /end CHARACTERISTIC
/begin CHARACTERISTIC DDRCObsvr_Intl.DebStcLim123_CA "" VAL_BLK 0x804D8E31 ValA_Wu8 127.5 DDRCObsvr_Prc_Half 0.00 127.5 FORMAT "%5.1" NUMBER 3 /end CHARACTERISTIC
/begin CHARACTERISTIC DDRCObsvr_Intl.DebStcLim124_CA "" VAL_BLK 0x804D8E34 ValA_Wu8 127.5 DDRCObsvr_Prc_Half 0.00 127.5 FORMAT "%5.1" NUMBER 3 /end CHARACTERISTIC
/begin CHARACTERISTIC DDRCObsvr_Intl.DebStcLim125_CA "" VAL_BLK 0x804D8E37 ValA_Wu8 127.5 DDRCObsvr_Prc_Half 0.00 127.5 FORMAT "%5.1" NUMBER 3 /end CHARACTERISTIC
/begin CHARACTERISTIC DDRCObsvr_Intl.DebStcLim126_CA "" VAL_BLK 0x804D8E3A ValA_Wu8 127.5 DDRCObsvr_Prc_Half 0.00 127.5 FORMAT "%5.1" NUMBER 3 /end CHARACTERISTIC
/begin CHARACTERISTIC DDRCObsvr_Intl.DebStcLim127_CA "" VAL_BLK 0x804D8E3D ValA_Wu8 127.5 DDRCObsvr_Prc_Half 0.00 127.5 FORMAT "%5.1" NUMBER 3 /end CHARACTERISTIC
/begin CHARACTERISTIC DDRCObsvr_Intl.DebStcLim128_CA "" VAL_BLK 0x804D8E40 ValA_Wu8 127.5 DDRCObsvr_Prc_Half 0.00 127.5 FORMAT "%5.1" NUMBER 3 /end CHARACTERISTIC
/begin CHARACTERISTIC DDRCObsvr_Intl.DebStcLim129_CA "" VAL_BLK 0x804D8E43 ValA_Wu8 127.5 DDRCObsvr_Prc_Half 0.00 127.5 FORMAT "%5.1" NUMBER 3 /end CHARACTERISTIC
/begin CHARACTERISTIC DDRCObsvr_Intl.DebStcLim130_CA "" VAL_BLK 0x804D8E46 ValA_Wu8 127.5 DDRCObsvr_Prc_Half 0.00 127.5 FORMAT "%5.1" NUMBER 3 /end CHARACTERISTIC
/begin CHARACTERISTIC DDRCObsvr_Intl.DebStcLim131_CA "" VAL_BLK 0x804D8E49 ValA_Wu8 127.5 DDRCObsvr_Prc_Half 0.00 127.5 FORMAT "%5.1" NUMBER 3 /end CHARACTERISTIC
/begin CHARACTERISTIC DDRCObsvr_Intl.DebStcLim132_CA "" VAL_BLK 0x804D8E4C ValA_Wu8 127.5 DDRCObsvr_Prc_Half 0.00 127.5 FORMAT "%5.1" NUMBER 3 /end CHARACTERISTIC
/begin CHARACTERISTIC DDRCObsvr_Intl.DebStcLim133_CA "" VAL_BLK 0x804D8E4F ValA_Wu8 127.5 DDRCObsvr_Prc_Half 0.00 127.5 FORMAT "%5.1" NUMBER 3 /end CHARACTERISTIC
/begin CHARACTERISTIC DDRCObsvr_Intl.DebStcLim134_CA "" VAL_BLK 0x804D8E52 ValA_Wu8 127.5 DDRCObsvr_Prc_Half 0.00 127.5 FORMAT "%5.1" NUMBER 3 /end CHARACTERISTIC
/begin CHARACTERISTIC DDRCObsvr_Intl.DebStcLim135_CA "" VAL_BLK 0x804D8E55 ValA_Wu8 127.5 DDRCObsvr_Prc_Half 0.00 127.5 FORMAT "%5.1" NUMBER 3 /end CHARACTERISTIC
/begin CHARACTERISTIC DDRCObsvr_Intl.DebStcLim136_CA "" VAL_BLK 0x804D8E58 ValA_Wu8 127.5 DDRCObsvr_Prc_Half 0.00 127.5 FORMAT "%5.1" NUMBER 3 /end CHARACTERISTIC
/begin CHARACTERISTIC DDRCObsvr_Intl.DebStcLim137_CA "" VAL_BLK 0x804D8E5B ValA_Wu8 127.5 DDRCObsvr_Prc_Half 0.00 127.5 FORMAT "%5.1" NUMBER 3 /end CHARACTERISTIC
/begin CHARACTERISTIC DDRCObsvr_Intl.DebStcLim138_CA "" VAL_BLK 0x804D8E5E ValA_Wu8 127.5 DDRCObsvr_Prc_Half 0.00 127.5 FORMAT "%5.1" NUMBER 3 /end CHARACTERISTIC
/begin CHARACTERISTIC DDRCObsvr_Intl.DebStcLim139_CA "" VAL_BLK 0x804D8E61 ValA_Wu8 127.5 DDRCObsvr_Prc_Half 0.00 127.5 FORMAT "%5.1" NUMBER 3 /end CHARACTERISTIC
/begin CHARACTERISTIC DDRCObsvr_Intl.DebStcLim140_CA "" VAL_BLK 0x804D8E64 ValA_Wu8 127.5 DDRCObsvr_Prc_Half 0.00 127.5 FORMAT "%5.1" NUMBER 3 /end CHARACTERISTIC
/begin CHARACTERISTIC DDRCObsvr_Intl.DebStcLim141_CA "" VAL_BLK 0x804D8E67 ValA_Wu8 127.5 DDRCObsvr_Prc_Half 0.00 127.5 FORMAT "%5.1" NUMBER 3 /end CHARACTERISTIC
/begin CHARACTERISTIC DDRCObsvr_Intl.DebStcLim142_CA "" VAL_BLK 0x804D8E6A ValA_Wu8 127.5 DDRCObsvr_Prc_Half 0.00 127.5 FORMAT "%5.1" NUMBER 3 /end CHARACTERISTIC
/begin CHARACTERISTIC DDRCObsvr_Intl.DebStcLim143_CA "" VAL_BLK 0x804D8E6D ValA_Wu8 127.5 DDRCObsvr_Prc_Half 0.00 127.5 FORMAT "%5.1" NUMBER 3 /end CHARACTERISTIC
/begin CHARACTERISTIC DDRCObsvr_Intl.DebStcLim144_CA "" VAL_BLK 0x804D8E70 ValA_Wu8 127.5 DDRCObsvr_Prc_Half 0.00 127.5 FORMAT "%5.1" NUMBER 3 /end CHARACTERISTIC
/begin CHARACTERISTIC DDRCObsvr_Intl.DebStcLim145_CA "" VAL_BLK 0x804D8E73 ValA_Wu8 127.5 DDRCObsvr_Prc_Half 0.00 127.5 FORMAT "%5.1" NUMBER 3 /end CHARACTERISTIC
/begin CHARACTERISTIC DDRCObsvr_Intl.DebStcLim146_CA "" VAL_BLK 0x804D8E76 ValA_Wu8 127.5 DDRCObsvr_Prc_Half 0.00 127.5 FORMAT "%5.1" NUMBER 3 /end CHARACTERISTIC
/begin CHARACTERISTIC DDRCObsvr_Intl.DebStcLim147_CA "" VAL_BLK 0x804D8E79 ValA_Wu8 127.5 DDRCObsvr_Prc_Half 0.00 127.5 FORMAT "%5.1" NUMBER 3 /end CHARACTERISTIC
/begin CHARACTERISTIC DDRCObsvr_Intl.DebStcLim148_CA "" VAL_BLK 0x804D8E7C ValA_Wu8 127.5 DDRCObsvr_Prc_Half 0.00 127.5 FORMAT "%5.1" NUMBER 3 /end CHARACTERISTIC
/begin CHARACTERISTIC DDRCObsvr_Intl.DebStcLim149_CA "" VAL_BLK 0x804D8E7F ValA_Wu8 127.5 DDRCObsvr_Prc_Half 0.00 127.5 FORMAT "%5.1" NUMBER 3 /end CHARACTERISTIC
/begin CHARACTERISTIC DDRCObsvr_Intl.DebStcLim150_CA "" VAL_BLK 0x804D8E82 ValA_Wu8 127.5 DDRCObsvr_Prc_Half 0.00 127.5 FORMAT "%5.1" NUMBER 3 /end CHARACTERISTIC
/begin CHARACTERISTIC DDRCObsvr_Intl.DebStcLim151_CA "" VAL_BLK 0x804D8E85 ValA_Wu8 127.5 DDRCObsvr_Prc_Half 0.00 127.5 FORMAT "%5.1" NUMBER 3 /end CHARACTERISTIC
/begin CHARACTERISTIC DDRCObsvr_Intl.DebStcLim152_CA "" VAL_BLK 0x804D8E88 ValA_Wu8 127.5 DDRCObsvr_Prc_Half 0.00 127.5 FORMAT "%5.1" NUMBER 3 /end CHARACTERISTIC
/begin CHARACTERISTIC DDRCObsvr_Intl.DebStcLim153_CA "" VAL_BLK 0x804D8E8B ValA_Wu8 127.5 DDRCObsvr_Prc_Half 0.00 127.5 FORMAT "%5.1" NUMBER 3 /end CHARACTERISTIC
/begin CHARACTERISTIC DDRCObsvr_Intl.DebStcLim154_CA "" VAL_BLK 0x804D8E8E ValA_Wu8 127.5 DDRCObsvr_Prc_Half 0.00 127.5 FORMAT "%5.1" NUMBER 3 /end CHARACTERISTIC
/begin CHARACTERISTIC DDRCObsvr_Intl.DebStcLim155_CA "" VAL_BLK 0x804D8E91 ValA_Wu8 127.5 DDRCObsvr_Prc_Half 0.00 127.5 FORMAT "%5.1" NUMBER 3 /end CHARACTERISTIC
/begin CHARACTERISTIC DDRCObsvr_Intl.DebStcLim156_CA "" VAL_BLK 0x804D8E94 ValA_Wu8 127.5 DDRCObsvr_Prc_Half 0.00 127.5 FORMAT "%5.1" NUMBER 3 /end CHARACTERISTIC
/begin CHARACTERISTIC DDRCObsvr_Intl.DebStcLim157_CA "" VAL_BLK 0x804D8E97 ValA_Wu8 127.5 DDRCObsvr_Prc_Half 0.00 127.5 FORMAT "%5.1" NUMBER 3 /end CHARACTERISTIC
/begin CHARACTERISTIC DDRCObsvr_Intl.DebStcLim158_CA "" VAL_BLK 0x804D8E9A ValA_Wu8 127.5 DDRCObsvr_Prc_Half 0.00 127.5 FORMAT "%5.1" NUMBER 3 /end CHARACTERISTIC
/begin CHARACTERISTIC DDRCObsvr_Intl.DebStcLim159_CA "" VAL_BLK 0x804D8E9D ValA_Wu8 127.5 DDRCObsvr_Prc_Half 0.00 127.5 FORMAT "%5.1" NUMBER 3 /end CHARACTERISTIC
/begin CHARACTERISTIC DDRCObsvr_Intl.DebStcLim160_CA "" VAL_BLK 0x804D8EA0 ValA_Wu8 127.5 DDRCObsvr_Prc_Half 0.00 127.5 FORMAT "%5.1" NUMBER 3 /end CHARACTERISTIC
/begin CHARACTERISTIC DDRCObsvr_Intl.DebStcLim161_CA "" VAL_BLK 0x804D8EA3 ValA_Wu8 127.5 DDRCObsvr_Prc_Half 0.00 127.5 FORMAT "%5.1" NUMBER 3 /end CHARACTERISTIC
/begin CHARACTERISTIC DDRCObsvr_Intl.DebStcLim162_CA "" VAL_BLK 0x804D8EA6 ValA_Wu8 127.5 DDRCObsvr_Prc_Half 0.00 127.5 FORMAT "%5.1" NUMBER 3 /end CHARACTERISTIC
/begin CHARACTERISTIC DDRCObsvr_Intl.DebStcLim163_CA "" VAL_BLK 0x804D8EA9 ValA_Wu8 127.5 DDRCObsvr_Prc_Half 0.00 127.5 FORMAT "%5.1" NUMBER 3 /end CHARACTERISTIC
/begin CHARACTERISTIC DDRCObsvr_Intl.DebStcLim164_CA "" VAL_BLK 0x804D8EAC ValA_Wu8 127.5 DDRCObsvr_Prc_Half 0.00 127.5 FORMAT "%5.1" NUMBER 3 /end CHARACTERISTIC
/begin CHARACTERISTIC DDRCObsvr_Intl.DebStcLim165_CA "" VAL_BLK 0x804D8EAF ValA_Wu8 127.5 DDRCObsvr_Prc_Half 0.00 127.5 FORMAT "%5.1" NUMBER 3 /end CHARACTERISTIC
/begin CHARACTERISTIC DDRCObsvr_Intl.DebStcLim166_CA "" VAL_BLK 0x804D8EB2 ValA_Wu8 127.5 DDRCObsvr_Prc_Half 0.00 127.5 FORMAT "%5.1" NUMBER 3 /end CHARACTERISTIC
/begin CHARACTERISTIC DDRCObsvr_Intl.DebStcLim167_CA "" VAL_BLK 0x804D8EB5 ValA_Wu8 127.5 DDRCObsvr_Prc_Half 0.00 127.5 FORMAT "%5.1" NUMBER 3 /end CHARACTERISTIC
/begin CHARACTERISTIC DDRCObsvr_Intl.DebStcLim168_CA "" VAL_BLK 0x804D8EB8 ValA_Wu8 127.5 DDRCObsvr_Prc_Half 0.00 127.5 FORMAT "%5.1" NUMBER 3 /end CHARACTERISTIC
/begin CHARACTERISTIC DDRCObsvr_Intl.DebStcLim169_CA "" VAL_BLK 0x804D8EBB ValA_Wu8 127.5 DDRCObsvr_Prc_Half 0.00 127.5 FORMAT "%5.1" NUMBER 3 /end CHARACTERISTIC
/begin CHARACTERISTIC DDRCObsvr_Intl.DebStcLim170_CA "" VAL_BLK 0x804D8EBE ValA_Wu8 127.5 DDRCObsvr_Prc_Half 0.00 127.5 FORMAT "%5.1" NUMBER 3 /end CHARACTERISTIC
/begin CHARACTERISTIC DDRCObsvr_Intl.DebStcLim171_CA "" VAL_BLK 0x804D8EC1 ValA_Wu8 127.5 DDRCObsvr_Prc_Half 0.00 127.5 FORMAT "%5.1" NUMBER 3 /end CHARACTERISTIC
/begin CHARACTERISTIC DDRCObsvr_Intl.DebStcLim172_CA "" VAL_BLK 0x804D8EC4 ValA_Wu8 127.5 DDRCObsvr_Prc_Half 0.00 127.5 FORMAT "%5.1" NUMBER 3 /end CHARACTERISTIC
/begin CHARACTERISTIC DDRCObsvr_Intl.DebStcLim173_CA "" VAL_BLK 0x804D8EC7 ValA_Wu8 127.5 DDRCObsvr_Prc_Half 0.00 127.5 FORMAT "%5.1" NUMBER 3 /end CHARACTERISTIC
/begin CHARACTERISTIC DDRCObsvr_Intl.DebStcLim174_CA "" VAL_BLK 0x804D8ECA ValA_Wu8 127.5 DDRCObsvr_Prc_Half 0.00 127.5 FORMAT "%5.1" NUMBER 3 /end CHARACTERISTIC
/begin CHARACTERISTIC DDRCObsvr_Intl.DebStcLim175_CA "" VAL_BLK 0x804D8ECD ValA_Wu8 127.5 DDRCObsvr_Prc_Half 0.00 127.5 FORMAT "%5.1" NUMBER 3 /end CHARACTERISTIC
/begin CHARACTERISTIC DDRCObsvr_Intl.DebStcLim176_CA "" VAL_BLK 0x804D8ED0 ValA_Wu8 127.5 DDRCObsvr_Prc_Half 0.00 127.5 FORMAT "%5.1" NUMBER 3 /end CHARACTERISTIC
/begin CHARACTERISTIC DDRCObsvr_Intl.DebStcLim177_CA "" VAL_BLK 0x804D8ED3 ValA_Wu8 127.5 DDRCObsvr_Prc_Half 0.00 127.5 FORMAT "%5.1" NUMBER 3 /end CHARACTERISTIC
/begin CHARACTERISTIC DDRCObsvr_Intl.DebStcLim178_CA "" VAL_BLK 0x804D8ED6 ValA_Wu8 127.5 DDRCObsvr_Prc_Half 0.00 127.5 FORMAT "%5.1" NUMBER 3 /end CHARACTERISTIC
/begin CHARACTERISTIC DDRCObsvr_Intl.DebStcLim179_CA "" VAL_BLK 0x804D8ED9 ValA_Wu8 127.5 DDRCObsvr_Prc_Half 0.00 127.5 FORMAT "%5.1" NUMBER 3 /end CHARACTERISTIC
/begin CHARACTERISTIC DDRCObsvr_Intl.DebStcLim180_CA "" VAL_BLK 0x804D8EDC ValA_Wu8 127.5 DDRCObsvr_Prc_Half 0.00 127.5 FORMAT "%5.1" NUMBER 3 /end CHARACTERISTIC
/begin CHARACTERISTIC DDRCObsvr_Intl.DebStcLim181_CA "" VAL_BLK 0x804D8EDF ValA_Wu8 127.5 DDRCObsvr_Prc_Half 0.00 127.5 FORMAT "%5.1" NUMBER 3 /end CHARACTERISTIC
/begin CHARACTERISTIC DDRCObsvr_Intl.DebStcLim182_CA "" VAL_BLK 0x804D8EE2 ValA_Wu8 127.5 DDRCObsvr_Prc_Half 0.00 127.5 FORMAT "%5.1" NUMBER 3 /end CHARACTERISTIC
/begin CHARACTERISTIC DDRCObsvr_Intl.DebStcLim183_CA "" VAL_BLK 0x804D8EE5 ValA_Wu8 127.5 DDRCObsvr_Prc_Half 0.00 127.5 FORMAT "%5.1" NUMBER 3 /end CHARACTERISTIC
/begin CHARACTERISTIC DDRCObsvr_Intl.DebStcLim184_CA "" VAL_BLK 0x804D8EE8 ValA_Wu8 127.5 DDRCObsvr_Prc_Half 0.00 127.5 FORMAT "%5.1" NUMBER 3 /end CHARACTERISTIC
/begin CHARACTERISTIC DDRCObsvr_Intl.DebStcLim185_CA "" VAL_BLK 0x804D8EEB ValA_Wu8 127.5 DDRCObsvr_Prc_Half 0.00 127.5 FORMAT "%5.1" NUMBER 3 /end CHARACTERISTIC
/begin CHARACTERISTIC DDRCObsvr_Intl.DebStcLim186_CA "" VAL_BLK 0x804D8EEE ValA_Wu8 127.5 DDRCObsvr_Prc_Half 0.00 127.5 FORMAT "%5.1" NUMBER 3 /end CHARACTERISTIC
/begin CHARACTERISTIC DDRCObsvr_Intl.DebStcLim187_CA "" VAL_BLK 0x804D8EF1 ValA_Wu8 127.5 DDRCObsvr_Prc_Half 0.00 127.5 FORMAT "%5.1" NUMBER 3 /end CHARACTERISTIC
/begin CHARACTERISTIC DDRCObsvr_Intl.DebStcLim188_CA "" VAL_BLK 0x804D8EF4 ValA_Wu8 127.5 DDRCObsvr_Prc_Half 0.00 127.5 FORMAT "%5.1" NUMBER 3 /end CHARACTERISTIC
/begin CHARACTERISTIC DDRCObsvr_Intl.DebStcLim189_CA "" VAL_BLK 0x804D8EF7 ValA_Wu8 127.5 DDRCObsvr_Prc_Half 0.00 127.5 FORMAT "%5.1" NUMBER 3 /end CHARACTERISTIC
/begin CHARACTERISTIC DDRCObsvr_Intl.DebStcLim190_CA "" VAL_BLK 0x804D8EFA ValA_Wu8 127.5 DDRCObsvr_Prc_Half 0.00 127.5 FORMAT "%5.1" NUMBER 3 /end CHARACTERISTIC
/begin CHARACTERISTIC DDRCObsvr_Intl.DebStcLim191_CA "" VAL_BLK 0x804D8EFD ValA_Wu8 127.5 DDRCObsvr_Prc_Half 0.00 127.5 FORMAT "%5.1" NUMBER 3 /end CHARACTERISTIC
/begin CHARACTERISTIC DDRCObsvr_Intl.DebStcLim192_CA "" VAL_BLK 0x804D8F00 ValA_Wu8 127.5 DDRCObsvr_Prc_Half 0.00 127.5 FORMAT "%5.1" NUMBER 3 /end CHARACTERISTIC
/begin CHARACTERISTIC DDRCObsvr_Intl.DebStcLim193_CA "" VAL_BLK 0x804D8F03 ValA_Wu8 127.5 DDRCObsvr_Prc_Half 0.00 127.5 FORMAT "%5.1" NUMBER 3 /end CHARACTERISTIC
/begin CHARACTERISTIC DDRCObsvr_Intl.DebStcLim194_CA "" VAL_BLK 0x804D8F06 ValA_Wu8 127.5 DDRCObsvr_Prc_Half 0.00 127.5 FORMAT "%5.1" NUMBER 3 /end CHARACTERISTIC
/begin CHARACTERISTIC DDRCObsvr_Intl.DebStcLim195_CA "" VAL_BLK 0x804D8F09 ValA_Wu8 127.5 DDRCObsvr_Prc_Half 0.00 127.5 FORMAT "%5.1" NUMBER 3 /end CHARACTERISTIC
/begin CHARACTERISTIC DDRCObsvr_Intl.DebStcLim196_CA "" VAL_BLK 0x804D8F0C ValA_Wu8 127.5 DDRCObsvr_Prc_Half 0.00 127.5 FORMAT "%5.1" NUMBER 3 /end CHARACTERISTIC
/begin CHARACTERISTIC DDRCObsvr_Intl.DebStcLim197_CA "" VAL_BLK 0x804D8F0F ValA_Wu8 127.5 DDRCObsvr_Prc_Half 0.00 127.5 FORMAT "%5.1" NUMBER 3 /end CHARACTERISTIC
/begin CHARACTERISTIC DDRCObsvr_Intl.DebStcLim198_CA "" VAL_BLK 0x804D8F12 ValA_Wu8 127.5 DDRCObsvr_Prc_Half 0.00 127.5 FORMAT "%5.1" NUMBER 3 /end CHARACTERISTIC
/begin CHARACTERISTIC DDRCObsvr_Intl.DebStcLim199_CA "" VAL_BLK 0x804D8F15 ValA_Wu8 127.5 DDRCObsvr_Prc_Half 0.00 127.5 FORMAT "%5.1" NUMBER 3 /end CHARACTERISTIC
/begin CHARACTERISTIC DDRCObsvr_Intl.DebStcLim200_CA "" VAL_BLK 0x804D8F18 ValA_Wu8 127.5 DDRCObsvr_Prc_Half 0.00 127.5 FORMAT "%5.1" NUMBER 3 /end CHARACTERISTIC
/begin CHARACTERISTIC DDRCObsvr_Intl.DebStcLim201_CA "" VAL_BLK 0x804D8F1B ValA_Wu8 127.5 DDRCObsvr_Prc_Half 0.00 127.5 FORMAT "%5.1" NUMBER 3 /end CHARACTERISTIC
/begin CHARACTERISTIC DDRCObsvr_Intl.DebStcLim202_CA "" VAL_BLK 0x804D8F1E ValA_Wu8 127.5 DDRCObsvr_Prc_Half 0.00 127.5 FORMAT "%5.1" NUMBER 3 /end CHARACTERISTIC
/begin CHARACTERISTIC DDRCObsvr_Intl.DebStcLim203_CA "" VAL_BLK 0x804D8F21 ValA_Wu8 127.5 DDRCObsvr_Prc_Half 0.00 127.5 FORMAT "%5.1" NUMBER 3 /end CHARACTERISTIC
/begin CHARACTERISTIC DDRCObsvr_Intl.DebStcLim204_CA "" VAL_BLK 0x804D8F24 ValA_Wu8 127.5 DDRCObsvr_Prc_Half 0.00 127.5 FORMAT "%5.1" NUMBER 3 /end CHARACTERISTIC
/begin CHARACTERISTIC DDRCObsvr_Intl.DebStcLim205_CA "" VAL_BLK 0x804D8F27 ValA_Wu8 127.5 DDRCObsvr_Prc_Half 0.00 127.5 FORMAT "%5.1" NUMBER 3 /end CHARACTERISTIC
/begin CHARACTERISTIC DDRCObsvr_Intl.DebStcLim206_CA "" VAL_BLK 0x804D8F2A ValA_Wu8 127.5 DDRCObsvr_Prc_Half 0.00 127.5 FORMAT "%5.1" NUMBER 3 /end CHARACTERISTIC
/begin CHARACTERISTIC DDRCObsvr_Intl.DebStcLim207_CA "" VAL_BLK 0x804D8F2D ValA_Wu8 127.5 DDRCObsvr_Prc_Half 0.00 127.5 FORMAT "%5.1" NUMBER 3 /end CHARACTERISTIC
/begin CHARACTERISTIC DDRCObsvr_Intl.DebStcLim208_CA "" VAL_BLK 0x804D8F30 ValA_Wu8 127.5 DDRCObsvr_Prc_Half 0.00 127.5 FORMAT "%5.1" NUMBER 3 /end CHARACTERISTIC
/begin CHARACTERISTIC DDRCObsvr_Intl.DebStcLim209_CA "" VAL_BLK 0x804D8F33 ValA_Wu8 127.5 DDRCObsvr_Prc_Half 0.00 127.5 FORMAT "%5.1" NUMBER 3 /end CHARACTERISTIC
/begin CHARACTERISTIC DDRCObsvr_Intl.DebStcLim210_CA "" VAL_BLK 0x804D8F36 ValA_Wu8 127.5 DDRCObsvr_Prc_Half 0.00 127.5 FORMAT "%5.1" NUMBER 3 /end CHARACTERISTIC
/begin CHARACTERISTIC DDRCObsvr_Intl.DebStcLim211_CA "" VAL_BLK 0x804D8F39 ValA_Wu8 127.5 DDRCObsvr_Prc_Half 0.00 127.5 FORMAT "%5.1" NUMBER 3 /end CHARACTERISTIC
/begin CHARACTERISTIC DDRCObsvr_Intl.DebStcLim212_CA "" VAL_BLK 0x804D8F3C ValA_Wu8 127.5 DDRCObsvr_Prc_Half 0.00 127.5 FORMAT "%5.1" NUMBER 3 /end CHARACTERISTIC
/begin CHARACTERISTIC DDRCObsvr_Intl.DebStcLim213_CA "" VAL_BLK 0x804D8F3F ValA_Wu8 127.5 DDRCObsvr_Prc_Half 0.00 127.5 FORMAT "%5.1" NUMBER 3 /end CHARACTERISTIC
/begin CHARACTERISTIC DDRCObsvr_Intl.DebStcLim214_CA "" VAL_BLK 0x804D8F42 ValA_Wu8 127.5 DDRCObsvr_Prc_Half 0.00 127.5 FORMAT "%5.1" NUMBER 3 /end CHARACTERISTIC
/begin CHARACTERISTIC DDRCObsvr_Intl.DebStcLim215_CA "" VAL_BLK 0x804D8F45 ValA_Wu8 127.5 DDRCObsvr_Prc_Half 0.00 127.5 FORMAT "%5.1" NUMBER 3 /end CHARACTERISTIC
/begin CHARACTERISTIC DDRCObsvr_Intl.DebStcLim216_CA "" VAL_BLK 0x804D8F48 ValA_Wu8 127.5 DDRCObsvr_Prc_Half 0.00 127.5 FORMAT "%5.1" NUMBER 3 /end CHARACTERISTIC
/begin CHARACTERISTIC DDRCObsvr_Intl.DebStcLim217_CA "" VAL_BLK 0x804D8F4B ValA_Wu8 127.5 DDRCObsvr_Prc_Half 0.00 127.5 FORMAT "%5.1" NUMBER 3 /end CHARACTERISTIC
/begin CHARACTERISTIC DDRCObsvr_Intl.DebStcLim218_CA "" VAL_BLK 0x804D8F4E ValA_Wu8 127.5 DDRCObsvr_Prc_Half 0.00 127.5 FORMAT "%5.1" NUMBER 3 /end CHARACTERISTIC
/begin CHARACTERISTIC DDRCObsvr_Intl.DebStcLim219_CA "" VAL_BLK 0x804D8F51 ValA_Wu8 127.5 DDRCObsvr_Prc_Half 0.00 127.5 FORMAT "%5.1" NUMBER 3 /end CHARACTERISTIC
/begin CHARACTERISTIC DDRCObsvr_Intl.DebStcLim220_CA "" VAL_BLK 0x804D8F54 ValA_Wu8 127.5 DDRCObsvr_Prc_Half 0.00 127.5 FORMAT "%5.1" NUMBER 3 /end CHARACTERISTIC
/begin CHARACTERISTIC DDRCObsvr_Intl.DebStcLim221_CA "" VAL_BLK 0x804D8F57 ValA_Wu8 127.5 DDRCObsvr_Prc_Half 0.00 127.5 FORMAT "%5.1" NUMBER 3 /end CHARACTERISTIC
/begin CHARACTERISTIC DDRCObsvr_Intl.DebStcLim222_CA "" VAL_BLK 0x804D8F5A ValA_Wu8 127.5 DDRCObsvr_Prc_Half 0.00 127.5 FORMAT "%5.1" NUMBER 3 /end CHARACTERISTIC
/begin CHARACTERISTIC DDRCObsvr_Intl.DebStcLim223_CA "" VAL_BLK 0x804D8F5D ValA_Wu8 127.5 DDRCObsvr_Prc_Half 0.00 127.5 FORMAT "%5.1" NUMBER 3 /end CHARACTERISTIC
/begin CHARACTERISTIC DDRCObsvr_Intl.DebStcLim224_CA "" VAL_BLK 0x804D8F60 ValA_Wu8 127.5 DDRCObsvr_Prc_Half 0.00 127.5 FORMAT "%5.1" NUMBER 3 /end CHARACTERISTIC
/begin CHARACTERISTIC DDRCObsvr_Intl.DebStcLim225_CA "" VAL_BLK 0x804D8F63 ValA_Wu8 127.5 DDRCObsvr_Prc_Half 0.00 127.5 FORMAT "%5.1" NUMBER 3 /end CHARACTERISTIC
/begin CHARACTERISTIC DDRCObsvr_Intl.DebStcLim226_CA "" VAL_BLK 0x804D8F66 ValA_Wu8 127.5 DDRCObsvr_Prc_Half 0.00 127.5 FORMAT "%5.1" NUMBER 3 /end CHARACTERISTIC
/begin CHARACTERISTIC DDRCObsvr_Intl.DebStcLim227_CA "" VAL_BLK 0x804D8F69 ValA_Wu8 127.5 DDRCObsvr_Prc_Half 0.00 127.5 FORMAT "%5.1" NUMBER 3 /end CHARACTERISTIC
/begin CHARACTERISTIC DDRCObsvr_Intl.DebStcLim228_CA "" VAL_BLK 0x804D8F6C ValA_Wu8 127.5 DDRCObsvr_Prc_Half 0.00 127.5 FORMAT "%5.1" NUMBER 3 /end CHARACTERISTIC
/begin CHARACTERISTIC DDRCObsvr_Intl.DebStcLim229_CA "" VAL_BLK 0x804D8F6F ValA_Wu8 127.5 DDRCObsvr_Prc_Half 0.00 127.5 FORMAT "%5.1" NUMBER 3 /end CHARACTERISTIC
/begin CHARACTERISTIC DDRCObsvr_Intl.DebStcLim230_CA "" VAL_BLK 0x804D8F72 ValA_Wu8 127.5 DDRCObsvr_Prc_Half 0.00 127.5 FORMAT "%5.1" NUMBER 3 /end CHARACTERISTIC
/begin CHARACTERISTIC DDRCObsvr_Intl.DebStcLim231_CA "" VAL_BLK 0x804D8F75 ValA_Wu8 127.5 DDRCObsvr_Prc_Half 0.00 127.5 FORMAT "%5.1" NUMBER 3 /end CHARACTERISTIC
/begin CHARACTERISTIC DDRCObsvr_Intl.DebStcLim232_CA "" VAL_BLK 0x804D8F78 ValA_Wu8 127.5 DDRCObsvr_Prc_Half 0.00 127.5 FORMAT "%5.1" NUMBER 3 /end CHARACTERISTIC
/begin CHARACTERISTIC DDRCObsvr_Intl.DebStcLim233_CA "" VAL_BLK 0x804D8F7B ValA_Wu8 127.5 DDRCObsvr_Prc_Half 0.00 127.5 FORMAT "%5.1" NUMBER 3 /end CHARACTERISTIC
/begin CHARACTERISTIC DDRCObsvr_Intl.DebStcLim234_CA "" VAL_BLK 0x804D8F7E ValA_Wu8 127.5 DDRCObsvr_Prc_Half 0.00 127.5 FORMAT "%5.1" NUMBER 3 /end CHARACTERISTIC
/begin CHARACTERISTIC DDRCObsvr_Intl.DebStcLim235_CA "" VAL_BLK 0x804D8F81 ValA_Wu8 127.5 DDRCObsvr_Prc_Half 0.00 127.5 FORMAT "%5.1" NUMBER 3 /end CHARACTERISTIC
/begin CHARACTERISTIC DDRCObsvr_Intl.DebStcLim236_CA "" VAL_BLK 0x804D8F84 ValA_Wu8 127.5 DDRCObsvr_Prc_Half 0.00 127.5 FORMAT "%5.1" NUMBER 3 /end CHARACTERISTIC
/begin CHARACTERISTIC DDRCObsvr_Intl.DebStcLim237_CA "" VAL_BLK 0x804D8F87 ValA_Wu8 127.5 DDRCObsvr_Prc_Half 0.00 127.5 FORMAT "%5.1" NUMBER 3 /end CHARACTERISTIC
/begin CHARACTERISTIC DDRCObsvr_Intl.DebStcLim238_CA "" VAL_BLK 0x804D8F8A ValA_Wu8 127.5 DDRCObsvr_Prc_Half 0.00 127.5 FORMAT "%5.1" NUMBER 3 /end CHARACTERISTIC
/begin CHARACTERISTIC DDRCObsvr_Intl.DebStcLim239_CA "" VAL_BLK 0x804D8F8D ValA_Wu8 127.5 DDRCObsvr_Prc_Half 0.00 127.5 FORMAT "%5.1" NUMBER 3 /end CHARACTERISTIC
/begin CHARACTERISTIC DDRCObsvr_Intl.DebStcLim240_CA "" VAL_BLK 0x804D8F90 ValA_Wu8 127.5 DDRCObsvr_Prc_Half 0.00 127.5 FORMAT "%5.1" NUMBER 3 /end CHARACTERISTIC
/begin CHARACTERISTIC DDRCObsvr_Intl.DebStcLim241_CA "" VAL_BLK 0x804D8F93 ValA_Wu8 127.5 DDRCObsvr_Prc_Half 0.00 127.5 FORMAT "%5.1" NUMBER 3 /end CHARACTERISTIC
/begin CHARACTERISTIC DDRCObsvr_Intl.DebStcLim242_CA "" VAL_BLK 0x804D8F96 ValA_Wu8 127.5 DDRCObsvr_Prc_Half 0.00 127.5 FORMAT "%5.1" NUMBER 3 /end CHARACTERISTIC
/begin CHARACTERISTIC DDRCObsvr_Intl.DebStcLim243_CA "" VAL_BLK 0x804D8F99 ValA_Wu8 127.5 DDRCObsvr_Prc_Half 0.00 127.5 FORMAT "%5.1" NUMBER 3 /end CHARACTERISTIC
/begin CHARACTERISTIC DDRCObsvr_Intl.DebStcLim244_CA "" VAL_BLK 0x804D8F9C ValA_Wu8 127.5 DDRCObsvr_Prc_Half 0.00 127.5 FORMAT "%5.1" NUMBER 3 /end CHARACTERISTIC
/begin CHARACTERISTIC DDRCObsvr_Intl.DebStcLim245_CA "" VAL_BLK 0x804D8F9F ValA_Wu8 127.5 DDRCObsvr_Prc_Half 0.00 127.5 FORMAT "%5.1" NUMBER 3 /end CHARACTERISTIC
/begin CHARACTERISTIC DDRCObsvr_Intl.DebStcLim246_CA "" VAL_BLK 0x804D8FA2 ValA_Wu8 127.5 DDRCObsvr_Prc_Half 0.00 127.5 FORMAT "%5.1" NUMBER 3 /end CHARACTERISTIC
/begin CHARACTERISTIC DDRCObsvr_Intl.DebStcLim247_CA "" VAL_BLK 0x804D8FA5 ValA_Wu8 127.5 DDRCObsvr_Prc_Half 0.00 127.5 FORMAT "%5.1" NUMBER 3 /end CHARACTERISTIC
/begin CHARACTERISTIC DDRCObsvr_Intl.DebStcLim248_CA "" VAL_BLK 0x804D8FA8 ValA_Wu8 127.5 DDRCObsvr_Prc_Half 0.00 127.5 FORMAT "%5.1" NUMBER 3 /end CHARACTERISTIC
/begin CHARACTERISTIC DDRCObsvr_Intl.DebStcLim249_CA "" VAL_BLK 0x804D8FAB ValA_Wu8 127.5 DDRCObsvr_Prc_Half 0.00 127.5 FORMAT "%5.1" NUMBER 3 /end CHARACTERISTIC
/begin CHARACTERISTIC DDRCObsvr_Intl.DebStcLim250_CA "" VAL_BLK 0x804D8FAE ValA_Wu8 127.5 DDRCObsvr_Prc_Half 0.00 127.5 FORMAT "%5.1" NUMBER 3 /end CHARACTERISTIC
/begin CHARACTERISTIC DDRCObsvr_Intl.DebStcLim251_CA "" VAL_BLK 0x804D8FB1 ValA_Wu8 127.5 DDRCObsvr_Prc_Half 0.00 127.5 FORMAT "%5.1" NUMBER 3 /end CHARACTERISTIC
/begin CHARACTERISTIC DDRCObsvr_Intl.DebStcLim252_CA "" VAL_BLK 0x804D8FB4 ValA_Wu8 127.5 DDRCObsvr_Prc_Half 0.00 127.5 FORMAT "%5.1" NUMBER 3 /end CHARACTERISTIC
/begin CHARACTERISTIC DDRCObsvr_Intl.DebStcLim253_CA "" VAL_BLK 0x804D8FB7 ValA_Wu8 127.5 DDRCObsvr_Prc_Half 0.00 127.5 FORMAT "%5.1" NUMBER 3 /end CHARACTERISTIC
/begin CHARACTERISTIC DDRCObsvr_Intl.DebStcLim254_CA "" VAL_BLK 0x804D8FBA ValA_Wu8 127.5 DDRCObsvr_Prc_Half 0.00 127.5 FORMAT "%5.1" NUMBER 3 /end CHARACTERISTIC
/begin CHARACTERISTIC DDRCObsvr_OvfThd_C "Threshold for anti-overflow activation" VALUE 0x8058B000 Val_Wu8 255.0 OneToOne 0.00 255.0 FORMAT "%5.1" /end CHARACTERISTIC
/begin CHARACTERISTIC DDRCObsvr_RstTrg_CA "Reset trigger to re-initialize statistics value array" VAL_BLK 0x80504192 ValA_Wu8 1.000 OneToOne 0.00 1.000 FORMAT "%5.3" EXTENDED_LIMITS 0.00 255.0 NUMBER 255 /end CHARACTERISTIC
/begin CHARACTERISTIC DDRC_DebArCtrBase.MyCtrBasedClass_2.isJmpDwnActv_C "Parameters of ArCtrBase debouncing /  / Jump at change from ""Failed"" to ""Passed"" debouncing" VALUE 0x8053ADE2 RB_Val_Wu8 1.000 OneToOne 0.00 1.000 FORMAT "%5.3" EXTENDED_LIMITS 0.00 255.0 /end CHARACTERISTIC
/begin CHARACTERISTIC DDRC_DebArCtrBase.MyCtrBasedClass_2.isJmpUpActv_C "Parameters of ArCtrBase debouncing /  / Jump at change from ""Passed"" to ""Failed"" debouncing" VALUE 0x8053ADE3 RB_Val_Wu8 1.000 OneToOne 0.00 1.000 FORMAT "%5.3" EXTENDED_LIMITS 0.00 255.0 /end CHARACTERISTIC
/begin CHARACTERISTIC DDRC_DebArCtrBase.MyCtrBasedClass_2.limPassd_C "Parameters of ArCtrBase debouncing /  / ""Passed"" limit" VALUE 0x8053ADE4 RB_Val_Ws16 32767.00 OneToOne -32768.00 -1.00 FORMAT "%8.2" EXTENDED_LIMITS -32768.00 32767.00 /end CHARACTERISTIC
/begin CHARACTERISTIC DDRC_DebArCtrBase.MyCtrBasedClass_2.limFaild_C "Parameters of ArCtrBase debouncing /  / ""Failed"" limit" VALUE 0x8053ADE6 RB_Val_Ws16 32766.00 OneToOne 1.00 32767.00 FORMAT "%8.2" EXTENDED_LIMITS -32768.00 32767.00 /end CHARACTERISTIC
/begin CHARACTERISTIC DDRC_DebArCtrBase.MyCtrBasedClass_2.jmpUpVal_C "Parameters of ArCtrBase debouncing /  / Jumppoint direction ""Failed""" VALUE 0x8053ADE8 RB_Val_Ws16 65535.00 OneToOne -32768.00 32767.00 FORMAT "%8.2" /end CHARACTERISTIC
/begin CHARACTERISTIC DDRC_DebArCtrBase.MyCtrBasedClass_2.jmpDwnVal_C "Parameters of ArCtrBase debouncing /  / Jumppoint direction ""Passed""" VALUE 0x8053ADEA RB_Val_Ws16 65535.00 OneToOne -32768.00 32767.00 FORMAT "%8.2" /end CHARACTERISTIC
/begin CHARACTERISTIC DDRC_DebArCtrBase.MyCtrBasedClass_2.stepUp_C "Parameters of ArCtrBase debouncing /  / Stepsize of ""Failed"" direction" VALUE 0x8053ADEC RB_Val_Ws16 32766.00 OneToOne 1.00 32767.00 FORMAT "%8.2" EXTENDED_LIMITS -32768.00 32767.00 /end CHARACTERISTIC
/begin CHARACTERISTIC DDRC_DebArCtrBase.MyCtrBasedClass_2.stepDwn_C "Parameters of ArCtrBase debouncing /  / Stepsize of ""Passed"" direction" VALUE 0x8053ADEE RB_Val_Ws16 32767.00 OneToOne -32768.00 -1.00 FORMAT "%8.2" EXTENDED_LIMITS -32768.00 32767.00 /end CHARACTERISTIC
/begin CHARACTERISTIC DDRC_DebArCtrBase.MyCtrBasedClass_1.isJmpDwnActv_C "Parameters of ArCtrBase debouncing /  / Jump at change from ""Failed"" to ""Passed"" debouncing" VALUE 0x8053ADF0 RB_Val_Wu8 1.000 OneToOne 0.00 1.000 FORMAT "%5.3" EXTENDED_LIMITS 0.00 255.0 /end CHARACTERISTIC
/begin CHARACTERISTIC DDRC_DebArCtrBase.MyCtrBasedClass_1.isJmpUpActv_C "Parameters of ArCtrBase debouncing /  / Jump at change from ""Passed"" to ""Failed"" debouncing" VALUE 0x8053ADF1 RB_Val_Wu8 1.000 OneToOne 0.00 1.000 FORMAT "%5.3" EXTENDED_LIMITS 0.00 255.0 /end CHARACTERISTIC
/begin CHARACTERISTIC DDRC_DebArCtrBase.MyCtrBasedClass_1.limPassd_C "Parameters of ArCtrBase debouncing /  / ""Passed"" limit" VALUE 0x8053ADF2 RB_Val_Ws16 32767.00 OneToOne -32768.00 -1.00 FORMAT "%8.2" EXTENDED_LIMITS -32768.00 32767.00 /end CHARACTERISTIC
/begin CHARACTERISTIC DDRC_DebArCtrBase.MyCtrBasedClass_1.limFaild_C "Parameters of ArCtrBase debouncing /  / ""Failed"" limit" VALUE 0x8053ADF4 RB_Val_Ws16 32766.00 OneToOne 1.00 32767.00 FORMAT "%8.2" EXTENDED_LIMITS -32768.00 32767.00 /end CHARACTERISTIC
/begin CHARACTERISTIC DDRC_DebArCtrBase.MyCtrBasedClass_1.jmpUpVal_C "Parameters of ArCtrBase debouncing /  / Jumppoint direction ""Failed""" VALUE 0x8053ADF6 RB_Val_Ws16 65535.00 OneToOne -32768.00 32767.00 FORMAT "%8.2" /end CHARACTERISTIC
/begin CHARACTERISTIC DDRC_DebArCtrBase.MyCtrBasedClass_1.jmpDwnVal_C "Parameters of ArCtrBase debouncing /  / Jumppoint direction ""Passed""" VALUE 0x8053ADF8 RB_Val_Ws16 65535.00 OneToOne -32768.00 32767.00 FORMAT "%8.2" /end CHARACTERISTIC
/begin CHARACTERISTIC DDRC_DebArCtrBase.MyCtrBasedClass_1.stepUp_C "Parameters of ArCtrBase debouncing /  / Stepsize of ""Failed"" direction" VALUE 0x8053ADFA RB_Val_Ws16 32766.00 OneToOne 1.00 32767.00 FORMAT "%8.2" EXTENDED_LIMITS -32768.00 32767.00 /end CHARACTERISTIC
/begin CHARACTERISTIC DDRC_DebArCtrBase.MyCtrBasedClass_1.stepDwn_C "Parameters of ArCtrBase debouncing /  / Stepsize of ""Passed"" direction" VALUE 0x8053ADFC RB_Val_Ws16 32767.00 OneToOne -32768.00 -1.00 FORMAT "%8.2" EXTENDED_LIMITS -32768.00 32767.00 /end CHARACTERISTIC
/begin CHARACTERISTIC DDRC_DebArCtrBase.DemDebounceCounterBasedClass_standard.isJmpDwnActv_C "Parameters of ArCtrBase debouncing /  / Jump at change from ""Failed"" to ""Passed"" debouncing" VALUE 0x8053ADFE RB_Val_Wu8 1.000 OneToOne 0.00 1.000 FORMAT "%5.3" EXTENDED_LIMITS 0.00 255.0 /end CHARACTERISTIC
/begin CHARACTERISTIC DDRC_DebArCtrBase.DemDebounceCounterBasedClass_standard.isJmpUpActv_C "Parameters of ArCtrBase debouncing /  / Jump at change from ""Passed"" to ""Failed"" debouncing" VALUE 0x8053ADFF RB_Val_Wu8 1.000 OneToOne 0.00 1.000 FORMAT "%5.3" EXTENDED_LIMITS 0.00 255.0 /end CHARACTERISTIC
/begin CHARACTERISTIC DDRC_DebArCtrBase.DemDebounceCounterBasedClass_standard.limPassd_C "Parameters of ArCtrBase debouncing /  / ""Passed"" limit" VALUE 0x8053AE00 RB_Val_Ws16 32767.00 OneToOne -32768.00 -1.00 FORMAT "%8.2" EXTENDED_LIMITS -32768.00 32767.00 /end CHARACTERISTIC
/begin CHARACTERISTIC DDRC_DebArCtrBase.DemDebounceCounterBasedClass_standard.limFaild_C "Parameters of ArCtrBase debouncing /  / ""Failed"" limit" VALUE 0x8053AE02 RB_Val_Ws16 32766.00 OneToOne 1.00 32767.00 FORMAT "%8.2" EXTENDED_LIMITS -32768.00 32767.00 /end CHARACTERISTIC
/begin CHARACTERISTIC DDRC_DebArCtrBase.DemDebounceCounterBasedClass_standard.jmpUpVal_C "Parameters of ArCtrBase debouncing /  / Jumppoint direction ""Failed""" VALUE 0x8053AE04 RB_Val_Ws16 65535.00 OneToOne -32768.00 32767.00 FORMAT "%8.2" /end CHARACTERISTIC
/begin CHARACTERISTIC DDRC_DebArCtrBase.DemDebounceCounterBasedClass_standard.jmpDwnVal_C "Parameters of ArCtrBase debouncing /  / Jumppoint direction ""Passed""" VALUE 0x8053AE06 RB_Val_Ws16 65535.00 OneToOne -32768.00 32767.00 FORMAT "%8.2" /end CHARACTERISTIC
/begin CHARACTERISTIC DDRC_DebArCtrBase.DemDebounceCounterBasedClass_standard.stepUp_C "Parameters of ArCtrBase debouncing /  / Stepsize of ""Failed"" direction" VALUE 0x8053AE08 RB_Val_Ws16 32766.00 OneToOne 1.00 32767.00 FORMAT "%8.2" EXTENDED_LIMITS -32768.00 32767.00 /end CHARACTERISTIC
/begin CHARACTERISTIC DDRC_DebArCtrBase.DemDebounceCounterBasedClass_standard.stepDwn_C "Parameters of ArCtrBase debouncing /  / Stepsize of ""Passed"" direction" VALUE 0x8053AE0A RB_Val_Ws16 32767.00 OneToOne -32768.00 -1.00 FORMAT "%8.2" EXTENDED_LIMITS -32768.00 32767.00 /end CHARACTERISTIC
/begin CHARACTERISTIC DDRC_DebArTime.DFC_BusDiagCANAPPLBusOff.tiLimFaild_C "Parameters of ArTime debouncing /  / ""Failed"" limit" VALUE 0x8053AE0C RB_Val_Ws16 327660.0 DDRCTime_ms 10.0 327670.0 FORMAT "%8.1" EXTENDED_LIMITS -327680.0 327670.0 /end CHARACTERISTIC
/begin CHARACTERISTIC DDRC_DebArTime.DFC_BusDiagCANAPPLBusOff.tiLimPassd_C "Parameters of ArTime debouncing /  / ""Passed"" limit" VALUE 0x8053AE0E RB_Val_Ws16 327670.0 DDRCTime_ms -327680.0 -10.0 FORMAT "%8.1" EXTENDED_LIMITS -327680.0 327670.0 /end CHARACTERISTIC
/begin CHARACTERISTIC DDRC_DebArTime.DFC_BusDiagCANCANCBusOff.tiLimFaild_C "Parameters of ArTime debouncing /  / ""Failed"" limit" VALUE 0x8053AE12 RB_Val_Ws16 327660.0 DDRCTime_ms 10.0 327670.0 FORMAT "%8.1" EXTENDED_LIMITS -327680.0 327670.0 /end CHARACTERISTIC
/begin CHARACTERISTIC DDRC_DebArTime.DFC_BusDiagCANCANCBusOff.tiLimPassd_C "Parameters of ArTime debouncing /  / ""Passed"" limit" VALUE 0x8053AE14 RB_Val_Ws16 327670.0 DDRCTime_ms -327680.0 -10.0 FORMAT "%8.1" EXTENDED_LIMITS -327680.0 327670.0 /end CHARACTERISTIC
/begin CHARACTERISTIC DDRC_DebArTime.DFC_BusDiagCANVEHICLEBusOff.tiLimFaild_C "Parameters of ArTime debouncing /  / ""Failed"" limit" VALUE 0x8053AE18 RB_Val_Ws16 327660.0 DDRCTime_ms 10.0 327670.0 FORMAT "%8.1" EXTENDED_LIMITS -327680.0 327670.0 /end CHARACTERISTIC
/begin CHARACTERISTIC DDRC_DebArTime.DFC_BusDiagCANVEHICLEBusOff.tiLimPassd_C "Parameters of ArTime debouncing /  / ""Passed"" limit" VALUE 0x8053AE1A RB_Val_Ws16 327670.0 DDRCTime_ms -327680.0 -10.0 FORMAT "%8.1" EXTENDED_LIMITS -327680.0 327670.0 /end CHARACTERISTIC
/begin CHARACTERISTIC DDRC_DebArTime.DFC_RBA_IODIAGPWR_rba_IoExtCy329_SignalVltSply_0.tiLimFaild_C "Parameters of ArTime debouncing /  / ""Failed"" limit" VALUE 0x8053AE1E RB_Val_Ws16 327660.0 DDRCTime_ms 10.0 327670.0 FORMAT "%8.1" EXTENDED_LIMITS -327680.0 327670.0 /end CHARACTERISTIC
/begin CHARACTERISTIC DDRC_DebArTime.DFC_RBA_IODIAGPWR_rba_IoExtCy329_SignalVltSply_0.tiLimPassd_C "Parameters of ArTime debouncing /  / ""Passed"" limit" VALUE 0x8053AE20 RB_Val_Ws16 327670.0 DDRCTime_ms -327680.0 -10.0 FORMAT "%8.1" EXTENDED_LIMITS -327680.0 327670.0 /end CHARACTERISTIC
/begin CHARACTERISTIC DDRC_DebArTime.DFC_RBA_IODIAGPWR_rba_IoExtCy329_SignalVltSply_0OT.tiLimFaild_C "Parameters of ArTime debouncing /  / ""Failed"" limit" VALUE 0x8053AE24 RB_Val_Ws16 327660.0 DDRCTime_ms 10.0 327670.0 FORMAT "%8.1" EXTENDED_LIMITS -327680.0 327670.0 /end CHARACTERISTIC
/begin CHARACTERISTIC DDRC_DebArTime.DFC_RBA_IODIAGPWR_rba_IoExtCy329_SignalVltSply_0OT.tiLimPassd_C "Parameters of ArTime debouncing /  / ""Passed"" limit" VALUE 0x8053AE26 RB_Val_Ws16 327670.0 DDRCTime_ms -327680.0 -10.0 FORMAT "%8.1" EXTENDED_LIMITS -327680.0 327670.0 /end CHARACTERISTIC
/begin CHARACTERISTIC DDRC_DebArTime.DFC_RBA_IODIAGPWR_rba_IoExtCy329_SignalVltSply_0OV.tiLimFaild_C "Parameters of ArTime debouncing /  / ""Failed"" limit" VALUE 0x8053AE2A RB_Val_Ws16 327660.0 DDRCTime_ms 10.0 327670.0 FORMAT "%8.1" EXTENDED_LIMITS -327680.0 327670.0 /end CHARACTERISTIC
/begin CHARACTERISTIC DDRC_DebArTime.DFC_RBA_IODIAGPWR_rba_IoExtCy329_SignalVltSply_0OV.tiLimPassd_C "Parameters of ArTime debouncing /  / ""Passed"" limit" VALUE 0x8053AE2C RB_Val_Ws16 327670.0 DDRCTime_ms -327680.0 -10.0 FORMAT "%8.1" EXTENDED_LIMITS -327680.0 327670.0 /end CHARACTERISTIC
/begin CHARACTERISTIC DDRC_DebArTime.DFC_RBA_IODIAGPWR_rba_IoExtCy329_SignalVltSply_0SCG.tiLimFaild_C "Parameters of ArTime debouncing /  / ""Failed"" limit" VALUE 0x8053AE30 RB_Val_Ws16 327660.0 DDRCTime_ms 10.0 327670.0 FORMAT "%8.1" EXTENDED_LIMITS -327680.0 327670.0 /end CHARACTERISTIC
/begin CHARACTERISTIC DDRC_DebArTime.DFC_RBA_IODIAGPWR_rba_IoExtCy329_SignalVltSply_0SCG.tiLimPassd_C "Parameters of ArTime debouncing /  / ""Passed"" limit" VALUE 0x8053AE32 RB_Val_Ws16 327670.0 DDRCTime_ms -327680.0 -10.0 FORMAT "%8.1" EXTENDED_LIMITS -327680.0 327670.0 /end CHARACTERISTIC
/begin CHARACTERISTIC DDRC_DebArTime.DFC_RBA_IODIAGPWR_rba_IoExtCy329_SignalVltSply_0UV.tiLimFaild_C "Parameters of ArTime debouncing /  / ""Failed"" limit" VALUE 0x8053AE36 RB_Val_Ws16 327660.0 DDRCTime_ms 10.0 327670.0 FORMAT "%8.1" EXTENDED_LIMITS -327680.0 327670.0 /end CHARACTERISTIC
/begin CHARACTERISTIC DDRC_DebArTime.DFC_RBA_IODIAGPWR_rba_IoExtCy329_SignalVltSply_0UV.tiLimPassd_C "Parameters of ArTime debouncing /  / ""Passed"" limit" VALUE 0x8053AE38 RB_Val_Ws16 327670.0 DDRCTime_ms -327680.0 -10.0 FORMAT "%8.1" EXTENDED_LIMITS -327680.0 327670.0 /end CHARACTERISTIC
/begin CHARACTERISTIC DDRC_DebArTime.DFC_RBA_IODIAGPWR_rba_IoExtCy329_SignalVltSply_1.tiLimFaild_C "Parameters of ArTime debouncing /  / ""Failed"" limit" VALUE 0x8053AE3C RB_Val_Ws16 327660.0 DDRCTime_ms 10.0 327670.0 FORMAT "%8.1" EXTENDED_LIMITS -327680.0 327670.0 /end CHARACTERISTIC
/begin CHARACTERISTIC DDRC_DebArTime.DFC_RBA_IODIAGPWR_rba_IoExtCy329_SignalVltSply_1.tiLimPassd_C "Parameters of ArTime debouncing /  / ""Passed"" limit" VALUE 0x8053AE3E RB_Val_Ws16 327670.0 DDRCTime_ms -327680.0 -10.0 FORMAT "%8.1" EXTENDED_LIMITS -327680.0 327670.0 /end CHARACTERISTIC
/begin CHARACTERISTIC DDRC_DebArTime.DFC_RBA_IODIAGPWR_rba_IoExtCy329_SignalVltSply_1OT.tiLimFaild_C "Parameters of ArTime debouncing /  / ""Failed"" limit" VALUE 0x8053AE42 RB_Val_Ws16 327660.0 DDRCTime_ms 10.0 327670.0 FORMAT "%8.1" EXTENDED_LIMITS -327680.0 327670.0 /end CHARACTERISTIC
/begin CHARACTERISTIC DDRC_DebArTime.DFC_RBA_IODIAGPWR_rba_IoExtCy329_SignalVltSply_1OT.tiLimPassd_C "Parameters of ArTime debouncing /  / ""Passed"" limit" VALUE 0x8053AE44 RB_Val_Ws16 327670.0 DDRCTime_ms -327680.0 -10.0 FORMAT "%8.1" EXTENDED_LIMITS -327680.0 327670.0 /end CHARACTERISTIC
/begin CHARACTERISTIC DDRC_DebArTime.DFC_RBA_IODIAGPWR_rba_IoExtCy329_SignalVltSply_1OV.tiLimFaild_C "Parameters of ArTime debouncing /  / ""Failed"" limit" VALUE 0x8053AE48 RB_Val_Ws16 327660.0 DDRCTime_ms 10.0 327670.0 FORMAT "%8.1" EXTENDED_LIMITS -327680.0 327670.0 /end CHARACTERISTIC
/begin CHARACTERISTIC DDRC_DebArTime.DFC_RBA_IODIAGPWR_rba_IoExtCy329_SignalVltSply_1OV.tiLimPassd_C "Parameters of ArTime debouncing /  / ""Passed"" limit" VALUE 0x8053AE4A RB_Val_Ws16 327670.0 DDRCTime_ms -327680.0 -10.0 FORMAT "%8.1" EXTENDED_LIMITS -327680.0 327670.0 /end CHARACTERISTIC
/begin CHARACTERISTIC DDRC_DebArTime.DFC_RBA_IODIAGPWR_rba_IoExtCy329_SignalVltSply_1SCG.tiLimFaild_C "Parameters of ArTime debouncing /  / ""Failed"" limit" VALUE 0x8053AE4E RB_Val_Ws16 327660.0 DDRCTime_ms 10.0 327670.0 FORMAT "%8.1" EXTENDED_LIMITS -327680.0 327670.0 /end CHARACTERISTIC
/begin CHARACTERISTIC DDRC_DebArTime.DFC_RBA_IODIAGPWR_rba_IoExtCy329_SignalVltSply_1SCG.tiLimPassd_C "Parameters of ArTime debouncing /  / ""Passed"" limit" VALUE 0x8053AE50 RB_Val_Ws16 327670.0 DDRCTime_ms -327680.0 -10.0 FORMAT "%8.1" EXTENDED_LIMITS -327680.0 327670.0 /end CHARACTERISTIC
/begin CHARACTERISTIC DDRC_DebArTime.DFC_RBA_IODIAGPWR_rba_IoExtCy329_SignalVltSply_1UV.tiLimFaild_C "Parameters of ArTime debouncing /  / ""Failed"" limit" VALUE 0x8053AE54 RB_Val_Ws16 327660.0 DDRCTime_ms 10.0 327670.0 FORMAT "%8.1" EXTENDED_LIMITS -327680.0 327670.0 /end CHARACTERISTIC
/begin CHARACTERISTIC DDRC_DebArTime.DFC_RBA_IODIAGPWR_rba_IoExtCy329_SignalVltSply_1UV.tiLimPassd_C "Parameters of ArTime debouncing /  / ""Passed"" limit" VALUE 0x8053AE56 RB_Val_Ws16 327670.0 DDRCTime_ms -327680.0 -10.0 FORMAT "%8.1" EXTENDED_LIMITS -327680.0 327670.0 /end CHARACTERISTIC
/begin CHARACTERISTIC DDRC_DebArTime.DFC_RBA_IODIAGPWR_rba_IoExtCy329_SignalVltSply_2.tiLimFaild_C "Parameters of ArTime debouncing /  / ""Failed"" limit" VALUE 0x8053AE5A RB_Val_Ws16 327660.0 DDRCTime_ms 10.0 327670.0 FORMAT "%8.1" EXTENDED_LIMITS -327680.0 327670.0 /end CHARACTERISTIC
/begin CHARACTERISTIC DDRC_DebArTime.DFC_RBA_IODIAGPWR_rba_IoExtCy329_SignalVltSply_2.tiLimPassd_C "Parameters of ArTime debouncing /  / ""Passed"" limit" VALUE 0x8053AE5C RB_Val_Ws16 327670.0 DDRCTime_ms -327680.0 -10.0 FORMAT "%8.1" EXTENDED_LIMITS -327680.0 327670.0 /end CHARACTERISTIC
/begin CHARACTERISTIC DDRC_DebArTime.DFC_RBA_IODIAGPWR_rba_IoExtCy329_SignalVltSply_2OT.tiLimFaild_C "Parameters of ArTime debouncing /  / ""Failed"" limit" VALUE 0x8053AE60 RB_Val_Ws16 327660.0 DDRCTime_ms 10.0 327670.0 FORMAT "%8.1" EXTENDED_LIMITS -327680.0 327670.0 /end CHARACTERISTIC
/begin CHARACTERISTIC DDRC_DebArTime.DFC_RBA_IODIAGPWR_rba_IoExtCy329_SignalVltSply_2OT.tiLimPassd_C "Parameters of ArTime debouncing /  / ""Passed"" limit" VALUE 0x8053AE62 RB_Val_Ws16 327670.0 DDRCTime_ms -327680.0 -10.0 FORMAT "%8.1" EXTENDED_LIMITS -327680.0 327670.0 /end CHARACTERISTIC
/begin CHARACTERISTIC DDRC_DebArTime.DFC_RBA_IODIAGPWR_rba_IoExtCy329_SignalVltSply_2OV.tiLimFaild_C "Parameters of ArTime debouncing /  / ""Failed"" limit" VALUE 0x8053AE66 RB_Val_Ws16 327660.0 DDRCTime_ms 10.0 327670.0 FORMAT "%8.1" EXTENDED_LIMITS -327680.0 327670.0 /end CHARACTERISTIC
/begin CHARACTERISTIC DDRC_DebArTime.DFC_RBA_IODIAGPWR_rba_IoExtCy329_SignalVltSply_2OV.tiLimPassd_C "Parameters of ArTime debouncing /  / ""Passed"" limit" VALUE 0x8053AE68 RB_Val_Ws16 327670.0 DDRCTime_ms -327680.0 -10.0 FORMAT "%8.1" EXTENDED_LIMITS -327680.0 327670.0 /end CHARACTERISTIC
/begin CHARACTERISTIC DDRC_DebArTime.DFC_RBA_IODIAGPWR_rba_IoExtCy329_SignalVltSply_2SCG.tiLimFaild_C "Parameters of ArTime debouncing /  / ""Failed"" limit" VALUE 0x8053AE6C RB_Val_Ws16 327660.0 DDRCTime_ms 10.0 327670.0 FORMAT "%8.1" EXTENDED_LIMITS -327680.0 327670.0 /end CHARACTERISTIC
/begin CHARACTERISTIC DDRC_DebArTime.DFC_RBA_IODIAGPWR_rba_IoExtCy329_SignalVltSply_2SCG.tiLimPassd_C "Parameters of ArTime debouncing /  / ""Passed"" limit" VALUE 0x8053AE6E RB_Val_Ws16 327670.0 DDRCTime_ms -327680.0 -10.0 FORMAT "%8.1" EXTENDED_LIMITS -327680.0 327670.0 /end CHARACTERISTIC
/begin CHARACTERISTIC DDRC_DebArTime.DFC_RBA_IODIAGPWR_rba_IoExtCy329_SignalVltSply_2UV.tiLimFaild_C "Parameters of ArTime debouncing /  / ""Failed"" limit" VALUE 0x8053AE72 RB_Val_Ws16 327660.0 DDRCTime_ms 10.0 327670.0 FORMAT "%8.1" EXTENDED_LIMITS -327680.0 327670.0 /end CHARACTERISTIC
/begin CHARACTERISTIC DDRC_DebArTime.DFC_RBA_IODIAGPWR_rba_IoExtCy329_SignalVltSply_2UV.tiLimPassd_C "Parameters of ArTime debouncing /  / ""Passed"" limit" VALUE 0x8053AE74 RB_Val_Ws16 327670.0 DDRCTime_ms -327680.0 -10.0 FORMAT "%8.1" EXTENDED_LIMITS -327680.0 327670.0 /end CHARACTERISTIC
/begin CHARACTERISTIC DDRC_RatDeb.Com_tiCntTCU12UDRat_C "Ratioof up-down debouncing / Defect / Heal Ratio for check DFC_ComCntTCU12" VALUE 0x804F5AA4 Val_Wu8 3.00000000000 DDRC_Ratio 1.00000000000 4.00000000000 FORMAT "%13.11" /end CHARACTERISTIC
/begin CHARACTERISTIC DDRC_RatDeb.Com_tiCntTCU13UDRat_C "Ratioof up-down debouncing / Defect / Heal Ratio for check DFC_ComCntTCU13" VALUE 0x804F5AA5 Val_Wu8 3.00000000000 DDRC_Ratio 1.00000000000 4.00000000000 FORMAT "%13.11" /end CHARACTERISTIC
/begin CHARACTERISTIC DDRC_RatDeb.Com_tiCntTCU2UDRat_C "Ratioof up-down debouncing / Defect / Heal Ratio for check DFC_ComCntTCU2" VALUE 0x804F5AA6 Val_Wu8 3.00000000000 DDRC_Ratio 1.00000000000 4.00000000000 FORMAT "%13.11" /end CHARACTERISTIC
/begin CHARACTERISTIC DDRC_RatDeb.Com_tiCntTCU3UDRat_C "Ratioof up-down debouncing / Defect / Heal Ratio for check DFC_ComCntTCU3" VALUE 0x804F5AA7 Val_Wu8 3.00000000000 DDRC_Ratio 1.00000000000 4.00000000000 FORMAT "%13.11" /end CHARACTERISTIC
/begin CHARACTERISTIC DDRC_RatDeb.Com_tiCntTCU4UDRat_C "Ratioof up-down debouncing / Defect / Heal Ratio for check DFC_ComCntTCU4" VALUE 0x804F5AA8 Val_Wu8 3.00000000000 DDRC_Ratio 1.00000000000 4.00000000000 FORMAT "%13.11" /end CHARACTERISTIC
/begin CHARACTERISTIC DDRC_RatDeb.Com_tiTOutTCU01UDRat_C "Ratioof up-down debouncing / Defect / Heal Ratio for check DFC_ComTOutTCU01" VALUE 0x804F5AA9 Val_Wu8 3.00000000000 DDRC_Ratio 1.00000000000 4.00000000000 FORMAT "%13.11" /end CHARACTERISTIC
/begin CHARACTERISTIC DDRC_RatDeb.Com_tiTOutTCU02UDRat_C "Ratioof up-down debouncing / Defect / Heal Ratio for check DFC_ComTOutTCU02" VALUE 0x804F5AAA Val_Wu8 3.00000000000 DDRC_Ratio 1.00000000000 4.00000000000 FORMAT "%13.11" /end CHARACTERISTIC
/begin CHARACTERISTIC DDRC_RatDeb.Com_tiTOutTCU1UDRat_C "Ratioof up-down debouncing / Defect / Heal Ratio for check DFC_ComTOutTCU1" VALUE 0x804F5AAB Val_Wu8 3.00000000000 DDRC_Ratio 1.00000000000 4.00000000000 FORMAT "%13.11" /end CHARACTERISTIC
/begin CHARACTERISTIC DDRC_RatDeb.Com_tiTOutTCU11UDRat_C "Ratioof up-down debouncing / Defect / Heal Ratio for check DFC_ComTOutTCU11" VALUE 0x804F5AAC Val_Wu8 3.00000000000 DDRC_Ratio 1.00000000000 4.00000000000 FORMAT "%13.11" /end CHARACTERISTIC
/begin CHARACTERISTIC DDRC_RatDeb.Com_tiTOutTCU12UDRat_C "Ratioof up-down debouncing / Defect / Heal Ratio for check DFC_ComTOutTCU12" VALUE 0x804F5AAD Val_Wu8 3.00000000000 DDRC_Ratio 1.00000000000 4.00000000000 FORMAT "%13.11" /end CHARACTERISTIC
/begin CHARACTERISTIC DDRC_RatDeb.Com_tiTOutTCU13UDRat_C "Ratioof up-down debouncing / Defect / Heal Ratio for check DFC_ComTOutTCU13" VALUE 0x804F5AAE Val_Wu8 3.00000000000 DDRC_Ratio 1.00000000000 4.00000000000 FORMAT "%13.11" /end CHARACTERISTIC
/begin CHARACTERISTIC DDRC_RatDeb.Com_tiTOutTCU14UDRat_C "Ratioof up-down debouncing / Defect / Heal Ratio for check DFC_ComTOutTCU14" VALUE 0x804F5AAF Val_Wu8 3.00000000000 DDRC_Ratio 1.00000000000 4.00000000000 FORMAT "%13.11" /end CHARACTERISTIC
/begin CHARACTERISTIC DDRC_RatDeb.Com_tiTOutTCU2UDRat_C "Ratioof up-down debouncing / Defect / Heal Ratio for check DFC_ComTOutTCU2" VALUE 0x804F5AB0 Val_Wu8 3.00000000000 DDRC_Ratio 1.00000000000 4.00000000000 FORMAT "%13.11" /end CHARACTERISTIC
/begin CHARACTERISTIC DDRC_RatDeb.Com_tiTOutTCU3UDRat_C "Ratioof up-down debouncing / Defect / Heal Ratio for check DFC_ComTOutTCU3" VALUE 0x804F5AB1 Val_Wu8 3.00000000000 DDRC_Ratio 1.00000000000 4.00000000000 FORMAT "%13.11" /end CHARACTERISTIC
/begin CHARACTERISTIC DDRC_RatDeb.Com_tiTOutTCU4UDRat_C "Ratioof up-down debouncing / Defect / Heal Ratio for check DFC_ComTOutTCU4" VALUE 0x804F5AB2 Val_Wu8 3.00000000000 DDRC_Ratio 1.00000000000 4.00000000000 FORMAT "%13.11" /end CHARACTERISTIC
/begin CHARACTERISTIC DDRC_RatDeb.DevLib_tiBattUHiUDRat_C "Ratioof up-down debouncing / Defect / Heal Ratio for check DFC_DevLibBattUHi" VALUE 0x804F5AB3 Val_Wu8 3.00000000000 DDRC_Ratio 1.00000000000 4.00000000000 FORMAT "%13.11" /end CHARACTERISTIC
/begin CHARACTERISTIC DDRC_RatDeb.DevLib_tiBattULoUDRat_C "Ratioof up-down debouncing / Defect / Heal Ratio for check DFC_DevLibBattULo" VALUE 0x804F5AB4 Val_Wu8 3.00000000000 DDRC_Ratio 1.00000000000 4.00000000000 FORMAT "%13.11" /end CHARACTERISTIC
/begin CHARACTERISTIC DDRC_RatDeb.EGRVlv_tiFailSafeActvUDRat_C "Ratioof up-down debouncing / Defect / Heal Ratio for check DFC_EGRVlvFailSafeActv" VALUE 0x804F5AB5 Val_Wu8 3.00000000000 DDRC_Ratio 1.00000000000 4.00000000000 FORMAT "%13.11" /end CHARACTERISTIC
/begin CHARACTERISTIC DDRC_RatDeb.EGRVlv_tiGovDvtCldUDRat_C "Ratioof up-down debouncing / Defect / Heal Ratio for check DFC_EGRVlvGovDvtCld" VALUE 0x804F5AB6 Val_Wu8 3.00000000000 DDRC_Ratio 1.00000000000 4.00000000000 FORMAT "%13.11" /end CHARACTERISTIC
/begin CHARACTERISTIC DDRC_RatDeb.EGRVlv_tiPhysSRCMaxUDRat_C "Ratioof up-down debouncing / Defect / Heal Ratio for check DFC_EGRVlvPhysSRCMax" VALUE 0x804F5AB7 Val_Wu8 3.00000000000 DDRC_Ratio 1.00000000000 4.00000000000 FORMAT "%13.11" /end CHARACTERISTIC
/begin CHARACTERISTIC DDRC_RatDeb.EGRVlv_tiPhysSRCMinUDRat_C "Ratioof up-down debouncing / Defect / Heal Ratio for check DFC_EGRVlvPhysSRCMin" VALUE 0x804F5AB8 Val_Wu8 3.00000000000 DDRC_Ratio 1.00000000000 4.00000000000 FORMAT "%13.11" /end CHARACTERISTIC
/begin CHARACTERISTIC DDRC_RatDeb.Fan_tiDIOOLUDRat_C "Ratioof up-down debouncing / Defect / Heal Ratio for check DFC_FanDIOOL" VALUE 0x804F5AB9 Val_Wu8 3.00000000000 DDRC_Ratio 1.00000000000 4.00000000000 FORMAT "%13.11" /end CHARACTERISTIC
/begin CHARACTERISTIC DDRC_RatDeb.Fan_tiDIOOvrTempUDRat_C "Ratioof up-down debouncing / Defect / Heal Ratio for check DFC_FanDIOOvrTemp" VALUE 0x804F5ABA Val_Wu8 3.00000000000 DDRC_Ratio 1.00000000000 4.00000000000 FORMAT "%13.11" /end CHARACTERISTIC
/begin CHARACTERISTIC DDRC_RatDeb.Fan_tiDIOSCBUDRat_C "Ratioof up-down debouncing / Defect / Heal Ratio for check DFC_FanDIOSCB" VALUE 0x804F5ABB Val_Wu8 3.00000000000 DDRC_Ratio 1.00000000000 4.00000000000 FORMAT "%13.11" /end CHARACTERISTIC
/begin CHARACTERISTIC DDRC_RatDeb.Fan_tiDIOSCGUDRat_C "Ratioof up-down debouncing / Defect / Heal Ratio for check DFC_FanDIOSCG" VALUE 0x804F5ABC Val_Wu8 3.00000000000 DDRC_Ratio 1.00000000000 4.00000000000 FORMAT "%13.11" /end CHARACTERISTIC
/begin CHARACTERISTIC DDRC_RatDeb.MRlyDcOL_tisigOLUDRat_C "Ratioof up-down debouncing / Defect / Heal Ratio for check DFC_MRlyDcOL" VALUE 0x804F5ABD Val_Wu8 3.00000000000 DDRC_Ratio 1.00000000000 4.00000000000 FORMAT "%13.11" /end CHARACTERISTIC
/begin CHARACTERISTIC DDRC_RatDeb.MRlyDcSCB_tisigSCBUDRat_C "Ratioof up-down debouncing / Defect / Heal Ratio for check DFC_MRlyDcSCB" VALUE 0x804F5ABE Val_Wu8 3.00000000000 DDRC_Ratio 1.00000000000 4.00000000000 FORMAT "%13.11" /end CHARACTERISTIC
/begin CHARACTERISTIC DDRC_RatDeb.MRlyDcSCG_tisigSCGUDRat_C "Ratioof up-down debouncing / Defect / Heal Ratio for check DFC_MRlyDcSCG" VALUE 0x804F5ABF Val_Wu8 3.00000000000 DDRC_Ratio 1.00000000000 4.00000000000 FORMAT "%13.11" /end CHARACTERISTIC
/begin CHARACTERISTIC DDRC_RatDeb.PSP_tiOLUDRat_C "Ratioof up-down debouncing / Defect / Heal Ratio for check DFC_PSPOL" VALUE 0x804F5AC0 Val_Wu8 3.00000000000 DDRC_Ratio 1.00000000000 4.00000000000 FORMAT "%13.11" /end CHARACTERISTIC
/begin CHARACTERISTIC DDRC_RatDeb.PSP_tiOvrTempUDRat_C "Ratioof up-down debouncing / Defect / Heal Ratio for check DFC_PSPOvrTemp" VALUE 0x804F5AC1 Val_Wu8 3.00000000000 DDRC_Ratio 1.00000000000 4.00000000000 FORMAT "%13.11" /end CHARACTERISTIC
/begin CHARACTERISTIC DDRC_RatDeb.PSP_tiSCBUDRat_C "Ratioof up-down debouncing / Defect / Heal Ratio for check DFC_PSPSCB" VALUE 0x804F5AC2 Val_Wu8 3.00000000000 DDRC_Ratio 1.00000000000 4.00000000000 FORMAT "%13.11" /end CHARACTERISTIC
/begin CHARACTERISTIC DDRC_RatDeb.PSP_tiSCGUDRat_C "Ratioof up-down debouncing / Defect / Heal Ratio for check DFC_PSPSCG" VALUE 0x804F5AC3 Val_Wu8 3.00000000000 DDRC_Ratio 1.00000000000 4.00000000000 FORMAT "%13.11" /end CHARACTERISTIC
/begin CHARACTERISTIC DDRC_RatDeb.T50_tiErrUDRat_C "Ratioof up-down debouncing / Defect / Heal Ratio for check DFC_T50Err" VALUE 0x804F5AC4 Val_Wu8 3.00000000000 DDRC_Ratio 1.00000000000 4.00000000000 FORMAT "%13.11" /end CHARACTERISTIC
/begin CHARACTERISTIC DDRC_RatDeb.ThrVlv_tiLoBattB1UDRat_C "Ratioof up-down debouncing / Defect / Heal Ratio for check DFC_ThrVlvLoBattB1" VALUE 0x804F5AC5 Val_Wu8 3.00000000000 DDRC_Ratio 1.00000000000 4.00000000000 FORMAT "%13.11" /end CHARACTERISTIC
/begin CHARACTERISTIC DDRC_RatDeb.UEGO_tiOperPlausUDRat_C "Ratioof up-down debouncing / Defect / Heal Ratio for check DFC_UegoSigOperPlausS1B1" VALUE 0x804F5AC6 Val_Wu8 3.00000000000 DDRC_Ratio 1.00000000000 4.00000000000 FORMAT "%13.11" /end CHARACTERISTIC
/begin CHARACTERISTIC DDRC_RatDeb.VehV_tiCANSigFLUDRat_C "Ratioof up-down debouncing / Defect / Heal Ratio for check DFC_VehVSigFL" VALUE 0x804F5AC7 Val_Wu8 3.00000000000 DDRC_Ratio 1.00000000000 4.00000000000 FORMAT "%13.11" /end CHARACTERISTIC
/begin CHARACTERISTIC DDRC_RatDeb.VehV_tiCANSigFRUDRat_C "Ratioof up-down debouncing / Defect / Heal Ratio for check DFC_VehVSigFR" VALUE 0x804F5AC8 Val_Wu8 3.00000000000 DDRC_Ratio 1.00000000000 4.00000000000 FORMAT "%13.11" /end CHARACTERISTIC
/begin CHARACTERISTIC DDRC_RatDeb.VehV_tiCANSigRLUDRat_C "Ratioof up-down debouncing / Defect / Heal Ratio for check DFC_VehVSigRL" VALUE 0x804F5AC9 Val_Wu8 3.00000000000 DDRC_Ratio 1.00000000000 4.00000000000 FORMAT "%13.11" /end CHARACTERISTIC
/begin CHARACTERISTIC DDRC_RatDeb.VehV_tiCANSigRRUDRat_C "Ratioof up-down debouncing / Defect / Heal Ratio for check DFC_VehVSigRR" VALUE 0x804F5ACA Val_Wu8 3.00000000000 DDRC_Ratio 1.00000000000 4.00000000000 FORMAT "%13.11" /end CHARACTERISTIC
/begin CHARACTERISTIC DDRC_RatDeb.VehV_tiOLUDRat_C "Ratioof up-down debouncing / Defect / Heal Ratio for check DFC_VehVSclOutOL" VALUE 0x804F5ACB Val_Wu8 3.00000000000 DDRC_Ratio 1.00000000000 4.00000000000 FORMAT "%13.11" /end CHARACTERISTIC
/begin CHARACTERISTIC DDRC_RatDeb.VehV_tiOTUDRat_C "Ratioof up-down debouncing / Defect / Heal Ratio for check DFC_VehVSclOutOT" VALUE 0x804F5ACC Val_Wu8 3.00000000000 DDRC_Ratio 1.00000000000 4.00000000000 FORMAT "%13.11" /end CHARACTERISTIC
/begin CHARACTERISTIC DDRC_RatDeb.VehV_tiPhysRngHiUDRat_C "Ratioof up-down debouncing / Defect / Heal Ratio for check DFC_VehVPhysRngHi" VALUE 0x804F5ACD Val_Wu8 3.00000000000 DDRC_Ratio 1.00000000000 4.00000000000 FORMAT "%13.11" /end CHARACTERISTIC
/begin CHARACTERISTIC DDRC_RatDeb.VehV_tiSCBUDRat_C "Ratioof up-down debouncing / Defect / Heal Ratio for check DFC_VehVSclOutSCB" VALUE 0x804F5ACE Val_Wu8 3.00000000000 DDRC_Ratio 1.00000000000 4.00000000000 FORMAT "%13.11" /end CHARACTERISTIC
/begin CHARACTERISTIC DDRC_RatDeb.VehV_tiSCGUDRat_C "Ratioof up-down debouncing / Defect / Heal Ratio for check DFC_VehVSclOutSCG" VALUE 0x804F5ACF Val_Wu8 3.00000000000 DDRC_Ratio 1.00000000000 4.00000000000 FORMAT "%13.11" /end CHARACTERISTIC
/begin CHARACTERISTIC DDRC_RatDeb.VehV_tiSnsrARngHiUDRat_C "Ratioof up-down debouncing / Defect / Heal Ratio for check DFC_VehVSnsrARngHi" VALUE 0x804F5AD0 Val_Wu8 3.00000000000 DDRC_Ratio 1.00000000000 4.00000000000 FORMAT "%13.11" /end CHARACTERISTIC
/begin CHARACTERISTIC DDRC_RatDeb.VehV_tiSnsrBRngHiUDRat_C "Ratioof up-down debouncing / Defect / Heal Ratio for check DFC_VehVSnsrBRngHi" VALUE 0x804F5AD1 Val_Wu8 3.00000000000 DDRC_Ratio 1.00000000000 4.00000000000 FORMAT "%13.11" /end CHARACTERISTIC
/begin CHARACTERISTIC DDRC_RatDeb.VehV_tiSpdRtyDiagUDRat_C "Ratioof up-down debouncing / Defect / Heal Ratio for check DFC_VehVSpdRtyDiag" VALUE 0x804F5AD2 Val_Wu8 3.00000000000 DDRC_Ratio 1.00000000000 4.00000000000 FORMAT "%13.11" /end CHARACTERISTIC
/begin CHARACTERISTIC DDRC_RatDeb.DDHFHD_numDhfDebDef_CUDRat_C "Ratioof up-down debouncing / Defect / Heal Ratio for check DFC_DHFHD" VALUE 0x804F5AD3 Val_Wu8 3.00000000000 DDRC_Ratio 1.00000000000 4.00000000000 FORMAT "%13.11" /end CHARACTERISTIC
/begin CHARACTERISTIC DDRC_RatDeb.InjVlv_numDcDcUDRat_C "Ratioof up-down debouncing / Defect / Heal Ratio for check DFC_InjVlv_DI_DcDc" VALUE 0x804F5AD4 Val_Wu8 3.00000000000 DDRC_Ratio 1.00000000000 4.00000000000 FORMAT "%13.11" /end CHARACTERISTIC
/begin CHARACTERISTIC DDRC_RatDeb.InjVlv_numNoLdUDRat_C "Ratioof up-down debouncing / Defect / Heal Ratio for check DFC_InjVlv_DI_NoLd" VALUE 0x804F5AD5 Val_Wu8 3.00000000000 DDRC_Ratio 1.00000000000 4.00000000000 FORMAT "%13.11" /end CHARACTERISTIC
/begin CHARACTERISTIC DDRC_RatDeb.InjVlv_numScBnkUDRat_C "Ratioof up-down debouncing / Defect / Heal Ratio for check DFC_InjVlv_DI_ScBnk" VALUE 0x804F5AD6 Val_Wu8 3.00000000000 DDRC_Ratio 1.00000000000 4.00000000000 FORMAT "%13.11" /end CHARACTERISTIC
/begin CHARACTERISTIC DDRC_RatDeb.InjVlv_numScCylUDRat_C "Ratioof up-down debouncing / Defect / Heal Ratio for check DFC_InjVlv_DI_ScCyl" VALUE 0x804F5AD7 Val_Wu8 3.00000000000 DDRC_Ratio 1.00000000000 4.00000000000 FORMAT "%13.11" /end CHARACTERISTIC
/begin CHARACTERISTIC DDRC_RatDeb.InjVlv_numScHsLsUDRat_C "Ratioof up-down debouncing / Defect / Heal Ratio for check DFC_InjVlv_DI_ScHsLs" VALUE 0x804F5AD8 Val_Wu8 3.00000000000 DDRC_Ratio 1.00000000000 4.00000000000 FORMAT "%13.11" /end CHARACTERISTIC
/begin CHARACTERISTIC DDRC_RatDeb.MfPsDia_numOpenLoadUDRat_C "Ratioof up-down debouncing / Defect / Heal Ratio for check DFC_MfPsDiaOpenLoad1" VALUE 0x804F5AD9 Val_Wu8 3.00000000000 DDRC_Ratio 1.00000000000 4.00000000000 FORMAT "%13.11" /end CHARACTERISTIC
/begin CHARACTERISTIC DDRC_RatDeb.MfPsDia_numScHiSUDRat_C "Ratioof up-down debouncing / Defect / Heal Ratio for check DFC_MfPsDiaScHiS1" VALUE 0x804F5ADA Val_Wu8 3.00000000000 DDRC_Ratio 1.00000000000 4.00000000000 FORMAT "%13.11" /end CHARACTERISTIC
/begin CHARACTERISTIC DDRC_RatDeb.MfPsDia_numScHiSLowSUDRat_C "Ratioof up-down debouncing / Defect / Heal Ratio for check DFC_MfPsDiaScHiSLowS1" VALUE 0x804F5ADB Val_Wu8 3.00000000000 DDRC_Ratio 1.00000000000 4.00000000000 FORMAT "%13.11" /end CHARACTERISTIC
/begin CHARACTERISTIC DDRC_RatDeb.MfPsDia_numScLowSUDRat_C "Ratioof up-down debouncing / Defect / Heal Ratio for check DFC_MfPsDiaScLowS1" VALUE 0x804F5ADC Val_Wu8 3.00000000000 DDRC_Ratio 1.00000000000 4.00000000000 FORMAT "%13.11" /end CHARACTERISTIC
/begin CHARACTERISTIC DDRC_RatDeb.ACEvpT_tiPhysRngHiUDRat_C "Ratioof up-down debouncing / Defect / Heal Ratio for check DFC_ACEvpTPhysRngHi" VALUE 0x804F5ADD Val_Wu8 3.00000000000 DDRC_Ratio 1.00000000000 4.00000000000 FORMAT "%13.11" /end CHARACTERISTIC
/begin CHARACTERISTIC DDRC_RatDeb.ACEvpT_tiPhysRngLoUDRat_C "Ratioof up-down debouncing / Defect / Heal Ratio for check DFC_ACEvpTPhysRngLo" VALUE 0x804F5ADE Val_Wu8 3.00000000000 DDRC_Ratio 1.00000000000 4.00000000000 FORMAT "%13.11" /end CHARACTERISTIC
/begin CHARACTERISTIC DDRC_RatDeb.ACEvpT_tiSRCMaxUDRat_C "Ratioof up-down debouncing / Defect / Heal Ratio for check DFC_ACEvpTSRCMax" VALUE 0x804F5ADF Val_Wu8 3.00000000000 DDRC_Ratio 1.00000000000 4.00000000000 FORMAT "%13.11" /end CHARACTERISTIC
/begin CHARACTERISTIC DDRC_RatDeb.ACEvpT_tiSRCMinUDRat_C "Ratioof up-down debouncing / Defect / Heal Ratio for check DFC_ACEvpTSRCMin" VALUE 0x804F5AE0 Val_Wu8 3.00000000000 DDRC_Ratio 1.00000000000 4.00000000000 FORMAT "%13.11" /end CHARACTERISTIC
/begin CHARACTERISTIC DDRC_RatDeb.AFS_tiRawSigRngHiB1UDRat_C "Ratioof up-down debouncing / Defect / Heal Ratio for check DFC_AfsRawSigRngHiB1" VALUE 0x804F5AE1 Val_Wu8 3.00000000000 DDRC_Ratio 1.00000000000 4.00000000000 FORMAT "%13.11" /end CHARACTERISTIC
/begin CHARACTERISTIC DDRC_RatDeb.AFS_tiRawSigRngLoB1UDRat_C "Ratioof up-down debouncing / Defect / Heal Ratio for check DFC_AfsRawSigRngLoB1" VALUE 0x804F5AE2 Val_Wu8 3.00000000000 DDRC_Ratio 1.00000000000 4.00000000000 FORMAT "%13.11" /end CHARACTERISTIC
/begin CHARACTERISTIC DDRC_RatDeb.AFS_tiSnsrErrB1UDRat_C "Ratioof up-down debouncing / Defect / Heal Ratio for check DFC_AfsSnsrErrB1" VALUE 0x804F5AE3 Val_Wu8 3.00000000000 DDRC_Ratio 1.00000000000 4.00000000000 FORMAT "%13.11" /end CHARACTERISTIC
/begin CHARACTERISTIC DDRC_RatDeb.AirC_tiClntSRCMaxUDRat_C "Ratioof up-down debouncing / Defect / Heal Ratio for check DFC_AirCClntPAnaSRCMax" VALUE 0x804F5AE4 Val_Wu8 3.00000000000 DDRC_Ratio 1.00000000000 4.00000000000 FORMAT "%13.11" /end CHARACTERISTIC
/begin CHARACTERISTIC DDRC_RatDeb.AirC_tiClntSRCMinUDRat_C "Ratioof up-down debouncing / Defect / Heal Ratio for check DFC_AirCClntPAnaSRCMin" VALUE 0x804F5AE5 Val_Wu8 3.00000000000 DDRC_Ratio 1.00000000000 4.00000000000 FORMAT "%13.11" /end CHARACTERISTIC
/begin CHARACTERISTIC DDRC_RatDeb.AirC_tiSwtNplUDRat_C "Ratioof up-down debouncing / Defect / Heal Ratio for check DFC_AirCSwtNpl" VALUE 0x804F5AE6 Val_Wu8 3.00000000000 DDRC_Ratio 1.00000000000 4.00000000000 FORMAT "%13.11" /end CHARACTERISTIC
/begin CHARACTERISTIC DDRC_RatDeb.AirC_tiSwtSigUDRat_C "Ratioof up-down debouncing / Defect / Heal Ratio for check DFC_AirCSwtSig" VALUE 0x804F5AE7 Val_Wu8 3.00000000000 DDRC_Ratio 1.00000000000 4.00000000000 FORMAT "%13.11" /end CHARACTERISTIC
/begin CHARACTERISTIC DDRC_RatDeb.BrkBstP_tiSCBUDRat_C "Ratioof up-down debouncing / Defect / Heal Ratio for check DFC_BrkBstSensSCB" VALUE 0x804F5AE8 Val_Wu8 3.00000000000 DDRC_Ratio 1.00000000000 4.00000000000 FORMAT "%13.11" /end CHARACTERISTIC
/begin CHARACTERISTIC DDRC_RatDeb.BrkBstP_tiSCGUDRat_C "Ratioof up-down debouncing / Defect / Heal Ratio for check DFC_BrkBstSensSCG" VALUE 0x804F5AE9 Val_Wu8 3.00000000000 DDRC_Ratio 1.00000000000 4.00000000000 FORMAT "%13.11" /end CHARACTERISTIC
/begin CHARACTERISTIC DDRC_RatDeb.Brk_tiUDRat_C "Ratioof up-down debouncing / Defect / Heal Ratio for check DFC_Brk" VALUE 0x804F5AEA Val_Wu8 3.00000000000 DDRC_Ratio 1.00000000000 4.00000000000 FORMAT "%13.11" /end CHARACTERISTIC
/begin CHARACTERISTIC DDRC_RatDeb.Brk_tiSigUDRat_C "Ratioof up-down debouncing / Defect / Heal Ratio for check DFC_BrkSig" VALUE 0x804F5AEB Val_Wu8 3.00000000000 DDRC_Ratio 1.00000000000 4.00000000000 FORMAT "%13.11" /end CHARACTERISTIC
/begin CHARACTERISTIC DDRC_RatDeb.Clth_tiSigUDRat_C "Ratioof up-down debouncing / Defect / Heal Ratio for check DFC_ClthSig" VALUE 0x804F5AEC Val_Wu8 3.00000000000 DDRC_Ratio 1.00000000000 4.00000000000 FORMAT "%13.11" /end CHARACTERISTIC
/begin CHARACTERISTIC DDRC_RatDeb.EGRVlv_tiCurrLimUDRat_C "Ratioof up-down debouncing / Defect / Heal Ratio for check DFC_EGRVlvCurrLim" VALUE 0x804F5AED Val_Wu8 3.00000000000 DDRC_Ratio 1.00000000000 4.00000000000 FORMAT "%13.11" /end CHARACTERISTIC
/begin CHARACTERISTIC DDRC_RatDeb.EGRVlv_tiOLUDRat_C "Ratioof up-down debouncing / Defect / Heal Ratio for check DFC_EGRVlvOL" VALUE 0x804F5AEE Val_Wu8 3.00000000000 DDRC_Ratio 1.00000000000 4.00000000000 FORMAT "%13.11" /end CHARACTERISTIC
/begin CHARACTERISTIC DDRC_RatDeb.EGRVlv_tiOvrTempUDRat_C "Ratioof up-down debouncing / Defect / Heal Ratio for check DFC_EGRVlvOvrTemp" VALUE 0x804F5AEF Val_Wu8 3.00000000000 DDRC_Ratio 1.00000000000 4.00000000000 FORMAT "%13.11" /end CHARACTERISTIC
/begin CHARACTERISTIC DDRC_RatDeb.EGRVlv_tiSCBUDRat_C "Ratioof up-down debouncing / Defect / Heal Ratio for check DFC_EGRVlvSCB" VALUE 0x804F5AF0 Val_Wu8 3.00000000000 DDRC_Ratio 1.00000000000 4.00000000000 FORMAT "%13.11" /end CHARACTERISTIC
/begin CHARACTERISTIC DDRC_RatDeb.EGRVlv_tiSCGUDRat_C "Ratioof up-down debouncing / Defect / Heal Ratio for check DFC_EGRVlvSCG" VALUE 0x804F5AF1 Val_Wu8 3.00000000000 DDRC_Ratio 1.00000000000 4.00000000000 FORMAT "%13.11" /end CHARACTERISTIC
/begin CHARACTERISTIC DDRC_RatDeb.EGRVlv_tiSRCMaxUDRat_C "Ratioof up-down debouncing / Defect / Heal Ratio for check DFC_EGRVlvSRCMax" VALUE 0x804F5AF2 Val_Wu8 3.00000000000 DDRC_Ratio 1.00000000000 4.00000000000 FORMAT "%13.11" /end CHARACTERISTIC
/begin CHARACTERISTIC DDRC_RatDeb.EGRVlv_tiSRCMinUDRat_C "Ratioof up-down debouncing / Defect / Heal Ratio for check DFC_EGRVlvSRCMin" VALUE 0x804F5AF3 Val_Wu8 3.00000000000 DDRC_Ratio 1.00000000000 4.00000000000 FORMAT "%13.11" /end CHARACTERISTIC
/begin CHARACTERISTIC DDRC_RatDeb.HLSDem_tiOvhtUDRat_C "Ratioof up-down debouncing / Defect / Heal Ratio for check DFC_HLSDemOvhtEngLim" VALUE 0x804F5AF4 Val_Wu8 3.00000000000 DDRC_Ratio 1.00000000000 4.00000000000 FORMAT "%13.11" /end CHARACTERISTIC
/begin CHARACTERISTIC DDRC_RatDeb.Oil_tiSRCMaxPSwmpUDRat_C "Ratioof up-down debouncing / Defect / Heal Ratio for check DFC_OilPSwmpSRCMax" VALUE 0x804F5AF5 Val_Wu8 3.00000000000 DDRC_Ratio 1.00000000000 4.00000000000 FORMAT "%13.11" /end CHARACTERISTIC
/begin CHARACTERISTIC DDRC_RatDeb.Oil_tiSRCMinPSwmpUDRat_C "Ratioof up-down debouncing / Defect / Heal Ratio for check DFC_OilPSwmpSRCMin" VALUE 0x804F5AF6 Val_Wu8 3.00000000000 DDRC_Ratio 1.00000000000 4.00000000000 FORMAT "%13.11" /end CHARACTERISTIC
/begin CHARACTERISTIC DDRC_RatDeb.PIntkVUs_tiLineHiB1UDRat_C "Ratioof up-down debouncing / Defect / Heal Ratio for check DFC_PIntkVUsLineHiB1" VALUE 0x804F5AF7 Val_Wu8 3.00000000000 DDRC_Ratio 1.00000000000 4.00000000000 FORMAT "%13.11" /end CHARACTERISTIC
/begin CHARACTERISTIC DDRC_RatDeb.PIntkVUs_tiLineLoB1UDRat_C "Ratioof up-down debouncing / Defect / Heal Ratio for check DFC_PIntkVUsLineLoB1" VALUE 0x804F5AF8 Val_Wu8 3.00000000000 DDRC_Ratio 1.00000000000 4.00000000000 FORMAT "%13.11" /end CHARACTERISTIC
/begin CHARACTERISTIC DDRC_RatDeb.VehV_tiPhysRngLoUDRat_C "Ratioof up-down debouncing / Defect / Heal Ratio for check DFC_VehVPhysRngLo" VALUE 0x804F5AF9 Val_Wu8 3.00000000000 DDRC_Ratio 1.00000000000 4.00000000000 FORMAT "%13.11" /end CHARACTERISTIC
/begin CHARACTERISTIC DDRC_RatDeb.VehV_tiSigCanUDRat_C "Ratioof up-down debouncing / Defect / Heal Ratio for check DFC_VehVSigCan" VALUE 0x804F5AFA Val_Wu8 3.00000000000 DDRC_Ratio 1.00000000000 4.00000000000 FORMAT "%13.11" /end CHARACTERISTIC
/begin CHARACTERISTIC DDRC_RatDeb.VehV_tiSigCanSafeUDRat_C "Ratioof up-down debouncing / Defect / Heal Ratio for check DFC_VehVSigCanSafe" VALUE 0x804F5AFB Val_Wu8 3.00000000000 DDRC_Ratio 1.00000000000 4.00000000000 FORMAT "%13.11" /end CHARACTERISTIC
/begin CHARACTERISTIC DDRC_RatDeb.VlvLft_tiSRCMaxOilPSnsrIntk11UDRat_C "Ratioof up-down debouncing / Defect / Heal Ratio for check DFC_VlvLftFbOilPSnsrIntk11SRCMax" VALUE 0x804F5AFC Val_Wu8 3.00000000000 DDRC_Ratio 1.00000000000 4.00000000000 FORMAT "%13.11" /end CHARACTERISTIC
/begin CHARACTERISTIC DDRC_RatDeb.VlvLft_tiSRCMinOilPSnsrIntk11UDRat_C "Ratioof up-down debouncing / Defect / Heal Ratio for check DFC_VlvLftFbOilPSnsrIntk11SRCMin" VALUE 0x804F5AFD Val_Wu8 3.00000000000 DDRC_Ratio 1.00000000000 4.00000000000 FORMAT "%13.11" /end CHARACTERISTIC
/begin CHARACTERISTIC DDRC_RatDeb.Clth_numPlaUDRat_C "Ratioof up-down debouncing / Defect / Heal Ratio for check DFC_ClthNpl" VALUE 0x804F5AFE Val_Wu8 3.00000000000 DDRC_Ratio 1.00000000000 4.00000000000 FORMAT "%13.11" /end CHARACTERISTIC
/begin CHARACTERISTIC DDRC_RatDeb.Gbx_numPNPosnDrvCdnUDRat_C "Ratioof up-down debouncing / Defect / Heal Ratio for check DFC_GbxPNPosnDrvCdn" VALUE 0x804F5AFF Val_Wu8 3.00000000000 DDRC_Ratio 1.00000000000 4.00000000000 FORMAT "%13.11" /end CHARACTERISTIC
/begin CHARACTERISTIC DDRC_RatDeb.Gbx_numPNPosnPlausyUDRat_C "Ratioof up-down debouncing / Defect / Heal Ratio for check DFC_GbxPNPosnPlausy" VALUE 0x804F5B00 Val_Wu8 3.00000000000 DDRC_Ratio 1.00000000000 4.00000000000 FORMAT "%13.11" /end CHARACTERISTIC
/begin CHARACTERISTIC DDSKVFRAMN "min threshold for fra mixture deviation" VALUE 0x8053AE7A RB_Val_Wu16 1.999969 fak_uw_b2 0.00 1.999969 FORMAT "%8.6" /end CHARACTERISTIC
/begin CHARACTERISTIC DDSKVFRAMX "max threshold for fra mixture deviation" VALUE 0x8053AE7C RB_Val_Wu16 1.999969 fak_uw_b2 0.00 1.999969 FORMAT "%8.6" /end CHARACTERISTIC
/begin CHARACTERISTIC DDSKVORAMN "min threshold for ora mixture deviation" VALUE 0x8053AE7E RB_Val_Ws16 3071.953 rel_sw_b1536 -1536.000 1535.953 FORMAT "%8.3" /end CHARACTERISTIC
/begin CHARACTERISTIC DDSKVORAMX "max threshold for ora mixture deviation" VALUE 0x8053AE80 RB_Val_Ws16 3071.953 rel_sw_b1536 -1536.000 1535.953 FORMAT "%8.3" /end CHARACTERISTIC
/begin CHARACTERISTIC DSKVTABST "delay time to recognize cold soak" VALUE 0x8053AE82 RB_Val_Wu16 65535.00 t1sxs_uw_q1 0.00 65535.00 FORMAT "%8.2" /end CHARACTERISTIC
/begin CHARACTERISTIC DTMSTANSO "upper threshold for the closed intervall between tum and tans" VALUE 0x8053AE84 RB_Val_Wu8 191.3 temp_ub_q0p75_o48 -48.0 143.3 FORMAT "%5.1" /end CHARACTERISTIC
/begin CHARACTERISTIC DTMSTTUMO "upper threshold for the difference of ambient air temperature and engine start temperature" VALUE 0x8053AE85 RB_Val_Wu8 191.3 temp_ub_q0p75_o48 -48.0 143.3 FORMAT "%5.1" /end CHARACTERISTIC
/begin CHARACTERISTIC DTMSTTUMU "lower threshold for the difference of ambient air temperature and engine start temperature" VALUE 0x8053AE86 RB_Val_Wu8 191.3 temp_ub_q0p75_o48 -48.0 143.3 FORMAT "%5.1" /end CHARACTERISTIC
/begin CHARACTERISTIC DTUMTANSU "lower threshold for the difference of ambient air temperature and intake air temperature" VALUE 0x8053AE87 RB_Val_Wu8 191.3 temp_ub_q0p75_o48 -48.0 143.3 FORMAT "%5.1" /end CHARACTERISTIC
/begin CHARACTERISTIC FuPHi_pAftPreDrvMin_C "absolute pressure threshold for ekp prerun pressure" VALUE 0x8053AE88 RB_Val_Wu16 131.0700 RBPtCel_p_0p002_1 0.00 131.0700 FORMAT "%8.4" /end CHARACTERISTIC
/begin CHARACTERISTIC FuPHi_pNegOffsSuspcThd_C "threshold for negative offset" VALUE 0x8053AE8A RB_Val_Wu16 131.0700 RBPtCel_p_0p002_1 0.00 131.0700 FORMAT "%8.4" /end CHARACTERISTIC
/begin CHARACTERISTIC FuPHi_pPosOffsAftPreRunThd_C "threshold for positive offset after PSP prerun" VALUE 0x8053AE8C RB_Val_Wu16 131.0700 RBPtCel_p_0p002_1 0.00 131.0700 FORMAT "%8.4" /end CHARACTERISTIC
/begin CHARACTERISTIC FuPHi_pPosOffsSuspcThd_C "threshold for suspicion positive offset" VALUE 0x8053AE8E RB_Val_Wu16 131.0700 RBPtCel_p_0p002_1 0.00 131.0700 FORMAT "%8.4" /end CHARACTERISTIC
/begin CHARACTERISTIC FuPHi_pRngChkMaxExtd_T "Table for upper limit of range check, dependent on nmot" CURVE 0x8053AE90 RB_Curve_U8_U16_Static 131.0700 RBPtCel_p_0p002_1 0.00 131.0700 FORMAT "%8.4"
 /begin AXIS_DESCR STD_AXIS Epm_nEngLRes nmot_ub_q40 5 0.00 10200. FORMAT "%5.0" DEPOSIT ABSOLUTE /end AXIS_DESCR
/end CHARACTERISTIC
/begin CHARACTERISTIC FuPHi_pRngChkMin_C "minimum value for plausible rail pressure" VALUE 0x8053AEA0 RB_Val_Ws16 131.0700 RBPtCel_p_0p002_1 -65.53600 65.53400 FORMAT "%8.5" /end CHARACTERISTIC
/begin CHARACTERISTIC FuPHi_pSpstPhdMin_C "pressure threshold for ban of stop" VALUE 0x8053AEA2 RB_Val_Wu16 131.0700 RBPtCel_p_0p002_1 0.00 131.0700 FORMAT "%8.4" /end CHARACTERISTIC
/begin CHARACTERISTIC KLTDDSNO "threshold to avoid fault diagnosis, air in System" CURVE 0x8053AEA4 RB_Curve_U16_U8_Static 2.550 t_q0p01 0.00 2.550 FORMAT "%5.3"
 /begin AXIS_DESCR STD_AXIS tiekp_w t_q0p1 6 0.00 6553.500 FORMAT "%8.3" DEPOSIT ABSOLUTE /end AXIS_DESCR
/end CHARACTERISTIC
/begin CHARACTERISTIC NDECJ "Engine speed threshold for power stage diagnosis" VALUE 0x8058A942 KwWU8 10200. EngN_LRes 0.00 10200. FORMAT "%5.0" /end CHARACTERISTIC
/begin CHARACTERISTIC TATMDIFF "temperature limit for changeable ambient conditions before start" VALUE 0x8053AEB8 RB_Val_Wu8 191.3 temp_ub_q0p75_o48 -48.0 143.3 FORMAT "%5.1" /end CHARACTERISTIC
/begin CHARACTERISTIC TDEKPON "delay time EKP-pre run" VALUE 0x8053AEB9 RB_Val_Wu8 2.550 t_q0p01 0.00 2.550 FORMAT "%5.3" /end CHARACTERISTIC
/begin CHARACTERISTIC TDEKPPRE "delay time EKP-pre run in predrive" VALUE 0x8053AEBA RB_Val_Wu8 2.550 t_q0p01 0.00 2.550 FORMAT "%5.3" /end CHARACTERISTIC
/begin CHARACTERISTIC TMABSDSO "temperature threshold tmotab to recognize cold soak" VALUE 0x8053AEBB RB_Val_Wu8 191.3 temp_ub_q0p75_o48 -48.0 143.3 FORMAT "%5.1" /end CHARACTERISTIC
/begin CHARACTERISTIC TMMXREQ "tmot threshold for ban of stop" VALUE 0x8053AEBC RB_Val_Wu8 191.3 temp_ub_q0p75_o48 -48.0 143.3 FORMAT "%5.1" /end CHARACTERISTIC
/begin CHARACTERISTIC TMSTSDSO "temperature threshold tmst to recognize cold soak" VALUE 0x8053AEBD RB_Val_Wu8 191.3 temp_ub_q0p75_o48 -48.0 143.3 FORMAT "%5.1" /end CHARACTERISTIC
/begin CHARACTERISTIC TMTADIFF "temperature limit for auxiliary heating before start" VALUE 0x8053AEBE RB_Val_Wu8 191.3 temp_ub_q0p75_o48 -48.0 143.3 FORMAT "%5.1" /end CHARACTERISTIC
/begin CHARACTERISTIC TNSEDDSKV "max delay for retrigger after engine start" VALUE 0x8053AEC0 RB_Val_Wu16 6553.500 t_q0p1 0.00 6553.500 FORMAT "%8.3" /end CHARACTERISTIC
/begin CHARACTERISTIC TSTENDDSNO "threshold to avoid fault diagnosis, failure EKP or empty fuel tank" VALUE 0x8053AEC2 RB_Val_Wu16 3276.750 t_q0p05 0.00 3276.750 FORMAT "%8.3" /end CHARACTERISTIC
/begin CHARACTERISTIC TVDDSKV "delay time for retrigger of cold soak condition" VALUE 0x8053AEC4 RB_Val_Wu16 655.3500 t_q0p01 0.00 655.3500 FORMAT "%8.4" /end CHARACTERISTIC
/begin CHARACTERISTIC TVDDSKVEO "delay time for ban of stop" VALUE 0x8053AEC6 RB_Val_Wu8 12.75 t_q0p05 0.00 12.75 FORMAT "%5.2" /end CHARACTERISTIC
/begin CHARACTERISTIC TVDDSKVSEO "delay time for reset of ban of stop" VALUE 0x8053AEC8 RB_Val_Wu16 3276.750 t_q0p05 0.00 3276.750 FORMAT "%8.3" /end CHARACTERISTIC
/begin CHARACTERISTIC TVDSKVRH "Time constant for healing of pressure sensor error" VALUE 0x8053AECA RB_Val_Wu8 12.75 t_q0p05 0.00 12.75 FORMAT "%5.2" /end CHARACTERISTIC
/begin CHARACTERISTIC TVDSKVRHL "Time constant for healing range check of pressure sensor error" VALUE 0x8053AECB RB_Val_Wu8 12.75 t_q0p05 0.00 12.75 FORMAT "%5.2" /end CHARACTERISTIC
/begin CHARACTERISTIC TVPRMNPL "Debouncing time of high pressure sensor range check" VALUE 0x8053AECC RB_Val_Wu8 12.75 t_q0p05 0.00 12.75 FORMAT "%5.2" /end CHARACTERISTIC
/begin CHARACTERISTIC UBCJMN "Min. Ubat-threshold for release of the power stage diagnosis" VALUE 0x8058A944 KwWU16 15000.00 Volt_Batt 0.00 15000.00 FORMAT "%8.2" EXTENDED_LIMITS 0.00 1310700. /end CHARACTERISTIC
/begin CHARACTERISTIC UBCJMX "Max. Ubat-threshold f. release of the BSP 752 R-power stage diagnosis" VALUE 0x8058A946 KwWU16 25500.00 Volt_Batt 0.00 25500.00 FORMAT "%8.2" EXTENDED_LIMITS 0.00 1310700. /end CHARACTERISTIC
/begin MEASUREMENT B_bhdtf "Time window for blockheater detection finished" UBYTE B_TRUE 1 100 0.00 1.00000000000 BIT_MASK 0x1 FORMAT "%13.11" ECU_ADDRESS 0x60000112 /end MEASUREMENT
/begin MEASUREMENT B_coskneg "no negative offset" UBYTE B_TRUE 1 100 0.00 1.00000000000 BIT_MASK 0x1 FORMAT "%13.11" ECU_ADDRESS 0x60000111 /end MEASUREMENT
/begin MEASUREMENT B_coskretr "Retrigger of DDSKV cold soak condition" UBYTE B_TRUE 1 100 0.00 1.00000000000 BIT_MASK 0x1 FORMAT "%13.11" ECU_ADDRESS 0x60000110 /end MEASUREMENT
/begin MEASUREMENT B_deseehr_msg "Diagnosis power stage after the main Relay: entry conditions fulfilled" UBYTE B_TRUE 1 100 0.00 1.00000000000 BIT_MASK 0x1 FORMAT "%13.11" ECU_ADDRESS 0x70000C14 /end MEASUREMENT
/begin MEASUREMENT B_desee_msg "Diagnosis power stages, entry conditions fulfilled" UBYTE B_TRUE 1 100 0.00 1.00000000000 BIT_MASK 0x1 FORMAT "%13.11" ECU_ADDRESS 0x70000C15 /end MEASUREMENT
/begin MEASUREMENT B_dskvcosk_msg "condition cold soak" UBYTE B_TRUE 1 100 0.00 1.00000000000 BIT_MASK 0x1 FORMAT "%13.11" ECU_ADDRESS 0x6000023E /end MEASUREMENT
/begin MEASUREMENT B_dskvekpv "positive offset suspicion via ekp prerun pressure" UBYTE B_TRUE 1 100 0.00 1.00000000000 BIT_MASK 0x1 FORMAT "%13.11" ECU_ADDRESS 0x60036DEB /end MEASUREMENT
/begin MEASUREMENT B_dskveno "condition negative offset error" UBYTE B_TRUE 1 100 0.00 1.00000000000 BIT_MASK 0x1 FORMAT "%13.11" ECU_ADDRESS 0x6000010F /end MEASUREMENT
/begin MEASUREMENT B_dskvepo_msg "condition positive offset error" UBYTE B_TRUE 1 100 0.00 1.00000000000 BIT_MASK 0x1 FORMAT "%13.11" ECU_ADDRESS 0x6000023D /end MEASUREMENT
/begin MEASUREMENT B_dskvnng_msg "condition suspicion negative offset" UBYTE B_TRUE 1 100 0.00 1.00000000000 BIT_MASK 0x1 FORMAT "%13.11" ECU_ADDRESS 0x6000023C /end MEASUREMENT
/begin MEASUREMENT B_dskvnno_msg "condition no negative offset error" UBYTE B_TRUE 1 100 0.00 1.00000000000 BIT_MASK 0x1 FORMAT "%13.11" ECU_ADDRESS 0x6000023B /end MEASUREMENT
/begin MEASUREMENT B_dskvnpl "condition negative offset error (npl (error)" UBYTE B_TRUE 1 100 0.00 1.00000000000 BIT_MASK 0x1 FORMAT "%13.11" ECU_ADDRESS 0x6000010E /end MEASUREMENT
/begin MEASUREMENT B_dskvnpo_msg "condition no positive offset" UBYTE B_TRUE 1 100 0.00 1.00000000000 BIT_MASK 0x1 FORMAT "%13.11" ECU_ADDRESS 0x6000023A /end MEASUREMENT
/begin MEASUREMENT B_dskvpwf "condition power failure" UBYTE B_TRUE 1 100 0.00 1.00000000000 BIT_MASK 0x1 FORMAT "%13.11" ECU_ADDRESS 0x60036DEA /end MEASUREMENT
/begin MEASUREMENT B_dskvsepo_msg "condition suspicion positive offset error" UBYTE B_TRUE 1 100 0.00 1.00000000000 BIT_MASK 0x1 FORMAT "%13.11" ECU_ADDRESS 0x60036E3B /end MEASUREMENT
/begin MEASUREMENT B_dskvsig_msg "condition positive offset error(sig error)" UBYTE B_TRUE 1 100 0.00 1.00000000000 BIT_MASK 0x1 FORMAT "%13.11" ECU_ADDRESS 0x60000239 /end MEASUREMENT
/begin MEASUREMENT B_dskvsno_msg "condition suspicion negative offset error" UBYTE B_TRUE 1 100 0.00 1.00000000000 BIT_MASK 0x1 FORMAT "%13.11" ECU_ADDRESS 0x60036E3A /end MEASUREMENT
/begin MEASUREMENT B_dskvspoi_msg "condition suspicion positive offset" UBYTE B_TRUE 1 100 0.00 1.00000000000 BIT_MASK 0x1 FORMAT "%13.11" ECU_ADDRESS 0x60000238 /end MEASUREMENT
/begin MEASUREMENT B_dskvspo_msg "condition suspicion positive offset" UBYTE B_TRUE 1 100 0.00 1.00000000000 BIT_MASK 0x1 FORMAT "%13.11" ECU_ADDRESS 0x60036E39 /end MEASUREMENT
/begin MEASUREMENT B_dskvtank_msg "condition fuel is in tank and ekp is ok" UBYTE B_TRUE 1 100 0.00 1.00000000000 BIT_MASK 0x1 FORMAT "%13.11" ECU_ADDRESS 0x60000237 /end MEASUREMENT
/begin MEASUREMENT B_ekpvlpre "condition ekp pre-run in predrive ended" UBYTE B_TRUE 1 100 0.00 1.00000000000 BIT_MASK 0x1 FORMAT "%13.11" ECU_ADDRESS 0x60036DE9 /end MEASUREMENT
/begin MEASUREMENT B_initpr "init pressure is available" UBYTE B_TRUE 1 100 0.00 1.00000000000 BIT_MASK 0x1 FORMAT "%13.11" ECU_ADDRESS 0x6000010D /end MEASUREMENT
/begin MEASUREMENT B_nmotno_msg "condition nmot not" UBYTE B_TRUE 1 100 0.00 1.00000000000 BIT_MASK 0x1 FORMAT "%13.11" ECU_ADDRESS 0x600001F1 /end MEASUREMENT
/begin MEASUREMENT B_plprroh_msg "Condition high pressure sensor plausible" UBYTE B_TRUE 1 100 0.00 1.00000000000 BIT_MASK 0x1 FORMAT "%13.11" ECU_ADDRESS 0x600001E5 /end MEASUREMENT
/begin MEASUREMENT B_PmdInit_msg "Reset of standard powerstage diagnosis required" UBYTE B_TRUE 1 100 0.00 1.00000000000 BIT_MASK 0x1 FORMAT "%13.11" ECU_ADDRESS 0x70000C42 /end MEASUREMENT
/begin MEASUREMENT B_prcproh "condition range check no error" UBYTE B_TRUE 1 100 0.00 1.00000000000 BIT_MASK 0x1 FORMAT "%13.11" ECU_ADDRESS 0x6000010C /end MEASUREMENT
/begin MEASUREMENT B_prini "condition: rail pressure at ini2 pressent" UBYTE B_TRUE 1 100 0.00 1.00000000000 BIT_MASK 0x1 FORMAT "%13.11" ECU_ADDRESS 0x6000010B /end MEASUREMENT
/begin MEASUREMENT B_propre "condition: rail pressure at predrive" UBYTE B_TRUE 1 100 0.00 1.00000000000 BIT_MASK 0x1 FORMAT "%13.11" ECU_ADDRESS 0x6000010A /end MEASUREMENT
/begin MEASUREMENT B_proten "condition: rail pressure at ini2 calculate" UBYTE B_TRUE 1 100 0.00 1.00000000000 BIT_MASK 0x1 FORMAT "%13.11" ECU_ADDRESS 0x60000109 /end MEASUREMENT
/begin MEASUREMENT B_prpre "condition: rail pressure at predrive before ekp prerun present" UBYTE B_TRUE 1 100 0.00 1.00000000000 BIT_MASK 0x1 FORMAT "%13.11" ECU_ADDRESS 0x60036DE8 /end MEASUREMENT
/begin MEASUREMENT B_reqddskv_msg "Condition request action of fuel mixture adaptation because of a suspicion high pressure sensor offset" UBYTE B_TRUE 1 100 0.00 1.00000000000 BIT_MASK 0x1 FORMAT "%13.11" ECU_ADDRESS 0x600001DC /end MEASUREMENT
/begin MEASUREMENT B_tiekold "recognizing ekp prerun" UBYTE B_TRUE 1 100 0.00 1.00000000000 BIT_MASK 0x1 FORMAT "%13.11" ECU_ADDRESS 0x60000108 /end MEASUREMENT
/begin MEASUREMENT DDRCObsvr_stUpdDi "Status of statistics value array update disable" UBYTE OneToOne 1 100 0.00 255.0 FORMAT "%5.1" ARRAY_SIZE 32 ECU_ADDRESS 0x60011B8A /end MEASUREMENT
/begin MEASUREMENT DDRCObsvr_Val.DebStcVal0 "" UBYTE OneToOne 1 100 0.00 255.0 FORMAT "%5.1" ARRAY_SIZE 3 ECU_ADDRESS 0x60038914 /end MEASUREMENT
/begin MEASUREMENT DDRCObsvr_Val.DebStcVal1 "" UBYTE OneToOne 1 100 0.00 255.0 FORMAT "%5.1" ARRAY_SIZE 3 ECU_ADDRESS 0x60038917 /end MEASUREMENT
/begin MEASUREMENT DDRCObsvr_Val.DebStcVal2 "" UBYTE OneToOne 1 100 0.00 255.0 FORMAT "%5.1" ARRAY_SIZE 3 ECU_ADDRESS 0x6003891A /end MEASUREMENT
/begin MEASUREMENT DDRCObsvr_Val.DebStcVal3 "" UBYTE OneToOne 1 100 0.00 255.0 FORMAT "%5.1" ARRAY_SIZE 3 ECU_ADDRESS 0x6003891D /end MEASUREMENT
/begin MEASUREMENT DDRCObsvr_Val.DebStcVal4 "" UBYTE OneToOne 1 100 0.00 255.0 FORMAT "%5.1" ARRAY_SIZE 3 ECU_ADDRESS 0x60038920 /end MEASUREMENT
/begin MEASUREMENT DDRCObsvr_Val.DebStcVal5 "" UBYTE OneToOne 1 100 0.00 255.0 FORMAT "%5.1" ARRAY_SIZE 3 ECU_ADDRESS 0x60038923 /end MEASUREMENT
/begin MEASUREMENT DDRCObsvr_Val.DebStcVal6 "" UBYTE OneToOne 1 100 0.00 255.0 FORMAT "%5.1" ARRAY_SIZE 3 ECU_ADDRESS 0x60038926 /end MEASUREMENT
/begin MEASUREMENT DDRCObsvr_Val.DebStcVal7 "" UBYTE OneToOne 1 100 0.00 255.0 FORMAT "%5.1" ARRAY_SIZE 3 ECU_ADDRESS 0x60038929 /end MEASUREMENT
/begin MEASUREMENT DDRCObsvr_Val.DebStcVal8 "" UBYTE OneToOne 1 100 0.00 255.0 FORMAT "%5.1" ARRAY_SIZE 3 ECU_ADDRESS 0x6003892C /end MEASUREMENT
/begin MEASUREMENT DDRCObsvr_Val.DebStcVal9 "" UBYTE OneToOne 1 100 0.00 255.0 FORMAT "%5.1" ARRAY_SIZE 3 ECU_ADDRESS 0x6003892F /end MEASUREMENT
/begin MEASUREMENT DDRCObsvr_Val.DebStcVal10 "" UBYTE OneToOne 1 100 0.00 255.0 FORMAT "%5.1" ARRAY_SIZE 3 ECU_ADDRESS 0x60038932 /end MEASUREMENT
/begin MEASUREMENT DDRCObsvr_Val.DebStcVal11 "" UBYTE OneToOne 1 100 0.00 255.0 FORMAT "%5.1" ARRAY_SIZE 3 ECU_ADDRESS 0x60038935 /end MEASUREMENT
/begin MEASUREMENT DDRCObsvr_Val.DebStcVal12 "" UBYTE OneToOne 1 100 0.00 255.0 FORMAT "%5.1" ARRAY_SIZE 3 ECU_ADDRESS 0x60038938 /end MEASUREMENT
/begin MEASUREMENT DDRCObsvr_Val.DebStcVal13 "" UBYTE OneToOne 1 100 0.00 255.0 FORMAT "%5.1" ARRAY_SIZE 3 ECU_ADDRESS 0x6003893B /end MEASUREMENT
/begin MEASUREMENT DDRCObsvr_Val.DebStcVal14 "" UBYTE OneToOne 1 100 0.00 255.0 FORMAT "%5.1" ARRAY_SIZE 3 ECU_ADDRESS 0x6003893E /end MEASUREMENT
/begin MEASUREMENT DDRCObsvr_Val.DebStcVal15 "" UBYTE OneToOne 1 100 0.00 255.0 FORMAT "%5.1" ARRAY_SIZE 3 ECU_ADDRESS 0x60038941 /end MEASUREMENT
/begin MEASUREMENT DDRCObsvr_Val.DebStcVal16 "" UBYTE OneToOne 1 100 0.00 255.0 FORMAT "%5.1" ARRAY_SIZE 3 ECU_ADDRESS 0x60038944 /end MEASUREMENT
/begin MEASUREMENT DDRCObsvr_Val.DebStcVal17 "" UBYTE OneToOne 1 100 0.00 255.0 FORMAT "%5.1" ARRAY_SIZE 3 ECU_ADDRESS 0x60038947 /end MEASUREMENT
/begin MEASUREMENT DDRCObsvr_Val.DebStcVal18 "" UBYTE OneToOne 1 100 0.00 255.0 FORMAT "%5.1" ARRAY_SIZE 3 ECU_ADDRESS 0x6003894A /end MEASUREMENT
/begin MEASUREMENT DDRCObsvr_Val.DebStcVal19 "" UBYTE OneToOne 1 100 0.00 255.0 FORMAT "%5.1" ARRAY_SIZE 3 ECU_ADDRESS 0x6003894D /end MEASUREMENT
/begin MEASUREMENT DDRCObsvr_Val.DebStcVal20 "" UBYTE OneToOne 1 100 0.00 255.0 FORMAT "%5.1" ARRAY_SIZE 3 ECU_ADDRESS 0x60038950 /end MEASUREMENT
/begin MEASUREMENT DDRCObsvr_Val.DebStcVal21 "" UBYTE OneToOne 1 100 0.00 255.0 FORMAT "%5.1" ARRAY_SIZE 3 ECU_ADDRESS 0x60038953 /end MEASUREMENT
/begin MEASUREMENT DDRCObsvr_Val.DebStcVal22 "" UBYTE OneToOne 1 100 0.00 255.0 FORMAT "%5.1" ARRAY_SIZE 3 ECU_ADDRESS 0x60038956 /end MEASUREMENT
/begin MEASUREMENT DDRCObsvr_Val.DebStcVal23 "" UBYTE OneToOne 1 100 0.00 255.0 FORMAT "%5.1" ARRAY_SIZE 3 ECU_ADDRESS 0x60038959 /end MEASUREMENT
/begin MEASUREMENT DDRCObsvr_Val.DebStcVal24 "" UBYTE OneToOne 1 100 0.00 255.0 FORMAT "%5.1" ARRAY_SIZE 3 ECU_ADDRESS 0x6003895C /end MEASUREMENT
/begin MEASUREMENT DDRCObsvr_Val.DebStcVal25 "" UBYTE OneToOne 1 100 0.00 255.0 FORMAT "%5.1" ARRAY_SIZE 3 ECU_ADDRESS 0x6003895F /end MEASUREMENT
/begin MEASUREMENT DDRCObsvr_Val.DebStcVal26 "" UBYTE OneToOne 1 100 0.00 255.0 FORMAT "%5.1" ARRAY_SIZE 3 ECU_ADDRESS 0x60038962 /end MEASUREMENT
/begin MEASUREMENT DDRCObsvr_Val.DebStcVal27 "" UBYTE OneToOne 1 100 0.00 255.0 FORMAT "%5.1" ARRAY_SIZE 3 ECU_ADDRESS 0x60038965 /end MEASUREMENT
/begin MEASUREMENT DDRCObsvr_Val.DebStcVal28 "" UBYTE OneToOne 1 100 0.00 255.0 FORMAT "%5.1" ARRAY_SIZE 3 ECU_ADDRESS 0x60038968 /end MEASUREMENT
/begin MEASUREMENT DDRCObsvr_Val.DebStcVal29 "" UBYTE OneToOne 1 100 0.00 255.0 FORMAT "%5.1" ARRAY_SIZE 3 ECU_ADDRESS 0x6003896B /end MEASUREMENT
/begin MEASUREMENT DDRCObsvr_Val.DebStcVal30 "" UBYTE OneToOne 1 100 0.00 255.0 FORMAT "%5.1" ARRAY_SIZE 3 ECU_ADDRESS 0x6003896E /end MEASUREMENT
/begin MEASUREMENT DDRCObsvr_Val.DebStcVal31 "" UBYTE OneToOne 1 100 0.00 255.0 FORMAT "%5.1" ARRAY_SIZE 3 ECU_ADDRESS 0x60038971 /end MEASUREMENT
/begin MEASUREMENT DDRCObsvr_Val.DebStcVal32 "" UBYTE OneToOne 1 100 0.00 255.0 FORMAT "%5.1" ARRAY_SIZE 3 ECU_ADDRESS 0x60038974 /end MEASUREMENT
/begin MEASUREMENT DDRCObsvr_Val.DebStcVal33 "" UBYTE OneToOne 1 100 0.00 255.0 FORMAT "%5.1" ARRAY_SIZE 3 ECU_ADDRESS 0x60038977 /end MEASUREMENT
/begin MEASUREMENT DDRCObsvr_Val.DebStcVal34 "" UBYTE OneToOne 1 100 0.00 255.0 FORMAT "%5.1" ARRAY_SIZE 3 ECU_ADDRESS 0x6003897A /end MEASUREMENT
/begin MEASUREMENT DDRCObsvr_Val.DebStcVal35 "" UBYTE OneToOne 1 100 0.00 255.0 FORMAT "%5.1" ARRAY_SIZE 3 ECU_ADDRESS 0x6003897D /end MEASUREMENT
/begin MEASUREMENT DDRCObsvr_Val.DebStcVal36 "" UBYTE OneToOne 1 100 0.00 255.0 FORMAT "%5.1" ARRAY_SIZE 3 ECU_ADDRESS 0x60038980 /end MEASUREMENT
/begin MEASUREMENT DDRCObsvr_Val.DebStcVal37 "" UBYTE OneToOne 1 100 0.00 255.0 FORMAT "%5.1" ARRAY_SIZE 3 ECU_ADDRESS 0x60038983 /end MEASUREMENT
/begin MEASUREMENT DDRCObsvr_Val.DebStcVal38 "" UBYTE OneToOne 1 100 0.00 255.0 FORMAT "%5.1" ARRAY_SIZE 3 ECU_ADDRESS 0x60038986 /end MEASUREMENT
/begin MEASUREMENT DDRCObsvr_Val.DebStcVal39 "" UBYTE OneToOne 1 100 0.00 255.0 FORMAT "%5.1" ARRAY_SIZE 3 ECU_ADDRESS 0x60038989 /end MEASUREMENT
/begin MEASUREMENT DDRCObsvr_Val.DebStcVal40 "" UBYTE OneToOne 1 100 0.00 255.0 FORMAT "%5.1" ARRAY_SIZE 3 ECU_ADDRESS 0x6003898C /end MEASUREMENT
/begin MEASUREMENT DDRCObsvr_Val.DebStcVal41 "" UBYTE OneToOne 1 100 0.00 255.0 FORMAT "%5.1" ARRAY_SIZE 3 ECU_ADDRESS 0x6003898F /end MEASUREMENT
/begin MEASUREMENT DDRCObsvr_Val.DebStcVal42 "" UBYTE OneToOne 1 100 0.00 255.0 FORMAT "%5.1" ARRAY_SIZE 3 ECU_ADDRESS 0x60038992 /end MEASUREMENT
/begin MEASUREMENT DDRCObsvr_Val.DebStcVal43 "" UBYTE OneToOne 1 100 0.00 255.0 FORMAT "%5.1" ARRAY_SIZE 3 ECU_ADDRESS 0x60038995 /end MEASUREMENT
/begin MEASUREMENT DDRCObsvr_Val.DebStcVal44 "" UBYTE OneToOne 1 100 0.00 255.0 FORMAT "%5.1" ARRAY_SIZE 3 ECU_ADDRESS 0x60038998 /end MEASUREMENT
/begin MEASUREMENT DDRCObsvr_Val.DebStcVal45 "" UBYTE OneToOne 1 100 0.00 255.0 FORMAT "%5.1" ARRAY_SIZE 3 ECU_ADDRESS 0x6003899B /end MEASUREMENT
/begin MEASUREMENT DDRCObsvr_Val.DebStcVal46 "" UBYTE OneToOne 1 100 0.00 255.0 FORMAT "%5.1" ARRAY_SIZE 3 ECU_ADDRESS 0x6003899E /end MEASUREMENT
/begin MEASUREMENT DDRCObsvr_Val.DebStcVal47 "" UBYTE OneToOne 1 100 0.00 255.0 FORMAT "%5.1" ARRAY_SIZE 3 ECU_ADDRESS 0x600389A1 /end MEASUREMENT
/begin MEASUREMENT DDRCObsvr_Val.DebStcVal48 "" UBYTE OneToOne 1 100 0.00 255.0 FORMAT "%5.1" ARRAY_SIZE 3 ECU_ADDRESS 0x600389A4 /end MEASUREMENT
/begin MEASUREMENT DDRCObsvr_Val.DebStcVal49 "" UBYTE OneToOne 1 100 0.00 255.0 FORMAT "%5.1" ARRAY_SIZE 3 ECU_ADDRESS 0x600389A7 /end MEASUREMENT
/begin MEASUREMENT DDRCObsvr_Val.DebStcVal50 "" UBYTE OneToOne 1 100 0.00 255.0 FORMAT "%5.1" ARRAY_SIZE 3 ECU_ADDRESS 0x600389AA /end MEASUREMENT
/begin MEASUREMENT DDRCObsvr_Val.DebStcVal51 "" UBYTE OneToOne 1 100 0.00 255.0 FORMAT "%5.1" ARRAY_SIZE 3 ECU_ADDRESS 0x600389AD /end MEASUREMENT
/begin MEASUREMENT DDRCObsvr_Val.DebStcVal52 "" UBYTE OneToOne 1 100 0.00 255.0 FORMAT "%5.1" ARRAY_SIZE 3 ECU_ADDRESS 0x600389B0 /end MEASUREMENT
/begin MEASUREMENT DDRCObsvr_Val.DebStcVal53 "" UBYTE OneToOne 1 100 0.00 255.0 FORMAT "%5.1" ARRAY_SIZE 3 ECU_ADDRESS 0x600389B3 /end MEASUREMENT
/begin MEASUREMENT DDRCObsvr_Val.DebStcVal54 "" UBYTE OneToOne 1 100 0.00 255.0 FORMAT "%5.1" ARRAY_SIZE 3 ECU_ADDRESS 0x600389B6 /end MEASUREMENT
/begin MEASUREMENT DDRCObsvr_Val.DebStcVal55 "" UBYTE OneToOne 1 100 0.00 255.0 FORMAT "%5.1" ARRAY_SIZE 3 ECU_ADDRESS 0x600389B9 /end MEASUREMENT
/begin MEASUREMENT DDRCObsvr_Val.DebStcVal56 "" UBYTE OneToOne 1 100 0.00 255.0 FORMAT "%5.1" ARRAY_SIZE 3 ECU_ADDRESS 0x600389BC /end MEASUREMENT
/begin MEASUREMENT DDRCObsvr_Val.DebStcVal57 "" UBYTE OneToOne 1 100 0.00 255.0 FORMAT "%5.1" ARRAY_SIZE 3 ECU_ADDRESS 0x600389BF /end MEASUREMENT
/begin MEASUREMENT DDRCObsvr_Val.DebStcVal58 "" UBYTE OneToOne 1 100 0.00 255.0 FORMAT "%5.1" ARRAY_SIZE 3 ECU_ADDRESS 0x600389C2 /end MEASUREMENT
/begin MEASUREMENT DDRCObsvr_Val.DebStcVal59 "" UBYTE OneToOne 1 100 0.00 255.0 FORMAT "%5.1" ARRAY_SIZE 3 ECU_ADDRESS 0x600389C5 /end MEASUREMENT
/begin MEASUREMENT DDRCObsvr_Val.DebStcVal60 "" UBYTE OneToOne 1 100 0.00 255.0 FORMAT "%5.1" ARRAY_SIZE 3 ECU_ADDRESS 0x600389C8 /end MEASUREMENT
/begin MEASUREMENT DDRCObsvr_Val.DebStcVal61 "" UBYTE OneToOne 1 100 0.00 255.0 FORMAT "%5.1" ARRAY_SIZE 3 ECU_ADDRESS 0x600389CB /end MEASUREMENT
/begin MEASUREMENT DDRCObsvr_Val.DebStcVal62 "" UBYTE OneToOne 1 100 0.00 255.0 FORMAT "%5.1" ARRAY_SIZE 3 ECU_ADDRESS 0x600389CE /end MEASUREMENT
/begin MEASUREMENT DDRCObsvr_Val.DebStcVal63 "" UBYTE OneToOne 1 100 0.00 255.0 FORMAT "%5.1" ARRAY_SIZE 3 ECU_ADDRESS 0x600389D1 /end MEASUREMENT
/begin MEASUREMENT DDRCObsvr_Val.DebStcVal64 "" UBYTE OneToOne 1 100 0.00 255.0 FORMAT "%5.1" ARRAY_SIZE 3 ECU_ADDRESS 0x600389D4 /end MEASUREMENT
/begin MEASUREMENT DDRCObsvr_Val.DebStcVal65 "" UBYTE OneToOne 1 100 0.00 255.0 FORMAT "%5.1" ARRAY_SIZE 3 ECU_ADDRESS 0x600389D7 /end MEASUREMENT
/begin MEASUREMENT DDRCObsvr_Val.DebStcVal66 "" UBYTE OneToOne 1 100 0.00 255.0 FORMAT "%5.1" ARRAY_SIZE 3 ECU_ADDRESS 0x600389DA /end MEASUREMENT
/begin MEASUREMENT DDRCObsvr_Val.DebStcVal67 "" UBYTE OneToOne 1 100 0.00 255.0 FORMAT "%5.1" ARRAY_SIZE 3 ECU_ADDRESS 0x600389DD /end MEASUREMENT
/begin MEASUREMENT DDRCObsvr_Val.DebStcVal68 "" UBYTE OneToOne 1 100 0.00 255.0 FORMAT "%5.1" ARRAY_SIZE 3 ECU_ADDRESS 0x600389E0 /end MEASUREMENT
/begin MEASUREMENT DDRCObsvr_Val.DebStcVal69 "" UBYTE OneToOne 1 100 0.00 255.0 FORMAT "%5.1" ARRAY_SIZE 3 ECU_ADDRESS 0x600389E3 /end MEASUREMENT
/begin MEASUREMENT DDRCObsvr_Val.DebStcVal70 "" UBYTE OneToOne 1 100 0.00 255.0 FORMAT "%5.1" ARRAY_SIZE 3 ECU_ADDRESS 0x600389E6 /end MEASUREMENT
/begin MEASUREMENT DDRCObsvr_Val.DebStcVal71 "" UBYTE OneToOne 1 100 0.00 255.0 FORMAT "%5.1" ARRAY_SIZE 3 ECU_ADDRESS 0x600389E9 /end MEASUREMENT
/begin MEASUREMENT DDRCObsvr_Val.DebStcVal72 "" UBYTE OneToOne 1 100 0.00 255.0 FORMAT "%5.1" ARRAY_SIZE 3 ECU_ADDRESS 0x600389EC /end MEASUREMENT
/begin MEASUREMENT DDRCObsvr_Val.DebStcVal73 "" UBYTE OneToOne 1 100 0.00 255.0 FORMAT "%5.1" ARRAY_SIZE 3 ECU_ADDRESS 0x600389EF /end MEASUREMENT
/begin MEASUREMENT DDRCObsvr_Val.DebStcVal74 "" UBYTE OneToOne 1 100 0.00 255.0 FORMAT "%5.1" ARRAY_SIZE 3 ECU_ADDRESS 0x600389F2 /end MEASUREMENT
/begin MEASUREMENT DDRCObsvr_Val.DebStcVal75 "" UBYTE OneToOne 1 100 0.00 255.0 FORMAT "%5.1" ARRAY_SIZE 3 ECU_ADDRESS 0x600389F5 /end MEASUREMENT
/begin MEASUREMENT DDRCObsvr_Val.DebStcVal76 "" UBYTE OneToOne 1 100 0.00 255.0 FORMAT "%5.1" ARRAY_SIZE 3 ECU_ADDRESS 0x600389F8 /end MEASUREMENT
/begin MEASUREMENT DDRCObsvr_Val.DebStcVal77 "" UBYTE OneToOne 1 100 0.00 255.0 FORMAT "%5.1" ARRAY_SIZE 3 ECU_ADDRESS 0x600389FB /end MEASUREMENT
/begin MEASUREMENT DDRCObsvr_Val.DebStcVal78 "" UBYTE OneToOne 1 100 0.00 255.0 FORMAT "%5.1" ARRAY_SIZE 3 ECU_ADDRESS 0x600389FE /end MEASUREMENT
/begin MEASUREMENT DDRCObsvr_Val.DebStcVal79 "" UBYTE OneToOne 1 100 0.00 255.0 FORMAT "%5.1" ARRAY_SIZE 3 ECU_ADDRESS 0x60038A01 /end MEASUREMENT
/begin MEASUREMENT DDRCObsvr_Val.DebStcVal80 "" UBYTE OneToOne 1 100 0.00 255.0 FORMAT "%5.1" ARRAY_SIZE 3 ECU_ADDRESS 0x60038A04 /end MEASUREMENT
/begin MEASUREMENT DDRCObsvr_Val.DebStcVal81 "" UBYTE OneToOne 1 100 0.00 255.0 FORMAT "%5.1" ARRAY_SIZE 3 ECU_ADDRESS 0x60038A07 /end MEASUREMENT
/begin MEASUREMENT DDRCObsvr_Val.DebStcVal82 "" UBYTE OneToOne 1 100 0.00 255.0 FORMAT "%5.1" ARRAY_SIZE 3 ECU_ADDRESS 0x60038A0A /end MEASUREMENT
/begin MEASUREMENT DDRCObsvr_Val.DebStcVal83 "" UBYTE OneToOne 1 100 0.00 255.0 FORMAT "%5.1" ARRAY_SIZE 3 ECU_ADDRESS 0x60038A0D /end MEASUREMENT
/begin MEASUREMENT DDRCObsvr_Val.DebStcVal84 "" UBYTE OneToOne 1 100 0.00 255.0 FORMAT "%5.1" ARRAY_SIZE 3 ECU_ADDRESS 0x60038A10 /end MEASUREMENT
/begin MEASUREMENT DDRCObsvr_Val.DebStcVal85 "" UBYTE OneToOne 1 100 0.00 255.0 FORMAT "%5.1" ARRAY_SIZE 3 ECU_ADDRESS 0x60038A13 /end MEASUREMENT
/begin MEASUREMENT DDRCObsvr_Val.DebStcVal86 "" UBYTE OneToOne 1 100 0.00 255.0 FORMAT "%5.1" ARRAY_SIZE 3 ECU_ADDRESS 0x60038A16 /end MEASUREMENT
/begin MEASUREMENT DDRCObsvr_Val.DebStcVal87 "" UBYTE OneToOne 1 100 0.00 255.0 FORMAT "%5.1" ARRAY_SIZE 3 ECU_ADDRESS 0x60038A19 /end MEASUREMENT
/begin MEASUREMENT DDRCObsvr_Val.DebStcVal88 "" UBYTE OneToOne 1 100 0.00 255.0 FORMAT "%5.1" ARRAY_SIZE 3 ECU_ADDRESS 0x60038A1C /end MEASUREMENT
/begin MEASUREMENT DDRCObsvr_Val.DebStcVal89 "" UBYTE OneToOne 1 100 0.00 255.0 FORMAT "%5.1" ARRAY_SIZE 3 ECU_ADDRESS 0x60038A1F /end MEASUREMENT
/begin MEASUREMENT DDRCObsvr_Val.DebStcVal90 "" UBYTE OneToOne 1 100 0.00 255.0 FORMAT "%5.1" ARRAY_SIZE 3 ECU_ADDRESS 0x60038A22 /end MEASUREMENT
/begin MEASUREMENT DDRCObsvr_Val.DebStcVal91 "" UBYTE OneToOne 1 100 0.00 255.0 FORMAT "%5.1" ARRAY_SIZE 3 ECU_ADDRESS 0x60038A25 /end MEASUREMENT
/begin MEASUREMENT DDRCObsvr_Val.DebStcVal92 "" UBYTE OneToOne 1 100 0.00 255.0 FORMAT "%5.1" ARRAY_SIZE 3 ECU_ADDRESS 0x60038A28 /end MEASUREMENT
/begin MEASUREMENT DDRCObsvr_Val.DebStcVal93 "" UBYTE OneToOne 1 100 0.00 255.0 FORMAT "%5.1" ARRAY_SIZE 3 ECU_ADDRESS 0x60038A2B /end MEASUREMENT
/begin MEASUREMENT DDRCObsvr_Val.DebStcVal94 "" UBYTE OneToOne 1 100 0.00 255.0 FORMAT "%5.1" ARRAY_SIZE 3 ECU_ADDRESS 0x60038A2E /end MEASUREMENT
/begin MEASUREMENT DDRCObsvr_Val.DebStcVal95 "" UBYTE OneToOne 1 100 0.00 255.0 FORMAT "%5.1" ARRAY_SIZE 3 ECU_ADDRESS 0x60038A31 /end MEASUREMENT
/begin MEASUREMENT DDRCObsvr_Val.DebStcVal96 "" UBYTE OneToOne 1 100 0.00 255.0 FORMAT "%5.1" ARRAY_SIZE 3 ECU_ADDRESS 0x60038A34 /end MEASUREMENT
/begin MEASUREMENT DDRCObsvr_Val.DebStcVal97 "" UBYTE OneToOne 1 100 0.00 255.0 FORMAT "%5.1" ARRAY_SIZE 3 ECU_ADDRESS 0x60038A37 /end MEASUREMENT
/begin MEASUREMENT DDRCObsvr_Val.DebStcVal98 "" UBYTE OneToOne 1 100 0.00 255.0 FORMAT "%5.1" ARRAY_SIZE 3 ECU_ADDRESS 0x60038A3A /end MEASUREMENT
/begin MEASUREMENT DDRCObsvr_Val.DebStcVal99 "" UBYTE OneToOne 1 100 0.00 255.0 FORMAT "%5.1" ARRAY_SIZE 3 ECU_ADDRESS 0x60038A3D /end MEASUREMENT
/begin MEASUREMENT DDRCObsvr_Val.DebStcVal100 "" UBYTE OneToOne 1 100 0.00 255.0 FORMAT "%5.1" ARRAY_SIZE 3 ECU_ADDRESS 0x60038A40 /end MEASUREMENT
/begin MEASUREMENT DDRCObsvr_Val.DebStcVal101 "" UBYTE OneToOne 1 100 0.00 255.0 FORMAT "%5.1" ARRAY_SIZE 3 ECU_ADDRESS 0x60038A43 /end MEASUREMENT
/begin MEASUREMENT DDRCObsvr_Val.DebStcVal102 "" UBYTE OneToOne 1 100 0.00 255.0 FORMAT "%5.1" ARRAY_SIZE 3 ECU_ADDRESS 0x60038A46 /end MEASUREMENT
/begin MEASUREMENT DDRCObsvr_Val.DebStcVal103 "" UBYTE OneToOne 1 100 0.00 255.0 FORMAT "%5.1" ARRAY_SIZE 3 ECU_ADDRESS 0x60038A49 /end MEASUREMENT
/begin MEASUREMENT DDRCObsvr_Val.DebStcVal104 "" UBYTE OneToOne 1 100 0.00 255.0 FORMAT "%5.1" ARRAY_SIZE 3 ECU_ADDRESS 0x60038A4C /end MEASUREMENT
/begin MEASUREMENT DDRCObsvr_Val.DebStcVal105 "" UBYTE OneToOne 1 100 0.00 255.0 FORMAT "%5.1" ARRAY_SIZE 3 ECU_ADDRESS 0x60038A4F /end MEASUREMENT
/begin MEASUREMENT DDRCObsvr_Val.DebStcVal106 "" UBYTE OneToOne 1 100 0.00 255.0 FORMAT "%5.1" ARRAY_SIZE 3 ECU_ADDRESS 0x60038A52 /end MEASUREMENT
/begin MEASUREMENT DDRCObsvr_Val.DebStcVal107 "" UBYTE OneToOne 1 100 0.00 255.0 FORMAT "%5.1" ARRAY_SIZE 3 ECU_ADDRESS 0x60038A55 /end MEASUREMENT
/begin MEASUREMENT DDRCObsvr_Val.DebStcVal108 "" UBYTE OneToOne 1 100 0.00 255.0 FORMAT "%5.1" ARRAY_SIZE 3 ECU_ADDRESS 0x60038A58 /end MEASUREMENT
/begin MEASUREMENT DDRCObsvr_Val.DebStcVal109 "" UBYTE OneToOne 1 100 0.00 255.0 FORMAT "%5.1" ARRAY_SIZE 3 ECU_ADDRESS 0x60038A5B /end MEASUREMENT
/begin MEASUREMENT DDRCObsvr_Val.DebStcVal110 "" UBYTE OneToOne 1 100 0.00 255.0 FORMAT "%5.1" ARRAY_SIZE 3 ECU_ADDRESS 0x60038A5E /end MEASUREMENT
/begin MEASUREMENT DDRCObsvr_Val.DebStcVal111 "" UBYTE OneToOne 1 100 0.00 255.0 FORMAT "%5.1" ARRAY_SIZE 3 ECU_ADDRESS 0x60038A61 /end MEASUREMENT
/begin MEASUREMENT DDRCObsvr_Val.DebStcVal112 "" UBYTE OneToOne 1 100 0.00 255.0 FORMAT "%5.1" ARRAY_SIZE 3 ECU_ADDRESS 0x60038A64 /end MEASUREMENT
/begin MEASUREMENT DDRCObsvr_Val.DebStcVal113 "" UBYTE OneToOne 1 100 0.00 255.0 FORMAT "%5.1" ARRAY_SIZE 3 ECU_ADDRESS 0x60038A67 /end MEASUREMENT
/begin MEASUREMENT DDRCObsvr_Val.DebStcVal114 "" UBYTE OneToOne 1 100 0.00 255.0 FORMAT "%5.1" ARRAY_SIZE 3 ECU_ADDRESS 0x60038A6A /end MEASUREMENT
/begin MEASUREMENT DDRCObsvr_Val.DebStcVal115 "" UBYTE OneToOne 1 100 0.00 255.0 FORMAT "%5.1" ARRAY_SIZE 3 ECU_ADDRESS 0x60038A6D /end MEASUREMENT
/begin MEASUREMENT DDRCObsvr_Val.DebStcVal116 "" UBYTE OneToOne 1 100 0.00 255.0 FORMAT "%5.1" ARRAY_SIZE 3 ECU_ADDRESS 0x60038A70 /end MEASUREMENT
/begin MEASUREMENT DDRCObsvr_Val.DebStcVal117 "" UBYTE OneToOne 1 100 0.00 255.0 FORMAT "%5.1" ARRAY_SIZE 3 ECU_ADDRESS 0x60038A73 /end MEASUREMENT
/begin MEASUREMENT DDRCObsvr_Val.DebStcVal118 "" UBYTE OneToOne 1 100 0.00 255.0 FORMAT "%5.1" ARRAY_SIZE 3 ECU_ADDRESS 0x60038A76 /end MEASUREMENT
/begin MEASUREMENT DDRCObsvr_Val.DebStcVal119 "" UBYTE OneToOne 1 100 0.00 255.0 FORMAT "%5.1" ARRAY_SIZE 3 ECU_ADDRESS 0x60038A79 /end MEASUREMENT
/begin MEASUREMENT DDRCObsvr_Val.DebStcVal120 "" UBYTE OneToOne 1 100 0.00 255.0 FORMAT "%5.1" ARRAY_SIZE 3 ECU_ADDRESS 0x60038A7C /end MEASUREMENT
/begin MEASUREMENT DDRCObsvr_Val.DebStcVal121 "" UBYTE OneToOne 1 100 0.00 255.0 FORMAT "%5.1" ARRAY_SIZE 3 ECU_ADDRESS 0x60038A7F /end MEASUREMENT
/begin MEASUREMENT DDRCObsvr_Val.DebStcVal122 "" UBYTE OneToOne 1 100 0.00 255.0 FORMAT "%5.1" ARRAY_SIZE 3 ECU_ADDRESS 0x60038A82 /end MEASUREMENT
/begin MEASUREMENT DDRCObsvr_Val.DebStcVal123 "" UBYTE OneToOne 1 100 0.00 255.0 FORMAT "%5.1" ARRAY_SIZE 3 ECU_ADDRESS 0x60038A85 /end MEASUREMENT
/begin MEASUREMENT DDRCObsvr_Val.DebStcVal124 "" UBYTE OneToOne 1 100 0.00 255.0 FORMAT "%5.1" ARRAY_SIZE 3 ECU_ADDRESS 0x60038A88 /end MEASUREMENT
/begin MEASUREMENT DDRCObsvr_Val.DebStcVal125 "" UBYTE OneToOne 1 100 0.00 255.0 FORMAT "%5.1" ARRAY_SIZE 3 ECU_ADDRESS 0x60038A8B /end MEASUREMENT
/begin MEASUREMENT DDRCObsvr_Val.DebStcVal126 "" UBYTE OneToOne 1 100 0.00 255.0 FORMAT "%5.1" ARRAY_SIZE 3 ECU_ADDRESS 0x60038A8E /end MEASUREMENT
/begin MEASUREMENT DDRCObsvr_Val.DebStcVal127 "" UBYTE OneToOne 1 100 0.00 255.0 FORMAT "%5.1" ARRAY_SIZE 3 ECU_ADDRESS 0x60038A91 /end MEASUREMENT
/begin MEASUREMENT DDRCObsvr_Val.DebStcVal128 "" UBYTE OneToOne 1 100 0.00 255.0 FORMAT "%5.1" ARRAY_SIZE 3 ECU_ADDRESS 0x60038A94 /end MEASUREMENT
/begin MEASUREMENT DDRCObsvr_Val.DebStcVal129 "" UBYTE OneToOne 1 100 0.00 255.0 FORMAT "%5.1" ARRAY_SIZE 3 ECU_ADDRESS 0x60038A97 /end MEASUREMENT
/begin MEASUREMENT DDRCObsvr_Val.DebStcVal130 "" UBYTE OneToOne 1 100 0.00 255.0 FORMAT "%5.1" ARRAY_SIZE 3 ECU_ADDRESS 0x60038A9A /end MEASUREMENT
/begin MEASUREMENT DDRCObsvr_Val.DebStcVal131 "" UBYTE OneToOne 1 100 0.00 255.0 FORMAT "%5.1" ARRAY_SIZE 3 ECU_ADDRESS 0x60038A9D /end MEASUREMENT
/begin MEASUREMENT DDRCObsvr_Val.DebStcVal132 "" UBYTE OneToOne 1 100 0.00 255.0 FORMAT "%5.1" ARRAY_SIZE 3 ECU_ADDRESS 0x60038AA0 /end MEASUREMENT
/begin MEASUREMENT DDRCObsvr_Val.DebStcVal133 "" UBYTE OneToOne 1 100 0.00 255.0 FORMAT "%5.1" ARRAY_SIZE 3 ECU_ADDRESS 0x60038AA3 /end MEASUREMENT
/begin MEASUREMENT DDRCObsvr_Val.DebStcVal134 "" UBYTE OneToOne 1 100 0.00 255.0 FORMAT "%5.1" ARRAY_SIZE 3 ECU_ADDRESS 0x60038AA6 /end MEASUREMENT
/begin MEASUREMENT DDRCObsvr_Val.DebStcVal135 "" UBYTE OneToOne 1 100 0.00 255.0 FORMAT "%5.1" ARRAY_SIZE 3 ECU_ADDRESS 0x60038AA9 /end MEASUREMENT
/begin MEASUREMENT DDRCObsvr_Val.DebStcVal136 "" UBYTE OneToOne 1 100 0.00 255.0 FORMAT "%5.1" ARRAY_SIZE 3 ECU_ADDRESS 0x60038AAC /end MEASUREMENT
/begin MEASUREMENT DDRCObsvr_Val.DebStcVal137 "" UBYTE OneToOne 1 100 0.00 255.0 FORMAT "%5.1" ARRAY_SIZE 3 ECU_ADDRESS 0x60038AAF /end MEASUREMENT
/begin MEASUREMENT DDRCObsvr_Val.DebStcVal138 "" UBYTE OneToOne 1 100 0.00 255.0 FORMAT "%5.1" ARRAY_SIZE 3 ECU_ADDRESS 0x60038AB2 /end MEASUREMENT
/begin MEASUREMENT DDRCObsvr_Val.DebStcVal139 "" UBYTE OneToOne 1 100 0.00 255.0 FORMAT "%5.1" ARRAY_SIZE 3 ECU_ADDRESS 0x60038AB5 /end MEASUREMENT
/begin MEASUREMENT DDRCObsvr_Val.DebStcVal140 "" UBYTE OneToOne 1 100 0.00 255.0 FORMAT "%5.1" ARRAY_SIZE 3 ECU_ADDRESS 0x60038AB8 /end MEASUREMENT
/begin MEASUREMENT DDRCObsvr_Val.DebStcVal141 "" UBYTE OneToOne 1 100 0.00 255.0 FORMAT "%5.1" ARRAY_SIZE 3 ECU_ADDRESS 0x60038ABB /end MEASUREMENT
/begin MEASUREMENT DDRCObsvr_Val.DebStcVal142 "" UBYTE OneToOne 1 100 0.00 255.0 FORMAT "%5.1" ARRAY_SIZE 3 ECU_ADDRESS 0x60038ABE /end MEASUREMENT
/begin MEASUREMENT DDRCObsvr_Val.DebStcVal143 "" UBYTE OneToOne 1 100 0.00 255.0 FORMAT "%5.1" ARRAY_SIZE 3 ECU_ADDRESS 0x60038AC1 /end MEASUREMENT
/begin MEASUREMENT DDRCObsvr_Val.DebStcVal144 "" UBYTE OneToOne 1 100 0.00 255.0 FORMAT "%5.1" ARRAY_SIZE 3 ECU_ADDRESS 0x60038AC4 /end MEASUREMENT
/begin MEASUREMENT DDRCObsvr_Val.DebStcVal145 "" UBYTE OneToOne 1 100 0.00 255.0 FORMAT "%5.1" ARRAY_SIZE 3 ECU_ADDRESS 0x60038AC7 /end MEASUREMENT
/begin MEASUREMENT DDRCObsvr_Val.DebStcVal146 "" UBYTE OneToOne 1 100 0.00 255.0 FORMAT "%5.1" ARRAY_SIZE 3 ECU_ADDRESS 0x60038ACA /end MEASUREMENT
/begin MEASUREMENT DDRCObsvr_Val.DebStcVal147 "" UBYTE OneToOne 1 100 0.00 255.0 FORMAT "%5.1" ARRAY_SIZE 3 ECU_ADDRESS 0x60038ACD /end MEASUREMENT
/begin MEASUREMENT DDRCObsvr_Val.DebStcVal148 "" UBYTE OneToOne 1 100 0.00 255.0 FORMAT "%5.1" ARRAY_SIZE 3 ECU_ADDRESS 0x60038AD0 /end MEASUREMENT
/begin MEASUREMENT DDRCObsvr_Val.DebStcVal149 "" UBYTE OneToOne 1 100 0.00 255.0 FORMAT "%5.1" ARRAY_SIZE 3 ECU_ADDRESS 0x60038AD3 /end MEASUREMENT
/begin MEASUREMENT DDRCObsvr_Val.DebStcVal150 "" UBYTE OneToOne 1 100 0.00 255.0 FORMAT "%5.1" ARRAY_SIZE 3 ECU_ADDRESS 0x60038AD6 /end MEASUREMENT
/begin MEASUREMENT DDRCObsvr_Val.DebStcVal151 "" UBYTE OneToOne 1 100 0.00 255.0 FORMAT "%5.1" ARRAY_SIZE 3 ECU_ADDRESS 0x60038AD9 /end MEASUREMENT
/begin MEASUREMENT DDRCObsvr_Val.DebStcVal152 "" UBYTE OneToOne 1 100 0.00 255.0 FORMAT "%5.1" ARRAY_SIZE 3 ECU_ADDRESS 0x60038ADC /end MEASUREMENT
/begin MEASUREMENT DDRCObsvr_Val.DebStcVal153 "" UBYTE OneToOne 1 100 0.00 255.0 FORMAT "%5.1" ARRAY_SIZE 3 ECU_ADDRESS 0x60038ADF /end MEASUREMENT
/begin MEASUREMENT DDRCObsvr_Val.DebStcVal154 "" UBYTE OneToOne 1 100 0.00 255.0 FORMAT "%5.1" ARRAY_SIZE 3 ECU_ADDRESS 0x60038AE2 /end MEASUREMENT
/begin MEASUREMENT DDRCObsvr_Val.DebStcVal155 "" UBYTE OneToOne 1 100 0.00 255.0 FORMAT "%5.1" ARRAY_SIZE 3 ECU_ADDRESS 0x60038AE5 /end MEASUREMENT
/begin MEASUREMENT DDRCObsvr_Val.DebStcVal156 "" UBYTE OneToOne 1 100 0.00 255.0 FORMAT "%5.1" ARRAY_SIZE 3 ECU_ADDRESS 0x60038AE8 /end MEASUREMENT
/begin MEASUREMENT DDRCObsvr_Val.DebStcVal157 "" UBYTE OneToOne 1 100 0.00 255.0 FORMAT "%5.1" ARRAY_SIZE 3 ECU_ADDRESS 0x60038AEB /end MEASUREMENT
/begin MEASUREMENT DDRCObsvr_Val.DebStcVal158 "" UBYTE OneToOne 1 100 0.00 255.0 FORMAT "%5.1" ARRAY_SIZE 3 ECU_ADDRESS 0x60038AEE /end MEASUREMENT
/begin MEASUREMENT DDRCObsvr_Val.DebStcVal159 "" UBYTE OneToOne 1 100 0.00 255.0 FORMAT "%5.1" ARRAY_SIZE 3 ECU_ADDRESS 0x60038AF1 /end MEASUREMENT
/begin MEASUREMENT DDRCObsvr_Val.DebStcVal160 "" UBYTE OneToOne 1 100 0.00 255.0 FORMAT "%5.1" ARRAY_SIZE 3 ECU_ADDRESS 0x60038AF4 /end MEASUREMENT
/begin MEASUREMENT DDRCObsvr_Val.DebStcVal161 "" UBYTE OneToOne 1 100 0.00 255.0 FORMAT "%5.1" ARRAY_SIZE 3 ECU_ADDRESS 0x60038AF7 /end MEASUREMENT
/begin MEASUREMENT DDRCObsvr_Val.DebStcVal162 "" UBYTE OneToOne 1 100 0.00 255.0 FORMAT "%5.1" ARRAY_SIZE 3 ECU_ADDRESS 0x60038AFA /end MEASUREMENT
/begin MEASUREMENT DDRCObsvr_Val.DebStcVal163 "" UBYTE OneToOne 1 100 0.00 255.0 FORMAT "%5.1" ARRAY_SIZE 3 ECU_ADDRESS 0x60038AFD /end MEASUREMENT
/begin MEASUREMENT DDRCObsvr_Val.DebStcVal164 "" UBYTE OneToOne 1 100 0.00 255.0 FORMAT "%5.1" ARRAY_SIZE 3 ECU_ADDRESS 0x60038B00 /end MEASUREMENT
/begin MEASUREMENT DDRCObsvr_Val.DebStcVal165 "" UBYTE OneToOne 1 100 0.00 255.0 FORMAT "%5.1" ARRAY_SIZE 3 ECU_ADDRESS 0x60038B03 /end MEASUREMENT
/begin MEASUREMENT DDRCObsvr_Val.DebStcVal166 "" UBYTE OneToOne 1 100 0.00 255.0 FORMAT "%5.1" ARRAY_SIZE 3 ECU_ADDRESS 0x60038B06 /end MEASUREMENT
/begin MEASUREMENT DDRCObsvr_Val.DebStcVal167 "" UBYTE OneToOne 1 100 0.00 255.0 FORMAT "%5.1" ARRAY_SIZE 3 ECU_ADDRESS 0x60038B09 /end MEASUREMENT
/begin MEASUREMENT DDRCObsvr_Val.DebStcVal168 "" UBYTE OneToOne 1 100 0.00 255.0 FORMAT "%5.1" ARRAY_SIZE 3 ECU_ADDRESS 0x60038B0C /end MEASUREMENT
/begin MEASUREMENT DDRCObsvr_Val.DebStcVal169 "" UBYTE OneToOne 1 100 0.00 255.0 FORMAT "%5.1" ARRAY_SIZE 3 ECU_ADDRESS 0x60038B0F /end MEASUREMENT
/begin MEASUREMENT DDRCObsvr_Val.DebStcVal170 "" UBYTE OneToOne 1 100 0.00 255.0 FORMAT "%5.1" ARRAY_SIZE 3 ECU_ADDRESS 0x60038B12 /end MEASUREMENT
/begin MEASUREMENT DDRCObsvr_Val.DebStcVal171 "" UBYTE OneToOne 1 100 0.00 255.0 FORMAT "%5.1" ARRAY_SIZE 3 ECU_ADDRESS 0x60038B15 /end MEASUREMENT
/begin MEASUREMENT DDRCObsvr_Val.DebStcVal172 "" UBYTE OneToOne 1 100 0.00 255.0 FORMAT "%5.1" ARRAY_SIZE 3 ECU_ADDRESS 0x60038B18 /end MEASUREMENT
/begin MEASUREMENT DDRCObsvr_Val.DebStcVal173 "" UBYTE OneToOne 1 100 0.00 255.0 FORMAT "%5.1" ARRAY_SIZE 3 ECU_ADDRESS 0x60038B1B /end MEASUREMENT
/begin MEASUREMENT DDRCObsvr_Val.DebStcVal174 "" UBYTE OneToOne 1 100 0.00 255.0 FORMAT "%5.1" ARRAY_SIZE 3 ECU_ADDRESS 0x60038B1E /end MEASUREMENT
/begin MEASUREMENT DDRCObsvr_Val.DebStcVal175 "" UBYTE OneToOne 1 100 0.00 255.0 FORMAT "%5.1" ARRAY_SIZE 3 ECU_ADDRESS 0x60038B21 /end MEASUREMENT
/begin MEASUREMENT DDRCObsvr_Val.DebStcVal176 "" UBYTE OneToOne 1 100 0.00 255.0 FORMAT "%5.1" ARRAY_SIZE 3 ECU_ADDRESS 0x60038B24 /end MEASUREMENT
/begin MEASUREMENT DDRCObsvr_Val.DebStcVal177 "" UBYTE OneToOne 1 100 0.00 255.0 FORMAT "%5.1" ARRAY_SIZE 3 ECU_ADDRESS 0x60038B27 /end MEASUREMENT
/begin MEASUREMENT DDRCObsvr_Val.DebStcVal178 "" UBYTE OneToOne 1 100 0.00 255.0 FORMAT "%5.1" ARRAY_SIZE 3 ECU_ADDRESS 0x60038B2A /end MEASUREMENT
/begin MEASUREMENT DDRCObsvr_Val.DebStcVal179 "" UBYTE OneToOne 1 100 0.00 255.0 FORMAT "%5.1" ARRAY_SIZE 3 ECU_ADDRESS 0x60038B2D /end MEASUREMENT
/begin MEASUREMENT DDRCObsvr_Val.DebStcVal180 "" UBYTE OneToOne 1 100 0.00 255.0 FORMAT "%5.1" ARRAY_SIZE 3 ECU_ADDRESS 0x60038B30 /end MEASUREMENT
/begin MEASUREMENT DDRCObsvr_Val.DebStcVal181 "" UBYTE OneToOne 1 100 0.00 255.0 FORMAT "%5.1" ARRAY_SIZE 3 ECU_ADDRESS 0x60038B33 /end MEASUREMENT
/begin MEASUREMENT DDRCObsvr_Val.DebStcVal182 "" UBYTE OneToOne 1 100 0.00 255.0 FORMAT "%5.1" ARRAY_SIZE 3 ECU_ADDRESS 0x60038B36 /end MEASUREMENT
/begin MEASUREMENT DDRCObsvr_Val.DebStcVal183 "" UBYTE OneToOne 1 100 0.00 255.0 FORMAT "%5.1" ARRAY_SIZE 3 ECU_ADDRESS 0x60038B39 /end MEASUREMENT
/begin MEASUREMENT DDRCObsvr_Val.DebStcVal184 "" UBYTE OneToOne 1 100 0.00 255.0 FORMAT "%5.1" ARRAY_SIZE 3 ECU_ADDRESS 0x60038B3C /end MEASUREMENT
/begin MEASUREMENT DDRCObsvr_Val.DebStcVal185 "" UBYTE OneToOne 1 100 0.00 255.0 FORMAT "%5.1" ARRAY_SIZE 3 ECU_ADDRESS 0x60038B3F /end MEASUREMENT
/begin MEASUREMENT DDRCObsvr_Val.DebStcVal186 "" UBYTE OneToOne 1 100 0.00 255.0 FORMAT "%5.1" ARRAY_SIZE 3 ECU_ADDRESS 0x60038B42 /end MEASUREMENT
/begin MEASUREMENT DDRCObsvr_Val.DebStcVal187 "" UBYTE OneToOne 1 100 0.00 255.0 FORMAT "%5.1" ARRAY_SIZE 3 ECU_ADDRESS 0x60038B45 /end MEASUREMENT
/begin MEASUREMENT DDRCObsvr_Val.DebStcVal188 "" UBYTE OneToOne 1 100 0.00 255.0 FORMAT "%5.1" ARRAY_SIZE 3 ECU_ADDRESS 0x60038B48 /end MEASUREMENT
/begin MEASUREMENT DDRCObsvr_Val.DebStcVal189 "" UBYTE OneToOne 1 100 0.00 255.0 FORMAT "%5.1" ARRAY_SIZE 3 ECU_ADDRESS 0x60038B4B /end MEASUREMENT
/begin MEASUREMENT DDRCObsvr_Val.DebStcVal190 "" UBYTE OneToOne 1 100 0.00 255.0 FORMAT "%5.1" ARRAY_SIZE 3 ECU_ADDRESS 0x60038B4E /end MEASUREMENT
/begin MEASUREMENT DDRCObsvr_Val.DebStcVal191 "" UBYTE OneToOne 1 100 0.00 255.0 FORMAT "%5.1" ARRAY_SIZE 3 ECU_ADDRESS 0x60038B51 /end MEASUREMENT
/begin MEASUREMENT DDRCObsvr_Val.DebStcVal192 "" UBYTE OneToOne 1 100 0.00 255.0 FORMAT "%5.1" ARRAY_SIZE 3 ECU_ADDRESS 0x60038B54 /end MEASUREMENT
/begin MEASUREMENT DDRCObsvr_Val.DebStcVal193 "" UBYTE OneToOne 1 100 0.00 255.0 FORMAT "%5.1" ARRAY_SIZE 3 ECU_ADDRESS 0x60038B57 /end MEASUREMENT
/begin MEASUREMENT DDRCObsvr_Val.DebStcVal194 "" UBYTE OneToOne 1 100 0.00 255.0 FORMAT "%5.1" ARRAY_SIZE 3 ECU_ADDRESS 0x60038B5A /end MEASUREMENT
/begin MEASUREMENT DDRCObsvr_Val.DebStcVal195 "" UBYTE OneToOne 1 100 0.00 255.0 FORMAT "%5.1" ARRAY_SIZE 3 ECU_ADDRESS 0x60038B5D /end MEASUREMENT
/begin MEASUREMENT DDRCObsvr_Val.DebStcVal196 "" UBYTE OneToOne 1 100 0.00 255.0 FORMAT "%5.1" ARRAY_SIZE 3 ECU_ADDRESS 0x60038B60 /end MEASUREMENT
/begin MEASUREMENT DDRCObsvr_Val.DebStcVal197 "" UBYTE OneToOne 1 100 0.00 255.0 FORMAT "%5.1" ARRAY_SIZE 3 ECU_ADDRESS 0x60038B63 /end MEASUREMENT
/begin MEASUREMENT DDRCObsvr_Val.DebStcVal198 "" UBYTE OneToOne 1 100 0.00 255.0 FORMAT "%5.1" ARRAY_SIZE 3 ECU_ADDRESS 0x60038B66 /end MEASUREMENT
/begin MEASUREMENT DDRCObsvr_Val.DebStcVal199 "" UBYTE OneToOne 1 100 0.00 255.0 FORMAT "%5.1" ARRAY_SIZE 3 ECU_ADDRESS 0x60038B69 /end MEASUREMENT
/begin MEASUREMENT DDRCObsvr_Val.DebStcVal200 "" UBYTE OneToOne 1 100 0.00 255.0 FORMAT "%5.1" ARRAY_SIZE 3 ECU_ADDRESS 0x60038B6C /end MEASUREMENT
/begin MEASUREMENT DDRCObsvr_Val.DebStcVal201 "" UBYTE OneToOne 1 100 0.00 255.0 FORMAT "%5.1" ARRAY_SIZE 3 ECU_ADDRESS 0x60038B6F /end MEASUREMENT
/begin MEASUREMENT DDRCObsvr_Val.DebStcVal202 "" UBYTE OneToOne 1 100 0.00 255.0 FORMAT "%5.1" ARRAY_SIZE 3 ECU_ADDRESS 0x60038B72 /end MEASUREMENT
/begin MEASUREMENT DDRCObsvr_Val.DebStcVal203 "" UBYTE OneToOne 1 100 0.00 255.0 FORMAT "%5.1" ARRAY_SIZE 3 ECU_ADDRESS 0x60038B75 /end MEASUREMENT
/begin MEASUREMENT DDRCObsvr_Val.DebStcVal204 "" UBYTE OneToOne 1 100 0.00 255.0 FORMAT "%5.1" ARRAY_SIZE 3 ECU_ADDRESS 0x60038B78 /end MEASUREMENT
/begin MEASUREMENT DDRCObsvr_Val.DebStcVal205 "" UBYTE OneToOne 1 100 0.00 255.0 FORMAT "%5.1" ARRAY_SIZE 3 ECU_ADDRESS 0x60038B7B /end MEASUREMENT
/begin MEASUREMENT DDRCObsvr_Val.DebStcVal206 "" UBYTE OneToOne 1 100 0.00 255.0 FORMAT "%5.1" ARRAY_SIZE 3 ECU_ADDRESS 0x60038B7E /end MEASUREMENT
/begin MEASUREMENT DDRCObsvr_Val.DebStcVal207 "" UBYTE OneToOne 1 100 0.00 255.0 FORMAT "%5.1" ARRAY_SIZE 3 ECU_ADDRESS 0x60038B81 /end MEASUREMENT
/begin MEASUREMENT DDRCObsvr_Val.DebStcVal208 "" UBYTE OneToOne 1 100 0.00 255.0 FORMAT "%5.1" ARRAY_SIZE 3 ECU_ADDRESS 0x60038B84 /end MEASUREMENT
/begin MEASUREMENT DDRCObsvr_Val.DebStcVal209 "" UBYTE OneToOne 1 100 0.00 255.0 FORMAT "%5.1" ARRAY_SIZE 3 ECU_ADDRESS 0x60038B87 /end MEASUREMENT
/begin MEASUREMENT DDRCObsvr_Val.DebStcVal210 "" UBYTE OneToOne 1 100 0.00 255.0 FORMAT "%5.1" ARRAY_SIZE 3 ECU_ADDRESS 0x60038B8A /end MEASUREMENT
/begin MEASUREMENT DDRCObsvr_Val.DebStcVal211 "" UBYTE OneToOne 1 100 0.00 255.0 FORMAT "%5.1" ARRAY_SIZE 3 ECU_ADDRESS 0x60038B8D /end MEASUREMENT
/begin MEASUREMENT DDRCObsvr_Val.DebStcVal212 "" UBYTE OneToOne 1 100 0.00 255.0 FORMAT "%5.1" ARRAY_SIZE 3 ECU_ADDRESS 0x60038B90 /end MEASUREMENT
/begin MEASUREMENT DDRCObsvr_Val.DebStcVal213 "" UBYTE OneToOne 1 100 0.00 255.0 FORMAT "%5.1" ARRAY_SIZE 3 ECU_ADDRESS 0x60038B93 /end MEASUREMENT
/begin MEASUREMENT DDRCObsvr_Val.DebStcVal214 "" UBYTE OneToOne 1 100 0.00 255.0 FORMAT "%5.1" ARRAY_SIZE 3 ECU_ADDRESS 0x60038B96 /end MEASUREMENT
/begin MEASUREMENT DDRCObsvr_Val.DebStcVal215 "" UBYTE OneToOne 1 100 0.00 255.0 FORMAT "%5.1" ARRAY_SIZE 3 ECU_ADDRESS 0x60038B99 /end MEASUREMENT
/begin MEASUREMENT DDRCObsvr_Val.DebStcVal216 "" UBYTE OneToOne 1 100 0.00 255.0 FORMAT "%5.1" ARRAY_SIZE 3 ECU_ADDRESS 0x60038B9C /end MEASUREMENT
/begin MEASUREMENT DDRCObsvr_Val.DebStcVal217 "" UBYTE OneToOne 1 100 0.00 255.0 FORMAT "%5.1" ARRAY_SIZE 3 ECU_ADDRESS 0x60038B9F /end MEASUREMENT
/begin MEASUREMENT DDRCObsvr_Val.DebStcVal218 "" UBYTE OneToOne 1 100 0.00 255.0 FORMAT "%5.1" ARRAY_SIZE 3 ECU_ADDRESS 0x60038BA2 /end MEASUREMENT
/begin MEASUREMENT DDRCObsvr_Val.DebStcVal219 "" UBYTE OneToOne 1 100 0.00 255.0 FORMAT "%5.1" ARRAY_SIZE 3 ECU_ADDRESS 0x60038BA5 /end MEASUREMENT
/begin MEASUREMENT DDRCObsvr_Val.DebStcVal220 "" UBYTE OneToOne 1 100 0.00 255.0 FORMAT "%5.1" ARRAY_SIZE 3 ECU_ADDRESS 0x60038BA8 /end MEASUREMENT
/begin MEASUREMENT DDRCObsvr_Val.DebStcVal221 "" UBYTE OneToOne 1 100 0.00 255.0 FORMAT "%5.1" ARRAY_SIZE 3 ECU_ADDRESS 0x60038BAB /end MEASUREMENT
/begin MEASUREMENT DDRCObsvr_Val.DebStcVal222 "" UBYTE OneToOne 1 100 0.00 255.0 FORMAT "%5.1" ARRAY_SIZE 3 ECU_ADDRESS 0x60038BAE /end MEASUREMENT
/begin MEASUREMENT DDRCObsvr_Val.DebStcVal223 "" UBYTE OneToOne 1 100 0.00 255.0 FORMAT "%5.1" ARRAY_SIZE 3 ECU_ADDRESS 0x60038BB1 /end MEASUREMENT
/begin MEASUREMENT DDRCObsvr_Val.DebStcVal224 "" UBYTE OneToOne 1 100 0.00 255.0 FORMAT "%5.1" ARRAY_SIZE 3 ECU_ADDRESS 0x60038BB4 /end MEASUREMENT
/begin MEASUREMENT DDRCObsvr_Val.DebStcVal225 "" UBYTE OneToOne 1 100 0.00 255.0 FORMAT "%5.1" ARRAY_SIZE 3 ECU_ADDRESS 0x60038BB7 /end MEASUREMENT
/begin MEASUREMENT DDRCObsvr_Val.DebStcVal226 "" UBYTE OneToOne 1 100 0.00 255.0 FORMAT "%5.1" ARRAY_SIZE 3 ECU_ADDRESS 0x60038BBA /end MEASUREMENT
/begin MEASUREMENT DDRCObsvr_Val.DebStcVal227 "" UBYTE OneToOne 1 100 0.00 255.0 FORMAT "%5.1" ARRAY_SIZE 3 ECU_ADDRESS 0x60038BBD /end MEASUREMENT
/begin MEASUREMENT DDRCObsvr_Val.DebStcVal228 "" UBYTE OneToOne 1 100 0.00 255.0 FORMAT "%5.1" ARRAY_SIZE 3 ECU_ADDRESS 0x60038BC0 /end MEASUREMENT
/begin MEASUREMENT DDRCObsvr_Val.DebStcVal229 "" UBYTE OneToOne 1 100 0.00 255.0 FORMAT "%5.1" ARRAY_SIZE 3 ECU_ADDRESS 0x60038BC3 /end MEASUREMENT
/begin MEASUREMENT DDRCObsvr_Val.DebStcVal230 "" UBYTE OneToOne 1 100 0.00 255.0 FORMAT "%5.1" ARRAY_SIZE 3 ECU_ADDRESS 0x60038BC6 /end MEASUREMENT
/begin MEASUREMENT DDRCObsvr_Val.DebStcVal231 "" UBYTE OneToOne 1 100 0.00 255.0 FORMAT "%5.1" ARRAY_SIZE 3 ECU_ADDRESS 0x60038BC9 /end MEASUREMENT
/begin MEASUREMENT DDRCObsvr_Val.DebStcVal232 "" UBYTE OneToOne 1 100 0.00 255.0 FORMAT "%5.1" ARRAY_SIZE 3 ECU_ADDRESS 0x60038BCC /end MEASUREMENT
/begin MEASUREMENT DDRCObsvr_Val.DebStcVal233 "" UBYTE OneToOne 1 100 0.00 255.0 FORMAT "%5.1" ARRAY_SIZE 3 ECU_ADDRESS 0x60038BCF /end MEASUREMENT
/begin MEASUREMENT DDRCObsvr_Val.DebStcVal234 "" UBYTE OneToOne 1 100 0.00 255.0 FORMAT "%5.1" ARRAY_SIZE 3 ECU_ADDRESS 0x60038BD2 /end MEASUREMENT
/begin MEASUREMENT DDRCObsvr_Val.DebStcVal235 "" UBYTE OneToOne 1 100 0.00 255.0 FORMAT "%5.1" ARRAY_SIZE 3 ECU_ADDRESS 0x60038BD5 /end MEASUREMENT
/begin MEASUREMENT DDRCObsvr_Val.DebStcVal236 "" UBYTE OneToOne 1 100 0.00 255.0 FORMAT "%5.1" ARRAY_SIZE 3 ECU_ADDRESS 0x60038BD8 /end MEASUREMENT
/begin MEASUREMENT DDRCObsvr_Val.DebStcVal237 "" UBYTE OneToOne 1 100 0.00 255.0 FORMAT "%5.1" ARRAY_SIZE 3 ECU_ADDRESS 0x60038BDB /end MEASUREMENT
/begin MEASUREMENT DDRCObsvr_Val.DebStcVal238 "" UBYTE OneToOne 1 100 0.00 255.0 FORMAT "%5.1" ARRAY_SIZE 3 ECU_ADDRESS 0x60038BDE /end MEASUREMENT
/begin MEASUREMENT DDRCObsvr_Val.DebStcVal239 "" UBYTE OneToOne 1 100 0.00 255.0 FORMAT "%5.1" ARRAY_SIZE 3 ECU_ADDRESS 0x60038BE1 /end MEASUREMENT
/begin MEASUREMENT DDRCObsvr_Val.DebStcVal240 "" UBYTE OneToOne 1 100 0.00 255.0 FORMAT "%5.1" ARRAY_SIZE 3 ECU_ADDRESS 0x60038BE4 /end MEASUREMENT
/begin MEASUREMENT DDRCObsvr_Val.DebStcVal241 "" UBYTE OneToOne 1 100 0.00 255.0 FORMAT "%5.1" ARRAY_SIZE 3 ECU_ADDRESS 0x60038BE7 /end MEASUREMENT
/begin MEASUREMENT DDRCObsvr_Val.DebStcVal242 "" UBYTE OneToOne 1 100 0.00 255.0 FORMAT "%5.1" ARRAY_SIZE 3 ECU_ADDRESS 0x60038BEA /end MEASUREMENT
/begin MEASUREMENT DDRCObsvr_Val.DebStcVal243 "" UBYTE OneToOne 1 100 0.00 255.0 FORMAT "%5.1" ARRAY_SIZE 3 ECU_ADDRESS 0x60038BED /end MEASUREMENT
/begin MEASUREMENT DDRCObsvr_Val.DebStcVal244 "" UBYTE OneToOne 1 100 0.00 255.0 FORMAT "%5.1" ARRAY_SIZE 3 ECU_ADDRESS 0x60038BF0 /end MEASUREMENT
/begin MEASUREMENT DDRCObsvr_Val.DebStcVal245 "" UBYTE OneToOne 1 100 0.00 255.0 FORMAT "%5.1" ARRAY_SIZE 3 ECU_ADDRESS 0x60038BF3 /end MEASUREMENT
/begin MEASUREMENT DDRCObsvr_Val.DebStcVal246 "" UBYTE OneToOne 1 100 0.00 255.0 FORMAT "%5.1" ARRAY_SIZE 3 ECU_ADDRESS 0x60038BF6 /end MEASUREMENT
/begin MEASUREMENT DDRCObsvr_Val.DebStcVal247 "" UBYTE OneToOne 1 100 0.00 255.0 FORMAT "%5.1" ARRAY_SIZE 3 ECU_ADDRESS 0x60038BF9 /end MEASUREMENT
/begin MEASUREMENT DDRCObsvr_Val.DebStcVal248 "" UBYTE OneToOne 1 100 0.00 255.0 FORMAT "%5.1" ARRAY_SIZE 3 ECU_ADDRESS 0x60038BFC /end MEASUREMENT
/begin MEASUREMENT DDRCObsvr_Val.DebStcVal249 "" UBYTE OneToOne 1 100 0.00 255.0 FORMAT "%5.1" ARRAY_SIZE 3 ECU_ADDRESS 0x60038BFF /end MEASUREMENT
/begin MEASUREMENT DDRCObsvr_Val.DebStcVal250 "" UBYTE OneToOne 1 100 0.00 255.0 FORMAT "%5.1" ARRAY_SIZE 3 ECU_ADDRESS 0x60038C02 /end MEASUREMENT
/begin MEASUREMENT DDRCObsvr_Val.DebStcVal251 "" UBYTE OneToOne 1 100 0.00 255.0 FORMAT "%5.1" ARRAY_SIZE 3 ECU_ADDRESS 0x60038C05 /end MEASUREMENT
/begin MEASUREMENT DDRCObsvr_Val.DebStcVal252 "" UBYTE OneToOne 1 100 0.00 255.0 FORMAT "%5.1" ARRAY_SIZE 3 ECU_ADDRESS 0x60038C08 /end MEASUREMENT
/begin MEASUREMENT DDRCObsvr_Val.DebStcVal253 "" UBYTE OneToOne 1 100 0.00 255.0 FORMAT "%5.1" ARRAY_SIZE 3 ECU_ADDRESS 0x60038C0B /end MEASUREMENT
/begin MEASUREMENT DDRCObsvr_Val.DebStcVal254 "" UBYTE OneToOne 1 100 0.00 255.0 FORMAT "%5.1" ARRAY_SIZE 3 ECU_ADDRESS 0x60038C0E /end MEASUREMENT
/begin MEASUREMENT DDRC_ctArDebLvl.DFC_BusDiagCANAPPLBusOff "Debouncing counters / Debounce Timer or Event counter for check DFC_BusDiagCANAPPLBusOff" SWORD DFC_OneToOne 1 100 -32768.00 32767.00 FORMAT "%8.2" ECU_ADDRESS 0x50005916 /end MEASUREMENT
/begin MEASUREMENT DDRC_ctArDebLvl.DFC_BusDiagCANCANCBusOff "Debouncing counters / Debounce Timer or Event counter for check DFC_BusDiagCANCANCBusOff" SWORD DFC_OneToOne 1 100 -32768.00 32767.00 FORMAT "%8.2" ECU_ADDRESS 0x50005918 /end MEASUREMENT
/begin MEASUREMENT DDRC_ctArDebLvl.DFC_BusDiagCANVEHICLEBusOff "Debouncing counters / Debounce Timer or Event counter for check DFC_BusDiagCANVEHICLEBusOff" SWORD DFC_OneToOne 1 100 -32768.00 32767.00 FORMAT "%8.2" ECU_ADDRESS 0x5000591A /end MEASUREMENT
/begin MEASUREMENT DDRC_ctArDebLvl.DFC_RBA_IODIAGPWR_rba_IoExtCy329_SignalVltSply_0 "Debouncing counters / Debounce Timer or Event counter for check DFC_RBA_IODIAGPWR_rba_IoExtCy329_SignalVltSply_0" SWORD DFC_OneToOne 1 100 -32768.00 32767.00 FORMAT "%8.2" ECU_ADDRESS 0x5000591C /end MEASUREMENT
/begin MEASUREMENT DDRC_ctArDebLvl.DFC_RBA_IODIAGPWR_rba_IoExtCy329_SignalVltSply_0OT "Debouncing counters / Debounce Timer or Event counter for check DFC_RBA_IODIAGPWR_rba_IoExtCy329_SignalVltSply_0OT" SWORD DFC_OneToOne 1 100 -32768.00 32767.00 FORMAT "%8.2" ECU_ADDRESS 0x5000591E /end MEASUREMENT
/begin MEASUREMENT DDRC_ctArDebLvl.DFC_RBA_IODIAGPWR_rba_IoExtCy329_SignalVltSply_0OV "Debouncing counters / Debounce Timer or Event counter for check DFC_RBA_IODIAGPWR_rba_IoExtCy329_SignalVltSply_0OV" SWORD DFC_OneToOne 1 100 -32768.00 32767.00 FORMAT "%8.2" ECU_ADDRESS 0x50005920 /end MEASUREMENT
/begin MEASUREMENT DDRC_ctArDebLvl.DFC_RBA_IODIAGPWR_rba_IoExtCy329_SignalVltSply_0SCG "Debouncing counters / Debounce Timer or Event counter for check DFC_RBA_IODIAGPWR_rba_IoExtCy329_SignalVltSply_0SCG" SWORD DFC_OneToOne 1 100 -32768.00 32767.00 FORMAT "%8.2" ECU_ADDRESS 0x50005922 /end MEASUREMENT
/begin MEASUREMENT DDRC_ctArDebLvl.DFC_RBA_IODIAGPWR_rba_IoExtCy329_SignalVltSply_0UV "Debouncing counters / Debounce Timer or Event counter for check DFC_RBA_IODIAGPWR_rba_IoExtCy329_SignalVltSply_0UV" SWORD DFC_OneToOne 1 100 -32768.00 32767.00 FORMAT "%8.2" ECU_ADDRESS 0x50005924 /end MEASUREMENT
/begin MEASUREMENT DDRC_ctArDebLvl.DFC_RBA_IODIAGPWR_rba_IoExtCy329_SignalVltSply_1 "Debouncing counters / Debounce Timer or Event counter for check DFC_RBA_IODIAGPWR_rba_IoExtCy329_SignalVltSply_1" SWORD DFC_OneToOne 1 100 -32768.00 32767.00 FORMAT "%8.2" ECU_ADDRESS 0x50005926 /end MEASUREMENT
/begin MEASUREMENT DDRC_ctArDebLvl.DFC_RBA_IODIAGPWR_rba_IoExtCy329_SignalVltSply_1OT "Debouncing counters / Debounce Timer or Event counter for check DFC_RBA_IODIAGPWR_rba_IoExtCy329_SignalVltSply_1OT" SWORD DFC_OneToOne 1 100 -32768.00 32767.00 FORMAT "%8.2" ECU_ADDRESS 0x50005928 /end MEASUREMENT
/begin MEASUREMENT DDRC_ctArDebLvl.DFC_RBA_IODIAGPWR_rba_IoExtCy329_SignalVltSply_1OV "Debouncing counters / Debounce Timer or Event counter for check DFC_RBA_IODIAGPWR_rba_IoExtCy329_SignalVltSply_1OV" SWORD DFC_OneToOne 1 100 -32768.00 32767.00 FORMAT "%8.2" ECU_ADDRESS 0x5000592A /end MEASUREMENT
/begin MEASUREMENT DDRC_ctArDebLvl.DFC_RBA_IODIAGPWR_rba_IoExtCy329_SignalVltSply_1SCG "Debouncing counters / Debounce Timer or Event counter for check DFC_RBA_IODIAGPWR_rba_IoExtCy329_SignalVltSply_1SCG" SWORD DFC_OneToOne 1 100 -32768.00 32767.00 FORMAT "%8.2" ECU_ADDRESS 0x5000592C /end MEASUREMENT
/begin MEASUREMENT DDRC_ctArDebLvl.DFC_RBA_IODIAGPWR_rba_IoExtCy329_SignalVltSply_1UV "Debouncing counters / Debounce Timer or Event counter for check DFC_RBA_IODIAGPWR_rba_IoExtCy329_SignalVltSply_1UV" SWORD DFC_OneToOne 1 100 -32768.00 32767.00 FORMAT "%8.2" ECU_ADDRESS 0x5000592E /end MEASUREMENT
/begin MEASUREMENT DDRC_ctArDebLvl.DFC_RBA_IODIAGPWR_rba_IoExtCy329_SignalVltSply_2 "Debouncing counters / Debounce Timer or Event counter for check DFC_RBA_IODIAGPWR_rba_IoExtCy329_SignalVltSply_2" SWORD DFC_OneToOne 1 100 -32768.00 32767.00 FORMAT "%8.2" ECU_ADDRESS 0x50005930 /end MEASUREMENT
/begin MEASUREMENT DDRC_ctArDebLvl.DFC_RBA_IODIAGPWR_rba_IoExtCy329_SignalVltSply_2OT "Debouncing counters / Debounce Timer or Event counter for check DFC_RBA_IODIAGPWR_rba_IoExtCy329_SignalVltSply_2OT" SWORD DFC_OneToOne 1 100 -32768.00 32767.00 FORMAT "%8.2" ECU_ADDRESS 0x50005932 /end MEASUREMENT
/begin MEASUREMENT DDRC_ctArDebLvl.DFC_RBA_IODIAGPWR_rba_IoExtCy329_SignalVltSply_2OV "Debouncing counters / Debounce Timer or Event counter for check DFC_RBA_IODIAGPWR_rba_IoExtCy329_SignalVltSply_2OV" SWORD DFC_OneToOne 1 100 -32768.00 32767.00 FORMAT "%8.2" ECU_ADDRESS 0x50005934 /end MEASUREMENT
/begin MEASUREMENT DDRC_ctArDebLvl.DFC_RBA_IODIAGPWR_rba_IoExtCy329_SignalVltSply_2SCG "Debouncing counters / Debounce Timer or Event counter for check DFC_RBA_IODIAGPWR_rba_IoExtCy329_SignalVltSply_2SCG" SWORD DFC_OneToOne 1 100 -32768.00 32767.00 FORMAT "%8.2" ECU_ADDRESS 0x50005936 /end MEASUREMENT
/begin MEASUREMENT DDRC_ctArDebLvl.DFC_RBA_IODIAGPWR_rba_IoExtCy329_SignalVltSply_2UV "Debouncing counters / Debounce Timer or Event counter for check DFC_RBA_IODIAGPWR_rba_IoExtCy329_SignalVltSply_2UV" SWORD DFC_OneToOne 1 100 -32768.00 32767.00 FORMAT "%8.2" ECU_ADDRESS 0x50005938 /end MEASUREMENT
/begin MEASUREMENT DDRC_ctArDebLvl.DFC_CAN_E_TIMEOUT "Debouncing counters / Debounce Timer or Event counter for check DFC_CAN_E_TIMEOUT" SWORD DFC_OneToOne 1 100 -32768.00 32767.00 FORMAT "%8.2" ECU_ADDRESS 0x5000593A /end MEASUREMENT
/begin MEASUREMENT DDRC_ctArDebLvl.DFC_LIN_E_TIMEOUT "Debouncing counters / Debounce Timer or Event counter for check DFC_LIN_E_TIMEOUT" SWORD DFC_OneToOne 1 100 -32768.00 32767.00 FORMAT "%8.2" ECU_ADDRESS 0x5000593C /end MEASUREMENT
/begin MEASUREMENT DDRC_ctArDebLvl.DFC_MRlyOL "Debouncing counters / Debounce Timer or Event counter for check DFC_MRlyOL" SWORD DFC_OneToOne 1 100 -32768.00 32767.00 FORMAT "%8.2" ECU_ADDRESS 0x5000593E /end MEASUREMENT
/begin MEASUREMENT DDRC_ctArDebLvl.DFC_MRlySCB "Debouncing counters / Debounce Timer or Event counter for check DFC_MRlySCB" SWORD DFC_OneToOne 1 100 -32768.00 32767.00 FORMAT "%8.2" ECU_ADDRESS 0x50005940 /end MEASUREMENT
/begin MEASUREMENT DDRC_ctArDebLvl.DFC_MRlySCG "Debouncing counters / Debounce Timer or Event counter for check DFC_MRlySCG" SWORD DFC_OneToOne 1 100 -32768.00 32767.00 FORMAT "%8.2" ECU_ADDRESS 0x50005942 /end MEASUREMENT
/begin MEASUREMENT DDRC_ctArDebLvl.DFC_rba_MultiStackTrace_Threshold "Debouncing counters / Debounce Timer or Event counter for check DFC_rba_MultiStackTrace_Threshold" SWORD DFC_OneToOne 1 100 -32768.00 32767.00 FORMAT "%8.2" ECU_ADDRESS 0x50005944 /end MEASUREMENT
/begin MEASUREMENT DDRC_stLstRprtEve.DFC_BusDiagCANAPPLBusOff "Monitoring state / Monitoring state of DFC_BusDiagCANAPPLBusOff" UBYTE DDRC_LstRprtEve_VERB 1 100 0.00 255.000000000 FORMAT "%13.9" ECU_ADDRESS 0x60010F25 /end MEASUREMENT
/begin MEASUREMENT DDRC_stLstRprtEve.DFC_BusDiagCANCANCBusOff "Monitoring state / Monitoring state of DFC_BusDiagCANCANCBusOff" UBYTE DDRC_LstRprtEve_VERB 1 100 0.00 255.000000000 FORMAT "%13.9" ECU_ADDRESS 0x60010F26 /end MEASUREMENT
/begin MEASUREMENT DDRC_stLstRprtEve.DFC_BusDiagCANVEHICLEBusOff "Monitoring state / Monitoring state of DFC_BusDiagCANVEHICLEBusOff" UBYTE DDRC_LstRprtEve_VERB 1 100 0.00 255.000000000 FORMAT "%13.9" ECU_ADDRESS 0x60010F27 /end MEASUREMENT
/begin MEASUREMENT DDRC_stLstRprtEve.DFC_RBA_IODIAGPWR_rba_IoExtCy329_SignalVltSply_0 "Monitoring state / Monitoring state of DFC_RBA_IODIAGPWR_rba_IoExtCy329_SignalVltSply_0" UBYTE DDRC_LstRprtEve_VERB 1 100 0.00 255.000000000 FORMAT "%13.9" ECU_ADDRESS 0x60010F28 /end MEASUREMENT
/begin MEASUREMENT DDRC_stLstRprtEve.DFC_RBA_IODIAGPWR_rba_IoExtCy329_SignalVltSply_0OT "Monitoring state / Monitoring state of DFC_RBA_IODIAGPWR_rba_IoExtCy329_SignalVltSply_0OT" UBYTE DDRC_LstRprtEve_VERB 1 100 0.00 255.000000000 FORMAT "%13.9" ECU_ADDRESS 0x60010F29 /end MEASUREMENT
/begin MEASUREMENT DDRC_stLstRprtEve.DFC_RBA_IODIAGPWR_rba_IoExtCy329_SignalVltSply_0OV "Monitoring state / Monitoring state of DFC_RBA_IODIAGPWR_rba_IoExtCy329_SignalVltSply_0OV" UBYTE DDRC_LstRprtEve_VERB 1 100 0.00 255.000000000 FORMAT "%13.9" ECU_ADDRESS 0x60010F2A /end MEASUREMENT
/begin MEASUREMENT DDRC_stLstRprtEve.DFC_RBA_IODIAGPWR_rba_IoExtCy329_SignalVltSply_0SCG "Monitoring state / Monitoring state of DFC_RBA_IODIAGPWR_rba_IoExtCy329_SignalVltSply_0SCG" UBYTE DDRC_LstRprtEve_VERB 1 100 0.00 255.000000000 FORMAT "%13.9" ECU_ADDRESS 0x60010F2B /end MEASUREMENT
/begin MEASUREMENT DDRC_stLstRprtEve.DFC_RBA_IODIAGPWR_rba_IoExtCy329_SignalVltSply_0UV "Monitoring state / Monitoring state of DFC_RBA_IODIAGPWR_rba_IoExtCy329_SignalVltSply_0UV" UBYTE DDRC_LstRprtEve_VERB 1 100 0.00 255.000000000 FORMAT "%13.9" ECU_ADDRESS 0x60010F2C /end MEASUREMENT
/begin MEASUREMENT DDRC_stLstRprtEve.DFC_RBA_IODIAGPWR_rba_IoExtCy329_SignalVltSply_1 "Monitoring state / Monitoring state of DFC_RBA_IODIAGPWR_rba_IoExtCy329_SignalVltSply_1" UBYTE DDRC_LstRprtEve_VERB 1 100 0.00 255.000000000 FORMAT "%13.9" ECU_ADDRESS 0x60010F2D /end MEASUREMENT
/begin MEASUREMENT DDRC_stLstRprtEve.DFC_RBA_IODIAGPWR_rba_IoExtCy329_SignalVltSply_1OT "Monitoring state / Monitoring state of DFC_RBA_IODIAGPWR_rba_IoExtCy329_SignalVltSply_1OT" UBYTE DDRC_LstRprtEve_VERB 1 100 0.00 255.000000000 FORMAT "%13.9" ECU_ADDRESS 0x60010F2E /end MEASUREMENT
/begin MEASUREMENT DDRC_stLstRprtEve.DFC_RBA_IODIAGPWR_rba_IoExtCy329_SignalVltSply_1OV "Monitoring state / Monitoring state of DFC_RBA_IODIAGPWR_rba_IoExtCy329_SignalVltSply_1OV" UBYTE DDRC_LstRprtEve_VERB 1 100 0.00 255.000000000 FORMAT "%13.9" ECU_ADDRESS 0x60010F2F /end MEASUREMENT
/begin MEASUREMENT DDRC_stLstRprtEve.DFC_RBA_IODIAGPWR_rba_IoExtCy329_SignalVltSply_1SCG "Monitoring state / Monitoring state of DFC_RBA_IODIAGPWR_rba_IoExtCy329_SignalVltSply_1SCG" UBYTE DDRC_LstRprtEve_VERB 1 100 0.00 255.000000000 FORMAT "%13.9" ECU_ADDRESS 0x60010F30 /end MEASUREMENT
/begin MEASUREMENT DDRC_stLstRprtEve.DFC_RBA_IODIAGPWR_rba_IoExtCy329_SignalVltSply_1UV "Monitoring state / Monitoring state of DFC_RBA_IODIAGPWR_rba_IoExtCy329_SignalVltSply_1UV" UBYTE DDRC_LstRprtEve_VERB 1 100 0.00 255.000000000 FORMAT "%13.9" ECU_ADDRESS 0x60010F31 /end MEASUREMENT
/begin MEASUREMENT DDRC_stLstRprtEve.DFC_RBA_IODIAGPWR_rba_IoExtCy329_SignalVltSply_2 "Monitoring state / Monitoring state of DFC_RBA_IODIAGPWR_rba_IoExtCy329_SignalVltSply_2" UBYTE DDRC_LstRprtEve_VERB 1 100 0.00 255.000000000 FORMAT "%13.9" ECU_ADDRESS 0x60010F32 /end MEASUREMENT
/begin MEASUREMENT DDRC_stLstRprtEve.DFC_RBA_IODIAGPWR_rba_IoExtCy329_SignalVltSply_2OT "Monitoring state / Monitoring state of DFC_RBA_IODIAGPWR_rba_IoExtCy329_SignalVltSply_2OT" UBYTE DDRC_LstRprtEve_VERB 1 100 0.00 255.000000000 FORMAT "%13.9" ECU_ADDRESS 0x60010F33 /end MEASUREMENT
/begin MEASUREMENT DDRC_stLstRprtEve.DFC_RBA_IODIAGPWR_rba_IoExtCy329_SignalVltSply_2OV "Monitoring state / Monitoring state of DFC_RBA_IODIAGPWR_rba_IoExtCy329_SignalVltSply_2OV" UBYTE DDRC_LstRprtEve_VERB 1 100 0.00 255.000000000 FORMAT "%13.9" ECU_ADDRESS 0x60010F34 /end MEASUREMENT
/begin MEASUREMENT DDRC_stLstRprtEve.DFC_RBA_IODIAGPWR_rba_IoExtCy329_SignalVltSply_2SCG "Monitoring state / Monitoring state of DFC_RBA_IODIAGPWR_rba_IoExtCy329_SignalVltSply_2SCG" UBYTE DDRC_LstRprtEve_VERB 1 100 0.00 255.000000000 FORMAT "%13.9" ECU_ADDRESS 0x60010F35 /end MEASUREMENT
/begin MEASUREMENT DDRC_stLstRprtEve.DFC_RBA_IODIAGPWR_rba_IoExtCy329_SignalVltSply_2UV "Monitoring state / Monitoring state of DFC_RBA_IODIAGPWR_rba_IoExtCy329_SignalVltSply_2UV" UBYTE DDRC_LstRprtEve_VERB 1 100 0.00 255.000000000 FORMAT "%13.9" ECU_ADDRESS 0x60010F36 /end MEASUREMENT
/begin MEASUREMENT DDRC_stLstRprtEve.DFC_CAN_E_TIMEOUT "Monitoring state / Monitoring state of DFC_CAN_E_TIMEOUT" UBYTE DDRC_LstRprtEve_VERB 1 100 0.00 255.000000000 FORMAT "%13.9" ECU_ADDRESS 0x60010F37 /end MEASUREMENT
/begin MEASUREMENT DDRC_stLstRprtEve.DFC_LIN_E_TIMEOUT "Monitoring state / Monitoring state of DFC_LIN_E_TIMEOUT" UBYTE DDRC_LstRprtEve_VERB 1 100 0.00 255.000000000 FORMAT "%13.9" ECU_ADDRESS 0x60010F38 /end MEASUREMENT
/begin MEASUREMENT DDRC_stLstRprtEve.DFC_MRlyOL "Monitoring state / Monitoring state of DFC_MRlyOL" UBYTE DDRC_LstRprtEve_VERB 1 100 0.00 255.000000000 FORMAT "%13.9" ECU_ADDRESS 0x60010F39 /end MEASUREMENT
/begin MEASUREMENT DDRC_stLstRprtEve.DFC_MRlySCB "Monitoring state / Monitoring state of DFC_MRlySCB" UBYTE DDRC_LstRprtEve_VERB 1 100 0.00 255.000000000 FORMAT "%13.9" ECU_ADDRESS 0x60010F3A /end MEASUREMENT
/begin MEASUREMENT DDRC_stLstRprtEve.DFC_MRlySCG "Monitoring state / Monitoring state of DFC_MRlySCG" UBYTE DDRC_LstRprtEve_VERB 1 100 0.00 255.000000000 FORMAT "%13.9" ECU_ADDRESS 0x60010F3B /end MEASUREMENT
/begin MEASUREMENT DDRC_stLstRprtEve.DFC_rba_MultiStackTrace_Threshold "Monitoring state / Monitoring state of DFC_rba_MultiStackTrace_Threshold" UBYTE DDRC_LstRprtEve_VERB 1 100 0.00 255.000000000 FORMAT "%13.9" ECU_ADDRESS 0x60010F3C /end MEASUREMENT
/begin MEASUREMENT FuPHi_flgDSMClrDSKVRNpl10ms "handshake variable for DSM-Clear handling" UBYTE B_TRUE 1 100 0.00 1.00000000000 BIT_MASK 0x1 FORMAT "%13.11" ECU_ADDRESS 0x70000384 /end MEASUREMENT
/begin MEASUREMENT FuPHi_flgDSMClrDSKVRNpl50ms "handshake variable for DSM-Clear handling" UBYTE B_TRUE 1 100 0.00 1.00000000000 BIT_MASK 0x1 FORMAT "%13.11" ECU_ADDRESS 0x70000383 /end MEASUREMENT
/begin MEASUREMENT FuPHi_flgDSMClrDSKVRSig10ms "handshake variable for DSM-Clear handling" UBYTE B_TRUE 1 100 0.00 1.00000000000 BIT_MASK 0x1 FORMAT "%13.11" ECU_ADDRESS 0x70000382 /end MEASUREMENT
/begin MEASUREMENT FuPHi_flgDSMClrDSKVRSig50ms "handshake variable for DSM-Clear handling" UBYTE B_TRUE 1 100 0.00 1.00000000000 BIT_MASK 0x1 FORMAT "%13.11" ECU_ADDRESS 0x70000381 /end MEASUREMENT
/begin MEASUREMENT FuPHi_flgEnaStoreLoP_msg "activate storage ekp pressure (low pressure)" UBYTE B_TRUE 1 100 0.00 1.00000000000 BIT_MASK 0x1 FORMAT "%13.11" ECU_ADDRESS 0x600001B1 /end MEASUREMENT
/begin MEASUREMENT FuPHi_pRawRelInit "fuel rail pressure raw value (relative value) before start" UWORD RBPtCel_p_0p002_1 1 100 0.00 131.0700 FORMAT "%8.4" ECU_ADDRESS 0x60001618 /end MEASUREMENT
/begin MEASUREMENT FuPHi_stDetSleep "state for detection of power on" ULONG OneToOne 1 100 0.00 4294967295.00 FORMAT "%13.2" ECU_ADDRESS 0x70039BF4 /end MEASUREMENT
/begin MEASUREMENT pnekp_w "Unfiltered rail pressure real value (relative pressure) after ekp prerun" UWORD RBPtCel_p_0p002_1 1 100 0.00 131.0700 FORMAT "%8.4" ECU_ADDRESS 0x60001060 /end MEASUREMENT
/begin MEASUREMENT prnekpvl_w "rail pressure real value (abs.) after ekp prerun" UWORD RBPtCel_p_0p002_1 1 100 0.00 131.0700 FORMAT "%8.4" ECU_ADDRESS 0x6000105E /end MEASUREMENT
/begin MEASUREMENT prprekp_w "Unfiltered rail pressure real value (relative pressure) predrive after ekp prerun" UWORD RBPtCel_p_0p002_1 1 100 0.00 131.0700 FORMAT "%8.4" ECU_ADDRESS 0x6003977E /end MEASUREMENT
/begin MEASUREMENT prpre_w "Unfiltered rail pressure real value (relative pressure) predrive" UWORD RBPtCel_p_0p002_1 1 100 0.00 131.0700 FORMAT "%8.4" ECU_ADDRESS 0x6003977C /end MEASUREMENT
/begin MEASUREMENT prvekpvl_w "rail pressure real value (abs.) before ekp prerun" UWORD RBPtCel_p_0p002_1 1 100 0.00 131.0700 FORMAT "%8.4" ECU_ADDRESS 0x6000105C /end MEASUREMENT
/begin MEASUREMENT tiekpold "system time after EKP prerun" ULONG t_q10_ms 1 100 0.00 42949672950.0 FORMAT "%13.1" ECU_ADDRESS 0x60001058 /end MEASUREMENT
/begin MEASUREMENT tiekp_w "time duration after B_ekp" UWORD t_q0p1 1 100 0.00 6553.500 FORMAT "%8.3" ECU_ADDRESS 0x60001056 /end MEASUREMENT
/begin FUNCTION DDRC "30000.21.1Diagnostic Debounce and Report of Check"
 /begin DEF_CHARACTERISTIC DDRC_RatDeb.Com_tiCntTCU12UDRat_C DDRC_RatDeb.Com_tiCntTCU13UDRat_C DDRC_RatDeb.Com_tiCntTCU2UDRat_C DDRC_RatDeb.Com_tiCntTCU3UDRat_C DDRC_RatDeb.Com_tiCntTCU4UDRat_C DDRC_RatDeb.Com_tiTOutTCU01UDRat_C DDRC_RatDeb.Com_tiTOutTCU02UDRat_C DDRC_RatDeb.Com_tiTOutTCU1UDRat_C DDRC_RatDeb.Com_tiTOutTCU11UDRat_C DDRC_RatDeb.Com_tiTOutTCU12UDRat_C DDRC_RatDeb.Com_tiTOutTCU13UDRat_C DDRC_RatDeb.Com_tiTOutTCU14UDRat_C DDRC_RatDeb.Com_tiTOutTCU2UDRat_C DDRC_RatDeb.Com_tiTOutTCU3UDRat_C DDRC_RatDeb.Com_tiTOutTCU4UDRat_C DDRC_RatDeb.DevLib_tiBattUHiUDRat_C DDRC_RatDeb.DevLib_tiBattULoUDRat_C DDRC_RatDeb.EGRVlv_tiFailSafeActvUDRat_C DDRC_RatDeb.EGRVlv_tiGovDvtCldUDRat_C DDRC_RatDeb.EGRVlv_tiPhysSRCMaxUDRat_C DDRC_RatDeb.EGRVlv_tiPhysSRCMinUDRat_C DDRC_RatDeb.Fan_tiDIOOLUDRat_C DDRC_RatDeb.Fan_tiDIOOvrTempUDRat_C DDRC_RatDeb.Fan_tiDIOSCBUDRat_C DDRC_RatDeb.Fan_tiDIOSCGUDRat_C DDRC_RatDeb.MRlyDcOL_tisigOLUDRat_C DDRC_RatDeb.MRlyDcSCB_tisigSCBUDRat_C DDRC_RatDeb.MRlyDcSCG_tisigSCGUDRat_C DDRC_RatDeb.PSP_tiOLUDRat_C DDRC_RatDeb.PSP_tiOvrTempUDRat_C DDRC_RatDeb.PSP_tiSCBUDRat_C DDRC_RatDeb.PSP_tiSCGUDRat_C DDRC_RatDeb.T50_tiErrUDRat_C DDRC_RatDeb.ThrVlv_tiLoBattB1UDRat_C DDRC_RatDeb.UEGO_tiOperPlausUDRat_C DDRC_RatDeb.VehV_tiCANSigFLUDRat_C DDRC_RatDeb.VehV_tiCANSigFRUDRat_C DDRC_RatDeb.VehV_tiCANSigRLUDRat_C DDRC_RatDeb.VehV_tiCANSigRRUDRat_C DDRC_RatDeb.VehV_tiOLUDRat_C DDRC_RatDeb.VehV_tiOTUDRat_C DDRC_RatDeb.VehV_tiPhysRngHiUDRat_C DDRC_RatDeb.VehV_tiSCBUDRat_C DDRC_RatDeb.VehV_tiSCGUDRat_C DDRC_RatDeb.VehV_tiSnsrARngHiUDRat_C DDRC_RatDeb.VehV_tiSnsrBRngHiUDRat_C DDRC_RatDeb.VehV_tiSpdRtyDiagUDRat_C DDRC_RatDeb.DDHFHD_numDhfDebDef_CUDRat_C DDRC_RatDeb.InjVlv_numDcDcUDRat_C DDRC_RatDeb.InjVlv_numNoLdUDRat_C DDRC_RatDeb.InjVlv_numScBnkUDRat_C DDRC_RatDeb.InjVlv_numScCylUDRat_C DDRC_RatDeb.InjVlv_numScHsLsUDRat_C DDRC_RatDeb.MfPsDia_numOpenLoadUDRat_C DDRC_RatDeb.MfPsDia_numScHiSUDRat_C DDRC_RatDeb.MfPsDia_numScHiSLowSUDRat_C DDRC_RatDeb.MfPsDia_numScLowSUDRat_C DDRC_RatDeb.ACEvpT_tiPhysRngHiUDRat_C DDRC_RatDeb.ACEvpT_tiPhysRngLoUDRat_C DDRC_RatDeb.ACEvpT_tiSRCMaxUDRat_C DDRC_RatDeb.ACEvpT_tiSRCMinUDRat_C DDRC_RatDeb.AFS_tiRawSigRngHiB1UDRat_C DDRC_RatDeb.AFS_tiRawSigRngLoB1UDRat_C DDRC_RatDeb.AFS_tiSnsrErrB1UDRat_C DDRC_RatDeb.AirC_tiClntSRCMaxUDRat_C DDRC_RatDeb.AirC_tiClntSRCMinUDRat_C DDRC_RatDeb.AirC_tiSwtNplUDRat_C DDRC_RatDeb.AirC_tiSwtSigUDRat_C DDRC_RatDeb.BrkBstP_tiSCBUDRat_C DDRC_RatDeb.BrkBstP_tiSCGUDRat_C DDRC_RatDeb.Brk_tiUDRat_C DDRC_RatDeb.Brk_tiSigUDRat_C DDRC_RatDeb.Clth_tiSigUDRat_C DDRC_RatDeb.EGRVlv_tiCurrLimUDRat_C DDRC_RatDeb.EGRVlv_tiOLUDRat_C DDRC_RatDeb.EGRVlv_tiOvrTempUDRat_C DDRC_RatDeb.EGRVlv_tiSCBUDRat_C DDRC_RatDeb.EGRVlv_tiSCGUDRat_C DDRC_RatDeb.EGRVlv_tiSRCMaxUDRat_C DDRC_RatDeb.EGRVlv_tiSRCMinUDRat_C DDRC_RatDeb.HLSDem_tiOvhtUDRat_C DDRC_RatDeb.Oil_tiSRCMaxPSwmpUDRat_C DDRC_RatDeb.Oil_tiSRCMinPSwmpUDRat_C DDRC_RatDeb.PIntkVUs_tiLineHiB1UDRat_C DDRC_RatDeb.PIntkVUs_tiLineLoB1UDRat_C DDRC_RatDeb.VehV_tiPhysRngLoUDRat_C DDRC_RatDeb.VehV_tiSigCanUDRat_C DDRC_RatDeb.VehV_tiSigCanSafeUDRat_C DDRC_RatDeb.VlvLft_tiSRCMaxOilPSnsrIntk11UDRat_C DDRC_RatDeb.VlvLft_tiSRCMinOilPSnsrIntk11UDRat_C DDRC_RatDeb.Clth_numPlaUDRat_C DDRC_RatDeb.Gbx_numPNPosnDrvCdnUDRat_C DDRC_RatDeb.Gbx_numPNPosnPlausyUDRat_C /end DEF_CHARACTERISTIC
 FUNCTION_VERSION "30000.21.1" /end FUNCTION
/begin FUNCTION DDRCObsvr "30164.0.0 Observer for Diagnostic Debounce and Report of Check"
 /begin DEF_CHARACTERISTIC DDRCObsvr_Check_CA DDRCObsvr_Intl.DebStcLim0_CA DDRCObsvr_Intl.DebStcLim1_CA DDRCObsvr_Intl.DebStcLim2_CA DDRCObsvr_Intl.DebStcLim3_CA DDRCObsvr_Intl.DebStcLim4_CA DDRCObsvr_Intl.DebStcLim5_CA DDRCObsvr_Intl.DebStcLim6_CA DDRCObsvr_Intl.DebStcLim7_CA DDRCObsvr_Intl.DebStcLim8_CA DDRCObsvr_Intl.DebStcLim9_CA DDRCObsvr_Intl.DebStcLim10_CA DDRCObsvr_Intl.DebStcLim11_CA DDRCObsvr_Intl.DebStcLim12_CA DDRCObsvr_Intl.DebStcLim13_CA DDRCObsvr_Intl.DebStcLim14_CA DDRCObsvr_Intl.DebStcLim15_CA DDRCObsvr_Intl.DebStcLim16_CA DDRCObsvr_Intl.DebStcLim17_CA DDRCObsvr_Intl.DebStcLim18_CA DDRCObsvr_Intl.DebStcLim19_CA DDRCObsvr_Intl.DebStcLim20_CA DDRCObsvr_Intl.DebStcLim21_CA DDRCObsvr_Intl.DebStcLim22_CA DDRCObsvr_Intl.DebStcLim23_CA DDRCObsvr_Intl.DebStcLim24_CA DDRCObsvr_Intl.DebStcLim25_CA DDRCObsvr_Intl.DebStcLim26_CA DDRCObsvr_Intl.DebStcLim27_CA DDRCObsvr_Intl.DebStcLim28_CA DDRCObsvr_Intl.DebStcLim29_CA DDRCObsvr_Intl.DebStcLim30_CA DDRCObsvr_Intl.DebStcLim31_CA DDRCObsvr_Intl.DebStcLim32_CA DDRCObsvr_Intl.DebStcLim33_CA DDRCObsvr_Intl.DebStcLim34_CA DDRCObsvr_Intl.DebStcLim35_CA DDRCObsvr_Intl.DebStcLim36_CA DDRCObsvr_Intl.DebStcLim37_CA DDRCObsvr_Intl.DebStcLim38_CA DDRCObsvr_Intl.DebStcLim39_CA DDRCObsvr_Intl.DebStcLim40_CA DDRCObsvr_Intl.DebStcLim41_CA DDRCObsvr_Intl.DebStcLim42_CA DDRCObsvr_Intl.DebStcLim43_CA DDRCObsvr_Intl.DebStcLim44_CA DDRCObsvr_Intl.DebStcLim45_CA DDRCObsvr_Intl.DebStcLim46_CA DDRCObsvr_Intl.DebStcLim47_CA DDRCObsvr_Intl.DebStcLim48_CA DDRCObsvr_Intl.DebStcLim49_CA DDRCObsvr_Intl.DebStcLim50_CA DDRCObsvr_Intl.DebStcLim51_CA DDRCObsvr_Intl.DebStcLim52_CA DDRCObsvr_Intl.DebStcLim53_CA DDRCObsvr_Intl.DebStcLim54_CA DDRCObsvr_Intl.DebStcLim55_CA DDRCObsvr_Intl.DebStcLim56_CA DDRCObsvr_Intl.DebStcLim57_CA DDRCObsvr_Intl.DebStcLim58_CA DDRCObsvr_Intl.DebStcLim59_CA DDRCObsvr_Intl.DebStcLim60_CA DDRCObsvr_Intl.DebStcLim61_CA DDRCObsvr_Intl.DebStcLim62_CA DDRCObsvr_Intl.DebStcLim63_CA DDRCObsvr_Intl.DebStcLim64_CA DDRCObsvr_Intl.DebStcLim65_CA DDRCObsvr_Intl.DebStcLim66_CA DDRCObsvr_Intl.DebStcLim67_CA DDRCObsvr_Intl.DebStcLim68_CA DDRCObsvr_Intl.DebStcLim69_CA DDRCObsvr_Intl.DebStcLim70_CA DDRCObsvr_Intl.DebStcLim71_CA DDRCObsvr_Intl.DebStcLim72_CA DDRCObsvr_Intl.DebStcLim73_CA DDRCObsvr_Intl.DebStcLim74_CA DDRCObsvr_Intl.DebStcLim75_CA DDRCObsvr_Intl.DebStcLim76_CA DDRCObsvr_Intl.DebStcLim77_CA DDRCObsvr_Intl.DebStcLim78_CA DDRCObsvr_Intl.DebStcLim79_CA DDRCObsvr_Intl.DebStcLim80_CA DDRCObsvr_Intl.DebStcLim81_CA DDRCObsvr_Intl.DebStcLim82_CA DDRCObsvr_Intl.DebStcLim83_CA DDRCObsvr_Intl.DebStcLim84_CA DDRCObsvr_Intl.DebStcLim85_CA DDRCObsvr_Intl.DebStcLim86_CA DDRCObsvr_Intl.DebStcLim87_CA DDRCObsvr_Intl.DebStcLim88_CA DDRCObsvr_Intl.DebStcLim89_CA DDRCObsvr_Intl.DebStcLim90_CA DDRCObsvr_Intl.DebStcLim91_CA DDRCObsvr_Intl.DebStcLim92_CA DDRCObsvr_Intl.DebStcLim93_CA DDRCObsvr_Intl.DebStcLim94_CA DDRCObsvr_Intl.DebStcLim95_CA DDRCObsvr_Intl.DebStcLim96_CA DDRCObsvr_Intl.DebStcLim97_CA DDRCObsvr_Intl.DebStcLim98_CA DDRCObsvr_Intl.DebStcLim99_CA DDRCObsvr_Intl.DebStcLim100_CA DDRCObsvr_Intl.DebStcLim101_CA DDRCObsvr_Intl.DebStcLim102_CA DDRCObsvr_Intl.DebStcLim103_CA DDRCObsvr_Intl.DebStcLim104_CA DDRCObsvr_Intl.DebStcLim105_CA DDRCObsvr_Intl.DebStcLim106_CA DDRCObsvr_Intl.DebStcLim107_CA DDRCObsvr_Intl.DebStcLim108_CA DDRCObsvr_Intl.DebStcLim109_CA DDRCObsvr_Intl.DebStcLim110_CA DDRCObsvr_Intl.DebStcLim111_CA DDRCObsvr_Intl.DebStcLim112_CA DDRCObsvr_Intl.DebStcLim113_CA DDRCObsvr_Intl.DebStcLim114_CA DDRCObsvr_Intl.DebStcLim115_CA DDRCObsvr_Intl.DebStcLim116_CA DDRCObsvr_Intl.DebStcLim117_CA DDRCObsvr_Intl.DebStcLim118_CA DDRCObsvr_Intl.DebStcLim119_CA DDRCObsvr_Intl.DebStcLim120_CA DDRCObsvr_Intl.DebStcLim121_CA DDRCObsvr_Intl.DebStcLim122_CA DDRCObsvr_Intl.DebStcLim123_CA DDRCObsvr_Intl.DebStcLim124_CA DDRCObsvr_Intl.DebStcLim125_CA DDRCObsvr_Intl.DebStcLim126_CA DDRCObsvr_Intl.DebStcLim127_CA DDRCObsvr_Intl.DebStcLim128_CA DDRCObsvr_Intl.DebStcLim129_CA DDRCObsvr_Intl.DebStcLim130_CA DDRCObsvr_Intl.DebStcLim131_CA DDRCObsvr_Intl.DebStcLim132_CA DDRCObsvr_Intl.DebStcLim133_CA DDRCObsvr_Intl.DebStcLim134_CA DDRCObsvr_Intl.DebStcLim135_CA DDRCObsvr_Intl.DebStcLim136_CA DDRCObsvr_Intl.DebStcLim137_CA DDRCObsvr_Intl.DebStcLim138_CA DDRCObsvr_Intl.DebStcLim139_CA DDRCObsvr_Intl.DebStcLim140_CA DDRCObsvr_Intl.DebStcLim141_CA DDRCObsvr_Intl.DebStcLim142_CA DDRCObsvr_Intl.DebStcLim143_CA DDRCObsvr_Intl.DebStcLim144_CA DDRCObsvr_Intl.DebStcLim145_CA DDRCObsvr_Intl.DebStcLim146_CA DDRCObsvr_Intl.DebStcLim147_CA DDRCObsvr_Intl.DebStcLim148_CA DDRCObsvr_Intl.DebStcLim149_CA DDRCObsvr_Intl.DebStcLim150_CA DDRCObsvr_Intl.DebStcLim151_CA DDRCObsvr_Intl.DebStcLim152_CA DDRCObsvr_Intl.DebStcLim153_CA DDRCObsvr_Intl.DebStcLim154_CA DDRCObsvr_Intl.DebStcLim155_CA DDRCObsvr_Intl.DebStcLim156_CA DDRCObsvr_Intl.DebStcLim157_CA DDRCObsvr_Intl.DebStcLim158_CA DDRCObsvr_Intl.DebStcLim159_CA DDRCObsvr_Intl.DebStcLim160_CA DDRCObsvr_Intl.DebStcLim161_CA DDRCObsvr_Intl.DebStcLim162_CA DDRCObsvr_Intl.DebStcLim163_CA DDRCObsvr_Intl.DebStcLim164_CA DDRCObsvr_Intl.DebStcLim165_CA DDRCObsvr_Intl.DebStcLim166_CA DDRCObsvr_Intl.DebStcLim167_CA DDRCObsvr_Intl.DebStcLim168_CA DDRCObsvr_Intl.DebStcLim169_CA DDRCObsvr_Intl.DebStcLim170_CA DDRCObsvr_Intl.DebStcLim171_CA DDRCObsvr_Intl.DebStcLim172_CA DDRCObsvr_Intl.DebStcLim173_CA DDRCObsvr_Intl.DebStcLim174_CA DDRCObsvr_Intl.DebStcLim175_CA DDRCObsvr_Intl.DebStcLim176_CA DDRCObsvr_Intl.DebStcLim177_CA DDRCObsvr_Intl.DebStcLim178_CA DDRCObsvr_Intl.DebStcLim179_CA DDRCObsvr_Intl.DebStcLim180_CA DDRCObsvr_Intl.DebStcLim181_CA DDRCObsvr_Intl.DebStcLim182_CA DDRCObsvr_Intl.DebStcLim183_CA DDRCObsvr_Intl.DebStcLim184_CA DDRCObsvr_Intl.DebStcLim185_CA DDRCObsvr_Intl.DebStcLim186_CA DDRCObsvr_Intl.DebStcLim187_CA DDRCObsvr_Intl.DebStcLim188_CA DDRCObsvr_Intl.DebStcLim189_CA DDRCObsvr_Intl.DebStcLim190_CA DDRCObsvr_Intl.DebStcLim191_CA DDRCObsvr_Intl.DebStcLim192_CA DDRCObsvr_Intl.DebStcLim193_CA DDRCObsvr_Intl.DebStcLim194_CA DDRCObsvr_Intl.DebStcLim195_CA DDRCObsvr_Intl.DebStcLim196_CA DDRCObsvr_Intl.DebStcLim197_CA DDRCObsvr_Intl.DebStcLim198_CA DDRCObsvr_Intl.DebStcLim199_CA DDRCObsvr_Intl.DebStcLim200_CA DDRCObsvr_Intl.DebStcLim201_CA DDRCObsvr_Intl.DebStcLim202_CA DDRCObsvr_Intl.DebStcLim203_CA DDRCObsvr_Intl.DebStcLim204_CA DDRCObsvr_Intl.DebStcLim205_CA DDRCObsvr_Intl.DebStcLim206_CA DDRCObsvr_Intl.DebStcLim207_CA DDRCObsvr_Intl.DebStcLim208_CA DDRCObsvr_Intl.DebStcLim209_CA DDRCObsvr_Intl.DebStcLim210_CA DDRCObsvr_Intl.DebStcLim211_CA DDRCObsvr_Intl.DebStcLim212_CA DDRCObsvr_Intl.DebStcLim213_CA DDRCObsvr_Intl.DebStcLim214_CA DDRCObsvr_Intl.DebStcLim215_CA DDRCObsvr_Intl.DebStcLim216_CA DDRCObsvr_Intl.DebStcLim217_CA DDRCObsvr_Intl.DebStcLim218_CA DDRCObsvr_Intl.DebStcLim219_CA DDRCObsvr_Intl.DebStcLim220_CA DDRCObsvr_Intl.DebStcLim221_CA DDRCObsvr_Intl.DebStcLim222_CA DDRCObsvr_Intl.DebStcLim223_CA DDRCObsvr_Intl.DebStcLim224_CA DDRCObsvr_Intl.DebStcLim225_CA DDRCObsvr_Intl.DebStcLim226_CA DDRCObsvr_Intl.DebStcLim227_CA DDRCObsvr_Intl.DebStcLim228_CA DDRCObsvr_Intl.DebStcLim229_CA DDRCObsvr_Intl.DebStcLim230_CA DDRCObsvr_Intl.DebStcLim231_CA DDRCObsvr_Intl.DebStcLim232_CA DDRCObsvr_Intl.DebStcLim233_CA DDRCObsvr_Intl.DebStcLim234_CA DDRCObsvr_Intl.DebStcLim235_CA DDRCObsvr_Intl.DebStcLim236_CA DDRCObsvr_Intl.DebStcLim237_CA DDRCObsvr_Intl.DebStcLim238_CA DDRCObsvr_Intl.DebStcLim239_CA DDRCObsvr_Intl.DebStcLim240_CA DDRCObsvr_Intl.DebStcLim241_CA DDRCObsvr_Intl.DebStcLim242_CA DDRCObsvr_Intl.DebStcLim243_CA DDRCObsvr_Intl.DebStcLim244_CA DDRCObsvr_Intl.DebStcLim245_CA DDRCObsvr_Intl.DebStcLim246_CA DDRCObsvr_Intl.DebStcLim247_CA DDRCObsvr_Intl.DebStcLim248_CA DDRCObsvr_Intl.DebStcLim249_CA DDRCObsvr_Intl.DebStcLim250_CA DDRCObsvr_Intl.DebStcLim251_CA DDRCObsvr_Intl.DebStcLim252_CA DDRCObsvr_Intl.DebStcLim253_CA DDRCObsvr_Intl.DebStcLim254_CA DDRCObsvr_OvfThd_C DDRCObsvr_RstTrg_CA /end DEF_CHARACTERISTIC
 /begin LOC_MEASUREMENT DDRCObsvr_stUpdDi DDRCObsvr_Val.DebStcVal0 DDRCObsvr_Val.DebStcVal1 DDRCObsvr_Val.DebStcVal2 DDRCObsvr_Val.DebStcVal3 DDRCObsvr_Val.DebStcVal4 DDRCObsvr_Val.DebStcVal5 DDRCObsvr_Val.DebStcVal6 DDRCObsvr_Val.DebStcVal7 DDRCObsvr_Val.DebStcVal8 DDRCObsvr_Val.DebStcVal9 DDRCObsvr_Val.DebStcVal10 DDRCObsvr_Val.DebStcVal11 DDRCObsvr_Val.DebStcVal12 DDRCObsvr_Val.DebStcVal13 DDRCObsvr_Val.DebStcVal14 DDRCObsvr_Val.DebStcVal15 DDRCObsvr_Val.DebStcVal16 DDRCObsvr_Val.DebStcVal17 DDRCObsvr_Val.DebStcVal18 DDRCObsvr_Val.DebStcVal19 DDRCObsvr_Val.DebStcVal20 DDRCObsvr_Val.DebStcVal21 DDRCObsvr_Val.DebStcVal22 DDRCObsvr_Val.DebStcVal23 DDRCObsvr_Val.DebStcVal24 DDRCObsvr_Val.DebStcVal25 DDRCObsvr_Val.DebStcVal26 DDRCObsvr_Val.DebStcVal27 DDRCObsvr_Val.DebStcVal28 DDRCObsvr_Val.DebStcVal29 DDRCObsvr_Val.DebStcVal30 DDRCObsvr_Val.DebStcVal31 DDRCObsvr_Val.DebStcVal32 DDRCObsvr_Val.DebStcVal33 DDRCObsvr_Val.DebStcVal34 DDRCObsvr_Val.DebStcVal35 DDRCObsvr_Val.DebStcVal36 DDRCObsvr_Val.DebStcVal37 DDRCObsvr_Val.DebStcVal38 DDRCObsvr_Val.DebStcVal39 DDRCObsvr_Val.DebStcVal40 DDRCObsvr_Val.DebStcVal41 DDRCObsvr_Val.DebStcVal42 DDRCObsvr_Val.DebStcVal43 DDRCObsvr_Val.DebStcVal44 DDRCObsvr_Val.DebStcVal45 DDRCObsvr_Val.DebStcVal46 DDRCObsvr_Val.DebStcVal47 DDRCObsvr_Val.DebStcVal48 DDRCObsvr_Val.DebStcVal49 DDRCObsvr_Val.DebStcVal50 DDRCObsvr_Val.DebStcVal51 DDRCObsvr_Val.DebStcVal52 DDRCObsvr_Val.DebStcVal53 DDRCObsvr_Val.DebStcVal54 DDRCObsvr_Val.DebStcVal55 DDRCObsvr_Val.DebStcVal56 DDRCObsvr_Val.DebStcVal57 DDRCObsvr_Val.DebStcVal58 DDRCObsvr_Val.DebStcVal59 DDRCObsvr_Val.DebStcVal60 DDRCObsvr_Val.DebStcVal61 DDRCObsvr_Val.DebStcVal62 DDRCObsvr_Val.DebStcVal63 DDRCObsvr_Val.DebStcVal64 DDRCObsvr_Val.DebStcVal65 DDRCObsvr_Val.DebStcVal66 DDRCObsvr_Val.DebStcVal67 DDRCObsvr_Val.DebStcVal68 DDRCObsvr_Val.DebStcVal69 DDRCObsvr_Val.DebStcVal70 DDRCObsvr_Val.DebStcVal71 DDRCObsvr_Val.DebStcVal72 DDRCObsvr_Val.DebStcVal73 DDRCObsvr_Val.DebStcVal74 DDRCObsvr_Val.DebStcVal75 DDRCObsvr_Val.DebStcVal76 DDRCObsvr_Val.DebStcVal77 DDRCObsvr_Val.DebStcVal78 DDRCObsvr_Val.DebStcVal79 DDRCObsvr_Val.DebStcVal80 DDRCObsvr_Val.DebStcVal81 DDRCObsvr_Val.DebStcVal82 DDRCObsvr_Val.DebStcVal83 DDRCObsvr_Val.DebStcVal84 DDRCObsvr_Val.DebStcVal85 DDRCObsvr_Val.DebStcVal86 DDRCObsvr_Val.DebStcVal87 DDRCObsvr_Val.DebStcVal88 DDRCObsvr_Val.DebStcVal89 DDRCObsvr_Val.DebStcVal90 DDRCObsvr_Val.DebStcVal91 DDRCObsvr_Val.DebStcVal92 DDRCObsvr_Val.DebStcVal93 DDRCObsvr_Val.DebStcVal94 DDRCObsvr_Val.DebStcVal95 DDRCObsvr_Val.DebStcVal96 DDRCObsvr_Val.DebStcVal97 DDRCObsvr_Val.DebStcVal98 DDRCObsvr_Val.DebStcVal99 DDRCObsvr_Val.DebStcVal100 DDRCObsvr_Val.DebStcVal101 DDRCObsvr_Val.DebStcVal102 DDRCObsvr_Val.DebStcVal103 DDRCObsvr_Val.DebStcVal104 DDRCObsvr_Val.DebStcVal105 DDRCObsvr_Val.DebStcVal106 DDRCObsvr_Val.DebStcVal107 DDRCObsvr_Val.DebStcVal108 DDRCObsvr_Val.DebStcVal109 DDRCObsvr_Val.DebStcVal110 DDRCObsvr_Val.DebStcVal111 DDRCObsvr_Val.DebStcVal112 DDRCObsvr_Val.DebStcVal113 DDRCObsvr_Val.DebStcVal114 DDRCObsvr_Val.DebStcVal115 DDRCObsvr_Val.DebStcVal116 DDRCObsvr_Val.DebStcVal117 DDRCObsvr_Val.DebStcVal118 DDRCObsvr_Val.DebStcVal119 DDRCObsvr_Val.DebStcVal120 DDRCObsvr_Val.DebStcVal121 DDRCObsvr_Val.DebStcVal122 DDRCObsvr_Val.DebStcVal123 DDRCObsvr_Val.DebStcVal124 DDRCObsvr_Val.DebStcVal125 DDRCObsvr_Val.DebStcVal126 DDRCObsvr_Val.DebStcVal127 DDRCObsvr_Val.DebStcVal128 DDRCObsvr_Val.DebStcVal129 DDRCObsvr_Val.DebStcVal130 DDRCObsvr_Val.DebStcVal131 DDRCObsvr_Val.DebStcVal132 DDRCObsvr_Val.DebStcVal133 DDRCObsvr_Val.DebStcVal134 DDRCObsvr_Val.DebStcVal135 DDRCObsvr_Val.DebStcVal136 DDRCObsvr_Val.DebStcVal137 DDRCObsvr_Val.DebStcVal138 DDRCObsvr_Val.DebStcVal139 DDRCObsvr_Val.DebStcVal140 DDRCObsvr_Val.DebStcVal141 DDRCObsvr_Val.DebStcVal142 DDRCObsvr_Val.DebStcVal143 DDRCObsvr_Val.DebStcVal144 DDRCObsvr_Val.DebStcVal145 DDRCObsvr_Val.DebStcVal146 DDRCObsvr_Val.DebStcVal147 DDRCObsvr_Val.DebStcVal148 DDRCObsvr_Val.DebStcVal149 DDRCObsvr_Val.DebStcVal150 DDRCObsvr_Val.DebStcVal151 DDRCObsvr_Val.DebStcVal152 DDRCObsvr_Val.DebStcVal153 DDRCObsvr_Val.DebStcVal154 DDRCObsvr_Val.DebStcVal155 DDRCObsvr_Val.DebStcVal156 DDRCObsvr_Val.DebStcVal157 DDRCObsvr_Val.DebStcVal158 DDRCObsvr_Val.DebStcVal159 DDRCObsvr_Val.DebStcVal160 DDRCObsvr_Val.DebStcVal161 DDRCObsvr_Val.DebStcVal162 DDRCObsvr_Val.DebStcVal163 DDRCObsvr_Val.DebStcVal164 DDRCObsvr_Val.DebStcVal165 DDRCObsvr_Val.DebStcVal166 DDRCObsvr_Val.DebStcVal167 DDRCObsvr_Val.DebStcVal168 DDRCObsvr_Val.DebStcVal169 DDRCObsvr_Val.DebStcVal170 DDRCObsvr_Val.DebStcVal171 DDRCObsvr_Val.DebStcVal172 DDRCObsvr_Val.DebStcVal173 DDRCObsvr_Val.DebStcVal174 DDRCObsvr_Val.DebStcVal175 DDRCObsvr_Val.DebStcVal176 DDRCObsvr_Val.DebStcVal177 DDRCObsvr_Val.DebStcVal178 DDRCObsvr_Val.DebStcVal179 DDRCObsvr_Val.DebStcVal180 DDRCObsvr_Val.DebStcVal181 DDRCObsvr_Val.DebStcVal182 DDRCObsvr_Val.DebStcVal183 DDRCObsvr_Val.DebStcVal184 DDRCObsvr_Val.DebStcVal185 DDRCObsvr_Val.DebStcVal186 DDRCObsvr_Val.DebStcVal187 DDRCObsvr_Val.DebStcVal188 DDRCObsvr_Val.DebStcVal189 DDRCObsvr_Val.DebStcVal190 DDRCObsvr_Val.DebStcVal191 DDRCObsvr_Val.DebStcVal192 DDRCObsvr_Val.DebStcVal193 DDRCObsvr_Val.DebStcVal194 DDRCObsvr_Val.DebStcVal195 DDRCObsvr_Val.DebStcVal196 DDRCObsvr_Val.DebStcVal197 DDRCObsvr_Val.DebStcVal198 DDRCObsvr_Val.DebStcVal199 DDRCObsvr_Val.DebStcVal200 DDRCObsvr_Val.DebStcVal201 DDRCObsvr_Val.DebStcVal202 DDRCObsvr_Val.DebStcVal203 DDRCObsvr_Val.DebStcVal204 DDRCObsvr_Val.DebStcVal205 DDRCObsvr_Val.DebStcVal206 DDRCObsvr_Val.DebStcVal207 DDRCObsvr_Val.DebStcVal208 DDRCObsvr_Val.DebStcVal209 DDRCObsvr_Val.DebStcVal210 DDRCObsvr_Val.DebStcVal211 DDRCObsvr_Val.DebStcVal212 DDRCObsvr_Val.DebStcVal213 DDRCObsvr_Val.DebStcVal214 DDRCObsvr_Val.DebStcVal215 DDRCObsvr_Val.DebStcVal216 DDRCObsvr_Val.DebStcVal217 DDRCObsvr_Val.DebStcVal218 DDRCObsvr_Val.DebStcVal219 DDRCObsvr_Val.DebStcVal220 DDRCObsvr_Val.DebStcVal221 DDRCObsvr_Val.DebStcVal222 DDRCObsvr_Val.DebStcVal223 DDRCObsvr_Val.DebStcVal224 DDRCObsvr_Val.DebStcVal225 DDRCObsvr_Val.DebStcVal226 DDRCObsvr_Val.DebStcVal227 DDRCObsvr_Val.DebStcVal228 DDRCObsvr_Val.DebStcVal229 DDRCObsvr_Val.DebStcVal230 DDRCObsvr_Val.DebStcVal231 DDRCObsvr_Val.DebStcVal232 DDRCObsvr_Val.DebStcVal233 DDRCObsvr_Val.DebStcVal234 DDRCObsvr_Val.DebStcVal235 DDRCObsvr_Val.DebStcVal236 DDRCObsvr_Val.DebStcVal237 DDRCObsvr_Val.DebStcVal238 DDRCObsvr_Val.DebStcVal239 DDRCObsvr_Val.DebStcVal240 DDRCObsvr_Val.DebStcVal241 DDRCObsvr_Val.DebStcVal242 DDRCObsvr_Val.DebStcVal243 DDRCObsvr_Val.DebStcVal244 DDRCObsvr_Val.DebStcVal245 DDRCObsvr_Val.DebStcVal246 DDRCObsvr_Val.DebStcVal247 DDRCObsvr_Val.DebStcVal248 DDRCObsvr_Val.DebStcVal249 DDRCObsvr_Val.DebStcVal250 DDRCObsvr_Val.DebStcVal251 DDRCObsvr_Val.DebStcVal252 DDRCObsvr_Val.DebStcVal253 DDRCObsvr_Val.DebStcVal254 /end LOC_MEASUREMENT
 FUNCTION_VERSION "30164.0.0" /end FUNCTION
/begin FUNCTION DDRC_DemDeb ""
 /begin DEF_CHARACTERISTIC DDRC_DebArCtrBase.MyCtrBasedClass_2.isJmpDwnActv_C DDRC_DebArCtrBase.MyCtrBasedClass_2.isJmpUpActv_C DDRC_DebArCtrBase.MyCtrBasedClass_2.limPassd_C DDRC_DebArCtrBase.MyCtrBasedClass_2.limFaild_C DDRC_DebArCtrBase.MyCtrBasedClass_2.jmpUpVal_C DDRC_DebArCtrBase.MyCtrBasedClass_2.jmpDwnVal_C DDRC_DebArCtrBase.MyCtrBasedClass_2.stepUp_C DDRC_DebArCtrBase.MyCtrBasedClass_2.stepDwn_C DDRC_DebArCtrBase.MyCtrBasedClass_1.isJmpDwnActv_C DDRC_DebArCtrBase.MyCtrBasedClass_1.isJmpUpActv_C DDRC_DebArCtrBase.MyCtrBasedClass_1.limPassd_C DDRC_DebArCtrBase.MyCtrBasedClass_1.limFaild_C DDRC_DebArCtrBase.MyCtrBasedClass_1.jmpUpVal_C DDRC_DebArCtrBase.MyCtrBasedClass_1.jmpDwnVal_C DDRC_DebArCtrBase.MyCtrBasedClass_1.stepUp_C DDRC_DebArCtrBase.MyCtrBasedClass_1.stepDwn_C DDRC_DebArCtrBase.DemDebounceCounterBasedClass_standard.isJmpDwnActv_C DDRC_DebArCtrBase.DemDebounceCounterBasedClass_standard.isJmpUpActv_C DDRC_DebArCtrBase.DemDebounceCounterBasedClass_standard.limPassd_C DDRC_DebArCtrBase.DemDebounceCounterBasedClass_standard.limFaild_C DDRC_DebArCtrBase.DemDebounceCounterBasedClass_standard.jmpUpVal_C DDRC_DebArCtrBase.DemDebounceCounterBasedClass_standard.jmpDwnVal_C DDRC_DebArCtrBase.DemDebounceCounterBasedClass_standard.stepUp_C DDRC_DebArCtrBase.DemDebounceCounterBasedClass_standard.stepDwn_C DDRC_DebArTime.DFC_BusDiagCANAPPLBusOff.tiLimFaild_C DDRC_DebArTime.DFC_BusDiagCANAPPLBusOff.tiLimPassd_C DDRC_DebArTime.DFC_BusDiagCANCANCBusOff.tiLimFaild_C DDRC_DebArTime.DFC_BusDiagCANCANCBusOff.tiLimPassd_C DDRC_DebArTime.DFC_BusDiagCANVEHICLEBusOff.tiLimFaild_C DDRC_DebArTime.DFC_BusDiagCANVEHICLEBusOff.tiLimPassd_C DDRC_DebArTime.DFC_RBA_IODIAGPWR_rba_IoExtCy329_SignalVltSply_0.tiLimFaild_C DDRC_DebArTime.DFC_RBA_IODIAGPWR_rba_IoExtCy329_SignalVltSply_0.tiLimPassd_C DDRC_DebArTime.DFC_RBA_IODIAGPWR_rba_IoExtCy329_SignalVltSply_0OT.tiLimFaild_C DDRC_DebArTime.DFC_RBA_IODIAGPWR_rba_IoExtCy329_SignalVltSply_0OT.tiLimPassd_C DDRC_DebArTime.DFC_RBA_IODIAGPWR_rba_IoExtCy329_SignalVltSply_0OV.tiLimFaild_C DDRC_DebArTime.DFC_RBA_IODIAGPWR_rba_IoExtCy329_SignalVltSply_0OV.tiLimPassd_C DDRC_DebArTime.DFC_RBA_IODIAGPWR_rba_IoExtCy329_SignalVltSply_0SCG.tiLimFaild_C DDRC_DebArTime.DFC_RBA_IODIAGPWR_rba_IoExtCy329_SignalVltSply_0SCG.tiLimPassd_C DDRC_DebArTime.DFC_RBA_IODIAGPWR_rba_IoExtCy329_SignalVltSply_0UV.tiLimFaild_C DDRC_DebArTime.DFC_RBA_IODIAGPWR_rba_IoExtCy329_SignalVltSply_0UV.tiLimPassd_C DDRC_DebArTime.DFC_RBA_IODIAGPWR_rba_IoExtCy329_SignalVltSply_1.tiLimFaild_C DDRC_DebArTime.DFC_RBA_IODIAGPWR_rba_IoExtCy329_SignalVltSply_1.tiLimPassd_C DDRC_DebArTime.DFC_RBA_IODIAGPWR_rba_IoExtCy329_SignalVltSply_1OT.tiLimFaild_C DDRC_DebArTime.DFC_RBA_IODIAGPWR_rba_IoExtCy329_SignalVltSply_1OT.tiLimPassd_C DDRC_DebArTime.DFC_RBA_IODIAGPWR_rba_IoExtCy329_SignalVltSply_1OV.tiLimFaild_C DDRC_DebArTime.DFC_RBA_IODIAGPWR_rba_IoExtCy329_SignalVltSply_1OV.tiLimPassd_C DDRC_DebArTime.DFC_RBA_IODIAGPWR_rba_IoExtCy329_SignalVltSply_1SCG.tiLimFaild_C DDRC_DebArTime.DFC_RBA_IODIAGPWR_rba_IoExtCy329_SignalVltSply_1SCG.tiLimPassd_C DDRC_DebArTime.DFC_RBA_IODIAGPWR_rba_IoExtCy329_SignalVltSply_1UV.tiLimFaild_C DDRC_DebArTime.DFC_RBA_IODIAGPWR_rba_IoExtCy329_SignalVltSply_1UV.tiLimPassd_C DDRC_DebArTime.DFC_RBA_IODIAGPWR_rba_IoExtCy329_SignalVltSply_2.tiLimFaild_C DDRC_DebArTime.DFC_RBA_IODIAGPWR_rba_IoExtCy329_SignalVltSply_2.tiLimPassd_C DDRC_DebArTime.DFC_RBA_IODIAGPWR_rba_IoExtCy329_SignalVltSply_2OT.tiLimFaild_C DDRC_DebArTime.DFC_RBA_IODIAGPWR_rba_IoExtCy329_SignalVltSply_2OT.tiLimPassd_C DDRC_DebArTime.DFC_RBA_IODIAGPWR_rba_IoExtCy329_SignalVltSply_2OV.tiLimFaild_C DDRC_DebArTime.DFC_RBA_IODIAGPWR_rba_IoExtCy329_SignalVltSply_2OV.tiLimPassd_C DDRC_DebArTime.DFC_RBA_IODIAGPWR_rba_IoExtCy329_SignalVltSply_2SCG.tiLimFaild_C DDRC_DebArTime.DFC_RBA_IODIAGPWR_rba_IoExtCy329_SignalVltSply_2SCG.tiLimPassd_C DDRC_DebArTime.DFC_RBA_IODIAGPWR_rba_IoExtCy329_SignalVltSply_2UV.tiLimFaild_C DDRC_DebArTime.DFC_RBA_IODIAGPWR_rba_IoExtCy329_SignalVltSply_2UV.tiLimPassd_C /end DEF_CHARACTERISTIC
 /begin LOC_MEASUREMENT DDRC_ctArDebLvl.DFC_BusDiagCANAPPLBusOff DDRC_ctArDebLvl.DFC_BusDiagCANCANCBusOff DDRC_ctArDebLvl.DFC_BusDiagCANVEHICLEBusOff DDRC_ctArDebLvl.DFC_RBA_IODIAGPWR_rba_IoExtCy329_SignalVltSply_0 DDRC_ctArDebLvl.DFC_RBA_IODIAGPWR_rba_IoExtCy329_SignalVltSply_0OT DDRC_ctArDebLvl.DFC_RBA_IODIAGPWR_rba_IoExtCy329_SignalVltSply_0OV DDRC_ctArDebLvl.DFC_RBA_IODIAGPWR_rba_IoExtCy329_SignalVltSply_0SCG DDRC_ctArDebLvl.DFC_RBA_IODIAGPWR_rba_IoExtCy329_SignalVltSply_0UV DDRC_ctArDebLvl.DFC_RBA_IODIAGPWR_rba_IoExtCy329_SignalVltSply_1 DDRC_ctArDebLvl.DFC_RBA_IODIAGPWR_rba_IoExtCy329_SignalVltSply_1OT DDRC_ctArDebLvl.DFC_RBA_IODIAGPWR_rba_IoExtCy329_SignalVltSply_1OV DDRC_ctArDebLvl.DFC_RBA_IODIAGPWR_rba_IoExtCy329_SignalVltSply_1SCG DDRC_ctArDebLvl.DFC_RBA_IODIAGPWR_rba_IoExtCy329_SignalVltSply_1UV DDRC_ctArDebLvl.DFC_RBA_IODIAGPWR_rba_IoExtCy329_SignalVltSply_2 DDRC_ctArDebLvl.DFC_RBA_IODIAGPWR_rba_IoExtCy329_SignalVltSply_2OT DDRC_ctArDebLvl.DFC_RBA_IODIAGPWR_rba_IoExtCy329_SignalVltSply_2OV DDRC_ctArDebLvl.DFC_RBA_IODIAGPWR_rba_IoExtCy329_SignalVltSply_2SCG DDRC_ctArDebLvl.DFC_RBA_IODIAGPWR_rba_IoExtCy329_SignalVltSply_2UV DDRC_ctArDebLvl.DFC_CAN_E_TIMEOUT DDRC_ctArDebLvl.DFC_LIN_E_TIMEOUT DDRC_ctArDebLvl.DFC_MRlyOL DDRC_ctArDebLvl.DFC_MRlySCB DDRC_ctArDebLvl.DFC_MRlySCG DDRC_ctArDebLvl.DFC_rba_MultiStackTrace_Threshold DDRC_stLstRprtEve.DFC_BusDiagCANAPPLBusOff DDRC_stLstRprtEve.DFC_BusDiagCANCANCBusOff DDRC_stLstRprtEve.DFC_BusDiagCANVEHICLEBusOff DDRC_stLstRprtEve.DFC_RBA_IODIAGPWR_rba_IoExtCy329_SignalVltSply_0 DDRC_stLstRprtEve.DFC_RBA_IODIAGPWR_rba_IoExtCy329_SignalVltSply_0OT DDRC_stLstRprtEve.DFC_RBA_IODIAGPWR_rba_IoExtCy329_SignalVltSply_0OV DDRC_stLstRprtEve.DFC_RBA_IODIAGPWR_rba_IoExtCy329_SignalVltSply_0SCG DDRC_stLstRprtEve.DFC_RBA_IODIAGPWR_rba_IoExtCy329_SignalVltSply_0UV DDRC_stLstRprtEve.DFC_RBA_IODIAGPWR_rba_IoExtCy329_SignalVltSply_1 DDRC_stLstRprtEve.DFC_RBA_IODIAGPWR_rba_IoExtCy329_SignalVltSply_1OT DDRC_stLstRprtEve.DFC_RBA_IODIAGPWR_rba_IoExtCy329_SignalVltSply_1OV DDRC_stLstRprtEve.DFC_RBA_IODIAGPWR_rba_IoExtCy329_SignalVltSply_1SCG DDRC_stLstRprtEve.DFC_RBA_IODIAGPWR_rba_IoExtCy329_SignalVltSply_1UV DDRC_stLstRprtEve.DFC_RBA_IODIAGPWR_rba_IoExtCy329_SignalVltSply_2 DDRC_stLstRprtEve.DFC_RBA_IODIAGPWR_rba_IoExtCy329_SignalVltSply_2OT DDRC_stLstRprtEve.DFC_RBA_IODIAGPWR_rba_IoExtCy329_SignalVltSply_2OV DDRC_stLstRprtEve.DFC_RBA_IODIAGPWR_rba_IoExtCy329_SignalVltSply_2SCG DDRC_stLstRprtEve.DFC_RBA_IODIAGPWR_rba_IoExtCy329_SignalVltSply_2UV DDRC_stLstRprtEve.DFC_CAN_E_TIMEOUT DDRC_stLstRprtEve.DFC_LIN_E_TIMEOUT DDRC_stLstRprtEve.DFC_MRlyOL DDRC_stLstRprtEve.DFC_MRlySCB DDRC_stLstRprtEve.DFC_MRlySCG DDRC_stLstRprtEve.DFC_rba_MultiStackTrace_Threshold /end LOC_MEASUREMENT
/end FUNCTION
/begin FUNCTION DDSKV "51.22.0   Diagnosis; high pressure sensor"
 /begin DEF_CHARACTERISTIC CWDSKVR CWDSKVR1 DDSKVFRAMN DDSKVFRAMX DDSKVORAMN DDSKVORAMX DSKVTABST DTMSTANSO DTMSTTUMO DTMSTTUMU DTUMTANSU FuPHi_pAftPreDrvMin_C FuPHi_pNegOffsSuspcThd_C FuPHi_pPosOffsAftPreRunThd_C FuPHi_pPosOffsSuspcThd_C FuPHi_pRngChkMaxExtd_T FuPHi_pRngChkMin_C FuPHi_pSpstPhdMin_C KLTDDSNO TATMDIFF TDEKPON TDEKPPRE TMABSDSO TMMXREQ TMSTSDSO TMTADIFF TNSEDDSKV TSTENDDSNO TVDDSKV TVDDSKVEO TVDDSKVSEO TVDSKVRH TVDSKVRHL TVPRMNPL /end DEF_CHARACTERISTIC
 /begin IN_MEASUREMENT B_ebfmod_msg B_enbhtr_msg B_nbhtr_msg B_nibhtr_msg B_prrohrg_msg B_tmsrt_msg CEngDsT_t CEngDsT_tStop CEngDsT_tStrt Eep_EnvRamHist Eep_EnvRamInvld EngStrt_bFrstStrtEnd EnvT_t EpmCrS_stSigMode Epm_nEngLRes Epm_stSpd fra_w_msg FuPHi_pRawRel ora_w_msg PSP_st SyC_stSub SyC_stSubOld SyC_tiDrv tans_msg TiEngOff_stTi TiEngOff_ti tnse_w_msg /end IN_MEASUREMENT
 /begin OUT_MEASUREMENT B_dskvcosk_msg B_dskvepo_msg B_dskvnng_msg B_dskvnno_msg B_dskvnpo_msg B_dskvsepo_msg B_dskvsig_msg B_dskvsno_msg B_dskvspoi_msg B_dskvspo_msg B_dskvtank_msg B_nmotno_msg B_plprroh_msg B_reqddskv_msg FuPHi_flgEnaStoreLoP_msg FuPHi_pRawRelInit /end OUT_MEASUREMENT
 /begin LOC_MEASUREMENT B_bhdtf B_coskneg B_coskretr B_dskvekpv B_dskveno B_dskvnpl B_dskvpwf B_ekpvlpre B_initpr B_prcproh B_prini B_propre B_proten B_prpre B_tiekold FuPHi_flgDSMClrDSKVRNpl10ms FuPHi_flgDSMClrDSKVRNpl50ms FuPHi_flgDSMClrDSKVRSig10ms FuPHi_flgDSMClrDSKVRSig50ms FuPHi_stDetSleep pnekp_w prnekpvl_w prprekp_w prpre_w prvekpvl_w tiekpold tiekp_w /end LOC_MEASUREMENT
 FUNCTION_VERSION "51.22.0" /end FUNCTION
/begin FUNCTION DECJ "100.4.0   standard powerstage diagnosis enabling" /begin DEF_CHARACTERISTIC NDECJ UBCJMN UBCJMX /end DEF_CHARACTERISTIC /begin IN_MEASUREMENT BattU_u Epm_nEngLRes SyC_stSub /end IN_MEASUREMENT /begin OUT_MEASUREMENT B_deseehr_msg B_desee_msg B_PmdInit_msg /end OUT_MEASUREMENT FUNCTION_VERSION "100.4.0" /end FUNCTION
/begin FUNCTION DELib "1.67.0_1.7.0Library Device Encapsulation" FUNCTION_VERSION "1.67.0_1.7.0" /end FUNCTION
/begin FUNCTION DELib_ActrCoorrSimple "1.4.0     Simple Coordinator Layer for Actuators" FUNCTION_VERSION "1.4.0" /end FUNCTION
/begin FUNCTION DELib_ActrElecDrvrSimple "1.5.0     Simple Electrical Driver Layer for Actuators" FUNCTION_VERSION "1.5.0" /end FUNCTION
/begin FUNCTION DELib_ActrElecMonSimple "1.5.0     Simple Electrical Monitoring Layer for Actuators" FUNCTION_VERSION "1.5.0" /end FUNCTION
/begin FUNCTION DELib_ActrHldILimnSimple "1.4.0     Simple Holding Current Limitation for Actuators" FUNCTION_VERSION "1.4.0" /end FUNCTION
/begin FUNCTION DELib_ActrPsDrvrSimple "1.6.0     Simple Power Stage Driver for Actuators" FUNCTION_VERSION "1.6.0" /end FUNCTION
/begin FUNCTION DELib_ActrPwrStgDrvr "3.0.0     Actuator power stage driver" FUNCTION_VERSION "3.0.0" /end FUNCTION
/begin FUNCTION DELib_ActrRCalcn "2.2.0     Electrical resistance calculation of coils" FUNCTION_VERSION "2.2.0" /end FUNCTION
/begin FUNCTION DELib_ActvnDeactvnCdn "2.0.0     Activation and Deactivation Conditions" FUNCTION_VERSION "2.0.0" /end FUNCTION
/begin COMPU_METHOD B_TRUE "" TAB_VERB "%6.3" "" COMPU_TAB_REF B_TRUE /end COMPU_METHOD
/begin COMPU_VTAB B_TRUE "" TAB_VERB 2 0 "FALSE" 1 "TRUE" /end COMPU_VTAB
/begin COMPU_METHOD DDRCObsvr_DebDFCVerb "" TAB_VERB "%6.3" "NO" COMPU_TAB_REF DDRCObsvr_DebDFCVerb /end COMPU_METHOD
/begin COMPU_VTAB DDRCObsvr_DebDFCVerb "" TAB_VERB 407 0 "DFC_Unused" 1 "DFC_AAVEmax" 2 "DFC_AAVEmin" 3 "DFC_AAVEsig" 379 "DFC_ACEvpTPhysRngHi" 380 "DFC_ACEvpTPhysRngLo" 381 "DFC_ACEvpTSRCMax" 382 "DFC_ACEvpTSRCMin" 288 "DFC_AfsPhyRngHiB1" 289 "DFC_AfsPhyRngLoB1" 383 "DFC_AfsRawSigRngHiB1" 384 "DFC_AfsRawSigRngLoB1" 415 "DFC_AfsSigErrLineHiB1" 416 "DFC_AfsSigErrLineLoB1" 385 "DFC_AfsSnsrErrB1" 386 "DFC_AirCClntPAnaSRCMax" 387 "DFC_AirCClntPAnaSRCMin" 290 "DFC_AirCCmprOL" 291 "DFC_AirCCmprOvrTemp" 292 "DFC_AirCCmprSCB" 293 "DFC_AirCCmprSCG" 388 "DFC_AirCSwtNpl" 389 "DFC_AirCSwtSig" 294 "DFC_AltErr" 4 "DFC_AltIOACGFailr" 5 "DFC_AltIOACGHiVltg" 6 "DFC_AltIOACGLoVltg" 7 "DFC_AltIOACGTHi" 8 "DFC_AltIODConnACG" 10 "DFC_BattUHiFailr" 11 "DFC_BattULoFailr" 295 "DFC_BattUSRCMax" 296 "DFC_BattUSRCMin" 9 "DFC_BGOELWAF" 390 "DFC_Brk" 12 "DFC_BrkBstPDriftHiErr" 13 "DFC_BrkBstPDriftLoErr" 14 "DFC_BrkBstPSnsrStuck" 391 "DFC_BrkBstSensSCB" 392 "DFC_BrkBstSensSCG" 15 "DFC_BrkMnSwtContOn" 16 "DFC_BrkMnSwtNotStp" 17 "DFC_BrkNpl" 18 "DFC_BrkRdntSwtContOn" 19 "DFC_BrkRdntSwtNotStp" 393 "DFC_BrkSig" 20 "DFC_Clth3ONStuck" 21 "DFC_Clth4OFFStuck" 260 "DFC_ClthMax" 412 "DFC_ClthNpl" 22 "DFC_ClthOFFStuck" 23 "DFC_ClthONStuck" 394 "DFC_ClthSig" 24 "DFC_ClthStkFailInfo" 25 "DFC_ComACFailInfo" 26 "DFC_ComATFTValErr" 27 "DFC_ComATMILReq" 28 "DFC_ComAYCAChksum" 29 "DFC_ComAYCARingCnt" 30 "DFC_ComAYCATOut" 31 "DFC_ComAYCDChkSum" 32 "DFC_ComAYCDTOut" 33 "DFC_ComAYCFChksum" 34 "DFC_ComAYCFRingCnt" 35 "DFC_ComAYCFTOut" 36 "DFC_ComAYCGChksum" 37 "DFC_ComAYCGRingCnt" 38 "DFC_ComAYCGTOut" 39 "DFC_ComAYCIChkSum" 40 "DFC_ComAYCIRingCnt" 41 "DFC_ComAYCITOut" 42 "DFC_ComBCM1ChkSum" 43 "DFC_ComBCM1RingCnt" 44 "DFC_ComBCM1TOut" 45 "DFC_ComCANABusOffErr" 46 "DFC_ComCANBBusOffErr" 47 "DFC_ComCANCBusOffErr" 48 "DFC_ComCGW1ChkSum" 49 "DFC_ComCGW1RingCnt" 50 "DFC_ComCGW1TOut" 297 "DFC_ComChksTCU1" 298 "DFC_ComChksTCU11" 299 "DFC_ComChksTCU12" 300 "DFC_ComChksTCU13" 301 "DFC_ComChksTCU2" 302 "DFC_ComChksTCU3" 303 "DFC_ComChksTCU4" 304 "DFC_ComCntTCU1" 305 "DFC_ComCntTCU11" 306 "DFC_ComCntTCU12" 307 "DFC_ComCntTCU13" 308 "DFC_ComCntTCU2" 309 "DFC_ComCntTCU3" 310 "DFC_ComCntTCU4" 51 "DFC_ComConvBoostErr" 52 "DFC_ComConvSlipErr" 53 "DFC_ComDCDCPrfmncErr" 54 "DFC_ComDCDCTempWarn" 55 "DFC_ComEAT10Chksum" 56 "DFC_ComEAT10RingCnt" 57 "DFC_ComEAT10TOut" 58 "DFC_ComEAT11ChkSum" 59 "DFC_ComEAT11RingCnt" 60 "DFC_ComEAT11TOut" 61 "DFC_ComEAT12ChkSum" 62 "DFC_ComEAT12RingCnt" 63 "DFC_ComEAT12TOut" 64 "DFC_ComEAT13ChkSum" 65 "DFC_ComEAT13RingCnt" 66 "DFC_ComEAT13TOut" 67 "DFC_ComEAT1Chksum" 68 "DFC_ComEAT1RingCnt" 69 "DFC_ComEAT1TOut" 70 "DFC_ComEAT2ChkSum" 71 "DFC_ComEAT2RingCnt" 72 "DFC_ComEAT2TOut" 73 "DFC_ComEAT4ChkSum" 74 "DFC_ComEAT4RingCnt" 75 "DFC_ComEAT4TOut" 76 "DFC_ComEAT6Chksum" 77 "DFC_ComEAT6RingCnt" 78 "DFC_ComEAT6TOut" 79 "DFC_ComEAT7Chksum" 80 "DFC_ComEAT7RingCnt" 81 "DFC_ComEAT7TOut" 82 "DFC_ComEAT8Chksum" 83 "DFC_ComEAT8RingCnt" 84 "DFC_ComEAT8TOut" 85 "DFC_ComEATAChksum" 86 "DFC_ComEATARingCnt" 87 "DFC_ComEATATOut" 88 "DFC_ComEATBChkSum" 89 "DFC_ComEATBRingCnt" 90 "DFC_ComEATBTOut" 91 "DFC_ComEATCChksum" 92 "DFC_ComEATCRingCnt" 93 "DFC_ComEATCTOut" 103 "DFC_ComEngCanRxErr" 94 "DFC_ComEPBBChkSum" 95 "DFC_ComEPBBRingCnt" 96 "DFC_ComEPBBTOut" 97 "DFC_ComEPBChksum" 99 "DFC_ComEPBctRing" 98 "DFC_ComEPBTOut" 100 "DFC_ComEPS1Chksum" 101 "DFC_ComEPS1RingCnt" 102 "DFC_ComEPS1TOut" 104 "DFC_ComGrvySnsrErr" 105 "DFC_ComGwIMG1ChkSum" 106 "DFC_ComGwIMG1RingCnt" 107 "DFC_ComGwIMG1TOut" 108 "DFC_ComGwIMG3ChkSum" 109 "DFC_ComGwIMG3RingCnt" 110 "DFC_ComGwIMG3TOut" 111 "DFC_ComGwIMG4ChkSum" 112 "DFC_ComGwIMG4RingCnt" 113 "DFC_ComGwIMG4TOut" 114 "DFC_ComGwIMG5ChkSum" 115 "DFC_ComGwIMG5RingCnt" 116 "DFC_ComGwIMG5TOut" 117 "DFC_ComGwIMG6ChkSum" 118 "DFC_ComGwIMG6RingCnt" 119 "DFC_ComGwIMG6TOut" 120 "DFC_ComIDASBChksum" 121 "DFC_ComIDASBRingCnt" 122 "DFC_ComIDASBTOut" 123 "DFC_ComIMGMILReq" 124 "DFC_ComISSPrms" 125 "DFC_ComMETAChksum" 126 "DFC_ComMETAChksumPstDrv" 127 "DFC_ComMETARingCnt" 128 "DFC_ComMETARingCntPstDrv" 129 "DFC_ComMETATOut" 130 "DFC_ComMETATOutPstDrv" 131 "DFC_ComMETCChksum" 132 "DFC_ComMETCRingCnt" 133 "DFC_ComMETCTOut" 134 "DFC_ComMETDChksum" 135 "DFC_ComMETDRingCnt" 136 "DFC_ComMETDTOut" 137 "DFC_ComMETE2Chksum" 138 "DFC_ComMETE2RingCnt" 139 "DFC_ComMETE2TOut" 140 "DFC_ComMETFChksum" 141 "DFC_ComMETFRingCnt" 142 "DFC_ComMETFTOut" 143 "DFC_ComMETGChksum" 144 "DFC_ComMETGRingCnt" 145 "DFC_ComMETGTOut" 146 "DFC_ComMETH2Chksum" 147 "DFC_ComMETH2RingCnt" 148 "DFC_ComMETH2TOut" 149 "DFC_ComMETHChksum" 150 "DFC_ComMETHRingCnt" 151 "DFC_ComMETHTOut" 152 "DFC_ComMETIChksum" 153 "DFC_ComMETIRingCnt" 154 "DFC_ComMETITOut" 155 "DFC_ComMETKChksum" 156 "DFC_ComMETKRingCnt" 157 "DFC_ComMETKTOut" 158 "DFC_ComMETLChksum" 159 "DFC_ComMETLRingCnt" 160 "DFC_ComMETLTOut" 161 "DFC_ComMETMChksum" 162 "DFC_ComMETMRingCnt" 163 "DFC_ComMETMTOut" 164 "DFC_ComMETNChksum" 165 "DFC_ComMETNRingCnt" 166 "DFC_ComMETNTOut" 167 "DFC_ComMtrCom" 168 "DFC_ComPCUChkSum" 169 "DFC_ComPCURingCnt" 170 "DFC_ComPCUTOut" 171 "DFC_ComSRSAChksum" 172 "DFC_ComSRSARingCnt" 173 "DFC_ComSRSATOut" 174 "DFC_ComSRSBChksum" 175 "DFC_ComSRSBRingCnt" 176 "DFC_ComSRSBTOut" 177 "DFC_ComSRSChksum" 178 "DFC_ComSRSErr" 179 "DFC_ComSRSRingCnt" 180 "DFC_ComSRSTOut" 311 "DFC_ComTOutTCU01" 312 "DFC_ComTOutTCU02" 313 "DFC_ComTOutTCU1" 314 "DFC_ComTOutTCU11" 315 "DFC_ComTOutTCU12" 316 "DFC_ComTOutTCU13" 317 "DFC_ComTOutTCU14" 318 "DFC_ComTOutTCU2" 319 "DFC_ComTOutTCU3" 320 "DFC_ComTOutTCU4" 181 "DFC_ComVehSpdPndFltTCU" 321 "DFC_DevLibBattUHi" 322 "DFC_DevLibBattULo" 357 "DFC_DHFHD" 182 "DFC_EbsChartcCurrErr" 183 "DFC_EbsSelfDiagErr" 395 "DFC_EGRVlvCurrLim" 323 "DFC_EGRVlvFailSafeActv" 324 "DFC_EGRVlvGovDvtCld" 396 "DFC_EGRVlvOL" 397 "DFC_EGRVlvOvrTemp" 325 "DFC_EGRVlvPhysSRCMax" 326 "DFC_EGRVlvPhysSRCMin" 398 "DFC_EGRVlvSCB" 399 "DFC_EGRVlvSCG" 400 "DFC_EGRVlvSRCMax" 401 "DFC_EGRVlvSRCMin" 327 "DFC_FanDIOOL" 329 "DFC_FanDIOOvrTemp" 331 "DFC_FanDIOSCB" 333 "DFC_FanDIOSCG" 188 "DFC_GbxCANDigPlausErr" 189 "DFC_GbxNPos1SRCMax" 190 "DFC_GbxNPos1SRCMin" 191 "DFC_GbxNPos2SRCMax" 192 "DFC_GbxNPos2SRCMin" 193 "DFC_GbxNPosAlvChk" 194 "DFC_GbxNPosSyncErr" 413 "DFC_GbxPNPosnDrvCdn" 414 "DFC_GbxPNPosnPlausy" 184 "DFC_GEVlvPhaCsersIntkB1" 185 "DFC_GEVlvPhaPsOpenLoadIntkB1" 186 "DFC_GEVlvPhaPsShoToBattIntkB1" 187 "DFC_GEVlvPhaPsShoToGndIntkB1" 195 "DFC_HEGOS2B1HtrPsMax" 196 "DFC_HEGOS2B1HtrPsMin" 197 "DFC_HEGOS2B1HtrPsSig" 402 "DFC_HLSDemOvhtEngLim" 261 "DFC_IgnClPs_DevComErr" 262 "DFC_IgnClPs_LineOl" 266 "DFC_IgnClPs_LineScb" 270 "DFC_IgnClPs_LineScg" 358 "DFC_InjVlv_DI_DcDc" 359 "DFC_InjVlv_DI_NoLd" 363 "DFC_InjVlv_DI_ScBnk" 367 "DFC_InjVlv_DI_ScCyl" 371 "DFC_InjVlv_DI_ScHsLs" 428 "DFC_KnDetSens1PortAMax" 429 "DFC_KnDetSens1PortAMin" 430 "DFC_KnDetSens1PortBMax" 431 "DFC_KnDetSens1PortBMin" 274 "DFC_KRVEKOEVAB" 275 "DFC_KRVEKOEVAB0" 276 "DFC_KRVEKOEVAB1" 277 "DFC_KRVEKOEVAB2" 278 "DFC_KRVEKOEVAB3" 198 "DFC_LinCSErrACG" 199 "DFC_LinCSErrAEV" 200 "DFC_LinCSErrDCDC" 201 "DFC_LinCSErrEBS" 202 "DFC_LinHdrTimeoutErrACG" 203 "DFC_LinHdrTimeoutErrAEV" 204 "DFC_LinHdrTimeoutErrDCDC" 205 "DFC_LinHdrTimeoutErrEBS" 206 "DFC_LinMsgTimeoutErrACG" 207 "DFC_LinMsgTimeoutErrAEV" 208 "DFC_LinMsgTimeoutErrDCDC" 209 "DFC_LinMsgTimeoutErrEBS" 210 "DFC_LinNoStrtComErr" 211 "DFC_LowPresOilP" 375 "DFC_MfPsDiaOpenLoad1" 376 "DFC_MfPsDiaScHiS1" 377 "DFC_MfPsDiaScHiSLowS1" 378 "DFC_MfPsDiaScLowS1" 228 "DFC_MisfDetdVWhlFrntLePlaus" 229 "DFC_MisfDetdVWhlFrntRiPlaus" 230 "DFC_MisfDetdVWhlReLePlaus" 231 "DFC_MisfDetdVWhlReRiPlaus" 212 "DFC_MisfDetVWhlFrntLeOORHi" 213 "DFC_MisfDetVWhlFrntLeRatyHi" 214 "DFC_MisfDetVWhlFrntLeRatyLo" 215 "DFC_MisfDetVWhlFrntLeStuck" 216 "DFC_MisfDetVWhlFrntRiOORHi" 217 "DFC_MisfDetVWhlFrntRiRatyHi" 218 "DFC_MisfDetVWhlFrntRiRatyLo" 219 "DFC_MisfDetVWhlFrntRiStuck" 220 "DFC_MisfDetVWhlReLeOORHi" 221 "DFC_MisfDetVWhlReLeRatyHi" 222 "DFC_MisfDetVWhlReLeRatyLo" 223 "DFC_MisfDetVWhlReLeStuck" 224 "DFC_MisfDetVWhlReRiOORHi" 225 "DFC_MisfDetVWhlReRiRatyHi" 226 "DFC_MisfDetVWhlReRiRatyLo" 227 "DFC_MisfDetVWhlReRiStuck" 335 "DFC_MRlyDcOL" 336 "DFC_MRlyDcSCB" 337 "DFC_MRlyDcSCG" 403 "DFC_OilPSwmpSRCMax" 404 "DFC_OilPSwmpSRCMin" 417 "DFC_PEnvCcMax" 418 "DFC_PEnvCcMin" 419 "DFC_PEnvRngChkMax" 420 "DFC_PEnvRngChkMin" 232 "DFC_PEnvSigRngMax" 233 "DFC_PEnvSigRngMin" 421 "DFC_PEnvSnsrPlaus" 405 "DFC_PIntkVUsLineHiB1" 406 "DFC_PIntkVUsLineLoB1" 338 "DFC_PSPOL" 339 "DFC_PSPOvrTemp" 340 "DFC_PSPSCB" 341 "DFC_PSPSCG" 234 "DFC_StmFault" 236 "DFC_StrtCtlErr" 235 "DFC_StrtCtOffPth" 237 "DFC_StrtFault" 238 "DFC_StrtLckJudg1" 239 "DFC_StrtLckJudg2" 240 "DFC_StrtOL" 241 "DFC_StrtOL2" 242 "DFC_StrtSCB" 243 "DFC_StrtSCB2" 244 "DFC_StrtSCG" 245 "DFC_StrtSCG2" 246 "DFC_StrtStkRly1" 247 "DFC_StrtStkRly2" 342 "DFC_T50Err" 248 "DFC_TEVEmax" 249 "DFC_TEVEmin" 250 "DFC_TEVEsig" 343 "DFC_ThrVlvLoBattB1" 251 "DFC_UegoHeatrPrfmncLoS1B1" 422 "DFC_UEGOHeatrRlyPsOLS1B1" 423 "DFC_UEGOHeatrRlyPsSCBS1B1" 424 "DFC_UEGOHeatrRlyPsSCGS1B1" 425 "DFC_UegoHeatrWireOlS1B1" 426 "DFC_UegoHeatrWireScbS1B1" 427 "DFC_UegoHeatrWireScgS1B1" 279 "DFC_UegoSigEcuAsicS1B1" 280 "DFC_UegoSigEcuComS1B1" 344 "DFC_UegoSigOperPlausS1B1" 281 "DFC_UegoSigSnsrS1B1" 282 "DFC_UegoSigWireOlApesS1B1" 283 "DFC_UegoSigWireOlIpeS1B1" 284 "DFC_UegoSigWireOlReS1B1" 285 "DFC_UegoSigWireRCmpS1B1" 286 "DFC_UegoSigWireScbS1B1" 287 "DFC_UegoSigWireScgS1B1" 252 "DFC_VehVAllPlaus" 253 "DFC_VehVNCSnsrElecFailr" 345 "DFC_VehVPhysRngHi" 407 "DFC_VehVPhysRngLo" 254 "DFC_VehVPlausCan" 255 "DFC_VehVPlausFco" 256 "DFC_VehVPlausPwr" 257 "DFC_VehVPlausV2N" 346 "DFC_VehVSclOutOL" 347 "DFC_VehVSclOutOT" 348 "DFC_VehVSclOutSCB" 349 "DFC_VehVSclOutSCG" 408 "DFC_VehVSigCan" 409 "DFC_VehVSigCanSafe" 350 "DFC_VehVSigFL" 351 "DFC_VehVSigFR" 352 "DFC_VehVSigRL" 353 "DFC_VehVSigRR" 354 "DFC_VehVSnsrARngHi" 355 "DFC_VehVSnsrBRngHi" 356 "DFC_VehVSpdRtyDiag" 258 "DFC_VehVSpdSnsrAElecFailr" 259 "DFC_VehVSpdSnsrBElecFailr" 410 "DFC_VlvLftFbOilPSnsrIntk11SRCMax" 411 "DFC_VlvLftFbOilPSnsrIntk11SRCMin" DEFAULT_VALUE "---" /end COMPU_VTAB
/begin COMPU_METHOD DDRCObsvr_Prc_Half "" RAT_FUNC "%6.3" "%" COEFFS 0 2 0 0 0 1 /end COMPU_METHOD
/begin COMPU_METHOD DDRCTime_ms "" RAT_FUNC "%6.1" "ms" COEFFS 0 1 0 0 0 10 /end COMPU_METHOD
/begin COMPU_METHOD DDRC_LstRprtEve_VERB "" TAB_VERB "%6.3" "" COMPU_TAB_REF DDRC_LstRprtEve_VERB /end COMPU_METHOD
/begin COMPU_VTAB DDRC_LstRprtEve_VERB "" TAB_VERB 5 0 "PASSED" 1 "FAILED" 2 "PREPASSED" 3 "PREFAILED" 255 "INVALID" /end COMPU_VTAB
/begin COMPU_METHOD DDRC_Ratio "" TAB_VERB "%6.3" "-" COMPU_TAB_REF DDRC_Ratio /end COMPU_METHOD
/begin COMPU_VTAB DDRC_Ratio "" TAB_VERB 4 1 "Ratio1" 2 "Ratio2" 3 "Ratio3" 4 "Ratio4" /end COMPU_VTAB
/begin COMPU_METHOD dez "" RAT_FUNC "%6.2" "" COEFFS 0 1 0 0 0 1 /end COMPU_METHOD
/begin COMPU_METHOD DFC_OneToOne "" RAT_FUNC "%6.2" "-" COEFFS 0 1 0 0 0 1 /end COMPU_METHOD
/begin COMPU_METHOD EGSDIA_VAR_SY_Compu "" TAB_VERB "%6.3" "" COMPU_TAB_REF EGSDIA_VAR_SY_Compu /end COMPU_METHOD
/begin COMPU_VTAB EGSDIA_VAR_SY_Compu "" TAB_VERB 51 0 "kein Kundenbezug" 1 "DAI" 3 "VWW" 4 "POR" 5 "AUD" 6 "OPE" 9 "FIA" 11 "BMW" 14 "PSA" 15 "REN" 17 "ALF" 18 "SAB" 19 "VOL" 20 "NIS" 21 "GMU" 22 "FOR" 26 "IMJ" 36 "MAN" 51 "SEA" 53 "CHR" 54 "JAG" 55 "ROL" 69 "FER" 72 "TOY" 112 "BMWMotorradAG" 123 "MIT" 147 "HYU" 159 "HON" 160 "MAZ" 183 "CU" 190 "LRG" 204 "VVW" 214 "AVT" 242 "Iveco" 243 "DMC" 248 "SUZ" 267 "SSANGYONG" 270 "KEF" 289 "AMG" 308 "TAT" 319 "MVM" 385 "UAES" 578 "AL" 590 "Scania" 760 "WEICHAI" 828 "RBCD" 966 "International" 998 "S1" 999 "ALL" 2887 "NONOX" 9454 "Fuso" /end COMPU_VTAB
/begin COMPU_METHOD EGSDNOX_TRANDS_SC_Compu "" TAB_VERB "%6.3" "" COMPU_TAB_REF EGSDNOX_TRANDS_SC_Compu /end COMPU_METHOD
/begin COMPU_VTAB EGSDNOX_TRANDS_SC_Compu "" TAB_VERB 2 0 "False" 1 "True" /end COMPU_VTAB
/begin COMPU_METHOD EGSDO2_SYMCDYNDIAG_SC_Compu "" TAB_VERB "%6.3" "" COMPU_TAB_REF EGSDO2_SYMCDYNDIAG_SC_Compu /end COMPU_METHOD
/begin COMPU_VTAB EGSDO2_SYMCDYNDIAG_SC_Compu "" TAB_VERB 2 0 "False" 1 "True" /end COMPU_VTAB
/begin COMPU_METHOD EGSDUFILDYN_SC_Compu "" TAB_VERB "%6.3" "" COMPU_TAB_REF EGSDUFILDYN_SC_Compu /end COMPU_METHOD
/begin COMPU_VTAB EGSDUFILDYN_SC_Compu "" TAB_VERB 2 0 "False" 1 "True" /end COMPU_VTAB
/begin COMPU_METHOD EGSDU_CRSSBNK_SC_Compu "" TAB_VERB "%6.3" "" COMPU_TAB_REF EGSDU_CRSSBNK_SC_Compu /end COMPU_METHOD
/begin COMPU_VTAB EGSDU_CRSSBNK_SC_Compu "" TAB_VERB 2 0 "False" 1 "True" /end COMPU_VTAB
/begin COMPU_METHOD EGSDU_DLYLEAN_SC_Compu "" TAB_VERB "%6.3" "" COMPU_TAB_REF EGSDU_DLYLEAN_SC_Compu /end COMPU_METHOD
/begin COMPU_VTAB EGSDU_DLYLEAN_SC_Compu "" TAB_VERB 2 0 "False" 1 "True" /end COMPU_VTAB
/begin COMPU_METHOD EGSDU_EVLNPASDS_SC_Compu "" TAB_VERB "%6.3" "" COMPU_TAB_REF EGSDU_EVLNPASDS_SC_Compu /end COMPU_METHOD
/begin COMPU_VTAB EGSDU_EVLNPASDS_SC_Compu "" TAB_VERB 2 0 "False" 1 "True" /end COMPU_VTAB
/begin COMPU_METHOD EGSDU_FCO_SC_Compu "" TAB_VERB "%6.3" "" COMPU_TAB_REF EGSDU_FCO_SC_Compu /end COMPU_METHOD
/begin COMPU_VTAB EGSDU_FCO_SC_Compu "" TAB_VERB 2 0 "False" 1 "True" /end COMPU_VTAB
/begin COMPU_METHOD EGSDU_LIMDS_SC_Compu "" TAB_VERB "%6.3" "" COMPU_TAB_REF EGSDU_LIMDS_SC_Compu /end COMPU_METHOD
/begin COMPU_VTAB EGSDU_LIMDS_SC_Compu "" TAB_VERB 2 0 "False" 1 "True" /end COMPU_VTAB
/begin COMPU_METHOD EGSDU_STKUS_SC_Compu "" TAB_VERB "%6.3" "" COMPU_TAB_REF EGSDU_STKUS_SC_Compu /end COMPU_METHOD
/begin COMPU_VTAB EGSDU_STKUS_SC_Compu "" TAB_VERB 2 0 "False" 1 "True" /end COMPU_VTAB
/begin COMPU_METHOD EGSDU_TRANPAS_SC_Compu "" TAB_VERB "%6.3" "" COMPU_TAB_REF EGSDU_TRANPAS_SC_Compu /end COMPU_METHOD
/begin COMPU_VTAB EGSDU_TRANPAS_SC_Compu "" TAB_VERB 2 0 "False" 1 "True" /end COMPU_VTAB
/begin COMPU_METHOD EGSPREPN_ENANOXEGTDS_SC_Compu "" TAB_VERB "%6.3" "" COMPU_TAB_REF EGSPREPN_ENANOXEGTDS_SC_Compu /end COMPU_METHOD
/begin COMPU_VTAB EGSPREPN_ENANOXEGTDS_SC_Compu "" TAB_VERB 2 0 "False" 1 "True" /end COMPU_VTAB
/begin COMPU_METHOD EGSPREPN_VAR_SY_Compu "" TAB_VERB "%6.3" "" COMPU_TAB_REF EGSPREPN_VAR_SY_Compu /end COMPU_METHOD
/begin COMPU_VTAB EGSPREPN_VAR_SY_Compu "" TAB_VERB 51 0 "kein_Kundenbezug" 1 "DAI" 3 "VWW" 4 "POR" 5 "AUD" 6 "OPE" 9 "FIA" 11 "BMW" 14 "PSA" 15 "REN" 17 "ALF" 18 "SAB" 19 "VOL" 20 "NIS" 21 "GMU" 22 "FOR" 26 "IMJ" 36 "MAN" 51 "SEA" 53 "CHR" 54 "JAG" 55 "ROL" 69 "FER" 72 "TOY" 112 "BMWMotorradAG" 123 "MIT" 147 "HYU" 159 "HON" 160 "MAZ" 183 "CU" 190 "LRG" 204 "VVW" 214 "AVT" 242 "Iveco" 243 "DMC" 248 "SUZ" 267 "SSANGYONG" 270 "KEF" 289 "AMG" 308 "TAT" 319 "MVM" 385 "UAES" 578 "AL" 590 "Scania" 760 "WEICHAI" 828 "RBCD" 966 "International" 998 "S1" 999 "All" 2887 "NONOX" 9454 "Fuso" /end COMPU_VTAB
/begin COMPU_METHOD EGSSIG_CRSSSNVTYHIRESLENGSPD_SC_Compu "" TAB_VERB "%6.3" "" COMPU_TAB_REF EGSSIG_CRSSSNVTYHIRESLENGSPD_SC_Compu /end COMPU_METHOD
/begin COMPU_VTAB EGSSIG_CRSSSNVTYHIRESLENGSPD_SC_Compu "" TAB_VERB 2 0 "False" 1 "True" /end COMPU_VTAB
/begin COMPU_METHOD EGSSIG_DICORRNHSP_SC_Compu "" TAB_VERB "%6.3" "" COMPU_TAB_REF EGSSIG_DICORRNHSP_SC_Compu /end COMPU_METHOD
/begin COMPU_VTAB EGSSIG_DICORRNHSP_SC_Compu "" TAB_VERB 2 0 "False" 1 "True" /end COMPU_VTAB
/begin COMPU_METHOD EGSSIG_DLYMEASBUFSIZE_SC_Compu "" RAT_FUNC "%6.2" "" COEFFS 0 1 0 0 0 1 /end COMPU_METHOD
/begin COMPU_METHOD EGSSIG_ENACORRNEOM_SC_Compu "" TAB_VERB "%6.3" "" COMPU_TAB_REF EGSSIG_ENACORRNEOM_SC_Compu /end COMPU_METHOD
/begin COMPU_VTAB EGSSIG_ENACORRNEOM_SC_Compu "" TAB_VERB 2 0 "False" 1 "True" /end COMPU_VTAB
/begin COMPU_METHOD EGSSIG_ENACORRNFUINJ_SC_Compu "" TAB_VERB "%6.3" "" COMPU_TAB_REF EGSSIG_ENACORRNFUINJ_SC_Compu /end COMPU_METHOD
/begin COMPU_VTAB EGSSIG_ENACORRNFUINJ_SC_Compu "" TAB_VERB 2 0 "False" 1 "True" /end COMPU_VTAB
/begin COMPU_METHOD EGSSIG_ENALAMPENVCORRD_SC_Compu "" TAB_VERB "%6.3" "" COMPU_TAB_REF EGSSIG_ENALAMPENVCORRD_SC_Compu /end COMPU_METHOD
/begin COMPU_VTAB EGSSIG_ENALAMPENVCORRD_SC_Compu "" TAB_VERB 2 0 "False" 1 "True" /end COMPU_VTAB
/begin COMPU_METHOD EGSSIG_SELNOXTWC2DS_SC_Compu "" TAB_VERB "%6.3" "" COMPU_TAB_REF EGSSIG_SELNOXTWC2DS_SC_Compu /end COMPU_METHOD
/begin COMPU_VTAB EGSSIG_SELNOXTWC2DS_SC_Compu "" TAB_VERB 7 0 "0" 1 "1" 2 "2" 3 "3" 4 "4" 6 "6" 255 "255" /end COMPU_VTAB
/begin COMPU_METHOD EGSSIG_SELNOXTWC2US_SC_Compu "" TAB_VERB "%6.3" "" COMPU_TAB_REF EGSSIG_SELNOXTWC2US_SC_Compu /end COMPU_METHOD
/begin COMPU_VTAB EGSSIG_SELNOXTWC2US_SC_Compu "" TAB_VERB 7 0 "0" 1 "1" 2 "2" 3 "3" 4 "4" 6 "6" 255 "255" /end COMPU_VTAB
/begin COMPU_METHOD EGSSIG_SELNOXTWCDS_SC_Compu "" TAB_VERB "%6.3" "" COMPU_TAB_REF EGSSIG_SELNOXTWCDS_SC_Compu /end COMPU_METHOD
/begin COMPU_VTAB EGSSIG_SELNOXTWCDS_SC_Compu "" TAB_VERB 7 0 "0" 1 "1" 2 "2" 3 "3" 4 "4" 6 "6" 255 "255" /end COMPU_VTAB
/begin COMPU_METHOD EGSSIG_SELNOXTWCUS_SC_Compu "" TAB_VERB "%6.3" "" COMPU_TAB_REF EGSSIG_SELNOXTWCUS_SC_Compu /end COMPU_METHOD
/begin COMPU_VTAB EGSSIG_SELNOXTWCUS_SC_Compu "" TAB_VERB 7 0 "0" 1 "1" 2 "2" 3 "3" 4 "4" 6 "6" 255 "255" /end COMPU_VTAB
/begin COMPU_METHOD EGSSIG_SELO2ENGDS_SC_Compu "" TAB_VERB "%6.3" "" COMPU_TAB_REF EGSSIG_SELO2ENGDS_SC_Compu /end COMPU_METHOD
/begin COMPU_VTAB EGSSIG_SELO2ENGDS_SC_Compu "" TAB_VERB 4 0 "NO_SNSR_SEL" 1 "SNSR1" 2 "SNSR2" 3 "SNSR_VIA_CAL" /end COMPU_VTAB
/begin COMPU_METHOD EGSSIG_SELO2TWC2DS_SC_Compu "" TAB_VERB "%6.3" "" COMPU_TAB_REF EGSSIG_SELO2TWC2DS_SC_Compu /end COMPU_METHOD
/begin COMPU_VTAB EGSSIG_SELO2TWC2DS_SC_Compu "" TAB_VERB 7 0 "0" 1 "1" 2 "2" 3 "3" 4 "4" 6 "6" 255 "255" /end COMPU_VTAB
/begin COMPU_METHOD EGSSIG_SELO2TWC2US_SC_Compu "" TAB_VERB "%6.3" "" COMPU_TAB_REF EGSSIG_SELO2TWC2US_SC_Compu /end COMPU_METHOD
/begin COMPU_VTAB EGSSIG_SELO2TWC2US_SC_Compu "" TAB_VERB 7 0 "0" 1 "1" 2 "2" 3 "3" 4 "4" 6 "6" 255 "255" /end COMPU_VTAB
/begin COMPU_METHOD EGSSIG_SELO2TWCDS_SC_Compu "" TAB_VERB "%6.3" "" COMPU_TAB_REF EGSSIG_SELO2TWCDS_SC_Compu /end COMPU_METHOD
/begin COMPU_VTAB EGSSIG_SELO2TWCDS_SC_Compu "" TAB_VERB 7 0 "0" 1 "1" 2 "2" 3 "3" 4 "4" 6 "6" 255 "255" /end COMPU_VTAB
/begin COMPU_METHOD EGSSIG_SELO2TWCUS_SC_Compu "" TAB_VERB "%6.3" "" COMPU_TAB_REF EGSSIG_SELO2TWCUS_SC_Compu /end COMPU_METHOD
/begin COMPU_VTAB EGSSIG_SELO2TWCUS_SC_Compu "" TAB_VERB 7 0 "0" 1 "1" 2 "2" 3 "3" 4 "4" 6 "6" 255 "255" /end COMPU_VTAB
/begin COMPU_METHOD EGSSIG_SWTENAEGSSIG_SC_Compu "" TAB_VERB "%6.3" "" COMPU_TAB_REF EGSSIG_SWTENAEGSSIG_SC_Compu /end COMPU_METHOD
/begin COMPU_VTAB EGSSIG_SWTENAEGSSIG_SC_Compu "" TAB_VERB 2 0 "Deactivated" 1 "Activated" /end COMPU_VTAB
/begin COMPU_METHOD EGSSIG_SWTENAO2AIRPADPN_SC_Compu "" TAB_VERB "%6.3" "" COMPU_TAB_REF EGSSIG_SWTENAO2AIRPADPN_SC_Compu /end COMPU_METHOD
/begin COMPU_VTAB EGSSIG_SWTENAO2AIRPADPN_SC_Compu "" TAB_VERB 2 0 "False" 1 "True" /end COMPU_VTAB
/begin COMPU_METHOD EGSSIG_SWTENAO2SWADPR_SC_Compu "" TAB_VERB "%6.3" "" COMPU_TAB_REF EGSSIG_SWTENAO2SWADPR_SC_Compu /end COMPU_METHOD
/begin COMPU_VTAB EGSSIG_SWTENAO2SWADPR_SC_Compu "" TAB_VERB 2 0 "False" 1 "True" /end COMPU_VTAB
/begin COMPU_METHOD EGTFact "" RAT_FUNC "%6.5" "-" COEFFS 0 1000 0 0 0 1 /end COMPU_METHOD
/begin COMPU_METHOD EGTSwt "" RAT_FUNC "%10.9" "-" COEFFS 0 16384000 0 0 0 1 /end COMPU_METHOD
/begin COMPU_METHOD EGTSwt_S16 "" RAT_FUNC "%7.6" "-" COEFFS 0 16384 0 0 0 1 /end COMPU_METHOD
/begin COMPU_METHOD EngN_LRes "" RAT_FUNC "%6.1" "rpm" COEFFS 0 0.025 0 0 0 1 /end COMPU_METHOD
/begin COMPU_METHOD fak_uw_b2 "" RAT_FUNC "%7.6" "-" COEFFS 0 65536 0 0 0 2 /end COMPU_METHOD
/begin COMPU_METHOD nmot_ub_q40 "" RAT_FUNC "%6.1" "1/min" COEFFS 0 1 0 0 0 40 /end COMPU_METHOD
/begin COMPU_METHOD OneToOne "" RAT_FUNC "%6.2" "-" COEFFS 0 1 0 0 0 1 /end COMPU_METHOD
/begin COMPU_METHOD RBPtCel_p_0p002_1 "" RAT_FUNC "%6.4" "MPa" COEFFS 0 1000 0 0 0 2 /end COMPU_METHOD
/begin COMPU_METHOD rel_sw_b1536 "" RAT_FUNC "%6.4" "%" COEFFS 0 65536 0 0 0 3072 /end COMPU_METHOD
/begin COMPU_METHOD t1sxs_uw_q1 "" RAT_FUNC "%6.2" "s" COEFFS 0 1 0 0 0 1 /end COMPU_METHOD
/begin COMPU_METHOD temp_ub_q0p75_o48 "" RAT_FUNC "%6.2" "Grad C" COEFFS 0 1 48 0 0 0.75 /end COMPU_METHOD
/begin COMPU_METHOD t_q0p01 "" RAT_FUNC "%6.4" "s" COEFFS 0 100 0 0 0 1 /end COMPU_METHOD
/begin COMPU_METHOD t_q0p05 "" RAT_FUNC "%6.4" "s" COEFFS 0 100 0 0 0 5 /end COMPU_METHOD
/begin COMPU_METHOD t_q0p1 "" RAT_FUNC "%6.3" "s" COEFFS 0 10 0 0 0 1 /end COMPU_METHOD
/begin COMPU_METHOD t_q10_ms "" RAT_FUNC "%6.1" "ms" COEFFS 0 1 0 0 0 10 /end COMPU_METHOD
/begin COMPU_METHOD Volt_Batt "" RAT_FUNC "%6.1" "mV" COEFFS 0 0.05 0 0 0 1 /end COMPU_METHOD
/begin RECORD_LAYOUT KwWU16 FNC_VALUES 1 UWORD COLUMN_DIR DIRECT /end RECORD_LAYOUT
/begin RECORD_LAYOUT KwWU8 FNC_VALUES 1 UBYTE COLUMN_DIR DIRECT /end RECORD_LAYOUT
/begin RECORD_LAYOUT RB_Curve_U16_U8_Static NO_AXIS_PTS_X 1 UWORD AXIS_PTS_X 2 UWORD INDEX_INCR DIRECT FNC_VALUES 3 UBYTE COLUMN_DIR DIRECT STATIC_RECORD_LAYOUT /end RECORD_LAYOUT
/begin RECORD_LAYOUT RB_Curve_U8_U16_Static NO_AXIS_PTS_X 1 UBYTE AXIS_PTS_X 2 UBYTE INDEX_INCR DIRECT FNC_VALUES 3 UWORD COLUMN_DIR DIRECT STATIC_RECORD_LAYOUT /end RECORD_LAYOUT
/begin RECORD_LAYOUT RB_Val_Ws16 FNC_VALUES 1 SWORD COLUMN_DIR DIRECT /end RECORD_LAYOUT
/begin RECORD_LAYOUT RB_Val_Wu16 FNC_VALUES 1 UWORD COLUMN_DIR DIRECT /end RECORD_LAYOUT
/begin RECORD_LAYOUT RB_Val_Wu8 FNC_VALUES 1 UBYTE COLUMN_DIR DIRECT /end RECORD_LAYOUT
/begin RECORD_LAYOUT ValA_Wu16 FNC_VALUES 1 UWORD COLUMN_DIR DIRECT /end RECORD_LAYOUT
/begin RECORD_LAYOUT ValA_Wu8 FNC_VALUES 1 UBYTE COLUMN_DIR DIRECT /end RECORD_LAYOUT
/begin RECORD_LAYOUT Val_Wu8 FNC_VALUES 1 UBYTE COLUMN_DIR DIRECT /end RECORD_LAYOUT
/end MODULE
/end PROJECT
