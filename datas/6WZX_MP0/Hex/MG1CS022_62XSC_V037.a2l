ASAP2_VERSION 1 60
/begin PROJECT MG1CS022 "MG1CS022"
/begin HEADER "" VERSION "MG1CS022_62XSC_V037" PROJECT_NO MG1CS022 /end HEADER
/begin MODULE DIM ""
/begin MOD_COMMON "" BYTE_ORDER MSB_LAST ALIGNMENT_BYTE 1 ALIGNMENT_WORD 2 ALIGNMENT_LONG 4 ALIGNMENT_INT64 4 ALIGNMENT_FLOAT32_IEEE 4 ALIGNMENT_FLOAT64_IEEE 4 DATA_SIZE 32 /end MOD_COMMON
/begin MEASUREMENT DINH_nrActvInhReas.FId_OilPPlausT15 "Number of active inhibit reasons for the FIds / Number of active inhibit reasons for FId_OilPPlausT15" UWORD DINH_ct_Compu 1 100 -4095.000 4096.000 BIT_MASK 0x1fff FORMAT "%8.3" ECU_ADDRESS 0x60014518 /end MEASUREMENT
/begin MEASUREMENT DINH_nrActvInhReas.FId_OilPRplVal "Number of active inhibit reasons for the FIds / Number of active inhibit reasons for FId_OilPRplVal" UWORD DINH_ct_Compu 1 100 -4095.000 4096.000 BIT_MASK 0x1fff FORMAT "%8.3" ECU_ADDRESS 0x6001451A /end MEASUREMENT
/begin MEASUREMENT DINH_nrActvInhReas.FId_OilPSnsrErr "Number of active inhibit reasons for the FIds / Number of active inhibit reasons for FId_OilPSnsrErr" UWORD DINH_ct_Compu 1 100 -4095.000 4096.000 BIT_MASK 0x1fff FORMAT "%8.3" ECU_ADDRESS 0x6001451C /end MEASUREMENT
/begin MEASUREMENT DINH_nrActvInhReas.FId_OilPSwmpSRC "Number of active inhibit reasons for the FIds / Number of active inhibit reasons for FId_OilPSwmpSRC" UWORD DINH_ct_Compu 1 100 -4095.000 4096.000 BIT_MASK 0x1fff FORMAT "%8.3" ECU_ADDRESS 0x6001451E /end MEASUREMENT
/begin MEASUREMENT DINH_nrActvInhReas.FId_OilSwmpTCEngDsTWrmUp "Number of active inhibit reasons for the FIds / Number of active inhibit reasons for FId_OilSwmpTCEngDsTWrmUp" UWORD DINH_ct_Compu 1 100 -4095.000 4096.000 BIT_MASK 0x1fff FORMAT "%8.3" ECU_ADDRESS 0x60014520 /end MEASUREMENT
/begin MEASUREMENT DINH_nrActvInhReas.FId_OilSwmpT_B_tospg "Number of active inhibit reasons for the FIds / Number of active inhibit reasons for FId_OilSwmpT_B_tospg" UWORD DINH_ct_Compu 1 100 -4095.000 4096.000 BIT_MASK 0x1fff FORMAT "%8.3" ECU_ADDRESS 0x60014522 /end MEASUREMENT
/begin MEASUREMENT DINH_nrActvInhReas.FId_OilSwmpT_B_tospgg "Number of active inhibit reasons for the FIds / Number of active inhibit reasons for FId_OilSwmpT_B_tospgg" UWORD DINH_ct_Compu 1 100 -4095.000 4096.000 BIT_MASK 0x1fff FORMAT "%8.3" ECU_ADDRESS 0x60014524 /end MEASUREMENT
/begin MEASUREMENT DINH_nrActvInhReas.FId_OilSwmpT_CmbdSnsrErr "Number of active inhibit reasons for the FIds / Number of active inhibit reasons for FId_OilSwmpT_CmbdSnsrErr" UWORD DINH_ct_Compu 1 100 -4095.000 4096.000 BIT_MASK 0x1fff FORMAT "%8.3" ECU_ADDRESS 0x60014526 /end MEASUREMENT
/begin MEASUREMENT DINH_nrActvInhReas.FId_OilSwmpT_CmbdSnsrTiTErr "Number of active inhibit reasons for the FIds / Number of active inhibit reasons for FId_OilSwmpT_CmbdSnsrTiTErr" UWORD DINH_ct_Compu 1 100 -4095.000 4096.000 BIT_MASK 0x1fff FORMAT "%8.3" ECU_ADDRESS 0x60014528 /end MEASUREMENT
/begin MEASUREMENT DINH_nrActvInhReas.FId_OilSwmpT_EnvT "Number of active inhibit reasons for the FIds / Number of active inhibit reasons for FId_OilSwmpT_EnvT" UWORD DINH_ct_Compu 1 100 -4095.000 4096.000 BIT_MASK 0x1fff FORMAT "%8.3" ECU_ADDRESS 0x6001452A /end MEASUREMENT
/begin MEASUREMENT DINH_nrActvInhReas.FId_OilSwmpT_TSnsrErr "Number of active inhibit reasons for the FIds / Number of active inhibit reasons for FId_OilSwmpT_TSnsrErr" UWORD DINH_ct_Compu 1 100 -4095.000 4096.000 BIT_MASK 0x1fff FORMAT "%8.3" ECU_ADDRESS 0x6001452C /end MEASUREMENT
/begin MEASUREMENT DINH_nrActvInhReas.FId_PEnvMeasVld "Number of active inhibit reasons for the FIds / Number of active inhibit reasons for FId_PEnvMeasVld" UWORD DINH_ct_Compu 1 100 -4095.000 4096.000 BIT_MASK 0x1fff FORMAT "%8.3" ECU_ADDRESS 0x6001452E /end MEASUREMENT
/begin MEASUREMENT DINH_nrActvInhReas.FId_PEnvModel "Number of active inhibit reasons for the FIds / Number of active inhibit reasons for FId_PEnvModel" UWORD DINH_ct_Compu 1 100 -4095.000 4096.000 BIT_MASK 0x1fff FORMAT "%8.3" ECU_ADDRESS 0x60014530 /end MEASUREMENT
/begin MEASUREMENT DINH_nrActvInhReas.FId_PEnvPlausDiagVDD "Number of active inhibit reasons for the FIds / Number of active inhibit reasons for FId_PEnvPlausDiagVDD" UWORD DINH_ct_Compu 1 100 -4095.000 4096.000 BIT_MASK 0x1fff FORMAT "%8.3" ECU_ADDRESS 0x60014532 /end MEASUREMENT
/begin MEASUREMENT DINH_nrActvInhReas.FId_PEnvRawVldVDD "Number of active inhibit reasons for the FIds / Number of active inhibit reasons for FId_PEnvRawVldVDD" UWORD DINH_ct_Compu 1 100 -4095.000 4096.000 BIT_MASK 0x1fff FORMAT "%8.3" ECU_ADDRESS 0x60014534 /end MEASUREMENT
/begin MEASUREMENT DINH_nrActvInhReas.FId_PEnvRefSnsr "Number of active inhibit reasons for the FIds / Number of active inhibit reasons for FId_PEnvRefSnsr" UWORD DINH_ct_Compu 1 100 -4095.000 4096.000 BIT_MASK 0x1fff FORMAT "%8.3" ECU_ADDRESS 0x60014536 /end MEASUREMENT
/begin MEASUREMENT DINH_nrActvInhReas.FId_PEnvSigRngVld "Number of active inhibit reasons for the FIds / Number of active inhibit reasons for FId_PEnvSigRngVld" UWORD DINH_ct_Compu 1 100 -4095.000 4096.000 BIT_MASK 0x1fff FORMAT "%8.3" ECU_ADDRESS 0x60014538 /end MEASUREMENT
/begin MEASUREMENT DINH_nrActvInhReas.FId_PEnvSnsrPlausVDD "Number of active inhibit reasons for the FIds / Number of active inhibit reasons for FId_PEnvSnsrPlausVDD" UWORD DINH_ct_Compu 1 100 -4095.000 4096.000 BIT_MASK 0x1fff FORMAT "%8.3" ECU_ADDRESS 0x6001453A /end MEASUREMENT
/begin MEASUREMENT DINH_nrActvInhReas.FId_PEnvVldVDD "Number of active inhibit reasons for the FIds / Number of active inhibit reasons for FId_PEnvVldVDD" UWORD DINH_ct_Compu 1 100 -4095.000 4096.000 BIT_MASK 0x1fff FORMAT "%8.3" ECU_ADDRESS 0x6001453C /end MEASUREMENT
/begin MEASUREMENT DINH_nrActvInhReas.FId_PIDA6SigSrcErr "Number of active inhibit reasons for the FIds / Number of active inhibit reasons for FId_PIDA6SigSrcErr" UWORD DINH_ct_Compu 1 100 -4095.000 4096.000 BIT_MASK 0x1fff FORMAT "%8.3" ECU_ADDRESS 0x6001453E /end MEASUREMENT
/begin MEASUREMENT DINH_nrActvInhReas.FId_PIntkMnfldPlaus "Number of active inhibit reasons for the FIds / Number of active inhibit reasons for FId_PIntkMnfldPlaus" UWORD DINH_ct_Compu 1 100 -4095.000 4096.000 BIT_MASK 0x1fff FORMAT "%8.3" ECU_ADDRESS 0x60014540 /end MEASUREMENT
/begin MEASUREMENT DINH_nrActvInhReas.FId_PIntkVUsElecDiagB1 "Number of active inhibit reasons for the FIds / Number of active inhibit reasons for FId_PIntkVUsElecDiagB1" UWORD DINH_ct_Compu 1 100 -4095.000 4096.000 BIT_MASK 0x1fff FORMAT "%8.3" ECU_ADDRESS 0x60014542 /end MEASUREMENT
/begin MEASUREMENT DINH_nrActvInhReas.FId_PSPCtlDisbl "Number of active inhibit reasons for the FIds / Number of active inhibit reasons for FId_PSPCtlDisbl" UWORD DINH_ct_Compu 1 100 -4095.000 4096.000 BIT_MASK 0x1fff FORMAT "%8.3" ECU_ADDRESS 0x60014544 /end MEASUREMENT
/begin MEASUREMENT DINH_nrActvInhReas.FId_PSPCtlIntkAirVapLock "Number of active inhibit reasons for the FIds / Number of active inhibit reasons for FId_PSPCtlIntkAirVapLock" UWORD DINH_ct_Compu 1 100 -4095.000 4096.000 BIT_MASK 0x1fff FORMAT "%8.3" ECU_ADDRESS 0x60014546 /end MEASUREMENT
/begin MEASUREMENT DINH_nrActvInhReas.FId_PSPCtlPreRun "Number of active inhibit reasons for the FIds / Number of active inhibit reasons for FId_PSPCtlPreRun" UWORD DINH_ct_Compu 1 100 -4095.000 4096.000 BIT_MASK 0x1fff FORMAT "%8.3" ECU_ADDRESS 0x60014548 /end MEASUREMENT
/begin MEASUREMENT DINH_nrActvInhReas.FId_PSPCtlVapLock "Number of active inhibit reasons for the FIds / Number of active inhibit reasons for FId_PSPCtlVapLock" UWORD DINH_ct_Compu 1 100 -4095.000 4096.000 BIT_MASK 0x1fff FORMAT "%8.3" ECU_ADDRESS 0x6001454A /end MEASUREMENT
/begin MEASUREMENT DINH_nrActvInhReas.FId_PSPDiagDisbl "Number of active inhibit reasons for the FIds / Number of active inhibit reasons for FId_PSPDiagDisbl" UWORD DINH_ct_Compu 1 100 -4095.000 4096.000 BIT_MASK 0x1fff FORMAT "%8.3" ECU_ADDRESS 0x6001454C /end MEASUREMENT
/begin MEASUREMENT DINH_nrActvInhReas.FId_PTGripConv "Number of active inhibit reasons for the FIds / Number of active inhibit reasons for FId_PTGripConv" UWORD DINH_ct_Compu 1 100 -4095.000 4096.000 BIT_MASK 0x1fff FORMAT "%8.3" ECU_ADDRESS 0x6001454E /end MEASUREMENT
/begin MEASUREMENT DINH_nrActvInhReas.FId_PTGripConvStrt "Number of active inhibit reasons for the FIds / Number of active inhibit reasons for FId_PTGripConvStrt" UWORD DINH_ct_Compu 1 100 -4095.000 4096.000 BIT_MASK 0x1fff FORMAT "%8.3" ECU_ADDRESS 0x60014550 /end MEASUREMENT
/begin MEASUREMENT DINH_nrActvInhReas.FId_PTGripMnlClth "Number of active inhibit reasons for the FIds / Number of active inhibit reasons for FId_PTGripMnlClth" UWORD DINH_ct_Compu 1 100 -4095.000 4096.000 BIT_MASK 0x1fff FORMAT "%8.3" ECU_ADDRESS 0x60014552 /end MEASUREMENT
/begin MEASUREMENT DINH_nrActvInhReas.FId_PTGripMnlClthStrt "Number of active inhibit reasons for the FIds / Number of active inhibit reasons for FId_PTGripMnlClthStrt" UWORD DINH_ct_Compu 1 100 -4095.000 4096.000 BIT_MASK 0x1fff FORMAT "%8.3" ECU_ADDRESS 0x60014554 /end MEASUREMENT
/begin MEASUREMENT DINH_nrActvInhReas.FId_PTTrqRatCANPtd "Number of active inhibit reasons for the FIds / Number of active inhibit reasons for FId_PTTrqRatCANPtd" UWORD DINH_ct_Compu 1 100 -4095.000 4096.000 BIT_MASK 0x1fff FORMAT "%8.3" ECU_ADDRESS 0x60014556 /end MEASUREMENT
/begin MEASUREMENT DINH_nrActvInhReas.FId_PThrVlVUsVldB1 "Number of active inhibit reasons for the FIds / Number of active inhibit reasons for FId_PThrVlVUsVldB1" UWORD DINH_ct_Compu 1 100 -4095.000 4096.000 BIT_MASK 0x1fff FORMAT "%8.3" ECU_ADDRESS 0x60014558 /end MEASUREMENT
/begin MEASUREMENT DINH_nrActvInhReas.FId_PThrVlvUsMeasdVldB1 "Number of active inhibit reasons for the FIds / Number of active inhibit reasons for FId_PThrVlvUsMeasdVldB1" UWORD DINH_ct_Compu 1 100 -4095.000 4096.000 BIT_MASK 0x1fff FORMAT "%8.3" ECU_ADDRESS 0x6001455A /end MEASUREMENT
/begin MEASUREMENT DINH_nrActvInhReas.FId_P_VSE11_Diag "Number of active inhibit reasons for the FIds / Number of active inhibit reasons for FId_P_VSE11_Diag" UWORD DINH_ct_Compu 1 100 -4095.000 4096.000 BIT_MASK 0x1fff FORMAT "%8.3" ECU_ADDRESS 0x6001455C /end MEASUREMENT
/begin MEASUREMENT DINH_nrActvInhReas.FId_PrmId03_FltRdnS1B1 "Number of active inhibit reasons for the FIds / Number of active inhibit reasons for FId_PrmId03_FltRdnS1B1" UWORD DINH_ct_Compu 1 100 -4095.000 4096.000 BIT_MASK 0x1fff FORMAT "%8.3" ECU_ADDRESS 0x6001455E /end MEASUREMENT
/begin MEASUREMENT DINH_nrActvInhReas.FId_PrmId03_FltUegoS1B1 "Number of active inhibit reasons for the FIds / Number of active inhibit reasons for FId_PrmId03_FltUegoS1B1" UWORD DINH_ct_Compu 1 100 -4095.000 4096.000 BIT_MASK 0x1fff FORMAT "%8.3" ECU_ADDRESS 0x60014560 /end MEASUREMENT
/begin MEASUREMENT DINH_nrActvInhReas.FId_RevLck "Number of active inhibit reasons for the FIds / Number of active inhibit reasons for FId_RevLck" UWORD DINH_ct_Compu 1 100 -4095.000 4096.000 BIT_MASK 0x1fff FORMAT "%8.3" ECU_ADDRESS 0x60014562 /end MEASUREMENT
/begin MEASUREMENT DINH_nrActvInhReas.FId_RstAdpnPIntkMnfldAfs "Number of active inhibit reasons for the FIds / Number of active inhibit reasons for FId_RstAdpnPIntkMnfldAfs" UWORD DINH_ct_Compu 1 100 -4095.000 4096.000 BIT_MASK 0x1fff FORMAT "%8.3" ECU_ADDRESS 0x60014564 /end MEASUREMENT
/begin MEASUREMENT DINH_nrActvInhReas.FId_RvsPosnFailr "Number of active inhibit reasons for the FIds / Number of active inhibit reasons for FId_RvsPosnFailr" UWORD DINH_ct_Compu 1 100 -4095.000 4096.000 BIT_MASK 0x1fff FORMAT "%8.3" ECU_ADDRESS 0x60014566 /end MEASUREMENT
/begin MEASUREMENT DINH_nrActvInhReas.FId_SSEEPBRelease "Number of active inhibit reasons for the FIds / Number of active inhibit reasons for FId_SSEEPBRelease" UWORD DINH_ct_Compu 1 100 -4095.000 4096.000 BIT_MASK 0x1fff FORMAT "%8.3" ECU_ADDRESS 0x60014568 /end MEASUREMENT
/begin MEASUREMENT DINH_nrActvInhReas.FId_SSEFCANPRelease "Number of active inhibit reasons for the FIds / Number of active inhibit reasons for FId_SSEFCANPRelease" UWORD DINH_ct_Compu 1 100 -4095.000 4096.000 BIT_MASK 0x1fff FORMAT "%8.3" ECU_ADDRESS 0x6001456A /end MEASUREMENT
/begin MEASUREMENT DINH_nrActvInhReas.FId_SSEPTCANPRelease "Number of active inhibit reasons for the FIds / Number of active inhibit reasons for FId_SSEPTCANPRelease" UWORD DINH_ct_Compu 1 100 -4095.000 4096.000 BIT_MASK 0x1fff FORMAT "%8.3" ECU_ADDRESS 0x6001456C /end MEASUREMENT
/begin MEASUREMENT DINH_nrActvInhReas.FId_SSEStartRelease "Number of active inhibit reasons for the FIds / Number of active inhibit reasons for FId_SSEStartRelease" UWORD DINH_ct_Compu 1 100 -4095.000 4096.000 BIT_MASK 0x1fff FORMAT "%8.3" ECU_ADDRESS 0x6001456E /end MEASUREMENT
/begin MEASUREMENT DINH_nrActvInhReas.FId_SSEStartReleaseMTCl10 "Number of active inhibit reasons for the FIds / Number of active inhibit reasons for FId_SSEStartReleaseMTCl10" UWORD DINH_ct_Compu 1 100 -4095.000 4096.000 BIT_MASK 0x1fff FORMAT "%8.3" ECU_ADDRESS 0x60014570 /end MEASUREMENT
/begin MEASUREMENT DINH_nrActvInhReas.FId_SSEStartReleaseMTCl100 "Number of active inhibit reasons for the FIds / Number of active inhibit reasons for FId_SSEStartReleaseMTCl100" UWORD DINH_ct_Compu 1 100 -4095.000 4096.000 BIT_MASK 0x1fff FORMAT "%8.3" ECU_ADDRESS 0x60014572 /end MEASUREMENT
/begin MEASUREMENT DINH_nrActvInhReas.FId_SSEStartReleaseMTCl20 "Number of active inhibit reasons for the FIds / Number of active inhibit reasons for FId_SSEStartReleaseMTCl20" UWORD DINH_ct_Compu 1 100 -4095.000 4096.000 BIT_MASK 0x1fff FORMAT "%8.3" ECU_ADDRESS 0x60014574 /end MEASUREMENT
/begin MEASUREMENT DINH_nrActvInhReas.FId_SSEStartReleaseMTCl90 "Number of active inhibit reasons for the FIds / Number of active inhibit reasons for FId_SSEStartReleaseMTCl90" UWORD DINH_ct_Compu 1 100 -4095.000 4096.000 BIT_MASK 0x1fff FORMAT "%8.3" ECU_ADDRESS 0x60014576 /end MEASUREMENT
/begin MEASUREMENT DINH_nrActvInhReas.FId_SSEStartRequest "Number of active inhibit reasons for the FIds / Number of active inhibit reasons for FId_SSEStartRequest" UWORD DINH_ct_Compu 1 100 -4095.000 4096.000 BIT_MASK 0x1fff FORMAT "%8.3" ECU_ADDRESS 0x60014578 /end MEASUREMENT
/begin MEASUREMENT DINH_nrActvInhReas.FId_SSEStopRelease "Number of active inhibit reasons for the FIds / Number of active inhibit reasons for FId_SSEStopRelease" UWORD DINH_ct_Compu 1 100 -4095.000 4096.000 BIT_MASK 0x1fff FORMAT "%8.3" ECU_ADDRESS 0x6001457A /end MEASUREMENT
/begin MEASUREMENT DINH_nrActvInhReas.FId_SSEStrtStopRelease "Number of active inhibit reasons for the FIds / Number of active inhibit reasons for FId_SSEStrtStopRelease" UWORD DINH_ct_Compu 1 100 -4095.000 4096.000 BIT_MASK 0x1fff FORMAT "%8.3" ECU_ADDRESS 0x6001457C /end MEASUREMENT
/begin MEASUREMENT DINH_nrActvInhReas.FId_SSESysOff "Number of active inhibit reasons for the FIds / Number of active inhibit reasons for FId_SSESysOff" UWORD DINH_ct_Compu 1 100 -4095.000 4096.000 BIT_MASK 0x1fff FORMAT "%8.3" ECU_ADDRESS 0x6001457E /end MEASUREMENT
/begin MEASUREMENT DINH_nrActvInhReas.FId_SSEUI2DCSysFailr "Number of active inhibit reasons for the FIds / Number of active inhibit reasons for FId_SSEUI2DCSysFailr" UWORD DINH_ct_Compu 1 100 -4095.000 4096.000 BIT_MASK 0x1fff FORMAT "%8.3" ECU_ADDRESS 0x60014580 /end MEASUREMENT
/begin MEASUREMENT DINH_nrActvInhReas.FId_SSEUIBCANErr "Number of active inhibit reasons for the FIds / Number of active inhibit reasons for FId_SSEUIBCANErr" UWORD DINH_ct_Compu 1 100 -4095.000 4096.000 BIT_MASK 0x1fff FORMAT "%8.3" ECU_ADDRESS 0x60014582 /end MEASUREMENT
/begin MEASUREMENT DINH_nrActvInhReas.FId_SSEUISysFail "Number of active inhibit reasons for the FIds / Number of active inhibit reasons for FId_SSEUISysFail" UWORD DINH_ct_Compu 1 100 -4095.000 4096.000 BIT_MASK 0x1fff FORMAT "%8.3" ECU_ADDRESS 0x60014584 /end MEASUREMENT
/begin MEASUREMENT DINH_nrActvInhReas.FId_SiaEEPErr "Number of active inhibit reasons for the FIds / Number of active inhibit reasons for FId_SiaEEPErr" UWORD DINH_ct_Compu 1 100 -4095.000 4096.000 BIT_MASK 0x1fff FORMAT "%8.3" ECU_ADDRESS 0x60014586 /end MEASUREMENT
/begin MEASUREMENT DINH_nrActvInhReas.FId_SnglWhlErrDiagEna "Number of active inhibit reasons for the FIds / Number of active inhibit reasons for FId_SnglWhlErrDiagEna" UWORD DINH_ct_Compu 1 100 -4095.000 4096.000 BIT_MASK 0x1fff FORMAT "%8.3" ECU_ADDRESS 0x60014588 /end MEASUREMENT
/begin MEASUREMENT DINH_nrActvInhReas.FId_StrtCtlAutoCrkModeCdn "Number of active inhibit reasons for the FIds / Number of active inhibit reasons for FId_StrtCtlAutoCrkModeCdn" UWORD DINH_ct_Compu 1 100 -4095.000 4096.000 BIT_MASK 0x1fff FORMAT "%8.3" ECU_ADDRESS 0x6001458A /end MEASUREMENT
/begin MEASUREMENT DINH_nrActvInhReas.FId_StrtCtlComEngStrtErr "Number of active inhibit reasons for the FIds / Number of active inhibit reasons for FId_StrtCtlComEngStrtErr" UWORD DINH_ct_Compu 1 100 -4095.000 4096.000 BIT_MASK 0x1fff FORMAT "%8.3" ECU_ADDRESS 0x6001458C /end MEASUREMENT
/begin MEASUREMENT DINH_nrActvInhReas.FId_StrtCtlNPCdnCncl "Number of active inhibit reasons for the FIds / Number of active inhibit reasons for FId_StrtCtlNPCdnCncl" UWORD DINH_ct_Compu 1 100 -4095.000 4096.000 BIT_MASK 0x1fff FORMAT "%8.3" ECU_ADDRESS 0x6001458E /end MEASUREMENT
/begin MEASUREMENT DINH_nrActvInhReas.FId_StrtCtlNoCpuFailr "Number of active inhibit reasons for the FIds / Number of active inhibit reasons for FId_StrtCtlNoCpuFailr" UWORD DINH_ct_Compu 1 100 -4095.000 4096.000 BIT_MASK 0x1fff FORMAT "%8.3" ECU_ADDRESS 0x60014590 /end MEASUREMENT
/begin MEASUREMENT DINH_nrActvInhReas.FId_StrtCtlNoFailCanLine "Number of active inhibit reasons for the FIds / Number of active inhibit reasons for FId_StrtCtlNoFailCanLine" UWORD DINH_ct_Compu 1 100 -4095.000 4096.000 BIT_MASK 0x1fff FORMAT "%8.3" ECU_ADDRESS 0x60014592 /end MEASUREMENT
/begin MEASUREMENT DINH_nrActvInhReas.FId_StrtCtlNoFailPTCanLine "Number of active inhibit reasons for the FIds / Number of active inhibit reasons for FId_StrtCtlNoFailPTCanLine" UWORD DINH_ct_Compu 1 100 -4095.000 4096.000 BIT_MASK 0x1fff FORMAT "%8.3" ECU_ADDRESS 0x60014594 /end MEASUREMENT
/begin MEASUREMENT DINH_nrActvInhReas.FId_StrtCtlPNPosnSubsVal "Number of active inhibit reasons for the FIds / Number of active inhibit reasons for FId_StrtCtlPNPosnSubsVal" UWORD DINH_ct_Compu 1 100 -4095.000 4096.000 BIT_MASK 0x1fff FORMAT "%8.3" ECU_ADDRESS 0x60014596 /end MEASUREMENT
/begin MEASUREMENT DINH_nrActvInhReas.FId_StrtCtlSTMFailr "Number of active inhibit reasons for the FIds / Number of active inhibit reasons for FId_StrtCtlSTMFailr" UWORD DINH_ct_Compu 1 100 -4095.000 4096.000 BIT_MASK 0x1fff FORMAT "%8.3" ECU_ADDRESS 0x60014598 /end MEASUREMENT
/begin MEASUREMENT DINH_nrActvInhReas.FId_StrtErrShaft "Number of active inhibit reasons for the FIds / Number of active inhibit reasons for FId_StrtErrShaft" UWORD DINH_ct_Compu 1 100 -4095.000 4096.000 BIT_MASK 0x1fff FORMAT "%8.3" ECU_ADDRESS 0x6001459A /end MEASUREMENT
/begin MEASUREMENT DINH_nrActvInhReas.FId_SumErrHndlg "Number of active inhibit reasons for the FIds / Number of active inhibit reasons for FId_SumErrHndlg" UWORD DINH_ct_Compu 1 100 -4095.000 4096.000 BIT_MASK 0x1fff FORMAT "%8.3" ECU_ADDRESS 0x6001459C /end MEASUREMENT
/begin MEASUREMENT DINH_nrActvInhReas.FId_SysDiagComErr "Number of active inhibit reasons for the FIds / Number of active inhibit reasons for FId_SysDiagComErr" UWORD DINH_ct_Compu 1 100 -4095.000 4096.000 BIT_MASK 0x1fff FORMAT "%8.3" ECU_ADDRESS 0x6001459E /end MEASUREMENT
/begin MEASUREMENT DINH_nrActvInhReas.FId_SysDiagModInhbErr "Number of active inhibit reasons for the FIds / Number of active inhibit reasons for FId_SysDiagModInhbErr" UWORD DINH_ct_Compu 1 100 -4095.000 4096.000 BIT_MASK 0x1fff FORMAT "%8.3" ECU_ADDRESS 0x600145A0 /end MEASUREMENT
/begin MEASUREMENT DINH_nrActvInhReas.FId_TOSPM "Number of active inhibit reasons for the FIds / Number of active inhibit reasons for FId_TOSPM" UWORD DINH_ct_Compu 1 100 -4095.000 4096.000 BIT_MASK 0x1fff FORMAT "%8.3" ECU_ADDRESS 0x600145A2 /end MEASUREMENT
/begin MEASUREMENT DINH_nrActvInhReas.FId_TWCCILck "Number of active inhibit reasons for the FIds / Number of active inhibit reasons for FId_TWCCILck" UWORD DINH_ct_Compu 1 100 -4095.000 4096.000 BIT_MASK 0x1fff FORMAT "%8.3" ECU_ADDRESS 0x600145A4 /end MEASUREMENT
/begin MEASUREMENT DINH_nrActvInhReas.FId_TWCCILckExtd "Number of active inhibit reasons for the FIds / Number of active inhibit reasons for FId_TWCCILckExtd" UWORD DINH_ct_Compu 1 100 -4095.000 4096.000 BIT_MASK 0x1fff FORMAT "%8.3" ECU_ADDRESS 0x600145A6 /end MEASUREMENT
/begin MEASUREMENT DINH_nrActvInhReas.FId_TWCCIRstB1 "Number of active inhibit reasons for the FIds / Number of active inhibit reasons for FId_TWCCIRstB1" UWORD DINH_ct_Compu 1 100 -4095.000 4096.000 BIT_MASK 0x1fff FORMAT "%8.3" ECU_ADDRESS 0x600145A8 /end MEASUREMENT
/begin MEASUREMENT DINH_nrActvInhReas.FId_TWCCIRstDSMClearB1 "Number of active inhibit reasons for the FIds / Number of active inhibit reasons for FId_TWCCIRstDSMClearB1" UWORD DINH_ct_Compu 1 100 -4095.000 4096.000 BIT_MASK 0x1fff FORMAT "%8.3" ECU_ADDRESS 0x600145AA /end MEASUREMENT
/begin MEASUREMENT DINH_nrActvInhReas.FId_TWCCLsuB1 "Number of active inhibit reasons for the FIds / Number of active inhibit reasons for FId_TWCCLsuB1" UWORD DINH_ct_Compu 1 100 -4095.000 4096.000 BIT_MASK 0x1fff FORMAT "%8.3" ECU_ADDRESS 0x600145AC /end MEASUREMENT
/begin MEASUREMENT DINH_nrActvInhReas.FId_TWCCLsuCyc "Number of active inhibit reasons for the FIds / Number of active inhibit reasons for FId_TWCCLsuCyc" UWORD DINH_ct_Compu 1 100 -4095.000 4096.000 BIT_MASK 0x1fff FORMAT "%8.3" ECU_ADDRESS 0x600145AE /end MEASUREMENT
/begin MEASUREMENT DINH_nrActvInhReas.FId_TWCCLsuDynB1 "Number of active inhibit reasons for the FIds / Number of active inhibit reasons for FId_TWCCLsuDynB1" UWORD DINH_ct_Compu 1 100 -4095.000 4096.000 BIT_MASK 0x1fff FORMAT "%8.3" ECU_ADDRESS 0x600145B0 /end MEASUREMENT
/begin MEASUREMENT DINH_nrActvInhReas.FId_TWCCMisfDetn "Number of active inhibit reasons for the FIds / Number of active inhibit reasons for FId_TWCCMisfDetn" UWORD DINH_ct_Compu 1 100 -4095.000 4096.000 BIT_MASK 0x1fff FORMAT "%8.3" ECU_ADDRESS 0x600145B2 /end MEASUREMENT
/begin MEASUREMENT DINH_nrActvInhReas.FId_TWCDPriCatParB1 "Number of active inhibit reasons for the FIds / Number of active inhibit reasons for FId_TWCDPriCatParB1" UWORD DINH_ct_Compu 1 100 -4095.000 4096.000 BIT_MASK 0x1fff FORMAT "%8.3" ECU_ADDRESS 0x600145B4 /end MEASUREMENT
/begin MEASUREMENT DINH_nrActvInhReas.FId_TWCDPriCatVldnB1 "Number of active inhibit reasons for the FIds / Number of active inhibit reasons for FId_TWCDPriCatVldnB1" UWORD DINH_ct_Compu 1 100 -4095.000 4096.000 BIT_MASK 0x1fff FORMAT "%8.3" ECU_ADDRESS 0x600145B6 /end MEASUREMENT
/begin MEASUREMENT DINH_nrActvInhReas.FId_TankPCpv1DteskLoLoadStuckClsd "Number of active inhibit reasons for the FIds / Number of active inhibit reasons for FId_TankPCpv1DteskLoLoadStuckClsd" UWORD DINH_ct_Compu 1 100 -4095.000 4096.000 BIT_MASK 0x1fff FORMAT "%8.3" ECU_ADDRESS 0x600145B8 /end MEASUREMENT
/begin MEASUREMENT DINH_nrActvInhReas.FId_TankPCpv1DteskLoLoadStuckOpen "Number of active inhibit reasons for the FIds / Number of active inhibit reasons for FId_TankPCpv1DteskLoLoadStuckOpen" UWORD DINH_ct_Compu 1 100 -4095.000 4096.000 BIT_MASK 0x1fff FORMAT "%8.3" ECU_ADDRESS 0x600145BA /end MEASUREMENT
/begin MEASUREMENT DINH_nrActvInhReas.FId_TankPSnsrElecChkVld "Number of active inhibit reasons for the FIds / Number of active inhibit reasons for FId_TankPSnsrElecChkVld" UWORD DINH_ct_Compu 1 100 -4095.000 4096.000 BIT_MASK 0x1fff FORMAT "%8.3" ECU_ADDRESS 0x600145BC /end MEASUREMENT
/begin MEASUREMENT DINH_nrActvInhReas.FId_ThrVlvMon "Number of active inhibit reasons for the FIds / Number of active inhibit reasons for FId_ThrVlvMon" UWORD DINH_ct_Compu 1 100 -4095.000 4096.000 BIT_MASK 0x1fff FORMAT "%8.3" ECU_ADDRESS 0x600145BE /end MEASUREMENT
/begin MEASUREMENT DINH_nrActvInhReas.FId_ThrVlvOffsLrnPrmsB1 "Number of active inhibit reasons for the FIds / Number of active inhibit reasons for FId_ThrVlvOffsLrnPrmsB1" UWORD DINH_ct_Compu 1 100 -4095.000 4096.000 BIT_MASK 0x1fff FORMAT "%8.3" ECU_ADDRESS 0x600145C0 /end MEASUREMENT
/begin MEASUREMENT DINH_nrActvInhReas.FId_TiOffTBasdChkFast "Number of active inhibit reasons for the FIds / Number of active inhibit reasons for FId_TiOffTBasdChkFast" UWORD DINH_ct_Compu 1 100 -4095.000 4096.000 BIT_MASK 0x1fff FORMAT "%8.3" ECU_ADDRESS 0x600145C2 /end MEASUREMENT
/begin MEASUREMENT DINH_nrActvInhReas.FId_TiOffTBasdChkSlow "Number of active inhibit reasons for the FIds / Number of active inhibit reasons for FId_TiOffTBasdChkSlow" UWORD DINH_ct_Compu 1 100 -4095.000 4096.000 BIT_MASK 0x1fff FORMAT "%8.3" ECU_ADDRESS 0x600145C4 /end MEASUREMENT
/begin MEASUREMENT DINH_nrActvInhReas.FId_TiOffVdClk "Number of active inhibit reasons for the FIds / Number of active inhibit reasons for FId_TiOffVdClk" UWORD DINH_ct_Compu 1 100 -4095.000 4096.000 BIT_MASK 0x1fff FORMAT "%8.3" ECU_ADDRESS 0x600145C6 /end MEASUREMENT
/begin MEASUREMENT DINH_nrActvInhReas.FId_TqDecelOffsInhb "Number of active inhibit reasons for the FIds / Number of active inhibit reasons for FId_TqDecelOffsInhb" UWORD DINH_ct_Compu 1 100 -4095.000 4096.000 BIT_MASK 0x1fff FORMAT "%8.3" ECU_ADDRESS 0x600145C8 /end MEASUREMENT
/begin MEASUREMENT DINH_nrActvInhReas.FId_TraAddAirCANPtd "Number of active inhibit reasons for the FIds / Number of active inhibit reasons for FId_TraAddAirCANPtd" UWORD DINH_ct_Compu 1 100 -4095.000 4096.000 BIT_MASK 0x1fff FORMAT "%8.3" ECU_ADDRESS 0x600145CA /end MEASUREMENT
/begin MEASUREMENT DINH_nrActvInhReas.FId_TraAddClntCANPtd "Number of active inhibit reasons for the FIds / Number of active inhibit reasons for FId_TraAddClntCANPtd" UWORD DINH_ct_Compu 1 100 -4095.000 4096.000 BIT_MASK 0x1fff FORMAT "%8.3" ECU_ADDRESS 0x600145CC /end MEASUREMENT
/begin MEASUREMENT DINH_nrActvInhReas.FId_TraFwdRvsCluInfo "Number of active inhibit reasons for the FIds / Number of active inhibit reasons for FId_TraFwdRvsCluInfo" UWORD DINH_ct_Compu 1 100 -4095.000 4096.000 BIT_MASK 0x1fff FORMAT "%8.3" ECU_ADDRESS 0x600145CE /end MEASUREMENT
/begin MEASUREMENT DINH_nrActvInhReas.FId_TraGbxNPos "Number of active inhibit reasons for the FIds / Number of active inhibit reasons for FId_TraGbxNPos" UWORD DINH_ct_Compu 1 100 -4095.000 4096.000 BIT_MASK 0x1fff FORMAT "%8.3" ECU_ADDRESS 0x600145D0 /end MEASUREMENT
/begin MEASUREMENT DINH_nrActvInhReas.FId_TraGearInfoCanCom "Number of active inhibit reasons for the FIds / Number of active inhibit reasons for FId_TraGearInfoCanCom" UWORD DINH_ct_Compu 1 100 -4095.000 4096.000 BIT_MASK 0x1fff FORMAT "%8.3" ECU_ADDRESS 0x600145D2 /end MEASUREMENT
/begin MEASUREMENT DINH_nrActvInhReas.FId_TraGearInfoDet "Number of active inhibit reasons for the FIds / Number of active inhibit reasons for FId_TraGearInfoDet" UWORD DINH_ct_Compu 1 100 -4095.000 4096.000 BIT_MASK 0x1fff FORMAT "%8.3" ECU_ADDRESS 0x600145D4 /end MEASUREMENT
/begin MEASUREMENT DINH_nrActvInhReas.FId_TraGearInfoGearShftActv "Number of active inhibit reasons for the FIds / Number of active inhibit reasons for FId_TraGearInfoGearShftActv" UWORD DINH_ct_Compu 1 100 -4095.000 4096.000 BIT_MASK 0x1fff FORMAT "%8.3" ECU_ADDRESS 0x600145D6 /end MEASUREMENT
/begin MEASUREMENT DINH_nrActvInhReas.FId_TraGearInfoInfoCan "Number of active inhibit reasons for the FIds / Number of active inhibit reasons for FId_TraGearInfoInfoCan" UWORD DINH_ct_Compu 1 100 -4095.000 4096.000 BIT_MASK 0x1fff FORMAT "%8.3" ECU_ADDRESS 0x600145D8 /end MEASUREMENT
/begin MEASUREMENT DINH_nrActvInhReas.FId_TraGearInfoLevPos "Number of active inhibit reasons for the FIds / Number of active inhibit reasons for FId_TraGearInfoLevPos" UWORD DINH_ct_Compu 1 100 -4095.000 4096.000 BIT_MASK 0x1fff FORMAT "%8.3" ECU_ADDRESS 0x600145DA /end MEASUREMENT
/begin MEASUREMENT DINH_nrActvInhReas.FId_TraGearInfoLoRng "Number of active inhibit reasons for the FIds / Number of active inhibit reasons for FId_TraGearInfoLoRng" UWORD DINH_ct_Compu 1 100 -4095.000 4096.000 BIT_MASK 0x1fff FORMAT "%8.3" ECU_ADDRESS 0x600145DC /end MEASUREMENT
/begin MEASUREMENT DINH_nrActvInhReas.FId_TraGearInfoRTra "Number of active inhibit reasons for the FIds / Number of active inhibit reasons for FId_TraGearInfoRTra" UWORD DINH_ct_Compu 1 100 -4095.000 4096.000 BIT_MASK 0x1fff FORMAT "%8.3" ECU_ADDRESS 0x600145DE /end MEASUREMENT
/begin MEASUREMENT DINH_nrActvInhReas.FId_TraGearInfoRevGear "Number of active inhibit reasons for the FIds / Number of active inhibit reasons for FId_TraGearInfoRevGear" UWORD DINH_ct_Compu 1 100 -4095.000 4096.000 BIT_MASK 0x1fff FORMAT "%8.3" ECU_ADDRESS 0x600145E0 /end MEASUREMENT
/begin MEASUREMENT DINH_nrActvInhReas.FId_TraGearReq "Number of active inhibit reasons for the FIds / Number of active inhibit reasons for FId_TraGearReq" UWORD DINH_ct_Compu 1 100 -4095.000 4096.000 BIT_MASK 0x1fff FORMAT "%8.3" ECU_ADDRESS 0x600145E2 /end MEASUREMENT
/begin MEASUREMENT DINH_nrActvInhReas.FId_TraNoShftIdctr "Number of active inhibit reasons for the FIds / Number of active inhibit reasons for FId_TraNoShftIdctr" UWORD DINH_ct_Compu 1 100 -4095.000 4096.000 BIT_MASK 0x1fff FORMAT "%8.3" ECU_ADDRESS 0x600145E4 /end MEASUREMENT
/begin MEASUREMENT DINH_nrActvInhReas.FId_TraPrtGearCANPtd "Number of active inhibit reasons for the FIds / Number of active inhibit reasons for FId_TraPrtGearCANPtd" UWORD DINH_ct_Compu 1 100 -4095.000 4096.000 BIT_MASK 0x1fff FORMAT "%8.3" ECU_ADDRESS 0x600145E6 /end MEASUREMENT
/begin MEASUREMENT DINH_nrActvInhReas.FId_TraPrtGearIndpdtProblem "Number of active inhibit reasons for the FIds / Number of active inhibit reasons for FId_TraPrtGearIndpdtProblem" UWORD DINH_ct_Compu 1 100 -4095.000 4096.000 BIT_MASK 0x1fff FORMAT "%8.3" ECU_ADDRESS 0x600145E8 /end MEASUREMENT
/begin MEASUREMENT DINH_nrActvInhReas.FId_TraRPosn "Number of active inhibit reasons for the FIds / Number of active inhibit reasons for FId_TraRPosn" UWORD DINH_ct_Compu 1 100 -4095.000 4096.000 BIT_MASK 0x1fff FORMAT "%8.3" ECU_ADDRESS 0x600145EA /end MEASUREMENT
/begin MEASUREMENT DINH_nrActvInhReas.FId_TraRtnIntfcASTIntv "Number of active inhibit reasons for the FIds / Number of active inhibit reasons for FId_TraRtnIntfcASTIntv" UWORD DINH_ct_Compu 1 100 -4095.000 4096.000 BIT_MASK 0x1fff FORMAT "%8.3" ECU_ADDRESS 0x600145EC /end MEASUREMENT
/begin MEASUREMENT DINH_nrActvInhReas.FId_TraRtnIntfcIdlSetP "Number of active inhibit reasons for the FIds / Number of active inhibit reasons for FId_TraRtnIntfcIdlSetP" UWORD DINH_ct_Compu 1 100 -4095.000 4096.000 BIT_MASK 0x1fff FORMAT "%8.3" ECU_ADDRESS 0x600145EE /end MEASUREMENT
/begin MEASUREMENT DINH_nrActvInhReas.FId_TraRtnIntfcNMaxCan "Number of active inhibit reasons for the FIds / Number of active inhibit reasons for FId_TraRtnIntfcNMaxCan" UWORD DINH_ct_Compu 1 100 -4095.000 4096.000 BIT_MASK 0x1fff FORMAT "%8.3" ECU_ADDRESS 0x600145F0 /end MEASUREMENT
/begin MEASUREMENT DINH_nrActvInhReas.FId_TraRtnIntfcNMaxVel "Number of active inhibit reasons for the FIds / Number of active inhibit reasons for FId_TraRtnIntfcNMaxVel" UWORD DINH_ct_Compu 1 100 -4095.000 4096.000 BIT_MASK 0x1fff FORMAT "%8.3" ECU_ADDRESS 0x600145F2 /end MEASUREMENT
/begin MEASUREMENT DINH_nrActvInhReas.FId_TraTrqRedLmpHmeDec "Number of active inhibit reasons for the FIds / Number of active inhibit reasons for FId_TraTrqRedLmpHmeDec" UWORD DINH_ct_Compu 1 100 -4095.000 4096.000 BIT_MASK 0x1fff FORMAT "%8.3" ECU_ADDRESS 0x600145F4 /end MEASUREMENT
/begin MEASUREMENT DINH_nrActvInhReas.FId_TraTrqRedLmpHmeInc "Number of active inhibit reasons for the FIds / Number of active inhibit reasons for FId_TraTrqRedLmpHmeInc" UWORD DINH_ct_Compu 1 100 -4095.000 4096.000 BIT_MASK 0x1fff FORMAT "%8.3" ECU_ADDRESS 0x600145F6 /end MEASUREMENT
/begin MEASUREMENT DINH_nrActvInhReas.FId_TraTrqRedPTCanErr "Number of active inhibit reasons for the FIds / Number of active inhibit reasons for FId_TraTrqRedPTCanErr" UWORD DINH_ct_Compu 1 100 -4095.000 4096.000 BIT_MASK 0x1fff FORMAT "%8.3" ECU_ADDRESS 0x600145F8 /end MEASUREMENT
/begin MEASUREMENT DINH_nrActvInhReas.FId_TraTrqRedTIIntvDes "Number of active inhibit reasons for the FIds / Number of active inhibit reasons for FId_TraTrqRedTIIntvDes" UWORD DINH_ct_Compu 1 100 -4095.000 4096.000 BIT_MASK 0x1fff FORMAT "%8.3" ECU_ADDRESS 0x600145FA /end MEASUREMENT
/begin MEASUREMENT DINH_nrActvInhReas.FId_TraTrqRedTIIntvLead "Number of active inhibit reasons for the FIds / Number of active inhibit reasons for FId_TraTrqRedTIIntvLead" UWORD DINH_ct_Compu 1 100 -4095.000 4096.000 BIT_MASK 0x1fff FORMAT "%8.3" ECU_ADDRESS 0x600145FC /end MEASUREMENT
/begin MEASUREMENT DINH_nrActvInhReas.FId_TraTrqRedTSCIntvDes "Number of active inhibit reasons for the FIds / Number of active inhibit reasons for FId_TraTrqRedTSCIntvDes" UWORD DINH_ct_Compu 1 100 -4095.000 4096.000 BIT_MASK 0x1fff FORMAT "%8.3" ECU_ADDRESS 0x600145FE /end MEASUREMENT
/begin MEASUREMENT DINH_nrActvInhReas.FId_TraTrqRedTSCIntvLead "Number of active inhibit reasons for the FIds / Number of active inhibit reasons for FId_TraTrqRedTSCIntvLead" UWORD DINH_ct_Compu 1 100 -4095.000 4096.000 BIT_MASK 0x1fff FORMAT "%8.3" ECU_ADDRESS 0x60014600 /end MEASUREMENT
/begin MEASUREMENT DINH_nrActvInhReas.FId_TraTrsmTypHw "Number of active inhibit reasons for the FIds / Number of active inhibit reasons for FId_TraTrsmTypHw" UWORD DINH_ct_Compu 1 100 -4095.000 4096.000 BIT_MASK 0x1fff FORMAT "%8.3" ECU_ADDRESS 0x60014602 /end MEASUREMENT
/begin MEASUREMENT DINH_nrActvInhReas.FId_TranIdleDes "Number of active inhibit reasons for the FIds / Number of active inhibit reasons for FId_TranIdleDes" UWORD DINH_ct_Compu 1 100 -4095.000 4096.000 BIT_MASK 0x1fff FORMAT "%8.3" ECU_ADDRESS 0x60014604 /end MEASUREMENT
/begin MEASUREMENT DINH_nrActvInhReas.FId_UEGOHeatgUpRglS1B1 "Number of active inhibit reasons for the FIds / Number of active inhibit reasons for FId_UEGOHeatgUpRglS1B1" UWORD DINH_ct_Compu 1 100 -4095.000 4096.000 BIT_MASK 0x1fff FORMAT "%8.3" ECU_ADDRESS 0x60014606 /end MEASUREMENT
/begin MEASUREMENT DINH_nrActvInhReas.FId_UEGOHeatrCtrlS1B1 "Number of active inhibit reasons for the FIds / Number of active inhibit reasons for FId_UEGOHeatrCtrlS1B1" UWORD DINH_ct_Compu 1 100 -4095.000 4096.000 BIT_MASK 0x1fff FORMAT "%8.3" ECU_ADDRESS 0x60014608 /end MEASUREMENT
/begin MEASUREMENT DINH_nrActvInhReas.FId_UEGOHeatrPrfmncDiagRelsS1B1 "Number of active inhibit reasons for the FIds / Number of active inhibit reasons for FId_UEGOHeatrPrfmncDiagRelsS1B1" UWORD DINH_ct_Compu 1 100 -4095.000 4096.000 BIT_MASK 0x1fff FORMAT "%8.3" ECU_ADDRESS 0x6001460A /end MEASUREMENT
/begin MEASUREMENT DINH_nrActvInhReas.FId_UEGOHeatrPwrStgDiagRelsS1B1 "Number of active inhibit reasons for the FIds / Number of active inhibit reasons for FId_UEGOHeatrPwrStgDiagRelsS1B1" UWORD DINH_ct_Compu 1 100 -4095.000 4096.000 BIT_MASK 0x1fff FORMAT "%8.3" ECU_ADDRESS 0x6001460C /end MEASUREMENT
/begin MEASUREMENT DINH_nrActvInhReas.FId_UEGOModCtrlRelsS1B1 "Number of active inhibit reasons for the FIds / Number of active inhibit reasons for FId_UEGOModCtrlRelsS1B1" UWORD DINH_ct_Compu 1 100 -4095.000 4096.000 BIT_MASK 0x1fff FORMAT "%8.3" ECU_ADDRESS 0x6001460E /end MEASUREMENT
/begin MEASUREMENT DINH_nrActvInhReas.FId_UEGOStrtDiagInhRprtErrS1B1 "Number of active inhibit reasons for the FIds / Number of active inhibit reasons for FId_UEGOStrtDiagInhRprtErrS1B1" UWORD DINH_ct_Compu 1 100 -4095.000 4096.000 BIT_MASK 0x1fff FORMAT "%8.3" ECU_ADDRESS 0x60014610 /end MEASUREMENT
/begin MEASUREMENT DINH_nrActvInhReas.FId_UEGOStrtDiagRelsS1B1 "Number of active inhibit reasons for the FIds / Number of active inhibit reasons for FId_UEGOStrtDiagRelsS1B1" UWORD DINH_ct_Compu 1 100 -4095.000 4096.000 BIT_MASK 0x1fff FORMAT "%8.3" ECU_ADDRESS 0x60014612 /end MEASUREMENT
/begin MEASUREMENT DINH_nrActvInhReas.FId_UEGOTCeramicRelsS1B1 "Number of active inhibit reasons for the FIds / Number of active inhibit reasons for FId_UEGOTCeramicRelsS1B1" UWORD DINH_ct_Compu 1 100 -4095.000 4096.000 BIT_MASK 0x1fff FORMAT "%8.3" ECU_ADDRESS 0x60014614 /end MEASUREMENT
/begin MEASUREMENT DINH_nrActvInhReas.FId_UegoDiagRelsBattSplyOk "Number of active inhibit reasons for the FIds / Number of active inhibit reasons for FId_UegoDiagRelsBattSplyOk" UWORD DINH_ct_Compu 1 100 -4095.000 4096.000 BIT_MASK 0x1fff FORMAT "%8.3" ECU_ADDRESS 0x60014616 /end MEASUREMENT
/begin MEASUREMENT DINH_nrActvInhReas.FId_UegoDiagSigEcuAsicS1B1 "Number of active inhibit reasons for the FIds / Number of active inhibit reasons for FId_UegoDiagSigEcuAsicS1B1" UWORD DINH_ct_Compu 1 100 -4095.000 4096.000 BIT_MASK 0x1fff FORMAT "%8.3" ECU_ADDRESS 0x60014618 /end MEASUREMENT
/begin MEASUREMENT DINH_nrActvInhReas.FId_UegoDiagSigEcuComS1B1 "Number of active inhibit reasons for the FIds / Number of active inhibit reasons for FId_UegoDiagSigEcuComS1B1" UWORD DINH_ct_Compu 1 100 -4095.000 4096.000 BIT_MASK 0x1fff FORMAT "%8.3" ECU_ADDRESS 0x6001461A /end MEASUREMENT
/begin MEASUREMENT DINH_nrActvInhReas.FId_UegoDiagSigOperPlausS1B1 "Number of active inhibit reasons for the FIds / Number of active inhibit reasons for FId_UegoDiagSigOperPlausS1B1" UWORD DINH_ct_Compu 1 100 -4095.000 4096.000 BIT_MASK 0x1fff FORMAT "%8.3" ECU_ADDRESS 0x6001461C /end MEASUREMENT
/begin MEASUREMENT DINH_nrActvInhReas.FId_UegoDiagSigSnsrS1B1 "Number of active inhibit reasons for the FIds / Number of active inhibit reasons for FId_UegoDiagSigSnsrS1B1" UWORD DINH_ct_Compu 1 100 -4095.000 4096.000 BIT_MASK 0x1fff FORMAT "%8.3" ECU_ADDRESS 0x6001461E /end MEASUREMENT
/begin MEASUREMENT DINH_nrActvInhReas.FId_UegoDiagSigWireOlS1B1 "Number of active inhibit reasons for the FIds / Number of active inhibit reasons for FId_UegoDiagSigWireOlS1B1" UWORD DINH_ct_Compu 1 100 -4095.000 4096.000 BIT_MASK 0x1fff FORMAT "%8.3" ECU_ADDRESS 0x60014620 /end MEASUREMENT
/begin MEASUREMENT DINH_nrActvInhReas.FId_UegoDiagSigWireScS1B1 "Number of active inhibit reasons for the FIds / Number of active inhibit reasons for FId_UegoDiagSigWireScS1B1" UWORD DINH_ct_Compu 1 100 -4095.000 4096.000 BIT_MASK 0x1fff FORMAT "%8.3" ECU_ADDRESS 0x60014622 /end MEASUREMENT
/begin MEASUREMENT DINH_nrActvInhReas.FId_UegoDiagSigWireScTstdS1B1 "Number of active inhibit reasons for the FIds / Number of active inhibit reasons for FId_UegoDiagSigWireScTstdS1B1" UWORD DINH_ct_Compu 1 100 -4095.000 4096.000 BIT_MASK 0x1fff FORMAT "%8.3" ECU_ADDRESS 0x60014624 /end MEASUREMENT
/begin MEASUREMENT DINH_nrActvInhReas.FId_UegoInhbOperRelsS1B1 "Number of active inhibit reasons for the FIds / Number of active inhibit reasons for FId_UegoInhbOperRelsS1B1" UWORD DINH_ct_Compu 1 100 -4095.000 4096.000 BIT_MASK 0x1fff FORMAT "%8.3" ECU_ADDRESS 0x60014626 /end MEASUREMENT
/begin MEASUREMENT DINH_nrActvInhReas.FId_UegoO2HiPrcsnS1B1 "Number of active inhibit reasons for the FIds / Number of active inhibit reasons for FId_UegoO2HiPrcsnS1B1" UWORD DINH_ct_Compu 1 100 -4095.000 4096.000 BIT_MASK 0x1fff FORMAT "%8.3" ECU_ADDRESS 0x60014628 /end MEASUREMENT
/begin MEASUREMENT DINH_nrActvInhReas.FId_UegoO2PlausErrS1B1 "Number of active inhibit reasons for the FIds / Number of active inhibit reasons for FId_UegoO2PlausErrS1B1" UWORD DINH_ct_Compu 1 100 -4095.000 4096.000 BIT_MASK 0x1fff FORMAT "%8.3" ECU_ADDRESS 0x6001462A /end MEASUREMENT
/begin MEASUREMENT DINH_nrActvInhReas.FId_UegoO2VldS1B1 "Number of active inhibit reasons for the FIds / Number of active inhibit reasons for FId_UegoO2VldS1B1" UWORD DINH_ct_Compu 1 100 -4095.000 4096.000 BIT_MASK 0x1fff FORMAT "%8.3" ECU_ADDRESS 0x6001462C /end MEASUREMENT
/begin MEASUREMENT DINH_nrActvInhReas.FId_UegoOperPlausBattSplyOk "Number of active inhibit reasons for the FIds / Number of active inhibit reasons for FId_UegoOperPlausBattSplyOk" UWORD DINH_ct_Compu 1 100 -4095.000 4096.000 BIT_MASK 0x1fff FORMAT "%8.3" ECU_ADDRESS 0x6001462E /end MEASUREMENT
/begin MEASUREMENT DINH_nrActvInhReas.FId_UegoPlausErrHndlg "Number of active inhibit reasons for the FIds / Number of active inhibit reasons for FId_UegoPlausErrHndlg" UWORD DINH_ct_Compu 1 100 -4095.000 4096.000 BIT_MASK 0x1fff FORMAT "%8.3" ECU_ADDRESS 0x60014630 /end MEASUREMENT
/begin MEASUREMENT DINH_nrActvInhReas.FId_VMSIDCSRmpShOff "Number of active inhibit reasons for the FIds / Number of active inhibit reasons for FId_VMSIDCSRmpShOff" UWORD DINH_ct_Compu 1 100 -4095.000 4096.000 BIT_MASK 0x1fff FORMAT "%8.3" ECU_ADDRESS 0x60014632 /end MEASUREMENT
/begin MEASUREMENT DINH_nrActvInhReas.FId_VMSIDCSShOff "Number of active inhibit reasons for the FIds / Number of active inhibit reasons for FId_VMSIDCSShOff" UWORD DINH_ct_Compu 1 100 -4095.000 4096.000 BIT_MASK 0x1fff FORMAT "%8.3" ECU_ADDRESS 0x60014634 /end MEASUREMENT
/begin MEASUREMENT DINH_nrActvInhReas.FId_VMSITCSRmpShOff "Number of active inhibit reasons for the FIds / Number of active inhibit reasons for FId_VMSITCSRmpShOff" UWORD DINH_ct_Compu 1 100 -4095.000 4096.000 BIT_MASK 0x1fff FORMAT "%8.3" ECU_ADDRESS 0x60014636 /end MEASUREMENT
/begin MEASUREMENT DINH_nrActvInhReas.FId_VMSITCSShOff "Number of active inhibit reasons for the FIds / Number of active inhibit reasons for FId_VMSITCSShOff" UWORD DINH_ct_Compu 1 100 -4095.000 4096.000 BIT_MASK 0x1fff FORMAT "%8.3" ECU_ADDRESS 0x60014638 /end MEASUREMENT
/begin MEASUREMENT DINH_nrActvInhReas.FId_VSACANErr "Number of active inhibit reasons for the FIds / Number of active inhibit reasons for FId_VSACANErr" UWORD DINH_ct_Compu 1 100 -4095.000 4096.000 BIT_MASK 0x1fff FORMAT "%8.3" ECU_ADDRESS 0x6001463A /end MEASUREMENT
/begin MEASUREMENT DINH_nrActvInhReas.FId_VehStcACGFailr "Number of active inhibit reasons for the FIds / Number of active inhibit reasons for FId_VehStcACGFailr" UWORD DINH_ct_Compu 1 100 -4095.000 4096.000 BIT_MASK 0x1fff FORMAT "%8.3" ECU_ADDRESS 0x6001463C /end MEASUREMENT
/begin MEASUREMENT DINH_nrActvInhReas.FId_VehStcBattMngFailr "Number of active inhibit reasons for the FIds / Number of active inhibit reasons for FId_VehStcBattMngFailr" UWORD DINH_ct_Compu 1 100 -4095.000 4096.000 BIT_MASK 0x1fff FORMAT "%8.3" ECU_ADDRESS 0x6001463E /end MEASUREMENT
/begin MEASUREMENT DINH_nrActvInhReas.FId_VehStcDCDCFailr "Number of active inhibit reasons for the FIds / Number of active inhibit reasons for FId_VehStcDCDCFailr" UWORD DINH_ct_Compu 1 100 -4095.000 4096.000 BIT_MASK 0x1fff FORMAT "%8.3" ECU_ADDRESS 0x60014640 /end MEASUREMENT
/begin MEASUREMENT DINH_nrActvInhReas.FId_VehStcEBSFailr "Number of active inhibit reasons for the FIds / Number of active inhibit reasons for FId_VehStcEBSFailr" UWORD DINH_ct_Compu 1 100 -4095.000 4096.000 BIT_MASK 0x1fff FORMAT "%8.3" ECU_ADDRESS 0x60014642 /end MEASUREMENT
/begin MEASUREMENT DINH_nrActvInhReas.FId_VehStcMisf "Number of active inhibit reasons for the FIds / Number of active inhibit reasons for FId_VehStcMisf" UWORD DINH_ct_Compu 1 100 -4095.000 4096.000 BIT_MASK 0x1fff FORMAT "%8.3" ECU_ADDRESS 0x60014644 /end MEASUREMENT
/begin MEASUREMENT DINH_nrActvInhReas.FId_VehStcMtrComFailr "Number of active inhibit reasons for the FIds / Number of active inhibit reasons for FId_VehStcMtrComFailr" UWORD DINH_ct_Compu 1 100 -4095.000 4096.000 BIT_MASK 0x1fff FORMAT "%8.3" ECU_ADDRESS 0x60014646 /end MEASUREMENT
/begin MEASUREMENT DINH_nrActvInhReas.FId_VehStcNVMFailr "Number of active inhibit reasons for the FIds / Number of active inhibit reasons for FId_VehStcNVMFailr" UWORD DINH_ct_Compu 1 100 -4095.000 4096.000 BIT_MASK 0x1fff FORMAT "%8.3" ECU_ADDRESS 0x60014648 /end MEASUREMENT
/begin MEASUREMENT DINH_nrActvInhReas.FId_VehVCANFrzVal "Number of active inhibit reasons for the FIds / Number of active inhibit reasons for FId_VehVCANFrzVal" UWORD DINH_ct_Compu 1 100 -4095.000 4096.000 BIT_MASK 0x1fff FORMAT "%8.3" ECU_ADDRESS 0x6001464A /end MEASUREMENT
/begin MEASUREMENT DINH_nrActvInhReas.FId_VehVCANReplVal "Number of active inhibit reasons for the FIds / Number of active inhibit reasons for FId_VehVCANReplVal" UWORD DINH_ct_Compu 1 100 -4095.000 4096.000 BIT_MASK 0x1fff FORMAT "%8.3" ECU_ADDRESS 0x6001464C /end MEASUREMENT
/begin MEASUREMENT DINH_nrActvInhReas.FId_VehVCanSafeFrzVal "Number of active inhibit reasons for the FIds / Number of active inhibit reasons for FId_VehVCanSafeFrzVal" UWORD DINH_ct_Compu 1 100 -4095.000 4096.000 BIT_MASK 0x1fff FORMAT "%8.3" ECU_ADDRESS 0x6001464E /end MEASUREMENT
/begin MEASUREMENT DINH_nrActvInhReas.FId_VehVCanSafeReplVal "Number of active inhibit reasons for the FIds / Number of active inhibit reasons for FId_VehVCanSafeReplVal" UWORD DINH_ct_Compu 1 100 -4095.000 4096.000 BIT_MASK 0x1fff FORMAT "%8.3" ECU_ADDRESS 0x60014650 /end MEASUREMENT
/begin MEASUREMENT DINH_nrActvInhReas.FId_VehVCom "Number of active inhibit reasons for the FIds / Number of active inhibit reasons for FId_VehVCom" UWORD DINH_ct_Compu 1 100 -4095.000 4096.000 BIT_MASK 0x1fff FORMAT "%8.3" ECU_ADDRESS 0x60014652 /end MEASUREMENT
/begin MEASUREMENT DINH_nrActvInhReas.FId_VehVExcdLim "Number of active inhibit reasons for the FIds / Number of active inhibit reasons for FId_VehVExcdLim" UWORD DINH_ct_Compu 1 100 -4095.000 4096.000 BIT_MASK 0x1fff FORMAT "%8.3" ECU_ADDRESS 0x60014654 /end MEASUREMENT
/begin MEASUREMENT DINH_nrActvInhReas.FId_VehVFrzVal "Number of active inhibit reasons for the FIds / Number of active inhibit reasons for FId_VehVFrzVal" UWORD DINH_ct_Compu 1 100 -4095.000 4096.000 BIT_MASK 0x1fff FORMAT "%8.3" ECU_ADDRESS 0x60014656 /end MEASUREMENT
/begin MEASUREMENT DINH_nrActvInhReas.FId_VehVNCSnsrElecFailr "Number of active inhibit reasons for the FIds / Number of active inhibit reasons for FId_VehVNCSnsrElecFailr" UWORD DINH_ct_Compu 1 100 -4095.000 4096.000 BIT_MASK 0x1fff FORMAT "%8.3" ECU_ADDRESS 0x60014658 /end MEASUREMENT
/begin MEASUREMENT DINH_nrActvInhReas.FId_VehVOBDFrzVal "Number of active inhibit reasons for the FIds / Number of active inhibit reasons for FId_VehVOBDFrzVal" UWORD DINH_ct_Compu 1 100 -4095.000 4096.000 BIT_MASK 0x1fff FORMAT "%8.3" ECU_ADDRESS 0x6001465A /end MEASUREMENT
/begin MEASUREMENT DINH_nrActvInhReas.FId_VehVOBDReplVal "Number of active inhibit reasons for the FIds / Number of active inhibit reasons for FId_VehVOBDReplVal" UWORD DINH_ct_Compu 1 100 -4095.000 4096.000 BIT_MASK 0x1fff FORMAT "%8.3" ECU_ADDRESS 0x6001465C /end MEASUREMENT
/begin MEASUREMENT DINH_nrActvInhReas.FId_VehVOutCanErr "Number of active inhibit reasons for the FIds / Number of active inhibit reasons for FId_VehVOutCanErr" UWORD DINH_ct_Compu 1 100 -4095.000 4096.000 BIT_MASK 0x1fff FORMAT "%8.3" ECU_ADDRESS 0x6001465E /end MEASUREMENT
/begin MEASUREMENT DINH_nrActvInhReas.FId_VehVPWMFrzVal "Number of active inhibit reasons for the FIds / Number of active inhibit reasons for FId_VehVPWMFrzVal" UWORD DINH_ct_Compu 1 100 -4095.000 4096.000 BIT_MASK 0x1fff FORMAT "%8.3" ECU_ADDRESS 0x60014660 /end MEASUREMENT
/begin MEASUREMENT DINH_nrActvInhReas.FId_VehVPWMReplVal "Number of active inhibit reasons for the FIds / Number of active inhibit reasons for FId_VehVPWMReplVal" UWORD DINH_ct_Compu 1 100 -4095.000 4096.000 BIT_MASK 0x1fff FORMAT "%8.3" ECU_ADDRESS 0x60014662 /end MEASUREMENT
/begin MEASUREMENT DINH_nrActvInhReas.FId_VehVPhysRng "Number of active inhibit reasons for the FIds / Number of active inhibit reasons for FId_VehVPhysRng" UWORD DINH_ct_Compu 1 100 -4095.000 4096.000 BIT_MASK 0x1fff FORMAT "%8.3" ECU_ADDRESS 0x60014664 /end MEASUREMENT
/begin MEASUREMENT DINH_nrActvInhReas.FId_VehVPlaus "Number of active inhibit reasons for the FIds / Number of active inhibit reasons for FId_VehVPlaus" UWORD DINH_ct_Compu 1 100 -4095.000 4096.000 BIT_MASK 0x1fff FORMAT "%8.3" ECU_ADDRESS 0x60014666 /end MEASUREMENT
/begin MEASUREMENT DINH_nrActvInhReas.FId_VehVPlausCan "Number of active inhibit reasons for the FIds / Number of active inhibit reasons for FId_VehVPlausCan" UWORD DINH_ct_Compu 1 100 -4095.000 4096.000 BIT_MASK 0x1fff FORMAT "%8.3" ECU_ADDRESS 0x60014668 /end MEASUREMENT
/begin MEASUREMENT DINH_nrActvInhReas.FId_VehVPlausFco "Number of active inhibit reasons for the FIds / Number of active inhibit reasons for FId_VehVPlausFco" UWORD DINH_ct_Compu 1 100 -4095.000 4096.000 BIT_MASK 0x1fff FORMAT "%8.3" ECU_ADDRESS 0x6001466A /end MEASUREMENT
/begin MEASUREMENT DINH_nrActvInhReas.FId_VehVPlausPwr "Number of active inhibit reasons for the FIds / Number of active inhibit reasons for FId_VehVPlausPwr" UWORD DINH_ct_Compu 1 100 -4095.000 4096.000 BIT_MASK 0x1fff FORMAT "%8.3" ECU_ADDRESS 0x6001466C /end MEASUREMENT
/begin MEASUREMENT DINH_nrActvInhReas.FId_VehVPlausV2N "Number of active inhibit reasons for the FIds / Number of active inhibit reasons for FId_VehVPlausV2N" UWORD DINH_ct_Compu 1 100 -4095.000 4096.000 BIT_MASK 0x1fff FORMAT "%8.3" ECU_ADDRESS 0x6001466E /end MEASUREMENT
/begin MEASUREMENT DINH_nrActvInhReas.FId_VehVReplVal "Number of active inhibit reasons for the FIds / Number of active inhibit reasons for FId_VehVReplVal" UWORD DINH_ct_Compu 1 100 -4095.000 4096.000 BIT_MASK 0x1fff FORMAT "%8.3" ECU_ADDRESS 0x60014670 /end MEASUREMENT
/begin MEASUREMENT DINH_nrActvInhReas.FId_VehVSigCan "Number of active inhibit reasons for the FIds / Number of active inhibit reasons for FId_VehVSigCan" UWORD DINH_ct_Compu 1 100 -4095.000 4096.000 BIT_MASK 0x1fff FORMAT "%8.3" ECU_ADDRESS 0x60014672 /end MEASUREMENT
/begin MEASUREMENT DINH_nrActvInhReas.FId_VehVSigCanSafe "Number of active inhibit reasons for the FIds / Number of active inhibit reasons for FId_VehVSigCanSafe" UWORD DINH_ct_Compu 1 100 -4095.000 4096.000 BIT_MASK 0x1fff FORMAT "%8.3" ECU_ADDRESS 0x60014674 /end MEASUREMENT
/begin MEASUREMENT DINH_nrActvInhReas.FId_VehVSngWhlCanFrzVal "Number of active inhibit reasons for the FIds / Number of active inhibit reasons for FId_VehVSngWhlCanFrzVal" UWORD DINH_ct_Compu 1 100 -4095.000 4096.000 BIT_MASK 0x1fff FORMAT "%8.3" ECU_ADDRESS 0x60014676 /end MEASUREMENT
/begin MEASUREMENT DINH_nrActvInhReas.FId_VehVSngWhlCanReplVal "Number of active inhibit reasons for the FIds / Number of active inhibit reasons for FId_VehVSngWhlCanReplVal" UWORD DINH_ct_Compu 1 100 -4095.000 4096.000 BIT_MASK 0x1fff FORMAT "%8.3" ECU_ADDRESS 0x60014678 /end MEASUREMENT
/begin MEASUREMENT DINH_nrActvInhReas.FId_VehVSnsrARngHi "Number of active inhibit reasons for the FIds / Number of active inhibit reasons for FId_VehVSnsrARngHi" UWORD DINH_ct_Compu 1 100 -4095.000 4096.000 BIT_MASK 0x1fff FORMAT "%8.3" ECU_ADDRESS 0x6001467A /end MEASUREMENT
/begin MEASUREMENT DINH_nrActvInhReas.FId_VehVSnsrBRngHi "Number of active inhibit reasons for the FIds / Number of active inhibit reasons for FId_VehVSnsrBRngHi" UWORD DINH_ct_Compu 1 100 -4095.000 4096.000 BIT_MASK 0x1fff FORMAT "%8.3" ECU_ADDRESS 0x6001467C /end MEASUREMENT
/begin MEASUREMENT DINH_nrActvInhReas.FId_VehVSpdRtyDiag "Number of active inhibit reasons for the FIds / Number of active inhibit reasons for FId_VehVSpdRtyDiag" UWORD DINH_ct_Compu 1 100 -4095.000 4096.000 BIT_MASK 0x1fff FORMAT "%8.3" ECU_ADDRESS 0x6001467E /end MEASUREMENT
/begin MEASUREMENT DINH_nrActvInhReas.FId_VehVSpdSnsrAElecFailr "Number of active inhibit reasons for the FIds / Number of active inhibit reasons for FId_VehVSpdSnsrAElecFailr" UWORD DINH_ct_Compu 1 100 -4095.000 4096.000 BIT_MASK 0x1fff FORMAT "%8.3" ECU_ADDRESS 0x60014680 /end MEASUREMENT
/begin MEASUREMENT DINH_nrActvInhReas.FId_VehVSpdSnsrBElecFailr "Number of active inhibit reasons for the FIds / Number of active inhibit reasons for FId_VehVSpdSnsrBElecFailr" UWORD DINH_ct_Compu 1 100 -4095.000 4096.000 BIT_MASK 0x1fff FORMAT "%8.3" ECU_ADDRESS 0x60014682 /end MEASUREMENT
/begin MEASUREMENT DINH_nrActvInhReas.FId_VehVvFLWhlSpd "Number of active inhibit reasons for the FIds / Number of active inhibit reasons for FId_VehVvFLWhlSpd" UWORD DINH_ct_Compu 1 100 -4095.000 4096.000 BIT_MASK 0x1fff FORMAT "%8.3" ECU_ADDRESS 0x60014684 /end MEASUREMENT
/begin MEASUREMENT DINH_nrActvInhReas.FId_VehVvFRWhlSpd "Number of active inhibit reasons for the FIds / Number of active inhibit reasons for FId_VehVvFRWhlSpd" UWORD DINH_ct_Compu 1 100 -4095.000 4096.000 BIT_MASK 0x1fff FORMAT "%8.3" ECU_ADDRESS 0x60014686 /end MEASUREMENT
/begin MEASUREMENT DINH_nrActvInhReas.FId_VehVvRLWhlSpd "Number of active inhibit reasons for the FIds / Number of active inhibit reasons for FId_VehVvRLWhlSpd" UWORD DINH_ct_Compu 1 100 -4095.000 4096.000 BIT_MASK 0x1fff FORMAT "%8.3" ECU_ADDRESS 0x60014688 /end MEASUREMENT
/begin MEASUREMENT DINH_nrActvInhReas.FId_VehVvRRWhlSpd "Number of active inhibit reasons for the FIds / Number of active inhibit reasons for FId_VehVvRRWhlSpd" UWORD DINH_ct_Compu 1 100 -4095.000 4096.000 BIT_MASK 0x1fff FORMAT "%8.3" ECU_ADDRESS 0x6001468A /end MEASUREMENT
/begin MEASUREMENT DINH_nrActvInhReas.FId_VldtLamDynS1B1 "Number of active inhibit reasons for the FIds / Number of active inhibit reasons for FId_VldtLamDynS1B1" UWORD DINH_ct_Compu 1 100 -4095.000 4096.000 BIT_MASK 0x1fff FORMAT "%8.3" ECU_ADDRESS 0x6001468C /end MEASUREMENT
/begin MEASUREMENT DINH_nrActvInhReas.FId_VlvLftFbIntkOilPSnsr11SRC "Number of active inhibit reasons for the FIds / Number of active inhibit reasons for FId_VlvLftFbIntkOilPSnsr11SRC" UWORD DINH_ct_Compu 1 100 -4095.000 4096.000 BIT_MASK 0x1fff FORMAT "%8.3" ECU_ADDRESS 0x6001468E /end MEASUREMENT
/begin MEASUREMENT DINH_nrActvInhReas.FId_VlvLftFbSwtIntk11Diag "Number of active inhibit reasons for the FIds / Number of active inhibit reasons for FId_VlvLftFbSwtIntk11Diag" UWORD DINH_ct_Compu 1 100 -4095.000 4096.000 BIT_MASK 0x1fff FORMAT "%8.3" ECU_ADDRESS 0x60014690 /end MEASUREMENT
/begin MEASUREMENT DINH_nrActvInhReas.FId_ZGLZSR "Number of active inhibit reasons for the FIds / Number of active inhibit reasons for FId_ZGLZSR" UWORD DINH_ct_Compu 1 100 -4095.000 4096.000 BIT_MASK 0x1fff FORMAT "%8.3" ECU_ADDRESS 0x60014692 /end MEASUREMENT
/begin MEASUREMENT DINH_nrActvInhReas.FId_airIntkFltSnsrKnkPrtnIgn "Number of active inhibit reasons for the FIds / Number of active inhibit reasons for FId_airIntkFltSnsrKnkPrtnIgn" UWORD DINH_ct_Compu 1 100 -4095.000 4096.000 BIT_MASK 0x1fff FORMAT "%8.3" ECU_ADDRESS 0x60014694 /end MEASUREMENT
/begin MEASUREMENT DINH_nrActvInhReas.FId_ctrladpncvo "Number of active inhibit reasons for the FIds / Number of active inhibit reasons for FId_ctrladpncvo" UWORD DINH_ct_Compu 1 100 -4095.000 4096.000 BIT_MASK 0x1fff FORMAT "%8.3" ECU_ADDRESS 0x60014696 /end MEASUREMENT
/begin MEASUREMENT DINH_nrActvInhReas.FId_stChkChgnSys "Number of active inhibit reasons for the FIds / Number of active inhibit reasons for FId_stChkChgnSys" UWORD DINH_ct_Compu 1 100 -4095.000 4096.000 BIT_MASK 0x1fff FORMAT "%8.3" ECU_ADDRESS 0x60014698 /end MEASUREMENT
/begin MEASUREMENT DINH_nrActvInhReas.FId_stChkChgnSys2DC "Number of active inhibit reasons for the FIds / Number of active inhibit reasons for FId_stChkChgnSys2DC" UWORD DINH_ct_Compu 1 100 -4095.000 4096.000 BIT_MASK 0x1fff FORMAT "%8.3" ECU_ADDRESS 0x6001469A /end MEASUREMENT
/begin MEASUREMENT DINH_nrActvInhReas.FId_tFltSnsrKnkPrtnIgn "Number of active inhibit reasons for the FIds / Number of active inhibit reasons for FId_tFltSnsrKnkPrtnIgn" UWORD DINH_ct_Compu 1 100 -4095.000 4096.000 BIT_MASK 0x1fff FORMAT "%8.3" ECU_ADDRESS 0x6001469C /end MEASUREMENT
/begin MEASUREMENT DINH_stClctFId_mp "Collected states of all function identifiers, if the bit is 1 the FId is inhibited" UWORD DFC_OneToOne 1 100 0.00 65535.00 FORMAT "%8.2" ARRAY_SIZE 61 ECU_ADDRESS 0x70009D76 /end MEASUREMENT
/begin MEASUREMENT DINH_stFId.FId_Unused "Inhibit Status of FIds / " UWORD DFC_OneToOne 1 100 0.00 65535.00 FORMAT "%8.2" ECU_ADDRESS 0x60013F0C /end MEASUREMENT
/begin MEASUREMENT DINH_stFId.FID_AFRA "Inhibit Status of FIds / Status of function identifier FID_AFRA" UWORD DFC_OneToOne 1 100 0.00 65535.00 FORMAT "%8.2" ECU_ADDRESS 0x60013F0E /end MEASUREMENT
/begin MEASUREMENT DINH_stFId.FID_AORA "Inhibit Status of FIds / Status of function identifier FID_AORA" UWORD DFC_OneToOne 1 100 0.00 65535.00 FORMAT "%8.2" ECU_ADDRESS 0x60013F10 /end MEASUREMENT
/begin MEASUREMENT DINH_stFId.FID_ATEH "Inhibit Status of FIds / Status of function identifier FID_ATEH" UWORD DFC_OneToOne 1 100 0.00 65535.00 FORMAT "%8.2" ECU_ADDRESS 0x60013F12 /end MEASUREMENT
/begin MEASUREMENT DINH_stFId.FID_ATEL "Inhibit Status of FIds / Status of function identifier FID_ATEL" UWORD DFC_OneToOne 1 100 0.00 65535.00 FORMAT "%8.2" ECU_ADDRESS 0x60013F14 /end MEASUREMENT
/begin MEASUREMENT DINH_stFId.FID_ATEN "Inhibit Status of FIds / Status of function identifier FID_ATEN" UWORD DFC_OneToOne 1 100 0.00 65535.00 FORMAT "%8.2" ECU_ADDRESS 0x60013F16 /end MEASUREMENT
/begin MEASUREMENT DINH_stFId.FID_ATLDI "Inhibit Status of FIds / Status of function identifier FID_ATLDI" UWORD DFC_OneToOne 1 100 0.00 65535.00 FORMAT "%8.2" ECU_ADDRESS 0x60013F18 /end MEASUREMENT
/begin MEASUREMENT DINH_stFId.FID_ATLDO "Inhibit Status of FIds / Status of function identifier FID_ATLDO" UWORD DFC_OneToOne 1 100 0.00 65535.00 FORMAT "%8.2" ECU_ADDRESS 0x60013F1A /end MEASUREMENT
/begin MEASUREMENT DINH_stFId.FID_BEONV "Inhibit Status of FIds / Status of function identifier FID_BEONV" UWORD DFC_OneToOne 1 100 0.00 65535.00 FORMAT "%8.2" ECU_ADDRESS 0x60013F1C /end MEASUREMENT
/begin MEASUREMENT DINH_stFId.FId_EGSDCmnSeg1B1Parl "Inhibit Status of FIds / Status of function identifier FId_EGSDCmnSeg1B1Parl" UWORD DFC_OneToOne 1 100 0.00 65535.00 FORMAT "%8.2" ECU_ADDRESS 0x60013F1E /end MEASUREMENT
/begin MEASUREMENT DINH_stFId.FID_BAGRA "Inhibit Status of FIds / Status of function identifier FID_BAGRA" UWORD DFC_OneToOne 1 100 0.00 65535.00 FORMAT "%8.2" ECU_ADDRESS 0x60013F20 /end MEASUREMENT
/begin MEASUREMENT DINH_stFId.FID_BAGRASD "Inhibit Status of FIds / Status of function identifier FID_BAGRASD" UWORD DFC_OneToOne 1 100 0.00 65535.00 FORMAT "%8.2" ECU_ADDRESS 0x60013F22 /end MEASUREMENT
/begin MEASUREMENT DINH_stFId.FID_BDSTOF "Inhibit Status of FIds / Status of function identifier FID_BDSTOF" UWORD DFC_OneToOne 1 100 0.00 65535.00 FORMAT "%8.2" ECU_ADDRESS 0x60013F24 /end MEASUREMENT
/begin MEASUREMENT DINH_stFId.FID_BFVDFRM "Inhibit Status of FIds / Status of function identifier FID_BFVDFRM" UWORD DFC_OneToOne 1 100 0.00 65535.00 FORMAT "%8.2" ECU_ADDRESS 0x60013F26 /end MEASUREMENT
/begin MEASUREMENT DINH_stFId.FID_BHOM "Inhibit Status of FIds / Status of function identifier FID_BHOM" UWORD DFC_OneToOne 1 100 0.00 65535.00 FORMAT "%8.2" ECU_ADDRESS 0x60013F28 /end MEASUREMENT
/begin MEASUREMENT DINH_stFId.FID_BLLRH "Inhibit Status of FIds / Status of function identifier FID_BLLRH" UWORD DFC_OneToOne 1 100 0.00 65535.00 FORMAT "%8.2" ECU_ADDRESS 0x60013F2A /end MEASUREMENT
/begin MEASUREMENT DINH_stFId.FID_BLLRKH "Inhibit Status of FIds / Status of function identifier FID_BLLRKH" UWORD DFC_OneToOne 1 100 0.00 65535.00 FORMAT "%8.2" ECU_ADDRESS 0x60013F2C /end MEASUREMENT
/begin MEASUREMENT DINH_stFId.FID_BPLSU "Inhibit Status of FIds / Status of function identifier FID_BPLSU" UWORD DFC_OneToOne 1 100 0.00 65535.00 FORMAT "%8.2" ECU_ADDRESS 0x60013F2E /end MEASUREMENT
/begin MEASUREMENT DINH_stFId.FID_FRAMBAVMB "Inhibit Status of FIds / Status of function identifier FID_FRAMBAVMB" UWORD DFC_OneToOne 1 100 0.00 65535.00 FORMAT "%8.2" ECU_ADDRESS 0x60013F30 /end MEASUREMENT
/begin MEASUREMENT DINH_stFId.FId_CatHeatgColdStrtReq "Inhibit Status of FIds / Status of function identifier FId_CatHeatgColdStrtReq" UWORD DFC_OneToOne 1 100 0.00 65535.00 FORMAT "%8.2" ECU_ADDRESS 0x60013F32 /end MEASUREMENT
/begin MEASUREMENT DINH_stFId.FId_CatHeatgWrmReq "Inhibit Status of FIds / Status of function identifier FId_CatHeatgWrmReq" UWORD DFC_OneToOne 1 100 0.00 65535.00 FORMAT "%8.2" ECU_ADDRESS 0x60013F34 /end MEASUREMENT
/begin MEASUREMENT DINH_stFId.FId_DSMBDEPHSpOpMode "Inhibit Status of FIds / Status of function identifier FId_DSMBDEPHSpOpMode" UWORD DFC_OneToOne 1 100 0.00 65535.00 FORMAT "%8.2" ECU_ADDRESS 0x60013F36 /end MEASUREMENT
/begin MEASUREMENT DINH_stFId.FId_EGRVlvCoord "Inhibit Status of FIds / Status of function identifier FId_EGRVlvCoord" UWORD DFC_OneToOne 1 100 0.00 65535.00 FORMAT "%8.2" ECU_ADDRESS 0x60013F38 /end MEASUREMENT
/begin MEASUREMENT DINH_stFId.FId_EGSDO2FuTrmB1 "Inhibit Status of FIds / Status of function identifier FId_EGSDO2FuTrmB1" UWORD DFC_OneToOne 1 100 0.00 65535.00 FORMAT "%8.2" ECU_ADDRESS 0x60013F3A /end MEASUREMENT
/begin MEASUREMENT DINH_stFId.FId_EGSDO2SnsrMntdRelsS1B1 "Inhibit Status of FIds / Status of function identifier FId_EGSDO2SnsrMntdRelsS1B1" UWORD DFC_OneToOne 1 100 0.00 65535.00 FORMAT "%8.2" ECU_ADDRESS 0x60013F3C /end MEASUREMENT
/begin MEASUREMENT DINH_stFId.FId_EGSDO2_LamOffsFastS1B1 "Inhibit Status of FIds / Status of function identifier FId_EGSDO2_LamOffsFastS1B1" UWORD DFC_OneToOne 1 100 0.00 65535.00 FORMAT "%8.2" ECU_ADDRESS 0x60013F3E /end MEASUREMENT
/begin MEASUREMENT DINH_stFId.FId_MisfDetDnAdpnNv "Inhibit Status of FIds / Status of function identifier FId_MisfDetDnAdpnNv" UWORD DFC_OneToOne 1 100 0.00 65535.00 FORMAT "%8.2" ECU_ADDRESS 0x60013F40 /end MEASUREMENT
/begin MEASUREMENT DINH_stFId.FId_bascadpncvo "Inhibit Status of FIds / Status of function identifier FId_bascadpncvo" UWORD DFC_OneToOne 1 100 0.00 65535.00 FORMAT "%8.2" ECU_ADDRESS 0x60013F42 /end MEASUREMENT
/begin MEASUREMENT DINH_stFId.FID_AGRS "Inhibit Status of FIds / Status of function identifier FID_AGRS" UWORD DFC_OneToOne 1 100 0.00 65535.00 FORMAT "%8.2" ECU_ADDRESS 0x60013F44 /end MEASUREMENT
/begin MEASUREMENT DINH_stFId.FID_BBAGR "Inhibit Status of FIds / Status of function identifier FID_BBAGR" UWORD DFC_OneToOne 1 100 0.00 65535.00 FORMAT "%8.2" ECU_ADDRESS 0x60013F46 /end MEASUREMENT
/begin MEASUREMENT DINH_stFId.FID_BBAGRA "Inhibit Status of FIds / Status of function identifier FID_BBAGRA" UWORD DFC_OneToOne 1 100 0.00 65535.00 FORMAT "%8.2" ECU_ADDRESS 0x60013F48 /end MEASUREMENT
/begin MEASUREMENT DINH_stFId.FID_BGFKMS "Inhibit Status of FIds / Status of function identifier FID_BGFKMS" UWORD DFC_OneToOne 1 100 0.00 65535.00 FORMAT "%8.2" ECU_ADDRESS 0x60013F4A /end MEASUREMENT
/begin MEASUREMENT DINH_stFId.FID_BGMSDKS "Inhibit Status of FIds / Status of function identifier FID_BGMSDKS" UWORD DFC_OneToOne 1 100 0.00 65535.00 FORMAT "%8.2" ECU_ADDRESS 0x60013F4C /end MEASUREMENT
/begin MEASUREMENT DINH_stFId.FID_CAGRSUS "Inhibit Status of FIds / Status of function identifier FID_CAGRSUS" UWORD DFC_OneToOne 1 100 0.00 65535.00 FORMAT "%8.2" ECU_ADDRESS 0x60013F4E /end MEASUREMENT
/begin MEASUREMENT DINH_stFId.FID_CBGTFUELM "Inhibit Status of FIds / Status of function identifier FID_CBGTFUELM" UWORD DFC_OneToOne 1 100 0.00 65535.00 FORMAT "%8.2" ECU_ADDRESS 0x60013F50 /end MEASUREMENT
/begin MEASUREMENT DINH_stFId.FID_CBGTHDEV "Inhibit Status of FIds / Status of function identifier FID_CBGTHDEV" UWORD DFC_OneToOne 1 100 0.00 65535.00 FORMAT "%8.2" ECU_ADDRESS 0x60013F52 /end MEASUREMENT
/begin MEASUREMENT DINH_stFId.FID_CDESVF "Inhibit Status of FIds / Status of function identifier FID_CDESVF" UWORD DFC_OneToOne 1 100 0.00 65535.00 FORMAT "%8.2" ECU_ADDRESS 0x60013F54 /end MEASUREMENT
/begin MEASUREMENT DINH_stFId.FID_CDETHS "Inhibit Status of FIds / Status of function identifier FID_CDETHS" UWORD DFC_OneToOne 1 100 0.00 65535.00 FORMAT "%8.2" ECU_ADDRESS 0x60013F56 /end MEASUREMENT
/begin MEASUREMENT DINH_stFId.FID_CDRCTSTRT "Inhibit Status of FIds / Status of function identifier FID_CDRCTSTRT" UWORD DFC_OneToOne 1 100 0.00 65535.00 FORMAT "%8.2" ECU_ADDRESS 0x60013F58 /end MEASUREMENT
/begin MEASUREMENT DINH_stFId.FID_CDSKV "Inhibit Status of FIds / Status of function identifier FID_CDSKV" UWORD DFC_OneToOne 1 100 0.00 65535.00 FORMAT "%8.2" ECU_ADDRESS 0x60013F5A /end MEASUREMENT
/begin MEASUREMENT DINH_stFId.FID_CDSKVRNO "Inhibit Status of FIds / Status of function identifier FID_CDSKVRNO" UWORD DFC_OneToOne 1 100 0.00 65535.00 FORMAT "%8.2" ECU_ADDRESS 0x60013F5C /end MEASUREMENT
/begin MEASUREMENT DINH_stFId.FID_CDSKVRPO "Inhibit Status of FIds / Status of function identifier FID_CDSKVRPO" UWORD DFC_OneToOne 1 100 0.00 65535.00 FORMAT "%8.2" ECU_ADDRESS 0x60013F5E /end MEASUREMENT
/begin MEASUREMENT DINH_stFId.FID_CDSKVRaty "Inhibit Status of FIds / Status of function identifier FID_CDSKVRaty" UWORD DFC_OneToOne 1 100 0.00 65535.00 FORMAT "%8.2" ECU_ADDRESS 0x60013F60 /end MEASUREMENT
/begin MEASUREMENT DINH_stFId.FID_CDSKVRng "Inhibit Status of FIds / Status of function identifier FID_CDSKVRng" UWORD DFC_OneToOne 1 100 0.00 65535.00 FORMAT "%8.2" ECU_ADDRESS 0x60013F62 /end MEASUREMENT
/begin MEASUREMENT DINH_stFId.FID_CDSKVS "Inhibit Status of FIds / Status of function identifier FID_CDSKVS" UWORD DFC_OneToOne 1 100 0.00 65535.00 FORMAT "%8.2" ECU_ADDRESS 0x60013F64 /end MEASUREMENT
/begin MEASUREMENT DINH_stFId.FID_CDSTR "Inhibit Status of FIds / Status of function identifier FID_CDSTR" UWORD DFC_OneToOne 1 100 0.00 65535.00 FORMAT "%8.2" ECU_ADDRESS 0x60013F66 /end MEASUREMENT
/begin MEASUREMENT DINH_stFId.FID_CDSTTI "Inhibit Status of FIds / Status of function identifier FID_CDSTTI" UWORD DFC_OneToOne 1 100 0.00 65535.00 FORMAT "%8.2" ECU_ADDRESS 0x60013F68 /end MEASUREMENT
/begin MEASUREMENT DINH_stFId.FID_CETHG "Inhibit Status of FIds / Status of function identifier FID_CETHG" UWORD DFC_OneToOne 1 100 0.00 65535.00 FORMAT "%8.2" ECU_ADDRESS 0x60013F6A /end MEASUREMENT
/begin MEASUREMENT DINH_stFId.FID_CETHSPLnpl "Inhibit Status of FIds / Status of function identifier FID_CETHSPLnpl" UWORD DFC_OneToOne 1 100 0.00 65535.00 FORMAT "%8.2" ECU_ADDRESS 0x60013F6C /end MEASUREMENT
/begin MEASUREMENT DINH_stFId.FID_CETHSTPLnpl "Inhibit Status of FIds / Status of function identifier FID_CETHSTPLnpl" UWORD DFC_OneToOne 1 100 0.00 65535.00 FORMAT "%8.2" ECU_ADDRESS 0x60013F6E /end MEASUREMENT
/begin MEASUREMENT DINH_stFId.FID_CETKHL "Inhibit Status of FIds / Status of function identifier FID_CETKHL" UWORD DFC_OneToOne 1 100 0.00 65535.00 FORMAT "%8.2" ECU_ADDRESS 0x60013F70 /end MEASUREMENT
/begin MEASUREMENT DINH_stFId.FID_CETKHT "Inhibit Status of FIds / Status of function identifier FID_CETKHT" UWORD DFC_OneToOne 1 100 0.00 65535.00 FORMAT "%8.2" ECU_ADDRESS 0x60013F72 /end MEASUREMENT
/begin MEASUREMENT DINH_stFId.FID_CGDISTRT "Inhibit Status of FIds / Status of function identifier FID_CGDISTRT" UWORD DFC_OneToOne 1 100 0.00 65535.00 FORMAT "%8.2" ECU_ADDRESS 0x60013F74 /end MEASUREMENT
/begin MEASUREMENT DINH_stFId.FID_CGLSRDP "Inhibit Status of FIds / Status of function identifier FID_CGLSRDP" UWORD DFC_OneToOne 1 100 0.00 65535.00 FORMAT "%8.2" ECU_ADDRESS 0x60013F76 /end MEASUREMENT
/begin MEASUREMENT DINH_stFId.FID_CHDR "Inhibit Status of FIds / Status of function identifier FID_CHDR" UWORD DFC_OneToOne 1 100 0.00 65535.00 FORMAT "%8.2" ECU_ADDRESS 0x60013F78 /end MEASUREMENT
/begin MEASUREMENT DINH_stFId.FID_CHDRKH "Inhibit Status of FIds / Status of function identifier FID_CHDRKH" UWORD DFC_OneToOne 1 100 0.00 65535.00 FORMAT "%8.2" ECU_ADDRESS 0x60013F7A /end MEASUREMENT
/begin MEASUREMENT DINH_stFId.FID_CHDRPL "Inhibit Status of FIds / Status of function identifier FID_CHDRPL" UWORD DFC_OneToOne 1 100 0.00 65535.00 FORMAT "%8.2" ECU_ADDRESS 0x60013F7C /end MEASUREMENT
/begin MEASUREMENT DINH_stFId.FID_CLLKHV "Inhibit Status of FIds / Status of function identifier FID_CLLKHV" UWORD DFC_OneToOne 1 100 0.00 65535.00 FORMAT "%8.2" ECU_ADDRESS 0x60013F7E /end MEASUREMENT
/begin MEASUREMENT DINH_stFId.FID_CLLRHV "Inhibit Status of FIds / Status of function identifier FID_CLLRHV" UWORD DFC_OneToOne 1 100 0.00 65535.00 FORMAT "%8.2" ECU_ADDRESS 0x60013F80 /end MEASUREMENT
/begin MEASUREMENT DINH_stFId.FID_CLZSRDP "Inhibit Status of FIds / Status of function identifier FID_CLZSRDP" UWORD DFC_OneToOne 1 100 0.00 65535.00 FORMAT "%8.2" ECU_ADDRESS 0x60013F82 /end MEASUREMENT
/begin MEASUREMENT DINH_stFId.FID_CLZSRHP "Inhibit Status of FIds / Status of function identifier FID_CLZSRHP" UWORD DFC_OneToOne 1 100 0.00 65535.00 FORMAT "%8.2" ECU_ADDRESS 0x60013F84 /end MEASUREMENT
/begin MEASUREMENT DINH_stFId.FID_CNLHP "Inhibit Status of FIds / Status of function identifier FID_CNLHP" UWORD DFC_OneToOne 1 100 0.00 65535.00 FORMAT "%8.2" ECU_ADDRESS 0x60013F86 /end MEASUREMENT
/begin MEASUREMENT DINH_stFId.FID_CNLHP2 "Inhibit Status of FIds / Status of function identifier FID_CNLHP2" UWORD DFC_OneToOne 1 100 0.00 65535.00 FORMAT "%8.2" ECU_ADDRESS 0x60013F88 /end MEASUREMENT
/begin MEASUREMENT DINH_stFId.FID_CNLKO2 "Inhibit Status of FIds / Status of function identifier FID_CNLKO2" UWORD DFC_OneToOne 1 100 0.00 65535.00 FORMAT "%8.2" ECU_ADDRESS 0x60013F8A /end MEASUREMENT
/begin MEASUREMENT DINH_stFId.FID_CNLKO3 "Inhibit Status of FIds / Status of function identifier FID_CNLKO3" UWORD DFC_OneToOne 1 100 0.00 65535.00 FORMAT "%8.2" ECU_ADDRESS 0x60013F8C /end MEASUREMENT
/begin MEASUREMENT DINH_stFId.FID_CNLLP "Inhibit Status of FIds / Status of function identifier FID_CNLLP" UWORD DFC_OneToOne 1 100 0.00 65535.00 FORMAT "%8.2" ECU_ADDRESS 0x60013F8E /end MEASUREMENT
/begin MEASUREMENT DINH_stFId.FID_CNLPL "Inhibit Status of FIds / Status of function identifier FID_CNLPL" UWORD DFC_OneToOne 1 100 0.00 65535.00 FORMAT "%8.2" ECU_ADDRESS 0x60013F90 /end MEASUREMENT
/begin MEASUREMENT DINH_stFId.FID_CNLPS "Inhibit Status of FIds / Status of function identifier FID_CNLPS" UWORD DFC_OneToOne 1 100 0.00 65535.00 FORMAT "%8.2" ECU_ADDRESS 0x60013F92 /end MEASUREMENT
/begin MEASUREMENT DINH_stFId.FID_CNSAD "Inhibit Status of FIds / Status of function identifier FID_CNSAD" UWORD DFC_OneToOne 1 100 0.00 65535.00 FORMAT "%8.2" ECU_ADDRESS 0x60013F94 /end MEASUREMENT
/begin MEASUREMENT DINH_stFId.FID_CNSAD2 "Inhibit Status of FIds / Status of function identifier FID_CNSAD2" UWORD DFC_OneToOne 1 100 0.00 65535.00 FORMAT "%8.2" ECU_ADDRESS 0x60013F96 /end MEASUREMENT
/begin MEASUREMENT DINH_stFId.FID_CPSRB "Inhibit Status of FIds / Status of function identifier FID_CPSRB" UWORD DFC_OneToOne 1 100 0.00 65535.00 FORMAT "%8.2" ECU_ADDRESS 0x60013F98 /end MEASUREMENT
/begin MEASUREMENT DINH_stFId.FID_CPSRP "Inhibit Status of FIds / Status of function identifier FID_CPSRP" UWORD DFC_OneToOne 1 100 0.00 65535.00 FORMAT "%8.2" ECU_ADDRESS 0x60013F9A /end MEASUREMENT
/begin MEASUREMENT DINH_stFId.FID_CSTHDR "Inhibit Status of FIds / Status of function identifier FID_CSTHDR" UWORD DFC_OneToOne 1 100 0.00 65535.00 FORMAT "%8.2" ECU_ADDRESS 0x60013F9C /end MEASUREMENT
/begin MEASUREMENT DINH_stFId.FID_CSTRTCTL "Inhibit Status of FIds / Status of function identifier FID_CSTRTCTL" UWORD DFC_OneToOne 1 100 0.00 65535.00 FORMAT "%8.2" ECU_ADDRESS 0x60013F9E /end MEASUREMENT
/begin MEASUREMENT DINH_stFId.FID_CTESF "Inhibit Status of FIds / Status of function identifier FID_CTESF" UWORD DFC_OneToOne 1 100 0.00 65535.00 FORMAT "%8.2" ECU_ADDRESS 0x60013FA0 /end MEASUREMENT
/begin MEASUREMENT DINH_stFId.FID_CTESG "Inhibit Status of FIds / Status of function identifier FID_CTESG" UWORD DFC_OneToOne 1 100 0.00 65535.00 FORMAT "%8.2" ECU_ADDRESS 0x60013FA2 /end MEASUREMENT
/begin MEASUREMENT DINH_stFId.FID_CTHIPSTRT "Inhibit Status of FIds / Status of function identifier FID_CTHIPSTRT" UWORD DFC_OneToOne 1 100 0.00 65535.00 FORMAT "%8.2" ECU_ADDRESS 0x60013FA4 /end MEASUREMENT
/begin MEASUREMENT DINH_stFId.FID_CTKACS "Inhibit Status of FIds / Status of function identifier FID_CTKACS" UWORD DFC_OneToOne 1 100 0.00 65535.00 FORMAT "%8.2" ECU_ADDRESS 0x60013FA6 /end MEASUREMENT
/begin MEASUREMENT DINH_stFId.FID_CTMSV "Inhibit Status of FIds / Status of function identifier FID_CTMSV" UWORD DFC_OneToOne 1 100 0.00 65535.00 FORMAT "%8.2" ECU_ADDRESS 0x60013FA8 /end MEASUREMENT
/begin MEASUREMENT DINH_stFId.FID_CTOSP "Inhibit Status of FIds / Status of function identifier FID_CTOSP" UWORD DFC_OneToOne 1 100 0.00 65535.00 FORMAT "%8.2" ECU_ADDRESS 0x60013FAA /end MEASUREMENT
/begin MEASUREMENT DINH_stFId.FID_DHFERR "Inhibit Status of FIds / Status of function identifier FID_DHFERR" UWORD DFC_OneToOne 1 100 0.00 65535.00 FORMAT "%8.2" ECU_ADDRESS 0x60013FAC /end MEASUREMENT
/begin MEASUREMENT DINH_stFId.FID_DKRSA "Inhibit Status of FIds / Status of function identifier FID_DKRSA" UWORD DFC_OneToOne 1 100 0.00 65535.00 FORMAT "%8.2" ECU_ADDRESS 0x60013FAE /end MEASUREMENT
/begin MEASUREMENT DINH_stFId.FID_DLLRBandEndTst "Inhibit Status of FIds / Status of function identifier FID_DLLRBandEndTst" UWORD DFC_OneToOne 1 100 0.00 65535.00 FORMAT "%8.2" ECU_ADDRESS 0x60013FB0 /end MEASUREMENT
/begin MEASUREMENT DINH_stFId.FID_DLLRShrtTrpSpdRmp "Inhibit Status of FIds / Status of function identifier FID_DLLRShrtTrpSpdRmp" UWORD DFC_OneToOne 1 100 0.00 65535.00 FORMAT "%8.2" ECU_ADDRESS 0x60013FB2 /end MEASUREMENT
/begin MEASUREMENT DINH_stFId.FID_FEDKAHB "Inhibit Status of FIds / Status of function identifier FID_FEDKAHB" UWORD DFC_OneToOne 1 100 0.00 65535.00 FORMAT "%8.2" ECU_ADDRESS 0x60013FB4 /end MEASUREMENT
/begin MEASUREMENT DINH_stFId.FID_FEDKAPB "Inhibit Status of FIds / Status of function identifier FID_FEDKAPB" UWORD DFC_OneToOne 1 100 0.00 65535.00 FORMAT "%8.2" ECU_ADDRESS 0x60013FB6 /end MEASUREMENT
/begin MEASUREMENT DINH_stFId.FID_FEDSSB "Inhibit Status of FIds / Status of function identifier FID_FEDSSB" UWORD DFC_OneToOne 1 100 0.00 65535.00 FORMAT "%8.2" ECU_ADDRESS 0x60013FB8 /end MEASUREMENT
/begin MEASUREMENT DINH_stFId.FID_FOFSTP "Inhibit Status of FIds / Status of function identifier FID_FOFSTP" UWORD DFC_OneToOne 1 100 0.00 65535.00 FORMAT "%8.2" ECU_ADDRESS 0x60013FBA /end MEASUREMENT
/begin MEASUREMENT DINH_stFId.FID_FONSTP "Inhibit Status of FIds / Status of function identifier FID_FONSTP" UWORD DFC_OneToOne 1 100 0.00 65535.00 FORMAT "%8.2" ECU_ADDRESS 0x60013FBC /end MEASUREMENT
/begin MEASUREMENT DINH_stFId.FID_FUEDK "Inhibit Status of FIds / Status of function identifier FID_FUEDK" UWORD DFC_OneToOne 1 100 0.00 65535.00 FORMAT "%8.2" ECU_ADDRESS 0x60013FBE /end MEASUREMENT
/begin MEASUREMENT DINH_stFId.FID_FVLRA "Inhibit Status of FIds / Status of function identifier FID_FVLRA" UWORD DFC_OneToOne 1 100 0.00 65535.00 FORMAT "%8.2" ECU_ADDRESS 0x60013FC0 /end MEASUREMENT
/begin MEASUREMENT DINH_stFId.FID_KRREGact "Inhibit Status of FIds / Status of function identifier FID_KRREGact" UWORD DFC_OneToOne 1 100 0.00 65535.00 FORMAT "%8.2" ECU_ADDRESS 0x60013FC2 /end MEASUREMENT
/begin MEASUREMENT DINH_stFId.FID_KRREGloc "Inhibit Status of FIds / Status of function identifier FID_KRREGloc" UWORD DFC_OneToOne 1 100 0.00 65535.00 FORMAT "%8.2" ECU_ADDRESS 0x60013FC4 /end MEASUREMENT
/begin MEASUREMENT DINH_stFId.FID_LRADLSU "Inhibit Status of FIds / Status of function identifier FID_LRADLSU" UWORD DFC_OneToOne 1 100 0.00 65535.00 FORMAT "%8.2" ECU_ADDRESS 0x60013FC6 /end MEASUREMENT
/begin MEASUREMENT DINH_stFId.FID_LRALSVErr "Inhibit Status of FIds / Status of function identifier FID_LRALSVErr" UWORD DFC_OneToOne 1 100 0.00 65535.00 FORMAT "%8.2" ECU_ADDRESS 0x60013FC8 /end MEASUREMENT
/begin MEASUREMENT DINH_stFId.FID_LRAPLLSU "Inhibit Status of FIds / Status of function identifier FID_LRAPLLSU" UWORD DFC_OneToOne 1 100 0.00 65535.00 FORMAT "%8.2" ECU_ADDRESS 0x60013FCA /end MEASUREMENT
/begin MEASUREMENT DINH_stFId.FID_LUSTP "Inhibit Status of FIds / Status of function identifier FID_LUSTP" UWORD DFC_OneToOne 1 100 0.00 65535.00 FORMAT "%8.2" ECU_ADDRESS 0x60013FCC /end MEASUREMENT
/begin MEASUREMENT DINH_stFId.FID_LnKS1 "Inhibit Status of FIds / Status of function identifier FID_LnKS1" UWORD DFC_OneToOne 1 100 0.00 65535.00 FORMAT "%8.2" ECU_ADDRESS 0x60013FCE /end MEASUREMENT
/begin MEASUREMENT DINH_stFId.FID_PLSUV "Inhibit Status of FIds / Status of function identifier FID_PLSUV" UWORD DFC_OneToOne 1 100 0.00 65535.00 FORMAT "%8.2" ECU_ADDRESS 0x60013FD0 /end MEASUREMENT
/begin MEASUREMENT DINH_stFId.FID_PSRMOZDG "Inhibit Status of FIds / Status of function identifier FID_PSRMOZDG" UWORD DFC_OneToOne 1 100 0.00 65535.00 FORMAT "%8.2" ECU_ADDRESS 0x60013FD2 /end MEASUREMENT
/begin MEASUREMENT DINH_stFId.FID_PSRMOZG "Inhibit Status of FIds / Status of function identifier FID_PSRMOZG" UWORD DFC_OneToOne 1 100 0.00 65535.00 FORMAT "%8.2" ECU_ADDRESS 0x60013FD4 /end MEASUREMENT
/begin MEASUREMENT DINH_stFId.FID_STRTDIA "Inhibit Status of FIds / Status of function identifier FID_STRTDIA" UWORD DFC_OneToOne 1 100 0.00 65535.00 FORMAT "%8.2" ECU_ADDRESS 0x60013FD6 /end MEASUREMENT
/begin MEASUREMENT DINH_stFId.FID_STRTSTM "Inhibit Status of FIds / Status of function identifier FID_STRTSTM" UWORD DFC_OneToOne 1 100 0.00 65535.00 FORMAT "%8.2" ECU_ADDRESS 0x60013FD8 /end MEASUREMENT
/begin MEASUREMENT DINH_stFId.FID_TFA1CSMW "Inhibit Status of FIds / Status of function identifier FID_TFA1CSMW" UWORD DFC_OneToOne 1 100 0.00 65535.00 FORMAT "%8.2" ECU_ADDRESS 0x60013FDA /end MEASUREMENT
/begin MEASUREMENT DINH_stFId.FID_TFA2CSMW "Inhibit Status of FIds / Status of function identifier FID_TFA2CSMW" UWORD DFC_OneToOne 1 100 0.00 65535.00 FORMAT "%8.2" ECU_ADDRESS 0x60013FDC /end MEASUREMENT
/begin MEASUREMENT DINH_stFId.FID_TKACSMW "Inhibit Status of FIds / Status of function identifier FID_TKACSMW" UWORD DFC_OneToOne 1 100 0.00 65535.00 FORMAT "%8.2" ECU_ADDRESS 0x60013FDE /end MEASUREMENT
/begin MEASUREMENT DINH_stFId.FID_TMCSMW "Inhibit Status of FIds / Status of function identifier FID_TMCSMW" UWORD DFC_OneToOne 1 100 0.00 65535.00 FORMAT "%8.2" ECU_ADDRESS 0x60013FE0 /end MEASUREMENT
/begin MEASUREMENT DINH_stFId.FID_TOCHOilSwmpTQly "Inhibit Status of FIds / Status of function identifier FID_TOCHOilSwmpTQly" UWORD DFC_OneToOne 1 100 0.00 65535.00 FORMAT "%8.2" ECU_ADDRESS 0x60013FE2 /end MEASUREMENT
/begin MEASUREMENT DINH_stFId.FID_TOCHTME "Inhibit Status of FIds / Status of function identifier FID_TOCHTME" UWORD DFC_OneToOne 1 100 0.00 65535.00 FORMAT "%8.2" ECU_ADDRESS 0x60013FE4 /end MEASUREMENT
/begin MEASUREMENT DINH_stFId.FID_TOSPCSMW "Inhibit Status of FIds / Status of function identifier FID_TOSPCSMW" UWORD DFC_OneToOne 1 100 0.00 65535.00 FORMAT "%8.2" ECU_ADDRESS 0x60013FE6 /end MEASUREMENT
/begin MEASUREMENT DINH_stFId.FID_TSRLX "Inhibit Status of FIds / Status of function identifier FID_TSRLX" UWORD DFC_OneToOne 1 100 0.00 65535.00 FORMAT "%8.2" ECU_ADDRESS 0x60013FE8 /end MEASUREMENT
/begin MEASUREMENT DINH_stFId.FID_UEGOHeatrRlyS1B1 "Inhibit Status of FIds / Status of function identifier FID_UEGOHeatrRlyS1B1" UWORD DFC_OneToOne 1 100 0.00 65535.00 FORMAT "%8.2" ECU_ADDRESS 0x60013FEA /end MEASUREMENT
/begin MEASUREMENT DINH_stFId.FID_VehStvSSEOk "Inhibit Status of FIds / Status of function identifier FID_VehStvSSEOk" UWORD DFC_OneToOne 1 100 0.00 65535.00 FORMAT "%8.2" ECU_ADDRESS 0x60013FEC /end MEASUREMENT
/begin MEASUREMENT DINH_stFId.FID_VldtLamPlausMaxS1B1 "Inhibit Status of FIds / Status of function identifier FID_VldtLamPlausMaxS1B1" UWORD DFC_OneToOne 1 100 0.00 65535.00 FORMAT "%8.2" ECU_ADDRESS 0x60013FEE /end MEASUREMENT
/begin MEASUREMENT DINH_stFId.FID_VldtLamPlausMinS1B1 "Inhibit Status of FIds / Status of function identifier FID_VldtLamPlausMinS1B1" UWORD DFC_OneToOne 1 100 0.00 65535.00 FORMAT "%8.2" ECU_ADDRESS 0x60013FF0 /end MEASUREMENT
/begin MEASUREMENT DINH_stFId.FId_ACClntPSSPMon "Inhibit Status of FIds / Status of function identifier FId_ACClntPSSPMon" UWORD DFC_OneToOne 1 100 0.00 65535.00 FORMAT "%8.2" ECU_ADDRESS 0x60013FF2 /end MEASUREMENT
/begin MEASUREMENT DINH_stFId.FId_ACCompComCANBusOff "Inhibit Status of FIds / Status of function identifier FId_ACCompComCANBusOff" UWORD DFC_OneToOne 1 100 0.00 65535.00 FORMAT "%8.2" ECU_ADDRESS 0x60013FF4 /end MEASUREMENT
/begin MEASUREMENT DINH_stFId.FId_ACCompComCANErrMtr "Inhibit Status of FIds / Status of function identifier FId_ACCompComCANErrMtr" UWORD DFC_OneToOne 1 100 0.00 65535.00 FORMAT "%8.2" ECU_ADDRESS 0x60013FF6 /end MEASUREMENT
/begin MEASUREMENT DINH_stFId.FId_ACComp_HiUTWSnsrErr "Inhibit Status of FIds / Status of function identifier FId_ACComp_HiUTWSnsrErr" UWORD DFC_OneToOne 1 100 0.00 65535.00 FORMAT "%8.2" ECU_ADDRESS 0x60013FF8 /end MEASUREMENT
/begin MEASUREMENT DINH_stFId.FId_ACComp_LoUTWSnsrErr "Inhibit Status of FIds / Status of function identifier FId_ACComp_LoUTWSnsrErr" UWORD DFC_OneToOne 1 100 0.00 65535.00 FORMAT "%8.2" ECU_ADDRESS 0x60013FFA /end MEASUREMENT
/begin MEASUREMENT DINH_stFId.FId_ACComp_PDSnsrErr "Inhibit Status of FIds / Status of function identifier FId_ACComp_PDSnsrErr" UWORD DFC_OneToOne 1 100 0.00 65535.00 FORMAT "%8.2" ECU_ADDRESS 0x60013FFC /end MEASUREMENT
/begin MEASUREMENT DINH_stFId.FId_ACComp_VehSpdSnsrErr "Inhibit Status of FIds / Status of function identifier FId_ACComp_VehSpdSnsrErr" UWORD DFC_OneToOne 1 100 0.00 65535.00 FORMAT "%8.2" ECU_ADDRESS 0x60013FFE /end MEASUREMENT
/begin MEASUREMENT DINH_stFId.FId_ACCtl_ACStrtCut "Inhibit Status of FIds / Status of function identifier FId_ACCtl_ACStrtCut" UWORD DFC_OneToOne 1 100 0.00 65535.00 FORMAT "%8.2" ECU_ADDRESS 0x60014000 /end MEASUREMENT
/begin MEASUREMENT DINH_stFId.FId_ACCtl_APP1 "Inhibit Status of FIds / Status of function identifier FId_ACCtl_APP1" UWORD DFC_OneToOne 1 100 0.00 65535.00 FORMAT "%8.2" ECU_ADDRESS 0x60014002 /end MEASUREMENT
/begin MEASUREMENT DINH_stFId.FId_ACCtl_APP2 "Inhibit Status of FIds / Status of function identifier FId_ACCtl_APP2" UWORD DFC_OneToOne 1 100 0.00 65535.00 FORMAT "%8.2" ECU_ADDRESS 0x60014004 /end MEASUREMENT
/begin MEASUREMENT DINH_stFId.FId_ACCtl_APPSync "Inhibit Status of FIds / Status of function identifier FId_ACCtl_APPSync" UWORD DFC_OneToOne 1 100 0.00 65535.00 FORMAT "%8.2" ECU_ADDRESS 0x60014006 /end MEASUREMENT
/begin MEASUREMENT DINH_stFId.FId_ACCtl_AcOff "Inhibit Status of FIds / Status of function identifier FId_ACCtl_AcOff" UWORD DFC_OneToOne 1 100 0.00 65535.00 FORMAT "%8.2" ECU_ADDRESS 0x60014008 /end MEASUREMENT
/begin MEASUREMENT DINH_stFId.FId_ACCtl_Clmb "Inhibit Status of FIds / Status of function identifier FId_ACCtl_Clmb" UWORD DFC_OneToOne 1 100 0.00 65535.00 FORMAT "%8.2" ECU_ADDRESS 0x6001400A /end MEASUREMENT
/begin MEASUREMENT DINH_stFId.FId_ACCtl_DK1 "Inhibit Status of FIds / Status of function identifier FId_ACCtl_DK1" UWORD DFC_OneToOne 1 100 0.00 65535.00 FORMAT "%8.2" ECU_ADDRESS 0x6001400C /end MEASUREMENT
/begin MEASUREMENT DINH_stFId.FId_ACCtl_DK2 "Inhibit Status of FIds / Status of function identifier FId_ACCtl_DK2" UWORD DFC_OneToOne 1 100 0.00 65535.00 FORMAT "%8.2" ECU_ADDRESS 0x6001400E /end MEASUREMENT
/begin MEASUREMENT DINH_stFId.FId_ACCtl_DKSync "Inhibit Status of FIds / Status of function identifier FId_ACCtl_DKSync" UWORD DFC_OneToOne 1 100 0.00 65535.00 FORMAT "%8.2" ECU_ADDRESS 0x60014010 /end MEASUREMENT
/begin MEASUREMENT DINH_stFId.FId_ACCtl_VehSpdSnsrErr "Inhibit Status of FIds / Status of function identifier FId_ACCtl_VehSpdSnsrErr" UWORD DFC_OneToOne 1 100 0.00 65535.00 FORMAT "%8.2" ECU_ADDRESS 0x60014012 /end MEASUREMENT
/begin MEASUREMENT DINH_stFId.FId_ACCtl_pAC "Inhibit Status of FIds / Status of function identifier FId_ACCtl_pAC" UWORD DFC_OneToOne 1 100 0.00 65535.00 FORMAT "%8.2" ECU_ADDRESS 0x60014014 /end MEASUREMENT
/begin MEASUREMENT DINH_stFId.FId_ACEvpTCANErr "Inhibit Status of FIds / Status of function identifier FId_ACEvpTCANErr" UWORD DFC_OneToOne 1 100 0.00 65535.00 FORMAT "%8.2" ECU_ADDRESS 0x60014016 /end MEASUREMENT
/begin MEASUREMENT DINH_stFId.FId_ACEvpTFrzVal "Inhibit Status of FIds / Status of function identifier FId_ACEvpTFrzVal" UWORD DFC_OneToOne 1 100 0.00 65535.00 FORMAT "%8.2" ECU_ADDRESS 0x60014018 /end MEASUREMENT
/begin MEASUREMENT DINH_stFId.FId_ACEvpTPhysRng "Inhibit Status of FIds / Status of function identifier FId_ACEvpTPhysRng" UWORD DFC_OneToOne 1 100 0.00 65535.00 FORMAT "%8.2" ECU_ADDRESS 0x6001401A /end MEASUREMENT
/begin MEASUREMENT DINH_stFId.FId_ACEvpTRplVal "Inhibit Status of FIds / Status of function identifier FId_ACEvpTRplVal" UWORD DFC_OneToOne 1 100 0.00 65535.00 FORMAT "%8.2" ECU_ADDRESS 0x6001401C /end MEASUREMENT
/begin MEASUREMENT DINH_stFId.FId_AFCLFailr "Inhibit Status of FIds / Status of function identifier FId_AFCLFailr" UWORD DFC_OneToOne 1 100 0.00 65535.00 FORMAT "%8.2" ECU_ADDRESS 0x6001401E /end MEASUREMENT
/begin MEASUREMENT DINH_stFId.FId_AFS "Inhibit Status of FIds / Status of function identifier FId_AFS" UWORD DFC_OneToOne 1 100 0.00 65535.00 FORMAT "%8.2" ECU_ADDRESS 0x60014020 /end MEASUREMENT
/begin MEASUREMENT DINH_stFId.FId_AFSPhyRng "Inhibit Status of FIds / Status of function identifier FId_AFSPhyRng" UWORD DFC_OneToOne 1 100 0.00 65535.00 FORMAT "%8.2" ECU_ADDRESS 0x60014022 /end MEASUREMENT
/begin MEASUREMENT DINH_stFId.FId_APP1SigPath "Inhibit Status of FIds / Status of function identifier FId_APP1SigPath" UWORD DFC_OneToOne 1 100 0.00 65535.00 FORMAT "%8.2" ECU_ADDRESS 0x60014024 /end MEASUREMENT
/begin MEASUREMENT DINH_stFId.FId_APP2SigPath "Inhibit Status of FIds / Status of function identifier FId_APP2SigPath" UWORD DFC_OneToOne 1 100 0.00 65535.00 FORMAT "%8.2" ECU_ADDRESS 0x60014026 /end MEASUREMENT
/begin MEASUREMENT DINH_stFId.FId_APPBrkErr "Inhibit Status of FIds / Status of function identifier FId_APPBrkErr" UWORD DFC_OneToOne 1 100 0.00 65535.00 FORMAT "%8.2" ECU_ADDRESS 0x60014028 /end MEASUREMENT
/begin MEASUREMENT DINH_stFId.FId_APPLETVldnErr "Inhibit Status of FIds / Status of function identifier FId_APPLETVldnErr" UWORD DFC_OneToOne 1 100 0.00 65535.00 FORMAT "%8.2" ECU_ADDRESS 0x6001402A /end MEASUREMENT
/begin MEASUREMENT DINH_stFId.FId_APPLrn "Inhibit Status of FIds / Status of function identifier FId_APPLrn" UWORD DFC_OneToOne 1 100 0.00 65535.00 FORMAT "%8.2" ECU_ADDRESS 0x6001402C /end MEASUREMENT
/begin MEASUREMENT DINH_stFId.FId_APPVehVErr "Inhibit Status of FIds / Status of function identifier FId_APPVehVErr" UWORD DFC_OneToOne 1 100 0.00 65535.00 FORMAT "%8.2" ECU_ADDRESS 0x6001402E /end MEASUREMENT
/begin MEASUREMENT DINH_stFId.FId_AccPedDrvModComErr "Inhibit Status of FIds / Status of function identifier FId_AccPedDrvModComErr" UWORD DFC_OneToOne 1 100 0.00 65535.00 FORMAT "%8.2" ECU_ADDRESS 0x60014030 /end MEASUREMENT
/begin MEASUREMENT DINH_stFId.FId_AccPedDrvModFailr "Inhibit Status of FIds / Status of function identifier FId_AccPedDrvModFailr" UWORD DFC_OneToOne 1 100 0.00 65535.00 FORMAT "%8.2" ECU_ADDRESS 0x60014032 /end MEASUREMENT
/begin MEASUREMENT DINH_stFId.FId_AccPedNMaxLim "Inhibit Status of FIds / Status of function identifier FId_AccPedNMaxLim" UWORD DFC_OneToOne 1 100 0.00 65535.00 FORMAT "%8.2" ECU_ADDRESS 0x60014034 /end MEASUREMENT
/begin MEASUREMENT DINH_stFId.FId_AccPedNMinLim "Inhibit Status of FIds / Status of function identifier FId_AccPedNMinLim" UWORD DFC_OneToOne 1 100 0.00 65535.00 FORMAT "%8.2" ECU_ADDRESS 0x60014036 /end MEASUREMENT
/begin MEASUREMENT DINH_stFId.FId_AccPedNMinLimBrkApp "Inhibit Status of FIds / Status of function identifier FId_AccPedNMinLimBrkApp" UWORD DFC_OneToOne 1 100 0.00 65535.00 FORMAT "%8.2" ECU_ADDRESS 0x60014038 /end MEASUREMENT
/begin MEASUREMENT DINH_stFId.FId_AccPedTrqLim "Inhibit Status of FIds / Status of function identifier FId_AccPedTrqLim" UWORD DFC_OneToOne 1 100 0.00 65535.00 FORMAT "%8.2" ECU_ADDRESS 0x6001403A /end MEASUREMENT
/begin MEASUREMENT DINH_stFId.FId_AfsDdDiag "Inhibit Status of FIds / Status of function identifier FId_AfsDdDiag" UWORD DFC_OneToOne 1 100 0.00 65535.00 FORMAT "%8.2" ECU_ADDRESS 0x6001403C /end MEASUREMENT
/begin MEASUREMENT DINH_stFId.FId_AfsDiagErr "Inhibit Status of FIds / Status of function identifier FId_AfsDiagErr" UWORD DFC_OneToOne 1 100 0.00 65535.00 FORMAT "%8.2" ECU_ADDRESS 0x6001403E /end MEASUREMENT
/begin MEASUREMENT DINH_stFId.FId_AfsDiagTst "Inhibit Status of FIds / Status of function identifier FId_AfsDiagTst" UWORD DFC_OneToOne 1 100 0.00 65535.00 FORMAT "%8.2" ECU_ADDRESS 0x60014040 /end MEASUREMENT
/begin MEASUREMENT DINH_stFId.FId_AfsPlausDiag "Inhibit Status of FIds / Status of function identifier FId_AfsPlausDiag" UWORD DFC_OneToOne 1 100 0.00 65535.00 FORMAT "%8.2" ECU_ADDRESS 0x60014042 /end MEASUREMENT
/begin MEASUREMENT DINH_stFId.FId_AfsVrntDiag "Inhibit Status of FIds / Status of function identifier FId_AfsVrntDiag" UWORD DFC_OneToOne 1 100 0.00 65535.00 FORMAT "%8.2" ECU_ADDRESS 0x60014044 /end MEASUREMENT
/begin MEASUREMENT DINH_stFId.FId_AirCClntPFrzVal "Inhibit Status of FIds / Status of function identifier FId_AirCClntPFrzVal" UWORD DFC_OneToOne 1 100 0.00 65535.00 FORMAT "%8.2" ECU_ADDRESS 0x60014046 /end MEASUREMENT
/begin MEASUREMENT DINH_stFId.FId_AirCClntPRplVal "Inhibit Status of FIds / Status of function identifier FId_AirCClntPRplVal" UWORD DFC_OneToOne 1 100 0.00 65535.00 FORMAT "%8.2" ECU_ADDRESS 0x60014048 /end MEASUREMENT
/begin MEASUREMENT DINH_stFId.FId_AirCSwt "Inhibit Status of FIds / Status of function identifier FId_AirCSwt" UWORD DFC_OneToOne 1 100 0.00 65535.00 FORMAT "%8.2" ECU_ADDRESS 0x6001404A /end MEASUREMENT
/begin MEASUREMENT DINH_stFId.FId_AirDvPAdpnPEnv "Inhibit Status of FIds / Status of function identifier FId_AirDvPAdpnPEnv" UWORD DFC_OneToOne 1 100 0.00 65535.00 FORMAT "%8.2" ECU_ADDRESS 0x6001404C /end MEASUREMENT
/begin MEASUREMENT DINH_stFId.FId_AirDvPAdpnPIntkVUsB1 "Inhibit Status of FIds / Status of function identifier FId_AirDvPAdpnPIntkVUsB1" UWORD DFC_OneToOne 1 100 0.00 65535.00 FORMAT "%8.2" ECU_ADDRESS 0x6001404E /end MEASUREMENT
/begin MEASUREMENT DINH_stFId.FId_AirDvPPSnsrAdpn_PModeActv "Inhibit Status of FIds / Status of function identifier FId_AirDvPPSnsrAdpn_PModeActv" UWORD DFC_OneToOne 1 100 0.00 65535.00 FORMAT "%8.2" ECU_ADDRESS 0x60014050 /end MEASUREMENT
/begin MEASUREMENT DINH_stFId.FId_AltACGFailr "Inhibit Status of FIds / Status of function identifier FId_AltACGFailr" UWORD DFC_OneToOne 1 100 0.00 65535.00 FORMAT "%8.2" ECU_ADDRESS 0x60014052 /end MEASUREMENT
/begin MEASUREMENT DINH_stFId.FId_AltAPPErrSt "Inhibit Status of FIds / Status of function identifier FId_AltAPPErrSt" UWORD DFC_OneToOne 1 100 0.00 65535.00 FORMAT "%8.2" ECU_ADDRESS 0x60014054 /end MEASUREMENT
/begin MEASUREMENT DINH_stFId.FId_AltBattMngtFailr "Inhibit Status of FIds / Status of function identifier FId_AltBattMngtFailr" UWORD DFC_OneToOne 1 100 0.00 65535.00 FORMAT "%8.2" ECU_ADDRESS 0x60014056 /end MEASUREMENT
/begin MEASUREMENT DINH_stFId.FId_AltBrkErrSt "Inhibit Status of FIds / Status of function identifier FId_AltBrkErrSt" UWORD DFC_OneToOne 1 100 0.00 65535.00 FORMAT "%8.2" ECU_ADDRESS 0x60014058 /end MEASUREMENT
/begin MEASUREMENT DINH_stFId.FId_AltComErr "Inhibit Status of FIds / Status of function identifier FId_AltComErr" UWORD DFC_OneToOne 1 100 0.00 65535.00 FORMAT "%8.2" ECU_ADDRESS 0x6001405A /end MEASUREMENT
/begin MEASUREMENT DINH_stFId.FId_AltENGB "Inhibit Status of FIds / Status of function identifier FId_AltENGB" UWORD DFC_OneToOne 1 100 0.00 65535.00 FORMAT "%8.2" ECU_ADDRESS 0x6001405C /end MEASUREMENT
/begin MEASUREMENT DINH_stFId.FId_AltElecLoadErr "Inhibit Status of FIds / Status of function identifier FId_AltElecLoadErr" UWORD DFC_OneToOne 1 100 0.00 65535.00 FORMAT "%8.2" ECU_ADDRESS 0x6001405E /end MEASUREMENT
/begin MEASUREMENT DINH_stFId.FId_AltEnvTErr "Inhibit Status of FIds / Status of function identifier FId_AltEnvTErr" UWORD DFC_OneToOne 1 100 0.00 65535.00 FORMAT "%8.2" ECU_ADDRESS 0x60014060 /end MEASUREMENT
/begin MEASUREMENT DINH_stFId.FId_AltFFAltLoadFast "Inhibit Status of FIds / Status of function identifier FId_AltFFAltLoadFast" UWORD DFC_OneToOne 1 100 0.00 65535.00 FORMAT "%8.2" ECU_ADDRESS 0x60014062 /end MEASUREMENT
/begin MEASUREMENT DINH_stFId.FId_AltFFAltLoadSlow "Inhibit Status of FIds / Status of function identifier FId_AltFFAltLoadSlow" UWORD DFC_OneToOne 1 100 0.00 65535.00 FORMAT "%8.2" ECU_ADDRESS 0x60014064 /end MEASUREMENT
/begin MEASUREMENT DINH_stFId.FId_AltIOACGErr "Inhibit Status of FIds / Status of function identifier FId_AltIOACGErr" UWORD DFC_OneToOne 1 100 0.00 65535.00 FORMAT "%8.2" ECU_ADDRESS 0x60014066 /end MEASUREMENT
/begin MEASUREMENT DINH_stFId.FId_AltIOACGLinComFailr "Inhibit Status of FIds / Status of function identifier FId_AltIOACGLinComFailr" UWORD DFC_OneToOne 1 100 0.00 65535.00 FORMAT "%8.2" ECU_ADDRESS 0x60014068 /end MEASUREMENT
/begin MEASUREMENT DINH_stFId.FId_AltIOComErr "Inhibit Status of FIds / Status of function identifier FId_AltIOComErr" UWORD DFC_OneToOne 1 100 0.00 65535.00 FORMAT "%8.2" ECU_ADDRESS 0x6001406A /end MEASUREMENT
/begin MEASUREMENT DINH_stFId.FId_AltLinErr "Inhibit Status of FIds / Status of function identifier FId_AltLinErr" UWORD DFC_OneToOne 1 100 0.00 65535.00 FORMAT "%8.2" ECU_ADDRESS 0x6001406C /end MEASUREMENT
/begin MEASUREMENT DINH_stFId.FId_AltPwr "Inhibit Status of FIds / Status of function identifier FId_AltPwr" UWORD DFC_OneToOne 1 100 0.00 65535.00 FORMAT "%8.2" ECU_ADDRESS 0x6001406E /end MEASUREMENT
/begin MEASUREMENT DINH_stFId.FId_AltVehVErrSt "Inhibit Status of FIds / Status of function identifier FId_AltVehVErrSt" UWORD DFC_OneToOne 1 100 0.00 65535.00 FORMAT "%8.2" ECU_ADDRESS 0x60014070 /end MEASUREMENT
/begin MEASUREMENT DINH_stFId.FId_AltvCluFail "Inhibit Status of FIds / Status of function identifier FId_AltvCluFail" UWORD DFC_OneToOne 1 100 0.00 65535.00 FORMAT "%8.2" ECU_ADDRESS 0x60014072 /end MEASUREMENT
/begin MEASUREMENT DINH_stFId.FId_BGAGRTS "Inhibit Status of FIds / Status of function identifier FId_BGAGRTS" UWORD DFC_OneToOne 1 100 0.00 65535.00 FORMAT "%8.2" ECU_ADDRESS 0x60014074 /end MEASUREMENT
/begin MEASUREMENT DINH_stFId.FId_BGFKMSEPSR "Inhibit Status of FIds / Status of function identifier FId_BGFKMSEPSR" UWORD DFC_OneToOne 1 100 0.00 65535.00 FORMAT "%8.2" ECU_ADDRESS 0x60014076 /end MEASUREMENT
/begin MEASUREMENT DINH_stFId.FId_BGFKMSEPU "Inhibit Status of FIds / Status of function identifier FId_BGFKMSEPU" UWORD DFC_OneToOne 1 100 0.00 65535.00 FORMAT "%8.2" ECU_ADDRESS 0x60014078 /end MEASUREMENT
/begin MEASUREMENT DINH_stFId.FId_BGFKMSESumClr "Inhibit Status of FIds / Status of function identifier FId_BGFKMSESumClr" UWORD DFC_OneToOne 1 100 0.00 65535.00 FORMAT "%8.2" ECU_ADDRESS 0x6001407A /end MEASUREMENT
/begin MEASUREMENT DINH_stFId.FId_BGFKMSHFME "Inhibit Status of FIds / Status of function identifier FId_BGFKMSHFME" UWORD DFC_OneToOne 1 100 0.00 65535.00 FORMAT "%8.2" ECU_ADDRESS 0x6001407C /end MEASUREMENT
/begin MEASUREMENT DINH_stFId.FId_BGFKMSHFMZ "Inhibit Status of FIds / Status of function identifier FId_BGFKMSHFMZ" UWORD DFC_OneToOne 1 100 0.00 65535.00 FORMAT "%8.2" ECU_ADDRESS 0x6001407E /end MEASUREMENT
/begin MEASUREMENT DINH_stFId.FId_BGFKMSZPSR "Inhibit Status of FIds / Status of function identifier FId_BGFKMSZPSR" UWORD DFC_OneToOne 1 100 0.00 65535.00 FORMAT "%8.2" ECU_ADDRESS 0x60014080 /end MEASUREMENT
/begin MEASUREMENT DINH_stFId.FId_BGOSCCat1B1 "Inhibit Status of FIds / Status of function identifier FId_BGOSCCat1B1" UWORD DFC_OneToOne 1 100 0.00 65535.00 FORMAT "%8.2" ECU_ADDRESS 0x60014082 /end MEASUREMENT
/begin MEASUREMENT DINH_stFId.FId_BGOSCCat2B1 "Inhibit Status of FIds / Status of function identifier FId_BGOSCCat2B1" UWORD DFC_OneToOne 1 100 0.00 65535.00 FORMAT "%8.2" ECU_ADDRESS 0x60014084 /end MEASUREMENT
/begin MEASUREMENT DINH_stFId.FId_BattAltFailr "Inhibit Status of FIds / Status of function identifier FId_BattAltFailr" UWORD DFC_OneToOne 1 100 0.00 65535.00 FORMAT "%8.2" ECU_ADDRESS 0x60014086 /end MEASUREMENT
/begin MEASUREMENT DINH_stFId.FId_BattMngtFailr "Inhibit Status of FIds / Status of function identifier FId_BattMngtFailr" UWORD DFC_OneToOne 1 100 0.00 65535.00 FORMAT "%8.2" ECU_ADDRESS 0x60014088 /end MEASUREMENT
/begin MEASUREMENT DINH_stFId.FId_BattSigPtd "Inhibit Status of FIds / Status of function identifier FId_BattSigPtd" UWORD DFC_OneToOne 1 100 0.00 65535.00 FORMAT "%8.2" ECU_ADDRESS 0x6001408A /end MEASUREMENT
/begin MEASUREMENT DINH_stFId.FId_BattU2MEDSRC "Inhibit Status of FIds / Status of function identifier FId_BattU2MEDSRC" UWORD DFC_OneToOne 1 100 0.00 65535.00 FORMAT "%8.2" ECU_ADDRESS 0x6001408C /end MEASUREMENT
/begin MEASUREMENT DINH_stFId.FId_BattUDrpPrvOff "Inhibit Status of FIds / Status of function identifier FId_BattUDrpPrvOff" UWORD DFC_OneToOne 1 100 0.00 65535.00 FORMAT "%8.2" ECU_ADDRESS 0x6001408E /end MEASUREMENT
/begin MEASUREMENT DINH_stFId.FId_BattUFrzVal "Inhibit Status of FIds / Status of function identifier FId_BattUFrzVal" UWORD DFC_OneToOne 1 100 0.00 65535.00 FORMAT "%8.2" ECU_ADDRESS 0x60014090 /end MEASUREMENT
/begin MEASUREMENT DINH_stFId.FId_BattUHiFailrEna "Inhibit Status of FIds / Status of function identifier FId_BattUHiFailrEna" UWORD DFC_OneToOne 1 100 0.00 65535.00 FORMAT "%8.2" ECU_ADDRESS 0x60014092 /end MEASUREMENT
/begin MEASUREMENT DINH_stFId.FId_BattUIMGTCUCANFailr "Inhibit Status of FIds / Status of function identifier FId_BattUIMGTCUCANFailr" UWORD DFC_OneToOne 1 100 0.00 65535.00 FORMAT "%8.2" ECU_ADDRESS 0x60014094 /end MEASUREMENT
/begin MEASUREMENT DINH_stFId.FId_BattULoFailrEna "Inhibit Status of FIds / Status of function identifier FId_BattULoFailrEna" UWORD DFC_OneToOne 1 100 0.00 65535.00 FORMAT "%8.2" ECU_ADDRESS 0x60014096 /end MEASUREMENT
/begin MEASUREMENT DINH_stFId.FId_BattUReplVal "Inhibit Status of FIds / Status of function identifier FId_BattUReplVal" UWORD DFC_OneToOne 1 100 0.00 65535.00 FORMAT "%8.2" ECU_ADDRESS 0x60014098 /end MEASUREMENT
/begin MEASUREMENT DINH_stFId.FId_BattUSRC "Inhibit Status of FIds / Status of function identifier FId_BattUSRC" UWORD DFC_OneToOne 1 100 0.00 65535.00 FORMAT "%8.2" ECU_ADDRESS 0x6001409A /end MEASUREMENT
/begin MEASUREMENT DINH_stFId.FId_BlwrComErr "Inhibit Status of FIds / Status of function identifier FId_BlwrComErr" UWORD DFC_OneToOne 1 100 0.00 65535.00 FORMAT "%8.2" ECU_ADDRESS 0x6001409C /end MEASUREMENT
/begin MEASUREMENT DINH_stFId.FId_BrkBstMdl "Inhibit Status of FIds / Status of function identifier FId_BrkBstMdl" UWORD DFC_OneToOne 1 100 0.00 65535.00 FORMAT "%8.2" ECU_ADDRESS 0x6001409E /end MEASUREMENT
/begin MEASUREMENT DINH_stFId.FId_BrkBstMdlBrkP "Inhibit Status of FIds / Status of function identifier FId_BrkBstMdlBrkP" UWORD DFC_OneToOne 1 100 0.00 65535.00 FORMAT "%8.2" ECU_ADDRESS 0x600140A0 /end MEASUREMENT
/begin MEASUREMENT DINH_stFId.FId_BrkBstMdlBrkSt "Inhibit Status of FIds / Status of function identifier FId_BrkBstMdlBrkSt" UWORD DFC_OneToOne 1 100 0.00 65535.00 FORMAT "%8.2" ECU_ADDRESS 0x600140A2 /end MEASUREMENT
/begin MEASUREMENT DINH_stFId.FId_BrkBstMdlEnvP "Inhibit Status of FIds / Status of function identifier FId_BrkBstMdlEnvP" UWORD DFC_OneToOne 1 100 0.00 65535.00 FORMAT "%8.2" ECU_ADDRESS 0x600140A4 /end MEASUREMENT
/begin MEASUREMENT DINH_stFId.FId_BrkBstPDetnInhbn "Inhibit Status of FIds / Status of function identifier FId_BrkBstPDetnInhbn" UWORD DFC_OneToOne 1 100 0.00 65535.00 FORMAT "%8.2" ECU_ADDRESS 0x600140A6 /end MEASUREMENT
/begin MEASUREMENT DINH_stFId.FId_BrkBstPMstCylPSnsrFail "Inhibit Status of FIds / Status of function identifier FId_BrkBstPMstCylPSnsrFail" UWORD DFC_OneToOne 1 100 0.00 65535.00 FORMAT "%8.2" ECU_ADDRESS 0x600140A8 /end MEASUREMENT
/begin MEASUREMENT DINH_stFId.FId_BrkBstPSnsrStuckDetn "Inhibit Status of FIds / Status of function identifier FId_BrkBstPSnsrStuckDetn" UWORD DFC_OneToOne 1 100 0.00 65535.00 FORMAT "%8.2" ECU_ADDRESS 0x600140AA /end MEASUREMENT
/begin MEASUREMENT DINH_stFId.FId_BrkBstSigPath "Inhibit Status of FIds / Status of function identifier FId_BrkBstSigPath" UWORD DFC_OneToOne 1 100 0.00 65535.00 FORMAT "%8.2" ECU_ADDRESS 0x600140AC /end MEASUREMENT
/begin MEASUREMENT DINH_stFId.FId_BrkBstVehVv "Inhibit Status of FIds / Status of function identifier FId_BrkBstVehVv" UWORD DFC_OneToOne 1 100 0.00 65535.00 FORMAT "%8.2" ECU_ADDRESS 0x600140AE /end MEASUREMENT
/begin MEASUREMENT DINH_stFId.FId_BrkMnSwtErr "Inhibit Status of FIds / Status of function identifier FId_BrkMnSwtErr" UWORD DFC_OneToOne 1 100 0.00 65535.00 FORMAT "%8.2" ECU_ADDRESS 0x600140B0 /end MEASUREMENT
/begin MEASUREMENT DINH_stFId.FId_BrkPFrzVal "Inhibit Status of FIds / Status of function identifier FId_BrkPFrzVal" UWORD DFC_OneToOne 1 100 0.00 65535.00 FORMAT "%8.2" ECU_ADDRESS 0x600140B2 /end MEASUREMENT
/begin MEASUREMENT DINH_stFId.FId_BrkPOilPres "Inhibit Status of FIds / Status of function identifier FId_BrkPOilPres" UWORD DFC_OneToOne 1 100 0.00 65535.00 FORMAT "%8.2" ECU_ADDRESS 0x600140B4 /end MEASUREMENT
/begin MEASUREMENT DINH_stFId.FId_BrkPReplVal "Inhibit Status of FIds / Status of function identifier FId_BrkPReplVal" UWORD DFC_OneToOne 1 100 0.00 65535.00 FORMAT "%8.2" ECU_ADDRESS 0x600140B6 /end MEASUREMENT
/begin MEASUREMENT DINH_stFId.FId_BrkPedEngStopEna "Inhibit Status of FIds / Status of function identifier FId_BrkPedEngStopEna" UWORD DFC_OneToOne 1 100 0.00 65535.00 FORMAT "%8.2" ECU_ADDRESS 0x600140B8 /end MEASUREMENT
/begin MEASUREMENT DINH_stFId.FId_BrkRdntSwtErr "Inhibit Status of FIds / Status of function identifier FId_BrkRdntSwtErr" UWORD DFC_OneToOne 1 100 0.00 65535.00 FORMAT "%8.2" ECU_ADDRESS 0x600140BA /end MEASUREMENT
/begin MEASUREMENT DINH_stFId.FId_CAGRSDS "Inhibit Status of FIds / Status of function identifier FId_CAGRSDS" UWORD DFC_OneToOne 1 100 0.00 65535.00 FORMAT "%8.2" ECU_ADDRESS 0x600140BC /end MEASUREMENT
/begin MEASUREMENT DINH_stFId.FId_CEngDsTColdStrt "Inhibit Status of FIds / Status of function identifier FId_CEngDsTColdStrt" UWORD DFC_OneToOne 1 100 0.00 65535.00 FORMAT "%8.2" ECU_ADDRESS 0x600140BE /end MEASUREMENT
/begin MEASUREMENT DINH_stFId.FId_CEngDsTColdStrtErr "Inhibit Status of FIds / Status of function identifier FId_CEngDsTColdStrtErr" UWORD DFC_OneToOne 1 100 0.00 65535.00 FORMAT "%8.2" ECU_ADDRESS 0x600140C0 /end MEASUREMENT
/begin MEASUREMENT DINH_stFId.FId_CEngDsTHSC "Inhibit Status of FIds / Status of function identifier FId_CEngDsTHSC" UWORD DFC_OneToOne 1 100 0.00 65535.00 FORMAT "%8.2" ECU_ADDRESS 0x600140C2 /end MEASUREMENT
/begin MEASUREMENT DINH_stFId.FId_CEngDsTLSC "Inhibit Status of FIds / Status of function identifier FId_CEngDsTLSC" UWORD DFC_OneToOne 1 100 0.00 65535.00 FORMAT "%8.2" ECU_ADDRESS 0x600140C4 /end MEASUREMENT
/begin MEASUREMENT DINH_stFId.FId_CEngDsTPlausErr "Inhibit Status of FIds / Status of function identifier FId_CEngDsTPlausErr" UWORD DFC_OneToOne 1 100 0.00 65535.00 FORMAT "%8.2" ECU_ADDRESS 0x600140C6 /end MEASUREMENT
/begin MEASUREMENT DINH_stFId.FId_CEngDsTReplMdlEngStop "Inhibit Status of FIds / Status of function identifier FId_CEngDsTReplMdlEngStop" UWORD DFC_OneToOne 1 100 0.00 65535.00 FORMAT "%8.2" ECU_ADDRESS 0x600140C8 /end MEASUREMENT
/begin MEASUREMENT DINH_stFId.FId_CEngDsTSTC "Inhibit Status of FIds / Status of function identifier FId_CEngDsTSTC" UWORD DFC_OneToOne 1 100 0.00 65535.00 FORMAT "%8.2" ECU_ADDRESS 0x600140CA /end MEASUREMENT
/begin MEASUREMENT DINH_stFId.FId_CEngDsTSnsrElec "Inhibit Status of FIds / Status of function identifier FId_CEngDsTSnsrElec" UWORD DFC_OneToOne 1 100 0.00 65535.00 FORMAT "%8.2" ECU_ADDRESS 0x600140CC /end MEASUREMENT
/begin MEASUREMENT DINH_stFId.FId_CEngDsTSwtReplMdl "Inhibit Status of FIds / Status of function identifier FId_CEngDsTSwtReplMdl" UWORD DFC_OneToOne 1 100 0.00 65535.00 FORMAT "%8.2" ECU_ADDRESS 0x600140CE /end MEASUREMENT
/begin MEASUREMENT DINH_stFId.FId_CEngUsTColdChkErr "Inhibit Status of FIds / Status of function identifier FId_CEngUsTColdChkErr" UWORD DFC_OneToOne 1 100 0.00 65535.00 FORMAT "%8.2" ECU_ADDRESS 0x600140D0 /end MEASUREMENT
/begin MEASUREMENT DINH_stFId.FId_CEngUsTCrssChk "Inhibit Status of FIds / Status of function identifier FId_CEngUsTCrssChk" UWORD DFC_OneToOne 1 100 0.00 65535.00 FORMAT "%8.2" ECU_ADDRESS 0x600140D2 /end MEASUREMENT
/begin MEASUREMENT DINH_stFId.FId_CEngUsTElecErr "Inhibit Status of FIds / Status of function identifier FId_CEngUsTElecErr" UWORD DFC_OneToOne 1 100 0.00 65535.00 FORMAT "%8.2" ECU_ADDRESS 0x600140D4 /end MEASUREMENT
/begin MEASUREMENT DINH_stFId.FId_CEngUsTSnsrElecErr "Inhibit Status of FIds / Status of function identifier FId_CEngUsTSnsrElecErr" UWORD DFC_OneToOne 1 100 0.00 65535.00 FORMAT "%8.2" ECU_ADDRESS 0x600140D6 /end MEASUREMENT
/begin MEASUREMENT DINH_stFId.FId_CEngUsTSwtReplMdl "Inhibit Status of FIds / Status of function identifier FId_CEngUsTSwtReplMdl" UWORD DFC_OneToOne 1 100 0.00 65535.00 FORMAT "%8.2" ECU_ADDRESS 0x600140D8 /end MEASUREMENT
/begin MEASUREMENT DINH_stFId.FId_CInjCatHeatgDiag "Inhibit Status of FIds / Status of function identifier FId_CInjCatHeatgDiag" UWORD DFC_OneToOne 1 100 0.00 65535.00 FORMAT "%8.2" ECU_ADDRESS 0x600140DA /end MEASUREMENT
/begin MEASUREMENT DINH_stFId.FId_CMSUDKSOM1 "Inhibit Status of FIds / Status of function identifier FId_CMSUDKSOM1" UWORD DFC_OneToOne 1 100 0.00 65535.00 FORMAT "%8.2" ECU_ADDRESS 0x600140DC /end MEASUREMENT
/begin MEASUREMENT DINH_stFId.FId_CMSUDKSOM2 "Inhibit Status of FIds / Status of function identifier FId_CMSUDKSOM2" UWORD DFC_OneToOne 1 100 0.00 65535.00 FORMAT "%8.2" ECU_ADDRESS 0x600140DE /end MEASUREMENT
/begin MEASUREMENT DINH_stFId.FId_CatHeatgEomShtrpAct "Inhibit Status of FIds / Status of function identifier FId_CatHeatgEomShtrpAct" UWORD DFC_OneToOne 1 100 0.00 65535.00 FORMAT "%8.2" ECU_ADDRESS 0x600140E0 /end MEASUREMENT
/begin MEASUREMENT DINH_stFId.FId_ChrctlAgrsErr "Inhibit Status of FIds / Status of function identifier FId_ChrctlAgrsErr" UWORD DFC_OneToOne 1 100 0.00 65535.00 FORMAT "%8.2" ECU_ADDRESS 0x600140E2 /end MEASUREMENT
/begin MEASUREMENT DINH_stFId.FId_ChrctlAgrscf "Inhibit Status of FIds / Status of function identifier FId_ChrctlAgrscf" UWORD DFC_OneToOne 1 100 0.00 65535.00 FORMAT "%8.2" ECU_ADDRESS 0x600140E4 /end MEASUREMENT
/begin MEASUREMENT DINH_stFId.FId_ClntTempENGB "Inhibit Status of FIds / Status of function identifier FId_ClntTempENGB" UWORD DFC_OneToOne 1 100 0.00 65535.00 FORMAT "%8.2" ECU_ADDRESS 0x600140E6 /end MEASUREMENT
/begin MEASUREMENT DINH_stFId.FId_Clth "Inhibit Status of FIds / Status of function identifier FId_Clth" UWORD DFC_OneToOne 1 100 0.00 65535.00 FORMAT "%8.2" ECU_ADDRESS 0x600140E8 /end MEASUREMENT
/begin MEASUREMENT DINH_stFId.FId_Clth2 "Inhibit Status of FIds / Status of function identifier FId_Clth2" UWORD DFC_OneToOne 1 100 0.00 65535.00 FORMAT "%8.2" ECU_ADDRESS 0x600140EA /end MEASUREMENT
/begin MEASUREMENT DINH_stFId.FId_Clth3StuckOn "Inhibit Status of FIds / Status of function identifier FId_Clth3StuckOn" UWORD DFC_OneToOne 1 100 0.00 65535.00 FORMAT "%8.2" ECU_ADDRESS 0x600140EC /end MEASUREMENT
/begin MEASUREMENT DINH_stFId.FId_Clth4 "Inhibit Status of FIds / Status of function identifier FId_Clth4" UWORD DFC_OneToOne 1 100 0.00 65535.00 FORMAT "%8.2" ECU_ADDRESS 0x600140EE /end MEASUREMENT
/begin MEASUREMENT DINH_stFId.FId_ClthCAN "Inhibit Status of FIds / Status of function identifier FId_ClthCAN" UWORD DFC_OneToOne 1 100 0.00 65535.00 FORMAT "%8.2" ECU_ADDRESS 0x600140F0 /end MEASUREMENT
/begin MEASUREMENT DINH_stFId.FId_ClthMax "Inhibit Status of FIds / Status of function identifier FId_ClthMax" UWORD DFC_OneToOne 1 100 0.00 65535.00 FORMAT "%8.2" ECU_ADDRESS 0x600140F2 /end MEASUREMENT
/begin MEASUREMENT DINH_stFId.FId_ClthStk "Inhibit Status of FIds / Status of function identifier FId_ClthStk" UWORD DFC_OneToOne 1 100 0.00 65535.00 FORMAT "%8.2" ECU_ADDRESS 0x600140F4 /end MEASUREMENT
/begin MEASUREMENT DINH_stFId.FId_ClthStkErr "Inhibit Status of FIds / Status of function identifier FId_ClthStkErr" UWORD DFC_OneToOne 1 100 0.00 65535.00 FORMAT "%8.2" ECU_ADDRESS 0x600140F6 /end MEASUREMENT
/begin MEASUREMENT DINH_stFId.FId_ClthStkFailr "Inhibit Status of FIds / Status of function identifier FId_ClthStkFailr" UWORD DFC_OneToOne 1 100 0.00 65535.00 FORMAT "%8.2" ECU_ADDRESS 0x600140F8 /end MEASUREMENT
/begin MEASUREMENT DINH_stFId.FId_ClthStkOFFStuck "Inhibit Status of FIds / Status of function identifier FId_ClthStkOFFStuck" UWORD DFC_OneToOne 1 100 0.00 65535.00 FORMAT "%8.2" ECU_ADDRESS 0x600140FA /end MEASUREMENT
/begin MEASUREMENT DINH_stFId.FId_ClthStkONStuck "Inhibit Status of FIds / Status of function identifier FId_ClthStkONStuck" UWORD DFC_OneToOne 1 100 0.00 65535.00 FORMAT "%8.2" ECU_ADDRESS 0x600140FC /end MEASUREMENT
/begin MEASUREMENT DINH_stFId.FId_ClthSwtFailr "Inhibit Status of FIds / Status of function identifier FId_ClthSwtFailr" UWORD DFC_OneToOne 1 100 0.00 65535.00 FORMAT "%8.2" ECU_ADDRESS 0x600140FE /end MEASUREMENT
/begin MEASUREMENT DINH_stFId.FId_CntrShaftFailr "Inhibit Status of FIds / Status of function identifier FId_CntrShaftFailr" UWORD DFC_OneToOne 1 100 0.00 65535.00 FORMAT "%8.2" ECU_ADDRESS 0x60014100 /end MEASUREMENT
/begin MEASUREMENT DINH_stFId.FId_CoEOMGdiEomErrLcy "Inhibit Status of FIds / Status of function identifier FId_CoEOMGdiEomErrLcy" UWORD DFC_OneToOne 1 100 0.00 65535.00 FORMAT "%8.2" ECU_ADDRESS 0x60014102 /end MEASUREMENT
/begin MEASUREMENT DINH_stFId.FId_CoESSBlowrVld "Inhibit Status of FIds / Status of function identifier FId_CoESSBlowrVld" UWORD DFC_OneToOne 1 100 0.00 65535.00 FORMAT "%8.2" ECU_ADDRESS 0x60014104 /end MEASUREMENT
/begin MEASUREMENT DINH_stFId.FId_CoETM "Inhibit Status of FIds / Status of function identifier FId_CoETM" UWORD DFC_OneToOne 1 100 0.00 65535.00 FORMAT "%8.2" ECU_ADDRESS 0x60014106 /end MEASUREMENT
/begin MEASUREMENT DINH_stFId.FId_CoETS_StTrqLimErr1 "Inhibit Status of FIds / Status of function identifier FId_CoETS_StTrqLimErr1" UWORD DFC_OneToOne 1 100 0.00 65535.00 FORMAT "%8.2" ECU_ADDRESS 0x60014108 /end MEASUREMENT
/begin MEASUREMENT DINH_stFId.FId_CoETS_StTrqLimErr2 "Inhibit Status of FIds / Status of function identifier FId_CoETS_StTrqLimErr2" UWORD DFC_OneToOne 1 100 0.00 65535.00 FORMAT "%8.2" ECU_ADDRESS 0x6001410A /end MEASUREMENT
/begin MEASUREMENT DINH_stFId.FId_CoEngStopEnblStSpEngT "Inhibit Status of FIds / Status of function identifier FId_CoEngStopEnblStSpEngT" UWORD DFC_OneToOne 1 100 0.00 65535.00 FORMAT "%8.2" ECU_ADDRESS 0x6001410C /end MEASUREMENT
/begin MEASUREMENT DINH_stFId.FId_CoEngStopEnblStSpLSU "Inhibit Status of FIds / Status of function identifier FId_CoEngStopEnblStSpLSU" UWORD DFC_OneToOne 1 100 0.00 65535.00 FORMAT "%8.2" ECU_ADDRESS 0x6001410E /end MEASUREMENT
/begin MEASUREMENT DINH_stFId.FId_CoEngStopEnblStSpTcT "Inhibit Status of FIds / Status of function identifier FId_CoEngStopEnblStSpTcT" UWORD DFC_OneToOne 1 100 0.00 65535.00 FORMAT "%8.2" ECU_ADDRESS 0x60014110 /end MEASUREMENT
/begin MEASUREMENT DINH_stFId.FId_CoEngStopEnblSysErr "Inhibit Status of FIds / Status of function identifier FId_CoEngStopEnblSysErr" UWORD DFC_OneToOne 1 100 0.00 65535.00 FORMAT "%8.2" ECU_ADDRESS 0x60014112 /end MEASUREMENT
/begin MEASUREMENT DINH_stFId.FId_CoEngVlvLftSpIntk "Inhibit Status of FIds / Status of function identifier FId_CoEngVlvLftSpIntk" UWORD DFC_OneToOne 1 100 0.00 65535.00 FORMAT "%8.2" ECU_ADDRESS 0x60014114 /end MEASUREMENT
/begin MEASUREMENT DINH_stFId.FId_CoPOMStrtgDevStrtr "Inhibit Status of FIds / Status of function identifier FId_CoPOMStrtgDevStrtr" UWORD DFC_OneToOne 1 100 0.00 65535.00 FORMAT "%8.2" ECU_ADDRESS 0x60014116 /end MEASUREMENT
/begin MEASUREMENT DINH_stFId.FId_CoPOM_FirstStrtAut "Inhibit Status of FIds / Status of function identifier FId_CoPOM_FirstStrtAut" UWORD DFC_OneToOne 1 100 0.00 65535.00 FORMAT "%8.2" ECU_ADDRESS 0x60014118 /end MEASUREMENT
/begin MEASUREMENT DINH_stFId.FId_CoTS_SwtOff "Inhibit Status of FIds / Status of function identifier FId_CoTS_SwtOff" UWORD DFC_OneToOne 1 100 0.00 65535.00 FORMAT "%8.2" ECU_ADDRESS 0x6001411A /end MEASUREMENT
/begin MEASUREMENT DINH_stFId.FId_CoVOMACCComFailr "Inhibit Status of FIds / Status of function identifier FId_CoVOMACCComFailr" UWORD DFC_OneToOne 1 100 0.00 65535.00 FORMAT "%8.2" ECU_ADDRESS 0x6001411C /end MEASUREMENT
/begin MEASUREMENT DINH_stFId.FId_CoVOMBrkPedISABSigFailr "Inhibit Status of FIds / Status of function identifier FId_CoVOMBrkPedISABSigFailr" UWORD DFC_OneToOne 1 100 0.00 65535.00 FORMAT "%8.2" ECU_ADDRESS 0x6001411E /end MEASUREMENT
/begin MEASUREMENT DINH_stFId.FId_CoVOMEngCrkAbort "Inhibit Status of FIds / Status of function identifier FId_CoVOMEngCrkAbort" UWORD DFC_OneToOne 1 100 0.00 65535.00 FORMAT "%8.2" ECU_ADDRESS 0x60014120 /end MEASUREMENT
/begin MEASUREMENT DINH_stFId.FId_CoVOMEngRstrtEnaCdn "Inhibit Status of FIds / Status of function identifier FId_CoVOMEngRstrtEnaCdn" UWORD DFC_OneToOne 1 100 0.00 65535.00 FORMAT "%8.2" ECU_ADDRESS 0x60014122 /end MEASUREMENT
/begin MEASUREMENT DINH_stFId.FId_CoVOMISSEng "Inhibit Status of FIds / Status of function identifier FId_CoVOMISSEng" UWORD DFC_OneToOne 1 100 0.00 65535.00 FORMAT "%8.2" ECU_ADDRESS 0x60014124 /end MEASUREMENT
/begin MEASUREMENT DINH_stFId.FId_ComACRly "Inhibit Status of FIds / Status of function identifier FId_ComACRly" UWORD DFC_OneToOne 1 100 0.00 65535.00 FORMAT "%8.2" ECU_ADDRESS 0x60014126 /end MEASUREMENT
/begin MEASUREMENT DINH_stFId.FId_ComAPPSensFail "Inhibit Status of FIds / Status of function identifier FId_ComAPPSensFail" UWORD DFC_OneToOne 1 100 0.00 65535.00 FORMAT "%8.2" ECU_ADDRESS 0x60014128 /end MEASUREMENT
/begin MEASUREMENT DINH_stFId.FId_ComAPedl "Inhibit Status of FIds / Status of function identifier FId_ComAPedl" UWORD DFC_OneToOne 1 100 0.00 65535.00 FORMAT "%8.2" ECU_ADDRESS 0x6001412A /end MEASUREMENT
/begin MEASUREMENT DINH_stFId.FId_ComAYCA "Inhibit Status of FIds / Status of function identifier FId_ComAYCA" UWORD DFC_OneToOne 1 100 0.00 65535.00 FORMAT "%8.2" ECU_ADDRESS 0x6001412C /end MEASUREMENT
/begin MEASUREMENT DINH_stFId.FId_ComAYCAMon "Inhibit Status of FIds / Status of function identifier FId_ComAYCAMon" UWORD DFC_OneToOne 1 100 0.00 65535.00 FORMAT "%8.2" ECU_ADDRESS 0x6001412E /end MEASUREMENT
/begin MEASUREMENT DINH_stFId.FId_ComAYCD "Inhibit Status of FIds / Status of function identifier FId_ComAYCD" UWORD DFC_OneToOne 1 100 0.00 65535.00 FORMAT "%8.2" ECU_ADDRESS 0x60014130 /end MEASUREMENT
/begin MEASUREMENT DINH_stFId.FId_ComAYCDMon "Inhibit Status of FIds / Status of function identifier FId_ComAYCDMon" UWORD DFC_OneToOne 1 100 0.00 65535.00 FORMAT "%8.2" ECU_ADDRESS 0x60014132 /end MEASUREMENT
/begin MEASUREMENT DINH_stFId.FId_ComAYCF "Inhibit Status of FIds / Status of function identifier FId_ComAYCF" UWORD DFC_OneToOne 1 100 0.00 65535.00 FORMAT "%8.2" ECU_ADDRESS 0x60014134 /end MEASUREMENT
/begin MEASUREMENT DINH_stFId.FId_ComAYCFMon "Inhibit Status of FIds / Status of function identifier FId_ComAYCFMon" UWORD DFC_OneToOne 1 100 0.00 65535.00 FORMAT "%8.2" ECU_ADDRESS 0x60014136 /end MEASUREMENT
/begin MEASUREMENT DINH_stFId.FId_ComAYCG "Inhibit Status of FIds / Status of function identifier FId_ComAYCG" UWORD DFC_OneToOne 1 100 0.00 65535.00 FORMAT "%8.2" ECU_ADDRESS 0x60014138 /end MEASUREMENT
/begin MEASUREMENT DINH_stFId.FId_ComAYCGMon "Inhibit Status of FIds / Status of function identifier FId_ComAYCGMon" UWORD DFC_OneToOne 1 100 0.00 65535.00 FORMAT "%8.2" ECU_ADDRESS 0x6001413A /end MEASUREMENT
/begin MEASUREMENT DINH_stFId.FId_ComAYCI "Inhibit Status of FIds / Status of function identifier FId_ComAYCI" UWORD DFC_OneToOne 1 100 0.00 65535.00 FORMAT "%8.2" ECU_ADDRESS 0x6001413C /end MEASUREMENT
/begin MEASUREMENT DINH_stFId.FId_ComAYCIMon "Inhibit Status of FIds / Status of function identifier FId_ComAYCIMon" UWORD DFC_OneToOne 1 100 0.00 65535.00 FORMAT "%8.2" ECU_ADDRESS 0x6001413E /end MEASUREMENT
/begin MEASUREMENT DINH_stFId.FId_ComAirPThrUsSnsrErr "Inhibit Status of FIds / Status of function identifier FId_ComAirPThrUsSnsrErr" UWORD DFC_OneToOne 1 100 0.00 65535.00 FORMAT "%8.2" ECU_ADDRESS 0x60014140 /end MEASUREMENT
/begin MEASUREMENT DINH_stFId.FId_ComAltFail "Inhibit Status of FIds / Status of function identifier FId_ComAltFail" UWORD DFC_OneToOne 1 100 0.00 65535.00 FORMAT "%8.2" ECU_ADDRESS 0x60014142 /end MEASUREMENT
/begin MEASUREMENT DINH_stFId.FId_ComAppVehSnsrFailr "Inhibit Status of FIds / Status of function identifier FId_ComAppVehSnsrFailr" UWORD DFC_OneToOne 1 100 0.00 65535.00 FORMAT "%8.2" ECU_ADDRESS 0x60014144 /end MEASUREMENT
/begin MEASUREMENT DINH_stFId.FId_ComBCM1 "Inhibit Status of FIds / Status of function identifier FId_ComBCM1" UWORD DFC_OneToOne 1 100 0.00 65535.00 FORMAT "%8.2" ECU_ADDRESS 0x60014146 /end MEASUREMENT
/begin MEASUREMENT DINH_stFId.FId_ComBCM1Mon "Inhibit Status of FIds / Status of function identifier FId_ComBCM1Mon" UWORD DFC_OneToOne 1 100 0.00 65535.00 FORMAT "%8.2" ECU_ADDRESS 0x60014148 /end MEASUREMENT
/begin MEASUREMENT DINH_stFId.FId_ComBCMUnitCfmdErr "Inhibit Status of FIds / Status of function identifier FId_ComBCMUnitCfmdErr" UWORD DFC_OneToOne 1 100 0.00 65535.00 FORMAT "%8.2" ECU_ADDRESS 0x6001414A /end MEASUREMENT
/begin MEASUREMENT DINH_stFId.FId_ComBCMUnitNotTstd "Inhibit Status of FIds / Status of function identifier FId_ComBCMUnitNotTstd" UWORD DFC_OneToOne 1 100 0.00 65535.00 FORMAT "%8.2" ECU_ADDRESS 0x6001414C /end MEASUREMENT
/begin MEASUREMENT DINH_stFId.FId_ComBstCtrl "Inhibit Status of FIds / Status of function identifier FId_ComBstCtrl" UWORD DFC_OneToOne 1 100 0.00 65535.00 FORMAT "%8.2" ECU_ADDRESS 0x6001414E /end MEASUREMENT
/begin MEASUREMENT DINH_stFId.FId_ComCANVEHICLEBusOff "Inhibit Status of FIds / Status of function identifier FId_ComCANVEHICLEBusOff" UWORD DFC_OneToOne 1 100 0.00 65535.00 FORMAT "%8.2" ECU_ADDRESS 0x60014150 /end MEASUREMENT
/begin MEASUREMENT DINH_stFId.FId_ComCGW1 "Inhibit Status of FIds / Status of function identifier FId_ComCGW1" UWORD DFC_OneToOne 1 100 0.00 65535.00 FORMAT "%8.2" ECU_ADDRESS 0x60014152 /end MEASUREMENT
/begin MEASUREMENT DINH_stFId.FId_ComCGW1Mon "Inhibit Status of FIds / Status of function identifier FId_ComCGW1Mon" UWORD DFC_OneToOne 1 100 0.00 65535.00 FORMAT "%8.2" ECU_ADDRESS 0x60014154 /end MEASUREMENT
/begin MEASUREMENT DINH_stFId.FId_ComClthSt "Inhibit Status of FIds / Status of function identifier FId_ComClthSt" UWORD DFC_OneToOne 1 100 0.00 65535.00 FORMAT "%8.2" ECU_ADDRESS 0x60014156 /end MEASUREMENT
/begin MEASUREMENT DINH_stFId.FId_ComConvClth "Inhibit Status of FIds / Status of function identifier FId_ComConvClth" UWORD DFC_OneToOne 1 100 0.00 65535.00 FORMAT "%8.2" ECU_ADDRESS 0x60014158 /end MEASUREMENT
/begin MEASUREMENT DINH_stFId.FId_ComCrCtlReq "Inhibit Status of FIds / Status of function identifier FId_ComCrCtlReq" UWORD DFC_OneToOne 1 100 0.00 65535.00 FORMAT "%8.2" ECU_ADDRESS 0x6001415A /end MEASUREMENT
/begin MEASUREMENT DINH_stFId.FId_ComCrsMaiIndcnLampReq "Inhibit Status of FIds / Status of function identifier FId_ComCrsMaiIndcnLampReq" UWORD DFC_OneToOne 1 100 0.00 65535.00 FORMAT "%8.2" ECU_ADDRESS 0x6001415C /end MEASUREMENT
/begin MEASUREMENT DINH_stFId.FId_ComCrsSetIndcnLampReq "Inhibit Status of FIds / Status of function identifier FId_ComCrsSetIndcnLampReq" UWORD DFC_OneToOne 1 100 0.00 65535.00 FORMAT "%8.2" ECU_ADDRESS 0x6001415E /end MEASUREMENT
/begin MEASUREMENT DINH_stFId.FId_ComDCDCCdn "Inhibit Status of FIds / Status of function identifier FId_ComDCDCCdn" UWORD DFC_OneToOne 1 100 0.00 65535.00 FORMAT "%8.2" ECU_ADDRESS 0x60014160 /end MEASUREMENT
/begin MEASUREMENT DINH_stFId.FId_ComDCDCErr "Inhibit Status of FIds / Status of function identifier FId_ComDCDCErr" UWORD DFC_OneToOne 1 100 0.00 65535.00 FORMAT "%8.2" ECU_ADDRESS 0x60014162 /end MEASUREMENT
/begin MEASUREMENT DINH_stFId.FId_ComDesGearCurr "Inhibit Status of FIds / Status of function identifier FId_ComDesGearCurr" UWORD DFC_OneToOne 1 100 0.00 65535.00 FORMAT "%8.2" ECU_ADDRESS 0x60014164 /end MEASUREMENT
/begin MEASUREMENT DINH_stFId.FId_ComDetrmAirM "Inhibit Status of FIds / Status of function identifier FId_ComDetrmAirM" UWORD DFC_OneToOne 1 100 0.00 65535.00 FORMAT "%8.2" ECU_ADDRESS 0x60014166 /end MEASUREMENT
/begin MEASUREMENT DINH_stFId.FId_ComDwnShiftCtrlReq "Inhibit Status of FIds / Status of function identifier FId_ComDwnShiftCtrlReq" UWORD DFC_OneToOne 1 100 0.00 65535.00 FORMAT "%8.2" ECU_ADDRESS 0x60014168 /end MEASUREMENT
/begin MEASUREMENT DINH_stFId.FId_ComEAT1 "Inhibit Status of FIds / Status of function identifier FId_ComEAT1" UWORD DFC_OneToOne 1 100 0.00 65535.00 FORMAT "%8.2" ECU_ADDRESS 0x6001416A /end MEASUREMENT
/begin MEASUREMENT DINH_stFId.FId_ComEAT10 "Inhibit Status of FIds / Status of function identifier FId_ComEAT10" UWORD DFC_OneToOne 1 100 0.00 65535.00 FORMAT "%8.2" ECU_ADDRESS 0x6001416C /end MEASUREMENT
/begin MEASUREMENT DINH_stFId.FId_ComEAT10Mon "Inhibit Status of FIds / Status of function identifier FId_ComEAT10Mon" UWORD DFC_OneToOne 1 100 0.00 65535.00 FORMAT "%8.2" ECU_ADDRESS 0x6001416E /end MEASUREMENT
/begin MEASUREMENT DINH_stFId.FId_ComEAT11 "Inhibit Status of FIds / Status of function identifier FId_ComEAT11" UWORD DFC_OneToOne 1 100 0.00 65535.00 FORMAT "%8.2" ECU_ADDRESS 0x60014170 /end MEASUREMENT
/begin MEASUREMENT DINH_stFId.FId_ComEAT11Mon "Inhibit Status of FIds / Status of function identifier FId_ComEAT11Mon" UWORD DFC_OneToOne 1 100 0.00 65535.00 FORMAT "%8.2" ECU_ADDRESS 0x60014172 /end MEASUREMENT
/begin MEASUREMENT DINH_stFId.FId_ComEAT12 "Inhibit Status of FIds / Status of function identifier FId_ComEAT12" UWORD DFC_OneToOne 1 100 0.00 65535.00 FORMAT "%8.2" ECU_ADDRESS 0x60014174 /end MEASUREMENT
/begin MEASUREMENT DINH_stFId.FId_ComEAT12Mon "Inhibit Status of FIds / Status of function identifier FId_ComEAT12Mon" UWORD DFC_OneToOne 1 100 0.00 65535.00 FORMAT "%8.2" ECU_ADDRESS 0x60014176 /end MEASUREMENT
/begin MEASUREMENT DINH_stFId.FId_ComEAT13 "Inhibit Status of FIds / Status of function identifier FId_ComEAT13" UWORD DFC_OneToOne 1 100 0.00 65535.00 FORMAT "%8.2" ECU_ADDRESS 0x60014178 /end MEASUREMENT
/begin MEASUREMENT DINH_stFId.FId_ComEAT13Mon "Inhibit Status of FIds / Status of function identifier FId_ComEAT13Mon" UWORD DFC_OneToOne 1 100 0.00 65535.00 FORMAT "%8.2" ECU_ADDRESS 0x6001417A /end MEASUREMENT
/begin MEASUREMENT DINH_stFId.FId_ComEAT1Mon "Inhibit Status of FIds / Status of function identifier FId_ComEAT1Mon" UWORD DFC_OneToOne 1 100 0.00 65535.00 FORMAT "%8.2" ECU_ADDRESS 0x6001417C /end MEASUREMENT
/begin MEASUREMENT DINH_stFId.FId_ComEAT2 "Inhibit Status of FIds / Status of function identifier FId_ComEAT2" UWORD DFC_OneToOne 1 100 0.00 65535.00 FORMAT "%8.2" ECU_ADDRESS 0x6001417E /end MEASUREMENT
/begin MEASUREMENT DINH_stFId.FId_ComEAT2Mon "Inhibit Status of FIds / Status of function identifier FId_ComEAT2Mon" UWORD DFC_OneToOne 1 100 0.00 65535.00 FORMAT "%8.2" ECU_ADDRESS 0x60014180 /end MEASUREMENT
/begin MEASUREMENT DINH_stFId.FId_ComEAT4 "Inhibit Status of FIds / Status of function identifier FId_ComEAT4" UWORD DFC_OneToOne 1 100 0.00 65535.00 FORMAT "%8.2" ECU_ADDRESS 0x60014182 /end MEASUREMENT
/begin MEASUREMENT DINH_stFId.FId_ComEAT4Mon "Inhibit Status of FIds / Status of function identifier FId_ComEAT4Mon" UWORD DFC_OneToOne 1 100 0.00 65535.00 FORMAT "%8.2" ECU_ADDRESS 0x60014184 /end MEASUREMENT
/begin MEASUREMENT DINH_stFId.FId_ComEAT6 "Inhibit Status of FIds / Status of function identifier FId_ComEAT6" UWORD DFC_OneToOne 1 100 0.00 65535.00 FORMAT "%8.2" ECU_ADDRESS 0x60014186 /end MEASUREMENT
/begin MEASUREMENT DINH_stFId.FId_ComEAT6Mon "Inhibit Status of FIds / Status of function identifier FId_ComEAT6Mon" UWORD DFC_OneToOne 1 100 0.00 65535.00 FORMAT "%8.2" ECU_ADDRESS 0x60014188 /end MEASUREMENT
/begin MEASUREMENT DINH_stFId.FId_ComEAT7 "Inhibit Status of FIds / Status of function identifier FId_ComEAT7" UWORD DFC_OneToOne 1 100 0.00 65535.00 FORMAT "%8.2" ECU_ADDRESS 0x6001418A /end MEASUREMENT
/begin MEASUREMENT DINH_stFId.FId_ComEAT7Mon "Inhibit Status of FIds / Status of function identifier FId_ComEAT7Mon" UWORD DFC_OneToOne 1 100 0.00 65535.00 FORMAT "%8.2" ECU_ADDRESS 0x6001418C /end MEASUREMENT
/begin MEASUREMENT DINH_stFId.FId_ComEAT8 "Inhibit Status of FIds / Status of function identifier FId_ComEAT8" UWORD DFC_OneToOne 1 100 0.00 65535.00 FORMAT "%8.2" ECU_ADDRESS 0x6001418E /end MEASUREMENT
/begin MEASUREMENT DINH_stFId.FId_ComEAT8Mon "Inhibit Status of FIds / Status of function identifier FId_ComEAT8Mon" UWORD DFC_OneToOne 1 100 0.00 65535.00 FORMAT "%8.2" ECU_ADDRESS 0x60014190 /end MEASUREMENT
/begin MEASUREMENT DINH_stFId.FId_ComEATA "Inhibit Status of FIds / Status of function identifier FId_ComEATA" UWORD DFC_OneToOne 1 100 0.00 65535.00 FORMAT "%8.2" ECU_ADDRESS 0x60014192 /end MEASUREMENT
/begin MEASUREMENT DINH_stFId.FId_ComEATAMon "Inhibit Status of FIds / Status of function identifier FId_ComEATAMon" UWORD DFC_OneToOne 1 100 0.00 65535.00 FORMAT "%8.2" ECU_ADDRESS 0x60014194 /end MEASUREMENT
/begin MEASUREMENT DINH_stFId.FId_ComEATB "Inhibit Status of FIds / Status of function identifier FId_ComEATB" UWORD DFC_OneToOne 1 100 0.00 65535.00 FORMAT "%8.2" ECU_ADDRESS 0x60014196 /end MEASUREMENT
/begin MEASUREMENT DINH_stFId.FId_ComEATBMon "Inhibit Status of FIds / Status of function identifier FId_ComEATBMon" UWORD DFC_OneToOne 1 100 0.00 65535.00 FORMAT "%8.2" ECU_ADDRESS 0x60014198 /end MEASUREMENT
/begin MEASUREMENT DINH_stFId.FId_ComEATC "Inhibit Status of FIds / Status of function identifier FId_ComEATC" UWORD DFC_OneToOne 1 100 0.00 65535.00 FORMAT "%8.2" ECU_ADDRESS 0x6001419A /end MEASUREMENT
/begin MEASUREMENT DINH_stFId.FId_ComEATCMon "Inhibit Status of FIds / Status of function identifier FId_ComEATCMon" UWORD DFC_OneToOne 1 100 0.00 65535.00 FORMAT "%8.2" ECU_ADDRESS 0x6001419C /end MEASUREMENT
/begin MEASUREMENT DINH_stFId.FId_ComEBSSelfDiagErr "Inhibit Status of FIds / Status of function identifier FId_ComEBSSelfDiagErr" UWORD DFC_OneToOne 1 100 0.00 65535.00 FORMAT "%8.2" ECU_ADDRESS 0x6001419E /end MEASUREMENT
/begin MEASUREMENT DINH_stFId.FId_ComECUHwErr "Inhibit Status of FIds / Status of function identifier FId_ComECUHwErr" UWORD DFC_OneToOne 1 100 0.00 65535.00 FORMAT "%8.2" ECU_ADDRESS 0x600141A0 /end MEASUREMENT
/begin MEASUREMENT DINH_stFId.FId_ComEGRVlvErr "Inhibit Status of FIds / Status of function identifier FId_ComEGRVlvErr" UWORD DFC_OneToOne 1 100 0.00 65535.00 FORMAT "%8.2" ECU_ADDRESS 0x600141A2 /end MEASUREMENT
/begin MEASUREMENT DINH_stFId.FId_ComEMSIntAirTemp "Inhibit Status of FIds / Status of function identifier FId_ComEMSIntAirTemp" UWORD DFC_OneToOne 1 100 0.00 65535.00 FORMAT "%8.2" ECU_ADDRESS 0x600141A4 /end MEASUREMENT
/begin MEASUREMENT DINH_stFId.FId_ComEPB "Inhibit Status of FIds / Status of function identifier FId_ComEPB" UWORD DFC_OneToOne 1 100 0.00 65535.00 FORMAT "%8.2" ECU_ADDRESS 0x600141A6 /end MEASUREMENT
/begin MEASUREMENT DINH_stFId.FId_ComEPBB "Inhibit Status of FIds / Status of function identifier FId_ComEPBB" UWORD DFC_OneToOne 1 100 0.00 65535.00 FORMAT "%8.2" ECU_ADDRESS 0x600141A8 /end MEASUREMENT
/begin MEASUREMENT DINH_stFId.FId_ComEPBBMon "Inhibit Status of FIds / Status of function identifier FId_ComEPBBMon" UWORD DFC_OneToOne 1 100 0.00 65535.00 FORMAT "%8.2" ECU_ADDRESS 0x600141AA /end MEASUREMENT
/begin MEASUREMENT DINH_stFId.FId_ComEPBMon "Inhibit Status of FIds / Status of function identifier FId_ComEPBMon" UWORD DFC_OneToOne 1 100 0.00 65535.00 FORMAT "%8.2" ECU_ADDRESS 0x600141AC /end MEASUREMENT
/begin MEASUREMENT DINH_stFId.FId_ComEPS1 "Inhibit Status of FIds / Status of function identifier FId_ComEPS1" UWORD DFC_OneToOne 1 100 0.00 65535.00 FORMAT "%8.2" ECU_ADDRESS 0x600141AE /end MEASUREMENT
/begin MEASUREMENT DINH_stFId.FId_ComEPS1Mon "Inhibit Status of FIds / Status of function identifier FId_ComEPS1Mon" UWORD DFC_OneToOne 1 100 0.00 65535.00 FORMAT "%8.2" ECU_ADDRESS 0x600141B0 /end MEASUREMENT
/begin MEASUREMENT DINH_stFId.FId_ComEPSUnitCfmdErr "Inhibit Status of FIds / Status of function identifier FId_ComEPSUnitCfmdErr" UWORD DFC_OneToOne 1 100 0.00 65535.00 FORMAT "%8.2" ECU_ADDRESS 0x600141B2 /end MEASUREMENT
/begin MEASUREMENT DINH_stFId.FId_ComEPSUnitNotTstd "Inhibit Status of FIds / Status of function identifier FId_ComEPSUnitNotTstd" UWORD DFC_OneToOne 1 100 0.00 65535.00 FORMAT "%8.2" ECU_ADDRESS 0x600141B4 /end MEASUREMENT
/begin MEASUREMENT DINH_stFId.FId_ComEngBrkOvrdInfo "Inhibit Status of FIds / Status of function identifier FId_ComEngBrkOvrdInfo" UWORD DFC_OneToOne 1 100 0.00 65535.00 FORMAT "%8.2" ECU_ADDRESS 0x600141B6 /end MEASUREMENT
/begin MEASUREMENT DINH_stFId.FId_ComEngBrkOvrdMtr "Inhibit Status of FIds / Status of function identifier FId_ComEngBrkOvrdMtr" UWORD DFC_OneToOne 1 100 0.00 65535.00 FORMAT "%8.2" ECU_ADDRESS 0x600141B8 /end MEASUREMENT
/begin MEASUREMENT DINH_stFId.FId_ComEngBrkSwErr "Inhibit Status of FIds / Status of function identifier FId_ComEngBrkSwErr" UWORD DFC_OneToOne 1 100 0.00 65535.00 FORMAT "%8.2" ECU_ADDRESS 0x600141BA /end MEASUREMENT
/begin MEASUREMENT DINH_stFId.FId_ComEngPosng "Inhibit Status of FIds / Status of function identifier FId_ComEngPosng" UWORD DFC_OneToOne 1 100 0.00 65535.00 FORMAT "%8.2" ECU_ADDRESS 0x600141BC /end MEASUREMENT
/begin MEASUREMENT DINH_stFId.FId_ComEngRPMLim "Inhibit Status of FIds / Status of function identifier FId_ComEngRPMLim" UWORD DFC_OneToOne 1 100 0.00 65535.00 FORMAT "%8.2" ECU_ADDRESS 0x600141BE /end MEASUREMENT
/begin MEASUREMENT DINH_stFId.FId_ComEngTrqLim "Inhibit Status of FIds / Status of function identifier FId_ComEngTrqLim" UWORD DFC_OneToOne 1 100 0.00 65535.00 FORMAT "%8.2" ECU_ADDRESS 0x600141C0 /end MEASUREMENT
/begin MEASUREMENT DINH_stFId.FId_ComEnvtlAirPSnsrErr "Inhibit Status of FIds / Status of function identifier FId_ComEnvtlAirPSnsrErr" UWORD DFC_OneToOne 1 100 0.00 65535.00 FORMAT "%8.2" ECU_ADDRESS 0x600141C2 /end MEASUREMENT
/begin MEASUREMENT DINH_stFId.FId_ComEstmTqNormJdg "Inhibit Status of FIds / Status of function identifier FId_ComEstmTqNormJdg" UWORD DFC_OneToOne 1 100 0.00 65535.00 FORMAT "%8.2" ECU_ADDRESS 0x600141C4 /end MEASUREMENT
/begin MEASUREMENT DINH_stFId.FId_ComEthnlSErr "Inhibit Status of FIds / Status of function identifier FId_ComEthnlSErr" UWORD DFC_OneToOne 1 100 0.00 65535.00 FORMAT "%8.2" ECU_ADDRESS 0x600141C6 /end MEASUREMENT
/begin MEASUREMENT DINH_stFId.FId_ComFlSply "Inhibit Status of FIds / Status of function identifier FId_ComFlSply" UWORD DFC_OneToOne 1 100 0.00 65535.00 FORMAT "%8.2" ECU_ADDRESS 0x600141C8 /end MEASUREMENT
/begin MEASUREMENT DINH_stFId.FId_ComFuCnsBitDurgIdleStop "Inhibit Status of FIds / Status of function identifier FId_ComFuCnsBitDurgIdleStop" UWORD DFC_OneToOne 1 100 0.00 65535.00 FORMAT "%8.2" ECU_ADDRESS 0x600141CA /end MEASUREMENT
/begin MEASUREMENT DINH_stFId.FId_ComGEVCntrl "Inhibit Status of FIds / Status of function identifier FId_ComGEVCntrl" UWORD DFC_OneToOne 1 100 0.00 65535.00 FORMAT "%8.2" ECU_ADDRESS 0x600141CC /end MEASUREMENT
/begin MEASUREMENT DINH_stFId.FId_ComGbxNPosFail "Inhibit Status of FIds / Status of function identifier FId_ComGbxNPosFail" UWORD DFC_OneToOne 1 100 0.00 65535.00 FORMAT "%8.2" ECU_ADDRESS 0x600141CE /end MEASUREMENT
/begin MEASUREMENT DINH_stFId.FId_ComGbxTemp "Inhibit Status of FIds / Status of function identifier FId_ComGbxTemp" UWORD DFC_OneToOne 1 100 0.00 65535.00 FORMAT "%8.2" ECU_ADDRESS 0x600141D0 /end MEASUREMENT
/begin MEASUREMENT DINH_stFId.FId_ComGwIMG1 "Inhibit Status of FIds / Status of function identifier FId_ComGwIMG1" UWORD DFC_OneToOne 1 100 0.00 65535.00 FORMAT "%8.2" ECU_ADDRESS 0x600141D2 /end MEASUREMENT
/begin MEASUREMENT DINH_stFId.FId_ComGwIMG1Mon "Inhibit Status of FIds / Status of function identifier FId_ComGwIMG1Mon" UWORD DFC_OneToOne 1 100 0.00 65535.00 FORMAT "%8.2" ECU_ADDRESS 0x600141D4 /end MEASUREMENT
/begin MEASUREMENT DINH_stFId.FId_ComGwIMG3 "Inhibit Status of FIds / Status of function identifier FId_ComGwIMG3" UWORD DFC_OneToOne 1 100 0.00 65535.00 FORMAT "%8.2" ECU_ADDRESS 0x600141D6 /end MEASUREMENT
/begin MEASUREMENT DINH_stFId.FId_ComGwIMG3Mon "Inhibit Status of FIds / Status of function identifier FId_ComGwIMG3Mon" UWORD DFC_OneToOne 1 100 0.00 65535.00 FORMAT "%8.2" ECU_ADDRESS 0x600141D8 /end MEASUREMENT
/begin MEASUREMENT DINH_stFId.FId_ComGwIMG4 "Inhibit Status of FIds / Status of function identifier FId_ComGwIMG4" UWORD DFC_OneToOne 1 100 0.00 65535.00 FORMAT "%8.2" ECU_ADDRESS 0x600141DA /end MEASUREMENT
/begin MEASUREMENT DINH_stFId.FId_ComGwIMG4Mon "Inhibit Status of FIds / Status of function identifier FId_ComGwIMG4Mon" UWORD DFC_OneToOne 1 100 0.00 65535.00 FORMAT "%8.2" ECU_ADDRESS 0x600141DC /end MEASUREMENT
/begin MEASUREMENT DINH_stFId.FId_ComGwIMG5 "Inhibit Status of FIds / Status of function identifier FId_ComGwIMG5" UWORD DFC_OneToOne 1 100 0.00 65535.00 FORMAT "%8.2" ECU_ADDRESS 0x600141DE /end MEASUREMENT
/begin MEASUREMENT DINH_stFId.FId_ComGwIMG5Mon "Inhibit Status of FIds / Status of function identifier FId_ComGwIMG5Mon" UWORD DFC_OneToOne 1 100 0.00 65535.00 FORMAT "%8.2" ECU_ADDRESS 0x600141E0 /end MEASUREMENT
/begin MEASUREMENT DINH_stFId.FId_ComGwIMG6 "Inhibit Status of FIds / Status of function identifier FId_ComGwIMG6" UWORD DFC_OneToOne 1 100 0.00 65535.00 FORMAT "%8.2" ECU_ADDRESS 0x600141E2 /end MEASUREMENT
/begin MEASUREMENT DINH_stFId.FId_ComGwIMG6Mon "Inhibit Status of FIds / Status of function identifier FId_ComGwIMG6Mon" UWORD DFC_OneToOne 1 100 0.00 65535.00 FORMAT "%8.2" ECU_ADDRESS 0x600141E4 /end MEASUREMENT
/begin MEASUREMENT DINH_stFId.FId_ComHFMSnsrErr "Inhibit Status of FIds / Status of function identifier FId_ComHFMSnsrErr" UWORD DFC_OneToOne 1 100 0.00 65535.00 FORMAT "%8.2" ECU_ADDRESS 0x600141E6 /end MEASUREMENT
/begin MEASUREMENT DINH_stFId.FId_ComIDASB "Inhibit Status of FIds / Status of function identifier FId_ComIDASB" UWORD DFC_OneToOne 1 100 0.00 65535.00 FORMAT "%8.2" ECU_ADDRESS 0x600141E8 /end MEASUREMENT
/begin MEASUREMENT DINH_stFId.FId_ComIDASBMon "Inhibit Status of FIds / Status of function identifier FId_ComIDASBMon" UWORD DFC_OneToOne 1 100 0.00 65535.00 FORMAT "%8.2" ECU_ADDRESS 0x600141EA /end MEASUREMENT
/begin MEASUREMENT DINH_stFId.FId_ComIDASBUnitCfmdErr "Inhibit Status of FIds / Status of function identifier FId_ComIDASBUnitCfmdErr" UWORD DFC_OneToOne 1 100 0.00 65535.00 FORMAT "%8.2" ECU_ADDRESS 0x600141EC /end MEASUREMENT
/begin MEASUREMENT DINH_stFId.FId_ComIDASBUnitNotTstd "Inhibit Status of FIds / Status of function identifier FId_ComIDASBUnitNotTstd" UWORD DFC_OneToOne 1 100 0.00 65535.00 FORMAT "%8.2" ECU_ADDRESS 0x600141EE /end MEASUREMENT
/begin MEASUREMENT DINH_stFId.FId_ComIDASEngFail "Inhibit Status of FIds / Status of function identifier FId_ComIDASEngFail" UWORD DFC_OneToOne 1 100 0.00 65535.00 FORMAT "%8.2" ECU_ADDRESS 0x600141F0 /end MEASUREMENT
/begin MEASUREMENT DINH_stFId.FId_ComIDASEngFailMil "Inhibit Status of FIds / Status of function identifier FId_ComIDASEngFailMil" UWORD DFC_OneToOne 1 100 0.00 65535.00 FORMAT "%8.2" ECU_ADDRESS 0x600141F2 /end MEASUREMENT
/begin MEASUREMENT DINH_stFId.FId_ComIMGUnitCfmdErr "Inhibit Status of FIds / Status of function identifier FId_ComIMGUnitCfmdErr" UWORD DFC_OneToOne 1 100 0.00 65535.00 FORMAT "%8.2" ECU_ADDRESS 0x600141F4 /end MEASUREMENT
/begin MEASUREMENT DINH_stFId.FId_ComIMGUnitNotTstd "Inhibit Status of FIds / Status of function identifier FId_ComIMGUnitNotTstd" UWORD DFC_OneToOne 1 100 0.00 65535.00 FORMAT "%8.2" ECU_ADDRESS 0x600141F6 /end MEASUREMENT
/begin MEASUREMENT DINH_stFId.FId_ComISG2 "Inhibit Status of FIds / Status of function identifier FId_ComISG2" UWORD DFC_OneToOne 1 100 0.00 65535.00 FORMAT "%8.2" ECU_ADDRESS 0x600141F8 /end MEASUREMENT
/begin MEASUREMENT DINH_stFId.FId_ComIgnCtrl "Inhibit Status of FIds / Status of function identifier FId_ComIgnCtrl" UWORD DFC_OneToOne 1 100 0.00 65535.00 FORMAT "%8.2" ECU_ADDRESS 0x600141FA /end MEASUREMENT
/begin MEASUREMENT DINH_stFId.FId_ComInjCtrl "Inhibit Status of FIds / Status of function identifier FId_ComInjCtrl" UWORD DFC_OneToOne 1 100 0.00 65535.00 FORMAT "%8.2" ECU_ADDRESS 0x600141FC /end MEASUREMENT
/begin MEASUREMENT DINH_stFId.FId_ComIntkAirPSnsrErr "Inhibit Status of FIds / Status of function identifier FId_ComIntkAirPSnsrErr" UWORD DFC_OneToOne 1 100 0.00 65535.00 FORMAT "%8.2" ECU_ADDRESS 0x600141FE /end MEASUREMENT
/begin MEASUREMENT DINH_stFId.FId_ComLamCtrl "Inhibit Status of FIds / Status of function identifier FId_ComLamCtrl" UWORD DFC_OneToOne 1 100 0.00 65535.00 FORMAT "%8.2" ECU_ADDRESS 0x60014200 /end MEASUREMENT
/begin MEASUREMENT DINH_stFId.FId_ComMETA "Inhibit Status of FIds / Status of function identifier FId_ComMETA" UWORD DFC_OneToOne 1 100 0.00 65535.00 FORMAT "%8.2" ECU_ADDRESS 0x60014202 /end MEASUREMENT
/begin MEASUREMENT DINH_stFId.FId_ComMETAMon "Inhibit Status of FIds / Status of function identifier FId_ComMETAMon" UWORD DFC_OneToOne 1 100 0.00 65535.00 FORMAT "%8.2" ECU_ADDRESS 0x60014204 /end MEASUREMENT
/begin MEASUREMENT DINH_stFId.FId_ComMETC "Inhibit Status of FIds / Status of function identifier FId_ComMETC" UWORD DFC_OneToOne 1 100 0.00 65535.00 FORMAT "%8.2" ECU_ADDRESS 0x60014206 /end MEASUREMENT
/begin MEASUREMENT DINH_stFId.FId_ComMETCMon "Inhibit Status of FIds / Status of function identifier FId_ComMETCMon" UWORD DFC_OneToOne 1 100 0.00 65535.00 FORMAT "%8.2" ECU_ADDRESS 0x60014208 /end MEASUREMENT
/begin MEASUREMENT DINH_stFId.FId_ComMETD "Inhibit Status of FIds / Status of function identifier FId_ComMETD" UWORD DFC_OneToOne 1 100 0.00 65535.00 FORMAT "%8.2" ECU_ADDRESS 0x6001420A /end MEASUREMENT
/begin MEASUREMENT DINH_stFId.FId_ComMETDMon "Inhibit Status of FIds / Status of function identifier FId_ComMETDMon" UWORD DFC_OneToOne 1 100 0.00 65535.00 FORMAT "%8.2" ECU_ADDRESS 0x6001420C /end MEASUREMENT
/begin MEASUREMENT DINH_stFId.FId_ComMETE2 "Inhibit Status of FIds / Status of function identifier FId_ComMETE2" UWORD DFC_OneToOne 1 100 0.00 65535.00 FORMAT "%8.2" ECU_ADDRESS 0x6001420E /end MEASUREMENT
/begin MEASUREMENT DINH_stFId.FId_ComMETE2Mon "Inhibit Status of FIds / Status of function identifier FId_ComMETE2Mon" UWORD DFC_OneToOne 1 100 0.00 65535.00 FORMAT "%8.2" ECU_ADDRESS 0x60014210 /end MEASUREMENT
/begin MEASUREMENT DINH_stFId.FId_ComMETF "Inhibit Status of FIds / Status of function identifier FId_ComMETF" UWORD DFC_OneToOne 1 100 0.00 65535.00 FORMAT "%8.2" ECU_ADDRESS 0x60014212 /end MEASUREMENT
/begin MEASUREMENT DINH_stFId.FId_ComMETFMon "Inhibit Status of FIds / Status of function identifier FId_ComMETFMon" UWORD DFC_OneToOne 1 100 0.00 65535.00 FORMAT "%8.2" ECU_ADDRESS 0x60014214 /end MEASUREMENT
/begin MEASUREMENT DINH_stFId.FId_ComMETG "Inhibit Status of FIds / Status of function identifier FId_ComMETG" UWORD DFC_OneToOne 1 100 0.00 65535.00 FORMAT "%8.2" ECU_ADDRESS 0x60014216 /end MEASUREMENT
/begin MEASUREMENT DINH_stFId.FId_ComMETGMon "Inhibit Status of FIds / Status of function identifier FId_ComMETGMon" UWORD DFC_OneToOne 1 100 0.00 65535.00 FORMAT "%8.2" ECU_ADDRESS 0x60014218 /end MEASUREMENT
/begin MEASUREMENT DINH_stFId.FId_ComMETH "Inhibit Status of FIds / Status of function identifier FId_ComMETH" UWORD DFC_OneToOne 1 100 0.00 65535.00 FORMAT "%8.2" ECU_ADDRESS 0x6001421A /end MEASUREMENT
/begin MEASUREMENT DINH_stFId.FId_ComMETH2 "Inhibit Status of FIds / Status of function identifier FId_ComMETH2" UWORD DFC_OneToOne 1 100 0.00 65535.00 FORMAT "%8.2" ECU_ADDRESS 0x6001421C /end MEASUREMENT
/begin MEASUREMENT DINH_stFId.FId_ComMETH2Mon "Inhibit Status of FIds / Status of function identifier FId_ComMETH2Mon" UWORD DFC_OneToOne 1 100 0.00 65535.00 FORMAT "%8.2" ECU_ADDRESS 0x6001421E /end MEASUREMENT
/begin MEASUREMENT DINH_stFId.FId_ComMETHMon "Inhibit Status of FIds / Status of function identifier FId_ComMETHMon" UWORD DFC_OneToOne 1 100 0.00 65535.00 FORMAT "%8.2" ECU_ADDRESS 0x60014220 /end MEASUREMENT
/begin MEASUREMENT DINH_stFId.FId_ComMETI "Inhibit Status of FIds / Status of function identifier FId_ComMETI" UWORD DFC_OneToOne 1 100 0.00 65535.00 FORMAT "%8.2" ECU_ADDRESS 0x60014222 /end MEASUREMENT
/begin MEASUREMENT DINH_stFId.FId_ComMETIMon "Inhibit Status of FIds / Status of function identifier FId_ComMETIMon" UWORD DFC_OneToOne 1 100 0.00 65535.00 FORMAT "%8.2" ECU_ADDRESS 0x60014224 /end MEASUREMENT
/begin MEASUREMENT DINH_stFId.FId_ComMETK "Inhibit Status of FIds / Status of function identifier FId_ComMETK" UWORD DFC_OneToOne 1 100 0.00 65535.00 FORMAT "%8.2" ECU_ADDRESS 0x60014226 /end MEASUREMENT
/begin MEASUREMENT DINH_stFId.FId_ComMETKMon "Inhibit Status of FIds / Status of function identifier FId_ComMETKMon" UWORD DFC_OneToOne 1 100 0.00 65535.00 FORMAT "%8.2" ECU_ADDRESS 0x60014228 /end MEASUREMENT
/begin MEASUREMENT DINH_stFId.FId_ComMETL "Inhibit Status of FIds / Status of function identifier FId_ComMETL" UWORD DFC_OneToOne 1 100 0.00 65535.00 FORMAT "%8.2" ECU_ADDRESS 0x6001422A /end MEASUREMENT
/begin MEASUREMENT DINH_stFId.FId_ComMETLMon "Inhibit Status of FIds / Status of function identifier FId_ComMETLMon" UWORD DFC_OneToOne 1 100 0.00 65535.00 FORMAT "%8.2" ECU_ADDRESS 0x6001422C /end MEASUREMENT
/begin MEASUREMENT DINH_stFId.FId_ComMETM "Inhibit Status of FIds / Status of function identifier FId_ComMETM" UWORD DFC_OneToOne 1 100 0.00 65535.00 FORMAT "%8.2" ECU_ADDRESS 0x6001422E /end MEASUREMENT
/begin MEASUREMENT DINH_stFId.FId_ComMETMMon "Inhibit Status of FIds / Status of function identifier FId_ComMETMMon" UWORD DFC_OneToOne 1 100 0.00 65535.00 FORMAT "%8.2" ECU_ADDRESS 0x60014230 /end MEASUREMENT
/begin MEASUREMENT DINH_stFId.FId_ComMETN "Inhibit Status of FIds / Status of function identifier FId_ComMETN" UWORD DFC_OneToOne 1 100 0.00 65535.00 FORMAT "%8.2" ECU_ADDRESS 0x60014232 /end MEASUREMENT
/begin MEASUREMENT DINH_stFId.FId_ComMETNMon "Inhibit Status of FIds / Status of function identifier FId_ComMETNMon" UWORD DFC_OneToOne 1 100 0.00 65535.00 FORMAT "%8.2" ECU_ADDRESS 0x60014234 /end MEASUREMENT
/begin MEASUREMENT DINH_stFId.FId_ComMETUnitCfmdErr "Inhibit Status of FIds / Status of function identifier FId_ComMETUnitCfmdErr" UWORD DFC_OneToOne 1 100 0.00 65535.00 FORMAT "%8.2" ECU_ADDRESS 0x60014236 /end MEASUREMENT
/begin MEASUREMENT DINH_stFId.FId_ComMETUnitNotTstd "Inhibit Status of FIds / Status of function identifier FId_ComMETUnitNotTstd" UWORD DFC_OneToOne 1 100 0.00 65535.00 FORMAT "%8.2" ECU_ADDRESS 0x60014238 /end MEASUREMENT
/begin MEASUREMENT DINH_stFId.FId_ComMisf "Inhibit Status of FIds / Status of function identifier FId_ComMisf" UWORD DFC_OneToOne 1 100 0.00 65535.00 FORMAT "%8.2" ECU_ADDRESS 0x6001423A /end MEASUREMENT
/begin MEASUREMENT DINH_stFId.FId_ComMon "Inhibit Status of FIds / Status of function identifier FId_ComMon" UWORD DFC_OneToOne 1 100 0.00 65535.00 FORMAT "%8.2" ECU_ADDRESS 0x6001423C /end MEASUREMENT
/begin MEASUREMENT DINH_stFId.FId_ComNTrbn "Inhibit Status of FIds / Status of function identifier FId_ComNTrbn" UWORD DFC_OneToOne 1 100 0.00 65535.00 FORMAT "%8.2" ECU_ADDRESS 0x6001423E /end MEASUREMENT
/begin MEASUREMENT DINH_stFId.FId_ComODOff "Inhibit Status of FIds / Status of function identifier FId_ComODOff" UWORD DFC_OneToOne 1 100 0.00 65535.00 FORMAT "%8.2" ECU_ADDRESS 0x60014240 /end MEASUREMENT
/begin MEASUREMENT DINH_stFId.FId_ComOilLvlLamp "Inhibit Status of FIds / Status of function identifier FId_ComOilLvlLamp" UWORD DFC_OneToOne 1 100 0.00 65535.00 FORMAT "%8.2" ECU_ADDRESS 0x60014242 /end MEASUREMENT
/begin MEASUREMENT DINH_stFId.FId_ComOilPWarnLamp "Inhibit Status of FIds / Status of function identifier FId_ComOilPWarnLamp" UWORD DFC_OneToOne 1 100 0.00 65535.00 FORMAT "%8.2" ECU_ADDRESS 0x60014244 /end MEASUREMENT
/begin MEASUREMENT DINH_stFId.FId_ComPASensFail "Inhibit Status of FIds / Status of function identifier FId_ComPASensFail" UWORD DFC_OneToOne 1 100 0.00 65535.00 FORMAT "%8.2" ECU_ADDRESS 0x60014246 /end MEASUREMENT
/begin MEASUREMENT DINH_stFId.FId_ComPBSensFail "Inhibit Status of FIds / Status of function identifier FId_ComPBSensFail" UWORD DFC_OneToOne 1 100 0.00 65535.00 FORMAT "%8.2" ECU_ADDRESS 0x60014248 /end MEASUREMENT
/begin MEASUREMENT DINH_stFId.FId_ComPCU "Inhibit Status of FIds / Status of function identifier FId_ComPCU" UWORD DFC_OneToOne 1 100 0.00 65535.00 FORMAT "%8.2" ECU_ADDRESS 0x6001424A /end MEASUREMENT
/begin MEASUREMENT DINH_stFId.FId_ComPCUMon "Inhibit Status of FIds / Status of function identifier FId_ComPCUMon" UWORD DFC_OneToOne 1 100 0.00 65535.00 FORMAT "%8.2" ECU_ADDRESS 0x6001424C /end MEASUREMENT
/begin MEASUREMENT DINH_stFId.FId_ComPosActnSpdLimrFctReq "Inhibit Status of FIds / Status of function identifier FId_ComPosActnSpdLimrFctReq" UWORD DFC_OneToOne 1 100 0.00 65535.00 FORMAT "%8.2" ECU_ADDRESS 0x6001424E /end MEASUREMENT
/begin MEASUREMENT DINH_stFId.FId_ComSRS "Inhibit Status of FIds / Status of function identifier FId_ComSRS" UWORD DFC_OneToOne 1 100 0.00 65535.00 FORMAT "%8.2" ECU_ADDRESS 0x60014250 /end MEASUREMENT
/begin MEASUREMENT DINH_stFId.FId_ComSRSA "Inhibit Status of FIds / Status of function identifier FId_ComSRSA" UWORD DFC_OneToOne 1 100 0.00 65535.00 FORMAT "%8.2" ECU_ADDRESS 0x60014252 /end MEASUREMENT
/begin MEASUREMENT DINH_stFId.FId_ComSRSAMon "Inhibit Status of FIds / Status of function identifier FId_ComSRSAMon" UWORD DFC_OneToOne 1 100 0.00 65535.00 FORMAT "%8.2" ECU_ADDRESS 0x60014254 /end MEASUREMENT
/begin MEASUREMENT DINH_stFId.FId_ComSRSB "Inhibit Status of FIds / Status of function identifier FId_ComSRSB" UWORD DFC_OneToOne 1 100 0.00 65535.00 FORMAT "%8.2" ECU_ADDRESS 0x60014256 /end MEASUREMENT
/begin MEASUREMENT DINH_stFId.FId_ComSRSBMon "Inhibit Status of FIds / Status of function identifier FId_ComSRSBMon" UWORD DFC_OneToOne 1 100 0.00 65535.00 FORMAT "%8.2" ECU_ADDRESS 0x60014258 /end MEASUREMENT
/begin MEASUREMENT DINH_stFId.FId_ComSRSMon "Inhibit Status of FIds / Status of function identifier FId_ComSRSMon" UWORD DFC_OneToOne 1 100 0.00 65535.00 FORMAT "%8.2" ECU_ADDRESS 0x6001425A /end MEASUREMENT
/begin MEASUREMENT DINH_stFId.FId_ComSRSUnitCfmdErr "Inhibit Status of FIds / Status of function identifier FId_ComSRSUnitCfmdErr" UWORD DFC_OneToOne 1 100 0.00 65535.00 FORMAT "%8.2" ECU_ADDRESS 0x6001425C /end MEASUREMENT
/begin MEASUREMENT DINH_stFId.FId_ComSRSUnitNotTstd "Inhibit Status of FIds / Status of function identifier FId_ComSRSUnitNotTstd" UWORD DFC_OneToOne 1 100 0.00 65535.00 FORMAT "%8.2" ECU_ADDRESS 0x6001425E /end MEASUREMENT
/begin MEASUREMENT DINH_stFId.FId_ComSTFlt "Inhibit Status of FIds / Status of function identifier FId_ComSTFlt" UWORD DFC_OneToOne 1 100 0.00 65535.00 FORMAT "%8.2" ECU_ADDRESS 0x60014260 /end MEASUREMENT
/begin MEASUREMENT DINH_stFId.FId_ComSpdLimrDevActvn "Inhibit Status of FIds / Status of function identifier FId_ComSpdLimrDevActvn" UWORD DFC_OneToOne 1 100 0.00 65535.00 FORMAT "%8.2" ECU_ADDRESS 0x60014262 /end MEASUREMENT
/begin MEASUREMENT DINH_stFId.FId_ComTCU01 "Inhibit Status of FIds / Status of function identifier FId_ComTCU01" UWORD DFC_OneToOne 1 100 0.00 65535.00 FORMAT "%8.2" ECU_ADDRESS 0x60014264 /end MEASUREMENT
/begin MEASUREMENT DINH_stFId.FId_ComTCU02 "Inhibit Status of FIds / Status of function identifier FId_ComTCU02" UWORD DFC_OneToOne 1 100 0.00 65535.00 FORMAT "%8.2" ECU_ADDRESS 0x60014266 /end MEASUREMENT
/begin MEASUREMENT DINH_stFId.FId_ComTCU1 "Inhibit Status of FIds / Status of function identifier FId_ComTCU1" UWORD DFC_OneToOne 1 100 0.00 65535.00 FORMAT "%8.2" ECU_ADDRESS 0x60014268 /end MEASUREMENT
/begin MEASUREMENT DINH_stFId.FId_ComTCU11 "Inhibit Status of FIds / Status of function identifier FId_ComTCU11" UWORD DFC_OneToOne 1 100 0.00 65535.00 FORMAT "%8.2" ECU_ADDRESS 0x6001426A /end MEASUREMENT
/begin MEASUREMENT DINH_stFId.FId_ComTCU12 "Inhibit Status of FIds / Status of function identifier FId_ComTCU12" UWORD DFC_OneToOne 1 100 0.00 65535.00 FORMAT "%8.2" ECU_ADDRESS 0x6001426C /end MEASUREMENT
/begin MEASUREMENT DINH_stFId.FId_ComTCU13 "Inhibit Status of FIds / Status of function identifier FId_ComTCU13" UWORD DFC_OneToOne 1 100 0.00 65535.00 FORMAT "%8.2" ECU_ADDRESS 0x6001426E /end MEASUREMENT
/begin MEASUREMENT DINH_stFId.FId_ComTCU14 "Inhibit Status of FIds / Status of function identifier FId_ComTCU14" UWORD DFC_OneToOne 1 100 0.00 65535.00 FORMAT "%8.2" ECU_ADDRESS 0x60014270 /end MEASUREMENT
/begin MEASUREMENT DINH_stFId.FId_ComTCU2 "Inhibit Status of FIds / Status of function identifier FId_ComTCU2" UWORD DFC_OneToOne 1 100 0.00 65535.00 FORMAT "%8.2" ECU_ADDRESS 0x60014272 /end MEASUREMENT
/begin MEASUREMENT DINH_stFId.FId_ComTCU3 "Inhibit Status of FIds / Status of function identifier FId_ComTCU3" UWORD DFC_OneToOne 1 100 0.00 65535.00 FORMAT "%8.2" ECU_ADDRESS 0x60014274 /end MEASUREMENT
/begin MEASUREMENT DINH_stFId.FId_ComTCU4 "Inhibit Status of FIds / Status of function identifier FId_ComTCU4" UWORD DFC_OneToOne 1 100 0.00 65535.00 FORMAT "%8.2" ECU_ADDRESS 0x60014276 /end MEASUREMENT
/begin MEASUREMENT DINH_stFId.FId_ComTCUGear "Inhibit Status of FIds / Status of function identifier FId_ComTCUGear" UWORD DFC_OneToOne 1 100 0.00 65535.00 FORMAT "%8.2" ECU_ADDRESS 0x60014278 /end MEASUREMENT
/begin MEASUREMENT DINH_stFId.FId_ComTarGearDwnShift "Inhibit Status of FIds / Status of function identifier FId_ComTarGearDwnShift" UWORD DFC_OneToOne 1 100 0.00 65535.00 FORMAT "%8.2" ECU_ADDRESS 0x6001427A /end MEASUREMENT
/begin MEASUREMENT DINH_stFId.FId_ComTarGearUpShift "Inhibit Status of FIds / Status of function identifier FId_ComTarGearUpShift" UWORD DFC_OneToOne 1 100 0.00 65535.00 FORMAT "%8.2" ECU_ADDRESS 0x6001427C /end MEASUREMENT
/begin MEASUREMENT DINH_stFId.FId_ComThrPosnFail "Inhibit Status of FIds / Status of function identifier FId_ComThrPosnFail" UWORD DFC_OneToOne 1 100 0.00 65535.00 FORMAT "%8.2" ECU_ADDRESS 0x6001427E /end MEASUREMENT
/begin MEASUREMENT DINH_stFId.FId_ComThrVlv "Inhibit Status of FIds / Status of function identifier FId_ComThrVlv" UWORD DFC_OneToOne 1 100 0.00 65535.00 FORMAT "%8.2" ECU_ADDRESS 0x60014280 /end MEASUREMENT
/begin MEASUREMENT DINH_stFId.FId_ComTrboChrgnErr "Inhibit Status of FIds / Status of function identifier FId_ComTrboChrgnErr" UWORD DFC_OneToOne 1 100 0.00 65535.00 FORMAT "%8.2" ECU_ADDRESS 0x60014282 /end MEASUREMENT
/begin MEASUREMENT DINH_stFId.FId_ComTrqAccuracySlow "Inhibit Status of FIds / Status of function identifier FId_ComTrqAccuracySlow" UWORD DFC_OneToOne 1 100 0.00 65535.00 FORMAT "%8.2" ECU_ADDRESS 0x60014284 /end MEASUREMENT
/begin MEASUREMENT DINH_stFId.FId_ComTrqReqFast "Inhibit Status of FIds / Status of function identifier FId_ComTrqReqFast" UWORD DFC_OneToOne 1 100 0.00 65535.00 FORMAT "%8.2" ECU_ADDRESS 0x60014286 /end MEASUREMENT
/begin MEASUREMENT DINH_stFId.FId_ComTrqReqSlow "Inhibit Status of FIds / Status of function identifier FId_ComTrqReqSlow" UWORD DFC_OneToOne 1 100 0.00 65535.00 FORMAT "%8.2" ECU_ADDRESS 0x60014288 /end MEASUREMENT
/begin MEASUREMENT DINH_stFId.FId_ComVSAErr "Inhibit Status of FIds / Status of function identifier FId_ComVSAErr" UWORD DFC_OneToOne 1 100 0.00 65535.00 FORMAT "%8.2" ECU_ADDRESS 0x6001428A /end MEASUREMENT
/begin MEASUREMENT DINH_stFId.FId_ComVSAUnitCfmdErr "Inhibit Status of FIds / Status of function identifier FId_ComVSAUnitCfmdErr" UWORD DFC_OneToOne 1 100 0.00 65535.00 FORMAT "%8.2" ECU_ADDRESS 0x6001428C /end MEASUREMENT
/begin MEASUREMENT DINH_stFId.FId_ComVSAUnitNotTstd "Inhibit Status of FIds / Status of function identifier FId_ComVSAUnitNotTstd" UWORD DFC_OneToOne 1 100 0.00 65535.00 FORMAT "%8.2" ECU_ADDRESS 0x6001428E /end MEASUREMENT
/begin MEASUREMENT DINH_stFId.FId_ComVehSpdFlLvl "Inhibit Status of FIds / Status of function identifier FId_ComVehSpdFlLvl" UWORD DFC_OneToOne 1 100 0.00 65535.00 FORMAT "%8.2" ECU_ADDRESS 0x60014290 /end MEASUREMENT
/begin MEASUREMENT DINH_stFId.FId_ComVehSpdFltChk "Inhibit Status of FIds / Status of function identifier FId_ComVehSpdFltChk" UWORD DFC_OneToOne 1 100 0.00 65535.00 FORMAT "%8.2" ECU_ADDRESS 0x60014292 /end MEASUREMENT
/begin MEASUREMENT DINH_stFId.FId_ComVehSpdImpsErr "Inhibit Status of FIds / Status of function identifier FId_ComVehSpdImpsErr" UWORD DFC_OneToOne 1 100 0.00 65535.00 FORMAT "%8.2" ECU_ADDRESS 0x60014294 /end MEASUREMENT
/begin MEASUREMENT DINH_stFId.FId_ComVlvLftCtrl "Inhibit Status of FIds / Status of function identifier FId_ComVlvLftCtrl" UWORD DFC_OneToOne 1 100 0.00 65535.00 FORMAT "%8.2" ECU_ADDRESS 0x60014296 /end MEASUREMENT
/begin MEASUREMENT DINH_stFId.FId_ComvolEng "Inhibit Status of FIds / Status of function identifier FId_ComvolEng" UWORD DFC_OneToOne 1 100 0.00 65535.00 FORMAT "%8.2" ECU_ADDRESS 0x60014298 /end MEASUREMENT
/begin MEASUREMENT DINH_stFId.FId_ConvLdCalcLvrPos "Inhibit Status of FIds / Status of function identifier FId_ConvLdCalcLvrPos" UWORD DFC_OneToOne 1 100 0.00 65535.00 FORMAT "%8.2" ECU_ADDRESS 0x6001429A /end MEASUREMENT
/begin MEASUREMENT DINH_stFId.FId_ConvLdNTrbnCan "Inhibit Status of FIds / Status of function identifier FId_ConvLdNTrbnCan" UWORD DFC_OneToOne 1 100 0.00 65535.00 FORMAT "%8.2" ECU_ADDRESS 0x6001429C /end MEASUREMENT
/begin MEASUREMENT DINH_stFId.FId_ConvLdOilCoolrPmp "Inhibit Status of FIds / Status of function identifier FId_ConvLdOilCoolrPmp" UWORD DFC_OneToOne 1 100 0.00 65535.00 FORMAT "%8.2" ECU_ADDRESS 0x6001429E /end MEASUREMENT
/begin MEASUREMENT DINH_stFId.FId_ConvLdOilTemp "Inhibit Status of FIds / Status of function identifier FId_ConvLdOilTemp" UWORD DFC_OneToOne 1 100 0.00 65535.00 FORMAT "%8.2" ECU_ADDRESS 0x600142A0 /end MEASUREMENT
/begin MEASUREMENT DINH_stFId.FId_ConvLdTrqLdCan "Inhibit Status of FIds / Status of function identifier FId_ConvLdTrqLdCan" UWORD DFC_OneToOne 1 100 0.00 65535.00 FORMAT "%8.2" ECU_ADDRESS 0x600142A2 /end MEASUREMENT
/begin MEASUREMENT DINH_stFId.FId_ConvLdVel "Inhibit Status of FIds / Status of function identifier FId_ConvLdVel" UWORD DFC_OneToOne 1 100 0.00 65535.00 FORMAT "%8.2" ECU_ADDRESS 0x600142A4 /end MEASUREMENT
/begin MEASUREMENT DINH_stFId.FId_CooltTVldyTMdl "Inhibit Status of FIds / Status of function identifier FId_CooltTVldyTMdl" UWORD DFC_OneToOne 1 100 0.00 65535.00 FORMAT "%8.2" ECU_ADDRESS 0x600142A6 /end MEASUREMENT
/begin MEASUREMENT DINH_stFId.FId_CptProtnCamsft "Inhibit Status of FIds / Status of function identifier FId_CptProtnCamsft" UWORD DFC_OneToOne 1 100 0.00 65535.00 FORMAT "%8.2" ECU_ADDRESS 0x600142A8 /end MEASUREMENT
/begin MEASUREMENT DINH_stFId.FId_CptProtnExhTempMdl "Inhibit Status of FIds / Status of function identifier FId_CptProtnExhTempMdl" UWORD DFC_OneToOne 1 100 0.00 65535.00 FORMAT "%8.2" ECU_ADDRESS 0x600142AA /end MEASUREMENT
/begin MEASUREMENT DINH_stFId.FId_CptProtnO2SnsrB1 "Inhibit Status of FIds / Status of function identifier FId_CptProtnO2SnsrB1" UWORD DFC_OneToOne 1 100 0.00 65535.00 FORMAT "%8.2" ECU_ADDRESS 0x600142AC /end MEASUREMENT
/begin MEASUREMENT DINH_stFId.FId_CptProtnVVeh "Inhibit Status of FIds / Status of function identifier FId_CptProtnVVeh" UWORD DFC_OneToOne 1 100 0.00 65535.00 FORMAT "%8.2" ECU_ADDRESS 0x600142AE /end MEASUREMENT
/begin MEASUREMENT DINH_stFId.FId_CrCUI1EFRxErr "Inhibit Status of FIds / Status of function identifier FId_CrCUI1EFRxErr" UWORD DFC_OneToOne 1 100 0.00 65535.00 FORMAT "%8.2" ECU_ADDRESS 0x600142B0 /end MEASUREMENT
/begin MEASUREMENT DINH_stFId.FId_CrCUICANRxErr "Inhibit Status of FIds / Status of function identifier FId_CrCUICANRxErr" UWORD DFC_OneToOne 1 100 0.00 65535.00 FORMAT "%8.2" ECU_ADDRESS 0x600142B2 /end MEASUREMENT
/begin MEASUREMENT DINH_stFId.FId_CrCUIFCMRxErr "Inhibit Status of FIds / Status of function identifier FId_CrCUIFCMRxErr" UWORD DFC_OneToOne 1 100 0.00 65535.00 FORMAT "%8.2" ECU_ADDRESS 0x600142B4 /end MEASUREMENT
/begin MEASUREMENT DINH_stFId.FId_CrCUIMETDRxErr "Inhibit Status of FIds / Status of function identifier FId_CrCUIMETDRxErr" UWORD DFC_OneToOne 1 100 0.00 65535.00 FORMAT "%8.2" ECU_ADDRESS 0x600142B6 /end MEASUREMENT
/begin MEASUREMENT DINH_stFId.FId_CrCtlACCRxErr "Inhibit Status of FIds / Status of function identifier FId_CrCtlACCRxErr" UWORD DFC_OneToOne 1 100 0.00 65535.00 FORMAT "%8.2" ECU_ADDRESS 0x600142B8 /end MEASUREMENT
/begin MEASUREMENT DINH_stFId.FId_CrCtlAppSnsrErr "Inhibit Status of FIds / Status of function identifier FId_CrCtlAppSnsrErr" UWORD DFC_OneToOne 1 100 0.00 65535.00 FORMAT "%8.2" ECU_ADDRESS 0x600142BA /end MEASUREMENT
/begin MEASUREMENT DINH_stFId.FId_CrCtlShutOffEng "Inhibit Status of FIds / Status of function identifier FId_CrCtlShutOffEng" UWORD DFC_OneToOne 1 100 0.00 65535.00 FORMAT "%8.2" ECU_ADDRESS 0x600142BC /end MEASUREMENT
/begin MEASUREMENT DINH_stFId.FId_CstrPurgGnrlTstrReq "Inhibit Status of FIds / Status of function identifier FId_CstrPurgGnrlTstrReq" UWORD DFC_OneToOne 1 100 0.00 65535.00 FORMAT "%8.2" ECU_ADDRESS 0x600142BE /end MEASUREMENT
/begin MEASUREMENT DINH_stFId.FId_DAGRS "Inhibit Status of FIds / Status of function identifier FId_DAGRS" UWORD DFC_OneToOne 1 100 0.00 65535.00 FORMAT "%8.2" ECU_ADDRESS 0x600142C0 /end MEASUREMENT
/begin MEASUREMENT DINH_stFId.FId_DELibBrkBstP "Inhibit Status of FIds / Status of function identifier FId_DELibBrkBstP" UWORD DFC_OneToOne 1 100 0.00 65535.00 FORMAT "%8.2" ECU_ADDRESS 0x600142C2 /end MEASUREMENT
/begin MEASUREMENT DINH_stFId.FId_DELibCEngDsT "Inhibit Status of FIds / Status of function identifier FId_DELibCEngDsT" UWORD DFC_OneToOne 1 100 0.00 65535.00 FORMAT "%8.2" ECU_ADDRESS 0x600142C4 /end MEASUREMENT
/begin MEASUREMENT DINH_stFId.FId_DELibCEngUsT "Inhibit Status of FIds / Status of function identifier FId_DELibCEngUsT" UWORD DFC_OneToOne 1 100 0.00 65535.00 FORMAT "%8.2" ECU_ADDRESS 0x600142C6 /end MEASUREMENT
/begin MEASUREMENT DINH_stFId.FId_DELibEngDatEng "Inhibit Status of FIds / Status of function identifier FId_DELibEngDatEng" UWORD DFC_OneToOne 1 100 0.00 65535.00 FORMAT "%8.2" ECU_ADDRESS 0x600142C8 /end MEASUREMENT
/begin MEASUREMENT DINH_stFId.FId_DELibEnvP "Inhibit Status of FIds / Status of function identifier FId_DELibEnvP" UWORD DFC_OneToOne 1 100 0.00 65535.00 FORMAT "%8.2" ECU_ADDRESS 0x600142CA /end MEASUREMENT
/begin MEASUREMENT DINH_stFId.FId_DELibEnvT "Inhibit Status of FIds / Status of function identifier FId_DELibEnvT" UWORD DFC_OneToOne 1 100 0.00 65535.00 FORMAT "%8.2" ECU_ADDRESS 0x600142CC /end MEASUREMENT
/begin MEASUREMENT DINH_stFId.FId_DELibFuelT "Inhibit Status of FIds / Status of function identifier FId_DELibFuelT" UWORD DFC_OneToOne 1 100 0.00 65535.00 FORMAT "%8.2" ECU_ADDRESS 0x600142CE /end MEASUREMENT
/begin MEASUREMENT DINH_stFId.FId_DELibIntkAirT "Inhibit Status of FIds / Status of function identifier FId_DELibIntkAirT" UWORD DFC_OneToOne 1 100 0.00 65535.00 FORMAT "%8.2" ECU_ADDRESS 0x600142D0 /end MEASUREMENT
/begin MEASUREMENT DINH_stFId.FId_DELibNRCat "Inhibit Status of FIds / Status of function identifier FId_DELibNRCat" UWORD DFC_OneToOne 1 100 0.00 65535.00 FORMAT "%8.2" ECU_ADDRESS 0x600142D2 /end MEASUREMENT
/begin MEASUREMENT DINH_stFId.FId_DELibOilP "Inhibit Status of FIds / Status of function identifier FId_DELibOilP" UWORD DFC_OneToOne 1 100 0.00 65535.00 FORMAT "%8.2" ECU_ADDRESS 0x600142D4 /end MEASUREMENT
/begin MEASUREMENT DINH_stFId.FId_DELibOilSwmpT "Inhibit Status of FIds / Status of function identifier FId_DELibOilSwmpT" UWORD DFC_OneToOne 1 100 0.00 65535.00 FORMAT "%8.2" ECU_ADDRESS 0x600142D6 /end MEASUREMENT
/begin MEASUREMENT DINH_stFId.FId_DELibPRelPfilDs "Inhibit Status of FIds / Status of function identifier FId_DELibPRelPfilDs" UWORD DFC_OneToOne 1 100 0.00 65535.00 FORMAT "%8.2" ECU_ADDRESS 0x600142D8 /end MEASUREMENT
/begin MEASUREMENT DINH_stFId.FId_DELibTEGRClrLPDs "Inhibit Status of FIds / Status of function identifier FId_DELibTEGRClrLPDs" UWORD DFC_OneToOne 1 100 0.00 65535.00 FORMAT "%8.2" ECU_ADDRESS 0x600142DA /end MEASUREMENT
/begin MEASUREMENT DINH_stFId.FId_DEONVEBPEnv "Inhibit Status of FIds / Status of function identifier FId_DEONVEBPEnv" UWORD DFC_OneToOne 1 100 0.00 65535.00 FORMAT "%8.2" ECU_ADDRESS 0x600142DC /end MEASUREMENT
/begin MEASUREMENT DINH_stFId.FId_DEONVTCCpv1DteskLoLoadStuckClsd "Inhibit Status of FIds / Status of function identifier FId_DEONVTCCpv1DteskLoLoadStuckClsd" UWORD DFC_OneToOne 1 100 0.00 65535.00 FORMAT "%8.2" ECU_ADDRESS 0x600142DE /end MEASUREMENT
/begin MEASUREMENT DINH_stFId.FId_DEONVTCCpv1DteskLoLoadStuckOpen "Inhibit Status of FIds / Status of function identifier FId_DEONVTCCpv1DteskLoLoadStuckOpen" UWORD DFC_OneToOne 1 100 0.00 65535.00 FORMAT "%8.2" ECU_ADDRESS 0x600142E0 /end MEASUREMENT
/begin MEASUREMENT DINH_stFId.FId_DIUMPRCldStrtMon "Inhibit Status of FIds / Status of function identifier FId_DIUMPRCldStrtMon" UWORD DFC_OneToOne 1 100 0.00 65535.00 FORMAT "%8.2" ECU_ADDRESS 0x600142E2 /end MEASUREMENT
/begin MEASUREMENT DINH_stFId.FId_DIUMPREvapMon "Inhibit Status of FIds / Status of function identifier FId_DIUMPREvapMon" UWORD DFC_OneToOne 1 100 0.00 65535.00 FORMAT "%8.2" ECU_ADDRESS 0x600142E4 /end MEASUREMENT
/begin MEASUREMENT DINH_stFId.FId_DIUMPRGenDenom1 "Inhibit Status of FIds / Status of function identifier FId_DIUMPRGenDenom1" UWORD DFC_OneToOne 1 100 0.00 65535.00 FORMAT "%8.2" ECU_ADDRESS 0x600142E6 /end MEASUREMENT
/begin MEASUREMENT DINH_stFId.FId_DIUMPRGenDenom1PDTC "Inhibit Status of FIds / Status of function identifier FId_DIUMPRGenDenom1PDTC" UWORD DFC_OneToOne 1 100 0.00 65535.00 FORMAT "%8.2" ECU_ADDRESS 0x600142E8 /end MEASUREMENT
/begin MEASUREMENT DINH_stFId.FId_DIUMPRGenDenom2 "Inhibit Status of FIds / Status of function identifier FId_DIUMPRGenDenom2" UWORD DFC_OneToOne 1 100 0.00 65535.00 FORMAT "%8.2" ECU_ADDRESS 0x600142EA /end MEASUREMENT
/begin MEASUREMENT DINH_stFId.FId_DIUMPRGenDenom3 "Inhibit Status of FIds / Status of function identifier FId_DIUMPRGenDenom3" UWORD DFC_OneToOne 1 100 0.00 65535.00 FORMAT "%8.2" ECU_ADDRESS 0x600142EC /end MEASUREMENT
/begin MEASUREMENT DINH_stFId.FId_DIUMPRIgn "Inhibit Status of FIds / Status of function identifier FId_DIUMPRIgn" UWORD DFC_OneToOne 1 100 0.00 65535.00 FORMAT "%8.2" ECU_ADDRESS 0x600142EE /end MEASUREMENT
/begin MEASUREMENT DINH_stFId.FId_DOGov "Inhibit Status of FIds / Status of function identifier FId_DOGov" UWORD DFC_OneToOne 1 100 0.00 65535.00 FORMAT "%8.2" ECU_ADDRESS 0x600142F0 /end MEASUREMENT
/begin MEASUREMENT DINH_stFId.FId_DSMWarmUpCycle "Inhibit Status of FIds / Status of function identifier FId_DSMWarmUpCycle" UWORD DFC_OneToOne 1 100 0.00 65535.00 FORMAT "%8.2" ECU_ADDRESS 0x600142F2 /end MEASUREMENT
/begin MEASUREMENT DINH_stFId.FId_DTESKEBCpv1DteskLoLoadStuckClsd "Inhibit Status of FIds / Status of function identifier FId_DTESKEBCpv1DteskLoLoadStuckClsd" UWORD DFC_OneToOne 1 100 0.00 65535.00 FORMAT "%8.2" ECU_ADDRESS 0x600142F4 /end MEASUREMENT
/begin MEASUREMENT DINH_stFId.FId_DTESKEBCpv1DteskLoLoadStuckOpen "Inhibit Status of FIds / Status of function identifier FId_DTESKEBCpv1DteskLoLoadStuckOpen" UWORD DFC_OneToOne 1 100 0.00 65535.00 FORMAT "%8.2" ECU_ADDRESS 0x600142F6 /end MEASUREMENT
/begin MEASUREMENT DINH_stFId.FId_DTESKEnvCondVld "Inhibit Status of FIds / Status of function identifier FId_DTESKEnvCondVld" UWORD DFC_OneToOne 1 100 0.00 65535.00 FORMAT "%8.2" ECU_ADDRESS 0x600142F8 /end MEASUREMENT
/begin MEASUREMENT DINH_stFId.FId_DTESKFuLvlCondVld "Inhibit Status of FIds / Status of function identifier FId_DTESKFuLvlCondVld" UWORD DFC_OneToOne 1 100 0.00 65535.00 FORMAT "%8.2" ECU_ADDRESS 0x600142FA /end MEASUREMENT
/begin MEASUREMENT DINH_stFId.FId_DTESKvfz "Inhibit Status of FIds / Status of function identifier FId_DTESKvfz" UWORD DFC_OneToOne 1 100 0.00 65535.00 FORMAT "%8.2" ECU_ADDRESS 0x600142FC /end MEASUREMENT
/begin MEASUREMENT DINH_stFId.FId_DdskvFraTstd "Inhibit Status of FIds / Status of function identifier FId_DdskvFraTstd" UWORD DFC_OneToOne 1 100 0.00 65535.00 FORMAT "%8.2" ECU_ADDRESS 0x600142FE /end MEASUREMENT
/begin MEASUREMENT DINH_stFId.FId_DdskvOraTstd "Inhibit Status of FIds / Status of function identifier FId_DdskvOraTstd" UWORD DFC_OneToOne 1 100 0.00 65535.00 FORMAT "%8.2" ECU_ADDRESS 0x60014300 /end MEASUREMENT
/begin MEASUREMENT DINH_stFId.FId_DewDetTKAMax "Inhibit Status of FIds / Status of function identifier FId_DewDetTKAMax" UWORD DFC_OneToOne 1 100 0.00 65535.00 FORMAT "%8.2" ECU_ADDRESS 0x60014302 /end MEASUREMENT
/begin MEASUREMENT DINH_stFId.FId_DiagBlkdLine "Inhibit Status of FIds / Status of function identifier FId_DiagBlkdLine" UWORD DFC_OneToOne 1 100 0.00 65535.00 FORMAT "%8.2" ECU_ADDRESS 0x60014304 /end MEASUREMENT
/begin MEASUREMENT DINH_stFId.FId_DiagCpv1DteskLoLoad "Inhibit Status of FIds / Status of function identifier FId_DiagCpv1DteskLoLoad" UWORD DFC_OneToOne 1 100 0.00 65535.00 FORMAT "%8.2" ECU_ADDRESS 0x60014306 /end MEASUREMENT
/begin MEASUREMENT DINH_stFId.FId_DkrsaEpmNoSig "Inhibit Status of FIds / Status of function identifier FId_DkrsaEpmNoSig" UWORD DFC_OneToOne 1 100 0.00 65535.00 FORMAT "%8.2" ECU_ADDRESS 0x60014308 /end MEASUREMENT
/begin MEASUREMENT DINH_stFId.FId_EBBCANErrFrzVal "Inhibit Status of FIds / Status of function identifier FId_EBBCANErrFrzVal" UWORD DFC_OneToOne 1 100 0.00 65535.00 FORMAT "%8.2" ECU_ADDRESS 0x6001430A /end MEASUREMENT
/begin MEASUREMENT DINH_stFId.FId_EBBCANErrReplVal "Inhibit Status of FIds / Status of function identifier FId_EBBCANErrReplVal" UWORD DFC_OneToOne 1 100 0.00 65535.00 FORMAT "%8.2" ECU_ADDRESS 0x6001430C /end MEASUREMENT
/begin MEASUREMENT DINH_stFId.FId_EGLZSR "Inhibit Status of FIds / Status of function identifier FId_EGLZSR" UWORD DFC_OneToOne 1 100 0.00 65535.00 FORMAT "%8.2" ECU_ADDRESS 0x6001430E /end MEASUREMENT
/begin MEASUREMENT DINH_stFId.FId_EGRVlvActrOff "Inhibit Status of FIds / Status of function identifier FId_EGRVlvActrOff" UWORD DFC_OneToOne 1 100 0.00 65535.00 FORMAT "%8.2" ECU_ADDRESS 0x60014310 /end MEASUREMENT
/begin MEASUREMENT DINH_stFId.FId_EGRVlvCldStrt "Inhibit Status of FIds / Status of function identifier FId_EGRVlvCldStrt" UWORD DFC_OneToOne 1 100 0.00 65535.00 FORMAT "%8.2" ECU_ADDRESS 0x60014312 /end MEASUREMENT
/begin MEASUREMENT DINH_stFId.FId_EGRVlvClnVrfy "Inhibit Status of FIds / Status of function identifier FId_EGRVlvClnVrfy" UWORD DFC_OneToOne 1 100 0.00 65535.00 FORMAT "%8.2" ECU_ADDRESS 0x60014314 /end MEASUREMENT
/begin MEASUREMENT DINH_stFId.FId_EGRVlvCtrlErr "Inhibit Status of FIds / Status of function identifier FId_EGRVlvCtrlErr" UWORD DFC_OneToOne 1 100 0.00 65535.00 FORMAT "%8.2" ECU_ADDRESS 0x60014316 /end MEASUREMENT
/begin MEASUREMENT DINH_stFId.FId_EGRVlvEngTempDef "Inhibit Status of FIds / Status of function identifier FId_EGRVlvEngTempDef" UWORD DFC_OneToOne 1 100 0.00 65535.00 FORMAT "%8.2" ECU_ADDRESS 0x60014318 /end MEASUREMENT
/begin MEASUREMENT DINH_stFId.FId_EGRVlvFailSafeActv "Inhibit Status of FIds / Status of function identifier FId_EGRVlvFailSafeActv" UWORD DFC_OneToOne 1 100 0.00 65535.00 FORMAT "%8.2" ECU_ADDRESS 0x6001431A /end MEASUREMENT
/begin MEASUREMENT DINH_stFId.FId_EGRVlvFrzVal "Inhibit Status of FIds / Status of function identifier FId_EGRVlvFrzVal" UWORD DFC_OneToOne 1 100 0.00 65535.00 FORMAT "%8.2" ECU_ADDRESS 0x6001431C /end MEASUREMENT
/begin MEASUREMENT DINH_stFId.FId_EGRVlvGovOn "Inhibit Status of FIds / Status of function identifier FId_EGRVlvGovOn" UWORD DFC_OneToOne 1 100 0.00 65535.00 FORMAT "%8.2" ECU_ADDRESS 0x6001431E /end MEASUREMENT
/begin MEASUREMENT DINH_stFId.FId_EGRVlvGovOnCld "Inhibit Status of FIds / Status of function identifier FId_EGRVlvGovOnCld" UWORD DFC_OneToOne 1 100 0.00 65535.00 FORMAT "%8.2" ECU_ADDRESS 0x60014320 /end MEASUREMENT
/begin MEASUREMENT DINH_stFId.FId_EGRVlvGovrOnRelsFct "Inhibit Status of FIds / Status of function identifier FId_EGRVlvGovrOnRelsFct" UWORD DFC_OneToOne 1 100 0.00 65535.00 FORMAT "%8.2" ECU_ADDRESS 0x60014322 /end MEASUREMENT
/begin MEASUREMENT DINH_stFId.FId_EGRVlvILimn "Inhibit Status of FIds / Status of function identifier FId_EGRVlvILimn" UWORD DFC_OneToOne 1 100 0.00 65535.00 FORMAT "%8.2" ECU_ADDRESS 0x60014324 /end MEASUREMENT
/begin MEASUREMENT DINH_stFId.FId_EGRVlvIni "Inhibit Status of FIds / Status of function identifier FId_EGRVlvIni" UWORD DFC_OneToOne 1 100 0.00 65535.00 FORMAT "%8.2" ECU_ADDRESS 0x60014326 /end MEASUREMENT
/begin MEASUREMENT DINH_stFId.FId_EGRVlvMon "Inhibit Status of FIds / Status of function identifier FId_EGRVlvMon" UWORD DFC_OneToOne 1 100 0.00 65535.00 FORMAT "%8.2" ECU_ADDRESS 0x60014328 /end MEASUREMENT
/begin MEASUREMENT DINH_stFId.FId_EGRVlvOfsLrnInhib "Inhibit Status of FIds / Status of function identifier FId_EGRVlvOfsLrnInhib" UWORD DFC_OneToOne 1 100 0.00 65535.00 FORMAT "%8.2" ECU_ADDRESS 0x6001432A /end MEASUREMENT
/begin MEASUREMENT DINH_stFId.FId_EGRVlvPhysRng "Inhibit Status of FIds / Status of function identifier FId_EGRVlvPhysRng" UWORD DFC_OneToOne 1 100 0.00 65535.00 FORMAT "%8.2" ECU_ADDRESS 0x6001432C /end MEASUREMENT
/begin MEASUREMENT DINH_stFId.FId_EGRVlvPsSwtOff "Inhibit Status of FIds / Status of function identifier FId_EGRVlvPsSwtOff" UWORD DFC_OneToOne 1 100 0.00 65535.00 FORMAT "%8.2" ECU_ADDRESS 0x6001432E /end MEASUREMENT
/begin MEASUREMENT DINH_stFId.FId_EGRVlvPwrStgMonDis "Inhibit Status of FIds / Status of function identifier FId_EGRVlvPwrStgMonDis" UWORD DFC_OneToOne 1 100 0.00 65535.00 FORMAT "%8.2" ECU_ADDRESS 0x60014330 /end MEASUREMENT
/begin MEASUREMENT DINH_stFId.FId_EGRVlvRplVal "Inhibit Status of FIds / Status of function identifier FId_EGRVlvRplVal" UWORD DFC_OneToOne 1 100 0.00 65535.00 FORMAT "%8.2" ECU_ADDRESS 0x60014332 /end MEASUREMENT
/begin MEASUREMENT DINH_stFId.FId_EGRVlvSSpMon "Inhibit Status of FIds / Status of function identifier FId_EGRVlvSSpMon" UWORD DFC_OneToOne 1 100 0.00 65535.00 FORMAT "%8.2" ECU_ADDRESS 0x60014334 /end MEASUREMENT
/begin MEASUREMENT DINH_stFId.FId_EGRVlvSnsrErr "Inhibit Status of FIds / Status of function identifier FId_EGRVlvSnsrErr" UWORD DFC_OneToOne 1 100 0.00 65535.00 FORMAT "%8.2" ECU_ADDRESS 0x60014336 /end MEASUREMENT
/begin MEASUREMENT DINH_stFId.FId_EGRVlvTempCmp "Inhibit Status of FIds / Status of function identifier FId_EGRVlvTempCmp" UWORD DFC_OneToOne 1 100 0.00 65535.00 FORMAT "%8.2" ECU_ADDRESS 0x60014338 /end MEASUREMENT
/begin MEASUREMENT DINH_stFId.FId_EGRVlvTempMdlEEPErr "Inhibit Status of FIds / Status of function identifier FId_EGRVlvTempMdlEEPErr" UWORD DFC_OneToOne 1 100 0.00 65535.00 FORMAT "%8.2" ECU_ADDRESS 0x6001433A /end MEASUREMENT
/begin MEASUREMENT DINH_stFId.FId_EGRVlvTmpErrCnt "Inhibit Status of FIds / Status of function identifier FId_EGRVlvTmpErrCnt" UWORD DFC_OneToOne 1 100 0.00 65535.00 FORMAT "%8.2" ECU_ADDRESS 0x6001433C /end MEASUREMENT
/begin MEASUREMENT DINH_stFId.FId_EGRVlvTrlPtr "Inhibit Status of FIds / Status of function identifier FId_EGRVlvTrlPtr" UWORD DFC_OneToOne 1 100 0.00 65535.00 FORMAT "%8.2" ECU_ADDRESS 0x6001433E /end MEASUREMENT
/begin MEASUREMENT DINH_stFId.FId_EGRVlv_VehvErr "Inhibit Status of FIds / Status of function identifier FId_EGRVlv_VehvErr" UWORD DFC_OneToOne 1 100 0.00 65535.00 FORMAT "%8.2" ECU_ADDRESS 0x60014340 /end MEASUREMENT
/begin MEASUREMENT DINH_stFId.FId_EGRVlviActIEfcLimn "Inhibit Status of FIds / Status of function identifier FId_EGRVlviActIEfcLimn" UWORD DFC_OneToOne 1 100 0.00 65535.00 FORMAT "%8.2" ECU_ADDRESS 0x60014342 /end MEASUREMENT
/begin MEASUREMENT DINH_stFId.FId_EGRVlvpDsbcInvld "Inhibit Status of FIds / Status of function identifier FId_EGRVlvpDsbcInvld" UWORD DFC_OneToOne 1 100 0.00 65535.00 FORMAT "%8.2" ECU_ADDRESS 0x60014344 /end MEASUREMENT
/begin MEASUREMENT DINH_stFId.FId_EGSDO2OffsRstDsmS1B1 "Inhibit Status of FIds / Status of function identifier FId_EGSDO2OffsRstDsmS1B1" UWORD DFC_OneToOne 1 100 0.00 65535.00 FORMAT "%8.2" ECU_ADDRESS 0x60014346 /end MEASUREMENT
/begin MEASUREMENT DINH_stFId.FId_EGSDO2_LamOffsSlowS1 "Inhibit Status of FIds / Status of function identifier FId_EGSDO2_LamOffsSlowS1" UWORD DFC_OneToOne 1 100 0.00 65535.00 FORMAT "%8.2" ECU_ADDRESS 0x60014348 /end MEASUREMENT
/begin MEASUREMENT DINH_stFId.FId_EGSDO2_RstFltSuspcnOffsB1 "Inhibit Status of FIds / Status of function identifier FId_EGSDO2_RstFltSuspcnOffsB1" UWORD DFC_OneToOne 1 100 0.00 65535.00 FORMAT "%8.2" ECU_ADDRESS 0x6001434A /end MEASUREMENT
/begin MEASUREMENT DINH_stFId.FId_EGSDUS2B1DlyEvln "Inhibit Status of FIds / Status of function identifier FId_EGSDUS2B1DlyEvln" UWORD DFC_OneToOne 1 100 0.00 65535.00 FORMAT "%8.2" ECU_ADDRESS 0x6001434C /end MEASUREMENT
/begin MEASUREMENT DINH_stFId.FId_EGSDUS2B1LtrDly "Inhibit Status of FIds / Status of function identifier FId_EGSDUS2B1LtrDly" UWORD DFC_OneToOne 1 100 0.00 65535.00 FORMAT "%8.2" ECU_ADDRESS 0x6001434E /end MEASUREMENT
/begin MEASUREMENT DINH_stFId.FId_EGSDUS2B1LtrPT1 "Inhibit Status of FIds / Status of function identifier FId_EGSDUS2B1LtrPT1" UWORD DFC_OneToOne 1 100 0.00 65535.00 FORMAT "%8.2" ECU_ADDRESS 0x60014350 /end MEASUREMENT
/begin MEASUREMENT DINH_stFId.FId_EGSDUS2B1PT1Evln "Inhibit Status of FIds / Status of function identifier FId_EGSDUS2B1PT1Evln" UWORD DFC_OneToOne 1 100 0.00 65535.00 FORMAT "%8.2" ECU_ADDRESS 0x60014352 /end MEASUREMENT
/begin MEASUREMENT DINH_stFId.FId_EGSDUS2B1RtlDly "Inhibit Status of FIds / Status of function identifier FId_EGSDUS2B1RtlDly" UWORD DFC_OneToOne 1 100 0.00 65535.00 FORMAT "%8.2" ECU_ADDRESS 0x60014354 /end MEASUREMENT
/begin MEASUREMENT DINH_stFId.FId_EGSDUS2B1RtlPT1 "Inhibit Status of FIds / Status of function identifier FId_EGSDUS2B1RtlPT1" UWORD DFC_OneToOne 1 100 0.00 65535.00 FORMAT "%8.2" ECU_ADDRESS 0x60014356 /end MEASUREMENT
/begin MEASUREMENT DINH_stFId.FId_EGSDUS2B1TarEvln "Inhibit Status of FIds / Status of function identifier FId_EGSDUS2B1TarEvln" UWORD DFC_OneToOne 1 100 0.00 65535.00 FORMAT "%8.2" ECU_ADDRESS 0x60014358 /end MEASUREMENT
/begin MEASUREMENT DINH_stFId.FId_EGSDUS2B1TarLean "Inhibit Status of FIds / Status of function identifier FId_EGSDUS2B1TarLean" UWORD DFC_OneToOne 1 100 0.00 65535.00 FORMAT "%8.2" ECU_ADDRESS 0x6001435A /end MEASUREMENT
/begin MEASUREMENT DINH_stFId.FId_EGSDUS2B1TarRich "Inhibit Status of FIds / Status of function identifier FId_EGSDUS2B1TarRich" UWORD DFC_OneToOne 1 100 0.00 65535.00 FORMAT "%8.2" ECU_ADDRESS 0x6001435C /end MEASUREMENT
/begin MEASUREMENT DINH_stFId.FId_EGSSigO2S1B1 "Inhibit Status of FIds / Status of function identifier FId_EGSSigO2S1B1" UWORD DFC_OneToOne 1 100 0.00 65535.00 FORMAT "%8.2" ECU_ADDRESS 0x6001435E /end MEASUREMENT
/begin MEASUREMENT DINH_stFId.FId_ELZSR "Inhibit Status of FIds / Status of function identifier FId_ELZSR" UWORD DFC_OneToOne 1 100 0.00 65535.00 FORMAT "%8.2" ECU_ADDRESS 0x60014360 /end MEASUREMENT
/begin MEASUREMENT DINH_stFId.FId_EPBErr "Inhibit Status of FIds / Status of function identifier FId_EPBErr" UWORD DFC_OneToOne 1 100 0.00 65535.00 FORMAT "%8.2" ECU_ADDRESS 0x60014362 /end MEASUREMENT
/begin MEASUREMENT DINH_stFId.FId_EPBFrmErr "Inhibit Status of FIds / Status of function identifier FId_EPBFrmErr" UWORD DFC_OneToOne 1 100 0.00 65535.00 FORMAT "%8.2" ECU_ADDRESS 0x60014364 /end MEASUREMENT
/begin MEASUREMENT DINH_stFId.FId_EPBFrmErrClth "Inhibit Status of FIds / Status of function identifier FId_EPBFrmErrClth" UWORD DFC_OneToOne 1 100 0.00 65535.00 FORMAT "%8.2" ECU_ADDRESS 0x60014366 /end MEASUREMENT
/begin MEASUREMENT DINH_stFId.FId_ETHSCPErrDrvCyc "Inhibit Status of FIds / Status of function identifier FId_ETHSCPErrDrvCyc" UWORD DFC_OneToOne 1 100 0.00 65535.00 FORMAT "%8.2" ECU_ADDRESS 0x60014368 /end MEASUREMENT
/begin MEASUREMENT DINH_stFId.FId_EVPComFailr "Inhibit Status of FIds / Status of function identifier FId_EVPComFailr" UWORD DFC_OneToOne 1 100 0.00 65535.00 FORMAT "%8.2" ECU_ADDRESS 0x6001436A /end MEASUREMENT
/begin MEASUREMENT DINH_stFId.FId_EbsLinErr "Inhibit Status of FIds / Status of function identifier FId_EbsLinErr" UWORD DFC_OneToOne 1 100 0.00 65535.00 FORMAT "%8.2" ECU_ADDRESS 0x6001436C /end MEASUREMENT
/begin MEASUREMENT DINH_stFId.FId_ElecLdComErr "Inhibit Status of FIds / Status of function identifier FId_ElecLdComErr" UWORD DFC_OneToOne 1 100 0.00 65535.00 FORMAT "%8.2" ECU_ADDRESS 0x6001436E /end MEASUREMENT
/begin MEASUREMENT DINH_stFId.FId_ElecLdFrzVal "Inhibit Status of FIds / Status of function identifier FId_ElecLdFrzVal" UWORD DFC_OneToOne 1 100 0.00 65535.00 FORMAT "%8.2" ECU_ADDRESS 0x60014370 /end MEASUREMENT
/begin MEASUREMENT DINH_stFId.FId_ElecLdHdLiComErr "Inhibit Status of FIds / Status of function identifier FId_ElecLdHdLiComErr" UWORD DFC_OneToOne 1 100 0.00 65535.00 FORMAT "%8.2" ECU_ADDRESS 0x60014372 /end MEASUREMENT
/begin FUNCTION DINH "30000.27.0_1.0.0Diagnostic Inhibit Handler"
 /begin LOC_MEASUREMENT DINH_nrActvInhReas.FId_OilPPlausT15 DINH_nrActvInhReas.FId_OilPRplVal DINH_nrActvInhReas.FId_OilPSnsrErr DINH_nrActvInhReas.FId_OilPSwmpSRC DINH_nrActvInhReas.FId_OilSwmpTCEngDsTWrmUp DINH_nrActvInhReas.FId_OilSwmpT_B_tospg DINH_nrActvInhReas.FId_OilSwmpT_B_tospgg DINH_nrActvInhReas.FId_OilSwmpT_CmbdSnsrErr DINH_nrActvInhReas.FId_OilSwmpT_CmbdSnsrTiTErr DINH_nrActvInhReas.FId_OilSwmpT_EnvT DINH_nrActvInhReas.FId_OilSwmpT_TSnsrErr DINH_nrActvInhReas.FId_PEnvMeasVld DINH_nrActvInhReas.FId_PEnvModel DINH_nrActvInhReas.FId_PEnvPlausDiagVDD DINH_nrActvInhReas.FId_PEnvRawVldVDD DINH_nrActvInhReas.FId_PEnvRefSnsr DINH_nrActvInhReas.FId_PEnvSigRngVld DINH_nrActvInhReas.FId_PEnvSnsrPlausVDD DINH_nrActvInhReas.FId_PEnvVldVDD DINH_nrActvInhReas.FId_PIDA6SigSrcErr DINH_nrActvInhReas.FId_PIntkMnfldPlaus DINH_nrActvInhReas.FId_PIntkVUsElecDiagB1 DINH_nrActvInhReas.FId_PSPCtlDisbl DINH_nrActvInhReas.FId_PSPCtlIntkAirVapLock DINH_nrActvInhReas.FId_PSPCtlPreRun DINH_nrActvInhReas.FId_PSPCtlVapLock DINH_nrActvInhReas.FId_PSPDiagDisbl DINH_nrActvInhReas.FId_PTGripConv DINH_nrActvInhReas.FId_PTGripConvStrt DINH_nrActvInhReas.FId_PTGripMnlClth DINH_nrActvInhReas.FId_PTGripMnlClthStrt DINH_nrActvInhReas.FId_PTTrqRatCANPtd DINH_nrActvInhReas.FId_PThrVlVUsVldB1 DINH_nrActvInhReas.FId_PThrVlvUsMeasdVldB1 DINH_nrActvInhReas.FId_P_VSE11_Diag DINH_nrActvInhReas.FId_PrmId03_FltRdnS1B1 DINH_nrActvInhReas.FId_PrmId03_FltUegoS1B1 DINH_nrActvInhReas.FId_RevLck DINH_nrActvInhReas.FId_RstAdpnPIntkMnfldAfs DINH_nrActvInhReas.FId_RvsPosnFailr DINH_nrActvInhReas.FId_SSEEPBRelease DINH_nrActvInhReas.FId_SSEFCANPRelease DINH_nrActvInhReas.FId_SSEPTCANPRelease DINH_nrActvInhReas.FId_SSEStartRelease DINH_nrActvInhReas.FId_SSEStartReleaseMTCl10 DINH_nrActvInhReas.FId_SSEStartReleaseMTCl100 DINH_nrActvInhReas.FId_SSEStartReleaseMTCl20 DINH_nrActvInhReas.FId_SSEStartReleaseMTCl90 DINH_nrActvInhReas.FId_SSEStartRequest DINH_nrActvInhReas.FId_SSEStopRelease DINH_nrActvInhReas.FId_SSEStrtStopRelease DINH_nrActvInhReas.FId_SSESysOff DINH_nrActvInhReas.FId_SSEUI2DCSysFailr DINH_nrActvInhReas.FId_SSEUIBCANErr DINH_nrActvInhReas.FId_SSEUISysFail DINH_nrActvInhReas.FId_SiaEEPErr DINH_nrActvInhReas.FId_SnglWhlErrDiagEna DINH_nrActvInhReas.FId_StrtCtlAutoCrkModeCdn DINH_nrActvInhReas.FId_StrtCtlComEngStrtErr DINH_nrActvInhReas.FId_StrtCtlNPCdnCncl DINH_nrActvInhReas.FId_StrtCtlNoCpuFailr DINH_nrActvInhReas.FId_StrtCtlNoFailCanLine DINH_nrActvInhReas.FId_StrtCtlNoFailPTCanLine DINH_nrActvInhReas.FId_StrtCtlPNPosnSubsVal DINH_nrActvInhReas.FId_StrtCtlSTMFailr DINH_nrActvInhReas.FId_StrtErrShaft DINH_nrActvInhReas.FId_SumErrHndlg DINH_nrActvInhReas.FId_SysDiagComErr DINH_nrActvInhReas.FId_SysDiagModInhbErr DINH_nrActvInhReas.FId_TOSPM DINH_nrActvInhReas.FId_TWCCILck DINH_nrActvInhReas.FId_TWCCILckExtd DINH_nrActvInhReas.FId_TWCCIRstB1 DINH_nrActvInhReas.FId_TWCCIRstDSMClearB1 DINH_nrActvInhReas.FId_TWCCLsuB1 DINH_nrActvInhReas.FId_TWCCLsuCyc DINH_nrActvInhReas.FId_TWCCLsuDynB1 DINH_nrActvInhReas.FId_TWCCMisfDetn DINH_nrActvInhReas.FId_TWCDPriCatParB1 DINH_nrActvInhReas.FId_TWCDPriCatVldnB1 DINH_nrActvInhReas.FId_TankPCpv1DteskLoLoadStuckClsd DINH_nrActvInhReas.FId_TankPCpv1DteskLoLoadStuckOpen DINH_nrActvInhReas.FId_TankPSnsrElecChkVld DINH_nrActvInhReas.FId_ThrVlvMon DINH_nrActvInhReas.FId_ThrVlvOffsLrnPrmsB1 DINH_nrActvInhReas.FId_TiOffTBasdChkFast DINH_nrActvInhReas.FId_TiOffTBasdChkSlow DINH_nrActvInhReas.FId_TiOffVdClk DINH_nrActvInhReas.FId_TqDecelOffsInhb DINH_nrActvInhReas.FId_TraAddAirCANPtd DINH_nrActvInhReas.FId_TraAddClntCANPtd DINH_nrActvInhReas.FId_TraFwdRvsCluInfo DINH_nrActvInhReas.FId_TraGbxNPos DINH_nrActvInhReas.FId_TraGearInfoCanCom DINH_nrActvInhReas.FId_TraGearInfoDet DINH_nrActvInhReas.FId_TraGearInfoGearShftActv DINH_nrActvInhReas.FId_TraGearInfoInfoCan DINH_nrActvInhReas.FId_TraGearInfoLevPos DINH_nrActvInhReas.FId_TraGearInfoLoRng DINH_nrActvInhReas.FId_TraGearInfoRTra DINH_nrActvInhReas.FId_TraGearInfoRevGear DINH_nrActvInhReas.FId_TraGearReq DINH_nrActvInhReas.FId_TraNoShftIdctr DINH_nrActvInhReas.FId_TraPrtGearCANPtd DINH_nrActvInhReas.FId_TraPrtGearIndpdtProblem DINH_nrActvInhReas.FId_TraRPosn DINH_nrActvInhReas.FId_TraRtnIntfcASTIntv DINH_nrActvInhReas.FId_TraRtnIntfcIdlSetP DINH_nrActvInhReas.FId_TraRtnIntfcNMaxCan DINH_nrActvInhReas.FId_TraRtnIntfcNMaxVel DINH_nrActvInhReas.FId_TraTrqRedLmpHmeDec DINH_nrActvInhReas.FId_TraTrqRedLmpHmeInc DINH_nrActvInhReas.FId_TraTrqRedPTCanErr DINH_nrActvInhReas.FId_TraTrqRedTIIntvDes DINH_nrActvInhReas.FId_TraTrqRedTIIntvLead DINH_nrActvInhReas.FId_TraTrqRedTSCIntvDes DINH_nrActvInhReas.FId_TraTrqRedTSCIntvLead DINH_nrActvInhReas.FId_TraTrsmTypHw DINH_nrActvInhReas.FId_TranIdleDes DINH_nrActvInhReas.FId_UEGOHeatgUpRglS1B1 DINH_nrActvInhReas.FId_UEGOHeatrCtrlS1B1 DINH_nrActvInhReas.FId_UEGOHeatrPrfmncDiagRelsS1B1 DINH_nrActvInhReas.FId_UEGOHeatrPwrStgDiagRelsS1B1 DINH_nrActvInhReas.FId_UEGOModCtrlRelsS1B1 DINH_nrActvInhReas.FId_UEGOStrtDiagInhRprtErrS1B1 DINH_nrActvInhReas.FId_UEGOStrtDiagRelsS1B1 DINH_nrActvInhReas.FId_UEGOTCeramicRelsS1B1 DINH_nrActvInhReas.FId_UegoDiagRelsBattSplyOk DINH_nrActvInhReas.FId_UegoDiagSigEcuAsicS1B1 DINH_nrActvInhReas.FId_UegoDiagSigEcuComS1B1 DINH_nrActvInhReas.FId_UegoDiagSigOperPlausS1B1 DINH_nrActvInhReas.FId_UegoDiagSigSnsrS1B1 DINH_nrActvInhReas.FId_UegoDiagSigWireOlS1B1 DINH_nrActvInhReas.FId_UegoDiagSigWireScS1B1 DINH_nrActvInhReas.FId_UegoDiagSigWireScTstdS1B1 DINH_nrActvInhReas.FId_UegoInhbOperRelsS1B1 DINH_nrActvInhReas.FId_UegoO2HiPrcsnS1B1 DINH_nrActvInhReas.FId_UegoO2PlausErrS1B1 DINH_nrActvInhReas.FId_UegoO2VldS1B1 DINH_nrActvInhReas.FId_UegoOperPlausBattSplyOk DINH_nrActvInhReas.FId_UegoPlausErrHndlg DINH_nrActvInhReas.FId_VMSIDCSRmpShOff DINH_nrActvInhReas.FId_VMSIDCSShOff DINH_nrActvInhReas.FId_VMSITCSRmpShOff DINH_nrActvInhReas.FId_VMSITCSShOff DINH_nrActvInhReas.FId_VSACANErr DINH_nrActvInhReas.FId_VehStcACGFailr DINH_nrActvInhReas.FId_VehStcBattMngFailr DINH_nrActvInhReas.FId_VehStcDCDCFailr DINH_nrActvInhReas.FId_VehStcEBSFailr DINH_nrActvInhReas.FId_VehStcMisf DINH_nrActvInhReas.FId_VehStcMtrComFailr DINH_nrActvInhReas.FId_VehStcNVMFailr DINH_nrActvInhReas.FId_VehVCANFrzVal DINH_nrActvInhReas.FId_VehVCANReplVal DINH_nrActvInhReas.FId_VehVCanSafeFrzVal DINH_nrActvInhReas.FId_VehVCanSafeReplVal DINH_nrActvInhReas.FId_VehVCom DINH_nrActvInhReas.FId_VehVExcdLim DINH_nrActvInhReas.FId_VehVFrzVal DINH_nrActvInhReas.FId_VehVNCSnsrElecFailr DINH_nrActvInhReas.FId_VehVOBDFrzVal DINH_nrActvInhReas.FId_VehVOBDReplVal DINH_nrActvInhReas.FId_VehVOutCanErr DINH_nrActvInhReas.FId_VehVPWMFrzVal DINH_nrActvInhReas.FId_VehVPWMReplVal DINH_nrActvInhReas.FId_VehVPhysRng DINH_nrActvInhReas.FId_VehVPlaus DINH_nrActvInhReas.FId_VehVPlausCan DINH_nrActvInhReas.FId_VehVPlausFco DINH_nrActvInhReas.FId_VehVPlausPwr DINH_nrActvInhReas.FId_VehVPlausV2N DINH_nrActvInhReas.FId_VehVReplVal DINH_nrActvInhReas.FId_VehVSigCan DINH_nrActvInhReas.FId_VehVSigCanSafe DINH_nrActvInhReas.FId_VehVSngWhlCanFrzVal DINH_nrActvInhReas.FId_VehVSngWhlCanReplVal DINH_nrActvInhReas.FId_VehVSnsrARngHi DINH_nrActvInhReas.FId_VehVSnsrBRngHi DINH_nrActvInhReas.FId_VehVSpdRtyDiag DINH_nrActvInhReas.FId_VehVSpdSnsrAElecFailr DINH_nrActvInhReas.FId_VehVSpdSnsrBElecFailr DINH_nrActvInhReas.FId_VehVvFLWhlSpd DINH_nrActvInhReas.FId_VehVvFRWhlSpd DINH_nrActvInhReas.FId_VehVvRLWhlSpd DINH_nrActvInhReas.FId_VehVvRRWhlSpd DINH_nrActvInhReas.FId_VldtLamDynS1B1 DINH_nrActvInhReas.FId_VlvLftFbIntkOilPSnsr11SRC DINH_nrActvInhReas.FId_VlvLftFbSwtIntk11Diag DINH_nrActvInhReas.FId_ZGLZSR DINH_nrActvInhReas.FId_airIntkFltSnsrKnkPrtnIgn DINH_nrActvInhReas.FId_ctrladpncvo DINH_nrActvInhReas.FId_stChkChgnSys DINH_nrActvInhReas.FId_stChkChgnSys2DC DINH_nrActvInhReas.FId_tFltSnsrKnkPrtnIgn DINH_stClctFId_mp DINH_stFId.FId_Unused DINH_stFId.FID_AFRA DINH_stFId.FID_AORA DINH_stFId.FID_ATEH DINH_stFId.FID_ATEL DINH_stFId.FID_ATEN DINH_stFId.FID_ATLDI DINH_stFId.FID_ATLDO DINH_stFId.FID_BEONV DINH_stFId.FId_EGSDCmnSeg1B1Parl DINH_stFId.FID_BAGRA DINH_stFId.FID_BAGRASD DINH_stFId.FID_BDSTOF DINH_stFId.FID_BFVDFRM DINH_stFId.FID_BHOM DINH_stFId.FID_BLLRH DINH_stFId.FID_BLLRKH DINH_stFId.FID_BPLSU DINH_stFId.FID_FRAMBAVMB DINH_stFId.FId_CatHeatgColdStrtReq DINH_stFId.FId_CatHeatgWrmReq DINH_stFId.FId_DSMBDEPHSpOpMode DINH_stFId.FId_EGRVlvCoord DINH_stFId.FId_EGSDO2FuTrmB1 DINH_stFId.FId_EGSDO2SnsrMntdRelsS1B1 DINH_stFId.FId_EGSDO2_LamOffsFastS1B1 DINH_stFId.FId_MisfDetDnAdpnNv DINH_stFId.FId_bascadpncvo DINH_stFId.FID_AGRS DINH_stFId.FID_BBAGR DINH_stFId.FID_BBAGRA DINH_stFId.FID_BGFKMS DINH_stFId.FID_BGMSDKS DINH_stFId.FID_CAGRSUS DINH_stFId.FID_CBGTFUELM DINH_stFId.FID_CBGTHDEV DINH_stFId.FID_CDESVF DINH_stFId.FID_CDETHS DINH_stFId.FID_CDRCTSTRT DINH_stFId.FID_CDSKV DINH_stFId.FID_CDSKVRNO DINH_stFId.FID_CDSKVRPO DINH_stFId.FID_CDSKVRaty DINH_stFId.FID_CDSKVRng DINH_stFId.FID_CDSKVS DINH_stFId.FID_CDSTR DINH_stFId.FID_CDSTTI DINH_stFId.FID_CETHG DINH_stFId.FID_CETHSPLnpl DINH_stFId.FID_CETHSTPLnpl DINH_stFId.FID_CETKHL DINH_stFId.FID_CETKHT DINH_stFId.FID_CGDISTRT DINH_stFId.FID_CGLSRDP DINH_stFId.FID_CHDR DINH_stFId.FID_CHDRKH DINH_stFId.FID_CHDRPL DINH_stFId.FID_CLLKHV DINH_stFId.FID_CLLRHV DINH_stFId.FID_CLZSRDP DINH_stFId.FID_CLZSRHP DINH_stFId.FID_CNLHP DINH_stFId.FID_CNLHP2 DINH_stFId.FID_CNLKO2 DINH_stFId.FID_CNLKO3 DINH_stFId.FID_CNLLP DINH_stFId.FID_CNLPL DINH_stFId.FID_CNLPS DINH_stFId.FID_CNSAD DINH_stFId.FID_CNSAD2 DINH_stFId.FID_CPSRB DINH_stFId.FID_CPSRP DINH_stFId.FID_CSTHDR DINH_stFId.FID_CSTRTCTL DINH_stFId.FID_CTESF DINH_stFId.FID_CTESG DINH_stFId.FID_CTHIPSTRT DINH_stFId.FID_CTKACS DINH_stFId.FID_CTMSV DINH_stFId.FID_CTOSP DINH_stFId.FID_DHFERR DINH_stFId.FID_DKRSA DINH_stFId.FID_DLLRBandEndTst DINH_stFId.FID_DLLRShrtTrpSpdRmp DINH_stFId.FID_FEDKAHB DINH_stFId.FID_FEDKAPB DINH_stFId.FID_FEDSSB DINH_stFId.FID_FOFSTP DINH_stFId.FID_FONSTP DINH_stFId.FID_FUEDK DINH_stFId.FID_FVLRA DINH_stFId.FID_KRREGact DINH_stFId.FID_KRREGloc DINH_stFId.FID_LRADLSU DINH_stFId.FID_LRALSVErr DINH_stFId.FID_LRAPLLSU DINH_stFId.FID_LUSTP DINH_stFId.FID_LnKS1 DINH_stFId.FID_PLSUV DINH_stFId.FID_PSRMOZDG DINH_stFId.FID_PSRMOZG DINH_stFId.FID_STRTDIA DINH_stFId.FID_STRTSTM DINH_stFId.FID_TFA1CSMW DINH_stFId.FID_TFA2CSMW DINH_stFId.FID_TKACSMW DINH_stFId.FID_TMCSMW DINH_stFId.FID_TOCHOilSwmpTQly DINH_stFId.FID_TOCHTME DINH_stFId.FID_TOSPCSMW DINH_stFId.FID_TSRLX DINH_stFId.FID_UEGOHeatrRlyS1B1 DINH_stFId.FID_VehStvSSEOk DINH_stFId.FID_VldtLamPlausMaxS1B1 DINH_stFId.FID_VldtLamPlausMinS1B1 DINH_stFId.FId_ACClntPSSPMon DINH_stFId.FId_ACCompComCANBusOff DINH_stFId.FId_ACCompComCANErrMtr DINH_stFId.FId_ACComp_HiUTWSnsrErr DINH_stFId.FId_ACComp_LoUTWSnsrErr DINH_stFId.FId_ACComp_PDSnsrErr DINH_stFId.FId_ACComp_VehSpdSnsrErr DINH_stFId.FId_ACCtl_ACStrtCut DINH_stFId.FId_ACCtl_APP1 DINH_stFId.FId_ACCtl_APP2 DINH_stFId.FId_ACCtl_APPSync DINH_stFId.FId_ACCtl_AcOff DINH_stFId.FId_ACCtl_Clmb DINH_stFId.FId_ACCtl_DK1 DINH_stFId.FId_ACCtl_DK2 DINH_stFId.FId_ACCtl_DKSync DINH_stFId.FId_ACCtl_VehSpdSnsrErr DINH_stFId.FId_ACCtl_pAC DINH_stFId.FId_ACEvpTCANErr DINH_stFId.FId_ACEvpTFrzVal DINH_stFId.FId_ACEvpTPhysRng DINH_stFId.FId_ACEvpTRplVal DINH_stFId.FId_AFCLFailr DINH_stFId.FId_AFS DINH_stFId.FId_AFSPhyRng DINH_stFId.FId_APP1SigPath DINH_stFId.FId_APP2SigPath DINH_stFId.FId_APPBrkErr DINH_stFId.FId_APPLETVldnErr DINH_stFId.FId_APPLrn DINH_stFId.FId_APPVehVErr DINH_stFId.FId_AccPedDrvModComErr DINH_stFId.FId_AccPedDrvModFailr DINH_stFId.FId_AccPedNMaxLim DINH_stFId.FId_AccPedNMinLim DINH_stFId.FId_AccPedNMinLimBrkApp DINH_stFId.FId_AccPedTrqLim DINH_stFId.FId_AfsDdDiag DINH_stFId.FId_AfsDiagErr DINH_stFId.FId_AfsDiagTst DINH_stFId.FId_AfsPlausDiag DINH_stFId.FId_AfsVrntDiag DINH_stFId.FId_AirCClntPFrzVal DINH_stFId.FId_AirCClntPRplVal DINH_stFId.FId_AirCSwt DINH_stFId.FId_AirDvPAdpnPEnv DINH_stFId.FId_AirDvPAdpnPIntkVUsB1 DINH_stFId.FId_AirDvPPSnsrAdpn_PModeActv DINH_stFId.FId_AltACGFailr DINH_stFId.FId_AltAPPErrSt DINH_stFId.FId_AltBattMngtFailr DINH_stFId.FId_AltBrkErrSt DINH_stFId.FId_AltComErr DINH_stFId.FId_AltENGB DINH_stFId.FId_AltElecLoadErr DINH_stFId.FId_AltEnvTErr DINH_stFId.FId_AltFFAltLoadFast DINH_stFId.FId_AltFFAltLoadSlow DINH_stFId.FId_AltIOACGErr DINH_stFId.FId_AltIOACGLinComFailr DINH_stFId.FId_AltIOComErr DINH_stFId.FId_AltLinErr DINH_stFId.FId_AltPwr DINH_stFId.FId_AltVehVErrSt DINH_stFId.FId_AltvCluFail DINH_stFId.FId_BGAGRTS DINH_stFId.FId_BGFKMSEPSR DINH_stFId.FId_BGFKMSEPU DINH_stFId.FId_BGFKMSESumClr DINH_stFId.FId_BGFKMSHFME DINH_stFId.FId_BGFKMSHFMZ DINH_stFId.FId_BGFKMSZPSR DINH_stFId.FId_BGOSCCat1B1 DINH_stFId.FId_BGOSCCat2B1 DINH_stFId.FId_BattAltFailr DINH_stFId.FId_BattMngtFailr DINH_stFId.FId_BattSigPtd DINH_stFId.FId_BattU2MEDSRC DINH_stFId.FId_BattUDrpPrvOff DINH_stFId.FId_BattUFrzVal DINH_stFId.FId_BattUHiFailrEna DINH_stFId.FId_BattUIMGTCUCANFailr DINH_stFId.FId_BattULoFailrEna DINH_stFId.FId_BattUReplVal DINH_stFId.FId_BattUSRC DINH_stFId.FId_BlwrComErr DINH_stFId.FId_BrkBstMdl DINH_stFId.FId_BrkBstMdlBrkP DINH_stFId.FId_BrkBstMdlBrkSt DINH_stFId.FId_BrkBstMdlEnvP DINH_stFId.FId_BrkBstPDetnInhbn DINH_stFId.FId_BrkBstPMstCylPSnsrFail DINH_stFId.FId_BrkBstPSnsrStuckDetn DINH_stFId.FId_BrkBstSigPath DINH_stFId.FId_BrkBstVehVv DINH_stFId.FId_BrkMnSwtErr DINH_stFId.FId_BrkPFrzVal DINH_stFId.FId_BrkPOilPres DINH_stFId.FId_BrkPReplVal DINH_stFId.FId_BrkPedEngStopEna DINH_stFId.FId_BrkRdntSwtErr DINH_stFId.FId_CAGRSDS DINH_stFId.FId_CEngDsTColdStrt DINH_stFId.FId_CEngDsTColdStrtErr DINH_stFId.FId_CEngDsTHSC DINH_stFId.FId_CEngDsTLSC DINH_stFId.FId_CEngDsTPlausErr DINH_stFId.FId_CEngDsTReplMdlEngStop DINH_stFId.FId_CEngDsTSTC DINH_stFId.FId_CEngDsTSnsrElec DINH_stFId.FId_CEngDsTSwtReplMdl DINH_stFId.FId_CEngUsTColdChkErr DINH_stFId.FId_CEngUsTCrssChk DINH_stFId.FId_CEngUsTElecErr DINH_stFId.FId_CEngUsTSnsrElecErr DINH_stFId.FId_CEngUsTSwtReplMdl DINH_stFId.FId_CInjCatHeatgDiag DINH_stFId.FId_CMSUDKSOM1 DINH_stFId.FId_CMSUDKSOM2 DINH_stFId.FId_CatHeatgEomShtrpAct DINH_stFId.FId_ChrctlAgrsErr DINH_stFId.FId_ChrctlAgrscf DINH_stFId.FId_ClntTempENGB DINH_stFId.FId_Clth DINH_stFId.FId_Clth2 DINH_stFId.FId_Clth3StuckOn DINH_stFId.FId_Clth4 DINH_stFId.FId_ClthCAN DINH_stFId.FId_ClthMax DINH_stFId.FId_ClthStk DINH_stFId.FId_ClthStkErr DINH_stFId.FId_ClthStkFailr DINH_stFId.FId_ClthStkOFFStuck DINH_stFId.FId_ClthStkONStuck DINH_stFId.FId_ClthSwtFailr DINH_stFId.FId_CntrShaftFailr DINH_stFId.FId_CoEOMGdiEomErrLcy DINH_stFId.FId_CoESSBlowrVld DINH_stFId.FId_CoETM DINH_stFId.FId_CoETS_StTrqLimErr1 DINH_stFId.FId_CoETS_StTrqLimErr2 DINH_stFId.FId_CoEngStopEnblStSpEngT DINH_stFId.FId_CoEngStopEnblStSpLSU DINH_stFId.FId_CoEngStopEnblStSpTcT DINH_stFId.FId_CoEngStopEnblSysErr DINH_stFId.FId_CoEngVlvLftSpIntk DINH_stFId.FId_CoPOMStrtgDevStrtr DINH_stFId.FId_CoPOM_FirstStrtAut DINH_stFId.FId_CoTS_SwtOff DINH_stFId.FId_CoVOMACCComFailr DINH_stFId.FId_CoVOMBrkPedISABSigFailr DINH_stFId.FId_CoVOMEngCrkAbort DINH_stFId.FId_CoVOMEngRstrtEnaCdn DINH_stFId.FId_CoVOMISSEng DINH_stFId.FId_ComACRly DINH_stFId.FId_ComAPPSensFail DINH_stFId.FId_ComAPedl DINH_stFId.FId_ComAYCA DINH_stFId.FId_ComAYCAMon DINH_stFId.FId_ComAYCD DINH_stFId.FId_ComAYCDMon DINH_stFId.FId_ComAYCF DINH_stFId.FId_ComAYCFMon DINH_stFId.FId_ComAYCG DINH_stFId.FId_ComAYCGMon DINH_stFId.FId_ComAYCI DINH_stFId.FId_ComAYCIMon DINH_stFId.FId_ComAirPThrUsSnsrErr DINH_stFId.FId_ComAltFail DINH_stFId.FId_ComAppVehSnsrFailr DINH_stFId.FId_ComBCM1 DINH_stFId.FId_ComBCM1Mon DINH_stFId.FId_ComBCMUnitCfmdErr DINH_stFId.FId_ComBCMUnitNotTstd DINH_stFId.FId_ComBstCtrl DINH_stFId.FId_ComCANVEHICLEBusOff DINH_stFId.FId_ComCGW1 DINH_stFId.FId_ComCGW1Mon DINH_stFId.FId_ComClthSt DINH_stFId.FId_ComConvClth DINH_stFId.FId_ComCrCtlReq DINH_stFId.FId_ComCrsMaiIndcnLampReq DINH_stFId.FId_ComCrsSetIndcnLampReq DINH_stFId.FId_ComDCDCCdn DINH_stFId.FId_ComDCDCErr DINH_stFId.FId_ComDesGearCurr DINH_stFId.FId_ComDetrmAirM DINH_stFId.FId_ComDwnShiftCtrlReq DINH_stFId.FId_ComEAT1 DINH_stFId.FId_ComEAT10 DINH_stFId.FId_ComEAT10Mon DINH_stFId.FId_ComEAT11 DINH_stFId.FId_ComEAT11Mon DINH_stFId.FId_ComEAT12 DINH_stFId.FId_ComEAT12Mon DINH_stFId.FId_ComEAT13 DINH_stFId.FId_ComEAT13Mon DINH_stFId.FId_ComEAT1Mon DINH_stFId.FId_ComEAT2 DINH_stFId.FId_ComEAT2Mon DINH_stFId.FId_ComEAT4 DINH_stFId.FId_ComEAT4Mon DINH_stFId.FId_ComEAT6 DINH_stFId.FId_ComEAT6Mon DINH_stFId.FId_ComEAT7 DINH_stFId.FId_ComEAT7Mon DINH_stFId.FId_ComEAT8 DINH_stFId.FId_ComEAT8Mon DINH_stFId.FId_ComEATA DINH_stFId.FId_ComEATAMon DINH_stFId.FId_ComEATB DINH_stFId.FId_ComEATBMon DINH_stFId.FId_ComEATC DINH_stFId.FId_ComEATCMon DINH_stFId.FId_ComEBSSelfDiagErr DINH_stFId.FId_ComECUHwErr DINH_stFId.FId_ComEGRVlvErr DINH_stFId.FId_ComEMSIntAirTemp DINH_stFId.FId_ComEPB DINH_stFId.FId_ComEPBB DINH_stFId.FId_ComEPBBMon DINH_stFId.FId_ComEPBMon DINH_stFId.FId_ComEPS1 DINH_stFId.FId_ComEPS1Mon DINH_stFId.FId_ComEPSUnitCfmdErr DINH_stFId.FId_ComEPSUnitNotTstd DINH_stFId.FId_ComEngBrkOvrdInfo DINH_stFId.FId_ComEngBrkOvrdMtr DINH_stFId.FId_ComEngBrkSwErr DINH_stFId.FId_ComEngPosng DINH_stFId.FId_ComEngRPMLim DINH_stFId.FId_ComEngTrqLim DINH_stFId.FId_ComEnvtlAirPSnsrErr DINH_stFId.FId_ComEstmTqNormJdg DINH_stFId.FId_ComEthnlSErr DINH_stFId.FId_ComFlSply DINH_stFId.FId_ComFuCnsBitDurgIdleStop DINH_stFId.FId_ComGEVCntrl DINH_stFId.FId_ComGbxNPosFail DINH_stFId.FId_ComGbxTemp DINH_stFId.FId_ComGwIMG1 DINH_stFId.FId_ComGwIMG1Mon DINH_stFId.FId_ComGwIMG3 DINH_stFId.FId_ComGwIMG3Mon DINH_stFId.FId_ComGwIMG4 DINH_stFId.FId_ComGwIMG4Mon DINH_stFId.FId_ComGwIMG5 DINH_stFId.FId_ComGwIMG5Mon DINH_stFId.FId_ComGwIMG6 DINH_stFId.FId_ComGwIMG6Mon DINH_stFId.FId_ComHFMSnsrErr DINH_stFId.FId_ComIDASB DINH_stFId.FId_ComIDASBMon DINH_stFId.FId_ComIDASBUnitCfmdErr DINH_stFId.FId_ComIDASBUnitNotTstd DINH_stFId.FId_ComIDASEngFail DINH_stFId.FId_ComIDASEngFailMil DINH_stFId.FId_ComIMGUnitCfmdErr DINH_stFId.FId_ComIMGUnitNotTstd DINH_stFId.FId_ComISG2 DINH_stFId.FId_ComIgnCtrl DINH_stFId.FId_ComInjCtrl DINH_stFId.FId_ComIntkAirPSnsrErr DINH_stFId.FId_ComLamCtrl DINH_stFId.FId_ComMETA DINH_stFId.FId_ComMETAMon DINH_stFId.FId_ComMETC DINH_stFId.FId_ComMETCMon DINH_stFId.FId_ComMETD DINH_stFId.FId_ComMETDMon DINH_stFId.FId_ComMETE2 DINH_stFId.FId_ComMETE2Mon DINH_stFId.FId_ComMETF DINH_stFId.FId_ComMETFMon DINH_stFId.FId_ComMETG DINH_stFId.FId_ComMETGMon DINH_stFId.FId_ComMETH DINH_stFId.FId_ComMETH2 DINH_stFId.FId_ComMETH2Mon DINH_stFId.FId_ComMETHMon DINH_stFId.FId_ComMETI DINH_stFId.FId_ComMETIMon DINH_stFId.FId_ComMETK DINH_stFId.FId_ComMETKMon DINH_stFId.FId_ComMETL DINH_stFId.FId_ComMETLMon DINH_stFId.FId_ComMETM DINH_stFId.FId_ComMETMMon DINH_stFId.FId_ComMETN DINH_stFId.FId_ComMETNMon DINH_stFId.FId_ComMETUnitCfmdErr DINH_stFId.FId_ComMETUnitNotTstd DINH_stFId.FId_ComMisf DINH_stFId.FId_ComMon DINH_stFId.FId_ComNTrbn DINH_stFId.FId_ComODOff DINH_stFId.FId_ComOilLvlLamp DINH_stFId.FId_ComOilPWarnLamp DINH_stFId.FId_ComPASensFail DINH_stFId.FId_ComPBSensFail DINH_stFId.FId_ComPCU DINH_stFId.FId_ComPCUMon DINH_stFId.FId_ComPosActnSpdLimrFctReq DINH_stFId.FId_ComSRS DINH_stFId.FId_ComSRSA DINH_stFId.FId_ComSRSAMon DINH_stFId.FId_ComSRSB DINH_stFId.FId_ComSRSBMon DINH_stFId.FId_ComSRSMon DINH_stFId.FId_ComSRSUnitCfmdErr DINH_stFId.FId_ComSRSUnitNotTstd DINH_stFId.FId_ComSTFlt DINH_stFId.FId_ComSpdLimrDevActvn DINH_stFId.FId_ComTCU01 DINH_stFId.FId_ComTCU02 DINH_stFId.FId_ComTCU1 DINH_stFId.FId_ComTCU11 DINH_stFId.FId_ComTCU12 DINH_stFId.FId_ComTCU13 DINH_stFId.FId_ComTCU14 DINH_stFId.FId_ComTCU2 DINH_stFId.FId_ComTCU3 DINH_stFId.FId_ComTCU4 DINH_stFId.FId_ComTCUGear DINH_stFId.FId_ComTarGearDwnShift DINH_stFId.FId_ComTarGearUpShift DINH_stFId.FId_ComThrPosnFail DINH_stFId.FId_ComThrVlv DINH_stFId.FId_ComTrboChrgnErr DINH_stFId.FId_ComTrqAccuracySlow DINH_stFId.FId_ComTrqReqFast DINH_stFId.FId_ComTrqReqSlow DINH_stFId.FId_ComVSAErr DINH_stFId.FId_ComVSAUnitCfmdErr DINH_stFId.FId_ComVSAUnitNotTstd DINH_stFId.FId_ComVehSpdFlLvl DINH_stFId.FId_ComVehSpdFltChk DINH_stFId.FId_ComVehSpdImpsErr DINH_stFId.FId_ComVlvLftCtrl DINH_stFId.FId_ComvolEng DINH_stFId.FId_ConvLdCalcLvrPos DINH_stFId.FId_ConvLdNTrbnCan DINH_stFId.FId_ConvLdOilCoolrPmp DINH_stFId.FId_ConvLdOilTemp DINH_stFId.FId_ConvLdTrqLdCan DINH_stFId.FId_ConvLdVel DINH_stFId.FId_CooltTVldyTMdl DINH_stFId.FId_CptProtnCamsft DINH_stFId.FId_CptProtnExhTempMdl DINH_stFId.FId_CptProtnO2SnsrB1 DINH_stFId.FId_CptProtnVVeh DINH_stFId.FId_CrCUI1EFRxErr DINH_stFId.FId_CrCUICANRxErr DINH_stFId.FId_CrCUIFCMRxErr DINH_stFId.FId_CrCUIMETDRxErr DINH_stFId.FId_CrCtlACCRxErr DINH_stFId.FId_CrCtlAppSnsrErr DINH_stFId.FId_CrCtlShutOffEng DINH_stFId.FId_CstrPurgGnrlTstrReq DINH_stFId.FId_DAGRS DINH_stFId.FId_DELibBrkBstP DINH_stFId.FId_DELibCEngDsT DINH_stFId.FId_DELibCEngUsT DINH_stFId.FId_DELibEngDatEng DINH_stFId.FId_DELibEnvP DINH_stFId.FId_DELibEnvT DINH_stFId.FId_DELibFuelT DINH_stFId.FId_DELibIntkAirT DINH_stFId.FId_DELibNRCat DINH_stFId.FId_DELibOilP DINH_stFId.FId_DELibOilSwmpT DINH_stFId.FId_DELibPRelPfilDs DINH_stFId.FId_DELibTEGRClrLPDs DINH_stFId.FId_DEONVEBPEnv DINH_stFId.FId_DEONVTCCpv1DteskLoLoadStuckClsd DINH_stFId.FId_DEONVTCCpv1DteskLoLoadStuckOpen DINH_stFId.FId_DIUMPRCldStrtMon DINH_stFId.FId_DIUMPREvapMon DINH_stFId.FId_DIUMPRGenDenom1 DINH_stFId.FId_DIUMPRGenDenom1PDTC DINH_stFId.FId_DIUMPRGenDenom2 DINH_stFId.FId_DIUMPRGenDenom3 DINH_stFId.FId_DIUMPRIgn DINH_stFId.FId_DOGov DINH_stFId.FId_DSMWarmUpCycle DINH_stFId.FId_DTESKEBCpv1DteskLoLoadStuckClsd DINH_stFId.FId_DTESKEBCpv1DteskLoLoadStuckOpen DINH_stFId.FId_DTESKEnvCondVld DINH_stFId.FId_DTESKFuLvlCondVld DINH_stFId.FId_DTESKvfz DINH_stFId.FId_DdskvFraTstd DINH_stFId.FId_DdskvOraTstd DINH_stFId.FId_DewDetTKAMax DINH_stFId.FId_DiagBlkdLine DINH_stFId.FId_DiagCpv1DteskLoLoad DINH_stFId.FId_DkrsaEpmNoSig DINH_stFId.FId_EBBCANErrFrzVal DINH_stFId.FId_EBBCANErrReplVal DINH_stFId.FId_EGLZSR DINH_stFId.FId_EGRVlvActrOff DINH_stFId.FId_EGRVlvCldStrt DINH_stFId.FId_EGRVlvClnVrfy DINH_stFId.FId_EGRVlvCtrlErr DINH_stFId.FId_EGRVlvEngTempDef DINH_stFId.FId_EGRVlvFailSafeActv DINH_stFId.FId_EGRVlvFrzVal DINH_stFId.FId_EGRVlvGovOn DINH_stFId.FId_EGRVlvGovOnCld DINH_stFId.FId_EGRVlvGovrOnRelsFct DINH_stFId.FId_EGRVlvILimn DINH_stFId.FId_EGRVlvIni DINH_stFId.FId_EGRVlvMon DINH_stFId.FId_EGRVlvOfsLrnInhib DINH_stFId.FId_EGRVlvPhysRng DINH_stFId.FId_EGRVlvPsSwtOff DINH_stFId.FId_EGRVlvPwrStgMonDis DINH_stFId.FId_EGRVlvRplVal DINH_stFId.FId_EGRVlvSSpMon DINH_stFId.FId_EGRVlvSnsrErr DINH_stFId.FId_EGRVlvTempCmp DINH_stFId.FId_EGRVlvTempMdlEEPErr DINH_stFId.FId_EGRVlvTmpErrCnt DINH_stFId.FId_EGRVlvTrlPtr DINH_stFId.FId_EGRVlv_VehvErr DINH_stFId.FId_EGRVlviActIEfcLimn DINH_stFId.FId_EGRVlvpDsbcInvld DINH_stFId.FId_EGSDO2OffsRstDsmS1B1 DINH_stFId.FId_EGSDO2_LamOffsSlowS1 DINH_stFId.FId_EGSDO2_RstFltSuspcnOffsB1 DINH_stFId.FId_EGSDUS2B1DlyEvln DINH_stFId.FId_EGSDUS2B1LtrDly DINH_stFId.FId_EGSDUS2B1LtrPT1 DINH_stFId.FId_EGSDUS2B1PT1Evln DINH_stFId.FId_EGSDUS2B1RtlDly DINH_stFId.FId_EGSDUS2B1RtlPT1 DINH_stFId.FId_EGSDUS2B1TarEvln DINH_stFId.FId_EGSDUS2B1TarLean DINH_stFId.FId_EGSDUS2B1TarRich DINH_stFId.FId_EGSSigO2S1B1 DINH_stFId.FId_ELZSR DINH_stFId.FId_EPBErr DINH_stFId.FId_EPBFrmErr DINH_stFId.FId_EPBFrmErrClth DINH_stFId.FId_ETHSCPErrDrvCyc DINH_stFId.FId_EVPComFailr DINH_stFId.FId_EbsLinErr DINH_stFId.FId_ElecLdComErr DINH_stFId.FId_ElecLdFrzVal DINH_stFId.FId_ElecLdHdLiComErr /end LOC_MEASUREMENT
 FUNCTION_VERSION "30000.27.0_1.0.0" /end FUNCTION
/begin COMPU_METHOD DFC_OneToOne "" RAT_FUNC "%6.2" "-" COEFFS 0 1 0 0 0 1 /end COMPU_METHOD
/begin COMPU_METHOD DINH_ct_Compu "" RAT_FUNC "%6.0" "" COEFFS 0 -1 4096 0 0 1 /end COMPU_METHOD
/end MODULE
/end PROJECT
