ASAP2_VERSION 1 60
/begin PROJECT MG1CS022 "MG1CS022"
/begin HEADER "" VERSION "MG1CS022_62XSC_V037" PROJECT_NO MG1CS022 /end HEADER
/begin MODULE DIM ""
/begin MOD_COMMON "" BYTE_ORDER MSB_LAST ALIGNMENT_BYTE 1 ALIGNMENT_WORD 2 ALIGNMENT_LONG 4 ALIGNMENT_INT64 4 ALIGNMENT_FLOAT32_IEEE 4 ALIGNMENT_FLOAT64_IEEE 4 DATA_SIZE 32 /end MOD_COMMON
/begin CHARACTERISTIC APP_dRawSigFac_C "Factor between sensor raw values" VALUE 0x805085F8 RB_Val_Wu16 7.999878 Fact 0.00 7.999878 FORMAT "%8.6" /end CHARACTERISTIC
/begin CHARACTERISTIC APP_drLimNegLrn_C "Learned max. pedal value decrease per computation step during operation of brake" VALUE 0x805085FA RB_Val_Ws16 39999.39 PrcPerSec -20000.00 19999.39 FORMAT "%8.2" /end CHARACTERISTIC
/begin CHARACTERISTIC APP_drLimpMaxLrn_C "Limit for APP gradient in limphome mode" VALUE 0x805085FC RB_Val_Ws16 39999.39 PrcPerSec -20000.00 19999.39 FORMAT "%8.2" /end CHARACTERISTIC
/begin CHARACTERISTIC APP_drLimPosLrn_C "Max. permissible pedal value increase per computation step after operating brake" VALUE 0x805085FE RB_Val_Ws16 39999.39 PrcPerSec -20000.00 19999.39 FORMAT "%8.2" /end CHARACTERISTIC
/begin CHARACTERISTIC APP_drLinRmp_C "error ramp by the switch between the two sets of linearisation parameters" VALUE 0x80508600 RB_Val_Ws16 39999.39 PrcPerSec -20000.00 19999.39 FORMAT "%8.2" /end CHARACTERISTIC
/begin CHARACTERISTIC APP_duLimErrPos_C "Pos. voltage gradient at switching of signals in case of error on the pedal sensor" VALUE 0x805085E8 RB_Val_Wu32 655.358886719 RmpVolt 0.00 655.358886719 FORMAT "%13.9" EXTENDED_LIMITS 0.00 13107199.9969 /end CHARACTERISTIC
/begin CHARACTERISTIC APP_I_P_ATS_ATS.LimitTypeMsk_C "Actuator test APP_I_P_ATS_ATS / Tester demand monitoring enable mask for actuators" VALUE 0x8058AD00 Val_Wu8 255.0 OneToOne 0.00 255.0 FORMAT "%5.1" /end CHARACTERISTIC
/begin CHARACTERISTIC APP_I_P_ATS_ATS.CnvNorm_C "Actuator test APP_I_P_ATS_ATS / Conversion norm used for conversion to/from internal scaling" VALUE 0x8058AD01 Val_Wu8 255.0 OneToOne 0.00 255.0 FORMAT "%5.1" /end CHARACTERISTIC
/begin CHARACTERISTIC APP_I_P_ATS_ATS.LowLim_C "Actuator test APP_I_P_ATS_ATS / Lower limit for monitoring" VALUE 0x8058AD02 Val_Ws16 799.9878 Prc -400.0000 399.9878 FORMAT "%8.4" /end CHARACTERISTIC
/begin CHARACTERISTIC APP_I_P_ATS_ATS.UpLim_C "Actuator test APP_I_P_ATS_ATS / Upper limit for monitoring" VALUE 0x8058AD04 Val_Ws16 799.9878 Prc -400.0000 399.9878 FORMAT "%8.4" /end CHARACTERISTIC
/begin CHARACTERISTIC APP_I_P_ATS_ATS.CnvFac_C "Actuator test APP_I_P_ATS_ATS / Factor used for conversion to/from internal scaling" VALUE 0x8058AD08 Val_Ws32 4294967295.00 OneToOne -2147483648.00 2147483647.00 FORMAT "%13.2" /end CHARACTERISTIC
/begin CHARACTERISTIC APP_I_P_ATS_ATS.CnvOfs_C "Actuator test APP_I_P_ATS_ATS / Offset used for conversion to/from internal scaling" VALUE 0x8058AD0C Val_Ws16 65535.00 OneToOne -32768.00 32767.00 FORMAT "%8.2" /end CHARACTERISTIC
/begin CHARACTERISTIC APP_I_P_ATS_ATS.DfltVal_C "Actuator test APP_I_P_ATS_ATS / Default value for standbytest" VALUE 0x8058AD0E Val_Ws16 65535.00 OneToOne -32768.00 32767.00 FORMAT "%8.2" /end CHARACTERISTIC
/begin CHARACTERISTIC APP_rAppATSMax_C "Maximum acceleration pedal position allowed from ATS" VALUE 0x80508602 RB_Val_Ws16 799.9878 Prc -400.0000 399.9878 FORMAT "%8.4" /end CHARACTERISTIC
/begin CHARACTERISTIC APP_rAppATSMin_C "Minimum acceleration pedal position allowed from ATS" VALUE 0x80508604 RB_Val_Ws16 799.9878 Prc -400.0000 399.9878 FORMAT "%8.4" /end CHARACTERISTIC
/begin CHARACTERISTIC APP_rAppLimnMax_C "Maximum limitation acceleration pedal position" VALUE 0x80508606 RB_Val_Ws16 799.9878 Prc -400.0000 399.9878 FORMAT "%8.4" /end CHARACTERISTIC
/begin CHARACTERISTIC APP_rAppLimnMin_C "Minimum limitation acceleration pedal position" VALUE 0x80508608 RB_Val_Ws16 799.9878 Prc -400.0000 399.9878 FORMAT "%8.4" /end CHARACTERISTIC
/begin CHARACTERISTIC APP_rAPPMaxLrnFixOffs_C "Calibration parameter(percent) after Fixed Offset calculation(subtraction) from maximum APP ratio, which corresponds to point in APP Linearization curve." VALUE 0x8050860A RB_Val_Ws16 799.9878 Prc -400.0000 399.9878 FORMAT "%8.4" /end CHARACTERISTIC
/begin CHARACTERISTIC APP_rAPPMaxLrnPosOffs_C "Calibration parameter(percent) after Offset calculation(subtraction) from maximum APP ratio." VALUE 0x8050860C RB_Val_Ws16 799.9878 Prc -400.0000 399.9878 FORMAT "%8.4" /end CHARACTERISTIC
/begin CHARACTERISTIC APP_rAPPMaxLrnPos_C "Calibration parameter(percent) for maximum APP ratio" VALUE 0x8050860E RB_Val_Ws16 799.9878 Prc -400.0000 399.9878 FORMAT "%8.4" /end CHARACTERISTIC
/begin CHARACTERISTIC APP_rLimpMaxLrn_C "Limit for APP value in limphome mode" VALUE 0x80508610 RB_Val_Ws16 799.9878 Prc -400.0000 399.9878 FORMAT "%8.4" /end CHARACTERISTIC
/begin CHARACTERISTIC APP_rLinAPPMax_C "Maximum value of acceleration pedal position" VALUE 0x80508612 RB_Val_Ws16 799.9878 Prc -400.0000 399.9878 FORMAT "%8.4" /end CHARACTERISTIC
/begin CHARACTERISTIC APP_rLinAPPMin_C "Minimum value of acceleration pedal position" VALUE 0x80508614 RB_Val_Ws16 799.9878 Prc -400.0000 399.9878 FORMAT "%8.4" /end CHARACTERISTIC
/begin CHARACTERISTIC APP_rPlaMaxValLrn_C "Maximum APP value when plausibility with brake failed" VALUE 0x80508616 RB_Val_Ws16 799.9878 Prc -400.0000 399.9878 FORMAT "%8.4" /end CHARACTERISTIC
/begin CHARACTERISTIC APP_rPrevLETThd_C "Threshold value of acceleration pedal position to abort LET request" VALUE 0x80508618 RB_Val_Ws16 799.9878 Prc -400.0000 399.9878 FORMAT "%8.4" /end CHARACTERISTIC
/begin CHARACTERISTIC APP_swtCfg_CW "codeword in APP" VALUE 0x8050861A RB_Val_Wu16 65535.00 OneToOne 0.00 65535.00 FORMAT "%8.2" /end CHARACTERISTIC
/begin CHARACTERISTIC APP_tiEngOnLETThd_C "Threshold value of engine on time to disable Line End Tester" VALUE 0x8050861C RB_Val_Wu32 4294967295.00 TimeEngOn 0.00 4294967295.00 FORMAT "%13.2" /end CHARACTERISTIC
/begin CHARACTERISTIC APP_tiPhyHigh1DebDef_C "Defect debounce time for DFC_PhyHighAPP1" VALUE 0x80508620 RB_Val_Ws16 655350.0 Time_ms -327680.0 327670.0 FORMAT "%8.1" /end CHARACTERISTIC
/begin CHARACTERISTIC APP_tiPhyHigh1DebOk_C "Healing debounce time for DFC_PhyHighAPP1" VALUE 0x80508622 RB_Val_Ws16 655350.0 Time_ms -327680.0 327670.0 FORMAT "%8.1" /end CHARACTERISTIC
/begin CHARACTERISTIC APP_tiPhyHigh2DebDef_C "Defect debounce time for DFC_PhyHighAPP2" VALUE 0x80508624 RB_Val_Ws16 655350.0 Time_ms -327680.0 327670.0 FORMAT "%8.1" /end CHARACTERISTIC
/begin CHARACTERISTIC APP_tiPhyHigh2DebOk_C "Healing debounce time for DFC_PhyHighAPP2" VALUE 0x80508626 RB_Val_Ws16 655350.0 Time_ms -327680.0 327670.0 FORMAT "%8.1" /end CHARACTERISTIC
/begin CHARACTERISTIC APP_tiPhyLow1DebDef_C "Defect debounce time for DFC_PhyLowAPP1" VALUE 0x80508628 RB_Val_Ws16 655350.0 Time_ms -327680.0 327670.0 FORMAT "%8.1" /end CHARACTERISTIC
/begin CHARACTERISTIC APP_tiPhyLow1DebOk_C "Healing debounce time for DFC_PhyLowAPP1" VALUE 0x8050862A RB_Val_Ws16 655350.0 Time_ms -327680.0 327670.0 FORMAT "%8.1" /end CHARACTERISTIC
/begin CHARACTERISTIC APP_tiPhyLow2DebDef_C "Defect debounce time for DFC_PhyLowAPP2" VALUE 0x8050862C RB_Val_Ws16 655350.0 Time_ms -327680.0 327670.0 FORMAT "%8.1" /end CHARACTERISTIC
/begin CHARACTERISTIC APP_tiPhyLow2DebOk_C "Healing debounce time for DFC_PhyLowAPP2" VALUE 0x8050862E RB_Val_Ws16 655350.0 Time_ms -327680.0 327670.0 FORMAT "%8.1" /end CHARACTERISTIC
/begin CHARACTERISTIC APP_tiPlaAPP12DebDef_C "debounce time fot the defect detection of sync check" VALUE 0x80508630 RB_Val_Ws16 655350.0 Time_ms -327680.0 327670.0 FORMAT "%8.1" /end CHARACTERISTIC
/begin CHARACTERISTIC APP_tiPlaAPP12DebOk_C "debounce time for the healing of sync check" VALUE 0x80508632 RB_Val_Ws16 655350.0 Time_ms -327680.0 327670.0 FORMAT "%8.1" /end CHARACTERISTIC
/begin CHARACTERISTIC APP_tiSRCHigh1DebDef_C "Duration of defect debouncing for check DFC_SRCHighAPP1" VALUE 0x80508634 RB_Val_Ws16 655350.0 Time_ms -327680.0 327670.0 FORMAT "%8.1" /end CHARACTERISTIC
/begin CHARACTERISTIC APP_tiSRCHigh1DebOk_C "Duration of healing debouncing for check DFC_SRCHighAPP1" VALUE 0x80508636 RB_Val_Ws16 655350.0 Time_ms -327680.0 327670.0 FORMAT "%8.1" /end CHARACTERISTIC
/begin CHARACTERISTIC APP_tiSRCHigh2DebDef_C "Duration of defect debouncing for check DFC_SRCHighAPP2" VALUE 0x80508638 RB_Val_Ws16 655350.0 Time_ms -327680.0 327670.0 FORMAT "%8.1" /end CHARACTERISTIC
/begin CHARACTERISTIC APP_tiSRCHigh2DebOk_C "Duration of healing debouncing for check DFC_SRCHighAPP2" VALUE 0x8050863A RB_Val_Ws16 655350.0 Time_ms -327680.0 327670.0 FORMAT "%8.1" /end CHARACTERISTIC
/begin CHARACTERISTIC APP_tiSRCLow1DebDef_C "Duration of defect debouncing for check DFC_SRCLowAPP1" VALUE 0x8050863C RB_Val_Ws16 655350.0 Time_ms -327680.0 327670.0 FORMAT "%8.1" /end CHARACTERISTIC
/begin CHARACTERISTIC APP_tiSRCLow1DebOk_C "Duration of healing debouncing for check DFC_SRCLowAPP1" VALUE 0x8050863E RB_Val_Ws16 655350.0 Time_ms -327680.0 327670.0 FORMAT "%8.1" /end CHARACTERISTIC
/begin CHARACTERISTIC APP_tiSRCLow2DebDef_C "Duration of defect debouncing for check DFC_SRCLowAPP2" VALUE 0x80508640 RB_Val_Ws16 655350.0 Time_ms -327680.0 327670.0 FORMAT "%8.1" /end CHARACTERISTIC
/begin CHARACTERISTIC APP_tiSRCLow2DebOk_C "Duration of healing debouncing for check DFC_SRCLowAPP2" VALUE 0x80508642 RB_Val_Ws16 655350.0 Time_ms -327680.0 327670.0 FORMAT "%8.1" /end CHARACTERISTIC
/begin CHARACTERISTIC APP_uAPPDef_C "Substitute value if both sensors are defect" VALUE 0x805085EC RB_Val_Ws16 13107.00 Volt -6553.600 6553.400 FORMAT "%8.3" /end CHARACTERISTIC
/begin CHARACTERISTIC APP_uJitter_C "Threshold for unjittering" VALUE 0x805085F0 RB_Val_Ws16 13107.00 Volt -6553.600 6553.400 FORMAT "%8.3" /end CHARACTERISTIC
/begin CHARACTERISTIC APP_uPreUnJitter1_C "Threshold for unjittering sensor signal 1" VALUE 0x805085F2 RB_Val_Ws16 13107.00 Volt -6553.600 6553.400 FORMAT "%8.3" /end CHARACTERISTIC
/begin CHARACTERISTIC APP_uPreUnJitter2_C "Threshold for unjittering sensor signal 2" VALUE 0x805085F4 RB_Val_Ws16 13107.00 Volt -6553.600 6553.400 FORMAT "%8.3" /end CHARACTERISTIC
/begin CHARACTERISTIC APP_uRaw1Def_C "Substitute value for sensor 1 defect" VALUE 0x80508644 RB_Val_Ws16 13107.00 Volt -6553.600 6553.400 FORMAT "%8.3" /end CHARACTERISTIC
/begin CHARACTERISTIC APP_uRaw2Def_C "Substitute value for sensor 2 defect" VALUE 0x80508646 RB_Val_Ws16 13107.00 Volt -6553.600 6553.400 FORMAT "%8.3" /end CHARACTERISTIC
/begin CHARACTERISTIC APP_uRaw2Offset_C "Offset for sensor signal 2" VALUE 0x805085EE RB_Val_Ws16 13107.00 Volt -6553.600 6553.400 FORMAT "%8.3" /end CHARACTERISTIC
/begin CHARACTERISTIC APP_uRawFullLdLimp_C "upper normalisation parameter in case of limp modus" VALUE 0x80508648 RB_Val_Ws16 13107.00 Volt -6553.600 6553.400 FORMAT "%8.3" /end CHARACTERISTIC
/begin CHARACTERISTIC APP_uRawFullLd_C "PWG voltage threshold for full-throttle range" VALUE 0x8050864A RB_Val_Ws16 13107.00 Volt -6553.600 6553.400 FORMAT "%8.3" /end CHARACTERISTIC
/begin CHARACTERISTIC APP_uRawIdlLimp_C "PWG voltage threshold for partial throttle range in Limp mode" VALUE 0x8050864C RB_Val_Ws16 13107.00 Volt -6553.600 6553.400 FORMAT "%8.3" /end CHARACTERISTIC
/begin CHARACTERISTIC APP_uRawIdl_C "PWG voltage threshold for partial throttle range" VALUE 0x8050864E RB_Val_Ws16 13107.00 Volt -6553.600 6553.400 FORMAT "%8.3" /end CHARACTERISTIC
/begin CHARACTERISTIC APP_uSnsrMaxOffs_C "Calibration parameter Offset voltage subtracted from APP learned max value." VALUE 0x80508650 RB_Val_Ws16 13107.00 Volt -6553.600 6553.400 FORMAT "%8.3" /end CHARACTERISTIC
/begin CHARACTERISTIC APP_uSply_C "Sensor supply voltage" VALUE 0x80508652 RB_Val_Ws16 13107.00 Volt -6553.600 6553.400 FORMAT "%8.3" /end CHARACTERISTIC
/begin CHARACTERISTIC APP_vVehLETThd_C "Threshold value of vehicle velocity to abort LET request" VALUE 0x80508654 RB_Val_Ws16 655.3500 Vel -327.6800 327.6700 FORMAT "%8.4" /end CHARACTERISTIC
/begin CHARACTERISTIC ASDdc_facNDiff_CUR "antijerk idle speed difference factor for Kd" CURVE 0x80508658 RB_Curve_S16_U8_Static 1.000000 fak_ub_b2 0.00 1.000000 FORMAT "%8.6" EXTENDED_LIMITS 0.00 1.992188
 /begin AXIS_DESCR STD_AXIS ASDdc_nDiff EngN 2 -16384.00 16383.50 FORMAT "%8.2" DEPOSIT ABSOLUTE /end AXIS_DESCR
/end CHARACTERISTIC
/begin CHARACTERISTIC ASDdc_facTEngFeth_MAP "antijerk engine temperature and ethanol factor for Kd" MAP 0x80508660 RB_Map_U16U16_U8 1.000000 fak_ub_b2 0.00 1.000000 FORMAT "%8.6" EXTENDED_LIMITS 0.00 1.992188
 /begin AXIS_DESCR STD_AXIS ASDdc_tEng Temp_Cels 4 -273.140 3003.560 FORMAT "%8.3" EXTENDED_LIMITS -273.1400 6280.360 DEPOSIT ABSOLUTE /end AXIS_DESCR
 /begin AXIS_DESCR STD_AXIS ASDdc_facEth fak_uw_b2 3 0.00 1.999969 FORMAT "%8.6" DEPOSIT ABSOLUTE /end AXIS_DESCR
/end CHARACTERISTIC
/begin CHARACTERISTIC ASDdc_facTrqInit_CUR "antijerk factor for dynamic driving init value" CURVE 0x8050867E RB_Curve_S16_U8_Static 1.000000 fak_ub_b2 0.00 1.000000 FORMAT "%8.6" EXTENDED_LIMITS 0.00 1.992188
 /begin AXIS_DESCR STD_AXIS ASDdc_nGradMin EngNGrd 2 -16384.00 16383.50 FORMAT "%8.2" DEPOSIT ABSOLUTE /end AXIS_DESCR
/end CHARACTERISTIC
/begin CHARACTERISTIC ASDdc_facTrq_C "antijerk factor slope for dynamic driving" VALUE 0x80508686 RB_Val_Wu8 0.5000000 fak_ub_b2 0.00 0.5000000 FORMAT "%9.7" EXTENDED_LIMITS 0.00 1.992188 /end CHARACTERISTIC
/begin CHARACTERISTIC ASDdc_facVVeh_CUR "antijerk vehicle speed factor for Kd" CURVE 0x80508688 RB_Curve_U16_U8_Static 1.000000 fak_ub_b2 0.00 1.000000 FORMAT "%8.6" EXTENDED_LIMITS 0.00 1.992188
 /begin AXIS_DESCR STD_AXIS ASDdc_v Vel 2 0.00 327.6700 FORMAT "%8.4" EXTENDED_LIMITS 0.00 655.3500 DEPOSIT ABSOLUTE /end AXIS_DESCR
/end CHARACTERISTIC
/begin CHARACTERISTIC ASDdc_KdDynNegEco_GMAP "Amplification of dynamic antijerking intervention negative for ECO mode" MAP 0x80508690 RB_MapGroup_U8 7.969 q0p03125_Nm_DIV_rpm 0.00 7.969 FORMAT "%5.3"
 /begin AXIS_DESCR COM_AXIS ASDdc_ratTq TransR 7 -327.6800 327.6700 FORMAT "%8.4" AXIS_PTS_REF ASDdc_rTrq_DST /end AXIS_DESCR
 /begin AXIS_DESCR COM_AXIS ASDdc_nPT EngN 6 -16384.00 16383.50 FORMAT "%8.2" AXIS_PTS_REF ASDdc_nPT_DST /end AXIS_DESCR
/end CHARACTERISTIC
/begin CHARACTERISTIC ASDdc_KdDynNegSprt_GMAP "Sports Mode:Amplification of dynamic antijerking intervention negative" MAP 0x805086BA RB_MapGroup_U8 7.969 q0p03125_Nm_DIV_rpm 0.00 7.969 FORMAT "%5.3"
 /begin AXIS_DESCR COM_AXIS ASDdc_ratTq TransR 7 -327.6800 327.6700 FORMAT "%8.4" AXIS_PTS_REF ASDdc_rTrq_DST /end AXIS_DESCR
 /begin AXIS_DESCR COM_AXIS ASDdc_nPT EngN 6 -16384.00 16383.50 FORMAT "%8.2" AXIS_PTS_REF ASDdc_nPT_DST /end AXIS_DESCR
/end CHARACTERISTIC
/begin CHARACTERISTIC ASDdc_KdDynNeg_GMAP "Amplification of dynamic antijerking intervention negative" MAP 0x805086E4 RB_MapGroup_U8 7.969 q0p03125_Nm_DIV_rpm 0.00 7.969 FORMAT "%5.3"
 /begin AXIS_DESCR COM_AXIS ASDdc_ratTq TransR 7 -327.6800 327.6700 FORMAT "%8.4" AXIS_PTS_REF ASDdc_rTrq_DST /end AXIS_DESCR
 /begin AXIS_DESCR COM_AXIS ASDdc_nPT EngN 6 -16384.00 16383.50 FORMAT "%8.2" AXIS_PTS_REF ASDdc_nPT_DST /end AXIS_DESCR
/end CHARACTERISTIC
/begin CHARACTERISTIC ASDdc_KdDynPosEco_GMAP "Amplification of dynamic antijerking interventions for ECO mode(positive)" MAP 0x8050870E RB_MapGroup_U8 7.969 q0p03125_Nm_DIV_rpm 0.00 7.969 FORMAT "%5.3"
 /begin AXIS_DESCR COM_AXIS ASDdc_ratTq TransR 7 -327.6800 327.6700 FORMAT "%8.4" AXIS_PTS_REF ASDdc_rTrq_DST /end AXIS_DESCR
 /begin AXIS_DESCR COM_AXIS ASDdc_nPT EngN 6 -16384.00 16383.50 FORMAT "%8.2" AXIS_PTS_REF ASDdc_nPT_DST /end AXIS_DESCR
/end CHARACTERISTIC
/begin CHARACTERISTIC ASDdc_KdDynPosSprt_GMAP "Sports Mode:Amplification of dynamic antijerking intervention positive" MAP 0x80508738 RB_MapGroup_U8 7.969 q0p03125_Nm_DIV_rpm 0.00 7.969 FORMAT "%5.3"
 /begin AXIS_DESCR COM_AXIS ASDdc_ratTq TransR 7 -327.6800 327.6700 FORMAT "%8.4" AXIS_PTS_REF ASDdc_rTrq_DST /end AXIS_DESCR
 /begin AXIS_DESCR COM_AXIS ASDdc_nPT EngN 6 -16384.00 16383.50 FORMAT "%8.2" AXIS_PTS_REF ASDdc_nPT_DST /end AXIS_DESCR
/end CHARACTERISTIC
/begin CHARACTERISTIC ASDdc_KdDynPos_GMAP "Amplification of dynamic antijerking intervention positive" MAP 0x80508762 RB_MapGroup_U8 7.969 q0p03125_Nm_DIV_rpm 0.00 7.969 FORMAT "%5.3"
 /begin AXIS_DESCR COM_AXIS ASDdc_ratTq TransR 7 -327.6800 327.6700 FORMAT "%8.4" AXIS_PTS_REF ASDdc_rTrq_DST /end AXIS_DESCR
 /begin AXIS_DESCR COM_AXIS ASDdc_nPT EngN 6 -16384.00 16383.50 FORMAT "%8.2" AXIS_PTS_REF ASDdc_nPT_DST /end AXIS_DESCR
/end CHARACTERISTIC
/begin CHARACTERISTIC ASDdc_nDifGripDetnMax_C "Maximum difference in speed for grip detection" VALUE 0x8050878C RB_Val_Ws16 32767.50 EngN -16384.00 16383.50 FORMAT "%8.2" /end CHARACTERISTIC
/begin CHARACTERISTIC ASDdc_nMax_C "maximum engine speed for release disturbance control" VALUE 0x8050878E RB_Val_Ws16 16383.50 EngN 0.00 16383.50 FORMAT "%8.2" EXTENDED_LIMITS -16384.00 16383.50 /end CHARACTERISTIC
/begin CHARACTERISTIC ASDdc_nMinIdlOff_C "offset to idle speed for release of disturbance control at idle speed" VALUE 0x80508790 RB_Val_Ws16 32767.50 EngN -16384.00 16383.50 FORMAT "%8.2" /end CHARACTERISTIC
/begin CHARACTERISTIC ASDdc_nMinOff_C "offset to idle speed for release of disturbance control" VALUE 0x80508792 RB_Val_Ws16 32767.50 EngN -16384.00 16383.50 FORMAT "%8.2" /end CHARACTERISTIC
/begin AXIS_PTS ASDdc_nPT_DST "group axis points engine speed" 0x80508794 ASDdc_nPT RB_Axis_S16 32767.50 EngN 6 -16384.00 16383.50 FORMAT "%8.2" DEPOSIT ABSOLUTE /end AXIS_PTS
/begin AXIS_PTS ASDdc_rTrq_DST "antijerk gear ratio" 0x805087A2 ASDdc_ratTq RB_Axis_S16 655.3500 TransR 7 -327.6800 327.6700 FORMAT "%8.4" DEPOSIT ABSOLUTE /end AXIS_PTS
/begin CHARACTERISTIC ASDdc_stCfg2_CW "code word ASDdc" VALUE 0x805087B2 RB_Val_Wu8 255.0 dez 0.00 255.0 FORMAT "%5.1" /end CHARACTERISTIC
/begin CHARACTERISTIC ASDdc_stCfg_CW "code word ASDdc" VALUE 0x805087B4 RB_Val_Wu16 65535.00 dez 0.00 65535.00 FORMAT "%8.2" /end CHARACTERISTIC
/begin CHARACTERISTIC ASDdc_swtNDiffSeln_C "selection switch between engine speed difference" VALUE 0x805087B6 RB_Val_Wboolean 1.00000000000 B_TRUE 0.00 1.00000000000 FORMAT "%13.11" /end CHARACTERISTIC
/begin CHARACTERISTIC ASDdc_tiActvAftFCO_C "antijerk delay after deactivation fuel cut off" VALUE 0x805087B7 RB_Val_Wu8 2.550 t_q0p01 0.00 2.550 FORMAT "%5.3" /end CHARACTERISTIC
/begin CHARACTERISTIC ASDdc_tiActvDyn_C "antijerk delay after deactivation dynamic" VALUE 0x805087B8 RB_Val_Wu16 65.53500 t_q0p001 0.00 65.53500 FORMAT "%8.5" /end CHARACTERISTIC
/begin CHARACTERISTIC ASDdc_tiGripDeb_GCUR "time delay after grip condition to enable active surge damper" CURVE 0x805087BA RB_CurveGroup_U8 2.550 t_q0p01 0.00 2.550 FORMAT "%5.3"
 /begin AXIS_DESCR COM_AXIS ASDdc_trqClthAct md_q0p1 8 -3276.800 3276.700 FORMAT "%8.3" AXIS_PTS_REF ASDdc_trqClthAct_DST /end AXIS_DESCR
/end CHARACTERISTIC
/begin CHARACTERISTIC ASDdc_tiPerDur_GCUR "characteristic jerk time" CURVE 0x805087C2 RB_CurveGroup_U8 0.4961 t_q1p95em3 0.0020 0.4980 EXTENDED_LIMITS 0.00 0.4980
 /begin AXIS_DESCR COM_AXIS ASDdc_ratTq TransR 7 -327.6800 327.6700 FORMAT "%8.4" AXIS_PTS_REF ASDdc_rTrq_DST /end AXIS_DESCR
/end CHARACTERISTIC
/begin CHARACTERISTIC ASDdc_tiShftDeb_GCUR "delay time after gear shift to enable active surge damper" CURVE 0x805087C9 RB_CurveGroup_U8 2.550 t_q0p01 0.00 2.550 FORMAT "%5.3"
 /begin AXIS_DESCR COM_AXIS ASDdc_trqClthWoDstC md_q0p1 8 -3276.800 3276.700 FORMAT "%8.3" AXIS_PTS_REF ASDdc_trqClthWoDstC_DST /end AXIS_DESCR
/end CHARACTERISTIC
/begin AXIS_PTS ASDdc_trqClthAct_DST "group axis points antijerk clutch torque" 0x805087D2 ASDdc_trqClthAct RB_Axis_S16 6553.500 md_q0p1 8 -3276.800 3276.700 FORMAT "%8.3" DEPOSIT ABSOLUTE /end AXIS_PTS
/begin AXIS_PTS ASDdc_trqClthWoDstC_DST "group axis points clutch torque without disturbance control" 0x805087E4 ASDdc_trqClthWoDstC RB_Axis_S16 6553.500 md_q0p1 8 -3276.800 3276.700 FORMAT "%8.3" DEPOSIT ABSOLUTE /end AXIS_PTS
/begin CHARACTERISTIC ASDdc_trqThresDynNegEco_GMAP "Eco mode :Threshold for dynamic antijerking intervention negative" MAP 0x805087F6 RB_MapGroup_S16 3276.700 md_q0p1 0.00 3276.700 FORMAT "%8.3" EXTENDED_LIMITS -3276.800 3276.700
 /begin AXIS_DESCR COM_AXIS ASDdc_ratTq TransR 7 -327.6800 327.6700 FORMAT "%8.4" AXIS_PTS_REF ASDdc_rTrq_DST /end AXIS_DESCR
 /begin AXIS_DESCR COM_AXIS ASDdc_trqClthAct md_q0p1 8 -3276.800 3276.700 FORMAT "%8.3" AXIS_PTS_REF ASDdc_trqClthAct_DST /end AXIS_DESCR
/end CHARACTERISTIC
/begin CHARACTERISTIC ASDdc_trqThresDynNegSprt_GMAP "Torque threshold for dynamic antijerking interventions for sport mode (Negative)" MAP 0x80508866 RB_MapGroup_S16 3276.700 md_q0p1 0.00 3276.700 FORMAT "%8.3" EXTENDED_LIMITS -3276.800 3276.700
 /begin AXIS_DESCR COM_AXIS ASDdc_ratTq TransR 7 -327.6800 327.6700 FORMAT "%8.4" AXIS_PTS_REF ASDdc_rTrq_DST /end AXIS_DESCR
 /begin AXIS_DESCR COM_AXIS ASDdc_trqClthAct md_q0p1 8 -3276.800 3276.700 FORMAT "%8.3" AXIS_PTS_REF ASDdc_trqClthAct_DST /end AXIS_DESCR
/end CHARACTERISTIC
/begin CHARACTERISTIC ASDdc_trqThresDynNeg_GMAP "Threshold for dynamic antijerking intervention negative" MAP 0x805088D6 RB_MapGroup_S16 3276.700 md_q0p1 0.00 3276.700 FORMAT "%8.3" EXTENDED_LIMITS -3276.800 3276.700
 /begin AXIS_DESCR COM_AXIS ASDdc_ratTq TransR 7 -327.6800 327.6700 FORMAT "%8.4" AXIS_PTS_REF ASDdc_rTrq_DST /end AXIS_DESCR
 /begin AXIS_DESCR COM_AXIS ASDdc_trqClthAct md_q0p1 8 -3276.800 3276.700 FORMAT "%8.3" AXIS_PTS_REF ASDdc_trqClthAct_DST /end AXIS_DESCR
/end CHARACTERISTIC
/begin CHARACTERISTIC ASDdc_trqThresDynPosEco_GMAP "Torque threshold for dynamic antijerking interventions for Eco mode(Positive)" MAP 0x80508946 RB_MapGroup_S16 3276.700 md_q0p1 0.00 3276.700 FORMAT "%8.3" EXTENDED_LIMITS -3276.800 3276.700
 /begin AXIS_DESCR COM_AXIS ASDdc_ratTq TransR 7 -327.6800 327.6700 FORMAT "%8.4" AXIS_PTS_REF ASDdc_rTrq_DST /end AXIS_DESCR
 /begin AXIS_DESCR COM_AXIS ASDdc_trqClthAct md_q0p1 8 -3276.800 3276.700 FORMAT "%8.3" AXIS_PTS_REF ASDdc_trqClthAct_DST /end AXIS_DESCR
/end CHARACTERISTIC
/begin CHARACTERISTIC ASDdc_trqThresDynPosSprt_GMAP "Torque threshold for dynamic antijerking interventions for sport mode (positive)" MAP 0x805089B6 RB_MapGroup_S16 3276.700 md_q0p1 0.00 3276.700 FORMAT "%8.3" EXTENDED_LIMITS -3276.800 3276.700
 /begin AXIS_DESCR COM_AXIS ASDdc_ratTq TransR 7 -327.6800 327.6700 FORMAT "%8.4" AXIS_PTS_REF ASDdc_rTrq_DST /end AXIS_DESCR
 /begin AXIS_DESCR COM_AXIS ASDdc_trqClthAct md_q0p1 8 -3276.800 3276.700 FORMAT "%8.3" AXIS_PTS_REF ASDdc_trqClthAct_DST /end AXIS_DESCR
/end CHARACTERISTIC
/begin CHARACTERISTIC ASDdc_trqThresDynPos_GMAP "Threshold for dynamic antijerking intervention positive" MAP 0x80508A26 RB_MapGroup_S16 3276.700 md_q0p1 0.00 3276.700 FORMAT "%8.3" EXTENDED_LIMITS -3276.800 3276.700
 /begin AXIS_DESCR COM_AXIS ASDdc_ratTq TransR 7 -327.6800 327.6700 FORMAT "%8.4" AXIS_PTS_REF ASDdc_rTrq_DST /end AXIS_DESCR
 /begin AXIS_DESCR COM_AXIS ASDdc_trqClthAct md_q0p1 8 -3276.800 3276.700 FORMAT "%8.3" AXIS_PTS_REF ASDdc_trqClthAct_DST /end AXIS_DESCR
/end CHARACTERISTIC
/begin CHARACTERISTIC ASDrf_bPhyTqLyrHybCmpbl_C "Physical torque layer hybrid compatible calibration switch" VALUE 0x8050AEE8 RB_Val_Wboolean 1.00000000000 B_TRUE 0.00 1.00000000000 FORMAT "%13.11" /end CHARACTERISTIC
/begin CHARACTERISTIC ASDrf_CfgNew_C "configuration codeword new ASD method" VALUE 0x8050AEEA RB_Val_Wu16 65535.00 OneToOne 0.00 65535.00 FORMAT "%8.2" /end CHARACTERISTIC
/begin CHARACTERISTIC ASDrf_cntrSigMaxReset_C "counter for reset of detection engine speed maximum" VALUE 0x8050AEEC RB_Val_Ws8 255.0 OneToOne -128.0 127.0 FORMAT "%5.1" /end CHARACTERISTIC
/begin CHARACTERISTIC ASDrf_cntrSigMaxSet_C "counter for set of detection engine speed maximum" VALUE 0x8050AEED RB_Val_Ws8 255.0 OneToOne -128.0 127.0 FORMAT "%5.1" /end CHARACTERISTIC
/begin CHARACTERISTIC ASDrf_dndeltaMaxIni_C "initial value maximum change filtered engine speed gradient" VALUE 0x8050AEEE RB_Val_Ws16 8192.000 EngNGrd 0.00 8192.000 FORMAT "%8.3" EXTENDED_LIMITS -16384.00 16383.50 /end CHARACTERISTIC
/begin CHARACTERISTIC ASDrf_dnEngMaxReset_C "engine speed gradient for reset of detection engine speed maximum" VALUE 0x8050AEF0 RB_Val_Ws16 32767.50 EngNGrd -16384.00 16383.50 FORMAT "%8.2" /end CHARACTERISTIC
/begin CHARACTERISTIC ASDrf_dnEngMaxSet_C "engine speed gradient for set of detection engine speed maximum" VALUE 0x8050AEF2 RB_Val_Ws16 32767.50 EngNGrd -16384.00 16383.50 FORMAT "%8.2" /end CHARACTERISTIC
/begin CHARACTERISTIC ASDrf_dtqEcoRampMtModPosAcOn_T "increase of limitation ramp in positive case for Eco manual transmission mode when AC is ON" CURVE 0x80508A9A RB_Curve_S16_S16 327660.0 mdgrad_q10 10.0 327670.0 FORMAT "%8.1" EXTENDED_LIMITS -327680.0 327670.0
 /begin AXIS_DESCR STD_AXIS RngMod_trqClthBs md_q0p1 10 -3276.800 3276.700 FORMAT "%8.3" DEPOSIT ABSOLUTE /end AXIS_DESCR
/end CHARACTERISTIC
/begin CHARACTERISTIC ASDrf_dtqEcoRampMtModPos_T "increase of limitation ramp in positive case for ECO manual transmission mode" CURVE 0x80508AC4 RB_Curve_S16_S16 327660.0 mdgrad_q10 10.0 327670.0 FORMAT "%8.1" EXTENDED_LIMITS -327680.0 327670.0
 /begin AXIS_DESCR STD_AXIS RngMod_trqClthBs md_q0p1 10 -3276.800 3276.700 FORMAT "%8.3" DEPOSIT ABSOLUTE /end AXIS_DESCR
/end CHARACTERISTIC
/begin CHARACTERISTIC ASDrf_dtqEcoRampPosAcOn_T "increase of limitation ramp in positive case for Eco mode during AC On" CURVE 0x80508AEE RB_Curve_S16_S16 327660.0 mdgrad_q10 10.0 327670.0 FORMAT "%8.1" EXTENDED_LIMITS -327680.0 327670.0
 /begin AXIS_DESCR STD_AXIS RngMod_trqClthBs md_q0p1 10 -3276.800 3276.700 FORMAT "%8.3" DEPOSIT ABSOLUTE /end AXIS_DESCR
/end CHARACTERISTIC
/begin CHARACTERISTIC ASDrf_dtqEcoRampPos_T "increase of limitation ramp in positive case for Eco mode" CURVE 0x80508B18 RB_Curve_S16_S16 327660.0 mdgrad_q10 10.0 327670.0 FORMAT "%8.1" EXTENDED_LIMITS -327680.0 327670.0
 /begin AXIS_DESCR STD_AXIS RngMod_trqClthBs md_q0p1 10 -3276.800 3276.700 FORMAT "%8.3" DEPOSIT ABSOLUTE /end AXIS_DESCR
/end CHARACTERISTIC
/begin CHARACTERISTIC ASDrf_dtqNegMax_C "maximum gradient of torque limitation negative load change" VALUE 0x8050AEF4 RB_Val_Ws16 6553.500 mdt_q0p1_Nm_DIV_s -3276.800 3276.700 FORMAT "%8.3" /end CHARACTERISTIC
/begin CHARACTERISTIC ASDrf_dtqNegMin_C "minimum gradient of torque limitation negative load change" VALUE 0x8050AEF6 RB_Val_Ws16 6553.500 mdt_q0p1_Nm_DIV_s -3276.800 3276.700 FORMAT "%8.3" /end CHARACTERISTIC
/begin CHARACTERISTIC ASDrf_dtqPosMax_M "gradient for torque limitation positive load change" MAP 0x8050AEF8 RB_Map_S16S16_S16 6553.500 mdt_q0p1_Nm_DIV_s -3276.800 3276.700 FORMAT "%8.3"
 /begin AXIS_DESCR STD_AXIS ASDrf_facDesDyn Fact 5 -4.000000 3.999878 FORMAT "%8.6" DEPOSIT ABSOLUTE /end AXIS_DESCR
 /begin AXIS_DESCR STD_AXIS Epm_nEng EngN 6 -16384.00 16383.50 FORMAT "%8.2" DEPOSIT ABSOLUTE /end AXIS_DESCR
/end CHARACTERISTIC
/begin CHARACTERISTIC ASDrf_dtqRampMtModPosAcOn_T "increase of limitation ramp in positive case for manual transmission mode when AC is ON" CURVE 0x80508B42 RB_Curve_S16_S16 327660.0 mdgrad_q10 10.0 327670.0 FORMAT "%8.1" EXTENDED_LIMITS -327680.0 327670.0
 /begin AXIS_DESCR STD_AXIS RngMod_trqClthBs md_q0p1 10 -3276.800 3276.700 FORMAT "%8.3" DEPOSIT ABSOLUTE /end AXIS_DESCR
/end CHARACTERISTIC
/begin CHARACTERISTIC ASDrf_dtqRampMtModPosFFVAcOn_T "increase of limitation ramp in positive case for manual transmission mode for flex fuel when AC is ON" CURVE 0x80508B6C RB_Curve_S16_S16 327660.0 mdgrad_q10 10.0 327670.0 FORMAT "%8.1" EXTENDED_LIMITS -327680.0 327670.0
 /begin AXIS_DESCR STD_AXIS RngMod_trqClthBs md_q0p1 10 -3276.800 3276.700 FORMAT "%8.3" DEPOSIT ABSOLUTE /end AXIS_DESCR
/end CHARACTERISTIC
/begin CHARACTERISTIC ASDrf_dtqRampMtModPosFFV_T "increase of limitation ramp in positive case for manual transmission mode for FFV" CURVE 0x80508B96 RB_Curve_S16_S16 327660.0 mdgrad_q10 10.0 327670.0 FORMAT "%8.1" EXTENDED_LIMITS -327680.0 327670.0
 /begin AXIS_DESCR STD_AXIS RngMod_trqClthBs md_q0p1 10 -3276.800 3276.700 FORMAT "%8.3" DEPOSIT ABSOLUTE /end AXIS_DESCR
/end CHARACTERISTIC
/begin CHARACTERISTIC ASDrf_dtqRampMtModPos_T "increase of limitation ramp in positive case for manual transmission mode" CURVE 0x80508BC0 RB_Curve_S16_S16 327660.0 mdgrad_q10 10.0 327670.0 FORMAT "%8.1" EXTENDED_LIMITS -327680.0 327670.0
 /begin AXIS_DESCR STD_AXIS RngMod_trqClthBs md_q0p1 10 -3276.800 3276.700 FORMAT "%8.3" DEPOSIT ABSOLUTE /end AXIS_DESCR
/end CHARACTERISTIC
/begin CHARACTERISTIC ASDrf_dtqRampPosFFVAcOn_T "increase of limitation ramp in positive case for FFV during AC On" CURVE 0x80508BEA RB_Curve_S16_S16 327660.0 mdgrad_q10 10.0 327670.0 FORMAT "%8.1" EXTENDED_LIMITS -327680.0 327670.0
 /begin AXIS_DESCR STD_AXIS RngMod_trqClthBs md_q0p1 10 -3276.800 3276.700 FORMAT "%8.3" DEPOSIT ABSOLUTE /end AXIS_DESCR
/end CHARACTERISTIC
/begin CHARACTERISTIC ASDrf_dtqRampPosFFV_T "increase of limitation ramp in positive case for FFV" CURVE 0x80508C14 RB_Curve_S16_S16 327660.0 mdgrad_q10 10.0 327670.0 FORMAT "%8.1" EXTENDED_LIMITS -327680.0 327670.0
 /begin AXIS_DESCR STD_AXIS RngMod_trqClthBs md_q0p1 10 -3276.800 3276.700 FORMAT "%8.3" DEPOSIT ABSOLUTE /end AXIS_DESCR
/end CHARACTERISTIC
/begin CHARACTERISTIC ASDrf_dtqSprtAirCdnrOnRampPos_T "increase of limitation ramp in positive case for sport mode ac on" CURVE 0x80508C3E RB_Curve_S16_S16 327660.0 mdgrad_q10 10.0 327670.0 FORMAT "%8.1" EXTENDED_LIMITS -327680.0 327670.0
 /begin AXIS_DESCR STD_AXIS RngMod_trqClthBs md_q0p1 10 -3276.800 3276.700 FORMAT "%8.3" DEPOSIT ABSOLUTE /end AXIS_DESCR
/end CHARACTERISTIC
/begin CHARACTERISTIC ASDrf_dtqSprtRampMtModPos_T "increase of limitation ramp in positive case for sport manual transmission mode" CURVE 0x80508C68 RB_Curve_S16_S16 327660.0 mdgrad_q10 10.0 327670.0 FORMAT "%8.1" EXTENDED_LIMITS -327680.0 327670.0
 /begin AXIS_DESCR STD_AXIS RngMod_trqClthBs md_q0p1 10 -3276.800 3276.700 FORMAT "%8.3" DEPOSIT ABSOLUTE /end AXIS_DESCR
/end CHARACTERISTIC
/begin CHARACTERISTIC ASDrf_dtqSprtRampPos_T "increase of limitation ramp in positive case for sport mode" CURVE 0x80508C92 RB_Curve_S16_S16 327660.0 mdgrad_q10 10.0 327670.0 FORMAT "%8.1" EXTENDED_LIMITS -327680.0 327670.0
 /begin AXIS_DESCR STD_AXIS RngMod_trqClthBs md_q0p1 10 -3276.800 3276.700 FORMAT "%8.3" DEPOSIT ABSOLUTE /end AXIS_DESCR
/end CHARACTERISTIC
/begin CHARACTERISTIC ASDrf_dtqSptRampMtModPosAcOn_T "increase of limitation ramp in positive case for Sport manual transmission mode when AC is ON" CURVE 0x80508CBC RB_Curve_S16_S16 327660.0 mdgrad_q10 10.0 327670.0 FORMAT "%8.1" EXTENDED_LIMITS -327680.0 327670.0
 /begin AXIS_DESCR STD_AXIS RngMod_trqClthBs md_q0p1 10 -3276.800 3276.700 FORMAT "%8.3" DEPOSIT ABSOLUTE /end AXIS_DESCR
/end CHARACTERISTIC
/begin CHARACTERISTIC ASDrf_dtrqRmpPosAcOn_CUR "increase of limitation ramp in positive case during AC On" CURVE 0x80508CE6 RB_Curve_S16_S16 327660.0 mdgrad_q10 10.0 327670.0 FORMAT "%8.1" EXTENDED_LIMITS -327680.0 327670.0
 /begin AXIS_DESCR STD_AXIS RngMod_trqClthBs md_q0p1 10 -3276.800 3276.700 FORMAT "%8.3" DEPOSIT ABSOLUTE /end AXIS_DESCR
/end CHARACTERISTIC
/begin CHARACTERISTIC ASDrf_dtrqRmpPos_CUR "increase of limitation ramp in positive case" CURVE 0x80508D10 RB_Curve_S16_S16 327660.0 mdgrad_q10 10.0 327670.0 FORMAT "%8.1" EXTENDED_LIMITS -327680.0 327670.0
 /begin AXIS_DESCR STD_AXIS RngMod_trqClthBs md_q0p1 10 -3276.800 3276.700 FORMAT "%8.3" DEPOSIT ABSOLUTE /end AXIS_DESCR
/end CHARACTERISTIC
/begin CHARACTERISTIC ASDrf_facAirFric_C "factor air friction torque" VALUE 0x8050AF4E RB_Val_Ws16 0.3276700 m_q0p00001 0.00 0.3276700 FORMAT "%9.7" EXTENDED_LIMITS -0.3276800 0.3276700 /end CHARACTERISTIC
/begin AXIS_PTS ASDrf_facDesDyn_DST "driveability factor" 0x8050C596 ASDrf_facDesDyn RB_Axis_S16 7.999878 Fact 10 -4.000000 3.999878 FORMAT "%8.6" DEPOSIT ABSOLUTE /end AXIS_PTS
/begin CHARACTERISTIC ASDrf_facdtqPosMax_T "gear dependent correction of gradient for torque limitation positive load change" CURVE 0x8050AF50 RB_Curve_S8_U8_Static 3.984 fak_ub_b4 0.00 3.984 FORMAT "%5.3"
 /begin AXIS_DESCR STD_AXIS Tra_numGear OneToOne 10 -128.0 127.0 FORMAT "%5.1" DEPOSIT ABSOLUTE /end AXIS_DESCR
/end CHARACTERISTIC
/begin CHARACTERISTIC ASDrf_facEcoRampMtModPosAcOn_GM "weight of positive ramp in Eco manual transmission mode when AC is ON" MAP 0x80508D3A RB_MapGroup_U8 1.000000 fak_ub_b2 0.00 1.000000 FORMAT "%8.6" EXTENDED_LIMITS 0.00 1.992188
 /begin AXIS_DESCR COM_AXIS ASDrf_facDesDyn Fact 10 -4.000000 3.999878 FORMAT "%8.6" AXIS_PTS_REF ASDrf_facDesDyn_DST /end AXIS_DESCR
 /begin AXIS_DESCR COM_AXIS Epm_nEng EngN 8 -16384.00 16383.50 FORMAT "%8.2" AXIS_PTS_REF ASDrf_nEng_DST /end AXIS_DESCR
/end CHARACTERISTIC
/begin CHARACTERISTIC ASDrf_facEcoRampMtModPosAcOn_GT "weight of positive ramp in Eco manual transmission mode when AC is ON" CURVE 0x80508D8A RB_CurveGroup_U8 1.000000 fak_ub_b2 0.00 1.000000 FORMAT "%8.6" EXTENDED_LIMITS 0.00 1.992188
 /begin AXIS_DESCR COM_AXIS PT_rTrq TransR 8 -327.6800 327.6700 FORMAT "%8.4" AXIS_PTS_REF ASDrf_rTrq_DST /end AXIS_DESCR
/end CHARACTERISTIC
/begin CHARACTERISTIC ASDrf_facEcoRampMtModPos_GM "weight of positive ramp in eco manual transmission mode" MAP 0x80508D92 RB_MapGroup_U8 1.000000 fak_ub_b2 0.00 1.000000 FORMAT "%8.6" EXTENDED_LIMITS 0.00 1.992188
 /begin AXIS_DESCR COM_AXIS ASDrf_facDesDyn Fact 10 -4.000000 3.999878 FORMAT "%8.6" AXIS_PTS_REF ASDrf_facDesDyn_DST /end AXIS_DESCR
 /begin AXIS_DESCR COM_AXIS Epm_nEng EngN 8 -16384.00 16383.50 FORMAT "%8.2" AXIS_PTS_REF ASDrf_nEng_DST /end AXIS_DESCR
/end CHARACTERISTIC
/begin CHARACTERISTIC ASDrf_facEcoRampMtModPos_GT "weight of positive ramp in Eco manual transmission mode" CURVE 0x80508DE2 RB_CurveGroup_U8 1.000000 fak_ub_b2 0.00 1.000000 FORMAT "%8.6" EXTENDED_LIMITS 0.00 1.992188
 /begin AXIS_DESCR COM_AXIS PT_rTrq TransR 8 -327.6800 327.6700 FORMAT "%8.4" AXIS_PTS_REF ASDrf_rTrq_DST /end AXIS_DESCR
/end CHARACTERISTIC
/begin CHARACTERISTIC ASDrf_facEcoRampPosAcOn_GM "weight of positive ramp in Eco mode during AC On" MAP 0x80508DEA RB_MapGroup_U8 1.000000 fak_ub_b2 0.00 1.000000 FORMAT "%8.6" EXTENDED_LIMITS 0.00 1.992188
 /begin AXIS_DESCR COM_AXIS ASDrf_facDesDyn Fact 10 -4.000000 3.999878 FORMAT "%8.6" AXIS_PTS_REF ASDrf_facDesDyn_DST /end AXIS_DESCR
 /begin AXIS_DESCR COM_AXIS Epm_nEng EngN 8 -16384.00 16383.50 FORMAT "%8.2" AXIS_PTS_REF ASDrf_nEng_DST /end AXIS_DESCR
/end CHARACTERISTIC
/begin CHARACTERISTIC ASDrf_facEcoRampPosAcOn_GT "weight of positive ramp in Eco mode during AC On" CURVE 0x80508E3A RB_CurveGroup_U8 1.000000 fak_ub_b2 0.00 1.000000 FORMAT "%8.6" EXTENDED_LIMITS 0.00 1.992188
 /begin AXIS_DESCR COM_AXIS PT_rTrq TransR 8 -327.6800 327.6700 FORMAT "%8.4" AXIS_PTS_REF ASDrf_rTrq_DST /end AXIS_DESCR
/end CHARACTERISTIC
/begin CHARACTERISTIC ASDrf_facEcoRampPos_GM "weight of positive ramp in Eco mode" MAP 0x80508E42 RB_MapGroup_U8 1.000000 fak_ub_b2 0.00 1.000000 FORMAT "%8.6" EXTENDED_LIMITS 0.00 1.992188
 /begin AXIS_DESCR COM_AXIS ASDrf_facDesDyn Fact 10 -4.000000 3.999878 FORMAT "%8.6" AXIS_PTS_REF ASDrf_facDesDyn_DST /end AXIS_DESCR
 /begin AXIS_DESCR COM_AXIS Epm_nEng EngN 8 -16384.00 16383.50 FORMAT "%8.2" AXIS_PTS_REF ASDrf_nEng_DST /end AXIS_DESCR
/end CHARACTERISTIC
/begin CHARACTERISTIC ASDrf_facEcoRampPos_GT "weight of positive ramp in Eco mode" CURVE 0x80508E92 RB_CurveGroup_U8 1.000000 fak_ub_b2 0.00 1.000000 FORMAT "%8.6" EXTENDED_LIMITS 0.00 1.992188
 /begin AXIS_DESCR COM_AXIS PT_rTrq TransR 8 -327.6800 327.6700 FORMAT "%8.4" AXIS_PTS_REF ASDrf_rTrq_DST /end AXIS_DESCR
/end CHARACTERISTIC
/begin CHARACTERISTIC ASDrf_facEcoTiAirCdnrOnNegLead_GT "weighting factor time constant lead path for AC on in Eco mode" CURVE 0x80508E9A RB_CurveGroup_U8 7.969 fak_ub_b8 0.00 7.969 FORMAT "%5.3"
 /begin AXIS_DESCR COM_AXIS PT_rTrq TransR 8 -327.6800 327.6700 FORMAT "%8.4" AXIS_PTS_REF ASDrf_rTrq_DST /end AXIS_DESCR
/end CHARACTERISTIC
/begin CHARACTERISTIC ASDrf_facEcoTqIniAirCdnrOnNeg_GM "weighting factor for init-jump lead dashpot for AC on in Eco mode" MAP 0x80508EA2 RB_MapGroup_U8 1.000000 fak_ub_b2 0.00 1.000000 FORMAT "%8.6" EXTENDED_LIMITS 0.00 1.992188
 /begin AXIS_DESCR COM_AXIS ASDrf_tqCluBasc Trq 5 -3276.800 3276.700 FORMAT "%8.3" AXIS_PTS_REF ASDrf_trqClthBs_DST /end AXIS_DESCR
 /begin AXIS_DESCR COM_AXIS Epm_nEng EngN 8 -16384.00 16383.50 FORMAT "%8.2" AXIS_PTS_REF ASDrf_nEng_DST /end AXIS_DESCR
/end CHARACTERISTIC
/begin CHARACTERISTIC ASDrf_facEcoTqIniAirCdnrOnNeg_GT "weighting factor for init-jump lead dashpot for AC on" CURVE 0x80508ECA RB_CurveGroup_U8 7.969 fak_ub_b8 0.00 7.969 FORMAT "%5.3"
 /begin AXIS_DESCR COM_AXIS PT_rTrq TransR 8 -327.6800 327.6700 FORMAT "%8.4" AXIS_PTS_REF ASDrf_rTrq_DST /end AXIS_DESCR
/end CHARACTERISTIC
/begin CHARACTERISTIC ASDrf_facEcoTqIniMtModNegAcOn_GM "weighting factor for init-jump lead dashpot in Eco manual transmission mode when AC is ON" MAP 0x80508ED2 RB_MapGroup_U8 1.000000 fak_ub_b2 0.00 1.000000 FORMAT "%8.6" EXTENDED_LIMITS 0.00 1.992188
 /begin AXIS_DESCR COM_AXIS ASDrf_tqCluBasc Trq 5 -3276.800 3276.700 FORMAT "%8.3" AXIS_PTS_REF ASDrf_trqClthBs_DST /end AXIS_DESCR
 /begin AXIS_DESCR COM_AXIS Epm_nEng EngN 8 -16384.00 16383.50 FORMAT "%8.2" AXIS_PTS_REF ASDrf_nEng_DST /end AXIS_DESCR
/end CHARACTERISTIC
/begin CHARACTERISTIC ASDrf_facEcoTqIniMtModNegAcOn_GT "weighting factor for init-jump lead dashpot in Eco manual transmission mode when AC is ON" CURVE 0x80508EFA RB_CurveGroup_U8 7.969 fak_ub_b8 0.00 7.969 FORMAT "%5.3"
 /begin AXIS_DESCR COM_AXIS PT_rTrq TransR 8 -327.6800 327.6700 FORMAT "%8.4" AXIS_PTS_REF ASDrf_rTrq_DST /end AXIS_DESCR
/end CHARACTERISTIC
/begin CHARACTERISTIC ASDrf_facEcoTqIniMtModNeg_GM "weighting factor for init-jump lead dashpot in Eco manual transmission mode" MAP 0x80508F02 RB_MapGroup_U8 1.000000 fak_ub_b2 0.00 1.000000 FORMAT "%8.6" EXTENDED_LIMITS 0.00 1.992188
 /begin AXIS_DESCR COM_AXIS ASDrf_tqCluBasc Trq 5 -3276.800 3276.700 FORMAT "%8.3" AXIS_PTS_REF ASDrf_trqClthBs_DST /end AXIS_DESCR
 /begin AXIS_DESCR COM_AXIS Epm_nEng EngN 8 -16384.00 16383.50 FORMAT "%8.2" AXIS_PTS_REF ASDrf_nEng_DST /end AXIS_DESCR
/end CHARACTERISTIC
/begin CHARACTERISTIC ASDrf_facEcoTqIniMtModNeg_GT "weighting factor for init-jump lead dashpot in Eco manual transmission mode" CURVE 0x80508F2A RB_CurveGroup_U8 7.969 fak_ub_b8 0.00 7.969 FORMAT "%5.3"
 /begin AXIS_DESCR COM_AXIS PT_rTrq TransR 8 -327.6800 327.6700 FORMAT "%8.4" AXIS_PTS_REF ASDrf_rTrq_DST /end AXIS_DESCR
/end CHARACTERISTIC
/begin CHARACTERISTIC ASDrf_facEcoTqIniNeg_GM "weighting factor for init-jump lead dashpot in Eco mode" MAP 0x80508F32 RB_MapGroup_U8 1.000000 fak_ub_b2 0.00 1.000000 FORMAT "%8.6" EXTENDED_LIMITS 0.00 1.992188
 /begin AXIS_DESCR COM_AXIS ASDrf_tqCluBasc Trq 5 -3276.800 3276.700 FORMAT "%8.3" AXIS_PTS_REF ASDrf_trqClthBs_DST /end AXIS_DESCR
 /begin AXIS_DESCR COM_AXIS Epm_nEng EngN 8 -16384.00 16383.50 FORMAT "%8.2" AXIS_PTS_REF ASDrf_nEng_DST /end AXIS_DESCR
/end CHARACTERISTIC
/begin CHARACTERISTIC ASDrf_facEcoTqIniTEngAirCdnrOnNeg_GT "engine temperature dependent weighting factor for init-jump lead dashpot for AC on in Eco mode" CURVE 0x80508F5A RB_CurveGroup_U8 1.992188 fak_ub_b2 0.00 1.992188 FORMAT "%8.6"
 /begin AXIS_DESCR COM_AXIS EngDa_tEng Temp_Cels 6 -3549.940 3003.560 FORMAT "%8.3" AXIS_PTS_REF ASDrf_tEng_DST /end AXIS_DESCR
/end CHARACTERISTIC
/begin CHARACTERISTIC ASDrf_facEcoTqIniTEngNeg_GT "engine temperature dependent weighting factor for init-jump lead dashpot in Eco mode" CURVE 0x80508F60 RB_CurveGroup_U8 1.992188 fak_ub_b2 0.00 1.992188 FORMAT "%8.6"
 /begin AXIS_DESCR COM_AXIS EngDa_tEng Temp_Cels 6 -3549.940 3003.560 FORMAT "%8.3" AXIS_PTS_REF ASDrf_tEng_DST /end AXIS_DESCR
/end CHARACTERISTIC
/begin CHARACTERISTIC ASDrf_facEcoTrqIniNeg_GCUR "weighting factor for init-jump lead dashpot in Eco mode" CURVE 0x80508F66 RB_CurveGroup_U8 7.969 fak_ub_b8 0.00 7.969 FORMAT "%5.3"
 /begin AXIS_DESCR COM_AXIS PT_rTrq TransR 8 -327.6800 327.6700 FORMAT "%8.4" AXIS_PTS_REF ASDrf_rTrq_DST /end AXIS_DESCR
/end CHARACTERISTIC
/begin CHARACTERISTIC ASDrf_facLimAbv_GM "Map: factor for upper limitation edge" MAP 0x8050AF66 RB_MapGroup_U8 1.992188 fak_ub_b2 0.00 1.992188 FORMAT "%8.6"
 /begin AXIS_DESCR COM_AXIS ASDrf_facDesDyn Fact 10 -4.000000 3.999878 FORMAT "%8.6" AXIS_PTS_REF ASDrf_facDesDyn_DST /end AXIS_DESCR
 /begin AXIS_DESCR COM_AXIS ASDrf_nPt EngN 8 -16384.00 16383.50 FORMAT "%8.2" AXIS_PTS_REF ASDrf_nPt_DST /end AXIS_DESCR
/end CHARACTERISTIC
/begin CHARACTERISTIC ASDrf_facLimBlw_GM "Map: factor for lower limitation edge" MAP 0x8050AFB6 RB_MapGroup_U8 1.992188 fak_ub_b2 0.00 1.992188 FORMAT "%8.6"
 /begin AXIS_DESCR COM_AXIS ASDrf_facDesDyn Fact 10 -4.000000 3.999878 FORMAT "%8.6" AXIS_PTS_REF ASDrf_facDesDyn_DST /end AXIS_DESCR
 /begin AXIS_DESCR COM_AXIS ASDrf_nPt EngN 8 -16384.00 16383.50 FORMAT "%8.2" AXIS_PTS_REF ASDrf_nPt_DST /end AXIS_DESCR
/end CHARACTERISTIC
/begin CHARACTERISTIC ASDrf_facRampMtModPosAcOn_GM "weight of positive ramp in manual transmission mode when AC is ON" MAP 0x80508F6E RB_MapGroup_U8 1.000000 fak_ub_b2 0.00 1.000000 FORMAT "%8.6" EXTENDED_LIMITS 0.00 1.992188
 /begin AXIS_DESCR COM_AXIS ASDrf_facDesDyn Fact 10 -4.000000 3.999878 FORMAT "%8.6" AXIS_PTS_REF ASDrf_facDesDyn_DST /end AXIS_DESCR
 /begin AXIS_DESCR COM_AXIS Epm_nEng EngN 8 -16384.00 16383.50 FORMAT "%8.2" AXIS_PTS_REF ASDrf_nEng_DST /end AXIS_DESCR
/end CHARACTERISTIC
/begin CHARACTERISTIC ASDrf_facRampMtModPosAcOn_GT "weight of positive ramp in manual transmission mode when AC is ON" CURVE 0x80508FBE RB_CurveGroup_U8 1.000000 fak_ub_b2 0.00 1.000000 FORMAT "%8.6" EXTENDED_LIMITS 0.00 1.992188
 /begin AXIS_DESCR COM_AXIS PT_rTrq TransR 8 -327.6800 327.6700 FORMAT "%8.4" AXIS_PTS_REF ASDrf_rTrq_DST /end AXIS_DESCR
/end CHARACTERISTIC
/begin CHARACTERISTIC ASDrf_facRampMtModPosFFVAcOn_GM "weight of positive ramp in manual transmission mode for flex fuel when AC is ON" MAP 0x80508FC6 RB_MapGroup_U8 1.000000 fak_ub_b2 0.00 1.000000 FORMAT "%8.6" EXTENDED_LIMITS 0.00 1.992188
 /begin AXIS_DESCR COM_AXIS ASDrf_facDesDyn Fact 10 -4.000000 3.999878 FORMAT "%8.6" AXIS_PTS_REF ASDrf_facDesDyn_DST /end AXIS_DESCR
 /begin AXIS_DESCR COM_AXIS Epm_nEng EngN 8 -16384.00 16383.50 FORMAT "%8.2" AXIS_PTS_REF ASDrf_nEng_DST /end AXIS_DESCR
/end CHARACTERISTIC
/begin CHARACTERISTIC ASDrf_facRampMtModPosFFVAcOn_GT "weight of positive ramp in manual transmission mode for flex fuel when AC is ON" CURVE 0x80509016 RB_CurveGroup_U8 1.000000 fak_ub_b2 0.00 1.000000 FORMAT "%8.6" EXTENDED_LIMITS 0.00 1.992188
 /begin AXIS_DESCR COM_AXIS PT_rTrq TransR 8 -327.6800 327.6700 FORMAT "%8.4" AXIS_PTS_REF ASDrf_rTrq_DST /end AXIS_DESCR
/end CHARACTERISTIC
/begin CHARACTERISTIC ASDrf_facRampMtModPosFFV_GM "weight of positive ramp in manual transmission mode for FFV" MAP 0x8050901E RB_MapGroup_U8 1.000000 fak_ub_b2 0.00 1.000000 FORMAT "%8.6" EXTENDED_LIMITS 0.00 1.992188
 /begin AXIS_DESCR COM_AXIS ASDrf_facDesDyn Fact 10 -4.000000 3.999878 FORMAT "%8.6" AXIS_PTS_REF ASDrf_facDesDyn_DST /end AXIS_DESCR
 /begin AXIS_DESCR COM_AXIS Epm_nEng EngN 8 -16384.00 16383.50 FORMAT "%8.2" AXIS_PTS_REF ASDrf_nEng_DST /end AXIS_DESCR
/end CHARACTERISTIC
/begin CHARACTERISTIC ASDrf_facRampMtModPosFFV_GT "weight of positive ramp in manual transmission mode for FFV" CURVE 0x8050906E RB_CurveGroup_U8 1.000000 fak_ub_b2 0.00 1.000000 FORMAT "%8.6" EXTENDED_LIMITS 0.00 1.992188
 /begin AXIS_DESCR COM_AXIS PT_rTrq TransR 8 -327.6800 327.6700 FORMAT "%8.4" AXIS_PTS_REF ASDrf_rTrq_DST /end AXIS_DESCR
/end CHARACTERISTIC
/begin CHARACTERISTIC ASDrf_facRampMtModPos_GM "weight of positive ramp in manual transmission mode" MAP 0x80509076 RB_MapGroup_U8 1.000000 fak_ub_b2 0.00 1.000000 FORMAT "%8.6" EXTENDED_LIMITS 0.00 1.992188
 /begin AXIS_DESCR COM_AXIS ASDrf_facDesDyn Fact 10 -4.000000 3.999878 FORMAT "%8.6" AXIS_PTS_REF ASDrf_facDesDyn_DST /end AXIS_DESCR
 /begin AXIS_DESCR COM_AXIS Epm_nEng EngN 8 -16384.00 16383.50 FORMAT "%8.2" AXIS_PTS_REF ASDrf_nEng_DST /end AXIS_DESCR
/end CHARACTERISTIC
/begin CHARACTERISTIC ASDrf_facRampMtModPos_GT "weight of positive ramp in manual transmission mode" CURVE 0x805090C6 RB_CurveGroup_U8 1.000000 fak_ub_b2 0.00 1.000000 FORMAT "%8.6" EXTENDED_LIMITS 0.00 1.992188
 /begin AXIS_DESCR COM_AXIS PT_rTrq TransR 8 -327.6800 327.6700 FORMAT "%8.4" AXIS_PTS_REF ASDrf_rTrq_DST /end AXIS_DESCR
/end CHARACTERISTIC
/begin CHARACTERISTIC ASDrf_facRampPosFFVAcOn_GM "weight of positive ramp for FFV during AC On" MAP 0x805090CE RB_MapGroup_U8 1.000000 fak_ub_b2 0.00 1.000000 FORMAT "%8.6" EXTENDED_LIMITS 0.00 1.992188
 /begin AXIS_DESCR COM_AXIS ASDrf_facDesDyn Fact 10 -4.000000 3.999878 FORMAT "%8.6" AXIS_PTS_REF ASDrf_facDesDyn_DST /end AXIS_DESCR
 /begin AXIS_DESCR COM_AXIS Epm_nEng EngN 8 -16384.00 16383.50 FORMAT "%8.2" AXIS_PTS_REF ASDrf_nEng_DST /end AXIS_DESCR
/end CHARACTERISTIC
/begin CHARACTERISTIC ASDrf_facRampPosFFVAcOn_GT "weight of positive ramp for FFV durign AC On" CURVE 0x8050911E RB_CurveGroup_U8 1.000000 fak_ub_b2 0.00 1.000000 FORMAT "%8.6" EXTENDED_LIMITS 0.00 1.992188
 /begin AXIS_DESCR COM_AXIS PT_rTrq TransR 8 -327.6800 327.6700 FORMAT "%8.4" AXIS_PTS_REF ASDrf_rTrq_DST /end AXIS_DESCR
/end CHARACTERISTIC
/begin CHARACTERISTIC ASDrf_facRampPosFFV_GM "weight of positive ramp for FFV" MAP 0x80509126 RB_MapGroup_U8 1.000000 fak_ub_b2 0.00 1.000000 FORMAT "%8.6" EXTENDED_LIMITS 0.00 1.992188
 /begin AXIS_DESCR COM_AXIS ASDrf_facDesDyn Fact 10 -4.000000 3.999878 FORMAT "%8.6" AXIS_PTS_REF ASDrf_facDesDyn_DST /end AXIS_DESCR
 /begin AXIS_DESCR COM_AXIS Epm_nEng EngN 8 -16384.00 16383.50 FORMAT "%8.2" AXIS_PTS_REF ASDrf_nEng_DST /end AXIS_DESCR
/end CHARACTERISTIC
/begin CHARACTERISTIC ASDrf_facRampPosFFV_GT "weight of positive ramp for FFV" CURVE 0x80509176 RB_CurveGroup_U8 1.000000 fak_ub_b2 0.00 1.000000 FORMAT "%8.6" EXTENDED_LIMITS 0.00 1.992188
 /begin AXIS_DESCR COM_AXIS PT_rTrq TransR 8 -327.6800 327.6700 FORMAT "%8.4" AXIS_PTS_REF ASDrf_rTrq_DST /end AXIS_DESCR
/end CHARACTERISTIC
/begin CHARACTERISTIC ASDrf_facRmpPosAcOn_GCUR "weight of positive ramp during AC On" CURVE 0x8050917E RB_CurveGroup_U8 1.000000 fak_ub_b2 0.00 1.000000 FORMAT "%8.6" EXTENDED_LIMITS 0.00 1.992188
 /begin AXIS_DESCR COM_AXIS PT_rTrq TransR 8 -327.6800 327.6700 FORMAT "%8.4" AXIS_PTS_REF ASDrf_rTrq_DST /end AXIS_DESCR
/end CHARACTERISTIC
/begin CHARACTERISTIC ASDrf_facRmpPosAcOn_GMAP "weight of positive ramp during AC On" MAP 0x80509186 RB_MapGroup_U8 1.000000 fak_ub_b2 0.00 1.000000 FORMAT "%8.6" EXTENDED_LIMITS 0.00 1.992188
 /begin AXIS_DESCR COM_AXIS ASDrf_facDesDyn Fact 10 -4.000000 3.999878 FORMAT "%8.6" AXIS_PTS_REF ASDrf_facDesDyn_DST /end AXIS_DESCR
 /begin AXIS_DESCR COM_AXIS Epm_nEng EngN 8 -16384.00 16383.50 FORMAT "%8.2" AXIS_PTS_REF ASDrf_nEng_DST /end AXIS_DESCR
/end CHARACTERISTIC
/begin CHARACTERISTIC ASDrf_facRmpPos_GCUR "weight of positive ramp" CURVE 0x805091D6 RB_CurveGroup_U8 1.000000 fak_ub_b2 0.00 1.000000 FORMAT "%8.6" EXTENDED_LIMITS 0.00 1.992188
 /begin AXIS_DESCR COM_AXIS PT_rTrq TransR 8 -327.6800 327.6700 FORMAT "%8.4" AXIS_PTS_REF ASDrf_rTrq_DST /end AXIS_DESCR
/end CHARACTERISTIC
/begin CHARACTERISTIC ASDrf_facRmpPos_GMAP "weight of positive ramp" MAP 0x805091DE RB_MapGroup_U8 1.000000 fak_ub_b2 0.00 1.000000 FORMAT "%8.6" EXTENDED_LIMITS 0.00 1.992188
 /begin AXIS_DESCR COM_AXIS ASDrf_facDesDyn Fact 10 -4.000000 3.999878 FORMAT "%8.6" AXIS_PTS_REF ASDrf_facDesDyn_DST /end AXIS_DESCR
 /begin AXIS_DESCR COM_AXIS Epm_nEng EngN 8 -16384.00 16383.50 FORMAT "%8.2" AXIS_PTS_REF ASDrf_nEng_DST /end AXIS_DESCR
/end CHARACTERISTIC
/begin CHARACTERISTIC ASDrf_facRollFric_C "factor rolling friction torque" VALUE 0x8050B006 RB_Val_Ws16 3276.700 Trq 0.00 3276.700 FORMAT "%8.3" EXTENDED_LIMITS -3276.800 3276.700 /end CHARACTERISTIC
/begin CHARACTERISTIC ASDrf_facSprtAirCdnrOnRampPos_GM "weight of positive ramp in sport mode with AC on" MAP 0x8050922E RB_MapGroup_U8 1.000000 fak_ub_b2 0.00 1.000000 FORMAT "%8.6" EXTENDED_LIMITS 0.00 1.992188
 /begin AXIS_DESCR COM_AXIS ASDrf_facDesDyn Fact 10 -4.000000 3.999878 FORMAT "%8.6" AXIS_PTS_REF ASDrf_facDesDyn_DST /end AXIS_DESCR
 /begin AXIS_DESCR COM_AXIS Epm_nEng EngN 8 -16384.00 16383.50 FORMAT "%8.2" AXIS_PTS_REF ASDrf_nEng_DST /end AXIS_DESCR
/end CHARACTERISTIC
/begin CHARACTERISTIC ASDrf_facSprtAirCdnrOnRampPos_GT "time constant Lead path for sport mode with AC on" CURVE 0x8050927E RB_CurveGroup_U8 1.000000 fak_ub_b2 0.00 1.000000 FORMAT "%8.6" EXTENDED_LIMITS 0.00 1.992188
 /begin AXIS_DESCR COM_AXIS PT_rTrq TransR 8 -327.6800 327.6700 FORMAT "%8.4" AXIS_PTS_REF ASDrf_rTrq_DST /end AXIS_DESCR
/end CHARACTERISTIC
/begin CHARACTERISTIC ASDrf_facSprtAirCdnrOnTqIniNeg_GM "weighting factor for init-jump lead dashpot in sport mode with AC on" MAP 0x80509286 RB_MapGroup_U8 1.000000 fak_ub_b2 0.00 1.000000 FORMAT "%8.6" EXTENDED_LIMITS 0.00 1.992188
 /begin AXIS_DESCR COM_AXIS ASDrf_tqCluBasc Trq 5 -3276.800 3276.700 FORMAT "%8.3" AXIS_PTS_REF ASDrf_trqClthBs_DST /end AXIS_DESCR
 /begin AXIS_DESCR COM_AXIS Epm_nEng EngN 8 -16384.00 16383.50 FORMAT "%8.2" AXIS_PTS_REF ASDrf_nEng_DST /end AXIS_DESCR
/end CHARACTERISTIC
/begin CHARACTERISTIC ASDrf_facSprtAirCdnrOnTqIniNeg_GT "weighting factor for init-jump lead dashpot in sport mode with AC on" CURVE 0x805092AE RB_CurveGroup_U8 7.969 fak_ub_b8 0.00 7.969 FORMAT "%5.3"
 /begin AXIS_DESCR COM_AXIS PT_rTrq TransR 8 -327.6800 327.6700 FORMAT "%8.4" AXIS_PTS_REF ASDrf_rTrq_DST /end AXIS_DESCR
/end CHARACTERISTIC
/begin CHARACTERISTIC ASDrf_facSprtRampMtModPos_GM "weight of positive ramp in sport manual transmission mode" MAP 0x805092B6 RB_MapGroup_U8 1.000000 fak_ub_b2 0.00 1.000000 FORMAT "%8.6" EXTENDED_LIMITS 0.00 1.992188
 /begin AXIS_DESCR COM_AXIS ASDrf_facDesDyn Fact 10 -4.000000 3.999878 FORMAT "%8.6" AXIS_PTS_REF ASDrf_facDesDyn_DST /end AXIS_DESCR
 /begin AXIS_DESCR COM_AXIS Epm_nEng EngN 8 -16384.00 16383.50 FORMAT "%8.2" AXIS_PTS_REF ASDrf_nEng_DST /end AXIS_DESCR
/end CHARACTERISTIC
/begin CHARACTERISTIC ASDrf_facSprtRampMtModPos_GT "weight of positive ramp in sport manual transmission mode" CURVE 0x80509306 RB_CurveGroup_U8 1.000000 fak_ub_b2 0.00 1.000000 FORMAT "%8.6" EXTENDED_LIMITS 0.00 1.992188
 /begin AXIS_DESCR COM_AXIS PT_rTrq TransR 8 -327.6800 327.6700 FORMAT "%8.4" AXIS_PTS_REF ASDrf_rTrq_DST /end AXIS_DESCR
/end CHARACTERISTIC
/begin CHARACTERISTIC ASDrf_facSprtRampPos_GM "weight of positive ramp in sport mode" MAP 0x8050930E RB_MapGroup_U8 1.000000 fak_ub_b2 0.00 1.000000 FORMAT "%8.6" EXTENDED_LIMITS 0.00 1.992188
 /begin AXIS_DESCR COM_AXIS ASDrf_facDesDyn Fact 10 -4.000000 3.999878 FORMAT "%8.6" AXIS_PTS_REF ASDrf_facDesDyn_DST /end AXIS_DESCR
 /begin AXIS_DESCR COM_AXIS Epm_nEng EngN 8 -16384.00 16383.50 FORMAT "%8.2" AXIS_PTS_REF ASDrf_nEng_DST /end AXIS_DESCR
/end CHARACTERISTIC
/begin CHARACTERISTIC ASDrf_facSprtRampPos_GT "weight of positive ramp in sport mode" CURVE 0x8050935E RB_CurveGroup_U8 1.000000 fak_ub_b2 0.00 1.000000 FORMAT "%8.6" EXTENDED_LIMITS 0.00 1.992188
 /begin AXIS_DESCR COM_AXIS PT_rTrq TransR 8 -327.6800 327.6700 FORMAT "%8.4" AXIS_PTS_REF ASDrf_rTrq_DST /end AXIS_DESCR
/end CHARACTERISTIC
/begin CHARACTERISTIC ASDrf_facSprtTqIniMtModNeg_GM "weighting factor for init-jump lead dashpot in sport manual transmission mode" MAP 0x80509366 RB_MapGroup_U8 1.000000 fak_ub_b2 0.00 1.000000 FORMAT "%8.6" EXTENDED_LIMITS 0.00 1.992188
 /begin AXIS_DESCR COM_AXIS ASDrf_tqCluBasc Trq 5 -3276.800 3276.700 FORMAT "%8.3" AXIS_PTS_REF ASDrf_trqClthBs_DST /end AXIS_DESCR
 /begin AXIS_DESCR COM_AXIS Epm_nEng EngN 8 -16384.00 16383.50 FORMAT "%8.2" AXIS_PTS_REF ASDrf_nEng_DST /end AXIS_DESCR
/end CHARACTERISTIC
/begin CHARACTERISTIC ASDrf_facSprtTqIniMtModNeg_GT "weighting factor for init-jump lead dashpot in sport manual transmission mode" CURVE 0x8050938E RB_CurveGroup_U8 7.969 fak_ub_b8 0.00 7.969 FORMAT "%5.3"
 /begin AXIS_DESCR COM_AXIS PT_rTrq TransR 8 -327.6800 327.6700 FORMAT "%8.4" AXIS_PTS_REF ASDrf_rTrq_DST /end AXIS_DESCR
/end CHARACTERISTIC
/begin CHARACTERISTIC ASDrf_facSprtTqIniNeg_GM "weighting factor for init-jump lead dashpot in sport mode" MAP 0x80509396 RB_MapGroup_U8 1.000000 fak_ub_b2 0.00 1.000000 FORMAT "%8.6" EXTENDED_LIMITS 0.00 1.992188
 /begin AXIS_DESCR COM_AXIS ASDrf_tqCluBasc Trq 5 -3276.800 3276.700 FORMAT "%8.3" AXIS_PTS_REF ASDrf_trqClthBs_DST /end AXIS_DESCR
 /begin AXIS_DESCR COM_AXIS Epm_nEng EngN 8 -16384.00 16383.50 FORMAT "%8.2" AXIS_PTS_REF ASDrf_nEng_DST /end AXIS_DESCR
/end CHARACTERISTIC
/begin CHARACTERISTIC ASDrf_facSprtTqIniNeg_GT "weighting factor for init-jump lead dashpot in sport mode" CURVE 0x805093BE RB_CurveGroup_U8 7.969 fak_ub_b8 0.00 7.969 FORMAT "%5.3"
 /begin AXIS_DESCR COM_AXIS PT_rTrq TransR 8 -327.6800 327.6700 FORMAT "%8.4" AXIS_PTS_REF ASDrf_rTrq_DST /end AXIS_DESCR
/end CHARACTERISTIC
/begin CHARACTERISTIC ASDrf_facSptRampMtModPosAcOn_GM "weight of positive ramp in Sport manual transmission mode when AC is ON" MAP 0x805093C6 RB_MapGroup_U8 1.000000 fak_ub_b2 0.00 1.000000 FORMAT "%8.6" EXTENDED_LIMITS 0.00 1.992188
 /begin AXIS_DESCR COM_AXIS ASDrf_facDesDyn Fact 10 -4.000000 3.999878 FORMAT "%8.6" AXIS_PTS_REF ASDrf_facDesDyn_DST /end AXIS_DESCR
 /begin AXIS_DESCR COM_AXIS Epm_nEng EngN 8 -16384.00 16383.50 FORMAT "%8.2" AXIS_PTS_REF ASDrf_nEng_DST /end AXIS_DESCR
/end CHARACTERISTIC
/begin CHARACTERISTIC ASDrf_facSptRampMtModPosAcOn_GT "weight of positive ramp in Sport manual transmission mode when AC is ON" CURVE 0x80509416 RB_CurveGroup_U8 1.000000 fak_ub_b2 0.00 1.000000 FORMAT "%8.6" EXTENDED_LIMITS 0.00 1.992188
 /begin AXIS_DESCR COM_AXIS PT_rTrq TransR 8 -327.6800 327.6700 FORMAT "%8.4" AXIS_PTS_REF ASDrf_rTrq_DST /end AXIS_DESCR
/end CHARACTERISTIC
/begin CHARACTERISTIC ASDrf_facSptTqIniMtModNegAcOn_GM "weighting factor for init-jump lead dashpot in sport manual transmission mode when AC is ON" MAP 0x8050941E RB_MapGroup_U8 1.000000 fak_ub_b2 0.00 1.000000 FORMAT "%8.6" EXTENDED_LIMITS 0.00 1.992188
 /begin AXIS_DESCR COM_AXIS ASDrf_tqCluBasc Trq 5 -3276.800 3276.700 FORMAT "%8.3" AXIS_PTS_REF ASDrf_trqClthBs_DST /end AXIS_DESCR
 /begin AXIS_DESCR COM_AXIS Epm_nEng EngN 8 -16384.00 16383.50 FORMAT "%8.2" AXIS_PTS_REF ASDrf_nEng_DST /end AXIS_DESCR
/end CHARACTERISTIC
/begin CHARACTERISTIC ASDrf_facSptTqIniMtModNegAcOn_GT "weighting factor for init-jump lead dashpot in sport manual transmission mode when AC is ON" CURVE 0x80509446 RB_CurveGroup_U8 7.969 fak_ub_b8 0.00 7.969 FORMAT "%5.3"
 /begin AXIS_DESCR COM_AXIS PT_rTrq TransR 8 -327.6800 327.6700 FORMAT "%8.4" AXIS_PTS_REF ASDrf_rTrq_DST /end AXIS_DESCR
/end CHARACTERISTIC
/begin CHARACTERISTIC ASDrf_facTiAirCdnrOnNegLead_GT "weighting factor time constant lead path for AC on" CURVE 0x8050944E RB_CurveGroup_U8 7.969 fak_ub_b8 0.00 7.969 FORMAT "%5.3"
 /begin AXIS_DESCR COM_AXIS PT_rTrq TransR 8 -327.6800 327.6700 FORMAT "%8.4" AXIS_PTS_REF ASDrf_rTrq_DST /end AXIS_DESCR
/end CHARACTERISTIC
/begin CHARACTERISTIC ASDrf_facTiEcoNegLead_GT "weighting factor time constant lead path for Eco mode" CURVE 0x80509456 RB_CurveGroup_U8 7.969 fak_ub_b8 0.00 7.969 FORMAT "%5.3"
 /begin AXIS_DESCR COM_AXIS PT_rTrq TransR 8 -327.6800 327.6700 FORMAT "%8.4" AXIS_PTS_REF ASDrf_rTrq_DST /end AXIS_DESCR
/end CHARACTERISTIC
/begin CHARACTERISTIC ASDrf_facTiMtModEcoNegLeadAcOn_GT "weighting factor time constant lead path in Eco manual transmission when AC is ON" CURVE 0x8050945E RB_CurveGroup_U8 7.969 fak_ub_b8 0.00 7.969 FORMAT "%5.3"
 /begin AXIS_DESCR COM_AXIS PT_rTrq TransR 8 -327.6800 327.6700 FORMAT "%8.4" AXIS_PTS_REF ASDrf_rTrq_DST /end AXIS_DESCR
/end CHARACTERISTIC
/begin CHARACTERISTIC ASDrf_facTiMtModEcoNegLead_GT "weighting factor time constant lead path in Eco manual transmission" CURVE 0x80509466 RB_CurveGroup_U8 7.969 fak_ub_b8 0.00 7.969 FORMAT "%5.3"
 /begin AXIS_DESCR COM_AXIS PT_rTrq TransR 8 -327.6800 327.6700 FORMAT "%8.4" AXIS_PTS_REF ASDrf_rTrq_DST /end AXIS_DESCR
/end CHARACTERISTIC
/begin CHARACTERISTIC ASDrf_facTiMtModNegLeadAcOn_GT "weighting factor time constant lead path when AC is ON" CURVE 0x8050946E RB_CurveGroup_U8 7.969 fak_ub_b8 0.00 7.969 FORMAT "%5.3"
 /begin AXIS_DESCR COM_AXIS PT_rTrq TransR 8 -327.6800 327.6700 FORMAT "%8.4" AXIS_PTS_REF ASDrf_rTrq_DST /end AXIS_DESCR
/end CHARACTERISTIC
/begin CHARACTERISTIC ASDrf_facTiMtModNegLeadFFVAcOn_GT "weighting factor time constant lead path for FFV when AC is ON" CURVE 0x80509476 RB_CurveGroup_U8 7.969 fak_ub_b8 0.00 7.969 FORMAT "%5.3"
 /begin AXIS_DESCR COM_AXIS PT_rTrq TransR 8 -327.6800 327.6700 FORMAT "%8.4" AXIS_PTS_REF ASDrf_rTrq_DST /end AXIS_DESCR
/end CHARACTERISTIC
/begin CHARACTERISTIC ASDrf_facTiMtModNegLeadFFV_GT "weighting factor time constant lead path for FFV" CURVE 0x8050947E RB_CurveGroup_U8 7.969 fak_ub_b8 0.00 7.969 FORMAT "%5.3"
 /begin AXIS_DESCR COM_AXIS PT_rTrq TransR 8 -327.6800 327.6700 FORMAT "%8.4" AXIS_PTS_REF ASDrf_rTrq_DST /end AXIS_DESCR
/end CHARACTERISTIC
/begin CHARACTERISTIC ASDrf_facTiMtModNegLead_GT "weighting factor time constant lead path" CURVE 0x80509486 RB_CurveGroup_U8 7.969 fak_ub_b8 0.00 7.969 FORMAT "%5.3"
 /begin AXIS_DESCR COM_AXIS PT_rTrq TransR 8 -327.6800 327.6700 FORMAT "%8.4" AXIS_PTS_REF ASDrf_rTrq_DST /end AXIS_DESCR
/end CHARACTERISTIC
/begin CHARACTERISTIC ASDrf_facTiMtModSptNegLeadAcOn_GT "weighting factor time constant lead path in Sport manual transmission when AC is ON" CURVE 0x8050948E RB_CurveGroup_U8 7.969 fak_ub_b8 0.00 7.969 FORMAT "%5.3"
 /begin AXIS_DESCR COM_AXIS PT_rTrq TransR 8 -327.6800 327.6700 FORMAT "%8.4" AXIS_PTS_REF ASDrf_rTrq_DST /end AXIS_DESCR
/end CHARACTERISTIC
/begin CHARACTERISTIC ASDrf_facTiMtModSptNegLead_GT "weighting factor time constant lead path in Sport manual transmission" CURVE 0x80509496 RB_CurveGroup_U8 7.969 fak_ub_b8 0.00 7.969 FORMAT "%5.3"
 /begin AXIS_DESCR COM_AXIS PT_rTrq TransR 8 -327.6800 327.6700 FORMAT "%8.4" AXIS_PTS_REF ASDrf_rTrq_DST /end AXIS_DESCR
/end CHARACTERISTIC
/begin CHARACTERISTIC ASDrf_facTiNegLeadFFVAcOn_GT "weighting factor time constant lead path for FFV when AC is ON" CURVE 0x8050949E RB_CurveGroup_U8 7.969 fak_ub_b8 0.00 7.969 FORMAT "%5.3"
 /begin AXIS_DESCR COM_AXIS PT_rTrq TransR 8 -327.6800 327.6700 FORMAT "%8.4" AXIS_PTS_REF ASDrf_rTrq_DST /end AXIS_DESCR
/end CHARACTERISTIC
/begin CHARACTERISTIC ASDrf_facTiNegLeadFFV_GT "weighting factor time constant lead path for FFV" CURVE 0x805094A6 RB_CurveGroup_U8 7.969 fak_ub_b8 0.00 7.969 FORMAT "%5.3"
 /begin AXIS_DESCR COM_AXIS PT_rTrq TransR 8 -327.6800 327.6700 FORMAT "%8.4" AXIS_PTS_REF ASDrf_rTrq_DST /end AXIS_DESCR
/end CHARACTERISTIC
/begin CHARACTERISTIC ASDrf_facTiNegLead_GCUR "weighting factor time constant lead path" CURVE 0x805094AE RB_CurveGroup_U8 7.969 fak_ub_b8 0.00 7.969 FORMAT "%5.3"
 /begin AXIS_DESCR COM_AXIS PT_rTrq TransR 8 -327.6800 327.6700 FORMAT "%8.4" AXIS_PTS_REF ASDrf_rTrq_DST /end AXIS_DESCR
/end CHARACTERISTIC
/begin CHARACTERISTIC ASDrf_facTiOscdtqNeg_C "factor of duration time fo reduction to reference torque negative load change" VALUE 0x8050B008 RB_Val_Wu8 1.992188 fak_ub_b2 0.00 1.992188 FORMAT "%8.6" /end CHARACTERISTIC
/begin CHARACTERISTIC ASDrf_facTiOscLimPos_C "factor of duration time as maximum time for limitation positive load change" VALUE 0x8050B009 RB_Val_Wu8 1.992188 fak_ub_b2 0.00 1.992188 FORMAT "%8.6" /end CHARACTERISTIC
/begin CHARACTERISTIC ASDrf_facTiOscStrtRed_C "factor of duration time as maximum time for start torque reduction negative load change" VALUE 0x8050B00A RB_Val_Wu8 1.992188 fak_ub_b2 0.00 1.992188 FORMAT "%8.6" /end CHARACTERISTIC
/begin CHARACTERISTIC ASDrf_facTiSprtAirCdnrOnNegLead_GT "weighting factor time constant lead path for sport mode with AC on" CURVE 0x805094B6 RB_CurveGroup_U8 7.969 fak_ub_b8 0.00 7.969 FORMAT "%5.3"
 /begin AXIS_DESCR COM_AXIS PT_rTrq TransR 8 -327.6800 327.6700 FORMAT "%8.4" AXIS_PTS_REF ASDrf_rTrq_DST /end AXIS_DESCR
/end CHARACTERISTIC
/begin CHARACTERISTIC ASDrf_facTiSprtNegLead_GT "weighting factor time constant lead path for sport mode" CURVE 0x805094BE RB_CurveGroup_U8 7.969 fak_ub_b8 0.00 7.969 FORMAT "%5.3"
 /begin AXIS_DESCR COM_AXIS PT_rTrq TransR 8 -327.6800 327.6700 FORMAT "%8.4" AXIS_PTS_REF ASDrf_rTrq_DST /end AXIS_DESCR
/end CHARACTERISTIC
/begin CHARACTERISTIC ASDrf_facTqBasLim_C "factor base torque adjustment for requested set torque" VALUE 0x80508A96 RB_Val_Wu8 0.1875000 fak_ub_b2 1.015625 1.203125 FORMAT "%8.6" EXTENDED_LIMITS 0.00 1.992188 /end CHARACTERISTIC
/begin CHARACTERISTIC ASDrf_facTqIniAirCdnrOnNeg_GM "weighting factor for init-jump lead dashpot for AC on" MAP 0x805094C6 RB_MapGroup_U8 1.000000 fak_ub_b2 0.00 1.000000 FORMAT "%8.6" EXTENDED_LIMITS 0.00 1.992188
 /begin AXIS_DESCR COM_AXIS ASDrf_tqCluBasc Trq 5 -3276.800 3276.700 FORMAT "%8.3" AXIS_PTS_REF ASDrf_trqClthBs_DST /end AXIS_DESCR
 /begin AXIS_DESCR COM_AXIS Epm_nEng EngN 8 -16384.00 16383.50 FORMAT "%8.2" AXIS_PTS_REF ASDrf_nEng_DST /end AXIS_DESCR
/end CHARACTERISTIC
/begin CHARACTERISTIC ASDrf_facTqIniAirCdnrOnNeg_GT "weighting factor for init-jump lead dashpot for AC on" CURVE 0x805094EE RB_CurveGroup_U8 7.969 fak_ub_b8 0.00 7.969 FORMAT "%5.3"
 /begin AXIS_DESCR COM_AXIS PT_rTrq TransR 8 -327.6800 327.6700 FORMAT "%8.4" AXIS_PTS_REF ASDrf_rTrq_DST /end AXIS_DESCR
/end CHARACTERISTIC
/begin CHARACTERISTIC ASDrf_facTqIniMtModNegAcOn_GM "weighting factor for init-jump lead dashpot in manual transmission mode when AC is ON" MAP 0x805094F6 RB_MapGroup_U8 1.000000 fak_ub_b2 0.00 1.000000 FORMAT "%8.6" EXTENDED_LIMITS 0.00 1.992188
 /begin AXIS_DESCR COM_AXIS ASDrf_tqCluBasc Trq 5 -3276.800 3276.700 FORMAT "%8.3" AXIS_PTS_REF ASDrf_trqClthBs_DST /end AXIS_DESCR
 /begin AXIS_DESCR COM_AXIS Epm_nEng EngN 8 -16384.00 16383.50 FORMAT "%8.2" AXIS_PTS_REF ASDrf_nEng_DST /end AXIS_DESCR
/end CHARACTERISTIC
/begin CHARACTERISTIC ASDrf_facTqIniMtModNegAcOn_GT "weighting factor for init-jump lead dashpot in manual transmission mode when AC is ON" CURVE 0x8050951E RB_CurveGroup_U8 7.969 fak_ub_b8 0.00 7.969 FORMAT "%5.3"
 /begin AXIS_DESCR COM_AXIS PT_rTrq TransR 8 -327.6800 327.6700 FORMAT "%8.4" AXIS_PTS_REF ASDrf_rTrq_DST /end AXIS_DESCR
/end CHARACTERISTIC
/begin CHARACTERISTIC ASDrf_facTqIniMtModNegFFVAcOn_GM "weighting factor for init-jump lead dashpot in manual transmission mode for flex fuel when AC is ON" MAP 0x80509526 RB_MapGroup_U8 1.000000 fak_ub_b2 0.00 1.000000 FORMAT "%8.6" EXTENDED_LIMITS 0.00 1.992188
 /begin AXIS_DESCR COM_AXIS ASDrf_tqCluBasc Trq 5 -3276.800 3276.700 FORMAT "%8.3" AXIS_PTS_REF ASDrf_trqClthBs_DST /end AXIS_DESCR
 /begin AXIS_DESCR COM_AXIS Epm_nEng EngN 8 -16384.00 16383.50 FORMAT "%8.2" AXIS_PTS_REF ASDrf_nEng_DST /end AXIS_DESCR
/end CHARACTERISTIC
/begin CHARACTERISTIC ASDrf_facTqIniMtModNegFFVAcOn_GT "weighting factor for init-jump lead dashpot in manual transmission mode for flex fuel when AC is ON" CURVE 0x8050954E RB_CurveGroup_U8 7.969 fak_ub_b8 0.00 7.969 FORMAT "%5.3"
 /begin AXIS_DESCR COM_AXIS PT_rTrq TransR 8 -327.6800 327.6700 FORMAT "%8.4" AXIS_PTS_REF ASDrf_rTrq_DST /end AXIS_DESCR
/end CHARACTERISTIC
/begin CHARACTERISTIC ASDrf_facTqIniMtModNegFFV_GM "weighting factor for init-jump lead dashpot in manual transmission mode for FFV" MAP 0x80509556 RB_MapGroup_U8 1.000000 fak_ub_b2 0.00 1.000000 FORMAT "%8.6" EXTENDED_LIMITS 0.00 1.992188
 /begin AXIS_DESCR COM_AXIS ASDrf_tqCluBasc Trq 5 -3276.800 3276.700 FORMAT "%8.3" AXIS_PTS_REF ASDrf_trqClthBs_DST /end AXIS_DESCR
 /begin AXIS_DESCR COM_AXIS Epm_nEng EngN 8 -16384.00 16383.50 FORMAT "%8.2" AXIS_PTS_REF ASDrf_nEng_DST /end AXIS_DESCR
/end CHARACTERISTIC
/begin CHARACTERISTIC ASDrf_facTqIniMtModNegFFV_GT "weighting factor for init-jump lead dashpot in manual transmission mode for FFV" CURVE 0x8050957E RB_CurveGroup_U8 7.969 fak_ub_b8 0.00 7.969 FORMAT "%5.3"
 /begin AXIS_DESCR COM_AXIS PT_rTrq TransR 8 -327.6800 327.6700 FORMAT "%8.4" AXIS_PTS_REF ASDrf_rTrq_DST /end AXIS_DESCR
/end CHARACTERISTIC
/begin CHARACTERISTIC ASDrf_facTqIniMtModNeg_GM "weighting factor for init-jump lead dashpot in manual transmission mode" MAP 0x80509586 RB_MapGroup_U8 1.000000 fak_ub_b2 0.00 1.000000 FORMAT "%8.6" EXTENDED_LIMITS 0.00 1.992188
 /begin AXIS_DESCR COM_AXIS ASDrf_tqCluBasc Trq 5 -3276.800 3276.700 FORMAT "%8.3" AXIS_PTS_REF ASDrf_trqClthBs_DST /end AXIS_DESCR
 /begin AXIS_DESCR COM_AXIS Epm_nEng EngN 8 -16384.00 16383.50 FORMAT "%8.2" AXIS_PTS_REF ASDrf_nEng_DST /end AXIS_DESCR
/end CHARACTERISTIC
/begin CHARACTERISTIC ASDrf_facTqIniMtModNeg_GT "weighting factor for init-jump lead dashpot in manual transmission mode" CURVE 0x805095AE RB_CurveGroup_U8 7.969 fak_ub_b8 0.00 7.969 FORMAT "%5.3"
 /begin AXIS_DESCR COM_AXIS PT_rTrq TransR 8 -327.6800 327.6700 FORMAT "%8.4" AXIS_PTS_REF ASDrf_rTrq_DST /end AXIS_DESCR
/end CHARACTERISTIC
/begin CHARACTERISTIC ASDrf_facTqIniNegFFVAcOn_GM "weighting factor for init-jump lead dashpot for FFV during AC On" MAP 0x805095B6 RB_MapGroup_U8 1.000000 fak_ub_b2 0.00 1.000000 FORMAT "%8.6" EXTENDED_LIMITS 0.00 1.992188
 /begin AXIS_DESCR COM_AXIS ASDrf_tqCluBasc Trq 5 -3276.800 3276.700 FORMAT "%8.3" AXIS_PTS_REF ASDrf_trqClthBs_DST /end AXIS_DESCR
 /begin AXIS_DESCR COM_AXIS Epm_nEng EngN 8 -16384.00 16383.50 FORMAT "%8.2" AXIS_PTS_REF ASDrf_nEng_DST /end AXIS_DESCR
/end CHARACTERISTIC
/begin CHARACTERISTIC ASDrf_facTqIniNegFFVAcOn_GT "weighting factor for init-jump lead dashpot for FFV during AC On" CURVE 0x805095DE RB_CurveGroup_U8 7.969 fak_ub_b8 0.00 7.969 FORMAT "%5.3"
 /begin AXIS_DESCR COM_AXIS PT_rTrq TransR 8 -327.6800 327.6700 FORMAT "%8.4" AXIS_PTS_REF ASDrf_rTrq_DST /end AXIS_DESCR
/end CHARACTERISTIC
/begin CHARACTERISTIC ASDrf_facTqIniNegFFV_GM "weighting factor for init-jump lead dashpot for FFV" MAP 0x805095E6 RB_MapGroup_U8 1.000000 fak_ub_b2 0.00 1.000000 FORMAT "%8.6" EXTENDED_LIMITS 0.00 1.992188
 /begin AXIS_DESCR COM_AXIS ASDrf_tqCluBasc Trq 5 -3276.800 3276.700 FORMAT "%8.3" AXIS_PTS_REF ASDrf_trqClthBs_DST /end AXIS_DESCR
 /begin AXIS_DESCR COM_AXIS Epm_nEng EngN 8 -16384.00 16383.50 FORMAT "%8.2" AXIS_PTS_REF ASDrf_nEng_DST /end AXIS_DESCR
/end CHARACTERISTIC
/begin CHARACTERISTIC ASDrf_facTqIniNegFFV_GT "weighting factor for init-jump lead dashpot for FFV" CURVE 0x8050960E RB_CurveGroup_U8 7.969 fak_ub_b8 0.00 7.969 FORMAT "%5.3"
 /begin AXIS_DESCR COM_AXIS PT_rTrq TransR 8 -327.6800 327.6700 FORMAT "%8.4" AXIS_PTS_REF ASDrf_rTrq_DST /end AXIS_DESCR
/end CHARACTERISTIC
/begin CHARACTERISTIC ASDrf_facTqIniTEngAirCdnrOnNeg_GT "engine temperature dependent weighting factor for init-jump lead dashpot for AC on" CURVE 0x80509616 RB_CurveGroup_U8 1.992188 fak_ub_b2 0.00 1.992188 FORMAT "%8.6"
 /begin AXIS_DESCR COM_AXIS EngDa_tEng Temp_Cels 6 -3549.940 3003.560 FORMAT "%8.3" AXIS_PTS_REF ASDrf_tEng_DST /end AXIS_DESCR
/end CHARACTERISTIC
/begin CHARACTERISTIC ASDrf_facTqIniTEngNeg_GT "engine temperature dependent weighting factor for init-jump lead dashpot" CURVE 0x8050961C RB_CurveGroup_U8 1.992188 fak_ub_b2 0.00 1.992188 FORMAT "%8.6"
 /begin AXIS_DESCR COM_AXIS EngDa_tEng Temp_Cels 6 -3549.940 3003.560 FORMAT "%8.3" AXIS_PTS_REF ASDrf_tEng_DST /end AXIS_DESCR
/end CHARACTERISTIC
/begin CHARACTERISTIC ASDrf_factqOffNeg_T "gear dependent correction of offset for reference torque negative load change" CURVE 0x8050B00C RB_Curve_S8_U8_Static 3.984 fak_ub_b4 0.00 3.984 FORMAT "%5.3"
 /begin AXIS_DESCR STD_AXIS Tra_numGear OneToOne 10 -128.0 127.0 FORMAT "%5.1" DEPOSIT ABSOLUTE /end AXIS_DESCR
/end CHARACTERISTIC
/begin CHARACTERISTIC ASDrf_factqOffPos_T "gear dependent correction of offset for reference torque positive load change" CURVE 0x8050B022 RB_Curve_S8_U8_Static 3.984 fak_ub_b4 0.00 3.984 FORMAT "%5.3"
 /begin AXIS_DESCR STD_AXIS Tra_numGear OneToOne 10 -128.0 127.0 FORMAT "%5.1" DEPOSIT ABSOLUTE /end AXIS_DESCR
/end CHARACTERISTIC
/begin CHARACTERISTIC ASDrf_facTrqIniNeg_GCUR "weighting factor for init-jump lead dashpot" CURVE 0x80509622 RB_CurveGroup_U8 7.969 fak_ub_b8 0.00 7.969 FORMAT "%5.3"
 /begin AXIS_DESCR COM_AXIS PT_rTrq TransR 8 -327.6800 327.6700 FORMAT "%8.4" AXIS_PTS_REF ASDrf_rTrq_DST /end AXIS_DESCR
/end CHARACTERISTIC
/begin CHARACTERISTIC ASDrf_facTrqIniNeg_GMAP "weighting factor for init-jump lead dashpot" MAP 0x8050962A RB_MapGroup_U8 1.000000 fak_ub_b2 0.00 1.000000 FORMAT "%8.6" EXTENDED_LIMITS 0.00 1.992188
 /begin AXIS_DESCR COM_AXIS ASDrf_tqCluBasc Trq 5 -3276.800 3276.700 FORMAT "%8.3" AXIS_PTS_REF ASDrf_trqClthBs_DST /end AXIS_DESCR
 /begin AXIS_DESCR COM_AXIS Epm_nEng EngN 8 -16384.00 16383.50 FORMAT "%8.2" AXIS_PTS_REF ASDrf_nEng_DST /end AXIS_DESCR
/end CHARACTERISTIC
/begin AXIS_PTS ASDrf_nEng_DST "engine speed" 0x8050D3A4 Epm_nEng RB_Axis_S16 32767.50 EngN 8 -16384.00 16383.50 FORMAT "%8.2" DEPOSIT ABSOLUTE /end AXIS_PTS
/begin AXIS_PTS ASDrf_nPt_DST "speed powertrain" 0x8050D3B6 ASDrf_nPt RB_Axis_S16 32767.50 EngN 8 -16384.00 16383.50 FORMAT "%8.2" DEPOSIT ABSOLUTE /end AXIS_PTS
/begin AXIS_PTS ASDrf_ratApp_DST "Accelerator pedal ratio" 0x8050B038 APP_r RB_Axis_S16 799.9878 Prc 10 -400.0000 399.9878 FORMAT "%8.4" DEPOSIT ABSOLUTE /end AXIS_PTS
/begin CHARACTERISTIC ASDrf_rGripThdSlip_C "Grip Threshold" VALUE 0x8050B04E RB_Val_Ws16 655.3500 TransR -327.6800 327.6700 FORMAT "%8.4" /end CHARACTERISTIC
/begin AXIS_PTS ASDrf_rTrq_DST "ratio of transmission" 0x8050E058 PT_rTrq RB_Axis_S16 655.3500 TransR 8 -327.6800 327.6700 FORMAT "%8.4" DEPOSIT ABSOLUTE /end AXIS_PTS
/begin CHARACTERISTIC ASDrf_swtTrqRng_C "Calibration to switch between Inner torque and clutch torque" VALUE 0x80509652 RB_Val_Wboolean 1.00000000000 B_TRUE 0.00 1.00000000000 FORMAT "%13.11" /end CHARACTERISTIC
/begin CHARACTERISTIC ASDrf_tCooltHiThd_C "High threshold for coolant temperature" VALUE 0x8050B050 RB_Val_Ws16 6553.500 Temp_Cels -3549.940 3003.560 FORMAT "%8.3" /end CHARACTERISTIC
/begin CHARACTERISTIC ASDrf_tCooltLoThd_C "Low threshold for coolant temperature" VALUE 0x8050B052 RB_Val_Ws16 6553.500 Temp_Cels -3549.940 3003.560 FORMAT "%8.3" /end CHARACTERISTIC
/begin AXIS_PTS ASDrf_tEng_DST "engine temperature" 0x8050E08E EngDa_tEng RB_Axis_S16 6553.500 Temp_Cels 6 -3549.940 3003.560 FORMAT "%8.3" DEPOSIT ABSOLUTE /end AXIS_PTS
/begin CHARACTERISTIC ASDrf_tiAirCdnrOnNegLead_GM "time constant Lead path for AC on" MAP 0x80509653 RB_MapGroup_U8 2.550 t_q0p01 0.00 2.550 FORMAT "%5.3"
 /begin AXIS_DESCR COM_AXIS ASDrf_tqCluBasc Trq 5 -3276.800 3276.700 FORMAT "%8.3" AXIS_PTS_REF ASDrf_trqClthBs_DST /end AXIS_DESCR
 /begin AXIS_DESCR COM_AXIS Epm_nEng EngN 8 -16384.00 16383.50 FORMAT "%8.2" AXIS_PTS_REF ASDrf_nEng_DST /end AXIS_DESCR
/end CHARACTERISTIC
/begin CHARACTERISTIC ASDrf_tiEcoAirCdnrOnNegLead_GM "time constant Lead path for AC on in Eco mode" MAP 0x8050967B RB_MapGroup_U8 2.550 t_q0p01 0.00 2.550 FORMAT "%5.3"
 /begin AXIS_DESCR COM_AXIS ASDrf_tqCluBasc Trq 5 -3276.800 3276.700 FORMAT "%8.3" AXIS_PTS_REF ASDrf_trqClthBs_DST /end AXIS_DESCR
 /begin AXIS_DESCR COM_AXIS Epm_nEng EngN 8 -16384.00 16383.50 FORMAT "%8.2" AXIS_PTS_REF ASDrf_nEng_DST /end AXIS_DESCR
/end CHARACTERISTIC
/begin CHARACTERISTIC ASDrf_tiEcoNegLead_GM "time constant Lead path for Eco mode" MAP 0x805096A3 RB_MapGroup_U8 2.550 t_q0p01 0.00 2.550 FORMAT "%5.3"
 /begin AXIS_DESCR COM_AXIS ASDrf_tqCluBasc Trq 5 -3276.800 3276.700 FORMAT "%8.3" AXIS_PTS_REF ASDrf_trqClthBs_DST /end AXIS_DESCR
 /begin AXIS_DESCR COM_AXIS Epm_nEng EngN 8 -16384.00 16383.50 FORMAT "%8.2" AXIS_PTS_REF ASDrf_nEng_DST /end AXIS_DESCR
/end CHARACTERISTIC
/begin CHARACTERISTIC ASDrf_tiMaxPos_GMAP "maximum delay time" MAP 0x805096CB RB_MapGroup_U8 2.530 t_q0p01 0.010 2.540 FORMAT "%5.3" EXTENDED_LIMITS 0.00 2.550
 /begin AXIS_DESCR COM_AXIS ASDrf_facDesDyn Fact 10 -4.000000 3.999878 FORMAT "%8.6" AXIS_PTS_REF ASDrf_facDesDyn_DST /end AXIS_DESCR
 /begin AXIS_DESCR COM_AXIS ASDrf_nPt EngN 8 -16384.00 16383.50 FORMAT "%8.2" AXIS_PTS_REF ASDrf_nPt_DST /end AXIS_DESCR
/end CHARACTERISTIC
/begin CHARACTERISTIC ASDrf_tiMtModEcoNegLeadAcOn_GM "time constant Lead path for Eco manual transmission mode when AC is ON" MAP 0x8050971B RB_MapGroup_U8 2.550 t_q0p01 0.00 2.550 FORMAT "%5.3"
 /begin AXIS_DESCR COM_AXIS ASDrf_tqCluBasc Trq 5 -3276.800 3276.700 FORMAT "%8.3" AXIS_PTS_REF ASDrf_trqClthBs_DST /end AXIS_DESCR
 /begin AXIS_DESCR COM_AXIS Epm_nEng EngN 8 -16384.00 16383.50 FORMAT "%8.2" AXIS_PTS_REF ASDrf_nEng_DST /end AXIS_DESCR
/end CHARACTERISTIC
/begin CHARACTERISTIC ASDrf_tiMtModEcoNegLead_GM "time constant Lead path for Eco manual transmission mode" MAP 0x80509743 RB_MapGroup_U8 2.550 t_q0p01 0.00 2.550 FORMAT "%5.3"
 /begin AXIS_DESCR COM_AXIS ASDrf_tqCluBasc Trq 5 -3276.800 3276.700 FORMAT "%8.3" AXIS_PTS_REF ASDrf_trqClthBs_DST /end AXIS_DESCR
 /begin AXIS_DESCR COM_AXIS Epm_nEng EngN 8 -16384.00 16383.50 FORMAT "%8.2" AXIS_PTS_REF ASDrf_nEng_DST /end AXIS_DESCR
/end CHARACTERISTIC
/begin CHARACTERISTIC ASDrf_tiMtModNegLeadAcOn_GM "time constant Lead path for manual transmission mode when AC is ON" MAP 0x8050976B RB_MapGroup_U8 2.550 t_q0p01 0.00 2.550 FORMAT "%5.3"
 /begin AXIS_DESCR COM_AXIS ASDrf_tqCluBasc Trq 5 -3276.800 3276.700 FORMAT "%8.3" AXIS_PTS_REF ASDrf_trqClthBs_DST /end AXIS_DESCR
 /begin AXIS_DESCR COM_AXIS Epm_nEng EngN 8 -16384.00 16383.50 FORMAT "%8.2" AXIS_PTS_REF ASDrf_nEng_DST /end AXIS_DESCR
/end CHARACTERISTIC
/begin CHARACTERISTIC ASDrf_tiMtModNegLeadFFVAcOn_GM "time constant Lead path for manual transmission mode for flex fuel when AC is ON" MAP 0x80509793 RB_MapGroup_U8 2.550 t_q0p01 0.00 2.550 FORMAT "%5.3"
 /begin AXIS_DESCR COM_AXIS ASDrf_tqCluBasc Trq 5 -3276.800 3276.700 FORMAT "%8.3" AXIS_PTS_REF ASDrf_trqClthBs_DST /end AXIS_DESCR
 /begin AXIS_DESCR COM_AXIS Epm_nEng EngN 8 -16384.00 16383.50 FORMAT "%8.2" AXIS_PTS_REF ASDrf_nEng_DST /end AXIS_DESCR
/end CHARACTERISTIC
/begin CHARACTERISTIC ASDrf_tiMtModNegLeadFFV_GM "time constant Lead path for manual transmission mode for flex fuel" MAP 0x805097BB RB_MapGroup_U8 2.550 t_q0p01 0.00 2.550 FORMAT "%5.3"
 /begin AXIS_DESCR COM_AXIS ASDrf_tqCluBasc Trq 5 -3276.800 3276.700 FORMAT "%8.3" AXIS_PTS_REF ASDrf_trqClthBs_DST /end AXIS_DESCR
 /begin AXIS_DESCR COM_AXIS Epm_nEng EngN 8 -16384.00 16383.50 FORMAT "%8.2" AXIS_PTS_REF ASDrf_nEng_DST /end AXIS_DESCR
/end CHARACTERISTIC
/begin CHARACTERISTIC ASDrf_tiMtModNegLead_GM "time constant Lead path for manual transmission mode" MAP 0x805097E3 RB_MapGroup_U8 2.550 t_q0p01 0.00 2.550 FORMAT "%5.3"
 /begin AXIS_DESCR COM_AXIS ASDrf_tqCluBasc Trq 5 -3276.800 3276.700 FORMAT "%8.3" AXIS_PTS_REF ASDrf_trqClthBs_DST /end AXIS_DESCR
 /begin AXIS_DESCR COM_AXIS ASDrf_nPt EngN 8 -16384.00 16383.50 FORMAT "%8.2" AXIS_PTS_REF ASDrf_nPt_DST /end AXIS_DESCR
/end CHARACTERISTIC
/begin CHARACTERISTIC ASDrf_tiMtModSptNegLeadAcOn_GM "time constant Lead path for Sport manual transmission mode when AC is ON" MAP 0x8050980B RB_MapGroup_U8 2.550 t_q0p01 0.00 2.550 FORMAT "%5.3"
 /begin AXIS_DESCR COM_AXIS ASDrf_tqCluBasc Trq 5 -3276.800 3276.700 FORMAT "%8.3" AXIS_PTS_REF ASDrf_trqClthBs_DST /end AXIS_DESCR
 /begin AXIS_DESCR COM_AXIS Epm_nEng EngN 8 -16384.00 16383.50 FORMAT "%8.2" AXIS_PTS_REF ASDrf_nEng_DST /end AXIS_DESCR
/end CHARACTERISTIC
/begin CHARACTERISTIC ASDrf_tiMtModSptNegLead_GM "time constant Lead path for Sport manual transmission mode" MAP 0x80509833 RB_MapGroup_U8 2.550 t_q0p01 0.00 2.550 FORMAT "%5.3"
 /begin AXIS_DESCR COM_AXIS ASDrf_tqCluBasc Trq 5 -3276.800 3276.700 FORMAT "%8.3" AXIS_PTS_REF ASDrf_trqClthBs_DST /end AXIS_DESCR
 /begin AXIS_DESCR COM_AXIS Epm_nEng EngN 8 -16384.00 16383.50 FORMAT "%8.2" AXIS_PTS_REF ASDrf_nEng_DST /end AXIS_DESCR
/end CHARACTERISTIC
/begin CHARACTERISTIC ASDrf_tiNegLeadFFVAcOn_GM "time constant Lead path for FFV when AC is ON" MAP 0x8050985B RB_MapGroup_U8 2.550 t_q0p01 0.00 2.550 FORMAT "%5.3"
 /begin AXIS_DESCR COM_AXIS ASDrf_tqCluBasc Trq 5 -3276.800 3276.700 FORMAT "%8.3" AXIS_PTS_REF ASDrf_trqClthBs_DST /end AXIS_DESCR
 /begin AXIS_DESCR COM_AXIS Epm_nEng EngN 8 -16384.00 16383.50 FORMAT "%8.2" AXIS_PTS_REF ASDrf_nEng_DST /end AXIS_DESCR
/end CHARACTERISTIC
/begin CHARACTERISTIC ASDrf_tiNegLeadFFV_GM "time constant Lead path for FFV" MAP 0x80509883 RB_MapGroup_U8 2.550 t_q0p01 0.00 2.550 FORMAT "%5.3"
 /begin AXIS_DESCR COM_AXIS ASDrf_tqCluBasc Trq 5 -3276.800 3276.700 FORMAT "%8.3" AXIS_PTS_REF ASDrf_trqClthBs_DST /end AXIS_DESCR
 /begin AXIS_DESCR COM_AXIS Epm_nEng EngN 8 -16384.00 16383.50 FORMAT "%8.2" AXIS_PTS_REF ASDrf_nEng_DST /end AXIS_DESCR
/end CHARACTERISTIC
/begin CHARACTERISTIC ASDrf_tiNegLead_GMAP "time constant Lead path" MAP 0x805098AB RB_MapGroup_U8 2.550 t_q0p01 0.00 2.550 FORMAT "%5.3"
 /begin AXIS_DESCR COM_AXIS ASDrf_tqCluBasc Trq 5 -3276.800 3276.700 FORMAT "%8.3" AXIS_PTS_REF ASDrf_trqClthBs_DST /end AXIS_DESCR
 /begin AXIS_DESCR COM_AXIS ASDrf_nPt EngN 8 -16384.00 16383.50 FORMAT "%8.2" AXIS_PTS_REF ASDrf_nPt_DST /end AXIS_DESCR
/end CHARACTERISTIC
/begin CHARACTERISTIC ASDrf_tiOscNeg_T "cycle duration negative load change" CURVE 0x8050B054 RB_Curve_S16_U16_Static 655.3500 t_q0p01 0.00 655.3500 FORMAT "%8.4"
 /begin AXIS_DESCR STD_AXIS Tra_numGear OneToOne 10 -128.0000 127.0000 FORMAT "%8.4" EXTENDED_LIMITS -32768.00 32767.00 DEPOSIT ABSOLUTE /end AXIS_DESCR
/end CHARACTERISTIC
/begin CHARACTERISTIC ASDrf_tiOscPos_T "cycle duration positive load change" CURVE 0x8050B07E RB_Curve_S16_U16_Static 655.3500 t_q0p01 0.00 655.3500 FORMAT "%8.4"
 /begin AXIS_DESCR STD_AXIS Tra_numGear OneToOne 10 -128.0000 127.0000 FORMAT "%8.4" EXTENDED_LIMITS -32768.00 32767.00 DEPOSIT ABSOLUTE /end AXIS_DESCR
/end CHARACTERISTIC
/begin CHARACTERISTIC ASDrf_tiSprtAirCdnrOnNegLead_GM "time constant Lead path for sport mode with AC on" MAP 0x805098D3 RB_MapGroup_U8 2.550 t_q0p01 0.00 2.550 FORMAT "%5.3"
 /begin AXIS_DESCR COM_AXIS ASDrf_tqCluBasc Trq 5 -3276.800 3276.700 FORMAT "%8.3" AXIS_PTS_REF ASDrf_trqClthBs_DST /end AXIS_DESCR
 /begin AXIS_DESCR COM_AXIS Epm_nEng EngN 8 -16384.00 16383.50 FORMAT "%8.2" AXIS_PTS_REF ASDrf_nEng_DST /end AXIS_DESCR
/end CHARACTERISTIC
/begin CHARACTERISTIC ASDrf_tiSprtNegLead_GM "time constant Lead path for sport mode" MAP 0x805098FB RB_MapGroup_U8 2.550 t_q0p01 0.00 2.550 FORMAT "%5.3"
 /begin AXIS_DESCR COM_AXIS ASDrf_tqCluBasc Trq 5 -3276.800 3276.700 FORMAT "%8.3" AXIS_PTS_REF ASDrf_trqClthBs_DST /end AXIS_DESCR
 /begin AXIS_DESCR COM_AXIS Epm_nEng EngN 8 -16384.00 16383.50 FORMAT "%8.2" AXIS_PTS_REF ASDrf_nEng_DST /end AXIS_DESCR
/end CHARACTERISTIC
/begin CHARACTERISTIC ASDrf_tqLimAbv_GT "Curve: upper limitation edge" CURVE 0x8050B0A8 RB_CurveGroup_S16 6553.500 md_sw_q0p1 -3276.800 3276.700 FORMAT "%8.3"
 /begin AXIS_DESCR COM_AXIS PT_rTrq TransR 8 -327.6800 327.6700 FORMAT "%8.4" AXIS_PTS_REF ASDrf_rTrq_DST /end AXIS_DESCR
/end CHARACTERISTIC
/begin CHARACTERISTIC ASDrf_tqLimBlw_GT "Curve: lower limitation edge" CURVE 0x8050B0B8 RB_CurveGroup_S16 6553.500 md_sw_q0p1 -3276.800 3276.700 FORMAT "%8.3"
 /begin AXIS_DESCR COM_AXIS PT_rTrq TransR 8 -327.6800 327.6700 FORMAT "%8.4" AXIS_PTS_REF ASDrf_rTrq_DST /end AXIS_DESCR
/end CHARACTERISTIC
/begin CHARACTERISTIC ASDrf_tqLimNegOff_C "offset to reference torque to break limitation" VALUE 0x8050B0C8 RB_Val_Ws16 6553.500 Trq -3276.800 3276.700 FORMAT "%8.3" /end CHARACTERISTIC
/begin CHARACTERISTIC ASDrf_tqLossEcoOffsMtModNegLeadAcOn_GT "offset to clutch torque zero in Eco manual transmission mode when AC is ON for negative case" CURVE 0x80509924 RB_CurveGroup_S16 6553.500 md_q0p1 -3276.800 3276.700 FORMAT "%8.3"
 /begin AXIS_DESCR COM_AXIS Epm_nEng EngN 8 -16384.00 16383.50 FORMAT "%8.2" AXIS_PTS_REF ASDrf_nEng_DST /end AXIS_DESCR
/end CHARACTERISTIC
/begin CHARACTERISTIC ASDrf_tqLossEcoOffsMtModNegLead_GT "offset to clutch torque zero in ECO manual transmission mode" CURVE 0x80509934 RB_CurveGroup_S16 6553.500 md_q0p1 -3276.800 3276.700 FORMAT "%8.3"
 /begin AXIS_DESCR COM_AXIS Epm_nEng EngN 8 -16384.00 16383.50 FORMAT "%8.2" AXIS_PTS_REF ASDrf_nEng_DST /end AXIS_DESCR
/end CHARACTERISTIC
/begin CHARACTERISTIC ASDrf_tqLossEcoOffsMtModPosLeadAcOn_GM "offset to clutch torque zero in Eco manual transmission mode when AC is ON for positive case" MAP 0x80509944 RB_MapGroup_S16 6553.500 md_q0p1 -3276.800 3276.700 FORMAT "%8.3"
 /begin AXIS_DESCR COM_AXIS ASDrf_facDesDyn Fact 10 -4.000000 3.999878 FORMAT "%8.6" AXIS_PTS_REF ASDrf_facDesDyn_DST /end AXIS_DESCR
 /begin AXIS_DESCR COM_AXIS Epm_nEng EngN 8 -16384.00 16383.50 FORMAT "%8.2" AXIS_PTS_REF ASDrf_nEng_DST /end AXIS_DESCR
/end CHARACTERISTIC
/begin CHARACTERISTIC ASDrf_tqLossEcoOffsMtModPosLead_GM "offset to clutch torque zero in Eco manual transmission mode" MAP 0x805099E4 RB_MapGroup_S16 6553.500 md_q0p1 -3276.800 3276.700 FORMAT "%8.3"
 /begin AXIS_DESCR COM_AXIS ASDrf_facDesDyn Fact 10 -4.000000 3.999878 FORMAT "%8.6" AXIS_PTS_REF ASDrf_facDesDyn_DST /end AXIS_DESCR
 /begin AXIS_DESCR COM_AXIS Epm_nEng EngN 8 -16384.00 16383.50 FORMAT "%8.2" AXIS_PTS_REF ASDrf_nEng_DST /end AXIS_DESCR
/end CHARACTERISTIC
/begin CHARACTERISTIC ASDrf_tqLossEcoOffsNegLead_GT "offset to clutch torque zero in Eco mode" CURVE 0x80509A84 RB_CurveGroup_S16 6553.500 md_q0p1 -3276.800 3276.700 FORMAT "%8.3"
 /begin AXIS_DESCR COM_AXIS Epm_nEng EngN 8 -16384.00 16383.50 FORMAT "%8.2" AXIS_PTS_REF ASDrf_nEng_DST /end AXIS_DESCR
/end CHARACTERISTIC
/begin CHARACTERISTIC ASDrf_tqLossEcoOffsPosLeadAcOn_GM "offset to clutch torque zero in Eco mode during AC On" MAP 0x80509A94 RB_MapGroup_S16 6553.500 md_q0p1 -3276.800 3276.700 FORMAT "%8.3"
 /begin AXIS_DESCR COM_AXIS ASDrf_facDesDyn Fact 10 -4.000000 3.999878 FORMAT "%8.6" AXIS_PTS_REF ASDrf_facDesDyn_DST /end AXIS_DESCR
 /begin AXIS_DESCR COM_AXIS Epm_nEng EngN 8 -16384.00 16383.50 FORMAT "%8.2" AXIS_PTS_REF ASDrf_nEng_DST /end AXIS_DESCR
/end CHARACTERISTIC
/begin CHARACTERISTIC ASDrf_tqLossEcoOffsPosLead_GM "offset to clutch torque zero in Eco mode" MAP 0x80509B34 RB_MapGroup_S16 6553.500 md_q0p1 -3276.800 3276.700 FORMAT "%8.3"
 /begin AXIS_DESCR COM_AXIS ASDrf_facDesDyn Fact 10 -4.000000 3.999878 FORMAT "%8.6" AXIS_PTS_REF ASDrf_facDesDyn_DST /end AXIS_DESCR
 /begin AXIS_DESCR COM_AXIS Epm_nEng EngN 8 -16384.00 16383.50 FORMAT "%8.2" AXIS_PTS_REF ASDrf_nEng_DST /end AXIS_DESCR
/end CHARACTERISTIC
/begin CHARACTERISTIC ASDrf_tqLossEcoOfsAirCdnrOnNegLead_GT "offset to clutch torque zero for AC on in Eco mode" CURVE 0x80509BD4 RB_CurveGroup_S16 6553.500 md_q0p1 -3276.800 3276.700 FORMAT "%8.3"
 /begin AXIS_DESCR COM_AXIS Epm_nEng EngN 8 -16384.00 16383.50 FORMAT "%8.2" AXIS_PTS_REF ASDrf_nEng_DST /end AXIS_DESCR
/end CHARACTERISTIC
/begin CHARACTERISTIC ASDrf_tqLossOffsMtModNegLeadAcOn_GT "offset to clutch torque zero in manual transmission mode when AC is ON for negative case" CURVE 0x80509BE4 RB_CurveGroup_S16 6553.500 md_q0p1 -3276.800 3276.700 FORMAT "%8.3"
 /begin AXIS_DESCR COM_AXIS Epm_nEng EngN 8 -16384.00 16383.50 FORMAT "%8.2" AXIS_PTS_REF ASDrf_nEng_DST /end AXIS_DESCR
/end CHARACTERISTIC
/begin CHARACTERISTIC ASDrf_tqLossOffsMtModNegLeadFFVAcOn_GT "offset to clutch torque zero in manual transmission mode for flex fuel when AC is ON for negative case" CURVE 0x80509BF4 RB_CurveGroup_S16 6553.500 md_q0p1 -3276.800 3276.700 FORMAT "%8.3"
 /begin AXIS_DESCR COM_AXIS Epm_nEng EngN 8 -16384.00 16383.50 FORMAT "%8.2" AXIS_PTS_REF ASDrf_nEng_DST /end AXIS_DESCR
/end CHARACTERISTIC
/begin CHARACTERISTIC ASDrf_tqLossOffsMtModNegLeadFFV_GT "offset to clutch torque zero in manual transmission mode for FFV" CURVE 0x80509C04 RB_CurveGroup_S16 6553.500 md_q0p1 -3276.800 3276.700 FORMAT "%8.3"
 /begin AXIS_DESCR COM_AXIS Epm_nEng EngN 8 -16384.00 16383.50 FORMAT "%8.2" AXIS_PTS_REF ASDrf_nEng_DST /end AXIS_DESCR
/end CHARACTERISTIC
/begin CHARACTERISTIC ASDrf_tqLossOffsMtModNegLead_GT "offset to clutch torque zero in manual transmission mode" CURVE 0x80509C14 RB_CurveGroup_S16 6553.500 md_q0p1 -3276.800 3276.700 FORMAT "%8.3"
 /begin AXIS_DESCR COM_AXIS Epm_nEng EngN 8 -16384.00 16383.50 FORMAT "%8.2" AXIS_PTS_REF ASDrf_nEng_DST /end AXIS_DESCR
/end CHARACTERISTIC
/begin CHARACTERISTIC ASDrf_tqLossOffsMtModPosLeadAcOn_GM "offset to clutch torque zero in manual transmission mode when AC is ON for positive case" MAP 0x80509C24 RB_MapGroup_S16 6553.500 md_q0p1 -3276.800 3276.700 FORMAT "%8.3"
 /begin AXIS_DESCR COM_AXIS ASDrf_facDesDyn Fact 10 -4.000000 3.999878 FORMAT "%8.6" AXIS_PTS_REF ASDrf_facDesDyn_DST /end AXIS_DESCR
 /begin AXIS_DESCR COM_AXIS Epm_nEng EngN 8 -16384.00 16383.50 FORMAT "%8.2" AXIS_PTS_REF ASDrf_nEng_DST /end AXIS_DESCR
/end CHARACTERISTIC
/begin CHARACTERISTIC ASDrf_tqLossOffsMtModPosLeadFFVAcOn_GM "offset to clutch torque zero in manual transmission mode for flex fuel when AC is ON for positive case" MAP 0x80509CC4 RB_MapGroup_S16 6553.500 md_q0p1 -3276.800 3276.700 FORMAT "%8.3"
 /begin AXIS_DESCR COM_AXIS ASDrf_facDesDyn Fact 10 -4.000000 3.999878 FORMAT "%8.6" AXIS_PTS_REF ASDrf_facDesDyn_DST /end AXIS_DESCR
 /begin AXIS_DESCR COM_AXIS Epm_nEng EngN 8 -16384.00 16383.50 FORMAT "%8.2" AXIS_PTS_REF ASDrf_nEng_DST /end AXIS_DESCR
/end CHARACTERISTIC
/begin CHARACTERISTIC ASDrf_tqLossOffsMtModPosLeadFFV_GM "offset to clutch torque zero in manual transmission mode for FFV" MAP 0x80509D64 RB_MapGroup_S16 6553.500 md_q0p1 -3276.800 3276.700 FORMAT "%8.3"
 /begin AXIS_DESCR COM_AXIS ASDrf_facDesDyn Fact 10 -4.000000 3.999878 FORMAT "%8.6" AXIS_PTS_REF ASDrf_facDesDyn_DST /end AXIS_DESCR
 /begin AXIS_DESCR COM_AXIS Epm_nEng EngN 8 -16384.00 16383.50 FORMAT "%8.2" AXIS_PTS_REF ASDrf_nEng_DST /end AXIS_DESCR
/end CHARACTERISTIC
/begin CHARACTERISTIC ASDrf_tqLossOffsMtModPosLead_GM "offset to clutch torque zero in manual transmission mode" MAP 0x80509E04 RB_MapGroup_S16 6553.500 md_q0p1 -3276.800 3276.700 FORMAT "%8.3"
 /begin AXIS_DESCR COM_AXIS ASDrf_facDesDyn Fact 10 -4.000000 3.999878 FORMAT "%8.6" AXIS_PTS_REF ASDrf_facDesDyn_DST /end AXIS_DESCR
 /begin AXIS_DESCR COM_AXIS Epm_nEng EngN 8 -16384.00 16383.50 FORMAT "%8.2" AXIS_PTS_REF ASDrf_nEng_DST /end AXIS_DESCR
/end CHARACTERISTIC
/begin CHARACTERISTIC ASDrf_tqLossOffsNegLeadFFVAcOn_GT "offset to clutch torque zero for FFV during AC On" CURVE 0x80509EA4 RB_CurveGroup_S16 6553.500 md_q0p1 -3276.800 3276.700 FORMAT "%8.3"
 /begin AXIS_DESCR COM_AXIS Epm_nEng EngN 8 -16384.00 16383.50 FORMAT "%8.2" AXIS_PTS_REF ASDrf_nEng_DST /end AXIS_DESCR
/end CHARACTERISTIC
/begin CHARACTERISTIC ASDrf_tqLossOffsNegLeadFFV_GT "offset to clutch torque zero for FFV" CURVE 0x80509EB4 RB_CurveGroup_S16 6553.500 md_q0p1 -3276.800 3276.700 FORMAT "%8.3"
 /begin AXIS_DESCR COM_AXIS Epm_nEng EngN 8 -16384.00 16383.50 FORMAT "%8.2" AXIS_PTS_REF ASDrf_nEng_DST /end AXIS_DESCR
/end CHARACTERISTIC
/begin CHARACTERISTIC ASDrf_tqLossOffsPosLeadFFVAcOn_GM "offset to clutch torque zero for FFV during AC On" MAP 0x80509EC4 RB_MapGroup_S16 6553.500 md_q0p1 -3276.800 3276.700 FORMAT "%8.3"
 /begin AXIS_DESCR COM_AXIS ASDrf_facDesDyn Fact 10 -4.000000 3.999878 FORMAT "%8.6" AXIS_PTS_REF ASDrf_facDesDyn_DST /end AXIS_DESCR
 /begin AXIS_DESCR COM_AXIS Epm_nEng EngN 8 -16384.00 16383.50 FORMAT "%8.2" AXIS_PTS_REF ASDrf_nEng_DST /end AXIS_DESCR
/end CHARACTERISTIC
/begin CHARACTERISTIC ASDrf_tqLossOffsPosLeadFFV_GM "offset to clutch torque zero for FFV" MAP 0x80509F64 RB_MapGroup_S16 6553.500 md_q0p1 -3276.800 3276.700 FORMAT "%8.3"
 /begin AXIS_DESCR COM_AXIS ASDrf_facDesDyn Fact 10 -4.000000 3.999878 FORMAT "%8.6" AXIS_PTS_REF ASDrf_facDesDyn_DST /end AXIS_DESCR
 /begin AXIS_DESCR COM_AXIS Epm_nEng EngN 8 -16384.00 16383.50 FORMAT "%8.2" AXIS_PTS_REF ASDrf_nEng_DST /end AXIS_DESCR
/end CHARACTERISTIC
/begin CHARACTERISTIC ASDrf_tqLossOffsSlipOpenEco_GM "Offset to Loss-torque for init at open converter clutch (ASDrf_bNoRmp), to avoid dopple crossing of engine speed for ECO mode" MAP 0x8050B0CA RB_MapGroup_S16 6553.500 md_q0p1 -3276.800 3276.700 FORMAT "%8.3"
 /begin AXIS_DESCR COM_AXIS PT_rTrq TransR 8 -327.6800 327.6700 FORMAT "%8.4" AXIS_PTS_REF ASDrf_rTrq_DST /end AXIS_DESCR
 /begin AXIS_DESCR COM_AXIS APP_r Prc 10 -400.0000 399.9878 FORMAT "%8.4" AXIS_PTS_REF ASDrf_ratApp_DST /end AXIS_DESCR
/end CHARACTERISTIC
/begin CHARACTERISTIC ASDrf_tqLossOffsSlipOpenPos_GM "Offset to Loss-torque for init at open converter clutch (ASDrf_bNoRmp), to avoid dopple crossing of engine speed." MAP 0x8050B16A RB_MapGroup_S16 6553.500 md_q0p1 -3276.800 3276.700 FORMAT "%8.3"
 /begin AXIS_DESCR COM_AXIS PT_rTrq TransR 8 -327.6800 327.6700 FORMAT "%8.4" AXIS_PTS_REF ASDrf_rTrq_DST /end AXIS_DESCR
 /begin AXIS_DESCR COM_AXIS APP_r Prc 10 -400.0000 399.9878 FORMAT "%8.4" AXIS_PTS_REF ASDrf_ratApp_DST /end AXIS_DESCR
/end CHARACTERISTIC
/begin CHARACTERISTIC ASDrf_tqLossOffsSlipOpenSpt_GM "Offset to Loss-torque for init at open converter clutch (ASDrf_bNoRmp), to avoid dopple crossing of engine speed for Sport mode" MAP 0x8050B20A RB_MapGroup_S16 6553.500 md_q0p1 -3276.800 3276.700 FORMAT "%8.3"
 /begin AXIS_DESCR COM_AXIS PT_rTrq TransR 8 -327.6800 327.6700 FORMAT "%8.4" AXIS_PTS_REF ASDrf_rTrq_DST /end AXIS_DESCR
 /begin AXIS_DESCR COM_AXIS APP_r Prc 10 -400.0000 399.9878 FORMAT "%8.4" AXIS_PTS_REF ASDrf_ratApp_DST /end AXIS_DESCR
/end CHARACTERISTIC
/begin CHARACTERISTIC ASDrf_tqLossOffsSlipOpenTrsmMt_GM "Offset to Loss-torque for init at open converter clutch (ASDrf_bNoRmp), to avoid dopple crossing of engine speed for manual transmission" MAP 0x8050B2AA RB_MapGroup_S16 6553.500 md_q0p1 -3276.800 3276.700 FORMAT "%8.3"
 /begin AXIS_DESCR COM_AXIS PT_rTrq TransR 8 -327.6800 327.6700 FORMAT "%8.4" AXIS_PTS_REF ASDrf_rTrq_DST /end AXIS_DESCR
 /begin AXIS_DESCR COM_AXIS APP_r Prc 10 -400.0000 399.9878 FORMAT "%8.4" AXIS_PTS_REF ASDrf_ratApp_DST /end AXIS_DESCR
/end CHARACTERISTIC
/begin CHARACTERISTIC ASDrf_tqLossSprtAirCdnrOnOffsNegLead_GT "offset to clutch torque zero in sport mode with AC on" CURVE 0x8050A004 RB_CurveGroup_S16 6553.500 md_q0p1 -3276.800 3276.700 FORMAT "%8.3"
 /begin AXIS_DESCR COM_AXIS Epm_nEng EngN 8 -16384.00 16383.50 FORMAT "%8.2" AXIS_PTS_REF ASDrf_nEng_DST /end AXIS_DESCR
/end CHARACTERISTIC
/begin CHARACTERISTIC ASDrf_tqLossSprtAirCdnrOnOffsPosLead_GM "offset to clutch torque zero in sport mode with AC on" MAP 0x8050A014 RB_MapGroup_S16 6553.500 md_q0p1 -3276.800 3276.700 FORMAT "%8.3"
 /begin AXIS_DESCR COM_AXIS ASDrf_facDesDyn Fact 10 -4.000000 3.999878 FORMAT "%8.6" AXIS_PTS_REF ASDrf_facDesDyn_DST /end AXIS_DESCR
 /begin AXIS_DESCR COM_AXIS Epm_nEng EngN 8 -16384.00 16383.50 FORMAT "%8.2" AXIS_PTS_REF ASDrf_nEng_DST /end AXIS_DESCR
/end CHARACTERISTIC
/begin CHARACTERISTIC ASDrf_tqLossSprtOffsMtModNegLead_GT "offset to clutch torque zero in sport manual transmission mode" CURVE 0x8050A0B4 RB_CurveGroup_S16 6553.500 md_q0p1 -3276.800 3276.700 FORMAT "%8.3"
 /begin AXIS_DESCR COM_AXIS Epm_nEng EngN 8 -16384.00 16383.50 FORMAT "%8.2" AXIS_PTS_REF ASDrf_nEng_DST /end AXIS_DESCR
/end CHARACTERISTIC
/begin CHARACTERISTIC ASDrf_tqLossSprtOffsMtModPosLead_GM "offset to clutch torque zero in sport manual transmission mode" MAP 0x8050A0C4 RB_MapGroup_S16 6553.500 md_q0p1 -3276.800 3276.700 FORMAT "%8.3"
 /begin AXIS_DESCR COM_AXIS ASDrf_facDesDyn Fact 10 -4.000000 3.999878 FORMAT "%8.6" AXIS_PTS_REF ASDrf_facDesDyn_DST /end AXIS_DESCR
 /begin AXIS_DESCR COM_AXIS Epm_nEng EngN 8 -16384.00 16383.50 FORMAT "%8.2" AXIS_PTS_REF ASDrf_nEng_DST /end AXIS_DESCR
/end CHARACTERISTIC
/begin CHARACTERISTIC ASDrf_tqLossSprtOffsNegLead_GT "offset to clutch torque zero in sport mode" CURVE 0x8050A164 RB_CurveGroup_S16 6553.500 md_q0p1 -3276.800 3276.700 FORMAT "%8.3"
 /begin AXIS_DESCR COM_AXIS Epm_nEng EngN 8 -16384.00 16383.50 FORMAT "%8.2" AXIS_PTS_REF ASDrf_nEng_DST /end AXIS_DESCR
/end CHARACTERISTIC
/begin CHARACTERISTIC ASDrf_tqLossSprtOffsPosLead_GM "offset to clutch torque zero in sport mode" MAP 0x8050A174 RB_MapGroup_S16 6553.500 md_q0p1 -3276.800 3276.700 FORMAT "%8.3"
 /begin AXIS_DESCR COM_AXIS ASDrf_facDesDyn Fact 10 -4.000000 3.999878 FORMAT "%8.6" AXIS_PTS_REF ASDrf_facDesDyn_DST /end AXIS_DESCR
 /begin AXIS_DESCR COM_AXIS Epm_nEng EngN 8 -16384.00 16383.50 FORMAT "%8.2" AXIS_PTS_REF ASDrf_nEng_DST /end AXIS_DESCR
/end CHARACTERISTIC
/begin CHARACTERISTIC ASDrf_tqLossSptOffsMtModNegLeadAcOn_GT "offset to clutch torque zero in Sport manual transmission mode when AC is ON for negative case" CURVE 0x8050A214 RB_CurveGroup_S16 6553.500 md_q0p1 -3276.800 3276.700 FORMAT "%8.3"
 /begin AXIS_DESCR COM_AXIS Epm_nEng EngN 8 -16384.00 16383.50 FORMAT "%8.2" AXIS_PTS_REF ASDrf_nEng_DST /end AXIS_DESCR
/end CHARACTERISTIC
/begin CHARACTERISTIC ASDrf_tqLossSptOffsMtModPosLeadAcOn_GM "offset to clutch torque zero in Sport manual transmission mode when AC is ON for positive case" MAP 0x8050A224 RB_MapGroup_S16 6553.500 md_q0p1 -3276.800 3276.700 FORMAT "%8.3"
 /begin AXIS_DESCR COM_AXIS ASDrf_facDesDyn Fact 10 -4.000000 3.999878 FORMAT "%8.6" AXIS_PTS_REF ASDrf_facDesDyn_DST /end AXIS_DESCR
 /begin AXIS_DESCR COM_AXIS Epm_nEng EngN 8 -16384.00 16383.50 FORMAT "%8.2" AXIS_PTS_REF ASDrf_nEng_DST /end AXIS_DESCR
/end CHARACTERISTIC
/begin CHARACTERISTIC ASDrf_tqOffNeg_M "offset for reference torque negative load change" MAP 0x8050B34A RB_Map_S16S16_S16 6553.500 Trq -3276.800 3276.700 FORMAT "%8.3"
 /begin AXIS_DESCR STD_AXIS ASDrf_tqAct md_sw_q0p1 5 -3276.800 3276.700 FORMAT "%8.3" DEPOSIT ABSOLUTE /end AXIS_DESCR
 /begin AXIS_DESCR STD_AXIS Epm_nEng EngN 6 -16384.00 16383.50 FORMAT "%8.2" DEPOSIT ABSOLUTE /end AXIS_DESCR
/end CHARACTERISTIC
/begin CHARACTERISTIC ASDrf_tqOffPos_M "offset for reference torque positive load change" MAP 0x8050B3A0 RB_Map_S16S16_S16 6553.500 Trq -3276.800 3276.700 FORMAT "%8.3"
 /begin AXIS_DESCR STD_AXIS ASDrf_facDesDyn Fact 5 -4.000000 3.999878 FORMAT "%8.6" DEPOSIT ABSOLUTE /end AXIS_DESCR
 /begin AXIS_DESCR STD_AXIS Epm_nEng EngN 6 -16384.00 16383.50 FORMAT "%8.2" DEPOSIT ABSOLUTE /end AXIS_DESCR
/end CHARACTERISTIC
/begin CHARACTERISTIC ASDrf_tqOffsLimNegMin_C "offset to reference torque for limitation maximum torque at negative load change" VALUE 0x8050B3F6 RB_Val_Ws16 6553.500 md_sw_q0p1 -3276.800 3276.700 FORMAT "%8.3" /end CHARACTERISTIC
/begin CHARACTERISTIC ASDrf_tqOfsBasLim_C "offset to reference torque for limitation of requested set torque" VALUE 0x80508A98 RB_Val_Ws16 6553.500 md_sw_q0p1 -3276.800 3276.700 FORMAT "%8.3" /end CHARACTERISTIC
/begin CHARACTERISTIC ASDrf_tqThdEcoMtModNegLeadAcOn_C "Torque threshold for Lead path in Eco manual transmission mode when AC is ON for negative case" VALUE 0x8050A2C4 RB_Val_Ws16 6553.500 md_q0p1 -3276.800 3276.700 FORMAT "%8.3" /end CHARACTERISTIC
/begin CHARACTERISTIC ASDrf_tqThdEcoMtModNegLead_C "Torque threshold for Lead path in Eco manual transmission mode" VALUE 0x8050A2C6 RB_Val_Ws16 6553.500 md_q0p1 -3276.800 3276.700 FORMAT "%8.3" /end CHARACTERISTIC
/begin CHARACTERISTIC ASDrf_tqThdEcoMtModPosLeadAcOn_GM "Torque threshold for Lead path in Eco manual transmission mode when AC is ON for positive case" MAP 0x8050A2C8 RB_MapGroup_S16 6553.500 md_q0p1 -3276.800 3276.700 FORMAT "%8.3"
 /begin AXIS_DESCR COM_AXIS ASDrf_facDesDyn Fact 10 -4.000000 3.999878 FORMAT "%8.6" AXIS_PTS_REF ASDrf_facDesDyn_DST /end AXIS_DESCR
 /begin AXIS_DESCR COM_AXIS Epm_nEng EngN 8 -16384.00 16383.50 FORMAT "%8.2" AXIS_PTS_REF ASDrf_nEng_DST /end AXIS_DESCR
/end CHARACTERISTIC
/begin CHARACTERISTIC ASDrf_tqThdEcoMtModPosLead_GM "Torque threshold for Lead path in Eco manual transmission mode" MAP 0x8050A368 RB_MapGroup_S16 6553.500 md_q0p1 -3276.800 3276.700 FORMAT "%8.3"
 /begin AXIS_DESCR COM_AXIS ASDrf_facDesDyn Fact 10 -4.000000 3.999878 FORMAT "%8.6" AXIS_PTS_REF ASDrf_facDesDyn_DST /end AXIS_DESCR
 /begin AXIS_DESCR COM_AXIS Epm_nEng EngN 8 -16384.00 16383.50 FORMAT "%8.2" AXIS_PTS_REF ASDrf_nEng_DST /end AXIS_DESCR
/end CHARACTERISTIC
/begin CHARACTERISTIC ASDrf_tqThdEcoNegLeadAcOn_C "Torque threshold for Lead path in Eco mode with AC on" VALUE 0x8050A408 RB_Val_Ws16 6553.500 md_q0p1 -3276.800 3276.700 FORMAT "%8.3" /end CHARACTERISTIC
/begin CHARACTERISTIC ASDrf_tqThdEcoNegLead_C "Torque threshold for Lead path in Eco mode" VALUE 0x8050A40A RB_Val_Ws16 6553.500 md_q0p1 -3276.800 3276.700 FORMAT "%8.3" /end CHARACTERISTIC
/begin CHARACTERISTIC ASDrf_tqThdEcoPosLeadAcOn_GM "Torque threshold for Lead path in Eco mode during AC On" MAP 0x8050A40C RB_MapGroup_S16 6553.500 md_q0p1 -3276.800 3276.700 FORMAT "%8.3"
 /begin AXIS_DESCR COM_AXIS ASDrf_facDesDyn Fact 10 -4.000000 3.999878 FORMAT "%8.6" AXIS_PTS_REF ASDrf_facDesDyn_DST /end AXIS_DESCR
 /begin AXIS_DESCR COM_AXIS Epm_nEng EngN 8 -16384.00 16383.50 FORMAT "%8.2" AXIS_PTS_REF ASDrf_nEng_DST /end AXIS_DESCR
/end CHARACTERISTIC
/begin CHARACTERISTIC ASDrf_tqThdEcoPosLead_GM "Torque threshold for Lead path in Eco mode" MAP 0x8050A4AC RB_MapGroup_S16 6553.500 md_q0p1 -3276.800 3276.700 FORMAT "%8.3"
 /begin AXIS_DESCR COM_AXIS ASDrf_facDesDyn Fact 10 -4.000000 3.999878 FORMAT "%8.6" AXIS_PTS_REF ASDrf_facDesDyn_DST /end AXIS_DESCR
 /begin AXIS_DESCR COM_AXIS Epm_nEng EngN 8 -16384.00 16383.50 FORMAT "%8.2" AXIS_PTS_REF ASDrf_nEng_DST /end AXIS_DESCR
/end CHARACTERISTIC
/begin CHARACTERISTIC ASDrf_tqThdMtModNegLeadAcOn_C "Torque threshold for Lead path in manual transmission mode when AC is ON for negative case" VALUE 0x8050A54C RB_Val_Ws16 6553.500 md_q0p1 -3276.800 3276.700 FORMAT "%8.3" /end CHARACTERISTIC
/begin CHARACTERISTIC ASDrf_tqThdMtModNegLeadFFVAcOn_C "Torque threshold for Lead path in manual transmission mode for flex fuel when AC is ON for negative case" VALUE 0x8050A54E RB_Val_Ws16 6553.500 md_q0p1 -3276.800 3276.700 FORMAT "%8.3" /end CHARACTERISTIC
/begin CHARACTERISTIC ASDrf_tqThdMtModNegLeadFFV_C "Torque threshold for Lead path in manual transmission mode for FFV" VALUE 0x8050A550 RB_Val_Ws16 6553.500 md_q0p1 -3276.800 3276.700 FORMAT "%8.3" /end CHARACTERISTIC
/begin CHARACTERISTIC ASDrf_tqThdMtModNegLead_C "Torque threshold for Lead path in manual transmission mode" VALUE 0x8050A552 RB_Val_Ws16 6553.500 md_q0p1 -3276.800 3276.700 FORMAT "%8.3" /end CHARACTERISTIC
/begin CHARACTERISTIC ASDrf_tqThdMtModPosLeadAcOn_GM "Torque threshold for Lead path in manual transmission mode when AC is ON for positive case" MAP 0x8050A554 RB_MapGroup_S16 6553.500 md_q0p1 -3276.800 3276.700 FORMAT "%8.3"
 /begin AXIS_DESCR COM_AXIS ASDrf_facDesDyn Fact 10 -4.000000 3.999878 FORMAT "%8.6" AXIS_PTS_REF ASDrf_facDesDyn_DST /end AXIS_DESCR
 /begin AXIS_DESCR COM_AXIS Epm_nEng EngN 8 -16384.00 16383.50 FORMAT "%8.2" AXIS_PTS_REF ASDrf_nEng_DST /end AXIS_DESCR
/end CHARACTERISTIC
/begin CHARACTERISTIC ASDrf_tqThdMtModPosLeadFFVAcOn_GM "Torque threshold for Lead path in manual transmission for flex fuel mode when AC is ON for positive case" MAP 0x8050A5F4 RB_MapGroup_S16 6553.500 md_q0p1 -3276.800 3276.700 FORMAT "%8.3"
 /begin AXIS_DESCR COM_AXIS ASDrf_facDesDyn Fact 10 -4.000000 3.999878 FORMAT "%8.6" AXIS_PTS_REF ASDrf_facDesDyn_DST /end AXIS_DESCR
 /begin AXIS_DESCR COM_AXIS Epm_nEng EngN 8 -16384.00 16383.50 FORMAT "%8.2" AXIS_PTS_REF ASDrf_nEng_DST /end AXIS_DESCR
/end CHARACTERISTIC
/begin CHARACTERISTIC ASDrf_tqThdMtModPosLeadFFV_GM "Torque threshold for Lead path in manual transmission mode for FFV" MAP 0x8050A694 RB_MapGroup_S16 6553.500 md_q0p1 -3276.800 3276.700 FORMAT "%8.3"
 /begin AXIS_DESCR COM_AXIS ASDrf_facDesDyn Fact 10 -4.000000 3.999878 FORMAT "%8.6" AXIS_PTS_REF ASDrf_facDesDyn_DST /end AXIS_DESCR
 /begin AXIS_DESCR COM_AXIS Epm_nEng EngN 8 -16384.00 16383.50 FORMAT "%8.2" AXIS_PTS_REF ASDrf_nEng_DST /end AXIS_DESCR
/end CHARACTERISTIC
/begin CHARACTERISTIC ASDrf_tqThdMtModPosLead_GM "Torque threshold for Lead path in manual transmission mode" MAP 0x8050A734 RB_MapGroup_S16 6553.500 md_q0p1 -3276.800 3276.700 FORMAT "%8.3"
 /begin AXIS_DESCR COM_AXIS ASDrf_facDesDyn Fact 10 -4.000000 3.999878 FORMAT "%8.6" AXIS_PTS_REF ASDrf_facDesDyn_DST /end AXIS_DESCR
 /begin AXIS_DESCR COM_AXIS Epm_nEng EngN 8 -16384.00 16383.50 FORMAT "%8.2" AXIS_PTS_REF ASDrf_nEng_DST /end AXIS_DESCR
/end CHARACTERISTIC
/begin CHARACTERISTIC ASDrf_tqThdNegLeadFFVAcOn_C "Torque threshold for Lead path for FFV during AC On" VALUE 0x8050A7D4 RB_Val_Ws16 6553.500 md_q0p1 -3276.800 3276.700 FORMAT "%8.3" /end CHARACTERISTIC
/begin CHARACTERISTIC ASDrf_tqThdNegLeadFFV_C "Torque threshold for Lead path for FFV" VALUE 0x8050A7D6 RB_Val_Ws16 6553.500 md_q0p1 -3276.800 3276.700 FORMAT "%8.3" /end CHARACTERISTIC
/begin CHARACTERISTIC ASDrf_tqThdPosLeadFFVAcOn_GM "Torque threshold for Lead path for FFV during AC On" MAP 0x8050A7D8 RB_MapGroup_S16 6553.500 md_q0p1 -3276.800 3276.700 FORMAT "%8.3"
 /begin AXIS_DESCR COM_AXIS ASDrf_facDesDyn Fact 10 -4.000000 3.999878 FORMAT "%8.6" AXIS_PTS_REF ASDrf_facDesDyn_DST /end AXIS_DESCR
 /begin AXIS_DESCR COM_AXIS Epm_nEng EngN 8 -16384.00 16383.50 FORMAT "%8.2" AXIS_PTS_REF ASDrf_nEng_DST /end AXIS_DESCR
/end CHARACTERISTIC
/begin CHARACTERISTIC ASDrf_tqThdPosLeadFFV_GM "Torque threshold for Lead path for FFV" MAP 0x8050A878 RB_MapGroup_S16 6553.500 md_q0p1 -3276.800 3276.700 FORMAT "%8.3"
 /begin AXIS_DESCR COM_AXIS ASDrf_facDesDyn Fact 10 -4.000000 3.999878 FORMAT "%8.6" AXIS_PTS_REF ASDrf_facDesDyn_DST /end AXIS_DESCR
 /begin AXIS_DESCR COM_AXIS Epm_nEng EngN 8 -16384.00 16383.50 FORMAT "%8.2" AXIS_PTS_REF ASDrf_nEng_DST /end AXIS_DESCR
/end CHARACTERISTIC
/begin CHARACTERISTIC ASDrf_tqThdSprtAirCdnrOnNegLead_C "Torque threshold for Lead path in sport mode with AC on" VALUE 0x8050A918 RB_Val_Ws16 6553.500 md_q0p1 -3276.800 3276.700 FORMAT "%8.3" /end CHARACTERISTIC
/begin CHARACTERISTIC ASDrf_tqThdSprtAirCdnrOnPosLead_GM "offset to clutch torque zero for AC on" MAP 0x8050A91A RB_MapGroup_S16 6553.500 md_q0p1 -3276.800 3276.700 FORMAT "%8.3"
 /begin AXIS_DESCR COM_AXIS ASDrf_facDesDyn Fact 10 -4.000000 3.999878 FORMAT "%8.6" AXIS_PTS_REF ASDrf_facDesDyn_DST /end AXIS_DESCR
 /begin AXIS_DESCR COM_AXIS Epm_nEng EngN 8 -16384.00 16383.50 FORMAT "%8.2" AXIS_PTS_REF ASDrf_nEng_DST /end AXIS_DESCR
/end CHARACTERISTIC
/begin CHARACTERISTIC ASDrf_tqThdSprtMtModNegLead_C "Torque threshold for Lead path in sport manual transmission mode" VALUE 0x8050A9BA RB_Val_Ws16 6553.500 md_q0p1 -3276.800 3276.700 FORMAT "%8.3" /end CHARACTERISTIC
/begin CHARACTERISTIC ASDrf_tqThdSprtMtModPosLead_GM "Torque threshold for Lead path in sport manual transmission mode" MAP 0x8050A9BC RB_MapGroup_S16 6553.500 md_q0p1 -3276.800 3276.700 FORMAT "%8.3"
 /begin AXIS_DESCR COM_AXIS ASDrf_facDesDyn Fact 10 -4.000000 3.999878 FORMAT "%8.6" AXIS_PTS_REF ASDrf_facDesDyn_DST /end AXIS_DESCR
 /begin AXIS_DESCR COM_AXIS Epm_nEng EngN 8 -16384.00 16383.50 FORMAT "%8.2" AXIS_PTS_REF ASDrf_nEng_DST /end AXIS_DESCR
/end CHARACTERISTIC
/begin CHARACTERISTIC ASDrf_tqThdSprtNegLead_C "Torque threshold for Lead path in sport mode" VALUE 0x8050AA5C RB_Val_Ws16 6553.500 md_q0p1 -3276.800 3276.700 FORMAT "%8.3" /end CHARACTERISTIC
/begin CHARACTERISTIC ASDrf_tqThdSprtPosLead_GM "Torque threshold for Lead path in sport mode" MAP 0x8050AA5E RB_MapGroup_S16 6553.500 md_q0p1 -3276.800 3276.700 FORMAT "%8.3"
 /begin AXIS_DESCR COM_AXIS ASDrf_facDesDyn Fact 10 -4.000000 3.999878 FORMAT "%8.6" AXIS_PTS_REF ASDrf_facDesDyn_DST /end AXIS_DESCR
 /begin AXIS_DESCR COM_AXIS Epm_nEng EngN 8 -16384.00 16383.50 FORMAT "%8.2" AXIS_PTS_REF ASDrf_nEng_DST /end AXIS_DESCR
/end CHARACTERISTIC
/begin CHARACTERISTIC ASDrf_tqThdSptMtModNegLeadAcOn_C "Torque threshold for Lead path in Sport manual transmission mode when AC is ON for negative case" VALUE 0x8050AAFE RB_Val_Ws16 6553.500 md_q0p1 -3276.800 3276.700 FORMAT "%8.3" /end CHARACTERISTIC
/begin CHARACTERISTIC ASDrf_tqThdSptMtModPosLeadAcOn_GM "Torque threshold for Lead path in Sport manual transmission mode when AC is ON for positive case" MAP 0x8050AB00 RB_MapGroup_S16 6553.500 md_q0p1 -3276.800 3276.700 FORMAT "%8.3"
 /begin AXIS_DESCR COM_AXIS ASDrf_facDesDyn Fact 10 -4.000000 3.999878 FORMAT "%8.6" AXIS_PTS_REF ASDrf_facDesDyn_DST /end AXIS_DESCR
 /begin AXIS_DESCR COM_AXIS Epm_nEng EngN 8 -16384.00 16383.50 FORMAT "%8.2" AXIS_PTS_REF ASDrf_nEng_DST /end AXIS_DESCR
/end CHARACTERISTIC
/begin AXIS_PTS ASDrf_trqClthBs_DST "basic torque on clutch level" 0x8050E99C ASDrf_tqCluBasc RB_Axis_S16 6553.500 Trq 5 -3276.800 3276.700 FORMAT "%8.3" DEPOSIT ABSOLUTE /end AXIS_PTS
/begin CHARACTERISTIC ASDrf_trqLeadPrfm_C "threshold for end of lead filter" VALUE 0x8050ABA0 RB_Val_Ws16 6553.500 md_q0p1 -3276.800 3276.700 FORMAT "%8.3" /end CHARACTERISTIC
/begin CHARACTERISTIC ASDrf_trqLosOfsAirCdnrOnNegLead_GT "offset to clutch torque zero in sport mode with AC on" CURVE 0x8050ABA2 RB_CurveGroup_S16 6553.500 md_q0p1 -3276.800 3276.700 FORMAT "%8.3"
 /begin AXIS_DESCR COM_AXIS Epm_nEng EngN 8 -16384.00 16383.50 FORMAT "%8.2" AXIS_PTS_REF ASDrf_nEng_DST /end AXIS_DESCR
/end CHARACTERISTIC
/begin CHARACTERISTIC ASDrf_trqLosOfsLeadSlipOpn_GMAP "offset to initialisation of torque range during open converter clutch" MAP 0x8050ABB2 RB_MapGroup_S16 6553.500 md_q0p1 -3276.800 3276.700 FORMAT "%8.3"
 /begin AXIS_DESCR COM_AXIS ASDrf_facDesDyn Fact 10 -4.000000 3.999878 FORMAT "%8.6" AXIS_PTS_REF ASDrf_facDesDyn_DST /end AXIS_DESCR
 /begin AXIS_DESCR COM_AXIS ASDrf_nPt EngN 8 -16384.00 16383.50 FORMAT "%8.2" AXIS_PTS_REF ASDrf_nPt_DST /end AXIS_DESCR
/end CHARACTERISTIC
/begin CHARACTERISTIC ASDrf_trqLosOfsNegLead_GCUR "offset to clutch torque zero" CURVE 0x8050AC52 RB_CurveGroup_S16 6553.500 md_q0p1 -3276.800 3276.700 FORMAT "%8.3"
 /begin AXIS_DESCR COM_AXIS Epm_nEng EngN 8 -16384.00 16383.50 FORMAT "%8.2" AXIS_PTS_REF ASDrf_nEng_DST /end AXIS_DESCR
/end CHARACTERISTIC
/begin CHARACTERISTIC ASDrf_trqLosOfsPosLeadAcOn_GMAP "offset to clutch torque zero during AC On" MAP 0x8050AC62 RB_MapGroup_S16 6553.500 md_q0p1 -3276.800 3276.700 FORMAT "%8.3"
 /begin AXIS_DESCR COM_AXIS ASDrf_facDesDyn Fact 10 -4.000000 3.999878 FORMAT "%8.6" AXIS_PTS_REF ASDrf_facDesDyn_DST /end AXIS_DESCR
 /begin AXIS_DESCR COM_AXIS Epm_nEng EngN 8 -16384.00 16383.50 FORMAT "%8.2" AXIS_PTS_REF ASDrf_nEng_DST /end AXIS_DESCR
/end CHARACTERISTIC
/begin CHARACTERISTIC ASDrf_trqLosOfsPosLead_GMAP "offset to clutch torque zero" MAP 0x8050AD02 RB_MapGroup_S16 6553.500 md_q0p1 -3276.800 3276.700 FORMAT "%8.3"
 /begin AXIS_DESCR COM_AXIS ASDrf_facDesDyn Fact 10 -4.000000 3.999878 FORMAT "%8.6" AXIS_PTS_REF ASDrf_facDesDyn_DST /end AXIS_DESCR
 /begin AXIS_DESCR COM_AXIS Epm_nEng EngN 8 -16384.00 16383.50 FORMAT "%8.2" AXIS_PTS_REF ASDrf_nEng_DST /end AXIS_DESCR
/end CHARACTERISTIC
/begin CHARACTERISTIC ASDrf_trqOfsAirChrg_C "Upper limit of the torque band, during gradient limitation is activ,as offset to the torque by minimal charge (RngMod_trqMin AirChg)" VALUE 0x8050B3F8 RB_Val_Ws16 6553.500 md_q0p1 -3276.800 3276.700 FORMAT "%8.3" /end CHARACTERISTIC
/begin CHARACTERISTIC ASDrf_trqStrtRmpPos_C "neg. starting offset" VALUE 0x8050ADA2 RB_Val_Ws16 6553.500 md_q0p1 -3276.800 3276.700 FORMAT "%8.3" /end CHARACTERISTIC
/begin CHARACTERISTIC ASDrf_trqThresDet_C "Threshold for detection of driver's request gradient" VALUE 0x8050B3FA RB_Val_Wu8 25.50 md_sw_q0p1 0.00 25.50 FORMAT "%5.2" /end CHARACTERISTIC
/begin CHARACTERISTIC ASDrf_trqThresNegLeadAcOn_C "Torque threshold for Lead path with AC on" VALUE 0x8050ADA4 RB_Val_Ws16 6553.500 md_q0p1 -3276.800 3276.700 FORMAT "%8.3" /end CHARACTERISTIC
/begin CHARACTERISTIC ASDrf_trqThresNegLead_C "Torque threshold for Lead path" VALUE 0x8050ADA6 RB_Val_Ws16 6553.500 md_q0p1 -3276.800 3276.700 FORMAT "%8.3" /end CHARACTERISTIC
/begin CHARACTERISTIC ASDrf_trqThresPosLeadAcOn_GMAP "Torque threshold for Lead path during AC On" MAP 0x8050ADA8 RB_MapGroup_S16 6553.500 md_q0p1 -3276.800 3276.700 FORMAT "%8.3"
 /begin AXIS_DESCR COM_AXIS ASDrf_facDesDyn Fact 10 -4.000000 3.999878 FORMAT "%8.6" AXIS_PTS_REF ASDrf_facDesDyn_DST /end AXIS_DESCR
 /begin AXIS_DESCR COM_AXIS Epm_nEng EngN 8 -16384.00 16383.50 FORMAT "%8.2" AXIS_PTS_REF ASDrf_nEng_DST /end AXIS_DESCR
/end CHARACTERISTIC
/begin CHARACTERISTIC ASDrf_trqThresPosLead_GMAP "Torque threshold for Lead path" MAP 0x8050AE48 RB_MapGroup_S16 6553.500 md_q0p1 -3276.800 3276.700 FORMAT "%8.3"
 /begin AXIS_DESCR COM_AXIS ASDrf_facDesDyn Fact 10 -4.000000 3.999878 FORMAT "%8.6" AXIS_PTS_REF ASDrf_facDesDyn_DST /end AXIS_DESCR
 /begin AXIS_DESCR COM_AXIS Epm_nEng EngN 8 -16384.00 16383.50 FORMAT "%8.2" AXIS_PTS_REF ASDrf_nEng_DST /end AXIS_DESCR
/end CHARACTERISTIC
/begin MEASUREMENT APP_bT15Deb "Status T15 debounced with maximum debounce time" UBYTE B_TRUE 1 100 0.00 1.00000000000 BIT_MASK 0x1 FORMAT "%13.11" ECU_ADDRESS 0x6000F1B4 /end MEASUREMENT
/begin MEASUREMENT APP_bTempErr "Status temporary error" UBYTE B_TRUE 1 100 0.00 1.00000000000 BIT_MASK 0x1 FORMAT "%13.11" ECU_ADDRESS 0x6000FAF3 /end MEASUREMENT
/begin MEASUREMENT APP_cntrPostDrvLve "counter for state re-initialization" UBYTE OneToOne 1 100 0.00 255.0 FORMAT "%5.1" ECU_ADDRESS 0x6000F1B6 /end MEASUREMENT
/begin MEASUREMENT APP_dr "The deviation of accelerator pedal position at every 80ms" SWORD PrcPerSec 1 100 -20000.00 19999.39 FORMAT "%8.2" ECU_ADDRESS 0x60009C6C /end MEASUREMENT
/begin MEASUREMENT APP_drUnFlt "Acceleration pedal position gradient of unfilterd value" SWORD PrcPerSec 1 100 -20000.00 19999.39 FORMAT "%8.2" ECU_ADDRESS 0x60009C6A /end MEASUREMENT
/begin MEASUREMENT APP_flgATSActv "Acceleration pedal position ATS active status" UBYTE B_TRUE 1 100 0.00 1.00000000000 BIT_MASK 0x1 FORMAT "%13.11" ECU_ADDRESS 0x6000FAF2 /end MEASUREMENT
/begin MEASUREMENT App_flgLETVldActv "Acceleration pedal position Line End Tester request is active and valid" UBYTE B_TRUE 1 100 0.00 1.00000000000 BIT_MASK 0x1 FORMAT "%13.11" ECU_ADDRESS 0x6000FAD4 /end MEASUREMENT
/begin MEASUREMENT APP_r "Standardized accelerator pedal position" SWORD Prc 1 100 -400.0000 399.9878 FORMAT "%8.4" ECU_ADDRESS 0x6001476A /end MEASUREMENT
/begin MEASUREMENT APP_rAppPrev "APP raw value from sensor for COMDIA module" SWORD Prc 1 100 -400.0000 399.9878 FORMAT "%8.4" ECU_ADDRESS 0x60009C68 /end MEASUREMENT
/begin MEASUREMENT APP_rLET "Raw APP ratio from Line End Tester" SWORD Prc 1 100 -400.0000 399.9878 FORMAT "%8.4" ECU_ADDRESS 0x60009C66 /end MEASUREMENT
/begin MEASUREMENT APP_rLinRmp "acceleration pedal ratio by the switch between the two sets of linearisation parameters" SWORD Prc 1 100 -400.0000 399.9878 FORMAT "%8.4" ECU_ADDRESS 0x60008150 /end MEASUREMENT
/begin MEASUREMENT APP_rMaxLrnUnFlt "Acceleration pedal position maximum learned value unfiltered" SWORD Prc 1 100 -400.0000 399.9878 FORMAT "%8.4" ECU_ADDRESS 0x60009C64 /end MEASUREMENT
/begin MEASUREMENT APP_rOBDPID5A "Acceleration pedal OBD signal PID 5A" SWORD Prc 1 100 -400.0000 399.9878 FORMAT "%8.4" ECU_ADDRESS 0x70005274 /end MEASUREMENT
/begin MEASUREMENT APP_rUnFlt "Unfiltered APP value" SWORD Prc 1 100 -400.0000 399.9878 FORMAT "%8.4" ECU_ADDRESS 0x6001476C /end MEASUREMENT
/begin MEASUREMENT APP_rUnLimMaxLrnUnFlt "Learned acceleration pedal ratio by the acceleration brake plausibility in normal and limp mode" SWORD Prc 1 100 -400.0000 399.9878 FORMAT "%8.4" ECU_ADDRESS 0x6000814E /end MEASUREMENT
/begin MEASUREMENT APP_rUnLimMaxLrn_mp "APP Max learnt value not limited by alive detection" SWORD Prc 1 100 -400.0000 399.9878 FORMAT "%8.4" ECU_ADDRESS 0x7000A824 /end MEASUREMENT
/begin MEASUREMENT APP_stLETAbort "Line End Tester abort status" UBYTE B_TRUE 1 100 0.00 1.00000000000 BIT_MASK 0x1 FORMAT "%13.11" ECU_ADDRESS 0x6000FAF0 /end MEASUREMENT
/begin MEASUREMENT APP_stMaxLrnFixOffsPosnCalc "Offset voltage calculated status" UBYTE B_TRUE 1 100 0.00 1.00000000000 BIT_MASK 0x1 FORMAT "%13.11" ECU_ADDRESS 0x6000F1B5 /end MEASUREMENT
/begin MEASUREMENT APP_stSigSrc "Status of accelerator pedal" UBYTE OneToOne 1 100 0.00 255.0 FORMAT "%5.1" ECU_ADDRESS 0x6000FFEB /end MEASUREMENT
/begin MEASUREMENT APP_tiPhyHigh1DebDef "Defect debounce time for DFC_PhyHighAPP1" SWORD Time_ms 1 100 -327680.0 327670.0 FORMAT "%8.1" ECU_ADDRESS 0x60009C62 /end MEASUREMENT
/begin MEASUREMENT APP_tiPhyHigh1DebOk "Healing debounce time for DFC_PhyHighAPP1" SWORD Time_ms 1 100 -327680.0 327670.0 FORMAT "%8.1" ECU_ADDRESS 0x60009C60 /end MEASUREMENT
/begin MEASUREMENT APP_tiPhyHigh2DebDef "Defect debounce time for DFC_PhyHighAPP2" SWORD Time_ms 1 100 -327680.0 327670.0 FORMAT "%8.1" ECU_ADDRESS 0x60009C5E /end MEASUREMENT
/begin MEASUREMENT APP_tiPhyHigh2DebOk "Healing debounce time for DFC_PhyHighAPP2" SWORD Time_ms 1 100 -327680.0 327670.0 FORMAT "%8.1" ECU_ADDRESS 0x60009C5C /end MEASUREMENT
/begin MEASUREMENT APP_tiPhyLow1DebDef "Defect debounce time for DFC_PhyLowAPP1" SWORD Time_ms 1 100 -327680.0 327670.0 FORMAT "%8.1" ECU_ADDRESS 0x60009C5A /end MEASUREMENT
/begin MEASUREMENT APP_tiPhyLow1DebOk "Healing debounce time for DFC_PhyLowAPP1" SWORD Time_ms 1 100 -327680.0 327670.0 FORMAT "%8.1" ECU_ADDRESS 0x60009C58 /end MEASUREMENT
/begin MEASUREMENT APP_tiPhyLow2DebDef "Defect debounce time for DFC_PhyLowAPP2" SWORD Time_ms 1 100 -327680.0 327670.0 FORMAT "%8.1" ECU_ADDRESS 0x60009C56 /end MEASUREMENT
/begin MEASUREMENT APP_tiPhyLow2DebOk "Healing debounce time for DFC_PhyLowAPP2" SWORD Time_ms 1 100 -327680.0 327670.0 FORMAT "%8.1" ECU_ADDRESS 0x60009C54 /end MEASUREMENT
/begin MEASUREMENT APP_tiSRCHigh1DebDef "Duration of defect debouncing for check DFC_SRCHighAPP1" SWORD Time_ms 1 100 -327680.0 327670.0 FORMAT "%8.1" ECU_ADDRESS 0x60009C52 /end MEASUREMENT
/begin MEASUREMENT APP_tiSRCHigh1DebOk "Duration of healing debouncing for check DFC_SRCHighAPP1" SWORD Time_ms 1 100 -327680.0 327670.0 FORMAT "%8.1" ECU_ADDRESS 0x60009C50 /end MEASUREMENT
/begin MEASUREMENT APP_tiSRCHigh2DebDef "Duration of defect debouncing for check DFC_SRCHighAPP2" SWORD Time_ms 1 100 -327680.0 327670.0 FORMAT "%8.1" ECU_ADDRESS 0x60009C4E /end MEASUREMENT
/begin MEASUREMENT APP_tiSRCHigh2DebOk "Duration of healing debouncing for check DFC_SRCHighAPP2" SWORD Time_ms 1 100 -327680.0 327670.0 FORMAT "%8.1" ECU_ADDRESS 0x60009C4C /end MEASUREMENT
/begin MEASUREMENT APP_tiSRCLow1DebDef "Duration of defect debouncing for check DFC_SRCLowAPP1" SWORD Time_ms 1 100 -327680.0 327670.0 FORMAT "%8.1" ECU_ADDRESS 0x60009C4A /end MEASUREMENT
/begin MEASUREMENT APP_tiSRCLow1DebOk "Duration of healing debouncing for check DFC_SRCLowAPP1" SWORD Time_ms 1 100 -327680.0 327670.0 FORMAT "%8.1" ECU_ADDRESS 0x60009C48 /end MEASUREMENT
/begin MEASUREMENT APP_tiSRCLow2DebDef "Duration of defect debouncing for check DFC_SRCLowAPP2" SWORD Time_ms 1 100 -327680.0 327670.0 FORMAT "%8.1" ECU_ADDRESS 0x60009C46 /end MEASUREMENT
/begin MEASUREMENT APP_tiSRCLow2DebOk "Duration of healing debouncing for check DFC_SRCLowAPP2" SWORD Time_ms 1 100 -327680.0 327670.0 FORMAT "%8.1" ECU_ADDRESS 0x60009C44 /end MEASUREMENT
/begin MEASUREMENT APP_uMaxLrnFixOffsPosn "Voltage corresponding to APP_rAPPMaxLrnPosOffs_C offset position of dynamic curve" SWORD Volt 1 100 -6553.600 6553.400 FORMAT "%8.3" ECU_ADDRESS 0x6000814C /end MEASUREMENT
/begin MEASUREMENT APP_uPreUnJit1 "Acceleration pedal sensor 1 unjitterd signal" SWORD Volt 1 100 -6553.600 6553.400 FORMAT "%8.3" ECU_ADDRESS 0x6000814A /end MEASUREMENT
/begin MEASUREMENT APP_uPreUnJit2 "Acceleration pedal sensor 2 unjitterd signal" SWORD Volt 1 100 -6553.600 6553.400 FORMAT "%8.3" ECU_ADDRESS 0x7000527A /end MEASUREMENT
/begin MEASUREMENT APP_uRaw "Acceleration pedal position raw value" SWORD Volt 1 100 -6553.600 6553.400 FORMAT "%8.3" ECU_ADDRESS 0x60008152 /end MEASUREMENT
/begin MEASUREMENT APP_uRaw1 "Acceleration Pedal Position D" SWORD Volt 1 100 -6553.600 6553.400 FORMAT "%8.3" ECU_ADDRESS 0x70005352 /end MEASUREMENT
/begin MEASUREMENT APP_uRaw1Old "frozen value sensor 1" SWORD Volt 1 100 -6553.600 6553.400 FORMAT "%8.3" ECU_ADDRESS 0x7000527C /end MEASUREMENT
/begin MEASUREMENT APP_uRaw1unLim "Acceleration pedal sensor 1 unlimited raw value" SWORD Volt 1 100 -6553.600 6553.400 FORMAT "%8.3" ECU_ADDRESS 0x6001476E /end MEASUREMENT
/begin MEASUREMENT APP_uRaw2 "Acceleration Pedal Position E" SWORD Volt 1 100 -6553.600 6553.400 FORMAT "%8.3" ECU_ADDRESS 0x70005354 /end MEASUREMENT
/begin MEASUREMENT APP_uRaw2Old "frozen value sensor 2" SWORD Volt 1 100 -6553.600 6553.400 FORMAT "%8.3" ECU_ADDRESS 0x7000527E /end MEASUREMENT
/begin MEASUREMENT APP_uRaw2unLim "Acceleration pedal sensor 2 unlimited raw value" SWORD Volt 1 100 -6553.600 6553.400 FORMAT "%8.3" ECU_ADDRESS 0x70005356 /end MEASUREMENT
/begin MEASUREMENT APP_uUnJit "Acceleration pedal position unjittered value" SWORD Volt 1 100 -6553.600 6553.400 FORMAT "%8.3" ECU_ADDRESS 0x600011D6 /end MEASUREMENT
/begin MEASUREMENT ASDdc_bCalcMin "calculation minimal engine speed gradient active" UBYTE B_TRUE 1 100 0.00 1.00000000000 BIT_MASK 0x1 FORMAT "%13.11" ECU_ADDRESS 0x70003229 /end MEASUREMENT
/begin MEASUREMENT ASDdc_bCalcRmp "calculation ramp active" UBYTE B_TRUE 1 100 0.00 1.00000000000 BIT_MASK 0x1 FORMAT "%13.11" ECU_ADDRESS 0x70003228 /end MEASUREMENT
/begin MEASUREMENT ASDdc_bDstCActv "antijerking active on ENG" UBYTE B_TRUE 1 100 0.00 1.00000000000 BIT_MASK 0x1 FORMAT "%13.11" ECU_ADDRESS 0x7000364A /end MEASUREMENT
/begin MEASUREMENT ASDdc_bDstCActvAftFCO "antijerking active after fuel cut off" UBYTE B_TRUE 1 100 0.00 1.00000000000 BIT_MASK 0x1 FORMAT "%13.11" ECU_ADDRESS 0x70003649 /end MEASUREMENT
/begin MEASUREMENT ASDdc_bDstCActvEBNM_I.oldSignal "edge disturbance control active / EdgeBiNoMem.oldsignal" UBYTE B_TRUE 1 100 0.00 1.00000000000 BIT_MASK 0x1 FORMAT "%13.11" ECU_ADDRESS 0x50000947 /end MEASUREMENT
/begin MEASUREMENT ASDdc_bDstCActvEna "antijerking ready on ENG" UBYTE B_TRUE 1 100 0.00 1.00000000000 BIT_MASK 0x1 FORMAT "%13.11" ECU_ADDRESS 0x70003226 /end MEASUREMENT
/begin MEASUREMENT ASDdc_bDstCActvEnaTONVNM_I.time "turn on delay release disturbance control / Delay Time" UBYTE t_q0p01 1 100 0.00 2.550 FORMAT "%5.3" ECU_ADDRESS 0x6000F1AF /end MEASUREMENT
/begin MEASUREMENT ASDdc_bDyn "dynamic antijerk intervention active" UBYTE B_TRUE 1 100 0.00 1.00000000000 BIT_MASK 0x1 FORMAT "%13.11" ECU_ADDRESS 0x70003227 /end MEASUREMENT
/begin MEASUREMENT ASDdc_bGrip "grip for disturbance control" UBYTE B_TRUE 1 100 0.00 1.00000000000 BIT_MASK 0x1 FORMAT "%13.11" ECU_ADDRESS 0x6000FAEF /end MEASUREMENT
/begin MEASUREMENT ASDdc_bGripSlip "grip with consideration of converter respectively clutch slip" UBYTE B_TRUE 1 100 0.00 1.00000000000 BIT_MASK 0x1 FORMAT "%13.11" ECU_ADDRESS 0x6000F1B3 /end MEASUREMENT
/begin MEASUREMENT ASDdc_bGripTONV_I.outbit "turn on delay grip detection / return value" UBYTE B_TRUE 1 100 0.00 1.00000000000 BIT_MASK 0x1 FORMAT "%13.11" ECU_ADDRESS 0x6000813C /end MEASUREMENT
/begin MEASUREMENT ASDdc_bGripTONV_I.time "turn on delay grip detection / expired delay time" UBYTE t_q0p01 1 100 0.00 2.550 FORMAT "%5.3" ECU_ADDRESS 0x6000813D /end MEASUREMENT
/begin MEASUREMENT ASDdc_bSignChng "antijerk signal change" UBYTE B_TRUE 1 100 0.00 1.00000000000 BIT_MASK 0x1 FORMAT "%13.11" ECU_ADDRESS 0x70003648 /end MEASUREMENT
/begin MEASUREMENT ASDdc_cntDyn "dynamic counter" UBYTE t_q1p95em3 1 100 0.00 0.4980 ECU_ADDRESS 0x600008A8 /end MEASUREMENT
/begin MEASUREMENT ASDdc_cntDynIni "dynmaic counter initial value" UBYTE t_q1p95em3 1 100 0.0020 0.4980 ECU_ADDRESS 0x600008A9 /end MEASUREMENT
/begin MEASUREMENT ASDdc_ctIniDrvTrqCalcEng10ms "drive cycle counter 10ms-Eng-task" UBYTE OneToOne 1 100 0.00 255.0 FORMAT "%5.1" ECU_ADDRESS 0x6000F1B2 /end MEASUREMENT
/begin MEASUREMENT ASDdc_ctIniDrvTrqCalcPT10ms "drive cycle counter 10ms-PT-task" UBYTE OneToOne 1 100 0.00 255.0 FORMAT "%5.1" ECU_ADDRESS 0x6000F1B1 /end MEASUREMENT
/begin MEASUREMENT ASDdc_ctIniDrvTrqCalcSyncSx "drive cycle counter synchro-task" UBYTE OneToOne 1 100 0.00 255.0 FORMAT "%5.1" ECU_ADDRESS 0x50000948 /end MEASUREMENT
/begin MEASUREMENT ASDdc_D2T2nEng_I.B_bActvOld "D2T2 filter engine speed / Calculation active in last cycle" UBYTE B_TRUE 1 100 0.00 1.00000000000 BIT_MASK 0x1 FORMAT "%13.11" ECU_ADDRESS 0x50000190 /end MEASUREMENT
/begin MEASUREMENT ASDdc_D2T2nEng_I.B_bSigChg "D2T2 filter engine speed / signal change" UBYTE B_TRUE 1 100 0.00 1.00000000000 BIT_MASK 0x1 FORMAT "%13.11" ECU_ADDRESS 0x50000191 /end MEASUREMENT
/begin MEASUREMENT ASDdc_D2T2nEng_I.B_msbOld "D2T2 filter engine speed / signal change in last cycle" UBYTE B_TRUE 1 100 0.00 1.00000000000 BIT_MASK 0x1 FORMAT "%13.11" ECU_ADDRESS 0x50000192 /end MEASUREMENT
/begin MEASUREMENT ASDdc_D2T2nEng_I.mem1x_S32 "D2T2 filter engine speed / memory x1 for D2T2" SLONG fak_q0p00195 1 100 -4194304.00000 4194303.99805 FORMAT "%13.5" ECU_ADDRESS 0x50000194 /end MEASUREMENT
/begin MEASUREMENT ASDdc_D2T2nEng_I.mem1y_S32 "D2T2 filter engine speed / memory y1 for D2T2" SLONG fak_q0p00195 1 100 -4194304.00000 4194303.99805 FORMAT "%13.5" ECU_ADDRESS 0x50000198 /end MEASUREMENT
/begin MEASUREMENT ASDdc_D2T2nEng_I.mem2x_S32 "D2T2 filter engine speed / memory x2 for D2T2" SLONG fak_q0p00195 1 100 -4194304.00000 4194303.99805 FORMAT "%13.5" ECU_ADDRESS 0x5000019C /end MEASUREMENT
/begin MEASUREMENT ASDdc_D2T2nEng_I.mem2y_S32 "D2T2 filter engine speed / memory y2 for D2T2" SLONG fak_q0p00195 1 100 -4194304.00000 4194303.99805 FORMAT "%13.5" ECU_ADDRESS 0x500001A0 /end MEASUREMENT
/begin MEASUREMENT ASDdc_facEth "Ethanol content factor in fuel" UWORD fak_uw_b2 1 100 0.00 1.999969 FORMAT "%8.6" ECU_ADDRESS 0x60008148 /end MEASUREMENT
/begin MEASUREMENT ASDdc_facKd "correction factor amplification disturbance control" UWORD fak_uw_b2 1 100 0.00 1.999969 FORMAT "%8.6" ECU_ADDRESS 0x60008146 /end MEASUREMENT
/begin MEASUREMENT ASDdc_facTrq "antijerk factor for dynamic driving" UBYTE fak_ub_b2 1 100 0.00 1.000000 FORMAT "%8.6" ECU_ADDRESS 0x50000949 /end MEASUREMENT
/begin MEASUREMENT ASDdc_HMBActvFF_I.status "flip-flop HEM active / current value of RS-FF" UBYTE B_TRUE 1 100 0.00 1.00000000000 BIT_MASK 0x1 FORMAT "%13.11" ECU_ADDRESS 0x6000F1B0 /end MEASUREMENT
/begin MEASUREMENT ASDdc_KdDyn "Amplification of dynamic antijerking intervention" UBYTE q0p03125_Nm_DIV_rpm 1 100 0.00 7.969 FORMAT "%5.3" ECU_ADDRESS 0x6000092C /end MEASUREMENT
/begin MEASUREMENT ASDdc_KdDynCurr "actual Amplification of dynamic antijerking intervention" UBYTE q0p03125_Nm_DIV_rpm 1 100 0.00 7.969 FORMAT "%5.3" ECU_ADDRESS 0x50000946 /end MEASUREMENT
/begin MEASUREMENT ASDdc_nDiff "antijerk idle speed difference" SWORD EngN 1 100 -16384.00 16383.50 FORMAT "%8.2" ECU_ADDRESS 0x60008144 /end MEASUREMENT
/begin MEASUREMENT ASDdc_nEngOsc "antijerk: engine speed oscillation (out of D2T2 filter)" SWORD nmot_q0p5 1 100 -16384.00 16383.50 FORMAT "%8.2" ECU_ADDRESS 0x500007C0 /end MEASUREMENT
/begin MEASUREMENT ASDdc_nGradMin "antijerk engine speed gradient for dynamic drives" SWORD EngNGrd 1 100 -16384.00 16383.50 FORMAT "%8.2" ECU_ADDRESS 0x500006EE /end MEASUREMENT
/begin MEASUREMENT ASDdc_nPT "powertrain speed" SWORD EngN 1 100 -16384.00 16383.50 FORMAT "%8.2" ECU_ADDRESS 0x70005280 /end MEASUREMENT
/begin MEASUREMENT ASDdc_ratTq "powertrain torque ratio" SWORD TransR 1 100 -327.6800 327.6700 FORMAT "%8.4" ECU_ADDRESS 0x60008142 /end MEASUREMENT
/begin MEASUREMENT ASDdc_stShftOpTOFFV_I.outbit "turn off delay gear shift active / Output Bit" UBYTE B_TRUE 1 100 0.00 1.00000000000 BIT_MASK 0x1 FORMAT "%13.11" ECU_ADDRESS 0x6000813A /end MEASUREMENT
/begin MEASUREMENT ASDdc_stShftOpTOFFV_I.time "turn off delay gear shift active / Occured Time" UBYTE t_q0p01 1 100 0.00 2.550 FORMAT "%5.3" ECU_ADDRESS 0x6000813B /end MEASUREMENT
/begin MEASUREMENT ASDdc_tEng "antijerk engine temperature" UWORD Temp_Cels 1 100 -273.140 3003.560 FORMAT "%8.3" ECU_ADDRESS 0x60008140 /end MEASUREMENT
/begin MEASUREMENT ASDdc_tiPerDur "time constant for D2T2-model" UBYTE t_q1p95em3 1 100 0.0020 0.4980 ECU_ADDRESS 0x6000092E /end MEASUREMENT
/begin MEASUREMENT ASDdc_TOffVSyncDyn_I.outp "turn off delay dynamic disturbance control active / logical output turn off delay" UBYTE B_TRUE 1 100 0.00 1.00000000000 BIT_MASK 0x1 FORMAT "%13.11" ECU_ADDRESS 0x500001A4 /end MEASUREMENT
/begin MEASUREMENT ASDdc_TOffVSyncDyn_I.time "turn off delay dynamic disturbance control active / timer turn off delay" SLONG Per_Dur 1 100 -2147483648.00 2147483647.00 FORMAT "%13.2" ECU_ADDRESS 0x500001A8 /end MEASUREMENT
/begin MEASUREMENT ASDdc_TOffVSyncFadeOutDyn_I.outp "turn off delay fade out dynamic disturbance control active / logical output turn off delay" UBYTE B_TRUE 1 100 0.00 1.00000000000 BIT_MASK 0x1 FORMAT "%13.11" ECU_ADDRESS 0x500001AC /end MEASUREMENT
/begin MEASUREMENT ASDdc_TOffVSyncFadeOutDyn_I.time "turn off delay fade out dynamic disturbance control active / timer turn off delay" SLONG Per_Dur 1 100 -2147483648.00 2147483647.00 FORMAT "%13.2" ECU_ADDRESS 0x500001B0 /end MEASUREMENT
/begin MEASUREMENT ASDdc_trq "Torque Demand Disturbance Control" SWORD md_q0p1 1 100 -3276.800 3276.700 FORMAT "%8.3" ECU_ADDRESS 0x500007C2 /end MEASUREMENT
/begin MEASUREMENT ASDdc_trqClthAct "antijerk clutch torque" SWORD md_q0p1 1 100 -3276.800 3276.700 FORMAT "%8.3" ECU_ADDRESS 0x70005282 /end MEASUREMENT
/begin MEASUREMENT ASDdc_trqClthWoDstC "clutch torque without disturbance control" SWORD md_q0p1 1 100 -3276.800 3276.700 FORMAT "%8.3" ECU_ADDRESS 0x70005284 /end MEASUREMENT
/begin MEASUREMENT ASDdc_trqThresDyn "Threshold for dynamic antijerking intervention" SWORD md_q0p1 1 100 0.00 3276.700 FORMAT "%8.3" ECU_ADDRESS 0x60000632 /end MEASUREMENT
/begin MEASUREMENT ASDdc_v "antijerk vehicle speed" UWORD Vel 1 100 0.00 327.6700 FORMAT "%8.4" ECU_ADDRESS 0x6000813E /end MEASUREMENT
/begin MEASUREMENT ASDrf_barmed "check driveability filter without ramping activated" UBYTE B_TRUE 1 100 0.00 1.00000000000 BIT_MASK 0x1 FORMAT "%13.11" ECU_ADDRESS 0x6000F1A7 /end MEASUREMENT
/begin MEASUREMENT ASDrf_bBsBlw "status bit indicating base clutch torque in lead path is less than losses at clutch level" UBYTE B_TRUE 1 100 0.00 1.00000000000 BIT_MASK 0x1 FORMAT "%13.11" ECU_ADDRESS 0x6000F1AE /end MEASUREMENT
/begin MEASUREMENT ASDrf_bCtOffConDelEFNM_I.oldSignal "falling edge delayed release fuel cut off / memory to detect falling edge" UBYTE B_TRUE 1 100 0.00 1.00000000000 BIT_MASK 0x1 FORMAT "%13.11" ECU_ADDRESS 0x6000F19C /end MEASUREMENT
/begin MEASUREMENT ASDrf_bDelLeadActv "delay on lead path active" UBYTE B_TRUE 1 100 0.00 1.00000000000 BIT_MASK 0x1 FORMAT "%13.11" ECU_ADDRESS 0x6000F1AD /end MEASUREMENT
/begin MEASUREMENT ASDrf_bDelNeg "condition delay of reduction of airpath torque" UBYTE B_TRUE 1 100 0.00 1.00000000000 BIT_MASK 0x1 FORMAT "%13.11" ECU_ADDRESS 0x6000F1AC /end MEASUREMENT
/begin MEASUREMENT ASDrf_bFltDemLeadER_I.buffer "rising edge demand for torque filtering in lead path / rising edge detected" UBYTE B_TRUE 1 100 0.00 1.00000000000 BIT_MASK 0x1 FORMAT "%13.11" ECU_ADDRESS 0x70003224 /end MEASUREMENT
/begin MEASUREMENT ASDrf_bFltDemLeadER_I.oldSignal "rising edge demand for torque filtering in lead path / flag rising edge" UBYTE B_TRUE 1 100 0.00 1.00000000000 BIT_MASK 0x1 FORMAT "%13.11" ECU_ADDRESS 0x70003225 /end MEASUREMENT
/begin MEASUREMENT ASDrf_bFltNegLead "filtering in lead dashpot active" UBYTE B_TRUE 1 100 0.00 1.00000000000 BIT_MASK 0x1 FORMAT "%13.11" ECU_ADDRESS 0x6000F1AB /end MEASUREMENT
/begin MEASUREMENT ASDrf_bFltWoIA "variable dashpot without ignition angle" UBYTE B_TRUE 1 100 0.00 1.00000000000 BIT_MASK 0x1 FORMAT "%13.11" ECU_ADDRESS 0x6000F1A6 /end MEASUREMENT
/begin MEASUREMENT ASDrf_bLim "limitation active" UBYTE B_TRUE 1 100 0.00 1.00000000000 BIT_MASK 0x1 FORMAT "%13.11" ECU_ADDRESS 0x6000FAEB /end MEASUREMENT
/begin MEASUREMENT ASDrf_bNoRmp "realization of driveability without ramping" UBYTE B_TRUE 1 100 0.00 1.00000000000 BIT_MASK 0x1 FORMAT "%13.11" ECU_ADDRESS 0x6000FAE7 /end MEASUREMENT
/begin MEASUREMENT ASDrf_bNotNCmpOld "engine speed not lower than turbine speed last cycle" UBYTE B_TRUE 1 100 0.00 1.00000000000 BIT_MASK 0x1 FORMAT "%13.11" ECU_ADDRESS 0x6000F1A5 /end MEASUREMENT
/begin MEASUREMENT ASDrf_bPhyTqLyrHybCmpbl "Physical torque layer hybrid compatible system constant status" UBYTE B_TRUE 1 100 0.00 1.00000000000 BIT_MASK 0x1 FORMAT "%13.11" ECU_ADDRESS 0x6000F1A4 /end MEASUREMENT
/begin MEASUREMENT ASDrf_bPosNegDes "status driver request Sum" UBYTE B_TRUE 1 100 0.00 1.00000000000 BIT_MASK 0x1 FORMAT "%13.11" ECU_ADDRESS 0x6000FAE6 /end MEASUREMENT
/begin MEASUREMENT ASDrf_bPosNegLead "status driver request Lead" UBYTE B_TRUE 1 100 0.00 1.00000000000 BIT_MASK 0x1 FORMAT "%13.11" ECU_ADDRESS 0x6000FAE5 /end MEASUREMENT
/begin MEASUREMENT ASDrf_bRmpLeadActv "ramp on lead path active" UBYTE B_TRUE 1 100 0.00 1.00000000000 BIT_MASK 0x1 FORMAT "%13.11" ECU_ADDRESS 0x6000F1AA /end MEASUREMENT
/begin MEASUREMENT ASDrf_bRstEngSt "reset ASD due to engine state" UBYTE B_TRUE 1 100 0.00 1.00000000000 BIT_MASK 0x1 FORMAT "%13.11" ECU_ADDRESS 0x6000FAE4 /end MEASUREMENT
/begin MEASUREMENT ASDrf_bTrqDemDrv "Torque demand greater than SetPoint" UBYTE B_TRUE 1 100 0.00 1.00000000000 BIT_MASK 0x1 FORMAT "%13.11" ECU_ADDRESS 0x6000F19F /end MEASUREMENT
/begin MEASUREMENT ASDrf_cntrSigndnEng "counter constant engine speed gradient" SBYTE OneToOne 1 100 -128.0 127.0 FORMAT "%5.1" ECU_ADDRESS 0x6000F1A3 /end MEASUREMENT
/begin MEASUREMENT ASDrf_ctIniDrvFilter10ms "drive cycle counter 10ms-task" UBYTE OneToOne 1 100 0.00 255.0 FORMAT "%5.1" ECU_ADDRESS 0x60014A24 /end MEASUREMENT
/begin MEASUREMENT ASDrf_ctIniDrvLead10ms "drive cycle counter 10ms-task" UBYTE OneToOne 1 100 0.00 255.0 FORMAT "%5.1" ECU_ADDRESS 0x60014A25 /end MEASUREMENT
/begin MEASUREMENT ASDrf_ctIniDrvLimIA10ms "drive cycle counter 10ms-task" UBYTE OneToOne 1 100 0.00 255.0 FORMAT "%5.1" ECU_ADDRESS 0x60014A26 /end MEASUREMENT
/begin MEASUREMENT ASDrf_ctIniDrvMinMax10ms "drive cycle counter 10ms-task" UBYTE OneToOne 1 100 0.00 255.0 FORMAT "%5.1" ECU_ADDRESS 0x60014A27 /end MEASUREMENT
/begin MEASUREMENT ASDrf_ctIniDrvPosNeg10ms "drive cycle counter 10ms-task" UBYTE OneToOne 1 100 0.00 255.0 FORMAT "%5.1" ECU_ADDRESS 0x60014A28 /end MEASUREMENT
/begin MEASUREMENT ASDrf_DetnTqGrdtDes_I.bPosNeg "detection torque gradient of setpoint / status torque gradient" UBYTE B_TRUE 1 100 0.00 1.00000000000 BIT_MASK 0x1 FORMAT "%13.11" ECU_ADDRESS 0x6000F19E /end MEASUREMENT
/begin MEASUREMENT ASDrf_DetnTqGrdtLead_I.bPosNeg "detection torque gradient of airpath setpoint / status torque gradient" UBYTE B_TRUE 1 100 0.00 1.00000000000 BIT_MASK 0x1 FORMAT "%13.11" ECU_ADDRESS 0x6000F19D /end MEASUREMENT
/begin MEASUREMENT ASdrf_dn "difference engine speed gradient - filtered engine speed gradient" SWORD EngNGrd 1 100 -16384.00 16383.50 FORMAT "%8.2" ECU_ADDRESS 0x6000812C /end MEASUREMENT
/begin MEASUREMENT ASDrf_dndeltaMax "maximum change filtered engine speed gradient" SWORD EngNGrd 1 100 -16384.00 16383.50 FORMAT "%8.2" ECU_ADDRESS 0x6000812A /end MEASUREMENT
/begin MEASUREMENT ASdrf_dnEngFlt "filtered engine speed gradient" SWORD EngNGrd 1 100 -16384.00 16383.50 FORMAT "%8.2" ECU_ADDRESS 0x60008128 /end MEASUREMENT
/begin MEASUREMENT ASDrf_dtqNeg "maximum gradient of torque limitation negative load change" SWORD mdt_q0p1_Nm_DIV_s 1 100 -3276.800 3276.700 FORMAT "%8.3" ECU_ADDRESS 0x60008126 /end MEASUREMENT
/begin MEASUREMENT ASDrf_dtqPos "maximum gradient of torque limitation positive load change" SWORD mdt_q0p1_Nm_DIV_s 1 100 -3276.800 3276.700 FORMAT "%8.3" ECU_ADDRESS 0x60008124 /end MEASUREMENT
/begin MEASUREMENT ASDrf_dtrqRmp "gradient of limitation ramp" SWORD md_q0p1 1 100 -3276.800 3276.700 FORMAT "%8.3" ECU_ADDRESS 0x60008136 /end MEASUREMENT
/begin MEASUREMENT ASDrf_facStrtNeg "weighting factor for init-jump lead dashpot" UBYTE fak_ub_b2 1 100 0.00 1.000000 FORMAT "%8.6" ECU_ADDRESS 0x60014A2A /end MEASUREMENT
/begin MEASUREMENT ASDrf_flgNMax "flag engine speed maximum detected" UBYTE B_TRUE 1 100 0.00 1.00000000000 BIT_MASK 0x1 FORMAT "%13.11" ECU_ADDRESS 0x6000F1A2 /end MEASUREMENT
/begin MEASUREMENT ASDrf_flgnMaxEF_I.buffer "edge for detection engine speed maximum / memory to detect falling edge" UBYTE B_TRUE 1 100 0.00 1.00000000000 BIT_MASK 0x1 FORMAT "%13.11" ECU_ADDRESS 0x6000810C /end MEASUREMENT
/begin MEASUREMENT ASDrf_flgnMaxEF_I.oldSignal "edge for detection engine speed maximum / memory to detect falling edge" UBYTE B_TRUE 1 100 0.00 1.00000000000 BIT_MASK 0x1 FORMAT "%13.11" ECU_ADDRESS 0x6000810D /end MEASUREMENT
/begin MEASUREMENT ASDrf_flgNMaxTrig "trigger detection engine speed maximum" UBYTE B_TRUE 1 100 0.00 1.00000000000 BIT_MASK 0x1 FORMAT "%13.11" ECU_ADDRESS 0x6000F1A1 /end MEASUREMENT
/begin MEASUREMENT ASDrf_flgStrtRed "flag start torque reduction negative load change" UBYTE B_TRUE 1 100 0.00 1.00000000000 BIT_MASK 0x1 FORMAT "%13.11" ECU_ADDRESS 0x6000F1A0 /end MEASUREMENT
/begin MEASUREMENT ASDrf_Leadtimer "timer for delay lead torque increase" UBYTE t_q0p01 1 100 0.00 2.550 FORMAT "%5.3" ECU_ADDRESS 0x6000F1A9 /end MEASUREMENT
/begin MEASUREMENT ASDrf_posnegEB_I.buffer "edge load change / EdgeBi.buffer" UBYTE B_TRUE 1 100 0.00 1.00000000000 BIT_MASK 0x1 FORMAT "%13.11" ECU_ADDRESS 0x6000810A /end MEASUREMENT
/begin MEASUREMENT ASDrf_posnegEB_I.oldSignal "edge load change / EdgeBi.odlSignal" UBYTE B_TRUE 1 100 0.00 1.00000000000 BIT_MASK 0x1 FORMAT "%13.11" ECU_ADDRESS 0x6000810B /end MEASUREMENT
/begin MEASUREMENT ASDrf_stLimMinMax "status statemachine for MinMax-limitation" UBYTE dez 1 100 0.00 255.0 FORMAT "%5.1" ECU_ADDRESS 0x6000FFEA /end MEASUREMENT
/begin MEASUREMENT ASDrf_tiLead "time constant Lead path" UBYTE t_q0p01 1 100 0.010 2.550 FORMAT "%5.3" ECU_ADDRESS 0x6000F1A8 /end MEASUREMENT
/begin MEASUREMENT ASDrf_tiOscNeg "cycle duration negative load change" UWORD t_q0p01 1 100 0.00 655.3500 FORMAT "%8.4" ECU_ADDRESS 0x60008122 /end MEASUREMENT
/begin MEASUREMENT ASDrf_tiOscPos "cycle duration positive load change" UWORD t_q0p01 1 100 0.00 655.3500 FORMAT "%8.4" ECU_ADDRESS 0x60008120 /end MEASUREMENT
/begin MEASUREMENT ASDrf_tiPosNeg "time since last load change (positive or negative)" UWORD t_q0p01 1 100 0.00 655.3500 FORMAT "%8.4" ECU_ADDRESS 0x6000811E /end MEASUREMENT
/begin MEASUREMENT ASDrf_tqAct "actual engine torque - clutch torque" SWORD md_q0p1 1 100 -3276.800 3276.700 FORMAT "%8.3" ECU_ADDRESS 0x6000811C /end MEASUREMENT
/begin MEASUREMENT ASDrf_tqAirFric "air friction torque" SWORD Trq 1 100 0.00 3276.700 FORMAT "%8.3" ECU_ADDRESS 0x6000811A /end MEASUREMENT
/begin MEASUREMENT ASDrf_tqInrFltUnlimLT_I.memory "lowpass filter unlimited driver torque request / current lowpass value" SLONG dez 1 100 -2147483648.00 2147483647.00 FORMAT "%13.2" ECU_ADDRESS 0x60012EC0 /end MEASUREMENT
/begin MEASUREMENT ASDrf_tqLim "drive friction torque" SWORD md_sw_q0p1 1 100 0.00 3276.700 FORMAT "%8.3" ECU_ADDRESS 0x60008118 /end MEASUREMENT
/begin MEASUREMENT ASDrf_tqLimAbv "upper limitation edge" SWORD md_sw_q0p1 1 100 -3276.800 3276.700 FORMAT "%8.3" ECU_ADDRESS 0x70005288 /end MEASUREMENT
/begin MEASUREMENT ASDrf_tqLimBlw "lower limitation edge" SWORD md_sw_q0p1 1 100 -3276.800 3276.700 FORMAT "%8.3" ECU_ADDRESS 0x60013CA0 /end MEASUREMENT
/begin MEASUREMENT ASDrf_tqLimNeg "reference torque negative load change" SWORD Trq 1 100 -3276.800 3276.700 FORMAT "%8.3" ECU_ADDRESS 0x60008116 /end MEASUREMENT
/begin MEASUREMENT ASDrf_tqLimPos "reference torque positive load change" SWORD Trq 1 100 -3276.800 3276.700 FORMAT "%8.3" ECU_ADDRESS 0x60008114 /end MEASUREMENT
/begin MEASUREMENT ASDrf_tqLosComp "Loss compensation at Clutch level" SWORD Trq 1 100 -3276.800 3276.700 FORMAT "%8.3" ECU_ADDRESS 0x60008134 /end MEASUREMENT
/begin MEASUREMENT ASDrf_tqOffNeg "offset for reference torque negative load change" SWORD Trq 1 100 -3276.800 3276.700 FORMAT "%8.3" ECU_ADDRESS 0x60008112 /end MEASUREMENT
/begin MEASUREMENT ASDrf_tqOffPos "offset for reference torque positive load change" SWORD Trq 1 100 -3276.800 3276.700 FORMAT "%8.3" ECU_ADDRESS 0x60008110 /end MEASUREMENT
/begin MEASUREMENT ASDrf_tqRollFric "rolling friction torque" SWORD Trq 1 100 0.00 3276.700 FORMAT "%8.3" ECU_ADDRESS 0x6000810E /end MEASUREMENT
/begin MEASUREMENT ASDrf_tqTgtLeadLT_I.memory "lowpass filter target airpath torque / current lowpass value" SLONG Trq 1 100 -214748364.800 214748364.700 FORMAT "%13.3" ECU_ADDRESS 0x60003230 /end MEASUREMENT
/begin MEASUREMENT ASDrf_trqClthFlt "drivers wish torque filtered" SWORD Trq 1 100 -3276.800 3276.700 FORMAT "%8.3" ECU_ADDRESS 0x50005C8C /end MEASUREMENT
/begin MEASUREMENT ASDrf_trqClthFltUnlim "filtered unlimited driver demand torque on clutch level" SWORD Trq 1 100 -3276.800 3276.700 FORMAT "%8.3" ECU_ADDRESS 0x60009C2C /end MEASUREMENT
/begin MEASUREMENT ASDrf_trqClthLeadEng "filtered air torque demand" SWORD Trq 1 100 -3276.800 3276.700 FORMAT "%8.3" ECU_ADDRESS 0x60009C2A /end MEASUREMENT
/begin MEASUREMENT ASDrf_trqClthMax "Max torque for limitation" SWORD md_sw_q0p1 1 100 -3276.800 3276.700 FORMAT "%8.3" ECU_ADDRESS 0x60009C28 /end MEASUREMENT
/begin MEASUREMENT ASDrf_trqClthMin "Min torque for limitation" SWORD md_sw_q0p1 1 100 -3276.800 3276.700 FORMAT "%8.3" ECU_ADDRESS 0x60009C26 /end MEASUREMENT
/begin MEASUREMENT ASDrf_trqCluBsLim "Limited base Clutch torque" SWORD md_sw_q0p1 1 100 -3276.800 3276.700 FORMAT "%8.3" ECU_ADDRESS 0x60008138 /end MEASUREMENT
/begin MEASUREMENT ASDrf_trqFltDem "Input torque ASD reference filter" SWORD md_sw_q0p1 1 100 -3276.800 3276.700 FORMAT "%8.3" ECU_ADDRESS 0x7000528A /end MEASUREMENT
/begin MEASUREMENT ASDrf_trqIniLead "initial torque lead path" SWORD md_q0p1 1 100 -3276.800 3276.700 FORMAT "%8.3" ECU_ADDRESS 0x60008132 /end MEASUREMENT
/begin MEASUREMENT ASDrf_trqLosCmp "Torque loss compensation" SWORD Trq 1 100 -3276.800 3276.700 FORMAT "%8.3" ECU_ADDRESS 0x6000812E /end MEASUREMENT
/begin MEASUREMENT ASDrf_trqLosOfsLead "offset to clutch torque zero" SWORD md_q0p1 1 100 -3276.800 3276.700 FORMAT "%8.3" ECU_ADDRESS 0x60013CA2 /end MEASUREMENT
/begin MEASUREMENT ASDrf_trqTgtLead "target value of lead filter" SWORD md_q0p1 1 100 -3276.800 3276.700 FORMAT "%8.3" ECU_ADDRESS 0x60008130 /end MEASUREMENT
/begin MEASUREMENT ASDrf_trqThresLead "Torque threshold for Lead path" SWORD md_q0p1 1 100 -3276.800 3276.700 FORMAT "%8.3" ECU_ADDRESS 0x60013CA4 /end MEASUREMENT
/begin FUNCTION APP_SelSig "45.0.0    Acceleration Pedal Position Signal Selection" /begin DEF_CHARACTERISTIC APP_duLimErrPos_C APP_uAPPDef_C APP_uRaw2Offset_C /end DEF_CHARACTERISTIC /begin REF_CHARACTERISTIC APP_dRawSigFac_C APP_swtCfg_CW /end REF_CHARACTERISTIC
 /begin IN_MEASUREMENT APP_bAPP1FinalDef APP_bAPP1ProvDef APP_bAPP2FinalDef APP_bAPP2ProvDef APP_bSync APP_bSyncDeb MoFAPP_stLimpMsg /end IN_MEASUREMENT
 /begin OUT_MEASUREMENT APP_bTempErr APP_stSigSrc /end OUT_MEASUREMENT
 /begin LOC_MEASUREMENT APP_uRaw /end LOC_MEASUREMENT
 FUNCTION_VERSION "45.0.0" /end FUNCTION
/begin FUNCTION APP_UnJit "1.2.0     Unjitter function" /begin DEF_CHARACTERISTIC APP_uJitter_C APP_uPreUnJitter1_C APP_uPreUnJitter2_C /end DEF_CHARACTERISTIC /begin REF_CHARACTERISTIC APP_swtCfg_CW /end REF_CHARACTERISTIC FUNCTION_VERSION "1.2.0" /end FUNCTION
/begin FUNCTION APP_VD "169.3.0   Acceleration Pedal Position Virtual Device"
 /begin DEF_CHARACTERISTIC APP_dRawSigFac_C APP_drLimNegLrn_C APP_drLimpMaxLrn_C APP_drLimPosLrn_C APP_drLinRmp_C APP_I_P_ATS_ATS.LimitTypeMsk_C APP_I_P_ATS_ATS.CnvNorm_C APP_I_P_ATS_ATS.LowLim_C APP_I_P_ATS_ATS.UpLim_C APP_I_P_ATS_ATS.CnvFac_C APP_I_P_ATS_ATS.CnvOfs_C APP_I_P_ATS_ATS.DfltVal_C APP_rAppATSMax_C APP_rAppATSMin_C APP_rAppLimnMax_C APP_rAppLimnMin_C APP_rAPPMaxLrnFixOffs_C APP_rAPPMaxLrnPosOffs_C APP_rAPPMaxLrnPos_C APP_rLimpMaxLrn_C APP_rLinAPPMax_C APP_rLinAPPMin_C APP_rPlaMaxValLrn_C APP_rPrevLETThd_C APP_swtCfg_CW APP_tiEngOnLETThd_C APP_tiPhyHigh1DebDef_C APP_tiPhyHigh1DebOk_C APP_tiPhyHigh2DebDef_C APP_tiPhyHigh2DebOk_C APP_tiPhyLow1DebDef_C APP_tiPhyLow1DebOk_C APP_tiPhyLow2DebDef_C APP_tiPhyLow2DebOk_C APP_tiPlaAPP12DebDef_C APP_tiPlaAPP12DebOk_C APP_tiSRCHigh1DebDef_C APP_tiSRCHigh1DebOk_C APP_tiSRCHigh2DebDef_C APP_tiSRCHigh2DebOk_C APP_tiSRCLow1DebDef_C APP_tiSRCLow1DebOk_C APP_tiSRCLow2DebDef_C APP_tiSRCLow2DebOk_C APP_uRaw1Def_C APP_uRaw2Def_C APP_uRawFullLdLimp_C APP_uRawFullLd_C APP_uRawIdlLimp_C APP_uRawIdl_C APP_uSnsrMaxOffs_C APP_uSply_C APP_vVehLETThd_C /end DEF_CHARACTERISTIC
 /begin IN_MEASUREMENT APP_bAlive APP_bAPP1FinalDef APP_bAPP1ProvDef APP_bAPP2FinalDef APP_bAPP2ProvDef APP_bPlaBrk APP_bSync APP_bSyncDeb APP_stSigSrc APP_uCurrSnsrMax APP_uRaw1ADC APP_uRaw2ADC Brk_st B_dksbeg EngDa_tiEngOnOBD Gbx_stGearLvr MoFETC_stTstMsg PT_stTraType SyC_ctPostDrvLeave T15_st VehV_v /end IN_MEASUREMENT
 /begin OUT_MEASUREMENT APP_bT15Deb APP_dr APP_drUnFlt APP_flgATSActv App_flgLETVldActv APP_r APP_rAppPrev APP_rLET APP_rMaxLrnUnFlt APP_rOBDPID5A APP_rUnFlt APP_stLETAbort APP_tiPhyHigh1DebDef APP_tiPhyHigh1DebOk APP_tiPhyHigh2DebDef APP_tiPhyHigh2DebOk APP_tiPhyLow1DebDef APP_tiPhyLow1DebOk APP_tiPhyLow2DebDef APP_tiPhyLow2DebOk APP_tiSRCHigh1DebDef APP_tiSRCHigh1DebOk APP_tiSRCHigh2DebDef APP_tiSRCHigh2DebOk APP_tiSRCLow1DebDef APP_tiSRCLow1DebOk APP_tiSRCLow2DebDef APP_tiSRCLow2DebOk APP_uRaw1 APP_uRaw1unLim APP_uRaw2 APP_uRaw2unLim /end OUT_MEASUREMENT
 /begin LOC_MEASUREMENT APP_cntrPostDrvLve APP_rLinRmp APP_rUnLimMaxLrnUnFlt APP_rUnLimMaxLrn_mp APP_stMaxLrnFixOffsPosnCalc APP_uMaxLrnFixOffsPosn APP_uPreUnJit1 APP_uPreUnJit2 APP_uRaw1Old APP_uRaw2Old APP_uUnJit /end LOC_MEASUREMENT
 FUNCTION_VERSION "169.3.0" /end FUNCTION
/begin FUNCTION ASDdc_TrqCalc "28.3.0    AntiSurgeDamper - disturbance control"
 /begin DEF_CHARACTERISTIC ASDdc_facNDiff_CUR ASDdc_facTEngFeth_MAP ASDdc_facTrqInit_CUR ASDdc_facTrq_C ASDdc_facVVeh_CUR ASDdc_KdDynNegEco_GMAP ASDdc_KdDynNegSprt_GMAP ASDdc_KdDynNeg_GMAP ASDdc_KdDynPosEco_GMAP ASDdc_KdDynPosSprt_GMAP ASDdc_KdDynPos_GMAP ASDdc_nDifGripDetnMax_C ASDdc_nMax_C ASDdc_nMinIdlOff_C ASDdc_nMinOff_C ASDdc_nPT_DST ASDdc_rTrq_DST ASDdc_stCfg2_CW ASDdc_stCfg_CW ASDdc_swtNDiffSeln_C ASDdc_tiActvAftFCO_C ASDdc_tiActvDyn_C ASDdc_tiGripDeb_GCUR ASDdc_tiPerDur_GCUR ASDdc_tiShftDeb_GCUR ASDdc_trqClthAct_DST ASDdc_trqClthWoDstC_DST ASDdc_trqThresDynNegEco_GMAP ASDdc_trqThresDynNegSprt_GMAP ASDdc_trqThresDynNeg_GMAP ASDdc_trqThresDynPosEco_GMAP ASDdc_trqThresDynPosSprt_GMAP ASDdc_trqThresDynPos_GMAP /end DEF_CHARACTERISTIC
 /begin IN_MEASUREMENT ActMod_trqCrSWoDstC ASDrf_bPosNegDes ASDrf_flgEcoModActv ASDrf_flgSptModActv CoETS_bIntvActvDes Com_flgAntiJerkCnvrSlipEna Com_stAntiJerkCtrlInhb Conv_nTrbn CoVeh_trqAcs DOGov_bActv EngDa_tEng EngStrt_flgStrtEndTqStruct Epm_dnEngFlt Epm_nEng FfPrm_facEth HLSDem_nSetPLo InjSys_bInjVlvActv LIGov_nDiff MESCtrlr_nSpDif PthSet_bEnaIndivRes PT_bConvSlip PT_bConvSlipClsd PT_bGrip PT_bNoGrip PT_nClth PT_rTrq PT_stTraShftOp PT_stTraType PT_tqCluEngWoIntvExt SyC_ctDrvEnter VehMot_stPrpAccPed VehMot_stPrpCrCtl VehV_v /end IN_MEASUREMENT
 /begin OUT_MEASUREMENT ASDdc_bDstCActv ASDdc_bDstCActvEna ASDdc_KdDyn ASDdc_nEngOsc ASDdc_tiPerDur ASDdc_trq ASDdc_trqThresDyn /end OUT_MEASUREMENT
 /begin LOC_MEASUREMENT ASDdc_bCalcMin ASDdc_bCalcRmp ASDdc_bDstCActvAftFCO ASDdc_bDstCActvEBNM_I.oldSignal ASDdc_bDstCActvEnaTONVNM_I.time ASDdc_bDyn ASDdc_bGrip ASDdc_bGripSlip ASDdc_bGripTONV_I.outbit ASDdc_bGripTONV_I.time ASDdc_bSignChng ASDdc_cntDyn ASDdc_cntDynIni ASDdc_ctIniDrvTrqCalcEng10ms ASDdc_ctIniDrvTrqCalcPT10ms ASDdc_ctIniDrvTrqCalcSyncSx ASDdc_D2T2nEng_I.B_bActvOld ASDdc_D2T2nEng_I.B_bSigChg ASDdc_D2T2nEng_I.B_msbOld ASDdc_D2T2nEng_I.mem1x_S32 ASDdc_D2T2nEng_I.mem1y_S32 ASDdc_D2T2nEng_I.mem2x_S32 ASDdc_D2T2nEng_I.mem2y_S32 ASDdc_facEth ASDdc_facKd ASDdc_facTrq ASDdc_HMBActvFF_I.status ASDdc_KdDynCurr ASDdc_nDiff ASDdc_nGradMin ASDdc_nPT ASDdc_ratTq ASDdc_stShftOpTOFFV_I.outbit ASDdc_stShftOpTOFFV_I.time ASDdc_tEng ASDdc_TOffVSyncDyn_I.outp ASDdc_TOffVSyncDyn_I.time ASDdc_TOffVSyncFadeOutDyn_I.outp ASDdc_TOffVSyncFadeOutDyn_I.time ASDdc_trqClthAct ASDdc_trqClthWoDstC ASDdc_v /end LOC_MEASUREMENT
 FUNCTION_VERSION "28.3.0" /end FUNCTION
/begin FUNCTION ASDrf_Filter "28.2.0    Forming guidance part of drivability functions" /begin DEF_CHARACTERISTIC ASDrf_facTqBasLim_C ASDrf_tqOfsBasLim_C /end DEF_CHARACTERISTIC
 /begin IN_MEASUREMENT ASDrf_KdFltSet ASDrf_tiFltSet ASDrf_trqClthFlt ASDrf_trqLosSet CoVeh_trqAcs RngMod_trqCrSMin RngMod_trqInrBsWoIntv StatyCoorn_tqCluDesLimd SyC_ctDrvEnter /end IN_MEASUREMENT
 /begin OUT_MEASUREMENT ASDrf_trqClthFltUnlim /end OUT_MEASUREMENT
 /begin LOC_MEASUREMENT ASDrf_ctIniDrvFilter10ms ASDrf_tqInrFltUnlimLT_I.memory ASDrf_trqCluBsLim ASDrf_trqFltDem /end LOC_MEASUREMENT
 FUNCTION_VERSION "28.2.0" /end FUNCTION
/begin FUNCTION ASDrf_Lead "28.4.0    Calculation of torque demand for lead path"
 /begin DEF_CHARACTERISTIC ASDrf_dtqEcoRampMtModPosAcOn_T ASDrf_dtqEcoRampMtModPos_T ASDrf_dtqEcoRampPosAcOn_T ASDrf_dtqEcoRampPos_T ASDrf_dtqRampMtModPosAcOn_T ASDrf_dtqRampMtModPosFFVAcOn_T ASDrf_dtqRampMtModPosFFV_T ASDrf_dtqRampMtModPos_T ASDrf_dtqRampPosFFVAcOn_T ASDrf_dtqRampPosFFV_T ASDrf_dtqSprtAirCdnrOnRampPos_T ASDrf_dtqSprtRampMtModPos_T ASDrf_dtqSprtRampPos_T ASDrf_dtqSptRampMtModPosAcOn_T ASDrf_dtrqRmpPosAcOn_CUR ASDrf_dtrqRmpPos_CUR ASDrf_facEcoRampMtModPosAcOn_GM ASDrf_facEcoRampMtModPosAcOn_GT ASDrf_facEcoRampMtModPos_GM ASDrf_facEcoRampMtModPos_GT ASDrf_facEcoRampPosAcOn_GM ASDrf_facEcoRampPosAcOn_GT ASDrf_facEcoRampPos_GM ASDrf_facEcoRampPos_GT ASDrf_facEcoTiAirCdnrOnNegLead_GT ASDrf_facEcoTqIniAirCdnrOnNeg_GM ASDrf_facEcoTqIniAirCdnrOnNeg_GT ASDrf_facEcoTqIniMtModNegAcOn_GM ASDrf_facEcoTqIniMtModNegAcOn_GT ASDrf_facEcoTqIniMtModNeg_GM ASDrf_facEcoTqIniMtModNeg_GT ASDrf_facEcoTqIniNeg_GM ASDrf_facEcoTqIniTEngAirCdnrOnNeg_GT ASDrf_facEcoTqIniTEngNeg_GT ASDrf_facEcoTrqIniNeg_GCUR ASDrf_facRampMtModPosAcOn_GM ASDrf_facRampMtModPosAcOn_GT ASDrf_facRampMtModPosFFVAcOn_GM ASDrf_facRampMtModPosFFVAcOn_GT ASDrf_facRampMtModPosFFV_GM ASDrf_facRampMtModPosFFV_GT ASDrf_facRampMtModPos_GM ASDrf_facRampMtModPos_GT ASDrf_facRampPosFFVAcOn_GM ASDrf_facRampPosFFVAcOn_GT ASDrf_facRampPosFFV_GM ASDrf_facRampPosFFV_GT ASDrf_facRmpPosAcOn_GCUR ASDrf_facRmpPosAcOn_GMAP ASDrf_facRmpPos_GCUR ASDrf_facRmpPos_GMAP ASDrf_facSprtAirCdnrOnRampPos_GM ASDrf_facSprtAirCdnrOnRampPos_GT ASDrf_facSprtAirCdnrOnTqIniNeg_GM ASDrf_facSprtAirCdnrOnTqIniNeg_GT ASDrf_facSprtRampMtModPos_GM ASDrf_facSprtRampMtModPos_GT ASDrf_facSprtRampPos_GM ASDrf_facSprtRampPos_GT ASDrf_facSprtTqIniMtModNeg_GM ASDrf_facSprtTqIniMtModNeg_GT ASDrf_facSprtTqIniNeg_GM ASDrf_facSprtTqIniNeg_GT ASDrf_facSptRampMtModPosAcOn_GM ASDrf_facSptRampMtModPosAcOn_GT ASDrf_facSptTqIniMtModNegAcOn_GM ASDrf_facSptTqIniMtModNegAcOn_GT ASDrf_facTiAirCdnrOnNegLead_GT ASDrf_facTiEcoNegLead_GT ASDrf_facTiMtModEcoNegLeadAcOn_GT ASDrf_facTiMtModEcoNegLead_GT ASDrf_facTiMtModNegLeadAcOn_GT ASDrf_facTiMtModNegLeadFFVAcOn_GT ASDrf_facTiMtModNegLeadFFV_GT ASDrf_facTiMtModNegLead_GT ASDrf_facTiMtModSptNegLeadAcOn_GT ASDrf_facTiMtModSptNegLead_GT ASDrf_facTiNegLeadFFVAcOn_GT ASDrf_facTiNegLeadFFV_GT ASDrf_facTiNegLead_GCUR ASDrf_facTiSprtAirCdnrOnNegLead_GT ASDrf_facTiSprtNegLead_GT ASDrf_facTqIniAirCdnrOnNeg_GM ASDrf_facTqIniAirCdnrOnNeg_GT ASDrf_facTqIniMtModNegAcOn_GM ASDrf_facTqIniMtModNegAcOn_GT ASDrf_facTqIniMtModNegFFVAcOn_GM ASDrf_facTqIniMtModNegFFVAcOn_GT ASDrf_facTqIniMtModNegFFV_GM ASDrf_facTqIniMtModNegFFV_GT ASDrf_facTqIniMtModNeg_GM ASDrf_facTqIniMtModNeg_GT ASDrf_facTqIniNegFFVAcOn_GM ASDrf_facTqIniNegFFVAcOn_GT ASDrf_facTqIniNegFFV_GM ASDrf_facTqIniNegFFV_GT ASDrf_facTqIniTEngAirCdnrOnNeg_GT ASDrf_facTqIniTEngNeg_GT ASDrf_facTrqIniNeg_GCUR ASDrf_facTrqIniNeg_GMAP ASDrf_swtTrqRng_C ASDrf_tiAirCdnrOnNegLead_GM ASDrf_tiEcoAirCdnrOnNegLead_GM ASDrf_tiEcoNegLead_GM ASDrf_tiMaxPos_GMAP ASDrf_tiMtModEcoNegLeadAcOn_GM ASDrf_tiMtModEcoNegLead_GM ASDrf_tiMtModNegLeadAcOn_GM ASDrf_tiMtModNegLeadFFVAcOn_GM ASDrf_tiMtModNegLeadFFV_GM ASDrf_tiMtModNegLead_GM ASDrf_tiMtModSptNegLeadAcOn_GM ASDrf_tiMtModSptNegLead_GM ASDrf_tiNegLeadFFVAcOn_GM ASDrf_tiNegLeadFFV_GM ASDrf_tiNegLead_GMAP ASDrf_tiSprtAirCdnrOnNegLead_GM ASDrf_tiSprtNegLead_GM ASDrf_tqLossEcoOffsMtModNegLeadAcOn_GT ASDrf_tqLossEcoOffsMtModNegLead_GT ASDrf_tqLossEcoOffsMtModPosLeadAcOn_GM ASDrf_tqLossEcoOffsMtModPosLead_GM ASDrf_tqLossEcoOffsNegLead_GT ASDrf_tqLossEcoOffsPosLeadAcOn_GM ASDrf_tqLossEcoOffsPosLead_GM ASDrf_tqLossEcoOfsAirCdnrOnNegLead_GT ASDrf_tqLossOffsMtModNegLeadAcOn_GT ASDrf_tqLossOffsMtModNegLeadFFVAcOn_GT ASDrf_tqLossOffsMtModNegLeadFFV_GT ASDrf_tqLossOffsMtModNegLead_GT ASDrf_tqLossOffsMtModPosLeadAcOn_GM ASDrf_tqLossOffsMtModPosLeadFFVAcOn_GM ASDrf_tqLossOffsMtModPosLeadFFV_GM ASDrf_tqLossOffsMtModPosLead_GM ASDrf_tqLossOffsNegLeadFFVAcOn_GT ASDrf_tqLossOffsNegLeadFFV_GT ASDrf_tqLossOffsPosLeadFFVAcOn_GM ASDrf_tqLossOffsPosLeadFFV_GM ASDrf_tqLossSprtAirCdnrOnOffsNegLead_GT ASDrf_tqLossSprtAirCdnrOnOffsPosLead_GM ASDrf_tqLossSprtOffsMtModNegLead_GT ASDrf_tqLossSprtOffsMtModPosLead_GM ASDrf_tqLossSprtOffsNegLead_GT ASDrf_tqLossSprtOffsPosLead_GM ASDrf_tqLossSptOffsMtModNegLeadAcOn_GT ASDrf_tqLossSptOffsMtModPosLeadAcOn_GM ASDrf_tqThdEcoMtModNegLeadAcOn_C ASDrf_tqThdEcoMtModNegLead_C ASDrf_tqThdEcoMtModPosLeadAcOn_GM ASDrf_tqThdEcoMtModPosLead_GM ASDrf_tqThdEcoNegLeadAcOn_C ASDrf_tqThdEcoNegLead_C ASDrf_tqThdEcoPosLeadAcOn_GM ASDrf_tqThdEcoPosLead_GM ASDrf_tqThdMtModNegLeadAcOn_C ASDrf_tqThdMtModNegLeadFFVAcOn_C ASDrf_tqThdMtModNegLeadFFV_C ASDrf_tqThdMtModNegLead_C ASDrf_tqThdMtModPosLeadAcOn_GM ASDrf_tqThdMtModPosLeadFFVAcOn_GM ASDrf_tqThdMtModPosLeadFFV_GM ASDrf_tqThdMtModPosLead_GM ASDrf_tqThdNegLeadFFVAcOn_C ASDrf_tqThdNegLeadFFV_C ASDrf_tqThdPosLeadFFVAcOn_GM ASDrf_tqThdPosLeadFFV_GM ASDrf_tqThdSprtAirCdnrOnNegLead_C ASDrf_tqThdSprtAirCdnrOnPosLead_GM ASDrf_tqThdSprtMtModNegLead_C ASDrf_tqThdSprtMtModPosLead_GM ASDrf_tqThdSprtNegLead_C ASDrf_tqThdSprtPosLead_GM ASDrf_tqThdSptMtModNegLeadAcOn_C ASDrf_tqThdSptMtModPosLeadAcOn_GM ASDrf_trqLeadPrfm_C ASDrf_trqLosOfsAirCdnrOnNegLead_GT ASDrf_trqLosOfsLeadSlipOpn_GMAP ASDrf_trqLosOfsNegLead_GCUR ASDrf_trqLosOfsPosLeadAcOn_GMAP ASDrf_trqLosOfsPosLead_GMAP ASDrf_trqStrtRmpPos_C ASDrf_trqThresNegLeadAcOn_C ASDrf_trqThresNegLead_C ASDrf_trqThresPosLeadAcOn_GMAP ASDrf_trqThresPosLead_GMAP /end DEF_CHARACTERISTIC
 /begin REF_CHARACTERISTIC ASDrf_Cfg2_CW ASDrf_Cfg3_CW ASDrf_Cfg4_CW ASDrf_Cfg_CW ASDrf_facDesDyn_DST ASDrf_nEng_DST ASDrf_nPt_DST ASDrf_nrGear_DST ASDrf_rTrq_DST ASDrf_tEng_DST ASDrf_trqClthBs_DST ASDrf_vDOPos_C /end REF_CHARACTERISTIC
 /begin IN_MEASUREMENT AirC_stPsCmpr ASDrf_bCalcTrqBs ASDrf_bConvSlipOpn ASDrf_bNCmp ASDrf_bNoGrip ASDrf_bPosNegLead ASDrf_facDesDyn ASDrf_flgEcoModActv ASDrf_flgSptModActv ASDrf_flgTrsmMtModActv ASDrf_nPt ASDrf_tiFltSet ASDrf_tqCluBasc ASDrf_tqCluBasLead CoETS_bFltDemLead EngDa_tEng Epm_nEng FfPrm_facEth Gbx_bATSlipOpn LsComp_tqCmpActvSpdGovr LsComp_tqSwilLossNotFild PT_bConvSlipOpn PT_rTrq PT_stTraType RngMod_trqClthBs RngMod_trqClthMin RngMod_trqInrBs RngMod_trqInrBsMin SpdGov_trqLead StatyCoorn_tqCluLeadLimd SyC_ctDrvEnter VehV_v /end IN_MEASUREMENT
 /begin OUT_MEASUREMENT ASDrf_trqClthLeadEng /end OUT_MEASUREMENT
 /begin LOC_MEASUREMENT ASDrf_bBsBlw ASDrf_bDelLeadActv ASDrf_bDelNeg ASDrf_bFltDemLeadER_I.buffer ASDrf_bFltDemLeadER_I.oldSignal ASDrf_bFltNegLead ASDrf_bRmpLeadActv ASDrf_ctIniDrvLead10ms ASDrf_dtrqRmp ASDrf_facStrtNeg ASDrf_Leadtimer ASDrf_tiLead ASDrf_tqLosComp ASDrf_tqTgtLeadLT_I.memory ASDrf_trqIniLead ASDrf_trqLosOfsLead ASDrf_trqTgtLead ASDrf_trqThresLead /end LOC_MEASUREMENT
 FUNCTION_VERSION "28.4.0" /end FUNCTION
/begin FUNCTION ASDrf_LimIA "28.1.0    Gradient limitation and ignition angle release of drivability functions" /begin REF_CHARACTERISTIC ASDrf_Cfg_CW /end REF_CHARACTERISTIC
 /begin IN_MEASUREMENT ASDrf_trqClthFltUnlim ASDrf_trqClthMax ASDrf_trqClthMin CoEng_bCtOffConDel CoETS_bFltDemSet CoETS_trqInrLimSet LsComp_tqCmpActvSpdGovr LsComp_tqSwilLossNotFild PthSet_bEnaIndivRes PthSet_stOvrRun RngMod_trqClthBsMin RngMod_trqClthMin SpdGov_trqClth StatyCoorn_tqCluDesLimd SyC_ctDrvEnter /end IN_MEASUREMENT
 /begin OUT_MEASUREMENT ASDrf_bLim ASDrf_trqClthFlt /end OUT_MEASUREMENT
 /begin LOC_MEASUREMENT ASDrf_ctIniDrvLimIA10ms ASDrf_trqLosCmp /end LOC_MEASUREMENT
 FUNCTION_VERSION "28.1.0" /end FUNCTION
/begin FUNCTION ASDrf_MinMax "28.3.0    Calculation of extremas of the gradient limitation"
 /begin DEF_CHARACTERISTIC ASDrf_bPhyTqLyrHybCmpbl_C ASDrf_CfgNew_C ASDrf_cntrSigMaxReset_C ASDrf_cntrSigMaxSet_C ASDrf_dndeltaMaxIni_C ASDrf_dnEngMaxReset_C ASDrf_dnEngMaxSet_C ASDrf_dtqNegMax_C ASDrf_dtqNegMin_C ASDrf_dtqPosMax_M ASDrf_facAirFric_C ASDrf_facdtqPosMax_T ASDrf_facLimAbv_GM ASDrf_facLimBlw_GM ASDrf_facRollFric_C ASDrf_facTiOscdtqNeg_C ASDrf_facTiOscLimPos_C ASDrf_facTiOscStrtRed_C ASDrf_factqOffNeg_T ASDrf_factqOffPos_T ASDrf_ratApp_DST ASDrf_rGripThdSlip_C ASDrf_tCooltHiThd_C ASDrf_tCooltLoThd_C ASDrf_tiOscNeg_T ASDrf_tiOscPos_T ASDrf_tqLimAbv_GT ASDrf_tqLimBlw_GT ASDrf_tqLimNegOff_C ASDrf_tqLossOffsSlipOpenEco_GM ASDrf_tqLossOffsSlipOpenPos_GM ASDrf_tqLossOffsSlipOpenSpt_GM ASDrf_tqLossOffsSlipOpenTrsmMt_GM ASDrf_tqOffNeg_M ASDrf_tqOffPos_M ASDrf_tqOffsLimNegMin_C ASDrf_trqOfsAirChrg_C /end DEF_CHARACTERISTIC
 /begin REF_CHARACTERISTIC ASDrf_Cfg2_CW ASDrf_Cfg4_CW ASDrf_Cfg_CW ASDrf_facDesDyn_DST ASDrf_nPt_DST ASDrf_rTrq_DST /end REF_CHARACTERISTIC
 /begin IN_MEASUREMENT APP_r ASDrf_bConvSlipOpn ASDrf_bLim ASDrf_bNCmp ASDrf_bNoGrip ASDrf_bPosNegDes ASDrf_bRstEngSt ASDrf_CoefA ASDrf_CoefB ASDrf_facDesDyn ASDrf_flgEcoModActv ASDrf_flgSptModActv ASDrf_flgTrsmMtModActv ASDrf_nPt ASDrf_tqCluDemSet ASDrf_trqClthFlt ASDrf_trqClthFltUnlim ASDrf_trqLosSet B_kh_msg CEngDsT_t CoETS_bFltDemLead CoETS_bFltDemSet Epm_dnEng Epm_nEng Gbx_bATSlipOpn PthLead_stTrqResvActv PthLead_trqResv PthSet_bIARlsWoDstC PT_bConvSlipOpn PT_rGrip PT_rTrq PT_stTraType PT_tqCluEngWoIntvExt RngMod_trqInrBs RngMod_trqInrMinAirChrg StatyCoorn_tqCluDesLimd SyC_ctDrvEnter Tra_numGear VehV_v /end IN_MEASUREMENT
 /begin OUT_MEASUREMENT ASDrf_bNoRmp ASDrf_stLimMinMax ASDrf_trqClthMax ASDrf_trqClthMin /end OUT_MEASUREMENT
 /begin LOC_MEASUREMENT ASDrf_barmed ASDrf_bFltWoIA ASDrf_bNotNCmpOld ASDrf_bPhyTqLyrHybCmpbl ASDrf_cntrSigndnEng ASDrf_ctIniDrvMinMax10ms ASdrf_dn ASDrf_dndeltaMax ASdrf_dnEngFlt ASDrf_dtqNeg ASDrf_dtqPos ASDrf_flgNMax ASDrf_flgnMaxEF_I.buffer ASDrf_flgnMaxEF_I.oldSignal ASDrf_flgNMaxTrig ASDrf_flgStrtRed ASDrf_posnegEB_I.buffer ASDrf_posnegEB_I.oldSignal ASDrf_tiOscNeg ASDrf_tiOscPos ASDrf_tiPosNeg ASDrf_tqAct ASDrf_tqAirFric ASDrf_tqLim ASDrf_tqLimAbv ASDrf_tqLimBlw ASDrf_tqLimNeg ASDrf_tqLimPos ASDrf_tqOffNeg ASDrf_tqOffPos ASDrf_tqRollFric /end LOC_MEASUREMENT
 FUNCTION_VERSION "28.3.0" /end FUNCTION
/begin FUNCTION ASDrf_PosNeg "28.2.0    Detection of positive/negative gradient of driver's demand" /begin DEF_CHARACTERISTIC ASDrf_trqThresDet_C /end DEF_CHARACTERISTIC /begin REF_CHARACTERISTIC ASDrf_Cfg2_CW /end REF_CHARACTERISTIC
 /begin IN_MEASUREMENT ASDrf_bSlipOpnActv ASDrf_trqClthFlt ASDrf_trqClthLeadEng CoEng_bCtOffConDel CoEng_stMai PT_tqCluMinWoFco StatyCoorn_tqCluDesLimd StatyCoorn_tqCluLeadLimd SyC_ctDrvEnter /end IN_MEASUREMENT
 /begin OUT_MEASUREMENT ASDrf_bPosNegDes ASDrf_bPosNegLead ASDrf_bRstEngSt /end OUT_MEASUREMENT
 /begin LOC_MEASUREMENT ASDrf_bCtOffConDelEFNM_I.oldSignal ASDrf_bTrqDemDrv ASDrf_ctIniDrvPosNeg10ms ASDrf_DetnTqGrdtDes_I.bPosNeg ASDrf_DetnTqGrdtLead_I.bPosNeg /end LOC_MEASUREMENT
 FUNCTION_VERSION "28.2.0" /end FUNCTION
/begin COMPU_METHOD BUEK_SY_Compu "" TAB_VERB "%6.3" "" COMPU_TAB_REF BUEK_SY_Compu /end COMPU_METHOD
/begin COMPU_VTAB BUEK_SY_Compu "" TAB_VERB 2 0 "False" 1 "True" /end COMPU_VTAB
/begin COMPU_METHOD BYPASS_SY_Compu "" TAB_VERB "%6.3" "" COMPU_TAB_REF BYPASS_SY_Compu /end COMPU_METHOD
/begin COMPU_VTAB BYPASS_SY_Compu "" TAB_VERB 2 0 "No Bypass" 1 "Bypass" /end COMPU_VTAB
/begin COMPU_METHOD B_TRUE "" TAB_VERB "%6.3" "" COMPU_TAB_REF B_TRUE /end COMPU_METHOD
/begin COMPU_VTAB B_TRUE "" TAB_VERB 2 0 "FALSE" 1 "TRUE" /end COMPU_VTAB
/begin COMPU_METHOD CACDSPLP_TYPAVL_SC_Compu "" TAB_VERB "%6.3" "" COMPU_TAB_REF CACDSPLP_TYPAVL_SC_Compu /end COMPU_METHOD
/begin COMPU_VTAB CACDSPLP_TYPAVL_SC_Compu "" TAB_VERB 2 0 "False" 1 "True" /end COMPU_VTAB
/begin COMPU_METHOD CACDSP_TYPAVL_SY_Compu "" TAB_VERB "%6.3" "" COMPU_TAB_REF CACDSP_TYPAVL_SY_Compu /end COMPU_METHOD
/begin COMPU_VTAB CACDSP_TYPAVL_SY_Compu "" TAB_VERB 2 0 "False" 1 "True" /end COMPU_VTAB
/begin COMPU_METHOD CACDSTLP_TYPAVL_SC_Compu "" TAB_VERB "%6.3" "" COMPU_TAB_REF CACDSTLP_TYPAVL_SC_Compu /end COMPU_METHOD
/begin COMPU_VTAB CACDSTLP_TYPAVL_SC_Compu "" TAB_VERB 2 0 "False" 1 "True" /end COMPU_VTAB
/begin COMPU_METHOD CACDST_TYPAVL_SY_Compu "" TAB_VERB "%6.3" "" COMPU_TAB_REF CACDST_TYPAVL_SY_Compu /end COMPU_METHOD
/begin COMPU_VTAB CACDST_TYPAVL_SY_Compu "" TAB_VERB 2 0 "False" 1 "True" /end COMPU_VTAB
/begin COMPU_METHOD CACPMP_TYPAVLCONVENTIONAL_SC_Compu "" RAT_FUNC "%6.2" "" COEFFS 0 1 0 0 0 1 /end COMPU_METHOD
/begin COMPU_METHOD CACPMP_TYPAVL_SY_Compu "" TAB_VERB "%6.3" "" COMPU_TAB_REF CACPMP_TYPAVL_SY_Compu /end COMPU_METHOD
/begin COMPU_VTAB CACPMP_TYPAVL_SY_Compu "" TAB_VERB 2 0 "False" 1 "True" /end COMPU_VTAB
/begin COMPU_METHOD CACUSP_TYPAVL_SY_Compu "" TAB_VERB "%6.3" "" COMPU_TAB_REF CACUSP_TYPAVL_SY_Compu /end COMPU_METHOD
/begin COMPU_VTAB CACUSP_TYPAVL_SY_Compu "" TAB_VERB 2 0 "False" 1 "True" /end COMPU_VTAB
/begin COMPU_METHOD CACUST_TYPAVL_SY_Compu "" TAB_VERB "%6.3" "" COMPU_TAB_REF CACUST_TYPAVL_SY_Compu /end COMPU_METHOD
/begin COMPU_VTAB CACUST_TYPAVL_SY_Compu "" TAB_VERB 2 0 "False" 1 "True" /end COMPU_VTAB
/begin COMPU_METHOD CAIRHT_SY_Compu "" TAB_VERB "%6.3" "" COMPU_TAB_REF CAIRHT_SY_Compu /end COMPU_METHOD
/begin COMPU_VTAB CAIRHT_SY_Compu "" TAB_VERB 2 0 "False" 1 "True" /end COMPU_VTAB
/begin COMPU_METHOD CALCNROLLGDIAGPLAUS_SC_Compu "" TAB_VERB "%6.3" "" COMPU_TAB_REF CALCNROLLGDIAGPLAUS_SC_Compu /end COMPU_METHOD
/begin COMPU_VTAB CALCNROLLGDIAGPLAUS_SC_Compu "" TAB_VERB 2 0 "False" 1 "True" /end COMPU_VTAB
/begin COMPU_METHOD CALMAXAIRCHRG_SC_Compu "" TAB_VERB "%6.3" "" COMPU_TAB_REF CALMAXAIRCHRG_SC_Compu /end COMPU_METHOD
/begin COMPU_VTAB CALMAXAIRCHRG_SC_Compu "" TAB_VERB 2 0 "False" 1 "True" /end COMPU_VTAB
/begin COMPU_METHOD CALMAXREDSTG_SC_Compu "" TAB_VERB "%6.3" "" COMPU_TAB_REF CALMAXREDSTG_SC_Compu /end COMPU_METHOD
/begin COMPU_VTAB CALMAXREDSTG_SC_Compu "" TAB_VERB 2 0 "False" 1 "True" /end COMPU_VTAB
/begin COMPU_METHOD Calory "" RAT_FUNC "%6.2" "J/g" COEFFS 0 1 0 0 0 1 /end COMPU_METHOD
/begin COMPU_METHOD CalVal_q0p01 "" RAT_FUNC "%6.4" "MJ/Kg" COEFFS 0 100 0 0 0 1 /end COMPU_METHOD
/begin COMPU_METHOD CALWUP_SY_Compu "" TAB_VERB "%6.3" "" COMPU_TAB_REF CALWUP_SY_Compu /end COMPU_METHOD
/begin COMPU_VTAB CALWUP_SY_Compu "" TAB_VERB 2 0 "no calibration wake up" 1 "calibration wake up" /end COMPU_VTAB
/begin COMPU_METHOD CAMSFT_ACTRINTKB2_SC_Compu "" TAB_VERB "%6.3" "" COMPU_TAB_REF CAMSFT_ACTRINTKB2_SC_Compu /end COMPU_METHOD
/begin COMPU_VTAB CAMSFT_ACTRINTKB2_SC_Compu "" TAB_VERB 2 0 "False" 1 "True" /end COMPU_VTAB
/begin COMPU_METHOD CAMSFT_ACTROUTLB2_SC_Compu "" TAB_VERB "%6.3" "" COMPU_TAB_REF CAMSFT_ACTROUTLB2_SC_Compu /end COMPU_METHOD
/begin COMPU_VTAB CAMSFT_ACTROUTLB2_SC_Compu "" TAB_VERB 2 0 "False" 1 "True" /end COMPU_VTAB
/begin COMPU_METHOD CAMSFT_ADAP_SC_Compu "" TAB_VERB "%6.3" "" COMPU_TAB_REF CAMSFT_ADAP_SC_Compu /end COMPU_METHOD
/begin COMPU_VTAB CAMSFT_ADAP_SC_Compu "" TAB_VERB 2 0 "False" 1 "True" /end COMPU_VTAB
/begin COMPU_METHOD CAMSFT_ADPNCLB_SC_Compu "" TAB_VERB "%6.3" "" COMPU_TAB_REF CAMSFT_ADPNCLB_SC_Compu /end COMPU_METHOD
/begin COMPU_VTAB CAMSFT_ADPNCLB_SC_Compu "" TAB_VERB 2 0 "OFF" 1 "ON" /end COMPU_VTAB
/begin COMPU_METHOD CAMSFT_AGSPATS_SC_Compu "" TAB_VERB "%6.3" "" COMPU_TAB_REF CAMSFT_AGSPATS_SC_Compu /end COMPU_METHOD
/begin COMPU_VTAB CAMSFT_AGSPATS_SC_Compu "" TAB_VERB 2 0 "False" 1 "True" /end COMPU_VTAB
/begin COMPU_METHOD CAMSFT_ATS_SC_Compu "" TAB_VERB "%6.3" "" COMPU_TAB_REF CAMSFT_ATS_SC_Compu /end COMPU_METHOD
/begin COMPU_VTAB CAMSFT_ATS_SC_Compu "" TAB_VERB 2 0 "False" 1 "True" /end COMPU_VTAB
/begin COMPU_METHOD dez "" RAT_FUNC "%6.2" "" COEFFS 0 1 0 0 0 1 /end COMPU_METHOD
/begin COMPU_METHOD EngN "" RAT_FUNC "%6.3" "rpm" COEFFS 0 2 0 0 0 1 /end COMPU_METHOD
/begin COMPU_METHOD EngNGrd "" RAT_FUNC "%6.3" "rpm/s" COEFFS 0 2 0 0 0 1 /end COMPU_METHOD
/begin COMPU_METHOD Fact "" RAT_FUNC "%6.5" "-" COEFFS 0 8192 0 0 0 1 /end COMPU_METHOD
/begin COMPU_METHOD fak_q0p00195 "" RAT_FUNC "%6.4" "-" COEFFS 0 65536 0 0 0 128 /end COMPU_METHOD
/begin COMPU_METHOD fak_ub_b2 "" RAT_FUNC "%8.5" "-" COEFFS 0 256 0 0 0 2 /end COMPU_METHOD
/begin COMPU_METHOD fak_ub_b4 "" RAT_FUNC "%6.4" "-" COEFFS 0 256 0 0 0 4 /end COMPU_METHOD
/begin COMPU_METHOD fak_ub_b8 "" RAT_FUNC "%6.4" "-" COEFFS 0 256 0 0 0 8 /end COMPU_METHOD
/begin COMPU_METHOD fak_uw_b2 "" RAT_FUNC "%7.6" "-" COEFFS 0 65536 0 0 0 2 /end COMPU_METHOD
/begin COMPU_METHOD mdgrad_q10 "" RAT_FUNC "%6.1" "Nm/s" COEFFS 0 1 0 0 0 10 /end COMPU_METHOD
/begin COMPU_METHOD mdt_q0p1_Nm_DIV_s "" RAT_FUNC "%6.3" "Nm/s" COEFFS 0 10 0 0 0 1 /end COMPU_METHOD
/begin COMPU_METHOD md_q0p1 "" RAT_FUNC "%6.3" "Nm" COEFFS 0 10 0 0 0 1 /end COMPU_METHOD
/begin COMPU_METHOD md_sw_q0p1 "" RAT_FUNC "%6.3" "Nm" COEFFS 0 10 0 0 0 1 /end COMPU_METHOD
/begin COMPU_METHOD m_q0p00001 "" RAT_FUNC "%8.7" "kg" COEFFS 0 100000 0 0 0 1 /end COMPU_METHOD
/begin COMPU_METHOD nmot_q0p5 "" RAT_FUNC "%6.3" "1/min" COEFFS 0 2 0 0 0 1 /end COMPU_METHOD
/begin COMPU_METHOD OneToOne "" RAT_FUNC "%6.2" "-" COEFFS 0 1 0 0 0 1 /end COMPU_METHOD
/begin COMPU_METHOD Per_Dur "" RAT_FUNC "%6.2" "usec" COEFFS 0 1 0 0 0 1 /end COMPU_METHOD
/begin COMPU_METHOD Prc "" RAT_FUNC "%6.4" "%" COEFFS 0 81.92 0 0 0 1 /end COMPU_METHOD
/begin COMPU_METHOD PrcPerSec "" RAT_FUNC "%6.3" "%/s" COEFFS 0 1.6384 0 0 0 1 /end COMPU_METHOD
/begin COMPU_METHOD q0p03125_Nm_DIV_rpm "" RAT_FUNC "%6.4" "Nm/rpm" COEFFS 0 32 0 0 0 1 /end COMPU_METHOD
/begin COMPU_METHOD RmpVolt "" RAT_FUNC "%6.4" "mV/s" COEFFS 0 327.68 0 0 0 1 /end COMPU_METHOD
/begin COMPU_METHOD Temp_Cels "" RAT_FUNC "%6.1" "deg C" COEFFS 0 10 2731.4 0 0 1 /end COMPU_METHOD
/begin COMPU_METHOD TimeEngOn "" RAT_FUNC "%6.2" "s" COEFFS 0 1 0 0 0 1 /end COMPU_METHOD
/begin COMPU_METHOD Time_ms "" RAT_FUNC "%6.1" "ms" COEFFS 0 0.1 0 0 0 1 /end COMPU_METHOD
/begin COMPU_METHOD TransR "" RAT_FUNC "%6.4" "-" COEFFS 0 100 0 0 0 1 /end COMPU_METHOD
/begin COMPU_METHOD Trq "" RAT_FUNC "%6.3" "Nm" COEFFS 0 10 0 0 0 1 /end COMPU_METHOD
/begin COMPU_METHOD t_q0p001 "" RAT_FUNC "%6.5" "s" COEFFS 0 1000 0 0 0 1 /end COMPU_METHOD
/begin COMPU_METHOD t_q0p01 "" RAT_FUNC "%6.4" "s" COEFFS 0 100 0 0 0 1 /end COMPU_METHOD
/begin COMPU_METHOD t_q1p95em3 "" RAT_FUNC "%6.4" "s" COEFFS 0 512 0 0 0 1 /end COMPU_METHOD
/begin COMPU_METHOD Vel "" RAT_FUNC "%6.4" "km/h" COEFFS 0 100 0 0 0 1 /end COMPU_METHOD
/begin COMPU_METHOD Volt "" RAT_FUNC "%6.3" "mV" COEFFS 0 5 0 0 0 1 /end COMPU_METHOD
/begin RECORD_LAYOUT RB_Axis_S16 NO_AXIS_PTS_X 1 SWORD AXIS_PTS_X 2 SWORD INDEX_INCR DIRECT /end RECORD_LAYOUT
/begin RECORD_LAYOUT RB_CurveGroup_S16 FNC_VALUES 1 SWORD COLUMN_DIR DIRECT /end RECORD_LAYOUT
/begin RECORD_LAYOUT RB_CurveGroup_U8 FNC_VALUES 1 UBYTE COLUMN_DIR DIRECT /end RECORD_LAYOUT
/begin RECORD_LAYOUT RB_Curve_S16_S16 NO_AXIS_PTS_X 1 SWORD AXIS_PTS_X 2 SWORD INDEX_INCR DIRECT FNC_VALUES 3 SWORD COLUMN_DIR DIRECT /end RECORD_LAYOUT
/begin RECORD_LAYOUT RB_Curve_S16_U16_Static NO_AXIS_PTS_X 1 SWORD AXIS_PTS_X 2 SWORD INDEX_INCR DIRECT FNC_VALUES 3 UWORD COLUMN_DIR DIRECT STATIC_RECORD_LAYOUT /end RECORD_LAYOUT
/begin RECORD_LAYOUT RB_Curve_S16_U8_Static NO_AXIS_PTS_X 1 SWORD AXIS_PTS_X 2 SWORD INDEX_INCR DIRECT FNC_VALUES 3 UBYTE COLUMN_DIR DIRECT STATIC_RECORD_LAYOUT /end RECORD_LAYOUT
/begin RECORD_LAYOUT RB_Curve_S8_U8_Static NO_AXIS_PTS_X 1 SBYTE AXIS_PTS_X 2 SBYTE INDEX_INCR DIRECT FNC_VALUES 3 UBYTE COLUMN_DIR DIRECT STATIC_RECORD_LAYOUT /end RECORD_LAYOUT
/begin RECORD_LAYOUT RB_Curve_U16_U8_Static NO_AXIS_PTS_X 1 UWORD AXIS_PTS_X 2 UWORD INDEX_INCR DIRECT FNC_VALUES 3 UBYTE COLUMN_DIR DIRECT STATIC_RECORD_LAYOUT /end RECORD_LAYOUT
/begin RECORD_LAYOUT RB_MapGroup_S16 FNC_VALUES 1 SWORD COLUMN_DIR DIRECT /end RECORD_LAYOUT
/begin RECORD_LAYOUT RB_MapGroup_U8 FNC_VALUES 1 UBYTE COLUMN_DIR DIRECT /end RECORD_LAYOUT
/begin RECORD_LAYOUT RB_Map_S16S16_S16 NO_AXIS_PTS_X 1 SWORD NO_AXIS_PTS_Y 2 SWORD AXIS_PTS_X 3 SWORD INDEX_INCR DIRECT AXIS_PTS_Y 4 SWORD INDEX_INCR DIRECT FNC_VALUES 5 SWORD COLUMN_DIR DIRECT /end RECORD_LAYOUT
/begin RECORD_LAYOUT RB_Map_U16U16_U8 NO_AXIS_PTS_X 1 UWORD NO_AXIS_PTS_Y 2 UWORD AXIS_PTS_X 3 UWORD INDEX_INCR DIRECT AXIS_PTS_Y 4 UWORD INDEX_INCR DIRECT FNC_VALUES 5 UBYTE COLUMN_DIR DIRECT /end RECORD_LAYOUT
/begin RECORD_LAYOUT RB_Val_Wboolean FNC_VALUES 1 UBYTE COLUMN_DIR DIRECT /end RECORD_LAYOUT
/begin RECORD_LAYOUT RB_Val_Ws16 FNC_VALUES 1 SWORD COLUMN_DIR DIRECT /end RECORD_LAYOUT
/begin RECORD_LAYOUT RB_Val_Ws8 FNC_VALUES 1 SBYTE COLUMN_DIR DIRECT /end RECORD_LAYOUT
/begin RECORD_LAYOUT RB_Val_Wu16 FNC_VALUES 1 UWORD COLUMN_DIR DIRECT /end RECORD_LAYOUT
/begin RECORD_LAYOUT RB_Val_Wu32 FNC_VALUES 1 ULONG COLUMN_DIR DIRECT /end RECORD_LAYOUT
/begin RECORD_LAYOUT RB_Val_Wu8 FNC_VALUES 1 UBYTE COLUMN_DIR DIRECT /end RECORD_LAYOUT
/begin RECORD_LAYOUT Val_Ws16 FNC_VALUES 1 SWORD COLUMN_DIR DIRECT /end RECORD_LAYOUT
/begin RECORD_LAYOUT Val_Ws32 FNC_VALUES 1 SLONG COLUMN_DIR DIRECT /end RECORD_LAYOUT
/begin RECORD_LAYOUT Val_Wu8 FNC_VALUES 1 UBYTE COLUMN_DIR DIRECT /end RECORD_LAYOUT
/end MODULE
/end PROJECT
