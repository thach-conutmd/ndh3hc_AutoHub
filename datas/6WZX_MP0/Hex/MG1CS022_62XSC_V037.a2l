ASAP2_VERSION 1 60
/begin PROJECT MG1CS022 "MG1CS022"
/begin HEADER "" VERSION "MG1CS022_62XSC_V037" PROJECT_NO MG1CS022 /end HEADER
/begin MODULE DIM ""
/begin MOD_COMMON "" BYTE_ORDER MSB_LAST ALIGNMENT_BYTE 1 ALIGNMENT_WORD 2 ALIGNMENT_LONG 4 ALIGNMENT_INT64 4 ALIGNMENT_FLOAT32_IEEE 4 ALIGNMENT_FLOAT64_IEEE 4 DATA_SIZE 32 /end MOD_COMMON
/begin CHARACTERISTIC DFES_MeterOut.DFC_AAVEmax_C "project specific calibration data / Project specific calibration data for DFC_AAVEmax" VALUE 0x804F5678 Val_Wu8 255.0 OneToOne 0.00 255.0 FORMAT "%5.1" /end CHARACTERISTIC
/begin CHARACTERISTIC DFES_MeterOut.DFC_AAVEmin_C "project specific calibration data / Project specific calibration data for DFC_AAVEmin" VALUE 0x804F5679 Val_Wu8 255.0 OneToOne 0.00 255.0 FORMAT "%5.1" /end CHARACTERISTIC
/begin CHARACTERISTIC DFES_MeterOut.DFC_AAVEsig_C "project specific calibration data / Project specific calibration data for DFC_AAVEsig" VALUE 0x804F567A Val_Wu8 255.0 OneToOne 0.00 255.0 FORMAT "%5.1" /end CHARACTERISTIC
/begin CHARACTERISTIC DFES_MeterOut.DFC_AltIOACGFailr_C "project specific calibration data / Project specific calibration data for DFC_AltIOACGFailr" VALUE 0x804F567B Val_Wu8 255.0 OneToOne 0.00 255.0 FORMAT "%5.1" /end CHARACTERISTIC
/begin CHARACTERISTIC DFES_MeterOut.DFC_AltIOACGHiVltg_C "project specific calibration data / Project specific calibration data for DFC_AltIOACGHiVltg" VALUE 0x804F567C Val_Wu8 255.0 OneToOne 0.00 255.0 FORMAT "%5.1" /end CHARACTERISTIC
/begin CHARACTERISTIC DFES_MeterOut.DFC_AltIOACGLoVltg_C "project specific calibration data / Project specific calibration data for DFC_AltIOACGLoVltg" VALUE 0x804F567D Val_Wu8 255.0 OneToOne 0.00 255.0 FORMAT "%5.1" /end CHARACTERISTIC
/begin CHARACTERISTIC DFES_MeterOut.DFC_AltIOACGTHi_C "project specific calibration data / Project specific calibration data for DFC_AltIOACGTHi" VALUE 0x804F567E Val_Wu8 255.0 OneToOne 0.00 255.0 FORMAT "%5.1" /end CHARACTERISTIC
/begin CHARACTERISTIC DFES_MeterOut.DFC_AltIODConnACG_C "project specific calibration data / Project specific calibration data for DFC_AltIODConnACG" VALUE 0x804F567F Val_Wu8 255.0 OneToOne 0.00 255.0 FORMAT "%5.1" /end CHARACTERISTIC
/begin CHARACTERISTIC DFES_MeterOut.DFC_BGOELWAF_C "project specific calibration data / Project specific calibration data for DFC_BGOELWAF" VALUE 0x804F5680 Val_Wu8 255.0 OneToOne 0.00 255.0 FORMAT "%5.1" /end CHARACTERISTIC
/begin CHARACTERISTIC DFES_MeterOut.DFC_BattUHiFailr_C "project specific calibration data / Project specific calibration data for DFC_BattUHiFailr" VALUE 0x804F5681 Val_Wu8 255.0 OneToOne 0.00 255.0 FORMAT "%5.1" /end CHARACTERISTIC
/begin CHARACTERISTIC DFES_MeterOut.DFC_BattULoFailr_C "project specific calibration data / Project specific calibration data for DFC_BattULoFailr" VALUE 0x804F5682 Val_Wu8 255.0 OneToOne 0.00 255.0 FORMAT "%5.1" /end CHARACTERISTIC
/begin CHARACTERISTIC DFES_MeterOut.DFC_BrkBstPDriftHiErr_C "project specific calibration data / Project specific calibration data for DFC_BrkBstPDriftHiErr" VALUE 0x804F5683 Val_Wu8 255.0 OneToOne 0.00 255.0 FORMAT "%5.1" /end CHARACTERISTIC
/begin CHARACTERISTIC DFES_MeterOut.DFC_BrkBstPDriftLoErr_C "project specific calibration data / Project specific calibration data for DFC_BrkBstPDriftLoErr" VALUE 0x804F5684 Val_Wu8 255.0 OneToOne 0.00 255.0 FORMAT "%5.1" /end CHARACTERISTIC
/begin CHARACTERISTIC DFES_MeterOut.DFC_BrkBstPSnsrStuck_C "project specific calibration data / Project specific calibration data for DFC_BrkBstPSnsrStuck" VALUE 0x804F5685 Val_Wu8 255.0 OneToOne 0.00 255.0 FORMAT "%5.1" /end CHARACTERISTIC
/begin CHARACTERISTIC DFES_MeterOut.DFC_BrkMnSwtContOn_C "project specific calibration data / Project specific calibration data for DFC_BrkMnSwtContOn" VALUE 0x804F5686 Val_Wu8 255.0 OneToOne 0.00 255.0 FORMAT "%5.1" /end CHARACTERISTIC
/begin CHARACTERISTIC DFES_MeterOut.DFC_BrkMnSwtNotStp_C "project specific calibration data / Project specific calibration data for DFC_BrkMnSwtNotStp" VALUE 0x804F5687 Val_Wu8 255.0 OneToOne 0.00 255.0 FORMAT "%5.1" /end CHARACTERISTIC
/begin CHARACTERISTIC DFES_MeterOut.DFC_BrkNpl_C "project specific calibration data / Project specific calibration data for DFC_BrkNpl" VALUE 0x804F5688 Val_Wu8 255.0 OneToOne 0.00 255.0 FORMAT "%5.1" /end CHARACTERISTIC
/begin CHARACTERISTIC DFES_MeterOut.DFC_BrkRdntSwtContOn_C "project specific calibration data / Project specific calibration data for DFC_BrkRdntSwtContOn" VALUE 0x804F5689 Val_Wu8 255.0 OneToOne 0.00 255.0 FORMAT "%5.1" /end CHARACTERISTIC
/begin CHARACTERISTIC DFES_MeterOut.DFC_BrkRdntSwtNotStp_C "project specific calibration data / Project specific calibration data for DFC_BrkRdntSwtNotStp" VALUE 0x804F568A Val_Wu8 255.0 OneToOne 0.00 255.0 FORMAT "%5.1" /end CHARACTERISTIC
/begin CHARACTERISTIC DFES_MeterOut.DFC_Clth3ONStuck_C "project specific calibration data / Project specific calibration data for DFC_Clth3ONStuck" VALUE 0x804F568B Val_Wu8 255.0 OneToOne 0.00 255.0 FORMAT "%5.1" /end CHARACTERISTIC
/begin CHARACTERISTIC DFES_MeterOut.DFC_Clth4OFFStuck_C "project specific calibration data / Project specific calibration data for DFC_Clth4OFFStuck" VALUE 0x804F568C Val_Wu8 255.0 OneToOne 0.00 255.0 FORMAT "%5.1" /end CHARACTERISTIC
/begin CHARACTERISTIC DFES_MeterOut.DFC_ClthOFFStuck_C "project specific calibration data / Project specific calibration data for DFC_ClthOFFStuck" VALUE 0x804F568D Val_Wu8 255.0 OneToOne 0.00 255.0 FORMAT "%5.1" /end CHARACTERISTIC
/begin CHARACTERISTIC DFES_MeterOut.DFC_ClthONStuck_C "project specific calibration data / Project specific calibration data for DFC_ClthONStuck" VALUE 0x804F568E Val_Wu8 255.0 OneToOne 0.00 255.0 FORMAT "%5.1" /end CHARACTERISTIC
/begin CHARACTERISTIC DFES_MeterOut.DFC_ClthStkFailInfo_C "project specific calibration data / Project specific calibration data for DFC_ClthStkFailInfo" VALUE 0x804F568F Val_Wu8 255.0 OneToOne 0.00 255.0 FORMAT "%5.1" /end CHARACTERISTIC
/begin CHARACTERISTIC DFES_MeterOut.DFC_ComACFailInfo_C "project specific calibration data / Project specific calibration data for DFC_ComACFailInfo" VALUE 0x804F5690 Val_Wu8 255.0 OneToOne 0.00 255.0 FORMAT "%5.1" /end CHARACTERISTIC
/begin CHARACTERISTIC DFES_MeterOut.DFC_ComATFTValErr_C "project specific calibration data / Project specific calibration data for DFC_ComATFTValErr" VALUE 0x804F5691 Val_Wu8 255.0 OneToOne 0.00 255.0 FORMAT "%5.1" /end CHARACTERISTIC
/begin CHARACTERISTIC DFES_MeterOut.DFC_ComATMILReq_C "project specific calibration data / Project specific calibration data for DFC_ComATMILReq" VALUE 0x804F5692 Val_Wu8 255.0 OneToOne 0.00 255.0 FORMAT "%5.1" /end CHARACTERISTIC
/begin CHARACTERISTIC DFES_MeterOut.DFC_ComAYCAChksum_C "project specific calibration data / Project specific calibration data for DFC_ComAYCAChksum" VALUE 0x804F5693 Val_Wu8 255.0 OneToOne 0.00 255.0 FORMAT "%5.1" /end CHARACTERISTIC
/begin CHARACTERISTIC DFES_MeterOut.DFC_ComAYCARingCnt_C "project specific calibration data / Project specific calibration data for DFC_ComAYCARingCnt" VALUE 0x804F5694 Val_Wu8 255.0 OneToOne 0.00 255.0 FORMAT "%5.1" /end CHARACTERISTIC
/begin CHARACTERISTIC DFES_MeterOut.DFC_ComAYCATOut_C "project specific calibration data / Project specific calibration data for DFC_ComAYCATOut" VALUE 0x804F5695 Val_Wu8 255.0 OneToOne 0.00 255.0 FORMAT "%5.1" /end CHARACTERISTIC
/begin CHARACTERISTIC DFES_MeterOut.DFC_ComAYCDChkSum_C "project specific calibration data / Project specific calibration data for DFC_ComAYCDChkSum" VALUE 0x804F5696 Val_Wu8 255.0 OneToOne 0.00 255.0 FORMAT "%5.1" /end CHARACTERISTIC
/begin CHARACTERISTIC DFES_MeterOut.DFC_ComAYCDTOut_C "project specific calibration data / Project specific calibration data for DFC_ComAYCDTOut" VALUE 0x804F5697 Val_Wu8 255.0 OneToOne 0.00 255.0 FORMAT "%5.1" /end CHARACTERISTIC
/begin CHARACTERISTIC DFES_MeterOut.DFC_ComAYCFChksum_C "project specific calibration data / Project specific calibration data for DFC_ComAYCFChksum" VALUE 0x804F5698 Val_Wu8 255.0 OneToOne 0.00 255.0 FORMAT "%5.1" /end CHARACTERISTIC
/begin CHARACTERISTIC DFES_MeterOut.DFC_ComAYCFRingCnt_C "project specific calibration data / Project specific calibration data for DFC_ComAYCFRingCnt" VALUE 0x804F5699 Val_Wu8 255.0 OneToOne 0.00 255.0 FORMAT "%5.1" /end CHARACTERISTIC
/begin CHARACTERISTIC DFES_MeterOut.DFC_ComAYCFTOut_C "project specific calibration data / Project specific calibration data for DFC_ComAYCFTOut" VALUE 0x804F569A Val_Wu8 255.0 OneToOne 0.00 255.0 FORMAT "%5.1" /end CHARACTERISTIC
/begin CHARACTERISTIC DSCHED_Excl.AFRA_AORA_C "exclusion relation / Exclusive FIds to FID_AFRA and FID_AORA" VALUE 0x804F54F8 Val_Wu8 255.0 DFC_OneToOne 0.00 255.0 FORMAT "%5.1" /end CHARACTERISTIC
/begin CHARACTERISTIC DSCHED_Excl.AFRA_ATEH_C "exclusion relation / Exclusive FIds to FID_AFRA and FID_ATEH" VALUE 0x804F54F9 Val_Wu8 255.0 DFC_OneToOne 0.00 255.0 FORMAT "%5.1" /end CHARACTERISTIC
/begin CHARACTERISTIC DSCHED_Excl.AFRA_ATEL_C "exclusion relation / Exclusive FIds to FID_AFRA and FID_ATEL" VALUE 0x804F54FA Val_Wu8 255.0 DFC_OneToOne 0.00 255.0 FORMAT "%5.1" /end CHARACTERISTIC
/begin CHARACTERISTIC DSCHED_Excl.AFRA_ATEN_C "exclusion relation / Exclusive FIds to FID_AFRA and FID_ATEN" VALUE 0x804F54FB Val_Wu8 255.0 DFC_OneToOne 0.00 255.0 FORMAT "%5.1" /end CHARACTERISTIC
/begin CHARACTERISTIC DSCHED_Excl.AFRA_ATLDI_C "exclusion relation / Exclusive FIds to FID_AFRA and FID_ATLDI" VALUE 0x804F54FC Val_Wu8 255.0 DFC_OneToOne 0.00 255.0 FORMAT "%5.1" /end CHARACTERISTIC
/begin CHARACTERISTIC DSCHED_Excl.AFRA_ATLDO_C "exclusion relation / Exclusive FIds to FID_AFRA and FID_ATLDO" VALUE 0x804F54FD Val_Wu8 255.0 DFC_OneToOne 0.00 255.0 FORMAT "%5.1" /end CHARACTERISTIC
/begin CHARACTERISTIC DSCHED_Excl.AFRA_BEONV_C "exclusion relation / Exclusive FIds to FID_AFRA and FID_BEONV" VALUE 0x804F54FE Val_Wu8 255.0 DFC_OneToOne 0.00 255.0 FORMAT "%5.1" /end CHARACTERISTIC
/begin CHARACTERISTIC DSCHED_Excl.AFRA_EGSDCmnSeg1B1Parl_C "exclusion relation / Exclusive FIds to FID_AFRA and FId_EGSDCmnSeg1B1Parl" VALUE 0x804F54FF Val_Wu8 255.0 DFC_OneToOne 0.00 255.0 FORMAT "%5.1" /end CHARACTERISTIC
/begin CHARACTERISTIC DSCHED_Excl.AFRA_BAGRA_C "exclusion relation / Exclusive FIds to FID_AFRA and FID_BAGRA" VALUE 0x804F5500 Val_Wu8 255.0 DFC_OneToOne 0.00 255.0 FORMAT "%5.1" /end CHARACTERISTIC
/begin CHARACTERISTIC DSCHED_Excl.AFRA_BAGRASD_C "exclusion relation / Exclusive FIds to FID_AFRA and FID_BAGRASD" VALUE 0x804F5501 Val_Wu8 255.0 DFC_OneToOne 0.00 255.0 FORMAT "%5.1" /end CHARACTERISTIC
/begin CHARACTERISTIC DSCHED_Excl.AFRA_BDSTOF_C "exclusion relation / Exclusive FIds to FID_AFRA and FID_BDSTOF" VALUE 0x804F5502 Val_Wu8 255.0 DFC_OneToOne 0.00 255.0 FORMAT "%5.1" /end CHARACTERISTIC
/begin CHARACTERISTIC DSCHED_Excl.AFRA_BFVDFRM_C "exclusion relation / Exclusive FIds to FID_AFRA and FID_BFVDFRM" VALUE 0x804F5503 Val_Wu8 255.0 DFC_OneToOne 0.00 255.0 FORMAT "%5.1" /end CHARACTERISTIC
/begin CHARACTERISTIC DSCHED_Excl.AFRA_BHOM_C "exclusion relation / Exclusive FIds to FID_AFRA and FID_BHOM" VALUE 0x804F5504 Val_Wu8 255.0 DFC_OneToOne 0.00 255.0 FORMAT "%5.1" /end CHARACTERISTIC
/begin CHARACTERISTIC DSCHED_Excl.AFRA_BLLRH_C "exclusion relation / Exclusive FIds to FID_AFRA and FID_BLLRH" VALUE 0x804F5505 Val_Wu8 255.0 DFC_OneToOne 0.00 255.0 FORMAT "%5.1" /end CHARACTERISTIC
/begin CHARACTERISTIC DSCHED_Excl.AFRA_BLLRKH_C "exclusion relation / Exclusive FIds to FID_AFRA and FID_BLLRKH" VALUE 0x804F5506 Val_Wu8 255.0 DFC_OneToOne 0.00 255.0 FORMAT "%5.1" /end CHARACTERISTIC
/begin CHARACTERISTIC DSCHED_Excl.AFRA_BPLSU_C "exclusion relation / Exclusive FIds to FID_AFRA and FID_BPLSU" VALUE 0x804F5507 Val_Wu8 255.0 DFC_OneToOne 0.00 255.0 FORMAT "%5.1" /end CHARACTERISTIC
/begin CHARACTERISTIC DSCHED_Excl.AFRA_FRAMBAVMB_C "exclusion relation / Exclusive FIds to FID_AFRA and FID_FRAMBAVMB" VALUE 0x804F5508 Val_Wu8 255.0 DFC_OneToOne 0.00 255.0 FORMAT "%5.1" /end CHARACTERISTIC
/begin CHARACTERISTIC DSCHED_Excl.AFRA_CatHeatgColdStrtReq_C "exclusion relation / Exclusive FIds to FID_AFRA and FId_CatHeatgColdStrtReq" VALUE 0x804F5509 Val_Wu8 255.0 DFC_OneToOne 0.00 255.0 FORMAT "%5.1" /end CHARACTERISTIC
/begin CHARACTERISTIC DSCHED_Excl.AFRA_CatHeatgWrmReq_C "exclusion relation / Exclusive FIds to FID_AFRA and FId_CatHeatgWrmReq" VALUE 0x804F550A Val_Wu8 255.0 DFC_OneToOne 0.00 255.0 FORMAT "%5.1" /end CHARACTERISTIC
/begin CHARACTERISTIC DSCHED_Excl.AFRA_DSMBDEPHSpOpMode_C "exclusion relation / Exclusive FIds to FID_AFRA and FId_DSMBDEPHSpOpMode" VALUE 0x804F550B Val_Wu8 255.0 DFC_OneToOne 0.00 255.0 FORMAT "%5.1" /end CHARACTERISTIC
/begin CHARACTERISTIC DSCHED_Excl.AFRA_EGRVlvCoord_C "exclusion relation / Exclusive FIds to FID_AFRA and FId_EGRVlvCoord" VALUE 0x804F550C Val_Wu8 255.0 DFC_OneToOne 0.00 255.0 FORMAT "%5.1" /end CHARACTERISTIC
/begin CHARACTERISTIC DSCHED_Excl.AFRA_EGSDO2FuTrmB1_C "exclusion relation / Exclusive FIds to FID_AFRA and FId_EGSDO2FuTrmB1" VALUE 0x804F550D Val_Wu8 255.0 DFC_OneToOne 0.00 255.0 FORMAT "%5.1" /end CHARACTERISTIC
/begin CHARACTERISTIC DSCHED_Excl.AFRA_EGSDO2SnsrMntdRelsS1B1_C "exclusion relation / Exclusive FIds to FID_AFRA and FId_EGSDO2SnsrMntdRelsS1B1" VALUE 0x804F550E Val_Wu8 255.0 DFC_OneToOne 0.00 255.0 FORMAT "%5.1" /end CHARACTERISTIC
/begin CHARACTERISTIC DSCHED_Excl.AFRA_EGSDO2_LamOffsFastS1B1_C "exclusion relation / Exclusive FIds to FID_AFRA and FId_EGSDO2_LamOffsFastS1B1" VALUE 0x804F550F Val_Wu8 255.0 DFC_OneToOne 0.00 255.0 FORMAT "%5.1" /end CHARACTERISTIC
/begin CHARACTERISTIC DSCHED_Excl.AFRA_MisfDetDnAdpnNv_C "exclusion relation / Exclusive FIds to FID_AFRA and FId_MisfDetDnAdpnNv" VALUE 0x804F5510 Val_Wu8 255.0 DFC_OneToOne 0.00 255.0 FORMAT "%5.1" /end CHARACTERISTIC
/begin CHARACTERISTIC DSCHED_Excl.AFRA_bascadpncvo_C "exclusion relation / Exclusive FIds to FID_AFRA and FId_bascadpncvo" VALUE 0x804F5511 Val_Wu8 255.0 DFC_OneToOne 0.00 255.0 FORMAT "%5.1" /end CHARACTERISTIC
/begin CHARACTERISTIC DSCHED_Excl.AORA_ATEH_C "exclusion relation / Exclusive FIds to FID_AORA and FID_ATEH" VALUE 0x804F5512 Val_Wu8 255.0 DFC_OneToOne 0.00 255.0 FORMAT "%5.1" /end CHARACTERISTIC
/begin CHARACTERISTIC DSCHED_Excl.AORA_ATEL_C "exclusion relation / Exclusive FIds to FID_AORA and FID_ATEL" VALUE 0x804F5513 Val_Wu8 255.0 DFC_OneToOne 0.00 255.0 FORMAT "%5.1" /end CHARACTERISTIC
/begin CHARACTERISTIC DSCHED_Excl.AORA_ATEN_C "exclusion relation / Exclusive FIds to FID_AORA and FID_ATEN" VALUE 0x804F5514 Val_Wu8 255.0 DFC_OneToOne 0.00 255.0 FORMAT "%5.1" /end CHARACTERISTIC
/begin CHARACTERISTIC DSCHED_Excl.AORA_ATLDI_C "exclusion relation / Exclusive FIds to FID_AORA and FID_ATLDI" VALUE 0x804F5515 Val_Wu8 255.0 DFC_OneToOne 0.00 255.0 FORMAT "%5.1" /end CHARACTERISTIC
/begin CHARACTERISTIC DSCHED_Excl.AORA_ATLDO_C "exclusion relation / Exclusive FIds to FID_AORA and FID_ATLDO" VALUE 0x804F5516 Val_Wu8 255.0 DFC_OneToOne 0.00 255.0 FORMAT "%5.1" /end CHARACTERISTIC
/begin CHARACTERISTIC DSCHED_Excl.AORA_BEONV_C "exclusion relation / Exclusive FIds to FID_AORA and FID_BEONV" VALUE 0x804F5517 Val_Wu8 255.0 DFC_OneToOne 0.00 255.0 FORMAT "%5.1" /end CHARACTERISTIC
/begin CHARACTERISTIC DSCHED_Excl.AORA_EGSDCmnSeg1B1Parl_C "exclusion relation / Exclusive FIds to FID_AORA and FId_EGSDCmnSeg1B1Parl" VALUE 0x804F5518 Val_Wu8 255.0 DFC_OneToOne 0.00 255.0 FORMAT "%5.1" /end CHARACTERISTIC
/begin CHARACTERISTIC DSCHED_Excl.AORA_BAGRA_C "exclusion relation / Exclusive FIds to FID_AORA and FID_BAGRA" VALUE 0x804F5519 Val_Wu8 255.0 DFC_OneToOne 0.00 255.0 FORMAT "%5.1" /end CHARACTERISTIC
/begin CHARACTERISTIC DSCHED_Excl.AORA_BAGRASD_C "exclusion relation / Exclusive FIds to FID_AORA and FID_BAGRASD" VALUE 0x804F551A Val_Wu8 255.0 DFC_OneToOne 0.00 255.0 FORMAT "%5.1" /end CHARACTERISTIC
/begin CHARACTERISTIC DSCHED_Excl.AORA_BDSTOF_C "exclusion relation / Exclusive FIds to FID_AORA and FID_BDSTOF" VALUE 0x804F551B Val_Wu8 255.0 DFC_OneToOne 0.00 255.0 FORMAT "%5.1" /end CHARACTERISTIC
/begin CHARACTERISTIC DSCHED_Excl.AORA_BFVDFRM_C "exclusion relation / Exclusive FIds to FID_AORA and FID_BFVDFRM" VALUE 0x804F551C Val_Wu8 255.0 DFC_OneToOne 0.00 255.0 FORMAT "%5.1" /end CHARACTERISTIC
/begin CHARACTERISTIC DSCHED_Excl.AORA_BHOM_C "exclusion relation / Exclusive FIds to FID_AORA and FID_BHOM" VALUE 0x804F551D Val_Wu8 255.0 DFC_OneToOne 0.00 255.0 FORMAT "%5.1" /end CHARACTERISTIC
/begin CHARACTERISTIC DSCHED_Excl.AORA_BLLRH_C "exclusion relation / Exclusive FIds to FID_AORA and FID_BLLRH" VALUE 0x804F551E Val_Wu8 255.0 DFC_OneToOne 0.00 255.0 FORMAT "%5.1" /end CHARACTERISTIC
/begin CHARACTERISTIC DSCHED_Excl.AORA_BLLRKH_C "exclusion relation / Exclusive FIds to FID_AORA and FID_BLLRKH" VALUE 0x804F551F Val_Wu8 255.0 DFC_OneToOne 0.00 255.0 FORMAT "%5.1" /end CHARACTERISTIC
/begin CHARACTERISTIC DSCHED_Excl.AORA_BPLSU_C "exclusion relation / Exclusive FIds to FID_AORA and FID_BPLSU" VALUE 0x804F5520 Val_Wu8 255.0 DFC_OneToOne 0.00 255.0 FORMAT "%5.1" /end CHARACTERISTIC
/begin CHARACTERISTIC DSCHED_Excl.AORA_FRAMBAVMB_C "exclusion relation / Exclusive FIds to FID_AORA and FID_FRAMBAVMB" VALUE 0x804F5521 Val_Wu8 255.0 DFC_OneToOne 0.00 255.0 FORMAT "%5.1" /end CHARACTERISTIC
/begin CHARACTERISTIC DSCHED_Excl.AORA_CatHeatgColdStrtReq_C "exclusion relation / Exclusive FIds to FID_AORA and FId_CatHeatgColdStrtReq" VALUE 0x804F5522 Val_Wu8 255.0 DFC_OneToOne 0.00 255.0 FORMAT "%5.1" /end CHARACTERISTIC
/begin CHARACTERISTIC DSCHED_Excl.AORA_CatHeatgWrmReq_C "exclusion relation / Exclusive FIds to FID_AORA and FId_CatHeatgWrmReq" VALUE 0x804F5523 Val_Wu8 255.0 DFC_OneToOne 0.00 255.0 FORMAT "%5.1" /end CHARACTERISTIC
/begin CHARACTERISTIC DSCHED_Excl.AORA_DSMBDEPHSpOpMode_C "exclusion relation / Exclusive FIds to FID_AORA and FId_DSMBDEPHSpOpMode" VALUE 0x804F5524 Val_Wu8 255.0 DFC_OneToOne 0.00 255.0 FORMAT "%5.1" /end CHARACTERISTIC
/begin CHARACTERISTIC DSCHED_Excl.AORA_EGRVlvCoord_C "exclusion relation / Exclusive FIds to FID_AORA and FId_EGRVlvCoord" VALUE 0x804F5525 Val_Wu8 255.0 DFC_OneToOne 0.00 255.0 FORMAT "%5.1" /end CHARACTERISTIC
/begin CHARACTERISTIC DSCHED_Excl.AORA_EGSDO2FuTrmB1_C "exclusion relation / Exclusive FIds to FID_AORA and FId_EGSDO2FuTrmB1" VALUE 0x804F5526 Val_Wu8 255.0 DFC_OneToOne 0.00 255.0 FORMAT "%5.1" /end CHARACTERISTIC
/begin CHARACTERISTIC DSCHED_Excl.AORA_EGSDO2SnsrMntdRelsS1B1_C "exclusion relation / Exclusive FIds to FID_AORA and FId_EGSDO2SnsrMntdRelsS1B1" VALUE 0x804F5527 Val_Wu8 255.0 DFC_OneToOne 0.00 255.0 FORMAT "%5.1" /end CHARACTERISTIC
/begin CHARACTERISTIC DSCHED_Excl.AORA_EGSDO2_LamOffsFastS1B1_C "exclusion relation / Exclusive FIds to FID_AORA and FId_EGSDO2_LamOffsFastS1B1" VALUE 0x804F5528 Val_Wu8 255.0 DFC_OneToOne 0.00 255.0 FORMAT "%5.1" /end CHARACTERISTIC
/begin CHARACTERISTIC DSCHED_Excl.AORA_MisfDetDnAdpnNv_C "exclusion relation / Exclusive FIds to FID_AORA and FId_MisfDetDnAdpnNv" VALUE 0x804F5529 Val_Wu8 255.0 DFC_OneToOne 0.00 255.0 FORMAT "%5.1" /end CHARACTERISTIC
/begin CHARACTERISTIC DSCHED_Excl.AORA_bascadpncvo_C "exclusion relation / Exclusive FIds to FID_AORA and FId_bascadpncvo" VALUE 0x804F552A Val_Wu8 255.0 DFC_OneToOne 0.00 255.0 FORMAT "%5.1" /end CHARACTERISTIC
/begin CHARACTERISTIC DSCHED_Excl.ATEH_ATEL_C "exclusion relation / Exclusive FIds to FID_ATEH and FID_ATEL" VALUE 0x804F552B Val_Wu8 255.0 DFC_OneToOne 0.00 255.0 FORMAT "%5.1" /end CHARACTERISTIC
/begin CHARACTERISTIC DSCHED_Excl.ATEH_ATEN_C "exclusion relation / Exclusive FIds to FID_ATEH and FID_ATEN" VALUE 0x804F552C Val_Wu8 255.0 DFC_OneToOne 0.00 255.0 FORMAT "%5.1" /end CHARACTERISTIC
/begin CHARACTERISTIC DSCHED_Excl.ATEH_ATLDI_C "exclusion relation / Exclusive FIds to FID_ATEH and FID_ATLDI" VALUE 0x804F552D Val_Wu8 255.0 DFC_OneToOne 0.00 255.0 FORMAT "%5.1" /end CHARACTERISTIC
/begin CHARACTERISTIC DSCHED_Excl.ATEH_ATLDO_C "exclusion relation / Exclusive FIds to FID_ATEH and FID_ATLDO" VALUE 0x804F552E Val_Wu8 255.0 DFC_OneToOne 0.00 255.0 FORMAT "%5.1" /end CHARACTERISTIC
/begin CHARACTERISTIC DSCHED_Excl.ATEH_BEONV_C "exclusion relation / Exclusive FIds to FID_ATEH and FID_BEONV" VALUE 0x804F552F Val_Wu8 255.0 DFC_OneToOne 0.00 255.0 FORMAT "%5.1" /end CHARACTERISTIC
/begin CHARACTERISTIC DSCHED_Excl.ATEH_EGSDCmnSeg1B1Parl_C "exclusion relation / Exclusive FIds to FID_ATEH and FId_EGSDCmnSeg1B1Parl" VALUE 0x804F5530 Val_Wu8 255.0 DFC_OneToOne 0.00 255.0 FORMAT "%5.1" /end CHARACTERISTIC
/begin CHARACTERISTIC DSCHED_Excl.ATEH_BAGRA_C "exclusion relation / Exclusive FIds to FID_ATEH and FID_BAGRA" VALUE 0x804F5531 Val_Wu8 255.0 DFC_OneToOne 0.00 255.0 FORMAT "%5.1" /end CHARACTERISTIC
/begin CHARACTERISTIC DSCHED_Excl.ATEH_BAGRASD_C "exclusion relation / Exclusive FIds to FID_ATEH and FID_BAGRASD" VALUE 0x804F5532 Val_Wu8 255.0 DFC_OneToOne 0.00 255.0 FORMAT "%5.1" /end CHARACTERISTIC
/begin CHARACTERISTIC DSCHED_Excl.ATEH_BDSTOF_C "exclusion relation / Exclusive FIds to FID_ATEH and FID_BDSTOF" VALUE 0x804F5533 Val_Wu8 255.0 DFC_OneToOne 0.00 255.0 FORMAT "%5.1" /end CHARACTERISTIC
/begin CHARACTERISTIC DSCHED_Excl.ATEH_BFVDFRM_C "exclusion relation / Exclusive FIds to FID_ATEH and FID_BFVDFRM" VALUE 0x804F5534 Val_Wu8 255.0 DFC_OneToOne 0.00 255.0 FORMAT "%5.1" /end CHARACTERISTIC
/begin CHARACTERISTIC DSCHED_Excl.ATEH_BHOM_C "exclusion relation / Exclusive FIds to FID_ATEH and FID_BHOM" VALUE 0x804F5535 Val_Wu8 255.0 DFC_OneToOne 0.00 255.0 FORMAT "%5.1" /end CHARACTERISTIC
/begin CHARACTERISTIC DSCHED_Excl.ATEH_BLLRH_C "exclusion relation / Exclusive FIds to FID_ATEH and FID_BLLRH" VALUE 0x804F5536 Val_Wu8 255.0 DFC_OneToOne 0.00 255.0 FORMAT "%5.1" /end CHARACTERISTIC
/begin CHARACTERISTIC DSCHED_Excl.ATEH_BLLRKH_C "exclusion relation / Exclusive FIds to FID_ATEH and FID_BLLRKH" VALUE 0x804F5537 Val_Wu8 255.0 DFC_OneToOne 0.00 255.0 FORMAT "%5.1" /end CHARACTERISTIC
/begin CHARACTERISTIC DSCHED_Excl.ATEH_BPLSU_C "exclusion relation / Exclusive FIds to FID_ATEH and FID_BPLSU" VALUE 0x804F5538 Val_Wu8 255.0 DFC_OneToOne 0.00 255.0 FORMAT "%5.1" /end CHARACTERISTIC
/begin CHARACTERISTIC DSCHED_Excl.ATEH_FRAMBAVMB_C "exclusion relation / Exclusive FIds to FID_ATEH and FID_FRAMBAVMB" VALUE 0x804F5539 Val_Wu8 255.0 DFC_OneToOne 0.00 255.0 FORMAT "%5.1" /end CHARACTERISTIC
/begin CHARACTERISTIC DSCHED_Excl.ATEH_CatHeatgColdStrtReq_C "exclusion relation / Exclusive FIds to FID_ATEH and FId_CatHeatgColdStrtReq" VALUE 0x804F553A Val_Wu8 255.0 DFC_OneToOne 0.00 255.0 FORMAT "%5.1" /end CHARACTERISTIC
/begin CHARACTERISTIC DSCHED_Excl.ATEH_CatHeatgWrmReq_C "exclusion relation / Exclusive FIds to FID_ATEH and FId_CatHeatgWrmReq" VALUE 0x804F553B Val_Wu8 255.0 DFC_OneToOne 0.00 255.0 FORMAT "%5.1" /end CHARACTERISTIC
/begin CHARACTERISTIC DSCHED_Excl.ATEH_DSMBDEPHSpOpMode_C "exclusion relation / Exclusive FIds to FID_ATEH and FId_DSMBDEPHSpOpMode" VALUE 0x804F553C Val_Wu8 255.0 DFC_OneToOne 0.00 255.0 FORMAT "%5.1" /end CHARACTERISTIC
/begin CHARACTERISTIC DSCHED_Excl.ATEH_EGRVlvCoord_C "exclusion relation / Exclusive FIds to FID_ATEH and FId_EGRVlvCoord" VALUE 0x804F553D Val_Wu8 255.0 DFC_OneToOne 0.00 255.0 FORMAT "%5.1" /end CHARACTERISTIC
/begin CHARACTERISTIC DSCHED_Excl.ATEH_EGSDO2FuTrmB1_C "exclusion relation / Exclusive FIds to FID_ATEH and FId_EGSDO2FuTrmB1" VALUE 0x804F553E Val_Wu8 255.0 DFC_OneToOne 0.00 255.0 FORMAT "%5.1" /end CHARACTERISTIC
/begin CHARACTERISTIC DSCHED_Excl.ATEH_EGSDO2SnsrMntdRelsS1B1_C "exclusion relation / Exclusive FIds to FID_ATEH and FId_EGSDO2SnsrMntdRelsS1B1" VALUE 0x804F553F Val_Wu8 255.0 DFC_OneToOne 0.00 255.0 FORMAT "%5.1" /end CHARACTERISTIC
/begin CHARACTERISTIC DSCHED_Excl.ATEH_EGSDO2_LamOffsFastS1B1_C "exclusion relation / Exclusive FIds to FID_ATEH and FId_EGSDO2_LamOffsFastS1B1" VALUE 0x804F5540 Val_Wu8 255.0 DFC_OneToOne 0.00 255.0 FORMAT "%5.1" /end CHARACTERISTIC
/begin CHARACTERISTIC DSCHED_Excl.ATEH_MisfDetDnAdpnNv_C "exclusion relation / Exclusive FIds to FID_ATEH and FId_MisfDetDnAdpnNv" VALUE 0x804F5541 Val_Wu8 255.0 DFC_OneToOne 0.00 255.0 FORMAT "%5.1" /end CHARACTERISTIC
/begin CHARACTERISTIC DSCHED_Excl.ATEH_bascadpncvo_C "exclusion relation / Exclusive FIds to FID_ATEH and FId_bascadpncvo" VALUE 0x804F5542 Val_Wu8 255.0 DFC_OneToOne 0.00 255.0 FORMAT "%5.1" /end CHARACTERISTIC
/begin CHARACTERISTIC DSCHED_Excl.ATEL_ATEN_C "exclusion relation / Exclusive FIds to FID_ATEL and FID_ATEN" VALUE 0x804F5543 Val_Wu8 255.0 DFC_OneToOne 0.00 255.0 FORMAT "%5.1" /end CHARACTERISTIC
/begin CHARACTERISTIC DSCHED_Excl.ATEL_ATLDI_C "exclusion relation / Exclusive FIds to FID_ATEL and FID_ATLDI" VALUE 0x804F5544 Val_Wu8 255.0 DFC_OneToOne 0.00 255.0 FORMAT "%5.1" /end CHARACTERISTIC
/begin CHARACTERISTIC DSCHED_Excl.ATEL_ATLDO_C "exclusion relation / Exclusive FIds to FID_ATEL and FID_ATLDO" VALUE 0x804F5545 Val_Wu8 255.0 DFC_OneToOne 0.00 255.0 FORMAT "%5.1" /end CHARACTERISTIC
/begin CHARACTERISTIC DSCHED_Excl.ATEL_BEONV_C "exclusion relation / Exclusive FIds to FID_ATEL and FID_BEONV" VALUE 0x804F5546 Val_Wu8 255.0 DFC_OneToOne 0.00 255.0 FORMAT "%5.1" /end CHARACTERISTIC
/begin CHARACTERISTIC DSCHED_Excl.ATEL_EGSDCmnSeg1B1Parl_C "exclusion relation / Exclusive FIds to FID_ATEL and FId_EGSDCmnSeg1B1Parl" VALUE 0x804F5547 Val_Wu8 255.0 DFC_OneToOne 0.00 255.0 FORMAT "%5.1" /end CHARACTERISTIC
/begin CHARACTERISTIC DSCHED_Excl.ATEL_BAGRA_C "exclusion relation / Exclusive FIds to FID_ATEL and FID_BAGRA" VALUE 0x804F5548 Val_Wu8 255.0 DFC_OneToOne 0.00 255.0 FORMAT "%5.1" /end CHARACTERISTIC
/begin CHARACTERISTIC DSCHED_Excl.ATEL_BAGRASD_C "exclusion relation / Exclusive FIds to FID_ATEL and FID_BAGRASD" VALUE 0x804F5549 Val_Wu8 255.0 DFC_OneToOne 0.00 255.0 FORMAT "%5.1" /end CHARACTERISTIC
/begin CHARACTERISTIC DSCHED_Excl.ATEL_BDSTOF_C "exclusion relation / Exclusive FIds to FID_ATEL and FID_BDSTOF" VALUE 0x804F554A Val_Wu8 255.0 DFC_OneToOne 0.00 255.0 FORMAT "%5.1" /end CHARACTERISTIC
/begin CHARACTERISTIC DSCHED_Excl.ATEL_BFVDFRM_C "exclusion relation / Exclusive FIds to FID_ATEL and FID_BFVDFRM" VALUE 0x804F554B Val_Wu8 255.0 DFC_OneToOne 0.00 255.0 FORMAT "%5.1" /end CHARACTERISTIC
/begin CHARACTERISTIC DSCHED_Excl.ATEL_BHOM_C "exclusion relation / Exclusive FIds to FID_ATEL and FID_BHOM" VALUE 0x804F554C Val_Wu8 255.0 DFC_OneToOne 0.00 255.0 FORMAT "%5.1" /end CHARACTERISTIC
/begin CHARACTERISTIC DSCHED_Excl.ATEL_BLLRH_C "exclusion relation / Exclusive FIds to FID_ATEL and FID_BLLRH" VALUE 0x804F554D Val_Wu8 255.0 DFC_OneToOne 0.00 255.0 FORMAT "%5.1" /end CHARACTERISTIC
/begin CHARACTERISTIC DSCHED_Excl.ATEL_BLLRKH_C "exclusion relation / Exclusive FIds to FID_ATEL and FID_BLLRKH" VALUE 0x804F554E Val_Wu8 255.0 DFC_OneToOne 0.00 255.0 FORMAT "%5.1" /end CHARACTERISTIC
/begin CHARACTERISTIC DSCHED_Excl.ATEL_BPLSU_C "exclusion relation / Exclusive FIds to FID_ATEL and FID_BPLSU" VALUE 0x804F554F Val_Wu8 255.0 DFC_OneToOne 0.00 255.0 FORMAT "%5.1" /end CHARACTERISTIC
/begin CHARACTERISTIC DSCHED_Excl.ATEL_FRAMBAVMB_C "exclusion relation / Exclusive FIds to FID_ATEL and FID_FRAMBAVMB" VALUE 0x804F5550 Val_Wu8 255.0 DFC_OneToOne 0.00 255.0 FORMAT "%5.1" /end CHARACTERISTIC
/begin CHARACTERISTIC DSCHED_Excl.ATEL_CatHeatgColdStrtReq_C "exclusion relation / Exclusive FIds to FID_ATEL and FId_CatHeatgColdStrtReq" VALUE 0x804F5551 Val_Wu8 255.0 DFC_OneToOne 0.00 255.0 FORMAT "%5.1" /end CHARACTERISTIC
/begin CHARACTERISTIC DSCHED_Excl.ATEL_CatHeatgWrmReq_C "exclusion relation / Exclusive FIds to FID_ATEL and FId_CatHeatgWrmReq" VALUE 0x804F5552 Val_Wu8 255.0 DFC_OneToOne 0.00 255.0 FORMAT "%5.1" /end CHARACTERISTIC
/begin CHARACTERISTIC DSCHED_Excl.ATEL_DSMBDEPHSpOpMode_C "exclusion relation / Exclusive FIds to FID_ATEL and FId_DSMBDEPHSpOpMode" VALUE 0x804F5553 Val_Wu8 255.0 DFC_OneToOne 0.00 255.0 FORMAT "%5.1" /end CHARACTERISTIC
/begin CHARACTERISTIC DSCHED_Excl.ATEL_EGRVlvCoord_C "exclusion relation / Exclusive FIds to FID_ATEL and FId_EGRVlvCoord" VALUE 0x804F5554 Val_Wu8 255.0 DFC_OneToOne 0.00 255.0 FORMAT "%5.1" /end CHARACTERISTIC
/begin CHARACTERISTIC DSCHED_Excl.ATEL_EGSDO2FuTrmB1_C "exclusion relation / Exclusive FIds to FID_ATEL and FId_EGSDO2FuTrmB1" VALUE 0x804F5555 Val_Wu8 255.0 DFC_OneToOne 0.00 255.0 FORMAT "%5.1" /end CHARACTERISTIC
/begin CHARACTERISTIC DSCHED_Excl.ATEL_EGSDO2SnsrMntdRelsS1B1_C "exclusion relation / Exclusive FIds to FID_ATEL and FId_EGSDO2SnsrMntdRelsS1B1" VALUE 0x804F5556 Val_Wu8 255.0 DFC_OneToOne 0.00 255.0 FORMAT "%5.1" /end CHARACTERISTIC
/begin CHARACTERISTIC DSCHED_Excl.ATEL_EGSDO2_LamOffsFastS1B1_C "exclusion relation / Exclusive FIds to FID_ATEL and FId_EGSDO2_LamOffsFastS1B1" VALUE 0x804F5557 Val_Wu8 255.0 DFC_OneToOne 0.00 255.0 FORMAT "%5.1" /end CHARACTERISTIC
/begin CHARACTERISTIC DSCHED_Excl.ATEL_MisfDetDnAdpnNv_C "exclusion relation / Exclusive FIds to FID_ATEL and FId_MisfDetDnAdpnNv" VALUE 0x804F5558 Val_Wu8 255.0 DFC_OneToOne 0.00 255.0 FORMAT "%5.1" /end CHARACTERISTIC
/begin CHARACTERISTIC DSCHED_Excl.ATEL_bascadpncvo_C "exclusion relation / Exclusive FIds to FID_ATEL and FId_bascadpncvo" VALUE 0x804F5559 Val_Wu8 255.0 DFC_OneToOne 0.00 255.0 FORMAT "%5.1" /end CHARACTERISTIC
/begin CHARACTERISTIC DSCHED_Excl.ATEN_ATLDI_C "exclusion relation / Exclusive FIds to FID_ATEN and FID_ATLDI" VALUE 0x804F555A Val_Wu8 255.0 DFC_OneToOne 0.00 255.0 FORMAT "%5.1" /end CHARACTERISTIC
/begin CHARACTERISTIC DSCHED_Excl.ATEN_ATLDO_C "exclusion relation / Exclusive FIds to FID_ATEN and FID_ATLDO" VALUE 0x804F555B Val_Wu8 255.0 DFC_OneToOne 0.00 255.0 FORMAT "%5.1" /end CHARACTERISTIC
/begin CHARACTERISTIC DSCHED_Excl.ATEN_BEONV_C "exclusion relation / Exclusive FIds to FID_ATEN and FID_BEONV" VALUE 0x804F555C Val_Wu8 255.0 DFC_OneToOne 0.00 255.0 FORMAT "%5.1" /end CHARACTERISTIC
/begin CHARACTERISTIC DSCHED_Excl.ATEN_EGSDCmnSeg1B1Parl_C "exclusion relation / Exclusive FIds to FID_ATEN and FId_EGSDCmnSeg1B1Parl" VALUE 0x804F555D Val_Wu8 255.0 DFC_OneToOne 0.00 255.0 FORMAT "%5.1" /end CHARACTERISTIC
/begin CHARACTERISTIC DSCHED_Excl.ATEN_BAGRA_C "exclusion relation / Exclusive FIds to FID_ATEN and FID_BAGRA" VALUE 0x804F555E Val_Wu8 255.0 DFC_OneToOne 0.00 255.0 FORMAT "%5.1" /end CHARACTERISTIC
/begin CHARACTERISTIC DSCHED_Excl.ATEN_BAGRASD_C "exclusion relation / Exclusive FIds to FID_ATEN and FID_BAGRASD" VALUE 0x804F555F Val_Wu8 255.0 DFC_OneToOne 0.00 255.0 FORMAT "%5.1" /end CHARACTERISTIC
/begin CHARACTERISTIC DSCHED_Excl.ATEN_BDSTOF_C "exclusion relation / Exclusive FIds to FID_ATEN and FID_BDSTOF" VALUE 0x804F5560 Val_Wu8 255.0 DFC_OneToOne 0.00 255.0 FORMAT "%5.1" /end CHARACTERISTIC
/begin CHARACTERISTIC DSCHED_Excl.ATEN_BFVDFRM_C "exclusion relation / Exclusive FIds to FID_ATEN and FID_BFVDFRM" VALUE 0x804F5561 Val_Wu8 255.0 DFC_OneToOne 0.00 255.0 FORMAT "%5.1" /end CHARACTERISTIC
/begin CHARACTERISTIC DSCHED_Excl.ATEN_BHOM_C "exclusion relation / Exclusive FIds to FID_ATEN and FID_BHOM" VALUE 0x804F5562 Val_Wu8 255.0 DFC_OneToOne 0.00 255.0 FORMAT "%5.1" /end CHARACTERISTIC
/begin CHARACTERISTIC DSCHED_Excl.ATEN_BLLRH_C "exclusion relation / Exclusive FIds to FID_ATEN and FID_BLLRH" VALUE 0x804F5563 Val_Wu8 255.0 DFC_OneToOne 0.00 255.0 FORMAT "%5.1" /end CHARACTERISTIC
/begin CHARACTERISTIC DSCHED_Excl.ATEN_BLLRKH_C "exclusion relation / Exclusive FIds to FID_ATEN and FID_BLLRKH" VALUE 0x804F5564 Val_Wu8 255.0 DFC_OneToOne 0.00 255.0 FORMAT "%5.1" /end CHARACTERISTIC
/begin CHARACTERISTIC DSCHED_Excl.ATEN_BPLSU_C "exclusion relation / Exclusive FIds to FID_ATEN and FID_BPLSU" VALUE 0x804F5565 Val_Wu8 255.0 DFC_OneToOne 0.00 255.0 FORMAT "%5.1" /end CHARACTERISTIC
/begin CHARACTERISTIC DSCHED_Excl.ATEN_FRAMBAVMB_C "exclusion relation / Exclusive FIds to FID_ATEN and FID_FRAMBAVMB" VALUE 0x804F5566 Val_Wu8 255.0 DFC_OneToOne 0.00 255.0 FORMAT "%5.1" /end CHARACTERISTIC
/begin CHARACTERISTIC DSCHED_Excl.ATEN_CatHeatgColdStrtReq_C "exclusion relation / Exclusive FIds to FID_ATEN and FId_CatHeatgColdStrtReq" VALUE 0x804F5567 Val_Wu8 255.0 DFC_OneToOne 0.00 255.0 FORMAT "%5.1" /end CHARACTERISTIC
/begin CHARACTERISTIC DSCHED_Excl.ATEN_CatHeatgWrmReq_C "exclusion relation / Exclusive FIds to FID_ATEN and FId_CatHeatgWrmReq" VALUE 0x804F5568 Val_Wu8 255.0 DFC_OneToOne 0.00 255.0 FORMAT "%5.1" /end CHARACTERISTIC
/begin CHARACTERISTIC DSCHED_Excl.ATEN_DSMBDEPHSpOpMode_C "exclusion relation / Exclusive FIds to FID_ATEN and FId_DSMBDEPHSpOpMode" VALUE 0x804F5569 Val_Wu8 255.0 DFC_OneToOne 0.00 255.0 FORMAT "%5.1" /end CHARACTERISTIC
/begin CHARACTERISTIC DSCHED_Excl.ATEN_EGRVlvCoord_C "exclusion relation / Exclusive FIds to FID_ATEN and FId_EGRVlvCoord" VALUE 0x804F556A Val_Wu8 255.0 DFC_OneToOne 0.00 255.0 FORMAT "%5.1" /end CHARACTERISTIC
/begin CHARACTERISTIC DSCHED_Excl.ATEN_EGSDO2FuTrmB1_C "exclusion relation / Exclusive FIds to FID_ATEN and FId_EGSDO2FuTrmB1" VALUE 0x804F556B Val_Wu8 255.0 DFC_OneToOne 0.00 255.0 FORMAT "%5.1" /end CHARACTERISTIC
/begin CHARACTERISTIC DSCHED_Excl.ATEN_EGSDO2SnsrMntdRelsS1B1_C "exclusion relation / Exclusive FIds to FID_ATEN and FId_EGSDO2SnsrMntdRelsS1B1" VALUE 0x804F556C Val_Wu8 255.0 DFC_OneToOne 0.00 255.0 FORMAT "%5.1" /end CHARACTERISTIC
/begin CHARACTERISTIC DSCHED_Excl.ATEN_EGSDO2_LamOffsFastS1B1_C "exclusion relation / Exclusive FIds to FID_ATEN and FId_EGSDO2_LamOffsFastS1B1" VALUE 0x804F556D Val_Wu8 255.0 DFC_OneToOne 0.00 255.0 FORMAT "%5.1" /end CHARACTERISTIC
/begin CHARACTERISTIC DSCHED_Excl.ATEN_MisfDetDnAdpnNv_C "exclusion relation / Exclusive FIds to FID_ATEN and FId_MisfDetDnAdpnNv" VALUE 0x804F556E Val_Wu8 255.0 DFC_OneToOne 0.00 255.0 FORMAT "%5.1" /end CHARACTERISTIC
/begin CHARACTERISTIC DSCHED_Excl.ATEN_bascadpncvo_C "exclusion relation / Exclusive FIds to FID_ATEN and FId_bascadpncvo" VALUE 0x804F556F Val_Wu8 255.0 DFC_OneToOne 0.00 255.0 FORMAT "%5.1" /end CHARACTERISTIC
/begin CHARACTERISTIC DSCHED_Excl.ATLDI_ATLDO_C "exclusion relation / Exclusive FIds to FID_ATLDI and FID_ATLDO" VALUE 0x804F5570 Val_Wu8 255.0 DFC_OneToOne 0.00 255.0 FORMAT "%5.1" /end CHARACTERISTIC
/begin CHARACTERISTIC DSCHED_Excl.ATLDI_BEONV_C "exclusion relation / Exclusive FIds to FID_ATLDI and FID_BEONV" VALUE 0x804F5571 Val_Wu8 255.0 DFC_OneToOne 0.00 255.0 FORMAT "%5.1" /end CHARACTERISTIC
/begin CHARACTERISTIC DSCHED_Excl.ATLDI_EGSDCmnSeg1B1Parl_C "exclusion relation / Exclusive FIds to FID_ATLDI and FId_EGSDCmnSeg1B1Parl" VALUE 0x804F5572 Val_Wu8 255.0 DFC_OneToOne 0.00 255.0 FORMAT "%5.1" /end CHARACTERISTIC
/begin CHARACTERISTIC DSCHED_Excl.ATLDI_BAGRA_C "exclusion relation / Exclusive FIds to FID_ATLDI and FID_BAGRA" VALUE 0x804F5573 Val_Wu8 255.0 DFC_OneToOne 0.00 255.0 FORMAT "%5.1" /end CHARACTERISTIC
/begin CHARACTERISTIC DSCHED_Excl.ATLDI_BAGRASD_C "exclusion relation / Exclusive FIds to FID_ATLDI and FID_BAGRASD" VALUE 0x804F5574 Val_Wu8 255.0 DFC_OneToOne 0.00 255.0 FORMAT "%5.1" /end CHARACTERISTIC
/begin CHARACTERISTIC DSCHED_Excl.ATLDI_BDSTOF_C "exclusion relation / Exclusive FIds to FID_ATLDI and FID_BDSTOF" VALUE 0x804F5575 Val_Wu8 255.0 DFC_OneToOne 0.00 255.0 FORMAT "%5.1" /end CHARACTERISTIC
/begin CHARACTERISTIC DSCHED_Excl.ATLDI_BFVDFRM_C "exclusion relation / Exclusive FIds to FID_ATLDI and FID_BFVDFRM" VALUE 0x804F5576 Val_Wu8 255.0 DFC_OneToOne 0.00 255.0 FORMAT "%5.1" /end CHARACTERISTIC
/begin CHARACTERISTIC DSCHED_Excl.ATLDI_BHOM_C "exclusion relation / Exclusive FIds to FID_ATLDI and FID_BHOM" VALUE 0x804F5577 Val_Wu8 255.0 DFC_OneToOne 0.00 255.0 FORMAT "%5.1" /end CHARACTERISTIC
/begin CHARACTERISTIC DSCHED_Excl.ATLDI_BLLRH_C "exclusion relation / Exclusive FIds to FID_ATLDI and FID_BLLRH" VALUE 0x804F5578 Val_Wu8 255.0 DFC_OneToOne 0.00 255.0 FORMAT "%5.1" /end CHARACTERISTIC
/begin CHARACTERISTIC DSCHED_Excl.ATLDI_BLLRKH_C "exclusion relation / Exclusive FIds to FID_ATLDI and FID_BLLRKH" VALUE 0x804F5579 Val_Wu8 255.0 DFC_OneToOne 0.00 255.0 FORMAT "%5.1" /end CHARACTERISTIC
/begin CHARACTERISTIC DSCHED_Excl.ATLDI_BPLSU_C "exclusion relation / Exclusive FIds to FID_ATLDI and FID_BPLSU" VALUE 0x804F557A Val_Wu8 255.0 DFC_OneToOne 0.00 255.0 FORMAT "%5.1" /end CHARACTERISTIC
/begin CHARACTERISTIC DSCHED_Excl.ATLDI_FRAMBAVMB_C "exclusion relation / Exclusive FIds to FID_ATLDI and FID_FRAMBAVMB" VALUE 0x804F557B Val_Wu8 255.0 DFC_OneToOne 0.00 255.0 FORMAT "%5.1" /end CHARACTERISTIC
/begin CHARACTERISTIC DSCHED_Excl.ATLDI_CatHeatgColdStrtReq_C "exclusion relation / Exclusive FIds to FID_ATLDI and FId_CatHeatgColdStrtReq" VALUE 0x804F557C Val_Wu8 255.0 DFC_OneToOne 0.00 255.0 FORMAT "%5.1" /end CHARACTERISTIC
/begin CHARACTERISTIC DSCHED_Excl.ATLDI_CatHeatgWrmReq_C "exclusion relation / Exclusive FIds to FID_ATLDI and FId_CatHeatgWrmReq" VALUE 0x804F557D Val_Wu8 255.0 DFC_OneToOne 0.00 255.0 FORMAT "%5.1" /end CHARACTERISTIC
/begin CHARACTERISTIC DSCHED_Excl.ATLDI_DSMBDEPHSpOpMode_C "exclusion relation / Exclusive FIds to FID_ATLDI and FId_DSMBDEPHSpOpMode" VALUE 0x804F557E Val_Wu8 255.0 DFC_OneToOne 0.00 255.0 FORMAT "%5.1" /end CHARACTERISTIC
/begin CHARACTERISTIC DSCHED_Excl.ATLDI_EGRVlvCoord_C "exclusion relation / Exclusive FIds to FID_ATLDI and FId_EGRVlvCoord" VALUE 0x804F557F Val_Wu8 255.0 DFC_OneToOne 0.00 255.0 FORMAT "%5.1" /end CHARACTERISTIC
/begin CHARACTERISTIC DSCHED_Excl.ATLDI_EGSDO2FuTrmB1_C "exclusion relation / Exclusive FIds to FID_ATLDI and FId_EGSDO2FuTrmB1" VALUE 0x804F5580 Val_Wu8 255.0 DFC_OneToOne 0.00 255.0 FORMAT "%5.1" /end CHARACTERISTIC
/begin CHARACTERISTIC DSCHED_Excl.ATLDI_EGSDO2SnsrMntdRelsS1B1_C "exclusion relation / Exclusive FIds to FID_ATLDI and FId_EGSDO2SnsrMntdRelsS1B1" VALUE 0x804F5581 Val_Wu8 255.0 DFC_OneToOne 0.00 255.0 FORMAT "%5.1" /end CHARACTERISTIC
/begin CHARACTERISTIC DSCHED_Excl.ATLDI_EGSDO2_LamOffsFastS1B1_C "exclusion relation / Exclusive FIds to FID_ATLDI and FId_EGSDO2_LamOffsFastS1B1" VALUE 0x804F5582 Val_Wu8 255.0 DFC_OneToOne 0.00 255.0 FORMAT "%5.1" /end CHARACTERISTIC
/begin CHARACTERISTIC DSCHED_Excl.ATLDI_MisfDetDnAdpnNv_C "exclusion relation / Exclusive FIds to FID_ATLDI and FId_MisfDetDnAdpnNv" VALUE 0x804F5583 Val_Wu8 255.0 DFC_OneToOne 0.00 255.0 FORMAT "%5.1" /end CHARACTERISTIC
/begin CHARACTERISTIC DSCHED_Excl.ATLDI_bascadpncvo_C "exclusion relation / Exclusive FIds to FID_ATLDI and FId_bascadpncvo" VALUE 0x804F5584 Val_Wu8 255.0 DFC_OneToOne 0.00 255.0 FORMAT "%5.1" /end CHARACTERISTIC
/begin CHARACTERISTIC DSCHED_Excl.ATLDO_BEONV_C "exclusion relation / Exclusive FIds to FID_ATLDO and FID_BEONV" VALUE 0x804F5585 Val_Wu8 255.0 DFC_OneToOne 0.00 255.0 FORMAT "%5.1" /end CHARACTERISTIC
/begin CHARACTERISTIC DSCHED_Excl.ATLDO_EGSDCmnSeg1B1Parl_C "exclusion relation / Exclusive FIds to FID_ATLDO and FId_EGSDCmnSeg1B1Parl" VALUE 0x804F5586 Val_Wu8 255.0 DFC_OneToOne 0.00 255.0 FORMAT "%5.1" /end CHARACTERISTIC
/begin CHARACTERISTIC DSCHED_Excl.ATLDO_BAGRA_C "exclusion relation / Exclusive FIds to FID_ATLDO and FID_BAGRA" VALUE 0x804F5587 Val_Wu8 255.0 DFC_OneToOne 0.00 255.0 FORMAT "%5.1" /end CHARACTERISTIC
/begin CHARACTERISTIC DSCHED_Excl.ATLDO_BAGRASD_C "exclusion relation / Exclusive FIds to FID_ATLDO and FID_BAGRASD" VALUE 0x804F5588 Val_Wu8 255.0 DFC_OneToOne 0.00 255.0 FORMAT "%5.1" /end CHARACTERISTIC
/begin CHARACTERISTIC DSCHED_Excl.ATLDO_BDSTOF_C "exclusion relation / Exclusive FIds to FID_ATLDO and FID_BDSTOF" VALUE 0x804F5589 Val_Wu8 255.0 DFC_OneToOne 0.00 255.0 FORMAT "%5.1" /end CHARACTERISTIC
/begin CHARACTERISTIC DSCHED_Excl.ATLDO_BFVDFRM_C "exclusion relation / Exclusive FIds to FID_ATLDO and FID_BFVDFRM" VALUE 0x804F558A Val_Wu8 255.0 DFC_OneToOne 0.00 255.0 FORMAT "%5.1" /end CHARACTERISTIC
/begin CHARACTERISTIC DSCHED_Excl.ATLDO_BHOM_C "exclusion relation / Exclusive FIds to FID_ATLDO and FID_BHOM" VALUE 0x804F558B Val_Wu8 255.0 DFC_OneToOne 0.00 255.0 FORMAT "%5.1" /end CHARACTERISTIC
/begin CHARACTERISTIC DSCHED_Excl.ATLDO_BLLRH_C "exclusion relation / Exclusive FIds to FID_ATLDO and FID_BLLRH" VALUE 0x804F558C Val_Wu8 255.0 DFC_OneToOne 0.00 255.0 FORMAT "%5.1" /end CHARACTERISTIC
/begin CHARACTERISTIC DSCHED_Excl.ATLDO_BLLRKH_C "exclusion relation / Exclusive FIds to FID_ATLDO and FID_BLLRKH" VALUE 0x804F558D Val_Wu8 255.0 DFC_OneToOne 0.00 255.0 FORMAT "%5.1" /end CHARACTERISTIC
/begin CHARACTERISTIC DSCHED_Excl.ATLDO_BPLSU_C "exclusion relation / Exclusive FIds to FID_ATLDO and FID_BPLSU" VALUE 0x804F558E Val_Wu8 255.0 DFC_OneToOne 0.00 255.0 FORMAT "%5.1" /end CHARACTERISTIC
/begin CHARACTERISTIC DSCHED_Excl.ATLDO_FRAMBAVMB_C "exclusion relation / Exclusive FIds to FID_ATLDO and FID_FRAMBAVMB" VALUE 0x804F558F Val_Wu8 255.0 DFC_OneToOne 0.00 255.0 FORMAT "%5.1" /end CHARACTERISTIC
/begin CHARACTERISTIC DSCHED_Excl.ATLDO_CatHeatgColdStrtReq_C "exclusion relation / Exclusive FIds to FID_ATLDO and FId_CatHeatgColdStrtReq" VALUE 0x804F5590 Val_Wu8 255.0 DFC_OneToOne 0.00 255.0 FORMAT "%5.1" /end CHARACTERISTIC
/begin CHARACTERISTIC DSCHED_Excl.ATLDO_CatHeatgWrmReq_C "exclusion relation / Exclusive FIds to FID_ATLDO and FId_CatHeatgWrmReq" VALUE 0x804F5591 Val_Wu8 255.0 DFC_OneToOne 0.00 255.0 FORMAT "%5.1" /end CHARACTERISTIC
/begin CHARACTERISTIC DSCHED_Excl.ATLDO_DSMBDEPHSpOpMode_C "exclusion relation / Exclusive FIds to FID_ATLDO and FId_DSMBDEPHSpOpMode" VALUE 0x804F5592 Val_Wu8 255.0 DFC_OneToOne 0.00 255.0 FORMAT "%5.1" /end CHARACTERISTIC
/begin CHARACTERISTIC DSCHED_Excl.ATLDO_EGRVlvCoord_C "exclusion relation / Exclusive FIds to FID_ATLDO and FId_EGRVlvCoord" VALUE 0x804F5593 Val_Wu8 255.0 DFC_OneToOne 0.00 255.0 FORMAT "%5.1" /end CHARACTERISTIC
/begin CHARACTERISTIC DSCHED_Excl.ATLDO_EGSDO2FuTrmB1_C "exclusion relation / Exclusive FIds to FID_ATLDO and FId_EGSDO2FuTrmB1" VALUE 0x804F5594 Val_Wu8 255.0 DFC_OneToOne 0.00 255.0 FORMAT "%5.1" /end CHARACTERISTIC
/begin CHARACTERISTIC DSCHED_Excl.ATLDO_EGSDO2SnsrMntdRelsS1B1_C "exclusion relation / Exclusive FIds to FID_ATLDO and FId_EGSDO2SnsrMntdRelsS1B1" VALUE 0x804F5595 Val_Wu8 255.0 DFC_OneToOne 0.00 255.0 FORMAT "%5.1" /end CHARACTERISTIC
/begin CHARACTERISTIC DSCHED_Excl.ATLDO_EGSDO2_LamOffsFastS1B1_C "exclusion relation / Exclusive FIds to FID_ATLDO and FId_EGSDO2_LamOffsFastS1B1" VALUE 0x804F5596 Val_Wu8 255.0 DFC_OneToOne 0.00 255.0 FORMAT "%5.1" /end CHARACTERISTIC
/begin CHARACTERISTIC DSCHED_Excl.ATLDO_MisfDetDnAdpnNv_C "exclusion relation / Exclusive FIds to FID_ATLDO and FId_MisfDetDnAdpnNv" VALUE 0x804F5597 Val_Wu8 255.0 DFC_OneToOne 0.00 255.0 FORMAT "%5.1" /end CHARACTERISTIC
/begin CHARACTERISTIC DSCHED_Excl.ATLDO_bascadpncvo_C "exclusion relation / Exclusive FIds to FID_ATLDO and FId_bascadpncvo" VALUE 0x804F5598 Val_Wu8 255.0 DFC_OneToOne 0.00 255.0 FORMAT "%5.1" /end CHARACTERISTIC
/begin CHARACTERISTIC DSCHED_Excl.BEONV_EGSDCmnSeg1B1Parl_C "exclusion relation / Exclusive FIds to FID_BEONV and FId_EGSDCmnSeg1B1Parl" VALUE 0x804F5599 Val_Wu8 255.0 DFC_OneToOne 0.00 255.0 FORMAT "%5.1" /end CHARACTERISTIC
/begin CHARACTERISTIC DSCHED_Excl.BEONV_BAGRA_C "exclusion relation / Exclusive FIds to FID_BEONV and FID_BAGRA" VALUE 0x804F559A Val_Wu8 255.0 DFC_OneToOne 0.00 255.0 FORMAT "%5.1" /end CHARACTERISTIC
/begin CHARACTERISTIC DSCHED_Excl.BEONV_BAGRASD_C "exclusion relation / Exclusive FIds to FID_BEONV and FID_BAGRASD" VALUE 0x804F559B Val_Wu8 255.0 DFC_OneToOne 0.00 255.0 FORMAT "%5.1" /end CHARACTERISTIC
/begin CHARACTERISTIC DSCHED_Excl.BEONV_BDSTOF_C "exclusion relation / Exclusive FIds to FID_BEONV and FID_BDSTOF" VALUE 0x804F559C Val_Wu8 255.0 DFC_OneToOne 0.00 255.0 FORMAT "%5.1" /end CHARACTERISTIC
/begin CHARACTERISTIC DSCHED_Excl.BEONV_BFVDFRM_C "exclusion relation / Exclusive FIds to FID_BEONV and FID_BFVDFRM" VALUE 0x804F559D Val_Wu8 255.0 DFC_OneToOne 0.00 255.0 FORMAT "%5.1" /end CHARACTERISTIC
/begin CHARACTERISTIC DSCHED_Excl.BEONV_BHOM_C "exclusion relation / Exclusive FIds to FID_BEONV and FID_BHOM" VALUE 0x804F559E Val_Wu8 255.0 DFC_OneToOne 0.00 255.0 FORMAT "%5.1" /end CHARACTERISTIC
/begin CHARACTERISTIC DSCHED_Excl.BEONV_BLLRH_C "exclusion relation / Exclusive FIds to FID_BEONV and FID_BLLRH" VALUE 0x804F559F Val_Wu8 255.0 DFC_OneToOne 0.00 255.0 FORMAT "%5.1" /end CHARACTERISTIC
/begin CHARACTERISTIC DSCHED_Excl.BEONV_BLLRKH_C "exclusion relation / Exclusive FIds to FID_BEONV and FID_BLLRKH" VALUE 0x804F55A0 Val_Wu8 255.0 DFC_OneToOne 0.00 255.0 FORMAT "%5.1" /end CHARACTERISTIC
/begin CHARACTERISTIC DSCHED_Excl.BEONV_BPLSU_C "exclusion relation / Exclusive FIds to FID_BEONV and FID_BPLSU" VALUE 0x804F55A1 Val_Wu8 255.0 DFC_OneToOne 0.00 255.0 FORMAT "%5.1" /end CHARACTERISTIC
/begin CHARACTERISTIC DSCHED_Excl.BEONV_FRAMBAVMB_C "exclusion relation / Exclusive FIds to FID_BEONV and FID_FRAMBAVMB" VALUE 0x804F55A2 Val_Wu8 255.0 DFC_OneToOne 0.00 255.0 FORMAT "%5.1" /end CHARACTERISTIC
/begin CHARACTERISTIC DSCHED_Excl.BEONV_CatHeatgColdStrtReq_C "exclusion relation / Exclusive FIds to FID_BEONV and FId_CatHeatgColdStrtReq" VALUE 0x804F55A3 Val_Wu8 255.0 DFC_OneToOne 0.00 255.0 FORMAT "%5.1" /end CHARACTERISTIC
/begin CHARACTERISTIC DSCHED_Excl.BEONV_CatHeatgWrmReq_C "exclusion relation / Exclusive FIds to FID_BEONV and FId_CatHeatgWrmReq" VALUE 0x804F55A4 Val_Wu8 255.0 DFC_OneToOne 0.00 255.0 FORMAT "%5.1" /end CHARACTERISTIC
/begin CHARACTERISTIC DSCHED_Excl.BEONV_DSMBDEPHSpOpMode_C "exclusion relation / Exclusive FIds to FID_BEONV and FId_DSMBDEPHSpOpMode" VALUE 0x804F55A5 Val_Wu8 255.0 DFC_OneToOne 0.00 255.0 FORMAT "%5.1" /end CHARACTERISTIC
/begin CHARACTERISTIC DSCHED_Excl.BEONV_EGRVlvCoord_C "exclusion relation / Exclusive FIds to FID_BEONV and FId_EGRVlvCoord" VALUE 0x804F55A6 Val_Wu8 255.0 DFC_OneToOne 0.00 255.0 FORMAT "%5.1" /end CHARACTERISTIC
/begin CHARACTERISTIC DSCHED_Excl.BEONV_EGSDO2FuTrmB1_C "exclusion relation / Exclusive FIds to FID_BEONV and FId_EGSDO2FuTrmB1" VALUE 0x804F55A7 Val_Wu8 255.0 DFC_OneToOne 0.00 255.0 FORMAT "%5.1" /end CHARACTERISTIC
/begin CHARACTERISTIC DSCHED_Excl.BEONV_EGSDO2SnsrMntdRelsS1B1_C "exclusion relation / Exclusive FIds to FID_BEONV and FId_EGSDO2SnsrMntdRelsS1B1" VALUE 0x804F55A8 Val_Wu8 255.0 DFC_OneToOne 0.00 255.0 FORMAT "%5.1" /end CHARACTERISTIC
/begin CHARACTERISTIC DSCHED_Excl.BEONV_EGSDO2_LamOffsFastS1B1_C "exclusion relation / Exclusive FIds to FID_BEONV and FId_EGSDO2_LamOffsFastS1B1" VALUE 0x804F55A9 Val_Wu8 255.0 DFC_OneToOne 0.00 255.0 FORMAT "%5.1" /end CHARACTERISTIC
/begin CHARACTERISTIC DSCHED_Excl.BEONV_MisfDetDnAdpnNv_C "exclusion relation / Exclusive FIds to FID_BEONV and FId_MisfDetDnAdpnNv" VALUE 0x804F55AA Val_Wu8 255.0 DFC_OneToOne 0.00 255.0 FORMAT "%5.1" /end CHARACTERISTIC
/begin CHARACTERISTIC DSCHED_Excl.BEONV_bascadpncvo_C "exclusion relation / Exclusive FIds to FID_BEONV and FId_bascadpncvo" VALUE 0x804F55AB Val_Wu8 255.0 DFC_OneToOne 0.00 255.0 FORMAT "%5.1" /end CHARACTERISTIC
/begin CHARACTERISTIC DSCHED_Excl.EGSDCmnSeg1B1Parl_BAGRA_C "exclusion relation / Exclusive FIds to FId_EGSDCmnSeg1B1Parl and FID_BAGRA" VALUE 0x804F55AC Val_Wu8 255.0 DFC_OneToOne 0.00 255.0 FORMAT "%5.1" /end CHARACTERISTIC
/begin CHARACTERISTIC DSCHED_Excl.EGSDCmnSeg1B1Parl_BAGRASD_C "exclusion relation / Exclusive FIds to FId_EGSDCmnSeg1B1Parl and FID_BAGRASD" VALUE 0x804F55AD Val_Wu8 255.0 DFC_OneToOne 0.00 255.0 FORMAT "%5.1" /end CHARACTERISTIC
/begin CHARACTERISTIC DSCHED_Excl.EGSDCmnSeg1B1Parl_BDSTOF_C "exclusion relation / Exclusive FIds to FId_EGSDCmnSeg1B1Parl and FID_BDSTOF" VALUE 0x804F55AE Val_Wu8 255.0 DFC_OneToOne 0.00 255.0 FORMAT "%5.1" /end CHARACTERISTIC
/begin CHARACTERISTIC DSCHED_Excl.EGSDCmnSeg1B1Parl_BFVDFRM_C "exclusion relation / Exclusive FIds to FId_EGSDCmnSeg1B1Parl and FID_BFVDFRM" VALUE 0x804F55AF Val_Wu8 255.0 DFC_OneToOne 0.00 255.0 FORMAT "%5.1" /end CHARACTERISTIC
/begin CHARACTERISTIC DSCHED_Excl.EGSDCmnSeg1B1Parl_BHOM_C "exclusion relation / Exclusive FIds to FId_EGSDCmnSeg1B1Parl and FID_BHOM" VALUE 0x804F55B0 Val_Wu8 255.0 DFC_OneToOne 0.00 255.0 FORMAT "%5.1" /end CHARACTERISTIC
/begin CHARACTERISTIC DSCHED_Excl.EGSDCmnSeg1B1Parl_BLLRH_C "exclusion relation / Exclusive FIds to FId_EGSDCmnSeg1B1Parl and FID_BLLRH" VALUE 0x804F55B1 Val_Wu8 255.0 DFC_OneToOne 0.00 255.0 FORMAT "%5.1" /end CHARACTERISTIC
/begin CHARACTERISTIC DSCHED_Excl.EGSDCmnSeg1B1Parl_BLLRKH_C "exclusion relation / Exclusive FIds to FId_EGSDCmnSeg1B1Parl and FID_BLLRKH" VALUE 0x804F55B2 Val_Wu8 255.0 DFC_OneToOne 0.00 255.0 FORMAT "%5.1" /end CHARACTERISTIC
/begin CHARACTERISTIC DSCHED_Excl.EGSDCmnSeg1B1Parl_BPLSU_C "exclusion relation / Exclusive FIds to FId_EGSDCmnSeg1B1Parl and FID_BPLSU" VALUE 0x804F55B3 Val_Wu8 255.0 DFC_OneToOne 0.00 255.0 FORMAT "%5.1" /end CHARACTERISTIC
/begin CHARACTERISTIC DSCHED_Excl.EGSDCmnSeg1B1Parl_FRAMBAVMB_C "exclusion relation / Exclusive FIds to FId_EGSDCmnSeg1B1Parl and FID_FRAMBAVMB" VALUE 0x804F55B4 Val_Wu8 255.0 DFC_OneToOne 0.00 255.0 FORMAT "%5.1" /end CHARACTERISTIC
/begin CHARACTERISTIC DSCHED_Excl.EGSDCmnSeg1B1Parl_CatHeatgColdStrtReq_C "exclusion relation / Exclusive FIds to FId_EGSDCmnSeg1B1Parl and FId_CatHeatgColdStrtReq" VALUE 0x804F55B5 Val_Wu8 255.0 DFC_OneToOne 0.00 255.0 FORMAT "%5.1" /end CHARACTERISTIC
/begin CHARACTERISTIC DSCHED_Excl.EGSDCmnSeg1B1Parl_CatHeatgWrmReq_C "exclusion relation / Exclusive FIds to FId_EGSDCmnSeg1B1Parl and FId_CatHeatgWrmReq" VALUE 0x804F55B6 Val_Wu8 255.0 DFC_OneToOne 0.00 255.0 FORMAT "%5.1" /end CHARACTERISTIC
/begin CHARACTERISTIC DSCHED_Excl.EGSDCmnSeg1B1Parl_DSMBDEPHSpOpMode_C "exclusion relation / Exclusive FIds to FId_EGSDCmnSeg1B1Parl and FId_DSMBDEPHSpOpMode" VALUE 0x804F55B7 Val_Wu8 255.0 DFC_OneToOne 0.00 255.0 FORMAT "%5.1" /end CHARACTERISTIC
/begin CHARACTERISTIC DSCHED_Excl.EGSDCmnSeg1B1Parl_EGRVlvCoord_C "exclusion relation / Exclusive FIds to FId_EGSDCmnSeg1B1Parl and FId_EGRVlvCoord" VALUE 0x804F55B8 Val_Wu8 255.0 DFC_OneToOne 0.00 255.0 FORMAT "%5.1" /end CHARACTERISTIC
/begin CHARACTERISTIC DSCHED_Excl.EGSDCmnSeg1B1Parl_EGSDO2FuTrmB1_C "exclusion relation / Exclusive FIds to FId_EGSDCmnSeg1B1Parl and FId_EGSDO2FuTrmB1" VALUE 0x804F55B9 Val_Wu8 255.0 DFC_OneToOne 0.00 255.0 FORMAT "%5.1" /end CHARACTERISTIC
/begin CHARACTERISTIC DSCHED_Excl.EGSDCmnSeg1B1Parl_EGSDO2SnsrMntdRelsS1B1_C "exclusion relation / Exclusive FIds to FId_EGSDCmnSeg1B1Parl and FId_EGSDO2SnsrMntdRelsS1B1" VALUE 0x804F55BA Val_Wu8 255.0 DFC_OneToOne 0.00 255.0 FORMAT "%5.1" /end CHARACTERISTIC
/begin CHARACTERISTIC DSCHED_Excl.EGSDCmnSeg1B1Parl_EGSDO2_LamOffsFastS1B1_C "exclusion relation / Exclusive FIds to FId_EGSDCmnSeg1B1Parl and FId_EGSDO2_LamOffsFastS1B1" VALUE 0x804F55BB Val_Wu8 255.0 DFC_OneToOne 0.00 255.0 FORMAT "%5.1" /end CHARACTERISTIC
/begin CHARACTERISTIC DSCHED_Excl.EGSDCmnSeg1B1Parl_MisfDetDnAdpnNv_C "exclusion relation / Exclusive FIds to FId_EGSDCmnSeg1B1Parl and FId_MisfDetDnAdpnNv" VALUE 0x804F55BC Val_Wu8 255.0 DFC_OneToOne 0.00 255.0 FORMAT "%5.1" /end CHARACTERISTIC
/begin CHARACTERISTIC DSCHED_Excl.EGSDCmnSeg1B1Parl_bascadpncvo_C "exclusion relation / Exclusive FIds to FId_EGSDCmnSeg1B1Parl and FId_bascadpncvo" VALUE 0x804F55BD Val_Wu8 255.0 DFC_OneToOne 0.00 255.0 FORMAT "%5.1" /end CHARACTERISTIC
/begin CHARACTERISTIC DSCHED_Excl.BAGRA_BAGRASD_C "exclusion relation / Exclusive FIds to FID_BAGRA and FID_BAGRASD" VALUE 0x804F55BE Val_Wu8 255.0 DFC_OneToOne 0.00 255.0 FORMAT "%5.1" /end CHARACTERISTIC
/begin CHARACTERISTIC DSCHED_Excl.BAGRA_BDSTOF_C "exclusion relation / Exclusive FIds to FID_BAGRA and FID_BDSTOF" VALUE 0x804F55BF Val_Wu8 255.0 DFC_OneToOne 0.00 255.0 FORMAT "%5.1" /end CHARACTERISTIC
/begin CHARACTERISTIC DSCHED_Excl.BAGRA_BFVDFRM_C "exclusion relation / Exclusive FIds to FID_BAGRA and FID_BFVDFRM" VALUE 0x804F55C0 Val_Wu8 255.0 DFC_OneToOne 0.00 255.0 FORMAT "%5.1" /end CHARACTERISTIC
/begin CHARACTERISTIC DSCHED_Excl.BAGRA_BHOM_C "exclusion relation / Exclusive FIds to FID_BAGRA and FID_BHOM" VALUE 0x804F55C1 Val_Wu8 255.0 DFC_OneToOne 0.00 255.0 FORMAT "%5.1" /end CHARACTERISTIC
/begin CHARACTERISTIC DSCHED_Excl.BAGRA_BLLRH_C "exclusion relation / Exclusive FIds to FID_BAGRA and FID_BLLRH" VALUE 0x804F55C2 Val_Wu8 255.0 DFC_OneToOne 0.00 255.0 FORMAT "%5.1" /end CHARACTERISTIC
/begin CHARACTERISTIC DSCHED_Excl.BAGRA_BLLRKH_C "exclusion relation / Exclusive FIds to FID_BAGRA and FID_BLLRKH" VALUE 0x804F55C3 Val_Wu8 255.0 DFC_OneToOne 0.00 255.0 FORMAT "%5.1" /end CHARACTERISTIC
/begin CHARACTERISTIC DSCHED_Excl.BAGRA_BPLSU_C "exclusion relation / Exclusive FIds to FID_BAGRA and FID_BPLSU" VALUE 0x804F55C4 Val_Wu8 255.0 DFC_OneToOne 0.00 255.0 FORMAT "%5.1" /end CHARACTERISTIC
/begin CHARACTERISTIC DSCHED_Excl.BAGRA_FRAMBAVMB_C "exclusion relation / Exclusive FIds to FID_BAGRA and FID_FRAMBAVMB" VALUE 0x804F55C5 Val_Wu8 255.0 DFC_OneToOne 0.00 255.0 FORMAT "%5.1" /end CHARACTERISTIC
/begin CHARACTERISTIC DSCHED_Excl.BAGRA_CatHeatgColdStrtReq_C "exclusion relation / Exclusive FIds to FID_BAGRA and FId_CatHeatgColdStrtReq" VALUE 0x804F55C6 Val_Wu8 255.0 DFC_OneToOne 0.00 255.0 FORMAT "%5.1" /end CHARACTERISTIC
/begin CHARACTERISTIC DSCHED_Excl.BAGRA_CatHeatgWrmReq_C "exclusion relation / Exclusive FIds to FID_BAGRA and FId_CatHeatgWrmReq" VALUE 0x804F55C7 Val_Wu8 255.0 DFC_OneToOne 0.00 255.0 FORMAT "%5.1" /end CHARACTERISTIC
/begin CHARACTERISTIC DSCHED_Excl.BAGRA_DSMBDEPHSpOpMode_C "exclusion relation / Exclusive FIds to FID_BAGRA and FId_DSMBDEPHSpOpMode" VALUE 0x804F55C8 Val_Wu8 255.0 DFC_OneToOne 0.00 255.0 FORMAT "%5.1" /end CHARACTERISTIC
/begin CHARACTERISTIC DSCHED_Excl.BAGRA_EGRVlvCoord_C "exclusion relation / Exclusive FIds to FID_BAGRA and FId_EGRVlvCoord" VALUE 0x804F55C9 Val_Wu8 255.0 DFC_OneToOne 0.00 255.0 FORMAT "%5.1" /end CHARACTERISTIC
/begin CHARACTERISTIC DSCHED_Excl.BAGRA_EGSDO2FuTrmB1_C "exclusion relation / Exclusive FIds to FID_BAGRA and FId_EGSDO2FuTrmB1" VALUE 0x804F55CA Val_Wu8 255.0 DFC_OneToOne 0.00 255.0 FORMAT "%5.1" /end CHARACTERISTIC
/begin CHARACTERISTIC DSCHED_Excl.BAGRA_EGSDO2SnsrMntdRelsS1B1_C "exclusion relation / Exclusive FIds to FID_BAGRA and FId_EGSDO2SnsrMntdRelsS1B1" VALUE 0x804F55CB Val_Wu8 255.0 DFC_OneToOne 0.00 255.0 FORMAT "%5.1" /end CHARACTERISTIC
/begin CHARACTERISTIC DSCHED_Excl.BAGRA_EGSDO2_LamOffsFastS1B1_C "exclusion relation / Exclusive FIds to FID_BAGRA and FId_EGSDO2_LamOffsFastS1B1" VALUE 0x804F55CC Val_Wu8 255.0 DFC_OneToOne 0.00 255.0 FORMAT "%5.1" /end CHARACTERISTIC
/begin CHARACTERISTIC DSCHED_Excl.BAGRA_MisfDetDnAdpnNv_C "exclusion relation / Exclusive FIds to FID_BAGRA and FId_MisfDetDnAdpnNv" VALUE 0x804F55CD Val_Wu8 255.0 DFC_OneToOne 0.00 255.0 FORMAT "%5.1" /end CHARACTERISTIC
/begin CHARACTERISTIC DSCHED_Excl.BAGRA_bascadpncvo_C "exclusion relation / Exclusive FIds to FID_BAGRA and FId_bascadpncvo" VALUE 0x804F55CE Val_Wu8 255.0 DFC_OneToOne 0.00 255.0 FORMAT "%5.1" /end CHARACTERISTIC
/begin CHARACTERISTIC DSCHED_Excl.BAGRASD_BDSTOF_C "exclusion relation / Exclusive FIds to FID_BAGRASD and FID_BDSTOF" VALUE 0x804F55CF Val_Wu8 255.0 DFC_OneToOne 0.00 255.0 FORMAT "%5.1" /end CHARACTERISTIC
/begin CHARACTERISTIC DSCHED_Excl.BAGRASD_BFVDFRM_C "exclusion relation / Exclusive FIds to FID_BAGRASD and FID_BFVDFRM" VALUE 0x804F55D0 Val_Wu8 255.0 DFC_OneToOne 0.00 255.0 FORMAT "%5.1" /end CHARACTERISTIC
/begin CHARACTERISTIC DSCHED_Excl.BAGRASD_BHOM_C "exclusion relation / Exclusive FIds to FID_BAGRASD and FID_BHOM" VALUE 0x804F55D1 Val_Wu8 255.0 DFC_OneToOne 0.00 255.0 FORMAT "%5.1" /end CHARACTERISTIC
/begin CHARACTERISTIC DSCHED_Excl.BAGRASD_BLLRH_C "exclusion relation / Exclusive FIds to FID_BAGRASD and FID_BLLRH" VALUE 0x804F55D2 Val_Wu8 255.0 DFC_OneToOne 0.00 255.0 FORMAT "%5.1" /end CHARACTERISTIC
/begin CHARACTERISTIC DSCHED_Excl.BAGRASD_BLLRKH_C "exclusion relation / Exclusive FIds to FID_BAGRASD and FID_BLLRKH" VALUE 0x804F55D3 Val_Wu8 255.0 DFC_OneToOne 0.00 255.0 FORMAT "%5.1" /end CHARACTERISTIC
/begin CHARACTERISTIC DSCHED_Excl.BAGRASD_BPLSU_C "exclusion relation / Exclusive FIds to FID_BAGRASD and FID_BPLSU" VALUE 0x804F55D4 Val_Wu8 255.0 DFC_OneToOne 0.00 255.0 FORMAT "%5.1" /end CHARACTERISTIC
/begin CHARACTERISTIC DSCHED_Excl.BAGRASD_FRAMBAVMB_C "exclusion relation / Exclusive FIds to FID_BAGRASD and FID_FRAMBAVMB" VALUE 0x804F55D5 Val_Wu8 255.0 DFC_OneToOne 0.00 255.0 FORMAT "%5.1" /end CHARACTERISTIC
/begin CHARACTERISTIC DSCHED_Excl.BAGRASD_CatHeatgColdStrtReq_C "exclusion relation / Exclusive FIds to FID_BAGRASD and FId_CatHeatgColdStrtReq" VALUE 0x804F55D6 Val_Wu8 255.0 DFC_OneToOne 0.00 255.0 FORMAT "%5.1" /end CHARACTERISTIC
/begin CHARACTERISTIC DSCHED_Excl.BAGRASD_CatHeatgWrmReq_C "exclusion relation / Exclusive FIds to FID_BAGRASD and FId_CatHeatgWrmReq" VALUE 0x804F55D7 Val_Wu8 255.0 DFC_OneToOne 0.00 255.0 FORMAT "%5.1" /end CHARACTERISTIC
/begin CHARACTERISTIC DSCHED_Excl.BAGRASD_DSMBDEPHSpOpMode_C "exclusion relation / Exclusive FIds to FID_BAGRASD and FId_DSMBDEPHSpOpMode" VALUE 0x804F55D8 Val_Wu8 255.0 DFC_OneToOne 0.00 255.0 FORMAT "%5.1" /end CHARACTERISTIC
/begin CHARACTERISTIC DSCHED_Excl.BAGRASD_EGRVlvCoord_C "exclusion relation / Exclusive FIds to FID_BAGRASD and FId_EGRVlvCoord" VALUE 0x804F55D9 Val_Wu8 255.0 DFC_OneToOne 0.00 255.0 FORMAT "%5.1" /end CHARACTERISTIC
/begin CHARACTERISTIC DSCHED_Excl.BAGRASD_EGSDO2FuTrmB1_C "exclusion relation / Exclusive FIds to FID_BAGRASD and FId_EGSDO2FuTrmB1" VALUE 0x804F55DA Val_Wu8 255.0 DFC_OneToOne 0.00 255.0 FORMAT "%5.1" /end CHARACTERISTIC
/begin CHARACTERISTIC DSCHED_Excl.BAGRASD_EGSDO2SnsrMntdRelsS1B1_C "exclusion relation / Exclusive FIds to FID_BAGRASD and FId_EGSDO2SnsrMntdRelsS1B1" VALUE 0x804F55DB Val_Wu8 255.0 DFC_OneToOne 0.00 255.0 FORMAT "%5.1" /end CHARACTERISTIC
/begin CHARACTERISTIC DSCHED_Excl.BAGRASD_EGSDO2_LamOffsFastS1B1_C "exclusion relation / Exclusive FIds to FID_BAGRASD and FId_EGSDO2_LamOffsFastS1B1" VALUE 0x804F55DC Val_Wu8 255.0 DFC_OneToOne 0.00 255.0 FORMAT "%5.1" /end CHARACTERISTIC
/begin CHARACTERISTIC DSCHED_Excl.BAGRASD_MisfDetDnAdpnNv_C "exclusion relation / Exclusive FIds to FID_BAGRASD and FId_MisfDetDnAdpnNv" VALUE 0x804F55DD Val_Wu8 255.0 DFC_OneToOne 0.00 255.0 FORMAT "%5.1" /end CHARACTERISTIC
/begin CHARACTERISTIC DSCHED_Excl.BAGRASD_bascadpncvo_C "exclusion relation / Exclusive FIds to FID_BAGRASD and FId_bascadpncvo" VALUE 0x804F55DE Val_Wu8 255.0 DFC_OneToOne 0.00 255.0 FORMAT "%5.1" /end CHARACTERISTIC
/begin CHARACTERISTIC DSCHED_Excl.BDSTOF_BFVDFRM_C "exclusion relation / Exclusive FIds to FID_BDSTOF and FID_BFVDFRM" VALUE 0x804F55DF Val_Wu8 255.0 DFC_OneToOne 0.00 255.0 FORMAT "%5.1" /end CHARACTERISTIC
/begin CHARACTERISTIC DSCHED_Excl.BDSTOF_BHOM_C "exclusion relation / Exclusive FIds to FID_BDSTOF and FID_BHOM" VALUE 0x804F55E0 Val_Wu8 255.0 DFC_OneToOne 0.00 255.0 FORMAT "%5.1" /end CHARACTERISTIC
/begin CHARACTERISTIC DSCHED_Excl.BDSTOF_BLLRH_C "exclusion relation / Exclusive FIds to FID_BDSTOF and FID_BLLRH" VALUE 0x804F55E1 Val_Wu8 255.0 DFC_OneToOne 0.00 255.0 FORMAT "%5.1" /end CHARACTERISTIC
/begin CHARACTERISTIC DSCHED_Excl.BDSTOF_BLLRKH_C "exclusion relation / Exclusive FIds to FID_BDSTOF and FID_BLLRKH" VALUE 0x804F55E2 Val_Wu8 255.0 DFC_OneToOne 0.00 255.0 FORMAT "%5.1" /end CHARACTERISTIC
/begin CHARACTERISTIC DSCHED_Excl.BDSTOF_BPLSU_C "exclusion relation / Exclusive FIds to FID_BDSTOF and FID_BPLSU" VALUE 0x804F55E3 Val_Wu8 255.0 DFC_OneToOne 0.00 255.0 FORMAT "%5.1" /end CHARACTERISTIC
/begin CHARACTERISTIC DSCHED_Excl.BDSTOF_FRAMBAVMB_C "exclusion relation / Exclusive FIds to FID_BDSTOF and FID_FRAMBAVMB" VALUE 0x804F55E4 Val_Wu8 255.0 DFC_OneToOne 0.00 255.0 FORMAT "%5.1" /end CHARACTERISTIC
/begin CHARACTERISTIC DSCHED_Excl.BDSTOF_CatHeatgColdStrtReq_C "exclusion relation / Exclusive FIds to FID_BDSTOF and FId_CatHeatgColdStrtReq" VALUE 0x804F55E5 Val_Wu8 255.0 DFC_OneToOne 0.00 255.0 FORMAT "%5.1" /end CHARACTERISTIC
/begin CHARACTERISTIC DSCHED_Excl.BDSTOF_CatHeatgWrmReq_C "exclusion relation / Exclusive FIds to FID_BDSTOF and FId_CatHeatgWrmReq" VALUE 0x804F55E6 Val_Wu8 255.0 DFC_OneToOne 0.00 255.0 FORMAT "%5.1" /end CHARACTERISTIC
/begin CHARACTERISTIC DSCHED_Excl.BDSTOF_DSMBDEPHSpOpMode_C "exclusion relation / Exclusive FIds to FID_BDSTOF and FId_DSMBDEPHSpOpMode" VALUE 0x804F55E7 Val_Wu8 255.0 DFC_OneToOne 0.00 255.0 FORMAT "%5.1" /end CHARACTERISTIC
/begin CHARACTERISTIC DSCHED_Excl.BDSTOF_EGRVlvCoord_C "exclusion relation / Exclusive FIds to FID_BDSTOF and FId_EGRVlvCoord" VALUE 0x804F55E8 Val_Wu8 255.0 DFC_OneToOne 0.00 255.0 FORMAT "%5.1" /end CHARACTERISTIC
/begin CHARACTERISTIC DSCHED_Excl.BDSTOF_EGSDO2FuTrmB1_C "exclusion relation / Exclusive FIds to FID_BDSTOF and FId_EGSDO2FuTrmB1" VALUE 0x804F55E9 Val_Wu8 255.0 DFC_OneToOne 0.00 255.0 FORMAT "%5.1" /end CHARACTERISTIC
/begin CHARACTERISTIC DSCHED_Excl.BDSTOF_EGSDO2SnsrMntdRelsS1B1_C "exclusion relation / Exclusive FIds to FID_BDSTOF and FId_EGSDO2SnsrMntdRelsS1B1" VALUE 0x804F55EA Val_Wu8 255.0 DFC_OneToOne 0.00 255.0 FORMAT "%5.1" /end CHARACTERISTIC
/begin CHARACTERISTIC DSCHED_Excl.BDSTOF_EGSDO2_LamOffsFastS1B1_C "exclusion relation / Exclusive FIds to FID_BDSTOF and FId_EGSDO2_LamOffsFastS1B1" VALUE 0x804F55EB Val_Wu8 255.0 DFC_OneToOne 0.00 255.0 FORMAT "%5.1" /end CHARACTERISTIC
/begin CHARACTERISTIC DSCHED_Excl.BDSTOF_MisfDetDnAdpnNv_C "exclusion relation / Exclusive FIds to FID_BDSTOF and FId_MisfDetDnAdpnNv" VALUE 0x804F55EC Val_Wu8 255.0 DFC_OneToOne 0.00 255.0 FORMAT "%5.1" /end CHARACTERISTIC
/begin CHARACTERISTIC DSCHED_Excl.BDSTOF_bascadpncvo_C "exclusion relation / Exclusive FIds to FID_BDSTOF and FId_bascadpncvo" VALUE 0x804F55ED Val_Wu8 255.0 DFC_OneToOne 0.00 255.0 FORMAT "%5.1" /end CHARACTERISTIC
/begin CHARACTERISTIC DSCHED_Excl.BFVDFRM_BHOM_C "exclusion relation / Exclusive FIds to FID_BFVDFRM and FID_BHOM" VALUE 0x804F55EE Val_Wu8 255.0 DFC_OneToOne 0.00 255.0 FORMAT "%5.1" /end CHARACTERISTIC
/begin CHARACTERISTIC DSCHED_Excl.BFVDFRM_BLLRH_C "exclusion relation / Exclusive FIds to FID_BFVDFRM and FID_BLLRH" VALUE 0x804F55EF Val_Wu8 255.0 DFC_OneToOne 0.00 255.0 FORMAT "%5.1" /end CHARACTERISTIC
/begin CHARACTERISTIC DSCHED_Excl.BFVDFRM_BLLRKH_C "exclusion relation / Exclusive FIds to FID_BFVDFRM and FID_BLLRKH" VALUE 0x804F55F0 Val_Wu8 255.0 DFC_OneToOne 0.00 255.0 FORMAT "%5.1" /end CHARACTERISTIC
/begin CHARACTERISTIC DSCHED_Excl.BFVDFRM_BPLSU_C "exclusion relation / Exclusive FIds to FID_BFVDFRM and FID_BPLSU" VALUE 0x804F55F1 Val_Wu8 255.0 DFC_OneToOne 0.00 255.0 FORMAT "%5.1" /end CHARACTERISTIC
/begin CHARACTERISTIC DSCHED_Excl.BFVDFRM_FRAMBAVMB_C "exclusion relation / Exclusive FIds to FID_BFVDFRM and FID_FRAMBAVMB" VALUE 0x804F55F2 Val_Wu8 255.0 DFC_OneToOne 0.00 255.0 FORMAT "%5.1" /end CHARACTERISTIC
/begin CHARACTERISTIC DSCHED_Excl.BFVDFRM_CatHeatgColdStrtReq_C "exclusion relation / Exclusive FIds to FID_BFVDFRM and FId_CatHeatgColdStrtReq" VALUE 0x804F55F3 Val_Wu8 255.0 DFC_OneToOne 0.00 255.0 FORMAT "%5.1" /end CHARACTERISTIC
/begin CHARACTERISTIC DSCHED_Excl.BFVDFRM_CatHeatgWrmReq_C "exclusion relation / Exclusive FIds to FID_BFVDFRM and FId_CatHeatgWrmReq" VALUE 0x804F55F4 Val_Wu8 255.0 DFC_OneToOne 0.00 255.0 FORMAT "%5.1" /end CHARACTERISTIC
/begin CHARACTERISTIC DSCHED_Excl.BFVDFRM_DSMBDEPHSpOpMode_C "exclusion relation / Exclusive FIds to FID_BFVDFRM and FId_DSMBDEPHSpOpMode" VALUE 0x804F55F5 Val_Wu8 255.0 DFC_OneToOne 0.00 255.0 FORMAT "%5.1" /end CHARACTERISTIC
/begin CHARACTERISTIC DSCHED_Excl.BFVDFRM_EGRVlvCoord_C "exclusion relation / Exclusive FIds to FID_BFVDFRM and FId_EGRVlvCoord" VALUE 0x804F55F6 Val_Wu8 255.0 DFC_OneToOne 0.00 255.0 FORMAT "%5.1" /end CHARACTERISTIC
/begin CHARACTERISTIC DSCHED_Excl.BFVDFRM_EGSDO2FuTrmB1_C "exclusion relation / Exclusive FIds to FID_BFVDFRM and FId_EGSDO2FuTrmB1" VALUE 0x804F55F7 Val_Wu8 255.0 DFC_OneToOne 0.00 255.0 FORMAT "%5.1" /end CHARACTERISTIC
/begin CHARACTERISTIC DSCHED_Excl.BFVDFRM_EGSDO2SnsrMntdRelsS1B1_C "exclusion relation / Exclusive FIds to FID_BFVDFRM and FId_EGSDO2SnsrMntdRelsS1B1" VALUE 0x804F55F8 Val_Wu8 255.0 DFC_OneToOne 0.00 255.0 FORMAT "%5.1" /end CHARACTERISTIC
/begin CHARACTERISTIC DSCHED_Excl.BFVDFRM_EGSDO2_LamOffsFastS1B1_C "exclusion relation / Exclusive FIds to FID_BFVDFRM and FId_EGSDO2_LamOffsFastS1B1" VALUE 0x804F55F9 Val_Wu8 255.0 DFC_OneToOne 0.00 255.0 FORMAT "%5.1" /end CHARACTERISTIC
/begin CHARACTERISTIC DSCHED_Excl.BFVDFRM_MisfDetDnAdpnNv_C "exclusion relation / Exclusive FIds to FID_BFVDFRM and FId_MisfDetDnAdpnNv" VALUE 0x804F55FA Val_Wu8 255.0 DFC_OneToOne 0.00 255.0 FORMAT "%5.1" /end CHARACTERISTIC
/begin CHARACTERISTIC DSCHED_Excl.BFVDFRM_bascadpncvo_C "exclusion relation / Exclusive FIds to FID_BFVDFRM and FId_bascadpncvo" VALUE 0x804F55FB Val_Wu8 255.0 DFC_OneToOne 0.00 255.0 FORMAT "%5.1" /end CHARACTERISTIC
/begin CHARACTERISTIC DSCHED_Excl.BHOM_BLLRH_C "exclusion relation / Exclusive FIds to FID_BHOM and FID_BLLRH" VALUE 0x804F55FC Val_Wu8 255.0 DFC_OneToOne 0.00 255.0 FORMAT "%5.1" /end CHARACTERISTIC
/begin CHARACTERISTIC DSCHED_Excl.BHOM_BLLRKH_C "exclusion relation / Exclusive FIds to FID_BHOM and FID_BLLRKH" VALUE 0x804F55FD Val_Wu8 255.0 DFC_OneToOne 0.00 255.0 FORMAT "%5.1" /end CHARACTERISTIC
/begin CHARACTERISTIC DSCHED_Excl.BHOM_BPLSU_C "exclusion relation / Exclusive FIds to FID_BHOM and FID_BPLSU" VALUE 0x804F55FE Val_Wu8 255.0 DFC_OneToOne 0.00 255.0 FORMAT "%5.1" /end CHARACTERISTIC
/begin CHARACTERISTIC DSCHED_Excl.BHOM_FRAMBAVMB_C "exclusion relation / Exclusive FIds to FID_BHOM and FID_FRAMBAVMB" VALUE 0x804F55FF Val_Wu8 255.0 DFC_OneToOne 0.00 255.0 FORMAT "%5.1" /end CHARACTERISTIC
/begin CHARACTERISTIC DSCHED_Excl.BHOM_CatHeatgColdStrtReq_C "exclusion relation / Exclusive FIds to FID_BHOM and FId_CatHeatgColdStrtReq" VALUE 0x804F5600 Val_Wu8 255.0 DFC_OneToOne 0.00 255.0 FORMAT "%5.1" /end CHARACTERISTIC
/begin CHARACTERISTIC DSCHED_Excl.BHOM_CatHeatgWrmReq_C "exclusion relation / Exclusive FIds to FID_BHOM and FId_CatHeatgWrmReq" VALUE 0x804F5601 Val_Wu8 255.0 DFC_OneToOne 0.00 255.0 FORMAT "%5.1" /end CHARACTERISTIC
/begin CHARACTERISTIC DSCHED_Excl.BHOM_DSMBDEPHSpOpMode_C "exclusion relation / Exclusive FIds to FID_BHOM and FId_DSMBDEPHSpOpMode" VALUE 0x804F5602 Val_Wu8 255.0 DFC_OneToOne 0.00 255.0 FORMAT "%5.1" /end CHARACTERISTIC
/begin CHARACTERISTIC DSCHED_Excl.BHOM_EGRVlvCoord_C "exclusion relation / Exclusive FIds to FID_BHOM and FId_EGRVlvCoord" VALUE 0x804F5603 Val_Wu8 255.0 DFC_OneToOne 0.00 255.0 FORMAT "%5.1" /end CHARACTERISTIC
/begin CHARACTERISTIC DSCHED_Excl.BHOM_EGSDO2FuTrmB1_C "exclusion relation / Exclusive FIds to FID_BHOM and FId_EGSDO2FuTrmB1" VALUE 0x804F5604 Val_Wu8 255.0 DFC_OneToOne 0.00 255.0 FORMAT "%5.1" /end CHARACTERISTIC
/begin CHARACTERISTIC DSCHED_Excl.BHOM_EGSDO2SnsrMntdRelsS1B1_C "exclusion relation / Exclusive FIds to FID_BHOM and FId_EGSDO2SnsrMntdRelsS1B1" VALUE 0x804F5605 Val_Wu8 255.0 DFC_OneToOne 0.00 255.0 FORMAT "%5.1" /end CHARACTERISTIC
/begin CHARACTERISTIC DSCHED_Excl.BHOM_EGSDO2_LamOffsFastS1B1_C "exclusion relation / Exclusive FIds to FID_BHOM and FId_EGSDO2_LamOffsFastS1B1" VALUE 0x804F5606 Val_Wu8 255.0 DFC_OneToOne 0.00 255.0 FORMAT "%5.1" /end CHARACTERISTIC
/begin CHARACTERISTIC DSCHED_Excl.BHOM_MisfDetDnAdpnNv_C "exclusion relation / Exclusive FIds to FID_BHOM and FId_MisfDetDnAdpnNv" VALUE 0x804F5607 Val_Wu8 255.0 DFC_OneToOne 0.00 255.0 FORMAT "%5.1" /end CHARACTERISTIC
/begin CHARACTERISTIC DSCHED_Excl.BHOM_bascadpncvo_C "exclusion relation / Exclusive FIds to FID_BHOM and FId_bascadpncvo" VALUE 0x804F5608 Val_Wu8 255.0 DFC_OneToOne 0.00 255.0 FORMAT "%5.1" /end CHARACTERISTIC
/begin CHARACTERISTIC DSCHED_Excl.BLLRH_BLLRKH_C "exclusion relation / Exclusive FIds to FID_BLLRH and FID_BLLRKH" VALUE 0x804F5609 Val_Wu8 255.0 DFC_OneToOne 0.00 255.0 FORMAT "%5.1" /end CHARACTERISTIC
/begin CHARACTERISTIC DSCHED_Excl.BLLRH_BPLSU_C "exclusion relation / Exclusive FIds to FID_BLLRH and FID_BPLSU" VALUE 0x804F560A Val_Wu8 255.0 DFC_OneToOne 0.00 255.0 FORMAT "%5.1" /end CHARACTERISTIC
/begin CHARACTERISTIC DSCHED_Excl.BLLRH_FRAMBAVMB_C "exclusion relation / Exclusive FIds to FID_BLLRH and FID_FRAMBAVMB" VALUE 0x804F560B Val_Wu8 255.0 DFC_OneToOne 0.00 255.0 FORMAT "%5.1" /end CHARACTERISTIC
/begin CHARACTERISTIC DSCHED_Excl.BLLRH_CatHeatgColdStrtReq_C "exclusion relation / Exclusive FIds to FID_BLLRH and FId_CatHeatgColdStrtReq" VALUE 0x804F560C Val_Wu8 255.0 DFC_OneToOne 0.00 255.0 FORMAT "%5.1" /end CHARACTERISTIC
/begin CHARACTERISTIC DSCHED_Excl.BLLRH_CatHeatgWrmReq_C "exclusion relation / Exclusive FIds to FID_BLLRH and FId_CatHeatgWrmReq" VALUE 0x804F560D Val_Wu8 255.0 DFC_OneToOne 0.00 255.0 FORMAT "%5.1" /end CHARACTERISTIC
/begin CHARACTERISTIC DSCHED_Excl.BLLRH_DSMBDEPHSpOpMode_C "exclusion relation / Exclusive FIds to FID_BLLRH and FId_DSMBDEPHSpOpMode" VALUE 0x804F560E Val_Wu8 255.0 DFC_OneToOne 0.00 255.0 FORMAT "%5.1" /end CHARACTERISTIC
/begin CHARACTERISTIC DSCHED_Excl.BLLRH_EGRVlvCoord_C "exclusion relation / Exclusive FIds to FID_BLLRH and FId_EGRVlvCoord" VALUE 0x804F560F Val_Wu8 255.0 DFC_OneToOne 0.00 255.0 FORMAT "%5.1" /end CHARACTERISTIC
/begin CHARACTERISTIC DSCHED_Excl.BLLRH_EGSDO2FuTrmB1_C "exclusion relation / Exclusive FIds to FID_BLLRH and FId_EGSDO2FuTrmB1" VALUE 0x804F5610 Val_Wu8 255.0 DFC_OneToOne 0.00 255.0 FORMAT "%5.1" /end CHARACTERISTIC
/begin CHARACTERISTIC DSCHED_Excl.BLLRH_EGSDO2SnsrMntdRelsS1B1_C "exclusion relation / Exclusive FIds to FID_BLLRH and FId_EGSDO2SnsrMntdRelsS1B1" VALUE 0x804F5611 Val_Wu8 255.0 DFC_OneToOne 0.00 255.0 FORMAT "%5.1" /end CHARACTERISTIC
/begin CHARACTERISTIC DSCHED_Excl.BLLRH_EGSDO2_LamOffsFastS1B1_C "exclusion relation / Exclusive FIds to FID_BLLRH and FId_EGSDO2_LamOffsFastS1B1" VALUE 0x804F5612 Val_Wu8 255.0 DFC_OneToOne 0.00 255.0 FORMAT "%5.1" /end CHARACTERISTIC
/begin CHARACTERISTIC DSCHED_Excl.BLLRH_MisfDetDnAdpnNv_C "exclusion relation / Exclusive FIds to FID_BLLRH and FId_MisfDetDnAdpnNv" VALUE 0x804F5613 Val_Wu8 255.0 DFC_OneToOne 0.00 255.0 FORMAT "%5.1" /end CHARACTERISTIC
/begin CHARACTERISTIC DSCHED_Excl.BLLRH_bascadpncvo_C "exclusion relation / Exclusive FIds to FID_BLLRH and FId_bascadpncvo" VALUE 0x804F5614 Val_Wu8 255.0 DFC_OneToOne 0.00 255.0 FORMAT "%5.1" /end CHARACTERISTIC
/begin CHARACTERISTIC DSCHED_Excl.BLLRKH_BPLSU_C "exclusion relation / Exclusive FIds to FID_BLLRKH and FID_BPLSU" VALUE 0x804F5615 Val_Wu8 255.0 DFC_OneToOne 0.00 255.0 FORMAT "%5.1" /end CHARACTERISTIC
/begin CHARACTERISTIC DSCHED_Excl.BLLRKH_FRAMBAVMB_C "exclusion relation / Exclusive FIds to FID_BLLRKH and FID_FRAMBAVMB" VALUE 0x804F5616 Val_Wu8 255.0 DFC_OneToOne 0.00 255.0 FORMAT "%5.1" /end CHARACTERISTIC
/begin CHARACTERISTIC DSCHED_Excl.BLLRKH_CatHeatgColdStrtReq_C "exclusion relation / Exclusive FIds to FID_BLLRKH and FId_CatHeatgColdStrtReq" VALUE 0x804F5617 Val_Wu8 255.0 DFC_OneToOne 0.00 255.0 FORMAT "%5.1" /end CHARACTERISTIC
/begin CHARACTERISTIC DSCHED_Excl.BLLRKH_CatHeatgWrmReq_C "exclusion relation / Exclusive FIds to FID_BLLRKH and FId_CatHeatgWrmReq" VALUE 0x804F5618 Val_Wu8 255.0 DFC_OneToOne 0.00 255.0 FORMAT "%5.1" /end CHARACTERISTIC
/begin CHARACTERISTIC DSCHED_Excl.BLLRKH_DSMBDEPHSpOpMode_C "exclusion relation / Exclusive FIds to FID_BLLRKH and FId_DSMBDEPHSpOpMode" VALUE 0x804F5619 Val_Wu8 255.0 DFC_OneToOne 0.00 255.0 FORMAT "%5.1" /end CHARACTERISTIC
/begin CHARACTERISTIC DSCHED_Excl.BLLRKH_EGRVlvCoord_C "exclusion relation / Exclusive FIds to FID_BLLRKH and FId_EGRVlvCoord" VALUE 0x804F561A Val_Wu8 255.0 DFC_OneToOne 0.00 255.0 FORMAT "%5.1" /end CHARACTERISTIC
/begin CHARACTERISTIC DSCHED_Excl.BLLRKH_EGSDO2FuTrmB1_C "exclusion relation / Exclusive FIds to FID_BLLRKH and FId_EGSDO2FuTrmB1" VALUE 0x804F561B Val_Wu8 255.0 DFC_OneToOne 0.00 255.0 FORMAT "%5.1" /end CHARACTERISTIC
/begin CHARACTERISTIC DSCHED_Excl.BLLRKH_EGSDO2SnsrMntdRelsS1B1_C "exclusion relation / Exclusive FIds to FID_BLLRKH and FId_EGSDO2SnsrMntdRelsS1B1" VALUE 0x804F561C Val_Wu8 255.0 DFC_OneToOne 0.00 255.0 FORMAT "%5.1" /end CHARACTERISTIC
/begin CHARACTERISTIC DSCHED_Excl.BLLRKH_EGSDO2_LamOffsFastS1B1_C "exclusion relation / Exclusive FIds to FID_BLLRKH and FId_EGSDO2_LamOffsFastS1B1" VALUE 0x804F561D Val_Wu8 255.0 DFC_OneToOne 0.00 255.0 FORMAT "%5.1" /end CHARACTERISTIC
/begin CHARACTERISTIC DSCHED_Excl.BLLRKH_MisfDetDnAdpnNv_C "exclusion relation / Exclusive FIds to FID_BLLRKH and FId_MisfDetDnAdpnNv" VALUE 0x804F561E Val_Wu8 255.0 DFC_OneToOne 0.00 255.0 FORMAT "%5.1" /end CHARACTERISTIC
/begin CHARACTERISTIC DSCHED_Excl.BLLRKH_bascadpncvo_C "exclusion relation / Exclusive FIds to FID_BLLRKH and FId_bascadpncvo" VALUE 0x804F561F Val_Wu8 255.0 DFC_OneToOne 0.00 255.0 FORMAT "%5.1" /end CHARACTERISTIC
/begin CHARACTERISTIC DSCHED_Excl.BPLSU_FRAMBAVMB_C "exclusion relation / Exclusive FIds to FID_BPLSU and FID_FRAMBAVMB" VALUE 0x804F5620 Val_Wu8 255.0 DFC_OneToOne 0.00 255.0 FORMAT "%5.1" /end CHARACTERISTIC
/begin CHARACTERISTIC DSCHED_Excl.BPLSU_CatHeatgColdStrtReq_C "exclusion relation / Exclusive FIds to FID_BPLSU and FId_CatHeatgColdStrtReq" VALUE 0x804F5621 Val_Wu8 255.0 DFC_OneToOne 0.00 255.0 FORMAT "%5.1" /end CHARACTERISTIC
/begin CHARACTERISTIC DSCHED_Excl.BPLSU_CatHeatgWrmReq_C "exclusion relation / Exclusive FIds to FID_BPLSU and FId_CatHeatgWrmReq" VALUE 0x804F5622 Val_Wu8 255.0 DFC_OneToOne 0.00 255.0 FORMAT "%5.1" /end CHARACTERISTIC
/begin CHARACTERISTIC DSCHED_Excl.BPLSU_DSMBDEPHSpOpMode_C "exclusion relation / Exclusive FIds to FID_BPLSU and FId_DSMBDEPHSpOpMode" VALUE 0x804F5623 Val_Wu8 255.0 DFC_OneToOne 0.00 255.0 FORMAT "%5.1" /end CHARACTERISTIC
/begin CHARACTERISTIC DSCHED_Excl.BPLSU_EGRVlvCoord_C "exclusion relation / Exclusive FIds to FID_BPLSU and FId_EGRVlvCoord" VALUE 0x804F5624 Val_Wu8 255.0 DFC_OneToOne 0.00 255.0 FORMAT "%5.1" /end CHARACTERISTIC
/begin CHARACTERISTIC DSCHED_Excl.BPLSU_EGSDO2FuTrmB1_C "exclusion relation / Exclusive FIds to FID_BPLSU and FId_EGSDO2FuTrmB1" VALUE 0x804F5625 Val_Wu8 255.0 DFC_OneToOne 0.00 255.0 FORMAT "%5.1" /end CHARACTERISTIC
/begin CHARACTERISTIC DSCHED_Excl.BPLSU_EGSDO2SnsrMntdRelsS1B1_C "exclusion relation / Exclusive FIds to FID_BPLSU and FId_EGSDO2SnsrMntdRelsS1B1" VALUE 0x804F5626 Val_Wu8 255.0 DFC_OneToOne 0.00 255.0 FORMAT "%5.1" /end CHARACTERISTIC
/begin CHARACTERISTIC DSCHED_Excl.BPLSU_EGSDO2_LamOffsFastS1B1_C "exclusion relation / Exclusive FIds to FID_BPLSU and FId_EGSDO2_LamOffsFastS1B1" VALUE 0x804F5627 Val_Wu8 255.0 DFC_OneToOne 0.00 255.0 FORMAT "%5.1" /end CHARACTERISTIC
/begin CHARACTERISTIC DSCHED_Excl.BPLSU_MisfDetDnAdpnNv_C "exclusion relation / Exclusive FIds to FID_BPLSU and FId_MisfDetDnAdpnNv" VALUE 0x804F5628 Val_Wu8 255.0 DFC_OneToOne 0.00 255.0 FORMAT "%5.1" /end CHARACTERISTIC
/begin CHARACTERISTIC DSCHED_Excl.BPLSU_bascadpncvo_C "exclusion relation / Exclusive FIds to FID_BPLSU and FId_bascadpncvo" VALUE 0x804F5629 Val_Wu8 255.0 DFC_OneToOne 0.00 255.0 FORMAT "%5.1" /end CHARACTERISTIC
/begin CHARACTERISTIC DSCHED_Excl.FRAMBAVMB_CatHeatgColdStrtReq_C "exclusion relation / Exclusive FIds to FID_FRAMBAVMB and FId_CatHeatgColdStrtReq" VALUE 0x804F562A Val_Wu8 255.0 DFC_OneToOne 0.00 255.0 FORMAT "%5.1" /end CHARACTERISTIC
/begin CHARACTERISTIC DSCHED_Excl.FRAMBAVMB_CatHeatgWrmReq_C "exclusion relation / Exclusive FIds to FID_FRAMBAVMB and FId_CatHeatgWrmReq" VALUE 0x804F562B Val_Wu8 255.0 DFC_OneToOne 0.00 255.0 FORMAT "%5.1" /end CHARACTERISTIC
/begin CHARACTERISTIC DSCHED_Excl.FRAMBAVMB_DSMBDEPHSpOpMode_C "exclusion relation / Exclusive FIds to FID_FRAMBAVMB and FId_DSMBDEPHSpOpMode" VALUE 0x804F562C Val_Wu8 255.0 DFC_OneToOne 0.00 255.0 FORMAT "%5.1" /end CHARACTERISTIC
/begin CHARACTERISTIC DSCHED_Excl.FRAMBAVMB_EGRVlvCoord_C "exclusion relation / Exclusive FIds to FID_FRAMBAVMB and FId_EGRVlvCoord" VALUE 0x804F562D Val_Wu8 255.0 DFC_OneToOne 0.00 255.0 FORMAT "%5.1" /end CHARACTERISTIC
/begin CHARACTERISTIC DSCHED_Excl.FRAMBAVMB_EGSDO2FuTrmB1_C "exclusion relation / Exclusive FIds to FID_FRAMBAVMB and FId_EGSDO2FuTrmB1" VALUE 0x804F562E Val_Wu8 255.0 DFC_OneToOne 0.00 255.0 FORMAT "%5.1" /end CHARACTERISTIC
/begin CHARACTERISTIC DSCHED_Excl.FRAMBAVMB_EGSDO2SnsrMntdRelsS1B1_C "exclusion relation / Exclusive FIds to FID_FRAMBAVMB and FId_EGSDO2SnsrMntdRelsS1B1" VALUE 0x804F562F Val_Wu8 255.0 DFC_OneToOne 0.00 255.0 FORMAT "%5.1" /end CHARACTERISTIC
/begin CHARACTERISTIC DSCHED_Excl.FRAMBAVMB_EGSDO2_LamOffsFastS1B1_C "exclusion relation / Exclusive FIds to FID_FRAMBAVMB and FId_EGSDO2_LamOffsFastS1B1" VALUE 0x804F5630 Val_Wu8 255.0 DFC_OneToOne 0.00 255.0 FORMAT "%5.1" /end CHARACTERISTIC
/begin CHARACTERISTIC DSCHED_Excl.FRAMBAVMB_MisfDetDnAdpnNv_C "exclusion relation / Exclusive FIds to FID_FRAMBAVMB and FId_MisfDetDnAdpnNv" VALUE 0x804F5631 Val_Wu8 255.0 DFC_OneToOne 0.00 255.0 FORMAT "%5.1" /end CHARACTERISTIC
/begin CHARACTERISTIC DSCHED_Excl.FRAMBAVMB_bascadpncvo_C "exclusion relation / Exclusive FIds to FID_FRAMBAVMB and FId_bascadpncvo" VALUE 0x804F5632 Val_Wu8 255.0 DFC_OneToOne 0.00 255.0 FORMAT "%5.1" /end CHARACTERISTIC
/begin CHARACTERISTIC DSCHED_Excl.CatHeatgColdStrtReq_CatHeatgWrmReq_C "exclusion relation / Exclusive FIds to FId_CatHeatgColdStrtReq and FId_CatHeatgWrmReq" VALUE 0x804F5633 Val_Wu8 255.0 DFC_OneToOne 0.00 255.0 FORMAT "%5.1" /end CHARACTERISTIC
/begin CHARACTERISTIC DSCHED_Excl.CatHeatgColdStrtReq_DSMBDEPHSpOpMode_C "exclusion relation / Exclusive FIds to FId_CatHeatgColdStrtReq and FId_DSMBDEPHSpOpMode" VALUE 0x804F5634 Val_Wu8 255.0 DFC_OneToOne 0.00 255.0 FORMAT "%5.1" /end CHARACTERISTIC
/begin CHARACTERISTIC DSCHED_Excl.CatHeatgColdStrtReq_EGRVlvCoord_C "exclusion relation / Exclusive FIds to FId_CatHeatgColdStrtReq and FId_EGRVlvCoord" VALUE 0x804F5635 Val_Wu8 255.0 DFC_OneToOne 0.00 255.0 FORMAT "%5.1" /end CHARACTERISTIC
/begin CHARACTERISTIC DSCHED_Excl.CatHeatgColdStrtReq_EGSDO2FuTrmB1_C "exclusion relation / Exclusive FIds to FId_CatHeatgColdStrtReq and FId_EGSDO2FuTrmB1" VALUE 0x804F5636 Val_Wu8 255.0 DFC_OneToOne 0.00 255.0 FORMAT "%5.1" /end CHARACTERISTIC
/begin CHARACTERISTIC DSCHED_Excl.CatHeatgColdStrtReq_EGSDO2SnsrMntdRelsS1B1_C "exclusion relation / Exclusive FIds to FId_CatHeatgColdStrtReq and FId_EGSDO2SnsrMntdRelsS1B1" VALUE 0x804F5637 Val_Wu8 255.0 DFC_OneToOne 0.00 255.0 FORMAT "%5.1" /end CHARACTERISTIC
/begin CHARACTERISTIC DSCHED_Excl.CatHeatgColdStrtReq_EGSDO2_LamOffsFastS1B1_C "exclusion relation / Exclusive FIds to FId_CatHeatgColdStrtReq and FId_EGSDO2_LamOffsFastS1B1" VALUE 0x804F5638 Val_Wu8 255.0 DFC_OneToOne 0.00 255.0 FORMAT "%5.1" /end CHARACTERISTIC
/begin CHARACTERISTIC DSCHED_Excl.CatHeatgColdStrtReq_MisfDetDnAdpnNv_C "exclusion relation / Exclusive FIds to FId_CatHeatgColdStrtReq and FId_MisfDetDnAdpnNv" VALUE 0x804F5639 Val_Wu8 255.0 DFC_OneToOne 0.00 255.0 FORMAT "%5.1" /end CHARACTERISTIC
/begin CHARACTERISTIC DSCHED_Excl.CatHeatgColdStrtReq_bascadpncvo_C "exclusion relation / Exclusive FIds to FId_CatHeatgColdStrtReq and FId_bascadpncvo" VALUE 0x804F563A Val_Wu8 255.0 DFC_OneToOne 0.00 255.0 FORMAT "%5.1" /end CHARACTERISTIC
/begin CHARACTERISTIC DSCHED_Excl.CatHeatgWrmReq_DSMBDEPHSpOpMode_C "exclusion relation / Exclusive FIds to FId_CatHeatgWrmReq and FId_DSMBDEPHSpOpMode" VALUE 0x804F563B Val_Wu8 255.0 DFC_OneToOne 0.00 255.0 FORMAT "%5.1" /end CHARACTERISTIC
/begin CHARACTERISTIC DSCHED_Excl.CatHeatgWrmReq_EGRVlvCoord_C "exclusion relation / Exclusive FIds to FId_CatHeatgWrmReq and FId_EGRVlvCoord" VALUE 0x804F563C Val_Wu8 255.0 DFC_OneToOne 0.00 255.0 FORMAT "%5.1" /end CHARACTERISTIC
/begin CHARACTERISTIC DSCHED_Excl.CatHeatgWrmReq_EGSDO2FuTrmB1_C "exclusion relation / Exclusive FIds to FId_CatHeatgWrmReq and FId_EGSDO2FuTrmB1" VALUE 0x804F563D Val_Wu8 255.0 DFC_OneToOne 0.00 255.0 FORMAT "%5.1" /end CHARACTERISTIC
/begin CHARACTERISTIC DSCHED_Excl.CatHeatgWrmReq_EGSDO2SnsrMntdRelsS1B1_C "exclusion relation / Exclusive FIds to FId_CatHeatgWrmReq and FId_EGSDO2SnsrMntdRelsS1B1" VALUE 0x804F563E Val_Wu8 255.0 DFC_OneToOne 0.00 255.0 FORMAT "%5.1" /end CHARACTERISTIC
/begin CHARACTERISTIC DSCHED_Excl.CatHeatgWrmReq_EGSDO2_LamOffsFastS1B1_C "exclusion relation / Exclusive FIds to FId_CatHeatgWrmReq and FId_EGSDO2_LamOffsFastS1B1" VALUE 0x804F563F Val_Wu8 255.0 DFC_OneToOne 0.00 255.0 FORMAT "%5.1" /end CHARACTERISTIC
/begin CHARACTERISTIC DSCHED_Excl.CatHeatgWrmReq_MisfDetDnAdpnNv_C "exclusion relation / Exclusive FIds to FId_CatHeatgWrmReq and FId_MisfDetDnAdpnNv" VALUE 0x804F5640 Val_Wu8 255.0 DFC_OneToOne 0.00 255.0 FORMAT "%5.1" /end CHARACTERISTIC
/begin CHARACTERISTIC DSCHED_Excl.CatHeatgWrmReq_bascadpncvo_C "exclusion relation / Exclusive FIds to FId_CatHeatgWrmReq and FId_bascadpncvo" VALUE 0x804F5641 Val_Wu8 255.0 DFC_OneToOne 0.00 255.0 FORMAT "%5.1" /end CHARACTERISTIC
/begin CHARACTERISTIC DSCHED_Excl.DSMBDEPHSpOpMode_EGRVlvCoord_C "exclusion relation / Exclusive FIds to FId_DSMBDEPHSpOpMode and FId_EGRVlvCoord" VALUE 0x804F5642 Val_Wu8 255.0 DFC_OneToOne 0.00 255.0 FORMAT "%5.1" /end CHARACTERISTIC
/begin CHARACTERISTIC DSCHED_Excl.DSMBDEPHSpOpMode_EGSDO2FuTrmB1_C "exclusion relation / Exclusive FIds to FId_DSMBDEPHSpOpMode and FId_EGSDO2FuTrmB1" VALUE 0x804F5643 Val_Wu8 255.0 DFC_OneToOne 0.00 255.0 FORMAT "%5.1" /end CHARACTERISTIC
/begin CHARACTERISTIC DSCHED_Excl.DSMBDEPHSpOpMode_EGSDO2SnsrMntdRelsS1B1_C "exclusion relation / Exclusive FIds to FId_DSMBDEPHSpOpMode and FId_EGSDO2SnsrMntdRelsS1B1" VALUE 0x804F5644 Val_Wu8 255.0 DFC_OneToOne 0.00 255.0 FORMAT "%5.1" /end CHARACTERISTIC
/begin CHARACTERISTIC DSCHED_Excl.DSMBDEPHSpOpMode_EGSDO2_LamOffsFastS1B1_C "exclusion relation / Exclusive FIds to FId_DSMBDEPHSpOpMode and FId_EGSDO2_LamOffsFastS1B1" VALUE 0x804F5645 Val_Wu8 255.0 DFC_OneToOne 0.00 255.0 FORMAT "%5.1" /end CHARACTERISTIC
/begin CHARACTERISTIC DSCHED_Excl.DSMBDEPHSpOpMode_MisfDetDnAdpnNv_C "exclusion relation / Exclusive FIds to FId_DSMBDEPHSpOpMode and FId_MisfDetDnAdpnNv" VALUE 0x804F5646 Val_Wu8 255.0 DFC_OneToOne 0.00 255.0 FORMAT "%5.1" /end CHARACTERISTIC
/begin CHARACTERISTIC DSCHED_Excl.DSMBDEPHSpOpMode_bascadpncvo_C "exclusion relation / Exclusive FIds to FId_DSMBDEPHSpOpMode and FId_bascadpncvo" VALUE 0x804F5647 Val_Wu8 255.0 DFC_OneToOne 0.00 255.0 FORMAT "%5.1" /end CHARACTERISTIC
/begin CHARACTERISTIC DSCHED_Excl.EGRVlvCoord_EGSDO2FuTrmB1_C "exclusion relation / Exclusive FIds to FId_EGRVlvCoord and FId_EGSDO2FuTrmB1" VALUE 0x804F5648 Val_Wu8 255.0 DFC_OneToOne 0.00 255.0 FORMAT "%5.1" /end CHARACTERISTIC
/begin CHARACTERISTIC DSCHED_Excl.EGRVlvCoord_EGSDO2SnsrMntdRelsS1B1_C "exclusion relation / Exclusive FIds to FId_EGRVlvCoord and FId_EGSDO2SnsrMntdRelsS1B1" VALUE 0x804F5649 Val_Wu8 255.0 DFC_OneToOne 0.00 255.0 FORMAT "%5.1" /end CHARACTERISTIC
/begin CHARACTERISTIC DSCHED_Excl.EGRVlvCoord_EGSDO2_LamOffsFastS1B1_C "exclusion relation / Exclusive FIds to FId_EGRVlvCoord and FId_EGSDO2_LamOffsFastS1B1" VALUE 0x804F564A Val_Wu8 255.0 DFC_OneToOne 0.00 255.0 FORMAT "%5.1" /end CHARACTERISTIC
/begin CHARACTERISTIC DSCHED_Excl.EGRVlvCoord_MisfDetDnAdpnNv_C "exclusion relation / Exclusive FIds to FId_EGRVlvCoord and FId_MisfDetDnAdpnNv" VALUE 0x804F564B Val_Wu8 255.0 DFC_OneToOne 0.00 255.0 FORMAT "%5.1" /end CHARACTERISTIC
/begin CHARACTERISTIC DSCHED_Excl.EGRVlvCoord_bascadpncvo_C "exclusion relation / Exclusive FIds to FId_EGRVlvCoord and FId_bascadpncvo" VALUE 0x804F564C Val_Wu8 255.0 DFC_OneToOne 0.00 255.0 FORMAT "%5.1" /end CHARACTERISTIC
/begin CHARACTERISTIC DSCHED_Excl.EGSDO2FuTrmB1_EGSDO2SnsrMntdRelsS1B1_C "exclusion relation / Exclusive FIds to FId_EGSDO2FuTrmB1 and FId_EGSDO2SnsrMntdRelsS1B1" VALUE 0x804F564D Val_Wu8 255.0 DFC_OneToOne 0.00 255.0 FORMAT "%5.1" /end CHARACTERISTIC
/begin CHARACTERISTIC DSCHED_Excl.EGSDO2FuTrmB1_EGSDO2_LamOffsFastS1B1_C "exclusion relation / Exclusive FIds to FId_EGSDO2FuTrmB1 and FId_EGSDO2_LamOffsFastS1B1" VALUE 0x804F564E Val_Wu8 255.0 DFC_OneToOne 0.00 255.0 FORMAT "%5.1" /end CHARACTERISTIC
/begin CHARACTERISTIC DSCHED_Excl.EGSDO2FuTrmB1_MisfDetDnAdpnNv_C "exclusion relation / Exclusive FIds to FId_EGSDO2FuTrmB1 and FId_MisfDetDnAdpnNv" VALUE 0x804F564F Val_Wu8 255.0 DFC_OneToOne 0.00 255.0 FORMAT "%5.1" /end CHARACTERISTIC
/begin CHARACTERISTIC DSCHED_Excl.EGSDO2FuTrmB1_bascadpncvo_C "exclusion relation / Exclusive FIds to FId_EGSDO2FuTrmB1 and FId_bascadpncvo" VALUE 0x804F5650 Val_Wu8 255.0 DFC_OneToOne 0.00 255.0 FORMAT "%5.1" /end CHARACTERISTIC
/begin CHARACTERISTIC DSCHED_Excl.EGSDO2SnsrMntdRelsS1B1_EGSDO2_LamOffsFastS1B1_C "exclusion relation / Exclusive FIds to FId_EGSDO2SnsrMntdRelsS1B1 and FId_EGSDO2_LamOffsFastS1B1" VALUE 0x804F5651 Val_Wu8 255.0 DFC_OneToOne 0.00 255.0 FORMAT "%5.1" /end CHARACTERISTIC
/begin CHARACTERISTIC DSCHED_Excl.EGSDO2SnsrMntdRelsS1B1_MisfDetDnAdpnNv_C "exclusion relation / Exclusive FIds to FId_EGSDO2SnsrMntdRelsS1B1 and FId_MisfDetDnAdpnNv" VALUE 0x804F5652 Val_Wu8 255.0 DFC_OneToOne 0.00 255.0 FORMAT "%5.1" /end CHARACTERISTIC
/begin CHARACTERISTIC DSCHED_Excl.EGSDO2SnsrMntdRelsS1B1_bascadpncvo_C "exclusion relation / Exclusive FIds to FId_EGSDO2SnsrMntdRelsS1B1 and FId_bascadpncvo" VALUE 0x804F5653 Val_Wu8 255.0 DFC_OneToOne 0.00 255.0 FORMAT "%5.1" /end CHARACTERISTIC
/begin CHARACTERISTIC DSCHED_Excl.EGSDO2_LamOffsFastS1B1_MisfDetDnAdpnNv_C "exclusion relation / Exclusive FIds to FId_EGSDO2_LamOffsFastS1B1 and FId_MisfDetDnAdpnNv" VALUE 0x804F5654 Val_Wu8 255.0 DFC_OneToOne 0.00 255.0 FORMAT "%5.1" /end CHARACTERISTIC
/begin CHARACTERISTIC DSCHED_Excl.EGSDO2_LamOffsFastS1B1_bascadpncvo_C "exclusion relation / Exclusive FIds to FId_EGSDO2_LamOffsFastS1B1 and FId_bascadpncvo" VALUE 0x804F5655 Val_Wu8 255.0 DFC_OneToOne 0.00 255.0 FORMAT "%5.1" /end CHARACTERISTIC
/begin CHARACTERISTIC DSCHED_Excl.MisfDetDnAdpnNv_bascadpncvo_C "exclusion relation / Exclusive FIds to FId_MisfDetDnAdpnNv and FId_bascadpncvo" VALUE 0x804F5656 Val_Wu8 255.0 DFC_OneToOne 0.00 255.0 FORMAT "%5.1" /end CHARACTERISTIC
/begin CHARACTERISTIC DSCHED_OpModeMsk.FID_AFRA_C "operation mode mask / Operation Mode Mask for scheduled FId FID_AFRA" VALUE 0x80503E34 Val_Wu16 65535.00 DFC_OneToOne 0.00 65535.00 FORMAT "%8.2" /end CHARACTERISTIC
/begin CHARACTERISTIC DSCHED_OpModeMsk.FID_AORA_C "operation mode mask / Operation Mode Mask for scheduled FId FID_AORA" VALUE 0x80503E36 Val_Wu16 65535.00 DFC_OneToOne 0.00 65535.00 FORMAT "%8.2" /end CHARACTERISTIC
/begin CHARACTERISTIC DSCHED_OpModeMsk.FID_ATEH_C "operation mode mask / Operation Mode Mask for scheduled FId FID_ATEH" VALUE 0x80503E38 Val_Wu16 65535.00 DFC_OneToOne 0.00 65535.00 FORMAT "%8.2" /end CHARACTERISTIC
/begin CHARACTERISTIC DSCHED_OpModeMsk.FID_ATEL_C "operation mode mask / Operation Mode Mask for scheduled FId FID_ATEL" VALUE 0x80503E3A Val_Wu16 65535.00 DFC_OneToOne 0.00 65535.00 FORMAT "%8.2" /end CHARACTERISTIC
/begin CHARACTERISTIC DSCHED_OpModeMsk.FID_ATEN_C "operation mode mask / Operation Mode Mask for scheduled FId FID_ATEN" VALUE 0x80503E3C Val_Wu16 65535.00 DFC_OneToOne 0.00 65535.00 FORMAT "%8.2" /end CHARACTERISTIC
/begin CHARACTERISTIC DSCHED_OpModeMsk.FID_ATLDI_C "operation mode mask / Operation Mode Mask for scheduled FId FID_ATLDI" VALUE 0x80503E3E Val_Wu16 65535.00 DFC_OneToOne 0.00 65535.00 FORMAT "%8.2" /end CHARACTERISTIC
/begin CHARACTERISTIC DSCHED_OpModeMsk.FID_ATLDO_C "operation mode mask / Operation Mode Mask for scheduled FId FID_ATLDO" VALUE 0x80503E40 Val_Wu16 65535.00 DFC_OneToOne 0.00 65535.00 FORMAT "%8.2" /end CHARACTERISTIC
/begin CHARACTERISTIC DSCHED_OpModeMsk.FID_BEONV_C "operation mode mask / Operation Mode Mask for scheduled FId FID_BEONV" VALUE 0x80503E42 Val_Wu16 65535.00 DFC_OneToOne 0.00 65535.00 FORMAT "%8.2" /end CHARACTERISTIC
/begin CHARACTERISTIC DSCHED_OpModeMsk.FId_EGSDCmnSeg1B1Parl_C "operation mode mask / Operation Mode Mask for scheduled FId FId_EGSDCmnSeg1B1Parl" VALUE 0x80503E44 Val_Wu16 65535.00 DFC_OneToOne 0.00 65535.00 FORMAT "%8.2" /end CHARACTERISTIC
/begin CHARACTERISTIC DSCHED_OpModeMsk.FID_BAGRA_C "operation mode mask / Operation Mode Mask for scheduled FId FID_BAGRA" VALUE 0x80503E46 Val_Wu16 65535.00 DFC_OneToOne 0.00 65535.00 FORMAT "%8.2" /end CHARACTERISTIC
/begin CHARACTERISTIC DSCHED_OpModeMsk.FID_BAGRASD_C "operation mode mask / Operation Mode Mask for scheduled FId FID_BAGRASD" VALUE 0x80503E48 Val_Wu16 65535.00 DFC_OneToOne 0.00 65535.00 FORMAT "%8.2" /end CHARACTERISTIC
/begin CHARACTERISTIC DSCHED_OpModeMsk.FID_BDSTOF_C "operation mode mask / Operation Mode Mask for scheduled FId FID_BDSTOF" VALUE 0x80503E4A Val_Wu16 65535.00 DFC_OneToOne 0.00 65535.00 FORMAT "%8.2" /end CHARACTERISTIC
/begin CHARACTERISTIC DSCHED_OpModeMsk.FID_BFVDFRM_C "operation mode mask / Operation Mode Mask for scheduled FId FID_BFVDFRM" VALUE 0x80503E4C Val_Wu16 65535.00 DFC_OneToOne 0.00 65535.00 FORMAT "%8.2" /end CHARACTERISTIC
/begin CHARACTERISTIC DSCHED_OpModeMsk.FID_BHOM_C "operation mode mask / Operation Mode Mask for scheduled FId FID_BHOM" VALUE 0x80503E4E Val_Wu16 65535.00 DFC_OneToOne 0.00 65535.00 FORMAT "%8.2" /end CHARACTERISTIC
/begin CHARACTERISTIC DSCHED_OpModeMsk.FID_BLLRH_C "operation mode mask / Operation Mode Mask for scheduled FId FID_BLLRH" VALUE 0x80503E50 Val_Wu16 65535.00 DFC_OneToOne 0.00 65535.00 FORMAT "%8.2" /end CHARACTERISTIC
/begin CHARACTERISTIC DSCHED_OpModeMsk.FID_BLLRKH_C "operation mode mask / Operation Mode Mask for scheduled FId FID_BLLRKH" VALUE 0x80503E52 Val_Wu16 65535.00 DFC_OneToOne 0.00 65535.00 FORMAT "%8.2" /end CHARACTERISTIC
/begin CHARACTERISTIC DSCHED_OpModeMsk.FID_BPLSU_C "operation mode mask / Operation Mode Mask for scheduled FId FID_BPLSU" VALUE 0x80503E54 Val_Wu16 65535.00 DFC_OneToOne 0.00 65535.00 FORMAT "%8.2" /end CHARACTERISTIC
/begin CHARACTERISTIC DSCHED_OpModeMsk.FID_FRAMBAVMB_C "operation mode mask / Operation Mode Mask for scheduled FId FID_FRAMBAVMB" VALUE 0x80503E56 Val_Wu16 65535.00 DFC_OneToOne 0.00 65535.00 FORMAT "%8.2" /end CHARACTERISTIC
/begin CHARACTERISTIC DSCHED_OpModeMsk.FId_CatHeatgColdStrtReq_C "operation mode mask / Operation Mode Mask for scheduled FId FId_CatHeatgColdStrtReq" VALUE 0x80503E58 Val_Wu16 65535.00 DFC_OneToOne 0.00 65535.00 FORMAT "%8.2" /end CHARACTERISTIC
/begin CHARACTERISTIC DSCHED_OpModeMsk.FId_CatHeatgWrmReq_C "operation mode mask / Operation Mode Mask for scheduled FId FId_CatHeatgWrmReq" VALUE 0x80503E5A Val_Wu16 65535.00 DFC_OneToOne 0.00 65535.00 FORMAT "%8.2" /end CHARACTERISTIC
/begin CHARACTERISTIC DSCHED_OpModeMsk.FId_DSMBDEPHSpOpMode_C "operation mode mask / Operation Mode Mask for scheduled FId FId_DSMBDEPHSpOpMode" VALUE 0x80503E5C Val_Wu16 65535.00 DFC_OneToOne 0.00 65535.00 FORMAT "%8.2" /end CHARACTERISTIC
/begin CHARACTERISTIC DSCHED_OpModeMsk.FId_EGRVlvCoord_C "operation mode mask / Operation Mode Mask for scheduled FId FId_EGRVlvCoord" VALUE 0x80503E5E Val_Wu16 65535.00 DFC_OneToOne 0.00 65535.00 FORMAT "%8.2" /end CHARACTERISTIC
/begin CHARACTERISTIC DSCHED_OpModeMsk.FId_EGSDO2FuTrmB1_C "operation mode mask / Operation Mode Mask for scheduled FId FId_EGSDO2FuTrmB1" VALUE 0x80503E60 Val_Wu16 65535.00 DFC_OneToOne 0.00 65535.00 FORMAT "%8.2" /end CHARACTERISTIC
/begin CHARACTERISTIC DSCHED_OpModeMsk.FId_EGSDO2SnsrMntdRelsS1B1_C "operation mode mask / Operation Mode Mask for scheduled FId FId_EGSDO2SnsrMntdRelsS1B1" VALUE 0x80503E62 Val_Wu16 65535.00 DFC_OneToOne 0.00 65535.00 FORMAT "%8.2" /end CHARACTERISTIC
/begin CHARACTERISTIC DSCHED_OpModeMsk.FId_EGSDO2_LamOffsFastS1B1_C "operation mode mask / Operation Mode Mask for scheduled FId FId_EGSDO2_LamOffsFastS1B1" VALUE 0x80503E64 Val_Wu16 65535.00 DFC_OneToOne 0.00 65535.00 FORMAT "%8.2" /end CHARACTERISTIC
/begin CHARACTERISTIC DSCHED_OpModeMsk.FId_MisfDetDnAdpnNv_C "operation mode mask / Operation Mode Mask for scheduled FId FId_MisfDetDnAdpnNv" VALUE 0x80503E66 Val_Wu16 65535.00 DFC_OneToOne 0.00 65535.00 FORMAT "%8.2" /end CHARACTERISTIC
/begin CHARACTERISTIC DSCHED_OpModeMsk.FId_bascadpncvo_C "operation mode mask / Operation Mode Mask for scheduled FId FId_bascadpncvo" VALUE 0x80503E68 Val_Wu16 65535.00 DFC_OneToOne 0.00 65535.00 FORMAT "%8.2" /end CHARACTERISTIC
/begin CHARACTERISTIC DSCHED_stMode_C "Central disable switch for all scheduled FIDs (disabled if set to 0)" VALUE 0x80503E6A Val_Wu8 255.0 DINH_OneToOne 0.00 255.0 FORMAT "%5.1" /end CHARACTERISTIC
/begin CHARACTERISTIC DSCHED_StSimnSeln_C "Simulation approaches selection" VALUE 0x80503E6B Val_Wu8 1.00000000000 DSCHED_StSimnSeln_C_Verb 0.00 1.00000000000 FORMAT "%13.11" /end CHARACTERISTIC
/begin CHARACTERISTIC DSCHED_valDflOpMode_C "Default request value for operation mode coordinator during disable state (DSCHED_stMode_C = 0)" VALUE 0x80503E6C Val_Wu16 65535.00 DINH_OneToOne 0.00 65535.00 FORMAT "%8.2" /end CHARACTERISTIC
/begin CHARACTERISTIC DSMAUX_dtWUCMin_C "minimum temperature raise for warm up cycle detection" VALUE 0x804F5658 Val_Ws16 6553.500 TempDiff_Kelv -3276.800 3276.700 FORMAT "%8.3" /end CHARACTERISTIC
/begin CHARACTERISTIC DSMAUX_tWUCMin_C "minimum temperature for warm up cycle detection" VALUE 0x804F565A Val_Ws16 6553.500 Temp_Cels -3549.940 3003.560 FORMAT "%8.3" /end CHARACTERISTIC
/begin CHARACTERISTIC DSMAUX_xClearMode_C "clear mode for clear trigger" VALUE 0x804F565C Val_Wu16 906.000000000 DFC_Verb 0.00 906.000000000 FORMAT "%13.9" /end CHARACTERISTIC
/begin CHARACTERISTIC DSMAUX_xClearTrg_C "clear trigger to delete diagnostic information" VALUE 0x804F565E Val_Wu8 255.0 DFC_OneToOne 0.00 255.0 FORMAT "%5.1" /end CHARACTERISTIC
/begin CHARACTERISTIC DSMDur_valEvntQntDist_C "increment quantization for travelled distance counter" VALUE 0x804F5660 Val_Wu16 65535.00 DFES_OneToOne 0.00 65535.00 FORMAT "%8.2" /end CHARACTERISTIC
/begin CHARACTERISTIC DSMDur_valEvntQntTi_C "increment quantization for operation time counter" VALUE 0x804F5662 Val_Wu16 65535.00 DFES_OneToOne 0.00 65535.00 FORMAT "%8.2" /end CHARACTERISTIC
/begin CHARACTERISTIC DSMDur_xEnaGlb_CA "Enable conditions for global duration counters" VAL_BLK 0x804F5664 ValA_Wu16 65535.00 DFES_OneToOne 0.00 65535.00 FORMAT "%8.2" NUMBER 1 /end CHARACTERISTIC
/begin CHARACTERISTIC DSMDur_xRstGlb_CA "Reset conditions for global duration counters" VAL_BLK 0x804F5666 ValA_Wu8 255.0 DFES_OneToOne 0.00 255.0 FORMAT "%5.1" NUMBER 1 /end CHARACTERISTIC
/begin CHARACTERISTIC DSMDur_xSelEvntGlb_CA "Counting event selection for global duration counters" VAL_BLK 0x804F5667 ValA_Wu8 8.00000000000 DSMDur_EvntSel_Verb 0.00 8.00000000000 FORMAT "%13.11" NUMBER 1 /end CHARACTERISTIC
/begin CHARACTERISTIC DSMRdy_Grp.FlSys_CA "Fault checks for readiness calculation / Checks for group FlSys" VAL_BLK 0x80503E70 ValA_Wu16 906.000000000 DFC_Verb 0.00 906.000000000 FORMAT "%13.9" NUMBER 15 /end CHARACTERISTIC
/begin CHARACTERISTIC DSMRdy_Grp.Cat_CA "Fault checks for readiness calculation / Checks for group Cat" VAL_BLK 0x80503E90 ValA_Wu16 906.000000000 DFC_Verb 0.00 906.000000000 FORMAT "%13.9" NUMBER 15 /end CHARACTERISTIC
/begin CHARACTERISTIC DSMRdy_Grp.HtCat_CA "Fault checks for readiness calculation / Checks for group HtCat" VAL_BLK 0x80503EAE ValA_Wu16 906.000000000 DFC_Verb 0.00 906.000000000 FORMAT "%13.9" NUMBER 15 /end CHARACTERISTIC
/begin CHARACTERISTIC DSMRdy_Grp.EvpSys_CA "Fault checks for readiness calculation / Checks for group EvpSys" VAL_BLK 0x80503ECC ValA_Wu16 906.000000000 DFC_Verb 0.00 906.000000000 FORMAT "%13.9" NUMBER 15 /end CHARACTERISTIC
/begin CHARACTERISTIC DSMRdy_Grp.SecAirSys_CA "Fault checks for readiness calculation / Checks for group SecAirSys" VAL_BLK 0x80503EEA ValA_Wu16 906.000000000 DFC_Verb 0.00 906.000000000 FORMAT "%13.9" NUMBER 15 /end CHARACTERISTIC
/begin CHARACTERISTIC DSMRdy_Grp.GPF_CA "Fault checks for readiness calculation / " VAL_BLK 0x80503F08 ValA_Wu16 906.000000000 DFC_Verb 0.00 906.000000000 FORMAT "%13.9" NUMBER 15 /end CHARACTERISTIC
/begin CHARACTERISTIC DSMRdy_Grp.O2Sens_CA "Fault checks for readiness calculation / Checks for group O2Sens" VAL_BLK 0x80503F26 ValA_Wu16 906.000000000 DFC_Verb 0.00 906.000000000 FORMAT "%13.9" NUMBER 25 /end CHARACTERISTIC
/begin CHARACTERISTIC DSMRdy_Grp.O2SensHt_CA "Fault checks for readiness calculation / Checks for group O2SensHt" VAL_BLK 0x80503F58 ValA_Wu16 906.000000000 DFC_Verb 0.00 906.000000000 FORMAT "%13.9" NUMBER 15 /end CHARACTERISTIC
/begin CHARACTERISTIC DSMRdy_Grp.EGR_CA "Fault checks for readiness calculation / Checks for group EGR" VAL_BLK 0x80503F76 ValA_Wu16 906.000000000 DFC_Verb 0.00 906.000000000 FORMAT "%13.9" NUMBER 15 /end CHARACTERISTIC
/begin CHARACTERISTIC DSMRdy_X.PID1ForceLowMsk_C "DSMRdy calibration masks / Enforced zero bits of PID$01 output" VALUE 0x804F5668 Val_Wu32 4294967295.00 DSMRdy_OneToOne 0.00 4294967295.00 FORMAT "%13.2" /end CHARACTERISTIC
/begin CHARACTERISTIC DSMRdy_X.PID1ForceHighMsk_C "DSMRdy calibration masks / Enforced one bits of PID$01 output" VALUE 0x804F566C Val_Wu32 4294967295.00 DSMRdy_OneToOne 0.00 4294967295.00 FORMAT "%13.2" /end CHARACTERISTIC
/begin CHARACTERISTIC DSMRdy_X.PID41ForceLowMsk_C "DSMRdy calibration masks / Enforced zero bits of PID$41 output" VALUE 0x804F5670 Val_Wu32 4294967295.00 DSMRdy_OneToOne 0.00 4294967295.00 FORMAT "%13.2" /end CHARACTERISTIC
/begin CHARACTERISTIC DSMRdy_X.PID41ForceHighMsk_C "DSMRdy calibration masks / Enforced one bits of PID$41 output" VALUE 0x804F5674 Val_Wu32 4294967295.00 DSMRdy_OneToOne 0.00 4294967295.00 FORMAT "%13.2" /end CHARACTERISTIC
/begin CHARACTERISTIC PRIOMAKUPL "Prio. phuhom (urgency operating mode homogeneous) for beginning (clutch adapt.)" VALUE 0x8058A94C KwUb 207.0 dez 48.0 255.0 FORMAT "%5.1" EXTENDED_LIMITS 0.00 255.0 /end CHARACTERISTIC
/begin CHARACTERISTIC SF_LM "Inputs for sum of Loas sensor faults DFP_LM" VAL_BLK 0x8053B344 RB_ValA_Wu16 82.0000000000 dfp_verbal 0.00 82.0000000000 FORMAT "%13.10" READ_ONLY NUMBER 4 /end CHARACTERISTIC
/begin MEASUREMENT B_ehfs_msg "Condition substitute value main charge sensor" UBYTE B_TRUE 1 100 0.00 1.00000000000 BIT_MASK 0x1 FORMAT "%13.11" ECU_ADDRESS 0x60000233 /end MEASUREMENT
/begin MEASUREMENT B_fhfs_msg "condition: error of main filling sensor" UBYTE B_TRUE 1 100 0.00 1.00000000000 BIT_MASK 0x1 FORMAT "%13.11" ECU_ADDRESS 0x6000021C /end MEASUREMENT
/begin MEASUREMENT B_statas_msg "status cylinder charge estimation for CAN" UBYTE B_TRUE 1 100 0.00 1.00000000000 BIT_MASK 0x1 FORMAT "%13.11" ECU_ADDRESS 0x600001D0 /end MEASUREMENT
/begin MEASUREMENT Dem_BswErrorBufferWriteCounter "Write access counter" UWORD OneToOne 1 100 0.00 65535.00 FORMAT "%8.2" ECU_ADDRESS 0x70005918 /end MEASUREMENT
/begin MEASUREMENT Dem_BswErrorBufferWriteIndex "Write index for pre init buffer" UWORD OneToOne 1 100 0.00 65535.00 FORMAT "%8.2" ECU_ADDRESS 0x7000591A /end MEASUREMENT
/begin MEASUREMENT Dem_PTOSt "Current PTO active status reported to Dem" UBYTE OneToOne 1 100 0.00 255.0 BIT_MASK 0x1 FORMAT "%5.1" ECU_ADDRESS 0x70006B00 /end MEASUREMENT
/begin MEASUREMENT Dem_stInit "Initialization state of Dem" UBYTE OneToOne 1 100 0.00 255.0 FORMAT "%5.1" ECU_ADDRESS 0x70006B1F /end MEASUREMENT
/begin MEASUREMENT DFC_idxDfcTrans "Index of Dfc that is last processed during transition" UWORD OneToOne 1 100 0.00 65535.00 FORMAT "%8.2" ARRAY_SIZE 1 ECU_ADDRESS 0x6000A006 /end MEASUREMENT
/begin MEASUREMENT DSCHED_idxFIdMaxPrio "The array stores the selected FIds with maximal priorities under different stille possible operation mode sets" UWORD OneToOne 1 100 0.00 65535.00 FORMAT "%8.2" ARRAY_SIZE 16 ECU_ADDRESS 0x6000AD18 /end MEASUREMENT
/begin MEASUREMENT DSCHED_idxSeldTop "Top position of the stack pointer" UBYTE OneToOne 1 100 0.00 255.0 FORMAT "%5.1" ECU_ADDRESS 0x6001158C /end MEASUREMENT
/begin MEASUREMENT DSCHED_St.FId_Unused "Scheduler Status / " UBYTE DSCHED_StVerb 1 100 0.00 238.000000000 FORMAT "%13.9" ECU_ADDRESS 0x600109F0 /end MEASUREMENT
/begin MEASUREMENT DSCHED_St.FID_AFRA "Scheduler Status / Scheduler status of function identifier FID_AFRA" UBYTE DSCHED_StVerb 1 100 0.00 238.000000000 FORMAT "%13.9" ECU_ADDRESS 0x600109F1 /end MEASUREMENT
/begin MEASUREMENT DSCHED_St.FID_AORA "Scheduler Status / Scheduler status of function identifier FID_AORA" UBYTE DSCHED_StVerb 1 100 0.00 238.000000000 FORMAT "%13.9" ECU_ADDRESS 0x600109F2 /end MEASUREMENT
/begin MEASUREMENT DSCHED_St.FID_ATEH "Scheduler Status / Scheduler status of function identifier FID_ATEH" UBYTE DSCHED_StVerb 1 100 0.00 238.000000000 FORMAT "%13.9" ECU_ADDRESS 0x600109F3 /end MEASUREMENT
/begin MEASUREMENT DSCHED_St.FID_ATEL "Scheduler Status / Scheduler status of function identifier FID_ATEL" UBYTE DSCHED_StVerb 1 100 0.00 238.000000000 FORMAT "%13.9" ECU_ADDRESS 0x600109F4 /end MEASUREMENT
/begin MEASUREMENT DSCHED_St.FID_ATEN "Scheduler Status / Scheduler status of function identifier FID_ATEN" UBYTE DSCHED_StVerb 1 100 0.00 238.000000000 FORMAT "%13.9" ECU_ADDRESS 0x600109F5 /end MEASUREMENT
/begin MEASUREMENT DSCHED_St.FID_ATLDI "Scheduler Status / Scheduler status of function identifier FID_ATLDI" UBYTE DSCHED_StVerb 1 100 0.00 238.000000000 FORMAT "%13.9" ECU_ADDRESS 0x600109F6 /end MEASUREMENT
/begin MEASUREMENT DSCHED_St.FID_ATLDO "Scheduler Status / Scheduler status of function identifier FID_ATLDO" UBYTE DSCHED_StVerb 1 100 0.00 238.000000000 FORMAT "%13.9" ECU_ADDRESS 0x600109F7 /end MEASUREMENT
/begin MEASUREMENT DSCHED_St.FID_BEONV "Scheduler Status / Scheduler status of function identifier FID_BEONV" UBYTE DSCHED_StVerb 1 100 0.00 238.000000000 FORMAT "%13.9" ECU_ADDRESS 0x600109F8 /end MEASUREMENT
/begin MEASUREMENT DSCHED_St.FId_EGSDCmnSeg1B1Parl "Scheduler Status / Scheduler status of function identifier FId_EGSDCmnSeg1B1Parl" UBYTE DSCHED_StVerb 1 100 0.00 238.000000000 FORMAT "%13.9" ECU_ADDRESS 0x600109F9 /end MEASUREMENT
/begin MEASUREMENT DSCHED_St.FID_BAGRA "Scheduler Status / Scheduler status of function identifier FID_BAGRA" UBYTE DSCHED_StVerb 1 100 0.00 238.000000000 FORMAT "%13.9" ECU_ADDRESS 0x600109FA /end MEASUREMENT
/begin MEASUREMENT DSCHED_St.FID_BAGRASD "Scheduler Status / Scheduler status of function identifier FID_BAGRASD" UBYTE DSCHED_StVerb 1 100 0.00 238.000000000 FORMAT "%13.9" ECU_ADDRESS 0x600109FB /end MEASUREMENT
/begin MEASUREMENT DSCHED_St.FID_BDSTOF "Scheduler Status / Scheduler status of function identifier FID_BDSTOF" UBYTE DSCHED_StVerb 1 100 0.00 238.000000000 FORMAT "%13.9" ECU_ADDRESS 0x600109FC /end MEASUREMENT
/begin MEASUREMENT DSCHED_St.FID_BFVDFRM "Scheduler Status / Scheduler status of function identifier FID_BFVDFRM" UBYTE DSCHED_StVerb 1 100 0.00 238.000000000 FORMAT "%13.9" ECU_ADDRESS 0x600109FD /end MEASUREMENT
/begin MEASUREMENT DSCHED_St.FID_BHOM "Scheduler Status / Scheduler status of function identifier FID_BHOM" UBYTE DSCHED_StVerb 1 100 0.00 238.000000000 FORMAT "%13.9" ECU_ADDRESS 0x600109FE /end MEASUREMENT
/begin MEASUREMENT DSCHED_St.FID_BLLRH "Scheduler Status / Scheduler status of function identifier FID_BLLRH" UBYTE DSCHED_StVerb 1 100 0.00 238.000000000 FORMAT "%13.9" ECU_ADDRESS 0x600109FF /end MEASUREMENT
/begin MEASUREMENT DSCHED_St.FID_BLLRKH "Scheduler Status / Scheduler status of function identifier FID_BLLRKH" UBYTE DSCHED_StVerb 1 100 0.00 238.000000000 FORMAT "%13.9" ECU_ADDRESS 0x60010A00 /end MEASUREMENT
/begin MEASUREMENT DSCHED_St.FID_BPLSU "Scheduler Status / Scheduler status of function identifier FID_BPLSU" UBYTE DSCHED_StVerb 1 100 0.00 238.000000000 FORMAT "%13.9" ECU_ADDRESS 0x60010A01 /end MEASUREMENT
/begin MEASUREMENT DSCHED_St.FID_FRAMBAVMB "Scheduler Status / Scheduler status of function identifier FID_FRAMBAVMB" UBYTE DSCHED_StVerb 1 100 0.00 238.000000000 FORMAT "%13.9" ECU_ADDRESS 0x60010A02 /end MEASUREMENT
/begin MEASUREMENT DSCHED_St.FId_CatHeatgColdStrtReq "Scheduler Status / Scheduler status of function identifier FId_CatHeatgColdStrtReq" UBYTE DSCHED_StVerb 1 100 0.00 238.000000000 FORMAT "%13.9" ECU_ADDRESS 0x60010A03 /end MEASUREMENT
/begin MEASUREMENT DSCHED_St.FId_CatHeatgWrmReq "Scheduler Status / Scheduler status of function identifier FId_CatHeatgWrmReq" UBYTE DSCHED_StVerb 1 100 0.00 238.000000000 FORMAT "%13.9" ECU_ADDRESS 0x60010A04 /end MEASUREMENT
/begin MEASUREMENT DSCHED_St.FId_DSMBDEPHSpOpMode "Scheduler Status / Scheduler status of function identifier FId_DSMBDEPHSpOpMode" UBYTE DSCHED_StVerb 1 100 0.00 238.000000000 FORMAT "%13.9" ECU_ADDRESS 0x60010A05 /end MEASUREMENT
/begin MEASUREMENT DSCHED_St.FId_EGRVlvCoord "Scheduler Status / Scheduler status of function identifier FId_EGRVlvCoord" UBYTE DSCHED_StVerb 1 100 0.00 238.000000000 FORMAT "%13.9" ECU_ADDRESS 0x60010A06 /end MEASUREMENT
/begin MEASUREMENT DSCHED_St.FId_EGSDO2FuTrmB1 "Scheduler Status / Scheduler status of function identifier FId_EGSDO2FuTrmB1" UBYTE DSCHED_StVerb 1 100 0.00 238.000000000 FORMAT "%13.9" ECU_ADDRESS 0x60010A07 /end MEASUREMENT
/begin MEASUREMENT DSCHED_St.FId_EGSDO2SnsrMntdRelsS1B1 "Scheduler Status / Scheduler status of function identifier FId_EGSDO2SnsrMntdRelsS1B1" UBYTE DSCHED_StVerb 1 100 0.00 238.000000000 FORMAT "%13.9" ECU_ADDRESS 0x60010A08 /end MEASUREMENT
/begin MEASUREMENT DSCHED_St.FId_EGSDO2_LamOffsFastS1B1 "Scheduler Status / Scheduler status of function identifier FId_EGSDO2_LamOffsFastS1B1" UBYTE DSCHED_StVerb 1 100 0.00 238.000000000 FORMAT "%13.9" ECU_ADDRESS 0x60010A09 /end MEASUREMENT
/begin MEASUREMENT DSCHED_St.FId_MisfDetDnAdpnNv "Scheduler Status / Scheduler status of function identifier FId_MisfDetDnAdpnNv" UBYTE DSCHED_StVerb 1 100 0.00 238.000000000 FORMAT "%13.9" ECU_ADDRESS 0x60010A0A /end MEASUREMENT
/begin MEASUREMENT DSCHED_St.FId_bascadpncvo "Scheduler Status / Scheduler status of function identifier FId_bascadpncvo" UBYTE DSCHED_StVerb 1 100 0.00 238.000000000 FORMAT "%13.9" ECU_ADDRESS 0x60010A0B /end MEASUREMENT
/begin MEASUREMENT DSCHED_stOpMode "Current system-mode as provided by system-mode-manager" ULONG OneToOne 1 100 0.00 4294967295.00 FORMAT "%13.2" ECU_ADDRESS 0x60006434 /end MEASUREMENT
/begin MEASUREMENT DSCHED_stPrmsOpMode "The array stores the still possible operation mode sets reduced by the selected FIds with maximal priorities" UWORD OneToOne 1 100 0.00 65535.00 FORMAT "%8.2" ARRAY_SIZE 16 ECU_ADDRESS 0x6000ACF8 /end MEASUREMENT
/begin MEASUREMENT DSCHED_VirtSt.FId_Unused "Scheduler Virtual Status / " UBYTE DSCHED_VirtStVerb 1 100 0.00 200.000000000 FORMAT "%13.9" ECU_ADDRESS 0x600109D4 /end MEASUREMENT
/begin MEASUREMENT DSCHED_VirtSt.FID_AFRA "Scheduler Virtual Status / Scheduler virtual status of function identifier FID_AFRA" UBYTE DSCHED_VirtStVerb 1 100 0.00 200.000000000 FORMAT "%13.9" ECU_ADDRESS 0x600109D5 /end MEASUREMENT
/begin MEASUREMENT DSCHED_VirtSt.FID_AORA "Scheduler Virtual Status / Scheduler virtual status of function identifier FID_AORA" UBYTE DSCHED_VirtStVerb 1 100 0.00 200.000000000 FORMAT "%13.9" ECU_ADDRESS 0x600109D6 /end MEASUREMENT
/begin MEASUREMENT DSCHED_VirtSt.FID_ATEH "Scheduler Virtual Status / Scheduler virtual status of function identifier FID_ATEH" UBYTE DSCHED_VirtStVerb 1 100 0.00 200.000000000 FORMAT "%13.9" ECU_ADDRESS 0x600109D7 /end MEASUREMENT
/begin MEASUREMENT DSCHED_VirtSt.FID_ATEL "Scheduler Virtual Status / Scheduler virtual status of function identifier FID_ATEL" UBYTE DSCHED_VirtStVerb 1 100 0.00 200.000000000 FORMAT "%13.9" ECU_ADDRESS 0x600109D8 /end MEASUREMENT
/begin MEASUREMENT DSCHED_VirtSt.FID_ATEN "Scheduler Virtual Status / Scheduler virtual status of function identifier FID_ATEN" UBYTE DSCHED_VirtStVerb 1 100 0.00 200.000000000 FORMAT "%13.9" ECU_ADDRESS 0x600109D9 /end MEASUREMENT
/begin MEASUREMENT DSCHED_VirtSt.FID_ATLDI "Scheduler Virtual Status / Scheduler virtual status of function identifier FID_ATLDI" UBYTE DSCHED_VirtStVerb 1 100 0.00 200.000000000 FORMAT "%13.9" ECU_ADDRESS 0x600109DA /end MEASUREMENT
/begin MEASUREMENT DSCHED_VirtSt.FID_ATLDO "Scheduler Virtual Status / Scheduler virtual status of function identifier FID_ATLDO" UBYTE DSCHED_VirtStVerb 1 100 0.00 200.000000000 FORMAT "%13.9" ECU_ADDRESS 0x600109DB /end MEASUREMENT
/begin MEASUREMENT DSCHED_VirtSt.FID_BEONV "Scheduler Virtual Status / Scheduler virtual status of function identifier FID_BEONV" UBYTE DSCHED_VirtStVerb 1 100 0.00 200.000000000 FORMAT "%13.9" ECU_ADDRESS 0x600109DC /end MEASUREMENT
/begin MEASUREMENT DSCHED_VirtSt.FId_EGSDCmnSeg1B1Parl "Scheduler Virtual Status / Scheduler virtual status of function identifier FId_EGSDCmnSeg1B1Parl" UBYTE DSCHED_VirtStVerb 1 100 0.00 200.000000000 FORMAT "%13.9" ECU_ADDRESS 0x600109DD /end MEASUREMENT
/begin MEASUREMENT DSCHED_VirtSt.FID_BAGRA "Scheduler Virtual Status / Scheduler virtual status of function identifier FID_BAGRA" UBYTE DSCHED_VirtStVerb 1 100 0.00 200.000000000 FORMAT "%13.9" ECU_ADDRESS 0x600109DE /end MEASUREMENT
/begin MEASUREMENT DSCHED_VirtSt.FID_BAGRASD "Scheduler Virtual Status / Scheduler virtual status of function identifier FID_BAGRASD" UBYTE DSCHED_VirtStVerb 1 100 0.00 200.000000000 FORMAT "%13.9" ECU_ADDRESS 0x600109DF /end MEASUREMENT
/begin MEASUREMENT DSCHED_VirtSt.FID_BDSTOF "Scheduler Virtual Status / Scheduler virtual status of function identifier FID_BDSTOF" UBYTE DSCHED_VirtStVerb 1 100 0.00 200.000000000 FORMAT "%13.9" ECU_ADDRESS 0x600109E0 /end MEASUREMENT
/begin MEASUREMENT DSCHED_VirtSt.FID_BFVDFRM "Scheduler Virtual Status / Scheduler virtual status of function identifier FID_BFVDFRM" UBYTE DSCHED_VirtStVerb 1 100 0.00 200.000000000 FORMAT "%13.9" ECU_ADDRESS 0x600109E1 /end MEASUREMENT
/begin MEASUREMENT DSCHED_VirtSt.FID_BHOM "Scheduler Virtual Status / Scheduler virtual status of function identifier FID_BHOM" UBYTE DSCHED_VirtStVerb 1 100 0.00 200.000000000 FORMAT "%13.9" ECU_ADDRESS 0x600109E2 /end MEASUREMENT
/begin MEASUREMENT DSCHED_VirtSt.FID_BLLRH "Scheduler Virtual Status / Scheduler virtual status of function identifier FID_BLLRH" UBYTE DSCHED_VirtStVerb 1 100 0.00 200.000000000 FORMAT "%13.9" ECU_ADDRESS 0x600109E3 /end MEASUREMENT
/begin MEASUREMENT DSCHED_VirtSt.FID_BLLRKH "Scheduler Virtual Status / Scheduler virtual status of function identifier FID_BLLRKH" UBYTE DSCHED_VirtStVerb 1 100 0.00 200.000000000 FORMAT "%13.9" ECU_ADDRESS 0x600109E4 /end MEASUREMENT
/begin MEASUREMENT DSCHED_VirtSt.FID_BPLSU "Scheduler Virtual Status / Scheduler virtual status of function identifier FID_BPLSU" UBYTE DSCHED_VirtStVerb 1 100 0.00 200.000000000 FORMAT "%13.9" ECU_ADDRESS 0x600109E5 /end MEASUREMENT
/begin MEASUREMENT DSCHED_VirtSt.FID_FRAMBAVMB "Scheduler Virtual Status / Scheduler virtual status of function identifier FID_FRAMBAVMB" UBYTE DSCHED_VirtStVerb 1 100 0.00 200.000000000 FORMAT "%13.9" ECU_ADDRESS 0x600109E6 /end MEASUREMENT
/begin MEASUREMENT DSCHED_VirtSt.FId_CatHeatgColdStrtReq "Scheduler Virtual Status / Scheduler virtual status of function identifier FId_CatHeatgColdStrtReq" UBYTE DSCHED_VirtStVerb 1 100 0.00 200.000000000 FORMAT "%13.9" ECU_ADDRESS 0x600109E7 /end MEASUREMENT
/begin MEASUREMENT DSCHED_VirtSt.FId_CatHeatgWrmReq "Scheduler Virtual Status / Scheduler virtual status of function identifier FId_CatHeatgWrmReq" UBYTE DSCHED_VirtStVerb 1 100 0.00 200.000000000 FORMAT "%13.9" ECU_ADDRESS 0x600109E8 /end MEASUREMENT
/begin MEASUREMENT DSCHED_VirtSt.FId_DSMBDEPHSpOpMode "Scheduler Virtual Status / Scheduler virtual status of function identifier FId_DSMBDEPHSpOpMode" UBYTE DSCHED_VirtStVerb 1 100 0.00 200.000000000 FORMAT "%13.9" ECU_ADDRESS 0x600109E9 /end MEASUREMENT
/begin MEASUREMENT DSCHED_VirtSt.FId_EGRVlvCoord "Scheduler Virtual Status / Scheduler virtual status of function identifier FId_EGRVlvCoord" UBYTE DSCHED_VirtStVerb 1 100 0.00 200.000000000 FORMAT "%13.9" ECU_ADDRESS 0x600109EA /end MEASUREMENT
/begin MEASUREMENT DSCHED_VirtSt.FId_EGSDO2FuTrmB1 "Scheduler Virtual Status / Scheduler virtual status of function identifier FId_EGSDO2FuTrmB1" UBYTE DSCHED_VirtStVerb 1 100 0.00 200.000000000 FORMAT "%13.9" ECU_ADDRESS 0x600109EB /end MEASUREMENT
/begin MEASUREMENT DSCHED_VirtSt.FId_EGSDO2SnsrMntdRelsS1B1 "Scheduler Virtual Status / Scheduler virtual status of function identifier FId_EGSDO2SnsrMntdRelsS1B1" UBYTE DSCHED_VirtStVerb 1 100 0.00 200.000000000 FORMAT "%13.9" ECU_ADDRESS 0x600109EC /end MEASUREMENT
/begin MEASUREMENT DSCHED_VirtSt.FId_EGSDO2_LamOffsFastS1B1 "Scheduler Virtual Status / Scheduler virtual status of function identifier FId_EGSDO2_LamOffsFastS1B1" UBYTE DSCHED_VirtStVerb 1 100 0.00 200.000000000 FORMAT "%13.9" ECU_ADDRESS 0x600109ED /end MEASUREMENT
/begin MEASUREMENT DSCHED_VirtSt.FId_MisfDetDnAdpnNv "Scheduler Virtual Status / Scheduler virtual status of function identifier FId_MisfDetDnAdpnNv" UBYTE DSCHED_VirtStVerb 1 100 0.00 200.000000000 FORMAT "%13.9" ECU_ADDRESS 0x600109EE /end MEASUREMENT
/begin MEASUREMENT DSCHED_VirtSt.FId_bascadpncvo "Scheduler Virtual Status / Scheduler virtual status of function identifier FId_bascadpncvo" UBYTE DSCHED_VirtStVerb 1 100 0.00 200.000000000 FORMAT "%13.9" ECU_ADDRESS 0x600109EF /end MEASUREMENT
/begin MEASUREMENT DSCHED_WhyExcl.FId_Unused "exclusion reason / " UWORD DSCHED_FIdExcCauseVerb 1 100 0.00 255.000000000 FORMAT "%13.9" ECU_ADDRESS 0x50005AA8 /end MEASUREMENT
/begin MEASUREMENT DSCHED_WhyExcl.FID_AFRA "exclusion reason / Exclusion cause of scheduled function identifier FID_AFRA" UWORD DSCHED_FIdExcCauseVerb 1 100 0.00 255.000000000 FORMAT "%13.9" ECU_ADDRESS 0x50005AAA /end MEASUREMENT
/begin MEASUREMENT DSCHED_WhyExcl.FID_AORA "exclusion reason / Exclusion cause of scheduled function identifier FID_AORA" UWORD DSCHED_FIdExcCauseVerb 1 100 0.00 255.000000000 FORMAT "%13.9" ECU_ADDRESS 0x50005AAC /end MEASUREMENT
/begin MEASUREMENT DSCHED_WhyExcl.FID_ATEH "exclusion reason / Exclusion cause of scheduled function identifier FID_ATEH" UWORD DSCHED_FIdExcCauseVerb 1 100 0.00 255.000000000 FORMAT "%13.9" ECU_ADDRESS 0x50005AAE /end MEASUREMENT
/begin MEASUREMENT DSCHED_WhyExcl.FID_ATEL "exclusion reason / Exclusion cause of scheduled function identifier FID_ATEL" UWORD DSCHED_FIdExcCauseVerb 1 100 0.00 255.000000000 FORMAT "%13.9" ECU_ADDRESS 0x50005AB0 /end MEASUREMENT
/begin MEASUREMENT DSCHED_WhyExcl.FID_ATEN "exclusion reason / Exclusion cause of scheduled function identifier FID_ATEN" UWORD DSCHED_FIdExcCauseVerb 1 100 0.00 255.000000000 FORMAT "%13.9" ECU_ADDRESS 0x50005AB2 /end MEASUREMENT
/begin MEASUREMENT DSCHED_WhyExcl.FID_ATLDI "exclusion reason / Exclusion cause of scheduled function identifier FID_ATLDI" UWORD DSCHED_FIdExcCauseVerb 1 100 0.00 255.000000000 FORMAT "%13.9" ECU_ADDRESS 0x50005AB4 /end MEASUREMENT
/begin MEASUREMENT DSCHED_WhyExcl.FID_ATLDO "exclusion reason / Exclusion cause of scheduled function identifier FID_ATLDO" UWORD DSCHED_FIdExcCauseVerb 1 100 0.00 255.000000000 FORMAT "%13.9" ECU_ADDRESS 0x50005AB6 /end MEASUREMENT
/begin MEASUREMENT DSCHED_WhyExcl.FID_BEONV "exclusion reason / Exclusion cause of scheduled function identifier FID_BEONV" UWORD DSCHED_FIdExcCauseVerb 1 100 0.00 255.000000000 FORMAT "%13.9" ECU_ADDRESS 0x50005AB8 /end MEASUREMENT
/begin MEASUREMENT DSCHED_WhyExcl.FId_EGSDCmnSeg1B1Parl "exclusion reason / Exclusion cause of scheduled function identifier FId_EGSDCmnSeg1B1Parl" UWORD DSCHED_FIdExcCauseVerb 1 100 0.00 255.000000000 FORMAT "%13.9" ECU_ADDRESS 0x50005ABA /end MEASUREMENT
/begin MEASUREMENT DSCHED_WhyExcl.FID_BAGRA "exclusion reason / Exclusion cause of scheduled function identifier FID_BAGRA" UWORD DSCHED_FIdExcCauseVerb 1 100 0.00 255.000000000 FORMAT "%13.9" ECU_ADDRESS 0x50005ABC /end MEASUREMENT
/begin MEASUREMENT DSCHED_WhyExcl.FID_BAGRASD "exclusion reason / Exclusion cause of scheduled function identifier FID_BAGRASD" UWORD DSCHED_FIdExcCauseVerb 1 100 0.00 255.000000000 FORMAT "%13.9" ECU_ADDRESS 0x50005ABE /end MEASUREMENT
/begin MEASUREMENT DSCHED_WhyExcl.FID_BDSTOF "exclusion reason / Exclusion cause of scheduled function identifier FID_BDSTOF" UWORD DSCHED_FIdExcCauseVerb 1 100 0.00 255.000000000 FORMAT "%13.9" ECU_ADDRESS 0x50005AC0 /end MEASUREMENT
/begin MEASUREMENT DSCHED_WhyExcl.FID_BFVDFRM "exclusion reason / Exclusion cause of scheduled function identifier FID_BFVDFRM" UWORD DSCHED_FIdExcCauseVerb 1 100 0.00 255.000000000 FORMAT "%13.9" ECU_ADDRESS 0x50005AC2 /end MEASUREMENT
/begin MEASUREMENT DSCHED_WhyExcl.FID_BHOM "exclusion reason / Exclusion cause of scheduled function identifier FID_BHOM" UWORD DSCHED_FIdExcCauseVerb 1 100 0.00 255.000000000 FORMAT "%13.9" ECU_ADDRESS 0x50005AC4 /end MEASUREMENT
/begin MEASUREMENT DSCHED_WhyExcl.FID_BLLRH "exclusion reason / Exclusion cause of scheduled function identifier FID_BLLRH" UWORD DSCHED_FIdExcCauseVerb 1 100 0.00 255.000000000 FORMAT "%13.9" ECU_ADDRESS 0x50005AC6 /end MEASUREMENT
/begin MEASUREMENT DSCHED_WhyExcl.FID_BLLRKH "exclusion reason / Exclusion cause of scheduled function identifier FID_BLLRKH" UWORD DSCHED_FIdExcCauseVerb 1 100 0.00 255.000000000 FORMAT "%13.9" ECU_ADDRESS 0x50005AC8 /end MEASUREMENT
/begin MEASUREMENT DSCHED_WhyExcl.FID_BPLSU "exclusion reason / Exclusion cause of scheduled function identifier FID_BPLSU" UWORD DSCHED_FIdExcCauseVerb 1 100 0.00 255.000000000 FORMAT "%13.9" ECU_ADDRESS 0x50005ACA /end MEASUREMENT
/begin MEASUREMENT DSCHED_WhyExcl.FID_FRAMBAVMB "exclusion reason / Exclusion cause of scheduled function identifier FID_FRAMBAVMB" UWORD DSCHED_FIdExcCauseVerb 1 100 0.00 255.000000000 FORMAT "%13.9" ECU_ADDRESS 0x50005ACC /end MEASUREMENT
/begin MEASUREMENT DSCHED_WhyExcl.FId_CatHeatgColdStrtReq "exclusion reason / Exclusion cause of scheduled function identifier FId_CatHeatgColdStrtReq" UWORD DSCHED_FIdExcCauseVerb 1 100 0.00 255.000000000 FORMAT "%13.9" ECU_ADDRESS 0x50005ACE /end MEASUREMENT
/begin MEASUREMENT DSCHED_WhyExcl.FId_CatHeatgWrmReq "exclusion reason / Exclusion cause of scheduled function identifier FId_CatHeatgWrmReq" UWORD DSCHED_FIdExcCauseVerb 1 100 0.00 255.000000000 FORMAT "%13.9" ECU_ADDRESS 0x50005AD0 /end MEASUREMENT
/begin MEASUREMENT DSCHED_WhyExcl.FId_DSMBDEPHSpOpMode "exclusion reason / Exclusion cause of scheduled function identifier FId_DSMBDEPHSpOpMode" UWORD DSCHED_FIdExcCauseVerb 1 100 0.00 255.000000000 FORMAT "%13.9" ECU_ADDRESS 0x50005AD2 /end MEASUREMENT
/begin MEASUREMENT DSCHED_WhyExcl.FId_EGRVlvCoord "exclusion reason / Exclusion cause of scheduled function identifier FId_EGRVlvCoord" UWORD DSCHED_FIdExcCauseVerb 1 100 0.00 255.000000000 FORMAT "%13.9" ECU_ADDRESS 0x50005AD4 /end MEASUREMENT
/begin MEASUREMENT DSCHED_WhyExcl.FId_EGSDO2FuTrmB1 "exclusion reason / Exclusion cause of scheduled function identifier FId_EGSDO2FuTrmB1" UWORD DSCHED_FIdExcCauseVerb 1 100 0.00 255.000000000 FORMAT "%13.9" ECU_ADDRESS 0x50005AD6 /end MEASUREMENT
/begin MEASUREMENT DSCHED_WhyExcl.FId_EGSDO2SnsrMntdRelsS1B1 "exclusion reason / Exclusion cause of scheduled function identifier FId_EGSDO2SnsrMntdRelsS1B1" UWORD DSCHED_FIdExcCauseVerb 1 100 0.00 255.000000000 FORMAT "%13.9" ECU_ADDRESS 0x50005AD8 /end MEASUREMENT
/begin MEASUREMENT DSCHED_WhyExcl.FId_EGSDO2_LamOffsFastS1B1 "exclusion reason / Exclusion cause of scheduled function identifier FId_EGSDO2_LamOffsFastS1B1" UWORD DSCHED_FIdExcCauseVerb 1 100 0.00 255.000000000 FORMAT "%13.9" ECU_ADDRESS 0x50005ADA /end MEASUREMENT
/begin MEASUREMENT DSCHED_WhyExcl.FId_MisfDetDnAdpnNv "exclusion reason / Exclusion cause of scheduled function identifier FId_MisfDetDnAdpnNv" UWORD DSCHED_FIdExcCauseVerb 1 100 0.00 255.000000000 FORMAT "%13.9" ECU_ADDRESS 0x50005ADC /end MEASUREMENT
/begin MEASUREMENT DSCHED_WhyExcl.FId_bascadpncvo "exclusion reason / Exclusion cause of scheduled function identifier FId_bascadpncvo" UWORD DSCHED_FIdExcCauseVerb 1 100 0.00 255.000000000 FORMAT "%13.9" ECU_ADDRESS 0x50005ADE /end MEASUREMENT
/begin MEASUREMENT DSCHED_WhyVirtExcl.FId_Unused "exclusion reason regarding virtual scheduling / " UWORD DSCHED_FIdExcCauseVerb 1 100 0.00 255.000000000 FORMAT "%13.9" ECU_ADDRESS 0x60009F92 /end MEASUREMENT
/begin MEASUREMENT DSCHED_WhyVirtExcl.FID_AFRA "exclusion reason regarding virtual scheduling / exclusion cause of scheduled function identifier regarding virtual scheduling FID_AFRA" UWORD DSCHED_FIdExcCauseVerb 1 100 0.00 255.000000000 FORMAT "%13.9" ECU_ADDRESS 0x60009F94 /end MEASUREMENT
/begin MEASUREMENT DSCHED_WhyVirtExcl.FID_AORA "exclusion reason regarding virtual scheduling / exclusion cause of scheduled function identifier regarding virtual scheduling FID_AORA" UWORD DSCHED_FIdExcCauseVerb 1 100 0.00 255.000000000 FORMAT "%13.9" ECU_ADDRESS 0x60009F96 /end MEASUREMENT
/begin MEASUREMENT DSCHED_WhyVirtExcl.FID_ATEH "exclusion reason regarding virtual scheduling / exclusion cause of scheduled function identifier regarding virtual scheduling FID_ATEH" UWORD DSCHED_FIdExcCauseVerb 1 100 0.00 255.000000000 FORMAT "%13.9" ECU_ADDRESS 0x60009F98 /end MEASUREMENT
/begin MEASUREMENT DSCHED_WhyVirtExcl.FID_ATEL "exclusion reason regarding virtual scheduling / exclusion cause of scheduled function identifier regarding virtual scheduling FID_ATEL" UWORD DSCHED_FIdExcCauseVerb 1 100 0.00 255.000000000 FORMAT "%13.9" ECU_ADDRESS 0x60009F9A /end MEASUREMENT
/begin MEASUREMENT DSCHED_WhyVirtExcl.FID_ATEN "exclusion reason regarding virtual scheduling / exclusion cause of scheduled function identifier regarding virtual scheduling FID_ATEN" UWORD DSCHED_FIdExcCauseVerb 1 100 0.00 255.000000000 FORMAT "%13.9" ECU_ADDRESS 0x60009F9C /end MEASUREMENT
/begin MEASUREMENT DSCHED_WhyVirtExcl.FID_ATLDI "exclusion reason regarding virtual scheduling / exclusion cause of scheduled function identifier regarding virtual scheduling FID_ATLDI" UWORD DSCHED_FIdExcCauseVerb 1 100 0.00 255.000000000 FORMAT "%13.9" ECU_ADDRESS 0x60009F9E /end MEASUREMENT
/begin MEASUREMENT DSCHED_WhyVirtExcl.FID_ATLDO "exclusion reason regarding virtual scheduling / exclusion cause of scheduled function identifier regarding virtual scheduling FID_ATLDO" UWORD DSCHED_FIdExcCauseVerb 1 100 0.00 255.000000000 FORMAT "%13.9" ECU_ADDRESS 0x60009FA0 /end MEASUREMENT
/begin MEASUREMENT DSCHED_WhyVirtExcl.FID_BEONV "exclusion reason regarding virtual scheduling / exclusion cause of scheduled function identifier regarding virtual scheduling FID_BEONV" UWORD DSCHED_FIdExcCauseVerb 1 100 0.00 255.000000000 FORMAT "%13.9" ECU_ADDRESS 0x60009FA2 /end MEASUREMENT
/begin MEASUREMENT DSCHED_WhyVirtExcl.FId_EGSDCmnSeg1B1Parl "exclusion reason regarding virtual scheduling / exclusion cause of scheduled function identifier regarding virtual scheduling FId_EGSDCmnSeg1B1Parl" UWORD DSCHED_FIdExcCauseVerb 1 100 0.00 255.000000000 FORMAT "%13.9" ECU_ADDRESS 0x60009FA4 /end MEASUREMENT
/begin MEASUREMENT DSCHED_WhyVirtExcl.FID_BAGRA "exclusion reason regarding virtual scheduling / exclusion cause of scheduled function identifier regarding virtual scheduling FID_BAGRA" UWORD DSCHED_FIdExcCauseVerb 1 100 0.00 255.000000000 FORMAT "%13.9" ECU_ADDRESS 0x60009FA6 /end MEASUREMENT
/begin MEASUREMENT DSCHED_WhyVirtExcl.FID_BAGRASD "exclusion reason regarding virtual scheduling / exclusion cause of scheduled function identifier regarding virtual scheduling FID_BAGRASD" UWORD DSCHED_FIdExcCauseVerb 1 100 0.00 255.000000000 FORMAT "%13.9" ECU_ADDRESS 0x60009FA8 /end MEASUREMENT
/begin MEASUREMENT DSCHED_WhyVirtExcl.FID_BDSTOF "exclusion reason regarding virtual scheduling / exclusion cause of scheduled function identifier regarding virtual scheduling FID_BDSTOF" UWORD DSCHED_FIdExcCauseVerb 1 100 0.00 255.000000000 FORMAT "%13.9" ECU_ADDRESS 0x60009FAA /end MEASUREMENT
/begin MEASUREMENT DSCHED_WhyVirtExcl.FID_BFVDFRM "exclusion reason regarding virtual scheduling / exclusion cause of scheduled function identifier regarding virtual scheduling FID_BFVDFRM" UWORD DSCHED_FIdExcCauseVerb 1 100 0.00 255.000000000 FORMAT "%13.9" ECU_ADDRESS 0x60009FAC /end MEASUREMENT
/begin MEASUREMENT DSCHED_WhyVirtExcl.FID_BHOM "exclusion reason regarding virtual scheduling / exclusion cause of scheduled function identifier regarding virtual scheduling FID_BHOM" UWORD DSCHED_FIdExcCauseVerb 1 100 0.00 255.000000000 FORMAT "%13.9" ECU_ADDRESS 0x60009FAE /end MEASUREMENT
/begin MEASUREMENT DSCHED_WhyVirtExcl.FID_BLLRH "exclusion reason regarding virtual scheduling / exclusion cause of scheduled function identifier regarding virtual scheduling FID_BLLRH" UWORD DSCHED_FIdExcCauseVerb 1 100 0.00 255.000000000 FORMAT "%13.9" ECU_ADDRESS 0x60009FB0 /end MEASUREMENT
/begin MEASUREMENT DSCHED_WhyVirtExcl.FID_BLLRKH "exclusion reason regarding virtual scheduling / exclusion cause of scheduled function identifier regarding virtual scheduling FID_BLLRKH" UWORD DSCHED_FIdExcCauseVerb 1 100 0.00 255.000000000 FORMAT "%13.9" ECU_ADDRESS 0x60009FB2 /end MEASUREMENT
/begin MEASUREMENT DSCHED_WhyVirtExcl.FID_BPLSU "exclusion reason regarding virtual scheduling / exclusion cause of scheduled function identifier regarding virtual scheduling FID_BPLSU" UWORD DSCHED_FIdExcCauseVerb 1 100 0.00 255.000000000 FORMAT "%13.9" ECU_ADDRESS 0x60009FB4 /end MEASUREMENT
/begin MEASUREMENT DSCHED_WhyVirtExcl.FID_FRAMBAVMB "exclusion reason regarding virtual scheduling / exclusion cause of scheduled function identifier regarding virtual scheduling FID_FRAMBAVMB" UWORD DSCHED_FIdExcCauseVerb 1 100 0.00 255.000000000 FORMAT "%13.9" ECU_ADDRESS 0x60009FB6 /end MEASUREMENT
/begin MEASUREMENT DSCHED_WhyVirtExcl.FId_CatHeatgColdStrtReq "exclusion reason regarding virtual scheduling / exclusion cause of scheduled function identifier regarding virtual scheduling FId_CatHeatgColdStrtReq" UWORD DSCHED_FIdExcCauseVerb 1 100 0.00 255.000000000 FORMAT "%13.9" ECU_ADDRESS 0x60009FB8 /end MEASUREMENT
/begin MEASUREMENT DSCHED_WhyVirtExcl.FId_CatHeatgWrmReq "exclusion reason regarding virtual scheduling / exclusion cause of scheduled function identifier regarding virtual scheduling FId_CatHeatgWrmReq" UWORD DSCHED_FIdExcCauseVerb 1 100 0.00 255.000000000 FORMAT "%13.9" ECU_ADDRESS 0x60009FBA /end MEASUREMENT
/begin MEASUREMENT DSCHED_WhyVirtExcl.FId_DSMBDEPHSpOpMode "exclusion reason regarding virtual scheduling / exclusion cause of scheduled function identifier regarding virtual scheduling FId_DSMBDEPHSpOpMode" UWORD DSCHED_FIdExcCauseVerb 1 100 0.00 255.000000000 FORMAT "%13.9" ECU_ADDRESS 0x60009FBC /end MEASUREMENT
/begin MEASUREMENT DSCHED_WhyVirtExcl.FId_EGRVlvCoord "exclusion reason regarding virtual scheduling / exclusion cause of scheduled function identifier regarding virtual scheduling FId_EGRVlvCoord" UWORD DSCHED_FIdExcCauseVerb 1 100 0.00 255.000000000 FORMAT "%13.9" ECU_ADDRESS 0x60009FBE /end MEASUREMENT
/begin MEASUREMENT DSCHED_WhyVirtExcl.FId_EGSDO2FuTrmB1 "exclusion reason regarding virtual scheduling / exclusion cause of scheduled function identifier regarding virtual scheduling FId_EGSDO2FuTrmB1" UWORD DSCHED_FIdExcCauseVerb 1 100 0.00 255.000000000 FORMAT "%13.9" ECU_ADDRESS 0x60009FC0 /end MEASUREMENT
/begin MEASUREMENT DSCHED_WhyVirtExcl.FId_EGSDO2SnsrMntdRelsS1B1 "exclusion reason regarding virtual scheduling / exclusion cause of scheduled function identifier regarding virtual scheduling FId_EGSDO2SnsrMntdRelsS1B1" UWORD DSCHED_FIdExcCauseVerb 1 100 0.00 255.000000000 FORMAT "%13.9" ECU_ADDRESS 0x60009FC2 /end MEASUREMENT
/begin MEASUREMENT DSCHED_WhyVirtExcl.FId_EGSDO2_LamOffsFastS1B1 "exclusion reason regarding virtual scheduling / exclusion cause of scheduled function identifier regarding virtual scheduling FId_EGSDO2_LamOffsFastS1B1" UWORD DSCHED_FIdExcCauseVerb 1 100 0.00 255.000000000 FORMAT "%13.9" ECU_ADDRESS 0x60009FC4 /end MEASUREMENT
/begin MEASUREMENT DSCHED_WhyVirtExcl.FId_MisfDetDnAdpnNv "exclusion reason regarding virtual scheduling / exclusion cause of scheduled function identifier regarding virtual scheduling FId_MisfDetDnAdpnNv" UWORD DSCHED_FIdExcCauseVerb 1 100 0.00 255.000000000 FORMAT "%13.9" ECU_ADDRESS 0x60009FC6 /end MEASUREMENT
/begin MEASUREMENT DSCHED_WhyVirtExcl.FId_bascadpncvo "exclusion reason regarding virtual scheduling / exclusion cause of scheduled function identifier regarding virtual scheduling FId_bascadpncvo" UWORD DSCHED_FIdExcCauseVerb 1 100 0.00 255.000000000 FORMAT "%13.9" ECU_ADDRESS 0x60009FC8 /end MEASUREMENT
/begin MEASUREMENT DSMAUX_ctObdDCy "Number of OBD driving cycle since diagnostic trouble codes cleared" UWORD OneToOne 1 100 0.00 65535.00 FORMAT "%8.2" ECU_ADDRESS 0x600388D6 /end MEASUREMENT
/begin MEASUREMENT DSMAUX_ctObdDCy_msg "Number of OBD driving cycle since diagnostic trouble codes cleared" UWORD OneToOne 1 100 0.00 65535.00 FORMAT "%8.2" ECU_ADDRESS 0x7000536E /end MEASUREMENT
/begin MEASUREMENT DSMAUX_ctWUC "Number of warm-ups since diagnostic trouble codes cleared" UBYTE OneToOne 1 100 0.00 255.0 FORMAT "%5.1" ECU_ADDRESS 0x60036DD3 /end MEASUREMENT
/begin MEASUREMENT DSMAUX_ctWUC_msg "Number of warm-ups since diagnostic trouble codes cleared" UBYTE OneToOne 1 100 0.00 255.0 FORMAT "%5.1" ECU_ADDRESS 0x7000548E /end MEASUREMENT
/begin MEASUREMENT DSMAUX_DTRG.DTRG_Time200ms "Trigger state / Trigger DTRG_Time200ms" UBYTE DFC_OneToOne 1 100 0.00 255.0 FORMAT "%5.1" ECU_ADDRESS 0x600385B4 /end MEASUREMENT
/begin MEASUREMENT DSMAUX_DTRG.DTRG_AlwaysTrue "Trigger state / Trigger DTRG_AlwaysTrue" UBYTE DFC_OneToOne 1 100 0.00 255.0 FORMAT "%5.1" ECU_ADDRESS 0x600385B5 /end MEASUREMENT
/begin MEASUREMENT DSMAUX_DTRG.DTRG_DrivingCycleFLC "Trigger state / Trigger DTRG_DrivingCycleFLC" UBYTE DFC_OneToOne 1 100 0.00 255.0 FORMAT "%5.1" ECU_ADDRESS 0x600385B6 /end MEASUREMENT
/begin MEASUREMENT DSMAUX_DTRG.DTRG_DrivingCycleHLC "Trigger state / Trigger DTRG_DrivingCycleHLC" UBYTE DFC_OneToOne 1 100 0.00 255.0 FORMAT "%5.1" ECU_ADDRESS 0x600385B7 /end MEASUREMENT
/begin MEASUREMENT DSMAUX_DTRG.DTRG_MDCatHLC "Trigger state / Trigger DTRG_MDCatHLC" UBYTE DFC_OneToOne 1 100 0.00 255.0 FORMAT "%5.1" ECU_ADDRESS 0x600385B8 /end MEASUREMENT
/begin MEASUREMENT DSMAUX_DTRG.DTRG_MDEmiHLC "Trigger state / Trigger DTRG_MDEmiHLC" UBYTE DFC_OneToOne 1 100 0.00 255.0 FORMAT "%5.1" ECU_ADDRESS 0x600385B9 /end MEASUREMENT
/begin MEASUREMENT DSMAUX_DTRG.DTRG_MDEmiStrtHLC "Trigger state / Trigger DTRG_MDEmiStrtHLC" UBYTE DFC_OneToOne 1 100 0.00 255.0 FORMAT "%5.1" ECU_ADDRESS 0x600385BA /end MEASUREMENT
/begin MEASUREMENT DSMAUX_DTRG.DTRG_MDFLC2 "Trigger state / Trigger DTRG_MDFLC2" UBYTE DFC_OneToOne 1 100 0.00 255.0 FORMAT "%5.1" ECU_ADDRESS 0x600385BB /end MEASUREMENT
/begin MEASUREMENT DSMAUX_DTRG.DTRG_MDHLC2 "Trigger state / Trigger DTRG_MDHLC2" UBYTE DFC_OneToOne 1 100 0.00 255.0 FORMAT "%5.1" ECU_ADDRESS 0x600385BC /end MEASUREMENT
/begin MEASUREMENT DSMAUX_DTRG.DTRG_NoTrigger "Trigger state / Trigger DTRG_NoTrigger" UBYTE DFC_OneToOne 1 100 0.00 255.0 FORMAT "%5.1" ECU_ADDRESS 0x600385BD /end MEASUREMENT
/begin MEASUREMENT DSMAUX_DTRG.DTRG_SimilarCondHLC "Trigger state / Trigger DTRG_SimilarCondHLC" UBYTE DFC_OneToOne 1 100 0.00 255.0 FORMAT "%5.1" ECU_ADDRESS 0x600385BE /end MEASUREMENT
/begin MEASUREMENT DSMAUX_DTRG.DTRG_WarmUpCycle "Trigger state / Trigger DTRG_WarmUpCycle" UBYTE DFC_OneToOne 1 100 0.00 255.0 FORMAT "%5.1" ECU_ADDRESS 0x600385BF /end MEASUREMENT
/begin MEASUREMENT DSMAUX_stClrTaskFin "End flag for OS_DSM_Clear_Task run" UBYTE OneToOne 1 100 0.00 255.0 FORMAT "%5.1" ECU_ADDRESS 0x60010A13 /end MEASUREMENT
/begin MEASUREMENT DSMAUX_stDCy "Status OBD driving cycle" UBYTE DSMAUX_stDCyVerb 1 100 0.00 3.00000000000 FORMAT "%13.11" ECU_ADDRESS 0x600388D4 /end MEASUREMENT
/begin MEASUREMENT DSMAUX_stDCy_msg "Status OBD driving cycle" UBYTE DSMAUX_stDCyVerb 1 100 0.00 3.00000000000 FORMAT "%13.11" ECU_ADDRESS 0x7000548F /end MEASUREMENT
/begin MEASUREMENT DSMAUX_stDsmClrActv "Indicator of a running DSM clear procedure" UBYTE B_TRUE 1 100 0.00 1.00000000000 BIT_MASK 0x1 FORMAT "%13.11" ECU_ADDRESS 0x60014AA1 /end MEASUREMENT
/begin MEASUREMENT DSMAUX_stObdDcycCmpl "Status of complete conditions for the OBD Driving Cycle reached." UBYTE B_TRUE 1 100 0.00 1.00000000000 BIT_MASK 0x1 FORMAT "%13.11" ECU_ADDRESS 0x6001012F /end MEASUREMENT
/begin MEASUREMENT DSMAUX_stStrtEnd "Condition normal engine operation was attained" UBYTE OneToOne 1 100 0.00 255.0 BIT_MASK 0x1 FORMAT "%5.1" ECU_ADDRESS 0x60010F48 /end MEASUREMENT
/begin MEASUREMENT DSMAUX_stTranGlbJob "Current transition job" UBYTE OneToOne 1 100 0.00 255.0 FORMAT "%5.1" ECU_ADDRESS 0x60010A14 /end MEASUREMENT
/begin MEASUREMENT DSMAUX_stTranReq "Queue of transition request" UBYTE OneToOne 1 100 0.00 255.0 FORMAT "%5.1" ARRAY_SIZE 3 ECU_ADDRESS 0x60034094 /end MEASUREMENT
/begin MEASUREMENT DSMAUX_stWrmUpCycCmpl "Status of complete conditions for the Warm Up Cycle reached." UBYTE B_TRUE 1 100 0.00 1.00000000000 BIT_MASK 0x1 FORMAT "%13.11" ECU_ADDRESS 0x6001012E /end MEASUREMENT
/begin MEASUREMENT DSMAUX_tClntStrt "coolant temperature at start" SWORD Temp_Cels 1 100 -3549.940 3003.560 FORMAT "%8.3" ECU_ADDRESS 0x6000A61E /end MEASUREMENT
/begin MEASUREMENT DSMConf_DFCSrv7VisClrSt "DFC and Service 7 Visibility infomation clear status" UBYTE OneToOne 1 100 0.00 255.0 FORMAT "%5.1" ECU_ADDRESS 0x6000FCB2 /end MEASUREMENT
/begin MEASUREMENT DSMDur_ctGlb "Global duration counters (32 bit values)" ULONG DFES_OneToOne 1 100 0.00 4294967295.00 FORMAT "%13.2" ARRAY_SIZE 1 ECU_ADDRESS 0x600385C4 /end MEASUREMENT
/begin MEASUREMENT DSMDur_ctPID21h "counter for distance travelled while MIL is activated" ULONG DSMDUR_10m_Counter 1 100 0.00 42949672.9500 FORMAT "%13.4" ECU_ADDRESS 0x60036DB8 /end MEASUREMENT
/begin MEASUREMENT DSMDur_ctPID31h "counter for distance since diagnostic trouble codes cleared" ULONG DSMDUR_10m_Counter 1 100 0.00 42949672.9500 FORMAT "%13.4" ECU_ADDRESS 0x60036DB4 /end MEASUREMENT
/begin MEASUREMENT DSMDur_lRef "distance when the next DSMDur increment will be counted" SLONG OneToOne 1 100 -2147483648.00 2147483647.00 FORMAT "%13.2" ECU_ADDRESS 0x60003C54 /end MEASUREMENT
/begin MEASUREMENT DSMDur_lRef10m "distance where next 10m increment will be counted" SLONG OneToOne 1 100 -2147483648.00 2147483647.00 FORMAT "%13.2" ECU_ADDRESS 0x50002820 /end MEASUREMENT
/begin MEASUREMENT DSMDur_stGlb "Global duration counter states" UBYTE DSMDur_StDispl_Verb 1 100 0.00 2.00000000000 FORMAT "%13.11" ARRAY_SIZE 1 ECU_ADDRESS 0x600385C1 /end MEASUREMENT
/begin MEASUREMENT DSMDur_stPID21h "state of the counter for distance travelled while MIL is activated" UBYTE DSMDur_StDispl_Verb 1 100 0.00 2.00000000000 FORMAT "%13.11" ECU_ADDRESS 0x600385C0 /end MEASUREMENT
/begin MEASUREMENT DSMDur_stWUCLst "warm up cycle reached" UBYTE OneToOne 1 100 0.00 255.0 FORMAT "%5.1" ECU_ADDRESS 0x60034097 /end MEASUREMENT
/begin MEASUREMENT DSMDur_tiMICumCont "Cumulative continuous MI counter which records the number of engine operation hours over its lifetime while a continuous-MI is activated." UWORD DSMDUR_MICntr_COMPU 1 100 0.00 65535.00 FORMAT "%8.2" ECU_ADDRESS 0x6003660C /end MEASUREMENT
/begin MEASUREMENT DSMDur_tiMICumContGlb "Variable to record the cumulative number of hours during which the engine has been operated over its life while a continuous- co is activated" UWORD DSMDUR_MICntr_COMPU 1 100 0.00 65535.00 FORMAT "%8.2" ECU_ADDRESS 0x6003660A /end MEASUREMENT
/begin MEASUREMENT DSMDur_tiMICumSubCont "Cumulative continuous MI sub-counter that leads to an incrementation of DSMDur_tiMICumCont after one hour has expired." UWORD DSMDUR_MISubCntr_COMPU 1 100 0.00 1.820417 FORMAT "%8.6" ECU_ADDRESS 0x60036608 /end MEASUREMENT
/begin MEASUREMENT DSMDur_tiMICumSubContGlb "Counter which are incremented every 100ms while a continuous-MI is activated" UWORD DSMDUR_MISubCntr_COMPU 1 100 0.00 1.820417 FORMAT "%8.6" ECU_ADDRESS 0x60036606 /end MEASUREMENT
/begin MEASUREMENT DSMDur_tiRef "time when next DSMDur increment will be counted" SLONG OneToOne 1 100 -2147483648.00 2147483647.00 FORMAT "%13.2" ECU_ADDRESS 0x50002824 /end MEASUREMENT
/begin MEASUREMENT DSMRdy_stGrpAct "Readiness calculation, cycle tested status" UWORD DSMRdy_OneToOne 1 100 0.00 65535.00 FORMAT "%8.2" ECU_ADDRESS 0x6003409A /end MEASUREMENT
/begin MEASUREMENT DSMRdy_stGrpLock "Readiness calculation, lock status" UWORD DSMRdy_OneToOne 1 100 0.00 65535.00 FORMAT "%8.2" ECU_ADDRESS 0x60034098 /end MEASUREMENT
/begin MEASUREMENT DSMRdy_stGrpRdy "Readiness calculation, ready status" UWORD DSMRdy_OneToOne 1 100 0.00 65535.00 FORMAT "%8.2" ECU_ADDRESS 0x600388DC /end MEASUREMENT
/begin MEASUREMENT DSMRdy_stGrpRdyDFES "Readiness calculation, ready status from DFES status" UWORD DSMRdy_OneToOne 1 100 0.00 65535.00 FORMAT "%8.2" ECU_ADDRESS 0x6000A00A /end MEASUREMENT
/begin MEASUREMENT DSMRdy_stGrpRdyScan "Readiness calculation, ready status from check scanning" UWORD DSMRdy_OneToOne 1 100 0.00 65535.00 FORMAT "%8.2" ECU_ADDRESS 0x6000A00C /end MEASUREMENT
/begin MEASUREMENT DSMRdy_stGrpSup "Readiness calculation, supported status" UWORD DSMRdy_OneToOne 1 100 0.00 65535.00 FORMAT "%8.2" ECU_ADDRESS 0x6000A008 /end MEASUREMENT
/begin MEASUREMENT DSMRdy_xPId1 "Readiness calculation, result for PID01" ULONG DSMRdy_OneToOne 1 100 0.00 4294967295.00 FORMAT "%13.2" ECU_ADDRESS 0x60002FB4 /end MEASUREMENT
/begin MEASUREMENT DSMRdy_xPId41 "Readiness calculation, result for PID41" ULONG DSMRdy_OneToOne 1 100 0.00 4294967295.00 FORMAT "%13.2" ECU_ADDRESS 0x50001428 /end MEASUREMENT
/begin MEASUREMENT DSM_bFuncTstActv "swift test ready; increased priority for DSM-gdi mode" UBYTE OneToOne 1 100 0.00 255.0 BIT_MASK 0x1 FORMAT "%5.1" ECU_ADDRESS 0x600100FB /end MEASUREMENT
/begin MEASUREMENT DSM_bInstableStatus "DSM internal variable to store the copy of the unstable operation mode (provided by DSM configuration)" UBYTE OneToOne 1 100 0.00 255.0 BIT_MASK 0x1 FORMAT "%5.1" ECU_ADDRESS 0x60010A0C /end MEASUREMENT
/begin MEASUREMENT DSM_bStFuncTst "DSM internal variable to store the copy of the function test requested (provided by DSM configuration)" UBYTE OneToOne 1 100 0.00 255.0 FORMAT "%5.1" ECU_ADDRESS 0x60014A64 /end MEASUREMENT
/begin MEASUREMENT DSM_CoEngtiNormalOBD "DSM internal variable to store the copy of the Engine running time - for OBD requirement" ULONG OneToOne 1 100 0.00 4294967295.00 FORMAT "%13.2" ECU_ADDRESS 0x60003C50 /end MEASUREMENT
/begin MEASUREMENT DSM_DFCSrv7VisClrReq "DFC and Service 7 Visibility infomation clear request" UWORD OneToOne 1 100 0.00 65535.00 FORMAT "%8.2" ECU_ADDRESS 0x600094FA /end MEASUREMENT
/begin MEASUREMENT DSM_DINHSrv7VisClrReq "DINH and Service 7 Infomation clear request" UBYTE OneToOne 1 100 0.00 255.0 FORMAT "%5.1" ECU_ADDRESS 0x6000FCB1 /end MEASUREMENT
/begin MEASUREMENT DSM_DisblMode_mp "Actual disable mode to prevent error memory entries (provided by DSM configuration)" UWORD OneToOne 1 100 0.00 65535.00 FORMAT "%8.2" ECU_ADDRESS 0x70009D60 /end MEASUREMENT
/begin MEASUREMENT DSM_ECUId "DSM internal variable to store the copy of the ECU identifier (e.g. masterslave systems), provided by DSM configuration" UBYTE OneToOne 1 100 0.00 255.0 FORMAT "%5.1" ECU_ADDRESS 0x60014A63 /end MEASUREMENT
/begin MEASUREMENT DSM_lDst "DSM internal variable to store the copy of the driven distance (provided by DSM configuration)" SLONG OneToOne 1 100 -2147483648.00 2147483647.00 FORMAT "%13.2" ECU_ADDRESS 0x5000280C /end MEASUREMENT
/begin MEASUREMENT DSM_PDTCDisbl_mp "Disable state of permanent DTC storage, as long as the value is not zero no permanent DTC will be stored." UBYTE OneToOne 1 100 0.00 255.0 FORMAT "%5.1" ECU_ADDRESS 0x70009FC0 /end MEASUREMENT
/begin MEASUREMENT DSM_pEnv "DSM internal variable to store the copy of the Environment pressure" SWORD Pres_hPa 1 100 -32768.00 32767.00 FORMAT "%8.2" ECU_ADDRESS 0x6001469E /end MEASUREMENT
/begin MEASUREMENT DSM_rAPP "DSM internal variable to store the copy of the Standardized accelerator pedal position" SWORD Prc 1 100 -400.0000 399.9878 FORMAT "%8.4" ECU_ADDRESS 0x600146A0 /end MEASUREMENT
/begin MEASUREMENT DSM_stCoOpMode "DSM internal variable to store the copy of the operation mode (provided by DSM configuration)" UWORD OneToOne 1 100 0.00 65535.00 FORMAT "%8.2" ECU_ADDRESS 0x6000A004 /end MEASUREMENT
/begin MEASUREMENT DSM_stCoPrmsOpMode "DSM internal variable to store the copy of the permissible operation modes (provided by DSM configuration)" UWORD OneToOne 1 100 0.00 65535.00 FORMAT "%8.2" ECU_ADDRESS 0x600146A2 /end MEASUREMENT
/begin MEASUREMENT DSM_stMaiEngRunng "Main engine running status" UBYTE OneToOne 1 100 0.00 255.0 BIT_MASK 0x1 FORMAT "%5.1" ECU_ADDRESS 0x60010A0D /end MEASUREMENT
/begin MEASUREMENT DSM_stOpMDes "GDI desired mode of diagnostic manager" UWORD OneToOne 1 100 0.00 65535.00 FORMAT "%8.2" ECU_ADDRESS 0x60009E18 /end MEASUREMENT
/begin MEASUREMENT DSM_stPostDrive "Status of DSM postdrive control" UBYTE OneToOne 1 100 0.00 255.0 FORMAT "%5.1" ECU_ADDRESS 0x60010A12 /end MEASUREMENT
/begin MEASUREMENT DSM_stReInit "Status of reinitialization in DSM after cancelled postdrive" UBYTE OneToOne 1 100 0.00 255.0 FORMAT "%5.1" ECU_ADDRESS 0x60010F4C /end MEASUREMENT
/begin MEASUREMENT DSM_stStrEnd "OBD Ready for Driving status" UBYTE OneToOne 1 100 0.00 255.0 BIT_MASK 0x1 FORMAT "%5.1" ECU_ADDRESS 0x60014A65 /end MEASUREMENT
/begin MEASUREMENT DSM_stWiggle_mp "wiggle test requested by ext. tester (provided by DSM configuration)" UBYTE OneToOne 1 100 0.00 255.0 FORMAT "%5.1" ECU_ADDRESS 0x70009FBF /end MEASUREMENT
/begin MEASUREMENT DSM_tEngDS "DSM internal variable to store the copy of the Coolant temperature at engine output" SWORD Temp_Cels 1 100 -3549.940 3003.560 FORMAT "%8.3" ECU_ADDRESS 0x6000A002 /end MEASUREMENT
/begin MEASUREMENT DSM_tEnv "DSM internal variable to store the copy of the Temperature of environment air" SWORD Temp_Cels 1 100 -3549.940 3003.560 FORMAT "%8.3" ECU_ADDRESS 0x600146A4 /end MEASUREMENT
/begin MEASUREMENT DSM_TripChgAndClrFinshd "Message to indicate completion of clear triggered by DSM after initialization" UBYTE OneToOne 1 100 0.00 255.0 BIT_MASK 0x1 FORMAT "%5.1" ECU_ADDRESS 0x6001019A /end MEASUREMENT
/begin MEASUREMENT DSM_TripChgFinshd "" UBYTE OneToOne 1 100 0.00 255.0 BIT_MASK 0x1 FORMAT "%5.1" ECU_ADDRESS 0x50006073 /end MEASUREMENT
/begin MEASUREMENT DSM_vVeh "DSM internal variable to store the copy of the Vehicle speed" SWORD Vel 1 100 -327.6800 327.6700 FORMAT "%8.4" ECU_ADDRESS 0x600146A6 /end MEASUREMENT
/begin FUNCTION DSCHED_Eval "30000.13.0Diagnostic Scheduler Evaluation"
 /begin DEF_CHARACTERISTIC DSCHED_Excl.AFRA_AORA_C DSCHED_Excl.AFRA_ATEH_C DSCHED_Excl.AFRA_ATEL_C DSCHED_Excl.AFRA_ATEN_C DSCHED_Excl.AFRA_ATLDI_C DSCHED_Excl.AFRA_ATLDO_C DSCHED_Excl.AFRA_BEONV_C DSCHED_Excl.AFRA_EGSDCmnSeg1B1Parl_C DSCHED_Excl.AFRA_BAGRA_C DSCHED_Excl.AFRA_BAGRASD_C DSCHED_Excl.AFRA_BDSTOF_C DSCHED_Excl.AFRA_BFVDFRM_C DSCHED_Excl.AFRA_BHOM_C DSCHED_Excl.AFRA_BLLRH_C DSCHED_Excl.AFRA_BLLRKH_C DSCHED_Excl.AFRA_BPLSU_C DSCHED_Excl.AFRA_FRAMBAVMB_C DSCHED_Excl.AFRA_CatHeatgColdStrtReq_C DSCHED_Excl.AFRA_CatHeatgWrmReq_C DSCHED_Excl.AFRA_DSMBDEPHSpOpMode_C DSCHED_Excl.AFRA_EGRVlvCoord_C DSCHED_Excl.AFRA_EGSDO2FuTrmB1_C DSCHED_Excl.AFRA_EGSDO2SnsrMntdRelsS1B1_C DSCHED_Excl.AFRA_EGSDO2_LamOffsFastS1B1_C DSCHED_Excl.AFRA_MisfDetDnAdpnNv_C DSCHED_Excl.AFRA_bascadpncvo_C DSCHED_Excl.AORA_ATEH_C DSCHED_Excl.AORA_ATEL_C DSCHED_Excl.AORA_ATEN_C DSCHED_Excl.AORA_ATLDI_C DSCHED_Excl.AORA_ATLDO_C DSCHED_Excl.AORA_BEONV_C DSCHED_Excl.AORA_EGSDCmnSeg1B1Parl_C DSCHED_Excl.AORA_BAGRA_C DSCHED_Excl.AORA_BAGRASD_C DSCHED_Excl.AORA_BDSTOF_C DSCHED_Excl.AORA_BFVDFRM_C DSCHED_Excl.AORA_BHOM_C DSCHED_Excl.AORA_BLLRH_C DSCHED_Excl.AORA_BLLRKH_C DSCHED_Excl.AORA_BPLSU_C DSCHED_Excl.AORA_FRAMBAVMB_C DSCHED_Excl.AORA_CatHeatgColdStrtReq_C DSCHED_Excl.AORA_CatHeatgWrmReq_C DSCHED_Excl.AORA_DSMBDEPHSpOpMode_C DSCHED_Excl.AORA_EGRVlvCoord_C DSCHED_Excl.AORA_EGSDO2FuTrmB1_C DSCHED_Excl.AORA_EGSDO2SnsrMntdRelsS1B1_C DSCHED_Excl.AORA_EGSDO2_LamOffsFastS1B1_C DSCHED_Excl.AORA_MisfDetDnAdpnNv_C DSCHED_Excl.AORA_bascadpncvo_C DSCHED_Excl.ATEH_ATEL_C DSCHED_Excl.ATEH_ATEN_C DSCHED_Excl.ATEH_ATLDI_C DSCHED_Excl.ATEH_ATLDO_C DSCHED_Excl.ATEH_BEONV_C DSCHED_Excl.ATEH_EGSDCmnSeg1B1Parl_C DSCHED_Excl.ATEH_BAGRA_C DSCHED_Excl.ATEH_BAGRASD_C DSCHED_Excl.ATEH_BDSTOF_C DSCHED_Excl.ATEH_BFVDFRM_C DSCHED_Excl.ATEH_BHOM_C DSCHED_Excl.ATEH_BLLRH_C DSCHED_Excl.ATEH_BLLRKH_C DSCHED_Excl.ATEH_BPLSU_C DSCHED_Excl.ATEH_FRAMBAVMB_C DSCHED_Excl.ATEH_CatHeatgColdStrtReq_C DSCHED_Excl.ATEH_CatHeatgWrmReq_C DSCHED_Excl.ATEH_DSMBDEPHSpOpMode_C DSCHED_Excl.ATEH_EGRVlvCoord_C DSCHED_Excl.ATEH_EGSDO2FuTrmB1_C DSCHED_Excl.ATEH_EGSDO2SnsrMntdRelsS1B1_C DSCHED_Excl.ATEH_EGSDO2_LamOffsFastS1B1_C DSCHED_Excl.ATEH_MisfDetDnAdpnNv_C DSCHED_Excl.ATEH_bascadpncvo_C DSCHED_Excl.ATEL_ATEN_C DSCHED_Excl.ATEL_ATLDI_C DSCHED_Excl.ATEL_ATLDO_C DSCHED_Excl.ATEL_BEONV_C DSCHED_Excl.ATEL_EGSDCmnSeg1B1Parl_C DSCHED_Excl.ATEL_BAGRA_C DSCHED_Excl.ATEL_BAGRASD_C DSCHED_Excl.ATEL_BDSTOF_C DSCHED_Excl.ATEL_BFVDFRM_C DSCHED_Excl.ATEL_BHOM_C DSCHED_Excl.ATEL_BLLRH_C DSCHED_Excl.ATEL_BLLRKH_C DSCHED_Excl.ATEL_BPLSU_C DSCHED_Excl.ATEL_FRAMBAVMB_C DSCHED_Excl.ATEL_CatHeatgColdStrtReq_C DSCHED_Excl.ATEL_CatHeatgWrmReq_C DSCHED_Excl.ATEL_DSMBDEPHSpOpMode_C DSCHED_Excl.ATEL_EGRVlvCoord_C DSCHED_Excl.ATEL_EGSDO2FuTrmB1_C DSCHED_Excl.ATEL_EGSDO2SnsrMntdRelsS1B1_C DSCHED_Excl.ATEL_EGSDO2_LamOffsFastS1B1_C DSCHED_Excl.ATEL_MisfDetDnAdpnNv_C DSCHED_Excl.ATEL_bascadpncvo_C DSCHED_Excl.ATEN_ATLDI_C DSCHED_Excl.ATEN_ATLDO_C DSCHED_Excl.ATEN_BEONV_C DSCHED_Excl.ATEN_EGSDCmnSeg1B1Parl_C DSCHED_Excl.ATEN_BAGRA_C DSCHED_Excl.ATEN_BAGRASD_C DSCHED_Excl.ATEN_BDSTOF_C DSCHED_Excl.ATEN_BFVDFRM_C DSCHED_Excl.ATEN_BHOM_C DSCHED_Excl.ATEN_BLLRH_C DSCHED_Excl.ATEN_BLLRKH_C DSCHED_Excl.ATEN_BPLSU_C DSCHED_Excl.ATEN_FRAMBAVMB_C DSCHED_Excl.ATEN_CatHeatgColdStrtReq_C DSCHED_Excl.ATEN_CatHeatgWrmReq_C DSCHED_Excl.ATEN_DSMBDEPHSpOpMode_C DSCHED_Excl.ATEN_EGRVlvCoord_C DSCHED_Excl.ATEN_EGSDO2FuTrmB1_C DSCHED_Excl.ATEN_EGSDO2SnsrMntdRelsS1B1_C DSCHED_Excl.ATEN_EGSDO2_LamOffsFastS1B1_C DSCHED_Excl.ATEN_MisfDetDnAdpnNv_C DSCHED_Excl.ATEN_bascadpncvo_C DSCHED_Excl.ATLDI_ATLDO_C DSCHED_Excl.ATLDI_BEONV_C DSCHED_Excl.ATLDI_EGSDCmnSeg1B1Parl_C DSCHED_Excl.ATLDI_BAGRA_C DSCHED_Excl.ATLDI_BAGRASD_C DSCHED_Excl.ATLDI_BDSTOF_C DSCHED_Excl.ATLDI_BFVDFRM_C DSCHED_Excl.ATLDI_BHOM_C DSCHED_Excl.ATLDI_BLLRH_C DSCHED_Excl.ATLDI_BLLRKH_C DSCHED_Excl.ATLDI_BPLSU_C DSCHED_Excl.ATLDI_FRAMBAVMB_C DSCHED_Excl.ATLDI_CatHeatgColdStrtReq_C DSCHED_Excl.ATLDI_CatHeatgWrmReq_C DSCHED_Excl.ATLDI_DSMBDEPHSpOpMode_C DSCHED_Excl.ATLDI_EGRVlvCoord_C DSCHED_Excl.ATLDI_EGSDO2FuTrmB1_C DSCHED_Excl.ATLDI_EGSDO2SnsrMntdRelsS1B1_C DSCHED_Excl.ATLDI_EGSDO2_LamOffsFastS1B1_C DSCHED_Excl.ATLDI_MisfDetDnAdpnNv_C DSCHED_Excl.ATLDI_bascadpncvo_C DSCHED_Excl.ATLDO_BEONV_C DSCHED_Excl.ATLDO_EGSDCmnSeg1B1Parl_C DSCHED_Excl.ATLDO_BAGRA_C DSCHED_Excl.ATLDO_BAGRASD_C DSCHED_Excl.ATLDO_BDSTOF_C DSCHED_Excl.ATLDO_BFVDFRM_C DSCHED_Excl.ATLDO_BHOM_C DSCHED_Excl.ATLDO_BLLRH_C DSCHED_Excl.ATLDO_BLLRKH_C DSCHED_Excl.ATLDO_BPLSU_C DSCHED_Excl.ATLDO_FRAMBAVMB_C DSCHED_Excl.ATLDO_CatHeatgColdStrtReq_C DSCHED_Excl.ATLDO_CatHeatgWrmReq_C DSCHED_Excl.ATLDO_DSMBDEPHSpOpMode_C DSCHED_Excl.ATLDO_EGRVlvCoord_C DSCHED_Excl.ATLDO_EGSDO2FuTrmB1_C DSCHED_Excl.ATLDO_EGSDO2SnsrMntdRelsS1B1_C DSCHED_Excl.ATLDO_EGSDO2_LamOffsFastS1B1_C DSCHED_Excl.ATLDO_MisfDetDnAdpnNv_C DSCHED_Excl.ATLDO_bascadpncvo_C DSCHED_Excl.BEONV_EGSDCmnSeg1B1Parl_C DSCHED_Excl.BEONV_BAGRA_C DSCHED_Excl.BEONV_BAGRASD_C DSCHED_Excl.BEONV_BDSTOF_C DSCHED_Excl.BEONV_BFVDFRM_C DSCHED_Excl.BEONV_BHOM_C DSCHED_Excl.BEONV_BLLRH_C DSCHED_Excl.BEONV_BLLRKH_C DSCHED_Excl.BEONV_BPLSU_C DSCHED_Excl.BEONV_FRAMBAVMB_C DSCHED_Excl.BEONV_CatHeatgColdStrtReq_C DSCHED_Excl.BEONV_CatHeatgWrmReq_C DSCHED_Excl.BEONV_DSMBDEPHSpOpMode_C DSCHED_Excl.BEONV_EGRVlvCoord_C DSCHED_Excl.BEONV_EGSDO2FuTrmB1_C DSCHED_Excl.BEONV_EGSDO2SnsrMntdRelsS1B1_C DSCHED_Excl.BEONV_EGSDO2_LamOffsFastS1B1_C DSCHED_Excl.BEONV_MisfDetDnAdpnNv_C DSCHED_Excl.BEONV_bascadpncvo_C DSCHED_Excl.EGSDCmnSeg1B1Parl_BAGRA_C DSCHED_Excl.EGSDCmnSeg1B1Parl_BAGRASD_C DSCHED_Excl.EGSDCmnSeg1B1Parl_BDSTOF_C DSCHED_Excl.EGSDCmnSeg1B1Parl_BFVDFRM_C DSCHED_Excl.EGSDCmnSeg1B1Parl_BHOM_C DSCHED_Excl.EGSDCmnSeg1B1Parl_BLLRH_C DSCHED_Excl.EGSDCmnSeg1B1Parl_BLLRKH_C DSCHED_Excl.EGSDCmnSeg1B1Parl_BPLSU_C DSCHED_Excl.EGSDCmnSeg1B1Parl_FRAMBAVMB_C DSCHED_Excl.EGSDCmnSeg1B1Parl_CatHeatgColdStrtReq_C DSCHED_Excl.EGSDCmnSeg1B1Parl_CatHeatgWrmReq_C DSCHED_Excl.EGSDCmnSeg1B1Parl_DSMBDEPHSpOpMode_C DSCHED_Excl.EGSDCmnSeg1B1Parl_EGRVlvCoord_C DSCHED_Excl.EGSDCmnSeg1B1Parl_EGSDO2FuTrmB1_C DSCHED_Excl.EGSDCmnSeg1B1Parl_EGSDO2SnsrMntdRelsS1B1_C DSCHED_Excl.EGSDCmnSeg1B1Parl_EGSDO2_LamOffsFastS1B1_C DSCHED_Excl.EGSDCmnSeg1B1Parl_MisfDetDnAdpnNv_C DSCHED_Excl.EGSDCmnSeg1B1Parl_bascadpncvo_C DSCHED_Excl.BAGRA_BAGRASD_C DSCHED_Excl.BAGRA_BDSTOF_C DSCHED_Excl.BAGRA_BFVDFRM_C DSCHED_Excl.BAGRA_BHOM_C DSCHED_Excl.BAGRA_BLLRH_C DSCHED_Excl.BAGRA_BLLRKH_C DSCHED_Excl.BAGRA_BPLSU_C DSCHED_Excl.BAGRA_FRAMBAVMB_C DSCHED_Excl.BAGRA_CatHeatgColdStrtReq_C DSCHED_Excl.BAGRA_CatHeatgWrmReq_C DSCHED_Excl.BAGRA_DSMBDEPHSpOpMode_C DSCHED_Excl.BAGRA_EGRVlvCoord_C DSCHED_Excl.BAGRA_EGSDO2FuTrmB1_C DSCHED_Excl.BAGRA_EGSDO2SnsrMntdRelsS1B1_C DSCHED_Excl.BAGRA_EGSDO2_LamOffsFastS1B1_C DSCHED_Excl.BAGRA_MisfDetDnAdpnNv_C DSCHED_Excl.BAGRA_bascadpncvo_C DSCHED_Excl.BAGRASD_BDSTOF_C DSCHED_Excl.BAGRASD_BFVDFRM_C DSCHED_Excl.BAGRASD_BHOM_C DSCHED_Excl.BAGRASD_BLLRH_C DSCHED_Excl.BAGRASD_BLLRKH_C DSCHED_Excl.BAGRASD_BPLSU_C DSCHED_Excl.BAGRASD_FRAMBAVMB_C DSCHED_Excl.BAGRASD_CatHeatgColdStrtReq_C DSCHED_Excl.BAGRASD_CatHeatgWrmReq_C DSCHED_Excl.BAGRASD_DSMBDEPHSpOpMode_C DSCHED_Excl.BAGRASD_EGRVlvCoord_C DSCHED_Excl.BAGRASD_EGSDO2FuTrmB1_C DSCHED_Excl.BAGRASD_EGSDO2SnsrMntdRelsS1B1_C DSCHED_Excl.BAGRASD_EGSDO2_LamOffsFastS1B1_C DSCHED_Excl.BAGRASD_MisfDetDnAdpnNv_C DSCHED_Excl.BAGRASD_bascadpncvo_C DSCHED_Excl.BDSTOF_BFVDFRM_C DSCHED_Excl.BDSTOF_BHOM_C DSCHED_Excl.BDSTOF_BLLRH_C DSCHED_Excl.BDSTOF_BLLRKH_C DSCHED_Excl.BDSTOF_BPLSU_C DSCHED_Excl.BDSTOF_FRAMBAVMB_C DSCHED_Excl.BDSTOF_CatHeatgColdStrtReq_C DSCHED_Excl.BDSTOF_CatHeatgWrmReq_C DSCHED_Excl.BDSTOF_DSMBDEPHSpOpMode_C DSCHED_Excl.BDSTOF_EGRVlvCoord_C DSCHED_Excl.BDSTOF_EGSDO2FuTrmB1_C DSCHED_Excl.BDSTOF_EGSDO2SnsrMntdRelsS1B1_C DSCHED_Excl.BDSTOF_EGSDO2_LamOffsFastS1B1_C DSCHED_Excl.BDSTOF_MisfDetDnAdpnNv_C DSCHED_Excl.BDSTOF_bascadpncvo_C DSCHED_Excl.BFVDFRM_BHOM_C DSCHED_Excl.BFVDFRM_BLLRH_C DSCHED_Excl.BFVDFRM_BLLRKH_C DSCHED_Excl.BFVDFRM_BPLSU_C DSCHED_Excl.BFVDFRM_FRAMBAVMB_C DSCHED_Excl.BFVDFRM_CatHeatgColdStrtReq_C DSCHED_Excl.BFVDFRM_CatHeatgWrmReq_C DSCHED_Excl.BFVDFRM_DSMBDEPHSpOpMode_C DSCHED_Excl.BFVDFRM_EGRVlvCoord_C DSCHED_Excl.BFVDFRM_EGSDO2FuTrmB1_C DSCHED_Excl.BFVDFRM_EGSDO2SnsrMntdRelsS1B1_C DSCHED_Excl.BFVDFRM_EGSDO2_LamOffsFastS1B1_C DSCHED_Excl.BFVDFRM_MisfDetDnAdpnNv_C DSCHED_Excl.BFVDFRM_bascadpncvo_C DSCHED_Excl.BHOM_BLLRH_C DSCHED_Excl.BHOM_BLLRKH_C DSCHED_Excl.BHOM_BPLSU_C DSCHED_Excl.BHOM_FRAMBAVMB_C DSCHED_Excl.BHOM_CatHeatgColdStrtReq_C DSCHED_Excl.BHOM_CatHeatgWrmReq_C DSCHED_Excl.BHOM_DSMBDEPHSpOpMode_C DSCHED_Excl.BHOM_EGRVlvCoord_C DSCHED_Excl.BHOM_EGSDO2FuTrmB1_C DSCHED_Excl.BHOM_EGSDO2SnsrMntdRelsS1B1_C DSCHED_Excl.BHOM_EGSDO2_LamOffsFastS1B1_C DSCHED_Excl.BHOM_MisfDetDnAdpnNv_C DSCHED_Excl.BHOM_bascadpncvo_C DSCHED_Excl.BLLRH_BLLRKH_C DSCHED_Excl.BLLRH_BPLSU_C DSCHED_Excl.BLLRH_FRAMBAVMB_C DSCHED_Excl.BLLRH_CatHeatgColdStrtReq_C DSCHED_Excl.BLLRH_CatHeatgWrmReq_C DSCHED_Excl.BLLRH_DSMBDEPHSpOpMode_C DSCHED_Excl.BLLRH_EGRVlvCoord_C DSCHED_Excl.BLLRH_EGSDO2FuTrmB1_C DSCHED_Excl.BLLRH_EGSDO2SnsrMntdRelsS1B1_C DSCHED_Excl.BLLRH_EGSDO2_LamOffsFastS1B1_C DSCHED_Excl.BLLRH_MisfDetDnAdpnNv_C DSCHED_Excl.BLLRH_bascadpncvo_C DSCHED_Excl.BLLRKH_BPLSU_C DSCHED_Excl.BLLRKH_FRAMBAVMB_C DSCHED_Excl.BLLRKH_CatHeatgColdStrtReq_C DSCHED_Excl.BLLRKH_CatHeatgWrmReq_C DSCHED_Excl.BLLRKH_DSMBDEPHSpOpMode_C DSCHED_Excl.BLLRKH_EGRVlvCoord_C DSCHED_Excl.BLLRKH_EGSDO2FuTrmB1_C DSCHED_Excl.BLLRKH_EGSDO2SnsrMntdRelsS1B1_C DSCHED_Excl.BLLRKH_EGSDO2_LamOffsFastS1B1_C DSCHED_Excl.BLLRKH_MisfDetDnAdpnNv_C DSCHED_Excl.BLLRKH_bascadpncvo_C DSCHED_Excl.BPLSU_FRAMBAVMB_C DSCHED_Excl.BPLSU_CatHeatgColdStrtReq_C DSCHED_Excl.BPLSU_CatHeatgWrmReq_C DSCHED_Excl.BPLSU_DSMBDEPHSpOpMode_C DSCHED_Excl.BPLSU_EGRVlvCoord_C DSCHED_Excl.BPLSU_EGSDO2FuTrmB1_C DSCHED_Excl.BPLSU_EGSDO2SnsrMntdRelsS1B1_C DSCHED_Excl.BPLSU_EGSDO2_LamOffsFastS1B1_C DSCHED_Excl.BPLSU_MisfDetDnAdpnNv_C DSCHED_Excl.BPLSU_bascadpncvo_C DSCHED_Excl.FRAMBAVMB_CatHeatgColdStrtReq_C DSCHED_Excl.FRAMBAVMB_CatHeatgWrmReq_C DSCHED_Excl.FRAMBAVMB_DSMBDEPHSpOpMode_C DSCHED_Excl.FRAMBAVMB_EGRVlvCoord_C DSCHED_Excl.FRAMBAVMB_EGSDO2FuTrmB1_C DSCHED_Excl.FRAMBAVMB_EGSDO2SnsrMntdRelsS1B1_C DSCHED_Excl.FRAMBAVMB_EGSDO2_LamOffsFastS1B1_C DSCHED_Excl.FRAMBAVMB_MisfDetDnAdpnNv_C DSCHED_Excl.FRAMBAVMB_bascadpncvo_C DSCHED_Excl.CatHeatgColdStrtReq_CatHeatgWrmReq_C DSCHED_Excl.CatHeatgColdStrtReq_DSMBDEPHSpOpMode_C DSCHED_Excl.CatHeatgColdStrtReq_EGRVlvCoord_C DSCHED_Excl.CatHeatgColdStrtReq_EGSDO2FuTrmB1_C DSCHED_Excl.CatHeatgColdStrtReq_EGSDO2SnsrMntdRelsS1B1_C DSCHED_Excl.CatHeatgColdStrtReq_EGSDO2_LamOffsFastS1B1_C DSCHED_Excl.CatHeatgColdStrtReq_MisfDetDnAdpnNv_C DSCHED_Excl.CatHeatgColdStrtReq_bascadpncvo_C DSCHED_Excl.CatHeatgWrmReq_DSMBDEPHSpOpMode_C DSCHED_Excl.CatHeatgWrmReq_EGRVlvCoord_C DSCHED_Excl.CatHeatgWrmReq_EGSDO2FuTrmB1_C DSCHED_Excl.CatHeatgWrmReq_EGSDO2SnsrMntdRelsS1B1_C DSCHED_Excl.CatHeatgWrmReq_EGSDO2_LamOffsFastS1B1_C DSCHED_Excl.CatHeatgWrmReq_MisfDetDnAdpnNv_C DSCHED_Excl.CatHeatgWrmReq_bascadpncvo_C DSCHED_Excl.DSMBDEPHSpOpMode_EGRVlvCoord_C DSCHED_Excl.DSMBDEPHSpOpMode_EGSDO2FuTrmB1_C DSCHED_Excl.DSMBDEPHSpOpMode_EGSDO2SnsrMntdRelsS1B1_C DSCHED_Excl.DSMBDEPHSpOpMode_EGSDO2_LamOffsFastS1B1_C DSCHED_Excl.DSMBDEPHSpOpMode_MisfDetDnAdpnNv_C DSCHED_Excl.DSMBDEPHSpOpMode_bascadpncvo_C DSCHED_Excl.EGRVlvCoord_EGSDO2FuTrmB1_C DSCHED_Excl.EGRVlvCoord_EGSDO2SnsrMntdRelsS1B1_C DSCHED_Excl.EGRVlvCoord_EGSDO2_LamOffsFastS1B1_C DSCHED_Excl.EGRVlvCoord_MisfDetDnAdpnNv_C DSCHED_Excl.EGRVlvCoord_bascadpncvo_C DSCHED_Excl.EGSDO2FuTrmB1_EGSDO2SnsrMntdRelsS1B1_C DSCHED_Excl.EGSDO2FuTrmB1_EGSDO2_LamOffsFastS1B1_C DSCHED_Excl.EGSDO2FuTrmB1_MisfDetDnAdpnNv_C DSCHED_Excl.EGSDO2FuTrmB1_bascadpncvo_C DSCHED_Excl.EGSDO2SnsrMntdRelsS1B1_EGSDO2_LamOffsFastS1B1_C DSCHED_Excl.EGSDO2SnsrMntdRelsS1B1_MisfDetDnAdpnNv_C DSCHED_Excl.EGSDO2SnsrMntdRelsS1B1_bascadpncvo_C DSCHED_Excl.EGSDO2_LamOffsFastS1B1_MisfDetDnAdpnNv_C DSCHED_Excl.EGSDO2_LamOffsFastS1B1_bascadpncvo_C DSCHED_Excl.MisfDetDnAdpnNv_bascadpncvo_C DSCHED_OpModeMsk.FID_AFRA_C DSCHED_OpModeMsk.FID_AORA_C DSCHED_OpModeMsk.FID_ATEH_C DSCHED_OpModeMsk.FID_ATEL_C DSCHED_OpModeMsk.FID_ATEN_C DSCHED_OpModeMsk.FID_ATLDI_C DSCHED_OpModeMsk.FID_ATLDO_C DSCHED_OpModeMsk.FID_BEONV_C DSCHED_OpModeMsk.FId_EGSDCmnSeg1B1Parl_C DSCHED_OpModeMsk.FID_BAGRA_C DSCHED_OpModeMsk.FID_BAGRASD_C DSCHED_OpModeMsk.FID_BDSTOF_C DSCHED_OpModeMsk.FID_BFVDFRM_C DSCHED_OpModeMsk.FID_BHOM_C DSCHED_OpModeMsk.FID_BLLRH_C DSCHED_OpModeMsk.FID_BLLRKH_C DSCHED_OpModeMsk.FID_BPLSU_C DSCHED_OpModeMsk.FID_FRAMBAVMB_C DSCHED_OpModeMsk.FId_CatHeatgColdStrtReq_C DSCHED_OpModeMsk.FId_CatHeatgWrmReq_C DSCHED_OpModeMsk.FId_DSMBDEPHSpOpMode_C DSCHED_OpModeMsk.FId_EGRVlvCoord_C DSCHED_OpModeMsk.FId_EGSDO2FuTrmB1_C DSCHED_OpModeMsk.FId_EGSDO2SnsrMntdRelsS1B1_C DSCHED_OpModeMsk.FId_EGSDO2_LamOffsFastS1B1_C DSCHED_OpModeMsk.FId_MisfDetDnAdpnNv_C DSCHED_OpModeMsk.FId_bascadpncvo_C DSCHED_stMode_C DSCHED_StSimnSeln_C DSCHED_valDflOpMode_C /end DEF_CHARACTERISTIC
 /begin OUT_MEASUREMENT DSCHED_St.FId_Unused DSCHED_St.FID_AFRA DSCHED_St.FID_AORA DSCHED_St.FID_ATEH DSCHED_St.FID_ATEL DSCHED_St.FID_ATEN DSCHED_St.FID_ATLDI DSCHED_St.FID_ATLDO DSCHED_St.FID_BEONV DSCHED_St.FId_EGSDCmnSeg1B1Parl DSCHED_St.FID_BAGRA DSCHED_St.FID_BAGRASD DSCHED_St.FID_BDSTOF DSCHED_St.FID_BFVDFRM DSCHED_St.FID_BHOM DSCHED_St.FID_BLLRH DSCHED_St.FID_BLLRKH DSCHED_St.FID_BPLSU DSCHED_St.FID_FRAMBAVMB DSCHED_St.FId_CatHeatgColdStrtReq DSCHED_St.FId_CatHeatgWrmReq DSCHED_St.FId_DSMBDEPHSpOpMode DSCHED_St.FId_EGRVlvCoord DSCHED_St.FId_EGSDO2FuTrmB1 DSCHED_St.FId_EGSDO2SnsrMntdRelsS1B1 DSCHED_St.FId_EGSDO2_LamOffsFastS1B1 DSCHED_St.FId_MisfDetDnAdpnNv DSCHED_St.FId_bascadpncvo DSCHED_VirtSt.FId_Unused DSCHED_VirtSt.FID_AFRA DSCHED_VirtSt.FID_AORA DSCHED_VirtSt.FID_ATEH DSCHED_VirtSt.FID_ATEL DSCHED_VirtSt.FID_ATEN DSCHED_VirtSt.FID_ATLDI DSCHED_VirtSt.FID_ATLDO DSCHED_VirtSt.FID_BEONV DSCHED_VirtSt.FId_EGSDCmnSeg1B1Parl DSCHED_VirtSt.FID_BAGRA DSCHED_VirtSt.FID_BAGRASD DSCHED_VirtSt.FID_BDSTOF DSCHED_VirtSt.FID_BFVDFRM DSCHED_VirtSt.FID_BHOM DSCHED_VirtSt.FID_BLLRH DSCHED_VirtSt.FID_BLLRKH DSCHED_VirtSt.FID_BPLSU DSCHED_VirtSt.FID_FRAMBAVMB DSCHED_VirtSt.FId_CatHeatgColdStrtReq DSCHED_VirtSt.FId_CatHeatgWrmReq DSCHED_VirtSt.FId_DSMBDEPHSpOpMode DSCHED_VirtSt.FId_EGRVlvCoord DSCHED_VirtSt.FId_EGSDO2FuTrmB1 DSCHED_VirtSt.FId_EGSDO2SnsrMntdRelsS1B1 DSCHED_VirtSt.FId_EGSDO2_LamOffsFastS1B1 DSCHED_VirtSt.FId_MisfDetDnAdpnNv DSCHED_VirtSt.FId_bascadpncvo DSCHED_WhyExcl.FId_Unused DSCHED_WhyExcl.FID_AFRA DSCHED_WhyExcl.FID_AORA DSCHED_WhyExcl.FID_ATEH DSCHED_WhyExcl.FID_ATEL DSCHED_WhyExcl.FID_ATEN DSCHED_WhyExcl.FID_ATLDI DSCHED_WhyExcl.FID_ATLDO DSCHED_WhyExcl.FID_BEONV DSCHED_WhyExcl.FId_EGSDCmnSeg1B1Parl DSCHED_WhyExcl.FID_BAGRA DSCHED_WhyExcl.FID_BAGRASD DSCHED_WhyExcl.FID_BDSTOF DSCHED_WhyExcl.FID_BFVDFRM DSCHED_WhyExcl.FID_BHOM DSCHED_WhyExcl.FID_BLLRH DSCHED_WhyExcl.FID_BLLRKH DSCHED_WhyExcl.FID_BPLSU DSCHED_WhyExcl.FID_FRAMBAVMB DSCHED_WhyExcl.FId_CatHeatgColdStrtReq DSCHED_WhyExcl.FId_CatHeatgWrmReq DSCHED_WhyExcl.FId_DSMBDEPHSpOpMode DSCHED_WhyExcl.FId_EGRVlvCoord DSCHED_WhyExcl.FId_EGSDO2FuTrmB1 DSCHED_WhyExcl.FId_EGSDO2SnsrMntdRelsS1B1 DSCHED_WhyExcl.FId_EGSDO2_LamOffsFastS1B1 DSCHED_WhyExcl.FId_MisfDetDnAdpnNv DSCHED_WhyExcl.FId_bascadpncvo DSCHED_WhyVirtExcl.FId_Unused DSCHED_WhyVirtExcl.FID_AFRA DSCHED_WhyVirtExcl.FID_AORA DSCHED_WhyVirtExcl.FID_ATEH DSCHED_WhyVirtExcl.FID_ATEL DSCHED_WhyVirtExcl.FID_ATEN DSCHED_WhyVirtExcl.FID_ATLDI DSCHED_WhyVirtExcl.FID_ATLDO DSCHED_WhyVirtExcl.FID_BEONV DSCHED_WhyVirtExcl.FId_EGSDCmnSeg1B1Parl DSCHED_WhyVirtExcl.FID_BAGRA DSCHED_WhyVirtExcl.FID_BAGRASD DSCHED_WhyVirtExcl.FID_BDSTOF DSCHED_WhyVirtExcl.FID_BFVDFRM DSCHED_WhyVirtExcl.FID_BHOM DSCHED_WhyVirtExcl.FID_BLLRH DSCHED_WhyVirtExcl.FID_BLLRKH DSCHED_WhyVirtExcl.FID_BPLSU DSCHED_WhyVirtExcl.FID_FRAMBAVMB DSCHED_WhyVirtExcl.FId_CatHeatgColdStrtReq DSCHED_WhyVirtExcl.FId_CatHeatgWrmReq DSCHED_WhyVirtExcl.FId_DSMBDEPHSpOpMode DSCHED_WhyVirtExcl.FId_EGRVlvCoord DSCHED_WhyVirtExcl.FId_EGSDO2FuTrmB1 DSCHED_WhyVirtExcl.FId_EGSDO2SnsrMntdRelsS1B1 DSCHED_WhyVirtExcl.FId_EGSDO2_LamOffsFastS1B1 DSCHED_WhyVirtExcl.FId_MisfDetDnAdpnNv DSCHED_WhyVirtExcl.FId_bascadpncvo /end OUT_MEASUREMENT
 /begin LOC_MEASUREMENT DSCHED_idxFIdMaxPrio DSCHED_idxSeldTop DSCHED_stOpMode DSCHED_stPrmsOpMode /end LOC_MEASUREMENT
 FUNCTION_VERSION "30000.13.0" /end FUNCTION
/begin FUNCTION DSELHFS "3.1.3     selection: diagnosis of main load sensor" /begin DEF_CHARACTERISTIC SF_LM /end DEF_CHARACTERISTIC
 /begin IN_MEASUREMENT B_cdehfm_msg B_ehfm_msg B_mshfmgg_msg B_psrgg_msg SyC_stSub ThrVlv_flgIrrvFuCutOffB1 ThrVlv_flgLimpModeB1 /end IN_MEASUREMENT
 /begin OUT_MEASUREMENT B_ehfs_msg B_fhfs_msg B_statas_msg /end OUT_MEASUREMENT
 FUNCTION_VERSION "3.1.3" /end FUNCTION
/begin FUNCTION DSM2AUTOSAR "30000.70.0_1.1.0AUTOSAR Layer to DSM"
 /begin IN_MEASUREMENT Dem_disableEventStatusUpdateGroup DFES_stErrLamp DFES_stOutstate DSMRdy_xPId1 /end IN_MEASUREMENT
 /begin LOC_MEASUREMENT Dem_BswErrorBufferWriteCounter Dem_BswErrorBufferWriteIndex Dem_PTOSt Dem_stInit /end LOC_MEASUREMENT
 FUNCTION_VERSION "30000.70.0_1.1.0" /end FUNCTION
/begin FUNCTION DSMAux "30000.53.0_1.0.0DSM Auxiliary"
 /begin DEF_CHARACTERISTIC DSMAUX_dtWUCMin_C DSMAUX_tWUCMin_C DSMAUX_xClearMode_C DSMAUX_xClearTrg_C /end DEF_CHARACTERISTIC
 /begin IN_MEASUREMENT SyC_stSub /end IN_MEASUREMENT
 /begin OUT_MEASUREMENT DSMAUX_ctObdDCy_msg DSMAUX_ctWUC DSMAUX_ctWUC_msg DSMAUX_DTRG.DTRG_Time200ms DSMAUX_DTRG.DTRG_AlwaysTrue DSMAUX_DTRG.DTRG_DrivingCycleFLC DSMAUX_DTRG.DTRG_DrivingCycleHLC DSMAUX_DTRG.DTRG_MDCatHLC DSMAUX_DTRG.DTRG_MDEmiHLC DSMAUX_DTRG.DTRG_MDEmiStrtHLC DSMAUX_DTRG.DTRG_MDFLC2 DSMAUX_DTRG.DTRG_MDHLC2 DSMAUX_DTRG.DTRG_NoTrigger DSMAUX_DTRG.DTRG_SimilarCondHLC DSMAUX_DTRG.DTRG_WarmUpCycle DSMAUX_stDCy DSMAUX_stDCy_msg DSMAUX_stDsmClrActv DSMAUX_stObdDcycCmpl DSMAUX_stWrmUpCycCmpl DSM_TripChgAndClrFinshd DSM_TripChgFinshd /end OUT_MEASUREMENT
 /begin LOC_MEASUREMENT DFC_idxDfcTrans DSMAUX_ctObdDCy DSMAUX_stClrTaskFin DSMAUX_stStrtEnd DSMAUX_stTranGlbJob DSMAUX_stTranReq DSMAUX_tClntStrt DSM_stPostDrive DSM_stReInit /end LOC_MEASUREMENT
 FUNCTION_VERSION "30000.53.0_1.0.0" /end FUNCTION
/begin FUNCTION DSMBDEP "1.5.0     GDI Mode Scheduling Priorities" /begin DEF_CHARACTERISTIC PRIOMAKUPL /end DEF_CHARACTERISTIC /begin IN_MEASUREMENT bdemodfa_msg /end IN_MEASUREMENT FUNCTION_VERSION "1.5.0" /end FUNCTION
/begin FUNCTION DSMDur "30000.15.2DSM Duration Counters"
 /begin DEF_CHARACTERISTIC DSMDur_valEvntQntDist_C DSMDur_valEvntQntTi_C DSMDur_xEnaGlb_CA DSMDur_xRstGlb_CA DSMDur_xSelEvntGlb_CA /end DEF_CHARACTERISTIC
 /begin IN_MEASUREMENT ErrLmp_stMIL /end IN_MEASUREMENT
 /begin OUT_MEASUREMENT DSMDur_ctGlb DSMDur_ctPID21h DSMDur_ctPID31h DSMDur_stGlb /end OUT_MEASUREMENT
 /begin LOC_MEASUREMENT DSMDur_lRef DSMDur_lRef10m DSMDur_stPID21h DSMDur_stWUCLst DSMDur_tiMICumCont DSMDur_tiMICumContGlb DSMDur_tiMICumSubCont DSMDur_tiMICumSubContGlb DSMDur_tiRef /end LOC_MEASUREMENT
 FUNCTION_VERSION "30000.15.2" /end FUNCTION
/begin FUNCTION DSMRdy "30000.22.1DSM Readiness"
 /begin DEF_CHARACTERISTIC DSMRdy_Grp.FlSys_CA DSMRdy_Grp.Cat_CA DSMRdy_Grp.HtCat_CA DSMRdy_Grp.EvpSys_CA DSMRdy_Grp.SecAirSys_CA DSMRdy_Grp.GPF_CA DSMRdy_Grp.O2Sens_CA DSMRdy_Grp.O2SensHt_CA DSMRdy_Grp.EGR_CA DSMRdy_X.PID1ForceLowMsk_C DSMRdy_X.PID1ForceHighMsk_C DSMRdy_X.PID41ForceLowMsk_C DSMRdy_X.PID41ForceHighMsk_C /end DEF_CHARACTERISTIC
 /begin IN_MEASUREMENT DINH_stDFCPid41Di DSMAUX_stDCy /end IN_MEASUREMENT
 /begin OUT_MEASUREMENT DSMRdy_xPId1 DSMRdy_xPId41 /end OUT_MEASUREMENT
 /begin LOC_MEASUREMENT DSMRdy_stGrpAct DSMRdy_stGrpLock DSMRdy_stGrpRdy DSMRdy_stGrpRdyDFES DSMRdy_stGrpRdyScan DSMRdy_stGrpSup /end LOC_MEASUREMENT
 FUNCTION_VERSION "30000.22.1" /end FUNCTION
/begin FUNCTION DSM_Conf "30164.6.0 DSM Kernel configuration"
 /begin DEF_CHARACTERISTIC DFES_MeterOut.DFC_AAVEmax_C DFES_MeterOut.DFC_AAVEmin_C DFES_MeterOut.DFC_AAVEsig_C DFES_MeterOut.DFC_AltIOACGFailr_C DFES_MeterOut.DFC_AltIOACGHiVltg_C DFES_MeterOut.DFC_AltIOACGLoVltg_C DFES_MeterOut.DFC_AltIOACGTHi_C DFES_MeterOut.DFC_AltIODConnACG_C DFES_MeterOut.DFC_BGOELWAF_C DFES_MeterOut.DFC_BattUHiFailr_C DFES_MeterOut.DFC_BattULoFailr_C DFES_MeterOut.DFC_BrkBstPDriftHiErr_C DFES_MeterOut.DFC_BrkBstPDriftLoErr_C DFES_MeterOut.DFC_BrkBstPSnsrStuck_C DFES_MeterOut.DFC_BrkMnSwtContOn_C DFES_MeterOut.DFC_BrkMnSwtNotStp_C DFES_MeterOut.DFC_BrkNpl_C DFES_MeterOut.DFC_BrkRdntSwtContOn_C DFES_MeterOut.DFC_BrkRdntSwtNotStp_C DFES_MeterOut.DFC_Clth3ONStuck_C DFES_MeterOut.DFC_Clth4OFFStuck_C DFES_MeterOut.DFC_ClthOFFStuck_C DFES_MeterOut.DFC_ClthONStuck_C DFES_MeterOut.DFC_ClthStkFailInfo_C DFES_MeterOut.DFC_ComACFailInfo_C DFES_MeterOut.DFC_ComATFTValErr_C DFES_MeterOut.DFC_ComATMILReq_C DFES_MeterOut.DFC_ComAYCAChksum_C DFES_MeterOut.DFC_ComAYCARingCnt_C DFES_MeterOut.DFC_ComAYCATOut_C DFES_MeterOut.DFC_ComAYCDChkSum_C DFES_MeterOut.DFC_ComAYCDTOut_C DFES_MeterOut.DFC_ComAYCFChksum_C DFES_MeterOut.DFC_ComAYCFRingCnt_C DFES_MeterOut.DFC_ComAYCFTOut_C /end DEF_CHARACTERISTIC
 /begin IN_MEASUREMENT BasSvr_bFuncTstReq BattU_u B_urstsprr_msg CBUtil_stReProgEvnt CEngDsT_t CoEng_bObdTmrInctg CoEng_st CoEng_stMai CoEng_tiNormalOBD CoEOM_bTransActv CoEOM_stOpMAct CoEOM_stOpMPos DSMAUX_stDsmClrActv EnvT_t Epm_nEng GlbDa_lTotDst MRly_st MRly_stAct PEnv_p StSys_stStrt SyC_stSub T15_st VehV_v VMD_rVirtAPP /end IN_MEASUREMENT
 /begin OUT_MEASUREMENT DSM_bFuncTstActv DSM_DFCSrv7VisClrReq DSM_DINHSrv7VisClrReq DSM_stMaiEngRunng DSM_stOpMDes /end OUT_MEASUREMENT
 /begin LOC_MEASUREMENT DSMConf_DFCSrv7VisClrSt DSM_bInstableStatus DSM_bStFuncTst DSM_CoEngtiNormalOBD DSM_DisblMode_mp DSM_ECUId DSM_lDst DSM_PDTCDisbl_mp DSM_pEnv DSM_rAPP DSM_stCoOpMode DSM_stCoPrmsOpMode DSM_stStrEnd DSM_stWiggle_mp DSM_tEngDS DSM_tEnv DSM_vVeh /end LOC_MEASUREMENT
 FUNCTION_VERSION "30164.6.0" /end FUNCTION
/begin COMPU_METHOD B_TRUE "" TAB_VERB "%6.3" "" COMPU_TAB_REF B_TRUE /end COMPU_METHOD
/begin COMPU_VTAB B_TRUE "" TAB_VERB 2 0 "FALSE" 1 "TRUE" /end COMPU_VTAB
/begin COMPU_METHOD dez "" RAT_FUNC "%6.2" "" COEFFS 0 1 0 0 0 1 /end COMPU_METHOD
/begin COMPU_METHOD DFC_OneToOne "" RAT_FUNC "%6.2" "-" COEFFS 0 1 0 0 0 1 /end COMPU_METHOD
/begin COMPU_METHOD DFC_Verb "" TAB_VERB "%6.3" "-" COMPU_TAB_REF DFC_Verb /end COMPU_METHOD
/begin COMPU_VTAB DFC_Verb "" TAB_VERB 907 0 "DFC_Unused" 1 "DFC_AAVEmax" 2 "DFC_AAVEmin" 3 "DFC_AAVEsig" 508 "DFC_AAVmin" 379 "DFC_ACEvpTPhysRngHi" 380 "DFC_ACEvpTPhysRngLo" 381 "DFC_ACEvpTSRCMax" 382 "DFC_ACEvpTSRCMin" 288 "DFC_AfsPhyRngHiB1" 289 "DFC_AfsPhyRngLoB1" 510 "DFC_AfsPlausDiagHi" 511 "DFC_AfsPlausDiagLo" 383 "DFC_AfsRawSigRngHiB1" 384 "DFC_AfsRawSigRngLoB1" 415 "DFC_AfsSigErrLineHiB1" 416 "DFC_AfsSigErrLineLoB1" 385 "DFC_AfsSnsrErrB1" 512 "DFC_AfsVrntDiagErrB1" 509 "DFC_AGRSUS" 386 "DFC_AirCClntPAnaSRCMax" 387 "DFC_AirCClntPAnaSRCMin" 290 "DFC_AirCCmprOL" 291 "DFC_AirCCmprOvrTemp" 292 "DFC_AirCCmprSCB" 293 "DFC_AirCCmprSCG" 388 "DFC_AirCSwtNpl" 389 "DFC_AirCSwtSig" 294 "DFC_AltErr" 4 "DFC_AltIOACGFailr" 5 "DFC_AltIOACGHiVltg" 6 "DFC_AltIOACGLoVltg" 7 "DFC_AltIOACGTHi" 8 "DFC_AltIODConnACG" 513 "DFC_AppAllSnsrDfct" 10 "DFC_BattUHiFailr" 11 "DFC_BattULoFailr" 295 "DFC_BattUSRCMax" 296 "DFC_BattUSRCMin" 516 "DFC_BattUStdbyDiaOL" 514 "DFC_BBKRnldg" 515 "DFC_BBKRsyne" 9 "DFC_BGOELWAF" 517 "DFC_BigLeakIntkMnfldEmiInfl" 518 "DFC_BlkdLineTank" 390 "DFC_Brk" 12 "DFC_BrkBstPDriftHiErr" 13 "DFC_BrkBstPDriftLoErr" 14 "DFC_BrkBstPSnsrStuck" 391 "DFC_BrkBstSensSCB" 392 "DFC_BrkBstSensSCG" 15 "DFC_BrkMnSwtContOn" 519 "DFC_BrkMnSwtContOnWarnLmp" 16 "DFC_BrkMnSwtNotStp" 520 "DFC_BrkMnSwtNotStpWarnLmp" 17 "DFC_BrkNpl" 18 "DFC_BrkRdntSwtContOn" 521 "DFC_BrkRdntSwtContOnWarnLmp" 19 "DFC_BrkRdntSwtNotStp" 522 "DFC_BrkRdntSwtNotStpWarnLmp" 393 "DFC_BrkSig" 496 "DFC_BSWM_E_ACTION_FAILED" 497 "DFC_BSWM_E_INTRPTQUEUE_FULL" 472 "DFC_BusDiagCANAPPLBusOff" 473 "DFC_BusDiagCANCANCBusOff" 474 "DFC_BusDiagCANVEHICLEBusOff" 490 "DFC_CAN_E_TIMEOUT" 523 "DFC_CEngDsTColdStrtMax" 524 "DFC_CEngDsTColdStrtMin" 525 "DFC_CEngDsTImps" 526 "DFC_CEngDsTPlausHSC" 527 "DFC_CEngDsTPlausLSC" 528 "DFC_CEngDsTPlausSTC" 531 "DFC_CEngDsTSig" 529 "DFC_CEngDsTSRCMax" 530 "DFC_CEngDsTSRCMin" 532 "DFC_CEngUsTColdStrtMax" 533 "DFC_CEngUsTColdStrtMin" 534 "DFC_CEngUsTLooseCnctn" 535 "DFC_CEngUsTSRCMax" 536 "DFC_CEngUsTSRCMin" 432 "DFC_Clth2ONStuck" 433 "DFC_Clth2ONStuckLdc" 20 "DFC_Clth3ONStuck" 434 "DFC_Clth3ONStuckLdc" 435 "DFC_Clth3ONStuckPostDrv" 21 "DFC_Clth4OFFStuck" 436 "DFC_Clth4ONStuck" 437 "DFC_Clth4ONStuckLdc" 260 "DFC_ClthMax" 412 "DFC_ClthNpl" 22 "DFC_ClthOFFStuck" 23 "DFC_ClthONStuck" 394 "DFC_ClthSig" 24 "DFC_ClthStkFailInfo" 25 "DFC_ComACFailInfo" 26 "DFC_ComATFTValErr" 27 "DFC_ComATMILReq" 28 "DFC_ComAYCAChksum" 29 "DFC_ComAYCARingCnt" 30 "DFC_ComAYCATOut" 31 "DFC_ComAYCDChkSum" 32 "DFC_ComAYCDTOut" 33 "DFC_ComAYCFChksum" 34 "DFC_ComAYCFRingCnt" 35 "DFC_ComAYCFTOut" 36 "DFC_ComAYCGChksum" 37 "DFC_ComAYCGRingCnt" 38 "DFC_ComAYCGTOut" 39 "DFC_ComAYCIChkSum" 40 "DFC_ComAYCIRingCnt" 41 "DFC_ComAYCITOut" 42 "DFC_ComBCM1ChkSum" 43 "DFC_ComBCM1RingCnt" 44 "DFC_ComBCM1TOut" 438 "DFC_ComBCMUnit" 45 "DFC_ComCANABusOffErr" 46 "DFC_ComCANBBusOffErr" 47 "DFC_ComCANCBusOffErr" 48 "DFC_ComCGW1ChkSum" 49 "DFC_ComCGW1RingCnt" 50 "DFC_ComCGW1TOut" 297 "DFC_ComChksTCU1" 298 "DFC_ComChksTCU11" 299 "DFC_ComChksTCU12" 300 "DFC_ComChksTCU13" 301 "DFC_ComChksTCU2" 302 "DFC_ComChksTCU3" 303 "DFC_ComChksTCU4" 304 "DFC_ComCntTCU1" 305 "DFC_ComCntTCU11" 306 "DFC_ComCntTCU12" 307 "DFC_ComCntTCU13" 308 "DFC_ComCntTCU2" 309 "DFC_ComCntTCU3" 310 "DFC_ComCntTCU4" 51 "DFC_ComConvBoostErr" 52 "DFC_ComConvSlipErr" 537 "DFC_ComDCDCACCFailr" 53 "DFC_ComDCDCPrfmncErr" 54 "DFC_ComDCDCTempWarn" 439 "DFC_ComDLCTCU01" 440 "DFC_ComDLCTCU02" 441 "DFC_ComDLCTCU1" 442 "DFC_ComDLCTCU11" 443 "DFC_ComDLCTCU12" 444 "DFC_ComDLCTCU13" 445 "DFC_ComDLCTCU14" 446 "DFC_ComDLCTCU2" 447 "DFC_ComDLCTCU3" 448 "DFC_ComDLCTCU4" 55 "DFC_ComEAT10Chksum" 56 "DFC_ComEAT10RingCnt" 57 "DFC_ComEAT10TOut" 58 "DFC_ComEAT11ChkSum" 59 "DFC_ComEAT11RingCnt" 60 "DFC_ComEAT11TOut" 61 "DFC_ComEAT12ChkSum" 62 "DFC_ComEAT12RingCnt" 63 "DFC_ComEAT12TOut" 64 "DFC_ComEAT13ChkSum" 65 "DFC_ComEAT13RingCnt" 66 "DFC_ComEAT13TOut" 67 "DFC_ComEAT1Chksum" 68 "DFC_ComEAT1RingCnt" 69 "DFC_ComEAT1TOut" 70 "DFC_ComEAT2ChkSum" 71 "DFC_ComEAT2RingCnt" 72 "DFC_ComEAT2TOut" 73 "DFC_ComEAT4ChkSum" 74 "DFC_ComEAT4RingCnt" 75 "DFC_ComEAT4TOut" 76 "DFC_ComEAT6Chksum" 77 "DFC_ComEAT6RingCnt" 78 "DFC_ComEAT6TOut" 79 "DFC_ComEAT7Chksum" 80 "DFC_ComEAT7RingCnt" 81 "DFC_ComEAT7TOut" 82 "DFC_ComEAT8Chksum" 83 "DFC_ComEAT8RingCnt" 84 "DFC_ComEAT8TOut" 85 "DFC_ComEATAChksum" 86 "DFC_ComEATARingCnt" 87 "DFC_ComEATATOut" 88 "DFC_ComEATBChkSum" 89 "DFC_ComEATBRingCnt" 90 "DFC_ComEATBTOut" 91 "DFC_ComEATCChksum" 92 "DFC_ComEATCRingCnt" 93 "DFC_ComEATCTOut" 103 "DFC_ComEngCanRxErr" 94 "DFC_ComEPBBChkSum" 95 "DFC_ComEPBBRingCnt" 96 "DFC_ComEPBBTOut" 97 "DFC_ComEPBChksum" 99 "DFC_ComEPBctRing" 98 "DFC_ComEPBTOut" 100 "DFC_ComEPS1Chksum" 101 "DFC_ComEPS1RingCnt" 102 "DFC_ComEPS1TOut" 449 "DFC_ComEPSUnit" 104 "DFC_ComGrvySnsrErr" 105 "DFC_ComGwIMG1ChkSum" 106 "DFC_ComGwIMG1RingCnt" 107 "DFC_ComGwIMG1TOut" 108 "DFC_ComGwIMG3ChkSum" 109 "DFC_ComGwIMG3RingCnt" 110 "DFC_ComGwIMG3TOut" 111 "DFC_ComGwIMG4ChkSum" 112 "DFC_ComGwIMG4RingCnt" 113 "DFC_ComGwIMG4TOut" 114 "DFC_ComGwIMG5ChkSum" 115 "DFC_ComGwIMG5RingCnt" 116 "DFC_ComGwIMG5TOut" 117 "DFC_ComGwIMG6ChkSum" 118 "DFC_ComGwIMG6RingCnt" 119 "DFC_ComGwIMG6TOut" 120 "DFC_ComIDASBChksum" 121 "DFC_ComIDASBRingCnt" 122 "DFC_ComIDASBTOut" 450 "DFC_ComIDASBUnit" 123 "DFC_ComIMGMILReq" 451 "DFC_ComIMGUnit" 124 "DFC_ComISSPrms" 125 "DFC_ComMETAChksum" 126 "DFC_ComMETAChksumPstDrv" 127 "DFC_ComMETARingCnt" 128 "DFC_ComMETARingCntPstDrv" 129 "DFC_ComMETATOut" 130 "DFC_ComMETATOutPstDrv" 131 "DFC_ComMETCChksum" 132 "DFC_ComMETCRingCnt" 133 "DFC_ComMETCTOut" 134 "DFC_ComMETDChksum" 135 "DFC_ComMETDRingCnt" 136 "DFC_ComMETDTOut" 137 "DFC_ComMETE2Chksum" 138 "DFC_ComMETE2RingCnt" 139 "DFC_ComMETE2TOut" 140 "DFC_ComMETFChksum" 141 "DFC_ComMETFRingCnt" 142 "DFC_ComMETFTOut" 143 "DFC_ComMETGChksum" 144 "DFC_ComMETGRingCnt" 145 "DFC_ComMETGTOut" 146 "DFC_ComMETH2Chksum" 147 "DFC_ComMETH2RingCnt" 148 "DFC_ComMETH2TOut" 149 "DFC_ComMETHChksum" 150 "DFC_ComMETHRingCnt" 151 "DFC_ComMETHTOut" 152 "DFC_ComMETIChksum" 153 "DFC_ComMETIRingCnt" 154 "DFC_ComMETITOut" 155 "DFC_ComMETKChksum" 156 "DFC_ComMETKRingCnt" 157 "DFC_ComMETKTOut" 158 "DFC_ComMETLChksum" 159 "DFC_ComMETLRingCnt" 160 "DFC_ComMETLTOut" 161 "DFC_ComMETMChksum" 162 "DFC_ComMETMRingCnt" 163 "DFC_ComMETMTOut" 164 "DFC_ComMETNChksum" 165 "DFC_ComMETNRingCnt" 166 "DFC_ComMETNTOut" 452 "DFC_ComMETUnit" 167 "DFC_ComMtrCom" 168 "DFC_ComPCUChkSum" 169 "DFC_ComPCURingCnt" 170 "DFC_ComPCUTOut" 171 "DFC_ComSRSAChksum" 172 "DFC_ComSRSARingCnt" 173 "DFC_ComSRSATOut" 174 "DFC_ComSRSBChksum" 175 "DFC_ComSRSBRingCnt" 176 "DFC_ComSRSBTOut" 177 "DFC_ComSRSChksum" 178 "DFC_ComSRSErr" 179 "DFC_ComSRSRingCnt" 180 "DFC_ComSRSTOut" 453 "DFC_ComSRSUnit" 311 "DFC_ComTOutTCU01" 312 "DFC_ComTOutTCU02" 313 "DFC_ComTOutTCU1" 314 "DFC_ComTOutTCU11" 315 "DFC_ComTOutTCU12" 316 "DFC_ComTOutTCU13" 317 "DFC_ComTOutTCU14" 318 "DFC_ComTOutTCU2" 319 "DFC_ComTOutTCU3" 320 "DFC_ComTOutTCU4" 181 "DFC_ComVehSpdPndFltTCU" 454 "DFC_ComVSAUnit" 538 "DFC_DCDCFltDet" 321 "DFC_DevLibBattUHi" 322 "DFC_DevLibBattULo" 357 "DFC_DHFHD" 558 "DFC_DiagCpv1DteskLoLoadStuckClsd" 559 "DFC_DiagCpv1DteskLoLoadStuckOpen" 541 "DFC_DKnpl" 539 "DFC_DKRSA" 540 "DFC_DKVSmax" 542 "DFC_DSKVRmax" 543 "DFC_DSKVRmin" 544 "DFC_DSKVRnpl" 545 "DFC_DSKVRsig" 546 "DFC_DSKVSsig" 547 "DFC_DSSmax" 548 "DFC_DSTDmax" 549 "DFC_DSTEmax" 550 "DFC_DSTEmin" 551 "DFC_DSTOFmax" 552 "DFC_DSTRmax" 553 "DFC_DSTRmin" 554 "DFC_DSTRnpl" 555 "DFC_DSTRsig" 556 "DFC_DSTTI" 557 "DFC_DSUmax" 182 "DFC_EbsChartcCurrErr" 183 "DFC_EbsSelfDiagErr" 455 "DFC_EbsSocFlt" 395 "DFC_EGRVlvCurrLim" 560 "DFC_EGRVlvDrftClsd" 561 "DFC_EGRVlvDrftOpn" 323 "DFC_EGRVlvFailSafeActv" 324 "DFC_EGRVlvGovDvtCld" 562 "DFC_EGRVlvJamVlvClsd" 563 "DFC_EGRVlvJamVlvOpn" 396 "DFC_EGRVlvOL" 397 "DFC_EGRVlvOvrTemp" 325 "DFC_EGRVlvPhysSRCMax" 326 "DFC_EGRVlvPhysSRCMin" 398 "DFC_EGRVlvSCB" 399 "DFC_EGRVlvSCG" 564 "DFC_EGRVlvSprgBrk" 400 "DFC_EGRVlvSRCMax" 401 "DFC_EGRVlvSRCMin" 565 "DFC_EGRVlvTempMdlEEPErr" 566 "DFC_EGRVlvTmpErr" 567 "DFC_EGSDUS2B1LtrDly" 568 "DFC_EGSDUS2B1LtrPT1" 569 "DFC_EGSDUS2B1RtlDly" 570 "DFC_EGSDUS2B1RtlPT1" 571 "DFC_EGSDUS2B1TarLean" 572 "DFC_EGSDUS2B1TarRich" 586 "DFC_EngICO" 587 "DFC_EngPrtOvrSpdMon" 573 "DFC_EONVmax" 588 "DFC_EpmCaSI1ErrSig" 589 "DFC_EpmCaSI1MntErr" 590 "DFC_EpmCaSI1NoSigMax" 591 "DFC_EpmCaSI1NoSigMin" 592 "DFC_EpmCaSI1OfsErr" 593 "DFC_EpmCrSDGI" 594 "DFC_EpmCrSErrSig" 595 "DFC_EpmCrSNoSig" 596 "DFC_EtaEngIdleNonCsers" 597 "DFC_EtaEngPtlNonCsers" 574 "DFC_ETAKHLmax" 575 "DFC_ETAKHTmax" 576 "DFC_ETHSEmax" 577 "DFC_ETHSEmin" 578 "DFC_ETHSFmax" 579 "DFC_ETHSFmin" 580 "DFC_ETHSFsig" 581 "DFC_ETHSNPWmax" 582 "DFC_ETHSNPWmin" 583 "DFC_ETHSNPWsig" 584 "DFC_ETHSPLnpl" 585 "DFC_ETHSTPLnpl" 327 "DFC_FanDIOOL_0" 328 "DFC_FanDIOOL_1" 329 "DFC_FanDIOOvrTemp_0" 330 "DFC_FanDIOOvrTemp_1" 331 "DFC_FanDIOSCB_0" 332 "DFC_FanDIOSCB_1" 333 "DFC_FanDIOSCG_0" 334 "DFC_FanDIOSCG_1" 598 "DFC_FRAmax" 599 "DFC_FRAmin" 600 "DFC_FSTEmax" 601 "DFC_FSTEmin" 605 "DFC_FSTmax" 602 "DFC_FSTRmax" 603 "DFC_FSTRmin" 604 "DFC_FSTRnpl" 606 "DFC_FTDLAmax" 607 "DFC_FTDLAmin" 608 "DFC_FuPHiSnsrEleclmax" 609 "DFC_FuPHiSnsrEleclmin" 610 "DFC_FuPHiSnsrEleclnpl" 611 "DFC_FuPHiSnsrURngMax" 612 "DFC_FuPHiSnsrURngMin" 613 "DFC_FuSnsrPhyRngMaxErr" 614 "DFC_FuSnsrPhyRngMinErr" 188 "DFC_GbxCANDigPlausErr" 189 "DFC_GbxNPos1SRCMax" 190 "DFC_GbxNPos1SRCMin" 191 "DFC_GbxNPos2SRCMax" 192 "DFC_GbxNPos2SRCMin" 193 "DFC_GbxNPosAlvChk" 194 "DFC_GbxNPosSyncErr" 413 "DFC_GbxPNPosnDrvCdn" 414 "DFC_GbxPNPosnPlausy" 618 "DFC_GbxRvsSwtStk" 615 "DFC_GEVlvLockPinDiagIntkB1" 184 "DFC_GEVlvPhaCsersIntkB1" 185 "DFC_GEVlvPhaPsOpenLoadIntkB1" 186 "DFC_GEVlvPhaPsShoToBattIntkB1" 187 "DFC_GEVlvPhaPsShoToGndIntkB1" 616 "DFC_GEVlvPhaSlowIntkB1" 617 "DFC_GEVlvPhaTargIntkB1" 619 "DFC_HDRKHmax" 620 "DFC_HDRKHmin" 623 "DFC_HDRmax" 624 "DFC_HDRmin" 621 "DFC_HDRPLmax" 622 "DFC_HDRPLmin" 625 "DFC_HEGOS2B1ElecMax" 626 "DFC_HEGOS2B1ElecMin" 627 "DFC_HEGOS2B1ElecSig" 628 "DFC_HEGOS2B1HtgNpl" 195 "DFC_HEGOS2B1HtrPsMax" 196 "DFC_HEGOS2B1HtrPsMin" 197 "DFC_HEGOS2B1HtrPsSig" 629 "DFC_HEV00max" 630 "DFC_HEV01max" 631 "DFC_HEV02max" 632 "DFC_HEV03max" 633 "DFC_HEVE0max" 634 "DFC_HEVE1max" 635 "DFC_HFMmax" 636 "DFC_HiPSysHiPMaxLimExcdd" 402 "DFC_HLSDemOvhtEngLim" 456 "DFC_I14229VINErr" 261 "DFC_IgnClPs_DevComErr" 262 "DFC_IgnClPs_LineOl_0" 263 "DFC_IgnClPs_LineOl_1" 264 "DFC_IgnClPs_LineOl_2" 265 "DFC_IgnClPs_LineOl_3" 266 "DFC_IgnClPs_LineScb_0" 267 "DFC_IgnClPs_LineScb_1" 268 "DFC_IgnClPs_LineScb_2" 269 "DFC_IgnClPs_LineScb_3" 270 "DFC_IgnClPs_LineScg_0" 271 "DFC_IgnClPs_LineScg_1" 272 "DFC_IgnClPs_LineScg_2" 273 "DFC_IgnClPs_LineScg_3" 457 "DFC_InjCatHeatgErr" 458 "DFC_InjSysMulInjDiagErr" 358 "DFC_InjVlv_DI_DcDc" 359 "DFC_InjVlv_DI_NoLd_0" 360 "DFC_InjVlv_DI_NoLd_1" 361 "DFC_InjVlv_DI_NoLd_2" 362 "DFC_InjVlv_DI_NoLd_3" 363 "DFC_InjVlv_DI_ScBnk_0" 364 "DFC_InjVlv_DI_ScBnk_1" 365 "DFC_InjVlv_DI_ScBnk_2" 366 "DFC_InjVlv_DI_ScBnk_3" 367 "DFC_InjVlv_DI_ScCyl_0" 368 "DFC_InjVlv_DI_ScCyl_1" 369 "DFC_InjVlv_DI_ScCyl_2" 370 "DFC_InjVlv_DI_ScCyl_3" 371 "DFC_InjVlv_DI_ScHsLs_0" 372 "DFC_InjVlv_DI_ScHsLs_1" 373 "DFC_InjVlv_DI_ScHsLs_2" 374 "DFC_InjVlv_DI_ScHsLs_3" 652 "DFC_IntkAirTAirFltDsCrssMax" 653 "DFC_IntkAirTAirFltDsCrssMin" 654 "DFC_IntkAirTAirFltDsHSCMax" 655 "DFC_IntkAirTAirFltDsImps" 656 "DFC_IntkAirTAirFltDsPRCMax" 657 "DFC_IntkAirTAirFltDsPRCMin" 658 "DFC_IntkAirTAirFltDsSRCMax" 659 "DFC_IntkAirTAirFltDsSRCMin" 660 "DFC_IntkAirTAirFltDsSTC" 661 "DFC_IntkAirTIntkMnfldCrssMax" 662 "DFC_IntkAirTIntkMnfldCrssMin" 663 "DFC_IntkAirTIntkMnfldHSCMax" 664 "DFC_IntkAirTIntkMnfldImps" 665 "DFC_IntkAirTIntkMnfldPRCMax" 666 "DFC_IntkAirTIntkMnfldPRCMin" 667 "DFC_IntkAirTIntkMnfldSRCMax" 668 "DFC_IntkAirTIntkMnfldSRCMin" 669 "DFC_IntkAirTIntkMnfldSTC" 647 "DFC_IVGdiCtl_CvoErr" 648 "DFC_IVGdiCtl_CvoSigPlaus_0" 649 "DFC_IVGdiCtl_CvoSigPlaus_1" 650 "DFC_IVGdiCtl_CvoSigPlaus_2" 651 "DFC_IVGdiCtl_CvoSigPlaus_3" 637 "DFC_IVGdiCtlCvoErrMax_0" 638 "DFC_IVGdiCtlCvoErrMax_1" 639 "DFC_IVGdiCtlCvoErrMax_2" 640 "DFC_IVGdiCtlCvoErrMax_3" 641 "DFC_IVGdiCtlCvoErrMin_0" 642 "DFC_IVGdiCtlCvoErrMin_1" 643 "DFC_IVGdiCtlCvoErrMin_2" 644 "DFC_IVGdiCtlCvoErrMin_3" 645 "DFC_IVGdiCtlCvoErrMinMax" 646 "DFC_IVGdiCtlCvoSigPlausErrSmrCdn" 428 "DFC_KnDetSens1PortAMax" 429 "DFC_KnDetSens1PortAMin" 430 "DFC_KnDetSens1PortBMax" 431 "DFC_KnDetSens1PortBMin" 670 "DFC_KRREGRLMX" 671 "DFC_KRVEKOCVLCI" 672 "DFC_KRVEKOENCHMT" 673 "DFC_KRVEKOENCHMT0" 674 "DFC_KRVEKOENCHMT1" 675 "DFC_KRVEKOENCHMT2" 676 "DFC_KRVEKOENCHMT3" 677 "DFC_KRVEKOENCHMT4" 678 "DFC_KRVEKOENCHMT5" 679 "DFC_KRVEKOENCHMT6" 680 "DFC_KRVEKOENCHMT7" 274 "DFC_KRVEKOEVAB" 275 "DFC_KRVEKOEVAB0" 276 "DFC_KRVEKOEVAB1" 277 "DFC_KRVEKOEVAB2" 278 "DFC_KRVEKOEVAB3" 681 "DFC_KRVEKORLMX" 682 "DFC_KRVEKORLMXL" 683 "DFC_KS1max" 684 "DFC_KS1min" 687 "DFC_LamDynDiagS1B1" 688 "DFC_LeakIntkMnfldEmiInfl" 491 "DFC_LIN_E_TIMEOUT" 465 "DFC_LinACGUnit" 466 "DFC_LinAEVUnit" 198 "DFC_LinCSErrACG" 199 "DFC_LinCSErrAEV" 200 "DFC_LinCSErrDCDC" 201 "DFC_LinCSErrEBS" 467 "DFC_LinEBSUnit" 689 "DFC_LinFrameErrDCDC" 202 "DFC_LinHdrTimeoutErrACG" 203 "DFC_LinHdrTimeoutErrAEV" 204 "DFC_LinHdrTimeoutErrDCDC" 205 "DFC_LinHdrTimeoutErrEBS" 206 "DFC_LinMsgTimeoutErrACG" 207 "DFC_LinMsgTimeoutErrAEV" 208 "DFC_LinMsgTimeoutErrDCDC" 209 "DFC_LinMsgTimeoutErrEBS" 210 "DFC_LinNoStrtComErr" 690 "DFC_LinOverrunErrDCDC" 459 "DFC_LLRHmax" 460 "DFC_LLRHmin" 461 "DFC_LLRHnpl" 462 "DFC_LLRKHmax" 463 "DFC_LLRKHmin" 464 "DFC_LLRKHnpl" 685 "DFC_LMmax" 211 "DFC_LowPresOilP" 686 "DFC_LZSRnpl" 691 "DFC_MD00max" 692 "DFC_MDBmax" 693 "DFC_MDCat" 694 "DFC_MDCatCrit" 695 "DFC_MDCatCurr" 696 "DFC_MDCyl_0" 697 "DFC_MDCyl_1" 698 "DFC_MDCyl_2" 699 "DFC_MDCyl_3" 700 "DFC_MDEmi" 701 "DFC_MDEmiStrt" 702 "DFC_MDFco" 705 "DFC_MDmax" 703 "DFC_MDMpl" 704 "DFC_MDSegTiAdpn" 375 "DFC_MfPsDiaOpenLoad1" 376 "DFC_MfPsDiaScHiS1" 377 "DFC_MfPsDiaScHiSLowS1" 378 "DFC_MfPsDiaScLowS1" 706 "DFC_MFuOilMax" 228 "DFC_MisfDetdVWhlFrntLePlaus" 229 "DFC_MisfDetdVWhlFrntRiPlaus" 230 "DFC_MisfDetdVWhlReLePlaus" 231 "DFC_MisfDetdVWhlReRiPlaus" 212 "DFC_MisfDetVWhlFrntLeOORHi" 213 "DFC_MisfDetVWhlFrntLeRatyHi" 214 "DFC_MisfDetVWhlFrntLeRatyLo" 215 "DFC_MisfDetVWhlFrntLeStuck" 216 "DFC_MisfDetVWhlFrntRiOORHi" 217 "DFC_MisfDetVWhlFrntRiRatyHi" 218 "DFC_MisfDetVWhlFrntRiRatyLo" 219 "DFC_MisfDetVWhlFrntRiStuck" 220 "DFC_MisfDetVWhlReLeOORHi" 221 "DFC_MisfDetVWhlReLeRatyHi" 222 "DFC_MisfDetVWhlReLeRatyLo" 223 "DFC_MisfDetVWhlReLeStuck" 224 "DFC_MisfDetVWhlReRiOORHi" 225 "DFC_MisfDetVWhlReRiRatyHi" 226 "DFC_MisfDetVWhlReRiRatyLo" 227 "DFC_MisfDetVWhlReRiStuck" 801 "DFC_MoCADCNTP" 802 "DFC_MoCADCTst" 803 "DFC_MoCSOPICO" 805 "DFC_MoFAirFilgPrdc" 806 "DFC_MoFAirFlCtOffGdi" 807 "DFC_MoFAirFlCylGdi" 808 "DFC_MoFAirFlFF" 809 "DFC_MoFAirFlIn" 810 "DFC_MoFAirFlMixCtlGdiChkAirFl" 811 "DFC_MoFAirFlMixCtlGdiChkCtrl" 812 "DFC_MoFAirFlMode" 804 "DFC_MoFAPP" 813 "DFC_MoFESpd" 814 "DFC_MoFIACo" 815 "DFC_MoFICOL1" 816 "DFC_MoFICOL2" 817 "DFC_MoFStrt" 818 "DFC_MoFTrqCmp" 819 "DFC_MoFTrqCmpMax" 820 "DFC_MoFTrqCmpMin" 821 "DFC_MoFVarPostBldSel" 707 "DFC_MOXEMM_SMU_ALM0_0" 708 "DFC_MOXEMM_SMU_ALM0_1" 709 "DFC_MOXEMM_SMU_ALM0_10" 710 "DFC_MOXEMM_SMU_ALM0_11" 711 "DFC_MOXEMM_SMU_ALM0_13" 712 "DFC_MOXEMM_SMU_ALM0_14" 713 "DFC_MOXEMM_SMU_ALM0_2" 714 "DFC_MOXEMM_SMU_ALM0_22" 715 "DFC_MOXEMM_SMU_ALM0_23" 716 "DFC_MOXEMM_SMU_ALM0_4" 717 "DFC_MOXEMM_SMU_ALM0_5" 718 "DFC_MOXEMM_SMU_ALM0_7" 719 "DFC_MOXEMM_SMU_ALM0_8" 720 "DFC_MOXEMM_SMU_ALM10_16" 721 "DFC_MOXEMM_SMU_ALM10_17" 722 "DFC_MOXEMM_SMU_ALM10_21" 723 "DFC_MOXEMM_SMU_ALM11_0" 724 "DFC_MOXEMM_SMU_ALM11_1" 725 "DFC_MOXEMM_SMU_ALM11_2" 726 "DFC_MOXEMM_SMU_ALM11_3" 727 "DFC_MOXEMM_SMU_ALM11_4" 728 "DFC_MOXEMM_SMU_ALM11_5" 729 "DFC_MOXEMM_SMU_ALM11_8" 730 "DFC_MOXEMM_SMU_ALM11_9" 731 "DFC_MOXEMM_SMU_ALM1_0" 732 "DFC_MOXEMM_SMU_ALM1_1" 733 "DFC_MOXEMM_SMU_ALM1_10" 734 "DFC_MOXEMM_SMU_ALM1_11" 735 "DFC_MOXEMM_SMU_ALM1_13" 736 "DFC_MOXEMM_SMU_ALM1_14" 737 "DFC_MOXEMM_SMU_ALM1_2" 738 "DFC_MOXEMM_SMU_ALM1_22" 739 "DFC_MOXEMM_SMU_ALM1_23" 740 "DFC_MOXEMM_SMU_ALM1_4" 741 "DFC_MOXEMM_SMU_ALM1_5" 742 "DFC_MOXEMM_SMU_ALM1_7" 743 "DFC_MOXEMM_SMU_ALM1_8" 744 "DFC_MOXEMM_SMU_ALM21_0" 745 "DFC_MOXEMM_SMU_ALM21_16" 746 "DFC_MOXEMM_SMU_ALM21_3" 747 "DFC_MOXEMM_SMU_ALM2_1" 748 "DFC_MOXEMM_SMU_ALM2_10" 749 "DFC_MOXEMM_SMU_ALM2_11" 750 "DFC_MOXEMM_SMU_ALM2_13" 751 "DFC_MOXEMM_SMU_ALM2_14" 752 "DFC_MOXEMM_SMU_ALM2_22" 753 "DFC_MOXEMM_SMU_ALM2_23" 754 "DFC_MOXEMM_SMU_ALM2_4" 755 "DFC_MOXEMM_SMU_ALM2_5" 756 "DFC_MOXEMM_SMU_ALM2_7" 757 "DFC_MOXEMM_SMU_ALM2_8" 758 "DFC_MOXEMM_SMU_ALM6_0" 759 "DFC_MOXEMM_SMU_ALM6_11" 760 "DFC_MOXEMM_SMU_ALM6_12" 761 "DFC_MOXEMM_SMU_ALM6_14" 762 "DFC_MOXEMM_SMU_ALM6_15" 763 "DFC_MOXEMM_SMU_ALM6_17" 764 "DFC_MOXEMM_SMU_ALM6_18" 765 "DFC_MOXEMM_SMU_ALM6_20" 766 "DFC_MOXEMM_SMU_ALM6_21" 767 "DFC_MOXEMM_SMU_ALM6_25" 768 "DFC_MOXEMM_SMU_ALM6_4" 769 "DFC_MOXEMM_SMU_ALM6_5" 770 "DFC_MOXEMM_SMU_ALM6_7" 771 "DFC_MOXEMM_SMU_ALM6_8" 772 "DFC_MOXEMM_SMU_ALM7_1" 773 "DFC_MOXEMM_SMU_ALM7_12" 774 "DFC_MOXEMM_SMU_ALM7_13" 775 "DFC_MOXEMM_SMU_ALM7_14" 776 "DFC_MOXEMM_SMU_ALM7_15" 777 "DFC_MOXEMM_SMU_ALM7_16" 778 "DFC_MOXEMM_SMU_ALM7_17" 779 "DFC_MOXEMM_SMU_ALM7_2" 780 "DFC_MOXEMM_SMU_ALM7_20" 781 "DFC_MOXEMM_SMU_ALM7_25" 782 "DFC_MOXEMM_SMU_ALM7_26" 783 "DFC_MOXEMM_SMU_ALM7_28" 784 "DFC_MOXEMM_SMU_ALM7_29" 785 "DFC_MOXEMM_SMU_ALM7_30" 786 "DFC_MOXEMM_SMU_ALM7_31" 787 "DFC_MOXEMM_SMU_ALM8_0" 788 "DFC_MOXEMM_SMU_ALM8_1" 789 "DFC_MOXEMM_SMU_ALM8_10" 790 "DFC_MOXEMM_SMU_ALM8_11" 791 "DFC_MOXEMM_SMU_ALM8_12" 792 "DFC_MOXEMM_SMU_ALM8_16" 793 "DFC_MOXEMM_SMU_ALM8_18" 794 "DFC_MOXEMM_SMU_ALM8_2" 795 "DFC_MOXEMM_SMU_ALM8_3" 796 "DFC_MOXEMM_SMU_ALM8_31" 797 "DFC_MOXEMM_SMU_ALM8_4" 798 "DFC_MOXEMM_SMU_ALM9_0" 799 "DFC_MOXEMM_SMU_ALM9_15" 800 "DFC_MOXEMM_SMU_ALM9_3" 822 "DFC_MoXEMMHwLTMCUFW" 823 "DFC_MoXEMMHwLTMonBIST" 824 "DFC_MoXEMMHwLTRegMonTest" 825 "DFC_MoXEMMHwLTStbySMUAlvTest" 826 "DFC_MoXEMMHwLTTempSens" 827 "DFC_MoXEMMHwLTUCBCfg" 335 "DFC_MRlyDcOL" 336 "DFC_MRlyDcSCB" 337 "DFC_MRlyDcSCG" 492 "DFC_MRlyOL" 493 "DFC_MRlySCB" 494 "DFC_MRlySCG" 828 "DFC_NWSEmax" 829 "DFC_NWSmax" 830 "DFC_OCWDAABEActv" 831 "DFC_OCWDACom" 832 "DFC_OCWDAErrPin" 833 "DFC_OCWDAOvrVltg" 836 "DFC_OilPPlaus" 403 "DFC_OilPSwmpSRCMax" 404 "DFC_OilPSwmpSRCMin" 834 "DFC_ORAmax" 835 "DFC_ORAmin" 847 "DFC_P_VSE11_OL" 848 "DFC_P_VSE11_SCB" 849 "DFC_P_VSE11_SCG" 417 "DFC_PEnvCcMax" 418 "DFC_PEnvCcMin" 419 "DFC_PEnvRngChkMax" 420 "DFC_PEnvRngChkMin" 232 "DFC_PEnvSigRngMax" 233 "DFC_PEnvSigRngMin" 421 "DFC_PEnvSnsrPlaus" 850 "DFC_PhyHighAPP1" 851 "DFC_PhyHighAPP2" 852 "DFC_PhyLowAPP1" 853 "DFC_PhyLowAPP2" 405 "DFC_PIntkVUsLineHiB1" 406 "DFC_PIntkVUsLineLoB1" 837 "DFC_PLLSUmax" 838 "DFC_PLLSUmin" 338 "DFC_PSPOL" 339 "DFC_PSPOvrTemp" 340 "DFC_PSPSCB" 341 "DFC_PSPSCG" 839 "DFC_PSR1max" 840 "DFC_PSRBmax" 841 "DFC_PSRBmin" 845 "DFC_PSRmax" 842 "DFC_PSRPmax" 843 "DFC_PSRPmin" 844 "DFC_PSRPsig" 846 "DFC_PUmax" 475 "DFC_RBA_IODIAGPWR_rba_IoExtCy329_SignalVltSply_0" 476 "DFC_RBA_IODIAGPWR_rba_IoExtCy329_SignalVltSply_0OT" 477 "DFC_RBA_IODIAGPWR_rba_IoExtCy329_SignalVltSply_0OV" 478 "DFC_RBA_IODIAGPWR_rba_IoExtCy329_SignalVltSply_0SCG" 479 "DFC_RBA_IODIAGPWR_rba_IoExtCy329_SignalVltSply_0UV" 480 "DFC_RBA_IODIAGPWR_rba_IoExtCy329_SignalVltSply_1" 481 "DFC_RBA_IODIAGPWR_rba_IoExtCy329_SignalVltSply_1OT" 482 "DFC_RBA_IODIAGPWR_rba_IoExtCy329_SignalVltSply_1OV" 483 "DFC_RBA_IODIAGPWR_rba_IoExtCy329_SignalVltSply_1SCG" 484 "DFC_RBA_IODIAGPWR_rba_IoExtCy329_SignalVltSply_1UV" 485 "DFC_RBA_IODIAGPWR_rba_IoExtCy329_SignalVltSply_2" 486 "DFC_RBA_IODIAGPWR_rba_IoExtCy329_SignalVltSply_2OT" 487 "DFC_RBA_IODIAGPWR_rba_IoExtCy329_SignalVltSply_2OV" 488 "DFC_RBA_IODIAGPWR_rba_IoExtCy329_SignalVltSply_2SCG" 489 "DFC_RBA_IODIAGPWR_rba_IoExtCy329_SignalVltSply_2UV" 498 "DFC_RBA_IOEXTLIB_KEEPALIVE_DRV" 499 "DFC_RBA_IOEXTLIB_KEEPALIVE_INI" 500 "DFC_rba_IoSigRtc_StopCounter" 502 "DFC_rba_MemDiag_MemReadErr" 503 "DFC_rba_MemDiag_MemWrErr" 501 "DFC_rba_MRly_Diag_Stk_Event" 495 "DFC_rba_MultiStackTrace_Threshold" 504 "DFC_rba_SyC_IrrSwOffTrigEngRun_Event" 505 "DFC_rba_T15_Diag_ComInVld_Event" 506 "DFC_rba_T15_Diag_ComOff_HwOn_Event" 507 "DFC_rba_T15_Diag_ComOn_HwOff_Event" 468 "DFC_RoughRoad" 469 "DFC_SiaEEPRdErr" 470 "DFC_SiaEEPWrngCod" 854 "DFC_SRCHighAPP1" 855 "DFC_SRCHighAPP2" 856 "DFC_SRCLowAPP1" 857 "DFC_SRCLowAPP2" 858 "DFC_SSpMon2" 859 "DFC_STHDRmax" 234 "DFC_StmFault" 236 "DFC_StrtCtlErr" 235 "DFC_StrtCtOffPth" 237 "DFC_StrtFault" 238 "DFC_StrtLckJudg1" 239 "DFC_StrtLckJudg2" 240 "DFC_StrtOL" 241 "DFC_StrtOL2" 242 "DFC_StrtSCB" 243 "DFC_StrtSCB2" 244 "DFC_StrtSCG" 245 "DFC_StrtSCG2" 246 "DFC_StrtStkRly1" 247 "DFC_StrtStkRly2" 860 "DFC_SWReset_0" 861 "DFC_SWReset_1" 862 "DFC_SWReset_2" 863 "DFC_SyncAPP" 342 "DFC_T50Err" 865 "DFC_TAmax_Dummy" 864 "DFC_TANKLnpl" 866 "DFC_TESFmax" 867 "DFC_TESGmax" 248 "DFC_TEVEmax" 249 "DFC_TEVEmin" 250 "DFC_TEVEsig" 875 "DFC_ThrVlvClsdPosnFirstOffsLrnImpoB1" 876 "DFC_ThrVlvClsdPosnOffsLrnImpoB1" 877 "DFC_ThrVlvClsdPosnOffsLrnMaxB1" 878 "DFC_ThrVlvClsdPosnOffsLrnMinB1" 879 "DFC_ThrVlvCtrlDeB1" 880 "DFC_ThrVlvDycB1" 881 "DFC_ThrVlvLimpAirPosnMaxAbsltDriftB1" 882 "DFC_ThrVlvLimpAirPosnMaxB1" 883 "DFC_ThrVlvLimpAirPosnMaxRelDriftB1" 884 "DFC_ThrVlvLimpAirPosnMinB1" 343 "DFC_ThrVlvLoBattB1" 885 "DFC_ThrVlvOpenLoadB1" 886 "DFC_ThrVlvOpenSprgB1" 887 "DFC_ThrVlvOpenSprgSprdB1" 888 "DFC_ThrVlvOpenSprgTwnB1" 889 "DFC_ThrVlvOverTB1" 890 "DFC_ThrVlvRetSprgB1" 891 "DFC_ThrVlvRetSprgSprdB1" 892 "DFC_ThrVlvRetSprgTwnB1" 893 "DFC_ThrVlvSens1MaxB1" 900 "DFC_ThrvlvSens1MinB1" 894 "DFC_ThrVlvSens1NplB1" 895 "DFC_ThrVlvSens2MaxB1" 896 "DFC_ThrVlvSens2MinB1" 897 "DFC_ThrVlvSens2NplB1" 898 "DFC_ThrVlvShoCircB1" 899 "DFC_ThrVlvSpiErrB1" 901 "DFC_TiOffTBasdChkFast" 902 "DFC_TiOffTBasdChkSlow" 868 "DFC_TKAEmax" 869 "DFC_TKAEmin" 870 "DFC_TKARmax" 871 "DFC_TKARnpl" 872 "DFC_TMmax_Dummy" 873 "DFC_TUMmax_Dummy" 874 "DFC_TWCDPriCatB1" 251 "DFC_UegoHeatrPrfmncLoS1B1" 422 "DFC_UEGOHeatrRlyPsOLS1B1" 423 "DFC_UEGOHeatrRlyPsSCBS1B1" 424 "DFC_UEGOHeatrRlyPsSCGS1B1" 471 "DFC_UegoHeatrStrtS1B1" 425 "DFC_UegoHeatrWireOlS1B1" 426 "DFC_UegoHeatrWireScbS1B1" 427 "DFC_UegoHeatrWireScgS1B1" 279 "DFC_UegoSigEcuAsicS1B1" 280 "DFC_UegoSigEcuComS1B1" 344 "DFC_UegoSigOperPlausS1B1" 281 "DFC_UegoSigSnsrS1B1" 282 "DFC_UegoSigWireOlApesS1B1" 283 "DFC_UegoSigWireOlIpeS1B1" 284 "DFC_UegoSigWireOlReS1B1" 285 "DFC_UegoSigWireRCmpS1B1" 286 "DFC_UegoSigWireScbS1B1" 287 "DFC_UegoSigWireScgS1B1" 903 "DFC_UEGOSnsrMntdS1B1" 252 "DFC_VehVAllPlaus" 253 "DFC_VehVNCSnsrElecFailr" 345 "DFC_VehVPhysRngHi" 407 "DFC_VehVPhysRngLo" 254 "DFC_VehVPlausCan" 255 "DFC_VehVPlausFco" 256 "DFC_VehVPlausPwr" 257 "DFC_VehVPlausV2N" 346 "DFC_VehVSclOutOL" 347 "DFC_VehVSclOutOT" 348 "DFC_VehVSclOutSCB" 349 "DFC_VehVSclOutSCG" 904 "DFC_VehVSig" 408 "DFC_VehVSigCan" 409 "DFC_VehVSigCanSafe" 350 "DFC_VehVSigFL" 351 "DFC_VehVSigFR" 352 "DFC_VehVSigRL" 353 "DFC_VehVSigRR" 354 "DFC_VehVSnsrARngHi" 355 "DFC_VehVSnsrBRngHi" 356 "DFC_VehVSpdRtyDiag" 258 "DFC_VehVSpdSnsrAElecFailr" 259 "DFC_VehVSpdSnsrBElecFailr" 410 "DFC_VlvLftFbOilPSnsrIntk11SRCMax" 411 "DFC_VlvLftFbOilPSnsrIntk11SRCMin" 905 "DFC_VlvLftFbSwtIntk11SpclFail" 906 "DFC_VlvLftFbSwtIntk11StdFail" DEFAULT_VALUE "---" /end COMPU_VTAB
/begin COMPU_METHOD DFES_OneToOne "" RAT_FUNC "%6.2" "-" COEFFS 0 1 0 0 0 1 /end COMPU_METHOD
/begin COMPU_METHOD dfp_verbal "" TAB_VERB "%6.3" "-" COMPU_TAB_REF dfp_verbal /end COMPU_METHOD
/begin COMPU_VTAB dfp_verbal "" TAB_VERB 83 0 "DFP_AAA" 1 "DFP_AAV" 2 "DFP_AAVE" 3 "DFP_AGRE" 4 "DFP_AGRS" 5 "DFP_DHFHD" 6 "DFP_DK" 7 "DFP_DK1P" 8 "DFP_DK2P" 9 "DFP_DKVS" 10 "DFP_DSKV" 11 "DFP_DSKVR" 12 "DFP_DSKVS" 13 "DFP_DSS" 14 "DFP_DSU" 15 "DFP_DVEE" 16 "DFP_DVEF" 17 "DFP_DVEFO" 18 "DFP_DVEL" 19 "DFP_DVEN" 20 "DFP_DVER" 21 "DFP_DVEU" 22 "DFP_DVEUB" 23 "DFP_DVEUW" 24 "DFP_DYLSU" 25 "DFP_ENWCS" 26 "DFP_ENWS" 27 "DFP_ENWSE" 28 "DFP_EONV" 29 "DFP_FP1P" 30 "DFP_FP2P" 31 "DFP_FRA" 32 "DFP_FST" 33 "DFP_FSTE" 34 "DFP_FSTR" 35 "DFP_FTDLA" 36 "DFP_HDR" 37 "DFP_HDRKH" 38 "DFP_HDRPL" 39 "DFP_HFM" 40 "DFP_HSH" 41 "DFP_HSHE" 42 "DFP_KAT" 43 "DFP_KPE" 44 "DFP_KS1" 45 "DFP_LLRH" 46 "DFP_LLRKH" 47 "DFP_LM" 48 "DFP_LSH" 49 "DFP_LZSR" 50 "DFP_MD" 51 "DFP_NWS" 52 "DFP_NWSE" 53 "DFP_ORA" 54 "DFP_PLLSU" 55 "DFP_PSR" 56 "DFP_PSR1" 57 "DFP_PSRB" 58 "DFP_PSRE" 59 "DFP_PSRP" 60 "DFP_PU" 61 "DFP_PUE" 62 "DFP_PUPL" 63 "DFP_PUR" 64 "DFP_STHDR" 65 "DFP_TA" 66 "DFP_TANKL" 67 "DFP_TANLCS" 68 "DFP_TANLPRC" 69 "DFP_TANLR" 70 "DFP_TASRCS" 71 "DFP_TASRE" 72 "DFP_TASRPRC" 73 "DFP_TASRR" 74 "DFP_TESF" 75 "DFP_TESG" 76 "DFP_TM" 77 "DFP_TMCS" 78 "DFP_TME" 79 "DFP_TMP" 80 "DFP_UB" 81 "DFP_VFZ" 82 "DFP_ZZZ" DEFAULT_VALUE "---" /end COMPU_VTAB
/begin COMPU_METHOD DINH_OneToOne "" RAT_FUNC "%6.2" "-" COEFFS 0 1 0 0 0 1 /end COMPU_METHOD
/begin COMPU_METHOD DSCHED_FIdExcCauseVerb "" TAB_VERB "%6.3" "-" COMPU_TAB_REF DSCHED_FIdExcCauseVerb /end COMPU_METHOD
/begin COMPU_VTAB DSCHED_FIdExcCauseVerb "" TAB_VERB 31 0 "No_exclusion" 1 "FID_AFRA" 2 "FID_AORA" 3 "FID_ATEH" 4 "FID_ATEL" 5 "FID_ATEN" 6 "FID_ATLDI" 7 "FID_ATLDO" 8 "FID_BEONV" 9 "FId_EGSDCmnSeg1B1Parl" 10 "FID_BAGRA" 11 "FID_BAGRASD" 12 "FID_BDSTOF" 13 "FID_BFVDFRM" 14 "FID_BHOM" 15 "FID_BLLRH" 16 "FID_BLLRKH" 17 "FID_BPLSU" 18 "FID_FRAMBAVMB" 19 "FId_CatHeatgColdStrtReq" 20 "FId_CatHeatgWrmReq" 21 "FId_DSMBDEPHSpOpMode" 22 "FId_EGRVlvCoord" 23 "FId_EGSDO2FuTrmB1" 24 "FId_EGSDO2SnsrMntdRelsS1B1" 25 "FId_EGSDO2_LamOffsFastS1B1" 26 "FId_MisfDetDnAdpnNv" 27 "FId_bascadpncvo" 253 "NO_PRIO" 254 "MODE_IMPOSSIBLE" 255 "NO_RUN" DEFAULT_VALUE "---" /end COMPU_VTAB
/begin COMPU_METHOD DSCHED_StSimnSeln_C_Verb "" TAB_VERB "%6.3" "" COMPU_TAB_REF DSCHED_StSimnSeln_C_Verb /end COMPU_METHOD
/begin COMPU_VTAB DSCHED_StSimnSeln_C_Verb "" TAB_VERB 2 0 "No_Exclusion_Considered" 1 "Exclusion_Considered" /end COMPU_VTAB
/begin COMPU_METHOD DSCHED_StVerb "" TAB_VERB "%6.3" "-" COMPU_TAB_REF DSCHED_StVerb /end COMPU_METHOD
/begin COMPU_VTAB DSCHED_StVerb "" TAB_VERB 64 0 "____________________________" 2 "_____________________RawPerm" 4 "_________________Act________" 6 "_________________Act_RawPerm" 8 "_____________Lck____________" 10 "_____________Lck_____RawPerm" 12 "_____________Lck_Act________" 14 "_____________Lck_Act_RawPerm" 32 "_________Val________________" 34 "_________Val_________RawPerm" 36 "_________Val_____Act________" 38 "_________Val_____Act_RawPerm" 40 "_________Val_Lck____________" 42 "_________Val_Lck_____RawPerm" 44 "_________Val_Lck_Act________" 46 "_________Val_Lck_Act_RawPerm" 64 "____Perm____________________" 66 "____Perm_____________RawPerm" 68 "____Perm_________Act________" 70 "____Perm_________Act_RawPerm" 72 "____Perm_____Lck____________" 74 "____Perm_____Lck_____RawPerm" 76 "____Perm_____Lck_Act________" 78 "____Perm_____Lck_Act_RawPerm" 96 "____Perm_Val________________" 98 "____Perm_Val_________RawPerm" 100 "____Perm_Val_____Act________" 102 "____Perm_Val_____Act_RawPerm" 104 "____Perm_Val_Lck____________" 106 "____Perm_Val_Lck_____RawPerm" 108 "____Perm_Val_Lck_Act________" 110 "____Perm_Val_Lck_Act_RawPerm" 128 "Rdy_________________________" 130 "Rdy__________________RawPerm" 132 "Rdy______________Act________" 134 "Rdy______________Act_RawPerm" 136 "Rdy__________Lck____________" 138 "Rdy__________Lck_____RawPerm" 140 "Rdy__________Lck_Act________" 142 "Rdy__________Lck_Act_RawPerm" 160 "Rdy______Val________________" 162 "Rdy______Val_________RawPerm" 164 "Rdy______Val_____Act________" 166 "Rdy______Val_____Act_RawPerm" 168 "Rdy______Val_Lck____________" 170 "Rdy______Val_Lck_____RawPerm" 172 "Rdy______Val_Lck_Act________" 174 "Rdy______Val_Lck_Act_RawPerm" 192 "Rdy_Perm____________________" 194 "Rdy_Perm_____________RawPerm" 196 "Rdy_Perm_________Act________" 198 "Rdy_Perm_________Act_RawPerm" 200 "Rdy_Perm_____Lck____________" 202 "Rdy_Perm_____Lck_____RawPerm" 204 "Rdy_Perm_____Lck_Act________" 206 "Rdy_Perm_____Lck_Act_RawPerm" 224 "Rdy_Perm_Val________________" 226 "Rdy_Perm_Val_________RawPerm" 228 "Rdy_Perm_Val_____Act________" 230 "Rdy_Perm_Val_____Act_RawPerm" 232 "Rdy_Perm_Val_Lck____________" 234 "Rdy_Perm_Val_Lck_____RawPerm" 236 "Rdy_Perm_Val_Lck_Act________" 238 "Rdy_Perm_Val_Lck_Act_RawPerm" /end COMPU_VTAB
/begin COMPU_METHOD DSCHED_VirtStVerb "" TAB_VERB "%6.3" "NO" COMPU_TAB_REF DSCHED_VirtStVerb /end COMPU_METHOD
/begin COMPU_VTAB DSCHED_VirtStVerb "" TAB_VERB 8 0 "____________________________" 8 "_____________Lck____________" 64 "____Perm____________________" 72 "____Perm_____Lck____________" 128 "Rdy_________________________" 136 "Rdy__________Lck____________" 192 "Rdy_Perm____________________" 200 "Rdy_Perm_____Lck____________" /end COMPU_VTAB
/begin COMPU_METHOD DSMAUX_stDCyVerb "" TAB_VERB "%6.3" "-" COMPU_TAB_REF DSMAUX_stDCyVerb /end COMPU_METHOD
/begin COMPU_VTAB DSMAUX_stDCyVerb "" TAB_VERB 4 0 "DCy_New" 1 "DCy_Qualified" 2 "DCy_KeyOnCyc" 3 "DCy_Completed" /end COMPU_VTAB
/begin COMPU_METHOD DSMDUR_10m_Counter "" RAT_FUNC "%6.4" "km" COEFFS 0 100 0 0 0 1 /end COMPU_METHOD
/begin COMPU_METHOD DSMDur_EvntSel_Verb "" TAB_VERB "%6.3" "-" COMPU_TAB_REF DSMDur_EvntSel_Verb /end COMPU_METHOD
/begin COMPU_VTAB DSMDur_EvntSel_Verb "" TAB_VERB 5 0 "NoCountEvent" 1 "DistanceEvents" 2 "TimeEvents" 4 "WarmUpCycleEvents" 8 "DistanceEvents10m" /end COMPU_VTAB
/begin COMPU_METHOD DSMDUR_MICntr_COMPU "" RAT_FUNC "%6.2" "h" COEFFS 0 1 0 0 0 1 /end COMPU_METHOD
/begin COMPU_METHOD DSMDUR_MISubCntr_COMPU "" RAT_FUNC "%7.6" "h" COEFFS 0 36000 0 0 0 1 /end COMPU_METHOD
/begin COMPU_METHOD DSMDur_StDispl_Verb "" TAB_VERB "%6.3" "-" COMPU_TAB_REF DSMDur_StDispl_Verb /end COMPU_METHOD
/begin COMPU_VTAB DSMDur_StDispl_Verb "" TAB_VERB 3 0 "NotEnabled" 1 "CountingEnabled" 2 "ResetCondition" /end COMPU_VTAB
/begin COMPU_METHOD DSMRdy_OneToOne "" RAT_FUNC "%6.2" "-" COEFFS 0 1 0 0 0 1 /end COMPU_METHOD
/begin COMPU_METHOD EXHMGT_CPTPROTNGOVRREDNFILLG_SC_Compu "" TAB_VERB "%6.3" "" COMPU_TAB_REF EXHMGT_CPTPROTNGOVRREDNFILLG_SC_Compu /end COMPU_METHOD
/begin COMPU_VTAB EXHMGT_CPTPROTNGOVRREDNFILLG_SC_Compu "" TAB_VERB 2 0 "False" 1 "True" /end COMPU_VTAB
/begin COMPU_METHOD EXHMGT_CPTPROTNGOVR_SC_Compu "" TAB_VERB "%6.3" "" COMPU_TAB_REF EXHMGT_CPTPROTNGOVR_SC_Compu /end COMPU_METHOD
/begin COMPU_VTAB EXHMGT_CPTPROTNGOVR_SC_Compu "" TAB_VERB 2 0 "False" 1 "True" /end COMPU_VTAB
/begin COMPU_METHOD EXHMGT_CPTPROTNPREIGN_SC_Compu "" TAB_VERB "%6.3" "" COMPU_TAB_REF EXHMGT_CPTPROTNPREIGN_SC_Compu /end COMPU_METHOD
/begin COMPU_VTAB EXHMGT_CPTPROTNPREIGN_SC_Compu "" TAB_VERB 2 0 "False" 1 "True" /end COMPU_VTAB
/begin COMPU_METHOD EXHMGT_CPTPROTNTRRNMOD_SC_Compu "" TAB_VERB "%6.3" "" COMPU_TAB_REF EXHMGT_CPTPROTNTRRNMOD_SC_Compu /end COMPU_METHOD
/begin COMPU_VTAB EXHMGT_CPTPROTNTRRNMOD_SC_Compu "" TAB_VERB 2 0 "False" 1 "True" /end COMPU_VTAB
/begin COMPU_METHOD EXHMGT_CYLINDCPTPROTN_SC_Compu "" TAB_VERB "%6.3" "" COMPU_TAB_REF EXHMGT_CYLINDCPTPROTN_SC_Compu /end COMPU_METHOD
/begin COMPU_VTAB EXHMGT_CYLINDCPTPROTN_SC_Compu "" TAB_VERB 2 0 "False" 1 "True" /end COMPU_VTAB
/begin COMPU_METHOD EXHMGT_DEACTVNDIAGIGNHYB_SC_Compu "" TAB_VERB "%6.3" "" COMPU_TAB_REF EXHMGT_DEACTVNDIAGIGNHYB_SC_Compu /end COMPU_METHOD
/begin COMPU_VTAB EXHMGT_DEACTVNDIAGIGNHYB_SC_Compu "" TAB_VERB 2 0 "False" 1 "True" /end COMPU_VTAB
/begin COMPU_METHOD EXHMGT_DEACTVNINJCPTPROTN_SC_Compu "" TAB_VERB "%6.3" "" COMPU_TAB_REF EXHMGT_DEACTVNINJCPTPROTN_SC_Compu /end COMPU_METHOD
/begin COMPU_VTAB EXHMGT_DEACTVNINJCPTPROTN_SC_Compu "" TAB_VERB 2 0 "False" 1 "True" /end COMPU_VTAB
/begin COMPU_METHOD EXHMGT_DMDCATHEATGDESOXTWC_SC_Compu "" TAB_VERB "%6.3" "" COMPU_TAB_REF EXHMGT_DMDCATHEATGDESOXTWC_SC_Compu /end COMPU_METHOD
/begin COMPU_VTAB EXHMGT_DMDCATHEATGDESOXTWC_SC_Compu "" TAB_VERB 2 0 "False" 1 "True" /end COMPU_VTAB
/begin COMPU_METHOD EXHMGT_ENAFEATTQINNRLIMNCATHEATG_SC_Compu "" TAB_VERB "%6.3" "" COMPU_TAB_REF EXHMGT_ENAFEATTQINNRLIMNCATHEATG_SC_Compu /end COMPU_METHOD
/begin COMPU_VTAB EXHMGT_ENAFEATTQINNRLIMNCATHEATG_SC_Compu "" TAB_VERB 2 0 "EXHMGT_ENAFEATTQINNRLIMNCATHEATG_SC = 0" 1 "EXHMGT_ENAFEATTQINNRLIMNCATHEATG_SC = 1" /end COMPU_VTAB
/begin COMPU_METHOD EXHMGT_ERRHNDLGCPTPROTN_SC_Compu "" TAB_VERB "%6.3" "" COMPU_TAB_REF EXHMGT_ERRHNDLGCPTPROTN_SC_Compu /end COMPU_METHOD
/begin COMPU_VTAB EXHMGT_ERRHNDLGCPTPROTN_SC_Compu "" TAB_VERB 2 0 "False" 1 "True" /end COMPU_VTAB
/begin COMPU_METHOD EXHMGT_KNKCTRLCPTPROTN_SC_Compu "" TAB_VERB "%6.3" "" COMPU_TAB_REF EXHMGT_KNKCTRLCPTPROTN_SC_Compu /end COMPU_METHOD
/begin COMPU_VTAB EXHMGT_KNKCTRLCPTPROTN_SC_Compu "" TAB_VERB 2 0 "False" 1 "True" /end COMPU_VTAB
/begin COMPU_METHOD EXHMGT_LAMONECNCPTCPTPROTN_SC_Compu "" TAB_VERB "%6.3" "" COMPU_TAB_REF EXHMGT_LAMONECNCPTCPTPROTN_SC_Compu /end COMPU_METHOD
/begin COMPU_VTAB EXHMGT_LAMONECNCPTCPTPROTN_SC_Compu "" TAB_VERB 2 0 "False" 1 "True" /end COMPU_VTAB
/begin COMPU_METHOD EXHMGT_MFLOWFCOINHBNCPTPROTN_SC_Compu "" TAB_VERB "%6.3" "" COMPU_TAB_REF EXHMGT_MFLOWFCOINHBNCPTPROTN_SC_Compu /end COMPU_METHOD
/begin COMPU_VTAB EXHMGT_MFLOWFCOINHBNCPTPROTN_SC_Compu "" TAB_VERB 2 0 "0" 1 "1" /end COMPU_VTAB
/begin COMPU_METHOD EXHMGT_NRBRICKCAT1_SC_Compu "" RAT_FUNC "%6.2" "" COEFFS 0 1 0 0 0 1 /end COMPU_METHOD
/begin COMPU_METHOD EXHMGT_NRBRICKCAT2_SC_Compu "" RAT_FUNC "%6.2" "" COEFFS 0 1 0 0 0 1 /end COMPU_METHOD
/begin COMPU_METHOD EXHMGT_POSNCATNSC1_SC_Compu "" TAB_VERB "%6.3" "" COMPU_TAB_REF EXHMGT_POSNCATNSC1_SC_Compu /end COMPU_METHOD
/begin COMPU_VTAB EXHMGT_POSNCATNSC1_SC_Compu "" TAB_VERB 5 0 "NSC1_NO" 1 "NSC1_CAT1" 2 "NSC1_CAT2" 3 "NSC1_CAT3" 4 "NSC1_CAT4" /end COMPU_VTAB
/begin COMPU_METHOD EXHMGT_PTSTANDDECOUPLENA_SC_Compu "" TAB_VERB "%6.3" "" COMPU_TAB_REF EXHMGT_PTSTANDDECOUPLENA_SC_Compu /end COMPU_METHOD
/begin COMPU_VTAB EXHMGT_PTSTANDDECOUPLENA_SC_Compu "" TAB_VERB 2 0 "False" 1 "True" /end COMPU_VTAB
/begin COMPU_METHOD EXHMGT_SECAIRVLVCTRL2ECU_SC_Compu "" TAB_VERB "%6.3" "" COMPU_TAB_REF EXHMGT_SECAIRVLVCTRL2ECU_SC_Compu /end COMPU_METHOD
/begin COMPU_VTAB EXHMGT_SECAIRVLVCTRL2ECU_SC_Compu "" TAB_VERB 2 0 "False" 1 "True" /end COMPU_VTAB
/begin COMPU_METHOD OneToOne "" RAT_FUNC "%6.2" "-" COEFFS 0 1 0 0 0 1 /end COMPU_METHOD
/begin COMPU_METHOD Prc "" RAT_FUNC "%6.4" "%" COEFFS 0 81.92 0 0 0 1 /end COMPU_METHOD
/begin COMPU_METHOD Pres_hPa "" RAT_FUNC "%6.2" "hPa" COEFFS 0 1 0 0 0 1 /end COMPU_METHOD
/begin COMPU_METHOD TempDiff_Kelv "" RAT_FUNC "%6.3" "K" COEFFS 0 10 0 0 0 1 /end COMPU_METHOD
/begin COMPU_METHOD Temp_Cels "" RAT_FUNC "%6.1" "deg C" COEFFS 0 10 2731.4 0 0 1 /end COMPU_METHOD
/begin COMPU_METHOD Vel "" RAT_FUNC "%6.4" "km/h" COEFFS 0 100 0 0 0 1 /end COMPU_METHOD
/begin RECORD_LAYOUT KwUb FNC_VALUES 1 UBYTE COLUMN_DIR DIRECT /end RECORD_LAYOUT
/begin RECORD_LAYOUT RB_ValA_Wu16 FNC_VALUES 1 UWORD COLUMN_DIR DIRECT /end RECORD_LAYOUT
/begin RECORD_LAYOUT ValA_Wu16 FNC_VALUES 1 UWORD COLUMN_DIR DIRECT /end RECORD_LAYOUT
/begin RECORD_LAYOUT ValA_Wu8 FNC_VALUES 1 UBYTE COLUMN_DIR DIRECT /end RECORD_LAYOUT
/begin RECORD_LAYOUT Val_Ws16 FNC_VALUES 1 SWORD COLUMN_DIR DIRECT /end RECORD_LAYOUT
/begin RECORD_LAYOUT Val_Wu16 FNC_VALUES 1 UWORD COLUMN_DIR DIRECT /end RECORD_LAYOUT
/begin RECORD_LAYOUT Val_Wu32 FNC_VALUES 1 ULONG COLUMN_DIR DIRECT /end RECORD_LAYOUT
/begin RECORD_LAYOUT Val_Wu8 FNC_VALUES 1 UBYTE COLUMN_DIR DIRECT /end RECORD_LAYOUT
/end MODULE
/end PROJECT
