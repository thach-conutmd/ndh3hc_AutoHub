ASAP2_VERSION 1 60
/begin PROJECT MG1CS022 "MG1CS022"
/begin HEADER "" VERSION "MG1CS022_62XSC_V037" PROJECT_NO MG1CS022 /end HEADER
/begin MODULE DIM ""
/begin MOD_COMMON "" BYTE_ORDER MSB_LAST ALIGNMENT_BYTE 1 ALIGNMENT_WORD 2 ALIGNMENT_LONG 4 ALIGNMENT_INT64 4 ALIGNMENT_FLOAT32_IEEE 4 ALIGNMENT_FLOAT64_IEEE 4 DATA_SIZE 32 /end MOD_COMMON
/begin CHARACTERISTIC MDNORM "maximum limit indicate engine torque standardization" VALUE 0x8057F426 RB_Val_Wu8 2520. md_ub_q10 30. 2550. FORMAT "%5.0" EXTENDED_LIMITS 0.00 2550. /end CHARACTERISTIC
/begin CHARACTERISTIC PT_rTraGear1_C "ratio of transition to 1. gear" VALUE 0x805804BC RB_Val_Ws16 655.3500 TransR -327.6800 327.6700 FORMAT "%8.4" /end CHARACTERISTIC
/begin CHARACTERISTIC PT_rTraGear2_C "ratio of transition to 2. gear" VALUE 0x805804BE RB_Val_Ws16 655.3500 TransR -327.6800 327.6700 FORMAT "%8.4" /end CHARACTERISTIC
/begin CHARACTERISTIC PT_rTraGear3_C "ratio of transition to 3. gear" VALUE 0x805804C0 RB_Val_Ws16 655.3500 TransR -327.6800 327.6700 FORMAT "%8.4" /end CHARACTERISTIC
/begin CHARACTERISTIC PT_rTraGear4_C "ratio of transition to 4. gear" VALUE 0x805804C2 RB_Val_Ws16 655.3500 TransR -327.6800 327.6700 FORMAT "%8.4" /end CHARACTERISTIC
/begin CHARACTERISTIC PT_rTraGear5_C "ratio of transition to 5. gear" VALUE 0x805804C4 RB_Val_Ws16 655.3500 TransR -327.6800 327.6700 FORMAT "%8.4" /end CHARACTERISTIC
/begin CHARACTERISTIC PT_rTraGear6_C "ratio of transition to 6. gear" VALUE 0x805804C6 RB_Val_Ws16 655.3500 TransR -327.6800 327.6700 FORMAT "%8.4" /end CHARACTERISTIC
/begin CHARACTERISTIC PT_rTraGear7_C "ratio of transition to 7. gear" VALUE 0x805804C8 RB_Val_Ws16 655.3500 TransR -327.6800 327.6700 FORMAT "%8.4" /end CHARACTERISTIC
/begin CHARACTERISTIC PT_rTraGear8_C "ratio of transition to 8. gear" VALUE 0x805804CA RB_Val_Ws16 655.3500 TransR -327.6800 327.6700 FORMAT "%8.4" /end CHARACTERISTIC
/begin CHARACTERISTIC PT_rTraGear9_C "ratio of transition to 9. gear" VALUE 0x805804CC RB_Val_Ws16 655.3500 TransR -327.6800 327.6700 FORMAT "%8.4" /end CHARACTERISTIC
/begin CHARACTERISTIC PT_rTraGearR_C "ratio of transition to reverse gear" VALUE 0x805804CE RB_Val_Ws16 655.3500 TransR -327.6800 327.6700 FORMAT "%8.4" /end CHARACTERISTIC
/begin CHARACTERISTIC PT_rTraLoRng_C "Calibration for ratio of low range" VALUE 0x805804D0 RB_Val_Ws16 655.3500 TransR -327.6800 327.6700 FORMAT "%8.4" /end CHARACTERISTIC
/begin CHARACTERISTIC PT_rTraMax_C "maximum ratio of transmission" VALUE 0x805804D2 RB_Val_Ws16 655.3500 TransR -327.6800 327.6700 FORMAT "%8.4" /end CHARACTERISTIC
/begin CHARACTERISTIC Tra_ATFCUpInh.tiHiLo_C "Time period for detecting injection cut-off to set up shift inhibit status / Time for a High to Low transition" VALUE 0x80591AD4 Kw_Ws16 655350.0 TimeDeb -327680.0 327670.0 FORMAT "%8.1" /end CHARACTERISTIC
/begin CHARACTERISTIC Tra_ATFCUpInh.tiLoHi_C "Time period for detecting injection cut-off to set up shift inhibit status / Time for a Low to High transition" VALUE 0x80591AD6 Kw_Ws16 655350.0 TimeDeb -327680.0 327670.0 FORMAT "%8.1" /end CHARACTERISTIC
/begin CHARACTERISTIC Tra_bAST_C "Status AST-Intervention active" VALUE 0x80581770 Val_Wu8 255.0 OneToOne 0.00 255.0 FORMAT "%5.1" /end CHARACTERISTIC
/begin CHARACTERISTIC Tra_bCanAirCanPtd_C "condition relative fan cooling capacity from CAN" VALUE 0x805804B4 RB_Val_Wu8 1.00000000000 B_TRUE 0.00 1.00000000000 FORMAT "%13.11" /end CHARACTERISTIC
/begin CHARACTERISTIC Tra_bCANASTIntv_C "Status AST-Intervention via CAN" VALUE 0x80581771 Val_Wu8 255.0 OneToOne 0.00 255.0 FORMAT "%5.1" /end CHARACTERISTIC
/begin CHARACTERISTIC Tra_bCanClntCanPtd_C "condition coolant temperature - set point value - from CAN" VALUE 0x805804B5 RB_Val_Wu8 1.00000000000 B_TRUE 0.00 1.00000000000 FORMAT "%13.11" /end CHARACTERISTIC
/begin CHARACTERISTIC Tra_bCanGearShftActv_C "Information gear shift active used via CAN" VALUE 0x805804D4 RB_Val_Wu8 1.00000000000 B_TRUE 0.00 1.00000000000 FORMAT "%13.11" /end CHARACTERISTIC
/begin CHARACTERISTIC Tra_bCANIdlSetP_C "Status gearbox low-idle speed increase via CAN" VALUE 0x80581772 Val_Wu8 255.0 OneToOne 0.00 255.0 FORMAT "%5.1" /end CHARACTERISTIC
/begin CHARACTERISTIC Tra_bCanInfoCan_C "condition ""information CAN"" is possible from CAN" VALUE 0x805804D5 RB_Val_Wu8 1.00000000000 B_TRUE 0.00 1.00000000000 FORMAT "%13.11" /end CHARACTERISTIC
/begin CHARACTERISTIC Tra_bCanLevPos_C "condition gear lever position from CAN" VALUE 0x805804D6 RB_Val_Wu8 1.00000000000 B_TRUE 0.00 1.00000000000 FORMAT "%13.11" /end CHARACTERISTIC
/begin CHARACTERISTIC Tra_bCanLoRng_C "condition gear reduction from CAN" VALUE 0x805804D7 RB_Val_Wu8 1.00000000000 B_TRUE 0.00 1.00000000000 FORMAT "%13.11" /end CHARACTERISTIC
/begin CHARACTERISTIC Tra_bCanPlausDecIntvDes_C "Condition decreasing transmission intervention plausible" VALUE 0x805817B0 RB_Val_Wu8 1.00000000000 B_TRUE 0.00 1.00000000000 FORMAT "%13.11" /end CHARACTERISTIC
/begin CHARACTERISTIC Tra_bCanPlausDecIntvLead_C "Condition decreasing transmission intervention plausible" VALUE 0x805817B1 RB_Val_Wu8 1.00000000000 B_TRUE 0.00 1.00000000000 FORMAT "%13.11" /end CHARACTERISTIC
/begin CHARACTERISTIC Tra_bCanPlausIncIntvDes_C "Condition increasing transmission intervention plausible" VALUE 0x805817B2 RB_Val_Wu8 1.00000000000 B_TRUE 0.00 1.00000000000 FORMAT "%13.11" /end CHARACTERISTIC
/begin CHARACTERISTIC Tra_bCanPlausIncIntvLead_C "Condition increasing transmission intervention plausible" VALUE 0x805817B3 RB_Val_Wu8 1.00000000000 B_TRUE 0.00 1.00000000000 FORMAT "%13.11" /end CHARACTERISTIC
/begin CHARACTERISTIC Tra_bCanRevGear_C "condition the information actual gear = regverse gear from CAN" VALUE 0x805804D8 RB_Val_Wu8 1.00000000000 B_TRUE 0.00 1.00000000000 FORMAT "%13.11" /end CHARACTERISTIC
/begin CHARACTERISTIC Tra_bCanRTra_C "condition current torque ratio of the gearbox (exclusive converter) from CAN" VALUE 0x805804D9 RB_Val_Wu8 1.00000000000 B_TRUE 0.00 1.00000000000 FORMAT "%13.11" /end CHARACTERISTIC
/begin CHARACTERISTIC Tra_bFltIdlSpdDes_C "Adopt status gearbox low-idle speed increase unfiltered or filtered" VALUE 0x80581773 Val_Wu8 255.0 OneToOne 0.00 255.0 FORMAT "%5.1" /end CHARACTERISTIC
/begin CHARACTERISTIC Tra_bGbxNPosEna_C "activate reading HW switch for neutral position of lever posoition" VALUE 0x805804DA RB_Val_Wu8 1.00000000000 B_TRUE 0.00 1.00000000000 FORMAT "%13.11" /end CHARACTERISTIC
/begin CHARACTERISTIC Tra_bIgnRtdtCtlSeln_C "Calibration switch to enable the Ignition retard control" VALUE 0x805817B4 RB_Val_Wu8 1.00000000000 B_TRUE 0.00 1.00000000000 FORMAT "%13.11" /end CHARACTERISTIC
/begin CHARACTERISTIC Tra_bStrtStopEnaDfl_C "Default value to enable start/stop function" VALUE 0x805804DB RB_Val_Wu8 1.00000000000 B_TRUE 0.00 1.00000000000 FORMAT "%13.11" /end CHARACTERISTIC
/begin CHARACTERISTIC Tra_ctMovAvrg_C "the number of times of moving for the moving averaging" VALUE 0x80580570 Val_Wu8 9.000 OneToOne 1.00 10.00 FORMAT "%5.2" EXTENDED_LIMITS 0.00 255.0 /end CHARACTERISTIC
/begin CHARACTERISTIC Tra_dTqNegValDecrIntvEndRamp_C "Negative torque slope for forming the end of decreasing transmission interventions" VALUE 0x805817B8 RB_Val_Ws32 6553599.99847 RmpTrq -3276800.00000 3276799.99847 FORMAT "%13.5" /end CHARACTERISTIC
/begin CHARACTERISTIC Tra_dTqNegValIncIntvEndRamp_C "Negative torque slope for forming the end of increasing transmission interventions" VALUE 0x805817BC RB_Val_Ws32 6553599.99847 RmpTrq -3276800.00000 3276799.99847 FORMAT "%13.5" /end CHARACTERISTIC
/begin CHARACTERISTIC Tra_dTqPosValDecrIntvEndRamp_C "Positive torque slope for forming the end of decreasing transmission interventions" VALUE 0x805817C0 RB_Val_Ws32 6553599.99847 RmpTrq -3276800.00000 3276799.99847 FORMAT "%13.5" /end CHARACTERISTIC
/begin CHARACTERISTIC Tra_dTqPosValIncIntvEndRamp_C "Positive torque slope for forming the end of increasing transmission interventions" VALUE 0x805817C4 RB_Val_Ws32 6553599.99847 RmpTrq -3276800.00000 3276799.99847 FORMAT "%13.5" /end CHARACTERISTIC
/begin CHARACTERISTIC Tra_dtqPrtRmpNeg_C "Negative ramp value for transmission protection" VALUE 0x805815E0 RB_Val_Ws32 6553599.99847 RmpTrq -3276800.00000 3276799.99847 FORMAT "%13.5" /end CHARACTERISTIC
/begin CHARACTERISTIC Tra_dtqPrtRmpPos_C "Positive ramp value for transmission protection" VALUE 0x805815E4 RB_Val_Ws32 6553599.99847 RmpTrq -3276800.00000 3276799.99847 FORMAT "%13.5" /end CHARACTERISTIC
/begin CHARACTERISTIC Tra_dtqSpcReasNegSlp_C "Negative slope for the transition to protection torque for specific reasons" VALUE 0x805815E8 RB_Val_Ws32 6553599.99847 RmpTrq -3276800.00000 3276799.99847 FORMAT "%13.5" /end CHARACTERISTIC
/begin CHARACTERISTIC Tra_dtrqRmpTIIDes_INST.Neg_C "ramp parameter / Parameter for ramp function" VALUE 0x805819BC RB_Val_Ws32 6553599.99847 RmpTrq -3276800.00000 3276799.99847 FORMAT "%13.5" /end CHARACTERISTIC
/begin CHARACTERISTIC Tra_dtrqRmpTIIDes_INST.Pos_C "ramp parameter / Parameter for ramp function" VALUE 0x805819C0 RB_Val_Ws32 6553599.99847 RmpTrq -3276800.00000 3276799.99847 FORMAT "%13.5" /end CHARACTERISTIC
/begin CHARACTERISTIC Tra_dtrqRmpTIILead_INST.Neg_C "ramp parameter / Parameter for ramp function" VALUE 0x805819C4 RB_Val_Ws32 6553599.99847 RmpTrq -3276800.00000 3276799.99847 FORMAT "%13.5" /end CHARACTERISTIC
/begin CHARACTERISTIC Tra_dtrqRmpTIILead_INST.Pos_C "ramp parameter / Parameter for ramp function" VALUE 0x805819C8 RB_Val_Ws32 6553599.99847 RmpTrq -3276800.00000 3276799.99847 FORMAT "%13.5" /end CHARACTERISTIC
/begin CHARACTERISTIC Tra_dtrqRmpTSCDes_INST.Neg_C "ramp parameter / Parameter for ramp function" VALUE 0x805819CC RB_Val_Ws32 6553599.99847 RmpTrq -3276800.00000 3276799.99847 FORMAT "%13.5" /end CHARACTERISTIC
/begin CHARACTERISTIC Tra_dtrqRmpTSCDes_INST.Pos_C "ramp parameter / Parameter for ramp function" VALUE 0x805819D0 RB_Val_Ws32 6553599.99847 RmpTrq -3276800.00000 3276799.99847 FORMAT "%13.5" /end CHARACTERISTIC
/begin CHARACTERISTIC Tra_dtrqRmpTSCLead_INST.Neg_C "ramp parameter / Parameter for ramp function" VALUE 0x805819D4 RB_Val_Ws32 6553599.99847 RmpTrq -3276800.00000 3276799.99847 FORMAT "%13.5" /end CHARACTERISTIC
/begin CHARACTERISTIC Tra_dtrqRmpTSCLead_INST.Pos_C "ramp parameter / Parameter for ramp function" VALUE 0x805819D8 RB_Val_Ws32 6553599.99847 RmpTrq -3276800.00000 3276799.99847 FORMAT "%13.5" /end CHARACTERISTIC
/begin CHARACTERISTIC Tra_facUpSpdCor_MAP "MAP of the correction factor for gear shift up indication" MAP 0x80580572 RB_Map_S16S16_S16 10.00000 Fact3 0.00 10.00000 FORMAT "%8.5" EXTENDED_LIMITS -327.6800 327.6700
 /begin AXIS_DESCR STD_AXIS Tra_numDispGear OneToOne 8 -1.000 6.000 FORMAT "%5.3" EXTENDED_LIMITS -32768. 32767. DEPOSIT ABSOLUTE /end AXIS_DESCR
 /begin AXIS_DESCR STD_AXIS Tra_rSlpEstFlt_mp Prc 16 -50.00000 50.00000 FORMAT "%8.5" EXTENDED_LIMITS -400.0000 399.9878 DEPOSIT ABSOLUTE /end AXIS_DESCR
/end CHARACTERISTIC
/begin CHARACTERISTIC Tra_flgAppOffSwtEna_C "Switch enable condition for APP off" VALUE 0x805806A6 Val_Wu8 1.00000000000 B_TRUE 0.00 1.00000000000 FORMAT "%13.11" /end CHARACTERISTIC
/begin CHARACTERISTIC Tra_flgCVTLeadTrqCalcn_C "Flag to select Slow Torque Values for Decreasing torque intervention" VALUE 0x805817C8 RB_Val_Wu8 1.00000000000 B_TRUE 0.00 1.00000000000 FORMAT "%13.11" /end CHARACTERISTIC
/begin CHARACTERISTIC Tra_flgRampEndOfDecIntv_C "Switch to activate the forming of the end of decreasing transmission interventions via the engine control unit" VALUE 0x805817C9 RB_Val_Wu8 1.00000000000 B_TRUE 0.00 1.00000000000 FORMAT "%13.11" /end CHARACTERISTIC
/begin CHARACTERISTIC Tra_flgRampEndOfIncrIntv_C "Switch to activate ramping of end of increasing transmission interventions" VALUE 0x805817CA RB_Val_Wu8 1.00000000000 B_TRUE 0.00 1.00000000000 FORMAT "%13.11" /end CHARACTERISTIC
/begin CHARACTERISTIC Tra_flgSwtDecTrsmIntvActvTrq_C "Switch to select between detection of an active decreasing transmission intervention by comparing the intervention torque with a calibratable threshold, or by taking the bit information from the transmission" VALUE 0x805817CB RB_Val_Wu8 1.00000000000 B_TRUE 0.00 1.00000000000 FORMAT "%13.11" /end CHARACTERISTIC
/begin CHARACTERISTIC Tra_flgSwtIncTrsmIntvActvTrq_C "Switch to select between detection of an active increasing transmission intervention by comparing the intervention torque with a calibratable threshold, or by taking the bit information from the transmission" VALUE 0x805817CC RB_Val_Wu8 1.00000000000 B_TRUE 0.00 1.00000000000 FORMAT "%13.11" /end CHARACTERISTIC
/begin CHARACTERISTIC Tra_flgSwtNoGearProtnTrq_C "Switch for aktivation of transmission protection torque when no gear information available" VALUE 0x805815EC RB_Val_Wu8 1.00000000000 B_TRUE 0.00 1.00000000000 FORMAT "%13.11" /end CHARACTERISTIC
/begin CHARACTERISTIC Tra_flgTrqIntvSeln_C "Flag to select Fast Torque Values for Decreasing torque intervention" VALUE 0x805817CD RB_Val_Wu8 1.00000000000 B_TRUE 0.00 1.00000000000 FORMAT "%13.11" /end CHARACTERISTIC
/begin CHARACTERISTIC Tra_flgTrqRedFunc_C "Flag to enable or disable the functionality for gearbox damage prevention when injection cutoff is not possible" VALUE 0x805817CE RB_Val_Wu8 1.00000000000 B_TRUE 0.00 1.00000000000 FORMAT "%13.11" /end CHARACTERISTIC
/begin CHARACTERISTIC Tra_frBaseAftShft_MAP "MAP of the maximum force after gear shift up" MAP 0x805806A8 RB_Map_S16S16_S16 65535.00 DrvFr -32768.00 32767.00 FORMAT "%8.2"
 /begin AXIS_DESCR STD_AXIS Tra_numGear1_mp OneToOne 8 -32768.00 32767.00 FORMAT "%8.2" DEPOSIT ABSOLUTE /end AXIS_DESCR
 /begin AXIS_DESCR STD_AXIS VehV_v Vel 16 -327.6800 327.6700 FORMAT "%8.4" DEPOSIT ABSOLUTE /end AXIS_DESCR
/end CHARACTERISTIC
/begin CHARACTERISTIC Tra_frNeed2ShftUp_CUR "Curve of threshold of spare force to gear shift up" CURVE 0x805807DC RB_Curve_S16_S16 20000.00 DrvFr -10000.00 10000.00 FORMAT "%8.2" EXTENDED_LIMITS -32768.00 32767.00
 /begin AXIS_DESCR STD_AXIS Tra_rSlpEst_mp Prc 7 -50.0000000000 50.0000000000 FORMAT "%13.10" EXTENDED_LIMITS -400.000000000 399.987792969 DEPOSIT ABSOLUTE /end AXIS_DESCR
/end CHARACTERISTIC
/begin CHARACTERISTIC Tra_frNeedAftShft_MAP "MAP of the driving resistance depends on slope after shift up" MAP 0x805807FA RB_Map_S16S16_S16 20000.00 DrvFr -10000.00 10000.00 FORMAT "%8.2" EXTENDED_LIMITS -32768.00 32767.00
 /begin AXIS_DESCR STD_AXIS Tra_vBaseShftUpCor_mp Vel 16 0.00 300.0000 FORMAT "%8.4" EXTENDED_LIMITS -327.6800 327.6700 DEPOSIT ABSOLUTE /end AXIS_DESCR
 /begin AXIS_DESCR STD_AXIS Tra_rSlpEst_mp Prc 16 -50.0000000000 50.0000000000 FORMAT "%13.10" EXTENDED_LIMITS -400.000000000 399.987792969 DEPOSIT ABSOLUTE /end AXIS_DESCR
/end CHARACTERISTIC
/begin CHARACTERISTIC Tra_frOutMax_MAP "MAP of the maximum force for shift indicator lamp" MAP 0x80580A3E RB_Map_S16S16_S16 65535.00 DrvFr -32768.00 32767.00 FORMAT "%8.2"
 /begin AXIS_DESCR STD_AXIS Tra_numDispGear OneToOne 8 -32768. 32767. FORMAT "%5.0" DEPOSIT ABSOLUTE /end AXIS_DESCR
 /begin AXIS_DESCR STD_AXIS VehV_v Vel 16 -327.6800 327.6700 FORMAT "%8.4" DEPOSIT ABSOLUTE /end AXIS_DESCR
/end CHARACTERISTIC
/begin CHARACTERISTIC Tra_frSlpEst_MAP "MAP of the driving resistance depends on slope" MAP 0x80580B72 RB_Map_S16S16_S16 20000.00 DrvFr -10000.00 10000.00 FORMAT "%8.2" EXTENDED_LIMITS -32768.00 32767.00
 /begin AXIS_DESCR STD_AXIS VehV_v Vel 16 0.00 300.0000 FORMAT "%8.4" EXTENDED_LIMITS -327.6800 327.6700 DEPOSIT ABSOLUTE /end AXIS_DESCR
 /begin AXIS_DESCR STD_AXIS Tra_rSlpEst_mp Prc 16 -50.0000000000 50.0000000000 FORMAT "%13.10" EXTENDED_LIMITS -400.000000000 399.987792969 DEPOSIT ABSOLUTE /end AXIS_DESCR
/end CHARACTERISTIC
/begin CHARACTERISTIC Tra_frSpr2Dwn_CUR "Curve of spare force to gear shift down" CURVE 0x80580DB6 RB_Curve_S16_S16 20000.00 DrvFr -10000.00 10000.00 FORMAT "%8.2" EXTENDED_LIMITS -32768.00 32767.00
 /begin AXIS_DESCR STD_AXIS Tra_rSlpEst_mp Prc 16 -50.0000000000 50.0000000000 FORMAT "%13.10" EXTENDED_LIMITS -400.000000000 399.987792969 DEPOSIT ABSOLUTE /end AXIS_DESCR
/end CHARACTERISTIC
/begin CHARACTERISTIC Tra_lRaTire_C "raduis of the tire" VALUE 0x80580DF8 Val_Ws16 327.6600 Length_m 0.0100 327.6700 FORMAT "%8.4" EXTENDED_LIMITS -327.6800 327.6700 /end CHARACTERISTIC
/begin CHARACTERISTIC Tra_mMsVeh_C "mass of the vehicle" VALUE 0x80580DFA Val_Ws16 3000.000 CarMass 0.00 3000.000 FORMAT "%8.3" EXTENDED_LIMITS -32768.00 32767.00 /end CHARACTERISTIC
/begin CHARACTERISTIC Tra_nASTDes_C "Substitute value for synchronisation speed" VALUE 0x80581774 Val_Ws16 32767.50 EngN -16384.00 16383.50 FORMAT "%8.2" /end CHARACTERISTIC
/begin CHARACTERISTIC Tra_nEngMin_C "minimum rpm of engine" VALUE 0x805804DC RB_Val_Ws16 32767.50 EngN -16384.00 16383.50 FORMAT "%8.2" /end CHARACTERISTIC
/begin CHARACTERISTIC Tra_nFrShftDwn_CUR "Curve of threshold of engine speed to shift down forcely" CURVE 0x80580DFC RB_Curve_S16_S16 10000.00 EngN 0.00 10000.00 FORMAT "%8.2" EXTENDED_LIMITS -16384.00 16383.50
 /begin AXIS_DESCR STD_AXIS Tra_numDispGear OneToOne 8 -1.000 6.000 FORMAT "%5.3" EXTENDED_LIMITS -32768. 32767. DEPOSIT ABSOLUTE /end AXIS_DESCR
/end CHARACTERISTIC
/begin CHARACTERISTIC Tra_nIdleDes_C "Substitute value for Synchronised desired engine speed." VALUE 0x80581776 Val_Ws16 32767.50 EngN -16384.00 16383.50 FORMAT "%8.2" /end CHARACTERISTIC
/begin CHARACTERISTIC Tra_nIdleDiagcReq_C "Idle speed during diagnostic request" VALUE 0x80591AD8 Val_Ws16 32767.50 EngN -16384.00 16383.50 FORMAT "%8.2" /end CHARACTERISTIC
/begin CHARACTERISTIC Tra_nIdleNeutPrkg_C "Idle target speed during Neutral or Parking" VALUE 0x80591ADA Val_Ws16 32767.50 EngN -16384.00 16383.50 FORMAT "%8.2" /end CHARACTERISTIC
/begin CHARACTERISTIC Tra_nIdleSpdRev_C "Idle speed during reverse" VALUE 0x80591ADC Val_Ws16 32767.50 EngN -16384.00 16383.50 FORMAT "%8.2" /end CHARACTERISTIC
/begin CHARACTERISTIC Tra_nInhShftDwnHys_C "hysteresis engine speed to inhibit shift down" VALUE 0x80580E1E Val_Ws16 10000.00 EngN 0.00 10000.00 FORMAT "%8.2" EXTENDED_LIMITS -16384.00 16383.50 /end CHARACTERISTIC
/begin CHARACTERISTIC Tra_nInhShftDwn_CUR "Engine speed value at Gear Shift down Inhibit status" CURVE 0x80580E20 RB_Curve_S16_S16 10000.00 EngN 0.00 10000.00 FORMAT "%8.2" EXTENDED_LIMITS -16384.00 16383.50
 /begin AXIS_DESCR STD_AXIS Tra_numDispGear OneToOne 7 -1.000 6.000 FORMAT "%5.3" EXTENDED_LIMITS -32768. 32767. DEPOSIT ABSOLUTE /end AXIS_DESCR
/end CHARACTERISTIC
/begin CHARACTERISTIC Tra_nMaxCanErrFco_CUR "Maximum Fuel Cut Off speed dependent on speed with reference to transmission with a CAN error" CURVE 0x80581778 RB_Curve_S16_S16 32767.50 EngN -16384.00 16383.50 FORMAT "%8.2"
 /begin AXIS_DESCR STD_AXIS Veh_Vel Vel 4 -327.6800 327.6700 FORMAT "%8.4" DEPOSIT ABSOLUTE /end AXIS_DESCR
/end CHARACTERISTIC
/begin CHARACTERISTIC Tra_nMaxCanErr_CUR "Maximum speed dependent on speed with reference to transmission with a CAN error." CURVE 0x8058178A RB_Curve_S16_S16 32767.50 EngN -16384.00 16383.50 FORMAT "%8.2"
 /begin AXIS_DESCR STD_AXIS Veh_Vel Vel 4 -327.6800 327.6700 FORMAT "%8.4" DEPOSIT ABSOLUTE /end AXIS_DESCR
/end CHARACTERISTIC
/begin CHARACTERISTIC Tra_nMaxEngFcoHi_C "Upper limit for Fuel cut off for max engine speed from CAN" VALUE 0x8058179C Val_Ws16 32767.50 EngN -16384.00 16383.50 FORMAT "%8.2" /end CHARACTERISTIC
/begin CHARACTERISTIC Tra_nMaxEngFcoLo_C "Lower limit for Fuel cut off for max engine speed from CAN" VALUE 0x8058179E Val_Ws16 32767.50 EngN -16384.00 16383.50 FORMAT "%8.2" /end CHARACTERISTIC
/begin CHARACTERISTIC Tra_nMaxEngTqLimHi_C "Upper limit for Maximum engine speed limitation request" VALUE 0x805817A0 Val_Ws16 32767.50 EngN -16384.00 16383.50 FORMAT "%8.2" /end CHARACTERISTIC
/begin CHARACTERISTIC Tra_nMaxEngTqLimLo_C "Lower limit for Maximum engine speed limitation request" VALUE 0x805817A2 Val_Ws16 32767.50 EngN -16384.00 16383.50 FORMAT "%8.2" /end CHARACTERISTIC
/begin CHARACTERISTIC Tra_nMax_C "maximum rotational speed for transmission" VALUE 0x805817A4 Val_Ws16 32767.50 EngN -16384.00 16383.50 FORMAT "%8.2" /end CHARACTERISTIC
/begin CHARACTERISTIC Tra_nMin_C "minimum rotational speed for transmission" VALUE 0x805817A6 Val_Ws16 32767.50 EngN -16384.00 16383.50 FORMAT "%8.2" /end CHARACTERISTIC
/begin CHARACTERISTIC Tra_nNeutrDetHi_C "high engine speed to detect neutral condition" VALUE 0x80580E3E Val_Ws16 10000.00 EngN 0.00 10000.00 FORMAT "%8.2" EXTENDED_LIMITS -16384.00 16383.50 /end CHARACTERISTIC
/begin CHARACTERISTIC Tra_nNeutrDetLo_C "low engine speed to detect neutral condition" VALUE 0x80580E40 Val_Ws16 10000.00 EngN 0.00 10000.00 FORMAT "%8.2" EXTENDED_LIMITS -16384.00 16383.50 /end CHARACTERISTIC
/begin CHARACTERISTIC Tra_numGearDisp_T "Curve for the conversion of Tra_numGearDisp to Tra_numGear" CURVE 0x80580E42 RB_Curve_S8_S8 255.0 OneToOne -128.0 127.0 FORMAT "%5.1"
 /begin AXIS_DESCR STD_AXIS Tra_numGearDisp OneToOne 9 -128.0 127.0 FORMAT "%5.1" DEPOSIT ABSOLUTE /end AXIS_DESCR
/end CHARACTERISTIC
/begin CHARACTERISTIC Tra_numGearMax_C "maximum gear number for gear shift up" VALUE 0x80580E56 Val_Ws16 7.000000 OneToOne -1.000000 6.000000 FORMAT "%8.6" EXTENDED_LIMITS -32768.00 32767.00 /end CHARACTERISTIC
/begin CHARACTERISTIC Tra_numGearShftDwnLimLo_C "minimum gear number for gear shift down" VALUE 0x80580E58 Val_Ws16 7.000000 OneToOne -1.000000 6.000000 FORMAT "%8.6" EXTENDED_LIMITS -32768.00 32767.00 /end CHARACTERISTIC
/begin CHARACTERISTIC Tra_numLevPosCan_C "default level position" VALUE 0x805804DE RB_Val_Wu8 255.0 OneToOne 0.00 255.0 FORMAT "%5.1" /end CHARACTERISTIC
/begin CHARACTERISTIC Tra_rAppClsDelta_C "The delta of the shreshold of accel pedal position" VALUE 0x80580E5A Val_Ws16 163.8350 APPCrCtl1 0.00 163.8350 FORMAT "%8.4" EXTENDED_LIMITS -163.8400 163.8350 /end CHARACTERISTIC
/begin CHARACTERISTIC Tra_rAppDwnInh_MAP "This is SW-CALPRM" MAP 0x80580E5C RB_Map_S16S16_S16 799.9756 Prc -400.0000 399.9756 FORMAT "%8.4" EXTENDED_LIMITS -400.0000 399.9878
 /begin AXIS_DESCR STD_AXIS VehV_v Vel 16 -327.6800 327.6700 FORMAT "%8.4" DEPOSIT ABSOLUTE /end AXIS_DESCR
 /begin AXIS_DESCR STD_AXIS Tra_numDispGear OneToOne 9 -32768. 32767. FORMAT "%5.0" DEPOSIT ABSOLUTE /end AXIS_DESCR
/end CHARACTERISTIC
/begin CHARACTERISTIC Tra_rAppOpenMin_C "The shreshold of accel pedal position" VALUE 0x80580FB2 Val_Ws16 163.8350 APPCrCtl1 0.00 163.8350 FORMAT "%8.4" EXTENDED_LIMITS -163.8400 163.8350 /end CHARACTERISTIC
/begin CHARACTERISTIC Tra_rClgDem_C "Parameter for the relative fan cooling capacity" VALUE 0x805804B6 RB_Val_Ws16 799.9878 Prc -400.0000 399.9878 FORMAT "%8.4" /end CHARACTERISTIC
/begin CHARACTERISTIC Tra_rCluStk_C "Percent of Clutch stroke to identify that clutch is activated in Tra_GearReq module." VALUE 0x80580FB4 Val_Ws16 255.9961 Prc_Fact256 -128.0000 127.9961 FORMAT "%8.4" /end CHARACTERISTIC
/begin CHARACTERISTIC Tra_rCVTGearMax_C "Maximum limit of CVT gear ratio" VALUE 0x805804E0 RB_Val_Ws16 65.53500 RatHiRes_COMPU -32.76800 32.76700 FORMAT "%8.5" /end CHARACTERISTIC
/begin CHARACTERISTIC Tra_rCVTGearMin_C "Minimum limit of CVT gear ratio" VALUE 0x805804E2 RB_Val_Ws16 65.53500 RatHiRes_COMPU -32.76800 32.76700 FORMAT "%8.5" /end CHARACTERISTIC
/begin CHARACTERISTIC Tra_rDftCVTGearRat_C "Default CVT Gear ratio" VALUE 0x805804E4 RB_Val_Ws16 65.53500 RatHiRes_COMPU -32.76800 32.76700 FORMAT "%8.5" /end CHARACTERISTIC
/begin CHARACTERISTIC Tra_rDrvAPPDem_C "driver acceleration demand for shift indicator lamp" VALUE 0x80580FB6 Val_Ws16 100.0000 Prc 0.00 100.0000 FORMAT "%8.4" EXTENDED_LIMITS -400.0000 399.9878 /end CHARACTERISTIC
/begin CHARACTERISTIC Tra_rGearCVT1Hi_C "Application parameter for maximum ratio of the 1st gear" VALUE 0x805804E6 RB_Val_Ws16 655.3500 TransR -327.6800 327.6700 FORMAT "%8.4" /end CHARACTERISTIC
/begin CHARACTERISTIC Tra_rGearCVT1Lo_C "Application parameter for minimum ratio of the 1st gear" VALUE 0x805804E8 RB_Val_Ws16 655.3500 TransR -327.6800 327.6700 FORMAT "%8.4" /end CHARACTERISTIC
/begin CHARACTERISTIC Tra_rGearCVT2Hi_C "Application parameter for maximum ratio of the 2nd gear" VALUE 0x805804EA RB_Val_Ws16 655.3500 TransR -327.6800 327.6700 FORMAT "%8.4" /end CHARACTERISTIC
/begin CHARACTERISTIC Tra_rGearCVT2Lo_C "Application parameter for minimum ratio of the 2nd gear" VALUE 0x805804EC RB_Val_Ws16 655.3500 TransR -327.6800 327.6700 FORMAT "%8.4" /end CHARACTERISTIC
/begin CHARACTERISTIC Tra_rGearCVT3Hi_C "Application parameter for maximum ratio of the 3rd gear" VALUE 0x805804EE RB_Val_Ws16 655.3500 TransR -327.6800 327.6700 FORMAT "%8.4" /end CHARACTERISTIC
/begin CHARACTERISTIC Tra_rGearCVT3Lo_C "Application parameter for minimum ratio of the 3rd gear" VALUE 0x805804F0 RB_Val_Ws16 655.3500 TransR -327.6800 327.6700 FORMAT "%8.4" /end CHARACTERISTIC
/begin CHARACTERISTIC Tra_rGearCVT4Hi_C "Application parameter for maximum ratio of the 4th gear" VALUE 0x805804F2 RB_Val_Ws16 655.3500 TransR -327.6800 327.6700 FORMAT "%8.4" /end CHARACTERISTIC
/begin CHARACTERISTIC Tra_rGearCVT4Lo_C "Application parameter for minimum ratio of the 4th gear" VALUE 0x805804F4 RB_Val_Ws16 655.3500 TransR -327.6800 327.6700 FORMAT "%8.4" /end CHARACTERISTIC
/begin CHARACTERISTIC Tra_rGearCVT5Hi_C "Application parameter for maximum ratio of the 5th gear" VALUE 0x805804F6 RB_Val_Ws16 655.3500 TransR -327.6800 327.6700 FORMAT "%8.4" /end CHARACTERISTIC
/begin CHARACTERISTIC Tra_rGearCVT5Lo_C "Application parameter for minimum ratio of the 5th gear" VALUE 0x805804F8 RB_Val_Ws16 655.3500 TransR -327.6800 327.6700 FORMAT "%8.4" /end CHARACTERISTIC
/begin CHARACTERISTIC Tra_rGearCVT6Hi_C "Application parameter for maximum ratio of the 6th gear" VALUE 0x805804FA RB_Val_Ws16 655.3500 TransR -327.6800 327.6700 FORMAT "%8.4" /end CHARACTERISTIC
/begin CHARACTERISTIC Tra_rGearCVT6Lo_C "Application parameter for minimum ratio of the 6th gear" VALUE 0x805804FC RB_Val_Ws16 655.3500 TransR -327.6800 327.6700 FORMAT "%8.4" /end CHARACTERISTIC
/begin CHARACTERISTIC Tra_rGearCVT7Hi_C "Application parameter for maximum ratio of the 7th gear" VALUE 0x805804FE RB_Val_Ws16 655.3500 TransR -327.6800 327.6700 FORMAT "%8.4" /end CHARACTERISTIC
/begin CHARACTERISTIC Tra_rGearCVT7Lo_C "Application parameter for minimum ratio of the 7th gear" VALUE 0x80580500 RB_Val_Ws16 655.3500 TransR -327.6800 327.6700 FORMAT "%8.4" /end CHARACTERISTIC
/begin CHARACTERISTIC Tra_rGearCVT8Hi_C "Application parameter for maximum ratio of the 8th gear" VALUE 0x80580502 RB_Val_Ws16 655.3500 TransR -327.6800 327.6700 FORMAT "%8.4" /end CHARACTERISTIC
/begin CHARACTERISTIC Tra_rGearCVT8Lo_C "Application parameter for minimum ratio of the 8th gear" VALUE 0x80580504 RB_Val_Ws16 655.3500 TransR -327.6800 327.6700 FORMAT "%8.4" /end CHARACTERISTIC
/begin CHARACTERISTIC Tra_rGearCVT9Hi_C "Application parameter for maximum ratio of the 9th gear" VALUE 0x80580506 RB_Val_Ws16 655.3500 TransR -327.6800 327.6700 FORMAT "%8.4" /end CHARACTERISTIC
/begin CHARACTERISTIC Tra_rGearCVT9Lo_C "Application parameter for minimum ratio of the 9th gear" VALUE 0x80580508 RB_Val_Ws16 655.3500 TransR -327.6800 327.6700 FORMAT "%8.4" /end CHARACTERISTIC
/begin CHARACTERISTIC Tra_rLoLdAPPThres_CUR "Curve of acceleration ratio threshold to detect low load" CURVE 0x80580FB8 RB_Curve_S16_S16 100.0000 Prc 0.00 100.0000 FORMAT "%8.4" EXTENDED_LIMITS -400.0000 399.9878
 /begin AXIS_DESCR STD_AXIS Tra_numDispGear OneToOne 8 -1.000 6.000 FORMAT "%5.3" EXTENDED_LIMITS -32768. 32767. DEPOSIT ABSOLUTE /end AXIS_DESCR
/end CHARACTERISTIC
/begin CHARACTERISTIC Tra_rLoRngCVT_C "Calibration for Low range for CVT" VALUE 0x8058050A RB_Val_Ws16 655.3500 TransR -327.6800 327.6700 FORMAT "%8.4" /end CHARACTERISTIC
/begin CHARACTERISTIC Tra_rSlpEst_MAP "MAP of estimation of road slope fot shift indicator lamp" MAP 0x80580FDA RB_Map_S16S16_S16 100.0000 Prc -50.00000 50.00000 FORMAT "%8.5" EXTENDED_LIMITS -400.0000 399.9878
 /begin AXIS_DESCR STD_AXIS Tra_frCurrRstnFlt_mp DrvFr 16 -10000.00 10000.00 FORMAT "%8.2" EXTENDED_LIMITS -32768.00 32767.00 DEPOSIT ABSOLUTE /end AXIS_DESCR
 /begin AXIS_DESCR STD_AXIS Tra_vSlpEstVehFlt_mp Vel 16 0.00 300.0000 FORMAT "%8.4" EXTENDED_LIMITS -327.6800 327.6700 DEPOSIT ABSOLUTE /end AXIS_DESCR
/end CHARACTERISTIC
/begin CHARACTERISTIC Tra_rV2NDfl_C "default value for quotient of velocity and rational speed" VALUE 0x8058050C RB_Val_Ws16 0.6553500 VelToN -0.3276800 0.3276700 FORMAT "%9.7" /end CHARACTERISTIC
/begin CHARACTERISTIC Tra_rVn1H_C "application parameter for maximum ratio of 1. gear" VALUE 0x8058050E RB_Val_Ws16 0.6553500 VelToN -0.3276800 0.3276700 FORMAT "%9.7" /end CHARACTERISTIC
/begin CHARACTERISTIC Tra_rVn1L_C "application parameter for minimum ratio of 1. gear" VALUE 0x80580510 RB_Val_Ws16 0.6553500 VelToN -0.3276800 0.3276700 FORMAT "%9.7" /end CHARACTERISTIC
/begin CHARACTERISTIC Tra_rVn1To2Des_C "application parameter for ratio of the 1. to 2. gear transition" VALUE 0x80580512 RB_Val_Ws16 0.6553500 VelToN -0.3276800 0.3276700 FORMAT "%9.7" /end CHARACTERISTIC
/begin CHARACTERISTIC Tra_rVn2H_C "application parameter for maximum ratio of 2. gear" VALUE 0x80580514 RB_Val_Ws16 0.6553500 VelToN -0.3276800 0.3276700 FORMAT "%9.7" /end CHARACTERISTIC
/begin CHARACTERISTIC Tra_rVn2L_C "application parameter for minimum ratio of 2. gear" VALUE 0x80580516 RB_Val_Ws16 0.6553500 VelToN -0.3276800 0.3276700 FORMAT "%9.7" /end CHARACTERISTIC
/begin CHARACTERISTIC Tra_rVn2To3Des_C "application parameter for ratio of the 2. to 3. gear transistion" VALUE 0x80580518 RB_Val_Ws16 0.6553500 VelToN -0.3276800 0.3276700 FORMAT "%9.7" /end CHARACTERISTIC
/begin CHARACTERISTIC Tra_rVn3H_C "application parameter for maximum ratio of 3. gear" VALUE 0x8058051A RB_Val_Ws16 0.6553500 VelToN -0.3276800 0.3276700 FORMAT "%9.7" /end CHARACTERISTIC
/begin CHARACTERISTIC Tra_rVn3L_C "application parameter for minimum ratio of 3. gear" VALUE 0x8058051C RB_Val_Ws16 0.6553500 VelToN -0.3276800 0.3276700 FORMAT "%9.7" /end CHARACTERISTIC
/begin CHARACTERISTIC Tra_rVn3To4Des_C "application parameter for ratio of the 3. to 4. gear transistion" VALUE 0x8058051E RB_Val_Ws16 0.6553500 VelToN -0.3276800 0.3276700 FORMAT "%9.7" /end CHARACTERISTIC
/begin CHARACTERISTIC Tra_rVn4H_C "application parameter for maximum ratio of 4. gear" VALUE 0x80580520 RB_Val_Ws16 0.6553500 VelToN -0.3276800 0.3276700 FORMAT "%9.7" /end CHARACTERISTIC
/begin CHARACTERISTIC Tra_rVn4L_C "application parameter for minimum ratio of 4. gear" VALUE 0x80580522 RB_Val_Ws16 0.6553500 VelToN -0.3276800 0.3276700 FORMAT "%9.7" /end CHARACTERISTIC
/begin CHARACTERISTIC Tra_rVn4To5Des_C "application parameter for ratio of the 4. to 5. gear transistion" VALUE 0x80580524 RB_Val_Ws16 0.6553500 VelToN -0.3276800 0.3276700 FORMAT "%9.7" /end CHARACTERISTIC
/begin CHARACTERISTIC Tra_rVn5H_C "application parameter for maximum ratio of 5. gear" VALUE 0x80580526 RB_Val_Ws16 0.6553500 VelToN -0.3276800 0.3276700 FORMAT "%9.7" /end CHARACTERISTIC
/begin CHARACTERISTIC Tra_rVn5L_C "application parameter for minimum ratio of 5. gear" VALUE 0x80580528 RB_Val_Ws16 0.6553500 VelToN -0.3276800 0.3276700 FORMAT "%9.7" /end CHARACTERISTIC
/begin CHARACTERISTIC Tra_rVn5To6Des_C "application parameter for ratio of the 5. to 6. gear transistion" VALUE 0x8058052A RB_Val_Ws16 0.6553500 VelToN -0.3276800 0.3276700 FORMAT "%9.7" /end CHARACTERISTIC
/begin CHARACTERISTIC Tra_rVn6H_C "application parameter for maximum ratio of 6. gear" VALUE 0x8058052C RB_Val_Ws16 0.6553500 VelToN -0.3276800 0.3276700 FORMAT "%9.7" /end CHARACTERISTIC
/begin CHARACTERISTIC Tra_rVn6L_C "application parameter for minimum ratio of 6. gear" VALUE 0x8058052E RB_Val_Ws16 0.6553500 VelToN -0.3276800 0.3276700 FORMAT "%9.7" /end CHARACTERISTIC
/begin CHARACTERISTIC Tra_rVn6To7Des_C "Application parameter for the ratio of the transfer from 6th to 7th gear" VALUE 0x80580530 RB_Val_Ws16 0.6553500 VelToN -0.3276800 0.3276700 FORMAT "%9.7" /end CHARACTERISTIC
/begin CHARACTERISTIC Tra_rVn7H_C "Application parameter for maximum ratio of the 7th gear" VALUE 0x80580532 RB_Val_Ws16 0.6553500 VelToN -0.3276800 0.3276700 FORMAT "%9.7" /end CHARACTERISTIC
/begin CHARACTERISTIC Tra_rVn7L_C "Application parameter for minimum ratio of the 7th gear" VALUE 0x80580534 RB_Val_Ws16 0.6553500 VelToN -0.3276800 0.3276700 FORMAT "%9.7" /end CHARACTERISTIC
/begin CHARACTERISTIC Tra_rVn7To8Des_C "Application parameter for the ratio of the transfer from 7th to 8th gear" VALUE 0x80580536 RB_Val_Ws16 0.6553500 VelToN -0.3276800 0.3276700 FORMAT "%9.7" /end CHARACTERISTIC
/begin CHARACTERISTIC Tra_rVn8H_C "Application parameter for maximum ratio of the 8th gear" VALUE 0x80580538 RB_Val_Ws16 0.6553500 VelToN -0.3276800 0.3276700 FORMAT "%9.7" /end CHARACTERISTIC
/begin CHARACTERISTIC Tra_rVn8L_C "Application parameter for minimum ratio of the 8th gear" VALUE 0x8058053A RB_Val_Ws16 0.6553500 VelToN -0.3276800 0.3276700 FORMAT "%9.7" /end CHARACTERISTIC
/begin CHARACTERISTIC Tra_rVn8To9Des_C "Application parameter for the ratio of the transfer from 8th to 9th gear" VALUE 0x8058053C RB_Val_Ws16 0.6553500 VelToN -0.3276800 0.3276700 FORMAT "%9.7" /end CHARACTERISTIC
/begin CHARACTERISTIC Tra_rVn9H_C "Application parameter for maximum ratio of the 9th gear" VALUE 0x8058053E RB_Val_Ws16 0.6553500 VelToN -0.3276800 0.3276700 FORMAT "%9.7" /end CHARACTERISTIC
/begin CHARACTERISTIC Tra_rVn9L_C "Application parameter for minimum ratio of the 9th gear" VALUE 0x80580540 RB_Val_Ws16 0.6553500 VelToN -0.3276800 0.3276700 FORMAT "%9.7" /end CHARACTERISTIC
/begin CHARACTERISTIC Tra_rVnRH_C "application parameter for maximum ratio of reverse gear" VALUE 0x80580542 RB_Val_Ws16 0.6553500 VelToN -0.3276800 0.3276700 FORMAT "%9.7" /end CHARACTERISTIC
/begin CHARACTERISTIC Tra_rVnRL_C "application parameter for minimum ratio of reverse gear" VALUE 0x80580544 RB_Val_Ws16 0.6553500 VelToN -0.3276800 0.3276700 FORMAT "%9.7" /end CHARACTERISTIC
/begin CHARACTERISTIC Tra_stCluActvMask_C "Calibration used for masking clutch press activation especially in case multiple switches are present" VALUE 0x8058121E Val_Wu8 255.0 OneToOne 0.00 255.0 FORMAT "%5.1" /end CHARACTERISTIC
/begin CHARACTERISTIC Tra_stHaltDisEgdActvMsk_C "Code word for selcting the bits of Gbx_stHaltDisEgdActv" VALUE 0x805817CF RB_Val_Wu8 255.0 OneToOne 0.00 255.0 FORMAT "%5.1" /end CHARACTERISTIC
/begin CHARACTERISTIC Tra_stHWSel_C "Parameter for selecting the gearbox type information from Hardware or Software" VALUE 0x805819DC RB_Val_Wu8 1.000 OneToOne 0.00 1.000 FORMAT "%5.3" EXTENDED_LIMITS 0.00 255.0 /end CHARACTERISTIC
/begin CHARACTERISTIC Tra_stLevPosD_C "application parameter for position D" VALUE 0x80580546 RB_Val_Wu8 255.0 OneToOne 0.00 255.0 FORMAT "%5.1" /end CHARACTERISTIC
/begin CHARACTERISTIC Tra_stPrtCfg_C "CAN configuration" VALUE 0x805815ED RB_Val_Wu8 1.00000000000 B_TRUE 0.00 1.00000000000 FORMAT "%13.11" /end CHARACTERISTIC
/begin CHARACTERISTIC Tra_stSelnDes_C "Switch to select YAC input message" VALUE 0x8058121F Val_Wu8 1.000 OneToOne 0.00 1.000 FORMAT "%5.3" EXTENDED_LIMITS 0.00 255.0 /end CHARACTERISTIC
/begin CHARACTERISTIC Tra_stSwtGearCalcEna_C "Calibration switch to enable Tra_numGear calculation by gear ratio" VALUE 0x80580547 RB_Val_Wu8 1.00000000000 B_TRUE 0.00 1.00000000000 FORMAT "%13.11" /end CHARACTERISTIC
/begin CHARACTERISTIC Tra_stSwtRevPosn_C "Switch to decide reverse gear sensing through sensor or through can" VALUE 0x80580548 RB_Val_Wu8 1.00000000000 B_TRUE 0.00 1.00000000000 FORMAT "%13.11" /end CHARACTERISTIC
/begin CHARACTERISTIC Tra_stTraType_C "application parameter storing the transmission type" VALUE 0x805819DD RB_Val_Wu8 255.0 OneToOne 0.00 255.0 FORMAT "%5.1" /end CHARACTERISTIC
/begin CHARACTERISTIC Tra_swtAppLLimSel_C "Required demand selection switch" VALUE 0x80581220 Val_Wu8 1.000 OneToOne 0.00 1.000 FORMAT "%5.3" EXTENDED_LIMITS 0.00 255.0 /end CHARACTERISTIC
/begin CHARACTERISTIC Tra_swtCANFIdMask_C "Calibration parameter for CAN FId mask for engine speed limitation" VALUE 0x805817A8 Val_Wu8 255.0 OneToOne 0.00 255.0 FORMAT "%5.1" /end CHARACTERISTIC
/begin CHARACTERISTIC Tra_swtCrCtlActv_C "Selection switch used for reading Cruise active status to inhibit Up\Down indication." VALUE 0x80581221 Val_Wu8 1.000 OneToOne 0.00 1.000 FORMAT "%5.3" EXTENDED_LIMITS 0.00 255.0 /end CHARACTERISTIC
/begin CHARACTERISTIC Tra_swtCVTSig_C "CVT enable switch status" VALUE 0x80580549 RB_Val_Wu8 1.00000000000 B_TRUE 0.00 1.00000000000 FORMAT "%13.11" /end CHARACTERISTIC
/begin CHARACTERISTIC Tra_swtGbxNPosSel_C "Select switch of neutral detection for down indication inhibit status" VALUE 0x80581222 Val_Wu8 1.000 OneToOne 0.00 1.000 FORMAT "%5.3" EXTENDED_LIMITS 0.00 255.0 /end CHARACTERISTIC
/begin CHARACTERISTIC Tra_swtGearTypSeln_C "Calibration to switch between Tra_numGear and Tra_numGearDisp" VALUE 0x80581223 Val_Wu8 1.000 OneToOne 0.00 1.000 FORMAT "%5.3" EXTENDED_LIMITS 0.00 255.0 /end CHARACTERISTIC
/begin CHARACTERISTIC Tra_swtGSIEquip_C "Switch of gear shift indicator system equipment" VALUE 0x80581224 Val_Wu8 1.000 OneToOne 0.00 1.000 FORMAT "%5.3" EXTENDED_LIMITS 0.00 255.0 /end CHARACTERISTIC
/begin CHARACTERISTIC Tra_swtHondaGDIFct_C "Switch to activate Honda GDi specific gear number calculation" VALUE 0x8058054A RB_Val_Wu8 1.000 OneToOne 0.00 1.000 FORMAT "%5.3" EXTENDED_LIMITS 0.00 255.0 /end CHARACTERISTIC
/begin CHARACTERISTIC Tra_swtLevPosSlct_CA "application data field gear detection has to be executed for level position: CAN or individual calculation" VAL_BLK 0x8058054B RB_ValA_Wu8 1.00000000000 B_TRUE 0.00 1.00000000000 FORMAT "%13.11" NUMBER 16 /end CHARACTERISTIC
/begin CHARACTERISTIC Tra_swtPllyRat_C "Calibration to select pulley ration Com message" VALUE 0x8058055B RB_Val_Wu8 1.00000000000 B_TRUE 0.00 1.00000000000 FORMAT "%13.11" /end CHARACTERISTIC
/begin CHARACTERISTIC Tra_swtRmpPtdDes_C "Switch for ramping functionality" VALUE 0x805817D0 RB_Val_Wu8 1.00000000000 B_TRUE 0.00 1.00000000000 FORMAT "%13.11" /end CHARACTERISTIC
/begin CHARACTERISTIC Tra_swtRmpPtdLead_C "Switch for ramping functionality" VALUE 0x805817D1 RB_Val_Wu8 1.00000000000 B_TRUE 0.00 1.00000000000 FORMAT "%13.11" /end CHARACTERISTIC
/begin CHARACTERISTIC Tra_swtTypeSlct_CA "application data field gear detection has to be executed for the specified transmission type: CAN or individual calculation" VAL_BLK 0x8058055C RB_ValA_Wu8 1.00000000000 B_TRUE 0.00 1.00000000000 FORMAT "%13.11" NUMBER 8 /end CHARACTERISTIC
/begin CHARACTERISTIC Tra_tClntDes_C "Calibratable Coolant temperature - Set point value" VALUE 0x805804B8 RB_Val_Ws16 6553.500 Temp_Cels -3549.940 3003.560 FORMAT "%8.3" /end CHARACTERISTIC
/begin CHARACTERISTIC Tra_tEcoLmpEnaHi_C "The water temp shreshold for SIL" VALUE 0x80581226 Val_Ws16 6553.500 Temp_Cels -3549.940 3003.560 FORMAT "%8.3" /end CHARACTERISTIC
/begin CHARACTERISTIC Tra_tEcoLmpEnaLo_C "The low water temp shreshold for SIL" VALUE 0x80581228 Val_Ws16 6553.500 Temp_Cels -3549.940 3003.560 FORMAT "%8.3" /end CHARACTERISTIC
/begin CHARACTERISTIC Tra_tiAppOffDly_C "delay time for APP off to inhibit shift up" VALUE 0x8058122A Val_Ws16 655350.0 Time_ms -327680.0 327670.0 FORMAT "%8.1" /end CHARACTERISTIC
/begin CHARACTERISTIC Tra_tiAppOpnDly_C "The delay timer for upshift indication after the accelerator open" VALUE 0x8058122C Val_Wu16 6553.500 t_q0p1 0.00 6553.500 FORMAT "%8.3" /end CHARACTERISTIC
/begin CHARACTERISTIC Tra_tiASTDes_C "Substitute value for synchronisation time" VALUE 0x805817AA Val_Ws16 655.3500 Time_s -327.6800 327.6700 FORMAT "%8.4" /end CHARACTERISTIC
/begin CHARACTERISTIC Tra_tiATDwnDly_C "This is SW-CALPRM" VALUE 0x8058122E Val_Ws16 655350.0 Time_ms -327680.0 327670.0 FORMAT "%8.1" /end CHARACTERISTIC
/begin CHARACTERISTIC Tra_tiATUpDly_C "This is SW-CALPRM" VALUE 0x80581230 Val_Ws16 655350.0 Time_ms -327680.0 327670.0 FORMAT "%8.1" /end CHARACTERISTIC
/begin CHARACTERISTIC Tra_tiBrkCondDly_C "Delay time for Brk condition to select PT1 parameter" VALUE 0x80581232 Val_Ws16 655350.0 Time_ms -327680.0 327670.0 FORMAT "%8.1" /end CHARACTERISTIC
/begin CHARACTERISTIC Tra_tiClthChngDelay_C "delay time for clutch condtiion change" VALUE 0x80581234 Val_Ws16 655350.0 Time_ms -327680.0 327670.0 FORMAT "%8.1" /end CHARACTERISTIC
/begin CHARACTERISTIC Tra_tiCltOffSil_C "Delay time for stop SIL after clutch off" VALUE 0x80581236 Val_Wu16 6553.500 t_q0p1 0.00 6553.500 FORMAT "%8.3" /end CHARACTERISTIC
/begin CHARACTERISTIC Tra_tiDetShftChgDelay_C "delay time to detect shift change" VALUE 0x80581238 Val_Ws16 655350.0 Time_ms -327680.0 327670.0 FORMAT "%8.1" /end CHARACTERISTIC
/begin CHARACTERISTIC Tra_tiDRMaxEvl_C "Drive-reverse evaluation time threshold" VALUE 0x805817AC Val_Ws16 655350.0 Time_ms -327680.0 327670.0 FORMAT "%8.1" /end CHARACTERISTIC
/begin CHARACTERISTIC Tra_tiEcoLmpOffDly_C "Delay time for ECO lamp off" VALUE 0x8058123A Val_Ws16 655.3500 Time_s -327.6800 327.6700 FORMAT "%8.4" /end CHARACTERISTIC
/begin CHARACTERISTIC Tra_tiEcoLmpOnDly_C "Delay time for ECO lamp on" VALUE 0x8058123C Val_Ws16 655.3500 Time_s -327.6800 327.6700 FORMAT "%8.4" /end CHARACTERISTIC
/begin CHARACTERISTIC Tra_tiEcoLmpThrSt_C "Delay time for indicate after SIL up" VALUE 0x8058123E Val_Wu16 6553.500 t_q0p1 0.00 6553.500 FORMAT "%8.3" /end CHARACTERISTIC
/begin CHARACTERISTIC Tra_tiFCUpInhDelay_C "delay time for fuel cut to inhibit shift up" VALUE 0x80581240 Val_Ws16 655350.0 Time_ms -327680.0 327670.0 FORMAT "%8.1" /end CHARACTERISTIC
/begin CHARACTERISTIC Tra_tiLoLdDelay_C "delay time to detect low load" VALUE 0x80581242 Val_Ws16 655350.0 Time_ms -327680.0 327670.0 FORMAT "%8.1" /end CHARACTERISTIC
/begin CHARACTERISTIC Tra_tiNDwnInhCondRstDly_C "Delay time to release the shift down inhibit N condition" VALUE 0x80581244 Val_Ws16 655350.0 Time_ms -327680.0 327670.0 FORMAT "%8.1" /end CHARACTERISTIC
/begin CHARACTERISTIC Tra_tiNNeutrDetDelay_C "delay time for engine speed condition to detect neutral" VALUE 0x80581246 Val_Ws16 655350.0 Time_ms -327680.0 327670.0 FORMAT "%8.1" /end CHARACTERISTIC
/begin CHARACTERISTIC Tra_tiNPT1_C "filter time constant for the pre filtering of the engine speed for the calculation of the v/n ratio" VALUE 0x80580564 RB_Val_Ws32 4294.9672940000000 TimeDelay_s 0.0000020000000 4294.9672959999998 FORMAT "%19.14" EXTENDED_LIMITS 0.000002000000001 4294.9672959999998 /end CHARACTERISTIC
/begin CHARACTERISTIC Tra_tiOnDlyATDwn_C "This is SW-CALPRM" VALUE 0x80581248 Val_Ws16 655350.0 Time_ms -327680.0 327670.0 FORMAT "%8.1" /end CHARACTERISTIC
/begin CHARACTERISTIC Tra_tiOnDlyATUp_C "This is SW-CALPRM" VALUE 0x8058124A Val_Ws16 655350.0 Time_ms -327680.0 327670.0 FORMAT "%8.1" /end CHARACTERISTIC
/begin CHARACTERISTIC Tra_tiPNMaxEvl_C "Parking-Neutral evaluation time threshold" VALUE 0x805817AE Val_Ws16 655350.0 Time_ms -327680.0 327670.0 FORMAT "%8.1" /end CHARACTERISTIC
/begin CHARACTERISTIC Tra_tiPwrAccRstnFltBrk_C "PT1filter delay time for acceleration resistance in case of Brk On" VALUE 0x8058124C Val_Ws32 4294967.3 TimeDelay_ms 0.0 4294967.3 FORMAT "%12.1" /end CHARACTERISTIC
/begin CHARACTERISTIC Tra_tiPwrAccRstnFlt_C "PT1 filter delay time for acceleration resistance" VALUE 0x80581250 Val_Ws32 4294967.3 TimeDelay_ms 0.0 4294967.3 FORMAT "%12.1" /end CHARACTERISTIC
/begin CHARACTERISTIC Tra_tiPwrCurrRstnFlt_C "PT1 filter delay time for current driving resistance" VALUE 0x80581254 Val_Ws32 4294967.3 TimeDelay_ms 0.0 4294967.3 FORMAT "%12.1" /end CHARACTERISTIC
/begin CHARACTERISTIC Tra_tiRlsDwnInhCdn_C "Delay time to release down inhibit condition" VALUE 0x80581258 Val_Wu16 6553.500 t_q0p1 0.00 6553.500 FORMAT "%8.3" /end CHARACTERISTIC
/begin CHARACTERISTIC Tra_tiRlsDwnInhDelay_C "delay time to release down inhibit condition" VALUE 0x8058125A Val_Ws16 655350.0 Time_ms -327680.0 327670.0 FORMAT "%8.1" /end CHARACTERISTIC
/begin CHARACTERISTIC Tra_tiRlsUpInhCdn_C "Delay time to release up inhibit condition" VALUE 0x8058125C Val_Wu16 6553.500 t_q0p1 0.00 6553.500 FORMAT "%8.3" /end CHARACTERISTIC
/begin CHARACTERISTIC Tra_tiRlsUpInhDelay_C "delay time to release up inhibit condition" VALUE 0x8058125E Val_Ws16 655350.0 Time_ms -327680.0 327670.0 FORMAT "%8.1" /end CHARACTERISTIC
/begin CHARACTERISTIC Tra_tiSilInhbDly_C "SIL inhibition delay for VSA" VALUE 0x80581260 Val_Wu16 3276.700 t_q0p1 0.00 3276.700 FORMAT "%8.3" EXTENDED_LIMITS 0.00 6553.500 /end CHARACTERISTIC
/begin CHARACTERISTIC Tra_tiSilOff_C "Delay time for not indicate SIL" VALUE 0x80581262 Val_Wu16 6553.500 t_q0p1 0.00 6553.500 FORMAT "%8.3" /end CHARACTERISTIC
/begin CHARACTERISTIC Tra_tiSlpEstFlt_C "PT1 filter delay time for the estimated slope" VALUE 0x80581264 Val_Ws32 4294967.3 TimeDelay_ms 0.0 4294967.3 FORMAT "%12.1" /end CHARACTERISTIC
/begin CHARACTERISTIC Tra_tiSlpEstVehFlt_C "PT1 filter delay time for vehicle speed to estimat slope" VALUE 0x80581268 Val_Ws32 4294967.3 TimeDelay_ms 0.0 4294967.3 FORMAT "%12.1" /end CHARACTERISTIC
/begin CHARACTERISTIC Tra_tiTrqWhlFlt_C "PT1 filter delay time for force depend on wheel torque" VALUE 0x8058126C Val_Ws32 4294967.3 TimeDelay_ms 0.0 4294967.3 FORMAT "%12.1" /end CHARACTERISTIC
/begin CHARACTERISTIC Tra_tiV2NPT1_C "filter time constant for the filtering of the v/n ratio" VALUE 0x80580568 RB_Val_Ws32 4294.9672940000000 TimeDelay_s 0.0000020000000 4294.9672959999998 FORMAT "%19.14" EXTENDED_LIMITS 0.000002000000001 4294.9672959999998 /end CHARACTERISTIC
/begin CHARACTERISTIC Tra_tqAppDpdt_T "Additional torque factor curve for calculating Slow Torque Values for Decreasing torque intervention dependent on Accped" CURVE 0x805817D2 RB_Curve_S16_S16 6553.500 Trq -3276.800 3276.700 FORMAT "%8.3"
 /begin AXIS_DESCR STD_AXIS APP_r Prc 12 -400.0000 399.9878 FORMAT "%8.4" DEPOSIT ABSOLUTE /end AXIS_DESCR
/end CHARACTERISTIC
/begin CHARACTERISTIC Tra_tqDecIntvDesMax_C "Torque limit for assessing whether a decreasing transmission intervention is active" VALUE 0x80581804 RB_Val_Ws16 6553.500 Trq -3276.800 3276.700 FORMAT "%8.3" /end CHARACTERISTIC
/begin CHARACTERISTIC Tra_tqIncIntvDesMin_C "Torque limit for assessing whether an increasing transmission intervention is active" VALUE 0x80581806 RB_Val_Ws16 6553.500 Trq -3276.800 3276.700 FORMAT "%8.3" /end CHARACTERISTIC
/begin CHARACTERISTIC Tra_tqInMax_C "General torque maximum value" VALUE 0x805815EE RB_Val_Ws16 6553.500 Trq -3276.800 3276.700 FORMAT "%8.3" /end CHARACTERISTIC
/begin CHARACTERISTIC Tra_tqMaxGear10_T "Application curve (ntrq) for gear 10" CURVE 0x805815F0 RB_Curve_S16_S16 6553.500 Trq -3276.800 3276.700 FORMAT "%8.3"
 /begin AXIS_DESCR STD_AXIS Epm_nEng EngN 8 -16384.00 16383.50 FORMAT "%8.2" DEPOSIT ABSOLUTE /end AXIS_DESCR
/end CHARACTERISTIC
/begin CHARACTERISTIC Tra_tqMaxGear1_T "Curve (ntrq) gear 1" CURVE 0x80581612 RB_Curve_S16_S16 6553.500 Trq -3276.800 3276.700 FORMAT "%8.3"
 /begin AXIS_DESCR STD_AXIS Epm_nEng EngN 8 -16384.00 16383.50 FORMAT "%8.2" DEPOSIT ABSOLUTE /end AXIS_DESCR
/end CHARACTERISTIC
/begin CHARACTERISTIC Tra_tqMaxGear2_T "Curve (ntrq) gear 2" CURVE 0x80581634 RB_Curve_S16_S16 6553.500 Trq -3276.800 3276.700 FORMAT "%8.3"
 /begin AXIS_DESCR STD_AXIS Epm_nEng EngN 8 -16384.00 16383.50 FORMAT "%8.2" DEPOSIT ABSOLUTE /end AXIS_DESCR
/end CHARACTERISTIC
/begin CHARACTERISTIC Tra_tqMaxGear3_T "Curve (ntrq) gear 3" CURVE 0x80581656 RB_Curve_S16_S16 6553.500 Trq -3276.800 3276.700 FORMAT "%8.3"
 /begin AXIS_DESCR STD_AXIS Epm_nEng EngN 8 -16384.00 16383.50 FORMAT "%8.2" DEPOSIT ABSOLUTE /end AXIS_DESCR
/end CHARACTERISTIC
/begin CHARACTERISTIC Tra_tqMaxGear4_T "Curve (ntrq) gear 4" CURVE 0x80581678 RB_Curve_S16_S16 6553.500 Trq -3276.800 3276.700 FORMAT "%8.3"
 /begin AXIS_DESCR STD_AXIS Epm_nEng EngN 8 -16384.00 16383.50 FORMAT "%8.2" DEPOSIT ABSOLUTE /end AXIS_DESCR
/end CHARACTERISTIC
/begin CHARACTERISTIC Tra_tqMaxGear5_T "Curve (ntrq) gear 5" CURVE 0x8058169A RB_Curve_S16_S16 6553.500 Trq -3276.800 3276.700 FORMAT "%8.3"
 /begin AXIS_DESCR STD_AXIS Epm_nEng EngN 8 -16384.00 16383.50 FORMAT "%8.2" DEPOSIT ABSOLUTE /end AXIS_DESCR
/end CHARACTERISTIC
/begin CHARACTERISTIC Tra_tqMaxGear6_T "Curve (ntrq) gear 6" CURVE 0x805816BC RB_Curve_S16_S16 6553.500 Trq -3276.800 3276.700 FORMAT "%8.3"
 /begin AXIS_DESCR STD_AXIS Epm_nEng EngN 8 -16384.00 16383.50 FORMAT "%8.2" DEPOSIT ABSOLUTE /end AXIS_DESCR
/end CHARACTERISTIC
/begin CHARACTERISTIC Tra_tqMaxGear7_T "Curve (ntrq) gear 7" CURVE 0x805816DE RB_Curve_S16_S16 6553.500 Trq -3276.800 3276.700 FORMAT "%8.3"
 /begin AXIS_DESCR STD_AXIS Epm_nEng EngN 8 -16384.00 16383.50 FORMAT "%8.2" DEPOSIT ABSOLUTE /end AXIS_DESCR
/end CHARACTERISTIC
/begin CHARACTERISTIC Tra_tqMaxGear8_T "Curve (ntrq) gear 8" CURVE 0x80581700 RB_Curve_S16_S16 6553.500 Trq -3276.800 3276.700 FORMAT "%8.3"
 /begin AXIS_DESCR STD_AXIS Epm_nEng EngN 8 -16384.00 16383.50 FORMAT "%8.2" DEPOSIT ABSOLUTE /end AXIS_DESCR
/end CHARACTERISTIC
/begin CHARACTERISTIC Tra_tqMaxGear9_T "Application curve (ntrq) for gear 9" CURVE 0x80581722 RB_Curve_S16_S16 6553.500 Trq -3276.800 3276.700 FORMAT "%8.3"
 /begin AXIS_DESCR STD_AXIS Epm_nEng EngN 8 -16384.00 16383.50 FORMAT "%8.2" DEPOSIT ABSOLUTE /end AXIS_DESCR
/end CHARACTERISTIC
/begin CHARACTERISTIC Tra_tqMaxGearIndpdtProblem_C "Protection torque in case of gear independent problems" VALUE 0x80581744 RB_Val_Ws16 6553.500 Trq -3276.800 3276.700 FORMAT "%8.3" /end CHARACTERISTIC
/begin CHARACTERISTIC Tra_tqMaxGearR_T "Curve (ntrq) gear R" CURVE 0x80581746 RB_Curve_S16_S16 6553.500 Trq -3276.800 3276.700 FORMAT "%8.3"
 /begin AXIS_DESCR STD_AXIS Epm_nEng EngN 8 -16384.00 16383.50 FORMAT "%8.2" DEPOSIT ABSOLUTE /end AXIS_DESCR
/end CHARACTERISTIC
/begin CHARACTERISTIC Tra_tqMaxNoGearInfo_C "Transmission protection torque when no gear information available" VALUE 0x80581768 RB_Val_Ws16 6553.500 Trq -3276.800 3276.700 FORMAT "%8.3" /end CHARACTERISTIC
/begin CHARACTERISTIC Tra_tqSil1Hi_T "The table for high value of torque" CURVE 0x80581270 RB_Curve_S16_S16 6553.500 Trq -3276.800 3276.700 FORMAT "%8.3"
 /begin AXIS_DESCR STD_AXIS Epm_nEng EngN 10 -16384.00 16383.50 FORMAT "%8.2" DEPOSIT ABSOLUTE /end AXIS_DESCR
/end CHARACTERISTIC
/begin CHARACTERISTIC Tra_tqSil1Lo_T "The table for low value of torque" CURVE 0x8058129A RB_Curve_S16_S16 6553.500 Trq -3276.800 3276.700 FORMAT "%8.3"
 /begin AXIS_DESCR STD_AXIS Epm_nEng EngN 10 -16384.00 16383.50 FORMAT "%8.2" DEPOSIT ABSOLUTE /end AXIS_DESCR
/end CHARACTERISTIC
/begin CHARACTERISTIC Tra_tqSil2Hi_T "The table for high value of torque" CURVE 0x805812C4 RB_Curve_S16_S16 6553.500 Trq -3276.800 3276.700 FORMAT "%8.3"
 /begin AXIS_DESCR STD_AXIS Epm_nEng EngN 10 -16384.00 16383.50 FORMAT "%8.2" DEPOSIT ABSOLUTE /end AXIS_DESCR
/end CHARACTERISTIC
/begin CHARACTERISTIC Tra_tqSil2Lo_T "The table for low value of torque" CURVE 0x805812EE RB_Curve_S16_S16 6553.500 Trq -3276.800 3276.700 FORMAT "%8.3"
 /begin AXIS_DESCR STD_AXIS Epm_nEng EngN 10 -16384.00 16383.50 FORMAT "%8.2" DEPOSIT ABSOLUTE /end AXIS_DESCR
/end CHARACTERISTIC
/begin CHARACTERISTIC Tra_trqDesMax_C "Parameter maximum torque" VALUE 0x80581808 RB_Val_Ws16 6553.500 Trq -3276.800 3276.700 FORMAT "%8.3" /end CHARACTERISTIC
/begin CHARACTERISTIC Tra_trqDesMin_C "Parameter minimum torque" VALUE 0x8058180A RB_Val_Ws16 6553.500 Trq -3276.800 3276.700 FORMAT "%8.3" /end CHARACTERISTIC
/begin CHARACTERISTIC Tra_trqLeadMax_C "Applicable maximum lead torque value" VALUE 0x8058180C RB_Val_Ws16 6553.500 Trq -3276.800 3276.700 FORMAT "%8.3" /end CHARACTERISTIC
/begin CHARACTERISTIC Tra_trqLeadMin_C "Calibratable minimum desired torque" VALUE 0x8058180E RB_Val_Ws16 6553.500 Trq -3276.800 3276.700 FORMAT "%8.3" /end CHARACTERISTIC
/begin CHARACTERISTIC Tra_trqLoLdTrqThres_CUR "Curve of torque threshold to detect low load" CURVE 0x80581318 RB_Curve_S16_S16 1500.000 Trq -500.000 1000.000 FORMAT "%8.3" EXTENDED_LIMITS -3276.800 3276.700
 /begin AXIS_DESCR STD_AXIS Tra_numDispGear OneToOne 8 -1.000 6.000 FORMAT "%5.3" EXTENDED_LIMITS -32768. 32767. DEPOSIT ABSOLUTE /end AXIS_DESCR
/end CHARACTERISTIC
/begin CHARACTERISTIC Tra_trqLos_C "current transmission torque loss" VALUE 0x805815DC RB_Val_Ws16 6553.500 Trq -3276.800 3276.700 FORMAT "%8.3" /end CHARACTERISTIC
/begin CHARACTERISTIC Tra_trqMaxDes_CUR "Desired torque depending on engine speed" CURVE 0x80581810 RB_Curve_S16_S16 6553.500 Trq -3276.800 3276.700 FORMAT "%8.3"
 /begin AXIS_DESCR STD_AXIS Epm_nEng EngN 10 -16384.00 16383.50 FORMAT "%8.2" DEPOSIT ABSOLUTE /end AXIS_DESCR
/end CHARACTERISTIC
/begin CHARACTERISTIC Tra_trqMaxLead_CUR "Desired torque depending on engine speed" CURVE 0x8058183A RB_Curve_S16_S16 6553.500 Trq -3276.800 3276.700 FORMAT "%8.3"
 /begin AXIS_DESCR STD_AXIS Epm_nEng EngN 10 -16384.00 16383.50 FORMAT "%8.2" DEPOSIT ABSOLUTE /end AXIS_DESCR
/end CHARACTERISTIC
/begin CHARACTERISTIC Tra_trqNeutrDetHi_C "high torque to detect neutral condition" VALUE 0x8058133A Val_Ws16 1500.000 Trq -500.000 1000.000 FORMAT "%8.3" EXTENDED_LIMITS -3276.800 3276.700 /end CHARACTERISTIC
/begin CHARACTERISTIC Tra_trqNeutrDetLo_C "low torque to detect neutral condition" VALUE 0x8058133C Val_Ws16 1500.000 Trq -500.000 1000.000 FORMAT "%8.3" EXTENDED_LIMITS -3276.800 3276.700 /end CHARACTERISTIC
/begin CHARACTERISTIC Tra_trqTSCIntvSlowDft_C "Default calibration parameter for slow torque" VALUE 0x80581864 RB_Val_Ws16 6553.500 Trq -3276.800 3276.700 FORMAT "%8.3" /end CHARACTERISTIC
/begin CHARACTERISTIC Tra_tShftUpReq_C "coolante temperature to shift up request" VALUE 0x8058133E Val_Ws16 200.0000 Temp_Cels -50.1400 149.8600 FORMAT "%8.4" EXTENDED_LIMITS -3549.940 3003.560 /end CHARACTERISTIC
/begin CHARACTERISTIC Tra_vBaseShftUp_MAP "MAP of vehicle speed to gear shift up" MAP 0x80581340 RB_Map_S16S16_S16 300.0000 Vel 0.00 300.0000 FORMAT "%8.4" EXTENDED_LIMITS -327.6800 327.6700
 /begin AXIS_DESCR STD_AXIS Tra_numDispGear OneToOne 8 -1.000 6.000 FORMAT "%5.3" EXTENDED_LIMITS -32768. 32767. DEPOSIT ABSOLUTE /end AXIS_DESCR
 /begin AXIS_DESCR STD_AXIS CEngDsT_t Temp_Cels 16 -50.1400 149.8600 FORMAT "%8.4" EXTENDED_LIMITS -3549.940 3003.560 DEPOSIT ABSOLUTE /end AXIS_DESCR
/end CHARACTERISTIC
/begin CHARACTERISTIC Tra_vDRBShftUp_MAP "MAP of drivability vehicle speed to shift up" MAP 0x80581474 RB_Map_S16S16_S16 300.0000 Vel 0.00 300.0000 FORMAT "%8.4" EXTENDED_LIMITS -327.6800 327.6700
 /begin AXIS_DESCR STD_AXIS Tra_numDispGear OneToOne 8 -1.000 6.000 FORMAT "%5.3" EXTENDED_LIMITS -32768. 32767. DEPOSIT ABSOLUTE /end AXIS_DESCR
 /begin AXIS_DESCR STD_AXIS Tra_rSlpEst_mp Prc 16 -50.0000000000 50.0000000000 FORMAT "%13.10" EXTENDED_LIMITS -400.000000000 399.987792969 DEPOSIT ABSOLUTE /end AXIS_DESCR
/end CHARACTERISTIC
/begin CHARACTERISTIC Tra_vEcoEnaHiDelta_C "The delta of the shreshold max vehicle speed" VALUE 0x805815A8 Val_Ws16 655.3500 Vel -327.6800 327.6700 FORMAT "%8.4" /end CHARACTERISTIC
/begin CHARACTERISTIC Tra_vEcoEnaHi_C "Max vehicle speed for lamp on indicate" VALUE 0x805815AA Val_Ws16 655.3500 Vel -327.6800 327.6700 FORMAT "%8.4" /end CHARACTERISTIC
/begin CHARACTERISTIC Tra_vEcoEnaLoDelta_C "The delta of the shreshold min vehicle speed" VALUE 0x805815AC Val_Ws16 655.3500 Vel -327.6800 327.6700 FORMAT "%8.4" /end CHARACTERISTIC
/begin CHARACTERISTIC Tra_vEcoEnaLo_C "Min vehicle speed for lamp on indicate" VALUE 0x805815AE Val_Ws16 655.3500 Vel -327.6800 327.6700 FORMAT "%8.4" /end CHARACTERISTIC
/begin CHARACTERISTIC Tra_vInhShftDwnLimLo_C "low limit vehicle speed to shift down" VALUE 0x805815B0 Val_Ws16 300.0000 Vel 0.00 300.0000 FORMAT "%8.4" EXTENDED_LIMITS -327.6800 327.6700 /end CHARACTERISTIC
/begin CHARACTERISTIC Tra_vMinTrqRed_C "Threshold vehicle speed for limp home" VALUE 0x80581866 RB_Val_Ws16 655.3500 Vel -327.6800 327.6700 FORMAT "%8.4" /end CHARACTERISTIC
/begin CHARACTERISTIC Tra_vMin_C "minimum value of velocity for gear detection" VALUE 0x8058056C RB_Val_Ws16 655.3500 Vel -327.6800 327.6700 FORMAT "%8.4" /end CHARACTERISTIC
/begin CHARACTERISTIC Tra_vNeutrDet_C "vehicle speed to detect neutral condition" VALUE 0x805815B2 Val_Ws16 300.0000 Vel 0.00 300.0000 FORMAT "%8.4" EXTENDED_LIMITS -327.6800 327.6700 /end CHARACTERISTIC
/begin CHARACTERISTIC Tra_vRevLckHi_C "High limit of vehicle speed for Reverse Lock solenoid condition" VALUE 0x8058176C RB_Val_Ws16 300.0000 Vel 0.00 300.0000 FORMAT "%8.4" EXTENDED_LIMITS -327.6800 327.6700 /end CHARACTERISTIC
/begin CHARACTERISTIC Tra_vRevLckLo_C "Low limit of vehicle speed for Reverse Lock solenoid condition" VALUE 0x8058176E RB_Val_Ws16 300.0000 Vel 0.00 300.0000 FORMAT "%8.4" EXTENDED_LIMITS -327.6800 327.6700 /end CHARACTERISTIC
/begin CHARACTERISTIC Tra_vShftUpInhHys_C "hysteresis vehicle speed to inhibit shift up" VALUE 0x805815B4 Val_Ws16 300.0000 Vel 0.00 300.0000 FORMAT "%8.4" EXTENDED_LIMITS -327.6800 327.6700 /end CHARACTERISTIC
/begin CHARACTERISTIC Tra_vShftUpInhThres_CUR "Threshold vehicle speed for Shift Up Inhibit indication status" CURVE 0x805815B6 RB_Curve_S16_S16 300.0000 Vel 0.00 300.0000 FORMAT "%8.4" EXTENDED_LIMITS -327.6800 327.6700
 /begin AXIS_DESCR STD_AXIS Tra_numDispGear OneToOne 8 -1.000 6.000 FORMAT "%5.3" EXTENDED_LIMITS -32768. 32767. DEPOSIT ABSOLUTE /end AXIS_DESCR
/end CHARACTERISTIC
/begin CHARACTERISTIC Tra_vSlopEstimnVeh_C "Velocity of the vehicle in order to cut the slope calculation." VALUE 0x805815D8 Val_Ws16 655.3500 Vel -327.6800 327.6700 FORMAT "%8.4" /end CHARACTERISTIC
/begin CHARACTERISTIC Tra_wIgnRtdtCtl_M "Map for air mass flow based on engine temperature at start and ethanol content interpolation factor" MAP 0x80581868 RB_Map_S16S16_S16 11.65049 m_uw_b23p3 0.00 11.65049 FORMAT "%8.5" EXTENDED_LIMITS -11.65084 11.65049
 /begin AXIS_DESCR STD_AXIS tmst temp_ub_q0p75_o48 12 -48.00 24527.25 FORMAT "%8.2" EXTENDED_LIMITS -24624.00 24527.25 DEPOSIT ABSOLUTE /end AXIS_DESCR
 /begin AXIS_DESCR STD_AXIS fethmnmx fak_ub_b2 12 0.00 255.9922 FORMAT "%8.4" EXTENDED_LIMITS -256.0000 255.9922 DEPOSIT ABSOLUTE /end AXIS_DESCR
/end CHARACTERISTIC
/begin CHARACTERISTIC TWCC_BalCat1B1_I.TWCC_flgExtdPurgCng_C "oxygen balancing for catalyst purge, catalyst 1 / Calibration flag to extend the purging due to the presence of excess H2 in CNG." VALUE 0x8057F640 RB_Val_Wu8 1.00000000000 B_TRUE 0.00 1.00000000000 FORMAT "%13.11" /end CHARACTERISTIC
/begin CHARACTERISTIC TWCC_BalCat1B1_I.facOSCPurge_C "oxygen balancing for catalyst purge, catalyst 1 / factor correction oxygen level after stop-start" VALUE 0x8057F641 RB_Val_Wu8 1.992188 fak_ub_b2 0.00 1.992188 FORMAT "%8.6" /end CHARACTERISTIC
/begin CHARACTERISTIC TWCC_BalCat1B1_I.facOSCScndFuelPurge_C "oxygen balancing for catalyst purge, catalyst 1 / factor initialize oxygen storage level at rich sensor voltage at second fuel type" VALUE 0x8057F642 RB_Val_Wu8 1.992188 fak_ub_b2 0.00 1.992188 FORMAT "%8.6" /end CHARACTERISTIC
/begin CHARACTERISTIC TWCC_BalCat1B1_I.facOSCState_C "oxygen balancing for catalyst purge, catalyst 1 / factor oxygen storage capacity for setting marker flag minimum oxygen entry during engine off" VALUE 0x8057F643 RB_Val_Wu8 1.992188 fak_ub_b2 0.00 1.992188 FORMAT "%8.6" /end CHARACTERISTIC
/begin CHARACTERISTIC TWCC_BalCat1B1_I.flgRstSensRichSFl_CW "oxygen balancing for catalyst purge, catalyst 1 / Codeword: Activate reset filling level to defined amount with rich sensor for CNG or FFV mode" VALUE 0x8057F644 RB_Val_Wu8 1.00000000000 B_TRUE 0.00 1.00000000000 FORMAT "%13.11" /end CHARACTERISTIC
/begin CHARACTERISTIC TWCC_BalCat1B1_I.mO2DisThresPurgeEngOn_C "oxygen balancing for catalyst purge, catalyst 1 / minimum amount of oxygen to be purged to end purging in case sensor voltage remained rich during lean phase (short lean phase), after fuel cut off" VALUE 0x8057F648 RB_Val_Wu32 429496729.500 m_q0p1_mg 0.00 429496729.500 FORMAT "%13.3" /end CHARACTERISTIC
/begin CHARACTERISTIC TWCC_BalCat1B1_I.mO2DisThresPurge_C "oxygen balancing for catalyst purge, catalyst 1 / minimum amount of oxygen to be purged to end purging in case sensor voltage remained rich during lean phase (short lean phase), after stop phase" VALUE 0x8057F64C RB_Val_Wu32 429496729.500 m_q0p1_mg 0.00 429496729.500 FORMAT "%13.3" /end CHARACTERISTIC
/begin CHARACTERISTIC TWCC_BalCat1B1_I.mO2EngOff_CUR "oxygen balancing for catalyst purge, catalyst 1 / oxygen entry into catalyst during engine off" CURVE 0x8057F650 RB_Curve_U16_U16 65535.00 m_q1_mg 0.00 65535.00 FORMAT "%8.2"
 /begin AXIS_DESCR STD_AXIS TWCC_BalCat1B1_I.tiEngOff t_q1 2 0.00 65535.00 FORMAT "%8.2" DEPOSIT ABSOLUTE /end AXIS_DESCR
/end CHARACTERISTIC
/begin CHARACTERISTIC TWCC_BalCat2B1_I.TWCC_flgExtdPurgCng_C "oxygen balancing for catalyst purge, catalyst 2 / Calibration flag to extend the purging due to the presence of excess H2 in CNG." VALUE 0x8057F660 RB_Val_Wu8 1.00000000000 B_TRUE 0.00 1.00000000000 FORMAT "%13.11" /end CHARACTERISTIC
/begin CHARACTERISTIC TWCC_BalCat2B1_I.facOSCPurge_C "oxygen balancing for catalyst purge, catalyst 2 / factor correction oxygen level after stop-start" VALUE 0x8057F661 RB_Val_Wu8 1.992188 fak_ub_b2 0.00 1.992188 FORMAT "%8.6" /end CHARACTERISTIC
/begin CHARACTERISTIC TWCC_BalCat2B1_I.facOSCScndFuelPurge_C "oxygen balancing for catalyst purge, catalyst 2 / factor initialize oxygen storage level at rich sensor voltage at second fuel type" VALUE 0x8057F662 RB_Val_Wu8 1.992188 fak_ub_b2 0.00 1.992188 FORMAT "%8.6" /end CHARACTERISTIC
/begin CHARACTERISTIC TWCC_BalCat2B1_I.facOSCState_C "oxygen balancing for catalyst purge, catalyst 2 / factor oxygen storage capacity for setting marker flag minimum oxygen entry during engine off" VALUE 0x8057F663 RB_Val_Wu8 1.992188 fak_ub_b2 0.00 1.992188 FORMAT "%8.6" /end CHARACTERISTIC
/begin CHARACTERISTIC TWCC_BalCat2B1_I.flgRstSensRichSFl_CW "oxygen balancing for catalyst purge, catalyst 2 / Codeword: Activate reset filling level to defined amount with rich sensor for CNG or FFV mode" VALUE 0x8057F664 RB_Val_Wu8 1.00000000000 B_TRUE 0.00 1.00000000000 FORMAT "%13.11" /end CHARACTERISTIC
/begin CHARACTERISTIC TWCC_BalCat2B1_I.mO2DisThresPurgeEngOn_C "oxygen balancing for catalyst purge, catalyst 2 / minimum amount of oxygen to be purged to end purging in case sensor voltage remained rich during lean phase (short lean phase), after fuel cut off" VALUE 0x8057F668 RB_Val_Wu32 429496729.500 m_q0p1_mg 0.00 429496729.500 FORMAT "%13.3" /end CHARACTERISTIC
/begin CHARACTERISTIC TWCC_BalCat2B1_I.mO2DisThresPurge_C "oxygen balancing for catalyst purge, catalyst 2 / minimum amount of oxygen to be purged to end purging in case sensor voltage remained rich during lean phase (short lean phase), after stop phase" VALUE 0x8057F66C RB_Val_Wu32 429496729.500 m_q0p1_mg 0.00 429496729.500 FORMAT "%13.3" /end CHARACTERISTIC
/begin CHARACTERISTIC TWCC_BalCat2B1_I.mO2EngOff_CUR "oxygen balancing for catalyst purge, catalyst 2 / oxygen entry into catalyst during engine off" CURVE 0x8057F670 RB_Curve_U16_U16 65535.00 m_q1_mg 0.00 65535.00 FORMAT "%8.2"
 /begin AXIS_DESCR STD_AXIS TWCC_BalCat2B1_I.tiEngOff t_q1 2 0.00 65535.00 FORMAT "%8.2" DEPOSIT ABSOLUTE /end AXIS_DESCR
/end CHARACTERISTIC
/begin CHARACTERISTIC TWCC_facCorO2Purg_C "correction factor for O2-massflow during start phase" VALUE 0x8057F428 RB_Val_Wu8 1.992188 fak_ub_b2 0.00 1.992188 FORMAT "%8.6" /end CHARACTERISTIC
/begin CHARACTERISTIC TWCC_facLamThd_C "lambda threshold for lean mixture detection based on setpoint lambda at engine outlet" VALUE 0x8057F42A RB_Val_Wu16 15.99976 fak_uw_b16 0.00 15.99976 FORMAT "%8.5" /end CHARACTERISTIC
/begin CHARACTERISTIC TWCC_facO2Parl_C "Correction factor O2 mass flow during parallelization" VALUE 0x8057F42C RB_Val_Wu16 14.99976 fak_uw_b16 1.00000 15.99976 FORMAT "%8.5" EXTENDED_LIMITS 0.00 15.99976 /end CHARACTERISTIC
/begin CHARACTERISTIC TWCC_facO2PtlFco_C "Correction factor O2 mass flow during partial fuel cut off" VALUE 0x8057F42E RB_Val_Wu16 14.99976 fak_uw_b16 1.00000 15.99976 FORMAT "%8.5" EXTENDED_LIMITS 0.00 15.99976 /end CHARACTERISTIC
/begin CHARACTERISTIC TWCC_flgCatPurgeAftParlDiag_CW "codeword to release catalyst purge only after parallelization diagnosis or fuel cut off" VALUE 0x8057F430 RB_Val_Wu8 1.00000000000 B_TRUE 0.00 1.00000000000 FORMAT "%13.11" /end CHARACTERISTIC
/begin CHARACTERISTIC TWCC_flgCorOSCPurgSelnCat1_CW "Code word flag for selecting correction of oxygen storage capacity for purging (Catalyst 1)" VALUE 0x8057F431 RB_Val_Wu8 1.00000000000 B_TRUE 0.00 1.00000000000 FORMAT "%13.11" /end CHARACTERISTIC
/begin CHARACTERISTIC TWCC_flgCorOSCPurgSelnCat2_CW "Code word flag for selecting correction of oxygen storage capacity for purging (Catalyst 2)" VALUE 0x8057F432 RB_Val_Wu8 1.00000000000 B_TRUE 0.00 1.00000000000 FORMAT "%13.11" /end CHARACTERISTIC
/begin CHARACTERISTIC TWCC_flgDiPurgCatHeatgEna_C "Calibration Flag to Disable Catalyst Purge when Catalyst Heating is Enable" VALUE 0x8057F433 RB_Val_Wu8 1.00000000000 B_TRUE 0.00 1.00000000000 FORMAT "%13.11" /end CHARACTERISTIC
/begin CHARACTERISTIC TWCC_flgEnaCatPurgColdOper_CW "Codebit for consideration of cold operation release of the HEGO sensor downstream catalyst" VALUE 0x8057F434 RB_Val_Wu8 1.00000000000 B_TRUE 0.00 1.00000000000 FORMAT "%13.11" /end CHARACTERISTIC
/begin CHARACTERISTIC TWCC_flgInhbPurgThrVlvLimpMod_C "flag to inhibit catalyst purging while throttle valve limpmode" VALUE 0x8057F435 RB_Val_Wu8 1.00000000000 B_TRUE 0.00 1.00000000000 FORMAT "%13.11" /end CHARACTERISTIC
/begin CHARACTERISTIC TWCC_flgLamMinPurgBascOilT_C "Flag to calculate the engine temperature depending lower limit of basic lambda setpoint for purging based on oil model temperature instead of coolant temperature at engine output" VALUE 0x8057F436 RB_Val_Wu8 1.00000000000 B_TRUE 0.00 1.00000000000 FORMAT "%13.11" /end CHARACTERISTIC
/begin CHARACTERISTIC TWCC_flgLamPurgBascEngOperPnt_C "Flag to select basic lambda for purging based on engine operation point (engine speed and load) instead of oxygen mass and exhaust mass flow" VALUE 0x8057F437 RB_Val_Wu8 1.00000000000 B_TRUE 0.00 1.00000000000 FORMAT "%13.11" /end CHARACTERISTIC
/begin CHARACTERISTIC TWCC_flgLamPurgRelO2_C "Switch to select Lambda for purging based on relative O2 level" VALUE 0x8057F438 RB_Val_Wu8 1.00000000000 B_TRUE 0.00 1.00000000000 FORMAT "%13.11" /end CHARACTERISTIC
/begin CHARACTERISTIC TWCC_flgReqPurgWoDly_C "Flag request purging without delay after injection resumes" VALUE 0x8057F439 RB_Val_Wu8 1.00000000000 B_TRUE 0.00 1.00000000000 FORMAT "%13.11" /end CHARACTERISTIC
/begin CHARACTERISTIC TWCC_flgRstCatPurgRstrt_CW "Code word for enabling reset of catalyst purge in engine start" VALUE 0x8057F43A RB_Val_Wu8 1.00000000000 B_TRUE 0.00 1.00000000000 FORMAT "%13.11" /end CHARACTERISTIC
/begin CHARACTERISTIC TWCC_flgRstPurgMixFlt_CW "code word for enabling and resetting the catalyst purge by a timeout criterion with lambda controller limit." VALUE 0x8057F43B RB_Val_Wu8 1.00000000000 B_TRUE 0.00 1.00000000000 FORMAT "%13.11" /end CHARACTERISTIC
/begin CHARACTERISTIC TWCC_mO2MinThresCat1Purg_C "minimum O2-level catalyst1 to request catalyst purge" VALUE 0x8057F43C RB_Val_Wu32 429496729.500 m_q0p1_mg 0.00 429496729.500 FORMAT "%13.3" /end CHARACTERISTIC
/begin CHARACTERISTIC TWCC_mO2MinThresCat2Purg_C "minimum O2-level catalyst2 to request catalyst purge" VALUE 0x8057F440 RB_Val_Wu32 429496729.500 m_q0p1_mg 0.00 429496729.500 FORMAT "%13.3" /end CHARACTERISTIC
/begin CHARACTERISTIC TWCC_OSCCat1B1_I.facOSCKNBB_C "oxygen storage capacity for catalyst purging, catalyst 1 bank 1 / correction of maximum oxygen storage capacity for catalyst purge if sensor not ready for operation" VALUE 0x8057F67C RB_Val_Wu8 3.984 fak_ub_b4 0.00 3.984 FORMAT "%5.3" /end CHARACTERISTIC
/begin CHARACTERISTIC TWCC_OSCCat1B1_I.facOSCKNBB_MAP "oxygen storage capacity for catalyst purging, catalyst 1 bank 1 / Catayst ageing and temperature dependent correction of maximum oxygen storage capacity for catalyst purge if sensor not ready for operation" MAP 0x8057F67E RB_Map_U16S16_U16 655.3500 fak_q0p01 0.00 655.3500 FORMAT "%8.4"
 /begin AXIS_DESCR STD_AXIS NO_INPUT_QUANTITY fak_q0p000244 5 0.00 15.99976 FORMAT "%8.5" DEPOSIT ABSOLUTE /end AXIS_DESCR
 /begin AXIS_DESCR STD_AXIS NO_INPUT_QUANTITY Temp_Cels 8 -3549.940 3003.560 FORMAT "%8.3" DEPOSIT ABSOLUTE /end AXIS_DESCR
/end CHARACTERISTIC
/begin CHARACTERISTIC TWCC_OSCCat1B1_I.facOSCK_C "oxygen storage capacity for catalyst purging, catalyst 1 bank 1 / correction of maximum oxygen storage capacity for catalyst purge if sensor ready for operation" VALUE 0x8057F6EC RB_Val_Wu8 3.984 fak_ub_b4 0.00 3.984 FORMAT "%5.3" /end CHARACTERISTIC
/begin CHARACTERISTIC TWCC_OSCCat1B1_I.facOSCK_MAP "oxygen storage capacity for catalyst purging, catalyst 1 bank 1 / Catayst ageing and temperature dependent correction of maximum oxygen storage capacity for catalyst purge if sensor ready for operation" MAP 0x8057F6EE RB_Map_U16S16_U16 655.3500 fak_q0p01 0.00 655.3500 FORMAT "%8.4"
 /begin AXIS_DESCR STD_AXIS NO_INPUT_QUANTITY fak_q0p000244 5 0.00 15.99976 FORMAT "%8.5" DEPOSIT ABSOLUTE /end AXIS_DESCR
 /begin AXIS_DESCR STD_AXIS NO_INPUT_QUANTITY Temp_Cels 8 -3549.940 3003.560 FORMAT "%8.3" DEPOSIT ABSOLUTE /end AXIS_DESCR
/end CHARACTERISTIC
/begin CHARACTERISTIC TWCC_OSCCat1B1_I.flgOSCFacSeln_CW "oxygen storage capacity for catalyst purging, catalyst 1 bank 1 / Code bit for selection of catalyst ageing and temperature dependent correction of maximum oxygen storage capacity for catalyst purge" VALUE 0x8057F75C RB_Val_Wu8 1.00000000000 B_TRUE 0.00 1.00000000000 FORMAT "%13.11" /end CHARACTERISTIC
/begin CHARACTERISTIC TWCC_OSCCat2B1_I.facOSCKNBB_C "oxygen storage capacity for catalyst purging, catalyst 2 bank 1 / correction of maximum oxygen storage capacity for catalyst purge if sensor not ready for operation" VALUE 0x8057F75E RB_Val_Wu8 3.984 fak_ub_b4 0.00 3.984 FORMAT "%5.3" /end CHARACTERISTIC
/begin CHARACTERISTIC TWCC_OSCCat2B1_I.facOSCKNBB_MAP "oxygen storage capacity for catalyst purging, catalyst 2 bank 1 / Catayst ageing and temperature dependent correction of maximum oxygen storage capacity for catalyst purge if sensor not ready for operation" MAP 0x8057F760 RB_Map_U16S16_U16 655.3500 fak_q0p01 0.00 655.3500 FORMAT "%8.4"
 /begin AXIS_DESCR STD_AXIS NO_INPUT_QUANTITY fak_q0p000244 5 0.00 15.99976 FORMAT "%8.5" DEPOSIT ABSOLUTE /end AXIS_DESCR
 /begin AXIS_DESCR STD_AXIS NO_INPUT_QUANTITY Temp_Cels 8 -3549.940 3003.560 FORMAT "%8.3" DEPOSIT ABSOLUTE /end AXIS_DESCR
/end CHARACTERISTIC
/begin CHARACTERISTIC TWCC_OSCCat2B1_I.facOSCK_C "oxygen storage capacity for catalyst purging, catalyst 2 bank 1 / correction of maximum oxygen storage capacity for catalyst purge if sensor ready for operation" VALUE 0x8057F7CE RB_Val_Wu8 3.984 fak_ub_b4 0.00 3.984 FORMAT "%5.3" /end CHARACTERISTIC
/begin CHARACTERISTIC TWCC_OSCCat2B1_I.facOSCK_MAP "oxygen storage capacity for catalyst purging, catalyst 2 bank 1 / Catayst ageing and temperature dependent correction of maximum oxygen storage capacity for catalyst purge if sensor ready for operation" MAP 0x8057F7D0 RB_Map_U16S16_U16 655.3500 fak_q0p01 0.00 655.3500 FORMAT "%8.4"
 /begin AXIS_DESCR STD_AXIS NO_INPUT_QUANTITY fak_q0p000244 5 0.00 15.99976 FORMAT "%8.5" DEPOSIT ABSOLUTE /end AXIS_DESCR
 /begin AXIS_DESCR STD_AXIS NO_INPUT_QUANTITY Temp_Cels 8 -3549.940 3003.560 FORMAT "%8.3" DEPOSIT ABSOLUTE /end AXIS_DESCR
/end CHARACTERISTIC
/begin CHARACTERISTIC TWCC_OSCCat2B1_I.flgOSCFacSeln_CW "oxygen storage capacity for catalyst purging, catalyst 2 bank 1 / Code bit for selection of catalyst ageing and temperature dependent correction of maximum oxygen storage capacity for catalyst purge" VALUE 0x8057F83E RB_Val_Wu8 1.00000000000 B_TRUE 0.00 1.00000000000 FORMAT "%13.11" /end CHARACTERISTIC
/begin CHARACTERISTIC TWCC_ratLamMinPurgCatT_T "Lower limit of Lambda setpoint for purging, dependent on catalyst temperature" CURVE 0x8057F444 RB_Curve_S16_U16_Static 15.99976 fak_uw_b16 0.00 15.99976 FORMAT "%8.5"
 /begin AXIS_DESCR STD_AXIS TWCC_tCat1WpDisp Temp_Cels 4 -3549.940 3003.560 FORMAT "%8.3" DEPOSIT ABSOLUTE /end AXIS_DESCR
/end CHARACTERISTIC
/begin CHARACTERISTIC TWCC_ratLamMinPurgEngOperPnt_M "Lower limit map of lambda setpoints for purging dependent on engine operation point (only relevant in case of an oxygen mass- and exhaust mass flow- depending basic lambda)" MAP 0x8057F456 RB_Map_U16U16_U16 15.99976 fak_uw_b16 0.00 15.99976 FORMAT "%8.5"
 /begin AXIS_DESCR STD_AXIS TWCC_nEngWpDisp nmot_uw_q0p25 5 0.00 16383.75 FORMAT "%8.2" DEPOSIT ABSOLUTE /end AXIS_DESCR
 /begin AXIS_DESCR STD_AXIS AirMod_ratChrgAirCyl rel_uw_q0p0234 4 0.00 1535.977 FORMAT "%8.3" DEPOSIT ABSOLUTE /end AXIS_DESCR
/end CHARACTERISTIC
/begin CHARACTERISTIC TWCC_ratLamMinPurgEngT_T "Lower limit curve of lambda setpoints for purging dependent on engine temperature (oil model temperature or coolant temperature at engine output)" CURVE 0x8057F494 RB_Curve_S16_U16_Static 15.99976 fak_uw_b16 0.00 15.99976 FORMAT "%8.5"
 /begin AXIS_DESCR STD_AXIS TWCC_tEngWpDisp Temp_Cels 4 -3549.940 3003.560 FORMAT "%8.3" DEPOSIT ABSOLUTE /end AXIS_DESCR
/end CHARACTERISTIC
/begin CHARACTERISTIC TWCC_ratLamMinPurgO2_T "Lower limit curve of lambda setpoints for purging depending on oxygen mass in the catalyst (only relevant in case of an engine operation point depending basic lambda)" CURVE 0x8057F4A6 RB_Curve_U16_U16 15.99976 fak_uw_b16 0.00 15.99976 FORMAT "%8.5"
 /begin AXIS_DESCR STD_AXIS TWCC_mO2StPurgMWpDisp m_q1_mg 4 0.00 65535.00 FORMAT "%8.2" DEPOSIT ABSOLUTE /end AXIS_DESCR
/end CHARACTERISTIC
/begin CHARACTERISTIC TWCC_ratLamMinPurgRelO2_T "Lower limit curve of lambda setpoints for purging depending on relative oxygen mass in the catalyst (only relevant in case of an engine operation point depending basic lambda)" CURVE 0x8057F4B8 RB_Curve_U16_U16 15.99976 fak_uw_b16 0.00 15.99976 FORMAT "%8.5"
 /begin AXIS_DESCR STD_AXIS TWCC_ratO2PurgWpDisp fak_uw_b2 4 0.00 1.999969 FORMAT "%8.6" DEPOSIT ABSOLUTE /end AXIS_DESCR
/end CHARACTERISTIC
/begin CHARACTERISTIC TWCC_ratLamSetPurgRelO2_M "Lambda-setpoint for catalyst purge based on relative O2 level" MAP 0x8057F4CA RB_Map_U16S16_U16 15.99976 fak_uw_b16 0.00 15.99976 FORMAT "%8.5"
 /begin AXIS_DESCR STD_AXIS TWCC_ratO2PurgWpDisp fak_uw_b2 5 0.00 1.999969 FORMAT "%8.6" DEPOSIT ABSOLUTE /end AXIS_DESCR
 /begin AXIS_DESCR STD_AXIS TWCC_dmfExhCat1MWpDisp m_q0p1 8 -3276.800 3276.700 FORMAT "%8.3" DEPOSIT ABSOLUTE /end AXIS_DESCR
/end CHARACTERISTIC
/begin CHARACTERISTIC TWCC_ratLamSpPurgEngOperPnt_M "Lambda setpoint map for catalyst purge based on engine operation point (engine speed and load)" MAP 0x8057F538 RB_Map_U16U16_U16 15.99976 fak_uw_b16 0.00 15.99976 FORMAT "%8.5"
 /begin AXIS_DESCR STD_AXIS TWCC_nEngWpDisp nmot_uw_q0p25 5 0.00 16383.75 FORMAT "%8.2" DEPOSIT ABSOLUTE /end AXIS_DESCR
 /begin AXIS_DESCR STD_AXIS AirMod_ratChrgAirCyl rel_uw_q0p0234 4 0.00 1535.977 FORMAT "%8.3" DEPOSIT ABSOLUTE /end AXIS_DESCR
/end CHARACTERISTIC
/begin CHARACTERISTIC TWCC_rLamSetPPurg_MAP "lambda setpoint map catalyst purge" MAP 0x8057F576 RB_Map_U16S16_U16 15.99976 fak_uw_b16 0.00 15.99976 FORMAT "%8.5"
 /begin AXIS_DESCR STD_AXIS TWCC_mO2StPurgMWpDisp m_q1_mg 5 0.00 65535.00 FORMAT "%8.2" DEPOSIT ABSOLUTE /end AXIS_DESCR
 /begin AXIS_DESCR STD_AXIS TWCC_dmfExhCat1MWpDisp m_q0p1 8 -3276.800 3276.700 FORMAT "%8.3" DEPOSIT ABSOLUTE /end AXIS_DESCR
/end CHARACTERISTIC
/begin CHARACTERISTIC TWCC_rLamSetPSFlPurg_MAP "lambda setpoint map catalyst purge, second fuel" MAP 0x8057F5E4 RB_Map_U16S16_U16 15.99976 fak_uw_b16 0.00 15.99976 FORMAT "%8.5"
 /begin AXIS_DESCR STD_AXIS TWCC_mO2StPurgMWpDisp m_q1_mg 5 0.00 65535.00 FORMAT "%8.2" DEPOSIT ABSOLUTE /end AXIS_DESCR
 /begin AXIS_DESCR STD_AXIS TWCC_dmfExhCat1MWpDisp m_q0p1 4 -3276.800 3276.700 FORMAT "%8.3" DEPOSIT ABSOLUTE /end AXIS_DESCR
/end CHARACTERISTIC
/begin CHARACTERISTIC TWCC_stEngStTiPurg_C "Selection of engine off time status for use of engine off time in O2 balancing" VALUE 0x8057F622 RB_Val_Wu8 1.000 dez 0.00 1.000 FORMAT "%5.3" EXTENDED_LIMITS 0.00 255.0 /end CHARACTERISTIC
/begin CHARACTERISTIC TWCC_stPurg2_CW "codeword2 catalyst purge" VALUE 0x8057F623 RB_Val_Wu8 255.0 dez 0.00 255.0 FORMAT "%5.1" /end CHARACTERISTIC
/begin CHARACTERISTIC TWCC_stPurg_CW "codeword catalyst purge" VALUE 0x8057F624 RB_Val_Wu16 65535.00 dez 0.00 65535.00 FORMAT "%8.2" /end CHARACTERISTIC
/begin CHARACTERISTIC TWCC_tiAddlDlyLeanPurgShrtRgn_C "optional additional time to extend the lean mixture detection (short range)" VALUE 0x8057F626 RB_Val_Wu8 5.100 t_q0p02 0.00 5.100 FORMAT "%5.3" /end CHARACTERISTIC
/begin CHARACTERISTIC TWCC_tiDebEngOnKSPurg_C "delay time to release catalyst purge after engine start (key-start)" VALUE 0x8057F628 RB_Val_Wu16 655.3500 t_q0p01 0.00 655.3500 FORMAT "%8.4" /end CHARACTERISTIC
/begin CHARACTERISTIC TWCC_tiDebEngOnPurg_C "delay time to release catalyst purge after engine start (re-start during driving cycle)" VALUE 0x8057F62A RB_Val_Wu16 655.3500 t_q0p01 0.00 655.3500 FORMAT "%8.4" /end CHARACTERISTIC
/begin CHARACTERISTIC TWCC_tiDebEngStrt_C "Hold time of bit engine start for inhibit of catalyst purge during start" VALUE 0x8057F62C RB_Val_Wu8 5.100 t_q0p02 0.00 5.100 FORMAT "%5.3" /end CHARACTERISTIC
/begin CHARACTERISTIC TWCC_tiDebLamSetPUsActv_C "debounce time lambda setpoint active lambda-control upstream catalyst purge" VALUE 0x8057F62E RB_Val_Wu16 1310.700 t_q0p02 0.00 1310.700 FORMAT "%8.3" /end CHARACTERISTIC
/begin CHARACTERISTIC TWCC_tiRichTOutPurg_C "maximum time waiting for rich mixture" VALUE 0x8057F630 RB_Val_Wu16 1310.700 t_q0p02 0.00 1310.700 FORMAT "%8.3" /end CHARACTERISTIC
/begin CHARACTERISTIC TWCC_tiRmpLambdaSetPPurg_C "time ramp down lambda for catalyst purge" VALUE 0x8057F632 RB_Val_Wu16 1310.6999997 zk20msxs_uw_b1310p72 0.0200003 1310.7200000 FORMAT "%12.7" EXTENDED_LIMITS 0.020000305180 1310.7200000 /end CHARACTERISTIC
/begin CHARACTERISTIC TWCC_tiWaitRstStrt_C "Time after start end for reset of O2 level of the unmonitored catalyst" VALUE 0x8057F634 RB_Val_Wu16 6553.500 t_q0p1 0.00 6553.500 FORMAT "%8.3" /end CHARACTERISTIC
/begin CHARACTERISTIC TWCC_tMinThresPurg_C "maximum temperature for catalyst purge" VALUE 0x8057F636 RB_Val_Ws16 6553.500 Temp_Cels -3549.940 3003.560 FORMAT "%8.3" /end CHARACTERISTIC
/begin CHARACTERISTIC TWCC_uRstStrt_C "Threshold of sensor voltage for reset of the O2 level of the unmonitored catalyst after start end" VALUE 0x8057F638 RB_Val_Wu8 1.245 spg_q0p00488 0.00 1.245 FORMAT "%5.3" /end CHARACTERISTIC
/begin CHARACTERISTIC TWCC_uThresLeanCat1Purg_C "Lean voltage threshold for catalyst O2 full determination, catalyst 1" VALUE 0x8057F639 RB_Val_Wu8 1.245 spg_q0p00488 0.00 1.245 FORMAT "%5.3" /end CHARACTERISTIC
/begin CHARACTERISTIC TWCC_uThresRichCat1Purg_C "Rich voltage threshold for purge end determination, catalyst 1" VALUE 0x8057F63A RB_Val_Wu8 1.245 spg_q0p00488 0.00 1.245 FORMAT "%5.3" /end CHARACTERISTIC
/begin CHARACTERISTIC ZZAEHLMN "Cylinder offset for actual torque computation during engine start - delay" VALUE 0x8057F427 RB_Val_Wu8 24.00 dez 0.00 24.00 FORMAT "%5.2" EXTENDED_LIMITS 0.00 255.0 /end CHARACTERISTIC
/begin MEASUREMENT ActMod_bEngActv "Actual Torque of combustion engine active" UBYTE B_TRUE 1 100 0.00 1.00000000000 BIT_MASK 0x1 FORMAT "%13.11" ECU_ADDRESS 0x70000C4D /end MEASUREMENT
/begin MEASUREMENT ActMod_bTrqInrPsv "Condition positive inner torque of combustion engine" UBYTE B_TRUE 1 100 0.00 1.00000000000 BIT_MASK 0x1 FORMAT "%13.11" ECU_ADDRESS 0x70000C4C /end MEASUREMENT
/begin MEASUREMENT ActMod_trqClth "actual engine torque - clutch torque" SWORD md_q0p1 1 100 -3276.800 3276.700 FORMAT "%8.3" ECU_ADDRESS 0x500007C6 /end MEASUREMENT
/begin MEASUREMENT ActMod_trqCrS "actual engine torque - crankshaft torque" SWORD md_q0p1 1 100 -3276.800 3276.700 FORMAT "%8.3" ECU_ADDRESS 0x6000063E /end MEASUREMENT
/begin MEASUREMENT ActMod_trqInr "Current, back-calculated inner engine torque" SWORD md_q0p1 1 100 0.00 3276.700 FORMAT "%8.3" ECU_ADDRESS 0x60000642 /end MEASUREMENT
/begin MEASUREMENT B_stTOFFV_I.outbit "Turn off delay: After condition for start / Output Bit" UBYTE B_TRUE 1 100 0.00 1.00000000000 BIT_MASK 0x1 FORMAT "%13.11" ECU_ADDRESS 0x600070C8 /end MEASUREMENT
/begin MEASUREMENT B_stTOFFV_I.time "Turn off delay: After condition for start / Occured Time" UBYTE t_q0p02 1 100 0.00 5.100 FORMAT "%5.3" ECU_ADDRESS 0x600070C9 /end MEASUREMENT
/begin MEASUREMENT dmvad_w_msg "Delta resistant torque from resistant torque adaptation" SWORD rel_sw_b100 1 100 -100.0000 99.9969 FORMAT "%8.4" ECU_ADDRESS 0x70003A22 /end MEASUREMENT
/begin MEASUREMENT fmi2trq_w_msg "Conversion factor from relative to absolute torque" UWORD fak_q0p001_Nm_DIV_pc 1 100 0.00 25.50000 FORMAT "%8.5" ECU_ADDRESS 0x600007A4 /end MEASUREMENT
/begin MEASUREMENT ftrq2mi_w_msg "Conversion factor from absolute to relative torque" UWORD fak_q2p384Em4_pc_DIV_Nm 1 100 0.00 15.62476 FORMAT "%8.5" ECU_ADDRESS 0x600007B8 /end MEASUREMENT
/begin MEASUREMENT mdverl_w_msg "Resistant torque of the engine" UWORD rel_uw_b100 1 100 0.00 99.99847 FORMAT "%8.5" ECU_ADDRESS 0x600007CE /end MEASUREMENT
/begin MEASUREMENT miautget_w_msg "Engine torque without torque intervention" UWORD rel_uw_b100 1 100 0.00 99.99847 FORMAT "%8.5" ECU_ADDRESS 0x70003788 /end MEASUREMENT
/begin MEASUREMENT mimin_w_msg "Minimal engine torque" UWORD rel_uw_b100 1 100 0.00 99.99847 FORMAT "%8.5" ECU_ADDRESS 0x70003784 /end MEASUREMENT
/begin MEASUREMENT PhyMod_etaIgnBsAvrg "basic spark efficiency - average of cylinder drum" UWORD fak_uw_b2 1 100 0.00 1.999969 FORMAT "%8.6" ECU_ADDRESS 0x60000736 /end MEASUREMENT
/begin MEASUREMENT PhyMod_etaIgnMin "Minimum spark efficiency" UWORD fak_uw_b2 1 100 0.00 1.999969 FORMAT "%8.6" ECU_ADDRESS 0x60000738 /end MEASUREMENT
/begin MEASUREMENT PT_rTraGear "current ratio for transmission" SWORD TransR 1 100 -327.6800 327.6700 FORMAT "%8.4" ECU_ADDRESS 0x6000984A /end MEASUREMENT
/begin MEASUREMENT PT_rTraGear1 "Transmission torque ratio for gear 1" SWORD TransR 1 100 -327.6800 327.6700 FORMAT "%8.4" ECU_ADDRESS 0x6000985C /end MEASUREMENT
/begin MEASUREMENT PT_rTraGear2 "Transmission torque retio for gear 2" SWORD TransR 1 100 -327.6800 327.6700 FORMAT "%8.4" ECU_ADDRESS 0x6000985A /end MEASUREMENT
/begin MEASUREMENT PT_rTraGear3 "Transmission torque ratio for gear 3" SWORD TransR 1 100 -327.6800 327.6700 FORMAT "%8.4" ECU_ADDRESS 0x60009858 /end MEASUREMENT
/begin MEASUREMENT PT_rTraGear4 "Transmission torque ratio for gear4" SWORD TransR 1 100 -327.6800 327.6700 FORMAT "%8.4" ECU_ADDRESS 0x60009856 /end MEASUREMENT
/begin MEASUREMENT PT_rTraGear5 "Transmission torque ratio for gear 5" SWORD TransR 1 100 -327.6800 327.6700 FORMAT "%8.4" ECU_ADDRESS 0x60009854 /end MEASUREMENT
/begin MEASUREMENT PT_rTraGear6 "Transmission torque ratio for gear 6" SWORD TransR 1 100 -327.6800 327.6700 FORMAT "%8.4" ECU_ADDRESS 0x60009852 /end MEASUREMENT
/begin MEASUREMENT PT_rTraGear7 "Transmission torque ratio for gear7" SWORD TransR 1 100 -327.6800 327.6700 FORMAT "%8.4" ECU_ADDRESS 0x60009850 /end MEASUREMENT
/begin MEASUREMENT PT_rTraGear8 "Transmission torque ratio for gear8" SWORD TransR 1 100 -327.6800 327.6700 FORMAT "%8.4" ECU_ADDRESS 0x6000984E /end MEASUREMENT
/begin MEASUREMENT PT_rTraGear9 "Transmission torque ratio for gear9" SWORD TransR 1 100 -327.6800 327.6700 FORMAT "%8.4" ECU_ADDRESS 0x6000984C /end MEASUREMENT
/begin MEASUREMENT PT_rTraGearDes "destination ratio of transmission" SWORD TransR 1 100 -327.6800 327.6700 FORMAT "%8.4" ECU_ADDRESS 0x700053B6 /end MEASUREMENT
/begin MEASUREMENT PT_rTraGearR "Transmission torque ratio for reverse gear" SWORD TransR 1 100 -327.6800 327.6700 FORMAT "%8.4" ECU_ADDRESS 0x60009848 /end MEASUREMENT
/begin MEASUREMENT PT_rTraLoRng "Ratio of low range" SWORD TransR 1 100 -327.6800 327.6700 FORMAT "%8.4" ECU_ADDRESS 0x60009846 /end MEASUREMENT
/begin MEASUREMENT PT_rTraMax "maximum ratio of transmission" SWORD TransR 1 100 -327.6800 327.6700 FORMAT "%8.4" ECU_ADDRESS 0x60009844 /end MEASUREMENT
/begin MEASUREMENT PT_rTraV2N "quotient of velocity and engine speed" SWORD VelToN 1 100 -0.3276800 0.3276700 FORMAT "%9.7" ECU_ADDRESS 0x6001492A /end MEASUREMENT
/begin MEASUREMENT PT_stTraGrip "Gearbox grip status" UBYTE OneToOne 1 100 0.00 255.0 FORMAT "%5.1" ECU_ADDRESS 0x7000549F /end MEASUREMENT
/begin MEASUREMENT PT_stTraLoRng "stores info if low range is active" UBYTE OneToOne 1 100 0.00 255.0 FORMAT "%5.1" ECU_ADDRESS 0x6000FBB4 /end MEASUREMENT
/begin MEASUREMENT PT_stTraRevGear "status if reverse gear is selected" UBYTE OneToOne 1 100 0.00 255.0 FORMAT "%5.1" ECU_ADDRESS 0x60014AC5 /end MEASUREMENT
/begin MEASUREMENT PT_stTraShftOp "status is shift operation is active" UBYTE OneToOne 1 100 0.00 255.0 FORMAT "%5.1" ECU_ADDRESS 0x6000FBB3 /end MEASUREMENT
/begin MEASUREMENT PT_stTraType "Current transmission type" UBYTE OneToOne 1 100 0.00 255.0 FORMAT "%5.1" ECU_ADDRESS 0x60014AC7 /end MEASUREMENT
/begin MEASUREMENT PT_tqCluTrsmProtn "Transmission protection torque at clutch level" SWORD Trq 1 100 -3276.800 3276.700 FORMAT "%8.3" ECU_ADDRESS 0x60009834 /end MEASUREMENT
/begin MEASUREMENT RngMod_bEngActv "Torque Range of combustion engine active" UBYTE B_TRUE 1 100 0.00 1.00000000000 BIT_MASK 0x1 FORMAT "%13.11" ECU_ADDRESS 0x700007A0 /end MEASUREMENT
/begin MEASUREMENT RngMod_trqClthBs "basic clutch torque" SWORD md_q0p1 1 100 -3276.800 3276.700 FORMAT "%8.3" ECU_ADDRESS 0x50000874 /end MEASUREMENT
/begin MEASUREMENT RngMod_trqClthBsMin "basic clutch torque, lower limit" SWORD md_q0p1 1 100 -3276.800 3276.700 FORMAT "%8.3" ECU_ADDRESS 0x70003A62 /end MEASUREMENT
/begin MEASUREMENT RngMod_trqClthMax "maximum clutch torque" SWORD md_q0p1 1 100 -3276.800 3276.700 FORMAT "%8.3" ECU_ADDRESS 0x70003A60 /end MEASUREMENT
/begin MEASUREMENT RngMod_trqCrSBs "basic torque - crankshaft level" SWORD md_q0p1 1 100 -3276.800 3276.700 FORMAT "%8.3" ECU_ADDRESS 0x6000073A /end MEASUREMENT
/begin MEASUREMENT RngMod_trqCrSMax "maximum torque - crankshaft level" SWORD md_q0p1 1 100 -3276.800 3276.700 FORMAT "%8.3" ECU_ADDRESS 0x6000073E /end MEASUREMENT
/begin MEASUREMENT RngMod_trqInrBs "indicated basic torque" SWORD md_q0p1 1 100 0.00 3276.700 FORMAT "%8.3" ECU_ADDRESS 0x60000744 /end MEASUREMENT
/begin MEASUREMENT RngMod_trqInrBsMax "indicated basic torque, upper limit" SWORD md_q0p1 1 100 0.00 3276.700 FORMAT "%8.3" ECU_ADDRESS 0x5000087C /end MEASUREMENT
/begin MEASUREMENT RngMod_trqInrBsMin "indicated basic torque, lower limit" SWORD md_q0p1 1 100 0.00 3276.700 FORMAT "%8.3" ECU_ADDRESS 0x60000746 /end MEASUREMENT
/begin MEASUREMENT RngMod_trqInrBsMinAvrg "indicated basic torque, averaged lower limit" SWORD md_q0p1 1 100 0.00 3276.700 FORMAT "%8.3" ECU_ADDRESS 0x60000748 /end MEASUREMENT
/begin MEASUREMENT RngMod_trqInrMax "Maximum inner torque" SWORD md_q0p1 1 100 0.00 3276.700 FORMAT "%8.3" ECU_ADDRESS 0x60000750 /end MEASUREMENT
/begin MEASUREMENT RngMod_trqInrMaxAvl "maximum, currently available inner torque" SWORD md_q0p1 1 100 0.00 3276.700 FORMAT "%8.3" ECU_ADDRESS 0x60000752 /end MEASUREMENT
/begin MEASUREMENT RngMod_trqInrOpt "optimum indicated torque" SWORD md_q0p1 1 100 0.00 3276.700 FORMAT "%8.3" ECU_ADDRESS 0x60000756 /end MEASUREMENT
/begin MEASUREMENT TME_ratActEngPercTqPrmIdH62 "Actual engine - percent torque" SWORD Prc 1 100 0.00 399.9878 FORMAT "%8.4" ECU_ADDRESS 0x700053D2 /end MEASUREMENT
/begin MEASUREMENT TME_ratEngFricPercTqPrmIdH8E "Engine friction - percent torque" SWORD Prc 1 100 0.00 399.9878 FORMAT "%8.4" ECU_ADDRESS 0x700053D4 /end MEASUREMENT
/begin MEASUREMENT Tra_bDRTmrDec "Drive-Reverse timer decrement request flag" UBYTE OneToOne 1 100 0.00 255.0 FORMAT "%5.1" ECU_ADDRESS 0x6000B5CA /end MEASUREMENT
/begin MEASUREMENT Tra_bIgnRtdtCtlActvn "Status of Ignition retard control" UBYTE B_TRUE 1 100 0.00 1.00000000000 BIT_MASK 0x1 FORMAT "%13.11" ECU_ADDRESS 0x6000F8CB /end MEASUREMENT
/begin MEASUREMENT Tra_bPNTmrDec "Parking-Neutral timer decrement request flag" UBYTE OneToOne 1 100 0.00 255.0 FORMAT "%5.1" ECU_ADDRESS 0x6000B5C9 /end MEASUREMENT
/begin MEASUREMENT Tra_bRTraCan "transmission ratio is used from CAN" UBYTE B_TRUE 1 100 0.00 1.00000000000 BIT_MASK 0x1 FORMAT "%13.11" ECU_ADDRESS 0x70000745 /end MEASUREMENT
/begin MEASUREMENT Tra_cntrPostDrvLve "PostDrive leave counter" UBYTE OneToOne 1 100 0.00 255.0 FORMAT "%5.1" ECU_ADDRESS 0x6000B5C8 /end MEASUREMENT
/begin MEASUREMENT Tra_cntrReIni "Counter For Detecting Reini process" UBYTE OneToOne 1 100 0.00 255.0 FORMAT "%5.1" ECU_ADDRESS 0x6000B5CB /end MEASUREMENT
/begin MEASUREMENT Tra_cntrReIniProc100ms "100 ms drive cycle counter which is incremented when system state SyC_PostDrive is left" UBYTE OneToOne 1 100 0.00 255.0 FORMAT "%5.1" ECU_ADDRESS 0x6000B5D5 /end MEASUREMENT
/begin MEASUREMENT Tra_cntrReIniProc10ms "10 ms drive cycle counter which is incremented when system state SyC_PostDrive is left" UBYTE OneToOne 1 100 0.00 255.0 FORMAT "%5.1" ECU_ADDRESS 0x6000B5D8 /end MEASUREMENT
/begin MEASUREMENT Tra_facUpSpdCor_mp "the correction factor for gear shift up indication" SWORD Fact3 1 100 -327.6800 327.6700 FORMAT "%8.4" ECU_ADDRESS 0x7000A0A2 /end MEASUREMENT
/begin MEASUREMENT Tra_flgCANPlaus "Flag to indicate CAN plausible" UBYTE B_TRUE 1 100 0.00 1.00000000000 BIT_MASK 0x1 FORMAT "%13.11" ECU_ADDRESS 0x6000B5CC /end MEASUREMENT
/begin MEASUREMENT Tra_flgDecrTraIntvDesActv "Decreasing transmission intervention is active from standpoint of transmission" UBYTE B_TRUE 1 100 0.00 1.00000000000 BIT_MASK 0x1 FORMAT "%13.11" ECU_ADDRESS 0x6000B5C7 /end MEASUREMENT
/begin MEASUREMENT Tra_flgDecrTraIntvDesEnd "Decreasing transmission intervention has ended in this time step" UBYTE B_TRUE 1 100 0.00 1.00000000000 BIT_MASK 0x1 FORMAT "%13.11" ECU_ADDRESS 0x6000B5C6 /end MEASUREMENT
/begin MEASUREMENT Tra_flgGearCanPtd "Flag for availability of gear information on CAN" UBYTE B_TRUE 1 100 0.00 1.00000000000 BIT_MASK 0x1 FORMAT "%13.11" ECU_ADDRESS 0x6000FB7E /end MEASUREMENT
/begin MEASUREMENT Tra_flgGearDetPtd "Flag for the validity of calculated gear" UBYTE B_TRUE 1 100 0.00 1.00000000000 BIT_MASK 0x1 FORMAT "%13.11" ECU_ADDRESS 0x6000FB7D /end MEASUREMENT
/begin MEASUREMENT Tra_flgIncrTraIntvDesActv "Increasing transmission intervention is active from standpoint of transmission" UBYTE B_TRUE 1 100 0.00 1.00000000000 BIT_MASK 0x1 FORMAT "%13.11" ECU_ADDRESS 0x6000B5C5 /end MEASUREMENT
/begin MEASUREMENT Tra_flgIncrTraIntvDesEnd "Increasing transmission intervention has ended in this time step" UBYTE B_TRUE 1 100 0.00 1.00000000000 BIT_MASK 0x1 FORMAT "%13.11" ECU_ADDRESS 0x6000B5C4 /end MEASUREMENT
/begin MEASUREMENT Tra_flgNeutPrkg "NeutralParking judjing flag" UBYTE OneToOne 1 100 0.00 255.0 BIT_MASK 0x1 FORMAT "%5.1" ECU_ADDRESS 0x6000F8CA /end MEASUREMENT
/begin MEASUREMENT Tra_frAccRstnFlt_mp "filtered the acceleration resistance to estimate road slope" SWORD DrvFr 1 100 -32768.00 32767.00 FORMAT "%8.2" ECU_ADDRESS 0x7000A0A0 /end MEASUREMENT
/begin MEASUREMENT Tra_frAccRstn_mp "the acceleration resistance to estimate road slope" SWORD DrvFr 1 100 -32768.00 32767.00 FORMAT "%8.2" ECU_ADDRESS 0x7000A09E /end MEASUREMENT
/begin MEASUREMENT Tra_frBaseAftShft_mp "the maximum force after gear shift up" SWORD DrvFr 1 100 -32768.00 32767.00 FORMAT "%8.2" ECU_ADDRESS 0x7000A09C /end MEASUREMENT
/begin MEASUREMENT Tra_frCurrRstnFlt_mp "filtered the current driving resistance to estimate road slope" SWORD DrvFr 1 100 -32768.00 32767.00 FORMAT "%8.2" ECU_ADDRESS 0x7000A09A /end MEASUREMENT
/begin MEASUREMENT Tra_frCurrRstn_mp "the current driving resistance to estimate road slope" SWORD DrvFr 1 100 -32768.00 32767.00 FORMAT "%8.2" ECU_ADDRESS 0x7000A098 /end MEASUREMENT
/begin MEASUREMENT Tra_frNeed2ShftUp_mp "threshold of spare force to gear shift up" SWORD DrvFr 1 100 -32768.00 32767.00 FORMAT "%8.2" ECU_ADDRESS 0x7000A096 /end MEASUREMENT
/begin MEASUREMENT Tra_frNeedAftShft_mp "the driving resistance depends on slope after shift up" SWORD DrvFr 1 100 -32768.00 32767.00 FORMAT "%8.2" ECU_ADDRESS 0x7000A094 /end MEASUREMENT
/begin MEASUREMENT Tra_frOutMax_mp "the maximum force for shift indicator lamp" SWORD DrvFr 1 100 -32768.00 32767.00 FORMAT "%8.2" ECU_ADDRESS 0x7000A092 /end MEASUREMENT
/begin MEASUREMENT Tra_frSlpEst_mp "the driving resistance depends on slope" SWORD DrvFr 1 100 -32768.00 32767.00 FORMAT "%8.2" ECU_ADDRESS 0x7000A090 /end MEASUREMENT
/begin MEASUREMENT Tra_frSpr2Dwn_mp "spare force to gear shift down" SWORD DrvFr 1 100 -32768.00 32767.00 FORMAT "%8.2" ECU_ADDRESS 0x7000A08E /end MEASUREMENT
/begin MEASUREMENT Tra_frSprAftShft_mp "spare force to gear shift up" SWORD DrvFr 1 100 -32768.00 32767.00 FORMAT "%8.2" ECU_ADDRESS 0x7000A08C /end MEASUREMENT
/begin MEASUREMENT Tra_frSprCurr_mp "current spare driving force" SWORD DrvFr 1 100 -32768.00 32767.00 FORMAT "%8.2" ECU_ADDRESS 0x7000A08A /end MEASUREMENT
/begin MEASUREMENT Tra_frWhlFlt_mp "demand force from wheel torque" SWORD DrvFr 1 100 -32768.00 32767.00 FORMAT "%8.2" ECU_ADDRESS 0x7000A088 /end MEASUREMENT
/begin MEASUREMENT Tra_frWhlUnFlt_mp "unfiltered demand force from wheel torque" SWORD DrvFr 1 100 -32768.00 32767.00 FORMAT "%8.2" ECU_ADDRESS 0x7000A086 /end MEASUREMENT
/begin MEASUREMENT Tra_nASTDes "Synchronisation speed" SWORD EngN 1 100 -16384.00 16383.50 FORMAT "%8.2" ECU_ADDRESS 0x60009780 /end MEASUREMENT
/begin MEASUREMENT Tra_nEngFlt_mp "low-pass filtered engine speed" SWORD EngN 1 100 -16384.00 16383.50 FORMAT "%8.2" ECU_ADDRESS 0x7000A0B0 /end MEASUREMENT
/begin MEASUREMENT Tra_nFrShftDwn_mp "threshold of engine speed to shift down forcely" SWORD EngN 1 100 -16384.00 16383.50 FORMAT "%8.2" ECU_ADDRESS 0x7000A084 /end MEASUREMENT
/begin MEASUREMENT Tra_nInhShftDwn_mp "engine speed to inhibit shift down" SWORD EngN 1 100 -16384.00 16383.50 FORMAT "%8.2" ECU_ADDRESS 0x7000A082 /end MEASUREMENT
/begin MEASUREMENT Tra_nMax "Maximum engine speed for gearbox" SWORD EngN 1 100 -16384.00 16383.50 FORMAT "%8.2" ECU_ADDRESS 0x6000977E /end MEASUREMENT
/begin MEASUREMENT Tra_nMin "Minimum engine speed for gearbox" SWORD EngN 1 100 -16384.00 16383.50 FORMAT "%8.2" ECU_ADDRESS 0x6000977C /end MEASUREMENT
/begin MEASUREMENT Tra_nReqEngFco "Fuel cut off request engine speed" SWORD EngN 1 100 -16384.00 16383.50 FORMAT "%8.2" ECU_ADDRESS 0x60009778 /end MEASUREMENT
/begin MEASUREMENT Tra_numDflGear_mp "measuring point for default value of gear" SBYTE OneToOne 1 100 -128.0 127.0 FORMAT "%5.1" ECU_ADDRESS 0x7000A0AE /end MEASUREMENT
/begin MEASUREMENT Tra_numDispGear "Variable to Display the current Gear number" SBYTE OneToOne 1 100 -128.0 127.0 FORMAT "%5.1" ECU_ADDRESS 0x6000B5D7 /end MEASUREMENT
/begin MEASUREMENT Tra_numGear "Current gear information" SBYTE OneToOne 1 100 -128.0 127.0 FORMAT "%5.1" ECU_ADDRESS 0x60014AD3 /end MEASUREMENT
/begin MEASUREMENT Tra_numGear1_mp "current gear number plus one" SWORD OneToOne 1 100 -32768.00 32767.00 FORMAT "%8.2" ECU_ADDRESS 0x7000A080 /end MEASUREMENT
/begin MEASUREMENT Tra_numGearDes "Application parameter for gear number of the destination gear of the transmission" SBYTE OneToOne 1 100 -128.0 127.0 FORMAT "%5.1" ECU_ADDRESS 0x60010000 /end MEASUREMENT
/begin MEASUREMENT Tra_numGearDesPf "Desired Gear number detection based on platform logic" SBYTE OneToOne 1 100 -128.0 127.0 FORMAT "%5.1" ECU_ADDRESS 0x6000FFFF /end MEASUREMENT
/begin MEASUREMENT Tra_numGearDisp "Actual gear number display" SBYTE OneToOne 1 100 -128.0 127.0 FORMAT "%5.1" ECU_ADDRESS 0x6000FFFE /end MEASUREMENT
/begin MEASUREMENT Tra_numGearPf "Gear number detection based on platform logic" SBYTE OneToOne 1 100 -128.0 127.0 FORMAT "%5.1" ECU_ADDRESS 0x6000B5D9 /end MEASUREMENT
/begin MEASUREMENT Tra_numLstGear "stored current gear calculated last call" SBYTE OneToOne 1 100 -128.0 127.0 FORMAT "%5.1" ECU_ADDRESS 0x6000FFFD /end MEASUREMENT
/begin MEASUREMENT Tra_numLstParGear "stored parameter gear calculated last call" SBYTE OneToOne 1 100 -128.0 127.0 FORMAT "%5.1" ECU_ADDRESS 0x6000FFFC /end MEASUREMENT
/begin MEASUREMENT Tra_numParGear "Application parameter for gear number of the parameter gear of the transmission" SBYTE OneToOne 1 100 -128.0 127.0 FORMAT "%5.1" ECU_ADDRESS 0x6000FFFB /end MEASUREMENT
/begin MEASUREMENT Tra_numStInd "The current number of shift indicater" UBYTE dez 1 100 0.00 255.0 FORMAT "%5.1" ECU_ADDRESS 0x6000F76B /end MEASUREMENT
/begin MEASUREMENT Tra_numStIndAmb "The current number of shift indicater for ambient meter" UBYTE dez 1 100 0.00 255.0 FORMAT "%5.1" ECU_ADDRESS 0x6000B5D4 /end MEASUREMENT
/begin MEASUREMENT Tra_rAppDes "Accelerator pedal value with high resolution" SWORD APPCrCtl1 1 100 0.00 163.8350 FORMAT "%8.4" ECU_ADDRESS 0x60009776 /end MEASUREMENT
/begin MEASUREMENT Tra_rAppDwnInh_mp "Acceleration value for gear shift down inhibition" SWORD Prc 1 100 -400.0000 399.9878 FORMAT "%8.4" ECU_ADDRESS 0x7000A07E /end MEASUREMENT
/begin MEASUREMENT Tra_rAppLLimSel_mp "the accelerator demand value" SWORD Prc 1 100 -400.0000 399.9878 FORMAT "%8.4" ECU_ADDRESS 0x7000A07C /end MEASUREMENT
/begin MEASUREMENT Tra_rClgDem "Relative fan cooling capacity" SWORD Prc 1 100 -400.0000 399.9878 FORMAT "%8.4" ECU_ADDRESS 0x60008FCE /end MEASUREMENT
/begin MEASUREMENT Tra_rCVTDesGearRat "CVT desired gear ratio detection" SWORD TransR 1 100 -327.6800 327.6700 FORMAT "%8.4" ECU_ADDRESS 0x60009774 /end MEASUREMENT
/begin MEASUREMENT Tra_rCVTDesGearRat_mp "Desired CVT gear ratio at 0.001bit resolution" SWORD RatHiRes_COMPU 1 100 -32.76800 32.76700 FORMAT "%8.5" ECU_ADDRESS 0x7000A0AC /end MEASUREMENT
/begin MEASUREMENT Tra_rCVTGearRat "CVT gear ratio" SWORD TransR 1 100 -327.6800 327.6700 FORMAT "%8.4" ECU_ADDRESS 0x60009772 /end MEASUREMENT
/begin MEASUREMENT Tra_rCVTGearRat_mp "CVT gear ratio at 0.001bit resolution" SWORD RatHiRes_COMPU 1 100 -32.76800 32.76700 FORMAT "%8.5" ECU_ADDRESS 0x7000A0AA /end MEASUREMENT
/begin MEASUREMENT Tra_rDesGearRatDetn "Desired gear ratio detection" SWORD TransR 1 100 -327.6800 327.6700 FORMAT "%8.4" ECU_ADDRESS 0x60009770 /end MEASUREMENT
/begin MEASUREMENT Tra_rGearCVT "Actual gear ratio for CVT" SWORD TransR 1 100 -327.6800 327.6700 FORMAT "%8.4" ECU_ADDRESS 0x6000974A /end MEASUREMENT
/begin MEASUREMENT Tra_rGearCVT1Hi "Maximum ratio of the 1st gear" SWORD TransR 1 100 -327.6800 327.6700 FORMAT "%8.4" ECU_ADDRESS 0x6000976E /end MEASUREMENT
/begin MEASUREMENT Tra_rGearCVT1Lo "Minimum ratio of the 1st gear" SWORD TransR 1 100 -327.6800 327.6700 FORMAT "%8.4" ECU_ADDRESS 0x6000976C /end MEASUREMENT
/begin MEASUREMENT Tra_rGearCVT2Hi "Maximum ratio of the 2nd gear" SWORD TransR 1 100 -327.6800 327.6700 FORMAT "%8.4" ECU_ADDRESS 0x6000976A /end MEASUREMENT
/begin MEASUREMENT Tra_rGearCVT2Lo "Minimum ratio of the 2nd gear" SWORD TransR 1 100 -327.6800 327.6700 FORMAT "%8.4" ECU_ADDRESS 0x60009768 /end MEASUREMENT
/begin MEASUREMENT Tra_rGearCVT3Hi "Maximum ratio of the 3rd gear" SWORD TransR 1 100 -327.6800 327.6700 FORMAT "%8.4" ECU_ADDRESS 0x60009766 /end MEASUREMENT
/begin MEASUREMENT Tra_rGearCVT3Lo "Minimum ratio of the 3rd gear" SWORD TransR 1 100 -327.6800 327.6700 FORMAT "%8.4" ECU_ADDRESS 0x60009764 /end MEASUREMENT
/begin MEASUREMENT Tra_rGearCVT4Hi "Maximum ratio of the 4th gear" SWORD TransR 1 100 -327.6800 327.6700 FORMAT "%8.4" ECU_ADDRESS 0x60009762 /end MEASUREMENT
/begin MEASUREMENT Tra_rGearCVT4Lo "Minimum ratio of the 4th gear" SWORD TransR 1 100 -327.6800 327.6700 FORMAT "%8.4" ECU_ADDRESS 0x60009760 /end MEASUREMENT
/begin MEASUREMENT Tra_rGearCVT5Hi "Maximum ratio of the 5th gear" SWORD TransR 1 100 -327.6800 327.6700 FORMAT "%8.4" ECU_ADDRESS 0x6000975E /end MEASUREMENT
/begin MEASUREMENT Tra_rGearCVT5Lo "Minimum ratio of the 5th gear" SWORD TransR 1 100 -327.6800 327.6700 FORMAT "%8.4" ECU_ADDRESS 0x6000975C /end MEASUREMENT
/begin MEASUREMENT Tra_rGearCVT6Hi "Maximum ratio of the 6th gear" SWORD TransR 1 100 -327.6800 327.6700 FORMAT "%8.4" ECU_ADDRESS 0x6000975A /end MEASUREMENT
/begin MEASUREMENT Tra_rGearCVT6Lo "Minimum ratio of the 6th gear" SWORD TransR 1 100 -327.6800 327.6700 FORMAT "%8.4" ECU_ADDRESS 0x60009758 /end MEASUREMENT
/begin MEASUREMENT Tra_rGearCVT7Hi "Maximum ratio of the 7th gear" SWORD TransR 1 100 -327.6800 327.6700 FORMAT "%8.4" ECU_ADDRESS 0x60009756 /end MEASUREMENT
/begin MEASUREMENT Tra_rGearCVT7Lo "Minimum ratio of the 7th gear" SWORD TransR 1 100 -327.6800 327.6700 FORMAT "%8.4" ECU_ADDRESS 0x60009754 /end MEASUREMENT
/begin MEASUREMENT Tra_rGearCVT8Hi "Maximum ratio of the 8th gear" SWORD TransR 1 100 -327.6800 327.6700 FORMAT "%8.4" ECU_ADDRESS 0x60009752 /end MEASUREMENT
/begin MEASUREMENT Tra_rGearCVT8Lo "Minimum ratio of the 8th gear" SWORD TransR 1 100 -327.6800 327.6700 FORMAT "%8.4" ECU_ADDRESS 0x60009750 /end MEASUREMENT
/begin MEASUREMENT Tra_rGearCVT9Hi "Maximum ratio of the 9th gear" SWORD TransR 1 100 -327.6800 327.6700 FORMAT "%8.4" ECU_ADDRESS 0x6000974E /end MEASUREMENT
/begin MEASUREMENT Tra_rGearCVT9Lo "Minimum ratio of the 9th gear" SWORD TransR 1 100 -327.6800 327.6700 FORMAT "%8.4" ECU_ADDRESS 0x6000974C /end MEASUREMENT
/begin MEASUREMENT Tra_rGearRatDetn "Gear ratio detection" SWORD TransR 1 100 -327.6800 327.6700 FORMAT "%8.4" ECU_ADDRESS 0x600070F8 /end MEASUREMENT
/begin MEASUREMENT Tra_rGearTarCVT "Target Gear ratio for CVT" SWORD TransR 1 100 -327.6800 327.6700 FORMAT "%8.4" ECU_ADDRESS 0x60009748 /end MEASUREMENT
/begin MEASUREMENT Tra_rLoLdAPPThres_mp "acceleration ratio threshold to detect low load" SWORD Prc 1 100 -400.0000 399.9878 FORMAT "%8.4" ECU_ADDRESS 0x7000A07A /end MEASUREMENT
/begin MEASUREMENT Tra_rSlopEstimnOld "Previous estimated value of road slope for shift indicator lamp" SLONG Prc 1 100 -26214400.0000 26214399.9878 FORMAT "%13.4" ECU_ADDRESS 0x6000263C /end MEASUREMENT
/begin MEASUREMENT Tra_rSlpEstFlt_mp "the result of the moving averaging value of estimation slope" SWORD Prc 1 100 -400.0000 399.9878 FORMAT "%8.4" ECU_ADDRESS 0x7000A078 /end MEASUREMENT
/begin MEASUREMENT Tra_rSlpEst_mp "estimation of road slope fot shift indicator lamp" SLONG Prc 1 100 -26214400.0000 26214399.9878 FORMAT "%13.4" ECU_ADDRESS 0x7000A074 /end MEASUREMENT
/begin MEASUREMENT Tra_rV2NLoRng_mp "quotient velocity to engine speed for low range" SWORD VelToN 1 100 -0.3276800 0.3276700 FORMAT "%9.7" ECU_ADDRESS 0x7000A0A8 /end MEASUREMENT
/begin MEASUREMENT Tra_rV2NUnFlt_mp "non-filtered v/n ratio" SWORD VelToN 1 100 -0.3276800 0.3276700 FORMAT "%9.7" ECU_ADDRESS 0x7000A0A6 /end MEASUREMENT
/begin MEASUREMENT Tra_stAmbLmp "Ambient Meter Display Pattern Status" UBYTE OneToOne 1 100 0.00 255.0 FORMAT "%5.1" ECU_ADDRESS 0x6000F76A /end MEASUREMENT
/begin MEASUREMENT Tra_stAppOpn "The status of accel open" UBYTE OneToOne 1 100 0.00 255.0 FORMAT "%5.1" ECU_ADDRESS 0x6000FB7C /end MEASUREMENT
/begin MEASUREMENT Tra_stAST "Automatic Shifted Transmission (AST) increasing intervention status" UWORD OneToOne 1 100 0.00 65535.00 FORMAT "%8.2" ECU_ADDRESS 0x600093C6 /end MEASUREMENT
/begin MEASUREMENT Tra_stCluActv_MP "Measuring point to indicate the clutch press activation" UBYTE OneToOne 1 100 0.00 255.0 FORMAT "%5.1" ECU_ADDRESS 0x7000A070 /end MEASUREMENT
/begin MEASUREMENT Tra_stCrkNotCmpl "Engine cranking is not finished(engine stop or cranking)" UBYTE OneToOne 1 100 0.00 255.0 FORMAT "%5.1" ECU_ADDRESS 0x6000FB7B /end MEASUREMENT
/begin MEASUREMENT Tra_stDwnSilDly "Delay time for shift down" UBYTE B_TRUE 1 100 0.00 1.00000000000 BIT_MASK 0x1 FORMAT "%13.11" ECU_ADDRESS 0x6000B5D2 /end MEASUREMENT
/begin MEASUREMENT Tra_stEcoLampEna "The status of the clutch off for SIL" UBYTE OneToOne 1 100 0.00 255.0 FORMAT "%5.1" ECU_ADDRESS 0x6000B5D1 /end MEASUREMENT
/begin MEASUREMENT Tra_stEcoLmpIdc "Actual throttle angle in of the maximum opening" UBYTE OneToOne 1 100 0.00 255.0 FORMAT "%5.1" ECU_ADDRESS 0x7000366C /end MEASUREMENT
/begin MEASUREMENT Tra_stEcoLmpSt "Message for status of turn on EcoLamp" UBYTE OneToOne 1 100 0.00 255.0 FORMAT "%5.1" ECU_ADDRESS 0x6000B5D0 /end MEASUREMENT
/begin MEASUREMENT Tra_stEcoLmpThr "The status of Eco Lamp request" UBYTE dez 1 100 0.00 255.0 FORMAT "%5.1" ECU_ADDRESS 0x6000B5CF /end MEASUREMENT
/begin MEASUREMENT Tra_stGearShftDwnIdctr "Message for status of gear shift down indicator" UBYTE OneToOne 1 100 0.00 255.0 FORMAT "%5.1" ECU_ADDRESS 0x6000FB79 /end MEASUREMENT
/begin MEASUREMENT Tra_stGearShftUpIdctr "Message for status of gear shift up indicator" UBYTE OneToOne 1 100 0.00 255.0 FORMAT "%5.1" ECU_ADDRESS 0x6000FB78 /end MEASUREMENT
/begin MEASUREMENT Tra_stHWSel "Variable for selecting the gearbox type information from Hardware or Software." UBYTE OneToOne 1 100 0.00 255.0 FORMAT "%5.1" ECU_ADDRESS 0x6000FB77 /end MEASUREMENT
/begin MEASUREMENT Tra_stInjCutOffNotPossbl "Flag to indicate injection cutoff is not possible" UBYTE B_TRUE 1 100 0.00 1.00000000000 BIT_MASK 0x1 FORMAT "%13.11" ECU_ADDRESS 0x6000B5C3 /end MEASUREMENT
/begin MEASUREMENT Tra_stISSActv_mp "Measurement point for state of ISS" UBYTE B_TRUE 1 100 0.00 1.00000000000 BIT_MASK 0x1 FORMAT "%13.11" ECU_ADDRESS 0x7000A06F /end MEASUREMENT
/begin MEASUREMENT Tra_stNeutrDetPre_mp "neutral detection pre condition for shift indicator lamp" UBYTE OneToOne 1 100 0.00 255.0 FORMAT "%5.1" ECU_ADDRESS 0x7000A06E /end MEASUREMENT
/begin MEASUREMENT Tra_stNeutrDet_mp "neutral detection status for shift indicator lamp" UBYTE OneToOne 1 100 0.00 255.0 FORMAT "%5.1" ECU_ADDRESS 0x7000A06D /end MEASUREMENT
/begin MEASUREMENT Tra_stNSetP "Status for current setpoint engine speed requirement" UBYTE OneToOne 1 100 0.00 255.0 FORMAT "%5.1" ECU_ADDRESS 0x6000FB76 /end MEASUREMENT
/begin MEASUREMENT Tra_stShftDwnInhCdn_mp "Gear shift down inhibit condition for AT" UBYTE OneToOne 1 100 0.00 255.0 FORMAT "%5.1" ECU_ADDRESS 0x7000A06C /end MEASUREMENT
/begin MEASUREMENT Tra_stShftDwnInhPre_mp "shift down inhibit pre condition" UWORD OneToOne 1 100 0.00 65535.00 FORMAT "%8.2" ECU_ADDRESS 0x7000A06A /end MEASUREMENT
/begin MEASUREMENT Tra_stShftDwnInh_mp "shift down inhibit status" UBYTE OneToOne 1 100 0.00 255.0 FORMAT "%5.1" ECU_ADDRESS 0x7000A068 /end MEASUREMENT
/begin MEASUREMENT Tra_stShftDwnNLo_mp "low engine speed status to shift down" UBYTE OneToOne 1 100 0.00 255.0 FORMAT "%5.1" ECU_ADDRESS 0x7000A067 /end MEASUREMENT
/begin MEASUREMENT Tra_stShftDwnReq_mp "shift down request status" UBYTE OneToOne 1 100 0.00 255.0 FORMAT "%5.1" ECU_ADDRESS 0x7000A066 /end MEASUREMENT
/begin MEASUREMENT Tra_stShftUpInhCdn_mp "Gear shift up inhibit condition for AT" UBYTE OneToOne 1 100 0.00 255.0 FORMAT "%5.1" ECU_ADDRESS 0x7000A065 /end MEASUREMENT
/begin MEASUREMENT Tra_stShftUpInhPre_mp "shift up inhibit pre condition" UBYTE OneToOne 1 100 0.00 255.0 FORMAT "%5.1" ECU_ADDRESS 0x7000A064 /end MEASUREMENT
/begin MEASUREMENT Tra_stShftUpInh_mp "shift up inhibit status" UBYTE OneToOne 1 100 0.00 255.0 FORMAT "%5.1" ECU_ADDRESS 0x7000A063 /end MEASUREMENT
/begin MEASUREMENT Tra_stShftUpReq_mp "shift up request status" UBYTE OneToOne 1 100 0.00 255.0 FORMAT "%5.1" ECU_ADDRESS 0x7000A062 /end MEASUREMENT
/begin MEASUREMENT Tra_stSilOff "Delay time for not indicate SIL" UBYTE B_TRUE 1 100 0.00 1.00000000000 BIT_MASK 0x1 FORMAT "%13.11" ECU_ADDRESS 0x6000F8C9 /end MEASUREMENT
/begin MEASUREMENT Tra_stSilOffDly "Delay time for not indicate SIL" UBYTE B_TRUE 1 100 0.00 1.00000000000 BIT_MASK 0x1 FORMAT "%13.11" ECU_ADDRESS 0x6000B5CE /end MEASUREMENT
/begin MEASUREMENT Tra_stSilOffReqByVSA "SIL off request by VSA" UBYTE B_TRUE 1 100 0.00 1.00000000000 BIT_MASK 0x1 FORMAT "%13.11" ECU_ADDRESS 0x6000B5D6 /end MEASUREMENT
/begin MEASUREMENT Tra_stStopEna "enable stop function" UBYTE OneToOne 1 100 0.00 255.0 FORMAT "%5.1" ECU_ADDRESS 0x700054B8 /end MEASUREMENT
/begin MEASUREMENT Tra_stStrtEna "enable start function" UBYTE OneToOne 1 100 0.00 255.0 FORMAT "%5.1" ECU_ADDRESS 0x700054B9 /end MEASUREMENT
/begin MEASUREMENT Tra_stTraType "Status of the transmission type" UBYTE OneToOne 1 100 0.00 255.0 FORMAT "%5.1" ECU_ADDRESS 0x6000FB72 /end MEASUREMENT
/begin MEASUREMENT Tra_stTrsmTypFrz "freezed CAN value during harware or CAN error." UBYTE OneToOne 1 100 0.00 255.0 FORMAT "%5.1" ECU_ADDRESS 0x60038DBC /end MEASUREMENT
/begin MEASUREMENT Tra_stTSCPtd "TSC Plausibility status" UBYTE OneToOne 1 100 0.00 255.0 FORMAT "%5.1" ECU_ADDRESS 0x6000FB75 /end MEASUREMENT
/begin MEASUREMENT Tra_stTSCPtdDes "Gearbox torque intervention permitted" UBYTE OneToOne 1 100 0.00 255.0 FORMAT "%5.1" ECU_ADDRESS 0x6000FB74 /end MEASUREMENT
/begin MEASUREMENT Tra_stTSCPtdLead "Transmission intervention torque permitted" UBYTE OneToOne 1 100 0.00 255.0 FORMAT "%5.1" ECU_ADDRESS 0x6000FB73 /end MEASUREMENT
/begin MEASUREMENT Tra_stUpInhPre_mp "shift up inhibit pre condition" UWORD OneToOne 1 100 0.00 65535.00 FORMAT "%8.2" ECU_ADDRESS 0x7000A060 /end MEASUREMENT
/begin MEASUREMENT Tra_stUpSilDly "Delay time for shift up" UBYTE B_TRUE 1 100 0.00 1.00000000000 BIT_MASK 0x1 FORMAT "%13.11" ECU_ADDRESS 0x6000B5CD /end MEASUREMENT
/begin MEASUREMENT Tra_swtCVTSig "CVT signal switch" UBYTE OneToOne 1 100 0.00 255.0 FORMAT "%5.1" ECU_ADDRESS 0x6000FB71 /end MEASUREMENT
/begin MEASUREMENT Tra_swtSlctGearInfoCan_mp "switch to read information form CAN" UBYTE OneToOne 1 100 0.00 255.0 FORMAT "%5.1" ECU_ADDRESS 0x7000A0A4 /end MEASUREMENT
/begin MEASUREMENT Tra_tClntDes "Coolant temperature - Set point value" SWORD Temp_Cels 1 100 -3549.940 3003.560 FORMAT "%8.3" ECU_ADDRESS 0x60008FCC /end MEASUREMENT
/begin MEASUREMENT Tra_tiASTDes "Synchronisation time" SWORD Time_s 1 100 -327.6800 327.6700 FORMAT "%8.4" ECU_ADDRESS 0x60009746 /end MEASUREMENT
/begin MEASUREMENT Tra_tiDREvl "Drive-reverse evaluation time" SWORD Time_ms 1 100 -327680.0 327670.0 FORMAT "%8.1" ECU_ADDRESS 0x600070F2 /end MEASUREMENT
/begin MEASUREMENT Tra_tiPNEvl "Parking-Neutral evaluation time" SWORD Time_ms 1 100 -327680.0 327670.0 FORMAT "%8.1" ECU_ADDRESS 0x600070F0 /end MEASUREMENT
/begin MEASUREMENT Tra_tqDesDecIntvEndRamp "Formed torque at the end of a decreasing transmission intervention" SWORD Trq 1 100 -3276.800 3276.700 FORMAT "%8.3" ECU_ADDRESS 0x600070EC /end MEASUREMENT
/begin MEASUREMENT Tra_tqDesIncIntvEndRamp "Formed torque at the end of a increasing transmission intervention" SWORD Trq 1 100 -3276.800 3276.700 FORMAT "%8.3" ECU_ADDRESS 0x600070EA /end MEASUREMENT
/begin MEASUREMENT Tra_tqHiSil "Table high value for throttle" SWORD Trq 1 100 -3276.800 3276.700 FORMAT "%8.3" ECU_ADDRESS 0x600070F6 /end MEASUREMENT
/begin MEASUREMENT Tra_tqIncIntvDesEndRampOut_mp "Ramped output torque at the end of an increasing transmission intervention" SWORD Trq 1 100 -3276.800 3276.700 FORMAT "%8.3" ECU_ADDRESS 0x7000A04E /end MEASUREMENT
/begin MEASUREMENT Tra_tqLoSil "Table low value for throttle" SWORD Trq 1 100 -3276.800 3276.700 FORMAT "%8.3" ECU_ADDRESS 0x600070F4 /end MEASUREMENT
/begin MEASUREMENT Tra_tqProtnGear_MP "Protection torque determied from application curve for gear 1 to 9 and R" SWORD Trq 1 100 -3276.800 3276.700 FORMAT "%8.3" ECU_ADDRESS 0x7000A052 /end MEASUREMENT
/begin MEASUREMENT Tra_tqProtnTrsm "Transmission protection torque" SWORD Trq 1 100 -3276.800 3276.700 FORMAT "%8.3" ECU_ADDRESS 0x60013DEA /end MEASUREMENT
/begin MEASUREMENT Tra_tqPrtKnall_mp "Measuring point of torque value jump start path" SWORD Trq 1 100 -3276.800 3276.700 FORMAT "%8.3" ECU_ADDRESS 0x7000A050 /end MEASUREMENT
/begin MEASUREMENT Tra_trqDecDemDes_mp "Decreasing intervention torque on desired path" SWORD Trq 1 100 -3276.800 3276.700 FORMAT "%8.3" ECU_ADDRESS 0x7000A04C /end MEASUREMENT
/begin MEASUREMENT Tra_trqDecDemLead_mp "Decreasing intervention torque for lead path" SWORD Trq 1 100 -3276.800 3276.700 FORMAT "%8.3" ECU_ADDRESS 0x7000A04A /end MEASUREMENT
/begin MEASUREMENT Tra_trqDecIntvDesEndRampOut_mp "Ramped output torque at the end of a decreasing transmission intervention" SWORD Trq 1 100 -3276.800 3276.700 FORMAT "%8.3" ECU_ADDRESS 0x7000A048 /end MEASUREMENT
/begin MEASUREMENT Tra_trqDesMax "Decrement torque demand from gearbox" SWORD Trq 1 100 -3276.800 3276.700 FORMAT "%8.3" ECU_ADDRESS 0x60009744 /end MEASUREMENT
/begin MEASUREMENT Tra_trqDesMin "Increment torque demand from gearbox" SWORD Trq 1 100 -3276.800 3276.700 FORMAT "%8.3" ECU_ADDRESS 0x60009742 /end MEASUREMENT
/begin MEASUREMENT Tra_trqIncDemDes_mp "Increasing intervention torque on desired path" SWORD Trq 1 100 -3276.800 3276.700 FORMAT "%8.3" ECU_ADDRESS 0x7000A046 /end MEASUREMENT
/begin MEASUREMENT Tra_trqIncDemLead_mp "Current torque value measuringpoint for lead path" SWORD Trq 1 100 -3276.800 3276.700 FORMAT "%8.3" ECU_ADDRESS 0x7000A044 /end MEASUREMENT
/begin MEASUREMENT Tra_trqLeadMax "Decrement lead torque demand from gearbox" SWORD Trq 1 100 -3276.800 3276.700 FORMAT "%8.3" ECU_ADDRESS 0x60009740 /end MEASUREMENT
/begin MEASUREMENT Tra_trqLeadMin "Increment lead torque demand from gearbox" SWORD Trq 1 100 -3276.800 3276.700 FORMAT "%8.3" ECU_ADDRESS 0x6000973E /end MEASUREMENT
/begin MEASUREMENT Tra_trqLoLdTrqThres_mp "torque threshold to detect low load" SWORD Trq 1 100 -3276.800 3276.700 FORMAT "%8.3" ECU_ADDRESS 0x7000A05E /end MEASUREMENT
/begin MEASUREMENT Tra_trqLos "Gearbox torque loss" SWORD Trq 1 100 -3276.800 3276.700 FORMAT "%8.3" ECU_ADDRESS 0x60014966 /end MEASUREMENT
/begin MEASUREMENT Tra_trqTSCIntvDesCVT "Internal engine target torque for Des path for CVT" SWORD Trq 1 100 -3276.800 3276.700 FORMAT "%8.3" ECU_ADDRESS 0x6000973C /end MEASUREMENT
/begin MEASUREMENT Tra_trqTSCIntvLeadCVT "Internal engine target torque for lead path for CVT" SWORD Trq 1 100 -3276.800 3276.700 FORMAT "%8.3" ECU_ADDRESS 0x6000973A /end MEASUREMENT
/begin MEASUREMENT Tra_vBaseShftUpCor_mp "correction vehicle speed to gear shift up" SWORD Vel 1 100 -327.6800 327.6700 FORMAT "%8.4" ECU_ADDRESS 0x7000A05C /end MEASUREMENT
/begin MEASUREMENT Tra_vBaseShftUp_mp "vehicle speed to gear shift up" SWORD Vel 1 100 -327.6800 327.6700 FORMAT "%8.4" ECU_ADDRESS 0x7000A05A /end MEASUREMENT
/begin MEASUREMENT Tra_vDRBShftUp_mp "drivability vehicle speed to shift up" SWORD Vel 1 100 -327.6800 327.6700 FORMAT "%8.4" ECU_ADDRESS 0x7000A058 /end MEASUREMENT
/begin MEASUREMENT Tra_vShftUpInhThres_mp "threshold of vehicle speed to inhibit shift up" SWORD Vel 1 100 -327.6800 327.6700 FORMAT "%8.4" ECU_ADDRESS 0x7000A056 /end MEASUREMENT
/begin MEASUREMENT Tra_vSlpEstVehFlt_mp "filtered vehicle speed for slope estimation" SWORD Vel 1 100 -327.6800 327.6700 FORMAT "%8.4" ECU_ADDRESS 0x7000A054 /end MEASUREMENT
/begin MEASUREMENT TSDa_tClntIniVal "initial value of coolant temperature at engine outlet" SWORD Temp_Cels 1 100 -3549.940 3003.560 FORMAT "%8.3" ECU_ADDRESS 0x60008FE8 /end MEASUREMENT
/begin MEASUREMENT TSDa_tClntRadOut "Coolant temperature at radiator outlet" SWORD Temp_Cels 1 100 -3549.940 3003.560 FORMAT "%8.3" ECU_ADDRESS 0x60008FE6 /end MEASUREMENT
/begin MEASUREMENT TS_tClntEngOut "coolant temperature at engine outlet" SWORD Temp_Cels 1 100 -3549.940 3003.560 FORMAT "%8.3" ECU_ADDRESS 0x60008FE4 /end MEASUREMENT
/begin MEASUREMENT TWCC_BalCat1B1_I.bEngOffMark "oxygen balancing for catalyst purge, catalyst 1 / marker for engine off" UBYTE B_TRUE 1 100 0.00 1.00000000000 BIT_MASK 0x1 FORMAT "%13.11" ECU_ADDRESS 0x50001D08 /end MEASUREMENT
/begin MEASUREMENT TWCC_BalCat1B1_I.bEngOffO2 "oxygen balancing for catalyst purge, catalyst 1 / marker for minimum oxygen entry during engine off" UBYTE B_TRUE 1 100 0.00 1.00000000000 BIT_MASK 0x2 FORMAT "%13.11" ECU_ADDRESS 0x50001D08 /end MEASUREMENT
/begin MEASUREMENT TWCC_BalCat1B1_I.bLeanPurg "oxygen balancing for catalyst purge, catalyst 1 / oxygen entry into catalyst in lean phase" UBYTE B_TRUE 1 100 0.00 1.00000000000 BIT_MASK 0x4 FORMAT "%13.11" ECU_ADDRESS 0x50001D08 /end MEASUREMENT
/begin MEASUREMENT TWCC_BalCat1B1_I.bLeanSt "oxygen balancing for catalyst purge, catalyst 1 / catalyst full of oxygen" UBYTE B_TRUE 1 100 0.00 1.00000000000 BIT_MASK 0x1 FORMAT "%13.11" ECU_ADDRESS 0x50001D0A /end MEASUREMENT
/begin MEASUREMENT TWCC_BalCat1B1_I.bO2Max "oxygen balancing for catalyst purge, catalyst 1 / maximum oxygen level reached while engine off" UBYTE B_TRUE 1 100 0.00 1.00000000000 BIT_MASK 0x8 FORMAT "%13.11" ECU_ADDRESS 0x50001D08 /end MEASUREMENT
/begin MEASUREMENT TWCC_BalCat1B1_I.bO2MaxEngOn "oxygen balancing for catalyst purge, catalyst 1 / maximum oxygen level reached during normal engine on operation" UBYTE B_TRUE 1 100 0.00 1.00000000000 BIT_MASK 0x4 FORMAT "%13.11" ECU_ADDRESS 0x50001D09 /end MEASUREMENT
/begin MEASUREMENT TWCC_BalCat1B1_I.bO2MinThres "oxygen balancing for catalyst purge, catalyst 1 / minimum amount of oxygen in catalyst for requesting purge present" UBYTE B_TRUE 1 100 0.00 1.00000000000 BIT_MASK 0x10 FORMAT "%13.11" ECU_ADDRESS 0x50001D08 /end MEASUREMENT
/begin MEASUREMENT TWCC_BalCat1B1_I.bRichReq "oxygen balancing for catalyst purge, catalyst 1 / request of catalyst purge" UBYTE B_TRUE 1 100 0.00 1.00000000000 BIT_MASK 0x1 FORMAT "%13.11" ECU_ADDRESS 0x50001D0B /end MEASUREMENT
/begin MEASUREMENT TWCC_BalCat1B1_I.bRichSt "oxygen balancing for catalyst purge, catalyst 1 / oxygen fully purged" UBYTE B_TRUE 1 100 0.00 1.00000000000 BIT_MASK 0x1 FORMAT "%13.11" ECU_ADDRESS 0x50001D0C /end MEASUREMENT
/begin MEASUREMENT TWCC_BalCat1B1_I.bRstSensRich "oxygen balancing for catalyst purge, catalyst 1 / reset catalyst with rich sensor without change from lean to rich detected" UBYTE B_TRUE 1 100 0.00 1.00000000000 BIT_MASK 0x20 FORMAT "%13.11" ECU_ADDRESS 0x50001D08 /end MEASUREMENT
/begin MEASUREMENT TWCC_BalCat1B1_I.bSensLean "oxygen balancing for catalyst purge, catalyst 1 / lean sensor output detected" UBYTE B_TRUE 1 100 0.00 1.00000000000 BIT_MASK 0x40 FORMAT "%13.11" ECU_ADDRESS 0x50001D08 /end MEASUREMENT
/begin MEASUREMENT TWCC_BalCat1B1_I.bSensLeanToRich "oxygen balancing for catalyst purge, catalyst 1 / sensor voltage change from lean to rich detected" UBYTE B_TRUE 1 100 0.00 1.00000000000 BIT_MASK 0x80 FORMAT "%13.11" ECU_ADDRESS 0x50001D08 /end MEASUREMENT
/begin MEASUREMENT TWCC_BalCat1B1_I.flgExtdPurgCng "oxygen balancing for catalyst purge, catalyst 1 / flag to extend the purging due to the presence of excess H2 in CNG." UBYTE B_TRUE 1 100 0.00 1.00000000000 BIT_MASK 0x1 FORMAT "%13.11" ECU_ADDRESS 0x50001D0D /end MEASUREMENT
/begin MEASUREMENT TWCC_BalCat1B1_I.mO2 "oxygen balancing for catalyst purge, catalyst 1 / oxygen storage level" ULONG m_q0p1_mg 1 100 0.00 429496729.500 FORMAT "%13.3" ECU_ADDRESS 0x50001D10 /end MEASUREMENT
/begin MEASUREMENT TWCC_BalCat1B1_I.mO2Max "oxygen balancing for catalyst purge, catalyst 1 / maximum oxygen level while engine off" ULONG m_q0p1_mg 1 100 0.00 429496729.500 FORMAT "%13.3" ECU_ADDRESS 0x50001D14 /end MEASUREMENT
/begin MEASUREMENT TWCC_BalCat1B1_I.mO2MaxEngOn "oxygen balancing for catalyst purge, catalyst 1 / maximum oxygen level while engine on" ULONG m_q0p1_mg 1 100 0.00 429496729.500 FORMAT "%13.3" ECU_ADDRESS 0x50001D18 /end MEASUREMENT
/begin MEASUREMENT TWCC_BalCat1B1_I.tiEngOff "oxygen balancing for catalyst purge, catalyst 1 / engine stop time" UWORD t_q1 1 100 0.00 65535.00 FORMAT "%8.2" ECU_ADDRESS 0x50001D1C /end MEASUREMENT
/begin MEASUREMENT TWCC_BalCat1B1_I.O2_IKL.memory "oxygen balancing for catalyst purge, catalyst 1 / oxygen balance / Current Integrator value" FLOAT32_IEEE m_q1_mg 1 100 0.0000 1.0000E+037 FORMAT "%10.4" ECU_ADDRESS 0x50001D20 /end MEASUREMENT
/begin MEASUREMENT TWCC_BalCat1B1_I.SensLeanER_I.buffer "oxygen balancing for catalyst purge, catalyst 1 / edge-rising lean sensor output detected / rising edge detected" UBYTE B_TRUE 1 100 0.00 1.00000000000 BIT_MASK 0x1 FORMAT "%13.11" ECU_ADDRESS 0x50001D24 /end MEASUREMENT
/begin MEASUREMENT TWCC_BalCat1B1_I.SensLeanER_I.oldSignal "oxygen balancing for catalyst purge, catalyst 1 / edge-rising lean sensor output detected / flag rising edge" UBYTE B_TRUE 1 100 0.00 1.00000000000 BIT_MASK 0x1 FORMAT "%13.11" ECU_ADDRESS 0x50001D25 /end MEASUREMENT
/begin MEASUREMENT TWCC_BalCat1B1_I.SensLeanToRichER_I.buffer "oxygen balancing for catalyst purge, catalyst 1 / edge-rising sensor voltage change from lean to rich detected / rising edge detected" UBYTE B_TRUE 1 100 0.00 1.00000000000 BIT_MASK 0x1 FORMAT "%13.11" ECU_ADDRESS 0x50001D26 /end MEASUREMENT
/begin MEASUREMENT TWCC_BalCat1B1_I.SensLeanToRichER_I.oldSignal "oxygen balancing for catalyst purge, catalyst 1 / edge-rising sensor voltage change from lean to rich detected / flag rising edge" UBYTE B_TRUE 1 100 0.00 1.00000000000 BIT_MASK 0x1 FORMAT "%13.11" ECU_ADDRESS 0x50001D27 /end MEASUREMENT
/begin MEASUREMENT TWCC_BalCat2B1_I.bEngOffMark "oxygen balancing for catalyst purge, catalyst 2 / marker for engine off" UBYTE B_TRUE 1 100 0.00 1.00000000000 BIT_MASK 0x1 FORMAT "%13.11" ECU_ADDRESS 0x50001D28 /end MEASUREMENT
/begin MEASUREMENT TWCC_BalCat2B1_I.bEngOffO2 "oxygen balancing for catalyst purge, catalyst 2 / marker for minimum oxygen entry during engine off" UBYTE B_TRUE 1 100 0.00 1.00000000000 BIT_MASK 0x2 FORMAT "%13.11" ECU_ADDRESS 0x50001D28 /end MEASUREMENT
/begin MEASUREMENT TWCC_BalCat2B1_I.bLeanPurg "oxygen balancing for catalyst purge, catalyst 2 / oxygen entry into catalyst in lean phase" UBYTE B_TRUE 1 100 0.00 1.00000000000 BIT_MASK 0x4 FORMAT "%13.11" ECU_ADDRESS 0x50001D28 /end MEASUREMENT
/begin MEASUREMENT TWCC_BalCat2B1_I.bLeanSt "oxygen balancing for catalyst purge, catalyst 2 / catalyst full of oxygen" UBYTE B_TRUE 1 100 0.00 1.00000000000 BIT_MASK 0x1 FORMAT "%13.11" ECU_ADDRESS 0x50001D2A /end MEASUREMENT
/begin MEASUREMENT TWCC_BalCat2B1_I.bO2Max "oxygen balancing for catalyst purge, catalyst 2 / maximum oxygen level reached while engine off" UBYTE B_TRUE 1 100 0.00 1.00000000000 BIT_MASK 0x8 FORMAT "%13.11" ECU_ADDRESS 0x50001D28 /end MEASUREMENT
/begin MEASUREMENT TWCC_BalCat2B1_I.bO2MaxEngOn "oxygen balancing for catalyst purge, catalyst 2 / maximum oxygen level reached during normal engine on operation" UBYTE B_TRUE 1 100 0.00 1.00000000000 BIT_MASK 0x4 FORMAT "%13.11" ECU_ADDRESS 0x50001D29 /end MEASUREMENT
/begin MEASUREMENT TWCC_BalCat2B1_I.bO2MinThres "oxygen balancing for catalyst purge, catalyst 2 / minimum amount of oxygen in catalyst for requesting purge present" UBYTE B_TRUE 1 100 0.00 1.00000000000 BIT_MASK 0x10 FORMAT "%13.11" ECU_ADDRESS 0x50001D28 /end MEASUREMENT
/begin MEASUREMENT TWCC_BalCat2B1_I.bRichReq "oxygen balancing for catalyst purge, catalyst 2 / request of catalyst purge" UBYTE B_TRUE 1 100 0.00 1.00000000000 BIT_MASK 0x1 FORMAT "%13.11" ECU_ADDRESS 0x50001D2B /end MEASUREMENT
/begin MEASUREMENT TWCC_BalCat2B1_I.bRichSt "oxygen balancing for catalyst purge, catalyst 2 / oxygen fully purged" UBYTE B_TRUE 1 100 0.00 1.00000000000 BIT_MASK 0x1 FORMAT "%13.11" ECU_ADDRESS 0x50001D2C /end MEASUREMENT
/begin MEASUREMENT TWCC_BalCat2B1_I.bRstSensRich "oxygen balancing for catalyst purge, catalyst 2 / reset catalyst with rich sensor without change from lean to rich detected" UBYTE B_TRUE 1 100 0.00 1.00000000000 BIT_MASK 0x20 FORMAT "%13.11" ECU_ADDRESS 0x50001D28 /end MEASUREMENT
/begin MEASUREMENT TWCC_BalCat2B1_I.bSensLean "oxygen balancing for catalyst purge, catalyst 2 / lean sensor output detected" UBYTE B_TRUE 1 100 0.00 1.00000000000 BIT_MASK 0x40 FORMAT "%13.11" ECU_ADDRESS 0x50001D28 /end MEASUREMENT
/begin MEASUREMENT TWCC_BalCat2B1_I.bSensLeanToRich "oxygen balancing for catalyst purge, catalyst 2 / sensor voltage change from lean to rich detected" UBYTE B_TRUE 1 100 0.00 1.00000000000 BIT_MASK 0x80 FORMAT "%13.11" ECU_ADDRESS 0x50001D28 /end MEASUREMENT
/begin MEASUREMENT TWCC_BalCat2B1_I.flgExtdPurgCng "oxygen balancing for catalyst purge, catalyst 2 / flag to extend the purging due to the presence of excess H2 in CNG." UBYTE B_TRUE 1 100 0.00 1.00000000000 BIT_MASK 0x1 FORMAT "%13.11" ECU_ADDRESS 0x50001D2D /end MEASUREMENT
/begin MEASUREMENT TWCC_BalCat2B1_I.mO2 "oxygen balancing for catalyst purge, catalyst 2 / oxygen storage level" ULONG m_q0p1_mg 1 100 0.00 429496729.500 FORMAT "%13.3" ECU_ADDRESS 0x50001D30 /end MEASUREMENT
/begin MEASUREMENT TWCC_BalCat2B1_I.mO2Max "oxygen balancing for catalyst purge, catalyst 2 / maximum oxygen level while engine off" ULONG m_q0p1_mg 1 100 0.00 429496729.500 FORMAT "%13.3" ECU_ADDRESS 0x50001D34 /end MEASUREMENT
/begin MEASUREMENT TWCC_BalCat2B1_I.mO2MaxEngOn "oxygen balancing for catalyst purge, catalyst 2 / maximum oxygen level while engine on" ULONG m_q0p1_mg 1 100 0.00 429496729.500 FORMAT "%13.3" ECU_ADDRESS 0x50001D38 /end MEASUREMENT
/begin MEASUREMENT TWCC_BalCat2B1_I.tiEngOff "oxygen balancing for catalyst purge, catalyst 2 / engine stop time" UWORD t_q1 1 100 0.00 65535.00 FORMAT "%8.2" ECU_ADDRESS 0x50001D3C /end MEASUREMENT
/begin MEASUREMENT TWCC_BalCat2B1_I.O2_IKL.memory "oxygen balancing for catalyst purge, catalyst 2 / oxygen balance / Current Integrator value" FLOAT32_IEEE m_q1_mg 1 100 0.0000 1.0000E+037 FORMAT "%10.4" ECU_ADDRESS 0x50001D40 /end MEASUREMENT
/begin MEASUREMENT TWCC_BalCat2B1_I.SensLeanER_I.buffer "oxygen balancing for catalyst purge, catalyst 2 / edge-rising lean sensor output detected / rising edge detected" UBYTE B_TRUE 1 100 0.00 1.00000000000 BIT_MASK 0x1 FORMAT "%13.11" ECU_ADDRESS 0x50001D44 /end MEASUREMENT
/begin MEASUREMENT TWCC_BalCat2B1_I.SensLeanER_I.oldSignal "oxygen balancing for catalyst purge, catalyst 2 / edge-rising lean sensor output detected / flag rising edge" UBYTE B_TRUE 1 100 0.00 1.00000000000 BIT_MASK 0x1 FORMAT "%13.11" ECU_ADDRESS 0x50001D45 /end MEASUREMENT
/begin MEASUREMENT TWCC_BalCat2B1_I.SensLeanToRichER_I.buffer "oxygen balancing for catalyst purge, catalyst 2 / edge-rising sensor voltage change from lean to rich detected / rising edge detected" UBYTE B_TRUE 1 100 0.00 1.00000000000 BIT_MASK 0x1 FORMAT "%13.11" ECU_ADDRESS 0x50001D46 /end MEASUREMENT
/begin MEASUREMENT TWCC_BalCat2B1_I.SensLeanToRichER_I.oldSignal "oxygen balancing for catalyst purge, catalyst 2 / edge-rising sensor voltage change from lean to rich detected / flag rising edge" UBYTE B_TRUE 1 100 0.00 1.00000000000 BIT_MASK 0x1 FORMAT "%13.11" ECU_ADDRESS 0x50001D47 /end MEASUREMENT
/begin MEASUREMENT TWCC_bCatModPurgRstC2B1 "reset oxygen filling level catalyst 2 bank 1 via rich sensor voltage downstream main catalyst after (stop-)start" UBYTE B_TRUE 1 100 0.00 1.00000000000 BIT_MASK 0x1 FORMAT "%13.11" ECU_ADDRESS 0x70000104 /end MEASUREMENT
/begin MEASUREMENT TWCC_bDebEngOnPurg "bit catalyst purge enabled after engine on" UBYTE B_TRUE 1 100 0.00 1.00000000000 BIT_MASK 0x1 FORMAT "%13.11" ECU_ADDRESS 0x70000103 /end MEASUREMENT
/begin MEASUREMENT TWCC_bEnaLeanPurgB1 "Flag lean gas entering catalyst bank 1" UBYTE B_TRUE 1 100 0.00 1.00000000000 BIT_MASK 0x1 FORMAT "%13.11" ECU_ADDRESS 0x70000102 /end MEASUREMENT
/begin MEASUREMENT TWCC_bEnaRichPurgB1 "bit catalyst purge with rich lambda requested, bank 1" UBYTE B_TRUE 1 100 0.00 1.00000000000 BIT_MASK 0x1 FORMAT "%13.11" ECU_ADDRESS 0x70000764 /end MEASUREMENT
/begin MEASUREMENT TWCC_bEngOffPurg "bit engine off" UBYTE B_TRUE 1 100 0.00 1.00000000000 BIT_MASK 0x1 FORMAT "%13.11" ECU_ADDRESS 0x70000101 /end MEASUREMENT
/begin MEASUREMENT TWCC_bEngOffPurgTOFFV_I.outbit "Turn off delay: bit engine off / Output Bit" UBYTE B_TRUE 1 100 0.00 1.00000000000 BIT_MASK 0x1 FORMAT "%13.11" ECU_ADDRESS 0x600070BC /end MEASUREMENT
/begin MEASUREMENT TWCC_bEngOffPurgTOFFV_I.time "Turn off delay: bit engine off / Occured Time" UWORD t_q0p02 1 100 0.00 1310.700 FORMAT "%8.3" ECU_ADDRESS 0x600070BE /end MEASUREMENT
/begin MEASUREMENT TWCC_bInhNoRstCatPurgB1 "bit Inhibit catalyst purge without O2 model reset" UBYTE B_TRUE 1 100 0.00 1.00000000000 BIT_MASK 0x1 FORMAT "%13.11" ECU_ADDRESS 0x70000100 /end MEASUREMENT
/begin MEASUREMENT TWCC_bLeanInCat1PurgB1 "bit O2-entry into catalyst1" UBYTE B_TRUE 1 100 0.00 1.00000000000 BIT_MASK 0x1 FORMAT "%13.11" ECU_ADDRESS 0x700000FF /end MEASUREMENT
/begin MEASUREMENT TWCC_bLeanInCat2PurgB1 "bit O2-entry into catalyst2" UBYTE B_TRUE 1 100 0.00 1.00000000000 BIT_MASK 0x1 FORMAT "%13.11" ECU_ADDRESS 0x700000FE /end MEASUREMENT
/begin MEASUREMENT TWCC_bLeanPurgB1 "bit lean mixture" UBYTE B_TRUE 1 100 0.00 1.00000000000 BIT_MASK 0x1 FORMAT "%13.11" ECU_ADDRESS 0x700000FD /end MEASUREMENT
/begin MEASUREMENT TWCC_bLeanStCat1PurgB1 "bit O2-filled catalyst 1" UBYTE B_TRUE 1 100 0.00 1.00000000000 BIT_MASK 0x1 FORMAT "%13.11" ECU_ADDRESS 0x7000075D /end MEASUREMENT
/begin MEASUREMENT TWCC_bLeanStCat2PurgB1 "bit O2-filled catalyst 2" UBYTE B_TRUE 1 100 0.00 1.00000000000 BIT_MASK 0x1 FORMAT "%13.11" ECU_ADDRESS 0x7000075C /end MEASUREMENT
/begin MEASUREMENT TWCC_bRichInCat1PurgB1 "bit rich catalyst purge catalyst1" UBYTE B_TRUE 1 100 0.00 1.00000000000 BIT_MASK 0x1 FORMAT "%13.11" ECU_ADDRESS 0x700000FC /end MEASUREMENT
/begin MEASUREMENT TWCC_bRichInCat2PurgB1 "bit rich catalyst purge catalyst2" UBYTE B_TRUE 1 100 0.00 1.00000000000 BIT_MASK 0x1 FORMAT "%13.11" ECU_ADDRESS 0x700000FB /end MEASUREMENT
/begin MEASUREMENT TWCC_bRichReqCat1PurgB1 "bit request rich mixture catalyst 1" UBYTE B_TRUE 1 100 0.00 1.00000000000 BIT_MASK 0x1 FORMAT "%13.11" ECU_ADDRESS 0x700000FA /end MEASUREMENT
/begin MEASUREMENT TWCC_bRichReqCat2PurgB1 "bit request rich mixture catalyst 2" UBYTE B_TRUE 1 100 0.00 1.00000000000 BIT_MASK 0x1 FORMAT "%13.11" ECU_ADDRESS 0x700000F9 /end MEASUREMENT
/begin MEASUREMENT TWCC_bRichReqPurgB1 "bit overall request rich mixture" UBYTE B_TRUE 1 100 0.00 1.00000000000 BIT_MASK 0x1 FORMAT "%13.11" ECU_ADDRESS 0x700000F8 /end MEASUREMENT
/begin MEASUREMENT TWCC_bRichStCat1PurgB1 "bit O2-empty catalyst 1" UBYTE B_TRUE 1 100 0.00 1.00000000000 BIT_MASK 0x1 FORMAT "%13.11" ECU_ADDRESS 0x700000F7 /end MEASUREMENT
/begin MEASUREMENT TWCC_bRichStCat2PurgB1 "bit O2-empty catalyst 2" UBYTE B_TRUE 1 100 0.00 1.00000000000 BIT_MASK 0x1 FORMAT "%13.11" ECU_ADDRESS 0x700000F6 /end MEASUREMENT
/begin MEASUREMENT TWCC_bRstCatPurgB1 "bit reset catalysts" UBYTE B_TRUE 1 100 0.00 1.00000000000 BIT_MASK 0x1 FORMAT "%13.11" ECU_ADDRESS 0x700000F5 /end MEASUREMENT
/begin MEASUREMENT TWCC_bRstPurgB1 "bit terminate catalyst purge" UBYTE B_TRUE 1 100 0.00 1.00000000000 BIT_MASK 0x1 FORMAT "%13.11" ECU_ADDRESS 0x70000757 /end MEASUREMENT
/begin MEASUREMENT TWCC_B_stz_ER.buffer "Condition rising edge 1st end of start in cycle reached / rising edge detected" UBYTE B_TRUE 1 100 0.00 1.00000000000 BIT_MASK 0x1 FORMAT "%13.11" ECU_ADDRESS 0x600070C6 /end MEASUREMENT
/begin MEASUREMENT TWCC_B_stz_ER.oldSignal "Condition rising edge 1st end of start in cycle reached / flag rising edge" UBYTE B_TRUE 1 100 0.00 1.00000000000 BIT_MASK 0x1 FORMAT "%13.11" ECU_ADDRESS 0x600070C7 /end MEASUREMENT
/begin MEASUREMENT TWCC_B_st_FF.status "Flip flop: condition end of start reached / current value of RS-FF" UBYTE B_TRUE 1 100 0.00 1.00000000000 BIT_MASK 0x1 FORMAT "%13.11" ECU_ADDRESS 0x6000B5C0 /end MEASUREMENT
/begin MEASUREMENT TWCC_dmfExhCat1MWpDisp "input to lambda setpoint map catalyst purge Map Working Point Display" SWORD m_q0p1 1 100 -3276.800 3276.700 FORMAT "%8.3" ECU_ADDRESS 0x600070E8 /end MEASUREMENT
/begin MEASUREMENT TWCC_dmO2Cat1PurgB1 "O2-massflow into catalyst 1" FLOAT32_IEEE mgrad_q1_mgdivs 1 100 -1.0000E+037 1.0000E+037 FORMAT "%10.4" ECU_ADDRESS 0x600130B8 /end MEASUREMENT
/begin MEASUREMENT TWCC_dmO2Cat2PurgB1 "O2-massflow into catalyst 2" FLOAT32_IEEE mgrad_q1_mgdivs 1 100 -1.0000E+037 1.0000E+037 FORMAT "%10.4" ECU_ADDRESS 0x600130BC /end MEASUREMENT
/begin MEASUREMENT TWCC_EngOffPurgER_I.buffer "edge-rising bit engine off / rising edge detected" UBYTE B_TRUE 1 100 0.00 1.00000000000 BIT_MASK 0x1 FORMAT "%13.11" ECU_ADDRESS 0x600070C4 /end MEASUREMENT
/begin MEASUREMENT TWCC_EngOffPurgER_I.oldSignal "edge-rising bit engine off / flag rising edge" UBYTE B_TRUE 1 100 0.00 1.00000000000 BIT_MASK 0x1 FORMAT "%13.11" ECU_ADDRESS 0x600070C5 /end MEASUREMENT
/begin MEASUREMENT TWCC_flgDynDiagDsCat1B1 "Condition dynamic diagnosis of the sensor downstream catalyst 1, bank 1" UBYTE B_TRUE 1 100 0.00 1.00000000000 BIT_MASK 0x1 FORMAT "%13.11" ECU_ADDRESS 0x700000F4 /end MEASUREMENT
/begin MEASUREMENT TWCC_flgDynDiagDsCat2B1 "Condition dynamic diagnosis of the sensor downstream catalyst 2, bank 1" UBYTE B_TRUE 1 100 0.00 1.00000000000 BIT_MASK 0x1 FORMAT "%13.11" ECU_ADDRESS 0x700000F3 /end MEASUREMENT
/begin MEASUREMENT TWCC_flgLeanParlB1 "Flag lean phase of parallelization on bank 1" UBYTE B_TRUE 1 100 0.00 1.00000000000 BIT_MASK 0x1 FORMAT "%13.11" ECU_ADDRESS 0x700000F2 /end MEASUREMENT
/begin MEASUREMENT TWCC_flgPtlFcoB1 "Flag partial fuel cut off on bank 1" UBYTE B_TRUE 1 100 0.00 1.00000000000 BIT_MASK 0x1 FORMAT "%13.11" ECU_ADDRESS 0x700000F1 /end MEASUREMENT
/begin MEASUREMENT TWCC_FuelCutOffPurgB1TOFFV_I.outbit "turn off delay flag lean for extended O2 balancing, bank 1 / Output Bit" UBYTE B_TRUE 1 100 0.00 1.00000000000 BIT_MASK 0x1 FORMAT "%13.11" ECU_ADDRESS 0x500057DC /end MEASUREMENT
/begin MEASUREMENT TWCC_FuelCutOffPurgB1TOFFV_I.time "turn off delay flag lean for extended O2 balancing, bank 1 / Occured Time" UWORD t_q0p02 1 100 0.00 1310.700 FORMAT "%8.3" ECU_ADDRESS 0x500057DE /end MEASUREMENT
/begin MEASUREMENT TWCC_LamSetPUsActvPurgB1TOFFV_I.outbit "lambda setpoint active lambda-control upstream catalyst purge / Output Bit" UBYTE B_TRUE 1 100 0.00 1.00000000000 BIT_MASK 0x1 FORMAT "%13.11" ECU_ADDRESS 0x600070C0 /end MEASUREMENT
/begin MEASUREMENT TWCC_LamSetPUsActvPurgB1TOFFV_I.time "lambda setpoint active lambda-control upstream catalyst purge / Occured Time" UWORD t_q0p02 1 100 0.00 1310.700 FORMAT "%8.3" ECU_ADDRESS 0x600070C2 /end MEASUREMENT
/begin MEASUREMENT TWCC_mO2EngOffCat1PurgB1 "O2-level catalyst1 at engine turn off" ULONG m_q0p1_mg 1 100 0.00 429496729.500 FORMAT "%13.3" ECU_ADDRESS 0x60038DB8 /end MEASUREMENT
/begin MEASUREMENT TWCC_mO2EngOffCat2PurgB1 "O2-level catalyst2 at engine turn off" ULONG m_q0p1_mg 1 100 0.00 429496729.500 FORMAT "%13.3" ECU_ADDRESS 0x60038DB4 /end MEASUREMENT
/begin MEASUREMENT TWCC_mO2MaxPurgB1 "maximum O2 storage capacity of all catalysts, bank 1" ULONG m_q0p1_mg 1 100 0.00 429496729.500 FORMAT "%13.3" ECU_ADDRESS 0x60002638 /end MEASUREMENT
/begin MEASUREMENT TWCC_mO2StCat1PurgB1 "O2-level catalyst1" ULONG m_q0p1_mg 1 100 0.00 429496729.500 FORMAT "%13.3" ECU_ADDRESS 0x50001D6C /end MEASUREMENT
/begin MEASUREMENT TWCC_mO2StCat2PurgB1 "O2-level catalyst2" ULONG m_q0p1_mg 1 100 0.00 429496729.500 FORMAT "%13.3" ECU_ADDRESS 0x600130C0 /end MEASUREMENT
/begin MEASUREMENT TWCC_mO2StPurgB1 "O2-level overall" ULONG m_q0p1_mg 1 100 0.00 429496729.500 FORMAT "%13.3" ECU_ADDRESS 0x60002634 /end MEASUREMENT
/begin MEASUREMENT TWCC_mO2StPurgMWpDisp "Map working point display to indicate O2-level overall" UWORD m_q1_mg 1 100 0.00 65535.00 FORMAT "%8.2" ECU_ADDRESS 0x600070E6 /end MEASUREMENT
/begin MEASUREMENT TWCC_mOSCCat1PurgB1 "oxygen storage capacity for catalyst purge, catalyst 1, bank 1" ULONG m_q0p1_mg 1 100 0.00 429496729.500 FORMAT "%13.3" ECU_ADDRESS 0x50001D70 /end MEASUREMENT
/begin MEASUREMENT TWCC_mOSCCat2PurgB1 "oxygen storage capacity for catalyst purge, catalyst 2, bank 1" ULONG m_q0p1_mg 1 100 0.00 429496729.500 FORMAT "%13.3" ECU_ADDRESS 0x50001D74 /end MEASUREMENT
/begin MEASUREMENT TWCC_nEngWpDisp "Engine speed for working point display of calibration map" UWORD nmot_uw_q0p25 1 100 0.00 16383.75 FORMAT "%8.2" ECU_ADDRESS 0x600070E4 /end MEASUREMENT
/begin MEASUREMENT TWCC_ratLamMinPurgEngOperPnt "Lower limit of lambda setpoint for purging dependent on engine operation point (only relevant in case of an oxygen mass- and exhaust mass flow- depending basic lambda)" UWORD fak_uw_b16 1 100 0.00 15.99976 FORMAT "%8.5" ECU_ADDRESS 0x600070E2 /end MEASUREMENT
/begin MEASUREMENT TWCC_ratLamSpCatTBascB1 "basic lambda setpoint for catalyst purge based on catalyst temperature, bank 1" UWORD fak_uw_b16 1 100 0.00 15.99976 FORMAT "%8.5" ECU_ADDRESS 0x600070E0 /end MEASUREMENT
/begin MEASUREMENT TWCC_ratLamSpEngOperPntBascB1 "basic lambda setpoint for catalyst purge based on engine operation point (engine speed and load), bank 1" UWORD fak_uw_b16 1 100 0.00 15.99976 FORMAT "%8.5" ECU_ADDRESS 0x600070DE /end MEASUREMENT
/begin MEASUREMENT TWCC_ratLamSpEngTBasc "Lower limit of lambda setpoints for purging depending on engine temperature" UWORD fak_uw_b16 1 100 0.00 15.99976 FORMAT "%8.5" ECU_ADDRESS 0x600070DC /end MEASUREMENT
/begin MEASUREMENT TWCC_ratLamSpO2BascB1 "basic lambda setpoint for catalyst purge based on (relative) oxygen mass in catalyst, bank 1" UWORD fak_uw_b16 1 100 0.00 15.99976 FORMAT "%8.5" ECU_ADDRESS 0x600070DA /end MEASUREMENT
/begin MEASUREMENT TWCC_ratLamSpPurgBascB1 "basic lambda setpoint for catalyst purge, bank 1" UWORD fak_uw_b16 1 100 0.00 15.99976 FORMAT "%8.5" ECU_ADDRESS 0x600070D8 /end MEASUREMENT
/begin MEASUREMENT TWCC_ratLamSpPurgEngOperPnt "Lambda setpoint for catalyst purge based on engine operation point (engine speed and load)" UWORD fak_uw_b16 1 100 0.00 15.99976 FORMAT "%8.5" ECU_ADDRESS 0x600070D6 /end MEASUREMENT
/begin MEASUREMENT TWCC_ratLamSpPurgMapBascB1 "basic lambda setpoint for catalyst purge after (oxygen mass-, engine operation point-, temperature-depending) maps, bank 1" UWORD fak_uw_b16 1 100 0.00 15.99976 FORMAT "%8.5" ECU_ADDRESS 0x600070D4 /end MEASUREMENT
/begin MEASUREMENT TWCC_ratO2PurgB1 "Ratio of present O2 level to Maximum O2 level in Bank 1" UWORD fak_uw_b2 1 100 0.00 1.999969 FORMAT "%8.6" ECU_ADDRESS 0x600070D2 /end MEASUREMENT
/begin MEASUREMENT TWCC_ratO2PurgWpDisp "Ratio of present O2 level to Maximum O2 level for working point display" UWORD fak_uw_b2 1 100 0.00 1.999969 FORMAT "%8.6" ECU_ADDRESS 0x600070D0 /end MEASUREMENT
/begin MEASUREMENT TWCC_rLamCat1PurgB1 "lambda upstream catalyst1" UWORD fak_uw_b16 1 100 0.00 15.99976 FORMAT "%8.5" ECU_ADDRESS 0x60013DD6 /end MEASUREMENT
/begin MEASUREMENT TWCC_rLamCat2PurgB1 "lambda upstream catalyst2" UWORD fak_uw_b16 1 100 0.00 15.99976 FORMAT "%8.5" ECU_ADDRESS 0x60013DD8 /end MEASUREMENT
/begin MEASUREMENT TWCC_rLamSetPPurgB1 "lambda setpoint requested by function catalyst purge" UWORD fak_uw_b16 1 100 0.00 15.99976 FORMAT "%8.5" ECU_ADDRESS 0x600093CC /end MEASUREMENT
/begin MEASUREMENT TWCC_RmpLamSetPPurgB1 "ramp of lambda setpoint for catalyst purge" UWORD fak_uw_b16 1 100 0.00 15.99976 FORMAT "%8.5" ECU_ADDRESS 0x60013DD0 /end MEASUREMENT
/begin MEASUREMENT TWCC_tCat1WpDisp "Working Point Display for temperature catalyst1" SWORD Temp_Cels 1 100 -3549.940 3003.560 FORMAT "%8.3" ECU_ADDRESS 0x600070CE /end MEASUREMENT
/begin MEASUREMENT TWCC_tEngWpDisp "Working Point Display for temperature of engine" SWORD Temp_Cels 1 100 -3549.940 3003.560 FORMAT "%8.3" ECU_ADDRESS 0x600070CC /end MEASUREMENT
/begin MEASUREMENT TWCC_tiRichTOutPurgB1 "time passed waiting for rich mixture for catalyst purging" UWORD t_q0p02 1 100 0.00 1310.700 FORMAT "%8.3" ECU_ADDRESS 0x600070CA /end MEASUREMENT
/begin MEASUREMENT TWCC_tiWaitRstStrtERCat2_I.buffer "ER if threshold for time after (stop-)start is exceeded C2B1 / rising edge detected" UBYTE B_TRUE 1 100 0.00 1.00000000000 BIT_MASK 0x1 FORMAT "%13.11" ECU_ADDRESS 0x600070BA /end MEASUREMENT
/begin MEASUREMENT TWCC_tiWaitRstStrtERCat2_I.oldSignal "ER if threshold for time after (stop-)start is exceeded C2B1 / flag rising edge" UBYTE B_TRUE 1 100 0.00 1.00000000000 BIT_MASK 0x1 FORMAT "%13.11" ECU_ADDRESS 0x600070BB /end MEASUREMENT
/begin MEASUREMENT TWCC_uThdRichCat1PurgB1 "Rich voltage threshold for purge end determination, catalyst 1 bank 1" UBYTE spg_q0p00488 1 100 0.00 1.245 FORMAT "%5.3" ECU_ADDRESS 0x6000B5C2 /end MEASUREMENT
/begin MEASUREMENT TWCC_uThdRichCat2PurgB1 "Rich voltage threshold for purge end determination, catalyst 2 bank 1" UBYTE spg_q0p00488 1 100 0.00 1.245 FORMAT "%5.3" ECU_ADDRESS 0x6000B5C1 /end MEASUREMENT
/begin MEASUREMENT Veh_Vel "Vehicle speed in case of CAN error (max speed)" SWORD Vel 1 100 -327.6800 327.6700 FORMAT "%8.4" ECU_ADDRESS 0x600070EE /end MEASUREMENT
/begin MEASUREMENT _mdverl_w "temp label for Resistant torque of the engine" UWORD rel_uw_b100 1 100 0.00 99.99847 FORMAT "%8.5" ECU_ADDRESS 0x70001F26 /end MEASUREMENT
/begin MEASUREMENT _miautget_w "temp label of Engine torque without torque intervention" UWORD rel_uw_b100 1 100 0.00 99.99847 FORMAT "%8.5" ECU_ADDRESS 0x70001F28 /end MEASUREMENT
/begin MEASUREMENT _mimin_w "Temp label of Minimal engine torque" UWORD rel_uw_b100 1 100 0.00 99.99847 FORMAT "%8.5" ECU_ADDRESS 0x70001F24 /end MEASUREMENT
/begin FUNCTION TME_ObdSig "1.1.0     Calculates and Provides all OBD-Relevant signals from BC:TME" /begin IN_MEASUREMENT ActMod_trqInr CoEng_tqEngRefPrmIdH63 RngMod_trqCrSMin /end IN_MEASUREMENT /begin OUT_MEASUREMENT TME_ratActEngPercTqPrmIdH62 TME_ratEngFricPercTqPrmIdH8E /end OUT_MEASUREMENT FUNCTION_VERSION "1.1.0" /end FUNCTION
/begin FUNCTION TMO2ETS "1.24.0    Interface adapter Torque Model (TMO) to ETS" /begin DEF_CHARACTERISTIC MDNORM ZZAEHLMN /end DEF_CHARACTERISTIC
 /begin IN_MEASUREMENT anztib_msg B_stendzw_msg etazwbm_w_msg etazwmn_w_msg mibas_w_msg mibminm_w_msg mibmn_w_msg mibmx_w_msg miist_w_msg mimaxa_w_msg mimax_w_msg miopt_w_msg RngMod_trqClthMin RngMod_trqCrSMin zzaehl_msg /end IN_MEASUREMENT
 /begin OUT_MEASUREMENT ActMod_bEngActv ActMod_bTrqInrPsv ActMod_trqClth ActMod_trqCrS ActMod_trqInr fmi2trq_w_msg ftrq2mi_w_msg PhyMod_etaIgnBsAvrg PhyMod_etaIgnMin RngMod_bEngActv RngMod_trqClthBs RngMod_trqClthBsMin RngMod_trqClthMax RngMod_trqCrSBs RngMod_trqCrSMax RngMod_trqInrBs RngMod_trqInrBsMax RngMod_trqInrBsMin RngMod_trqInrBsMinAvrg RngMod_trqInrMax RngMod_trqInrMaxAvl RngMod_trqInrOpt /end OUT_MEASUREMENT
 FUNCTION_VERSION "1.24.0" /end FUNCTION
/begin FUNCTION TraTypVar_M_MinDnAdpn "" /begin REF_CHARACTERISTIC MisfDet_dnThdMinDnAdpnN_AX MisfDet_dnThdMinDnAdpnTq_AX /end REF_CHARACTERISTIC /end FUNCTION
/begin FUNCTION Tra_Add "4.11.0    Gearbox additions"
 /begin DEF_CHARACTERISTIC Tra_bCanAirCanPtd_C Tra_bCanClntCanPtd_C Tra_rClgDem_C Tra_tClntDes_C /end DEF_CHARACTERISTIC
 /begin IN_MEASUREMENT Gbx_rFanClgDem Gbx_tClntDes /end IN_MEASUREMENT
 /begin OUT_MEASUREMENT Tra_rClgDem Tra_tClntDes /end OUT_MEASUREMENT
 FUNCTION_VERSION "4.11.0" /end FUNCTION
/begin FUNCTION Tra_GearInfo "287.0.0   Gearbox gear information"
 /begin DEF_CHARACTERISTIC PT_rTraGear1_C PT_rTraGear2_C PT_rTraGear3_C PT_rTraGear4_C PT_rTraGear5_C PT_rTraGear6_C PT_rTraGear7_C PT_rTraGear8_C PT_rTraGear9_C PT_rTraGearR_C PT_rTraLoRng_C PT_rTraMax_C Tra_bCanGearShftActv_C Tra_bCanInfoCan_C Tra_bCanLevPos_C Tra_bCanLoRng_C Tra_bCanRevGear_C Tra_bCanRTra_C Tra_bGbxNPosEna_C Tra_bStrtStopEnaDfl_C Tra_nEngMin_C Tra_numLevPosCan_C Tra_rCVTGearMax_C Tra_rCVTGearMin_C Tra_rDftCVTGearRat_C Tra_rGearCVT1Hi_C Tra_rGearCVT1Lo_C Tra_rGearCVT2Hi_C Tra_rGearCVT2Lo_C Tra_rGearCVT3Hi_C Tra_rGearCVT3Lo_C Tra_rGearCVT4Hi_C Tra_rGearCVT4Lo_C Tra_rGearCVT5Hi_C Tra_rGearCVT5Lo_C Tra_rGearCVT6Hi_C Tra_rGearCVT6Lo_C Tra_rGearCVT7Hi_C Tra_rGearCVT7Lo_C Tra_rGearCVT8Hi_C Tra_rGearCVT8Lo_C Tra_rGearCVT9Hi_C Tra_rGearCVT9Lo_C Tra_rLoRngCVT_C Tra_rV2NDfl_C Tra_rVn1H_C Tra_rVn1L_C Tra_rVn1To2Des_C Tra_rVn2H_C Tra_rVn2L_C Tra_rVn2To3Des_C Tra_rVn3H_C Tra_rVn3L_C Tra_rVn3To4Des_C Tra_rVn4H_C Tra_rVn4L_C Tra_rVn4To5Des_C Tra_rVn5H_C Tra_rVn5L_C Tra_rVn5To6Des_C Tra_rVn6H_C Tra_rVn6L_C Tra_rVn6To7Des_C Tra_rVn7H_C Tra_rVn7L_C Tra_rVn7To8Des_C Tra_rVn8H_C Tra_rVn8L_C Tra_rVn8To9Des_C Tra_rVn9H_C Tra_rVn9L_C Tra_rVnRH_C Tra_rVnRL_C Tra_stLevPosD_C Tra_stSwtGearCalcEna_C Tra_stSwtRevPosn_C Tra_swtCVTSig_C Tra_swtHondaGDIFct_C Tra_swtLevPosSlct_CA Tra_swtPllyRat_C Tra_swtTypeSlct_CA Tra_tiNPT1_C Tra_tiV2NPT1_C Tra_vMin_C /end DEF_CHARACTERISTIC
 /begin IN_MEASUREMENT Com_rCVTAct Com_rTarPlly Com_stShftInD Com_stShftInL Com_stShftInNeutr Com_stShftInPark Com_stShftInRev Com_stShftInS Dfftl_bLowRng Epm_nEng Gbx_bGearShftActv Gbx_bRevGear Gbx_numGear Gbx_numGearTrgt Gbx_rTrqTra Gbx_stGearLvr Gbx_stNPos Gbx_stRvsPos GlbDa_vX GlbDa_vXFlt PT_stTraType T15_st /end IN_MEASUREMENT
 /begin OUT_MEASUREMENT PT_rTraGear PT_rTraGear1 PT_rTraGear2 PT_rTraGear3 PT_rTraGear4 PT_rTraGear5 PT_rTraGear6 PT_rTraGear7 PT_rTraGear8 PT_rTraGear9 PT_rTraGearDes PT_rTraGearR PT_rTraLoRng PT_rTraMax PT_rTraV2N PT_stTraLoRng PT_stTraRevGear PT_stTraShftOp Tra_bRTraCan Tra_flgGearCanPtd Tra_flgGearDetPtd Tra_numGear Tra_numGearDes Tra_numGearDesPf Tra_numGearDisp Tra_numLstGear Tra_numLstParGear Tra_numParGear Tra_rCVTDesGearRat Tra_rCVTGearRat Tra_rDesGearRatDetn Tra_rGearCVT Tra_rGearCVT1Hi Tra_rGearCVT1Lo Tra_rGearCVT2Hi Tra_rGearCVT2Lo Tra_rGearCVT3Hi Tra_rGearCVT3Lo Tra_rGearCVT4Hi Tra_rGearCVT4Lo Tra_rGearCVT5Hi Tra_rGearCVT5Lo Tra_rGearCVT6Hi Tra_rGearCVT6Lo Tra_rGearCVT7Hi Tra_rGearCVT7Lo Tra_rGearCVT8Hi Tra_rGearCVT8Lo Tra_rGearCVT9Hi Tra_rGearCVT9Lo Tra_rGearTarCVT Tra_stStopEna Tra_stStrtEna Tra_swtCVTSig /end OUT_MEASUREMENT
 /begin LOC_MEASUREMENT Tra_nEngFlt_mp Tra_numDflGear_mp Tra_numGearPf Tra_rCVTDesGearRat_mp Tra_rCVTGearRat_mp Tra_rGearRatDetn Tra_rV2NLoRng_mp Tra_rV2NUnFlt_mp Tra_swtSlctGearInfoCan_mp /end LOC_MEASUREMENT
 FUNCTION_VERSION "287.0.0" /end FUNCTION
/begin FUNCTION Tra_GearReq "40.0.0    Gear Shift Indication"
 /begin DEF_CHARACTERISTIC Tra_ATFCUpInh.tiHiLo_C Tra_ATFCUpInh.tiLoHi_C Tra_ctMovAvrg_C Tra_facUpSpdCor_MAP Tra_flgAppOffSwtEna_C Tra_frBaseAftShft_MAP Tra_frNeed2ShftUp_CUR Tra_frNeedAftShft_MAP Tra_frOutMax_MAP Tra_frSlpEst_MAP Tra_frSpr2Dwn_CUR Tra_lRaTire_C Tra_mMsVeh_C Tra_nFrShftDwn_CUR Tra_nInhShftDwnHys_C Tra_nInhShftDwn_CUR Tra_nNeutrDetHi_C Tra_nNeutrDetLo_C Tra_numGearDisp_T Tra_numGearMax_C Tra_numGearShftDwnLimLo_C Tra_rAppClsDelta_C Tra_rAppDwnInh_MAP Tra_rAppOpenMin_C Tra_rCluStk_C Tra_rDrvAPPDem_C Tra_rLoLdAPPThres_CUR Tra_rSlpEst_MAP Tra_stCluActvMask_C Tra_stSelnDes_C Tra_swtAppLLimSel_C Tra_swtCrCtlActv_C Tra_swtGbxNPosSel_C Tra_swtGearTypSeln_C Tra_swtGSIEquip_C Tra_tEcoLmpEnaHi_C Tra_tEcoLmpEnaLo_C Tra_tiAppOffDly_C Tra_tiAppOpnDly_C Tra_tiATDwnDly_C Tra_tiATUpDly_C Tra_tiBrkCondDly_C Tra_tiClthChngDelay_C Tra_tiCltOffSil_C Tra_tiDetShftChgDelay_C Tra_tiEcoLmpOffDly_C Tra_tiEcoLmpOnDly_C Tra_tiEcoLmpThrSt_C Tra_tiFCUpInhDelay_C Tra_tiLoLdDelay_C Tra_tiNDwnInhCondRstDly_C Tra_tiNNeutrDetDelay_C Tra_tiOnDlyATDwn_C Tra_tiOnDlyATUp_C Tra_tiPwrAccRstnFltBrk_C Tra_tiPwrAccRstnFlt_C Tra_tiPwrCurrRstnFlt_C Tra_tiRlsDwnInhCdn_C Tra_tiRlsDwnInhDelay_C Tra_tiRlsUpInhCdn_C Tra_tiRlsUpInhDelay_C Tra_tiSilInhbDly_C Tra_tiSilOff_C Tra_tiSlpEstFlt_C Tra_tiSlpEstVehFlt_C Tra_tiTrqWhlFlt_C Tra_tqSil1Hi_T Tra_tqSil1Lo_T Tra_tqSil2Hi_T Tra_tqSil2Lo_T Tra_trqLoLdTrqThres_CUR Tra_trqNeutrDetHi_C Tra_trqNeutrDetLo_C Tra_tShftUpReq_C Tra_vBaseShftUp_MAP Tra_vDRBShftUp_MAP Tra_vEcoEnaHiDelta_C Tra_vEcoEnaHi_C Tra_vEcoEnaLoDelta_C Tra_vEcoEnaLo_C Tra_vInhShftDwnLimLo_C Tra_vNeutrDet_C Tra_vShftUpInhHys_C Tra_vShftUpInhThres_CUR Tra_vSlopEstimnVeh_C /end DEF_CHARACTERISTIC
 /begin IN_MEASUREMENT ActMod_trqClth APP_r APP_stPlaBrk Brk_st CEngDsT_t Clth_r Clth_st CoEng_stMai Com_stAmbLmpPrms Com_stATShftUpDwnReq Com_stAYC Com_stAYCF Com_stShiftDwnReco Com_stShiftUpReco CoVMD_r CoVOM_bSSEEngStopPassed CoVOM_stSSE CrCtl_stActive DFES_stErrLamp EISGov_trq EngDa_tEng Epm_nEng Gbx_stAnaNPos GlbDa_vX InjCtl_qRaw LLim_rCCASLAppReq PthSet_bOvrRun PthSet_trqInrDes PT_stTraType PT_trqWhl RngMod_trqInrMax StbIntv_bDCSIntv StbIntv_bTCSIntv SyC_ctPostDrvLeave Tra_numGear Tra_numGearDisp VehV_a VehV_v /end IN_MEASUREMENT
 /begin OUT_MEASUREMENT Tra_numStInd Tra_rAppDes Tra_stAmbLmp Tra_stAppOpn Tra_stCrkNotCmpl Tra_stEcoLmpIdc Tra_stGearShftDwnIdctr Tra_stGearShftUpIdctr Tra_stSilOff /end OUT_MEASUREMENT
 /begin LOC_MEASUREMENT Tra_cntrReIniProc100ms Tra_cntrReIniProc10ms Tra_facUpSpdCor_mp Tra_frAccRstnFlt_mp Tra_frAccRstn_mp Tra_frBaseAftShft_mp Tra_frCurrRstnFlt_mp Tra_frCurrRstn_mp Tra_frNeed2ShftUp_mp Tra_frNeedAftShft_mp Tra_frOutMax_mp Tra_frSlpEst_mp Tra_frSpr2Dwn_mp Tra_frSprAftShft_mp Tra_frSprCurr_mp Tra_frWhlFlt_mp Tra_frWhlUnFlt_mp Tra_nFrShftDwn_mp Tra_nInhShftDwn_mp Tra_numDispGear Tra_numGear1_mp Tra_numStIndAmb Tra_rAppDwnInh_mp Tra_rAppLLimSel_mp Tra_rLoLdAPPThres_mp Tra_rSlopEstimnOld Tra_rSlpEstFlt_mp Tra_rSlpEst_mp Tra_stCluActv_MP Tra_stDwnSilDly Tra_stEcoLampEna Tra_stEcoLmpSt Tra_stEcoLmpThr Tra_stISSActv_mp Tra_stNeutrDetPre_mp Tra_stNeutrDet_mp Tra_stShftDwnInhCdn_mp Tra_stShftDwnInhPre_mp Tra_stShftDwnInh_mp Tra_stShftDwnNLo_mp Tra_stShftDwnReq_mp Tra_stShftUpInhCdn_mp Tra_stShftUpInhPre_mp Tra_stShftUpInh_mp Tra_stShftUpReq_mp Tra_stSilOffDly Tra_stSilOffReqByVSA Tra_stUpInhPre_mp Tra_stUpSilDly Tra_tqHiSil Tra_tqLoSil Tra_trqLoLdTrqThres_mp Tra_vBaseShftUpCor_mp Tra_vBaseShftUp_mp Tra_vDRBShftUp_mp Tra_vShftUpInhThres_mp Tra_vSlpEstVehFlt_mp /end LOC_MEASUREMENT
 FUNCTION_VERSION "40.0.0" /end FUNCTION
/begin FUNCTION Tra_Grip "1.10.0    Gearbox grip detection" /begin IN_MEASUREMENT Tra_numGear /end IN_MEASUREMENT /begin OUT_MEASUREMENT PT_stTraGrip /end OUT_MEASUREMENT FUNCTION_VERSION "1.10.0" /end FUNCTION
/begin FUNCTION Tra_Los "2.9.0     Gearbox torque loss" /begin DEF_CHARACTERISTIC Tra_trqLos_C /end DEF_CHARACTERISTIC /begin OUT_MEASUREMENT Tra_trqLos /end OUT_MEASUREMENT FUNCTION_VERSION "2.9.0" /end FUNCTION
/begin FUNCTION Tra_Prt "135.1.0   Gearbox Protection"
 /begin DEF_CHARACTERISTIC Tra_dtqPrtRmpNeg_C Tra_dtqPrtRmpPos_C Tra_dtqSpcReasNegSlp_C Tra_flgSwtNoGearProtnTrq_C Tra_stPrtCfg_C Tra_tqInMax_C Tra_tqMaxGear10_T Tra_tqMaxGear1_T Tra_tqMaxGear2_T Tra_tqMaxGear3_T Tra_tqMaxGear4_T Tra_tqMaxGear5_T Tra_tqMaxGear6_T Tra_tqMaxGear7_T Tra_tqMaxGear8_T Tra_tqMaxGear9_T Tra_tqMaxGearIndpdtProblem_C Tra_tqMaxGearR_T Tra_tqMaxNoGearInfo_C /end DEF_CHARACTERISTIC
 /begin IN_MEASUREMENT Epm_nEng Gbx_trqPrt Tra_flgGearCanPtd Tra_flgGearDetPtd Tra_numGear /end IN_MEASUREMENT
 /begin OUT_MEASUREMENT PT_tqCluTrsmProtn /end OUT_MEASUREMENT
 /begin LOC_MEASUREMENT Tra_flgCANPlaus Tra_tqProtnGear_MP Tra_tqProtnTrsm Tra_tqPrtKnall_mp /end LOC_MEASUREMENT
 FUNCTION_VERSION "135.1.0" /end FUNCTION
/begin FUNCTION Tra_RevLck "2.0.0     Reverse Lock Solenoid Condition" /begin DEF_CHARACTERISTIC Tra_vRevLckHi_C Tra_vRevLckLo_C /end DEF_CHARACTERISTIC /begin IN_MEASUREMENT Gbx_stRevLck SyC_ctPostDrvLeave VehV_v /end IN_MEASUREMENT /begin LOC_MEASUREMENT Tra_cntrReIni /end LOC_MEASUREMENT FUNCTION_VERSION "2.0.0" /end FUNCTION
/begin FUNCTION Tra_RtnIntfc "61.1.0    Transmission rotational speed interface"
 /begin DEF_CHARACTERISTIC Tra_bAST_C Tra_bCANASTIntv_C Tra_bCANIdlSetP_C Tra_bFltIdlSpdDes_C Tra_nASTDes_C Tra_nIdleDes_C Tra_nIdleDiagcReq_C Tra_nIdleNeutPrkg_C Tra_nIdleSpdRev_C Tra_nMaxCanErrFco_CUR Tra_nMaxCanErr_CUR Tra_nMaxEngFcoHi_C Tra_nMaxEngFcoLo_C Tra_nMaxEngTqLimHi_C Tra_nMaxEngTqLimLo_C Tra_nMax_C Tra_nMin_C Tra_swtCANFIdMask_C Tra_tiASTDes_C Tra_tiDRMaxEvl_C Tra_tiPNMaxEvl_C /end DEF_CHARACTERISTIC
 /begin IN_MEASUREMENT Com_stFwdRvsCluInfo Com_stShftInNeutr Com_stShftInPark Com_stShftInRev DReqSwt_stClrDeb Gbx_bASTIntv Gbx_bASTNeutr Gbx_nASTDes Gbx_nIdlDes Gbx_nMaxEngFco Gbx_nMaxEngTrqLim Gbx_tiASTDes PT_stTraType SrvCSwt_st SyC_ctPostDrvLeave VehV_v /end IN_MEASUREMENT
 /begin OUT_MEASUREMENT Tra_flgNeutPrkg Tra_nASTDes Tra_nMax Tra_nMin Tra_nReqEngFco Tra_stAST Tra_stNSetP Tra_tiASTDes /end OUT_MEASUREMENT
 /begin LOC_MEASUREMENT Tra_bDRTmrDec Tra_bPNTmrDec Tra_cntrPostDrvLve Tra_tiDREvl Tra_tiPNEvl Veh_Vel /end LOC_MEASUREMENT
 FUNCTION_VERSION "61.1.0" /end FUNCTION
/begin FUNCTION Tra_TrqRed "55.0.0    Decreasing transmission interventions"
 /begin DEF_CHARACTERISTIC Tra_bCanPlausDecIntvDes_C Tra_bCanPlausDecIntvLead_C Tra_bCanPlausIncIntvDes_C Tra_bCanPlausIncIntvLead_C Tra_bIgnRtdtCtlSeln_C Tra_dTqNegValDecrIntvEndRamp_C Tra_dTqNegValIncIntvEndRamp_C Tra_dTqPosValDecrIntvEndRamp_C Tra_dTqPosValIncIntvEndRamp_C Tra_dtrqRmpTIIDes_INST.Neg_C Tra_dtrqRmpTIIDes_INST.Pos_C Tra_dtrqRmpTIILead_INST.Neg_C Tra_dtrqRmpTIILead_INST.Pos_C Tra_dtrqRmpTSCDes_INST.Neg_C Tra_dtrqRmpTSCDes_INST.Pos_C Tra_dtrqRmpTSCLead_INST.Neg_C Tra_dtrqRmpTSCLead_INST.Pos_C Tra_flgCVTLeadTrqCalcn_C Tra_flgRampEndOfDecIntv_C Tra_flgRampEndOfIncrIntv_C Tra_flgSwtDecTrsmIntvActvTrq_C Tra_flgSwtIncTrsmIntvActvTrq_C Tra_flgTrqIntvSeln_C Tra_flgTrqRedFunc_C Tra_stHaltDisEgdActvMsk_C Tra_swtRmpPtdDes_C Tra_swtRmpPtdLead_C Tra_tqAppDpdt_T Tra_tqDecIntvDesMax_C Tra_tqIncIntvDesMin_C Tra_trqDesMax_C Tra_trqDesMin_C Tra_trqLeadMax_C Tra_trqLeadMin_C Tra_trqMaxDes_CUR Tra_trqMaxLead_CUR Tra_trqTSCIntvSlowDft_C Tra_vMinTrqRed_C Tra_wIgnRtdtCtl_M /end DEF_CHARACTERISTIC
 /begin IN_MEASUREMENT APP_r Com_bTSCIntvFast Com_bTSCIntvSlow Com_stTrsmFailMod CoPT_trqDesCompEng ECT_bFCOEnaCmpnPrt Epm_nEng fethmnmx Gbx_bTIIIntv Gbx_bTSCIntv Gbx_stHaltDisEgdActv Gbx_trqTIIDes Gbx_trqTIILead Gbx_trqTSCIntvDes Gbx_trqTSCIntvFast Gbx_trqTSCIntvLead Gbx_trqTSCIntvSlow GlbDa_vX imlatm_w LsComp_tqCmpActvSpdGovr MoFExtInt_stTSCPtdMsg PtCoornDyn_flgTrsmIntvActvDes PthSet_stTrgFCO RngMod_trqClthMin RngMod_trqInrMinWoCtOff SpdGov_trqLead SpdGov_trqSet T15_st tmst /end IN_MEASUREMENT
 /begin OUT_MEASUREMENT Tra_bIgnRtdtCtlActvn Tra_stTSCPtd Tra_stTSCPtdDes Tra_stTSCPtdLead Tra_trqDesMax Tra_trqDesMin Tra_trqLeadMax Tra_trqLeadMin Tra_trqTSCIntvDesCVT Tra_trqTSCIntvLeadCVT /end OUT_MEASUREMENT
 /begin LOC_MEASUREMENT Tra_flgDecrTraIntvDesActv Tra_flgDecrTraIntvDesEnd Tra_flgIncrTraIntvDesActv Tra_flgIncrTraIntvDesEnd Tra_stInjCutOffNotPossbl Tra_tqDesDecIntvEndRamp Tra_tqDesIncIntvEndRamp Tra_tqIncIntvDesEndRampOut_mp Tra_trqDecDemDes_mp Tra_trqDecDemLead_mp Tra_trqDecIntvDesEndRampOut_mp Tra_trqIncDemDes_mp Tra_trqIncDemLead_mp /end LOC_MEASUREMENT
 FUNCTION_VERSION "55.0.0" /end FUNCTION
/begin FUNCTION Tra_TypeInfo "3.10.0    Gearbox type information" /begin DEF_CHARACTERISTIC Tra_stHWSel_C Tra_stTraType_C /end DEF_CHARACTERISTIC /begin IN_MEASUREMENT GbxMTAT_stTraType /end IN_MEASUREMENT /begin OUT_MEASUREMENT PT_stTraType Tra_stHWSel Tra_stTraType /end OUT_MEASUREMENT /begin LOC_MEASUREMENT Tra_stTrsmTypFrz /end LOC_MEASUREMENT FUNCTION_VERSION "3.10.0" /end FUNCTION
/begin FUNCTION TrqMod2ME "1.6.0     MF interface adapter ETS to ME(D)17"
 /begin IN_MEASUREMENT ftrq2mi_w_msg PthSet_trqInrWoDstC RngMod_stDrvState RngMod_trqDiffAdap RngMod_trqInrMinWoCtOff RngMod_trqLos /end IN_MEASUREMENT
 /begin OUT_MEASUREMENT dmvad_w_msg mdverl_w_msg miautget_w_msg mimin_w_msg _mdverl_w _mimin_w /end OUT_MEASUREMENT
 /begin LOC_MEASUREMENT _miautget_w /end LOC_MEASUREMENT
 FUNCTION_VERSION "1.6.0" /end FUNCTION
/begin FUNCTION TSDa_tClnt "2.2.0     Coolant temperatures for the thermal supply system" /begin IN_MEASUREMENT CEngDsT_t CEngUsT_t /end IN_MEASUREMENT /begin OUT_MEASUREMENT TSDa_tClntIniVal TSDa_tClntRadOut TS_tClntEngOut /end OUT_MEASUREMENT FUNCTION_VERSION "2.2.0" /end FUNCTION
/begin FUNCTION TWCC_CatPurge "1.54.0    Catalyst Purge"
 /begin DEF_CHARACTERISTIC TWCC_BalCat1B1_I.TWCC_flgExtdPurgCng_C TWCC_BalCat1B1_I.facOSCPurge_C TWCC_BalCat1B1_I.facOSCScndFuelPurge_C TWCC_BalCat1B1_I.facOSCState_C TWCC_BalCat1B1_I.flgRstSensRichSFl_CW TWCC_BalCat1B1_I.mO2DisThresPurgeEngOn_C TWCC_BalCat1B1_I.mO2DisThresPurge_C TWCC_BalCat1B1_I.mO2EngOff_CUR TWCC_BalCat2B1_I.TWCC_flgExtdPurgCng_C TWCC_BalCat2B1_I.facOSCPurge_C TWCC_BalCat2B1_I.facOSCScndFuelPurge_C TWCC_BalCat2B1_I.facOSCState_C TWCC_BalCat2B1_I.flgRstSensRichSFl_CW TWCC_BalCat2B1_I.mO2DisThresPurgeEngOn_C TWCC_BalCat2B1_I.mO2DisThresPurge_C TWCC_BalCat2B1_I.mO2EngOff_CUR TWCC_facCorO2Purg_C TWCC_facLamThd_C TWCC_facO2Parl_C TWCC_facO2PtlFco_C TWCC_flgCatPurgeAftParlDiag_CW TWCC_flgCorOSCPurgSelnCat1_CW TWCC_flgCorOSCPurgSelnCat2_CW TWCC_flgDiPurgCatHeatgEna_C TWCC_flgEnaCatPurgColdOper_CW TWCC_flgInhbPurgThrVlvLimpMod_C TWCC_flgLamMinPurgBascOilT_C TWCC_flgLamPurgBascEngOperPnt_C TWCC_flgLamPurgRelO2_C TWCC_flgReqPurgWoDly_C TWCC_flgRstCatPurgRstrt_CW TWCC_flgRstPurgMixFlt_CW TWCC_mO2MinThresCat1Purg_C TWCC_mO2MinThresCat2Purg_C TWCC_OSCCat1B1_I.facOSCKNBB_C TWCC_OSCCat1B1_I.facOSCKNBB_MAP TWCC_OSCCat1B1_I.facOSCK_C TWCC_OSCCat1B1_I.facOSCK_MAP TWCC_OSCCat1B1_I.flgOSCFacSeln_CW TWCC_OSCCat2B1_I.facOSCKNBB_C TWCC_OSCCat2B1_I.facOSCKNBB_MAP TWCC_OSCCat2B1_I.facOSCK_C TWCC_OSCCat2B1_I.facOSCK_MAP TWCC_OSCCat2B1_I.flgOSCFacSeln_CW TWCC_ratLamMinPurgCatT_T TWCC_ratLamMinPurgEngOperPnt_M TWCC_ratLamMinPurgEngT_T TWCC_ratLamMinPurgO2_T TWCC_ratLamMinPurgRelO2_T TWCC_ratLamSetPurgRelO2_M TWCC_ratLamSpPurgEngOperPnt_M TWCC_rLamSetPPurg_MAP TWCC_rLamSetPSFlPurg_MAP TWCC_stEngStTiPurg_C TWCC_stPurg2_CW TWCC_stPurg_CW TWCC_tiAddlDlyLeanPurgShrtRgn_C TWCC_tiDebEngOnKSPurg_C TWCC_tiDebEngOnPurg_C TWCC_tiDebEngStrt_C TWCC_tiDebLamSetPUsActv_C TWCC_tiRichTOutPurg_C TWCC_tiRmpLambdaSetPPurg_C TWCC_tiWaitRstStrt_C TWCC_tMinThresPurg_C TWCC_uRstStrt_C TWCC_uThresLeanCat1Purg_C TWCC_uThresRichCat1Purg_C /end DEF_CHARACTERISTIC
 /begin IN_MEASUREMENT AirMod_ratChrgAirCyl B_bevab_msg B_frmax_msg B_khakt_msg B_kh_msg B_lrseta_msg B_lrs_msg CEngDsT_t EGSDCmn_flgLamReqParlB1 EngStrt_bFrstStrtEnd EngStrt_bStrt EngStrt_bStrtEnd Epm_nEng Epm_stSpd ExhMod_dmExhWoFuUsCat1B1 ExhMod_dmExhWoFuUsCat2B1 ExhMod_facIntrpnGslSecFu ExhMod_mO2StrCat1B1 ExhMod_mO2StrCat2B1 ExhMod_mO2StrExtdCat1B1 ExhMod_mO2StrExtdCat2B1 ExhMod_mO2StrNewCat1B1 ExhMod_mO2StrNewCat2B1 ExhMod_rLamLS1B1 ExhMod_tCat1B1 ExhMod_tCat2B1 HEGO_bS2B1Vld HEGO_flgS2B1EnaLamCtlColdOper HEGO_uS2B1 InjSys_flgFcoBnk lamsbrs_w_msg OilSwmpT_tMdl ThrVlv_flgLimpModeB1 ThrVlv_flgReqFuCutOffB1 TiEngOff_bEngRot TiEngOff_bRst TiEngOff_stTi TiEngOff_ti tlrs_w_msg tnse_w_msg tnst_w_msg zlamko_msg zlrs_w_msg /end IN_MEASUREMENT
 /begin OUT_MEASUREMENT TWCC_bEnaRichPurgB1 TWCC_bLeanStCat1PurgB1 TWCC_bLeanStCat2PurgB1 TWCC_bRstPurgB1 TWCC_rLamSetPPurgB1 /end OUT_MEASUREMENT
 /begin LOC_MEASUREMENT B_stTOFFV_I.outbit B_stTOFFV_I.time TWCC_BalCat1B1_I.bEngOffMark TWCC_BalCat1B1_I.bEngOffO2 TWCC_BalCat1B1_I.bLeanPurg TWCC_BalCat1B1_I.bLeanSt TWCC_BalCat1B1_I.bO2Max TWCC_BalCat1B1_I.bO2MaxEngOn TWCC_BalCat1B1_I.bO2MinThres TWCC_BalCat1B1_I.bRichReq TWCC_BalCat1B1_I.bRichSt TWCC_BalCat1B1_I.bRstSensRich TWCC_BalCat1B1_I.bSensLean TWCC_BalCat1B1_I.bSensLeanToRich TWCC_BalCat1B1_I.flgExtdPurgCng TWCC_BalCat1B1_I.mO2 TWCC_BalCat1B1_I.mO2Max TWCC_BalCat1B1_I.mO2MaxEngOn TWCC_BalCat1B1_I.tiEngOff TWCC_BalCat1B1_I.O2_IKL.memory TWCC_BalCat1B1_I.SensLeanER_I.buffer TWCC_BalCat1B1_I.SensLeanER_I.oldSignal TWCC_BalCat1B1_I.SensLeanToRichER_I.buffer TWCC_BalCat1B1_I.SensLeanToRichER_I.oldSignal TWCC_BalCat2B1_I.bEngOffMark TWCC_BalCat2B1_I.bEngOffO2 TWCC_BalCat2B1_I.bLeanPurg TWCC_BalCat2B1_I.bLeanSt TWCC_BalCat2B1_I.bO2Max TWCC_BalCat2B1_I.bO2MaxEngOn TWCC_BalCat2B1_I.bO2MinThres TWCC_BalCat2B1_I.bRichReq TWCC_BalCat2B1_I.bRichSt TWCC_BalCat2B1_I.bRstSensRich TWCC_BalCat2B1_I.bSensLean TWCC_BalCat2B1_I.bSensLeanToRich TWCC_BalCat2B1_I.flgExtdPurgCng TWCC_BalCat2B1_I.mO2 TWCC_BalCat2B1_I.mO2Max TWCC_BalCat2B1_I.mO2MaxEngOn TWCC_BalCat2B1_I.tiEngOff TWCC_BalCat2B1_I.O2_IKL.memory TWCC_BalCat2B1_I.SensLeanER_I.buffer TWCC_BalCat2B1_I.SensLeanER_I.oldSignal TWCC_BalCat2B1_I.SensLeanToRichER_I.buffer TWCC_BalCat2B1_I.SensLeanToRichER_I.oldSignal TWCC_bCatModPurgRstC2B1 TWCC_bDebEngOnPurg TWCC_bEnaLeanPurgB1 TWCC_bEngOffPurg TWCC_bEngOffPurgTOFFV_I.outbit TWCC_bEngOffPurgTOFFV_I.time TWCC_bInhNoRstCatPurgB1 TWCC_bLeanInCat1PurgB1 TWCC_bLeanInCat2PurgB1 TWCC_bLeanPurgB1 TWCC_bRichInCat1PurgB1 TWCC_bRichInCat2PurgB1 TWCC_bRichReqCat1PurgB1 TWCC_bRichReqCat2PurgB1 TWCC_bRichReqPurgB1 TWCC_bRichStCat1PurgB1 TWCC_bRichStCat2PurgB1 TWCC_bRstCatPurgB1 TWCC_B_stz_ER.buffer TWCC_B_stz_ER.oldSignal TWCC_B_st_FF.status TWCC_dmfExhCat1MWpDisp TWCC_dmO2Cat1PurgB1 TWCC_dmO2Cat2PurgB1 TWCC_EngOffPurgER_I.buffer TWCC_EngOffPurgER_I.oldSignal TWCC_flgDynDiagDsCat1B1 TWCC_flgDynDiagDsCat2B1 TWCC_flgLeanParlB1 TWCC_flgPtlFcoB1 TWCC_FuelCutOffPurgB1TOFFV_I.outbit TWCC_FuelCutOffPurgB1TOFFV_I.time TWCC_LamSetPUsActvPurgB1TOFFV_I.outbit TWCC_LamSetPUsActvPurgB1TOFFV_I.time TWCC_mO2EngOffCat1PurgB1 TWCC_mO2EngOffCat2PurgB1 TWCC_mO2MaxPurgB1 TWCC_mO2StCat1PurgB1 TWCC_mO2StCat2PurgB1 TWCC_mO2StPurgB1 TWCC_mO2StPurgMWpDisp TWCC_mOSCCat1PurgB1 TWCC_mOSCCat2PurgB1 TWCC_nEngWpDisp TWCC_ratLamMinPurgEngOperPnt TWCC_ratLamSpCatTBascB1 TWCC_ratLamSpEngOperPntBascB1 TWCC_ratLamSpEngTBasc TWCC_ratLamSpO2BascB1 TWCC_ratLamSpPurgBascB1 TWCC_ratLamSpPurgEngOperPnt TWCC_ratLamSpPurgMapBascB1 TWCC_ratO2PurgB1 TWCC_ratO2PurgWpDisp TWCC_rLamCat1PurgB1 TWCC_rLamCat2PurgB1 TWCC_RmpLamSetPPurgB1 TWCC_tCat1WpDisp TWCC_tEngWpDisp TWCC_tiRichTOutPurgB1 TWCC_tiWaitRstStrtERCat2_I.buffer TWCC_tiWaitRstStrtERCat2_I.oldSignal TWCC_uThdRichCat1PurgB1 TWCC_uThdRichCat2PurgB1 /end LOC_MEASUREMENT
 FUNCTION_VERSION "1.54.0" /end FUNCTION
/begin COMPU_METHOD APPCrCtl1 "" RAT_FUNC "%6.4" "%" COEFFS 0 200 0 0 0 1 /end COMPU_METHOD
/begin COMPU_METHOD B_TRUE "" TAB_VERB "%6.3" "" COMPU_TAB_REF B_TRUE /end COMPU_METHOD
/begin COMPU_VTAB B_TRUE "" TAB_VERB 2 0 "FALSE" 1 "TRUE" /end COMPU_VTAB
/begin COMPU_METHOD CarMass "" RAT_FUNC "%6.2" "kg" COEFFS 0 1 0 0 0 1 /end COMPU_METHOD
/begin COMPU_METHOD dez "" RAT_FUNC "%6.2" "" COEFFS 0 1 0 0 0 1 /end COMPU_METHOD
/begin COMPU_METHOD DrvFr "" RAT_FUNC "%6.2" "N" COEFFS 0 1 0 0 0 1 /end COMPU_METHOD
/begin COMPU_METHOD EngN "" RAT_FUNC "%6.3" "rpm" COEFFS 0 2 0 0 0 1 /end COMPU_METHOD
/begin COMPU_METHOD Fact3 "" RAT_FUNC "%6.4" "-" COEFFS 0 100 0 0 0 1 /end COMPU_METHOD
/begin COMPU_METHOD fak_q0p000244 "" RAT_FUNC "%6.5" "-" COEFFS 0 65536 0 0 0 16 /end COMPU_METHOD
/begin COMPU_METHOD fak_q0p001_Nm_DIV_pc "" RAT_FUNC "%6.5" "Nm/%" COEFFS 0 1000 0 0 0 1 /end COMPU_METHOD
/begin COMPU_METHOD fak_q0p01 "" RAT_FUNC "%6.4" "" COEFFS 0 100 0 0 0 1 /end COMPU_METHOD
/begin COMPU_METHOD fak_q2p384Em4_pc_DIV_Nm "" RAT_FUNC "%6.5" "%/Nm" COEFFS 0 1048576 0 0 0 250 /end COMPU_METHOD
/begin COMPU_METHOD fak_ub_b2 "" RAT_FUNC "%8.5" "-" COEFFS 0 256 0 0 0 2 /end COMPU_METHOD
/begin COMPU_METHOD fak_ub_b4 "" RAT_FUNC "%6.4" "-" COEFFS 0 256 0 0 0 4 /end COMPU_METHOD
/begin COMPU_METHOD fak_uw_b16 "" RAT_FUNC "%6.5" "-" COEFFS 0 65536 0 0 0 16 /end COMPU_METHOD
/begin COMPU_METHOD fak_uw_b2 "" RAT_FUNC "%7.6" "-" COEFFS 0 65536 0 0 0 2 /end COMPU_METHOD
/begin COMPU_METHOD Length_m "" RAT_FUNC "%6.4" "m" COEFFS 0 100 0 0 0 1 /end COMPU_METHOD
/begin COMPU_METHOD md_q0p1 "" RAT_FUNC "%6.3" "Nm" COEFFS 0 10 0 0 0 1 /end COMPU_METHOD
/begin COMPU_METHOD md_ub_q10 "" RAT_FUNC "%6.1" "Nm" COEFFS 0 1 0 0 0 10 /end COMPU_METHOD
/begin COMPU_METHOD mgrad_q1_mgdivs "" RAT_FUNC "%6.2" "mg/s" COEFFS 0 1 0 0 0 1 /end COMPU_METHOD
/begin COMPU_METHOD m_q0p1 "" RAT_FUNC "%6.3" "kg/h" COEFFS 0 10 0 0 0 1 /end COMPU_METHOD
/begin COMPU_METHOD m_q0p1_mg "" RAT_FUNC "%6.3" "mg" COEFFS 0 1 0 0 0 0.1 /end COMPU_METHOD
/begin COMPU_METHOD m_q1_mg "" RAT_FUNC "%6.2" "mg" COEFFS 0 1 0 0 0 1 /end COMPU_METHOD
/begin COMPU_METHOD m_uw_b23p3 "" RAT_FUNC "%6.5" "kg" COEFFS 0 2812.5 0 0 0 1 /end COMPU_METHOD
/begin COMPU_METHOD nmot_uw_q0p25 "" RAT_FUNC "%6.3" "1/min" COEFFS 0 1 0 0 0 0.25 /end COMPU_METHOD
/begin COMPU_METHOD OneToOne "" RAT_FUNC "%6.2" "-" COEFFS 0 1 0 0 0 1 /end COMPU_METHOD
/begin COMPU_METHOD Prc "" RAT_FUNC "%6.4" "%" COEFFS 0 81.92 0 0 0 1 /end COMPU_METHOD
/begin COMPU_METHOD Prc_Fact256 "" RAT_FUNC "%6.4" "%" COEFFS 0 256 0 0 0 1 /end COMPU_METHOD
/begin COMPU_METHOD RatHiRes_COMPU "" RAT_FUNC "%6.5" "-" COEFFS 0 1000 0 0 0 1 /end COMPU_METHOD
/begin COMPU_METHOD rel_sw_b100 "" RAT_FUNC "%6.4" "%" COEFFS 0 32768 0 0 0 100 /end COMPU_METHOD
/begin COMPU_METHOD rel_uw_b100 "" RAT_FUNC "%6.4" "%" COEFFS 0 65536 0 0 0 100 /end COMPU_METHOD
/begin COMPU_METHOD rel_uw_q0p0234 "" RAT_FUNC "%6.4" "%" COEFFS 0 32 0 0 0 0.75 /end COMPU_METHOD
/begin COMPU_METHOD RmpTrq "" RAT_FUNC "%6.4" "Nm/s" COEFFS 0 655.36 0 0 0 1 /end COMPU_METHOD
/begin COMPU_METHOD spg_q0p00488 "" RAT_FUNC "%6.4" "V" COEFFS 0 1024 0 0 0 5 /end COMPU_METHOD
/begin COMPU_METHOD Temp_Cels "" RAT_FUNC "%6.1" "deg C" COEFFS 0 10 2731.4 0 0 1 /end COMPU_METHOD
/begin COMPU_METHOD temp_ub_q0p75_o48 "" RAT_FUNC "%6.2" "Grad C" COEFFS 0 1 48 0 0 0.75 /end COMPU_METHOD
/begin COMPU_METHOD TimeDeb "" RAT_FUNC "%6.1" "ms" COEFFS 0 0.1 0 0 0 1 /end COMPU_METHOD
/begin COMPU_METHOD TimeDelay_ms "" RAT_FUNC "%13.2" "ms" COEFFS 0 0 1 0 2.3283064365387e-007 0 /end COMPU_METHOD
/begin COMPU_METHOD TimeDelay_s "" RAT_FUNC "%6.1" "s" COEFFS 0 0 1 0 0.00023283064365387 0 /end COMPU_METHOD
/begin COMPU_METHOD Time_ms "" RAT_FUNC "%6.1" "ms" COEFFS 0 0.1 0 0 0 1 /end COMPU_METHOD
/begin COMPU_METHOD Time_s "" RAT_FUNC "%6.4" "s" COEFFS 0 100 0 0 0 1 /end COMPU_METHOD
/begin COMPU_METHOD TransR "" RAT_FUNC "%6.4" "-" COEFFS 0 100 0 0 0 1 /end COMPU_METHOD
/begin COMPU_METHOD TrbChN_float "" RAT_FUNC "%6.2" "rpm" COEFFS 0 1 0 0 0 1 /end COMPU_METHOD
/begin COMPU_METHOD TRBCH_ACTRTYP_SC_Compu "" TAB_VERB "%6.3" "" COMPU_TAB_REF TRBCH_ACTRTYP_SC_Compu /end COMPU_METHOD
/begin COMPU_VTAB TRBCH_ACTRTYP_SC_Compu "" TAB_VERB 7 0 "0" 1 "1" 2 "2" 3 "3" 4 "4" 5 "PWM + h-bridge" 6 "6" /end COMPU_VTAB
/begin COMPU_METHOD TRBCH_BLDCMOT_SC_Compu "" TAB_VERB "%6.3" "" COMPU_TAB_REF TRBCH_BLDCMOT_SC_Compu /end COMPU_METHOD
/begin COMPU_VTAB TRBCH_BLDCMOT_SC_Compu "" TAB_VERB 2 0 "inactive" 1 "active" /end COMPU_VTAB
/begin COMPU_METHOD TRBCH_TYPAVL_SY_Compu "" TAB_VERB "%6.3" "" COMPU_TAB_REF TRBCH_TYPAVL_SY_Compu /end COMPU_METHOD
/begin COMPU_VTAB TRBCH_TYPAVL_SY_Compu "" TAB_VERB 2 0 "FALSE" 1 "TRUE" /end COMPU_VTAB
/begin COMPU_METHOD TRBHP2I_TYPAVL_SC_Compu "" TAB_VERB "%6.3" "" COMPU_TAB_REF TRBHP2I_TYPAVL_SC_Compu /end COMPU_METHOD
/begin COMPU_VTAB TRBHP2I_TYPAVL_SC_Compu "" TAB_VERB 2 0 "False" 1 "True" /end COMPU_VTAB
/begin COMPU_METHOD TRBHPBYPI_TYPAVL_SC_Compu "" TAB_VERB "%6.3" "" COMPU_TAB_REF TRBHPBYPI_TYPAVL_SC_Compu /end COMPU_METHOD
/begin COMPU_VTAB TRBHPBYPI_TYPAVL_SC_Compu "" TAB_VERB 2 0 "False" 1 "True" /end COMPU_VTAB
/begin COMPU_METHOD TRBHPI_TYPAVL_SC_Compu "" TAB_VERB "%6.3" "" COMPU_TAB_REF TRBHPI_TYPAVL_SC_Compu /end COMPU_METHOD
/begin COMPU_VTAB TRBHPI_TYPAVL_SC_Compu "" TAB_VERB 2 0 "False" 1 "True" /end COMPU_VTAB
/begin COMPU_METHOD TRBLPI_TYPAVL_SC_Compu "" TAB_VERB "%6.3" "" COMPU_TAB_REF TRBLPI_TYPAVL_SC_Compu /end COMPU_METHOD
/begin COMPU_VTAB TRBLPI_TYPAVL_SC_Compu "" TAB_VERB 2 0 "False" 1 "True" /end COMPU_VTAB
/begin COMPU_METHOD TRBNBYVLV1INSDT_TYPAVL_SC_Compu "" TAB_VERB "%6.3" "" COMPU_TAB_REF TRBNBYVLV1INSDT_TYPAVL_SC_Compu /end COMPU_METHOD
/begin COMPU_VTAB TRBNBYVLV1INSDT_TYPAVL_SC_Compu "" TAB_VERB 2 0 "False" 1 "True" /end COMPU_VTAB
/begin COMPU_METHOD TRBNBYVLV2INSDT_TYPAVL_SC_Compu "" TAB_VERB "%6.3" "" COMPU_TAB_REF TRBNBYVLV2INSDT_TYPAVL_SC_Compu /end COMPU_METHOD
/begin COMPU_VTAB TRBNBYVLV2INSDT_TYPAVL_SC_Compu "" TAB_VERB 2 0 "False" 1 "True" /end COMPU_VTAB
/begin COMPU_METHOD TRBNBYVLV_TYPAVL_SY_Compu "" TAB_VERB "%6.3" "" COMPU_TAB_REF TRBNBYVLV_TYPAVL_SY_Compu /end COMPU_METHOD
/begin COMPU_VTAB TRBNBYVLV_TYPAVL_SY_Compu "" TAB_VERB 2 0 "FALSE" 1 "TRUE" /end COMPU_VTAB
/begin COMPU_METHOD Trq "" RAT_FUNC "%6.3" "Nm" COEFFS 0 10 0 0 0 1 /end COMPU_METHOD
/begin COMPU_METHOD TRQBS_WOINTV_SY_Compu "" TAB_VERB "%6.3" "" COMPU_TAB_REF TRQBS_WOINTV_SY_Compu /end COMPU_METHOD
/begin COMPU_VTAB TRQBS_WOINTV_SY_Compu "" TAB_VERB 2 0 "no addtional modelling" 1 "addtional modelling of basic torque w/o interventi" /end COMPU_VTAB
/begin COMPU_METHOD TRQBS_WOTRAINTV_SY_Compu "" TAB_VERB "%6.3" "" COMPU_TAB_REF TRQBS_WOTRAINTV_SY_Compu /end COMPU_METHOD
/begin COMPU_VTAB TRQBS_WOTRAINTV_SY_Compu "" TAB_VERB 2 0 "no addtional modelling" 1 "addtional modelling of basic torque w.o. tra.intv." /end COMPU_VTAB
/begin COMPU_METHOD TRQCONVLDMOD_SY_Compu "" RAT_FUNC "%6.2" "" COEFFS 0 1 0 0 0 1 /end COMPU_METHOD
/begin COMPU_METHOD TRQCONV_CESSLIP_SC_Compu "" TAB_VERB "%6.3" "" COMPU_TAB_REF TRQCONV_CESSLIP_SC_Compu /end COMPU_METHOD
/begin COMPU_VTAB TRQCONV_CESSLIP_SC_Compu "" TAB_VERB 2 0 "False" 1 "True" /end COMPU_VTAB
/begin COMPU_METHOD TRQCONV_SY_Compu "" TAB_VERB "%6.3" "" COMPU_TAB_REF TRQCONV_SY_Compu /end COMPU_METHOD
/begin COMPU_VTAB TRQCONV_SY_Compu "" TAB_VERB 2 0 "False" 1 "True" /end COMPU_VTAB
/begin COMPU_METHOD TrqInrKd "" RAT_FUNC "%8.7" "%/Nm" COEFFS 0 655360 0 0 0 1 /end COMPU_METHOD
/begin COMPU_METHOD TrqInrKd_16 "" RAT_FUNC "%7.6" "%/Nm" COEFFS 0 40960 0 0 0 1 /end COMPU_METHOD
/begin COMPU_METHOD TrqInrKi "" RAT_FUNC "%7.6" "%/(Nm*s)" COEFFS 0 21474.83648 0 0 0 1 /end COMPU_METHOD
/begin COMPU_METHOD TrqInrKi_8 "" RAT_FUNC "%6.5" "%/(Nm*s)" COEFFS 0 2684.35456 0 0 0 1 /end COMPU_METHOD
/begin COMPU_METHOD TrqInrKp "" RAT_FUNC "%8.7" "%/Nm" COEFFS 0 327680 0 0 0 1 /end COMPU_METHOD
/begin COMPU_METHOD TrqInrKp_128 "" RAT_FUNC "%6.5" "%/Nm" COEFFS 0 2560 0 0 0 1 /end COMPU_METHOD
/begin COMPU_METHOD TRQLIMCOORD2ECU_SY_Compu "" TAB_VERB "%6.3" "" COMPU_TAB_REF TRQLIMCOORD2ECU_SY_Compu /end COMPU_METHOD
/begin COMPU_VTAB TRQLIMCOORD2ECU_SY_Compu "" TAB_VERB 2 0 "not enabled" 1 "enabled" /end COMPU_VTAB
/begin COMPU_METHOD TrqPrp "" RAT_FUNC "%6.2" "Nm" COEFFS 0 0.625 0 0 0 1 /end COMPU_METHOD
/begin COMPU_METHOD TRQRESV_CONST_SY_Compu "" TAB_VERB "%6.3" "" COMPU_TAB_REF TRQRESV_CONST_SY_Compu /end COMPU_METHOD
/begin COMPU_VTAB TRQRESV_CONST_SY_Compu "" TAB_VERB 2 0 "0" 1 "1" /end COMPU_VTAB
/begin COMPU_METHOD TRQRESV_CP_SY_Compu "" TAB_VERB "%6.3" "" COMPU_TAB_REF TRQRESV_CP_SY_Compu /end COMPU_METHOD
/begin COMPU_VTAB TRQRESV_CP_SY_Compu "" TAB_VERB 2 0 "no torque reserve for purge control available" 1 "torque reserve for purge control available" /end COMPU_VTAB
/begin COMPU_METHOD TRQRESV_ETAREQ_SY_Compu "" TAB_VERB "%6.3" "" COMPU_TAB_REF TRQRESV_ETAREQ_SY_Compu /end COMPU_METHOD
/begin COMPU_VTAB TRQRESV_ETAREQ_SY_Compu "" TAB_VERB 2 0 "0" 1 "1" /end COMPU_VTAB
/begin COMPU_METHOD TRQRESV_EXL_SY_Compu "" TAB_VERB "%6.3" "" COMPU_TAB_REF TRQRESV_EXL_SY_Compu /end COMPU_METHOD
/begin COMPU_VTAB TRQRESV_EXL_SY_Compu "" TAB_VERB 3 0 "no_excl_t_reserve" 1 "basic" 2 "standard" /end COMPU_VTAB
/begin COMPU_METHOD TRQRNG_EXL_SY_Compu "" TAB_VERB "%6.3" "" COMPU_TAB_REF TRQRNG_EXL_SY_Compu /end COMPU_METHOD
/begin COMPU_VTAB TRQRNG_EXL_SY_Compu "" TAB_VERB 2 0 "False" 1 "True" /end COMPU_VTAB
/begin COMPU_METHOD TRQ_ENGINTV_SY_Compu "" TAB_VERB "%6.3" "" COMPU_TAB_REF TRQ_ENGINTV_SY_Compu /end COMPU_METHOD
/begin COMPU_VTAB TRQ_ENGINTV_SY_Compu "" TAB_VERB 2 0 "DISABLED" 1 "ENABLED" /end COMPU_VTAB
/begin COMPU_METHOD TRQ_MONLIM_CNT_SY_Compu "" TAB_VERB "%6.3" "" COMPU_TAB_REF TRQ_MONLIM_CNT_SY_Compu /end COMPU_METHOD
/begin COMPU_VTAB TRQ_MONLIM_CNT_SY_Compu "" TAB_VERB 2 0 "False" 1 "True" /end COMPU_VTAB
/begin COMPU_METHOD TRQ_MONLIM_DIAG_SY_Compu "" TAB_VERB "%6.3" "" COMPU_TAB_REF TRQ_MONLIM_DIAG_SY_Compu /end COMPU_METHOD
/begin COMPU_VTAB TRQ_MONLIM_DIAG_SY_Compu "" TAB_VERB 2 0 "False" 1 "True" /end COMPU_VTAB
/begin COMPU_METHOD TRQ_WOTRAINTV_SY_Compu "" TAB_VERB "%6.3" "" COMPU_TAB_REF TRQ_WOTRAINTV_SY_Compu /end COMPU_METHOD
/begin COMPU_VTAB TRQ_WOTRAINTV_SY_Compu "" TAB_VERB 2 0 "0" 1 "1" /end COMPU_VTAB
/begin COMPU_METHOD TRSMINCTREQOVRDSAPPERR_SC_Compu "" TAB_VERB "%6.3" "" COMPU_TAB_REF TRSMINCTREQOVRDSAPPERR_SC_Compu /end COMPU_METHOD
/begin COMPU_VTAB TRSMINCTREQOVRDSAPPERR_SC_Compu "" TAB_VERB 2 0 "False" 1 "True" /end COMPU_VTAB
/begin COMPU_METHOD TRSMNEUTCTRLCOASTAVL_SC_Compu "" TAB_VERB "%6.3" "" COMPU_TAB_REF TRSMNEUTCTRLCOASTAVL_SC_Compu /end COMPU_METHOD
/begin COMPU_VTAB TRSMNEUTCTRLCOASTAVL_SC_Compu "" TAB_VERB 2 0 "False" 1 "True" /end COMPU_VTAB
/begin COMPU_METHOD TSTRDMDSTOPCHRGADJMT_SC_Compu "" TAB_VERB "%6.3" "" COMPU_TAB_REF TSTRDMDSTOPCHRGADJMT_SC_Compu /end COMPU_METHOD
/begin COMPU_VTAB TSTRDMDSTOPCHRGADJMT_SC_Compu "" TAB_VERB 2 0 "False" 1 "True" /end COMPU_VTAB
/begin COMPU_METHOD TS_CTTMON_SY_Compu "" TAB_VERB "%6.3" "" COMPU_TAB_REF TS_CTTMON_SY_Compu /end COMPU_METHOD
/begin COMPU_VTAB TS_CTTMON_SY_Compu "" TAB_VERB 4 0 "CTTMON_OFF" 1 "CTTMON_AIRMASS" 2 "CTTMON_TEMP" 3 "CTTMON_2SNSR" /end COMPU_VTAB
/begin COMPU_METHOD TTRBNUS_TYPAVL_SY_Compu "" TAB_VERB "%6.3" "" COMPU_TAB_REF TTRBNUS_TYPAVL_SY_Compu /end COMPU_METHOD
/begin COMPU_VTAB TTRBNUS_TYPAVL_SY_Compu "" TAB_VERB 2 0 "False" 1 "True" /end COMPU_VTAB
/begin COMPU_METHOD TTRBUSASICT_TYPAVL_SC_Compu "" TAB_VERB "%6.3" "" COMPU_TAB_REF TTRBUSASICT_TYPAVL_SC_Compu /end COMPU_METHOD
/begin COMPU_VTAB TTRBUSASICT_TYPAVL_SC_Compu "" TAB_VERB 2 0 "False" 1 "True" /end COMPU_VTAB
/begin COMPU_METHOD TTWCSNSRNR_SC_Compu "" TAB_VERB "%6.3" "" COMPU_TAB_REF TTWCSNSRNR_SC_Compu /end COMPU_METHOD
/begin COMPU_VTAB TTWCSNSRNR_SC_Compu "" TAB_VERB 3 0 "NOT_AVAILABLE" 1 "ONE_SENSOR" 2 "TWO_SENSOR" /end COMPU_VTAB
/begin COMPU_METHOD t_q0p01 "" RAT_FUNC "%6.4" "s" COEFFS 0 100 0 0 0 1 /end COMPU_METHOD
/begin COMPU_METHOD t_q0p02 "" RAT_FUNC "%6.4" "s" COEFFS 0 100 0 0 0 2 /end COMPU_METHOD
/begin COMPU_METHOD t_q0p1 "" RAT_FUNC "%6.3" "s" COEFFS 0 10 0 0 0 1 /end COMPU_METHOD
/begin COMPU_METHOD t_q1 "" RAT_FUNC "%6.2" "s" COEFFS 0 1 0 0 0 1 /end COMPU_METHOD
/begin COMPU_METHOD Vel "" RAT_FUNC "%6.4" "km/h" COEFFS 0 100 0 0 0 1 /end COMPU_METHOD
/begin COMPU_METHOD VelToN "" RAT_FUNC "%8.7" "(km/h)/rpm" COEFFS 0 100000 0 0 0 1 /end COMPU_METHOD
/begin COMPU_METHOD zk20msxs_uw_b1310p72 "" RAT_FUNC "%6.1" "s" COEFFS 0 0 65536 0 50 0 /end COMPU_METHOD
/begin RECORD_LAYOUT Kw_Ws16 FNC_VALUES 1 SWORD COLUMN_DIR DIRECT /end RECORD_LAYOUT
/begin RECORD_LAYOUT RB_Curve_S16_S16 NO_AXIS_PTS_X 1 SWORD AXIS_PTS_X 2 SWORD INDEX_INCR DIRECT FNC_VALUES 3 SWORD COLUMN_DIR DIRECT /end RECORD_LAYOUT
/begin RECORD_LAYOUT RB_Curve_S16_U16_Static NO_AXIS_PTS_X 1 SWORD AXIS_PTS_X 2 SWORD INDEX_INCR DIRECT FNC_VALUES 3 UWORD COLUMN_DIR DIRECT STATIC_RECORD_LAYOUT /end RECORD_LAYOUT
/begin RECORD_LAYOUT RB_Curve_S8_S8 NO_AXIS_PTS_X 1 SBYTE AXIS_PTS_X 2 SBYTE INDEX_INCR DIRECT FNC_VALUES 3 SBYTE COLUMN_DIR DIRECT /end RECORD_LAYOUT
/begin RECORD_LAYOUT RB_Curve_U16_U16 NO_AXIS_PTS_X 1 UWORD AXIS_PTS_X 2 UWORD INDEX_INCR DIRECT FNC_VALUES 3 UWORD COLUMN_DIR DIRECT /end RECORD_LAYOUT
/begin RECORD_LAYOUT RB_Map_S16S16_S16 NO_AXIS_PTS_X 1 SWORD NO_AXIS_PTS_Y 2 SWORD AXIS_PTS_X 3 SWORD INDEX_INCR DIRECT AXIS_PTS_Y 4 SWORD INDEX_INCR DIRECT FNC_VALUES 5 SWORD COLUMN_DIR DIRECT /end RECORD_LAYOUT
/begin RECORD_LAYOUT RB_Map_U16S16_U16 NO_AXIS_PTS_X 1 UWORD NO_AXIS_PTS_Y 2 UWORD AXIS_PTS_X 3 UWORD INDEX_INCR DIRECT AXIS_PTS_Y 4 SWORD INDEX_INCR DIRECT FNC_VALUES 5 UWORD COLUMN_DIR DIRECT /end RECORD_LAYOUT
/begin RECORD_LAYOUT RB_Map_U16U16_U16 NO_AXIS_PTS_X 1 UWORD NO_AXIS_PTS_Y 2 UWORD AXIS_PTS_X 3 UWORD INDEX_INCR DIRECT AXIS_PTS_Y 4 UWORD INDEX_INCR DIRECT FNC_VALUES 5 UWORD COLUMN_DIR DIRECT /end RECORD_LAYOUT
/begin RECORD_LAYOUT RB_ValA_Wu8 FNC_VALUES 1 UBYTE COLUMN_DIR DIRECT /end RECORD_LAYOUT
/begin RECORD_LAYOUT RB_Val_Ws16 FNC_VALUES 1 SWORD COLUMN_DIR DIRECT /end RECORD_LAYOUT
/begin RECORD_LAYOUT RB_Val_Ws32 FNC_VALUES 1 SLONG COLUMN_DIR DIRECT /end RECORD_LAYOUT
/begin RECORD_LAYOUT RB_Val_Wu16 FNC_VALUES 1 UWORD COLUMN_DIR DIRECT /end RECORD_LAYOUT
/begin RECORD_LAYOUT RB_Val_Wu32 FNC_VALUES 1 ULONG COLUMN_DIR DIRECT /end RECORD_LAYOUT
/begin RECORD_LAYOUT RB_Val_Wu8 FNC_VALUES 1 UBYTE COLUMN_DIR DIRECT /end RECORD_LAYOUT
/begin RECORD_LAYOUT Val_Ws16 FNC_VALUES 1 SWORD COLUMN_DIR DIRECT /end RECORD_LAYOUT
/begin RECORD_LAYOUT Val_Ws32 FNC_VALUES 1 SLONG COLUMN_DIR DIRECT /end RECORD_LAYOUT
/begin RECORD_LAYOUT Val_Wu16 FNC_VALUES 1 UWORD COLUMN_DIR DIRECT /end RECORD_LAYOUT
/begin RECORD_LAYOUT Val_Wu8 FNC_VALUES 1 UBYTE COLUMN_DIR DIRECT /end RECORD_LAYOUT
/end MODULE
/end PROJECT
