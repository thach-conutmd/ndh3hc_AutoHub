ASAP2_VERSION 1 60
/begin PROJECT MG1CS022 "MG1CS022"
/begin HEADER "" VERSION "MG1CS022_62XSC_V037" PROJECT_NO MG1CS022 /end HEADER
/begin MODULE DIM ""
/begin MOD_COMMON "" BYTE_ORDER MSB_LAST ALIGNMENT_BYTE 1 ALIGNMENT_WORD 2 ALIGNMENT_LONG 4 ALIGNMENT_INT64 4 ALIGNMENT_FLOAT32_IEEE 4 ALIGNMENT_FLOAT64_IEEE 4 DATA_SIZE 32 /end MOD_COMMON
/begin CHARACTERISTIC BPHUTEB "characteristic line for physically uegency für purge control" CURVE 0x8054F708 RB_Curve_S8_U8_Static 255.0 dez 0.00 255.0 FORMAT "%5.1"
 /begin AXIS_DESCR STD_AXIS fteadvir fak_q0p5 4 -64.00 63.50 FORMAT "%5.2" DEPOSIT ABSOLUTE /end AXIS_DESCR
/end CHARACTERISTIC
/begin CHARACTERISTIC ChrCtl_facTCorrnHfmPlst_T "correction of HFM pulsation depending on intake air temperature" CURVE 0x8054F252 RB_Curve_S16_U8_Static 1.992188 fak_ub_b2 0.00 1.992188 FORMAT "%8.6"
 /begin AXIS_DESCR STD_AXIS IntkAirT_tIntkMnfld Temp_Cels 8 -3549.940 3003.560 FORMAT "%8.3" DEPOSIT ABSOLUTE /end AXIS_DESCR
/end CHARACTERISTIC
/begin CHARACTERISTIC ChrCtl_nEngCepAg_C "Engine speed threshold for switching desired throttle angle based on CEP based angle" VALUE 0x8054F562 RB_Val_Wu16 1000.000 EngN 0.00 1000.000 FORMAT "%8.3" EXTENDED_LIMITS 0.00 32767.50 /end CHARACTERISTIC
/begin CHARACTERISTIC ChrCtl_ratThrVlvWotLimnToAvdAfsPlst_M "Characteristic map for Throttle angle limitation to avoid HFM pulsations (engine speed and ethanol factordependent)" MAP 0x8054F26C RB_Map_S16U16_U16 99.99847 rel_uw_b100 0.00 99.99847 FORMAT "%8.5"
 /begin AXIS_DESCR STD_AXIS Epm_nEng EngN 16 -16384.00 16383.50 FORMAT "%8.2" DEPOSIT ABSOLUTE /end AXIS_DESCR
 /begin AXIS_DESCR STD_AXIS ChrCtl_facEthnlCntnt fak_uw_b2 8 0.00 1.999969 FORMAT "%8.6" DEPOSIT ABSOLUTE /end AXIS_DESCR
/end CHARACTERISTIC
/begin CHARACTERISTIC Com_bTSCIntvSlowTrsmFail_C "Fail safe calibration value for Com_bTSCIntvSlowTrsmFail" VALUE 0x80555B14 RB_Val_Wu8 1.000 OneToOne 0.00 1.000 FORMAT "%5.3" EXTENDED_LIMITS 0.00 255.0 /end CHARACTERISTIC
/begin CHARACTERISTIC Com_bTSCIntvSlow_C "Calibration value for Com_bTSCIntvSlow" VALUE 0x80555B15 RB_Val_Wu8 1.000 OneToOne 0.00 1.000 FORMAT "%5.3" EXTENDED_LIMITS 0.00 255.0 /end CHARACTERISTIC
/begin CHARACTERISTIC Com_ctCRingEAT1_C "Default application constant ring counter for EAT1 frame" VALUE 0x80555ADC RB_Val_Wu8 3.000 OneToOne 0.00 3.000 FORMAT "%5.3" EXTENDED_LIMITS 0.00 255.0 /end CHARACTERISTIC
/begin CHARACTERISTIC Com_ctCRingEAT2_C "Default application constant for Com_ctCRingEAT2 in case of defective reception" VALUE 0x80555B0C RB_Val_Wu8 3.000 OneToOne 0.00 3.000 FORMAT "%5.3" EXTENDED_LIMITS 0.00 255.0 /end CHARACTERISTIC
/begin CHARACTERISTIC Com_ctCRingEAT4_C "Default value for the message counter for frame EAT4 in case of system error" VALUE 0x80555B16 RB_Val_Wu8 3.000 OneToOne 0.00 3.000 FORMAT "%5.3" EXTENDED_LIMITS 0.00 255.0 /end CHARACTERISTIC
/begin CHARACTERISTIC Com_dEAT10MaxDiff_C "Maximum difference between 2 message counters of EAT10 for error detection" VALUE 0x80555AE8 RB_Val_Wu8 255.0 OneToOne 0.00 255.0 FORMAT "%5.1" /end CHARACTERISTIC
/begin CHARACTERISTIC Com_dEAT10MaxPer_C "Maximum period count for the detection of EAT10 stopped message counter" VALUE 0x80555AE9 RB_Val_Wu8 255.0 OneToOne 0.00 255.0 FORMAT "%5.1" /end CHARACTERISTIC
/begin CHARACTERISTIC Com_dEAT11MaxDiff_C "Maximum difference between 2 message counters of EAT11 for error detection" VALUE 0x80555AF0 RB_Val_Wu8 255.0 OneToOne 0.00 255.0 FORMAT "%5.1" /end CHARACTERISTIC
/begin CHARACTERISTIC Com_dEAT11MaxPer_C "Maximum period count for the detection of EAT11 stopped message counter" VALUE 0x80555AF1 RB_Val_Wu8 255.0 OneToOne 0.00 255.0 FORMAT "%5.1" /end CHARACTERISTIC
/begin CHARACTERISTIC Com_dEAT12MaxDiff_C "EAT12 Ring counter max diff calibration" VALUE 0x80555AF4 RB_Val_Wu8 255.0 OneToOne 0.00 255.0 FORMAT "%5.1" /end CHARACTERISTIC
/begin CHARACTERISTIC Com_dEAT12MaxPer_C "EAT12 Ring counter Max Period calibration" VALUE 0x80555AF5 RB_Val_Wu8 255.0 OneToOne 0.00 255.0 FORMAT "%5.1" /end CHARACTERISTIC
/begin CHARACTERISTIC Com_dEAT12SigSel_C "Signal selection data for EAT12 frame" VALUE 0x80555AF6 RB_Val_Wu8 255.0 OneToOne 0.00 255.0 FORMAT "%5.1" /end CHARACTERISTIC
/begin CHARACTERISTIC Com_dEAT13MaxDiff_C "Ring counter max diff calibartion" VALUE 0x80555B00 RB_Val_Wu8 255.0 OneToOne 0.00 255.0 FORMAT "%5.1" /end CHARACTERISTIC
/begin CHARACTERISTIC Com_dEAT13MaxPer_C "EAT13 ring counter max period" VALUE 0x80555B01 RB_Val_Wu8 255.0 OneToOne 0.00 255.0 FORMAT "%5.1" /end CHARACTERISTIC
/begin CHARACTERISTIC Com_dEAT13SigSel_C "Signal selection data for EAT13 frame" VALUE 0x80555B02 RB_Val_Wu8 255.0 OneToOne 0.00 255.0 FORMAT "%5.1" /end CHARACTERISTIC
/begin CHARACTERISTIC Com_dEAT1MaxDiff_C "Application constant for Maximum difference for EAT1 frame" VALUE 0x80555ADD RB_Val_Wu8 255.0 OneToOne 0.00 255.0 FORMAT "%5.1" /end CHARACTERISTIC
/begin CHARACTERISTIC Com_dEAT1MaxPer_C "Period for EAT1 frame." VALUE 0x80555ADE RB_Val_Wu8 255.0 OneToOne 0.00 255.0 FORMAT "%5.1" /end CHARACTERISTIC
/begin CHARACTERISTIC Com_dEAT2MaxDiff_C "Application constant for Maximum difference for EAT2 frame" VALUE 0x80555B0D RB_Val_Wu8 255.0 OneToOne 0.00 255.0 FORMAT "%5.1" /end CHARACTERISTIC
/begin CHARACTERISTIC Com_dEAT2MaxPer_C "Period for EAT2 frame." VALUE 0x80555B0E RB_Val_Wu8 255.0 OneToOne 0.00 255.0 FORMAT "%5.1" /end CHARACTERISTIC
/begin CHARACTERISTIC Com_dEAT4MaxDiff_C "Maximum difference between 2 message counters of EAT2 for error detection" VALUE 0x80555B17 RB_Val_Wu8 255.0 OneToOne 0.00 255.0 FORMAT "%5.1" /end CHARACTERISTIC
/begin CHARACTERISTIC Com_dEAT4MaxPer_C "Maximum period count for the detection of EAT2 stopped message counter" VALUE 0x80555B18 RB_Val_Wu8 255.0 OneToOne 0.00 255.0 FORMAT "%5.1" /end CHARACTERISTIC
/begin CHARACTERISTIC Com_dEAT6MaxDiff_C "Maximum difference between 2 message counters of EAT6 for error detection" VALUE 0x80555B2C RB_Val_Wu8 255.0 OneToOne 0.00 255.0 FORMAT "%5.1" /end CHARACTERISTIC
/begin CHARACTERISTIC Com_dEAT6MaxPer_C "Maximum period count for the detection of EAT6 stopped message counter" VALUE 0x80555B2D RB_Val_Wu8 255.0 OneToOne 0.00 255.0 FORMAT "%5.1" /end CHARACTERISTIC
/begin CHARACTERISTIC Com_dEAT6SigSel_C "Signal selection data for EAT6 frame" VALUE 0x80555B2E RB_Val_Wu8 255.0 OneToOne 0.00 255.0 FORMAT "%5.1" /end CHARACTERISTIC
/begin CHARACTERISTIC Com_ErrDeb_FailSafeA_TmrEAT4_C "Timer Calibration for fail safe handling after which fail safe A values would be assigned to messages when error is in DEBOUNCING state" VALUE 0x80555B1C RB_Val_Ws32 21474836470.0 Time_ms 0.00 21474836470.0 FORMAT "%13.1" EXTENDED_LIMITS -21474836480.0 21474836470.0 /end CHARACTERISTIC
/begin CHARACTERISTIC Com_numCsumEAT1_C "Default value for checksum for EAT1 frame" VALUE 0x80555ADF RB_Val_Wu8 15.00 OneToOne 0.00 15.00 FORMAT "%5.2" EXTENDED_LIMITS 0.00 255.0 /end CHARACTERISTIC
/begin CHARACTERISTIC Com_numCsumEAT2_C "Checksum value in case of system errors for EAT2 frame" VALUE 0x80555B0F RB_Val_Wu8 15.00 OneToOne 0.00 15.00 FORMAT "%5.2" EXTENDED_LIMITS 0.00 255.0 /end CHARACTERISTIC
/begin CHARACTERISTIC Com_numCsumEAT4_C "Default value for checksum for frame EAT4 in case of system error" VALUE 0x80555B20 RB_Val_Wu8 15.00 OneToOne 0.00 15.00 FORMAT "%5.2" EXTENDED_LIMITS 0.00 255.0 /end CHARACTERISTIC
/begin CHARACTERISTIC Com_rConvBoostErr_C "Torque Converter Boost Ratio Error Calibration" VALUE 0x80555AE0 RB_Val_Wu16 3.999939 Com_Fact_b0p00006 0.00 3.999939 FORMAT "%8.6" /end CHARACTERISTIC
/begin CHARACTERISTIC Com_rConvBoost_C "torque converter boost information calibration" VALUE 0x80555AE2 RB_Val_Wu16 3.999939 Com_Fact_b0p00006 0.00 3.999939 FORMAT "%8.6" /end CHARACTERISTIC
/begin CHARACTERISTIC Com_rTarPlly_C "Calibration for target pulley ratio" VALUE 0x8058A94E KwWS16 1023.984 TransR_COMPU -512.0000 511.9844 FORMAT "%8.4" /end CHARACTERISTIC
/begin CHARACTERISTIC Com_rTrsmTotFild_C "Calibration for Filtered TM overall ratio" VALUE 0x80555AEA RB_Val_Wu16 31.99951 Fact_2pwr11 0.00 31.99951 FORMAT "%8.5" /end CHARACTERISTIC
/begin CHARACTERISTIC Com_stConvClth_C "calibration for Hydrodynamic converter clutch value" VALUE 0x8058A950 KwWU8 255.0 OneToOne 0.00 255.0 FORMAT "%5.1" /end CHARACTERISTIC
/begin CHARACTERISTIC Com_stConvrClth_T "Curve for Com_stConvrClth" CURVE 0x8058A952 KlAxU8SstxU16WU16 65535.00 OneToOne 0.00 65535.00 FORMAT "%8.2"
 /begin AXIS_DESCR STD_AXIS Com_rConvSlip CrCtlSlipRat 10 0.00 327.6750 FORMAT "%8.4" DEPOSIT ABSOLUTE /end AXIS_DESCR
/end CHARACTERISTIC
/begin CHARACTERISTIC Com_stCVTEngmtInfo_C "Default value for Drive train engagement information for ISAB ( CVT PT engagement information )" VALUE 0x80555AE4 RB_Val_Wu8 255.0 OneToOne 0.00 255.0 FORMAT "%5.1" /end CHARACTERISTIC
/begin CHARACTERISTIC Com_stIdleStrtStopDispFct_C "default calibration value of Idle startstop display function" VALUE 0x80555AE5 RB_Val_Wu8 1.000 OneToOne 0.00 1.000 FORMAT "%5.3" EXTENDED_LIMITS 0.00 255.0 /end CHARACTERISTIC
/begin CHARACTERISTIC Com_stLCClth_C "status LLC clucth" VALUE 0x8058A97C KwWU8 255.0 OneToOne 0.00 255.0 FORMAT "%5.1" /end CHARACTERISTIC
/begin CHARACTERISTIC Com_stLuckUpOpn_C "status luck up open calibaration" VALUE 0x8058A97D KwWU8 1.00000000000 B_TRUE 0.00 1.00000000000 FORMAT "%13.11" /end CHARACTERISTIC
/begin CHARACTERISTIC Com_swtEAT10MonEna_C "EAT10 error monitoring enable switch" VALUE 0x80555AEC RB_Val_Wu8 1.000 OneToOne 0.00 1.000 FORMAT "%5.3" EXTENDED_LIMITS 0.00 255.0 /end CHARACTERISTIC
/begin CHARACTERISTIC Com_swtEAT1MonEna_C "EAT1 error monitoring enable switch" VALUE 0x80555AE6 RB_Val_Wu8 1.000 OneToOne 0.00 1.000 FORMAT "%5.3" EXTENDED_LIMITS 0.00 255.0 /end CHARACTERISTIC
/begin CHARACTERISTIC Com_swtEAT2MonEna_C "EAT2 error monitoring enable switch" VALUE 0x80555B10 RB_Val_Wu8 1.000 OneToOne 0.00 1.000 FORMAT "%5.3" EXTENDED_LIMITS 0.00 255.0 /end CHARACTERISTIC
/begin CHARACTERISTIC Com_swtEAT4MonEna_C "EAT4 error monitoring enable switch" VALUE 0x80555B21 RB_Val_Wu8 1.000 OneToOne 0.00 1.000 FORMAT "%5.3" EXTENDED_LIMITS 0.00 255.0 /end CHARACTERISTIC
/begin CHARACTERISTIC Com_swtEAT6MonEna_C "EAT6 error monitoring enable switch" VALUE 0x80555B2F RB_Val_Wu8 1.000 OneToOne 0.00 1.000 FORMAT "%5.3" EXTENDED_LIMITS 0.00 255.0 /end CHARACTERISTIC
/begin CHARACTERISTIC Com_swtGbxConvClth_C "swicth convert clucth" VALUE 0x8058A97E KwWU8 1.00000000000 B_TRUE 0.00 1.00000000000 FORMAT "%13.11" /end CHARACTERISTIC
/begin CHARACTERISTIC Com_tiEAT12BusOffTOutDly_C "Timer of EAT12 with respect to bus Off and timeout Error" VALUE 0x80555AF8 RB_Val_Ws32 42949672.9500 Time_s -21474836.4800 21474836.4700 FORMAT "%13.4" /end CHARACTERISTIC
/begin CHARACTERISTIC Com_tiEAT12RingCntChkSumDly_C "Time for EAT12 with respect Ring Counter or Checksum" VALUE 0x80555AFC RB_Val_Ws32 42949672.9500 Time_s -21474836.4800 21474836.4700 FORMAT "%13.4" /end CHARACTERISTIC
/begin CHARACTERISTIC Com_tiEAT13BusOffTOutDly_C "Timer of EAT13 with respect to bus Off and timeout Error" VALUE 0x80555B04 RB_Val_Ws32 42949672.9500 Time_s -21474836.4800 21474836.4700 FORMAT "%13.4" /end CHARACTERISTIC
/begin CHARACTERISTIC Com_tiEAT13RingCntChkSumDly_C "Time for EAT13 with respect Ring Counter or Checksum" VALUE 0x80555B08 RB_Val_Ws32 42949672.9500 Time_s -21474836.4800 21474836.4700 FORMAT "%13.4" /end CHARACTERISTIC
/begin CHARACTERISTIC Com_tiEAT4PreErr_C "Time for EAT4 frame preliminary error check" VALUE 0x80555B22 RB_Val_Ws16 327670.0 Time_ms 0.00 327670.0 FORMAT "%8.1" EXTENDED_LIMITS -327680.0 327670.0 /end CHARACTERISTIC
/begin CHARACTERISTIC Com_TqTMClutch_C_RP "application-switch for switching calculation of torque loss absolute (Prototype)" VALUE 0x8058A97F KwWU8 255.0 OneToOne 0.00 255.0 FORMAT "%5.1" /end CHARACTERISTIC
/begin CHARACTERISTIC Com_vVehTcu_C "Calibration for default value of FI control used vehicle speed" VALUE 0x80555AEE RB_Val_Wu16 255.9961 Vel_CrCtl 0.00 255.9961 FORMAT "%8.4" /end CHARACTERISTIC
/begin CHARACTERISTIC CstrPurg_cwFuPurgCmpDiagCPV_C "Codeword for activation of CPV opening compensation with mass flow during CPV diagnosis" VALUE 0x8055030C RB_Val_Wu8 255.0 dez 0.00 255.0 FORMAT "%5.1" /end CHARACTERISTIC
/begin CHARACTERISTIC CstrPurg_cwRstrtPurg_C "Codeword for Condition slow decrement of purge rate in case of Start Stop" VALUE 0x8055030D RB_Val_Wu8 255.0 dez 0.00 255.0 FORMAT "%5.1" /end CHARACTERISTIC
/begin CHARACTERISTIC CstrPurg_dstMinBnk1LoLoad_C "minimum value for transportation distance in delay-time block for low load purge line" VALUE 0x805504FC RB_Val_Wu16 0.9999390 fak_uw_b2 0.0000305 0.9999695 FORMAT "%9.7" EXTENDED_LIMITS 0.00 1.999969 /end CHARACTERISTIC
/begin CHARACTERISTIC CstrPurg_dstMinLoLoadDiag_C "minimum value for transportation distance delay-time block during diagnosis of low load purge line" VALUE 0x805504FE RB_Val_Wu16 0.9999390 fak_uw_b2 0.0000305 0.9999695 FORMAT "%9.7" EXTENDED_LIMITS 0.00 1.999969 /end CHARACTERISTIC
/begin CHARACTERISTIC CstrPurg_dstTrvlMFlowLoLd_M "Distance travelled by the mass flow in the transport model in delay-time block in the low load purge line." MAP 0x80550500 RB_Map_U16S16_U16 0.9999390 fak_uw_b2 0.0000305 0.9999695 FORMAT "%9.7" EXTENDED_LIMITS 0.00 1.999969
 /begin AXIS_DESCR STD_AXIS rltevol_w_msg rel_uw_b100 8 0.00 99.99847 FORMAT "%8.5" DEPOSIT ABSOLUTE /end AXIS_DESCR
 /begin AXIS_DESCR STD_AXIS Epm_nEng EngN 5 -16384.00 16383.50 FORMAT "%8.2" DEPOSIT ABSOLUTE /end AXIS_DESCR
/end CHARACTERISTIC
/begin CHARACTERISTIC CstrPurg_etakhDelta_C "delta of desired engine efficiency for catalyst heating" VALUE 0x8055030E RB_Val_Wu16 1.999969 fak_uw_b2 0.00 1.999969 FORMAT "%8.6" /end CHARACTERISTIC
/begin CHARACTERISTIC CstrPurg_etakhMinEff_C "minimum desired engine efficiency for catalyst heating to release canister purging" VALUE 0x80550310 RB_Val_Wu16 1.999969 fak_uw_b2 0.00 1.999969 FORMAT "%8.6" /end CHARACTERISTIC
/begin CHARACTERISTIC CstrPurg_facChartcFlowCorrnCpv_M "Map correction value for mass flow through the canister purge valve (CPV)" MAP 0x8054F784 RB_Map_U16U16_U16 1.999969 fak_uw_b2 0.00 1.999969 FORMAT "%8.6"
 /begin AXIS_DESCR STD_AXIS tateout_w_msg rel_q0p00153 10 0.00 99.99847 FORMAT "%8.5" DEPOSIT ABSOLUTE /end AXIS_DESCR
 /begin AXIS_DESCR STD_AXIS CstrPurg_ratPLoLoadPurgLnToEnv fak_uw_b8 10 0.00 7.999878 FORMAT "%8.6" DEPOSIT ABSOLUTE /end AXIS_DESCR
/end CHARACTERISTIC
/begin CHARACTERISTIC CstrPurg_facChartcMFlowCpv_M "Map flow-characteristic mass flow through canister purge line (CPV) incl. line from active carbon filter (ACF) to CPV - low load purge line" MAP 0x8054F878 RB_Map_U16U16_U16 1.999969 fak_uw_b2 0.00 1.999969 FORMAT "%8.6"
 /begin AXIS_DESCR STD_AXIS mssgin1_w_msg m_uw_b6553p5 8 0.00 6553.500 FORMAT "%8.3" DEPOSIT ABSOLUTE /end AXIS_DESCR
 /begin AXIS_DESCR STD_AXIS CstrPurg_ratPLoLoadPurgLnToEnv fak_uw_b8 20 0.00 7.999878 FORMAT "%8.6" DEPOSIT ABSOLUTE /end AXIS_DESCR
/end CHARACTERISTIC
/begin CHARACTERISTIC CstrPurg_facChartcMFlowHalfEngModCpv_M "map flow-characteristic of CPV mass flow(incl. CPV carcoal-canister line) - during HEM or small cam" MAP 0x8054F9F4 RB_Map_U16U16_U16 1.999969 fak_uw_b2 0.00 1.999969 FORMAT "%8.6"
 /begin AXIS_DESCR STD_AXIS mssgin1_w_msg m_uw_b6553p5 8 0.00 6553.500 FORMAT "%8.3" DEPOSIT ABSOLUTE /end AXIS_DESCR
 /begin AXIS_DESCR STD_AXIS CstrPurg_ratPLoLoadPurgLnToEnv fak_uw_b8 20 0.00 7.999878 FORMAT "%8.6" DEPOSIT ABSOLUTE /end AXIS_DESCR
/end CHARACTERISTIC
/begin CHARACTERISTIC CstrPurg_facCorrnAltiTCpvMod_T "Altitude correction factor" CURVE 0x8054FB70 RB_Curve_U16_U16 1.999969 fak_sw_b1 0.00 1.999969 FORMAT "%8.6"
 /begin AXIS_DESCR STD_AXIS PEnv_facCorrAlti fak_uw_b4 6 0.00 3.999939 FORMAT "%8.6" DEPOSIT ABSOLUTE /end AXIS_DESCR
/end CHARACTERISTIC
/begin CHARACTERISTIC CstrPurg_facCpvmfLimHiAlti_T "Map:Ambient pressure based limiting factor for high altitude" CURVE 0x8054FD20 RB_Curve_U16_U8_Static 1.992188 fak_ub_b2 0.00 1.992188 FORMAT "%8.6"
 /begin AXIS_DESCR STD_AXIS PEnv_p p_uw_q0p039 6 0.00 2559.961 FORMAT "%8.3" DEPOSIT ABSOLUTE /end AXIS_DESCR
/end CHARACTERISTIC
/begin CHARACTERISTIC CstrPurg_facDeltaLam_C "factor for reset the filter during fuel cut off" VALUE 0x8054FD34 RB_Val_Wu16 15.99976 fak_uw_b16 0.00 15.99976 FORMAT "%8.5" /end CHARACTERISTIC
/begin CHARACTERISTIC CstrPurg_facDesFuPartEgsDiagParl_GM "characteristic map of desired fuel from purge control for catalyst diagnosis during parallelisation" MAP 0x8054FD36 RB_MapGroup_U8 0.9961 fak_ub_b1 0.00 0.9961
 /begin AXIS_DESCR COM_AXIS Epm_nEngLRes EngN_LRes 4 0.00 10200. FORMAT "%5.0" AXIS_PTS_REF SNM04TEUB /end AXIS_DESCR
 /begin AXIS_DESCR COM_AXIS misol_w_msg rel_uw_b100 4 0.00 99.99847 FORMAT "%8.5" AXIS_PTS_REF SMI04TEUW /end AXIS_DESCR
/end CHARACTERISTIC
/begin CHARACTERISTIC CstrPurg_facDftEthGsl_C "default ethanol content in gasoline" VALUE 0x8054F760 RB_Val_Wu16 1.999969 fak_uw_b2 0.00 1.999969 FORMAT "%8.6" /end CHARACTERISTIC
/begin CHARACTERISTIC CstrPurg_facDilPurgAirLoLoadDiag_T "Characteristic line: filter factor of dilution purge flow with fresh air in low load purge line during diagnosis" CURVE 0x8055056E RB_Curve_U8_U8 0.9961 fak_ub_b1 0.00 0.9961
 /begin AXIS_DESCR STD_AXIS Epm_nEngLRes EngN_LRes 6 0.00 10200. FORMAT "%5.0" DEPOSIT ABSOLUTE /end AXIS_DESCR
/end CHARACTERISTIC
/begin CHARACTERISTIC CstrPurg_facDilPurgAirLoLoadPCmp_M "Characteristic map: filter factor of dilution purge flow with fresh air in low load purge line (depending on engine speed and air charge, pressure compensated)" MAP 0x8055057C RB_Map_U8U16_U8 0.9922 fak_ub_b1 0.0039 0.9961 EXTENDED_LIMITS 0.00 0.9961
 /begin AXIS_DESCR STD_AXIS Epm_nEngLRes EngN_LRes 6 0.00 10200. FORMAT "%5.0" DEPOSIT ABSOLUTE /end AXIS_DESCR
 /begin AXIS_DESCR STD_AXIS rltevol_w_msg rel_uw_b100 6 0.00 99.99847 FORMAT "%8.5" DEPOSIT ABSOLUTE /end AXIS_DESCR
/end CHARACTERISTIC
/begin CHARACTERISTIC CstrPurg_facDilPurgAirLoLoad_M "Characteristic map: filter factor of dilution purge flow with fresh air in low load purge line (depending on engine speed and air charge)" MAP 0x805505B4 RB_Map_U8U16_U8 0.9922 fak_ub_b1 0.0039 0.9961 EXTENDED_LIMITS 0.00 0.9961
 /begin AXIS_DESCR STD_AXIS Epm_nEngLRes EngN_LRes 6 0.00 10200. FORMAT "%5.0" DEPOSIT ABSOLUTE /end AXIS_DESCR
 /begin AXIS_DESCR STD_AXIS CstrPurg_ratAirChrg rel_uw_q0p0234 6 0.00 1535.977 FORMAT "%8.3" DEPOSIT ABSOLUTE /end AXIS_DESCR
/end CHARACTERISTIC
/begin CHARACTERISTIC CstrPurg_facDynDilLoLoadBnk1_GT "dynamic factor of dilution purge flow with fresh air in low load purge line" CURVE 0x805505EC RB_CurveGroup_U8 7.938 fak_ub_b8 0.031 7.969 FORMAT "%5.3" EXTENDED_LIMITS 0.00 7.969
 /begin AXIS_DESCR COM_AXIS qmsdyn fak_ub_b16 5 0.00 15.94 FORMAT "%5.2" AXIS_PTS_REF SQM05TEUB /end AXIS_DESCR
/end CHARACTERISTIC
/begin CHARACTERISTIC CstrPurg_facDynDlyBnk1LoLoad_GT "dynamic factor delay of purge flow in low load purge line" CURVE 0x805505F2 RB_CurveGroup_U16 0.003906190 t_q5p96046Em8_min 0.00 0.003906190 FORMAT "%11.9"
 /begin AXIS_DESCR COM_AXIS qmsdyn fak_ub_b16 5 0.00 15.94 FORMAT "%5.2" AXIS_PTS_REF SQM05TEUB /end AXIS_DESCR
/end CHARACTERISTIC
/begin CHARACTERISTIC CstrPurg_facFilBndyValCtrl_T "Characteristic curve factor time constant for filtering of limit control fuel evaporation" CURVE 0x8054FD46 RB_Curve_S8_U8_Static 0.9961 fak_ub_b1 0.00 0.9961
 /begin AXIS_DESCR STD_AXIS fteadf_msg fak_sb_b64 5 -64.00 63.50 FORMAT "%5.2" DEPOSIT ABSOLUTE /end AXIS_DESCR
/end CHARACTERISTIC
/begin CHARACTERISTIC CstrPurg_facFteadMaxOlc_C "maximum purge control adaptation value during open loop control of fuel purge control limp-home mode" VALUE 0x80550376 RB_Val_Ws16 127.9980 fak_sw_b64 -64.00000 63.99805 FORMAT "%8.5" /end CHARACTERISTIC
/begin CHARACTERISTIC CstrPurg_facFteadRampDwnOlc_C "Step size for decrease of purge control adaptation value in fuel purge limp-home mode" VALUE 0x80550378 RB_Val_Wu16 255.9961 fak_ub_b1 0.00 255.9961 FORMAT "%8.4" /end CHARACTERISTIC
/begin CHARACTERISTIC CstrPurg_facFteadRampUpOlc_C "Step size for increase of purge control adaptation value in fuel purge limp-home mode in case of high evapuration" VALUE 0x8055037A RB_Val_Wu16 0.9999695 fak_sw_b1 0.00 0.9999695 FORMAT "%9.7" EXTENDED_LIMITS 0.00 1.999969 /end CHARACTERISTIC
/begin CHARACTERISTIC CstrPurg_facImpsCstrLoadMax_T "the maximum threshold for ftead" CURVE 0x8054F712 RB_Curve_S16_S16 127.9980 fak_sw_b64 -64.00000 63.99805 FORMAT "%8.5"
 /begin AXIS_DESCR STD_AXIS CstrPurg_temploc Temp_Cels 4 -3549.940 3003.560 FORMAT "%8.3" DEPOSIT ABSOLUTE /end AXIS_DESCR
/end CHARACTERISTIC
/begin CHARACTERISTIC CstrPurg_facImpsCstrLoadMin_C "the minimum threshold for ftead" VALUE 0x8054F724 RB_Val_Ws16 127.9980 fak_sw_b64 -64.00000 63.99805 FORMAT "%8.5" /end CHARACTERISTIC
/begin CHARACTERISTIC CstrPurg_facIntrpnMaxInc_M "characteristic line interpolation for maximum increase of purge mass flow" MAP 0x8055012A RB_Map_S16U8_U16 1.000000 fak_uw_b2 0.00 1.000000 FORMAT "%8.6" EXTENDED_LIMITS 0.00 1.999969
 /begin AXIS_DESCR STD_AXIS ftead_w_msg fak_sw_b64 5 -64.00000 63.99805 FORMAT "%8.5" DEPOSIT ABSOLUTE /end AXIS_DESCR
 /begin AXIS_DESCR STD_AXIS imsteini_msg m_ub_q0p0444 5 0.00 11.32 FORMAT "%5.2" DEPOSIT ABSOLUTE /end AXIS_DESCR
/end CHARACTERISTIC
/begin CHARACTERISTIC CstrPurg_facLoadCoeff_T "curve load coefficient" CURVE 0x8054FB8A RB_Curve_U16_U16 3.999939 fak_uw_b4 0.00 3.999939 FORMAT "%8.6"
 /begin AXIS_DESCR STD_AXIS rl_w_msg rel_uw_q0p0234 8 0.00 1535.977 FORMAT "%8.3" DEPOSIT ABSOLUTE /end AXIS_DESCR
/end CHARACTERISTIC
/begin CHARACTERISTIC CstrPurg_facLoadIni_C "Initial factor factor canister purge valve temperature effect on account of the vehicle speed and the weighteded filtered load" VALUE 0x8054FBAC RB_Val_Ws16 1.999969 fak_sw_b1 -1.000000 0.999969 FORMAT "%8.6" EXTENDED_LIMITS -1.000000 0.9999695 /end CHARACTERISTIC
/begin CHARACTERISTIC CstrPurg_facLoad_M "Characteristic field to the determination of the unfiltered factor canister purge valve temperature effect on account of the vehicle speed and the weighteded filtered load" MAP 0x8054FBAE RB_Map_S16U16_S16 1.999969 fak_sw_b1 -1.000000 0.999969 FORMAT "%8.6" EXTENDED_LIMITS -1.000000 0.9999695
 /begin AXIS_DESCR STD_AXIS VehV_v Vel 6 -327.6800 327.6700 FORMAT "%8.4" DEPOSIT ABSOLUTE /end AXIS_DESCR
 /begin AXIS_DESCR STD_AXIS CstrPurg_ratWghtRelAirFillgFilt rel_uw_q0p0234 4 0.00 1535.977 FORMAT "%8.3" DEPOSIT ABSOLUTE /end AXIS_DESCR
/end CHARACTERISTIC
/begin CHARACTERISTIC CstrPurg_facMaxCpvOpenEnvT_T "characteristic line for max. percentage of purge valve opening" CURVE 0x8054FD52 RB_Curve_S16_U8_Static 1.000000 fak_ub_b2 0.00 1.000000 FORMAT "%8.6" EXTENDED_LIMITS 0.00 1.992188
 /begin AXIS_DESCR STD_AXIS EnvT_t Temp_Cels 4 -3549.940 3003.560 FORMAT "%8.3" DEPOSIT ABSOLUTE /end AXIS_DESCR
/end CHARACTERISTIC
/begin CHARACTERISTIC CstrPurg_facMaxCPVOpenNEtc_M "Characteristic map for maximum percentage of purge valve opening (engine speed, throttle)" MAP 0x8054FD60 RB_Map_S16S16_U16 0.9999847 fak_uw_b1 0.00 0.9999847 FORMAT "%9.7"
 /begin AXIS_DESCR STD_AXIS Epm_nEng EngN 6 -16384.00 16383.50 FORMAT "%8.2" DEPOSIT ABSOLUTE /end AXIS_DESCR
 /begin AXIS_DESCR STD_AXIS CstrPurg_ratThrVlv relDK_q0p02441 6 -800.0000 799.9756 FORMAT "%8.4" DEPOSIT ABSOLUTE /end AXIS_DESCR
/end CHARACTERISTIC
/begin CHARACTERISTIC CstrPurg_facMaxCPVOpenNLoadExtd_M "Characteristic map for maximum percentage of purge valve opening (engine speed, load) extended to 8 x 8" MAP 0x8054FDC4 RB_Map_S16U16_U16 0.9999847 fak_uw_b1 0.00 0.9999847 FORMAT "%9.7"
 /begin AXIS_DESCR STD_AXIS Epm_nEng EngN 8 -16384.00 16383.50 FORMAT "%8.2" DEPOSIT ABSOLUTE /end AXIS_DESCR
 /begin AXIS_DESCR STD_AXIS CstrPurg_relAirChrg rel_uw_q0p0234 8 0.00 1535.977 FORMAT "%8.3" DEPOSIT ABSOLUTE /end AXIS_DESCR
/end CHARACTERISTIC
/begin CHARACTERISTIC CstrPurg_facMaxCPVOpenNP_M "Characteristic map for maximum percentage of purge valve opening (engine speed, pressure)" MAP 0x8054FE68 RB_Map_S16U16_U16 0.9999847 fak_uw_b1 0.00 0.9999847 FORMAT "%9.7"
 /begin AXIS_DESCR STD_AXIS Epm_nEng EngN 4 -16384.00 16383.50 FORMAT "%8.2" DEPOSIT ABSOLUTE /end AXIS_DESCR
 /begin AXIS_DESCR STD_AXIS pndkpu_w_msg fak_uw_b8 8 0.00 7.999878 FORMAT "%8.6" DEPOSIT ABSOLUTE /end AXIS_DESCR
/end CHARACTERISTIC
/begin CHARACTERISTIC CstrPurg_facMaxCpvOpndFullLdPFIModEpm_M "Characteristic map for max. percentage of purge valve opening near full load in port fuel injection mode (PFI-mode) for engine speed" MAP 0x8054FEC4 RB_Map_S16S16_S16 0.9999695 fak_sw_b1 0.00 0.9999695 FORMAT "%9.7" EXTENDED_LIMITS -1.000000 0.9999695
 /begin AXIS_DESCR STD_AXIS Epm_nEng EngN 5 -16384.00 16383.50 FORMAT "%8.2" DEPOSIT ABSOLUTE /end AXIS_DESCR
 /begin AXIS_DESCR STD_AXIS pdiff_w p_sw_q0p039 6 -1280.000 1279.961 FORMAT "%8.3" DEPOSIT ABSOLUTE /end AXIS_DESCR
/end CHARACTERISTIC
/begin CHARACTERISTIC CstrPurg_facPurgCtrlAdapnOffs_T "Offset value for purge control adaption" CURVE 0x8055037C RB_Curve_S16_S16 127.9980 fak_sw_b64 -64.00000 63.99805 FORMAT "%8.5"
 /begin AXIS_DESCR STD_AXIS CstrPurg_facLamDeMin fak_sw_b1 5 -1.000000 0.999969 FORMAT "%8.6" EXTENDED_LIMITS -1.000000 0.9999695 DEPOSIT ABSOLUTE /end AXIS_DESCR
/end CHARACTERISTIC
/begin CHARACTERISTIC CstrPurg_facPurgRateRednMin_C "Minimum value of purge rate reduction due to deviations of lambda controller" VALUE 0x80550392 RB_Val_Wu8 15.94 fak_ub_b16 0.00 15.94 FORMAT "%5.2" /end CHARACTERISTIC
/begin CHARACTERISTIC CstrPurg_facStoiAirFlexfu_T "stoichiometric air-to-fuel ratio of gas-ethanol-mixture dependent on the ethanol content" CURVE 0x8054F762 RB_Curve_U16_U16 15.99976 fak_uw_b16 0.00 15.99976 FORMAT "%8.5"
 /begin AXIS_DESCR STD_AXIS CstrPurg_facEthGsl fak_uw_b2 5 0.00 1.999969 FORMAT "%8.6" DEPOSIT ABSOLUTE /end AXIS_DESCR
/end CHARACTERISTIC
/begin CHARACTERISTIC CstrPurg_facTCorrnFuPurgAdpn_M "Correction factor for fuel purge adaptation based on temperature and engine off state" MAP 0x80550394 RB_Map_U16S16_U16 1.999969 fak_uw_b2 0.00 1.999969 FORMAT "%8.6"
 /begin AXIS_DESCR STD_AXIS TiEngOff_ti_loc t_q1 6 0.00 65535.00 FORMAT "%8.2" DEPOSIT ABSOLUTE /end AXIS_DESCR
 /begin AXIS_DESCR STD_AXIS CstrPurg_tPurgAdpnCorrn Temp_Cels 6 -3549.940 3003.560 FORMAT "%8.3" DEPOSIT ABSOLUTE /end AXIS_DESCR
/end CHARACTERISTIC
/begin CHARACTERISTIC CstrPurg_fakMFlowAcfIni_C "init value of the factor containing the fuel part of the massflow from ACF in order to take into considerantion the cooling effect in CPV" VALUE 0x8054FBF6 RB_Val_Wu16 0.9999847 fak_uw_b1 0.00 0.9999847 FORMAT "%9.7" /end CHARACTERISTIC
/begin CHARACTERISTIC CstrPurg_fakMFlowAcfLd_M "Map for determination of the factor containing the fuel part of the massflow from ACF in order to take into considerantion the cooling effect in CPV" MAP 0x8054FBF8 RB_Map_U16S16_U16 0.9999847 fak_uw_b1 0.00 0.9999847 FORMAT "%9.7"
 /begin AXIS_DESCR STD_AXIS mste_w_msg m_uw_b25p6 6 0.00 25.59961 FORMAT "%8.5" DEPOSIT ABSOLUTE /end AXIS_DESCR
 /begin AXIS_DESCR STD_AXIS ftead_w_msg fak_sw_b64 6 -64.00000 63.99805 FORMAT "%8.5" DEPOSIT ABSOLUTE /end AXIS_DESCR
/end CHARACTERISTIC
/begin CHARACTERISTIC CstrPurg_fakRadrCoolgIni_C "init value CPV cooling effect due to vehicle speed and radiator shutter position" VALUE 0x8054FC5C RB_Val_Ws16 1.999969 fak_sw_b1 -1.000000 0.999969 FORMAT "%8.6" EXTENDED_LIMITS -1.000000 0.9999695 /end CHARACTERISTIC
/begin CHARACTERISTIC CstrPurg_fakRadrCoolg_M "Map for determination of the factor, CPV cooling effect due to vehicle speed and radiator shutter position" MAP 0x8054FC5E RB_Map_S16U16_S16 1.999969 fak_sw_b1 -1.000000 0.999969 FORMAT "%8.6" EXTENDED_LIMITS -1.000000 0.9999695
 /begin AXIS_DESCR STD_AXIS VehV_v Vel 6 -327.6800 327.6700 FORMAT "%8.4" DEPOSIT ABSOLUTE /end AXIS_DESCR
 /begin AXIS_DESCR STD_AXIS CstrPurg_ratRadShtDes rel_uw_b200 4 0.00 199.9969 FORMAT "%8.4" DEPOSIT ABSOLUTE /end AXIS_DESCR
/end CHARACTERISTIC
/begin CHARACTERISTIC CstrPurg_flgFteadRampUpActvOlc_M "Activation map for increase of purge control adaptation value (FuPurg - limp home mode) in case of high evapuration" MAP 0x805503F8 RB_Map_S16S16_U8 1.000 OneToOne 0.00 1.000 FORMAT "%5.3" EXTENDED_LIMITS 0.00 255.0
 /begin AXIS_DESCR STD_AXIS EnvT_t Temp_Cels 6 -3549.940 3003.560 FORMAT "%8.3" DEPOSIT ABSOLUTE /end AXIS_DESCR
 /begin AXIS_DESCR STD_AXIS EnvP_p RBPtCel_p_1p0_1 6 -32768.00 32767.00 FORMAT "%8.2" DEPOSIT ABSOLUTE /end AXIS_DESCR
/end CHARACTERISTIC
/begin AXIS_PTS CstrPurg_IntkAirTDpdtBscPnt_AX "intake air dependent basic point (number = 4)" 0x8054FF1A CstrPurg_tIntkAir RB_Axis_S16 6553.500 Temp_Cels 4 -3549.940 3003.560 FORMAT "%8.3" DEPOSIT ABSOLUTE /end AXIS_PTS
/begin CHARACTERISTIC CstrPurg_LambdaEnaMax_C "Lambda control factor Maximum calibration value" VALUE 0x80550312 RB_Val_Wu16 1.999969 fak_uw_b2 0.00 1.999969 FORMAT "%8.6" /end CHARACTERISTIC
/begin CHARACTERISTIC CstrPurg_LambdaEnaMin_C "Lambda control factor Minimum calibration value" VALUE 0x80550314 RB_Val_Wu16 1.999969 fak_uw_b2 0.00 1.999969 FORMAT "%8.6" /end CHARACTERISTIC
/begin CHARACTERISTIC CstrPurg_mfMaxIncLoAcfLoad_M "characteristic line maximum increase of purge mass flow for low canister load" MAP 0x80550170 RB_Map_U16U16_U16 26214.07 mgrad_q0p400001 0.00 26214.07 FORMAT "%8.2"
 /begin AXIS_DESCR STD_AXIS mstesoll_w_msg m_uw_b25p6 5 0.00 25.59961 FORMAT "%8.5" DEPOSIT ABSOLUTE /end AXIS_DESCR
 /begin AXIS_DESCR STD_AXIS CstrPurg_ratPLoLoadPurgLnToEnv fak_uw_b8 6 0.00 7.999878 FORMAT "%8.6" DEPOSIT ABSOLUTE /end AXIS_DESCR
/end CHARACTERISTIC
/begin CHARACTERISTIC CstrPurg_mfMaxLimCatWrmActv_M "Map to limit the massflow through the CPV based on engine speed and engine temperature during catalyst warming phase" MAP 0x805501C6 RB_Map_S16S16_U16 25.59961 m_uw_b25p6 0.00 25.59961 FORMAT "%8.5"
 /begin AXIS_DESCR STD_AXIS Epm_nEng EngN 6 -16384.00 16383.50 FORMAT "%8.2" DEPOSIT ABSOLUTE /end AXIS_DESCR
 /begin AXIS_DESCR STD_AXIS CEngDsT_t Temp_Cels 6 -3549.940 3003.560 FORMAT "%8.3" DEPOSIT ABSOLUTE /end AXIS_DESCR
/end CHARACTERISTIC
/begin CHARACTERISTIC CstrPurg_nEngMinDlyLoLoad_C "Minimum Engine speed for calculating the distance travelled by the mass flow in the transport model in delay-time block in the low load purge line." VALUE 0x805505FC RB_Val_Wu16 32767.50 EngN 0.00 32767.50 FORMAT "%8.2" /end CHARACTERISTIC
/begin CHARACTERISTIC CstrPurg_nEngThd_T "Additional threshold for engine speed out of idle speed for canister purge control" CURVE 0x80550316 RB_Curve_S16_S16 32767.50 EngN -16384.00 16383.50 FORMAT "%8.2"
 /begin AXIS_DESCR STD_AXIS VehV_v Vel 8 -327.6800 327.6700 FORMAT "%8.4" DEPOSIT ABSOLUTE /end AXIS_DESCR
/end CHARACTERISTIC
/begin CHARACTERISTIC CstrPurg_ratWghtRelAirFillgIni_C "Initial factor weighteded relative air charge" VALUE 0x8054FCA6 RB_Val_Wu16 1535.977 rel_uw_q0p0234 0.00 1535.977 FORMAT "%8.3" /end CHARACTERISTIC
/begin CHARACTERISTIC CstrPurg_stCpvClsFcoDly_C "codeword for reset the filter after a delay when fuel cut off is finished" VALUE 0x8054FF24 RB_Val_Wu8 255.0 OneToOne 0.00 255.0 FORMAT "%5.1" /end CHARACTERISTIC
/begin CHARACTERISTIC CstrPurg_stFuCmpDeact_C "Deactivation of the fuel compensation during the cannister purging diagnosis (diagnosis that use a lambda deviation as an OK criteria should deactivate the compensation) Bitwise coded" VALUE 0x805505FE RB_Val_Wu8 255.0 dez 0.00 255.0 FORMAT "%5.1" /end CHARACTERISTIC
/begin CHARACTERISTIC CstrPurg_stIniTESKSOL_C "Codeword for initialisation in the function: Set value calculation for specific fuel rate of purge control (TESKSOL)" VALUE 0x8054FF25 RB_Val_Wu8 255.0 OneToOne 0.00 255.0 FORMAT "%5.1" /end CHARACTERISTIC
/begin CHARACTERISTIC CstrPurg_stMfMaxIncAcfLoad_C "Codeword to activate the load-dependent max. increase of the purge mass flow" VALUE 0x8055022A RB_Val_Wu8 255.0 dez 0.00 255.0 FORMAT "%5.1" /end CHARACTERISTIC
/begin CHARACTERISTIC CstrPurg_stSelnLamRdy_C "Lambda selection ready for Canister Purging" VALUE 0x8054F704 RB_Val_Wu8 255.0 dez 0.00 255.0 FORMAT "%5.1" /end CHARACTERISTIC
/begin CHARACTERISTIC CstrPurg_SwtMnfldCpvTMdl_C "Switch for manifold temperature selection for CPV temperature modelling" VALUE 0x8054FCA8 RB_Val_Wu8 255.0 OneToOne 0.00 255.0 FORMAT "%5.1" /end CHARACTERISTIC
/begin CHARACTERISTIC CstrPurg_tiAdpnAuthModChg_C "Time delay for reactivation the computation of the fuel adaptation after a mode change" VALUE 0x80550438 RB_Val_Wu8 25.50 t_q0p1 0.00 25.50 FORMAT "%5.2" /end CHARACTERISTIC
/begin CHARACTERISTIC CstrPurg_tiAgThrFil_C "Time constant for the filtering of the throttle angle" VALUE 0x8054FF26 RB_Val_Wu16 1310.680 t_q0p02 0.020 1310.700 FORMAT "%8.3" EXTENDED_LIMITS 0.00 1310.700 /end CHARACTERISTIC
/begin CHARACTERISTIC CstrPurg_tiAirChrgFil_C "time constant for filtering the rel. air charge" VALUE 0x8054FF28 RB_Val_Wu16 1310.680 t_q0p02 0.020 1310.700 FORMAT "%8.3" EXTENDED_LIMITS 0.00 1310.700 /end CHARACTERISTIC
/begin CHARACTERISTIC CstrPurg_tiBndyValCtrl_M "time constant for filtering of boundary value control fuel evaporation" MAP 0x8054FF2A RB_Map_S16U16_U8 25.40 t_q0p1 0.10 25.50 FORMAT "%5.2" EXTENDED_LIMITS 0.00 25.50
 /begin AXIS_DESCR STD_AXIS Epm_nEng EngN 5 -16384.00 16383.50 FORMAT "%8.2" DEPOSIT ABSOLUTE /end AXIS_DESCR
 /begin AXIS_DESCR STD_AXIS rl_w_msg rel_uw_q0p0234 5 0.00 1535.977 FORMAT "%8.3" DEPOSIT ABSOLUTE /end AXIS_DESCR
/end CHARACTERISTIC
/begin CHARACTERISTIC CstrPurg_tiCpvClsFcoDly_C "time delay to reset the filter during fuel cut off" VALUE 0x8054FF5C RB_Val_Wu8 25.50 t_q0p1 0.00 25.50 FORMAT "%5.2" /end CHARACTERISTIC
/begin CHARACTERISTIC CstrPurg_tiCstrLdAdpnDly_C "Canister load adaption Delay time after fuel cut off was disabled" VALUE 0x80550439 RB_Val_Wu8 25.50 t_q0p1 0.00 25.50 FORMAT "%5.2" /end CHARACTERISTIC
/begin CHARACTERISTIC CstrPurg_tiFakMFlowAcfLd_T "Filtered factor, load of the massflow flowing through the CPV" CURVE 0x8054FCAA RB_Curve_U16_U16 1310.680 t_q0p02 0.020 1310.700 FORMAT "%8.3" EXTENDED_LIMITS 0.00 1310.700
 /begin AXIS_DESCR STD_AXIS mste_w_msg m_uw_b25p6 5 0.00 25.59961 FORMAT "%8.5" DEPOSIT ABSOLUTE /end AXIS_DESCR
/end CHARACTERISTIC
/begin CHARACTERISTIC CstrPurg_tiFilEtc_M "Filter-Value for the distance-Modeling from ETC to CPV" MAP 0x8054FCC0 RB_Map_U16U16_U16 1310.680 t_q0p02 0.020 1310.700 FORMAT "%8.3" EXTENDED_LIMITS 0.00 1310.700
 /begin AXIS_DESCR STD_AXIS rl_w_msg rel_uw_q0p0234 5 0.00 1535.977 FORMAT "%8.3" DEPOSIT ABSOLUTE /end AXIS_DESCR
 /begin AXIS_DESCR STD_AXIS CstrPurg_tDifThr2Env temp_q0p0234_o273 5 0.014 1262.827 FORMAT "%8.3" EXTENDED_LIMITS -273.1500 1262.827 DEPOSIT ABSOLUTE /end AXIS_DESCR
/end CHARACTERISTIC
/begin CHARACTERISTIC CstrPurg_tiFtivDiagDmtlHiLoad_C "Time to delay the DMTL diagnosis to detect high loading in canister" VALUE 0x8055060C RB_Val_Wu16 6553.500 t_q0p1 0.00 6553.500 FORMAT "%8.3" /end CHARACTERISTIC
/begin CHARACTERISTIC CstrPurg_tiInhLamDevMax_C "Max. time for a large deviation in the lambda value to inhibit the canister purging" VALUE 0x80550338 RB_Val_Wu16 6553.500 t_q0p1 0.00 6553.500 FORMAT "%8.3" /end CHARACTERISTIC
/begin CHARACTERISTIC CstrPurg_tiLoadFilt_C "Time constant for filtering of the factor canister purge valve temperature effect on account of the vehicle speed and the weighteded filtered load" VALUE 0x8054FD0A RB_Val_Wu16 1310.680 t_q0p02 0.020 1310.700 FORMAT "%8.3" EXTENDED_LIMITS 0.00 1310.700 /end CHARACTERISTIC
/begin CHARACTERISTIC CstrPurg_tiMfRmpDwnDft_C "Default Ramp down time for desired mass flow" VALUE 0x8055022B RB_Val_Wu8 5.100 t_q0p02 0.00 5.100 FORMAT "%5.3" /end CHARACTERISTIC
/begin CHARACTERISTIC CstrPurg_tiMfRmpDwnDiagLoLdPurgLn_C "Ramp down time for desired mass flow for Diag Low Load Purge Line" VALUE 0x8055022C RB_Val_Wu8 5.100 t_q0p02 0.00 5.100 FORMAT "%5.3" /end CHARACTERISTIC
/begin CHARACTERISTIC CstrPurg_tIntkAirIdleThd_C "Intake air temperature threshold for canister purge control with idle speed" VALUE 0x8055033A RB_Val_Ws16 6553.500 Temp_Cels -3549.940 3003.560 FORMAT "%8.3" /end CHARACTERISTIC
/begin CHARACTERISTIC CstrPurg_tiRadrCoolgFilt_C "Time constante for filtering factor, CPV cooling effect due to vehicle speed and radiator shutter position" VALUE 0x8054FD0C RB_Val_Wu16 1310.6999997 zk20msxs_uw_b1310p72 0.0200003 1310.7200000 FORMAT "%12.7" EXTENDED_LIMITS 0.020000305180 1310.7200000 /end CHARACTERISTIC
/begin CHARACTERISTIC CstrPurg_tiWghtRelAirFillgFilt_C "Time constant for filtering of the weighteded relative air charge" VALUE 0x8054FD0E RB_Val_Wu16 1310.680 t_q0p02 0.020 1310.700 FORMAT "%8.3" EXTENDED_LIMITS 0.00 1310.700 /end CHARACTERISTIC
/begin CHARACTERISTIC CstrPurg_tqMaxRngOptmTqCpv_M "Maximum band optimum torque for TEV" MAP 0x8055060E RB_Map_S16S16_U16 99.99847 rel_uw_b100 0.00 99.99847 FORMAT "%8.5"
 /begin AXIS_DESCR STD_AXIS ftead_w_msg fak_sw_b64 7 -64.00000 63.99805 FORMAT "%8.5" DEPOSIT ABSOLUTE /end AXIS_DESCR
 /begin AXIS_DESCR STD_AXIS CstrPurg_tIntkAir Temp_Cels 5 -3549.940 3003.560 FORMAT "%8.3" DEPOSIT ABSOLUTE /end AXIS_DESCR
/end CHARACTERISTIC
/begin CHARACTERISTIC CstrPurg_tqMinRngOptmTqCpv_M "Minimum band optimum torque for TEV" MAP 0x80550670 RB_Map_S16S16_U16 99.99847 rel_uw_b100 0.00 99.99847 FORMAT "%8.5"
 /begin AXIS_DESCR STD_AXIS ftead_w_msg fak_sw_b64 7 -64.00000 63.99805 FORMAT "%8.5" DEPOSIT ABSOLUTE /end AXIS_DESCR
 /begin AXIS_DESCR STD_AXIS CstrPurg_tIntkAir Temp_Cels 5 -3549.940 3003.560 FORMAT "%8.3" DEPOSIT ABSOLUTE /end AXIS_DESCR
/end CHARACTERISTIC
/begin CHARACTERISTIC CstrPurg_ttadkmax_C "maximum intake air temperature at throttle" VALUE 0x8054FD10 RB_Val_Wu16 1535.977 temp_q0p0234_o273 -273.150 1262.827 FORMAT "%8.3" /end CHARACTERISTIC
/begin CHARACTERISTIC CstrPurg_uBattMax_C "Maximum battery voltage for fuel purge activated" VALUE 0x8055033C RB_Val_Ws16 1310700. Volt_Batt -655360.0 655340.0 FORMAT "%8.1" /end CHARACTERISTIC
/begin CHARACTERISTIC CstrPurg_uBattMin_C "Minimum battery voltage for fuel purge activated" VALUE 0x8055033E RB_Val_Ws16 1310700. Volt_Batt -655360.0 655340.0 FORMAT "%8.1" /end CHARACTERISTIC
/begin CHARACTERISTIC CWDTETERK "Configuration for the relative fuel part calculation in the fuel purge system" VALUE 0x805505FF RB_Val_Wu8 255.0 dez 0.00 255.0 FORMAT "%5.1" /end CHARACTERISTIC
/begin CHARACTERISTIC CWFPC "Codeword fuel purge control" VALUE 0x80550340 RB_Val_Wu8 255.0 dez 0.00 255.0 FORMAT "%5.1" /end CHARACTERISTIC
/begin CHARACTERISTIC CWFPC2CE "Codeword priority FPC2CE" VALUE 0x805506D2 RB_Val_Wu8 255.0 dez 0.00 255.0 FORMAT "%5.1" /end CHARACTERISTIC
/begin CHARACTERISTIC CWFPCES "Codeword closed loop purge control for error suspicion" VALUE 0x80550341 RB_Val_Wu8 255.0 dez 0.00 255.0 FORMAT "%5.1" /end CHARACTERISTIC
/begin CHARACTERISTIC CWFPCFELMR "Codeword configuration massflow request from tank leakage diagnosis" VALUE 0x80550342 RB_Val_Wu8 255.0 dez 0.00 255.0 FORMAT "%5.1" /end CHARACTERISTIC
/begin CHARACTERISTIC CWFPCKH "codeword to configure purge control during catalyst heating" VALUE 0x80550343 RB_Val_Wu8 255.0 dez 0.00 255.0 FORMAT "%5.1" /end CHARACTERISTIC
/begin CHARACTERISTIC CWFPCMW "Codeword fuel purge control mode change" VALUE 0x80550344 RB_Val_Wu8 255.0 dez 0.00 255.0 FORMAT "%5.1" /end CHARACTERISTIC
/begin CHARACTERISTIC CWFPCPHU "codeword physical urgency fuel purge control" VALUE 0x8054F726 RB_Val_Wu8 255.0 dez 0.00 255.0 FORMAT "%5.1" /end CHARACTERISTIC
/begin CHARACTERISTIC CWFPCPRIO "codeword to activate high canister load" VALUE 0x80550345 RB_Val_Wu8 255.0 dez 0.00 255.0 FORMAT "%5.1" /end CHARACTERISTIC
/begin CHARACTERISTIC CWFPCTEN "Code word: reset integral of purge mass flow (imsteini) in case of tank ventilation in emergency" VALUE 0x8054FF5D RB_Val_Wu8 255.0 OneToOne 0.00 255.0 FORMAT "%5.1" /end CHARACTERISTIC
/begin CHARACTERISTIC CWFTEVFTEAD "Codeword for the configuration of the relative canister purge valve (CPV) opening dependent of the fuel purge adaptation factor" VALUE 0x8054FF5E RB_Val_Wu8 255.0 OneToOne 0.00 255.0 FORMAT "%5.1" /end CHARACTERISTIC
/begin CHARACTERISTIC CWFUEDK "codeword FUEDK" VALUE 0x8054F3A0 RB_Val_Wu16 65535.00 dez 0.00 65535.00 FORMAT "%8.2" /end CHARACTERISTIC
/begin CHARACTERISTIC CWLRASTO "codeword to configure the adaptation strategy in start-stop-systems" VALUE 0x8054F22C RB_Val_Wu8 255.0 dez 0.00 255.0 FORMAT "%5.1" /end CHARACTERISTIC
/begin CHARACTERISTIC CWLRASTO2 "codeword to configure the adaptation strategy in start-stop-systems" VALUE 0x8054F22D RB_Val_Wu8 255.0 dez 0.00 255.0 FORMAT "%5.1" /end CHARACTERISTIC
/begin CHARACTERISTIC CWOSSDABBR "codeword for configuration of ORA stop prohibitions in case of strategy ""one ORA adaptation per DCY""" VALUE 0x8054F22E RB_Val_Wu8 255.0 dez 0.00 255.0 FORMAT "%5.1" /end CHARACTERISTIC
/begin CHARACTERISTIC CWTEBGTEV "Codeword for several configurations in the function: calculation of the actual massflow (TEBGTEV)" VALUE 0x8054FD12 RB_Val_Wu8 255.0 dez 0.00 255.0 FORMAT "%5.1" /end CHARACTERISTIC
/begin CHARACTERISTIC CWTEGAEOL "Codeword: activation inhibit of fuel purge until mixture adaptation is stabilized (for end of line)" VALUE 0x80550346 RB_Val_Wu8 255.0 dez 0.00 255.0 FORMAT "%5.1" /end CHARACTERISTIC
/begin CHARACTERISTIC CWTEINI "Codeword to switch between ambient air temperature, engine temperature or the model temperature for fuel" VALUE 0x8054FF5F RB_Val_Wu8 255.0 OneToOne 0.00 255.0 FORMAT "%5.1" /end CHARACTERISTIC
/begin CHARACTERISTIC CWTERK "Configuration for the relative fuel part calculation in the fuel purge system" VALUE 0x80550600 RB_Val_Wu8 255.0 dez 0.00 255.0 FORMAT "%5.1" /end CHARACTERISTIC
/begin CHARACTERISTIC DKNOTBEGR "Limtation of set value as f(nmot) if B_dknot = true" CURVE 0x8054F564 RB_Curve_S16_U16_Static 99.99847 rel_uw_b100 0.00 99.99847 FORMAT "%8.5"
 /begin AXIS_DESCR STD_AXIS Epm_nEng EngN 8 -16384.00 16383.50 FORMAT "%8.2" DEPOSIT ABSOLUTE /end AXIS_DESCR
/end CHARACTERISTIC
/begin CHARACTERISTIC DRLSOLMF "threshold delta rlsol for Medianfilter" VALUE 0x8054F586 RB_Val_Wu16 49.99219 rel_uw_q0p0234 0.00 49.99219 FORMAT "%8.5" EXTENDED_LIMITS 0.00 1535.977 /end CHARACTERISTIC
/begin CHARACTERISTIC DRLTELL "Delta hyteresis for the minimum air filling at the idle speed" VALUE 0x80550348 RB_Val_Wu16 1535.977 rel_q0p0234 0.00 1535.977 FORMAT "%8.3" /end CHARACTERISTIC
/begin CHARACTERISTIC EngStrt_nEngThdFstCutOff_C "engine speed threshold to set Demand for fast starter cut off during succession start" VALUE 0x8054F248 RB_Val_Ws16 32767.50 EngN -16384.00 16383.50 FORMAT "%8.2" /end CHARACTERISTIC
/begin CHARACTERISTIC FBTEFKA "Correction factor for the learning speed of the fuel purge adaptation due to the actual specific fuel amount" CURVE 0x8055043A RB_Curve_U8_U8 0.9961 fak_ub_b1 0.00 0.9961
 /begin AXIS_DESCR STD_AXIS fkaste_msg fak_ub_b0p5 5 0.00 0.4980 DEPOSIT ABSOLUTE /end AXIS_DESCR
/end CHARACTERISTIC
/begin CHARACTERISTIC FBTEFKAX "Correction factor for the learning speed of the fuel purge adaptation due to the max. possible specific fuel amount" CURVE 0x80550445 RB_Curve_U8_U8 0.9961 fak_ub_b1 0.00 0.9961
 /begin AXIS_DESCR STD_AXIS fkastexm fak_ub_b0p5 5 0.00 0.4980 DEPOSIT ABSOLUTE /end AXIS_DESCR
/end CHARACTERISTIC
/begin CHARACTERISTIC FGWRMSMX "Max. value of the lambda controller depending mass flow reduction" VALUE 0x8055022D RB_Val_Wu8 15.94 fak_ub_b16 0.00 15.94 FORMAT "%5.2" /end CHARACTERISTIC
/begin CHARACTERISTIC FKAKORBMN "minimum of the range of fkakormt_w for identification of mixture error suspicion" VALUE 0x8054F728 RB_Val_Wu16 1.999969 fak_uw_b2 0.00 1.999969 FORMAT "%8.6" /end CHARACTERISTIC
/begin CHARACTERISTIC FKAKORBMX "maximum of the range of fkakormt_w for identification of mixture error suspicion" VALUE 0x8054F72A RB_Val_Wu16 1.999969 fak_uw_b2 0.00 1.999969 FORMAT "%8.6" /end CHARACTERISTIC
/begin CHARACTERISTIC FKAPROG "Progression for opening speed for the specific fuel purge fuel amount calculation" CURVE 0x8054FF60 RB_Curve_U8_U8 7.969 fak_ub_b8 0.00 7.969 FORMAT "%5.3"
 /begin AXIS_DESCR STD_AXIS fkastes fak_ub_b0p5 5 0.00 0.4980 DEPOSIT ABSOLUTE /end AXIS_DESCR
/end CHARACTERISTIC
/begin CHARACTERISTIC FKASTINXH "Characteristic line maximum specific fuel amount with integral of purge mass flow after long purge stop" CURVE 0x8054FF6C RB_Curve_U8_U16_Static 0.4999924 fak_uw_b0p5 0.00 0.4999924 FORMAT "%9.7"
 /begin AXIS_DESCR STD_AXIS imsteini_msg m_ub_q0p0444 5 0.00 11.32 FORMAT "%5.2" DEPOSIT ABSOLUTE /end AXIS_DESCR
/end CHARACTERISTIC
/begin CHARACTERISTIC FKATEB "Characteristic curve for fuel portion depending on injection time to minimum injection time" CURVE 0x8054FF7C RB_Curve_U8_U8 0.9961 fak_ub_b1 0.00 0.9961
 /begin AXIS_DESCR STD_AXIS qtetemin_msg fak_ub_b4 4 0.00 3.984 FORMAT "%5.3" DEPOSIT ABSOLUTE /end AXIS_DESCR
/end CHARACTERISTIC
/begin CHARACTERISTIC FKATEBMFE "Characteristic curve for fuel portion depending on injection time to minimum injection time with multiple injections" CURVE 0x8054FF85 RB_Curve_U8_U8 0.9961 fak_ub_b1 0.00 0.9961
 /begin AXIS_DESCR STD_AXIS qtetemin_msg fak_ub_b4 4 0.00 3.984 FORMAT "%5.3" DEPOSIT ABSOLUTE /end AXIS_DESCR
/end CHARACTERISTIC
/begin CHARACTERISTIC FKATEUM "Factor purge fuel amount for enabling Gasoline Direct Injection (GDI) mode change" VALUE 0x8055022E RB_Val_Wu8 0.9961 fak_ub_b1 0.00 0.9961 /end CHARACTERISTIC
/begin CHARACTERISTIC FKATEUMS "factor purge fuel amount for enabeling BDE mode change" VALUE 0x8054F72C RB_Val_Ws8 0.9922 fak_sb_b1 0.00 0.9922 EXTENDED_LIMITS -1.000 0.9922 /end CHARACTERISTIC
/begin CHARACTERISTIC FKLAFUGD "Output of KLAF in event of PSPVDKUG" VALUE 0x8054F3A2 RB_Val_Wu16 1.000000 fak_q3p0518Em5 0.00 1.000000 FORMAT "%8.6" EXTENDED_LIMITS 0.00 1.999969 READ_ONLY /end CHARACTERISTIC
/begin CHARACTERISTIC FlMA_facEvapThdMax_T "deactivation threshold of fuel mixtue adaptation if the proportion of evaporating fuel from the engine oil to the fuel demand is too big" CURVE 0x8054F22F RB_Curve_U8_U8 1.992188 fak_ub_b2 0.00 1.992188 FORMAT "%8.6"
 /begin AXIS_DESCR STD_AXIS Epm_nEngLRes EngN_LRes 4 0.00 10200. FORMAT "%5.0" DEPOSIT ABSOLUTE /end AXIS_DESCR
/end CHARACTERISTIC
/begin CHARACTERISTIC FLMA_nrMaxStrtVDpd_C "Maximum allowed number of engine starts depending on vehicle speed" VALUE 0x8054F238 RB_Val_Wu16 65535.00 OneToOne 0.00 65535.00 FORMAT "%8.2" /end CHARACTERISTIC
/begin CHARACTERISTIC FLTEFUEL "Factor for purge flow directly entering into manifold" CURVE 0x8054FD13 RB_Curve_U8_U8 0.9961 fak_ub_b1 0.00 0.9961 /begin AXIS_DESCR STD_AXIS qltefil fak_ub_b1 4 0.00 0.9961 DEPOSIT ABSOLUTE /end AXIS_DESCR /end CHARACTERISTIC
/begin CHARACTERISTIC FPCtl_mfThdCpvFlow_C "lower threshold for the integrated purge mass flow" VALUE 0x8055034A RB_Val_Wu8 11.32 m_ub_q0p0444 0.00 11.32 FORMAT "%5.2" /end CHARACTERISTIC
/begin CHARACTERISTIC FPWDKAPP "throttle angle dependent on accelerator pedal position, only for calibration" CURVE 0x8054F3A4 RB_Curve_S16_U16_Static 99.99847 rel_uw_b100 0.00 99.99847 FORMAT "%8.5"
 /begin AXIS_DESCR STD_AXIS APP_r Prc 8 -400.0000 399.9878 FORMAT "%8.4" DEPOSIT ABSOLUTE /end AXIS_DESCR
/end CHARACTERISTIC
/begin CHARACTERISTIC FRKTEMN "Factor for minimum permissible relative fuel part calculation in the fuel purge system" VALUE 0x80550602 RB_Val_Ws16 1.999969 fak_sw_b1 -1.000000 0.999969 FORMAT "%8.6" EXTENDED_LIMITS -1.000000 0.9999695 /end CHARACTERISTIC
/begin CHARACTERISTIC FRKTEMX "Factor for maximum permissible relative fuel part calculation in the fuel purge system" VALUE 0x80550604 RB_Val_Ws16 1.999969 fak_sw_b1 -1.000000 0.999969 FORMAT "%8.6" EXTENDED_LIMITS -1.000000 0.9999695 /end CHARACTERISTIC
/begin CHARACTERISTIC FSRFKAS "Factor for control speed of specific purge fuel rate controller" VALUE 0x8054FF8E RB_Val_Wu8 31.75 fak_ub_b64 0.25 32.00 FORMAT "%5.2" EXTENDED_LIMITS 0.00 63.75 /end CHARACTERISTIC
/begin CHARACTERISTIC FTEADBNL "Learning speed fuel component regeneration gas in open loop mode fuel purge" VALUE 0x80550450 RB_Val_Wu8 79.69 perio_q0p3125 0.00 79.69 FORMAT "%5.2" /end CHARACTERISTIC
/begin CHARACTERISTIC FTEADMAX "maximum value purge control adaptation" VALUE 0x80550451 RB_Val_Ws8 127.5 fak_sb_b64 -64.00 63.50 FORMAT "%5.2" /end CHARACTERISTIC
/begin CHARACTERISTIC FTEADMINH "minimum limitation purge control adaptation homogenous mode" VALUE 0x80550452 RB_Val_Ws8 127.5 fak_sb_b64 -64.00 63.50 FORMAT "%5.2" /end CHARACTERISTIC
/begin CHARACTERISTIC FTEADPRIMN "min. threshold canister load for prohibition engine stop" VALUE 0x805506D3 RB_Val_Ws8 127.5 fak_sb_b64 -64.00 63.50 FORMAT "%5.2" /end CHARACTERISTIC
/begin CHARACTERISTIC FTEADPRIMX "max. threshold canister load for prohibition engine stop" VALUE 0x805506D4 RB_Val_Ws8 127.5 fak_sb_b64 -64.00 63.50 FORMAT "%5.2" /end CHARACTERISTIC
/begin CHARACTERISTIC FTEADRNMN "Minimum threshold reset HC-load open loop mode fuel purge" VALUE 0x80550454 RB_Val_Wu16 127.9980 fak_uw_b128 0.00 127.9980 FORMAT "%8.4" /end CHARACTERISTIC
/begin CHARACTERISTIC FTEADRPL "load threshold for reset from medium load to low load" VALUE 0x8055034B RB_Val_Ws8 127.5 fak_sb_b64 -64.00 63.50 FORMAT "%5.2" /end CHARACTERISTIC
/begin CHARACTERISTIC FTEADSPH "load threshold for set from medium load to high load" VALUE 0x8055034C RB_Val_Ws8 127.5 fak_sb_b64 -64.00 63.50 FORMAT "%5.2" /end CHARACTERISTIC
/begin CHARACTERISTIC FuPurgCPVDiag_idxEngLd_C "parameter for Index of load demand to the engine coordinator for canister purge valve diagnosis" VALUE 0x805506D5 RB_Val_Wu8 255.0 OneToOne 0.00 255.0 FORMAT "%5.1" /end CHARACTERISTIC
/begin CHARACTERISTIC FuPurgCPVDiag_stOpmHybStgyReq_C "parameter for Operation mode hybrid strategy request for canister purge valve diagnosis" VALUE 0x805506D6 RB_Val_Wu8 255.0 OneToOne 0.00 255.0 FORMAT "%5.1" /end CHARACTERISTIC
/begin CHARACTERISTIC FuPurgCtrl_facCatClngAdpn_M "Calibratable table concerning the learning speed of the FC" MAP 0x80550456 RB_Map_U16S16_U8 2.000 q0p01 0.00 2.000 FORMAT "%5.3" EXTENDED_LIMITS 0.00 2.550
 /begin AXIS_DESCR STD_AXIS FuPurgCtrl_mExhB1 q0p1_g 5 0.00 6553.500 FORMAT "%8.3" DEPOSIT ABSOLUTE /end AXIS_DESCR
 /begin AXIS_DESCR STD_AXIS EnvT_t Temp_Cels 5 -3549.940 3003.560 FORMAT "%8.3" DEPOSIT ABSOLUTE /end AXIS_DESCR
/end CHARACTERISTIC
/begin CHARACTERISTIC FuPurgHiHCLoad_idxEngLd_C "parameter for Index of load demand to the engine coordinator for high canister load" VALUE 0x805506D7 RB_Val_Wu8 255.0 OneToOne 0.00 255.0 FORMAT "%5.1" /end CHARACTERISTIC
/begin CHARACTERISTIC FuPurgHiHCLoad_stOpmHybStgyReq_C "parameter for Operation mode hybrid strategy request with high canister load" VALUE 0x805506D8 RB_Val_Wu8 255.0 OneToOne 0.00 255.0 FORMAT "%5.1" /end CHARACTERISTIC
/begin CHARACTERISTIC FuPurg_facAdpnInhHMBMin_C "minimum ftead value to reset setpoint of camshaft during high canister load" VALUE 0x805506D9 RB_Val_Ws8 127.5 fak_sb_b64 -64.00 63.50 FORMAT "%5.2" /end CHARACTERISTIC
/begin CHARACTERISTIC FuPurg_facAdpnRailPRednMax_C "maximum ftead to request rail pressure reduction during high canister load" VALUE 0x805506DA RB_Val_Ws8 127.5 fak_sb_b64 -64.00 63.50 FORMAT "%5.2" /end CHARACTERISTIC
/begin CHARACTERISTIC FuPurg_facAdpnRailPRednMin_C "minimum ftead value to reset rail pressure reduction during high canister load" VALUE 0x805506DB RB_Val_Ws8 127.5 fak_sb_b64 -64.00 63.50 FORMAT "%5.2" /end CHARACTERISTIC
/begin CHARACTERISTIC FuPurg_facAdpnSpCamsftMax_C "maximum ftead to request setpoint of camshaft during high canister load" VALUE 0x805506DC RB_Val_Ws8 127.5 fak_sb_b64 -64.00 63.50 FORMAT "%5.2" /end CHARACTERISTIC
/begin CHARACTERISTIC GBX_CONVCLTH_CLSDC_RP "Application Value of Status of the Gearbox converter clutch for closed clutch (PROTOTYPE)" VALUE 0x8058A980 KwWU8 255.0 OneToOne 0.00 255.0 FORMAT "%5.1" /end CHARACTERISTIC
/begin CHARACTERISTIC GBX_CONVCLTH_CTL_C_RP "Application Value of Status of the Gearbox converter clutch for clutch in motion(PROTOTYPE)" VALUE 0x8058A981 KwWU8 255.0 OneToOne 0.00 255.0 FORMAT "%5.1" /end CHARACTERISTIC
/begin CHARACTERISTIC GBX_CONVCLTH_ERROR_C_RP "Application Value of Status of the Gearbox converter clutch for error clutch-state (PROTOTYPE)" VALUE 0x8058A982 KwWU8 255.0 OneToOne 0.00 255.0 FORMAT "%5.1" /end CHARACTERISTIC
/begin CHARACTERISTIC GBX_CONVCLTH_OPN_C_RP "Application Value of Status of the Gearbox converter clutch for open clutch (PROTOTYPE)" VALUE 0x8058A983 KwWU8 255.0 OneToOne 0.00 255.0 FORMAT "%5.1" /end CHARACTERISTIC
/begin CHARACTERISTIC Gbx_trqOilPmpLos_C "Default Calibration for Gbx_trqOilPmplos_C" VALUE 0x80555B24 RB_Val_Ws16 6553.500 Trq -3276.800 3276.700 FORMAT "%8.3" /end CHARACTERISTIC
/begin CHARACTERISTIC Gbx_trqTSCIntvSlowTrsmFail_C "Fail safe calibration vlaue for Gbx_trqTSCIntvSlow" VALUE 0x80555B26 RB_Val_Ws16 6553.500 Trq -3276.800 3276.700 FORMAT "%8.3" /end CHARACTERISTIC
/begin CHARACTERISTIC Gbx_trqTSCIntvSlow_FailSafeA_C "FailSafeA calibration for Engine torque amount (by Air) when error is in DEBOUNCING state" VALUE 0x80555B28 RB_Val_Ws16 6553.500 Trq -3276.800 3276.700 FORMAT "%8.3" /end CHARACTERISTIC
/begin CHARACTERISTIC Gbx_trqTSCIntvSlow_FailSafeB_C "FailSafeB calibration for Engine torque amount (by Air) when error is in DEBOUNCED state" VALUE 0x80555B2A RB_Val_Ws16 6553.500 Trq -3276.800 3276.700 FORMAT "%8.3" /end CHARACTERISTIC
/begin CHARACTERISTIC IMSRTENL "Threshold reset intregral purge mass flow for open loop fuel purge" VALUE 0x8054FF8F RB_Val_Wu8 1.992188 fak_ub_b2 0.00 1.992188 FORMAT "%8.6" /end CHARACTERISTIC
/begin CHARACTERISTIC IMSTFTEVMN "Min. threshold for the integrated mass flow through the canister purge valve (CPV) to limit the relative CPV opening dependent of fuel purge adaptation factor" VALUE 0x8054FF90 RB_Val_Wu8 11.32 m_ub_q0p0444 0.00 11.32 FORMAT "%5.2" /end CHARACTERISTIC
/begin CHARACTERISTIC KAFLTESG "Flow constant from canister purge line to manifold" VALUE 0x8054FD1C RB_Val_Wu16 28.79956 fak1_q4p3945Em4 0.00 28.79956 FORMAT "%8.5" /end CHARACTERISTIC
/begin CHARACTERISTIC KFDMSTES "characteristic line maximum increase of purge mass flow" MAP 0x80550230 RB_Map_U16U8_U16 26214.07 mgrad_q0p400001 0.00 26214.07 FORMAT "%8.2"
 /begin AXIS_DESCR STD_AXIS mstesoll_w_msg m_uw_b25p6 5 0.00 25.59961 FORMAT "%8.5" DEPOSIT ABSOLUTE /end AXIS_DESCR
 /begin AXIS_DESCR STD_AXIS mksbg_msg m_ub_b25p6 6 0.00 25.50 FORMAT "%5.2" DEPOSIT ABSOLUTE /end AXIS_DESCR
/end CHARACTERISTIC
/begin CHARACTERISTIC KFFGWRKA "Map for purge rate reduction due to deviations of lambda controller" MAP 0x8054FF91 RB_Map_U8U8_U8 15.94 fak_ub_b16 0.00 15.94 FORMAT "%5.2"
 /begin AXIS_DESCR STD_AXIS fkakordl fak_ub_b4 10 0.00 3.984 FORMAT "%5.3" DEPOSIT ABSOLUTE /end AXIS_DESCR
 /begin AXIS_DESCR STD_AXIS mksbg_msg m_ub_b25p6 6 0.00 25.50 FORMAT "%5.2" DEPOSIT ABSOLUTE /end AXIS_DESCR
/end CHARACTERISTIC
/begin CHARACTERISTIC KFFKASVHE "characteristic map max. spec. purge fuel amount for variable valve lifting" MAP 0x8054FFDF RB_MapGroup_U8 0.4980 fak_ub_b0p5 0.00 0.4980
 /begin AXIS_DESCR COM_AXIS mksbg_msg m_ub_b25p6 5 0.00 25.50 FORMAT "%5.2" AXIS_PTS_REF SMK05TEUB /end AXIS_DESCR
 /begin AXIS_DESCR COM_AXIS CstrPurg_tIntkAir Temp_Cels 4 -3549.940 3003.560 FORMAT "%8.3" AXIS_PTS_REF CstrPurg_IntkAirTDpdtBscPnt_AX /end AXIS_DESCR
/end CHARACTERISTIC
/begin CHARACTERISTIC KFFKASX "Characteristic map for max. specific fuel purge fuel amount" MAP 0x8054FFF3 RB_MapGroup_U8 0.4980 fak_ub_b0p5 0.00 0.4980
 /begin AXIS_DESCR COM_AXIS mksbg_msg m_ub_b25p6 5 0.00 25.50 FORMAT "%5.2" AXIS_PTS_REF SMK05TEUB /end AXIS_DESCR
 /begin AXIS_DESCR COM_AXIS CstrPurg_tIntkAir Temp_Cels 4 -3549.940 3003.560 FORMAT "%8.3" AXIS_PTS_REF CstrPurg_IntkAirTDpdtBscPnt_AX /end AXIS_DESCR
/end CHARACTERISTIC
/begin CHARACTERISTIC KFFTEAD "curve factor purge control adaptation" MAP 0x80550488 RB_Map_U8U8_U8 79.69 perio_q0p3125 0.00 79.69 FORMAT "%5.2"
 /begin AXIS_DESCR STD_AXIS mksbg_msg m_ub_b25p6 5 0.00 25.50 FORMAT "%5.2" DEPOSIT ABSOLUTE /end AXIS_DESCR
 /begin AXIS_DESCR STD_AXIS imsteini_msg m_ub_q0p0444 3 0.00 11.32 FORMAT "%5.2" DEPOSIT ABSOLUTE /end AXIS_DESCR
/end CHARACTERISTIC
/begin CHARACTERISTIC KFFTEVFTEADLIM "Characteristic map for max. percentage of purge valve opening near full load in port fuel injection mode (PFI-mode) for fuel purge adaptation factor" MAP 0x80550008 RB_Map_S16S16_S16 0.9999695 fak_sw_b1 0.00 0.9999695 FORMAT "%9.7" EXTENDED_LIMITS -1.000000 0.9999695
 /begin AXIS_DESCR STD_AXIS ftead_w_msg fak_sw_b64 4 -64.00000 63.99805 FORMAT "%8.5" DEPOSIT ABSOLUTE /end AXIS_DESCR
 /begin AXIS_DESCR STD_AXIS pdiff_w p_sw_q0p039 6 -1280.000 1279.961 FORMAT "%8.3" DEPOSIT ABSOLUTE /end AXIS_DESCR
/end CHARACTERISTIC
/begin CHARACTERISTIC KFHTEKAH "characteristic map of desired fuel portion purge control in homogeneous mode" MAP 0x80550050 RB_MapGroup_U8 0.9961 fak_ub_b1 0.00 0.9961
 /begin AXIS_DESCR COM_AXIS Epm_nEngLRes EngN_LRes 4 0.00 10200. FORMAT "%5.0" AXIS_PTS_REF SNM04TEUB /end AXIS_DESCR
 /begin AXIS_DESCR COM_AXIS misol_w_msg rel_uw_b100 8 0.00 99.99847 FORMAT "%8.5" AXIS_PTS_REF SMI08TEUW /end AXIS_DESCR
/end CHARACTERISTIC
/begin CHARACTERISTIC KFKASNH "Characteristic map for max. specific fuel purge fuel amount for limp home homogeneous mode" MAP 0x80550070 RB_MapGroup_U8 0.4980 fak_ub_b0p5 0.00 0.4980
 /begin AXIS_DESCR COM_AXIS Epm_nEngLRes EngN_LRes 4 0.00 10200. FORMAT "%5.0" AXIS_PTS_REF SNM04TEUB /end AXIS_DESCR
 /begin AXIS_DESCR COM_AXIS misol_w_msg rel_uw_b100 4 0.00 99.99847 FORMAT "%8.5" AXIS_PTS_REF SMI04TEUW /end AXIS_DESCR
/end CHARACTERISTIC
/begin CHARACTERISTIC KFKORMTMOD "characteristic map for max. percentage of purge valve opening" MAP 0x805504A2 RB_Map_U8U16_U16 1.999969 fak_uw_b2 0.00 1.999969 FORMAT "%8.6"
 /begin AXIS_DESCR STD_AXIS mksbg_msg m_ub_b25p6 4 0.00 25.50 FORMAT "%5.2" DEPOSIT ABSOLUTE /end AXIS_DESCR
 /begin AXIS_DESCR STD_AXIS fkakormt_loc fak_uw_b2 8 0.00 1.999969 FORMAT "%8.6" DEPOSIT ABSOLUTE /end AXIS_DESCR
/end CHARACTERISTIC
/begin CHARACTERISTIC KFMOPTE "optimum torque for TEV" MAP 0x805506DE RB_Map_S16U16_U16 99.99847 rel_uw_b100 0.00 99.99847 FORMAT "%8.5"
 /begin AXIS_DESCR STD_AXIS ftead_w_msg fak_sw_b64 7 -64.00000 63.99805 FORMAT "%8.5" DEPOSIT ABSOLUTE /end AXIS_DESCR
 /begin AXIS_DESCR STD_AXIS EpmnEng_nmot nmot_uw_q0p25 7 0.00 16383.75 FORMAT "%8.2" DEPOSIT ABSOLUTE /end AXIS_DESCR
/end CHARACTERISTIC
/begin CHARACTERISTIC KFTEINI "Map to calculate the time for detecting a purge stop based on ambient air, engine or model temperature of the fuel and the fuel purge adaptation factor" MAP 0x80550080 RB_Map_S16U8_U16 6553.500 t_q0p1 0.00 6553.500 FORMAT "%8.3"
 /begin AXIS_DESCR STD_AXIS fteadf_msg fak_sb_b64 6 -64.00000 63.50000 FORMAT "%8.5" EXTENDED_LIMITS -16384.00 16383.50 DEPOSIT ABSOLUTE /end AXIS_DESCR
 /begin AXIS_DESCR STD_AXIS teini temp_ub_q0p75_o48 6 -48.0 143.3 FORMAT "%5.1" DEPOSIT ABSOLUTE /end AXIS_DESCR
/end CHARACTERISTIC
/begin CHARACTERISTIC KFTETPU "map temperature pressure fuel purge control" MAP 0x8054F72D RB_Map_U8U8_U8 1.992 fak_q0p0078 0.00 1.992 FORMAT "%5.3"
 /begin AXIS_DESCR STD_AXIS EnvTt_tumg temp_ub_q0p75_o48 4 -48.0 143.3 FORMAT "%5.1" DEPOSIT ABSOLUTE /end AXIS_DESCR
 /begin AXIS_DESCR STD_AXIS PEnv_pu p_ub_q5 4 0.00 1275. FORMAT "%5.0" DEPOSIT ABSOLUTE /end AXIS_DESCR
/end CHARACTERISTIC
/begin CHARACTERISTIC KFTQTEABF "Map for Canister Purge Valve shutoff time selection depending on the mass flow (mste_w) and the Carbon Canister load (ftead_w)" MAP 0x80550280 RB_Map_U16S16_U16 1.999969 fak_uw_b2 0.00 1.999969 FORMAT "%8.6"
 /begin AXIS_DESCR STD_AXIS mste_w_msg m_uw_b25p6 5 0.00 25.59961 FORMAT "%8.5" DEPOSIT ABSOLUTE /end AXIS_DESCR
 /begin AXIS_DESCR STD_AXIS ftead_w_msg fak_sw_b64 5 -64.00000 63.99805 FORMAT "%8.5" DEPOSIT ABSOLUTE /end AXIS_DESCR
/end CHARACTERISTIC
/begin CHARACTERISTIC KFWDKMSMXN "throttle angle at max. mass flow (depends on engine speed and engine temperature)" MAP 0x8054F3C6 RB_Map_S16S16_U16 99.99847 rel_uw_b100 0.00 99.99847 FORMAT "%8.5"
 /begin AXIS_DESCR STD_AXIS Epm_nEng EngN 5 -16384.00 16383.50 FORMAT "%8.2" DEPOSIT ABSOLUTE /end AXIS_DESCR
 /begin AXIS_DESCR STD_AXIS CEngDsT_t Temp_Cels 2 -3549.940 3003.560 FORMAT "%8.3" DEPOSIT ABSOLUTE /end AXIS_DESCR
/end CHARACTERISTIC
/begin CHARACTERISTIC KFWDKMSNVP "desired throttle angle" MAP 0x8054F3EC RB_Map_U16U16_U16 99.99847 rel_uw_b100 0.00 99.99847 FORMAT "%8.5"
 /begin AXIS_DESCR STD_AXIS msndkoos_w m_uw_b6553p5 18 0.00 6553.500 FORMAT "%8.3" DEPOSIT ABSOLUTE /end AXIS_DESCR
 /begin AXIS_DESCR STD_AXIS vpsrvdb_w_msg fak_q3p0518Em5 8 0.00 1.999969 FORMAT "%8.6" DEPOSIT ABSOLUTE /end AXIS_DESCR
/end CHARACTERISTIC
/begin CHARACTERISTIC KLDMSTES "Second curve to calculate dmstes_w depending on nmot_w." CURVE 0x805502CA RB_Curve_S16_U16_Static 26214.07 mgrad_q0p400001 0.00 26214.07 FORMAT "%8.2"
 /begin AXIS_DESCR STD_AXIS Epm_nEng EngN 5 -16384.00 16383.50 FORMAT "%8.2" DEPOSIT ABSOLUTE /end AXIS_DESCR
/end CHARACTERISTIC
/begin CHARACTERISTIC KLFDMSTES "Factor to calculate the input to Integrator for purge mass flow (dmstes_w)" CURVE 0x805502E0 RB_Curve_U16_S16_Static 3.999878 fak_sw_b4 0.00 3.999878 FORMAT "%8.6" EXTENDED_LIMITS -4.000000 3.999878
 /begin AXIS_DESCR STD_AXIS msteo_w_msg m_uw_b25p6 4 0.00 25.59961 FORMAT "%8.5" DEPOSIT ABSOLUTE /end AXIS_DESCR
/end CHARACTERISTIC
/begin CHARACTERISTIC KLFMDTE "Amplification factor for torque TEV" CURVE 0x80550760 RB_Curve_U16_U16 1.999969 fak_uw_b2 0.00 1.999969 FORMAT "%8.6"
 /begin AXIS_DESCR STD_AXIS PEnv_facCorrAlti fak_uw_b4 5 0.00 3.999939 FORMAT "%8.6" DEPOSIT ABSOLUTE /end AXIS_DESCR
/end CHARACTERISTIC
/begin CHARACTERISTIC KLFTEVFTEAD "Time constant for lowpass filtered canister purge valve (CPV) opening limitation dependent of fuel purge adaptation factor" CURVE 0x805500DE RB_Curve_S16_U16_Static 1310.680 t_q0p02 0.020 1310.700 FORMAT "%8.3" EXTENDED_LIMITS 0.00 1310.700
 /begin AXIS_DESCR STD_AXIS ftead_w_msg fak_sw_b64 4 -64.00000 63.99805 FORMAT "%8.5" DEPOSIT ABSOLUTE /end AXIS_DESCR
/end CHARACTERISTIC
/begin CHARACTERISTIC KLPRTMTEH "Curve delay of reset stopp inhibit in depedence on engine temperature" CURVE 0x80550776 RB_Curve_U8_U8 25.50 t_q0p1 0.00 25.50 FORMAT "%5.2"
 /begin AXIS_DESCR STD_AXIS CEngDsT_t_tmot temp_ub_q0p75_o48 4 -48.0 143.3 FORMAT "%5.1" DEPOSIT ABSOLUTE /end AXIS_DESCR
/end CHARACTERISTIC
/begin CHARACTERISTIC KLTEINIFHO "Characteristic line of time for detection of purge stop based on altitude correction factor (fho_w)" CURVE 0x805500F0 RB_Curve_U8_U16_Static 6553.500 t_q0p1 0.00 6553.500 FORMAT "%8.3"
 /begin AXIS_DESCR STD_AXIS PEnvfacCorrAlti_fho fak_ub_b4 5 0.00 3.984 FORMAT "%5.3" DEPOSIT ABSOLUTE /end AXIS_DESCR
/end CHARACTERISTIC
/begin CHARACTERISTIC KLTEMSZ "curve counter massflow fuel purge control" CURVE 0x8054F748 RB_Curve_U16_U8_Static 1.992 fak_q0p0078 0.00 1.992 FORMAT "%5.3"
 /begin AXIS_DESCR STD_AXIS coumsnte_w t_q0p1 5 0.00 6553.500 FORMAT "%8.3" DEPOSIT ABSOLUTE /end AXIS_DESCR
/end CHARACTERISTIC
/begin CHARACTERISTIC KMLTESG "Constant for purge mass in Canister purge line-manifold at normal pressure and temperature." VALUE 0x8054FD1E RB_Val_Wu16 1.066634 fak1_q1p63Em5 0.000016 1.066650 FORMAT "%8.6" EXTENDED_LIMITS 0.00 1.066650 /end CHARACTERISTIC
/begin CHARACTERISTIC KTEVANMK "characteristic line for purge valve opening speed" CURVE 0x8054F778 RB_CurveGroup_U8 0.0121593164 perio_ub_b0p012207 0.00 0.0121593164 FORMAT "%12.10"
 /begin AXIS_DESCR COM_AXIS mksbg_msg m_ub_b25p6 5 0.00 25.50 FORMAT "%5.2" AXIS_PTS_REF SMK05TEUB /end AXIS_DESCR
/end CHARACTERISTIC
/begin CHARACTERISTIC KWWINPOSOF "Shift of the observation window" VALUE 0x8054F24A RB_Val_Ws8 191.3 zw_sb_q0p75 -96.00 95.25 FORMAT "%5.2" /end CHARACTERISTIC
/begin CHARACTERISTIC LAMTEMN "minimum of lambda threshold for canister purge control active" VALUE 0x8054F706 RB_Val_Wu16 15.99976 fak_uw_b16 0.00 15.99976 FORMAT "%8.5" /end CHARACTERISTIC
/begin CHARACTERISTIC MIMNTEH "Request min torque for TEV (high load)" VALUE 0x80550780 RB_Val_Wu16 99.99847 rel_uw_b100 0.00 99.99847 FORMAT "%8.5" /end CHARACTERISTIC
/begin CHARACTERISTIC MIMXTEH "Request max torque for TEV (high load)" VALUE 0x80550782 RB_Val_Wu16 99.99847 rel_uw_b100 0.00 99.99847 FORMAT "%8.5" /end CHARACTERISTIC
/begin CHARACTERISTIC MSTEFTEAD "Threshold release calculation HC(HydroCarbon)-load fuel purge control" VALUE 0x805504F8 RB_Val_Wu16 25.59961 m_uw_b25p6 0.00 25.59961 FORMAT "%8.5" /end CHARACTERISTIC
/begin CHARACTERISTIC MSTEPTEK "Characteristic line purge mass flow depending from tank pressure" CURVE 0x805502F2 RB_Curve_S16_U16_Static 25.59961 m_uw_b25p6 0.00 25.59961 FORMAT "%8.5"
 /begin AXIS_DESCR STD_AXIS ptek_w_msg p_q0p00122 6 -40.00000 39.99878 FORMAT "%8.5" DEPOSIT ABSOLUTE /end AXIS_DESCR
/end CHARACTERISTIC
/begin CHARACTERISTIC NMDTEMNSPLD "Minumum threshold of RPM (revolution per minute) for 2nd discharge point" VALUE 0x80550784 RB_Val_Wu16 16383.75 nmot_q0p25 0.00 16383.75 FORMAT "%8.2" /end CHARACTERISTIC
/begin CHARACTERISTIC NMDTEMXSPLD "Maximum threshold of RPM (revolution per minute) for 2nd discharge point" VALUE 0x80550786 RB_Val_Wu16 16383.75 nmot_q0p25 0.00 16383.75 FORMAT "%8.2" /end CHARACTERISTIC
/begin CHARACTERISTIC NMOTCVWDK "max. rpm, when throttle position demand is because of tester" VALUE 0x8054F544 RB_Val_Wu8 10200. nmot_ub_q40 0.00 10200. FORMAT "%5.0" /end CHARACTERISTIC
/begin CHARACTERISTIC NMOTDTEMND "Minimum engine speed for priority DTEV" VALUE 0x80550788 RB_Val_Wu16 16383.75 nmot_q0p25 0.00 16383.75 FORMAT "%8.2" /end CHARACTERISTIC
/begin CHARACTERISTIC NMOTDTEMXD "Maximum engine speed for priority DTEV" VALUE 0x8055078A RB_Val_Wu16 16383.75 nmot_q0p25 0.00 16383.75 FORMAT "%8.2" /end CHARACTERISTIC
/begin CHARACTERISTIC NMOTGRDMN "Minimum revolution speed gradient in observation window for fast starter cut off" VALUE 0x8054F24C RB_Val_Ws16 400.0000 nmotg_q1_DIV_min_10ms -200.0000 200.0000 FORMAT "%8.4" EXTENDED_LIMITS -32768.00 32767.00 /end CHARACTERISTIC
/begin CHARACTERISTIC NMOTTEHMN "Minimum engine speed shift of operation point - fuel purge" VALUE 0x8055078C RB_Val_Wu16 16383.75 nmot_uw_q0p25 0.00 16383.75 FORMAT "%8.2" /end CHARACTERISTIC
/begin CHARACTERISTIC NMOTTEHMX "Maximum engine speed shift of operation point - fuel purge" VALUE 0x8055078E RB_Val_Wu16 16383.75 nmot_uw_q0p25 0.00 16383.75 FORMAT "%8.2" /end CHARACTERISTIC
/begin CHARACTERISTIC NMOTWINMN "Revolution speed threshold for fast starter cut off" VALUE 0x8054F24E RB_Val_Wu8 2550. nmot_q10 0.00 2550. FORMAT "%5.0" /end CHARACTERISTIC
/begin CHARACTERISTIC OFMSNWDKHF "leakage of throttle blade for calculation of wdkhf" VALUE 0x8054F546 RB_Val_Ws16 6553.500 m_q0p1 -3276.800 3276.700 FORMAT "%8.3" /end CHARACTERISTIC
/begin CHARACTERISTIC PRIOTEH "priority operation point demand from canister purge system" VALUE 0x80550790 RB_Val_Wu8 255.0 OneToOne 0.00 255.0 FORMAT "%5.1" /end CHARACTERISTIC
/begin CHARACTERISTIC PRIOTES "priority operation point demand from canister purge diagnose" VALUE 0x80550791 RB_Val_Wu8 255.0 OneToOne 0.00 255.0 FORMAT "%5.1" /end CHARACTERISTIC
/begin CHARACTERISTIC RIMSFHO "Reset integrated Mass flow depending on Altitude" VALUE 0x80550100 RB_Val_Wu8 3.984 fak_ub_b4 0.00 3.984 FORMAT "%5.3" /end CHARACTERISTIC
/begin CHARACTERISTIC RIMSFTEAD "Reset integrated Mass flow depending Canister load" VALUE 0x80550101 RB_Val_Ws8 127.5 fak_sb_b64 -64.00 63.50 FORMAT "%5.2" /end CHARACTERISTIC
/begin CHARACTERISTIC RLDTEMND "Minimum air charge for priority DTEV" VALUE 0x80550792 RB_Val_Wu16 1535.977 rel_q0p0234 0.00 1535.977 FORMAT "%8.3" /end CHARACTERISTIC
/begin CHARACTERISTIC RLDTEMNSPLD "Minumum threshold of load for 2nd discharge point" VALUE 0x80550794 RB_Val_Wu16 1535.977 rel_q0p0234 0.00 1535.977 FORMAT "%8.3" /end CHARACTERISTIC
/begin CHARACTERISTIC RLDTEMXD "Maximum air charge for priority DTEV" VALUE 0x80550796 RB_Val_Wu16 1535.977 rel_q0p0234 0.00 1535.977 FORMAT "%8.3" /end CHARACTERISTIC
/begin CHARACTERISTIC RLDTEMXSPLD "Maximum threshold of load for 2nd discharge point" VALUE 0x80550798 RB_Val_Wu16 1535.977 rel_q0p0234 0.00 1535.977 FORMAT "%8.3" /end CHARACTERISTIC
/begin CHARACTERISTIC RLTELLMN "min threshold of air charge to release the canister at the idle speed" VALUE 0x8055034E RB_Val_Wu16 1535.977 rel_q0p0234 0.00 1535.977 FORMAT "%8.3" /end CHARACTERISTIC
/begin AXIS_PTS SMI04TEUW "desired troque dependent basic point (number =4)" 0x80550102 misol_w_msg RB_Axis_U16 99.99847 rel_uw_b100 4 0.00 99.99847 FORMAT "%8.5" DEPOSIT ABSOLUTE /end AXIS_PTS
/begin AXIS_PTS SMI08TEUW "desired troque dependent basic point (number =8)" 0x8055010C misol_w_msg RB_Axis_U16 99.99847 rel_uw_b100 8 0.00 99.99847 FORMAT "%8.5" DEPOSIT ABSOLUTE /end AXIS_PTS
/begin AXIS_PTS SMK05TEUB "fuel dependent basic point (number =5)" 0x8054F77D mksbg_msg RB_Axis_U8 25.50 m_ub_b25p6 5 0.00 25.50 FORMAT "%5.2" DEPOSIT ABSOLUTE /end AXIS_PTS
/begin AXIS_PTS SNM04TEUB "engine speed dependent basic point (number =4)" 0x8055011E Epm_nEngLRes RB_Axis_U8 10200. EngN_LRes 4 0.00 10200. FORMAT "%5.0" DEPOSIT ABSOLUTE /end AXIS_PTS
/begin AXIS_PTS SQM05TEUB "air mass quotient dependent basic point (number =5)" 0x80550606 qmsdyn RB_Axis_U8 15.94 fak_ub_b16 5 0.00 15.94 FORMAT "%5.2" DEPOSIT ABSOLUTE /end AXIS_PTS
/begin CHARACTERISTIC TAVDKMNDK "min. temperature of offset-addition to DK-map (if nmot=0)" VALUE 0x8054F548 RB_Val_Wu16 1535.977 temp_q0p0234_o273 -273.150 1262.827 FORMAT "%8.3" /end CHARACTERISTIC
/begin CHARACTERISTIC TEDLKH "Time delay for activation of canister purge control after catalyst heating" VALUE 0x80550350 RB_Val_Wu16 6553.500 t_q0p1 0.00 6553.500 FORMAT "%8.3" /end CHARACTERISTIC
/begin CHARACTERISTIC TEFGAUSG "max. threshold of evaporation proportion of fuel for canister purge" VALUE 0x80550352 RB_Val_Wu8 1.992188 fak_ub_b2 0.00 1.992188 FORMAT "%8.6" /end CHARACTERISTIC
/begin CHARACTERISTIC TENSOSSDMN_L "threshold for engine stop time copied at the time of first engine start in the driving cycle" VALUE 0x8054F23C RB_Val_Ws32 17179869180.0 t_q4_s -8589934592.00 8589934588.00 FORMAT "%13.2" /end CHARACTERISTIC
/begin CHARACTERISTIC TFGWRTEFV "time for identification of mixture error suspicion due to lambda controller deviations" VALUE 0x8054F75A RB_Val_Wu8 25.50 t_q0p1 0.00 25.50 FORMAT "%5.2" /end CHARACTERISTIC
/begin CHARACTERISTIC TFKAKORFV "time for identification of mixture error suspicion" VALUE 0x8054F75C RB_Val_Wu16 25.00000 t_q0p1 5.00000 30.00000 FORMAT "%8.5" EXTENDED_LIMITS 0.00 6553.500 /end CHARACTERISTIC
/begin CHARACTERISTIC TFTEINI "Time for detection of purge stop" VALUE 0x80550124 RB_Val_Wu16 6553.500 t_q0p1 0.00 6553.500 FORMAT "%8.3" /end CHARACTERISTIC
/begin CHARACTERISTIC TFTEININL "Time for reset integrated mass flow at open loop purge control" VALUE 0x80550126 RB_Val_Wu8 25.50 t_q0p1 0.00 25.50 FORMAT "%5.2" /end CHARACTERISTIC
/begin CHARACTERISTIC TFWDKPSPV "filtering time of desired throttle angle" CURVE 0x8054F54A RB_Curve_U16_U16 655.3400 t_q0p01 0.0100 655.3500 FORMAT "%8.4" EXTENDED_LIMITS 0.00 655.3500
 /begin AXIS_DESCR STD_AXIS vpsrvdk_w_msg fak_uw_b2 4 0.00 1.999969 FORMAT "%8.6" DEPOSIT ABSOLUTE /end AXIS_DESCR
/end CHARACTERISTIC
/begin CHARACTERISTIC TMNFRAOSRQ "min. time of FRA-adaptation active for request of ORA stop inhibition" VALUE 0x8054F240 RB_Val_Wu16 13107.00 t_q0p2 0.00 13107.00 FORMAT "%8.2" /end CHARACTERISTIC
/begin CHARACTERISTIC TMSTOSSDMX "max. engine start temperature for one ORA-adaptation per DCY in Start-Stop-systems" VALUE 0x8054F242 RB_Val_Wu8 191.3 temp_ub_q0p75_o48 -48.0 143.3 FORMAT "%5.1" /end CHARACTERISTIC
/begin CHARACTERISTIC TMSTTE "Engine start temperature threshold at this the Canister Purge valve can be directly active" VALUE 0x80550353 RB_Val_Wu8 191.3 temp_ub_q0p75_o48 -48.0 143.3 FORMAT "%5.1" /end CHARACTERISTIC
/begin CHARACTERISTIC TMTE "engine-temperature threshold for canister purge" VALUE 0x80550354 RB_Val_Wu8 191.3 temp_ub_q0p75_o48 -48.0 143.3 FORMAT "%5.1" /end CHARACTERISTIC
/begin CHARACTERISTIC TOSSDCYMX "max. adaptation time for one ORA-adaptation per DCY in Start-Stop-systems" VALUE 0x8054F244 RB_Val_Wu16 13107.00 t_q0p2 0.00 13107.00 FORMAT "%8.2" /end CHARACTERISTIC
/begin CHARACTERISTIC TQTEAB "time for decrementation of the purge rate" VALUE 0x80550127 RB_Val_Wu8 81.60 t_q0p32000082 0.00 81.60 FORMAT "%5.2" /end CHARACTERISTIC
/begin CHARACTERISTIC TRFTEVFTEAD "Time constant for lowpass filtered canister purge valve (CPV) opening limitation" VALUE 0x80550128 RB_Val_Wu16 1310.680 t_q0p02 0.020 1310.700 FORMAT "%8.3" EXTENDED_LIMITS 0.00 1310.700 /end CHARACTERISTIC
/begin CHARACTERISTIC TSABTE_CUR "Delay time curve for deactivation of the canister purge with fuel cut off request" CURVE 0x80550356 RB_Curve_S16_U16_Static 1310.700 t_q0p02 0.00 1310.700 FORMAT "%8.3"
 /begin AXIS_DESCR STD_AXIS Epm_nEng EngN 4 -16384.00 16383.50 FORMAT "%8.2" DEPOSIT ABSOLUTE /end AXIS_DESCR
/end CHARACTERISTIC
/begin CHARACTERISTIC TTEATMTPA "Delay time purge control after upstream catalyst exceeds dew-point" VALUE 0x80550368 RB_Val_Wu16 6553.500 t_q0p1 0.00 6553.500 FORMAT "%8.3" /end CHARACTERISTIC
/begin CHARACTERISTIC TTEAUS "Delay time after engine start for activating the purge control valve" VALUE 0x8055036A RB_Val_Wu16 6553.500 t_q0p1 0.00 6553.500 FORMAT "%8.3" /end CHARACTERISTIC
/begin CHARACTERISTIC TTEAUSNW "Delay timer after engine restart for activating the purge control valve" VALUE 0x8055036C RB_Val_Wu8 25.50 t100msxs_ub_b25p5 0.00 25.50 FORMAT "%5.2" /end CHARACTERISTIC
/begin CHARACTERISTIC TTEGERTE "delay deactivation controlled purging" VALUE 0x8055036E RB_Val_Wu16 6553.500 t_q0p1 0.00 6553.500 FORMAT "%8.3" /end CHARACTERISTIC
/begin CHARACTERISTIC TVATEH "delay time to inhibit purge control, high canister load" VALUE 0x80550370 RB_Val_Wu8 25.50 t_q0p1 0.00 25.50 FORMAT "%5.2" /end CHARACTERISTIC
/begin CHARACTERISTIC TVATEHDTE "delay time to inhibit purge control homogeneous, high canister load" VALUE 0x80550371 RB_Val_Wu8 25.50 t_q0p1 0.00 25.50 FORMAT "%5.2" /end CHARACTERISTIC
/begin CHARACTERISTIC TVATEL "delay time to inhibit purge control, low canister load" VALUE 0x80550372 RB_Val_Wu8 25.50 t_q0p1 0.00 25.50 FORMAT "%5.2" /end CHARACTERISTIC
/begin CHARACTERISTIC TVATELDTE "delay time to inhibit purge control homogeneous, low canister load" VALUE 0x80550373 RB_Val_Wu8 25.50 t_q0p1 0.00 25.50 FORMAT "%5.2" /end CHARACTERISTIC
/begin CHARACTERISTIC TVEVLOCTE "delay time for injection restart after suppression" VALUE 0x80550374 RB_Val_Wu8 5.100 t_q0p02 0.00 5.100 FORMAT "%5.3" /end CHARACTERISTIC
/begin CHARACTERISTIC TVTEB "delay time for locking of Purge control after switch off of Injection" VALUE 0x80550375 RB_Val_Wu8 25.50 t_q0p1 0.00 25.50 FORMAT "%5.2" /end CHARACTERISTIC
/begin CHARACTERISTIC TVWDKVFZGMX "throshold of vehicle speed to adjust Throtthle valve actuation delay" VALUE 0x8054F588 RB_Val_Ws16 655.3500 Vel -327.6800 327.6700 FORMAT "%8.4" /end CHARACTERISTIC
/begin CHARACTERISTIC VFZGBBORA "vehicle speed threshold for requesting a stop-prohibition for ORA adaptation" VALUE 0x8054F246 RB_Val_Wu16 511.9922 vfzg_uw_b512 0.00 511.9922 FORMAT "%8.4" /end CHARACTERISTIC
/begin CHARACTERISTIC VPSRSVDRDU "pressure ratio at thottle blade for disable WOT if no request for WOT (hysterese)" VALUE 0x8054F55C RB_Val_Wu16 0.05001831 fak_uw_b1 0.8999939 0.9500122 FORMAT "%9.7" EXTENDED_LIMITS 0.00 0.9999847 /end CHARACTERISTIC
/begin CHARACTERISTIC WDKSAPP "throttle angle for calibration tasks" VALUE 0x8054F55E RB_Val_Wu16 99.99847 rel_uw_b100 0.00 99.99847 FORMAT "%8.5" /end CHARACTERISTIC
/begin CHARACTERISTIC WDKSOFS "Offset added to appl. value of desired throttle position at low temperature" VALUE 0x8054F560 RB_Val_Wu16 99.99847 rel_uw_b100 0.00 99.99847 FORMAT "%8.5" /end CHARACTERISTIC
/begin CHARACTERISTIC WDKSWE "Throttle-valve nominal-value threshold for predicted de-jittering" VALUE 0x8054F58A RB_Val_Wu16 99.99847 rel_uw_b100 0.00 99.99847 FORMAT "%8.5" /end CHARACTERISTIC
/begin CHARACTERISTIC WINWIDTH "Width of revolution speed observation window in [°CrS]" VALUE 0x8054F250 RB_Val_Wu16 6553.500 kw_q0p1 0.00 6553.500 FORMAT "%8.3" /end CHARACTERISTIC
/begin CHARACTERISTIC ZKFTEAD "Time constant for lowpass filtered fuel purge adaptation factor during fuel purging" VALUE 0x805504FA RB_Val_Wu16 6553.4999985 zk100msxs_uw_b6553p6 0.1000015 6553.6000000 FORMAT "%12.7" EXTENDED_LIMITS 0.10000152590 6553.6000000 /end CHARACTERISTIC
/begin CHARACTERISTIC ZKFTEADVA "filter time constant fuel purge adaptation: purge control active" VALUE 0x8054F75E RB_Val_Wu8 25.4996 zk100msxs_ub_b25p6 0.1004 25.6000 FORMAT "%7.4" EXTENDED_LIMITS 0.100392 25.6000 /end CHARACTERISTIC
/begin CHARACTERISTIC ZKFTEADVNA "filter time constant fuel purge adaptation: purge control not active" VALUE 0x8054F75F RB_Val_Wu8 25.4996 zk100msxs_ub_b25p6 0.1004 25.6000 FORMAT "%7.4" EXTENDED_LIMITS 0.100392 25.6000 /end CHARACTERISTIC
/begin MEASUREMENT abscissa "Index array, that holds abscissa values for linear regression procedure" UBYTE dez 1 100 0.00 255.0 FORMAT "%5.1" ARRAY_SIZE 6 ECU_ADDRESS 0x6000B89E /end MEASUREMENT
/begin MEASUREMENT bslope_w "Slope of rotatinal speed curve in the observation window" SWORD nmotg_q1_DIV_min_10ms 1 100 -32768.00 32767.00 FORMAT "%8.2" ECU_ADDRESS 0x600075F0 /end MEASUREMENT
/begin MEASUREMENT B_avateh_msg "current active state of function Purge control, high canister load" UBYTE B_TRUE 1 100 0.00 1.00000000000 BIT_MASK 0x1 FORMAT "%13.11" ECU_ADDRESS 0x6000F701 /end MEASUREMENT
/begin MEASUREMENT B_avatel_msg "current active state of function Purge control, low canister load" UBYTE B_TRUE 1 100 0.00 1.00000000000 BIT_MASK 0x1 FORMAT "%13.11" ECU_ADDRESS 0x6000F700 /end MEASUREMENT
/begin MEASUREMENT B_avaten_msg "current active state of function emergency canister purge" UBYTE B_TRUE 1 100 0.00 1.00000000000 BIT_MASK 0x1 FORMAT "%13.11" ECU_ADDRESS 0x6000F6FF /end MEASUREMENT
/begin MEASUREMENT B_dkstrl_msg "Condition: throttle blade controls charge" UBYTE B_TRUE 1 100 0.00 1.00000000000 BIT_MASK 0x1 FORMAT "%13.11" ECU_ADDRESS 0x60001504 /end MEASUREMENT
/begin MEASUREMENT B_dwdksugd "difference of desired throttle angle refered at 95% to 100% charge active" UBYTE B_TRUE 1 100 0.00 1.00000000000 BIT_MASK 0x1 FORMAT "%13.11" ECU_ADDRESS 0x60000F4D /end MEASUREMENT
/begin MEASUREMENT B_dwdkugdf "Condition: enable WOT area" UBYTE B_TRUE 1 100 0.00 1.00000000000 BIT_MASK 0x1 FORMAT "%13.11" ECU_ADDRESS 0x60000F4C /end MEASUREMENT
/begin MEASUREMENT B_fastcoff_msg "Demand fast starter cut off during succession start" UBYTE B_TRUE 1 100 0.00 1.00000000000 BIT_MASK 0x1 FORMAT "%13.11" ECU_ADDRESS 0x70000BCB /end MEASUREMENT
/begin MEASUREMENT B_fgdkabgs_msg "Condition: enable throtttle adaption from desired calculation" UBYTE B_TRUE 1 100 0.00 1.00000000000 BIT_MASK 0x1 FORMAT "%13.11" ECU_ADDRESS 0x600014F9 /end MEASUREMENT
/begin MEASUREMENT B_framil "mil state for fra" UBYTE B_TRUE 1 100 0.00 1.00000000000 BIT_MASK 0x1 FORMAT "%13.11" ECU_ADDRESS 0x70000BC0 /end MEASUREMENT
/begin MEASUREMENT B_frteatmtpa_msg "enable condition dewpoint exceeded or tmst greater threshold" UBYTE B_TRUE 1 100 0.00 1.00000000000 BIT_MASK 0x1 FORMAT "%13.11" ECU_ADDRESS 0x6000F6EA /end MEASUREMENT
/begin MEASUREMENT B_fteadber_msg "Condition HC load may be adapted" UBYTE B_TRUE 1 100 0.00 1.00000000000 BIT_MASK 0x1 FORMAT "%13.11" ECU_ADDRESS 0x6000F6E9 /end MEASUREMENT
/begin MEASUREMENT B_fteadh_msg "Condition high canister load" UBYTE B_TRUE 1 100 0.00 1.00000000000 BIT_MASK 0x1 FORMAT "%13.11" ECU_ADDRESS 0x6000F6E8 /end MEASUREMENT
/begin MEASUREMENT B_fvfgwrte "mixture error suspicion from purge rate reduction during fr-controller deviations" UBYTE B_TRUE 1 100 0.00 1.00000000000 BIT_MASK 0x1 FORMAT "%13.11" ECU_ADDRESS 0x6000B899 /end MEASUREMENT
/begin MEASUREMENT B_fvfkakormt "mixture error suspicion from lambdafactor deviations" UBYTE B_TRUE 1 100 0.00 1.00000000000 BIT_MASK 0x1 FORMAT "%13.11" ECU_ADDRESS 0x6000B898 /end MEASUREMENT
/begin MEASUREMENT B_fvftead "mixture error suspicion from ACF-load" UBYTE B_TRUE 1 100 0.00 1.00000000000 BIT_MASK 0x1 FORMAT "%13.11" ECU_ADDRESS 0x6000B897 /end MEASUREMENT
/begin MEASUREMENT B_fvgte_msg "mixture error suspicion from canister purge" UBYTE B_TRUE 1 100 0.00 1.00000000000 BIT_MASK 0x1 FORMAT "%13.11" ECU_ADDRESS 0x6000F6E7 /end MEASUREMENT
/begin MEASUREMENT B_genstopora "general stop inhibit" UBYTE B_TRUE 1 100 0.00 1.00000000000 BIT_MASK 0x1 FORMAT "%13.11" ECU_ADDRESS 0x7000025E /end MEASUREMENT
/begin MEASUREMENT B_gerte_msg "Condition for closed loop control" UBYTE B_TRUE 1 100 0.00 1.00000000000 BIT_MASK 0x1 FORMAT "%13.11" ECU_ADDRESS 0x6000F6E6 /end MEASUREMENT
/begin MEASUREMENT B_inwin "Observation window is still open" UBYTE B_TRUE 1 100 0.00 1.00000000000 BIT_MASK 0x1 FORMAT "%13.11" ECU_ADDRESS 0x70000255 /end MEASUREMENT
/begin MEASUREMENT B_lamrb_msg "Set value of lambda within allowed thresholds for canister purge" UBYTE B_TRUE 1 100 0.00 1.00000000000 BIT_MASK 0x1 FORMAT "%13.11" ECU_ADDRESS 0x6000F6E3 /end MEASUREMENT
/begin MEASUREMENT B_lltans "low intake air temperature in Idle speed" UBYTE B_TRUE 1 100 0.00 1.00000000000 BIT_MASK 0x1 FORMAT "%13.11" ECU_ADDRESS 0x6000B87B /end MEASUREMENT
/begin MEASUREMENT B_lrar_msg "condition for reducted correction ranges at LRA" UBYTE B_TRUE 1 100 0.00 1.00000000000 BIT_MASK 0x1 FORMAT "%13.11" ECU_ADDRESS 0x6000F6E0 /end MEASUREMENT
/begin MEASUREMENT B_lteab_msg "Condition slow decrementation of purge rate" UBYTE B_TRUE 1 100 0.00 1.00000000000 BIT_MASK 0x1 FORMAT "%13.11" ECU_ADDRESS 0x6000F6DF /end MEASUREMENT
/begin MEASUREMENT B_msdksg_msg "Condition:desired mass flow is valid" UBYTE B_TRUE 1 100 0.00 1.00000000000 BIT_MASK 0x1 FORMAT "%13.11" ECU_ADDRESS 0x600014EF /end MEASUREMENT
/begin MEASUREMENT B_mstefg_msg "condition enabling of the mass flow over the canister purge valve" UBYTE B_TRUE 1 100 0.00 1.00000000000 BIT_MASK 0x1 FORMAT "%13.11" ECU_ADDRESS 0x6000FA88 /end MEASUREMENT
/begin MEASUREMENT B_mwte_msg "GDI mode change purge control (hand shake)" UBYTE B_TRUE 1 100 0.00 1.00000000000 BIT_MASK 0x1 FORMAT "%13.11" ECU_ADDRESS 0x6000FA82 /end MEASUREMENT
/begin MEASUREMENT B_oramil "MIL on because of ORA error" UBYTE B_TRUE 1 100 0.00 1.00000000000 BIT_MASK 0x1 FORMAT "%13.11" ECU_ADDRESS 0x70000B4D /end MEASUREMENT
/begin MEASUREMENT B_orassdcy "one ORA-adaptation per DCY in Start-Stop-systems requested" UBYTE B_TRUE 1 100 0.00 1.00000000000 BIT_MASK 0x1 FORMAT "%13.11" ECU_ADDRESS 0x7000025D /end MEASUREMENT
/begin MEASUREMENT B_orasspr "ORA-prio to request stop prohition enabled" UBYTE B_TRUE 1 100 0.00 1.00000000000 BIT_MASK 0x1 FORMAT "%13.11" ECU_ADDRESS 0x7000025C /end MEASUREMENT
/begin MEASUREMENT B_otdiag "local variable ftiv or piv diagnosis activ" UBYTE B_TRUE 1 100 0.00 1.00000000000 BIT_MASK 0x1 FORMAT "%13.11" ECU_ADDRESS 0x6000B88C /end MEASUREMENT
/begin MEASUREMENT B_pbboerw_msg "Stop inhibit for ORA adaptation expected (for display only)" UBYTE B_TRUE 1 100 0.00 1.00000000000 BIT_MASK 0x1 FORMAT "%13.11" ECU_ADDRESS 0x70000B47 /end MEASUREMENT
/begin MEASUREMENT b_pyatenloc "local variable to check the status of purge for exclusions of FID" UBYTE B_TRUE 1 100 0.00 1.00000000000 BIT_MASK 0x1 FORMAT "%13.11" ECU_ADDRESS 0x6000B87A /end MEASUREMENT
/begin MEASUREMENT B_rbte_msg "Condition cloesd loop control readiness for canister purge" UBYTE B_TRUE 1 100 0.00 1.00000000000 BIT_MASK 0x1 FORMAT "%13.11" ECU_ADDRESS 0x6000F6DC /end MEASUREMENT
/begin MEASUREMENT B_resimftiv "request to close Canister Purge valve, reset imsteini" UBYTE B_TRUE 1 100 0.00 1.00000000000 BIT_MASK 0x1 FORMAT "%13.11" ECU_ADDRESS 0x6000B88A /end MEASUREMENT
/begin MEASUREMENT B_resims_msg "condition reset integrated massflow" UBYTE B_TRUE 1 100 0.00 1.00000000000 BIT_MASK 0x1 FORMAT "%13.11" ECU_ADDRESS 0x6000F6DB /end MEASUREMENT
/begin MEASUREMENT B_rkteb_msg "fuel portion of canister purge at its limit" UBYTE B_TRUE 1 100 0.00 1.00000000000 BIT_MASK 0x1 FORMAT "%13.11" ECU_ADDRESS 0x6000FA76 /end MEASUREMENT
/begin MEASUREMENT B_stHEVVal_FPC2CE "Status of SY_HEV" UBYTE B_TRUE 1 100 0.00 1.00000000000 BIT_MASK 0x1 FORMAT "%13.11" ECU_ADDRESS 0x6000B864 /end MEASUREMENT
/begin MEASUREMENT B_teakt_msg "condition purge control active (open loop or closed loop)" UBYTE B_TRUE 1 100 0.00 1.00000000000 BIT_MASK 0x1 FORMAT "%13.11" ECU_ADDRESS 0x6000F6D5 /end MEASUREMENT
/begin MEASUREMENT B_teffv "Enable condition flex fuel vehicle" UBYTE B_TRUE 1 100 0.00 1.00000000000 BIT_MASK 0x1 FORMAT "%13.11" ECU_ADDRESS 0x6000B879 /end MEASUREMENT
/begin MEASUREMENT B_tef_msg "Condition canister purge function basically released" UBYTE B_TRUE 1 100 0.00 1.00000000000 BIT_MASK 0x1 FORMAT "%13.11" ECU_ADDRESS 0x6000F6D4 /end MEASUREMENT
/begin MEASUREMENT B_tei_msg "Internal condition: canister purge function active" UBYTE B_TRUE 1 100 0.00 1.00000000000 BIT_MASK 0x1 FORMAT "%13.11" ECU_ADDRESS 0x6000F6D3 /end MEASUREMENT
/begin MEASUREMENT B_telrlei "Condition no fuel purge due to limit of low rl in engine idle" UBYTE B_TRUE 1 100 0.00 1.00000000000 BIT_MASK 0x1 FORMAT "%13.11" ECU_ADDRESS 0x6000B878 /end MEASUREMENT
/begin MEASUREMENT B_ten_msg "condition open loop purging" UBYTE B_TRUE 1 100 0.00 1.00000000000 BIT_MASK 0x1 FORMAT "%13.11" ECU_ADDRESS 0x6000FA61 /end MEASUREMENT
/begin MEASUREMENT B_te_msg "Condition canister purge active" UBYTE B_TRUE 1 100 0.00 1.00000000000 BIT_MASK 0x1 FORMAT "%13.11" ECU_ADDRESS 0x6000F6D6 /end MEASUREMENT
/begin MEASUREMENT B_tvateh "condition delay time expired to inhibit purge control, high canister load" UBYTE B_TRUE 1 100 0.00 1.00000000000 BIT_MASK 0x1 FORMAT "%13.11" ECU_ADDRESS 0x6000B877 /end MEASUREMENT
/begin MEASUREMENT B_tvatel "condition delay time expired to inhibit purge control, low canister load" UBYTE B_TRUE 1 100 0.00 1.00000000000 BIT_MASK 0x1 FORMAT "%13.11" ECU_ADDRESS 0x6000B876 /end MEASUREMENT
/begin MEASUREMENT B_wdkap_msg "Condition: desired throttle position from appl. characteristic line or at start" UBYTE B_TRUE 1 100 0.00 1.00000000000 BIT_MASK 0x1 FORMAT "%13.11" ECU_ADDRESS 0x600014E2 /end MEASUREMENT
/begin MEASUREMENT B_wdkhfg_msg "Condition throttle angle calculated from main charging sensor (wdkhf_w) is valid" UBYTE B_TRUE 1 100 0.00 1.00000000000 BIT_MASK 0x1 FORMAT "%13.11" ECU_ADDRESS 0x600014E1 /end MEASUREMENT
/begin MEASUREMENT B_wdkhfu_msg "cond: wide opened throttle angle calculated from main charging sensor" UBYTE B_TRUE 1 100 0.00 1.00000000000 BIT_MASK 0x1 FORMAT "%13.11" ECU_ADDRESS 0x600014E0 /end MEASUREMENT
/begin MEASUREMENT B_wdksugd_msg "Condition: WOT area active" UBYTE B_TRUE 1 100 0.00 1.00000000000 BIT_MASK 0x1 FORMAT "%13.11" ECU_ADDRESS 0x600014DF /end MEASUREMENT
/begin MEASUREMENT B_wdkuehsp_msg "Condition: it is possible to activate WOT operation in HSP mode" UBYTE B_TRUE 1 100 0.00 1.00000000000 BIT_MASK 0x1 FORMAT "%13.11" ECU_ADDRESS 0x600014DE /end MEASUREMENT
/begin MEASUREMENT B_winleft "Observation window was left or closed, respectively" UBYTE B_TRUE 1 100 0.00 1.00000000000 BIT_MASK 0x1 FORMAT "%13.11" ECU_ADDRESS 0x70000254 /end MEASUREMENT
/begin MEASUREMENT CEngDsT_t_tmot "Temporary variable before KLPRTMTEH" UBYTE temp_ub_q0p75_o48 1 100 -48.0 143.3 FORMAT "%5.1" ECU_ADDRESS 0x6000B863 /end MEASUREMENT
/begin MEASUREMENT ChrCtl_agCamsftLimnHfmPlst "Camshaft angle as input for calculating limiting throttle angle to avoid HFM pulsation." SWORD kw_q0p0156 1 100 -512.0000 511.9844 FORMAT "%8.4" ECU_ADDRESS 0x60000F4A /end MEASUREMENT
/begin MEASUREMENT ChrCtl_agDeltaTqToStrt "Delta throttle angle between desired throttle angle and its filtered value" SWORD rel_sw_b100 1 100 -100.0000 99.9969 FORMAT "%8.4" ECU_ADDRESS 0x700050A8 /end MEASUREMENT
/begin MEASUREMENT ChrCtl_facEthnlCntnt "ethanol content factor" UWORD fak_uw_b2 1 100 0.00 1.999969 FORMAT "%8.6" ECU_ADDRESS 0x60000F48 /end MEASUREMENT
/begin MEASUREMENT ChrCtl_nEngHfmPlst "Engine speed for the calculation of throttle angle limitation to avoid HFM pulsation" SWORD EngN 1 100 -16384.00 16383.50 FORMAT "%8.2" ECU_ADDRESS 0x60000F46 /end MEASUREMENT
/begin MEASUREMENT ChrCtl_ratThrAgLimnToAvdHfmPlst "Throttle angle limitation to avoid HFM pulsations" UWORD rel_uw_b100 1 100 0.00 99.99847 FORMAT "%8.5" ECU_ADDRESS 0x60000F44 /end MEASUREMENT
/begin MEASUREMENT ChrCtl_ratThrVlvWoMdnFilLimd "Throttle valve angle without median filter limited" UWORD rel_uw_b100 1 100 0.00 99.99847 FORMAT "%8.5" ECU_ADDRESS 0x60000F42 /end MEASUREMENT
/begin MEASUREMENT Com_bTSCIntvFast "TM torque down request by ignition" UBYTE OneToOne 1 100 0.00 255.0 FORMAT "%5.1" ECU_ADDRESS 0x6000FF2D /end MEASUREMENT
/begin MEASUREMENT Com_ctReIni10msEAT12 "ReInit Counter for EAT12 frame" UBYTE OneToOne 1 100 0.00 255.0 FORMAT "%5.1" ECU_ADDRESS 0x6000B85F /end MEASUREMENT
/begin MEASUREMENT Com_ctReIni10msEAT13 "ReInit Counter for EAT13 frame" UBYTE OneToOne 1 100 0.00 255.0 FORMAT "%5.1" ECU_ADDRESS 0x6000B85E /end MEASUREMENT
/begin MEASUREMENT Com_rConvBoost "Torque Converter Boost Ratio" UWORD Com_Fact_b0p00006 1 100 0.00 3.999939 FORMAT "%8.6" ECU_ADDRESS 0x60009558 /end MEASUREMENT
/begin MEASUREMENT Com_rTarPlly "Target pulley ratio" SWORD TransR_COMPU 1 100 -512.0000 511.9844 FORMAT "%8.4" ECU_ADDRESS 0x60009ACC /end MEASUREMENT
/begin MEASUREMENT Com_stComEAT4 "EAT4 Preliminary error timer value" UBYTE OneToOne 1 100 0.00 255.0 FORMAT "%5.1" ECU_ADDRESS 0x6000FE49 /end MEASUREMENT
/begin MEASUREMENT Com_stConvSlip "status torque converter slip" UBYTE OneToOne 1 100 0.00 255.0 FORMAT "%5.1" ECU_ADDRESS 0x6000FE47 /end MEASUREMENT
/begin MEASUREMENT Com_stEAT10Mon "Status for EAT10 error monitoring" UBYTE OneToOne 1 100 0.00 255.0 FORMAT "%5.1" ECU_ADDRESS 0x6000FE3F /end MEASUREMENT
/begin MEASUREMENT Com_stEAT12RingCntChkSumErr "Ring counter and Checksum Error for EAt12 frame" UBYTE OneToOne 1 100 0.00 255.0 FORMAT "%5.1" ECU_ADDRESS 0x6000FE3E /end MEASUREMENT
/begin MEASUREMENT Com_stEAT12TOutBusOffErr "Bus off and Timeout Check with respect to EAT12 frame" UBYTE OneToOne 1 100 0.00 255.0 FORMAT "%5.1" ECU_ADDRESS 0x6000FE3D /end MEASUREMENT
/begin MEASUREMENT Com_stEAT13RingCntChkSumErr "Ring conter and checksum error for EAt13 frame." UBYTE OneToOne 1 100 0.00 255.0 FORMAT "%5.1" ECU_ADDRESS 0x6000F81C /end MEASUREMENT
/begin MEASUREMENT Com_stEAT13TOutBusOffErr "Bus off and Timeout Check with respect to EAT13 frame" UBYTE OneToOne 1 100 0.00 255.0 FORMAT "%5.1" ECU_ADDRESS 0x6000F81B /end MEASUREMENT
/begin MEASUREMENT Com_stEAT1Mon "Status for EAT1 error monitoring" UBYTE OneToOne 1 100 0.00 255.0 FORMAT "%5.1" ECU_ADDRESS 0x6000FE3C /end MEASUREMENT
/begin MEASUREMENT Com_stEAT2Mon "Status for EAT2 error monitoring" UBYTE OneToOne 1 100 0.00 255.0 FORMAT "%5.1" ECU_ADDRESS 0x6000FE3B /end MEASUREMENT
/begin MEASUREMENT Com_stEAT4Mon "Status for EAT4 error monitoring" UBYTE OneToOne 1 100 0.00 255.0 FORMAT "%5.1" ECU_ADDRESS 0x6000FE39 /end MEASUREMENT
/begin MEASUREMENT Com_stEAT6Mon "Status for EAT6 error monitoring" UBYTE OneToOne 1 100 0.00 255.0 FORMAT "%5.1" ECU_ADDRESS 0x6000FE38 /end MEASUREMENT
/begin MEASUREMENT Com_stRxEAT12ChkSumOk "EAT12 Checksum OK status" UBYTE B_TRUE 1 100 0.00 1.00000000000 BIT_MASK 0x1 FORMAT "%13.11" ECU_ADDRESS 0x6000F9AC /end MEASUREMENT
/begin MEASUREMENT Com_stRxEAT12Deb "EAT12 Timeout Status" UBYTE B_TRUE 1 100 0.00 1.00000000000 BIT_MASK 0x1 FORMAT "%13.11" ECU_ADDRESS 0x6000F9AB /end MEASUREMENT
/begin MEASUREMENT Com_stRxEAT12RingCntOk "EAT12 Ring counter status" UBYTE B_TRUE 1 100 0.00 1.00000000000 BIT_MASK 0x1 FORMAT "%13.11" ECU_ADDRESS 0x6000F9AA /end MEASUREMENT
/begin MEASUREMENT Com_stRxEAT13ChkSumOk "EAT13 Checksum status" UBYTE B_TRUE 1 100 0.00 1.00000000000 BIT_MASK 0x1 FORMAT "%13.11" ECU_ADDRESS 0x6000F6C1 /end MEASUREMENT
/begin MEASUREMENT Com_stRxEAT13Deb "EAT13 Timeout status" UBYTE B_TRUE 1 100 0.00 1.00000000000 BIT_MASK 0x1 FORMAT "%13.11" ECU_ADDRESS 0x6000F6C0 /end MEASUREMENT
/begin MEASUREMENT Com_stRxEAT13RingCntOk "EAT13 Ring counter Status" UBYTE B_TRUE 1 100 0.00 1.00000000000 BIT_MASK 0x1 FORMAT "%13.11" ECU_ADDRESS 0x6000F6BF /end MEASUREMENT
/begin MEASUREMENT Com_tiEAT4PreErr_MP "measurement point" SWORD Time_ms 1 100 -327680.0 327670.0 FORMAT "%8.1" ECU_ADDRESS 0x7000A276 /end MEASUREMENT
/begin MEASUREMENT coumsnte_w "time-counter fuel purge control inactive" UWORD t_q0p1 1 100 0.00 6553.500 FORMAT "%8.3" ECU_ADDRESS 0x600075E0 /end MEASUREMENT
/begin MEASUREMENT CstrPurg_dstNrmBnk1LoLoad "normalised distance of further transport from purge flow in low load purge line" UWORD fak_uw_b2 1 100 0.00 1.999969 FORMAT "%8.6" ECU_ADDRESS 0x60007562 /end MEASUREMENT
/begin MEASUREMENT CstrPurg_facCorrnT "correction factor for temperature CPV" UWORD fak_uw_b2 1 100 0.00 1.999969 FORMAT "%8.6" ECU_ADDRESS 0x600075DA /end MEASUREMENT
/begin MEASUREMENT CstrPurg_facCorrnTCpvMod "correction factor for temperature CPV from temperature model" UWORD fak_uw_b2 1 100 0.00 1.999969 FORMAT "%8.6" ECU_ADDRESS 0x600075D8 /end MEASUREMENT
/begin MEASUREMENT CstrPurg_facEthGsl "actual ethanol content in gasoline for stoichiometric correction" UWORD fak_uw_b2 1 100 0.00 1.999969 FORMAT "%8.6" ECU_ADDRESS 0x600075DC /end MEASUREMENT
/begin MEASUREMENT CstrPurg_facFlowCpvLoLoad "Factor flow through PCV (for low load)" UWORD fak_uw_b2 1 100 0.00 1.999969 FORMAT "%8.6" ECU_ADDRESS 0x600075D6 /end MEASUREMENT
/begin MEASUREMENT CstrPurg_facFlowCpvLoLoadCda "Factor flow through Canister Purge valve for high load during Half Engine mode (HEM) or small cam" UWORD fak_uw_b2 1 100 0.00 1.999969 FORMAT "%8.6" ECU_ADDRESS 0x600075D4 /end MEASUREMENT
/begin MEASUREMENT CstrPurg_facFlowCpvTAltiLoLoad "factor flow through CPV corrected by altitude and temperature for low load" UWORD fak_uw_b2 1 100 0.00 1.999969 FORMAT "%8.6" ECU_ADDRESS 0x600075D2 /end MEASUREMENT
/begin MEASUREMENT CstrPurg_facFlowDutyCycCpv "correction factor flow through CPV" UWORD fak_uw_b2 1 100 0.00 1.999969 FORMAT "%8.6" ECU_ADDRESS 0x600075D0 /end MEASUREMENT
/begin MEASUREMENT CstrPurg_facLamDeMin "Minimum value of lambda deviation" SWORD fak_sw_b1 1 100 -1.000000 0.999969 FORMAT "%8.6" ECU_ADDRESS 0x6000756E /end MEASUREMENT
/begin MEASUREMENT CstrPurg_facLamRecprBnk1LoLoadIntkVlv "reciprocal time-delayed Lambda due to purge gas in low load purge line" SWORD fak_q0p000488 1 100 -16.00000 15.99951 FORMAT "%8.5" ECU_ADDRESS 0x60007560 /end MEASUREMENT
/begin MEASUREMENT CstrPurg_facLamRecprDlyBnk1LoLoad "reciprocal time-delayed Lambda due to purge gas in low load purge line" SWORD fak_q0p000488 1 100 -16.00000 15.99951 FORMAT "%8.5" ECU_ADDRESS 0x6000755E /end MEASUREMENT
/begin MEASUREMENT CstrPurg_facLoad "unfiltered factor canister purge valve temperature effect on account of the vehicle speed and the weighteded filtered load" SWORD fak_sw_b1 1 100 -1.000000 0.999969 FORMAT "%8.6" ECU_ADDRESS 0x600075CE /end MEASUREMENT
/begin MEASUREMENT CstrPurg_facLoadFilt "filtered factor canister purge valve temperature effect on account of the vehicle speed and the weighteded filtered load" SWORD fak_sw_b1 1 100 -1.000000 0.999969 FORMAT "%8.6" ECU_ADDRESS 0x600075CC /end MEASUREMENT
/begin MEASUREMENT CstrPurg_facMfCpvDtesk "factor flow through CPV for DTESK with closed CCV" UWORD fak_uw_b2 1 100 0.00 1.999969 FORMAT "%8.6" ECU_ADDRESS 0x600075CA /end MEASUREMENT
/begin MEASUREMENT CstrPurg_facSpcPurgFuAmntLimd "Limit of maximum value of specific purge fuel amount" UWORD fak_uw_b0p5 1 100 0.00 0.4999924 FORMAT "%9.7" ECU_ADDRESS 0x60007596 /end MEASUREMENT
/begin MEASUREMENT CstrPurg_facSpcPurgFuAmntMax "maximum value of specific purge fuel amount" UBYTE fak_ub_b0p5 1 100 0.00 0.4980 ECU_ADDRESS 0x6000B889 /end MEASUREMENT
/begin MEASUREMENT CstrPurg_facWghtLoadCoeff "Weighting factor for the relative air charge from the identity line load coefficient" UWORD fak_uw_b4 1 100 0.00 3.999939 FORMAT "%8.6" ECU_ADDRESS 0x600075C8 /end MEASUREMENT
/begin MEASUREMENT CstrPurg_fakMFlowAcfLd "Unfiltered value of the factor containing the fuel part of the massflow from ACF in order to take into considerantion the cooling effect in CPV" UWORD fak_uw_b1 1 100 0.00 0.9999847 FORMAT "%9.7" ECU_ADDRESS 0x600075C6 /end MEASUREMENT
/begin MEASUREMENT CstrPurg_fakMFlowAcfLdFilt "Filtered value of the factor containing the fuel part of the massflow from ACF in order to take into considerantion the cooling effect in CPV" UWORD fak_uw_b1 1 100 0.00 0.9999847 FORMAT "%9.7" ECU_ADDRESS 0x600075C4 /end MEASUREMENT
/begin MEASUREMENT CstrPurg_fakRadrCoolg "Unfiltered factor, CPV cooling effect due to vehicle speed and radiator shutter position" SWORD fak_sw_b1 1 100 -1.000000 0.999969 FORMAT "%8.6" ECU_ADDRESS 0x600075C2 /end MEASUREMENT
/begin MEASUREMENT CstrPurg_fakRadrCoolgFilt "Filtered factor, CPV cooling effect due to vehicle speed and radiator shutter position" SWORD fak_sw_b1 1 100 -1.000000 0.999969 FORMAT "%8.6" ECU_ADDRESS 0x600075C0 /end MEASUREMENT
/begin MEASUREMENT CstrPurg_flgAbrt "Condition: Canister purge is not allowed" UBYTE B_TRUE 1 100 0.00 1.00000000000 BIT_MASK 0x1 FORMAT "%13.11" ECU_ADDRESS 0x6000B875 /end MEASUREMENT
/begin MEASUREMENT CstrPurg_flgAbrtCdnCatHeatg "Abort Condition for catalyst heating" UBYTE B_TRUE 1 100 0.00 1.00000000000 BIT_MASK 0x1 FORMAT "%13.11" ECU_ADDRESS 0x6000B874 /end MEASUREMENT
/begin MEASUREMENT CstrPurg_flgBigLamDev "Big Lambda deviation inhibit Canister purging enable flag" UBYTE B_TRUE 1 100 0.00 1.00000000000 BIT_MASK 0x1 FORMAT "%13.11" ECU_ADDRESS 0x6000B873 /end MEASUREMENT
/begin MEASUREMENT CstrPurg_flgCdnFuCutOffDly "Condition for release of canister purge valve control due to fuel cut off" UBYTE B_TRUE 1 100 0.00 1.00000000000 BIT_MASK 0x1 FORMAT "%13.11" ECU_ADDRESS 0x6000F99A /end MEASUREMENT
/begin MEASUREMENT CstrPurg_flgEnaCdnTiStrtEnd "enable condition if the engine start is finished and time after startend is reached" UBYTE B_TRUE 1 100 0.00 1.00000000000 BIT_MASK 0x1 FORMAT "%13.11" ECU_ADDRESS 0x6000B872 /end MEASUREMENT
/begin MEASUREMENT CstrPurg_flgFteadRampUpActvOlc "Status activation increase of purge control adaptation value in fuel purge limp-home mode in case of high evapuration" UBYTE B_TRUE 1 100 0.00 1.00000000000 BIT_MASK 0x1 FORMAT "%13.11" ECU_ADDRESS 0x6000B86C /end MEASUREMENT
/begin MEASUREMENT CstrPurg_flgImsteiniNV "Flag: NV-stored value of integral of purge mass flow (imsteini_msg) is used" UBYTE B_TRUE 1 100 0.00 1.00000000000 BIT_MASK 0x1 FORMAT "%13.11" ECU_ADDRESS 0x6000F6BA /end MEASUREMENT
/begin MEASUREMENT CstrPurg_flgIniTEADAP100ms "Initialisation necessary for TEADAP 100ms" UBYTE B_TRUE 1 100 0.00 1.00000000000 BIT_MASK 0x1 FORMAT "%13.11" ECU_ADDRESS 0x6000F6B9 /end MEASUREMENT
/begin MEASUREMENT CstrPurg_flgIniTESKSOL100ms "Initialisation necessary for TESKSOL 100ms" UBYTE B_TRUE 1 100 0.00 1.00000000000 BIT_MASK 0x1 FORMAT "%13.11" ECU_ADDRESS 0x6000B888 /end MEASUREMENT
/begin MEASUREMENT CstrPurg_flgPurgActv "Purge active" UBYTE B_TRUE 1 100 0.00 1.00000000000 BIT_MASK 0x1 FORMAT "%13.11" ECU_ADDRESS 0x6000F6B8 /end MEASUREMENT
/begin MEASUREMENT CstrPurg_flgPurgDeactvd "Purge deactivated" UBYTE B_TRUE 1 100 0.00 1.00000000000 BIT_MASK 0x1 FORMAT "%13.11" ECU_ADDRESS 0x6000B87D /end MEASUREMENT
/begin MEASUREMENT CstrPurg_flgReIniTEBGTEV20ms "Re-Initialisation necessary for TEBGTEV 20ms" UBYTE B_TRUE 1 100 0.00 1.00000000000 BIT_MASK 0x1 FORMAT "%13.11" ECU_ADDRESS 0x6000B88F /end MEASUREMENT
/begin MEASUREMENT CstrPurg_flgReIniTELAM100ms "Re-Initialisation necessary for TELAM 100ms" UBYTE B_TRUE 1 100 0.00 1.00000000000 BIT_MASK 0x1 FORMAT "%13.11" ECU_ADDRESS 0x6000F6B7 /end MEASUREMENT
/begin MEASUREMENT CstrPurg_flgReIniTESIGTE100ms "Re-Initialisation necessary for TESIGTE 100ms" UBYTE B_TRUE 1 100 0.00 1.00000000000 BIT_MASK 0x1 FORMAT "%13.11" ECU_ADDRESS 0x6000B890 /end MEASUREMENT
/begin MEASUREMENT CstrPurg_flgReIniTESIGTE20ms "Re-Initialisation necessary for TESIGTE 20ms" UBYTE B_TRUE 1 100 0.00 1.00000000000 BIT_MASK 0x1 FORMAT "%13.11" ECU_ADDRESS 0x6000B891 /end MEASUREMENT
/begin MEASUREMENT CstrPurg_flgReIniTESKSOL100ms "Re-Initialisation necessary for TESKSOL 100ms" UBYTE B_TRUE 1 100 0.00 1.00000000000 BIT_MASK 0x1 FORMAT "%13.11" ECU_ADDRESS 0x6000B887 /end MEASUREMENT
/begin MEASUREMENT CstrPurg_flgReIniTESKSOL20ms "Re-Initialisation necessary for TESKSOL 20ms" UBYTE B_TRUE 1 100 0.00 1.00000000000 BIT_MASK 0x1 FORMAT "%13.11" ECU_ADDRESS 0x6000B88B /end MEASUREMENT
/begin MEASUREMENT CstrPurg_flgTiEngOffRst "Condition: Reset integral mass flow rate canister purge valve" UBYTE B_TRUE 1 100 0.00 1.00000000000 BIT_MASK 0x1 FORMAT "%13.11" ECU_ADDRESS 0x6000B886 /end MEASUREMENT
/begin MEASUREMENT CstrPurg_flgUBattOk "Battery voltage OK for CPV components (within limits CstrPurg_uBattMin and CstrPurg_uBattMax)" UBYTE B_TRUE 1 100 0.00 1.00000000000 BIT_MASK 0x1 FORMAT "%13.11" ECU_ADDRESS 0x6000F6B5 /end MEASUREMENT
/begin MEASUREMENT CstrPurg_mfCpvDteskBlkdLine "purge mass flow for DTESK blocked line diagnosis between tank and active carbon canister" UWORD m_uw_b25p6 1 100 0.00 25.59961 FORMAT "%8.5" ECU_ADDRESS 0x60009506 /end MEASUREMENT
/begin MEASUREMENT CstrPurg_mfDeltaRampDwn "Delta Canister purge mass flow for ramp down" ULONG m_uw_b25p6 1 100 0.00 1677721.59961 FORMAT "%13.5" ECU_ADDRESS 0x50001424 /end MEASUREMENT
/begin MEASUREMENT CstrPurg_mFlowCpv1LoLdPurgLn "Cannister Purging massflow in low load purge line CPV1" UWORD m_uw_b25p6 1 100 0.00 25.59961 FORMAT "%8.5" ECU_ADDRESS 0x6000950E /end MEASUREMENT
/begin MEASUREMENT CstrPurg_mFlowCpv1LoLdPurgLnMod "Modelled canister purge mass flow in the low load purge line (length of the purge line is taken into consideration)" UWORD m_uw_b25p6 1 100 0.00 25.59961 FORMAT "%8.5" ECU_ADDRESS 0x6000950C /end MEASUREMENT
/begin MEASUREMENT CstrPurg_mFlowCpvLoLdPurgLn "Total massflow through CPV1 in low load purge line" UWORD m_uw_b25p6 1 100 0.00 25.59961 FORMAT "%8.5" ECU_ADDRESS 0x6000950A /end MEASUREMENT
/begin MEASUREMENT CstrPurg_mMFlowMnfld "Mass flow into manifold" UWORD m_uw_b6553p5 1 100 0.00 6553.500 FORMAT "%8.3" ECU_ADDRESS 0x60009508 /end MEASUREMENT
/begin MEASUREMENT CstrPurg_pAftThr "Pressure after Throttle" UWORD p_uw_q0p078 1 100 0.00 5119.922 FORMAT "%8.3" ECU_ADDRESS 0x600075BE /end MEASUREMENT
/begin MEASUREMENT CstrPurg_ratAirChrg "canisterpurge rational air charge" UWORD rel_q0p0234 1 100 0.00 1535.977 FORMAT "%8.3" ECU_ADDRESS 0x6000755C /end MEASUREMENT
/begin MEASUREMENT CstrPurg_ratPAftCpvToEnv "quotient: pressure behind CPV ambient pressure" UWORD fak_uw_b8 1 100 0.00 7.999878 FORMAT "%8.6" ECU_ADDRESS 0x60009502 /end MEASUREMENT
/begin MEASUREMENT CstrPurg_ratPLoLoadPurgLnToEnv "Ratio between pressure low load purgeline and ambient pressure" UWORD fak_uw_b8 1 100 0.00 7.999878 FORMAT "%8.6" ECU_ADDRESS 0x60009500 /end MEASUREMENT
/begin MEASUREMENT CstrPurg_ratRadShtDes "local variable for determination of the factor, CPV cooling effect due to vehicle speed and radiator shutter position" UWORD rel_uw_b200 1 100 0.00 199.9969 FORMAT "%8.4" ECU_ADDRESS 0x600075BC /end MEASUREMENT
/begin MEASUREMENT CstrPurg_ratThrVlv "Throttle valve position" SWORD relDK_q0p02441 1 100 -800.0000 799.9756 FORMAT "%8.4" ECU_ADDRESS 0x600075A0 /end MEASUREMENT
/begin MEASUREMENT CstrPurg_ratWghtRelAirFillg "weighteded relative air charge" UWORD rel_uw_q0p0234 1 100 0.00 1535.977 FORMAT "%8.3" ECU_ADDRESS 0x600075BA /end MEASUREMENT
/begin MEASUREMENT CstrPurg_ratWghtRelAirFillgFilt "weighteded relative air charge filtered" UWORD rel_uw_q0p0234 1 100 0.00 1535.977 FORMAT "%8.3" ECU_ADDRESS 0x600075B8 /end MEASUREMENT
/begin MEASUREMENT CstrPurg_relAirChrg "relative air charge" UWORD rel_uw_q0p0234 1 100 0.00 1535.977 FORMAT "%8.3" ECU_ADDRESS 0x6000759E /end MEASUREMENT
/begin MEASUREMENT CstrPurg_rPMnfTank "quotient: pressure behind PCV tank pressure" UWORD fak_uw_b8 1 100 0.00 7.999878 FORMAT "%8.6" ECU_ADDRESS 0x600075B6 /end MEASUREMENT
/begin MEASUREMENT CstrPurg_stAbortReas "Canister purging abort reason status" UWORD dez 1 100 0.00 65535.00 FORMAT "%8.2" ECU_ADDRESS 0x6000757A /end MEASUREMENT
/begin MEASUREMENT CstrPurg_stFuCmpTERKDeact "Current state of deactivation of the fuel compensation during the cannister purging diagnosis (diagnosis that use a lambda deviation as an OK criteria should deactivate the compensation) Bitwise coded" UBYTE OneToOne 1 100 0.00 255.0 FORMAT "%5.1" ECU_ADDRESS 0x6000B866 /end MEASUREMENT
/begin MEASUREMENT CstrPurg_stInhbnReas "Reason for inhibit of fuel purging" ULONG dez 1 100 0.00 4294967295.00 FORMAT "%13.2" ECU_ADDRESS 0x600027C4 /end MEASUREMENT
/begin MEASUREMENT CstrPurg_tCpvMod "Modled Cpv-temperature" UWORD temp_q0p0234_o273 1 100 -273.150 1262.827 FORMAT "%8.3" ECU_ADDRESS 0x600094FC /end MEASUREMENT
/begin MEASUREMENT CstrPurg_tDifThr2Env "Temperature difference between throttle and environment temperature" UWORD temp_q0p0234_o273 1 100 0.014 1262.827 FORMAT "%8.3" ECU_ADDRESS 0x600075B4 /end MEASUREMENT
/begin MEASUREMENT CstrPurg_temploc "local variable for temperature" SWORD Temp_Cels 1 100 -3549.940 3003.560 FORMAT "%8.3" ECU_ADDRESS 0x600075DE /end MEASUREMENT
/begin MEASUREMENT CstrPurg_tFiltDifThr2Env "Filtered temperature difference between throttle and environment temperature" UWORD temp_q0p0234_o273 1 100 -273.150 1262.827 FORMAT "%8.3" ECU_ADDRESS 0x600075B2 /end MEASUREMENT
/begin MEASUREMENT CstrPurg_tiAftStrt "Time after Start (EngineOffTime stands still)" UWORD t_q0p1 1 100 0.00 6553.500 FORMAT "%8.3" ECU_ADDRESS 0x60007594 /end MEASUREMENT
/begin MEASUREMENT CstrPurg_tiInhLamDev "Elapsed time since a big lambda deviation not caused by the canister purging has been detected." UWORD t_q0p1 1 100 0.00 6553.500 FORMAT "%8.3" ECU_ADDRESS 0x60007578 /end MEASUREMENT
/begin MEASUREMENT CstrPurg_tiMfRmpDwn "Ramp down time for desired mass flow" UWORD t_q0p02 1 100 0.00 1310.700 FORMAT "%8.3" ECU_ADDRESS 0x60007586 /end MEASUREMENT
/begin MEASUREMENT CstrPurg_tIntkAir "Intake air temperature for canister purge control" SWORD Temp_Cels 1 100 -3549.940 3003.560 FORMAT "%8.3" ECU_ADDRESS 0x60009212 /end MEASUREMENT
/begin MEASUREMENT CstrPurg_tiResMfRmpDwn "Ramp down time for desired mass flow scaled with factor from ftead and mste" UWORD t_q0p02 1 100 0.00 1310.700 FORMAT "%8.3" ECU_ADDRESS 0x60007584 /end MEASUREMENT
/begin MEASUREMENT CstrPurg_tLoadTChgCpv "Component the canister purge valve temperature due to vehicle speed and the relative air charge" UWORD temp_q0p0234_o273 1 100 -273.150 1262.827 FORMAT "%8.3" ECU_ADDRESS 0x600075B0 /end MEASUREMENT
/begin MEASUREMENT CstrPurg_tPurgAdpnCorrn "input temperature to fuel purge adaptation correction factor map" SWORD Temp_Cels 1 100 -3549.940 3003.560 FORMAT "%8.3" ECU_ADDRESS 0x6000756C /end MEASUREMENT
/begin MEASUREMENT CstrPurg_tRadrCoolgCpv "CPV cooling effect due to vehicle speed and radiator shutter position" UWORD temp_q0p0234_o273 1 100 -273.150 1262.827 FORMAT "%8.3" ECU_ADDRESS 0x600075AE /end MEASUREMENT
/begin MEASUREMENT CstrPurg_tThrHeatgCpv "Filtered throttle temperature (depending on the engine load and difference to environment temperature)" UWORD temp_q0p0234_o273 1 100 -273.150 1262.827 FORMAT "%8.3" ECU_ADDRESS 0x600075AC /end MEASUREMENT
/begin MEASUREMENT CstrPurg_tThrIntAirFilt "Filtered throttle temperature (depending on the engine load and difference to environment temperature)" UWORD temp_q0p0234_o273 1 100 -273.150 1262.827 FORMAT "%8.3" ECU_ADDRESS 0x600075AA /end MEASUREMENT
/begin MEASUREMENT dfkasteold_w "Old input value for integrator specific desired purge fuel amount" SWORD perio_q4p76836Em5 1 100 -1.562496 1.562448 FORMAT "%8.6" ECU_ADDRESS 0x60007592 /end MEASUREMENT
/begin MEASUREMENT dfkaster "basic input value for integrator specific desired purge fuel amount" SBYTE fak_sb_b16 1 100 -16.00 15.88 FORMAT "%5.2" ECU_ADDRESS 0x6000B885 /end MEASUREMENT
/begin MEASUREMENT dfkastes_w "input value for integrator specific desired purge fuel amount" SWORD perio_q4p76836Em5 1 100 -1.562496 1.562448 FORMAT "%8.6" ECU_ADDRESS 0x60007590 /end MEASUREMENT
/begin MEASUREMENT dfkasteub "Unlimited control deviation specific set fuel amount" SBYTE fak_sb_b16 1 100 -16.00 15.88 FORMAT "%5.2" ECU_ADDRESS 0x6000B884 /end MEASUREMENT
/begin MEASUREMENT divtqteabf "Variable for Canister Purge Valve shutoff time selection depending on the mass flow (mste_w) and the Carbon Canister load (ftead_w)" UWORD fak_uw_b2 1 100 0.00 1.999969 FORMAT "%8.6" ECU_ADDRESS 0x60007582 /end MEASUREMENT
/begin MEASUREMENT dmstes_w "Input Integrator purge mass flow" SWORD m_q0p002441_kg_DIV_h_s 1 100 -80.00000 79.99756 FORMAT "%8.5" ECU_ADDRESS 0x600095EE /end MEASUREMENT
/begin MEASUREMENT drlsolmf_w "delta desired relative air charge for medianfilter" UWORD rel_uw_q0p0234 1 100 0.00 1535.977 FORMAT "%8.3" ECU_ADDRESS 0x70005098 /end MEASUREMENT
/begin MEASUREMENT dwdksumx_w "difference of desired throttle angle between 95% and 100% charge" UWORD rel_uw_b100 1 100 0.00 99.99847 FORMAT "%8.5" ECU_ADDRESS 0x60000CAA /end MEASUREMENT
/begin MEASUREMENT dwdksuofna1_w "Delta Sollwinkel Drosselklappe ab Beginn ungedrosselt ohne Filterung" UWORD rel_uw_b100 1 100 0.00 99.99847 FORMAT "%8.5" ECU_ADDRESS 0x60000F40 /end MEASUREMENT
/begin MEASUREMENT dwdksuofna2_w "Delta Sollwinkel Drosselklappe ab Beginn ungedrosselt ohne Filterung" UWORD rel_uw_b100 1 100 0.00 99.99847 FORMAT "%8.5" ECU_ADDRESS 0x60000F3E /end MEASUREMENT
/begin MEASUREMENT dwdksuofnasum_w "Delta Sollwinkel Drosselklappe ab Beginn ungedrosselt ohne Filterung" UWORD rel_uw_b100 1 100 0.00 99.99847 FORMAT "%8.5" ECU_ADDRESS 0x60000F3C /end MEASUREMENT
/begin MEASUREMENT dwdksuof_w "difference of desired throttle angle refered to 95% charge without filtering" UWORD rel_uw_b100 1 100 0.00 99.99847 FORMAT "%8.5" ECU_ADDRESS 0x60000F3A /end MEASUREMENT
/begin MEASUREMENT EngStrt_flgStrtAsscFastCutOff "Demand fast starter cut off during succession start" UBYTE B_TRUE 1 100 0.00 1.00000000000 BIT_MASK 0x1 FORMAT "%13.11" ECU_ADDRESS 0x70000995 /end MEASUREMENT
/begin MEASUREMENT Engstrt_stReIniFSTSTRTOFF "Local Status of ReIni Enter in FSTSTRTOFF" UBYTE OneToOne 1 100 0.00 255.0 FORMAT "%5.1" ECU_ADDRESS 0x6000B89D /end MEASUREMENT
/begin MEASUREMENT EnvTt_tumg "Temporary variable for x-input of KFTETPU" UBYTE temp_ub_q0p75_o48 1 100 -48.0 143.3 FORMAT "%5.1" ECU_ADDRESS 0x6000B896 /end MEASUREMENT
/begin MEASUREMENT EpmnEng_nmot "Temporary variable for y-input of KFMOPTE" UWORD nmot_uw_q0p25 1 100 0.00 16383.75 FORMAT "%8.2" ECU_ADDRESS 0x60007556 /end MEASUREMENT
/begin MEASUREMENT fgwrteufld "value: unfiltered purge rate reduction because of fr-controller deviations" UBYTE fak_ub_b16 1 100 0.00 15.94 FORMAT "%5.2" ECU_ADDRESS 0x6000B883 /end MEASUREMENT
/begin MEASUREMENT fgwrte_msg "value: purge rate reduction because of fr-controller deviations" UBYTE fak_ub_b16 1 100 0.00 15.94 FORMAT "%5.2" ECU_ADDRESS 0x6000F73E /end MEASUREMENT
/begin MEASUREMENT fkakordl "With delta lambda calculation of mean value product of Lambda and Lambda factor deviation" UBYTE fak_ub_b4 1 100 0.00 3.984 FORMAT "%5.3" ECU_ADDRESS 0x6000B882 /end MEASUREMENT
/begin MEASUREMENT fkakormt_loc "Local copy of mean value bank1, bank2 of the product of the Lambda and Lambda factor deviation (fkakormt_w)" UWORD fak_uw_b2 1 100 0.00 1.999969 FORMAT "%8.6" ECU_ADDRESS 0x6000756A /end MEASUREMENT
/begin MEASUREMENT fkakormt_w_msg "mean value bank1, bank2 of the produkt of the Lambda and Lambdafactor deviation" UWORD fak_uw_b2 1 100 0.00 1.999969 FORMAT "%8.6" ECU_ADDRESS 0x60008D7A /end MEASUREMENT
/begin MEASUREMENT fkakormx_w_msg "Maximum value bank1, bank2 of the product of the Lambda and Lambda factor deviation" UWORD fak_uw_b4 1 100 0.00 3.999939 FORMAT "%8.6" ECU_ADDRESS 0x60008D78 /end MEASUREMENT
/begin MEASUREMENT fkakor_w_msg "Product of the Lambda and Lambda factor deviation, bank1" UWORD fak_uw_b4 1 100 0.00 3.999939 FORMAT "%8.6" ECU_ADDRESS 0x60008D7C /end MEASUREMENT
/begin MEASUREMENT fkastes "desired value of the specific purge fuel amount" UBYTE fak_ub_b0p5 1 100 0.00 0.4980 ECU_ADDRESS 0x6000B881 /end MEASUREMENT
/begin MEASUREMENT fkastes_w_msg "desired value of the specific purge fuel amount (16 bit)" UWORD fak_uw_b0p5 1 100 0.00 0.4999924 FORMAT "%9.7" ECU_ADDRESS 0x60008D76 /end MEASUREMENT
/begin MEASUREMENT fkastexm "Maximum possible value specific fuel component for canister purging" UBYTE fak_ub_b0p5 1 100 0.00 0.4980 ECU_ADDRESS 0x6000B86B /end MEASUREMENT
/begin MEASUREMENT fkastexm_w_msg "Max possible value of the specific purge fuel amount, unlimited" UWORD fak_uw_b0p5 1 100 0.00 0.4999924 FORMAT "%9.7" ECU_ADDRESS 0x60008D74 /end MEASUREMENT
/begin MEASUREMENT fkastex_w "Max value of the specific purge fuel amount" UWORD fak_uw_b0p5 1 100 0.00 0.4999924 FORMAT "%9.7" ECU_ADDRESS 0x6000758E /end MEASUREMENT
/begin MEASUREMENT fkaste_msg "actual value of the specific purge fuel amount" UBYTE fak_ub_b0p5 1 100 0.00 0.4980 ECU_ADDRESS 0x6000F738 /end MEASUREMENT
/begin MEASUREMENT fkastold_w "Old value of the specific purge fuel amount (16 bit)" UWORD fak_uw_b0p5 1 100 0.00 0.4999924 FORMAT "%9.7" ECU_ADDRESS 0x6000758C /end MEASUREMENT
/begin MEASUREMENT fkasx "max. spec. purge fuel amount" UBYTE fak_ub_b0p5 1 100 0.00 0.4980 ECU_ADDRESS 0x6000B880 /end MEASUREMENT
/begin MEASUREMENT fkatefrg_w_msg "factor fuel rate purge control at desired purge rate" SWORD fak_q0p0009766 1 100 -32.00000 31.99902 FORMAT "%8.5" ECU_ADDRESS 0x60008FBE /end MEASUREMENT
/begin MEASUREMENT fkatei_msg "factor fuel part purge control (actual value)" SBYTE fak_sb_b1 1 100 -1.000 0.992 FORMAT "%5.3" ECU_ADDRESS 0x6000F8A5 /end MEASUREMENT
/begin MEASUREMENT FlMA_facEvapThdMax "deactivation threshold of fuel mixtue adaptation if the proportion of evaporating fuel from the engine oil to the fuel demand is too big" UBYTE fak_ub_b2 1 100 0.00 1.992188 FORMAT "%8.6" ECU_ADDRESS 0x6000B8A7 /end MEASUREMENT
/begin MEASUREMENT FlMA_flgAbortReqOffsAdpn "Abbruchbedingung für die Anforderung Offsetadaption" UBYTE B_TRUE 1 100 0.00 1.00000000000 BIT_MASK 0x1 FORMAT "%13.11" ECU_ADDRESS 0x7000025B /end MEASUREMENT
/begin MEASUREMENT FlMA_flgEnaCdnEngCoorrCoupl "the general enable conditions are fulfilled" UBYTE B_TRUE 1 100 0.00 1.00000000000 BIT_MASK 0x1 FORMAT "%13.11" ECU_ADDRESS 0x7000025A /end MEASUREMENT
/begin MEASUREMENT FlMA_flgFacErrDeb "Condition factor adaptation error is debounced" UBYTE B_TRUE 1 100 0.00 1.00000000000 BIT_MASK 0x1 FORMAT "%13.11" ECU_ADDRESS 0x70000259 /end MEASUREMENT
/begin MEASUREMENT FlMA_flgFacErrTstd "Condition factor adaptation error is tested" UBYTE B_TRUE 1 100 0.00 1.00000000000 BIT_MASK 0x1 FORMAT "%13.11" ECU_ADDRESS 0x70000258 /end MEASUREMENT
/begin MEASUREMENT FlMA_flgOffsErrDeb "Condition offset adaptation error is debounced" UBYTE B_TRUE 1 100 0.00 1.00000000000 BIT_MASK 0x1 FORMAT "%13.11" ECU_ADDRESS 0x70000257 /end MEASUREMENT
/begin MEASUREMENT FlMA_flgOffsErrTstd "Condition offset adaptation error is tested" UBYTE B_TRUE 1 100 0.00 1.00000000000 BIT_MASK 0x1 FORMAT "%13.11" ECU_ADDRESS 0x70000256 /end MEASUREMENT
/begin MEASUREMENT FLMA_nrStrtVDpd "Number of engine starts depending on vehicle speed" UWORD OneToOne 1 100 0.00 65535.00 FORMAT "%8.2" ECU_ADDRESS 0x600075F8 /end MEASUREMENT
/begin MEASUREMENT FlMA_tiEngOff "engine stop time copied at the time of first engine start in the driving cycle" SLONG t_q4_s 1 100 -8589934592.00 8589934588.00 FORMAT "%13.2" ECU_ADDRESS 0x600027C8 /end MEASUREMENT
/begin MEASUREMENT FMA2CE_AVORASW_I.timeCounter "Stop watch / expired time since start" UWORD t_q0p2 1 100 0.00 13107.00 FORMAT "%8.2" ECU_ADDRESS 0x600075F6 /end MEASUREMENT
/begin MEASUREMENT FMA2CE_BALRAFF_I.status "Flipflop / current value of RS-FF" UBYTE B_TRUE 1 100 0.00 1.00000000000 BIT_MASK 0x1 FORMAT "%13.11" ECU_ADDRESS 0x6000B8A6 /end MEASUREMENT
/begin MEASUREMENT FMA2CE_BfdgserFF_I.status "Flipflop / current value of RS-FF" UBYTE B_TRUE 1 100 0.00 1.00000000000 BIT_MASK 0x1 FORMAT "%13.11" ECU_ADDRESS 0x6000B8A5 /end MEASUREMENT
/begin MEASUREMENT FMA2CE_LRAFRATONV_I.outbit "Turn on delay / return value" UBYTE B_TRUE 1 100 0.00 1.00000000000 BIT_MASK 0x1 FORMAT "%13.11" ECU_ADDRESS 0x600075F2 /end MEASUREMENT
/begin MEASUREMENT FMA2CE_LRAFRATONV_I.time "Turn on delay / expired delay time" UWORD t_q0p2 1 100 0.00 13107.00 FORMAT "%8.2" ECU_ADDRESS 0x600075F4 /end MEASUREMENT
/begin MEASUREMENT FMA2CE_ORASTPVBCTR_I.counter "current counter value / current counter value" UBYTE dez 1 100 0.00 255.0 FORMAT "%5.1" ECU_ADDRESS 0x6000B8A4 /end MEASUREMENT
/begin MEASUREMENT fmdte_w "Amplification factor for torque TEV" UWORD fak_uw_b2 1 100 0.00 1.999969 FORMAT "%8.6" ECU_ADDRESS 0x60007554 /end MEASUREMENT
/begin MEASUREMENT FPCtl_ctReIniTEADAPPostDrvLeave "Local variable to store the global drive cycle counter(SyC_ctPostDrvLeave)" UBYTE OneToOne 1 100 0.00 255.0 FORMAT "%5.1" ECU_ADDRESS 0x6000B86A /end MEASUREMENT
/begin MEASUREMENT FPCtl_flg100msReIniTEEB "Re-Initialisation necessary for TEEB 100ms" UBYTE B_TRUE 1 100 0.00 1.00000000000 BIT_MASK 0x1 FORMAT "%13.11" ECU_ADDRESS 0x6000B871 /end MEASUREMENT
/begin MEASUREMENT FPCtl_flg20msReIniTEEB "Re-Initialisation necessary for TEEB 20ms" UBYTE B_TRUE 1 100 0.00 1.00000000000 BIT_MASK 0x1 FORMAT "%13.11" ECU_ADDRESS 0x6000B87C /end MEASUREMENT
/begin MEASUREMENT FPCtl_flgIniDrvTEBGTEV "flag to be set if there is a inidrv raster called" UBYTE B_TRUE 1 100 0.00 1.00000000000 BIT_MASK 0x1 FORMAT "%13.11" ECU_ADDRESS 0x6000B88E /end MEASUREMENT
/begin MEASUREMENT FPCtl_flgReIniFPC2CE "Re-Initialisation necessary for FPC2CE" UBYTE B_TRUE 1 100 0.00 1.00000000000 BIT_MASK 0x1 FORMAT "%13.11" ECU_ADDRESS 0x6000B862 /end MEASUREMENT
/begin MEASUREMENT FPCtl_flgReIniTEMSSOLS20ms "Re-Initialisation necessary for TEMSSOLS 20ms" UBYTE B_TRUE 1 100 0.00 1.00000000000 BIT_MASK 0x1 FORMAT "%13.11" ECU_ADDRESS 0x6000F96F /end MEASUREMENT
/begin MEASUREMENT FPCtl_flgReIniTESIGOUT100ms "Re-Initialisation necessary for TESIGOUT 100ms" UBYTE B_TRUE 1 100 0.00 1.00000000000 BIT_MASK 0x1 FORMAT "%13.11" ECU_ADDRESS 0x6000B895 /end MEASUREMENT
/begin MEASUREMENT FPCtl_flgReIniTESIGOUT20ms "Re-Initialisation necessary for TESIGOUT 20ms" UBYTE B_TRUE 1 100 0.00 1.00000000000 BIT_MASK 0x1 FORMAT "%13.11" ECU_ADDRESS 0x6000B89A /end MEASUREMENT
/begin MEASUREMENT FPCtl_flgSyncS1ReIniTEEB "Local variable to store the global drive cycle counter (SyC_ctPostDrvLeave)" UBYTE B_TRUE 1 100 0.00 1.00000000000 BIT_MASK 0x1 FORMAT "%13.11" ECU_ADDRESS 0x6000B870 /end MEASUREMENT
/begin MEASUREMENT FPCtl_FPC2CEfteadfHLRSC_I.hysterese "Hysteresis for filter factor tank venting adaptation. / Current value of the hysteresis" UBYTE B_TRUE 1 100 0.00 1.00000000000 BIT_MASK 0x1 FORMAT "%13.11" ECU_ADDRESS 0x6000B860 /end MEASUREMENT
/begin MEASUREMENT fteadf_msg "filtered factor purge control adaptation" SBYTE fak_sb_b64 1 100 -64.00 63.50 FORMAT "%5.2" ECU_ADDRESS 0x6000F8A4 /end MEASUREMENT
/begin MEASUREMENT fteadf_w_msg "filtered factor purge control adaptation" SWORD fak_sw_b64 1 100 -64.00000 63.99805 FORMAT "%8.5" ECU_ADDRESS 0x60008FBA /end MEASUREMENT
/begin MEASUREMENT fteadten_w "factor fuel purge adaptation at open loop purging" UWORD fak_q0p00195 1 100 0.00 127.9980 FORMAT "%8.4" ECU_ADDRESS 0x6000758A /end MEASUREMENT
/begin MEASUREMENT fteadvir "virtual factor fuel purge adaption" SBYTE fak_q0p5 1 100 -64.00 63.50 FORMAT "%5.2" ECU_ADDRESS 0x6000B894 /end MEASUREMENT
/begin MEASUREMENT ftead_w_msg "factor fuel purge adaptation" SWORD fak_sw_b64 1 100 -64.00000 63.99805 FORMAT "%8.5" ECU_ADDRESS 0x600398B8 /end MEASUREMENT
/begin MEASUREMENT ftefsoll_w_msg "desired canister purge rate" UWORD fak_uw_b0p5 1 100 0.00 0.4999924 FORMAT "%9.7" ECU_ADDRESS 0x6000935A /end MEASUREMENT
/begin MEASUREMENT ftevflox_w_msg "Max. value of purge valve relative opening (16 bit)" UWORD fak_uw_b1 1 100 0.00 0.9999847 FORMAT "%9.7" ECU_ADDRESS 0x60009358 /end MEASUREMENT
/begin MEASUREMENT ftevflxmin_w "Min. value characteristic map of purge valve relative opening (16 bit)" UWORD fak_uw_b1 1 100 0.00 0.9999847 FORMAT "%9.7" ECU_ADDRESS 0x6000759C /end MEASUREMENT
/begin MEASUREMENT ftevflxm_w "Max. value characteristic map of purge valve relative opening (16 bit)" UWORD fak_uw_b1 1 100 0.00 0.9999847 FORMAT "%9.7" ECU_ADDRESS 0x60009356 /end MEASUREMENT
/begin MEASUREMENT ftevfteadlim_w "limitation of relative opening CPV" UWORD fak_uw_b1 1 100 0.00 0.9999847 FORMAT "%9.7" ECU_ADDRESS 0x6000759A /end MEASUREMENT
/begin MEASUREMENT ftho_w_msg "factor temperature and altitude depending correction of mass flow" UWORD fak_uw_b2 1 100 0.00 1.999969 FORMAT "%8.6" ECU_ADDRESS 0x60009354 /end MEASUREMENT
/begin MEASUREMENT FuPHi_pPID23 "value for rail pressure for PID23" UWORD p_q10_kPa 1 100 0.00 655350.0 FORMAT "%8.1" ECU_ADDRESS 0x6000149A /end MEASUREMENT
/begin MEASUREMENT FuPurgCtrl_flgIdle "Idle speed from drivers sight" UBYTE B_TRUE 1 100 0.00 1.00000000000 BIT_MASK 0x1 FORMAT "%13.11" ECU_ADDRESS 0x6000B86F /end MEASUREMENT
/begin MEASUREMENT FuPurgCtrl_LoadAdpndkhckorrIKL_I.memory "Internal TEADAP Integrator measurement value Current Integrator value / Current Integrator value" SLONG fak_sw_b64 1 100 -4194304.00000 4194303.99805 FORMAT "%13.5" ECU_ADDRESS 0x600027C0 /end MEASUREMENT
/begin MEASUREMENT FuPurgCtrl_LoadAdpnRstIntegFF_I.status "Internal TEADAP FlipFlop measurement value current value of RS-FF / current value of RS-FF" UBYTE B_TRUE 1 100 0.00 1.00000000000 BIT_MASK 0x1 FORMAT "%13.11" ECU_ADDRESS 0x6000B867 /end MEASUREMENT
/begin MEASUREMENT FuPurgCtrl_mExhB1 "Local calculation for the integrated exhaust mass" UWORD q0p1_g 1 100 0.00 6553.500 FORMAT "%8.3" ECU_ADDRESS 0x60007568 /end MEASUREMENT
/begin MEASUREMENT FuPurgCtrl_mFlowCpv1LoLdPurgLnDiag "Cannister Purging massflow in low load purge line CPV1 before diagnosis limitation" UWORD m_uw_b25p6 1 100 0.00 25.59961 FORMAT "%8.5" ECU_ADDRESS 0x6000945E /end MEASUREMENT
/begin MEASUREMENT FuPurgCtrl_mIntglPurgMFlow "integral of canister purge mass flow" UWORD RBPtCel_m_0p001_3 1 100 0.00 65.53500 FORMAT "%8.5" ECU_ADDRESS 0x60008E50 /end MEASUREMENT
/begin MEASUREMENT FuPurgCtrl_TEEBAllLocInjVlvActvTONV_I.outbit "Condition all injection valves are activated, two camshaft revolutions delayed after fuel cutoff / return value" UBYTE B_TRUE 1 100 0.00 1.00000000000 BIT_MASK 0x1 FORMAT "%13.11" ECU_ADDRESS 0x60007576 /end MEASUREMENT
/begin MEASUREMENT FuPurgCtrl_TEEBAllLocInjVlvActvTONV_I.time "Condition all injection valves are activated, two camshaft revolutions delayed after fuel cutoff / expired delay time" UBYTE t_q0p02 1 100 0.00 5.100 FORMAT "%5.3" ECU_ADDRESS 0x60007577 /end MEASUREMENT
/begin MEASUREMENT FuPurgCtrl_TEEBClsdLoopCtrlTOFFV_I.outbit "Condition cloesd loop control readiness for canister purge / Output Bit" UBYTE B_TRUE 1 100 0.00 1.00000000000 BIT_MASK 0x1 FORMAT "%13.11" ECU_ADDRESS 0x60007572 /end MEASUREMENT
/begin MEASUREMENT FuPurgCtrl_TEEBClsdLoopCtrlTOFFV_I.time "Condition cloesd loop control readiness for canister purge / Occured Time" UWORD t_q0p1 1 100 0.00 6553.500 FORMAT "%8.3" ECU_ADDRESS 0x60007574 /end MEASUREMENT
/begin MEASUREMENT FuPurgCtrl_TEEBCpvClsForFcoTOFFV_I.outbit "Flag: close canister purge valve for fuel cut-off. / Output Bit" UBYTE B_TRUE 1 100 0.00 1.00000000000 BIT_MASK 0x1 FORMAT "%13.11" ECU_ADDRESS 0x60007570 /end MEASUREMENT
/begin MEASUREMENT FuPurgCtrl_TEEBCpvClsForFcoTOFFV_I.time "Flag: close canister purge valve for fuel cut-off. / Occured Time" UBYTE t_q0p1 1 100 0.00 25.50 FORMAT "%5.2" ECU_ADDRESS 0x60007571 /end MEASUREMENT
/begin MEASUREMENT FuPurgCtrl_TEEBHiLoadTONVNM_I.time "condition delay time expired to inhibit purge control, high canister load / Delay Time" UBYTE t_q0p1 1 100 0.00 25.50 FORMAT "%5.2" ECU_ADDRESS 0x6000B86E /end MEASUREMENT
/begin MEASUREMENT FuPurgCtrl_TEEBLoLoadTONVNM_I.time "condition delay time expired to inhibit purge control, low canister load / Delay Time" UBYTE t_q0p1 1 100 0.00 25.50 FORMAT "%5.2" ECU_ADDRESS 0x6000B86D /end MEASUREMENT
/begin MEASUREMENT FuPurg_flgpriobbteh "local variable for priority of requested operating conditions for canister purge system with high canister load" UBYTE B_TRUE 1 100 0.00 1.00000000000 BIT_MASK 0x1 FORMAT "%13.11" ECU_ADDRESS 0x6000B861 /end MEASUREMENT
/begin MEASUREMENT FuPurg_flgReqRailPRedn "request reduction of rail pressure during fuel purge with high canister load" UBYTE B_TRUE 1 100 0.00 1.00000000000 BIT_MASK 0x1 FORMAT "%13.11" ECU_ADDRESS 0x6000F67F /end MEASUREMENT
/begin MEASUREMENT FuPurg_flgReqSpCamsft "request setpoint of camshaft during fuel purge with high canister load" UBYTE B_TRUE 1 100 0.00 1.00000000000 BIT_MASK 0x1 FORMAT "%13.11" ECU_ADDRESS 0x6000F67E /end MEASUREMENT
/begin MEASUREMENT FuPurg_idxEngLd "Index of load demand to the engine coordinator for fuel purge control internal demands" UBYTE OneToOne 1 100 0.00 255.0 FORMAT "%5.1" ECU_ADDRESS 0x6000F7BE /end MEASUREMENT
/begin MEASUREMENT FuPurg_nEngKfmiop "local variable for KFMIOP input engine speed" UWORD nmot_uw_q0p25 1 100 0.00 16383.75 FORMAT "%8.2" ECU_ADDRESS 0x60007552 /end MEASUREMENT
/begin MEASUREMENT FuPurg_nMaxDes "request operating condition for maximum engine speed for fuel purge control internal demands" SWORD EngN 1 100 -16384.00 16383.50 FORMAT "%8.2" ECU_ADDRESS 0x600090B4 /end MEASUREMENT
/begin MEASUREMENT FuPurg_nMaxDesDiag "Request max nmot_w for DTEV" UWORD EngN 1 100 0.00 32767.50 FORMAT "%8.2" ECU_ADDRESS 0x60008E4E /end MEASUREMENT
/begin MEASUREMENT FuPurg_nMaxDesLoad "requested operating conditions: max. engine speed for canister-purge-system (high load)" SWORD EngN 1 100 -16384.00 16383.50 FORMAT "%8.2" ECU_ADDRESS 0x600090B2 /end MEASUREMENT
/begin MEASUREMENT FuPurg_nMinDes "request operating condition for minimum engine speed for fuel purge control internal demands" SWORD EngN 1 100 -16384.00 16383.50 FORMAT "%8.2" ECU_ADDRESS 0x600090B0 /end MEASUREMENT
/begin MEASUREMENT FuPurg_nMinDesDiag "requested operating conditions: min. engine speed for canister purge system (diagnosis)" UWORD EngN 1 100 0.00 32767.50 FORMAT "%8.2" ECU_ADDRESS 0x60008E4C /end MEASUREMENT
/begin MEASUREMENT FuPurg_nMinDesLoad "requested operating conditions: min. engine speed for canister purge system (high load)" SWORD EngN 1 100 -16384.00 16383.50 FORMAT "%8.2" ECU_ADDRESS 0x600090AE /end MEASUREMENT
/begin MEASUREMENT FuPurg_stOpmHybStgyReq "Operation mode hybrid strategy request for fuel purge control internal demands" UBYTE OneToOne 1 100 0.00 255.0 FORMAT "%5.1" ECU_ADDRESS 0x6000F7BD /end MEASUREMENT
/begin MEASUREMENT FuPurg_stPrioWpDmdHyb "priority of requested operating conditions for fuel purge control internal demands" UBYTE OneToOne 1 100 0.00 255.0 FORMAT "%5.1" ECU_ADDRESS 0x6000F7BC /end MEASUREMENT
/begin MEASUREMENT FuPurg_stPrioWpDmdHybDiag "priority of requested operating conditions for canister purge valve diagnosis" UBYTE OneToOne 1 100 0.00 255.0 FORMAT "%5.1" ECU_ADDRESS 0x6000F7BB /end MEASUREMENT
/begin MEASUREMENT FuPurg_stPrioWpDmdHybLoad "priority of requested operating conditions for canister purge system with high canister load" UBYTE OneToOne 1 100 0.00 255.0 FORMAT "%5.1" ECU_ADDRESS 0x6000F7BA /end MEASUREMENT
/begin MEASUREMENT FuPurg_stStopPhdUrgDiag "urgency of stop prohibition for CPV diagnosis" UBYTE OneToOne 1 100 0.00 255.0 FORMAT "%5.1" ECU_ADDRESS 0x6000F7B9 /end MEASUREMENT
/begin MEASUREMENT FuPurg_stStrtDmdUrgDiag "urgency of start demand for CPV diagnosis" UBYTE OneToOne 1 100 0.00 255.0 FORMAT "%5.1" ECU_ADDRESS 0x6000F7B8 /end MEASUREMENT
/begin MEASUREMENT FuPurg_trqInrMaxDes "Request max torque for fuel purge control internal demands" SWORD Trq 1 100 -3276.800 3276.700 FORMAT "%8.3" ECU_ADDRESS 0x600090AC /end MEASUREMENT
/begin MEASUREMENT FuPurg_trqInrMaxDesDiag "Request max torque for canister purge system (diagnosis)" SWORD Trq 1 100 -3276.800 3276.700 FORMAT "%8.3" ECU_ADDRESS 0x600090AA /end MEASUREMENT
/begin MEASUREMENT FuPurg_trqInrMaxDesLoad "Request max torque for TEV (high load)" SWORD Trq 1 100 -3276.800 3276.700 FORMAT "%8.3" ECU_ADDRESS 0x600090A8 /end MEASUREMENT
/begin MEASUREMENT FuPurg_trqInrMinDes "Request min torque for fuel purge control internal demands" SWORD Trq 1 100 -3276.800 3276.700 FORMAT "%8.3" ECU_ADDRESS 0x600090A6 /end MEASUREMENT
/begin MEASUREMENT FuPurg_trqInrMinDesDiag "Request min torque for canister purge system (diagnosis)" SWORD Trq 1 100 -3276.800 3276.700 FORMAT "%8.3" ECU_ADDRESS 0x600090A4 /end MEASUREMENT
/begin MEASUREMENT FuPurg_trqInrMinDesLoad "Request min torque for TEV (high load)" SWORD Trq 1 100 -3276.800 3276.700 FORMAT "%8.3" ECU_ADDRESS 0x600090A2 /end MEASUREMENT
/begin MEASUREMENT GbxECU_ctEAT10RngCnt_MP "Alive counter measurement point" UBYTE OneToOne 1 100 0.00 255.0 FORMAT "%5.1" ECU_ADDRESS 0x7000A27C /end MEASUREMENT
/begin MEASUREMENT GbxECU_ctEAT11RngCnt_MP "Ring Counter Measuring Point for EAT11" UBYTE OneToOne 1 100 0.00 3.000 FORMAT "%5.3" ECU_ADDRESS 0x7000A27B /end MEASUREMENT
/begin MEASUREMENT GbxECU_ctEAT12RngCnt_MP "EAT 12 Ring conter Measuring point" UBYTE OneToOne 1 100 0.00 3.000 FORMAT "%5.3" ECU_ADDRESS 0x7000A27A /end MEASUREMENT
/begin MEASUREMENT GbxECU_ctEAT13RngCnt_MP "EAT 13 ring counter Measuring point" UBYTE OneToOne 1 100 0.00 3.000 FORMAT "%5.3" ECU_ADDRESS 0x7000A279 /end MEASUREMENT
/begin MEASUREMENT GbxECU_ctEAT1RngCnt_MP "Measuring Point for Ring counter of EAT1 Frame" UBYTE OneToOne 1 100 0.00 255.0 FORMAT "%5.1" ECU_ADDRESS 0x7000A27D /end MEASUREMENT
/begin MEASUREMENT GbxECU_ctEAT2RngCnt_MP "Alive counter measurement point" UBYTE OneToOne 1 100 0.00 255.0 FORMAT "%5.1" ECU_ADDRESS 0x7000A278 /end MEASUREMENT
/begin MEASUREMENT GbxECU_ctEAT4RngCnt_MP "Alive counter measurement point" UBYTE OneToOne 1 100 0.00 255.0 FORMAT "%5.1" ECU_ADDRESS 0x7000A274 /end MEASUREMENT
/begin MEASUREMENT GbxECU_ctEAT6RngCnt_MP "Alive counter measurement point" UBYTE OneToOne 1 100 0.00 255.0 FORMAT "%5.1" ECU_ADDRESS 0x7000A273 /end MEASUREMENT
/begin MEASUREMENT Gbx_bLuckUpOpn "status luck up open" UBYTE B_TRUE 1 100 0.00 1.00000000000 BIT_MASK 0x1 FORMAT "%13.11" ECU_ADDRESS 0x6000F94B /end MEASUREMENT
/begin MEASUREMENT Gbx_stConvClth "Gearbox converter clutch" UBYTE OneToOne 1 100 0.00 255.0 FORMAT "%5.1" ECU_ADDRESS 0x6000FC71 /end MEASUREMENT
/begin MEASUREMENT Gbx_trqConvLos "Gear box transmission torque loss absolute" SWORD Trq 1 100 -3276.800 3276.700 FORMAT "%8.3" ECU_ADDRESS 0x60009910 /end MEASUREMENT
/begin MEASUREMENT Gbx_trqTSCIntvFast "TM requested torque (ignition)" SWORD Trq 1 100 -3276.800 3276.700 FORMAT "%8.3" ECU_ADDRESS 0x6000990C /end MEASUREMENT
/begin MEASUREMENT imsteini_msg "integral of purge mass flow" UBYTE m_ub_q0p0444 1 100 0.00 11.32 FORMAT "%5.2" ECU_ADDRESS 0x6003985E /end MEASUREMENT
/begin MEASUREMENT kintftead "Learning speed fuel component regeneration gas" UBYTE perio_q0p3125 1 100 0.00 79.69 FORMAT "%5.2" ECU_ADDRESS 0x6000B869 /end MEASUREMENT
/begin MEASUREMENT kintftead_calc_loc "Local calulcation for kintftead after multipilcation" UBYTE perio_q0p3125 1 100 0.00 79.69 FORMAT "%5.2" ECU_ADDRESS 0x6000B868 /end MEASUREMENT
/begin MEASUREMENT kormtmod_w "Mean value bank1, bank2 of the product of the Lambda and Lambda factor deviation" UWORD fak_uw_b2 1 100 0.00 1.999969 FORMAT "%8.6" ECU_ADDRESS 0x60007566 /end MEASUREMENT
/begin MEASUREMENT ktevanst_msg "Basic value of purge valve opening speed" UBYTE perio_ub_b0p012207 1 100 0.00 0.0121593164 FORMAT "%12.10" ECU_ADDRESS 0x6000F72B /end MEASUREMENT
/begin MEASUREMENT lamsbgm_w_msg "Mean value of the limited desired lambda of bank 1 and bank 2" UWORD fak_uw_b16 1 100 0.00 15.99976 FORMAT "%8.5" ECU_ADDRESS 0x60008D60 /end MEASUREMENT
/begin MEASUREMENT mdmnte_w "Minimum band optimum torque for TEV" UWORD rel_uw_b100 1 100 0.00 99.99847 FORMAT "%8.5" ECU_ADDRESS 0x60007550 /end MEASUREMENT
/begin MEASUREMENT mdmxte_w "Maximum band optimum torque for TEV" UWORD rel_uw_b100 1 100 0.00 99.99847 FORMAT "%8.5" ECU_ADDRESS 0x6000754E /end MEASUREMENT
/begin MEASUREMENT mdteh_w "optimum torque for TEV" UWORD rel_uw_b100 1 100 0.00 99.99847 FORMAT "%8.5" ECU_ADDRESS 0x6000754C /end MEASUREMENT
/begin MEASUREMENT mimnteh_w_msg "Request min torque for TEV (high load)" UWORD rel_uw_b100 1 100 0.00 99.99847 FORMAT "%8.5" ECU_ADDRESS 0x60008D4C /end MEASUREMENT
/begin MEASUREMENT mimxteh_w_msg "Request max torque for TEV (high load)" UWORD rel_uw_b100 1 100 0.00 99.99847 FORMAT "%8.5" ECU_ADDRESS 0x60008D4A /end MEASUREMENT
/begin MEASUREMENT mksbg_msg "fuel mass flow calculated from air mass flow filtered (ml_w) and Desired Lambda limitation (lamsbg_w)" UBYTE m_ub_b25p6 1 100 0.00 25.50 FORMAT "%5.2" ECU_ADDRESS 0x6000F72A /end MEASUREMENT
/begin MEASUREMENT mleitmx_w "max. purge mass in line PCV manifold" UWORD m_q2p71267Em5 1 100 0.00 1.777751 FORMAT "%8.6" ECU_ADDRESS 0x600075A8 /end MEASUREMENT
/begin MEASUREMENT mleit_w "purge mass in line PCV manifold" UWORD m_q2p71267Em5 1 100 0.00 1.777751 FORMAT "%8.6" ECU_ADDRESS 0x600075A6 /end MEASUREMENT
/begin MEASUREMENT msndkoos_w "normed air mass flow for desired value of throttle blade" UWORD m_uw_b6553p5 1 100 0.00 6553.500 FORMAT "%8.3" ECU_ADDRESS 0x7000509A /end MEASUREMENT
/begin MEASUREMENT msndks_w_msg "normed set air mass flow through throttling valve" UWORD m_uw_b6553p5 1 100 0.00 6553.500 FORMAT "%8.3" ECU_ADDRESS 0x700050AC /end MEASUREMENT
/begin MEASUREMENT msntesol_w_msg "standardized mass flow through CPV" UWORD m_uw_b25p6 1 100 0.00 25.59961 FORMAT "%8.5" ECU_ADDRESS 0x60009318 /end MEASUREMENT
/begin MEASUREMENT msntes_w_msg "standardized mass flow from canister purge control" UWORD m_uw_b25p6 1 100 0.00 25.59961 FORMAT "%8.5" ECU_ADDRESS 0x6000931A /end MEASUREMENT
/begin MEASUREMENT msotdiag_w "local variable for standardized mass flow through CPV" UWORD m_uw_b25p6 1 100 0.00 25.59961 FORMAT "%8.5" ECU_ADDRESS 0x600075A2 /end MEASUREMENT
/begin MEASUREMENT mssgin1_w_msg "mass flow into manifold (through throttle and PCV) in Bank1" UWORD m_uw_b6553p5 1 100 0.00 6553.500 FORMAT "%8.3" ECU_ADDRESS 0x60009310 /end MEASUREMENT
/begin MEASUREMENT mssgout1_w_msg "mass flow out of manifold (through throttle and PCV + EGR) in Bank1" UWORD m_uw_b6553p5 1 100 0.00 6553.500 FORMAT "%8.3" ECU_ADDRESS 0x6000930E /end MEASUREMENT
/begin MEASUREMENT mste1_w_msg "mass flow purge control into the manifold" UWORD m_uw_b25p6 1 100 0.00 25.59961 FORMAT "%8.5" ECU_ADDRESS 0x6000930C /end MEASUREMENT
/begin MEASUREMENT mstedte1_w_msg "purge mass flow for DTEV (word) (1st CPV)" UWORD m_uw_b25p6 1 100 0.00 25.59961 FORMAT "%8.5" ECU_ADDRESS 0x60009308 /end MEASUREMENT
/begin MEASUREMENT mstedte_w_msg "purge mass flow for DTEV (word)" UWORD m_uw_b25p6 1 100 0.00 25.59961 FORMAT "%8.5" ECU_ADDRESS 0x60009306 /end MEASUREMENT
/begin MEASUREMENT msteo_w_msg "Mass flow the 100 % opened TEV" UWORD m_uw_b25p6 1 100 0.00 25.59961 FORMAT "%8.5" ECU_ADDRESS 0x60009304 /end MEASUREMENT
/begin MEASUREMENT mstesmxi_w "Input signal of low pass filter for max. possible desired purge mass flow(mstesmx_w)" UWORD m_uw_b25p6 1 100 0.00 25.59961 FORMAT "%8.5" ECU_ADDRESS 0x60007580 /end MEASUREMENT
/begin MEASUREMENT mstesmx_w "max. possible desired purge mass flow" UWORD m_uw_b25p6 1 100 0.00 25.59961 FORMAT "%8.5" ECU_ADDRESS 0x6000757E /end MEASUREMENT
/begin MEASUREMENT mstesnc_w_msg "max. massflow over CPV, limited during engine mode switchover" UWORD m_uw_b25p6 1 100 0.00 25.59961 FORMAT "%8.5" ECU_ADDRESS 0x60009302 /end MEASUREMENT
/begin MEASUREMENT mstesold_w "old desired purge mass flow" UWORD m_uw_b25p6 1 100 0.00 25.59961 FORMAT "%8.5" ECU_ADDRESS 0x6000757C /end MEASUREMENT
/begin MEASUREMENT mstesoll_w_msg "desired purge mass flow" UWORD m_uw_b25p6 1 100 0.00 25.59961 FORMAT "%8.5" ECU_ADDRESS 0x60009300 /end MEASUREMENT
/begin MEASUREMENT mstesr_w "Mass flow manifold" UWORD m_uw_b25p6 1 100 0.00 25.59961 FORMAT "%8.5" ECU_ADDRESS 0x600075A4 /end MEASUREMENT
/begin MEASUREMENT mste_w_msg "mass flow purge control into the manifold" UWORD m_uw_b25p6 1 100 0.00 25.59961 FORMAT "%8.5" ECU_ADDRESS 0x6000930A /end MEASUREMENT
/begin MEASUREMENT nmnteh_w_msg "requested operating conditions: min. engine speed for canister purge system (high load)" UWORD nmot_uw_q0p25 1 100 0.00 16383.75 FORMAT "%8.2" ECU_ADDRESS 0x60008D40 /end MEASUREMENT
/begin MEASUREMENT nmntes_w_msg "requested operating conditions: min. engine speed for canister purge system (diagnosis)" UWORD nmot_q0p25 1 100 0.00 16383.75 FORMAT "%8.2" ECU_ADDRESS 0x60008D3E /end MEASUREMENT
/begin MEASUREMENT nmotavar "Rotational speed data array" UWORD nmot_q10 1 100 0.00 655350.0 FORMAT "%8.1" ARRAY_SIZE 6 ECU_ADDRESS 0x600075E4 /end MEASUREMENT
/begin MEASUREMENT nmotold "Previous rotational speed" UBYTE nmot_q10 1 100 0.00 2550. FORMAT "%5.0" ECU_ADDRESS 0x6000B89C /end MEASUREMENT
/begin MEASUREMENT nmxftiv_w "Request max nmot_w for FTIV-System" UWORD nmot_q0p25 1 100 0.00 16383.75 FORMAT "%8.2" ECU_ADDRESS 0x6000754A /end MEASUREMENT
/begin MEASUREMENT nmxteh_w_msg "requested operating conditions: max. engine speed for canister-purge-system (high load)" UWORD nmot_uw_q0p25 1 100 0.00 16383.75 FORMAT "%8.2" ECU_ADDRESS 0x60008D3A /end MEASUREMENT
/begin MEASUREMENT nmxtes_w_msg "Request max nmot_w for DTEV" UWORD nmot_q0p25 1 100 0.00 16383.75 FORMAT "%8.2" ECU_ADDRESS 0x60008D38 /end MEASUREMENT
/begin MEASUREMENT pdiff_w "difference pressure between CPV-line and environment" SWORD p_sw_q0p039 1 100 -1280.000 1279.961 FORMAT "%8.3" ECU_ADDRESS 0x60007598 /end MEASUREMENT
/begin MEASUREMENT PEnvfacCorrAlti_fho "Temporary variable before KLTEINIFHO" UBYTE fak_ub_b4 1 100 0.00 3.984 FORMAT "%5.3" ECU_ADDRESS 0x6000B87F /end MEASUREMENT
/begin MEASUREMENT PEnv_pu "Temporary variable for y-input of KFTETPU" UBYTE p_ub_q5 1 100 0.00 1275. FORMAT "%5.0" ECU_ADDRESS 0x6000B893 /end MEASUREMENT
/begin MEASUREMENT phurgen "physical urgency Canister Purge" UBYTE dez 1 100 0.00 255.0 FORMAT "%5.1" ECU_ADDRESS 0x6000B892 /end MEASUREMENT
/begin MEASUREMENT priobbora_msg "priority of requested operating conditions for additive fuel mixture adaptation" UBYTE dez 1 100 0.00 255.0 FORMAT "%5.1" ECU_ADDRESS 0x6000F724 /end MEASUREMENT
/begin MEASUREMENT priobbteh_msg "priority of requested operating conditions for canister purge system with high canister load" UBYTE dez 1 100 0.00 255.0 FORMAT "%5.1" ECU_ADDRESS 0x6000F723 /end MEASUREMENT
/begin MEASUREMENT priobbtes_msg "priority of requested operating conditions for canister purge valve diagnosis" UBYTE dez 1 100 0.00 255.0 FORMAT "%5.1" ECU_ADDRESS 0x6000F722 /end MEASUREMENT
/begin MEASUREMENT qltefil "Degree of being filled with purge gas of line PCV-manifold" UBYTE fak_ub_b1 1 100 0.00 0.9961 ECU_ADDRESS 0x6000B88D /end MEASUREMENT
/begin MEASUREMENT qmsdyn "Quotient from mass flow into manifold (mssgin_w_msg) and mass flow out of manifold (mssgout_w_msg)" UBYTE fak_ub_b16 1 100 0.00 15.94 FORMAT "%5.2" ECU_ADDRESS 0x6000B865 /end MEASUREMENT
/begin MEASUREMENT qtetemin_msg "quotient: te TEMIN for BDE teh_wteminh_w resp. tes_wtemins_w" UBYTE fak_ub_b4 1 100 0.00 3.984 FORMAT "%5.3" ECU_ADDRESS 0x6000FB2C /end MEASUREMENT
/begin MEASUREMENT rkgb_w "relative fuel mass total used for limitation" UWORD rel_uw_b3072 1 100 0.00 3071.953 FORMAT "%8.3" ECU_ADDRESS 0x6000755A /end MEASUREMENT
/begin MEASUREMENT rkg_old_w "relative fuel mass total old value" UWORD rel_uw_b3072 1 100 0.00 3071.953 FORMAT "%8.3" ECU_ADDRESS 0x60007558 /end MEASUREMENT
/begin MEASUREMENT rkte_w_msg "relative fuel part of the purge control" SWORD rel_sw_q0p0468 1 100 -1536.000 1535.953 FORMAT "%8.3" ECU_ADDRESS 0x50005F14 /end MEASUREMENT
/begin MEASUREMENT rlmntes_w_msg "Request min rl_w for DTEV" UWORD rel_q0p0234 1 100 0.00 1535.977 FORMAT "%8.3" ECU_ADDRESS 0x60008D24 /end MEASUREMENT
/begin MEASUREMENT rlmxtes_w_msg "Request max rl_w for DTEV" UWORD rel_q0p0234 1 100 0.00 1535.977 FORMAT "%8.3" ECU_ADDRESS 0x60008D1E /end MEASUREMENT
/begin MEASUREMENT rltevol_w_msg "Relative air charge with Pressure compensation" UWORD rel_uw_b100 1 100 0.00 99.99847 FORMAT "%8.5" ECU_ADDRESS 0x600092C6 /end MEASUREMENT
/begin MEASUREMENT rpmdatactr "Counter for data recorded in the observation window" UBYTE dez 1 100 0.00 6.000 FORMAT "%5.3" ECU_ADDRESS 0x6000B89B /end MEASUREMENT
/begin MEASUREMENT teini "Y-input (ambient air temperature, engine temperature or the model temperature for fuel) to the map KFTEINI" UBYTE temp_ub_q0p75_o48 1 100 -48.0 143.3 FORMAT "%5.1" ECU_ADDRESS 0x6000B87E /end MEASUREMENT
/begin MEASUREMENT tfteini_w "time for detection of purge stop" UWORD t_q0p1 1 100 0.00 6553.500 FORMAT "%8.3" ECU_ADDRESS 0x60007588 /end MEASUREMENT
/begin MEASUREMENT TiEngOff_ti_loc "local variable to determine engine off time" UWORD t_q1 1 100 0.00 65535.00 FORMAT "%8.2" ECU_ADDRESS 0x60007564 /end MEASUREMENT
/begin MEASUREMENT umsnmsok_w "Conversion of standardized mass flow into mass flow at throttle blade without KLAF-correction" UWORD fak_uw_b8 1 100 0.00 7.999878 FORMAT "%8.6" ECU_ADDRESS 0x7000509C /end MEASUREMENT
/begin MEASUREMENT umsnmsug_w "Conversion of standardized mass flow into mass flow at throttle blade (UGD)" UWORD fak_uw_b8 1 100 0.00 7.999878 FORMAT "%8.6" ECU_ADDRESS 0x7000509E /end MEASUREMENT
/begin MEASUREMENT wdkhfu_w "throttle <) calculated from unthrottled mass flow of main charging sensor" UWORD rel_uw_b100 1 100 0.00 99.99847 FORMAT "%8.5" ECU_ADDRESS 0x700050A0 /end MEASUREMENT
/begin MEASUREMENT wdkhf_w_msg "throttle angle calculated from main charging sensor" UWORD rel_uw_b100 1 100 0.00 99.99847 FORMAT "%8.5" ECU_ADDRESS 0x6000152A /end MEASUREMENT
/begin MEASUREMENT wdkobugs_w "nominal throttle angle from torque structure not imited by unthrottled angle" UWORD rel_uw_b100 1 100 0.00 99.99847 FORMAT "%8.5" ECU_ADDRESS 0x700050A2 /end MEASUREMENT
/begin MEASUREMENT wdkoufs_w "desired throttle valve angle without WOT filter" UWORD rel_uw_b100 1 100 0.00 99.99847 FORMAT "%8.5" ECU_ADDRESS 0x700050A4 /end MEASUREMENT
/begin MEASUREMENT wdkrohs_w_msg "desired throttle position" UWORD rel_uw_b100 1 100 0.00 99.99847 FORMAT "%8.5" ECU_ADDRESS 0x60001526 /end MEASUREMENT
/begin MEASUREMENT wdksba2_w "Throttle-valve target angle after limiting, value from computing schedule n-2" UWORD rel_uw_b100 1 100 0.00 99.99847 FORMAT "%8.5" ECU_ADDRESS 0x60000F38 /end MEASUREMENT
/begin MEASUREMENT wdksba_w "Throttle-valve target angle after limiting, value from computing schedule n-1" UWORD rel_uw_b100 1 100 0.00 99.99847 FORMAT "%8.5" ECU_ADDRESS 0x60000F36 /end MEASUREMENT
/begin MEASUREMENT wdksb_w "Throttle-valve target angle after limiting" UWORD rel_uw_b100 1 100 0.00 99.99847 FORMAT "%8.5" ECU_ADDRESS 0x60000F34 /end MEASUREMENT
/begin MEASUREMENT wdksgvin_w "nominal throttle valve angle - entrance in low pass filter" UWORD rel_uw_b100 1 100 0.00 99.99847 FORMAT "%8.5" ECU_ADDRESS 0x60000F32 /end MEASUREMENT
/begin MEASUREMENT wdksgv_w_msg "desired throttle blade before application interface( filtered)" UWORD rel_uw_b100 1 100 0.00 99.99847 FORMAT "%8.5" ECU_ADDRESS 0x700050BC /end MEASUREMENT
/begin MEASUREMENT wdksof_w_msg "nominal throttle valve angle without median filter" UWORD rel_uw_b100 1 100 0.00 99.99847 FORMAT "%8.5" ECU_ADDRESS 0x700050BE /end MEASUREMENT
/begin MEASUREMENT wdkspverz_w "Praedizierter Drosselklappen-Sollwinkel nach der Verzögerung" UWORD rel_uw_b100 1 100 0.00 99.99847 FORMAT "%8.5" ECU_ADDRESS 0x700050A6 /end MEASUREMENT
/begin MEASUREMENT wdksp_w_msg "predicted desired throttle angle" UWORD rel_uw_b100 1 100 0.00 99.99847 FORMAT "%8.5" ECU_ADDRESS 0x60001520 /end MEASUREMENT
/begin MEASUREMENT wdks_msg "desired throttle angle w.r.t. to lower mechanical stop" UBYTE relDK_ub_b100 1 100 0.00 100.0 FORMAT "%5.1" ECU_ADDRESS 0x700050C1 /end MEASUREMENT
/begin MEASUREMENT wdks_w_msg "desired throttle angle w.r.t. to lower mechanical stop" UWORD relDK_uw_b100 1 100 0.00 100.0000 FORMAT "%8.4" ECU_ADDRESS 0x60001524 /end MEASUREMENT
/begin MEASUREMENT wdkugd_w_msg "Throttle valve angle during which 95% charge is reached" UWORD rel_uw_b100 1 100 0.00 99.99847 FORMAT "%8.5" ECU_ADDRESS 0x60000D40 /end MEASUREMENT
/begin MEASUREMENT wdkugtn_w_msg "throttle valve angle at which the 95 charge is through minimum tolerance" UWORD rel_uw_b100 1 100 0.00 99.99847 FORMAT "%8.5" ECU_ADDRESS 0x6000151E /end MEASUREMENT
/begin MEASUREMENT wdkugtx_w_msg "throttle valve angle at which the 95% charge is through maximum tolerance" UWORD rel_uw_b100 1 100 0.00 99.99847 FORMAT "%8.5" ECU_ADDRESS 0x6000151C /end MEASUREMENT
/begin MEASUREMENT wkwposit_w "Crankshaft angle" UWORD kw_q0p1 1 100 0.00 6553.500 FORMAT "%8.3" ECU_ADDRESS 0x600075E2 /end MEASUREMENT
/begin FUNCTION FMA2CE "30001.52.0_1.2.0Adapter Fuel Mixture Adaptation to Coordination Engine"
 /begin DEF_CHARACTERISTIC CWLRASTO CWLRASTO2 CWOSSDABBR FlMA_facEvapThdMax_T FLMA_nrMaxStrtVDpd_C TENSOSSDMN_L TMNFRAOSRQ TMSTOSSDMX TOSSDCYMX VFZGBBORA /end DEF_CHARACTERISTIC
 /begin REF_CHARACTERISTIC DVFUBOERW PHUORAHP /end REF_CHARACTERISTIC
 /begin IN_MEASUREMENT B_avora_msg B_balra_msg B_eora_msg B_fdgser_msg B_frastab_msg B_fvlra_msg B_gaenres_msg B_gaeora_msg B_lrabstv_msg B_lrafra_msg B_noora_msg B_orastab_msg B_reqlra_msg B_ubpoerw_msg CEngDsT_tStrtFrst Epm_nEngLRes fgausmx_msg FlMA_flgIninFinshdAckd FlMA_flgIninTrig phuoraloc_msg TiEngOff_tiFirstStrt VehV_v /end IN_MEASUREMENT
 /begin OUT_MEASUREMENT B_pbboerw_msg priobbora_msg /end OUT_MEASUREMENT
 /begin LOC_MEASUREMENT B_framil B_genstopora B_oramil B_orassdcy B_orasspr FlMA_facEvapThdMax FlMA_flgAbortReqOffsAdpn FlMA_flgEnaCdnEngCoorrCoupl FlMA_flgFacErrDeb FlMA_flgFacErrTstd FlMA_flgOffsErrDeb FlMA_flgOffsErrTstd FLMA_nrStrtVDpd FlMA_tiEngOff FMA2CE_AVORASW_I.timeCounter FMA2CE_BALRAFF_I.status FMA2CE_BfdgserFF_I.status FMA2CE_LRAFRATONV_I.outbit FMA2CE_LRAFRATONV_I.time FMA2CE_ORASTPVBCTR_I.counter /end LOC_MEASUREMENT
 FUNCTION_VERSION "30001.52.0_1.2.0" /end FUNCTION
/begin FUNCTION FSTSTRTOFF "3.5.0     Fast starter cut off for direct start"
 /begin DEF_CHARACTERISTIC EngStrt_nEngThdFstCutOff_C KWWINPOSOF NMOTGRDMN NMOTWINMN WINWIDTH /end DEF_CHARACTERISTIC
 /begin REF_CHARACTERISTIC EpmSeq_phiInt_CA /end REF_CHARACTERISTIC
 /begin IN_MEASUREMENT destrange_msg EngStrt_flgDrctStrt Epm_nEngTooth10ms Epm_stSpd Epm_stSync SyC_stSub zwstt_msg /end IN_MEASUREMENT
 /begin OUT_MEASUREMENT B_fastcoff_msg EngStrt_flgStrtAsscFastCutOff /end OUT_MEASUREMENT
 /begin LOC_MEASUREMENT abscissa bslope_w B_inwin B_winleft Engstrt_stReIniFSTSTRTOFF nmotavar nmotold rpmdatactr wkwposit_w /end LOC_MEASUREMENT
 FUNCTION_VERSION "3.5.0" /end FUNCTION
/begin FUNCTION FUEDK "64.2.0    Charge control (calculation of nominal throttle-valve angle)"
 /begin DEF_CHARACTERISTIC ChrCtl_facTCorrnHfmPlst_T ChrCtl_ratThrVlvWotLimnToAvdAfsPlst_M CWFUEDK FKLAFUGD FPWDKAPP KFWDKMSMXN KFWDKMSNVP NMOTCVWDK OFMSNWDKHF TAVDKMNDK TFWDKPSPV VPSRSVDRDU WDKSAPP WDKSOFS /end DEF_CHARACTERISTIC
 /begin REF_CHARACTERISTIC FKVDVP OFMSNDKTN OFMSNDKTX VPSRVDUGD /end REF_CHARACTERISTIC
 /begin IN_MEASUREMENT APP_r B_cwdk_msg B_ethgg_msg B_fpwdkap_msg B_homfes_msg B_hspfes_msg B_kh_msg B_ll_msg B_msdkhfsg_msg B_msudksom_msg B_tfwdksom_msg B_vpdkugd_msg B_wdksap_msg B_wdksg_msg CEngDsT_t cvwdk_msg dfuelsan_w_msg dkpsrmh_w_msg EngStrt_bFrstStrtEnd EngStrt_bStrtEnd Epm_nEng Epm_nEngLRes Epm_stSpd FfPrm_facEth ftpavdn_w_msg ftpavdx_w_msg ftpavd_w_msg ftpvd_w_msg IntkAirT_tIntkMnfld IntkAirT_tThrVlvUs msdkhfs_w_msg msdkmx_w_msg msdks_w_msg msdkugd_w_msg msdkugtn_w_msg msdkugtx_w_msg msdstats_w_msg msudksom_w_msg ofmsndk_w_msg psrdkugd_w_msg psrsldr_w_msg psr_w_msg PthSet_flgCritTqIncPhd pvd_w_msg SyC_stSub tfwdksom_w_msg ummsnms_w_msg vpsrvdb_w_msg vpsrvdk_w_msg wdkmsmx_w_msg wnwve_w_msg wnwvu_w_msg /end IN_MEASUREMENT
 /begin OUT_MEASUREMENT B_dkstrl_msg B_fgdkabgs_msg B_msdksg_msg B_wdkap_msg B_wdkhfg_msg B_wdkhfu_msg B_wdksugd_msg B_wdkuehsp_msg ChrCtl_agDeltaTqToStrt msndks_w_msg wdkhf_w_msg wdkrohs_w_msg wdksgv_w_msg wdksof_w_msg wdkugd_w_msg wdkugtn_w_msg wdkugtx_w_msg /end OUT_MEASUREMENT
 /begin LOC_MEASUREMENT B_dwdksugd B_dwdkugdf ChrCtl_agCamsftLimnHfmPlst ChrCtl_facEthnlCntnt ChrCtl_nEngHfmPlst ChrCtl_ratThrAgLimnToAvdHfmPlst ChrCtl_ratThrVlvWoMdnFilLimd dwdksumx_w dwdksuofna1_w dwdksuofna2_w dwdksuofnasum_w dwdksuof_w msndkoos_w umsnmsok_w umsnmsug_w wdkhfu_w wdkobugs_w wdkoufs_w /end LOC_MEASUREMENT
 FUNCTION_VERSION "64.2.0" /end FUNCTION
/begin FUNCTION FUEDKSA "11.15.0   Influence of air charge by throttle blade, processing throttle-valve angle" /begin DEF_CHARACTERISTIC ChrCtl_nEngCepAg_C DKNOTBEGR DRLSOLMF TVWDKVFZGMX WDKSWE /end DEF_CHARACTERISTIC
 /begin IN_MEASUREMENT B_ll_msg EngStrt_flgCepActv EngStrt_ratAgThrVlvDesCep Epm_nEng Epm_nEngTooth10ms rlfgks_w_msg SyC_stSub ThrVlv_flgSngSensErrB1 tvwdkprs_msg VehV_v wdkrohs_w_msg /end IN_MEASUREMENT
 /begin OUT_MEASUREMENT wdksp_w_msg wdks_msg wdks_w_msg /end OUT_MEASUREMENT
 /begin LOC_MEASUREMENT drlsolmf_w wdksba2_w wdksba_w wdksb_w wdksgvin_w wdkspverz_w /end LOC_MEASUREMENT
 FUNCTION_VERSION "11.15.0" /end FUNCTION
/begin FUNCTION FuPHi_TstrOutp "51.2.0    Fuel high pressure sensor, tester output" /begin IN_MEASUREMENT FuPHi_pRawRel /end IN_MEASUREMENT /begin OUT_MEASUREMENT FuPHi_pPID23 /end OUT_MEASUREMENT FUNCTION_VERSION "51.2.0" /end FUNCTION
/begin FUNCTION FuPurgCmn_Adpr "30301.1.0 Fuel purge common functions adapter" /begin IN_MEASUREMENT IntkAirT_tIntkMnfld SyC_stSub /end IN_MEASUREMENT /begin OUT_MEASUREMENT CstrPurg_tIntkAir /end OUT_MEASUREMENT FUNCTION_VERSION "30301.1.0" /end FUNCTION
/begin FUNCTION FuPurgCmn_LamCdng "30301.2.0 Conditioning Lambda-signals for Fuel Purge Control" /begin DEF_CHARACTERISTIC CstrPurg_stSelnLamRdy_C LAMTEMN /end DEF_CHARACTERISTIC
 /begin IN_MEASUREMENT B_lrs_msg B_mstefg_msg B_sbblsu_msg frm_w_msg lamsons_w_msg lamssok_w_msg lamzak_w_msg SyC_stSub /end IN_MEASUREMENT
 /begin OUT_MEASUREMENT B_lamrb_msg B_rbte_msg fkakormt_w_msg fkakormx_w_msg fkakor_w_msg /end OUT_MEASUREMENT
 /begin LOC_MEASUREMENT CstrPurg_flgReIniTELAM100ms /end LOC_MEASUREMENT
 FUNCTION_VERSION "30301.2.0" /end FUNCTION
/begin FUNCTION FuPurgCmn_SigOutp "30301.2.0 Preparation of FPC-Output Signals for external functions"
 /begin DEF_CHARACTERISTIC BPHUTEB CstrPurg_facImpsCstrLoadMax_T CstrPurg_facImpsCstrLoadMin_C CWFPCPHU FKAKORBMN FKAKORBMX FKATEUMS KFTETPU KLTEMSZ TFGWRTEFV TFKAKORFV ZKFTEADVA ZKFTEADVNA /end DEF_CHARACTERISTIC
 /begin IN_MEASUREMENT B_fteadber_msg B_mwtes_msg B_rkteb_msg B_tei_msg B_ten_msg B_zfra_msg B_zora_msg EngStrt_bStrtEnd EnvT_t fgwrte_msg fkakormt_w_msg fteadf_msg ftead_w_msg InjSys_ratFuM msntetev_w_msg PEnv_p rkte_w_msg SyC_stSub tateout_w_msg /end IN_MEASUREMENT
 /begin OUT_MEASUREMENT B_fvgte_msg B_lrar_msg B_mwte_msg /end OUT_MEASUREMENT
 /begin LOC_MEASUREMENT B_fvfgwrte B_fvfkakormt B_fvftead coumsnte_w CstrPurg_temploc EnvTt_tumg FPCtl_flgReIniTESIGOUT100ms FPCtl_flgReIniTESIGOUT20ms fteadvir PEnv_pu phurgen /end LOC_MEASUREMENT
 FUNCTION_VERSION "30301.2.0" /end FUNCTION
/begin FUNCTION FuPurgCmn_SigPrepn "30301.2.0 Preparation of external Signals for Fuel Purge Control"
 /begin DEF_CHARACTERISTIC CstrPurg_facDftEthGsl_C CstrPurg_facStoiAirFlexfu_T KTEVANMK SMK05TEUB /end DEF_CHARACTERISTIC
 /begin IN_MEASUREMENT FfPrm_facEthCurr FfPrm_flgActv lamsbg_w_msg ml_w_msg qtitimnh_msg rflmorgi_w_msg rfrexroh_w_msg rlfgroh_w_msg SyC_stSub umsrln_w_msg /end IN_MEASUREMENT
 /begin OUT_MEASUREMENT ktevanst_msg lamsbgm_w_msg mksbg_msg mssgin1_w_msg mssgout1_w_msg qtetemin_msg /end OUT_MEASUREMENT
 /begin LOC_MEASUREMENT CstrPurg_facEthGsl CstrPurg_flgReIniTESIGTE100ms CstrPurg_flgReIniTESIGTE20ms /end LOC_MEASUREMENT
 FUNCTION_VERSION "30301.2.0" /end FUNCTION
/begin FUNCTION FuPurgCtrl_ActMFlow "30301.5.0_1.0.0Calculation of Actual Purge Mass Flow"
 /begin DEF_CHARACTERISTIC CstrPurg_facChartcFlowCorrnCpv_M CstrPurg_facChartcMFlowCpv_M CstrPurg_facChartcMFlowHalfEngModCpv_M CstrPurg_facCorrnAltiTCpvMod_T CstrPurg_facLoadCoeff_T CstrPurg_facLoadIni_C CstrPurg_facLoad_M CstrPurg_fakMFlowAcfIni_C CstrPurg_fakMFlowAcfLd_M CstrPurg_fakRadrCoolgIni_C CstrPurg_fakRadrCoolg_M CstrPurg_ratWghtRelAirFillgIni_C CstrPurg_SwtMnfldCpvTMdl_C CstrPurg_tiFakMFlowAcfLd_T CstrPurg_tiFilEtc_M CstrPurg_tiLoadFilt_C CstrPurg_tiRadrCoolgFilt_C CstrPurg_tiWghtRelAirFillgFilt_C CstrPurg_ttadkmax_C CWTEBGTEV FLTEFUEL KAFLTESG KMLTESG /end DEF_CHARACTERISTIC
 /begin REF_CHARACTERISTIC CstrPurg_cwFuPurgCmpDiagCPV_C FTVDKTAVDK /end REF_CHARACTERISTIC
 /begin IN_MEASUREMENT B_dteaa_msg B_tldav_msg B_vheg_msg CstrPurg_tIntkAir EnvT_t ftead_w_msg ftvdk_w_msg msntetev_w_msg msntevo_w_msg mssgin1_w_msg PEnv_facCorrAlti PEnv_p pndkpu_w_msg pndk_w_msg pttp_w_msg rl_w_msg SyC_stSub tadk_w_msg tasrg_w_msg tateout_w_msg VehV_v /end IN_MEASUREMENT
 /begin OUT_MEASUREMENT CstrPurg_mfCpvDteskBlkdLine CstrPurg_mFlowCpv1LoLdPurgLn CstrPurg_mFlowCpv1LoLdPurgLnMod CstrPurg_mFlowCpvLoLdPurgLn CstrPurg_ratPAftCpvToEnv CstrPurg_ratPLoLoadPurgLnToEnv CstrPurg_tCpvMod ftho_w_msg mste1_w_msg mstedte1_w_msg mstedte_w_msg msteo_w_msg mste_w_msg /end OUT_MEASUREMENT
 /begin LOC_MEASUREMENT CstrPurg_facCorrnT CstrPurg_facCorrnTCpvMod CstrPurg_facFlowCpvLoLoad CstrPurg_facFlowCpvLoLoadCda CstrPurg_facFlowCpvTAltiLoLoad CstrPurg_facFlowDutyCycCpv CstrPurg_facLoad CstrPurg_facLoadFilt CstrPurg_facMfCpvDtesk CstrPurg_facWghtLoadCoeff CstrPurg_fakMFlowAcfLd CstrPurg_fakMFlowAcfLdFilt CstrPurg_fakRadrCoolg CstrPurg_fakRadrCoolgFilt CstrPurg_flgReIniTEBGTEV20ms CstrPurg_pAftThr CstrPurg_ratRadShtDes CstrPurg_ratWghtRelAirFillg CstrPurg_ratWghtRelAirFillgFilt CstrPurg_rPMnfTank CstrPurg_tDifThr2Env CstrPurg_tFiltDifThr2Env CstrPurg_tLoadTChgCpv CstrPurg_tRadrCoolgCpv CstrPurg_tThrHeatgCpv CstrPurg_tThrIntAirFilt FPCtl_flgIniDrvTEBGTEV FuPurgCtrl_mFlowCpv1LoLdPurgLnDiag mleitmx_w mleit_w mstesr_w qltefil /end LOC_MEASUREMENT
 FUNCTION_VERSION "30301.5.0_1.0.0" /end FUNCTION
/begin FUNCTION FuPurgCtrl_CoornMFlow "30301.1.0 Coordination of requester for the setpoint of Mass Flow over the CPV" /begin IN_MEASUREMENT B_dtes_msg CstrPurg_mfDiagCpv1w msntes_w_msg SyC_stSub /end IN_MEASUREMENT /begin OUT_MEASUREMENT msntesol_w_msg /end OUT_MEASUREMENT /begin LOC_MEASUREMENT B_otdiag msotdiag_w /end LOC_MEASUREMENT FUNCTION_VERSION "30301.1.0" /end FUNCTION
/begin FUNCTION FuPurgCtrl_DesFuRate "30301.5.0 Calculation of Desired Fuel Rate of the Fuel Purge Control"
 /begin DEF_CHARACTERISTIC CstrPurg_facCpvmfLimHiAlti_T CstrPurg_facDeltaLam_C CstrPurg_facDesFuPartEgsDiagParl_GM CstrPurg_facFilBndyValCtrl_T CstrPurg_facMaxCpvOpenEnvT_T CstrPurg_facMaxCPVOpenNEtc_M CstrPurg_facMaxCPVOpenNLoadExtd_M CstrPurg_facMaxCPVOpenNP_M CstrPurg_facMaxCpvOpndFullLdPFIModEpm_M CstrPurg_IntkAirTDpdtBscPnt_AX CstrPurg_stCpvClsFcoDly_C CstrPurg_stIniTESKSOL_C CstrPurg_tiAgThrFil_C CstrPurg_tiAirChrgFil_C CstrPurg_tiBndyValCtrl_M CstrPurg_tiCpvClsFcoDly_C CWFPCTEN CWFTEVFTEAD CWTEINI FKAPROG FKASTINXH FKATEB FKATEBMFE FSRFKAS IMSRTENL IMSTFTEVMN KFFGWRKA KFFKASVHE KFFKASX KFFTEVFTEADLIM KFHTEKAH KFKASNH KFTEINI KLFTEVFTEAD KLTEINIFHO RIMSFHO RIMSFTEAD SMI04TEUW SMI08TEUW SNM04TEUB TFTEINI TFTEININL TQTEAB TRFTEVFTEAD /end DEF_CHARACTERISTIC
 /begin REF_CHARACTERISTIC CWFPCES SMK05TEUB /end REF_CHARACTERISTIC
 /begin IN_MEASUREMENT B_fvgte_msg B_rkteb_msg B_teakt_msg B_tef_msg B_ten_msg B_vheg_msg CEngDsT_t CoEng_flgCpvClsForFco CstrPurg_tIntkAir EGSDCmn_flgSeg1B1ReldParl EnvT_t Epm_nEng Epm_nEngLRes Epm_stSpd fkakormt_w_msg fteadf_msg ftead_w_msg InjSys_nrInjCyc ktevanst_msg lamsbgm_w_msg lamsons_w_msg misol_w_msg mksbg_msg msntetev_w_msg mssgin1_w_msg mstedte_w_msg msteo_w_msg mste_w_msg PEnv_facCorrAlti PEnv_p pndkpu_w_msg psr_w_msg pvv_w_msg qtetemin_msg rl_w_msg SyC_stSub TiEngOff_bEngRot TiEngOff_stTi TiEngOff_ti wdkba_w_msg /end IN_MEASUREMENT
 /begin OUT_MEASUREMENT B_resims_msg CstrPurg_flgImsteiniNV CstrPurg_flgPurgActv fgwrte_msg fkastes_w_msg fkastexm_w_msg fkaste_msg fkatefrg_w_msg fkatei_msg ftefsoll_w_msg ftevflox_w_msg FuPurgCtrl_mIntglPurgMFlow imsteini_msg /end OUT_MEASUREMENT
 /begin LOC_MEASUREMENT B_resimftiv CstrPurg_facSpcPurgFuAmntLimd CstrPurg_facSpcPurgFuAmntMax CstrPurg_flgIniTESKSOL100ms CstrPurg_flgReIniTESKSOL100ms CstrPurg_flgReIniTESKSOL20ms CstrPurg_flgTiEngOffRst CstrPurg_mMFlowMnfld CstrPurg_ratThrVlv CstrPurg_relAirChrg CstrPurg_tiAftStrt dfkasteold_w dfkaster dfkastes_w dfkasteub fgwrteufld fkakordl fkastes fkastex_w fkastold_w fkasx fteadten_w ftevflxmin_w ftevflxm_w ftevfteadlim_w pdiff_w PEnvfacCorrAlti_fho teini tfteini_w /end LOC_MEASUREMENT
 FUNCTION_VERSION "30301.5.0" /end FUNCTION
/begin FUNCTION FuPurgCtrl_DesMFlow "30301.10.1Calculate desired mass flow of purge control"
 /begin DEF_CHARACTERISTIC CstrPurg_facIntrpnMaxInc_M CstrPurg_mfMaxIncLoAcfLoad_M CstrPurg_mfMaxLimCatWrmActv_M CstrPurg_stMfMaxIncAcfLoad_C CstrPurg_tiMfRmpDwnDft_C CstrPurg_tiMfRmpDwnDiagLoLdPurgLn_C FGWRMSMX FKATEUM KFDMSTES KFTQTEABF KLDMSTES KLFDMSTES MSTEPTEK /end DEF_CHARACTERISTIC
 /begin IN_MEASUREMENT B_dtezamh_msg B_kw_msg B_ll_msg B_mstefg_msg B_mwtes_msg B_tldav_msg CEngDsT_t CstrPurg_flgDiagCpv1DteskLoLoad CstrPurg_flgPurgActv CstrPurg_ratPLoLoadPurgLnToEnv Epm_nEng fgwrte_msg ftead_w_msg ftevflox_w_msg imsteini_msg ktevanst_msg lamsbgm_w_msg mksbg_msg msnstld_w_msg msntevo_w_msg mssgin1_w_msg msteo_w_msg mste_w_msg ptek_w_msg SyC_stSub /end IN_MEASUREMENT
 /begin OUT_MEASUREMENT msntes_w_msg mstesnc_w_msg mstesoll_w_msg /end OUT_MEASUREMENT
 /begin LOC_MEASUREMENT CstrPurg_flgPurgDeactvd CstrPurg_mfDeltaRampDwn CstrPurg_tiMfRmpDwn CstrPurg_tiResMfRmpDwn divtqteabf dmstes_w FPCtl_flgReIniTEMSSOLS20ms mstesmxi_w mstesmx_w mstesold_w /end LOC_MEASUREMENT
 FUNCTION_VERSION "30301.10.1" /end FUNCTION
/begin FUNCTION FuPurgCtrl_EnaCdn "30301.6.0 Enable Condition for Fuel Purge Control"
 /begin DEF_CHARACTERISTIC CstrPurg_cwFuPurgCmpDiagCPV_C CstrPurg_cwRstrtPurg_C CstrPurg_etakhDelta_C CstrPurg_etakhMinEff_C CstrPurg_LambdaEnaMax_C CstrPurg_LambdaEnaMin_C CstrPurg_nEngThd_T CstrPurg_tiInhLamDevMax_C CstrPurg_tIntkAirIdleThd_C CstrPurg_uBattMax_C CstrPurg_uBattMin_C CWFPC CWFPCES CWFPCFELMR CWFPCKH CWFPCMW CWFPCPRIO CWTEGAEOL DRLTELL FPCtl_mfThdCpvFlow_C FTEADRPL FTEADSPH RLTELLMN TEDLKH TEFGAUSG TMSTTE TMTE TSABTE_CUR TTEATMTPA TTEAUS TTEAUSNW TTEGERTE TVATEH TVATEHDTE TVATEL TVATELDTE TVEVLOCTE TVTEB /end DEF_CHARACTERISTIC
 /begin IN_MEASUREMENT BattU_u B_dteaa_msg B_dtezamh_msg B_evloc_msg B_fvgte_msg B_gaenres_msg B_kh_msg B_lamkh_msg B_lamrb_msg B_ll_msg B_mwtes_msg B_rbte_msg B_stoevab_msg B_stopeng_msg B_tldav_msg CEngDsT_t CEngDsT_tStrt CoEng_flgCpvClsForFco CstrPurg_flgTstrReq CstrPurg_tIntkAir Epm_nEng Epm_stSpd etakh_w_msg ExhMod_flgDewPntEndS1B1 fgausmx_msg frm_w_msg fteadf_msg imsteini_msg msntetev_w_msg priobbteh_msg rl_w_msg SyC_stSub tnsez_w_msg tnse_w_msg VehV_v /end IN_MEASUREMENT
 /begin OUT_MEASUREMENT B_avateh_msg B_avatel_msg B_avaten_msg B_frteatmtpa_msg B_fteadh_msg B_gerte_msg B_lteab_msg B_mstefg_msg B_teakt_msg B_tef_msg B_tei_msg B_ten_msg B_te_msg CstrPurg_flgUBattOk /end OUT_MEASUREMENT
 /begin LOC_MEASUREMENT B_lltans b_pyatenloc B_teffv B_telrlei B_tvateh B_tvatel CstrPurg_flgAbrt CstrPurg_flgAbrtCdnCatHeatg CstrPurg_flgBigLamDev CstrPurg_flgCdnFuCutOffDly CstrPurg_flgEnaCdnTiStrtEnd CstrPurg_stAbortReas CstrPurg_stInhbnReas CstrPurg_tiInhLamDev FPCtl_flg100msReIniTEEB FPCtl_flg20msReIniTEEB FPCtl_flgSyncS1ReIniTEEB FuPurgCtrl_flgIdle FuPurgCtrl_TEEBAllLocInjVlvActvTONV_I.outbit FuPurgCtrl_TEEBAllLocInjVlvActvTONV_I.time FuPurgCtrl_TEEBClsdLoopCtrlTOFFV_I.outbit FuPurgCtrl_TEEBClsdLoopCtrlTOFFV_I.time FuPurgCtrl_TEEBCpvClsForFcoTOFFV_I.outbit FuPurgCtrl_TEEBCpvClsForFcoTOFFV_I.time FuPurgCtrl_TEEBHiLoadTONVNM_I.time FuPurgCtrl_TEEBLoLoadTONVNM_I.time /end LOC_MEASUREMENT
 FUNCTION_VERSION "30301.6.0" /end FUNCTION
/begin FUNCTION FuPurgCtrl_LoadAdpn "30301.4.0 Adaption of Load of carbon canister during Fuel Purge Control"
 /begin DEF_CHARACTERISTIC CstrPurg_facFteadMaxOlc_C CstrPurg_facFteadRampDwnOlc_C CstrPurg_facFteadRampUpOlc_C CstrPurg_facPurgCtrlAdapnOffs_T CstrPurg_facPurgRateRednMin_C CstrPurg_facTCorrnFuPurgAdpn_M CstrPurg_flgFteadRampUpActvOlc_M CstrPurg_tiAdpnAuthModChg_C CstrPurg_tiCstrLdAdpnDly_C FBTEFKA FBTEFKAX FTEADBNL FTEADMAX FTEADMINH FTEADRNMN FuPurgCtrl_facCatClngAdpn_M KFFTEAD KFKORMTMOD MSTEFTEAD ZKFTEAD /end DEF_CHARACTERISTIC
 /begin REF_CHARACTERISTIC CWFPCES /end REF_CHARACTERISTIC
 /begin IN_MEASUREMENT B_fvgte_msg B_mwtes_msg B_rkteb_msg B_ten_msg B_te_msg CoEng_flgCpvClsForFco CstrPurg_flgImsteiniNV dfr_w_msg EnvP_p EnvT_t ExhMod_mfExhB1 fgwrte_msg fkakormt_w_msg fkastexm_w_msg fkaste_msg imsteini_msg mksbg_msg msntetev_w_msg SyC_ctPostDrvLeave SyC_stSub TiEngOff_stTi TiEngOff_ti zlamko_msg /end IN_MEASUREMENT
 /begin OUT_MEASUREMENT B_fteadber_msg fteadf_msg fteadf_w_msg ftead_w_msg /end OUT_MEASUREMENT
 /begin LOC_MEASUREMENT CstrPurg_facLamDeMin CstrPurg_flgFteadRampUpActvOlc CstrPurg_flgIniTEADAP100ms CstrPurg_tPurgAdpnCorrn fkakormt_loc fkastexm FPCtl_ctReIniTEADAPPostDrvLeave FuPurgCtrl_LoadAdpndkhckorrIKL_I.memory FuPurgCtrl_LoadAdpnRstIntegFF_I.status FuPurgCtrl_mExhB1 kintftead kintftead_calc_loc kormtmod_w TiEngOff_ti_loc /end LOC_MEASUREMENT
 FUNCTION_VERSION "30301.4.0" /end FUNCTION
/begin FUNCTION FuPurgCtrl_RelFuM "30301.2.0 Calculation of Relative Fuel Mass of the Fuel Purge Control"
 /begin DEF_CHARACTERISTIC CstrPurg_dstMinBnk1LoLoad_C CstrPurg_dstMinLoLoadDiag_C CstrPurg_dstTrvlMFlowLoLd_M CstrPurg_facDilPurgAirLoLoadDiag_T CstrPurg_facDilPurgAirLoLoadPCmp_M CstrPurg_facDilPurgAirLoLoad_M CstrPurg_facDynDilLoLoadBnk1_GT CstrPurg_facDynDlyBnk1LoLoad_GT CstrPurg_nEngMinDlyLoLoad_C CstrPurg_stFuCmpDeact_C CWDTETERK CWTERK FRKTEMN FRKTEMX SQM05TEUB /end DEF_CHARACTERISTIC
 /begin IN_MEASUREMENT B_dteaa_msg CoEng_stMai CstrPurg_mFlowCpvLoLdPurgLn Epm_nEng Epm_nEngLRes ftead_w_msg InjSys_ratFuMTot mssgin1_w_msg mssgout1_w_msg psr_w_msg rl_w_msg umsrln_w_msg /end IN_MEASUREMENT
 /begin OUT_MEASUREMENT B_rkteb_msg rkte_w_msg rltevol_w_msg /end OUT_MEASUREMENT
 /begin LOC_MEASUREMENT CstrPurg_dstNrmBnk1LoLoad CstrPurg_facLamRecprBnk1LoLoadIntkVlv CstrPurg_facLamRecprDlyBnk1LoLoad CstrPurg_ratAirChrg CstrPurg_stFuCmpTERKDeact qmsdyn rkgb_w rkg_old_w /end LOC_MEASUREMENT
 FUNCTION_VERSION "30301.2.0" /end FUNCTION
/begin FUNCTION FuPurgToCoorrEng "30301.5.0 Communication from Fuel Purge Control To Coordinator Engine"
 /begin DEF_CHARACTERISTIC CstrPurg_tiFtivDiagDmtlHiLoad_C CstrPurg_tqMaxRngOptmTqCpv_M CstrPurg_tqMinRngOptmTqCpv_M CWFPC2CE FTEADPRIMN FTEADPRIMX FuPurgCPVDiag_idxEngLd_C FuPurgCPVDiag_stOpmHybStgyReq_C FuPurgHiHCLoad_idxEngLd_C FuPurgHiHCLoad_stOpmHybStgyReq_C FuPurg_facAdpnInhHMBMin_C FuPurg_facAdpnRailPRednMax_C FuPurg_facAdpnRailPRednMin_C FuPurg_facAdpnSpCamsftMax_C KFMOPTE KLFMDTE KLPRTMTEH MIMNTEH MIMXTEH NMDTEMNSPLD NMDTEMXSPLD NMOTDTEMND NMOTDTEMXD NMOTTEHMN NMOTTEHMX PRIOTEH PRIOTES RLDTEMND RLDTEMNSPLD RLDTEMXD RLDTEMXSPLD /end DEF_CHARACTERISTIC
 /begin REF_CHARACTERISTIC KFMIOP /end REF_CHARACTERISTIC
 /begin IN_MEASUREMENT B_cdtes_msg B_priodesk_msg B_te_msg CEngDsT_t CstrPurg_flgDiagCpv1DteskLoLoad CstrPurg_tIntkAir Epm_nEng fmi2trq_w_msg fteadf_msg ftead_w_msg PEnv_facCorrAlti SyC_stSub /end IN_MEASUREMENT
 /begin OUT_MEASUREMENT FuPurg_flgReqRailPRedn FuPurg_flgReqSpCamsft FuPurg_idxEngLd FuPurg_nMaxDes FuPurg_nMaxDesLoad FuPurg_nMinDes FuPurg_nMinDesDiag FuPurg_nMinDesLoad FuPurg_stOpmHybStgyReq FuPurg_stPrioWpDmdHyb FuPurg_stPrioWpDmdHybDiag FuPurg_stPrioWpDmdHybLoad FuPurg_stStopPhdUrgDiag FuPurg_trqInrMaxDes FuPurg_trqInrMaxDesDiag FuPurg_trqInrMaxDesLoad FuPurg_trqInrMinDes FuPurg_trqInrMinDesDiag FuPurg_trqInrMinDesLoad mimnteh_w_msg mimxteh_w_msg nmnteh_w_msg nmntes_w_msg nmxteh_w_msg nmxtes_w_msg priobbteh_msg priobbtes_msg rlmntes_w_msg rlmxtes_w_msg /end OUT_MEASUREMENT
 /begin LOC_MEASUREMENT B_stHEVVal_FPC2CE CEngDsT_t_tmot EpmnEng_nmot fmdte_w FPCtl_flgReIniFPC2CE FPCtl_FPC2CEfteadfHLRSC_I.hysterese FuPurg_flgpriobbteh FuPurg_nEngKfmiop FuPurg_nMaxDesDiag FuPurg_stStrtDmdUrgDiag mdmnte_w mdmxte_w mdteh_w nmxftiv_w /end LOC_MEASUREMENT
 FUNCTION_VERSION "30301.5.0" /end FUNCTION
/begin FUNCTION GbxECU_Co "118.2.0_6SAACoordinator for received CAN messages gearbox"
 /begin DEF_CHARACTERISTIC Com_rTarPlly_C Com_stConvClth_C Com_stConvrClth_T Com_stLCClth_C Com_stLuckUpOpn_C Com_swtGbxConvClth_C Com_TqTMClutch_C_RP GBX_CONVCLTH_CLSDC_RP GBX_CONVCLTH_CTL_C_RP GBX_CONVCLTH_ERROR_C_RP GBX_CONVCLTH_OPN_C_RP /end DEF_CHARACTERISTIC
 /begin IN_MEASUREMENT Com_rConvSlip Com_rTrsmTotFild Com_stFwdRvsCluInfo Com_stLCZone Gbx_stPNPos Gbx_trqOilPmpLos PT_stTraType /end IN_MEASUREMENT
 /begin OUT_MEASUREMENT Com_rTarPlly Com_stConvSlip Gbx_bLuckUpOpn Gbx_stConvClth Gbx_trqConvLos /end OUT_MEASUREMENT
 FUNCTION_VERSION "118.2.0_6SAA" /end FUNCTION
/begin FUNCTION GbxECU_EAT1 "6.2.0_6SAAReception process for the CAN frame EAT1"
 /begin DEF_CHARACTERISTIC Com_ctCRingEAT1_C Com_dEAT1MaxDiff_C Com_dEAT1MaxPer_C Com_numCsumEAT1_C Com_rConvBoostErr_C Com_rConvBoost_C Com_stCVTEngmtInfo_C Com_stIdleStrtStopDispFct_C Com_swtEAT1MonEna_C /end DEF_CHARACTERISTIC
 /begin IN_MEASUREMENT Com_ctCRingEAT1 Com_numCsumEAT1 Com_rConvBoostRaw Com_stCVTEngmtInfo Com_stFrmRxEna Com_stIdleStrtStopDispFct Com_stMon Com_stPreStop Com_stTranStop /end IN_MEASUREMENT
 /begin OUT_MEASUREMENT Com_rConvBoost Com_stEAT1Mon /end OUT_MEASUREMENT
 /begin LOC_MEASUREMENT GbxECU_ctEAT1RngCnt_MP /end LOC_MEASUREMENT
 FUNCTION_VERSION "6.2.0_6SAA" /end FUNCTION
/begin FUNCTION GbxECU_EAT10 "5.2.0_6SAAReception process for the CAN frame EAT10"
 /begin DEF_CHARACTERISTIC Com_dEAT10MaxDiff_C Com_dEAT10MaxPer_C Com_rTrsmTotFild_C Com_swtEAT10MonEna_C Com_vVehTcu_C /end DEF_CHARACTERISTIC
 /begin IN_MEASUREMENT Com_ctCRingEAT10 Com_numCsumEAT10 Com_rTrsmTotFild Com_stFrmRxEna Com_stMon Com_vVehTcu /end IN_MEASUREMENT
 /begin OUT_MEASUREMENT Com_stEAT10Mon /end OUT_MEASUREMENT
 /begin LOC_MEASUREMENT GbxECU_ctEAT10RngCnt_MP /end LOC_MEASUREMENT
 FUNCTION_VERSION "5.2.0_6SAA" /end FUNCTION
/begin FUNCTION GbxECU_EAT11 "3.2.0_6SAAReception process for the CAN frame EAT11" /begin DEF_CHARACTERISTIC Com_dEAT11MaxDiff_C Com_dEAT11MaxPer_C /end DEF_CHARACTERISTIC
 /begin IN_MEASUREMENT Com_ctCRingEAT11 Com_numCsumEAT11 Com_stFrmRxEna Com_stMon Com_vVehSpdCVTCtrl /end IN_MEASUREMENT
 /begin LOC_MEASUREMENT GbxECU_ctEAT11RngCnt_MP /end LOC_MEASUREMENT
 FUNCTION_VERSION "3.2.0_6SAA" /end FUNCTION
/begin FUNCTION GbxECU_EAT12 "2.4.0     Reception process for the CAN frame EAT12"
 /begin DEF_CHARACTERISTIC Com_dEAT12MaxDiff_C Com_dEAT12MaxPer_C Com_dEAT12SigSel_C Com_tiEAT12BusOffTOutDly_C Com_tiEAT12RingCntChkSumDly_C /end DEF_CHARACTERISTIC
 /begin IN_MEASUREMENT Com_ctCRingEAT12 Com_numCsumEAT12 Com_stCANANoBusOff Com_stCfmdNPosn Com_stCfmdPPosnFCAN Com_stFrmRxEna Com_stMon Com_stNotTxDrvgFFCAN SyC_ctPostDrvLeave T15_st /end IN_MEASUREMENT
 /begin OUT_MEASUREMENT Com_stEAT12RingCntChkSumErr Com_stEAT12TOutBusOffErr Com_stRxEAT12ChkSumOk Com_stRxEAT12Deb Com_stRxEAT12RingCntOk /end OUT_MEASUREMENT
 /begin LOC_MEASUREMENT Com_ctReIni10msEAT12 GbxECU_ctEAT12RngCnt_MP /end LOC_MEASUREMENT
 FUNCTION_VERSION "2.4.0" /end FUNCTION
/begin FUNCTION GbxECU_EAT13 "3.5.0     Reception process for the CAN frame EAT13"
 /begin DEF_CHARACTERISTIC Com_dEAT13MaxDiff_C Com_dEAT13MaxPer_C Com_dEAT13SigSel_C Com_tiEAT13BusOffTOutDly_C Com_tiEAT13RingCntChkSumDly_C /end DEF_CHARACTERISTIC
 /begin IN_MEASUREMENT Com_ctCRingEAT13 Com_numCsumEAT13 Com_stCANBNoBusOff Com_stCfmdPPosnPTCAN Com_stFrmRxEna Com_stGearPPosnReqPTCAN Com_stMon Com_stNotTxDrvgFPTCAN SyC_ctPostDrvLeave T15_st /end IN_MEASUREMENT
 /begin OUT_MEASUREMENT Com_stEAT13RingCntChkSumErr Com_stEAT13TOutBusOffErr Com_stRxEAT13ChkSumOk Com_stRxEAT13Deb Com_stRxEAT13RingCntOk /end OUT_MEASUREMENT
 /begin LOC_MEASUREMENT Com_ctReIni10msEAT13 GbxECU_ctEAT13RngCnt_MP /end LOC_MEASUREMENT
 FUNCTION_VERSION "3.5.0" /end FUNCTION
/begin FUNCTION GbxECU_EAT2 "6.4.0     Reception process for the CAN frame EAT2"
 /begin DEF_CHARACTERISTIC Com_ctCRingEAT2_C Com_dEAT2MaxDiff_C Com_dEAT2MaxPer_C Com_numCsumEAT2_C Com_swtEAT2MonEna_C /end DEF_CHARACTERISTIC
 /begin IN_MEASUREMENT Com_ctCRingEAT2 Com_flgExecdManMod Com_numCsumEAT2 Com_stFrmRxEna Com_stLCZone Com_stMon Com_stVSAInh /end IN_MEASUREMENT
 /begin OUT_MEASUREMENT Com_stEAT2Mon /end OUT_MEASUREMENT
 /begin LOC_MEASUREMENT GbxECU_ctEAT2RngCnt_MP /end LOC_MEASUREMENT
 FUNCTION_VERSION "6.4.0" /end FUNCTION
/begin FUNCTION GbxECU_EAT4 "13.3.0_6SAAReception process for the CAN frame EAT4"
 /begin DEF_CHARACTERISTIC Com_bTSCIntvSlowTrsmFail_C Com_bTSCIntvSlow_C Com_ctCRingEAT4_C Com_dEAT4MaxDiff_C Com_dEAT4MaxPer_C Com_ErrDeb_FailSafeA_TmrEAT4_C Com_numCsumEAT4_C Com_swtEAT4MonEna_C Com_tiEAT4PreErr_C Gbx_trqOilPmpLos_C Gbx_trqTSCIntvSlowTrsmFail_C Gbx_trqTSCIntvSlow_FailSafeA_C Gbx_trqTSCIntvSlow_FailSafeB_C /end DEF_CHARACTERISTIC
 /begin IN_MEASUREMENT Com_bTSCIntvSlow Com_ctCRingEAT4 Com_numCsumEAT4 Com_stFrmRxEna Com_stMon Com_stTMTqDwnReq Com_stTrsmFailMod Com_trqEATReq Gbx_trqOilPmpLos Gbx_trqTSCIntvSlow /end IN_MEASUREMENT
 /begin OUT_MEASUREMENT Com_bTSCIntvFast Com_stComEAT4 Com_stEAT4Mon Gbx_trqTSCIntvFast /end OUT_MEASUREMENT
 /begin LOC_MEASUREMENT Com_tiEAT4PreErr_MP GbxECU_ctEAT4RngCnt_MP /end LOC_MEASUREMENT
 FUNCTION_VERSION "13.3.0_6SAA" /end FUNCTION
/begin FUNCTION GbxECU_EAT6 "5.3.0_6SAAReception process for the CAN frame EAT6"
 /begin DEF_CHARACTERISTIC Com_dEAT6MaxDiff_C Com_dEAT6MaxPer_C Com_dEAT6SigSel_C Com_swtEAT6MonEna_C /end DEF_CHARACTERISTIC
 /begin IN_MEASUREMENT Com_ctCRingEAT6 Com_numCsumEAT6 Com_stATFTVal Com_stFrmRxEna Com_stMon Gbx_tOilConv /end IN_MEASUREMENT
 /begin OUT_MEASUREMENT Com_stEAT6Mon /end OUT_MEASUREMENT
 /begin LOC_MEASUREMENT GbxECU_ctEAT6RngCnt_MP /end LOC_MEASUREMENT
 FUNCTION_VERSION "5.3.0_6SAA" /end FUNCTION
/begin COMPU_METHOD B_TRUE "" TAB_VERB "%6.3" "" COMPU_TAB_REF B_TRUE /end COMPU_METHOD
/begin COMPU_VTAB B_TRUE "" TAB_VERB 2 0 "FALSE" 1 "TRUE" /end COMPU_VTAB
/begin COMPU_METHOD Com_Fact_b0p00006 "" RAT_FUNC "%7.6" "-" COEFFS 0 16384 0 0 0 1 /end COMPU_METHOD
/begin COMPU_METHOD CrCtlSlipRat "" RAT_FUNC "%6.4" "%" COEFFS 0 200 0 0 0 1 /end COMPU_METHOD
/begin COMPU_METHOD dez "" RAT_FUNC "%6.2" "" COEFFS 0 1 0 0 0 1 /end COMPU_METHOD
/begin COMPU_METHOD EngN "" RAT_FUNC "%6.3" "rpm" COEFFS 0 2 0 0 0 1 /end COMPU_METHOD
/begin COMPU_METHOD EngN_LRes "" RAT_FUNC "%6.1" "rpm" COEFFS 0 0.025 0 0 0 1 /end COMPU_METHOD
/begin COMPU_METHOD Fact_2pwr11 "" RAT_FUNC "%6.5" "-" COEFFS 0 2048 0 0 0 1 /end COMPU_METHOD
/begin COMPU_METHOD fak1_q1p63Em5 "" RAT_FUNC "%7.6" "[g*K]/hPa" COEFFS 0 61440 0 0 0 1 /end COMPU_METHOD
/begin COMPU_METHOD fak1_q4p3945Em4 "" RAT_FUNC "%6.5" "[kg/h]/g" COEFFS 0 65536 0 0 0 28.8 /end COMPU_METHOD
/begin COMPU_METHOD fak_q0p000488 "" RAT_FUNC "%6.5" "-" COEFFS 0 65536 0 0 0 32 /end COMPU_METHOD
/begin COMPU_METHOD fak_q0p0009766 "" RAT_FUNC "%6.5" "-" COEFFS 0 65536 0 0 0 64 /end COMPU_METHOD
/begin COMPU_METHOD fak_q0p00195 "" RAT_FUNC "%6.4" "-" COEFFS 0 65536 0 0 0 128 /end COMPU_METHOD
/begin COMPU_METHOD fak_q0p0078 "" RAT_FUNC "%6.4" "-" COEFFS 0 128 0 0 0 1 /end COMPU_METHOD
/begin COMPU_METHOD fak_q0p5 "" RAT_FUNC "%6.3" "-" COEFFS 0 1 0 0 0 0.5 /end COMPU_METHOD
/begin COMPU_METHOD fak_q3p0518Em5 "" RAT_FUNC "%7.6" "" COEFFS 0 32768 0 0 0 1 /end COMPU_METHOD
/begin COMPU_METHOD fak_sb_b1 "" RAT_FUNC "%6.4" "-" COEFFS 0 256 0 0 0 2 /end COMPU_METHOD
/begin COMPU_METHOD fak_sb_b16 "" RAT_FUNC "%6.3" "-" COEFFS 0 256 0 0 0 32 /end COMPU_METHOD
/begin COMPU_METHOD fak_sb_b64 "" RAT_FUNC "%6.3" "-" COEFFS 0 256 0 0 0 128 /end COMPU_METHOD
/begin COMPU_METHOD fak_sw_b1 "" RAT_FUNC "%7.6" "-" COEFFS 0 65536 0 0 0 2 /end COMPU_METHOD
/begin COMPU_METHOD fak_sw_b4 "" RAT_FUNC "%6.5" "-" COEFFS 0 65536 0 0 0 8 /end COMPU_METHOD
/begin COMPU_METHOD fak_sw_b64 "" RAT_FUNC "%6.4" "-" COEFFS 0 65536 0 0 0 128 /end COMPU_METHOD
/begin COMPU_METHOD fak_ub_b0p5 "" RAT_FUNC "%6.4" "-" COEFFS 0 256 0 0 0 0.5 /end COMPU_METHOD
/begin COMPU_METHOD fak_ub_b1 "" RAT_FUNC "%6.4" "-" COEFFS 0 256 0 0 0 1 /end COMPU_METHOD
/begin COMPU_METHOD fak_ub_b16 "" RAT_FUNC "%6.4" "-" COEFFS 0 256 0 0 0 16 /end COMPU_METHOD
/begin COMPU_METHOD fak_ub_b2 "" RAT_FUNC "%8.5" "-" COEFFS 0 256 0 0 0 2 /end COMPU_METHOD
/begin COMPU_METHOD fak_ub_b4 "" RAT_FUNC "%6.4" "-" COEFFS 0 256 0 0 0 4 /end COMPU_METHOD
/begin COMPU_METHOD fak_ub_b64 "" RAT_FUNC "%6.3" "-" COEFFS 0 256 0 0 0 64 /end COMPU_METHOD
/begin COMPU_METHOD fak_ub_b8 "" RAT_FUNC "%6.4" "-" COEFFS 0 256 0 0 0 8 /end COMPU_METHOD
/begin COMPU_METHOD fak_uw_b0p5 "" RAT_FUNC "%8.7" "-" COEFFS 0 65536 0 0 0 0.5 /end COMPU_METHOD
/begin COMPU_METHOD fak_uw_b1 "" RAT_FUNC "%7.6" "-" COEFFS 0 65536 0 0 0 1 /end COMPU_METHOD
/begin COMPU_METHOD fak_uw_b128 "" RAT_FUNC "%6.4" "-" COEFFS 0 65536 0 0 0 128 /end COMPU_METHOD
/begin COMPU_METHOD fak_uw_b16 "" RAT_FUNC "%6.5" "-" COEFFS 0 65536 0 0 0 16 /end COMPU_METHOD
/begin COMPU_METHOD fak_uw_b2 "" RAT_FUNC "%7.6" "-" COEFFS 0 65536 0 0 0 2 /end COMPU_METHOD
/begin COMPU_METHOD fak_uw_b4 "" RAT_FUNC "%7.6" "-" COEFFS 0 65536 0 0 0 4 /end COMPU_METHOD
/begin COMPU_METHOD fak_uw_b8 "" RAT_FUNC "%6.5" "-" COEFFS 0 65536 0 0 0 8 /end COMPU_METHOD
/begin COMPU_METHOD kw_q0p0156 "" RAT_FUNC "%6.4" "Grad KW" COEFFS 0 64 0 0 0 1 /end COMPU_METHOD
/begin COMPU_METHOD kw_q0p1 "" RAT_FUNC "%6.3" "Grad KW" COEFFS 0 10 0 0 0 1 /end COMPU_METHOD
/begin COMPU_METHOD mgrad_q0p400001 "" RAT_FUNC "%6.3" "kg/h" COEFFS 0 195312 0 0 0 78125 /end COMPU_METHOD
/begin COMPU_METHOD MIXADPNRNGNRPNTS_SC_Compu "" RAT_FUNC "%6.2" "" COEFFS 0 1 0 0 0 1 /end COMPU_METHOD
/begin COMPU_METHOD MIXADPNSPDVBL_SC_Compu "" TAB_VERB "%6.3" "" COMPU_TAB_REF MIXADPNSPDVBL_SC_Compu /end COMPU_METHOD
/begin COMPU_VTAB MIXADPNSPDVBL_SC_Compu "" TAB_VERB 2 0 "False" 1 "True" /end COMPU_VTAB
/begin COMPU_METHOD MIXCORRNTQ_SC_Compu "" TAB_VERB "%6.3" "" COMPU_TAB_REF MIXCORRNTQ_SC_Compu /end COMPU_METHOD
/begin COMPU_VTAB MIXCORRNTQ_SC_Compu "" TAB_VERB 2 0 "0" 1 "1" /end COMPU_VTAB
/begin COMPU_METHOD MMSBKVSR_SY_Compu "" TAB_VERB "%6.3" "" COMPU_TAB_REF MMSBKVSR_SY_Compu /end COMPU_METHOD
/begin COMPU_VTAB MMSBKVSR_SY_Compu "" TAB_VERB 2 0 "False" 1 "True" /end COMPU_VTAB
/begin COMPU_METHOD MOCCPU_IT_SY_Compu "" TAB_VERB "%6.3" "" COMPU_TAB_REF MOCCPU_IT_SY_Compu /end COMPU_METHOD
/begin COMPU_VTAB MOCCPU_IT_SY_Compu "" TAB_VERB 7 0 "CHISTE" 1 "FIT" 2 "OTCG" 3 "CHISTEundOTCG" 4 "FITundOTCG" 5 "Lock-Step" 6 "HW_CMPBL_SOLN" /end COMPU_VTAB
/begin COMPU_METHOD MOCFC_GTMCLKMON_SC_Compu "" TAB_VERB "%6.3" "" COMPU_TAB_REF MOCFC_GTMCLKMON_SC_Compu /end COMPU_METHOD
/begin COMPU_VTAB MOCFC_GTMCLKMON_SC_Compu "" TAB_VERB 2 0 "False" 1 "True" /end COMPU_VTAB
/begin COMPU_METHOD MOCFC_GTMCONNTYP_SC_Compu "" TAB_VERB "%6.3" "" COMPU_TAB_REF MOCFC_GTMCONNTYP_SC_Compu /end COMPU_METHOD
/begin COMPU_VTAB MOCFC_GTMCONNTYP_SC_Compu "" TAB_VERB 2 0 "PORT" 1 "AUX_IN" /end COMPU_VTAB
/begin COMPU_METHOD MOCFC_NRCYCBLK_SC_Compu "" RAT_FUNC "%6.2" "" COEFFS 0 1 0 0 0 1 /end COMPU_METHOD
/begin COMPU_METHOD MOCFC_NRFASTCYCBLK_SC_Compu "" RAT_FUNC "%6.2" "" COEFFS 0 1 0 0 0 1 /end COMPU_METHOD
/begin COMPU_METHOD MOCFC_POSTBLDCHKS_SC_Compu "" TAB_VERB "%6.3" "" COMPU_TAB_REF MOCFC_POSTBLDCHKS_SC_Compu /end COMPU_METHOD
/begin COMPU_VTAB MOCFC_POSTBLDCHKS_SC_Compu "" TAB_VERB 2 0 "False" 1 "True" /end COMPU_VTAB
/begin COMPU_METHOD MOCFC_SCCERRREACTN_SC_Compu "" TAB_VERB "%6.3" "" COMPU_TAB_REF MOCFC_SCCERRREACTN_SC_Compu /end COMPU_METHOD
/begin COMPU_VTAB MOCFC_SCCERRREACTN_SC_Compu "" TAB_VERB 2 0 "Disable" 1 "Enable" /end COMPU_VTAB
/begin COMPU_METHOD MOCMM_ABESHTOFFPAHTESTENA_SC_Compu "" TAB_VERB "%6.3" "" COMPU_TAB_REF MOCMM_ABESHTOFFPAHTESTENA_SC_Compu /end COMPU_METHOD
/begin COMPU_VTAB MOCMM_ABESHTOFFPAHTESTENA_SC_Compu "" TAB_VERB 2 0 "False" 1 "True" /end COMPU_VTAB
/begin COMPU_METHOD MOCMM_CANSHOFFPAHTESTENA_SC_Compu "" TAB_VERB "%6.3" "" COMPU_TAB_REF MOCMM_CANSHOFFPAHTESTENA_SC_Compu /end COMPU_METHOD
/begin COMPU_VTAB MOCMM_CANSHOFFPAHTESTENA_SC_Compu "" TAB_VERB 2 0 "Disabled" 1 "Enabled" /end COMPU_VTAB
/begin COMPU_METHOD MOCMM_FRSHOFFPAHTESTENA_SC_Compu "" TAB_VERB "%6.3" "" COMPU_TAB_REF MOCMM_FRSHOFFPAHTESTENA_SC_Compu /end COMPU_METHOD
/begin COMPU_VTAB MOCMM_FRSHOFFPAHTESTENA_SC_Compu "" TAB_VERB 2 0 "Disabled" 1 "Enabled" /end COMPU_VTAB
/begin COMPU_METHOD MOCMM_MCUINJSHTOFFPAHTESTENA_SC_Compu "" TAB_VERB "%6.3" "" COMPU_TAB_REF MOCMM_MCUINJSHTOFFPAHTESTENA_SC_Compu /end COMPU_METHOD
/begin COMPU_VTAB MOCMM_MCUINJSHTOFFPAHTESTENA_SC_Compu "" TAB_VERB 2 0 "False" 1 "True" /end COMPU_VTAB
/begin COMPU_METHOD MOCMM_NRTRCV_SC_Compu "" RAT_FUNC "%6.2" "" COEFFS 0 1 0 0 0 1 /end COMPU_METHOD
/begin COMPU_METHOD MOCMM_UCHIP_SC_Compu "" TAB_VERB "%6.3" "" COMPU_TAB_REF MOCMM_UCHIP_SC_Compu /end COMPU_METHOD
/begin COMPU_VTAB MOCMM_UCHIP_SC_Compu "" TAB_VERB 2 0 "False" 1 "True" /end COMPU_VTAB
/begin COMPU_METHOD mOilAsh_g "" RAT_FUNC "%6.4" "g" COEFFS 0 100 0 0 0 1 /end COMPU_METHOD
/begin COMPU_METHOD Molmass "" RAT_FUNC "%6.4" "g/mol" COEFFS 0 100 0 0 0 1 /end COMPU_METHOD
/begin COMPU_METHOD MO_AUXHTRPRS_SY_Compu "" RAT_FUNC "%6.2" "" COEFFS 0 1 0 0 0 1 /end COMPU_METHOD
/begin COMPU_METHOD MO_CMNDSLGSLSW_SC_Compu "" TAB_VERB "%6.3" "" COMPU_TAB_REF MO_CMNDSLGSLSW_SC_Compu /end COMPU_METHOD
/begin COMPU_VTAB MO_CMNDSLGSLSW_SC_Compu "" TAB_VERB 2 0 "False" 1 "True" /end COMPU_VTAB
/begin COMPU_METHOD MO_COMCUST_SC_Compu "" TAB_VERB "%6.3" "" COMPU_TAB_REF MO_COMCUST_SC_Compu /end COMPU_METHOD
/begin COMPU_VTAB MO_COMCUST_SC_Compu "" TAB_VERB 30 0 "NO_CAN" 1 "PSA" 2 "HMC" 3 "CVP" 4 "NEVS" 5 "BMW" 6 "STREETSCOOTER" 7 "VOLVO" 8 "VW" 9 "JLR" 10 "DAIMLER" 11 "SUZUKI" 12 "EGO" 13 "BYTON" 14 "FCCU" 15 "RBCD" 16 "ISUZU" 17 "KAMAZ" 18 "TOGG" 19 "NAVISTAR" 20 "HONDA" 21 "MAN" 22 "NISSAN" 23 "RSA" 24 "NIKOLA" 25 "SYMC" 26 "MAHINDRA" 27 "YMC" 72 "TOYOTA" 255 "PLATFORM" /end COMPU_VTAB
/begin COMPU_METHOD MO_EXTDTSK_SC_Compu "" TAB_VERB "%6.3" "" COMPU_TAB_REF MO_EXTDTSK_SC_Compu /end COMPU_METHOD
/begin COMPU_VTAB MO_EXTDTSK_SC_Compu "" TAB_VERB 4 0 "Disabled" 2 "2ms" 4 "4ms" 5 "5ms" /end COMPU_VTAB
/begin COMPU_METHOD MO_FRDMINTFRMETHOD_SC_Compu "" TAB_VERB "%6.3" "" COMPU_TAB_REF MO_FRDMINTFRMETHOD_SC_Compu /end COMPU_METHOD
/begin COMPU_VTAB MO_FRDMINTFRMETHOD_SC_Compu "" TAB_VERB 3 0 "CPL" 1 "MPU" 2 "CPL_MPU" /end COMPU_VTAB
/begin COMPU_METHOD MO_LBISTENA_SC_Compu "" TAB_VERB "%6.3" "" COMPU_TAB_REF MO_LBISTENA_SC_Compu /end COMPU_METHOD
/begin COMPU_VTAB MO_LBISTENA_SC_Compu "" TAB_VERB 2 0 "Disabled" 1 "Enabled" /end COMPU_VTAB
/begin COMPU_METHOD MO_MAXVALINDCR_SC_Compu "" TAB_VERB "%6.3" "" COMPU_TAB_REF MO_MAXVALINDCR_SC_Compu /end COMPU_METHOD
/begin COMPU_VTAB MO_MAXVALINDCR_SC_Compu "" TAB_VERB 2 0 "Disabled" 1 "Enabled" /end COMPU_VTAB
/begin COMPU_METHOD MO_NRSLOTS_SC_Compu "" RAT_FUNC "%6.2" "" COEFFS 0 1 0 0 0 1 /end COMPU_METHOD
/begin COMPU_METHOD MO_NRUSEDCORESFTY_SC_Compu "" TAB_VERB "%6.3" "" COMPU_TAB_REF MO_NRUSEDCORESFTY_SC_Compu /end COMPU_METHOD
/begin COMPU_VTAB MO_NRUSEDCORESFTY_SC_Compu "" TAB_VERB 8 1 "Core0" 2 "Core1" 3 "Core0_and_Core1" 4 "Core2" 5 "Core0_and_Core2" 6 "Core1_and_Core2" 7 "Core0_Core1_and_Core2" 8 "Core3" /end COMPU_VTAB
/begin COMPU_METHOD MO_RAMCHKTYP_SC_Compu "" TAB_VERB "%6.3" "" COMPU_TAB_REF MO_RAMCHKTYP_SC_Compu /end COMPU_METHOD
/begin COMPU_VTAB MO_RAMCHKTYP_SC_Compu "" TAB_VERB 2 1 "Default" 2 "MBIST" /end COMPU_VTAB
/begin COMPU_METHOD MO_ROM_SY_Compu "" TAB_VERB "%6.3" "" COMPU_TAB_REF MO_ROM_SY_Compu /end COMPU_METHOD
/begin COMPU_VTAB MO_ROM_SY_Compu "" TAB_VERB 2 0 "False" 1 "True" /end COMPU_VTAB
/begin COMPU_METHOD MO_VDD5MONHWTYP_SC_Compu "" TAB_VERB "%6.3" "" COMPU_TAB_REF MO_VDD5MONHWTYP_SC_Compu /end COMPU_METHOD
/begin COMPU_VTAB MO_VDD5MONHWTYP_SC_Compu "" TAB_VERB 2 0 "ASIC" 1 "DIPO_CIRC" /end COMPU_VTAB
/begin COMPU_METHOD MRLY_STACTDSQENA_SC_Compu "" TAB_VERB "%6.3" "" COMPU_TAB_REF MRLY_STACTDSQENA_SC_Compu /end COMPU_METHOD
/begin COMPU_VTAB MRLY_STACTDSQENA_SC_Compu "" TAB_VERB 2 0 "Disabled" 1 "Enabled" /end COMPU_VTAB
/begin COMPU_METHOD MSAGEN_SY_Compu "" TAB_VERB "%6.3" "" COMPU_TAB_REF MSAGEN_SY_Compu /end COMPU_METHOD
/begin COMPU_VTAB MSAGEN_SY_Compu "" TAB_VERB 3 0 "keine Motorstopautomatik (MSA)" 1 "Motorstopautomatik Generation 1 (MSA1)" 2 "Motorstopautomatik Generation 2 (MSA2)" /end COMPU_VTAB
/begin COMPU_METHOD MSAPP1_SY_Compu "" TAB_VERB "%6.3" "" COMPU_TAB_REF MSAPP1_SY_Compu /end COMPU_METHOD
/begin COMPU_VTAB MSAPP1_SY_Compu "" TAB_VERB 3 0 "Switch connected to master" 1 "Switch connected to slave1" 2 "Switch connected to slave2" /end COMPU_VTAB
/begin COMPU_METHOD MSAPP2_SY_Compu "" TAB_VERB "%6.3" "" COMPU_TAB_REF MSAPP2_SY_Compu /end COMPU_METHOD
/begin COMPU_VTAB MSAPP2_SY_Compu "" TAB_VERB 3 0 "Switch connected to master" 1 "Switch connected to slave1" 2 "Switch connected to slave2" /end COMPU_VTAB
/begin COMPU_METHOD MSBRKADC_SY_Compu "" TAB_VERB "%6.3" "" COMPU_TAB_REF MSBRKADC_SY_Compu /end COMPU_METHOD
/begin COMPU_VTAB MSBRKADC_SY_Compu "" TAB_VERB 3 0 "Switch connected to master" 1 "Switch connected to slave1" 2 "Switch connected to slave2" /end COMPU_VTAB
/begin COMPU_METHOD MSI_SC_Compu "" TAB_VERB "%6.3" "" COMPU_TAB_REF MSI_SC_Compu /end COMPU_METHOD
/begin COMPU_VTAB MSI_SC_Compu "" TAB_VERB 3 0 "0" 1 "1" 2 "2" /end COMPU_VTAB
/begin COMPU_METHOD MSI_TMPR_SY_Compu "" TAB_VERB "%6.3" "" COMPU_TAB_REF MSI_TMPR_SY_Compu /end COMPU_METHOD
/begin COMPU_VTAB MSI_TMPR_SY_Compu "" TAB_VERB 2 0 "False" 1 "True" /end COMPU_VTAB
/begin COMPU_METHOD mSoot_g "" RAT_FUNC "%6.4" "g" COEFFS 0 100 0 0 0 1 /end COMPU_METHOD
/begin COMPU_METHOD MsPerVol "" RAT_FUNC "%6.5" "g/l" COEFFS 0 1000 0 0 0 1 /end COMPU_METHOD
/begin COMPU_METHOD MsPrTime_mgprsec_q0p1_COMPU "" RAT_FUNC "%6.3" "mg/s" COEFFS 0 10 0 0 0 1 /end COMPU_METHOD
/begin COMPU_METHOD MSVSUBKOMP_SC_Compu "" TAB_VERB "%6.3" "" COMPU_TAB_REF MSVSUBKOMP_SC_Compu /end COMPU_METHOD
/begin COMPU_VTAB MSVSUBKOMP_SC_Compu "" TAB_VERB 13 1 "Bosch_HDP5" 2 "Bosch_HDP5evo" 3 "Bosch_HDP6" 4 "Marelli" 5 "Conti" 6 "HitachiIIIA_NO" 7 "Denso" 8 "HitachiIIIB_NO" 9 "Conti_withAgreementDI" 10 "Hitachi_Gen5_NO" 11 "Marelli_withAgreementDI" 12 "Delphi_GFP_2.35_NO" 13 "Marelli_var2" /end COMPU_VTAB
/begin COMPU_METHOD Ms_g_q0p001_COMPU "" RAT_FUNC "%6.5" "g" COEFFS 0 1000 0 0 0 1 /end COMPU_METHOD
/begin COMPU_METHOD Ms_kg_COMPU "" RAT_FUNC "%6.4" "kg" COEFFS 0 100 0 0 0 1 /end COMPU_METHOD
/begin COMPU_METHOD Ms_O2 "" RAT_FUNC "%6.5" "g" COEFFS 0 1000 0 0 0 1 /end COMPU_METHOD
/begin COMPU_METHOD Ms_SOx "" RAT_FUNC "%6.5" "g" COEFFS 0 3278.68852459016 0 0 0 1 /end COMPU_METHOD
/begin COMPU_METHOD Ms_SOxLdTot "" RAT_FUNC "%6.3" "mg" COEFFS 0 2 0 0 0 1 /end COMPU_METHOD
/begin COMPU_METHOD Ms_SOxNOx "" RAT_FUNC "%8.7" "g" COEFFS 0 100000 0 0 0 1 /end COMPU_METHOD
/begin COMPU_METHOD MULTIHSS_SC_Compu "" TAB_VERB "%6.3" "" COMPU_TAB_REF MULTIHSS_SC_Compu /end COMPU_METHOD
/begin COMPU_VTAB MULTIHSS_SC_Compu "" TAB_VERB 7 0 "no_MultiHss" 1 "one_MultiHss" 2 "two_MultiHss" 3 "three_MultiHss" 4 "four_MultiHss" 5 "five_MultiHss" 6 "six_MultiHss" /end COMPU_VTAB
/begin COMPU_METHOD MVBTYP_SC_Compu "" TAB_VERB "%6.3" "" COMPU_TAB_REF MVBTYP_SC_Compu /end COMPU_METHOD
/begin COMPU_VTAB MVBTYP_SC_Compu "" TAB_VERB 4 0 "Bosch" 1 "A123" 2 "Other" 3 "HMC" /end COMPU_VTAB
/begin COMPU_METHOD MWF_SC_Compu "" TAB_VERB "%6.3" "" COMPU_TAB_REF MWF_SC_Compu /end COMPU_METHOD
/begin COMPU_VTAB MWF_SC_Compu "" TAB_VERB 2 0 "False" 1 "True" /end COMPU_VTAB
/begin COMPU_METHOD M_NOxLd_LoRes "" RAT_FUNC "%6.4" "g" COEFFS 0 250 0 0 0 1 /end COMPU_METHOD
/begin COMPU_METHOD m_q0p002441_kg_DIV_h_s "" RAT_FUNC "%6.4" "kg/(h*s)" COEFFS 0 65536 0 0 0 160 /end COMPU_METHOD
/begin COMPU_METHOD m_q0p1 "" RAT_FUNC "%6.3" "kg/h" COEFFS 0 10 0 0 0 1 /end COMPU_METHOD
/begin COMPU_METHOD m_q2p71267Em5 "" RAT_FUNC "%7.6" "g" COEFFS 0 184320 0 0 0 5 /end COMPU_METHOD
/begin COMPU_METHOD m_q5p4253Em7_g "" RAT_FUNC "%9.8" "g" COEFFS 0 1843200 0 0 0 1 /end COMPU_METHOD
/begin COMPU_METHOD m_ub_b25p6 "" RAT_FUNC "%6.3" "kg/h" COEFFS 0 256 0 0 0 25.6 /end COMPU_METHOD
/begin COMPU_METHOD m_ub_q0p0444 "" RAT_FUNC "%6.4" "g" COEFFS 0 1 0 0 0 0.0444 /end COMPU_METHOD
/begin COMPU_METHOD m_uw_b25p6 "" RAT_FUNC "%6.5" "kg/h" COEFFS 0 65536 0 0 0 25.6 /end COMPU_METHOD
/begin COMPU_METHOD m_uw_b6553p5 "" RAT_FUNC "%6.3" "kg/h" COEFFS 0 1 0 0 0 0.1 /end COMPU_METHOD
/begin COMPU_METHOD m_uw_bn6553p5 "" RAT_FUNC "%6.5" "kg/h" COEFFS 0 -1 0 0 0 0.1 /end COMPU_METHOD
/begin COMPU_METHOD NEOFUNCTYP_SC_Compu "" TAB_VERB "%6.3" "" COMPU_TAB_REF NEOFUNCTYP_SC_Compu /end COMPU_METHOD
/begin COMPU_VTAB NEOFUNCTYP_SC_Compu "" TAB_VERB 3 0 "Deactvd" 1 "PLL" 2 "RRS" /end COMPU_VTAB
/begin COMPU_METHOD NLKO_SY_Compu "" TAB_VERB "%6.3" "" COMPU_TAB_REF NLKO_SY_Compu /end COMPU_METHOD
/begin COMPU_VTAB NLKO_SY_Compu "" TAB_VERB 5 0 "0" 1 "1" 2 "2" 3 "3" 4 "4" /end COMPU_VTAB
/begin COMPU_METHOD NMAXDSPL_ALTDCOR_SY_Compu "" TAB_VERB "%6.3" "" COMPU_TAB_REF NMAXDSPL_ALTDCOR_SY_Compu /end COMPU_METHOD
/begin COMPU_VTAB NMAXDSPL_ALTDCOR_SY_Compu "" TAB_VERB 2 0 "False" 1 "True" /end COMPU_VTAB
/begin COMPU_METHOD NMAXDSPL_SY_Compu "" TAB_VERB "%6.3" "" COMPU_TAB_REF NMAXDSPL_SY_Compu /end COMPU_METHOD
/begin COMPU_VTAB NMAXDSPL_SY_Compu "" TAB_VERB 3 0 "0" 1 "1" 2 "2" /end COMPU_VTAB
/begin COMPU_METHOD NMAXENGEXT_SC_Compu "" TAB_VERB "%6.3" "" COMPU_TAB_REF NMAXENGEXT_SC_Compu /end COMPU_METHOD
/begin COMPU_VTAB NMAXENGEXT_SC_Compu "" TAB_VERB 2 0 "False" 1 "True" /end COMPU_VTAB
/begin COMPU_METHOD NMINENG_SC_Compu "" TAB_VERB "%6.3" "" COMPU_TAB_REF NMINENG_SC_Compu /end COMPU_METHOD
/begin COMPU_VTAB NMINENG_SC_Compu "" TAB_VERB 2 0 "False" 1 "True" /end COMPU_VTAB
/begin COMPU_METHOD nmotg_q1_DIV_min_10ms "" RAT_FUNC "%6.2" "U/(min*10ms)" COEFFS 0 1 0 0 0 1 /end COMPU_METHOD
/begin COMPU_METHOD nmot_q0p25 "" RAT_FUNC "%6.3" "1/min" COEFFS 0 4 0 0 0 1 /end COMPU_METHOD
/begin COMPU_METHOD nmot_q10 "" RAT_FUNC "%6.1" "1/min" COEFFS 0 1 0 0 0 10 /end COMPU_METHOD
/begin COMPU_METHOD nmot_ub_q40 "" RAT_FUNC "%6.1" "1/min" COEFFS 0 1 0 0 0 40 /end COMPU_METHOD
/begin COMPU_METHOD nmot_uw_q0p25 "" RAT_FUNC "%6.3" "1/min" COEFFS 0 1 0 0 0 0.25 /end COMPU_METHOD
/begin COMPU_METHOD NOINIDRV_SC_Compu "" TAB_VERB "%6.3" "" COMPU_TAB_REF NOINIDRV_SC_Compu /end COMPU_METHOD
/begin COMPU_VTAB NOINIDRV_SC_Compu "" TAB_VERB 2 0 "IniDrv" 1 "NoIniDrv" /end COMPU_VTAB
/begin COMPU_METHOD NOMIDLSPD_ATS_SY_Compu "" RAT_FUNC "%6.2" "" COEFFS 0 1 0 0 0 1 /end COMPU_METHOD
/begin COMPU_METHOD NOREINI_SC_Compu "" TAB_VERB "%6.3" "" COMPU_TAB_REF NOREINI_SC_Compu /end COMPU_METHOD
/begin COMPU_VTAB NOREINI_SC_Compu "" TAB_VERB 2 0 "Reini" 1 "NoReini" /end COMPU_VTAB
/begin COMPU_METHOD NOSTSPSWT_SY_Compu "" TAB_VERB "%6.3" "" COMPU_TAB_REF NOSTSPSWT_SY_Compu /end COMPU_METHOD
/begin COMPU_VTAB NOSTSPSWT_SY_Compu "" TAB_VERB 2 0 "False" 1 "True" /end COMPU_VTAB
/begin COMPU_METHOD nox "" RAT_FUNC "%6.2" "ppm" COEFFS 0 1 0 0 0 1 /end COMPU_METHOD
/begin COMPU_METHOD NOxFlwEG "" RAT_FUNC "%6.4" "Gram/s" COEFFS 0 40 0 0 0 1 /end COMPU_METHOD
/begin COMPU_METHOD OneToOne "" RAT_FUNC "%6.2" "-" COEFFS 0 1 0 0 0 1 /end COMPU_METHOD
/begin COMPU_METHOD perio_q0p3125 "" RAT_FUNC "%6.3" "1/s" COEFFS 0 32 0 0 0 10 /end COMPU_METHOD
/begin COMPU_METHOD perio_q4p76836Em5 "" RAT_FUNC "%7.6" "1/s" COEFFS 0 256000000 0 0 0 12207 /end COMPU_METHOD
/begin COMPU_METHOD perio_ub_b0p012207 "" RAT_FUNC "%10.8" "1/s" COEFFS 0 256 0 0 0 0.012207 /end COMPU_METHOD
/begin COMPU_METHOD Prc "" RAT_FUNC "%6.4" "%" COEFFS 0 81.92 0 0 0 1 /end COMPU_METHOD
/begin COMPU_METHOD p_q0p00122 "" RAT_FUNC "%6.4" "hPa" COEFFS 0 65536 0 0 0 80 /end COMPU_METHOD
/begin COMPU_METHOD p_q10_kPa "" RAT_FUNC "%6.1" "kPa" COEFFS 0 1 0 0 0 10 /end COMPU_METHOD
/begin COMPU_METHOD p_sw_q0p039 "" RAT_FUNC "%6.4" "hPa" COEFFS 0 256 0 0 0 10 /end COMPU_METHOD
/begin COMPU_METHOD p_ub_q5 "" RAT_FUNC "%6.2" "hPa" COEFFS 0 1 0 0 0 5 /end COMPU_METHOD
/begin COMPU_METHOD p_uw_q0p039 "" RAT_FUNC "%6.4" "hPa" COEFFS 0 256 0 0 0 10 /end COMPU_METHOD
/begin COMPU_METHOD p_uw_q0p078 "" RAT_FUNC "%6.4" "hPa" COEFFS 0 256 0 0 0 20 /end COMPU_METHOD
/begin COMPU_METHOD q0p01 "" RAT_FUNC "%6.4" "-" COEFFS 0 100 0 0 0 1 /end COMPU_METHOD
/begin COMPU_METHOD q0p1_g "" RAT_FUNC "%6.3" "g" COEFFS 0 10 0 0 0 1 /end COMPU_METHOD
/begin COMPU_METHOD RBPtCel_m_0p001_3 "" RAT_FUNC "%6.5" "kg" COEFFS 0 1000 0 0 0 1 /end COMPU_METHOD
/begin COMPU_METHOD RBPtCel_p_1p0_1 "" RAT_FUNC "%6.2" "hPa" COEFFS 0 1 0 0 0 1 /end COMPU_METHOD
/begin COMPU_METHOD relDK_q0p02441 "" RAT_FUNC "%6.4" "%DK" COEFFS 0 65536 0 0 0 1600 /end COMPU_METHOD
/begin COMPU_METHOD relDK_ub_b100 "" RAT_FUNC "%6.3" "%DK" COEFFS 0 255 0 0 0 100 /end COMPU_METHOD
/begin COMPU_METHOD relDK_uw_b100 "" RAT_FUNC "%6.4" "%DK" COEFFS 0 65535 0 0 0 100 /end COMPU_METHOD
/begin COMPU_METHOD rel_q0p00153 "" RAT_FUNC "%6.4" "%" COEFFS 0 65536 0 0 0 100 /end COMPU_METHOD
/begin COMPU_METHOD rel_q0p0234 "" RAT_FUNC "%6.4" "%" COEFFS 0 128 0 0 0 3 /end COMPU_METHOD
/begin COMPU_METHOD rel_sw_b100 "" RAT_FUNC "%6.4" "%" COEFFS 0 32768 0 0 0 100 /end COMPU_METHOD
/begin COMPU_METHOD rel_sw_q0p0468 "" RAT_FUNC "%6.4" "%" COEFFS 0 65536 0 0 0 3072 /end COMPU_METHOD
/begin COMPU_METHOD rel_uw_b100 "" RAT_FUNC "%6.4" "%" COEFFS 0 65536 0 0 0 100 /end COMPU_METHOD
/begin COMPU_METHOD rel_uw_b200 "" RAT_FUNC "%6.4" "%" COEFFS 0 65536 0 0 0 200 /end COMPU_METHOD
/begin COMPU_METHOD rel_uw_b3072 "" RAT_FUNC "%6.4" "%" COEFFS 0 65536 0 0 0 3072 /end COMPU_METHOD
/begin COMPU_METHOD rel_uw_q0p0234 "" RAT_FUNC "%6.4" "%" COEFFS 0 32 0 0 0 0.75 /end COMPU_METHOD
/begin COMPU_METHOD t100msxs_ub_b25p5 "" RAT_FUNC "%6.3" "s" COEFFS 0 1 0 0 0 0.1 /end COMPU_METHOD
/begin COMPU_METHOD Temp_Cels "" RAT_FUNC "%6.1" "deg C" COEFFS 0 10 2731.4 0 0 1 /end COMPU_METHOD
/begin COMPU_METHOD temp_q0p0234_o273 "" RAT_FUNC "%6.1" "Grad C" COEFFS 0 1 273.15 0 0 0.0234375 /end COMPU_METHOD
/begin COMPU_METHOD temp_ub_q0p75_o48 "" RAT_FUNC "%6.2" "Grad C" COEFFS 0 1 48 0 0 0.75 /end COMPU_METHOD
/begin COMPU_METHOD Time_ms "" RAT_FUNC "%6.1" "ms" COEFFS 0 0.1 0 0 0 1 /end COMPU_METHOD
/begin COMPU_METHOD Time_s "" RAT_FUNC "%6.4" "s" COEFFS 0 100 0 0 0 1 /end COMPU_METHOD
/begin COMPU_METHOD TransR_COMPU "" RAT_FUNC "%6.4" "" COEFFS 0 64 0 0 0 1 /end COMPU_METHOD
/begin COMPU_METHOD Trq "" RAT_FUNC "%6.3" "Nm" COEFFS 0 10 0 0 0 1 /end COMPU_METHOD
/begin COMPU_METHOD t_q0p01 "" RAT_FUNC "%6.4" "s" COEFFS 0 100 0 0 0 1 /end COMPU_METHOD
/begin COMPU_METHOD t_q0p02 "" RAT_FUNC "%6.4" "s" COEFFS 0 100 0 0 0 2 /end COMPU_METHOD
/begin COMPU_METHOD t_q0p1 "" RAT_FUNC "%6.3" "s" COEFFS 0 10 0 0 0 1 /end COMPU_METHOD
/begin COMPU_METHOD t_q0p2 "" RAT_FUNC "%6.3" "s" COEFFS 0 10 0 0 0 2 /end COMPU_METHOD
/begin COMPU_METHOD t_q0p32000082 "" RAT_FUNC "%6.3" "s" COEFFS 0 48828 0 0 0 15625 /end COMPU_METHOD
/begin COMPU_METHOD t_q1 "" RAT_FUNC "%6.2" "s" COEFFS 0 1 0 0 0 1 /end COMPU_METHOD
/begin COMPU_METHOD t_q4_s "" RAT_FUNC "%6.2" "s" COEFFS 0 1 0 0 0 4 /end COMPU_METHOD
/begin COMPU_METHOD t_q5p96046Em8_min "" RAT_FUNC "%10.9" "min" COEFFS 0 16777216 0 0 0 1 /end COMPU_METHOD
/begin COMPU_METHOD Vel "" RAT_FUNC "%6.4" "km/h" COEFFS 0 100 0 0 0 1 /end COMPU_METHOD
/begin COMPU_METHOD Vel_CrCtl "" RAT_FUNC "%6.4" "km/h" COEFFS 0 256 0 0 0 1 /end COMPU_METHOD
/begin COMPU_METHOD vfzg_uw_b512 "" RAT_FUNC "%6.4" "km/h" COEFFS 0 65536 0 0 0 512 /end COMPU_METHOD
/begin COMPU_METHOD Volt_Batt "" RAT_FUNC "%6.1" "mV" COEFFS 0 0.05 0 0 0 1 /end COMPU_METHOD
/begin COMPU_METHOD zk100msxs_ub_b25p6 "" RAT_FUNC "%6.3" "s" COEFFS 0 0 256 0 10 0 /end COMPU_METHOD
/begin COMPU_METHOD zk100msxs_uw_b6553p6 "" RAT_FUNC "%6.1" "s" COEFFS 0 0 65536 0 10 0 /end COMPU_METHOD
/begin COMPU_METHOD zk20msxs_uw_b1310p72 "" RAT_FUNC "%6.1" "s" COEFFS 0 0 65536 0 50 0 /end COMPU_METHOD
/begin COMPU_METHOD zw_sb_q0p75 "" RAT_FUNC "%6.3" "Grad KW" COEFFS 0 255 0 0 0 191.25 /end COMPU_METHOD
/begin RECORD_LAYOUT KlAxU8SstxU16WU16 NO_AXIS_PTS_X 1 UWORD AXIS_PTS_X 2 UWORD INDEX_INCR DIRECT FNC_VALUES 3 UWORD COLUMN_DIR DIRECT /end RECORD_LAYOUT
/begin RECORD_LAYOUT KwWS16 FNC_VALUES 1 SWORD COLUMN_DIR DIRECT /end RECORD_LAYOUT
/begin RECORD_LAYOUT KwWU8 FNC_VALUES 1 UBYTE COLUMN_DIR DIRECT /end RECORD_LAYOUT
/begin RECORD_LAYOUT RB_Axis_S16 NO_AXIS_PTS_X 1 SWORD AXIS_PTS_X 2 SWORD INDEX_INCR DIRECT /end RECORD_LAYOUT
/begin RECORD_LAYOUT RB_Axis_U16 NO_AXIS_PTS_X 1 UWORD AXIS_PTS_X 2 UWORD INDEX_INCR DIRECT /end RECORD_LAYOUT
/begin RECORD_LAYOUT RB_Axis_U8 NO_AXIS_PTS_X 1 UBYTE AXIS_PTS_X 2 UBYTE INDEX_INCR DIRECT /end RECORD_LAYOUT
/begin RECORD_LAYOUT RB_CurveGroup_U16 FNC_VALUES 1 UWORD COLUMN_DIR DIRECT /end RECORD_LAYOUT
/begin RECORD_LAYOUT RB_CurveGroup_U8 FNC_VALUES 1 UBYTE COLUMN_DIR DIRECT /end RECORD_LAYOUT
/begin RECORD_LAYOUT RB_Curve_S16_S16 NO_AXIS_PTS_X 1 SWORD AXIS_PTS_X 2 SWORD INDEX_INCR DIRECT FNC_VALUES 3 SWORD COLUMN_DIR DIRECT /end RECORD_LAYOUT
/begin RECORD_LAYOUT RB_Curve_S16_U16_Static NO_AXIS_PTS_X 1 SWORD AXIS_PTS_X 2 SWORD INDEX_INCR DIRECT FNC_VALUES 3 UWORD COLUMN_DIR DIRECT STATIC_RECORD_LAYOUT /end RECORD_LAYOUT
/begin RECORD_LAYOUT RB_Curve_S16_U8_Static NO_AXIS_PTS_X 1 SWORD AXIS_PTS_X 2 SWORD INDEX_INCR DIRECT FNC_VALUES 3 UBYTE COLUMN_DIR DIRECT STATIC_RECORD_LAYOUT /end RECORD_LAYOUT
/begin RECORD_LAYOUT RB_Curve_S8_U8_Static NO_AXIS_PTS_X 1 SBYTE AXIS_PTS_X 2 SBYTE INDEX_INCR DIRECT FNC_VALUES 3 UBYTE COLUMN_DIR DIRECT STATIC_RECORD_LAYOUT /end RECORD_LAYOUT
/begin RECORD_LAYOUT RB_Curve_U16_S16_Static NO_AXIS_PTS_X 1 UWORD AXIS_PTS_X 2 UWORD INDEX_INCR DIRECT FNC_VALUES 3 SWORD COLUMN_DIR DIRECT STATIC_RECORD_LAYOUT /end RECORD_LAYOUT
/begin RECORD_LAYOUT RB_Curve_U16_U16 NO_AXIS_PTS_X 1 UWORD AXIS_PTS_X 2 UWORD INDEX_INCR DIRECT FNC_VALUES 3 UWORD COLUMN_DIR DIRECT /end RECORD_LAYOUT
/begin RECORD_LAYOUT RB_Curve_U16_U8_Static NO_AXIS_PTS_X 1 UWORD AXIS_PTS_X 2 UWORD INDEX_INCR DIRECT FNC_VALUES 3 UBYTE COLUMN_DIR DIRECT STATIC_RECORD_LAYOUT /end RECORD_LAYOUT
/begin RECORD_LAYOUT RB_Curve_U8_U16_Static NO_AXIS_PTS_X 1 UBYTE AXIS_PTS_X 2 UBYTE INDEX_INCR DIRECT FNC_VALUES 3 UWORD COLUMN_DIR DIRECT STATIC_RECORD_LAYOUT /end RECORD_LAYOUT
/begin RECORD_LAYOUT RB_Curve_U8_U8 NO_AXIS_PTS_X 1 UBYTE AXIS_PTS_X 2 UBYTE INDEX_INCR DIRECT FNC_VALUES 3 UBYTE COLUMN_DIR DIRECT /end RECORD_LAYOUT
/begin RECORD_LAYOUT RB_MapGroup_U8 FNC_VALUES 1 UBYTE COLUMN_DIR DIRECT /end RECORD_LAYOUT
/begin RECORD_LAYOUT RB_Map_S16S16_S16 NO_AXIS_PTS_X 1 SWORD NO_AXIS_PTS_Y 2 SWORD AXIS_PTS_X 3 SWORD INDEX_INCR DIRECT AXIS_PTS_Y 4 SWORD INDEX_INCR DIRECT FNC_VALUES 5 SWORD COLUMN_DIR DIRECT /end RECORD_LAYOUT
/begin RECORD_LAYOUT RB_Map_S16S16_U16 NO_AXIS_PTS_X 1 SWORD NO_AXIS_PTS_Y 2 SWORD AXIS_PTS_X 3 SWORD INDEX_INCR DIRECT AXIS_PTS_Y 4 SWORD INDEX_INCR DIRECT FNC_VALUES 5 UWORD COLUMN_DIR DIRECT /end RECORD_LAYOUT
/begin RECORD_LAYOUT RB_Map_S16S16_U8 NO_AXIS_PTS_X 1 SWORD NO_AXIS_PTS_Y 2 SWORD AXIS_PTS_X 3 SWORD INDEX_INCR DIRECT AXIS_PTS_Y 4 SWORD INDEX_INCR DIRECT FNC_VALUES 5 UBYTE COLUMN_DIR DIRECT /end RECORD_LAYOUT
/begin RECORD_LAYOUT RB_Map_S16U16_S16 NO_AXIS_PTS_X 1 SWORD NO_AXIS_PTS_Y 2 SWORD AXIS_PTS_X 3 SWORD INDEX_INCR DIRECT AXIS_PTS_Y 4 UWORD INDEX_INCR DIRECT FNC_VALUES 5 SWORD ROW_DIR DIRECT /end RECORD_LAYOUT
/begin RECORD_LAYOUT RB_Map_S16U16_U16 NO_AXIS_PTS_X 1 SWORD NO_AXIS_PTS_Y 2 SWORD AXIS_PTS_X 3 SWORD INDEX_INCR DIRECT AXIS_PTS_Y 4 UWORD INDEX_INCR DIRECT FNC_VALUES 5 UWORD ROW_DIR DIRECT /end RECORD_LAYOUT
/begin RECORD_LAYOUT RB_Map_S16U16_U8 NO_AXIS_PTS_X 1 SWORD NO_AXIS_PTS_Y 2 SWORD AXIS_PTS_X 3 SWORD INDEX_INCR DIRECT AXIS_PTS_Y 4 UWORD INDEX_INCR DIRECT FNC_VALUES 5 UBYTE ROW_DIR DIRECT /end RECORD_LAYOUT
/begin RECORD_LAYOUT RB_Map_S16U8_U16 NO_AXIS_PTS_X 1 SWORD NO_AXIS_PTS_Y 2 SWORD AXIS_PTS_X 3 SWORD INDEX_INCR DIRECT AXIS_PTS_Y 4 UBYTE INDEX_INCR DIRECT FNC_VALUES 5 UWORD COLUMN_DIR DIRECT /end RECORD_LAYOUT
/begin RECORD_LAYOUT RB_Map_U16S16_U16 NO_AXIS_PTS_X 1 UWORD NO_AXIS_PTS_Y 2 UWORD AXIS_PTS_X 3 UWORD INDEX_INCR DIRECT AXIS_PTS_Y 4 SWORD INDEX_INCR DIRECT FNC_VALUES 5 UWORD COLUMN_DIR DIRECT /end RECORD_LAYOUT
/begin RECORD_LAYOUT RB_Map_U16S16_U8 NO_AXIS_PTS_X 1 UWORD NO_AXIS_PTS_Y 2 UWORD AXIS_PTS_X 3 UWORD INDEX_INCR DIRECT AXIS_PTS_Y 4 SWORD INDEX_INCR DIRECT FNC_VALUES 5 UBYTE COLUMN_DIR DIRECT /end RECORD_LAYOUT
/begin RECORD_LAYOUT RB_Map_U16U16_U16 NO_AXIS_PTS_X 1 UWORD NO_AXIS_PTS_Y 2 UWORD AXIS_PTS_X 3 UWORD INDEX_INCR DIRECT AXIS_PTS_Y 4 UWORD INDEX_INCR DIRECT FNC_VALUES 5 UWORD COLUMN_DIR DIRECT /end RECORD_LAYOUT
/begin RECORD_LAYOUT RB_Map_U16U8_U16 NO_AXIS_PTS_X 1 UWORD NO_AXIS_PTS_Y 2 UWORD AXIS_PTS_X 3 UWORD INDEX_INCR DIRECT AXIS_PTS_Y 4 UBYTE INDEX_INCR DIRECT FNC_VALUES 5 UWORD COLUMN_DIR DIRECT /end RECORD_LAYOUT
/begin RECORD_LAYOUT RB_Map_U8U16_U16 NO_AXIS_PTS_X 1 UBYTE NO_AXIS_PTS_Y 2 UBYTE AXIS_PTS_X 3 UBYTE INDEX_INCR DIRECT AXIS_PTS_Y 4 UWORD INDEX_INCR DIRECT FNC_VALUES 5 UWORD ROW_DIR DIRECT /end RECORD_LAYOUT
/begin RECORD_LAYOUT RB_Map_U8U16_U8 NO_AXIS_PTS_X 1 UBYTE NO_AXIS_PTS_Y 2 UBYTE AXIS_PTS_X 3 UBYTE INDEX_INCR DIRECT AXIS_PTS_Y 4 UWORD INDEX_INCR DIRECT FNC_VALUES 5 UBYTE ROW_DIR DIRECT /end RECORD_LAYOUT
/begin RECORD_LAYOUT RB_Map_U8U8_U8 NO_AXIS_PTS_X 1 UBYTE NO_AXIS_PTS_Y 2 UBYTE AXIS_PTS_X 3 UBYTE INDEX_INCR DIRECT AXIS_PTS_Y 4 UBYTE INDEX_INCR DIRECT FNC_VALUES 5 UBYTE COLUMN_DIR DIRECT /end RECORD_LAYOUT
/begin RECORD_LAYOUT RB_Val_Ws16 FNC_VALUES 1 SWORD COLUMN_DIR DIRECT /end RECORD_LAYOUT
/begin RECORD_LAYOUT RB_Val_Ws32 FNC_VALUES 1 SLONG COLUMN_DIR DIRECT /end RECORD_LAYOUT
/begin RECORD_LAYOUT RB_Val_Ws8 FNC_VALUES 1 SBYTE COLUMN_DIR DIRECT /end RECORD_LAYOUT
/begin RECORD_LAYOUT RB_Val_Wu16 FNC_VALUES 1 UWORD COLUMN_DIR DIRECT /end RECORD_LAYOUT
/begin RECORD_LAYOUT RB_Val_Wu8 FNC_VALUES 1 UBYTE COLUMN_DIR DIRECT /end RECORD_LAYOUT
/end MODULE
/end PROJECT
