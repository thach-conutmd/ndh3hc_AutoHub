ASAP2_VERSION 1 60
/begin PROJECT MG1CS022 "MG1CS022"
/begin HEADER "" VERSION "MG1CS022_62XSC_V037" PROJECT_NO MG1CS022 /end HEADER
/begin MODULE DIM ""
/begin MOD_COMMON "" BYTE_ORDER MSB_LAST ALIGNMENT_BYTE 1 ALIGNMENT_WORD 2 ALIGNMENT_LONG 4 ALIGNMENT_INT64 4 ALIGNMENT_FLOAT32_IEEE 4 ALIGNMENT_FLOAT64_IEEE 4 DATA_SIZE 32 /end MOD_COMMON
/begin CHARACTERISTIC DFES_FaultTyp.DFC_IgnClPs_LineScg_2_C "assigned fault type / Fault type assignment for check DFC_IgnClPs_LineScg_2" VALUE 0x80504E48 Val_Wu8 255.0 DFES_OneToOne 0.00 255.0 FORMAT "%5.1" /end CHARACTERISTIC
/begin CHARACTERISTIC DFES_FaultTyp.DFC_IgnClPs_LineScg_3_C "assigned fault type / Fault type assignment for check DFC_IgnClPs_LineScg_3" VALUE 0x80504E49 Val_Wu8 255.0 DFES_OneToOne 0.00 255.0 FORMAT "%5.1" /end CHARACTERISTIC
/begin CHARACTERISTIC DFES_FaultTyp.DFC_KRVEKOEVAB_C "assigned fault type / Fault type assignment for check DFC_KRVEKOEVAB" VALUE 0x80504E4A Val_Wu8 255.0 DFES_OneToOne 0.00 255.0 FORMAT "%5.1" /end CHARACTERISTIC
/begin CHARACTERISTIC DFES_FaultTyp.DFC_KRVEKOEVAB0_C "assigned fault type / Fault type assignment for check DFC_KRVEKOEVAB0" VALUE 0x80504E4B Val_Wu8 255.0 DFES_OneToOne 0.00 255.0 FORMAT "%5.1" /end CHARACTERISTIC
/begin CHARACTERISTIC DFES_FaultTyp.DFC_KRVEKOEVAB1_C "assigned fault type / Fault type assignment for check DFC_KRVEKOEVAB1" VALUE 0x80504E4C Val_Wu8 255.0 DFES_OneToOne 0.00 255.0 FORMAT "%5.1" /end CHARACTERISTIC
/begin CHARACTERISTIC DFES_FaultTyp.DFC_KRVEKOEVAB2_C "assigned fault type / Fault type assignment for check DFC_KRVEKOEVAB2" VALUE 0x80504E4D Val_Wu8 255.0 DFES_OneToOne 0.00 255.0 FORMAT "%5.1" /end CHARACTERISTIC
/begin CHARACTERISTIC DFES_FaultTyp.DFC_KRVEKOEVAB3_C "assigned fault type / Fault type assignment for check DFC_KRVEKOEVAB3" VALUE 0x80504E4E Val_Wu8 255.0 DFES_OneToOne 0.00 255.0 FORMAT "%5.1" /end CHARACTERISTIC
/begin CHARACTERISTIC DFES_FaultTyp.DFC_UegoSigEcuAsicS1B1_C "assigned fault type / Fault type assignment for check DFC_UegoSigEcuAsicS1B1" VALUE 0x80504E4F Val_Wu8 255.0 DFES_OneToOne 0.00 255.0 FORMAT "%5.1" /end CHARACTERISTIC
/begin CHARACTERISTIC DFES_FaultTyp.DFC_UegoSigEcuComS1B1_C "assigned fault type / Fault type assignment for check DFC_UegoSigEcuComS1B1" VALUE 0x80504E50 Val_Wu8 255.0 DFES_OneToOne 0.00 255.0 FORMAT "%5.1" /end CHARACTERISTIC
/begin CHARACTERISTIC DFES_FaultTyp.DFC_UegoSigSnsrS1B1_C "assigned fault type / Fault type assignment for check DFC_UegoSigSnsrS1B1" VALUE 0x80504E51 Val_Wu8 255.0 DFES_OneToOne 0.00 255.0 FORMAT "%5.1" /end CHARACTERISTIC
/begin CHARACTERISTIC DFES_FaultTyp.DFC_UegoSigWireOlApesS1B1_C "assigned fault type / Fault type assignment for check DFC_UegoSigWireOlApesS1B1" VALUE 0x80504E52 Val_Wu8 255.0 DFES_OneToOne 0.00 255.0 FORMAT "%5.1" /end CHARACTERISTIC
/begin CHARACTERISTIC DFES_FaultTyp.DFC_UegoSigWireOlIpeS1B1_C "assigned fault type / Fault type assignment for check DFC_UegoSigWireOlIpeS1B1" VALUE 0x80504E53 Val_Wu8 255.0 DFES_OneToOne 0.00 255.0 FORMAT "%5.1" /end CHARACTERISTIC
/begin CHARACTERISTIC DFES_FaultTyp.DFC_UegoSigWireOlReS1B1_C "assigned fault type / Fault type assignment for check DFC_UegoSigWireOlReS1B1" VALUE 0x80504E54 Val_Wu8 255.0 DFES_OneToOne 0.00 255.0 FORMAT "%5.1" /end CHARACTERISTIC
/begin CHARACTERISTIC DFES_FaultTyp.DFC_UegoSigWireRCmpS1B1_C "assigned fault type / Fault type assignment for check DFC_UegoSigWireRCmpS1B1" VALUE 0x80504E55 Val_Wu8 255.0 DFES_OneToOne 0.00 255.0 FORMAT "%5.1" /end CHARACTERISTIC
/begin CHARACTERISTIC DFES_FaultTyp.DFC_UegoSigWireScbS1B1_C "assigned fault type / Fault type assignment for check DFC_UegoSigWireScbS1B1" VALUE 0x80504E56 Val_Wu8 255.0 DFES_OneToOne 0.00 255.0 FORMAT "%5.1" /end CHARACTERISTIC
/begin CHARACTERISTIC DFES_FaultTyp.DFC_UegoSigWireScgS1B1_C "assigned fault type / Fault type assignment for check DFC_UegoSigWireScgS1B1" VALUE 0x80504E57 Val_Wu8 255.0 DFES_OneToOne 0.00 255.0 FORMAT "%5.1" /end CHARACTERISTIC
/begin CHARACTERISTIC DFES_FaultTyp.DFC_AfsPhyRngHiB1_C "assigned fault type / Fault type assignment for check DFC_AfsPhyRngHiB1" VALUE 0x80504E58 Val_Wu8 255.0 DFES_OneToOne 0.00 255.0 FORMAT "%5.1" /end CHARACTERISTIC
/begin CHARACTERISTIC DFES_FaultTyp.DFC_AfsPhyRngLoB1_C "assigned fault type / Fault type assignment for check DFC_AfsPhyRngLoB1" VALUE 0x80504E59 Val_Wu8 255.0 DFES_OneToOne 0.00 255.0 FORMAT "%5.1" /end CHARACTERISTIC
/begin CHARACTERISTIC DFES_FaultTyp.DFC_AirCCmprOL_C "assigned fault type / Fault type assignment for check DFC_AirCCmprOL" VALUE 0x80504E5A Val_Wu8 255.0 DFES_OneToOne 0.00 255.0 FORMAT "%5.1" /end CHARACTERISTIC
/begin CHARACTERISTIC DFES_FaultTyp.DFC_AirCCmprOvrTemp_C "assigned fault type / Fault type assignment for check DFC_AirCCmprOvrTemp" VALUE 0x80504E5B Val_Wu8 255.0 DFES_OneToOne 0.00 255.0 FORMAT "%5.1" /end CHARACTERISTIC
/begin CHARACTERISTIC DFES_FaultTyp.DFC_AirCCmprSCB_C "assigned fault type / Fault type assignment for check DFC_AirCCmprSCB" VALUE 0x80504E5C Val_Wu8 255.0 DFES_OneToOne 0.00 255.0 FORMAT "%5.1" /end CHARACTERISTIC
/begin CHARACTERISTIC DFES_FaultTyp.DFC_AirCCmprSCG_C "assigned fault type / Fault type assignment for check DFC_AirCCmprSCG" VALUE 0x80504E5D Val_Wu8 255.0 DFES_OneToOne 0.00 255.0 FORMAT "%5.1" /end CHARACTERISTIC
/begin CHARACTERISTIC DFES_FaultTyp.DFC_AltErr_C "assigned fault type / Fault type assignment for check DFC_AltErr" VALUE 0x80504E5E Val_Wu8 255.0 DFES_OneToOne 0.00 255.0 FORMAT "%5.1" /end CHARACTERISTIC
/begin CHARACTERISTIC DFES_FaultTyp.DFC_BattUSRCMax_C "assigned fault type / Fault type assignment for check DFC_BattUSRCMax" VALUE 0x80504E5F Val_Wu8 255.0 DFES_OneToOne 0.00 255.0 FORMAT "%5.1" /end CHARACTERISTIC
/begin CHARACTERISTIC DFES_FaultTyp.DFC_BattUSRCMin_C "assigned fault type / Fault type assignment for check DFC_BattUSRCMin" VALUE 0x80504E60 Val_Wu8 255.0 DFES_OneToOne 0.00 255.0 FORMAT "%5.1" /end CHARACTERISTIC
/begin CHARACTERISTIC DFES_FaultTyp.DFC_ComChksTCU1_C "assigned fault type / Fault type assignment for check DFC_ComChksTCU1" VALUE 0x80504E61 Val_Wu8 255.0 DFES_OneToOne 0.00 255.0 FORMAT "%5.1" /end CHARACTERISTIC
/begin CHARACTERISTIC DFES_FaultTyp.DFC_ComChksTCU11_C "assigned fault type / Fault type assignment for check DFC_ComChksTCU11" VALUE 0x80504E62 Val_Wu8 255.0 DFES_OneToOne 0.00 255.0 FORMAT "%5.1" /end CHARACTERISTIC
/begin CHARACTERISTIC DFES_FaultTyp.DFC_ComChksTCU12_C "assigned fault type / Fault type assignment for check DFC_ComChksTCU12" VALUE 0x80504E63 Val_Wu8 255.0 DFES_OneToOne 0.00 255.0 FORMAT "%5.1" /end CHARACTERISTIC
/begin CHARACTERISTIC DFES_FaultTyp.DFC_ComChksTCU13_C "assigned fault type / Fault type assignment for check DFC_ComChksTCU13" VALUE 0x80504E64 Val_Wu8 255.0 DFES_OneToOne 0.00 255.0 FORMAT "%5.1" /end CHARACTERISTIC
/begin CHARACTERISTIC DFES_FaultTyp.DFC_ComChksTCU2_C "assigned fault type / Fault type assignment for check DFC_ComChksTCU2" VALUE 0x80504E65 Val_Wu8 255.0 DFES_OneToOne 0.00 255.0 FORMAT "%5.1" /end CHARACTERISTIC
/begin CHARACTERISTIC DFES_FaultTyp.DFC_ComChksTCU3_C "assigned fault type / Fault type assignment for check DFC_ComChksTCU3" VALUE 0x80504E66 Val_Wu8 255.0 DFES_OneToOne 0.00 255.0 FORMAT "%5.1" /end CHARACTERISTIC
/begin CHARACTERISTIC DFES_FaultTyp.DFC_ComChksTCU4_C "assigned fault type / Fault type assignment for check DFC_ComChksTCU4" VALUE 0x80504E67 Val_Wu8 255.0 DFES_OneToOne 0.00 255.0 FORMAT "%5.1" /end CHARACTERISTIC
/begin CHARACTERISTIC DFES_FaultTyp.DFC_ComCntTCU1_C "assigned fault type / Fault type assignment for check DFC_ComCntTCU1" VALUE 0x80504E68 Val_Wu8 255.0 DFES_OneToOne 0.00 255.0 FORMAT "%5.1" /end CHARACTERISTIC
/begin CHARACTERISTIC DFES_FaultTyp.DFC_ComCntTCU11_C "assigned fault type / Fault type assignment for check DFC_ComCntTCU11" VALUE 0x80504E69 Val_Wu8 255.0 DFES_OneToOne 0.00 255.0 FORMAT "%5.1" /end CHARACTERISTIC
/begin CHARACTERISTIC DFES_FaultTyp.DFC_ComCntTCU12_C "assigned fault type / Fault type assignment for check DFC_ComCntTCU12" VALUE 0x80504E6A Val_Wu8 255.0 DFES_OneToOne 0.00 255.0 FORMAT "%5.1" /end CHARACTERISTIC
/begin CHARACTERISTIC DFES_FaultTyp.DFC_ComCntTCU13_C "assigned fault type / Fault type assignment for check DFC_ComCntTCU13" VALUE 0x80504E6B Val_Wu8 255.0 DFES_OneToOne 0.00 255.0 FORMAT "%5.1" /end CHARACTERISTIC
/begin CHARACTERISTIC DFES_FaultTyp.DFC_ComCntTCU2_C "assigned fault type / Fault type assignment for check DFC_ComCntTCU2" VALUE 0x80504E6C Val_Wu8 255.0 DFES_OneToOne 0.00 255.0 FORMAT "%5.1" /end CHARACTERISTIC
/begin CHARACTERISTIC DFES_FaultTyp.DFC_ComCntTCU3_C "assigned fault type / Fault type assignment for check DFC_ComCntTCU3" VALUE 0x80504E6D Val_Wu8 255.0 DFES_OneToOne 0.00 255.0 FORMAT "%5.1" /end CHARACTERISTIC
/begin CHARACTERISTIC DFES_FaultTyp.DFC_ComCntTCU4_C "assigned fault type / Fault type assignment for check DFC_ComCntTCU4" VALUE 0x80504E6E Val_Wu8 255.0 DFES_OneToOne 0.00 255.0 FORMAT "%5.1" /end CHARACTERISTIC
/begin CHARACTERISTIC DFES_FaultTyp.DFC_ComTOutTCU01_C "assigned fault type / Fault type assignment for check DFC_ComTOutTCU01" VALUE 0x80504E6F Val_Wu8 255.0 DFES_OneToOne 0.00 255.0 FORMAT "%5.1" /end CHARACTERISTIC
/begin CHARACTERISTIC DFES_FaultTyp.DFC_ComTOutTCU02_C "assigned fault type / Fault type assignment for check DFC_ComTOutTCU02" VALUE 0x80504E70 Val_Wu8 255.0 DFES_OneToOne 0.00 255.0 FORMAT "%5.1" /end CHARACTERISTIC
/begin CHARACTERISTIC DFES_FaultTyp.DFC_ComTOutTCU1_C "assigned fault type / Fault type assignment for check DFC_ComTOutTCU1" VALUE 0x80504E71 Val_Wu8 255.0 DFES_OneToOne 0.00 255.0 FORMAT "%5.1" /end CHARACTERISTIC
/begin CHARACTERISTIC DFES_FaultTyp.DFC_ComTOutTCU11_C "assigned fault type / Fault type assignment for check DFC_ComTOutTCU11" VALUE 0x80504E72 Val_Wu8 255.0 DFES_OneToOne 0.00 255.0 FORMAT "%5.1" /end CHARACTERISTIC
/begin CHARACTERISTIC DFES_FaultTyp.DFC_ComTOutTCU12_C "assigned fault type / Fault type assignment for check DFC_ComTOutTCU12" VALUE 0x80504E73 Val_Wu8 255.0 DFES_OneToOne 0.00 255.0 FORMAT "%5.1" /end CHARACTERISTIC
/begin CHARACTERISTIC DFES_FaultTyp.DFC_ComTOutTCU13_C "assigned fault type / Fault type assignment for check DFC_ComTOutTCU13" VALUE 0x80504E74 Val_Wu8 255.0 DFES_OneToOne 0.00 255.0 FORMAT "%5.1" /end CHARACTERISTIC
/begin CHARACTERISTIC DFES_FaultTyp.DFC_ComTOutTCU14_C "assigned fault type / Fault type assignment for check DFC_ComTOutTCU14" VALUE 0x80504E75 Val_Wu8 255.0 DFES_OneToOne 0.00 255.0 FORMAT "%5.1" /end CHARACTERISTIC
/begin CHARACTERISTIC DFES_FaultTyp.DFC_ComTOutTCU2_C "assigned fault type / Fault type assignment for check DFC_ComTOutTCU2" VALUE 0x80504E76 Val_Wu8 255.0 DFES_OneToOne 0.00 255.0 FORMAT "%5.1" /end CHARACTERISTIC
/begin CHARACTERISTIC DFES_FaultTyp.DFC_ComTOutTCU3_C "assigned fault type / Fault type assignment for check DFC_ComTOutTCU3" VALUE 0x80504E77 Val_Wu8 255.0 DFES_OneToOne 0.00 255.0 FORMAT "%5.1" /end CHARACTERISTIC
/begin CHARACTERISTIC DFES_FaultTyp.DFC_ComTOutTCU4_C "assigned fault type / Fault type assignment for check DFC_ComTOutTCU4" VALUE 0x80504E78 Val_Wu8 255.0 DFES_OneToOne 0.00 255.0 FORMAT "%5.1" /end CHARACTERISTIC
/begin CHARACTERISTIC DFES_FaultTyp.DFC_DevLibBattUHi_C "assigned fault type / Fault type assignment for check DFC_DevLibBattUHi" VALUE 0x80504E79 Val_Wu8 255.0 DFES_OneToOne 0.00 255.0 FORMAT "%5.1" /end CHARACTERISTIC
/begin CHARACTERISTIC DFES_FaultTyp.DFC_DevLibBattULo_C "assigned fault type / Fault type assignment for check DFC_DevLibBattULo" VALUE 0x80504E7A Val_Wu8 255.0 DFES_OneToOne 0.00 255.0 FORMAT "%5.1" /end CHARACTERISTIC
/begin CHARACTERISTIC DFES_FaultTyp.DFC_EGRVlvFailSafeActv_C "assigned fault type / Fault type assignment for check DFC_EGRVlvFailSafeActv" VALUE 0x80504E7B Val_Wu8 255.0 DFES_OneToOne 0.00 255.0 FORMAT "%5.1" /end CHARACTERISTIC
/begin CHARACTERISTIC DFES_FaultTyp.DFC_EGRVlvGovDvtCld_C "assigned fault type / Fault type assignment for check DFC_EGRVlvGovDvtCld" VALUE 0x80504E7C Val_Wu8 255.0 DFES_OneToOne 0.00 255.0 FORMAT "%5.1" /end CHARACTERISTIC
/begin CHARACTERISTIC DFES_FaultTyp.DFC_EGRVlvPhysSRCMax_C "assigned fault type / Fault type assignment for check DFC_EGRVlvPhysSRCMax" VALUE 0x80504E7D Val_Wu8 255.0 DFES_OneToOne 0.00 255.0 FORMAT "%5.1" /end CHARACTERISTIC
/begin CHARACTERISTIC DFES_FaultTyp.DFC_EGRVlvPhysSRCMin_C "assigned fault type / Fault type assignment for check DFC_EGRVlvPhysSRCMin" VALUE 0x80504E7E Val_Wu8 255.0 DFES_OneToOne 0.00 255.0 FORMAT "%5.1" /end CHARACTERISTIC
/begin CHARACTERISTIC DFES_FaultTyp.DFC_FanDIOOL_0_C "assigned fault type / Fault type assignment for check DFC_FanDIOOL_0" VALUE 0x80504E7F Val_Wu8 255.0 DFES_OneToOne 0.00 255.0 FORMAT "%5.1" /end CHARACTERISTIC
/begin CHARACTERISTIC DFES_FaultTyp.DFC_FanDIOOL_1_C "assigned fault type / Fault type assignment for check DFC_FanDIOOL_1" VALUE 0x80504E80 Val_Wu8 255.0 DFES_OneToOne 0.00 255.0 FORMAT "%5.1" /end CHARACTERISTIC
/begin CHARACTERISTIC DFES_FaultTyp.DFC_FanDIOOvrTemp_0_C "assigned fault type / Fault type assignment for check DFC_FanDIOOvrTemp_0" VALUE 0x80504E81 Val_Wu8 255.0 DFES_OneToOne 0.00 255.0 FORMAT "%5.1" /end CHARACTERISTIC
/begin CHARACTERISTIC DFES_FaultTyp.DFC_FanDIOOvrTemp_1_C "assigned fault type / Fault type assignment for check DFC_FanDIOOvrTemp_1" VALUE 0x80504E82 Val_Wu8 255.0 DFES_OneToOne 0.00 255.0 FORMAT "%5.1" /end CHARACTERISTIC
/begin CHARACTERISTIC DFES_FaultTyp.DFC_FanDIOSCB_0_C "assigned fault type / Fault type assignment for check DFC_FanDIOSCB_0" VALUE 0x80504E83 Val_Wu8 255.0 DFES_OneToOne 0.00 255.0 FORMAT "%5.1" /end CHARACTERISTIC
/begin CHARACTERISTIC DFES_FaultTyp.DFC_FanDIOSCB_1_C "assigned fault type / Fault type assignment for check DFC_FanDIOSCB_1" VALUE 0x80504E84 Val_Wu8 255.0 DFES_OneToOne 0.00 255.0 FORMAT "%5.1" /end CHARACTERISTIC
/begin CHARACTERISTIC DFES_FaultTyp.DFC_FanDIOSCG_0_C "assigned fault type / Fault type assignment for check DFC_FanDIOSCG_0" VALUE 0x80504E85 Val_Wu8 255.0 DFES_OneToOne 0.00 255.0 FORMAT "%5.1" /end CHARACTERISTIC
/begin CHARACTERISTIC DFES_FaultTyp.DFC_FanDIOSCG_1_C "assigned fault type / Fault type assignment for check DFC_FanDIOSCG_1" VALUE 0x80504E86 Val_Wu8 255.0 DFES_OneToOne 0.00 255.0 FORMAT "%5.1" /end CHARACTERISTIC
/begin CHARACTERISTIC DFES_FaultTyp.DFC_MRlyDcOL_C "assigned fault type / Fault type assignment for check DFC_MRlyDcOL" VALUE 0x80504E87 Val_Wu8 255.0 DFES_OneToOne 0.00 255.0 FORMAT "%5.1" /end CHARACTERISTIC
/begin CHARACTERISTIC DFES_FaultTyp.DFC_MRlyDcSCB_C "assigned fault type / Fault type assignment for check DFC_MRlyDcSCB" VALUE 0x80504E88 Val_Wu8 255.0 DFES_OneToOne 0.00 255.0 FORMAT "%5.1" /end CHARACTERISTIC
/begin CHARACTERISTIC DFES_FaultTyp.DFC_MRlyDcSCG_C "assigned fault type / Fault type assignment for check DFC_MRlyDcSCG" VALUE 0x80504E89 Val_Wu8 255.0 DFES_OneToOne 0.00 255.0 FORMAT "%5.1" /end CHARACTERISTIC
/begin CHARACTERISTIC DFES_FaultTyp.DFC_PSPOL_C "assigned fault type / Fault type assignment for check DFC_PSPOL" VALUE 0x80504E8A Val_Wu8 255.0 DFES_OneToOne 0.00 255.0 FORMAT "%5.1" /end CHARACTERISTIC
/begin CHARACTERISTIC DFES_FaultTyp.DFC_PSPOvrTemp_C "assigned fault type / Fault type assignment for check DFC_PSPOvrTemp" VALUE 0x80504E8B Val_Wu8 255.0 DFES_OneToOne 0.00 255.0 FORMAT "%5.1" /end CHARACTERISTIC
/begin CHARACTERISTIC DFES_FaultTyp.DFC_PSPSCB_C "assigned fault type / Fault type assignment for check DFC_PSPSCB" VALUE 0x80504E8C Val_Wu8 255.0 DFES_OneToOne 0.00 255.0 FORMAT "%5.1" /end CHARACTERISTIC
/begin CHARACTERISTIC DFES_FaultTyp.DFC_PSPSCG_C "assigned fault type / Fault type assignment for check DFC_PSPSCG" VALUE 0x80504E8D Val_Wu8 255.0 DFES_OneToOne 0.00 255.0 FORMAT "%5.1" /end CHARACTERISTIC
/begin CHARACTERISTIC DFES_FaultTyp.DFC_T50Err_C "assigned fault type / Fault type assignment for check DFC_T50Err" VALUE 0x80504E8E Val_Wu8 255.0 DFES_OneToOne 0.00 255.0 FORMAT "%5.1" /end CHARACTERISTIC
/begin CHARACTERISTIC DFES_FaultTyp.DFC_ThrVlvLoBattB1_C "assigned fault type / Fault type assignment for check DFC_ThrVlvLoBattB1" VALUE 0x80504E8F Val_Wu8 255.0 DFES_OneToOne 0.00 255.0 FORMAT "%5.1" /end CHARACTERISTIC
/begin CHARACTERISTIC DFES_FaultTyp.DFC_UegoSigOperPlausS1B1_C "assigned fault type / Fault type assignment for check DFC_UegoSigOperPlausS1B1" VALUE 0x80504E90 Val_Wu8 255.0 DFES_OneToOne 0.00 255.0 FORMAT "%5.1" /end CHARACTERISTIC
/begin CHARACTERISTIC DFES_FaultTyp.DFC_VehVPhysRngHi_C "assigned fault type / Fault type assignment for check DFC_VehVPhysRngHi" VALUE 0x80504E91 Val_Wu8 255.0 DFES_OneToOne 0.00 255.0 FORMAT "%5.1" /end CHARACTERISTIC
/begin CHARACTERISTIC DFES_FaultTyp.DFC_VehVSclOutOL_C "assigned fault type / Fault type assignment for check DFC_VehVSclOutOL" VALUE 0x80504E92 Val_Wu8 255.0 DFES_OneToOne 0.00 255.0 FORMAT "%5.1" /end CHARACTERISTIC
/begin CHARACTERISTIC DFES_FaultTyp.DFC_VehVSclOutOT_C "assigned fault type / Fault type assignment for check DFC_VehVSclOutOT" VALUE 0x80504E93 Val_Wu8 255.0 DFES_OneToOne 0.00 255.0 FORMAT "%5.1" /end CHARACTERISTIC
/begin CHARACTERISTIC DFES_FaultTyp.DFC_VehVSclOutSCB_C "assigned fault type / Fault type assignment for check DFC_VehVSclOutSCB" VALUE 0x80504E94 Val_Wu8 255.0 DFES_OneToOne 0.00 255.0 FORMAT "%5.1" /end CHARACTERISTIC
/begin CHARACTERISTIC DFES_FaultTyp.DFC_VehVSclOutSCG_C "assigned fault type / Fault type assignment for check DFC_VehVSclOutSCG" VALUE 0x80504E95 Val_Wu8 255.0 DFES_OneToOne 0.00 255.0 FORMAT "%5.1" /end CHARACTERISTIC
/begin CHARACTERISTIC DFES_FaultTyp.DFC_VehVSigFL_C "assigned fault type / Fault type assignment for check DFC_VehVSigFL" VALUE 0x80504E96 Val_Wu8 255.0 DFES_OneToOne 0.00 255.0 FORMAT "%5.1" /end CHARACTERISTIC
/begin CHARACTERISTIC DFES_FaultTyp.DFC_VehVSigFR_C "assigned fault type / Fault type assignment for check DFC_VehVSigFR" VALUE 0x80504E97 Val_Wu8 255.0 DFES_OneToOne 0.00 255.0 FORMAT "%5.1" /end CHARACTERISTIC
/begin CHARACTERISTIC DFES_FaultTyp.DFC_VehVSigRL_C "assigned fault type / Fault type assignment for check DFC_VehVSigRL" VALUE 0x80504E98 Val_Wu8 255.0 DFES_OneToOne 0.00 255.0 FORMAT "%5.1" /end CHARACTERISTIC
/begin CHARACTERISTIC DFES_FaultTyp.DFC_VehVSigRR_C "assigned fault type / Fault type assignment for check DFC_VehVSigRR" VALUE 0x80504E99 Val_Wu8 255.0 DFES_OneToOne 0.00 255.0 FORMAT "%5.1" /end CHARACTERISTIC
/begin CHARACTERISTIC DFES_FaultTyp.DFC_VehVSnsrARngHi_C "assigned fault type / Fault type assignment for check DFC_VehVSnsrARngHi" VALUE 0x80504E9A Val_Wu8 255.0 DFES_OneToOne 0.00 255.0 FORMAT "%5.1" /end CHARACTERISTIC
/begin CHARACTERISTIC DFES_FaultTyp.DFC_VehVSnsrBRngHi_C "assigned fault type / Fault type assignment for check DFC_VehVSnsrBRngHi" VALUE 0x80504E9B Val_Wu8 255.0 DFES_OneToOne 0.00 255.0 FORMAT "%5.1" /end CHARACTERISTIC
/begin CHARACTERISTIC DFES_FaultTyp.DFC_VehVSpdRtyDiag_C "assigned fault type / Fault type assignment for check DFC_VehVSpdRtyDiag" VALUE 0x80504E9C Val_Wu8 255.0 DFES_OneToOne 0.00 255.0 FORMAT "%5.1" /end CHARACTERISTIC
/begin CHARACTERISTIC DFES_FaultTyp.DFC_DHFHD_C "assigned fault type / Fault type assignment for check DFC_DHFHD" VALUE 0x80504E9D Val_Wu8 255.0 DFES_OneToOne 0.00 255.0 FORMAT "%5.1" /end CHARACTERISTIC
/begin CHARACTERISTIC DFES_FaultTyp.DFC_InjVlv_DI_DcDc_C "assigned fault type / Fault type assignment for check DFC_InjVlv_DI_DcDc" VALUE 0x80504E9E Val_Wu8 255.0 DFES_OneToOne 0.00 255.0 FORMAT "%5.1" /end CHARACTERISTIC
/begin CHARACTERISTIC DFES_FaultTyp.DFC_InjVlv_DI_NoLd_0_C "assigned fault type / Fault type assignment for check DFC_InjVlv_DI_NoLd_0" VALUE 0x80504E9F Val_Wu8 255.0 DFES_OneToOne 0.00 255.0 FORMAT "%5.1" /end CHARACTERISTIC
/begin CHARACTERISTIC DFES_FaultTyp.DFC_InjVlv_DI_NoLd_1_C "assigned fault type / Fault type assignment for check DFC_InjVlv_DI_NoLd_1" VALUE 0x80504EA0 Val_Wu8 255.0 DFES_OneToOne 0.00 255.0 FORMAT "%5.1" /end CHARACTERISTIC
/begin CHARACTERISTIC DFES_FaultTyp.DFC_InjVlv_DI_NoLd_2_C "assigned fault type / Fault type assignment for check DFC_InjVlv_DI_NoLd_2" VALUE 0x80504EA1 Val_Wu8 255.0 DFES_OneToOne 0.00 255.0 FORMAT "%5.1" /end CHARACTERISTIC
/begin CHARACTERISTIC DFES_FaultTyp.DFC_InjVlv_DI_NoLd_3_C "assigned fault type / Fault type assignment for check DFC_InjVlv_DI_NoLd_3" VALUE 0x80504EA2 Val_Wu8 255.0 DFES_OneToOne 0.00 255.0 FORMAT "%5.1" /end CHARACTERISTIC
/begin CHARACTERISTIC DFES_FaultTyp.DFC_InjVlv_DI_ScBnk_0_C "assigned fault type / Fault type assignment for check DFC_InjVlv_DI_ScBnk_0" VALUE 0x80504EA3 Val_Wu8 255.0 DFES_OneToOne 0.00 255.0 FORMAT "%5.1" /end CHARACTERISTIC
/begin CHARACTERISTIC DFES_FaultTyp.DFC_InjVlv_DI_ScBnk_1_C "assigned fault type / Fault type assignment for check DFC_InjVlv_DI_ScBnk_1" VALUE 0x80504EA4 Val_Wu8 255.0 DFES_OneToOne 0.00 255.0 FORMAT "%5.1" /end CHARACTERISTIC
/begin CHARACTERISTIC DFES_FaultTyp.DFC_InjVlv_DI_ScBnk_2_C "assigned fault type / Fault type assignment for check DFC_InjVlv_DI_ScBnk_2" VALUE 0x80504EA5 Val_Wu8 255.0 DFES_OneToOne 0.00 255.0 FORMAT "%5.1" /end CHARACTERISTIC
/begin CHARACTERISTIC DFES_FaultTyp.DFC_InjVlv_DI_ScBnk_3_C "assigned fault type / Fault type assignment for check DFC_InjVlv_DI_ScBnk_3" VALUE 0x80504EA6 Val_Wu8 255.0 DFES_OneToOne 0.00 255.0 FORMAT "%5.1" /end CHARACTERISTIC
/begin CHARACTERISTIC DFES_FaultTyp.DFC_InjVlv_DI_ScCyl_0_C "assigned fault type / Fault type assignment for check DFC_InjVlv_DI_ScCyl_0" VALUE 0x80504EA7 Val_Wu8 255.0 DFES_OneToOne 0.00 255.0 FORMAT "%5.1" /end CHARACTERISTIC
/begin CHARACTERISTIC DFES_FaultTyp.DFC_InjVlv_DI_ScCyl_1_C "assigned fault type / Fault type assignment for check DFC_InjVlv_DI_ScCyl_1" VALUE 0x80504EA8 Val_Wu8 255.0 DFES_OneToOne 0.00 255.0 FORMAT "%5.1" /end CHARACTERISTIC
/begin CHARACTERISTIC DFES_FaultTyp.DFC_InjVlv_DI_ScCyl_2_C "assigned fault type / Fault type assignment for check DFC_InjVlv_DI_ScCyl_2" VALUE 0x80504EA9 Val_Wu8 255.0 DFES_OneToOne 0.00 255.0 FORMAT "%5.1" /end CHARACTERISTIC
/begin CHARACTERISTIC DFES_FaultTyp.DFC_InjVlv_DI_ScCyl_3_C "assigned fault type / Fault type assignment for check DFC_InjVlv_DI_ScCyl_3" VALUE 0x80504EAA Val_Wu8 255.0 DFES_OneToOne 0.00 255.0 FORMAT "%5.1" /end CHARACTERISTIC
/begin CHARACTERISTIC DFES_FaultTyp.DFC_InjVlv_DI_ScHsLs_0_C "assigned fault type / Fault type assignment for check DFC_InjVlv_DI_ScHsLs_0" VALUE 0x80504EAB Val_Wu8 255.0 DFES_OneToOne 0.00 255.0 FORMAT "%5.1" /end CHARACTERISTIC
/begin CHARACTERISTIC DFES_FaultTyp.DFC_InjVlv_DI_ScHsLs_1_C "assigned fault type / Fault type assignment for check DFC_InjVlv_DI_ScHsLs_1" VALUE 0x80504EAC Val_Wu8 255.0 DFES_OneToOne 0.00 255.0 FORMAT "%5.1" /end CHARACTERISTIC
/begin CHARACTERISTIC DFES_FaultTyp.DFC_InjVlv_DI_ScHsLs_2_C "assigned fault type / Fault type assignment for check DFC_InjVlv_DI_ScHsLs_2" VALUE 0x80504EAD Val_Wu8 255.0 DFES_OneToOne 0.00 255.0 FORMAT "%5.1" /end CHARACTERISTIC
/begin CHARACTERISTIC DFES_FaultTyp.DFC_InjVlv_DI_ScHsLs_3_C "assigned fault type / Fault type assignment for check DFC_InjVlv_DI_ScHsLs_3" VALUE 0x80504EAE Val_Wu8 255.0 DFES_OneToOne 0.00 255.0 FORMAT "%5.1" /end CHARACTERISTIC
/begin CHARACTERISTIC DFES_FaultTyp.DFC_MfPsDiaOpenLoad1_C "assigned fault type / Fault type assignment for check DFC_MfPsDiaOpenLoad1" VALUE 0x80504EAF Val_Wu8 255.0 DFES_OneToOne 0.00 255.0 FORMAT "%5.1" /end CHARACTERISTIC
/begin CHARACTERISTIC DFES_FaultTyp.DFC_MfPsDiaScHiS1_C "assigned fault type / Fault type assignment for check DFC_MfPsDiaScHiS1" VALUE 0x80504EB0 Val_Wu8 255.0 DFES_OneToOne 0.00 255.0 FORMAT "%5.1" /end CHARACTERISTIC
/begin CHARACTERISTIC DFES_FaultTyp.DFC_MfPsDiaScHiSLowS1_C "assigned fault type / Fault type assignment for check DFC_MfPsDiaScHiSLowS1" VALUE 0x80504EB1 Val_Wu8 255.0 DFES_OneToOne 0.00 255.0 FORMAT "%5.1" /end CHARACTERISTIC
/begin CHARACTERISTIC DFES_FaultTyp.DFC_MfPsDiaScLowS1_C "assigned fault type / Fault type assignment for check DFC_MfPsDiaScLowS1" VALUE 0x80504EB2 Val_Wu8 255.0 DFES_OneToOne 0.00 255.0 FORMAT "%5.1" /end CHARACTERISTIC
/begin CHARACTERISTIC DFES_FaultTyp.DFC_ACEvpTPhysRngHi_C "assigned fault type / Fault type assignment for check DFC_ACEvpTPhysRngHi" VALUE 0x80504EB3 Val_Wu8 255.0 DFES_OneToOne 0.00 255.0 FORMAT "%5.1" /end CHARACTERISTIC
/begin CHARACTERISTIC DFES_FaultTyp.DFC_ACEvpTPhysRngLo_C "assigned fault type / Fault type assignment for check DFC_ACEvpTPhysRngLo" VALUE 0x80504EB4 Val_Wu8 255.0 DFES_OneToOne 0.00 255.0 FORMAT "%5.1" /end CHARACTERISTIC
/begin CHARACTERISTIC DFES_FaultTyp.DFC_ACEvpTSRCMax_C "assigned fault type / Fault type assignment for check DFC_ACEvpTSRCMax" VALUE 0x80504EB5 Val_Wu8 255.0 DFES_OneToOne 0.00 255.0 FORMAT "%5.1" /end CHARACTERISTIC
/begin CHARACTERISTIC DFES_FaultTyp.DFC_ACEvpTSRCMin_C "assigned fault type / Fault type assignment for check DFC_ACEvpTSRCMin" VALUE 0x80504EB6 Val_Wu8 255.0 DFES_OneToOne 0.00 255.0 FORMAT "%5.1" /end CHARACTERISTIC
/begin CHARACTERISTIC DFES_FaultTyp.DFC_AfsRawSigRngHiB1_C "assigned fault type / Fault type assignment for check DFC_AfsRawSigRngHiB1" VALUE 0x80504EB7 Val_Wu8 255.0 DFES_OneToOne 0.00 255.0 FORMAT "%5.1" /end CHARACTERISTIC
/begin CHARACTERISTIC DFES_FaultTyp.DFC_AfsRawSigRngLoB1_C "assigned fault type / Fault type assignment for check DFC_AfsRawSigRngLoB1" VALUE 0x80504EB8 Val_Wu8 255.0 DFES_OneToOne 0.00 255.0 FORMAT "%5.1" /end CHARACTERISTIC
/begin CHARACTERISTIC DFES_FaultTyp.DFC_AfsSnsrErrB1_C "assigned fault type / Fault type assignment for check DFC_AfsSnsrErrB1" VALUE 0x80504EB9 Val_Wu8 255.0 DFES_OneToOne 0.00 255.0 FORMAT "%5.1" /end CHARACTERISTIC
/begin CHARACTERISTIC DFES_FaultTyp.DFC_AirCClntPAnaSRCMax_C "assigned fault type / Fault type assignment for check DFC_AirCClntPAnaSRCMax" VALUE 0x80504EBA Val_Wu8 255.0 DFES_OneToOne 0.00 255.0 FORMAT "%5.1" /end CHARACTERISTIC
/begin CHARACTERISTIC DFES_FaultTyp.DFC_AirCClntPAnaSRCMin_C "assigned fault type / Fault type assignment for check DFC_AirCClntPAnaSRCMin" VALUE 0x80504EBB Val_Wu8 255.0 DFES_OneToOne 0.00 255.0 FORMAT "%5.1" /end CHARACTERISTIC
/begin CHARACTERISTIC DFES_FaultTyp.DFC_AirCSwtNpl_C "assigned fault type / Fault type assignment for check DFC_AirCSwtNpl" VALUE 0x80504EBC Val_Wu8 255.0 DFES_OneToOne 0.00 255.0 FORMAT "%5.1" /end CHARACTERISTIC
/begin CHARACTERISTIC DFES_FaultTyp.DFC_AirCSwtSig_C "assigned fault type / Fault type assignment for check DFC_AirCSwtSig" VALUE 0x80504EBD Val_Wu8 255.0 DFES_OneToOne 0.00 255.0 FORMAT "%5.1" /end CHARACTERISTIC
/begin CHARACTERISTIC DFES_FaultTyp.DFC_Brk_C "assigned fault type / Fault type assignment for check DFC_Brk" VALUE 0x80504EBE Val_Wu8 255.0 DFES_OneToOne 0.00 255.0 FORMAT "%5.1" /end CHARACTERISTIC
/begin CHARACTERISTIC DFES_FaultTyp.DFC_BrkBstSensSCB_C "assigned fault type / Fault type assignment for check DFC_BrkBstSensSCB" VALUE 0x80504EBF Val_Wu8 255.0 DFES_OneToOne 0.00 255.0 FORMAT "%5.1" /end CHARACTERISTIC
/begin CHARACTERISTIC DFES_FaultTyp.DFC_BrkBstSensSCG_C "assigned fault type / Fault type assignment for check DFC_BrkBstSensSCG" VALUE 0x80504EC0 Val_Wu8 255.0 DFES_OneToOne 0.00 255.0 FORMAT "%5.1" /end CHARACTERISTIC
/begin CHARACTERISTIC DFES_FaultTyp.DFC_BrkSig_C "assigned fault type / Fault type assignment for check DFC_BrkSig" VALUE 0x80504EC1 Val_Wu8 255.0 DFES_OneToOne 0.00 255.0 FORMAT "%5.1" /end CHARACTERISTIC
/begin CHARACTERISTIC DFES_FaultTyp.DFC_ClthSig_C "assigned fault type / Fault type assignment for check DFC_ClthSig" VALUE 0x80504EC2 Val_Wu8 255.0 DFES_OneToOne 0.00 255.0 FORMAT "%5.1" /end CHARACTERISTIC
/begin CHARACTERISTIC DFES_FaultTyp.DFC_EGRVlvCurrLim_C "assigned fault type / Fault type assignment for check DFC_EGRVlvCurrLim" VALUE 0x80504EC3 Val_Wu8 255.0 DFES_OneToOne 0.00 255.0 FORMAT "%5.1" /end CHARACTERISTIC
/begin CHARACTERISTIC DFES_FaultTyp.DFC_EGRVlvOL_C "assigned fault type / Fault type assignment for check DFC_EGRVlvOL" VALUE 0x80504EC4 Val_Wu8 255.0 DFES_OneToOne 0.00 255.0 FORMAT "%5.1" /end CHARACTERISTIC
/begin CHARACTERISTIC DFES_FaultTyp.DFC_EGRVlvOvrTemp_C "assigned fault type / Fault type assignment for check DFC_EGRVlvOvrTemp" VALUE 0x80504EC5 Val_Wu8 255.0 DFES_OneToOne 0.00 255.0 FORMAT "%5.1" /end CHARACTERISTIC
/begin CHARACTERISTIC DFES_FaultTyp.DFC_EGRVlvSCB_C "assigned fault type / Fault type assignment for check DFC_EGRVlvSCB" VALUE 0x80504EC6 Val_Wu8 255.0 DFES_OneToOne 0.00 255.0 FORMAT "%5.1" /end CHARACTERISTIC
/begin CHARACTERISTIC DFES_FaultTyp.DFC_EGRVlvSCG_C "assigned fault type / Fault type assignment for check DFC_EGRVlvSCG" VALUE 0x80504EC7 Val_Wu8 255.0 DFES_OneToOne 0.00 255.0 FORMAT "%5.1" /end CHARACTERISTIC
/begin CHARACTERISTIC DFES_FaultTyp.DFC_EGRVlvSRCMax_C "assigned fault type / Fault type assignment for check DFC_EGRVlvSRCMax" VALUE 0x80504EC8 Val_Wu8 255.0 DFES_OneToOne 0.00 255.0 FORMAT "%5.1" /end CHARACTERISTIC
/begin CHARACTERISTIC DFES_FaultTyp.DFC_EGRVlvSRCMin_C "assigned fault type / Fault type assignment for check DFC_EGRVlvSRCMin" VALUE 0x80504EC9 Val_Wu8 255.0 DFES_OneToOne 0.00 255.0 FORMAT "%5.1" /end CHARACTERISTIC
/begin CHARACTERISTIC DFES_FaultTyp.DFC_HLSDemOvhtEngLim_C "assigned fault type / Fault type assignment for check DFC_HLSDemOvhtEngLim" VALUE 0x80504ECA Val_Wu8 255.0 DFES_OneToOne 0.00 255.0 FORMAT "%5.1" /end CHARACTERISTIC
/begin CHARACTERISTIC DFES_FaultTyp.DFC_OilPSwmpSRCMax_C "assigned fault type / Fault type assignment for check DFC_OilPSwmpSRCMax" VALUE 0x80504ECB Val_Wu8 255.0 DFES_OneToOne 0.00 255.0 FORMAT "%5.1" /end CHARACTERISTIC
/begin CHARACTERISTIC DFES_FaultTyp.DFC_OilPSwmpSRCMin_C "assigned fault type / Fault type assignment for check DFC_OilPSwmpSRCMin" VALUE 0x80504ECC Val_Wu8 255.0 DFES_OneToOne 0.00 255.0 FORMAT "%5.1" /end CHARACTERISTIC
/begin CHARACTERISTIC DFES_FaultTyp.DFC_PIntkVUsLineHiB1_C "assigned fault type / Fault type assignment for check DFC_PIntkVUsLineHiB1" VALUE 0x80504ECD Val_Wu8 255.0 DFES_OneToOne 0.00 255.0 FORMAT "%5.1" /end CHARACTERISTIC
/begin CHARACTERISTIC DFES_FaultTyp.DFC_PIntkVUsLineLoB1_C "assigned fault type / Fault type assignment for check DFC_PIntkVUsLineLoB1" VALUE 0x80504ECE Val_Wu8 255.0 DFES_OneToOne 0.00 255.0 FORMAT "%5.1" /end CHARACTERISTIC
/begin CHARACTERISTIC DFES_FaultTyp.DFC_VehVPhysRngLo_C "assigned fault type / Fault type assignment for check DFC_VehVPhysRngLo" VALUE 0x80504ECF Val_Wu8 255.0 DFES_OneToOne 0.00 255.0 FORMAT "%5.1" /end CHARACTERISTIC
/begin CHARACTERISTIC DFES_FaultTyp.DFC_VehVSigCan_C "assigned fault type / Fault type assignment for check DFC_VehVSigCan" VALUE 0x80504ED0 Val_Wu8 255.0 DFES_OneToOne 0.00 255.0 FORMAT "%5.1" /end CHARACTERISTIC
/begin CHARACTERISTIC DFES_FaultTyp.DFC_VehVSigCanSafe_C "assigned fault type / Fault type assignment for check DFC_VehVSigCanSafe" VALUE 0x80504ED1 Val_Wu8 255.0 DFES_OneToOne 0.00 255.0 FORMAT "%5.1" /end CHARACTERISTIC
/begin CHARACTERISTIC DFES_FaultTyp.DFC_VlvLftFbOilPSnsrIntk11SRCMax_C "assigned fault type / Fault type assignment for check DFC_VlvLftFbOilPSnsrIntk11SRCMax" VALUE 0x80504ED2 Val_Wu8 255.0 DFES_OneToOne 0.00 255.0 FORMAT "%5.1" /end CHARACTERISTIC
/begin CHARACTERISTIC DFES_FaultTyp.DFC_VlvLftFbOilPSnsrIntk11SRCMin_C "assigned fault type / Fault type assignment for check DFC_VlvLftFbOilPSnsrIntk11SRCMin" VALUE 0x80504ED3 Val_Wu8 255.0 DFES_OneToOne 0.00 255.0 FORMAT "%5.1" /end CHARACTERISTIC
/begin CHARACTERISTIC DFES_FaultTyp.DFC_ClthNpl_C "assigned fault type / Fault type assignment for check DFC_ClthNpl" VALUE 0x80504ED4 Val_Wu8 255.0 DFES_OneToOne 0.00 255.0 FORMAT "%5.1" /end CHARACTERISTIC
/begin CHARACTERISTIC DFES_FaultTyp.DFC_GbxPNPosnDrvCdn_C "assigned fault type / Fault type assignment for check DFC_GbxPNPosnDrvCdn" VALUE 0x80504ED5 Val_Wu8 255.0 DFES_OneToOne 0.00 255.0 FORMAT "%5.1" /end CHARACTERISTIC
/begin CHARACTERISTIC DFES_FaultTyp.DFC_GbxPNPosnPlausy_C "assigned fault type / Fault type assignment for check DFC_GbxPNPosnPlausy" VALUE 0x80504ED6 Val_Wu8 255.0 DFES_OneToOne 0.00 255.0 FORMAT "%5.1" /end CHARACTERISTIC
/begin CHARACTERISTIC DFES_FaultTyp.DFC_AfsSigErrLineHiB1_C "assigned fault type / Fault type assignment for check DFC_AfsSigErrLineHiB1" VALUE 0x80504ED7 Val_Wu8 255.0 DFES_OneToOne 0.00 255.0 FORMAT "%5.1" /end CHARACTERISTIC
/begin CHARACTERISTIC DFES_FaultTyp.DFC_AfsSigErrLineLoB1_C "assigned fault type / Fault type assignment for check DFC_AfsSigErrLineLoB1" VALUE 0x80504ED8 Val_Wu8 255.0 DFES_OneToOne 0.00 255.0 FORMAT "%5.1" /end CHARACTERISTIC
/begin CHARACTERISTIC DFES_FaultTyp.DFC_PEnvCcMax_C "assigned fault type / Fault type assignment for check DFC_PEnvCcMax" VALUE 0x80504ED9 Val_Wu8 255.0 DFES_OneToOne 0.00 255.0 FORMAT "%5.1" /end CHARACTERISTIC
/begin CHARACTERISTIC DFES_FaultTyp.DFC_PEnvCcMin_C "assigned fault type / Fault type assignment for check DFC_PEnvCcMin" VALUE 0x80504EDA Val_Wu8 255.0 DFES_OneToOne 0.00 255.0 FORMAT "%5.1" /end CHARACTERISTIC
/begin CHARACTERISTIC DFES_FaultTyp.DFC_PEnvRngChkMax_C "assigned fault type / Fault type assignment for check DFC_PEnvRngChkMax" VALUE 0x80504EDB Val_Wu8 255.0 DFES_OneToOne 0.00 255.0 FORMAT "%5.1" /end CHARACTERISTIC
/begin CHARACTERISTIC DFES_FaultTyp.DFC_PEnvRngChkMin_C "assigned fault type / Fault type assignment for check DFC_PEnvRngChkMin" VALUE 0x80504EDC Val_Wu8 255.0 DFES_OneToOne 0.00 255.0 FORMAT "%5.1" /end CHARACTERISTIC
/begin CHARACTERISTIC DFES_FaultTyp.DFC_PEnvSnsrPlaus_C "assigned fault type / Fault type assignment for check DFC_PEnvSnsrPlaus" VALUE 0x80504EDD Val_Wu8 255.0 DFES_OneToOne 0.00 255.0 FORMAT "%5.1" /end CHARACTERISTIC
/begin CHARACTERISTIC DFES_FaultTyp.DFC_UEGOHeatrRlyPsOLS1B1_C "assigned fault type / Fault type assignment for check DFC_UEGOHeatrRlyPsOLS1B1" VALUE 0x80504EDE Val_Wu8 255.0 DFES_OneToOne 0.00 255.0 FORMAT "%5.1" /end CHARACTERISTIC
/begin CHARACTERISTIC DFES_FaultTyp.DFC_UEGOHeatrRlyPsSCBS1B1_C "assigned fault type / Fault type assignment for check DFC_UEGOHeatrRlyPsSCBS1B1" VALUE 0x80504EDF Val_Wu8 255.0 DFES_OneToOne 0.00 255.0 FORMAT "%5.1" /end CHARACTERISTIC
/begin CHARACTERISTIC DFES_FaultTyp.DFC_UEGOHeatrRlyPsSCGS1B1_C "assigned fault type / Fault type assignment for check DFC_UEGOHeatrRlyPsSCGS1B1" VALUE 0x80504EE0 Val_Wu8 255.0 DFES_OneToOne 0.00 255.0 FORMAT "%5.1" /end CHARACTERISTIC
/begin CHARACTERISTIC DFES_FaultTyp.DFC_UegoHeatrWireOlS1B1_C "assigned fault type / Fault type assignment for check DFC_UegoHeatrWireOlS1B1" VALUE 0x80504EE1 Val_Wu8 255.0 DFES_OneToOne 0.00 255.0 FORMAT "%5.1" /end CHARACTERISTIC
/begin CHARACTERISTIC DFES_FaultTyp.DFC_UegoHeatrWireScbS1B1_C "assigned fault type / Fault type assignment for check DFC_UegoHeatrWireScbS1B1" VALUE 0x80504EE2 Val_Wu8 255.0 DFES_OneToOne 0.00 255.0 FORMAT "%5.1" /end CHARACTERISTIC
/begin CHARACTERISTIC DFES_FaultTyp.DFC_UegoHeatrWireScgS1B1_C "assigned fault type / Fault type assignment for check DFC_UegoHeatrWireScgS1B1" VALUE 0x80504EE3 Val_Wu8 255.0 DFES_OneToOne 0.00 255.0 FORMAT "%5.1" /end CHARACTERISTIC
/begin CHARACTERISTIC DFES_FaultTyp.DFC_KnDetSens1PortAMax_C "assigned fault type / Fault type assignment for check DFC_KnDetSens1PortAMax" VALUE 0x80504EE4 Val_Wu8 255.0 DFES_OneToOne 0.00 255.0 FORMAT "%5.1" /end CHARACTERISTIC
/begin CHARACTERISTIC DFES_FaultTyp.DFC_KnDetSens1PortAMin_C "assigned fault type / Fault type assignment for check DFC_KnDetSens1PortAMin" VALUE 0x80504EE5 Val_Wu8 255.0 DFES_OneToOne 0.00 255.0 FORMAT "%5.1" /end CHARACTERISTIC
/begin CHARACTERISTIC DFES_FaultTyp.DFC_KnDetSens1PortBMax_C "assigned fault type / Fault type assignment for check DFC_KnDetSens1PortBMax" VALUE 0x80504EE6 Val_Wu8 255.0 DFES_OneToOne 0.00 255.0 FORMAT "%5.1" /end CHARACTERISTIC
/begin CHARACTERISTIC DFES_FaultTyp.DFC_KnDetSens1PortBMin_C "assigned fault type / Fault type assignment for check DFC_KnDetSens1PortBMin" VALUE 0x80504EE7 Val_Wu8 255.0 DFES_OneToOne 0.00 255.0 FORMAT "%5.1" /end CHARACTERISTIC
/begin CHARACTERISTIC DFES_FaultTyp.DFC_Clth2ONStuck_C "assigned fault type / Fault type assignment for check DFC_Clth2ONStuck" VALUE 0x80504EE8 Val_Wu8 255.0 DFES_OneToOne 0.00 255.0 FORMAT "%5.1" /end CHARACTERISTIC
/begin CHARACTERISTIC DFES_FaultTyp.DFC_Clth2ONStuckLdc_C "assigned fault type / Fault type assignment for check DFC_Clth2ONStuckLdc" VALUE 0x80504EE9 Val_Wu8 255.0 DFES_OneToOne 0.00 255.0 FORMAT "%5.1" /end CHARACTERISTIC
/begin CHARACTERISTIC DFES_FaultTyp.DFC_Clth3ONStuckLdc_C "assigned fault type / Fault type assignment for check DFC_Clth3ONStuckLdc" VALUE 0x80504EEA Val_Wu8 255.0 DFES_OneToOne 0.00 255.0 FORMAT "%5.1" /end CHARACTERISTIC
/begin CHARACTERISTIC DFES_FaultTyp.DFC_Clth3ONStuckPostDrv_C "assigned fault type / Fault type assignment for check DFC_Clth3ONStuckPostDrv" VALUE 0x80504EEB Val_Wu8 255.0 DFES_OneToOne 0.00 255.0 FORMAT "%5.1" /end CHARACTERISTIC
/begin CHARACTERISTIC DFES_FaultTyp.DFC_Clth4ONStuck_C "assigned fault type / Fault type assignment for check DFC_Clth4ONStuck" VALUE 0x80504EEC Val_Wu8 255.0 DFES_OneToOne 0.00 255.0 FORMAT "%5.1" /end CHARACTERISTIC
/begin CHARACTERISTIC DFES_FaultTyp.DFC_Clth4ONStuckLdc_C "assigned fault type / Fault type assignment for check DFC_Clth4ONStuckLdc" VALUE 0x80504EED Val_Wu8 255.0 DFES_OneToOne 0.00 255.0 FORMAT "%5.1" /end CHARACTERISTIC
/begin CHARACTERISTIC DFES_FaultTyp.DFC_ComBCMUnit_C "assigned fault type / Fault type assignment for check DFC_ComBCMUnit" VALUE 0x80504EEE Val_Wu8 255.0 DFES_OneToOne 0.00 255.0 FORMAT "%5.1" /end CHARACTERISTIC
/begin CHARACTERISTIC DFES_FaultTyp.DFC_ComDLCTCU01_C "assigned fault type / Fault type assignment for check DFC_ComDLCTCU01" VALUE 0x80504EEF Val_Wu8 255.0 DFES_OneToOne 0.00 255.0 FORMAT "%5.1" /end CHARACTERISTIC
/begin CHARACTERISTIC DFES_FaultTyp.DFC_ComDLCTCU02_C "assigned fault type / Fault type assignment for check DFC_ComDLCTCU02" VALUE 0x80504EF0 Val_Wu8 255.0 DFES_OneToOne 0.00 255.0 FORMAT "%5.1" /end CHARACTERISTIC
/begin CHARACTERISTIC DFES_FaultTyp.DFC_ComDLCTCU1_C "assigned fault type / Fault type assignment for check DFC_ComDLCTCU1" VALUE 0x80504EF1 Val_Wu8 255.0 DFES_OneToOne 0.00 255.0 FORMAT "%5.1" /end CHARACTERISTIC
/begin CHARACTERISTIC DFES_FaultTyp.DFC_ComDLCTCU11_C "assigned fault type / Fault type assignment for check DFC_ComDLCTCU11" VALUE 0x80504EF2 Val_Wu8 255.0 DFES_OneToOne 0.00 255.0 FORMAT "%5.1" /end CHARACTERISTIC
/begin CHARACTERISTIC DFES_FaultTyp.DFC_ComDLCTCU12_C "assigned fault type / Fault type assignment for check DFC_ComDLCTCU12" VALUE 0x80504EF3 Val_Wu8 255.0 DFES_OneToOne 0.00 255.0 FORMAT "%5.1" /end CHARACTERISTIC
/begin CHARACTERISTIC DFES_FaultTyp.DFC_ComDLCTCU13_C "assigned fault type / Fault type assignment for check DFC_ComDLCTCU13" VALUE 0x80504EF4 Val_Wu8 255.0 DFES_OneToOne 0.00 255.0 FORMAT "%5.1" /end CHARACTERISTIC
/begin CHARACTERISTIC DFES_FaultTyp.DFC_ComDLCTCU14_C "assigned fault type / Fault type assignment for check DFC_ComDLCTCU14" VALUE 0x80504EF5 Val_Wu8 255.0 DFES_OneToOne 0.00 255.0 FORMAT "%5.1" /end CHARACTERISTIC
/begin CHARACTERISTIC DFES_FaultTyp.DFC_ComDLCTCU2_C "assigned fault type / Fault type assignment for check DFC_ComDLCTCU2" VALUE 0x80504EF6 Val_Wu8 255.0 DFES_OneToOne 0.00 255.0 FORMAT "%5.1" /end CHARACTERISTIC
/begin CHARACTERISTIC DFES_FaultTyp.DFC_ComDLCTCU3_C "assigned fault type / Fault type assignment for check DFC_ComDLCTCU3" VALUE 0x80504EF7 Val_Wu8 255.0 DFES_OneToOne 0.00 255.0 FORMAT "%5.1" /end CHARACTERISTIC
/begin CHARACTERISTIC DFES_FaultTyp.DFC_ComDLCTCU4_C "assigned fault type / Fault type assignment for check DFC_ComDLCTCU4" VALUE 0x80504EF8 Val_Wu8 255.0 DFES_OneToOne 0.00 255.0 FORMAT "%5.1" /end CHARACTERISTIC
/begin CHARACTERISTIC DFES_FaultTyp.DFC_ComEPSUnit_C "assigned fault type / Fault type assignment for check DFC_ComEPSUnit" VALUE 0x80504EF9 Val_Wu8 255.0 DFES_OneToOne 0.00 255.0 FORMAT "%5.1" /end CHARACTERISTIC
/begin CHARACTERISTIC DFES_FaultTyp.DFC_ComIDASBUnit_C "assigned fault type / Fault type assignment for check DFC_ComIDASBUnit" VALUE 0x80504EFA Val_Wu8 255.0 DFES_OneToOne 0.00 255.0 FORMAT "%5.1" /end CHARACTERISTIC
/begin CHARACTERISTIC DFES_FaultTyp.DFC_ComIMGUnit_C "assigned fault type / Fault type assignment for check DFC_ComIMGUnit" VALUE 0x80504EFB Val_Wu8 255.0 DFES_OneToOne 0.00 255.0 FORMAT "%5.1" /end CHARACTERISTIC
/begin CHARACTERISTIC DFES_FaultTyp.DFC_ComMETUnit_C "assigned fault type / Fault type assignment for check DFC_ComMETUnit" VALUE 0x80504EFC Val_Wu8 255.0 DFES_OneToOne 0.00 255.0 FORMAT "%5.1" /end CHARACTERISTIC
/begin CHARACTERISTIC DFES_FaultTyp.DFC_ComSRSUnit_C "assigned fault type / Fault type assignment for check DFC_ComSRSUnit" VALUE 0x80504EFD Val_Wu8 255.0 DFES_OneToOne 0.00 255.0 FORMAT "%5.1" /end CHARACTERISTIC
/begin CHARACTERISTIC DFES_FaultTyp.DFC_ComVSAUnit_C "assigned fault type / Fault type assignment for check DFC_ComVSAUnit" VALUE 0x80504EFE Val_Wu8 255.0 DFES_OneToOne 0.00 255.0 FORMAT "%5.1" /end CHARACTERISTIC
/begin CHARACTERISTIC DFES_FaultTyp.DFC_EbsSocFlt_C "assigned fault type / Fault type assignment for check DFC_EbsSocFlt" VALUE 0x80504EFF Val_Wu8 255.0 DFES_OneToOne 0.00 255.0 FORMAT "%5.1" /end CHARACTERISTIC
/begin CHARACTERISTIC DFES_FaultTyp.DFC_I14229VINErr_C "assigned fault type / Fault type assignment for check DFC_I14229VINErr" VALUE 0x80504F00 Val_Wu8 255.0 DFES_OneToOne 0.00 255.0 FORMAT "%5.1" /end CHARACTERISTIC
/begin CHARACTERISTIC DFES_FaultTyp.DFC_InjCatHeatgErr_C "assigned fault type / Fault type assignment for check DFC_InjCatHeatgErr" VALUE 0x80504F01 Val_Wu8 255.0 DFES_OneToOne 0.00 255.0 FORMAT "%5.1" /end CHARACTERISTIC
/begin CHARACTERISTIC DFES_FaultTyp.DFC_InjSysMulInjDiagErr_C "assigned fault type / Fault type assignment for check DFC_InjSysMulInjDiagErr" VALUE 0x80504F02 Val_Wu8 255.0 DFES_OneToOne 0.00 255.0 FORMAT "%5.1" /end CHARACTERISTIC
/begin CHARACTERISTIC DFES_FaultTyp.DFC_LLRHmax_C "assigned fault type / Fault type assignment for check DFC_LLRHmax" VALUE 0x80504F03 Val_Wu8 255.0 DFES_OneToOne 0.00 255.0 FORMAT "%5.1" /end CHARACTERISTIC
/begin CHARACTERISTIC DFES_FaultTyp.DFC_LLRHmin_C "assigned fault type / Fault type assignment for check DFC_LLRHmin" VALUE 0x80504F04 Val_Wu8 255.0 DFES_OneToOne 0.00 255.0 FORMAT "%5.1" /end CHARACTERISTIC
/begin CHARACTERISTIC DFES_FaultTyp.DFC_LLRHnpl_C "assigned fault type / Fault type assignment for check DFC_LLRHnpl" VALUE 0x80504F05 Val_Wu8 255.0 DFES_OneToOne 0.00 255.0 FORMAT "%5.1" /end CHARACTERISTIC
/begin CHARACTERISTIC DFES_FaultTyp.DFC_LLRKHmax_C "assigned fault type / Fault type assignment for check DFC_LLRKHmax" VALUE 0x80504F06 Val_Wu8 255.0 DFES_OneToOne 0.00 255.0 FORMAT "%5.1" /end CHARACTERISTIC
/begin CHARACTERISTIC DFES_FaultTyp.DFC_LLRKHmin_C "assigned fault type / Fault type assignment for check DFC_LLRKHmin" VALUE 0x80504F07 Val_Wu8 255.0 DFES_OneToOne 0.00 255.0 FORMAT "%5.1" /end CHARACTERISTIC
/begin CHARACTERISTIC DFES_FaultTyp.DFC_LLRKHnpl_C "assigned fault type / Fault type assignment for check DFC_LLRKHnpl" VALUE 0x80504F08 Val_Wu8 255.0 DFES_OneToOne 0.00 255.0 FORMAT "%5.1" /end CHARACTERISTIC
/begin CHARACTERISTIC DFES_FaultTyp.DFC_LinACGUnit_C "assigned fault type / Fault type assignment for check DFC_LinACGUnit" VALUE 0x80504F09 Val_Wu8 255.0 DFES_OneToOne 0.00 255.0 FORMAT "%5.1" /end CHARACTERISTIC
/begin CHARACTERISTIC DFES_FaultTyp.DFC_LinAEVUnit_C "assigned fault type / Fault type assignment for check DFC_LinAEVUnit" VALUE 0x80504F0A Val_Wu8 255.0 DFES_OneToOne 0.00 255.0 FORMAT "%5.1" /end CHARACTERISTIC
/begin CHARACTERISTIC DFES_FaultTyp.DFC_LinEBSUnit_C "assigned fault type / Fault type assignment for check DFC_LinEBSUnit" VALUE 0x80504F0B Val_Wu8 255.0 DFES_OneToOne 0.00 255.0 FORMAT "%5.1" /end CHARACTERISTIC
/begin CHARACTERISTIC DFES_FaultTyp.DFC_RoughRoad_C "assigned fault type / Fault type assignment for check DFC_RoughRoad" VALUE 0x80504F0C Val_Wu8 255.0 DFES_OneToOne 0.00 255.0 FORMAT "%5.1" /end CHARACTERISTIC
/begin CHARACTERISTIC DFES_FaultTyp.DFC_SiaEEPRdErr_C "assigned fault type / Fault type assignment for check DFC_SiaEEPRdErr" VALUE 0x80504F0D Val_Wu8 255.0 DFES_OneToOne 0.00 255.0 FORMAT "%5.1" /end CHARACTERISTIC
/begin CHARACTERISTIC DFES_FaultTyp.DFC_SiaEEPWrngCod_C "assigned fault type / Fault type assignment for check DFC_SiaEEPWrngCod" VALUE 0x80504F0E Val_Wu8 255.0 DFES_OneToOne 0.00 255.0 FORMAT "%5.1" /end CHARACTERISTIC
/begin CHARACTERISTIC DFES_FaultTyp.DFC_UegoHeatrStrtS1B1_C "assigned fault type / Fault type assignment for check DFC_UegoHeatrStrtS1B1" VALUE 0x80504F0F Val_Wu8 255.0 DFES_OneToOne 0.00 255.0 FORMAT "%5.1" /end CHARACTERISTIC
/begin CHARACTERISTIC DFES_FaultTyp.DFC_BusDiagCANAPPLBusOff_C "assigned fault type / Fault type assignment for check DFC_BusDiagCANAPPLBusOff" VALUE 0x80504F10 Val_Wu8 255.0 DFES_OneToOne 0.00 255.0 FORMAT "%5.1" /end CHARACTERISTIC
/begin CHARACTERISTIC DFES_FaultTyp.DFC_BusDiagCANCANCBusOff_C "assigned fault type / Fault type assignment for check DFC_BusDiagCANCANCBusOff" VALUE 0x80504F11 Val_Wu8 255.0 DFES_OneToOne 0.00 255.0 FORMAT "%5.1" /end CHARACTERISTIC
/begin CHARACTERISTIC DFES_FaultTyp.DFC_BusDiagCANVEHICLEBusOff_C "assigned fault type / Fault type assignment for check DFC_BusDiagCANVEHICLEBusOff" VALUE 0x80504F12 Val_Wu8 255.0 DFES_OneToOne 0.00 255.0 FORMAT "%5.1" /end CHARACTERISTIC
/begin CHARACTERISTIC DFES_FaultTyp.DFC_RBA_IODIAGPWR_rba_IoExtCy329_SignalVltSply_0_C "assigned fault type / Fault type assignment for check DFC_RBA_IODIAGPWR_rba_IoExtCy329_SignalVltSply_0" VALUE 0x80504F13 Val_Wu8 255.0 DFES_OneToOne 0.00 255.0 FORMAT "%5.1" /end CHARACTERISTIC
/begin CHARACTERISTIC DFES_FaultTyp.DFC_RBA_IODIAGPWR_rba_IoExtCy329_SignalVltSply_0OT_C "assigned fault type / Fault type assignment for check DFC_RBA_IODIAGPWR_rba_IoExtCy329_SignalVltSply_0OT" VALUE 0x80504F14 Val_Wu8 255.0 DFES_OneToOne 0.00 255.0 FORMAT "%5.1" /end CHARACTERISTIC
/begin CHARACTERISTIC DFES_FaultTyp.DFC_RBA_IODIAGPWR_rba_IoExtCy329_SignalVltSply_0OV_C "assigned fault type / Fault type assignment for check DFC_RBA_IODIAGPWR_rba_IoExtCy329_SignalVltSply_0OV" VALUE 0x80504F15 Val_Wu8 255.0 DFES_OneToOne 0.00 255.0 FORMAT "%5.1" /end CHARACTERISTIC
/begin CHARACTERISTIC DFES_FaultTyp.DFC_RBA_IODIAGPWR_rba_IoExtCy329_SignalVltSply_0SCG_C "assigned fault type / Fault type assignment for check DFC_RBA_IODIAGPWR_rba_IoExtCy329_SignalVltSply_0SCG" VALUE 0x80504F16 Val_Wu8 255.0 DFES_OneToOne 0.00 255.0 FORMAT "%5.1" /end CHARACTERISTIC
/begin CHARACTERISTIC DFES_FaultTyp.DFC_RBA_IODIAGPWR_rba_IoExtCy329_SignalVltSply_0UV_C "assigned fault type / Fault type assignment for check DFC_RBA_IODIAGPWR_rba_IoExtCy329_SignalVltSply_0UV" VALUE 0x80504F17 Val_Wu8 255.0 DFES_OneToOne 0.00 255.0 FORMAT "%5.1" /end CHARACTERISTIC
/begin CHARACTERISTIC DFES_FaultTyp.DFC_RBA_IODIAGPWR_rba_IoExtCy329_SignalVltSply_1_C "assigned fault type / Fault type assignment for check DFC_RBA_IODIAGPWR_rba_IoExtCy329_SignalVltSply_1" VALUE 0x80504F18 Val_Wu8 255.0 DFES_OneToOne 0.00 255.0 FORMAT "%5.1" /end CHARACTERISTIC
/begin CHARACTERISTIC DFES_FaultTyp.DFC_RBA_IODIAGPWR_rba_IoExtCy329_SignalVltSply_1OT_C "assigned fault type / Fault type assignment for check DFC_RBA_IODIAGPWR_rba_IoExtCy329_SignalVltSply_1OT" VALUE 0x80504F19 Val_Wu8 255.0 DFES_OneToOne 0.00 255.0 FORMAT "%5.1" /end CHARACTERISTIC
/begin CHARACTERISTIC DFES_FaultTyp.DFC_RBA_IODIAGPWR_rba_IoExtCy329_SignalVltSply_1OV_C "assigned fault type / Fault type assignment for check DFC_RBA_IODIAGPWR_rba_IoExtCy329_SignalVltSply_1OV" VALUE 0x80504F1A Val_Wu8 255.0 DFES_OneToOne 0.00 255.0 FORMAT "%5.1" /end CHARACTERISTIC
/begin CHARACTERISTIC DFES_FaultTyp.DFC_RBA_IODIAGPWR_rba_IoExtCy329_SignalVltSply_1SCG_C "assigned fault type / Fault type assignment for check DFC_RBA_IODIAGPWR_rba_IoExtCy329_SignalVltSply_1SCG" VALUE 0x80504F1B Val_Wu8 255.0 DFES_OneToOne 0.00 255.0 FORMAT "%5.1" /end CHARACTERISTIC
/begin CHARACTERISTIC DFES_FaultTyp.DFC_RBA_IODIAGPWR_rba_IoExtCy329_SignalVltSply_1UV_C "assigned fault type / Fault type assignment for check DFC_RBA_IODIAGPWR_rba_IoExtCy329_SignalVltSply_1UV" VALUE 0x80504F1C Val_Wu8 255.0 DFES_OneToOne 0.00 255.0 FORMAT "%5.1" /end CHARACTERISTIC
/begin CHARACTERISTIC DFES_FaultTyp.DFC_RBA_IODIAGPWR_rba_IoExtCy329_SignalVltSply_2_C "assigned fault type / Fault type assignment for check DFC_RBA_IODIAGPWR_rba_IoExtCy329_SignalVltSply_2" VALUE 0x80504F1D Val_Wu8 255.0 DFES_OneToOne 0.00 255.0 FORMAT "%5.1" /end CHARACTERISTIC
/begin CHARACTERISTIC DFES_FaultTyp.DFC_RBA_IODIAGPWR_rba_IoExtCy329_SignalVltSply_2OT_C "assigned fault type / Fault type assignment for check DFC_RBA_IODIAGPWR_rba_IoExtCy329_SignalVltSply_2OT" VALUE 0x80504F1E Val_Wu8 255.0 DFES_OneToOne 0.00 255.0 FORMAT "%5.1" /end CHARACTERISTIC
/begin CHARACTERISTIC DFES_FaultTyp.DFC_RBA_IODIAGPWR_rba_IoExtCy329_SignalVltSply_2OV_C "assigned fault type / Fault type assignment for check DFC_RBA_IODIAGPWR_rba_IoExtCy329_SignalVltSply_2OV" VALUE 0x80504F1F Val_Wu8 255.0 DFES_OneToOne 0.00 255.0 FORMAT "%5.1" /end CHARACTERISTIC
/begin CHARACTERISTIC DFES_FaultTyp.DFC_RBA_IODIAGPWR_rba_IoExtCy329_SignalVltSply_2SCG_C "assigned fault type / Fault type assignment for check DFC_RBA_IODIAGPWR_rba_IoExtCy329_SignalVltSply_2SCG" VALUE 0x80504F20 Val_Wu8 255.0 DFES_OneToOne 0.00 255.0 FORMAT "%5.1" /end CHARACTERISTIC
/begin CHARACTERISTIC DFES_FaultTyp.DFC_RBA_IODIAGPWR_rba_IoExtCy329_SignalVltSply_2UV_C "assigned fault type / Fault type assignment for check DFC_RBA_IODIAGPWR_rba_IoExtCy329_SignalVltSply_2UV" VALUE 0x80504F21 Val_Wu8 255.0 DFES_OneToOne 0.00 255.0 FORMAT "%5.1" /end CHARACTERISTIC
/begin CHARACTERISTIC DFES_FaultTyp.DFC_CAN_E_TIMEOUT_C "assigned fault type / Fault type assignment for check DFC_CAN_E_TIMEOUT" VALUE 0x80504F22 Val_Wu8 255.0 DFES_OneToOne 0.00 255.0 FORMAT "%5.1" /end CHARACTERISTIC
/begin CHARACTERISTIC DFES_FaultTyp.DFC_LIN_E_TIMEOUT_C "assigned fault type / Fault type assignment for check DFC_LIN_E_TIMEOUT" VALUE 0x80504F23 Val_Wu8 255.0 DFES_OneToOne 0.00 255.0 FORMAT "%5.1" /end CHARACTERISTIC
/begin CHARACTERISTIC DFES_FaultTyp.DFC_MRlyOL_C "assigned fault type / Fault type assignment for check DFC_MRlyOL" VALUE 0x80504F24 Val_Wu8 255.0 DFES_OneToOne 0.00 255.0 FORMAT "%5.1" /end CHARACTERISTIC
/begin CHARACTERISTIC DFES_FaultTyp.DFC_MRlySCB_C "assigned fault type / Fault type assignment for check DFC_MRlySCB" VALUE 0x80504F25 Val_Wu8 255.0 DFES_OneToOne 0.00 255.0 FORMAT "%5.1" /end CHARACTERISTIC
/begin CHARACTERISTIC DFES_FaultTyp.DFC_MRlySCG_C "assigned fault type / Fault type assignment for check DFC_MRlySCG" VALUE 0x80504F26 Val_Wu8 255.0 DFES_OneToOne 0.00 255.0 FORMAT "%5.1" /end CHARACTERISTIC
/begin CHARACTERISTIC DFES_FaultTyp.DFC_rba_MultiStackTrace_Threshold_C "assigned fault type / Fault type assignment for check DFC_rba_MultiStackTrace_Threshold" VALUE 0x80504F27 Val_Wu8 255.0 DFES_OneToOne 0.00 255.0 FORMAT "%5.1" /end CHARACTERISTIC
/begin CHARACTERISTIC DFES_FaultTyp.DFC_BSWM_E_ACTION_FAILED_C "assigned fault type / Fault type assignment for check DFC_BSWM_E_ACTION_FAILED" VALUE 0x80504F28 Val_Wu8 255.0 DFES_OneToOne 0.00 255.0 FORMAT "%5.1" /end CHARACTERISTIC
/begin CHARACTERISTIC DFES_FaultTyp.DFC_BSWM_E_INTRPTQUEUE_FULL_C "assigned fault type / Fault type assignment for check DFC_BSWM_E_INTRPTQUEUE_FULL" VALUE 0x80504F29 Val_Wu8 255.0 DFES_OneToOne 0.00 255.0 FORMAT "%5.1" /end CHARACTERISTIC
/begin CHARACTERISTIC DFES_FaultTyp.DFC_RBA_IOEXTLIB_KEEPALIVE_DRV_C "assigned fault type / Fault type assignment for check DFC_RBA_IOEXTLIB_KEEPALIVE_DRV" VALUE 0x80504F2A Val_Wu8 255.0 DFES_OneToOne 0.00 255.0 FORMAT "%5.1" /end CHARACTERISTIC
/begin CHARACTERISTIC DFES_FaultTyp.DFC_RBA_IOEXTLIB_KEEPALIVE_INI_C "assigned fault type / Fault type assignment for check DFC_RBA_IOEXTLIB_KEEPALIVE_INI" VALUE 0x80504F2B Val_Wu8 255.0 DFES_OneToOne 0.00 255.0 FORMAT "%5.1" /end CHARACTERISTIC
/begin CHARACTERISTIC DFES_FaultTyp.DFC_rba_IoSigRtc_StopCounter_C "assigned fault type / Fault type assignment for check DFC_rba_IoSigRtc_StopCounter" VALUE 0x80504F2C Val_Wu8 255.0 DFES_OneToOne 0.00 255.0 FORMAT "%5.1" /end CHARACTERISTIC
/begin CHARACTERISTIC DFES_FaultTyp.DFC_rba_MRly_Diag_Stk_Event_C "assigned fault type / Fault type assignment for check DFC_rba_MRly_Diag_Stk_Event" VALUE 0x80504F2D Val_Wu8 255.0 DFES_OneToOne 0.00 255.0 FORMAT "%5.1" /end CHARACTERISTIC
/begin CHARACTERISTIC DFES_FaultTyp.DFC_rba_MemDiag_MemReadErr_C "assigned fault type / Fault type assignment for check DFC_rba_MemDiag_MemReadErr" VALUE 0x80504F2E Val_Wu8 255.0 DFES_OneToOne 0.00 255.0 FORMAT "%5.1" /end CHARACTERISTIC
/begin CHARACTERISTIC DFES_FaultTyp.DFC_rba_MemDiag_MemWrErr_C "assigned fault type / Fault type assignment for check DFC_rba_MemDiag_MemWrErr" VALUE 0x80504F2F Val_Wu8 255.0 DFES_OneToOne 0.00 255.0 FORMAT "%5.1" /end CHARACTERISTIC
/begin CHARACTERISTIC DFES_FaultTyp.DFC_rba_SyC_IrrSwOffTrigEngRun_Event_C "assigned fault type / Fault type assignment for check DFC_rba_SyC_IrrSwOffTrigEngRun_Event" VALUE 0x80504F30 Val_Wu8 255.0 DFES_OneToOne 0.00 255.0 FORMAT "%5.1" /end CHARACTERISTIC
/begin CHARACTERISTIC DFES_FaultTyp.DFC_rba_T15_Diag_ComInVld_Event_C "assigned fault type / Fault type assignment for check DFC_rba_T15_Diag_ComInVld_Event" VALUE 0x80504F31 Val_Wu8 255.0 DFES_OneToOne 0.00 255.0 FORMAT "%5.1" /end CHARACTERISTIC
/begin CHARACTERISTIC DFES_FaultTyp.DFC_rba_T15_Diag_ComOff_HwOn_Event_C "assigned fault type / Fault type assignment for check DFC_rba_T15_Diag_ComOff_HwOn_Event" VALUE 0x80504F32 Val_Wu8 255.0 DFES_OneToOne 0.00 255.0 FORMAT "%5.1" /end CHARACTERISTIC
/begin CHARACTERISTIC DFES_FaultTyp.DFC_rba_T15_Diag_ComOn_HwOff_Event_C "assigned fault type / Fault type assignment for check DFC_rba_T15_Diag_ComOn_HwOff_Event" VALUE 0x80504F33 Val_Wu8 255.0 DFES_OneToOne 0.00 255.0 FORMAT "%5.1" /end CHARACTERISTIC
/begin CHARACTERISTIC DFES_FaultTyp.DFC_AAVmin_C "assigned fault type / Fault type assignment for check DFC_AAVmin" VALUE 0x80504F34 Val_Wu8 255.0 DFES_OneToOne 0.00 255.0 FORMAT "%5.1" /end CHARACTERISTIC
/begin CHARACTERISTIC DFES_FaultTyp.DFC_AGRSUS_C "assigned fault type / Fault type assignment for check DFC_AGRSUS" VALUE 0x80504F35 Val_Wu8 255.0 DFES_OneToOne 0.00 255.0 FORMAT "%5.1" /end CHARACTERISTIC
/begin CHARACTERISTIC DFES_FaultTyp.DFC_AfsPlausDiagHi_C "assigned fault type / Fault type assignment for check DFC_AfsPlausDiagHi" VALUE 0x80504F36 Val_Wu8 255.0 DFES_OneToOne 0.00 255.0 FORMAT "%5.1" /end CHARACTERISTIC
/begin CHARACTERISTIC DFES_FaultTyp.DFC_AfsPlausDiagLo_C "assigned fault type / Fault type assignment for check DFC_AfsPlausDiagLo" VALUE 0x80504F37 Val_Wu8 255.0 DFES_OneToOne 0.00 255.0 FORMAT "%5.1" /end CHARACTERISTIC
/begin CHARACTERISTIC DFES_FaultTyp.DFC_AfsVrntDiagErrB1_C "assigned fault type / Fault type assignment for check DFC_AfsVrntDiagErrB1" VALUE 0x80504F38 Val_Wu8 255.0 DFES_OneToOne 0.00 255.0 FORMAT "%5.1" /end CHARACTERISTIC
/begin CHARACTERISTIC DFES_FaultTyp.DFC_AppAllSnsrDfct_C "assigned fault type / Fault type assignment for check DFC_AppAllSnsrDfct" VALUE 0x80504F39 Val_Wu8 255.0 DFES_OneToOne 0.00 255.0 FORMAT "%5.1" /end CHARACTERISTIC
/begin CHARACTERISTIC DFES_FaultTyp.DFC_BBKRnldg_C "assigned fault type / Fault type assignment for check DFC_BBKRnldg" VALUE 0x80504F3A Val_Wu8 255.0 DFES_OneToOne 0.00 255.0 FORMAT "%5.1" /end CHARACTERISTIC
/begin CHARACTERISTIC DFES_FaultTyp.DFC_BBKRsyne_C "assigned fault type / Fault type assignment for check DFC_BBKRsyne" VALUE 0x80504F3B Val_Wu8 255.0 DFES_OneToOne 0.00 255.0 FORMAT "%5.1" /end CHARACTERISTIC
/begin CHARACTERISTIC DFES_FaultTyp.DFC_BattUStdbyDiaOL_C "assigned fault type / Fault type assignment for check DFC_BattUStdbyDiaOL" VALUE 0x80504F3C Val_Wu8 255.0 DFES_OneToOne 0.00 255.0 FORMAT "%5.1" /end CHARACTERISTIC
/begin CHARACTERISTIC DFES_FaultTyp.DFC_BigLeakIntkMnfldEmiInfl_C "assigned fault type / Fault type assignment for check DFC_BigLeakIntkMnfldEmiInfl" VALUE 0x80504F3D Val_Wu8 255.0 DFES_OneToOne 0.00 255.0 FORMAT "%5.1" /end CHARACTERISTIC
/begin CHARACTERISTIC DFES_FaultTyp.DFC_BlkdLineTank_C "assigned fault type / Fault type assignment for check DFC_BlkdLineTank" VALUE 0x80504F3E Val_Wu8 255.0 DFES_OneToOne 0.00 255.0 FORMAT "%5.1" /end CHARACTERISTIC
/begin CHARACTERISTIC DFES_FaultTyp.DFC_BrkMnSwtContOnWarnLmp_C "assigned fault type / Fault type assignment for check DFC_BrkMnSwtContOnWarnLmp" VALUE 0x80504F3F Val_Wu8 255.0 DFES_OneToOne 0.00 255.0 FORMAT "%5.1" /end CHARACTERISTIC
/begin CHARACTERISTIC DFES_FaultTyp.DFC_BrkMnSwtNotStpWarnLmp_C "assigned fault type / Fault type assignment for check DFC_BrkMnSwtNotStpWarnLmp" VALUE 0x80504F40 Val_Wu8 255.0 DFES_OneToOne 0.00 255.0 FORMAT "%5.1" /end CHARACTERISTIC
/begin CHARACTERISTIC DFES_FaultTyp.DFC_BrkRdntSwtContOnWarnLmp_C "assigned fault type / Fault type assignment for check DFC_BrkRdntSwtContOnWarnLmp" VALUE 0x80504F41 Val_Wu8 255.0 DFES_OneToOne 0.00 255.0 FORMAT "%5.1" /end CHARACTERISTIC
/begin CHARACTERISTIC DFES_FaultTyp.DFC_BrkRdntSwtNotStpWarnLmp_C "assigned fault type / Fault type assignment for check DFC_BrkRdntSwtNotStpWarnLmp" VALUE 0x80504F42 Val_Wu8 255.0 DFES_OneToOne 0.00 255.0 FORMAT "%5.1" /end CHARACTERISTIC
/begin CHARACTERISTIC DFES_FaultTyp.DFC_CEngDsTColdStrtMax_C "assigned fault type / Fault type assignment for check DFC_CEngDsTColdStrtMax" VALUE 0x80504F43 Val_Wu8 255.0 DFES_OneToOne 0.00 255.0 FORMAT "%5.1" /end CHARACTERISTIC
/begin CHARACTERISTIC DFES_FaultTyp.DFC_CEngDsTColdStrtMin_C "assigned fault type / Fault type assignment for check DFC_CEngDsTColdStrtMin" VALUE 0x80504F44 Val_Wu8 255.0 DFES_OneToOne 0.00 255.0 FORMAT "%5.1" /end CHARACTERISTIC
/begin CHARACTERISTIC DFES_FaultTyp.DFC_CEngDsTImps_C "assigned fault type / Fault type assignment for check DFC_CEngDsTImps" VALUE 0x80504F45 Val_Wu8 255.0 DFES_OneToOne 0.00 255.0 FORMAT "%5.1" /end CHARACTERISTIC
/begin CHARACTERISTIC DFES_FaultTyp.DFC_CEngDsTPlausHSC_C "assigned fault type / Fault type assignment for check DFC_CEngDsTPlausHSC" VALUE 0x80504F46 Val_Wu8 255.0 DFES_OneToOne 0.00 255.0 FORMAT "%5.1" /end CHARACTERISTIC
/begin CHARACTERISTIC DFES_FaultTyp.DFC_CEngDsTPlausLSC_C "assigned fault type / Fault type assignment for check DFC_CEngDsTPlausLSC" VALUE 0x80504F47 Val_Wu8 255.0 DFES_OneToOne 0.00 255.0 FORMAT "%5.1" /end CHARACTERISTIC
/begin CHARACTERISTIC DFES_FaultTyp.DFC_CEngDsTPlausSTC_C "assigned fault type / Fault type assignment for check DFC_CEngDsTPlausSTC" VALUE 0x80504F48 Val_Wu8 255.0 DFES_OneToOne 0.00 255.0 FORMAT "%5.1" /end CHARACTERISTIC
/begin CHARACTERISTIC DFES_FaultTyp.DFC_CEngDsTSRCMax_C "assigned fault type / Fault type assignment for check DFC_CEngDsTSRCMax" VALUE 0x80504F49 Val_Wu8 255.0 DFES_OneToOne 0.00 255.0 FORMAT "%5.1" /end CHARACTERISTIC
/begin CHARACTERISTIC DFES_FaultTyp.DFC_CEngDsTSRCMin_C "assigned fault type / Fault type assignment for check DFC_CEngDsTSRCMin" VALUE 0x80504F4A Val_Wu8 255.0 DFES_OneToOne 0.00 255.0 FORMAT "%5.1" /end CHARACTERISTIC
/begin CHARACTERISTIC DFES_FaultTyp.DFC_CEngDsTSig_C "assigned fault type / Fault type assignment for check DFC_CEngDsTSig" VALUE 0x80504F4B Val_Wu8 255.0 DFES_OneToOne 0.00 255.0 FORMAT "%5.1" /end CHARACTERISTIC
/begin CHARACTERISTIC DFES_FaultTyp.DFC_CEngUsTColdStrtMax_C "assigned fault type / Fault type assignment for check DFC_CEngUsTColdStrtMax" VALUE 0x80504F4C Val_Wu8 255.0 DFES_OneToOne 0.00 255.0 FORMAT "%5.1" /end CHARACTERISTIC
/begin CHARACTERISTIC DFES_FaultTyp.DFC_CEngUsTColdStrtMin_C "assigned fault type / Fault type assignment for check DFC_CEngUsTColdStrtMin" VALUE 0x80504F4D Val_Wu8 255.0 DFES_OneToOne 0.00 255.0 FORMAT "%5.1" /end CHARACTERISTIC
/begin CHARACTERISTIC DFES_FaultTyp.DFC_CEngUsTLooseCnctn_C "assigned fault type / Fault type assignment for check DFC_CEngUsTLooseCnctn" VALUE 0x80504F4E Val_Wu8 255.0 DFES_OneToOne 0.00 255.0 FORMAT "%5.1" /end CHARACTERISTIC
/begin CHARACTERISTIC DFES_FaultTyp.DFC_CEngUsTSRCMax_C "assigned fault type / Fault type assignment for check DFC_CEngUsTSRCMax" VALUE 0x80504F4F Val_Wu8 255.0 DFES_OneToOne 0.00 255.0 FORMAT "%5.1" /end CHARACTERISTIC
/begin CHARACTERISTIC DFES_FaultTyp.DFC_CEngUsTSRCMin_C "assigned fault type / Fault type assignment for check DFC_CEngUsTSRCMin" VALUE 0x80504F50 Val_Wu8 255.0 DFES_OneToOne 0.00 255.0 FORMAT "%5.1" /end CHARACTERISTIC
/begin CHARACTERISTIC DFES_FaultTyp.DFC_ComDCDCACCFailr_C "assigned fault type / Fault type assignment for check DFC_ComDCDCACCFailr" VALUE 0x80504F51 Val_Wu8 255.0 DFES_OneToOne 0.00 255.0 FORMAT "%5.1" /end CHARACTERISTIC
/begin CHARACTERISTIC DFES_FaultTyp.DFC_DCDCFltDet_C "assigned fault type / Fault type assignment for check DFC_DCDCFltDet" VALUE 0x80504F52 Val_Wu8 255.0 DFES_OneToOne 0.00 255.0 FORMAT "%5.1" /end CHARACTERISTIC
/begin CHARACTERISTIC DFES_FaultTyp.DFC_DKRSA_C "assigned fault type / Fault type assignment for check DFC_DKRSA" VALUE 0x80504F53 Val_Wu8 255.0 DFES_OneToOne 0.00 255.0 FORMAT "%5.1" /end CHARACTERISTIC
/begin CHARACTERISTIC DFES_FaultTyp.DFC_DKVSmax_C "assigned fault type / Fault type assignment for check DFC_DKVSmax" VALUE 0x80504F54 Val_Wu8 255.0 DFES_OneToOne 0.00 255.0 FORMAT "%5.1" /end CHARACTERISTIC
/begin CHARACTERISTIC DFES_FaultTyp.DFC_DKnpl_C "assigned fault type / Fault type assignment for check DFC_DKnpl" VALUE 0x80504F55 Val_Wu8 255.0 DFES_OneToOne 0.00 255.0 FORMAT "%5.1" /end CHARACTERISTIC
/begin CHARACTERISTIC DFES_FaultTyp.DFC_DSKVRmax_C "assigned fault type / Fault type assignment for check DFC_DSKVRmax" VALUE 0x80504F56 Val_Wu8 255.0 DFES_OneToOne 0.00 255.0 FORMAT "%5.1" /end CHARACTERISTIC
/begin CHARACTERISTIC DFES_FaultTyp.DFC_DSKVRmin_C "assigned fault type / Fault type assignment for check DFC_DSKVRmin" VALUE 0x80504F57 Val_Wu8 255.0 DFES_OneToOne 0.00 255.0 FORMAT "%5.1" /end CHARACTERISTIC
/begin CHARACTERISTIC DFES_FaultTyp.DFC_DSKVRnpl_C "assigned fault type / Fault type assignment for check DFC_DSKVRnpl" VALUE 0x80504F58 Val_Wu8 255.0 DFES_OneToOne 0.00 255.0 FORMAT "%5.1" /end CHARACTERISTIC
/begin CHARACTERISTIC DFES_FaultTyp.DFC_DSKVRsig_C "assigned fault type / Fault type assignment for check DFC_DSKVRsig" VALUE 0x80504F59 Val_Wu8 255.0 DFES_OneToOne 0.00 255.0 FORMAT "%5.1" /end CHARACTERISTIC
/begin CHARACTERISTIC DFES_FaultTyp.DFC_DSKVSsig_C "assigned fault type / Fault type assignment for check DFC_DSKVSsig" VALUE 0x80504F5A Val_Wu8 255.0 DFES_OneToOne 0.00 255.0 FORMAT "%5.1" /end CHARACTERISTIC
/begin CHARACTERISTIC DFES_FaultTyp.DFC_DSSmax_C "assigned fault type / Fault type assignment for check DFC_DSSmax" VALUE 0x80504F5B Val_Wu8 255.0 DFES_OneToOne 0.00 255.0 FORMAT "%5.1" /end CHARACTERISTIC
/begin CHARACTERISTIC DFES_FaultTyp.DFC_DSTDmax_C "assigned fault type / Fault type assignment for check DFC_DSTDmax" VALUE 0x80504F5C Val_Wu8 255.0 DFES_OneToOne 0.00 255.0 FORMAT "%5.1" /end CHARACTERISTIC
/begin CHARACTERISTIC DFES_FaultTyp.DFC_DSTEmax_C "assigned fault type / Fault type assignment for check DFC_DSTEmax" VALUE 0x80504F5D Val_Wu8 255.0 DFES_OneToOne 0.00 255.0 FORMAT "%5.1" /end CHARACTERISTIC
/begin CHARACTERISTIC DFES_FaultTyp.DFC_DSTEmin_C "assigned fault type / Fault type assignment for check DFC_DSTEmin" VALUE 0x80504F5E Val_Wu8 255.0 DFES_OneToOne 0.00 255.0 FORMAT "%5.1" /end CHARACTERISTIC
/begin CHARACTERISTIC DFES_FaultTyp.DFC_DSTOFmax_C "assigned fault type / Fault type assignment for check DFC_DSTOFmax" VALUE 0x80504F5F Val_Wu8 255.0 DFES_OneToOne 0.00 255.0 FORMAT "%5.1" /end CHARACTERISTIC
/begin CHARACTERISTIC DFES_FaultTyp.DFC_DSTRmax_C "assigned fault type / Fault type assignment for check DFC_DSTRmax" VALUE 0x80504F60 Val_Wu8 255.0 DFES_OneToOne 0.00 255.0 FORMAT "%5.1" /end CHARACTERISTIC
/begin CHARACTERISTIC DFES_FaultTyp.DFC_DSTRmin_C "assigned fault type / Fault type assignment for check DFC_DSTRmin" VALUE 0x80504F61 Val_Wu8 255.0 DFES_OneToOne 0.00 255.0 FORMAT "%5.1" /end CHARACTERISTIC
/begin CHARACTERISTIC DFES_FaultTyp.DFC_DSTRnpl_C "assigned fault type / Fault type assignment for check DFC_DSTRnpl" VALUE 0x80504F62 Val_Wu8 255.0 DFES_OneToOne 0.00 255.0 FORMAT "%5.1" /end CHARACTERISTIC
/begin CHARACTERISTIC DFES_FaultTyp.DFC_DSTRsig_C "assigned fault type / Fault type assignment for check DFC_DSTRsig" VALUE 0x80504F63 Val_Wu8 255.0 DFES_OneToOne 0.00 255.0 FORMAT "%5.1" /end CHARACTERISTIC
/begin CHARACTERISTIC DFES_FaultTyp.DFC_DSTTI_C "assigned fault type / Fault type assignment for check DFC_DSTTI" VALUE 0x80504F64 Val_Wu8 255.0 DFES_OneToOne 0.00 255.0 FORMAT "%5.1" /end CHARACTERISTIC
/begin CHARACTERISTIC DFES_FaultTyp.DFC_DSUmax_C "assigned fault type / Fault type assignment for check DFC_DSUmax" VALUE 0x80504F65 Val_Wu8 255.0 DFES_OneToOne 0.00 255.0 FORMAT "%5.1" /end CHARACTERISTIC
/begin CHARACTERISTIC DFES_FaultTyp.DFC_DiagCpv1DteskLoLoadStuckClsd_C "assigned fault type / Fault type assignment for check DFC_DiagCpv1DteskLoLoadStuckClsd" VALUE 0x80504F66 Val_Wu8 255.0 DFES_OneToOne 0.00 255.0 FORMAT "%5.1" /end CHARACTERISTIC
/begin CHARACTERISTIC DFES_FaultTyp.DFC_DiagCpv1DteskLoLoadStuckOpen_C "assigned fault type / Fault type assignment for check DFC_DiagCpv1DteskLoLoadStuckOpen" VALUE 0x80504F67 Val_Wu8 255.0 DFES_OneToOne 0.00 255.0 FORMAT "%5.1" /end CHARACTERISTIC
/begin CHARACTERISTIC DFES_FaultTyp.DFC_EGRVlvDrftClsd_C "assigned fault type / Fault type assignment for check DFC_EGRVlvDrftClsd" VALUE 0x80504F68 Val_Wu8 255.0 DFES_OneToOne 0.00 255.0 FORMAT "%5.1" /end CHARACTERISTIC
/begin CHARACTERISTIC DFES_FaultTyp.DFC_EGRVlvDrftOpn_C "assigned fault type / Fault type assignment for check DFC_EGRVlvDrftOpn" VALUE 0x80504F69 Val_Wu8 255.0 DFES_OneToOne 0.00 255.0 FORMAT "%5.1" /end CHARACTERISTIC
/begin CHARACTERISTIC DFES_FaultTyp.DFC_EGRVlvJamVlvClsd_C "assigned fault type / Fault type assignment for check DFC_EGRVlvJamVlvClsd" VALUE 0x80504F6A Val_Wu8 255.0 DFES_OneToOne 0.00 255.0 FORMAT "%5.1" /end CHARACTERISTIC
/begin CHARACTERISTIC DFES_FaultTyp.DFC_EGRVlvJamVlvOpn_C "assigned fault type / Fault type assignment for check DFC_EGRVlvJamVlvOpn" VALUE 0x80504F6B Val_Wu8 255.0 DFES_OneToOne 0.00 255.0 FORMAT "%5.1" /end CHARACTERISTIC
/begin CHARACTERISTIC DFES_FaultTyp.DFC_EGRVlvSprgBrk_C "assigned fault type / Fault type assignment for check DFC_EGRVlvSprgBrk" VALUE 0x80504F6C Val_Wu8 255.0 DFES_OneToOne 0.00 255.0 FORMAT "%5.1" /end CHARACTERISTIC
/begin CHARACTERISTIC DFES_FaultTyp.DFC_EGRVlvTempMdlEEPErr_C "assigned fault type / Fault type assignment for check DFC_EGRVlvTempMdlEEPErr" VALUE 0x80504F6D Val_Wu8 255.0 DFES_OneToOne 0.00 255.0 FORMAT "%5.1" /end CHARACTERISTIC
/begin CHARACTERISTIC DFES_FaultTyp.DFC_EGRVlvTmpErr_C "assigned fault type / Fault type assignment for check DFC_EGRVlvTmpErr" VALUE 0x80504F6E Val_Wu8 255.0 DFES_OneToOne 0.00 255.0 FORMAT "%5.1" /end CHARACTERISTIC
/begin CHARACTERISTIC DFES_FaultTyp.DFC_EGSDUS2B1LtrDly_C "assigned fault type / Fault type assignment for check DFC_EGSDUS2B1LtrDly" VALUE 0x80504F6F Val_Wu8 255.0 DFES_OneToOne 0.00 255.0 FORMAT "%5.1" /end CHARACTERISTIC
/begin CHARACTERISTIC DFES_FaultTyp.DFC_EGSDUS2B1LtrPT1_C "assigned fault type / Fault type assignment for check DFC_EGSDUS2B1LtrPT1" VALUE 0x80504F70 Val_Wu8 255.0 DFES_OneToOne 0.00 255.0 FORMAT "%5.1" /end CHARACTERISTIC
/begin CHARACTERISTIC DFES_FaultTyp.DFC_EGSDUS2B1RtlDly_C "assigned fault type / Fault type assignment for check DFC_EGSDUS2B1RtlDly" VALUE 0x80504F71 Val_Wu8 255.0 DFES_OneToOne 0.00 255.0 FORMAT "%5.1" /end CHARACTERISTIC
/begin CHARACTERISTIC DFES_FaultTyp.DFC_EGSDUS2B1RtlPT1_C "assigned fault type / Fault type assignment for check DFC_EGSDUS2B1RtlPT1" VALUE 0x80504F72 Val_Wu8 255.0 DFES_OneToOne 0.00 255.0 FORMAT "%5.1" /end CHARACTERISTIC
/begin CHARACTERISTIC DFES_FaultTyp.DFC_EGSDUS2B1TarLean_C "assigned fault type / Fault type assignment for check DFC_EGSDUS2B1TarLean" VALUE 0x80504F73 Val_Wu8 255.0 DFES_OneToOne 0.00 255.0 FORMAT "%5.1" /end CHARACTERISTIC
/begin CHARACTERISTIC DFES_FaultTyp.DFC_EGSDUS2B1TarRich_C "assigned fault type / Fault type assignment for check DFC_EGSDUS2B1TarRich" VALUE 0x80504F74 Val_Wu8 255.0 DFES_OneToOne 0.00 255.0 FORMAT "%5.1" /end CHARACTERISTIC
/begin CHARACTERISTIC DFES_FaultTyp.DFC_EONVmax_C "assigned fault type / Fault type assignment for check DFC_EONVmax" VALUE 0x80504F75 Val_Wu8 255.0 DFES_OneToOne 0.00 255.0 FORMAT "%5.1" /end CHARACTERISTIC
/begin CHARACTERISTIC DFES_FaultTyp.DFC_ETAKHLmax_C "assigned fault type / Fault type assignment for check DFC_ETAKHLmax" VALUE 0x80504F76 Val_Wu8 255.0 DFES_OneToOne 0.00 255.0 FORMAT "%5.1" /end CHARACTERISTIC
/begin CHARACTERISTIC DFES_FaultTyp.DFC_ETAKHTmax_C "assigned fault type / Fault type assignment for check DFC_ETAKHTmax" VALUE 0x80504F77 Val_Wu8 255.0 DFES_OneToOne 0.00 255.0 FORMAT "%5.1" /end CHARACTERISTIC
/begin CHARACTERISTIC DFES_FaultTyp.DFC_ETHSEmax_C "assigned fault type / Fault type assignment for check DFC_ETHSEmax" VALUE 0x80504F78 Val_Wu8 255.0 DFES_OneToOne 0.00 255.0 FORMAT "%5.1" /end CHARACTERISTIC
/begin CHARACTERISTIC DFES_FaultTyp.DFC_ETHSEmin_C "assigned fault type / Fault type assignment for check DFC_ETHSEmin" VALUE 0x80504F79 Val_Wu8 255.0 DFES_OneToOne 0.00 255.0 FORMAT "%5.1" /end CHARACTERISTIC
/begin CHARACTERISTIC DFES_FaultTyp.DFC_ETHSFmax_C "assigned fault type / Fault type assignment for check DFC_ETHSFmax" VALUE 0x80504F7A Val_Wu8 255.0 DFES_OneToOne 0.00 255.0 FORMAT "%5.1" /end CHARACTERISTIC
/begin CHARACTERISTIC DFES_FaultTyp.DFC_ETHSFmin_C "assigned fault type / Fault type assignment for check DFC_ETHSFmin" VALUE 0x80504F7B Val_Wu8 255.0 DFES_OneToOne 0.00 255.0 FORMAT "%5.1" /end CHARACTERISTIC
/begin CHARACTERISTIC DFES_FaultTyp.DFC_ETHSFsig_C "assigned fault type / Fault type assignment for check DFC_ETHSFsig" VALUE 0x80504F7C Val_Wu8 255.0 DFES_OneToOne 0.00 255.0 FORMAT "%5.1" /end CHARACTERISTIC
/begin CHARACTERISTIC DFES_FaultTyp.DFC_ETHSNPWmax_C "assigned fault type / Fault type assignment for check DFC_ETHSNPWmax" VALUE 0x80504F7D Val_Wu8 255.0 DFES_OneToOne 0.00 255.0 FORMAT "%5.1" /end CHARACTERISTIC
/begin CHARACTERISTIC DFES_FaultTyp.DFC_ETHSNPWmin_C "assigned fault type / Fault type assignment for check DFC_ETHSNPWmin" VALUE 0x80504F7E Val_Wu8 255.0 DFES_OneToOne 0.00 255.0 FORMAT "%5.1" /end CHARACTERISTIC
/begin CHARACTERISTIC DFES_FaultTyp.DFC_ETHSNPWsig_C "assigned fault type / Fault type assignment for check DFC_ETHSNPWsig" VALUE 0x80504F7F Val_Wu8 255.0 DFES_OneToOne 0.00 255.0 FORMAT "%5.1" /end CHARACTERISTIC
/begin CHARACTERISTIC DFES_FaultTyp.DFC_ETHSPLnpl_C "assigned fault type / Fault type assignment for check DFC_ETHSPLnpl" VALUE 0x80504F80 Val_Wu8 255.0 DFES_OneToOne 0.00 255.0 FORMAT "%5.1" /end CHARACTERISTIC
/begin CHARACTERISTIC DFES_FaultTyp.DFC_ETHSTPLnpl_C "assigned fault type / Fault type assignment for check DFC_ETHSTPLnpl" VALUE 0x80504F81 Val_Wu8 255.0 DFES_OneToOne 0.00 255.0 FORMAT "%5.1" /end CHARACTERISTIC
/begin CHARACTERISTIC DFES_FaultTyp.DFC_EngICO_C "assigned fault type / Fault type assignment for check DFC_EngICO" VALUE 0x80504F82 Val_Wu8 255.0 DFES_OneToOne 0.00 255.0 FORMAT "%5.1" /end CHARACTERISTIC
/begin CHARACTERISTIC DFES_FaultTyp.DFC_EngPrtOvrSpdMon_C "assigned fault type / Fault type assignment for check DFC_EngPrtOvrSpdMon" VALUE 0x80504F83 Val_Wu8 255.0 DFES_OneToOne 0.00 255.0 FORMAT "%5.1" /end CHARACTERISTIC
/begin CHARACTERISTIC DFES_FaultTyp.DFC_EpmCaSI1ErrSig_C "assigned fault type / Fault type assignment for check DFC_EpmCaSI1ErrSig" VALUE 0x80504F84 Val_Wu8 255.0 DFES_OneToOne 0.00 255.0 FORMAT "%5.1" /end CHARACTERISTIC
/begin CHARACTERISTIC DFES_FaultTyp.DFC_EpmCaSI1MntErr_C "assigned fault type / Fault type assignment for check DFC_EpmCaSI1MntErr" VALUE 0x80504F85 Val_Wu8 255.0 DFES_OneToOne 0.00 255.0 FORMAT "%5.1" /end CHARACTERISTIC
/begin CHARACTERISTIC DFES_FaultTyp.DFC_EpmCaSI1NoSigMax_C "assigned fault type / Fault type assignment for check DFC_EpmCaSI1NoSigMax" VALUE 0x80504F86 Val_Wu8 255.0 DFES_OneToOne 0.00 255.0 FORMAT "%5.1" /end CHARACTERISTIC
/begin CHARACTERISTIC DFES_FaultTyp.DFC_EpmCaSI1NoSigMin_C "assigned fault type / Fault type assignment for check DFC_EpmCaSI1NoSigMin" VALUE 0x80504F87 Val_Wu8 255.0 DFES_OneToOne 0.00 255.0 FORMAT "%5.1" /end CHARACTERISTIC
/begin CHARACTERISTIC DFES_FaultTyp.DFC_EpmCaSI1OfsErr_C "assigned fault type / Fault type assignment for check DFC_EpmCaSI1OfsErr" VALUE 0x80504F88 Val_Wu8 255.0 DFES_OneToOne 0.00 255.0 FORMAT "%5.1" /end CHARACTERISTIC
/begin CHARACTERISTIC DFES_FaultTyp.DFC_EpmCrSDGI_C "assigned fault type / Fault type assignment for check DFC_EpmCrSDGI" VALUE 0x80504F89 Val_Wu8 255.0 DFES_OneToOne 0.00 255.0 FORMAT "%5.1" /end CHARACTERISTIC
/begin CHARACTERISTIC DFES_FaultTyp.DFC_EpmCrSErrSig_C "assigned fault type / Fault type assignment for check DFC_EpmCrSErrSig" VALUE 0x80504F8A Val_Wu8 255.0 DFES_OneToOne 0.00 255.0 FORMAT "%5.1" /end CHARACTERISTIC
/begin CHARACTERISTIC DFES_FaultTyp.DFC_EpmCrSNoSig_C "assigned fault type / Fault type assignment for check DFC_EpmCrSNoSig" VALUE 0x80504F8B Val_Wu8 255.0 DFES_OneToOne 0.00 255.0 FORMAT "%5.1" /end CHARACTERISTIC
/begin CHARACTERISTIC DFES_FaultTyp.DFC_EtaEngIdleNonCsers_C "assigned fault type / Fault type assignment for check DFC_EtaEngIdleNonCsers" VALUE 0x80504F8C Val_Wu8 255.0 DFES_OneToOne 0.00 255.0 FORMAT "%5.1" /end CHARACTERISTIC
/begin CHARACTERISTIC DFES_FaultTyp.DFC_EtaEngPtlNonCsers_C "assigned fault type / Fault type assignment for check DFC_EtaEngPtlNonCsers" VALUE 0x80504F8D Val_Wu8 255.0 DFES_OneToOne 0.00 255.0 FORMAT "%5.1" /end CHARACTERISTIC
/begin CHARACTERISTIC DFES_FaultTyp.DFC_FRAmax_C "assigned fault type / Fault type assignment for check DFC_FRAmax" VALUE 0x80504F8E Val_Wu8 255.0 DFES_OneToOne 0.00 255.0 FORMAT "%5.1" /end CHARACTERISTIC
/begin CHARACTERISTIC DFES_FaultTyp.DFC_FRAmin_C "assigned fault type / Fault type assignment for check DFC_FRAmin" VALUE 0x80504F8F Val_Wu8 255.0 DFES_OneToOne 0.00 255.0 FORMAT "%5.1" /end CHARACTERISTIC
/begin CHARACTERISTIC DFES_FaultTyp.DFC_FSTEmax_C "assigned fault type / Fault type assignment for check DFC_FSTEmax" VALUE 0x80504F90 Val_Wu8 255.0 DFES_OneToOne 0.00 255.0 FORMAT "%5.1" /end CHARACTERISTIC
/begin CHARACTERISTIC DFES_FaultTyp.DFC_FSTEmin_C "assigned fault type / Fault type assignment for check DFC_FSTEmin" VALUE 0x80504F91 Val_Wu8 255.0 DFES_OneToOne 0.00 255.0 FORMAT "%5.1" /end CHARACTERISTIC
/begin CHARACTERISTIC DFES_FaultTyp.DFC_FSTRmax_C "assigned fault type / Fault type assignment for check DFC_FSTRmax" VALUE 0x80504F92 Val_Wu8 255.0 DFES_OneToOne 0.00 255.0 FORMAT "%5.1" /end CHARACTERISTIC
/begin CHARACTERISTIC DFES_FaultTyp.DFC_FSTRmin_C "assigned fault type / Fault type assignment for check DFC_FSTRmin" VALUE 0x80504F93 Val_Wu8 255.0 DFES_OneToOne 0.00 255.0 FORMAT "%5.1" /end CHARACTERISTIC
/begin CHARACTERISTIC DFES_FaultTyp.DFC_FSTRnpl_C "assigned fault type / Fault type assignment for check DFC_FSTRnpl" VALUE 0x80504F94 Val_Wu8 255.0 DFES_OneToOne 0.00 255.0 FORMAT "%5.1" /end CHARACTERISTIC
/begin CHARACTERISTIC DFES_FaultTyp.DFC_FSTmax_C "assigned fault type / Fault type assignment for check DFC_FSTmax" VALUE 0x80504F95 Val_Wu8 255.0 DFES_OneToOne 0.00 255.0 FORMAT "%5.1" /end CHARACTERISTIC
/begin CHARACTERISTIC DFES_FaultTyp.DFC_FTDLAmax_C "assigned fault type / Fault type assignment for check DFC_FTDLAmax" VALUE 0x80504F96 Val_Wu8 255.0 DFES_OneToOne 0.00 255.0 FORMAT "%5.1" /end CHARACTERISTIC
/begin CHARACTERISTIC DFES_FaultTyp.DFC_FTDLAmin_C "assigned fault type / Fault type assignment for check DFC_FTDLAmin" VALUE 0x80504F97 Val_Wu8 255.0 DFES_OneToOne 0.00 255.0 FORMAT "%5.1" /end CHARACTERISTIC
/begin CHARACTERISTIC DFES_FaultTyp.DFC_FuPHiSnsrEleclmax_C "assigned fault type / Fault type assignment for check DFC_FuPHiSnsrEleclmax" VALUE 0x80504F98 Val_Wu8 255.0 DFES_OneToOne 0.00 255.0 FORMAT "%5.1" /end CHARACTERISTIC
/begin CHARACTERISTIC DFES_FaultTyp.DFC_FuPHiSnsrEleclmin_C "assigned fault type / Fault type assignment for check DFC_FuPHiSnsrEleclmin" VALUE 0x80504F99 Val_Wu8 255.0 DFES_OneToOne 0.00 255.0 FORMAT "%5.1" /end CHARACTERISTIC
/begin CHARACTERISTIC DFES_FaultTyp.DFC_FuPHiSnsrEleclnpl_C "assigned fault type / Fault type assignment for check DFC_FuPHiSnsrEleclnpl" VALUE 0x80504F9A Val_Wu8 255.0 DFES_OneToOne 0.00 255.0 FORMAT "%5.1" /end CHARACTERISTIC
/begin CHARACTERISTIC DFES_FaultTyp.DFC_FuPHiSnsrURngMax_C "assigned fault type / Fault type assignment for check DFC_FuPHiSnsrURngMax" VALUE 0x80504F9B Val_Wu8 255.0 DFES_OneToOne 0.00 255.0 FORMAT "%5.1" /end CHARACTERISTIC
/begin CHARACTERISTIC DFES_FaultTyp.DFC_FuPHiSnsrURngMin_C "assigned fault type / Fault type assignment for check DFC_FuPHiSnsrURngMin" VALUE 0x80504F9C Val_Wu8 255.0 DFES_OneToOne 0.00 255.0 FORMAT "%5.1" /end CHARACTERISTIC
/begin CHARACTERISTIC DFES_FaultTyp.DFC_FuSnsrPhyRngMaxErr_C "assigned fault type / Fault type assignment for check DFC_FuSnsrPhyRngMaxErr" VALUE 0x80504F9D Val_Wu8 255.0 DFES_OneToOne 0.00 255.0 FORMAT "%5.1" /end CHARACTERISTIC
/begin CHARACTERISTIC DFES_FaultTyp.DFC_FuSnsrPhyRngMinErr_C "assigned fault type / Fault type assignment for check DFC_FuSnsrPhyRngMinErr" VALUE 0x80504F9E Val_Wu8 255.0 DFES_OneToOne 0.00 255.0 FORMAT "%5.1" /end CHARACTERISTIC
/begin CHARACTERISTIC DFES_FaultTyp.DFC_GEVlvLockPinDiagIntkB1_C "assigned fault type / Fault type assignment for check DFC_GEVlvLockPinDiagIntkB1" VALUE 0x80504F9F Val_Wu8 255.0 DFES_OneToOne 0.00 255.0 FORMAT "%5.1" /end CHARACTERISTIC
/begin CHARACTERISTIC DFES_FaultTyp.DFC_GEVlvPhaSlowIntkB1_C "assigned fault type / Fault type assignment for check DFC_GEVlvPhaSlowIntkB1" VALUE 0x80504FA0 Val_Wu8 255.0 DFES_OneToOne 0.00 255.0 FORMAT "%5.1" /end CHARACTERISTIC
/begin CHARACTERISTIC DFES_FaultTyp.DFC_GEVlvPhaTargIntkB1_C "assigned fault type / Fault type assignment for check DFC_GEVlvPhaTargIntkB1" VALUE 0x80504FA1 Val_Wu8 255.0 DFES_OneToOne 0.00 255.0 FORMAT "%5.1" /end CHARACTERISTIC
/begin CHARACTERISTIC DFES_FaultTyp.DFC_GbxRvsSwtStk_C "assigned fault type / Fault type assignment for check DFC_GbxRvsSwtStk" VALUE 0x80504FA2 Val_Wu8 255.0 DFES_OneToOne 0.00 255.0 FORMAT "%5.1" /end CHARACTERISTIC
/begin CHARACTERISTIC DFES_FaultTyp.DFC_HDRKHmax_C "assigned fault type / Fault type assignment for check DFC_HDRKHmax" VALUE 0x80504FA3 Val_Wu8 255.0 DFES_OneToOne 0.00 255.0 FORMAT "%5.1" /end CHARACTERISTIC
/begin CHARACTERISTIC DFES_FaultTyp.DFC_HDRKHmin_C "assigned fault type / Fault type assignment for check DFC_HDRKHmin" VALUE 0x80504FA4 Val_Wu8 255.0 DFES_OneToOne 0.00 255.0 FORMAT "%5.1" /end CHARACTERISTIC
/begin CHARACTERISTIC DFES_FaultTyp.DFC_HDRPLmax_C "assigned fault type / Fault type assignment for check DFC_HDRPLmax" VALUE 0x80504FA5 Val_Wu8 255.0 DFES_OneToOne 0.00 255.0 FORMAT "%5.1" /end CHARACTERISTIC
/begin CHARACTERISTIC DFES_FaultTyp.DFC_HDRPLmin_C "assigned fault type / Fault type assignment for check DFC_HDRPLmin" VALUE 0x80504FA6 Val_Wu8 255.0 DFES_OneToOne 0.00 255.0 FORMAT "%5.1" /end CHARACTERISTIC
/begin CHARACTERISTIC DFES_FaultTyp.DFC_HDRmax_C "assigned fault type / Fault type assignment for check DFC_HDRmax" VALUE 0x80504FA7 Val_Wu8 255.0 DFES_OneToOne 0.00 255.0 FORMAT "%5.1" /end CHARACTERISTIC
/begin CHARACTERISTIC DFES_FaultTyp.DFC_HDRmin_C "assigned fault type / Fault type assignment for check DFC_HDRmin" VALUE 0x80504FA8 Val_Wu8 255.0 DFES_OneToOne 0.00 255.0 FORMAT "%5.1" /end CHARACTERISTIC
/begin CHARACTERISTIC DFES_FaultTyp.DFC_HEGOS2B1ElecMax_C "assigned fault type / Fault type assignment for check DFC_HEGOS2B1ElecMax" VALUE 0x80504FA9 Val_Wu8 255.0 DFES_OneToOne 0.00 255.0 FORMAT "%5.1" /end CHARACTERISTIC
/begin CHARACTERISTIC DFES_FaultTyp.DFC_HEGOS2B1ElecMin_C "assigned fault type / Fault type assignment for check DFC_HEGOS2B1ElecMin" VALUE 0x80504FAA Val_Wu8 255.0 DFES_OneToOne 0.00 255.0 FORMAT "%5.1" /end CHARACTERISTIC
/begin CHARACTERISTIC DFES_FaultTyp.DFC_HEGOS2B1ElecSig_C "assigned fault type / Fault type assignment for check DFC_HEGOS2B1ElecSig" VALUE 0x80504FAB Val_Wu8 255.0 DFES_OneToOne 0.00 255.0 FORMAT "%5.1" /end CHARACTERISTIC
/begin CHARACTERISTIC DFES_FaultTyp.DFC_HEGOS2B1HtgNpl_C "assigned fault type / Fault type assignment for check DFC_HEGOS2B1HtgNpl" VALUE 0x80504FAC Val_Wu8 255.0 DFES_OneToOne 0.00 255.0 FORMAT "%5.1" /end CHARACTERISTIC
/begin CHARACTERISTIC DFES_FaultTyp.DFC_HEV00max_C "assigned fault type / Fault type assignment for check DFC_HEV00max" VALUE 0x80504FAD Val_Wu8 255.0 DFES_OneToOne 0.00 255.0 FORMAT "%5.1" /end CHARACTERISTIC
/begin CHARACTERISTIC DFES_FaultTyp.DFC_HEV01max_C "assigned fault type / Fault type assignment for check DFC_HEV01max" VALUE 0x80504FAE Val_Wu8 255.0 DFES_OneToOne 0.00 255.0 FORMAT "%5.1" /end CHARACTERISTIC
/begin CHARACTERISTIC DFES_FaultTyp.DFC_HEV02max_C "assigned fault type / Fault type assignment for check DFC_HEV02max" VALUE 0x80504FAF Val_Wu8 255.0 DFES_OneToOne 0.00 255.0 FORMAT "%5.1" /end CHARACTERISTIC
/begin CHARACTERISTIC DFES_FaultTyp.DFC_HEV03max_C "assigned fault type / Fault type assignment for check DFC_HEV03max" VALUE 0x80504FB0 Val_Wu8 255.0 DFES_OneToOne 0.00 255.0 FORMAT "%5.1" /end CHARACTERISTIC
/begin CHARACTERISTIC DFES_FaultTyp.DFC_HEVE0max_C "assigned fault type / Fault type assignment for check DFC_HEVE0max" VALUE 0x80504FB1 Val_Wu8 255.0 DFES_OneToOne 0.00 255.0 FORMAT "%5.1" /end CHARACTERISTIC
/begin CHARACTERISTIC DFES_FaultTyp.DFC_HEVE1max_C "assigned fault type / Fault type assignment for check DFC_HEVE1max" VALUE 0x80504FB2 Val_Wu8 255.0 DFES_OneToOne 0.00 255.0 FORMAT "%5.1" /end CHARACTERISTIC
/begin CHARACTERISTIC DFES_FaultTyp.DFC_HFMmax_C "assigned fault type / Fault type assignment for check DFC_HFMmax" VALUE 0x80504FB3 Val_Wu8 255.0 DFES_OneToOne 0.00 255.0 FORMAT "%5.1" /end CHARACTERISTIC
/begin CHARACTERISTIC DFES_FaultTyp.DFC_HiPSysHiPMaxLimExcdd_C "assigned fault type / Fault type assignment for check DFC_HiPSysHiPMaxLimExcdd" VALUE 0x80504FB4 Val_Wu8 255.0 DFES_OneToOne 0.00 255.0 FORMAT "%5.1" /end CHARACTERISTIC
/begin CHARACTERISTIC DFES_FaultTyp.DFC_IVGdiCtlCvoErrMax_0_C "assigned fault type / Fault type assignment for check DFC_IVGdiCtlCvoErrMax_0" VALUE 0x80504FB5 Val_Wu8 255.0 DFES_OneToOne 0.00 255.0 FORMAT "%5.1" /end CHARACTERISTIC
/begin CHARACTERISTIC DFES_FaultTyp.DFC_IVGdiCtlCvoErrMax_1_C "assigned fault type / Fault type assignment for check DFC_IVGdiCtlCvoErrMax_1" VALUE 0x80504FB6 Val_Wu8 255.0 DFES_OneToOne 0.00 255.0 FORMAT "%5.1" /end CHARACTERISTIC
/begin CHARACTERISTIC DFES_FaultTyp.DFC_IVGdiCtlCvoErrMax_2_C "assigned fault type / Fault type assignment for check DFC_IVGdiCtlCvoErrMax_2" VALUE 0x80504FB7 Val_Wu8 255.0 DFES_OneToOne 0.00 255.0 FORMAT "%5.1" /end CHARACTERISTIC
/begin CHARACTERISTIC DFES_FaultTyp.DFC_IVGdiCtlCvoErrMax_3_C "assigned fault type / Fault type assignment for check DFC_IVGdiCtlCvoErrMax_3" VALUE 0x80504FB8 Val_Wu8 255.0 DFES_OneToOne 0.00 255.0 FORMAT "%5.1" /end CHARACTERISTIC
/begin CHARACTERISTIC DFES_FaultTyp.DFC_IVGdiCtlCvoErrMin_0_C "assigned fault type / Fault type assignment for check DFC_IVGdiCtlCvoErrMin_0" VALUE 0x80504FB9 Val_Wu8 255.0 DFES_OneToOne 0.00 255.0 FORMAT "%5.1" /end CHARACTERISTIC
/begin CHARACTERISTIC DFES_FaultTyp.DFC_IVGdiCtlCvoErrMin_1_C "assigned fault type / Fault type assignment for check DFC_IVGdiCtlCvoErrMin_1" VALUE 0x80504FBA Val_Wu8 255.0 DFES_OneToOne 0.00 255.0 FORMAT "%5.1" /end CHARACTERISTIC
/begin CHARACTERISTIC DFES_FaultTyp.DFC_IVGdiCtlCvoErrMin_2_C "assigned fault type / Fault type assignment for check DFC_IVGdiCtlCvoErrMin_2" VALUE 0x80504FBB Val_Wu8 255.0 DFES_OneToOne 0.00 255.0 FORMAT "%5.1" /end CHARACTERISTIC
/begin CHARACTERISTIC DFES_FaultTyp.DFC_IVGdiCtlCvoErrMin_3_C "assigned fault type / Fault type assignment for check DFC_IVGdiCtlCvoErrMin_3" VALUE 0x80504FBC Val_Wu8 255.0 DFES_OneToOne 0.00 255.0 FORMAT "%5.1" /end CHARACTERISTIC
/begin CHARACTERISTIC DFES_FaultTyp.DFC_IVGdiCtlCvoErrMinMax_C "assigned fault type / Fault type assignment for check DFC_IVGdiCtlCvoErrMinMax" VALUE 0x80504FBD Val_Wu8 255.0 DFES_OneToOne 0.00 255.0 FORMAT "%5.1" /end CHARACTERISTIC
/begin CHARACTERISTIC DFES_FaultTyp.DFC_IVGdiCtlCvoSigPlausErrSmrCdn_C "assigned fault type / Fault type assignment for check DFC_IVGdiCtlCvoSigPlausErrSmrCdn" VALUE 0x80504FBE Val_Wu8 255.0 DFES_OneToOne 0.00 255.0 FORMAT "%5.1" /end CHARACTERISTIC
/begin CHARACTERISTIC DFES_FaultTyp.DFC_IVGdiCtl_CvoErr_C "assigned fault type / Fault type assignment for check DFC_IVGdiCtl_CvoErr" VALUE 0x80504FBF Val_Wu8 255.0 DFES_OneToOne 0.00 255.0 FORMAT "%5.1" /end CHARACTERISTIC
/begin CHARACTERISTIC DFES_FaultTyp.DFC_IVGdiCtl_CvoSigPlaus_0_C "assigned fault type / Fault type assignment for check DFC_IVGdiCtl_CvoSigPlaus_0" VALUE 0x80504FC0 Val_Wu8 255.0 DFES_OneToOne 0.00 255.0 FORMAT "%5.1" /end CHARACTERISTIC
/begin CHARACTERISTIC DFES_FaultTyp.DFC_IVGdiCtl_CvoSigPlaus_1_C "assigned fault type / Fault type assignment for check DFC_IVGdiCtl_CvoSigPlaus_1" VALUE 0x80504FC1 Val_Wu8 255.0 DFES_OneToOne 0.00 255.0 FORMAT "%5.1" /end CHARACTERISTIC
/begin CHARACTERISTIC DFES_FaultTyp.DFC_IVGdiCtl_CvoSigPlaus_2_C "assigned fault type / Fault type assignment for check DFC_IVGdiCtl_CvoSigPlaus_2" VALUE 0x80504FC2 Val_Wu8 255.0 DFES_OneToOne 0.00 255.0 FORMAT "%5.1" /end CHARACTERISTIC
/begin CHARACTERISTIC DFES_FaultTyp.DFC_IVGdiCtl_CvoSigPlaus_3_C "assigned fault type / Fault type assignment for check DFC_IVGdiCtl_CvoSigPlaus_3" VALUE 0x80504FC3 Val_Wu8 255.0 DFES_OneToOne 0.00 255.0 FORMAT "%5.1" /end CHARACTERISTIC
/begin CHARACTERISTIC DFES_FaultTyp.DFC_IntkAirTAirFltDsCrssMax_C "assigned fault type / Fault type assignment for check DFC_IntkAirTAirFltDsCrssMax" VALUE 0x80504FC4 Val_Wu8 255.0 DFES_OneToOne 0.00 255.0 FORMAT "%5.1" /end CHARACTERISTIC
/begin CHARACTERISTIC DFES_FaultTyp.DFC_IntkAirTAirFltDsCrssMin_C "assigned fault type / Fault type assignment for check DFC_IntkAirTAirFltDsCrssMin" VALUE 0x80504FC5 Val_Wu8 255.0 DFES_OneToOne 0.00 255.0 FORMAT "%5.1" /end CHARACTERISTIC
/begin CHARACTERISTIC DFES_FaultTyp.DFC_IntkAirTAirFltDsHSCMax_C "assigned fault type / Fault type assignment for check DFC_IntkAirTAirFltDsHSCMax" VALUE 0x80504FC6 Val_Wu8 255.0 DFES_OneToOne 0.00 255.0 FORMAT "%5.1" /end CHARACTERISTIC
/begin CHARACTERISTIC DFES_FaultTyp.DFC_IntkAirTAirFltDsImps_C "assigned fault type / Fault type assignment for check DFC_IntkAirTAirFltDsImps" VALUE 0x80504FC7 Val_Wu8 255.0 DFES_OneToOne 0.00 255.0 FORMAT "%5.1" /end CHARACTERISTIC
/begin CHARACTERISTIC DFES_FaultTyp.DFC_IntkAirTAirFltDsPRCMax_C "assigned fault type / Fault type assignment for check DFC_IntkAirTAirFltDsPRCMax" VALUE 0x80504FC8 Val_Wu8 255.0 DFES_OneToOne 0.00 255.0 FORMAT "%5.1" /end CHARACTERISTIC
/begin CHARACTERISTIC DFES_FaultTyp.DFC_IntkAirTAirFltDsPRCMin_C "assigned fault type / Fault type assignment for check DFC_IntkAirTAirFltDsPRCMin" VALUE 0x80504FC9 Val_Wu8 255.0 DFES_OneToOne 0.00 255.0 FORMAT "%5.1" /end CHARACTERISTIC
/begin CHARACTERISTIC DFES_FaultTyp.DFC_IntkAirTAirFltDsSRCMax_C "assigned fault type / Fault type assignment for check DFC_IntkAirTAirFltDsSRCMax" VALUE 0x80504FCA Val_Wu8 255.0 DFES_OneToOne 0.00 255.0 FORMAT "%5.1" /end CHARACTERISTIC
/begin CHARACTERISTIC DFES_FaultTyp.DFC_IntkAirTAirFltDsSRCMin_C "assigned fault type / Fault type assignment for check DFC_IntkAirTAirFltDsSRCMin" VALUE 0x80504FCB Val_Wu8 255.0 DFES_OneToOne 0.00 255.0 FORMAT "%5.1" /end CHARACTERISTIC
/begin CHARACTERISTIC DFES_FaultTyp.DFC_IntkAirTAirFltDsSTC_C "assigned fault type / Fault type assignment for check DFC_IntkAirTAirFltDsSTC" VALUE 0x80504FCC Val_Wu8 255.0 DFES_OneToOne 0.00 255.0 FORMAT "%5.1" /end CHARACTERISTIC
/begin CHARACTERISTIC DFES_FaultTyp.DFC_IntkAirTIntkMnfldCrssMax_C "assigned fault type / Fault type assignment for check DFC_IntkAirTIntkMnfldCrssMax" VALUE 0x80504FCD Val_Wu8 255.0 DFES_OneToOne 0.00 255.0 FORMAT "%5.1" /end CHARACTERISTIC
/begin CHARACTERISTIC DFES_FaultTyp.DFC_IntkAirTIntkMnfldCrssMin_C "assigned fault type / Fault type assignment for check DFC_IntkAirTIntkMnfldCrssMin" VALUE 0x80504FCE Val_Wu8 255.0 DFES_OneToOne 0.00 255.0 FORMAT "%5.1" /end CHARACTERISTIC
/begin CHARACTERISTIC DFES_FaultTyp.DFC_IntkAirTIntkMnfldHSCMax_C "assigned fault type / Fault type assignment for check DFC_IntkAirTIntkMnfldHSCMax" VALUE 0x80504FCF Val_Wu8 255.0 DFES_OneToOne 0.00 255.0 FORMAT "%5.1" /end CHARACTERISTIC
/begin CHARACTERISTIC DFES_FaultTyp.DFC_IntkAirTIntkMnfldImps_C "assigned fault type / Fault type assignment for check DFC_IntkAirTIntkMnfldImps" VALUE 0x80504FD0 Val_Wu8 255.0 DFES_OneToOne 0.00 255.0 FORMAT "%5.1" /end CHARACTERISTIC
/begin CHARACTERISTIC DFES_FaultTyp.DFC_IntkAirTIntkMnfldPRCMax_C "assigned fault type / Fault type assignment for check DFC_IntkAirTIntkMnfldPRCMax" VALUE 0x80504FD1 Val_Wu8 255.0 DFES_OneToOne 0.00 255.0 FORMAT "%5.1" /end CHARACTERISTIC
/begin CHARACTERISTIC DFES_FaultTyp.DFC_IntkAirTIntkMnfldPRCMin_C "assigned fault type / Fault type assignment for check DFC_IntkAirTIntkMnfldPRCMin" VALUE 0x80504FD2 Val_Wu8 255.0 DFES_OneToOne 0.00 255.0 FORMAT "%5.1" /end CHARACTERISTIC
/begin CHARACTERISTIC DFES_FaultTyp.DFC_IntkAirTIntkMnfldSRCMax_C "assigned fault type / Fault type assignment for check DFC_IntkAirTIntkMnfldSRCMax" VALUE 0x80504FD3 Val_Wu8 255.0 DFES_OneToOne 0.00 255.0 FORMAT "%5.1" /end CHARACTERISTIC
/begin CHARACTERISTIC DFES_FaultTyp.DFC_IntkAirTIntkMnfldSRCMin_C "assigned fault type / Fault type assignment for check DFC_IntkAirTIntkMnfldSRCMin" VALUE 0x80504FD4 Val_Wu8 255.0 DFES_OneToOne 0.00 255.0 FORMAT "%5.1" /end CHARACTERISTIC
/begin CHARACTERISTIC DFES_FaultTyp.DFC_IntkAirTIntkMnfldSTC_C "assigned fault type / Fault type assignment for check DFC_IntkAirTIntkMnfldSTC" VALUE 0x80504FD5 Val_Wu8 255.0 DFES_OneToOne 0.00 255.0 FORMAT "%5.1" /end CHARACTERISTIC
/begin CHARACTERISTIC DFES_FaultTyp.DFC_KRREGRLMX_C "assigned fault type / Fault type assignment for check DFC_KRREGRLMX" VALUE 0x80504FD6 Val_Wu8 255.0 DFES_OneToOne 0.00 255.0 FORMAT "%5.1" /end CHARACTERISTIC
/begin CHARACTERISTIC DFES_FaultTyp.DFC_KRVEKOCVLCI_C "assigned fault type / Fault type assignment for check DFC_KRVEKOCVLCI" VALUE 0x80504FD7 Val_Wu8 255.0 DFES_OneToOne 0.00 255.0 FORMAT "%5.1" /end CHARACTERISTIC
/begin CHARACTERISTIC DFES_FaultTyp.DFC_KRVEKOENCHMT_C "assigned fault type / Fault type assignment for check DFC_KRVEKOENCHMT" VALUE 0x80504FD8 Val_Wu8 255.0 DFES_OneToOne 0.00 255.0 FORMAT "%5.1" /end CHARACTERISTIC
/begin CHARACTERISTIC DFES_FaultTyp.DFC_KRVEKOENCHMT0_C "assigned fault type / Fault type assignment for check DFC_KRVEKOENCHMT0" VALUE 0x80504FD9 Val_Wu8 255.0 DFES_OneToOne 0.00 255.0 FORMAT "%5.1" /end CHARACTERISTIC
/begin CHARACTERISTIC DFES_FaultTyp.DFC_KRVEKOENCHMT1_C "assigned fault type / Fault type assignment for check DFC_KRVEKOENCHMT1" VALUE 0x80504FDA Val_Wu8 255.0 DFES_OneToOne 0.00 255.0 FORMAT "%5.1" /end CHARACTERISTIC
/begin CHARACTERISTIC DFES_FaultTyp.DFC_KRVEKOENCHMT2_C "assigned fault type / Fault type assignment for check DFC_KRVEKOENCHMT2" VALUE 0x80504FDB Val_Wu8 255.0 DFES_OneToOne 0.00 255.0 FORMAT "%5.1" /end CHARACTERISTIC
/begin CHARACTERISTIC DFES_FaultTyp.DFC_KRVEKOENCHMT3_C "assigned fault type / Fault type assignment for check DFC_KRVEKOENCHMT3" VALUE 0x80504FDC Val_Wu8 255.0 DFES_OneToOne 0.00 255.0 FORMAT "%5.1" /end CHARACTERISTIC
/begin CHARACTERISTIC DFES_FaultTyp.DFC_KRVEKOENCHMT4_C "assigned fault type / Fault type assignment for check DFC_KRVEKOENCHMT4" VALUE 0x80504FDD Val_Wu8 255.0 DFES_OneToOne 0.00 255.0 FORMAT "%5.1" /end CHARACTERISTIC
/begin CHARACTERISTIC DFES_FaultTyp.DFC_KRVEKOENCHMT5_C "assigned fault type / Fault type assignment for check DFC_KRVEKOENCHMT5" VALUE 0x80504FDE Val_Wu8 255.0 DFES_OneToOne 0.00 255.0 FORMAT "%5.1" /end CHARACTERISTIC
/begin CHARACTERISTIC DFES_FaultTyp.DFC_KRVEKOENCHMT6_C "assigned fault type / Fault type assignment for check DFC_KRVEKOENCHMT6" VALUE 0x80504FDF Val_Wu8 255.0 DFES_OneToOne 0.00 255.0 FORMAT "%5.1" /end CHARACTERISTIC
/begin CHARACTERISTIC DFES_FaultTyp.DFC_KRVEKOENCHMT7_C "assigned fault type / Fault type assignment for check DFC_KRVEKOENCHMT7" VALUE 0x80504FE0 Val_Wu8 255.0 DFES_OneToOne 0.00 255.0 FORMAT "%5.1" /end CHARACTERISTIC
/begin CHARACTERISTIC DFES_FaultTyp.DFC_KRVEKORLMX_C "assigned fault type / Fault type assignment for check DFC_KRVEKORLMX" VALUE 0x80504FE1 Val_Wu8 255.0 DFES_OneToOne 0.00 255.0 FORMAT "%5.1" /end CHARACTERISTIC
/begin CHARACTERISTIC DFES_FaultTyp.DFC_KRVEKORLMXL_C "assigned fault type / Fault type assignment for check DFC_KRVEKORLMXL" VALUE 0x80504FE2 Val_Wu8 255.0 DFES_OneToOne 0.00 255.0 FORMAT "%5.1" /end CHARACTERISTIC
/begin CHARACTERISTIC DFES_FaultTyp.DFC_KS1max_C "assigned fault type / Fault type assignment for check DFC_KS1max" VALUE 0x80504FE3 Val_Wu8 255.0 DFES_OneToOne 0.00 255.0 FORMAT "%5.1" /end CHARACTERISTIC
/begin CHARACTERISTIC DFES_FaultTyp.DFC_KS1min_C "assigned fault type / Fault type assignment for check DFC_KS1min" VALUE 0x80504FE4 Val_Wu8 255.0 DFES_OneToOne 0.00 255.0 FORMAT "%5.1" /end CHARACTERISTIC
/begin CHARACTERISTIC DFES_FaultTyp.DFC_LMmax_C "assigned fault type / Fault type assignment for check DFC_LMmax" VALUE 0x80504FE5 Val_Wu8 255.0 DFES_OneToOne 0.00 255.0 FORMAT "%5.1" /end CHARACTERISTIC
/begin CHARACTERISTIC DFES_FaultTyp.DFC_LZSRnpl_C "assigned fault type / Fault type assignment for check DFC_LZSRnpl" VALUE 0x80504FE6 Val_Wu8 255.0 DFES_OneToOne 0.00 255.0 FORMAT "%5.1" /end CHARACTERISTIC
/begin CHARACTERISTIC DFES_FaultTyp.DFC_LamDynDiagS1B1_C "assigned fault type / Fault type assignment for check DFC_LamDynDiagS1B1" VALUE 0x80504FE7 Val_Wu8 255.0 DFES_OneToOne 0.00 255.0 FORMAT "%5.1" /end CHARACTERISTIC
/begin CHARACTERISTIC DFES_FaultTyp.DFC_LeakIntkMnfldEmiInfl_C "assigned fault type / Fault type assignment for check DFC_LeakIntkMnfldEmiInfl" VALUE 0x80504FE8 Val_Wu8 255.0 DFES_OneToOne 0.00 255.0 FORMAT "%5.1" /end CHARACTERISTIC
/begin CHARACTERISTIC DFES_FaultTyp.DFC_LinFrameErrDCDC_C "assigned fault type / Fault type assignment for check DFC_LinFrameErrDCDC" VALUE 0x80504FE9 Val_Wu8 255.0 DFES_OneToOne 0.00 255.0 FORMAT "%5.1" /end CHARACTERISTIC
/begin CHARACTERISTIC DFES_FaultTyp.DFC_LinOverrunErrDCDC_C "assigned fault type / Fault type assignment for check DFC_LinOverrunErrDCDC" VALUE 0x80504FEA Val_Wu8 255.0 DFES_OneToOne 0.00 255.0 FORMAT "%5.1" /end CHARACTERISTIC
/begin CHARACTERISTIC DFES_FaultTyp.DFC_MD00max_C "assigned fault type / Fault type assignment for check DFC_MD00max" VALUE 0x80504FEB Val_Wu8 255.0 DFES_OneToOne 0.00 255.0 FORMAT "%5.1" /end CHARACTERISTIC
/begin CHARACTERISTIC DFES_FaultTyp.DFC_MDBmax_C "assigned fault type / Fault type assignment for check DFC_MDBmax" VALUE 0x80504FEC Val_Wu8 255.0 DFES_OneToOne 0.00 255.0 FORMAT "%5.1" /end CHARACTERISTIC
/begin CHARACTERISTIC DFES_FaultTyp.DFC_MDCat_C "assigned fault type / Fault type assignment for check DFC_MDCat" VALUE 0x80504FED Val_Wu8 255.0 DFES_OneToOne 0.00 255.0 FORMAT "%5.1" /end CHARACTERISTIC
/begin CHARACTERISTIC DFES_FaultTyp.DFC_MDCatCrit_C "assigned fault type / Fault type assignment for check DFC_MDCatCrit" VALUE 0x80504FEE Val_Wu8 255.0 DFES_OneToOne 0.00 255.0 FORMAT "%5.1" /end CHARACTERISTIC
/begin CHARACTERISTIC DFES_FaultTyp.DFC_MDCatCurr_C "assigned fault type / Fault type assignment for check DFC_MDCatCurr" VALUE 0x80504FEF Val_Wu8 255.0 DFES_OneToOne 0.00 255.0 FORMAT "%5.1" /end CHARACTERISTIC
/begin CHARACTERISTIC DFES_FaultTyp.DFC_MDCyl_0_C "assigned fault type / Fault type assignment for check DFC_MDCyl_0" VALUE 0x80504FF0 Val_Wu8 255.0 DFES_OneToOne 0.00 255.0 FORMAT "%5.1" /end CHARACTERISTIC
/begin CHARACTERISTIC DFES_FaultTyp.DFC_MDCyl_1_C "assigned fault type / Fault type assignment for check DFC_MDCyl_1" VALUE 0x80504FF1 Val_Wu8 255.0 DFES_OneToOne 0.00 255.0 FORMAT "%5.1" /end CHARACTERISTIC
/begin CHARACTERISTIC DFES_FaultTyp.DFC_MDCyl_2_C "assigned fault type / Fault type assignment for check DFC_MDCyl_2" VALUE 0x80504FF2 Val_Wu8 255.0 DFES_OneToOne 0.00 255.0 FORMAT "%5.1" /end CHARACTERISTIC
/begin CHARACTERISTIC DFES_FaultTyp.DFC_MDCyl_3_C "assigned fault type / Fault type assignment for check DFC_MDCyl_3" VALUE 0x80504FF3 Val_Wu8 255.0 DFES_OneToOne 0.00 255.0 FORMAT "%5.1" /end CHARACTERISTIC
/begin CHARACTERISTIC DFES_FaultTyp.DFC_MDEmi_C "assigned fault type / Fault type assignment for check DFC_MDEmi" VALUE 0x80504FF4 Val_Wu8 255.0 DFES_OneToOne 0.00 255.0 FORMAT "%5.1" /end CHARACTERISTIC
/begin CHARACTERISTIC DFES_FaultTyp.DFC_MDEmiStrt_C "assigned fault type / Fault type assignment for check DFC_MDEmiStrt" VALUE 0x80504FF5 Val_Wu8 255.0 DFES_OneToOne 0.00 255.0 FORMAT "%5.1" /end CHARACTERISTIC
/begin CHARACTERISTIC DFES_FaultTyp.DFC_MDFco_C "assigned fault type / Fault type assignment for check DFC_MDFco" VALUE 0x80504FF6 Val_Wu8 255.0 DFES_OneToOne 0.00 255.0 FORMAT "%5.1" /end CHARACTERISTIC
/begin CHARACTERISTIC DFES_FaultTyp.DFC_MDMpl_C "assigned fault type / Fault type assignment for check DFC_MDMpl" VALUE 0x80504FF7 Val_Wu8 255.0 DFES_OneToOne 0.00 255.0 FORMAT "%5.1" /end CHARACTERISTIC
/begin CHARACTERISTIC DFES_FaultTyp.DFC_MDSegTiAdpn_C "assigned fault type / Fault type assignment for check DFC_MDSegTiAdpn" VALUE 0x80504FF8 Val_Wu8 255.0 DFES_OneToOne 0.00 255.0 FORMAT "%5.1" /end CHARACTERISTIC
/begin CHARACTERISTIC DFES_FaultTyp.DFC_MDmax_C "assigned fault type / Fault type assignment for check DFC_MDmax" VALUE 0x80504FF9 Val_Wu8 255.0 DFES_OneToOne 0.00 255.0 FORMAT "%5.1" /end CHARACTERISTIC
/begin CHARACTERISTIC DFES_FaultTyp.DFC_MFuOilMax_C "assigned fault type / Fault type assignment for check DFC_MFuOilMax" VALUE 0x80504FFA Val_Wu8 255.0 DFES_OneToOne 0.00 255.0 FORMAT "%5.1" /end CHARACTERISTIC
/begin CHARACTERISTIC DFES_FaultTyp.DFC_MOXEMM_SMU_ALM0_0_C "assigned fault type / Fault type assignment for check DFC_MOXEMM_SMU_ALM0_0" VALUE 0x80504FFB Val_Wu8 255.0 DFES_OneToOne 0.00 255.0 FORMAT "%5.1" /end CHARACTERISTIC
/begin CHARACTERISTIC DFES_FaultTyp.DFC_MOXEMM_SMU_ALM0_1_C "assigned fault type / Fault type assignment for check DFC_MOXEMM_SMU_ALM0_1" VALUE 0x80504FFC Val_Wu8 255.0 DFES_OneToOne 0.00 255.0 FORMAT "%5.1" /end CHARACTERISTIC
/begin CHARACTERISTIC DFES_FaultTyp.DFC_MOXEMM_SMU_ALM0_10_C "assigned fault type / Fault type assignment for check DFC_MOXEMM_SMU_ALM0_10" VALUE 0x80504FFD Val_Wu8 255.0 DFES_OneToOne 0.00 255.0 FORMAT "%5.1" /end CHARACTERISTIC
/begin CHARACTERISTIC DFES_FaultTyp.DFC_MOXEMM_SMU_ALM0_11_C "assigned fault type / Fault type assignment for check DFC_MOXEMM_SMU_ALM0_11" VALUE 0x80504FFE Val_Wu8 255.0 DFES_OneToOne 0.00 255.0 FORMAT "%5.1" /end CHARACTERISTIC
/begin CHARACTERISTIC DFES_FaultTyp.DFC_MOXEMM_SMU_ALM0_13_C "assigned fault type / Fault type assignment for check DFC_MOXEMM_SMU_ALM0_13" VALUE 0x80504FFF Val_Wu8 255.0 DFES_OneToOne 0.00 255.0 FORMAT "%5.1" /end CHARACTERISTIC
/begin CHARACTERISTIC DFES_FaultTyp.DFC_MOXEMM_SMU_ALM0_14_C "assigned fault type / Fault type assignment for check DFC_MOXEMM_SMU_ALM0_14" VALUE 0x80505000 Val_Wu8 255.0 DFES_OneToOne 0.00 255.0 FORMAT "%5.1" /end CHARACTERISTIC
/begin CHARACTERISTIC DFES_FaultTyp.DFC_MOXEMM_SMU_ALM0_2_C "assigned fault type / Fault type assignment for check DFC_MOXEMM_SMU_ALM0_2" VALUE 0x80505001 Val_Wu8 255.0 DFES_OneToOne 0.00 255.0 FORMAT "%5.1" /end CHARACTERISTIC
/begin CHARACTERISTIC DFES_FaultTyp.DFC_MOXEMM_SMU_ALM0_22_C "assigned fault type / Fault type assignment for check DFC_MOXEMM_SMU_ALM0_22" VALUE 0x80505002 Val_Wu8 255.0 DFES_OneToOne 0.00 255.0 FORMAT "%5.1" /end CHARACTERISTIC
/begin CHARACTERISTIC DFES_FaultTyp.DFC_MOXEMM_SMU_ALM0_23_C "assigned fault type / Fault type assignment for check DFC_MOXEMM_SMU_ALM0_23" VALUE 0x80505003 Val_Wu8 255.0 DFES_OneToOne 0.00 255.0 FORMAT "%5.1" /end CHARACTERISTIC
/begin CHARACTERISTIC DFES_FaultTyp.DFC_MOXEMM_SMU_ALM0_4_C "assigned fault type / Fault type assignment for check DFC_MOXEMM_SMU_ALM0_4" VALUE 0x80505004 Val_Wu8 255.0 DFES_OneToOne 0.00 255.0 FORMAT "%5.1" /end CHARACTERISTIC
/begin CHARACTERISTIC DFES_FaultTyp.DFC_MOXEMM_SMU_ALM0_5_C "assigned fault type / Fault type assignment for check DFC_MOXEMM_SMU_ALM0_5" VALUE 0x80505005 Val_Wu8 255.0 DFES_OneToOne 0.00 255.0 FORMAT "%5.1" /end CHARACTERISTIC
/begin CHARACTERISTIC DFES_FaultTyp.DFC_MOXEMM_SMU_ALM0_7_C "assigned fault type / Fault type assignment for check DFC_MOXEMM_SMU_ALM0_7" VALUE 0x80505006 Val_Wu8 255.0 DFES_OneToOne 0.00 255.0 FORMAT "%5.1" /end CHARACTERISTIC
/begin CHARACTERISTIC DFES_FaultTyp.DFC_MOXEMM_SMU_ALM0_8_C "assigned fault type / Fault type assignment for check DFC_MOXEMM_SMU_ALM0_8" VALUE 0x80505007 Val_Wu8 255.0 DFES_OneToOne 0.00 255.0 FORMAT "%5.1" /end CHARACTERISTIC
/begin CHARACTERISTIC DFES_FaultTyp.DFC_MOXEMM_SMU_ALM10_16_C "assigned fault type / Fault type assignment for check DFC_MOXEMM_SMU_ALM10_16" VALUE 0x80505008 Val_Wu8 255.0 DFES_OneToOne 0.00 255.0 FORMAT "%5.1" /end CHARACTERISTIC
/begin CHARACTERISTIC DFES_FaultTyp.DFC_MOXEMM_SMU_ALM10_17_C "assigned fault type / Fault type assignment for check DFC_MOXEMM_SMU_ALM10_17" VALUE 0x80505009 Val_Wu8 255.0 DFES_OneToOne 0.00 255.0 FORMAT "%5.1" /end CHARACTERISTIC
/begin CHARACTERISTIC DFES_FaultTyp.DFC_MOXEMM_SMU_ALM10_21_C "assigned fault type / Fault type assignment for check DFC_MOXEMM_SMU_ALM10_21" VALUE 0x8050500A Val_Wu8 255.0 DFES_OneToOne 0.00 255.0 FORMAT "%5.1" /end CHARACTERISTIC
/begin CHARACTERISTIC DFES_FaultTyp.DFC_MOXEMM_SMU_ALM11_0_C "assigned fault type / Fault type assignment for check DFC_MOXEMM_SMU_ALM11_0" VALUE 0x8050500B Val_Wu8 255.0 DFES_OneToOne 0.00 255.0 FORMAT "%5.1" /end CHARACTERISTIC
/begin CHARACTERISTIC DFES_FaultTyp.DFC_MOXEMM_SMU_ALM11_1_C "assigned fault type / Fault type assignment for check DFC_MOXEMM_SMU_ALM11_1" VALUE 0x8050500C Val_Wu8 255.0 DFES_OneToOne 0.00 255.0 FORMAT "%5.1" /end CHARACTERISTIC
/begin CHARACTERISTIC DFES_FaultTyp.DFC_MOXEMM_SMU_ALM11_2_C "assigned fault type / Fault type assignment for check DFC_MOXEMM_SMU_ALM11_2" VALUE 0x8050500D Val_Wu8 255.0 DFES_OneToOne 0.00 255.0 FORMAT "%5.1" /end CHARACTERISTIC
/begin CHARACTERISTIC DFES_FaultTyp.DFC_MOXEMM_SMU_ALM11_3_C "assigned fault type / Fault type assignment for check DFC_MOXEMM_SMU_ALM11_3" VALUE 0x8050500E Val_Wu8 255.0 DFES_OneToOne 0.00 255.0 FORMAT "%5.1" /end CHARACTERISTIC
/begin CHARACTERISTIC DFES_FaultTyp.DFC_MOXEMM_SMU_ALM11_4_C "assigned fault type / Fault type assignment for check DFC_MOXEMM_SMU_ALM11_4" VALUE 0x8050500F Val_Wu8 255.0 DFES_OneToOne 0.00 255.0 FORMAT "%5.1" /end CHARACTERISTIC
/begin CHARACTERISTIC DFES_FaultTyp.DFC_MOXEMM_SMU_ALM11_5_C "assigned fault type / Fault type assignment for check DFC_MOXEMM_SMU_ALM11_5" VALUE 0x80505010 Val_Wu8 255.0 DFES_OneToOne 0.00 255.0 FORMAT "%5.1" /end CHARACTERISTIC
/begin CHARACTERISTIC DFES_FaultTyp.DFC_MOXEMM_SMU_ALM11_8_C "assigned fault type / Fault type assignment for check DFC_MOXEMM_SMU_ALM11_8" VALUE 0x80505011 Val_Wu8 255.0 DFES_OneToOne 0.00 255.0 FORMAT "%5.1" /end CHARACTERISTIC
/begin CHARACTERISTIC DFES_FaultTyp.DFC_MOXEMM_SMU_ALM11_9_C "assigned fault type / Fault type assignment for check DFC_MOXEMM_SMU_ALM11_9" VALUE 0x80505012 Val_Wu8 255.0 DFES_OneToOne 0.00 255.0 FORMAT "%5.1" /end CHARACTERISTIC
/begin CHARACTERISTIC DFES_FaultTyp.DFC_MOXEMM_SMU_ALM1_0_C "assigned fault type / Fault type assignment for check DFC_MOXEMM_SMU_ALM1_0" VALUE 0x80505013 Val_Wu8 255.0 DFES_OneToOne 0.00 255.0 FORMAT "%5.1" /end CHARACTERISTIC
/begin CHARACTERISTIC DFES_FaultTyp.DFC_MOXEMM_SMU_ALM1_1_C "assigned fault type / Fault type assignment for check DFC_MOXEMM_SMU_ALM1_1" VALUE 0x80505014 Val_Wu8 255.0 DFES_OneToOne 0.00 255.0 FORMAT "%5.1" /end CHARACTERISTIC
/begin CHARACTERISTIC DFES_FaultTyp.DFC_MOXEMM_SMU_ALM1_10_C "assigned fault type / Fault type assignment for check DFC_MOXEMM_SMU_ALM1_10" VALUE 0x80505015 Val_Wu8 255.0 DFES_OneToOne 0.00 255.0 FORMAT "%5.1" /end CHARACTERISTIC
/begin CHARACTERISTIC DFES_FaultTyp.DFC_MOXEMM_SMU_ALM1_11_C "assigned fault type / Fault type assignment for check DFC_MOXEMM_SMU_ALM1_11" VALUE 0x80505016 Val_Wu8 255.0 DFES_OneToOne 0.00 255.0 FORMAT "%5.1" /end CHARACTERISTIC
/begin CHARACTERISTIC DFES_FaultTyp.DFC_MOXEMM_SMU_ALM1_13_C "assigned fault type / Fault type assignment for check DFC_MOXEMM_SMU_ALM1_13" VALUE 0x80505017 Val_Wu8 255.0 DFES_OneToOne 0.00 255.0 FORMAT "%5.1" /end CHARACTERISTIC
/begin CHARACTERISTIC DFES_FaultTyp.DFC_MOXEMM_SMU_ALM1_14_C "assigned fault type / Fault type assignment for check DFC_MOXEMM_SMU_ALM1_14" VALUE 0x80505018 Val_Wu8 255.0 DFES_OneToOne 0.00 255.0 FORMAT "%5.1" /end CHARACTERISTIC
/begin CHARACTERISTIC DFES_FaultTyp.DFC_MOXEMM_SMU_ALM1_2_C "assigned fault type / Fault type assignment for check DFC_MOXEMM_SMU_ALM1_2" VALUE 0x80505019 Val_Wu8 255.0 DFES_OneToOne 0.00 255.0 FORMAT "%5.1" /end CHARACTERISTIC
/begin CHARACTERISTIC DFES_FaultTyp.DFC_MOXEMM_SMU_ALM1_22_C "assigned fault type / Fault type assignment for check DFC_MOXEMM_SMU_ALM1_22" VALUE 0x8050501A Val_Wu8 255.0 DFES_OneToOne 0.00 255.0 FORMAT "%5.1" /end CHARACTERISTIC
/begin CHARACTERISTIC DFES_FaultTyp.DFC_MOXEMM_SMU_ALM1_23_C "assigned fault type / Fault type assignment for check DFC_MOXEMM_SMU_ALM1_23" VALUE 0x8050501B Val_Wu8 255.0 DFES_OneToOne 0.00 255.0 FORMAT "%5.1" /end CHARACTERISTIC
/begin CHARACTERISTIC DFES_FaultTyp.DFC_MOXEMM_SMU_ALM1_4_C "assigned fault type / Fault type assignment for check DFC_MOXEMM_SMU_ALM1_4" VALUE 0x8050501C Val_Wu8 255.0 DFES_OneToOne 0.00 255.0 FORMAT "%5.1" /end CHARACTERISTIC
/begin CHARACTERISTIC DFES_FaultTyp.DFC_MOXEMM_SMU_ALM1_5_C "assigned fault type / Fault type assignment for check DFC_MOXEMM_SMU_ALM1_5" VALUE 0x8050501D Val_Wu8 255.0 DFES_OneToOne 0.00 255.0 FORMAT "%5.1" /end CHARACTERISTIC
/begin CHARACTERISTIC DFES_FaultTyp.DFC_MOXEMM_SMU_ALM1_7_C "assigned fault type / Fault type assignment for check DFC_MOXEMM_SMU_ALM1_7" VALUE 0x8050501E Val_Wu8 255.0 DFES_OneToOne 0.00 255.0 FORMAT "%5.1" /end CHARACTERISTIC
/begin CHARACTERISTIC DFES_FaultTyp.DFC_MOXEMM_SMU_ALM1_8_C "assigned fault type / Fault type assignment for check DFC_MOXEMM_SMU_ALM1_8" VALUE 0x8050501F Val_Wu8 255.0 DFES_OneToOne 0.00 255.0 FORMAT "%5.1" /end CHARACTERISTIC
/begin CHARACTERISTIC DFES_FaultTyp.DFC_MOXEMM_SMU_ALM21_0_C "assigned fault type / Fault type assignment for check DFC_MOXEMM_SMU_ALM21_0" VALUE 0x80505020 Val_Wu8 255.0 DFES_OneToOne 0.00 255.0 FORMAT "%5.1" /end CHARACTERISTIC
/begin CHARACTERISTIC DFES_FaultTyp.DFC_MOXEMM_SMU_ALM21_16_C "assigned fault type / Fault type assignment for check DFC_MOXEMM_SMU_ALM21_16" VALUE 0x80505021 Val_Wu8 255.0 DFES_OneToOne 0.00 255.0 FORMAT "%5.1" /end CHARACTERISTIC
/begin CHARACTERISTIC DFES_FaultTyp.DFC_MOXEMM_SMU_ALM21_3_C "assigned fault type / Fault type assignment for check DFC_MOXEMM_SMU_ALM21_3" VALUE 0x80505022 Val_Wu8 255.0 DFES_OneToOne 0.00 255.0 FORMAT "%5.1" /end CHARACTERISTIC
/begin CHARACTERISTIC DFES_FaultTyp.DFC_MOXEMM_SMU_ALM2_1_C "assigned fault type / Fault type assignment for check DFC_MOXEMM_SMU_ALM2_1" VALUE 0x80505023 Val_Wu8 255.0 DFES_OneToOne 0.00 255.0 FORMAT "%5.1" /end CHARACTERISTIC
/begin CHARACTERISTIC DFES_FaultTyp.DFC_MOXEMM_SMU_ALM2_10_C "assigned fault type / Fault type assignment for check DFC_MOXEMM_SMU_ALM2_10" VALUE 0x80505024 Val_Wu8 255.0 DFES_OneToOne 0.00 255.0 FORMAT "%5.1" /end CHARACTERISTIC
/begin CHARACTERISTIC DFES_FaultTyp.DFC_MOXEMM_SMU_ALM2_11_C "assigned fault type / Fault type assignment for check DFC_MOXEMM_SMU_ALM2_11" VALUE 0x80505025 Val_Wu8 255.0 DFES_OneToOne 0.00 255.0 FORMAT "%5.1" /end CHARACTERISTIC
/begin CHARACTERISTIC DFES_FaultTyp.DFC_MOXEMM_SMU_ALM2_13_C "assigned fault type / Fault type assignment for check DFC_MOXEMM_SMU_ALM2_13" VALUE 0x80505026 Val_Wu8 255.0 DFES_OneToOne 0.00 255.0 FORMAT "%5.1" /end CHARACTERISTIC
/begin CHARACTERISTIC DFES_FaultTyp.DFC_MOXEMM_SMU_ALM2_14_C "assigned fault type / Fault type assignment for check DFC_MOXEMM_SMU_ALM2_14" VALUE 0x80505027 Val_Wu8 255.0 DFES_OneToOne 0.00 255.0 FORMAT "%5.1" /end CHARACTERISTIC
/begin CHARACTERISTIC DFES_FaultTyp.DFC_MOXEMM_SMU_ALM2_22_C "assigned fault type / Fault type assignment for check DFC_MOXEMM_SMU_ALM2_22" VALUE 0x80505028 Val_Wu8 255.0 DFES_OneToOne 0.00 255.0 FORMAT "%5.1" /end CHARACTERISTIC
/begin CHARACTERISTIC DFES_FaultTyp.DFC_MOXEMM_SMU_ALM2_23_C "assigned fault type / Fault type assignment for check DFC_MOXEMM_SMU_ALM2_23" VALUE 0x80505029 Val_Wu8 255.0 DFES_OneToOne 0.00 255.0 FORMAT "%5.1" /end CHARACTERISTIC
/begin CHARACTERISTIC DFES_FaultTyp.DFC_MOXEMM_SMU_ALM2_4_C "assigned fault type / Fault type assignment for check DFC_MOXEMM_SMU_ALM2_4" VALUE 0x8050502A Val_Wu8 255.0 DFES_OneToOne 0.00 255.0 FORMAT "%5.1" /end CHARACTERISTIC
/begin CHARACTERISTIC DFES_FaultTyp.DFC_MOXEMM_SMU_ALM2_5_C "assigned fault type / Fault type assignment for check DFC_MOXEMM_SMU_ALM2_5" VALUE 0x8050502B Val_Wu8 255.0 DFES_OneToOne 0.00 255.0 FORMAT "%5.1" /end CHARACTERISTIC
/begin CHARACTERISTIC DFES_FaultTyp.DFC_MOXEMM_SMU_ALM2_7_C "assigned fault type / Fault type assignment for check DFC_MOXEMM_SMU_ALM2_7" VALUE 0x8050502C Val_Wu8 255.0 DFES_OneToOne 0.00 255.0 FORMAT "%5.1" /end CHARACTERISTIC
/begin CHARACTERISTIC DFES_FaultTyp.DFC_MOXEMM_SMU_ALM2_8_C "assigned fault type / Fault type assignment for check DFC_MOXEMM_SMU_ALM2_8" VALUE 0x8050502D Val_Wu8 255.0 DFES_OneToOne 0.00 255.0 FORMAT "%5.1" /end CHARACTERISTIC
/begin CHARACTERISTIC DFES_FaultTyp.DFC_MOXEMM_SMU_ALM6_0_C "assigned fault type / Fault type assignment for check DFC_MOXEMM_SMU_ALM6_0" VALUE 0x8050502E Val_Wu8 255.0 DFES_OneToOne 0.00 255.0 FORMAT "%5.1" /end CHARACTERISTIC
/begin CHARACTERISTIC DFES_FaultTyp.DFC_MOXEMM_SMU_ALM6_11_C "assigned fault type / Fault type assignment for check DFC_MOXEMM_SMU_ALM6_11" VALUE 0x8050502F Val_Wu8 255.0 DFES_OneToOne 0.00 255.0 FORMAT "%5.1" /end CHARACTERISTIC
/begin CHARACTERISTIC DFES_FaultTyp.DFC_MOXEMM_SMU_ALM6_12_C "assigned fault type / Fault type assignment for check DFC_MOXEMM_SMU_ALM6_12" VALUE 0x80505030 Val_Wu8 255.0 DFES_OneToOne 0.00 255.0 FORMAT "%5.1" /end CHARACTERISTIC
/begin CHARACTERISTIC DFES_FaultTyp.DFC_MOXEMM_SMU_ALM6_14_C "assigned fault type / Fault type assignment for check DFC_MOXEMM_SMU_ALM6_14" VALUE 0x80505031 Val_Wu8 255.0 DFES_OneToOne 0.00 255.0 FORMAT "%5.1" /end CHARACTERISTIC
/begin CHARACTERISTIC DFES_FaultTyp.DFC_MOXEMM_SMU_ALM6_15_C "assigned fault type / Fault type assignment for check DFC_MOXEMM_SMU_ALM6_15" VALUE 0x80505032 Val_Wu8 255.0 DFES_OneToOne 0.00 255.0 FORMAT "%5.1" /end CHARACTERISTIC
/begin CHARACTERISTIC DFES_FaultTyp.DFC_MOXEMM_SMU_ALM6_17_C "assigned fault type / Fault type assignment for check DFC_MOXEMM_SMU_ALM6_17" VALUE 0x80505033 Val_Wu8 255.0 DFES_OneToOne 0.00 255.0 FORMAT "%5.1" /end CHARACTERISTIC
/begin CHARACTERISTIC DFES_FaultTyp.DFC_MOXEMM_SMU_ALM6_18_C "assigned fault type / Fault type assignment for check DFC_MOXEMM_SMU_ALM6_18" VALUE 0x80505034 Val_Wu8 255.0 DFES_OneToOne 0.00 255.0 FORMAT "%5.1" /end CHARACTERISTIC
/begin CHARACTERISTIC DFES_FaultTyp.DFC_MOXEMM_SMU_ALM6_20_C "assigned fault type / Fault type assignment for check DFC_MOXEMM_SMU_ALM6_20" VALUE 0x80505035 Val_Wu8 255.0 DFES_OneToOne 0.00 255.0 FORMAT "%5.1" /end CHARACTERISTIC
/begin CHARACTERISTIC DFES_FaultTyp.DFC_MOXEMM_SMU_ALM6_21_C "assigned fault type / Fault type assignment for check DFC_MOXEMM_SMU_ALM6_21" VALUE 0x80505036 Val_Wu8 255.0 DFES_OneToOne 0.00 255.0 FORMAT "%5.1" /end CHARACTERISTIC
/begin CHARACTERISTIC DFES_FaultTyp.DFC_MOXEMM_SMU_ALM6_25_C "assigned fault type / Fault type assignment for check DFC_MOXEMM_SMU_ALM6_25" VALUE 0x80505037 Val_Wu8 255.0 DFES_OneToOne 0.00 255.0 FORMAT "%5.1" /end CHARACTERISTIC
/begin CHARACTERISTIC DFES_FaultTyp.DFC_MOXEMM_SMU_ALM6_4_C "assigned fault type / Fault type assignment for check DFC_MOXEMM_SMU_ALM6_4" VALUE 0x80505038 Val_Wu8 255.0 DFES_OneToOne 0.00 255.0 FORMAT "%5.1" /end CHARACTERISTIC
/begin CHARACTERISTIC DFES_FaultTyp.DFC_MOXEMM_SMU_ALM6_5_C "assigned fault type / Fault type assignment for check DFC_MOXEMM_SMU_ALM6_5" VALUE 0x80505039 Val_Wu8 255.0 DFES_OneToOne 0.00 255.0 FORMAT "%5.1" /end CHARACTERISTIC
/begin CHARACTERISTIC DFES_FaultTyp.DFC_MOXEMM_SMU_ALM6_7_C "assigned fault type / Fault type assignment for check DFC_MOXEMM_SMU_ALM6_7" VALUE 0x8050503A Val_Wu8 255.0 DFES_OneToOne 0.00 255.0 FORMAT "%5.1" /end CHARACTERISTIC
/begin CHARACTERISTIC DFES_FaultTyp.DFC_MOXEMM_SMU_ALM6_8_C "assigned fault type / Fault type assignment for check DFC_MOXEMM_SMU_ALM6_8" VALUE 0x8050503B Val_Wu8 255.0 DFES_OneToOne 0.00 255.0 FORMAT "%5.1" /end CHARACTERISTIC
/begin CHARACTERISTIC DFES_FaultTyp.DFC_MOXEMM_SMU_ALM7_1_C "assigned fault type / Fault type assignment for check DFC_MOXEMM_SMU_ALM7_1" VALUE 0x8050503C Val_Wu8 255.0 DFES_OneToOne 0.00 255.0 FORMAT "%5.1" /end CHARACTERISTIC
/begin CHARACTERISTIC DFES_FaultTyp.DFC_MOXEMM_SMU_ALM7_12_C "assigned fault type / Fault type assignment for check DFC_MOXEMM_SMU_ALM7_12" VALUE 0x8050503D Val_Wu8 255.0 DFES_OneToOne 0.00 255.0 FORMAT "%5.1" /end CHARACTERISTIC
/begin CHARACTERISTIC DFES_FaultTyp.DFC_MOXEMM_SMU_ALM7_13_C "assigned fault type / Fault type assignment for check DFC_MOXEMM_SMU_ALM7_13" VALUE 0x8050503E Val_Wu8 255.0 DFES_OneToOne 0.00 255.0 FORMAT "%5.1" /end CHARACTERISTIC
/begin CHARACTERISTIC DFES_FaultTyp.DFC_MOXEMM_SMU_ALM7_14_C "assigned fault type / Fault type assignment for check DFC_MOXEMM_SMU_ALM7_14" VALUE 0x8050503F Val_Wu8 255.0 DFES_OneToOne 0.00 255.0 FORMAT "%5.1" /end CHARACTERISTIC
/begin CHARACTERISTIC DFES_FaultTyp.DFC_MOXEMM_SMU_ALM7_15_C "assigned fault type / Fault type assignment for check DFC_MOXEMM_SMU_ALM7_15" VALUE 0x80505040 Val_Wu8 255.0 DFES_OneToOne 0.00 255.0 FORMAT "%5.1" /end CHARACTERISTIC
/begin CHARACTERISTIC DFES_FaultTyp.DFC_MOXEMM_SMU_ALM7_16_C "assigned fault type / Fault type assignment for check DFC_MOXEMM_SMU_ALM7_16" VALUE 0x80505041 Val_Wu8 255.0 DFES_OneToOne 0.00 255.0 FORMAT "%5.1" /end CHARACTERISTIC
/begin CHARACTERISTIC DFES_FaultTyp.DFC_MOXEMM_SMU_ALM7_17_C "assigned fault type / Fault type assignment for check DFC_MOXEMM_SMU_ALM7_17" VALUE 0x80505042 Val_Wu8 255.0 DFES_OneToOne 0.00 255.0 FORMAT "%5.1" /end CHARACTERISTIC
/begin CHARACTERISTIC DFES_FaultTyp.DFC_MOXEMM_SMU_ALM7_2_C "assigned fault type / Fault type assignment for check DFC_MOXEMM_SMU_ALM7_2" VALUE 0x80505043 Val_Wu8 255.0 DFES_OneToOne 0.00 255.0 FORMAT "%5.1" /end CHARACTERISTIC
/begin CHARACTERISTIC DFES_FaultTyp.DFC_MOXEMM_SMU_ALM7_20_C "assigned fault type / Fault type assignment for check DFC_MOXEMM_SMU_ALM7_20" VALUE 0x80505044 Val_Wu8 255.0 DFES_OneToOne 0.00 255.0 FORMAT "%5.1" /end CHARACTERISTIC
/begin CHARACTERISTIC DFES_FaultTyp.DFC_MOXEMM_SMU_ALM7_25_C "assigned fault type / Fault type assignment for check DFC_MOXEMM_SMU_ALM7_25" VALUE 0x80505045 Val_Wu8 255.0 DFES_OneToOne 0.00 255.0 FORMAT "%5.1" /end CHARACTERISTIC
/begin CHARACTERISTIC DFES_FaultTyp.DFC_MOXEMM_SMU_ALM7_26_C "assigned fault type / Fault type assignment for check DFC_MOXEMM_SMU_ALM7_26" VALUE 0x80505046 Val_Wu8 255.0 DFES_OneToOne 0.00 255.0 FORMAT "%5.1" /end CHARACTERISTIC
/begin CHARACTERISTIC DFES_FaultTyp.DFC_MOXEMM_SMU_ALM7_28_C "assigned fault type / Fault type assignment for check DFC_MOXEMM_SMU_ALM7_28" VALUE 0x80505047 Val_Wu8 255.0 DFES_OneToOne 0.00 255.0 FORMAT "%5.1" /end CHARACTERISTIC
/begin CHARACTERISTIC DFES_FaultTyp.DFC_MOXEMM_SMU_ALM7_29_C "assigned fault type / Fault type assignment for check DFC_MOXEMM_SMU_ALM7_29" VALUE 0x80505048 Val_Wu8 255.0 DFES_OneToOne 0.00 255.0 FORMAT "%5.1" /end CHARACTERISTIC
/begin CHARACTERISTIC DFES_FaultTyp.DFC_MOXEMM_SMU_ALM7_30_C "assigned fault type / Fault type assignment for check DFC_MOXEMM_SMU_ALM7_30" VALUE 0x80505049 Val_Wu8 255.0 DFES_OneToOne 0.00 255.0 FORMAT "%5.1" /end CHARACTERISTIC
/begin CHARACTERISTIC DFES_FaultTyp.DFC_MOXEMM_SMU_ALM7_31_C "assigned fault type / Fault type assignment for check DFC_MOXEMM_SMU_ALM7_31" VALUE 0x8050504A Val_Wu8 255.0 DFES_OneToOne 0.00 255.0 FORMAT "%5.1" /end CHARACTERISTIC
/begin CHARACTERISTIC DFES_FaultTyp.DFC_MOXEMM_SMU_ALM8_0_C "assigned fault type / Fault type assignment for check DFC_MOXEMM_SMU_ALM8_0" VALUE 0x8050504B Val_Wu8 255.0 DFES_OneToOne 0.00 255.0 FORMAT "%5.1" /end CHARACTERISTIC
/begin CHARACTERISTIC DFES_FaultTyp.DFC_MOXEMM_SMU_ALM8_1_C "assigned fault type / Fault type assignment for check DFC_MOXEMM_SMU_ALM8_1" VALUE 0x8050504C Val_Wu8 255.0 DFES_OneToOne 0.00 255.0 FORMAT "%5.1" /end CHARACTERISTIC
/begin CHARACTERISTIC DFES_FaultTyp.DFC_MOXEMM_SMU_ALM8_10_C "assigned fault type / Fault type assignment for check DFC_MOXEMM_SMU_ALM8_10" VALUE 0x8050504D Val_Wu8 255.0 DFES_OneToOne 0.00 255.0 FORMAT "%5.1" /end CHARACTERISTIC
/begin CHARACTERISTIC DFES_FaultTyp.DFC_MOXEMM_SMU_ALM8_11_C "assigned fault type / Fault type assignment for check DFC_MOXEMM_SMU_ALM8_11" VALUE 0x8050504E Val_Wu8 255.0 DFES_OneToOne 0.00 255.0 FORMAT "%5.1" /end CHARACTERISTIC
/begin CHARACTERISTIC DFES_FaultTyp.DFC_MOXEMM_SMU_ALM8_12_C "assigned fault type / Fault type assignment for check DFC_MOXEMM_SMU_ALM8_12" VALUE 0x8050504F Val_Wu8 255.0 DFES_OneToOne 0.00 255.0 FORMAT "%5.1" /end CHARACTERISTIC
/begin CHARACTERISTIC DFES_FaultTyp.DFC_MOXEMM_SMU_ALM8_16_C "assigned fault type / Fault type assignment for check DFC_MOXEMM_SMU_ALM8_16" VALUE 0x80505050 Val_Wu8 255.0 DFES_OneToOne 0.00 255.0 FORMAT "%5.1" /end CHARACTERISTIC
/begin CHARACTERISTIC DFES_FaultTyp.DFC_MOXEMM_SMU_ALM8_18_C "assigned fault type / Fault type assignment for check DFC_MOXEMM_SMU_ALM8_18" VALUE 0x80505051 Val_Wu8 255.0 DFES_OneToOne 0.00 255.0 FORMAT "%5.1" /end CHARACTERISTIC
/begin CHARACTERISTIC DFES_FaultTyp.DFC_MOXEMM_SMU_ALM8_2_C "assigned fault type / Fault type assignment for check DFC_MOXEMM_SMU_ALM8_2" VALUE 0x80505052 Val_Wu8 255.0 DFES_OneToOne 0.00 255.0 FORMAT "%5.1" /end CHARACTERISTIC
/begin CHARACTERISTIC DFES_FaultTyp.DFC_MOXEMM_SMU_ALM8_3_C "assigned fault type / Fault type assignment for check DFC_MOXEMM_SMU_ALM8_3" VALUE 0x80505053 Val_Wu8 255.0 DFES_OneToOne 0.00 255.0 FORMAT "%5.1" /end CHARACTERISTIC
/begin CHARACTERISTIC DFES_FaultTyp.DFC_MOXEMM_SMU_ALM8_31_C "assigned fault type / Fault type assignment for check DFC_MOXEMM_SMU_ALM8_31" VALUE 0x80505054 Val_Wu8 255.0 DFES_OneToOne 0.00 255.0 FORMAT "%5.1" /end CHARACTERISTIC
/begin CHARACTERISTIC DFES_FaultTyp.DFC_MOXEMM_SMU_ALM8_4_C "assigned fault type / Fault type assignment for check DFC_MOXEMM_SMU_ALM8_4" VALUE 0x80505055 Val_Wu8 255.0 DFES_OneToOne 0.00 255.0 FORMAT "%5.1" /end CHARACTERISTIC
/begin CHARACTERISTIC DFES_FaultTyp.DFC_MOXEMM_SMU_ALM9_0_C "assigned fault type / Fault type assignment for check DFC_MOXEMM_SMU_ALM9_0" VALUE 0x80505056 Val_Wu8 255.0 DFES_OneToOne 0.00 255.0 FORMAT "%5.1" /end CHARACTERISTIC
/begin CHARACTERISTIC DFES_FaultTyp.DFC_MOXEMM_SMU_ALM9_15_C "assigned fault type / Fault type assignment for check DFC_MOXEMM_SMU_ALM9_15" VALUE 0x80505057 Val_Wu8 255.0 DFES_OneToOne 0.00 255.0 FORMAT "%5.1" /end CHARACTERISTIC
/begin CHARACTERISTIC DFES_FaultTyp.DFC_MOXEMM_SMU_ALM9_3_C "assigned fault type / Fault type assignment for check DFC_MOXEMM_SMU_ALM9_3" VALUE 0x80505058 Val_Wu8 255.0 DFES_OneToOne 0.00 255.0 FORMAT "%5.1" /end CHARACTERISTIC
/begin CHARACTERISTIC DFES_FaultTyp.DFC_MoCADCNTP_C "assigned fault type / Fault type assignment for check DFC_MoCADCNTP" VALUE 0x80505059 Val_Wu8 255.0 DFES_OneToOne 0.00 255.0 FORMAT "%5.1" /end CHARACTERISTIC
/begin CHARACTERISTIC DFES_FaultTyp.DFC_MoCADCTst_C "assigned fault type / Fault type assignment for check DFC_MoCADCTst" VALUE 0x8050505A Val_Wu8 255.0 DFES_OneToOne 0.00 255.0 FORMAT "%5.1" /end CHARACTERISTIC
/begin CHARACTERISTIC DFES_FaultTyp.DFC_MoCSOPICO_C "assigned fault type / Fault type assignment for check DFC_MoCSOPICO" VALUE 0x8050505B Val_Wu8 255.0 DFES_OneToOne 0.00 255.0 FORMAT "%5.1" /end CHARACTERISTIC
/begin CHARACTERISTIC DFES_FaultTyp.DFC_MoFAPP_C "assigned fault type / Fault type assignment for check DFC_MoFAPP" VALUE 0x8050505C Val_Wu8 255.0 DFES_OneToOne 0.00 255.0 FORMAT "%5.1" /end CHARACTERISTIC
/begin CHARACTERISTIC DFES_FaultTyp.DFC_MoFAirFilgPrdc_C "assigned fault type / Fault type assignment for check DFC_MoFAirFilgPrdc" VALUE 0x8050505D Val_Wu8 255.0 DFES_OneToOne 0.00 255.0 FORMAT "%5.1" /end CHARACTERISTIC
/begin CHARACTERISTIC DFES_FaultTyp.DFC_MoFAirFlCtOffGdi_C "assigned fault type / Fault type assignment for check DFC_MoFAirFlCtOffGdi" VALUE 0x8050505E Val_Wu8 255.0 DFES_OneToOne 0.00 255.0 FORMAT "%5.1" /end CHARACTERISTIC
/begin CHARACTERISTIC DFES_FaultTyp.DFC_MoFAirFlCylGdi_C "assigned fault type / Fault type assignment for check DFC_MoFAirFlCylGdi" VALUE 0x8050505F Val_Wu8 255.0 DFES_OneToOne 0.00 255.0 FORMAT "%5.1" /end CHARACTERISTIC
/begin CHARACTERISTIC DFES_FaultTyp.DFC_MoFAirFlFF_C "assigned fault type / Fault type assignment for check DFC_MoFAirFlFF" VALUE 0x80505060 Val_Wu8 255.0 DFES_OneToOne 0.00 255.0 FORMAT "%5.1" /end CHARACTERISTIC
/begin CHARACTERISTIC DFES_FaultTyp.DFC_MoFAirFlIn_C "assigned fault type / Fault type assignment for check DFC_MoFAirFlIn" VALUE 0x80505061 Val_Wu8 255.0 DFES_OneToOne 0.00 255.0 FORMAT "%5.1" /end CHARACTERISTIC
/begin CHARACTERISTIC DFES_FaultTyp.DFC_MoFAirFlMixCtlGdiChkAirFl_C "assigned fault type / Fault type assignment for check DFC_MoFAirFlMixCtlGdiChkAirFl" VALUE 0x80505062 Val_Wu8 255.0 DFES_OneToOne 0.00 255.0 FORMAT "%5.1" /end CHARACTERISTIC
/begin CHARACTERISTIC DFES_FaultTyp.DFC_MoFAirFlMixCtlGdiChkCtrl_C "assigned fault type / Fault type assignment for check DFC_MoFAirFlMixCtlGdiChkCtrl" VALUE 0x80505063 Val_Wu8 255.0 DFES_OneToOne 0.00 255.0 FORMAT "%5.1" /end CHARACTERISTIC
/begin CHARACTERISTIC DFES_FaultTyp.DFC_MoFAirFlMode_C "assigned fault type / Fault type assignment for check DFC_MoFAirFlMode" VALUE 0x80505064 Val_Wu8 255.0 DFES_OneToOne 0.00 255.0 FORMAT "%5.1" /end CHARACTERISTIC
/begin CHARACTERISTIC DFES_FaultTyp.DFC_MoFESpd_C "assigned fault type / Fault type assignment for check DFC_MoFESpd" VALUE 0x80505065 Val_Wu8 255.0 DFES_OneToOne 0.00 255.0 FORMAT "%5.1" /end CHARACTERISTIC
/begin CHARACTERISTIC DFES_FaultTyp.DFC_MoFIACo_C "assigned fault type / Fault type assignment for check DFC_MoFIACo" VALUE 0x80505066 Val_Wu8 255.0 DFES_OneToOne 0.00 255.0 FORMAT "%5.1" /end CHARACTERISTIC
/begin CHARACTERISTIC DFES_FaultTyp.DFC_MoFICOL1_C "assigned fault type / Fault type assignment for check DFC_MoFICOL1" VALUE 0x80505067 Val_Wu8 255.0 DFES_OneToOne 0.00 255.0 FORMAT "%5.1" /end CHARACTERISTIC
/begin CHARACTERISTIC DFES_FaultTyp.DFC_MoFICOL2_C "assigned fault type / Fault type assignment for check DFC_MoFICOL2" VALUE 0x80505068 Val_Wu8 255.0 DFES_OneToOne 0.00 255.0 FORMAT "%5.1" /end CHARACTERISTIC
/begin CHARACTERISTIC DFES_FaultTyp.DFC_MoFStrt_C "assigned fault type / Fault type assignment for check DFC_MoFStrt" VALUE 0x80505069 Val_Wu8 255.0 DFES_OneToOne 0.00 255.0 FORMAT "%5.1" /end CHARACTERISTIC
/begin CHARACTERISTIC DFES_FaultTyp.DFC_MoFTrqCmp_C "assigned fault type / Fault type assignment for check DFC_MoFTrqCmp" VALUE 0x8050506A Val_Wu8 255.0 DFES_OneToOne 0.00 255.0 FORMAT "%5.1" /end CHARACTERISTIC
/begin CHARACTERISTIC DFES_FaultTyp.DFC_MoFTrqCmpMax_C "assigned fault type / Fault type assignment for check DFC_MoFTrqCmpMax" VALUE 0x8050506B Val_Wu8 255.0 DFES_OneToOne 0.00 255.0 FORMAT "%5.1" /end CHARACTERISTIC
/begin CHARACTERISTIC DFES_FaultTyp.DFC_MoFTrqCmpMin_C "assigned fault type / Fault type assignment for check DFC_MoFTrqCmpMin" VALUE 0x8050506C Val_Wu8 255.0 DFES_OneToOne 0.00 255.0 FORMAT "%5.1" /end CHARACTERISTIC
/begin CHARACTERISTIC DFES_FaultTyp.DFC_MoFVarPostBldSel_C "assigned fault type / Fault type assignment for check DFC_MoFVarPostBldSel" VALUE 0x8050506D Val_Wu8 255.0 DFES_OneToOne 0.00 255.0 FORMAT "%5.1" /end CHARACTERISTIC
/begin CHARACTERISTIC DFES_FaultTyp.DFC_MoXEMMHwLTMCUFW_C "assigned fault type / Fault type assignment for check DFC_MoXEMMHwLTMCUFW" VALUE 0x8050506E Val_Wu8 255.0 DFES_OneToOne 0.00 255.0 FORMAT "%5.1" /end CHARACTERISTIC
/begin CHARACTERISTIC DFES_FaultTyp.DFC_MoXEMMHwLTMonBIST_C "assigned fault type / Fault type assignment for check DFC_MoXEMMHwLTMonBIST" VALUE 0x8050506F Val_Wu8 255.0 DFES_OneToOne 0.00 255.0 FORMAT "%5.1" /end CHARACTERISTIC
/begin CHARACTERISTIC DFES_FaultTyp.DFC_MoXEMMHwLTRegMonTest_C "assigned fault type / Fault type assignment for check DFC_MoXEMMHwLTRegMonTest" VALUE 0x80505070 Val_Wu8 255.0 DFES_OneToOne 0.00 255.0 FORMAT "%5.1" /end CHARACTERISTIC
/begin CHARACTERISTIC DFES_FaultTyp.DFC_MoXEMMHwLTStbySMUAlvTest_C "assigned fault type / Fault type assignment for check DFC_MoXEMMHwLTStbySMUAlvTest" VALUE 0x80505071 Val_Wu8 255.0 DFES_OneToOne 0.00 255.0 FORMAT "%5.1" /end CHARACTERISTIC
/begin CHARACTERISTIC DFES_FaultTyp.DFC_MoXEMMHwLTTempSens_C "assigned fault type / Fault type assignment for check DFC_MoXEMMHwLTTempSens" VALUE 0x80505072 Val_Wu8 255.0 DFES_OneToOne 0.00 255.0 FORMAT "%5.1" /end CHARACTERISTIC
/begin CHARACTERISTIC DFES_FaultTyp.DFC_MoXEMMHwLTUCBCfg_C "assigned fault type / Fault type assignment for check DFC_MoXEMMHwLTUCBCfg" VALUE 0x80505073 Val_Wu8 255.0 DFES_OneToOne 0.00 255.0 FORMAT "%5.1" /end CHARACTERISTIC
/begin CHARACTERISTIC DFES_FaultTyp.DFC_NWSEmax_C "assigned fault type / Fault type assignment for check DFC_NWSEmax" VALUE 0x80505074 Val_Wu8 255.0 DFES_OneToOne 0.00 255.0 FORMAT "%5.1" /end CHARACTERISTIC
/begin CHARACTERISTIC DFES_FaultTyp.DFC_NWSmax_C "assigned fault type / Fault type assignment for check DFC_NWSmax" VALUE 0x80505075 Val_Wu8 255.0 DFES_OneToOne 0.00 255.0 FORMAT "%5.1" /end CHARACTERISTIC
/begin CHARACTERISTIC DFES_FaultTyp.DFC_OCWDAABEActv_C "assigned fault type / Fault type assignment for check DFC_OCWDAABEActv" VALUE 0x80505076 Val_Wu8 255.0 DFES_OneToOne 0.00 255.0 FORMAT "%5.1" /end CHARACTERISTIC
/begin CHARACTERISTIC DFES_FaultTyp.DFC_OCWDACom_C "assigned fault type / Fault type assignment for check DFC_OCWDACom" VALUE 0x80505077 Val_Wu8 255.0 DFES_OneToOne 0.00 255.0 FORMAT "%5.1" /end CHARACTERISTIC
/begin CHARACTERISTIC DFES_FaultTyp.DFC_OCWDAErrPin_C "assigned fault type / Fault type assignment for check DFC_OCWDAErrPin" VALUE 0x80505078 Val_Wu8 255.0 DFES_OneToOne 0.00 255.0 FORMAT "%5.1" /end CHARACTERISTIC
/begin CHARACTERISTIC DFES_FaultTyp.DFC_OCWDAOvrVltg_C "assigned fault type / Fault type assignment for check DFC_OCWDAOvrVltg" VALUE 0x80505079 Val_Wu8 255.0 DFES_OneToOne 0.00 255.0 FORMAT "%5.1" /end CHARACTERISTIC
/begin CHARACTERISTIC DFES_FaultTyp.DFC_ORAmax_C "assigned fault type / Fault type assignment for check DFC_ORAmax" VALUE 0x8050507A Val_Wu8 255.0 DFES_OneToOne 0.00 255.0 FORMAT "%5.1" /end CHARACTERISTIC
/begin CHARACTERISTIC DFES_FaultTyp.DFC_ORAmin_C "assigned fault type / Fault type assignment for check DFC_ORAmin" VALUE 0x8050507B Val_Wu8 255.0 DFES_OneToOne 0.00 255.0 FORMAT "%5.1" /end CHARACTERISTIC
/begin CHARACTERISTIC DFES_FaultTyp.DFC_OilPPlaus_C "assigned fault type / Fault type assignment for check DFC_OilPPlaus" VALUE 0x8050507C Val_Wu8 255.0 DFES_OneToOne 0.00 255.0 FORMAT "%5.1" /end CHARACTERISTIC
/begin CHARACTERISTIC DFES_FaultTyp.DFC_PLLSUmax_C "assigned fault type / Fault type assignment for check DFC_PLLSUmax" VALUE 0x8050507D Val_Wu8 255.0 DFES_OneToOne 0.00 255.0 FORMAT "%5.1" /end CHARACTERISTIC
/begin CHARACTERISTIC DFES_FaultTyp.DFC_PLLSUmin_C "assigned fault type / Fault type assignment for check DFC_PLLSUmin" VALUE 0x8050507E Val_Wu8 255.0 DFES_OneToOne 0.00 255.0 FORMAT "%5.1" /end CHARACTERISTIC
/begin CHARACTERISTIC DFES_FaultTyp.DFC_PSR1max_C "assigned fault type / Fault type assignment for check DFC_PSR1max" VALUE 0x8050507F Val_Wu8 255.0 DFES_OneToOne 0.00 255.0 FORMAT "%5.1" /end CHARACTERISTIC
/begin CHARACTERISTIC DFES_FaultTyp.DFC_PSRBmax_C "assigned fault type / Fault type assignment for check DFC_PSRBmax" VALUE 0x80505080 Val_Wu8 255.0 DFES_OneToOne 0.00 255.0 FORMAT "%5.1" /end CHARACTERISTIC
/begin CHARACTERISTIC DFES_FaultTyp.DFC_PSRBmin_C "assigned fault type / Fault type assignment for check DFC_PSRBmin" VALUE 0x80505081 Val_Wu8 255.0 DFES_OneToOne 0.00 255.0 FORMAT "%5.1" /end CHARACTERISTIC
/begin CHARACTERISTIC DFES_FaultTyp.DFC_PSRPmax_C "assigned fault type / Fault type assignment for check DFC_PSRPmax" VALUE 0x80505082 Val_Wu8 255.0 DFES_OneToOne 0.00 255.0 FORMAT "%5.1" /end CHARACTERISTIC
/begin CHARACTERISTIC DFES_FaultTyp.DFC_PSRPmin_C "assigned fault type / Fault type assignment for check DFC_PSRPmin" VALUE 0x80505083 Val_Wu8 255.0 DFES_OneToOne 0.00 255.0 FORMAT "%5.1" /end CHARACTERISTIC
/begin CHARACTERISTIC DFES_FaultTyp.DFC_PSRPsig_C "assigned fault type / Fault type assignment for check DFC_PSRPsig" VALUE 0x80505084 Val_Wu8 255.0 DFES_OneToOne 0.00 255.0 FORMAT "%5.1" /end CHARACTERISTIC
/begin CHARACTERISTIC DFES_FaultTyp.DFC_PSRmax_C "assigned fault type / Fault type assignment for check DFC_PSRmax" VALUE 0x80505085 Val_Wu8 255.0 DFES_OneToOne 0.00 255.0 FORMAT "%5.1" /end CHARACTERISTIC
/begin CHARACTERISTIC DFES_FaultTyp.DFC_PUmax_C "assigned fault type / Fault type assignment for check DFC_PUmax" VALUE 0x80505086 Val_Wu8 255.0 DFES_OneToOne 0.00 255.0 FORMAT "%5.1" /end CHARACTERISTIC
/begin CHARACTERISTIC DFES_FaultTyp.DFC_P_VSE11_OL_C "assigned fault type / Fault type assignment for check DFC_P_VSE11_OL" VALUE 0x80505087 Val_Wu8 255.0 DFES_OneToOne 0.00 255.0 FORMAT "%5.1" /end CHARACTERISTIC
/begin CHARACTERISTIC DFES_FaultTyp.DFC_P_VSE11_SCB_C "assigned fault type / Fault type assignment for check DFC_P_VSE11_SCB" VALUE 0x80505088 Val_Wu8 255.0 DFES_OneToOne 0.00 255.0 FORMAT "%5.1" /end CHARACTERISTIC
/begin CHARACTERISTIC DFES_FaultTyp.DFC_P_VSE11_SCG_C "assigned fault type / Fault type assignment for check DFC_P_VSE11_SCG" VALUE 0x80505089 Val_Wu8 255.0 DFES_OneToOne 0.00 255.0 FORMAT "%5.1" /end CHARACTERISTIC
/begin CHARACTERISTIC DFES_FaultTyp.DFC_PhyHighAPP1_C "assigned fault type / Fault type assignment for check DFC_PhyHighAPP1" VALUE 0x8050508A Val_Wu8 255.0 DFES_OneToOne 0.00 255.0 FORMAT "%5.1" /end CHARACTERISTIC
/begin CHARACTERISTIC DFES_FaultTyp.DFC_PhyHighAPP2_C "assigned fault type / Fault type assignment for check DFC_PhyHighAPP2" VALUE 0x8050508B Val_Wu8 255.0 DFES_OneToOne 0.00 255.0 FORMAT "%5.1" /end CHARACTERISTIC
/begin CHARACTERISTIC DFES_FaultTyp.DFC_PhyLowAPP1_C "assigned fault type / Fault type assignment for check DFC_PhyLowAPP1" VALUE 0x8050508C Val_Wu8 255.0 DFES_OneToOne 0.00 255.0 FORMAT "%5.1" /end CHARACTERISTIC
/begin CHARACTERISTIC DFES_FaultTyp.DFC_PhyLowAPP2_C "assigned fault type / Fault type assignment for check DFC_PhyLowAPP2" VALUE 0x8050508D Val_Wu8 255.0 DFES_OneToOne 0.00 255.0 FORMAT "%5.1" /end CHARACTERISTIC
/begin CHARACTERISTIC DFES_FaultTyp.DFC_SRCHighAPP1_C "assigned fault type / Fault type assignment for check DFC_SRCHighAPP1" VALUE 0x8050508E Val_Wu8 255.0 DFES_OneToOne 0.00 255.0 FORMAT "%5.1" /end CHARACTERISTIC
/begin CHARACTERISTIC DFES_FaultTyp.DFC_SRCHighAPP2_C "assigned fault type / Fault type assignment for check DFC_SRCHighAPP2" VALUE 0x8050508F Val_Wu8 255.0 DFES_OneToOne 0.00 255.0 FORMAT "%5.1" /end CHARACTERISTIC
/begin CHARACTERISTIC DFES_FaultTyp.DFC_SRCLowAPP1_C "assigned fault type / Fault type assignment for check DFC_SRCLowAPP1" VALUE 0x80505090 Val_Wu8 255.0 DFES_OneToOne 0.00 255.0 FORMAT "%5.1" /end CHARACTERISTIC
/begin CHARACTERISTIC DFES_FaultTyp.DFC_SRCLowAPP2_C "assigned fault type / Fault type assignment for check DFC_SRCLowAPP2" VALUE 0x80505091 Val_Wu8 255.0 DFES_OneToOne 0.00 255.0 FORMAT "%5.1" /end CHARACTERISTIC
/begin CHARACTERISTIC DFES_FaultTyp.DFC_SSpMon2_C "assigned fault type / Fault type assignment for check DFC_SSpMon2" VALUE 0x80505092 Val_Wu8 255.0 DFES_OneToOne 0.00 255.0 FORMAT "%5.1" /end CHARACTERISTIC
/begin CHARACTERISTIC DFES_FaultTyp.DFC_STHDRmax_C "assigned fault type / Fault type assignment for check DFC_STHDRmax" VALUE 0x80505093 Val_Wu8 255.0 DFES_OneToOne 0.00 255.0 FORMAT "%5.1" /end CHARACTERISTIC
/begin CHARACTERISTIC DFES_FaultTyp.DFC_SWReset_0_C "assigned fault type / Fault type assignment for check DFC_SWReset_0" VALUE 0x80505094 Val_Wu8 255.0 DFES_OneToOne 0.00 255.0 FORMAT "%5.1" /end CHARACTERISTIC
/begin CHARACTERISTIC DFES_FaultTyp.DFC_SWReset_1_C "assigned fault type / Fault type assignment for check DFC_SWReset_1" VALUE 0x80505095 Val_Wu8 255.0 DFES_OneToOne 0.00 255.0 FORMAT "%5.1" /end CHARACTERISTIC
/begin CHARACTERISTIC DFES_FaultTyp.DFC_SWReset_2_C "assigned fault type / Fault type assignment for check DFC_SWReset_2" VALUE 0x80505096 Val_Wu8 255.0 DFES_OneToOne 0.00 255.0 FORMAT "%5.1" /end CHARACTERISTIC
/begin CHARACTERISTIC DFES_FaultTyp.DFC_SyncAPP_C "assigned fault type / Fault type assignment for check DFC_SyncAPP" VALUE 0x80505097 Val_Wu8 255.0 DFES_OneToOne 0.00 255.0 FORMAT "%5.1" /end CHARACTERISTIC
/begin CHARACTERISTIC DFES_FaultTyp.DFC_TANKLnpl_C "assigned fault type / Fault type assignment for check DFC_TANKLnpl" VALUE 0x80505098 Val_Wu8 255.0 DFES_OneToOne 0.00 255.0 FORMAT "%5.1" /end CHARACTERISTIC
/begin CHARACTERISTIC DFES_FaultTyp.DFC_TAmax_Dummy_C "assigned fault type / Fault type assignment for check DFC_TAmax_Dummy" VALUE 0x80505099 Val_Wu8 255.0 DFES_OneToOne 0.00 255.0 FORMAT "%5.1" /end CHARACTERISTIC
/begin CHARACTERISTIC DFES_FaultTyp.DFC_TESFmax_C "assigned fault type / Fault type assignment for check DFC_TESFmax" VALUE 0x8050509A Val_Wu8 255.0 DFES_OneToOne 0.00 255.0 FORMAT "%5.1" /end CHARACTERISTIC
/begin CHARACTERISTIC DFES_FaultTyp.DFC_TESGmax_C "assigned fault type / Fault type assignment for check DFC_TESGmax" VALUE 0x8050509B Val_Wu8 255.0 DFES_OneToOne 0.00 255.0 FORMAT "%5.1" /end CHARACTERISTIC
/begin CHARACTERISTIC DFES_FaultTyp.DFC_TKAEmax_C "assigned fault type / Fault type assignment for check DFC_TKAEmax" VALUE 0x8050509C Val_Wu8 255.0 DFES_OneToOne 0.00 255.0 FORMAT "%5.1" /end CHARACTERISTIC
/begin CHARACTERISTIC DFES_FaultTyp.DFC_TKAEmin_C "assigned fault type / Fault type assignment for check DFC_TKAEmin" VALUE 0x8050509D Val_Wu8 255.0 DFES_OneToOne 0.00 255.0 FORMAT "%5.1" /end CHARACTERISTIC
/begin CHARACTERISTIC DFES_FaultTyp.DFC_TKARmax_C "assigned fault type / Fault type assignment for check DFC_TKARmax" VALUE 0x8050509E Val_Wu8 255.0 DFES_OneToOne 0.00 255.0 FORMAT "%5.1" /end CHARACTERISTIC
/begin CHARACTERISTIC DFES_FaultTyp.DFC_TKARnpl_C "assigned fault type / Fault type assignment for check DFC_TKARnpl" VALUE 0x8050509F Val_Wu8 255.0 DFES_OneToOne 0.00 255.0 FORMAT "%5.1" /end CHARACTERISTIC
/begin CHARACTERISTIC DFES_FaultTyp.DFC_TMmax_Dummy_C "assigned fault type / Fault type assignment for check DFC_TMmax_Dummy" VALUE 0x805050A0 Val_Wu8 255.0 DFES_OneToOne 0.00 255.0 FORMAT "%5.1" /end CHARACTERISTIC
/begin CHARACTERISTIC DFES_FaultTyp.DFC_TUMmax_Dummy_C "assigned fault type / Fault type assignment for check DFC_TUMmax_Dummy" VALUE 0x805050A1 Val_Wu8 255.0 DFES_OneToOne 0.00 255.0 FORMAT "%5.1" /end CHARACTERISTIC
/begin CHARACTERISTIC DFES_FaultTyp.DFC_TWCDPriCatB1_C "assigned fault type / Fault type assignment for check DFC_TWCDPriCatB1" VALUE 0x805050A2 Val_Wu8 255.0 DFES_OneToOne 0.00 255.0 FORMAT "%5.1" /end CHARACTERISTIC
/begin CHARACTERISTIC DFES_FaultTyp.DFC_ThrVlvClsdPosnFirstOffsLrnImpoB1_C "assigned fault type / Fault type assignment for check DFC_ThrVlvClsdPosnFirstOffsLrnImpoB1" VALUE 0x805050A3 Val_Wu8 255.0 DFES_OneToOne 0.00 255.0 FORMAT "%5.1" /end CHARACTERISTIC
/begin CHARACTERISTIC DFES_FaultTyp.DFC_ThrVlvClsdPosnOffsLrnImpoB1_C "assigned fault type / Fault type assignment for check DFC_ThrVlvClsdPosnOffsLrnImpoB1" VALUE 0x805050A4 Val_Wu8 255.0 DFES_OneToOne 0.00 255.0 FORMAT "%5.1" /end CHARACTERISTIC
/begin CHARACTERISTIC DFES_FaultTyp.DFC_ThrVlvClsdPosnOffsLrnMaxB1_C "assigned fault type / Fault type assignment for check DFC_ThrVlvClsdPosnOffsLrnMaxB1" VALUE 0x805050A5 Val_Wu8 255.0 DFES_OneToOne 0.00 255.0 FORMAT "%5.1" /end CHARACTERISTIC
/begin CHARACTERISTIC DFES_FaultTyp.DFC_ThrVlvClsdPosnOffsLrnMinB1_C "assigned fault type / Fault type assignment for check DFC_ThrVlvClsdPosnOffsLrnMinB1" VALUE 0x805050A6 Val_Wu8 255.0 DFES_OneToOne 0.00 255.0 FORMAT "%5.1" /end CHARACTERISTIC
/begin CHARACTERISTIC DFES_FaultTyp.DFC_ThrVlvCtrlDeB1_C "assigned fault type / Fault type assignment for check DFC_ThrVlvCtrlDeB1" VALUE 0x805050A7 Val_Wu8 255.0 DFES_OneToOne 0.00 255.0 FORMAT "%5.1" /end CHARACTERISTIC
/begin CHARACTERISTIC DFES_FaultTyp.DFC_ThrVlvDycB1_C "assigned fault type / Fault type assignment for check DFC_ThrVlvDycB1" VALUE 0x805050A8 Val_Wu8 255.0 DFES_OneToOne 0.00 255.0 FORMAT "%5.1" /end CHARACTERISTIC
/begin CHARACTERISTIC DFES_FaultTyp.DFC_ThrVlvLimpAirPosnMaxAbsltDriftB1_C "assigned fault type / Fault type assignment for check DFC_ThrVlvLimpAirPosnMaxAbsltDriftB1" VALUE 0x805050A9 Val_Wu8 255.0 DFES_OneToOne 0.00 255.0 FORMAT "%5.1" /end CHARACTERISTIC
/begin CHARACTERISTIC DFES_FaultTyp.DFC_ThrVlvLimpAirPosnMaxB1_C "assigned fault type / Fault type assignment for check DFC_ThrVlvLimpAirPosnMaxB1" VALUE 0x805050AA Val_Wu8 255.0 DFES_OneToOne 0.00 255.0 FORMAT "%5.1" /end CHARACTERISTIC
/begin CHARACTERISTIC DFES_FaultTyp.DFC_ThrVlvLimpAirPosnMaxRelDriftB1_C "assigned fault type / Fault type assignment for check DFC_ThrVlvLimpAirPosnMaxRelDriftB1" VALUE 0x805050AB Val_Wu8 255.0 DFES_OneToOne 0.00 255.0 FORMAT "%5.1" /end CHARACTERISTIC
/begin CHARACTERISTIC DFES_FaultTyp.DFC_ThrVlvLimpAirPosnMinB1_C "assigned fault type / Fault type assignment for check DFC_ThrVlvLimpAirPosnMinB1" VALUE 0x805050AC Val_Wu8 255.0 DFES_OneToOne 0.00 255.0 FORMAT "%5.1" /end CHARACTERISTIC
/begin CHARACTERISTIC DFES_FaultTyp.DFC_ThrVlvOpenLoadB1_C "assigned fault type / Fault type assignment for check DFC_ThrVlvOpenLoadB1" VALUE 0x805050AD Val_Wu8 255.0 DFES_OneToOne 0.00 255.0 FORMAT "%5.1" /end CHARACTERISTIC
/begin CHARACTERISTIC DFES_FaultTyp.DFC_ThrVlvOpenSprgB1_C "assigned fault type / Fault type assignment for check DFC_ThrVlvOpenSprgB1" VALUE 0x805050AE Val_Wu8 255.0 DFES_OneToOne 0.00 255.0 FORMAT "%5.1" /end CHARACTERISTIC
/begin CHARACTERISTIC DFES_FaultTyp.DFC_ThrVlvOpenSprgSprdB1_C "assigned fault type / Fault type assignment for check DFC_ThrVlvOpenSprgSprdB1" VALUE 0x805050AF Val_Wu8 255.0 DFES_OneToOne 0.00 255.0 FORMAT "%5.1" /end CHARACTERISTIC
/begin CHARACTERISTIC DFES_FaultTyp.DFC_ThrVlvOpenSprgTwnB1_C "assigned fault type / Fault type assignment for check DFC_ThrVlvOpenSprgTwnB1" VALUE 0x805050B0 Val_Wu8 255.0 DFES_OneToOne 0.00 255.0 FORMAT "%5.1" /end CHARACTERISTIC
/begin CHARACTERISTIC DFES_FaultTyp.DFC_ThrVlvOverTB1_C "assigned fault type / Fault type assignment for check DFC_ThrVlvOverTB1" VALUE 0x805050B1 Val_Wu8 255.0 DFES_OneToOne 0.00 255.0 FORMAT "%5.1" /end CHARACTERISTIC
/begin CHARACTERISTIC DFES_FaultTyp.DFC_ThrVlvRetSprgB1_C "assigned fault type / Fault type assignment for check DFC_ThrVlvRetSprgB1" VALUE 0x805050B2 Val_Wu8 255.0 DFES_OneToOne 0.00 255.0 FORMAT "%5.1" /end CHARACTERISTIC
/begin CHARACTERISTIC DFES_FaultTyp.DFC_ThrVlvRetSprgSprdB1_C "assigned fault type / Fault type assignment for check DFC_ThrVlvRetSprgSprdB1" VALUE 0x805050B3 Val_Wu8 255.0 DFES_OneToOne 0.00 255.0 FORMAT "%5.1" /end CHARACTERISTIC
/begin CHARACTERISTIC DFES_FaultTyp.DFC_ThrVlvRetSprgTwnB1_C "assigned fault type / Fault type assignment for check DFC_ThrVlvRetSprgTwnB1" VALUE 0x805050B4 Val_Wu8 255.0 DFES_OneToOne 0.00 255.0 FORMAT "%5.1" /end CHARACTERISTIC
/begin CHARACTERISTIC DFES_FaultTyp.DFC_ThrVlvSens1MaxB1_C "assigned fault type / Fault type assignment for check DFC_ThrVlvSens1MaxB1" VALUE 0x805050B5 Val_Wu8 255.0 DFES_OneToOne 0.00 255.0 FORMAT "%5.1" /end CHARACTERISTIC
/begin CHARACTERISTIC DFES_FaultTyp.DFC_ThrVlvSens1NplB1_C "assigned fault type / Fault type assignment for check DFC_ThrVlvSens1NplB1" VALUE 0x805050B6 Val_Wu8 255.0 DFES_OneToOne 0.00 255.0 FORMAT "%5.1" /end CHARACTERISTIC
/begin CHARACTERISTIC DFES_FaultTyp.DFC_ThrVlvSens2MaxB1_C "assigned fault type / Fault type assignment for check DFC_ThrVlvSens2MaxB1" VALUE 0x805050B7 Val_Wu8 255.0 DFES_OneToOne 0.00 255.0 FORMAT "%5.1" /end CHARACTERISTIC
/begin CHARACTERISTIC DFES_FaultTyp.DFC_ThrVlvSens2MinB1_C "assigned fault type / Fault type assignment for check DFC_ThrVlvSens2MinB1" VALUE 0x805050B8 Val_Wu8 255.0 DFES_OneToOne 0.00 255.0 FORMAT "%5.1" /end CHARACTERISTIC
/begin CHARACTERISTIC DFES_FaultTyp.DFC_ThrVlvSens2NplB1_C "assigned fault type / Fault type assignment for check DFC_ThrVlvSens2NplB1" VALUE 0x805050B9 Val_Wu8 255.0 DFES_OneToOne 0.00 255.0 FORMAT "%5.1" /end CHARACTERISTIC
/begin CHARACTERISTIC DFES_FaultTyp.DFC_ThrVlvShoCircB1_C "assigned fault type / Fault type assignment for check DFC_ThrVlvShoCircB1" VALUE 0x805050BA Val_Wu8 255.0 DFES_OneToOne 0.00 255.0 FORMAT "%5.1" /end CHARACTERISTIC
/begin CHARACTERISTIC DFES_FaultTyp.DFC_ThrVlvSpiErrB1_C "assigned fault type / Fault type assignment for check DFC_ThrVlvSpiErrB1" VALUE 0x805050BB Val_Wu8 255.0 DFES_OneToOne 0.00 255.0 FORMAT "%5.1" /end CHARACTERISTIC
/begin CHARACTERISTIC DFES_FaultTyp.DFC_ThrvlvSens1MinB1_C "assigned fault type / Fault type assignment for check DFC_ThrvlvSens1MinB1" VALUE 0x805050BC Val_Wu8 255.0 DFES_OneToOne 0.00 255.0 FORMAT "%5.1" /end CHARACTERISTIC
/begin CHARACTERISTIC DFES_FaultTyp.DFC_TiOffTBasdChkFast_C "assigned fault type / Fault type assignment for check DFC_TiOffTBasdChkFast" VALUE 0x805050BD Val_Wu8 255.0 DFES_OneToOne 0.00 255.0 FORMAT "%5.1" /end CHARACTERISTIC
/begin CHARACTERISTIC DFES_FaultTyp.DFC_TiOffTBasdChkSlow_C "assigned fault type / Fault type assignment for check DFC_TiOffTBasdChkSlow" VALUE 0x805050BE Val_Wu8 255.0 DFES_OneToOne 0.00 255.0 FORMAT "%5.1" /end CHARACTERISTIC
/begin CHARACTERISTIC DFES_FaultTyp.DFC_UEGOSnsrMntdS1B1_C "assigned fault type / Fault type assignment for check DFC_UEGOSnsrMntdS1B1" VALUE 0x805050BF Val_Wu8 255.0 DFES_OneToOne 0.00 255.0 FORMAT "%5.1" /end CHARACTERISTIC
/begin CHARACTERISTIC DFES_FaultTyp.DFC_VehVSig_C "assigned fault type / Fault type assignment for check DFC_VehVSig" VALUE 0x805050C0 Val_Wu8 255.0 DFES_OneToOne 0.00 255.0 FORMAT "%5.1" /end CHARACTERISTIC
/begin CHARACTERISTIC DFES_FaultTyp.DFC_VlvLftFbSwtIntk11SpclFail_C "assigned fault type / Fault type assignment for check DFC_VlvLftFbSwtIntk11SpclFail" VALUE 0x805050C1 Val_Wu8 255.0 DFES_OneToOne 0.00 255.0 FORMAT "%5.1" /end CHARACTERISTIC
/begin CHARACTERISTIC DFES_FaultTyp.DFC_VlvLftFbSwtIntk11StdFail_C "assigned fault type / Fault type assignment for check DFC_VlvLftFbSwtIntk11StdFail" VALUE 0x805050C2 Val_Wu8 255.0 DFES_OneToOne 0.00 255.0 FORMAT "%5.1" /end CHARACTERISTIC
/begin CHARACTERISTIC DFES_GrpRpr.DFC_Unused_C "common MIL debouncing / " VALUE 0x805050C8 Val_Wu16 906.000000000 DFC_Verb 0.00 906.000000000 FORMAT "%13.9" READ_ONLY /end CHARACTERISTIC
/begin CHARACTERISTIC DFES_GrpRpr.DFC_AAVEmax_C "common MIL debouncing / group representative for common MIL debouncing of DFC_AAVEmax" VALUE 0x805050CA Val_Wu16 906.000000000 DFC_Verb 0.00 906.000000000 FORMAT "%13.9" /end CHARACTERISTIC
/begin CHARACTERISTIC DFES_GrpRpr.DFC_AAVEmin_C "common MIL debouncing / group representative for common MIL debouncing of DFC_AAVEmin" VALUE 0x805050CC Val_Wu16 906.000000000 DFC_Verb 0.00 906.000000000 FORMAT "%13.9" /end CHARACTERISTIC
/begin CHARACTERISTIC DFES_GrpRpr.DFC_AAVEsig_C "common MIL debouncing / group representative for common MIL debouncing of DFC_AAVEsig" VALUE 0x805050CE Val_Wu16 906.000000000 DFC_Verb 0.00 906.000000000 FORMAT "%13.9" /end CHARACTERISTIC
/begin CHARACTERISTIC DFES_GrpRpr.DFC_AltIOACGFailr_C "common MIL debouncing / group representative for common MIL debouncing of DFC_AltIOACGFailr" VALUE 0x805050D0 Val_Wu16 906.000000000 DFC_Verb 0.00 906.000000000 FORMAT "%13.9" /end CHARACTERISTIC
/begin CHARACTERISTIC DFES_GrpRpr.DFC_AltIOACGHiVltg_C "common MIL debouncing / group representative for common MIL debouncing of DFC_AltIOACGHiVltg" VALUE 0x805050D2 Val_Wu16 906.000000000 DFC_Verb 0.00 906.000000000 FORMAT "%13.9" /end CHARACTERISTIC
/begin CHARACTERISTIC DFES_GrpRpr.DFC_AltIOACGLoVltg_C "common MIL debouncing / group representative for common MIL debouncing of DFC_AltIOACGLoVltg" VALUE 0x805050D4 Val_Wu16 906.000000000 DFC_Verb 0.00 906.000000000 FORMAT "%13.9" /end CHARACTERISTIC
/begin CHARACTERISTIC DFES_GrpRpr.DFC_AltIOACGTHi_C "common MIL debouncing / group representative for common MIL debouncing of DFC_AltIOACGTHi" VALUE 0x805050D6 Val_Wu16 906.000000000 DFC_Verb 0.00 906.000000000 FORMAT "%13.9" /end CHARACTERISTIC
/begin CHARACTERISTIC DFES_GrpRpr.DFC_AltIODConnACG_C "common MIL debouncing / group representative for common MIL debouncing of DFC_AltIODConnACG" VALUE 0x805050D8 Val_Wu16 906.000000000 DFC_Verb 0.00 906.000000000 FORMAT "%13.9" /end CHARACTERISTIC
/begin CHARACTERISTIC DFES_GrpRpr.DFC_BGOELWAF_C "common MIL debouncing / group representative for common MIL debouncing of DFC_BGOELWAF" VALUE 0x805050DA Val_Wu16 906.000000000 DFC_Verb 0.00 906.000000000 FORMAT "%13.9" /end CHARACTERISTIC
/begin CHARACTERISTIC DFES_GrpRpr.DFC_BattUHiFailr_C "common MIL debouncing / group representative for common MIL debouncing of DFC_BattUHiFailr" VALUE 0x805050DC Val_Wu16 906.000000000 DFC_Verb 0.00 906.000000000 FORMAT "%13.9" /end CHARACTERISTIC
/begin CHARACTERISTIC DFES_GrpRpr.DFC_BattULoFailr_C "common MIL debouncing / group representative for common MIL debouncing of DFC_BattULoFailr" VALUE 0x805050DE Val_Wu16 906.000000000 DFC_Verb 0.00 906.000000000 FORMAT "%13.9" /end CHARACTERISTIC
/begin CHARACTERISTIC DFES_GrpRpr.DFC_BrkBstPDriftHiErr_C "common MIL debouncing / group representative for common MIL debouncing of DFC_BrkBstPDriftHiErr" VALUE 0x805050E0 Val_Wu16 906.000000000 DFC_Verb 0.00 906.000000000 FORMAT "%13.9" /end CHARACTERISTIC
/begin CHARACTERISTIC DFES_GrpRpr.DFC_BrkBstPDriftLoErr_C "common MIL debouncing / group representative for common MIL debouncing of DFC_BrkBstPDriftLoErr" VALUE 0x805050E2 Val_Wu16 906.000000000 DFC_Verb 0.00 906.000000000 FORMAT "%13.9" /end CHARACTERISTIC
/begin CHARACTERISTIC DFES_GrpRpr.DFC_BrkBstPSnsrStuck_C "common MIL debouncing / group representative for common MIL debouncing of DFC_BrkBstPSnsrStuck" VALUE 0x805050E4 Val_Wu16 906.000000000 DFC_Verb 0.00 906.000000000 FORMAT "%13.9" /end CHARACTERISTIC
/begin CHARACTERISTIC DFES_GrpRpr.DFC_BrkMnSwtContOn_C "common MIL debouncing / group representative for common MIL debouncing of DFC_BrkMnSwtContOn" VALUE 0x805050E6 Val_Wu16 906.000000000 DFC_Verb 0.00 906.000000000 FORMAT "%13.9" /end CHARACTERISTIC
/begin CHARACTERISTIC DFES_GrpRpr.DFC_BrkMnSwtNotStp_C "common MIL debouncing / group representative for common MIL debouncing of DFC_BrkMnSwtNotStp" VALUE 0x805050E8 Val_Wu16 906.000000000 DFC_Verb 0.00 906.000000000 FORMAT "%13.9" /end CHARACTERISTIC
/begin CHARACTERISTIC DFES_GrpRpr.DFC_BrkNpl_C "common MIL debouncing / group representative for common MIL debouncing of DFC_BrkNpl" VALUE 0x805050EA Val_Wu16 906.000000000 DFC_Verb 0.00 906.000000000 FORMAT "%13.9" /end CHARACTERISTIC
/begin CHARACTERISTIC DFES_GrpRpr.DFC_BrkRdntSwtContOn_C "common MIL debouncing / group representative for common MIL debouncing of DFC_BrkRdntSwtContOn" VALUE 0x805050EC Val_Wu16 906.000000000 DFC_Verb 0.00 906.000000000 FORMAT "%13.9" /end CHARACTERISTIC
/begin CHARACTERISTIC DFES_GrpRpr.DFC_BrkRdntSwtNotStp_C "common MIL debouncing / group representative for common MIL debouncing of DFC_BrkRdntSwtNotStp" VALUE 0x805050EE Val_Wu16 906.000000000 DFC_Verb 0.00 906.000000000 FORMAT "%13.9" /end CHARACTERISTIC
/begin CHARACTERISTIC DFES_GrpRpr.DFC_Clth3ONStuck_C "common MIL debouncing / group representative for common MIL debouncing of DFC_Clth3ONStuck" VALUE 0x805050F0 Val_Wu16 906.000000000 DFC_Verb 0.00 906.000000000 FORMAT "%13.9" /end CHARACTERISTIC
/begin CHARACTERISTIC DFES_GrpRpr.DFC_Clth4OFFStuck_C "common MIL debouncing / group representative for common MIL debouncing of DFC_Clth4OFFStuck" VALUE 0x805050F2 Val_Wu16 906.000000000 DFC_Verb 0.00 906.000000000 FORMAT "%13.9" /end CHARACTERISTIC
/begin CHARACTERISTIC DFES_GrpRpr.DFC_ClthOFFStuck_C "common MIL debouncing / group representative for common MIL debouncing of DFC_ClthOFFStuck" VALUE 0x805050F4 Val_Wu16 906.000000000 DFC_Verb 0.00 906.000000000 FORMAT "%13.9" /end CHARACTERISTIC
/begin CHARACTERISTIC DFES_GrpRpr.DFC_ClthONStuck_C "common MIL debouncing / group representative for common MIL debouncing of DFC_ClthONStuck" VALUE 0x805050F6 Val_Wu16 906.000000000 DFC_Verb 0.00 906.000000000 FORMAT "%13.9" /end CHARACTERISTIC
/begin CHARACTERISTIC DFES_GrpRpr.DFC_ClthStkFailInfo_C "common MIL debouncing / group representative for common MIL debouncing of DFC_ClthStkFailInfo" VALUE 0x805050F8 Val_Wu16 906.000000000 DFC_Verb 0.00 906.000000000 FORMAT "%13.9" /end CHARACTERISTIC
/begin CHARACTERISTIC DFES_GrpRpr.DFC_ComACFailInfo_C "common MIL debouncing / group representative for common MIL debouncing of DFC_ComACFailInfo" VALUE 0x805050FA Val_Wu16 906.000000000 DFC_Verb 0.00 906.000000000 FORMAT "%13.9" /end CHARACTERISTIC
/begin CHARACTERISTIC DFES_GrpRpr.DFC_ComATFTValErr_C "common MIL debouncing / group representative for common MIL debouncing of DFC_ComATFTValErr" VALUE 0x805050FC Val_Wu16 906.000000000 DFC_Verb 0.00 906.000000000 FORMAT "%13.9" /end CHARACTERISTIC
/begin CHARACTERISTIC DFES_GrpRpr.DFC_ComATMILReq_C "common MIL debouncing / group representative for common MIL debouncing of DFC_ComATMILReq" VALUE 0x805050FE Val_Wu16 906.000000000 DFC_Verb 0.00 906.000000000 FORMAT "%13.9" /end CHARACTERISTIC
/begin CHARACTERISTIC DFES_GrpRpr.DFC_ComAYCAChksum_C "common MIL debouncing / group representative for common MIL debouncing of DFC_ComAYCAChksum" VALUE 0x80505100 Val_Wu16 906.000000000 DFC_Verb 0.00 906.000000000 FORMAT "%13.9" /end CHARACTERISTIC
/begin CHARACTERISTIC DFES_GrpRpr.DFC_ComAYCARingCnt_C "common MIL debouncing / group representative for common MIL debouncing of DFC_ComAYCARingCnt" VALUE 0x80505102 Val_Wu16 906.000000000 DFC_Verb 0.00 906.000000000 FORMAT "%13.9" /end CHARACTERISTIC
/begin CHARACTERISTIC DFES_GrpRpr.DFC_ComAYCATOut_C "common MIL debouncing / group representative for common MIL debouncing of DFC_ComAYCATOut" VALUE 0x80505104 Val_Wu16 906.000000000 DFC_Verb 0.00 906.000000000 FORMAT "%13.9" /end CHARACTERISTIC
/begin CHARACTERISTIC DFES_GrpRpr.DFC_ComAYCDChkSum_C "common MIL debouncing / group representative for common MIL debouncing of DFC_ComAYCDChkSum" VALUE 0x80505106 Val_Wu16 906.000000000 DFC_Verb 0.00 906.000000000 FORMAT "%13.9" /end CHARACTERISTIC
/begin CHARACTERISTIC DFES_GrpRpr.DFC_ComAYCDTOut_C "common MIL debouncing / group representative for common MIL debouncing of DFC_ComAYCDTOut" VALUE 0x80505108 Val_Wu16 906.000000000 DFC_Verb 0.00 906.000000000 FORMAT "%13.9" /end CHARACTERISTIC
/begin CHARACTERISTIC DFES_GrpRpr.DFC_ComAYCFChksum_C "common MIL debouncing / group representative for common MIL debouncing of DFC_ComAYCFChksum" VALUE 0x8050510A Val_Wu16 906.000000000 DFC_Verb 0.00 906.000000000 FORMAT "%13.9" /end CHARACTERISTIC
/begin CHARACTERISTIC DFES_GrpRpr.DFC_ComAYCFRingCnt_C "common MIL debouncing / group representative for common MIL debouncing of DFC_ComAYCFRingCnt" VALUE 0x8050510C Val_Wu16 906.000000000 DFC_Verb 0.00 906.000000000 FORMAT "%13.9" /end CHARACTERISTIC
/begin CHARACTERISTIC DFES_GrpRpr.DFC_ComAYCFTOut_C "common MIL debouncing / group representative for common MIL debouncing of DFC_ComAYCFTOut" VALUE 0x8050510E Val_Wu16 906.000000000 DFC_Verb 0.00 906.000000000 FORMAT "%13.9" /end CHARACTERISTIC
/begin CHARACTERISTIC DFES_GrpRpr.DFC_ComAYCGChksum_C "common MIL debouncing / group representative for common MIL debouncing of DFC_ComAYCGChksum" VALUE 0x80505110 Val_Wu16 906.000000000 DFC_Verb 0.00 906.000000000 FORMAT "%13.9" /end CHARACTERISTIC
/begin FUNCTION DFES "30000.73.0_2.0.0Diagnostic Fault Event Storage"
 /begin DEF_CHARACTERISTIC DFES_FaultTyp.DFC_IgnClPs_LineScg_2_C DFES_FaultTyp.DFC_IgnClPs_LineScg_3_C DFES_FaultTyp.DFC_KRVEKOEVAB_C DFES_FaultTyp.DFC_KRVEKOEVAB0_C DFES_FaultTyp.DFC_KRVEKOEVAB1_C DFES_FaultTyp.DFC_KRVEKOEVAB2_C DFES_FaultTyp.DFC_KRVEKOEVAB3_C DFES_FaultTyp.DFC_UegoSigEcuAsicS1B1_C DFES_FaultTyp.DFC_UegoSigEcuComS1B1_C DFES_FaultTyp.DFC_UegoSigSnsrS1B1_C DFES_FaultTyp.DFC_UegoSigWireOlApesS1B1_C DFES_FaultTyp.DFC_UegoSigWireOlIpeS1B1_C DFES_FaultTyp.DFC_UegoSigWireOlReS1B1_C DFES_FaultTyp.DFC_UegoSigWireRCmpS1B1_C DFES_FaultTyp.DFC_UegoSigWireScbS1B1_C DFES_FaultTyp.DFC_UegoSigWireScgS1B1_C DFES_FaultTyp.DFC_AfsPhyRngHiB1_C DFES_FaultTyp.DFC_AfsPhyRngLoB1_C DFES_FaultTyp.DFC_AirCCmprOL_C DFES_FaultTyp.DFC_AirCCmprOvrTemp_C DFES_FaultTyp.DFC_AirCCmprSCB_C DFES_FaultTyp.DFC_AirCCmprSCG_C DFES_FaultTyp.DFC_AltErr_C DFES_FaultTyp.DFC_BattUSRCMax_C DFES_FaultTyp.DFC_BattUSRCMin_C DFES_FaultTyp.DFC_ComChksTCU1_C DFES_FaultTyp.DFC_ComChksTCU11_C DFES_FaultTyp.DFC_ComChksTCU12_C DFES_FaultTyp.DFC_ComChksTCU13_C DFES_FaultTyp.DFC_ComChksTCU2_C DFES_FaultTyp.DFC_ComChksTCU3_C DFES_FaultTyp.DFC_ComChksTCU4_C DFES_FaultTyp.DFC_ComCntTCU1_C DFES_FaultTyp.DFC_ComCntTCU11_C DFES_FaultTyp.DFC_ComCntTCU12_C DFES_FaultTyp.DFC_ComCntTCU13_C DFES_FaultTyp.DFC_ComCntTCU2_C DFES_FaultTyp.DFC_ComCntTCU3_C DFES_FaultTyp.DFC_ComCntTCU4_C DFES_FaultTyp.DFC_ComTOutTCU01_C DFES_FaultTyp.DFC_ComTOutTCU02_C DFES_FaultTyp.DFC_ComTOutTCU1_C DFES_FaultTyp.DFC_ComTOutTCU11_C DFES_FaultTyp.DFC_ComTOutTCU12_C DFES_FaultTyp.DFC_ComTOutTCU13_C DFES_FaultTyp.DFC_ComTOutTCU14_C DFES_FaultTyp.DFC_ComTOutTCU2_C DFES_FaultTyp.DFC_ComTOutTCU3_C DFES_FaultTyp.DFC_ComTOutTCU4_C DFES_FaultTyp.DFC_DevLibBattUHi_C DFES_FaultTyp.DFC_DevLibBattULo_C DFES_FaultTyp.DFC_EGRVlvFailSafeActv_C DFES_FaultTyp.DFC_EGRVlvGovDvtCld_C DFES_FaultTyp.DFC_EGRVlvPhysSRCMax_C DFES_FaultTyp.DFC_EGRVlvPhysSRCMin_C DFES_FaultTyp.DFC_FanDIOOL_0_C DFES_FaultTyp.DFC_FanDIOOL_1_C DFES_FaultTyp.DFC_FanDIOOvrTemp_0_C DFES_FaultTyp.DFC_FanDIOOvrTemp_1_C DFES_FaultTyp.DFC_FanDIOSCB_0_C DFES_FaultTyp.DFC_FanDIOSCB_1_C DFES_FaultTyp.DFC_FanDIOSCG_0_C DFES_FaultTyp.DFC_FanDIOSCG_1_C DFES_FaultTyp.DFC_MRlyDcOL_C DFES_FaultTyp.DFC_MRlyDcSCB_C DFES_FaultTyp.DFC_MRlyDcSCG_C DFES_FaultTyp.DFC_PSPOL_C DFES_FaultTyp.DFC_PSPOvrTemp_C DFES_FaultTyp.DFC_PSPSCB_C DFES_FaultTyp.DFC_PSPSCG_C DFES_FaultTyp.DFC_T50Err_C DFES_FaultTyp.DFC_ThrVlvLoBattB1_C DFES_FaultTyp.DFC_UegoSigOperPlausS1B1_C DFES_FaultTyp.DFC_VehVPhysRngHi_C DFES_FaultTyp.DFC_VehVSclOutOL_C DFES_FaultTyp.DFC_VehVSclOutOT_C DFES_FaultTyp.DFC_VehVSclOutSCB_C DFES_FaultTyp.DFC_VehVSclOutSCG_C DFES_FaultTyp.DFC_VehVSigFL_C DFES_FaultTyp.DFC_VehVSigFR_C DFES_FaultTyp.DFC_VehVSigRL_C DFES_FaultTyp.DFC_VehVSigRR_C DFES_FaultTyp.DFC_VehVSnsrARngHi_C DFES_FaultTyp.DFC_VehVSnsrBRngHi_C DFES_FaultTyp.DFC_VehVSpdRtyDiag_C DFES_FaultTyp.DFC_DHFHD_C DFES_FaultTyp.DFC_InjVlv_DI_DcDc_C DFES_FaultTyp.DFC_InjVlv_DI_NoLd_0_C DFES_FaultTyp.DFC_InjVlv_DI_NoLd_1_C DFES_FaultTyp.DFC_InjVlv_DI_NoLd_2_C DFES_FaultTyp.DFC_InjVlv_DI_NoLd_3_C DFES_FaultTyp.DFC_InjVlv_DI_ScBnk_0_C DFES_FaultTyp.DFC_InjVlv_DI_ScBnk_1_C DFES_FaultTyp.DFC_InjVlv_DI_ScBnk_2_C DFES_FaultTyp.DFC_InjVlv_DI_ScBnk_3_C DFES_FaultTyp.DFC_InjVlv_DI_ScCyl_0_C DFES_FaultTyp.DFC_InjVlv_DI_ScCyl_1_C DFES_FaultTyp.DFC_InjVlv_DI_ScCyl_2_C DFES_FaultTyp.DFC_InjVlv_DI_ScCyl_3_C DFES_FaultTyp.DFC_InjVlv_DI_ScHsLs_0_C DFES_FaultTyp.DFC_InjVlv_DI_ScHsLs_1_C DFES_FaultTyp.DFC_InjVlv_DI_ScHsLs_2_C DFES_FaultTyp.DFC_InjVlv_DI_ScHsLs_3_C DFES_FaultTyp.DFC_MfPsDiaOpenLoad1_C DFES_FaultTyp.DFC_MfPsDiaScHiS1_C DFES_FaultTyp.DFC_MfPsDiaScHiSLowS1_C DFES_FaultTyp.DFC_MfPsDiaScLowS1_C DFES_FaultTyp.DFC_ACEvpTPhysRngHi_C DFES_FaultTyp.DFC_ACEvpTPhysRngLo_C DFES_FaultTyp.DFC_ACEvpTSRCMax_C DFES_FaultTyp.DFC_ACEvpTSRCMin_C DFES_FaultTyp.DFC_AfsRawSigRngHiB1_C DFES_FaultTyp.DFC_AfsRawSigRngLoB1_C DFES_FaultTyp.DFC_AfsSnsrErrB1_C DFES_FaultTyp.DFC_AirCClntPAnaSRCMax_C DFES_FaultTyp.DFC_AirCClntPAnaSRCMin_C DFES_FaultTyp.DFC_AirCSwtNpl_C DFES_FaultTyp.DFC_AirCSwtSig_C DFES_FaultTyp.DFC_Brk_C DFES_FaultTyp.DFC_BrkBstSensSCB_C DFES_FaultTyp.DFC_BrkBstSensSCG_C DFES_FaultTyp.DFC_BrkSig_C DFES_FaultTyp.DFC_ClthSig_C DFES_FaultTyp.DFC_EGRVlvCurrLim_C DFES_FaultTyp.DFC_EGRVlvOL_C DFES_FaultTyp.DFC_EGRVlvOvrTemp_C DFES_FaultTyp.DFC_EGRVlvSCB_C DFES_FaultTyp.DFC_EGRVlvSCG_C DFES_FaultTyp.DFC_EGRVlvSRCMax_C DFES_FaultTyp.DFC_EGRVlvSRCMin_C DFES_FaultTyp.DFC_HLSDemOvhtEngLim_C DFES_FaultTyp.DFC_OilPSwmpSRCMax_C DFES_FaultTyp.DFC_OilPSwmpSRCMin_C DFES_FaultTyp.DFC_PIntkVUsLineHiB1_C DFES_FaultTyp.DFC_PIntkVUsLineLoB1_C DFES_FaultTyp.DFC_VehVPhysRngLo_C DFES_FaultTyp.DFC_VehVSigCan_C DFES_FaultTyp.DFC_VehVSigCanSafe_C DFES_FaultTyp.DFC_VlvLftFbOilPSnsrIntk11SRCMax_C DFES_FaultTyp.DFC_VlvLftFbOilPSnsrIntk11SRCMin_C DFES_FaultTyp.DFC_ClthNpl_C DFES_FaultTyp.DFC_GbxPNPosnDrvCdn_C DFES_FaultTyp.DFC_GbxPNPosnPlausy_C DFES_FaultTyp.DFC_AfsSigErrLineHiB1_C DFES_FaultTyp.DFC_AfsSigErrLineLoB1_C DFES_FaultTyp.DFC_PEnvCcMax_C DFES_FaultTyp.DFC_PEnvCcMin_C DFES_FaultTyp.DFC_PEnvRngChkMax_C DFES_FaultTyp.DFC_PEnvRngChkMin_C DFES_FaultTyp.DFC_PEnvSnsrPlaus_C DFES_FaultTyp.DFC_UEGOHeatrRlyPsOLS1B1_C DFES_FaultTyp.DFC_UEGOHeatrRlyPsSCBS1B1_C DFES_FaultTyp.DFC_UEGOHeatrRlyPsSCGS1B1_C DFES_FaultTyp.DFC_UegoHeatrWireOlS1B1_C DFES_FaultTyp.DFC_UegoHeatrWireScbS1B1_C DFES_FaultTyp.DFC_UegoHeatrWireScgS1B1_C DFES_FaultTyp.DFC_KnDetSens1PortAMax_C DFES_FaultTyp.DFC_KnDetSens1PortAMin_C DFES_FaultTyp.DFC_KnDetSens1PortBMax_C DFES_FaultTyp.DFC_KnDetSens1PortBMin_C DFES_FaultTyp.DFC_Clth2ONStuck_C DFES_FaultTyp.DFC_Clth2ONStuckLdc_C DFES_FaultTyp.DFC_Clth3ONStuckLdc_C DFES_FaultTyp.DFC_Clth3ONStuckPostDrv_C DFES_FaultTyp.DFC_Clth4ONStuck_C DFES_FaultTyp.DFC_Clth4ONStuckLdc_C DFES_FaultTyp.DFC_ComBCMUnit_C DFES_FaultTyp.DFC_ComDLCTCU01_C DFES_FaultTyp.DFC_ComDLCTCU02_C DFES_FaultTyp.DFC_ComDLCTCU1_C DFES_FaultTyp.DFC_ComDLCTCU11_C DFES_FaultTyp.DFC_ComDLCTCU12_C DFES_FaultTyp.DFC_ComDLCTCU13_C DFES_FaultTyp.DFC_ComDLCTCU14_C DFES_FaultTyp.DFC_ComDLCTCU2_C DFES_FaultTyp.DFC_ComDLCTCU3_C DFES_FaultTyp.DFC_ComDLCTCU4_C DFES_FaultTyp.DFC_ComEPSUnit_C DFES_FaultTyp.DFC_ComIDASBUnit_C DFES_FaultTyp.DFC_ComIMGUnit_C DFES_FaultTyp.DFC_ComMETUnit_C DFES_FaultTyp.DFC_ComSRSUnit_C DFES_FaultTyp.DFC_ComVSAUnit_C DFES_FaultTyp.DFC_EbsSocFlt_C DFES_FaultTyp.DFC_I14229VINErr_C DFES_FaultTyp.DFC_InjCatHeatgErr_C DFES_FaultTyp.DFC_InjSysMulInjDiagErr_C DFES_FaultTyp.DFC_LLRHmax_C DFES_FaultTyp.DFC_LLRHmin_C DFES_FaultTyp.DFC_LLRHnpl_C DFES_FaultTyp.DFC_LLRKHmax_C DFES_FaultTyp.DFC_LLRKHmin_C DFES_FaultTyp.DFC_LLRKHnpl_C DFES_FaultTyp.DFC_LinACGUnit_C DFES_FaultTyp.DFC_LinAEVUnit_C DFES_FaultTyp.DFC_LinEBSUnit_C DFES_FaultTyp.DFC_RoughRoad_C DFES_FaultTyp.DFC_SiaEEPRdErr_C DFES_FaultTyp.DFC_SiaEEPWrngCod_C DFES_FaultTyp.DFC_UegoHeatrStrtS1B1_C DFES_FaultTyp.DFC_BusDiagCANAPPLBusOff_C DFES_FaultTyp.DFC_BusDiagCANCANCBusOff_C DFES_FaultTyp.DFC_BusDiagCANVEHICLEBusOff_C DFES_FaultTyp.DFC_RBA_IODIAGPWR_rba_IoExtCy329_SignalVltSply_0_C DFES_FaultTyp.DFC_RBA_IODIAGPWR_rba_IoExtCy329_SignalVltSply_0OT_C DFES_FaultTyp.DFC_RBA_IODIAGPWR_rba_IoExtCy329_SignalVltSply_0OV_C DFES_FaultTyp.DFC_RBA_IODIAGPWR_rba_IoExtCy329_SignalVltSply_0SCG_C DFES_FaultTyp.DFC_RBA_IODIAGPWR_rba_IoExtCy329_SignalVltSply_0UV_C DFES_FaultTyp.DFC_RBA_IODIAGPWR_rba_IoExtCy329_SignalVltSply_1_C DFES_FaultTyp.DFC_RBA_IODIAGPWR_rba_IoExtCy329_SignalVltSply_1OT_C DFES_FaultTyp.DFC_RBA_IODIAGPWR_rba_IoExtCy329_SignalVltSply_1OV_C DFES_FaultTyp.DFC_RBA_IODIAGPWR_rba_IoExtCy329_SignalVltSply_1SCG_C DFES_FaultTyp.DFC_RBA_IODIAGPWR_rba_IoExtCy329_SignalVltSply_1UV_C DFES_FaultTyp.DFC_RBA_IODIAGPWR_rba_IoExtCy329_SignalVltSply_2_C DFES_FaultTyp.DFC_RBA_IODIAGPWR_rba_IoExtCy329_SignalVltSply_2OT_C DFES_FaultTyp.DFC_RBA_IODIAGPWR_rba_IoExtCy329_SignalVltSply_2OV_C DFES_FaultTyp.DFC_RBA_IODIAGPWR_rba_IoExtCy329_SignalVltSply_2SCG_C DFES_FaultTyp.DFC_RBA_IODIAGPWR_rba_IoExtCy329_SignalVltSply_2UV_C DFES_FaultTyp.DFC_CAN_E_TIMEOUT_C DFES_FaultTyp.DFC_LIN_E_TIMEOUT_C DFES_FaultTyp.DFC_MRlyOL_C DFES_FaultTyp.DFC_MRlySCB_C DFES_FaultTyp.DFC_MRlySCG_C DFES_FaultTyp.DFC_rba_MultiStackTrace_Threshold_C DFES_FaultTyp.DFC_BSWM_E_ACTION_FAILED_C DFES_FaultTyp.DFC_BSWM_E_INTRPTQUEUE_FULL_C DFES_FaultTyp.DFC_RBA_IOEXTLIB_KEEPALIVE_DRV_C DFES_FaultTyp.DFC_RBA_IOEXTLIB_KEEPALIVE_INI_C DFES_FaultTyp.DFC_rba_IoSigRtc_StopCounter_C DFES_FaultTyp.DFC_rba_MRly_Diag_Stk_Event_C DFES_FaultTyp.DFC_rba_MemDiag_MemReadErr_C DFES_FaultTyp.DFC_rba_MemDiag_MemWrErr_C DFES_FaultTyp.DFC_rba_SyC_IrrSwOffTrigEngRun_Event_C DFES_FaultTyp.DFC_rba_T15_Diag_ComInVld_Event_C DFES_FaultTyp.DFC_rba_T15_Diag_ComOff_HwOn_Event_C DFES_FaultTyp.DFC_rba_T15_Diag_ComOn_HwOff_Event_C DFES_FaultTyp.DFC_AAVmin_C DFES_FaultTyp.DFC_AGRSUS_C DFES_FaultTyp.DFC_AfsPlausDiagHi_C DFES_FaultTyp.DFC_AfsPlausDiagLo_C DFES_FaultTyp.DFC_AfsVrntDiagErrB1_C DFES_FaultTyp.DFC_AppAllSnsrDfct_C DFES_FaultTyp.DFC_BBKRnldg_C DFES_FaultTyp.DFC_BBKRsyne_C DFES_FaultTyp.DFC_BattUStdbyDiaOL_C DFES_FaultTyp.DFC_BigLeakIntkMnfldEmiInfl_C DFES_FaultTyp.DFC_BlkdLineTank_C DFES_FaultTyp.DFC_BrkMnSwtContOnWarnLmp_C DFES_FaultTyp.DFC_BrkMnSwtNotStpWarnLmp_C DFES_FaultTyp.DFC_BrkRdntSwtContOnWarnLmp_C DFES_FaultTyp.DFC_BrkRdntSwtNotStpWarnLmp_C DFES_FaultTyp.DFC_CEngDsTColdStrtMax_C DFES_FaultTyp.DFC_CEngDsTColdStrtMin_C DFES_FaultTyp.DFC_CEngDsTImps_C DFES_FaultTyp.DFC_CEngDsTPlausHSC_C DFES_FaultTyp.DFC_CEngDsTPlausLSC_C DFES_FaultTyp.DFC_CEngDsTPlausSTC_C DFES_FaultTyp.DFC_CEngDsTSRCMax_C DFES_FaultTyp.DFC_CEngDsTSRCMin_C DFES_FaultTyp.DFC_CEngDsTSig_C DFES_FaultTyp.DFC_CEngUsTColdStrtMax_C DFES_FaultTyp.DFC_CEngUsTColdStrtMin_C DFES_FaultTyp.DFC_CEngUsTLooseCnctn_C DFES_FaultTyp.DFC_CEngUsTSRCMax_C DFES_FaultTyp.DFC_CEngUsTSRCMin_C DFES_FaultTyp.DFC_ComDCDCACCFailr_C DFES_FaultTyp.DFC_DCDCFltDet_C DFES_FaultTyp.DFC_DKRSA_C DFES_FaultTyp.DFC_DKVSmax_C DFES_FaultTyp.DFC_DKnpl_C DFES_FaultTyp.DFC_DSKVRmax_C DFES_FaultTyp.DFC_DSKVRmin_C DFES_FaultTyp.DFC_DSKVRnpl_C DFES_FaultTyp.DFC_DSKVRsig_C DFES_FaultTyp.DFC_DSKVSsig_C DFES_FaultTyp.DFC_DSSmax_C DFES_FaultTyp.DFC_DSTDmax_C DFES_FaultTyp.DFC_DSTEmax_C DFES_FaultTyp.DFC_DSTEmin_C DFES_FaultTyp.DFC_DSTOFmax_C DFES_FaultTyp.DFC_DSTRmax_C DFES_FaultTyp.DFC_DSTRmin_C DFES_FaultTyp.DFC_DSTRnpl_C DFES_FaultTyp.DFC_DSTRsig_C DFES_FaultTyp.DFC_DSTTI_C DFES_FaultTyp.DFC_DSUmax_C DFES_FaultTyp.DFC_DiagCpv1DteskLoLoadStuckClsd_C DFES_FaultTyp.DFC_DiagCpv1DteskLoLoadStuckOpen_C DFES_FaultTyp.DFC_EGRVlvDrftClsd_C DFES_FaultTyp.DFC_EGRVlvDrftOpn_C DFES_FaultTyp.DFC_EGRVlvJamVlvClsd_C DFES_FaultTyp.DFC_EGRVlvJamVlvOpn_C DFES_FaultTyp.DFC_EGRVlvSprgBrk_C DFES_FaultTyp.DFC_EGRVlvTempMdlEEPErr_C DFES_FaultTyp.DFC_EGRVlvTmpErr_C DFES_FaultTyp.DFC_EGSDUS2B1LtrDly_C DFES_FaultTyp.DFC_EGSDUS2B1LtrPT1_C DFES_FaultTyp.DFC_EGSDUS2B1RtlDly_C DFES_FaultTyp.DFC_EGSDUS2B1RtlPT1_C DFES_FaultTyp.DFC_EGSDUS2B1TarLean_C DFES_FaultTyp.DFC_EGSDUS2B1TarRich_C DFES_FaultTyp.DFC_EONVmax_C DFES_FaultTyp.DFC_ETAKHLmax_C DFES_FaultTyp.DFC_ETAKHTmax_C DFES_FaultTyp.DFC_ETHSEmax_C DFES_FaultTyp.DFC_ETHSEmin_C DFES_FaultTyp.DFC_ETHSFmax_C DFES_FaultTyp.DFC_ETHSFmin_C DFES_FaultTyp.DFC_ETHSFsig_C DFES_FaultTyp.DFC_ETHSNPWmax_C DFES_FaultTyp.DFC_ETHSNPWmin_C DFES_FaultTyp.DFC_ETHSNPWsig_C DFES_FaultTyp.DFC_ETHSPLnpl_C DFES_FaultTyp.DFC_ETHSTPLnpl_C DFES_FaultTyp.DFC_EngICO_C DFES_FaultTyp.DFC_EngPrtOvrSpdMon_C DFES_FaultTyp.DFC_EpmCaSI1ErrSig_C DFES_FaultTyp.DFC_EpmCaSI1MntErr_C DFES_FaultTyp.DFC_EpmCaSI1NoSigMax_C DFES_FaultTyp.DFC_EpmCaSI1NoSigMin_C DFES_FaultTyp.DFC_EpmCaSI1OfsErr_C DFES_FaultTyp.DFC_EpmCrSDGI_C DFES_FaultTyp.DFC_EpmCrSErrSig_C DFES_FaultTyp.DFC_EpmCrSNoSig_C DFES_FaultTyp.DFC_EtaEngIdleNonCsers_C DFES_FaultTyp.DFC_EtaEngPtlNonCsers_C DFES_FaultTyp.DFC_FRAmax_C DFES_FaultTyp.DFC_FRAmin_C DFES_FaultTyp.DFC_FSTEmax_C DFES_FaultTyp.DFC_FSTEmin_C DFES_FaultTyp.DFC_FSTRmax_C DFES_FaultTyp.DFC_FSTRmin_C DFES_FaultTyp.DFC_FSTRnpl_C DFES_FaultTyp.DFC_FSTmax_C DFES_FaultTyp.DFC_FTDLAmax_C DFES_FaultTyp.DFC_FTDLAmin_C DFES_FaultTyp.DFC_FuPHiSnsrEleclmax_C DFES_FaultTyp.DFC_FuPHiSnsrEleclmin_C DFES_FaultTyp.DFC_FuPHiSnsrEleclnpl_C DFES_FaultTyp.DFC_FuPHiSnsrURngMax_C DFES_FaultTyp.DFC_FuPHiSnsrURngMin_C DFES_FaultTyp.DFC_FuSnsrPhyRngMaxErr_C DFES_FaultTyp.DFC_FuSnsrPhyRngMinErr_C DFES_FaultTyp.DFC_GEVlvLockPinDiagIntkB1_C DFES_FaultTyp.DFC_GEVlvPhaSlowIntkB1_C DFES_FaultTyp.DFC_GEVlvPhaTargIntkB1_C DFES_FaultTyp.DFC_GbxRvsSwtStk_C DFES_FaultTyp.DFC_HDRKHmax_C DFES_FaultTyp.DFC_HDRKHmin_C DFES_FaultTyp.DFC_HDRPLmax_C DFES_FaultTyp.DFC_HDRPLmin_C DFES_FaultTyp.DFC_HDRmax_C DFES_FaultTyp.DFC_HDRmin_C DFES_FaultTyp.DFC_HEGOS2B1ElecMax_C DFES_FaultTyp.DFC_HEGOS2B1ElecMin_C DFES_FaultTyp.DFC_HEGOS2B1ElecSig_C DFES_FaultTyp.DFC_HEGOS2B1HtgNpl_C DFES_FaultTyp.DFC_HEV00max_C DFES_FaultTyp.DFC_HEV01max_C DFES_FaultTyp.DFC_HEV02max_C DFES_FaultTyp.DFC_HEV03max_C DFES_FaultTyp.DFC_HEVE0max_C DFES_FaultTyp.DFC_HEVE1max_C DFES_FaultTyp.DFC_HFMmax_C DFES_FaultTyp.DFC_HiPSysHiPMaxLimExcdd_C DFES_FaultTyp.DFC_IVGdiCtlCvoErrMax_0_C DFES_FaultTyp.DFC_IVGdiCtlCvoErrMax_1_C DFES_FaultTyp.DFC_IVGdiCtlCvoErrMax_2_C DFES_FaultTyp.DFC_IVGdiCtlCvoErrMax_3_C DFES_FaultTyp.DFC_IVGdiCtlCvoErrMin_0_C DFES_FaultTyp.DFC_IVGdiCtlCvoErrMin_1_C DFES_FaultTyp.DFC_IVGdiCtlCvoErrMin_2_C DFES_FaultTyp.DFC_IVGdiCtlCvoErrMin_3_C DFES_FaultTyp.DFC_IVGdiCtlCvoErrMinMax_C DFES_FaultTyp.DFC_IVGdiCtlCvoSigPlausErrSmrCdn_C DFES_FaultTyp.DFC_IVGdiCtl_CvoErr_C DFES_FaultTyp.DFC_IVGdiCtl_CvoSigPlaus_0_C DFES_FaultTyp.DFC_IVGdiCtl_CvoSigPlaus_1_C DFES_FaultTyp.DFC_IVGdiCtl_CvoSigPlaus_2_C DFES_FaultTyp.DFC_IVGdiCtl_CvoSigPlaus_3_C DFES_FaultTyp.DFC_IntkAirTAirFltDsCrssMax_C DFES_FaultTyp.DFC_IntkAirTAirFltDsCrssMin_C DFES_FaultTyp.DFC_IntkAirTAirFltDsHSCMax_C DFES_FaultTyp.DFC_IntkAirTAirFltDsImps_C DFES_FaultTyp.DFC_IntkAirTAirFltDsPRCMax_C DFES_FaultTyp.DFC_IntkAirTAirFltDsPRCMin_C DFES_FaultTyp.DFC_IntkAirTAirFltDsSRCMax_C DFES_FaultTyp.DFC_IntkAirTAirFltDsSRCMin_C DFES_FaultTyp.DFC_IntkAirTAirFltDsSTC_C DFES_FaultTyp.DFC_IntkAirTIntkMnfldCrssMax_C DFES_FaultTyp.DFC_IntkAirTIntkMnfldCrssMin_C DFES_FaultTyp.DFC_IntkAirTIntkMnfldHSCMax_C DFES_FaultTyp.DFC_IntkAirTIntkMnfldImps_C DFES_FaultTyp.DFC_IntkAirTIntkMnfldPRCMax_C DFES_FaultTyp.DFC_IntkAirTIntkMnfldPRCMin_C DFES_FaultTyp.DFC_IntkAirTIntkMnfldSRCMax_C DFES_FaultTyp.DFC_IntkAirTIntkMnfldSRCMin_C DFES_FaultTyp.DFC_IntkAirTIntkMnfldSTC_C DFES_FaultTyp.DFC_KRREGRLMX_C DFES_FaultTyp.DFC_KRVEKOCVLCI_C DFES_FaultTyp.DFC_KRVEKOENCHMT_C DFES_FaultTyp.DFC_KRVEKOENCHMT0_C DFES_FaultTyp.DFC_KRVEKOENCHMT1_C DFES_FaultTyp.DFC_KRVEKOENCHMT2_C DFES_FaultTyp.DFC_KRVEKOENCHMT3_C DFES_FaultTyp.DFC_KRVEKOENCHMT4_C DFES_FaultTyp.DFC_KRVEKOENCHMT5_C DFES_FaultTyp.DFC_KRVEKOENCHMT6_C DFES_FaultTyp.DFC_KRVEKOENCHMT7_C DFES_FaultTyp.DFC_KRVEKORLMX_C DFES_FaultTyp.DFC_KRVEKORLMXL_C DFES_FaultTyp.DFC_KS1max_C DFES_FaultTyp.DFC_KS1min_C DFES_FaultTyp.DFC_LMmax_C DFES_FaultTyp.DFC_LZSRnpl_C DFES_FaultTyp.DFC_LamDynDiagS1B1_C DFES_FaultTyp.DFC_LeakIntkMnfldEmiInfl_C DFES_FaultTyp.DFC_LinFrameErrDCDC_C DFES_FaultTyp.DFC_LinOverrunErrDCDC_C DFES_FaultTyp.DFC_MD00max_C DFES_FaultTyp.DFC_MDBmax_C DFES_FaultTyp.DFC_MDCat_C DFES_FaultTyp.DFC_MDCatCrit_C DFES_FaultTyp.DFC_MDCatCurr_C DFES_FaultTyp.DFC_MDCyl_0_C DFES_FaultTyp.DFC_MDCyl_1_C DFES_FaultTyp.DFC_MDCyl_2_C DFES_FaultTyp.DFC_MDCyl_3_C DFES_FaultTyp.DFC_MDEmi_C DFES_FaultTyp.DFC_MDEmiStrt_C DFES_FaultTyp.DFC_MDFco_C DFES_FaultTyp.DFC_MDMpl_C DFES_FaultTyp.DFC_MDSegTiAdpn_C DFES_FaultTyp.DFC_MDmax_C DFES_FaultTyp.DFC_MFuOilMax_C DFES_FaultTyp.DFC_MOXEMM_SMU_ALM0_0_C DFES_FaultTyp.DFC_MOXEMM_SMU_ALM0_1_C DFES_FaultTyp.DFC_MOXEMM_SMU_ALM0_10_C DFES_FaultTyp.DFC_MOXEMM_SMU_ALM0_11_C DFES_FaultTyp.DFC_MOXEMM_SMU_ALM0_13_C DFES_FaultTyp.DFC_MOXEMM_SMU_ALM0_14_C DFES_FaultTyp.DFC_MOXEMM_SMU_ALM0_2_C DFES_FaultTyp.DFC_MOXEMM_SMU_ALM0_22_C DFES_FaultTyp.DFC_MOXEMM_SMU_ALM0_23_C DFES_FaultTyp.DFC_MOXEMM_SMU_ALM0_4_C DFES_FaultTyp.DFC_MOXEMM_SMU_ALM0_5_C DFES_FaultTyp.DFC_MOXEMM_SMU_ALM0_7_C DFES_FaultTyp.DFC_MOXEMM_SMU_ALM0_8_C DFES_FaultTyp.DFC_MOXEMM_SMU_ALM10_16_C DFES_FaultTyp.DFC_MOXEMM_SMU_ALM10_17_C DFES_FaultTyp.DFC_MOXEMM_SMU_ALM10_21_C DFES_FaultTyp.DFC_MOXEMM_SMU_ALM11_0_C DFES_FaultTyp.DFC_MOXEMM_SMU_ALM11_1_C DFES_FaultTyp.DFC_MOXEMM_SMU_ALM11_2_C DFES_FaultTyp.DFC_MOXEMM_SMU_ALM11_3_C DFES_FaultTyp.DFC_MOXEMM_SMU_ALM11_4_C DFES_FaultTyp.DFC_MOXEMM_SMU_ALM11_5_C DFES_FaultTyp.DFC_MOXEMM_SMU_ALM11_8_C DFES_FaultTyp.DFC_MOXEMM_SMU_ALM11_9_C DFES_FaultTyp.DFC_MOXEMM_SMU_ALM1_0_C DFES_FaultTyp.DFC_MOXEMM_SMU_ALM1_1_C DFES_FaultTyp.DFC_MOXEMM_SMU_ALM1_10_C DFES_FaultTyp.DFC_MOXEMM_SMU_ALM1_11_C DFES_FaultTyp.DFC_MOXEMM_SMU_ALM1_13_C DFES_FaultTyp.DFC_MOXEMM_SMU_ALM1_14_C DFES_FaultTyp.DFC_MOXEMM_SMU_ALM1_2_C DFES_FaultTyp.DFC_MOXEMM_SMU_ALM1_22_C DFES_FaultTyp.DFC_MOXEMM_SMU_ALM1_23_C DFES_FaultTyp.DFC_MOXEMM_SMU_ALM1_4_C DFES_FaultTyp.DFC_MOXEMM_SMU_ALM1_5_C DFES_FaultTyp.DFC_MOXEMM_SMU_ALM1_7_C DFES_FaultTyp.DFC_MOXEMM_SMU_ALM1_8_C DFES_FaultTyp.DFC_MOXEMM_SMU_ALM21_0_C DFES_FaultTyp.DFC_MOXEMM_SMU_ALM21_16_C DFES_FaultTyp.DFC_MOXEMM_SMU_ALM21_3_C DFES_FaultTyp.DFC_MOXEMM_SMU_ALM2_1_C DFES_FaultTyp.DFC_MOXEMM_SMU_ALM2_10_C DFES_FaultTyp.DFC_MOXEMM_SMU_ALM2_11_C DFES_FaultTyp.DFC_MOXEMM_SMU_ALM2_13_C DFES_FaultTyp.DFC_MOXEMM_SMU_ALM2_14_C DFES_FaultTyp.DFC_MOXEMM_SMU_ALM2_22_C DFES_FaultTyp.DFC_MOXEMM_SMU_ALM2_23_C DFES_FaultTyp.DFC_MOXEMM_SMU_ALM2_4_C DFES_FaultTyp.DFC_MOXEMM_SMU_ALM2_5_C DFES_FaultTyp.DFC_MOXEMM_SMU_ALM2_7_C DFES_FaultTyp.DFC_MOXEMM_SMU_ALM2_8_C DFES_FaultTyp.DFC_MOXEMM_SMU_ALM6_0_C DFES_FaultTyp.DFC_MOXEMM_SMU_ALM6_11_C DFES_FaultTyp.DFC_MOXEMM_SMU_ALM6_12_C DFES_FaultTyp.DFC_MOXEMM_SMU_ALM6_14_C DFES_FaultTyp.DFC_MOXEMM_SMU_ALM6_15_C DFES_FaultTyp.DFC_MOXEMM_SMU_ALM6_17_C DFES_FaultTyp.DFC_MOXEMM_SMU_ALM6_18_C DFES_FaultTyp.DFC_MOXEMM_SMU_ALM6_20_C DFES_FaultTyp.DFC_MOXEMM_SMU_ALM6_21_C DFES_FaultTyp.DFC_MOXEMM_SMU_ALM6_25_C DFES_FaultTyp.DFC_MOXEMM_SMU_ALM6_4_C DFES_FaultTyp.DFC_MOXEMM_SMU_ALM6_5_C DFES_FaultTyp.DFC_MOXEMM_SMU_ALM6_7_C DFES_FaultTyp.DFC_MOXEMM_SMU_ALM6_8_C DFES_FaultTyp.DFC_MOXEMM_SMU_ALM7_1_C DFES_FaultTyp.DFC_MOXEMM_SMU_ALM7_12_C DFES_FaultTyp.DFC_MOXEMM_SMU_ALM7_13_C DFES_FaultTyp.DFC_MOXEMM_SMU_ALM7_14_C DFES_FaultTyp.DFC_MOXEMM_SMU_ALM7_15_C DFES_FaultTyp.DFC_MOXEMM_SMU_ALM7_16_C DFES_FaultTyp.DFC_MOXEMM_SMU_ALM7_17_C DFES_FaultTyp.DFC_MOXEMM_SMU_ALM7_2_C DFES_FaultTyp.DFC_MOXEMM_SMU_ALM7_20_C DFES_FaultTyp.DFC_MOXEMM_SMU_ALM7_25_C DFES_FaultTyp.DFC_MOXEMM_SMU_ALM7_26_C DFES_FaultTyp.DFC_MOXEMM_SMU_ALM7_28_C DFES_FaultTyp.DFC_MOXEMM_SMU_ALM7_29_C DFES_FaultTyp.DFC_MOXEMM_SMU_ALM7_30_C DFES_FaultTyp.DFC_MOXEMM_SMU_ALM7_31_C DFES_FaultTyp.DFC_MOXEMM_SMU_ALM8_0_C DFES_FaultTyp.DFC_MOXEMM_SMU_ALM8_1_C DFES_FaultTyp.DFC_MOXEMM_SMU_ALM8_10_C DFES_FaultTyp.DFC_MOXEMM_SMU_ALM8_11_C DFES_FaultTyp.DFC_MOXEMM_SMU_ALM8_12_C DFES_FaultTyp.DFC_MOXEMM_SMU_ALM8_16_C DFES_FaultTyp.DFC_MOXEMM_SMU_ALM8_18_C DFES_FaultTyp.DFC_MOXEMM_SMU_ALM8_2_C DFES_FaultTyp.DFC_MOXEMM_SMU_ALM8_3_C DFES_FaultTyp.DFC_MOXEMM_SMU_ALM8_31_C DFES_FaultTyp.DFC_MOXEMM_SMU_ALM8_4_C DFES_FaultTyp.DFC_MOXEMM_SMU_ALM9_0_C DFES_FaultTyp.DFC_MOXEMM_SMU_ALM9_15_C DFES_FaultTyp.DFC_MOXEMM_SMU_ALM9_3_C DFES_FaultTyp.DFC_MoCADCNTP_C DFES_FaultTyp.DFC_MoCADCTst_C DFES_FaultTyp.DFC_MoCSOPICO_C DFES_FaultTyp.DFC_MoFAPP_C DFES_FaultTyp.DFC_MoFAirFilgPrdc_C DFES_FaultTyp.DFC_MoFAirFlCtOffGdi_C DFES_FaultTyp.DFC_MoFAirFlCylGdi_C DFES_FaultTyp.DFC_MoFAirFlFF_C DFES_FaultTyp.DFC_MoFAirFlIn_C DFES_FaultTyp.DFC_MoFAirFlMixCtlGdiChkAirFl_C DFES_FaultTyp.DFC_MoFAirFlMixCtlGdiChkCtrl_C DFES_FaultTyp.DFC_MoFAirFlMode_C DFES_FaultTyp.DFC_MoFESpd_C DFES_FaultTyp.DFC_MoFIACo_C DFES_FaultTyp.DFC_MoFICOL1_C DFES_FaultTyp.DFC_MoFICOL2_C DFES_FaultTyp.DFC_MoFStrt_C DFES_FaultTyp.DFC_MoFTrqCmp_C DFES_FaultTyp.DFC_MoFTrqCmpMax_C DFES_FaultTyp.DFC_MoFTrqCmpMin_C DFES_FaultTyp.DFC_MoFVarPostBldSel_C DFES_FaultTyp.DFC_MoXEMMHwLTMCUFW_C DFES_FaultTyp.DFC_MoXEMMHwLTMonBIST_C DFES_FaultTyp.DFC_MoXEMMHwLTRegMonTest_C DFES_FaultTyp.DFC_MoXEMMHwLTStbySMUAlvTest_C DFES_FaultTyp.DFC_MoXEMMHwLTTempSens_C DFES_FaultTyp.DFC_MoXEMMHwLTUCBCfg_C DFES_FaultTyp.DFC_NWSEmax_C DFES_FaultTyp.DFC_NWSmax_C DFES_FaultTyp.DFC_OCWDAABEActv_C DFES_FaultTyp.DFC_OCWDACom_C DFES_FaultTyp.DFC_OCWDAErrPin_C DFES_FaultTyp.DFC_OCWDAOvrVltg_C DFES_FaultTyp.DFC_ORAmax_C DFES_FaultTyp.DFC_ORAmin_C DFES_FaultTyp.DFC_OilPPlaus_C DFES_FaultTyp.DFC_PLLSUmax_C DFES_FaultTyp.DFC_PLLSUmin_C DFES_FaultTyp.DFC_PSR1max_C DFES_FaultTyp.DFC_PSRBmax_C DFES_FaultTyp.DFC_PSRBmin_C DFES_FaultTyp.DFC_PSRPmax_C DFES_FaultTyp.DFC_PSRPmin_C DFES_FaultTyp.DFC_PSRPsig_C DFES_FaultTyp.DFC_PSRmax_C DFES_FaultTyp.DFC_PUmax_C DFES_FaultTyp.DFC_P_VSE11_OL_C DFES_FaultTyp.DFC_P_VSE11_SCB_C DFES_FaultTyp.DFC_P_VSE11_SCG_C DFES_FaultTyp.DFC_PhyHighAPP1_C DFES_FaultTyp.DFC_PhyHighAPP2_C DFES_FaultTyp.DFC_PhyLowAPP1_C DFES_FaultTyp.DFC_PhyLowAPP2_C DFES_FaultTyp.DFC_SRCHighAPP1_C DFES_FaultTyp.DFC_SRCHighAPP2_C DFES_FaultTyp.DFC_SRCLowAPP1_C DFES_FaultTyp.DFC_SRCLowAPP2_C DFES_FaultTyp.DFC_SSpMon2_C DFES_FaultTyp.DFC_STHDRmax_C DFES_FaultTyp.DFC_SWReset_0_C DFES_FaultTyp.DFC_SWReset_1_C DFES_FaultTyp.DFC_SWReset_2_C DFES_FaultTyp.DFC_SyncAPP_C DFES_FaultTyp.DFC_TANKLnpl_C DFES_FaultTyp.DFC_TAmax_Dummy_C DFES_FaultTyp.DFC_TESFmax_C DFES_FaultTyp.DFC_TESGmax_C DFES_FaultTyp.DFC_TKAEmax_C DFES_FaultTyp.DFC_TKAEmin_C DFES_FaultTyp.DFC_TKARmax_C DFES_FaultTyp.DFC_TKARnpl_C DFES_FaultTyp.DFC_TMmax_Dummy_C DFES_FaultTyp.DFC_TUMmax_Dummy_C DFES_FaultTyp.DFC_TWCDPriCatB1_C DFES_FaultTyp.DFC_ThrVlvClsdPosnFirstOffsLrnImpoB1_C DFES_FaultTyp.DFC_ThrVlvClsdPosnOffsLrnImpoB1_C DFES_FaultTyp.DFC_ThrVlvClsdPosnOffsLrnMaxB1_C DFES_FaultTyp.DFC_ThrVlvClsdPosnOffsLrnMinB1_C DFES_FaultTyp.DFC_ThrVlvCtrlDeB1_C DFES_FaultTyp.DFC_ThrVlvDycB1_C DFES_FaultTyp.DFC_ThrVlvLimpAirPosnMaxAbsltDriftB1_C DFES_FaultTyp.DFC_ThrVlvLimpAirPosnMaxB1_C DFES_FaultTyp.DFC_ThrVlvLimpAirPosnMaxRelDriftB1_C DFES_FaultTyp.DFC_ThrVlvLimpAirPosnMinB1_C DFES_FaultTyp.DFC_ThrVlvOpenLoadB1_C DFES_FaultTyp.DFC_ThrVlvOpenSprgB1_C DFES_FaultTyp.DFC_ThrVlvOpenSprgSprdB1_C DFES_FaultTyp.DFC_ThrVlvOpenSprgTwnB1_C DFES_FaultTyp.DFC_ThrVlvOverTB1_C DFES_FaultTyp.DFC_ThrVlvRetSprgB1_C DFES_FaultTyp.DFC_ThrVlvRetSprgSprdB1_C DFES_FaultTyp.DFC_ThrVlvRetSprgTwnB1_C DFES_FaultTyp.DFC_ThrVlvSens1MaxB1_C DFES_FaultTyp.DFC_ThrVlvSens1NplB1_C DFES_FaultTyp.DFC_ThrVlvSens2MaxB1_C DFES_FaultTyp.DFC_ThrVlvSens2MinB1_C DFES_FaultTyp.DFC_ThrVlvSens2NplB1_C DFES_FaultTyp.DFC_ThrVlvShoCircB1_C DFES_FaultTyp.DFC_ThrVlvSpiErrB1_C DFES_FaultTyp.DFC_ThrvlvSens1MinB1_C DFES_FaultTyp.DFC_TiOffTBasdChkFast_C DFES_FaultTyp.DFC_TiOffTBasdChkSlow_C DFES_FaultTyp.DFC_UEGOSnsrMntdS1B1_C DFES_FaultTyp.DFC_VehVSig_C DFES_FaultTyp.DFC_VlvLftFbSwtIntk11SpclFail_C DFES_FaultTyp.DFC_VlvLftFbSwtIntk11StdFail_C DFES_GrpRpr.DFC_Unused_C DFES_GrpRpr.DFC_AAVEmax_C DFES_GrpRpr.DFC_AAVEmin_C DFES_GrpRpr.DFC_AAVEsig_C DFES_GrpRpr.DFC_AltIOACGFailr_C DFES_GrpRpr.DFC_AltIOACGHiVltg_C DFES_GrpRpr.DFC_AltIOACGLoVltg_C DFES_GrpRpr.DFC_AltIOACGTHi_C DFES_GrpRpr.DFC_AltIODConnACG_C DFES_GrpRpr.DFC_BGOELWAF_C DFES_GrpRpr.DFC_BattUHiFailr_C DFES_GrpRpr.DFC_BattULoFailr_C DFES_GrpRpr.DFC_BrkBstPDriftHiErr_C DFES_GrpRpr.DFC_BrkBstPDriftLoErr_C DFES_GrpRpr.DFC_BrkBstPSnsrStuck_C DFES_GrpRpr.DFC_BrkMnSwtContOn_C DFES_GrpRpr.DFC_BrkMnSwtNotStp_C DFES_GrpRpr.DFC_BrkNpl_C DFES_GrpRpr.DFC_BrkRdntSwtContOn_C DFES_GrpRpr.DFC_BrkRdntSwtNotStp_C DFES_GrpRpr.DFC_Clth3ONStuck_C DFES_GrpRpr.DFC_Clth4OFFStuck_C DFES_GrpRpr.DFC_ClthOFFStuck_C DFES_GrpRpr.DFC_ClthONStuck_C DFES_GrpRpr.DFC_ClthStkFailInfo_C DFES_GrpRpr.DFC_ComACFailInfo_C DFES_GrpRpr.DFC_ComATFTValErr_C DFES_GrpRpr.DFC_ComATMILReq_C DFES_GrpRpr.DFC_ComAYCAChksum_C DFES_GrpRpr.DFC_ComAYCARingCnt_C DFES_GrpRpr.DFC_ComAYCATOut_C DFES_GrpRpr.DFC_ComAYCDChkSum_C DFES_GrpRpr.DFC_ComAYCDTOut_C DFES_GrpRpr.DFC_ComAYCFChksum_C DFES_GrpRpr.DFC_ComAYCFRingCnt_C DFES_GrpRpr.DFC_ComAYCFTOut_C DFES_GrpRpr.DFC_ComAYCGChksum_C /end DEF_CHARACTERISTIC
 FUNCTION_VERSION "30000.73.0_2.0.0" /end FUNCTION
/begin COMPU_METHOD DFC_Verb "" TAB_VERB "%6.3" "-" COMPU_TAB_REF DFC_Verb /end COMPU_METHOD
/begin COMPU_VTAB DFC_Verb "" TAB_VERB 907 0 "DFC_Unused" 1 "DFC_AAVEmax" 2 "DFC_AAVEmin" 3 "DFC_AAVEsig" 508 "DFC_AAVmin" 379 "DFC_ACEvpTPhysRngHi" 380 "DFC_ACEvpTPhysRngLo" 381 "DFC_ACEvpTSRCMax" 382 "DFC_ACEvpTSRCMin" 288 "DFC_AfsPhyRngHiB1" 289 "DFC_AfsPhyRngLoB1" 510 "DFC_AfsPlausDiagHi" 511 "DFC_AfsPlausDiagLo" 383 "DFC_AfsRawSigRngHiB1" 384 "DFC_AfsRawSigRngLoB1" 415 "DFC_AfsSigErrLineHiB1" 416 "DFC_AfsSigErrLineLoB1" 385 "DFC_AfsSnsrErrB1" 512 "DFC_AfsVrntDiagErrB1" 509 "DFC_AGRSUS" 386 "DFC_AirCClntPAnaSRCMax" 387 "DFC_AirCClntPAnaSRCMin" 290 "DFC_AirCCmprOL" 291 "DFC_AirCCmprOvrTemp" 292 "DFC_AirCCmprSCB" 293 "DFC_AirCCmprSCG" 388 "DFC_AirCSwtNpl" 389 "DFC_AirCSwtSig" 294 "DFC_AltErr" 4 "DFC_AltIOACGFailr" 5 "DFC_AltIOACGHiVltg" 6 "DFC_AltIOACGLoVltg" 7 "DFC_AltIOACGTHi" 8 "DFC_AltIODConnACG" 513 "DFC_AppAllSnsrDfct" 10 "DFC_BattUHiFailr" 11 "DFC_BattULoFailr" 295 "DFC_BattUSRCMax" 296 "DFC_BattUSRCMin" 516 "DFC_BattUStdbyDiaOL" 514 "DFC_BBKRnldg" 515 "DFC_BBKRsyne" 9 "DFC_BGOELWAF" 517 "DFC_BigLeakIntkMnfldEmiInfl" 518 "DFC_BlkdLineTank" 390 "DFC_Brk" 12 "DFC_BrkBstPDriftHiErr" 13 "DFC_BrkBstPDriftLoErr" 14 "DFC_BrkBstPSnsrStuck" 391 "DFC_BrkBstSensSCB" 392 "DFC_BrkBstSensSCG" 15 "DFC_BrkMnSwtContOn" 519 "DFC_BrkMnSwtContOnWarnLmp" 16 "DFC_BrkMnSwtNotStp" 520 "DFC_BrkMnSwtNotStpWarnLmp" 17 "DFC_BrkNpl" 18 "DFC_BrkRdntSwtContOn" 521 "DFC_BrkRdntSwtContOnWarnLmp" 19 "DFC_BrkRdntSwtNotStp" 522 "DFC_BrkRdntSwtNotStpWarnLmp" 393 "DFC_BrkSig" 496 "DFC_BSWM_E_ACTION_FAILED" 497 "DFC_BSWM_E_INTRPTQUEUE_FULL" 472 "DFC_BusDiagCANAPPLBusOff" 473 "DFC_BusDiagCANCANCBusOff" 474 "DFC_BusDiagCANVEHICLEBusOff" 490 "DFC_CAN_E_TIMEOUT" 523 "DFC_CEngDsTColdStrtMax" 524 "DFC_CEngDsTColdStrtMin" 525 "DFC_CEngDsTImps" 526 "DFC_CEngDsTPlausHSC" 527 "DFC_CEngDsTPlausLSC" 528 "DFC_CEngDsTPlausSTC" 531 "DFC_CEngDsTSig" 529 "DFC_CEngDsTSRCMax" 530 "DFC_CEngDsTSRCMin" 532 "DFC_CEngUsTColdStrtMax" 533 "DFC_CEngUsTColdStrtMin" 534 "DFC_CEngUsTLooseCnctn" 535 "DFC_CEngUsTSRCMax" 536 "DFC_CEngUsTSRCMin" 432 "DFC_Clth2ONStuck" 433 "DFC_Clth2ONStuckLdc" 20 "DFC_Clth3ONStuck" 434 "DFC_Clth3ONStuckLdc" 435 "DFC_Clth3ONStuckPostDrv" 21 "DFC_Clth4OFFStuck" 436 "DFC_Clth4ONStuck" 437 "DFC_Clth4ONStuckLdc" 260 "DFC_ClthMax" 412 "DFC_ClthNpl" 22 "DFC_ClthOFFStuck" 23 "DFC_ClthONStuck" 394 "DFC_ClthSig" 24 "DFC_ClthStkFailInfo" 25 "DFC_ComACFailInfo" 26 "DFC_ComATFTValErr" 27 "DFC_ComATMILReq" 28 "DFC_ComAYCAChksum" 29 "DFC_ComAYCARingCnt" 30 "DFC_ComAYCATOut" 31 "DFC_ComAYCDChkSum" 32 "DFC_ComAYCDTOut" 33 "DFC_ComAYCFChksum" 34 "DFC_ComAYCFRingCnt" 35 "DFC_ComAYCFTOut" 36 "DFC_ComAYCGChksum" 37 "DFC_ComAYCGRingCnt" 38 "DFC_ComAYCGTOut" 39 "DFC_ComAYCIChkSum" 40 "DFC_ComAYCIRingCnt" 41 "DFC_ComAYCITOut" 42 "DFC_ComBCM1ChkSum" 43 "DFC_ComBCM1RingCnt" 44 "DFC_ComBCM1TOut" 438 "DFC_ComBCMUnit" 45 "DFC_ComCANABusOffErr" 46 "DFC_ComCANBBusOffErr" 47 "DFC_ComCANCBusOffErr" 48 "DFC_ComCGW1ChkSum" 49 "DFC_ComCGW1RingCnt" 50 "DFC_ComCGW1TOut" 297 "DFC_ComChksTCU1" 298 "DFC_ComChksTCU11" 299 "DFC_ComChksTCU12" 300 "DFC_ComChksTCU13" 301 "DFC_ComChksTCU2" 302 "DFC_ComChksTCU3" 303 "DFC_ComChksTCU4" 304 "DFC_ComCntTCU1" 305 "DFC_ComCntTCU11" 306 "DFC_ComCntTCU12" 307 "DFC_ComCntTCU13" 308 "DFC_ComCntTCU2" 309 "DFC_ComCntTCU3" 310 "DFC_ComCntTCU4" 51 "DFC_ComConvBoostErr" 52 "DFC_ComConvSlipErr" 537 "DFC_ComDCDCACCFailr" 53 "DFC_ComDCDCPrfmncErr" 54 "DFC_ComDCDCTempWarn" 439 "DFC_ComDLCTCU01" 440 "DFC_ComDLCTCU02" 441 "DFC_ComDLCTCU1" 442 "DFC_ComDLCTCU11" 443 "DFC_ComDLCTCU12" 444 "DFC_ComDLCTCU13" 445 "DFC_ComDLCTCU14" 446 "DFC_ComDLCTCU2" 447 "DFC_ComDLCTCU3" 448 "DFC_ComDLCTCU4" 55 "DFC_ComEAT10Chksum" 56 "DFC_ComEAT10RingCnt" 57 "DFC_ComEAT10TOut" 58 "DFC_ComEAT11ChkSum" 59 "DFC_ComEAT11RingCnt" 60 "DFC_ComEAT11TOut" 61 "DFC_ComEAT12ChkSum" 62 "DFC_ComEAT12RingCnt" 63 "DFC_ComEAT12TOut" 64 "DFC_ComEAT13ChkSum" 65 "DFC_ComEAT13RingCnt" 66 "DFC_ComEAT13TOut" 67 "DFC_ComEAT1Chksum" 68 "DFC_ComEAT1RingCnt" 69 "DFC_ComEAT1TOut" 70 "DFC_ComEAT2ChkSum" 71 "DFC_ComEAT2RingCnt" 72 "DFC_ComEAT2TOut" 73 "DFC_ComEAT4ChkSum" 74 "DFC_ComEAT4RingCnt" 75 "DFC_ComEAT4TOut" 76 "DFC_ComEAT6Chksum" 77 "DFC_ComEAT6RingCnt" 78 "DFC_ComEAT6TOut" 79 "DFC_ComEAT7Chksum" 80 "DFC_ComEAT7RingCnt" 81 "DFC_ComEAT7TOut" 82 "DFC_ComEAT8Chksum" 83 "DFC_ComEAT8RingCnt" 84 "DFC_ComEAT8TOut" 85 "DFC_ComEATAChksum" 86 "DFC_ComEATARingCnt" 87 "DFC_ComEATATOut" 88 "DFC_ComEATBChkSum" 89 "DFC_ComEATBRingCnt" 90 "DFC_ComEATBTOut" 91 "DFC_ComEATCChksum" 92 "DFC_ComEATCRingCnt" 93 "DFC_ComEATCTOut" 103 "DFC_ComEngCanRxErr" 94 "DFC_ComEPBBChkSum" 95 "DFC_ComEPBBRingCnt" 96 "DFC_ComEPBBTOut" 97 "DFC_ComEPBChksum" 99 "DFC_ComEPBctRing" 98 "DFC_ComEPBTOut" 100 "DFC_ComEPS1Chksum" 101 "DFC_ComEPS1RingCnt" 102 "DFC_ComEPS1TOut" 449 "DFC_ComEPSUnit" 104 "DFC_ComGrvySnsrErr" 105 "DFC_ComGwIMG1ChkSum" 106 "DFC_ComGwIMG1RingCnt" 107 "DFC_ComGwIMG1TOut" 108 "DFC_ComGwIMG3ChkSum" 109 "DFC_ComGwIMG3RingCnt" 110 "DFC_ComGwIMG3TOut" 111 "DFC_ComGwIMG4ChkSum" 112 "DFC_ComGwIMG4RingCnt" 113 "DFC_ComGwIMG4TOut" 114 "DFC_ComGwIMG5ChkSum" 115 "DFC_ComGwIMG5RingCnt" 116 "DFC_ComGwIMG5TOut" 117 "DFC_ComGwIMG6ChkSum" 118 "DFC_ComGwIMG6RingCnt" 119 "DFC_ComGwIMG6TOut" 120 "DFC_ComIDASBChksum" 121 "DFC_ComIDASBRingCnt" 122 "DFC_ComIDASBTOut" 450 "DFC_ComIDASBUnit" 123 "DFC_ComIMGMILReq" 451 "DFC_ComIMGUnit" 124 "DFC_ComISSPrms" 125 "DFC_ComMETAChksum" 126 "DFC_ComMETAChksumPstDrv" 127 "DFC_ComMETARingCnt" 128 "DFC_ComMETARingCntPstDrv" 129 "DFC_ComMETATOut" 130 "DFC_ComMETATOutPstDrv" 131 "DFC_ComMETCChksum" 132 "DFC_ComMETCRingCnt" 133 "DFC_ComMETCTOut" 134 "DFC_ComMETDChksum" 135 "DFC_ComMETDRingCnt" 136 "DFC_ComMETDTOut" 137 "DFC_ComMETE2Chksum" 138 "DFC_ComMETE2RingCnt" 139 "DFC_ComMETE2TOut" 140 "DFC_ComMETFChksum" 141 "DFC_ComMETFRingCnt" 142 "DFC_ComMETFTOut" 143 "DFC_ComMETGChksum" 144 "DFC_ComMETGRingCnt" 145 "DFC_ComMETGTOut" 146 "DFC_ComMETH2Chksum" 147 "DFC_ComMETH2RingCnt" 148 "DFC_ComMETH2TOut" 149 "DFC_ComMETHChksum" 150 "DFC_ComMETHRingCnt" 151 "DFC_ComMETHTOut" 152 "DFC_ComMETIChksum" 153 "DFC_ComMETIRingCnt" 154 "DFC_ComMETITOut" 155 "DFC_ComMETKChksum" 156 "DFC_ComMETKRingCnt" 157 "DFC_ComMETKTOut" 158 "DFC_ComMETLChksum" 159 "DFC_ComMETLRingCnt" 160 "DFC_ComMETLTOut" 161 "DFC_ComMETMChksum" 162 "DFC_ComMETMRingCnt" 163 "DFC_ComMETMTOut" 164 "DFC_ComMETNChksum" 165 "DFC_ComMETNRingCnt" 166 "DFC_ComMETNTOut" 452 "DFC_ComMETUnit" 167 "DFC_ComMtrCom" 168 "DFC_ComPCUChkSum" 169 "DFC_ComPCURingCnt" 170 "DFC_ComPCUTOut" 171 "DFC_ComSRSAChksum" 172 "DFC_ComSRSARingCnt" 173 "DFC_ComSRSATOut" 174 "DFC_ComSRSBChksum" 175 "DFC_ComSRSBRingCnt" 176 "DFC_ComSRSBTOut" 177 "DFC_ComSRSChksum" 178 "DFC_ComSRSErr" 179 "DFC_ComSRSRingCnt" 180 "DFC_ComSRSTOut" 453 "DFC_ComSRSUnit" 311 "DFC_ComTOutTCU01" 312 "DFC_ComTOutTCU02" 313 "DFC_ComTOutTCU1" 314 "DFC_ComTOutTCU11" 315 "DFC_ComTOutTCU12" 316 "DFC_ComTOutTCU13" 317 "DFC_ComTOutTCU14" 318 "DFC_ComTOutTCU2" 319 "DFC_ComTOutTCU3" 320 "DFC_ComTOutTCU4" 181 "DFC_ComVehSpdPndFltTCU" 454 "DFC_ComVSAUnit" 538 "DFC_DCDCFltDet" 321 "DFC_DevLibBattUHi" 322 "DFC_DevLibBattULo" 357 "DFC_DHFHD" 558 "DFC_DiagCpv1DteskLoLoadStuckClsd" 559 "DFC_DiagCpv1DteskLoLoadStuckOpen" 541 "DFC_DKnpl" 539 "DFC_DKRSA" 540 "DFC_DKVSmax" 542 "DFC_DSKVRmax" 543 "DFC_DSKVRmin" 544 "DFC_DSKVRnpl" 545 "DFC_DSKVRsig" 546 "DFC_DSKVSsig" 547 "DFC_DSSmax" 548 "DFC_DSTDmax" 549 "DFC_DSTEmax" 550 "DFC_DSTEmin" 551 "DFC_DSTOFmax" 552 "DFC_DSTRmax" 553 "DFC_DSTRmin" 554 "DFC_DSTRnpl" 555 "DFC_DSTRsig" 556 "DFC_DSTTI" 557 "DFC_DSUmax" 182 "DFC_EbsChartcCurrErr" 183 "DFC_EbsSelfDiagErr" 455 "DFC_EbsSocFlt" 395 "DFC_EGRVlvCurrLim" 560 "DFC_EGRVlvDrftClsd" 561 "DFC_EGRVlvDrftOpn" 323 "DFC_EGRVlvFailSafeActv" 324 "DFC_EGRVlvGovDvtCld" 562 "DFC_EGRVlvJamVlvClsd" 563 "DFC_EGRVlvJamVlvOpn" 396 "DFC_EGRVlvOL" 397 "DFC_EGRVlvOvrTemp" 325 "DFC_EGRVlvPhysSRCMax" 326 "DFC_EGRVlvPhysSRCMin" 398 "DFC_EGRVlvSCB" 399 "DFC_EGRVlvSCG" 564 "DFC_EGRVlvSprgBrk" 400 "DFC_EGRVlvSRCMax" 401 "DFC_EGRVlvSRCMin" 565 "DFC_EGRVlvTempMdlEEPErr" 566 "DFC_EGRVlvTmpErr" 567 "DFC_EGSDUS2B1LtrDly" 568 "DFC_EGSDUS2B1LtrPT1" 569 "DFC_EGSDUS2B1RtlDly" 570 "DFC_EGSDUS2B1RtlPT1" 571 "DFC_EGSDUS2B1TarLean" 572 "DFC_EGSDUS2B1TarRich" 586 "DFC_EngICO" 587 "DFC_EngPrtOvrSpdMon" 573 "DFC_EONVmax" 588 "DFC_EpmCaSI1ErrSig" 589 "DFC_EpmCaSI1MntErr" 590 "DFC_EpmCaSI1NoSigMax" 591 "DFC_EpmCaSI1NoSigMin" 592 "DFC_EpmCaSI1OfsErr" 593 "DFC_EpmCrSDGI" 594 "DFC_EpmCrSErrSig" 595 "DFC_EpmCrSNoSig" 596 "DFC_EtaEngIdleNonCsers" 597 "DFC_EtaEngPtlNonCsers" 574 "DFC_ETAKHLmax" 575 "DFC_ETAKHTmax" 576 "DFC_ETHSEmax" 577 "DFC_ETHSEmin" 578 "DFC_ETHSFmax" 579 "DFC_ETHSFmin" 580 "DFC_ETHSFsig" 581 "DFC_ETHSNPWmax" 582 "DFC_ETHSNPWmin" 583 "DFC_ETHSNPWsig" 584 "DFC_ETHSPLnpl" 585 "DFC_ETHSTPLnpl" 327 "DFC_FanDIOOL_0" 328 "DFC_FanDIOOL_1" 329 "DFC_FanDIOOvrTemp_0" 330 "DFC_FanDIOOvrTemp_1" 331 "DFC_FanDIOSCB_0" 332 "DFC_FanDIOSCB_1" 333 "DFC_FanDIOSCG_0" 334 "DFC_FanDIOSCG_1" 598 "DFC_FRAmax" 599 "DFC_FRAmin" 600 "DFC_FSTEmax" 601 "DFC_FSTEmin" 605 "DFC_FSTmax" 602 "DFC_FSTRmax" 603 "DFC_FSTRmin" 604 "DFC_FSTRnpl" 606 "DFC_FTDLAmax" 607 "DFC_FTDLAmin" 608 "DFC_FuPHiSnsrEleclmax" 609 "DFC_FuPHiSnsrEleclmin" 610 "DFC_FuPHiSnsrEleclnpl" 611 "DFC_FuPHiSnsrURngMax" 612 "DFC_FuPHiSnsrURngMin" 613 "DFC_FuSnsrPhyRngMaxErr" 614 "DFC_FuSnsrPhyRngMinErr" 188 "DFC_GbxCANDigPlausErr" 189 "DFC_GbxNPos1SRCMax" 190 "DFC_GbxNPos1SRCMin" 191 "DFC_GbxNPos2SRCMax" 192 "DFC_GbxNPos2SRCMin" 193 "DFC_GbxNPosAlvChk" 194 "DFC_GbxNPosSyncErr" 413 "DFC_GbxPNPosnDrvCdn" 414 "DFC_GbxPNPosnPlausy" 618 "DFC_GbxRvsSwtStk" 615 "DFC_GEVlvLockPinDiagIntkB1" 184 "DFC_GEVlvPhaCsersIntkB1" 185 "DFC_GEVlvPhaPsOpenLoadIntkB1" 186 "DFC_GEVlvPhaPsShoToBattIntkB1" 187 "DFC_GEVlvPhaPsShoToGndIntkB1" 616 "DFC_GEVlvPhaSlowIntkB1" 617 "DFC_GEVlvPhaTargIntkB1" 619 "DFC_HDRKHmax" 620 "DFC_HDRKHmin" 623 "DFC_HDRmax" 624 "DFC_HDRmin" 621 "DFC_HDRPLmax" 622 "DFC_HDRPLmin" 625 "DFC_HEGOS2B1ElecMax" 626 "DFC_HEGOS2B1ElecMin" 627 "DFC_HEGOS2B1ElecSig" 628 "DFC_HEGOS2B1HtgNpl" 195 "DFC_HEGOS2B1HtrPsMax" 196 "DFC_HEGOS2B1HtrPsMin" 197 "DFC_HEGOS2B1HtrPsSig" 629 "DFC_HEV00max" 630 "DFC_HEV01max" 631 "DFC_HEV02max" 632 "DFC_HEV03max" 633 "DFC_HEVE0max" 634 "DFC_HEVE1max" 635 "DFC_HFMmax" 636 "DFC_HiPSysHiPMaxLimExcdd" 402 "DFC_HLSDemOvhtEngLim" 456 "DFC_I14229VINErr" 261 "DFC_IgnClPs_DevComErr" 262 "DFC_IgnClPs_LineOl_0" 263 "DFC_IgnClPs_LineOl_1" 264 "DFC_IgnClPs_LineOl_2" 265 "DFC_IgnClPs_LineOl_3" 266 "DFC_IgnClPs_LineScb_0" 267 "DFC_IgnClPs_LineScb_1" 268 "DFC_IgnClPs_LineScb_2" 269 "DFC_IgnClPs_LineScb_3" 270 "DFC_IgnClPs_LineScg_0" 271 "DFC_IgnClPs_LineScg_1" 272 "DFC_IgnClPs_LineScg_2" 273 "DFC_IgnClPs_LineScg_3" 457 "DFC_InjCatHeatgErr" 458 "DFC_InjSysMulInjDiagErr" 358 "DFC_InjVlv_DI_DcDc" 359 "DFC_InjVlv_DI_NoLd_0" 360 "DFC_InjVlv_DI_NoLd_1" 361 "DFC_InjVlv_DI_NoLd_2" 362 "DFC_InjVlv_DI_NoLd_3" 363 "DFC_InjVlv_DI_ScBnk_0" 364 "DFC_InjVlv_DI_ScBnk_1" 365 "DFC_InjVlv_DI_ScBnk_2" 366 "DFC_InjVlv_DI_ScBnk_3" 367 "DFC_InjVlv_DI_ScCyl_0" 368 "DFC_InjVlv_DI_ScCyl_1" 369 "DFC_InjVlv_DI_ScCyl_2" 370 "DFC_InjVlv_DI_ScCyl_3" 371 "DFC_InjVlv_DI_ScHsLs_0" 372 "DFC_InjVlv_DI_ScHsLs_1" 373 "DFC_InjVlv_DI_ScHsLs_2" 374 "DFC_InjVlv_DI_ScHsLs_3" 652 "DFC_IntkAirTAirFltDsCrssMax" 653 "DFC_IntkAirTAirFltDsCrssMin" 654 "DFC_IntkAirTAirFltDsHSCMax" 655 "DFC_IntkAirTAirFltDsImps" 656 "DFC_IntkAirTAirFltDsPRCMax" 657 "DFC_IntkAirTAirFltDsPRCMin" 658 "DFC_IntkAirTAirFltDsSRCMax" 659 "DFC_IntkAirTAirFltDsSRCMin" 660 "DFC_IntkAirTAirFltDsSTC" 661 "DFC_IntkAirTIntkMnfldCrssMax" 662 "DFC_IntkAirTIntkMnfldCrssMin" 663 "DFC_IntkAirTIntkMnfldHSCMax" 664 "DFC_IntkAirTIntkMnfldImps" 665 "DFC_IntkAirTIntkMnfldPRCMax" 666 "DFC_IntkAirTIntkMnfldPRCMin" 667 "DFC_IntkAirTIntkMnfldSRCMax" 668 "DFC_IntkAirTIntkMnfldSRCMin" 669 "DFC_IntkAirTIntkMnfldSTC" 647 "DFC_IVGdiCtl_CvoErr" 648 "DFC_IVGdiCtl_CvoSigPlaus_0" 649 "DFC_IVGdiCtl_CvoSigPlaus_1" 650 "DFC_IVGdiCtl_CvoSigPlaus_2" 651 "DFC_IVGdiCtl_CvoSigPlaus_3" 637 "DFC_IVGdiCtlCvoErrMax_0" 638 "DFC_IVGdiCtlCvoErrMax_1" 639 "DFC_IVGdiCtlCvoErrMax_2" 640 "DFC_IVGdiCtlCvoErrMax_3" 641 "DFC_IVGdiCtlCvoErrMin_0" 642 "DFC_IVGdiCtlCvoErrMin_1" 643 "DFC_IVGdiCtlCvoErrMin_2" 644 "DFC_IVGdiCtlCvoErrMin_3" 645 "DFC_IVGdiCtlCvoErrMinMax" 646 "DFC_IVGdiCtlCvoSigPlausErrSmrCdn" 428 "DFC_KnDetSens1PortAMax" 429 "DFC_KnDetSens1PortAMin" 430 "DFC_KnDetSens1PortBMax" 431 "DFC_KnDetSens1PortBMin" 670 "DFC_KRREGRLMX" 671 "DFC_KRVEKOCVLCI" 672 "DFC_KRVEKOENCHMT" 673 "DFC_KRVEKOENCHMT0" 674 "DFC_KRVEKOENCHMT1" 675 "DFC_KRVEKOENCHMT2" 676 "DFC_KRVEKOENCHMT3" 677 "DFC_KRVEKOENCHMT4" 678 "DFC_KRVEKOENCHMT5" 679 "DFC_KRVEKOENCHMT6" 680 "DFC_KRVEKOENCHMT7" 274 "DFC_KRVEKOEVAB" 275 "DFC_KRVEKOEVAB0" 276 "DFC_KRVEKOEVAB1" 277 "DFC_KRVEKOEVAB2" 278 "DFC_KRVEKOEVAB3" 681 "DFC_KRVEKORLMX" 682 "DFC_KRVEKORLMXL" 683 "DFC_KS1max" 684 "DFC_KS1min" 687 "DFC_LamDynDiagS1B1" 688 "DFC_LeakIntkMnfldEmiInfl" 491 "DFC_LIN_E_TIMEOUT" 465 "DFC_LinACGUnit" 466 "DFC_LinAEVUnit" 198 "DFC_LinCSErrACG" 199 "DFC_LinCSErrAEV" 200 "DFC_LinCSErrDCDC" 201 "DFC_LinCSErrEBS" 467 "DFC_LinEBSUnit" 689 "DFC_LinFrameErrDCDC" 202 "DFC_LinHdrTimeoutErrACG" 203 "DFC_LinHdrTimeoutErrAEV" 204 "DFC_LinHdrTimeoutErrDCDC" 205 "DFC_LinHdrTimeoutErrEBS" 206 "DFC_LinMsgTimeoutErrACG" 207 "DFC_LinMsgTimeoutErrAEV" 208 "DFC_LinMsgTimeoutErrDCDC" 209 "DFC_LinMsgTimeoutErrEBS" 210 "DFC_LinNoStrtComErr" 690 "DFC_LinOverrunErrDCDC" 459 "DFC_LLRHmax" 460 "DFC_LLRHmin" 461 "DFC_LLRHnpl" 462 "DFC_LLRKHmax" 463 "DFC_LLRKHmin" 464 "DFC_LLRKHnpl" 685 "DFC_LMmax" 211 "DFC_LowPresOilP" 686 "DFC_LZSRnpl" 691 "DFC_MD00max" 692 "DFC_MDBmax" 693 "DFC_MDCat" 694 "DFC_MDCatCrit" 695 "DFC_MDCatCurr" 696 "DFC_MDCyl_0" 697 "DFC_MDCyl_1" 698 "DFC_MDCyl_2" 699 "DFC_MDCyl_3" 700 "DFC_MDEmi" 701 "DFC_MDEmiStrt" 702 "DFC_MDFco" 705 "DFC_MDmax" 703 "DFC_MDMpl" 704 "DFC_MDSegTiAdpn" 375 "DFC_MfPsDiaOpenLoad1" 376 "DFC_MfPsDiaScHiS1" 377 "DFC_MfPsDiaScHiSLowS1" 378 "DFC_MfPsDiaScLowS1" 706 "DFC_MFuOilMax" 228 "DFC_MisfDetdVWhlFrntLePlaus" 229 "DFC_MisfDetdVWhlFrntRiPlaus" 230 "DFC_MisfDetdVWhlReLePlaus" 231 "DFC_MisfDetdVWhlReRiPlaus" 212 "DFC_MisfDetVWhlFrntLeOORHi" 213 "DFC_MisfDetVWhlFrntLeRatyHi" 214 "DFC_MisfDetVWhlFrntLeRatyLo" 215 "DFC_MisfDetVWhlFrntLeStuck" 216 "DFC_MisfDetVWhlFrntRiOORHi" 217 "DFC_MisfDetVWhlFrntRiRatyHi" 218 "DFC_MisfDetVWhlFrntRiRatyLo" 219 "DFC_MisfDetVWhlFrntRiStuck" 220 "DFC_MisfDetVWhlReLeOORHi" 221 "DFC_MisfDetVWhlReLeRatyHi" 222 "DFC_MisfDetVWhlReLeRatyLo" 223 "DFC_MisfDetVWhlReLeStuck" 224 "DFC_MisfDetVWhlReRiOORHi" 225 "DFC_MisfDetVWhlReRiRatyHi" 226 "DFC_MisfDetVWhlReRiRatyLo" 227 "DFC_MisfDetVWhlReRiStuck" 801 "DFC_MoCADCNTP" 802 "DFC_MoCADCTst" 803 "DFC_MoCSOPICO" 805 "DFC_MoFAirFilgPrdc" 806 "DFC_MoFAirFlCtOffGdi" 807 "DFC_MoFAirFlCylGdi" 808 "DFC_MoFAirFlFF" 809 "DFC_MoFAirFlIn" 810 "DFC_MoFAirFlMixCtlGdiChkAirFl" 811 "DFC_MoFAirFlMixCtlGdiChkCtrl" 812 "DFC_MoFAirFlMode" 804 "DFC_MoFAPP" 813 "DFC_MoFESpd" 814 "DFC_MoFIACo" 815 "DFC_MoFICOL1" 816 "DFC_MoFICOL2" 817 "DFC_MoFStrt" 818 "DFC_MoFTrqCmp" 819 "DFC_MoFTrqCmpMax" 820 "DFC_MoFTrqCmpMin" 821 "DFC_MoFVarPostBldSel" 707 "DFC_MOXEMM_SMU_ALM0_0" 708 "DFC_MOXEMM_SMU_ALM0_1" 709 "DFC_MOXEMM_SMU_ALM0_10" 710 "DFC_MOXEMM_SMU_ALM0_11" 711 "DFC_MOXEMM_SMU_ALM0_13" 712 "DFC_MOXEMM_SMU_ALM0_14" 713 "DFC_MOXEMM_SMU_ALM0_2" 714 "DFC_MOXEMM_SMU_ALM0_22" 715 "DFC_MOXEMM_SMU_ALM0_23" 716 "DFC_MOXEMM_SMU_ALM0_4" 717 "DFC_MOXEMM_SMU_ALM0_5" 718 "DFC_MOXEMM_SMU_ALM0_7" 719 "DFC_MOXEMM_SMU_ALM0_8" 720 "DFC_MOXEMM_SMU_ALM10_16" 721 "DFC_MOXEMM_SMU_ALM10_17" 722 "DFC_MOXEMM_SMU_ALM10_21" 723 "DFC_MOXEMM_SMU_ALM11_0" 724 "DFC_MOXEMM_SMU_ALM11_1" 725 "DFC_MOXEMM_SMU_ALM11_2" 726 "DFC_MOXEMM_SMU_ALM11_3" 727 "DFC_MOXEMM_SMU_ALM11_4" 728 "DFC_MOXEMM_SMU_ALM11_5" 729 "DFC_MOXEMM_SMU_ALM11_8" 730 "DFC_MOXEMM_SMU_ALM11_9" 731 "DFC_MOXEMM_SMU_ALM1_0" 732 "DFC_MOXEMM_SMU_ALM1_1" 733 "DFC_MOXEMM_SMU_ALM1_10" 734 "DFC_MOXEMM_SMU_ALM1_11" 735 "DFC_MOXEMM_SMU_ALM1_13" 736 "DFC_MOXEMM_SMU_ALM1_14" 737 "DFC_MOXEMM_SMU_ALM1_2" 738 "DFC_MOXEMM_SMU_ALM1_22" 739 "DFC_MOXEMM_SMU_ALM1_23" 740 "DFC_MOXEMM_SMU_ALM1_4" 741 "DFC_MOXEMM_SMU_ALM1_5" 742 "DFC_MOXEMM_SMU_ALM1_7" 743 "DFC_MOXEMM_SMU_ALM1_8" 744 "DFC_MOXEMM_SMU_ALM21_0" 745 "DFC_MOXEMM_SMU_ALM21_16" 746 "DFC_MOXEMM_SMU_ALM21_3" 747 "DFC_MOXEMM_SMU_ALM2_1" 748 "DFC_MOXEMM_SMU_ALM2_10" 749 "DFC_MOXEMM_SMU_ALM2_11" 750 "DFC_MOXEMM_SMU_ALM2_13" 751 "DFC_MOXEMM_SMU_ALM2_14" 752 "DFC_MOXEMM_SMU_ALM2_22" 753 "DFC_MOXEMM_SMU_ALM2_23" 754 "DFC_MOXEMM_SMU_ALM2_4" 755 "DFC_MOXEMM_SMU_ALM2_5" 756 "DFC_MOXEMM_SMU_ALM2_7" 757 "DFC_MOXEMM_SMU_ALM2_8" 758 "DFC_MOXEMM_SMU_ALM6_0" 759 "DFC_MOXEMM_SMU_ALM6_11" 760 "DFC_MOXEMM_SMU_ALM6_12" 761 "DFC_MOXEMM_SMU_ALM6_14" 762 "DFC_MOXEMM_SMU_ALM6_15" 763 "DFC_MOXEMM_SMU_ALM6_17" 764 "DFC_MOXEMM_SMU_ALM6_18" 765 "DFC_MOXEMM_SMU_ALM6_20" 766 "DFC_MOXEMM_SMU_ALM6_21" 767 "DFC_MOXEMM_SMU_ALM6_25" 768 "DFC_MOXEMM_SMU_ALM6_4" 769 "DFC_MOXEMM_SMU_ALM6_5" 770 "DFC_MOXEMM_SMU_ALM6_7" 771 "DFC_MOXEMM_SMU_ALM6_8" 772 "DFC_MOXEMM_SMU_ALM7_1" 773 "DFC_MOXEMM_SMU_ALM7_12" 774 "DFC_MOXEMM_SMU_ALM7_13" 775 "DFC_MOXEMM_SMU_ALM7_14" 776 "DFC_MOXEMM_SMU_ALM7_15" 777 "DFC_MOXEMM_SMU_ALM7_16" 778 "DFC_MOXEMM_SMU_ALM7_17" 779 "DFC_MOXEMM_SMU_ALM7_2" 780 "DFC_MOXEMM_SMU_ALM7_20" 781 "DFC_MOXEMM_SMU_ALM7_25" 782 "DFC_MOXEMM_SMU_ALM7_26" 783 "DFC_MOXEMM_SMU_ALM7_28" 784 "DFC_MOXEMM_SMU_ALM7_29" 785 "DFC_MOXEMM_SMU_ALM7_30" 786 "DFC_MOXEMM_SMU_ALM7_31" 787 "DFC_MOXEMM_SMU_ALM8_0" 788 "DFC_MOXEMM_SMU_ALM8_1" 789 "DFC_MOXEMM_SMU_ALM8_10" 790 "DFC_MOXEMM_SMU_ALM8_11" 791 "DFC_MOXEMM_SMU_ALM8_12" 792 "DFC_MOXEMM_SMU_ALM8_16" 793 "DFC_MOXEMM_SMU_ALM8_18" 794 "DFC_MOXEMM_SMU_ALM8_2" 795 "DFC_MOXEMM_SMU_ALM8_3" 796 "DFC_MOXEMM_SMU_ALM8_31" 797 "DFC_MOXEMM_SMU_ALM8_4" 798 "DFC_MOXEMM_SMU_ALM9_0" 799 "DFC_MOXEMM_SMU_ALM9_15" 800 "DFC_MOXEMM_SMU_ALM9_3" 822 "DFC_MoXEMMHwLTMCUFW" 823 "DFC_MoXEMMHwLTMonBIST" 824 "DFC_MoXEMMHwLTRegMonTest" 825 "DFC_MoXEMMHwLTStbySMUAlvTest" 826 "DFC_MoXEMMHwLTTempSens" 827 "DFC_MoXEMMHwLTUCBCfg" 335 "DFC_MRlyDcOL" 336 "DFC_MRlyDcSCB" 337 "DFC_MRlyDcSCG" 492 "DFC_MRlyOL" 493 "DFC_MRlySCB" 494 "DFC_MRlySCG" 828 "DFC_NWSEmax" 829 "DFC_NWSmax" 830 "DFC_OCWDAABEActv" 831 "DFC_OCWDACom" 832 "DFC_OCWDAErrPin" 833 "DFC_OCWDAOvrVltg" 836 "DFC_OilPPlaus" 403 "DFC_OilPSwmpSRCMax" 404 "DFC_OilPSwmpSRCMin" 834 "DFC_ORAmax" 835 "DFC_ORAmin" 847 "DFC_P_VSE11_OL" 848 "DFC_P_VSE11_SCB" 849 "DFC_P_VSE11_SCG" 417 "DFC_PEnvCcMax" 418 "DFC_PEnvCcMin" 419 "DFC_PEnvRngChkMax" 420 "DFC_PEnvRngChkMin" 232 "DFC_PEnvSigRngMax" 233 "DFC_PEnvSigRngMin" 421 "DFC_PEnvSnsrPlaus" 850 "DFC_PhyHighAPP1" 851 "DFC_PhyHighAPP2" 852 "DFC_PhyLowAPP1" 853 "DFC_PhyLowAPP2" 405 "DFC_PIntkVUsLineHiB1" 406 "DFC_PIntkVUsLineLoB1" 837 "DFC_PLLSUmax" 838 "DFC_PLLSUmin" 338 "DFC_PSPOL" 339 "DFC_PSPOvrTemp" 340 "DFC_PSPSCB" 341 "DFC_PSPSCG" 839 "DFC_PSR1max" 840 "DFC_PSRBmax" 841 "DFC_PSRBmin" 845 "DFC_PSRmax" 842 "DFC_PSRPmax" 843 "DFC_PSRPmin" 844 "DFC_PSRPsig" 846 "DFC_PUmax" 475 "DFC_RBA_IODIAGPWR_rba_IoExtCy329_SignalVltSply_0" 476 "DFC_RBA_IODIAGPWR_rba_IoExtCy329_SignalVltSply_0OT" 477 "DFC_RBA_IODIAGPWR_rba_IoExtCy329_SignalVltSply_0OV" 478 "DFC_RBA_IODIAGPWR_rba_IoExtCy329_SignalVltSply_0SCG" 479 "DFC_RBA_IODIAGPWR_rba_IoExtCy329_SignalVltSply_0UV" 480 "DFC_RBA_IODIAGPWR_rba_IoExtCy329_SignalVltSply_1" 481 "DFC_RBA_IODIAGPWR_rba_IoExtCy329_SignalVltSply_1OT" 482 "DFC_RBA_IODIAGPWR_rba_IoExtCy329_SignalVltSply_1OV" 483 "DFC_RBA_IODIAGPWR_rba_IoExtCy329_SignalVltSply_1SCG" 484 "DFC_RBA_IODIAGPWR_rba_IoExtCy329_SignalVltSply_1UV" 485 "DFC_RBA_IODIAGPWR_rba_IoExtCy329_SignalVltSply_2" 486 "DFC_RBA_IODIAGPWR_rba_IoExtCy329_SignalVltSply_2OT" 487 "DFC_RBA_IODIAGPWR_rba_IoExtCy329_SignalVltSply_2OV" 488 "DFC_RBA_IODIAGPWR_rba_IoExtCy329_SignalVltSply_2SCG" 489 "DFC_RBA_IODIAGPWR_rba_IoExtCy329_SignalVltSply_2UV" 498 "DFC_RBA_IOEXTLIB_KEEPALIVE_DRV" 499 "DFC_RBA_IOEXTLIB_KEEPALIVE_INI" 500 "DFC_rba_IoSigRtc_StopCounter" 502 "DFC_rba_MemDiag_MemReadErr" 503 "DFC_rba_MemDiag_MemWrErr" 501 "DFC_rba_MRly_Diag_Stk_Event" 495 "DFC_rba_MultiStackTrace_Threshold" 504 "DFC_rba_SyC_IrrSwOffTrigEngRun_Event" 505 "DFC_rba_T15_Diag_ComInVld_Event" 506 "DFC_rba_T15_Diag_ComOff_HwOn_Event" 507 "DFC_rba_T15_Diag_ComOn_HwOff_Event" 468 "DFC_RoughRoad" 469 "DFC_SiaEEPRdErr" 470 "DFC_SiaEEPWrngCod" 854 "DFC_SRCHighAPP1" 855 "DFC_SRCHighAPP2" 856 "DFC_SRCLowAPP1" 857 "DFC_SRCLowAPP2" 858 "DFC_SSpMon2" 859 "DFC_STHDRmax" 234 "DFC_StmFault" 236 "DFC_StrtCtlErr" 235 "DFC_StrtCtOffPth" 237 "DFC_StrtFault" 238 "DFC_StrtLckJudg1" 239 "DFC_StrtLckJudg2" 240 "DFC_StrtOL" 241 "DFC_StrtOL2" 242 "DFC_StrtSCB" 243 "DFC_StrtSCB2" 244 "DFC_StrtSCG" 245 "DFC_StrtSCG2" 246 "DFC_StrtStkRly1" 247 "DFC_StrtStkRly2" 860 "DFC_SWReset_0" 861 "DFC_SWReset_1" 862 "DFC_SWReset_2" 863 "DFC_SyncAPP" 342 "DFC_T50Err" 865 "DFC_TAmax_Dummy" 864 "DFC_TANKLnpl" 866 "DFC_TESFmax" 867 "DFC_TESGmax" 248 "DFC_TEVEmax" 249 "DFC_TEVEmin" 250 "DFC_TEVEsig" 875 "DFC_ThrVlvClsdPosnFirstOffsLrnImpoB1" 876 "DFC_ThrVlvClsdPosnOffsLrnImpoB1" 877 "DFC_ThrVlvClsdPosnOffsLrnMaxB1" 878 "DFC_ThrVlvClsdPosnOffsLrnMinB1" 879 "DFC_ThrVlvCtrlDeB1" 880 "DFC_ThrVlvDycB1" 881 "DFC_ThrVlvLimpAirPosnMaxAbsltDriftB1" 882 "DFC_ThrVlvLimpAirPosnMaxB1" 883 "DFC_ThrVlvLimpAirPosnMaxRelDriftB1" 884 "DFC_ThrVlvLimpAirPosnMinB1" 343 "DFC_ThrVlvLoBattB1" 885 "DFC_ThrVlvOpenLoadB1" 886 "DFC_ThrVlvOpenSprgB1" 887 "DFC_ThrVlvOpenSprgSprdB1" 888 "DFC_ThrVlvOpenSprgTwnB1" 889 "DFC_ThrVlvOverTB1" 890 "DFC_ThrVlvRetSprgB1" 891 "DFC_ThrVlvRetSprgSprdB1" 892 "DFC_ThrVlvRetSprgTwnB1" 893 "DFC_ThrVlvSens1MaxB1" 900 "DFC_ThrvlvSens1MinB1" 894 "DFC_ThrVlvSens1NplB1" 895 "DFC_ThrVlvSens2MaxB1" 896 "DFC_ThrVlvSens2MinB1" 897 "DFC_ThrVlvSens2NplB1" 898 "DFC_ThrVlvShoCircB1" 899 "DFC_ThrVlvSpiErrB1" 901 "DFC_TiOffTBasdChkFast" 902 "DFC_TiOffTBasdChkSlow" 868 "DFC_TKAEmax" 869 "DFC_TKAEmin" 870 "DFC_TKARmax" 871 "DFC_TKARnpl" 872 "DFC_TMmax_Dummy" 873 "DFC_TUMmax_Dummy" 874 "DFC_TWCDPriCatB1" 251 "DFC_UegoHeatrPrfmncLoS1B1" 422 "DFC_UEGOHeatrRlyPsOLS1B1" 423 "DFC_UEGOHeatrRlyPsSCBS1B1" 424 "DFC_UEGOHeatrRlyPsSCGS1B1" 471 "DFC_UegoHeatrStrtS1B1" 425 "DFC_UegoHeatrWireOlS1B1" 426 "DFC_UegoHeatrWireScbS1B1" 427 "DFC_UegoHeatrWireScgS1B1" 279 "DFC_UegoSigEcuAsicS1B1" 280 "DFC_UegoSigEcuComS1B1" 344 "DFC_UegoSigOperPlausS1B1" 281 "DFC_UegoSigSnsrS1B1" 282 "DFC_UegoSigWireOlApesS1B1" 283 "DFC_UegoSigWireOlIpeS1B1" 284 "DFC_UegoSigWireOlReS1B1" 285 "DFC_UegoSigWireRCmpS1B1" 286 "DFC_UegoSigWireScbS1B1" 287 "DFC_UegoSigWireScgS1B1" 903 "DFC_UEGOSnsrMntdS1B1" 252 "DFC_VehVAllPlaus" 253 "DFC_VehVNCSnsrElecFailr" 345 "DFC_VehVPhysRngHi" 407 "DFC_VehVPhysRngLo" 254 "DFC_VehVPlausCan" 255 "DFC_VehVPlausFco" 256 "DFC_VehVPlausPwr" 257 "DFC_VehVPlausV2N" 346 "DFC_VehVSclOutOL" 347 "DFC_VehVSclOutOT" 348 "DFC_VehVSclOutSCB" 349 "DFC_VehVSclOutSCG" 904 "DFC_VehVSig" 408 "DFC_VehVSigCan" 409 "DFC_VehVSigCanSafe" 350 "DFC_VehVSigFL" 351 "DFC_VehVSigFR" 352 "DFC_VehVSigRL" 353 "DFC_VehVSigRR" 354 "DFC_VehVSnsrARngHi" 355 "DFC_VehVSnsrBRngHi" 356 "DFC_VehVSpdRtyDiag" 258 "DFC_VehVSpdSnsrAElecFailr" 259 "DFC_VehVSpdSnsrBElecFailr" 410 "DFC_VlvLftFbOilPSnsrIntk11SRCMax" 411 "DFC_VlvLftFbOilPSnsrIntk11SRCMin" 905 "DFC_VlvLftFbSwtIntk11SpclFail" 906 "DFC_VlvLftFbSwtIntk11StdFail" DEFAULT_VALUE "---" /end COMPU_VTAB
/begin COMPU_METHOD DFES_OneToOne "" RAT_FUNC "%6.2" "-" COEFFS 0 1 0 0 0 1 /end COMPU_METHOD
/begin RECORD_LAYOUT Val_Wu16 FNC_VALUES 1 UWORD COLUMN_DIR DIRECT /end RECORD_LAYOUT
/begin RECORD_LAYOUT Val_Wu8 FNC_VALUES 1 UBYTE COLUMN_DIR DIRECT /end RECORD_LAYOUT
/end MODULE
/end PROJECT
