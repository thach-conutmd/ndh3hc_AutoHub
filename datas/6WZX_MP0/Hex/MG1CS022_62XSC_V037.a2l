ASAP2_VERSION 1 60
/begin PROJECT MG1CS022 "MG1CS022"
/begin HEADER "" VERSION "MG1CS022_62XSC_V037" PROJECT_NO MG1CS022 /end HEADER
/begin MODULE DIM ""
/begin MOD_COMMON "" BYTE_ORDER MSB_LAST ALIGNMENT_BYTE 1 ALIGNMENT_WORD 2 ALIGNMENT_LONG 4 ALIGNMENT_INT64 4 ALIGNMENT_FLOAT32_IEEE 4 ALIGNMENT_FLOAT64_IEEE 4 DATA_SIZE 32 /end MOD_COMMON
/begin MEASUREMENT ComM_ChannelStruct[0].ChannelState_e "ComM Channel structure[0]/" ULONG RB_RBA_Common_CentralElements_CompuMethods_Identical 1 100 0.0 4.E9 FORMAT "%5.0" ECU_ADDRESS 0x50006438 /end MEASUREMENT
/begin MEASUREMENT ComM_ChannelStruct[1].ChannelState_e "ComM Channel structure[1]/" ULONG RB_RBA_Common_CentralElements_CompuMethods_Identical 1 100 0.0 4.E9 FORMAT "%5.0" ECU_ADDRESS 0x50006450 /end MEASUREMENT
/begin MEASUREMENT ComM_ChannelStruct[2].ChannelState_e "ComM Channel structure[2]/" ULONG RB_RBA_Common_CentralElements_CompuMethods_Identical 1 100 0.0 4.E9 FORMAT "%5.0" ECU_ADDRESS 0x50006468 /end MEASUREMENT
/begin MEASUREMENT ComM_ChannelStruct[3].ChannelState_e "ComM Channel structure[3]/" ULONG RB_RBA_Common_CentralElements_CompuMethods_Identical 1 100 0.0 4.E9 FORMAT "%5.0" ECU_ADDRESS 0x50006480 /end MEASUREMENT
/begin MEASUREMENT ComM_ChannelStruct[0].LightTimeoutCtr_u32 "ComM Channel structure[0]/" ULONG RB_RBA_Common_CentralElements_CompuMethods_Identical 1 100 0.0 4.E9 FORMAT "%5.0" ECU_ADDRESS 0x5000643C /end MEASUREMENT
/begin MEASUREMENT ComM_ChannelStruct[1].LightTimeoutCtr_u32 "ComM Channel structure[1]/" ULONG RB_RBA_Common_CentralElements_CompuMethods_Identical 1 100 0.0 4.E9 FORMAT "%5.0" ECU_ADDRESS 0x50006454 /end MEASUREMENT
/begin MEASUREMENT ComM_ChannelStruct[2].LightTimeoutCtr_u32 "ComM Channel structure[2]/" ULONG RB_RBA_Common_CentralElements_CompuMethods_Identical 1 100 0.0 4.E9 FORMAT "%5.0" ECU_ADDRESS 0x5000646C /end MEASUREMENT
/begin MEASUREMENT ComM_ChannelStruct[3].LightTimeoutCtr_u32 "ComM Channel structure[3]/" ULONG RB_RBA_Common_CentralElements_CompuMethods_Identical 1 100 0.0 4.E9 FORMAT "%5.0" ECU_ADDRESS 0x50006484 /end MEASUREMENT
/begin MEASUREMENT ComM_ChannelStruct[0].MinFullComTimeoutCtr_u16 "ComM Channel structure[0]/" UWORD RB_RBA_Common_CentralElements_CompuMethods_Identical 1 100 0.0 65535. FORMAT "%5.0" ECU_ADDRESS 0x50006440 /end MEASUREMENT
/begin MEASUREMENT ComM_ChannelStruct[1].MinFullComTimeoutCtr_u16 "ComM Channel structure[1]/" UWORD RB_RBA_Common_CentralElements_CompuMethods_Identical 1 100 0.0 65535. FORMAT "%5.0" ECU_ADDRESS 0x50006458 /end MEASUREMENT
/begin MEASUREMENT ComM_ChannelStruct[2].MinFullComTimeoutCtr_u16 "ComM Channel structure[2]/" UWORD RB_RBA_Common_CentralElements_CompuMethods_Identical 1 100 0.0 65535. FORMAT "%5.0" ECU_ADDRESS 0x50006470 /end MEASUREMENT
/begin MEASUREMENT ComM_ChannelStruct[3].MinFullComTimeoutCtr_u16 "ComM Channel structure[3]/" UWORD RB_RBA_Common_CentralElements_CompuMethods_Identical 1 100 0.0 65535. FORMAT "%5.0" ECU_ADDRESS 0x50006488 /end MEASUREMENT
/begin MEASUREMENT ComM_ChannelStruct[0].UserRequestCtr_u16 "ComM Channel structure[0]/" UWORD RB_RBA_Common_CentralElements_CompuMethods_Identical 1 100 0.0 65535. FORMAT "%5.0" ECU_ADDRESS 0x50006442 /end MEASUREMENT
/begin MEASUREMENT ComM_ChannelStruct[1].UserRequestCtr_u16 "ComM Channel structure[1]/" UWORD RB_RBA_Common_CentralElements_CompuMethods_Identical 1 100 0.0 65535. FORMAT "%5.0" ECU_ADDRESS 0x5000645A /end MEASUREMENT
/begin MEASUREMENT ComM_ChannelStruct[2].UserRequestCtr_u16 "ComM Channel structure[2]/" UWORD RB_RBA_Common_CentralElements_CompuMethods_Identical 1 100 0.0 65535. FORMAT "%5.0" ECU_ADDRESS 0x50006472 /end MEASUREMENT
/begin MEASUREMENT ComM_ChannelStruct[3].UserRequestCtr_u16 "ComM Channel structure[3]/" UWORD RB_RBA_Common_CentralElements_CompuMethods_Identical 1 100 0.0 65535. FORMAT "%5.0" ECU_ADDRESS 0x5000648A /end MEASUREMENT
/begin MEASUREMENT ComM_ChannelStruct[0].ChannelMode_u8 "ComM Channel structure[0]/" UBYTE RB_RBA_Common_CentralElements_CompuMethods_Identical 1 100 0.0 255. FORMAT "%5.0" ECU_ADDRESS 0x50006444 /end MEASUREMENT
/begin MEASUREMENT ComM_ChannelStruct[1].ChannelMode_u8 "ComM Channel structure[1]/" UBYTE RB_RBA_Common_CentralElements_CompuMethods_Identical 1 100 0.0 255. FORMAT "%5.0" ECU_ADDRESS 0x5000645C /end MEASUREMENT
/begin MEASUREMENT ComM_ChannelStruct[2].ChannelMode_u8 "ComM Channel structure[2]/" UBYTE RB_RBA_Common_CentralElements_CompuMethods_Identical 1 100 0.0 255. FORMAT "%5.0" ECU_ADDRESS 0x50006474 /end MEASUREMENT
/begin MEASUREMENT ComM_ChannelStruct[3].ChannelMode_u8 "ComM Channel structure[3]/" UBYTE RB_RBA_Common_CentralElements_CompuMethods_Identical 1 100 0.0 255. FORMAT "%5.0" ECU_ADDRESS 0x5000648C /end MEASUREMENT
/begin MEASUREMENT ComM_ChannelStruct[0].BusSmMode_u8 "ComM Channel structure[0]/" UBYTE RB_RBA_Common_CentralElements_CompuMethods_Identical 1 100 0.0 255. FORMAT "%5.0" ECU_ADDRESS 0x50006445 /end MEASUREMENT
/begin MEASUREMENT ComM_ChannelStruct[1].BusSmMode_u8 "ComM Channel structure[1]/" UBYTE RB_RBA_Common_CentralElements_CompuMethods_Identical 1 100 0.0 255. FORMAT "%5.0" ECU_ADDRESS 0x5000645D /end MEASUREMENT
/begin MEASUREMENT ComM_ChannelStruct[2].BusSmMode_u8 "ComM Channel structure[2]/" UBYTE RB_RBA_Common_CentralElements_CompuMethods_Identical 1 100 0.0 255. FORMAT "%5.0" ECU_ADDRESS 0x50006475 /end MEASUREMENT
/begin MEASUREMENT ComM_ChannelStruct[3].BusSmMode_u8 "ComM Channel structure[3]/" UBYTE RB_RBA_Common_CentralElements_CompuMethods_Identical 1 100 0.0 255. FORMAT "%5.0" ECU_ADDRESS 0x5000648D /end MEASUREMENT
/begin MEASUREMENT ComM_ChannelStruct[0].PassiveRequestState_u8 "ComM Channel structure[0]/" UBYTE RB_RBA_Common_CentralElements_CompuMethods_Identical 1 100 0.0 255. FORMAT "%5.0" ECU_ADDRESS 0x50006446 /end MEASUREMENT
/begin MEASUREMENT ComM_ChannelStruct[1].PassiveRequestState_u8 "ComM Channel structure[1]/" UBYTE RB_RBA_Common_CentralElements_CompuMethods_Identical 1 100 0.0 255. FORMAT "%5.0" ECU_ADDRESS 0x5000645E /end MEASUREMENT
/begin MEASUREMENT ComM_ChannelStruct[2].PassiveRequestState_u8 "ComM Channel structure[2]/" UBYTE RB_RBA_Common_CentralElements_CompuMethods_Identical 1 100 0.0 255. FORMAT "%5.0" ECU_ADDRESS 0x50006476 /end MEASUREMENT
/begin MEASUREMENT ComM_ChannelStruct[3].PassiveRequestState_u8 "ComM Channel structure[3]/" UBYTE RB_RBA_Common_CentralElements_CompuMethods_Identical 1 100 0.0 255. FORMAT "%5.0" ECU_ADDRESS 0x5000648E /end MEASUREMENT
/begin MEASUREMENT ComM_ChannelStruct[0].PncRequestCtr_u8 "ComM Channel structure[0]/" UBYTE RB_RBA_Common_CentralElements_CompuMethods_Identical 1 100 0.0 255. FORMAT "%5.0" ECU_ADDRESS 0x50006447 /end MEASUREMENT
/begin MEASUREMENT ComM_ChannelStruct[1].PncRequestCtr_u8 "ComM Channel structure[1]/" UBYTE RB_RBA_Common_CentralElements_CompuMethods_Identical 1 100 0.0 255. FORMAT "%5.0" ECU_ADDRESS 0x5000645F /end MEASUREMENT
/begin MEASUREMENT ComM_ChannelStruct[2].PncRequestCtr_u8 "ComM Channel structure[2]/" UBYTE RB_RBA_Common_CentralElements_CompuMethods_Identical 1 100 0.0 255. FORMAT "%5.0" ECU_ADDRESS 0x50006477 /end MEASUREMENT
/begin MEASUREMENT ComM_ChannelStruct[3].PncRequestCtr_u8 "ComM Channel structure[3]/" UBYTE RB_RBA_Common_CentralElements_CompuMethods_Identical 1 100 0.0 255. FORMAT "%5.0" ECU_ADDRESS 0x5000648F /end MEASUREMENT
/begin MEASUREMENT ComM_ChannelStruct[0].InhibitionReqStatus_u8 "ComM Channel structure[0]/" UBYTE RB_RBA_Common_CentralElements_CompuMethods_Identical 1 100 0.0 255. FORMAT "%5.0" ECU_ADDRESS 0x50006448 /end MEASUREMENT
/begin MEASUREMENT ComM_ChannelStruct[1].InhibitionReqStatus_u8 "ComM Channel structure[1]/" UBYTE RB_RBA_Common_CentralElements_CompuMethods_Identical 1 100 0.0 255. FORMAT "%5.0" ECU_ADDRESS 0x50006460 /end MEASUREMENT
/begin MEASUREMENT ComM_ChannelStruct[2].InhibitionReqStatus_u8 "ComM Channel structure[2]/" UBYTE RB_RBA_Common_CentralElements_CompuMethods_Identical 1 100 0.0 255. FORMAT "%5.0" ECU_ADDRESS 0x50006478 /end MEASUREMENT
/begin MEASUREMENT ComM_ChannelStruct[3].InhibitionReqStatus_u8 "ComM Channel structure[3]/" UBYTE RB_RBA_Common_CentralElements_CompuMethods_Identical 1 100 0.0 255. FORMAT "%5.0" ECU_ADDRESS 0x50006490 /end MEASUREMENT
/begin MEASUREMENT ComM_ChannelStruct[0].NmNetworkRequestStatus_b "ComM Channel structure[0]/" UBYTE RB_RBA_Common_CentralElements_CompuMethods_Identical 1 100 0.0 255. FORMAT "%5.0" ECU_ADDRESS 0x50006449 /end MEASUREMENT
/begin MEASUREMENT ComM_ChannelStruct[1].NmNetworkRequestStatus_b "ComM Channel structure[1]/" UBYTE RB_RBA_Common_CentralElements_CompuMethods_Identical 1 100 0.0 255. FORMAT "%5.0" ECU_ADDRESS 0x50006461 /end MEASUREMENT
/begin MEASUREMENT ComM_ChannelStruct[2].NmNetworkRequestStatus_b "ComM Channel structure[2]/" UBYTE RB_RBA_Common_CentralElements_CompuMethods_Identical 1 100 0.0 255. FORMAT "%5.0" ECU_ADDRESS 0x50006479 /end MEASUREMENT
/begin MEASUREMENT ComM_ChannelStruct[3].NmNetworkRequestStatus_b "ComM Channel structure[3]/" UBYTE RB_RBA_Common_CentralElements_CompuMethods_Identical 1 100 0.0 255. FORMAT "%5.0" ECU_ADDRESS 0x50006491 /end MEASUREMENT
/begin MEASUREMENT ComM_ChannelStruct[0].DiagnosticRequestState_b "ComM Channel structure[0]/" UBYTE RB_RBA_Common_CentralElements_CompuMethods_Identical 1 100 0.0 255. FORMAT "%5.0" ECU_ADDRESS 0x5000644A /end MEASUREMENT
/begin MEASUREMENT ComM_ChannelStruct[1].DiagnosticRequestState_b "ComM Channel structure[1]/" UBYTE RB_RBA_Common_CentralElements_CompuMethods_Identical 1 100 0.0 255. FORMAT "%5.0" ECU_ADDRESS 0x50006462 /end MEASUREMENT
/begin MEASUREMENT ComM_ChannelStruct[2].DiagnosticRequestState_b "ComM Channel structure[2]/" UBYTE RB_RBA_Common_CentralElements_CompuMethods_Identical 1 100 0.0 255. FORMAT "%5.0" ECU_ADDRESS 0x5000647A /end MEASUREMENT
/begin MEASUREMENT ComM_ChannelStruct[3].DiagnosticRequestState_b "ComM Channel structure[3]/" UBYTE RB_RBA_Common_CentralElements_CompuMethods_Identical 1 100 0.0 255. FORMAT "%5.0" ECU_ADDRESS 0x50006492 /end MEASUREMENT
/begin MEASUREMENT ComM_ChannelStruct[0].CommunicationAllowed_b "ComM Channel structure[0]/" UBYTE RB_RBA_Common_CentralElements_CompuMethods_Identical 1 100 0.0 255. FORMAT "%5.0" ECU_ADDRESS 0x5000644B /end MEASUREMENT
/begin MEASUREMENT ComM_ChannelStruct[1].CommunicationAllowed_b "ComM Channel structure[1]/" UBYTE RB_RBA_Common_CentralElements_CompuMethods_Identical 1 100 0.0 255. FORMAT "%5.0" ECU_ADDRESS 0x50006463 /end MEASUREMENT
/begin MEASUREMENT ComM_ChannelStruct[2].CommunicationAllowed_b "ComM Channel structure[2]/" UBYTE RB_RBA_Common_CentralElements_CompuMethods_Identical 1 100 0.0 255. FORMAT "%5.0" ECU_ADDRESS 0x5000647B /end MEASUREMENT
/begin MEASUREMENT ComM_ChannelStruct[3].CommunicationAllowed_b "ComM Channel structure[3]/" UBYTE RB_RBA_Common_CentralElements_CompuMethods_Identical 1 100 0.0 255. FORMAT "%5.0" ECU_ADDRESS 0x50006493 /end MEASUREMENT
/begin MEASUREMENT ComM_ChannelStruct[0].NmBusSleepIndicationStatus_b "ComM Channel structure[0]/" UBYTE RB_RBA_Common_CentralElements_CompuMethods_Identical 1 100 0.0 255. FORMAT "%5.0" ECU_ADDRESS 0x5000644C /end MEASUREMENT
/begin MEASUREMENT ComM_ChannelStruct[1].NmBusSleepIndicationStatus_b "ComM Channel structure[1]/" UBYTE RB_RBA_Common_CentralElements_CompuMethods_Identical 1 100 0.0 255. FORMAT "%5.0" ECU_ADDRESS 0x50006464 /end MEASUREMENT
/begin MEASUREMENT ComM_ChannelStruct[2].NmBusSleepIndicationStatus_b "ComM Channel structure[2]/" UBYTE RB_RBA_Common_CentralElements_CompuMethods_Identical 1 100 0.0 255. FORMAT "%5.0" ECU_ADDRESS 0x5000647C /end MEASUREMENT
/begin MEASUREMENT ComM_ChannelStruct[3].NmBusSleepIndicationStatus_b "ComM Channel structure[3]/" UBYTE RB_RBA_Common_CentralElements_CompuMethods_Identical 1 100 0.0 255. FORMAT "%5.0" ECU_ADDRESS 0x50006494 /end MEASUREMENT
/begin MEASUREMENT ComM_ChannelStruct[0].NmPrepareBusSleepIndicationStatus_b "ComM Channel structure[0]/" UBYTE RB_RBA_Common_CentralElements_CompuMethods_Identical 1 100 0.0 255. FORMAT "%5.0" ECU_ADDRESS 0x5000644D /end MEASUREMENT
/begin MEASUREMENT ComM_ChannelStruct[1].NmPrepareBusSleepIndicationStatus_b "ComM Channel structure[1]/" UBYTE RB_RBA_Common_CentralElements_CompuMethods_Identical 1 100 0.0 255. FORMAT "%5.0" ECU_ADDRESS 0x50006465 /end MEASUREMENT
/begin MEASUREMENT ComM_ChannelStruct[2].NmPrepareBusSleepIndicationStatus_b "ComM Channel structure[2]/" UBYTE RB_RBA_Common_CentralElements_CompuMethods_Identical 1 100 0.0 255. FORMAT "%5.0" ECU_ADDRESS 0x5000647D /end MEASUREMENT
/begin MEASUREMENT ComM_ChannelStruct[3].NmPrepareBusSleepIndicationStatus_b "ComM Channel structure[3]/" UBYTE RB_RBA_Common_CentralElements_CompuMethods_Identical 1 100 0.0 255. FORMAT "%5.0" ECU_ADDRESS 0x50006495 /end MEASUREMENT
/begin MEASUREMENT ComM_ChannelStruct[0].NmNetworkModeStatus_b "ComM Channel structure[0]/" UBYTE RB_RBA_Common_CentralElements_CompuMethods_Identical 1 100 0.0 255. FORMAT "%5.0" ECU_ADDRESS 0x5000644E /end MEASUREMENT
/begin MEASUREMENT ComM_ChannelStruct[1].NmNetworkModeStatus_b "ComM Channel structure[1]/" UBYTE RB_RBA_Common_CentralElements_CompuMethods_Identical 1 100 0.0 255. FORMAT "%5.0" ECU_ADDRESS 0x50006466 /end MEASUREMENT
/begin MEASUREMENT ComM_ChannelStruct[2].NmNetworkModeStatus_b "ComM Channel structure[2]/" UBYTE RB_RBA_Common_CentralElements_CompuMethods_Identical 1 100 0.0 255. FORMAT "%5.0" ECU_ADDRESS 0x5000647E /end MEASUREMENT
/begin MEASUREMENT ComM_ChannelStruct[3].NmNetworkModeStatus_b "ComM Channel structure[3]/" UBYTE RB_RBA_Common_CentralElements_CompuMethods_Identical 1 100 0.0 255. FORMAT "%5.0" ECU_ADDRESS 0x50006496 /end MEASUREMENT
/begin MEASUREMENT ComM_UserStruct[0].WakeUpInhibitionCtr_u16 "ComM user structure[0]/" UWORD RB_RBA_Common_CentralElements_CompuMethods_Identical 1 100 0.0 65535. FORMAT "%5.0" ECU_ADDRESS 0x5000649C /end MEASUREMENT
/begin MEASUREMENT ComM_UserStruct[1].WakeUpInhibitionCtr_u16 "ComM user structure[1]/" UWORD RB_RBA_Common_CentralElements_CompuMethods_Identical 1 100 0.0 65535. FORMAT "%5.0" ECU_ADDRESS 0x500064A6 /end MEASUREMENT
/begin MEASUREMENT ComM_UserStruct[2].WakeUpInhibitionCtr_u16 "ComM user structure[2]/" UWORD RB_RBA_Common_CentralElements_CompuMethods_Identical 1 100 0.0 65535. FORMAT "%5.0" ECU_ADDRESS 0x500064B0 /end MEASUREMENT
/begin MEASUREMENT ComM_UserStruct[3].WakeUpInhibitionCtr_u16 "ComM user structure[3]/" UWORD RB_RBA_Common_CentralElements_CompuMethods_Identical 1 100 0.0 65535. FORMAT "%5.0" ECU_ADDRESS 0x500064BA /end MEASUREMENT
/begin MEASUREMENT ComM_UserStruct[4].WakeUpInhibitionCtr_u16 "ComM user structure[4]/" UWORD RB_RBA_Common_CentralElements_CompuMethods_Identical 1 100 0.0 65535. FORMAT "%5.0" ECU_ADDRESS 0x500064C4 /end MEASUREMENT
/begin MEASUREMENT ComM_UserStruct[0].LimitToNoComCtr_u16 "ComM user structure[0]/" UWORD RB_RBA_Common_CentralElements_CompuMethods_Identical 1 100 0.0 65535. FORMAT "%5.0" ECU_ADDRESS 0x5000649E /end MEASUREMENT
/begin MEASUREMENT ComM_UserStruct[1].LimitToNoComCtr_u16 "ComM user structure[1]/" UWORD RB_RBA_Common_CentralElements_CompuMethods_Identical 1 100 0.0 65535. FORMAT "%5.0" ECU_ADDRESS 0x500064A8 /end MEASUREMENT
/begin MEASUREMENT ComM_UserStruct[2].LimitToNoComCtr_u16 "ComM user structure[2]/" UWORD RB_RBA_Common_CentralElements_CompuMethods_Identical 1 100 0.0 65535. FORMAT "%5.0" ECU_ADDRESS 0x500064B2 /end MEASUREMENT
/begin MEASUREMENT ComM_UserStruct[3].LimitToNoComCtr_u16 "ComM user structure[3]/" UWORD RB_RBA_Common_CentralElements_CompuMethods_Identical 1 100 0.0 65535. FORMAT "%5.0" ECU_ADDRESS 0x500064BC /end MEASUREMENT
/begin MEASUREMENT ComM_UserStruct[4].LimitToNoComCtr_u16 "ComM user structure[4]/" UWORD RB_RBA_Common_CentralElements_CompuMethods_Identical 1 100 0.0 65535. FORMAT "%5.0" ECU_ADDRESS 0x500064C6 /end MEASUREMENT
/begin MEASUREMENT ComM_UserStruct[0].RequestedUserMode_u8 "ComM user structure[0]/" UBYTE RB_RBA_Common_CentralElements_CompuMethods_Identical 1 100 0.0 255. FORMAT "%5.0" ECU_ADDRESS 0x500064A0 /end MEASUREMENT
/begin MEASUREMENT ComM_UserStruct[1].RequestedUserMode_u8 "ComM user structure[1]/" UBYTE RB_RBA_Common_CentralElements_CompuMethods_Identical 1 100 0.0 255. FORMAT "%5.0" ECU_ADDRESS 0x500064AA /end MEASUREMENT
/begin MEASUREMENT ComM_UserStruct[2].RequestedUserMode_u8 "ComM user structure[2]/" UBYTE RB_RBA_Common_CentralElements_CompuMethods_Identical 1 100 0.0 255. FORMAT "%5.0" ECU_ADDRESS 0x500064B4 /end MEASUREMENT
/begin MEASUREMENT ComM_UserStruct[3].RequestedUserMode_u8 "ComM user structure[3]/" UBYTE RB_RBA_Common_CentralElements_CompuMethods_Identical 1 100 0.0 255. FORMAT "%5.0" ECU_ADDRESS 0x500064BE /end MEASUREMENT
/begin MEASUREMENT ComM_UserStruct[4].RequestedUserMode_u8 "ComM user structure[4]/" UBYTE RB_RBA_Common_CentralElements_CompuMethods_Identical 1 100 0.0 255. FORMAT "%5.0" ECU_ADDRESS 0x500064C8 /end MEASUREMENT
/begin MEASUREMENT ComM_UserStruct[0].IndicatedUserMode_u8 "ComM user structure[0]/" UBYTE RB_RBA_Common_CentralElements_CompuMethods_Identical 1 100 0.0 255. FORMAT "%5.0" ECU_ADDRESS 0x500064A1 /end MEASUREMENT
/begin MEASUREMENT ComM_UserStruct[1].IndicatedUserMode_u8 "ComM user structure[1]/" UBYTE RB_RBA_Common_CentralElements_CompuMethods_Identical 1 100 0.0 255. FORMAT "%5.0" ECU_ADDRESS 0x500064AB /end MEASUREMENT
/begin MEASUREMENT ComM_UserStruct[2].IndicatedUserMode_u8 "ComM user structure[2]/" UBYTE RB_RBA_Common_CentralElements_CompuMethods_Identical 1 100 0.0 255. FORMAT "%5.0" ECU_ADDRESS 0x500064B5 /end MEASUREMENT
/begin MEASUREMENT ComM_UserStruct[3].IndicatedUserMode_u8 "ComM user structure[3]/" UBYTE RB_RBA_Common_CentralElements_CompuMethods_Identical 1 100 0.0 255. FORMAT "%5.0" ECU_ADDRESS 0x500064BF /end MEASUREMENT
/begin MEASUREMENT ComM_UserStruct[4].IndicatedUserMode_u8 "ComM user structure[4]/" UBYTE RB_RBA_Common_CentralElements_CompuMethods_Identical 1 100 0.0 255. FORMAT "%5.0" ECU_ADDRESS 0x500064C9 /end MEASUREMENT
/begin MEASUREMENT ComM_UserStruct[0].numChannelsInFullCom_u8 "ComM user structure[0]/" UBYTE RB_RBA_Common_CentralElements_CompuMethods_Identical 1 100 0.0 255. FORMAT "%5.0" ECU_ADDRESS 0x500064A2 /end MEASUREMENT
/begin MEASUREMENT ComM_UserStruct[1].numChannelsInFullCom_u8 "ComM user structure[1]/" UBYTE RB_RBA_Common_CentralElements_CompuMethods_Identical 1 100 0.0 255. FORMAT "%5.0" ECU_ADDRESS 0x500064AC /end MEASUREMENT
/begin MEASUREMENT ComM_UserStruct[2].numChannelsInFullCom_u8 "ComM user structure[2]/" UBYTE RB_RBA_Common_CentralElements_CompuMethods_Identical 1 100 0.0 255. FORMAT "%5.0" ECU_ADDRESS 0x500064B6 /end MEASUREMENT
/begin MEASUREMENT ComM_UserStruct[3].numChannelsInFullCom_u8 "ComM user structure[3]/" UBYTE RB_RBA_Common_CentralElements_CompuMethods_Identical 1 100 0.0 255. FORMAT "%5.0" ECU_ADDRESS 0x500064C0 /end MEASUREMENT
/begin MEASUREMENT ComM_UserStruct[4].numChannelsInFullCom_u8 "ComM user structure[4]/" UBYTE RB_RBA_Common_CentralElements_CompuMethods_Identical 1 100 0.0 255. FORMAT "%5.0" ECU_ADDRESS 0x500064CA /end MEASUREMENT
/begin MEASUREMENT ComM_UserStruct[0].numChannelsInSilentCom_u8 "ComM user structure[0]/" UBYTE RB_RBA_Common_CentralElements_CompuMethods_Identical 1 100 0.0 255. FORMAT "%5.0" ECU_ADDRESS 0x500064A3 /end MEASUREMENT
/begin MEASUREMENT ComM_UserStruct[1].numChannelsInSilentCom_u8 "ComM user structure[1]/" UBYTE RB_RBA_Common_CentralElements_CompuMethods_Identical 1 100 0.0 255. FORMAT "%5.0" ECU_ADDRESS 0x500064AD /end MEASUREMENT
/begin MEASUREMENT ComM_UserStruct[2].numChannelsInSilentCom_u8 "ComM user structure[2]/" UBYTE RB_RBA_Common_CentralElements_CompuMethods_Identical 1 100 0.0 255. FORMAT "%5.0" ECU_ADDRESS 0x500064B7 /end MEASUREMENT
/begin MEASUREMENT ComM_UserStruct[3].numChannelsInSilentCom_u8 "ComM user structure[3]/" UBYTE RB_RBA_Common_CentralElements_CompuMethods_Identical 1 100 0.0 255. FORMAT "%5.0" ECU_ADDRESS 0x500064C1 /end MEASUREMENT
/begin MEASUREMENT ComM_UserStruct[4].numChannelsInSilentCom_u8 "ComM user structure[4]/" UBYTE RB_RBA_Common_CentralElements_CompuMethods_Identical 1 100 0.0 255. FORMAT "%5.0" ECU_ADDRESS 0x500064CB /end MEASUREMENT
/begin MEASUREMENT ComM_UserStruct[0].numChannelsInNoCom_u8 "ComM user structure[0]/" UBYTE RB_RBA_Common_CentralElements_CompuMethods_Identical 1 100 0.0 255. FORMAT "%5.0" ECU_ADDRESS 0x500064A4 /end MEASUREMENT
/begin MEASUREMENT ComM_UserStruct[1].numChannelsInNoCom_u8 "ComM user structure[1]/" UBYTE RB_RBA_Common_CentralElements_CompuMethods_Identical 1 100 0.0 255. FORMAT "%5.0" ECU_ADDRESS 0x500064AE /end MEASUREMENT
/begin MEASUREMENT ComM_UserStruct[2].numChannelsInNoCom_u8 "ComM user structure[2]/" UBYTE RB_RBA_Common_CentralElements_CompuMethods_Identical 1 100 0.0 255. FORMAT "%5.0" ECU_ADDRESS 0x500064B8 /end MEASUREMENT
/begin MEASUREMENT ComM_UserStruct[3].numChannelsInNoCom_u8 "ComM user structure[3]/" UBYTE RB_RBA_Common_CentralElements_CompuMethods_Identical 1 100 0.0 255. FORMAT "%5.0" ECU_ADDRESS 0x500064C2 /end MEASUREMENT
/begin MEASUREMENT ComM_UserStruct[4].numChannelsInNoCom_u8 "ComM user structure[4]/" UBYTE RB_RBA_Common_CentralElements_CompuMethods_Identical 1 100 0.0 255. FORMAT "%5.0" ECU_ADDRESS 0x500064CC /end MEASUREMENT
/begin MEASUREMENT Fee_SecChngCnt_u32 "Current Sector Change Counter of the Flash EEPROM Emulation" ULONG RB_RBA_rba_MemLib_CompuMethods_Mem_Identical 1 100 0.0 1.7E7 FORMAT "%5.1" ECU_ADDRESS 0x60003B50 /end MEASUREMENT
/begin MEASUREMENT Lin_ChnlVar_MP[0].Status "Lin Channel context information which provides the status of individual frames[0]/" UBYTE AUTOSAR_Lin_CompuMethods_Lin_Enum_Status_type 1 100 0.0 10. FORMAT "%5.0" ECU_ADDRESS 0x60014B14 /end MEASUREMENT
/begin MEASUREMENT Lin_ChnlVar_MP[0].Length "Lin Channel context information which provides the status of individual frames[0]/" UBYTE RB_RBA_Common_CentralElements_CompuMethods_Identical 1 100 0.0 255. FORMAT "%5.0" ECU_ADDRESS 0x60014B15 /end MEASUREMENT
/begin MEASUREMENT Lin_ChnlVar_MP[0].CSmodel "Lin Channel context information which provides the status of individual frames[0]/" UBYTE AUTOSAR_Lin_CompuMethods_Lin_Enum_CheckSum_Type 1 100 0.0 1. FORMAT "%5.0" ECU_ADDRESS 0x60014B16 /end MEASUREMENT
/begin MEASUREMENT Lin_ChnlVar_MP[0].GotoSleepCtr "Lin Channel context information which provides the status of individual frames[0]/" UBYTE AUTOSAR_Lin_CompuMethods_Lin_Enum_FrameRespType 1 100 0.0 3. FORMAT "%5.0" ECU_ADDRESS 0x60014B19 /end MEASUREMENT
/begin MEASUREMENT Lin_ChnlVar_MP[0].FrameType "Lin Channel context information which provides the status of individual frames[0]/" UBYTE RB_RBA_Common_CentralElements_CompuMethods_Identical 1 100 0.0 255. FORMAT "%5.0" ECU_ADDRESS 0x60014B17 /end MEASUREMENT
/begin MEASUREMENT Lin_ChnlVar_MP[0].FramePid "Lin Channel context information which provides the status of individual frames[0]/" UBYTE AUTOSAR_Lin_CompuMethods_Lin_Enum_ChannelStateType 1 100 0.0 7. FORMAT "%5.0" ECU_ADDRESS 0x60014B1A /end MEASUREMENT
/begin MEASUREMENT Lin_ChnlVar_MP[0].ChannelState "Lin Channel context information which provides the status of individual frames[0]/" UBYTE RB_RBA_Common_CentralElements_CompuMethods_Identical 1 100 0.0 255. FORMAT "%5.0" ECU_ADDRESS 0x60014B18 /end MEASUREMENT
/begin MEASUREMENT Lin_ChnlVar_MP[0].Lin_Buf_au8 "Lin Channel context information which provides the status of individual frames[0]/" UBYTE RB_RBA_Common_CentralElements_CompuMethods_Identical 1 100 0.0 255. FORMAT "%5.0" ARRAY_SIZE 8 ECU_ADDRESS 0x60014B1B /end MEASUREMENT
/begin MEASUREMENT Lin_DrvFlags_MP "Lin driver state i.e TRUE (Iinitilased) FALSE (Uninitialised)" UBYTE RB_RBA_Common_CentralElements_CompuMethods_Identical 1 100 0.0 1. FORMAT "%5.0" ECU_ADDRESS 0x60000B66 /end MEASUREMENT
/begin MEASUREMENT LinIf_ChnlVar_as[0].ChannelStateFlag_u8 "Lin Interface channel status structure[0]/" UBYTE RB_RBA_Common_CentralElements_CompuMethods_Identical 1 100 0.0 255. FORMAT "%5.0" ECU_ADDRESS 0x50006614 /end MEASUREMENT
/begin MEASUREMENT LinIf_ChnlVar_as[0].ChannelStatusFlags_u8 "Lin Interface channel status structure[0]/" UBYTE RB_RBA_Common_CentralElements_CompuMethods_Identical 1 100 0.0 255. FORMAT "%5.0" ECU_ADDRESS 0x50006615 /end MEASUREMENT
/begin MEASUREMENT LinIf_ChnlVar_as[0].DelayCount_u8 "Lin Interface channel status structure[0]/" UBYTE RB_RBA_Common_CentralElements_CompuMethods_Identical 1 100 0.0 255. FORMAT "%5.0" ECU_ADDRESS 0x50006616 /end MEASUREMENT
/begin MEASUREMENT LinIf_ChnlVar_as[0].CurrentScheduleTable_u8 "Lin Interface channel status structure[0]/" UBYTE RB_RBA_Common_CentralElements_CompuMethods_Identical 1 100 0.0 255. FORMAT "%5.0" ECU_ADDRESS 0x50006617 /end MEASUREMENT
/begin MEASUREMENT LinIf_ChnlVar_as[0].CurrentIndex_u8 "Lin Interface channel status structure[0]/" UBYTE RB_RBA_Common_CentralElements_CompuMethods_Identical 1 100 0.0 255. FORMAT "%5.0" ECU_ADDRESS 0x50006619 /end MEASUREMENT
/begin MEASUREMENT LinIf_ChnlVar_as[0].SavedScheduleTable_u8 "Lin Interface channel status structure[0]/" UBYTE RB_RBA_Common_CentralElements_CompuMethods_Identical 1 100 0.0 255. FORMAT "%5.0" ECU_ADDRESS 0x5000661A /end MEASUREMENT
/begin MEASUREMENT LinIf_ChnlVar_as[0].SavedIndex_u8 "Lin Interface channel status structure[0]/" UBYTE RB_RBA_Common_CentralElements_CompuMethods_Identical 1 100 0.0 255. FORMAT "%5.0" ECU_ADDRESS 0x5000661B /end MEASUREMENT
/begin MEASUREMENT LinIf_ChnlVar_as[0].Temp_SpoFrmCount_u8 "Lin Interface channel status structure[0]/" UBYTE RB_RBA_Common_CentralElements_CompuMethods_Identical 1 100 0.0 255. FORMAT "%5.0" ECU_ADDRESS 0x5000661C /end MEASUREMENT
/begin MEASUREMENT LinIf_ChnlVar_as[0].SpoETIndex_u8 "Lin Interface channel status structure[0]/" UBYTE RB_RBA_Common_CentralElements_CompuMethods_Identical 1 100 0.0 255. FORMAT "%5.0" ECU_ADDRESS 0x5000661D /end MEASUREMENT
/begin MEASUREMENT LinIf_ChnlVar_as[0].Wakeup_u8 "Lin Interface channel status structure[0]/" UBYTE RB_RBA_Common_CentralElements_CompuMethods_Identical 1 100 0.0 255. FORMAT "%5.0" ECU_ADDRESS 0x50006620 /end MEASUREMENT
/begin MEASUREMENT LinIf_ChnlVar_as[0].TransmitSRF_u8 "Lin Interface channel status structure[0]/" UBYTE RB_RBA_Common_CentralElements_CompuMethods_Identical 1 100 0.0 255. FORMAT "%5.0" ECU_ADDRESS 0x50006623 /end MEASUREMENT
/begin MEASUREMENT LinIf_ChnlVar_as[0].SlpGetStatus_u8 "Lin Interface channel status structure[0]/" UBYTE RB_RBA_Common_CentralElements_CompuMethods_Identical 1 100 0.0 255. FORMAT "%5.0" ECU_ADDRESS 0x50006624 /end MEASUREMENT
/begin MEASUREMENT LinIf_ChnlVar_as[0].NewScheduleTable_u8 "Lin Interface channel status structure[0]/" UBYTE RB_RBA_Common_CentralElements_CompuMethods_Identical 1 100 0.0 255. FORMAT "%5.0" ECU_ADDRESS 0x50006618 /end MEASUREMENT
/begin MEASUREMENT LinIf_ChnlVar_as[0].GotoSleepCtr "Lin Interface channel status structure[0]/" UBYTE RB_RBA_Common_CentralElements_CompuMethods_Identical 1 100 0.0 255. FORMAT "%5.0" ECU_ADDRESS 0x5000661F /end MEASUREMENT
/begin MEASUREMENT LinIf_Status_u8 "Lin Interface status variable" UBYTE RB_RBA_Common_CentralElements_CompuMethods_Identical 1 100 0.0 255. FORMAT "%5.0" ECU_ADDRESS 0x60012D4B /end MEASUREMENT
/begin MEASUREMENT LinSM_ModeRepeatReq_Max_u8 "Maximum Tries for Same Mode Request Possible in LinSM" UBYTE RB_RBA_Common_CentralElements_CompuMethods_Identical 1 100 0.0 255. FORMAT "%5.0" ECU_ADDRESS 0x60010CA9 /end MEASUREMENT
/begin MEASUREMENT LinSM_RamVar_ast[0].ChnlState "LinSM type variable[0]/" UBYTE AUTOSAR_LinSM_CompuMethods_LinSM_CompuMethod_OperationalMode 1 100 0.0 255. FORMAT "%5.0" ECU_ADDRESS 0x50006638 /end MEASUREMENT
/begin MEASUREMENT LinSM_RamVar_ast[0].TimeOutCounter "LinSM type variable[0]/" ULONG RB_RBA_Common_CentralElements_CompuMethods_Identical 1 100 0.0 4.E9 FORMAT "%5.0" ECU_ADDRESS 0x5000663C /end MEASUREMENT
/begin MEASUREMENT LinSM_RamVar_ast[0].TimeoutFlag "LinSM type variable[0]/" UBYTE RB_RBA_Common_CentralElements_CompuMethods_Identical 1 100 0.0 255. FORMAT "%5.0" ECU_ADDRESS 0x50006640 /end MEASUREMENT
/begin MEASUREMENT LinSM_RamVar_ast[0].StoredSchdTab "LinSM type variable[0]/" UBYTE RB_RBA_Common_CentralElements_CompuMethods_Identical 1 100 0.0 255. FORMAT "%5.0" ECU_ADDRESS 0x50006641 /end MEASUREMENT
/begin MEASUREMENT LinSM_RamVar_ast[0].LinSm_SchdReq_E_NOT_OK "LinSM type variable[0]/" UBYTE RB_RBA_Common_CentralElements_CompuMethods_Identical 1 100 0.0 255. FORMAT "%5.0" ECU_ADDRESS 0x50006642 /end MEASUREMENT
/begin MEASUREMENT LinSM_RamVar_ast[0].LinSm_Conf_Status "LinSM type variable[0]/" UBYTE RB_RBA_Common_CentralElements_CompuMethods_Identical 1 100 0.0 255. FORMAT "%5.0" ECU_ADDRESS 0x50006643 /end MEASUREMENT
/begin MEASUREMENT LinSM_RamVar_ast[0].LinSm_Request_Status "LinSM type variable[0]/" UBYTE RB_RBA_Common_CentralElements_CompuMethods_Identical 1 100 0.0 255. FORMAT "%5.0" ECU_ADDRESS 0x50006644 /end MEASUREMENT
/begin MEASUREMENT LinSM_RamVar_ast[0].LinSm_Sleep_Status "LinSM type variable[0]/" UBYTE RB_RBA_Common_CentralElements_CompuMethods_Identical 1 100 0.0 255. FORMAT "%5.0" ECU_ADDRESS 0x50006645 /end MEASUREMENT
/begin MEASUREMENT LinSM_RamVar_ast[0].LinSmModReqRepMax "LinSM type variable[0]/" UBYTE RB_RBA_Common_CentralElements_CompuMethods_Identical 1 100 0.0 255. FORMAT "%5.0" ECU_ADDRESS 0x50006646 /end MEASUREMENT
/begin MEASUREMENT LinSM_State_en "State variable of LINSM" UBYTE RB_RBA_Common_CentralElements_CompuMethods_Identical 1 100 0.0 255. FORMAT "%5.0" ECU_ADDRESS 0x60012D54 /end MEASUREMENT
/begin MEASUREMENT PduR_State "State information of Pdur module" UBYTE RB_RBA_Common_CentralElements_CompuMethods_Identical 1 100 0.0 255. FORMAT "%5.0" ECU_ADDRESS 0x70005538 /end MEASUREMENT
/begin MEASUREMENT ComScl_Bdy_RawSignal_PCU_ALIVE_COUNTER_45B_u8 "NetworkSignal ComScl_Bdy_RawSignal_PCU_ALIVE_COUNTER_45B_u8" UBYTE RB_RBA_Common_CentralElements_CompuMethods_Identical 1 100 0.0 255. FORMAT "%10.0" ECU_ADDRESS 0x600113E8 /end MEASUREMENT
/begin MEASUREMENT ComScl_Bdy_RawSignal_PCU_CHECKSUM_45B_u8 "NetworkSignal ComScl_Bdy_RawSignal_PCU_CHECKSUM_45B_u8" UBYTE RB_RBA_Common_CentralElements_CompuMethods_Identical 1 100 0.0 255. FORMAT "%10.0" ECU_ADDRESS 0x600113E7 /end MEASUREMENT
/begin MEASUREMENT ComScl_Bdy_RawSignal_PCU_REM_ENG_START_b "NetworkSignal ComScl_Bdy_RawSignal_PCU_REM_ENG_START_b" UBYTE RB_RBA_Common_CentralElements_CompuMethods_Identical 1 100 0.0 255. FORMAT "%10.0" ECU_ADDRESS 0x600113E6 /end MEASUREMENT
/begin MEASUREMENT ComScl_Bdy_RawSignal_SRS_ALIVE_COUNTER_039_u8 "NetworkSignal ComScl_Bdy_RawSignal_SRS_ALIVE_COUNTER_039_u8" UBYTE RB_RBA_Common_CentralElements_CompuMethods_Identical 1 100 0.0 255. FORMAT "%10.0" ECU_ADDRESS 0x600113D5 /end MEASUREMENT
/begin MEASUREMENT ComScl_Bdy_RawSignal_SRS_ALIVE_COUNTER_094_u8 "NetworkSignal ComScl_Bdy_RawSignal_SRS_ALIVE_COUNTER_094_u8" UBYTE RB_RBA_Common_CentralElements_CompuMethods_Identical 1 100 0.0 255. FORMAT "%10.0" ECU_ADDRESS 0x600113E2 /end MEASUREMENT
/begin MEASUREMENT ComScl_Bdy_RawSignal_SRS_ALIVE_COUNTER_305_u8 "NetworkSignal ComScl_Bdy_RawSignal_SRS_ALIVE_COUNTER_305_u8" UBYTE RB_RBA_Common_CentralElements_CompuMethods_Identical 1 100 0.0 255. FORMAT "%10.0" ECU_ADDRESS 0x600113E5 /end MEASUREMENT
/begin MEASUREMENT ComScl_Bdy_RawSignal_SRS_CAL_LAT_G_b "NetworkSignal ComScl_Bdy_RawSignal_SRS_CAL_LAT_G_b" UBYTE RB_RBA_Common_CentralElements_CompuMethods_Identical 1 100 0.0 255. FORMAT "%10.0" ECU_ADDRESS 0x600113E1 /end MEASUREMENT
/begin MEASUREMENT ComScl_Bdy_RawSignal_SRS_CAL_LON_G_b "NetworkSignal ComScl_Bdy_RawSignal_SRS_CAL_LON_G_b" UBYTE RB_RBA_Common_CentralElements_CompuMethods_Identical 1 100 0.0 255. FORMAT "%10.0" ECU_ADDRESS 0x600113E0 /end MEASUREMENT
/begin MEASUREMENT ComScl_Bdy_RawSignal_SRS_CHECKSUM_039_u8 "NetworkSignal ComScl_Bdy_RawSignal_SRS_CHECKSUM_039_u8" UBYTE RB_RBA_Common_CentralElements_CompuMethods_Identical 1 100 0.0 255. FORMAT "%10.0" ECU_ADDRESS 0x600113D4 /end MEASUREMENT
/begin MEASUREMENT ComScl_Bdy_RawSignal_SRS_CHECKSUM_094_u8 "NetworkSignal ComScl_Bdy_RawSignal_SRS_CHECKSUM_094_u8" UBYTE RB_RBA_Common_CentralElements_CompuMethods_Identical 1 100 0.0 255. FORMAT "%10.0" ECU_ADDRESS 0x600113DF /end MEASUREMENT
/begin MEASUREMENT ComScl_Bdy_RawSignal_SRS_CHECKSUM_305_u8 "NetworkSignal ComScl_Bdy_RawSignal_SRS_CHECKSUM_305_u8" UBYTE RB_RBA_Common_CentralElements_CompuMethods_Identical 1 100 0.0 255. FORMAT "%10.0" ECU_ADDRESS 0x600113E4 /end MEASUREMENT
/begin MEASUREMENT ComScl_Bdy_RawSignal_SRS_DR_BELT_STATUS_u8 "NetworkSignal ComScl_Bdy_RawSignal_SRS_DR_BELT_STATUS_u8" UBYTE RB_RBA_Common_CentralElements_CompuMethods_Identical 1 100 0.0 255. FORMAT "%10.0" ECU_ADDRESS 0x600113E3 /end MEASUREMENT
/begin MEASUREMENT ComScl_Bdy_RawSignal_SRS_HI_CDS_b "NetworkSignal ComScl_Bdy_RawSignal_SRS_HI_CDS_b" UBYTE RB_RBA_Common_CentralElements_CompuMethods_Identical 1 100 0.0 255. FORMAT "%10.0" ECU_ADDRESS 0x600113D3 /end MEASUREMENT
/begin MEASUREMENT ComScl_Bdy_RawSignal_SRS_LAT_G_u16 "NetworkSignal ComScl_Bdy_RawSignal_SRS_LAT_G_u16" UWORD RB_RBA_Common_CentralElements_CompuMethods_Identical 1 100 0.0 65535. FORMAT "%10.0" ECU_ADDRESS 0x6000A902 /end MEASUREMENT
/begin MEASUREMENT ComScl_Bdy_RawSignal_SRS_LON_G_u16 "NetworkSignal ComScl_Bdy_RawSignal_SRS_LON_G_u16" UWORD RB_RBA_Common_CentralElements_CompuMethods_Identical 1 100 0.0 65535. FORMAT "%10.0" ECU_ADDRESS 0x6000A900 /end MEASUREMENT
/begin MEASUREMENT ComScl_Bdy_RawSignal_SRS_P_ERR_LAT_G_b "NetworkSignal ComScl_Bdy_RawSignal_SRS_P_ERR_LAT_G_b" UBYTE RB_RBA_Common_CentralElements_CompuMethods_Identical 1 100 0.0 255. FORMAT "%10.0" ECU_ADDRESS 0x600113DE /end MEASUREMENT
/begin MEASUREMENT ComScl_Bdy_RawSignal_SRS_P_ERR_LON_G_b "NetworkSignal ComScl_Bdy_RawSignal_SRS_P_ERR_LON_G_b" UBYTE RB_RBA_Common_CentralElements_CompuMethods_Identical 1 100 0.0 255. FORMAT "%10.0" ECU_ADDRESS 0x600113DD /end MEASUREMENT
/begin MEASUREMENT ComScl_Bdy_RawSignal_SRS_P_ERR_YAW1_b "NetworkSignal ComScl_Bdy_RawSignal_SRS_P_ERR_YAW1_b" UBYTE RB_RBA_Common_CentralElements_CompuMethods_Identical 1 100 0.0 255. FORMAT "%10.0" ECU_ADDRESS 0x600113DC /end MEASUREMENT
/begin MEASUREMENT ComScl_Bdy_RawSignal_SRS_SENSOR_ERR_MC_b "NetworkSignal ComScl_Bdy_RawSignal_SRS_SENSOR_ERR_MC_b" UBYTE RB_RBA_Common_CentralElements_CompuMethods_Identical 1 100 0.0 255. FORMAT "%10.0" ECU_ADDRESS 0x600113DB /end MEASUREMENT
/begin MEASUREMENT ComScl_Bdy_RawSignal_SRS_SENSOR_START_UP_b "NetworkSignal ComScl_Bdy_RawSignal_SRS_SENSOR_START_UP_b" UBYTE RB_RBA_Common_CentralElements_CompuMethods_Identical 1 100 0.0 255. FORMAT "%10.0" ECU_ADDRESS 0x600113DA /end MEASUREMENT
/begin MEASUREMENT ComScl_Bdy_RawSignal_SRS_SENSOR_STATE_IG_b "NetworkSignal ComScl_Bdy_RawSignal_SRS_SENSOR_STATE_IG_b" UBYTE RB_RBA_Common_CentralElements_CompuMethods_Identical 1 100 0.0 255. FORMAT "%10.0" ECU_ADDRESS 0x600113D9 /end MEASUREMENT
/begin MEASUREMENT ComScl_Bdy_RawSignal_SRS_T_ERR_LAT_G_b "NetworkSignal ComScl_Bdy_RawSignal_SRS_T_ERR_LAT_G_b" UBYTE RB_RBA_Common_CentralElements_CompuMethods_Identical 1 100 0.0 255. FORMAT "%10.0" ECU_ADDRESS 0x600113D8 /end MEASUREMENT
/begin MEASUREMENT ComScl_Bdy_RawSignal_SRS_T_ERR_LON_G_b "NetworkSignal ComScl_Bdy_RawSignal_SRS_T_ERR_LON_G_b" UBYTE RB_RBA_Common_CentralElements_CompuMethods_Identical 1 100 0.0 255. FORMAT "%10.0" ECU_ADDRESS 0x600113D7 /end MEASUREMENT
/begin MEASUREMENT ComScl_Bdy_RawSignal_SRS_T_ERR_YAW1_b "NetworkSignal ComScl_Bdy_RawSignal_SRS_T_ERR_YAW1_b" UBYTE RB_RBA_Common_CentralElements_CompuMethods_Identical 1 100 0.0 255. FORMAT "%10.0" ECU_ADDRESS 0x600113D6 /end MEASUREMENT
/begin MEASUREMENT ComScl_Bdy_RawSignal_SRS_YAW_1_u16 "NetworkSignal ComScl_Bdy_RawSignal_SRS_YAW_1_u16" UWORD RB_RBA_Common_CentralElements_CompuMethods_Identical 1 100 0.0 65535. FORMAT "%10.0" ECU_ADDRESS 0x6000A8FE /end MEASUREMENT
/begin MEASUREMENT ComScl_Dspl_RawSignal_METER_AC_ACGUP_REQ_b "NetworkSignal ComScl_Dspl_RawSignal_METER_AC_ACGUP_REQ_b" UBYTE RB_RBA_Common_CentralElements_CompuMethods_Identical 1 100 0.0 255. FORMAT "%10.0" ECU_ADDRESS 0x60011A71 /end MEASUREMENT
/begin MEASUREMENT ComScl_Dspl_RawSignal_METER_AC_FR_BLW_VF_u8 "NetworkSignal ComScl_Dspl_RawSignal_METER_AC_FR_BLW_VF_u8" UBYTE RB_RBA_Common_CentralElements_CompuMethods_Identical 1 100 0.0 255. FORMAT "%10.0" ECU_ADDRESS 0x60011A6C /end MEASUREMENT
/begin MEASUREMENT ComScl_Dspl_RawSignal_METER_AC_HACCUT_NG_2_u8 "NetworkSignal ComScl_Dspl_RawSignal_METER_AC_HACCUT_NG_2_u8" UBYTE RB_RBA_Common_CentralElements_CompuMethods_Identical 1 100 0.0 255. FORMAT "%10.0" ECU_ADDRESS 0x60011A7C /end MEASUREMENT
/begin MEASUREMENT ComScl_Dspl_RawSignal_METER_AC_HACCUT_NG_u8 "NetworkSignal ComScl_Dspl_RawSignal_METER_AC_HACCUT_NG_u8" UBYTE RB_RBA_Common_CentralElements_CompuMethods_Identical 1 100 0.0 255. FORMAT "%10.0" ECU_ADDRESS 0x60011A82 /end MEASUREMENT
/begin MEASUREMENT ComScl_Dspl_RawSignal_METER_AC_OUTAIRTEMP01_u8 "NetworkSignal ComScl_Dspl_RawSignal_METER_AC_OUTAIRTEMP01_u8" UBYTE RB_RBA_Common_CentralElements_CompuMethods_Identical 1 100 0.0 255. FORMAT "%10.0" ECU_ADDRESS 0x60011A70 /end MEASUREMENT
/begin MEASUREMENT ComScl_Dspl_RawSignal_METER_AC_PTC_STATUS_u8 "NetworkSignal ComScl_Dspl_RawSignal_METER_AC_PTC_STATUS_u8" UBYTE RB_RBA_Common_CentralElements_CompuMethods_Identical 1 100 0.0 255. FORMAT "%10.0" ECU_ADDRESS 0x60011A6F /end MEASUREMENT
/begin MEASUREMENT ComScl_Dspl_RawSignal_METER_AC_RRDEF_b "NetworkSignal ComScl_Dspl_RawSignal_METER_AC_RRDEF_b" UBYTE RB_RBA_Common_CentralElements_CompuMethods_Identical 1 100 0.0 255. FORMAT "%10.0" ECU_ADDRESS 0x60011A6B /end MEASUREMENT
/begin MEASUREMENT ComScl_Dspl_RawSignal_METER_AC_RR_BLW_VF_u8 "NetworkSignal ComScl_Dspl_RawSignal_METER_AC_RR_BLW_VF_u8" UBYTE RB_RBA_Common_CentralElements_CompuMethods_Identical 1 100 0.0 255. FORMAT "%10.0" ECU_ADDRESS 0x60011A6A /end MEASUREMENT
/begin MEASUREMENT ComScl_Dspl_RawSignal_METER_AC_TEVATEMP05_u8 "NetworkSignal ComScl_Dspl_RawSignal_METER_AC_TEVATEMP05_u8" UBYTE RB_RBA_Common_CentralElements_CompuMethods_Identical 1 100 0.0 255. FORMAT "%10.0" ECU_ADDRESS 0x60011A4C /end MEASUREMENT
/begin MEASUREMENT ComScl_Dspl_RawSignal_METER_AC_TYPE_ECON_b "NetworkSignal ComScl_Dspl_RawSignal_METER_AC_TYPE_ECON_b" UBYTE RB_RBA_Common_CentralElements_CompuMethods_Identical 1 100 0.0 255. FORMAT "%10.0" ECU_ADDRESS 0x60011A8F /end MEASUREMENT
/begin MEASUREMENT ComScl_Dspl_RawSignal_METER_AC_VARI_u8 "NetworkSignal ComScl_Dspl_RawSignal_METER_AC_VARI_u8" UBYTE RB_RBA_Common_CentralElements_CompuMethods_Identical 1 100 0.0 255. FORMAT "%10.0" ECU_ADDRESS 0x60011A69 /end MEASUREMENT
/begin MEASUREMENT ComScl_Dspl_RawSignal_METER_ALIVE_COUNTER_221_2_u8 "NetworkSignal ComScl_Dspl_RawSignal_METER_ALIVE_COUNTER_221_2_u8" UBYTE RB_RBA_Common_CentralElements_CompuMethods_Identical 1 100 0.0 255. FORMAT "%10.0" ECU_ADDRESS 0x60011A95 /end MEASUREMENT
/begin MEASUREMENT ComScl_Dspl_RawSignal_METER_ALIVE_COUNTER_221_u8 "NetworkSignal ComScl_Dspl_RawSignal_METER_ALIVE_COUNTER_221_u8" UBYTE RB_RBA_Common_CentralElements_CompuMethods_Identical 1 100 0.0 255. FORMAT "%10.0" ECU_ADDRESS 0x60011A9B /end MEASUREMENT
/begin MEASUREMENT ComScl_Dspl_RawSignal_METER_ALIVE_COUNTER_296_u8 "NetworkSignal ComScl_Dspl_RawSignal_METER_ALIVE_COUNTER_296_u8" UBYTE RB_RBA_Common_CentralElements_CompuMethods_Identical 1 100 0.0 255. FORMAT "%10.0" ECU_ADDRESS 0x60011A54 /end MEASUREMENT
/begin MEASUREMENT ComScl_Dspl_RawSignal_METER_ALIVE_COUNTER_309_u8 "NetworkSignal ComScl_Dspl_RawSignal_METER_ALIVE_COUNTER_309_u8" UBYTE RB_RBA_Common_CentralElements_CompuMethods_Identical 1 100 0.0 255. FORMAT "%10.0" ECU_ADDRESS 0x60011A88 /end MEASUREMENT
/begin MEASUREMENT ComScl_Dspl_RawSignal_METER_ALIVE_COUNTER_326_u8 "NetworkSignal ComScl_Dspl_RawSignal_METER_ALIVE_COUNTER_326_u8" UBYTE RB_RBA_Common_CentralElements_CompuMethods_Identical 1 100 0.0 255. FORMAT "%10.0" ECU_ADDRESS 0x60011AA7 /end MEASUREMENT
/begin MEASUREMENT ComScl_Dspl_RawSignal_METER_ALIVE_COUNTER_331_u8 "NetworkSignal ComScl_Dspl_RawSignal_METER_ALIVE_COUNTER_331_u8" UBYTE RB_RBA_Common_CentralElements_CompuMethods_Identical 1 100 0.0 255. FORMAT "%10.0" ECU_ADDRESS 0x60011A4B /end MEASUREMENT
/begin MEASUREMENT ComScl_Dspl_RawSignal_METER_ALIVE_COUNTER_371_u8 "NetworkSignal ComScl_Dspl_RawSignal_METER_ALIVE_COUNTER_371_u8" UBYTE RB_RBA_Common_CentralElements_CompuMethods_Identical 1 100 0.0 255. FORMAT "%10.0" ECU_ADDRESS 0x60011A75 /end MEASUREMENT
/begin MEASUREMENT ComScl_Dspl_RawSignal_METER_ALIVE_COUNTER_372_2_u8 "NetworkSignal ComScl_Dspl_RawSignal_METER_ALIVE_COUNTER_372_2_u8" UBYTE RB_RBA_Common_CentralElements_CompuMethods_Identical 1 100 0.0 255. FORMAT "%10.0" ECU_ADDRESS 0x60011A7B /end MEASUREMENT
/begin MEASUREMENT ComScl_Dspl_RawSignal_METER_ALIVE_COUNTER_372_u8 "NetworkSignal ComScl_Dspl_RawSignal_METER_ALIVE_COUNTER_372_u8" UBYTE RB_RBA_Common_CentralElements_CompuMethods_Identical 1 100 0.0 255. FORMAT "%10.0" ECU_ADDRESS 0x60011A81 /end MEASUREMENT
/begin MEASUREMENT ComScl_Dspl_RawSignal_METER_ALIVE_COUNTER_374_u8 "NetworkSignal ComScl_Dspl_RawSignal_METER_ALIVE_COUNTER_374_u8" UBYTE RB_RBA_Common_CentralElements_CompuMethods_Identical 1 100 0.0 255. FORMAT "%10.0" ECU_ADDRESS 0x60011AA1 /end MEASUREMENT
/begin MEASUREMENT ComScl_Dspl_RawSignal_METER_ALIVE_COUNTER_37B_u8 "NetworkSignal ComScl_Dspl_RawSignal_METER_ALIVE_COUNTER_37B_u8" UBYTE RB_RBA_Common_CentralElements_CompuMethods_Identical 1 100 0.0 255. FORMAT "%10.0" ECU_ADDRESS 0x60011A68 /end MEASUREMENT
/begin MEASUREMENT ComScl_Dspl_RawSignal_METER_ALIVE_COUNTER_396_u8 "NetworkSignal ComScl_Dspl_RawSignal_METER_ALIVE_COUNTER_396_u8" UBYTE RB_RBA_Common_CentralElements_CompuMethods_Identical 1 100 0.0 255. FORMAT "%10.0" ECU_ADDRESS 0x60011A8E /end MEASUREMENT
/begin MEASUREMENT ComScl_Dspl_RawSignal_METER_ALIVE_COUNTER_3A1_u8 "NetworkSignal ComScl_Dspl_RawSignal_METER_ALIVE_COUNTER_3A1_u8" UBYTE RB_RBA_Common_CentralElements_CompuMethods_Identical 1 100 0.0 255. FORMAT "%10.0" ECU_ADDRESS 0x60011A50 /end MEASUREMENT
/begin MEASUREMENT ComScl_Dspl_RawSignal_METER_ALIVE_COUNTER_510_u8 "NetworkSignal ComScl_Dspl_RawSignal_METER_ALIVE_COUNTER_510_u8" UBYTE RB_RBA_Common_CentralElements_CompuMethods_Identical 1 100 0.0 255. FORMAT "%10.0" ECU_ADDRESS 0x60011A6E /end MEASUREMENT
/begin MEASUREMENT ComScl_Dspl_RawSignal_METER_ALIVE_COUNTER_516_u8 "NetworkSignal ComScl_Dspl_RawSignal_METER_ALIVE_COUNTER_516_u8" UBYTE RB_RBA_Common_CentralElements_CompuMethods_Identical 1 100 0.0 255. FORMAT "%10.0" ECU_ADDRESS 0x60011A5D /end MEASUREMENT
/begin MEASUREMENT ComScl_Dspl_RawSignal_METER_ASL_CAN_ERROR_b "NetworkSignal ComScl_Dspl_RawSignal_METER_ASL_CAN_ERROR_b" UBYTE RB_RBA_Common_CentralElements_CompuMethods_Identical 1 100 0.0 255. FORMAT "%10.0" ECU_ADDRESS 0x60011A5C /end MEASUREMENT
/begin MEASUREMENT ComScl_Dspl_RawSignal_METER_BCAN_FAILCODE_BCAN_b "NetworkSignal ComScl_Dspl_RawSignal_METER_BCAN_FAILCODE_BCAN_b" UBYTE RB_RBA_Common_CentralElements_CompuMethods_Identical 1 100 0.0 255. FORMAT "%10.0" ECU_ADDRESS 0x60011A5B /end MEASUREMENT
/begin MEASUREMENT ComScl_Dspl_RawSignal_METER_BCAN_FAILCODE_COMB_UNIT_b "NetworkSignal ComScl_Dspl_RawSignal_METER_BCAN_FAILCODE_COMB_UNIT_b" UBYTE RB_RBA_Common_CentralElements_CompuMethods_Identical 1 100 0.0 255. FORMAT "%10.0" ECU_ADDRESS 0x60011A5A /end MEASUREMENT
/begin MEASUREMENT ComScl_Dspl_RawSignal_METER_BCAN_FAILCODE_HAC_b "NetworkSignal ComScl_Dspl_RawSignal_METER_BCAN_FAILCODE_HAC_b" UBYTE RB_RBA_Common_CentralElements_CompuMethods_Identical 1 100 0.0 255. FORMAT "%10.0" ECU_ADDRESS 0x60011A59 /end MEASUREMENT
/begin MEASUREMENT ComScl_Dspl_RawSignal_METER_BCAN_FAILCODE_MCU_UNIT_b "NetworkSignal ComScl_Dspl_RawSignal_METER_BCAN_FAILCODE_MCU_UNIT_b" UBYTE RB_RBA_Common_CentralElements_CompuMethods_Identical 1 100 0.0 255. FORMAT "%10.0" ECU_ADDRESS 0x60011A58 /end MEASUREMENT
/begin MEASUREMENT ComScl_Dspl_RawSignal_METER_BCAN_REPRO_b "NetworkSignal ComScl_Dspl_RawSignal_METER_BCAN_REPRO_b" UBYTE RB_RBA_Common_CentralElements_CompuMethods_Identical 1 100 0.0 255. FORMAT "%10.0" ECU_ADDRESS 0x60011AA6 /end MEASUREMENT
/begin MEASUREMENT ComScl_Dspl_RawSignal_METER_CC_MAIN_STATUS_b "NetworkSignal ComScl_Dspl_RawSignal_METER_CC_MAIN_STATUS_b" UBYTE RB_RBA_Common_CentralElements_CompuMethods_Identical 1 100 0.0 255. FORMAT "%10.0" ECU_ADDRESS 0x60011AA5 /end MEASUREMENT
/begin MEASUREMENT ComScl_Dspl_RawSignal_METER_CC_TARGETSP_DISP_b "NetworkSignal ComScl_Dspl_RawSignal_METER_CC_TARGETSP_DISP_b" UBYTE RB_RBA_Common_CentralElements_CompuMethods_Identical 1 100 0.0 255. FORMAT "%10.0" ECU_ADDRESS 0x60011A87 /end MEASUREMENT
/begin MEASUREMENT ComScl_Dspl_RawSignal_METER_CHECKSUM_221_2_u8 "NetworkSignal ComScl_Dspl_RawSignal_METER_CHECKSUM_221_2_u8" UBYTE RB_RBA_Common_CentralElements_CompuMethods_Identical 1 100 0.0 255. FORMAT "%10.0" ECU_ADDRESS 0x60011A94 /end MEASUREMENT
/begin MEASUREMENT ComScl_Dspl_RawSignal_METER_CHECKSUM_221_u8 "NetworkSignal ComScl_Dspl_RawSignal_METER_CHECKSUM_221_u8" UBYTE RB_RBA_Common_CentralElements_CompuMethods_Identical 1 100 0.0 255. FORMAT "%10.0" ECU_ADDRESS 0x60011A9A /end MEASUREMENT
/begin MEASUREMENT ComScl_Dspl_RawSignal_METER_CHECKSUM_296_u8 "NetworkSignal ComScl_Dspl_RawSignal_METER_CHECKSUM_296_u8" UBYTE RB_RBA_Common_CentralElements_CompuMethods_Identical 1 100 0.0 255. FORMAT "%10.0" ECU_ADDRESS 0x60011A53 /end MEASUREMENT
/begin MEASUREMENT ComScl_Dspl_RawSignal_METER_CHECKSUM_309_u8 "NetworkSignal ComScl_Dspl_RawSignal_METER_CHECKSUM_309_u8" UBYTE RB_RBA_Common_CentralElements_CompuMethods_Identical 1 100 0.0 255. FORMAT "%10.0" ECU_ADDRESS 0x60011A86 /end MEASUREMENT
/begin MEASUREMENT ComScl_Dspl_RawSignal_METER_CHECKSUM_326_u8 "NetworkSignal ComScl_Dspl_RawSignal_METER_CHECKSUM_326_u8" UBYTE RB_RBA_Common_CentralElements_CompuMethods_Identical 1 100 0.0 255. FORMAT "%10.0" ECU_ADDRESS 0x60011AA4 /end MEASUREMENT
/begin MEASUREMENT ComScl_Dspl_RawSignal_METER_CHECKSUM_331_u8 "NetworkSignal ComScl_Dspl_RawSignal_METER_CHECKSUM_331_u8" UBYTE RB_RBA_Common_CentralElements_CompuMethods_Identical 1 100 0.0 255. FORMAT "%10.0" ECU_ADDRESS 0x60011A4A /end MEASUREMENT
/begin MEASUREMENT ComScl_Dspl_RawSignal_METER_CHECKSUM_371_u8 "NetworkSignal ComScl_Dspl_RawSignal_METER_CHECKSUM_371_u8" UBYTE RB_RBA_Common_CentralElements_CompuMethods_Identical 1 100 0.0 255. FORMAT "%10.0" ECU_ADDRESS 0x60011A74 /end MEASUREMENT
/begin MEASUREMENT ComScl_Dspl_RawSignal_METER_CHECKSUM_372_2_u8 "NetworkSignal ComScl_Dspl_RawSignal_METER_CHECKSUM_372_2_u8" UBYTE RB_RBA_Common_CentralElements_CompuMethods_Identical 1 100 0.0 255. FORMAT "%10.0" ECU_ADDRESS 0x60011A7A /end MEASUREMENT
/begin MEASUREMENT ComScl_Dspl_RawSignal_METER_CHECKSUM_372_u8 "NetworkSignal ComScl_Dspl_RawSignal_METER_CHECKSUM_372_u8" UBYTE RB_RBA_Common_CentralElements_CompuMethods_Identical 1 100 0.0 255. FORMAT "%10.0" ECU_ADDRESS 0x60011A80 /end MEASUREMENT
/begin MEASUREMENT ComScl_Dspl_RawSignal_METER_CHECKSUM_374_u8 "NetworkSignal ComScl_Dspl_RawSignal_METER_CHECKSUM_374_u8" UBYTE RB_RBA_Common_CentralElements_CompuMethods_Identical 1 100 0.0 255. FORMAT "%10.0" ECU_ADDRESS 0x60011AA0 /end MEASUREMENT
/begin MEASUREMENT ComScl_Dspl_RawSignal_METER_CHECKSUM_37B_u8 "NetworkSignal ComScl_Dspl_RawSignal_METER_CHECKSUM_37B_u8" UBYTE RB_RBA_Common_CentralElements_CompuMethods_Identical 1 100 0.0 255. FORMAT "%10.0" ECU_ADDRESS 0x60011A67 /end MEASUREMENT
/begin MEASUREMENT ComScl_Dspl_RawSignal_METER_CHECKSUM_396_u8 "NetworkSignal ComScl_Dspl_RawSignal_METER_CHECKSUM_396_u8" UBYTE RB_RBA_Common_CentralElements_CompuMethods_Identical 1 100 0.0 255. FORMAT "%10.0" ECU_ADDRESS 0x60011A8D /end MEASUREMENT
/begin MEASUREMENT ComScl_Dspl_RawSignal_METER_CHECKSUM_3A1_u8 "NetworkSignal ComScl_Dspl_RawSignal_METER_CHECKSUM_3A1_u8" UBYTE RB_RBA_Common_CentralElements_CompuMethods_Identical 1 100 0.0 255. FORMAT "%10.0" ECU_ADDRESS 0x60011A4F /end MEASUREMENT
/begin MEASUREMENT ComScl_Dspl_RawSignal_METER_CHECKSUM_510_u8 "NetworkSignal ComScl_Dspl_RawSignal_METER_CHECKSUM_510_u8" UBYTE RB_RBA_Common_CentralElements_CompuMethods_Identical 1 100 0.0 255. FORMAT "%10.0" ECU_ADDRESS 0x60011A6D /end MEASUREMENT
/begin MEASUREMENT ComScl_Dspl_RawSignal_METER_CHECKSUM_516_u8 "NetworkSignal ComScl_Dspl_RawSignal_METER_CHECKSUM_516_u8" UBYTE RB_RBA_Common_CentralElements_CompuMethods_Identical 1 100 0.0 255. FORMAT "%10.0" ECU_ADDRESS 0x60011A57 /end MEASUREMENT
/begin MEASUREMENT ComScl_Dspl_RawSignal_METER_COMPCURRENT_HIBYTE_u8 "NetworkSignal ComScl_Dspl_RawSignal_METER_COMPCURRENT_HIBYTE_u8" UBYTE RB_RBA_Common_CentralElements_CompuMethods_Identical 1 100 0.0 255. FORMAT "%10.0" ECU_ADDRESS 0x60011A73 /end MEASUREMENT
/begin MEASUREMENT ComScl_Dspl_RawSignal_METER_COMPCURRENT_LOWBYTE_u8 "NetworkSignal ComScl_Dspl_RawSignal_METER_COMPCURRENT_LOWBYTE_u8" UBYTE RB_RBA_Common_CentralElements_CompuMethods_Identical 1 100 0.0 255. FORMAT "%10.0" ECU_ADDRESS 0x60011A72 /end MEASUREMENT
/begin MEASUREMENT ComScl_Dspl_RawSignal_METER_CUSTOM_DEFAULT_b "NetworkSignal ComScl_Dspl_RawSignal_METER_CUSTOM_DEFAULT_b" UBYTE RB_RBA_Common_CentralElements_CompuMethods_Identical 1 100 0.0 255. FORMAT "%10.0" ECU_ADDRESS 0x60011A4E /end MEASUREMENT
/begin MEASUREMENT ComScl_Dspl_RawSignal_METER_CUSTOM_KJ_SPEED_LIMITER_b "NetworkSignal ComScl_Dspl_RawSignal_METER_CUSTOM_KJ_SPEED_LIMITER_b" UBYTE RB_RBA_Common_CentralElements_CompuMethods_Identical 1 100 0.0 255. FORMAT "%10.0" ECU_ADDRESS 0x60011A85 /end MEASUREMENT
/begin MEASUREMENT ComScl_Dspl_RawSignal_METER_CUSTOM_STATUS_b "NetworkSignal ComScl_Dspl_RawSignal_METER_CUSTOM_STATUS_b" UBYTE RB_RBA_Common_CentralElements_CompuMethods_Identical 1 100 0.0 255. FORMAT "%10.0" ECU_ADDRESS 0x60011A4D /end MEASUREMENT
/begin MEASUREMENT ComScl_Dspl_RawSignal_METER_DIGITAL_SPEED_DISPLAY_u8 "NetworkSignal ComScl_Dspl_RawSignal_METER_DIGITAL_SPEED_DISPLAY_u8" UBYTE RB_RBA_Common_CentralElements_CompuMethods_Identical 1 100 0.0 255. FORMAT "%10.0" ECU_ADDRESS 0x60011A84 /end MEASUREMENT
/begin MEASUREMENT ComScl_Dspl_RawSignal_METER_DIGITAL_SPEED_TARGET_u16 "NetworkSignal ComScl_Dspl_RawSignal_METER_DIGITAL_SPEED_TARGET_u16" UWORD RB_RBA_Common_CentralElements_CompuMethods_Identical 1 100 0.0 65535. FORMAT "%10.0" ECU_ADDRESS 0x6000B43C /end MEASUREMENT
/begin MEASUREMENT ComScl_Dspl_RawSignal_METER_DISPLAY_SPEED_u16 "NetworkSignal ComScl_Dspl_RawSignal_METER_DISPLAY_SPEED_u16" UWORD RB_RBA_Common_CentralElements_CompuMethods_Identical 1 100 0.0 65535. FORMAT "%10.0" ECU_ADDRESS 0x6000B43A /end MEASUREMENT
/begin MEASUREMENT ComScl_Dspl_RawSignal_METER_ECONSW_ON_2_b "NetworkSignal ComScl_Dspl_RawSignal_METER_ECONSW_ON_2_b" UBYTE RB_RBA_Common_CentralElements_CompuMethods_Identical 1 100 0.0 255. FORMAT "%10.0" ECU_ADDRESS 0x60011A93 /end MEASUREMENT
/begin MEASUREMENT ComScl_Dspl_RawSignal_METER_EVA_TEMP_2_u8 "NetworkSignal ComScl_Dspl_RawSignal_METER_EVA_TEMP_2_u8" UBYTE RB_RBA_Common_CentralElements_CompuMethods_Identical 1 100 0.0 255. FORMAT "%10.0" ECU_ADDRESS 0x60011A92 /end MEASUREMENT
/begin MEASUREMENT ComScl_Dspl_RawSignal_METER_EVA_TEMP_u8 "NetworkSignal ComScl_Dspl_RawSignal_METER_EVA_TEMP_u8" UBYTE RB_RBA_Common_CentralElements_CompuMethods_Identical 1 100 0.0 255. FORMAT "%10.0" ECU_ADDRESS 0x60011A99 /end MEASUREMENT
/begin MEASUREMENT ComScl_Dspl_RawSignal_METER_FRDEF_b "NetworkSignal ComScl_Dspl_RawSignal_METER_FRDEF_b" UBYTE RB_RBA_Common_CentralElements_CompuMethods_Identical 1 100 0.0 255. FORMAT "%10.0" ECU_ADDRESS 0x60011A8C /end MEASUREMENT
/begin MEASUREMENT ComScl_Dspl_RawSignal_METER_FRFOGRLY_b "NetworkSignal ComScl_Dspl_RawSignal_METER_FRFOGRLY_b" UBYTE RB_RBA_Common_CentralElements_CompuMethods_Identical 1 100 0.0 255. FORMAT "%10.0" ECU_ADDRESS 0x60011A9F /end MEASUREMENT
/begin MEASUREMENT ComScl_Dspl_RawSignal_METER_FUEL_LEVEL_RAW_u8 "NetworkSignal ComScl_Dspl_RawSignal_METER_FUEL_LEVEL_RAW_u8" UBYTE RB_RBA_Common_CentralElements_CompuMethods_Identical 1 100 0.0 255. FORMAT "%10.0" ECU_ADDRESS 0x60011AA3 /end MEASUREMENT
/begin MEASUREMENT ComScl_Dspl_RawSignal_METER_ICU_ACBLW_VD_u8 "NetworkSignal ComScl_Dspl_RawSignal_METER_ICU_ACBLW_VD_u8" UBYTE RB_RBA_Common_CentralElements_CompuMethods_Identical 1 100 0.0 255. FORMAT "%10.0" ECU_ADDRESS 0x60011A66 /end MEASUREMENT
/begin MEASUREMENT ComScl_Dspl_RawSignal_METER_ICU_HOOD_2_b "NetworkSignal ComScl_Dspl_RawSignal_METER_ICU_HOOD_2_b" UBYTE RB_RBA_Common_CentralElements_CompuMethods_Identical 1 100 0.0 255. FORMAT "%10.0" ECU_ADDRESS 0x60011A79 /end MEASUREMENT
/begin MEASUREMENT ComScl_Dspl_RawSignal_METER_ICU_HOOD_ERR_2_b "NetworkSignal ComScl_Dspl_RawSignal_METER_ICU_HOOD_ERR_2_b" UBYTE RB_RBA_Common_CentralElements_CompuMethods_Identical 1 100 0.0 255. FORMAT "%10.0" ECU_ADDRESS 0x60011A78 /end MEASUREMENT
/begin MEASUREMENT ComScl_Dspl_RawSignal_METER_ICU_HOOD_ERR_b "NetworkSignal ComScl_Dspl_RawSignal_METER_ICU_HOOD_ERR_b" UBYTE RB_RBA_Common_CentralElements_CompuMethods_Identical 1 100 0.0 255. FORMAT "%10.0" ECU_ADDRESS 0x60011A7E /end MEASUREMENT
/begin MEASUREMENT ComScl_Dspl_RawSignal_METER_ICU_HOOD_b "NetworkSignal ComScl_Dspl_RawSignal_METER_ICU_HOOD_b" UBYTE RB_RBA_Common_CentralElements_CompuMethods_Identical 1 100 0.0 255. FORMAT "%10.0" ECU_ADDRESS 0x60011A7F /end MEASUREMENT
/begin MEASUREMENT ComScl_Dspl_RawSignal_METER_IN_AIR_TEMP_u8 "NetworkSignal ComScl_Dspl_RawSignal_METER_IN_AIR_TEMP_u8" UBYTE RB_RBA_Common_CentralElements_CompuMethods_Identical 1 100 0.0 255. FORMAT "%10.0" ECU_ADDRESS 0x60011A8B /end MEASUREMENT
/begin MEASUREMENT ComScl_Dspl_RawSignal_METER_IS_INHIBITSW_ON_2_b "NetworkSignal ComScl_Dspl_RawSignal_METER_IS_INHIBITSW_ON_2_b" UBYTE RB_RBA_Common_CentralElements_CompuMethods_Identical 1 100 0.0 255. FORMAT "%10.0" ECU_ADDRESS 0x60011A91 /end MEASUREMENT
/begin MEASUREMENT ComScl_Dspl_RawSignal_METER_IS_INHIBITSW_ON_b "NetworkSignal ComScl_Dspl_RawSignal_METER_IS_INHIBITSW_ON_b" UBYTE RB_RBA_Common_CentralElements_CompuMethods_Identical 1 100 0.0 255. FORMAT "%10.0" ECU_ADDRESS 0x60011A98 /end MEASUREMENT
/begin MEASUREMENT ComScl_Dspl_RawSignal_METER_IS_PERMIT_b "NetworkSignal ComScl_Dspl_RawSignal_METER_IS_PERMIT_b" UBYTE RB_RBA_Common_CentralElements_CompuMethods_Identical 1 100 0.0 255. FORMAT "%10.0" ECU_ADDRESS 0x60011A8A /end MEASUREMENT
/begin MEASUREMENT ComScl_Dspl_RawSignal_METER_IS_TIME_2_u8 "NetworkSignal ComScl_Dspl_RawSignal_METER_IS_TIME_2_u8" UBYTE RB_RBA_Common_CentralElements_CompuMethods_Identical 1 100 0.0 255. FORMAT "%10.0" ECU_ADDRESS 0x60011A90 /end MEASUREMENT
/begin MEASUREMENT ComScl_Dspl_RawSignal_METER_IS_TIME_u8 "NetworkSignal ComScl_Dspl_RawSignal_METER_IS_TIME_u8" UBYTE RB_RBA_Common_CentralElements_CompuMethods_Identical 1 100 0.0 255. FORMAT "%10.0" ECU_ADDRESS 0x60011A97 /end MEASUREMENT
/begin MEASUREMENT ComScl_Dspl_RawSignal_METER_KLDDORLOCK_2_u8 "NetworkSignal ComScl_Dspl_RawSignal_METER_KLDDORLOCK_2_u8" UBYTE RB_RBA_Common_CentralElements_CompuMethods_Identical 1 100 0.0 255. FORMAT "%10.0" ECU_ADDRESS 0x60011A77 /end MEASUREMENT
/begin MEASUREMENT ComScl_Dspl_RawSignal_METER_MICU_FRDEICERRLY_b "NetworkSignal ComScl_Dspl_RawSignal_METER_MICU_FRDEICERRLY_b" UBYTE RB_RBA_Common_CentralElements_CompuMethods_Identical 1 100 0.0 255. FORMAT "%10.0" ECU_ADDRESS 0x60011A65 /end MEASUREMENT
/begin MEASUREMENT ComScl_Dspl_RawSignal_METER_MICU_FRWIPMTR_u8 "NetworkSignal ComScl_Dspl_RawSignal_METER_MICU_FRWIPMTR_u8" UBYTE RB_RBA_Common_CentralElements_CompuMethods_Identical 1 100 0.0 255. FORMAT "%10.0" ECU_ADDRESS 0x60011A64 /end MEASUREMENT
/begin MEASUREMENT ComScl_Dspl_RawSignal_METER_MICU_RRDEFSW_b "NetworkSignal ComScl_Dspl_RawSignal_METER_MICU_RRDEFSW_b" UBYTE RB_RBA_Common_CentralElements_CompuMethods_Identical 1 100 0.0 255. FORMAT "%10.0" ECU_ADDRESS 0x60011A63 /end MEASUREMENT
/begin MEASUREMENT ComScl_Dspl_RawSignal_METER_MICU_TYPE_b "NetworkSignal ComScl_Dspl_RawSignal_METER_MICU_TYPE_b" UBYTE RB_RBA_Common_CentralElements_CompuMethods_Identical 1 100 0.0 255. FORMAT "%10.0" ECU_ADDRESS 0x60011A62 /end MEASUREMENT
/begin MEASUREMENT ComScl_Dspl_RawSignal_METER_ODODATA_STATE_b "NetworkSignal ComScl_Dspl_RawSignal_METER_ODODATA_STATE_b" UBYTE RB_RBA_Common_CentralElements_CompuMethods_Identical 1 100 0.0 255. FORMAT "%10.0" ECU_ADDRESS 0x60011A56 /end MEASUREMENT
/begin MEASUREMENT ComScl_Dspl_RawSignal_METER_ODO_DATA_u32 "NetworkSignal ComScl_Dspl_RawSignal_METER_ODO_DATA_u32" ULONG RB_RBA_Common_CentralElements_CompuMethods_Identical 1 100 0.0 4.E9 FORMAT "%10.0" ECU_ADDRESS 0x5000272C /end MEASUREMENT
/begin MEASUREMENT ComScl_Dspl_RawSignal_METER_OIL_LIFE_RESSW_b "NetworkSignal ComScl_Dspl_RawSignal_METER_OIL_LIFE_RESSW_b" UBYTE RB_RBA_Common_CentralElements_CompuMethods_Identical 1 100 0.0 255. FORMAT "%10.0" ECU_ADDRESS 0x60011A55 /end MEASUREMENT
/begin MEASUREMENT ComScl_Dspl_RawSignal_METER_OUTTEMP_u8 "NetworkSignal ComScl_Dspl_RawSignal_METER_OUTTEMP_u8" UBYTE RB_RBA_Common_CentralElements_CompuMethods_Identical 1 100 0.0 255. FORMAT "%10.0" ECU_ADDRESS 0x60011A9E /end MEASUREMENT
/begin MEASUREMENT ComScl_Dspl_RawSignal_METER_OUT_AIR_TEMP_u8 "NetworkSignal ComScl_Dspl_RawSignal_METER_OUT_AIR_TEMP_u8" UBYTE RB_RBA_Common_CentralElements_CompuMethods_Identical 1 100 0.0 255. FORMAT "%10.0" ECU_ADDRESS 0x60011A89 /end MEASUREMENT
/begin MEASUREMENT ComScl_Dspl_RawSignal_METER_RM_DRLKC_b "NetworkSignal ComScl_Dspl_RawSignal_METER_RM_DRLKC_b" UBYTE RB_RBA_Common_CentralElements_CompuMethods_Identical 1 100 0.0 255. FORMAT "%10.0" ECU_ADDRESS 0x60011A61 /end MEASUREMENT
/begin MEASUREMENT ComScl_Dspl_RawSignal_METER_RM_HLHIRLY_b "NetworkSignal ComScl_Dspl_RawSignal_METER_RM_HLHIRLY_b" UBYTE RB_RBA_Common_CentralElements_CompuMethods_Identical 1 100 0.0 255. FORMAT "%10.0" ECU_ADDRESS 0x60011A60 /end MEASUREMENT
/begin MEASUREMENT ComScl_Dspl_RawSignal_METER_RM_HLLORLY_b "NetworkSignal ComScl_Dspl_RawSignal_METER_RM_HLLORLY_b" UBYTE RB_RBA_Common_CentralElements_CompuMethods_Identical 1 100 0.0 255. FORMAT "%10.0" ECU_ADDRESS 0x60011A5F /end MEASUREMENT
/begin MEASUREMENT ComScl_Dspl_RawSignal_METER_RM_ILL_SML_b "NetworkSignal ComScl_Dspl_RawSignal_METER_RM_ILL_SML_b" UBYTE RB_RBA_Common_CentralElements_CompuMethods_Identical 1 100 0.0 255. FORMAT "%10.0" ECU_ADDRESS 0x60011A5E /end MEASUREMENT
/begin MEASUREMENT ComScl_Dspl_RawSignal_METER_RRFOGRLY_b "NetworkSignal ComScl_Dspl_RawSignal_METER_RRFOGRLY_b" UBYTE RB_RBA_Common_CentralElements_CompuMethods_Identical 1 100 0.0 255. FORMAT "%10.0" ECU_ADDRESS 0x60011A9D /end MEASUREMENT
/begin MEASUREMENT ComScl_Dspl_RawSignal_METER_SPEED_UNIT_b "NetworkSignal ComScl_Dspl_RawSignal_METER_SPEED_UNIT_b" UBYTE RB_RBA_Common_CentralElements_CompuMethods_Identical 1 100 0.0 255. FORMAT "%10.0" ECU_ADDRESS 0x60011A83 /end MEASUREMENT
/begin MEASUREMENT ComScl_Dspl_RawSignal_METER_SW_STATUS_CC_STANDARD_u8 "NetworkSignal ComScl_Dspl_RawSignal_METER_SW_STATUS_CC_STANDARD_u8" UBYTE RB_RBA_Common_CentralElements_CompuMethods_Identical 1 100 0.0 255. FORMAT "%10.0" ECU_ADDRESS 0x60011A52 /end MEASUREMENT
/begin MEASUREMENT ComScl_Dspl_RawSignal_METER_SW_STATUS_HAC_2_b "NetworkSignal ComScl_Dspl_RawSignal_METER_SW_STATUS_HAC_2_b" UBYTE RB_RBA_Common_CentralElements_CompuMethods_Identical 1 100 0.0 255. FORMAT "%10.0" ECU_ADDRESS 0x60011A76 /end MEASUREMENT
/begin MEASUREMENT ComScl_Dspl_RawSignal_METER_SW_STATUS_HAC_b "NetworkSignal ComScl_Dspl_RawSignal_METER_SW_STATUS_HAC_b" UBYTE RB_RBA_Common_CentralElements_CompuMethods_Identical 1 100 0.0 255. FORMAT "%10.0" ECU_ADDRESS 0x60011A7D /end MEASUREMENT
/begin MEASUREMENT ComScl_Dspl_RawSignal_METER_SW_STATUS_IS_INH_b "NetworkSignal ComScl_Dspl_RawSignal_METER_SW_STATUS_IS_INH_b" UBYTE RB_RBA_Common_CentralElements_CompuMethods_Identical 1 100 0.0 255. FORMAT "%10.0" ECU_ADDRESS 0x60011A96 /end MEASUREMENT
/begin MEASUREMENT ComScl_Dspl_RawSignal_METER_SW_STATUS_LKAS_CCLIM_DIST_u8 "NetworkSignal ComScl_Dspl_RawSignal_METER_SW_STATUS_LKAS_CCLIM_DIST_u8" UBYTE RB_RBA_Common_CentralElements_CompuMethods_Identical 1 100 0.0 255. FORMAT "%10.0" ECU_ADDRESS 0x60011A51 /end MEASUREMENT
/begin MEASUREMENT ComScl_Dspl_RawSignal_METER_SW_STATUS_PARK_BRAKE_b "NetworkSignal ComScl_Dspl_RawSignal_METER_SW_STATUS_PARK_BRAKE_b" UBYTE RB_RBA_Common_CentralElements_CompuMethods_Identical 1 100 0.0 255. FORMAT "%10.0" ECU_ADDRESS 0x60011AA2 /end MEASUREMENT
/begin MEASUREMENT ComScl_Dspl_RawSignal_METER_WIPER_STATUS_u8 "NetworkSignal ComScl_Dspl_RawSignal_METER_WIPER_STATUS_u8" UBYTE RB_RBA_Common_CentralElements_CompuMethods_Identical 1 100 0.0 255. FORMAT "%10.0" ECU_ADDRESS 0x60011A9C /end MEASUREMENT
/begin MEASUREMENT ComScl_EngLin_RawSignal_Lin_Alt_B_Signal_ACG_Temp_8_r_msg_u8 "NetworkSignal ComScl_EngLin_RawSignal_Lin_Alt_B_Signal_ACG_Temp_8_r_msg_u8" UBYTE RB_RBA_Common_CentralElements_CompuMethods_Identical 1 100 0.0 255. FORMAT "%10.0" ECU_ADDRESS 0x60011ADD /end MEASUREMENT
/begin MEASUREMENT ComScl_EngLin_RawSignal_Lin_Alt_B_Signal_ComTOut_1_r_msg_b "NetworkSignal ComScl_EngLin_RawSignal_Lin_Alt_B_Signal_ComTOut_1_r_msg_b" UBYTE RB_RBA_Common_CentralElements_CompuMethods_Identical 1 100 0.0 255. FORMAT "%10.0" ECU_ADDRESS 0x60011ADC /end MEASUREMENT
/begin MEASUREMENT ComScl_EngLin_RawSignal_Lin_Alt_B_Signal_Com_1_r_msg_b "NetworkSignal ComScl_EngLin_RawSignal_Lin_Alt_B_Signal_Com_1_r_msg_b" UBYTE RB_RBA_Common_CentralElements_CompuMethods_Identical 1 100 0.0 255. FORMAT "%10.0" ECU_ADDRESS 0x60011ADB /end MEASUREMENT
/begin MEASUREMENT ComScl_EngLin_RawSignal_Lin_Alt_B_Signal_Dyc_5_r_msg_u8 "NetworkSignal ComScl_EngLin_RawSignal_Lin_Alt_B_Signal_Dyc_5_r_msg_u8" UBYTE RB_RBA_Common_CentralElements_CompuMethods_Identical 1 100 0.0 255. FORMAT "%10.0" ECU_ADDRESS 0x60011ADA /end MEASUREMENT
/begin MEASUREMENT ComScl_EngLin_RawSignal_Lin_Alt_B_Signal_Elec_1_r_msg_b "NetworkSignal ComScl_EngLin_RawSignal_Lin_Alt_B_Signal_Elec_1_r_msg_b" UBYTE RB_RBA_Common_CentralElements_CompuMethods_Identical 1 100 0.0 255. FORMAT "%10.0" ECU_ADDRESS 0x60011AD9 /end MEASUREMENT
/begin MEASUREMENT ComScl_EngLin_RawSignal_Lin_Alt_B_Signal_ExctCrnt_8_r_msg_u8 "NetworkSignal ComScl_EngLin_RawSignal_Lin_Alt_B_Signal_ExctCrnt_8_r_msg_u8" UBYTE RB_RBA_Common_CentralElements_CompuMethods_Identical 1 100 0.0 255. FORMAT "%10.0" ECU_ADDRESS 0x60011AD8 /end MEASUREMENT
/begin MEASUREMENT ComScl_EngLin_RawSignal_Lin_Alt_B_Signal_HiTemp_1_r_msg_b "NetworkSignal ComScl_EngLin_RawSignal_Lin_Alt_B_Signal_HiTemp_1_r_msg_b" UBYTE RB_RBA_Common_CentralElements_CompuMethods_Identical 1 100 0.0 255. FORMAT "%10.0" ECU_ADDRESS 0x60011AD7 /end MEASUREMENT
/begin MEASUREMENT ComScl_EngLin_RawSignal_Lin_Alt_B_Signal_Mchn_1_r_msg_b "NetworkSignal ComScl_EngLin_RawSignal_Lin_Alt_B_Signal_Mchn_1_r_msg_b" UBYTE RB_RBA_Common_CentralElements_CompuMethods_Identical 1 100 0.0 255. FORMAT "%10.0" ECU_ADDRESS 0x60011AD6 /end MEASUREMENT
/begin MEASUREMENT ComScl_EngLin_RawSignal_Lin_BS_B_Signal_OCV_8_r_msg_u8 "NetworkSignal ComScl_EngLin_RawSignal_Lin_BS_B_Signal_OCV_8_r_msg_u8" UBYTE RB_RBA_Common_CentralElements_CompuMethods_Identical 1 100 0.0 255. FORMAT "%10.0" ECU_ADDRESS 0x60011AC4 /end MEASUREMENT
/begin MEASUREMENT ComScl_EngLin_RawSignal_Lin_BS_B_Signal_STBATTSENRST_1_r_msg_b "NetworkSignal ComScl_EngLin_RawSignal_Lin_BS_B_Signal_STBATTSENRST_1_r_msg_b" UBYTE RB_RBA_Common_CentralElements_CompuMethods_Identical 1 100 0.0 255. FORMAT "%10.0" ECU_ADDRESS 0x60011AC3 /end MEASUREMENT
/begin MEASUREMENT ComScl_EngLin_RawSignal_Lin_BS_B_Signal_TASIC_8_r_msg_u8 "NetworkSignal ComScl_EngLin_RawSignal_Lin_BS_B_Signal_TASIC_8_r_msg_u8" UBYTE RB_RBA_Common_CentralElements_CompuMethods_Identical 1 100 0.0 255. FORMAT "%10.0" ECU_ADDRESS 0x60011AB8 /end MEASUREMENT
/begin MEASUREMENT ComScl_EngLin_RawSignal_Lin_BS_B_Signal_tiDurAftIgnOff_16_r_msg_u16 "NetworkSignal ComScl_EngLin_RawSignal_Lin_BS_B_Signal_tiDurAftIgnOff_16_r_msg_u16" UWORD RB_RBA_Common_CentralElements_CompuMethods_Identical 1 100 0.0 65535. FORMAT "%10.0" ECU_ADDRESS 0x6000B44E /end MEASUREMENT
/begin MEASUREMENT ComScl_EngLin_RawSignal_Lin_BS_Signal_B_BATTCH_16_r_msg_u16 "NetworkSignal ComScl_EngLin_RawSignal_Lin_BS_Signal_B_BATTCH_16_r_msg_u16" UWORD RB_RBA_Common_CentralElements_CompuMethods_Identical 1 100 0.0 65535. FORMAT "%10.0" ECU_ADDRESS 0x6000B44C /end MEASUREMENT
/begin MEASUREMENT ComScl_EngLin_RawSignal_Lin_BS_Signal_B_BATTDCHA_16_r_msg_u16 "NetworkSignal ComScl_EngLin_RawSignal_Lin_BS_Signal_B_BATTDCHA_16_r_msg_u16" UWORD RB_RBA_Common_CentralElements_CompuMethods_Identical 1 100 0.0 65535. FORMAT "%10.0" ECU_ADDRESS 0x6000B44A /end MEASUREMENT
/begin MEASUREMENT ComScl_EngLin_RawSignal_Lin_BS_Signal_B_BATT_REPLACE_1_r_msg_b "NetworkSignal ComScl_EngLin_RawSignal_Lin_BS_Signal_B_BATT_REPLACE_1_r_msg_b" UBYTE RB_RBA_Common_CentralElements_CompuMethods_Identical 1 100 0.0 255. FORMAT "%10.0" ECU_ADDRESS 0x60011AD0 /end MEASUREMENT
/begin MEASUREMENT ComScl_EngLin_RawSignal_Lin_BS_Signal_B_BATT_SIZE_DETECT_1_r_msg_b "NetworkSignal ComScl_EngLin_RawSignal_Lin_BS_Signal_B_BATT_SIZE_DETECT_1_r_msg_b" UBYTE RB_RBA_Common_CentralElements_CompuMethods_Identical 1 100 0.0 255. FORMAT "%10.0" ECU_ADDRESS 0x60011AC2 /end MEASUREMENT
/begin MEASUREMENT ComScl_EngLin_RawSignal_Lin_BS_Signal_B_BATT_WARM_LEVEL_3_r_msg_u8 "NetworkSignal ComScl_EngLin_RawSignal_Lin_BS_Signal_B_BATT_WARM_LEVEL_3_r_msg_u8" UBYTE RB_RBA_Common_CentralElements_CompuMethods_Identical 1 100 0.0 255. FORMAT "%10.0" ECU_ADDRESS 0x60011ACF /end MEASUREMENT
/begin MEASUREMENT ComScl_EngLin_RawSignal_Lin_BS_Signal_B_BCF_1_r_msg_b "NetworkSignal ComScl_EngLin_RawSignal_Lin_BS_Signal_B_BCF_1_r_msg_b" UBYTE RB_RBA_Common_CentralElements_CompuMethods_Identical 1 100 0.0 255. FORMAT "%10.0" ECU_ADDRESS 0x60011AC1 /end MEASUREMENT
/begin MEASUREMENT ComScl_EngLin_RawSignal_Lin_BS_Signal_B_CHARGE_LOW_1_r_msg_b "NetworkSignal ComScl_EngLin_RawSignal_Lin_BS_Signal_B_CHARGE_LOW_1_r_msg_b" UBYTE RB_RBA_Common_CentralElements_CompuMethods_Identical 1 100 0.0 255. FORMAT "%10.0" ECU_ADDRESS 0x60011ACE /end MEASUREMENT
/begin MEASUREMENT ComScl_EngLin_RawSignal_Lin_BS_Signal_B_CTINTRESUPD_2_r_msg_u8 "NetworkSignal ComScl_EngLin_RawSignal_Lin_BS_Signal_B_CTINTRESUPD_2_r_msg_u8" UBYTE RB_RBA_Common_CentralElements_CompuMethods_Identical 1 100 0.0 255. FORMAT "%10.0" ECU_ADDRESS 0x60011AB7 /end MEASUREMENT
/begin MEASUREMENT ComScl_EngLin_RawSignal_Lin_BS_Signal_B_DATA_FORMAT_8_r_msg_u8 "NetworkSignal ComScl_EngLin_RawSignal_Lin_BS_Signal_B_DATA_FORMAT_8_r_msg_u8" UBYTE RB_RBA_Common_CentralElements_CompuMethods_Identical 1 100 0.0 255. FORMAT "%10.0" ECU_ADDRESS 0x60011ACD /end MEASUREMENT
/begin MEASUREMENT ComScl_EngLin_RawSignal_Lin_BS_Signal_B_ERROR_RES_1_r_msg_b "NetworkSignal ComScl_EngLin_RawSignal_Lin_BS_Signal_B_ERROR_RES_1_r_msg_b" UBYTE RB_RBA_Common_CentralElements_CompuMethods_Identical 1 100 0.0 255. FORMAT "%10.0" ECU_ADDRESS 0x60011ACC /end MEASUREMENT
/begin MEASUREMENT ComScl_EngLin_RawSignal_Lin_BS_Signal_B_HARNR_2_r_msg_u8 "NetworkSignal ComScl_EngLin_RawSignal_Lin_BS_Signal_B_HARNR_2_r_msg_u8" UBYTE RB_RBA_Common_CentralElements_CompuMethods_Identical 1 100 0.0 255. FORMAT "%10.0" ECU_ADDRESS 0x60011ACB /end MEASUREMENT
/begin MEASUREMENT ComScl_EngLin_RawSignal_Lin_BS_Signal_B_IBAT_16_r_msg_u16 "NetworkSignal ComScl_EngLin_RawSignal_Lin_BS_Signal_B_IBAT_16_r_msg_u16" UWORD RB_RBA_Common_CentralElements_CompuMethods_Identical 1 100 0.0 65535. FORMAT "%10.0" ECU_ADDRESS 0x6000B452 /end MEASUREMENT
/begin MEASUREMENT ComScl_EngLin_RawSignal_Lin_BS_Signal_B_IBAT_8_r_msg_u8 "NetworkSignal ComScl_EngLin_RawSignal_Lin_BS_Signal_B_IBAT_8_r_msg_u8" UBYTE RB_RBA_Common_CentralElements_CompuMethods_Identical 1 100 0.0 255. FORMAT "%10.0" ECU_ADDRESS 0x60011AD5 /end MEASUREMENT
/begin MEASUREMENT ComScl_EngLin_RawSignal_Lin_BS_Signal_B_IOP_ERROR_1_r_msg_b "NetworkSignal ComScl_EngLin_RawSignal_Lin_BS_Signal_B_IOP_ERROR_1_r_msg_b" UBYTE RB_RBA_Common_CentralElements_CompuMethods_Identical 1 100 0.0 255. FORMAT "%10.0" ECU_ADDRESS 0x60011ACA /end MEASUREMENT
/begin MEASUREMENT ComScl_EngLin_RawSignal_Lin_BS_Signal_B_MEASDR_2_r_msg_u8 "NetworkSignal ComScl_EngLin_RawSignal_Lin_BS_Signal_B_MEASDR_2_r_msg_u8" UBYTE RB_RBA_Common_CentralElements_CompuMethods_Identical 1 100 0.0 255. FORMAT "%10.0" ECU_ADDRESS 0x60011AB6 /end MEASUREMENT
/begin MEASUREMENT ComScl_EngLin_RawSignal_Lin_BS_Signal_B_RESMEASDBATT_16_r_msg_u16 "NetworkSignal ComScl_EngLin_RawSignal_Lin_BS_Signal_B_RESMEASDBATT_16_r_msg_u16" UWORD RB_RBA_Common_CentralElements_CompuMethods_Identical 1 100 0.0 65535. FORMAT "%10.0" ECU_ADDRESS 0x6000B440 /end MEASUREMENT
/begin MEASUREMENT ComScl_EngLin_RawSignal_Lin_BS_Signal_B_RI_ST_OTHER_MEASURE_16_r_msg_u16 "NetworkSignal ComScl_EngLin_RawSignal_Lin_BS_Signal_B_RI_ST_OTHER_MEASURE_16_r_msg_u16" UWORD RB_RBA_Common_CentralElements_CompuMethods_Identical 1 100 0.0 65535. FORMAT "%10.0" ECU_ADDRESS 0x6000B43E /end MEASUREMENT
/begin MEASUREMENT ComScl_EngLin_RawSignal_Lin_BS_Signal_B_SOC_8_r_msg_u8 "NetworkSignal ComScl_EngLin_RawSignal_Lin_BS_Signal_B_SOC_8_r_msg_u8" UBYTE RB_RBA_Common_CentralElements_CompuMethods_Identical 1 100 0.0 255. FORMAT "%10.0" ECU_ADDRESS 0x60011AC9 /end MEASUREMENT
/begin MEASUREMENT ComScl_EngLin_RawSignal_Lin_BS_Signal_B_SOC_STATE_3_r_msg_u8 "NetworkSignal ComScl_EngLin_RawSignal_Lin_BS_Signal_B_SOC_STATE_3_r_msg_u8" UBYTE RB_RBA_Common_CentralElements_CompuMethods_Identical 1 100 0.0 255. FORMAT "%10.0" ECU_ADDRESS 0x60011AC8 /end MEASUREMENT
/begin MEASUREMENT ComScl_EngLin_RawSignal_Lin_BS_Signal_B_SOFV_RESTART_8_r_msg_u8 "NetworkSignal ComScl_EngLin_RawSignal_Lin_BS_Signal_B_SOFV_RESTART_8_r_msg_u8" UBYTE RB_RBA_Common_CentralElements_CompuMethods_Identical 1 100 0.0 255. FORMAT "%10.0" ECU_ADDRESS 0x60011AC0 /end MEASUREMENT
/begin MEASUREMENT ComScl_EngLin_RawSignal_Lin_BS_Signal_B_SOFV_RESTART_STATE_1_r_msg_b "NetworkSignal ComScl_EngLin_RawSignal_Lin_BS_Signal_B_SOFV_RESTART_STATE_1_r_msg_b" UBYTE RB_RBA_Common_CentralElements_CompuMethods_Identical 1 100 0.0 255. FORMAT "%10.0" ECU_ADDRESS 0x60011ABF /end MEASUREMENT
/begin MEASUREMENT ComScl_EngLin_RawSignal_Lin_BS_Signal_B_SOH_COR_8_r_msg_u8 "NetworkSignal ComScl_EngLin_RawSignal_Lin_BS_Signal_B_SOH_COR_8_r_msg_u8" UBYTE RB_RBA_Common_CentralElements_CompuMethods_Identical 1 100 0.0 255. FORMAT "%10.0" ECU_ADDRESS 0x60011ABE /end MEASUREMENT
/begin MEASUREMENT ComScl_EngLin_RawSignal_Lin_BS_Signal_B_SOH_COR_STATE_1_r_msg_b "NetworkSignal ComScl_EngLin_RawSignal_Lin_BS_Signal_B_SOH_COR_STATE_1_r_msg_b" UBYTE RB_RBA_Common_CentralElements_CompuMethods_Identical 1 100 0.0 255. FORMAT "%10.0" ECU_ADDRESS 0x60011ABD /end MEASUREMENT
/begin MEASUREMENT ComScl_EngLin_RawSignal_Lin_BS_Signal_B_SOH_LAM_8_r_msg_u8 "NetworkSignal ComScl_EngLin_RawSignal_Lin_BS_Signal_B_SOH_LAM_8_r_msg_u8" UBYTE RB_RBA_Common_CentralElements_CompuMethods_Identical 1 100 0.0 255. FORMAT "%10.0" ECU_ADDRESS 0x60011ABC /end MEASUREMENT
/begin MEASUREMENT ComScl_EngLin_RawSignal_Lin_BS_Signal_B_SOH_LAM_STATE_1_r_msg_b "NetworkSignal ComScl_EngLin_RawSignal_Lin_BS_Signal_B_SOH_LAM_STATE_1_r_msg_b" UBYTE RB_RBA_Common_CentralElements_CompuMethods_Identical 1 100 0.0 255. FORMAT "%10.0" ECU_ADDRESS 0x60011ABB /end MEASUREMENT
/begin MEASUREMENT ComScl_EngLin_RawSignal_Lin_BS_Signal_B_SOH_SUL_8_r_msg_u8 "NetworkSignal ComScl_EngLin_RawSignal_Lin_BS_Signal_B_SOH_SUL_8_r_msg_u8" UBYTE RB_RBA_Common_CentralElements_CompuMethods_Identical 1 100 0.0 255. FORMAT "%10.0" ECU_ADDRESS 0x60011ABA /end MEASUREMENT
/begin MEASUREMENT ComScl_EngLin_RawSignal_Lin_BS_Signal_B_SOH_SUL_STATE_1_r_msg_b "NetworkSignal ComScl_EngLin_RawSignal_Lin_BS_Signal_B_SOH_SUL_STATE_1_r_msg_b" UBYTE RB_RBA_Common_CentralElements_CompuMethods_Identical 1 100 0.0 255. FORMAT "%10.0" ECU_ADDRESS 0x60011AB9 /end MEASUREMENT
/begin MEASUREMENT ComScl_EngLin_RawSignal_Lin_BS_Signal_B_SUPPLIER_CODE_8_r_msg_u8 "NetworkSignal ComScl_EngLin_RawSignal_Lin_BS_Signal_B_SUPPLIER_CODE_8_r_msg_u8" UBYTE RB_RBA_Common_CentralElements_CompuMethods_Identical 1 100 0.0 255. FORMAT "%10.0" ECU_ADDRESS 0x60011AC7 /end MEASUREMENT
/begin MEASUREMENT ComScl_EngLin_RawSignal_Lin_BS_Signal_B_TBAT_8_r_msg_u8 "NetworkSignal ComScl_EngLin_RawSignal_Lin_BS_Signal_B_TBAT_8_r_msg_u8" UBYTE RB_RBA_Common_CentralElements_CompuMethods_Identical 1 100 0.0 255. FORMAT "%10.0" ECU_ADDRESS 0x60011AC6 /end MEASUREMENT
/begin MEASUREMENT ComScl_EngLin_RawSignal_Lin_BS_Signal_B_UBAT_16_r_msg_u16 "NetworkSignal ComScl_EngLin_RawSignal_Lin_BS_Signal_B_UBAT_16_r_msg_u16" UWORD RB_RBA_Common_CentralElements_CompuMethods_Identical 1 100 0.0 65535. FORMAT "%10.0" ECU_ADDRESS 0x6000B450 /end MEASUREMENT
/begin MEASUREMENT ComScl_EngLin_RawSignal_Lin_BS_Signal_B_iStByCurrAft0h_10_r_msg_u16 "NetworkSignal ComScl_EngLin_RawSignal_Lin_BS_Signal_B_iStByCurrAft0h_10_r_msg_u16" UWORD RB_RBA_Common_CentralElements_CompuMethods_Identical 1 100 0.0 65535. FORMAT "%10.0" ECU_ADDRESS 0x6000B448 /end MEASUREMENT
/begin MEASUREMENT ComScl_EngLin_RawSignal_Lin_BS_Signal_B_iStByCurrAft1h_10_r_msg_u16 "NetworkSignal ComScl_EngLin_RawSignal_Lin_BS_Signal_B_iStByCurrAft1h_10_r_msg_u16" UWORD RB_RBA_Common_CentralElements_CompuMethods_Identical 1 100 0.0 65535. FORMAT "%10.0" ECU_ADDRESS 0x6000B446 /end MEASUREMENT
/begin MEASUREMENT ComScl_EngLin_RawSignal_Lin_BS_Signal_B_iStByCurrAft2h_10_r_msg_u16 "NetworkSignal ComScl_EngLin_RawSignal_Lin_BS_Signal_B_iStByCurrAft2h_10_r_msg_u16" UWORD RB_RBA_Common_CentralElements_CompuMethods_Identical 1 100 0.0 65535. FORMAT "%10.0" ECU_ADDRESS 0x6000B444 /end MEASUREMENT
/begin MEASUREMENT ComScl_EngLin_RawSignal_Lin_BS_Signal_B_iStByCurrLst_10_r_msg_u16 "NetworkSignal ComScl_EngLin_RawSignal_Lin_BS_Signal_B_iStByCurrLst_10_r_msg_u16" UWORD RB_RBA_Common_CentralElements_CompuMethods_Identical 1 100 0.0 65535. FORMAT "%10.0" ECU_ADDRESS 0x6000B442 /end MEASUREMENT
/begin MEASUREMENT ComScl_EngLin_RawSignal_Lin_BS_Signal_CHARERR_1_r_msg_b "NetworkSignal ComScl_EngLin_RawSignal_Lin_BS_Signal_CHARERR_1_r_msg_b" UBYTE RB_RBA_Common_CentralElements_CompuMethods_Identical 1 100 0.0 255. FORMAT "%10.0" ECU_ADDRESS 0x60011AD4 /end MEASUREMENT
/begin MEASUREMENT ComScl_EngLin_RawSignal_Lin_BS_Signal_ERRCMN_1_r_msg_b "NetworkSignal ComScl_EngLin_RawSignal_Lin_BS_Signal_ERRCMN_1_r_msg_b" UBYTE RB_RBA_Common_CentralElements_CompuMethods_Identical 1 100 0.0 255. FORMAT "%10.0" ECU_ADDRESS 0x60011AD3 /end MEASUREMENT
/begin MEASUREMENT ComScl_EngLin_RawSignal_Lin_BS_Signal_ERRST_1_r_msg_b "NetworkSignal ComScl_EngLin_RawSignal_Lin_BS_Signal_ERRST_1_r_msg_b" UBYTE RB_RBA_Common_CentralElements_CompuMethods_Identical 1 100 0.0 255. FORMAT "%10.0" ECU_ADDRESS 0x60011AD2 /end MEASUREMENT
/begin MEASUREMENT ComScl_EngLin_RawSignal_Lin_BS_Signal_IBATTAVGLINOFF_8_r_msg_u8 "NetworkSignal ComScl_EngLin_RawSignal_Lin_BS_Signal_IBATTAVGLINOFF_8_r_msg_u8" UBYTE RB_RBA_Common_CentralElements_CompuMethods_Identical 1 100 0.0 255. FORMAT "%10.0" ECU_ADDRESS 0x60011AC5 /end MEASUREMENT
/begin MEASUREMENT ComScl_EngLin_RawSignal_Lin_DCDC_Signal_nrSwVers_3_r_msg_u8 "NetworkSignal ComScl_EngLin_RawSignal_Lin_DCDC_Signal_nrSwVers_3_r_msg_u8" UBYTE RB_RBA_Common_CentralElements_CompuMethods_Identical 1 100 0.0 255. FORMAT "%10.0" ECU_ADDRESS 0x60011AB5 /end MEASUREMENT
/begin MEASUREMENT ComScl_EngLin_RawSignal_Lin_DCDC_Signal_stBoosterErr_1_r_msg_b "NetworkSignal ComScl_EngLin_RawSignal_Lin_DCDC_Signal_stBoosterErr_1_r_msg_b" UBYTE RB_RBA_Common_CentralElements_CompuMethods_Identical 1 100 0.0 255. FORMAT "%10.0" ECU_ADDRESS 0x60011AB4 /end MEASUREMENT
/begin MEASUREMENT ComScl_EngLin_RawSignal_Lin_DCDC_Signal_stCSTErr_1_r_msg_b "NetworkSignal ComScl_EngLin_RawSignal_Lin_DCDC_Signal_stCSTErr_1_r_msg_b" UBYTE RB_RBA_Common_CentralElements_CompuMethods_Identical 1 100 0.0 255. FORMAT "%10.0" ECU_ADDRESS 0x60011AB3 /end MEASUREMENT
/begin MEASUREMENT ComScl_EngLin_RawSignal_Lin_DCDC_Signal_stCSTHist_1_r_msg_b "NetworkSignal ComScl_EngLin_RawSignal_Lin_DCDC_Signal_stCSTHist_1_r_msg_b" UBYTE RB_RBA_Common_CentralElements_CompuMethods_Identical 1 100 0.0 255. FORMAT "%10.0" ECU_ADDRESS 0x60011AB2 /end MEASUREMENT
/begin MEASUREMENT ComScl_EngLin_RawSignal_Lin_DCDC_Signal_stDCLinRVer_1_r_msg_b "NetworkSignal ComScl_EngLin_RawSignal_Lin_DCDC_Signal_stDCLinRVer_1_r_msg_b" UBYTE RB_RBA_Common_CentralElements_CompuMethods_Identical 1 100 0.0 255. FORMAT "%10.0" ECU_ADDRESS 0x60011AB1 /end MEASUREMENT
/begin MEASUREMENT ComScl_EngLin_RawSignal_Lin_DCDC_Signal_stInpErr1_1_r_msg_b "NetworkSignal ComScl_EngLin_RawSignal_Lin_DCDC_Signal_stInpErr1_1_r_msg_b" UBYTE RB_RBA_Common_CentralElements_CompuMethods_Identical 1 100 0.0 255. FORMAT "%10.0" ECU_ADDRESS 0x60011AB0 /end MEASUREMENT
/begin MEASUREMENT ComScl_EngLin_RawSignal_Lin_DCDC_Signal_stInpErr2_1_r_msg_b "NetworkSignal ComScl_EngLin_RawSignal_Lin_DCDC_Signal_stInpErr2_1_r_msg_b" UBYTE RB_RBA_Common_CentralElements_CompuMethods_Identical 1 100 0.0 255. FORMAT "%10.0" ECU_ADDRESS 0x60011AAF /end MEASUREMENT
/begin MEASUREMENT ComScl_EngLin_RawSignal_Lin_DCDC_Signal_stIntErr_1_r_msg_b "NetworkSignal ComScl_EngLin_RawSignal_Lin_DCDC_Signal_stIntErr_1_r_msg_b" UBYTE RB_RBA_Common_CentralElements_CompuMethods_Identical 1 100 0.0 255. FORMAT "%10.0" ECU_ADDRESS 0x60011AAE /end MEASUREMENT
/begin MEASUREMENT ComScl_EngLin_RawSignal_Lin_DCDC_Signal_stMode_1_r_msg_b "NetworkSignal ComScl_EngLin_RawSignal_Lin_DCDC_Signal_stMode_1_r_msg_b" UBYTE RB_RBA_Common_CentralElements_CompuMethods_Identical 1 100 0.0 255. FORMAT "%10.0" ECU_ADDRESS 0x60011AAD /end MEASUREMENT
/begin MEASUREMENT ComScl_EngLin_RawSignal_Lin_DCDC_Signal_stOutpErr1_1_r_msg_b "NetworkSignal ComScl_EngLin_RawSignal_Lin_DCDC_Signal_stOutpErr1_1_r_msg_b" UBYTE RB_RBA_Common_CentralElements_CompuMethods_Identical 1 100 0.0 255. FORMAT "%10.0" ECU_ADDRESS 0x60011AAC /end MEASUREMENT
/begin MEASUREMENT ComScl_EngLin_RawSignal_Lin_DCDC_Signal_stOutpErr2_1_r_msg_b "NetworkSignal ComScl_EngLin_RawSignal_Lin_DCDC_Signal_stOutpErr2_1_r_msg_b" UBYTE RB_RBA_Common_CentralElements_CompuMethods_Identical 1 100 0.0 255. FORMAT "%10.0" ECU_ADDRESS 0x60011AAB /end MEASUREMENT
/begin MEASUREMENT ComScl_EngLin_RawSignal_Lin_DCDC_Signal_stTempWarn1_1_r_msg_b "NetworkSignal ComScl_EngLin_RawSignal_Lin_DCDC_Signal_stTempWarn1_1_r_msg_b" UBYTE RB_RBA_Common_CentralElements_CompuMethods_Identical 1 100 0.0 255. FORMAT "%10.0" ECU_ADDRESS 0x60011AAA /end MEASUREMENT
/begin MEASUREMENT ComScl_EngLin_RawSignal_Lin_DCDC_Signal_stTempWarn2_1_r_msg_b "NetworkSignal ComScl_EngLin_RawSignal_Lin_DCDC_Signal_stTempWarn2_1_r_msg_b" UBYTE RB_RBA_Common_CentralElements_CompuMethods_Identical 1 100 0.0 255. FORMAT "%10.0" ECU_ADDRESS 0x60011AA9 /end MEASUREMENT
/begin MEASUREMENT ComScl_EngLin_RawSignal_Lin_DCDC_Signal_stUnitSt_1_r_msg_b "NetworkSignal ComScl_EngLin_RawSignal_Lin_DCDC_Signal_stUnitSt_1_r_msg_b" UBYTE RB_RBA_Common_CentralElements_CompuMethods_Identical 1 100 0.0 255. FORMAT "%10.0" ECU_ADDRESS 0x60011AA8 /end MEASUREMENT
/begin MEASUREMENT ComScl_Gbx_RawSignal_CVT_MISS_MILON_REQ_FLAG_b "NetworkSignal ComScl_Gbx_RawSignal_CVT_MISS_MILON_REQ_FLAG_b" UBYTE RB_RBA_Common_CentralElements_CompuMethods_Identical 1 100 0.0 255. FORMAT "%10.0" ECU_ADDRESS 0x60011AEF /end MEASUREMENT
/begin MEASUREMENT ComScl_Gbx_RawSignal_CVT_MISS_VSENS_FAIL_FLAG_b "NetworkSignal ComScl_Gbx_RawSignal_CVT_MISS_VSENS_FAIL_FLAG_b" UBYTE RB_RBA_Common_CentralElements_CompuMethods_Identical 1 100 0.0 255. FORMAT "%10.0" ECU_ADDRESS 0x60011AEE /end MEASUREMENT
/begin MEASUREMENT ComScl_Gbx_RawSignal_CVT_MISS_VSENS_OK_FLAG_b "NetworkSignal ComScl_Gbx_RawSignal_CVT_MISS_VSENS_OK_FLAG_b" UBYTE RB_RBA_Common_CentralElements_CompuMethods_Identical 1 100 0.0 255. FORMAT "%10.0" ECU_ADDRESS 0x60011AED /end MEASUREMENT
/begin MEASUREMENT ComScl_Gbx_RawSignal_CVT_MISS_VSENS_TFCD_FLAG_b "NetworkSignal ComScl_Gbx_RawSignal_CVT_MISS_VSENS_TFCD_FLAG_b" UBYTE RB_RBA_Common_CentralElements_CompuMethods_Identical 1 100 0.0 255. FORMAT "%10.0" ECU_ADDRESS 0x60011AEC /end MEASUREMENT
/begin MEASUREMENT ComScl_Gbx_RawSignal_CVT_RATIO_INFO_191_u8 "NetworkSignal ComScl_Gbx_RawSignal_CVT_RATIO_INFO_191_u8" UBYTE RB_RBA_Common_CentralElements_CompuMethods_Identical 1 100 0.0 255. FORMAT "%10.0" ECU_ADDRESS 0x60011AEB /end MEASUREMENT
/begin MEASUREMENT ComScl_Gbx_RawSignal_CVT_SHFT_IN_D_b "NetworkSignal ComScl_Gbx_RawSignal_CVT_SHFT_IN_D_b" UBYTE RB_RBA_Common_CentralElements_CompuMethods_Identical 1 100 0.0 255. FORMAT "%10.0" ECU_ADDRESS 0x60011AEA /end MEASUREMENT
/begin MEASUREMENT ComScl_Gbx_RawSignal_CVT_SHFT_IN_L_b "NetworkSignal ComScl_Gbx_RawSignal_CVT_SHFT_IN_L_b" UBYTE RB_RBA_Common_CentralElements_CompuMethods_Identical 1 100 0.0 255. FORMAT "%10.0" ECU_ADDRESS 0x60011AE9 /end MEASUREMENT
/begin MEASUREMENT ComScl_Gbx_RawSignal_CVT_SHFT_IN_NEUTRAL_b "NetworkSignal ComScl_Gbx_RawSignal_CVT_SHFT_IN_NEUTRAL_b" UBYTE RB_RBA_Common_CentralElements_CompuMethods_Identical 1 100 0.0 255. FORMAT "%10.0" ECU_ADDRESS 0x60011AE8 /end MEASUREMENT
/begin MEASUREMENT ComScl_Gbx_RawSignal_CVT_SHFT_IN_PARKING_b "NetworkSignal ComScl_Gbx_RawSignal_CVT_SHFT_IN_PARKING_b" UBYTE RB_RBA_Common_CentralElements_CompuMethods_Identical 1 100 0.0 255. FORMAT "%10.0" ECU_ADDRESS 0x60011AE7 /end MEASUREMENT
/begin MEASUREMENT ComScl_Gbx_RawSignal_CVT_SHFT_IN_REVERSE_b "NetworkSignal ComScl_Gbx_RawSignal_CVT_SHFT_IN_REVERSE_b" UBYTE RB_RBA_Common_CentralElements_CompuMethods_Identical 1 100 0.0 255. FORMAT "%10.0" ECU_ADDRESS 0x60011AE6 /end MEASUREMENT
/begin MEASUREMENT ComScl_Gbx_RawSignal_CVT_SHFT_IN_S_b "NetworkSignal ComScl_Gbx_RawSignal_CVT_SHFT_IN_S_b" UBYTE RB_RBA_Common_CentralElements_CompuMethods_Identical 1 100 0.0 255. FORMAT "%10.0" ECU_ADDRESS 0x60011AE5 /end MEASUREMENT
/begin MEASUREMENT ComScl_Gbx_RawSignal_CVT_SHIFT_SURE_b "NetworkSignal ComScl_Gbx_RawSignal_CVT_SHIFT_SURE_b" UBYTE RB_RBA_Common_CentralElements_CompuMethods_Identical 1 100 0.0 255. FORMAT "%10.0" ECU_ADDRESS 0x60011AE4 /end MEASUREMENT
/begin MEASUREMENT ComScl_Gbx_RawSignal_CVT_TRANS_MIL_b "NetworkSignal ComScl_Gbx_RawSignal_CVT_TRANS_MIL_b" UBYTE RB_RBA_Common_CentralElements_CompuMethods_Identical 1 100 0.0 255. FORMAT "%10.0" ECU_ADDRESS 0x60011AE3 /end MEASUREMENT
/begin MEASUREMENT ComScl_Gbx_RawSignal_EAT_ALIVE_COUNTER_158_u8 "NetworkSignal ComScl_Gbx_RawSignal_EAT_ALIVE_COUNTER_158_u8" UBYTE RB_RBA_Common_CentralElements_CompuMethods_Identical 1 100 0.0 255. FORMAT "%10.0" ECU_ADDRESS 0x60011AF2 /end MEASUREMENT
/begin MEASUREMENT ComScl_Gbx_RawSignal_EAT_ALIVE_COUNTER_191_u8 "NetworkSignal ComScl_Gbx_RawSignal_EAT_ALIVE_COUNTER_191_u8" UBYTE RB_RBA_Common_CentralElements_CompuMethods_Identical 1 100 0.0 255. FORMAT "%10.0" ECU_ADDRESS 0x60011AE2 /end MEASUREMENT
/begin MEASUREMENT ComScl_Gbx_RawSignal_EAT_ALIVE_COUNTER_41B_u8 "NetworkSignal ComScl_Gbx_RawSignal_EAT_ALIVE_COUNTER_41B_u8" UBYTE RB_RBA_Common_CentralElements_CompuMethods_Identical 1 100 0.0 255. FORMAT "%10.0" ECU_ADDRESS 0x60011B0C /end MEASUREMENT
/begin MEASUREMENT ComScl_Gbx_RawSignal_EAT_ATF_TEMP_INVALID_b "NetworkSignal ComScl_Gbx_RawSignal_EAT_ATF_TEMP_INVALID_b" UBYTE RB_RBA_Common_CentralElements_CompuMethods_Identical 1 100 0.0 255. FORMAT "%10.0" ECU_ADDRESS 0x60011B0B /end MEASUREMENT
/begin MEASUREMENT ComScl_Gbx_RawSignal_EAT_CHECKSUM_158_u8 "NetworkSignal ComScl_Gbx_RawSignal_EAT_CHECKSUM_158_u8" UBYTE RB_RBA_Common_CentralElements_CompuMethods_Identical 1 100 0.0 255. FORMAT "%10.0" ECU_ADDRESS 0x60011AF1 /end MEASUREMENT
/begin MEASUREMENT ComScl_Gbx_RawSignal_EAT_CHECKSUM_191_u8 "NetworkSignal ComScl_Gbx_RawSignal_EAT_CHECKSUM_191_u8" UBYTE RB_RBA_Common_CentralElements_CompuMethods_Identical 1 100 0.0 255. FORMAT "%10.0" ECU_ADDRESS 0x60011AE1 /end MEASUREMENT
/begin MEASUREMENT ComScl_Gbx_RawSignal_EAT_CHECKSUM_41B_u8 "NetworkSignal ComScl_Gbx_RawSignal_EAT_CHECKSUM_41B_u8" UBYTE RB_RBA_Common_CentralElements_CompuMethods_Identical 1 100 0.0 255. FORMAT "%10.0" ECU_ADDRESS 0x60011B0A /end MEASUREMENT
/begin MEASUREMENT ComScl_Gbx_RawSignal_EAT_REF_DISTANCE_TRAVELLED_u8 "NetworkSignal ComScl_Gbx_RawSignal_EAT_REF_DISTANCE_TRAVELLED_u8" UBYTE RB_RBA_Common_CentralElements_CompuMethods_Identical 1 100 0.0 255. FORMAT "%10.0" ECU_ADDRESS 0x60011AF0 /end MEASUREMENT
/begin MEASUREMENT ComScl_Gbx_RawSignal_EAT_TRANS_MAIN_SHAFT_SPEED_u16 "NetworkSignal ComScl_Gbx_RawSignal_EAT_TRANS_MAIN_SHAFT_SPEED_u16" UWORD RB_RBA_Common_CentralElements_CompuMethods_Identical 1 100 0.0 65535. FORMAT "%10.0" ECU_ADDRESS 0x6000B45C /end MEASUREMENT
/begin MEASUREMENT ComScl_Gbx_RawSignal_EAT_TRANS_SPEED_VNC_u16 "NetworkSignal ComScl_Gbx_RawSignal_EAT_TRANS_SPEED_VNC_u16" UWORD RB_RBA_Common_CentralElements_CompuMethods_Identical 1 100 0.0 65535. FORMAT "%10.0" ECU_ADDRESS 0x6000B458 /end MEASUREMENT
/begin MEASUREMENT ComScl_Gbx_RawSignal_EAT_TRANS_SPEED_u16 "NetworkSignal ComScl_Gbx_RawSignal_EAT_TRANS_SPEED_u16" UWORD RB_RBA_Common_CentralElements_CompuMethods_Identical 1 100 0.0 65535. FORMAT "%10.0" ECU_ADDRESS 0x6000B45A /end MEASUREMENT
/begin MEASUREMENT ComScl_Gbx_RawSignal_TM_ALCZONE_u8 "NetworkSignal ComScl_Gbx_RawSignal_TM_ALCZONE_u8" UBYTE RB_RBA_Common_CentralElements_CompuMethods_Identical 1 100 0.0 255. FORMAT "%10.0" ECU_ADDRESS 0x60011B16 /end MEASUREMENT
/begin MEASUREMENT ComScl_Gbx_RawSignal_TM_ALIVE_COUNTER_071_u8 "NetworkSignal ComScl_Gbx_RawSignal_TM_ALIVE_COUNTER_071_u8" UBYTE RB_RBA_Common_CentralElements_CompuMethods_Identical 1 100 0.0 255. FORMAT "%10.0" ECU_ADDRESS 0x60011B08 /end MEASUREMENT
/begin MEASUREMENT ComScl_Gbx_RawSignal_TM_ALIVE_COUNTER_072_u8 "NetworkSignal ComScl_Gbx_RawSignal_TM_ALIVE_COUNTER_072_u8" UBYTE RB_RBA_Common_CentralElements_CompuMethods_Identical 1 100 0.0 255. FORMAT "%10.0" ECU_ADDRESS 0x60011AFC /end MEASUREMENT
/begin MEASUREMENT ComScl_Gbx_RawSignal_TM_ALIVE_COUNTER_07B_u8 "NetworkSignal ComScl_Gbx_RawSignal_TM_ALIVE_COUNTER_07B_u8" UBYTE RB_RBA_Common_CentralElements_CompuMethods_Identical 1 100 0.0 255. FORMAT "%10.0" ECU_ADDRESS 0x60011B22 /end MEASUREMENT
/begin MEASUREMENT ComScl_Gbx_RawSignal_TM_ALIVE_COUNTER_07C_u8 "NetworkSignal ComScl_Gbx_RawSignal_TM_ALIVE_COUNTER_07C_u8" UBYTE RB_RBA_Common_CentralElements_CompuMethods_Identical 1 100 0.0 255. FORMAT "%10.0" ECU_ADDRESS 0x60011B24 /end MEASUREMENT
/begin MEASUREMENT ComScl_Gbx_RawSignal_TM_ALIVE_COUNTER_07E_u8 "NetworkSignal ComScl_Gbx_RawSignal_TM_ALIVE_COUNTER_07E_u8" UBYTE RB_RBA_Common_CentralElements_CompuMethods_Identical 1 100 0.0 255. FORMAT "%10.0" ECU_ADDRESS 0x60011B15 /end MEASUREMENT
/begin MEASUREMENT ComScl_Gbx_RawSignal_TM_ALIVE_COUNTER_19D_u8 "NetworkSignal ComScl_Gbx_RawSignal_TM_ALIVE_COUNTER_19D_u8" UBYTE RB_RBA_Common_CentralElements_CompuMethods_Identical 1 100 0.0 255. FORMAT "%10.0" ECU_ADDRESS 0x60011B11 /end MEASUREMENT
/begin MEASUREMENT ComScl_Gbx_RawSignal_TM_ALIVE_COUNTER_1BF_u8 "NetworkSignal ComScl_Gbx_RawSignal_TM_ALIVE_COUNTER_1BF_u8" UBYTE RB_RBA_Common_CentralElements_CompuMethods_Identical 1 100 0.0 255. FORMAT "%10.0" ECU_ADDRESS 0x60011B20 /end MEASUREMENT
/begin MEASUREMENT ComScl_Gbx_RawSignal_TM_ALIVE_COUNTER_1F0_u8 "NetworkSignal ComScl_Gbx_RawSignal_TM_ALIVE_COUNTER_1F0_u8" UBYTE RB_RBA_Common_CentralElements_CompuMethods_Identical 1 100 0.0 255. FORMAT "%10.0" ECU_ADDRESS 0x60011B2A /end MEASUREMENT
/begin MEASUREMENT ComScl_Gbx_RawSignal_TM_ALIVE_COUNTER_351_u8 "NetworkSignal ComScl_Gbx_RawSignal_TM_ALIVE_COUNTER_351_u8" UBYTE RB_RBA_Common_CentralElements_CompuMethods_Identical 1 100 0.0 255. FORMAT "%10.0" ECU_ADDRESS 0x60011B1B /end MEASUREMENT
/begin MEASUREMENT ComScl_Gbx_RawSignal_TM_ALIVE_COUNTER_40B_u8 "NetworkSignal ComScl_Gbx_RawSignal_TM_ALIVE_COUNTER_40B_u8" UBYTE RB_RBA_Common_CentralElements_CompuMethods_Identical 1 100 0.0 255. FORMAT "%10.0" ECU_ADDRESS 0x60011AE0 /end MEASUREMENT
/begin MEASUREMENT ComScl_Gbx_RawSignal_TM_ATF_TEMP_u8 "NetworkSignal ComScl_Gbx_RawSignal_TM_ATF_TEMP_u8" UBYTE RB_RBA_Common_CentralElements_CompuMethods_Identical 1 100 0.0 255. FORMAT "%10.0" ECU_ADDRESS 0x60011B09 /end MEASUREMENT
/begin MEASUREMENT ComScl_Gbx_RawSignal_TM_AT_CC_FWD_b "NetworkSignal ComScl_Gbx_RawSignal_TM_AT_CC_FWD_b" UBYTE RB_RBA_Common_CentralElements_CompuMethods_Identical 1 100 0.0 255. FORMAT "%10.0" ECU_ADDRESS 0x60011AFB /end MEASUREMENT
/begin MEASUREMENT ComScl_Gbx_RawSignal_TM_CHECKSUM_071_u8 "NetworkSignal ComScl_Gbx_RawSignal_TM_CHECKSUM_071_u8" UBYTE RB_RBA_Common_CentralElements_CompuMethods_Identical 1 100 0.0 255. FORMAT "%10.0" ECU_ADDRESS 0x60011B07 /end MEASUREMENT
/begin MEASUREMENT ComScl_Gbx_RawSignal_TM_CHECKSUM_072_u8 "NetworkSignal ComScl_Gbx_RawSignal_TM_CHECKSUM_072_u8" UBYTE RB_RBA_Common_CentralElements_CompuMethods_Identical 1 100 0.0 255. FORMAT "%10.0" ECU_ADDRESS 0x60011AFA /end MEASUREMENT
/begin MEASUREMENT ComScl_Gbx_RawSignal_TM_CHECKSUM_07B_u8 "NetworkSignal ComScl_Gbx_RawSignal_TM_CHECKSUM_07B_u8" UBYTE RB_RBA_Common_CentralElements_CompuMethods_Identical 1 100 0.0 255. FORMAT "%10.0" ECU_ADDRESS 0x60011B21 /end MEASUREMENT
/begin MEASUREMENT ComScl_Gbx_RawSignal_TM_CHECKSUM_07C_u8 "NetworkSignal ComScl_Gbx_RawSignal_TM_CHECKSUM_07C_u8" UBYTE RB_RBA_Common_CentralElements_CompuMethods_Identical 1 100 0.0 255. FORMAT "%10.0" ECU_ADDRESS 0x60011B23 /end MEASUREMENT
/begin MEASUREMENT ComScl_Gbx_RawSignal_TM_CHECKSUM_07E_u8 "NetworkSignal ComScl_Gbx_RawSignal_TM_CHECKSUM_07E_u8" UBYTE RB_RBA_Common_CentralElements_CompuMethods_Identical 1 100 0.0 255. FORMAT "%10.0" ECU_ADDRESS 0x60011B14 /end MEASUREMENT
/begin MEASUREMENT ComScl_Gbx_RawSignal_TM_CHECKSUM_19D_u8 "NetworkSignal ComScl_Gbx_RawSignal_TM_CHECKSUM_19D_u8" UBYTE RB_RBA_Common_CentralElements_CompuMethods_Identical 1 100 0.0 255. FORMAT "%10.0" ECU_ADDRESS 0x60011B10 /end MEASUREMENT
/begin MEASUREMENT ComScl_Gbx_RawSignal_TM_CHECKSUM_1BF_u8 "NetworkSignal ComScl_Gbx_RawSignal_TM_CHECKSUM_1BF_u8" UBYTE RB_RBA_Common_CentralElements_CompuMethods_Identical 1 100 0.0 255. FORMAT "%10.0" ECU_ADDRESS 0x60011B1F /end MEASUREMENT
/begin MEASUREMENT ComScl_Gbx_RawSignal_TM_CHECKSUM_1F0_u8 "NetworkSignal ComScl_Gbx_RawSignal_TM_CHECKSUM_1F0_u8" UBYTE RB_RBA_Common_CentralElements_CompuMethods_Identical 1 100 0.0 255. FORMAT "%10.0" ECU_ADDRESS 0x60011B29 /end MEASUREMENT
/begin MEASUREMENT ComScl_Gbx_RawSignal_TM_CHECKSUM_351_u8 "NetworkSignal ComScl_Gbx_RawSignal_TM_CHECKSUM_351_u8" UBYTE RB_RBA_Common_CentralElements_CompuMethods_Identical 1 100 0.0 255. FORMAT "%10.0" ECU_ADDRESS 0x60011B1A /end MEASUREMENT
/begin MEASUREMENT ComScl_Gbx_RawSignal_TM_CHECKSUM_40B_u8 "NetworkSignal ComScl_Gbx_RawSignal_TM_CHECKSUM_40B_u8" UBYTE RB_RBA_Common_CentralElements_CompuMethods_Identical 1 100 0.0 255. FORMAT "%10.0" ECU_ADDRESS 0x60011ADF /end MEASUREMENT
/begin MEASUREMENT ComScl_Gbx_RawSignal_TM_CVTNP_FLAG_b "NetworkSignal ComScl_Gbx_RawSignal_TM_CVTNP_FLAG_b" UBYTE RB_RBA_Common_CentralElements_CompuMethods_Identical 1 100 0.0 255. FORMAT "%10.0" ECU_ADDRESS 0x60011AF9 /end MEASUREMENT
/begin MEASUREMENT ComScl_Gbx_RawSignal_TM_DEC_FC_LC_OK_b "NetworkSignal ComScl_Gbx_RawSignal_TM_DEC_FC_LC_OK_b" UBYTE RB_RBA_Common_CentralElements_CompuMethods_Identical 1 100 0.0 255. FORMAT "%10.0" ECU_ADDRESS 0x60011AF8 /end MEASUREMENT
/begin MEASUREMENT ComScl_Gbx_RawSignal_TM_ECON_POS_FAIL_OK_b "NetworkSignal ComScl_Gbx_RawSignal_TM_ECON_POS_FAIL_OK_b" UBYTE RB_RBA_Common_CentralElements_CompuMethods_Identical 1 100 0.0 255. FORMAT "%10.0" ECU_ADDRESS 0x60011B06 /end MEASUREMENT
/begin MEASUREMENT ComScl_Gbx_RawSignal_TM_FAULT_ACTION_STATUS_VSP_FAIL_b "NetworkSignal ComScl_Gbx_RawSignal_TM_FAULT_ACTION_STATUS_VSP_FAIL_b" UBYTE RB_RBA_Common_CentralElements_CompuMethods_Identical 1 100 0.0 255. FORMAT "%10.0" ECU_ADDRESS 0x60011AF7 /end MEASUREMENT
/begin MEASUREMENT ComScl_Gbx_RawSignal_TM_F_DFTRFENTM_b "NetworkSignal ComScl_Gbx_RawSignal_TM_F_DFTRFENTM_b" UBYTE RB_RBA_Common_CentralElements_CompuMethods_Identical 1 100 0.0 255. FORMAT "%10.0" ECU_ADDRESS 0x60011B28 /end MEASUREMENT
/begin MEASUREMENT ComScl_Gbx_RawSignal_TM_GEARPOS_N_DET_b "NetworkSignal ComScl_Gbx_RawSignal_TM_GEARPOS_N_DET_b" UBYTE RB_RBA_Common_CentralElements_CompuMethods_Identical 1 100 0.0 255. FORMAT "%10.0" ECU_ADDRESS 0x60011B1E /end MEASUREMENT
/begin MEASUREMENT ComScl_Gbx_RawSignal_TM_GEARPOS_P_DETSUB_b "NetworkSignal ComScl_Gbx_RawSignal_TM_GEARPOS_P_DETSUB_b" UBYTE RB_RBA_Common_CentralElements_CompuMethods_Identical 1 100 0.0 255. FORMAT "%10.0" ECU_ADDRESS 0x60011B19 /end MEASUREMENT
/begin MEASUREMENT ComScl_Gbx_RawSignal_TM_GEARPOS_P_DET_b "NetworkSignal ComScl_Gbx_RawSignal_TM_GEARPOS_P_DET_b" UBYTE RB_RBA_Common_CentralElements_CompuMethods_Identical 1 100 0.0 255. FORMAT "%10.0" ECU_ADDRESS 0x60011B1D /end MEASUREMENT
/begin MEASUREMENT ComScl_Gbx_RawSignal_TM_GEARPOS_P_REQSUB_b "NetworkSignal ComScl_Gbx_RawSignal_TM_GEARPOS_P_REQSUB_b" UBYTE RB_RBA_Common_CentralElements_CompuMethods_Identical 1 100 0.0 255. FORMAT "%10.0" ECU_ADDRESS 0x60011B18 /end MEASUREMENT
/begin MEASUREMENT ComScl_Gbx_RawSignal_TM_HACCUT_REQ_b "NetworkSignal ComScl_Gbx_RawSignal_TM_HACCUT_REQ_b" UBYTE RB_RBA_Common_CentralElements_CompuMethods_Identical 1 100 0.0 255. FORMAT "%10.0" ECU_ADDRESS 0x60011B05 /end MEASUREMENT
/begin MEASUREMENT ComScl_Gbx_RawSignal_TM_HEAVY_DEC_FLAG_b "NetworkSignal ComScl_Gbx_RawSignal_TM_HEAVY_DEC_FLAG_b" UBYTE RB_RBA_Common_CentralElements_CompuMethods_Identical 1 100 0.0 255. FORMAT "%10.0" ECU_ADDRESS 0x60011B04 /end MEASUREMENT
/begin MEASUREMENT ComScl_Gbx_RawSignal_TM_IDLE_STOP_CONDITION_b "NetworkSignal ComScl_Gbx_RawSignal_TM_IDLE_STOP_CONDITION_b" UBYTE RB_RBA_Common_CentralElements_CompuMethods_Identical 1 100 0.0 255. FORMAT "%10.0" ECU_ADDRESS 0x60011B27 /end MEASUREMENT
/begin MEASUREMENT ComScl_Gbx_RawSignal_TM_IDLE_STOP_OK_b "NetworkSignal ComScl_Gbx_RawSignal_TM_IDLE_STOP_OK_b" UBYTE RB_RBA_Common_CentralElements_CompuMethods_Identical 1 100 0.0 255. FORMAT "%10.0" ECU_ADDRESS 0x60011B26 /end MEASUREMENT
/begin MEASUREMENT ComScl_Gbx_RawSignal_TM_IDLE_STOP_TRIGGER_b "NetworkSignal ComScl_Gbx_RawSignal_TM_IDLE_STOP_TRIGGER_b" UBYTE RB_RBA_Common_CentralElements_CompuMethods_Identical 1 100 0.0 255. FORMAT "%10.0" ECU_ADDRESS 0x60011B25 /end MEASUREMENT
/begin MEASUREMENT ComScl_Gbx_RawSignal_TM_IG1_STATE_b "NetworkSignal ComScl_Gbx_RawSignal_TM_IG1_STATE_b" UBYTE RB_RBA_Common_CentralElements_CompuMethods_Identical 1 100 0.0 255. FORMAT "%10.0" ECU_ADDRESS 0x60011ADE /end MEASUREMENT
/begin MEASUREMENT ComScl_Gbx_RawSignal_TM_IG1_VOLTAGE_u16 "NetworkSignal ComScl_Gbx_RawSignal_TM_IG1_VOLTAGE_u16" UWORD RB_RBA_Common_CentralElements_CompuMethods_Identical 1 100 0.0 65535. FORMAT "%10.0" ECU_ADDRESS 0x6000B456 /end MEASUREMENT
/begin MEASUREMENT ComScl_Gbx_RawSignal_TM_LC_INFORMATION_u8 "NetworkSignal ComScl_Gbx_RawSignal_TM_LC_INFORMATION_u8" UBYTE RB_RBA_Common_CentralElements_CompuMethods_Identical 1 100 0.0 255. FORMAT "%10.0" ECU_ADDRESS 0x60011AF6 /end MEASUREMENT
/begin MEASUREMENT ComScl_Gbx_RawSignal_TM_LIMP_HOME_MODE_b "NetworkSignal ComScl_Gbx_RawSignal_TM_LIMP_HOME_MODE_b" UBYTE RB_RBA_Common_CentralElements_CompuMethods_Identical 1 100 0.0 255. FORMAT "%10.0" ECU_ADDRESS 0x60011B0F /end MEASUREMENT
/begin MEASUREMENT ComScl_Gbx_RawSignal_TM_MAP_CC_u8 "NetworkSignal ComScl_Gbx_RawSignal_TM_MAP_CC_u8" UBYTE RB_RBA_Common_CentralElements_CompuMethods_Identical 1 100 0.0 255. FORMAT "%10.0" ECU_ADDRESS 0x60011AF5 /end MEASUREMENT
/begin MEASUREMENT ComScl_Gbx_RawSignal_TM_MIL_REQUEST_b "NetworkSignal ComScl_Gbx_RawSignal_TM_MIL_REQUEST_b" UBYTE RB_RBA_Common_CentralElements_CompuMethods_Identical 1 100 0.0 255. FORMAT "%10.0" ECU_ADDRESS 0x60011AF4 /end MEASUREMENT
/begin MEASUREMENT ComScl_Gbx_RawSignal_TM_M_MODE_RUN_b "NetworkSignal ComScl_Gbx_RawSignal_TM_M_MODE_RUN_b" UBYTE RB_RBA_Common_CentralElements_CompuMethods_Identical 1 100 0.0 255. FORMAT "%10.0" ECU_ADDRESS 0x60011B13 /end MEASUREMENT
/begin MEASUREMENT ComScl_Gbx_RawSignal_TM_N_TC_u16 "NetworkSignal ComScl_Gbx_RawSignal_TM_N_TC_u16" UWORD RB_RBA_Common_CentralElements_CompuMethods_Identical 1 100 0.0 65535. FORMAT "%10.0" ECU_ADDRESS 0x6000B460 /end MEASUREMENT
/begin MEASUREMENT ComScl_Gbx_RawSignal_TM_OVERALL_FILTERED_RATIO_u16 "NetworkSignal ComScl_Gbx_RawSignal_TM_OVERALL_FILTERED_RATIO_u16" UWORD RB_RBA_Common_CentralElements_CompuMethods_Identical 1 100 0.0 65535. FORMAT "%10.0" ECU_ADDRESS 0x6000B46C /end MEASUREMENT
/begin MEASUREMENT ComScl_Gbx_RawSignal_TM_RECOGNITION_VOLTAGE_u16 "NetworkSignal ComScl_Gbx_RawSignal_TM_RECOGNITION_VOLTAGE_u16" UWORD RB_RBA_Common_CentralElements_CompuMethods_Identical 1 100 0.0 65535. FORMAT "%10.0" ECU_ADDRESS 0x6000B454 /end MEASUREMENT
/begin MEASUREMENT ComScl_Gbx_RawSignal_TM_REQ_ENG_TORQUE_FAST_s16 "NetworkSignal ComScl_Gbx_RawSignal_TM_REQ_ENG_TORQUE_FAST_s16" SWORD RB_RBA_Common_CentralElements_CompuMethods_Identical 1 100 -32768. 32767. FORMAT "%10.0" ECU_ADDRESS 0x6000B466 /end MEASUREMENT
/begin MEASUREMENT ComScl_Gbx_RawSignal_TM_REQ_ENG_TORQUE_SLOW_s16 "NetworkSignal ComScl_Gbx_RawSignal_TM_REQ_ENG_TORQUE_SLOW_s16" SWORD RB_RBA_Common_CentralElements_CompuMethods_Identical 1 100 -32768. 32767. FORMAT "%10.0" ECU_ADDRESS 0x6000B464 /end MEASUREMENT
/begin MEASUREMENT ComScl_Gbx_RawSignal_TM_REQ_MAX_FC_LIMT_ENG_SPEED_u8 "NetworkSignal ComScl_Gbx_RawSignal_TM_REQ_MAX_FC_LIMT_ENG_SPEED_u8" UBYTE RB_RBA_Common_CentralElements_CompuMethods_Identical 1 100 0.0 255. FORMAT "%10.0" ECU_ADDRESS 0x60011B03 /end MEASUREMENT
/begin MEASUREMENT ComScl_Gbx_RawSignal_TM_REQ_MAX_TQ_LIMT_ENG_SPEED_u8 "NetworkSignal ComScl_Gbx_RawSignal_TM_REQ_MAX_TQ_LIMT_ENG_SPEED_u8" UBYTE RB_RBA_Common_CentralElements_CompuMethods_Identical 1 100 0.0 255. FORMAT "%10.0" ECU_ADDRESS 0x60011B02 /end MEASUREMENT
/begin MEASUREMENT ComScl_Gbx_RawSignal_TM_REQ_MIN_IDLE_ENG_SPEED_u8 "NetworkSignal ComScl_Gbx_RawSignal_TM_REQ_MIN_IDLE_ENG_SPEED_u8" UBYTE RB_RBA_Common_CentralElements_CompuMethods_Identical 1 100 0.0 255. FORMAT "%10.0" ECU_ADDRESS 0x60011B01 /end MEASUREMENT
/begin MEASUREMENT ComScl_Gbx_RawSignal_TM_SHFT_IND_RECOM_DOWN_b "NetworkSignal ComScl_Gbx_RawSignal_TM_SHFT_IND_RECOM_DOWN_b" UBYTE RB_RBA_Common_CentralElements_CompuMethods_Identical 1 100 0.0 255. FORMAT "%10.0" ECU_ADDRESS 0x60011B00 /end MEASUREMENT
/begin MEASUREMENT ComScl_Gbx_RawSignal_TM_SHFT_IND_RECOM_UP_b "NetworkSignal ComScl_Gbx_RawSignal_TM_SHFT_IND_RECOM_UP_b" UBYTE RB_RBA_Common_CentralElements_CompuMethods_Identical 1 100 0.0 255. FORMAT "%10.0" ECU_ADDRESS 0x60011AFF /end MEASUREMENT
/begin MEASUREMENT ComScl_Gbx_RawSignal_TM_SHIFT_CONTROL_MODE_u8 "NetworkSignal ComScl_Gbx_RawSignal_TM_SHIFT_CONTROL_MODE_u8" UBYTE RB_RBA_Common_CentralElements_CompuMethods_Identical 1 100 0.0 255. FORMAT "%10.0" ECU_ADDRESS 0x60011AF3 /end MEASUREMENT
/begin MEASUREMENT ComScl_Gbx_RawSignal_TM_START_ENABLESUB_b "NetworkSignal ComScl_Gbx_RawSignal_TM_START_ENABLESUB_b" UBYTE RB_RBA_Common_CentralElements_CompuMethods_Identical 1 100 0.0 255. FORMAT "%10.0" ECU_ADDRESS 0x60011B17 /end MEASUREMENT
/begin MEASUREMENT ComScl_Gbx_RawSignal_TM_START_ENABLE_b "NetworkSignal ComScl_Gbx_RawSignal_TM_START_ENABLE_b" UBYTE RB_RBA_Common_CentralElements_CompuMethods_Identical 1 100 0.0 255. FORMAT "%10.0" ECU_ADDRESS 0x60011B1C /end MEASUREMENT
/begin MEASUREMENT ComScl_Gbx_RawSignal_TM_TORQUE_CONVERTER_SLIP_u16 "NetworkSignal ComScl_Gbx_RawSignal_TM_TORQUE_CONVERTER_SLIP_u16" UWORD RB_RBA_Common_CentralElements_CompuMethods_Identical 1 100 0.0 65535. FORMAT "%10.0" ECU_ADDRESS 0x6000B45E /end MEASUREMENT
/begin MEASUREMENT ComScl_Gbx_RawSignal_TM_TORQUE_CONV_TORQUE_RATIO_u16 "NetworkSignal ComScl_Gbx_RawSignal_TM_TORQUE_CONV_TORQUE_RATIO_u16" UWORD RB_RBA_Common_CentralElements_CompuMethods_Identical 1 100 0.0 65535. FORMAT "%10.0" ECU_ADDRESS 0x6000B46E /end MEASUREMENT
/begin MEASUREMENT ComScl_Gbx_RawSignal_TM_TORQUE_LOSSES_s16 "NetworkSignal ComScl_Gbx_RawSignal_TM_TORQUE_LOSSES_s16" SWORD RB_RBA_Common_CentralElements_CompuMethods_Identical 1 100 -32768. 32767. FORMAT "%10.0" ECU_ADDRESS 0x6000B462 /end MEASUREMENT
/begin MEASUREMENT ComScl_Gbx_RawSignal_TM_TRQ_CONTROL_MODE_FAST_DNREQ_b "NetworkSignal ComScl_Gbx_RawSignal_TM_TRQ_CONTROL_MODE_FAST_DNREQ_b" UBYTE RB_RBA_Common_CentralElements_CompuMethods_Identical 1 100 0.0 255. FORMAT "%10.0" ECU_ADDRESS 0x60011B0E /end MEASUREMENT
/begin MEASUREMENT ComScl_Gbx_RawSignal_TM_TRQ_CONTROL_MODE_SLOW_DNREQ_b "NetworkSignal ComScl_Gbx_RawSignal_TM_TRQ_CONTROL_MODE_SLOW_DNREQ_b" UBYTE RB_RBA_Common_CentralElements_CompuMethods_Identical 1 100 0.0 255. FORMAT "%10.0" ECU_ADDRESS 0x60011B0D /end MEASUREMENT
/begin MEASUREMENT ComScl_Gbx_RawSignal_TM_TRS_DRV_RATIO_u8 "NetworkSignal ComScl_Gbx_RawSignal_TM_TRS_DRV_RATIO_u8" UBYTE RB_RBA_Common_CentralElements_CompuMethods_Identical 1 100 0.0 255. FORMAT "%10.0" ECU_ADDRESS 0x60011AFE /end MEASUREMENT
/begin MEASUREMENT ComScl_Gbx_RawSignal_TM_VEHICLE_SPEED_u16 "NetworkSignal ComScl_Gbx_RawSignal_TM_VEHICLE_SPEED_u16" UWORD RB_RBA_Common_CentralElements_CompuMethods_Identical 1 100 0.0 65535. FORMAT "%10.0" ECU_ADDRESS 0x6000B46A /end MEASUREMENT
/begin MEASUREMENT ComScl_Gbx_RawSignal_TM_VLVW_u16 "NetworkSignal ComScl_Gbx_RawSignal_TM_VLVW_u16" UWORD RB_RBA_Common_CentralElements_CompuMethods_Identical 1 100 0.0 65535. FORMAT "%10.0" ECU_ADDRESS 0x6000B468 /end MEASUREMENT
/begin MEASUREMENT ComScl_Gbx_RawSignal_TM_VSA_INH_b "NetworkSignal ComScl_Gbx_RawSignal_TM_VSA_INH_b" UBYTE RB_RBA_Common_CentralElements_CompuMethods_Identical 1 100 0.0 255. FORMAT "%10.0" ECU_ADDRESS 0x60011B12 /end MEASUREMENT
/begin MEASUREMENT ComScl_Gbx_RawSignal_TM_WRITE_VIN_CLEAR_DONE_b "NetworkSignal ComScl_Gbx_RawSignal_TM_WRITE_VIN_CLEAR_DONE_b" UBYTE RB_RBA_Common_CentralElements_CompuMethods_Identical 1 100 0.0 255. FORMAT "%10.0" ECU_ADDRESS 0x60011AFD /end MEASUREMENT
/begin MEASUREMENT ComScl_Gw_RawSignal_GW_ALIVE_COUNTER_40E_u8 "NetworkSignal ComScl_Gw_RawSignal_GW_ALIVE_COUNTER_40E_u8" UBYTE RB_RBA_Common_CentralElements_CompuMethods_Identical 1 100 0.0 255. FORMAT "%10.0" ECU_ADDRESS 0x60011B2D /end MEASUREMENT
/begin MEASUREMENT ComScl_Gw_RawSignal_GW_ALIVE_COUNTER_444_u8 "NetworkSignal ComScl_Gw_RawSignal_GW_ALIVE_COUNTER_444_u8" UBYTE RB_RBA_Common_CentralElements_CompuMethods_Identical 1 100 0.0 255. FORMAT "%10.0" ECU_ADDRESS 0x60011B48 /end MEASUREMENT
/begin MEASUREMENT ComScl_Gw_RawSignal_GW_CHECKSUM_40E_u8 "NetworkSignal ComScl_Gw_RawSignal_GW_CHECKSUM_40E_u8" UBYTE RB_RBA_Common_CentralElements_CompuMethods_Identical 1 100 0.0 255. FORMAT "%10.0" ECU_ADDRESS 0x60011B2C /end MEASUREMENT
/begin MEASUREMENT ComScl_Gw_RawSignal_GW_CHECKSUM_444_u8 "NetworkSignal ComScl_Gw_RawSignal_GW_CHECKSUM_444_u8" UBYTE RB_RBA_Common_CentralElements_CompuMethods_Identical 1 100 0.0 255. FORMAT "%10.0" ECU_ADDRESS 0x60011B47 /end MEASUREMENT
/begin MEASUREMENT ComScl_Gw_RawSignal_GW_IG1_STATE_b "NetworkSignal ComScl_Gw_RawSignal_GW_IG1_STATE_b" UBYTE RB_RBA_Common_CentralElements_CompuMethods_Identical 1 100 0.0 255. FORMAT "%10.0" ECU_ADDRESS 0x60011B2B /end MEASUREMENT
/begin MEASUREMENT ComScl_Gw_RawSignal_GW_IG1_VOLTAGE_u16 "NetworkSignal ComScl_Gw_RawSignal_GW_IG1_VOLTAGE_u16" UWORD RB_RBA_Common_CentralElements_CompuMethods_Identical 1 100 0.0 65535. FORMAT "%10.0" ECU_ADDRESS 0x6000B472 /end MEASUREMENT
/begin MEASUREMENT ComScl_Gw_RawSignal_GW_RECOGNITION_VOLTAGE_u16 "NetworkSignal ComScl_Gw_RawSignal_GW_RECOGNITION_VOLTAGE_u16" UWORD RB_RBA_Common_CentralElements_CompuMethods_Identical 1 100 0.0 65535. FORMAT "%10.0" ECU_ADDRESS 0x6000B470 /end MEASUREMENT
/begin MEASUREMENT ComScl_Gw_RawSignal_IMG_ALIVE_COUNTER_082_u8 "NetworkSignal ComScl_Gw_RawSignal_IMG_ALIVE_COUNTER_082_u8" UBYTE RB_RBA_Common_CentralElements_CompuMethods_Identical 1 100 0.0 255. FORMAT "%10.0" ECU_ADDRESS 0x60011B41 /end MEASUREMENT
/begin MEASUREMENT ComScl_Gw_RawSignal_IMG_ALIVE_COUNTER_084_u8 "NetworkSignal ComScl_Gw_RawSignal_IMG_ALIVE_COUNTER_084_u8" UBYTE RB_RBA_Common_CentralElements_CompuMethods_Identical 1 100 0.0 255. FORMAT "%10.0" ECU_ADDRESS 0x60011B39 /end MEASUREMENT
/begin MEASUREMENT ComScl_Gw_RawSignal_IMG_ALIVE_COUNTER_22B_u8 "NetworkSignal ComScl_Gw_RawSignal_IMG_ALIVE_COUNTER_22B_u8" UBYTE RB_RBA_Common_CentralElements_CompuMethods_Identical 1 100 0.0 255. FORMAT "%10.0" ECU_ADDRESS 0x60011B45 /end MEASUREMENT
/begin MEASUREMENT ComScl_Gw_RawSignal_IMG_ALIVE_COUNTER_2F1_u8 "NetworkSignal ComScl_Gw_RawSignal_IMG_ALIVE_COUNTER_2F1_u8" UBYTE RB_RBA_Common_CentralElements_CompuMethods_Identical 1 100 0.0 255. FORMAT "%10.0" ECU_ADDRESS 0x60011B30 /end MEASUREMENT
/begin MEASUREMENT ComScl_Gw_RawSignal_IMG_CHECKSUM_082_u8 "NetworkSignal ComScl_Gw_RawSignal_IMG_CHECKSUM_082_u8" UBYTE RB_RBA_Common_CentralElements_CompuMethods_Identical 1 100 0.0 255. FORMAT "%10.0" ECU_ADDRESS 0x60011B40 /end MEASUREMENT
/begin MEASUREMENT ComScl_Gw_RawSignal_IMG_CHECKSUM_084_u8 "NetworkSignal ComScl_Gw_RawSignal_IMG_CHECKSUM_084_u8" UBYTE RB_RBA_Common_CentralElements_CompuMethods_Identical 1 100 0.0 255. FORMAT "%10.0" ECU_ADDRESS 0x60011B38 /end MEASUREMENT
/begin MEASUREMENT ComScl_Gw_RawSignal_IMG_CHECKSUM_22B_u8 "NetworkSignal ComScl_Gw_RawSignal_IMG_CHECKSUM_22B_u8" UBYTE RB_RBA_Common_CentralElements_CompuMethods_Identical 1 100 0.0 255. FORMAT "%10.0" ECU_ADDRESS 0x60011B44 /end MEASUREMENT
/begin MEASUREMENT ComScl_Gw_RawSignal_IMG_CHECKSUM_2F1_u8 "NetworkSignal ComScl_Gw_RawSignal_IMG_CHECKSUM_2F1_u8" UBYTE RB_RBA_Common_CentralElements_CompuMethods_Identical 1 100 0.0 255. FORMAT "%10.0" ECU_ADDRESS 0x60011B2F /end MEASUREMENT
/begin MEASUREMENT ComScl_Gw_RawSignal_IMG_DRVTRQ_STATUS_u8 "NetworkSignal ComScl_Gw_RawSignal_IMG_DRVTRQ_STATUS_u8" UBYTE RB_RBA_Common_CentralElements_CompuMethods_Identical 1 100 0.0 255. FORMAT "%10.0" ECU_ADDRESS 0x60011B3F /end MEASUREMENT
/begin MEASUREMENT ComScl_Gw_RawSignal_IMG_ENG_CAN_RECIEVE_ERROR_b "NetworkSignal ComScl_Gw_RawSignal_IMG_ENG_CAN_RECIEVE_ERROR_b" UBYTE RB_RBA_Common_CentralElements_CompuMethods_Identical 1 100 0.0 255. FORMAT "%10.0" ECU_ADDRESS 0x60011B37 /end MEASUREMENT
/begin MEASUREMENT ComScl_Gw_RawSignal_IMG_F_WVINCLDN_b "NetworkSignal ComScl_Gw_RawSignal_IMG_F_WVINCLDN_b" UBYTE RB_RBA_Common_CentralElements_CompuMethods_Identical 1 100 0.0 255. FORMAT "%10.0" ECU_ADDRESS 0x60011B2E /end MEASUREMENT
/begin MEASUREMENT ComScl_Gw_RawSignal_IMG_IDS_GRP_A12_MODE_u8 "NetworkSignal ComScl_Gw_RawSignal_IMG_IDS_GRP_A12_MODE_u8" UBYTE RB_RBA_Common_CentralElements_CompuMethods_Identical 1 100 0.0 255. FORMAT "%10.0" ECU_ADDRESS 0x60011B43 /end MEASUREMENT
/begin MEASUREMENT ComScl_Gw_RawSignal_IMG_IDS_GRP_A5_MODE_u8 "NetworkSignal ComScl_Gw_RawSignal_IMG_IDS_GRP_A5_MODE_u8" UBYTE RB_RBA_Common_CentralElements_CompuMethods_Identical 1 100 0.0 255. FORMAT "%10.0" ECU_ADDRESS 0x60011B42 /end MEASUREMENT
/begin MEASUREMENT ComScl_Gw_RawSignal_IMG_IS_BHOLD_ACT_b "NetworkSignal ComScl_Gw_RawSignal_IMG_IS_BHOLD_ACT_b" UBYTE RB_RBA_Common_CentralElements_CompuMethods_Identical 1 100 0.0 255. FORMAT "%10.0" ECU_ADDRESS 0x60011B36 /end MEASUREMENT
/begin MEASUREMENT ComScl_Gw_RawSignal_IMG_IS_BHOLD_STANBY_b "NetworkSignal ComScl_Gw_RawSignal_IMG_IS_BHOLD_STANBY_b" UBYTE RB_RBA_Common_CentralElements_CompuMethods_Identical 1 100 0.0 255. FORMAT "%10.0" ECU_ADDRESS 0x60011B35 /end MEASUREMENT
/begin MEASUREMENT ComScl_Gw_RawSignal_IMG_IS_BRKCNT_ADAS_b "NetworkSignal ComScl_Gw_RawSignal_IMG_IS_BRKCNT_ADAS_b" UBYTE RB_RBA_Common_CentralElements_CompuMethods_Identical 1 100 0.0 255. FORMAT "%10.0" ECU_ADDRESS 0x60011B3E /end MEASUREMENT
/begin MEASUREMENT ComScl_Gw_RawSignal_IMG_IS_INHIBITBRK_b "NetworkSignal ComScl_Gw_RawSignal_IMG_IS_INHIBITBRK_b" UBYTE RB_RBA_Common_CentralElements_CompuMethods_Identical 1 100 0.0 255. FORMAT "%10.0" ECU_ADDRESS 0x60011B34 /end MEASUREMENT
/begin MEASUREMENT ComScl_Gw_RawSignal_IMG_IS_RELEASE_REQUEST_b "NetworkSignal ComScl_Gw_RawSignal_IMG_IS_RELEASE_REQUEST_b" UBYTE RB_RBA_Common_CentralElements_CompuMethods_Identical 1 100 0.0 255. FORMAT "%10.0" ECU_ADDRESS 0x60011B3D /end MEASUREMENT
/begin MEASUREMENT ComScl_Gw_RawSignal_IMG_IS_RESTART_INHIBITBRK_b "NetworkSignal ComScl_Gw_RawSignal_IMG_IS_RESTART_INHIBITBRK_b" UBYTE RB_RBA_Common_CentralElements_CompuMethods_Identical 1 100 0.0 255. FORMAT "%10.0" ECU_ADDRESS 0x60011B33 /end MEASUREMENT
/begin MEASUREMENT ComScl_Gw_RawSignal_IMG_IS_SHIFT_INHBITBRK_b "NetworkSignal ComScl_Gw_RawSignal_IMG_IS_SHIFT_INHBITBRK_b" UBYTE RB_RBA_Common_CentralElements_CompuMethods_Identical 1 100 0.0 255. FORMAT "%10.0" ECU_ADDRESS 0x60011B32 /end MEASUREMENT
/begin MEASUREMENT ComScl_Gw_RawSignal_IMG_IS_SYSOFFBRK_b "NetworkSignal ComScl_Gw_RawSignal_IMG_IS_SYSOFFBRK_b" UBYTE RB_RBA_Common_CentralElements_CompuMethods_Identical 1 100 0.0 255. FORMAT "%10.0" ECU_ADDRESS 0x60011B31 /end MEASUREMENT
/begin MEASUREMENT ComScl_Gw_RawSignal_IMG_LIMTRQ_STATUS_u8 "NetworkSignal ComScl_Gw_RawSignal_IMG_LIMTRQ_STATUS_u8" UBYTE RB_RBA_Common_CentralElements_CompuMethods_Identical 1 100 0.0 255. FORMAT "%10.0" ECU_ADDRESS 0x60011B3C /end MEASUREMENT
/begin MEASUREMENT ComScl_Gw_RawSignal_IMG_MIL_REQ_b "NetworkSignal ComScl_Gw_RawSignal_IMG_MIL_REQ_b" UBYTE RB_RBA_Common_CentralElements_CompuMethods_Identical 1 100 0.0 255. FORMAT "%10.0" ECU_ADDRESS 0x60011B46 /end MEASUREMENT
/begin MEASUREMENT ComScl_Gw_RawSignal_IMG_REQ_BRK_CTRL_b "NetworkSignal ComScl_Gw_RawSignal_IMG_REQ_BRK_CTRL_b" UBYTE RB_RBA_Common_CentralElements_CompuMethods_Identical 1 100 0.0 255. FORMAT "%10.0" ECU_ADDRESS 0x60011B3B /end MEASUREMENT
/begin MEASUREMENT ComScl_Gw_RawSignal_IMG_REQ_DRVTRQ_s16 "NetworkSignal ComScl_Gw_RawSignal_IMG_REQ_DRVTRQ_s16" SWORD RB_RBA_Common_CentralElements_CompuMethods_Identical 1 100 -32768. 32767. FORMAT "%10.0" ECU_ADDRESS 0x6000B476 /end MEASUREMENT
/begin MEASUREMENT ComScl_Gw_RawSignal_IMG_REQ_LIMTRQ_s16 "NetworkSignal ComScl_Gw_RawSignal_IMG_REQ_LIMTRQ_s16" SWORD RB_RBA_Common_CentralElements_CompuMethods_Identical 1 100 -32768. 32767. FORMAT "%10.0" ECU_ADDRESS 0x6000B474 /end MEASUREMENT
/begin MEASUREMENT ComScl_Gw_RawSignal_IMG_SHIFT_REQUEST_u8 "NetworkSignal ComScl_Gw_RawSignal_IMG_SHIFT_REQUEST_u8" UBYTE RB_RBA_Common_CentralElements_CompuMethods_Identical 1 100 0.0 255. FORMAT "%10.0" ECU_ADDRESS 0x60011B3A /end MEASUREMENT
/begin MEASUREMENT ComScl_IDAS_RawSignal_IDAS_ALIVE_COUNTER_1EF_u8 "NetworkSignal ComScl_IDAS_RawSignal_IDAS_ALIVE_COUNTER_1EF_u8" UBYTE RB_RBA_Common_CentralElements_CompuMethods_Identical 1 100 0.0 255. FORMAT "%10.0" ECU_ADDRESS 0x60011B4B /end MEASUREMENT
/begin MEASUREMENT ComScl_IDAS_RawSignal_IDAS_CHECKSUM_1EF_u8 "NetworkSignal ComScl_IDAS_RawSignal_IDAS_CHECKSUM_1EF_u8" UBYTE RB_RBA_Common_CentralElements_CompuMethods_Identical 1 100 0.0 255. FORMAT "%10.0" ECU_ADDRESS 0x60011B4A /end MEASUREMENT
/begin MEASUREMENT ComScl_IDAS_RawSignal_IDAS_ISA_BASE_SPEED_u8 "NetworkSignal ComScl_IDAS_RawSignal_IDAS_ISA_BASE_SPEED_u8" UBYTE RB_RBA_Common_CentralElements_CompuMethods_Identical 1 100 0.0 255. FORMAT "%10.0" ECU_ADDRESS 0x60011B49 /end MEASUREMENT
/begin MEASUREMENT ComScl_PCU_RawSignal_PCU_ALIVE_COUNTER_1FB_u8 "NetworkSignal ComScl_PCU_RawSignal_PCU_ALIVE_COUNTER_1FB_u8" UBYTE RB_RBA_Common_CentralElements_CompuMethods_Identical 1 100 0.0 255. FORMAT "%10.0" ECU_ADDRESS 0x60011B4E /end MEASUREMENT
/begin MEASUREMENT ComScl_PCU_RawSignal_PCU_CHECKSUM_1FB_u8 "NetworkSignal ComScl_PCU_RawSignal_PCU_CHECKSUM_1FB_u8" UBYTE RB_RBA_Common_CentralElements_CompuMethods_Identical 1 100 0.0 255. FORMAT "%10.0" ECU_ADDRESS 0x60011B4D /end MEASUREMENT
/begin MEASUREMENT ComScl_PCU_RawSignal_PCU_INHBIT_START_ENG_b "NetworkSignal ComScl_PCU_RawSignal_PCU_INHBIT_START_ENG_b" UBYTE RB_RBA_Common_CentralElements_CompuMethods_Identical 1 100 0.0 255. FORMAT "%10.0" ECU_ADDRESS 0x60011B4C /end MEASUREMENT
/begin MEASUREMENT ComScl_StbIntv_RawSignal_EPB_ALIVE_COUNTER_112_u8 "NetworkSignal ComScl_StbIntv_RawSignal_EPB_ALIVE_COUNTER_112_u8" UBYTE RB_RBA_Common_CentralElements_CompuMethods_Identical 1 100 0.0 255. FORMAT "%10.0" ECU_ADDRESS 0x60011B5A /end MEASUREMENT
/begin MEASUREMENT ComScl_StbIntv_RawSignal_EPB_ALIVE_COUNTER_1C2_u8 "NetworkSignal ComScl_StbIntv_RawSignal_EPB_ALIVE_COUNTER_1C2_u8" UBYTE RB_RBA_Common_CentralElements_CompuMethods_Identical 1 100 0.0 255. FORMAT "%10.0" ECU_ADDRESS 0x60011B55 /end MEASUREMENT
/begin MEASUREMENT ComScl_StbIntv_RawSignal_EPB_APPLIED_b "NetworkSignal ComScl_StbIntv_RawSignal_EPB_APPLIED_b" UBYTE RB_RBA_Common_CentralElements_CompuMethods_Identical 1 100 0.0 255. FORMAT "%10.0" ECU_ADDRESS 0x60011B54 /end MEASUREMENT
/begin MEASUREMENT ComScl_StbIntv_RawSignal_EPB_CHECKSUM_112_u8 "NetworkSignal ComScl_StbIntv_RawSignal_EPB_CHECKSUM_112_u8" UBYTE RB_RBA_Common_CentralElements_CompuMethods_Identical 1 100 0.0 255. FORMAT "%10.0" ECU_ADDRESS 0x60011B59 /end MEASUREMENT
/begin MEASUREMENT ComScl_StbIntv_RawSignal_EPB_CHECKSUM_1C2_u8 "NetworkSignal ComScl_StbIntv_RawSignal_EPB_CHECKSUM_1C2_u8" UBYTE RB_RBA_Common_CentralElements_CompuMethods_Identical 1 100 0.0 255. FORMAT "%10.0" ECU_ADDRESS 0x60011B53 /end MEASUREMENT
/begin MEASUREMENT ComScl_StbIntv_RawSignal_EPB_CLUTCH_PEADAL_STROKE_u8 "NetworkSignal ComScl_StbIntv_RawSignal_EPB_CLUTCH_PEADAL_STROKE_u8" UBYTE RB_RBA_Common_CentralElements_CompuMethods_Identical 1 100 0.0 255. FORMAT "%10.0" ECU_ADDRESS 0x60011B58 /end MEASUREMENT
/begin MEASUREMENT ComScl_StbIntv_RawSignal_EPB_CLUTCH_PEDAL_FAIL_DETECT_b "NetworkSignal ComScl_StbIntv_RawSignal_EPB_CLUTCH_PEDAL_FAIL_DETECT_b" UBYTE RB_RBA_Common_CentralElements_CompuMethods_Identical 1 100 0.0 255. FORMAT "%10.0" ECU_ADDRESS 0x60011B56 /end MEASUREMENT
/begin MEASUREMENT ComScl_StbIntv_RawSignal_EPB_CLUTCH_PEDAL_FAIL_b "NetworkSignal ComScl_StbIntv_RawSignal_EPB_CLUTCH_PEDAL_FAIL_b" UBYTE RB_RBA_Common_CentralElements_CompuMethods_Identical 1 100 0.0 255. FORMAT "%10.0" ECU_ADDRESS 0x60011B57 /end MEASUREMENT
/begin MEASUREMENT ComScl_StbIntv_RawSignal_EPB_CPS1_OUTPUT_VOLTAGE_u16 "NetworkSignal ComScl_StbIntv_RawSignal_EPB_CPS1_OUTPUT_VOLTAGE_u16" UWORD RB_RBA_Common_CentralElements_CompuMethods_Identical 1 100 0.0 65535. FORMAT "%10.0" ECU_ADDRESS 0x6000B47A /end MEASUREMENT
/begin MEASUREMENT ComScl_StbIntv_RawSignal_EPB_CPS2_OUTPUT_VOLTAGE_u16 "NetworkSignal ComScl_StbIntv_RawSignal_EPB_CPS2_OUTPUT_VOLTAGE_u16" UWORD RB_RBA_Common_CentralElements_CompuMethods_Identical 1 100 0.0 65535. FORMAT "%10.0" ECU_ADDRESS 0x6000B478 /end MEASUREMENT
/begin MEASUREMENT ComScl_StbIntv_RawSignal_EPB_INHIBIT_ACT_b "NetworkSignal ComScl_StbIntv_RawSignal_EPB_INHIBIT_ACT_b" UBYTE RB_RBA_Common_CentralElements_CompuMethods_Identical 1 100 0.0 255. FORMAT "%10.0" ECU_ADDRESS 0x60011B52 /end MEASUREMENT
/begin MEASUREMENT ComScl_StbIntv_RawSignal_EPB_PLANT_SAFETY_MODE_STATUS_b "NetworkSignal ComScl_StbIntv_RawSignal_EPB_PLANT_SAFETY_MODE_STATUS_b" UBYTE RB_RBA_Common_CentralElements_CompuMethods_Identical 1 100 0.0 255. FORMAT "%10.0" ECU_ADDRESS 0x60011B51 /end MEASUREMENT
/begin MEASUREMENT ComScl_StbIntv_RawSignal_EPB_REFUSE_ACT_b "NetworkSignal ComScl_StbIntv_RawSignal_EPB_REFUSE_ACT_b" UBYTE RB_RBA_Common_CentralElements_CompuMethods_Identical 1 100 0.0 255. FORMAT "%10.0" ECU_ADDRESS 0x60011B50 /end MEASUREMENT
/begin MEASUREMENT ComScl_StbIntv_RawSignal_EPB_STATE_u8 "NetworkSignal ComScl_StbIntv_RawSignal_EPB_STATE_u8" UBYTE RB_RBA_Common_CentralElements_CompuMethods_Identical 1 100 0.0 255. FORMAT "%10.0" ECU_ADDRESS 0x60011B4F /end MEASUREMENT
/begin MEASUREMENT ComScl_StbIntv_RawSignal_VSA_ABS_CHECKSUM_1D0_u8 "NetworkSignal ComScl_StbIntv_RawSignal_VSA_ABS_CHECKSUM_1D0_u8" UBYTE RB_RBA_Common_CentralElements_CompuMethods_Identical 1 100 0.0 255. FORMAT "%10.0" ECU_ADDRESS 0x60011B70 /end MEASUREMENT
/begin MEASUREMENT ComScl_StbIntv_RawSignal_VSA_ABS_CTRL_b "NetworkSignal ComScl_StbIntv_RawSignal_VSA_ABS_CTRL_b" UBYTE RB_RBA_Common_CentralElements_CompuMethods_Identical 1 100 0.0 255. FORMAT "%10.0" ECU_ADDRESS 0x60011B84 /end MEASUREMENT
/begin MEASUREMENT ComScl_StbIntv_RawSignal_VSA_ABS_EBD_ACT_b "NetworkSignal ComScl_StbIntv_RawSignal_VSA_ABS_EBD_ACT_b" UBYTE RB_RBA_Common_CentralElements_CompuMethods_Identical 1 100 0.0 255. FORMAT "%10.0" ECU_ADDRESS 0x60011B83 /end MEASUREMENT
/begin MEASUREMENT ComScl_StbIntv_RawSignal_VSA_ABS_EBD_MIL_b "NetworkSignal ComScl_StbIntv_RawSignal_VSA_ABS_EBD_MIL_b" UBYTE RB_RBA_Common_CentralElements_CompuMethods_Identical 1 100 0.0 255. FORMAT "%10.0" ECU_ADDRESS 0x60011B82 /end MEASUREMENT
/begin MEASUREMENT ComScl_StbIntv_RawSignal_VSA_ABS_FAIL_FL_VW_SENSOR_b "NetworkSignal ComScl_StbIntv_RawSignal_VSA_ABS_FAIL_FL_VW_SENSOR_b" UBYTE RB_RBA_Common_CentralElements_CompuMethods_Identical 1 100 0.0 255. FORMAT "%10.0" ECU_ADDRESS 0x60011B68 /end MEASUREMENT
/begin MEASUREMENT ComScl_StbIntv_RawSignal_VSA_ABS_FAIL_FR_VW_SENSOR_b "NetworkSignal ComScl_StbIntv_RawSignal_VSA_ABS_FAIL_FR_VW_SENSOR_b" UBYTE RB_RBA_Common_CentralElements_CompuMethods_Identical 1 100 0.0 255. FORMAT "%10.0" ECU_ADDRESS 0x60011B67 /end MEASUREMENT
/begin MEASUREMENT ComScl_StbIntv_RawSignal_VSA_ABS_FAIL_RL_VW_SENSOR_b "NetworkSignal ComScl_StbIntv_RawSignal_VSA_ABS_FAIL_RL_VW_SENSOR_b" UBYTE RB_RBA_Common_CentralElements_CompuMethods_Identical 1 100 0.0 255. FORMAT "%10.0" ECU_ADDRESS 0x60011B66 /end MEASUREMENT
/begin MEASUREMENT ComScl_StbIntv_RawSignal_VSA_ABS_FAIL_RR_VW_SENSOR_b "NetworkSignal ComScl_StbIntv_RawSignal_VSA_ABS_FAIL_RR_VW_SENSOR_b" UBYTE RB_RBA_Common_CentralElements_CompuMethods_Identical 1 100 0.0 255. FORMAT "%10.0" ECU_ADDRESS 0x60011B65 /end MEASUREMENT
/begin MEASUREMENT ComScl_StbIntv_RawSignal_VSA_ABS_FL_WHEEL_SPEED_u16 "NetworkSignal ComScl_StbIntv_RawSignal_VSA_ABS_FL_WHEEL_SPEED_u16" UWORD RB_RBA_Common_CentralElements_CompuMethods_Identical 1 100 0.0 65535. FORMAT "%10.0" ECU_ADDRESS 0x6000B488 /end MEASUREMENT
/begin MEASUREMENT ComScl_StbIntv_RawSignal_VSA_ABS_FR_WHEEL_SPEED_u16 "NetworkSignal ComScl_StbIntv_RawSignal_VSA_ABS_FR_WHEEL_SPEED_u16" UWORD RB_RBA_Common_CentralElements_CompuMethods_Identical 1 100 0.0 65535. FORMAT "%10.0" ECU_ADDRESS 0x6000B486 /end MEASUREMENT
/begin MEASUREMENT ComScl_StbIntv_RawSignal_VSA_ABS_RL_WHEEL_SPEED_u16 "NetworkSignal ComScl_StbIntv_RawSignal_VSA_ABS_RL_WHEEL_SPEED_u16" UWORD RB_RBA_Common_CentralElements_CompuMethods_Identical 1 100 0.0 65535. FORMAT "%10.0" ECU_ADDRESS 0x6000B484 /end MEASUREMENT
/begin MEASUREMENT ComScl_StbIntv_RawSignal_VSA_ABS_RR_WHEEL_SPEED_u16 "NetworkSignal ComScl_StbIntv_RawSignal_VSA_ABS_RR_WHEEL_SPEED_u16" UWORD RB_RBA_Common_CentralElements_CompuMethods_Identical 1 100 0.0 65535. FORMAT "%10.0" ECU_ADDRESS 0x6000B482 /end MEASUREMENT
/begin MEASUREMENT ComScl_StbIntv_RawSignal_VSA_ACC_BRAKE_ACT_b "NetworkSignal ComScl_StbIntv_RawSignal_VSA_ACC_BRAKE_ACT_b" UBYTE RB_RBA_Common_CentralElements_CompuMethods_Identical 1 100 0.0 255. FORMAT "%10.0" ECU_ADDRESS 0x60011B81 /end MEASUREMENT
/begin MEASUREMENT ComScl_StbIntv_RawSignal_VSA_ALIVECOUNTER_1AC_u8 "NetworkSignal ComScl_StbIntv_RawSignal_VSA_ALIVECOUNTER_1AC_u8" UBYTE RB_RBA_Common_CentralElements_CompuMethods_Identical 1 100 0.0 255. FORMAT "%10.0" ECU_ADDRESS 0x60011B6F /end MEASUREMENT
/begin MEASUREMENT ComScl_StbIntv_RawSignal_VSA_ALIVE_COUNTER_12E_u8 "NetworkSignal ComScl_StbIntv_RawSignal_VSA_ALIVE_COUNTER_12E_u8" UBYTE RB_RBA_Common_CentralElements_CompuMethods_Identical 1 100 0.0 255. FORMAT "%10.0" ECU_ADDRESS 0x60011B5E /end MEASUREMENT
/begin MEASUREMENT ComScl_StbIntv_RawSignal_VSA_ALIVE_COUNTER_1A4_u8 "NetworkSignal ComScl_StbIntv_RawSignal_VSA_ALIVE_COUNTER_1A4_u8" UBYTE RB_RBA_Common_CentralElements_CompuMethods_Identical 1 100 0.0 255. FORMAT "%10.0" ECU_ADDRESS 0x60011B80 /end MEASUREMENT
/begin MEASUREMENT ComScl_StbIntv_RawSignal_VSA_ALIVE_COUNTER_1B0_u8 "NetworkSignal ComScl_StbIntv_RawSignal_VSA_ALIVE_COUNTER_1B0_u8" UBYTE RB_RBA_Common_CentralElements_CompuMethods_Identical 1 100 0.0 255. FORMAT "%10.0" ECU_ADDRESS 0x60011B64 /end MEASUREMENT
/begin MEASUREMENT ComScl_StbIntv_RawSignal_VSA_BHOLD_STATUS_ACT_b "NetworkSignal ComScl_StbIntv_RawSignal_VSA_BHOLD_STATUS_ACT_b" UBYTE RB_RBA_Common_CentralElements_CompuMethods_Identical 1 100 0.0 255. FORMAT "%10.0" ECU_ADDRESS 0x60011B7F /end MEASUREMENT
/begin MEASUREMENT ComScl_StbIntv_RawSignal_VSA_CASEN_b "NetworkSignal ComScl_StbIntv_RawSignal_VSA_CASEN_b" UBYTE RB_RBA_Common_CentralElements_CompuMethods_Identical 1 100 0.0 255. FORMAT "%10.0" ECU_ADDRESS 0x60011B7E /end MEASUREMENT
/begin MEASUREMENT ComScl_StbIntv_RawSignal_VSA_CAS_ACT_b "NetworkSignal ComScl_StbIntv_RawSignal_VSA_CAS_ACT_b" UBYTE RB_RBA_Common_CentralElements_CompuMethods_Identical 1 100 0.0 255. FORMAT "%10.0" ECU_ADDRESS 0x60011B7D /end MEASUREMENT
/begin MEASUREMENT ComScl_StbIntv_RawSignal_VSA_CHECKSUM_12E_u8 "NetworkSignal ComScl_StbIntv_RawSignal_VSA_CHECKSUM_12E_u8" UBYTE RB_RBA_Common_CentralElements_CompuMethods_Identical 1 100 0.0 255. FORMAT "%10.0" ECU_ADDRESS 0x60011B5D /end MEASUREMENT
/begin MEASUREMENT ComScl_StbIntv_RawSignal_VSA_CHECKSUM_1A4_u8 "NetworkSignal ComScl_StbIntv_RawSignal_VSA_CHECKSUM_1A4_u8" UBYTE RB_RBA_Common_CentralElements_CompuMethods_Identical 1 100 0.0 255. FORMAT "%10.0" ECU_ADDRESS 0x60011B7C /end MEASUREMENT
/begin MEASUREMENT ComScl_StbIntv_RawSignal_VSA_CHECKSUM_1AC_u8 "NetworkSignal ComScl_StbIntv_RawSignal_VSA_CHECKSUM_1AC_u8" UBYTE RB_RBA_Common_CentralElements_CompuMethods_Identical 1 100 0.0 255. FORMAT "%10.0" ECU_ADDRESS 0x60011B6E /end MEASUREMENT
/begin MEASUREMENT ComScl_StbIntv_RawSignal_VSA_CHECKSUM_1B0_u8 "NetworkSignal ComScl_StbIntv_RawSignal_VSA_CHECKSUM_1B0_u8" UBYTE RB_RBA_Common_CentralElements_CompuMethods_Identical 1 100 0.0 255. FORMAT "%10.0" ECU_ADDRESS 0x60011B63 /end MEASUREMENT
/begin MEASUREMENT ComScl_StbIntv_RawSignal_VSA_DRV_BRKTRQ_AYCI_u16 "NetworkSignal ComScl_StbIntv_RawSignal_VSA_DRV_BRKTRQ_AYCI_u16" UWORD RB_RBA_Common_CentralElements_CompuMethods_Identical 1 100 0.0 65535. FORMAT "%10.0" ECU_ADDRESS 0x6000B47C /end MEASUREMENT
/begin MEASUREMENT ComScl_StbIntv_RawSignal_VSA_DRV_BRKTRQ_u16 "NetworkSignal ComScl_StbIntv_RawSignal_VSA_DRV_BRKTRQ_u16" UWORD RB_RBA_Common_CentralElements_CompuMethods_Identical 1 100 0.0 65535. FORMAT "%10.0" ECU_ADDRESS 0x6000B47E /end MEASUREMENT
/begin MEASUREMENT ComScl_StbIntv_RawSignal_VSA_ECD_ACT_b "NetworkSignal ComScl_StbIntv_RawSignal_VSA_ECD_ACT_b" UBYTE RB_RBA_Common_CentralElements_CompuMethods_Identical 1 100 0.0 255. FORMAT "%10.0" ECU_ADDRESS 0x60011B6D /end MEASUREMENT
/begin MEASUREMENT ComScl_StbIntv_RawSignal_VSA_EPB_INHIBIT_BRAKE_b "NetworkSignal ComScl_StbIntv_RawSignal_VSA_EPB_INHIBIT_BRAKE_b" UBYTE RB_RBA_Common_CentralElements_CompuMethods_Identical 1 100 0.0 255. FORMAT "%10.0" ECU_ADDRESS 0x60011B7B /end MEASUREMENT
/begin MEASUREMENT ComScl_StbIntv_RawSignal_VSA_FAIL_LONG_G_SENSOR_b "NetworkSignal ComScl_StbIntv_RawSignal_VSA_FAIL_LONG_G_SENSOR_b" UBYTE RB_RBA_Common_CentralElements_CompuMethods_Identical 1 100 0.0 255. FORMAT "%10.0" ECU_ADDRESS 0x60011B62 /end MEASUREMENT
/begin MEASUREMENT ComScl_StbIntv_RawSignal_VSA_FAIL_MC_PRESSURE_SENSOR_b "NetworkSignal ComScl_StbIntv_RawSignal_VSA_FAIL_MC_PRESSURE_SENSOR_b" UBYTE RB_RBA_Common_CentralElements_CompuMethods_Identical 1 100 0.0 255. FORMAT "%10.0" ECU_ADDRESS 0x60011B7A /end MEASUREMENT
/begin MEASUREMENT ComScl_StbIntv_RawSignal_VSA_FAIL_YAW_RATE_SENSOR_b "NetworkSignal ComScl_StbIntv_RawSignal_VSA_FAIL_YAW_RATE_SENSOR_b" UBYTE RB_RBA_Common_CentralElements_CompuMethods_Identical 1 100 0.0 255. FORMAT "%10.0" ECU_ADDRESS 0x60011B61 /end MEASUREMENT
/begin MEASUREMENT ComScl_StbIntv_RawSignal_VSA_HSA_STATUS_ACT_b "NetworkSignal ComScl_StbIntv_RawSignal_VSA_HSA_STATUS_ACT_b" UBYTE RB_RBA_Common_CentralElements_CompuMethods_Identical 1 100 0.0 255. FORMAT "%10.0" ECU_ADDRESS 0x60011B79 /end MEASUREMENT
/begin MEASUREMENT ComScl_StbIntv_RawSignal_VSA_INHBIT_LONG_G_SENSOR_b "NetworkSignal ComScl_StbIntv_RawSignal_VSA_INHBIT_LONG_G_SENSOR_b" UBYTE RB_RBA_Common_CentralElements_CompuMethods_Identical 1 100 0.0 255. FORMAT "%10.0" ECU_ADDRESS 0x60011B60 /end MEASUREMENT
/begin MEASUREMENT ComScl_StbIntv_RawSignal_VSA_INHBIT_MC_PRESSURE_SENSOR_b "NetworkSignal ComScl_StbIntv_RawSignal_VSA_INHBIT_MC_PRESSURE_SENSOR_b" UBYTE RB_RBA_Common_CentralElements_CompuMethods_Identical 1 100 0.0 255. FORMAT "%10.0" ECU_ADDRESS 0x60011B78 /end MEASUREMENT
/begin MEASUREMENT ComScl_StbIntv_RawSignal_VSA_INHBIT_YAW_RATE_SENSOR_b "NetworkSignal ComScl_StbIntv_RawSignal_VSA_INHBIT_YAW_RATE_SENSOR_b" UBYTE RB_RBA_Common_CentralElements_CompuMethods_Identical 1 100 0.0 255. FORMAT "%10.0" ECU_ADDRESS 0x60011B5F /end MEASUREMENT
/begin MEASUREMENT ComScl_StbIntv_RawSignal_VSA_ISAB_ACT_b "NetworkSignal ComScl_StbIntv_RawSignal_VSA_ISAB_ACT_b" UBYTE RB_RBA_Common_CentralElements_CompuMethods_Identical 1 100 0.0 255. FORMAT "%10.0" ECU_ADDRESS 0x60011B5C /end MEASUREMENT
/begin MEASUREMENT ComScl_StbIntv_RawSignal_VSA_ISAB_ENABLE_b "NetworkSignal ComScl_StbIntv_RawSignal_VSA_ISAB_ENABLE_b" UBYTE RB_RBA_Common_CentralElements_CompuMethods_Identical 1 100 0.0 255. FORMAT "%10.0" ECU_ADDRESS 0x60011B5B /end MEASUREMENT
/begin MEASUREMENT ComScl_StbIntv_RawSignal_VSA_LAMP_STATUS_STANBY_BHOLD_b "NetworkSignal ComScl_StbIntv_RawSignal_VSA_LAMP_STATUS_STANBY_BHOLD_b" UBYTE RB_RBA_Common_CentralElements_CompuMethods_Identical 1 100 0.0 255. FORMAT "%10.0" ECU_ADDRESS 0x60011B77 /end MEASUREMENT
/begin MEASUREMENT ComScl_StbIntv_RawSignal_VSA_LAMP_STATUS_VSA_OFF_b "NetworkSignal ComScl_StbIntv_RawSignal_VSA_LAMP_STATUS_VSA_OFF_b" UBYTE RB_RBA_Common_CentralElements_CompuMethods_Identical 1 100 0.0 255. FORMAT "%10.0" ECU_ADDRESS 0x60011B76 /end MEASUREMENT
/begin MEASUREMENT ComScl_StbIntv_RawSignal_VSA_MASTER_CYLINDER_PRESSURE_u16 "NetworkSignal ComScl_StbIntv_RawSignal_VSA_MASTER_CYLINDER_PRESSURE_u16" UWORD RB_RBA_Common_CentralElements_CompuMethods_Identical 1 100 0.0 65535. FORMAT "%10.0" ECU_ADDRESS 0x6000B48A /end MEASUREMENT
/begin MEASUREMENT ComScl_StbIntv_RawSignal_VSA_REQ_MSR_PLUS_TRQ_b "NetworkSignal ComScl_StbIntv_RawSignal_VSA_REQ_MSR_PLUS_TRQ_b" UBYTE RB_RBA_Common_CentralElements_CompuMethods_Identical 1 100 0.0 255. FORMAT "%10.0" ECU_ADDRESS 0x60011B6C /end MEASUREMENT
/begin MEASUREMENT ComScl_StbIntv_RawSignal_VSA_REQ_TRQ_1AC_s16 "NetworkSignal ComScl_StbIntv_RawSignal_VSA_REQ_TRQ_1AC_s16" SWORD RB_RBA_Common_CentralElements_CompuMethods_Identical 1 100 -32768. 32767. FORMAT "%10.0" ECU_ADDRESS 0x6000B480 /end MEASUREMENT
/begin MEASUREMENT ComScl_StbIntv_RawSignal_VSA_REWRITE_START_b "NetworkSignal ComScl_StbIntv_RawSignal_VSA_REWRITE_START_b" UBYTE RB_RBA_Common_CentralElements_CompuMethods_Identical 1 100 0.0 255. FORMAT "%10.0" ECU_ADDRESS 0x60011B75 /end MEASUREMENT
/begin MEASUREMENT ComScl_StbIntv_RawSignal_VSA_SHIFT_REQ_1AC_u8 "NetworkSignal ComScl_StbIntv_RawSignal_VSA_SHIFT_REQ_1AC_u8" UBYTE RB_RBA_Common_CentralElements_CompuMethods_Identical 1 100 0.0 255. FORMAT "%10.0" ECU_ADDRESS 0x60011B6B /end MEASUREMENT
/begin MEASUREMENT ComScl_StbIntv_RawSignal_VSA_TRQ_CONTROL_MODE_u8 "NetworkSignal ComScl_StbIntv_RawSignal_VSA_TRQ_CONTROL_MODE_u8" UBYTE RB_RBA_Common_CentralElements_CompuMethods_Identical 1 100 0.0 255. FORMAT "%10.0" ECU_ADDRESS 0x60011B6A /end MEASUREMENT
/begin MEASUREMENT ComScl_StbIntv_RawSignal_VSA_TRQ_DOWN_REQ_FUEL_CUT_u8 "NetworkSignal ComScl_StbIntv_RawSignal_VSA_TRQ_DOWN_REQ_FUEL_CUT_u8" UBYTE RB_RBA_Common_CentralElements_CompuMethods_Identical 1 100 0.0 255. FORMAT "%10.0" ECU_ADDRESS 0x60011B69 /end MEASUREMENT
/begin MEASUREMENT ComScl_StbIntv_RawSignal_VSA_VSA_CTRL_b "NetworkSignal ComScl_StbIntv_RawSignal_VSA_VSA_CTRL_b" UBYTE RB_RBA_Common_CentralElements_CompuMethods_Identical 1 100 0.0 255. FORMAT "%10.0" ECU_ADDRESS 0x60011B74 /end MEASUREMENT
/begin MEASUREMENT ComScl_StbIntv_RawSignal_VSA_VSA_TCS_ACT_b "NetworkSignal ComScl_StbIntv_RawSignal_VSA_VSA_TCS_ACT_b" UBYTE RB_RBA_Common_CentralElements_CompuMethods_Identical 1 100 0.0 255. FORMAT "%10.0" ECU_ADDRESS 0x60011B73 /end MEASUREMENT
/begin MEASUREMENT ComScl_StbIntv_RawSignal_VSA_VSA_TCS_MIL_b "NetworkSignal ComScl_StbIntv_RawSignal_VSA_VSA_TCS_MIL_b" UBYTE RB_RBA_Common_CentralElements_CompuMethods_Identical 1 100 0.0 255. FORMAT "%10.0" ECU_ADDRESS 0x60011B72 /end MEASUREMENT
/begin MEASUREMENT ComScl_StbIntv_RawSignal_VSA_WARN_STATUS_ABS_b "NetworkSignal ComScl_StbIntv_RawSignal_VSA_WARN_STATUS_ABS_b" UBYTE RB_RBA_Common_CentralElements_CompuMethods_Identical 1 100 0.0 255. FORMAT "%10.0" ECU_ADDRESS 0x60011B71 /end MEASUREMENT
/begin MEASUREMENT ComScl_Strg_RawSignal_EPS_ALIVE_COUNTER_1AB_u8 "NetworkSignal ComScl_Strg_RawSignal_EPS_ALIVE_COUNTER_1AB_u8" UBYTE RB_RBA_Common_CentralElements_CompuMethods_Identical 1 100 0.0 255. FORMAT "%10.0" ECU_ADDRESS 0x60011B89 /end MEASUREMENT
/begin MEASUREMENT ComScl_Strg_RawSignal_EPS_CHECKSUM_1AB_u8 "NetworkSignal ComScl_Strg_RawSignal_EPS_CHECKSUM_1AB_u8" UBYTE RB_RBA_Common_CentralElements_CompuMethods_Identical 1 100 0.0 255. FORMAT "%10.0" ECU_ADDRESS 0x60011B88 /end MEASUREMENT
/begin MEASUREMENT ComScl_Strg_RawSignal_EPS_IS_RELEASE_REQUEST_b "NetworkSignal ComScl_Strg_RawSignal_EPS_IS_RELEASE_REQUEST_b" UBYTE RB_RBA_Common_CentralElements_CompuMethods_Identical 1 100 0.0 255. FORMAT "%10.0" ECU_ADDRESS 0x60011B87 /end MEASUREMENT
/begin MEASUREMENT ComScl_Strg_RawSignal_EPS_IS_SHIFT_INHIBIT_REQUEST_b "NetworkSignal ComScl_Strg_RawSignal_EPS_IS_SHIFT_INHIBIT_REQUEST_b" UBYTE RB_RBA_Common_CentralElements_CompuMethods_Identical 1 100 0.0 255. FORMAT "%10.0" ECU_ADDRESS 0x60011B86 /end MEASUREMENT
/begin MEASUREMENT ComScl_Strg_RawSignal_EPS_LOAD_u16 "NetworkSignal ComScl_Strg_RawSignal_EPS_LOAD_u16" UWORD RB_RBA_Common_CentralElements_CompuMethods_Identical 1 100 0.0 65535. FORMAT "%10.0" ECU_ADDRESS 0x6000B48C /end MEASUREMENT
/begin MEASUREMENT ComScl_Strg_RawSignal_EPS_MID_REQ_b "NetworkSignal ComScl_Strg_RawSignal_EPS_MID_REQ_b" UBYTE RB_RBA_Common_CentralElements_CompuMethods_Identical 1 100 0.0 255. FORMAT "%10.0" ECU_ADDRESS 0x60011B85 /end MEASUREMENT
/begin MEASUREMENT rba_Dme_Ovl_stEnable "Overlay state" UBYTE RB_RBA_Common_CentralElements_CompuMethods_Identical 1 100 0.0 255. FORMAT "%5.0" ECU_ADDRESS 0x60014AFB /end MEASUREMENT
/begin MEASUREMENT rba_Dme_adrError "address of vector causing error" ULONG RB_RBA_Common_CentralElements_CompuMethods_Identical 1 100 0.0 4.E9 FORMAT "%10.0" ECU_ADDRESS 0x60003B40 /end MEASUREMENT
/begin MEASUREMENT rba_Dme_numBytesAvailable "number of bytes available for calibration" ULONG RB_RBA_Common_CentralElements_CompuMethods_Identical 1 100 0.0 4.E9 FORMAT "%10.0" ECU_ADDRESS 0x60003B48 /end MEASUREMENT
/begin MEASUREMENT rba_Dme_numBytesAvailableOvl "number of bytes available for calibration" ULONG RB_RBA_Common_CentralElements_CompuMethods_Identical 1 100 0.0 4.E9 FORMAT "%10.0" ECU_ADDRESS 0x60003B44 /end MEASUREMENT
/begin MEASUREMENT rba_IoExtLib_KeepAliveDrvErrCyc_u32 "KeepAlive measurement variable" ULONG RB_RBA_Common_CentralElements_CompuMethods_Identical 1 100 0.0 4.E9 FORMAT "%9.0" ECU_ADDRESS 0x600340E8 /end MEASUREMENT
/begin MEASUREMENT rba_IoExtLib_KeepAliveDrvErrPerm_u32 "KeepAlive measurement variable" ULONG RB_RBA_Common_CentralElements_CompuMethods_Identical 1 100 0.0 4.E9 FORMAT "%9.0" ECU_ADDRESS 0x600360C8 /end MEASUREMENT
/begin MEASUREMENT rba_IoExtLib_KeepAliveIniErrCyc_u32 "KeepAlive measurement variable" ULONG RB_RBA_Common_CentralElements_CompuMethods_Identical 1 100 0.0 4.E9 FORMAT "%9.0" ECU_ADDRESS 0x600340E4 /end MEASUREMENT
/begin MEASUREMENT rba_IoExtLib_KeepAliveIniErrPerm_u32 "KeepAlive measurement variable" ULONG RB_RBA_Common_CentralElements_CompuMethods_Identical 1 100 0.0 4.E9 FORMAT "%9.0" ECU_ADDRESS 0x600360C4 /end MEASUREMENT
/begin FUNCTION ComM "9.16.1  McFunction ComM Created by MCFunctionUpdater"
 /begin LOC_MEASUREMENT ComM_ChannelStruct[0].BusSmMode_u8 ComM_ChannelStruct[0].ChannelMode_u8 ComM_ChannelStruct[0].ChannelState_e ComM_ChannelStruct[0].CommunicationAllowed_b ComM_ChannelStruct[0].DiagnosticRequestState_b ComM_ChannelStruct[0].InhibitionReqStatus_u8 ComM_ChannelStruct[0].LightTimeoutCtr_u32 ComM_ChannelStruct[0].MinFullComTimeoutCtr_u16 ComM_ChannelStruct[0].NmBusSleepIndicationStatus_b ComM_ChannelStruct[0].NmNetworkModeStatus_b ComM_ChannelStruct[0].NmNetworkRequestStatus_b ComM_ChannelStruct[0].NmPrepareBusSleepIndicationStatus_b ComM_ChannelStruct[0].PassiveRequestState_u8 ComM_ChannelStruct[0].PncRequestCtr_u8 ComM_ChannelStruct[0].UserRequestCtr_u16 ComM_ChannelStruct[1].BusSmMode_u8 ComM_ChannelStruct[1].ChannelMode_u8 ComM_ChannelStruct[1].ChannelState_e ComM_ChannelStruct[1].CommunicationAllowed_b ComM_ChannelStruct[1].DiagnosticRequestState_b ComM_ChannelStruct[1].InhibitionReqStatus_u8 ComM_ChannelStruct[1].LightTimeoutCtr_u32 ComM_ChannelStruct[1].MinFullComTimeoutCtr_u16 ComM_ChannelStruct[1].NmBusSleepIndicationStatus_b ComM_ChannelStruct[1].NmNetworkModeStatus_b ComM_ChannelStruct[1].NmNetworkRequestStatus_b ComM_ChannelStruct[1].NmPrepareBusSleepIndicationStatus_b ComM_ChannelStruct[1].PassiveRequestState_u8 ComM_ChannelStruct[1].PncRequestCtr_u8 ComM_ChannelStruct[1].UserRequestCtr_u16 ComM_ChannelStruct[2].BusSmMode_u8 ComM_ChannelStruct[2].ChannelMode_u8 ComM_ChannelStruct[2].ChannelState_e ComM_ChannelStruct[2].CommunicationAllowed_b ComM_ChannelStruct[2].DiagnosticRequestState_b ComM_ChannelStruct[2].InhibitionReqStatus_u8 ComM_ChannelStruct[2].LightTimeoutCtr_u32 ComM_ChannelStruct[2].MinFullComTimeoutCtr_u16 ComM_ChannelStruct[2].NmBusSleepIndicationStatus_b ComM_ChannelStruct[2].NmNetworkModeStatus_b ComM_ChannelStruct[2].NmNetworkRequestStatus_b ComM_ChannelStruct[2].NmPrepareBusSleepIndicationStatus_b ComM_ChannelStruct[2].PassiveRequestState_u8 ComM_ChannelStruct[2].PncRequestCtr_u8 ComM_ChannelStruct[2].UserRequestCtr_u16 ComM_ChannelStruct[3].BusSmMode_u8 ComM_ChannelStruct[3].ChannelMode_u8 ComM_ChannelStruct[3].ChannelState_e ComM_ChannelStruct[3].CommunicationAllowed_b ComM_ChannelStruct[3].DiagnosticRequestState_b ComM_ChannelStruct[3].InhibitionReqStatus_u8 ComM_ChannelStruct[3].LightTimeoutCtr_u32 ComM_ChannelStruct[3].MinFullComTimeoutCtr_u16 ComM_ChannelStruct[3].NmBusSleepIndicationStatus_b ComM_ChannelStruct[3].NmNetworkModeStatus_b ComM_ChannelStruct[3].NmNetworkRequestStatus_b ComM_ChannelStruct[3].NmPrepareBusSleepIndicationStatus_b ComM_ChannelStruct[3].PassiveRequestState_u8 ComM_ChannelStruct[3].PncRequestCtr_u8 ComM_ChannelStruct[3].UserRequestCtr_u16 ComM_UserStruct[0].IndicatedUserMode_u8 ComM_UserStruct[0].LimitToNoComCtr_u16 ComM_UserStruct[0].RequestedUserMode_u8 ComM_UserStruct[0].WakeUpInhibitionCtr_u16 ComM_UserStruct[0].numChannelsInFullCom_u8 ComM_UserStruct[0].numChannelsInNoCom_u8 ComM_UserStruct[0].numChannelsInSilentCom_u8 ComM_UserStruct[1].IndicatedUserMode_u8 ComM_UserStruct[1].LimitToNoComCtr_u16 ComM_UserStruct[1].RequestedUserMode_u8 ComM_UserStruct[1].WakeUpInhibitionCtr_u16 ComM_UserStruct[1].numChannelsInFullCom_u8 ComM_UserStruct[1].numChannelsInNoCom_u8 ComM_UserStruct[1].numChannelsInSilentCom_u8 ComM_UserStruct[2].IndicatedUserMode_u8 ComM_UserStruct[2].LimitToNoComCtr_u16 ComM_UserStruct[2].RequestedUserMode_u8 ComM_UserStruct[2].WakeUpInhibitionCtr_u16 ComM_UserStruct[2].numChannelsInFullCom_u8 ComM_UserStruct[2].numChannelsInNoCom_u8 ComM_UserStruct[2].numChannelsInSilentCom_u8 ComM_UserStruct[3].IndicatedUserMode_u8 ComM_UserStruct[3].LimitToNoComCtr_u16 ComM_UserStruct[3].RequestedUserMode_u8 ComM_UserStruct[3].WakeUpInhibitionCtr_u16 ComM_UserStruct[3].numChannelsInFullCom_u8 ComM_UserStruct[3].numChannelsInNoCom_u8 ComM_UserStruct[3].numChannelsInSilentCom_u8 ComM_UserStruct[4].IndicatedUserMode_u8 ComM_UserStruct[4].LimitToNoComCtr_u16 ComM_UserStruct[4].RequestedUserMode_u8 ComM_UserStruct[4].WakeUpInhibitionCtr_u16 ComM_UserStruct[4].numChannelsInFullCom_u8 ComM_UserStruct[4].numChannelsInNoCom_u8 ComM_UserStruct[4].numChannelsInSilentCom_u8 /end LOC_MEASUREMENT
 FUNCTION_VERSION "9.16.1" /end FUNCTION
/begin FUNCTION Fee "5.40.2  McFunction Fee Created by MCFunctionUpdater" /begin LOC_MEASUREMENT Fee_SecChngCnt_u32 /end LOC_MEASUREMENT FUNCTION_VERSION "5.40.2" /end FUNCTION
/begin FUNCTION Lin "8.11.0  McFunction Lin Created by MCFunctionUpdater"
 /begin LOC_MEASUREMENT Lin_ChnlVar_MP[0].CSmodel Lin_ChnlVar_MP[0].ChannelState Lin_ChnlVar_MP[0].FramePid Lin_ChnlVar_MP[0].FrameType Lin_ChnlVar_MP[0].GotoSleepCtr Lin_ChnlVar_MP[0].Length Lin_ChnlVar_MP[0].Lin_Buf_au8 Lin_ChnlVar_MP[0].Status Lin_DrvFlags_MP /end LOC_MEASUREMENT
 FUNCTION_VERSION "8.11.0" /end FUNCTION
/begin FUNCTION LinIf "9.16.2  McFunction LinIf Created by MCFunctionUpdater"
 /begin LOC_MEASUREMENT LinIf_ChnlVar_as[0].ChannelStateFlag_u8 LinIf_ChnlVar_as[0].ChannelStatusFlags_u8 LinIf_ChnlVar_as[0].CurrentIndex_u8 LinIf_ChnlVar_as[0].CurrentScheduleTable_u8 LinIf_ChnlVar_as[0].DelayCount_u8 LinIf_ChnlVar_as[0].GotoSleepCtr LinIf_ChnlVar_as[0].NewScheduleTable_u8 LinIf_ChnlVar_as[0].SavedIndex_u8 LinIf_ChnlVar_as[0].SavedScheduleTable_u8 LinIf_ChnlVar_as[0].SlpGetStatus_u8 LinIf_ChnlVar_as[0].SpoETIndex_u8 LinIf_ChnlVar_as[0].Temp_SpoFrmCount_u8 LinIf_ChnlVar_as[0].TransmitSRF_u8 LinIf_ChnlVar_as[0].Wakeup_u8 LinIf_Status_u8 /end LOC_MEASUREMENT
 FUNCTION_VERSION "9.16.2" /end FUNCTION
/begin FUNCTION LinSM "5.13.0  McFunction LinSM Created by MCFunctionUpdater"
 /begin LOC_MEASUREMENT LinSM_ModeRepeatReq_Max_u8 LinSM_RamVar_ast[0].ChnlState LinSM_RamVar_ast[0].LinSmModReqRepMax LinSM_RamVar_ast[0].LinSm_Conf_Status LinSM_RamVar_ast[0].LinSm_Request_Status LinSM_RamVar_ast[0].LinSm_SchdReq_E_NOT_OK LinSM_RamVar_ast[0].LinSm_Sleep_Status LinSM_RamVar_ast[0].StoredSchdTab LinSM_RamVar_ast[0].TimeOutCounter LinSM_RamVar_ast[0].TimeoutFlag LinSM_State_en /end LOC_MEASUREMENT
 FUNCTION_VERSION "5.13.0" /end FUNCTION
/begin FUNCTION PduR "15.16.2  McFunction PduR Created by MCFunctionUpdater" /begin LOC_MEASUREMENT PduR_State /end LOC_MEASUREMENT FUNCTION_VERSION "15.16.2" /end FUNCTION
/begin FUNCTION rba_ComScl "4.17.3_6.0.0  McFunction rba_ComScl Created by MCFunctionUpdater"
 /begin LOC_MEASUREMENT ComScl_Bdy_RawSignal_PCU_ALIVE_COUNTER_45B_u8 ComScl_Bdy_RawSignal_PCU_CHECKSUM_45B_u8 ComScl_Bdy_RawSignal_PCU_REM_ENG_START_b ComScl_Bdy_RawSignal_SRS_ALIVE_COUNTER_039_u8 ComScl_Bdy_RawSignal_SRS_ALIVE_COUNTER_094_u8 ComScl_Bdy_RawSignal_SRS_ALIVE_COUNTER_305_u8 ComScl_Bdy_RawSignal_SRS_CAL_LAT_G_b ComScl_Bdy_RawSignal_SRS_CAL_LON_G_b ComScl_Bdy_RawSignal_SRS_CHECKSUM_039_u8 ComScl_Bdy_RawSignal_SRS_CHECKSUM_094_u8 ComScl_Bdy_RawSignal_SRS_CHECKSUM_305_u8 ComScl_Bdy_RawSignal_SRS_DR_BELT_STATUS_u8 ComScl_Bdy_RawSignal_SRS_HI_CDS_b ComScl_Bdy_RawSignal_SRS_LAT_G_u16 ComScl_Bdy_RawSignal_SRS_LON_G_u16 ComScl_Bdy_RawSignal_SRS_P_ERR_LAT_G_b ComScl_Bdy_RawSignal_SRS_P_ERR_LON_G_b ComScl_Bdy_RawSignal_SRS_P_ERR_YAW1_b ComScl_Bdy_RawSignal_SRS_SENSOR_ERR_MC_b ComScl_Bdy_RawSignal_SRS_SENSOR_START_UP_b ComScl_Bdy_RawSignal_SRS_SENSOR_STATE_IG_b ComScl_Bdy_RawSignal_SRS_T_ERR_LAT_G_b ComScl_Bdy_RawSignal_SRS_T_ERR_LON_G_b ComScl_Bdy_RawSignal_SRS_T_ERR_YAW1_b ComScl_Bdy_RawSignal_SRS_YAW_1_u16 ComScl_Dspl_RawSignal_METER_AC_ACGUP_REQ_b ComScl_Dspl_RawSignal_METER_AC_FR_BLW_VF_u8 ComScl_Dspl_RawSignal_METER_AC_HACCUT_NG_2_u8 ComScl_Dspl_RawSignal_METER_AC_HACCUT_NG_u8 ComScl_Dspl_RawSignal_METER_AC_OUTAIRTEMP01_u8 ComScl_Dspl_RawSignal_METER_AC_PTC_STATUS_u8 ComScl_Dspl_RawSignal_METER_AC_RRDEF_b ComScl_Dspl_RawSignal_METER_AC_RR_BLW_VF_u8 ComScl_Dspl_RawSignal_METER_AC_TEVATEMP05_u8 ComScl_Dspl_RawSignal_METER_AC_TYPE_ECON_b ComScl_Dspl_RawSignal_METER_AC_VARI_u8 ComScl_Dspl_RawSignal_METER_ALIVE_COUNTER_221_2_u8 ComScl_Dspl_RawSignal_METER_ALIVE_COUNTER_221_u8 ComScl_Dspl_RawSignal_METER_ALIVE_COUNTER_296_u8 ComScl_Dspl_RawSignal_METER_ALIVE_COUNTER_309_u8 ComScl_Dspl_RawSignal_METER_ALIVE_COUNTER_326_u8 ComScl_Dspl_RawSignal_METER_ALIVE_COUNTER_331_u8 ComScl_Dspl_RawSignal_METER_ALIVE_COUNTER_371_u8 ComScl_Dspl_RawSignal_METER_ALIVE_COUNTER_372_2_u8 ComScl_Dspl_RawSignal_METER_ALIVE_COUNTER_372_u8 ComScl_Dspl_RawSignal_METER_ALIVE_COUNTER_374_u8 ComScl_Dspl_RawSignal_METER_ALIVE_COUNTER_37B_u8 ComScl_Dspl_RawSignal_METER_ALIVE_COUNTER_396_u8 ComScl_Dspl_RawSignal_METER_ALIVE_COUNTER_3A1_u8 ComScl_Dspl_RawSignal_METER_ALIVE_COUNTER_510_u8 ComScl_Dspl_RawSignal_METER_ALIVE_COUNTER_516_u8 ComScl_Dspl_RawSignal_METER_ASL_CAN_ERROR_b ComScl_Dspl_RawSignal_METER_BCAN_FAILCODE_BCAN_b ComScl_Dspl_RawSignal_METER_BCAN_FAILCODE_COMB_UNIT_b ComScl_Dspl_RawSignal_METER_BCAN_FAILCODE_HAC_b ComScl_Dspl_RawSignal_METER_BCAN_FAILCODE_MCU_UNIT_b ComScl_Dspl_RawSignal_METER_BCAN_REPRO_b ComScl_Dspl_RawSignal_METER_CC_MAIN_STATUS_b ComScl_Dspl_RawSignal_METER_CC_TARGETSP_DISP_b ComScl_Dspl_RawSignal_METER_CHECKSUM_221_2_u8 ComScl_Dspl_RawSignal_METER_CHECKSUM_221_u8 ComScl_Dspl_RawSignal_METER_CHECKSUM_296_u8 ComScl_Dspl_RawSignal_METER_CHECKSUM_309_u8 ComScl_Dspl_RawSignal_METER_CHECKSUM_326_u8 ComScl_Dspl_RawSignal_METER_CHECKSUM_331_u8 ComScl_Dspl_RawSignal_METER_CHECKSUM_371_u8 ComScl_Dspl_RawSignal_METER_CHECKSUM_372_2_u8 ComScl_Dspl_RawSignal_METER_CHECKSUM_372_u8 ComScl_Dspl_RawSignal_METER_CHECKSUM_374_u8 ComScl_Dspl_RawSignal_METER_CHECKSUM_37B_u8 ComScl_Dspl_RawSignal_METER_CHECKSUM_396_u8 ComScl_Dspl_RawSignal_METER_CHECKSUM_3A1_u8 ComScl_Dspl_RawSignal_METER_CHECKSUM_510_u8 ComScl_Dspl_RawSignal_METER_CHECKSUM_516_u8 ComScl_Dspl_RawSignal_METER_COMPCURRENT_HIBYTE_u8 ComScl_Dspl_RawSignal_METER_COMPCURRENT_LOWBYTE_u8 ComScl_Dspl_RawSignal_METER_CUSTOM_DEFAULT_b ComScl_Dspl_RawSignal_METER_CUSTOM_KJ_SPEED_LIMITER_b ComScl_Dspl_RawSignal_METER_CUSTOM_STATUS_b ComScl_Dspl_RawSignal_METER_DIGITAL_SPEED_DISPLAY_u8 ComScl_Dspl_RawSignal_METER_DIGITAL_SPEED_TARGET_u16 ComScl_Dspl_RawSignal_METER_DISPLAY_SPEED_u16 ComScl_Dspl_RawSignal_METER_ECONSW_ON_2_b ComScl_Dspl_RawSignal_METER_EVA_TEMP_2_u8 ComScl_Dspl_RawSignal_METER_EVA_TEMP_u8 ComScl_Dspl_RawSignal_METER_FRDEF_b ComScl_Dspl_RawSignal_METER_FRFOGRLY_b ComScl_Dspl_RawSignal_METER_FUEL_LEVEL_RAW_u8 ComScl_Dspl_RawSignal_METER_ICU_ACBLW_VD_u8 ComScl_Dspl_RawSignal_METER_ICU_HOOD_2_b ComScl_Dspl_RawSignal_METER_ICU_HOOD_ERR_2_b ComScl_Dspl_RawSignal_METER_ICU_HOOD_ERR_b ComScl_Dspl_RawSignal_METER_ICU_HOOD_b ComScl_Dspl_RawSignal_METER_IN_AIR_TEMP_u8 ComScl_Dspl_RawSignal_METER_IS_INHIBITSW_ON_2_b ComScl_Dspl_RawSignal_METER_IS_INHIBITSW_ON_b ComScl_Dspl_RawSignal_METER_IS_PERMIT_b ComScl_Dspl_RawSignal_METER_IS_TIME_2_u8 ComScl_Dspl_RawSignal_METER_IS_TIME_u8 ComScl_Dspl_RawSignal_METER_KLDDORLOCK_2_u8 ComScl_Dspl_RawSignal_METER_MICU_FRDEICERRLY_b ComScl_Dspl_RawSignal_METER_MICU_FRWIPMTR_u8 ComScl_Dspl_RawSignal_METER_MICU_RRDEFSW_b ComScl_Dspl_RawSignal_METER_MICU_TYPE_b ComScl_Dspl_RawSignal_METER_ODODATA_STATE_b ComScl_Dspl_RawSignal_METER_ODO_DATA_u32 ComScl_Dspl_RawSignal_METER_OIL_LIFE_RESSW_b ComScl_Dspl_RawSignal_METER_OUTTEMP_u8 ComScl_Dspl_RawSignal_METER_OUT_AIR_TEMP_u8 ComScl_Dspl_RawSignal_METER_RM_DRLKC_b ComScl_Dspl_RawSignal_METER_RM_HLHIRLY_b ComScl_Dspl_RawSignal_METER_RM_HLLORLY_b ComScl_Dspl_RawSignal_METER_RM_ILL_SML_b ComScl_Dspl_RawSignal_METER_RRFOGRLY_b ComScl_Dspl_RawSignal_METER_SPEED_UNIT_b ComScl_Dspl_RawSignal_METER_SW_STATUS_CC_STANDARD_u8 ComScl_Dspl_RawSignal_METER_SW_STATUS_HAC_2_b ComScl_Dspl_RawSignal_METER_SW_STATUS_HAC_b ComScl_Dspl_RawSignal_METER_SW_STATUS_IS_INH_b ComScl_Dspl_RawSignal_METER_SW_STATUS_LKAS_CCLIM_DIST_u8 ComScl_Dspl_RawSignal_METER_SW_STATUS_PARK_BRAKE_b ComScl_Dspl_RawSignal_METER_WIPER_STATUS_u8 ComScl_EngLin_RawSignal_Lin_Alt_B_Signal_ACG_Temp_8_r_msg_u8 ComScl_EngLin_RawSignal_Lin_Alt_B_Signal_ComTOut_1_r_msg_b ComScl_EngLin_RawSignal_Lin_Alt_B_Signal_Com_1_r_msg_b ComScl_EngLin_RawSignal_Lin_Alt_B_Signal_Dyc_5_r_msg_u8 ComScl_EngLin_RawSignal_Lin_Alt_B_Signal_Elec_1_r_msg_b ComScl_EngLin_RawSignal_Lin_Alt_B_Signal_ExctCrnt_8_r_msg_u8 ComScl_EngLin_RawSignal_Lin_Alt_B_Signal_HiTemp_1_r_msg_b ComScl_EngLin_RawSignal_Lin_Alt_B_Signal_Mchn_1_r_msg_b ComScl_EngLin_RawSignal_Lin_BS_B_Signal_OCV_8_r_msg_u8 ComScl_EngLin_RawSignal_Lin_BS_B_Signal_STBATTSENRST_1_r_msg_b ComScl_EngLin_RawSignal_Lin_BS_B_Signal_TASIC_8_r_msg_u8 ComScl_EngLin_RawSignal_Lin_BS_B_Signal_tiDurAftIgnOff_16_r_msg_u16 ComScl_EngLin_RawSignal_Lin_BS_Signal_B_BATTCH_16_r_msg_u16 ComScl_EngLin_RawSignal_Lin_BS_Signal_B_BATTDCHA_16_r_msg_u16 ComScl_EngLin_RawSignal_Lin_BS_Signal_B_BATT_REPLACE_1_r_msg_b ComScl_EngLin_RawSignal_Lin_BS_Signal_B_BATT_SIZE_DETECT_1_r_msg_b ComScl_EngLin_RawSignal_Lin_BS_Signal_B_BATT_WARM_LEVEL_3_r_msg_u8 ComScl_EngLin_RawSignal_Lin_BS_Signal_B_BCF_1_r_msg_b ComScl_EngLin_RawSignal_Lin_BS_Signal_B_CHARGE_LOW_1_r_msg_b ComScl_EngLin_RawSignal_Lin_BS_Signal_B_CTINTRESUPD_2_r_msg_u8 ComScl_EngLin_RawSignal_Lin_BS_Signal_B_DATA_FORMAT_8_r_msg_u8 ComScl_EngLin_RawSignal_Lin_BS_Signal_B_ERROR_RES_1_r_msg_b ComScl_EngLin_RawSignal_Lin_BS_Signal_B_HARNR_2_r_msg_u8 ComScl_EngLin_RawSignal_Lin_BS_Signal_B_IBAT_16_r_msg_u16 ComScl_EngLin_RawSignal_Lin_BS_Signal_B_IBAT_8_r_msg_u8 ComScl_EngLin_RawSignal_Lin_BS_Signal_B_IOP_ERROR_1_r_msg_b ComScl_EngLin_RawSignal_Lin_BS_Signal_B_MEASDR_2_r_msg_u8 ComScl_EngLin_RawSignal_Lin_BS_Signal_B_RESMEASDBATT_16_r_msg_u16 ComScl_EngLin_RawSignal_Lin_BS_Signal_B_RI_ST_OTHER_MEASURE_16_r_msg_u16 ComScl_EngLin_RawSignal_Lin_BS_Signal_B_SOC_8_r_msg_u8 ComScl_EngLin_RawSignal_Lin_BS_Signal_B_SOC_STATE_3_r_msg_u8 ComScl_EngLin_RawSignal_Lin_BS_Signal_B_SOFV_RESTART_8_r_msg_u8 ComScl_EngLin_RawSignal_Lin_BS_Signal_B_SOFV_RESTART_STATE_1_r_msg_b ComScl_EngLin_RawSignal_Lin_BS_Signal_B_SOH_COR_8_r_msg_u8 ComScl_EngLin_RawSignal_Lin_BS_Signal_B_SOH_COR_STATE_1_r_msg_b ComScl_EngLin_RawSignal_Lin_BS_Signal_B_SOH_LAM_8_r_msg_u8 ComScl_EngLin_RawSignal_Lin_BS_Signal_B_SOH_LAM_STATE_1_r_msg_b ComScl_EngLin_RawSignal_Lin_BS_Signal_B_SOH_SUL_8_r_msg_u8 ComScl_EngLin_RawSignal_Lin_BS_Signal_B_SOH_SUL_STATE_1_r_msg_b ComScl_EngLin_RawSignal_Lin_BS_Signal_B_SUPPLIER_CODE_8_r_msg_u8 ComScl_EngLin_RawSignal_Lin_BS_Signal_B_TBAT_8_r_msg_u8 ComScl_EngLin_RawSignal_Lin_BS_Signal_B_UBAT_16_r_msg_u16 ComScl_EngLin_RawSignal_Lin_BS_Signal_B_iStByCurrAft0h_10_r_msg_u16 ComScl_EngLin_RawSignal_Lin_BS_Signal_B_iStByCurrAft1h_10_r_msg_u16 ComScl_EngLin_RawSignal_Lin_BS_Signal_B_iStByCurrAft2h_10_r_msg_u16 ComScl_EngLin_RawSignal_Lin_BS_Signal_B_iStByCurrLst_10_r_msg_u16 ComScl_EngLin_RawSignal_Lin_BS_Signal_CHARERR_1_r_msg_b ComScl_EngLin_RawSignal_Lin_BS_Signal_ERRCMN_1_r_msg_b ComScl_EngLin_RawSignal_Lin_BS_Signal_ERRST_1_r_msg_b ComScl_EngLin_RawSignal_Lin_BS_Signal_IBATTAVGLINOFF_8_r_msg_u8 ComScl_EngLin_RawSignal_Lin_DCDC_Signal_nrSwVers_3_r_msg_u8 ComScl_EngLin_RawSignal_Lin_DCDC_Signal_stBoosterErr_1_r_msg_b ComScl_EngLin_RawSignal_Lin_DCDC_Signal_stCSTErr_1_r_msg_b ComScl_EngLin_RawSignal_Lin_DCDC_Signal_stCSTHist_1_r_msg_b ComScl_EngLin_RawSignal_Lin_DCDC_Signal_stDCLinRVer_1_r_msg_b ComScl_EngLin_RawSignal_Lin_DCDC_Signal_stInpErr1_1_r_msg_b ComScl_EngLin_RawSignal_Lin_DCDC_Signal_stInpErr2_1_r_msg_b ComScl_EngLin_RawSignal_Lin_DCDC_Signal_stIntErr_1_r_msg_b ComScl_EngLin_RawSignal_Lin_DCDC_Signal_stMode_1_r_msg_b ComScl_EngLin_RawSignal_Lin_DCDC_Signal_stOutpErr1_1_r_msg_b ComScl_EngLin_RawSignal_Lin_DCDC_Signal_stOutpErr2_1_r_msg_b ComScl_EngLin_RawSignal_Lin_DCDC_Signal_stTempWarn1_1_r_msg_b ComScl_EngLin_RawSignal_Lin_DCDC_Signal_stTempWarn2_1_r_msg_b ComScl_EngLin_RawSignal_Lin_DCDC_Signal_stUnitSt_1_r_msg_b ComScl_Gbx_RawSignal_CVT_MISS_MILON_REQ_FLAG_b ComScl_Gbx_RawSignal_CVT_MISS_VSENS_FAIL_FLAG_b ComScl_Gbx_RawSignal_CVT_MISS_VSENS_OK_FLAG_b ComScl_Gbx_RawSignal_CVT_MISS_VSENS_TFCD_FLAG_b ComScl_Gbx_RawSignal_CVT_RATIO_INFO_191_u8 ComScl_Gbx_RawSignal_CVT_SHFT_IN_D_b ComScl_Gbx_RawSignal_CVT_SHFT_IN_L_b ComScl_Gbx_RawSignal_CVT_SHFT_IN_NEUTRAL_b ComScl_Gbx_RawSignal_CVT_SHFT_IN_PARKING_b ComScl_Gbx_RawSignal_CVT_SHFT_IN_REVERSE_b ComScl_Gbx_RawSignal_CVT_SHFT_IN_S_b ComScl_Gbx_RawSignal_CVT_SHIFT_SURE_b ComScl_Gbx_RawSignal_CVT_TRANS_MIL_b ComScl_Gbx_RawSignal_EAT_ALIVE_COUNTER_158_u8 ComScl_Gbx_RawSignal_EAT_ALIVE_COUNTER_191_u8 ComScl_Gbx_RawSignal_EAT_ALIVE_COUNTER_41B_u8 ComScl_Gbx_RawSignal_EAT_ATF_TEMP_INVALID_b ComScl_Gbx_RawSignal_EAT_CHECKSUM_158_u8 ComScl_Gbx_RawSignal_EAT_CHECKSUM_191_u8 ComScl_Gbx_RawSignal_EAT_CHECKSUM_41B_u8 ComScl_Gbx_RawSignal_EAT_REF_DISTANCE_TRAVELLED_u8 ComScl_Gbx_RawSignal_EAT_TRANS_MAIN_SHAFT_SPEED_u16 ComScl_Gbx_RawSignal_EAT_TRANS_SPEED_VNC_u16 ComScl_Gbx_RawSignal_EAT_TRANS_SPEED_u16 ComScl_Gbx_RawSignal_TM_ALCZONE_u8 ComScl_Gbx_RawSignal_TM_ALIVE_COUNTER_071_u8 ComScl_Gbx_RawSignal_TM_ALIVE_COUNTER_072_u8 ComScl_Gbx_RawSignal_TM_ALIVE_COUNTER_07B_u8 ComScl_Gbx_RawSignal_TM_ALIVE_COUNTER_07C_u8 ComScl_Gbx_RawSignal_TM_ALIVE_COUNTER_07E_u8 ComScl_Gbx_RawSignal_TM_ALIVE_COUNTER_19D_u8 ComScl_Gbx_RawSignal_TM_ALIVE_COUNTER_1BF_u8 ComScl_Gbx_RawSignal_TM_ALIVE_COUNTER_1F0_u8 ComScl_Gbx_RawSignal_TM_ALIVE_COUNTER_351_u8 ComScl_Gbx_RawSignal_TM_ALIVE_COUNTER_40B_u8 ComScl_Gbx_RawSignal_TM_ATF_TEMP_u8 ComScl_Gbx_RawSignal_TM_AT_CC_FWD_b ComScl_Gbx_RawSignal_TM_CHECKSUM_071_u8 ComScl_Gbx_RawSignal_TM_CHECKSUM_072_u8 ComScl_Gbx_RawSignal_TM_CHECKSUM_07B_u8 ComScl_Gbx_RawSignal_TM_CHECKSUM_07C_u8 ComScl_Gbx_RawSignal_TM_CHECKSUM_07E_u8 ComScl_Gbx_RawSignal_TM_CHECKSUM_19D_u8 ComScl_Gbx_RawSignal_TM_CHECKSUM_1BF_u8 ComScl_Gbx_RawSignal_TM_CHECKSUM_1F0_u8 ComScl_Gbx_RawSignal_TM_CHECKSUM_351_u8 ComScl_Gbx_RawSignal_TM_CHECKSUM_40B_u8 ComScl_Gbx_RawSignal_TM_CVTNP_FLAG_b ComScl_Gbx_RawSignal_TM_DEC_FC_LC_OK_b ComScl_Gbx_RawSignal_TM_ECON_POS_FAIL_OK_b ComScl_Gbx_RawSignal_TM_FAULT_ACTION_STATUS_VSP_FAIL_b ComScl_Gbx_RawSignal_TM_F_DFTRFENTM_b ComScl_Gbx_RawSignal_TM_GEARPOS_N_DET_b ComScl_Gbx_RawSignal_TM_GEARPOS_P_DETSUB_b ComScl_Gbx_RawSignal_TM_GEARPOS_P_DET_b ComScl_Gbx_RawSignal_TM_GEARPOS_P_REQSUB_b ComScl_Gbx_RawSignal_TM_HACCUT_REQ_b ComScl_Gbx_RawSignal_TM_HEAVY_DEC_FLAG_b ComScl_Gbx_RawSignal_TM_IDLE_STOP_CONDITION_b ComScl_Gbx_RawSignal_TM_IDLE_STOP_OK_b ComScl_Gbx_RawSignal_TM_IDLE_STOP_TRIGGER_b ComScl_Gbx_RawSignal_TM_IG1_STATE_b ComScl_Gbx_RawSignal_TM_IG1_VOLTAGE_u16 ComScl_Gbx_RawSignal_TM_LC_INFORMATION_u8 ComScl_Gbx_RawSignal_TM_LIMP_HOME_MODE_b ComScl_Gbx_RawSignal_TM_MAP_CC_u8 ComScl_Gbx_RawSignal_TM_MIL_REQUEST_b ComScl_Gbx_RawSignal_TM_M_MODE_RUN_b ComScl_Gbx_RawSignal_TM_N_TC_u16 ComScl_Gbx_RawSignal_TM_OVERALL_FILTERED_RATIO_u16 ComScl_Gbx_RawSignal_TM_RECOGNITION_VOLTAGE_u16 ComScl_Gbx_RawSignal_TM_REQ_ENG_TORQUE_FAST_s16 ComScl_Gbx_RawSignal_TM_REQ_ENG_TORQUE_SLOW_s16 ComScl_Gbx_RawSignal_TM_REQ_MAX_FC_LIMT_ENG_SPEED_u8 ComScl_Gbx_RawSignal_TM_REQ_MAX_TQ_LIMT_ENG_SPEED_u8 ComScl_Gbx_RawSignal_TM_REQ_MIN_IDLE_ENG_SPEED_u8 ComScl_Gbx_RawSignal_TM_SHFT_IND_RECOM_DOWN_b ComScl_Gbx_RawSignal_TM_SHFT_IND_RECOM_UP_b ComScl_Gbx_RawSignal_TM_SHIFT_CONTROL_MODE_u8 ComScl_Gbx_RawSignal_TM_START_ENABLESUB_b ComScl_Gbx_RawSignal_TM_START_ENABLE_b ComScl_Gbx_RawSignal_TM_TORQUE_CONVERTER_SLIP_u16 ComScl_Gbx_RawSignal_TM_TORQUE_CONV_TORQUE_RATIO_u16 ComScl_Gbx_RawSignal_TM_TORQUE_LOSSES_s16 ComScl_Gbx_RawSignal_TM_TRQ_CONTROL_MODE_FAST_DNREQ_b ComScl_Gbx_RawSignal_TM_TRQ_CONTROL_MODE_SLOW_DNREQ_b ComScl_Gbx_RawSignal_TM_TRS_DRV_RATIO_u8 ComScl_Gbx_RawSignal_TM_VEHICLE_SPEED_u16 ComScl_Gbx_RawSignal_TM_VLVW_u16 ComScl_Gbx_RawSignal_TM_VSA_INH_b ComScl_Gbx_RawSignal_TM_WRITE_VIN_CLEAR_DONE_b ComScl_Gw_RawSignal_GW_ALIVE_COUNTER_40E_u8 ComScl_Gw_RawSignal_GW_ALIVE_COUNTER_444_u8 ComScl_Gw_RawSignal_GW_CHECKSUM_40E_u8 ComScl_Gw_RawSignal_GW_CHECKSUM_444_u8 ComScl_Gw_RawSignal_GW_IG1_STATE_b ComScl_Gw_RawSignal_GW_IG1_VOLTAGE_u16 ComScl_Gw_RawSignal_GW_RECOGNITION_VOLTAGE_u16 ComScl_Gw_RawSignal_IMG_ALIVE_COUNTER_082_u8 ComScl_Gw_RawSignal_IMG_ALIVE_COUNTER_084_u8 ComScl_Gw_RawSignal_IMG_ALIVE_COUNTER_22B_u8 ComScl_Gw_RawSignal_IMG_ALIVE_COUNTER_2F1_u8 ComScl_Gw_RawSignal_IMG_CHECKSUM_082_u8 ComScl_Gw_RawSignal_IMG_CHECKSUM_084_u8 ComScl_Gw_RawSignal_IMG_CHECKSUM_22B_u8 ComScl_Gw_RawSignal_IMG_CHECKSUM_2F1_u8 ComScl_Gw_RawSignal_IMG_DRVTRQ_STATUS_u8 ComScl_Gw_RawSignal_IMG_ENG_CAN_RECIEVE_ERROR_b ComScl_Gw_RawSignal_IMG_F_WVINCLDN_b ComScl_Gw_RawSignal_IMG_IDS_GRP_A12_MODE_u8 ComScl_Gw_RawSignal_IMG_IDS_GRP_A5_MODE_u8 ComScl_Gw_RawSignal_IMG_IS_BHOLD_ACT_b ComScl_Gw_RawSignal_IMG_IS_BHOLD_STANBY_b ComScl_Gw_RawSignal_IMG_IS_BRKCNT_ADAS_b ComScl_Gw_RawSignal_IMG_IS_INHIBITBRK_b ComScl_Gw_RawSignal_IMG_IS_RELEASE_REQUEST_b ComScl_Gw_RawSignal_IMG_IS_RESTART_INHIBITBRK_b ComScl_Gw_RawSignal_IMG_IS_SHIFT_INHBITBRK_b ComScl_Gw_RawSignal_IMG_IS_SYSOFFBRK_b ComScl_Gw_RawSignal_IMG_LIMTRQ_STATUS_u8 ComScl_Gw_RawSignal_IMG_MIL_REQ_b ComScl_Gw_RawSignal_IMG_REQ_BRK_CTRL_b ComScl_Gw_RawSignal_IMG_REQ_DRVTRQ_s16 ComScl_Gw_RawSignal_IMG_REQ_LIMTRQ_s16 ComScl_Gw_RawSignal_IMG_SHIFT_REQUEST_u8 ComScl_IDAS_RawSignal_IDAS_ALIVE_COUNTER_1EF_u8 ComScl_IDAS_RawSignal_IDAS_CHECKSUM_1EF_u8 ComScl_IDAS_RawSignal_IDAS_ISA_BASE_SPEED_u8 ComScl_PCU_RawSignal_PCU_ALIVE_COUNTER_1FB_u8 ComScl_PCU_RawSignal_PCU_CHECKSUM_1FB_u8 ComScl_PCU_RawSignal_PCU_INHBIT_START_ENG_b ComScl_StbIntv_RawSignal_EPB_ALIVE_COUNTER_112_u8 ComScl_StbIntv_RawSignal_EPB_ALIVE_COUNTER_1C2_u8 ComScl_StbIntv_RawSignal_EPB_APPLIED_b ComScl_StbIntv_RawSignal_EPB_CHECKSUM_112_u8 ComScl_StbIntv_RawSignal_EPB_CHECKSUM_1C2_u8 ComScl_StbIntv_RawSignal_EPB_CLUTCH_PEADAL_STROKE_u8 ComScl_StbIntv_RawSignal_EPB_CLUTCH_PEDAL_FAIL_DETECT_b ComScl_StbIntv_RawSignal_EPB_CLUTCH_PEDAL_FAIL_b ComScl_StbIntv_RawSignal_EPB_CPS1_OUTPUT_VOLTAGE_u16 ComScl_StbIntv_RawSignal_EPB_CPS2_OUTPUT_VOLTAGE_u16 ComScl_StbIntv_RawSignal_EPB_INHIBIT_ACT_b ComScl_StbIntv_RawSignal_EPB_PLANT_SAFETY_MODE_STATUS_b ComScl_StbIntv_RawSignal_EPB_REFUSE_ACT_b ComScl_StbIntv_RawSignal_EPB_STATE_u8 ComScl_StbIntv_RawSignal_VSA_ABS_CHECKSUM_1D0_u8 ComScl_StbIntv_RawSignal_VSA_ABS_CTRL_b ComScl_StbIntv_RawSignal_VSA_ABS_EBD_ACT_b ComScl_StbIntv_RawSignal_VSA_ABS_EBD_MIL_b ComScl_StbIntv_RawSignal_VSA_ABS_FAIL_FL_VW_SENSOR_b ComScl_StbIntv_RawSignal_VSA_ABS_FAIL_FR_VW_SENSOR_b ComScl_StbIntv_RawSignal_VSA_ABS_FAIL_RL_VW_SENSOR_b ComScl_StbIntv_RawSignal_VSA_ABS_FAIL_RR_VW_SENSOR_b ComScl_StbIntv_RawSignal_VSA_ABS_FL_WHEEL_SPEED_u16 ComScl_StbIntv_RawSignal_VSA_ABS_FR_WHEEL_SPEED_u16 ComScl_StbIntv_RawSignal_VSA_ABS_RL_WHEEL_SPEED_u16 ComScl_StbIntv_RawSignal_VSA_ABS_RR_WHEEL_SPEED_u16 ComScl_StbIntv_RawSignal_VSA_ACC_BRAKE_ACT_b ComScl_StbIntv_RawSignal_VSA_ALIVECOUNTER_1AC_u8 ComScl_StbIntv_RawSignal_VSA_ALIVE_COUNTER_12E_u8 ComScl_StbIntv_RawSignal_VSA_ALIVE_COUNTER_1A4_u8 ComScl_StbIntv_RawSignal_VSA_ALIVE_COUNTER_1B0_u8 ComScl_StbIntv_RawSignal_VSA_BHOLD_STATUS_ACT_b ComScl_StbIntv_RawSignal_VSA_CASEN_b ComScl_StbIntv_RawSignal_VSA_CAS_ACT_b ComScl_StbIntv_RawSignal_VSA_CHECKSUM_12E_u8 ComScl_StbIntv_RawSignal_VSA_CHECKSUM_1A4_u8 ComScl_StbIntv_RawSignal_VSA_CHECKSUM_1AC_u8 ComScl_StbIntv_RawSignal_VSA_CHECKSUM_1B0_u8 ComScl_StbIntv_RawSignal_VSA_DRV_BRKTRQ_AYCI_u16 ComScl_StbIntv_RawSignal_VSA_DRV_BRKTRQ_u16 ComScl_StbIntv_RawSignal_VSA_ECD_ACT_b ComScl_StbIntv_RawSignal_VSA_EPB_INHIBIT_BRAKE_b ComScl_StbIntv_RawSignal_VSA_FAIL_LONG_G_SENSOR_b ComScl_StbIntv_RawSignal_VSA_FAIL_MC_PRESSURE_SENSOR_b ComScl_StbIntv_RawSignal_VSA_FAIL_YAW_RATE_SENSOR_b ComScl_StbIntv_RawSignal_VSA_HSA_STATUS_ACT_b ComScl_StbIntv_RawSignal_VSA_INHBIT_LONG_G_SENSOR_b ComScl_StbIntv_RawSignal_VSA_INHBIT_MC_PRESSURE_SENSOR_b ComScl_StbIntv_RawSignal_VSA_INHBIT_YAW_RATE_SENSOR_b ComScl_StbIntv_RawSignal_VSA_ISAB_ACT_b ComScl_StbIntv_RawSignal_VSA_ISAB_ENABLE_b ComScl_StbIntv_RawSignal_VSA_LAMP_STATUS_STANBY_BHOLD_b ComScl_StbIntv_RawSignal_VSA_LAMP_STATUS_VSA_OFF_b ComScl_StbIntv_RawSignal_VSA_MASTER_CYLINDER_PRESSURE_u16 ComScl_StbIntv_RawSignal_VSA_REQ_MSR_PLUS_TRQ_b ComScl_StbIntv_RawSignal_VSA_REQ_TRQ_1AC_s16 ComScl_StbIntv_RawSignal_VSA_REWRITE_START_b ComScl_StbIntv_RawSignal_VSA_SHIFT_REQ_1AC_u8 ComScl_StbIntv_RawSignal_VSA_TRQ_CONTROL_MODE_u8 ComScl_StbIntv_RawSignal_VSA_TRQ_DOWN_REQ_FUEL_CUT_u8 ComScl_StbIntv_RawSignal_VSA_VSA_CTRL_b ComScl_StbIntv_RawSignal_VSA_VSA_TCS_ACT_b ComScl_StbIntv_RawSignal_VSA_VSA_TCS_MIL_b ComScl_StbIntv_RawSignal_VSA_WARN_STATUS_ABS_b ComScl_Strg_RawSignal_EPS_ALIVE_COUNTER_1AB_u8 ComScl_Strg_RawSignal_EPS_CHECKSUM_1AB_u8 ComScl_Strg_RawSignal_EPS_IS_RELEASE_REQUEST_b ComScl_Strg_RawSignal_EPS_IS_SHIFT_INHIBIT_REQUEST_b ComScl_Strg_RawSignal_EPS_LOAD_u16 ComScl_Strg_RawSignal_EPS_MID_REQ_b /end LOC_MEASUREMENT
 FUNCTION_VERSION "4.17.3_6.0.0" /end FUNCTION
/begin FUNCTION rba_Dme "1.45.0  McFunction rba_Dme Created by MCFunctionUpdater"
 /begin LOC_MEASUREMENT rba_Dme_Ovl_stEnable rba_Dme_adrError rba_Dme_numBytesAvailable rba_Dme_numBytesAvailableOvl /end LOC_MEASUREMENT
 FUNCTION_VERSION "1.45.0" /end FUNCTION
/begin FUNCTION rba_IoExtLib "1.24.1    Library for external devices"
 /begin LOC_MEASUREMENT rba_IoExtLib_KeepAliveDrvErrCyc_u32 rba_IoExtLib_KeepAliveDrvErrPerm_u32 rba_IoExtLib_KeepAliveIniErrCyc_u32 rba_IoExtLib_KeepAliveIniErrPerm_u32 /end LOC_MEASUREMENT
 FUNCTION_VERSION "1.24.1" /end FUNCTION
/*********** Start of merged COMPU_METHOD blocks ***********/
/begin COMPU_METHOD RB_RBA_Common_CentralElements_CompuMethods_Identical "The internal value and the physical one are identical. No physical unit available" RAT_FUNC "%10.5" "noUnit" COEFFS 0.0 1.0 0.0 0.0 0.0 1.0 REF_UNIT RB_RBA_Common_CentralElements_Units_NoUnit /end COMPU_METHOD
/begin COMPU_METHOD RB_RBA_rba_MemLib_CompuMethods_Mem_Identical "The internal value and the physical one are identical. No physical unit available" RAT_FUNC "%10.5" "Mem_NoUnit" COEFFS 0.0 1.0 0.0 0.0 0.0 1.0 REF_UNIT RB_RBA_rba_MemLib_Units_Mem_NoUnit /end COMPU_METHOD
/begin COMPU_METHOD AUTOSAR_Lin_CompuMethods_Lin_Enum_Status_type "Enumeration for status type" TAB_VERB "%10.5" "noUnit" COMPU_TAB_REF AUTOSAR_Lin_CompuMethods_Lin_Enum_Status_type REF_UNIT AUTOSAR_Lin_Units_NoUnit /end COMPU_METHOD
/begin COMPU_METHOD AUTOSAR_Lin_CompuMethods_Lin_Enum_CheckSum_Type "Enumeration for Checksum model" TAB_VERB "%10.5" "noUnit" COMPU_TAB_REF AUTOSAR_Lin_CompuMethods_Lin_Enum_CheckSum_Type REF_UNIT AUTOSAR_Lin_Units_NoUnit /end COMPU_METHOD
/begin COMPU_METHOD AUTOSAR_Lin_CompuMethods_Lin_Enum_FrameRespType "Enumeration for frame responce type" TAB_VERB "%10.5" "noUnit" COMPU_TAB_REF AUTOSAR_Lin_CompuMethods_Lin_Enum_FrameRespType REF_UNIT AUTOSAR_Lin_Units_NoUnit /end COMPU_METHOD
/begin COMPU_METHOD AUTOSAR_Lin_CompuMethods_Lin_Enum_ChannelStateType "Enumeration for channel state" TAB_VERB "%10.5" "noUnit" COMPU_TAB_REF AUTOSAR_Lin_CompuMethods_Lin_Enum_ChannelStateType REF_UNIT AUTOSAR_Lin_Units_NoUnit /end COMPU_METHOD
/begin COMPU_METHOD AUTOSAR_LinSM_CompuMethods_LinSM_CompuMethod_OperationalMode "computation method displaying the Operational modes of LinSM" TAB_VERB "%10.5" "noUnit" COMPU_TAB_REF AUTOSAR_LinSM_CompuMethods_LinSM_CompuMethod_OperationalMode REF_UNIT AUTOSAR_LinSM_Units_NoUnit /end COMPU_METHOD
/begin COMPU_VTAB AUTOSAR_Lin_CompuMethods_Lin_Enum_Status_type "Enumeration for status type" TAB_VERB 11 0 "LIN_NOT_OK" 1 "LIN_TX_OK" 2 "LIN_TX_BUSY" 3 "LIN_TX_HEADER_ERROR" 4 "LIN_TX_ERROR" 5 "LIN_RX_OK" 6 "LIN_RX_BUSY" 7 "LIN_RX_ERROR" 8 "LIN_RX_NO_RESPONSE" 9 "LIN_OPERATIONAL" 10 "LIN_CH_SLEEP" /end COMPU_VTAB
/begin COMPU_VTAB AUTOSAR_Lin_CompuMethods_Lin_Enum_CheckSum_Type "Enumeration for Checksum model" TAB_VERB 2 0 "LIN_ENHANCED_CS" 1 "LIN_CLASSIC_CS" /end COMPU_VTAB
/begin COMPU_VTAB AUTOSAR_Lin_CompuMethods_Lin_Enum_FrameRespType "Enumeration for frame responce type" TAB_VERB 4 0 "LIN_MASTER_RESPONSE" 1 "LIN_SLAVE_RESPONSE" 2 "LIN_SLAVE_TO_SLAVE" 3 "LIN_UNKNOWN_RESPONSE" /end COMPU_VTAB
/begin COMPU_VTAB AUTOSAR_Lin_CompuMethods_Lin_Enum_ChannelStateType "Enumeration for channel state" TAB_VERB 8 0 "LIN_CH_UNINIT_E" 1 "LIN_CH_SLEEP_E" 2 "LIN_CH_IDLE_E" 3 "LIN_CH_SENDFRAME_E" 4 "LIN_CH_RECEIVEHEADER_E" 5 "LIN_CH_RECEIVERESPONSE_E" 6 "LIN_CH_RECEIVESENTCS_E" 7 "LIN_CH_RECEIVESELFWAKEUP_E" /end COMPU_VTAB
/begin COMPU_VTAB AUTOSAR_LinSM_CompuMethods_LinSM_CompuMethod_OperationalMode "computation method displaying the Operational modes of LinSM" TAB_VERB 2 1 "LINSM_FULL_COM" 2 "LINSM_NO_COM" /end COMPU_VTAB
/begin COMPU_METHOD AgPrTime_COMPU "" RAT_FUNC "%6.4" "deg CrS/s" COEFFS 0 100 0 0 0 1 /end COMPU_METHOD
/begin COMPU_METHOD AGRVWK_SY_Compu "" TAB_VERB "%6.3" "" COMPU_TAB_REF AGRVWK_SY_Compu /end COMPU_METHOD
/begin COMPU_VTAB AGRVWK_SY_Compu "" TAB_VERB 2 0 "False" 1 "True" /end COMPU_VTAB
/begin COMPU_METHOD AIRACTRLABTEST_SC_Compu "" TAB_VERB "%6.3" "" COMPU_TAB_REF AIRACTRLABTEST_SC_Compu /end COMPU_METHOD
/begin COMPU_VTAB AIRACTRLABTEST_SC_Compu "" TAB_VERB 5 0 "NOTACTV" 1 "ONEVLV" 2 "TWOVLV" 3 "AIRACTR" 4 "BLDC" /end COMPU_VTAB
/begin COMPU_METHOD AIRCDNGSWTOFFENGSTOP_SC_Compu "" RAT_FUNC "%6.2" "" COEFFS 0 1 0 0 0 1 /end COMPU_METHOD
/begin COMPU_METHOD AIRCHRGCTRL_INHOUSE_SC_Compu "" TAB_VERB "%6.3" "" COMPU_TAB_REF AIRCHRGCTRL_INHOUSE_SC_Compu /end COMPU_METHOD
/begin COMPU_VTAB AIRCHRGCTRL_INHOUSE_SC_Compu "" TAB_VERB 2 0 "False" 1 "True" /end COMPU_VTAB
/begin COMPU_METHOD AIRCHRGCYLARYSPST_SC_Compu "" TAB_VERB "%6.3" "" COMPU_TAB_REF AIRCHRGCYLARYSPST_SC_Compu /end COMPU_METHOD
/begin COMPU_VTAB AIRCHRGCYLARYSPST_SC_Compu "" TAB_VERB 2 0 "False" 1 "True" /end COMPU_VTAB
/begin COMPU_METHOD AIRCHRGCYLARY_SC_Compu "" TAB_VERB "%6.3" "" COMPU_TAB_REF AIRCHRGCYLARY_SC_Compu /end COMPU_METHOD
/begin COMPU_VTAB AIRCHRGCYLARY_SC_Compu "" TAB_VERB 2 0 "False" 1 "True" /end COMPU_VTAB
/begin COMPU_METHOD AIRC_ATSINTVMODCMPR_SY_Compu "" RAT_FUNC "%6.2" "" COEFFS 0 1 0 0 0 1 /end COMPU_METHOD
/begin COMPU_METHOD AIRC_ATSINTVMODREDTRQ_SY_Compu "" RAT_FUNC "%6.2" "" COEFFS 0 1 0 0 0 1 /end COMPU_METHOD
/begin COMPU_METHOD AIRC_REDTRQCMPRENA_SY_Compu "" TAB_VERB "%6.3" "" COMPU_TAB_REF AIRC_REDTRQCMPRENA_SY_Compu /end COMPU_METHOD
/begin COMPU_VTAB AIRC_REDTRQCMPRENA_SY_Compu "" TAB_VERB 2 0 "FALSE" 1 "TRUE" /end COMPU_VTAB
/begin COMPU_METHOD AIRDEV_VAR_SY_Compu "" TAB_VERB "%6.3" "" COMPU_TAB_REF AIRDEV_VAR_SY_Compu /end COMPU_METHOD
/begin COMPU_VTAB AIRDEV_VAR_SY_Compu "" TAB_VERB 49 0 "kein Kundenbezug" 1 "DAI" 3 "VWW" 4 "POR" 5 "AUD" 6 "OPE" 9 "FIA" 11 "BMW" 14 "PSA" 15 "REN" 17 "ALF" 18 "SAB" 19 "VOL" 20 "NIS" 21 "GMU" 22 "FOR" 26 "IMJ" 36 "MAN" 51 "SEA" 53 "CHR" 54 "JAG" 55 "ROL" 69 "FER" 72 "TOY" 123 "MIT" 147 "HYU" 159 "HON" 160 "MAZ" 183 "CU" 190 "LRG" 204 "VVW" 214 "AVT" 242 "Iveco" 243 "DMC" 248 "SUZ" 267 "SSANGYONG" 270 "KEF" 289 "AMG" 319 "MVM" 328 "MM" 385 "UAES" 578 "AL" 590 "SCANIA" 760 "WEICHAI" 828 "RBCD" 966 "International" 999 "ALL" 2887 "NONOX" 9454 "Fuso" /end COMPU_VTAB
/begin COMPU_METHOD AIRDVP_PSNSRADPNLCY_SC_Compu "" TAB_VERB "%6.3" "" COMPU_TAB_REF AIRDVP_PSNSRADPNLCY_SC_Compu /end COMPU_METHOD
/begin COMPU_VTAB AIRDVP_PSNSRADPNLCY_SC_Compu "" TAB_VERB 2 0 "NoLegacyInterface" 1 "LegacyInterface" /end COMPU_VTAB
/begin COMPU_METHOD AIRDVP_PTHRVLVUSSNSRHWIF_SC_Compu "" TAB_VERB "%6.3" "" COMPU_TAB_REF AIRDVP_PTHRVLVUSSNSRHWIF_SC_Compu /end COMPU_METHOD
/begin COMPU_VTAB AIRDVP_PTHRVLVUSSNSRHWIF_SC_Compu "" TAB_VERB 6 0 "NO_SENSOR" 1 "Analogous_sensor" 2 "Digital_Sensor" 3 "Analog_sensor/Digital_sensor" 4 "CAN_sensor" 5 "PFM_Sensor" /end COMPU_VTAB
/begin COMPU_METHOD AIRDVP_VAR_SY_Compu "" TAB_VERB "%6.3" "" COMPU_TAB_REF AIRDVP_VAR_SY_Compu /end COMPU_METHOD
/begin COMPU_VTAB AIRDVP_VAR_SY_Compu "" TAB_VERB 50 0 "kein Kundenbezug" 1 "DAI" 3 "VWW" 4 "POR" 5 "AUD" 6 "OPE" 9 "FIA" 11 "BMW" 14 "PSA" 15 "REN" 17 "ALF" 18 "SAB" 19 "VOL" 20 "NIS" 21 "GMU" 22 "FOR" 26 "IMJ" 36 "MAN" 51 "SEA" 53 "CHR" 54 "JAG" 55 "ROL" 69 "FER" 72 "TOY" 123 "MIT" 147 "HYU" 159 "HON" 160 "MAZ" 183 "CU" 190 "LRG" 204 "VVW" 214 "AVT" 242 "Iveco" 243 "DMC" 248 "SUZ" 267 "SSANGYONG" 270 "KEF" 289 "AMG" 308 "TAT" 319 "MVM" 385 "UAES" 578 "AL" 590 "Scania" 609 "Deutz" 760 "WEICHAI" 828 "RBCD" 966 "International" 999 "ALL" 2887 "NONOX" 9454 "Fuso" /end COMPU_VTAB
/begin COMPU_METHOD AirFlRat "" RAT_FUNC "%6.4" "-" COEFFS 0 200 0 0 0 1 /end COMPU_METHOD
/begin COMPU_METHOD AIRLIMFORMAXINJTI_SC_Compu "" TAB_VERB "%6.3" "" COMPU_TAB_REF AIRLIMFORMAXINJTI_SC_Compu /end COMPU_METHOD
/begin COMPU_VTAB AIRLIMFORMAXINJTI_SC_Compu "" TAB_VERB 2 0 "False" 1 "True" /end COMPU_VTAB
/begin COMPU_METHOD AirMass "" RAT_FUNC "%6.4" "g" COEFFS 0 100 0 0 0 1 /end COMPU_METHOD
/begin COMPU_METHOD AirMassPerTimeMgScnd "" RAT_FUNC "%6.3" "mg/s" COEFFS 0 10 0 0 0 1 /end COMPU_METHOD
/begin COMPU_METHOD AirMassPerTime_2 "" RAT_FUNC "%7.6" "g/s" COEFFS 0 31250 0 0 0 1 /end COMPU_METHOD
/begin COMPU_METHOD AirMass_2 "" RAT_FUNC "%6.3" "g" COEFFS 0 10 0 0 0 1 /end COMPU_METHOD
/begin COMPU_METHOD AIRMODDIAGMIXADPN_SC_Compu "" TAB_VERB "%6.3" "" COMPU_TAB_REF AIRMODDIAGMIXADPN_SC_Compu /end COMPU_METHOD
/begin COMPU_VTAB AIRMODDIAGMIXADPN_SC_Compu "" TAB_VERB 2 0 "False" 1 "True" /end COMPU_VTAB
/begin COMPU_METHOD AIRMOD_AIRINTEGRFCO_SC_Compu "" TAB_VERB "%6.3" "" COMPU_TAB_REF AIRMOD_AIRINTEGRFCO_SC_Compu /end COMPU_METHOD
/begin COMPU_VTAB AIRMOD_AIRINTEGRFCO_SC_Compu "" TAB_VERB 2 0 "False" 1 "True" /end COMPU_VTAB
/begin COMPU_METHOD AIRMOD_BASCONLY_SC_Compu "" TAB_VERB "%6.3" "" COMPU_TAB_REF AIRMOD_BASCONLY_SC_Compu /end COMPU_METHOD
/begin COMPU_VTAB AIRMOD_BASCONLY_SC_Compu "" TAB_VERB 2 0 "False" 1 "True" /end COMPU_VTAB
/*********** Start of merged UNIT blocks ***********/
/begin UNIT RB_RBA_Common_CentralElements_Units_NoUnit "No Unit" "noUnit" EXTENDED_SI SI_EXPONENTS 0 0 0 0 0 0 0 /end UNIT
/begin UNIT RB_RBA_rba_MemLib_Units_Mem_NoUnit "Mem No Unit / 1:1 / Identical" "Mem_NoUnit" EXTENDED_SI SI_EXPONENTS 0 0 0 0 0 0 0 /end UNIT
/begin UNIT AUTOSAR_Lin_Units_NoUnit "No Unit" "noUnit" EXTENDED_SI SI_EXPONENTS 0 0 0 0 0 0 0 /end UNIT
/begin UNIT AUTOSAR_LinSM_Units_NoUnit "No Unit" "noUnit" EXTENDED_SI SI_EXPONENTS 0 0 0 0 0 0 0 /end UNIT
/end MODULE
/end PROJECT
