ASAP2_VERSION 1 60
/begin PROJECT MG1CS022 "MG1CS022"
/begin HEADER "" VERSION "MG1CS022_62XSC_V037" PROJECT_NO MG1CS022 /end HEADER
/begin MODULE DIM ""
/begin MOD_COMMON "" BYTE_ORDER MSB_LAST ALIGNMENT_BYTE 1 ALIGNMENT_WORD 2 ALIGNMENT_LONG 4 ALIGNMENT_INT64 4 ALIGNMENT_FLOAT32_IEEE 4 ALIGNMENT_FLOAT64_IEEE 4 DATA_SIZE 32 /end MOD_COMMON
/begin CHARACTERISTIC ACCmpr_numTstMax_C "Maximum number of test-impulses that could be sent in case of permanent error during one driving cycle" VALUE 0x80506138 RB_Val_Wu16 65535.00 OneToOne 0.00 65535.00 FORMAT "%8.2" /end CHARACTERISTIC
/begin CHARACTERISTIC ACCmpr_tiBtwTstOT_C "Time between test impulses in case of OT error" VALUE 0x8050613A RB_Val_Ws16 655.3500 Time_s -327.6800 327.6700 FORMAT "%8.4" /end CHARACTERISTIC
/begin CHARACTERISTIC ACCmpr_tiBtwTstSCB_C "Time between test impulses in case of permanent error for SCB" VALUE 0x8050613C RB_Val_Ws16 655350.0 Time_ms -327680.0 327670.0 FORMAT "%8.1" /end CHARACTERISTIC
/begin CHARACTERISTIC ACComp_CalcDem_CW "codeword: configuartion of torque calculation" VALUE 0x80506148 RB_Val_Wu8 255.0 OneToOne 0.00 255.0 FORMAT "%5.1" /end CHARACTERISTIC
/begin CHARACTERISTIC ACComp_facACCmprOnResv_M "MAP of AC HW off torque reserve factor when AC compressor on" MAP 0x8050614A RB_Map_S16S16_S16 327.6700 fak_q0p01 0.00 327.6700 FORMAT "%8.4" EXTENDED_LIMITS -327.6800 327.6700
 /begin AXIS_DESCR STD_AXIS AirC_pClnt PresAC_hPa 6 -65536.00 65534.00 FORMAT "%8.2" DEPOSIT ABSOLUTE /end AXIS_DESCR
 /begin AXIS_DESCR STD_AXIS ACEvpT_t Temp_Cels 6 -3549.940 3003.560 FORMAT "%8.3" DEPOSIT ABSOLUTE /end AXIS_DESCR
/end CHARACTERISTIC
/begin CHARACTERISTIC ACComp_facCmprEnthCorrnA_C "Correction coefficient for calculating compressor ?enthalpy at A/C ideal adiabatic(A term)" VALUE 0x805061B0 RB_Val_Ws32 429496.729500 Fact_10000 -214748.364800 214748.364700 FORMAT "%13.6" /end CHARACTERISTIC
/begin CHARACTERISTIC ACComp_facCmprEnthCorrnB_C "Correction coefficient for calculating compressor ?enthalpy at A/C ideal adiabatic(B term)" VALUE 0x805061B4 RB_Val_Ws32 429496.729500 Fact_10000 -214748.364800 214748.364700 FORMAT "%13.6" /end CHARACTERISTIC
/begin CHARACTERISTIC ACComp_facCmprPlly_C "COMPR PR Compressor pulley ratio" VALUE 0x805061B8 RB_Val_Ws16 655.3500 Fact100 -327.6800 327.6700 FORMAT "%8.4" /end CHARACTERISTIC
/begin CHARACTERISTIC ACComp_facCmprTqExtInp_C "Conversion coefficient of AC compressor torque external input" VALUE 0x805061BA RB_Val_Wu16 32.76700 Fact1000 0.00 32.76700 FORMAT "%8.5" EXTENDED_LIMITS 0.00 65.53500 /end CHARACTERISTIC
/begin CHARACTERISTIC ACComp_facCooltFlowQnty_M "MAP for calculating Coefficient for A/C refrigerant flow quantity" MAP 0x805061BC RB_Map_S16S16_S16 65.53500 Fact1000 -32.76800 32.76700 FORMAT "%8.5"
 /begin AXIS_DESCR STD_AXIS ACComp_rWindVWghtAvrg Prc_Fact100 3 -327.6800 327.6700 FORMAT "%8.4" DEPOSIT ABSOLUTE /end AXIS_DESCR
 /begin AXIS_DESCR STD_AXIS VehV_v Vel 8 -327.6800 327.6700 FORMAT "%8.4" DEPOSIT ABSOLUTE /end AXIS_DESCR
/end CHARACTERISTIC
/begin CHARACTERISTIC ACComp_facCurrCtrlVal_C "Coefficient of AC control value current chatacteristic" VALUE 0x80506208 RB_Val_Ws32 429496.729500 Fact_10000 -214748.364800 214748.364700 FORMAT "%13.6" /end CHARACTERISTIC
/begin CHARACTERISTIC ACComp_facEnthpyCorrnA_C "AC variable capacity COMPR delta Correction term A for enthalpy calculation A" VALUE 0x8050620C RB_Val_Ws32 429496.729500 Fact_10000 -214748.364800 214748.364700 FORMAT "%13.6" /end CHARACTERISTIC
/begin CHARACTERISTIC ACComp_facEnthpyCorrnB_C "AC variable capacity COMPR delta Correction term B for calculation of enthalpy B" VALUE 0x80506210 RB_Val_Ws32 429496.729500 Fact_10000 -214748.364800 214748.364700 FORMAT "%13.6" /end CHARACTERISTIC
/begin CHARACTERISTIC ACComp_facFanStVal_C "Coefficient for calculating Fan status value." VALUE 0x80506214 RB_Val_Ws32 429496.729500 Fact_10000 -214748.364800 214748.364700 FORMAT "%13.6" /end CHARACTERISTIC
/begin CHARACTERISTIC ACComp_facFullCpTqCoeffA_C "Coefficient for torque calculation in the time of compressor MAX capacity (A term)" VALUE 0x80506218 RB_Val_Ws32 429496.729500 Fact_10000 -214748.364800 214748.364700 FORMAT "%13.6" /end CHARACTERISTIC
/begin CHARACTERISTIC ACComp_facFullCpTqCoeffB_C "Coefficient for torque calculation in the time of compressor MAX capacity (B term)" VALUE 0x8050621C RB_Val_Ws32 429496.729500 Fact_10000 -214748.364800 214748.364700 FORMAT "%13.6" /end CHARACTERISTIC
/begin CHARACTERISTIC ACComp_facFullCpTqCorrn_C "correction term of torque calculation in the time of compressor MAX capacity" VALUE 0x80506220 RB_Val_Ws32 429496.729500 Fact_10000 -214748.364800 214748.364700 FORMAT "%13.6" /end CHARACTERISTIC
/begin CHARACTERISTIC ACComp_facGearACCmprOnResv_M "MAP of AC HW off torque reserve factor in driving state and AC compressor on" MAP 0x80506224 RB_Map_S16S16_S16 327.6700 fak_q0p01 0.00 327.6700 FORMAT "%8.4" EXTENDED_LIMITS -327.6800 327.6700
 /begin AXIS_DESCR STD_AXIS AirC_pClnt PresAC_hPa 6 -65536.00 65534.00 FORMAT "%8.2" DEPOSIT ABSOLUTE /end AXIS_DESCR
 /begin AXIS_DESCR STD_AXIS ACEvpT_t Temp_Cels 6 -3549.940 3003.560 FORMAT "%8.3" DEPOSIT ABSOLUTE /end AXIS_DESCR
/end CHARACTERISTIC
/begin CHARACTERISTIC ACComp_facHwGearOffResv_T "AC HW off torque reserve factor Curve in driving state" CURVE 0x80506288 RB_Curve_S16_S16 327.6700 fak_q0p01 0.00 327.6700 FORMAT "%8.4" EXTENDED_LIMITS -327.6800 327.6700
 /begin AXIS_DESCR STD_AXIS CEngDsT_t Temp_Cels 8 -3549.940 3003.560 FORMAT "%8.3" DEPOSIT ABSOLUTE /end AXIS_DESCR
/end CHARACTERISTIC
/begin CHARACTERISTIC ACComp_facHwOffResv_T "AC HW off torque reserve factor Curve" CURVE 0x805062AA RB_Curve_S16_S16 327.6700 fak_q0p01 0.00 327.6700 FORMAT "%8.4" EXTENDED_LIMITS -327.6800 327.6700
 /begin AXIS_DESCR STD_AXIS CEngDsT_t Temp_Cels 8 -3549.940 3003.560 FORMAT "%8.3" DEPOSIT ABSOLUTE /end AXIS_DESCR
/end CHARACTERISTIC
/begin CHARACTERISTIC ACComp_facOutdTCorrnA_C "Correction term of outside temperature in the time of idle (A term)" VALUE 0x805062CC RB_Val_Ws32 429496.729500 Fact_10000 -214748.364800 214748.364700 FORMAT "%13.6" /end CHARACTERISTIC
/begin CHARACTERISTIC ACComp_facOutdTCorrnB_C "Correction term of outside temperature in the time of idle (B term)" VALUE 0x805062D0 RB_Val_Ws32 429496.729500 Fact_10000 -214748.364800 214748.364700 FORMAT "%13.6" /end CHARACTERISTIC
/begin CHARACTERISTIC ACComp_facOutdTDurgIdleA_C "Correction coefficient for outside temperature in the time of idle (A term)" VALUE 0x805062D4 RB_Val_Ws32 429496.729500 Fact_10000 -214748.364800 214748.364700 FORMAT "%13.6" /end CHARACTERISTIC
/begin CHARACTERISTIC ACComp_facOutdTDurgIdleB_C "Correction coefficient for outside temperature in the time of idle (B term)" VALUE 0x805062D8 RB_Val_Ws32 429496.729500 Fact_10000 -214748.364800 214748.364700 FORMAT "%13.6" /end CHARACTERISTIC
/begin CHARACTERISTIC ACComp_facTqEvaprSnsrValB_C "Coefficient for calculating Evaporator torque at Ps control valve(B term)" VALUE 0x805062DC RB_Val_Ws32 429496.729500 Fact_10000 -214748.364800 214748.364700 FORMAT "%13.6" /end CHARACTERISTIC
/begin CHARACTERISTIC ACComp_facTqEvaprSnsrValC_C "Coefficient for calculating Evaporator torque in the time of compressor MAX capacity (C term)" VALUE 0x805062E0 RB_Val_Ws32 429496.729500 Fact_10000 -214748.364800 214748.364700 FORMAT "%13.6" /end CHARACTERISTIC
/begin CHARACTERISTIC ACComp_facTqPSnsrCtrlVal_C "Coefficient for calculating torque at Pressure sensor control value" VALUE 0x805062E4 RB_Val_Ws32 429496.729500 Fact_10000 -214748.364800 214748.364700 FORMAT "%13.6" /end CHARACTERISTIC
/begin CHARACTERISTIC ACCOMP_FALSE "FALSE value" VALUE 0x805062E8 RB_Val_Wu8 1.00000000000 B_TRUE 0.00 1.00000000000 FORMAT "%13.11" /end CHARACTERISTIC
/begin CHARACTERISTIC ACComp_flgSwtACCmprSeln_C "AC compressor selection switch" VALUE 0x805062E9 RB_Val_Wu8 1.00000000000 B_TRUE 0.00 1.00000000000 FORMAT "%13.11" /end CHARACTERISTIC
/begin CHARACTERISTIC ACComp_iMaxACCmpr_C "Calibration for Maximum AC compressor current" VALUE 0x805062EA RB_Val_Wu16 65535.00 i_q1_mA 0.00 65535.00 FORMAT "%8.2" /end CHARACTERISTIC
/begin CHARACTERISTIC ACComp_mMinCooltFlowQnty_T "Table for Minimum refrigerant flow quantity" CURVE 0x805062EC RB_Curve_S16_S16 655.3500 O2MassPerTime -327.6800 327.6700 FORMAT "%8.4"
 /begin AXIS_DESCR STD_AXIS ACComp_tActOutdT Temp_Cels 5 -3549.940 3003.560 FORMAT "%8.3" DEPOSIT ABSOLUTE /end AXIS_DESCR
/end CHARACTERISTIC
/begin CHARACTERISTIC ACComp_nOutdTCalcnPrmsSpd_C "Outside temperature calculation permission enable value" VALUE 0x80506302 RB_Val_Ws16 32767.50 EngN -16384.00 16383.50 FORMAT "%8.2" /end CHARACTERISTIC
/begin CHARACTERISTIC ACCOMP_PCOEFF "AC compressor pressure coefficient" VALUE 0x80506304 RB_Val_Wu16 65535.00 OneToOne 0.00 65535.00 FORMAT "%8.2" READ_ONLY /end CHARACTERISTIC
/begin CHARACTERISTIC ACComp_pCurrCorrnCtrlVal_C "Correction term of AC control value current chatacteristic" VALUE 0x80506308 RB_Val_Ws32 429496.729500 RBPtCel_p_0p0001_2 -214748.364800 214748.364700 FORMAT "%13.6" /end CHARACTERISTIC
/begin CHARACTERISTIC ACComp_rFan2_C "Coefficient value of Fan 2." VALUE 0x8050630C RB_Val_Ws16 799.9878 Prc -400.0000 399.9878 FORMAT "%8.4" /end CHARACTERISTIC
/begin CHARACTERISTIC ACComp_rFanHi_C "Higher Fan Threshold" VALUE 0x8050630E RB_Val_Ws16 799.9878 Prc -400.0000 399.9878 FORMAT "%8.4" /end CHARACTERISTIC
/begin CHARACTERISTIC ACComp_rFanLo_C "Lower Fan Threshold" VALUE 0x80506310 RB_Val_Ws16 799.9878 Prc -400.0000 399.9878 FORMAT "%8.4" /end CHARACTERISTIC
/begin CHARACTERISTIC ACComp_rFan_C "Coefficient value of Fan." VALUE 0x80506312 RB_Val_Ws16 799.9878 Prc -400.0000 399.9878 FORMAT "%8.4" /end CHARACTERISTIC
/begin CHARACTERISTIC ACComp_swtCmprExtInpTest_C "TEST switch for AC compressor torque external input" VALUE 0x80506314 RB_Val_Wu8 1.00000000000 B_TRUE 0.00 1.00000000000 FORMAT "%13.11" /end CHARACTERISTIC
/begin CHARACTERISTIC ACComp_swtComMsgSeln_C "Switch to select the Com message" VALUE 0x80506315 RB_Val_Wu8 255.0 OneToOne 0.00 255.0 FORMAT "%5.1" /end CHARACTERISTIC
/begin CHARACTERISTIC ACComp_swtLdCAN_C "switch AC torque via CAN" VALUE 0x80506316 RB_Val_Ws8 1.00000000000 B_TRUE 0.00 1.00000000000 FORMAT "%13.11" /end CHARACTERISTIC
/begin CHARACTERISTIC ACComp_swtLd_C "Codeword: Hard / soft load switch on of AC compressor" VALUE 0x80506317 RB_Val_Wu8 1.00000000000 B_TRUE 0.00 1.00000000000 FORMAT "%13.11" /end CHARACTERISTIC
/begin CHARACTERISTIC ACComp_swtStrtUpJdgCondByp_C "Bypass condition of Static torque calculation for Start Up Judgment" VALUE 0x80506318 RB_Val_Wu8 1.00000000000 B_TRUE 0.00 1.00000000000 FORMAT "%13.11" /end CHARACTERISTIC
/begin CHARACTERISTIC ACComp_swtTrqOffsBhv_C "Selecatable conditions for torque offset functionality" VALUE 0x80506319 RB_Val_Wu8 255.0 OneToOne 0.00 255.0 FORMAT "%5.1" /end CHARACTERISTIC
/begin CHARACTERISTIC ACComp_swtTSel_C "Switch to select different temparatures" VALUE 0x8050631A RB_Val_Wu8 255.0 OneToOne 0.00 255.0 FORMAT "%5.1" /end CHARACTERISTIC
/begin CHARACTERISTIC ACComp_swtVehVCondByp_C "Bypass vehicle speed condition of Static torque calculation for Start Up Judgment" VALUE 0x8050631B RB_Val_Wu8 1.00000000000 B_TRUE 0.00 1.00000000000 FORMAT "%13.11" /end CHARACTERISTIC
/begin CHARACTERISTIC ACComp_tCmprEnthIdealAdbt_M "Map for calculating compressor enthalpy at AC ideal adiabatic" MAP 0x8050631C RB_Map_S16S16_S16 655.3500 RBPtCel_t_0p01_2 -327.6800 327.6700 FORMAT "%8.4"
 /begin AXIS_DESCR STD_AXIS ACComp_pClntCtrlVal RBPtCel_p_1p0_3 9 -32768.00 32767.00 FORMAT "%8.2" DEPOSIT ABSOLUTE /end AXIS_DESCR
 /begin AXIS_DESCR STD_AXIS ACComp_pLoPVal RBPtCel_p_1p0_3 9 -32768.00 32767.00 FORMAT "%8.2" DEPOSIT ABSOLUTE /end AXIS_DESCR
/end CHARACTERISTIC
/begin CHARACTERISTIC ACComp_tCooltSatnT_T "AC coolant saturation temperature table" CURVE 0x805063E6 RB_Curve_S16_S16 6553.500 Temp_Cels -3549.940 3003.560 FORMAT "%8.3"
 /begin AXIS_DESCR STD_AXIS ACComp_pClntCtrlVal RBPtCel_p_1p0_3 9 -32768.00 32767.00 FORMAT "%8.2" DEPOSIT ABSOLUTE /end AXIS_DESCR
/end CHARACTERISTIC
/begin CHARACTERISTIC ACComp_tiACOffTimeInit_C "Init calibration for AC off time" VALUE 0x8050640C RB_Val_Ws16 1310.700 t_q0p02 -655.3600 655.3400 FORMAT "%8.4" /end CHARACTERISTIC
/begin CHARACTERISTIC ACComp_tiCmprStrtPClnt_T "AC variable capacity COMPR start time table" CURVE 0x8050640E RB_Curve_S16_S16 655350.0 Time_ms -327680.0 327670.0 FORMAT "%8.1"
 /begin AXIS_DESCR STD_AXIS AirC_pClnt PresAC_hPa 5 -65536.00 65534.00 FORMAT "%8.2" DEPOSIT ABSOLUTE /end AXIS_DESCR
/end CHARACTERISTIC
/begin CHARACTERISTIC ACComp_tiOnDlyT1DP_M "Map to determine Ramp up time depending on AC evaporator temparature and difference in pressure" MAP 0x80506424 RB_Map_S16S16_S16 1310.700 t_q0p02 -655.3600 655.3400 FORMAT "%8.4"
 /begin AXIS_DESCR STD_AXIS ACEvpT_t Temp_Cels 7 -3549.940 3003.560 FORMAT "%8.3" DEPOSIT ABSOLUTE /end AXIS_DESCR
 /begin AXIS_DESCR STD_AXIS ACComp_pACClntpDiff_MP PresAC_hPa 7 -65536.00 65534.00 FORMAT "%8.2" DEPOSIT ABSOLUTE /end AXIS_DESCR
/end CHARACTERISTIC
/begin CHARACTERISTIC ACComp_tiOnDlyT1Ti_M "Map to determine Ramp up time depending on AC evaporator temparature and AC off time" MAP 0x805064A6 RB_Map_S16S16_S16 1310.700 t_q0p02 -655.3600 655.3400 FORMAT "%8.4"
 /begin AXIS_DESCR STD_AXIS ACEvpT_t Temp_Cels 7 -3549.940 3003.560 FORMAT "%8.3" DEPOSIT ABSOLUTE /end AXIS_DESCR
 /begin AXIS_DESCR STD_AXIS ACComp_tiACOffTime t_q0p02 7 -655.3600 655.3400 FORMAT "%8.4" DEPOSIT ABSOLUTE /end AXIS_DESCR
/end CHARACTERISTIC
/begin CHARACTERISTIC ACComp_tiOnDlyT2DP_M "Map to determine Ramp down time depending on AC evaporator temparature and difference in pressure" MAP 0x80506528 RB_Map_S16S16_S16 1310.700 t_q0p02 -655.3600 655.3400 FORMAT "%8.4"
 /begin AXIS_DESCR STD_AXIS ACEvpT_t Temp_Cels 7 -3549.940 3003.560 FORMAT "%8.3" DEPOSIT ABSOLUTE /end AXIS_DESCR
 /begin AXIS_DESCR STD_AXIS ACComp_pACClntpDiff_MP PresAC_hPa 7 -65536.00 65534.00 FORMAT "%8.2" DEPOSIT ABSOLUTE /end AXIS_DESCR
/end CHARACTERISTIC
/begin CHARACTERISTIC ACComp_tiOnDlyT2Ti_M "Map to determine Ramp down time depending on AC evaporator temparature and AC off time" MAP 0x805065AA RB_Map_S16S16_S16 1310.700 t_q0p02 -655.3600 655.3400 FORMAT "%8.4"
 /begin AXIS_DESCR STD_AXIS ACEvpT_t Temp_Cels 7 -3549.940 3003.560 FORMAT "%8.3" DEPOSIT ABSOLUTE /end AXIS_DESCR
 /begin AXIS_DESCR STD_AXIS ACComp_tiACOffTime t_q0p02 7 -655.3600 655.3400 FORMAT "%8.4" DEPOSIT ABSOLUTE /end AXIS_DESCR
/end CHARACTERISTIC
/begin CHARACTERISTIC ACComp_tiOnDlyT3Ti_M "Map to determine Ramp up time depending on AC evaporator temparature and AC off time" MAP 0x8050662C RB_Map_S16S16_S16 1310.700 t_q0p02 -655.3600 655.3400 FORMAT "%8.4"
 /begin AXIS_DESCR STD_AXIS ACEvpT_t Temp_Cels 7 -3549.940 3003.560 FORMAT "%8.3" DEPOSIT ABSOLUTE /end AXIS_DESCR
 /begin AXIS_DESCR STD_AXIS ACComp_tiACOffTime t_q0p02 7 -655.3600 655.3400 FORMAT "%8.4" DEPOSIT ABSOLUTE /end AXIS_DESCR
/end CHARACTERISTIC
/begin CHARACTERISTIC ACComp_tiOnDlyT4Ti_M "Map to determine Ramp up time depending on AC evaporator temparature and AC off time" MAP 0x805066AE RB_Map_S16S16_S16 1310.700 t_q0p02 -655.3600 655.3400 FORMAT "%8.4"
 /begin AXIS_DESCR STD_AXIS ACEvpT_t Temp_Cels 7 -3549.940 3003.560 FORMAT "%8.3" DEPOSIT ABSOLUTE /end AXIS_DESCR
 /begin AXIS_DESCR STD_AXIS ACComp_tiACOffTime t_q0p02 7 -655.3600 655.3400 FORMAT "%8.4" DEPOSIT ABSOLUTE /end AXIS_DESCR
/end CHARACTERISTIC
/begin CHARACTERISTIC ACComp_tiOutdTCalcnPrms_C "Coefficient for outside temperature calculation permission" VALUE 0x80506730 RB_Val_Ws16 655.3500 t_q0p01 -327.6800 327.6700 FORMAT "%8.4" /end CHARACTERISTIC
/begin CHARACTERISTIC ACComp_tiTCalcnPrepnPrms_C "Coefficient for outside temperature calculation preperation permission" VALUE 0x80506732 RB_Val_Ws16 6553.500 t_q0p1 -3276.800 3276.700 FORMAT "%8.3" /end CHARACTERISTIC
/begin CHARACTERISTIC ACComp_tiTrqDes_C "Turn Off Delay Time for Filtering AC reserve Torque when shutting of AC compressor" VALUE 0x80506734 RB_Val_Ws32 42949672.9500 Time_s -21474836.4800 21474836.4700 FORMAT "%13.4" /end CHARACTERISTIC
/begin CHARACTERISTIC ACComp_tiTrqDyn_C "filter time for desired torque" VALUE 0x80506738 RB_Val_Wu32 4294.9672949999995 TimeDelay_s 0.0000010000000 4294.9672959999998 FORMAT "%19.14" /end CHARACTERISTIC
/begin CHARACTERISTIC ACComp_tiTrqOffRmpDwnone_C "accomp_time trouqeoffs ramp down one" VALUE 0x8050673C RB_Val_Ws32 4294.9672940000000 TimeDelay_s 0.0000020000000 4294.9672959999998 FORMAT "%19.14" EXTENDED_LIMITS 0.000002000000001 4294.9672959999998 /end CHARACTERISTIC
/begin CHARACTERISTIC ACComp_tiTrqOffsRmpDwn_C "filter time constant for downward ramping" VALUE 0x80506740 RB_Val_Ws32 4294.9672940000000 TimeDelay_s 0.0000020000000 4294.9672959999998 FORMAT "%19.14" EXTENDED_LIMITS 0.000002000000001 4294.9672959999998 /end CHARACTERISTIC
/begin CHARACTERISTIC ACComp_tiTrqOffsRmpUpone_C "accomp_time trouqe offs ramp up one" VALUE 0x80506744 RB_Val_Ws32 4294.9672940000000 TimeDelay_s 0.0000020000000 4294.9672959999998 FORMAT "%19.14" EXTENDED_LIMITS 0.000002000000001 4294.9672959999998 /end CHARACTERISTIC
/begin CHARACTERISTIC ACComp_tiTrqOffsRmpUp_C "filter time constant for UPward ramping" VALUE 0x80506748 RB_Val_Ws32 4294.9672940000000 TimeDelay_s 0.0000020000000 4294.9672959999998 FORMAT "%19.14" EXTENDED_LIMITS 0.000002000000001 4294.9672959999998 /end CHARACTERISTIC
/begin CHARACTERISTIC ACComp_tiTrqResv_C "time for torque reserve active at soft AC load switch" VALUE 0x8050674C RB_Val_Ws32 42949672.9500 Time_s -21474836.4800 21474836.4700 FORMAT "%13.4" /end CHARACTERISTIC
/begin CHARACTERISTIC ACComp_tOutAirLoThd_C "Low threshold for outside air temperature" VALUE 0x80506750 RB_Val_Ws16 6553.500 Temp_Cels -3549.940 3003.560 FORMAT "%8.3" /end CHARACTERISTIC
/begin CHARACTERISTIC ACComp_tOutAirThres_C "Threshold Outside air temparature above which replacement value is used" VALUE 0x80506752 RB_Val_Ws16 6553.500 Temp_Cels -3549.940 3003.560 FORMAT "%8.3" /end CHARACTERISTIC
/begin CHARACTERISTIC ACComp_tqACOffs1_M "accomp trouqe a coffs" MAP 0x80506754 RB_Map_S16S16_S16 6553.500 Trq -3276.800 3276.700 FORMAT "%8.3"
 /begin AXIS_DESCR STD_AXIS AirC_pClnt PresAC_hPa 7 -65536.00 65534.00 FORMAT "%8.2" DEPOSIT ABSOLUTE /end AXIS_DESCR
 /begin AXIS_DESCR STD_AXIS ACComp_tSeldTrqOffs Temp_Cels 7 -3549.940 3003.560 FORMAT "%8.3" DEPOSIT ABSOLUTE /end AXIS_DESCR
/end CHARACTERISTIC
/begin CHARACTERISTIC ACComp_tqACOffs_M "Map to determine offset torque" MAP 0x805067D6 RB_Map_S16S16_S16 6553.500 Trq -3276.800 3276.700 FORMAT "%8.3"
 /begin AXIS_DESCR STD_AXIS AirC_pClnt PresAC_hPa 7 -65536.00 65534.00 FORMAT "%8.2" DEPOSIT ABSOLUTE /end AXIS_DESCR
 /begin AXIS_DESCR STD_AXIS ACComp_tSeldTrqOffs Temp_Cels 7 -3549.940 3003.560 FORMAT "%8.3" DEPOSIT ABSOLUTE /end AXIS_DESCR
/end CHARACTERISTIC
/begin CHARACTERISTIC ACComp_tqCorrnMax_C "Torque calculation correction term at Ps control valve (at MAX capacity)" VALUE 0x80506858 RB_Val_Ws32 429496729.500 Trq -214748364.800 214748364.700 FORMAT "%13.3" /end CHARACTERISTIC
/begin CHARACTERISTIC ACComp_tqEstimd1TqStrt_T "AC variable capacity COMPR start time table" CURVE 0x8050685C RB_Curve_S16_S16 6553.500 Trq -3276.800 3276.700 FORMAT "%8.3"
 /begin AXIS_DESCR STD_AXIS ACComp_tiCmprVolCtrlStrt Time_ms 5 -327680.0 327670.0 FORMAT "%8.1" DEPOSIT ABSOLUTE /end AXIS_DESCR
/end CHARACTERISTIC
/begin CHARACTERISTIC ACComp_tqEstimd2TqStrt_T "AC variable capacity COMPR torque estimated value table at startup" CURVE 0x80506872 RB_Curve_S16_S16 6553.500 Trq -3276.800 3276.700 FORMAT "%8.3"
 /begin AXIS_DESCR STD_AXIS ACComp_tiCmprStrtUp1 Time_ms 5 -327680.0 327670.0 FORMAT "%8.1" DEPOSIT ABSOLUTE /end AXIS_DESCR
/end CHARACTERISTIC
/begin CHARACTERISTIC ACComp_tqEvaprTCorrnTq_C "EVA temperature torque calculation correction term in Ps control valve" VALUE 0x80506888 RB_Val_Ws32 429496729.500 Trq -214748364.800 214748364.700 FORMAT "%13.3" /end CHARACTERISTIC
/begin CHARACTERISTIC ACComp_tqHardDwnStep_C "AC off hard torque reserve reduce" VALUE 0x8050688C RB_Val_Ws16 6553.500 Trq -3276.800 3276.700 FORMAT "%8.3" /end CHARACTERISTIC
/begin CHARACTERISTIC ACComp_tqHwGearOffResv_M "AC HW off torque reserve Map in driving state" MAP 0x8050688E RB_Map_S16S16_S16 6553.500 Trq -3276.800 3276.700 FORMAT "%8.3"
 /begin AXIS_DESCR STD_AXIS Epm_nEng EngN 6 -16384.00 16383.50 FORMAT "%8.2" DEPOSIT ABSOLUTE /end AXIS_DESCR
 /begin AXIS_DESCR STD_AXIS NO_INPUT_QUANTITY rel_uw_b200 4 0.00 99.99695 FORMAT "%8.5" EXTENDED_LIMITS -100.0000 99.99695 DEPOSIT ABSOLUTE /end AXIS_DESCR
/end CHARACTERISTIC
/begin CHARACTERISTIC ACComp_tqHwOffResv_M "AC HW off torque reserve Map" MAP 0x805068D6 RB_Map_S16S16_S16 6553.500 Trq -3276.800 3276.700 FORMAT "%8.3"
 /begin AXIS_DESCR STD_AXIS Epm_nEng EngN 6 -16384.00 16383.50 FORMAT "%8.2" DEPOSIT ABSOLUTE /end AXIS_DESCR
 /begin AXIS_DESCR STD_AXIS NO_INPUT_QUANTITY rel_uw_b200 4 0.00 99.99695 FORMAT "%8.5" EXTENDED_LIMITS -100.0000 99.99695 DEPOSIT ABSOLUTE /end AXIS_DESCR
/end CHARACTERISTIC
/begin CHARACTERISTIC ACComp_tqPSnsrCorrnTq_C "Correstion term for calculating torque estimated by Ps control value" VALUE 0x80506920 RB_Val_Ws32 429496.729500 RBPtCel_tq_0p0001_1 -214748.364800 214748.364700 FORMAT "%13.6" /end CHARACTERISTIC
/begin CHARACTERISTIC ACComp_tqSwOffResv_M "AC Off torque reserve map" MAP 0x80506924 RB_Map_S16S16_S16 6553.500 Trq -3276.800 3276.700 FORMAT "%8.3"
 /begin AXIS_DESCR STD_AXIS Epm_nEng EngN 6 -16384.00 16383.50 FORMAT "%8.2" DEPOSIT ABSOLUTE /end AXIS_DESCR
 /begin AXIS_DESCR STD_AXIS AirC_pClnt PresAC_hPa 4 -65536.00 65534.00 FORMAT "%8.2" DEPOSIT ABSOLUTE /end AXIS_DESCR
/end CHARACTERISTIC
/begin CHARACTERISTIC ACComp_trqDyn_MAP "dynamic torque" MAP 0x8050696C RB_Map_S16S16_S16 6553.500 Trq -3276.800 3276.700 FORMAT "%8.3"
 /begin AXIS_DESCR STD_AXIS Epm_nEng EngN 8 -16384.00 16383.50 FORMAT "%8.2" DEPOSIT ABSOLUTE /end AXIS_DESCR
 /begin AXIS_DESCR STD_AXIS AirC_pClnt PresAC_hPa 8 -65536.00 65534.00 FORMAT "%8.2" DEPOSIT ABSOLUTE /end AXIS_DESCR
/end CHARACTERISTIC
/begin CHARACTERISTIC ACComp_trqLimMax_MAP "Limit maximum AC torque value" MAP 0x80506A10 RB_Map_S16S16_S16 6553.500 Trq -3276.800 3276.700 FORMAT "%8.3"
 /begin AXIS_DESCR STD_AXIS Epm_nEng EngN 4 -16384.00 16383.50 FORMAT "%8.2" DEPOSIT ABSOLUTE /end AXIS_DESCR
 /begin AXIS_DESCR STD_AXIS AirC_pClnt PresAC_hPa 4 -65536.00 65534.00 FORMAT "%8.2" DEPOSIT ABSOLUTE /end AXIS_DESCR
/end CHARACTERISTIC
/begin CHARACTERISTIC ACComp_trqOffsFlt_C "offset for start value for filter" VALUE 0x80506A44 RB_Val_Ws16 6553.500 Trq -3276.800 3276.700 FORMAT "%8.3" /end CHARACTERISTIC
/begin CHARACTERISTIC ACComp_trqStat_MAP "static torque" MAP 0x80506A46 RB_Map_S16S16_S16 6553.500 Trq -3276.800 3276.700 FORMAT "%8.3"
 /begin AXIS_DESCR STD_AXIS Epm_nEng EngN 8 -16384.00 16383.50 FORMAT "%8.2" DEPOSIT ABSOLUTE /end AXIS_DESCR
 /begin AXIS_DESCR STD_AXIS AirC_pClnt PresAC_hPa 8 -65536.00 65534.00 FORMAT "%8.2" DEPOSIT ABSOLUTE /end AXIS_DESCR
/end CHARACTERISTIC
/begin CHARACTERISTIC ACComp_tTCalcnRednVal_C "Outside temperature calculation reduction value" VALUE 0x80506AEA RB_Val_Ws16 6553.500 Temp_Cels -3549.940 3003.560 FORMAT "%8.3" /end CHARACTERISTIC
/begin CHARACTERISTIC ACComp_tTCalcnRiseVal_C "Outside temperature calculation raise value" VALUE 0x80506AEC RB_Val_Ws16 6553.500 Temp_Cels -3549.940 3003.560 FORMAT "%8.3" /end CHARACTERISTIC
/begin CHARACTERISTIC ACComp_tValDurgSnsrFailr_C "Alternative value at the time of outside temperature sensor failure." VALUE 0x80506AEE RB_Val_Ws16 6553.500 Temp_Cels -3549.940 3003.560 FORMAT "%8.3" /end CHARACTERISTIC
/begin CHARACTERISTIC ACComp_tWtrTOutdTSnsr_C "Water temperature for outside temperature sensor judgment at the time of IGON." VALUE 0x80506AF0 RB_Val_Ws16 6553.500 Temp_Cels -3549.940 3003.560 FORMAT "%8.3" /end CHARACTERISTIC
/begin CHARACTERISTIC ACComp_vOutdTCtrlStrtPrms_C "Vehicle speed for ECONTAM control start permission" VALUE 0x80506AF2 RB_Val_Ws16 655.3500 Vel -327.6800 327.6700 FORMAT "%8.4" /end CHARACTERISTIC
/begin CHARACTERISTIC ACComp_vTqOffsRmpDelta_C "calibrateable delta for vehicle speed hysteresis" VALUE 0x80506AF4 RB_Val_Ws16 655.3500 Vel -327.6800 327.6700 FORMAT "%8.4" /end CHARACTERISTIC
/begin CHARACTERISTIC ACComp_vTqOffsRmp_C "calibrateable median for vehicle speed hysteresis" VALUE 0x80506AF6 RB_Val_Ws16 655.3500 Vel -327.6800 327.6700 FORMAT "%8.4" /end CHARACTERISTIC
/begin CHARACTERISTIC ACComp_vVehSpdChgOutdT_C "Vehicle speed for change outside temperature" VALUE 0x80506AF8 RB_Val_Ws16 655.3500 Vel -327.6800 327.6700 FORMAT "%8.4" /end CHARACTERISTIC
/begin CHARACTERISTIC AccPed_flgNotSwilLossCmp_C "Activate the compensation of non switchable losses" VALUE 0x8050EB70 RB_Val_Wboolean 1.00000000000 B_TRUE 0.00 1.00000000000 FORMAT "%13.11" /end CHARACTERISTIC
/begin CHARACTERISTIC AccPed_flgSelFacCmpAcs_C "Flag used to consider compensation from speed governor also for non-switchable losses." VALUE 0x8050EB71 RB_Val_Wboolean 1.00000000000 B_TRUE 0.00 1.00000000000 FORMAT "%13.11" /end CHARACTERISTIC
/begin CHARACTERISTIC AccPed_nMax_C "Maximum engine speed in case of accelerator pedal error" VALUE 0x8050EB64 RB_Val_Ws16 32767.50 EngN -16384.00 16383.50 FORMAT "%8.2" /end CHARACTERISTIC
/begin CHARACTERISTIC AccPed_nMinBrkApp_C "Minimum engine speed in case of accelerator pedal brake implausibility" VALUE 0x8050EB66 RB_Val_Ws16 32767.50 EngN -16384.00 16383.50 FORMAT "%8.2" /end CHARACTERISTIC
/begin CHARACTERISTIC AccPed_nMinBrk_C "Minimum engine speed in case of accelerator pedal error and trodden brake" VALUE 0x8050EB68 RB_Val_Ws16 32767.50 EngN -16384.00 16383.50 FORMAT "%8.2" /end CHARACTERISTIC
/begin CHARACTERISTIC AccPed_nMinNoBrk_C "Minimum engine speed in case of accelerator pedal error and brake not applied" VALUE 0x8050EB6A RB_Val_Ws16 32767.50 EngN -16384.00 16383.50 FORMAT "%8.2" /end CHARACTERISTIC
/begin CHARACTERISTIC AccPed_rAPPHysHi_C "upper hysteresis threshold for accelerator pedal debouncing" VALUE 0x8050EB72 RB_Val_Ws16 399.9756 Prc 0.0122 399.9878 FORMAT "%8.4" EXTENDED_LIMITS -400.0000 399.9878 /end CHARACTERISTIC
/begin CHARACTERISTIC AccPed_rAPPHysLo_C "lower hysteresis threshold for accelerator pedal debouncing" VALUE 0x8050EB74 RB_Val_Ws16 399.9756 Prc 0.0122 399.9878 FORMAT "%8.4" EXTENDED_LIMITS -400.0000 399.9878 /end CHARACTERISTIC
/begin CHARACTERISTIC AccPed_rThdMaxCmp_C "used for calculating the overrun transition factor." VALUE 0x8050EB76 RB_Val_Ws16 799.9878 Prc -400.0000 399.9878 FORMAT "%8.4" /end CHARACTERISTIC
/begin CHARACTERISTIC AccPed_rThdNoCmp_C "With this calibration lable it is possible to set the minimum threshold value for compenstion" VALUE 0x8050EB78 RB_Val_Ws16 799.9878 Prc -400.0000 399.9878 FORMAT "%8.4" /end CHARACTERISTIC
/begin CHARACTERISTIC AccPed_swtDrvModSeln_C "Drive mode selection switch" VALUE 0x8050EB84 RB_Val_Wboolean 1.00000000000 B_TRUE 0.00 1.00000000000 FORMAT "%13.11" /end CHARACTERISTIC
/begin CHARACTERISTIC AccPed_swtFilActvn_C "Switch to active PT1 filter" VALUE 0x8050EB85 RB_Val_Wboolean 1.00000000000 B_TRUE 0.00 1.00000000000 FORMAT "%13.11" /end CHARACTERISTIC
/begin CHARACTERISTIC AccPed_tiGearFildFil_CA "Filter time constant, gear depending" VAL_BLK 0x8050EB88 RB_ValA_Ws32 4294.9672940000000 TimeDelay_s 0.0000020000000 4294.9672959999998 FORMAT "%19.14" EXTENDED_LIMITS 0.000002000000001 4294.9672959999998 NUMBER 11 /end CHARACTERISTIC
/begin CHARACTERISTIC AccPed_tiGearFildRmp_CA "Time in which the ramping between the drive modes shall happen, gear depending" VAL_BLK 0x8050EBB4 RB_ValA_Ws16 655.3500 Time_s -327.6800 327.6700 FORMAT "%8.4" NUMBER 11 /end CHARACTERISTIC
/begin CHARACTERISTIC AccPed_tiIDSDrvModTmpInhb_C "Threshold time to detect IDS temporary inhibit" VALUE 0x8050EB80 RB_Val_Wu16 655350.0 Time_ms 0.00 655350.0 FORMAT "%8.1" /end CHARACTERISTIC
/begin CHARACTERISTIC AccPed_tqCmftModGear1_M "Comfort mode gear1 engine demand map" MAP 0x8050EBCA RB_Map_S16S16_S16 6553.500 Trq -3276.800 3276.700 FORMAT "%8.3"
 /begin AXIS_DESCR STD_AXIS PT_nClth EngN 16 -16384.00 16383.50 FORMAT "%8.2" DEPOSIT ABSOLUTE /end AXIS_DESCR
 /begin AXIS_DESCR STD_AXIS APP_r Prc 16 -400.0000 399.9878 FORMAT "%8.4" DEPOSIT ABSOLUTE /end AXIS_DESCR
/end CHARACTERISTIC
/begin CHARACTERISTIC AccPed_tqCmftModGear2_M "Comfort mode gear2 engine demand map" MAP 0x8050EE0E RB_Map_S16S16_S16 6553.500 Trq -3276.800 3276.700 FORMAT "%8.3"
 /begin AXIS_DESCR STD_AXIS PT_nClth EngN 16 -16384.00 16383.50 FORMAT "%8.2" DEPOSIT ABSOLUTE /end AXIS_DESCR
 /begin AXIS_DESCR STD_AXIS APP_r Prc 16 -400.0000 399.9878 FORMAT "%8.4" DEPOSIT ABSOLUTE /end AXIS_DESCR
/end CHARACTERISTIC
/begin CHARACTERISTIC AccPed_tqCmftModGear3_M "Comfort mode gear3 engine demand map" MAP 0x8050F052 RB_Map_S16S16_S16 6553.500 Trq -3276.800 3276.700 FORMAT "%8.3"
 /begin AXIS_DESCR STD_AXIS PT_nClth EngN 16 -16384.00 16383.50 FORMAT "%8.2" DEPOSIT ABSOLUTE /end AXIS_DESCR
 /begin AXIS_DESCR STD_AXIS APP_r Prc 16 -400.0000 399.9878 FORMAT "%8.4" DEPOSIT ABSOLUTE /end AXIS_DESCR
/end CHARACTERISTIC
/begin CHARACTERISTIC AccPed_tqCmftModGear4_M "Comfort mode gear4 engine demand map" MAP 0x8050F296 RB_Map_S16S16_S16 6553.500 Trq -3276.800 3276.700 FORMAT "%8.3"
 /begin AXIS_DESCR STD_AXIS PT_nClth EngN 16 -16384.00 16383.50 FORMAT "%8.2" DEPOSIT ABSOLUTE /end AXIS_DESCR
 /begin AXIS_DESCR STD_AXIS APP_r Prc 16 -400.0000 399.9878 FORMAT "%8.4" DEPOSIT ABSOLUTE /end AXIS_DESCR
/end CHARACTERISTIC
/begin CHARACTERISTIC AccPed_tqCmftModGear5_M "Comfort mode gear5 engine demand map" MAP 0x8050F4DA RB_Map_S16S16_S16 6553.500 Trq -3276.800 3276.700 FORMAT "%8.3"
 /begin AXIS_DESCR STD_AXIS PT_nClth EngN 16 -16384.00 16383.50 FORMAT "%8.2" DEPOSIT ABSOLUTE /end AXIS_DESCR
 /begin AXIS_DESCR STD_AXIS APP_r Prc 16 -400.0000 399.9878 FORMAT "%8.4" DEPOSIT ABSOLUTE /end AXIS_DESCR
/end CHARACTERISTIC
/begin CHARACTERISTIC AccPed_tqCmftModGear6_M "Comfort mode gear6 engine demand map" MAP 0x8050F71E RB_Map_S16S16_S16 6553.500 Trq -3276.800 3276.700 FORMAT "%8.3"
 /begin AXIS_DESCR STD_AXIS PT_nClth EngN 16 -16384.00 16383.50 FORMAT "%8.2" DEPOSIT ABSOLUTE /end AXIS_DESCR
 /begin AXIS_DESCR STD_AXIS APP_r Prc 16 -400.0000 399.9878 FORMAT "%8.4" DEPOSIT ABSOLUTE /end AXIS_DESCR
/end CHARACTERISTIC
/begin CHARACTERISTIC AccPed_tqCmftModGear7_M "Comfort mode gear7 engine demand map" MAP 0x8050F962 RB_Map_S16S16_S16 6553.500 Trq -3276.800 3276.700 FORMAT "%8.3"
 /begin AXIS_DESCR STD_AXIS PT_nClth EngN 16 -16384.00 16383.50 FORMAT "%8.2" DEPOSIT ABSOLUTE /end AXIS_DESCR
 /begin AXIS_DESCR STD_AXIS APP_r Prc 16 -400.0000 399.9878 FORMAT "%8.4" DEPOSIT ABSOLUTE /end AXIS_DESCR
/end CHARACTERISTIC
/begin CHARACTERISTIC AccPed_tqCmftModGear8_M "Comfort mode gear8 engine demand map" MAP 0x8050FBA6 RB_Map_S16S16_S16 6553.500 Trq -3276.800 3276.700 FORMAT "%8.3"
 /begin AXIS_DESCR STD_AXIS PT_nClth EngN 16 -16384.00 16383.50 FORMAT "%8.2" DEPOSIT ABSOLUTE /end AXIS_DESCR
 /begin AXIS_DESCR STD_AXIS APP_r Prc 16 -400.0000 399.9878 FORMAT "%8.4" DEPOSIT ABSOLUTE /end AXIS_DESCR
/end CHARACTERISTIC
/begin CHARACTERISTIC AccPed_tqCmftModGear9_M "Comfort mode gear9 engine demand map" MAP 0x8050FDEA RB_Map_S16S16_S16 6553.500 Trq -3276.800 3276.700 FORMAT "%8.3"
 /begin AXIS_DESCR STD_AXIS PT_nClth EngN 16 -16384.00 16383.50 FORMAT "%8.2" DEPOSIT ABSOLUTE /end AXIS_DESCR
 /begin AXIS_DESCR STD_AXIS APP_r Prc 16 -400.0000 399.9878 FORMAT "%8.4" DEPOSIT ABSOLUTE /end AXIS_DESCR
/end CHARACTERISTIC
/begin CHARACTERISTIC AccPed_tqCvtEcoEng0_M "Driver demanded torque map for drive off torque for Eco mode of CVT transmission" MAP 0x8051002E RB_Map_S16S16_S16 6553.500 Trq -3276.800 3276.700 FORMAT "%8.3"
 /begin AXIS_DESCR STD_AXIS PT_nClth EngN 16 -16384.00 16383.50 FORMAT "%8.2" DEPOSIT ABSOLUTE /end AXIS_DESCR
 /begin AXIS_DESCR STD_AXIS APP_r Prc 16 -400.0000 399.9878 FORMAT "%8.4" DEPOSIT ABSOLUTE /end AXIS_DESCR
/end CHARACTERISTIC
/begin CHARACTERISTIC AccPed_tqCvtEcoEng1_M "Driver demanded torque map for gear1 for Eco mode of CVT transmission" MAP 0x80510272 RB_Map_S16S16_S16 6553.500 Trq -3276.800 3276.700 FORMAT "%8.3"
 /begin AXIS_DESCR STD_AXIS PT_nClth EngN 16 -16384.00 16383.50 FORMAT "%8.2" DEPOSIT ABSOLUTE /end AXIS_DESCR
 /begin AXIS_DESCR STD_AXIS APP_r Prc 16 -400.0000 399.9878 FORMAT "%8.4" DEPOSIT ABSOLUTE /end AXIS_DESCR
/end CHARACTERISTIC
/begin CHARACTERISTIC AccPed_tqCvtEcoEng2_M "Driver demanded torque map for gear2 for Eco mode of CVT transmission" MAP 0x805104B6 RB_Map_S16S16_S16 6553.500 Trq -3276.800 3276.700 FORMAT "%8.3"
 /begin AXIS_DESCR STD_AXIS PT_nClth EngN 16 -16384.00 16383.50 FORMAT "%8.2" DEPOSIT ABSOLUTE /end AXIS_DESCR
 /begin AXIS_DESCR STD_AXIS APP_r Prc 16 -400.0000 399.9878 FORMAT "%8.4" DEPOSIT ABSOLUTE /end AXIS_DESCR
/end CHARACTERISTIC
/begin CHARACTERISTIC AccPed_tqCvtEcoEng3_M "Driver demanded torque map for gear3 for Eco mode of CVT transmission" MAP 0x805106FA RB_Map_S16S16_S16 6553.500 Trq -3276.800 3276.700 FORMAT "%8.3"
 /begin AXIS_DESCR STD_AXIS PT_nClth EngN 16 -16384.00 16383.50 FORMAT "%8.2" DEPOSIT ABSOLUTE /end AXIS_DESCR
 /begin AXIS_DESCR STD_AXIS APP_r Prc 16 -400.0000 399.9878 FORMAT "%8.4" DEPOSIT ABSOLUTE /end AXIS_DESCR
/end CHARACTERISTIC
/begin CHARACTERISTIC AccPed_tqCvtEcoEng4_M "Driver demanded torque map for gear4 for Eco mode of CVT transmission" MAP 0x8051093E RB_Map_S16S16_S16 6553.500 Trq -3276.800 3276.700 FORMAT "%8.3"
 /begin AXIS_DESCR STD_AXIS PT_nClth EngN 16 -16384.00 16383.50 FORMAT "%8.2" DEPOSIT ABSOLUTE /end AXIS_DESCR
 /begin AXIS_DESCR STD_AXIS APP_r Prc 16 -400.0000 399.9878 FORMAT "%8.4" DEPOSIT ABSOLUTE /end AXIS_DESCR
/end CHARACTERISTIC
/begin CHARACTERISTIC AccPed_tqCvtEcoEng5_M "Driver demanded torque map for gear5 for Eco mode of CVT transmission" MAP 0x80510B82 RB_Map_S16S16_S16 6553.500 Trq -3276.800 3276.700 FORMAT "%8.3"
 /begin AXIS_DESCR STD_AXIS PT_nClth EngN 16 -16384.00 16383.50 FORMAT "%8.2" DEPOSIT ABSOLUTE /end AXIS_DESCR
 /begin AXIS_DESCR STD_AXIS APP_r Prc 16 -400.0000 399.9878 FORMAT "%8.4" DEPOSIT ABSOLUTE /end AXIS_DESCR
/end CHARACTERISTIC
/begin CHARACTERISTIC AccPed_tqCvtEcoEng6_M "Driver demanded torque map for gear6 for Eco mode of CVT transmission" MAP 0x80510DC6 RB_Map_S16S16_S16 6553.500 Trq -3276.800 3276.700 FORMAT "%8.3"
 /begin AXIS_DESCR STD_AXIS PT_nClth EngN 16 -16384.00 16383.50 FORMAT "%8.2" DEPOSIT ABSOLUTE /end AXIS_DESCR
 /begin AXIS_DESCR STD_AXIS APP_r Prc 16 -400.0000 399.9878 FORMAT "%8.4" DEPOSIT ABSOLUTE /end AXIS_DESCR
/end CHARACTERISTIC
/begin CHARACTERISTIC AccPed_tqCvtEcoEng7_M "Driver demanded torque map for gear7 for Eco mode of CVT transmission" MAP 0x8051100A RB_Map_S16S16_S16 6553.500 Trq -3276.800 3276.700 FORMAT "%8.3"
 /begin AXIS_DESCR STD_AXIS PT_nClth EngN 16 -16384.00 16383.50 FORMAT "%8.2" DEPOSIT ABSOLUTE /end AXIS_DESCR
 /begin AXIS_DESCR STD_AXIS APP_r Prc 16 -400.0000 399.9878 FORMAT "%8.4" DEPOSIT ABSOLUTE /end AXIS_DESCR
/end CHARACTERISTIC
/begin CHARACTERISTIC AccPed_tqCvtEcoEng8_M "Driver demanded torque map for gear8 for Eco mode of CVT transmission" MAP 0x8051124E RB_Map_S16S16_S16 6553.500 Trq -3276.800 3276.700 FORMAT "%8.3"
 /begin AXIS_DESCR STD_AXIS PT_nClth EngN 16 -16384.00 16383.50 FORMAT "%8.2" DEPOSIT ABSOLUTE /end AXIS_DESCR
 /begin AXIS_DESCR STD_AXIS APP_r Prc 16 -400.0000 399.9878 FORMAT "%8.4" DEPOSIT ABSOLUTE /end AXIS_DESCR
/end CHARACTERISTIC
/begin CHARACTERISTIC AccPed_tqCvtEng0_M "Driver demanded torque map for gear0 for CVT transmission" MAP 0x80511492 RB_Map_S16S16_S16 6553.500 Trq -3276.800 3276.700 FORMAT "%8.3"
 /begin AXIS_DESCR STD_AXIS PT_nClth EngN 16 -16384.00 16383.50 FORMAT "%8.2" DEPOSIT ABSOLUTE /end AXIS_DESCR
 /begin AXIS_DESCR STD_AXIS APP_r Prc 16 -400.0000 399.9878 FORMAT "%8.4" DEPOSIT ABSOLUTE /end AXIS_DESCR
/end CHARACTERISTIC
/begin CHARACTERISTIC AccPed_tqCvtEng1_M "Driver demanded torque map for gear1 for CVT transmission" MAP 0x805116D6 RB_Map_S16S16_S16 6553.500 Trq -3276.800 3276.700 FORMAT "%8.3"
 /begin AXIS_DESCR STD_AXIS PT_nClth EngN 16 -16384.00 16383.50 FORMAT "%8.2" DEPOSIT ABSOLUTE /end AXIS_DESCR
 /begin AXIS_DESCR STD_AXIS APP_r Prc 16 -400.0000 399.9878 FORMAT "%8.4" DEPOSIT ABSOLUTE /end AXIS_DESCR
/end CHARACTERISTIC
/begin CHARACTERISTIC AccPed_tqCvtEng2_M "Driver demanded torque map for gear2 for CVT transmission" MAP 0x8051191A RB_Map_S16S16_S16 6553.500 Trq -3276.800 3276.700 FORMAT "%8.3"
 /begin AXIS_DESCR STD_AXIS PT_nClth EngN 16 -16384.00 16383.50 FORMAT "%8.2" DEPOSIT ABSOLUTE /end AXIS_DESCR
 /begin AXIS_DESCR STD_AXIS APP_r Prc 16 -400.0000 399.9878 FORMAT "%8.4" DEPOSIT ABSOLUTE /end AXIS_DESCR
/end CHARACTERISTIC
/begin CHARACTERISTIC AccPed_tqCvtEng3_M "Driver demanded torque map for gear3 for CVT transmission" MAP 0x80511B5E RB_Map_S16S16_S16 6553.500 Trq -3276.800 3276.700 FORMAT "%8.3"
 /begin AXIS_DESCR STD_AXIS PT_nClth EngN 16 -16384.00 16383.50 FORMAT "%8.2" DEPOSIT ABSOLUTE /end AXIS_DESCR
 /begin AXIS_DESCR STD_AXIS APP_r Prc 16 -400.0000 399.9878 FORMAT "%8.4" DEPOSIT ABSOLUTE /end AXIS_DESCR
/end CHARACTERISTIC
/begin CHARACTERISTIC AccPed_tqCvtEng4_M "Driver demanded torque map for gear4 for CVT transmission" MAP 0x80511DA2 RB_Map_S16S16_S16 6553.500 Trq -3276.800 3276.700 FORMAT "%8.3"
 /begin AXIS_DESCR STD_AXIS PT_nClth EngN 16 -16384.00 16383.50 FORMAT "%8.2" DEPOSIT ABSOLUTE /end AXIS_DESCR
 /begin AXIS_DESCR STD_AXIS APP_r Prc 16 -400.0000 399.9878 FORMAT "%8.4" DEPOSIT ABSOLUTE /end AXIS_DESCR
/end CHARACTERISTIC
/begin CHARACTERISTIC AccPed_tqCvtEng5_M "Driver demanded torque map for gear5 for CVT transmission" MAP 0x80511FE6 RB_Map_S16S16_S16 6553.500 Trq -3276.800 3276.700 FORMAT "%8.3"
 /begin AXIS_DESCR STD_AXIS PT_nClth EngN 16 -16384.00 16383.50 FORMAT "%8.2" DEPOSIT ABSOLUTE /end AXIS_DESCR
 /begin AXIS_DESCR STD_AXIS APP_r Prc 16 -400.0000 399.9878 FORMAT "%8.4" DEPOSIT ABSOLUTE /end AXIS_DESCR
/end CHARACTERISTIC
/begin CHARACTERISTIC AccPed_tqCvtEng6_M "Driver demanded torque map for gear6 for CVT transmission" MAP 0x8051222A RB_Map_S16S16_S16 6553.500 Trq -3276.800 3276.700 FORMAT "%8.3"
 /begin AXIS_DESCR STD_AXIS PT_nClth EngN 16 -16384.00 16383.50 FORMAT "%8.2" DEPOSIT ABSOLUTE /end AXIS_DESCR
 /begin AXIS_DESCR STD_AXIS APP_r Prc 16 -400.0000 399.9878 FORMAT "%8.4" DEPOSIT ABSOLUTE /end AXIS_DESCR
/end CHARACTERISTIC
/begin CHARACTERISTIC AccPed_tqCvtEng7_M "Driver demanded torque map for gear7 for CVT transmission" MAP 0x8051246E RB_Map_S16S16_S16 6553.500 Trq -3276.800 3276.700 FORMAT "%8.3"
 /begin AXIS_DESCR STD_AXIS PT_nClth EngN 16 -16384.00 16383.50 FORMAT "%8.2" DEPOSIT ABSOLUTE /end AXIS_DESCR
 /begin AXIS_DESCR STD_AXIS APP_r Prc 16 -400.0000 399.9878 FORMAT "%8.4" DEPOSIT ABSOLUTE /end AXIS_DESCR
/end CHARACTERISTIC
/begin CHARACTERISTIC AccPed_tqCvtEng8_M "Driver demanded torque map for gear8 for CVT transmission" MAP 0x805126B2 RB_Map_S16S16_S16 6553.500 Trq -3276.800 3276.700 FORMAT "%8.3"
 /begin AXIS_DESCR STD_AXIS PT_nClth EngN 16 -16384.00 16383.50 FORMAT "%8.2" DEPOSIT ABSOLUTE /end AXIS_DESCR
 /begin AXIS_DESCR STD_AXIS APP_r Prc 16 -400.0000 399.9878 FORMAT "%8.4" DEPOSIT ABSOLUTE /end AXIS_DESCR
/end CHARACTERISTIC
/begin CHARACTERISTIC AccPed_tqCvtEngRvs_M "Driver demanded torque map for reverse gear for CVT transmission" MAP 0x805128F6 RB_Map_S16S16_S16 6553.500 Trq -3276.800 3276.700 FORMAT "%8.3"
 /begin AXIS_DESCR STD_AXIS PT_nClth EngN 16 -16384.00 16383.50 FORMAT "%8.2" DEPOSIT ABSOLUTE /end AXIS_DESCR
 /begin AXIS_DESCR STD_AXIS APP_r Prc 16 -400.0000 399.9878 FORMAT "%8.4" DEPOSIT ABSOLUTE /end AXIS_DESCR
/end CHARACTERISTIC
/begin CHARACTERISTIC AccPed_tqEcoModGear1_M "Economy mode gear1 engine demand map" MAP 0x80512B3A RB_Map_S16S16_S16 6553.500 Trq -3276.800 3276.700 FORMAT "%8.3"
 /begin AXIS_DESCR STD_AXIS PT_nClth EngN 16 -16384.00 16383.50 FORMAT "%8.2" DEPOSIT ABSOLUTE /end AXIS_DESCR
 /begin AXIS_DESCR STD_AXIS APP_r Prc 16 -400.0000 399.9878 FORMAT "%8.4" DEPOSIT ABSOLUTE /end AXIS_DESCR
/end CHARACTERISTIC
/begin CHARACTERISTIC AccPed_tqEcoModGear2_M "Economy mode gear2 engine demand map" MAP 0x80512D7E RB_Map_S16S16_S16 6553.500 Trq -3276.800 3276.700 FORMAT "%8.3"
 /begin AXIS_DESCR STD_AXIS PT_nClth EngN 16 -16384.00 16383.50 FORMAT "%8.2" DEPOSIT ABSOLUTE /end AXIS_DESCR
 /begin AXIS_DESCR STD_AXIS APP_r Prc 16 -400.0000 399.9878 FORMAT "%8.4" DEPOSIT ABSOLUTE /end AXIS_DESCR
/end CHARACTERISTIC
/begin CHARACTERISTIC AccPed_tqEcoModGear3_M "Economy mode gear3 engine demand map" MAP 0x80512FC2 RB_Map_S16S16_S16 6553.500 Trq -3276.800 3276.700 FORMAT "%8.3"
 /begin AXIS_DESCR STD_AXIS PT_nClth EngN 16 -16384.00 16383.50 FORMAT "%8.2" DEPOSIT ABSOLUTE /end AXIS_DESCR
 /begin AXIS_DESCR STD_AXIS APP_r Prc 16 -400.0000 399.9878 FORMAT "%8.4" DEPOSIT ABSOLUTE /end AXIS_DESCR
/end CHARACTERISTIC
/begin CHARACTERISTIC AccPed_tqEcoModGear4_M "Economy mode gear4 engine demand map" MAP 0x80513206 RB_Map_S16S16_S16 6553.500 Trq -3276.800 3276.700 FORMAT "%8.3"
 /begin AXIS_DESCR STD_AXIS PT_nClth EngN 16 -16384.00 16383.50 FORMAT "%8.2" DEPOSIT ABSOLUTE /end AXIS_DESCR
 /begin AXIS_DESCR STD_AXIS APP_r Prc 16 -400.0000 399.9878 FORMAT "%8.4" DEPOSIT ABSOLUTE /end AXIS_DESCR
/end CHARACTERISTIC
/begin CHARACTERISTIC AccPed_tqEcoModGear5_M "Economy mode gear5 engine demand map" MAP 0x8051344A RB_Map_S16S16_S16 6553.500 Trq -3276.800 3276.700 FORMAT "%8.3"
 /begin AXIS_DESCR STD_AXIS PT_nClth EngN 16 -16384.00 16383.50 FORMAT "%8.2" DEPOSIT ABSOLUTE /end AXIS_DESCR
 /begin AXIS_DESCR STD_AXIS APP_r Prc 16 -400.0000 399.9878 FORMAT "%8.4" DEPOSIT ABSOLUTE /end AXIS_DESCR
/end CHARACTERISTIC
/begin CHARACTERISTIC AccPed_tqEcoModGear6_M "Economy mode gear6 engine demand map" MAP 0x8051368E RB_Map_S16S16_S16 6553.500 Trq -3276.800 3276.700 FORMAT "%8.3"
 /begin AXIS_DESCR STD_AXIS PT_nClth EngN 16 -16384.00 16383.50 FORMAT "%8.2" DEPOSIT ABSOLUTE /end AXIS_DESCR
 /begin AXIS_DESCR STD_AXIS APP_r Prc 16 -400.0000 399.9878 FORMAT "%8.4" DEPOSIT ABSOLUTE /end AXIS_DESCR
/end CHARACTERISTIC
/begin CHARACTERISTIC AccPed_tqEcoModGear7_M "Economy mode gear7 engine demand map" MAP 0x805138D2 RB_Map_S16S16_S16 6553.500 Trq -3276.800 3276.700 FORMAT "%8.3"
 /begin AXIS_DESCR STD_AXIS PT_nClth EngN 16 -16384.00 16383.50 FORMAT "%8.2" DEPOSIT ABSOLUTE /end AXIS_DESCR
 /begin AXIS_DESCR STD_AXIS APP_r Prc 16 -400.0000 399.9878 FORMAT "%8.4" DEPOSIT ABSOLUTE /end AXIS_DESCR
/end CHARACTERISTIC
/begin CHARACTERISTIC AccPed_tqEcoModGear8_M "Economy mode gear8 engine demand map" MAP 0x80513B16 RB_Map_S16S16_S16 6553.500 Trq -3276.800 3276.700 FORMAT "%8.3"
 /begin AXIS_DESCR STD_AXIS PT_nClth EngN 16 -16384.00 16383.50 FORMAT "%8.2" DEPOSIT ABSOLUTE /end AXIS_DESCR
 /begin AXIS_DESCR STD_AXIS APP_r Prc 16 -400.0000 399.9878 FORMAT "%8.4" DEPOSIT ABSOLUTE /end AXIS_DESCR
/end CHARACTERISTIC
/begin CHARACTERISTIC AccPed_tqEcoModGear9_M "Economy mode gear9 engine demand map" MAP 0x80513D5A RB_Map_S16S16_S16 6553.500 Trq -3276.800 3276.700 FORMAT "%8.3"
 /begin AXIS_DESCR STD_AXIS PT_nClth EngN 16 -16384.00 16383.50 FORMAT "%8.2" DEPOSIT ABSOLUTE /end AXIS_DESCR
 /begin AXIS_DESCR STD_AXIS APP_r Prc 16 -400.0000 399.9878 FORMAT "%8.4" DEPOSIT ABSOLUTE /end AXIS_DESCR
/end CHARACTERISTIC
/begin CHARACTERISTIC AccPed_tqFilSwtOffLim_C "Threshold for detect the output reaches the input of the PT1 filter" VALUE 0x80513F9E RB_Val_Ws16 6553.500 Trq -3276.800 3276.700 FORMAT "%8.3" /end CHARACTERISTIC
/begin CHARACTERISTIC AccPed_tqHiIdleCVT_T "High Idle for Continuously Variable Transmission." CURVE 0x80513FA0 RB_Curve_S16_S16 6553.500 Trq -3276.800 3276.700 FORMAT "%8.3"
 /begin AXIS_DESCR STD_AXIS APP_r Prc 16 -400.0000 399.9878 FORMAT "%8.4" DEPOSIT ABSOLUTE /end AXIS_DESCR
/end CHARACTERISTIC
/begin CHARACTERISTIC AccPed_tqHiIdleMT_T "High Idle for Manual Transmission." CURVE 0x80513FE2 RB_Curve_S16_S16 6553.500 Trq -3276.800 3276.700 FORMAT "%8.3"
 /begin AXIS_DESCR STD_AXIS APP_r Prc 16 -400.0000 399.9878 FORMAT "%8.4" DEPOSIT ABSOLUTE /end AXIS_DESCR
/end CHARACTERISTIC
/begin CHARACTERISTIC AccPed_tqMinWoRamp_C "Minimum torque difference for ramping of torque during drive mode change to be activated" VALUE 0x80514024 RB_Val_Ws16 6553.500 Trq -3276.800 3276.700 FORMAT "%8.3" /end CHARACTERISTIC
/begin CHARACTERISTIC AccPed_tqModRvsCmft_M "Driver demanded torque map for reverse gear in Comfort mode" MAP 0x80514026 RB_Map_S16S16_S16 6553.500 Trq -3276.800 3276.700 FORMAT "%8.3"
 /begin AXIS_DESCR STD_AXIS PT_nClth EngN 16 -16384.00 16383.50 FORMAT "%8.2" DEPOSIT ABSOLUTE /end AXIS_DESCR
 /begin AXIS_DESCR STD_AXIS APP_r Prc 16 -400.0000 399.9878 FORMAT "%8.4" DEPOSIT ABSOLUTE /end AXIS_DESCR
/end CHARACTERISTIC
/begin CHARACTERISTIC AccPed_tqModRvsEco_M "Driver demanded torque map for reverse gear in Economy mode" MAP 0x8051426A RB_Map_S16S16_S16 6553.500 Trq -3276.800 3276.700 FORMAT "%8.3"
 /begin AXIS_DESCR STD_AXIS PT_nClth EngN 16 -16384.00 16383.50 FORMAT "%8.2" DEPOSIT ABSOLUTE /end AXIS_DESCR
 /begin AXIS_DESCR STD_AXIS APP_r Prc 16 -400.0000 399.9878 FORMAT "%8.4" DEPOSIT ABSOLUTE /end AXIS_DESCR
/end CHARACTERISTIC
/begin CHARACTERISTIC AccPed_tqModRvsNorm_M "Driver demanded torque map for reverse gear in Normal Mode" MAP 0x805144AE RB_Map_S16S16_S16 6553.500 Trq -3276.800 3276.700 FORMAT "%8.3"
 /begin AXIS_DESCR STD_AXIS PT_nClth EngN 16 -16384.00 16383.50 FORMAT "%8.2" DEPOSIT ABSOLUTE /end AXIS_DESCR
 /begin AXIS_DESCR STD_AXIS APP_r Prc 16 -400.0000 399.9878 FORMAT "%8.4" DEPOSIT ABSOLUTE /end AXIS_DESCR
/end CHARACTERISTIC
/begin CHARACTERISTIC AccPed_tqModRvsPlusR_M "Driver demanded torque map for reverse gear in Plus R Mode" MAP 0x805146F2 RB_Map_S16S16_S16 6553.500 Trq -3276.800 3276.700 FORMAT "%8.3"
 /begin AXIS_DESCR STD_AXIS PT_nClth EngN 16 -16384.00 16383.50 FORMAT "%8.2" DEPOSIT ABSOLUTE /end AXIS_DESCR
 /begin AXIS_DESCR STD_AXIS APP_r Prc 16 -400.0000 399.9878 FORMAT "%8.4" DEPOSIT ABSOLUTE /end AXIS_DESCR
/end CHARACTERISTIC
/begin CHARACTERISTIC AccPed_tqModRvsSnow_M "Driver demanded torque map for reverse gear in Snow Mode" MAP 0x80514936 RB_Map_S16S16_S16 6553.500 Trq -3276.800 3276.700 FORMAT "%8.3"
 /begin AXIS_DESCR STD_AXIS PT_nClth EngN 16 -16384.00 16383.50 FORMAT "%8.2" DEPOSIT ABSOLUTE /end AXIS_DESCR
 /begin AXIS_DESCR STD_AXIS APP_r Prc 16 -400.0000 399.9878 FORMAT "%8.4" DEPOSIT ABSOLUTE /end AXIS_DESCR
/end CHARACTERISTIC
/begin CHARACTERISTIC AccPed_tqModRvsSpt_M "Driver demanded torque map for reverse gear in Sport Mode" MAP 0x80514B7A RB_Map_S16S16_S16 6553.500 Trq -3276.800 3276.700 FORMAT "%8.3"
 /begin AXIS_DESCR STD_AXIS PT_nClth EngN 16 -16384.00 16383.50 FORMAT "%8.2" DEPOSIT ABSOLUTE /end AXIS_DESCR
 /begin AXIS_DESCR STD_AXIS APP_r Prc 16 -400.0000 399.9878 FORMAT "%8.4" DEPOSIT ABSOLUTE /end AXIS_DESCR
/end CHARACTERISTIC
/begin CHARACTERISTIC AccPed_tqMTGear1_M "Driver demanded torque map for gear1 for MT transmission" MAP 0x80514DBE RB_Map_S16S16_S16 6553.500 Trq -3276.800 3276.700 FORMAT "%8.3"
 /begin AXIS_DESCR STD_AXIS PT_nClth EngN 16 -16384.00 16383.50 FORMAT "%8.2" DEPOSIT ABSOLUTE /end AXIS_DESCR
 /begin AXIS_DESCR STD_AXIS APP_r Prc 16 -400.0000 399.9878 FORMAT "%8.4" DEPOSIT ABSOLUTE /end AXIS_DESCR
/end CHARACTERISTIC
/begin CHARACTERISTIC AccPed_tqMTGear2_M "Driver demanded torque map for gear2 for MT transmission" MAP 0x80515002 RB_Map_S16S16_S16 6553.500 Trq -3276.800 3276.700 FORMAT "%8.3"
 /begin AXIS_DESCR STD_AXIS PT_nClth EngN 16 -16384.00 16383.50 FORMAT "%8.2" DEPOSIT ABSOLUTE /end AXIS_DESCR
 /begin AXIS_DESCR STD_AXIS APP_r Prc 16 -400.0000 399.9878 FORMAT "%8.4" DEPOSIT ABSOLUTE /end AXIS_DESCR
/end CHARACTERISTIC
/begin CHARACTERISTIC AccPed_tqMTGear3_M "Driver demanded torque map for gear3 for MT transmission" MAP 0x80515246 RB_Map_S16S16_S16 6553.500 Trq -3276.800 3276.700 FORMAT "%8.3"
 /begin AXIS_DESCR STD_AXIS PT_nClth EngN 16 -16384.00 16383.50 FORMAT "%8.2" DEPOSIT ABSOLUTE /end AXIS_DESCR
 /begin AXIS_DESCR STD_AXIS APP_r Prc 16 -400.0000 399.9878 FORMAT "%8.4" DEPOSIT ABSOLUTE /end AXIS_DESCR
/end CHARACTERISTIC
/begin CHARACTERISTIC AccPed_tqMTGear4_M "Driver demanded torque map for gear4 for MT transmission" MAP 0x8051548A RB_Map_S16S16_S16 6553.500 Trq -3276.800 3276.700 FORMAT "%8.3"
 /begin AXIS_DESCR STD_AXIS PT_nClth EngN 16 -16384.00 16383.50 FORMAT "%8.2" DEPOSIT ABSOLUTE /end AXIS_DESCR
 /begin AXIS_DESCR STD_AXIS APP_r Prc 16 -400.0000 399.9878 FORMAT "%8.4" DEPOSIT ABSOLUTE /end AXIS_DESCR
/end CHARACTERISTIC
/begin CHARACTERISTIC AccPed_tqMTGear5_M "Driver demanded torque map for gear5 for MT transmission" MAP 0x805156CE RB_Map_S16S16_S16 6553.500 Trq -3276.800 3276.700 FORMAT "%8.3"
 /begin AXIS_DESCR STD_AXIS PT_nClth EngN 16 -16384.00 16383.50 FORMAT "%8.2" DEPOSIT ABSOLUTE /end AXIS_DESCR
 /begin AXIS_DESCR STD_AXIS APP_r Prc 16 -400.0000 399.9878 FORMAT "%8.4" DEPOSIT ABSOLUTE /end AXIS_DESCR
/end CHARACTERISTIC
/begin CHARACTERISTIC AccPed_tqMTGear6_M "Driver demanded torque map for gear6 for MT transmission" MAP 0x80515912 RB_Map_S16S16_S16 6553.500 Trq -3276.800 3276.700 FORMAT "%8.3"
 /begin AXIS_DESCR STD_AXIS PT_nClth EngN 16 -16384.00 16383.50 FORMAT "%8.2" DEPOSIT ABSOLUTE /end AXIS_DESCR
 /begin AXIS_DESCR STD_AXIS APP_r Prc 16 -400.0000 399.9878 FORMAT "%8.4" DEPOSIT ABSOLUTE /end AXIS_DESCR
/end CHARACTERISTIC
/begin CHARACTERISTIC AccPed_tqNormModGear1_M "Normal mode gear1 engine demand map" MAP 0x80515B56 RB_Map_S16S16_S16 6553.500 Trq -3276.800 3276.700 FORMAT "%8.3"
 /begin AXIS_DESCR STD_AXIS PT_nClth EngN 16 -16384.00 16383.50 FORMAT "%8.2" DEPOSIT ABSOLUTE /end AXIS_DESCR
 /begin AXIS_DESCR STD_AXIS APP_r Prc 16 -400.0000 399.9878 FORMAT "%8.4" DEPOSIT ABSOLUTE /end AXIS_DESCR
/end CHARACTERISTIC
/begin CHARACTERISTIC AccPed_tqNormModGear2_M "Normal mode gear2 engine demand map" MAP 0x80515D9A RB_Map_S16S16_S16 6553.500 Trq -3276.800 3276.700 FORMAT "%8.3"
 /begin AXIS_DESCR STD_AXIS PT_nClth EngN 16 -16384.00 16383.50 FORMAT "%8.2" DEPOSIT ABSOLUTE /end AXIS_DESCR
 /begin AXIS_DESCR STD_AXIS APP_r Prc 16 -400.0000 399.9878 FORMAT "%8.4" DEPOSIT ABSOLUTE /end AXIS_DESCR
/end CHARACTERISTIC
/begin CHARACTERISTIC AccPed_tqNormModGear3_M "Normal mode gear3 engine demand map" MAP 0x80515FDE RB_Map_S16S16_S16 6553.500 Trq -3276.800 3276.700 FORMAT "%8.3"
 /begin AXIS_DESCR STD_AXIS PT_nClth EngN 16 -16384.00 16383.50 FORMAT "%8.2" DEPOSIT ABSOLUTE /end AXIS_DESCR
 /begin AXIS_DESCR STD_AXIS APP_r Prc 16 -400.0000 399.9878 FORMAT "%8.4" DEPOSIT ABSOLUTE /end AXIS_DESCR
/end CHARACTERISTIC
/begin CHARACTERISTIC AccPed_tqNormModGear4_M "Normal mode gear4 engine demand map" MAP 0x80516222 RB_Map_S16S16_S16 6553.500 Trq -3276.800 3276.700 FORMAT "%8.3"
 /begin AXIS_DESCR STD_AXIS PT_nClth EngN 16 -16384.00 16383.50 FORMAT "%8.2" DEPOSIT ABSOLUTE /end AXIS_DESCR
 /begin AXIS_DESCR STD_AXIS APP_r Prc 16 -400.0000 399.9878 FORMAT "%8.4" DEPOSIT ABSOLUTE /end AXIS_DESCR
/end CHARACTERISTIC
/begin CHARACTERISTIC AccPed_tqNormModGear5_M "Normal mode gear5 engine demand map" MAP 0x80516466 RB_Map_S16S16_S16 6553.500 Trq -3276.800 3276.700 FORMAT "%8.3"
 /begin AXIS_DESCR STD_AXIS PT_nClth EngN 16 -16384.00 16383.50 FORMAT "%8.2" DEPOSIT ABSOLUTE /end AXIS_DESCR
 /begin AXIS_DESCR STD_AXIS APP_r Prc 16 -400.0000 399.9878 FORMAT "%8.4" DEPOSIT ABSOLUTE /end AXIS_DESCR
/end CHARACTERISTIC
/begin CHARACTERISTIC AccPed_tqNormModGear6_M "Normal mode gear6 engine demand map" MAP 0x805166AA RB_Map_S16S16_S16 6553.500 Trq -3276.800 3276.700 FORMAT "%8.3"
 /begin AXIS_DESCR STD_AXIS PT_nClth EngN 16 -16384.00 16383.50 FORMAT "%8.2" DEPOSIT ABSOLUTE /end AXIS_DESCR
 /begin AXIS_DESCR STD_AXIS APP_r Prc 16 -400.0000 399.9878 FORMAT "%8.4" DEPOSIT ABSOLUTE /end AXIS_DESCR
/end CHARACTERISTIC
/begin CHARACTERISTIC AccPed_tqNormModGear7_M "Normal mode gear7 engine demand map" MAP 0x805168EE RB_Map_S16S16_S16 6553.500 Trq -3276.800 3276.700 FORMAT "%8.3"
 /begin AXIS_DESCR STD_AXIS PT_nClth EngN 16 -16384.00 16383.50 FORMAT "%8.2" DEPOSIT ABSOLUTE /end AXIS_DESCR
 /begin AXIS_DESCR STD_AXIS APP_r Prc 16 -400.0000 399.9878 FORMAT "%8.4" DEPOSIT ABSOLUTE /end AXIS_DESCR
/end CHARACTERISTIC
/begin CHARACTERISTIC AccPed_tqNormModGear8_M "Normal mode gear8 engine demand map" MAP 0x80516B32 RB_Map_S16S16_S16 6553.500 Trq -3276.800 3276.700 FORMAT "%8.3"
 /begin AXIS_DESCR STD_AXIS PT_nClth EngN 16 -16384.00 16383.50 FORMAT "%8.2" DEPOSIT ABSOLUTE /end AXIS_DESCR
 /begin AXIS_DESCR STD_AXIS APP_r Prc 16 -400.0000 399.9878 FORMAT "%8.4" DEPOSIT ABSOLUTE /end AXIS_DESCR
/end CHARACTERISTIC
/begin CHARACTERISTIC AccPed_tqNormModGear9_M "Normal mode gear9 engine demand map" MAP 0x80516D76 RB_Map_S16S16_S16 6553.500 Trq -3276.800 3276.700 FORMAT "%8.3"
 /begin AXIS_DESCR STD_AXIS PT_nClth EngN 16 -16384.00 16383.50 FORMAT "%8.2" DEPOSIT ABSOLUTE /end AXIS_DESCR
 /begin AXIS_DESCR STD_AXIS APP_r Prc 16 -400.0000 399.9878 FORMAT "%8.4" DEPOSIT ABSOLUTE /end AXIS_DESCR
/end CHARACTERISTIC
/begin CHARACTERISTIC AccPed_tqPlusRModGear1_M "Plus R mode gear1 engine demand map" MAP 0x80516FBA RB_Map_S16S16_S16 6553.500 Trq -3276.800 3276.700 FORMAT "%8.3"
 /begin AXIS_DESCR STD_AXIS PT_nClth EngN 16 -16384.00 16383.50 FORMAT "%8.2" DEPOSIT ABSOLUTE /end AXIS_DESCR
 /begin AXIS_DESCR STD_AXIS APP_r Prc 16 -400.0000 399.9878 FORMAT "%8.4" DEPOSIT ABSOLUTE /end AXIS_DESCR
/end CHARACTERISTIC
/begin CHARACTERISTIC AccPed_tqPlusRModGear2_M "Plus R mode gear2 engine demand map" MAP 0x805171FE RB_Map_S16S16_S16 6553.500 Trq -3276.800 3276.700 FORMAT "%8.3"
 /begin AXIS_DESCR STD_AXIS PT_nClth EngN 16 -16384.00 16383.50 FORMAT "%8.2" DEPOSIT ABSOLUTE /end AXIS_DESCR
 /begin AXIS_DESCR STD_AXIS APP_r Prc 16 -400.0000 399.9878 FORMAT "%8.4" DEPOSIT ABSOLUTE /end AXIS_DESCR
/end CHARACTERISTIC
/begin CHARACTERISTIC AccPed_tqPlusRModGear3_M "Plus R mode gear3 engine demand map" MAP 0x80517442 RB_Map_S16S16_S16 6553.500 Trq -3276.800 3276.700 FORMAT "%8.3"
 /begin AXIS_DESCR STD_AXIS PT_nClth EngN 16 -16384.00 16383.50 FORMAT "%8.2" DEPOSIT ABSOLUTE /end AXIS_DESCR
 /begin AXIS_DESCR STD_AXIS APP_r Prc 16 -400.0000 399.9878 FORMAT "%8.4" DEPOSIT ABSOLUTE /end AXIS_DESCR
/end CHARACTERISTIC
/begin CHARACTERISTIC AccPed_tqPlusRModGear4_M "Plus R mode gear4 engine demand map" MAP 0x80517686 RB_Map_S16S16_S16 6553.500 Trq -3276.800 3276.700 FORMAT "%8.3"
 /begin AXIS_DESCR STD_AXIS PT_nClth EngN 16 -16384.00 16383.50 FORMAT "%8.2" DEPOSIT ABSOLUTE /end AXIS_DESCR
 /begin AXIS_DESCR STD_AXIS APP_r Prc 16 -400.0000 399.9878 FORMAT "%8.4" DEPOSIT ABSOLUTE /end AXIS_DESCR
/end CHARACTERISTIC
/begin CHARACTERISTIC AccPed_tqPlusRModGear5_M "Plus R mode gear5 engine demand map" MAP 0x805178CA RB_Map_S16S16_S16 6553.500 Trq -3276.800 3276.700 FORMAT "%8.3"
 /begin AXIS_DESCR STD_AXIS PT_nClth EngN 16 -16384.00 16383.50 FORMAT "%8.2" DEPOSIT ABSOLUTE /end AXIS_DESCR
 /begin AXIS_DESCR STD_AXIS APP_r Prc 16 -400.0000 399.9878 FORMAT "%8.4" DEPOSIT ABSOLUTE /end AXIS_DESCR
/end CHARACTERISTIC
/begin CHARACTERISTIC AccPed_tqPlusRModGear6_M "Plus R mode gear6 engine demand map" MAP 0x80517B0E RB_Map_S16S16_S16 6553.500 Trq -3276.800 3276.700 FORMAT "%8.3"
 /begin AXIS_DESCR STD_AXIS PT_nClth EngN 16 -16384.00 16383.50 FORMAT "%8.2" DEPOSIT ABSOLUTE /end AXIS_DESCR
 /begin AXIS_DESCR STD_AXIS APP_r Prc 16 -400.0000 399.9878 FORMAT "%8.4" DEPOSIT ABSOLUTE /end AXIS_DESCR
/end CHARACTERISTIC
/begin CHARACTERISTIC AccPed_tqPlusRModGear7_M "Plus R mode gear7 engine demand map" MAP 0x80517D52 RB_Map_S16S16_S16 6553.500 Trq -3276.800 3276.700 FORMAT "%8.3"
 /begin AXIS_DESCR STD_AXIS PT_nClth EngN 16 -16384.00 16383.50 FORMAT "%8.2" DEPOSIT ABSOLUTE /end AXIS_DESCR
 /begin AXIS_DESCR STD_AXIS APP_r Prc 16 -400.0000 399.9878 FORMAT "%8.4" DEPOSIT ABSOLUTE /end AXIS_DESCR
/end CHARACTERISTIC
/begin CHARACTERISTIC AccPed_tqPlusRModGear8_M "Plus R mode gear8 engine demand map" MAP 0x80517F96 RB_Map_S16S16_S16 6553.500 Trq -3276.800 3276.700 FORMAT "%8.3"
 /begin AXIS_DESCR STD_AXIS PT_nClth EngN 16 -16384.00 16383.50 FORMAT "%8.2" DEPOSIT ABSOLUTE /end AXIS_DESCR
 /begin AXIS_DESCR STD_AXIS APP_r Prc 16 -400.0000 399.9878 FORMAT "%8.4" DEPOSIT ABSOLUTE /end AXIS_DESCR
/end CHARACTERISTIC
/begin CHARACTERISTIC AccPed_tqPlusRModGear9_M "Plus R mode gear9 engine demand map" MAP 0x805181DA RB_Map_S16S16_S16 6553.500 Trq -3276.800 3276.700 FORMAT "%8.3"
 /begin AXIS_DESCR STD_AXIS PT_nClth EngN 16 -16384.00 16383.50 FORMAT "%8.2" DEPOSIT ABSOLUTE /end AXIS_DESCR
 /begin AXIS_DESCR STD_AXIS APP_r Prc 16 -400.0000 399.9878 FORMAT "%8.4" DEPOSIT ABSOLUTE /end AXIS_DESCR
/end CHARACTERISTIC
/begin CHARACTERISTIC AccPed_tqPullThd_C "Threshold for the propulsion state detection" VALUE 0x8050EB7C RB_Val_Ws32 429496729.500 TrqPrpHigh -214748364.800 214748364.700 FORMAT "%13.3" /end CHARACTERISTIC
/begin CHARACTERISTIC AccPed_tqSnowModGear1_M "Snow mode gear1 engine demand map" MAP 0x8051841E RB_Map_S16S16_S16 6553.500 Trq -3276.800 3276.700 FORMAT "%8.3"
 /begin AXIS_DESCR STD_AXIS PT_nClth EngN 16 -16384.00 16383.50 FORMAT "%8.2" DEPOSIT ABSOLUTE /end AXIS_DESCR
 /begin AXIS_DESCR STD_AXIS APP_r Prc 16 -400.0000 399.9878 FORMAT "%8.4" DEPOSIT ABSOLUTE /end AXIS_DESCR
/end CHARACTERISTIC
/begin CHARACTERISTIC AccPed_tqSnowModGear2_M "Snow mode gear2 engine demand map" MAP 0x80518662 RB_Map_S16S16_S16 6553.500 Trq -3276.800 3276.700 FORMAT "%8.3"
 /begin AXIS_DESCR STD_AXIS PT_nClth EngN 16 -16384.00 16383.50 FORMAT "%8.2" DEPOSIT ABSOLUTE /end AXIS_DESCR
 /begin AXIS_DESCR STD_AXIS APP_r Prc 16 -400.0000 399.9878 FORMAT "%8.4" DEPOSIT ABSOLUTE /end AXIS_DESCR
/end CHARACTERISTIC
/begin CHARACTERISTIC AccPed_tqSnowModGear3_M "Snow mode gear3 engine demand map" MAP 0x805188A6 RB_Map_S16S16_S16 6553.500 Trq -3276.800 3276.700 FORMAT "%8.3"
 /begin AXIS_DESCR STD_AXIS PT_nClth EngN 16 -16384.00 16383.50 FORMAT "%8.2" DEPOSIT ABSOLUTE /end AXIS_DESCR
 /begin AXIS_DESCR STD_AXIS APP_r Prc 16 -400.0000 399.9878 FORMAT "%8.4" DEPOSIT ABSOLUTE /end AXIS_DESCR
/end CHARACTERISTIC
/begin CHARACTERISTIC AccPed_tqSnowModGear4_M "Snow mode gear4 engine demand map" MAP 0x80518AEA RB_Map_S16S16_S16 6553.500 Trq -3276.800 3276.700 FORMAT "%8.3"
 /begin AXIS_DESCR STD_AXIS PT_nClth EngN 16 -16384.00 16383.50 FORMAT "%8.2" DEPOSIT ABSOLUTE /end AXIS_DESCR
 /begin AXIS_DESCR STD_AXIS APP_r Prc 16 -400.0000 399.9878 FORMAT "%8.4" DEPOSIT ABSOLUTE /end AXIS_DESCR
/end CHARACTERISTIC
/begin CHARACTERISTIC AccPed_tqSnowModGear5_M "Snow mode gear5 engine demand map" MAP 0x80518D2E RB_Map_S16S16_S16 6553.500 Trq -3276.800 3276.700 FORMAT "%8.3"
 /begin AXIS_DESCR STD_AXIS PT_nClth EngN 16 -16384.00 16383.50 FORMAT "%8.2" DEPOSIT ABSOLUTE /end AXIS_DESCR
 /begin AXIS_DESCR STD_AXIS APP_r Prc 16 -400.0000 399.9878 FORMAT "%8.4" DEPOSIT ABSOLUTE /end AXIS_DESCR
/end CHARACTERISTIC
/begin CHARACTERISTIC AccPed_tqSnowModGear6_M "Snow mode gear6 engine demand map" MAP 0x80518F72 RB_Map_S16S16_S16 6553.500 Trq -3276.800 3276.700 FORMAT "%8.3"
 /begin AXIS_DESCR STD_AXIS PT_nClth EngN 16 -16384.00 16383.50 FORMAT "%8.2" DEPOSIT ABSOLUTE /end AXIS_DESCR
 /begin AXIS_DESCR STD_AXIS APP_r Prc 16 -400.0000 399.9878 FORMAT "%8.4" DEPOSIT ABSOLUTE /end AXIS_DESCR
/end CHARACTERISTIC
/begin CHARACTERISTIC AccPed_tqSnowModGear7_M "Snow mode gear7 engine demand map" MAP 0x805191B6 RB_Map_S16S16_S16 6553.500 Trq -3276.800 3276.700 FORMAT "%8.3"
 /begin AXIS_DESCR STD_AXIS PT_nClth EngN 16 -16384.00 16383.50 FORMAT "%8.2" DEPOSIT ABSOLUTE /end AXIS_DESCR
 /begin AXIS_DESCR STD_AXIS APP_r Prc 16 -400.0000 399.9878 FORMAT "%8.4" DEPOSIT ABSOLUTE /end AXIS_DESCR
/end CHARACTERISTIC
/begin CHARACTERISTIC AccPed_tqSnowModGear8_M "Snow mode gear8 engine demand map" MAP 0x805193FA RB_Map_S16S16_S16 6553.500 Trq -3276.800 3276.700 FORMAT "%8.3"
 /begin AXIS_DESCR STD_AXIS PT_nClth EngN 16 -16384.00 16383.50 FORMAT "%8.2" DEPOSIT ABSOLUTE /end AXIS_DESCR
 /begin AXIS_DESCR STD_AXIS APP_r Prc 16 -400.0000 399.9878 FORMAT "%8.4" DEPOSIT ABSOLUTE /end AXIS_DESCR
/end CHARACTERISTIC
/begin CHARACTERISTIC AccPed_tqSnowModGear9_M "Snow mode gear9 engine demand map" MAP 0x8051963E RB_Map_S16S16_S16 6553.500 Trq -3276.800 3276.700 FORMAT "%8.3"
 /begin AXIS_DESCR STD_AXIS PT_nClth EngN 16 -16384.00 16383.50 FORMAT "%8.2" DEPOSIT ABSOLUTE /end AXIS_DESCR
 /begin AXIS_DESCR STD_AXIS APP_r Prc 16 -400.0000 399.9878 FORMAT "%8.4" DEPOSIT ABSOLUTE /end AXIS_DESCR
/end CHARACTERISTIC
/begin CHARACTERISTIC AccPed_tqSptModGear1_M "Sport mode gear1 engine demand map" MAP 0x80519882 RB_Map_S16S16_S16 6553.500 Trq -3276.800 3276.700 FORMAT "%8.3"
 /begin AXIS_DESCR STD_AXIS PT_nClth EngN 16 -16384.00 16383.50 FORMAT "%8.2" DEPOSIT ABSOLUTE /end AXIS_DESCR
 /begin AXIS_DESCR STD_AXIS APP_r Prc 16 -400.0000 399.9878 FORMAT "%8.4" DEPOSIT ABSOLUTE /end AXIS_DESCR
/end CHARACTERISTIC
/begin CHARACTERISTIC AccPed_tqSptModGear2_M "Sport mode gear2 engine demand map" MAP 0x80519AC6 RB_Map_S16S16_S16 6553.500 Trq -3276.800 3276.700 FORMAT "%8.3"
 /begin AXIS_DESCR STD_AXIS PT_nClth EngN 16 -16384.00 16383.50 FORMAT "%8.2" DEPOSIT ABSOLUTE /end AXIS_DESCR
 /begin AXIS_DESCR STD_AXIS APP_r Prc 16 -400.0000 399.9878 FORMAT "%8.4" DEPOSIT ABSOLUTE /end AXIS_DESCR
/end CHARACTERISTIC
/begin CHARACTERISTIC AccPed_tqSptModGear3_M "Sport mode gear3 engine demand map" MAP 0x80519D0A RB_Map_S16S16_S16 6553.500 Trq -3276.800 3276.700 FORMAT "%8.3"
 /begin AXIS_DESCR STD_AXIS PT_nClth EngN 16 -16384.00 16383.50 FORMAT "%8.2" DEPOSIT ABSOLUTE /end AXIS_DESCR
 /begin AXIS_DESCR STD_AXIS APP_r Prc 16 -400.0000 399.9878 FORMAT "%8.4" DEPOSIT ABSOLUTE /end AXIS_DESCR
/end CHARACTERISTIC
/begin CHARACTERISTIC AccPed_tqSptModGear4_M "Sport mode gear4 engine demand map" MAP 0x80519F4E RB_Map_S16S16_S16 6553.500 Trq -3276.800 3276.700 FORMAT "%8.3"
 /begin AXIS_DESCR STD_AXIS PT_nClth EngN 16 -16384.00 16383.50 FORMAT "%8.2" DEPOSIT ABSOLUTE /end AXIS_DESCR
 /begin AXIS_DESCR STD_AXIS APP_r Prc 16 -400.0000 399.9878 FORMAT "%8.4" DEPOSIT ABSOLUTE /end AXIS_DESCR
/end CHARACTERISTIC
/begin CHARACTERISTIC AccPed_tqSptModGear5_M "Sport mode gear5 engine demand map" MAP 0x8051A192 RB_Map_S16S16_S16 6553.500 Trq -3276.800 3276.700 FORMAT "%8.3"
 /begin AXIS_DESCR STD_AXIS PT_nClth EngN 16 -16384.00 16383.50 FORMAT "%8.2" DEPOSIT ABSOLUTE /end AXIS_DESCR
 /begin AXIS_DESCR STD_AXIS APP_r Prc 16 -400.0000 399.9878 FORMAT "%8.4" DEPOSIT ABSOLUTE /end AXIS_DESCR
/end CHARACTERISTIC
/begin CHARACTERISTIC AccPed_tqSptModGear6_M "Sport mode gear6 engine demand map" MAP 0x8051A3D6 RB_Map_S16S16_S16 6553.500 Trq -3276.800 3276.700 FORMAT "%8.3"
 /begin AXIS_DESCR STD_AXIS PT_nClth EngN 16 -16384.00 16383.50 FORMAT "%8.2" DEPOSIT ABSOLUTE /end AXIS_DESCR
 /begin AXIS_DESCR STD_AXIS APP_r Prc 16 -400.0000 399.9878 FORMAT "%8.4" DEPOSIT ABSOLUTE /end AXIS_DESCR
/end CHARACTERISTIC
/begin CHARACTERISTIC AccPed_tqSptModGear7_M "Sport mode gear7 engine demand map" MAP 0x8051A61A RB_Map_S16S16_S16 6553.500 Trq -3276.800 3276.700 FORMAT "%8.3"
 /begin AXIS_DESCR STD_AXIS PT_nClth EngN 16 -16384.00 16383.50 FORMAT "%8.2" DEPOSIT ABSOLUTE /end AXIS_DESCR
 /begin AXIS_DESCR STD_AXIS APP_r Prc 16 -400.0000 399.9878 FORMAT "%8.4" DEPOSIT ABSOLUTE /end AXIS_DESCR
/end CHARACTERISTIC
/begin CHARACTERISTIC AccPed_tqSptModGear8_M "Sport mode gear8 engine demand map" MAP 0x8051A85E RB_Map_S16S16_S16 6553.500 Trq -3276.800 3276.700 FORMAT "%8.3"
 /begin AXIS_DESCR STD_AXIS PT_nClth EngN 16 -16384.00 16383.50 FORMAT "%8.2" DEPOSIT ABSOLUTE /end AXIS_DESCR
 /begin AXIS_DESCR STD_AXIS APP_r Prc 16 -400.0000 399.9878 FORMAT "%8.4" DEPOSIT ABSOLUTE /end AXIS_DESCR
/end CHARACTERISTIC
/begin CHARACTERISTIC AccPed_tqSptModGear9_M "Sport mode gear9 engine demand map" MAP 0x8051AAA2 RB_Map_S16S16_S16 6553.500 Trq -3276.800 3276.700 FORMAT "%8.3"
 /begin AXIS_DESCR STD_AXIS PT_nClth EngN 16 -16384.00 16383.50 FORMAT "%8.2" DEPOSIT ABSOLUTE /end AXIS_DESCR
 /begin AXIS_DESCR STD_AXIS APP_r Prc 16 -400.0000 399.9878 FORMAT "%8.4" DEPOSIT ABSOLUTE /end AXIS_DESCR
/end CHARACTERISTIC
/begin CHARACTERISTIC AccPed_trqLimMax_C "Maximum wheel torque in case of accelerator pedal error" VALUE 0x8050EB6C RB_Val_Ws32 429496729.500 TrqPrpHigh -214748364.800 214748364.700 FORMAT "%13.3" /end CHARACTERISTIC
/begin CHARACTERISTIC AccPed_trqMod1Gear1_M "Mode 1 gear1 engine demand map" MAP 0x8051ACE6 RB_Map_S16S16_S16 6553.500 Trq -3276.800 3276.700 FORMAT "%8.3"
 /begin AXIS_DESCR STD_AXIS PT_nClth EngN 16 -16384.00 16383.50 FORMAT "%8.2" DEPOSIT ABSOLUTE /end AXIS_DESCR
 /begin AXIS_DESCR STD_AXIS APP_r Prc 16 -400.0000 399.9878 FORMAT "%8.4" DEPOSIT ABSOLUTE /end AXIS_DESCR
/end CHARACTERISTIC
/begin CHARACTERISTIC AccPed_trqMod1Gear2_M "Mode 1 gear2 engine demand map" MAP 0x8051AF2A RB_Map_S16S16_S16 6553.500 Trq -3276.800 3276.700 FORMAT "%8.3"
 /begin AXIS_DESCR STD_AXIS PT_nClth EngN 16 -16384.00 16383.50 FORMAT "%8.2" DEPOSIT ABSOLUTE /end AXIS_DESCR
 /begin AXIS_DESCR STD_AXIS APP_r Prc 16 -400.0000 399.9878 FORMAT "%8.4" DEPOSIT ABSOLUTE /end AXIS_DESCR
/end CHARACTERISTIC
/begin CHARACTERISTIC AccPed_trqMod1Gear3_M "Mode 1 gear3 engine demand map" MAP 0x8051B16E RB_Map_S16S16_S16 6553.500 Trq -3276.800 3276.700 FORMAT "%8.3"
 /begin AXIS_DESCR STD_AXIS PT_nClth EngN 16 -16384.00 16383.50 FORMAT "%8.2" DEPOSIT ABSOLUTE /end AXIS_DESCR
 /begin AXIS_DESCR STD_AXIS APP_r Prc 16 -400.0000 399.9878 FORMAT "%8.4" DEPOSIT ABSOLUTE /end AXIS_DESCR
/end CHARACTERISTIC
/begin CHARACTERISTIC AccPed_trqMod1Gear4_M "Mode 1 gear4 engine demand map" MAP 0x8051B3B2 RB_Map_S16S16_S16 6553.500 Trq -3276.800 3276.700 FORMAT "%8.3"
 /begin AXIS_DESCR STD_AXIS PT_nClth EngN 16 -16384.00 16383.50 FORMAT "%8.2" DEPOSIT ABSOLUTE /end AXIS_DESCR
 /begin AXIS_DESCR STD_AXIS APP_r Prc 16 -400.0000 399.9878 FORMAT "%8.4" DEPOSIT ABSOLUTE /end AXIS_DESCR
/end CHARACTERISTIC
/begin CHARACTERISTIC AccPed_trqMod1Gear5_M "Mode 1 gear5 engine demand map" MAP 0x8051B5F6 RB_Map_S16S16_S16 6553.500 Trq -3276.800 3276.700 FORMAT "%8.3"
 /begin AXIS_DESCR STD_AXIS PT_nClth EngN 16 -16384.00 16383.50 FORMAT "%8.2" DEPOSIT ABSOLUTE /end AXIS_DESCR
 /begin AXIS_DESCR STD_AXIS APP_r Prc 16 -400.0000 399.9878 FORMAT "%8.4" DEPOSIT ABSOLUTE /end AXIS_DESCR
/end CHARACTERISTIC
/begin CHARACTERISTIC AccPed_trqMod1Gear6_M "Mode 1 gear6 engine demand map" MAP 0x8051B83A RB_Map_S16S16_S16 6553.500 Trq -3276.800 3276.700 FORMAT "%8.3"
 /begin AXIS_DESCR STD_AXIS PT_nClth EngN 16 -16384.00 16383.50 FORMAT "%8.2" DEPOSIT ABSOLUTE /end AXIS_DESCR
 /begin AXIS_DESCR STD_AXIS APP_r Prc 16 -400.0000 399.9878 FORMAT "%8.4" DEPOSIT ABSOLUTE /end AXIS_DESCR
/end CHARACTERISTIC
/begin CHARACTERISTIC AirCCmpr_ATS.LimitTypeMsk_C "Actuator test AirCCmpr_ATS / Tester demand monitoring enable mask for actuators" VALUE 0x8058ACE0 Val_Wu8 255.0 OneToOne 0.00 255.0 FORMAT "%5.1" /end CHARACTERISTIC
/begin CHARACTERISTIC AirCCmpr_ATS.CnvNorm_C "Actuator test AirCCmpr_ATS / Conversion norm used for conversion to/from internal scaling" VALUE 0x8058ACE1 Val_Wu8 255.0 OneToOne 0.00 255.0 FORMAT "%5.1" /end CHARACTERISTIC
/begin CHARACTERISTIC AirCCmpr_ATS.LowLim_C "Actuator test AirCCmpr_ATS / Lower limit for monitoring" VALUE 0x8058ACE2 Val_Ws16 65535.00 OneToOne -32768.00 32767.00 FORMAT "%8.2" /end CHARACTERISTIC
/begin CHARACTERISTIC AirCCmpr_ATS.UpLim_C "Actuator test AirCCmpr_ATS / Upper limit for monitoring" VALUE 0x8058ACE4 Val_Ws16 65535.00 OneToOne -32768.00 32767.00 FORMAT "%8.2" /end CHARACTERISTIC
/begin CHARACTERISTIC AirCCmpr_ATS.CnvFac_C "Actuator test AirCCmpr_ATS / Factor used for conversion to/from internal scaling" VALUE 0x8058ACE8 Val_Ws32 4294967295.00 OneToOne -2147483648.00 2147483647.00 FORMAT "%13.2" /end CHARACTERISTIC
/begin CHARACTERISTIC AirCCmpr_ATS.CnvOfs_C "Actuator test AirCCmpr_ATS / Offset used for conversion to/from internal scaling" VALUE 0x8058ACEC Val_Ws16 65535.00 OneToOne -32768.00 32767.00 FORMAT "%8.2" /end CHARACTERISTIC
/begin CHARACTERISTIC AirCCmpr_ATS.DfltVal_C "Actuator test AirCCmpr_ATS / Default value for standbytest" VALUE 0x8058ACEE Val_Ws16 65535.00 OneToOne -32768.00 32767.00 FORMAT "%8.2" /end CHARACTERISTIC
/begin CHARACTERISTIC AirC_nEngLoLim_C "Lower limit for the engine speed above which a plausibility check for AC coolant pressure is valid" VALUE 0x805060EC RB_Val_Ws16 32767.50 EngN -16384.00 16383.50 FORMAT "%8.2" /end CHARACTERISTIC
/begin CHARACTERISTIC AirC_pClntTransfAna_CUR "Curve for transformation of ADC voltage to sensed value of AC coolant pressure" CURVE 0x805060EE RB_Curve_S16_S16 131070.0 PresAC_hPa -65536.00 65534.00 FORMAT "%8.2"
 /begin AXIS_DESCR STD_AXIS AirC_uAnaRawClnt Volt 16 -6553.600 6553.400 FORMAT "%8.3" DEPOSIT ABSOLUTE /end AXIS_DESCR
/end CHARACTERISTIC
/begin CHARACTERISTIC AirC_pDfl_C "Default substitute value for the AC coolant pressure in case of errors" VALUE 0x8058AC48 Kw_Ws16 131070.0 PresAC_hPa -65536.00 65534.00 FORMAT "%8.2" /end CHARACTERISTIC
/begin CHARACTERISTIC AirC_RmpSlpClntP.Pos_C "Slope of transition ramp to default value in case of an error / Slope if the ramp has to be increased" VALUE 0x8058AC4C Kw_Ws32 65535999.9695 RmpPresAC_hPa 0.00 65535999.9695 FORMAT "%13.4" EXTENDED_LIMITS -65536000.0000 65535999.9695 /end CHARACTERISTIC
/begin CHARACTERISTIC AirC_RmpSlpClntP.Neg_C "Slope of transition ramp to default value in case of an error / negative ramp slope" VALUE 0x8058AC50 Kw_Ws32 131071999.969 RmpPresAC_hPa -65536000.0000 65535999.9695 FORMAT "%13.4" /end CHARACTERISTIC
/begin CHARACTERISTIC AirC_stCmprPsDiaDisbl_C "Status for deactivation of the power stage diagnostics" VALUE 0x8050613E RB_Val_Wu16 65535.00 OneToOne 0.00 65535.00 FORMAT "%8.2" /end CHARACTERISTIC
/begin CHARACTERISTIC AirC_stCmprPsDisbl_C "Status for activation of the power stage" VALUE 0x80506140 RB_Val_Wu16 65535.00 OneToOne 0.00 65535.00 FORMAT "%8.2" /end CHARACTERISTIC
/begin CHARACTERISTIC AirC_stCmprTyp_CW "Code word for the selection of compressor type" VALUE 0x80506142 RB_Val_Wu8 255.0 OneToOne 0.00 255.0 FORMAT "%5.1" /end CHARACTERISTIC
/begin CHARACTERISTIC AirC_swtAnaClntPres_C "Selection switch for AC pressure error diagnosis" VALUE 0x80506130 RB_Val_Wu8 255.0 OneToOne 0.00 255.0 FORMAT "%5.1" /end CHARACTERISTIC
/begin CHARACTERISTIC AirC_tAirLoLim_C "Lower limit for the environment temperature above which a plausibility check for AC coolant pressure is valid" VALUE 0x80506132 RB_Val_Ws16 6553.500 Temp_Cels -3549.940 3003.560 FORMAT "%8.3" /end CHARACTERISTIC
/begin CHARACTERISTIC AirC_tiPT1_C "AC coolant pressure PT1 filter constant" VALUE 0x8058AC54 Val_Ws32 4294.9672940000000 TimeDelay_s 0.0000020000000 4294.9672959999998 FORMAT "%19.14" EXTENDED_LIMITS 0.000002000000001 4294.9672959999998 /end CHARACTERISTIC
/begin CHARACTERISTIC AirC_TransStgClntP.Dfl_C "Transstage structure for AC coolant pressure / Fixed replacement value" VALUE 0x8058AC58 Kw_Ws16 131070.0 PresAC_hPa -65536.00 65534.00 FORMAT "%8.2" /end CHARACTERISTIC
/begin CHARACTERISTIC AirC_TransStgClntP.stSensId_C "Transstage structure for AC coolant pressure / Sensor Id word" VALUE 0x8058AC5A Kw_Wu8 255.0 OneToOne 0.00 255.0 FORMAT "%5.1" /end CHARACTERISTIC
/begin CHARACTERISTIC AirC_trqCmprMin_C "Minimum value of the compressor torque." VALUE 0x80506144 RB_Val_Ws16 6553.500 Trq -3276.800 3276.700 FORMAT "%8.3" /end CHARACTERISTIC
/begin CHARACTERISTIC AirC_uSRCMaxClntPres_C "Threshold for the SRC Max error in AC coolant pressure sensor" VALUE 0x80506134 RB_Val_Ws16 13107.00 Volt -6553.600 6553.400 FORMAT "%8.3" /end CHARACTERISTIC
/begin CHARACTERISTIC AirC_uSRCMinClntPres_C "Threshold for SRC Min error in AC coolant pressure sensor" VALUE 0x80506136 RB_Val_Ws16 13107.00 Volt -6553.600 6553.400 FORMAT "%8.3" /end CHARACTERISTIC
/begin MEASUREMENT rba_OsShell_Cntr1000msTask "OS task counter for the OS_1000ms_Task" UWORD RB_RBA_Common_CentralElements_CompuMethods_Identical 1 100 0.0 65535. FORMAT "%5.0" ECU_ADDRESS 0x60015AE4 /end MEASUREMENT
/begin MEASUREMENT rba_OsShell_Cntr100msTask "OS task counter for the OS_100ms_Task" UWORD RB_RBA_Common_CentralElements_CompuMethods_Identical 1 100 0.0 65535. FORMAT "%5.0" ECU_ADDRESS 0x60015ADA /end MEASUREMENT
/begin MEASUREMENT rba_OsShell_Cntr10msTask "OS task counter for the OS_10ms_Task" UWORD RB_RBA_Common_CentralElements_CompuMethods_Identical 1 100 0.0 65535. FORMAT "%5.0" ECU_ADDRESS 0x60015AD4 /end MEASUREMENT
/begin MEASUREMENT rba_OsShell_Cntr1msTask "OS task counter for the OS_1ms_Task" UWORD RB_RBA_Common_CentralElements_CompuMethods_Identical 1 100 0.0 65535. FORMAT "%5.0" ECU_ADDRESS 0x60015AB8 /end MEASUREMENT
/begin MEASUREMENT rba_OsShell_Cntr200msTask "OS task counter for the OS_200ms_Task" UWORD RB_RBA_Common_CentralElements_CompuMethods_Identical 1 100 0.0 65535. FORMAT "%5.0" ECU_ADDRESS 0x60015ADC /end MEASUREMENT
/begin MEASUREMENT rba_OsShell_Cntr20msTask "OS task counter for the OS_20ms_Task" UWORD RB_RBA_Common_CentralElements_CompuMethods_Identical 1 100 0.0 65535. FORMAT "%5.0" ECU_ADDRESS 0x60015AD6 /end MEASUREMENT
/begin MEASUREMENT rba_OsShell_Cntr2msTask "OS task counter for the OS_2ms_Task" UWORD RB_RBA_Common_CentralElements_CompuMethods_Identical 1 100 0.0 65535. FORMAT "%5.0" ECU_ADDRESS 0x60015AC8 /end MEASUREMENT
/begin MEASUREMENT rba_OsShell_Cntr50msTask "OS task counter for the OS_50ms_Task" UWORD RB_RBA_Common_CentralElements_CompuMethods_Identical 1 100 0.0 65535. FORMAT "%5.0" ECU_ADDRESS 0x60015AD8 /end MEASUREMENT
/begin MEASUREMENT rba_OsShell_Cntr5msTask "OS task counter for the OS_5ms_Task" UWORD RB_RBA_Common_CentralElements_CompuMethods_Identical 1 100 0.0 65535. FORMAT "%5.0" ECU_ADDRESS 0x70005926 /end MEASUREMENT
/begin MEASUREMENT rba_OsShell_CntrAsw1BgTask "OS task counter for the OS_Asw1Bg_Task" UWORD RB_RBA_Common_CentralElements_CompuMethods_Identical 1 100 0.0 65535. FORMAT "%5.0" ECU_ADDRESS 0x60015AF6 /end MEASUREMENT
/begin MEASUREMENT rba_OsShell_CntrAsw2BgTask "OS task counter for the OS_Asw2Bg_Task" UWORD RB_RBA_Common_CentralElements_CompuMethods_Identical 1 100 0.0 65535. FORMAT "%5.0" ECU_ADDRESS 0x50008420 /end MEASUREMENT
/begin MEASUREMENT rba_OsShell_CntrBswBgTask "OS task counter for the OS_BswBg_Task" UWORD RB_RBA_Common_CentralElements_CompuMethods_Identical 1 100 0.0 65535. FORMAT "%5.0" ECU_ADDRESS 0x70005938 /end MEASUREMENT
/begin MEASUREMENT rba_OsShell_CntrCalWup100msTask "OS task counter for the OS_CalWup_100ms_Task" UWORD RB_RBA_Common_CentralElements_CompuMethods_Identical 1 100 0.0 65535. FORMAT "%5.0" ECU_ADDRESS 0x7000592E /end MEASUREMENT
/begin MEASUREMENT rba_OsShell_CntrCalWup10msTask "OS task counter for the OS_CalWup_10ms_Task" UWORD RB_RBA_Common_CentralElements_CompuMethods_Identical 1 100 0.0 65535. FORMAT "%5.0" ECU_ADDRESS 0x7000592A /end MEASUREMENT
/begin MEASUREMENT rba_OsShell_CntrCalWup20msTask "OS task counter for the OS_CalWup_20ms_Task" UWORD RB_RBA_Common_CentralElements_CompuMethods_Identical 1 100 0.0 65535. FORMAT "%5.0" ECU_ADDRESS 0x7000592C /end MEASUREMENT
/begin MEASUREMENT rba_OsShell_CntrCalWup2msTask "OS task counter for the OS_CalWup_2ms_Task" UWORD RB_RBA_Common_CentralElements_CompuMethods_Identical 1 100 0.0 65535. FORMAT "%5.0" ECU_ADDRESS 0x70005924 /end MEASUREMENT
/begin MEASUREMENT rba_OsShell_CntrCalWupAsw110msTask "OS task counter for the OS_CalWupAsw1_10ms_Task" UWORD RB_RBA_Common_CentralElements_CompuMethods_Identical 1 100 0.0 65535. FORMAT "%5.0" ECU_ADDRESS 0x60015AD2 /end MEASUREMENT
/begin MEASUREMENT rba_OsShell_CntrCalWupAsw210msTask "OS task counter for the OS_CalWupAsw2_10ms_Task" UWORD RB_RBA_Common_CentralElements_CompuMethods_Identical 1 100 0.0 65535. FORMAT "%5.0" ECU_ADDRESS 0x5000841A /end MEASUREMENT
/begin MEASUREMENT rba_OsShell_CntrCalWupBgTask "OS task counter for the OS_CalWup_Bg_Task" UWORD RB_RBA_Common_CentralElements_CompuMethods_Identical 1 100 0.0 65535. FORMAT "%5.0" ECU_ADDRESS 0x70005936 /end MEASUREMENT
/begin MEASUREMENT rba_OsShell_CntrCalWupIniEndTask "OS task counter for the OS_CalWup_IniEnd_Task" UWORD RB_RBA_Common_CentralElements_CompuMethods_Identical 1 100 0.0 65535. FORMAT "%5.0" ECU_ADDRESS 0x70005934 /end MEASUREMENT
/begin MEASUREMENT rba_OsShell_CntrCalWupIniTask "OS task counter for the OS_CalWup_Ini_Task" UWORD RB_RBA_Common_CentralElements_CompuMethods_Identical 1 100 0.0 65535. FORMAT "%5.0" ECU_ADDRESS 0x70005932 /end MEASUREMENT
/begin MEASUREMENT rba_OsShell_CntrDSMClearTask "OS task counter for the OS_DSM_Clear_Task" UWORD RB_RBA_Common_CentralElements_CompuMethods_Identical 1 100 0.0 65535. FORMAT "%5.0" ECU_ADDRESS 0x60015AE2 /end MEASUREMENT
/begin MEASUREMENT rba_OsShell_CntrDSMReiniTask "OS task counter for the OS_DSM_Reini_Task" UWORD RB_RBA_Common_CentralElements_CompuMethods_Identical 1 100 0.0 65535. FORMAT "%5.0" ECU_ADDRESS 0x60015AF4 /end MEASUREMENT
/begin MEASUREMENT rba_OsShell_CntrEngReStrtDummyTask "OS task counter for the OS_EngReStrt_Dummy_Task" UWORD RB_RBA_Common_CentralElements_CompuMethods_Identical 1 100 0.0 65535. FORMAT "%5.0" ECU_ADDRESS 0x60015AC4 /end MEASUREMENT
/begin MEASUREMENT rba_OsShell_CntrEngReStrtModeMTask "OS task counter for the OS_EngReStrtModeM_Task" UWORD RB_RBA_Common_CentralElements_CompuMethods_Identical 1 100 0.0 65535. FORMAT "%5.0" ECU_ADDRESS 0x60015AF2 /end MEASUREMENT
/begin MEASUREMENT rba_OsShell_CntrEngReStrtTask "OS task counter for the OS_EngReStrt_Task" UWORD RB_RBA_Common_CentralElements_CompuMethods_Identical 1 100 0.0 65535. FORMAT "%5.0" ECU_ADDRESS 0x50008414 /end MEASUREMENT
/begin MEASUREMENT rba_OsShell_CntrEpmNoSyncTask "OS task counter for the OS_EpmNoSync_Task" UWORD RB_RBA_Common_CentralElements_CompuMethods_Identical 1 100 0.0 65535. FORMAT "%5.0" ECU_ADDRESS 0x50008412 /end MEASUREMENT
/begin MEASUREMENT rba_OsShell_CntrErrLimit1000msTask "Limit error counter for OS_1000ms_Task" UBYTE RB_RBA_Common_CentralElements_CompuMethods_Identical 1 100 0.0 255. FORMAT "%5.0" ECU_ADDRESS 0x60011292 /end MEASUREMENT
/begin MEASUREMENT rba_OsShell_CntrErrLimit100msTask "Limit error counter for OS_100ms_Task" UBYTE RB_RBA_Common_CentralElements_CompuMethods_Identical 1 100 0.0 255. FORMAT "%5.0" ECU_ADDRESS 0x6001128D /end MEASUREMENT
/begin MEASUREMENT rba_OsShell_CntrErrLimit10msTask "Limit error counter for OS_10ms_Task" UBYTE RB_RBA_Common_CentralElements_CompuMethods_Identical 1 100 0.0 255. FORMAT "%5.0" ECU_ADDRESS 0x60011287 /end MEASUREMENT
/begin MEASUREMENT rba_OsShell_CntrErrLimit1msTask "Limit error counter for OS_1ms_Task" UBYTE RB_RBA_Common_CentralElements_CompuMethods_Identical 1 100 0.0 255. FORMAT "%5.0" ECU_ADDRESS 0x6001126A /end MEASUREMENT
/begin MEASUREMENT rba_OsShell_CntrErrLimit200msTask "Limit error counter for OS_200ms_Task" UBYTE RB_RBA_Common_CentralElements_CompuMethods_Identical 1 100 0.0 255. FORMAT "%5.0" ECU_ADDRESS 0x6001128E /end MEASUREMENT
/begin MEASUREMENT rba_OsShell_CntrErrLimit20msTask "Limit error counter for OS_20ms_Task" UBYTE RB_RBA_Common_CentralElements_CompuMethods_Identical 1 100 0.0 255. FORMAT "%5.0" ECU_ADDRESS 0x60011289 /end MEASUREMENT
/begin MEASUREMENT rba_OsShell_CntrErrLimit2msTask "Limit error counter for OS_2ms_Task" UBYTE RB_RBA_Common_CentralElements_CompuMethods_Identical 1 100 0.0 255. FORMAT "%5.0" ECU_ADDRESS 0x6001127B /end MEASUREMENT
/begin MEASUREMENT rba_OsShell_CntrErrLimit50msTask "Limit error counter for OS_50ms_Task" UBYTE RB_RBA_Common_CentralElements_CompuMethods_Identical 1 100 0.0 255. FORMAT "%5.0" ECU_ADDRESS 0x6001128A /end MEASUREMENT
/begin MEASUREMENT rba_OsShell_CntrErrLimit5msTask "Limit error counter for OS_5ms_Task" UBYTE RB_RBA_Common_CentralElements_CompuMethods_Identical 1 100 0.0 255. FORMAT "%5.0" ECU_ADDRESS 0x6001127D /end MEASUREMENT
/begin MEASUREMENT rba_OsShell_CntrErrLimitAsw1BgTask "Limit error counter for OS_Asw1Bg_Task" UBYTE RB_RBA_Common_CentralElements_CompuMethods_Identical 1 100 0.0 255. FORMAT "%5.0" ECU_ADDRESS 0x600112A2 /end MEASUREMENT
/begin MEASUREMENT rba_OsShell_CntrErrLimitAsw2BgTask "Limit error counter for OS_Asw2Bg_Task" UBYTE RB_RBA_Common_CentralElements_CompuMethods_Identical 1 100 0.0 255. FORMAT "%5.0" ECU_ADDRESS 0x600112A1 /end MEASUREMENT
/begin MEASUREMENT rba_OsShell_CntrErrLimitBswBgTask "Limit error counter for OS_BswBg_Task" UBYTE RB_RBA_Common_CentralElements_CompuMethods_Identical 1 100 0.0 255. FORMAT "%5.0" ECU_ADDRESS 0x600112A0 /end MEASUREMENT
/begin MEASUREMENT rba_OsShell_CntrErrLimitCalWup100msTask "Limit error counter for OS_CalWup_100ms_Task" UBYTE RB_RBA_Common_CentralElements_CompuMethods_Identical 1 100 0.0 255. FORMAT "%5.0" ECU_ADDRESS 0x6001128C /end MEASUREMENT
/begin MEASUREMENT rba_OsShell_CntrErrLimitCalWup10msTask "Limit error counter for OS_CalWup_10ms_Task" UBYTE RB_RBA_Common_CentralElements_CompuMethods_Identical 1 100 0.0 255. FORMAT "%5.0" ECU_ADDRESS 0x60011284 /end MEASUREMENT
/begin MEASUREMENT rba_OsShell_CntrErrLimitCalWup20msTask "Limit error counter for OS_CalWup_20ms_Task" UBYTE RB_RBA_Common_CentralElements_CompuMethods_Identical 1 100 0.0 255. FORMAT "%5.0" ECU_ADDRESS 0x60011288 /end MEASUREMENT
/begin MEASUREMENT rba_OsShell_CntrErrLimitCalWup2msTask "Limit error counter for OS_CalWup_2ms_Task" UBYTE RB_RBA_Common_CentralElements_CompuMethods_Identical 1 100 0.0 255. FORMAT "%5.0" ECU_ADDRESS 0x6001127A /end MEASUREMENT
/begin MEASUREMENT rba_OsShell_CntrErrLimitCalWupAsw110msTask "Limit error counter for OS_CalWupAsw1_10ms_Task" UBYTE RB_RBA_Common_CentralElements_CompuMethods_Identical 1 100 0.0 255. FORMAT "%5.0" ECU_ADDRESS 0x60011286 /end MEASUREMENT
/begin MEASUREMENT rba_OsShell_CntrErrLimitCalWupAsw210msTask "Limit error counter for OS_CalWupAsw2_10ms_Task" UBYTE RB_RBA_Common_CentralElements_CompuMethods_Identical 1 100 0.0 255. FORMAT "%5.0" ECU_ADDRESS 0x60011285 /end MEASUREMENT
/begin MEASUREMENT rba_OsShell_CntrErrLimitCalWupBgTask "Limit error counter for OS_CalWup_Bg_Task" UBYTE RB_RBA_Common_CentralElements_CompuMethods_Identical 1 100 0.0 255. FORMAT "%5.0" ECU_ADDRESS 0x6001129F /end MEASUREMENT
/begin MEASUREMENT rba_OsShell_CntrErrLimitCalWupIniEndTask "Limit error counter for OS_CalWup_IniEnd_Task" UBYTE RB_RBA_Common_CentralElements_CompuMethods_Identical 1 100 0.0 255. FORMAT "%5.0" ECU_ADDRESS 0x6001129E /end MEASUREMENT
/begin MEASUREMENT rba_OsShell_CntrErrLimitCalWupIniTask "Limit error counter for OS_CalWup_Ini_Task" UBYTE RB_RBA_Common_CentralElements_CompuMethods_Identical 1 100 0.0 255. FORMAT "%5.0" ECU_ADDRESS 0x6001129D /end MEASUREMENT
/begin MEASUREMENT rba_OsShell_CntrErrLimitDSMClearTask "Limit error counter for OS_DSM_Clear_Task" UBYTE RB_RBA_Common_CentralElements_CompuMethods_Identical 1 100 0.0 255. FORMAT "%5.0" ECU_ADDRESS 0x60011291 /end MEASUREMENT
/begin MEASUREMENT rba_OsShell_CntrErrLimitDSMReiniTask "Limit error counter for OS_DSM_Reini_Task" UBYTE RB_RBA_Common_CentralElements_CompuMethods_Identical 1 100 0.0 255. FORMAT "%5.0" ECU_ADDRESS 0x6001129C /end MEASUREMENT
/begin MEASUREMENT rba_OsShell_CntrErrLimitEngReStrtDummyTask "Limit error counter for OS_EngReStrt_Dummy_Task" UBYTE RB_RBA_Common_CentralElements_CompuMethods_Identical 1 100 0.0 255. FORMAT "%5.0" ECU_ADDRESS 0x60011278 /end MEASUREMENT
/begin MEASUREMENT rba_OsShell_CntrErrLimitEngReStrtModeMTask "Limit error counter for OS_EngReStrtModeM_Task" UBYTE RB_RBA_Common_CentralElements_CompuMethods_Identical 1 100 0.0 255. FORMAT "%5.0" ECU_ADDRESS 0x6001129B /end MEASUREMENT
/begin MEASUREMENT rba_OsShell_CntrErrLimitEngReStrtTask "Limit error counter for OS_EngReStrt_Task" UBYTE RB_RBA_Common_CentralElements_CompuMethods_Identical 1 100 0.0 255. FORMAT "%5.0" ECU_ADDRESS 0x60011277 /end MEASUREMENT
/begin MEASUREMENT rba_OsShell_CntrErrLimitEpmNoSyncTask "Limit error counter for OS_EpmNoSync_Task" UBYTE RB_RBA_Common_CentralElements_CompuMethods_Identical 1 100 0.0 255. FORMAT "%5.0" ECU_ADDRESS 0x60011276 /end MEASUREMENT
/begin MEASUREMENT rba_OsShell_CntrErrLimitInfraAsw1App10msTask "Limit error counter for OS_InfraAsw1App_10ms_Task" UBYTE RB_RBA_Common_CentralElements_CompuMethods_Identical 1 100 0.0 255. FORMAT "%5.0" ECU_ADDRESS 0x60011283 /end MEASUREMENT
/begin MEASUREMENT rba_OsShell_CntrErrLimitInfraAsw2App10msTask "Limit error counter for OS_InfraAsw2App_10ms_Task" UBYTE RB_RBA_Common_CentralElements_CompuMethods_Identical 1 100 0.0 255. FORMAT "%5.0" ECU_ADDRESS 0x60011282 /end MEASUREMENT
/begin MEASUREMENT rba_OsShell_CntrErrLimitInfraBswApp10msTask "Limit error counter for OS_InfraBswApp_10ms_Task" UBYTE RB_RBA_Common_CentralElements_CompuMethods_Identical 1 100 0.0 255. FORMAT "%5.0" ECU_ADDRESS 0x60011281 /end MEASUREMENT
/begin MEASUREMENT rba_OsShell_CntrErrLimitIniDrvTask "Limit error counter for OS_IniDrv_Task" UBYTE RB_RBA_Common_CentralElements_CompuMethods_Identical 1 100 0.0 255. FORMAT "%5.0" ECU_ADDRESS 0x60011290 /end MEASUREMENT
/begin MEASUREMENT rba_OsShell_CntrErrLimitIniEndTask "Limit error counter for OS_IniEnd_Task" UBYTE RB_RBA_Common_CentralElements_CompuMethods_Identical 1 100 0.0 255. FORMAT "%5.0" ECU_ADDRESS 0x6001129A /end MEASUREMENT
/begin MEASUREMENT rba_OsShell_CntrErrLimitIniTask "Limit error counter for OS_Ini_Task" UBYTE RB_RBA_Common_CentralElements_CompuMethods_Identical 1 100 0.0 255. FORMAT "%5.0" ECU_ADDRESS 0x60011299 /end MEASUREMENT
/begin MEASUREMENT rba_OsShell_CntrErrLimitIniTaskCore0 "Limit error counter for OS_Ini_Task_Core0" UBYTE RB_RBA_Common_CentralElements_CompuMethods_Identical 1 100 0.0 255. FORMAT "%5.0" ECU_ADDRESS 0x60011298 /end MEASUREMENT
/begin MEASUREMENT rba_OsShell_CntrErrLimitMoSyncFirstTask "Limit error counter for OS_Mo_SyncFirst_Task" UBYTE RB_RBA_Common_CentralElements_CompuMethods_Identical 1 100 0.0 255. FORMAT "%5.0" ECU_ADDRESS 0x60011275 /end MEASUREMENT
/begin MEASUREMENT rba_OsShell_CntrErrLimitMoSyncIniTask "Limit error counter for OS_Mo_SyncIni_Task" UBYTE RB_RBA_Common_CentralElements_CompuMethods_Identical 1 100 0.0 255. FORMAT "%5.0" ECU_ADDRESS 0x60011274 /end MEASUREMENT
/begin MEASUREMENT rba_OsShell_CntrErrLimitMoSyncS0Task "Limit error counter for OS_Mo_SyncS0_Task" UBYTE RB_RBA_Common_CentralElements_CompuMethods_Identical 1 100 0.0 255. FORMAT "%5.0" ECU_ADDRESS 0x60011273 /end MEASUREMENT
/begin MEASUREMENT rba_OsShell_CntrErrLimitMoSyncS1Task "Limit error counter for OS_Mo_SyncS1_Task" UBYTE RB_RBA_Common_CentralElements_CompuMethods_Identical 1 100 0.0 255. FORMAT "%5.0" ECU_ADDRESS 0x60011272 /end MEASUREMENT
/begin MEASUREMENT rba_OsShell_CntrErrLimitMoTask "Limit error counter for OS_Mo_Task" UBYTE RB_RBA_Common_CentralElements_CompuMethods_Identical 1 100 0.0 255. FORMAT "%5.0" ECU_ADDRESS 0x6001126B /end MEASUREMENT
/begin MEASUREMENT rba_OsShell_CntrErrLimitReIniModeMTask "Limit error counter for OS_ReIniModeM_Task" UBYTE RB_RBA_Common_CentralElements_CompuMethods_Identical 1 100 0.0 255. FORMAT "%5.0" ECU_ADDRESS 0x60011297 /end MEASUREMENT
/begin MEASUREMENT rba_OsShell_CntrErrLimitReIniTask "Limit error counter for OS_ReIni_Task" UBYTE RB_RBA_Common_CentralElements_CompuMethods_Identical 1 100 0.0 255. FORMAT "%5.0" ECU_ADDRESS 0x6001128F /end MEASUREMENT
/begin MEASUREMENT rba_OsShell_CntrErrLimitShutdown10msTask "Limit error counter for OS_Shutdown_10ms_Task" UBYTE RB_RBA_Common_CentralElements_CompuMethods_Identical 1 100 0.0 255. FORMAT "%5.0" ECU_ADDRESS 0x60011264 /end MEASUREMENT
/begin MEASUREMENT rba_OsShell_CntrErrLimitShutdownAsw1Task "Limit error counter for OS_Shutdown_Asw1_Task" UBYTE RB_RBA_Common_CentralElements_CompuMethods_Identical 1 100 0.0 255. FORMAT "%5.0" ECU_ADDRESS 0x60011268 /end MEASUREMENT
/begin MEASUREMENT rba_OsShell_CntrErrLimitShutdownAsw2Task "Limit error counter for OS_Shutdown_Asw2_Task" UBYTE RB_RBA_Common_CentralElements_CompuMethods_Identical 1 100 0.0 255. FORMAT "%5.0" ECU_ADDRESS 0x60011267 /end MEASUREMENT
/begin MEASUREMENT rba_OsShell_CntrErrLimitShutdownBswTask "Limit error counter for OS_Shutdown_Bsw_Task" UBYTE RB_RBA_Common_CentralElements_CompuMethods_Identical 1 100 0.0 255. FORMAT "%5.0" ECU_ADDRESS 0x60011266 /end MEASUREMENT
/begin MEASUREMENT rba_OsShell_CntrErrLimitShutdownSeqTask "Limit error counter for OS_Shutdown_Seq_Task" UBYTE RB_RBA_Common_CentralElements_CompuMethods_Identical 1 100 0.0 255. FORMAT "%5.0" ECU_ADDRESS 0x60011265 /end MEASUREMENT
/begin MEASUREMENT rba_OsShell_CntrErrLimitStopCntrWakeup100msTask "Limit error counter for OS_StopCntrWakeup_100ms_Task" UBYTE RB_RBA_Common_CentralElements_CompuMethods_Identical 1 100 0.0 255. FORMAT "%5.0" ECU_ADDRESS 0x6001128B /end MEASUREMENT
/begin MEASUREMENT rba_OsShell_CntrErrLimitStopCntrWakeup10msTask "Limit error counter for OS_StopCntrWakeup_10ms_Task" UBYTE RB_RBA_Common_CentralElements_CompuMethods_Identical 1 100 0.0 255. FORMAT "%5.0" ECU_ADDRESS 0x6001127E /end MEASUREMENT
/begin MEASUREMENT rba_OsShell_CntrErrLimitStopCntrWakeup1msTask "Limit error counter for OS_StopCntrWakeup_1ms_Task" UBYTE RB_RBA_Common_CentralElements_CompuMethods_Identical 1 100 0.0 255. FORMAT "%5.0" ECU_ADDRESS 0x60011269 /end MEASUREMENT
/begin MEASUREMENT rba_OsShell_CntrErrLimitStopCntrWakeup20msTask "Limit error counter for OS_StopCntrWakeup_20ms_Task" UBYTE RB_RBA_Common_CentralElements_CompuMethods_Identical 1 100 0.0 255. FORMAT "%5.0" ECU_ADDRESS 0x60011271 /end MEASUREMENT
/begin MEASUREMENT rba_OsShell_CntrErrLimitStopCntrWakeup2msTask "Limit error counter for OS_StopCntrWakeup_2ms_Task" UBYTE RB_RBA_Common_CentralElements_CompuMethods_Identical 1 100 0.0 255. FORMAT "%5.0" ECU_ADDRESS 0x60011279 /end MEASUREMENT
/begin MEASUREMENT rba_OsShell_CntrErrLimitStopCntrWakeup5msTask "Limit error counter for OS_StopCntrWakeup_5ms_Task" UBYTE RB_RBA_Common_CentralElements_CompuMethods_Identical 1 100 0.0 255. FORMAT "%5.0" ECU_ADDRESS 0x6001127C /end MEASUREMENT
/begin MEASUREMENT rba_OsShell_CntrErrLimitStopCntrWakeupAsw110msTask "Limit error counter for OS_StopCntrWakeupAsw1_10ms_Task" UBYTE RB_RBA_Common_CentralElements_CompuMethods_Identical 1 100 0.0 255. FORMAT "%5.0" ECU_ADDRESS 0x60011280 /end MEASUREMENT
/begin MEASUREMENT rba_OsShell_CntrErrLimitStopCntrWakeupAsw1BgTask "Limit error counter for OS_StopCntrWakeup_Asw1Bg_Task" UBYTE RB_RBA_Common_CentralElements_CompuMethods_Identical 1 100 0.0 255. FORMAT "%5.0" ECU_ADDRESS 0x60011296 /end MEASUREMENT
/begin MEASUREMENT rba_OsShell_CntrErrLimitStopCntrWakeupAsw210msTask "Limit error counter for OS_StopCntrWakeupAsw2_10ms_Task" UBYTE RB_RBA_Common_CentralElements_CompuMethods_Identical 1 100 0.0 255. FORMAT "%5.0" ECU_ADDRESS 0x6001127F /end MEASUREMENT
/begin MEASUREMENT rba_OsShell_CntrErrLimitStopCntrWakeupAsw2BgTask "Limit error counter for OS_StopCntrWakeup_Asw2Bg_Task" UBYTE RB_RBA_Common_CentralElements_CompuMethods_Identical 1 100 0.0 255. FORMAT "%5.0" ECU_ADDRESS 0x60011295 /end MEASUREMENT
/begin MEASUREMENT rba_OsShell_CntrErrLimitStopCntrWakeupIniEndTask "Limit error counter for OS_StopCntrWakeup_IniEnd_Task" UBYTE RB_RBA_Common_CentralElements_CompuMethods_Identical 1 100 0.0 255. FORMAT "%5.0" ECU_ADDRESS 0x60011294 /end MEASUREMENT
/begin MEASUREMENT rba_OsShell_CntrErrLimitStopCntrWakeupIniTask "Limit error counter for OS_StopCntrWakeup_Ini_Task" UBYTE RB_RBA_Common_CentralElements_CompuMethods_Identical 1 100 0.0 255. FORMAT "%5.0" ECU_ADDRESS 0x60011293 /end MEASUREMENT
/begin MEASUREMENT rba_OsShell_CntrErrLimitSyncFirstTask "Limit error counter for OS_SyncFirst_Task" UBYTE RB_RBA_Common_CentralElements_CompuMethods_Identical 1 100 0.0 255. FORMAT "%5.0" ECU_ADDRESS 0x60011270 /end MEASUREMENT
/begin MEASUREMENT rba_OsShell_CntrErrLimitSyncIniTask "Limit error counter for OS_SyncIni_Task" UBYTE RB_RBA_Common_CentralElements_CompuMethods_Identical 1 100 0.0 255. FORMAT "%5.0" ECU_ADDRESS 0x6001126F /end MEASUREMENT
/begin MEASUREMENT rba_OsShell_CntrErrLimitSyncPreTask "Limit error counter for OS_SyncPre_Task" UBYTE RB_RBA_Common_CentralElements_CompuMethods_Identical 1 100 0.0 255. FORMAT "%5.0" ECU_ADDRESS 0x6001126E /end MEASUREMENT
/begin MEASUREMENT rba_OsShell_CntrErrLimitSyncS0Task "Limit error counter for OS_SyncS0_Task" UBYTE RB_RBA_Common_CentralElements_CompuMethods_Identical 1 100 0.0 255. FORMAT "%5.0" ECU_ADDRESS 0x6001126D /end MEASUREMENT
/begin MEASUREMENT rba_OsShell_CntrErrLimitSyncS1Task "Limit error counter for OS_SyncS1_Task" UBYTE RB_RBA_Common_CentralElements_CompuMethods_Identical 1 100 0.0 255. FORMAT "%5.0" ECU_ADDRESS 0x6001126C /end MEASUREMENT
/begin MEASUREMENT rba_OsShell_CntrInfraAsw1App10msTask "OS task counter for the OS_InfraAsw1App_10ms_Task" UWORD RB_RBA_Common_CentralElements_CompuMethods_Identical 1 100 0.0 65535. FORMAT "%5.0" ECU_ADDRESS 0x60015AD0 /end MEASUREMENT
/begin MEASUREMENT rba_OsShell_CntrInfraAsw2App10msTask "OS task counter for the OS_InfraAsw2App_10ms_Task" UWORD RB_RBA_Common_CentralElements_CompuMethods_Identical 1 100 0.0 65535. FORMAT "%5.0" ECU_ADDRESS 0x50008418 /end MEASUREMENT
/begin MEASUREMENT rba_OsShell_CntrInfraBswApp10msTask "OS task counter for the OS_InfraBswApp_10ms_Task" UWORD RB_RBA_Common_CentralElements_CompuMethods_Identical 1 100 0.0 65535. FORMAT "%5.0" ECU_ADDRESS 0x70005928 /end MEASUREMENT
/begin MEASUREMENT rba_OsShell_CntrIniDrvTask "OS task counter for the OS_IniDrv_Task" UWORD RB_RBA_Common_CentralElements_CompuMethods_Identical 1 100 0.0 65535. FORMAT "%5.0" ECU_ADDRESS 0x60015AE0 /end MEASUREMENT
/begin MEASUREMENT rba_OsShell_CntrIniEndTask "OS task counter for the OS_IniEnd_Task" UWORD RB_RBA_Common_CentralElements_CompuMethods_Identical 1 100 0.0 65535. FORMAT "%5.0" ECU_ADDRESS 0x60015AF0 /end MEASUREMENT
/begin MEASUREMENT rba_OsShell_CntrIniTask "OS task counter for the OS_Ini_Task" UWORD RB_RBA_Common_CentralElements_CompuMethods_Identical 1 100 0.0 65535. FORMAT "%5.0" ECU_ADDRESS 0x60015AEE /end MEASUREMENT
/begin MEASUREMENT rba_OsShell_CntrIniTaskCore0 "OS task counter for the OS_Ini_Task_Core0" UWORD RB_RBA_Common_CentralElements_CompuMethods_Identical 1 100 0.0 65535. FORMAT "%5.0" ECU_ADDRESS 0x70005930 /end MEASUREMENT
/begin MEASUREMENT rba_OsShell_CntrMoSyncFirstTask "OS task counter for the OS_Mo_SyncFirst_Task" UWORD RB_RBA_Common_CentralElements_CompuMethods_Identical 1 100 0.0 65535. FORMAT "%5.0" ECU_ADDRESS 0x60015AC2 /end MEASUREMENT
/begin MEASUREMENT rba_OsShell_CntrMoSyncIniTask "OS task counter for the OS_Mo_SyncIni_Task" UWORD RB_RBA_Common_CentralElements_CompuMethods_Identical 1 100 0.0 65535. FORMAT "%5.0" ECU_ADDRESS 0x60015AC0 /end MEASUREMENT
/begin MEASUREMENT rba_OsShell_CntrMoSyncS0Task "OS task counter for the OS_Mo_SyncS0_Task" UWORD RB_RBA_Common_CentralElements_CompuMethods_Identical 1 100 0.0 65535. FORMAT "%5.0" ECU_ADDRESS 0x60015ABE /end MEASUREMENT
/begin MEASUREMENT rba_OsShell_CntrMoSyncS1Task "OS task counter for the OS_Mo_SyncS1_Task" UWORD RB_RBA_Common_CentralElements_CompuMethods_Identical 1 100 0.0 65535. FORMAT "%5.0" ECU_ADDRESS 0x60015ABC /end MEASUREMENT
/begin MEASUREMENT rba_OsShell_CntrMoTask "OS task counter for the OS_Mo_Task" UWORD RB_RBA_Common_CentralElements_CompuMethods_Identical 1 100 0.0 65535. FORMAT "%5.0" ECU_ADDRESS 0x60015ABA /end MEASUREMENT
/begin MEASUREMENT rba_OsShell_CntrReIniModeMTask "OS task counter for the OS_ReIniModeM_Task" UWORD RB_RBA_Common_CentralElements_CompuMethods_Identical 1 100 0.0 65535. FORMAT "%5.0" ECU_ADDRESS 0x60015AEC /end MEASUREMENT
/begin MEASUREMENT rba_OsShell_CntrReIniTask "OS task counter for the OS_ReIni_Task" UWORD RB_RBA_Common_CentralElements_CompuMethods_Identical 1 100 0.0 65535. FORMAT "%5.0" ECU_ADDRESS 0x60015ADE /end MEASUREMENT
/begin MEASUREMENT rba_OsShell_CntrShutdown10msTask "OS task counter for the OS_Shutdown_10ms_Task" UWORD RB_RBA_Common_CentralElements_CompuMethods_Identical 1 100 0.0 65535. FORMAT "%5.0" ECU_ADDRESS 0x7000591E /end MEASUREMENT
/begin MEASUREMENT rba_OsShell_CntrShutdownAsw1Task "OS task counter for the OS_Shutdown_Asw1_Task" UWORD RB_RBA_Common_CentralElements_CompuMethods_Identical 1 100 0.0 65535. FORMAT "%5.0" ECU_ADDRESS 0x60015AB4 /end MEASUREMENT
/begin MEASUREMENT rba_OsShell_CntrShutdownAsw2Task "OS task counter for the OS_Shutdown_Asw2_Task" UWORD RB_RBA_Common_CentralElements_CompuMethods_Identical 1 100 0.0 65535. FORMAT "%5.0" ECU_ADDRESS 0x50008404 /end MEASUREMENT
/begin MEASUREMENT rba_OsShell_CntrShutdownBswTask "OS task counter for the OS_Shutdown_Bsw_Task" UWORD RB_RBA_Common_CentralElements_CompuMethods_Identical 1 100 0.0 65535. FORMAT "%5.0" ECU_ADDRESS 0x70005922 /end MEASUREMENT
/begin MEASUREMENT rba_OsShell_CntrShutdownSeqTask "OS task counter for the OS_Shutdown_Seq_Task" UWORD RB_RBA_Common_CentralElements_CompuMethods_Identical 1 100 0.0 65535. FORMAT "%5.0" ECU_ADDRESS 0x70005920 /end MEASUREMENT
/begin MEASUREMENT rba_OsShell_CntrStopCntrWakeup100msTask "OS task counter for the OS_StopCntrWakeup_100ms_Task" UWORD RB_RBA_Common_CentralElements_CompuMethods_Identical 1 100 0.0 65535. FORMAT "%5.0" ECU_ADDRESS 0x5000841C /end MEASUREMENT
/begin MEASUREMENT rba_OsShell_CntrStopCntrWakeup10msTask "OS task counter for the OS_StopCntrWakeup_10ms_Task" UWORD RB_RBA_Common_CentralElements_CompuMethods_Identical 1 100 0.0 65535. FORMAT "%5.0" ECU_ADDRESS 0x60015ACC /end MEASUREMENT
/begin MEASUREMENT rba_OsShell_CntrStopCntrWakeup1msTask "OS task counter for the OS_StopCntrWakeup_1ms_Task" UWORD RB_RBA_Common_CentralElements_CompuMethods_Identical 1 100 0.0 65535. FORMAT "%5.0" ECU_ADDRESS 0x60015AB6 /end MEASUREMENT
/begin MEASUREMENT rba_OsShell_CntrStopCntrWakeup20msTask "OS task counter for the OS_StopCntrWakeup_20ms_Task" UWORD RB_RBA_Common_CentralElements_CompuMethods_Identical 1 100 0.0 65535. FORMAT "%5.0" ECU_ADDRESS 0x50008410 /end MEASUREMENT
/begin MEASUREMENT rba_OsShell_CntrStopCntrWakeup2msTask "OS task counter for the OS_StopCntrWakeup_2ms_Task" UWORD RB_RBA_Common_CentralElements_CompuMethods_Identical 1 100 0.0 65535. FORMAT "%5.0" ECU_ADDRESS 0x60015AC6 /end MEASUREMENT
/begin MEASUREMENT rba_OsShell_CntrStopCntrWakeup5msTask "OS task counter for the OS_StopCntrWakeup_5ms_Task" UWORD RB_RBA_Common_CentralElements_CompuMethods_Identical 1 100 0.0 65535. FORMAT "%5.0" ECU_ADDRESS 0x60015ACA /end MEASUREMENT
/begin MEASUREMENT rba_OsShell_CntrStopCntrWakeupAsw110msTask "OS task counter for the OS_StopCntrWakeupAsw1_10ms_Task" UWORD RB_RBA_Common_CentralElements_CompuMethods_Identical 1 100 0.0 65535. FORMAT "%5.0" ECU_ADDRESS 0x60015ACE /end MEASUREMENT
/begin MEASUREMENT rba_OsShell_CntrStopCntrWakeupAsw1BgTask "OS task counter for the OS_StopCntrWakeup_Asw1Bg_Task" UWORD RB_RBA_Common_CentralElements_CompuMethods_Identical 1 100 0.0 65535. FORMAT "%5.0" ECU_ADDRESS 0x60015AEA /end MEASUREMENT
/begin MEASUREMENT rba_OsShell_CntrStopCntrWakeupAsw210msTask "OS task counter for the OS_StopCntrWakeupAsw2_10ms_Task" UWORD RB_RBA_Common_CentralElements_CompuMethods_Identical 1 100 0.0 65535. FORMAT "%5.0" ECU_ADDRESS 0x50008416 /end MEASUREMENT
/begin MEASUREMENT rba_OsShell_CntrStopCntrWakeupAsw2BgTask "OS task counter for the OS_StopCntrWakeup_Asw2Bg_Task" UWORD RB_RBA_Common_CentralElements_CompuMethods_Identical 1 100 0.0 65535. FORMAT "%5.0" ECU_ADDRESS 0x5000841E /end MEASUREMENT
/begin MEASUREMENT rba_OsShell_CntrStopCntrWakeupIniEndTask "OS task counter for the OS_StopCntrWakeup_IniEnd_Task" UWORD RB_RBA_Common_CentralElements_CompuMethods_Identical 1 100 0.0 65535. FORMAT "%5.0" ECU_ADDRESS 0x60015AE8 /end MEASUREMENT
/begin MEASUREMENT rba_OsShell_CntrStopCntrWakeupIniTask "OS task counter for the OS_StopCntrWakeup_Ini_Task" UWORD RB_RBA_Common_CentralElements_CompuMethods_Identical 1 100 0.0 65535. FORMAT "%5.0" ECU_ADDRESS 0x60015AE6 /end MEASUREMENT
/begin MEASUREMENT rba_OsShell_CntrSyncFirstTask "OS task counter for the OS_SyncFirst_Task" UWORD RB_RBA_Common_CentralElements_CompuMethods_Identical 1 100 0.0 65535. FORMAT "%5.0" ECU_ADDRESS 0x5000840E /end MEASUREMENT
/begin MEASUREMENT rba_OsShell_CntrSyncIniTask "OS task counter for the OS_SyncIni_Task" UWORD RB_RBA_Common_CentralElements_CompuMethods_Identical 1 100 0.0 65535. FORMAT "%5.0" ECU_ADDRESS 0x5000840C /end MEASUREMENT
/begin MEASUREMENT rba_OsShell_CntrSyncPreTask "OS task counter for the OS_SyncPre_Task" UWORD RB_RBA_Common_CentralElements_CompuMethods_Identical 1 100 0.0 65535. FORMAT "%5.0" ECU_ADDRESS 0x5000840A /end MEASUREMENT
/begin MEASUREMENT rba_OsShell_CntrSyncS0Task "OS task counter for the OS_SyncS0_Task" UWORD RB_RBA_Common_CentralElements_CompuMethods_Identical 1 100 0.0 65535. FORMAT "%5.0" ECU_ADDRESS 0x50008408 /end MEASUREMENT
/begin MEASUREMENT rba_OsShell_CntrSyncS1Task "OS task counter for the OS_SyncS1_Task" UWORD RB_RBA_Common_CentralElements_CompuMethods_Identical 1 100 0.0 65535. FORMAT "%5.0" ECU_ADDRESS 0x50008406 /end MEASUREMENT
/begin MEASUREMENT rba_OsShell_cntrErrAccess "OS E_OS_ACCESS error counter" UBYTE RB_RBA_Common_CentralElements_CompuMethods_Identical 1 100 0.0 255. FORMAT "%5.0" ECU_ADDRESS 0x60011262 /end MEASUREMENT
/begin MEASUREMENT rba_OsShell_cntrErrCallevel "OS E_OS_CALLEVEL error counter" UBYTE RB_RBA_Common_CentralElements_CompuMethods_Identical 1 100 0.0 255. FORMAT "%5.0" ECU_ADDRESS 0x60011261 /end MEASUREMENT
/begin MEASUREMENT rba_OsShell_cntrErrId "OS E_OS_ID error counter" UBYTE RB_RBA_Common_CentralElements_CompuMethods_Identical 1 100 0.0 255. FORMAT "%5.0" ECU_ADDRESS 0x60011260 /end MEASUREMENT
/begin MEASUREMENT rba_OsShell_cntrErrLimitSum "OS E_OS_LIMIT error counter" UBYTE RB_RBA_Common_CentralElements_CompuMethods_Identical 1 100 0.0 255. FORMAT "%5.0" ECU_ADDRESS 0x6001125F /end MEASUREMENT
/begin MEASUREMENT rba_OsShell_cntrErrNoFunc "OS E_OS_NOFUNC error counter" UBYTE RB_RBA_Common_CentralElements_CompuMethods_Identical 1 100 0.0 255. FORMAT "%5.0" ECU_ADDRESS 0x6001125E /end MEASUREMENT
/begin MEASUREMENT rba_OsShell_cntrErrResource "OS E_OS_RESOURCE error counter" UBYTE RB_RBA_Common_CentralElements_CompuMethods_Identical 1 100 0.0 255. FORMAT "%5.0" ECU_ADDRESS 0x6001125D /end MEASUREMENT
/begin MEASUREMENT rba_OsShell_cntrErrState "OS E_OS_STATE error counter" UBYTE RB_RBA_Common_CentralElements_CompuMethods_Identical 1 100 0.0 255. FORMAT "%5.0" ECU_ADDRESS 0x6001125C /end MEASUREMENT
/begin MEASUREMENT rba_OsShell_cntrErrSum "OS overall error counter" UBYTE RB_RBA_Common_CentralElements_CompuMethods_Identical 1 100 0.0 255. FORMAT "%5.0" ECU_ADDRESS 0x60011247 /end MEASUREMENT
/begin MEASUREMENT rba_OsShell_cntrErrValue "OS E_OS_VALUE error counter" UBYTE RB_RBA_Common_CentralElements_CompuMethods_Identical 1 100 0.0 255. FORMAT "%5.0" ECU_ADDRESS 0x6001125B /end MEASUREMENT
/begin MEASUREMENT rba_OsShell_tiPowerOnFrst10ms "Time from last Power on Reset to first 10ms-Raster" UWORD RB_RBA_Common_CentralElements_CompuMethods_Identical 1 100 0.0 65535. FORMAT "%5.0" ECU_ADDRESS 0x6000A70E /end MEASUREMENT
/begin MEASUREMENT rba_OsShell_tiResetFrst10ms "Time from last Reset to first 10ms-Raster" UWORD RB_RBA_Common_CentralElements_CompuMethods_Identical 1 100 0.0 65535. FORMAT "%5.0" ECU_ADDRESS 0x6000A710 /end MEASUREMENT
/begin MEASUREMENT rba_SyC_ObservationCounters_IrrSwOffTrigEngRun_Value_MP "ObservationCounter: Irregular Switch Off Counter Triggered by Engine Running" UBYTE DefaultIdenticalCompu 1 100 0.0 255.0 ECU_ADDRESS 0x7000A934
 /begin ANNOTATION ANNOTATION_LABEL "Description (coming from AUTOSAR DESC field)"
  /begin ANNOTATION_TEXT "ObservationCounter: Irregular Switch Off Counter Triggered by Engine Running\r\n" /end ANNOTATION_TEXT
 /end ANNOTATION
/end MEASUREMENT
/begin MEASUREMENT rba_SyC_ObservationCounters_IrrSwOff_Value_MP "ObservationCounter: Irregular SwitchOff Counter" UBYTE DefaultIdenticalCompu 1 100 0.0 255.0 ECU_ADDRESS 0x7000A935
 /begin ANNOTATION ANNOTATION_LABEL "Description (coming from AUTOSAR DESC field)" /begin ANNOTATION_TEXT "ObservationCounter: Irregular SwitchOff Counter\r\n" /end ANNOTATION_TEXT /end ANNOTATION
/end MEASUREMENT
/begin MEASUREMENT rba_SyC_PowerOn_Reasons_MP "Switch on reasons of the ECU" UBYTE DefaultIdenticalCompu 1 100 0.0 255.0 ECU_ADDRESS 0x7000A961
 /begin ANNOTATION ANNOTATION_LABEL "Description (coming from AUTOSAR DESC field)" /begin ANNOTATION_TEXT "Switch on reasons of the ECU\r\n" /end ANNOTATION_TEXT /end ANNOTATION
/end MEASUREMENT
/begin MEASUREMENT rba_SyC_Rtc_EcuOffTime_Validity_MP "Indicate the validity of the ECU Off Time" UBYTE RB_RBA_rba_SyC_Rtc_BswModuleDescriptions_rba_SyC_Rtc_EcuOffTime_CompuMethod 1 100 0.0 11.000 FORMAT "%8.3" ECU_ADDRESS 0x7000A962
 /begin ANNOTATION ANNOTATION_LABEL "Description (coming from AUTOSAR DESC field)" /begin ANNOTATION_TEXT "Indicate the validity of the ECU Off Time\r\n" /end ANNOTATION_TEXT /end ANNOTATION
/end MEASUREMENT
/begin MEASUREMENT rba_SyC_Rtc_EcuOffTime_Value_MP "ECU Off Time in seconds" ULONG DefaultIdenticalCompu 1 100 0.0 4.294967295E9 ECU_ADDRESS 0x7000A930
 /begin ANNOTATION ANNOTATION_LABEL "Description (coming from AUTOSAR DESC field)" /begin ANNOTATION_TEXT "ECU Off Time in seconds\r\n" /end ANNOTATION_TEXT /end ANNOTATION
/end MEASUREMENT
/begin MEASUREMENT ACClntP_bCodAvl "Codinginformation" UBYTE B_TRUE 1 100 0.00 1.00000000000 BIT_MASK 0x1 FORMAT "%13.11" ECU_ADDRESS 0x6000FB11 /end MEASUREMENT
/begin MEASUREMENT ACCmpr_flgPsCmprDes "Desired compressor state" UBYTE B_TRUE 1 100 0.00 1.00000000000 BIT_MASK 0x1 FORMAT "%13.11" ECU_ADDRESS 0x70000438 /end MEASUREMENT
/begin MEASUREMENT ACComp_facCmprPCorrn "Enthalpy correction using coolant pressure" SLONG Fact_10000 1 100 -214748.364800 214748.364700 FORMAT "%13.6" ECU_ADDRESS 0x60003280 /end MEASUREMENT
/begin MEASUREMENT ACComp_facCmprSpdCorrn_MP "AC compressor speed correction" SLONG Fact_10000 1 100 -214748.364800 214748.364700 FORMAT "%13.6" ECU_ADDRESS 0x7000A904 /end MEASUREMENT
/begin MEASUREMENT ACComp_facCooltFlowQnty "Coefficient for calculating A/C refrigerant flow quantity" SWORD Fact1000 1 100 -32.76800 32.76700 FORMAT "%8.5" ECU_ADDRESS 0x60008330 /end MEASUREMENT
/begin MEASUREMENT ACComp_facEnthpyCorrnA "Enthalpy Correction factor A" SLONG Fact_10000 1 100 -214748.364800 214748.364700 FORMAT "%13.6" ECU_ADDRESS 0x50001098 /end MEASUREMENT
/begin MEASUREMENT ACComp_facEnthpyCorrnB "Enthalpy Correction Factor" SLONG Fact_10000 1 100 -214748.364800 214748.364700 FORMAT "%13.6" ECU_ADDRESS 0x5000109C /end MEASUREMENT
/begin MEASUREMENT ACComp_facHwOffResv "AC HW off torque reserve factor" SWORD fak_q0p01 1 100 0.00 327.6700 FORMAT "%8.4" ECU_ADDRESS 0x6000832E /end MEASUREMENT
/begin MEASUREMENT ACComp_facOutdTAftCorrnA_MP "Calculated outside temperature after correction (A value)" SLONG Fact_10000 1 100 -214748.364800 214748.364700 FORMAT "%13.6" ECU_ADDRESS 0x7000A900 /end MEASUREMENT
/begin MEASUREMENT ACComp_facOutdTAftCorrn_MP "Correction term for outside temperature sensor value" SLONG Fact_10000 1 100 -214748.364800 214748.364700 FORMAT "%13.6" ECU_ADDRESS 0x7000A8FC /end MEASUREMENT
/begin MEASUREMENT ACComp_facPWithCoeffB_MP "AC coolant pressure with Coefficient B" SLONG Fact_10000 1 100 -214748.364800 214748.364700 FORMAT "%13.6" ECU_ADDRESS 0x7000A8F8 /end MEASUREMENT
/begin MEASUREMENT ACComp_facSolCurrCorrn_MP "AC solinoid current correction" SLONG Fact_10000 1 100 -214748.364800 214748.364700 FORMAT "%13.6" ECU_ADDRESS 0x7000A8F4 /end MEASUREMENT
/begin MEASUREMENT ACComp_facSpdWithCoeffA_MP "Engine speed with Coefficient A" SLONG Fact_10000 1 100 -214748.364800 214748.364700 FORMAT "%13.6" ECU_ADDRESS 0x7000A8F0 /end MEASUREMENT
/begin MEASUREMENT ACComp_facTCorrnWithP_MP "Outside temperature correction with pressure" SLONG Fact_10000 1 100 -214748.364800 214748.364700 FORMAT "%13.6" ECU_ADDRESS 0x7000A8EC /end MEASUREMENT
/begin MEASUREMENT ACComp_facTemp18 "Correction term for enthalpy calculation for variable compressor" SLONG Fact_10000 1 100 -214748.364800 214748.364700 FORMAT "%13.6" ECU_ADDRESS 0x6000327C /end MEASUREMENT
/begin MEASUREMENT ACComp_facTemp21 "Correction term for enthalpy calculation for variable compressor" SLONG Fact_10000 1 100 -214748.364800 214748.364700 FORMAT "%13.6" ECU_ADDRESS 0x60003278 /end MEASUREMENT
/begin MEASUREMENT ACComp_facTemp25 "Correction term for outside temperature sensor value calculation" SLONG Fact_10000 1 100 -214748.364800 214748.364700 FORMAT "%13.6" ECU_ADDRESS 0x60003274 /end MEASUREMENT
/begin MEASUREMENT ACComp_facTemp30 "Correction term for outside temperature sensor value calculation" SLONG Fact_10000 1 100 -214748.364800 214748.364700 FORMAT "%13.6" ECU_ADDRESS 0x60003270 /end MEASUREMENT
/begin MEASUREMENT ACComp_facTrq_MP "AC compressor torque" SLONG Fact_10000 1 100 -214748.364800 214748.364700 FORMAT "%13.6" ECU_ADDRESS 0x7000A8E8 /end MEASUREMENT
/begin MEASUREMENT ACComp_flgACOn_MP "Flag to indicate AC on." UBYTE B_TRUE 1 100 0.00 1.00000000000 BIT_MASK 0x1 FORMAT "%13.11" ECU_ADDRESS 0x7000A8E4 /end MEASUREMENT
/begin MEASUREMENT ACComp_flgFirstStrtUpEnd "Judgement of first starting-up is end" UBYTE B_TRUE 1 100 0.00 1.00000000000 BIT_MASK 0x1 FORMAT "%13.11" ECU_ADDRESS 0x6000F239 /end MEASUREMENT
/begin MEASUREMENT ACComp_flgFirstStrtUpStart "Judgement of first starting-up is start" UBYTE B_TRUE 1 100 0.00 1.00000000000 BIT_MASK 0x1 FORMAT "%13.11" ECU_ADDRESS 0x6000F238 /end MEASUREMENT
/begin MEASUREMENT ACComp_flgOutdTFrstCalc "Status of outside temperature first calculation" UBYTE B_TRUE 1 100 0.00 1.00000000000 BIT_MASK 0x1 FORMAT "%13.11" ECU_ADDRESS 0x6000F237 /end MEASUREMENT
/begin MEASUREMENT ACComp_flgRampDwnActv "downwards torque ramping active" UBYTE B_TRUE 1 100 0.00 1.00000000000 BIT_MASK 0x1 FORMAT "%13.11" ECU_ADDRESS 0x6000F236 /end MEASUREMENT
/begin MEASUREMENT ACComp_flgRampDwnActv1 "downwards torque ramping active" UBYTE B_TRUE 1 100 0.00 1.00000000000 BIT_MASK 0x1 FORMAT "%13.11" ECU_ADDRESS 0x6000F235 /end MEASUREMENT
/begin MEASUREMENT ACComp_flgRampUpActv "upwards torque ramping active" UBYTE B_TRUE 1 100 0.00 1.00000000000 BIT_MASK 0x1 FORMAT "%13.11" ECU_ADDRESS 0x6000F234 /end MEASUREMENT
/begin MEASUREMENT ACComp_flgRampUpActv1 "upwards torque ramping active" UBYTE B_TRUE 1 100 0.00 1.00000000000 BIT_MASK 0x1 FORMAT "%13.11" ECU_ADDRESS 0x6000F233 /end MEASUREMENT
/begin MEASUREMENT ACComp_flgTqOffsVehV "aircondation compressor flag trouqe offset vechical speed" UBYTE B_TRUE 1 100 0.00 1.00000000000 BIT_MASK 0x1 FORMAT "%13.11" ECU_ADDRESS 0x6000F232 /end MEASUREMENT
/begin MEASUREMENT ACComp_flgVblDplCmprJdg "Variable displacement compressor enable flag" UBYTE B_TRUE 1 100 0.00 1.00000000000 BIT_MASK 0x1 FORMAT "%13.11" ECU_ADDRESS 0x6000FB10 /end MEASUREMENT
/begin MEASUREMENT ACComp_iCmprSol "Compressor volume control current value" UWORD i_q1_mA 1 100 0.00 65535.00 FORMAT "%8.2" ECU_ADDRESS 0x600095A0 /end MEASUREMENT
/begin MEASUREMENT ACComp_mCalcdFlowQnty_MP "AC coolant calculated flow quantity" SLONG InjMsPrTime_q0p001_COMPU 1 100 -2147483.64800 2147483.64700 FORMAT "%13.5" ECU_ADDRESS 0x7000A8E0 /end MEASUREMENT
/begin MEASUREMENT ACComp_mCooltFlowQnty "AC refrigerant flow quantity calculated value" SLONG InjMsPrTime_q0p001_COMPU 1 100 -2147483.64800 2147483.64700 FORMAT "%13.5" ECU_ADDRESS 0x500010A0 /end MEASUREMENT
/begin MEASUREMENT ACComp_mMinCooltFlowQnty "Minimum refrigerant flow quantity" SWORD O2MassPerTime 1 100 -327.6800 327.6700 FORMAT "%8.4" ECU_ADDRESS 0x6000832C /end MEASUREMENT
/begin MEASUREMENT ACComp_nEngCor_mp "measurement point for corrected engine speed" SWORD EngN 1 100 -16384.00 16383.50 FORMAT "%8.2" ECU_ADDRESS 0x7000A8DE /end MEASUREMENT
/begin MEASUREMENT ACComp_pACClntpDiff_MP "Difference between pressure at previous AC engagement and current pressure" SWORD PresAC_hPa 1 100 -65536.00 65534.00 FORMAT "%8.2" ECU_ADDRESS 0x7000A8DC /end MEASUREMENT
/begin MEASUREMENT ACComp_pClnt "AC compressor collant pressure" SWORD RBPtCel_p_1p0_3 1 100 -32768.00 32767.00 FORMAT "%8.2" ECU_ADDRESS 0x6000832A /end MEASUREMENT
/begin MEASUREMENT ACComp_pClntClthOff "AC coolant pressure when clutch is opened" SWORD PresAC_hPa 1 100 -65536.00 65534.00 FORMAT "%8.2" ECU_ADDRESS 0x60008328 /end MEASUREMENT
/begin MEASUREMENT ACComp_pClntCtrlVal "PD pressure value for control(absolute pressure)" SWORD RBPtCel_p_1p0_3 1 100 -32768.00 32767.00 FORMAT "%8.2" ECU_ADDRESS 0x60008326 /end MEASUREMENT
/begin MEASUREMENT ACComp_pLoPVal "Low Pressure value" SWORD RBPtCel_p_1p0_3 1 100 -32768.00 32767.00 FORMAT "%8.2" ECU_ADDRESS 0x60009C80 /end MEASUREMENT
/begin MEASUREMENT ACComp_rFanSt "Radiator fan driving mode" SLONG q0p0001_Perc 1 100 -214748.364800 214748.364700 FORMAT "%13.6" ECU_ADDRESS 0x6000326C /end MEASUREMENT
/begin MEASUREMENT ACComp_rFanStCalcdVal "The operating state calculated value of RADCOND FAN" SLONG q0p0001_Perc 1 100 -214748.364800 214748.364700 FORMAT "%13.6" ECU_ADDRESS 0x60003268 /end MEASUREMENT
/begin MEASUREMENT ACComp_rFanStCorrnVal_MP "Fan state correction value." SLONG q0p0001_Perc 1 100 -214748.364800 214748.364700 FORMAT "%13.6" ECU_ADDRESS 0x7000A8D8 /end MEASUREMENT
/begin MEASUREMENT ACComp_rPrevFanStCalcdVal "The operating state calculated value of RADCOND FAN (last time value)" SLONG q0p0001_Perc 1 100 -214748.364800 214748.364700 FORMAT "%13.6" ECU_ADDRESS 0x60003264 /end MEASUREMENT
/begin MEASUREMENT ACComp_rPrevStCorrnVal_MP "Fan previous state correction value" SLONG q0p0001_Perc 1 100 -214748.364800 214748.364700 FORMAT "%13.6" ECU_ADDRESS 0x7000A8D4 /end MEASUREMENT
/begin MEASUREMENT ACComp_rWindVWghtAvrg "calculated the wind velocity by weighted average throughout condenser." SWORD Prc_Fact100 1 100 -327.6800 327.6700 FORMAT "%8.4" ECU_ADDRESS 0x60008324 /end MEASUREMENT
/begin MEASUREMENT ACComp_stFanStInitCalcn "Finishing of the initial calculation of a RAD/COND FAN operating state by 1." UBYTE B_TRUE 1 100 0.00 1.00000000000 BIT_MASK 0x1 FORMAT "%13.11" ECU_ADDRESS 0x6000F231 /end MEASUREMENT
/begin MEASUREMENT ACCOmp_stOutdTActvCdn_MP "Status for enabling outside temperature calculation preparation" UBYTE B_TRUE 1 100 0.00 1.00000000000 BIT_MASK 0x1 FORMAT "%13.11" ECU_ADDRESS 0x7000A8D1 /end MEASUREMENT
/begin MEASUREMENT ACComp_stOutdTCalcnPrms "Status for enabling outside temperature calculation permission" UBYTE B_TRUE 1 100 0.00 1.00000000000 BIT_MASK 0x1 FORMAT "%13.11" ECU_ADDRESS 0x6000F230 /end MEASUREMENT
/begin MEASUREMENT ACComp_stTrqCalcnEna_MP "Status of AC compressor torque calculation enable" UBYTE B_TRUE 1 100 0.00 1.00000000000 BIT_MASK 0x1 FORMAT "%13.11" ECU_ADDRESS 0x7000A8D0 /end MEASUREMENT
/begin MEASUREMENT ACComp_stVehSpdTmrRst "Status of Vehicle speed timer reset at 0." UBYTE B_TRUE 1 100 0.00 1.00000000000 BIT_MASK 0x1 FORMAT "%13.11" ECU_ADDRESS 0x6000F22F /end MEASUREMENT
/begin MEASUREMENT ACComp_tActOutdT "Outside temperature(actual value)" SWORD Temp_Cels 1 100 -3549.940 3003.560 FORMAT "%8.3" ECU_ADDRESS 0x60008322 /end MEASUREMENT
/begin MEASUREMENT ACComp_tCalcdIdleOutdT "Outside temperature (Correction term of RAD/COND FAN, ACPDABS)" SWORD Temp_Cels 1 100 -3549.940 3003.560 FORMAT "%8.3" ECU_ADDRESS 0x60008320 /end MEASUREMENT
/begin MEASUREMENT ACComp_tCalcdOutdT "Outside temperature(Finishing of processing)" SWORD Temp_Cels 1 100 -3549.940 3003.560 FORMAT "%8.3" ECU_ADDRESS 0x600397D4 /end MEASUREMENT
/begin MEASUREMENT ACComp_tCmprEnthIdealAdbt "Compressor enthalpy at AC ideal adiabatic" SWORD RBPtCel_t_0p01_2 1 100 -327.6800 327.6700 FORMAT "%8.4" ECU_ADDRESS 0x6000831E /end MEASUREMENT
/begin MEASUREMENT ACComp_tCooltSatnT "AC coolant saturation temperature" SWORD Temp_Cels 1 100 -3549.940 3003.560 FORMAT "%8.3" ECU_ADDRESS 0x6000831C /end MEASUREMENT
/begin MEASUREMENT ACComp_tiACOffTime "duration since last AC off detected" SWORD t_q0p02 1 100 -655.3600 655.3400 FORMAT "%8.4" ECU_ADDRESS 0x6000831A /end MEASUREMENT
/begin MEASUREMENT ACComp_tiCmprStrtPClnt "AC variable volume compressor start-up time based on coolant pressure" SWORD Time_ms 1 100 -327680.0 327670.0 FORMAT "%8.1" ECU_ADDRESS 0x60008318 /end MEASUREMENT
/begin MEASUREMENT ACComp_tiCmprStrtUp1 "AC variable volume compressor start-up time." SWORD Time_ms 1 100 -327680.0 327670.0 FORMAT "%8.1" ECU_ADDRESS 0x60008316 /end MEASUREMENT
/begin MEASUREMENT ACComp_tiCmprVolCtrlStrt "The time of a compressor volume control is start" SWORD Time_ms 1 100 -327680.0 327670.0 FORMAT "%8.1" ECU_ADDRESS 0x60008314 /end MEASUREMENT
/begin MEASUREMENT ACComp_tiOnDlyT1 "Delay time after AC ON from which torque offset starts ramping up" SWORD t_q0p02 1 100 -655.3600 655.3400 FORMAT "%8.4" ECU_ADDRESS 0x60008312 /end MEASUREMENT
/begin MEASUREMENT ACComp_tiOnDlyT2 "Delay time after AC ON from which torque offset starts ramping down" SWORD t_q0p02 1 100 -655.3600 655.3400 FORMAT "%8.4" ECU_ADDRESS 0x60008310 /end MEASUREMENT
/begin MEASUREMENT ACComp_tiOnDlyT3 "Delay time after AC ON from which torque offset starts ramping up" SWORD t_q0p02 1 100 -655.3600 655.3400 FORMAT "%8.4" ECU_ADDRESS 0x6000830E /end MEASUREMENT
/begin MEASUREMENT ACComp_tiOnDlyT4 "Delay time after AC ON from which torque offset starts ramping up" SWORD t_q0p02 1 100 -655.3600 655.3400 FORMAT "%8.4" ECU_ADDRESS 0x6000830C /end MEASUREMENT
/begin MEASUREMENT ACComp_tOutdT "Outside temperature" SWORD Temp_Cels 1 100 -3549.940 3003.560 FORMAT "%8.3" ECU_ADDRESS 0x6000830A /end MEASUREMENT
/begin MEASUREMENT ACComp_tqACModel_MP "measurement point for modelled torque without additional offset" SWORD Trq 1 100 -3276.800 3276.700 FORMAT "%8.3" ECU_ADDRESS 0x7000A8CE /end MEASUREMENT
/begin MEASUREMENT ACComp_tqCmprFullCpTq "The value which presumed AC compressor torque(at 100% volume)" SWORD Trq 1 100 -3276.800 3276.700 FORMAT "%8.3" ECU_ADDRESS 0x60008308 /end MEASUREMENT
/begin MEASUREMENT ACComp_tqCorrnMax "Interface for torque calculation correction term at Ps control valve (at MAX capacity)" SLONG Trq 1 100 -214748364.800 214748364.700 FORMAT "%13.3" ECU_ADDRESS 0x60003260 /end MEASUREMENT
/begin MEASUREMENT ACComp_tqEstimd1TqStat "Estimated AC compressor torque. (stagnation term)" SWORD Trq 1 100 -3276.800 3276.700 FORMAT "%8.3" ECU_ADDRESS 0x60008306 /end MEASUREMENT
/begin MEASUREMENT ACComp_tqEstimd2TqStrt "Estimated AC compressor torque. (start-up term)" SWORD Trq 1 100 -3276.800 3276.700 FORMAT "%8.3" ECU_ADDRESS 0x60008304 /end MEASUREMENT
/begin MEASUREMENT ACComp_tqEstimdACCmpr "Estimated AC compressor torque" SWORD Trq 1 100 -3276.800 3276.700 FORMAT "%8.3" ECU_ADDRESS 0x60008302 /end MEASUREMENT
/begin MEASUREMENT ACComp_tqEvaprSnsrValB "Interface for calculating Evaporator torque at Ps control valve(B term)" SWORD Trq 1 100 -3276.800 3276.700 FORMAT "%8.3" ECU_ADDRESS 0x60008300 /end MEASUREMENT
/begin MEASUREMENT ACComp_tqEvaprSnsrValC "Interface for calculating Evaporator torque in the time of compressor MAX capacity (C term)" SWORD Trq 1 100 -3276.800 3276.700 FORMAT "%8.3" ECU_ADDRESS 0x600082FE /end MEASUREMENT
/begin MEASUREMENT ACComp_tqEvaprTCorrn "Interface for EVA temperature torque calculation correction term in Ps control valve" SLONG Trq 1 100 -214748364.800 214748364.700 FORMAT "%13.3" ECU_ADDRESS 0x6000325C /end MEASUREMENT
/begin MEASUREMENT ACComp_tqHardTmp "AC off hard temporary torque reserve" SWORD Trq 1 100 -3276.800 3276.700 FORMAT "%8.3" ECU_ADDRESS 0x600082FC /end MEASUREMENT
/begin MEASUREMENT ACComp_tqHwOffResv "AC HW off torque reserve" SWORD Trq 1 100 -3276.800 3276.700 FORMAT "%8.3" ECU_ADDRESS 0x600082FA /end MEASUREMENT
/begin MEASUREMENT ACComp_tqOffsFinal "final calculated torque" SWORD Trq 1 100 -3276.800 3276.700 FORMAT "%8.3" ECU_ADDRESS 0x600082F8 /end MEASUREMENT
/begin MEASUREMENT ACComp_tqOffsFinal1 "final calculated torque" SWORD Trq 1 100 -3276.800 3276.700 FORMAT "%8.3" ECU_ADDRESS 0x600082F6 /end MEASUREMENT
/begin MEASUREMENT ACComp_tqOffsReqd "Offset torque pre ramped value" SWORD Trq 1 100 -3276.800 3276.700 FORMAT "%8.3" ECU_ADDRESS 0x600082F4 /end MEASUREMENT
/begin MEASUREMENT ACComp_tqOffsReqd1 "final calculated torque" SWORD Trq 1 100 -3276.800 3276.700 FORMAT "%8.3" ECU_ADDRESS 0x600082F2 /end MEASUREMENT
/begin MEASUREMENT ACComp_tqPSnsrCtrlValTq "Torque calculated value by Ps control value" SWORD Trq 1 100 -3276.800 3276.700 FORMAT "%8.3" ECU_ADDRESS 0x600082F0 /end MEASUREMENT
/begin MEASUREMENT ACComp_tqStrtgCtrlCmprTq "The value which presumed AC compressor torque(at starting control)" SWORD Trq 1 100 -3276.800 3276.700 FORMAT "%8.3" ECU_ADDRESS 0x600082EE /end MEASUREMENT
/begin MEASUREMENT ACComp_tqSwOffResv "AC Off torque reserve" SWORD Trq 1 100 -3276.800 3276.700 FORMAT "%8.3" ECU_ADDRESS 0x600082EC /end MEASUREMENT
/begin MEASUREMENT ACComp_trqDesFltAbv_mp "desired torque filtered" SWORD Trq 1 100 -3276.800 3276.700 FORMAT "%8.3" ECU_ADDRESS 0x7000A8CC /end MEASUREMENT
/begin MEASUREMENT ACComp_trqDesFlt_mp "desired torque filtered" SWORD Trq 1 100 -3276.800 3276.700 FORMAT "%8.3" ECU_ADDRESS 0x7000A8CA /end MEASUREMENT
/begin MEASUREMENT ACComp_trqDyn_mp "dynamic torque" SWORD Trq 1 100 -3276.800 3276.700 FORMAT "%8.3" ECU_ADDRESS 0x7000A8C8 /end MEASUREMENT
/begin MEASUREMENT ACComp_trqOffsRamped "Offset torque after ramping" SWORD Trq 1 100 -3276.800 3276.700 FORMAT "%8.3" ECU_ADDRESS 0x600082EA /end MEASUREMENT
/begin MEASUREMENT ACComp_trqOffsRamped1 "Offset torque after ramping" SWORD Trq 1 100 -3276.800 3276.700 FORMAT "%8.3" ECU_ADDRESS 0x600082E8 /end MEASUREMENT
/begin MEASUREMENT ACComp_trqStat "Static AC compressor torque" SWORD Trq 1 100 -3276.800 3276.700 FORMAT "%8.3" ECU_ADDRESS 0x60009C7E /end MEASUREMENT
/begin MEASUREMENT ACComp_tSeldTrqOffs "Air Condation compressor time selected troque off set" SWORD Temp_Cels 1 100 -3549.940 3003.560 FORMAT "%8.3" ECU_ADDRESS 0x600082E6 /end MEASUREMENT
/begin MEASUREMENT ACComp_tVblCpCmprEnth "AC variable capacity Compressor enthalpy" SLONG RBPtCel_t_0p0001_1 1 100 -214748.364800 214748.364700 FORMAT "%13.6" ECU_ADDRESS 0x500010A4 /end MEASUREMENT
/begin MEASUREMENT AccPed_cntrPostDrvLve "AccPed counter post drive leave" UBYTE OneToOne 1 100 0.00 255.0 FORMAT "%5.1" ECU_ADDRESS 0x6000F22D /end MEASUREMENT
/begin MEASUREMENT AccPed_facAppMaxCmp "Compensation factor based on the driver demand" SWORD Fact 1 100 -4.000000 3.999878 FORMAT "%8.6" ECU_ADDRESS 0x600082E4 /end MEASUREMENT
/begin MEASUREMENT AccPed_facCompAcs "Compensation factor for loss compensation" SWORD Fact 1 100 -4.000000 3.999878 FORMAT "%8.6" ECU_ADDRESS 0x60009C20 /end MEASUREMENT
/begin MEASUREMENT AccPed_facModSwt "Factor for ramping of torque value during change in drive mode" SLONG Fact 1 100 -262144.000000 262143.999878 FORMAT "%13.6" ECU_ADDRESS 0x60003A50 /end MEASUREMENT
/begin MEASUREMENT AccPed_facModSwtStep "Factor for step change in slope used for ramping of torque during change in drive mode" SLONG Fact 1 100 -262144.000000 262143.999878 FORMAT "%13.6" ECU_ADDRESS 0x6000324C /end MEASUREMENT
/begin MEASUREMENT AccPed_flgChgGearDetn "Flag of gear change detection" UBYTE B_TRUE 1 100 0.00 1.00000000000 BIT_MASK 0x1 FORMAT "%13.11" ECU_ADDRESS 0x6000FADF /end MEASUREMENT
/begin MEASUREMENT AccPed_flgDrvModChg "Flag indicating driver mode change" UBYTE B_TRUE 1 100 0.00 1.00000000000 BIT_MASK 0x1 FORMAT "%13.11" ECU_ADDRESS 0x6000FADE /end MEASUREMENT
/begin MEASUREMENT AccPed_flgIDSDrvModFailr "Status of system failure detection for IDS inhibition" UBYTE B_TRUE 1 100 0.00 1.00000000000 BIT_MASK 0x1 FORMAT "%13.11" ECU_ADDRESS 0x6000FADD /end MEASUREMENT
/begin MEASUREMENT AccPed_flgIDSDrvModTmpInhb "IDS temporary inhibit flag" UBYTE B_TRUE 1 100 0.00 1.00000000000 BIT_MASK 0x1 FORMAT "%13.11" ECU_ADDRESS 0x6000FADC /end MEASUREMENT
/begin MEASUREMENT AccPed_nMax "Maximum engine speed in case of an accelerator pedal error" SWORD EngN 1 100 -16384.00 16383.50 FORMAT "%8.2" ECU_ADDRESS 0x60009C1E /end MEASUREMENT
/begin MEASUREMENT AccPed_nMin "Low idle setpoint on acceleration pedal error" SWORD EngN 1 100 -16384.00 16383.50 FORMAT "%8.2" ECU_ADDRESS 0x60009C1C /end MEASUREMENT
/begin MEASUREMENT AccPed_nrGearFildTmp "Filtered current gear information" UBYTE OneToOne 1 100 0.00 255.0 FORMAT "%5.1" ECU_ADDRESS 0x6000FFE9 /end MEASUREMENT
/begin MEASUREMENT AccPed_nrGearFildTmpPrev "Previous value of Filtered current gear information" UBYTE OneToOne 1 100 0.00 255.0 FORMAT "%5.1" ECU_ADDRESS 0x6000FFE8 /end MEASUREMENT
/begin MEASUREMENT AccPed_rTrq "Total drive train ratio of engine - wheel" SWORD TransR 1 100 -327.6800 327.6700 FORMAT "%8.4" ECU_ADDRESS 0x60009C1A /end MEASUREMENT
/begin MEASUREMENT AccPed_stDrvModPrev "Previous drive mode information used as reference to calculate old torque and to ramp to new torque based on new driving mode" UBYTE OneToOne 1 100 0.00 255.0 FORMAT "%5.1" ECU_ADDRESS 0x6000FFE7 /end MEASUREMENT
/begin MEASUREMENT AccPed_stNSetP "Status of engine speed demand of driver demand interpretation" UBYTE OneToOne 1 100 0.00 255.0 FORMAT "%5.1" ECU_ADDRESS 0x6000FFE6 /end MEASUREMENT
/begin MEASUREMENT AccPed_stRampActv "Ramping active" UBYTE B_TRUE 1 100 0.00 1.00000000000 BIT_MASK 0x1 FORMAT "%13.11" ECU_ADDRESS 0x6000F22C /end MEASUREMENT
/begin MEASUREMENT AccPed_stVirtAppUsg "Condition to select input of Dynamic factor for driver demand" UBYTE B_TRUE 1 100 0.00 1.00000000000 BIT_MASK 0x1 FORMAT "%13.11" ECU_ADDRESS 0x6000F22E /end MEASUREMENT
/begin MEASUREMENT AccPed_swtDrvMod "Drive mode selection switch" UBYTE OneToOne 1 100 0.00 255.0 FORMAT "%5.1" ECU_ADDRESS 0x60039865 /end MEASUREMENT
/begin MEASUREMENT AccPed_swtDrvModCpl "DriveMode cpl for monitoring" UBYTE OneToOne 1 100 0.00 255.0 FORMAT "%5.1" ECU_ADDRESS 0x6000FFE5 /end MEASUREMENT
/begin MEASUREMENT AccPed_swtDrvModPrev "Previous drive mode selection switch information" UBYTE OneToOne 1 100 0.00 255.0 FORMAT "%5.1" ECU_ADDRESS 0x6000FFE4 /end MEASUREMENT
/begin MEASUREMENT AccPed_tqBasDif "Torque base difference" SWORD Trq 1 100 -3276.800 3276.700 FORMAT "%8.3" ECU_ADDRESS 0x600082DE /end MEASUREMENT
/begin MEASUREMENT AccPed_tqBasFild "Torque base filtered" SWORD Trq 1 100 -3276.800 3276.700 FORMAT "%8.3" ECU_ADDRESS 0x600082DC /end MEASUREMENT
/begin MEASUREMENT AccPed_tqBasFiveModNew "Driver demanded pull torque based on current five drive mode" SWORD Trq 1 100 -3276.800 3276.700 FORMAT "%8.3" ECU_ADDRESS 0x600082DA /end MEASUREMENT
/begin MEASUREMENT AccPed_tqBasFiveModOld "Driver demanded pull torque based on previous five drive mode" SWORD Trq 1 100 -3276.800 3276.700 FORMAT "%8.3" ECU_ADDRESS 0x600082D8 /end MEASUREMENT
/begin MEASUREMENT AccPed_tqBasMod1 "Torque base mode 1" SWORD Trq 1 100 -3276.800 3276.700 FORMAT "%8.3" ECU_ADDRESS 0x600082D6 /end MEASUREMENT
/begin MEASUREMENT AccPed_tqBasMod1MT "Torque base mode 1 MT" SWORD Trq 1 100 -3276.800 3276.700 FORMAT "%8.3" ECU_ADDRESS 0x600082D4 /end MEASUREMENT
/begin MEASUREMENT AccPed_tqBasMod2 "Torque base mode 2" SWORD Trq 1 100 -3276.800 3276.700 FORMAT "%8.3" ECU_ADDRESS 0x600082D2 /end MEASUREMENT
/begin MEASUREMENT AccPed_tqBasModNew "New base mode torque" SWORD Trq 1 100 -3276.800 3276.700 FORMAT "%8.3" ECU_ADDRESS 0x600082D0 /end MEASUREMENT
/begin MEASUREMENT AccPed_tqBasModOld "Old base mode torque" SWORD Trq 1 100 -3276.800 3276.700 FORMAT "%8.3" ECU_ADDRESS 0x600082CE /end MEASUREMENT
/begin MEASUREMENT AccPed_tqBasUnfild "Torque base unfiltered" SWORD Trq 1 100 -3276.800 3276.700 FORMAT "%8.3" ECU_ADDRESS 0x600082CC /end MEASUREMENT
/begin MEASUREMENT AccPed_tqCmpLossSum "Total losses (Inclusive of switchable and non-switchable losses) after compensation" SWORD Trq 1 100 -3276.800 3276.700 FORMAT "%8.3" ECU_ADDRESS 0x600082E2 /end MEASUREMENT
/begin MEASUREMENT AccPed_tqCmpNotSwilLoss "Loss compensated non-switchable losses" SLONG TrqPrpHigh 1 100 -214748364.800 214748364.700 FORMAT "%13.3" ECU_ADDRESS 0x60003258 /end MEASUREMENT
/begin MEASUREMENT AccPed_tqCmpSwilLoss "Switchable losses" SLONG Trq 1 100 -214748364.800 214748364.700 FORMAT "%13.3" ECU_ADDRESS 0x60003254 /end MEASUREMENT
/begin MEASUREMENT AccPed_tqCvtEcoEng0 "CVT eco mode torque 0" SWORD Trq 1 100 -3276.800 3276.700 FORMAT "%8.3" ECU_ADDRESS 0x600082CA /end MEASUREMENT
/begin MEASUREMENT AccPed_tqCvtEcoEng1 "CVT eco mode torque 1" SWORD Trq 1 100 -3276.800 3276.700 FORMAT "%8.3" ECU_ADDRESS 0x600082C8 /end MEASUREMENT
/begin MEASUREMENT AccPed_tqCvtEcoEng12 "CVT eco mode torque 12" SWORD Trq 1 100 -3276.800 3276.700 FORMAT "%8.3" ECU_ADDRESS 0x600082C6 /end MEASUREMENT
/begin MEASUREMENT AccPed_tqCvtEcoEng2 "CVT eco mode torque 2" SWORD Trq 1 100 -3276.800 3276.700 FORMAT "%8.3" ECU_ADDRESS 0x600082C4 /end MEASUREMENT
/begin MEASUREMENT AccPed_tqCvtEcoEng23 "CVT eco mode torque 23" SWORD Trq 1 100 -3276.800 3276.700 FORMAT "%8.3" ECU_ADDRESS 0x600082C2 /end MEASUREMENT
/begin MEASUREMENT AccPed_tqCvtEcoEng3 "CVT eco mode torque 3" SWORD Trq 1 100 -3276.800 3276.700 FORMAT "%8.3" ECU_ADDRESS 0x600082C0 /end MEASUREMENT
/begin MEASUREMENT AccPed_tqCvtEcoEng34 "CVT eco mode torque 34" SWORD Trq 1 100 -3276.800 3276.700 FORMAT "%8.3" ECU_ADDRESS 0x600082BE /end MEASUREMENT
/begin MEASUREMENT AccPed_tqCvtEcoEng4 "CVT eco mode torque 4" SWORD Trq 1 100 -3276.800 3276.700 FORMAT "%8.3" ECU_ADDRESS 0x600082BC /end MEASUREMENT
/begin MEASUREMENT AccPed_tqCvtEcoEng45 "CVT eco mode torque 45" SWORD Trq 1 100 -3276.800 3276.700 FORMAT "%8.3" ECU_ADDRESS 0x600082BA /end MEASUREMENT
/begin MEASUREMENT AccPed_tqCvtEcoEng5 "CVT eco mode torque 5" SWORD Trq 1 100 -3276.800 3276.700 FORMAT "%8.3" ECU_ADDRESS 0x600082B8 /end MEASUREMENT
/begin MEASUREMENT AccPed_tqCvtEcoEng56 "CVT eco mode torque 56" SWORD Trq 1 100 -3276.800 3276.700 FORMAT "%8.3" ECU_ADDRESS 0x600082B6 /end MEASUREMENT
/begin MEASUREMENT AccPed_tqCvtEcoEng6 "CVT eco mode torque 6" SWORD Trq 1 100 -3276.800 3276.700 FORMAT "%8.3" ECU_ADDRESS 0x600082B4 /end MEASUREMENT
/begin MEASUREMENT AccPed_tqCvtEcoEng67 "CVT eco mode torque 67" SWORD Trq 1 100 -3276.800 3276.700 FORMAT "%8.3" ECU_ADDRESS 0x600082B2 /end MEASUREMENT
/begin MEASUREMENT AccPed_tqCvtEcoEng7 "CVT eco mode torque 7" SWORD Trq 1 100 -3276.800 3276.700 FORMAT "%8.3" ECU_ADDRESS 0x600082B0 /end MEASUREMENT
/begin MEASUREMENT AccPed_tqCvtEcoEng78 "CVT eco mode torque 78" SWORD Trq 1 100 -3276.800 3276.700 FORMAT "%8.3" ECU_ADDRESS 0x600082AE /end MEASUREMENT
/begin MEASUREMENT AccPed_tqCvtEcoEng8 "CVT eco mode torque 8" SWORD Trq 1 100 -3276.800 3276.700 FORMAT "%8.3" ECU_ADDRESS 0x600082AC /end MEASUREMENT
/begin MEASUREMENT AccPed_tqCVTEng0 "Driver demanded torque for gear0 for CVT transmission" SWORD Trq 1 100 -3276.800 3276.700 FORMAT "%8.3" ECU_ADDRESS 0x60009C16 /end MEASUREMENT
/begin MEASUREMENT AccPed_tqCVTEng1 "Driver demanded torque for gear1 for CVT transmission" SWORD Trq 1 100 -3276.800 3276.700 FORMAT "%8.3" ECU_ADDRESS 0x60009C14 /end MEASUREMENT
/begin MEASUREMENT AccPed_tqCVTEng12 "Driver demanded torque for gear1 for CVT transmission" SWORD Trq 1 100 -3276.800 3276.700 FORMAT "%8.3" ECU_ADDRESS 0x600082AA /end MEASUREMENT
/begin MEASUREMENT AccPed_tqCVTEng2 "Driver demanded torque for gear2 for CVT transmission" SWORD Trq 1 100 -3276.800 3276.700 FORMAT "%8.3" ECU_ADDRESS 0x60009C12 /end MEASUREMENT
/begin MEASUREMENT AccPed_tqCVTEng23 "Driver demanded torque for gear2 for CVT transmission" SWORD Trq 1 100 -3276.800 3276.700 FORMAT "%8.3" ECU_ADDRESS 0x600082A8 /end MEASUREMENT
/begin MEASUREMENT AccPed_tqCVTEng3 "Driver demanded torque for gear3 for CVT transmission" SWORD Trq 1 100 -3276.800 3276.700 FORMAT "%8.3" ECU_ADDRESS 0x60009C10 /end MEASUREMENT
/begin MEASUREMENT AccPed_tqCVTEng34 "Driver demanded torque for gear3 for CVT transmission" SWORD Trq 1 100 -3276.800 3276.700 FORMAT "%8.3" ECU_ADDRESS 0x600082A6 /end MEASUREMENT
/begin MEASUREMENT AccPed_tqCVTEng4 "Driver demanded torque for gear4 for CVT transmission" SWORD Trq 1 100 -3276.800 3276.700 FORMAT "%8.3" ECU_ADDRESS 0x60009C0E /end MEASUREMENT
/begin MEASUREMENT AccPed_tqCVTEng45 "Driver demanded torque for gear4 for CVT transmission" SWORD Trq 1 100 -3276.800 3276.700 FORMAT "%8.3" ECU_ADDRESS 0x600082A4 /end MEASUREMENT
/begin MEASUREMENT AccPed_tqCVTEng5 "Driver demanded torque for gear5 for CVT transmission" SWORD Trq 1 100 -3276.800 3276.700 FORMAT "%8.3" ECU_ADDRESS 0x60009C0C /end MEASUREMENT
/begin MEASUREMENT AccPed_tqCVTEng56 "Driver demanded torque for gear5 for CVT transmission" SWORD Trq 1 100 -3276.800 3276.700 FORMAT "%8.3" ECU_ADDRESS 0x600082A2 /end MEASUREMENT
/begin MEASUREMENT AccPed_tqCVTEng6 "Driver demanded torque for gear6 for CVT transmission" SWORD Trq 1 100 -3276.800 3276.700 FORMAT "%8.3" ECU_ADDRESS 0x60009C0A /end MEASUREMENT
/begin MEASUREMENT AccPed_tqCVTEng67 "Driver demanded torque for gear6 for CVT transmission" SWORD Trq 1 100 -3276.800 3276.700 FORMAT "%8.3" ECU_ADDRESS 0x600082A0 /end MEASUREMENT
/begin MEASUREMENT AccPed_tqCVTEng7 "Driver demanded torque for gear7 for CVT transmission" SWORD Trq 1 100 -3276.800 3276.700 FORMAT "%8.3" ECU_ADDRESS 0x60009C08 /end MEASUREMENT
/begin MEASUREMENT AccPed_tqCVTEng78 "Driver demanded torque for gear7 for CVT transmission" SWORD Trq 1 100 -3276.800 3276.700 FORMAT "%8.3" ECU_ADDRESS 0x6000829E /end MEASUREMENT
/begin MEASUREMENT AccPed_tqCVTEng8 "Driver demanded torque for gear8 for CVT transmission" SWORD Trq 1 100 -3276.800 3276.700 FORMAT "%8.3" ECU_ADDRESS 0x60009C06 /end MEASUREMENT
/begin MEASUREMENT AccPed_tqCVTEngRvs "Driver demanded torque for reverse gear for CVT transmission" SWORD Trq 1 100 -3276.800 3276.700 FORMAT "%8.3" ECU_ADDRESS 0x60009C04 /end MEASUREMENT
/begin MEASUREMENT AccPed_tqDesTmp "Desired driver demand (after loss compensation and E-Motor drag if applicable)" SLONG TrqPrpHigh 1 100 -214748364.800 214748364.700 FORMAT "%13.3" ECU_ADDRESS 0x500010B0 /end MEASUREMENT
/begin MEASUREMENT AccPed_tqGearDesCVT "Driver demanded torque for CVT transmission" SWORD Trq 1 100 -3276.800 3276.700 FORMAT "%8.3" ECU_ADDRESS 0x6000829C /end MEASUREMENT
/begin MEASUREMENT AccPed_tqGearDesMT "Driver demanded torque for MT transmission" SWORD Trq 1 100 -3276.800 3276.700 FORMAT "%8.3" ECU_ADDRESS 0x6000829A /end MEASUREMENT
/begin MEASUREMENT AccPed_tqGearMod1CVT "CVT gear mode 1 torque" SWORD Trq 1 100 -3276.800 3276.700 FORMAT "%8.3" ECU_ADDRESS 0x60008298 /end MEASUREMENT
/begin MEASUREMENT AccPed_tqLossSum "Total losses (Inclusive of switchable and non-switchable losses) before compensation" SLONG TrqPrpHigh 1 100 -214748364.800 214748364.700 FORMAT "%13.3" ECU_ADDRESS 0x60003250 /end MEASUREMENT
/begin MEASUREMENT AccPed_tqMapBasd "Map-based driver demanded torque" SWORD Trq 1 100 -3276.800 3276.700 FORMAT "%8.3" ECU_ADDRESS 0x60009C02 /end MEASUREMENT
/begin MEASUREMENT AccPed_tqNewTmp "Temporary value of torque based on current drive mode" SWORD Trq 1 100 -3276.800 3276.700 FORMAT "%8.3" ECU_ADDRESS 0x60008296 /end MEASUREMENT
/begin MEASUREMENT AccPed_tqNotSwilLoss "Non-switchable losses" SLONG TrqPrpHigh 1 100 -214748364.800 214748364.700 FORMAT "%13.3" ECU_ADDRESS 0x500010B4 /end MEASUREMENT
/begin MEASUREMENT AccPed_tqOldTmp "Temporary value of torque based on previous drive mode" SWORD Trq 1 100 -3276.800 3276.700 FORMAT "%8.3" ECU_ADDRESS 0x60008294 /end MEASUREMENT
/begin MEASUREMENT AccPed_tqPullInrCmp "Loss compensated Driver demanded pull torque at inner level" SLONG TrqPrpHigh 1 100 -214748364.800 214748364.700 FORMAT "%13.3" ECU_ADDRESS 0x500010B8 /end MEASUREMENT
/begin MEASUREMENT AccPed_tqWoCtOff "Accped based offset torque when there is no fuel cut-off for stable combustion" SWORD Trq 1 100 -3276.800 3276.700 FORMAT "%8.3" ECU_ADDRESS 0x600082E0 /end MEASUREMENT
/begin MEASUREMENT AccPed_trqBasPrev "Previous calculation of basic request desired torque for iMT" SWORD Trq 1 100 -3276.800 3276.700 FORMAT "%8.3" ECU_ADDRESS 0x60008292 /end MEASUREMENT
/begin MEASUREMENT AccPed_trqDes "driver torque value of propulsion after step limitation" SLONG TrqPrpHigh 1 100 -214748364.800 214748364.700 FORMAT "%13.3" ECU_ADDRESS 0x50004D94 /end MEASUREMENT
/begin MEASUREMENT AccPed_trqDesPull "Drivers demand in pull mode for desired value" SLONG TrqPrpHigh 1 100 -214748364.800 214748364.700 FORMAT "%13.3" ECU_ADDRESS 0x50004D98 /end MEASUREMENT
/begin MEASUREMENT AccPed_trqLimMax "Maximum wheel torque in case of accelerator pedal error" SLONG TrqPrpHigh 1 100 -214748364.800 214748364.700 FORMAT "%13.3" ECU_ADDRESS 0x50004D9C /end MEASUREMENT
/begin MEASUREMENT AC_trqDes "Application parametr for Desired AC compressor torque" SWORD Trq 1 100 -3276.800 3276.700 FORMAT "%8.3" ECU_ADDRESS 0x60014764 /end MEASUREMENT
/begin MEASUREMENT AC_trqResv "AC reserve torque" SWORD Trq 1 100 -3276.800 3276.700 FORMAT "%8.3" ECU_ADDRESS 0x60014766 /end MEASUREMENT
/begin MEASUREMENT AirC_pAnaClnt "The sensed value of the AC coolant pressure over ADC" SWORD PresAC_hPa 1 100 -65536.00 65534.00 FORMAT "%8.2" ECU_ADDRESS 0x60009BF8 /end MEASUREMENT
/begin MEASUREMENT AirC_pClnt "Air Condition coolant pressure" SWORD PresAC_hPa 1 100 -65536.00 65534.00 FORMAT "%8.2" ECU_ADDRESS 0x60009E10 /end MEASUREMENT
/begin MEASUREMENT AirC_stCmprAct "Actual Air compressor state" UBYTE OneToOne 1 100 0.00 255.0 FORMAT "%5.1" ECU_ADDRESS 0x6000FFE3 /end MEASUREMENT
/begin MEASUREMENT AirC_stPsCmpr "Final digital output to the power stage of AC compressor actuator" UBYTE OneToOne 1 100 0.00 255.0 FORMAT "%5.1" ECU_ADDRESS 0x6000FFE2 /end MEASUREMENT
/begin MEASUREMENT AirC_trqCmprMax "Maximum torque consumable by the AC compressor" SWORD Trq 1 100 -3276.800 3276.700 FORMAT "%8.3" ECU_ADDRESS 0x60009BF6 /end MEASUREMENT
/begin MEASUREMENT AirC_trqDes "Torque demanded by the AC compressor on CAN" SWORD Trq 1 100 -3276.800 3276.700 FORMAT "%8.3" ECU_ADDRESS 0x6001477C /end MEASUREMENT
/begin MEASUREMENT AirC_uAnaRawClnt "The raw voltage value from the ADC for AC coolant pressure" SWORD Volt 1 100 -6553.600 6553.400 FORMAT "%8.3" ECU_ADDRESS 0x6001477E /end MEASUREMENT
/begin MEASUREMENT VehMot_drAccPedUnFlt "accelerator pedal angle slope, unfiltered" SWORD PrcPerSec 1 100 -20000.00 19999.39 FORMAT "%8.2" ECU_ADDRESS 0x60009630 /end MEASUREMENT
/begin MEASUREMENT VehMot_facDesDyn "Dynamic factor for driver demand" SWORD Fact 1 100 -4.000000 3.999878 FORMAT "%8.6" ECU_ADDRESS 0x6000962C /end MEASUREMENT
/begin MEASUREMENT VehMot_rAccPedFlt "Filtered accelerator pedal value" SWORD Prc 1 100 -400.0000 399.9878 FORMAT "%8.4" ECU_ADDRESS 0x6000962A /end MEASUREMENT
/begin MEASUREMENT VehMot_stPrpAccPed "Status of propulsion demand by driver demand" UBYTE B_TRUE 1 100 0.00 1.00000000000 BIT_MASK 0x1 FORMAT "%13.11" ECU_ADDRESS 0x6000F8AD /end MEASUREMENT
/begin FUNCTION rba_OsShell "1.42.0  McFunction rba_OsShell Created by MCFunctionUpdater"
 /begin LOC_MEASUREMENT rba_OsShell_Cntr1000msTask rba_OsShell_Cntr100msTask rba_OsShell_Cntr10msTask rba_OsShell_Cntr1msTask rba_OsShell_Cntr200msTask rba_OsShell_Cntr20msTask rba_OsShell_Cntr2msTask rba_OsShell_Cntr50msTask rba_OsShell_Cntr5msTask rba_OsShell_CntrAsw1BgTask rba_OsShell_CntrAsw2BgTask rba_OsShell_CntrBswBgTask rba_OsShell_CntrCalWup100msTask rba_OsShell_CntrCalWup10msTask rba_OsShell_CntrCalWup20msTask rba_OsShell_CntrCalWup2msTask rba_OsShell_CntrCalWupAsw110msTask rba_OsShell_CntrCalWupAsw210msTask rba_OsShell_CntrCalWupBgTask rba_OsShell_CntrCalWupIniEndTask rba_OsShell_CntrCalWupIniTask rba_OsShell_CntrDSMClearTask rba_OsShell_CntrDSMReiniTask rba_OsShell_CntrEngReStrtDummyTask rba_OsShell_CntrEngReStrtModeMTask rba_OsShell_CntrEngReStrtTask rba_OsShell_CntrEpmNoSyncTask rba_OsShell_CntrErrLimit1000msTask rba_OsShell_CntrErrLimit100msTask rba_OsShell_CntrErrLimit10msTask rba_OsShell_CntrErrLimit1msTask rba_OsShell_CntrErrLimit200msTask rba_OsShell_CntrErrLimit20msTask rba_OsShell_CntrErrLimit2msTask rba_OsShell_CntrErrLimit50msTask rba_OsShell_CntrErrLimit5msTask rba_OsShell_CntrErrLimitAsw1BgTask rba_OsShell_CntrErrLimitAsw2BgTask rba_OsShell_CntrErrLimitBswBgTask rba_OsShell_CntrErrLimitCalWup100msTask rba_OsShell_CntrErrLimitCalWup10msTask rba_OsShell_CntrErrLimitCalWup20msTask rba_OsShell_CntrErrLimitCalWup2msTask rba_OsShell_CntrErrLimitCalWupAsw110msTask rba_OsShell_CntrErrLimitCalWupAsw210msTask rba_OsShell_CntrErrLimitCalWupBgTask rba_OsShell_CntrErrLimitCalWupIniEndTask rba_OsShell_CntrErrLimitCalWupIniTask rba_OsShell_CntrErrLimitDSMClearTask rba_OsShell_CntrErrLimitDSMReiniTask rba_OsShell_CntrErrLimitEngReStrtDummyTask rba_OsShell_CntrErrLimitEngReStrtModeMTask rba_OsShell_CntrErrLimitEngReStrtTask rba_OsShell_CntrErrLimitEpmNoSyncTask rba_OsShell_CntrErrLimitInfraAsw1App10msTask rba_OsShell_CntrErrLimitInfraAsw2App10msTask rba_OsShell_CntrErrLimitInfraBswApp10msTask rba_OsShell_CntrErrLimitIniDrvTask rba_OsShell_CntrErrLimitIniEndTask rba_OsShell_CntrErrLimitIniTask rba_OsShell_CntrErrLimitIniTaskCore0 rba_OsShell_CntrErrLimitMoSyncFirstTask rba_OsShell_CntrErrLimitMoSyncIniTask rba_OsShell_CntrErrLimitMoSyncS0Task rba_OsShell_CntrErrLimitMoSyncS1Task rba_OsShell_CntrErrLimitMoTask rba_OsShell_CntrErrLimitReIniModeMTask rba_OsShell_CntrErrLimitReIniTask rba_OsShell_CntrErrLimitShutdown10msTask rba_OsShell_CntrErrLimitShutdownAsw1Task rba_OsShell_CntrErrLimitShutdownAsw2Task rba_OsShell_CntrErrLimitShutdownBswTask rba_OsShell_CntrErrLimitShutdownSeqTask rba_OsShell_CntrErrLimitStopCntrWakeup100msTask rba_OsShell_CntrErrLimitStopCntrWakeup10msTask rba_OsShell_CntrErrLimitStopCntrWakeup1msTask rba_OsShell_CntrErrLimitStopCntrWakeup20msTask rba_OsShell_CntrErrLimitStopCntrWakeup2msTask rba_OsShell_CntrErrLimitStopCntrWakeup5msTask rba_OsShell_CntrErrLimitStopCntrWakeupAsw110msTask rba_OsShell_CntrErrLimitStopCntrWakeupAsw1BgTask rba_OsShell_CntrErrLimitStopCntrWakeupAsw210msTask rba_OsShell_CntrErrLimitStopCntrWakeupAsw2BgTask rba_OsShell_CntrErrLimitStopCntrWakeupIniEndTask rba_OsShell_CntrErrLimitStopCntrWakeupIniTask rba_OsShell_CntrErrLimitSyncFirstTask rba_OsShell_CntrErrLimitSyncIniTask rba_OsShell_CntrErrLimitSyncPreTask rba_OsShell_CntrErrLimitSyncS0Task rba_OsShell_CntrErrLimitSyncS1Task rba_OsShell_CntrInfraAsw1App10msTask rba_OsShell_CntrInfraAsw2App10msTask rba_OsShell_CntrInfraBswApp10msTask rba_OsShell_CntrIniDrvTask rba_OsShell_CntrIniEndTask rba_OsShell_CntrIniTask rba_OsShell_CntrIniTaskCore0 rba_OsShell_CntrMoSyncFirstTask rba_OsShell_CntrMoSyncIniTask rba_OsShell_CntrMoSyncS0Task rba_OsShell_CntrMoSyncS1Task rba_OsShell_CntrMoTask rba_OsShell_CntrReIniModeMTask rba_OsShell_CntrReIniTask rba_OsShell_CntrShutdown10msTask rba_OsShell_CntrShutdownAsw1Task rba_OsShell_CntrShutdownAsw2Task rba_OsShell_CntrShutdownBswTask rba_OsShell_CntrShutdownSeqTask rba_OsShell_CntrStopCntrWakeup100msTask rba_OsShell_CntrStopCntrWakeup10msTask rba_OsShell_CntrStopCntrWakeup1msTask rba_OsShell_CntrStopCntrWakeup20msTask rba_OsShell_CntrStopCntrWakeup2msTask rba_OsShell_CntrStopCntrWakeup5msTask rba_OsShell_CntrStopCntrWakeupAsw110msTask rba_OsShell_CntrStopCntrWakeupAsw1BgTask rba_OsShell_CntrStopCntrWakeupAsw210msTask rba_OsShell_CntrStopCntrWakeupAsw2BgTask rba_OsShell_CntrStopCntrWakeupIniEndTask rba_OsShell_CntrStopCntrWakeupIniTask rba_OsShell_CntrSyncFirstTask rba_OsShell_CntrSyncIniTask rba_OsShell_CntrSyncPreTask rba_OsShell_CntrSyncS0Task rba_OsShell_CntrSyncS1Task rba_OsShell_cntrErrAccess rba_OsShell_cntrErrCallevel rba_OsShell_cntrErrId rba_OsShell_cntrErrLimitSum rba_OsShell_cntrErrNoFunc rba_OsShell_cntrErrResource rba_OsShell_cntrErrState rba_OsShell_cntrErrSum rba_OsShell_cntrErrValue rba_OsShell_tiPowerOnFrst10ms rba_OsShell_tiResetFrst10ms /end LOC_MEASUREMENT
 FUNCTION_VERSION "1.42.0" /end FUNCTION
/begin FUNCTION rba_SyC_ObservationCounter "1.8.0     System Control Observation Counter"
 /begin LOC_MEASUREMENT rba_SyC_ObservationCounters_IrrSwOffTrigEngRun_Value_MP rba_SyC_ObservationCounters_IrrSwOff_Value_MP /end LOC_MEASUREMENT
 FUNCTION_VERSION "1.8.0" /end FUNCTION
/begin FUNCTION rba_SyC_Power "1.6.0  McFunction rba_SyC_Power Created by MCFunctionUpdater" /begin LOC_MEASUREMENT rba_SyC_PowerOn_Reasons_MP /end LOC_MEASUREMENT FUNCTION_VERSION "1.6.0" /end FUNCTION
/begin FUNCTION rba_SyC_Rtc "1.5.0  McFunction rba_SyC_Rtc Created by MCFunctionUpdater"
 /begin LOC_MEASUREMENT rba_SyC_Rtc_EcuOffTime_Validity_MP rba_SyC_Rtc_EcuOffTime_Value_MP /end LOC_MEASUREMENT
 FUNCTION_VERSION "1.5.0" /end FUNCTION
/*********** End of merged FUNCTION blocks ***********/
/begin FUNCTION ACClntP_DD "199.0.0   AC Coolant Pressure Device Driver"
 /begin DEF_CHARACTERISTIC AirC_nEngLoLim_C AirC_pClntTransfAna_CUR AirC_swtAnaClntPres_C AirC_tAirLoLim_C AirC_uSRCMaxClntPres_C AirC_uSRCMinClntPres_C /end DEF_CHARACTERISTIC
 /begin IN_MEASUREMENT AirC_stSwt AirC_stSwtPrs EnvT_t Epm_nEng /end IN_MEASUREMENT
 /begin OUT_MEASUREMENT ACClntP_bCodAvl AirC_pAnaClnt AirC_uAnaRawClnt /end OUT_MEASUREMENT
 FUNCTION_VERSION "199.0.0" /end FUNCTION
/begin FUNCTION ACClntP_VD "199.0.0   AC Coolant Pressure Virtual Device"
 /begin DEF_CHARACTERISTIC AirC_pDfl_C AirC_RmpSlpClntP.Pos_C AirC_RmpSlpClntP.Neg_C AirC_tiPT1_C AirC_TransStgClntP.Dfl_C AirC_TransStgClntP.stSensId_C /end DEF_CHARACTERISTIC
 /begin IN_MEASUREMENT AirC_pAnaClnt /end IN_MEASUREMENT
 /begin OUT_MEASUREMENT AirC_pClnt /end OUT_MEASUREMENT
 FUNCTION_VERSION "199.0.0" /end FUNCTION
/begin FUNCTION ACCmpr_DD "35.0.0    AC Compressor Device Driver"
 /begin DEF_CHARACTERISTIC ACCmpr_numTstMax_C ACCmpr_tiBtwTstOT_C ACCmpr_tiBtwTstSCB_C AirCCmpr_ATS.LimitTypeMsk_C AirCCmpr_ATS.CnvNorm_C AirCCmpr_ATS.LowLim_C AirCCmpr_ATS.UpLim_C AirCCmpr_ATS.CnvFac_C AirCCmpr_ATS.CnvOfs_C AirCCmpr_ATS.DfltVal_C AirC_stCmprPsDiaDisbl_C AirC_stCmprPsDisbl_C AirC_stCmprTyp_CW AirC_trqCmprMin_C /end DEF_CHARACTERISTIC
 /begin IN_MEASUREMENT AC_trqMaxAC DevLib_stPwrStgEnaCond /end IN_MEASUREMENT
 /begin OUT_MEASUREMENT AirC_stCmprAct AirC_stPsCmpr AirC_trqCmprMax AirC_trqDes /end OUT_MEASUREMENT
 /begin LOC_MEASUREMENT ACCmpr_flgPsCmprDes /end LOC_MEASUREMENT
 FUNCTION_VERSION "35.0.0" /end FUNCTION
/begin FUNCTION ACComp_Demand "180.1.0   Air conditioning compressor demand"
 /begin DEF_CHARACTERISTIC ACComp_CalcDem_CW ACComp_facACCmprOnResv_M ACComp_facCmprEnthCorrnA_C ACComp_facCmprEnthCorrnB_C ACComp_facCmprPlly_C ACComp_facCmprTqExtInp_C ACComp_facCooltFlowQnty_M ACComp_facCurrCtrlVal_C ACComp_facEnthpyCorrnA_C ACComp_facEnthpyCorrnB_C ACComp_facFanStVal_C ACComp_facFullCpTqCoeffA_C ACComp_facFullCpTqCoeffB_C ACComp_facFullCpTqCorrn_C ACComp_facGearACCmprOnResv_M ACComp_facHwGearOffResv_T ACComp_facHwOffResv_T ACComp_facOutdTCorrnA_C ACComp_facOutdTCorrnB_C ACComp_facOutdTDurgIdleA_C ACComp_facOutdTDurgIdleB_C ACComp_facTqEvaprSnsrValB_C ACComp_facTqEvaprSnsrValC_C ACComp_facTqPSnsrCtrlVal_C ACCOMP_FALSE ACComp_flgSwtACCmprSeln_C ACComp_iMaxACCmpr_C ACComp_mMinCooltFlowQnty_T ACComp_nOutdTCalcnPrmsSpd_C ACCOMP_PCOEFF ACComp_pCurrCorrnCtrlVal_C ACComp_rFan2_C ACComp_rFanHi_C ACComp_rFanLo_C ACComp_rFan_C ACComp_swtCmprExtInpTest_C ACComp_swtComMsgSeln_C ACComp_swtLdCAN_C ACComp_swtLd_C ACComp_swtStrtUpJdgCondByp_C ACComp_swtTrqOffsBhv_C ACComp_swtTSel_C ACComp_swtVehVCondByp_C ACComp_tCmprEnthIdealAdbt_M ACComp_tCooltSatnT_T ACComp_tiACOffTimeInit_C ACComp_tiCmprStrtPClnt_T ACComp_tiOnDlyT1DP_M ACComp_tiOnDlyT1Ti_M ACComp_tiOnDlyT2DP_M ACComp_tiOnDlyT2Ti_M ACComp_tiOnDlyT3Ti_M ACComp_tiOnDlyT4Ti_M ACComp_tiOutdTCalcnPrms_C ACComp_tiTCalcnPrepnPrms_C ACComp_tiTrqDes_C ACComp_tiTrqDyn_C ACComp_tiTrqOffRmpDwnone_C ACComp_tiTrqOffsRmpDwn_C ACComp_tiTrqOffsRmpUpone_C ACComp_tiTrqOffsRmpUp_C ACComp_tiTrqResv_C ACComp_tOutAirLoThd_C ACComp_tOutAirThres_C ACComp_tqACOffs1_M ACComp_tqACOffs_M ACComp_tqCorrnMax_C ACComp_tqEstimd1TqStrt_T ACComp_tqEstimd2TqStrt_T ACComp_tqEvaprTCorrnTq_C ACComp_tqHardDwnStep_C ACComp_tqHwGearOffResv_M ACComp_tqHwOffResv_M ACComp_tqPSnsrCorrnTq_C ACComp_tqSwOffResv_M ACComp_trqDyn_MAP ACComp_trqLimMax_MAP ACComp_trqOffsFlt_C ACComp_trqStat_MAP ACComp_tTCalcnRednVal_C ACComp_tTCalcnRiseVal_C ACComp_tValDurgSnsrFailr_C ACComp_tWtrTOutdTSnsr_C ACComp_vOutdTCtrlStrtPrms_C ACComp_vTqOffsRmpDelta_C ACComp_vTqOffsRmp_C ACComp_vVehSpdChgOutdT_C /end DEF_CHARACTERISTIC
 /begin REF_CHARACTERISTIC FanCtl_swtPWMFanActv_C /end REF_CHARACTERISTIC
 /begin IN_MEASUREMENT ACCtl_flgMgcOn ACCtl_flgSwOffResv ACCtl_stOut ACCtl_stTrqResv ACEvpT_t AirC_pClnt B_fs_msg B_ll_msg CEngDsT_t Com_iACCmpr Com_tACAirTOut Com_tAirOutside Com_tEnvT Eep_EnvRamInvld EnvT_t Epm_nEng Fan_r Fan_r2 mifa_w_msg T15_st tans_msg VehV_v /end IN_MEASUREMENT
 /begin OUT_MEASUREMENT ACComp_flgVblDplCmprJdg ACComp_iCmprSol ACComp_pLoPVal ACComp_trqStat AC_trqDes AC_trqResv /end OUT_MEASUREMENT
 /begin LOC_MEASUREMENT ACComp_facCmprPCorrn ACComp_facCmprSpdCorrn_MP ACComp_facCooltFlowQnty ACComp_facEnthpyCorrnA ACComp_facEnthpyCorrnB ACComp_facHwOffResv ACComp_facOutdTAftCorrnA_MP ACComp_facOutdTAftCorrn_MP ACComp_facPWithCoeffB_MP ACComp_facSolCurrCorrn_MP ACComp_facSpdWithCoeffA_MP ACComp_facTCorrnWithP_MP ACComp_facTemp18 ACComp_facTemp21 ACComp_facTemp25 ACComp_facTemp30 ACComp_facTrq_MP ACComp_flgACOn_MP ACComp_flgFirstStrtUpEnd ACComp_flgFirstStrtUpStart ACComp_flgOutdTFrstCalc ACComp_flgRampDwnActv ACComp_flgRampDwnActv1 ACComp_flgRampUpActv ACComp_flgRampUpActv1 ACComp_flgTqOffsVehV ACComp_mCalcdFlowQnty_MP ACComp_mCooltFlowQnty ACComp_mMinCooltFlowQnty ACComp_nEngCor_mp ACComp_pACClntpDiff_MP ACComp_pClnt ACComp_pClntClthOff ACComp_pClntCtrlVal ACComp_rFanSt ACComp_rFanStCalcdVal ACComp_rFanStCorrnVal_MP ACComp_rPrevFanStCalcdVal ACComp_rPrevStCorrnVal_MP ACComp_rWindVWghtAvrg ACComp_stFanStInitCalcn ACCOmp_stOutdTActvCdn_MP ACComp_stOutdTCalcnPrms ACComp_stTrqCalcnEna_MP ACComp_stVehSpdTmrRst ACComp_tActOutdT ACComp_tCalcdIdleOutdT ACComp_tCalcdOutdT ACComp_tCmprEnthIdealAdbt ACComp_tCooltSatnT ACComp_tiACOffTime ACComp_tiCmprStrtPClnt ACComp_tiCmprStrtUp1 ACComp_tiCmprVolCtrlStrt ACComp_tiOnDlyT1 ACComp_tiOnDlyT2 ACComp_tiOnDlyT3 ACComp_tiOnDlyT4 ACComp_tOutdT ACComp_tqACModel_MP ACComp_tqCmprFullCpTq ACComp_tqCorrnMax ACComp_tqEstimd1TqStat ACComp_tqEstimd2TqStrt ACComp_tqEstimdACCmpr ACComp_tqEvaprSnsrValB ACComp_tqEvaprSnsrValC ACComp_tqEvaprTCorrn ACComp_tqHardTmp ACComp_tqHwOffResv ACComp_tqOffsFinal ACComp_tqOffsFinal1 ACComp_tqOffsReqd ACComp_tqOffsReqd1 ACComp_tqPSnsrCtrlValTq ACComp_tqStrtgCtrlCmprTq ACComp_tqSwOffResv ACComp_trqDesFltAbv_mp ACComp_trqDesFlt_mp ACComp_trqDyn_mp ACComp_trqOffsRamped ACComp_trqOffsRamped1 ACComp_tSeldTrqOffs ACComp_tVblCpCmprEnth /end LOC_MEASUREMENT
 FUNCTION_VERSION "180.1.0" /end FUNCTION
/begin FUNCTION AccPed_DoCoordOut "233.0.0   Accelerator pedal torque coordination"
 /begin DEF_CHARACTERISTIC AccPed_nMax_C AccPed_nMinBrkApp_C AccPed_nMinBrk_C AccPed_nMinNoBrk_C AccPed_trqLimMax_C /end DEF_CHARACTERISTIC
 /begin IN_MEASUREMENT APP_drUnFlt APP_r CrCtl_stACCCond CrCtl_stActive LLim_stActive PT_rTrq VehMot_rTrqDfftl VehMot_stBrkPed VMD_rASLCC /end IN_MEASUREMENT
 /begin OUT_MEASUREMENT AccPed_nMax AccPed_nMin AccPed_rTrq AccPed_stNSetP AccPed_trqLimMax VehMot_drAccPedUnFlt VehMot_facDesDyn VehMot_rAccPedFlt /end OUT_MEASUREMENT
 /begin LOC_MEASUREMENT AccPed_stVirtAppUsg /end LOC_MEASUREMENT
 FUNCTION_VERSION "233.0.0" /end FUNCTION
/begin FUNCTION AccPed_DrvDemDes "69.13.2   Calculation of driver command torque set path"
 /begin DEF_CHARACTERISTIC AccPed_flgNotSwilLossCmp_C AccPed_flgSelFacCmpAcs_C AccPed_rAPPHysHi_C AccPed_rAPPHysLo_C AccPed_rThdMaxCmp_C AccPed_rThdNoCmp_C AccPed_tqPullThd_C /end DEF_CHARACTERISTIC
 /begin IN_MEASUREMENT AccPed_rTrq AccPed_tqMapBasd AccPed_trqLimMax APP_r CoME_trqDesComp CoVeh_trqAcs LsComp_bLossCmpActvd PT_rTrq PT_trqLos RngMod_trqComp RngMod_trqCrSMin RngMod_trqDiffAdap RngMod_trqInrMinWoCtOff RngMod_trqLosEng SpdGov_facComp Tra_trqLos VehMot_rTrqDfftl /end IN_MEASUREMENT
 /begin OUT_MEASUREMENT AccPed_facCompAcs AccPed_trqDes AccPed_trqDesPull VehMot_stPrpAccPed /end OUT_MEASUREMENT
 /begin LOC_MEASUREMENT AccPed_facAppMaxCmp AccPed_tqCmpLossSum AccPed_tqCmpNotSwilLoss AccPed_tqCmpSwilLoss AccPed_tqDesTmp AccPed_tqLossSum AccPed_tqNotSwilLoss AccPed_tqPullInrCmp AccPed_tqWoCtOff /end LOC_MEASUREMENT
 FUNCTION_VERSION "69.13.2" /end FUNCTION
/begin FUNCTION AccPed_DrvModSeln "233.1.0   Calculation of Drive Mode Selection Condition" /begin DEF_CHARACTERISTIC AccPed_tiIDSDrvModTmpInhb_C /end DEF_CHARACTERISTIC /begin REF_CHARACTERISTIC AccPed_swtDrvModSeln_C /end REF_CHARACTERISTIC
 /begin IN_MEASUREMENT AccPed_facModSwt Com_stAmbLmpPrms Com_stDrvModSwt Com_stIMGIDSDrvMod Com_stVSAInhbInfo PT_stTraType T15_st /end IN_MEASUREMENT
 /begin OUT_MEASUREMENT AccPed_flgDrvModChg AccPed_flgIDSDrvModFailr AccPed_flgIDSDrvModTmpInhb AccPed_stDrvModPrev AccPed_swtDrvMod AccPed_swtDrvModCpl AccPed_swtDrvModPrev /end OUT_MEASUREMENT
 FUNCTION_VERSION "233.1.0" /end FUNCTION
/begin FUNCTION AccPed_TqCalcn "233.1.0   Map based calculation of driver demand"
 /begin DEF_CHARACTERISTIC AccPed_swtDrvModSeln_C AccPed_swtFilActvn_C AccPed_tiGearFildFil_CA AccPed_tiGearFildRmp_CA AccPed_tqCmftModGear1_M AccPed_tqCmftModGear2_M AccPed_tqCmftModGear3_M AccPed_tqCmftModGear4_M AccPed_tqCmftModGear5_M AccPed_tqCmftModGear6_M AccPed_tqCmftModGear7_M AccPed_tqCmftModGear8_M AccPed_tqCmftModGear9_M AccPed_tqCvtEcoEng0_M AccPed_tqCvtEcoEng1_M AccPed_tqCvtEcoEng2_M AccPed_tqCvtEcoEng3_M AccPed_tqCvtEcoEng4_M AccPed_tqCvtEcoEng5_M AccPed_tqCvtEcoEng6_M AccPed_tqCvtEcoEng7_M AccPed_tqCvtEcoEng8_M AccPed_tqCvtEng0_M AccPed_tqCvtEng1_M AccPed_tqCvtEng2_M AccPed_tqCvtEng3_M AccPed_tqCvtEng4_M AccPed_tqCvtEng5_M AccPed_tqCvtEng6_M AccPed_tqCvtEng7_M AccPed_tqCvtEng8_M AccPed_tqCvtEngRvs_M AccPed_tqEcoModGear1_M AccPed_tqEcoModGear2_M AccPed_tqEcoModGear3_M AccPed_tqEcoModGear4_M AccPed_tqEcoModGear5_M AccPed_tqEcoModGear6_M AccPed_tqEcoModGear7_M AccPed_tqEcoModGear8_M AccPed_tqEcoModGear9_M AccPed_tqFilSwtOffLim_C AccPed_tqHiIdleCVT_T AccPed_tqHiIdleMT_T AccPed_tqMinWoRamp_C AccPed_tqModRvsCmft_M AccPed_tqModRvsEco_M AccPed_tqModRvsNorm_M AccPed_tqModRvsPlusR_M AccPed_tqModRvsSnow_M AccPed_tqModRvsSpt_M AccPed_tqMTGear1_M AccPed_tqMTGear2_M AccPed_tqMTGear3_M AccPed_tqMTGear4_M AccPed_tqMTGear5_M AccPed_tqMTGear6_M AccPed_tqNormModGear1_M AccPed_tqNormModGear2_M AccPed_tqNormModGear3_M AccPed_tqNormModGear4_M AccPed_tqNormModGear5_M AccPed_tqNormModGear6_M AccPed_tqNormModGear7_M AccPed_tqNormModGear8_M AccPed_tqNormModGear9_M AccPed_tqPlusRModGear1_M AccPed_tqPlusRModGear2_M AccPed_tqPlusRModGear3_M AccPed_tqPlusRModGear4_M AccPed_tqPlusRModGear5_M AccPed_tqPlusRModGear6_M AccPed_tqPlusRModGear7_M AccPed_tqPlusRModGear8_M AccPed_tqPlusRModGear9_M AccPed_tqSnowModGear1_M AccPed_tqSnowModGear2_M AccPed_tqSnowModGear3_M AccPed_tqSnowModGear4_M AccPed_tqSnowModGear5_M AccPed_tqSnowModGear6_M AccPed_tqSnowModGear7_M AccPed_tqSnowModGear8_M AccPed_tqSnowModGear9_M AccPed_tqSptModGear1_M AccPed_tqSptModGear2_M AccPed_tqSptModGear3_M AccPed_tqSptModGear4_M AccPed_tqSptModGear5_M AccPed_tqSptModGear6_M AccPed_tqSptModGear7_M AccPed_tqSptModGear8_M AccPed_tqSptModGear9_M AccPed_trqMod1Gear1_M AccPed_trqMod1Gear2_M AccPed_trqMod1Gear3_M AccPed_trqMod1Gear4_M AccPed_trqMod1Gear5_M AccPed_trqMod1Gear6_M /end DEF_CHARACTERISTIC
 /begin IN_MEASUREMENT AccPed_flgDrvModChg AccPed_stDrvModPrev AccPed_swtDrvMod APP_r I14229iocpMDA_stAPS PT_nClth PT_rTrq PT_stTraRevGear PT_stTraType SyC_ctPostDrvLeave Tra_numGear Tra_rGearCVT1Hi Tra_rGearCVT1Lo Tra_rGearCVT2Hi Tra_rGearCVT2Lo Tra_rGearCVT3Hi Tra_rGearCVT3Lo Tra_rGearCVT4Hi Tra_rGearCVT4Lo Tra_rGearCVT5Hi Tra_rGearCVT5Lo Tra_rGearCVT6Hi Tra_rGearCVT6Lo Tra_rGearCVT7Hi Tra_rGearCVT7Lo /end IN_MEASUREMENT
 /begin OUT_MEASUREMENT AccPed_facModSwt AccPed_flgChgGearDetn AccPed_nrGearFildTmp AccPed_nrGearFildTmpPrev AccPed_tqCVTEng0 AccPed_tqCVTEng1 AccPed_tqCVTEng2 AccPed_tqCVTEng3 AccPed_tqCVTEng4 AccPed_tqCVTEng5 AccPed_tqCVTEng6 AccPed_tqCVTEng7 AccPed_tqCVTEng8 AccPed_tqCVTEngRvs AccPed_tqMapBasd /end OUT_MEASUREMENT
 /begin LOC_MEASUREMENT AccPed_cntrPostDrvLve AccPed_facModSwtStep AccPed_stRampActv AccPed_tqBasDif AccPed_tqBasFild AccPed_tqBasFiveModNew AccPed_tqBasFiveModOld AccPed_tqBasMod1 AccPed_tqBasMod1MT AccPed_tqBasMod2 AccPed_tqBasModNew AccPed_tqBasModOld AccPed_tqBasUnfild AccPed_tqCvtEcoEng0 AccPed_tqCvtEcoEng1 AccPed_tqCvtEcoEng12 AccPed_tqCvtEcoEng2 AccPed_tqCvtEcoEng23 AccPed_tqCvtEcoEng3 AccPed_tqCvtEcoEng34 AccPed_tqCvtEcoEng4 AccPed_tqCvtEcoEng45 AccPed_tqCvtEcoEng5 AccPed_tqCvtEcoEng56 AccPed_tqCvtEcoEng6 AccPed_tqCvtEcoEng67 AccPed_tqCvtEcoEng7 AccPed_tqCvtEcoEng78 AccPed_tqCvtEcoEng8 AccPed_tqCVTEng12 AccPed_tqCVTEng23 AccPed_tqCVTEng34 AccPed_tqCVTEng45 AccPed_tqCVTEng56 AccPed_tqCVTEng67 AccPed_tqCVTEng78 AccPed_tqGearDesCVT AccPed_tqGearDesMT AccPed_tqGearMod1CVT AccPed_tqNewTmp AccPed_tqOldTmp AccPed_trqBasPrev /end LOC_MEASUREMENT
 FUNCTION_VERSION "233.1.0" /end FUNCTION
/begin FUNCTION AccPr "91.0.0    Access Protection" FUNCTION_VERSION "91.0.0" /end FUNCTION
/begin FUNCTION AccPrAppl "67.1.0    Access Protection Application" FUNCTION_VERSION "67.1.0" /end FUNCTION
/*********** Start of merged COMPU_METHOD blocks ***********/
/begin COMPU_METHOD RB_RBA_Common_CentralElements_CompuMethods_Identical "The internal value and the physical one are identical. No physical unit available" RAT_FUNC "%10.5" "noUnit" COEFFS 0.0 1.0 0.0 0.0 0.0 1.0 REF_UNIT RB_RBA_Common_CentralElements_Units_NoUnit /end COMPU_METHOD
/begin COMPU_METHOD RB_RBA_rba_SyC_Rtc_BswModuleDescriptions_rba_SyC_Rtc_EcuOffTime_CompuMethod "CompuMethod for EcuOffTime in System Control" TAB_VERB "%10.5" "nounit" COMPU_TAB_REF RB_RBA_rba_SyC_Rtc_BswModuleDescriptions_rba_SyC_Rtc_EcuOffTime_CompuMethod REF_UNIT RB_RBA_rba_SyC_Rtc_Units_NoUnit /end COMPU_METHOD
/begin COMPU_METHOD DefaultIdenticalCompu "" RAT_FUNC "%10.5" "" COEFFS 0.0 1.0 0.0 0.0 0.0 1.0 /end COMPU_METHOD
/begin COMPU_VTAB RB_RBA_rba_SyC_Rtc_BswModuleDescriptions_rba_SyC_Rtc_EcuOffTime_CompuMethod "CompuMethod for EcuOffTime in System Control" TAB_VERB 12 0 "RBA_SYC_RTC_ECUOFFTIME_VALIDITY_UNKNOWN" 1 "RBA_SYC_RTC_ECUOFFTIME_VALIDITY_VALID" 2 "RBA_SYC_RTC_ECUOFFTIME_VALIDITY_INVALID_DISABLED" 3 "RBA_SYC_RTC_ECUOFFTIME_VALIDITY_INVALID_READ_ERROR" 4 "RBA_SYC_RTC_ECUOFFTIME_VALIDITY_INVALID_IRRSWOFF" 5 "RBA_SYC_RTC_ECUOFFTIME_VALIDITY_INVALID_POWERFAIL" 6 "RBA_SYC_RTC_ECUOFFTIME_VALIDITY_INVALID_WRONG_MODE" 7 "RBA_SYC_RTC_ECUOFFTIME_VALIDITY_INVALID_NOT_RUNNING" 8 "RBA_SYC_RTC_ECUOFFTIME_VALIDITY_INVALID_STORAGE_ERROR" 9 "RBA_SYC_RTC_ECUOFFTIME_VALIDITY_INVALID_EXTERNAL" 10 "RBA_SYC_RTC_ECUOFFTIME_VALIDITY_VALID_EXPIRED" 11 "RBA_SYC_RTC_ECUOFFTIME_VALIDITY_INVALID_DATA" /end COMPU_VTAB
/begin COMPU_METHOD AIRMOD_VAR_SY_Compu "" TAB_VERB "%6.3" "" COMPU_TAB_REF AIRMOD_VAR_SY_Compu /end COMPU_METHOD
/begin COMPU_VTAB AIRMOD_VAR_SY_Compu "" TAB_VERB 50 0 "kein Kundenbezug" 1 "DAI" 3 "VWW" 4 "POR" 5 "AUD" 6 "OPE" 9 "FIA" 11 "BMW" 14 "PSA" 15 "REN" 17 "ALF" 18 "SAB" 19 "VOL" 20 "NIS" 21 "GMU" 22 "FOR" 26 "IMJ" 36 "MAN" 51 "SEA" 53 "CHR" 54 "JAG" 55 "ROL" 69 "FER" 72 "TOY" 123 "MIT" 147 "HYU" 159 "HON" 160 "MAZ" 183 "CU" 190 "LRG" 204 "VVW" 214 "AVT" 242 "Iveco" 243 "DMC" 248 "SUZ" 267 "SSANGYONG" 270 "KEF" 289 "AMG" 308 "TAT" 319 "MVM" 385 "UAES" 578 "AL" 590 "Scania" 760 "WEICHAI" 828 "RBCD" 966 "International" 998 "S1" 999 "ALL" 2887 "NONOX" 9454 "Fuso" /end COMPU_VTAB
/begin COMPU_METHOD AirMsPrTime_q0p0003_COMPU "" RAT_FUNC "%6.5" "g/s" COEFFS 0 3333.33333333333 0 0 0 1 /end COMPU_METHOD
/begin COMPU_METHOD AirMs_q0p1_COMPU "" RAT_FUNC "%6.3" "g" COEFFS 0 10 0 0 0 1 /end COMPU_METHOD
/begin COMPU_METHOD AIRPIN_TYPAVL_SY_Compu "" TAB_VERB "%6.3" "" COMPU_TAB_REF AIRPIN_TYPAVL_SY_Compu /end COMPU_METHOD
/begin COMPU_VTAB AIRPIN_TYPAVL_SY_Compu "" TAB_VERB 2 0 "False" 1 "True" /end COMPU_VTAB
/begin COMPU_METHOD AIRPOUT_TYPAVL_SC_Compu "" TAB_VERB "%6.3" "" COMPU_TAB_REF AIRPOUT_TYPAVL_SC_Compu /end COMPU_METHOD
/begin COMPU_VTAB AIRPOUT_TYPAVL_SC_Compu "" TAB_VERB 2 0 "False" 1 "True" /end COMPU_VTAB
/begin COMPU_METHOD AIRSNSR_DSQACTVT_SC_Compu "" TAB_VERB "%6.3" "" COMPU_TAB_REF AIRSNSR_DSQACTVT_SC_Compu /end COMPU_METHOD
/begin COMPU_VTAB AIRSNSR_DSQACTVT_SC_Compu "" TAB_VERB 2 0 "False" 1 "True" /end COMPU_VTAB
/begin COMPU_METHOD AIRSNSR_PSCCENGSTRT_SC_Compu "" TAB_VERB "%6.3" "" COMPU_TAB_REF AIRSNSR_PSCCENGSTRT_SC_Compu /end COMPU_METHOD
/begin COMPU_VTAB AIRSNSR_PSCCENGSTRT_SC_Compu "" TAB_VERB 2 0 "False" 1 "True" /end COMPU_VTAB
/begin COMPU_METHOD AirSysDdT_ms "" RAT_FUNC "%13.3" "ms" COEFFS 0 0 1 0 9.31322574615479e-006 0 /end COMPU_METHOD
/begin COMPU_METHOD AirSysSwt "" RAT_FUNC "%10.9" "-" COEFFS 0 16384000 0 0 0 1 /end COMPU_METHOD
/begin COMPU_METHOD AirSysSwt_S16 "" RAT_FUNC "%7.6" "-" COEFFS 0 16384 0 0 0 1 /end COMPU_METHOD
/begin COMPU_METHOD AIRSYS_ASYMC_SC_Compu "" TAB_VERB "%6.3" "" COMPU_TAB_REF AIRSYS_ASYMC_SC_Compu /end COMPU_METHOD
/begin COMPU_VTAB AIRSYS_ASYMC_SC_Compu "" TAB_VERB 2 0 "False" 1 "True" /end COMPU_VTAB
/begin COMPU_METHOD AIRTIN_TYPAVL_SC_Compu "" TAB_VERB "%6.3" "" COMPU_TAB_REF AIRTIN_TYPAVL_SC_Compu /end COMPU_METHOD
/begin COMPU_VTAB AIRTIN_TYPAVL_SC_Compu "" TAB_VERB 2 0 "False" 1 "True" /end COMPU_VTAB
/begin COMPU_METHOD AIRTOUT_TYPAVL_SY_Compu "" TAB_VERB "%6.3" "" COMPU_TAB_REF AIRTOUT_TYPAVL_SY_Compu /end COMPU_METHOD
/begin COMPU_VTAB AIRTOUT_TYPAVL_SY_Compu "" TAB_VERB 2 0 "False" 1 "True" /end COMPU_VTAB
/begin COMPU_METHOD AirVolPerTime "" RAT_FUNC "%6.3" "m^3/h" COEFFS 0 10 0 0 0 1 /end COMPU_METHOD
/begin COMPU_METHOD AIR_PCMPR2USPRES_SY_Compu "" TAB_VERB "%6.3" "" COMPU_TAB_REF AIR_PCMPR2USPRES_SY_Compu /end COMPU_METHOD
/begin COMPU_VTAB AIR_PCMPR2USPRES_SY_Compu "" TAB_VERB 2 0 "False" 1 "True" /end COMPU_VTAB
/begin COMPU_METHOD AltChpTemp_q8p0_COMPU "" RAT_FUNC "%6.2" "deg C" COEFFS 0 0.125 4 0 0 1 /end COMPU_METHOD
/begin COMPU_METHOD AltCrntLim_A_q0p25_COMPU "" RAT_FUNC "%6.3" "A" COEFFS 0 4 0 0 0 1 /end COMPU_METHOD
/begin COMPU_METHOD AltCrntOut_A_q0p125_COMPU "" RAT_FUNC "%6.3" "A" COEFFS 0 8 0 0 0 1 /end COMPU_METHOD
/begin COMPU_METHOD ALTIFTYP_SC_Compu "" TAB_VERB "%6.3" "" COMPU_TAB_REF ALTIFTYP_SC_Compu /end COMPU_METHOD
/begin COMPU_VTAB ALTIFTYP_SC_Compu "" TAB_VERB 2 0 "ALTIFTYP_0" 1 "ALTIFTYP_LOAD" /end COMPU_VTAB
/begin COMPU_METHOD ALTIOENA_SC_Compu "" TAB_VERB "%6.3" "" COMPU_TAB_REF ALTIOENA_SC_Compu /end COMPU_METHOD
/begin COMPU_VTAB ALTIOENA_SC_Compu "" TAB_VERB 2 0 "False" 1 "True" /end COMPU_VTAB
/begin COMPU_METHOD AltLd_q3p125_COMPU "" RAT_FUNC "%6.2" "%" COEFFS 0 0.32 0 0 0 1 /end COMPU_METHOD
/begin COMPU_METHOD AltVltg_V_q0p1_COMPU "" RAT_FUNC "%6.2" "V" COEFFS 0 10 -106 0 0 1 /end COMPU_METHOD
/begin COMPU_METHOD Ampere "" RAT_FUNC "%6.3" "mA" COEFFS 0 5 0 0 0 1 /end COMPU_METHOD
/begin COMPU_METHOD Ampere_q0p1_COMPU "" RAT_FUNC "%6.3" "uA" COEFFS 0 10 0 0 0 1 /end COMPU_METHOD
/begin COMPU_METHOD AMPT2NOxMPT_COMPU "" RAT_FUNC "%6.5" "(mg/s)/(Kg/h)" COEFFS 0 1000 0 0 0 1 /end COMPU_METHOD
/begin COMPU_METHOD AMPTDer_COMPU "" RAT_FUNC "%6.4" "(Kg/h)/s" COEFFS 0 100 0 0 0 1 /end COMPU_METHOD
/begin COMPU_METHOD AMPTgPerSec "" RAT_FUNC "%6.4" "g/s" COEFFS 0 20 0 0 0 1 /end COMPU_METHOD
/begin COMPU_METHOD AMPT_NOx "" RAT_FUNC "%8.7" "g/s" COEFFS 0 100000 0 0 0 1 /end COMPU_METHOD
/begin COMPU_METHOD AMPT_NOxLdUnld "" RAT_FUNC "%7.6" "g/s" COEFFS 0 10000 0 0 0 1 /end COMPU_METHOD
/begin COMPU_METHOD AMPT_NOxRgn "" RAT_FUNC "%6.5" "g/s" COEFFS 0 2000 0 0 0 1 /end COMPU_METHOD
/begin COMPU_METHOD AMPT_SOx1 "" RAT_FUNC "%6.4" "mg/s" COEFFS 0 333.333333333333 0 0 0 1 /end COMPU_METHOD
/begin COMPU_METHOD AngleIndexCpp "" RAT_FUNC "%6.2" "AgCA" COEFFS 0 -1 180 0 0 1 /end COMPU_METHOD
/begin COMPU_METHOD AngleStWhl "" RAT_FUNC "%6.4" "deg StWhl" COEFFS 0 32 0 0 0 1 /end COMPU_METHOD
/begin COMPU_METHOD AngleVelStWhl "" RAT_FUNC "%6.4" "deg StWhl/s" COEFFS 0 32 0 0 0 1 /end COMPU_METHOD
/begin COMPU_METHOD APPSWTECU_SY_Compu "" TAB_VERB "%6.3" "" COMPU_TAB_REF APPSWTECU_SY_Compu /end COMPU_METHOD
/begin COMPU_VTAB APPSWTECU_SY_Compu "" TAB_VERB 2 0 "FALSE" 1 "TRUE" /end COMPU_VTAB
/begin COMPU_METHOD B_TRUE "" TAB_VERB "%6.3" "" COMPU_TAB_REF B_TRUE /end COMPU_METHOD
/begin COMPU_VTAB B_TRUE "" TAB_VERB 2 0 "FALSE" 1 "TRUE" /end COMPU_VTAB
/begin COMPU_METHOD EngN "" RAT_FUNC "%6.3" "rpm" COEFFS 0 2 0 0 0 1 /end COMPU_METHOD
/begin COMPU_METHOD Fact "" RAT_FUNC "%6.5" "-" COEFFS 0 8192 0 0 0 1 /end COMPU_METHOD
/begin COMPU_METHOD Fact100 "" RAT_FUNC "%6.4" "-" COEFFS 0 100 0 0 0 1 /end COMPU_METHOD
/begin COMPU_METHOD Fact1000 "" RAT_FUNC "%6.5" "-" COEFFS 0 1000 0 0 0 1 /end COMPU_METHOD
/begin COMPU_METHOD Fact_10000 "" RAT_FUNC "%7.6" "-" COEFFS 0 10000 0 0 0 1 /end COMPU_METHOD
/begin COMPU_METHOD fak_q0p01 "" RAT_FUNC "%6.4" "" COEFFS 0 100 0 0 0 1 /end COMPU_METHOD
/begin COMPU_METHOD InjMsPrTime_q0p001_COMPU "" RAT_FUNC "%6.5" "Kg/h" COEFFS 0 1000 0 0 0 1 /end COMPU_METHOD
/begin COMPU_METHOD i_q1_mA "" RAT_FUNC "%6.2" "mA" COEFFS 0 1 0 0 0 1 /end COMPU_METHOD
/begin COMPU_METHOD O2MassPerTime "" RAT_FUNC "%6.4" "Kg/h" COEFFS 0 100 0 0 0 1 /end COMPU_METHOD
/begin COMPU_METHOD OneToOne "" RAT_FUNC "%6.2" "-" COEFFS 0 1 0 0 0 1 /end COMPU_METHOD
/begin COMPU_METHOD Prc "" RAT_FUNC "%6.4" "%" COEFFS 0 81.92 0 0 0 1 /end COMPU_METHOD
/begin COMPU_METHOD PrcPerSec "" RAT_FUNC "%6.3" "%/s" COEFFS 0 1.6384 0 0 0 1 /end COMPU_METHOD
/begin COMPU_METHOD Prc_Fact100 "" RAT_FUNC "%6.4" "%" COEFFS 0 100 0 0 0 1 /end COMPU_METHOD
/begin COMPU_METHOD PresAC_hPa "" RAT_FUNC "%6.2" "hPa" COEFFS 0 0.5 0 0 0 1 /end COMPU_METHOD
/begin COMPU_METHOD q0p0001_Perc "" RAT_FUNC "%7.6" "%" COEFFS 0 10000 0 0 0 1 /end COMPU_METHOD
/begin COMPU_METHOD RBPtCel_p_0p0001_2 "" RAT_FUNC "%7.6" "kPa" COEFFS 0 10000 0 0 0 1 /end COMPU_METHOD
/begin COMPU_METHOD RBPtCel_p_1p0_3 "" RAT_FUNC "%6.2" "kPa" COEFFS 0 1 0 0 0 1 /end COMPU_METHOD
/begin COMPU_METHOD RBPtCel_tq_0p0001_1 "" RAT_FUNC "%7.6" "Nm" COEFFS 0 10000 0 0 0 1 /end COMPU_METHOD
/begin COMPU_METHOD RBPtCel_t_0p0001_1 "" RAT_FUNC "%7.6" "kJ/kg" COEFFS 0 10000 0 0 0 1 /end COMPU_METHOD
/begin COMPU_METHOD RBPtCel_t_0p01_2 "" RAT_FUNC "%6.4" "kJ/kg" COEFFS 0 100 0 0 0 1 /end COMPU_METHOD
/begin COMPU_METHOD rel_uw_b200 "" RAT_FUNC "%6.4" "%" COEFFS 0 65536 0 0 0 200 /end COMPU_METHOD
/begin COMPU_METHOD RmpPresAC_hPa "" RAT_FUNC "%6.4" "hPa/s" COEFFS 0 32.768 0 0 0 1 /end COMPU_METHOD
/begin COMPU_METHOD Temp_Cels "" RAT_FUNC "%6.1" "deg C" COEFFS 0 10 2731.4 0 0 1 /end COMPU_METHOD
/begin COMPU_METHOD TimeDelay_s "" RAT_FUNC "%6.1" "s" COEFFS 0 0 1 0 0.00023283064365387 0 /end COMPU_METHOD
/begin COMPU_METHOD Time_ms "" RAT_FUNC "%6.1" "ms" COEFFS 0 0.1 0 0 0 1 /end COMPU_METHOD
/begin COMPU_METHOD Time_s "" RAT_FUNC "%6.4" "s" COEFFS 0 100 0 0 0 1 /end COMPU_METHOD
/begin COMPU_METHOD TransR "" RAT_FUNC "%6.4" "-" COEFFS 0 100 0 0 0 1 /end COMPU_METHOD
/begin COMPU_METHOD Trq "" RAT_FUNC "%6.3" "Nm" COEFFS 0 10 0 0 0 1 /end COMPU_METHOD
/begin COMPU_METHOD TrqPrpHigh "" RAT_FUNC "%6.3" "Nm" COEFFS 0 10 0 0 0 1 /end COMPU_METHOD
/begin COMPU_METHOD t_q0p01 "" RAT_FUNC "%6.4" "s" COEFFS 0 100 0 0 0 1 /end COMPU_METHOD
/begin COMPU_METHOD t_q0p02 "" RAT_FUNC "%6.4" "s" COEFFS 0 100 0 0 0 2 /end COMPU_METHOD
/begin COMPU_METHOD t_q0p1 "" RAT_FUNC "%6.3" "s" COEFFS 0 10 0 0 0 1 /end COMPU_METHOD
/begin COMPU_METHOD Vel "" RAT_FUNC "%6.4" "km/h" COEFFS 0 100 0 0 0 1 /end COMPU_METHOD
/begin COMPU_METHOD Volt "" RAT_FUNC "%6.3" "mV" COEFFS 0 5 0 0 0 1 /end COMPU_METHOD
/begin RECORD_LAYOUT Kw_Ws16 FNC_VALUES 1 SWORD COLUMN_DIR DIRECT /end RECORD_LAYOUT
/begin RECORD_LAYOUT Kw_Ws32 FNC_VALUES 1 SLONG COLUMN_DIR DIRECT /end RECORD_LAYOUT
/begin RECORD_LAYOUT Kw_Wu8 FNC_VALUES 1 UBYTE COLUMN_DIR DIRECT /end RECORD_LAYOUT
/begin RECORD_LAYOUT RB_Curve_S16_S16 NO_AXIS_PTS_X 1 SWORD AXIS_PTS_X 2 SWORD INDEX_INCR DIRECT FNC_VALUES 3 SWORD COLUMN_DIR DIRECT /end RECORD_LAYOUT
/begin RECORD_LAYOUT RB_Map_S16S16_S16 NO_AXIS_PTS_X 1 SWORD NO_AXIS_PTS_Y 2 SWORD AXIS_PTS_X 3 SWORD INDEX_INCR DIRECT AXIS_PTS_Y 4 SWORD INDEX_INCR DIRECT FNC_VALUES 5 SWORD COLUMN_DIR DIRECT /end RECORD_LAYOUT
/begin RECORD_LAYOUT RB_ValA_Ws16 FNC_VALUES 1 SWORD COLUMN_DIR DIRECT /end RECORD_LAYOUT
/begin RECORD_LAYOUT RB_ValA_Ws32 FNC_VALUES 1 SLONG COLUMN_DIR DIRECT /end RECORD_LAYOUT
/begin RECORD_LAYOUT RB_Val_Wboolean FNC_VALUES 1 UBYTE COLUMN_DIR DIRECT /end RECORD_LAYOUT
/begin RECORD_LAYOUT RB_Val_Ws16 FNC_VALUES 1 SWORD COLUMN_DIR DIRECT /end RECORD_LAYOUT
/begin RECORD_LAYOUT RB_Val_Ws32 FNC_VALUES 1 SLONG COLUMN_DIR DIRECT /end RECORD_LAYOUT
/begin RECORD_LAYOUT RB_Val_Ws8 FNC_VALUES 1 SBYTE COLUMN_DIR DIRECT /end RECORD_LAYOUT
/begin RECORD_LAYOUT RB_Val_Wu16 FNC_VALUES 1 UWORD COLUMN_DIR DIRECT /end RECORD_LAYOUT
/begin RECORD_LAYOUT RB_Val_Wu32 FNC_VALUES 1 ULONG COLUMN_DIR DIRECT /end RECORD_LAYOUT
/begin RECORD_LAYOUT RB_Val_Wu8 FNC_VALUES 1 UBYTE COLUMN_DIR DIRECT /end RECORD_LAYOUT
/begin RECORD_LAYOUT Val_Ws16 FNC_VALUES 1 SWORD COLUMN_DIR DIRECT /end RECORD_LAYOUT
/begin RECORD_LAYOUT Val_Ws32 FNC_VALUES 1 SLONG COLUMN_DIR DIRECT /end RECORD_LAYOUT
/begin RECORD_LAYOUT Val_Wu8 FNC_VALUES 1 UBYTE COLUMN_DIR DIRECT /end RECORD_LAYOUT
/*********** Start of merged UNIT blocks ***********/
/begin UNIT RB_RBA_Common_CentralElements_Units_NoUnit "No Unit" "noUnit" EXTENDED_SI SI_EXPONENTS 0 0 0 0 0 0 0 /end UNIT
/begin UNIT RB_RBA_rba_SyC_Rtc_Units_NoUnit "No Unit" "nounit" EXTENDED_SI SI_EXPONENTS 0 0 0 0 0 0 0 /end UNIT
/end MODULE
/end PROJECT
