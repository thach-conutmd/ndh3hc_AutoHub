ASAP2_VERSION 1 60
/begin PROJECT MG1CS022 "MG1CS022"
/begin HEADER "" VERSION "MG1CS022_62XSC_V037" PROJECT_NO MG1CS022 /end HEADER
/begin MODULE DIM ""
/begin MOD_PAR "MG1CS022" VERSION "MG1CS022_62XSC_V037" ADDR_EPK 0x804D8230 EPK "46/1/MDG1/159/MG1CS022//MG1CS022_62XSC_V037///" CUSTOMER_NO "159" USER "APPLICATOR" PHONE_NO "" ECU "MDG1" CPU_TYPE "IFX"
 SYSTEM_CONSTANT "SIGNALS_VIRTUAL_DCMDSPUDS_2699BYTE28_29_SIGNAL" "893"
 SYSTEM_CONSTANT "SIGNALS_VIRTUAL_DCMDSPUDS_2699BYTE2A_2B_SIGNAL" "894"
 SYSTEM_CONSTANT "SIGNALS_VIRTUAL_DCMDSPUDS_2699BYTE2E_SIGNAL" "895"
 SYSTEM_CONSTANT "SIGNALS_VIRTUAL_DCMDSPUDS_2699BYTE2F_30_SIGNAL" "896"
 SYSTEM_CONSTANT "SIGNALS_VIRTUAL_DCMDSPUDS_269ABYTE00_SIGNAL" "897"
 SYSTEM_CONSTANT "SIGNALS_VIRTUAL_DCMDSPUDS_269ABYTE01_SIGNAL" "898"
 SYSTEM_CONSTANT "SIGNALS_VIRTUAL_DCMDSPUDS_269ABYTE02_SIGNAL" "899"
 SYSTEM_CONSTANT "SIGNALS_VIRTUAL_DCMDSPUDS_269ABYTE03_SIGNAL" "900"
 SYSTEM_CONSTANT "SIGNALS_VIRTUAL_DCMDSPUDS_269ABYTE04_SIGNAL" "901"
 SYSTEM_CONSTANT "SIGNALS_VIRTUAL_DCMDSPUDS_269ABYTE05_SIGNAL" "902"
 SYSTEM_CONSTANT "SIGNALS_VIRTUAL_DCMDSPUDS_269BBYTE00_SIGNAL" "903"
 SYSTEM_CONSTANT "SIGNALS_VIRTUAL_DCMDSPUDS_269BBYTE01_SIGNAL" "904"
 SYSTEM_CONSTANT "SIGNALS_VIRTUAL_DCMDSPUDS_269BBYTE02_SIGNAL" "905"
 SYSTEM_CONSTANT "SIGNALS_VIRTUAL_DCMDSPUDS_269BBYTE03_SIGNAL" "906"
 SYSTEM_CONSTANT "SIGNALS_VIRTUAL_DCMDSPUDS_269BBYTE04_SIGNAL" "907"
 SYSTEM_CONSTANT "SIGNALS_VIRTUAL_DCMDSPUDS_269BBYTE05_SIGNAL" "908"
 SYSTEM_CONSTANT "SIGNALS_VIRTUAL_DCMDSPUDS_269EBYTE00_SIGNAL" "909"
 SYSTEM_CONSTANT "SIGNALS_VIRTUAL_DCMDSPUDS_269EBYTE01_SIGNAL" "910"
 SYSTEM_CONSTANT "SIGNALS_VIRTUAL_DCMDSPUDS_269EBYTE02_SIGNAL" "911"
 SYSTEM_CONSTANT "SIGNALS_VIRTUAL_DCMDSPUDS_269EBYTE03_SIGNAL" "912"
 SYSTEM_CONSTANT "SIGNALS_VIRTUAL_DCMDSPUDS_269EBYTE04_SIGNAL" "913"
 SYSTEM_CONSTANT "SIGNALS_VIRTUAL_DCMDSPUDS_269EBYTE05_SIGNAL" "914"
 SYSTEM_CONSTANT "SIGNALS_VIRTUAL_DCMDSPUDS_26A0BYTE00_SIGNAL" "915"
 SYSTEM_CONSTANT "SIGNALS_VIRTUAL_DCMDSPUDS_26A0BYTE01_SIGNAL" "916"
 SYSTEM_CONSTANT "SIGNALS_VIRTUAL_DCMDSPUDS_26A0BYTE02_SIGNAL" "917"
 SYSTEM_CONSTANT "SIGNALS_VIRTUAL_DCMDSPUDS_26A0BYTE03_SIGNAL" "918"
 SYSTEM_CONSTANT "SIGNALS_VIRTUAL_DCMDSPUDS_26A0BYTE04_SIGNAL" "919"
 SYSTEM_CONSTANT "SIGNALS_VIRTUAL_DCMDSPUDS_26A0BYTE05_SIGNAL" "920"
 SYSTEM_CONSTANT "SIGNALS_VIRTUAL_DCMDSPUDS_26A0BYTE06_SIGNAL" "921"
 SYSTEM_CONSTANT "SIGNALS_VIRTUAL_DCMDSPUDS_26A0BYTE07_SIGNAL" "922"
 SYSTEM_CONSTANT "SIGNALS_VIRTUAL_DCMDSPUDS_26A0BYTE08_SIGNAL" "923"
 SYSTEM_CONSTANT "SIGNALS_VIRTUAL_DCMDSPUDS_26A0BYTE09_SIGNAL" "924"
 SYSTEM_CONSTANT "SIGNALS_VIRTUAL_DCMDSPUDS_26A0BYTE0A_SIGNAL" "925"
 SYSTEM_CONSTANT "SIGNALS_VIRTUAL_DCMDSPUDS_26A0BYTE0B_SIGNAL" "926"
 SYSTEM_CONSTANT "SIGNALS_VIRTUAL_DCMDSPUDS_26A0BYTE0C_SIGNAL" "927"
 SYSTEM_CONSTANT "SIGNALS_VIRTUAL_DCMDSPUDS_26A0BYTE0D_SIGNAL" "928"
 SYSTEM_CONSTANT "SIGNALS_VIRTUAL_DCMDSPUDS_26A0BYTE0E_SIGNAL" "929"
 SYSTEM_CONSTANT "SIGNALS_VIRTUAL_DCMDSPUDS_26A0BYTE0F_SIGNAL" "930"
 SYSTEM_CONSTANT "SIGNALS_VIRTUAL_DCMDSPUDS_26A0BYTE10_SIGNAL" "931"
 SYSTEM_CONSTANT "SIGNALS_VIRTUAL_DCMDSPUDS_26A0BYTE11_SIGNAL" "932"
 SYSTEM_CONSTANT "SIGNALS_VIRTUAL_DCMDSPUDS_26A0BYTE12_SIGNAL" "933"
 SYSTEM_CONSTANT "SIGNALS_VIRTUAL_DCMDSPUDS_26A0BYTE13_SIGNAL" "934"
 SYSTEM_CONSTANT "SIGNALS_VIRTUAL_DCMDSPUDS_26A0BYTE14_SIGNAL" "935"
 SYSTEM_CONSTANT "SIGNALS_VIRTUAL_DCMDSPUDS_26A0BYTE15_SIGNAL" "936"
 SYSTEM_CONSTANT "SIGNALS_VIRTUAL_DCMDSPUDS_26A0BYTE16_SIGNAL" "937"
 SYSTEM_CONSTANT "SIGNALS_VIRTUAL_DCMDSPUDS_26A0BYTE17_SIGNAL" "938"
 SYSTEM_CONSTANT "SIGNALS_VIRTUAL_DCMDSPUDS_26A0BYTE18_SIGNAL" "939"
 SYSTEM_CONSTANT "SIGNALS_VIRTUAL_DCMDSPUDS_26A0BYTE19_SIGNAL" "940"
 SYSTEM_CONSTANT "SIGNALS_VIRTUAL_DCMDSPUDS_26A0BYTE1A_SIGNAL" "941"
 SYSTEM_CONSTANT "SIGNALS_VIRTUAL_DCMDSPUDS_26A0BYTE4E_SIGNAL" "942"
 SYSTEM_CONSTANT "SIGNALS_VIRTUAL_DCMDSPUDS_26A0BYTE52_53_SIGNAL" "943"
 SYSTEM_CONSTANT "SIGNALS_VIRTUAL_DCMDSPUDS_26A0BYTE54_55_SIGNAL" "944"
 SYSTEM_CONSTANT "SIGNALS_VIRTUAL_DCMDSPUDS_26A0BYTE56_57_SIGNAL" "945"
 SYSTEM_CONSTANT "SIGNALS_VIRTUAL_DCMDSPUDS_26A0BYTE66_SIGNAL" "946"
 SYSTEM_CONSTANT "SIGNALS_VIRTUAL_DCMDSPUDS_26A0BYTE67_SIGNAL" "947"
 SYSTEM_CONSTANT "SIGNALS_VIRTUAL_DCMDSPUDS_26A0BYTE68_SIGNAL" "948"
 SYSTEM_CONSTANT "SIGNALS_VIRTUAL_DCMDSPUDS_26A0BYTE69_SIGNAL" "949"
 SYSTEM_CONSTANT "SIGNALS_VIRTUAL_DCMDSPUDS_26A0BYTE6A_SIGNAL" "950"
 SYSTEM_CONSTANT "SIGNALS_VIRTUAL_DCMDSPUDS_26A0BYTE6B_SIGNAL" "951"
 SYSTEM_CONSTANT "SIGNALS_VIRTUAL_DCMDSPUDS_26A0BYTE6C_SIGNAL" "952"
 SYSTEM_CONSTANT "SIGNALS_VIRTUAL_DCMDSPUDS_26A0BYTE6D_SIGNAL" "953"
 SYSTEM_CONSTANT "SIGNALS_VIRTUAL_DCMDSPUDS_26A0BYTE7F_80_SIGNAL" "954"
 SYSTEM_CONSTANT "SIGNALS_VIRTUAL_DCMDSPUDS_26A0BYTE81_82_SIGNAL" "955"
 SYSTEM_CONSTANT "SIGNALS_VIRTUAL_DCMDSPUDS_26A0BYTE83_84_SIGNAL" "956"
 SYSTEM_CONSTANT "SIGNALS_VIRTUAL_DCMDSPUDS_26A0BYTE85_86_SIGNAL" "957"
 SYSTEM_CONSTANT "SIGNALS_VIRTUAL_DCMDSPUDS_26A0BYTE87_88_SIGNAL" "958"
 SYSTEM_CONSTANT "SIGNALS_VIRTUAL_DCMDSPUDS_26A0BYTE89_8A_SIGNAL" "959"
 SYSTEM_CONSTANT "SIGNALS_VIRTUAL_DCMDSPUDS_26A0BYTE8B_8C_SIGNAL" "960"
 SYSTEM_CONSTANT "SIGNALS_VIRTUAL_DCMDSPUDS_26A0BYTE8D_8E_SIGNAL" "961"
 SYSTEM_CONSTANT "SIGNALS_VIRTUAL_DCMDSPUDS_26A0BYTE8F_90_SIGNAL" "962"
 SYSTEM_CONSTANT "SIGNALS_VIRTUAL_DCMDSPUDS_26A0BYTE91_92_SIGNAL" "963"
 SYSTEM_CONSTANT "SIGNALS_VIRTUAL_DCMDSPUDS_26A0BYTE93_94_SIGNAL" "964"
 SYSTEM_CONSTANT "SIGNALS_VIRTUAL_DCMDSPUDS_26A0BYTE95_96_SIGNAL" "965"
 SYSTEM_CONSTANT "SIGNALS_VIRTUAL_DCMDSPUDS_26A0BYTE97_98_SIGNAL" "966"
 SYSTEM_CONSTANT "SIGNALS_VIRTUAL_DCMDSPUDS_26A0BYTE99_9A_SIGNAL" "967"
 SYSTEM_CONSTANT "SIGNALS_VIRTUAL_DCMDSPUDS_26A0BYTE9B_9C_SIGNAL" "968"
 SYSTEM_CONSTANT "SIGNALS_VIRTUAL_DCMDSPUDS_26A0BYTE9D_9E_SIGNAL" "969"
 SYSTEM_CONSTANT "SIGNALS_VIRTUAL_DCMDSPUDS_26A0BYTE9F_A0_SIGNAL" "970"
 SYSTEM_CONSTANT "SIGNALS_VIRTUAL_DCMDSPUDS_26A0BYTEA1_A2_SIGNAL" "971"
 SYSTEM_CONSTANT "SIGNALS_VIRTUAL_DCMDSPUDS_26A0BYTEA3_A4_SIGNAL" "972"
 SYSTEM_CONSTANT "SIGNALS_VIRTUAL_DCMDSPUDS_26A0BYTEA5_A6_SIGNAL" "973"
 SYSTEM_CONSTANT "SIGNALS_VIRTUAL_DCMDSPUDS_26A0BYTEA7_A8_SIGNAL" "974"
 SYSTEM_CONSTANT "SIGNALS_VIRTUAL_DCMDSPUDS_26A0BYTEA9_AA_SIGNAL" "975"
 SYSTEM_CONSTANT "SIGNALS_VIRTUAL_DCMDSPUDS_26A0BYTEAB_AC_SIGNAL" "976"
 SYSTEM_CONSTANT "SIGNALS_VIRTUAL_DCMDSPUDS_26A0BYTEAD_AE_SIGNAL" "977"
 SYSTEM_CONSTANT "SIGNALS_VIRTUAL_DCMDSPUDS_26A0BYTEAF_B0_SIGNAL" "978"
 SYSTEM_CONSTANT "SIGNALS_VIRTUAL_DCMDSPUDS_26A0BYTEB1_B2_SIGNAL" "979"
 SYSTEM_CONSTANT "SIGNALS_VIRTUAL_DCMDSPUDS_26A0BYTEB3_B4_SIGNAL" "980"
 SYSTEM_CONSTANT "SIGNALS_VIRTUAL_DCMDSPUDS_26A0BYTEB5_B6_SIGNAL" "981"
 SYSTEM_CONSTANT "SIGNALS_VIRTUAL_DCMDSPUDS_26A0BYTEB7_B8_SIGNAL" "982"
 SYSTEM_CONSTANT "SIGNALS_VIRTUAL_DCMDSPUDS_26A0BYTEB9_BA_SIGNAL" "983"
 SYSTEM_CONSTANT "SIGNALS_VIRTUAL_DCMDSPUDS_26A0BYTEBB_BC_SIGNAL" "984"
 SYSTEM_CONSTANT "SIGNALS_VIRTUAL_DCMDSPUDS_26A0BYTEBD_BE_SIGNAL" "985"
 SYSTEM_CONSTANT "SIGNALS_VIRTUAL_DCMDSPUDS_26A0BYTEBF_C0_SIGNAL" "986"
 SYSTEM_CONSTANT "SIGNALS_VIRTUAL_DCMDSPUDS_26A0BYTEC1_C2_SIGNAL" "987"
 SYSTEM_CONSTANT "SIGNALS_VIRTUAL_DCMDSPUDS_26A0BYTEC3_C4_SIGNAL" "988"
 SYSTEM_CONSTANT "SIGNALS_VIRTUAL_DCMDSPUDS_26A0BYTEC5_C6_SIGNAL" "989"
 SYSTEM_CONSTANT "SIGNALS_VIRTUAL_DCMDSPUDS_26A0BYTEC7_C8_SIGNAL" "990"
 SYSTEM_CONSTANT "SIGNALS_VIRTUAL_DCMDSPUDS_26A0BYTEC9_CA_SIGNAL" "991"
 SYSTEM_CONSTANT "SIGNALS_VIRTUAL_DCMDSPUDS_26A0BYTECB_CC_SIGNAL" "992"
 SYSTEM_CONSTANT "SIGNALS_VIRTUAL_DCMDSPUDS_26A0BYTECD_CE_SIGNAL" "993"
 SYSTEM_CONSTANT "SIGNALS_VIRTUAL_DCMDSPUDS_26A0BYTECF_D0_SIGNAL" "994"
 SYSTEM_CONSTANT "SIGNALS_VIRTUAL_DCMDSPUDS_26A0BYTED1_D2_SIGNAL" "995"
 SYSTEM_CONSTANT "SIGNALS_VIRTUAL_DCMDSPUDS_26A0BYTED3_D4_SIGNAL" "996"
 SYSTEM_CONSTANT "SIGNALS_VIRTUAL_DCMDSPUDS_26A0BYTED5_D6_SIGNAL" "997"
 SYSTEM_CONSTANT "SIGNALS_VIRTUAL_DCMDSPUDS_26A0BYTED7_D8_SIGNAL" "998"
 SYSTEM_CONSTANT "SIGNALS_VIRTUAL_DCMDSPUDS_26A0BYTED9_DA_SIGNAL" "999"
 SYSTEM_CONSTANT "SIGNALS_VIRTUAL_DCMDSPUDS_26A0BYTEDB_DC_SIGNAL" "1000"
 SYSTEM_CONSTANT "SIGNALS_VIRTUAL_DCMDSPUDS_26A0BYTEDD_DE_SIGNAL" "1001"
 SYSTEM_CONSTANT "SIGNALS_VIRTUAL_DCMDSPUDS_26A0BYTEDF_E0_SIGNAL" "1002"
 SYSTEM_CONSTANT "SIGNALS_VIRTUAL_DCMDSPUDS_26A0BYTEE1_E2_SIGNAL" "1003"
 SYSTEM_CONSTANT "SIGNALS_VIRTUAL_DCMDSPUDS_26A0BYTEE3_E4_SIGNAL" "1004"
 SYSTEM_CONSTANT "SIGNALS_VIRTUAL_DCMDSPUDS_26A0BYTEE5_E6_SIGNAL" "1005"
 SYSTEM_CONSTANT "SIGNALS_VIRTUAL_DCMDSPUDS_26A0BYTEE7_E8_SIGNAL" "1006"
 SYSTEM_CONSTANT "SIGNALS_VIRTUAL_DCMDSPUDS_26A0BYTEE9_EA_SIGNAL" "1007"
 SYSTEM_CONSTANT "SIGNALS_VIRTUAL_DCMDSPUDS_26A0BYTEEB_EC_SIGNAL" "1008"
 SYSTEM_CONSTANT "SIGNALS_VIRTUAL_DCMDSPUDS_26A0BYTEED_EE_SIGNAL" "1009"
 SYSTEM_CONSTANT "SIGNALS_VIRTUAL_DCMDSPUDS_26A0BYTEEF_F0_SIGNAL" "1010"
 SYSTEM_CONSTANT "SIGNALS_VIRTUAL_DCMDSPUDS_26A0BYTEF1_F2_SIGNAL" "1011"
 SYSTEM_CONSTANT "SIGNALS_VIRTUAL_DCMDSPUDS_26A1BYTE00_SIGNAL" "1012"
 SYSTEM_CONSTANT "SIGNALS_VIRTUAL_DCMDSPUDS_26A1BYTE01_SIGNAL" "1013"
 SYSTEM_CONSTANT "SIGNALS_VIRTUAL_DCMDSPUDS_26A1BYTE02_SIGNAL" "1014"
 SYSTEM_CONSTANT "SIGNALS_VIRTUAL_DCMDSPUDS_26A1BYTE03_SIGNAL" "1015"
 SYSTEM_CONSTANT "SIGNALS_VIRTUAL_DCMDSPUDS_26A1BYTE04_SIGNAL" "1016"
 SYSTEM_CONSTANT "SIGNALS_VIRTUAL_DCMDSPUDS_26A1BYTE05_SIGNAL" "1017"
 SYSTEM_CONSTANT "SIGNALS_VIRTUAL_DCMDSPUDS_26A1BYTE06_SIGNAL" "1018"
 SYSTEM_CONSTANT "SIGNALS_VIRTUAL_DCMDSPUDS_26A1BYTE07_SIGNAL" "1019"
 SYSTEM_CONSTANT "SIGNALS_VIRTUAL_DCMDSPUDS_26A1BYTE08_SIGNAL" "1020"
 SYSTEM_CONSTANT "SIGNALS_VIRTUAL_DCMDSPUDS_26A1BYTE09_SIGNAL" "1021"
 SYSTEM_CONSTANT "SIGNALS_VIRTUAL_DCMDSPUDS_26A1BYTE0A_SIGNAL" "1022"
 SYSTEM_CONSTANT "SIGNALS_VIRTUAL_DCMDSPUDS_26A1BYTE0B_SIGNAL" "1023"
 SYSTEM_CONSTANT "SIGNALS_VIRTUAL_DCMDSPUDS_26A1BYTE0C_SIGNAL" "1024"
 SYSTEM_CONSTANT "SIGNALS_VIRTUAL_DCMDSPUDS_26A1BYTE0D_SIGNAL" "1025"
 SYSTEM_CONSTANT "SIGNALS_VIRTUAL_DCMDSPUDS_26A1BYTE0E_SIGNAL" "1026"
 SYSTEM_CONSTANT "SIGNALS_VIRTUAL_DCMDSPUDS_26A1BYTE0F_SIGNAL" "1027"
 SYSTEM_CONSTANT "SIGNALS_VIRTUAL_DCMDSPUDS_26A1BYTE10_SIGNAL" "1028"
 SYSTEM_CONSTANT "SIGNALS_VIRTUAL_DCMDSPUDS_26A1BYTE11_SIGNAL" "1029"
 SYSTEM_CONSTANT "SIGNALS_VIRTUAL_DCMDSPUDS_26A1BYTE12_SIGNAL" "1030"
 SYSTEM_CONSTANT "SIGNALS_VIRTUAL_DCMDSPUDS_26A1BYTE13_SIGNAL" "1031"
 SYSTEM_CONSTANT "SIGNALS_VIRTUAL_DCMDSPUDS_26A1BYTE14_SIGNAL" "1032"
 SYSTEM_CONSTANT "SIGNALS_VIRTUAL_DCMDSPUDS_26A1BYTE15_SIGNAL" "1033"
 SYSTEM_CONSTANT "SIGNALS_VIRTUAL_DCMDSPUDS_26A1BYTE16_SIGNAL" "1034"
 SYSTEM_CONSTANT "SIGNALS_VIRTUAL_DCMDSPUDS_26A1BYTE17_SIGNAL" "1035"
 SYSTEM_CONSTANT "SIGNALS_VIRTUAL_DCMDSPUDS_26A1BYTE18_SIGNAL" "1036"
 SYSTEM_CONSTANT "SIGNALS_VIRTUAL_DCMDSPUDS_26A1BYTE19_SIGNAL" "1037"
 SYSTEM_CONSTANT "SIGNALS_VIRTUAL_DCMDSPUDS_26A1BYTE1A_SIGNAL" "1038"
 SYSTEM_CONSTANT "SIGNALS_VIRTUAL_DCMDSPUDS_26A1BYTE1B_1C_SIGNAL" "1039"
 SYSTEM_CONSTANT "SIGNALS_VIRTUAL_DCMDSPUDS_26A1BYTE1D_1E_SIGNAL" "1040"
 SYSTEM_CONSTANT "SIGNALS_VIRTUAL_DCMDSPUDS_26A1BYTE1F_20_SIGNAL" "1041"
 SYSTEM_CONSTANT "SIGNALS_VIRTUAL_DCMDSPUDS_26A1BYTE21_22_SIGNAL" "1042"
 SYSTEM_CONSTANT "SIGNALS_VIRTUAL_DCMDSPUDS_26A1BYTE23_24_SIGNAL" "1043"
 SYSTEM_CONSTANT "SIGNALS_VIRTUAL_DCMDSPUDS_26A1BYTE25_SIGNAL" "1044"
 SYSTEM_CONSTANT "SIGNALS_VIRTUAL_DCMDSPUDS_26A1BYTE26_SIGNAL" "1045"
 SYSTEM_CONSTANT "SIGNALS_VIRTUAL_DCMDSPUDS_26A1BYTE27_SIGNAL" "1046"
 SYSTEM_CONSTANT "SIGNALS_VIRTUAL_DCMDSPUDS_26A1BYTE28_SIGNAL" "1047"
 SYSTEM_CONSTANT "SIGNALS_VIRTUAL_DCMDSPUDS_26A1BYTE29_SIGNAL" "1048"
 SYSTEM_CONSTANT "SIGNALS_VIRTUAL_DCMDSPUDS_26A1BYTE2A_SIGNAL" "1049"
 SYSTEM_CONSTANT "SIGNALS_VIRTUAL_DCMDSPUDS_26A1BYTE2B_SIGNAL" "1050"
 SYSTEM_CONSTANT "SIGNALS_VIRTUAL_DCMDSPUDS_26A1BYTE2C_SIGNAL" "1051"
 SYSTEM_CONSTANT "SIGNALS_VIRTUAL_DCMDSPUDS_26A1BYTE2D_SIGNAL" "1052"
 SYSTEM_CONSTANT "SIGNALS_VIRTUAL_DCMDSPUDS_26A1BYTE2E_SIGNAL" "1053"
 SYSTEM_CONSTANT "SIGNALS_VIRTUAL_DCMDSPUDS_26A1BYTE2F_SIGNAL" "1054"
 SYSTEM_CONSTANT "SIGNALS_VIRTUAL_DCMDSPUDS_26A1BYTE30_SIGNAL" "1055"
 SYSTEM_CONSTANT "SIGNALS_VIRTUAL_DCMDSPUDS_26A1BYTE31_SIGNAL" "1056"
 SYSTEM_CONSTANT "SIGNALS_VIRTUAL_DCMDSPUDS_26A1BYTE32_SIGNAL" "1057"
 SYSTEM_CONSTANT "SIGNALS_VIRTUAL_DCMDSPUDS_26A1BYTE33_SIGNAL" "1058"
 SYSTEM_CONSTANT "SIGNALS_VIRTUAL_DCMDSPUDS_26A1BYTE34_SIGNAL" "1059"
 SYSTEM_CONSTANT "SIGNALS_VIRTUAL_DCMDSPUDS_26A1BYTE35_SIGNAL" "1060"
 SYSTEM_CONSTANT "SIGNALS_VIRTUAL_DCMDSPUDS_26A1BYTE36_SIGNAL" "1061"
 SYSTEM_CONSTANT "SIGNALS_VIRTUAL_DCMDSPUDS_26A1BYTE37_SIGNAL" "1062"
 SYSTEM_CONSTANT "SIGNALS_VIRTUAL_DCMDSPUDS_26A1BYTE38_SIGNAL" "1063"
 SYSTEM_CONSTANT "SIGNALS_VIRTUAL_DCMDSPUDS_26A1BYTE39_SIGNAL" "1064"
 SYSTEM_CONSTANT "SIGNALS_VIRTUAL_DCMDSPUDS_26A1BYTE6F_70_SIGNAL" "1065"
 SYSTEM_CONSTANT "SIGNALS_VIRTUAL_DCMDSPUDS_26A1BYTE71_72_SIGNAL" "1066"
 SYSTEM_CONSTANT "SIGNALS_VIRTUAL_DCMDSPUDS_26A1BYTE73_74_SIGNAL" "1067"
 SYSTEM_CONSTANT "SIGNALS_VIRTUAL_DCMDSPUDS_26A1BYTE75_76_SIGNAL" "1068"
 SYSTEM_CONSTANT "SIGNALS_VIRTUAL_DCMDSPUDS_26A1BYTE77_78_SIGNAL" "1069"
 SYSTEM_CONSTANT "SIGNALS_VIRTUAL_DCMDSPUDS_26A1BYTE79_SIGNAL" "1070"
 SYSTEM_CONSTANT "SIGNALS_VIRTUAL_DCMDSPUDS_26A1BYTE7B_SIGNAL" "1071"
 SYSTEM_CONSTANT "SIGNALS_VIRTUAL_DCMDSPUDS_26A2BYTE00_SIGNAL" "1072"
 SYSTEM_CONSTANT "SIGNALS_VIRTUAL_DCMDSPUDS_26A2BYTE01_SIGNAL" "1073"
 SYSTEM_CONSTANT "SIGNALS_VIRTUAL_DCMDSPUDS_26A2BYTE02_SIGNAL" "1074"
 SYSTEM_CONSTANT "SIGNALS_VIRTUAL_DCMDSPUDS_26A2BYTE03_SIGNAL" "1075"
 SYSTEM_CONSTANT "SIGNALS_VIRTUAL_DCMDSPUDS_26A2BYTE04_SIGNAL" "1076"
 SYSTEM_CONSTANT "SIGNALS_VIRTUAL_DCMDSPUDS_26A2BYTE05_SIGNAL" "1077"
 SYSTEM_CONSTANT "SIGNALS_VIRTUAL_DCMDSPUDS_26A2BYTE12_13_SIGNAL" "1078"
 SYSTEM_CONSTANT "SIGNALS_VIRTUAL_DCMDSPUDS_26A2BYTE1C_SIGNAL" "1079"
 SYSTEM_CONSTANT "SIGNALS_VIRTUAL_DCMDSPUDS_26A2BYTE1D_SIGNAL" "1080"
 SYSTEM_CONSTANT "SIGNALS_VIRTUAL_DCMDSPUDS_26A2BYTE21_SIGNAL" "1081"
 SYSTEM_CONSTANT "SIGNALS_VIRTUAL_DCMDSPUDS_26A2BYTE22_SIGNAL" "1082"
 SYSTEM_CONSTANT "SIGNALS_VIRTUAL_DCMDSPUDS_ACM_FZABGS_W_SIGNAL" "1083"
 SYSTEM_CONSTANT "SIGNALS_VIRTUAL_DCMDSPUDS_DID_2613BYTE2ETO2F_SIGNAL_VIRTFUNC_S" "1084"
 SYSTEM_CONSTANT "SIGNALS_VIRTUAL_DCMDSPUDS_DID_261ABYTE08_SIGNAL" "1085"
 SYSTEM_CONSTANT "SIGNALS_VIRTUAL_DCMDSPUDS_DID_261ABYTE09_SIGNAL" "1086"
 SYSTEM_CONSTANT "SIGNALS_VIRTUAL_DCMDSPUDS_DID_E402BYTE00_SIGNAL" "1087"
 SYSTEM_CONSTANT "SIGNALS_VIRTUAL_DCMDSPUDS_DID_E402BYTE01_SIGNAL" "1088"
 SYSTEM_CONSTANT "SIGNALS_VIRTUAL_DCMDSPUDS_DID_E402BYTE07TO08_SIGNAL" "1089"
 SYSTEM_CONSTANT "SIGNALS_VIRTUAL_DCMDSPUDS_DID_E402BYTE10TO11_SIGNAL" "1090"
 SYSTEM_CONSTANT "SIGNALS_VIRTUAL_DCMDSPUDS_DID_E402BYTE19TO1A_SIGNAL" "1091"
 SYSTEM_CONSTANT "SIGNALS_VIRTUAL_DCMDSPUDS_DID_E402BYTE22TO23_SIGNAL" "1092"
 SYSTEM_CONSTANT "SIGNALS_VIRTUAL_DCMDSPUDS_DID_E402BYTE2BTO2C_SIGNAL" "1093"
 SYSTEM_CONSTANT "SIGNALS_VIRTUAL_DCMDSPUDS_DID_F110BYTE0_3_SIGNAL" "1094"
 SYSTEM_CONSTANT "SIGNALS_VIRTUAL_DCMDSPUDS_DID_F110BYTE12_15_SIGNAL" "1095"
 SYSTEM_CONSTANT "SIGNALS_VIRTUAL_DCMDSPUDS_DID_F110BYTE16_SIGNAL" "1096"
 SYSTEM_CONSTANT "SIGNALS_VIRTUAL_DCMDSPUDS_DID_F110BYTE4_7_SIGNAL" "1097"
 SYSTEM_CONSTANT "SIGNALS_VIRTUAL_DCMDSPUDS_DID_F110BYTE8_11_SIGNAL" "1098"
 SYSTEM_CONSTANT "SIGNALS_VIRTUAL_DCMDSPUDS_DID_F112BYTE0_3_SIGNAL" "1099"
 SYSTEM_CONSTANT "SIGNALS_VIRTUAL_DCMDSPUDS_DID_F112BYTE12_15_SIGNAL" "1100"
 SYSTEM_CONSTANT "SIGNALS_VIRTUAL_DCMDSPUDS_DID_F112BYTE16_19_SIGNAL" "1101"
 SYSTEM_CONSTANT "SIGNALS_VIRTUAL_DCMDSPUDS_DID_F112BYTE20_23_SIGNAL" "1102"
 SYSTEM_CONSTANT "SIGNALS_VIRTUAL_DCMDSPUDS_DID_F112BYTE24_27_SIGNAL" "1103"
 SYSTEM_CONSTANT "SIGNALS_VIRTUAL_DCMDSPUDS_DID_F112BYTE28_29_SIGNAL" "1104"
 SYSTEM_CONSTANT "SIGNALS_VIRTUAL_DCMDSPUDS_DID_F112BYTE30_SIGNAL" "1105"
 SYSTEM_CONSTANT "SIGNALS_VIRTUAL_DCMDSPUDS_DID_F112BYTE4_7_SIGNAL" "1106"
 SYSTEM_CONSTANT "SIGNALS_VIRTUAL_DCMDSPUDS_DID_F112BYTE8_11_SIGNAL" "1107"
 SYSTEM_CONSTANT "SIGNALS_VIRTUAL_DCMDSPUDS_E602BYTE2_SIGNAL" "1108"
 SYSTEM_CONSTANT "SIGNALS_VIRTUAL_DCMDSPUDS_F181BYTE0_3_SIGNAL" "1109"
 SYSTEM_CONSTANT "SIGNALS_VIRTUAL_DCMDSPUDS_F181BYTE12_15_SIGNAL" "1110"
 SYSTEM_CONSTANT "SIGNALS_VIRTUAL_DCMDSPUDS_F181BYTE4_7_SIGNAL" "1111"
 SYSTEM_CONSTANT "SIGNALS_VIRTUAL_DCMDSPUDS_F181BYTE8_11_SIGNAL" "1112"
 SYSTEM_CONSTANT "SIGNALS_VIRTUAL_DCMDSPUDS_FZABGS_W_SIGNAL" "1113"
 SYSTEM_CONSTANT "SIGNALS_VIRTUAL_DCMDSPUDS_NUMREWRECUID1_SIGNAL" "1114"
 SYSTEM_CONSTANT "SIGNALS_VIRTUAL_DCMDSPUDS_NUMREWRECUID2_SIGNAL" "1115"
 SYSTEM_CONSTANT "SIGNALS_VIRTUAL_I14229B9_0490_FRNO09_SIGNAL" "1116"
 SYSTEM_CONSTANT "SIGNALS_VIRTUAL_I14229B9_0490_FRNO10_SIGNAL" "1117"
 SYSTEM_CONSTANT "SIGNALS_VIRTUAL_I14229B9_04B1_FRNO16_SIGNAL" "1118"
 SYSTEM_CONSTANT "SIGNALS_VIRTUAL_I14229B9_04B1_FRNO17_SIGNAL" "1119"
 SYSTEM_CONSTANT "SIGNALS_VIRTUAL_I14229B9_04B1_FRNO20_SIGNAL" "1120"
 SYSTEM_CONSTANT "SIGNALS_VIRTUAL_I14229B9_04B1_FRNO21_SIGNAL" "1121"
 SYSTEM_CONSTANT "SIGNALS_VIRTUAL_I14229B9_04B1_FRNO22_SIGNAL" "1122"
 SYSTEM_CONSTANT "SIGNALS_VIRTUAL_I14229B9_04B1_FRNO23_SIGNAL" "1123"
 SYSTEM_CONSTANT "SIGNALS_VIRTUAL_I14229B9_04C2_FRNO2021_SIGNAL" "1124"
 SYSTEM_CONSTANT "SIGNALS_VIRTUAL_I14229B9_04D2_FRNO24_SIGNAL" "1125"
 SYSTEM_CONSTANT "SIGNALS_VIRTUAL_I14229B9_04D2_FRNO25_SIGNAL" "1126"
 SYSTEM_CONSTANT "SIGNALS_VIRTUAL_I14229B9_0520_FRNO15_SIGNAL" "1127"
 SYSTEM_CONSTANT "SIGNALS_VIRTUAL_I14229B9_0520_FRNO16_SIGNAL" "1128"
 SYSTEM_CONSTANT "SIGNALS_VIRTUAL_I14229B9_0523_FRNO42_SIGNAL" "1129"
 SYSTEM_CONSTANT "SIGNALS_VIRTUAL_I14229B9_0523_FRNO43_SIGNAL" "1130"
 SYSTEM_CONSTANT "SIGNALS_VIRTUAL_I14229B9_0524_FRNO09_SIGNAL" "1131"
 SYSTEM_CONSTANT "SIGNALS_VIRTUAL_I14229B9_0524_FRNO10_SIGNAL" "1132"
 SYSTEM_CONSTANT "SIGNALS_VIRTUAL_I14229B9_0550_FRNO09_SIGNAL" "1133"
 SYSTEM_CONSTANT "SIGNALS_VIRTUAL_I14229B9_0550_FRNO10_SIGNAL" "1134"
 SYSTEM_CONSTANT "SIGNALS_VIRTUAL_I14229B9_0553_FRNO13_SIGNAL" "1135"
 SYSTEM_CONSTANT "SIGNALS_VIRTUAL_I14229B9_0553_FRNO14_SIGNAL" "1136"
 SYSTEM_CONSTANT "SIGNALS_VIRTUAL_I14229B9_056A_FRNO8_SIGNAL" "1137"
 SYSTEM_CONSTANT "SIGNALS_VIRTUAL_I14229B9_056A_FRNO9_SIGNAL" "1138"
 SYSTEM_CONSTANT "SIGNALS_VIRTUAL_I14229B9_0588_FRNO15_SIGNAL" "1139"
 SYSTEM_CONSTANT "SIGNALS_VIRTUAL_I14229B9_0588_FRNO16_SIGNAL" "1140"
 SYSTEM_CONSTANT "SIGNALS_VIRTUAL_I14229B9_05A0_FRNO40_SIGNAL" "1141"
 SYSTEM_CONSTANT "SIGNALS_VIRTUAL_I14229B9_05A0_FRNO41_SIGNAL" "1142"
 SYSTEM_CONSTANT "SIGNALS_VIRTUAL_I14229B9_05B0_FRNO13_SIGNAL" "1143"
 SYSTEM_CONSTANT "SIGNALS_VIRTUAL_I14229B9_05B0_FRNO14_SIGNAL" "1144"
 SYSTEM_CONSTANT "SIGNALS_VIRTUAL_I14229B9_05C0_FRNO12_SIGNAL" "1145"
 SYSTEM_CONSTANT "SIGNALS_VIRTUAL_I14229B9_05C0_FRNO13_SIGNAL" "1146"
 SYSTEM_CONSTANT "SIGNALS_VIRTUAL_I14229B9_05E0_FRNO19_SIGNAL" "1147"
 SYSTEM_CONSTANT "SIGNALS_VIRTUAL_I14229B9_05E0_FRNO20_SIGNAL" "1148"
 SYSTEM_CONSTANT "SIGNALS_VIRTUAL_I14229B9_05E0_FRNO21_SIGNAL" "1149"
 SYSTEM_CONSTANT "SIGNALS_VIRTUAL_I14229B9_05E0_FRNO22_SIGNAL" "1150"
 SYSTEM_CONSTANT "SIGNALS_VIRTUAL_I14229B9_05E0_FRNO23_SIGNAL" "1151"
 SYSTEM_CONSTANT "SIGNALS_VIRTUAL_I14229B9_05E0_FRNO24_SIGNAL" "1152"
 SYSTEM_CONSTANT "SIGNALS_VIRTUAL_I14229B9_1208_FRNO34_SIGNAL" "1153"
 SYSTEM_CONSTANT "SIGNALS_VIRTUAL_I14229B9_1208_FRNO35_SIGNAL" "1154"
 SYSTEM_CONSTANT "SIGNALS_VIRTUAL_I14229B9_1208_FRNO36_SIGNAL" "1155"
 SYSTEM_CONSTANT "SIGNALS_VIRTUAL_I14229B9_1208_FRNO37_SIGNAL" "1156"
 SYSTEM_CONSTANT "SIGNALS_VIRTUAL_I14229B9_120A_FRNO09_SIGNAL" "1157"
 SYSTEM_CONSTANT "SIGNALS_VIRTUAL_I14229B9_120A_FRNO10_SIGNAL" "1158"
 SYSTEM_CONSTANT "SIGNALS_VIRTUAL_I14229B9_120B_FRNO09_SIGNAL" "1159"
 SYSTEM_CONSTANT "SIGNALS_VIRTUAL_I14229B9_120B_FRNO10_SIGNAL" "1160"
 SYSTEM_CONSTANT "SIGNALS_VIRTUAL_I14229_AGINTKB1GEVLVSIG_SIGNAL" "1168"
 SYSTEM_CONSTANT "SIGNALS_VIRTUAL_I14229_COM_ALGTG_SIGNAL" "1161"
 SYSTEM_CONSTANT "SIGNALS_VIRTUAL_I14229_PENGSRTMIN_SIGNAL" "1162"
 SYSTEM_CONSTANT "SIGNALS_VIRTUAL_IKCTL_AGADPNCURR_S16_SIGNAL" "1163"
 SYSTEM_CONSTANT "SIGNALS_VIRTUAL_IKCTL_WINTGREF_AU32_0__S" "1164"
 SYSTEM_CONSTANT "SIGNALS_VIRTUAL_PTCOORNDYN_TQCLUDES_SIGNAL" "1165"
 SYSTEM_CONSTANT "SIGNALS_VIRTUAL_PTCOORNDYN_TQCLULEADTRSMINTV_SIGNAL" "1166"
 SYSTEM_CONSTANT "SIGNALS_VIRTUAL_TRA_NUMGEAR_SIGNAL" "1167"
 SYSTEM_CONSTANT "SIGQLY_FROZEN" "32"
 SYSTEM_CONSTANT "SIGQLY_INIT" "2"
 SYSTEM_CONSTANT "SIGQLY_INVALID" "64"
 SYSTEM_CONSTANT "SIGQLY_MODEL" "8"
 SYSTEM_CONSTANT "SIGQLY_NOTCALC" "1"
 SYSTEM_CONSTANT "SIGQLY_OK" "4"
 SYSTEM_CONSTANT "SIGQLY_REPLACEMENT" "16"
 SYSTEM_CONSTANT "Sig_I15031_LeanAppl_SY" "1"
 SYSTEM_CONSTANT "SIMPLE_SEG_SHIFT" "1"
 SYSTEM_CONSTANT "SMTACTR_SC" "0"
 SYSTEM_CONSTANT "SOTMASSPERSEC_RES" "0.1"
 SYSTEM_CONSTANT "SOTMASSPERSEC_RES_REV" "10"
 SYSTEM_CONSTANT "SOUNDTUN_SC" "0"
 SYSTEM_CONSTANT "SPAF_SY" "0"
 SYSTEM_CONSTANT "SPAVEL_RES" "10"
 SYSTEM_CONSTANT "SPC_SY" "0"
 SYSTEM_CONSTANT "SPDCTL_CRPINCBRKVAC_SC" "0"
 SYSTEM_CONSTANT "SPDCTL_DRVMODACTVTQRESV_SC" "0"
 SYSTEM_CONSTANT "SPDCTL_ENAGQUICKSTRT_SC" "0"
 SYSTEM_CONSTANT "SPDCTL_HPTQRESV_SC" "0"
 SYSTEM_CONSTANT "SPDCTL_HYB_SC" "0"
 SYSTEM_CONSTANT "SPDCTL_IDLESPDSPDEFRST_SC" "0"
 SYSTEM_CONSTANT "SPDCTL_SGA09LLSBSIZE_SC" "9"
 SYSTEM_CONSTANT "SPDCTL_TNRMAXSIZE_SC" "4"
 SYSTEM_CONSTANT "SPDCTL_TQLVL_SC" "1"
 SYSTEM_CONSTANT "SPDGOV_IARLS_BP" "8"
 SYSTEM_CONSTANT "SPDGOV_LOIDL_BP" "0"
 SYSTEM_CONSTANT "SPDGOV_NAGS_BP" "7"
 SYSTEM_CONSTANT "SPDGOV_NEGCURRTRQENA_BP" "6"
 SYSTEM_CONSTANT "SPDGOV_NEGLDTRQENA_BP" "5"
 SYSTEM_CONSTANT "SPDGOV_NGSH_BP" "2"
 SYSTEM_CONSTANT "SPDGOV_NMAX_BP" "1"
 SYSTEM_CONSTANT "SPDGOV_NSETP_ARRAY_CURR_POS" "0"
 SYSTEM_CONSTANT "SPDGOV_NSETP_ARRAY_HLSDEM_POS" "1"
 SYSTEM_CONSTANT "SPDGOV_NWRK_BP" "3"
 SYSTEM_CONSTANT "SPDGOV_RESVCONSTDEM_BP" "10"
 SYSTEM_CONSTANT "SPDGOV_RESVRELDEM_BP" "9"
 SYSTEM_CONSTANT "SPDGOV_SETPLO_ARRAYSIZE" "6"
 SYSTEM_CONSTANT "SPDGOV_TRQDEM" "4"
 SYSTEM_CONSTANT "SPDGOV_TRQDEM_BP" "4"
 SYSTEM_CONSTANT "SPDLIM_SY" "1"
 SYSTEM_CONSTANT "SPECHEATFINE_RES_REV" "5"
 SYSTEM_CONSTANT "SPECHEAT_RES" "2"
 SYSTEM_CONSTANT "SPECIFICHEAT_RES" "0.0001"
 SYSTEM_CONSTANT "SPECIFICHEAT_RES_REV" "10000"
 SYSTEM_CONSTANT "SPRT_SY" "1"
 SYSTEM_CONSTANT "SPTENGSTRT_SC" "0"
 SYSTEM_CONSTANT "SSPRITNUM_SY" "0"
 SYSTEM_CONSTANT "STADAP_INHCUST_SY" "0"
 SYSTEM_CONSTANT "STARTBACKUP" "13"
 SYSTEM_CONSTANT "STBINTVECU_AYCA_ZERO" "0"
 SYSTEM_CONSTANT "STBINTVECU_NEUTR" "0"
 SYSTEM_CONSTANT "STBINTVECU_TRQDOWN" "2"
 SYSTEM_CONSTANT "STBINTVECU_TRQUP" "1"
 SYSTEM_CONSTANT "STBINTVECU_ZERO" "3"
 SYSTEM_CONSTANT "STD" "0"
 SYSTEM_CONSTANT "STF_SY" "0"
 SYSTEM_CONSTANT "STNETHAD_INHCUST_SY" "0"
 SYSTEM_CONSTANT "STNETH_INHCUST_SY" "0"
 SYSTEM_CONSTANT "STNETH_SY" "0"
 SYSTEM_CONSTANT "STOPBACKUP" "12"
 SYSTEM_CONSTANT "STOPPHDREDN_SC" "0"
 SYSTEM_CONSTANT "STORED_STOP_POS" "0"
 SYSTEM_CONSTANT "STRGOILP_SC" "0"
 SYSTEM_CONSTANT "STRGTYP_SY" "0"
 SYSTEM_CONSTANT "STRTCTL_NTHRESSTRTCTOFF_MAPX" "6"
 SYSTEM_CONSTANT "STRTCTL_NTHRESSTRTCTOFF_MAPY" "3"
 SYSTEM_CONSTANT "STRTCTL_OFFAUTCRK_BP" "14"
 SYSTEM_CONSTANT "STRTCTL_OFFDRCT_BP" "10"
 SYSTEM_CONSTANT "STRTCTL_OFFERR_BP" "8"
 SYSTEM_CONSTANT "STRTCTL_OFFIDLESPSTTI_BP" "12"
 SYSTEM_CONSTANT "STRTCTL_OFFMANCRK_BP" "15"
 SYSTEM_CONSTANT "STRTCTL_OFFPANIC_BP" "4"
 SYSTEM_CONSTANT "STRTCTL_OFFRPMFLT_BP" "1"
 SYSTEM_CONSTANT "STRTCTL_OFFRPM_BP" "0"
 SYSTEM_CONSTANT "STRTCTL_OFFSPSTORD_BP" "13"
 SYSTEM_CONSTANT "STRTCTL_OFFT15_BP" "9"
 SYSTEM_CONSTANT "STRTCTL_OFFT50_BP" "7"
 SYSTEM_CONSTANT "STRTCTL_OFFTIFLT_BP" "3"
 SYSTEM_CONSTANT "STRTCTL_OFFTI_BP" "2"
 SYSTEM_CONSTANT "STRTCTL_OFFTRA_BP" "5"
 SYSTEM_CONSTANT "STRTCTL_ONEPUSHSTRT_SC" "1"
 SYSTEM_CONSTANT "STRTCTL_PRESTRTORD_BP" "7"
 SYSTEM_CONSTANT "STRTCTL_RLSDRV_BP" "9"
 SYSTEM_CONSTANT "STRTCTL_RLSNSTOP_BP" "10"
 SYSTEM_CONSTANT "STRTCTL_RLSREP_BP" "4"
 SYSTEM_CONSTANT "STRTCTL_RLSRPMLOW_BP" "6"
 SYSTEM_CONSTANT "STRTCTL_RLSRPM_BP" "1"
 SYSTEM_CONSTANT "STRTCTL_RLSSTRTOFF_BP" "2"
 SYSTEM_CONSTANT "STRTCTL_RLSTRA_BP" "3"
 SYSTEM_CONSTANT "STRTCTL_SC" "2"
 SYSTEM_CONSTANT "STRTCTL_STRTDLY_BP" "8"
 SYSTEM_CONSTANT "STRTCTL_STRTORD_BP" "0"
 SYSTEM_CONSTANT "STRTCTL_STRTRCLUCDN_BP" "13"
 SYSTEM_CONSTANT "STRTCTL_STRTRCUTRLYCDN_BP" "12"
 SYSTEM_CONSTANT "STRTCTL_STRTREQ_BP" "11"
 SYSTEM_CONSTANT "STRTCTL_STSPORD_BP" "5"
 SYSTEM_CONSTANT "STRTCTL_TISTRTCMFTMAX_CURX" "3"
 SYSTEM_CONSTANT "STRTCTL_TISTRTOPPANICMAX_MAPX" "3"
 SYSTEM_CONSTANT "STRTCTL_TISTRTOPPANICMAX_MAPY" "3"
 SYSTEM_CONSTANT "STRTCTL_TISTRTPWRMAX_CURX" "3"
 SYSTEM_CONSTANT "STRTCTL_VEHSPD_BP" "6"
 SYSTEM_CONSTANT "STRTEND_NENGCRIT_SET_NRITEM" "1"
 SYSTEM_CONSTANT "STRTEND_NENGDEB_SET_NRITEM" "1"
 SYSTEM_CONSTANT "STRTEND_NENGNRINJ_SET_NRITEM" "2"
 SYSTEM_CONSTANT "STRTEND_NENG_SET_NRITEM" "4"
 SYSTEM_CONSTANT "STRTTRQ_OFF" "0"
 SYSTEM_CONSTANT "STRTTRQ_ON" "1"
 SYSTEM_CONSTANT "STRT_ACTV" "1"
 SYSTEM_CONSTANT "STRT_FIN" "2"
 SYSTEM_CONSTANT "STRT_PS2_BP" "1"
 SYSTEM_CONSTANT "STRT_PSRET2_BP" "1"
 SYSTEM_CONSTANT "STRT_PSRET_BP" "0"
 SYSTEM_CONSTANT "STRT_PS_BP" "0"
 SYSTEM_CONSTANT "STRT_STRTRACTVNRLY_SC" "0"
 SYSTEM_CONSTANT "STSPTYP_SY" "0"
 SYSTEM_CONSTANT "STSP_EXT_SY" "0"
 SYSTEM_CONSTANT "STSP_SY" "1"
 SYSTEM_CONSTANT "STSYS_STRT" "1"
 SYSTEM_CONSTANT "STSYS_STRTDONE" "0"
 SYSTEM_CONSTANT "SUPCH_SY" "0"
 SYSTEM_CONSTANT "SVS_SY" "0"
 SYSTEM_CONSTANT "SWAPMP_PMP1_SY" "0"
 SYSTEM_CONSTANT "SWAPMP_PMP2_SY" "0"
 SYSTEM_CONSTANT "SWAPMP_PMP3_SY" "0"
 SYSTEM_CONSTANT "SWSVW_CHAELGDIAG_SY" "0"
 SYSTEM_CONSTANT "SWSVW_COPSPDDRVOFF_SY" "0"
 SYSTEM_CONSTANT "SWSVW_CS_SY" "0"
 SYSTEM_CONSTANT "SWSVW_DTEV_SY" "0"
 SYSTEM_CONSTANT "SWSVW_IFMBAL_SY" "0"
 SYSTEM_CONSTANT "SWSVW_LWBS_SY" "0"
 SYSTEM_CONSTANT "SWSVW_PCRMONOTURBO_SY" "0"
 SYSTEM_CONSTANT "SWSVW_PIGPROT_SY" "0"
 SYSTEM_CONSTANT "SWT_DISABLED" "0"
 SYSTEM_CONSTANT "SWT_ENABLED" "1"
 SYSTEM_CONSTANT "SYC_AFTRUNDIAG_SC" "0"
 SYSTEM_CONSTANT "SYC_CAL_PERMSPLYSYS_SY" "0"
 SYSTEM_CONSTANT "SYC_CNTPOSTDRV_SC" "0"
 SYSTEM_CONSTANT "SYC_COORD_SC" "0"
 SYSTEM_CONSTANT "SYC_DRIVE" "4"
 SYSTEM_CONSTANT "SYC_ENALCYPROLG_SC" "1"
 SYSTEM_CONSTANT "SYC_FSTSWOFF_SY" "0"
 SYSTEM_CONSTANT "SYC_INI" "0"
 SYSTEM_CONSTANT "SYC_INIEND" "2"
 SYSTEM_CONSTANT "SYC_INISYN" "1"
 SYSTEM_CONSTANT "SYC_MRLY_SC" "1"
 SYSTEM_CONSTANT "SYC_POSTDRIVE" "5"
 SYSTEM_CONSTANT "SYC_POST_OS_EXIT" "6"
 SYSTEM_CONSTANT "SYC_POWERUNDERVOLTAGE_SC" "1"
 SYSTEM_CONSTANT "SYC_POWER_SC" "1"
 SYSTEM_CONSTANT "SYC_PREDRIVE" "3"
 SYSTEM_CONSTANT "SYC_PREDRV_NWM" "4"
 SYSTEM_CONSTANT "SYC_PROLGPREDRV_SC" "0"
 SYSTEM_CONSTANT "SYC_SHUTDOWNSERVICES_SC" "1"
 SYSTEM_CONSTANT "SYC_SYSTYP_SC" "0"
 SYSTEM_CONSTANT "SYC_T15POSTPREDRV_SWRST_SY" "0"
 SYSTEM_CONSTANT "SYC_T15RSTSIM_SY" "1"
 SYSTEM_CONSTANT "SYC_WREEPBLK_SY" "1"
 SYSTEM_CONSTANT "SYC_X2ME_SC" "1"
 SYSTEM_CONSTANT "SYSA_DSQACTVT_SC" "0"
 SYSTEM_CONSTANT "SYSB_ENAUSER_SC" "0"
 SYSTEM_CONSTANT "SYSB_PHYTERMINAL15_SC" "1"
 SYSTEM_CONSTANT "SYSDIAG_EOLTESTCOORRENA_SC" "0"
 SYSTEM_CONSTANT "SYSDIAG_NRAFTRUNCOORRARRELEM_SC" "0"
 SYSTEM_CONSTANT "SYSDIAG_NROBDOBSVRCFG_SC" "0"
 SYSTEM_CONSTANT "SYSDIAG_SWTEMGYSTACTV_SC" "0"
 SYSTEM_CONSTANT "SY_2HDP2" "0"
 SYSTEM_CONSTANT "SY_2LBK" "0"
 SYSTEM_CONSTANT "SY_2SG" "0"
 SYSTEM_CONSTANT "SY_2SGHST" "0"
 SYSTEM_CONSTANT "SY_2TANK" "0"
 SYSTEM_CONSTANT "SY_2TEV" "0"
 SYSTEM_CONSTANT "SY_2VD" "0"
 SYSTEM_CONSTANT "SY_AAV" "0"
 SYSTEM_CONSTANT "SY_ABGKL" "0"
 SYSTEM_CONSTANT "SY_ABGY" "0"
 SYSTEM_CONSTANT "SY_ABGYVBP" "0"
 SYSTEM_CONSTANT "SY_ABMZND" "1"
 SYSTEM_CONSTANT "SY_ADTESK" "0"
 SYSTEM_CONSTANT "SY_AFIMVAR" "0"
 SYSTEM_CONSTANT "SY_AGR" "1"
 SYSTEM_CONSTANT "SY_AGR2" "0"
 SYSTEM_CONSTANT "SY_AGRBZSV" "0"
 SYSTEM_CONSTANT "SY_AGRCLV" "0"
 SYSTEM_CONSTANT "SY_AGREDK" "0"
 SYSTEM_CONSTANT "SY_AGREOA" "0"
 SYSTEM_CONSTANT "SY_AGREOB" "2"
 SYSTEM_CONSTANT "SY_AGRKOMP" "1"
 SYSTEM_CONSTANT "SY_AGRTS" "0"
 SYSTEM_CONSTANT "SY_AGRVR" "0"
 SYSTEM_CONSTANT "SY_AIRBAG" "0"
 SYSTEM_CONSTANT "SY_AMSHFMP" "0"
 SYSTEM_CONSTANT "SY_ANST" "0"
 SYSTEM_CONSTANT "SY_ANZEKP" "1"
 SYSTEM_CONSTANT "SY_ANZLUE" "2"
 SYSTEM_CONSTANT "SY_ANZPSLS" "0"
 SYSTEM_CONSTANT "SY_ANZSFST" "1"
 SYSTEM_CONSTANT "SY_ARC" "0"
 SYSTEM_CONSTANT "SY_ASG" "0"
 SYSTEM_CONSTANT "SY_ASGLC" "0"
 SYSTEM_CONSTANT "SY_ASM" "0"
 SYSTEM_CONSTANT "SY_ASR" "1"
 SYSTEM_CONSTANT "SY_ASTIKR" "0"
 SYSTEM_CONSTANT "SY_ASTNVK" "0"
 SYSTEM_CONSTANT "SY_ASTVHK" "0"
 SYSTEM_CONSTANT "SY_ASTVHK2" "0"
 SYSTEM_CONSTANT "SY_ASTVVK" "0"
 SYSTEM_CONSTANT "SY_ASV" "0"
 SYSTEM_CONSTANT "SY_ATLB" "0"
 SYSTEM_CONSTANT "SY_ATMTURB" "0"
 SYSTEM_CONSTANT "SY_ATMZA" "0"
 SYSTEM_CONSTANT "SY_ATR" "1"
 SYSTEM_CONSTANT "SY_ATURB" "0"
 SYSTEM_CONSTANT "SY_AUFLAD" "0"
 SYSTEM_CONSTANT "SY_AUFLAD2" "0"
 SYSTEM_CONSTANT "SY_BATTSG" "0"
 SYSTEM_CONSTANT "SY_BBBO" "1"
 SYSTEM_CONSTANT "SY_BBKOPT" "0"
 SYSTEM_CONSTANT "SY_BBSAWE" "0"
 SYSTEM_CONSTANT "SY_BDE" "1"
 SYSTEM_CONSTANT "SY_BGD3PK" "0"
 SYSTEM_CONSTANT "SY_BGSF" "0"
 SYSTEM_CONSTANT "SY_BH" "0"
 SYSTEM_CONSTANT "SY_BHIF" "1"
 SYSTEM_CONSTANT "SY_BKS" "0"
 SYSTEM_CONSTANT "SY_BKV" "2"
 SYSTEM_CONSTANT "SY_BKVP" "1"
 SYSTEM_CONSTANT "SY_BKVSRV" "1"
 SYSTEM_CONSTANT "SY_BOADAP" "0"
 SYSTEM_CONSTANT "SY_BOGALIM" "0"
 SYSTEM_CONSTANT "SY_BPEZEK" "1"
 SYSTEM_CONSTANT "SY_CAMNMSV" "4"
 SYSTEM_CONSTANT "SY_CATACT" "0"
 SYSTEM_CONSTANT "SY_CFCEO" "0"
 SYSTEM_CONSTANT "SY_CFMST" "0"
 SYSTEM_CONSTANT "SY_CHSPLMI" "0"
 SYSTEM_CONSTANT "SY_CJ230" "0"
 SYSTEM_CONSTANT "SY_CJ840" "0"
 SYSTEM_CONSTANT "SY_CJ841" "0"
 SYSTEM_CONSTANT "SY_CJ870" "0"
 SYSTEM_CONSTANT "SY_CK200" "0"
 SYSTEM_CONSTANT "SY_CK240" "0"
 SYSTEM_CONSTANT "SY_CK260" "0"
 SYSTEM_CONSTANT "SY_CKA" "0"
 SYSTEM_CONSTANT "SY_CNG" "0"
 SYSTEM_CONSTANT "SY_CPRDYL" "1"
 SYSTEM_CONSTANT "SY_CPRLAOX" "1"
 SYSTEM_CONSTANT "SY_CPRSCV" "0"
 SYSTEM_CONSTANT "SY_CVT" "1"
 SYSTEM_CONSTANT "SY_DAPRID" "0"
 SYSTEM_CONSTANT "SY_DCPV" "11"
 SYSTEM_CONSTANT "SY_DCPVLRR" "1"
 SYSTEM_CONSTANT "SY_DCPVPAS" "1"
 SYSTEM_CONSTANT "SY_DCPVSPL" "0"
 SYSTEM_CONSTANT "SY_DCV" "0"
 SYSTEM_CONSTANT "SY_DCYLIMB" "0"
 SYSTEM_CONSTANT "SY_DDS2A3" "0"
 SYSTEM_CONSTANT "SY_DDTLSFK" "0"
 SYSTEM_CONSTANT "SY_DDTLSHK" "0"
 SYSTEM_CONSTANT "SY_DECOS" "0"
 SYSTEM_CONSTANT "SY_DEGFE" "0"
 SYSTEM_CONSTANT "SY_DESOK" "0"
 SYSTEM_CONSTANT "SY_DEVAL" "1"
 SYSTEM_CONSTANT "SY_DFKTAV" "0"
 SYSTEM_CONSTANT "SY_DFKTAV2" "0"
 SYSTEM_CONSTANT "SY_DFKTSP" "0"
 SYSTEM_CONSTANT "SY_DFKTSP2" "0"
 SYSTEM_CONSTANT "SY_DFPMFFR" "1"
 SYSTEM_CONSTANT "SY_DFRAVUE" "0"
 SYSTEM_CONSTANT "SY_DFRST" "0"
 SYSTEM_CONSTANT "SY_DFSTTNL" "1"
 SYSTEM_CONSTANT "SY_DHDEVOE" "1"
 SYSTEM_CONSTANT "SY_DHKTAV" "0"
 SYSTEM_CONSTANT "SY_DHKTAV2" "0"
 SYSTEM_CONSTANT "SY_DHKTSP" "1"
 SYSTEM_CONSTANT "SY_DHKTSP2" "0"
 SYSTEM_CONSTANT "SY_DIGBT" "0"
 SYSTEM_CONSTANT "SY_DIONDE" "0"
 SYSTEM_CONSTANT "SY_DIRST" "1"
 SYSTEM_CONSTANT "SY_DISDPLT" "0"
 SYSTEM_CONSTANT "SY_DKATTE" "0"
 SYSTEM_CONSTANT "SY_DKNOTVVT" "0"
 SYSTEM_CONSTANT "SY_DKVFTAL" "0"
 SYSTEM_CONSTANT "SY_DKVSCMB" "0"
 SYSTEM_CONSTANT "SY_DKVSDFRM" "0"
 SYSTEM_CONSTANT "SY_DKVSFFC" "0"
 SYSTEM_CONSTANT "SY_DKVSSC" "1"
 SYSTEM_CONSTANT "SY_DLBTSZW" "1"
 SYSTEM_CONSTANT "SY_DLDP" "0"
 SYSTEM_CONSTANT "SY_DLDPATC" "1"
 SYSTEM_CONSTANT "SY_DLLRNPL" "1"
 SYSTEM_CONSTANT "SY_DLSHV" "0"
 SYSTEM_CONSTANT "SY_DLSHVTO" "0"
 SYSTEM_CONSTANT "SY_DLSUV" "0"
 SYSTEM_CONSTANT "SY_DMDADAP" "1"
 SYSTEM_CONSTANT "SY_DMDATEH" "1"
 SYSTEM_CONSTANT "SY_DMDBTGT" "0"
 SYSTEM_CONSTANT "SY_DMDCYLID" "0"
 SYSTEM_CONSTANT "SY_DMDFCER" "1"
 SYSTEM_CONSTANT "SY_DMDPAT" "0"
 SYSTEM_CONSTANT "SY_DMDSEGV" "1"
 SYSTEM_CONSTANT "SY_DMDSTQ" "50"
 SYSTEM_CONSTANT "SY_DMDTAL" "0"
 SYSTEM_CONSTANT "SY_DMDZAG" "2"
 SYSTEM_CONSTANT "SY_DMTL" "0"
 SYSTEM_CONSTANT "SY_DNSTAT" "0"
 SYSTEM_CONSTANT "SY_DOPZW" "0"
 SYSTEM_CONSTANT "SY_DPCS" "51"
 SYSTEM_CONSTANT "SY_DPLTCWL" "0"
 SYSTEM_CONSTANT "SY_DSKVND" "0"
 SYSTEM_CONSTANT "SY_DSKVRIN" "1"
 SYSTEM_CONSTANT "SY_DSKVSIN" "1"
 SYSTEM_CONSTANT "SY_DSLS" "0"
 SYSTEM_CONSTANT "SY_DSLSPS" "0"
 SYSTEM_CONSTANT "SY_DSM" "1"
 SYSTEM_CONSTANT "SY_DSMSUS" "0"
 SYSTEM_CONSTANT "SY_DSMSWOF" "1"
 SYSTEM_CONSTANT "SY_DSNDK" "0"
 SYSTEM_CONSTANT "SY_DSS" "1"
 SYSTEM_CONSTANT "SY_DSS2" "0"
 SYSTEM_CONSTANT "SY_DSTD" "0"
 SYSTEM_CONSTANT "SY_DSU" "1"
 SYSTEM_CONSTANT "SY_DSV2V" "0"
 SYSTEM_CONSTANT "SY_DSVDK" "0"
 SYSTEM_CONSTANT "SY_DSVDK2" "0"
 SYSTEM_CONSTANT "SY_DSVV" "0"
 SYSTEM_CONSTANT "SY_DTANKL" "1"
 SYSTEM_CONSTANT "SY_DTCWCS" "2"
 SYSTEM_CONSTANT "SY_DTCWHSC" "1"
 SYSTEM_CONSTANT "SY_DTHM" "0"
 SYSTEM_CONSTANT "SY_DVEADA" "1"
 SYSTEM_CONSTANT "SY_DVEAMP" "0"
 SYSTEM_CONSTANT "SY_DVEANZ" "1"
 SYSTEM_CONSTANT "SY_DVEFO" "1"
 SYSTEM_CONSTANT "SY_DVEKOMP" "4"
 SYSTEM_CONSTANT "SY_DVEKOOR" "0"
 SYSTEM_CONSTANT "SY_DYCOP" "0"
 SYSTEM_CONSTANT "SY_DYLSEVAL" "0"
 SYSTEM_CONSTANT "SY_DYLSF" "0"
 SYSTEM_CONSTANT "SY_DYLSH" "0"
 SYSTEM_CONSTANT "SY_DZWB2" "0"
 SYSTEM_CONSTANT "SY_DZWKS" "1"
 SYSTEM_CONSTANT "SY_EAOMSDK" "0"
 SYSTEM_CONSTANT "SY_EBFMOD" "3"
 SYSTEM_CONSTANT "SY_ECTPS1" "1"
 SYSTEM_CONSTANT "SY_ECTPS2" "3"
 SYSTEM_CONSTANT "SY_EDMMILA" "0"
 SYSTEM_CONSTANT "SY_EGAS" "1"
 SYSTEM_CONSTANT "SY_EOLT" "0"
 SYSTEM_CONSTANT "SY_ESIM" "0"
 SYSTEM_CONSTANT "SY_ETADZWF" "0"
 SYSTEM_CONSTANT "SY_ETAKHSV" "0"
 SYSTEM_CONSTANT "SY_ETAKHZW" "1"
 SYSTEM_CONSTANT "SY_ETHSENS" "1"
 SYSTEM_CONSTANT "SY_EWS" "0"
 SYSTEM_CONSTANT "SY_FABE" "1"
 SYSTEM_CONSTANT "SY_FAEVZUE" "0"
 SYSTEM_CONSTANT "SY_FAFSTKH" "0"
 SYSTEM_CONSTANT "SY_FAGALS" "0"
 SYSTEM_CONSTANT "SY_FANT" "0"
 SYSTEM_CONSTANT "SY_FAPAFG" "0"
 SYSTEM_CONSTANT "SY_FAWULA" "0"
 SYSTEM_CONSTANT "SY_FCOTSTR" "1"
 SYSTEM_CONSTANT "SY_FELMR" "1"
 SYSTEM_CONSTANT "SY_FEPB" "1"
 SYSTEM_CONSTANT "SY_FEPBAL" "0"
 SYSTEM_CONSTANT "SY_FFV" "1"
 SYSTEM_CONSTANT "SY_FFZ" "1"
 SYSTEM_CONSTANT "SY_FKAT" "0"
 SYSTEM_CONSTANT "SY_FLASHON" "0"
 SYSTEM_CONSTANT "SY_FLOAKT" "0"
 SYSTEM_CONSTANT "SY_FLUQ" "45"
 SYSTEM_CONSTANT "SY_FNSK" "0"
 SYSTEM_CONSTANT "SY_FNSWLK" "0"
 SYSTEM_CONSTANT "SY_FOFHEV" "0"
 SYSTEM_CONSTANT "SY_FOFSMPN" "11"
 SYSTEM_CONSTANT "SY_FPCCPV" "1"
 SYSTEM_CONSTANT "SY_FPCELPV" "0"
 SYSTEM_CONSTANT "SY_FPCES" "1"
 SYSTEM_CONSTANT "SY_FPCGWRK" "0"
 SYSTEM_CONSTANT "SY_FPCIMV" "0"
 SYSTEM_CONSTANT "SY_FPCLRBN" "1"
 SYSTEM_CONSTANT "SY_FPCMW" "1"
 SYSTEM_CONSTANT "SY_FPCPIN" "0"
 SYSTEM_CONSTANT "SY_FPCPR" "0"
 SYSTEM_CONSTANT "SY_FPCSSP" "0"
 SYSTEM_CONSTANT "SY_FPCSTRQ" "0"
 SYSTEM_CONSTANT "SY_FPCTKTM" "0"
 SYSTEM_CONSTANT "SY_FSGFS" "0"
 SYSTEM_CONSTANT "SY_FSGM" "1"
 SYSTEM_CONSTANT "SY_FSSKMA" "1"
 SYSTEM_CONSTANT "SY_FSSPRCT" "1"
 SYSTEM_CONSTANT "SY_FSSTPRS" "1"
 SYSTEM_CONSTANT "SY_FSSZPA" "1"
 SYSTEM_CONSTANT "SY_FSTCAN" "0"
 SYSTEM_CONSTANT "SY_FSTCEI" "0"
 SYSTEM_CONSTANT "SY_FSTK" "0"
 SYSTEM_CONSTANT "SY_FTIVDM" "0"
 SYSTEM_CONSTANT "SY_FTOFSLS" "1"
 SYSTEM_CONSTANT "SY_FUELVAP" "0"
 SYSTEM_CONSTANT "SY_FWLK" "0"
 SYSTEM_CONSTANT "SY_GAUSD" "0"
 SYSTEM_CONSTANT "SY_GDIPFI" "0"
 SYSTEM_CONSTANT "SY_GP" "0"
 SYSTEM_CONSTANT "SY_GRDWOF" "60"
 SYSTEM_CONSTANT "SY_GRDWRT" "102"
 SYSTEM_CONSTANT "SY_HDP" "2"
 SYSTEM_CONSTANT "SY_HDRFREQ" "1"
 SYSTEM_CONSTANT "SY_HDST" "1"
 SYSTEM_CONSTANT "SY_HEV" "0"
 SYSTEM_CONSTANT "SY_HFM" "1"
 SYSTEM_CONSTANT "SY_HFM2" "0"
 SYSTEM_CONSTANT "SY_HFMFIL" "1"
 SYSTEM_CONSTANT "SY_HFMKOMP" "1"
 SYSTEM_CONSTANT "SY_HFMPANZ" "3"
 SYSTEM_CONSTANT "SY_HFM_ANZKL" "1"
 SYSTEM_CONSTANT "SY_HKAT" "1"
 SYSTEM_CONSTANT "SY_HKS" "0"
 SYSTEM_CONSTANT "SY_HLSHRTP" "0"
 SYSTEM_CONSTANT "SY_HMB" "0"
 SYSTEM_CONSTANT "SY_HMBMBA" "0"
 SYSTEM_CONSTANT "SY_HMM" "0"
 SYSTEM_CONSTANT "SY_HOS" "0"
 SYSTEM_CONSTANT "SY_HSG" "0"
 SYSTEM_CONSTANT "SY_HSP" "1"
 SYSTEM_CONSTANT "SY_HSPMD" "1"
 SYSTEM_CONSTANT "SY_HSPNWS" "0"
 SYSTEM_CONSTANT "SY_IFOTMEN" "0"
 SYSTEM_CONSTANT "SY_IFTCWRP" "0"
 SYSTEM_CONSTANT "SY_IGIFLAG" "0"
 SYSTEM_CONSTANT "SY_INHIBIT" "1"
 SYSTEM_CONSTANT "SY_INI_OBD" "5"
 SYSTEM_CONSTANT "SY_INJADKM" "0"
 SYSTEM_CONSTANT "SY_ISG" "0"
 SYSTEM_CONSTANT "SY_IUMPR" "1"
 SYSTEM_CONSTANT "SY_KDHFM" "1"
 SYSTEM_CONSTANT "SY_KDS" "0"
 SYSTEM_CONSTANT "SY_KFLRA" "0"
 SYSTEM_CONSTANT "SY_KHETA" "1"
 SYSTEM_CONSTANT "SY_KHTMSFH" "1"
 SYSTEM_CONSTANT "SY_KJ" "0"
 SYSTEM_CONSTANT "SY_KOLBSC" "0"
 SYSTEM_CONSTANT "SY_KONWDK" "0"
 SYSTEM_CONSTANT "SY_KOP" "0"
 SYSTEM_CONSTANT "SY_KORRZ" "1"
 SYSTEM_CONSTANT "SY_KRADPZI" "1"
 SYSTEM_CONSTANT "SY_KRK" "0"
 SYSTEM_CONSTANT "SY_KRLZ" "1"
 SYSTEM_CONSTANT "SY_KRSAINT" "0"
 SYSTEM_CONSTANT "SY_KRSASW" "1"
 SYSTEM_CONSTANT "SY_KRZMF" "1"
 SYSTEM_CONSTANT "SY_KS1" "0"
 SYSTEM_CONSTANT "SY_KS2" "1"
 SYSTEM_CONSTANT "SY_KS3" "2"
 SYSTEM_CONSTANT "SY_KS4" "3"
 SYSTEM_CONSTANT "SY_KSENCHN" "3"
 SYSTEM_CONSTANT "SY_KSENFLT" "10"
 SYSTEM_CONSTANT "SY_KSZA" "1"
 SYSTEM_CONSTANT "SY_KT" "0"
 SYSTEM_CONSTANT "SY_KUPOT" "0"
 SYSTEM_CONSTANT "SY_LAMKAPP" "1"
 SYSTEM_CONSTANT "SY_LAMNSWLP" "0"
 SYSTEM_CONSTANT "SY_LAYER" "0"
 SYSTEM_CONSTANT "SY_LBK" "0"
 SYSTEM_CONSTANT "SY_LBKMD" "0"
 SYSTEM_CONSTANT "SY_LCSS" "0"
 SYSTEM_CONSTANT "SY_LEITMOD" "1"
 SYSTEM_CONSTANT "SY_LENKH" "0"
 SYSTEM_CONSTANT "SY_LF2B" "0"
 SYSTEM_CONSTANT "SY_LLKEO" "1"
 SYSTEM_CONSTANT "SY_LOWRA" "0"
 SYSTEM_CONSTANT "SY_LPG" "0"
 SYSTEM_CONSTANT "SY_LPI" "0"
 SYSTEM_CONSTANT "SY_LR2PAR" "0"
 SYSTEM_CONSTANT "SY_LRAT" "0"
 SYSTEM_CONSTANT "SY_LRATKG" "0"
 SYSTEM_CONSTANT "SY_LREBPS" "0"
 SYSTEM_CONSTANT "SY_LRFK" "0"
 SYSTEM_CONSTANT "SY_LRFK2" "0"
 SYSTEM_CONSTANT "SY_LRFKEF" "0"
 SYSTEM_CONSTANT "SY_LRSEZ" "0"
 SYSTEM_CONSTANT "SY_LS" "0"
 SYSTEM_CONSTANT "SY_LSAGETR" "0"
 SYSTEM_CONSTANT "SY_LSFIKR" "0"
 SYSTEM_CONSTANT "SY_LSFIKR2" "0"
 SYSTEM_CONSTANT "SY_LSFNHK" "1"
 SYSTEM_CONSTANT "SY_LSFNHK2" "0"
 SYSTEM_CONSTANT "SY_LSFNTL" "0"
 SYSTEM_CONSTANT "SY_LSFNTL2" "0"
 SYSTEM_CONSTANT "SY_LSFNVK" "0"
 SYSTEM_CONSTANT "SY_LSFNVK2" "0"
 SYSTEM_CONSTANT "SY_LSFV" "0"
 SYSTEM_CONSTANT "SY_LSFVHK" "0"
 SYSTEM_CONSTANT "SY_LSFVHK2" "0"
 SYSTEM_CONSTANT "SY_LSFVVK" "0"
 SYSTEM_CONSTANT "SY_LSFVVK2" "0"
 SYSTEM_CONSTANT "SY_LSHV" "0"
 SYSTEM_CONSTANT "SY_LSUIKR" "0"
 SYSTEM_CONSTANT "SY_LSUIKR2" "0"
 SYSTEM_CONSTANT "SY_LSUNHK" "0"
 SYSTEM_CONSTANT "SY_LSUNHK2" "0"
 SYSTEM_CONSTANT "SY_LSUNTL" "1"
 SYSTEM_CONSTANT "SY_LSUNTL2" "0"
 SYSTEM_CONSTANT "SY_LSUNVK" "0"
 SYSTEM_CONSTANT "SY_LSUNVK2" "0"
 SYSTEM_CONSTANT "SY_LSUVHK" "0"
 SYSTEM_CONSTANT "SY_LSUVHK2" "0"
 SYSTEM_CONSTANT "SY_LSUVVK" "0"
 SYSTEM_CONSTANT "SY_LSUVVK2" "0"
 SYSTEM_CONSTANT "SY_LSVV" "0"
 SYSTEM_CONSTANT "SY_LSZYVER" "0"
 SYSTEM_CONSTANT "SY_LUFAK" "140.7374884"
 SYSTEM_CONSTANT "SY_LUSRKR" "0"
 SYSTEM_CONSTANT "SY_LWMEXT" "0"
 SYSTEM_CONSTANT "SY_M8TE" "0"
 SYSTEM_CONSTANT "SY_MAGER" "0"
 SYSTEM_CONSTANT "SY_MDBGHS" "0"
 SYSTEM_CONSTANT "SY_MDBGTI" "0"
 SYSTEM_CONSTANT "SY_MDI" "1"
 SYSTEM_CONSTANT "SY_MDISTM" "0"
 SYSTEM_CONSTANT "SY_MDMXEXC" "1"
 SYSTEM_CONSTANT "SY_MEVD172" "0"
 SYSTEM_CONSTANT "SY_MSDKN" "0"
 SYSTEM_CONSTANT "SY_MSGRED" "0"
 SYSTEM_CONSTANT "SY_MSVKOMP" "2"
 SYSTEM_CONSTANT "SY_MTRXBLR" "0"
 SYSTEM_CONSTANT "SY_NG" "0"
 SYSTEM_CONSTANT "SY_NLLKHFH" "0"
 SYSTEM_CONSTANT "SY_NLZOFF" "0"
 SYSTEM_CONSTANT "SY_NOHK" "0"
 SYSTEM_CONSTANT "SY_NOKT" "1"
 SYSTEM_CONSTANT "SY_NOXKAT" "0"
 SYSTEM_CONSTANT "SY_NOXKAT2" "0"
 SYSTEM_CONSTANT "SY_NSAC" "2"
 SYSTEM_CONSTANT "SY_NSAD" "1"
 SYSTEM_CONSTANT "SY_NSALT" "0"
 SYSTEM_CONSTANT "SY_NSASG" "0"
 SYSTEM_CONSTANT "SY_NSBLP" "0"
 SYSTEM_CONSTANT "SY_NSCAM" "0"
 SYSTEM_CONSTANT "SY_NSCAT" "1"
 SYSTEM_CONSTANT "SY_NSCDE" "0"
 SYSTEM_CONSTANT "SY_NSCRP" "0"
 SYSTEM_CONSTANT "SY_NSCVT" "0"
 SYSTEM_CONSTANT "SY_NSFLX" "1"
 SYSTEM_CONSTANT "SY_NSGEN" "0"
 SYSTEM_CONSTANT "SY_NSHTD" "1"
 SYSTEM_CONSTANT "SY_NSHTI" "1"
 SYSTEM_CONSTANT "SY_NSKO" "0"
 SYSTEM_CONSTANT "SY_NSLPH" "2"
 SYSTEM_CONSTANT "SY_NSLWR" "0"
 SYSTEM_CONSTANT "SY_NSP" "0"
 SYSTEM_CONSTANT "SY_NSPST" "0"
 SYSTEM_CONSTANT "SY_NSPTS" "1"
 SYSTEM_CONSTANT "SY_NSPWG" "0"
 SYSTEM_CONSTANT "SY_NSREC" "0"
 SYSTEM_CONSTANT "SY_NSRNG" "0"
 SYSTEM_CONSTANT "SY_NSSTR" "0"
 SYSTEM_CONSTANT "SY_NSTCU" "0"
 SYSTEM_CONSTANT "SY_NSTST" "0"
 SYSTEM_CONSTANT "SY_NSVSP" "0"
 SYSTEM_CONSTANT "SY_NSWIH" "0"
 SYSTEM_CONSTANT "SY_NVLD" "0"
 SYSTEM_CONSTANT "SY_NVRAMBK" "1"
 SYSTEM_CONSTANT "SY_NWGA" "0"
 SYSTEM_CONSTANT "SY_NWGA2" "0"
 SYSTEM_CONSTANT "SY_NWGE" "1"
 SYSTEM_CONSTANT "SY_NWGE2" "0"
 SYSTEM_CONSTANT "SY_NWMSV" "0"
 SYSTEM_CONSTANT "SY_NWS" "2"
 SYSTEM_CONSTANT "SY_NWSA" "0"
 SYSTEM_CONSTANT "SY_NWSHSS" "0"
 SYSTEM_CONSTANT "SY_NWSKR" "1"
 SYSTEM_CONSTANT "SY_NWSV" "0"
 SYSTEM_CONSTANT "SY_OBDBR05" "1"
 SYSTEM_CONSTANT "SY_OBMD" "0"
 SYSTEM_CONSTANT "SY_OSTERST" "1"
 SYSTEM_CONSTANT "SY_OSTNOFF" "0"
 SYSTEM_CONSTANT "SY_OTMERST" "1"
 SYSTEM_CONSTANT "SY_PABMODU" "0"
 SYSTEM_CONSTANT "SY_PAFGBE" "0"
 SYSTEM_CONSTANT "SY_PEMDIA" "0"
 SYSTEM_CONSTANT "SY_PID41" "1"
 SYSTEM_CONSTANT "SY_PLNGFIL" "0"
 SYSTEM_CONSTANT "SY_PRIOHOM" "24"
 SYSTEM_CONSTANT "SY_PRIOHSP" "16"
 SYSTEM_CONSTANT "SY_PRIOMOD" "57"
 SYSTEM_CONSTANT "SY_PRSOLAD" "0"
 SYSTEM_CONSTANT "SY_PSF" "0"
 SYSTEM_CONSTANT "SY_PSMXAPP" "0"
 SYSTEM_CONSTANT "SY_PSR2SYN" "0"
 SYSTEM_CONSTANT "SY_PSTDRST" "0"
 SYSTEM_CONSTANT "SY_PSUV" "0"
 SYSTEM_CONSTANT "SY_PTL" "1"
 SYSTEM_CONSTANT "SY_PTLHC" "1"
 SYSTEM_CONSTANT "SY_PTO" "0"
 SYSTEM_CONSTANT "SY_RDE" "3"
 SYSTEM_CONSTANT "SY_RDYTLDX" "1"
 SYSTEM_CONSTANT "SY_REDEX" "1"
 SYSTEM_CONSTANT "SY_REDMI" "0"
 SYSTEM_CONSTANT "SY_REDSTAR" "1"
 SYSTEM_CONSTANT "SY_RLAPP" "1"
 SYSTEM_CONSTANT "SY_RLMXKV" "1"
 SYSTEM_CONSTANT "SY_RLRK" "1"
 SYSTEM_CONSTANT "SY_RLXDZW" "1"
 SYSTEM_CONSTANT "SY_RLXRED" "0"
 SYSTEM_CONSTANT "SY_RLXVD" "1"
 SYSTEM_CONSTANT "SY_RQMNUGA" "0"
 SYSTEM_CONSTANT "SY_RVS" "0"
 SYSTEM_CONSTANT "SY_RZSZ" "0"
 SYSTEM_CONSTANT "SY_SAGS" "1"
 SYSTEM_CONSTANT "SY_SALSU" "0"
 SYSTEM_CONSTANT "SY_SCG" "0"
 SYSTEM_CONSTANT "SY_SCH" "0"
 SYSTEM_CONSTANT "SY_SCHUMZW" "0"
 SYSTEM_CONSTANT "SY_SGANZ" "1"
 SYSTEM_CONSTANT "SY_SGANZFR" "1"
 SYSTEM_CONSTANT "SY_SKH" "0"
 SYSTEM_CONSTANT "SY_SKR" "0"
 SYSTEM_CONSTANT "SY_SLPANZ" "0"
 SYSTEM_CONSTANT "SY_SLS" "0"
 SYSTEM_CONSTANT "SY_SLVANZ" "0"
 SYSTEM_CONSTANT "SY_SLVEST" "0"
 SYSTEM_CONSTANT "SY_SOTUN" "0"
 SYSTEM_CONSTANT "SY_SPRSTRT" "0"
 SYSTEM_CONSTANT "SY_SSPDSKV" "1"
 SYSTEM_CONSTANT "SY_SSPPSR" "2"
 SYSTEM_CONSTANT "SY_STA" "1"
 SYSTEM_CONSTANT "SY_STADAP" "0"
 SYSTEM_CONSTANT "SY_STAEVAB" "0"
 SYSTEM_CONSTANT "SY_STARTDK" "1"
 SYSTEM_CONSTANT "SY_STASTO" "1"
 SYSTEM_CONSTANT "SY_STELRHE" "0"
 SYSTEM_CONSTANT "SY_STERBTS" "0"
 SYSTEM_CONSTANT "SY_STERHK" "0"
 SYSTEM_CONSTANT "SY_STERSY" "0"
 SYSTEM_CONSTANT "SY_STERVK" "0"
 SYSTEM_CONSTANT "SY_STETLR" "1"
 SYSTEM_CONSTANT "SY_SU" "0"
 SYSTEM_CONSTANT "SY_SUV" "0"
 SYSTEM_CONSTANT "SY_SUVTYP" "0"
 SYSTEM_CONSTANT "SY_SVBB" "1"
 SYSTEM_CONSTANT "SY_TAHEVCH" "0"
 SYSTEM_CONSTANT "SY_TAKH" "1"
 SYSTEM_CONSTANT "SY_TANDK" "0"
 SYSTEM_CONSTANT "SY_TANSPOS" "1"
 SYSTEM_CONSTANT "SY_TASR" "1"
 SYSTEM_CONSTANT "SY_TASR2" "0"
 SYSTEM_CONSTANT "SY_TAVDK" "0"
 SYSTEM_CONSTANT "SY_TAVDK2" "0"
 SYSTEM_CONSTANT "SY_TAVV" "0"
 SYSTEM_CONSTANT "SY_TAVVM" "0"
 SYSTEM_CONSTANT "SY_TCNS" "0"
 SYSTEM_CONSTANT "SY_TEBF" "0"
 SYSTEM_CONSTANT "SY_TEETH" "60"
 SYSTEM_CONSTANT "SY_TEV5" "0"
 SYSTEM_CONSTANT "SY_TEVANZ" "1"
 SYSTEM_CONSTANT "SY_TFA1GRD" "0"
 SYSTEM_CONSTANT "SY_TFA2GRD" "0"
 SYSTEM_CONSTANT "SY_TFA2POS" "6"
 SYSTEM_CONSTANT "SY_TFA3GRD" "0"
 SYSTEM_CONSTANT "SY_TFA4GRD" "0"
 SYSTEM_CONSTANT "SY_TFAJEC" "1"
 SYSTEM_CONSTANT "SY_TFAKON" "1"
 SYSTEM_CONSTANT "SY_TFAST" "1"
 SYSTEM_CONSTANT "SY_TFATSTR" "1"
 SYSTEM_CONSTANT "SY_TFBA" "0"
 SYSTEM_CONSTANT "SY_TFLTKCD" "0"
 SYSTEM_CONSTANT "SY_TFLTNK" "0"
 SYSTEM_CONSTANT "SY_TFMO" "0"
 SYSTEM_CONSTANT "SY_TFRK" "0"
 SYSTEM_CONSTANT "SY_TFST" "0"
 SYSTEM_CONSTANT "SY_TFSTQ" "10"
 SYSTEM_CONSTANT "SY_TFUEL" "2"
 SYSTEM_CONSTANT "SY_TFUELCN" "0"
 SYSTEM_CONSTANT "SY_TFVA" "0"
 SYSTEM_CONSTANT "SY_TKA" "1"
 SYSTEM_CONSTANT "SY_TKAA" "0"
 SYSTEM_CONSTANT "SY_TKACSD" "1"
 SYSTEM_CONSTANT "SY_TLDRMP" "0"
 SYSTEM_CONSTANT "SY_TLRARES" "0"
 SYSTEM_CONSTANT "SY_TMDR" "0"
 SYSTEM_CONSTANT "SY_TMO2KA" "2"
 SYSTEM_CONSTANT "SY_TMOHKS" "0"
 SYSTEM_CONSTANT "SY_TMOHSST" "0"
 SYSTEM_CONSTANT "SY_TMOLAM" "2"
 SYSTEM_CONSTANT "SY_TMOLAMH" "1"
 SYSTEM_CONSTANT "SY_TMOLB" "1"
 SYSTEM_CONSTANT "SY_TMORRI" "2"
 SYSTEM_CONSTANT "SY_TMSV" "1"
 SYSTEM_CONSTANT "SY_TOCH" "2"
 SYSTEM_CONSTANT "SY_TOSP" "2"
 SYSTEM_CONSTANT "SY_TOSPCN" "1"
 SYSTEM_CONSTANT "SY_TOSPMAI" "0"
 SYSTEM_CONSTANT "SY_TPEACNR" "1"
 SYSTEM_CONSTANT "SY_TREDFCO" "0"
 SYSTEM_CONSTANT "SY_TTEV" "1"
 SYSTEM_CONSTANT "SY_TUMG" "3"
 SYSTEM_CONSTANT "SY_TWDKS" "1"
 SYSTEM_CONSTANT "SY_UBDEDIQ" "70"
 SYSTEM_CONSTANT "SY_UBDEDIS" "65"
 SYSTEM_CONSTANT "SY_UBDEEN" "75"
 SYSTEM_CONSTANT "SY_UBDEENQ" "80"
 SYSTEM_CONSTANT "SY_UBR" "1"
 SYSTEM_CONSTANT "SY_UBSQ_W" "965"
 SYSTEM_CONSTANT "SY_UKAUFL" "0"
 SYSTEM_CONSTANT "SY_VARCODE" "0"
 SYSTEM_CONSTANT "SY_VD" "0"
 SYSTEM_CONSTANT "SY_VDEO" "0"
 SYSTEM_CONSTANT "SY_VHA" "0"
 SYSTEM_CONSTANT "SY_VHAANZ" "0"
 SYSTEM_CONSTANT "SY_VHE" "1"
 SYSTEM_CONSTANT "SY_VHEANZ" "1"
 SYSTEM_CONSTANT "SY_VS" "0"
 SYSTEM_CONSTANT "SY_VVT" "0"
 SYSTEM_CONSTANT "SY_WFS" "2"
 SYSTEM_CONSTANT "SY_WGPS" "0"
 SYSTEM_CONSTANT "SY_WMIN" "-80"
 SYSTEM_CONSTANT "SY_WNBM" "6"
 SYSTEM_CONSTANT "SY_WNWADM" "1"
 SYSTEM_CONSTANT "SY_ZAGPATTERNMX" "10"
 SYSTEM_CONSTANT "SY_ZBLRELS" "0"
 SYSTEM_CONSTANT "SY_ZCSTES" "0"
 SYSTEM_CONSTANT "SY_ZGST" "0"
 SYSTEM_CONSTANT "SY_ZIZVW" "0"
 SYSTEM_CONSTANT "SY_ZMS" "0"
 SYSTEM_CONSTANT "SY_ZNDAUS" "1"
 SYSTEM_CONSTANT "SY_ZUESTA" "0"
 SYSTEM_CONSTANT "SY_ZYLOFFH" "2"
 SYSTEM_CONSTANT "SY_ZYLOFFS" "0"
 SYSTEM_CONSTANT "SY_ZYLZA" "4"
 SYSTEM_CONSTANT "SY_ZYLZG" "4"
 SYSTEM_CONSTANT "SY_ZZBANK" "0"
 SYSTEM_CONSTANT "SY_ZZBANKB" "0"
 SYSTEM_CONSTANT "SY_ZZHMB" "0"
 SYSTEM_CONSTANT "SY_ZZLAM" "0"
 SYSTEM_CONSTANT "SY_ZZMBA" "0"
 SYSTEM_CONSTANT "SY_ZZRL" "0"
 SYSTEM_CONSTANT "SY_ZZSG" "0"
 SYSTEM_CONSTANT "SY_ZZYLB1" "4"
 SYSTEM_CONSTANT "SY_ZZYLB2" "0"
 SYSTEM_CONSTANT "T15RAWDSQENA_SC" "0"
 SYSTEM_CONSTANT "T15_WKDETN_SC" "0"
 SYSTEM_CONSTANT "T50_ATS_SY" "0"
 SYSTEM_CONSTANT "T50_STRTREQRST_BP" "1"
 SYSTEM_CONSTANT "T50_STRTREQ_BP" "0"
 SYSTEM_CONSTANT "T50_T50RET_BP" "0"
 SYSTEM_CONSTANT "T87_MON_SY" "0"
 SYSTEM_CONSTANT "TAIRCMPRDSMDL_SC" "0"
 SYSTEM_CONSTANT "TANKLEAKDIAGATLD_SC" "0"
 SYSTEM_CONSTANT "TANKLEAKDIAGELCM_SC" "0"
 SYSTEM_CONSTANT "TANKPSNSRNR_SC" "1"
 SYSTEM_CONSTANT "TBLOWBYHEATR_TYPAVL_SC" "0"
 SYSTEM_CONSTANT "TCAT2DMDL_SC" "0"
 SYSTEM_CONSTANT "TCE_FCOEXTD_SC" "0"
 SYSTEM_CONSTANT "TCSOVRDSTSCINC_SY" "1"
 SYSTEM_CONSTANT "TDC_ADAP_SY" "0"
 SYSTEM_CONSTANT "TDC_UNEQLGEOM_SY" "0"
 SYSTEM_CONSTANT "TDEV_DSQACTVT_SC" "0"
 SYSTEM_CONSTANT "TDPDTCPVCTRL_SC" "1"
 SYSTEM_CONSTANT "TECU_SMP480SENSPRS_SC" "1"
 SYSTEM_CONSTANT "TECU_TMSGFMT_SC" "1"
 SYSTEM_CONSTANT "TEGMOD_HEATFLOWKW_RES" "100000"
 SYSTEM_CONSTANT "TEGMOD_HEATFLOW_INTER_RES" "360"
 SYSTEM_CONSTANT "TEGMOD_HEATKJ_RES" "100"
 SYSTEM_CONSTANT "TEGMOD_INTER_RES" "1"
 SYSTEM_CONSTANT "TEGRCLR2DS_TYPAVL_SY" "0"
 SYSTEM_CONSTANT "TEGRCLRDS_TYPAVL_SY" "0"
 SYSTEM_CONSTANT "TEGRCLRLPDS_TYPAVL_SC" "1"
 SYSTEM_CONSTANT "TEGRCLRUS_TYPAVL_SY" "0"
 SYSTEM_CONSTANT "TEGRPIPUSSENS_SC" "0"
 SYSTEM_CONSTANT "TEGRVLVHOTDS_TYPAVL_SC" "0"
 SYSTEM_CONSTANT "TEMPCELS_ZERO" "0"
 SYSTEM_CONSTANT "TEMP_20_CELS" "20"
 SYSTEM_CONSTANT "TEMP_CELS_1200" "1200"
 SYSTEM_CONSTANT "TEMP_CELS_150" "150"
 SYSTEM_CONSTANT "TEMP_CELS_1500" "1500"
 SYSTEM_CONSTANT "TEMP_CELS_MAX" "3003.56"
 SYSTEM_CONSTANT "TEMP_CELS_MIN" "-3549.94"
 SYSTEM_CONSTANT "TEMP_CELS_M_100" "-100"
 SYSTEM_CONSTANT "TEMP_CELS_M_200" "-200"
 SYSTEM_CONSTANT "TEMP_DEFECT" "1"
 SYSTEM_CONSTANT "TEMP_KELV_1000" "1000"
 SYSTEM_CONSTANT "TEMP_KELV_1200" "1200"
 SYSTEM_CONSTANT "TEMP_KELV_M_1000" "-1000"
 SYSTEM_CONSTANT "TEMP_KELV_M_200" "-200"
 SYSTEM_CONSTANT "TFFVRES_SC" "0"
 SYSTEM_CONSTANT "TFUELADAP_SC" "0"
 SYSTEM_CONSTANT "THDEV_MAISWTAC_CAN" "1"
 SYSTEM_CONSTANT "THDEV_MAISWTAC_COD" "2"
 SYSTEM_CONSTANT "THDEV_MAISWTAC_DIO" "0"
 SYSTEM_CONSTANT "THDFACOPMODEMAXSIZE" "10"
 SYSTEM_CONSTANT "THERMCOORNENGTQRESVENA_SC" "0"
 SYSTEM_CONSTANT "THROVRHEATGPROTN_SC" "0"
 SYSTEM_CONSTANT "THRVLVAIRACTR_SC" "1"
 SYSTEM_CONSTANT "THRVLVCONTMN_SC" "1"
 SYSTEM_CONSTANT "THRVLVI_TYPAVL_SC" "0"
 SYSTEM_CONSTANT "THRVLVLP_AIRACTR_SC" "0"
 SYSTEM_CONSTANT "THRVLVLP_STUCKPOSNDETN_SC" "0"
 SYSTEM_CONSTANT "THRVLVPROD_SY" "0"
 SYSTEM_CONSTANT "THRVLVSNGSNSR_SC" "0"
 SYSTEM_CONSTANT "THRVLVUST_TYPAVL_SC" "0"
 SYSTEM_CONSTANT "THRVLV_AGLIMDAMON_SC" "0"
 SYSTEM_CONSTANT "THRVLV_ATSENA_SC" "1"
 SYSTEM_CONSTANT "THRVLV_BLDCMOT_SC" "0"
 SYSTEM_CONSTANT "THRVLV_CLNVRFY_SY" "0"
 SYSTEM_CONSTANT "THRVLV_DCMOT_SC" "1"
 SYSTEM_CONSTANT "THRVLV_DEDIA_SC" "0"
 SYSTEM_CONSTANT "THRVLV_ENAHBRDGSPLYCHK_SC" "0"
 SYSTEM_CONSTANT "THRVLV_ENASENTFBSEPSIGLINE_SC" "0"
 SYSTEM_CONSTANT "THRVLV_ENGSPDACTRSPENA_SC" "0"
 SYSTEM_CONSTANT "THRVLV_ENHDICERMVMOD_SC" "0"
 SYSTEM_CONSTANT "THRVLV_ICECHKATENGRUN_SC" "0"
 SYSTEM_CONSTANT "THRVLV_IOSIGHALFBRDG_SC" "0"
 SYSTEM_CONSTANT "THRVLV_LIMPAIRPOSNFCTENA_SC" "1"
 SYSTEM_CONSTANT "THRVLV_OPENPOSNLRN_SC" "0"
 SYSTEM_CONSTANT "THRVLV_PARLCHRGCTRL_SC" "0"
 SYSTEM_CONSTANT "THRVLV_PHYSRNGCHK_SY" "0"
 SYSTEM_CONSTANT "THRVLV_SENTENA_SC" "0"
 SYSTEM_CONSTANT "THRVLV_SNSRDRIFTCMP_SC" "0"
 SYSTEM_CONSTANT "THRVLV_SNSRSPLYB2_SC" "0"
 SYSTEM_CONSTANT "THRVLV_SNSRSPLY_SC" "1"
 SYSTEM_CONSTANT "THRVLV_TWNDESVAL_SC" "0"
 SYSTEM_CONSTANT "THRVLV_TYPTWINFLW_SY" "0"
 SYSTEM_CONSTANT "THS_COOLTMFEXHMNFLD_SC" "0"
 SYSTEM_CONSTANT "THS_GBXVLVDIAG_SC" "0"
 SYSTEM_CONSTANT "TIBASDCMB_SC" "0"
 SYSTEM_CONSTANT "TIINJCORRNCUSTACTV_SC" "0"
 SYSTEM_CONSTANT "TIMEDELAY_S_2_MIN" "0.001"
 SYSTEM_CONSTANT "TIMEDELAY_S_2_NRM" "8"
 SYSTEM_CONSTANT "TIME_5S_NRM_SY" "5"
 SYSTEM_CONSTANT "TIME_DEB_100MS" "100000"
 SYSTEM_CONSTANT "TIME_DEB_10MS" "10000"
 SYSTEM_CONSTANT "TIME_DT_1000MS" "1000000"
 SYSTEM_CONSTANT "TIME_DT_100MS" "100000"
 SYSTEM_CONSTANT "TIME_DT_10MS" "10000"
 SYSTEM_CONSTANT "TIME_DT_1S" "1000000"
 SYSTEM_CONSTANT "TIME_DT_200MS" "200000"
 SYSTEM_CONSTANT "TIME_MS_10MS_RES" "10"
 SYSTEM_CONSTANT "TIME_S_100US_RES" "0.0001"
 SYSTEM_CONSTANT "TIME_S_100US_RES_REV" "10000"
 SYSTEM_CONSTANT "TIME_S_12000" "12000"
 SYSTEM_CONSTANT "TIME_S_LORES_ONE" "1"
 SYSTEM_CONSTANT "Time_s_LORES_RES" "1"
 SYSTEM_CONSTANT "Time_s_LORES_RES_REV" "1"
 SYSTEM_CONSTANT "TIME_S_LORES_ZERO" "0"
 SYSTEM_CONSTANT "TIME_S_NSCRGN_MAX" "327.66"
 SYSTEM_CONSTANT "TIME_TICK_SEC_INV" "100"
 SYSTEM_CONSTANT "TIME_VALID" "2"
 SYSTEM_CONSTANT "TINTKVLVDSDYN_SC" "1"
 SYSTEM_CONSTANT "TINTKVUS_TYPAVL_SY" "0"
 SYSTEM_CONSTANT "TIOFF_DIAGENA_SC" "1"
 SYSTEM_CONSTANT "TIOFF_VDMDLCLKENA_SC" "0"
 SYSTEM_CONSTANT "TIOFF_VDTICMBOFFENA_SC" "0"
 SYSTEM_CONSTANT "TIOFF_VDTIENGOFFENA_SC" "0"
 SYSTEM_CONSTANT "TIOFF_VDTIPRPSYSACTVOFFENA_SC" "0"
 SYSTEM_CONSTANT "TIOFF_VDTISTRTENDOFFENA_SC" "0"
 SYSTEM_CONSTANT "TIPIN_SY" "0"
 SYSTEM_CONSTANT "TI_PII_EARL_REL" "13000"
 SYSTEM_CONSTANT "TI_POI2_LATE_REL" "-13000"
 SYSTEM_CONSTANT "TLE7209_SY" "0"
 SYSTEM_CONSTANT "TLE75602_SC" "0"
 SYSTEM_CONSTANT "TMECMB_HSPMDLETH_SET_NRITEM" "3"
 SYSTEM_CONSTANT "TMECMB_HSPMDL_SET_NRITEM" "3"
 SYSTEM_CONSTANT "TMEOBDACTV_SC" "0"
 SYSTEM_CONSTANT "TME_CCOFADEOUT_SC" "0"
 SYSTEM_CONSTANT "TME_CHRGAIRVLVSWT_SC" "1"
 SYSTEM_CONSTANT "TME_CHRGEXCHLOSSMDLSELN_SC" "0"
 SYSTEM_CONSTANT "TME_CHRGEXCHLOSSPOSNSELN_SC" "0"
 SYSTEM_CONSTANT "TME_CYLBNKSPCIAACTEFF_SC" "0"
 SYSTEM_CONSTANT "TME_CYLSPCAIRSYSIF_SC" "0"
 SYSTEM_CONSTANT "TME_CYLSPCIGNIF_SC" "0"
 SYSTEM_CONSTANT "TME_CYLSPCTQMDLIF_SC" "0"
 SYSTEM_CONSTANT "TME_DRGTQMDLSELN_SC" "0"
 SYSTEM_CONSTANT "TME_FAKETAIA_SC" "5"
 SYSTEM_CONSTANT "TME_STATYLTEIAEFFCALCN_SC" "0"
 SYSTEM_CONSTANT "TME_TCORRETA_SC" "0"
 SYSTEM_CONSTANT "TME_TQINNRMAXGBX_SC" "0"
 SYSTEM_CONSTANT "TME_TQMINACCRPEDL_SC" "1"
 SYSTEM_CONSTANT "TME_VIMMDL_SC" "0"
 SYSTEM_CONSTANT "TME_VIRTIA_SC" "0"
 SYSTEM_CONSTANT "TME_VIRTTQ_SC" "0"
 SYSTEM_CONSTANT "TMFWPRT_SY" "0"
 SYSTEM_CONSTANT "TMOSNMVO_SC" "16"
 SYSTEM_CONSTANT "TMOSNMZO_SC" "16"
 SYSTEM_CONSTANT "TMOSRLVO_SC" "12"
 SYSTEM_CONSTANT "TMOSRLZO_SC" "12"
 SYSTEM_CONSTANT "TNRM" "0"
 SYSTEM_CONSTANT "TOTENGREV_SC" "0"
 SYSTEM_CONSTANT "TOXDCAT_TYPAVL_SC" "0"
 SYSTEM_CONSTANT "TOXICATDS_TYPAVL_SY" "0"
 SYSTEM_CONSTANT "TOXICATUS_TYPAVL_SY" "0"
 SYSTEM_CONSTANT "TPFLTDS_TYPAVL_SY" "0"
 SYSTEM_CONSTANT "TPFLTUS_TYPAVL_SY" "0"
 SYSTEM_CONSTANT "TPS65917_SC" "0"
 SYSTEM_CONSTANT "TQCOORDCEN_SC" "0"
 SYSTEM_CONSTANT "TQCOORD_INHOUSE_SC" "0"
 SYSTEM_CONSTANT "TQFRICADPN_ATS_SC" "0"
 SYSTEM_CONSTANT "TQLIMNHIBOOSTP_SC" "0"
 SYSTEM_CONSTANT "TQLIMNLOCKDTCACTR_SC" "0"
 SYSTEM_CONSTANT "TQRESVLIMNREDNFASTINTV_SC" "0"
 SYSTEM_CONSTANT "TQSTRUCT2W_SC" "0"
 SYSTEM_CONSTANT "TQSTRUCTTYP_SC" "0"
 SYSTEM_CONSTANT "TRACKING_ACTUAL_POS" "1"
 SYSTEM_CONSTANT "TRANCMPVLVLFT_SC" "0"
 SYSTEM_CONSTANT "TRANOIPRV_SY" "0"
 SYSTEM_CONSTANT "TRANSPTMODE_SY" "0"
 SYSTEM_CONSTANT "TRATYPE_AST_SY" "2"
 SYSTEM_CONSTANT "TRATYPE_AT_SY" "1"
 SYSTEM_CONSTANT "TRATYPE_CVT_SY" "3"
 SYSTEM_CONSTANT "TRATYPE_DDCT_SY" "4"
 SYSTEM_CONSTANT "TRATYPE_MT_SY" "0"
 SYSTEM_CONSTANT "TRATYPE_NEW1_SY" "4"
 SYSTEM_CONSTANT "TRATYPE_NEW2_SY" "5"
 SYSTEM_CONSTANT "TRATYPE_NEW3_SY" "6"
 SYSTEM_CONSTANT "TRATYPE_NEW4_SY" "7"
 SYSTEM_CONSTANT "TRA_AST" "2"
 SYSTEM_CONSTANT "TRA_ASTINTVACTV_BP" "0"
 SYSTEM_CONSTANT "TRA_ASTNEUTR_BP" "1"
 SYSTEM_CONSTANT "TRA_AST_SY" "0"
 SYSTEM_CONSTANT "TRA_AT" "1"
 SYSTEM_CONSTANT "TRA_AT_SY" "0"
 SYSTEM_CONSTANT "TRA_AUTRKPROTNACTV_SC" "0"
 SYSTEM_CONSTANT "TRA_CVT" "3"
 SYSTEM_CONSTANT "TRA_CVT_SY" "1"
 SYSTEM_CONSTANT "TRA_DCT" "4"
 SYSTEM_CONSTANT "TRA_DCT_SY" "0"
 SYSTEM_CONSTANT "TRA_DDCT" "9"
 SYSTEM_CONSTANT "TRA_FACUPSPDCOR_MAP_X" "8"
 SYSTEM_CONSTANT "TRA_FACUPSPDCOR_MAP_Y" "16"
 SYSTEM_CONSTANT "TRA_FRBASEAFTSHFT_MAP_X" "8"
 SYSTEM_CONSTANT "TRA_FRBASEAFTSHFT_MAP_Y" "16"
 SYSTEM_CONSTANT "TRA_FRNEED2SHFTUP_CUR_X" "7"
 SYSTEM_CONSTANT "TRA_FRNEEDAFTSHFT_MAP_X" "16"
 SYSTEM_CONSTANT "TRA_FRNEEDAFTSHFT_MAP_Y" "16"
 SYSTEM_CONSTANT "TRA_FROUTMAX_MAP_X" "8"
 SYSTEM_CONSTANT "TRA_FROUTMAX_MAP_Y" "16"
 SYSTEM_CONSTANT "TRA_FRSLPEST_MAP_X" "16"
 SYSTEM_CONSTANT "TRA_FRSLPEST_MAP_Y" "16"
 SYSTEM_CONSTANT "TRA_FRSPR2DWN_CUR_X" "16"
 SYSTEM_CONSTANT "TRA_INTERLOCK_SY" "1"
 SYSTEM_CONSTANT "TRA_MANUAL" "3"
 SYSTEM_CONSTANT "TRA_MT" "0"
 SYSTEM_CONSTANT "TRA_MT_SY" "1"
 SYSTEM_CONSTANT "TRA_NCANERRMAX_CUR_X" "8"
 SYSTEM_CONSTANT "TRA_NFRSHFTDWN_CUR_X" "8"
 SYSTEM_CONSTANT "TRA_NINHSHFTDWN_CUR_X" "7"
 SYSTEM_CONSTANT "TRA_NOT_DEFINED" "0"
 SYSTEM_CONSTANT "TRA_NPL_DDCT" "25"
 SYSTEM_CONSTANT "TRA_NPL_SELESPEED" "21"
 SYSTEM_CONSTANT "TRA_NUMBUF" "10"
 SYSTEM_CONSTANT "TRA_PDK_SY" "0"
 SYSTEM_CONSTANT "TRA_RAPPDWNINH_MAP_X" "16"
 SYSTEM_CONSTANT "TRA_RAPPDWNINH_MAP_Y" "9"
 SYSTEM_CONSTANT "TRA_RLOLDAPPTHRES_CUR_X" "8"
 SYSTEM_CONSTANT "TRA_RSLPEST_MAP_X" "16"
 SYSTEM_CONSTANT "TRA_RSLPEST_MAP_Y" "16"
 SYSTEM_CONSTANT "TRA_SELESPEED" "5"
 SYSTEM_CONSTANT "TRA_STNSETP_FLT" "0"
 SYSTEM_CONSTANT "TRA_STNSETP_TIPIN" "2"
 SYSTEM_CONSTANT "TRA_STNSETP_UNFLT" "1"
 SYSTEM_CONSTANT "TRA_TRQDESMAXTRQ_CURX" "10"
 SYSTEM_CONSTANT "TRA_TRQLOLDTRQTHRES_CUR_X" "8"
 SYSTEM_CONSTANT "TRA_TSCPTD_BP" "0"
 SYSTEM_CONSTANT "TRA_VBASESHFTUP_MAP_X" "8"
 SYSTEM_CONSTANT "TRA_VBASESHFTUP_MAP_Y" "16"
 SYSTEM_CONSTANT "TRA_VDRBSHFTUP_MAP_X" "8"
 SYSTEM_CONSTANT "TRA_VDRBSHFTUP_MAP_Y" "16"
 SYSTEM_CONSTANT "TRA_VSHFTUPINHTHRES_CUR_X" "8"
 SYSTEM_CONSTANT "TRBCHAIRACTR_SC" "0"
 SYSTEM_CONSTANT "TRBCHINSDT_TYPAVL_SC" "0"
 SYSTEM_CONSTANT "TRBCH_ACTRTYP_SC" "0"
 SYSTEM_CONSTANT "TRBCH_BLDCMOT_SC" "0"
 SYSTEM_CONSTANT "TRBCH_TYPAVL_SY" "0"
 SYSTEM_CONSTANT "TRBHP2I_TYPAVL_SC" "0"
 SYSTEM_CONSTANT "TRBHPBYPI_TYPAVL_SC" "0"
 SYSTEM_CONSTANT "TRBHPI_TYPAVL_SC" "0"
 SYSTEM_CONSTANT "TRBLPI_TYPAVL_SC" "0"
 SYSTEM_CONSTANT "TRBNBYVLV1INSDT_TYPAVL_SC" "0"
 SYSTEM_CONSTANT "TRBNBYVLV2INSDT_TYPAVL_SC" "0"
 SYSTEM_CONSTANT "TRBNBYVLV_TYPAVL_SY" "0"
 SYSTEM_CONSTANT "TRQBS_WOINTV_SY" "1"
 SYSTEM_CONSTANT "TRQBS_WOTRAINTV_SY" "0"
 SYSTEM_CONSTANT "TRQCONVLDMOD_SY" "1"
 SYSTEM_CONSTANT "TRQCONV_CESSLIP_SC" "1"
 SYSTEM_CONSTANT "TRQCONV_SY" "1"
 SYSTEM_CONSTANT "TRQLIMCOORD2ECU_SY" "0"
 SYSTEM_CONSTANT "TRQRESV_CONST_SY" "1"
 SYSTEM_CONSTANT "TRQRESV_CP_SY" "1"
 SYSTEM_CONSTANT "TRQRESV_ETAREQ_SY" "1"
 SYSTEM_CONSTANT "TRQRESV_EXL_SY" "0"
 SYSTEM_CONSTANT "TRQRNG_EXL_SY" "1"
 SYSTEM_CONSTANT "TRQSEL_SY" "1"
 SYSTEM_CONSTANT "TRQ_ENGINTV_SY" "0"
 SYSTEM_CONSTANT "TRQ_MONLIM_CNT_SY" "0"
 SYSTEM_CONSTANT "TRQ_MONLIM_DIAG_SY" "1"
 SYSTEM_CONSTANT "TRQ_WOTRAINTV_SY" "1"
 SYSTEM_CONSTANT "TRQ_ZERO" "0"
 SYSTEM_CONSTANT "TRSMINCTREQOVRDSAPPERR_SC" "0"
 SYSTEM_CONSTANT "TRSMNEUTCTRLCOASTAVL_SC" "0"
 SYSTEM_CONSTANT "TSTRDMDSTOPCHRGADJMT_SC" "0"
 SYSTEM_CONSTANT "TS_CTTMON_SY" "0"
 SYSTEM_CONSTANT "TTRBNUS_TYPAVL_SY" "0"
 SYSTEM_CONSTANT "TTRBUSASICT_TYPAVL_SC" "0"
 SYSTEM_CONSTANT "TTWCSNSRNR_SC" "0"
 SYSTEM_CONSTANT "TWALLTC_MDLAVL_SC" "0"
 SYSTEM_CONSTANT "TWCCBALUP_SY" "0"
 SYSTEM_CONSTANT "TWCCDCTRL_SC" "0"
 SYSTEM_CONSTANT "TWCCMODLNBAL_SY" "1"
 SYSTEM_CONSTANT "TWCCOBDFUELTRIM_SY" "0"
 SYSTEM_CONSTANT "TWCCPRIB1_SY" "2"
 SYSTEM_CONSTANT "TWCCPRIB2_SY" "0"
 SYSTEM_CONSTANT "TWCCPRINF_SY" "0"
 SYSTEM_CONSTANT "TWCCSCNDB1_SY" "0"
 SYSTEM_CONSTANT "TWCCSCNDB2_SY" "0"
 SYSTEM_CONSTANT "TWCC_CTRLSTRUCT_SC" "0"
 SYSTEM_CONSTANT "TWCC_PRIMENAATS_SC" "0"
 SYSTEM_CONSTANT "TWCDMODCMPPRIB1_SY" "0"
 SYSTEM_CONSTANT "TWCDMODCMPPRIB2_SY" "0"
 SYSTEM_CONSTANT "TWCDMODCMPSCNDB1_SY" "0"
 SYSTEM_CONSTANT "TWCDMODCMPSCNDB2_SY" "0"
 SYSTEM_CONSTANT "TWCDOSCPAPRIB1_SY" "0"
 SYSTEM_CONSTANT "TWCDOSCPAPRIB2_SY" "0"
 SYSTEM_CONSTANT "TWCDOSCPASCNDB1_SY" "0"
 SYSTEM_CONSTANT "TWCDOSCPASCNDB2_SY" "0"
 SYSTEM_CONSTANT "TWCDOSCPRIB1_SY" "1"
 SYSTEM_CONSTANT "TWCDOSCPRIB2_SY" "0"
 SYSTEM_CONSTANT "TWCDOSCSCNDB1_SY" "0"
 SYSTEM_CONSTANT "TWCDOSCSCNDB2_SY" "0"
 SYSTEM_CONSTANT "TWCDRSCPATST_SY" "0"
 SYSTEM_CONSTANT "TWCDRSCPRIB1_SY" "0"
 SYSTEM_CONSTANT "TWCDRSCPRIB2_SY" "0"
 SYSTEM_CONSTANT "TWCDRSCSCNDB1_SY" "0"
 SYSTEM_CONSTANT "TWCDRSCSCNDB2_SY" "0"
 SYSTEM_CONSTANT "TWCDRSCTHRDB1_SY" "0"
 SYSTEM_CONSTANT "TWCDRSCTHRDB2_SY" "0"
 SYSTEM_CONSTANT "TWCD_OSCCAT2BNK1PARL_SC" "0"
 SYSTEM_CONSTANT "TWCD_OSCCAT2BNK2PARL_SC" "0"
 SYSTEM_CONSTANT "TWCD_PTLMEASMTPARL_SC" "0"
 SYSTEM_CONSTANT "TWCOR_HIRES_SC" "0"
 SYSTEM_CONSTANT "TWO_POW_NRM_EXP_RES_TRIGO_FUNC" "4096"
 SYSTEM_CONSTANT "TWTRCOOLRDS_TYPAVL_SC" "0"
 SYSTEM_CONSTANT "T_EXHGS_MAX" "1050"
 SYSTEM_CONSTANT "T_EXHGS_MIN" "-45"
 SYSTEM_CONSTANT "UART_SY" "1"
 SYSTEM_CONSTANT "UBFAILSRC_SY" "1"
 SYSTEM_CONSTANT "UCATDST2_TYPAVL_SC" "0"
 SYSTEM_CONSTANT "UCATDST_TYPAVL_SC" "0"
 SYSTEM_CONSTANT "UCATUST2_TYPAVL_SC" "0"
 SYSTEM_CONSTANT "UCATUST_TYPAVL_SC" "0"
 SYSTEM_CONSTANT "UEGOENG_ST_ININOTRUNNG" "5"
 SYSTEM_CONSTANT "UEGOENG_ST_RUNNGIDLE" "1"
 SYSTEM_CONSTANT "UEGOENG_ST_RUNNGSTD" "2"
 SYSTEM_CONSTANT "UEGOENG_ST_RUNNGWITHSCAV" "3"
 SYSTEM_CONSTANT "UEGOENG_ST_STOPPHADCYCEND" "6"
 SYSTEM_CONSTANT "UEGOENG_ST_TMPSTOP" "4"
 SYSTEM_CONSTANT "UEGO_24VSUPRT_SC" "0"
 SYSTEM_CONSTANT "UEGO_ASICSTEP_SC" "4"
 SYSTEM_CONSTANT "UEGO_CALREDN_SC" "0"
 SYSTEM_CONSTANT "UEGO_CIPEADPNENA_SC" "0"
 SYSTEM_CONSTANT "UEGO_CJ135AN_SC" "0"
 SYSTEM_CONSTANT "UEGO_CJ135IPMPOFFSIDN_SC" "0"
 SYSTEM_CONSTANT "UEGO_CJ135_SC" "1"
 SYSTEM_CONSTANT "UEGO_DATAVIS12VSUPRT_SC" "1"
 SYSTEM_CONSTANT "UEGO_DATAVIS24VSUPRT_SC" "0"
 SYSTEM_CONSTANT "UEGO_DATAVISCJ135CA_SC" "0"
 SYSTEM_CONSTANT "UEGO_DATAVISCJ135DA_SC" "0"
 SYSTEM_CONSTANT "UEGO_DATAVISCJ135EA_SC" "1"
 SYSTEM_CONSTANT "UEGO_DATAVISCJ135EB_SC" "0"
 SYSTEM_CONSTANT "UEGO_DATAVISCJ135FA_SC" "0"
 SYSTEM_CONSTANT "UEGO_DATAVISCJ135FB_SC" "0"
 SYSTEM_CONSTANT "UEGO_DATAVISCJ135FD_SC" "0"
 SYSTEM_CONSTANT "UEGO_DATAVISDENSOPLUS51_SC" "0"
 SYSTEM_CONSTANT "UEGO_DATAVISDENSOPLUS61_SC" "0"
 SYSTEM_CONSTANT "UEGO_DATAVISDENSOPLUS6F_SC" "0"
 SYSTEM_CONSTANT "UEGO_DATAVISLSU49TSP_SC" "0"
 SYSTEM_CONSTANT "UEGO_DATAVISLSU49_SC" "0"
 SYSTEM_CONSTANT "UEGO_DATAVISLSU51_SC" "0"
 SYSTEM_CONSTANT "UEGO_DATAVISLSU52_SC" "1"
 SYSTEM_CONSTANT "UEGO_DATAVISLSUADV_SC" "0"
 SYSTEM_CONSTANT "UEGO_DATAVISNORCMPPRSNT_SC" "0"
 SYSTEM_CONSTANT "UEGO_DATAVISNTKZFASU2_SC" "0"
 SYSTEM_CONSTANT "UEGO_DATAVISNTKZFASU3_SC" "0"
 SYSTEM_CONSTANT "UEGO_DATAVISRCMPPRSNT_SC" "1"
 SYSTEM_CONSTANT "UEGO_DGSCMNDRVR_SC" "1"
 SYSTEM_CONSTANT "UEGO_ENALAMPENVCORRD_SC" "0"
 SYSTEM_CONSTANT "UEGO_HEATGUPEXTD_SC" "0"
 SYSTEM_CONSTANT "UEGO_HEATRFCTENA_SC" "1"
 SYSTEM_CONSTANT "UEGO_HEATRRLY_SC" "1"
 SYSTEM_CONSTANT "UEGO_HEATRSTGY_SC" "0"
 SYSTEM_CONSTANT "UEGO_ICS1B1_SY" "2"
 SYSTEM_CONSTANT "UEGO_ICS1B2_SY" "0"
 SYSTEM_CONSTANT "UEGO_ICS2B1_SY" "0"
 SYSTEM_CONSTANT "UEGO_ICS2B2_SY" "0"
 SYSTEM_CONSTANT "UEGO_ICS3B1_SY" "0"
 SYSTEM_CONSTANT "UEGO_ICS3B2_SY" "0"
 SYSTEM_CONSTANT "UEGO_IPELEAKPAVEEP_SC" "0"
 SYSTEM_CONSTANT "UEGO_IPELEAKPAVUSG_SC" "0"
 SYSTEM_CONSTANT "UEGO_IPMPOFFS_SC" "0"
 SYSTEM_CONSTANT "UEGO_NRO2REFMDL_SC" "1"
 SYSTEM_CONSTANT "UEGO_OLRCMPDSTCN_SC" "0"
 SYSTEM_CONSTANT "UEGO_OVRHEATGPREVN_SC" "0"
 SYSTEM_CONSTANT "UEGO_RCMPPRSNT_SC" "1"
 SYSTEM_CONSTANT "UEGO_REDHEATGSTGYSIGWIRESC_SC" "0"
 SYSTEM_CONSTANT "UEGO_RICHCPBYDIAG_SC" "0"
 SYSTEM_CONSTANT "UEGO_RPC_SC" "0"
 SYSTEM_CONSTANT "UEGO_SECCELL_SC" "1"
 SYSTEM_CONSTANT "UEGO_SELTSKIPMPEVLN_SC" "0"
 SYSTEM_CONSTANT "UEGO_SEPUBATTTHDRIDIAG_SC" "0"
 SYSTEM_CONSTANT "UEGO_SNSR1BNK1_SC" "1"
 SYSTEM_CONSTANT "UEGO_SNSR1BNK2_SC" "0"
 SYSTEM_CONSTANT "UEGO_SNSR1INTK1_SC" "0"
 SYSTEM_CONSTANT "UEGO_SNSR2BNK1_SC" "0"
 SYSTEM_CONSTANT "UEGO_SNSR2BNK2_SC" "0"
 SYSTEM_CONSTANT "UEGO_SNSR3BNK1_SC" "0"
 SYSTEM_CONSTANT "UEGO_SNSR3BNK2_SC" "0"
 SYSTEM_CONSTANT "UEGO_SNSROPERPREENGSTRT_SC" "0"
 SYSTEM_CONSTANT "UEGO_SNSRPRETRBOCHRGRSNSR0BNK1_SC" "0"
 SYSTEM_CONSTANT "UEGO_SUMERR_SY" "1"
 SYSTEM_CONSTANT "UEGO_UNERNSTSETCTRLENA_SC" "0"
 SYSTEM_CONSTANT "UEGO_VCCMEAS_SC" "1"
 SYSTEM_CONSTANT "UEGO_VRNTSELN_SC" "56"
 SYSTEM_CONSTANT "UEGO_WIRESIGOLDSTCN_SC" "1"
 SYSTEM_CONSTANT "UEGO_WTRELECLYENA_SC" "0"
 SYSTEM_CONSTANT "UKBA_SY" "0"
 SYSTEM_CONSTANT "UNIAIRINTKLIVOMOD_SC" "0"
 SYSTEM_CONSTANT "USESTRTSYNCINTRPTCFG_SC" "0"
 SYSTEM_CONSTANT "USGOFFTIGENNIF_SC" "2"
 SYSTEM_CONSTANT "VARCOD_SY" "0"
 SYSTEM_CONSTANT "VCRTYP_SC" "0"
 SYSTEM_CONSTANT "VEHDEV_APPPIDENA_SC" "1"
 SYSTEM_CONSTANT "VEHDEV_HNDBRKENA_SC" "0"
 SYSTEM_CONSTANT "VEHDEV_HNDBRKLAMPENA_SC" "0"
 SYSTEM_CONSTANT "VEHFDE_NRCNDTRIG_SC" "0"
 SYSTEM_CONSTANT "VEHFDE_NRCNVTNLDISTBN_SC" "0"
 SYSTEM_CONSTANT "VEHFDE_NREXTTRIG_SC" "0"
 SYSTEM_CONSTANT "VEHFDE_NRFREETRIG_SC" "0"
 SYSTEM_CONSTANT "VEHFDE_NRINDCLASS_SC" "0"
 SYSTEM_CONSTANT "VEHFDE_NRMILGTRIG_SC" "0"
 SYSTEM_CONSTANT "VEHFDE_NRSNGVALSTC_SC" "0"
 SYSTEM_CONSTANT "VEHFDE_NRSTC_SC" "0"
 SYSTEM_CONSTANT "VEHFDE_NRVALCHGTRIG_SC" "0"
 SYSTEM_CONSTANT "VEHMOT_DCS_MSK" "2"
 SYSTEM_CONSTANT "VEHMOT_TCS_MSK" "1"
 SYSTEM_CONSTANT "VEHMOT_TITRQDRAGVX_CURX" "2"
 SYSTEM_CONSTANT "VEHMOT_TRQPRP_NRMFAC" "16"
 SYSTEM_CONSTANT "VEHSTC_ECOLAMPACTV_SC" "1"
 SYSTEM_CONSTANT "VEHTYPSELN_SC" "0"
 SYSTEM_CONSTANT "VEHTYP_SC" "2"
 SYSTEM_CONSTANT "VEHVCANSRCSEL_SC" "1"
 SYSTEM_CONSTANT "VEHVPWMOUT_SC" "1"
 SYSTEM_CONSTANT "VEHV_CANSAFE_SC" "1"
 SYSTEM_CONSTANT "VEHV_CAN_SC" "3"
 SYSTEM_CONSTANT "VEHV_COMV_DEF" "327.67"
 SYSTEM_CONSTANT "VEHV_DUALCANSRCACTV_SC" "0"
 SYSTEM_CONSTANT "VEHV_DUALSIG_SC" "1"
 SYSTEM_CONSTANT "VEHV_FCOPLAUS_SY" "0"
 SYSTEM_CONSTANT "VEHV_INHOUSE_SC" "0"
 SYSTEM_CONSTANT "VEHV_NUMTTHWHL_SY" "5"
 SYSTEM_CONSTANT "VEHV_OBDPLAUS_SY" "0"
 SYSTEM_CONSTANT "VEHV_PHYSRNGCHK_SY" "1"
 SYSTEM_CONSTANT "VEHV_PWMSAFE_SC" "1"
 SYSTEM_CONSTANT "VEHV_PWMVLDYCHK_SC" "0"
 SYSTEM_CONSTANT "VEHV_PWM_SC" "2"
 SYSTEM_CONSTANT "VEHV_SC" "1"
 SYSTEM_CONSTANT "VEHV_SELCOMSIG_SC" "0"
 SYSTEM_CONSTANT "VEHV_SGLWHLDIAG_SY" "0"
 SYSTEM_CONSTANT "VEHV_SWTASRC_SC" "1"
 SYSTEM_CONSTANT "VEHV_SWTPLAUSCAN_SC" "1"
 SYSTEM_CONSTANT "VEHV_SWTPLAUSFCO_SC" "1"
 SYSTEM_CONSTANT "VEHV_SWTPLAUSPWR_SC" "1"
 SYSTEM_CONSTANT "VEHV_SWTPLAUSREF_SC" "0"
 SYSTEM_CONSTANT "VEHV_SWTPLAUSV2N_SC" "1"
 SYSTEM_CONSTANT "VEHV_SWTPWRMDL_SC" "1"
 SYSTEM_CONSTANT "VEHV_SWTSIGSELNEEP_SC" "0"
 SYSTEM_CONSTANT "VEHV_TIPER_MAX" "13421772"
 SYSTEM_CONSTANT "VEL_KMH_0" "0"
 SYSTEM_CONSTANT "VEL_KMH_300" "300"
 SYSTEM_CONSTANT "VEL_KMH_M_300" "-300"
 SYSTEM_CONSTANT "VERSSTOPMISFGDETNBYINJ_SY" "1"
 SYSTEM_CONSTANT "VLVI_SY" "1"
 SYSTEM_CONSTANT "VLVLFTI_TYPAVL_SC" "0"
 SYSTEM_CONSTANT "VLVLFT_FBEXHSWT_SC" "0"
 SYSTEM_CONSTANT "VLVLFT_FBINTKSWT_SC" "1"
 SYSTEM_CONSTANT "VLVLFT_FBSWT_HIGHCAM" "1"
 SYSTEM_CONSTANT "VLVLFT_FBSWT_LOWCAM" "0"
 SYSTEM_CONSTANT "VLVLFT_INTK_SC" "1"
 SYSTEM_CONSTANT "VLVLFT_OUTL_SC" "0"
 SYSTEM_CONSTANT "VLVLFT_POSNOFSPCLLFTINTK_SC" "1"
 SYSTEM_CONSTANT "VLVLFT_SIGACTR_HIGHCAM" "1"
 SYSTEM_CONSTANT "VLVLFT_SIGACTR_LOWCAM" "0"
 SYSTEM_CONSTANT "VLVLFT_TYPINTK_SC" "4"
 SYSTEM_CONSTANT "VLVLFT_TYPOUTL_SC" "0"
 SYSTEM_CONSTANT "VLVLFT_UNIAIRINTK_SC" "0"
 SYSTEM_CONSTANT "VMD_DEGCNVN_CURX" "2"
 SYSTEM_CONSTANT "VMD_RENG_MAPX" "14"
 SYSTEM_CONSTANT "VMD_RENG_MAPY" "43"
 SYSTEM_CONSTANT "VMD_RPRP_MAPX" "6"
 SYSTEM_CONSTANT "VMD_RPRP_MAPY" "16"
 SYSTEM_CONSTANT "VMD_TRQTHRESENG_CURX" "6"
 SYSTEM_CONSTANT "VMD_TRQTHRESPRP_CURX" "6"
 SYSTEM_CONSTANT "VMSI_DCSPTD_BP" "0"
 SYSTEM_CONSTANT "VMSI_DCS_BP" "1"
 SYSTEM_CONSTANT "VMSI_RAMPENDINTV_SC" "0"
 SYSTEM_CONSTANT "VMSI_STCFG_DCSSHOFFRMPENA_BP" "0"
 SYSTEM_CONSTANT "VMSI_TCS_BP" "0"
 SYSTEM_CONSTANT "VNQ6040_SC" "0"
 SYSTEM_CONSTANT "VOL_FILGLVL_RES" "1"
 SYSTEM_CONSTANT "VOL_FILGLVL_RES_REV" "1"
 SYSTEM_CONSTANT "VOL_NSC_RES" "0.0001"
 SYSTEM_CONSTANT "VOL_NSC_RES_FL" "0.0001"
 SYSTEM_CONSTANT "VOL_NSC_RES_REV" "10000"
 SYSTEM_CONSTANT "VOL_RES_REV" "100"
 SYSTEM_CONSTANT "VSWVLVI_TYPAVL_SC" "0"
 SYSTEM_CONSTANT "VSWVLV_AIRACTR_SC" "0"
 SYSTEM_CONSTANT "VSWVLV_TYPAVLCONVENTIONAL_SC" "0"
 SYSTEM_CONSTANT "VVTDSLAVL_SC" "0"
 SYSTEM_CONSTANT "VVTIDLEMOD_SC" "0"
 SYSTEM_CONSTANT "V_CAM_RES_REV" "256"
 SYSTEM_CONSTANT "WAHT_SY" "0"
 SYSTEM_CONSTANT "WDGS_CFGADPR_SC" "1"
 SYSTEM_CONSTANT "WESDEM_SY" "0"
 SYSTEM_CONSTANT "WIPRIFTYP_SC" "4"
 SYSTEM_CONSTANT "WNTR_SY" "0"
 SYSTEM_CONSTANT "WRMUPCSERS_SC" "0"
 SYSTEM_CONSTANT "WTRCACT_TYPAVL_SC" "0"
 SYSTEM_CONSTANT "WTRCOOLTP1_TYPAVL_SY" "0"
 SYSTEM_CONSTANT "WTRCOOLTP_TYPAVL_SY" "0"
 SYSTEM_CONSTANT "WTRINJSYS_SC" "0"
 SYSTEM_CONSTANT "WTRPMP1_SC" "0"
 SYSTEM_CONSTANT "WTRPMP2_SC" "0"
 SYSTEM_CONSTANT "WTRPMP_VARNTYP_SC" "0"
 SYSTEM_CONSTANT "XCORECDD_SC" "0"
 SYSTEM_CONSTANT "XCPVERS_SC" "3"
 SYSTEM_CONSTANT "XCP_SY" "1"
 SYSTEM_CONSTANT "XDI_SC" "1"
 SYSTEM_CONSTANT "ZERO" "0"
 SYSTEM_CONSTANT "ZWMIN_ENAG_SC" "1" /end MOD_PAR
/begin MOD_COMMON "" BYTE_ORDER MSB_LAST ALIGNMENT_BYTE 1 ALIGNMENT_WORD 2 ALIGNMENT_LONG 4 ALIGNMENT_INT64 4 ALIGNMENT_FLOAT32_IEEE 4 ALIGNMENT_FLOAT64_IEEE 4 DATA_SIZE 32 /end MOD_COMMON
/begin IF_DATA ASAP1B_Bypass
 /begin TP_BLOB 0x102 /* Bypass version */ 0x102 /* Blob version */ /end TP_BLOB
/end IF_DATA
/begin IF_DATA ETK_XETK
 /begin ETK_XETK_LIST /* version */ ETK_XETK_AML_VERSION_2_2_0
  /begin ETK 1 INTERFACE_SPEED_100MBIT /* Interface */ CONFIG "CpuType" "TC37xED_A" CONFIG "EtkId" "162" CONFIG "EtkSubId" "0" CONFIG "HardwAdvId" "0" CONFIG "TriggerInterface" "reg" CONFIG "PullCalWakeup" "0" CONFIG "WatchdogDisable" "1" CONFIG "RegPollRate" "50" CONFIG "PowerFailDetection" "SBRAM" CONFIG "Startup" "reg" CONFIG "StartupTimeout" "-1" CONFIG "DebArb" "1" CONFIG "WatchdogPolarity" "1" CONFIG "DapClockSpeed" "100" CONFIG "DapBlock" "1" CONFIG "Dap2Pin" "0" DISPLAY_NAME "ETK-S20/21" /end ETK
  /begin XETK 2 /* ETK_XETK_ID BR-XETK-S3 */ CONFIG "CpuType" "TC37xED_A" CONFIG "BaseId" "21" CONFIG "Extension" "2" CONFIG "DapClockSpeed" "100" CONFIG "DapBlock" "1" CONFIG "Dap2Pin" "0" CONFIG "EcuWatchdogPolarity" "1" CONFIG "HandshakeTimeout" "-1" CONFIG "EcuTrigRegPollRate" "50" CONFIG "PowerFailDetection" "SBRAM" CONFIG "TriggerInterface" "reg" CONFIG "EcuWatchdogControlDisabled" "0" CONFIG "EcuWatchdogEnabled" "1" DISPLAY_NAME "BR-XETK-S3" /end XETK
  /begin XETK 3 CONFIG "CpuType" "TC37xED_A" CONFIG "BaseId" "11" CONFIG "Extension" "2" CONFIG "DapClockSpeed" "100" CONFIG "DapBlock" "1" CONFIG "Dap2Pin" "0" CONFIG "EcuWatchdogPolarity" "1" CONFIG "HandshakeTimeout" "-1" CONFIG "EcuTrigRegPollRate" "50" CONFIG "PowerFailDetection" "SBRAM" CONFIG "TriggerInterface" "reg" CONFIG "EcuWatchdogControlDisabled" "0" CONFIG "EcuWatchdogEnabled" "1" DISPLAY_NAME "XETK-S20/21" /end XETK
  /begin XETK 4 CONFIG "CpuType" "TC37xED_A" CONFIG "BaseId" "14" CONFIG "Extension" "2" CONFIG "DapClockSpeed" "100" CONFIG "DapBlock" "1" CONFIG "Dap2Pin" "0" CONFIG "EcuWatchdogPolarity" "1" CONFIG "HandshakeTimeout" "-1" CONFIG "EcuTrigRegPollRate" "50" CONFIG "PowerFailDetection" "SBRAM" CONFIG "TriggerInterface" "reg" CONFIG "EcuWatchdogControlDisabled" "0" CONFIG "EcuWatchdogEnabled" "1" DISPLAY_NAME "XETK-S30/31" /end XETK
  /begin XETK 5 CONFIG "CpuType" "TC37xED_A" CONFIG "BaseId" "16" CONFIG "Extension" "2" CONFIG "DapClockSpeed" "100" CONFIG "DapBlock" "1" CONFIG "Dap2Pin" "0" CONFIG "EcuWatchdogPolarity" "1" CONFIG "HandshakeTimeout" "-1" CONFIG "EcuTrigRegPollRate" "50" CONFIG "PowerFailDetection" "SBRAM" CONFIG "TriggerInterface" "reg" CONFIG "EcuWatchdogControlDisabled" "0" CONFIG "EcuWatchdogEnabled" "1" DISPLAY_NAME "BR-XETK-S1/2" /end XETK
  /begin FETK 7 CONFIG "CpuType" "TC37xED_A" CONFIG "BaseId" "6" CONFIG "Extension" "0" CONFIG "DapClockSpeed" "100" CONFIG "Dap2Pin" "0" CONFIG "WatchdogControlDisabled" "0" CONFIG "WatchdogDisable" "0" CONFIG "WatchdogPolarity" "1" CONFIG "StartupTimeout" "-1" DISPLAY_NAME "FETK-T1/2 (Serial debug interface based data acquisition)" /end FETK
  /begin FETK 8 CONFIG "CpuType" "TC37xED_A" CONFIG "BaseId" "7" CONFIG "Extension" "0" CONFIG "DapClockSpeed" "100" CONFIG "Dap2Pin" "0" CONFIG "WatchdogControlDisabled" "0" CONFIG "WatchdogDisable" "0" CONFIG "WatchdogPolarity" "1" CONFIG "StartupTimeout" "-1" DISPLAY_NAME "FETK-S1/2 " /end FETK
  /begin RASTER_CHECK OFFLINE_DEVICE 1 /* device with id 1 is the default device for offline raster check */ ONLINE_RESPECT_OFFLINE_LIMIT /end RASTER_CHECK
 /end ETK_XETK_LIST
 /begin TP_BLOB /* ByteOrder */ BYTE_ORDER_MSB_LAST /begin DISTAB_CFG /* Distab Type */ 17 /end DISTAB_CFG
  /begin ECU_EVENT_LIST 0xB92F0830 /* start address of ECU event list */ ETK_XETK_REF 1 2 3 4 5 7 8 /end ECU_EVENT_LIST
  TABLE_ALIGNMENT ALIGNMENT_4_BYTE
  /begin EVENT_CONFIG_OUTPUT_AREA 0xB92FB5F0 /* start of event config area */ 12324 /* size in bytes of event config area */ 0xB92FE614 /* start of event output area */ 6144 /* size in bytes of event output area */ ETK_XETK_REF 1 2 3 4 5 7 8 /end EVENT_CONFIG_OUTPUT_AREA
  /begin DATA_ACQUISITION PRIORITY_RANGE 1 4 ETK_XETK_REF 1 2 3 4 5 7 8 /end DATA_ACQUISITION
  /begin ECU_PROPERTY OVERALL_PERFORMANCE 303030 1212120 CORE_PERFORMANCE 3 303030 1212120 CORE_PERFORMANCE 1 454545 1818180 CORE_PERFORMANCE 2 454545 1818180 ETK_XETK_REF 1 2 3 4 5 7 8 /end ECU_PROPERTY
  /begin TRIGGER_CFG TRIGGER 29 DIRECT ECU_ID 29 TRIGGER 30 DIRECT ECU_ID 30 TRIGGER 31 DIRECT ECU_ID 31 TRIGGER 32 DIRECT ECU_ID 32 ETK_XETK_REF 1 2 3 4 5 /end TRIGGER_CFG
  /begin TRIGGER_CFG TRIGGER 93 DIRECT ECU_ID 93 TRIGGER 94 DIRECT ECU_ID 94 TRIGGER 95 DIRECT ECU_ID 95 TRIGGER 96 DIRECT ECU_ID 96 ETK_XETK_REF 7 8 /end TRIGGER_CFG
  /begin CODE_CHK /* Address ECU DATA section */ 0x804D8118 /* Address ECU RAM section */ 0xB92FFFC4 /* Length ECU DATA sections */ 8 PATTERN_REFRESH_TIMEOUT 0x200 ERROR_BEHAVIOR PERMANENT_RESET ETK_XETK_REF 1 2 3 4 5 7 8 /end CODE_CHK
  /begin COLDSTART_HANDSHAKE /* Address of ETKS coldstart pattern */ 0xB92FFFDC WAIT /* Dyn. length for wait pattern */ 0xE5 0xAD 0xEC 0x4D READY /* Dyn. length for ready pattern */ 0xDE 0xC0 0xED 0xFE ETK_XETK_REF 1 2 3 4 5 7 8 /end COLDSTART_HANDSHAKE
  /begin PAGE_SWITCH_METHOD 2 /* version */ MAILBOX 3 /* MBX_Version */ /* Version of mailbox */ 200 /* MBX_PageSetupTime */ /* max time the ECU needs to set up page in ms */ 0xB92FFFF4 /* MBX_StartAddress */ /* Start address of table */ AUTOSTART_BEHAVIOR LAST_ACTIVE_PAGE /* Table to be filled by INCA with info */ /* for the current active page */ OMD 0xB92FFE18 /* OMD_ADDRESS */ 2 /* OMD_CID */ 0 /* OMD_VERSION */ 0x1A8 /* OMD_MAX_LEN */ 23 /* OMD_NUMBER_OF_EMU_HANDLES */ CODE_CHK_PATTERN_WP 0xB92FFFCC /* Start address of WP CodeCheck Pattern */ ETK_XETK_REF 1 2 3 4 5 7 8 /end PAGE_SWITCH_METHOD
  /begin ECU_DEFINED_ERRORCODES ERROR_ENTRY 0x00000001 "OMD error" ERROR_ENTRY 0x45525201 "ECU will be reset - STOP engine!" ERROR_ENTRY 0x45525202 "ECU does not support Programming at T15 OFF" ERROR_ENTRY 0x45525203 "Mail Box Version is invalid" ERROR_ENTRY 0x45525204 "Call Back Function is not configured" /end ECU_DEFINED_ERRORCODES
  /begin DATA_FREEZE CONFIG "SAFETY_MAILBOX_ADDRESS" "0xB92FFFE8" CONFIG "SAFETY_MAILBOX_VERSION" "0x4D310100" CONFIG "SAFETY_MAILBOX_WAITMSG" "Datafreeze is pending" CONFIG "SAFETY_MAILBOX_WAITTOUT" "2000" CONFIG "STARTUP_MAILBOX_ADDRESS" "0x7003BE00" CONFIG "STARTUP_MAILBOX_VERSION" "0x4D320100" CONFIG "VALIDATE_PATTERN" "0x804D8000 0x100" CONFIG "INVALIDATE_PATTERN" "0x804D8120 0x00044408000004009011000208408C0090508808031010614000280812047640" ETK_XETK_REF 1 2 3 4 5 7 8 /end DATA_FREEZE
 /end TP_BLOB
 /begin SOURCE "segment synchronous" 103 1
  /begin QP_BLOB 2 3 2000
   /begin ETK_XETK_SPECIFIC TRG_NBR 0 /begin ECU_PROPERTY PERFORMANCE 2 757575 3030300 /end ECU_PROPERTY ETK_XETK_REF 1 2 3 4 5 7 8 /end ETK_XETK_SPECIFIC
  /end QP_BLOB
 /end SOURCE
 /begin SOURCE "10ms time synchronous" 4 1
  /begin QP_BLOB 3 2 9000
   /begin ETK_XETK_SPECIFIC TRG_NBR 0 /begin ECU_PROPERTY PERFORMANCE 1 151515 606060 /end ECU_PROPERTY ETK_XETK_REF 1 2 3 4 5 7 8 /end ETK_XETK_SPECIFIC
  /end QP_BLOB
 /end SOURCE
 /begin SOURCE "100ms time synchronous" 5 1
  /begin QP_BLOB 4 1 90000
   /begin ETK_XETK_SPECIFIC TRG_NBR 0 /begin ECU_PROPERTY PERFORMANCE 1 15151 60604 /end ECU_PROPERTY ETK_XETK_REF 1 2 3 4 5 7 8 /end ETK_XETK_SPECIFIC
  /end QP_BLOB
 /end SOURCE
 /begin SOURCE "1ms time synchronous" 3 1
  /begin QP_BLOB 1 4 900
   /begin ETK_XETK_SPECIFIC TRG_NBR 0 /begin ECU_PROPERTY PERFORMANCE 1 1515151 6060604 /end ECU_PROPERTY ETK_XETK_REF 1 2 3 4 5 7 8 /end ETK_XETK_SPECIFIC
  /end QP_BLOB
 /end SOURCE
/end IF_DATA
/begin IF_DATA SERVICE_BASED_BYPASS
 /begin SERVICES SERVICE_AML_VERSION_3_1_1 4 /* BaseOffsetValue */ 8 /* NumSrvPts */ "rba_SvbbEtk_SrvPtResId_KWB" /* SERVICE_POINTS_RESOURCE_ID */ "rba_SvbbEtk_SrvPtEnabled_KWB" /* SrvPtEnabled */ "rba_SvbbEtk_TimeOutPre_KWB" /* TimeOutMaxPre*/ "rba_SvbbEtk_TimeOutPost_KWB" /* TimeOutMaxPost*/ DOUBLE_BUFFERING_USED "rba_SvbbEtk_DisableProcExec_KWB" /* DisableFctExec*/ /begin IMPLEMENTED_SBB_VERSIONS SBB_V2_1 SBB_V3_1 /end IMPLEMENTED_SBB_VERSIONS /begin SERVICE_POINT 2 "rba_SvbbEtk_Seg1Byp" PRIORITY 2 HOOKED /end SERVICE_POINT /begin SERVICE_POINT 3 "rba_SvbbEtk_T10msByp" PRIORITY 3 HOOKED /end SERVICE_POINT /begin SERVICE_POINT 1 "rba_Svbb_DummyActivate" PRIORITY 1 /end SERVICE_POINT SBB_DYNAMIC_STRUCTURE 2 /* SBBDynStructVer */ 0xB92F5700 /* ResWorkArea: resource working area address,
where resource blocks and address tables and default value tables are
allocated. Located e.g. in ETK DATA region for parallel ETK types and ETK
RAM regions for serial ETK types */ 0x3000 /* ResWorkArea: length of the resource working
area in bytes */ 0xB92F8710 /* EcuWrtblResWorkArea: where RAM resource blocks
and data tables are allocated. Located e.g. in ETK RAM for parallel ETKs
and ECU RAM for serial ETKs */ 12000 /* EcuWrtblResWorkAreaLength: length of the ECU
writable resource working area in bytes */
  /begin TRIGGER_SEPARATED_FROM_CHANNEL
   /begin TRIGGER_CFG TRIGGER 1 DIRECT TRIGGER 2 DIRECT TRIGGER 3 DIRECT TRIGGER 4 DIRECT TRIGGER 5 DIRECT TRIGGER 6 DIRECT TRIGGER 7 DIRECT TRIGGER 8 DIRECT TRIGGER 9 DIRECT TRIGGER 10 DIRECT TRIGGER 11 DIRECT TRIGGER 12 DIRECT TRIGGER 13 DIRECT TRIGGER 14 DIRECT TRIGGER 15 DIRECT TRIGGER 16 DIRECT TRIGGER 17 DIRECT TRIGGER 18 DIRECT TRIGGER 19 DIRECT TRIGGER 20 DIRECT TRIGGER 21 DIRECT TRIGGER 22 DIRECT TRIGGER 23 DIRECT TRIGGER 24 DIRECT TRIGGER 25 DIRECT TRIGGER 26 DIRECT TRIGGER 27 DIRECT TRIGGER 28 DIRECT ETK_XETK_REF 1 2 3 4 5 /end TRIGGER_CFG
   /begin TRIGGER_CFG TRIGGER 1 DIRECT TRIGGER 2 DIRECT TRIGGER 3 DIRECT TRIGGER 4 DIRECT TRIGGER 5 DIRECT TRIGGER 6 DIRECT TRIGGER 7 DIRECT TRIGGER 8 DIRECT TRIGGER 9 DIRECT TRIGGER 10 DIRECT TRIGGER 11 DIRECT TRIGGER 12 DIRECT TRIGGER 13 DIRECT TRIGGER 14 DIRECT TRIGGER 15 DIRECT TRIGGER 16 DIRECT TRIGGER 17 DIRECT TRIGGER 18 DIRECT TRIGGER 19 DIRECT TRIGGER 20 DIRECT TRIGGER 21 DIRECT TRIGGER 22 DIRECT TRIGGER 23 DIRECT TRIGGER 24 DIRECT TRIGGER 25 DIRECT TRIGGER 26 DIRECT TRIGGER 27 DIRECT TRIGGER 28 DIRECT TRIGGER 29 DIRECT TRIGGER 30 DIRECT TRIGGER 31 DIRECT TRIGGER 32 DIRECT TRIGGER 33 DIRECT TRIGGER 34 DIRECT TRIGGER 35 DIRECT TRIGGER 36 DIRECT TRIGGER 37 DIRECT TRIGGER 38 DIRECT TRIGGER 39 DIRECT TRIGGER 40 DIRECT TRIGGER 41 DIRECT TRIGGER 42 DIRECT TRIGGER 43 DIRECT TRIGGER 44 DIRECT TRIGGER 45 DIRECT TRIGGER 46 DIRECT TRIGGER 47 DIRECT TRIGGER 48 DIRECT TRIGGER 49 DIRECT TRIGGER 50 DIRECT TRIGGER 51 DIRECT TRIGGER 52 DIRECT TRIGGER 53 DIRECT TRIGGER 54 DIRECT TRIGGER 55 DIRECT TRIGGER 56 DIRECT TRIGGER 57 DIRECT TRIGGER 58 DIRECT TRIGGER 59 DIRECT TRIGGER 60 DIRECT TRIGGER 61 DIRECT TRIGGER 62 DIRECT TRIGGER 63 DIRECT TRIGGER 64 DIRECT TRIGGER 65 DIRECT TRIGGER 66 DIRECT TRIGGER 67 DIRECT TRIGGER 68 DIRECT TRIGGER 69 DIRECT TRIGGER 70 DIRECT TRIGGER 71 DIRECT TRIGGER 72 DIRECT TRIGGER 73 DIRECT TRIGGER 74 DIRECT TRIGGER 75 DIRECT TRIGGER 76 DIRECT TRIGGER 77 DIRECT TRIGGER 78 DIRECT TRIGGER 79 DIRECT TRIGGER 80 DIRECT TRIGGER 81 DIRECT TRIGGER 82 DIRECT TRIGGER 83 DIRECT TRIGGER 84 DIRECT TRIGGER 85 DIRECT TRIGGER 86 DIRECT TRIGGER 87 DIRECT TRIGGER 88 DIRECT TRIGGER 89 DIRECT TRIGGER 90 DIRECT TRIGGER 91 DIRECT TRIGGER 92 DIRECT ETK_XETK_REF 6 7 8 /end TRIGGER_CFG
   /begin DATA_ACQUISITION PRIORITY_RANGE 5 32 ETK_XETK_REF 1 2 3 4 5 /end DATA_ACQUISITION
   /begin DATA_ACQUISITION PRIORITY_RANGE 5 64 ETK_XETK_REF 6 7 8 /end DATA_ACQUISITION
  /end TRIGGER_SEPARATED_FROM_CHANNEL
 /end SERVICES
/end IF_DATA
/*Service_Based_Bypass*/
/begin IF_DATA ASAP1B_DIAGNOSTIC_SERVICES /* Definition for KWP2000 on CAN and K-Line */
 /begin SOURCE "10msec" 4 /* Scaling Unit: 4 = 10 ms */ 1 /* Rate in Scaling Unit: 1 */ /* Refresh rate = 10 ms * 1 = 10 */ /* Codes for Scaling units (CSE) look at */ /* ASAP1b Spezifikation */ QP_BLOB /* QP-BLOB includes special info about measure sampling rate */ QP_BLOB_VERSION 0x0300 /* Measurement mode of ECU: Blockmode */ ADDRESSMODE MAX_NO_OF_SIGNALS 56 /* max. number of signals */ MAX_NO_OF_BYTES 56 /* Block mode: local identifier */ AVAILABLE_ON CAN /* availability of this raster : K-line, CAN or both */ /end SOURCE
 /begin SOURCE "100msec" 5 /* Scaling Unit: 5 = 100 ms */ 1 /* Rate in Scaling Unit: 1 */ /* Refresh rate = 10 ms * 1 = 10 */ /* Codes for Scaling units (CSE) look at */ /* ASAP1b Spezifikation */ QP_BLOB /* QP-BLOB includes special info about measure sampling rate */ QP_BLOB_VERSION 0x0300 /* Measurement mode of ECU: Blockmode */ ADDRESSMODE MAX_NO_OF_SIGNALS 56 /* max. number of signals */ MAX_NO_OF_BYTES 56 /* Block mode: local identifier */ AVAILABLE_ON CAN /* availability of this raster : K-line, CAN or both */ /end SOURCE
 /* TP-Blob includes general information for the ASAP1b-driver */
 /begin TP_BLOB /* blob version */ 0x300 /* KWP2000 version */ ISO14229_1_2003 /* byte order in measurements and characteristics */ BYTEORDER_MSB_LAST /begin SESSION "extendedDiagnosticSession" 0x03 /end SESSION /begin SECURITY_ACCESS 0x41 /* accMode */ 1 /* calcmethod */ 0 /* delay */ /end SECURITY_ACCESS /begin ADDRESS_AND_LENGTH_FORMAT_IDENTIFIER 0x44 AALFI_FOR_READ_MEMORY_BY_ADDR 0x14 /end ADDRESS_AND_LENGTH_FORMAT_IDENTIFIER
  /begin CAN /* Baudrate [Hz] */ 500000 /* Sample point [% complete bit time] */ SamplePoint 60 /* 1 or 3 samples per bit */ SamplesPerBit 1 /* BTL_CYCLES [slots/bit time] */ BTL_CYCLES 19 /* SJW length synchr. segm. In BTL_CYCLES */ SJW 3 /* SYNC_EDGE */ SYNC_EDGE 0
   /begin ADDRESS /* CAN_ID ECU (gateway)EINCA */ 0x98DAF110 /* CAN_ID INCA EECU (gateway) */ 0x98DA10F1 /* TGT_ECU 0x10 Extended / remote address ECU */ /* TGT_INCA 0xF1 Extended address INCA */ /end ADDRESS
   /begin TransportProtocolVersion ISO15765_2_2003 /end TransportProtocolVersion
   NETWORK_LIMITS /* WFT_MAX */ 10 /* XDL_MAX */ 0xFFF /* AS BS Cr P2min P2max P3min P3max in ms */ USDTP_TIMING_DEFAULTS 8192 256 256 0 50 3 512 USDTP_TIMING 4096 256 256 25 50 55 5000 /end CAN
 /end TP_BLOB
/end IF_DATA
/begin IF_DATA XCPplus 0x0102
 /begin PAG /* MAX_SEGMENTS */ 20 /end PAG
 /begin PROTOCOL_LAYER 0x0102 1000 1000 0 0 0 0 0 8 8 BYTE_ORDER_MSB_LAST ADDRESS_GRANULARITY_BYTE OPTIONAL_CMD GET_COMM_MODE_INFO OPTIONAL_CMD SET_MTA OPTIONAL_CMD UPLOAD OPTIONAL_CMD SHORT_UPLOAD OPTIONAL_CMD BUILD_CHECKSUM OPTIONAL_CMD DOWNLOAD OPTIONAL_CMD DOWNLOAD_NEXT OPTIONAL_CMD DOWNLOAD_MAX OPTIONAL_CMD SET_CAL_PAGE OPTIONAL_CMD GET_CAL_PAGE OPTIONAL_CMD COPY_CAL_PAGE OPTIONAL_CMD CLEAR_DAQ_LIST OPTIONAL_CMD SET_DAQ_PTR OPTIONAL_CMD WRITE_DAQ OPTIONAL_CMD SET_DAQ_LIST_MODE OPTIONAL_CMD START_STOP_DAQ_LIST OPTIONAL_CMD START_STOP_SYNCH OPTIONAL_CMD FREE_DAQ OPTIONAL_CMD ALLOC_DAQ OPTIONAL_CMD ALLOC_ODT OPTIONAL_CMD ALLOC_ODT_ENTRY COMMUNICATION_MODE_SUPPORTED BLOCK SLAVE MASTER 255 0 /end PROTOCOL_LAYER
 /begin DAQ DYNAMIC 65535 3 0 OPTIMISATION_TYPE_DEFAULT ADDRESS_EXTENSION_FREE IDENTIFICATION_FIELD_TYPE_ABSOLUTE GRANULARITY_ODT_ENTRY_SIZE_DAQ_BYTE 255 OVERLOAD_INDICATION_EVENT PRESCALER_SUPPORTED /begin DAQ_MEMORY_CONSUMPTION 5495 46 6 5 2 0 /end DAQ_MEMORY_CONSUMPTION
  /begin EVENT "segment synchronous" "seg_sync" 0 DAQ 1 0 5 7 CONSISTENCY EVENT /begin MIN_CYCLE_TIME 14 5 /end MIN_CYCLE_TIME /end EVENT
  /begin EVENT "10ms time synchronous" "10_ms" 1 DAQ 1 10 6 6 CONSISTENCY EVENT /end EVENT
  /begin EVENT "100ms time synchronous" "100_ms" 2 DAQ 1 100 6 5 CONSISTENCY EVENT /end EVENT
 /end DAQ
 /begin XCP_ON_CAN 0x0102 CAN_ID_MASTER 0x7F0 CAN_ID_SLAVE 0x7F1 BAUDRATE 500000 SAMPLE_POINT 81 BTL_CYCLES 16 SJW 3 MAX_BUS_LOAD 88
  /begin PROTOCOL_LAYER 0x0102 1000 1000 0 0 0 0 0 8 8 BYTE_ORDER_MSB_LAST ADDRESS_GRANULARITY_BYTE OPTIONAL_CMD GET_COMM_MODE_INFO OPTIONAL_CMD SET_MTA OPTIONAL_CMD UPLOAD OPTIONAL_CMD SHORT_UPLOAD OPTIONAL_CMD BUILD_CHECKSUM OPTIONAL_CMD DOWNLOAD OPTIONAL_CMD DOWNLOAD_NEXT OPTIONAL_CMD DOWNLOAD_MAX OPTIONAL_CMD SET_CAL_PAGE OPTIONAL_CMD GET_CAL_PAGE OPTIONAL_CMD COPY_CAL_PAGE OPTIONAL_CMD CLEAR_DAQ_LIST OPTIONAL_CMD SET_DAQ_PTR OPTIONAL_CMD WRITE_DAQ OPTIONAL_CMD SET_DAQ_LIST_MODE OPTIONAL_CMD START_STOP_DAQ_LIST OPTIONAL_CMD START_STOP_SYNCH OPTIONAL_CMD FREE_DAQ OPTIONAL_CMD ALLOC_DAQ OPTIONAL_CMD ALLOC_ODT OPTIONAL_CMD ALLOC_ODT_ENTRY COMMUNICATION_MODE_SUPPORTED BLOCK SLAVE MASTER 255 0 /end PROTOCOL_LAYER
  /begin DAQ DYNAMIC 65535 3 0 OPTIMISATION_TYPE_DEFAULT ADDRESS_EXTENSION_FREE IDENTIFICATION_FIELD_TYPE_ABSOLUTE GRANULARITY_ODT_ENTRY_SIZE_DAQ_BYTE 255 OVERLOAD_INDICATION_EVENT PRESCALER_SUPPORTED /begin DAQ_MEMORY_CONSUMPTION 5495 46 6 5 2 0 /end DAQ_MEMORY_CONSUMPTION
   /begin EVENT "segment synchronous" "seg_sync" 0 DAQ 1 0 5 7 CONSISTENCY EVENT /begin MIN_CYCLE_TIME 14 5 /end MIN_CYCLE_TIME /end EVENT
   /begin EVENT "10ms time synchronous" "10_ms" 1 DAQ 1 10 6 6 CONSISTENCY EVENT /end EVENT
   /begin EVENT "100ms time synchronous" "100_ms" 2 DAQ 1 100 6 5 CONSISTENCY EVENT /end EVENT
  /end DAQ
  TRANSPORT_LAYER_INSTANCE "Calibration CAN (APPL)" /end XCP_ON_CAN
 /begin XCP_ON_CAN 0x0102 CAN_ID_MASTER 0x7F0 CAN_ID_SLAVE 0x7F1 BAUDRATE 500000 SAMPLE_POINT 81 BTL_CYCLES 16 SJW 3 MAX_BUS_LOAD 88
  /begin PROTOCOL_LAYER 0x0102 1000 1000 0 0 0 0 0 8 8 BYTE_ORDER_MSB_LAST ADDRESS_GRANULARITY_BYTE OPTIONAL_CMD GET_COMM_MODE_INFO OPTIONAL_CMD SET_MTA OPTIONAL_CMD UPLOAD OPTIONAL_CMD SHORT_UPLOAD OPTIONAL_CMD BUILD_CHECKSUM OPTIONAL_CMD DOWNLOAD OPTIONAL_CMD DOWNLOAD_NEXT OPTIONAL_CMD DOWNLOAD_MAX OPTIONAL_CMD SET_CAL_PAGE OPTIONAL_CMD GET_CAL_PAGE OPTIONAL_CMD COPY_CAL_PAGE OPTIONAL_CMD CLEAR_DAQ_LIST OPTIONAL_CMD SET_DAQ_PTR OPTIONAL_CMD WRITE_DAQ OPTIONAL_CMD SET_DAQ_LIST_MODE OPTIONAL_CMD START_STOP_DAQ_LIST OPTIONAL_CMD START_STOP_SYNCH OPTIONAL_CMD FREE_DAQ OPTIONAL_CMD ALLOC_DAQ OPTIONAL_CMD ALLOC_ODT OPTIONAL_CMD ALLOC_ODT_ENTRY COMMUNICATION_MODE_SUPPORTED BLOCK SLAVE MASTER 255 0 /end PROTOCOL_LAYER
  /begin DAQ DYNAMIC 65535 3 0 OPTIMISATION_TYPE_DEFAULT ADDRESS_EXTENSION_FREE IDENTIFICATION_FIELD_TYPE_ABSOLUTE GRANULARITY_ODT_ENTRY_SIZE_DAQ_BYTE 255 OVERLOAD_INDICATION_EVENT PRESCALER_SUPPORTED /begin DAQ_MEMORY_CONSUMPTION 19995 46 6 5 2 0 /end DAQ_MEMORY_CONSUMPTION
   /begin EVENT "segment synchronous" "seg_sync" 0 DAQ 1 0 5 7 CONSISTENCY EVENT /begin MIN_CYCLE_TIME 14 5 /end MIN_CYCLE_TIME /end EVENT
   /begin EVENT "10ms time synchronous" "10_ms" 1 DAQ 1 10 6 6 CONSISTENCY EVENT /end EVENT
   /begin EVENT "100ms time synchronous" "100_ms" 2 DAQ 1 100 6 5 CONSISTENCY EVENT /end EVENT
  /end DAQ
  TRANSPORT_LAYER_INSTANCE "Calibration CAN (APPL) (ED-RAM)" /end XCP_ON_CAN
 /begin XCP_ON_CAN 0x0102 CAN_ID_MASTER 0x7F0 CAN_ID_SLAVE 0x7F1 BAUDRATE 500000 SAMPLE_POINT 81 BTL_CYCLES 16 SJW 3 MAX_BUS_LOAD 20
  /begin PROTOCOL_LAYER 0x0102 1000 1000 0 0 0 0 0 8 8 BYTE_ORDER_MSB_LAST ADDRESS_GRANULARITY_BYTE OPTIONAL_CMD GET_COMM_MODE_INFO OPTIONAL_CMD SET_MTA OPTIONAL_CMD UPLOAD OPTIONAL_CMD SHORT_UPLOAD OPTIONAL_CMD BUILD_CHECKSUM OPTIONAL_CMD DOWNLOAD OPTIONAL_CMD DOWNLOAD_NEXT OPTIONAL_CMD DOWNLOAD_MAX OPTIONAL_CMD SET_CAL_PAGE OPTIONAL_CMD GET_CAL_PAGE OPTIONAL_CMD COPY_CAL_PAGE OPTIONAL_CMD CLEAR_DAQ_LIST OPTIONAL_CMD SET_DAQ_PTR OPTIONAL_CMD WRITE_DAQ OPTIONAL_CMD SET_DAQ_LIST_MODE OPTIONAL_CMD START_STOP_DAQ_LIST OPTIONAL_CMD START_STOP_SYNCH OPTIONAL_CMD FREE_DAQ OPTIONAL_CMD ALLOC_DAQ OPTIONAL_CMD ALLOC_ODT OPTIONAL_CMD ALLOC_ODT_ENTRY COMMUNICATION_MODE_SUPPORTED BLOCK SLAVE MASTER 255 0 /end PROTOCOL_LAYER
  /begin DAQ DYNAMIC 65535 3 0 OPTIMISATION_TYPE_DEFAULT ADDRESS_EXTENSION_FREE IDENTIFICATION_FIELD_TYPE_ABSOLUTE GRANULARITY_ODT_ENTRY_SIZE_DAQ_BYTE 255 OVERLOAD_INDICATION_EVENT PRESCALER_SUPPORTED /begin DAQ_MEMORY_CONSUMPTION 5495 46 6 5 2 0 /end DAQ_MEMORY_CONSUMPTION
   /begin EVENT "segment synchronous" "seg_sync" 0 DAQ 1 0 5 7 CONSISTENCY EVENT /begin MIN_CYCLE_TIME 14 5 /end MIN_CYCLE_TIME /end EVENT
   /begin EVENT "10ms time synchronous" "10_ms" 1 DAQ 1 10 6 6 CONSISTENCY EVENT /end EVENT
   /begin EVENT "100ms time synchronous" "100_ms" 2 DAQ 1 100 6 5 CONSISTENCY EVENT /end EVENT
  /end DAQ
  TRANSPORT_LAYER_INSTANCE "Vehicle CAN (VEHICLE)" /end XCP_ON_CAN
 /begin XCP_ON_CAN 0x0102 CAN_ID_MASTER 0x7F0 CAN_ID_SLAVE 0x7F1 BAUDRATE 500000 SAMPLE_POINT 81 BTL_CYCLES 16 SJW 3 MAX_BUS_LOAD 20
  /begin PROTOCOL_LAYER 0x0102 1000 1000 0 0 0 0 0 8 8 BYTE_ORDER_MSB_LAST ADDRESS_GRANULARITY_BYTE OPTIONAL_CMD GET_COMM_MODE_INFO OPTIONAL_CMD SET_MTA OPTIONAL_CMD UPLOAD OPTIONAL_CMD SHORT_UPLOAD OPTIONAL_CMD BUILD_CHECKSUM OPTIONAL_CMD DOWNLOAD OPTIONAL_CMD DOWNLOAD_NEXT OPTIONAL_CMD DOWNLOAD_MAX OPTIONAL_CMD SET_CAL_PAGE OPTIONAL_CMD GET_CAL_PAGE OPTIONAL_CMD COPY_CAL_PAGE OPTIONAL_CMD CLEAR_DAQ_LIST OPTIONAL_CMD SET_DAQ_PTR OPTIONAL_CMD WRITE_DAQ OPTIONAL_CMD SET_DAQ_LIST_MODE OPTIONAL_CMD START_STOP_DAQ_LIST OPTIONAL_CMD START_STOP_SYNCH OPTIONAL_CMD FREE_DAQ OPTIONAL_CMD ALLOC_DAQ OPTIONAL_CMD ALLOC_ODT OPTIONAL_CMD ALLOC_ODT_ENTRY COMMUNICATION_MODE_SUPPORTED BLOCK SLAVE MASTER 255 0 /end PROTOCOL_LAYER
  /begin DAQ DYNAMIC 65535 3 0 OPTIMISATION_TYPE_DEFAULT ADDRESS_EXTENSION_FREE IDENTIFICATION_FIELD_TYPE_ABSOLUTE GRANULARITY_ODT_ENTRY_SIZE_DAQ_BYTE 255 OVERLOAD_INDICATION_EVENT PRESCALER_SUPPORTED /begin DAQ_MEMORY_CONSUMPTION 19995 46 6 5 2 0 /end DAQ_MEMORY_CONSUMPTION
   /begin EVENT "segment synchronous" "seg_sync" 0 DAQ 1 0 5 7 CONSISTENCY EVENT /begin MIN_CYCLE_TIME 14 5 /end MIN_CYCLE_TIME /end EVENT
   /begin EVENT "10ms time synchronous" "10_ms" 1 DAQ 1 10 6 6 CONSISTENCY EVENT /end EVENT
   /begin EVENT "100ms time synchronous" "100_ms" 2 DAQ 1 100 6 5 CONSISTENCY EVENT /end EVENT
  /end DAQ
  TRANSPORT_LAYER_INSTANCE "Vehicle CAN (VEHICLE) (ED-RAM)" /end XCP_ON_CAN
 /begin XCP_ON_CAN 0x0102 CAN_ID_MASTER 0x7F0 CAN_ID_SLAVE 0x7F1 BAUDRATE 500000 SAMPLE_POINT 81 BTL_CYCLES 16 SJW 3 MAX_BUS_LOAD 88
  /begin PROTOCOL_LAYER 0x0102 1000 1000 0 0 0 0 0 8 8 BYTE_ORDER_MSB_LAST ADDRESS_GRANULARITY_BYTE OPTIONAL_CMD GET_COMM_MODE_INFO OPTIONAL_CMD SET_MTA OPTIONAL_CMD UPLOAD OPTIONAL_CMD SHORT_UPLOAD OPTIONAL_CMD BUILD_CHECKSUM OPTIONAL_CMD DOWNLOAD OPTIONAL_CMD DOWNLOAD_NEXT OPTIONAL_CMD DOWNLOAD_MAX OPTIONAL_CMD SET_CAL_PAGE OPTIONAL_CMD GET_CAL_PAGE OPTIONAL_CMD COPY_CAL_PAGE OPTIONAL_CMD CLEAR_DAQ_LIST OPTIONAL_CMD SET_DAQ_PTR OPTIONAL_CMD WRITE_DAQ OPTIONAL_CMD SET_DAQ_LIST_MODE OPTIONAL_CMD START_STOP_DAQ_LIST OPTIONAL_CMD START_STOP_SYNCH OPTIONAL_CMD FREE_DAQ OPTIONAL_CMD ALLOC_DAQ OPTIONAL_CMD ALLOC_ODT OPTIONAL_CMD ALLOC_ODT_ENTRY COMMUNICATION_MODE_SUPPORTED BLOCK SLAVE MASTER 255 0 /end PROTOCOL_LAYER
  /begin DAQ DYNAMIC 65535 3 0 OPTIMISATION_TYPE_DEFAULT ADDRESS_EXTENSION_FREE IDENTIFICATION_FIELD_TYPE_ABSOLUTE GRANULARITY_ODT_ENTRY_SIZE_DAQ_BYTE 255 OVERLOAD_INDICATION_EVENT PRESCALER_SUPPORTED /begin DAQ_MEMORY_CONSUMPTION 5495 46 6 5 2 0 /end DAQ_MEMORY_CONSUMPTION
   /begin EVENT "segment synchronous" "seg_sync" 0 DAQ 1 0 5 7 CONSISTENCY EVENT /begin MIN_CYCLE_TIME 14 5 /end MIN_CYCLE_TIME /end EVENT
   /begin EVENT "10ms time synchronous" "10_ms" 1 DAQ 1 10 6 6 CONSISTENCY EVENT /end EVENT
   /begin EVENT "100ms time synchronous" "100_ms" 2 DAQ 1 100 6 5 CONSISTENCY EVENT /end EVENT
  /end DAQ
  TRANSPORT_LAYER_INSTANCE "CAN Channel (CAN C)" /end XCP_ON_CAN
 /begin XCP_ON_CAN 0x0102 CAN_ID_MASTER 0x7F0 CAN_ID_SLAVE 0x7F1 BAUDRATE 500000 SAMPLE_POINT 81 BTL_CYCLES 16 SJW 3 MAX_BUS_LOAD 88
  /begin PROTOCOL_LAYER 0x0102 1000 1000 0 0 0 0 0 8 8 BYTE_ORDER_MSB_LAST ADDRESS_GRANULARITY_BYTE OPTIONAL_CMD GET_COMM_MODE_INFO OPTIONAL_CMD SET_MTA OPTIONAL_CMD UPLOAD OPTIONAL_CMD SHORT_UPLOAD OPTIONAL_CMD BUILD_CHECKSUM OPTIONAL_CMD DOWNLOAD OPTIONAL_CMD DOWNLOAD_NEXT OPTIONAL_CMD DOWNLOAD_MAX OPTIONAL_CMD SET_CAL_PAGE OPTIONAL_CMD GET_CAL_PAGE OPTIONAL_CMD COPY_CAL_PAGE OPTIONAL_CMD CLEAR_DAQ_LIST OPTIONAL_CMD SET_DAQ_PTR OPTIONAL_CMD WRITE_DAQ OPTIONAL_CMD SET_DAQ_LIST_MODE OPTIONAL_CMD START_STOP_DAQ_LIST OPTIONAL_CMD START_STOP_SYNCH OPTIONAL_CMD FREE_DAQ OPTIONAL_CMD ALLOC_DAQ OPTIONAL_CMD ALLOC_ODT OPTIONAL_CMD ALLOC_ODT_ENTRY COMMUNICATION_MODE_SUPPORTED BLOCK SLAVE MASTER 255 0 /end PROTOCOL_LAYER
  /begin DAQ DYNAMIC 65535 3 0 OPTIMISATION_TYPE_DEFAULT ADDRESS_EXTENSION_FREE IDENTIFICATION_FIELD_TYPE_ABSOLUTE GRANULARITY_ODT_ENTRY_SIZE_DAQ_BYTE 255 OVERLOAD_INDICATION_EVENT PRESCALER_SUPPORTED /begin DAQ_MEMORY_CONSUMPTION 19995 46 6 5 2 0 /end DAQ_MEMORY_CONSUMPTION
   /begin EVENT "segment synchronous" "seg_sync" 0 DAQ 1 0 5 7 CONSISTENCY EVENT /begin MIN_CYCLE_TIME 14 5 /end MIN_CYCLE_TIME /end EVENT
   /begin EVENT "10ms time synchronous" "10_ms" 1 DAQ 1 10 6 6 CONSISTENCY EVENT /end EVENT
   /begin EVENT "100ms time synchronous" "100_ms" 2 DAQ 1 100 6 5 CONSISTENCY EVENT /end EVENT
  /end DAQ
  TRANSPORT_LAYER_INSTANCE "CAN Channel (CAN C) (ED-RAM)" /end XCP_ON_CAN
/end IF_DATA
/*********** Start of merged CHARACTERISTIC blocks ***********/
/begin CHARACTERISTIC CanIf_CanIfRxPduCfg_EAT10_RXCanDlc_C "Calibration parameter for the Data length of CAN frame CanIfRxPduCfg_EAT10_RX" VALUE 0x804D8643 DefaultValueRecordLayout_AUTOSAR_Platform_BaseTypes_uint8 8.0 RB_RBA_Common_CentralElements_CompuMethods_Identical 0.0 8. FORMAT "%5.0" /end CHARACTERISTIC
/begin CHARACTERISTIC CanIf_CanIfRxPduCfg_EAT11_RXCanDlc_C "Calibration parameter for the Data length of CAN frame CanIfRxPduCfg_EAT11_RX" VALUE 0x804D8642 DefaultValueRecordLayout_AUTOSAR_Platform_BaseTypes_uint8 8.0 RB_RBA_Common_CentralElements_CompuMethods_Identical 0.0 8. FORMAT "%5.0" /end CHARACTERISTIC
/begin CHARACTERISTIC CanIf_CanIfRxPduCfg_EAT12_RXCanDlc_C "Calibration parameter for the Data length of CAN frame CanIfRxPduCfg_EAT12_RX" VALUE 0x804D8641 DefaultValueRecordLayout_AUTOSAR_Platform_BaseTypes_uint8 2.0 RB_RBA_Common_CentralElements_CompuMethods_Identical 0.0 2. FORMAT "%5.0" /end CHARACTERISTIC
/begin CHARACTERISTIC CanIf_CanIfRxPduCfg_EAT13_RXCanDlc_C "Calibration parameter for the Data length of CAN frame CanIfRxPduCfg_EAT13_RX" VALUE 0x804D8640 DefaultValueRecordLayout_AUTOSAR_Platform_BaseTypes_uint8 3.0 RB_RBA_Common_CentralElements_CompuMethods_Identical 0.0 3. FORMAT "%5.0" /end CHARACTERISTIC
/begin CHARACTERISTIC CanIf_CanIfRxPduCfg_EAT4_RXCanDlc_C "Calibration parameter for the Data length of CAN frame CanIfRxPduCfg_EAT4_RX" VALUE 0x804D863F DefaultValueRecordLayout_AUTOSAR_Platform_BaseTypes_uint8 8.0 RB_RBA_Common_CentralElements_CompuMethods_Identical 0.0 8. FORMAT "%5.0" /end CHARACTERISTIC
/begin CHARACTERISTIC CanIf_CanIfRxPduCfg_EAT6_RXCanDlc_C "Calibration parameter for the Data length of CAN frame CanIfRxPduCfg_EAT6_RX" VALUE 0x804D863E DefaultValueRecordLayout_AUTOSAR_Platform_BaseTypes_uint8 3.0 RB_RBA_Common_CentralElements_CompuMethods_Identical 0.0 3. FORMAT "%5.0" /end CHARACTERISTIC
/begin CHARACTERISTIC CanIf_CanIfRxPduCfg_EAT7_RXCanDlc_C "Calibration parameter for the Data length of CAN frame CanIfRxPduCfg_EAT7_RX" VALUE 0x804D863D DefaultValueRecordLayout_AUTOSAR_Platform_BaseTypes_uint8 8.0 RB_RBA_Common_CentralElements_CompuMethods_Identical 0.0 8. FORMAT "%5.0" /end CHARACTERISTIC
/begin CHARACTERISTIC CanIf_CanIfRxPduCfg_EAT8_RXCanDlc_C "Calibration parameter for the Data length of CAN frame CanIfRxPduCfg_EAT8_RX" VALUE 0x804D863C DefaultValueRecordLayout_AUTOSAR_Platform_BaseTypes_uint8 8.0 RB_RBA_Common_CentralElements_CompuMethods_Identical 0.0 8. FORMAT "%5.0" /end CHARACTERISTIC
/begin CHARACTERISTIC CanIf_CanIfRxPduCfg_EATA_RXCanDlc_C "Calibration parameter for the Data length of CAN frame CanIfRxPduCfg_EATA_RX" VALUE 0x804D863B DefaultValueRecordLayout_AUTOSAR_Platform_BaseTypes_uint8 8.0 RB_RBA_Common_CentralElements_CompuMethods_Identical 0.0 8. FORMAT "%5.0" /end CHARACTERISTIC
/begin CHARACTERISTIC CanIf_CanIfRxPduCfg_EATB_RXCanDlc_C "Calibration parameter for the Data length of CAN frame CanIfRxPduCfg_EATB_RX" VALUE 0x804D863A DefaultValueRecordLayout_AUTOSAR_Platform_BaseTypes_uint8 8.0 RB_RBA_Common_CentralElements_CompuMethods_Identical 0.0 8. FORMAT "%5.0" /end CHARACTERISTIC
/begin CHARACTERISTIC CanIf_CanIfRxPduCfg_EATC_RXCanDlc_C "Calibration parameter for the Data length of CAN frame CanIfRxPduCfg_EATC_RX" VALUE 0x804D8639 DefaultValueRecordLayout_AUTOSAR_Platform_BaseTypes_uint8 8.0 RB_RBA_Common_CentralElements_CompuMethods_Identical 0.0 8. FORMAT "%5.0" /end CHARACTERISTIC
/begin CHARACTERISTIC CanIf_CanIfRxPduCfg_EPB2_RXCanDlc_C "Calibration parameter for the Data length of CAN frame CanIfRxPduCfg_EPB2_RX" VALUE 0x804D8638 DefaultValueRecordLayout_AUTOSAR_Platform_BaseTypes_uint8 8.0 RB_RBA_Common_CentralElements_CompuMethods_Identical 0.0 8. FORMAT "%5.0" /end CHARACTERISTIC
/begin CHARACTERISTIC CanIf_CanIfRxPduCfg_EPBB_RXCanDlc_C "Calibration parameter for the Data length of CAN frame CanIfRxPduCfg_EPBB_RX" VALUE 0x804D8637 DefaultValueRecordLayout_AUTOSAR_Platform_BaseTypes_uint8 8.0 RB_RBA_Common_CentralElements_CompuMethods_Identical 0.0 8. FORMAT "%5.0" /end CHARACTERISTIC
/begin CHARACTERISTIC CanIf_CanIfRxPduCfg_EPS1_RXCanDlc_C "Calibration parameter for the Data length of CAN frame CanIfRxPduCfg_EPS1_RX" VALUE 0x804D8636 DefaultValueRecordLayout_AUTOSAR_Platform_BaseTypes_uint8 3.0 RB_RBA_Common_CentralElements_CompuMethods_Identical 0.0 3. FORMAT "%5.0" /end CHARACTERISTIC
/begin CHARACTERISTIC CanIf_CanIfRxPduCfg_META_RXCanDlc_C "Calibration parameter for the Data length of CAN frame CanIfRxPduCfg_META_RX" VALUE 0x804D8635 DefaultValueRecordLayout_AUTOSAR_Platform_BaseTypes_uint8 8.0 RB_RBA_Common_CentralElements_CompuMethods_Identical 0.0 8. FORMAT "%5.0" /end CHARACTERISTIC
/begin CHARACTERISTIC CanIf_CanIfRxPduCfg_METD2_RXCanDlc_C "Calibration parameter for the Data length of CAN frame CanIfRxPduCfg_METD2_RX" VALUE 0x804D8634 DefaultValueRecordLayout_AUTOSAR_Platform_BaseTypes_uint8 6.0 RB_RBA_Common_CentralElements_CompuMethods_Identical 0.0 6. FORMAT "%5.0" /end CHARACTERISTIC
/begin CHARACTERISTIC CanIf_CanIfRxPduCfg_METD_RXCanDlc_C "Calibration parameter for the Data length of CAN frame CanIfRxPduCfg_METD_RX" VALUE 0x804D8633 DefaultValueRecordLayout_AUTOSAR_Platform_BaseTypes_uint8 7.0 RB_RBA_Common_CentralElements_CompuMethods_Identical 0.0 7. FORMAT "%5.0" /end CHARACTERISTIC
/begin CHARACTERISTIC CanIf_CanIfRxPduCfg_METF_RXCanDlc_C "Calibration parameter for the Data length of CAN frame CanIfRxPduCfg_METF_RX" VALUE 0x804D8632 DefaultValueRecordLayout_AUTOSAR_Platform_BaseTypes_uint8 8.0 RB_RBA_Common_CentralElements_CompuMethods_Identical 0.0 8. FORMAT "%5.0" /end CHARACTERISTIC
/begin CHARACTERISTIC CanIf_CanIfRxPduCfg_METG2_RXCanDlc_C "Calibration parameter for the Data length of CAN frame CanIfRxPduCfg_METG2_RX" VALUE 0x804D8631 DefaultValueRecordLayout_AUTOSAR_Platform_BaseTypes_uint8 8.0 RB_RBA_Common_CentralElements_CompuMethods_Identical 0.0 8. FORMAT "%5.0" /end CHARACTERISTIC
/begin CHARACTERISTIC CanIf_CanIfRxPduCfg_METG_RXCanDlc_C "Calibration parameter for the Data length of CAN frame CanIfRxPduCfg_METG_RX" VALUE 0x804D8630 DefaultValueRecordLayout_AUTOSAR_Platform_BaseTypes_uint8 4.0 RB_RBA_Common_CentralElements_CompuMethods_Identical 0.0 4. FORMAT "%5.0" /end CHARACTERISTIC
/begin CHARACTERISTIC CanIf_CanIfRxPduCfg_METH2_RXCanDlc_C "Calibration parameter for the Data length of CAN frame CanIfRxPduCfg_METH2_RX" VALUE 0x804D862F DefaultValueRecordLayout_AUTOSAR_Platform_BaseTypes_uint8 8.0 RB_RBA_Common_CentralElements_CompuMethods_Identical 0.0 8. FORMAT "%5.0" /end CHARACTERISTIC
/begin CHARACTERISTIC CanIf_CanIfRxPduCfg_METH_RXCanDlc_C "Calibration parameter for the Data length of CAN frame CanIfRxPduCfg_METH_RX" VALUE 0x804D862E DefaultValueRecordLayout_AUTOSAR_Platform_BaseTypes_uint8 8.0 RB_RBA_Common_CentralElements_CompuMethods_Identical 0.0 8. FORMAT "%5.0" /end CHARACTERISTIC
/begin CHARACTERISTIC CanIf_CanIfRxPduCfg_METI_RXCanDlc_C "Calibration parameter for the Data length of CAN frame CanIfRxPduCfg_METI_RX" VALUE 0x804D862D DefaultValueRecordLayout_AUTOSAR_Platform_BaseTypes_uint8 8.0 RB_RBA_Common_CentralElements_CompuMethods_Identical 0.0 8. FORMAT "%5.0" /end CHARACTERISTIC
/begin CHARACTERISTIC CanIf_CanIfRxPduCfg_METK_RXCanDlc_C "Calibration parameter for the Data length of CAN frame CanIfRxPduCfg_METK_RX" VALUE 0x804D862C DefaultValueRecordLayout_AUTOSAR_Platform_BaseTypes_uint8 8.0 RB_RBA_Common_CentralElements_CompuMethods_Identical 0.0 8. FORMAT "%5.0" /end CHARACTERISTIC
/begin CHARACTERISTIC CanIf_CanIfRxPduCfg_METL_RXCanDlc_C "Calibration parameter for the Data length of CAN frame CanIfRxPduCfg_METL_RX" VALUE 0x804D862B DefaultValueRecordLayout_AUTOSAR_Platform_BaseTypes_uint8 4.0 RB_RBA_Common_CentralElements_CompuMethods_Identical 0.0 4. FORMAT "%5.0" /end CHARACTERISTIC
/begin CHARACTERISTIC CanIf_CanIfRxPduCfg_METM_RXCanDlc_C "Calibration parameter for the Data length of CAN frame CanIfRxPduCfg_METM_RX" VALUE 0x804D862A DefaultValueRecordLayout_AUTOSAR_Platform_BaseTypes_uint8 8.0 RB_RBA_Common_CentralElements_CompuMethods_Identical 0.0 8. FORMAT "%5.0" /end CHARACTERISTIC
/begin CHARACTERISTIC CanIf_CanIfRxPduCfg_METN_RXCanDlc_C "Calibration parameter for the Data length of CAN frame CanIfRxPduCfg_METN_RX" VALUE 0x804D8629 DefaultValueRecordLayout_AUTOSAR_Platform_BaseTypes_uint8 4.0 RB_RBA_Common_CentralElements_CompuMethods_Identical 0.0 4. FORMAT "%5.0" /end CHARACTERISTIC
/begin CHARACTERISTIC CanIf_CanIfRxPduCfg_PCU_RXCanDlc_C "Calibration parameter for the Data length of CAN frame CanIfRxPduCfg_PCU_RX" VALUE 0x804D8628 DefaultValueRecordLayout_AUTOSAR_Platform_BaseTypes_uint8 1.0 RB_RBA_Common_CentralElements_CompuMethods_Identical 0.0 1. FORMAT "%5.0" /end CHARACTERISTIC
/begin CHARACTERISTIC CanIf_CanIfRxPduCfg_SRSB_RXCanDlc_C "Calibration parameter for the Data length of CAN frame CanIfRxPduCfg_SRSB_RX" VALUE 0x804D8627 DefaultValueRecordLayout_AUTOSAR_Platform_BaseTypes_uint8 3.0 RB_RBA_Common_CentralElements_CompuMethods_Identical 0.0 3. FORMAT "%5.0" /end CHARACTERISTIC
/begin CHARACTERISTIC CanIf_CanIfTxPduCfg_ENG10_TXCanDlc_C "Calibration parameter for the Data length of CAN frame CanIfTxPduCfg_ENG10_TX" VALUE 0x804D8626 DefaultValueRecordLayout_AUTOSAR_Platform_BaseTypes_uint8 8.0 RB_RBA_Common_CentralElements_CompuMethods_Identical 0.0 8. FORMAT "%5.0" /end CHARACTERISTIC
/begin CHARACTERISTIC CanIf_CanIfTxPduCfg_ENG10_TXCanId_C "Calibration parameter for the CanId of CAN frame CanIfTxPduCfg_ENG10_TX" VALUE 0x804D84A0 DefaultValueRecordLayout_AUTOSAR_Platform_BaseTypes_uint32 2047.0 RB_RBA_Common_CentralElements_CompuMethods_Identical 0.0 2047. FORMAT "%5.0" /end CHARACTERISTIC
/begin CHARACTERISTIC CanIf_CanIfTxPduCfg_ENG11_TXCanDlc_C "Calibration parameter for the Data length of CAN frame CanIfTxPduCfg_ENG11_TX" VALUE 0x804D8625 DefaultValueRecordLayout_AUTOSAR_Platform_BaseTypes_uint8 8.0 RB_RBA_Common_CentralElements_CompuMethods_Identical 0.0 8. FORMAT "%5.0" /end CHARACTERISTIC
/begin CHARACTERISTIC CanIf_CanIfTxPduCfg_ENG11_TXCanId_C "Calibration parameter for the CanId of CAN frame CanIfTxPduCfg_ENG11_TX" VALUE 0x804D849C DefaultValueRecordLayout_AUTOSAR_Platform_BaseTypes_uint32 2047.0 RB_RBA_Common_CentralElements_CompuMethods_Identical 0.0 2047. FORMAT "%5.0" /end CHARACTERISTIC
/begin CHARACTERISTIC CanIf_CanIfTxPduCfg_ENG15_TXCanDlc_C "Calibration parameter for the Data length of CAN frame CanIfTxPduCfg_ENG15_TX" VALUE 0x804D8624 DefaultValueRecordLayout_AUTOSAR_Platform_BaseTypes_uint8 8.0 RB_RBA_Common_CentralElements_CompuMethods_Identical 0.0 8. FORMAT "%5.0" /end CHARACTERISTIC
/begin CHARACTERISTIC CanIf_CanIfTxPduCfg_ENG15_TXCanId_C "Calibration parameter for the CanId of CAN frame CanIfTxPduCfg_ENG15_TX" VALUE 0x804D8498 DefaultValueRecordLayout_AUTOSAR_Platform_BaseTypes_uint32 2047.0 RB_RBA_Common_CentralElements_CompuMethods_Identical 0.0 2047. FORMAT "%5.0" /end CHARACTERISTIC
/begin CHARACTERISTIC CanIf_CanIfTxPduCfg_ENG16_TXCanDlc_C "Calibration parameter for the Data length of CAN frame CanIfTxPduCfg_ENG16_TX" VALUE 0x804D8623 DefaultValueRecordLayout_AUTOSAR_Platform_BaseTypes_uint8 8.0 RB_RBA_Common_CentralElements_CompuMethods_Identical 0.0 8. FORMAT "%5.0" /end CHARACTERISTIC
/begin CHARACTERISTIC CanIf_CanIfTxPduCfg_ENG16_TXCanId_C "Calibration parameter for the CanId of CAN frame CanIfTxPduCfg_ENG16_TX" VALUE 0x804D8494 DefaultValueRecordLayout_AUTOSAR_Platform_BaseTypes_uint32 2047.0 RB_RBA_Common_CentralElements_CompuMethods_Identical 0.0 2047. FORMAT "%5.0" /end CHARACTERISTIC
/begin CHARACTERISTIC CanIf_CanIfTxPduCfg_ENG17_TXCanDlc_C "Calibration parameter for the Data length of CAN frame CanIfTxPduCfg_ENG17_TX" VALUE 0x804D8622 DefaultValueRecordLayout_AUTOSAR_Platform_BaseTypes_uint8 8.0 RB_RBA_Common_CentralElements_CompuMethods_Identical 0.0 8. FORMAT "%5.0" /end CHARACTERISTIC
/begin CHARACTERISTIC CanIf_CanIfTxPduCfg_ENG17_TXCanId_C "Calibration parameter for the CanId of CAN frame CanIfTxPduCfg_ENG17_TX" VALUE 0x804D8490 DefaultValueRecordLayout_AUTOSAR_Platform_BaseTypes_uint32 2047.0 RB_RBA_Common_CentralElements_CompuMethods_Identical 0.0 2047. FORMAT "%5.0" /end CHARACTERISTIC
/begin CHARACTERISTIC CanIf_CanIfTxPduCfg_ENG18_TXCanDlc_C "Calibration parameter for the Data length of CAN frame CanIfTxPduCfg_ENG18_TX" VALUE 0x804D8621 DefaultValueRecordLayout_AUTOSAR_Platform_BaseTypes_uint8 8.0 RB_RBA_Common_CentralElements_CompuMethods_Identical 0.0 8. FORMAT "%5.0" /end CHARACTERISTIC
/begin CHARACTERISTIC CanIf_CanIfTxPduCfg_ENG18_TXCanId_C "Calibration parameter for the CanId of CAN frame CanIfTxPduCfg_ENG18_TX" VALUE 0x804D848C DefaultValueRecordLayout_AUTOSAR_Platform_BaseTypes_uint32 2047.0 RB_RBA_Common_CentralElements_CompuMethods_Identical 0.0 2047. FORMAT "%5.0" /end CHARACTERISTIC
/begin CHARACTERISTIC CanIf_CanIfTxPduCfg_ENG19_TXCanDlc_C "Calibration parameter for the Data length of CAN frame CanIfTxPduCfg_ENG19_TX" VALUE 0x804D8620 DefaultValueRecordLayout_AUTOSAR_Platform_BaseTypes_uint8 8.0 RB_RBA_Common_CentralElements_CompuMethods_Identical 0.0 8. FORMAT "%5.0" /end CHARACTERISTIC
/begin CHARACTERISTIC CanIf_CanIfTxPduCfg_ENG19_TXCanId_C "Calibration parameter for the CanId of CAN frame CanIfTxPduCfg_ENG19_TX" VALUE 0x804D8488 DefaultValueRecordLayout_AUTOSAR_Platform_BaseTypes_uint32 2047.0 RB_RBA_Common_CentralElements_CompuMethods_Identical 0.0 2047. FORMAT "%5.0" /end CHARACTERISTIC
/begin CHARACTERISTIC CanIf_CanIfTxPduCfg_ENG20_TXCanDlc_C "Calibration parameter for the Data length of CAN frame CanIfTxPduCfg_ENG20_TX" VALUE 0x804D861F DefaultValueRecordLayout_AUTOSAR_Platform_BaseTypes_uint8 8.0 RB_RBA_Common_CentralElements_CompuMethods_Identical 0.0 8. FORMAT "%5.0" /end CHARACTERISTIC
/begin CHARACTERISTIC CanIf_CanIfTxPduCfg_ENG20_TXCanId_C "Calibration parameter for the CanId of CAN frame CanIfTxPduCfg_ENG20_TX" VALUE 0x804D8484 DefaultValueRecordLayout_AUTOSAR_Platform_BaseTypes_uint32 2047.0 RB_RBA_Common_CentralElements_CompuMethods_Identical 0.0 2047. FORMAT "%5.0" /end CHARACTERISTIC
/begin CHARACTERISTIC CanIf_CanIfTxPduCfg_ENG21_TXCanDlc_C "Calibration parameter for the Data length of CAN frame CanIfTxPduCfg_ENG21_TX" VALUE 0x804D861E DefaultValueRecordLayout_AUTOSAR_Platform_BaseTypes_uint8 8.0 RB_RBA_Common_CentralElements_CompuMethods_Identical 0.0 8. FORMAT "%5.0" /end CHARACTERISTIC
/begin CHARACTERISTIC CanIf_CanIfTxPduCfg_ENG21_TXCanId_C "Calibration parameter for the CanId of CAN frame CanIfTxPduCfg_ENG21_TX" VALUE 0x804D8480 DefaultValueRecordLayout_AUTOSAR_Platform_BaseTypes_uint32 2047.0 RB_RBA_Common_CentralElements_CompuMethods_Identical 0.0 2047. FORMAT "%5.0" /end CHARACTERISTIC
/begin CHARACTERISTIC CanIf_CanIfTxPduCfg_ENG22_TXCanDlc_C "Calibration parameter for the Data length of CAN frame CanIfTxPduCfg_ENG22_TX" VALUE 0x804D861D DefaultValueRecordLayout_AUTOSAR_Platform_BaseTypes_uint8 8.0 RB_RBA_Common_CentralElements_CompuMethods_Identical 0.0 8. FORMAT "%5.0" /end CHARACTERISTIC
/begin CHARACTERISTIC CanIf_CanIfTxPduCfg_ENG22_TXCanId_C "Calibration parameter for the CanId of CAN frame CanIfTxPduCfg_ENG22_TX" VALUE 0x804D847C DefaultValueRecordLayout_AUTOSAR_Platform_BaseTypes_uint32 2047.0 RB_RBA_Common_CentralElements_CompuMethods_Identical 0.0 2047. FORMAT "%5.0" /end CHARACTERISTIC
/begin CHARACTERISTIC CanIf_CanIfTxPduCfg_ENG23_TXCanDlc_C "Calibration parameter for the Data length of CAN frame CanIfTxPduCfg_ENG23_TX" VALUE 0x804D861C DefaultValueRecordLayout_AUTOSAR_Platform_BaseTypes_uint8 8.0 RB_RBA_Common_CentralElements_CompuMethods_Identical 0.0 8. FORMAT "%5.0" /end CHARACTERISTIC
/begin CHARACTERISTIC CanIf_CanIfTxPduCfg_ENG23_TXCanId_C "Calibration parameter for the CanId of CAN frame CanIfTxPduCfg_ENG23_TX" VALUE 0x804D8478 DefaultValueRecordLayout_AUTOSAR_Platform_BaseTypes_uint32 2047.0 RB_RBA_Common_CentralElements_CompuMethods_Identical 0.0 2047. FORMAT "%5.0" /end CHARACTERISTIC
/begin CHARACTERISTIC CanIf_CanIfTxPduCfg_ENG24_TXCanDlc_C "Calibration parameter for the Data length of CAN frame CanIfTxPduCfg_ENG24_TX" VALUE 0x804D861B DefaultValueRecordLayout_AUTOSAR_Platform_BaseTypes_uint8 8.0 RB_RBA_Common_CentralElements_CompuMethods_Identical 0.0 8. FORMAT "%5.0" /end CHARACTERISTIC
/begin CHARACTERISTIC CanIf_CanIfTxPduCfg_ENG24_TXCanId_C "Calibration parameter for the CanId of CAN frame CanIfTxPduCfg_ENG24_TX" VALUE 0x804D8474 DefaultValueRecordLayout_AUTOSAR_Platform_BaseTypes_uint32 2047.0 RB_RBA_Common_CentralElements_CompuMethods_Identical 0.0 2047. FORMAT "%5.0" /end CHARACTERISTIC
/begin CHARACTERISTIC CanIf_CanIfTxPduCfg_ENG25_TXCanDlc_C "Calibration parameter for the Data length of CAN frame CanIfTxPduCfg_ENG25_TX" VALUE 0x804D861A DefaultValueRecordLayout_AUTOSAR_Platform_BaseTypes_uint8 8.0 RB_RBA_Common_CentralElements_CompuMethods_Identical 0.0 8. FORMAT "%5.0" /end CHARACTERISTIC
/begin CHARACTERISTIC CanIf_CanIfTxPduCfg_ENG25_TXCanId_C "Calibration parameter for the CanId of CAN frame CanIfTxPduCfg_ENG25_TX" VALUE 0x804D8470 DefaultValueRecordLayout_AUTOSAR_Platform_BaseTypes_uint32 2047.0 RB_RBA_Common_CentralElements_CompuMethods_Identical 0.0 2047. FORMAT "%5.0" /end CHARACTERISTIC
/begin CHARACTERISTIC CanIf_CanIfTxPduCfg_ENG2_TXCanDlc_C "Calibration parameter for the Data length of CAN frame CanIfTxPduCfg_ENG2_TX" VALUE 0x804D8619 DefaultValueRecordLayout_AUTOSAR_Platform_BaseTypes_uint8 5.0 RB_RBA_Common_CentralElements_CompuMethods_Identical 0.0 5. FORMAT "%5.0" /end CHARACTERISTIC
/begin CHARACTERISTIC CanIf_CanIfTxPduCfg_ENG2_TXCanId_C "Calibration parameter for the CanId of CAN frame CanIfTxPduCfg_ENG2_TX" VALUE 0x804D846C DefaultValueRecordLayout_AUTOSAR_Platform_BaseTypes_uint32 2047.0 RB_RBA_Common_CentralElements_CompuMethods_Identical 0.0 2047. FORMAT "%5.0" /end CHARACTERISTIC
/begin CHARACTERISTIC CanIf_CanIfTxPduCfg_ENG3_TXCanDlc_C "Calibration parameter for the Data length of CAN frame CanIfTxPduCfg_ENG3_TX" VALUE 0x804D8618 DefaultValueRecordLayout_AUTOSAR_Platform_BaseTypes_uint8 8.0 RB_RBA_Common_CentralElements_CompuMethods_Identical 0.0 8. FORMAT "%5.0" /end CHARACTERISTIC
/begin CHARACTERISTIC CanIf_CanIfTxPduCfg_ENG3_TXCanId_C "Calibration parameter for the CanId of CAN frame CanIfTxPduCfg_ENG3_TX" VALUE 0x804D8468 DefaultValueRecordLayout_AUTOSAR_Platform_BaseTypes_uint32 2047.0 RB_RBA_Common_CentralElements_CompuMethods_Identical 0.0 2047. FORMAT "%5.0" /end CHARACTERISTIC
/begin CHARACTERISTIC CanIf_CanIfTxPduCfg_ENG4_TXCanDlc_C "Calibration parameter for the Data length of CAN frame CanIfTxPduCfg_ENG4_TX" VALUE 0x804D8617 DefaultValueRecordLayout_AUTOSAR_Platform_BaseTypes_uint8 8.0 RB_RBA_Common_CentralElements_CompuMethods_Identical 0.0 8. FORMAT "%5.0" /end CHARACTERISTIC
/begin CHARACTERISTIC CanIf_CanIfTxPduCfg_ENG4_TXCanId_C "Calibration parameter for the CanId of CAN frame CanIfTxPduCfg_ENG4_TX" VALUE 0x804D8464 DefaultValueRecordLayout_AUTOSAR_Platform_BaseTypes_uint32 2047.0 RB_RBA_Common_CentralElements_CompuMethods_Identical 0.0 2047. FORMAT "%5.0" /end CHARACTERISTIC
/begin CHARACTERISTIC CanIf_CanIfTxPduCfg_ENG5_TXCanDlc_C "Calibration parameter for the Data length of CAN frame CanIfTxPduCfg_ENG5_TX" VALUE 0x804D8616 DefaultValueRecordLayout_AUTOSAR_Platform_BaseTypes_uint8 8.0 RB_RBA_Common_CentralElements_CompuMethods_Identical 0.0 8. FORMAT "%5.0" /end CHARACTERISTIC
/begin CHARACTERISTIC CanIf_CanIfTxPduCfg_ENG5_TXCanId_C "Calibration parameter for the CanId of CAN frame CanIfTxPduCfg_ENG5_TX" VALUE 0x804D8460 DefaultValueRecordLayout_AUTOSAR_Platform_BaseTypes_uint32 2047.0 RB_RBA_Common_CentralElements_CompuMethods_Identical 0.0 2047. FORMAT "%5.0" /end CHARACTERISTIC
/begin CHARACTERISTIC CanIf_CanIfTxPduCfg_ENG6_TXCanDlc_C "Calibration parameter for the Data length of CAN frame CanIfTxPduCfg_ENG6_TX" VALUE 0x804D8615 DefaultValueRecordLayout_AUTOSAR_Platform_BaseTypes_uint8 8.0 RB_RBA_Common_CentralElements_CompuMethods_Identical 0.0 8. FORMAT "%5.0" /end CHARACTERISTIC
/begin CHARACTERISTIC CanIf_CanIfTxPduCfg_ENG6_TXCanId_C "Calibration parameter for the CanId of CAN frame CanIfTxPduCfg_ENG6_TX" VALUE 0x804D845C DefaultValueRecordLayout_AUTOSAR_Platform_BaseTypes_uint32 2047.0 RB_RBA_Common_CentralElements_CompuMethods_Identical 0.0 2047. FORMAT "%5.0" /end CHARACTERISTIC
/begin CHARACTERISTIC CanIf_CanIfTxPduCfg_ENGAE_TXCanDlc_C "Calibration parameter for the Data length of CAN frame CanIfTxPduCfg_ENGAE_TX" VALUE 0x804D8614 DefaultValueRecordLayout_AUTOSAR_Platform_BaseTypes_uint8 8.0 RB_RBA_Common_CentralElements_CompuMethods_Identical 0.0 8. FORMAT "%5.0" /end CHARACTERISTIC
/begin CHARACTERISTIC CanIf_CanIfTxPduCfg_ENGAE_TXCanId_C "Calibration parameter for the CanId of CAN frame CanIfTxPduCfg_ENGAE_TX" VALUE 0x804D8458 DefaultValueRecordLayout_AUTOSAR_Platform_BaseTypes_uint32 5.0E8 RB_RBA_Common_CentralElements_CompuMethods_Identical 0.0 5.E8 FORMAT "%5.0" /end CHARACTERISTIC
/begin CHARACTERISTIC CanIf_CanIfTxPduCfg_ENGA_TXCanId_C "Calibration parameter for the CanId of CAN frame CanIfTxPduCfg_ENGA_TX" VALUE 0x804D8454 DefaultValueRecordLayout_AUTOSAR_Platform_BaseTypes_uint32 2047.0 RB_RBA_Common_CentralElements_CompuMethods_Identical 0.0 2047. FORMAT "%5.0" /end CHARACTERISTIC
/begin CHARACTERISTIC CanIf_CanIfTxPduCfg_ENGB_TXCanDlc_C "Calibration parameter for the Data length of CAN frame CanIfTxPduCfg_ENGB_TX" VALUE 0x804D8613 DefaultValueRecordLayout_AUTOSAR_Platform_BaseTypes_uint8 8.0 RB_RBA_Common_CentralElements_CompuMethods_Identical 0.0 8. FORMAT "%5.0" /end CHARACTERISTIC
/begin CHARACTERISTIC CanIf_CanIfTxPduCfg_ENGB_TXCanId_C "Calibration parameter for the CanId of CAN frame CanIfTxPduCfg_ENGB_TX" VALUE 0x804D8450 DefaultValueRecordLayout_AUTOSAR_Platform_BaseTypes_uint32 2047.0 RB_RBA_Common_CentralElements_CompuMethods_Identical 0.0 2047. FORMAT "%5.0" /end CHARACTERISTIC
/begin CHARACTERISTIC CanIf_CanIfTxPduCfg_ENGC_TXCanDlc_C "Calibration parameter for the Data length of CAN frame CanIfTxPduCfg_ENGC_TX" VALUE 0x804D8612 DefaultValueRecordLayout_AUTOSAR_Platform_BaseTypes_uint8 8.0 RB_RBA_Common_CentralElements_CompuMethods_Identical 0.0 8. FORMAT "%5.0" /end CHARACTERISTIC
/begin CHARACTERISTIC CanIf_CanIfTxPduCfg_ENGC_TXCanId_C "Calibration parameter for the CanId of CAN frame CanIfTxPduCfg_ENGC_TX" VALUE 0x804D844C DefaultValueRecordLayout_AUTOSAR_Platform_BaseTypes_uint32 2047.0 RB_RBA_Common_CentralElements_CompuMethods_Identical 0.0 2047. FORMAT "%5.0" /end CHARACTERISTIC
/begin CHARACTERISTIC CanIf_CanIfTxPduCfg_ENGF_TXCanDlc_C "Calibration parameter for the Data length of CAN frame CanIfTxPduCfg_ENGF_TX" VALUE 0x804D8611 DefaultValueRecordLayout_AUTOSAR_Platform_BaseTypes_uint8 2.0 RB_RBA_Common_CentralElements_CompuMethods_Identical 0.0 2. FORMAT "%5.0" /end CHARACTERISTIC
/begin CHARACTERISTIC CanIf_CanIfTxPduCfg_ENGF_TXCanId_C "Calibration parameter for the CanId of CAN frame CanIfTxPduCfg_ENGF_TX" VALUE 0x804D8448 DefaultValueRecordLayout_AUTOSAR_Platform_BaseTypes_uint32 2047.0 RB_RBA_Common_CentralElements_CompuMethods_Identical 0.0 2047. FORMAT "%5.0" /end CHARACTERISTIC
/begin CHARACTERISTIC CanIf_CanIfTxPduCfg_ENGIMG1_TXCanDlc_C "Calibration parameter for the Data length of CAN frame CanIfTxPduCfg_ENGIMG1_TX" VALUE 0x804D8610 DefaultValueRecordLayout_AUTOSAR_Platform_BaseTypes_uint8 8.0 RB_RBA_Common_CentralElements_CompuMethods_Identical 0.0 8. FORMAT "%5.0" /end CHARACTERISTIC
/begin CHARACTERISTIC CanIf_CanIfTxPduCfg_ENGIMG1_TXCanId_C "Calibration parameter for the CanId of CAN frame CanIfTxPduCfg_ENGIMG1_TX" VALUE 0x804D8444 DefaultValueRecordLayout_AUTOSAR_Platform_BaseTypes_uint32 2047.0 RB_RBA_Common_CentralElements_CompuMethods_Identical 0.0 2047. FORMAT "%5.0" /end CHARACTERISTIC
/begin CHARACTERISTIC CanIf_CanIfTxPduCfg_ENGJ3_TXCanDlc_C "Calibration parameter for the Data length of CAN frame CanIfTxPduCfg_ENGJ3_TX" VALUE 0x804D860F DefaultValueRecordLayout_AUTOSAR_Platform_BaseTypes_uint8 8.0 RB_RBA_Common_CentralElements_CompuMethods_Identical 0.0 8. FORMAT "%5.0" /end CHARACTERISTIC
/begin CHARACTERISTIC CanIf_CanIfTxPduCfg_ENGJ3_TXCanId_C "Calibration parameter for the CanId of CAN frame CanIfTxPduCfg_ENGJ3_TX" VALUE 0x804D8440 DefaultValueRecordLayout_AUTOSAR_Platform_BaseTypes_uint32 2047.0 RB_RBA_Common_CentralElements_CompuMethods_Identical 0.0 2047. FORMAT "%5.0" /end CHARACTERISTIC
/begin CHARACTERISTIC CanIf_CanIfTxPduCfg_ENGK3_TXCanDlc_C "Calibration parameter for the Data length of CAN frame CanIfTxPduCfg_ENGK3_TX" VALUE 0x804D860E DefaultValueRecordLayout_AUTOSAR_Platform_BaseTypes_uint8 8.0 RB_RBA_Common_CentralElements_CompuMethods_Identical 0.0 8. FORMAT "%5.0" /end CHARACTERISTIC
/begin CHARACTERISTIC CanIf_CanIfTxPduCfg_ENGK3_TXCanId_C "Calibration parameter for the CanId of CAN frame CanIfTxPduCfg_ENGK3_TX" VALUE 0x804D843C DefaultValueRecordLayout_AUTOSAR_Platform_BaseTypes_uint32 2047.0 RB_RBA_Common_CentralElements_CompuMethods_Identical 0.0 2047. FORMAT "%5.0" /end CHARACTERISTIC
/begin CHARACTERISTIC CanIf_CanIfTxPduCfg_ENGL_TXCanDlc_C "Calibration parameter for the Data length of CAN frame CanIfTxPduCfg_ENGL_TX" VALUE 0x804D860D DefaultValueRecordLayout_AUTOSAR_Platform_BaseTypes_uint8 8.0 RB_RBA_Common_CentralElements_CompuMethods_Identical 0.0 8. FORMAT "%5.0" /end CHARACTERISTIC
/begin CHARACTERISTIC CanIf_CanIfTxPduCfg_ENGL_TXCanId_C "Calibration parameter for the CanId of CAN frame CanIfTxPduCfg_ENGL_TX" VALUE 0x804D8438 DefaultValueRecordLayout_AUTOSAR_Platform_BaseTypes_uint32 2047.0 RB_RBA_Common_CentralElements_CompuMethods_Identical 0.0 2047. FORMAT "%5.0" /end CHARACTERISTIC
/begin CHARACTERISTIC CanIf_CanIfTxPduCfg_ENGN_TXCanDlc_C "Calibration parameter for the Data length of CAN frame CanIfTxPduCfg_ENGN_TX" VALUE 0x804D860C DefaultValueRecordLayout_AUTOSAR_Platform_BaseTypes_uint8 8.0 RB_RBA_Common_CentralElements_CompuMethods_Identical 0.0 8. FORMAT "%5.0" /end CHARACTERISTIC
/begin CHARACTERISTIC CanIf_CanIfTxPduCfg_ENGN_TXCanId_C "Calibration parameter for the CanId of CAN frame CanIfTxPduCfg_ENGN_TX" VALUE 0x804D8434 DefaultValueRecordLayout_AUTOSAR_Platform_BaseTypes_uint32 2047.0 RB_RBA_Common_CentralElements_CompuMethods_Identical 0.0 2047. FORMAT "%5.0" /end CHARACTERISTIC
/begin CHARACTERISTIC CanIf_CanIfTxPduCfg_ENGQ_TXCanDlc_C "Calibration parameter for the Data length of CAN frame CanIfTxPduCfg_ENGQ_TX" VALUE 0x804D860B DefaultValueRecordLayout_AUTOSAR_Platform_BaseTypes_uint8 2.0 RB_RBA_Common_CentralElements_CompuMethods_Identical 0.0 2. FORMAT "%5.0" /end CHARACTERISTIC
/begin CHARACTERISTIC CanIf_CanIfTxPduCfg_ENGQ_TXCanId_C "Calibration parameter for the CanId of CAN frame CanIfTxPduCfg_ENGQ_TX" VALUE 0x804D8430 DefaultValueRecordLayout_AUTOSAR_Platform_BaseTypes_uint32 2047.0 RB_RBA_Common_CentralElements_CompuMethods_Identical 0.0 2047. FORMAT "%5.0" /end CHARACTERISTIC
/begin CHARACTERISTIC CanIf_CanIfTxPduCfg_ENGR_TXCanDlc_C "Calibration parameter for the Data length of CAN frame CanIfTxPduCfg_ENGR_TX" VALUE 0x804D860A DefaultValueRecordLayout_AUTOSAR_Platform_BaseTypes_uint8 5.0 RB_RBA_Common_CentralElements_CompuMethods_Identical 0.0 5. FORMAT "%5.0" /end CHARACTERISTIC
/begin CHARACTERISTIC CanIf_CanIfTxPduCfg_ENGR_TXCanId_C "Calibration parameter for the CanId of CAN frame CanIfTxPduCfg_ENGR_TX" VALUE 0x804D842C DefaultValueRecordLayout_AUTOSAR_Platform_BaseTypes_uint32 2047.0 RB_RBA_Common_CentralElements_CompuMethods_Identical 0.0 2047. FORMAT "%5.0" /end CHARACTERISTIC
/begin CHARACTERISTIC CanIf_CanIfTxPduCfg_ENGT1_TXCanDlc_C "Calibration parameter for the Data length of CAN frame CanIfTxPduCfg_ENGT1_TX" VALUE 0x804D8609 DefaultValueRecordLayout_AUTOSAR_Platform_BaseTypes_uint8 8.0 RB_RBA_Common_CentralElements_CompuMethods_Identical 0.0 8. FORMAT "%5.0" /end CHARACTERISTIC
/begin CHARACTERISTIC CanIf_CanIfTxPduCfg_ENGT1_TXCanId_C "Calibration parameter for the CanId of CAN frame CanIfTxPduCfg_ENGT1_TX" VALUE 0x804D8428 DefaultValueRecordLayout_AUTOSAR_Platform_BaseTypes_uint32 2047.0 RB_RBA_Common_CentralElements_CompuMethods_Identical 0.0 2047. FORMAT "%5.0" /end CHARACTERISTIC
/begin CHARACTERISTIC CanIf_CanIfTxPduCfg_ENGT2_TXCanDlc_C "Calibration parameter for the Data length of CAN frame CanIfTxPduCfg_ENGT2_TX" VALUE 0x804D8608 DefaultValueRecordLayout_AUTOSAR_Platform_BaseTypes_uint8 8.0 RB_RBA_Common_CentralElements_CompuMethods_Identical 0.0 8. FORMAT "%5.0" /end CHARACTERISTIC
/begin CHARACTERISTIC CanIf_CanIfTxPduCfg_ENGT2_TXCanId_C "Calibration parameter for the CanId of CAN frame CanIfTxPduCfg_ENGT2_TX" VALUE 0x804D8424 DefaultValueRecordLayout_AUTOSAR_Platform_BaseTypes_uint32 2047.0 RB_RBA_Common_CentralElements_CompuMethods_Identical 0.0 2047. FORMAT "%5.0" /end CHARACTERISTIC
/begin CHARACTERISTIC CanIf_CanIfTxPduCfg_ENGT_TXCanDlc_C "Calibration parameter for the Data length of CAN frame CanIfTxPduCfg_ENGT_TX" VALUE 0x804D8607 DefaultValueRecordLayout_AUTOSAR_Platform_BaseTypes_uint8 8.0 RB_RBA_Common_CentralElements_CompuMethods_Identical 0.0 8. FORMAT "%5.0" /end CHARACTERISTIC
/begin CHARACTERISTIC CanIf_CanIfTxPduCfg_ENGT_TXCanId_C "Calibration parameter for the CanId of CAN frame CanIfTxPduCfg_ENGT_TX" VALUE 0x804D8420 DefaultValueRecordLayout_AUTOSAR_Platform_BaseTypes_uint32 2047.0 RB_RBA_Common_CentralElements_CompuMethods_Identical 0.0 2047. FORMAT "%5.0" /end CHARACTERISTIC
/begin CHARACTERISTIC CanIf_CanIfTxPduCfg_ENGU_TXCanDlc_C "Calibration parameter for the Data length of CAN frame CanIfTxPduCfg_ENGU_TX" VALUE 0x804D8606 DefaultValueRecordLayout_AUTOSAR_Platform_BaseTypes_uint8 8.0 RB_RBA_Common_CentralElements_CompuMethods_Identical 0.0 8. FORMAT "%5.0" /end CHARACTERISTIC
/begin CHARACTERISTIC CanIf_CanIfTxPduCfg_ENGU_TXCanId_C "Calibration parameter for the CanId of CAN frame CanIfTxPduCfg_ENGU_TX" VALUE 0x804D841C DefaultValueRecordLayout_AUTOSAR_Platform_BaseTypes_uint32 2047.0 RB_RBA_Common_CentralElements_CompuMethods_Identical 0.0 2047. FORMAT "%5.0" /end CHARACTERISTIC
/begin CHARACTERISTIC CanIf_CanIfTxPduCfg_ENGV_TXCanDlc_C "Calibration parameter for the Data length of CAN frame CanIfTxPduCfg_ENGV_TX" VALUE 0x804D8605 DefaultValueRecordLayout_AUTOSAR_Platform_BaseTypes_uint8 8.0 RB_RBA_Common_CentralElements_CompuMethods_Identical 0.0 8. FORMAT "%5.0" /end CHARACTERISTIC
/begin CHARACTERISTIC CanIf_CanIfTxPduCfg_ENGV_TXCanId_C "Calibration parameter for the CanId of CAN frame CanIfTxPduCfg_ENGV_TX" VALUE 0x804D8418 DefaultValueRecordLayout_AUTOSAR_Platform_BaseTypes_uint32 2047.0 RB_RBA_Common_CentralElements_CompuMethods_Identical 0.0 2047. FORMAT "%5.0" /end CHARACTERISTIC
/begin CHARACTERISTIC CanIf_CanIfTxPduCfg_ENGW_TXCanDlc_C "Calibration parameter for the Data length of CAN frame CanIfTxPduCfg_ENGW_TX" VALUE 0x804D8604 DefaultValueRecordLayout_AUTOSAR_Platform_BaseTypes_uint8 8.0 RB_RBA_Common_CentralElements_CompuMethods_Identical 0.0 8. FORMAT "%5.0" /end CHARACTERISTIC
/begin CHARACTERISTIC CanIf_CanIfTxPduCfg_ENGW_TXCanId_C "Calibration parameter for the CanId of CAN frame CanIfTxPduCfg_ENGW_TX" VALUE 0x804D8414 DefaultValueRecordLayout_AUTOSAR_Platform_BaseTypes_uint32 2047.0 RB_RBA_Common_CentralElements_CompuMethods_Identical 0.0 2047. FORMAT "%5.0" /end CHARACTERISTIC
/begin CHARACTERISTIC CanIf_CanIfTxPduCfg_ENGX2_TXCanDlc_C "Calibration parameter for the Data length of CAN frame CanIfTxPduCfg_ENGX2_TX" VALUE 0x804D8603 DefaultValueRecordLayout_AUTOSAR_Platform_BaseTypes_uint8 8.0 RB_RBA_Common_CentralElements_CompuMethods_Identical 0.0 8. FORMAT "%5.0" /end CHARACTERISTIC
/begin CHARACTERISTIC CanIf_CanIfTxPduCfg_ENGX2_TXCanId_C "Calibration parameter for the CanId of CAN frame CanIfTxPduCfg_ENGX2_TX" VALUE 0x804D8410 DefaultValueRecordLayout_AUTOSAR_Platform_BaseTypes_uint32 2047.0 RB_RBA_Common_CentralElements_CompuMethods_Identical 0.0 2047. FORMAT "%5.0" /end CHARACTERISTIC
/begin CHARACTERISTIC CanIf_CanIfTxPduCfg_ENGY2_TXCanDlc_C "Calibration parameter for the Data length of CAN frame CanIfTxPduCfg_ENGY2_TX" VALUE 0x804D8602 DefaultValueRecordLayout_AUTOSAR_Platform_BaseTypes_uint8 4.0 RB_RBA_Common_CentralElements_CompuMethods_Identical 0.0 4. FORMAT "%5.0" /end CHARACTERISTIC
/begin CHARACTERISTIC CanIf_CanIfTxPduCfg_ENGY2_TXCanId_C "Calibration parameter for the CanId of CAN frame CanIfTxPduCfg_ENGY2_TX" VALUE 0x804D840C DefaultValueRecordLayout_AUTOSAR_Platform_BaseTypes_uint32 2047.0 RB_RBA_Common_CentralElements_CompuMethods_Identical 0.0 2047. FORMAT "%5.0" /end CHARACTERISTIC
/begin CHARACTERISTIC CanIf_CanIfTxPduCfg_ENGY_TXCanDlc_C "Calibration parameter for the Data length of CAN frame CanIfTxPduCfg_ENGY_TX" VALUE 0x804D8601 DefaultValueRecordLayout_AUTOSAR_Platform_BaseTypes_uint8 5.0 RB_RBA_Common_CentralElements_CompuMethods_Identical 0.0 5. FORMAT "%5.0" /end CHARACTERISTIC
/begin CHARACTERISTIC CanIf_CanIfTxPduCfg_ENGY_TXCanId_C "Calibration parameter for the CanId of CAN frame CanIfTxPduCfg_ENGY_TX" VALUE 0x804D8408 DefaultValueRecordLayout_AUTOSAR_Platform_BaseTypes_uint32 2047.0 RB_RBA_Common_CentralElements_CompuMethods_Identical 0.0 2047. FORMAT "%5.0" /end CHARACTERISTIC
/begin CHARACTERISTIC CanIf_CanIfTxPduCfg_ENGZ_TXCanDlc_C "Calibration parameter for the Data length of CAN frame CanIfTxPduCfg_ENGZ_TX" VALUE 0x804D8600 DefaultValueRecordLayout_AUTOSAR_Platform_BaseTypes_uint8 8.0 RB_RBA_Common_CentralElements_CompuMethods_Identical 0.0 8. FORMAT "%5.0" /end CHARACTERISTIC
/begin CHARACTERISTIC CanIf_CanIfTxPduCfg_ENGZ_TXCanId_C "Calibration parameter for the CanId of CAN frame CanIfTxPduCfg_ENGZ_TX" VALUE 0x804D8404 DefaultValueRecordLayout_AUTOSAR_Platform_BaseTypes_uint32 2047.0 RB_RBA_Common_CentralElements_CompuMethods_Identical 0.0 2047. FORMAT "%5.0" /end CHARACTERISTIC
/begin CHARACTERISTIC CanIf_CanIfTxPduCfg_eng1_TXCanDlc_C "Calibration parameter for the Data length of CAN frame CanIfTxPduCfg_eng1_TX" VALUE 0x804D85FF DefaultValueRecordLayout_AUTOSAR_Platform_BaseTypes_uint8 8.0 RB_RBA_Common_CentralElements_CompuMethods_Identical 0.0 8. FORMAT "%5.0" /end CHARACTERISTIC
/begin CHARACTERISTIC CanIf_CanIfTxPduCfg_eng1_TXCanId_C "Calibration parameter for the CanId of CAN frame CanIfTxPduCfg_eng1_TX" VALUE 0x804D8400 DefaultValueRecordLayout_AUTOSAR_Platform_BaseTypes_uint32 2047.0 RB_RBA_Common_CentralElements_CompuMethods_Identical 0.0 2047. FORMAT "%5.0" /end CHARACTERISTIC
/begin CHARACTERISTIC CanIf_CanIfTxPduCfg_engo_TXCanDlc_C "Calibration parameter for the Data length of CAN frame CanIfTxPduCfg_engo_TX" VALUE 0x804D85FE DefaultValueRecordLayout_AUTOSAR_Platform_BaseTypes_uint8 8.0 RB_RBA_Common_CentralElements_CompuMethods_Identical 0.0 8. FORMAT "%5.0" /end CHARACTERISTIC
/begin CHARACTERISTIC CanIf_CanIfTxPduCfg_engo_TXCanId_C "Calibration parameter for the CanId of CAN frame CanIfTxPduCfg_engo_TX" VALUE 0x804D83FC DefaultValueRecordLayout_AUTOSAR_Platform_BaseTypes_uint32 2047.0 RB_RBA_Common_CentralElements_CompuMethods_Identical 0.0 2047. FORMAT "%5.0" /end CHARACTERISTIC
/begin CHARACTERISTIC CanIf_OBD_ON_CAN_Rx_0x7DF_VEHICLECanDlc_C "Calibration parameter for the Data length of CAN frame OBD_ON_CAN_Rx_0x7DF_VEHICLE" VALUE 0x804D85FD DefaultValueRecordLayout_AUTOSAR_Platform_BaseTypes_uint8 1.0 RB_RBA_Common_CentralElements_CompuMethods_Identical 0.0 1. FORMAT "%5.0" /end CHARACTERISTIC
/begin CHARACTERISTIC CanIf_OBD_ON_CAN_Rx_0x7E0_VEHICLECanDlc_C "Calibration parameter for the Data length of CAN frame OBD_ON_CAN_Rx_0x7E0_VEHICLE" VALUE 0x804D85FC DefaultValueRecordLayout_AUTOSAR_Platform_BaseTypes_uint8 1.0 RB_RBA_Common_CentralElements_CompuMethods_Identical 0.0 1. FORMAT "%5.0" /end CHARACTERISTIC
/begin CHARACTERISTIC CanIf_T1_RXCanDlc_C "Calibration parameter for the Data length of CAN frame T1_RX" VALUE 0x804D85FB DefaultValueRecordLayout_AUTOSAR_Platform_BaseTypes_uint8 8.0 RB_RBA_Common_CentralElements_CompuMethods_Identical 0.0 8. FORMAT "%5.0" /end CHARACTERISTIC
/begin CHARACTERISTIC CanIf_T1_TXCanId_C "Calibration parameter for the CanId of CAN frame T1_TX" VALUE 0x804D83F8 DefaultValueRecordLayout_AUTOSAR_Platform_BaseTypes_uint32 2047.0 RB_RBA_Common_CentralElements_CompuMethods_Identical 0.0 2047. FORMAT "%5.0" /end CHARACTERISTIC
/begin CHARACTERISTIC CanIf_UDS_ON_CAN_Rx_0x18da10f1_VEHICLECanDlc_C "Calibration parameter for the Data length of CAN frame UDS_ON_CAN_Rx_0x18da10f1_VEHICLE" VALUE 0x804D85FA DefaultValueRecordLayout_AUTOSAR_Platform_BaseTypes_uint8 1.0 RB_RBA_Common_CentralElements_CompuMethods_Identical 0.0 1. FORMAT "%5.0" /end CHARACTERISTIC
/begin CHARACTERISTIC CanIf_UDS_ON_CAN_Rx_0x18da10f2_VEHICLECanDlc_C "Calibration parameter for the Data length of CAN frame UDS_ON_CAN_Rx_0x18da10f2_VEHICLE" VALUE 0x804D85F9 DefaultValueRecordLayout_AUTOSAR_Platform_BaseTypes_uint8 1.0 RB_RBA_Common_CentralElements_CompuMethods_Identical 0.0 1. FORMAT "%5.0" /end CHARACTERISTIC
/begin CHARACTERISTIC CanIf_UDS_ON_CAN_Rx_0x18db2ff1_VEHICLECanDlc_C "Calibration parameter for the Data length of CAN frame UDS_ON_CAN_Rx_0x18db2ff1_VEHICLE" VALUE 0x804D85F8 DefaultValueRecordLayout_AUTOSAR_Platform_BaseTypes_uint8 1.0 RB_RBA_Common_CentralElements_CompuMethods_Identical 0.0 1. FORMAT "%5.0" /end CHARACTERISTIC
/begin CHARACTERISTIC CanIf_UDS_ON_CAN_Rx_0x18db33f1_VEHICLECanDlc_C "Calibration parameter for the Data length of CAN frame UDS_ON_CAN_Rx_0x18db33f1_VEHICLE" VALUE 0x804D85F7 DefaultValueRecordLayout_AUTOSAR_Platform_BaseTypes_uint8 1.0 RB_RBA_Common_CentralElements_CompuMethods_Identical 0.0 1. FORMAT "%5.0" /end CHARACTERISTIC
/begin CHARACTERISTIC CanIf_UDS_ON_CAN_Rx_0x18dbeff1_VEHICLECanDlc_C "Calibration parameter for the Data length of CAN frame UDS_ON_CAN_Rx_0x18dbeff1_VEHICLE" VALUE 0x804D85F6 DefaultValueRecordLayout_AUTOSAR_Platform_BaseTypes_uint8 1.0 RB_RBA_Common_CentralElements_CompuMethods_Identical 0.0 1. FORMAT "%5.0" /end CHARACTERISTIC
/begin CHARACTERISTIC CanIf_UDS_ON_CAN_Tx_0x18daf110_VEHICLECanId_C "Calibration parameter for the CanId of CAN frame UDS_ON_CAN_Tx_0x18daf110_VEHICLE" VALUE 0x804D83F4 DefaultValueRecordLayout_AUTOSAR_Platform_BaseTypes_uint32 5.0E8 RB_RBA_Common_CentralElements_CompuMethods_Identical 0.0 5.E8 FORMAT "%5.0" /end CHARACTERISTIC
/begin CHARACTERISTIC CanIf_UDS_ON_CAN_Tx_0x18daf210_VEHICLECanId_C "Calibration parameter for the CanId of CAN frame UDS_ON_CAN_Tx_0x18daf210_VEHICLE" VALUE 0x804D83F0 DefaultValueRecordLayout_AUTOSAR_Platform_BaseTypes_uint32 5.0E8 RB_RBA_Common_CentralElements_CompuMethods_Identical 0.0 5.E8 FORMAT "%5.0" /end CHARACTERISTIC
/begin CHARACTERISTIC CanIf_UDS_ON_CAN_Tx_0x7E8_VEHICLECanId_C "Calibration parameter for the CanId of CAN frame UDS_ON_CAN_Tx_0x7E8_VEHICLE" VALUE 0x804D83EC DefaultValueRecordLayout_AUTOSAR_Platform_BaseTypes_uint32 2047.0 RB_RBA_Common_CentralElements_CompuMethods_Identical 0.0 2047. FORMAT "%5.0" /end CHARACTERISTIC
/begin CHARACTERISTIC CanIf_XcpRx_Cmd_APPLCanDlc_C "Calibration parameter for the Data length of CAN frame XcpRx_Cmd_APPL" VALUE 0x804D85F5 DefaultValueRecordLayout_AUTOSAR_Platform_BaseTypes_uint8 1.0 RB_RBA_Common_CentralElements_CompuMethods_Identical 0.0 1. FORMAT "%5.0" /end CHARACTERISTIC
/begin CHARACTERISTIC CanIf_XcpRx_Cmd_CAN_CCanDlc_C "Calibration parameter for the Data length of CAN frame XcpRx_Cmd_CAN_C" VALUE 0x804D85F4 DefaultValueRecordLayout_AUTOSAR_Platform_BaseTypes_uint8 1.0 RB_RBA_Common_CentralElements_CompuMethods_Identical 0.0 1. FORMAT "%5.0" /end CHARACTERISTIC
/begin CHARACTERISTIC CanIf_XcpRx_Cmd_VEHICLECanDlc_C "Calibration parameter for the Data length of CAN frame XcpRx_Cmd_VEHICLE" VALUE 0x804D85F3 DefaultValueRecordLayout_AUTOSAR_Platform_BaseTypes_uint8 1.0 RB_RBA_Common_CentralElements_CompuMethods_Identical 0.0 1. FORMAT "%5.0" /end CHARACTERISTIC
/begin CHARACTERISTIC CanIf_XcpTx_Var_APPLCanId_C "Calibration parameter for the CanId of CAN frame XcpTx_Var_APPL" VALUE 0x804D83E8 DefaultValueRecordLayout_AUTOSAR_Platform_BaseTypes_uint32 2047.0 RB_RBA_Common_CentralElements_CompuMethods_Identical 0.0 2047. FORMAT "%5.0" /end CHARACTERISTIC
/begin CHARACTERISTIC CanIf_XcpTx_Var_CAN_CCanId_C "Calibration parameter for the CanId of CAN frame XcpTx_Var_CAN_C" VALUE 0x804D83E4 DefaultValueRecordLayout_AUTOSAR_Platform_BaseTypes_uint32 2047.0 RB_RBA_Common_CentralElements_CompuMethods_Identical 0.0 2047. FORMAT "%5.0" /end CHARACTERISTIC
/begin CHARACTERISTIC CanIf_XcpTx_Var_VEHICLECanId_C "Calibration parameter for the CanId of CAN frame XcpTx_Var_VEHICLE" VALUE 0x804D83E0 DefaultValueRecordLayout_AUTOSAR_Platform_BaseTypes_uint32 2047.0 RB_RBA_Common_CentralElements_CompuMethods_Identical 0.0 2047. FORMAT "%5.0" /end CHARACTERISTIC
/*********** Start of merged MEASUREMENT blocks ***********/
/begin MEASUREMENT CanIf_Prv_ControllerState_ast[0].Ctrl_Pdu_mode "Can Interface controller State[0]/" UBYTE RB_RBA_Common_CentralElements_CompuMethods_Identical 1 100 0.0 255. FORMAT "%5.0" ECU_ADDRESS 0x60012CD0 /end MEASUREMENT
/begin MEASUREMENT CanIf_Prv_ControllerState_ast[1].Ctrl_Pdu_mode "Can Interface controller State[1]/" UBYTE RB_RBA_Common_CentralElements_CompuMethods_Identical 1 100 0.0 255. FORMAT "%5.0" ECU_ADDRESS 0x60012CD2 /end MEASUREMENT
/begin MEASUREMENT CanIf_Prv_ControllerState_ast[2].Ctrl_Pdu_mode "Can Interface controller State[2]/" UBYTE RB_RBA_Common_CentralElements_CompuMethods_Identical 1 100 0.0 255. FORMAT "%5.0" ECU_ADDRESS 0x60012CD4 /end MEASUREMENT
/begin MEASUREMENT CanIf_Prv_InitStatus_b "Flag to check if CANIF is Initialized(TRUE) or Not Initialized (FALSE)" UBYTE RB_RBA_Common_CentralElements_CompuMethods_Identical 1 100 0.0 1. FORMAT "%5.0" ECU_ADDRESS 0x60012CD6 /end MEASUREMENT
/begin MEASUREMENT CanIf_Prv_TxBufferRam_ast[0].last_index "Can Interface Buffer Status[0]/" UBYTE RB_RBA_Common_CentralElements_CompuMethods_Identical 1 100 0.0 255. FORMAT "%5.0" ECU_ADDRESS 0x700054C8 /end MEASUREMENT
/begin MEASUREMENT CanIf_Prv_TxBufferRam_ast[1].last_index "Can Interface Buffer Status[1]/" UBYTE RB_RBA_Common_CentralElements_CompuMethods_Identical 1 100 0.0 255. FORMAT "%5.0" ECU_ADDRESS 0x700054CA /end MEASUREMENT
/begin MEASUREMENT CanIf_Prv_TxBufferRam_ast[2].last_index "Can Interface Buffer Status[2]/" UBYTE RB_RBA_Common_CentralElements_CompuMethods_Identical 1 100 0.0 255. FORMAT "%5.0" ECU_ADDRESS 0x700054CC /end MEASUREMENT
/begin MEASUREMENT CanIf_Prv_TxBufferRam_ast[3].last_index "Can Interface Buffer Status[3]/" UBYTE RB_RBA_Common_CentralElements_CompuMethods_Identical 1 100 0.0 255. FORMAT "%5.0" ECU_ADDRESS 0x700054CE /end MEASUREMENT
/begin MEASUREMENT CanIf_Prv_TxBufferRam_ast[4].last_index "Can Interface Buffer Status[4]/" UBYTE RB_RBA_Common_CentralElements_CompuMethods_Identical 1 100 0.0 255. FORMAT "%5.0" ECU_ADDRESS 0x700054D0 /end MEASUREMENT
/begin MEASUREMENT CanIf_Prv_TxBufferRam_ast[5].last_index "Can Interface Buffer Status[5]/" UBYTE RB_RBA_Common_CentralElements_CompuMethods_Identical 1 100 0.0 255. FORMAT "%5.0" ECU_ADDRESS 0x700054D2 /end MEASUREMENT
/begin MEASUREMENT CanIf_Prv_TxBufferRam_ast[6].last_index "Can Interface Buffer Status[6]/" UBYTE RB_RBA_Common_CentralElements_CompuMethods_Identical 1 100 0.0 255. FORMAT "%5.0" ECU_ADDRESS 0x700054D4 /end MEASUREMENT
/begin MEASUREMENT CanIf_Prv_TxBufferRam_ast[7].last_index "Can Interface Buffer Status[7]/" UBYTE RB_RBA_Common_CentralElements_CompuMethods_Identical 1 100 0.0 255. FORMAT "%5.0" ECU_ADDRESS 0x700054D6 /end MEASUREMENT
/begin MEASUREMENT CanIf_Prv_TxBufferRam_ast[8].last_index "Can Interface Buffer Status[8]/" UBYTE RB_RBA_Common_CentralElements_CompuMethods_Identical 1 100 0.0 255. FORMAT "%5.0" ECU_ADDRESS 0x700054D8 /end MEASUREMENT
/begin MEASUREMENT CanIf_Prv_TxBufferRam_ast[9].last_index "Can Interface Buffer Status[9]/" UBYTE RB_RBA_Common_CentralElements_CompuMethods_Identical 1 100 0.0 255. FORMAT "%5.0" ECU_ADDRESS 0x700054DA /end MEASUREMENT
/begin MEASUREMENT CanIf_Prv_TxBufferRam_ast[10].last_index "Can Interface Buffer Status[10]/" UBYTE RB_RBA_Common_CentralElements_CompuMethods_Identical 1 100 0.0 255. FORMAT "%5.0" ECU_ADDRESS 0x700054DC /end MEASUREMENT
/begin MEASUREMENT CanIf_Prv_TxBufferRam_ast[11].last_index "Can Interface Buffer Status[11]/" UBYTE RB_RBA_Common_CentralElements_CompuMethods_Identical 1 100 0.0 255. FORMAT "%5.0" ECU_ADDRESS 0x700054DE /end MEASUREMENT
/begin MEASUREMENT CanIf_Prv_TxBufferRam_ast[12].last_index "Can Interface Buffer Status[12]/" UBYTE RB_RBA_Common_CentralElements_CompuMethods_Identical 1 100 0.0 255. FORMAT "%5.0" ECU_ADDRESS 0x700054E0 /end MEASUREMENT
/begin MEASUREMENT CanIf_Prv_TxBufferRam_ast[13].last_index "Can Interface Buffer Status[13]/" UBYTE RB_RBA_Common_CentralElements_CompuMethods_Identical 1 100 0.0 255. FORMAT "%5.0" ECU_ADDRESS 0x700054E2 /end MEASUREMENT
/begin MEASUREMENT CanIf_Prv_TxBufferRam_ast[14].last_index "Can Interface Buffer Status[14]/" UBYTE RB_RBA_Common_CentralElements_CompuMethods_Identical 1 100 0.0 255. FORMAT "%5.0" ECU_ADDRESS 0x700054E4 /end MEASUREMENT
/begin MEASUREMENT CanIf_Prv_TxBufferRam_ast[15].last_index "Can Interface Buffer Status[15]/" UBYTE RB_RBA_Common_CentralElements_CompuMethods_Identical 1 100 0.0 255. FORMAT "%5.0" ECU_ADDRESS 0x700054E6 /end MEASUREMENT
/begin MEASUREMENT CanIf_Prv_TxBufferRam_ast[16].last_index "Can Interface Buffer Status[16]/" UBYTE RB_RBA_Common_CentralElements_CompuMethods_Identical 1 100 0.0 255. FORMAT "%5.0" ECU_ADDRESS 0x700054E8 /end MEASUREMENT
/begin MEASUREMENT CanIf_Prv_TxBufferRam_ast[17].last_index "Can Interface Buffer Status[17]/" UBYTE RB_RBA_Common_CentralElements_CompuMethods_Identical 1 100 0.0 255. FORMAT "%5.0" ECU_ADDRESS 0x700054EA /end MEASUREMENT
/begin MEASUREMENT CanIf_Prv_TxBufferRam_ast[18].last_index "Can Interface Buffer Status[18]/" UBYTE RB_RBA_Common_CentralElements_CompuMethods_Identical 1 100 0.0 255. FORMAT "%5.0" ECU_ADDRESS 0x700054EC /end MEASUREMENT
/begin MEASUREMENT CanIf_Prv_TxBufferRam_ast[19].last_index "Can Interface Buffer Status[19]/" UBYTE RB_RBA_Common_CentralElements_CompuMethods_Identical 1 100 0.0 255. FORMAT "%5.0" ECU_ADDRESS 0x700054EE /end MEASUREMENT
/begin MEASUREMENT CanIf_Prv_TxBufferRam_ast[20].last_index "Can Interface Buffer Status[20]/" UBYTE RB_RBA_Common_CentralElements_CompuMethods_Identical 1 100 0.0 255. FORMAT "%5.0" ECU_ADDRESS 0x700054F0 /end MEASUREMENT
/begin MEASUREMENT CanIf_Prv_TxBufferRam_ast[21].last_index "Can Interface Buffer Status[21]/" UBYTE RB_RBA_Common_CentralElements_CompuMethods_Identical 1 100 0.0 255. FORMAT "%5.0" ECU_ADDRESS 0x700054F2 /end MEASUREMENT
/begin MEASUREMENT CanIf_Prv_TxBufferRam_ast[22].last_index "Can Interface Buffer Status[22]/" UBYTE RB_RBA_Common_CentralElements_CompuMethods_Identical 1 100 0.0 255. FORMAT "%5.0" ECU_ADDRESS 0x700054F4 /end MEASUREMENT
/begin MEASUREMENT CanIf_Prv_TxBufferRam_ast[23].last_index "Can Interface Buffer Status[23]/" UBYTE RB_RBA_Common_CentralElements_CompuMethods_Identical 1 100 0.0 255. FORMAT "%5.0" ECU_ADDRESS 0x700054F6 /end MEASUREMENT
/begin MEASUREMENT CanIf_Prv_TxBufferRam_ast[24].last_index "Can Interface Buffer Status[24]/" UBYTE RB_RBA_Common_CentralElements_CompuMethods_Identical 1 100 0.0 255. FORMAT "%5.0" ECU_ADDRESS 0x700054F8 /end MEASUREMENT
/begin MEASUREMENT CanIf_Prv_TxBufferRam_ast[25].last_index "Can Interface Buffer Status[25]/" UBYTE RB_RBA_Common_CentralElements_CompuMethods_Identical 1 100 0.0 255. FORMAT "%5.0" ECU_ADDRESS 0x700054FA /end MEASUREMENT
/begin MEASUREMENT CanIf_Prv_TxBufferRam_ast[26].last_index "Can Interface Buffer Status[26]/" UBYTE RB_RBA_Common_CentralElements_CompuMethods_Identical 1 100 0.0 255. FORMAT "%5.0" ECU_ADDRESS 0x700054FC /end MEASUREMENT
/begin MEASUREMENT CanIf_Prv_TxBufferRam_ast[27].last_index "Can Interface Buffer Status[27]/" UBYTE RB_RBA_Common_CentralElements_CompuMethods_Identical 1 100 0.0 255. FORMAT "%5.0" ECU_ADDRESS 0x700054FE /end MEASUREMENT
/begin MEASUREMENT CanIf_Prv_TxBufferRam_ast[28].last_index "Can Interface Buffer Status[28]/" UBYTE RB_RBA_Common_CentralElements_CompuMethods_Identical 1 100 0.0 255. FORMAT "%5.0" ECU_ADDRESS 0x70005500 /end MEASUREMENT
/begin MEASUREMENT CanIf_Prv_TxBufferRam_ast[29].last_index "Can Interface Buffer Status[29]/" UBYTE RB_RBA_Common_CentralElements_CompuMethods_Identical 1 100 0.0 255. FORMAT "%5.0" ECU_ADDRESS 0x70005502 /end MEASUREMENT
/begin MEASUREMENT CanIf_Prv_TxBufferRam_ast[30].last_index "Can Interface Buffer Status[30]/" UBYTE RB_RBA_Common_CentralElements_CompuMethods_Identical 1 100 0.0 255. FORMAT "%5.0" ECU_ADDRESS 0x70005504 /end MEASUREMENT
/begin MEASUREMENT CanIf_Prv_TxBufferRam_ast[31].last_index "Can Interface Buffer Status[31]/" UBYTE RB_RBA_Common_CentralElements_CompuMethods_Identical 1 100 0.0 255. FORMAT "%5.0" ECU_ADDRESS 0x70005506 /end MEASUREMENT
/begin MEASUREMENT CanIf_Prv_TxBufferRam_ast[32].last_index "Can Interface Buffer Status[32]/" UBYTE RB_RBA_Common_CentralElements_CompuMethods_Identical 1 100 0.0 255. FORMAT "%5.0" ECU_ADDRESS 0x70005508 /end MEASUREMENT
/begin MEASUREMENT CanIf_Prv_TxBufferRam_ast[33].last_index "Can Interface Buffer Status[33]/" UBYTE RB_RBA_Common_CentralElements_CompuMethods_Identical 1 100 0.0 255. FORMAT "%5.0" ECU_ADDRESS 0x7000550A /end MEASUREMENT
/begin MEASUREMENT CanIf_Prv_TxBufferRam_ast[34].last_index "Can Interface Buffer Status[34]/" UBYTE RB_RBA_Common_CentralElements_CompuMethods_Identical 1 100 0.0 255. FORMAT "%5.0" ECU_ADDRESS 0x7000550C /end MEASUREMENT
/begin MEASUREMENT CanIf_Prv_TxBufferRam_ast[35].last_index "Can Interface Buffer Status[35]/" UBYTE RB_RBA_Common_CentralElements_CompuMethods_Identical 1 100 0.0 255. FORMAT "%5.0" ECU_ADDRESS 0x7000550E /end MEASUREMENT
/begin MEASUREMENT CanIf_Prv_TxBufferRam_ast[36].last_index "Can Interface Buffer Status[36]/" UBYTE RB_RBA_Common_CentralElements_CompuMethods_Identical 1 100 0.0 255. FORMAT "%5.0" ECU_ADDRESS 0x70005510 /end MEASUREMENT
/begin MEASUREMENT CanIf_Prv_TxBufferRam_ast[37].last_index "Can Interface Buffer Status[37]/" UBYTE RB_RBA_Common_CentralElements_CompuMethods_Identical 1 100 0.0 255. FORMAT "%5.0" ECU_ADDRESS 0x70005512 /end MEASUREMENT
/begin MEASUREMENT CanIf_Prv_TxBufferRam_ast[38].last_index "Can Interface Buffer Status[38]/" UBYTE RB_RBA_Common_CentralElements_CompuMethods_Identical 1 100 0.0 255. FORMAT "%5.0" ECU_ADDRESS 0x70005514 /end MEASUREMENT
/begin MEASUREMENT CanIf_Prv_TxBufferRam_ast[39].last_index "Can Interface Buffer Status[39]/" UBYTE RB_RBA_Common_CentralElements_CompuMethods_Identical 1 100 0.0 255. FORMAT "%5.0" ECU_ADDRESS 0x70005516 /end MEASUREMENT
/begin MEASUREMENT CanIf_Prv_TxBufferRam_ast[40].last_index "Can Interface Buffer Status[40]/" UBYTE RB_RBA_Common_CentralElements_CompuMethods_Identical 1 100 0.0 255. FORMAT "%5.0" ECU_ADDRESS 0x70005518 /end MEASUREMENT
/begin MEASUREMENT CanIf_Prv_TxBufferRam_ast[41].last_index "Can Interface Buffer Status[41]/" UBYTE RB_RBA_Common_CentralElements_CompuMethods_Identical 1 100 0.0 255. FORMAT "%5.0" ECU_ADDRESS 0x7000551A /end MEASUREMENT
/begin MEASUREMENT CanIf_Prv_TxBufferRam_ast[42].last_index "Can Interface Buffer Status[42]/" UBYTE RB_RBA_Common_CentralElements_CompuMethods_Identical 1 100 0.0 255. FORMAT "%5.0" ECU_ADDRESS 0x7000551C /end MEASUREMENT
/begin MEASUREMENT CanIf_Prv_TxBufferRam_ast[43].last_index "Can Interface Buffer Status[43]/" UBYTE RB_RBA_Common_CentralElements_CompuMethods_Identical 1 100 0.0 255. FORMAT "%5.0" ECU_ADDRESS 0x7000551E /end MEASUREMENT
/begin MEASUREMENT CanIf_Prv_TxBufferRam_ast[44].last_index "Can Interface Buffer Status[44]/" UBYTE RB_RBA_Common_CentralElements_CompuMethods_Identical 1 100 0.0 255. FORMAT "%5.0" ECU_ADDRESS 0x70005520 /end MEASUREMENT
/begin MEASUREMENT CanIf_Prv_TxBufferRam_ast[45].last_index "Can Interface Buffer Status[45]/" UBYTE RB_RBA_Common_CentralElements_CompuMethods_Identical 1 100 0.0 255. FORMAT "%5.0" ECU_ADDRESS 0x70005522 /end MEASUREMENT
/begin MEASUREMENT CanIf_Prv_TxBufferRam_ast[46].last_index "Can Interface Buffer Status[46]/" UBYTE RB_RBA_Common_CentralElements_CompuMethods_Identical 1 100 0.0 255. FORMAT "%5.0" ECU_ADDRESS 0x70005524 /end MEASUREMENT
/begin MEASUREMENT CanIf_Prv_TxBufferRam_ast[47].last_index "Can Interface Buffer Status[47]/" UBYTE RB_RBA_Common_CentralElements_CompuMethods_Identical 1 100 0.0 255. FORMAT "%5.0" ECU_ADDRESS 0x70005526 /end MEASUREMENT
/begin MEASUREMENT CanIf_Prv_TxBufferRam_ast[48].last_index "Can Interface Buffer Status[48]/" UBYTE RB_RBA_Common_CentralElements_CompuMethods_Identical 1 100 0.0 255. FORMAT "%5.0" ECU_ADDRESS 0x70005528 /end MEASUREMENT
/begin MEASUREMENT CanIf_Prv_TxBufferRam_ast[0].bufferstatus "Can Interface Buffer Status[0]/" UBYTE RB_RBA_Common_CentralElements_CompuMethods_Identical 1 100 0.0 255. FORMAT "%5.0" ECU_ADDRESS 0x700054C9 /end MEASUREMENT
/begin MEASUREMENT CanIf_Prv_TxBufferRam_ast[1].bufferstatus "Can Interface Buffer Status[1]/" UBYTE RB_RBA_Common_CentralElements_CompuMethods_Identical 1 100 0.0 255. FORMAT "%5.0" ECU_ADDRESS 0x700054CB /end MEASUREMENT
/begin MEASUREMENT CanIf_Prv_TxBufferRam_ast[2].bufferstatus "Can Interface Buffer Status[2]/" UBYTE RB_RBA_Common_CentralElements_CompuMethods_Identical 1 100 0.0 255. FORMAT "%5.0" ECU_ADDRESS 0x700054CD /end MEASUREMENT
/begin MEASUREMENT CanIf_Prv_TxBufferRam_ast[3].bufferstatus "Can Interface Buffer Status[3]/" UBYTE RB_RBA_Common_CentralElements_CompuMethods_Identical 1 100 0.0 255. FORMAT "%5.0" ECU_ADDRESS 0x700054CF /end MEASUREMENT
/begin MEASUREMENT CanIf_Prv_TxBufferRam_ast[4].bufferstatus "Can Interface Buffer Status[4]/" UBYTE RB_RBA_Common_CentralElements_CompuMethods_Identical 1 100 0.0 255. FORMAT "%5.0" ECU_ADDRESS 0x700054D1 /end MEASUREMENT
/begin MEASUREMENT CanIf_Prv_TxBufferRam_ast[5].bufferstatus "Can Interface Buffer Status[5]/" UBYTE RB_RBA_Common_CentralElements_CompuMethods_Identical 1 100 0.0 255. FORMAT "%5.0" ECU_ADDRESS 0x700054D3 /end MEASUREMENT
/begin MEASUREMENT CanIf_Prv_TxBufferRam_ast[6].bufferstatus "Can Interface Buffer Status[6]/" UBYTE RB_RBA_Common_CentralElements_CompuMethods_Identical 1 100 0.0 255. FORMAT "%5.0" ECU_ADDRESS 0x700054D5 /end MEASUREMENT
/begin MEASUREMENT CanIf_Prv_TxBufferRam_ast[7].bufferstatus "Can Interface Buffer Status[7]/" UBYTE RB_RBA_Common_CentralElements_CompuMethods_Identical 1 100 0.0 255. FORMAT "%5.0" ECU_ADDRESS 0x700054D7 /end MEASUREMENT
/begin MEASUREMENT CanIf_Prv_TxBufferRam_ast[8].bufferstatus "Can Interface Buffer Status[8]/" UBYTE RB_RBA_Common_CentralElements_CompuMethods_Identical 1 100 0.0 255. FORMAT "%5.0" ECU_ADDRESS 0x700054D9 /end MEASUREMENT
/begin MEASUREMENT CanIf_Prv_TxBufferRam_ast[9].bufferstatus "Can Interface Buffer Status[9]/" UBYTE RB_RBA_Common_CentralElements_CompuMethods_Identical 1 100 0.0 255. FORMAT "%5.0" ECU_ADDRESS 0x700054DB /end MEASUREMENT
/begin MEASUREMENT CanIf_Prv_TxBufferRam_ast[10].bufferstatus "Can Interface Buffer Status[10]/" UBYTE RB_RBA_Common_CentralElements_CompuMethods_Identical 1 100 0.0 255. FORMAT "%5.0" ECU_ADDRESS 0x700054DD /end MEASUREMENT
/begin MEASUREMENT CanIf_Prv_TxBufferRam_ast[11].bufferstatus "Can Interface Buffer Status[11]/" UBYTE RB_RBA_Common_CentralElements_CompuMethods_Identical 1 100 0.0 255. FORMAT "%5.0" ECU_ADDRESS 0x700054DF /end MEASUREMENT
/begin MEASUREMENT CanIf_Prv_TxBufferRam_ast[12].bufferstatus "Can Interface Buffer Status[12]/" UBYTE RB_RBA_Common_CentralElements_CompuMethods_Identical 1 100 0.0 255. FORMAT "%5.0" ECU_ADDRESS 0x700054E1 /end MEASUREMENT
/begin MEASUREMENT CanIf_Prv_TxBufferRam_ast[13].bufferstatus "Can Interface Buffer Status[13]/" UBYTE RB_RBA_Common_CentralElements_CompuMethods_Identical 1 100 0.0 255. FORMAT "%5.0" ECU_ADDRESS 0x700054E3 /end MEASUREMENT
/begin MEASUREMENT CanIf_Prv_TxBufferRam_ast[14].bufferstatus "Can Interface Buffer Status[14]/" UBYTE RB_RBA_Common_CentralElements_CompuMethods_Identical 1 100 0.0 255. FORMAT "%5.0" ECU_ADDRESS 0x700054E5 /end MEASUREMENT
/begin MEASUREMENT CanIf_Prv_TxBufferRam_ast[15].bufferstatus "Can Interface Buffer Status[15]/" UBYTE RB_RBA_Common_CentralElements_CompuMethods_Identical 1 100 0.0 255. FORMAT "%5.0" ECU_ADDRESS 0x700054E7 /end MEASUREMENT
/begin MEASUREMENT CanIf_Prv_TxBufferRam_ast[16].bufferstatus "Can Interface Buffer Status[16]/" UBYTE RB_RBA_Common_CentralElements_CompuMethods_Identical 1 100 0.0 255. FORMAT "%5.0" ECU_ADDRESS 0x700054E9 /end MEASUREMENT
/begin MEASUREMENT CanIf_Prv_TxBufferRam_ast[17].bufferstatus "Can Interface Buffer Status[17]/" UBYTE RB_RBA_Common_CentralElements_CompuMethods_Identical 1 100 0.0 255. FORMAT "%5.0" ECU_ADDRESS 0x700054EB /end MEASUREMENT
/begin MEASUREMENT CanIf_Prv_TxBufferRam_ast[18].bufferstatus "Can Interface Buffer Status[18]/" UBYTE RB_RBA_Common_CentralElements_CompuMethods_Identical 1 100 0.0 255. FORMAT "%5.0" ECU_ADDRESS 0x700054ED /end MEASUREMENT
/begin MEASUREMENT CanIf_Prv_TxBufferRam_ast[19].bufferstatus "Can Interface Buffer Status[19]/" UBYTE RB_RBA_Common_CentralElements_CompuMethods_Identical 1 100 0.0 255. FORMAT "%5.0" ECU_ADDRESS 0x700054EF /end MEASUREMENT
/begin MEASUREMENT CanIf_Prv_TxBufferRam_ast[20].bufferstatus "Can Interface Buffer Status[20]/" UBYTE RB_RBA_Common_CentralElements_CompuMethods_Identical 1 100 0.0 255. FORMAT "%5.0" ECU_ADDRESS 0x700054F1 /end MEASUREMENT
/begin MEASUREMENT CanIf_Prv_TxBufferRam_ast[21].bufferstatus "Can Interface Buffer Status[21]/" UBYTE RB_RBA_Common_CentralElements_CompuMethods_Identical 1 100 0.0 255. FORMAT "%5.0" ECU_ADDRESS 0x700054F3 /end MEASUREMENT
/begin MEASUREMENT CanIf_Prv_TxBufferRam_ast[22].bufferstatus "Can Interface Buffer Status[22]/" UBYTE RB_RBA_Common_CentralElements_CompuMethods_Identical 1 100 0.0 255. FORMAT "%5.0" ECU_ADDRESS 0x700054F5 /end MEASUREMENT
/begin MEASUREMENT CanIf_Prv_TxBufferRam_ast[23].bufferstatus "Can Interface Buffer Status[23]/" UBYTE RB_RBA_Common_CentralElements_CompuMethods_Identical 1 100 0.0 255. FORMAT "%5.0" ECU_ADDRESS 0x700054F7 /end MEASUREMENT
/begin MEASUREMENT CanIf_Prv_TxBufferRam_ast[24].bufferstatus "Can Interface Buffer Status[24]/" UBYTE RB_RBA_Common_CentralElements_CompuMethods_Identical 1 100 0.0 255. FORMAT "%5.0" ECU_ADDRESS 0x700054F9 /end MEASUREMENT
/begin MEASUREMENT CanIf_Prv_TxBufferRam_ast[25].bufferstatus "Can Interface Buffer Status[25]/" UBYTE RB_RBA_Common_CentralElements_CompuMethods_Identical 1 100 0.0 255. FORMAT "%5.0" ECU_ADDRESS 0x700054FB /end MEASUREMENT
/begin MEASUREMENT CanIf_Prv_TxBufferRam_ast[26].bufferstatus "Can Interface Buffer Status[26]/" UBYTE RB_RBA_Common_CentralElements_CompuMethods_Identical 1 100 0.0 255. FORMAT "%5.0" ECU_ADDRESS 0x700054FD /end MEASUREMENT
/begin MEASUREMENT CanIf_Prv_TxBufferRam_ast[27].bufferstatus "Can Interface Buffer Status[27]/" UBYTE RB_RBA_Common_CentralElements_CompuMethods_Identical 1 100 0.0 255. FORMAT "%5.0" ECU_ADDRESS 0x700054FF /end MEASUREMENT
/begin MEASUREMENT CanIf_Prv_TxBufferRam_ast[28].bufferstatus "Can Interface Buffer Status[28]/" UBYTE RB_RBA_Common_CentralElements_CompuMethods_Identical 1 100 0.0 255. FORMAT "%5.0" ECU_ADDRESS 0x70005501 /end MEASUREMENT
/begin MEASUREMENT CanIf_Prv_TxBufferRam_ast[29].bufferstatus "Can Interface Buffer Status[29]/" UBYTE RB_RBA_Common_CentralElements_CompuMethods_Identical 1 100 0.0 255. FORMAT "%5.0" ECU_ADDRESS 0x70005503 /end MEASUREMENT
/begin MEASUREMENT CanIf_Prv_TxBufferRam_ast[30].bufferstatus "Can Interface Buffer Status[30]/" UBYTE RB_RBA_Common_CentralElements_CompuMethods_Identical 1 100 0.0 255. FORMAT "%5.0" ECU_ADDRESS 0x70005505 /end MEASUREMENT
/begin MEASUREMENT CanIf_Prv_TxBufferRam_ast[31].bufferstatus "Can Interface Buffer Status[31]/" UBYTE RB_RBA_Common_CentralElements_CompuMethods_Identical 1 100 0.0 255. FORMAT "%5.0" ECU_ADDRESS 0x70005507 /end MEASUREMENT
/begin MEASUREMENT CanIf_Prv_TxBufferRam_ast[32].bufferstatus "Can Interface Buffer Status[32]/" UBYTE RB_RBA_Common_CentralElements_CompuMethods_Identical 1 100 0.0 255. FORMAT "%5.0" ECU_ADDRESS 0x70005509 /end MEASUREMENT
/begin MEASUREMENT CanIf_Prv_TxBufferRam_ast[33].bufferstatus "Can Interface Buffer Status[33]/" UBYTE RB_RBA_Common_CentralElements_CompuMethods_Identical 1 100 0.0 255. FORMAT "%5.0" ECU_ADDRESS 0x7000550B /end MEASUREMENT
/begin MEASUREMENT CanIf_Prv_TxBufferRam_ast[34].bufferstatus "Can Interface Buffer Status[34]/" UBYTE RB_RBA_Common_CentralElements_CompuMethods_Identical 1 100 0.0 255. FORMAT "%5.0" ECU_ADDRESS 0x7000550D /end MEASUREMENT
/begin MEASUREMENT CanIf_Prv_TxBufferRam_ast[35].bufferstatus "Can Interface Buffer Status[35]/" UBYTE RB_RBA_Common_CentralElements_CompuMethods_Identical 1 100 0.0 255. FORMAT "%5.0" ECU_ADDRESS 0x7000550F /end MEASUREMENT
/begin MEASUREMENT CanIf_Prv_TxBufferRam_ast[36].bufferstatus "Can Interface Buffer Status[36]/" UBYTE RB_RBA_Common_CentralElements_CompuMethods_Identical 1 100 0.0 255. FORMAT "%5.0" ECU_ADDRESS 0x70005511 /end MEASUREMENT
/begin MEASUREMENT CanIf_Prv_TxBufferRam_ast[37].bufferstatus "Can Interface Buffer Status[37]/" UBYTE RB_RBA_Common_CentralElements_CompuMethods_Identical 1 100 0.0 255. FORMAT "%5.0" ECU_ADDRESS 0x70005513 /end MEASUREMENT
/begin MEASUREMENT CanIf_Prv_TxBufferRam_ast[38].bufferstatus "Can Interface Buffer Status[38]/" UBYTE RB_RBA_Common_CentralElements_CompuMethods_Identical 1 100 0.0 255. FORMAT "%5.0" ECU_ADDRESS 0x70005515 /end MEASUREMENT
/begin MEASUREMENT CanIf_Prv_TxBufferRam_ast[39].bufferstatus "Can Interface Buffer Status[39]/" UBYTE RB_RBA_Common_CentralElements_CompuMethods_Identical 1 100 0.0 255. FORMAT "%5.0" ECU_ADDRESS 0x70005517 /end MEASUREMENT
/begin MEASUREMENT CanIf_Prv_TxBufferRam_ast[40].bufferstatus "Can Interface Buffer Status[40]/" UBYTE RB_RBA_Common_CentralElements_CompuMethods_Identical 1 100 0.0 255. FORMAT "%5.0" ECU_ADDRESS 0x70005519 /end MEASUREMENT
/begin MEASUREMENT CanIf_Prv_TxBufferRam_ast[41].bufferstatus "Can Interface Buffer Status[41]/" UBYTE RB_RBA_Common_CentralElements_CompuMethods_Identical 1 100 0.0 255. FORMAT "%5.0" ECU_ADDRESS 0x7000551B /end MEASUREMENT
/begin MEASUREMENT CanIf_Prv_TxBufferRam_ast[42].bufferstatus "Can Interface Buffer Status[42]/" UBYTE RB_RBA_Common_CentralElements_CompuMethods_Identical 1 100 0.0 255. FORMAT "%5.0" ECU_ADDRESS 0x7000551D /end MEASUREMENT
/begin MEASUREMENT CanIf_Prv_TxBufferRam_ast[43].bufferstatus "Can Interface Buffer Status[43]/" UBYTE RB_RBA_Common_CentralElements_CompuMethods_Identical 1 100 0.0 255. FORMAT "%5.0" ECU_ADDRESS 0x7000551F /end MEASUREMENT
/begin MEASUREMENT CanIf_Prv_TxBufferRam_ast[44].bufferstatus "Can Interface Buffer Status[44]/" UBYTE RB_RBA_Common_CentralElements_CompuMethods_Identical 1 100 0.0 255. FORMAT "%5.0" ECU_ADDRESS 0x70005521 /end MEASUREMENT
/begin MEASUREMENT CanIf_Prv_TxBufferRam_ast[45].bufferstatus "Can Interface Buffer Status[45]/" UBYTE RB_RBA_Common_CentralElements_CompuMethods_Identical 1 100 0.0 255. FORMAT "%5.0" ECU_ADDRESS 0x70005523 /end MEASUREMENT
/begin MEASUREMENT CanIf_Prv_TxBufferRam_ast[46].bufferstatus "Can Interface Buffer Status[46]/" UBYTE RB_RBA_Common_CentralElements_CompuMethods_Identical 1 100 0.0 255. FORMAT "%5.0" ECU_ADDRESS 0x70005525 /end MEASUREMENT
/begin MEASUREMENT CanIf_Prv_TxBufferRam_ast[47].bufferstatus "Can Interface Buffer Status[47]/" UBYTE RB_RBA_Common_CentralElements_CompuMethods_Identical 1 100 0.0 255. FORMAT "%5.0" ECU_ADDRESS 0x70005527 /end MEASUREMENT
/begin MEASUREMENT CanIf_Prv_TxBufferRam_ast[48].bufferstatus "Can Interface Buffer Status[48]/" UBYTE RB_RBA_Common_CentralElements_CompuMethods_Identical 1 100 0.0 255. FORMAT "%5.0" ECU_ADDRESS 0x70005529 /end MEASUREMENT
/*********** Start of merged FUNCTION blocks ***********/
/begin FUNCTION CanIf "15.16.4  McFunction CanIf Created by MCFunctionUpdater"
 /begin DEF_CHARACTERISTIC CanIf_CanIfRxPduCfg_EAT10_RXCanDlc_C CanIf_CanIfRxPduCfg_EAT11_RXCanDlc_C CanIf_CanIfRxPduCfg_EAT12_RXCanDlc_C CanIf_CanIfRxPduCfg_EAT13_RXCanDlc_C CanIf_CanIfRxPduCfg_EAT4_RXCanDlc_C CanIf_CanIfRxPduCfg_EAT6_RXCanDlc_C CanIf_CanIfRxPduCfg_EAT7_RXCanDlc_C CanIf_CanIfRxPduCfg_EAT8_RXCanDlc_C CanIf_CanIfRxPduCfg_EATA_RXCanDlc_C CanIf_CanIfRxPduCfg_EATB_RXCanDlc_C CanIf_CanIfRxPduCfg_EATC_RXCanDlc_C CanIf_CanIfRxPduCfg_EPB2_RXCanDlc_C CanIf_CanIfRxPduCfg_EPBB_RXCanDlc_C CanIf_CanIfRxPduCfg_EPS1_RXCanDlc_C CanIf_CanIfRxPduCfg_META_RXCanDlc_C CanIf_CanIfRxPduCfg_METD2_RXCanDlc_C CanIf_CanIfRxPduCfg_METD_RXCanDlc_C CanIf_CanIfRxPduCfg_METF_RXCanDlc_C CanIf_CanIfRxPduCfg_METG2_RXCanDlc_C CanIf_CanIfRxPduCfg_METG_RXCanDlc_C CanIf_CanIfRxPduCfg_METH2_RXCanDlc_C CanIf_CanIfRxPduCfg_METH_RXCanDlc_C CanIf_CanIfRxPduCfg_METI_RXCanDlc_C CanIf_CanIfRxPduCfg_METK_RXCanDlc_C CanIf_CanIfRxPduCfg_METL_RXCanDlc_C CanIf_CanIfRxPduCfg_METM_RXCanDlc_C CanIf_CanIfRxPduCfg_METN_RXCanDlc_C CanIf_CanIfRxPduCfg_PCU_RXCanDlc_C CanIf_CanIfRxPduCfg_SRSB_RXCanDlc_C CanIf_CanIfTxPduCfg_ENG10_TXCanDlc_C CanIf_CanIfTxPduCfg_ENG10_TXCanId_C CanIf_CanIfTxPduCfg_ENG11_TXCanDlc_C CanIf_CanIfTxPduCfg_ENG11_TXCanId_C CanIf_CanIfTxPduCfg_ENG15_TXCanDlc_C CanIf_CanIfTxPduCfg_ENG15_TXCanId_C CanIf_CanIfTxPduCfg_ENG16_TXCanDlc_C CanIf_CanIfTxPduCfg_ENG16_TXCanId_C CanIf_CanIfTxPduCfg_ENG17_TXCanDlc_C CanIf_CanIfTxPduCfg_ENG17_TXCanId_C CanIf_CanIfTxPduCfg_ENG18_TXCanDlc_C CanIf_CanIfTxPduCfg_ENG18_TXCanId_C CanIf_CanIfTxPduCfg_ENG19_TXCanDlc_C CanIf_CanIfTxPduCfg_ENG19_TXCanId_C CanIf_CanIfTxPduCfg_ENG20_TXCanDlc_C CanIf_CanIfTxPduCfg_ENG20_TXCanId_C CanIf_CanIfTxPduCfg_ENG21_TXCanDlc_C CanIf_CanIfTxPduCfg_ENG21_TXCanId_C CanIf_CanIfTxPduCfg_ENG22_TXCanDlc_C CanIf_CanIfTxPduCfg_ENG22_TXCanId_C CanIf_CanIfTxPduCfg_ENG23_TXCanDlc_C CanIf_CanIfTxPduCfg_ENG23_TXCanId_C CanIf_CanIfTxPduCfg_ENG24_TXCanDlc_C CanIf_CanIfTxPduCfg_ENG24_TXCanId_C CanIf_CanIfTxPduCfg_ENG25_TXCanDlc_C CanIf_CanIfTxPduCfg_ENG25_TXCanId_C CanIf_CanIfTxPduCfg_ENG2_TXCanDlc_C CanIf_CanIfTxPduCfg_ENG2_TXCanId_C CanIf_CanIfTxPduCfg_ENG3_TXCanDlc_C CanIf_CanIfTxPduCfg_ENG3_TXCanId_C CanIf_CanIfTxPduCfg_ENG4_TXCanDlc_C CanIf_CanIfTxPduCfg_ENG4_TXCanId_C CanIf_CanIfTxPduCfg_ENG5_TXCanDlc_C CanIf_CanIfTxPduCfg_ENG5_TXCanId_C CanIf_CanIfTxPduCfg_ENG6_TXCanDlc_C CanIf_CanIfTxPduCfg_ENG6_TXCanId_C CanIf_CanIfTxPduCfg_ENGAE_TXCanDlc_C CanIf_CanIfTxPduCfg_ENGAE_TXCanId_C CanIf_CanIfTxPduCfg_ENGA_TXCanId_C CanIf_CanIfTxPduCfg_ENGB_TXCanDlc_C CanIf_CanIfTxPduCfg_ENGB_TXCanId_C CanIf_CanIfTxPduCfg_ENGC_TXCanDlc_C CanIf_CanIfTxPduCfg_ENGC_TXCanId_C CanIf_CanIfTxPduCfg_ENGF_TXCanDlc_C CanIf_CanIfTxPduCfg_ENGF_TXCanId_C CanIf_CanIfTxPduCfg_ENGIMG1_TXCanDlc_C CanIf_CanIfTxPduCfg_ENGIMG1_TXCanId_C CanIf_CanIfTxPduCfg_ENGJ3_TXCanDlc_C CanIf_CanIfTxPduCfg_ENGJ3_TXCanId_C CanIf_CanIfTxPduCfg_ENGK3_TXCanDlc_C CanIf_CanIfTxPduCfg_ENGK3_TXCanId_C CanIf_CanIfTxPduCfg_ENGL_TXCanDlc_C CanIf_CanIfTxPduCfg_ENGL_TXCanId_C CanIf_CanIfTxPduCfg_ENGN_TXCanDlc_C CanIf_CanIfTxPduCfg_ENGN_TXCanId_C CanIf_CanIfTxPduCfg_ENGQ_TXCanDlc_C CanIf_CanIfTxPduCfg_ENGQ_TXCanId_C CanIf_CanIfTxPduCfg_ENGR_TXCanDlc_C CanIf_CanIfTxPduCfg_ENGR_TXCanId_C CanIf_CanIfTxPduCfg_ENGT1_TXCanDlc_C CanIf_CanIfTxPduCfg_ENGT1_TXCanId_C CanIf_CanIfTxPduCfg_ENGT2_TXCanDlc_C CanIf_CanIfTxPduCfg_ENGT2_TXCanId_C CanIf_CanIfTxPduCfg_ENGT_TXCanDlc_C CanIf_CanIfTxPduCfg_ENGT_TXCanId_C CanIf_CanIfTxPduCfg_ENGU_TXCanDlc_C CanIf_CanIfTxPduCfg_ENGU_TXCanId_C CanIf_CanIfTxPduCfg_ENGV_TXCanDlc_C CanIf_CanIfTxPduCfg_ENGV_TXCanId_C CanIf_CanIfTxPduCfg_ENGW_TXCanDlc_C CanIf_CanIfTxPduCfg_ENGW_TXCanId_C CanIf_CanIfTxPduCfg_ENGX2_TXCanDlc_C CanIf_CanIfTxPduCfg_ENGX2_TXCanId_C CanIf_CanIfTxPduCfg_ENGY2_TXCanDlc_C CanIf_CanIfTxPduCfg_ENGY2_TXCanId_C CanIf_CanIfTxPduCfg_ENGY_TXCanDlc_C CanIf_CanIfTxPduCfg_ENGY_TXCanId_C CanIf_CanIfTxPduCfg_ENGZ_TXCanDlc_C CanIf_CanIfTxPduCfg_ENGZ_TXCanId_C CanIf_CanIfTxPduCfg_eng1_TXCanDlc_C CanIf_CanIfTxPduCfg_eng1_TXCanId_C CanIf_CanIfTxPduCfg_engo_TXCanDlc_C CanIf_CanIfTxPduCfg_engo_TXCanId_C CanIf_OBD_ON_CAN_Rx_0x7DF_VEHICLECanDlc_C CanIf_OBD_ON_CAN_Rx_0x7E0_VEHICLECanDlc_C CanIf_T1_RXCanDlc_C CanIf_T1_TXCanId_C CanIf_UDS_ON_CAN_Rx_0x18da10f1_VEHICLECanDlc_C CanIf_UDS_ON_CAN_Rx_0x18da10f2_VEHICLECanDlc_C CanIf_UDS_ON_CAN_Rx_0x18db2ff1_VEHICLECanDlc_C CanIf_UDS_ON_CAN_Rx_0x18db33f1_VEHICLECanDlc_C CanIf_UDS_ON_CAN_Rx_0x18dbeff1_VEHICLECanDlc_C CanIf_UDS_ON_CAN_Tx_0x18daf110_VEHICLECanId_C CanIf_UDS_ON_CAN_Tx_0x18daf210_VEHICLECanId_C CanIf_UDS_ON_CAN_Tx_0x7E8_VEHICLECanId_C CanIf_XcpRx_Cmd_APPLCanDlc_C CanIf_XcpRx_Cmd_CAN_CCanDlc_C CanIf_XcpRx_Cmd_VEHICLECanDlc_C CanIf_XcpTx_Var_APPLCanId_C CanIf_XcpTx_Var_CAN_CCanId_C CanIf_XcpTx_Var_VEHICLECanId_C /end DEF_CHARACTERISTIC
 /begin LOC_MEASUREMENT CanIf_Prv_ControllerState_ast[0].Ctrl_Pdu_mode CanIf_Prv_ControllerState_ast[1].Ctrl_Pdu_mode CanIf_Prv_ControllerState_ast[2].Ctrl_Pdu_mode CanIf_Prv_InitStatus_b CanIf_Prv_TxBufferRam_ast[0].bufferstatus CanIf_Prv_TxBufferRam_ast[0].last_index CanIf_Prv_TxBufferRam_ast[10].bufferstatus CanIf_Prv_TxBufferRam_ast[10].last_index CanIf_Prv_TxBufferRam_ast[11].bufferstatus CanIf_Prv_TxBufferRam_ast[11].last_index CanIf_Prv_TxBufferRam_ast[12].bufferstatus CanIf_Prv_TxBufferRam_ast[12].last_index CanIf_Prv_TxBufferRam_ast[13].bufferstatus CanIf_Prv_TxBufferRam_ast[13].last_index CanIf_Prv_TxBufferRam_ast[14].bufferstatus CanIf_Prv_TxBufferRam_ast[14].last_index CanIf_Prv_TxBufferRam_ast[15].bufferstatus CanIf_Prv_TxBufferRam_ast[15].last_index CanIf_Prv_TxBufferRam_ast[16].bufferstatus CanIf_Prv_TxBufferRam_ast[16].last_index CanIf_Prv_TxBufferRam_ast[17].bufferstatus CanIf_Prv_TxBufferRam_ast[17].last_index CanIf_Prv_TxBufferRam_ast[18].bufferstatus CanIf_Prv_TxBufferRam_ast[18].last_index CanIf_Prv_TxBufferRam_ast[19].bufferstatus CanIf_Prv_TxBufferRam_ast[19].last_index CanIf_Prv_TxBufferRam_ast[1].bufferstatus CanIf_Prv_TxBufferRam_ast[1].last_index CanIf_Prv_TxBufferRam_ast[20].bufferstatus CanIf_Prv_TxBufferRam_ast[20].last_index CanIf_Prv_TxBufferRam_ast[21].bufferstatus CanIf_Prv_TxBufferRam_ast[21].last_index CanIf_Prv_TxBufferRam_ast[22].bufferstatus CanIf_Prv_TxBufferRam_ast[22].last_index CanIf_Prv_TxBufferRam_ast[23].bufferstatus CanIf_Prv_TxBufferRam_ast[23].last_index CanIf_Prv_TxBufferRam_ast[24].bufferstatus CanIf_Prv_TxBufferRam_ast[24].last_index CanIf_Prv_TxBufferRam_ast[25].bufferstatus CanIf_Prv_TxBufferRam_ast[25].last_index CanIf_Prv_TxBufferRam_ast[26].bufferstatus CanIf_Prv_TxBufferRam_ast[26].last_index CanIf_Prv_TxBufferRam_ast[27].bufferstatus CanIf_Prv_TxBufferRam_ast[27].last_index CanIf_Prv_TxBufferRam_ast[28].bufferstatus CanIf_Prv_TxBufferRam_ast[28].last_index CanIf_Prv_TxBufferRam_ast[29].bufferstatus CanIf_Prv_TxBufferRam_ast[29].last_index CanIf_Prv_TxBufferRam_ast[2].bufferstatus CanIf_Prv_TxBufferRam_ast[2].last_index CanIf_Prv_TxBufferRam_ast[30].bufferstatus CanIf_Prv_TxBufferRam_ast[30].last_index CanIf_Prv_TxBufferRam_ast[31].bufferstatus CanIf_Prv_TxBufferRam_ast[31].last_index CanIf_Prv_TxBufferRam_ast[32].bufferstatus CanIf_Prv_TxBufferRam_ast[32].last_index CanIf_Prv_TxBufferRam_ast[33].bufferstatus CanIf_Prv_TxBufferRam_ast[33].last_index CanIf_Prv_TxBufferRam_ast[34].bufferstatus CanIf_Prv_TxBufferRam_ast[34].last_index CanIf_Prv_TxBufferRam_ast[35].bufferstatus CanIf_Prv_TxBufferRam_ast[35].last_index CanIf_Prv_TxBufferRam_ast[36].bufferstatus CanIf_Prv_TxBufferRam_ast[36].last_index CanIf_Prv_TxBufferRam_ast[37].bufferstatus CanIf_Prv_TxBufferRam_ast[37].last_index CanIf_Prv_TxBufferRam_ast[38].bufferstatus CanIf_Prv_TxBufferRam_ast[38].last_index CanIf_Prv_TxBufferRam_ast[39].bufferstatus CanIf_Prv_TxBufferRam_ast[39].last_index CanIf_Prv_TxBufferRam_ast[3].bufferstatus CanIf_Prv_TxBufferRam_ast[3].last_index CanIf_Prv_TxBufferRam_ast[40].bufferstatus CanIf_Prv_TxBufferRam_ast[40].last_index CanIf_Prv_TxBufferRam_ast[41].bufferstatus CanIf_Prv_TxBufferRam_ast[41].last_index CanIf_Prv_TxBufferRam_ast[42].bufferstatus CanIf_Prv_TxBufferRam_ast[42].last_index CanIf_Prv_TxBufferRam_ast[43].bufferstatus CanIf_Prv_TxBufferRam_ast[43].last_index CanIf_Prv_TxBufferRam_ast[44].bufferstatus CanIf_Prv_TxBufferRam_ast[44].last_index CanIf_Prv_TxBufferRam_ast[45].bufferstatus CanIf_Prv_TxBufferRam_ast[45].last_index CanIf_Prv_TxBufferRam_ast[46].bufferstatus CanIf_Prv_TxBufferRam_ast[46].last_index CanIf_Prv_TxBufferRam_ast[47].bufferstatus CanIf_Prv_TxBufferRam_ast[47].last_index CanIf_Prv_TxBufferRam_ast[48].bufferstatus CanIf_Prv_TxBufferRam_ast[48].last_index CanIf_Prv_TxBufferRam_ast[4].bufferstatus CanIf_Prv_TxBufferRam_ast[4].last_index CanIf_Prv_TxBufferRam_ast[5].bufferstatus CanIf_Prv_TxBufferRam_ast[5].last_index CanIf_Prv_TxBufferRam_ast[6].bufferstatus CanIf_Prv_TxBufferRam_ast[6].last_index CanIf_Prv_TxBufferRam_ast[7].bufferstatus CanIf_Prv_TxBufferRam_ast[7].last_index CanIf_Prv_TxBufferRam_ast[8].bufferstatus CanIf_Prv_TxBufferRam_ast[8].last_index CanIf_Prv_TxBufferRam_ast[9].bufferstatus CanIf_Prv_TxBufferRam_ast[9].last_index /end LOC_MEASUREMENT
 FUNCTION_VERSION "15.16.4" /end FUNCTION
/*********** Start of merged COMPU_METHOD blocks ***********/
/begin COMPU_METHOD RB_RBA_Common_CentralElements_CompuMethods_Identical "The internal value and the physical one are identical. No physical unit available" RAT_FUNC "%10.5" "noUnit" COEFFS 0.0 1.0 0.0 0.0 0.0 1.0 REF_UNIT RB_RBA_Common_CentralElements_Units_NoUnit /end COMPU_METHOD
/*********** End of merged COMPU_METHOD blocks ***********/
/begin COMPU_METHOD ABMMNM_SY_Compu "" TAB_VERB "%6.3" "" COMPU_TAB_REF ABMMNM_SY_Compu /end COMPU_METHOD
/*********** End of merged COMPU_VTAB blocks ***********/
/begin COMPU_VTAB ABMMNM_SY_Compu "" TAB_VERB 2 0 "False" 1 "True" /end COMPU_VTAB
/begin COMPU_METHOD AccHi "" RAT_FUNC "%7.6" "m/s^2" COEFFS 0 10000 0 0 0 1 /end COMPU_METHOD
/*********** Start of merged RECORD_LAYOUT blocks ***********/
/begin RECORD_LAYOUT DefaultValueRecordLayout_AUTOSAR_Platform_BaseTypes_uint8 FNC_VALUES 1 UBYTE COLUMN_DIR DIRECT STATIC_RECORD_LAYOUT /end RECORD_LAYOUT
/begin RECORD_LAYOUT DefaultValueRecordLayout_AUTOSAR_Platform_BaseTypes_uint32 FNC_VALUES 1 ULONG COLUMN_DIR DIRECT STATIC_RECORD_LAYOUT /end RECORD_LAYOUT
/*********** Start of merged UNIT blocks ***********/
/begin UNIT RB_RBA_Common_CentralElements_Units_NoUnit "No Unit" "noUnit" EXTENDED_SI SI_EXPONENTS 0 0 0 0 0 0 0 /end UNIT
/end MODULE
/end PROJECT
