ASAP2_VERSION 1 60
/begin PROJECT MG1CS022 "MG1CS022"
/begin HEADER "" VERSION "MG1CS022_62XSC_V037" PROJECT_NO MG1CS022 /end HEADER
/begin MODULE DIM ""
/begin MOD_COMMON "" BYTE_ORDER MSB_LAST ALIGNMENT_BYTE 1 ALIGNMENT_WORD 2 ALIGNMENT_LONG 4 ALIGNMENT_INT64 4 ALIGNMENT_FLOAT32_IEEE 4 ALIGNMENT_FLOAT64_IEEE 4 DATA_SIZE 32 /end MOD_COMMON
/begin CHARACTERISTIC CWRKAKAP "Additive error Codeword" VALUE 0x8053F9B4 RB_Val_Wu8 255.0 dez 0.00 255.0 FORMAT "%5.1" /end CHARACTERISTIC
/begin CHARACTERISTIC DSDLUTSIMN "Min-limit integrator delta standard deviation engine roughness" VALUE 0x8053F9C6 RB_Val_Ws16 465.6542 lu_MEx -232.8306 232.8235 FORMAT "%8.4" /end CHARACTERISTIC
/begin CHARACTERISTIC DSDLUTSIMX "Max-limit integrator delta standard deviation engine roughness" VALUE 0x8053F9C8 RB_Val_Ws16 465.6542 lu_MEx -232.8306 232.8235 FORMAT "%8.4" /end CHARACTERISTIC
/begin CHARACTERISTIC EngStrt_stStdDeEngRoughns_C "Codeword configuration for standard deviation of engine roughness function." VALUE 0x8053F8E4 RB_Val_Wu8 255.0 dez 0.00 255.0 FORMAT "%5.1" /end CHARACTERISTIC
/begin CHARACTERISTIC EpmCrS_stTTMeasure_C "activate tooth time measurement" VALUE 0x80591470 Val_Wu8 255.0 OneToOne 0.00 255.0 FORMAT "%5.1" /end CHARACTERISTIC
/begin CHARACTERISTIC EpmCrS_swtMeasActvnS1_C "Measurement of the crank-shaft tooth-times in S1-interrupt is activated (==1)" VALUE 0x80591471 Val_Wu8 255.0 OneToOne 0.00 255.0 FORMAT "%5.1" /end CHARACTERISTIC
/begin CHARACTERISTIC EpmHAgClk_numAddTick_CA "Increment distribution of additional ticks of angle clock" VAL_BLK 0x80591472 ValA_Wu8 255.0 OneToOne 0.00 255.0 FORMAT "%5.1" NUMBER 8 /end CHARACTERISTIC
/begin CHARACTERISTIC EpmHCrS_nGapVldn_C "Lower engine speed threshold for verification of gap position" VALUE 0x80591498 Val_Ws32 999.99878584684188 EngN2tiIncPer 0.00116415316060 999.99995000000251 FORMAT "%19.15" EXTENDED_LIMITS 0.001164153160604 2499999.8750000061 /end CHARACTERISTIC
/begin CHARACTERISTIC EpmHCrS_phiThdFBC_C "Angle threshold for distinction between future-past (function EpmHCrS_GetBufSegFBC)" VALUE 0x8059148C Val_Ws16 719.9780 AngleCrS 0.00 719.9780 FORMAT "%8.4" EXTENDED_LIMITS -720.0000 719.9780 /end CHARACTERISTIC
/begin CHARACTERISTIC EpmHCrS_phiThdHi_C "Angle threshold for distinction between future-past (function EpmHCrS_GetBufSegHi)" VALUE 0x8059148E Val_Ws16 719.9780 AngleCrS 0.00 719.9780 FORMAT "%8.4" EXTENDED_LIMITS -720.0000 719.9780 /end CHARACTERISTIC
/begin CHARACTERISTIC EpmHCrS_phiThdPer_C "Angle threshold for distinction between future-past (function EpmHCrS_GetBufPer)" VALUE 0x80591494 Val_Ws16 1439.978 AngleCrS -720.0000 719.9780 FORMAT "%8.4" /end CHARACTERISTIC
/begin CHARACTERISTIC EpmHCrS_phiThdRaw_C "Angle threshold for distinction between future-past (function EpmHCrS_GetBufSegRaw)" VALUE 0x80591490 Val_Ws16 719.9780 AngleCrS 0.00 719.9780 FORMAT "%8.4" EXTENDED_LIMITS -720.0000 719.9780 /end CHARACTERISTIC
/begin CHARACTERISTIC EpmHCrS_phiThd_C "Angle threshold for distinction between future-past (function EpmHCrS_GetBufSeg)" VALUE 0x80591492 Val_Ws16 719.9780 AngleCrS 0.00 719.9780 FORMAT "%8.4" EXTENDED_LIMITS -720.0000 719.9780 /end CHARACTERISTIC
/begin CHARACTERISTIC EpmHCrS_tiEvlnOffsActv_C "Time distance from active edge where the signal processing to be done for Hybrid crankshaft sensor" VALUE 0x80591480 Val_Wu32 499.000000000 InjTimeHiRes_us 1.000000000 500.000000000 FORMAT "%13.9" EXTENDED_LIMITS 0.00 214748364.750 /end CHARACTERISTIC
/begin CHARACTERISTIC EpmHCrS_tiSyncIniTout_C "Delay time for resynchronisation of crankshaft driver" VALUE 0x80591484 Val_Wu32 800000.000000 InjTimeHiRes_us 0.00 800000.000000 FORMAT "%13.6" EXTENDED_LIMITS 0.00 214748364.750 /end CHARACTERISTIC
/begin CHARACTERISTIC EpmHCrS_tiSyncIniWait_C "Timeout time for execution of syncIni interrupt" VALUE 0x80591488 Val_Wu32 100000.000000 InjTimeHiRes_us 0.00 100000.000000 FORMAT "%13.6" EXTENDED_LIMITS 0.00 214748364.750 /end CHARACTERISTIC
/begin CHARACTERISTIC EpmHCrS_tiToutEngStop_C "Timeout duration for engine stop state detection" VALUE 0x8059147C Val_Wu32 3000000.00000 InjTimeHiRes_us 0.00 3000000.00000 FORMAT "%13.5" EXTENDED_LIMITS 0.00 214748364.750 /end CHARACTERISTIC
/begin CHARACTERISTIC EpmRRS_EnaIgnInj_CW "codeword of reverse rotation detection (engine shut off and starter active detection)" VALUE 0x8059149C Val_Wu8 3.000 OneToOne 0.00 3.000 FORMAT "%5.3" EXTENDED_LIMITS 0.00 255.0 /end CHARACTERISTIC
/begin CHARACTERISTIC EpmRRS_facExTTime_CA "factors for tooth time extrapolation" VAL_BLK 0x8059149E ValA_Wu16 100.0000 EPM_FAC_PLAUS 0.00 100.0000 FORMAT "%8.4" EXTENDED_LIMITS 0.00 4095.938 NUMBER 3 /end CHARACTERISTIC
/begin CHARACTERISTIC EpmRRS_nEngMaxCaS_C "Engine speed above which reverse rotation detection based on camshaft signal is disabled" VALUE 0x805914A4 Val_Ws16 3000.000 EngN 0.00 3000.000 FORMAT "%8.3" EXTENDED_LIMITS -16384.00 16383.50 /end CHARACTERISTIC
/begin CHARACTERISTIC EpmRRS_nEngMax_C "engine speed maximum for reverse rotation detection" VALUE 0x805914A6 Val_Ws16 1000.000 EngN 0.00 1000.000 FORMAT "%8.3" EXTENDED_LIMITS -16384.00 16383.50 /end CHARACTERISTIC
/begin CHARACTERISTIC EpmRRS_phiMax_C "maximal allowed reverse rotation angle" VALUE 0x805914A8 Val_Ws16 360.0000 AngleCrS 0.00 360.0000 FORMAT "%8.4" EXTENDED_LIMITS -720.0000 719.9780 /end CHARACTERISTIC
/begin CHARACTERISTIC EpmRRS_phiUndef_C "angle before TDC where reverse rotation detection is undefined" VALUE 0x805914AA Val_Ws16 90.00000 AngleCrS 0.00 90.00000 FORMAT "%8.5" EXTENDED_LIMITS -720.0000 719.9780 /end CHARACTERISTIC
/begin CHARACTERISTIC EpmRRS_swtMethod_C "Selection switch for method of engine reverse rotation detection" VALUE 0x805914AC Val_Wu8 1.000 OneToOne 0.00 1.000 FORMAT "%5.3" EXTENDED_LIMITS 0.00 255.0 /end CHARACTERISTIC
/begin CHARACTERISTIC EpmRRS_tiMaxToothTime_C "Upper limit for tooth timeout of engine stop detection" VALUE 0x805914AD Val_Wu8 970.0 t_q10_ms 30. 1000. FORMAT "%5.0" EXTENDED_LIMITS 0.00 2550. /end CHARACTERISTIC
/begin CHARACTERISTIC EpmRRS_tiMinToothTime_C "Lower limit for tooth timeout of engine stop detection" VALUE 0x805914AE Val_Wu8 970.0 t_q10_ms 30. 1000. FORMAT "%5.0" EXTENDED_LIMITS 0.00 2550. /end CHARACTERISTIC
/begin CHARACTERISTIC EpmRRS_tiTemp_CUR "max tooth periods with reverse rotation depending on temperature" CURVE 0x805914B0 Cur_Xs16Ws16 32767.00 OneToOne_us 0.00 32767.00 FORMAT "%8.2" EXTENDED_LIMITS -32768.00 32767.00
 /begin AXIS_DESCR STD_AXIS EpmIf_tCoolant Temp_Cels 3 -3549.940 3003.560 FORMAT "%8.3" DEPOSIT ABSOLUTE /end AXIS_DESCR
/end CHARACTERISTIC
/begin CHARACTERISTIC EpmRRS_vVehMax_C "Engine speed theshold, below that reverse rotation detection is active" VALUE 0x805914BE Val_Ws16 250.0000 vel_q0p01 0.00 250.0000 FORMAT "%8.4" EXTENDED_LIMITS -327.6800 327.6700 /end CHARACTERISTIC
/begin CHARACTERISTIC EpmSeq_nMaxStrtInt_C "max engine speed to perform a start interrupt" VALUE 0x805914C0 Val_Ws16 10000.00 EngN 0.00 10000.00 FORMAT "%8.2" EXTENDED_LIMITS -16384.00 16383.50 /end CHARACTERISTIC
/begin CHARACTERISTIC EpmSeq_phiIntBCr_CA "interrupt position before TDC during backup crankshaft" VAL_BLK 0x805914C2 ValA_Ws16 719.9780 AngleCrS 0.00 719.9780 FORMAT "%8.4" EXTENDED_LIMITS -720.0000 719.9780 NUMBER 2 /end CHARACTERISTIC
/begin CHARACTERISTIC EpmSeq_phiInt_CA "interrupt position related to TDC" VAL_BLK 0x805914C6 ValA_Ws16 719.9780 AngleCrS 0.00 719.9780 FORMAT "%8.4" EXTENDED_LIMITS -720.0000 719.9780 NUMBER 2 /end CHARACTERISTIC
/begin CHARACTERISTIC EpmSeq_phiStrtInt_CA "interrupt position related to TDC during start" VAL_BLK 0x805914CA ValA_Ws16 719.9780 AngleCrS 0.00 719.9780 FORMAT "%8.4" EXTENDED_LIMITS -720.0000 719.9780 NUMBER 2 /end CHARACTERISTIC
/begin CHARACTERISTIC EpmSeq_swtInt_C "switch to activate/deactivate functionality of the sequence-manager" VALUE 0x805914CE Val_Wu8 18.0000000000 EpmSeq_swtInt_Compu 0.00 18.0000000000 FORMAT "%13.10" /end CHARACTERISTIC
/begin CHARACTERISTIC EpmSyn_dCaSSegMsk_C "mask valid information in Calibration array for the Encoded series of camshaft segments." VALUE 0x805914D0 Val_Wu8 255.0 OneToOne 0.00 255.0 FORMAT "%5.1" /end CHARACTERISTIC
/begin CHARACTERISTIC EpmSyn_nrIgrCaSEdge_C "The number of Camshaft edges to be ignore to enable the synchronization at first Gap." VALUE 0x805914D1 Val_Wu8 255.0 OneToOne 0.00 255.0 FORMAT "%5.1" /end CHARACTERISTIC
/begin CHARACTERISTIC EpmSyn_phiIncCor_CUR "Engine speed depending angle error of crankshaft signal" CURVE 0x805914D4 Cur_Xs16Ws16 39.99023 AngleCrS -19.99512 19.99512 FORMAT "%8.5" EXTENDED_LIMITS -720.0000 719.9780
 /begin AXIS_DESCR STD_AXIS Epm_nEng EngN 4 -16384.00 16383.50 FORMAT "%8.2" DEPOSIT ABSOLUTE /end AXIS_DESCR
/end CHARACTERISTIC
/begin CHARACTERISTIC EpmSyn_stSwtSuppRvsRotCamsft_C "Activation suppressing reverse rotation detection on camshaft, if cam is not in lock position" VALUE 0x805914D2 Val_Wu8 255.0 OneToOne 0.00 255.0 FORMAT "%5.1" /end CHARACTERISTIC
/begin CHARACTERISTIC EpmSyn_swtDiFirstGapSyncn_C "Switch to disable the synchronization at first Gap." VALUE 0x805914D3 Val_Wu8 1.000 OneToOne 0.00 1.000 FORMAT "%5.3" EXTENDED_LIMITS 0.00 255.0 /end CHARACTERISTIC
/begin CHARACTERISTIC Epm_nALESyncMax_C "No sync via engine stop position above this engine speed" VALUE 0x805914F0 Val_Ws16 10000.00 EngN 0.00 10000.00 FORMAT "%8.2" EXTENDED_LIMITS -16384.00 16383.50 /end CHARACTERISTIC
/begin CHARACTERISTIC Epm_nLowSpdMax_C "Maximum threshold for calculation of LowSpd engine speed values" VALUE 0x80591506 Val_Ws16 2000.000 EngN 0.00 2000.000 FORMAT "%8.3" EXTENDED_LIMITS -16384.00 16383.50 /end CHARACTERISTIC
/begin CHARACTERISTIC Epm_nMaxSpdReSync_C "Speed threshold for ignoring teeth during initial speed calculation after resync" VALUE 0x805914FE Val_Ws16 16383.50 EngN 0.00 16383.50 FORMAT "%8.2" EXTENDED_LIMITS -16384.00 16383.50 /end CHARACTERISTIC
/begin CHARACTERISTIC Epm_nNoSyncVerify_C "In state EPM_MODE_VERIFY above this speed threshold no syncronisation until EPM_MODE_OK is reached." VALUE 0x805914F4 Val_Ws16 10000.00 EngN 0.00 10000.00 FORMAT "%8.2" EXTENDED_LIMITS -16384.00 16383.50 /end CHARACTERISTIC
/begin CHARACTERISTIC Epm_nSpd2Zero_C "Engine speed threshold for the transition of HOLD2ZERO through the run-out detection" VALUE 0x80591500 Val_Ws16 32767.50 EngN -16384.00 16383.50 FORMAT "%8.2" /end CHARACTERISTIC
/begin CHARACTERISTIC Epm_numCyl_C "Actual number of cylinder" VALUE 0x805914E6 Val_Wu8 3.000 OneToOne 1.000 4.000 FORMAT "%5.3" EXTENDED_LIMITS 0.00 255.0 /end CHARACTERISTIC
/begin CHARACTERISTIC Epm_numFireSeg_C "physical firing sequence" VAL_BLK 0x805914E7 ValA_Wu8 3.000 OneToOne 1.000 4.000 FORMAT "%5.3" EXTENDED_LIMITS 0.00 255.0 NUMBER 4 /end CHARACTERISTIC
/begin CHARACTERISTIC Epm_numIgrTeethReSync_C "Parameter to number of teeth to be ignored from the engine speed calculations after a crank error" VALUE 0x80591502 Val_Ws16 132.0000 OneToOne 0.00 132.0000 FORMAT "%8.4" EXTENDED_LIMITS -32768.00 32767.00 /end CHARACTERISTIC
/begin CHARACTERISTIC Epm_numReSync_C "number of the permissible re-synchronizations" VALUE 0x805914F6 Val_Wu8 255.0 OneToOne 0.00 255.0 FORMAT "%5.1" /end CHARACTERISTIC
/begin CHARACTERISTIC Epm_phiDiffMax_C "maximal allowed tolerance of engine stop position compared to position if CaS and CrS signal during synchronisation" VALUE 0x805914F8 Val_Ws16 90.00000 AngleCrS 0.00 90.00000 FORMAT "%8.5" EXTENDED_LIMITS -720.0000 719.9780 /end CHARACTERISTIC
/begin CHARACTERISTIC Epm_phiGap2Zero_C "angle between crankshaft signal gap and zero of angle system in ECU" VALUE 0x805914EC Val_Ws16 719.9780 AngleCrS 0.00 719.9780 FORMAT "%8.4" EXTENDED_LIMITS -720.0000 719.9780 /end CHARACTERISTIC
/begin CHARACTERISTIC Epm_phiTdc1_C "position of first TDC related to zero of angle system" VALUE 0x805914EE Val_Ws16 719.9780 AngleCrS 0.00 719.9780 FORMAT "%8.4" EXTENDED_LIMITS -720.0000 719.9780 /end CHARACTERISTIC
/begin CHARACTERISTIC Epm_swtBlkInjCaSSync_C "no synchronization before detection of crankshaft gap" VALUE 0x805914FA Val_Wu8 1.000 OneToOne 0.00 1.000 FORMAT "%5.3" EXTENDED_LIMITS 0.00 255.0 /end CHARACTERISTIC
/begin CHARACTERISTIC Epm_swtOpModeStgy_C "Bit coded switch to select features in Epm_OpMode" VALUE 0x805914FB Val_Wu8 255.0 OneToOne 0.00 255.0 FORMAT "%5.1" /end CHARACTERISTIC
/begin CHARACTERISTIC Epm_tiLockReSync_C "Time in state EPM_MODE_LOCKRESYNC without any crankshaft signal" VALUE 0x805914FC Val_Ws16 5000.000 Time_ms 0.00 5000.000 FORMAT "%8.3" EXTENDED_LIMITS -327680.0 327670.0 /end CHARACTERISTIC
/begin CHARACTERISTIC Epm_tiLowSpd2Zero_C "Timeout threshold for resetting LowSpd engine speeds to zero after last received increment" VALUE 0x80591508 Val_Ws16 4000.000 Time_ms 0.00 4000.000 FORMAT "%8.3" EXTENDED_LIMITS -327680.0 327670.0 /end CHARACTERISTIC
/begin CHARACTERISTIC Epm_tiSpd2Zero_C "Timeout until engine speed will be set to zero" VALUE 0x80591504 Val_Wu16 1000.000 Time_ms 0.00 1000.000 FORMAT "%8.3" EXTENDED_LIMITS 0.00 655350.0 /end CHARACTERISTIC
/begin CHARACTERISTIC Epm_tiSpdGrdAvgFlt_C "Filtertime for PT1-Filtermodule to calculatethe average filtered enginespeed-gradient" VALUE 0x8059150C Val_Ws32 999.0 TimeDelay_ms 1.0 1000.0 FORMAT "%12.1" EXTENDED_LIMITS 0.0 4294967.3 /end CHARACTERISTIC
/begin CHARACTERISTIC Epm_tiSpdGrdFlt_C "Filtertime for PT1-Filtermodule to calculate filtered enginespeed-gradient" VALUE 0x80591510 Val_Ws32 999.0 TimeDelay_ms 1.0 1000.0 FORMAT "%12.1" EXTENDED_LIMITS 0.0 4294967.3 /end CHARACTERISTIC
/begin CHARACTERISTIC ESC_stS0GdiCalcnMaxRst_C "Calibration label to enablereset maximum runtime, maximum lifetime runtime, maximum current cycle task load and maximum lifetime task load of main injection calculation" VALUE 0x805912D4 Val_Wu8 1.00000000000 ESC_MaxRtTskLoad_Rst_t 0.00 1.00000000000 FORMAT "%13.11" /end CHARACTERISTIC
/begin CHARACTERISTIC ESC_stS1FrstSched_C "angle synchronous scheduling starts always with a S1 Task (calculation of PILOT injections)" VALUE 0x805912D5 Val_Wu8 3.00000000000 ESC_stS1FrstSched_t 0.00 3.00000000000 FORMAT "%13.11" /end CHARACTERISTIC
/begin CHARACTERISTIC ESC_stS1GdiCalcnMaxRst_C "Calibration label to enablereset maximum runtime, maximum lifetime runtime, maximum current cycle task load and maximum lifetime task load of main injection calculation" VALUE 0x805912D6 Val_Wu8 1.00000000000 ESC_MaxRtTskLoad_Rst_t 0.00 1.00000000000 FORMAT "%13.11" /end CHARACTERISTIC
/begin CHARACTERISTIC ESC_stSyncS0MaxRst_C "Calibration label to enablereset maximum runtime, maximum lifetime runtime, maximum current cycle task load and maximum lifetime task load of Sync S0 task" VALUE 0x805912D7 Val_Wu8 1.00000000000 ESC_MaxRtTskLoad_Rst_t 0.00 1.00000000000 FORMAT "%13.11" /end CHARACTERISTIC
/begin CHARACTERISTIC ESC_stSyncS1MaxRst_C "Calibration label to enablereset maximum runtime, maximum lifetime runtime, maximum current cycle task load and maximum lifetime task load of Sync S1 task" VALUE 0x805912D8 Val_Wu8 1.00000000000 ESC_MaxRtTskLoad_Rst_t 0.00 1.00000000000 FORMAT "%13.11" /end CHARACTERISTIC
/begin CHARACTERISTIC FRKAP "factor, relative fuel mass for application" VALUE 0x8053F9B5 RB_Val_Wu8 1.992188 fak_ub_b2 0.00 1.992188 FORMAT "%8.6" /end CHARACTERISTIC
/begin CHARACTERISTIC InjSys_facCylIndCorrn0_ATS_ATS.LimitTypeMsk_C "Actuator test InjSys_facCylIndCorrn0_ATS_ATS / Tester demand monitoring enable mask for actuators" VALUE 0x8058ADCC Val_Wu8 255.0 OneToOne 0.00 255.0 FORMAT "%5.1" /end CHARACTERISTIC
/begin CHARACTERISTIC InjSys_facCylIndCorrn0_ATS_ATS.CnvNorm_C "Actuator test InjSys_facCylIndCorrn0_ATS_ATS / Conversion norm used for conversion to/from internal scaling" VALUE 0x8058ADCD Val_Wu8 255.0 OneToOne 0.00 255.0 FORMAT "%5.1" /end CHARACTERISTIC
/begin CHARACTERISTIC InjSys_facCylIndCorrn0_ATS_ATS.LowLim_C "Actuator test InjSys_facCylIndCorrn0_ATS_ATS / Lower limit for monitoring" VALUE 0x8058ADCE Val_Ws16 511.9922 fak_ub_b2 -256.0000 255.9922 FORMAT "%8.4" /end CHARACTERISTIC
/begin CHARACTERISTIC InjSys_facCylIndCorrn0_ATS_ATS.UpLim_C "Actuator test InjSys_facCylIndCorrn0_ATS_ATS / Upper limit for monitoring" VALUE 0x8058ADD0 Val_Ws16 511.9922 fak_ub_b2 -256.0000 255.9922 FORMAT "%8.4" /end CHARACTERISTIC
/begin CHARACTERISTIC InjSys_facCylIndCorrn0_ATS_ATS.CnvFac_C "Actuator test InjSys_facCylIndCorrn0_ATS_ATS / Factor used for conversion to/from internal scaling" VALUE 0x8058ADD4 Val_Ws32 4294967295.00 OneToOne -2147483648.00 2147483647.00 FORMAT "%13.2" /end CHARACTERISTIC
/begin CHARACTERISTIC InjSys_facCylIndCorrn0_ATS_ATS.CnvOfs_C "Actuator test InjSys_facCylIndCorrn0_ATS_ATS / Offset used for conversion to/from internal scaling" VALUE 0x8058ADD8 Val_Ws16 65535.00 OneToOne -32768.00 32767.00 FORMAT "%8.2" /end CHARACTERISTIC
/begin CHARACTERISTIC InjSys_facCylIndCorrn0_ATS_ATS.DfltVal_C "Actuator test InjSys_facCylIndCorrn0_ATS_ATS / Default value for standbytest" VALUE 0x8058ADDA Val_Ws16 65535.00 OneToOne -32768.00 32767.00 FORMAT "%8.2" /end CHARACTERISTIC
/begin CHARACTERISTIC InjSys_facCylIndCorrn1_ATS_ATS.LimitTypeMsk_C "Actuator test InjSys_facCylIndCorrn1_ATS_ATS / Tester demand monitoring enable mask for actuators" VALUE 0x8058ADDC Val_Wu8 255.0 OneToOne 0.00 255.0 FORMAT "%5.1" /end CHARACTERISTIC
/begin CHARACTERISTIC InjSys_facCylIndCorrn1_ATS_ATS.CnvNorm_C "Actuator test InjSys_facCylIndCorrn1_ATS_ATS / Conversion norm used for conversion to/from internal scaling" VALUE 0x8058ADDD Val_Wu8 255.0 OneToOne 0.00 255.0 FORMAT "%5.1" /end CHARACTERISTIC
/begin CHARACTERISTIC InjSys_facCylIndCorrn1_ATS_ATS.LowLim_C "Actuator test InjSys_facCylIndCorrn1_ATS_ATS / Lower limit for monitoring" VALUE 0x8058ADDE Val_Ws16 511.9922 fak_ub_b2 -256.0000 255.9922 FORMAT "%8.4" /end CHARACTERISTIC
/begin CHARACTERISTIC InjSys_facCylIndCorrn1_ATS_ATS.UpLim_C "Actuator test InjSys_facCylIndCorrn1_ATS_ATS / Upper limit for monitoring" VALUE 0x8058ADE0 Val_Ws16 511.9922 fak_ub_b2 -256.0000 255.9922 FORMAT "%8.4" /end CHARACTERISTIC
/begin CHARACTERISTIC InjSys_facCylIndCorrn1_ATS_ATS.CnvFac_C "Actuator test InjSys_facCylIndCorrn1_ATS_ATS / Factor used for conversion to/from internal scaling" VALUE 0x8058ADE4 Val_Ws32 4294967295.00 OneToOne -2147483648.00 2147483647.00 FORMAT "%13.2" /end CHARACTERISTIC
/begin CHARACTERISTIC InjSys_facCylIndCorrn1_ATS_ATS.CnvOfs_C "Actuator test InjSys_facCylIndCorrn1_ATS_ATS / Offset used for conversion to/from internal scaling" VALUE 0x8058ADE8 Val_Ws16 65535.00 OneToOne -32768.00 32767.00 FORMAT "%8.2" /end CHARACTERISTIC
/begin CHARACTERISTIC InjSys_facCylIndCorrn1_ATS_ATS.DfltVal_C "Actuator test InjSys_facCylIndCorrn1_ATS_ATS / Default value for standbytest" VALUE 0x8058ADEA Val_Ws16 65535.00 OneToOne -32768.00 32767.00 FORMAT "%8.2" /end CHARACTERISTIC
/begin CHARACTERISTIC InjSys_facCylIndCorrn2_ATS_ATS.LimitTypeMsk_C "Actuator test InjSys_facCylIndCorrn2_ATS_ATS / Tester demand monitoring enable mask for actuators" VALUE 0x8058ADEC Val_Wu8 255.0 OneToOne 0.00 255.0 FORMAT "%5.1" /end CHARACTERISTIC
/begin CHARACTERISTIC InjSys_facCylIndCorrn2_ATS_ATS.CnvNorm_C "Actuator test InjSys_facCylIndCorrn2_ATS_ATS / Conversion norm used for conversion to/from internal scaling" VALUE 0x8058ADED Val_Wu8 255.0 OneToOne 0.00 255.0 FORMAT "%5.1" /end CHARACTERISTIC
/begin CHARACTERISTIC InjSys_facCylIndCorrn2_ATS_ATS.LowLim_C "Actuator test InjSys_facCylIndCorrn2_ATS_ATS / Lower limit for monitoring" VALUE 0x8058ADEE Val_Ws16 511.9922 fak_ub_b2 -256.0000 255.9922 FORMAT "%8.4" /end CHARACTERISTIC
/begin CHARACTERISTIC InjSys_facCylIndCorrn2_ATS_ATS.UpLim_C "Actuator test InjSys_facCylIndCorrn2_ATS_ATS / Upper limit for monitoring" VALUE 0x8058ADF0 Val_Ws16 511.9922 fak_ub_b2 -256.0000 255.9922 FORMAT "%8.4" /end CHARACTERISTIC
/begin CHARACTERISTIC InjSys_facCylIndCorrn2_ATS_ATS.CnvFac_C "Actuator test InjSys_facCylIndCorrn2_ATS_ATS / Factor used for conversion to/from internal scaling" VALUE 0x8058ADF4 Val_Ws32 4294967295.00 OneToOne -2147483648.00 2147483647.00 FORMAT "%13.2" /end CHARACTERISTIC
/begin CHARACTERISTIC InjSys_facCylIndCorrn2_ATS_ATS.CnvOfs_C "Actuator test InjSys_facCylIndCorrn2_ATS_ATS / Offset used for conversion to/from internal scaling" VALUE 0x8058ADF8 Val_Ws16 65535.00 OneToOne -32768.00 32767.00 FORMAT "%8.2" /end CHARACTERISTIC
/begin CHARACTERISTIC InjSys_facCylIndCorrn2_ATS_ATS.DfltVal_C "Actuator test InjSys_facCylIndCorrn2_ATS_ATS / Default value for standbytest" VALUE 0x8058ADFA Val_Ws16 65535.00 OneToOne -32768.00 32767.00 FORMAT "%8.2" /end CHARACTERISTIC
/begin CHARACTERISTIC InjSys_facCylIndCorrn3_ATS_ATS.LimitTypeMsk_C "Actuator test InjSys_facCylIndCorrn3_ATS_ATS / Tester demand monitoring enable mask for actuators" VALUE 0x8058ADFC Val_Wu8 255.0 OneToOne 0.00 255.0 FORMAT "%5.1" /end CHARACTERISTIC
/begin CHARACTERISTIC InjSys_facCylIndCorrn3_ATS_ATS.CnvNorm_C "Actuator test InjSys_facCylIndCorrn3_ATS_ATS / Conversion norm used for conversion to/from internal scaling" VALUE 0x8058ADFD Val_Wu8 255.0 OneToOne 0.00 255.0 FORMAT "%5.1" /end CHARACTERISTIC
/begin CHARACTERISTIC InjSys_facCylIndCorrn3_ATS_ATS.LowLim_C "Actuator test InjSys_facCylIndCorrn3_ATS_ATS / Lower limit for monitoring" VALUE 0x8058ADFE Val_Ws16 511.9922 fak_ub_b2 -256.0000 255.9922 FORMAT "%8.4" /end CHARACTERISTIC
/begin CHARACTERISTIC InjSys_facCylIndCorrn3_ATS_ATS.UpLim_C "Actuator test InjSys_facCylIndCorrn3_ATS_ATS / Upper limit for monitoring" VALUE 0x8058AE00 Val_Ws16 511.9922 fak_ub_b2 -256.0000 255.9922 FORMAT "%8.4" /end CHARACTERISTIC
/begin CHARACTERISTIC InjSys_facCylIndCorrn3_ATS_ATS.CnvFac_C "Actuator test InjSys_facCylIndCorrn3_ATS_ATS / Factor used for conversion to/from internal scaling" VALUE 0x8058AE04 Val_Ws32 4294967295.00 OneToOne -2147483648.00 2147483647.00 FORMAT "%13.2" /end CHARACTERISTIC
/begin CHARACTERISTIC InjSys_facCylIndCorrn3_ATS_ATS.CnvOfs_C "Actuator test InjSys_facCylIndCorrn3_ATS_ATS / Offset used for conversion to/from internal scaling" VALUE 0x8058AE08 Val_Ws16 65535.00 OneToOne -32768.00 32767.00 FORMAT "%8.2" /end CHARACTERISTIC
/begin CHARACTERISTIC InjSys_facCylIndCorrn3_ATS_ATS.DfltVal_C "Actuator test InjSys_facCylIndCorrn3_ATS_ATS / Default value for standbytest" VALUE 0x8058AE0A Val_Ws16 65535.00 OneToOne -32768.00 32767.00 FORMAT "%8.2" /end CHARACTERISTIC
/begin CHARACTERISTIC InjSys_facCylIndCorrn4_ATS_ATS.LimitTypeMsk_C "Actuator test InjSys_facCylIndCorrn4_ATS_ATS / Tester demand monitoring enable mask for actuators" VALUE 0x8058AE0C Val_Wu8 255.0 OneToOne 0.00 255.0 FORMAT "%5.1" /end CHARACTERISTIC
/begin CHARACTERISTIC InjSys_facCylIndCorrn4_ATS_ATS.CnvNorm_C "Actuator test InjSys_facCylIndCorrn4_ATS_ATS / Conversion norm used for conversion to/from internal scaling" VALUE 0x8058AE0D Val_Wu8 255.0 OneToOne 0.00 255.0 FORMAT "%5.1" /end CHARACTERISTIC
/begin CHARACTERISTIC InjSys_facCylIndCorrn4_ATS_ATS.LowLim_C "Actuator test InjSys_facCylIndCorrn4_ATS_ATS / Lower limit for monitoring" VALUE 0x8058AE0E Val_Ws16 511.9922 fak_ub_b2 -256.0000 255.9922 FORMAT "%8.4" /end CHARACTERISTIC
/begin CHARACTERISTIC InjSys_facCylIndCorrn4_ATS_ATS.UpLim_C "Actuator test InjSys_facCylIndCorrn4_ATS_ATS / Upper limit for monitoring" VALUE 0x8058AE10 Val_Ws16 511.9922 fak_ub_b2 -256.0000 255.9922 FORMAT "%8.4" /end CHARACTERISTIC
/begin CHARACTERISTIC InjSys_facCylIndCorrn4_ATS_ATS.CnvFac_C "Actuator test InjSys_facCylIndCorrn4_ATS_ATS / Factor used for conversion to/from internal scaling" VALUE 0x8058AE14 Val_Ws32 4294967295.00 OneToOne -2147483648.00 2147483647.00 FORMAT "%13.2" /end CHARACTERISTIC
/begin CHARACTERISTIC InjSys_facCylIndCorrn4_ATS_ATS.CnvOfs_C "Actuator test InjSys_facCylIndCorrn4_ATS_ATS / Offset used for conversion to/from internal scaling" VALUE 0x8058AE18 Val_Ws16 65535.00 OneToOne -32768.00 32767.00 FORMAT "%8.2" /end CHARACTERISTIC
/begin CHARACTERISTIC InjSys_facCylIndCorrn4_ATS_ATS.DfltVal_C "Actuator test InjSys_facCylIndCorrn4_ATS_ATS / Default value for standbytest" VALUE 0x8058AE1A Val_Ws16 65535.00 OneToOne -32768.00 32767.00 FORMAT "%8.2" /end CHARACTERISTIC
/begin CHARACTERISTIC InjSys_facCylIndCorrn5_ATS_ATS.LimitTypeMsk_C "Actuator test InjSys_facCylIndCorrn5_ATS_ATS / Tester demand monitoring enable mask for actuators" VALUE 0x8058AE1C Val_Wu8 255.0 OneToOne 0.00 255.0 FORMAT "%5.1" /end CHARACTERISTIC
/begin CHARACTERISTIC InjSys_facCylIndCorrn5_ATS_ATS.CnvNorm_C "Actuator test InjSys_facCylIndCorrn5_ATS_ATS / Conversion norm used for conversion to/from internal scaling" VALUE 0x8058AE1D Val_Wu8 255.0 OneToOne 0.00 255.0 FORMAT "%5.1" /end CHARACTERISTIC
/begin CHARACTERISTIC InjSys_facCylIndCorrn5_ATS_ATS.LowLim_C "Actuator test InjSys_facCylIndCorrn5_ATS_ATS / Lower limit for monitoring" VALUE 0x8058AE1E Val_Ws16 511.9922 fak_ub_b2 -256.0000 255.9922 FORMAT "%8.4" /end CHARACTERISTIC
/begin CHARACTERISTIC InjSys_facCylIndCorrn5_ATS_ATS.UpLim_C "Actuator test InjSys_facCylIndCorrn5_ATS_ATS / Upper limit for monitoring" VALUE 0x8058AE20 Val_Ws16 511.9922 fak_ub_b2 -256.0000 255.9922 FORMAT "%8.4" /end CHARACTERISTIC
/begin CHARACTERISTIC InjSys_facCylIndCorrn5_ATS_ATS.CnvFac_C "Actuator test InjSys_facCylIndCorrn5_ATS_ATS / Factor used for conversion to/from internal scaling" VALUE 0x8058AE24 Val_Ws32 4294967295.00 OneToOne -2147483648.00 2147483647.00 FORMAT "%13.2" /end CHARACTERISTIC
/begin CHARACTERISTIC InjSys_facCylIndCorrn5_ATS_ATS.CnvOfs_C "Actuator test InjSys_facCylIndCorrn5_ATS_ATS / Offset used for conversion to/from internal scaling" VALUE 0x8058AE28 Val_Ws16 65535.00 OneToOne -32768.00 32767.00 FORMAT "%8.2" /end CHARACTERISTIC
/begin CHARACTERISTIC InjSys_facCylIndCorrn5_ATS_ATS.DfltVal_C "Actuator test InjSys_facCylIndCorrn5_ATS_ATS / Default value for standbytest" VALUE 0x8058AE2A Val_Ws16 65535.00 OneToOne -32768.00 32767.00 FORMAT "%8.2" /end CHARACTERISTIC
/begin CHARACTERISTIC InjSys_facCylIndCorrn6_ATS_ATS.LimitTypeMsk_C "Actuator test InjSys_facCylIndCorrn6_ATS_ATS / Tester demand monitoring enable mask for actuators" VALUE 0x8058AE2C Val_Wu8 255.0 OneToOne 0.00 255.0 FORMAT "%5.1" /end CHARACTERISTIC
/begin CHARACTERISTIC InjSys_facCylIndCorrn6_ATS_ATS.CnvNorm_C "Actuator test InjSys_facCylIndCorrn6_ATS_ATS / Conversion norm used for conversion to/from internal scaling" VALUE 0x8058AE2D Val_Wu8 255.0 OneToOne 0.00 255.0 FORMAT "%5.1" /end CHARACTERISTIC
/begin CHARACTERISTIC InjSys_facCylIndCorrn6_ATS_ATS.LowLim_C "Actuator test InjSys_facCylIndCorrn6_ATS_ATS / Lower limit for monitoring" VALUE 0x8058AE2E Val_Ws16 511.9922 fak_ub_b2 -256.0000 255.9922 FORMAT "%8.4" /end CHARACTERISTIC
/begin CHARACTERISTIC InjSys_facCylIndCorrn6_ATS_ATS.UpLim_C "Actuator test InjSys_facCylIndCorrn6_ATS_ATS / Upper limit for monitoring" VALUE 0x8058AE30 Val_Ws16 511.9922 fak_ub_b2 -256.0000 255.9922 FORMAT "%8.4" /end CHARACTERISTIC
/begin CHARACTERISTIC InjSys_facCylIndCorrn6_ATS_ATS.CnvFac_C "Actuator test InjSys_facCylIndCorrn6_ATS_ATS / Factor used for conversion to/from internal scaling" VALUE 0x8058AE34 Val_Ws32 4294967295.00 OneToOne -2147483648.00 2147483647.00 FORMAT "%13.2" /end CHARACTERISTIC
/begin CHARACTERISTIC InjSys_facCylIndCorrn6_ATS_ATS.CnvOfs_C "Actuator test InjSys_facCylIndCorrn6_ATS_ATS / Offset used for conversion to/from internal scaling" VALUE 0x8058AE38 Val_Ws16 65535.00 OneToOne -32768.00 32767.00 FORMAT "%8.2" /end CHARACTERISTIC
/begin CHARACTERISTIC InjSys_facCylIndCorrn6_ATS_ATS.DfltVal_C "Actuator test InjSys_facCylIndCorrn6_ATS_ATS / Default value for standbytest" VALUE 0x8058AE3A Val_Ws16 65535.00 OneToOne -32768.00 32767.00 FORMAT "%8.2" /end CHARACTERISTIC
/begin CHARACTERISTIC InjSys_facCylIndCorrn7_ATS_ATS.LimitTypeMsk_C "Actuator test InjSys_facCylIndCorrn7_ATS_ATS / Tester demand monitoring enable mask for actuators" VALUE 0x8058AE3C Val_Wu8 255.0 OneToOne 0.00 255.0 FORMAT "%5.1" /end CHARACTERISTIC
/begin CHARACTERISTIC InjSys_facCylIndCorrn7_ATS_ATS.CnvNorm_C "Actuator test InjSys_facCylIndCorrn7_ATS_ATS / Conversion norm used for conversion to/from internal scaling" VALUE 0x8058AE3D Val_Wu8 255.0 OneToOne 0.00 255.0 FORMAT "%5.1" /end CHARACTERISTIC
/begin CHARACTERISTIC InjSys_facCylIndCorrn7_ATS_ATS.LowLim_C "Actuator test InjSys_facCylIndCorrn7_ATS_ATS / Lower limit for monitoring" VALUE 0x8058AE3E Val_Ws16 511.9922 fak_ub_b2 -256.0000 255.9922 FORMAT "%8.4" /end CHARACTERISTIC
/begin CHARACTERISTIC InjSys_facCylIndCorrn7_ATS_ATS.UpLim_C "Actuator test InjSys_facCylIndCorrn7_ATS_ATS / Upper limit for monitoring" VALUE 0x8058AE40 Val_Ws16 511.9922 fak_ub_b2 -256.0000 255.9922 FORMAT "%8.4" /end CHARACTERISTIC
/begin CHARACTERISTIC InjSys_facCylIndCorrn7_ATS_ATS.CnvFac_C "Actuator test InjSys_facCylIndCorrn7_ATS_ATS / Factor used for conversion to/from internal scaling" VALUE 0x8058AE44 Val_Ws32 4294967295.00 OneToOne -2147483648.00 2147483647.00 FORMAT "%13.2" /end CHARACTERISTIC
/begin CHARACTERISTIC InjSys_facCylIndCorrn7_ATS_ATS.CnvOfs_C "Actuator test InjSys_facCylIndCorrn7_ATS_ATS / Offset used for conversion to/from internal scaling" VALUE 0x8058AE48 Val_Ws16 65535.00 OneToOne -32768.00 32767.00 FORMAT "%8.2" /end CHARACTERISTIC
/begin CHARACTERISTIC InjSys_facCylIndCorrn7_ATS_ATS.DfltVal_C "Actuator test InjSys_facCylIndCorrn7_ATS_ATS / Default value for standbytest" VALUE 0x8058AE4A Val_Ws16 65535.00 OneToOne -32768.00 32767.00 FORMAT "%8.2" /end CHARACTERISTIC
/begin CHARACTERISTIC KFFNSAMX "Map maximal value afterstart adaptation" MAP 0x8053F9CA RB_Map_U8U16_U16 1.999969 fak_uw_b2 0.00 1.999969 FORMAT "%8.6"
 /begin AXIS_DESCR STD_AXIS tmotnsad temp_ub_q0p75_o48 6 -48.0 143.3 FORMAT "%5.1" DEPOSIT ABSOLUTE /end AXIS_DESCR
 /begin AXIS_DESCR STD_AXIS EngStrt_facDesLamLimLoc fak_uw_b16 3 0.00 15.99976 FORMAT "%8.5" DEPOSIT ABSOLUTE /end AXIS_DESCR
/end CHARACTERISTIC
/begin CHARACTERISTIC KFSDLUSDMR "Map offset desired value standard deviation engine roughness" MAP 0x8053F8E6 RB_Map_U8U16_U8 14.50 lu_MEx_div_8 0.00 14.50 FORMAT "%5.2"
 /begin AXIS_DESCR STD_AXIS tmsdluts temp_ub_q0p75_o48 6 -48.0 143.3 FORMAT "%5.1" DEPOSIT ABSOLUTE /end AXIS_DESCR
 /begin AXIS_DESCR STD_AXIS dmrmx_w_msg rel_uw_b100 4 0.00 99.99847 FORMAT "%8.5" DEPOSIT ABSOLUTE /end AXIS_DESCR
/end CHARACTERISTIC
/begin CHARACTERISTIC KFSDLUSOL "Map desired value standard deviation engine roughness" MAP 0x8053F90E RB_Map_U8U16_U8 14.50 lu_MEx_div_8 0.00 14.50 FORMAT "%5.2"
 /begin AXIS_DESCR STD_AXIS tmsdluts temp_ub_q0p75_o48 6 -48.0 143.3 FORMAT "%5.1" DEPOSIT ABSOLUTE /end AXIS_DESCR
 /begin AXIS_DESCR STD_AXIS anztib_w_msg dez 12 0.00 65535.00 FORMAT "%8.2" DEPOSIT ABSOLUTE /end AXIS_DESCR
/end CHARACTERISTIC
/begin CHARACTERISTIC KFSDLUSRRI "Map desired value standard deviation engine roughness with inert gas" MAP 0x8053F976 RB_Map_U8U16_U8 14.50 lu_MEx_div_8 0.00 14.50 FORMAT "%5.2"
 /begin AXIS_DESCR STD_AXIS tmsdluts temp_ub_q0p75_o48 6 -48.0 143.3 FORMAT "%5.1" DEPOSIT ABSOLUTE /end AXIS_DESCR
 /begin AXIS_DESCR STD_AXIS rri_w_msg rel_uw_b100 4 0.00 99.99847 FORMAT "%8.5" DEPOSIT ABSOLUTE /end AXIS_DESCR
/end CHARACTERISTIC
/begin CHARACTERISTIC KLFNSADETH "Curve correction factor maximum value after-start adaptation" CURVE 0x8053F9FC RB_Curve_U8_U16_Static 1.999969 fak_uw_b2 0.00 1.999969 FORMAT "%8.6"
 /begin AXIS_DESCR STD_AXIS fethmnmx_msg fak_ub_b2 5 0.00 1.992188 FORMAT "%8.6" DEPOSIT ABSOLUTE /end AXIS_DESCR
/end CHARACTERISTIC
/begin CHARACTERISTIC KLFNSAMX "Characteristic line maximal value afterstart adaptation" CURVE 0x8053FA0C RB_Curve_U8_U16_Static 1.999969 fak_uw_b2 0.00 1.999969 FORMAT "%8.6"
 /begin AXIS_DESCR STD_AXIS ESNSAD_tEng temp_ub_q0p75_o48 6 -48.0 143.3 FORMAT "%5.1" DEPOSIT ABSOLUTE /end AXIS_DESCR
/end CHARACTERISTIC
/begin CHARACTERISTIC KLIPOLETH "Curve Conversion of ethanol content into interpolation factor for injection functions" CURVE 0x8053F9B6 RB_Curve_U8_U8 0.9961 fak_ub_b1 0.00 0.9961
 /begin AXIS_DESCR STD_AXIS fethstoe_msg fak_ub_b2 6 0.00 1.992188 FORMAT "%8.6" DEPOSIT ABSOLUTE /end AXIS_DESCR
/end CHARACTERISTIC
/begin CHARACTERISTIC KLLUTS "Amplification factor engine roughness" CURVE 0x8053F99E RB_Curve_S16_U16_Static 3.999939 fak_uw_b4 0.00 3.999939 FORMAT "%8.6"
 /begin AXIS_DESCR STD_AXIS luts_w_msg lu_MEx 4 -232.8306 232.8235 FORMAT "%8.4" DEPOSIT ABSOLUTE /end AXIS_DESCR
/end CHARACTERISTIC
/begin CHARACTERISTIC KLNSADI "Characteristic line integrator part of afterstart adaptation" CURVE 0x8053FA20 RB_Curve_S16_S16 1.999969 fak_sw_b1 -1.000000 0.999969 FORMAT "%8.6" EXTENDED_LIMITS -1.000000 0.9999695
 /begin AXIS_DESCR STD_AXIS dsdlutsi_w lu_MEx 6 -232.8306 232.8235 FORMAT "%8.4" DEPOSIT ABSOLUTE /end AXIS_DESCR
/end CHARACTERISTIC
/begin CHARACTERISTIC KLNSADP "Characteristic line proportional part afterstart adaptation" CURVE 0x8053FA3A RB_Curve_S16_U16_Static 1.999969 fak_uw_b2 0.00 1.999969 FORMAT "%8.6"
 /begin AXIS_DESCR STD_AXIS EngStrt_ratStdDeEngRoughnsLoc lu_MEx 6 -232.8306 232.8235 FORMAT "%8.4" DEPOSIT ABSOLUTE /end AXIS_DESCR
/end CHARACTERISTIC
/begin CHARACTERISTIC KLZKNSADI "Characteristic line integrator time constant afterstart adaptation" CURVE 0x8053FA54 RB_Curve_S16_U16_Static 0.9999847 fak_uw_b1 0.00 0.9999847 FORMAT "%9.7"
 /begin AXIS_DESCR STD_AXIS EngStrt_ratStdDeEngRoughnsLoc lu_MEx 6 -232.8306 232.8235 FORMAT "%8.4" DEPOSIT ABSOLUTE /end AXIS_DESCR
/end CHARACTERISTIC
/begin CHARACTERISTIC RKAKAP "Additive factor, relative fuel mass for application" VALUE 0x8053F9C4 RB_Val_Ws16 48.00000 rel_q0p09375 -24.00000 24.00000 FORMAT "%8.5" EXTENDED_LIMITS -3072.000 3071.906 /end CHARACTERISTIC
/begin CHARACTERISTIC TFNSADOFF "Time constant deactivation afterstart adaptation factor" VALUE 0x8053FA6E RB_Val_Wu16 6553.500 t100msxs_uw_b6553p5 0.00 6553.500 FORMAT "%8.3" /end CHARACTERISTIC
/begin CHARACTERISTIC TNSADHMX "Maximal hold time for afterstart adaptation factor at high engine speed" VALUE 0x8053FA70 RB_Val_Wu16 6553.500 t100msxs_uw_b6553p5 0.00 6553.500 FORMAT "%8.3" /end CHARACTERISTIC
/begin CHARACTERISTIC TNSEMX "maximum time after end of start for limitation of post-start-factor to 1" VALUE 0x8053FA72 RB_Val_Wu16 6553.500 t100msxs_uw_b6553p5 0.00 6553.500 FORMAT "%8.3" /end CHARACTERISTIC
/begin CHARACTERISTIC ZKASDLUTS "Time constant deviation from mean value engine roughness" VALUE 0x8053F9B0 RB_Val_Wu16 0.9999847 fak_uw_b1 0.00 0.9999847 FORMAT "%9.7" /end CHARACTERISTIC
/begin CHARACTERISTIC ZKMSDLUTS "Time constant mean value engine roughness" VALUE 0x8053F9B2 RB_Val_Wu16 0.9999847 fak_uw_b1 0.00 0.9999847 FORMAT "%9.7" /end CHARACTERISTIC
/begin MEASUREMENT CAS_BKUP "Camshaft BackUp mode" UBYTE OneToOne 1 100 0.00 255.0 FORMAT "%5.1" ECU_ADDRESS 0x600008AF /end MEASUREMENT
/begin MEASUREMENT dsdliold_w "Integrator delta standard deviation engine roughness old value" SWORD lu_MEx 1 100 -232.8306 232.8235 FORMAT "%8.4" ECU_ADDRESS 0x600005F2 /end MEASUREMENT
/begin MEASUREMENT dsdlutsi_w "Integrator delta standard deviation engine roughness" SWORD lu_MEx 1 100 -232.8306 232.8235 FORMAT "%8.4" ECU_ADDRESS 0x600005F4 /end MEASUREMENT
/begin MEASUREMENT dsdluts_w_msg "Delta standard deviation engine roughness" SWORD lu_MEx 1 100 -232.8306 232.8235 FORMAT "%8.4" ECU_ADDRESS 0x60000788 /end MEASUREMENT
/begin MEASUREMENT EngStrt_ctESNSADReIni100ms "Local variable to store the global post-drive leave counter(SyC_ctPostDrvLeave)" UBYTE OneToOne 1 100 0.00 255.0 FORMAT "%5.1" ECU_ADDRESS 0x60014A34 /end MEASUREMENT
/begin MEASUREMENT EngStrt_ctESNSADReIniSyncS0 "Local variable to store the global post-drive leave counter(SyC_ctPostDrvLeave)" UBYTE OneToOne 1 100 0.00 255.0 FORMAT "%5.1" ECU_ADDRESS 0x50000951 /end MEASUREMENT
/begin MEASUREMENT EngStrt_facDesLamLimLoc "Local Variable factor for deired lambda limitation" UWORD fak_uw_b16 1 100 0.00 15.99976 FORMAT "%8.5" ECU_ADDRESS 0x60013CFE /end MEASUREMENT
/begin MEASUREMENT EngStrt_ratStdDeEngRoughnsLoc "Local Variable for standard deviation of engine roughness" SWORD lu_MEx 1 100 -232.8306 232.8235 FORMAT "%8.4" ECU_ADDRESS 0x60000598 /end MEASUREMENT
/begin MEASUREMENT EpmCaS_stSnsrDeActvnPBVar "Camshaft sensor deactivation status" UBYTE OneToOne 1 100 0.00 255.0 FORMAT "%5.1" ARRAY_SIZE 1 ECU_ADDRESS 0x6000B963 /end MEASUREMENT
/begin MEASUREMENT EpmCrS_ctInc "crankshaft teeth counter" UBYTE OneToOne 1 100 0.00 255.0 FORMAT "%5.1" ECU_ADDRESS 0x50006074 /end MEASUREMENT
/begin MEASUREMENT EpmCrS_idxBuf_mp "Bufferindex of the crank edge elemets, at which the synchro was triggered" SWORD OneToOne 1 100 -32768.00 32767.00 FORMAT "%8.2" ECU_ADDRESS 0x70009CF0 /end MEASUREMENT
/begin MEASUREMENT EpmCrS_numIncPerSeg "The number of crankshaft teeth in the cylinder-segment EpmCrS_phiSeg" UWORD OneToOne 1 100 0.00 65535.00 FORMAT "%8.2" ECU_ADDRESS 0x60014842 /end MEASUREMENT
/begin MEASUREMENT EpmCrS_numNewInc_mp "TTMeasure - number of new tooth times since last interrupt" UBYTE OneToOne 1 100 0.00 255.0 FORMAT "%5.1" ECU_ADDRESS 0x70009F9B /end MEASUREMENT
/begin MEASUREMENT EpmCrS_numSeg "counter of part segments" UBYTE OneToOne 1 100 0.00 255.0 FORMAT "%5.1" ECU_ADDRESS 0x50006075 /end MEASUREMENT
/begin MEASUREMENT EpmCrS_phiAgClk "Relative angle of the engine position provided by the angle clock" SWORD AngleCrS 1 100 -720.0000 719.9780 FORMAT "%8.4" ECU_ADDRESS 0x50005D5E /end MEASUREMENT
/begin MEASUREMENT EpmCrS_phiInc "Relative angle of the engine position provided by the tooth counter" SWORD AngleCrS 1 100 -720.0000 719.9780 FORMAT "%8.4" ECU_ADDRESS 0x50005D60 /end MEASUREMENT
/begin MEASUREMENT EpmCrS_phiIntSeg "endposition of the current halfsegment" SWORD AngleCrS 1 100 -720.0000 719.9780 FORMAT "%8.4" ECU_ADDRESS 0x7000537C /end MEASUREMENT
/begin MEASUREMENT EpmCrS_phiSeg "Cylinder segment length" SWORD AngleCrS 1 100 -720.0000 719.9780 FORMAT "%8.4" ECU_ADDRESS 0x60014846 /end MEASUREMENT
/begin MEASUREMENT EpmCrS_phiSegHiRes "Segment for calculating EpmCrS_tiSegHiRes" SLONG RBPtCel_ag_1p373291em3_1 1 100 -2949120.00000 2949119.99863 FORMAT "%13.5" ECU_ADDRESS 0x50004F08 /end MEASUREMENT
/begin MEASUREMENT EpmCrS_stRotDir "Rotation direction based on DGI sensor (0 - Forward, 1- Reverse)" UBYTE EpmHCrS_stRotDir_t 1 100 0.00 3.00000000000 FORMAT "%13.11" ECU_ADDRESS 0x50006076 /end MEASUREMENT
/begin MEASUREMENT EpmCrS_stSigMode "state of crankshaft signal evaluation" UBYTE EpmHCrS_stSigMode_State_t 1 100 0.00 9.00000000000 FORMAT "%13.11" ECU_ADDRESS 0x50006077 /end MEASUREMENT
/begin MEASUREMENT EpmCrS_tiDgiPlsFwdAvrg "Average forward pulse width of the DGI sensor (over a segment)" ULONG OneToOne 1 100 0.00 4294967295.00 FORMAT "%13.2" ECU_ADDRESS 0x7000522C /end MEASUREMENT
/begin MEASUREMENT EpmCrS_tiDgiPlsFwdMax "Maximum forward pulse width of the DGI sensor (over a driving cycle)" ULONG OneToOne 1 100 0.00 4294967295.00 FORMAT "%13.2" ECU_ADDRESS 0x70005230 /end MEASUREMENT
/begin MEASUREMENT EpmCrS_tiDgiPlsFwdMin "Minimum forward pulse width of the DGI sensor (over a driving cycle)" ULONG OneToOne 1 100 0.00 4294967295.00 FORMAT "%13.2" ECU_ADDRESS 0x70005234 /end MEASUREMENT
/begin MEASUREMENT EpmCrS_tiDgiPlsRvsAvrg "Average reverse pulse width of the DGI sensor (over a segment)" ULONG OneToOne 1 100 0.00 4294967295.00 FORMAT "%13.2" ECU_ADDRESS 0x70005238 /end MEASUREMENT
/begin MEASUREMENT EpmCrS_tiDgiPlsRvsMax "Maximum reverse pulse width of the DGI sensor (over a driving cycle)" ULONG OneToOne 1 100 0.00 4294967295.00 FORMAT "%13.2" ECU_ADDRESS 0x7000523C /end MEASUREMENT
/begin MEASUREMENT EpmCrS_tiDgiPlsRvsMin "Minimum reverse pulse width of the DGI sensor (over a driving cycle)" ULONG OneToOne 1 100 0.00 4294967295.00 FORMAT "%13.2" ECU_ADDRESS 0x70005240 /end MEASUREMENT
/begin MEASUREMENT EpmCrS_tiInc_mp "TTMeasure - CrS-tooth times since last interrupt" SLONG Time_ns_to_us 1 100 -2147483.64800 2147483.64700 FORMAT "%13.5" ARRAY_SIZE 30 ECU_ADDRESS 0x70009A64 /end MEASUREMENT
/begin MEASUREMENT EpmCrS_tiSeg "cylinder segment time" SLONG Per_Dur 1 100 -2147483648.00 2147483647.00 FORMAT "%13.2" ECU_ADDRESS 0x70005248 /end MEASUREMENT
/begin MEASUREMENT EpmCrS_tiSegCurr "half cylinder segment time" SLONG Per_Dur 1 100 -2147483648.00 2147483647.00 FORMAT "%13.2" ECU_ADDRESS 0x50004F0C /end MEASUREMENT
/begin MEASUREMENT EpmCrS_tiSegHiRes "Crank segment time calculation with resolution with 50 ns" SLONG RBPtCel_ti_50p0_1 1 100 -107374182400. 107374182350. FORMAT "%13.0" ECU_ADDRESS 0x50004F10 /end MEASUREMENT
/begin MEASUREMENT EpmErr_ctErrInfoAryFree "Index of next, free entry in control buffer structure" UWORD OneToOne 1 100 0.00 65535.00 FORMAT "%8.2" ECU_ADDRESS 0x60007944 /end MEASUREMENT
/begin MEASUREMENT EpmErr_TraceCoreId "Core-Id on which the error was seen" ULONG OneToOne 1 100 0.00 4294967295.00 FORMAT "%13.2" ARRAY_SIZE 5 ECU_ADDRESS 0x50001770 /end MEASUREMENT
/begin MEASUREMENT EpmErr_TraceErrClass "Error-class of error" UBYTE EpmErr_ErrClass_t 1 100 0.00 4.00000000000 FORMAT "%13.11" ARRAY_SIZE 5 ECU_ADDRESS 0x6000B99B /end MEASUREMENT
/begin MEASUREMENT EpmErr_TraceErrId "Error number" UBYTE OneToOne 1 100 0.00 255.0 FORMAT "%5.1" ARRAY_SIZE 5 ECU_ADDRESS 0x6000B996 /end MEASUREMENT
/begin MEASUREMENT EpmErr_TraceErrInfo1 "additional information part 1" ULONG OneToOne 1 100 0.00 4294967295.00 FORMAT "%13.2" ARRAY_SIZE 5 ECU_ADDRESS 0x50001784 /end MEASUREMENT
/begin MEASUREMENT EpmErr_TraceErrInfo2 "additional information part 2" ULONG OneToOne 1 100 0.00 4294967295.00 FORMAT "%13.2" ARRAY_SIZE 5 ECU_ADDRESS 0x50001798 /end MEASUREMENT
/begin MEASUREMENT EpmErr_TraceErrInfo3 "additional information part 3" ULONG OneToOne 1 100 0.00 4294967295.00 FORMAT "%13.2" ARRAY_SIZE 5 ECU_ADDRESS 0x500017AC /end MEASUREMENT
/begin MEASUREMENT EpmErr_TraceErrInfo4 "additional information part 4" ULONG OneToOne 1 100 0.00 4294967295.00 FORMAT "%13.2" ARRAY_SIZE 5 ECU_ADDRESS 0x500017C0 /end MEASUREMENT
/begin MEASUREMENT EpmErr_TraceErrorReaction "Error Reaction" ULONG EpmErr_ErrClass_t 1 100 0.00 4.00000000000 FORMAT "%13.11" ARRAY_SIZE 5 ECU_ADDRESS 0x500017D4 /end MEASUREMENT
/begin MEASUREMENT EpmErr_TraceModId "Module-Id of the error handler calling software part" UBYTE Epm_ModId_t 1 100 0.00 80.0000000000 FORMAT "%13.10" ARRAY_SIZE 5 ECU_ADDRESS 0x6000B991 /end MEASUREMENT
/begin MEASUREMENT EpmErr_TraceStatus "error status information byte" UBYTE OneToOne 1 100 0.00 255.0 FORMAT "%5.1" ARRAY_SIZE 5 ECU_ADDRESS 0x6000B98C /end MEASUREMENT
/begin MEASUREMENT EpmErr_TraceTimeStamp "error occurence time stamp" ULONG t_q0p01_us 1 100 0.00 42949672.9500 FORMAT "%13.4" ARRAY_SIZE 5 ECU_ADDRESS 0x500017E8 /end MEASUREMENT
/begin MEASUREMENT EpmHAgClk_AddTick "Increment distribution of additional ticks of angle clock" UBYTE OneToOne 1 100 0.00 255.0 FORMAT "%5.1" ARRAY_SIZE 8 ECU_ADDRESS 0x6000B984 /end MEASUREMENT
/begin MEASUREMENT EpmHAgClk_agPosnTrigEve "Angle stamp of the current activiation event" SWORD AngleCrS 1 100 -720.0000 719.9780 FORMAT "%8.4" ECU_ADDRESS 0x6000059A /end MEASUREMENT
/begin MEASUREMENT EpmHAgClk_Gen_AgCntRaw_mp "Current angle clock value in 24-bit, read in 1ms task" ULONG AngleCrS 1 100 0.00 94371839.9781 FORMAT "%13.4" ECU_ADDRESS 0x70009A60 /end MEASUREMENT
/begin MEASUREMENT EpmHAgClk_Gen_AgCnt_mp "Current angle clock value limited to one working cycle (720), read in 1ms task" SWORD AngleCrS 1 100 -720.0000 719.9780 FORMAT "%8.4" ECU_ADDRESS 0x70009CEE /end MEASUREMENT
/begin MEASUREMENT EpmHAgClk_numAgClkFrq "Control parameter for extremal values of angle clock speed" UBYTE EpmHAgClk_AgClkFrq_t 1 100 0.00 3.00000000000 FORMAT "%13.11" ECU_ADDRESS 0x7000545E /end MEASUREMENT
/begin MEASUREMENT EpmHAgClk_numAgClkMode "Actual correction mode of angle clock" UBYTE EpmHAgClk_AgClkMode_t 1 100 0.00 3.00000000000 FORMAT "%13.11" ECU_ADDRESS 0x60014A38 /end MEASUREMENT
/begin MEASUREMENT EpmHAgClk_numAgClkState "Actual activation state of angle clock" UBYTE EpmHAgClk_AgClkState_t 1 100 0.00 1.00000000000 FORMAT "%13.11" ECU_ADDRESS 0x50006018 /end MEASUREMENT
/begin MEASUREMENT EpmHAgClk_numAgTicksPerInc "Nominal tick number of angle clock per increment" UWORD OneToOne 1 100 0.00 65535.00 FORMAT "%8.2" ECU_ADDRESS 0x60013D08 /end MEASUREMENT
/begin MEASUREMENT EpmHAgClk_numMissTick "Number of missing micro ticks not generated until synchronisation gap" SWORD OneToOne 1 100 -32768.00 32767.00 FORMAT "%8.2" ECU_ADDRESS 0x60007942 /end MEASUREMENT
/begin MEASUREMENT EpmHAgClk_stAPTSyn "Status: DPLL synchronous at hardware profile (ADT_T)" UBYTE OneToOne 1 100 0.00 255.0 BIT_MASK 0x1 FORMAT "%5.1" ECU_ADDRESS 0x6000B983 /end MEASUREMENT
/begin MEASUREMENT EpmHAgClk_tiIncPerBas "Nominal increment duration for setting of angle clock speed" SLONG OneToOne 1 100 -2147483648.00 2147483647.00 FORMAT "%13.2" ECU_ADDRESS 0x70005148 /end MEASUREMENT
/begin MEASUREMENT EpmHAgClk_tiMinPer "Minimum increment duration (according to maximum engine speed)" SLONG OneToOne 1 100 -2147483648.00 2147483647.00 FORMAT "%13.2" ECU_ADDRESS 0x500017FC /end MEASUREMENT
/begin MEASUREMENT EpmHCaS_ctEdgeCaSI1 "Absolute edge number of the inlet cam-shaft bank1" UBYTE OneToOne 1 100 0.00 255.0 FORMAT "%5.1" ECU_ADDRESS 0x60014A39 /end MEASUREMENT
/begin MEASUREMENT EpmHCaS_DataI1.agFallEdgeCorrn "signal buffer for the camshaft inlet bank 1 / engine speed and temperature depending correction of the angle for falling edges" SLONG AngleCrS 1 100 -47185920.0000 47185919.9780 FORMAT "%13.4" ECU_ADDRESS 0x70001ACC /end MEASUREMENT
/begin MEASUREMENT EpmHCaS_DataI1.agRisngEdgeCorrn "signal buffer for the camshaft inlet bank 1 / engine speed and temperature depending correction of the angle for rising edges" SLONG AngleCrS 1 100 -47185920.0000 47185919.9780 FORMAT "%13.4" ECU_ADDRESS 0x70001AD0 /end MEASUREMENT
/begin MEASUREMENT EpmHCaS_DataI1.ctEdge "signal buffer for the camshaft inlet bank 1 / total number auf measured edges since ECU init" SLONG OneToOne 1 100 -2147483648.00 2147483647.00 FORMAT "%13.2" ECU_ADDRESS 0x70001AD4 /end MEASUREMENT
/begin MEASUREMENT EpmHCaS_DataI1.tiGlitch "signal buffer for the camshaft inlet bank 1 / glitch filter value for each rising and falling edge" ULONG RBPtCel_ti_50p0_1 1 100 0.00 214748364750. FORMAT "%13.0" ECU_ADDRESS 0x70001AD8 /end MEASUREMENT
/begin MEASUREMENT EpmHCaS_DataI1.tiDiffEdge "signal buffer for the camshaft inlet bank 1 / time distance between the measured edge to the edge measured once before" ULONG RBPtCel_ti_50p0_1 1 100 0.00 214748364750. FORMAT "%13.0" ARRAY_SIZE 20 ECU_ADDRESS 0x70001ADC /end MEASUREMENT
/begin MEASUREMENT EpmHCaS_DataI1.tiDiffLstEdge "signal buffer for the camshaft inlet bank 1 / distance between the last measured edge to the edge measured once before" ULONG RBPtCel_ti_50p0_1 1 100 0.00 214748364750. FORMAT "%13.0" ECU_ADDRESS 0x70001B2C /end MEASUREMENT
/begin MEASUREMENT EpmHCaS_DataI1.tiStampEdge "signal buffer for the camshaft inlet bank 1 / point of time of the measured edge" ULONG RBPtCel_ti_50p0_1 1 100 0.00 214748364750. FORMAT "%13.0" ARRAY_SIZE 20 ECU_ADDRESS 0x70001B30 /end MEASUREMENT
/begin MEASUREMENT EpmHCaS_DataI1.agDiffEdge "signal buffer for the camshaft inlet bank 1 / angle distance between the measured edge to the edge measured once before" SWORD AngleCrS 1 100 -720.0000 719.9780 FORMAT "%8.4" ARRAY_SIZE 20 ECU_ADDRESS 0x70001B80 /end MEASUREMENT
/begin MEASUREMENT EpmHCaS_DataI1.agDiffLstEdge "signal buffer for the camshaft inlet bank 1 / angle distance between the last measured edge to the edge measured once before" SWORD AngleCrS 1 100 -720.0000 719.9780 FORMAT "%8.4" ECU_ADDRESS 0x70001BA8 /end MEASUREMENT
/begin MEASUREMENT EpmHCaS_DataI1.agEdgeAbslt "signal buffer for the camshaft inlet bank 1 / absolute angle of the measured edge (-720 deg, if not valid)" SWORD AngleCrS 1 100 -720.0000 719.9780 FORMAT "%8.4" ARRAY_SIZE 20 ECU_ADDRESS 0x70001BAA /end MEASUREMENT
/begin MEASUREMENT EpmHCaS_DataI1.agEdgeCorrn "signal buffer for the camshaft inlet bank 1 / engine speed and temperature depending correction of the angle" SWORD AngleCrS 1 100 -720.0000 719.9780 FORMAT "%8.4" ARRAY_SIZE 20 ECU_ADDRESS 0x70001BD2 /end MEASUREMENT
/begin MEASUREMENT EpmHCaS_DataI1.agEdgeRel "signal buffer for the camshaft inlet bank 1 / relative angle of the measured edge" SWORD AngleCrS 1 100 -720.0000 719.9780 FORMAT "%8.4" ARRAY_SIZE 20 ECU_ADDRESS 0x70001BFA /end MEASUREMENT
/begin MEASUREMENT EpmHCaS_DataI1.agPhaShiftRel "signal buffer for the camshaft inlet bank 1 / current phasing (deflection of the reference position) of the camshaft for the measured edge" SWORD AngleCrS 1 100 -720.0000 719.9780 FORMAT "%8.4" ARRAY_SIZE 20 ECU_ADDRESS 0x70001C22 /end MEASUREMENT
/begin MEASUREMENT EpmHCaS_DataI1.agRefPosCorrd "signal buffer for the camshaft inlet bank 1 / by the adaption corrected reference position of the edges" SWORD AngleCrS 1 100 -720.0000 719.9780 FORMAT "%8.4" ARRAY_SIZE 10 ECU_ADDRESS 0x70001C4A /end MEASUREMENT
/begin MEASUREMENT EpmHCaS_DataI1.ctBufIdx "signal buffer for the camshaft inlet bank 1 / Points to the next element in the buffer, which will be written (ctBufIdx - 1 contains the last measured edge)" SBYTE OneToOne 1 100 -128.0 127.0 FORMAT "%5.1" ECU_ADDRESS 0x70001C5E /end MEASUREMENT
/begin MEASUREMENT EpmHCaS_DataI1.ctValidEdge "signal buffer for the camshaft inlet bank 1 / number of measured edges with a valid angle stamp" SBYTE OneToOne 1 100 -128.0 127.0 FORMAT "%5.1" ECU_ADDRESS 0x70001C5F /end MEASUREMENT
/begin MEASUREMENT EpmHCaS_DataI1.ctValidTime "signal buffer for the camshaft inlet bank 1 / number of measured edges with a valid time stamp" SBYTE OneToOne 1 100 -128.0 127.0 FORMAT "%5.1" ECU_ADDRESS 0x70001C60 /end MEASUREMENT
/begin MEASUREMENT EpmHCaS_DataI1.numBufUsed "signal buffer for the camshaft inlet bank 1 / number of elements which are used for the edge data in the buffer (depends on EpmCaS_numSegSerLst)" UBYTE OneToOne 1 100 0.00 255.0 FORMAT "%5.1" ECU_ADDRESS 0x70001C61 /end MEASUREMENT
/begin MEASUREMENT EpmHCaS_DataI1.numLstEdgeAbslt "signal buffer for the camshaft inlet bank 1 / absolute edge position of the last measured edge (-1, if not vaild)" SBYTE OneToOne 1 100 -128.0 127.0 FORMAT "%5.1" ECU_ADDRESS 0x70001C8A /end MEASUREMENT
/begin MEASUREMENT EpmHCaS_DataI1.numLstEdgeWcy "signal buffer for the camshaft inlet bank 1 / relative edge position of the last measured edge" SBYTE OneToOne 1 100 -128.0 127.0 FORMAT "%5.1" ECU_ADDRESS 0x70001C8B /end MEASUREMENT
/begin MEASUREMENT EpmHCaS_DataI1.numEdgeAbslt "signal buffer for the camshaft inlet bank 1 / absolute edge position of the measured edge (-1, if not vaild)" SBYTE OneToOne 1 100 -128.0 127.0 FORMAT "%5.1" ARRAY_SIZE 20 ECU_ADDRESS 0x70001C62 /end MEASUREMENT
/begin MEASUREMENT EpmHCaS_DataI1.numEdgeWcy "signal buffer for the camshaft inlet bank 1 / relative edge position of the measured edge" SBYTE OneToOne 1 100 -128.0 127.0 FORMAT "%5.1" ARRAY_SIZE 20 ECU_ADDRESS 0x70001C76 /end MEASUREMENT
/begin MEASUREMENT EpmHCaS_DataI1.stCurLev "signal buffer for the camshaft inlet bank 1 / electrical level of the camshaft signal after the last measured edge" UBYTE OneToOne 1 100 0.00 255.0 FORMAT "%5.1" ECU_ADDRESS 0x70001C8C /end MEASUREMENT
/begin MEASUREMENT EpmHCaS_DataI1.stLevBeforeEdge "signal buffer for the camshaft inlet bank 1 / electrical level of the camshaft signal before the measured edge" UBYTE OneToOne 1 100 0.00 255.0 FORMAT "%5.1" ARRAY_SIZE 20 ECU_ADDRESS 0x70001C8D /end MEASUREMENT
/begin MEASUREMENT EpmHCaS_DataI1.stSig "signal buffer for the camshaft inlet bank 1 / state if a disturbance by the glitch filter was detected and faded out" UBYTE OneToOne 1 100 0.00 255.0 FORMAT "%5.1" ECU_ADDRESS 0x70001CA1 /end MEASUREMENT
/begin MEASUREMENT EpmHCaS_stCaSSig "stores the cas level for that cas segment" UBYTE OneToOne 1 100 0.00 255.0 FORMAT "%5.1" ARRAY_SIZE 1 ECU_ADDRESS 0x6000B982 /end MEASUREMENT
/begin MEASUREMENT EpmHCrS_agActvEdge "Angle stamp of active edge of crankshaft signal" ULONG OneToOne 1 100 0.00 4294967295.00 FORMAT "%13.2" ECU_ADDRESS 0x7000514C /end MEASUREMENT
/begin MEASUREMENT EpmHCrS_cntrDrvErrRst "Overall counter for crankshaft errors during driving operation" UWORD OneToOne 1 100 0.00 65535.00 FORMAT "%8.2" ECU_ADDRESS 0x60007924 /end MEASUREMENT
/begin MEASUREMENT EpmHCrS_cntrEdge "crankshaft edge counter which increased by the active and the inactive edges" ULONG OneToOne 1 100 0.00 4294967295.00 FORMAT "%13.2" ECU_ADDRESS 0x70005150 /end MEASUREMENT
/begin MEASUREMENT EpmHCrS_cntrErr "Counter array for single error reasons at crankshaft driver" UWORD OneToOne 1 100 0.00 65535.00 FORMAT "%8.2" ARRAY_SIZE 12 ECU_ADDRESS 0x60013D0A /end MEASUREMENT
/begin MEASUREMENT EpmHCrS_cntrErrRst "Overall counter for crankshaft errors with reset of crankshaft driver" UWORD OneToOne 1 100 0.00 65535.00 FORMAT "%8.2" ECU_ADDRESS 0x60007922 /end MEASUREMENT
/begin MEASUREMENT EpmHCrS_cntrErrSum "Overall counter for all crankshaft errors" UWORD OneToOne 1 100 0.00 65535.00 FORMAT "%8.2" ECU_ADDRESS 0x60013D22 /end MEASUREMENT
/begin MEASUREMENT EpmHCrS_cntrInct "crankshaft teeth counter" SWORD OneToOne 1 100 -32768.00 32767.00 FORMAT "%8.2" ECU_ADDRESS 0x70005296 /end MEASUREMENT
/begin MEASUREMENT EpmHCrS_cntrInctDcyc "Free running crankshaft teeth counter incremented at every active edge including missing teeth." ULONG OneToOne 1 100 0.00 4294967295.00 FORMAT "%13.2" ECU_ADDRESS 0x70005154 /end MEASUREMENT
/begin MEASUREMENT EpmHCrS_cntrInctDcycOld "The variable to hold previous value of EpmHCrS_cntrInctDcyc" ULONG OneToOne 1 100 0.00 4294967295.00 FORMAT "%13.2" ECU_ADDRESS 0x50001800 /end MEASUREMENT
/begin MEASUREMENT EpmHCrS_ctAPTDiff "Synchronisation shift as number of real increments (gap corresponds to one real increment)" SWORD OneToOne 1 100 -32768.00 32767.00 FORMAT "%8.2" ECU_ADDRESS 0x60007940 /end MEASUREMENT
/begin MEASUREMENT EpmHCrS_ctAPTPos "Calculation of Counter Values for Crankshaft Increments" SWORD OneToOne 1 100 -32768.00 32767.00 FORMAT "%8.2" ECU_ADDRESS 0x70005298 /end MEASUREMENT
/begin MEASUREMENT EpmHCrS_ctDebEdge "Edge counter at crankshaft driver state DEBEDGE" SWORD OneToOne 1 100 -32768.00 32767.00 FORMAT "%8.2" ECU_ADDRESS 0x6000793A /end MEASUREMENT
/begin MEASUREMENT EpmHCrS_ctEdgeStrt "Start edge counter for DMA initialisation" UBYTE OneToOne 1 100 0.00 255.0 FORMAT "%5.1" ECU_ADDRESS 0x6000B979 /end MEASUREMENT
/begin MEASUREMENT EpmHCrS_ctGapDetn "Counter for measurement of stay duration inside crankshaft driver state with active gap search" SWORD OneToOne 1 100 -32768.00 32767.00 FORMAT "%8.2" ECU_ADDRESS 0x60007938 /end MEASUREMENT
/begin MEASUREMENT EpmHCrS_ctGapPos "Internal - Migrated to SDOM from Old CMT" SWORD OneToOne 1 100 -32768.00 32767.00 FORMAT "%8.2" ECU_ADDRESS 0x7000529A /end MEASUREMENT
/begin MEASUREMENT EpmHCrS_ctGapRef "Position of crankshaft relatively to current gap" SWORD OneToOne 1 100 -32768.00 32767.00 FORMAT "%8.2" ECU_ADDRESS 0x7000529C /end MEASUREMENT
/begin MEASUREMENT EpmHCrS_ctIncActivate "Increment counter of the increment where the next synchro shall be activated" SWORD OneToOne 1 100 -32768.00 32767.00 FORMAT "%8.2" ECU_ADDRESS 0x7000302C /end MEASUREMENT
/begin MEASUREMENT EpmHCrS_ctIncEngPos "Tooth counter current engine position" UWORD OneToOne 1 100 0.00 65535.00 FORMAT "%8.2" ECU_ADDRESS 0x600006BE /end MEASUREMENT
/begin MEASUREMENT EpmHCrS_ctIncGap "Value of increment counter EpmHCrS_ctIncStrt at last gap" SWORD OneToOne 1 100 -32768.00 32767.00 FORMAT "%8.2" ECU_ADDRESS 0x500055D0 /end MEASUREMENT
/begin MEASUREMENT EpmHCrS_ctIncGapDly "Auxiliary information for calculation of reference counter EpmHCrS_ctGapRef" SWORD OneToOne 1 100 -32768.00 32767.00 FORMAT "%8.2" ARRAY_SIZE 2 ECU_ADDRESS 0x60013D24 /end MEASUREMENT
/begin MEASUREMENT EpmHCrS_ctIncPos "Increment counter with reference to zero mark" SWORD OneToOne 1 100 -32768.00 32767.00 FORMAT "%8.2" ECU_ADDRESS 0x60013D28 /end MEASUREMENT
/begin MEASUREMENT EpmHCrS_ctIncRvs "Counter for crankshaft increments with reverse engine rotation direction" UWORD OneToOne 1 100 0.00 65535.00 FORMAT "%8.2" ECU_ADDRESS 0x60007936 /end MEASUREMENT
/begin MEASUREMENT EpmHCrS_ctIncStrt "Increment counter with reference to engine start" SWORD OneToOne 1 100 -32768.00 32767.00 FORMAT "%8.2" ECU_ADDRESS 0x7000529E /end MEASUREMENT
/begin MEASUREMENT EpmHCrS_ctIncStrtOld "Value of increment counter EpmHCrS_ctIncStrt at preceding crankshaft tooth" SWORD OneToOne 1 100 -32768.00 32767.00 FORMAT "%8.2" ECU_ADDRESS 0x700052A0 /end MEASUREMENT
/begin MEASUREMENT EpmHCrS_ctOffsPos2Strt "Counter offset between EpmHCrS_ctIncPos and EpmHCrS_ctIncStrt" SWORD OneToOne 1 100 -32768.00 32767.00 FORMAT "%8.2" ECU_ADDRESS 0x60013D2A /end MEASUREMENT
/begin MEASUREMENT EpmHCrS_ctOffsRel2APT "Counter offset between EpmHCrS_ctRel and EpmHCrS_ctAPTPos" SWORD OneToOne 1 100 -32768.00 32767.00 FORMAT "%8.2" ECU_ADDRESS 0x60013D2C /end MEASUREMENT
/begin MEASUREMENT EpmHCrS_ctOffsRel2Strt "Counter offset between EpmHCrS_ctRel and EpmHCrS_ctIncStrt" SWORD OneToOne 1 100 -32768.00 32767.00 FORMAT "%8.2" ECU_ADDRESS 0x6000793E /end MEASUREMENT
/begin MEASUREMENT EpmHCrS_ctPosAry "Transformation array between hardware counter EpmHCrS_ctAPTPos and EpmHCrS_ctIncPos resp. EpmHCrS_ctGapPos" UWORD OneToOne 1 100 0.00 65535.00 FORMAT "%8.2" ARRAY_SIZE 116 ECU_ADDRESS 0x500055D2 /end MEASUREMENT
/begin MEASUREMENT EpmHCrS_ctRealGapPos "Array with values of hardware counter EpmHCrS_ctAPTPos at gap positions" SWORD OneToOne 1 100 -32768.00 32767.00 FORMAT "%8.2" ARRAY_SIZE 2 ECU_ADDRESS 0x60007932 /end MEASUREMENT
/begin MEASUREMENT EpmHCrS_ctRel "Free running internal edge counter" SWORD OneToOne 1 100 -32768.00 32767.00 FORMAT "%8.2" ECU_ADDRESS 0x700052A2 /end MEASUREMENT
/begin MEASUREMENT EpmHCrS_ctResyncUpperLvl "counter for the number of function calls" UWORD OneToOne 1 100 0.00 65535.00 FORMAT "%8.2" ECU_ADDRESS 0x60007928 /end MEASUREMENT
/begin MEASUREMENT EpmHCrS_ctSynGapPos "Value of gap counter EpmHCrS_ctGapPos at synchronisation gap" SWORD OneToOne 1 100 -32768.00 32767.00 FORMAT "%8.2" ECU_ADDRESS 0x6000793C /end MEASUREMENT
/begin MEASUREMENT EpmHCrS_ctSynInc "Value of increment counter EpmHCrS_ctIncStrt at synchronisation gap" SWORD OneToOne 1 100 -32768.00 32767.00 FORMAT "%8.2" ECU_ADDRESS 0x60007930 /end MEASUREMENT
/begin MEASUREMENT EpmHCrS_facGapCrit1 "Factor for adjustment of first gap criterion" UBYTE OneToOne 1 100 0.00 255.0 FORMAT "%5.1" ECU_ADDRESS 0x6000B974 /end MEASUREMENT
/begin MEASUREMENT EpmHCrS_facGapCrit2 "Factor for adjustment of second gap criterion" UBYTE OneToOne 1 100 0.00 255.0 FORMAT "%5.1" ECU_ADDRESS 0x60014A3A /end MEASUREMENT
/begin MEASUREMENT EpmHCrS_facGapPlausHigh "Timeout factor of crankshaft sensor signal at gap of wheel" ULONG FactLow 1 100 0.00 4194303.99902 FORMAT "%13.5" ECU_ADDRESS 0x50001804 /end MEASUREMENT
/begin MEASUREMENT EpmHCrS_facIncPlausHigh "Timeout factor of crankshaft sensor signal at increment of wheel" ULONG FactLow 1 100 0.00 4194303.99902 FORMAT "%13.5" ECU_ADDRESS 0x50001808 /end MEASUREMENT
/begin MEASUREMENT EpmHCrS_facIncPlausLow "Factor for lower threshold of plausibility window of crankshaft signal" ULONG FactLow 1 100 0.00 4194303.99902 FORMAT "%13.5" ECU_ADDRESS 0x60012F74 /end MEASUREMENT
/begin MEASUREMENT EpmHCrS_facPlausHigh "Timeout factor for increment signal of crankshaft sensor" ULONG FactLow 1 100 0.00 4194303.99902 FORMAT "%13.5" ECU_ADDRESS 0x70005158 /end MEASUREMENT
/begin MEASUREMENT EpmHCrS_facPlausHighOld "Timeout factor for increment signal of crankshaft sensor (old value)" ULONG FactLow 1 100 0.00 4194303.99902 FORMAT "%13.5" ECU_ADDRESS 0x60012F78 /end MEASUREMENT
/begin MEASUREMENT EpmHCrS_facPVTOld "Factor for lower threshold of plausibility window of crankshaft signal (old value)" ULONG OneToOne 1 100 0.00 4294967295.00 FORMAT "%13.2" ECU_ADDRESS 0x5000180C /end MEASUREMENT
/begin MEASUREMENT EpmHCrS_numDebInc "Number of crankshaft edges to debounce at crankshaft driver state DEBEDGE" UBYTE OneToOne 1 100 0.00 255.0 FORMAT "%5.1" ECU_ADDRESS 0x6000B973 /end MEASUREMENT
/begin MEASUREMENT EpmHCrS_numGapWcy "Number of gaps of crankshaft wheel within one working cycle" SWORD OneToOne 1 100 -32768.00 32767.00 FORMAT "%8.2" ECU_ADDRESS 0x6000792E /end MEASUREMENT
/begin MEASUREMENT EpmHCrS_numGap_Var "Number of gaps on crankshaft wheel" UBYTE OneToOne 1 100 0.00 255.0 FORMAT "%5.1" ECU_ADDRESS 0x600008C4 /end MEASUREMENT
/begin MEASUREMENT EpmHCrS_numIncGap2GapMax "Maximum number of increments between two gaps of crankshaft wheel" SWORD OneToOne 1 100 -32768.00 32767.00 FORMAT "%8.2" ECU_ADDRESS 0x6000792C /end MEASUREMENT
/begin MEASUREMENT EpmHCrS_numIncGap2Gap_Var "Gap distance expressed by increments" UBYTE OneToOne 1 100 0.00 255.0 FORMAT "%5.1" ARRAY_SIZE 2 ECU_ADDRESS 0x6000059C /end MEASUREMENT
/begin MEASUREMENT EpmHCrS_numIncGapMiss "Evaluation of Rotation Direction Information from Engine Speed Sensor" SWORD OneToOne 1 100 -32768.00 32767.00 FORMAT "%8.2" ECU_ADDRESS 0x60013D2E /end MEASUREMENT
/begin MEASUREMENT EpmHCrS_numIncGap_Var "Evaluation of Rotation Direction Information from Engine Speed Sensor" UBYTE OneToOne 1 100 0.00 255.0 FORMAT "%5.1" ECU_ADDRESS 0x600008C5 /end MEASUREMENT
/begin MEASUREMENT EpmHCrS_numIncReal "Number of real increments of crankshaft wheel (without gap increments) within one crankshaft rotation" SWORD OneToOne 1 100 -32768.00 32767.00 FORMAT "%8.2" ECU_ADDRESS 0x6000792A /end MEASUREMENT
/begin MEASUREMENT EpmHCrS_numIncRealWcy "Number of real increments of crankshaft wheel (without gap increments) within one working cycle" SWORD OneToOne 1 100 -32768.00 32767.00 FORMAT "%8.2" ECU_ADDRESS 0x60013D30 /end MEASUREMENT
/begin MEASUREMENT EpmHCrS_numIncRealWcyLast "Value of EpmHCrS_numIncRealWcy minus one" SWORD OneToOne 1 100 -32768.00 32767.00 FORMAT "%8.2" ECU_ADDRESS 0x60013D32 /end MEASUREMENT
/begin MEASUREMENT EpmHCrS_numIncWcy "Number of increments of crankshaft wheel (including gap increments) within one working cycle" SWORD OneToOne 1 100 -32768.00 32767.00 FORMAT "%8.2" ECU_ADDRESS 0x500056BA /end MEASUREMENT
/begin MEASUREMENT EpmHCrS_numInc_Var "Number of increments on crankshaft wheel" UBYTE OneToOne 1 100 0.00 255.0 FORMAT "%5.1" ECU_ADDRESS 0x600008C6 /end MEASUREMENT
/begin MEASUREMENT EpmHCrS_stActEdge "Status for definition of type of active edge" UBYTE OneToOne 1 100 0.00 255.0 FORMAT "%5.1" ECU_ADDRESS 0x600008C7 /end MEASUREMENT
/begin MEASUREMENT EpmHCrS_stBufFillUpd "Status: crankshaft signal buffer not filled completely" UBYTE OneToOne 1 100 0.00 255.0 BIT_MASK 0x1 FORMAT "%5.1" ECU_ADDRESS 0x60014A3B /end MEASUREMENT
/begin MEASUREMENT EpmHCrS_stBufGapCor "Release state for increment duration separation of gap (at 1. tooth after gap)" UBYTE OneToOne 1 100 0.00 255.0 BIT_MASK 0x1 FORMAT "%5.1" ECU_ADDRESS 0x60014A3C /end MEASUREMENT
/begin MEASUREMENT EpmHCrS_stDirChg "Status: engine rotation direction of last DGI pulse changed in relation to preceding pulse" UBYTE OneToOne 1 100 0.00 255.0 FORMAT "%5.1" ECU_ADDRESS 0x7000545F /end MEASUREMENT
/begin MEASUREMENT EpmHCrS_stDirEvln "Status of direction evaluation for DGI pulses" UBYTE OneToOne 1 100 0.00 255.0 FORMAT "%5.1" ECU_ADDRESS 0x70005460 /end MEASUREMENT
/begin MEASUREMENT EpmHCrS_stDisblNewSync "Status variable: request for change of crankshaft driver to state DISABLENEWSYNC is active" UBYTE OneToOne 1 100 0.00 255.0 FORMAT "%5.1" ECU_ADDRESS 0x6000B976 /end MEASUREMENT
/begin MEASUREMENT EpmHCrS_stEdgeISRActv "Dynamical Plausibility Check of Crankshaft Increment Duration" UBYTE OneToOne 1 100 0.00 255.0 BIT_MASK 0x1 FORMAT "%5.1" ECU_ADDRESS 0x70005461 /end MEASUREMENT
/begin MEASUREMENT EpmHCrS_stEngStrt "Engine start information for the calculation of start behavior" UBYTE OneToOne 1 100 0.00 255.0 FORMAT "%5.1" ECU_ADDRESS 0x50006019 /end MEASUREMENT
/begin MEASUREMENT EpmHCrS_stFirstValTooth "Status: first valid crankshaft tooth after reset of crankshaft driver" UBYTE OneToOne 1 100 0.00 255.0 BIT_MASK 0x1 FORMAT "%5.1" ECU_ADDRESS 0x60014A3D /end MEASUREMENT
/begin MEASUREMENT EpmHCrS_stGapSubState "Sub state of crankshaft driver for gap search" UBYTE OneToOne 1 100 0.00 255.0 FORMAT "%5.1" ECU_ADDRESS 0x6000B972 /end MEASUREMENT
/begin MEASUREMENT EpmHCrS_stMainIntrptEdge "Comparison mask for check of DMA phase within main functionality of crankshaft driver" ULONG OneToOne 1 100 0.00 4294967295.00 FORMAT "%13.2" ECU_ADDRESS 0x60012F7C /end MEASUREMENT
/begin MEASUREMENT EpmHCrS_stOneAftGap "Status: actual engine position is at first tooth after gap" UBYTE OneToOne 1 100 0.00 255.0 FORMAT "%5.1" ECU_ADDRESS 0x70005462 /end MEASUREMENT
/begin MEASUREMENT EpmHCrS_stPlsMod "Status variable to indicate pulse mode or edge mode for Crankshaft Hybrid Sensor" UBYTE OneToOne 1 100 0.00 255.0 BIT_MASK 0x1 FORMAT "%5.1" ECU_ADDRESS 0x70005463 /end MEASUREMENT
/begin MEASUREMENT EpmHCrS_stRdGTMReg "Status for direct read from GTM registers" UBYTE OneToOne 1 100 0.00 255.0 BIT_MASK 0x1 FORMAT "%5.1" ECU_ADDRESS 0x70005464 /end MEASUREMENT
/begin MEASUREMENT EpmHCrS_stReqDrvrRstrt "State of crankshaft driver restart request" UBYTE OneToOne 1 100 0.00 255.0 BIT_MASK 0x1 FORMAT "%5.1" ECU_ADDRESS 0x6000B971 /end MEASUREMENT
/begin MEASUREMENT EpmHCrS_stReqDrvRst "Status: reset of crankshaft driver is requested" UBYTE OneToOne 1 100 0.00 255.0 BIT_MASK 0x1 FORMAT "%5.1" ECU_ADDRESS 0x60014A3E /end MEASUREMENT
/begin MEASUREMENT EpmHCrS_stRotDir "DGI information: rotation direction of engine" UBYTE EpmHCrS_stRotDir_t 1 100 0.00 3.00000000000 FORMAT "%13.11" ECU_ADDRESS 0x60014A3F /end MEASUREMENT
/begin MEASUREMENT EpmHCrS_stRotDirRaw "DGI information: raw value of engine rotation direction" UBYTE EpmHCrS_stRotDir_t 1 100 0.00 3.00000000000 FORMAT "%13.11" ECU_ADDRESS 0x70005465 /end MEASUREMENT
/begin MEASUREMENT EpmHCrS_stSigErr "Bit coded error state of the crankshaft signal evaluation" UWORD OneToOne 1 100 0.00 65535.00 FORMAT "%8.2" ECU_ADDRESS 0x60007926 /end MEASUREMENT
/begin MEASUREMENT EpmHCrS_stSigMode "State of HW driver of crankshaft signal evaluation" UBYTE EpmHCrS_stSigMode_State_t 1 100 0.00 9.00000000000 FORMAT "%13.11" ECU_ADDRESS 0x5000601A /end MEASUREMENT
/begin MEASUREMENT EpmHCrS_stStrtSigMode "Request for resynchronisation of crankshaft driver" UBYTE OneToOne 1 100 0.00 255.0 BIT_MASK 0x1 FORMAT "%5.1" ECU_ADDRESS 0x60014A40 /end MEASUREMENT
/begin MEASUREMENT EpmHCrS_stSymGap "Status: symmetrical distribution of gaps of crankshaft wheel" UBYTE OneToOne 1 100 0.00 255.0 FORMAT "%5.1" ECU_ADDRESS 0x6000B97B /end MEASUREMENT
/begin MEASUREMENT EpmHCrS_stSyncIniExe "Status: syncIni processes of application software are executed" UBYTE OneToOne 1 100 0.00 255.0 BIT_MASK 0x1 FORMAT "%5.1" ECU_ADDRESS 0x6000B975 /end MEASUREMENT
/begin MEASUREMENT EpmHCrS_stTmrActv "Status: timer for resynchronisation of crankshaft driver is active" UBYTE OneToOne 1 100 0.00 255.0 BIT_MASK 0x1 FORMAT "%5.1" ECU_ADDRESS 0x6000B97A /end MEASUREMENT
/begin MEASUREMENT EpmHCrS_stTwoAftGap "Status: actual engine position is at second tooth after gap" UBYTE OneToOne 1 100 0.00 255.0 FORMAT "%5.1" ECU_ADDRESS 0x70005466 /end MEASUREMENT
/begin MEASUREMENT EpmHCrS_swtCntrPosRst "Request for reset of counter system with reference to engine position" UBYTE OneToOne 1 100 0.00 255.0 BIT_MASK 0x1 FORMAT "%5.1" ECU_ADDRESS 0x6000B978 /end MEASUREMENT
/begin MEASUREMENT EpmHCrS_swtDirChgRawOld "Status: rotation direction change occurred at last crankshaft increment" UBYTE OneToOne 1 100 0.00 255.0 BIT_MASK 0x1 FORMAT "%5.1" ECU_ADDRESS 0x6000B981 /end MEASUREMENT
/begin MEASUREMENT EpmHCrS_swtDirChgRawOld2 "Status: rotation direction change occurred at second to last crankshaft increment" UBYTE OneToOne 1 100 0.00 255.0 BIT_MASK 0x1 FORMAT "%5.1" ECU_ADDRESS 0x6000B980 /end MEASUREMENT
/begin MEASUREMENT EpmHCrS_swtDirInfoOn "Status: rotation direction is switched on" UBYTE OneToOne 1 100 0.00 255.0 BIT_MASK 0x1 FORMAT "%5.1" ECU_ADDRESS 0x6000B97E /end MEASUREMENT
/begin MEASUREMENT EpmHCrS_swtEdgeOcc "Indication for edge occurred since last crankshaft timeout" UBYTE OneToOne 1 100 0.00 255.0 FORMAT "%5.1" ECU_ADDRESS 0x70005467 /end MEASUREMENT
/begin MEASUREMENT EpmHCrS_swtEnaDirPlaus "Release state for dynamical direction evaluation" UBYTE OneToOne 1 100 0.00 255.0 BIT_MASK 0x1 FORMAT "%5.1" ECU_ADDRESS 0x6000B97F /end MEASUREMENT
/begin MEASUREMENT EpmHCrS_swtGapShft "Status: Request for synchronisation shift to new gap is active" UBYTE OneToOne 1 100 0.00 255.0 FORMAT "%5.1" ECU_ADDRESS 0x60014A41 /end MEASUREMENT
/begin MEASUREMENT EpmHCrS_swtGapTout "Switch to set timeout factor for gap or normal tooth" UBYTE OneToOne 1 100 0.00 255.0 FORMAT "%5.1" ECU_ADDRESS 0x60014A42 /end MEASUREMENT
/begin MEASUREMENT EpmHCrS_swtIntrptSetUp "Request for reset of interrupt system" UBYTE OneToOne 1 100 0.00 255.0 BIT_MASK 0x1 FORMAT "%5.1" ECU_ADDRESS 0x6000B977 /end MEASUREMENT
/begin MEASUREMENT EpmHCrS_swtNoPVTDly "Control variable for delayed activation of edge suppress range (PVT check)" UBYTE OneToOne 1 100 0.00 255.0 FORMAT "%5.1" ECU_ADDRESS 0x6000B97D /end MEASUREMENT
/begin MEASUREMENT EpmHCrS_swtToutActv "Switch for activation of timeout at crankshaft signal" UBYTE OneToOne 1 100 0.00 255.0 FORMAT "%5.1" ECU_ADDRESS 0x6000B97C /end MEASUREMENT
/begin MEASUREMENT EpmHCrS_tiActv2ActvEdge "Time distance between two successive active edges" ULONG OneToOne 1 100 0.00 4294967295.00 FORMAT "%13.2" ECU_ADDRESS 0x7000515C /end MEASUREMENT
/begin MEASUREMENT EpmHCrS_tiActv2PasEdge "Time distance between active and successive passive edge" ULONG OneToOne 1 100 0.00 4294967295.00 FORMAT "%13.2" ECU_ADDRESS 0x70005160 /end MEASUREMENT
/begin MEASUREMENT EpmHCrS_tiActvEdge "Time stamp of active edge of crankshaft signal" ULONG OneToOne 1 100 0.00 4294967295.00 FORMAT "%13.2" ECU_ADDRESS 0x70005164 /end MEASUREMENT
/begin MEASUREMENT EpmHCrS_tiFilDlyActvEdge "Delay time of time stamp of active edge because of hardware filtering" ULONG OneToOne 1 100 0.00 4294967295.00 FORMAT "%13.2" ECU_ADDRESS 0x50001810 /end MEASUREMENT
/begin MEASUREMENT EpmHCrS_tiFilDlyInActvEdge "Delay time of time stamp of inactive edge because of hardware filtering" ULONG OneToOne 1 100 0.00 4294967295.00 FORMAT "%13.2" ECU_ADDRESS 0x60012F80 /end MEASUREMENT
/begin MEASUREMENT EpmHCrS_tiIgnSig "Retention time at crankshaft driver state IGNTIME (target value)" SLONG OneToOne 1 100 -2147483648.00 2147483647.00 FORMAT "%13.2" ECU_ADDRESS 0x60002B8C /end MEASUREMENT
/begin MEASUREMENT EpmHCrS_tiLstActvEdge "Active edge time stamp of last tooth" ULONG OneToOne 1 100 0.00 4294967295.00 FORMAT "%13.2" ECU_ADDRESS 0x60002B90 /end MEASUREMENT
/begin MEASUREMENT EpmHCrS_tiLstEdge "Time stamp of the last Crankshaft Edge occurred" ULONG OneToOne 1 100 0.00 4294967295.00 FORMAT "%13.2" ECU_ADDRESS 0x50001814 /end MEASUREMENT
/begin MEASUREMENT EpmHCrS_tiPasEdge "Time stamp of passive edge of crankshaft signal" ULONG OneToOne 1 100 0.00 4294967295.00 FORMAT "%13.2" ECU_ADDRESS 0x70005168 /end MEASUREMENT
/begin MEASUREMENT EpmHCrS_tiPerTn "Time duration of actual increment" SLONG OneToOne 1 100 -2147483648.00 2147483647.00 FORMAT "%13.2" ECU_ADDRESS 0x7000516C /end MEASUREMENT
/begin MEASUREMENT EpmHCrS_tiPerTnACC "Retention time at crankshaft driver state IGNTIME (actual value)" SLONG OneToOne 1 100 -2147483648.00 2147483647.00 FORMAT "%13.2" ECU_ADDRESS 0x50001818 /end MEASUREMENT
/begin MEASUREMENT EpmHCrS_tiPerTn_1 "Time duration of last increment" SLONG OneToOne 1 100 -2147483648.00 2147483647.00 FORMAT "%13.2" ECU_ADDRESS 0x70005170 /end MEASUREMENT
/begin MEASUREMENT EpmHCrS_tiPerTn_2 "Time duration of last but one increment" SLONG OneToOne 1 100 -2147483648.00 2147483647.00 FORMAT "%13.2" ECU_ADDRESS 0x70005174 /end MEASUREMENT
/begin MEASUREMENT EpmHCrS_tiPlsFwd "forward pulse width of DGI crankshaft sensor" SLONG OneToOne 1 100 -2147483648.00 2147483647.00 FORMAT "%13.2" ECU_ADDRESS 0x600003AC /end MEASUREMENT
/begin MEASUREMENT EpmHCrS_tiPlsRvs "reverse pulse width of DGI crankshaft sensor" SLONG OneToOne 1 100 -2147483648.00 2147483647.00 FORMAT "%13.2" ECU_ADDRESS 0x600003B0 /end MEASUREMENT
/begin MEASUREMENT EpmHCrS_tiStampExt "Extended bit range of crankshaft edge time stamp" ULONG OneToOne 1 100 0.00 4294967295.00 FORMAT "%13.2" ECU_ADDRESS 0x60012F84 /end MEASUREMENT
/begin MEASUREMENT EpmHCrS_tiTmrStrt "Reference time for delay of resynchronisation of crankshaft driver" ULONG InjTimeHiRes_us 1 100 0.00 214748364.750 FORMAT "%13.3" ECU_ADDRESS 0x5000181C /end MEASUREMENT
/begin MEASUREMENT EpmHCrS_tiToutEngStop "Timeout duration for engine stop state detection" ULONG InjTimeHiRes_us 1 100 0.00 214748364.750 FORMAT "%13.3" ECU_ADDRESS 0x50001820 /end MEASUREMENT
/begin MEASUREMENT EpmHwE_DMARam "Ram Array to store GTM register values in DMA Transfer" ULONG OneToOne 1 100 0.00 4294967295.00 FORMAT "%13.2" ARRAY_SIZE 6 ECU_ADDRESS 0x50001080 /end MEASUREMENT
/begin MEASUREMENT EpmIf_tCoolant "Epm engine temperature" SWORD Temp_Cels 1 100 -3549.940 3003.560 FORMAT "%8.3" ECU_ADDRESS 0x600006C0 /end MEASUREMENT
/begin MEASUREMENT EpmIf_tOil "Epm oil temperature" SWORD RBPtCel_t_0p1om273p14_1 1 100 -3549.940 3003.560 FORMAT "%8.3" ECU_ADDRESS 0x600006C6 /end MEASUREMENT
/begin MEASUREMENT EpmRRS_actIncAr_mp "Array of current CrS tooth counters in 10ms task" UWORD OneToOne 1 100 0.00 65535.00 FORMAT "%8.2" ARRAY_SIZE 16 ECU_ADDRESS 0x70009CCE /end MEASUREMENT
/begin MEASUREMENT EpmRRS_actIncBuf_mp "CrS increment counter directly from from EpmHWE buffer" SWORD OneToOne 1 100 -32768.00 32767.00 FORMAT "%8.2" ECU_ADDRESS 0x70009CCC /end MEASUREMENT
/begin MEASUREMENT EpmRRS_actIncOrig_mp "current increment counter, related to EpmHWE" UWORD OneToOne 1 100 0.00 65535.00 FORMAT "%8.2" ECU_ADDRESS 0x70009CCA /end MEASUREMENT
/begin MEASUREMENT EpmRRS_actInc_mp "current increment counter, related to 0°CrS" UWORD OneToOne 1 100 0.00 65535.00 FORMAT "%8.2" ECU_ADDRESS 0x70009CC8 /end MEASUREMENT
/begin MEASUREMENT EpmRRS_bAgDetectflgClr "Request of FCM-clear for DFC_EpmRRS" UBYTE OneToOne 1 100 0.00 255.0 FORMAT "%5.1" ECU_ADDRESS 0x6000B970 /end MEASUREMENT
/begin MEASUREMENT EpmRRS_bEngStopAg "Validity of the engine run out position detection" UBYTE EpmRRS_bEngStopAg_t 1 100 0.00 1.00000000000 FORMAT "%13.11" ECU_ADDRESS 0x60014AAE /end MEASUREMENT
/begin MEASUREMENT EpmRRS_bEngSwOff "Emergency switch off due to reverse running engine" UBYTE EpmRRS_bEngSwOff_t 1 100 0.00 1.00000000000 FORMAT "%13.11" ECU_ADDRESS 0x60014AAF /end MEASUREMENT
/begin MEASUREMENT EpmRRS_ctGapInBuffer_mp "Number of gaps in the actual section of the tooth time buffer" UBYTE OneToOne 1 100 0.00 255.0 FORMAT "%5.1" ECU_ADDRESS 0x70009F9A /end MEASUREMENT
/begin MEASUREMENT EpmRRS_ctIncEngStop_mp "engine stop tooth number" SWORD OneToOne 1 100 -32768.00 32767.00 FORMAT "%8.2" ECU_ADDRESS 0x70009CC6 /end MEASUREMENT
/begin MEASUREMENT EpmRRS_ctIncRdPos_mp "tooth counter at start position for stop start for DGI" SWORD OneToOne 1 100 -32768.00 32767.00 FORMAT "%8.2" ECU_ADDRESS 0x70009CC4 /end MEASUREMENT
/begin MEASUREMENT EpmRRS_ctNewTeethOrig_mp "Number of new teeth in the signal buffer since last call of function" UBYTE OneToOne 1 100 0.00 255.0 FORMAT "%5.1" ARRAY_SIZE 2 ECU_ADDRESS 0x70009F98 /end MEASUREMENT
/begin MEASUREMENT EpmRRS_ctNewTeeth_mp "Number of new teeth in the signal buffer since last call of function, corrected by gap teeth" UBYTE OneToOne 1 100 0.00 255.0 FORMAT "%5.1" ECU_ADDRESS 0x70009F97 /end MEASUREMENT
/begin MEASUREMENT EpmRRS_ctToothTimeout_mp "Timeout counter: EpmRRS calls without new CrS tooth (10ms)" UWORD OneToOne 1 100 0.00 65535.00 FORMAT "%8.2" ECU_ADDRESS 0x70009CC2 /end MEASUREMENT
/begin MEASUREMENT EpmRRS_GapDetected_mp "Function EpmRRS_agDetect has found a gap" UBYTE OneToOne 1 100 0.00 255.0 FORMAT "%5.1" ECU_ADDRESS 0x70009F96 /end MEASUREMENT
/begin MEASUREMENT EpmRRS_idxWrAct_mp "Index of currecnt tooth in tooth time buffer" SWORD OneToOne 1 100 -32768.00 32767.00 FORMAT "%8.2" ECU_ADDRESS 0x70009CC0 /end MEASUREMENT
/begin MEASUREMENT EpmRRS_incGapTest_mp "Increment at gap test" SWORD OneToOne 1 100 -32768.00 32767.00 FORMAT "%8.2" ECU_ADDRESS 0x70009CBE /end MEASUREMENT
/begin MEASUREMENT EpmRRS_incSynOffs_mp "Increment for angle offset: EpmSyn_phiOffs at first call of EpmRRS" SWORD OneToOne 1 100 -32768.00 32767.00 FORMAT "%8.2" ECU_ADDRESS 0x70009CBC /end MEASUREMENT
/begin MEASUREMENT EpmRRS_maxToothCondAr_mp "Array of results of the function EpmRRS_MaxToothCondition" UWORD OneToOne 1 100 0.00 65535.00 FORMAT "%8.2" ARRAY_SIZE 16 ECU_ADDRESS 0x70009C9C /end MEASUREMENT
/begin MEASUREMENT EpmRRS_phiEngPos "crankshaft angle during engine run out in working cycle" SWORD AngleCrS 1 100 -720.0000 719.9780 FORMAT "%8.4" ECU_ADDRESS 0x7000537E /end MEASUREMENT
/begin MEASUREMENT EpmRRS_phiEngRR "Angle of first engine direction change" SWORD AngleCrS 1 100 -720.0000 719.9780 FORMAT "%8.4" ECU_ADDRESS 0x60007920 /end MEASUREMENT
/begin MEASUREMENT EpmRRS_phiEngStop "engine stop angle" SWORD AngleCrS 1 100 -720.0000 719.9780 FORMAT "%8.4" ECU_ADDRESS 0x70005380 /end MEASUREMENT
/begin MEASUREMENT EpmRRS_phiGapPos "Gap positions based on the calibrated zero position" SWORD AngleCrS 1 100 -720.0000 719.9780 FORMAT "%8.4" ARRAY_SIZE 2 ECU_ADDRESS 0x500056BC /end MEASUREMENT
/begin MEASUREMENT EpmRRS_phiRdPos_mp "angle at start for stop start systems for DGI" SWORD AngleCrS 1 100 -720.0000 719.9780 FORMAT "%8.4" ECU_ADDRESS 0x70009C9A /end MEASUREMENT
/begin MEASUREMENT EpmRRS_phiRelTDC_mp "angle relative to the TDC" SWORD AngleCrS 1 100 -720.0000 719.9780 FORMAT "%8.4" ECU_ADDRESS 0x70009C98 /end MEASUREMENT
/begin MEASUREMENT EpmRRS_phiStopPos "The angle is the distance between the current crankshaft angle and the ignition TDC of cylinder one" SWORD AngleCrS 1 100 -720.0000 719.9780 FORMAT "%8.4" ECU_ADDRESS 0x70005382 /end MEASUREMENT
/begin MEASUREMENT EpmRRS_phiStopPosCyl "The angle is the distance between the current crankshaft angle and the next ignition TDC" SWORD AngleCrS 1 100 -720.0000 719.9780 FORMAT "%8.4" ECU_ADDRESS 0x70005384 /end MEASUREMENT
/begin MEASUREMENT EpmRRS_stAgDetect "State of reverse rotation detection" UBYTE EpmRRS_stAgDetect_t 1 100 0.00 2.00000000000 FORMAT "%13.11" ECU_ADDRESS 0x6000B96F /end MEASUREMENT
/begin MEASUREMENT EpmRRS_stEnable "State of switch-on conditions of reverse rotation detection" UBYTE OneToOne 1 100 0.00 255.0 BIT_MASK 0x1 FORMAT "%5.1" ECU_ADDRESS 0x6000B96D /end MEASUREMENT
/begin MEASUREMENT EpmRRS_stEngPos "status of the engine position EpmRRS_phiEngPos" UBYTE OneToOne 1 100 0.00 255.0 FORMAT "%5.1" ECU_ADDRESS 0x70005495 /end MEASUREMENT
/begin MEASUREMENT EpmRRS_stEngStop "Engine has stopped after tooth timeout" UBYTE OneToOne 1 100 0.00 255.0 FORMAT "%5.1" ECU_ADDRESS 0x6000B96C /end MEASUREMENT
/begin MEASUREMENT EpmRRS_stEngStopAg "state of stopposition EpmRRS_phiEngStop (invalid, valid, valid for phasedetection)" UBYTE EpmRRS_stEngStopAg_t 1 100 0.00 2.00000000000 FORMAT "%13.11" ECU_ADDRESS 0x600393B4 /end MEASUREMENT
/begin MEASUREMENT EpmRRS_stEngStopAg_mp "Quality/validity of engine stop angle" UBYTE EpmRRS_stEngStopAg_t 1 100 0.00 2.00000000000 FORMAT "%13.11" ECU_ADDRESS 0x70009F95 /end MEASUREMENT
/begin MEASUREMENT EpmRRS_stEngStopOld "The variable to hold previous value of EpmRRS_stEngStop" UBYTE OneToOne 1 100 0.00 255.0 FORMAT "%5.1" ECU_ADDRESS 0x70005468 /end MEASUREMENT
/begin MEASUREMENT EpmRRS_stGetBufNumPer_mp "State of request to EpmHCrS CrS signal buffer" UBYTE OneToOne 1 100 0.00 255.0 FORMAT "%5.1" ECU_ADDRESS 0x70009F94 /end MEASUREMENT
/begin MEASUREMENT EpmRRS_stPlausAngle "State of reverse angle plausiblilisation" UBYTE EpmRRS_stEngStopAg_t 1 100 0.00 2.00000000000 FORMAT "%13.11" ECU_ADDRESS 0x6000B96E /end MEASUREMENT
/begin MEASUREMENT EpmRRS_stReason_mp "Methode which has detected a reverse running engine" UBYTE OneToOne 1 100 0.00 255.0 FORMAT "%5.1" ECU_ADDRESS 0x70009F93 /end MEASUREMENT
/begin MEASUREMENT EpmRRS_stRotDir "Rotation direction of engine" UBYTE EpmRRS_stRotDir_t 1 100 0.00 3.00000000000 FORMAT "%13.11" ECU_ADDRESS 0x60010093 /end MEASUREMENT
/begin MEASUREMENT EpmRRS_stToothPerBuf_mp "State of request to read CrS buffer" UBYTE OneToOne 1 100 0.00 255.0 FORMAT "%5.1" ECU_ADDRESS 0x70009F92 /end MEASUREMENT
/begin MEASUREMENT EpmRRS_tiToothPer "Array of tooth periods" SLONG OneToOne_us 1 100 -2147483648.00 2147483647.00 FORMAT "%13.2" ARRAY_SIZE 16 ECU_ADDRESS 0x60002B4C /end MEASUREMENT
/begin MEASUREMENT EpmRRS_tiToothPerDGI_mp "Array of tooth periods from the CrS signal buffer (for DGI)" SLONG OneToOne_us 1 100 -2147483648.00 2147483647.00 FORMAT "%13.2" ARRAY_SIZE 4 ECU_ADDRESS 0x70009A50 /end MEASUREMENT
/begin MEASUREMENT EpmRRS_tiToothPerOrg "Tooth time buffer without gap correction" SLONG OneToOne_us 1 100 -2147483648.00 2147483647.00 FORMAT "%13.2" ARRAY_SIZE 16 ECU_ADDRESS 0x60002B0C /end MEASUREMENT
/begin MEASUREMENT EpmSeq_ctActivateSyncPre "Counter to track SyncPre task activation" UWORD OneToOne 1 100 0.00 65535.00 FORMAT "%8.2" ECU_ADDRESS 0x60013D34 /end MEASUREMENT
/begin MEASUREMENT EpmSeq_ctForceResync "Counter to track resynchronization trigger" UWORD OneToOne 1 100 0.00 65535.00 FORMAT "%8.2" ECU_ADDRESS 0x6000791E /end MEASUREMENT
/begin MEASUREMENT EpmSeq_ctIncNextEvent_mp "event count at time of next interrupt activation" UWORD OneToOne 1 100 0.00 65535.00 FORMAT "%8.2" ECU_ADDRESS 0x70009C90 /end MEASUREMENT
/begin MEASUREMENT EpmSeq_currentEveId_mp "Event identifier of current activation" UBYTE EpmSeq_EveId_t 1 100 0.00 17.0000000000 FORMAT "%13.10" ECU_ADDRESS 0x70009F91 /end MEASUREMENT
/begin MEASUREMENT EpmSeq_eveCount "Counter to track the requested trigger events" UWORD OneToOne 1 100 0.00 65535.00 FORMAT "%8.2" ECU_ADDRESS 0x70009C8E /end MEASUREMENT
/begin MEASUREMENT EpmSeq_EveHndlr_stErr "Error information of the current activation" ULONG OneToOne 1 100 0.00 4294967295.00 FORMAT "%13.2" ECU_ADDRESS 0x60002B08 /end MEASUREMENT
/begin MEASUREMENT EpmSeq_eveId "Id of the event which activated the OS_SyncPre_Task" UBYTE EpmSeq_EveId_t 1 100 0.00 17.0000000000 FORMAT "%13.10" ECU_ADDRESS 0x5000607A /end MEASUREMENT
/begin MEASUREMENT EpmSeq_idxIntrptData "Index of the interrupt data at the moment of active static interrupt" SWORD OneToOne 1 100 -32768.00 32767.00 FORMAT "%8.2" ECU_ADDRESS 0x50005D64 /end MEASUREMENT
/begin MEASUREMENT EpmSeq_idxIntrptDataNxt "Index of the interrupt data at the moment of next active static interrupt" SWORD OneToOne 1 100 -32768.00 32767.00 FORMAT "%8.2" ECU_ADDRESS 0x50005D66 /end MEASUREMENT
/begin MEASUREMENT EpmSeq_idxIntrptDataNxt_mp "Measurement point of next expected index of EpmSeq_StateMn for usage in case of backup mode without camshaft sensor(s)" SWORD OneToOne 1 100 -32768.00 32767.00 FORMAT "%8.2" ECU_ADDRESS 0x70009C8C /end MEASUREMENT
/begin MEASUREMENT EpmSeq_idxIntrptData_mp "Measurement point of current index of EpmSeq_StateMn for usage in case of backup mode without camshaft sensor(s)" SWORD OneToOne 1 100 -32768.00 32767.00 FORMAT "%8.2" ECU_ADDRESS 0x70009C8A /end MEASUREMENT
/begin MEASUREMENT EpmSeq_numActvIntrpt "Number of the released static interrupts" SWORD OneToOne 1 100 -32768.00 32767.00 FORMAT "%8.2" ECU_ADDRESS 0x50005D68 /end MEASUREMENT
/begin MEASUREMENT EpmSeq_numIncDiffInt "Difference between 2 synchro-interrupts in crankshafttooth" SWORD OneToOne 1 100 -32768.00 32767.00 FORMAT "%8.2" ARRAY_SIZE 2 ECU_ADDRESS 0x70005386 /end MEASUREMENT
/begin MEASUREMENT EpmSeq_numInt "type of current interrupt" UBYTE EpmSeq_numInt_Compu 1 100 0.00 38.0000000000 FORMAT "%13.10" ECU_ADDRESS 0x5000607B /end MEASUREMENT
/begin MEASUREMENT EpmSeq_numIntPrev "Type of Previous Interrupt" UBYTE EpmSeq_numInt_Compu 1 100 0.00 38.0000000000 FORMAT "%13.10" ECU_ADDRESS 0x70005496 /end MEASUREMENT
/begin MEASUREMENT EpmSeq_phiEve "Angle stamp of the current activiation event" ULONG AngleCrS 1 100 0.00 94371839.9781 FORMAT "%13.4" ECU_ADDRESS 0x500005AC /end MEASUREMENT
/begin MEASUREMENT EpmSeq_phiIntrpt "Absolute interrupt position of the active static interrupt" SWORD AngleCrS 1 100 -720.0000 719.9780 FORMAT "%8.4" ECU_ADDRESS 0x50005D6A /end MEASUREMENT
/begin MEASUREMENT EpmSeq_phiNxtInt "angle of the next syncrointerrupt" SWORD AngleCrS 1 100 0.00 719.9780 FORMAT "%8.4" ECU_ADDRESS 0x50005BDC /end MEASUREMENT
/begin MEASUREMENT EpmSeq_phiNxtInt_msg "Angle of the next syncrointerrupt" SWORD AngleCrS 1 100 0.00 719.9780 FORMAT "%8.4" ECU_ADDRESS 0x50005D6C /end MEASUREMENT
/begin MEASUREMENT EpmSeq_stCurrInt "Currently executed angle synchronous interrupt" UBYTE EpmSeq_stInt_Compu 1 100 0.00 36.0000000000 FORMAT "%13.10" ECU_ADDRESS 0x70005497 /end MEASUREMENT
/begin MEASUREMENT EpmSeq_stInt "status of sequencemanager" UBYTE EpmSeq_stInt_Compu 1 100 0.00 36.0000000000 FORMAT "%13.10" ECU_ADDRESS 0x70005469 /end MEASUREMENT
/begin MEASUREMENT EpmSeq_stIntrptGen "Information which kinds of static interrupts have to be generated" UBYTE EpmSeq_stIntrptGen_Compu 1 100 0.00 4.00000000000 FORMAT "%13.11" ECU_ADDRESS 0x5000607C /end MEASUREMENT
/begin MEASUREMENT EpmSeq_stReqIntrptGen "Information which kinds of static interrupts are requested externally" UBYTE EpmSeq_stReqIntrptGen_Compu 1 100 0.00 1.00000000000 FORMAT "%13.11" ECU_ADDRESS 0x6000B96B /end MEASUREMENT
/begin MEASUREMENT EpmSeq_stSyncPrev "Previous synchronization state" UBYTE Epm_stSync_State_t 1 100 0.00 30.0000000000 FORMAT "%13.10" ECU_ADDRESS 0x5000601B /end MEASUREMENT
/begin MEASUREMENT EpmSeq_stSyncPrev_mp "Previous synchronization state" UBYTE Epm_stSync_State_t 1 100 0.00 30.0000000000 FORMAT "%13.10" ECU_ADDRESS 0x70009F90 /end MEASUREMENT
/begin MEASUREMENT EpmSeq_SyncPreEnaMask_mp "Enable mask for SyncPre task activation" ULONG OneToOne 1 100 0.00 4294967295.00 FORMAT "%13.2" ECU_ADDRESS 0x70009A4C /end MEASUREMENT
/begin MEASUREMENT EpmSeq_tiEve "Time stamp of the current activiation event" ULONG OneToOne 1 100 0.00 4294967295.00 FORMAT "%13.2" ECU_ADDRESS 0x500005B0 /end MEASUREMENT
/begin MEASUREMENT EpmSrv_stCnvAgT2Ag_mp "Internal state of the function EpmSrv_CnvAgT2Ag" UBYTE EpmSrv_stCnvAgT2Ag_t 1 100 0.00 255.000000000 FORMAT "%13.9" ECU_ADDRESS 0x70009F8F /end MEASUREMENT
/begin MEASUREMENT EpmSyn_CaSDataI1.SigTab "Signal table with the detected camshaft segments inlet bank 1 / Signal table (Bit0..3 - Seg, Bit4 - Level, Bit5 - Gap)" UBYTE OneToOne 1 100 0.00 255.0 FORMAT "%5.1" ARRAY_SIZE 10 ECU_ADDRESS 0x5000022C /end MEASUREMENT
/begin MEASUREMENT EpmSyn_CaSDataI1.stSearch "Signal table with the detected camshaft segments inlet bank 1 / Search state (Bit0..3 - Seg, Bit4 - Level, Bit5 - Gap)" UBYTE OneToOne 1 100 0.00 255.0 FORMAT "%5.1" ARRAY_SIZE 10 ECU_ADDRESS 0x50000236 /end MEASUREMENT
/begin MEASUREMENT EpmSyn_CaSDataI1.ctLstEdge "Signal table with the detected camshaft segments inlet bank 1 / Number of measured edges from the driver" SWORD OneToOne 1 100 -32768.00 32767.00 FORMAT "%8.2" ECU_ADDRESS 0x50000240 /end MEASUREMENT
/begin MEASUREMENT EpmSyn_CaSDataI1.phiIniCaSPos "Signal table with the detected camshaft segments inlet bank 1 / Starting angle of the evaluation of the camshaft" SWORD AngleCrS 1 100 -720.0000 719.9780 FORMAT "%8.4" ECU_ADDRESS 0x50000242 /end MEASUREMENT
/begin MEASUREMENT EpmSyn_CaSDataI1.phiLstEdge "Signal table with the detected camshaft segments inlet bank 1 / Angle of the last measured edge" SWORD AngleCrS 1 100 -720.0000 719.9780 FORMAT "%8.4" ECU_ADDRESS 0x50000244 /end MEASUREMENT
/begin MEASUREMENT EpmSyn_CaSDataI1.phiSegPos "Signal table with the detected camshaft segments inlet bank 1 / Sum of the angles of the segments in the reference table to the index of correlation in the signal table" SWORD AngleCrS 1 100 -720.0000 719.9780 FORMAT "%8.4" ECU_ADDRESS 0x50000246 /end MEASUREMENT
/begin MEASUREMENT EpmSyn_CaSDataI1.numSegInSigTab "Signal table with the detected camshaft segments inlet bank 1 / Number of detected segments in the signal table" UBYTE OneToOne 1 100 0.00 255.0 FORMAT "%5.1" ECU_ADDRESS 0x50000248 /end MEASUREMENT
/begin MEASUREMENT EpmSyn_CaSDataI1.ctSigTabLstEntr "Signal table with the detected camshaft segments inlet bank 1 / points to the last entry in the signal table (-1, table is reseted and contains no valid entries)" SBYTE OneToOne 1 100 -128.0 127.0 FORMAT "%5.1" ECU_ADDRESS 0x50000249 /end MEASUREMENT
/begin MEASUREMENT EpmSyn_CaSDataI1.ctWcycle "Signal table with the detected camshaft segments inlet bank 1 / Segment counter during the working cycle" SBYTE OneToOne 1 100 -128.0 127.0 FORMAT "%5.1" ECU_ADDRESS 0x5000024A /end MEASUREMENT
/begin MEASUREMENT EpmSyn_CaSDataI1.stPreSeg "Signal table with the detected camshaft segments inlet bank 1 / Last entry in the signals table is a temporarily entry" UBYTE OneToOne 1 100 0.00 255.0 FORMAT "%5.1" ECU_ADDRESS 0x5000024B /end MEASUREMENT
/begin MEASUREMENT EpmSyn_CaSDataI1.numNewEdges "Signal table with the detected camshaft segments inlet bank 1 / Number of new edges since the last call" UBYTE OneToOne 1 100 0.00 255.0 FORMAT "%5.1" ECU_ADDRESS 0x5000024C /end MEASUREMENT
/begin MEASUREMENT EpmSyn_CaSDataI1.numMatches "Signal table with the detected camshaft segments inlet bank 1 / Number of detected correlation between signal table and reference table" SBYTE OneToOne 1 100 -128.0 127.0 FORMAT "%5.1" ECU_ADDRESS 0x5000024D /end MEASUREMENT
/begin MEASUREMENT EpmSyn_CaSDataI1.numMatchPos "Signal table with the detected camshaft segments inlet bank 1 / Index of compliance with the signal table" SBYTE OneToOne 1 100 -128.0 127.0 FORMAT "%5.1" ECU_ADDRESS 0x5000024E /end MEASUREMENT
/begin MEASUREMENT EpmSyn_ctBackwards "Number of activations of pattern matching algorithm for backwards direction" UBYTE OneToOne 1 100 0.00 255.0 FORMAT "%5.1" ECU_ADDRESS 0x6000B96A /end MEASUREMENT
/begin MEASUREMENT EpmSyn_ctEdgeWcyOfs "offset between camshaft buffer and Calibration array for the Encoded series of camshaft segments." SBYTE OneToOne 1 100 -128.0 127.0 FORMAT "%5.1" ARRAY_SIZE 1 ECU_ADDRESS 0x6000B967 /end MEASUREMENT
/begin MEASUREMENT EpmSyn_ctIncEngPos_10ms "Tooth counter current engine position" UWORD OneToOne 1 100 0.00 65535.00 FORMAT "%8.2" ECU_ADDRESS 0x700035FA /end MEASUREMENT
/begin MEASUREMENT EpmSyn_GetAngleCnt_mp "angle clock value without offset correction" SWORD AngleCrS 1 100 -720.0000 719.9780 FORMAT "%8.4" ECU_ADDRESS 0x70009C84 /end MEASUREMENT
/begin MEASUREMENT EpmSyn_numCaSSync "camshaft used for phase position detection" UBYTE OneToOne 1 100 0.00 255.0 FORMAT "%5.1" ECU_ADDRESS 0x6000B966 /end MEASUREMENT
/begin MEASUREMENT EpmSyn_phiAgClk_mp "angle clock value with offset correction" SWORD AngleCrS 1 100 -720.0000 719.9780 FORMAT "%8.4" ECU_ADDRESS 0x70009C82 /end MEASUREMENT
/begin MEASUREMENT EpmSyn_phiCaSPos "angle of camshaft position after pattern matching" SWORD AngleCrS 1 100 -720.0000 719.9780 FORMAT "%8.4" ARRAY_SIZE 1 ECU_ADDRESS 0x6000791A /end MEASUREMENT
/begin MEASUREMENT EpmSyn_phiCaSPosCorrAdap "angledifference between applicated and adapted camshaftedge during synchronisation" SWORD AngleCrS 1 100 -720.0000 719.9780 FORMAT "%8.4" ARRAY_SIZE 1 ECU_ADDRESS 0x6000791C /end MEASUREMENT
/begin MEASUREMENT EpmSyn_phiDiff "difference between camshaft and crankshaft during synchronization" SWORD AngleCrS 1 100 -720.0000 719.9780 FORMAT "%8.4" ECU_ADDRESS 0x50005D6E /end MEASUREMENT
/begin MEASUREMENT EpmSyn_phiIncCor_mp "Correction value to transform the ECU-internal angle base into the physical angle base of the engine" SWORD AngleCrS 1 100 -720.0000 719.9780 FORMAT "%8.4" ECU_ADDRESS 0x70009C88 /end MEASUREMENT
/begin MEASUREMENT EpmSyn_phiInt "Position of syncro interrupt" SWORD AngleCrS 1 100 -720.0000 719.9780 FORMAT "%8.4" ECU_ADDRESS 0x50005D70 /end MEASUREMENT
/begin MEASUREMENT EpmSyn_phiOffs "Synchronisation offset" SWORD AngleCrS 1 100 -720.0000 719.9780 FORMAT "%8.4" ECU_ADDRESS 0x600146C8 /end MEASUREMENT
/begin MEASUREMENT EpmSyn_phiOffsCor "correction of the synchronisation offset EpmSyn_phiOffsCor" SWORD AngleCrS 1 100 -720.0000 719.9780 FORMAT "%8.4" ECU_ADDRESS 0x50005BDE /end MEASUREMENT
/begin MEASUREMENT EpmSyn_phiSetPos_mp "Absolute engine position based on cam-shaft or stop position information" SWORD AngleCrS 1 100 -720.0000 719.9780 FORMAT "%8.4" ECU_ADDRESS 0x70009C86 /end MEASUREMENT
/begin MEASUREMENT EpmSyn_stCaSEval "state of camshaft evaluation" UBYTE EpmSyn_stCaSEvalComp 1 100 0.00 4.00000000000 FORMAT "%13.11" ECU_ADDRESS 0x5000601C /end MEASUREMENT
/begin MEASUREMENT EpmSyn_stCaSPos "state of camshaft position" UBYTE EpmSyn_stCaSPosComp 1 100 0.00 20.0000000000 FORMAT "%13.10" ARRAY_SIZE 1 ECU_ADDRESS 0x6000B965 /end MEASUREMENT
/begin MEASUREMENT EpmSyn_stCaSPosReset "Camshaft evaluation is resetted" UBYTE OneToOne 1 100 0.00 255.0 FORMAT "%5.1" ARRAY_SIZE 1 ECU_ADDRESS 0x6000B969 /end MEASUREMENT
/begin MEASUREMENT EpmSyn_stCaSPosValid "EpmSyn_stCaSPos is valid" UBYTE OneToOne 1 100 0.00 255.0 FORMAT "%5.1" ARRAY_SIZE 1 ECU_ADDRESS 0x6000B964 /end MEASUREMENT
/begin MEASUREMENT EpmSyn_stCrSPos "state of crankshaft position" UBYTE EpmSyn_stCrSPos_State_t 1 100 0.00 3.00000000000 FORMAT "%13.11" ECU_ADDRESS 0x5000607D /end MEASUREMENT
/begin MEASUREMENT EpmSyn_stCrSPosErr "error of crankshaft position" UWORD OneToOne 1 100 0.00 65535.00 FORMAT "%8.2" ECU_ADDRESS 0x6000A014 /end MEASUREMENT
/begin MEASUREMENT EpmSyn_stDiFirstGapSyncn "Status of synchronization at first Gap is disabled or not" UBYTE OneToOne 1 100 0.00 255.0 FORMAT "%5.1" ARRAY_SIZE 1 ECU_ADDRESS 0x6000B968 /end MEASUREMENT
/begin MEASUREMENT EpmSyn_stGapPos "1=use of gap position for phase verification" UBYTE OneToOne 1 100 0.00 255.0 FORMAT "%5.1" ECU_ADDRESS 0x5000601D /end MEASUREMENT
/begin MEASUREMENT EpmSyn_stPostDrvMemd "Status variable to indicate whether the camshaft level information is to be used for synchronization during idle start" UBYTE OneToOne 1 100 0.00 255.0 BIT_MASK 0x1 FORMAT "%5.1" ECU_ADDRESS 0x60035689 /end MEASUREMENT
/begin MEASUREMENT EpmSyn_stRR "state of reverse running detection with camshaft pattern matching" UBYTE EpmSyn_stRRComp 1 100 0.00 1.00000000000 FORMAT "%13.11" ARRAY_SIZE 1 ECU_ADDRESS 0x60010092 /end MEASUREMENT
/begin MEASUREMENT EpmSyn_stSuppRvsRotCASI1_MP "Reverse rotation detection on camshaft I1 locked" UBYTE OneToOne 1 100 0.00 255.0 FORMAT "%5.1" ECU_ADDRESS 0x70009F8E /end MEASUREMENT
/begin MEASUREMENT EpmTDC_agCylCorrd "corrected TDC position" SWORD AngleCrS 1 100 -720.0000 719.9780 FORMAT "%8.4" ARRAY_SIZE 4 ECU_ADDRESS 0x50000250 /end MEASUREMENT
/begin MEASUREMENT EpmTDC_agCylCorrn "corrections (static and dynamic) of the TDCs in relation to the calibrated reference position of the TDCs (Epm_phiTdc_C)" SWORD AngleCrS 1 100 -720.0000 719.9780 FORMAT "%8.4" ARRAY_SIZE 4 ECU_ADDRESS 0x50000258 /end MEASUREMENT
/begin MEASUREMENT EpmTDC_agOffsCorrn "corrections (static and dynamic) of the TDCs in relation to the calibrated reference position of the TDCs (Epm_phiTdc_C) with influence for the acquisition of the camshaft position" SWORD AngleCrS 1 100 -720.0000 719.9780 FORMAT "%8.4" ECU_ADDRESS 0x500007DE /end MEASUREMENT
/begin MEASUREMENT Epm_agAbsltFirstSyncn "The absolute engine position at the point of synchronization." SWORD AngleCrS 1 100 -720.0000 719.9780 FORMAT "%8.4" ECU_ADDRESS 0x60009D54 /end MEASUREMENT
/begin MEASUREMENT Epm_bDnEngHiResAllw_mp "environmental conditions allow High resolution gradient calculation" UBYTE OneToOne 1 100 0.00 255.0 BIT_MASK 0x1 FORMAT "%5.1" ECU_ADDRESS 0x7000A2B0 /end MEASUREMENT
/begin MEASUREMENT Epm_bReSyncHiResGrd "freeze of gradient calculation after SyncIni and engine speed calculation is prevented" UBYTE OneToOne 1 100 0.00 255.0 BIT_MASK 0x1 FORMAT "%5.1" ECU_ADDRESS 0x5000607E /end MEASUREMENT
/begin MEASUREMENT Epm_bTrans2Wait_mp "status flag to indicate transition back to WAIT state" UBYTE OneToOne 1 100 0.00 255.0 FORMAT "%5.1" ECU_ADDRESS 0x70009F8D /end MEASUREMENT
/begin MEASUREMENT Epm_ctAPTLowSpd "Copy of crankshaft increment base counter (EpmHCrS_ctAPTPos) from LowSpd calculation raster" SWORD OneToOne 1 100 -32768.00 32767.00 FORMAT "%8.2" ECU_ADDRESS 0x60007914 /end MEASUREMENT
/begin MEASUREMENT Epm_ctCyl "EPM (Engine Position Management) software cylinder counter" UBYTE OneToOne 1 100 0.00 255.0 FORMAT "%5.1" ECU_ADDRESS 0x60014AB0 /end MEASUREMENT
/begin MEASUREMENT Epm_ctCylLoc "Epm_OpMode local cylinder counter used for backup mode without camshaft sensor(s)" UBYTE OneToOne 1 100 0.00 255.0 FORMAT "%5.1" ECU_ADDRESS 0x6000B961 /end MEASUREMENT
/begin MEASUREMENT Epm_ctGapLowSpd "Copy of crankshaft gap reference counter (EpmHCrS_ctGapRef) from LowSpd calculation raster" SWORD OneToOne 1 100 -32768.00 32767.00 FORMAT "%8.2" ECU_ADDRESS 0x60007912 /end MEASUREMENT
/begin MEASUREMENT Epm_ctIncDiff "difference of current increment counter to counter value 1ms before" SWORD OneToOne 1 100 -32768.00 32767.00 FORMAT "%8.2" ECU_ADDRESS 0x60009D52 /end MEASUREMENT
/begin MEASUREMENT Epm_ctIncDiffPrev "Number of nominal increments of last but one physical increment" SWORD OneToOne 1 100 -32768.00 32767.00 FORMAT "%8.2" ECU_ADDRESS 0x60007910 /end MEASUREMENT
/begin MEASUREMENT Epm_ctIncLowSpd "current tooth counter for low speed calculation" SWORD OneToOne 1 100 -32768.00 32767.00 FORMAT "%8.2" ECU_ADDRESS 0x60009D50 /end MEASUREMENT
/begin MEASUREMENT Epm_ctReSync "counter of re-synchronisations" UBYTE OneToOne 1 100 0.00 255.0 FORMAT "%5.1" ECU_ADDRESS 0x6000B95D /end MEASUREMENT
/begin MEASUREMENT Epm_dnEng "Enginespeed-gradient calculated over current crankshaft-segment (S0-S0 oder S1-S1)" SWORD EngNGrd 1 100 -16384.00 16383.50 FORMAT "%8.2" ECU_ADDRESS 0x7000538A /end MEASUREMENT
/begin MEASUREMENT Epm_dnEngAvg "Engine speed gradient calculated over one working cycle" SWORD EngNGrd 1 100 -16384.00 16383.50 FORMAT "%8.2" ECU_ADDRESS 0x6001484A /end MEASUREMENT
/begin MEASUREMENT Epm_dnEngAvgFlt "filtered engine speed gradient averaged over one cycle" SWORD EngNGrd 1 100 -16384.00 16383.50 FORMAT "%8.2" ECU_ADDRESS 0x6001484C /end MEASUREMENT
/begin MEASUREMENT Epm_dnEngFlt "Filtered engine speed gradient calculated over current crankshaft-segment (S0-S0 oder S1-S1)" SWORD EngNGrd 1 100 -16384.00 16383.50 FORMAT "%8.2" ECU_ADDRESS 0x60014850 /end MEASUREMENT
/begin MEASUREMENT Epm_dnEngHiRes "Engine speed gradient with resolution of 0.125 rpm per bit" SLONG RBPtCel_dn_0p125_1 1 100 -268435456.000 268435455.875 FORMAT "%13.3" ECU_ADDRESS 0x7000524C /end MEASUREMENT
/begin MEASUREMENT Epm_dnEngLowSpd "speed gradient of the speeds of the last two tooth periods and the average segment time from theses tooth periods" SWORD EngNGrd 1 100 -16384.00 16383.50 FORMAT "%8.2" ECU_ADDRESS 0x60009D4E /end MEASUREMENT
/begin MEASUREMENT Epm_dnEngLowSpdFl "speed gradient for low engine speed range in floating point format" FLOAT32_IEEE OneToOne 1 100 -20000.0000 20000.0000 FORMAT "%10.4" ECU_ADDRESS 0x50004F18 /end MEASUREMENT
/begin MEASUREMENT Epm_idxRdLowSpd "Actual value of crankshaft buffer read index from LowSpd calculation raster" SWORD OneToOne 1 100 -32768.00 32767.00 FORMAT "%8.2" ECU_ADDRESS 0x6000790E /end MEASUREMENT
/begin MEASUREMENT Epm_Ini_stFinalInit "Final release of the EPM-Interrupts after ECU Init" UBYTE OneToOne 1 100 0.00 255.0 FORMAT "%5.1" ECU_ADDRESS 0x6000B962 /end MEASUREMENT
/begin MEASUREMENT Epm_nEng "" SWORD EngN 1 100 -16384.00 16383.50 FORMAT "%8.2" ECU_ADDRESS 0x60014854 /end MEASUREMENT
/begin MEASUREMENT Epm_nEng10ms "engine speed calculated in 10ms" SWORD EngN 1 100 -16384.00 16383.50 FORMAT "%8.2" ECU_ADDRESS 0x60014856 /end MEASUREMENT
/begin MEASUREMENT Epm_nEng10msInt "engine speed calculated in 10ms" SWORD EngN 1 100 -16384.00 16383.50 FORMAT "%8.2" ECU_ADDRESS 0x700052A4 /end MEASUREMENT
/begin MEASUREMENT Epm_nEngCurr "engine speed for half cylinder segment" SWORD EngN 1 100 -16384.00 16383.50 FORMAT "%8.2" ECU_ADDRESS 0x7000538C /end MEASUREMENT
/begin MEASUREMENT Epm_nEngDiff "Difference fo enginespeeds calculated over current crankshaft-segment (S0-S0 oder S1-S1)" SWORD EngN 1 100 -16384.00 16383.50 FORMAT "%8.2" ECU_ADDRESS 0x50005D7A /end MEASUREMENT
/begin MEASUREMENT Epm_nEngDiffAvg "Difference of enginespeeds calculated over one working cycle for the same cylinder number" SWORD EngN 1 100 -16384.00 16383.50 FORMAT "%8.2" ECU_ADDRESS 0x7000538E /end MEASUREMENT
/begin MEASUREMENT Epm_nEngHiRes "New Engine speed calculation with resolution of 0.125 rpm per bit" SLONG RBPtCel_n_0p125_1 1 100 -268435456.000 268435455.875 FORMAT "%13.3" ECU_ADDRESS 0x50004F1C /end MEASUREMENT
/begin MEASUREMENT Epm_nEngHiResPrev_mp "calculated high-resolution speed for the preceeding segment" SLONG RBPtCel_n_0p125_1 1 100 -268435456.000 268435455.875 FORMAT "%13.3" ECU_ADDRESS 0x7000A2AC /end MEASUREMENT
/begin MEASUREMENT Epm_nEngInc10ms "One tooth engine speed" SWORD EngN 1 100 -16384.00 16383.50 FORMAT "%8.2" ECU_ADDRESS 0x60014858 /end MEASUREMENT
/begin MEASUREMENT Epm_nEngLowSpd "engine speed for low speed range" SWORD EngN 1 100 -16384.00 16383.50 FORMAT "%8.2" ECU_ADDRESS 0x60009D4C /end MEASUREMENT
/begin MEASUREMENT Epm_nEngLowSpdXP "Every 1ms extrapolated low engine speed after last tooth period has expired" SWORD EngN 1 100 -16384.00 16383.50 FORMAT "%8.2" ECU_ADDRESS 0x60009D4A /end MEASUREMENT
/begin MEASUREMENT Epm_nEngLRes "engine speed with low resolution" UBYTE EngN_LRes 1 100 0.00 10200. FORMAT "%5.0" ECU_ADDRESS 0x60014AB1 /end MEASUREMENT
/begin MEASUREMENT Epm_nEngOldS0_mp "Engine speed of last S0-Synchro" SWORD EngN 1 100 -16384.00 16383.50 FORMAT "%8.2" ECU_ADDRESS 0x70009C7C /end MEASUREMENT
/begin MEASUREMENT Epm_nEngOldS1_mp "Engine speed of last S1-Synchro" SWORD EngN 1 100 -16384.00 16383.50 FORMAT "%8.2" ECU_ADDRESS 0x70009C7A /end MEASUREMENT
/begin MEASUREMENT Epm_nEngRaw "Raw engine speed for OBD" SWORD EngN 1 100 -16384.00 16383.50 FORMAT "%8.2" ECU_ADDRESS 0x6001485A /end MEASUREMENT
/begin MEASUREMENT Epm_nEngReal1ms "Low floating point engine speed for gradient calculation" FLOAT32_IEEE EngN_float 1 100 -10000.0000 10000.0000 FORMAT "%10.4" ECU_ADDRESS 0x60003B10 /end MEASUREMENT
/begin MEASUREMENT Epm_nEngSeg_mp "engine speed calculated with EpmSpd_GetSegNEng" SWORD EngN 1 100 -16384.00 16383.50 FORMAT "%8.2" ECU_ADDRESS 0x70009C7E /end MEASUREMENT
/begin MEASUREMENT Epm_nEngTooth10ms "engine speed from 6 tooth periods, calculated all 10ms" SWORD EngN 1 100 -16384.00 16383.50 FORMAT "%8.2" ECU_ADDRESS 0x6001485C /end MEASUREMENT
/begin MEASUREMENT Epm_nEngVerify "Engine speed at transition to verification state: EPM_MODE_VERIFY" SWORD EngN 1 100 -16384.00 16383.50 FORMAT "%8.2" ECU_ADDRESS 0x500056C0 /end MEASUREMENT
/begin MEASUREMENT Epm_nLowSpdMax "Maximum threshold for calculation of LowSpd engine speed values" SWORD EngN 1 100 -16384.00 16383.50 FORMAT "%8.2" ECU_ADDRESS 0x6000790C /end MEASUREMENT
/begin MEASUREMENT Epm_nrInctFirstSyncn "The number of crankshaft teeth from engine start till synchronization" ULONG OneToOne 1 100 0.00 4294967295.00 FORMAT "%13.2" ECU_ADDRESS 0x50004F20 /end MEASUREMENT
/begin MEASUREMENT Epm_numCyl "Real number of cylinder" UBYTE OneToOne 1 100 0.00 255.0 FORMAT "%5.1" ECU_ADDRESS 0x70005498 /end MEASUREMENT
/begin MEASUREMENT Epm_numIntLoc "Epm_OpMode local interrupt type used for backup mode without camshaft sensor(s)" UBYTE EpmSeq_numInt_Compu 1 100 0.00 38.0000000000 FORMAT "%13.10" ECU_ADDRESS 0x6000B960 /end MEASUREMENT
/begin MEASUREMENT Epm_numValidTeeth_mp "Measurement point of number of valid CrS teeth in buffer" SWORD OneToOne 1 100 -32768.00 32767.00 FORMAT "%8.2" ECU_ADDRESS 0x70009C80 /end MEASUREMENT
/begin MEASUREMENT Epm_phiAbsPrev_mp "calculated absolut position of the preceeding segment" SWORD AngleCrS 1 100 -720.0000 719.9780 FORMAT "%8.4" ECU_ADDRESS 0x7000A2AA /end MEASUREMENT
/begin MEASUREMENT Epm_phiBufLenMin_mp "minimum needed segment length in CrS-buffer" SWORD AngleCrS 1 100 -720.0000 719.9780 FORMAT "%8.4" ECU_ADDRESS 0x7000A2A8 /end MEASUREMENT
/begin MEASUREMENT Epm_phiBufLen_mp "current available segement length in CrS-Buffer" SWORD AngleCrS 1 100 -720.0000 719.9780 FORMAT "%8.4" ECU_ADDRESS 0x7000A2A6 /end MEASUREMENT
/begin MEASUREMENT Epm_phiCurrPos "Synchro-current CrS angle" SWORD AngleCrS 1 100 -720.0000 719.9780 FORMAT "%8.4" ECU_ADDRESS 0x700052A6 /end MEASUREMENT
/begin MEASUREMENT Epm_phiCyl "Absolut angle of the combustion TDCs" SWORD AngleCrS 1 100 -720.0000 719.9780 FORMAT "%8.4" ARRAY_SIZE 4 ECU_ADDRESS 0x500056C2 /end MEASUREMENT
/begin MEASUREMENT Epm_phiDiffRRS "Difference between angle set by engine stop position detection and angle at CrS gap" SWORD AngleCrS 1 100 -720.0000 719.9780 FORMAT "%8.4" ECU_ADDRESS 0x60009D48 /end MEASUREMENT
/begin MEASUREMENT Epm_phiDiffTDC "distance between two cylinders" SWORD AngleCrS 1 100 -720.0000 719.9780 FORMAT "%8.4" ECU_ADDRESS 0x60009D46 /end MEASUREMENT
/begin MEASUREMENT Epm_phiIgrTeethReSync "angle equivalent for number of teeth to be ignored from the engine speed calculations after a crank error" SWORD AngleCrS 1 100 -720.0000 719.9780 FORMAT "%8.4" ECU_ADDRESS 0x500007E0 /end MEASUREMENT
/begin MEASUREMENT Epm_Reset_RSTDetected_u32 "marker for power on detected" ULONG OneToOne 1 100 0.00 4294967295.00 FORMAT "%13.2" ECU_ADDRESS 0x600340D8 /end MEASUREMENT
/begin MEASUREMENT Epm_SensTypCrS "Type of crankshaft sensor" UBYTE Epm_SensTypCrS_t 1 100 0.00 2.00000000000 FORMAT "%13.11" ECU_ADDRESS 0x60014A43 /end MEASUREMENT
/begin MEASUREMENT Epm_stALEDiag "State to request (=1) a diagnosis of the used engine stop position" UBYTE OneToOne 1 100 0.00 255.0 FORMAT "%5.1" ECU_ADDRESS 0x6000B95F /end MEASUREMENT
/begin MEASUREMENT Epm_stCaSNoErr_mp "Result of check for no CaS errors" UBYTE OneToOne 1 100 0.00 255.0 FORMAT "%5.1" ECU_ADDRESS 0x70009F8C /end MEASUREMENT
/begin MEASUREMENT Epm_stCheckStopPosValid_mp "Bit coded state-measurement-point of the validity check of the engine stop position" UBYTE OneToOne 1 100 0.00 255.0 FORMAT "%5.1" ECU_ADDRESS 0x70009F8B /end MEASUREMENT
/begin MEASUREMENT Epm_stCmbTestReq "state for request a combustion test" UBYTE Epm_stCmbTestReq_State_t 1 100 0.00 10.0000000000 FORMAT "%13.10" ECU_ADDRESS 0x60010091 /end MEASUREMENT
/begin MEASUREMENT Epm_stDirLowSpd "Status: No direction change inside last crankshaft increment" UBYTE OneToOne 1 100 0.00 255.0 BIT_MASK 0x1 FORMAT "%5.1" ECU_ADDRESS 0x6000B95B /end MEASUREMENT
/begin MEASUREMENT Epm_stDirstaleReady "ready status of direct start" UBYTE Epm_stDirstaleReady_State_t 1 100 0.00 10.0000000000 FORMAT "%13.10" ECU_ADDRESS 0x70005499 /end MEASUREMENT
/begin MEASUREMENT Epm_stDSMRdyOpMode "DSM init state used by the FC" UBYTE OneToOne 1 100 0.00 255.0 BIT_MASK 0x1 FORMAT "%5.1" ECU_ADDRESS 0x5000601E /end MEASUREMENT
/begin MEASUREMENT Epm_stEngPos "Indicates whether ECU is tracking the engine position permanently" UBYTE EPM_STENGPOS_VERB 1 100 0.00 1.00000000000 FORMAT "%13.11" ECU_ADDRESS 0x7000549A /end MEASUREMENT
/begin MEASUREMENT Epm_stHiResGrdMsk_mp "state mask of the high-resolution gredient calculation" UBYTE OneToOne 1 100 0.00 255.0 FORMAT "%5.1" ECU_ADDRESS 0x7000A2A4 /end MEASUREMENT
/begin MEASUREMENT Epm_stLowSpdActv "Status: LowSpd calculation active" UBYTE OneToOne 1 100 0.00 255.0 BIT_MASK 0x1 FORMAT "%5.1" ECU_ADDRESS 0x6000B95A /end MEASUREMENT
/begin MEASUREMENT Epm_stLowSpdXP "State of the extrapolated speed calculation" UBYTE Epm_stExtraPol_t 1 100 0.00 3.00000000000 FORMAT "%13.11" ECU_ADDRESS 0x60010090 /end MEASUREMENT
/begin MEASUREMENT Epm_stOpMode "state of EPM (Engine Position Management) operation mode" UBYTE Epm_stOpMode_State_t 1 100 1.0000000000 60.0000000000 FORMAT "%13.10" ECU_ADDRESS 0x60014AB3 /end MEASUREMENT
/begin MEASUREMENT Epm_stPBVarInit "Status of the PB initialisation" UBYTE OneToOne 1 100 0.00 255.0 FORMAT "%5.1" ECU_ADDRESS 0x600008C9 /end MEASUREMENT
/begin MEASUREMENT Epm_stPosDGI "State of availability / usage of the DGI stop position" UBYTE Epm_stPosDGI_State_t 1 100 0.00 1.00000000000 FORMAT "%13.11" ECU_ADDRESS 0x6000B95C /end MEASUREMENT
/begin MEASUREMENT Epm_stReSync "State to indicate the SynIni ocurrance due to crank error to avoid Engine speed calculations upto calibrated number of teeth" UBYTE OneToOne 1 100 0.00 255.0 BIT_MASK 0x1 FORMAT "%5.1" ECU_ADDRESS 0x60014AB4 /end MEASUREMENT
/begin MEASUREMENT Epm_stReSyncReasonInt "Reason of re-synchronisation loss of synchronisation" UBYTE Epm_stReSyncReason_State_t 1 100 0.00 17.0000000000 FORMAT "%13.10" ECU_ADDRESS 0x5000601F /end MEASUREMENT
/begin MEASUREMENT Epm_stReSyncReason_mp "Reason of re-synchronisation / loss of synchronisation" UBYTE Epm_stReSyncReason_State_t 1 100 0.00 17.0000000000 FORMAT "%13.10" ECU_ADDRESS 0x70009F8A /end MEASUREMENT
/begin MEASUREMENT Epm_stSigModeLst_mp "measurement point for copy of HCrS state in Last 10ms raster" UBYTE OneToOne 1 100 0.00 255.0 FORMAT "%5.1" ECU_ADDRESS 0x70009F89 /end MEASUREMENT
/begin MEASUREMENT Epm_stSpd "Selection of the engine speed" UBYTE Epm_stSpd_t 1 100 0.00 4.00000000000 FORMAT "%13.11" ECU_ADDRESS 0x60014AB5 /end MEASUREMENT
/begin MEASUREMENT Epm_stSupressIni "Status is set to prevent initialization of EPM-functions in case of forced synchronization loss" UBYTE default 1 100 0.00 255.0 BIT_MASK 0x1 FORMAT "%5.1" ECU_ADDRESS 0x70003618 /end MEASUREMENT
/begin MEASUREMENT Epm_stSync "state of synchronization" UBYTE Epm_stSync_State_t 1 100 0.00 30.0000000000 FORMAT "%13.10" ECU_ADDRESS 0x7000549B /end MEASUREMENT
/begin MEASUREMENT Epm_stTestInj "Backup with defect camshaft signal: result of sync with help of test injections" UBYTE OneToOne 1 100 0.00 255.0 FORMAT "%5.1" ECU_ADDRESS 0x6000B95E /end MEASUREMENT
/begin MEASUREMENT Epm_tiCalcPeriodLowSpd "Time since the last calculation of the speed nEngLowSpd" SLONG OneToOne_us 1 100 -2147483648.00 2147483647.00 FORMAT "%13.2" ECU_ADDRESS 0x50004F24 /end MEASUREMENT
/begin MEASUREMENT Epm_tiFirstSyncn "The time taken for synchronization, i.e. time interval from the engine start to synchronization" ULONG OneToOne_ms 1 100 0.00 4294967295.00 FORMAT "%13.2" ECU_ADDRESS 0x50004F28 /end MEASUREMENT
/begin MEASUREMENT Epm_tiLockReSync_mp "Value of timer to stay in Mode EPM_MODE_LOCKRESYNC" SWORD Time_ms 1 100 -327680.0 327670.0 FORMAT "%8.1" ECU_ADDRESS 0x60007918 /end MEASUREMENT
/begin MEASUREMENT Epm_tiLowSpd2Zero "Timeout threshold for resetting LowSpd engine speeds to zero after last received increment" SLONG OneToOne_us 1 100 -2147483648.00 2147483647.00 FORMAT "%13.2" ECU_ADDRESS 0x60002B04 /end MEASUREMENT
/begin MEASUREMENT Epm_tiSegLowSpd "Segment time of one CrS tooth for low speed calculation" SLONG OneToOne_us 1 100 -2147483648.00 2147483647.00 FORMAT "%13.2" ECU_ADDRESS 0x60003AE4 /end MEASUREMENT
/begin MEASUREMENT Epm_tiSegLowSpdPrev "Duration of last but one increment of LowSpd gradient calculation" SLONG OneToOne_us 1 100 -2147483648.00 2147483647.00 FORMAT "%13.2" ECU_ADDRESS 0x50001824 /end MEASUREMENT
/begin MEASUREMENT Epm_tiSegNTEETH_mp "Measurement point of segment time for angle NTEETH (6) teeth" SLONG OneToOne_us 1 100 -2147483648.00 2147483647.00 FORMAT "%13.2" ECU_ADDRESS 0x70009A48 /end MEASUREMENT
/begin MEASUREMENT Epm_tiSegOfs_mp "calculated duration betwenn angular center points of two associated high-resolution speed segments" SLONG RBPtCel_ti_50p0_1 1 100 -107374182400. 107374182350. FORMAT "%13.0" ECU_ADDRESS 0x7000A2A0 /end MEASUREMENT
/begin MEASUREMENT Epm_tiSegONETOOTH_mp "Measurement point of segment time for single CrS tooth" SLONG OneToOne_us 1 100 -2147483648.00 2147483647.00 FORMAT "%13.2" ECU_ADDRESS 0x70009A44 /end MEASUREMENT
/begin MEASUREMENT Epm_tiSegPARTSEG_mp "Measurement point of segment time for a cylinder segment: PARTSEG" SLONG OneToOne_us 1 100 -2147483648.00 2147483647.00 FORMAT "%13.2" ECU_ADDRESS 0x70009A40 /end MEASUREMENT
/begin MEASUREMENT Epm_tiSegPrev_mp "calculated duration for the preceeding segment" SLONG RBPtCel_ti_50p0_1 1 100 -107374182400. 107374182350. FORMAT "%13.0" ECU_ADDRESS 0x7000A29C /end MEASUREMENT
/begin MEASUREMENT Epm_tiSegRaw_mp "raw value segment time of one CrS revolution for OBD" SLONG OneToOne_us 1 100 -2147483648.00 2147483647.00 FORMAT "%13.2" ECU_ADDRESS 0x70009A3C /end MEASUREMENT
/begin MEASUREMENT Epm_tiSpd2Zero "Timeout timer until engine speed will set to zero" UWORD Time_ms 1 100 0.00 655350.0 FORMAT "%8.1" ECU_ADDRESS 0x60007916 /end MEASUREMENT
/begin MEASUREMENT Epm_tiTimeoutLowSpd "Timeout in 1ms after last CrS-edge" SLONG OneToOne_us 1 100 -2147483648.00 2147483647.00 FORMAT "%13.2" ECU_ADDRESS 0x60002B00 /end MEASUREMENT
/begin MEASUREMENT ESC_agSyncPreActvn "Angle position at activation of SyncPre task" SWORD AngleCrS 1 100 -720.0000 719.9780 FORMAT "%8.4" ECU_ADDRESS 0x6000790A /end MEASUREMENT
/begin MEASUREMENT ESC_cntStrtSyncPre "Counter for the to be activated OS_BswStart_SyncPre tasks to control the multiple activation of syncpre tasks" UBYTE OneToOne 1 100 0.00 255.0 FORMAT "%5.1" ECU_ADDRESS 0x5000605D /end MEASUREMENT
/begin MEASUREMENT ESC_dataMaxLoadS0GdiEnvram "Lifetime maximum task load of direct injection calculation in S0 Synchro in" ULONG Prc_q0p01_COMPU 1 100 0.00 42949672.9500 FORMAT "%13.4" ECU_ADDRESS 0x600393B0 /end MEASUREMENT
/begin MEASUREMENT ESC_dataMaxLoadS1GdiEnvram "Lifetime maximum task load of direct injection calculation in S1 Synchro in" ULONG Prc_q0p01_COMPU 1 100 0.00 42949672.9500 FORMAT "%13.4" ECU_ADDRESS 0x600393AC /end MEASUREMENT
/begin MEASUREMENT ESC_dataMaxTskLoadS0Envram "Lifetime Maximum task loading of Sync S0 task chain in" ULONG Prc_q0p01_COMPU 1 100 0.00 42949672.9500 FORMAT "%13.4" ECU_ADDRESS 0x600393A8 /end MEASUREMENT
/begin MEASUREMENT ESC_dataMaxTskLoadS1Envram "Lifetime maximum task loading of Sync S1 task chain in" ULONG Prc_q0p01_COMPU 1 100 0.00 42949672.9500 FORMAT "%13.4" ECU_ADDRESS 0x600393A4 /end MEASUREMENT
/begin MEASUREMENT ESC_dataS0GdiCalcnLoad "Task load of direct injection calculation in S0 Synchro in" UWORD Prc_q0p01_COMPU 1 100 0.00 655.3500 FORMAT "%8.4" ECU_ADDRESS 0x60007908 /end MEASUREMENT
/begin MEASUREMENT ESC_dataS0GdiCalcnMaxLoad "Maximum task load of direct injection calculation in S0 Synchro in" UWORD Prc_q0p01_COMPU 1 100 0.00 655.3500 FORMAT "%8.4" ECU_ADDRESS 0x60007906 /end MEASUREMENT
/begin MEASUREMENT ESC_dataS1GdiCalcnLoad "Task load of direct injection calculation in S1 Synchro in" UWORD Prc_q0p01_COMPU 1 100 0.00 655.3500 FORMAT "%8.4" ECU_ADDRESS 0x60007904 /end MEASUREMENT
/begin MEASUREMENT ESC_dataS1GdiCalcnMaxLoad "Maximum task load of direct injection calculation in S1 Synchro in" UWORD Prc_q0p01_COMPU 1 100 0.00 655.3500 FORMAT "%8.4" ECU_ADDRESS 0x60007902 /end MEASUREMENT
/begin MEASUREMENT ESC_dataSyncS0MaxTskLoad "Maximum task load of Sync S0 task chain in" UWORD Prc_q0p01_COMPU 1 100 0.00 655.3500 FORMAT "%8.4" ECU_ADDRESS 0x60007900 /end MEASUREMENT
/begin MEASUREMENT ESC_dataSyncS0TskLoad "Task loading of SyncS0 task chain" UWORD Prc_q0p01_COMPU 1 100 0.00 655.3500 FORMAT "%8.4" ECU_ADDRESS 0x600078FE /end MEASUREMENT
/begin MEASUREMENT ESC_dataSyncS1MaxTskLoad "Maximum task load of Sync S1 task chain in" UWORD Prc_q0p01_COMPU 1 100 0.00 655.3500 FORMAT "%8.4" ECU_ADDRESS 0x600078FC /end MEASUREMENT
/begin MEASUREMENT ESC_dataSyncS1TskLoad "Task loading of SyncS1 task chain" UWORD Prc_q0p01_COMPU 1 100 0.00 655.3500 FORMAT "%8.4" ECU_ADDRESS 0x600078FA /end MEASUREMENT
/begin MEASUREMENT ESC_stActivateSyncPre "Status of activation of SyncPre task" SBYTE OneToOne 1 100 -128.0 127.0 FORMAT "%5.1" ECU_ADDRESS 0x7000547E /end MEASUREMENT
/begin MEASUREMENT ESC_stActnSyncPre "Status to activate of SyncPre task" UBYTE OneToOne 1 100 0.00 255.0 BIT_MASK 0x1 FORMAT "%5.1" ECU_ADDRESS 0x5000605E /end MEASUREMENT
/begin MEASUREMENT ESC_stFrstSyncPreTsk "Status flag to indicate first SyncPre task after synchronizationresynchronization" UBYTE OneToOne 1 100 0.00 255.0 BIT_MASK 0x1 FORMAT "%5.1" ECU_ADDRESS 0x5000094E /end MEASUREMENT
/begin MEASUREMENT ESC_stmnSyncPre "Synchro chain state machine for ESC" UBYTE OneToOne 1 100 0.00 255.0 FORMAT "%5.1" ECU_ADDRESS 0x70005480 /end MEASUREMENT
/begin MEASUREMENT ESC_stStackErr "Sampling time stack overflow or underflow error status" UBYTE OneToOne 1 100 0.00 255.0 BIT_MASK 0x1 FORMAT "%5.1" ECU_ADDRESS 0x6000B959 /end MEASUREMENT
/begin MEASUREMENT ESC_tiLftiMaxRtS0Envram "Lifetime max runtime of Sync S0 task" ULONG OneToOne_us 1 100 0.00 4294967295.00 FORMAT "%13.2" ECU_ADDRESS 0x600393A0 /end MEASUREMENT
/begin MEASUREMENT ESC_tiLftiMaxRtS0GdiEnvram "Lifetime Maximum runtime of direct injection Calculation in S0 synchro" ULONG OneToOne_us 1 100 0.00 4294967295.00 FORMAT "%13.2" ECU_ADDRESS 0x6003939C /end MEASUREMENT
/begin MEASUREMENT ESC_tiLftiMaxRtS1Envram "Lifetime max runtime of Sync S1 task" ULONG OneToOne_us 1 100 0.00 4294967295.00 FORMAT "%13.2" ECU_ADDRESS 0x60039398 /end MEASUREMENT
/begin MEASUREMENT ESC_tiLftiMaxRtS1GdiEnvram "Lifetime Maximum runtime of direct injection Calculation in S1 synchro" ULONG OneToOne_us 1 100 0.00 4294967295.00 FORMAT "%13.2" ECU_ADDRESS 0x60039394 /end MEASUREMENT
/begin MEASUREMENT ESC_tiS0GdiCalcnRt "Runtime for direct injection calculation in S0 synchro" ULONG OneToOne_us 1 100 0.00 4294967295.00 FORMAT "%13.2" ECU_ADDRESS 0x60002AFC /end MEASUREMENT
/begin MEASUREMENT ESC_tiS0GdiCalcnRtMax "Maximum runtime for direct injection calculation in S0 Synchro for current driving cycle" ULONG OneToOne_us 1 100 0.00 4294967295.00 FORMAT "%13.2" ECU_ADDRESS 0x60002AF8 /end MEASUREMENT
/begin MEASUREMENT ESC_tiS1GdiCalcnRt "Runtime for direct injection calculation in S1 synchro" ULONG OneToOne_us 1 100 0.00 4294967295.00 FORMAT "%13.2" ECU_ADDRESS 0x60002AF4 /end MEASUREMENT
/begin MEASUREMENT ESC_tiS1GdiCalcnRtMax "Maximum runtime for direct injection calculation in S1 Synchro for current driving cycle" ULONG OneToOne_us 1 100 0.00 4294967295.00 FORMAT "%13.2" ECU_ADDRESS 0x60002AF0 /end MEASUREMENT
/begin MEASUREMENT ESC_tiSampleSyncPreTsk "Sampling time calculated for SyncPre task" ULONG OneToOne_us 1 100 0.00 4294967295.00 FORMAT "%13.2" ECU_ADDRESS 0x70003028 /end MEASUREMENT
/begin MEASUREMENT ESC_tiSyncPreDiff "Difference in time between configured position of current and last SyncPre task" SLONG OneToOne_us 1 100 -2147483648.00 2147483647.00 FORMAT "%13.2" ECU_ADDRESS 0x60002AEC /end MEASUREMENT
/begin MEASUREMENT ESC_tiSyncPreTrigLtcy "Latency for trigger of SyncPre task" SLONG OneToOne_us 1 100 -2147483648.00 2147483647.00 FORMAT "%13.2" ECU_ADDRESS 0x60002AE8 /end MEASUREMENT
/begin MEASUREMENT ESC_tiSyncPreTskStrt "Start time of SyncPre task in us" ULONG OneToOne_us 1 100 0.00 4294967295.00 FORMAT "%13.2" ECU_ADDRESS 0x50000208 /end MEASUREMENT
/begin MEASUREMENT ESC_tiSyncS0TskRt "Total runtime of SyncS0 task chain" ULONG OneToOne_us 1 100 0.00 4294967295.00 FORMAT "%13.2" ECU_ADDRESS 0x60002AE4 /end MEASUREMENT
/begin MEASUREMENT ESC_tiSyncS0TskRtMax "Maximum of all recorded runtime of SyncS0 task chain" ULONG OneToOne_us 1 100 0.00 4294967295.00 FORMAT "%13.2" ECU_ADDRESS 0x60002AE0 /end MEASUREMENT
/begin MEASUREMENT ESC_tiSyncS1TskRt "Total runtime of SyncS1 task chain" ULONG OneToOne_us 1 100 0.00 4294967295.00 FORMAT "%13.2" ECU_ADDRESS 0x60002ADC /end MEASUREMENT
/begin MEASUREMENT ESC_tiSyncS1TskRtMax "Maximum of all recorded runtime of SyncS1 task chain" ULONG OneToOne_us 1 100 0.00 4294967295.00 FORMAT "%13.2" ECU_ADDRESS 0x60002AD8 /end MEASUREMENT
/begin MEASUREMENT ESNSAD_tEng "Engine temperature" UBYTE temp_ub_q0p75_o48 1 100 -48.0 143.3 FORMAT "%5.1" ECU_ADDRESS 0x60014A32 /end MEASUREMENT
/begin MEASUREMENT expollin_mp "linear extrapolated toothtime" SWORD OneToOne 1 100 -32768.00 32767.00 FORMAT "%8.2" ECU_ADDRESS 0x70009C96 /end MEASUREMENT
/begin MEASUREMENT expolmax_mp "maximum of tooth time extrapolation from both methods" SWORD OneToOne 1 100 -32768.00 32767.00 FORMAT "%8.2" ECU_ADDRESS 0x70009C94 /end MEASUREMENT
/begin MEASUREMENT expolquad_mp "square extrapolated tooth time" SWORD OneToOne 1 100 -32768.00 32767.00 FORMAT "%8.2" ECU_ADDRESS 0x70009C92 /end MEASUREMENT
/begin MEASUREMENT fgru_msg "factor: basic pilot control" UBYTE fak_ub_b2 1 100 0.00 1.992188 FORMAT "%8.6" ECU_ADDRESS 0x60014AE5 /end MEASUREMENT
/begin MEASUREMENT fipoleth_msg "Factor interpolation betwenn E85 (or E100) and E0 for injection functions" UBYTE fak_ub_b1 1 100 0.00 0.9961 ECU_ADDRESS 0x6000F73D /end MEASUREMENT
/begin MEASUREMENT flimit_w "Limit for afterstart adaptation factor" UWORD fak_uw_b2 1 100 0.00 1.999969 FORMAT "%8.6" ECU_ADDRESS 0x60013DF2 /end MEASUREMENT
/begin MEASUREMENT flimuebw_w "Limit afterstart adaptation factor" UWORD fak_uw_b2 1 100 0.00 1.999969 FORMAT "%8.6" ECU_ADDRESS 0x60013DF4 /end MEASUREMENT
/begin MEASUREMENT fnsadi_w "Factor afterstart adaptation integrator part" SWORD fak_sw_b1 1 100 -1.000000 0.999969 FORMAT "%8.6" ECU_ADDRESS 0x600005FC /end MEASUREMENT
/begin MEASUREMENT fnsadlim_w "Limiter for factor afterstart adaptation" UWORD fak_uw_b2 1 100 0.00 1.999969 FORMAT "%8.6" ECU_ADDRESS 0x600078F8 /end MEASUREMENT
/begin MEASUREMENT fnsadp_w "Factor afterstart adaptation proportional part" UWORD fak_uw_b2 1 100 0.00 1.999969 FORMAT "%8.6" ECU_ADDRESS 0x600005FE /end MEASUREMENT
/begin MEASUREMENT fnsad_w_msg "Factor afterstart adaptation" UWORD fak_uw_b2 1 100 0.00 1.999969 FORMAT "%8.6" ECU_ADDRESS 0x500008CE /end MEASUREMENT
/begin MEASUREMENT InjSys_facCylIndCorrnArry_ATS "ATS ID - Array of Cylinder Individual Correction factors by Tester" UBYTE OneToOne 1 100 0.00 255.0 FORMAT "%5.1" ARRAY_SIZE 4 ECU_ADDRESS 0x6000B954 /end MEASUREMENT
/begin MEASUREMENT InjSys_facCylIndCorrnTstrLoc "Cylinder Individual Correction factors by Tester - Local" UBYTE fak_ub_b2 1 100 0.00 1.992188 FORMAT "%8.6" ECU_ADDRESS 0x6000B953 /end MEASUREMENT
/begin MEASUREMENT InjSys_facRatFuMCylIndTstr "Relative fuel mass cylinder individual Correction by Tester" UBYTE fak_ub_b2 1 100 0.00 1.992188 FORMAT "%8.6" ARRAY_SIZE 4 ECU_ADDRESS 0x6000FC37 /end MEASUREMENT
/begin MEASUREMENT lutsnorm_w "Standardized engine roughness" SWORD lu_MEx 1 100 -232.8306 232.8235 FORMAT "%8.4" ECU_ADDRESS 0x50000788 /end MEASUREMENT
/begin MEASUREMENT rkakapb_w_msg "Additive factor, relative fuel mass for application" SWORD rel_q0p09375 1 100 -24.00000 24.00000 FORMAT "%8.5" ECU_ADDRESS 0x600095D2 /end MEASUREMENT
/begin MEASUREMENT sdlutsol_w_msg "Desired value standard deviation engine roughness" SWORD lu_MEx 1 100 -232.8306 232.8235 FORMAT "%8.4" ECU_ADDRESS 0x5000093C /end MEASUREMENT
/begin MEASUREMENT sdluts_w_msg "Standard deviation engine roughness" SWORD lu_MEx 1 100 -232.8306 232.8235 FORMAT "%8.4" ECU_ADDRESS 0x700039D8 /end MEASUREMENT
/begin MEASUREMENT tmotnsad "engine temperature used in ESNSAD" UBYTE temp_ub_q0p75_o48 1 100 -48.0 143.3 FORMAT "%5.1" ECU_ADDRESS 0x6000B952 /end MEASUREMENT
/begin MEASUREMENT tmsdluts "engine temperature at start used in ESDSDLUT" UBYTE temp_ub_q0p75_o48 1 100 -48.0 143.3 FORMAT "%5.1" ECU_ADDRESS 0x6000B958 /end MEASUREMENT
/begin FUNCTION EpmCrS_Seg "101.17.0  calculation of crankshaft-segmenttimes" /begin DEF_CHARACTERISTIC EpmCrS_stTTMeasure_C EpmCrS_swtMeasActvnS1_C /end DEF_CHARACTERISTIC /begin REF_CHARACTERISTIC EpmSeq_phiInt_CA EpmSeq_swtInt_C /end REF_CHARACTERISTIC
 /begin IN_MEASUREMENT EpmHCrS_ctGapRef EpmHCrS_numIncGap_Var EpmHCrS_stRotDir EpmHCrS_stSigMode EpmHCrS_tiPerTn EpmHCrS_tiPerTn_1 EpmSeq_eveId EpmSeq_numInt EpmSeq_tiEve EpmSyn_phiInt Epm_ctCyl Epm_numCyl Epm_stOpMode Epm_stSupressIni /end IN_MEASUREMENT
 /begin OUT_MEASUREMENT EpmCrS_ctInc EpmCrS_numIncPerSeg EpmCrS_numSeg EpmCrS_phiAgClk EpmCrS_phiInc EpmCrS_phiIntSeg EpmCrS_phiSeg EpmCrS_phiSegHiRes EpmCrS_stRotDir EpmCrS_stSigMode EpmCrS_tiDgiPlsFwdAvrg EpmCrS_tiDgiPlsFwdMax EpmCrS_tiDgiPlsFwdMin EpmCrS_tiDgiPlsRvsAvrg EpmCrS_tiDgiPlsRvsMax EpmCrS_tiDgiPlsRvsMin EpmCrS_tiSeg EpmCrS_tiSegCurr EpmCrS_tiSegHiRes /end OUT_MEASUREMENT
 /begin LOC_MEASUREMENT EpmCrS_idxBuf_mp EpmCrS_numNewInc_mp EpmCrS_tiInc_mp /end LOC_MEASUREMENT
 FUNCTION_VERSION "101.17.0" /end FUNCTION
/begin FUNCTION EpmErr_Trace "101.3.1   Error Tracing"
 /begin LOC_MEASUREMENT EpmErr_ctErrInfoAryFree EpmErr_TraceCoreId EpmErr_TraceErrClass EpmErr_TraceErrId EpmErr_TraceErrInfo1 EpmErr_TraceErrInfo2 EpmErr_TraceErrInfo3 EpmErr_TraceErrInfo4 EpmErr_TraceErrorReaction EpmErr_TraceModId EpmErr_TraceStatus EpmErr_TraceTimeStamp Epm_Reset_RSTDetected_u32 /end LOC_MEASUREMENT
 FUNCTION_VERSION "101.3.1" /end FUNCTION
/begin FUNCTION EpmHAgClk_Gen "101.25.0  Controls the Digital Phase Locked Loop (DPLL) and generates the Angle Clock for the System" /begin DEF_CHARACTERISTIC EpmHAgClk_numAddTick_CA /end DEF_CHARACTERISTIC
 /begin IN_MEASUREMENT EpmCaS_numPriCamShft EpmHCrS_agActvEdge EpmHCrS_ctIncStrt EpmHCrS_ctRealGapPos EpmHCrS_numGapWcy EpmHCrS_numGap_Var EpmHCrS_numIncGapMiss EpmHCrS_numIncGap_Var EpmHCrS_numIncReal EpmHCrS_numIncRealWcy EpmHCrS_numInc_Var EpmHCrS_stActEdge EpmHCrS_stGapSubState EpmHCrS_stOneAftGap EpmHCrS_stRotDir EpmHCrS_tiActv2ActvEdge Epm_SensTypCrS /end IN_MEASUREMENT
 /begin OUT_MEASUREMENT EpmHAgClk_numAgTicksPerInc EpmHAgClk_tiIncPerBas EpmHAgClk_tiMinPer /end OUT_MEASUREMENT
 /begin LOC_MEASUREMENT EpmHAgClk_AddTick EpmHAgClk_Gen_AgCntRaw_mp EpmHAgClk_Gen_AgCnt_mp EpmHAgClk_numAgClkFrq EpmHAgClk_numAgClkMode EpmHAgClk_numAgClkState EpmHAgClk_numMissTick EpmHAgClk_stAPTSyn /end LOC_MEASUREMENT
 FUNCTION_VERSION "101.25.0" /end FUNCTION
/begin FUNCTION EpmHAgClk_TrigEve "101.2.3   Handles the Triggering of Events for the system based on the Angle clock" /begin LOC_MEASUREMENT EpmHAgClk_agPosnTrigEve /end LOC_MEASUREMENT FUNCTION_VERSION "101.2.3" /end FUNCTION
/begin FUNCTION EpmHCaS_auto "" /end FUNCTION
/begin FUNCTION EpmHCaS_SigBuf "101.9.5   signal buffer of camshaft" /begin IN_MEASUREMENT EpmCaS_numSegSerLst /end IN_MEASUREMENT
 /begin OUT_MEASUREMENT EpmHCaS_DataI1.agFallEdgeCorrn EpmHCaS_DataI1.agRisngEdgeCorrn EpmHCaS_DataI1.ctEdge EpmHCaS_DataI1.tiGlitch EpmHCaS_DataI1.tiDiffEdge EpmHCaS_DataI1.tiDiffLstEdge EpmHCaS_DataI1.tiStampEdge EpmHCaS_DataI1.agDiffEdge EpmHCaS_DataI1.agDiffLstEdge EpmHCaS_DataI1.agEdgeAbslt EpmHCaS_DataI1.agEdgeCorrn EpmHCaS_DataI1.agEdgeRel EpmHCaS_DataI1.agPhaShiftRel EpmHCaS_DataI1.agRefPosCorrd EpmHCaS_DataI1.ctBufIdx EpmHCaS_DataI1.ctValidEdge EpmHCaS_DataI1.ctValidTime EpmHCaS_DataI1.numBufUsed EpmHCaS_DataI1.numLstEdgeAbslt EpmHCaS_DataI1.numLstEdgeWcy EpmHCaS_DataI1.numEdgeAbslt EpmHCaS_DataI1.numEdgeWcy EpmHCaS_DataI1.stCurLev EpmHCaS_DataI1.stLevBeforeEdge EpmHCaS_DataI1.stSig /end OUT_MEASUREMENT
 FUNCTION_VERSION "101.9.5" /end FUNCTION
/begin FUNCTION EpmHCaS_SigEval "101.16.5  Camshaft Signal Evaluation" /begin REF_CHARACTERISTIC EpmCaS_stActEdge_C EpmCaS_tiGlitchFilter_C /end REF_CHARACTERISTIC
 /begin IN_MEASUREMENT EpmBCr_ctEdgeRefTabIdx EpmBCr_phiNxtCaSEdge EpmBCr_stPos EpmCaS_agCorrnStat EpmCaS_numPriCamShft EpmCaS_numSegSerLst EpmCaS_phiAdapRefPos EpmCaS_phiDiffCal2AdapEqAvg EpmCaS_stSnsrDeActvn EpmHCaS_DataI1.agFallEdgeCorrn EpmHCaS_DataI1.agRisngEdgeCorrn EpmHCaS_DataI1.ctEdge EpmHCaS_DataI1.tiGlitch EpmHCaS_DataI1.tiDiffEdge EpmHCaS_DataI1.tiDiffLstEdge EpmHCaS_DataI1.tiStampEdge EpmHCaS_DataI1.agDiffEdge EpmHCaS_DataI1.agDiffLstEdge EpmHCaS_DataI1.agEdgeAbslt EpmHCaS_DataI1.agEdgeCorrn EpmHCaS_DataI1.agEdgeRel EpmHCaS_DataI1.agPhaShiftRel EpmHCaS_DataI1.agRefPosCorrd EpmHCaS_DataI1.ctBufIdx EpmHCaS_DataI1.ctValidEdge EpmHCaS_DataI1.ctValidTime EpmHCaS_DataI1.numBufUsed EpmHCaS_DataI1.numLstEdgeAbslt EpmHCaS_DataI1.numLstEdgeWcy EpmHCaS_DataI1.numEdgeAbslt EpmHCaS_DataI1.numEdgeWcy EpmHCaS_DataI1.stCurLev EpmHCaS_DataI1.stLevBeforeEdge EpmHCaS_DataI1.stSig EpmHCrS_stTwoAftGap EpmSyn_ctEdgeWcyOfs EpmSyn_phiOffsCor EpmSyn_stCaSPosValid Epm_stSync /end IN_MEASUREMENT
 /begin OUT_MEASUREMENT EpmHCaS_ctEdgeCaSI1 EpmHCaS_stCaSSig /end OUT_MEASUREMENT
 FUNCTION_VERSION "101.16.5" /end FUNCTION
/begin FUNCTION EpmHCrS_DirEvln "101.16.1  Evaluation of Rotation Direction Information from Engine Speed Sensor"
 /begin IN_MEASUREMENT EpmCrS_swtSnsrTyp EpmHCrS_stPlsMod EpmHCrS_tiActv2PasEdge Epm_SensTypCrS /end IN_MEASUREMENT
 /begin OUT_MEASUREMENT EpmHCrS_stDirChg EpmHCrS_stDirEvln EpmHCrS_stRotDir EpmHCrS_stRotDirRaw EpmHCrS_swtDirInfoOn /end OUT_MEASUREMENT
 /begin LOC_MEASUREMENT EpmHCrS_swtDirChgRawOld EpmHCrS_swtDirChgRawOld2 EpmHCrS_swtEnaDirPlaus /end LOC_MEASUREMENT
 FUNCTION_VERSION "101.16.1" /end FUNCTION
/begin FUNCTION EpmHCrS_DynPlaus "101.13.2  Dynamical Plausibility Check of Crankshaft Increment Duration" /begin DEF_CHARACTERISTIC EpmHCrS_tiToutEngStop_C /end DEF_CHARACTERISTIC
 /begin IN_MEASUREMENT EpmHCrS_stEdgeISRActv EpmHCrS_stRotDir EpmHCrS_stSigErr EpmHCrS_tiActvEdge Epm_stOpMode /end IN_MEASUREMENT
 /begin OUT_MEASUREMENT EpmHCrS_facGapPlausHigh EpmHCrS_facIncPlausHigh EpmHCrS_facIncPlausLow /end OUT_MEASUREMENT
 /begin LOC_MEASUREMENT EpmHCrS_facPlausHigh EpmHCrS_facPlausHighOld EpmHCrS_facPVTOld EpmHCrS_swtEdgeOcc EpmHCrS_swtGapTout EpmHCrS_swtNoPVTDly EpmHCrS_swtToutActv EpmHCrS_tiToutEngStop /end LOC_MEASUREMENT
 FUNCTION_VERSION "101.13.2" /end FUNCTION
/begin FUNCTION EpmHCrS_InctCntr "101.13.0  Calculation of Counter Values for Crankshaft Increments"
 /begin IN_MEASUREMENT EpmHCrS_numGap_Var EpmHCrS_numIncGap2Gap_Var EpmHCrS_numIncGap_Var EpmHCrS_numInc_Var EpmHCrS_stRotDir EpmHCrS_stRotDirRaw Strt_stStaActv /end IN_MEASUREMENT
 /begin OUT_MEASUREMENT EpmHCrS_cntrInctDcyc EpmHCrS_cntrInctDcycOld EpmHCrS_ctAPTPos EpmHCrS_ctDebEdge EpmHCrS_ctGapDetn EpmHCrS_ctGapPos EpmHCrS_ctGapRef EpmHCrS_ctIncGap EpmHCrS_ctIncPos EpmHCrS_ctIncRvs EpmHCrS_ctIncStrt EpmHCrS_ctIncStrtOld EpmHCrS_ctRealGapPos EpmHCrS_ctSynInc EpmHCrS_numGapWcy EpmHCrS_numIncGap2GapMax EpmHCrS_numIncGapMiss EpmHCrS_numIncReal EpmHCrS_numIncRealWcy EpmHCrS_numIncRealWcyLast EpmHCrS_numIncWcy EpmHCrS_stEngStrt EpmHCrS_stSymGap /end OUT_MEASUREMENT
 /begin LOC_MEASUREMENT EpmHCrS_ctAPTDiff EpmHCrS_ctIncGapDly EpmHCrS_ctOffsPos2Strt EpmHCrS_ctOffsRel2APT EpmHCrS_ctOffsRel2Strt EpmHCrS_ctPosAry EpmHCrS_ctRel EpmHCrS_ctSynGapPos EpmHCrS_swtGapShft /end LOC_MEASUREMENT
 FUNCTION_VERSION "101.13.0" /end FUNCTION
/begin FUNCTION EpmHCrS_Interface "101.15.0  Interface for EpmHCrS"
 /begin DEF_CHARACTERISTIC EpmHCrS_phiThdFBC_C EpmHCrS_phiThdHi_C EpmHCrS_phiThdRaw_C EpmHCrS_phiThd_C /end DEF_CHARACTERISTIC
 /begin IN_MEASUREMENT EpmBCr_tiIncPer EpmCrS_numTiIncPerAvrg EpmHAgClk_tiMinPer EpmHCrS_cntrErr EpmHCrS_cntrErrSum EpmHCrS_facGapCrit1 EpmHCrS_facGapCrit2 EpmHCrS_facGapPlausHigh EpmHCrS_facIncPlausHigh EpmHCrS_facIncPlausLow EpmHCrS_numDebInc EpmHCrS_numInc_Var EpmHCrS_stRotDir EpmHCrS_stSigMode EpmHCrS_tiIgnSig EpmHCrS_tiPerTn EpmSyn_phiOffs EpmSyn_phiOffsCor /end IN_MEASUREMENT
 /begin OUT_MEASUREMENT EpmHCrS_ctIncEngPos EpmHCrS_stSigErr /end OUT_MEASUREMENT
 /begin LOC_MEASUREMENT EpmHCrS_ctResyncUpperLvl /end LOC_MEASUREMENT
 FUNCTION_VERSION "101.15.0" /end FUNCTION
/begin FUNCTION EpmHCrS_IntHndlr "101.22.0  Interrupt Service Routine Coordinator of the Crank Shaft Driver"
 /begin DEF_CHARACTERISTIC EpmHCrS_tiEvlnOffsActv_C EpmHCrS_tiSyncIniTout_C EpmHCrS_tiSyncIniWait_C /end DEF_CHARACTERISTIC
 /begin IN_MEASUREMENT EpmCrS_stHiEngSpd EpmCrS_swtSnsrTyp EpmHCrS_ctGapRef EpmHCrS_ctIncStrt EpmHCrS_facIncPlausLow EpmHCrS_stActEdge EpmHCrS_stFirstValTooth EpmHCrS_stReqDrvrRstrt EpmHCrS_stSigMode EpmHCrS_swtDirInfoOn EpmHCrS_tiActvEdge Epm_SensTypCrS Epm_stOpMode /end IN_MEASUREMENT
 /begin OUT_MEASUREMENT EpmHCrS_cntrDrvErrRst EpmHCrS_cntrEdge EpmHCrS_cntrErr EpmHCrS_cntrErrRst EpmHCrS_cntrErrSum EpmHCrS_ctEdgeStrt EpmHCrS_stEdgeISRActv EpmHCrS_stPlsMod EpmHCrS_stStrtSigMode EpmHCrS_swtCntrPosRst EpmHCrS_swtIntrptSetUp EpmHCrS_tiLstEdge /end OUT_MEASUREMENT
 /begin LOC_MEASUREMENT EpmHCrS_ctIncActivate EpmHCrS_stMainIntrptEdge EpmHCrS_stReqDrvRst EpmHCrS_stTmrActv EpmHCrS_tiTmrStrt /end LOC_MEASUREMENT
 FUNCTION_VERSION "101.22.0" /end FUNCTION
/begin FUNCTION EpmHCrS_Sampling "1.13.0    Capturing of Time and Angle Stamps of Active Edges of Crankshaft Signal"
 /begin IN_MEASUREMENT EpmHCrS_tiFilDlyActvEdge EpmHCrS_tiFilDlyInActvEdge Epm_SensTypCrS /end IN_MEASUREMENT
 /begin OUT_MEASUREMENT EpmHCrS_agActvEdge EpmHCrS_tiActv2ActvEdge EpmHCrS_tiActv2PasEdge EpmHCrS_tiActvEdge EpmHCrS_tiPasEdge /end OUT_MEASUREMENT
 /begin LOC_MEASUREMENT EpmHCrS_stRdGTMReg EpmHCrS_tiLstActvEdge EpmHCrS_tiStampExt /end LOC_MEASUREMENT
 FUNCTION_VERSION "1.13.0" /end FUNCTION
/begin FUNCTION EpmHCrS_SigBuf "101.37.0  signalbuffer crankshaft" /begin DEF_CHARACTERISTIC EpmHCrS_phiThdPer_C /end DEF_CHARACTERISTIC
 /begin IN_MEASUREMENT EpmHCrS_agActvEdge EpmHCrS_ctAPTPos EpmHCrS_ctGapPos EpmHCrS_ctGapRef EpmHCrS_ctIncStrt EpmHCrS_numGap_Var EpmHCrS_numIncGapMiss EpmHCrS_numIncGap_Var EpmHCrS_numIncWcy EpmHCrS_stDirEvln EpmHCrS_stRotDir EpmHCrS_stSigMode EpmHCrS_tiActv2ActvEdge EpmHCrS_tiActvEdge EpmHCrS_tiPasEdge EpmSeq_tiEve Epm_SensTypCrS /end IN_MEASUREMENT
 /begin LOC_MEASUREMENT EpmHCrS_cntrInct EpmHCrS_stBufFillUpd EpmHCrS_stBufGapCor /end LOC_MEASUREMENT
 FUNCTION_VERSION "101.37.0" /end FUNCTION
/begin FUNCTION EpmHCrS_SigEval_auto "" /end FUNCTION
/begin FUNCTION EpmHCrS_StMac "101.26.0  State machine of Crankshaft signal evaluation" /begin DEF_CHARACTERISTIC EpmHCrS_nGapVldn_C /end DEF_CHARACTERISTIC /begin REF_CHARACTERISTIC EpmHCrS_tiSyncIniTout_C EpmHCrS_tiSyncIniWait_C /end REF_CHARACTERISTIC
 /begin IN_MEASUREMENT EpmCrS_swtSnsrTyp EpmHCrS_ctAPTPos EpmHCrS_ctDebEdge EpmHCrS_ctGapDetn EpmHCrS_ctGapRef EpmHCrS_ctIncStrt EpmHCrS_numIncGap2GapMax EpmHCrS_numIncGap_Var EpmHCrS_stRotDir EpmHCrS_stSymGap EpmHCrS_tiActv2ActvEdge Epm_SensTypCrS Epm_stSync /end IN_MEASUREMENT
 /begin OUT_MEASUREMENT EpmHCrS_facGapCrit1 EpmHCrS_facGapCrit2 EpmHCrS_numDebInc EpmHCrS_stFirstValTooth EpmHCrS_stGapSubState EpmHCrS_stOneAftGap EpmHCrS_stReqDrvrRstrt EpmHCrS_stSigMode EpmHCrS_stTwoAftGap EpmHCrS_tiIgnSig EpmHCrS_tiPerTn EpmHCrS_tiPerTn_1 EpmHCrS_tiPerTn_2 /end OUT_MEASUREMENT
 /begin LOC_MEASUREMENT EpmHCrS_stDisblNewSync EpmHCrS_stSyncIniExe EpmHCrS_tiPerTnACC /end LOC_MEASUREMENT
 FUNCTION_VERSION "101.26.0" /end FUNCTION
/begin FUNCTION EpmHwE_Fil "1.5.3     Debounce Filter for Signal Edges of Crankshaft and Camshaft Sensor" /begin IN_MEASUREMENT EpmHCrS_stActEdge /end IN_MEASUREMENT /begin OUT_MEASUREMENT EpmHCrS_tiFilDlyActvEdge EpmHCrS_tiFilDlyInActvEdge /end OUT_MEASUREMENT FUNCTION_VERSION "1.5.3" /end FUNCTION
/begin FUNCTION EpmHwe_Ini "101.15.0  Hardware encapsulation init" /begin IN_MEASUREMENT Epm_SensTypCrS /end IN_MEASUREMENT /begin LOC_MEASUREMENT EpmHwE_DMARam /end LOC_MEASUREMENT FUNCTION_VERSION "101.15.0" /end FUNCTION
/begin FUNCTION EpmHwe_Srv "101.4.6   Service Library" /begin IN_MEASUREMENT EpmBCr_tiIncPer /end IN_MEASUREMENT FUNCTION_VERSION "101.4.6" /end FUNCTION
/begin FUNCTION EpmIf_Imprt "1.3.0     Epm Interface Import" /begin IN_MEASUREMENT EngDa_tEng Oil_tSwmp /end IN_MEASUREMENT /begin OUT_MEASUREMENT EpmIf_tCoolant EpmIf_tOil /end OUT_MEASUREMENT FUNCTION_VERSION "1.3.0" /end FUNCTION
/begin FUNCTION EpmRRS_AgDetect "101.15.2  Engine Position Management Reverse Rotation and Stop Angle Detection"
 /begin DEF_CHARACTERISTIC EpmRRS_EnaIgnInj_CW EpmRRS_facExTTime_CA EpmRRS_nEngMaxCaS_C EpmRRS_nEngMax_C EpmRRS_phiMax_C EpmRRS_phiUndef_C EpmRRS_swtMethod_C EpmRRS_tiMaxToothTime_C EpmRRS_tiMinToothTime_C EpmRRS_tiTemp_CUR EpmRRS_vVehMax_C /end DEF_CHARACTERISTIC
 /begin REF_CHARACTERISTIC Epm_phiGap2Zero_C Epm_swtOpModeStgy_C /end REF_CHARACTERISTIC
 /begin IN_MEASUREMENT CoVeh_stEngStopOrd Eep_EnvRamHist Eep_EnvRamInvld EpmHCrS_ctIncPos EpmHCrS_stEngStrt EpmHCrS_stRotDir EpmIf_tCoolant EpmSyn_phiOffs EpmSyn_stRR Epm_nEng10ms Epm_numCyl Epm_phiDiffTDC Epm_stOpMode Epm_stPosDGI Epm_stSync Strt_stStaActv SyC_stSub VehV_v /end IN_MEASUREMENT
 /begin OUT_MEASUREMENT EpmRRS_bEngStopAg EpmRRS_bEngSwOff EpmRRS_phiEngPos EpmRRS_phiEngStop EpmRRS_phiStopPos EpmRRS_phiStopPosCyl EpmRRS_stEnable EpmRRS_stEngPos EpmRRS_stEngStop EpmRRS_stEngStopAg EpmRRS_stEngStopOld EpmRRS_stRotDir /end OUT_MEASUREMENT
 /begin LOC_MEASUREMENT EpmRRS_actIncAr_mp EpmRRS_actIncBuf_mp EpmRRS_actIncOrig_mp EpmRRS_actInc_mp EpmRRS_bAgDetectflgClr EpmRRS_ctGapInBuffer_mp EpmRRS_ctIncEngStop_mp EpmRRS_ctIncRdPos_mp EpmRRS_ctNewTeethOrig_mp EpmRRS_ctNewTeeth_mp EpmRRS_ctToothTimeout_mp EpmRRS_GapDetected_mp EpmRRS_idxWrAct_mp EpmRRS_incGapTest_mp EpmRRS_incSynOffs_mp EpmRRS_maxToothCondAr_mp EpmRRS_phiEngRR EpmRRS_phiGapPos EpmRRS_phiRdPos_mp EpmRRS_phiRelTDC_mp EpmRRS_stAgDetect EpmRRS_stEngStopAg_mp EpmRRS_stGetBufNumPer_mp EpmRRS_stPlausAngle EpmRRS_stReason_mp EpmRRS_stToothPerBuf_mp EpmRRS_tiToothPer EpmRRS_tiToothPerDGI_mp EpmRRS_tiToothPerOrg expollin_mp expolmax_mp expolquad_mp /end LOC_MEASUREMENT
 FUNCTION_VERSION "101.15.2" /end FUNCTION
/begin FUNCTION EpmSeq_EveHndlr "101.13.9  EPM Event Handler of incoming trigger events"
 /begin IN_MEASUREMENT EpmSeq_phiNxtInt EpmSyn_phiInt Epm_nEng Epm_stOpMode Epm_stSync /end IN_MEASUREMENT
 /begin OUT_MEASUREMENT EpmSeq_EveHndlr_stErr EpmSeq_eveId EpmSeq_phiEve EpmSeq_tiEve /end OUT_MEASUREMENT
 /begin LOC_MEASUREMENT EpmSeq_ctActivateSyncPre EpmSeq_ctForceResync EpmSeq_ctIncNextEvent_mp EpmSeq_currentEveId_mp EpmSeq_eveCount EpmSeq_SyncPreEnaMask_mp /end LOC_MEASUREMENT
 FUNCTION_VERSION "101.13.9" /end FUNCTION
/begin FUNCTION EpmSeq_StateMn "1.39.0    statemachine of interrupt control"
 /begin DEF_CHARACTERISTIC EpmSeq_nMaxStrtInt_C EpmSeq_phiIntBCr_CA EpmSeq_phiInt_CA EpmSeq_phiStrtInt_CA EpmSeq_swtInt_C /end DEF_CHARACTERISTIC
 /begin IN_MEASUREMENT EpmSeq_eveId EpmSyn_phiInt Epm_nEng Epm_numCyl Epm_phiCyl Epm_stOpMode Epm_stSync /end IN_MEASUREMENT
 /begin OUT_MEASUREMENT EpmSeq_numIncDiffInt EpmSeq_numInt EpmSeq_numIntPrev EpmSeq_phiNxtInt EpmSeq_phiNxtInt_msg EpmSeq_stCurrInt EpmSeq_stInt Epm_ctCyl /end OUT_MEASUREMENT
 /begin LOC_MEASUREMENT EpmSeq_idxIntrptData EpmSeq_idxIntrptDataNxt EpmSeq_idxIntrptDataNxt_mp EpmSeq_idxIntrptData_mp EpmSeq_numActvIntrpt EpmSeq_phiIntrpt EpmSeq_stIntrptGen EpmSeq_stReqIntrptGen EpmSeq_stSyncPrev EpmSeq_stSyncPrev_mp /end LOC_MEASUREMENT
 FUNCTION_VERSION "1.39.0" /end FUNCTION
/begin FUNCTION EpmSrv_Lib "101.10.0  service library for EPM" /begin REF_CHARACTERISTIC Epm_numFireSeg_C /end REF_CHARACTERISTIC /begin IN_MEASUREMENT EpmSyn_phiOffs EpmTDC_agCylCorrd Epm_numCyl /end IN_MEASUREMENT /begin LOC_MEASUREMENT EpmSrv_stCnvAgT2Ag_mp /end LOC_MEASUREMENT FUNCTION_VERSION "101.10.0" /end FUNCTION
/begin FUNCTION EpmSyn_CaSPos "1.43.12   phasesynchronisation about camshaft"
 /begin DEF_CHARACTERISTIC EpmSyn_dCaSSegMsk_C EpmSyn_nrIgrCaSEdge_C EpmSyn_stSwtSuppRvsRotCamsft_C EpmSyn_swtDiFirstGapSyncn_C /end DEF_CHARACTERISTIC
 /begin REF_CHARACTERISTIC EpmCaS_phiSegOfs_CA EpmRRS_nEngMaxCaS_C Epm_phiGap2Zero_C /end REF_CHARACTERISTIC
 /begin IN_MEASUREMENT EpmCaS_numSegSerLst EpmCaS_phiRefPos EpmCaS_stAdap EpmCaS_stDiag EpmCaS_stDiagErr EpmCaS_stSnsrDeActvn EpmCrS_ctInc EpmCrS_stSigMode EpmHCaS_stCaSSig EpmHCrS_ctIncGap EpmSyn_stCrSPosErr Epm_nEng10ms Epm_stOpMode Epm_stSupressIni Epm_stSync /end IN_MEASUREMENT
 /begin OUT_MEASUREMENT EpmSyn_ctEdgeWcyOfs EpmSyn_numCaSSync EpmSyn_phiCaSPos EpmSyn_stCaSEval EpmSyn_stCaSPos EpmSyn_stCaSPosValid EpmSyn_stGapPos EpmSyn_stRR /end OUT_MEASUREMENT
 /begin LOC_MEASUREMENT EpmSyn_CaSDataI1.SigTab EpmSyn_CaSDataI1.stSearch EpmSyn_CaSDataI1.ctLstEdge EpmSyn_CaSDataI1.phiIniCaSPos EpmSyn_CaSDataI1.phiLstEdge EpmSyn_CaSDataI1.phiSegPos EpmSyn_CaSDataI1.numSegInSigTab EpmSyn_CaSDataI1.ctSigTabLstEntr EpmSyn_CaSDataI1.ctWcycle EpmSyn_CaSDataI1.stPreSeg EpmSyn_CaSDataI1.numNewEdges EpmSyn_CaSDataI1.numMatches EpmSyn_CaSDataI1.numMatchPos EpmSyn_ctBackwards EpmSyn_phiCaSPosCorrAdap EpmSyn_stCaSPosReset EpmSyn_stDiFirstGapSyncn EpmSyn_stPostDrvMemd EpmSyn_stSuppRvsRotCASI1_MP /end LOC_MEASUREMENT
 FUNCTION_VERSION "1.43.12" /end FUNCTION
/begin FUNCTION EpmSyn_CrSPos "101.9.2   synchronisation of crankshaftposition" /begin DEF_CHARACTERISTIC EpmSyn_phiIncCor_CUR /end DEF_CHARACTERISTIC /begin REF_CHARACTERISTIC Epm_phiGap2Zero_C /end REF_CHARACTERISTIC
 /begin IN_MEASUREMENT EpmCrS_ctInc EpmCrS_stSigMode EpmHCrS_ctIncPos EpmHCrS_ctSynInc EpmHCrS_numGapWcy EpmHCrS_numGap_Var EpmHCrS_numIncGap2Gap_Var EpmHCrS_numIncWcy EpmSeq_phiEve EpmTDC_agOffsCorrn Epm_nEng Epm_stOpMode Epm_stSupressIni /end IN_MEASUREMENT
 /begin OUT_MEASUREMENT EpmSyn_ctIncEngPos_10ms EpmSyn_phiDiff EpmSyn_phiInt EpmSyn_phiOffs EpmSyn_phiOffsCor EpmSyn_stCrSPos EpmSyn_stCrSPosErr /end OUT_MEASUREMENT
 /begin LOC_MEASUREMENT EpmSyn_GetAngleCnt_mp EpmSyn_phiAgClk_mp EpmSyn_phiIncCor_mp EpmSyn_phiSetPos_mp /end LOC_MEASUREMENT
 FUNCTION_VERSION "101.9.2" /end FUNCTION
/begin FUNCTION EpmTDC_Corrn "1.2.4     Correction of the TopDeadCenter (TDC)" /begin IN_MEASUREMENT Epm_numCyl Epm_phiCyl /end IN_MEASUREMENT /begin OUT_MEASUREMENT EpmTDC_agCylCorrd EpmTDC_agCylCorrn EpmTDC_agOffsCorrn /end OUT_MEASUREMENT FUNCTION_VERSION "1.2.4" /end FUNCTION
/begin FUNCTION EPM_Conf "101.6.1_3.0.0EPM Configuration with legacy mechanisms"
 /begin OUT_MEASUREMENT CAS_BKUP EpmCaS_stSnsrDeActvnPBVar EpmHCrS_numGap_Var EpmHCrS_numIncGap2Gap_Var EpmHCrS_numIncGap_Var EpmHCrS_numInc_Var EpmHCrS_stActEdge EpmHCrS_tiPlsFwd EpmHCrS_tiPlsRvs Epm_stPBVarInit /end OUT_MEASUREMENT
 FUNCTION_VERSION "101.6.1_3.0.0" /end FUNCTION
/begin FUNCTION Epm_Ini "101.11.0  Initialisation of EPM"
 /begin DEF_CHARACTERISTIC Epm_numCyl_C Epm_numFireSeg_C Epm_phiGap2Zero_C Epm_phiTdc1_C /end DEF_CHARACTERISTIC
 /begin OUT_MEASUREMENT Epm_numCyl Epm_phiCyl Epm_phiDiffTDC Epm_SensTypCrS /end OUT_MEASUREMENT
 /begin LOC_MEASUREMENT Epm_Ini_stFinalInit /end LOC_MEASUREMENT
 FUNCTION_VERSION "101.11.0" /end FUNCTION
/begin FUNCTION Epm_OpMode "101.33.0_1.0.1Operation Modes of EPM"
 /begin DEF_CHARACTERISTIC Epm_nALESyncMax_C Epm_nNoSyncVerify_C Epm_numReSync_C Epm_phiDiffMax_C Epm_swtBlkInjCaSSync_C Epm_swtOpModeStgy_C Epm_tiLockReSync_C /end DEF_CHARACTERISTIC
 /begin REF_CHARACTERISTIC EpmCaS_stActEdge_C EpmCaS_tiGlitchFilter_C /end REF_CHARACTERISTIC
 /begin IN_MEASUREMENT BattU_u DSM_TripChgFinshd Eep_EnvRamHist Eep_EnvRamInvld EpmBCr_flgStrtDirectAllwd EpmBCr_phiPos EpmBCr_stPos EpmCaS_nEng EpmCaS_stOfsErr EpmCrS_stRotDir EpmCrS_stSigMode EpmHCrS_cntrInctDcyc EpmHCrS_cntrInctDcycOld EpmHCrS_ctGapRef EpmHCrS_stEngStrt EpmRRS_bEngStopAg EpmRRS_bEngSwOff EpmRRS_stEngStopAg EpmSeq_eveId EpmSyn_numCaSSync EpmSyn_phiCaSPos EpmSyn_phiInt EpmSyn_phiOffs EpmSyn_stCaSPos EpmSyn_stCrSPos EpmSyn_stCrSPosErr EpmSyn_stGapPos EpmSyn_stRR Epm_nEng Strt_stStaActv SyC_ctDrvEnter SyC_stSub SyC_stSubOld /end IN_MEASUREMENT
 /begin OUT_MEASUREMENT Epm_agAbsltFirstSyncn Epm_ctReSync Epm_nrInctFirstSyncn Epm_phiDiffRRS Epm_stCmbTestReq Epm_stDirstaleReady Epm_stEngPos Epm_stOpMode Epm_stPosDGI Epm_stSupressIni Epm_stSync Epm_tiFirstSyncn /end OUT_MEASUREMENT
 /begin LOC_MEASUREMENT Epm_bTrans2Wait_mp Epm_ctCylLoc Epm_nEngVerify Epm_numIntLoc Epm_phiCurrPos Epm_stALEDiag Epm_stCaSNoErr_mp Epm_stCheckStopPosValid_mp Epm_stDSMRdyOpMode Epm_stReSyncReasonInt Epm_stReSyncReason_mp Epm_stTestInj Epm_tiLockReSync_mp /end LOC_MEASUREMENT
 FUNCTION_VERSION "101.33.0_1.0.1" /end FUNCTION
/begin FUNCTION Epm_Spd "101.17.0_1.0.1Calculation of Engine Speed"
 /begin DEF_CHARACTERISTIC Epm_nMaxSpdReSync_C Epm_nSpd2Zero_C Epm_numIgrTeethReSync_C Epm_tiSpd2Zero_C /end DEF_CHARACTERISTIC
 /begin IN_MEASUREMENT EpmBCr_nEng EpmBCr_stPos EpmCaS_nEng EpmCaS_numPriCamShft EpmCaS_numSegSerLst EpmCaS_stNEng EpmCrS_numIncPerSeg EpmCrS_phiSeg EpmCrS_stSigMode EpmCrS_tiSeg EpmCrS_tiSegCurr EpmHCrS_stSigMode EpmRRS_stEnable EpmRRS_stEngStop Epm_stOpMode Epm_stSupressIni /end IN_MEASUREMENT
 /begin OUT_MEASUREMENT Epm_nEng Epm_nEng10ms Epm_nEngCurr Epm_nEngInc10ms Epm_nEngRaw Epm_nEngTooth10ms Epm_phiIgrTeethReSync Epm_stReSync Epm_stSpd Epm_tiSpd2Zero /end OUT_MEASUREMENT
 /begin LOC_MEASUREMENT Epm_numValidTeeth_mp Epm_stSigModeLst_mp Epm_tiSegNTEETH_mp Epm_tiSegONETOOTH_mp Epm_tiSegPARTSEG_mp Epm_tiSegRaw_mp /end LOC_MEASUREMENT
 FUNCTION_VERSION "101.17.0_1.0.1" /end FUNCTION
/begin FUNCTION Epm_SpdFeat "1.8.0_1.0.1Feature specific engine speed calculation" /begin DEF_CHARACTERISTIC Epm_nLowSpdMax_C Epm_tiLowSpd2Zero_C /end DEF_CHARACTERISTIC
 /begin IN_MEASUREMENT EpmBCr_nEng EpmCaS_nEng EpmCrS_numIncPerSeg EpmCrS_phiSeg EpmCrS_phiSegHiRes EpmCrS_stHiEngSpd EpmCrS_stSigMode EpmCrS_tiSeg EpmCrS_tiSegHiRes EpmHCrS_numIncGap_Var Epm_nEng Epm_nEng10ms Epm_nEngInc10ms Epm_stReSync Epm_stSpd /end IN_MEASUREMENT
 /begin OUT_MEASUREMENT Epm_ctIncDiff Epm_ctIncLowSpd Epm_dnEngLowSpd Epm_dnEngLowSpdFl Epm_nEngHiRes Epm_nEngLowSpd Epm_nEngLowSpdXP Epm_nEngLRes Epm_nEngReal1ms Epm_stLowSpdXP Epm_tiCalcPeriodLowSpd Epm_tiSegLowSpd /end OUT_MEASUREMENT
 /begin LOC_MEASUREMENT Epm_ctAPTLowSpd Epm_ctGapLowSpd Epm_ctIncDiffPrev Epm_idxRdLowSpd Epm_nEng10msInt Epm_nEngSeg_mp Epm_nLowSpdMax Epm_stDirLowSpd Epm_stLowSpdActv Epm_tiLowSpd2Zero Epm_tiSegLowSpdPrev Epm_tiTimeoutLowSpd /end LOC_MEASUREMENT
 FUNCTION_VERSION "1.8.0_1.0.1" /end FUNCTION
/begin FUNCTION Epm_SpdGrd "1.30.5_1.0.2Calculation of enginespeed gradient" /begin DEF_CHARACTERISTIC Epm_tiSpdGrdAvgFlt_C Epm_tiSpdGrdFlt_C /end DEF_CHARACTERISTIC
 /begin IN_MEASUREMENT EpmCrS_phiSeg EpmCrS_phiSegHiRes EpmCrS_tiSeg EpmHCrS_numIncWcy EpmSeq_numInt EpmSyn_phiInt Epm_ctCyl Epm_nEng Epm_nEngHiRes Epm_numCyl Epm_phiIgrTeethReSync Epm_stOpMode Epm_stReSync Epm_stSpd Epm_stSupressIni Epm_stSync /end IN_MEASUREMENT
 /begin OUT_MEASUREMENT Epm_bReSyncHiResGrd Epm_dnEng Epm_dnEngAvg Epm_dnEngAvgFlt Epm_dnEngFlt Epm_dnEngHiRes Epm_nEngDiff Epm_nEngDiffAvg /end OUT_MEASUREMENT
 /begin LOC_MEASUREMENT Epm_bDnEngHiResAllw_mp Epm_nEngHiResPrev_mp Epm_nEngOldS0_mp Epm_nEngOldS1_mp Epm_phiAbsPrev_mp Epm_phiBufLenMin_mp Epm_phiBufLen_mp Epm_stHiResGrdMsk_mp Epm_tiSegOfs_mp Epm_tiSegPrev_mp /end LOC_MEASUREMENT
 FUNCTION_VERSION "1.30.5_1.0.2" /end FUNCTION
/begin FUNCTION ESC_Stack "30000.15.0Functional component to provide sampling time for both time and angle synchronous rasters" /begin IN_MEASUREMENT EpmCrS_tiSeg EpmCrS_tiSegCurr /end IN_MEASUREMENT
 /begin LOC_MEASUREMENT ESC_stFrstSyncPreTsk ESC_stStackErr ESC_tiSampleSyncPreTsk ESC_tiSyncPreTskStrt /end LOC_MEASUREMENT
 FUNCTION_VERSION "30000.15.0" /end FUNCTION
/begin FUNCTION ESC_TaskLink "30000.13.0activation of engine speed synchronous tasks"
 /begin DEF_CHARACTERISTIC ESC_stS0GdiCalcnMaxRst_C ESC_stS1FrstSched_C ESC_stS1GdiCalcnMaxRst_C ESC_stSyncS0MaxRst_C ESC_stSyncS1MaxRst_C /end DEF_CHARACTERISTIC
 /begin IN_MEASUREMENT Eep_EnvRamInvld EpmSeq_numInt SyC_stSub SyC_tiDrv /end IN_MEASUREMENT
 /begin LOC_MEASUREMENT ESC_agSyncPreActvn ESC_cntStrtSyncPre ESC_dataMaxLoadS0GdiEnvram ESC_dataMaxLoadS1GdiEnvram ESC_dataMaxTskLoadS0Envram ESC_dataMaxTskLoadS1Envram ESC_dataS0GdiCalcnLoad ESC_dataS0GdiCalcnMaxLoad ESC_dataS1GdiCalcnLoad ESC_dataS1GdiCalcnMaxLoad ESC_dataSyncS0MaxTskLoad ESC_dataSyncS0TskLoad ESC_dataSyncS1MaxTskLoad ESC_dataSyncS1TskLoad ESC_stActivateSyncPre ESC_stActnSyncPre ESC_stmnSyncPre ESC_tiLftiMaxRtS0Envram ESC_tiLftiMaxRtS0GdiEnvram ESC_tiLftiMaxRtS1Envram ESC_tiLftiMaxRtS1GdiEnvram ESC_tiS0GdiCalcnRt ESC_tiS0GdiCalcnRtMax ESC_tiS1GdiCalcnRt ESC_tiS1GdiCalcnRtMax ESC_tiSyncPreDiff ESC_tiSyncPreTrigLtcy ESC_tiSyncS0TskRt ESC_tiSyncS0TskRtMax ESC_tiSyncS1TskRt ESC_tiSyncS1TskRtMax /end LOC_MEASUREMENT
 FUNCTION_VERSION "30000.13.0" /end FUNCTION
/begin FUNCTION ESDSDLUT "4.1.0     Determination delta standard deviation of engine roughness"
 /begin DEF_CHARACTERISTIC EngStrt_stStdDeEngRoughns_C KFSDLUSDMR KFSDLUSOL KFSDLUSRRI KLLUTS ZKASDLUTS ZKMSDLUTS /end DEF_CHARACTERISTIC
 /begin IN_MEASUREMENT anztib_w_msg B_sdluts_msg CEngDsT_tStrt dmrmx_w_msg Epm_stSpd luts_w_msg rri_w_msg SyC_stSub /end IN_MEASUREMENT
 /begin OUT_MEASUREMENT dsdluts_w_msg sdlutsol_w_msg sdluts_w_msg /end OUT_MEASUREMENT
 /begin LOC_MEASUREMENT lutsnorm_w tmsdluts /end LOC_MEASUREMENT
 FUNCTION_VERSION "4.1.0" /end FUNCTION
/begin FUNCTION ESGRU "7.3.0     Basic function injection"
 /begin DEF_CHARACTERISTIC CWRKAKAP FRKAP InjSys_facCylIndCorrn0_ATS_ATS.LimitTypeMsk_C InjSys_facCylIndCorrn0_ATS_ATS.CnvNorm_C InjSys_facCylIndCorrn0_ATS_ATS.LowLim_C InjSys_facCylIndCorrn0_ATS_ATS.UpLim_C InjSys_facCylIndCorrn0_ATS_ATS.CnvFac_C InjSys_facCylIndCorrn0_ATS_ATS.CnvOfs_C InjSys_facCylIndCorrn0_ATS_ATS.DfltVal_C InjSys_facCylIndCorrn1_ATS_ATS.LimitTypeMsk_C InjSys_facCylIndCorrn1_ATS_ATS.CnvNorm_C InjSys_facCylIndCorrn1_ATS_ATS.LowLim_C InjSys_facCylIndCorrn1_ATS_ATS.UpLim_C InjSys_facCylIndCorrn1_ATS_ATS.CnvFac_C InjSys_facCylIndCorrn1_ATS_ATS.CnvOfs_C InjSys_facCylIndCorrn1_ATS_ATS.DfltVal_C InjSys_facCylIndCorrn2_ATS_ATS.LimitTypeMsk_C InjSys_facCylIndCorrn2_ATS_ATS.CnvNorm_C InjSys_facCylIndCorrn2_ATS_ATS.LowLim_C InjSys_facCylIndCorrn2_ATS_ATS.UpLim_C InjSys_facCylIndCorrn2_ATS_ATS.CnvFac_C InjSys_facCylIndCorrn2_ATS_ATS.CnvOfs_C InjSys_facCylIndCorrn2_ATS_ATS.DfltVal_C InjSys_facCylIndCorrn3_ATS_ATS.LimitTypeMsk_C InjSys_facCylIndCorrn3_ATS_ATS.CnvNorm_C InjSys_facCylIndCorrn3_ATS_ATS.LowLim_C InjSys_facCylIndCorrn3_ATS_ATS.UpLim_C InjSys_facCylIndCorrn3_ATS_ATS.CnvFac_C InjSys_facCylIndCorrn3_ATS_ATS.CnvOfs_C InjSys_facCylIndCorrn3_ATS_ATS.DfltVal_C InjSys_facCylIndCorrn4_ATS_ATS.LimitTypeMsk_C InjSys_facCylIndCorrn4_ATS_ATS.CnvNorm_C InjSys_facCylIndCorrn4_ATS_ATS.LowLim_C InjSys_facCylIndCorrn4_ATS_ATS.UpLim_C InjSys_facCylIndCorrn4_ATS_ATS.CnvFac_C InjSys_facCylIndCorrn4_ATS_ATS.CnvOfs_C InjSys_facCylIndCorrn4_ATS_ATS.DfltVal_C InjSys_facCylIndCorrn5_ATS_ATS.LimitTypeMsk_C InjSys_facCylIndCorrn5_ATS_ATS.CnvNorm_C InjSys_facCylIndCorrn5_ATS_ATS.LowLim_C InjSys_facCylIndCorrn5_ATS_ATS.UpLim_C InjSys_facCylIndCorrn5_ATS_ATS.CnvFac_C InjSys_facCylIndCorrn5_ATS_ATS.CnvOfs_C InjSys_facCylIndCorrn5_ATS_ATS.DfltVal_C InjSys_facCylIndCorrn6_ATS_ATS.LimitTypeMsk_C InjSys_facCylIndCorrn6_ATS_ATS.CnvNorm_C InjSys_facCylIndCorrn6_ATS_ATS.LowLim_C InjSys_facCylIndCorrn6_ATS_ATS.UpLim_C InjSys_facCylIndCorrn6_ATS_ATS.CnvFac_C InjSys_facCylIndCorrn6_ATS_ATS.CnvOfs_C InjSys_facCylIndCorrn6_ATS_ATS.DfltVal_C InjSys_facCylIndCorrn7_ATS_ATS.LimitTypeMsk_C InjSys_facCylIndCorrn7_ATS_ATS.CnvNorm_C InjSys_facCylIndCorrn7_ATS_ATS.LowLim_C InjSys_facCylIndCorrn7_ATS_ATS.UpLim_C InjSys_facCylIndCorrn7_ATS_ATS.CnvFac_C InjSys_facCylIndCorrn7_ATS_ATS.CnvOfs_C InjSys_facCylIndCorrn7_ATS_ATS.DfltVal_C KLIPOLETH RKAKAP /end DEF_CHARACTERISTIC
 /begin REF_CHARACTERISTIC N0 NRKAB /end REF_CHARACTERISTIC
 /begin IN_MEASUREMENT Epm_nEngLRes fethstoe_msg /end IN_MEASUREMENT
 /begin OUT_MEASUREMENT fgru_msg fipoleth_msg InjSys_facRatFuMCylIndTstr rkakapb_w_msg /end OUT_MEASUREMENT
 /begin LOC_MEASUREMENT InjSys_facCylIndCorrnArry_ATS InjSys_facCylIndCorrnTstrLoc /end LOC_MEASUREMENT
 FUNCTION_VERSION "7.3.0" /end FUNCTION
/begin FUNCTION ESNSAD "3.3.0     Afterstart fuel adaptation"
 /begin DEF_CHARACTERISTIC DSDLUTSIMN DSDLUTSIMX KFFNSAMX KLFNSADETH KLFNSAMX KLNSADI KLNSADP KLZKNSADI TFNSADOFF TNSADHMX TNSEMX /end DEF_CHARACTERISTIC
 /begin IN_MEASUREMENT B_nsadh_msg B_nsad_msg CEngDsT_t dsdluts_w_msg fethmnmx_msg lamsbg_w_msg SyC_ctPostDrvLeave tnse_w_msg /end IN_MEASUREMENT
 /begin OUT_MEASUREMENT fnsad_w_msg /end OUT_MEASUREMENT
 /begin LOC_MEASUREMENT dsdliold_w dsdlutsi_w EngStrt_ctESNSADReIni100ms EngStrt_ctESNSADReIniSyncS0 EngStrt_facDesLamLimLoc EngStrt_ratStdDeEngRoughnsLoc ESNSAD_tEng flimit_w flimuebw_w fnsadi_w fnsadlim_w fnsadp_w tmotnsad /end LOC_MEASUREMENT
 FUNCTION_VERSION "3.3.0" /end FUNCTION
/begin COMPU_METHOD AngleCrS "" RAT_FUNC "%6.4" "deg CrS" COEFFS 0 45.5111111111 0 0 0 1 /end COMPU_METHOD
/begin COMPU_METHOD dez "" RAT_FUNC "%6.2" "" COEFFS 0 1 0 0 0 1 /end COMPU_METHOD
/begin COMPU_METHOD EngN "" RAT_FUNC "%6.3" "rpm" COEFFS 0 2 0 0 0 1 /end COMPU_METHOD
/begin COMPU_METHOD EngN2tiIncPer "" RAT_FUNC "%8.0" "rpm" COEFFS 0 0 1 0 4.0000002e-007 0 /end COMPU_METHOD
/begin COMPU_METHOD EngNGrd "" RAT_FUNC "%6.3" "rpm/s" COEFFS 0 2 0 0 0 1 /end COMPU_METHOD
/begin COMPU_METHOD EngN_float "" RAT_FUNC "%6.2" "rpm" COEFFS 0 1 0 0 0 1 /end COMPU_METHOD
/begin COMPU_METHOD EngN_LRes "" RAT_FUNC "%6.1" "rpm" COEFFS 0 0.025 0 0 0 1 /end COMPU_METHOD
/begin COMPU_METHOD EpmErr_ErrClass_t "" TAB_VERB "%6.3" "" COMPU_TAB_REF EpmErr_ErrClass_t /end COMPU_METHOD
/begin COMPU_VTAB EpmErr_ErrClass_t "" TAB_VERB 5 0 "EPMERR_NO_ERR_E" 1 "EPMERR_RPRT_E" 2 "EPMERR_RESYNC_E" 3 "EPMERR_INTERR_E" 4 "EPMERR_RSTRT_E" /end COMPU_VTAB
/begin COMPU_METHOD EpmHAgClk_AgClkFrq_t "" TAB_VERB "%6.3" "" COMPU_TAB_REF EpmHAgClk_AgClkFrq_t /end COMPU_METHOD
/begin COMPU_VTAB EpmHAgClk_AgClkFrq_t "" TAB_VERB 4 0 "AGCLK_FRQ_NORMAL" 1 "AGCLK_FRQ_HIGH" 2 "AGCLK_FRQ_LOW" 3 "AGCLK_FRQ_ZERO" /end COMPU_VTAB
/begin COMPU_METHOD EpmHAgClk_AgClkMode_t "" TAB_VERB "%6.3" "" COMPU_TAB_REF EpmHAgClk_AgClkMode_t /end COMPU_METHOD
/begin COMPU_VTAB EpmHAgClk_AgClkMode_t "" TAB_VERB 4 0 "AUTOMATICEND_MODE" 1 "CONTINUOUS_MODE" 2 "MIXED_MODE" 3 "EMERGENCY_MODE" /end COMPU_VTAB
/begin COMPU_METHOD EpmHAgClk_AgClkState_t "" TAB_VERB "%6.3" "" COMPU_TAB_REF EpmHAgClk_AgClkState_t /end COMPU_METHOD
/begin COMPU_VTAB EpmHAgClk_AgClkState_t "" TAB_VERB 2 0 "AGCLK_STOPPED" 1 "AGCLK_RUNNING" /end COMPU_VTAB
/begin COMPU_METHOD EpmHCrS_stRotDir_t "" TAB_VERB "%6.3" "" COMPU_TAB_REF EpmHCrS_stRotDir_t /end COMPU_METHOD
/begin COMPU_VTAB EpmHCrS_stRotDir_t "" TAB_VERB 4 0 "EPMHCRS_ROT_AMB" 1 "EPMHCRS_ROT_FWD" 2 "EPMHCRS_ROT_RVS" 3 "EPMHCRS_ROT_STOP" /end COMPU_VTAB
/begin COMPU_METHOD EpmHCrS_stSigMode_State_t "" TAB_VERB "%6.3" "" COMPU_TAB_REF EpmHCrS_stSigMode_State_t /end COMPU_METHOD
/begin COMPU_VTAB EpmHCrS_stSigMode_State_t "" TAB_VERB 10 0 "EPMHCRS_HALT" 1 "EPMHCRS_WAITSIG" 2 "EPMHCRS_IGNTIME" 3 "EPMHCRS_DEBEDGE" 4 "EPMHCRS_WAITGAP" 5 "EPMHCRS_VERIFYGAP" 6 "EPMHCRS_AMBIGAP_E" 7 "EPMHCRS_KEEPDGISYNC" 8 "EPMHCRS_GAPFOUND" 9 "EPMHCRS_DISABLNEWSYNC" /end COMPU_VTAB
/begin COMPU_METHOD EpmRRS_bEngStopAg_t "" TAB_VERB "%6.3" "" COMPU_TAB_REF EpmRRS_bEngStopAg_t /end COMPU_METHOD
/begin COMPU_VTAB EpmRRS_bEngStopAg_t "" TAB_VERB 2 0 "EPMRRS_AG_INVLD" 1 "EPMRRS_AG_VLD" /end COMPU_VTAB
/begin COMPU_METHOD EpmRRS_bEngSwOff_t "" TAB_VERB "%6.3" "" COMPU_TAB_REF EpmRRS_bEngSwOff_t /end COMPU_METHOD
/begin COMPU_VTAB EpmRRS_bEngSwOff_t "" TAB_VERB 2 0 "EPMRRS_ENGSWTOFF_INACTV" 1 "EPMRRS_ENGSWTOFF_ACTV" /end COMPU_VTAB
/begin COMPU_METHOD EpmRRS_stAgDetect_t "" TAB_VERB "%6.3" "" COMPU_TAB_REF EpmRRS_stAgDetect_t /end COMPU_METHOD
/begin COMPU_VTAB EpmRRS_stAgDetect_t "" TAB_VERB 3 0 "EPMRRS_DISABLE" 1 "EPMRRS_ENABLE" 2 "EPMRRS_CONFIRM" /end COMPU_VTAB
/begin COMPU_METHOD EpmRRS_stEngStopAg_t "" TAB_VERB "%6.3" "" COMPU_TAB_REF EpmRRS_stEngStopAg_t /end COMPU_METHOD
/begin COMPU_VTAB EpmRRS_stEngStopAg_t "" TAB_VERB 3 0 "EPMRRS_INVLD_STOP_POS" 1 "EPMRRS_VLD_PHASE_DETECT" 2 "EPMRRS_VLD_STOP_POS" /end COMPU_VTAB
/begin COMPU_METHOD EpmRRS_stRotDir_t "" TAB_VERB "%6.3" "" COMPU_TAB_REF EpmRRS_stRotDir_t /end COMPU_METHOD
/begin COMPU_VTAB EpmRRS_stRotDir_t "" TAB_VERB 4 0 "AMBI" 1 "FORWARD" 2 "BACKWARD" 3 "STOPPED" /end COMPU_VTAB
/begin COMPU_METHOD EpmSeq_EveId_t "" TAB_VERB "%6.3" "" COMPU_TAB_REF EpmSeq_EveId_t /end COMPU_METHOD
/begin COMPU_VTAB EpmSeq_EveId_t "" TAB_VERB 18 0 "EVEHNDLR_ERROR" 1 "CRS_EDGE" 2 "CRS_DYNTIMEOUT" 3 "CRS_TIMEOUT" 4 "CAS_1_EDGE" 5 "CAS_1_TIMEOUT" 6 "CAS_2_EDGE" 7 "CAS_2_TIMEOUT" 8 "CAS_3_EDGE" 9 "CAS_3_TIMEOUT" 10 "CAS_4_EDGE" 11 "CAS_4_TIMEOUT" 12 "STOPBACKUP" 13 "STARTBACKUP" 14 "AG_CLOCK" 15 "FORCE_RESYNC" 16 "EPMRRS_DIRECTION" 17 "LAST_EVENT" /end COMPU_VTAB
/begin COMPU_METHOD EpmSeq_numInt_Compu "" TAB_VERB "%6.3" "" COMPU_TAB_REF EpmSeq_numInt_Compu /end COMPU_METHOD
/begin COMPU_VTAB EpmSeq_numInt_Compu "" TAB_VERB 11 0 "EPMSEQ_S_0" 1 "EPMSEQ_S_1" 2 "EPMSEQ_S_0_FIRST" 3 "EPMSEQ_S_1_FIRST" 6 "EPMSEQ_S_0_FIRST_START" 7 "EPMSEQ_S_1_FIRST_START" 8 "EPMSEQ_S_EPM" 16 "EPMSEQ_S_INI" 32 "EPMSEQ_S_0_H" 34 "EPMSEQ_S_0_H_FIRST" 38 "EPMSEQ_S_0_H_FIRST_START" /end COMPU_VTAB
/begin COMPU_METHOD EpmSeq_stIntrptGen_Compu "" TAB_VERB "%6.3" "" COMPU_TAB_REF EpmSeq_stIntrptGen_Compu /end COMPU_METHOD
/begin COMPU_VTAB EpmSeq_stIntrptGen_Compu "" TAB_VERB 4 0 "EPMSEQ_NO_INTRPTGEN" 1 "EPMSEQ_INTRPTGEN_STRT" 2 "EPMSEQ_INTRPTGEN_RGL" 4 "EPMSEQ_INTRPTGEN_BCR" /end COMPU_VTAB
/begin COMPU_METHOD EpmSeq_stInt_Compu "" TAB_VERB "%6.3" "" COMPU_TAB_REF EpmSeq_stInt_Compu /end COMPU_METHOD
/begin COMPU_VTAB EpmSeq_stInt_Compu "" TAB_VERB 8 0 "EPMSEQ_ST_S_0" 1 "EPMSEQ_ST_S_1" 4 "EPMSEQ_ST_S_0_START" 5 "EPMSEQ_ST_S_1_START" 8 "EPMSEQ_ST_EPM" 16 "EPMSEQ_ST_INI" 32 "EPMSEQ_ST_S_0_H" 36 "EPMSEQ_ST_S_0_H_START" /end COMPU_VTAB
/begin COMPU_METHOD EpmSeq_stReqIntrptGen_Compu "" TAB_VERB "%6.3" "" COMPU_TAB_REF EpmSeq_stReqIntrptGen_Compu /end COMPU_METHOD
/begin COMPU_VTAB EpmSeq_stReqIntrptGen_Compu "" TAB_VERB 2 0 "EPMSEQ_NO_INTRPT_REQ" 1 "EPMSEQ_GEN_STRT_INTRPT" /end COMPU_VTAB
/begin COMPU_METHOD EpmSeq_swtInt_Compu "" TAB_VERB "%6.3" "" COMPU_TAB_REF EpmSeq_swtInt_Compu /end COMPU_METHOD
/begin COMPU_VTAB EpmSeq_swtInt_Compu "" TAB_VERB 9 0 "STRTIR_S1CLB" 1 "STRTIR_S1AUT" 2 "STRTIR_NOS1IR" 4 "NOSTRTIR_S1CLB" 5 "NOSTRTIR_S1AUT" 6 "NOSTRTIR_NOS1IR" 16 "EXTINTRPTREQ_S1CLB" 17 "EXTINTRPTREQ_S1AUT" 18 "EXTINTRPTREQ_NOS1IR" /end COMPU_VTAB
/begin COMPU_METHOD EpmSrv_stCnvAgT2Ag_t "" TAB_VERB "%6.3" "" COMPU_TAB_REF EpmSrv_stCnvAgT2Ag_t /end COMPU_METHOD
/begin COMPU_VTAB EpmSrv_stCnvAgT2Ag_t "" TAB_VERB 31 0 "0" 1 "1" 2 "2" 3 "3" 4 "4" 5 "5" 6 "6" 7 "7" 8 "8" 9 "9" 10 "10" 11 "11" 12 "12" 13 "13" 14 "14" 15 "15" 16 "16" 17 "17" 18 "18" 19 "19" 20 "20" 21 "21" 22 "22" 23 "23" 24 "24" 25 "AVRGSPD" 26 "EXTRAPOLATION" 252 "EPMSRV_EXTPOL_MIAPFLT" 253 "ERRORSTGY" 254 "ERRORCRS" 255 "ERRORMIAP" /end COMPU_VTAB
/begin COMPU_METHOD EpmSyn_stCaSEvalComp "" TAB_VERB "%6.3" "" COMPU_TAB_REF EpmSyn_stCaSEvalComp /end COMPU_METHOD
/begin COMPU_VTAB EpmSyn_stCaSEvalComp "" TAB_VERB 5 0 "NO_CASPOS" 1 "SEARCH_CASPOS" 2 "VERIFY_CASPOS" 3 "SWTOFF_CASPOS" 4 "EVAL_CASPOS" /end COMPU_VTAB
/begin COMPU_METHOD EpmSyn_stCaSPosComp "" TAB_VERB "%6.3" "" COMPU_TAB_REF EpmSyn_stCaSPosComp /end COMPU_METHOD
/begin COMPU_VTAB EpmSyn_stCaSPosComp "" TAB_VERB 9 0 "EPMSYN_CASPOS_NOTVALID" 1 "EPMSYN_SIGTAB_NOUPDATE" 2 "EPMSYN_SIGTAB_AMBI" 5 "EPMSYN_CASPOS_VALID" 10 "EPMSYN_WRONG_SEG_LEN" 11 "EPMSYN_SIGTAB_END" 12 "EPMSYN_SIGTAB_SEQ" 13 "EPMSYN_EXCEED_TOLC" 20 "EPMSYN_CASPOS_SWTOFF" /end COMPU_VTAB
/begin COMPU_METHOD EpmSyn_stCrSPos_State_t "" TAB_VERB "%6.3" "" COMPU_TAB_REF EpmSyn_stCrSPos_State_t /end COMPU_METHOD
/begin COMPU_VTAB EpmSyn_stCrSPos_State_t "" TAB_VERB 4 0 "EPMSYN_NO_SYNC" 1 "EPMSYN_CRS_SYNC" 2 "EPMSYN_CAS_SYNC" 3 "EPMSYN_FULL_SYNC" /end COMPU_VTAB
/begin COMPU_METHOD EpmSyn_stRRComp "" TAB_VERB "%6.3" "" COMPU_TAB_REF EpmSyn_stRRComp /end COMPU_METHOD
/begin COMPU_VTAB EpmSyn_stRRComp "" TAB_VERB 2 0 "EPMSYN_FORWARDS" 1 "EPMSYN_BACKWARDS" /end COMPU_VTAB
/begin COMPU_METHOD EPM_FAC_PLAUS "" RAT_FUNC "%6.4" "-" COEFFS 0 16 0 0 0 1 /end COMPU_METHOD
/begin COMPU_METHOD Epm_ModId_t "" TAB_VERB "%6.3" "" COMPU_TAB_REF Epm_ModId_t /end COMPU_METHOD
/begin COMPU_VTAB Epm_ModId_t "" TAB_VERB 81 0 "EMPTY_ID" 1 "EPM_INI_ID" 2 "EPM_OPMODE_ID" 3 "EPM_SPD_ID" 4 "ENGDA_NENGREV_ID" 5 "EPM_AXISPOINTS_ID" 6 "EPM_HE_ID" 7 "EPM_OUT_ID" 8 "EPM_SPDGRD_ID" 9 "EPM_SPDOUT_ID" 10 "EPM_SPDPLAUS_ID" 11 "EPM_SWADP_ID" 12 "EPM_TRACE_ID" 13 "ENGSPD_DD_ID" 14 "HT2KTTD_ID" 15 "EPMBCA_TSTINJ_ID" 16 "EPMBCR_DYN_ID" 17 "EPMBCR_INTRCO_ID" 18 "EPMBCR_PLAUS_ID" 19 "EPMBCR_POS_ID" 20 "EPMCAS_ADAP_ID" 21 "EPMCAS_DIAG_ID" 22 "EPMCAS_MEAS_ID" 23 "EPMCAS_MON_ID" 24 "EPMCAS_OFSDIAG_ID" 25 "EPMCAS_OUT_ID" 26 "EPMCAS_SEG_ID" 27 "EPMCRS_DIAG_ID" 28 "EPMCRS_DIAGSYNCLOST_ID" 29 "EPMCRS_DIAGSYNCINJLOST_ID" 30 "EPMCRS_MON_ID" 31 "EPMCRS_PLAUS_ID" 32 "EPMCRS_REVCNT_ID" 33 "EPMCRS_SEG_ID" 34 "EPM_CUSTADP_ID" 35 "EPMERR_TRACE_ID" 36 "EPMERT_SEG_ID" 37 "EPMRRS_AGDETECT_ID" 38 "EPMRRS_PREDICT_ID" 39 "EPMRRS_STALLDETECT_ID" 40 "EPMRRS_STOPDETECT_ID" 41 "EPMSEQ_EVEHNDLR_ID" 42 "EPMSEQ_STATEMN_ID" 43 "EPMSPC_DIAGCAS_ID" 44 "EPMSPC_DIAGCRS_ID" 45 "EPMSRV_LIB_ID" 46 "EPMSYN_CAMSFTPST_ID" 47 "EPMSYN_CASPOS_ID" 48 "EPMSYN_CO_ID" 49 "EPMSYN_CPP_ID" 50 "EPMSYN_CRKSFTPAT_ID" 51 "EPMSYN_CRKSFTTOOTHT_ID" 52 "EPMSYN_CRSPOS_ID" 53 "EPMSYN_DBLLGN_ID" 54 "EPMSYN_INJRLS_ID" 55 "EPMSYN_INTKMNFLDP_ID" 56 "EPMSYN_TESTINJ_ID" 57 "EPMTDC_ADAP_ID" 58 "EPMTDC_CTL_ID" 59 "EPMHWE_FIL_ID" 60 "EPMHWE_INI_ID" 61 "EPMHWE_SRV_ID" 62 "EPMHAGCLK_GEN_ID" 63 "EPMHAGCLK_TRIGEVE_ID" 64 "EPMHCAS_DELAY_ID" 65 "EPMHCAS_INTERFACE_ID" 66 "EPMHCAS_SIGBUF_ID" 67 "EPMHCAS_SIGEVAL_ID" 68 "EPMHCRS_DIREVLN_ID" 69 "EPMHCRS_DYNPLAUS_ID" 70 "EPMHCRS_INTERFACE_ID" 71 "EPMHCRS_SAMPLING_ID" 72 "EPMHCRS_SIGBUF_ID" 73 "EPMHCRS_SIGEVAL_ID" 74 "EPMHCRS_STMAC_ID" 75 "EPMHERT_SIGBUF_ID" 76 "EPMHERT_SIGEVAL_ID" 77 "EPMHINT_INTGEN_ID" 78 "EPMHSPC_CHECK_ID" 79 "EPMHAGCLK_TRIG_ID" 80 "EPMHCRS_INTHNDLR_ID" /end COMPU_VTAB
/begin COMPU_METHOD Epm_SensTypCrS_t "" TAB_VERB "%6.3" "" COMPU_TAB_REF Epm_SensTypCrS_t /end COMPU_METHOD
/begin COMPU_VTAB Epm_SensTypCrS_t "" TAB_VERB 3 0 "STD" 1 "DGI" 2 "DG_DGI" /end COMPU_VTAB
/begin COMPU_METHOD Epm_stCmbTestReq_State_t "" TAB_VERB "%6.3" "" COMPU_TAB_REF Epm_stCmbTestReq_State_t /end COMPU_METHOD
/begin COMPU_VTAB Epm_stCmbTestReq_State_t "" TAB_VERB 2 0 "EPM_NO_CMBTEST" 10 "EPM_CMBTEST" /end COMPU_VTAB
/begin COMPU_METHOD Epm_stDirstaleReady_State_t "" TAB_VERB "%6.3" "" COMPU_TAB_REF Epm_stDirstaleReady_State_t /end COMPU_METHOD
/begin COMPU_VTAB Epm_stDirstaleReady_State_t "" TAB_VERB 2 0 "EPM_DIRST_NOT_READY" 10 "EPM_DIRST_READY" /end COMPU_VTAB
/begin COMPU_METHOD EPM_STENGPOS_VERB "" TAB_VERB "%6.3" "" COMPU_TAB_REF EPM_STENGPOS_VERB /end COMPU_METHOD
/begin COMPU_VTAB EPM_STENGPOS_VERB "" TAB_VERB 2 0 "STORED_STOP_POS" 1 "TRACKING_ACTUAL_POS" /end COMPU_VTAB
/begin COMPU_METHOD Epm_stExtraPol_t "" TAB_VERB "%6.3" "" COMPU_TAB_REF Epm_stExtraPol_t /end COMPU_METHOD
/begin COMPU_VTAB Epm_stExtraPol_t "" TAB_VERB 4 0 "EPM_SET_TO_ZERO" 1 "EPM_HOLD_LAST_PERIOD" 2 "EPM_EXTRAPOLATE" 3 "EPM_DIR_CHANGE" /end COMPU_VTAB
/begin COMPU_METHOD Epm_stOpMode_State_t "" TAB_VERB "%6.3" "" COMPU_TAB_REF Epm_stOpMode_State_t /end COMPU_METHOD
/begin COMPU_VTAB Epm_stOpMode_State_t "" TAB_VERB 8 1 "EPM_MODE_WAIT" 5 "EPM_MODE_LOCKRESYNC" 20 "EPM_MODE_ALE" 33 "EPM_MODE_VERIFY" 36 "EPM_MODE_VERIFY_EXT" 38 "EPM_MODE_BACKUP_CAS" 48 "EPM_MODE_OK" 60 "EPM_MODE_BACKUP_CRS" /end COMPU_VTAB
/begin COMPU_METHOD Epm_stPosDGI_State_t "" TAB_VERB "%6.3" "" COMPU_TAB_REF Epm_stPosDGI_State_t /end COMPU_METHOD
/begin COMPU_VTAB Epm_stPosDGI_State_t "" TAB_VERB 2 0 "EPM_NO_DGI_POS" 1 "EPM_USE_DGI_POS" /end COMPU_VTAB
/begin COMPU_METHOD Epm_stReSyncReason_State_t "" TAB_VERB "%6.3" "" COMPU_TAB_REF Epm_stReSyncReason_State_t /end COMPU_METHOD
/begin COMPU_VTAB Epm_stReSyncReason_State_t "" TAB_VERB 18 0 "EPM_RESYNC_NORESYNC" 1 "EPM_RESYNC_CRS_ERR_OR_STOP" 2 "EPM_RESYNC_SHIFT" 3 "EPM_RESYNC_CAS_ERROR" 4 "EPM_RESYNC_REVERSE_CRS" 5 "EPM_RESYNC_OFSERR" 6 "EPM_RESYNC_CANERR" 7 "EPM_RESYNC_UPPERLVL" 8 "EPM_RESYNC_REVERSE_CAS" 9 "EPM_RESYNC_START_BCR" 10 "EPM_RESYNC_RRS_SHIFT" 11 "EPM_RESYNC_LOCK_END" 12 "EPM_RESYNC_BCR_POS_NOT_PLAUS" 13 "EPM_RESYNC_BCR_RESTART" 14 "EPM_RESYNC_CRS_MIN_SPEED" 15 "EPM_RESYNC_BCR_NO_CAS_SPEED" 16 "EPM_RESYNC_BCR_NORESYNC" 17 "EPM_RESYNC_AGCLK_NOT_PLAUS" /end COMPU_VTAB
/begin COMPU_METHOD Epm_stSpd_t "" TAB_VERB "%6.3" "" COMPU_TAB_REF Epm_stSpd_t /end COMPU_METHOD
/begin COMPU_VTAB Epm_stSpd_t "" TAB_VERB 5 0 "EPM_SPD_CRS" 1 "EPM_SPD_HOLD" 2 "EPM_SPD_ZERO" 3 "EPM_SPD_CAS" 4 "EPM_SPD_BACKUP" /end COMPU_VTAB
/begin COMPU_METHOD Epm_stSync_State_t "" TAB_VERB "%6.3" "" COMPU_TAB_REF Epm_stSync_State_t /end COMPU_METHOD
/begin COMPU_VTAB Epm_stSync_State_t "" TAB_VERB 5 0 "EPM_NO_SYNC" 10 "EPM_ALE_SYNC" 20 "EPM_CAS_SYNC" 21 "EPM_DIRSTALE_SYNC" 30 "EPM_FULL_SYNC" /end COMPU_VTAB
/begin COMPU_METHOD ESC_MaxRtTskLoad_Rst_t "" TAB_VERB "%6.3" "" COMPU_TAB_REF ESC_MaxRtTskLoad_Rst_t /end COMPU_METHOD
/begin COMPU_VTAB ESC_MaxRtTskLoad_Rst_t "" TAB_VERB 2 0 "ESC_ENABLE_MAX_MEASMT" 1 "ESC_RESET_MAX_MEASMT" /end COMPU_VTAB
/begin COMPU_METHOD ESC_stS1FrstSched_t "" TAB_VERB "%6.3" "" COMPU_TAB_REF ESC_stS1FrstSched_t /end COMPU_METHOD
/begin COMPU_VTAB ESC_stS1FrstSched_t "" TAB_VERB 4 0 "ESC_SX_SCHEDSTRT" 1 "ESC_S1_SCHEDSTRT" 2 "ESC_S0_SCHEDSTRT" 3 "ESC_S1FORCED_SCHEDSTRT" /end COMPU_VTAB
/begin COMPU_METHOD FactLow "" RAT_FUNC "%6.5" "-" COEFFS 0 1024 0 0 0 1 /end COMPU_METHOD
/begin COMPU_METHOD fak_sw_b1 "" RAT_FUNC "%7.6" "-" COEFFS 0 65536 0 0 0 2 /end COMPU_METHOD
/begin COMPU_METHOD fak_ub_b1 "" RAT_FUNC "%6.4" "-" COEFFS 0 256 0 0 0 1 /end COMPU_METHOD
/begin COMPU_METHOD fak_ub_b2 "" RAT_FUNC "%8.5" "-" COEFFS 0 256 0 0 0 2 /end COMPU_METHOD
/begin COMPU_METHOD fak_uw_b1 "" RAT_FUNC "%7.6" "-" COEFFS 0 65536 0 0 0 1 /end COMPU_METHOD
/begin COMPU_METHOD fak_uw_b16 "" RAT_FUNC "%6.5" "-" COEFFS 0 65536 0 0 0 16 /end COMPU_METHOD
/begin COMPU_METHOD fak_uw_b2 "" RAT_FUNC "%7.6" "-" COEFFS 0 65536 0 0 0 2 /end COMPU_METHOD
/begin COMPU_METHOD fak_uw_b4 "" RAT_FUNC "%7.6" "-" COEFFS 0 65536 0 0 0 4 /end COMPU_METHOD
/begin COMPU_METHOD INJSYS_INJTMNGVRNT_SC_Compu "" TAB_VERB "%6.3" "" COMPU_TAB_REF INJSYS_INJTMNGVRNT_SC_Compu /end COMPU_METHOD
/begin COMPU_VTAB INJSYS_INJTMNGVRNT_SC_Compu "" TAB_VERB 2 0 "InjTiming_Variant_1" 1 "InjTiming_Variant_2" /end COMPU_VTAB
/begin COMPU_METHOD INJSYS_POI1SETPOINT_SY_Compu "" RAT_FUNC "%6.2" "" COEFFS 0 1 0 0 0 1 /end COMPU_METHOD
/begin COMPU_METHOD INJSYS_POI2SETPOINT_SY_Compu "" RAT_FUNC "%6.2" "" COEFFS 0 1 0 0 0 1 /end COMPU_METHOD
/begin COMPU_METHOD INJSYS_POI3SETPOINT_SY_Compu "" RAT_FUNC "%6.2" "" COEFFS 0 1 0 0 0 1 /end COMPU_METHOD
/begin COMPU_METHOD INJSYS_RAILLEAKTST_SY_Compu "" TAB_VERB "%6.3" "" COMPU_TAB_REF INJSYS_RAILLEAKTST_SY_Compu /end COMPU_METHOD
/begin COMPU_VTAB INJSYS_RAILLEAKTST_SY_Compu "" TAB_VERB 2 0 "False" 1 "True" /end COMPU_VTAB
/begin COMPU_METHOD INJSYS_TWNINJR_SC_Compu "" TAB_VERB "%6.3" "" COMPU_TAB_REF INJSYS_TWNINJR_SC_Compu /end COMPU_METHOD
/begin COMPU_VTAB INJSYS_TWNINJR_SC_Compu "" TAB_VERB 2 0 "False" 1 "True" /end COMPU_VTAB
/begin COMPU_METHOD INJSYS_TWOSTEPINJ_SC_Compu "" TAB_VERB "%6.3" "" COMPU_TAB_REF INJSYS_TWOSTEPINJ_SC_Compu /end COMPU_METHOD
/begin COMPU_VTAB INJSYS_TWOSTEPINJ_SC_Compu "" TAB_VERB 2 0 "False" 1 "True" /end COMPU_VTAB
/begin COMPU_METHOD InjTimeHiRes_us "" RAT_FUNC "%6.4" "us" COEFFS 0 20 0 0 0 1 /end COMPU_METHOD
/begin COMPU_METHOD InjTime_us "" RAT_FUNC "%6.3" "us" COEFFS 0 2.5 0 0 0 1 /end COMPU_METHOD
/begin COMPU_METHOD INJTMNGDIAGPRS_SC_Compu "" TAB_VERB "%6.3" "" COMPU_TAB_REF INJTMNGDIAGPRS_SC_Compu /end COMPU_METHOD
/begin COMPU_VTAB INJTMNGDIAGPRS_SC_Compu "" TAB_VERB 3 0 "NO_CSERS" 1 "LEVEL1_CSERS" 2 "LEVEL2_CSERS" /end COMPU_VTAB
/begin COMPU_METHOD INJVLVPS_DIASMALLTI_SY_Compu "" TAB_VERB "%6.3" "" COMPU_TAB_REF INJVLVPS_DIASMALLTI_SY_Compu /end COMPU_METHOD
/begin COMPU_VTAB INJVLVPS_DIASMALLTI_SY_Compu "" TAB_VERB 3 0 "NO_DIA_SMALL_TI" 1 "DIA_SMALL_TI" 2 "DIA_SMALL_TI_AND_PIN_POINTING" /end COMPU_VTAB
/begin COMPU_METHOD INJVLV_ADDRLY_SY_Compu "" RAT_FUNC "%6.2" "" COEFFS 0 1 0 0 0 1 /end COMPU_METHOD
/begin COMPU_METHOD INJVLV_ATSINJSP_SC_Compu "" TAB_VERB "%6.3" "" COMPU_TAB_REF INJVLV_ATSINJSP_SC_Compu /end COMPU_METHOD
/begin COMPU_VTAB INJVLV_ATSINJSP_SC_Compu "" TAB_VERB 4 0 "0" 1 "1" 2 "2" 3 "3" /end COMPU_VTAB
/begin COMPU_METHOD INJVLV_ATS_SY_Compu "" TAB_VERB "%6.3" "" COMPU_TAB_REF INJVLV_ATS_SY_Compu /end COMPU_METHOD
/begin COMPU_VTAB INJVLV_ATS_SY_Compu "" TAB_VERB 2 0 "False" 1 "True" /end COMPU_VTAB
/begin COMPU_METHOD INJVLV_CRNTPRFLMOD_SY_Compu "" TAB_VERB "%6.3" "" COMPU_TAB_REF INJVLV_CRNTPRFLMOD_SY_Compu /end COMPU_METHOD
/begin COMPU_VTAB INJVLV_CRNTPRFLMOD_SY_Compu "" TAB_VERB 4 0 "RB_3" 1 "Custom_3" 2 "RB_4" 3 "Custom_4" /end COMPU_VTAB
/begin COMPU_METHOD INJVLV_ENDC_SY_Compu "" TAB_VERB "%6.3" "" COMPU_TAB_REF INJVLV_ENDC_SY_Compu /end COMPU_METHOD
/begin COMPU_VTAB INJVLV_ENDC_SY_Compu "" TAB_VERB 2 0 "False" 1 "True" /end COMPU_VTAB
/begin COMPU_METHOD INJVLV_NUMDCDC_SY_Compu "" TAB_VERB "%6.3" "" COMPU_TAB_REF INJVLV_NUMDCDC_SY_Compu /end COMPU_METHOD
/begin COMPU_VTAB INJVLV_NUMDCDC_SY_Compu "" TAB_VERB 3 0 "0" 1 "1" 2 "2" /end COMPU_VTAB
/begin COMPU_METHOD INJVLV_PSIC_SC_Compu "" TAB_VERB "%6.3" "" COMPU_TAB_REF INJVLV_PSIC_SC_Compu /end COMPU_METHOD
/begin COMPU_VTAB INJVLV_PSIC_SC_Compu "" TAB_VERB 8 0 "CJ841" 1 "CJ870" 2 "CY335" 3 "CY372" 4 "CY375" 5 "SC900685" 6 "CY373" 7 "CY374" /end COMPU_VTAB
/begin COMPU_METHOD INJVLV_PSNR_SC_Compu "" RAT_FUNC "%6.2" "" COEFFS 0 1 0 0 0 1 /end COMPU_METHOD
/begin COMPU_METHOD INJVLV_STOREFLTONVEHSTOP_SC_Compu "" TAB_VERB "%6.3" "" COMPU_TAB_REF INJVLV_STOREFLTONVEHSTOP_SC_Compu /end COMPU_METHOD
/begin COMPU_VTAB INJVLV_STOREFLTONVEHSTOP_SC_Compu "" TAB_VERB 2 0 "Off" 1 "On" /end COMPU_VTAB
/begin COMPU_METHOD INJVLV_VLVTYPE_SY_Compu "" TAB_VERB "%6.3" "" COMPU_TAB_REF INJVLV_VLVTYPE_SY_Compu /end COMPU_METHOD
/begin COMPU_VTAB INJVLV_VLVTYPE_SY_Compu "" TAB_VERB 2 1 "SOLENOID" 2 "PIEZO" /end COMPU_VTAB
/begin COMPU_METHOD INJVVG_VAR_SY_Compu "" TAB_VERB "%6.3" "" COMPU_TAB_REF INJVVG_VAR_SY_Compu /end COMPU_METHOD
/begin COMPU_VTAB INJVVG_VAR_SY_Compu "" TAB_VERB 43 1 "DAI" 3 "VWW" 4 "POR" 5 "AUD" 6 "OPE" 9 "FIA" 11 "BMW" 14 "PSA" 15 "REN" 17 "ALF" 18 "SAB" 19 "VOL" 20 "NIS" 21 "GMU" 22 "FOR" 26 "IMJ" 51 "SEA" 53 "CHR" 54 "JAG" 55 "ROL" 69 "FER" 72 "TOY" 123 "MIT" 147 "HYU" 159 "HON" 160 "MAZ" 183 "CU" 190 "LRG" 204 "VVW" 214 "AVT" 242 "Iveco" 243 "DMC" 248 "SUZ" 267 "SSANGYONG" 270 "KEF" 289 "AMG" 308 "TAT" 319 "MVM" 385 "UAES" 828 "RBCD" 898 "MFTBC" 999 "ALL" 9454 "Fuso" /end COMPU_VTAB
/begin COMPU_METHOD InrtTrq_COMPU "" RAT_FUNC "%6.5" "kg*s^2" COEFFS 0 1024 0 0 0 1 /end COMPU_METHOD
/begin COMPU_METHOD INTGMGMT_SC_Compu "" TAB_VERB "%6.3" "" COMPU_TAB_REF INTGMGMT_SC_Compu /end COMPU_METHOD
/begin COMPU_VTAB INTGMGMT_SC_Compu "" TAB_VERB 2 0 "False" 1 "True" /end COMPU_VTAB
/begin COMPU_METHOD INTKAIRTSNSR1TYP_SC_Compu "" TAB_VERB "%6.3" "" COMPU_TAB_REF INTKAIRTSNSR1TYP_SC_Compu /end COMPU_METHOD
/begin COMPU_VTAB INTKAIRTSNSR1TYP_SC_Compu "" TAB_VERB 7 0 "no_snsr" 1 "ADC" 2 "ADC_CrssSwt" 3 "FAS" 4 "SENT" 5 "LIN" 255 "Switch" /end COMPU_VTAB
/begin COMPU_METHOD INTKAIRTSNSR2TYP_SC_Compu "" TAB_VERB "%6.3" "" COMPU_TAB_REF INTKAIRTSNSR2TYP_SC_Compu /end COMPU_METHOD
/begin COMPU_VTAB INTKAIRTSNSR2TYP_SC_Compu "" TAB_VERB 6 0 "no_snsr" 1 "ADC" 2 "ADC_CrssSwt" 3 "FAS" 4 "SENT" 255 "Switch" /end COMPU_VTAB
/begin COMPU_METHOD INTKAIRTSNSR3TYP_SC_Compu "" TAB_VERB "%6.3" "" COMPU_TAB_REF INTKAIRTSNSR3TYP_SC_Compu /end COMPU_METHOD
/begin COMPU_VTAB INTKAIRTSNSR3TYP_SC_Compu "" TAB_VERB 7 0 "no_snsr" 1 "ADC" 2 "ADC_CrssSwt" 3 "FAS" 4 "SENT" 5 "LIN" 255 "Switch" /end COMPU_VTAB
/begin COMPU_METHOD INTKAIRTSNSR4TYP_SC_Compu "" TAB_VERB "%6.3" "" COMPU_TAB_REF INTKAIRTSNSR4TYP_SC_Compu /end COMPU_METHOD
/begin COMPU_VTAB INTKAIRTSNSR4TYP_SC_Compu "" TAB_VERB 6 0 "no_snsr" 1 "ADC" 2 "ADC_CrssSwt" 3 "FAS" 4 "SENT" 255 "Switch" /end COMPU_VTAB
/begin COMPU_METHOD INTKAIRTSNSR5TYP_SC_Compu "" TAB_VERB "%6.3" "" COMPU_TAB_REF INTKAIRTSNSR5TYP_SC_Compu /end COMPU_METHOD
/begin COMPU_VTAB INTKAIRTSNSR5TYP_SC_Compu "" TAB_VERB 6 0 "no_sensor" 1 "ADC" 2 "ADC_CrssSwt" 3 "FAS" 4 "SENT" 255 "Switch" /end COMPU_VTAB
/begin COMPU_METHOD INTKAIRTSNSR6TYP_SC_Compu "" TAB_VERB "%6.3" "" COMPU_TAB_REF INTKAIRTSNSR6TYP_SC_Compu /end COMPU_METHOD
/begin COMPU_VTAB INTKAIRTSNSR6TYP_SC_Compu "" TAB_VERB 6 0 "no_sensor" 1 "ADC" 2 "ADC_CrssSwt" 3 "FAS" 4 "SENT" 255 "Switch" /end COMPU_VTAB
/begin COMPU_METHOD INTKAIRT_AIRFILDSB2_SC_Compu "" TAB_VERB "%6.3" "" COMPU_TAB_REF INTKAIRT_AIRFILDSB2_SC_Compu /end COMPU_METHOD
/begin COMPU_VTAB INTKAIRT_AIRFILDSB2_SC_Compu "" TAB_VERB 3 0 "no_signal" 1 "sensor" 2 "model" /end COMPU_VTAB
/begin COMPU_METHOD INTKAIRT_AIRFILDS_SC_Compu "" TAB_VERB "%6.3" "" COMPU_TAB_REF INTKAIRT_AIRFILDS_SC_Compu /end COMPU_METHOD
/begin COMPU_VTAB INTKAIRT_AIRFILDS_SC_Compu "" TAB_VERB 3 0 "no_signal" 1 "sensor" 2 "model" /end COMPU_VTAB
/begin COMPU_METHOD INTKAIRT_CMPR2USB2_SC_Compu "" TAB_VERB "%6.3" "" COMPU_TAB_REF INTKAIRT_CMPR2USB2_SC_Compu /end COMPU_METHOD
/begin COMPU_VTAB INTKAIRT_CMPR2USB2_SC_Compu "" TAB_VERB 3 0 "no_signal" 1 "sensor" 2 "model" /end COMPU_VTAB
/begin COMPU_METHOD INTKAIRT_CMPR2US_SC_Compu "" TAB_VERB "%6.3" "" COMPU_TAB_REF INTKAIRT_CMPR2US_SC_Compu /end COMPU_METHOD
/begin COMPU_VTAB INTKAIRT_CMPR2US_SC_Compu "" TAB_VERB 3 0 "no_signal" 1 "sensor" 2 "model" /end COMPU_VTAB
/begin COMPU_METHOD INTKAIRT_CMPRDSB2_SC_Compu "" TAB_VERB "%6.3" "" COMPU_TAB_REF INTKAIRT_CMPRDSB2_SC_Compu /end COMPU_METHOD
/begin COMPU_VTAB INTKAIRT_CMPRDSB2_SC_Compu "" TAB_VERB 3 0 "no_signal" 1 "sensor" 2 "model" /end COMPU_VTAB
/begin COMPU_METHOD INTKAIRT_CMPRDS_SC_Compu "" TAB_VERB "%6.3" "" COMPU_TAB_REF INTKAIRT_CMPRDS_SC_Compu /end COMPU_METHOD
/begin COMPU_VTAB INTKAIRT_CMPRDS_SC_Compu "" TAB_VERB 3 0 "no_signal" 1 "sensor" 2 "model" /end COMPU_VTAB
/begin COMPU_METHOD INTKAIRT_INTKMNFLDB2_SC_Compu "" TAB_VERB "%6.3" "" COMPU_TAB_REF INTKAIRT_INTKMNFLDB2_SC_Compu /end COMPU_METHOD
/begin COMPU_VTAB INTKAIRT_INTKMNFLDB2_SC_Compu "" TAB_VERB 3 0 "no_signal" 1 "sensor" 2 "model" /end COMPU_VTAB
/begin COMPU_METHOD INTKAIRT_INTKMNFLDSNSRMDL_SC_Compu "" TAB_VERB "%6.3" "" COMPU_TAB_REF INTKAIRT_INTKMNFLDSNSRMDL_SC_Compu /end COMPU_METHOD
/begin COMPU_VTAB INTKAIRT_INTKMNFLDSNSRMDL_SC_Compu "" TAB_VERB 2 0 "False" 1 "True" /end COMPU_VTAB
/begin COMPU_METHOD INTKAIRT_INTKMNFLD_SC_Compu "" TAB_VERB "%6.3" "" COMPU_TAB_REF INTKAIRT_INTKMNFLD_SC_Compu /end COMPU_METHOD
/begin COMPU_VTAB INTKAIRT_INTKMNFLD_SC_Compu "" TAB_VERB 3 0 "no_signal" 1 "sensor" 2 "model" /end COMPU_VTAB
/begin COMPU_METHOD INTKAIRT_MNFLDICODSB2_SC_Compu "" TAB_VERB "%6.3" "" COMPU_TAB_REF INTKAIRT_MNFLDICODSB2_SC_Compu /end COMPU_METHOD
/begin COMPU_VTAB INTKAIRT_MNFLDICODSB2_SC_Compu "" TAB_VERB 3 0 "no_signal" 1 "sensor" 2 "model" /end COMPU_VTAB
/begin COMPU_METHOD INTKAIRT_MNFLDICODS_SC_Compu "" TAB_VERB "%6.3" "" COMPU_TAB_REF INTKAIRT_MNFLDICODS_SC_Compu /end COMPU_METHOD
/begin COMPU_VTAB INTKAIRT_MNFLDICODS_SC_Compu "" TAB_VERB 3 0 "no_signal" 1 "sensor" 2 "model" /end COMPU_VTAB
/begin COMPU_METHOD INTKAIRT_PID68H_SC_Compu "" TAB_VERB "%6.3" "" COMPU_TAB_REF INTKAIRT_PID68H_SC_Compu /end COMPU_METHOD
/begin COMPU_VTAB INTKAIRT_PID68H_SC_Compu "" TAB_VERB 2 0 "not_part_of_intake_air" 1 "part_of_intake_air" /end COMPU_VTAB
/begin COMPU_METHOD INTKAIRT_PID75H_SC_Compu "" TAB_VERB "%6.3" "" COMPU_TAB_REF INTKAIRT_PID75H_SC_Compu /end COMPU_METHOD
/begin COMPU_VTAB INTKAIRT_PID75H_SC_Compu "" TAB_VERB 2 0 "not_part_of_intake_air" 1 "part_of_intake_air" /end COMPU_VTAB
/begin COMPU_METHOD INTKAIRT_PID76H_SC_Compu "" TAB_VERB "%6.3" "" COMPU_TAB_REF INTKAIRT_PID76H_SC_Compu /end COMPU_METHOD
/begin COMPU_VTAB INTKAIRT_PID76H_SC_Compu "" TAB_VERB 2 0 "not_part_of_intake_air" 1 "part_of_intake_air" /end COMPU_VTAB
/begin COMPU_METHOD INTKAIRT_PID77H_SC_Compu "" TAB_VERB "%6.3" "" COMPU_TAB_REF INTKAIRT_PID77H_SC_Compu /end COMPU_METHOD
/begin COMPU_VTAB INTKAIRT_PID77H_SC_Compu "" TAB_VERB 2 0 "not_part_of_intake_air" 1 "part_of_intake_air" /end COMPU_VTAB
/begin COMPU_METHOD INTKAIRT_SNSR1BNK_SC_Compu "" TAB_VERB "%6.3" "" COMPU_TAB_REF INTKAIRT_SNSR1BNK_SC_Compu /end COMPU_METHOD
/begin COMPU_VTAB INTKAIRT_SNSR1BNK_SC_Compu "" TAB_VERB 3 0 "no_sensor" 1 "Bank_1" 2 "Bank_2" /end COMPU_VTAB
/begin COMPU_METHOD INTKAIRT_SNSR1COLDCRSSCHK_SC_Compu "" TAB_VERB "%6.3" "" COMPU_TAB_REF INTKAIRT_SNSR1COLDCRSSCHK_SC_Compu /end COMPU_METHOD
/begin COMPU_VTAB INTKAIRT_SNSR1COLDCRSSCHK_SC_Compu "" TAB_VERB 2 0 "Disabled" 1 "Enabled" /end COMPU_VTAB
/begin COMPU_METHOD INTKAIRT_SNSR1PLAUSCHK_SC_Compu "" TAB_VERB "%6.3" "" COMPU_TAB_REF INTKAIRT_SNSR1PLAUSCHK_SC_Compu /end COMPU_METHOD
/begin COMPU_VTAB INTKAIRT_SNSR1PLAUSCHK_SC_Compu "" TAB_VERB 2 0 "Disable" 1 "Enable" /end COMPU_VTAB
/begin COMPU_METHOD INTKAIRT_SNSR1PLAUSHSC_SC_Compu "" TAB_VERB "%6.3" "" COMPU_TAB_REF INTKAIRT_SNSR1PLAUSHSC_SC_Compu /end COMPU_METHOD
/begin COMPU_VTAB INTKAIRT_SNSR1PLAUSHSC_SC_Compu "" TAB_VERB 2 0 "False" 1 "True" /end COMPU_VTAB
/begin COMPU_METHOD INTKAIRT_SNSR1PLAUSPRC_SC_Compu "" TAB_VERB "%6.3" "" COMPU_TAB_REF INTKAIRT_SNSR1PLAUSPRC_SC_Compu /end COMPU_METHOD
/begin COMPU_VTAB INTKAIRT_SNSR1PLAUSPRC_SC_Compu "" TAB_VERB 3 0 "Disabled" 1 "Sensor_Voltage" 2 "Sensor_Temperature" /end COMPU_VTAB
/begin COMPU_METHOD INTKAIRT_SNSR1PLAUSSTUCKCHK_SC_Compu "" TAB_VERB "%6.3" "" COMPU_TAB_REF INTKAIRT_SNSR1PLAUSSTUCKCHK_SC_Compu /end COMPU_METHOD
/begin COMPU_VTAB INTKAIRT_SNSR1PLAUSSTUCKCHK_SC_Compu "" TAB_VERB 2 0 "Disabled" 1 "Enabled" /end COMPU_VTAB
/begin COMPU_METHOD INTKAIRT_SNSR1POS_SC_Compu "" TAB_VERB "%6.3" "" COMPU_TAB_REF INTKAIRT_SNSR1POS_SC_Compu /end COMPU_METHOD
/begin COMPU_VTAB INTKAIRT_SNSR1POS_SC_Compu "" TAB_VERB 7 0 "no_sensor" 1 "IntkMnfld" 2 "MnfldIcoDs" 3 "ThrVlvUs" 4 "CmprDs" 5 "AirFltDs" 6 "Cmpr2Us" /end COMPU_VTAB
/begin COMPU_METHOD INTKAIRT_SNSR1PWRSPLY_SC_Compu "" TAB_VERB "%6.3" "" COMPU_TAB_REF INTKAIRT_SNSR1PWRSPLY_SC_Compu /end COMPU_METHOD
/begin COMPU_VTAB INTKAIRT_SNSR1PWRSPLY_SC_Compu "" TAB_VERB 4 0 "PWRSPLY_DEACTIVATE" 1 "PWRSPLY1" 2 "PWRSPLY2" 3 "PWRSPLY3" /end COMPU_VTAB
/begin COMPU_METHOD INTKAIRT_SNSR1SENTTYP_SC_Compu "" TAB_VERB "%6.3" "" COMPU_TAB_REF INTKAIRT_SNSR1SENTTYP_SC_Compu /end COMPU_METHOD
/begin COMPU_VTAB INTKAIRT_SNSR1SENTTYP_SC_Compu "" TAB_VERB 6 0 "no_SENT" 1 "Fast_Channel_HFM" 2 "Slow_Channel_HFM_T_CMF" 3 "Slow_Channel_HFM_T_NTC" 4 "Fast_Channel_TMAP" 5 "Fast_Channel_PFM" /end COMPU_VTAB
/begin COMPU_METHOD INTKAIRT_SNSR2BNK_SC_Compu "" TAB_VERB "%6.3" "" COMPU_TAB_REF INTKAIRT_SNSR2BNK_SC_Compu /end COMPU_METHOD
/begin COMPU_VTAB INTKAIRT_SNSR2BNK_SC_Compu "" TAB_VERB 3 0 "no_Sensor" 1 "Bank_1" 2 "Bank_2" /end COMPU_VTAB
/begin COMPU_METHOD INTKAIRT_SNSR2COLDCRSSCHK_SC_Compu "" TAB_VERB "%6.3" "" COMPU_TAB_REF INTKAIRT_SNSR2COLDCRSSCHK_SC_Compu /end COMPU_METHOD
/begin COMPU_VTAB INTKAIRT_SNSR2COLDCRSSCHK_SC_Compu "" TAB_VERB 2 0 "Disabled" 1 "Enabled" /end COMPU_VTAB
/begin COMPU_METHOD INTKAIRT_SNSR2PLAUSCHK_SC_Compu "" TAB_VERB "%6.3" "" COMPU_TAB_REF INTKAIRT_SNSR2PLAUSCHK_SC_Compu /end COMPU_METHOD
/begin COMPU_VTAB INTKAIRT_SNSR2PLAUSCHK_SC_Compu "" TAB_VERB 2 0 "Disabled" 1 "Enabled" /end COMPU_VTAB
/begin COMPU_METHOD INTKAIRT_SNSR2PLAUSHSC_SC_Compu "" TAB_VERB "%6.3" "" COMPU_TAB_REF INTKAIRT_SNSR2PLAUSHSC_SC_Compu /end COMPU_METHOD
/begin COMPU_VTAB INTKAIRT_SNSR2PLAUSHSC_SC_Compu "" TAB_VERB 2 0 "False" 1 "True" /end COMPU_VTAB
/begin COMPU_METHOD INTKAIRT_SNSR2PLAUSPRC_SC_Compu "" TAB_VERB "%6.3" "" COMPU_TAB_REF INTKAIRT_SNSR2PLAUSPRC_SC_Compu /end COMPU_METHOD
/begin COMPU_VTAB INTKAIRT_SNSR2PLAUSPRC_SC_Compu "" TAB_VERB 3 0 "Disabled" 1 "Sensor_Voltage" 2 "Sensor_Temperature" /end COMPU_VTAB
/begin COMPU_METHOD INTKAIRT_SNSR2PLAUSSTUCKCHK_SC_Compu "" TAB_VERB "%6.3" "" COMPU_TAB_REF INTKAIRT_SNSR2PLAUSSTUCKCHK_SC_Compu /end COMPU_METHOD
/begin COMPU_VTAB INTKAIRT_SNSR2PLAUSSTUCKCHK_SC_Compu "" TAB_VERB 2 0 "Disabled" 1 "Enabled" /end COMPU_VTAB
/begin COMPU_METHOD INTKAIRT_SNSR2POS_SC_Compu "" TAB_VERB "%6.3" "" COMPU_TAB_REF INTKAIRT_SNSR2POS_SC_Compu /end COMPU_METHOD
/begin COMPU_VTAB INTKAIRT_SNSR2POS_SC_Compu "" TAB_VERB 7 0 "no_sensor" 1 "IntkMnfld" 2 "MnfldIcoDs" 3 "ThrVlvUs" 4 "CmprDs" 5 "AirFltDs" 6 "Cmpr2Us" /end COMPU_VTAB
/begin COMPU_METHOD INTKAIRT_SNSR2PWRSPLY_SC_Compu "" TAB_VERB "%6.3" "" COMPU_TAB_REF INTKAIRT_SNSR2PWRSPLY_SC_Compu /end COMPU_METHOD
/begin COMPU_VTAB INTKAIRT_SNSR2PWRSPLY_SC_Compu "" TAB_VERB 4 0 "PWRSPLY_DEACTIVATE" 1 "PWRSPLY1" 2 "PWRSPLY2" 3 "PWRSPLY3" /end COMPU_VTAB
/begin COMPU_METHOD INTKAIRT_SNSR2SENTTYP_SC_Compu "" TAB_VERB "%6.3" "" COMPU_TAB_REF INTKAIRT_SNSR2SENTTYP_SC_Compu /end COMPU_METHOD
/begin COMPU_VTAB INTKAIRT_SNSR2SENTTYP_SC_Compu "" TAB_VERB 5 0 "no_SENT" 1 "Fast_Channel_HFM" 2 "Slow_Channel_HFM_T_CMF" 3 "Slow_Channel_HFM_T_NTC" 4 "Fast_Channel_TMAP" /end COMPU_VTAB
/begin COMPU_METHOD INTKAIRT_SNSR3BNK_SC_Compu "" TAB_VERB "%6.3" "" COMPU_TAB_REF INTKAIRT_SNSR3BNK_SC_Compu /end COMPU_METHOD
/begin COMPU_VTAB INTKAIRT_SNSR3BNK_SC_Compu "" TAB_VERB 3 0 "no_Sensor" 1 "Bank_1" 2 "Bank_2" /end COMPU_VTAB
/begin COMPU_METHOD INTKAIRT_SNSR3COLDCRSSCHK_SC_Compu "" TAB_VERB "%6.3" "" COMPU_TAB_REF INTKAIRT_SNSR3COLDCRSSCHK_SC_Compu /end COMPU_METHOD
/begin COMPU_VTAB INTKAIRT_SNSR3COLDCRSSCHK_SC_Compu "" TAB_VERB 2 0 "Disabled" 1 "Enabled" /end COMPU_VTAB
/begin COMPU_METHOD INTKAIRT_SNSR3PLAUSCHK_SC_Compu "" TAB_VERB "%6.3" "" COMPU_TAB_REF INTKAIRT_SNSR3PLAUSCHK_SC_Compu /end COMPU_METHOD
/begin COMPU_VTAB INTKAIRT_SNSR3PLAUSCHK_SC_Compu "" TAB_VERB 2 0 "Disabled" 1 "Enabled" /end COMPU_VTAB
/begin COMPU_METHOD INTKAIRT_SNSR3PLAUSHSC_SC_Compu "" TAB_VERB "%6.3" "" COMPU_TAB_REF INTKAIRT_SNSR3PLAUSHSC_SC_Compu /end COMPU_METHOD
/begin COMPU_VTAB INTKAIRT_SNSR3PLAUSHSC_SC_Compu "" TAB_VERB 2 0 "False" 1 "True" /end COMPU_VTAB
/begin COMPU_METHOD INTKAIRT_SNSR3PLAUSPRC_SC_Compu "" TAB_VERB "%6.3" "" COMPU_TAB_REF INTKAIRT_SNSR3PLAUSPRC_SC_Compu /end COMPU_METHOD
/begin COMPU_VTAB INTKAIRT_SNSR3PLAUSPRC_SC_Compu "" TAB_VERB 3 0 "Disabled" 1 "Sensor_Voltage" 2 "Sensor_Temperature" /end COMPU_VTAB
/begin COMPU_METHOD INTKAIRT_SNSR3PLAUSSTUCKCHK_SC_Compu "" TAB_VERB "%6.3" "" COMPU_TAB_REF INTKAIRT_SNSR3PLAUSSTUCKCHK_SC_Compu /end COMPU_METHOD
/begin COMPU_VTAB INTKAIRT_SNSR3PLAUSSTUCKCHK_SC_Compu "" TAB_VERB 2 0 "Disabled" 1 "Enabled" /end COMPU_VTAB
/begin COMPU_METHOD INTKAIRT_SNSR3POS_SC_Compu "" TAB_VERB "%6.3" "" COMPU_TAB_REF INTKAIRT_SNSR3POS_SC_Compu /end COMPU_METHOD
/begin COMPU_VTAB INTKAIRT_SNSR3POS_SC_Compu "" TAB_VERB 7 0 "no_sensor" 1 "IntkMnfld" 2 "MnfldIcoDs" 3 "ThrVlvUs" 4 "CmprDs" 5 "AirFltDs" 6 "Cmpr2Us" /end COMPU_VTAB
/begin COMPU_METHOD INTKAIRT_SNSR3PWRSPLY_SC_Compu "" TAB_VERB "%6.3" "" COMPU_TAB_REF INTKAIRT_SNSR3PWRSPLY_SC_Compu /end COMPU_METHOD
/begin COMPU_VTAB INTKAIRT_SNSR3PWRSPLY_SC_Compu "" TAB_VERB 4 0 "PWRSPLY_DEACTIVATE" 1 "PWRSPLY1" 2 "PWRSPLY2" 3 "PWRSPLY3" /end COMPU_VTAB
/begin COMPU_METHOD INTKAIRT_SNSR4BNK_SC_Compu "" TAB_VERB "%6.3" "" COMPU_TAB_REF INTKAIRT_SNSR4BNK_SC_Compu /end COMPU_METHOD
/begin COMPU_VTAB INTKAIRT_SNSR4BNK_SC_Compu "" TAB_VERB 3 0 "no_Sensor" 1 "Bank_1" 2 "Bank_2" /end COMPU_VTAB
/begin COMPU_METHOD INTKAIRT_SNSR4COLDCRSSCHK_SC_Compu "" TAB_VERB "%6.3" "" COMPU_TAB_REF INTKAIRT_SNSR4COLDCRSSCHK_SC_Compu /end COMPU_METHOD
/begin COMPU_VTAB INTKAIRT_SNSR4COLDCRSSCHK_SC_Compu "" TAB_VERB 2 0 "Disabled" 1 "Enabled" /end COMPU_VTAB
/begin COMPU_METHOD INTKAIRT_SNSR4PLAUSCHK_SC_Compu "" TAB_VERB "%6.3" "" COMPU_TAB_REF INTKAIRT_SNSR4PLAUSCHK_SC_Compu /end COMPU_METHOD
/begin COMPU_VTAB INTKAIRT_SNSR4PLAUSCHK_SC_Compu "" TAB_VERB 2 0 "Disabled" 1 "Enabled" /end COMPU_VTAB
/begin COMPU_METHOD INTKAIRT_SNSR4PLAUSPRC_SC_Compu "" TAB_VERB "%6.3" "" COMPU_TAB_REF INTKAIRT_SNSR4PLAUSPRC_SC_Compu /end COMPU_METHOD
/begin COMPU_VTAB INTKAIRT_SNSR4PLAUSPRC_SC_Compu "" TAB_VERB 3 0 "Disabled" 1 "Sensor_Voltage" 2 "Sensor_Temperature" /end COMPU_VTAB
/begin COMPU_METHOD INTKAIRT_SNSR4PLAUSSTUCKCHK_SC_Compu "" TAB_VERB "%6.3" "" COMPU_TAB_REF INTKAIRT_SNSR4PLAUSSTUCKCHK_SC_Compu /end COMPU_METHOD
/begin COMPU_VTAB INTKAIRT_SNSR4PLAUSSTUCKCHK_SC_Compu "" TAB_VERB 2 0 "Disabled" 1 "Enabled" /end COMPU_VTAB
/begin COMPU_METHOD INTKAIRT_SNSR4POS_SC_Compu "" TAB_VERB "%6.3" "" COMPU_TAB_REF INTKAIRT_SNSR4POS_SC_Compu /end COMPU_METHOD
/begin COMPU_VTAB INTKAIRT_SNSR4POS_SC_Compu "" TAB_VERB 7 0 "no_sensor" 1 "IntkMnfld" 2 "MnfldIcoDs" 3 "ThrVlvUs" 4 "CmprDs" 5 "AirFltDs" 6 "Cmpr2Us" /end COMPU_VTAB
/begin COMPU_METHOD INTKAIRT_SNSR4PWRSPLY_SC_Compu "" TAB_VERB "%6.3" "" COMPU_TAB_REF INTKAIRT_SNSR4PWRSPLY_SC_Compu /end COMPU_METHOD
/begin COMPU_VTAB INTKAIRT_SNSR4PWRSPLY_SC_Compu "" TAB_VERB 4 0 "PWRSPLY_DEACTIVATE" 1 "PWRSPLY1" 2 "PWRSPLY2" 3 "PWRSPLY3" /end COMPU_VTAB
/begin COMPU_METHOD INTKAIRT_SNSR5BNK_SC_Compu "" TAB_VERB "%6.3" "" COMPU_TAB_REF INTKAIRT_SNSR5BNK_SC_Compu /end COMPU_METHOD
/begin COMPU_VTAB INTKAIRT_SNSR5BNK_SC_Compu "" TAB_VERB 3 0 "no_sensor" 1 "Bank_1" 2 "Bank_2" /end COMPU_VTAB
/begin COMPU_METHOD INTKAIRT_SNSR5PLAUSCHK_SC_Compu "" TAB_VERB "%6.3" "" COMPU_TAB_REF INTKAIRT_SNSR5PLAUSCHK_SC_Compu /end COMPU_METHOD
/begin COMPU_VTAB INTKAIRT_SNSR5PLAUSCHK_SC_Compu "" TAB_VERB 2 0 "Disabled" 1 "Enabled" /end COMPU_VTAB
/begin COMPU_METHOD INTKAIRT_SNSR5PLAUSPRC_SC_Compu "" TAB_VERB "%6.3" "" COMPU_TAB_REF INTKAIRT_SNSR5PLAUSPRC_SC_Compu /end COMPU_METHOD
/begin COMPU_VTAB INTKAIRT_SNSR5PLAUSPRC_SC_Compu "" TAB_VERB 3 0 "Disabled" 1 "Sensor_Voltage" 2 "Sensor_Temperature" /end COMPU_VTAB
/begin COMPU_METHOD INTKAIRT_SNSR5PLAUSSTUCKCHK_SC_Compu "" TAB_VERB "%6.3" "" COMPU_TAB_REF INTKAIRT_SNSR5PLAUSSTUCKCHK_SC_Compu /end COMPU_METHOD
/begin COMPU_VTAB INTKAIRT_SNSR5PLAUSSTUCKCHK_SC_Compu "" TAB_VERB 2 0 "Disabled" 1 "Enabled" /end COMPU_VTAB
/begin COMPU_METHOD INTKAIRT_SNSR5POS_SC_Compu "" TAB_VERB "%6.3" "" COMPU_TAB_REF INTKAIRT_SNSR5POS_SC_Compu /end COMPU_METHOD
/begin COMPU_VTAB INTKAIRT_SNSR5POS_SC_Compu "" TAB_VERB 7 0 "no_sensor" 1 "IntkMnfld" 2 "MnfldIcoDs" 3 "ThrVlvUs" 4 "CmprDs" 5 "AirFltDs" 6 "Cmpr2Us" /end COMPU_VTAB
/begin COMPU_METHOD INTKAIRT_SNSR5PWRSPLY_SC_Compu "" TAB_VERB "%6.3" "" COMPU_TAB_REF INTKAIRT_SNSR5PWRSPLY_SC_Compu /end COMPU_METHOD
/begin COMPU_VTAB INTKAIRT_SNSR5PWRSPLY_SC_Compu "" TAB_VERB 4 0 "PWRSPLY_DEACTIVATE" 1 "PWRSPLY1" 2 "PWRSPLY2" 3 "PWRSPLY3" /end COMPU_VTAB
/begin COMPU_METHOD INTKAIRT_SNSR6BNK_SC_Compu "" TAB_VERB "%6.3" "" COMPU_TAB_REF INTKAIRT_SNSR6BNK_SC_Compu /end COMPU_METHOD
/begin COMPU_VTAB INTKAIRT_SNSR6BNK_SC_Compu "" TAB_VERB 3 0 "no_sensor" 1 "Bank_1" 2 "Bank_2" /end COMPU_VTAB
/begin COMPU_METHOD INTKAIRT_SNSR6PLAUSCHK_SC_Compu "" TAB_VERB "%6.3" "" COMPU_TAB_REF INTKAIRT_SNSR6PLAUSCHK_SC_Compu /end COMPU_METHOD
/begin COMPU_VTAB INTKAIRT_SNSR6PLAUSCHK_SC_Compu "" TAB_VERB 2 0 "Disabled" 1 "Enabled" /end COMPU_VTAB
/begin COMPU_METHOD INTKAIRT_SNSR6PLAUSPRC_SC_Compu "" TAB_VERB "%6.3" "" COMPU_TAB_REF INTKAIRT_SNSR6PLAUSPRC_SC_Compu /end COMPU_METHOD
/begin COMPU_VTAB INTKAIRT_SNSR6PLAUSPRC_SC_Compu "" TAB_VERB 3 0 "Disabled" 1 "Sensor_Voltage" 2 "Sensor_Temperature" /end COMPU_VTAB
/begin COMPU_METHOD INTKAIRT_SNSR6PLAUSSTUCKCHK_SC_Compu "" TAB_VERB "%6.3" "" COMPU_TAB_REF INTKAIRT_SNSR6PLAUSSTUCKCHK_SC_Compu /end COMPU_METHOD
/begin COMPU_VTAB INTKAIRT_SNSR6PLAUSSTUCKCHK_SC_Compu "" TAB_VERB 2 0 "Disabled" 1 "Enabled" /end COMPU_VTAB
/begin COMPU_METHOD INTKAIRT_SNSR6POS_SC_Compu "" TAB_VERB "%6.3" "" COMPU_TAB_REF INTKAIRT_SNSR6POS_SC_Compu /end COMPU_METHOD
/begin COMPU_VTAB INTKAIRT_SNSR6POS_SC_Compu "" TAB_VERB 7 0 "no_sensor" 1 "IntkMnfld" 2 "MnfldIcoDs" 3 "ThrVlvUs" 4 "CmprDs" 5 "AirFltDs" 6 "Cmpr2Us" /end COMPU_VTAB
/begin COMPU_METHOD INTKAIRT_SNSR6PWRSPLY_SC_Compu "" TAB_VERB "%6.3" "" COMPU_TAB_REF INTKAIRT_SNSR6PWRSPLY_SC_Compu /end COMPU_METHOD
/begin COMPU_VTAB INTKAIRT_SNSR6PWRSPLY_SC_Compu "" TAB_VERB 4 0 "PWRSPLY_DEACTIVATE" 1 "PWRSPLY1" 2 "PWRSPLY2" 3 "PWRSPLY3" /end COMPU_VTAB
/begin COMPU_METHOD INTKAIRT_THRVLVUSB2_SC_Compu "" TAB_VERB "%6.3" "" COMPU_TAB_REF INTKAIRT_THRVLVUSB2_SC_Compu /end COMPU_METHOD
/begin COMPU_VTAB INTKAIRT_THRVLVUSB2_SC_Compu "" TAB_VERB 3 0 "no_signal" 1 "sensor" 2 "model" /end COMPU_VTAB
/begin COMPU_METHOD INTKAIRT_THRVLVUS_SC_Compu "" TAB_VERB "%6.3" "" COMPU_TAB_REF INTKAIRT_THRVLVUS_SC_Compu /end COMPU_METHOD
/begin COMPU_VTAB INTKAIRT_THRVLVUS_SC_Compu "" TAB_VERB 3 0 "no_signal" 1 "sensor" 2 "model" /end COMPU_VTAB
/begin COMPU_METHOD INTKAIRT_TYPAVL_SC_Compu "" TAB_VERB "%6.3" "" COMPU_TAB_REF INTKAIRT_TYPAVL_SC_Compu /end COMPU_METHOD
/begin COMPU_VTAB INTKAIRT_TYPAVL_SC_Compu "" TAB_VERB 2 0 "False" 1 "True" /end COMPU_VTAB
/begin COMPU_METHOD IOEXTDEV_CJ260_SC_Compu "" RAT_FUNC "%6.2" "" COEFFS 0 1 0 0 0 1 /end COMPU_METHOD
/begin COMPU_METHOD IOEXTDEV_PORTEXP_SC_Compu "" TAB_VERB "%6.3" "" COMPU_TAB_REF IOEXTDEV_PORTEXP_SC_Compu /end COMPU_METHOD
/begin COMPU_VTAB IOEXTDEV_PORTEXP_SC_Compu "" TAB_VERB 2 0 "No_Port_Expander" 1 "Port_Expander_I2C" /end COMPU_VTAB
/begin COMPU_METHOD IPDUM_SC_Compu "" TAB_VERB "%6.3" "" COMPU_TAB_REF IPDUM_SC_Compu /end COMPU_METHOD
/begin COMPU_VTAB IPDUM_SC_Compu "" TAB_VERB 2 0 "False" 1 "True" /end COMPU_VTAB
/begin COMPU_METHOD IUMPR_SY_Compu "" TAB_VERB "%6.3" "" COMPU_TAB_REF IUMPR_SY_Compu /end COMPU_METHOD
/begin COMPU_VTAB IUMPR_SY_Compu "" TAB_VERB 2 0 "NO_IUMPR_ACTIVE" 1 "IUMPR_ACTIVE" /end COMPU_VTAB
/begin COMPU_METHOD IUMPR_VERS_SY_Compu "" TAB_VERB "%6.3" "" COMPU_TAB_REF IUMPR_VERS_SY_Compu /end COMPU_METHOD
/begin COMPU_VTAB IUMPR_VERS_SY_Compu "" TAB_VERB 4 0 "IUMPR_2005" 1 "IUMPR_2007" 2 "IUMPR_2009" 3 "IUMPR_2016" /end COMPU_VTAB
/begin COMPU_METHOD IVGdiCtl_CvoAdpn_EEP_TYP_t "" TAB_VERB "%6.3" "" COMPU_TAB_REF IVGdiCtl_CvoAdpn_EEP_TYP_t /end COMPU_METHOD
/begin COMPU_VTAB IVGdiCtl_CvoAdpn_EEP_TYP_t "" TAB_VERB 2 1 "CVOADPN_EEP_TYP_EEPROM" 2 "CVOADPN_EEP_TYP_EEPROM_MEASURABLE" /end COMPU_VTAB
/begin COMPU_METHOD lu_MEx "" RAT_FUNC "%6.4" "(Umdr./sec)^2" COEFFS 0 140.7374884 0 0 0 1 /end COMPU_METHOD
/begin COMPU_METHOD lu_MEx_div_8 "" RAT_FUNC "%6.4" "(Umdr./sec)^2" COEFFS 0 17.592186044416 0 0 0 1 /end COMPU_METHOD
/begin COMPU_METHOD OneToOne "" RAT_FUNC "%6.2" "-" COEFFS 0 1 0 0 0 1 /end COMPU_METHOD
/begin COMPU_METHOD OneToOne_ms "" RAT_FUNC "%6.2" "ms" COEFFS 0 1 0 0 0 1 /end COMPU_METHOD
/begin COMPU_METHOD OneToOne_us "" RAT_FUNC "%6.2" "us" COEFFS 0 1 0 0 0 1 /end COMPU_METHOD
/begin COMPU_METHOD Per_Dur "" RAT_FUNC "%6.2" "usec" COEFFS 0 1 0 0 0 1 /end COMPU_METHOD
/begin COMPU_METHOD Prc_q0p01_COMPU "" RAT_FUNC "%6.4" "%" COEFFS 0 100 0 0 0 1 /end COMPU_METHOD
/begin COMPU_METHOD RBPtCel_ag_1p373291em3_1 "" RAT_FUNC "%6.4" "degCrS" COEFFS 0 7281777777776 0 0 0 10000000000 /end COMPU_METHOD
/begin COMPU_METHOD RBPtCel_dn_0p125_1 "" RAT_FUNC "%6.3" "rpm/s" COEFFS 0 8 0 0 0 1 /end COMPU_METHOD
/begin COMPU_METHOD RBPtCel_n_0p125_1 "" RAT_FUNC "%6.3" "rpm" COEFFS 0 8 0 0 0 1 /end COMPU_METHOD
/begin COMPU_METHOD RBPtCel_ti_50p0_1 "" RAT_FUNC "%6.1" "ns" COEFFS 0 1 0 0 0 50 /end COMPU_METHOD
/begin COMPU_METHOD RBPtCel_t_0p1om273p14_1 "" RAT_FUNC "%6.1" "Deg C" COEFFS 0 10 2731.4 0 0 1 /end COMPU_METHOD
/begin COMPU_METHOD rel_q0p09375 "" RAT_FUNC "%6.3" "%" COEFFS 0 1 0 0 0 0.09375 /end COMPU_METHOD
/begin COMPU_METHOD rel_uw_b100 "" RAT_FUNC "%6.4" "%" COEFFS 0 65536 0 0 0 100 /end COMPU_METHOD
/begin COMPU_METHOD t100msxs_uw_b6553p5 "" RAT_FUNC "%6.3" "s" COEFFS 0 1 0 0 0 0.1 /end COMPU_METHOD
/begin COMPU_METHOD Temp_Cels "" RAT_FUNC "%6.1" "deg C" COEFFS 0 10 2731.4 0 0 1 /end COMPU_METHOD
/begin COMPU_METHOD temp_ub_q0p75_o48 "" RAT_FUNC "%6.2" "Grad C" COEFFS 0 1 48 0 0 0.75 /end COMPU_METHOD
/begin COMPU_METHOD TimeDelay_ms "" RAT_FUNC "%13.2" "ms" COEFFS 0 0 1 0 2.3283064365387e-007 0 /end COMPU_METHOD
/begin COMPU_METHOD Time_ms "" RAT_FUNC "%6.1" "ms" COEFFS 0 0.1 0 0 0 1 /end COMPU_METHOD
/begin COMPU_METHOD Time_ns_to_us "" RAT_FUNC "%6.5" "us" COEFFS 0 1000 0 0 0 1 /end COMPU_METHOD
/begin COMPU_METHOD t_q0p01_us "" RAT_FUNC "%6.4" "us" COEFFS 0 100 0 0 0 1 /end COMPU_METHOD
/begin COMPU_METHOD t_q10_ms "" RAT_FUNC "%6.1" "ms" COEFFS 0 1 0 0 0 10 /end COMPU_METHOD
/begin COMPU_METHOD vel_q0p01 "" RAT_FUNC "%6.4" "km/h" COEFFS 0 100 0 0 0 1 /end COMPU_METHOD
/begin COMPU_METHOD default "" RAT_FUNC "%6.2" "" COEFFS 0 1 0 0 0 1 /end COMPU_METHOD
/begin RECORD_LAYOUT Cur_Xs16Ws16 NO_AXIS_PTS_X 1 SWORD AXIS_PTS_X 2 SWORD INDEX_INCR DIRECT FNC_VALUES 3 SWORD COLUMN_DIR DIRECT /end RECORD_LAYOUT
/begin RECORD_LAYOUT RB_Curve_S16_S16 NO_AXIS_PTS_X 1 SWORD AXIS_PTS_X 2 SWORD INDEX_INCR DIRECT FNC_VALUES 3 SWORD COLUMN_DIR DIRECT /end RECORD_LAYOUT
/begin RECORD_LAYOUT RB_Curve_S16_U16_Static NO_AXIS_PTS_X 1 SWORD AXIS_PTS_X 2 SWORD INDEX_INCR DIRECT FNC_VALUES 3 UWORD COLUMN_DIR DIRECT STATIC_RECORD_LAYOUT /end RECORD_LAYOUT
/begin RECORD_LAYOUT RB_Curve_U8_U16_Static NO_AXIS_PTS_X 1 UBYTE AXIS_PTS_X 2 UBYTE INDEX_INCR DIRECT FNC_VALUES 3 UWORD COLUMN_DIR DIRECT STATIC_RECORD_LAYOUT /end RECORD_LAYOUT
/begin RECORD_LAYOUT RB_Curve_U8_U8 NO_AXIS_PTS_X 1 UBYTE AXIS_PTS_X 2 UBYTE INDEX_INCR DIRECT FNC_VALUES 3 UBYTE COLUMN_DIR DIRECT /end RECORD_LAYOUT
/begin RECORD_LAYOUT RB_Map_U8U16_U16 NO_AXIS_PTS_X 1 UBYTE NO_AXIS_PTS_Y 2 UBYTE AXIS_PTS_X 3 UBYTE INDEX_INCR DIRECT AXIS_PTS_Y 4 UWORD INDEX_INCR DIRECT FNC_VALUES 5 UWORD ROW_DIR DIRECT /end RECORD_LAYOUT
/begin RECORD_LAYOUT RB_Map_U8U16_U8 NO_AXIS_PTS_X 1 UBYTE NO_AXIS_PTS_Y 2 UBYTE AXIS_PTS_X 3 UBYTE INDEX_INCR DIRECT AXIS_PTS_Y 4 UWORD INDEX_INCR DIRECT FNC_VALUES 5 UBYTE ROW_DIR DIRECT /end RECORD_LAYOUT
/begin RECORD_LAYOUT RB_Val_Ws16 FNC_VALUES 1 SWORD COLUMN_DIR DIRECT /end RECORD_LAYOUT
/begin RECORD_LAYOUT RB_Val_Wu16 FNC_VALUES 1 UWORD COLUMN_DIR DIRECT /end RECORD_LAYOUT
/begin RECORD_LAYOUT RB_Val_Wu8 FNC_VALUES 1 UBYTE COLUMN_DIR DIRECT /end RECORD_LAYOUT
/begin RECORD_LAYOUT ValA_Ws16 FNC_VALUES 1 SWORD COLUMN_DIR DIRECT /end RECORD_LAYOUT
/begin RECORD_LAYOUT ValA_Wu16 FNC_VALUES 1 UWORD COLUMN_DIR DIRECT /end RECORD_LAYOUT
/begin RECORD_LAYOUT ValA_Wu8 FNC_VALUES 1 UBYTE COLUMN_DIR DIRECT /end RECORD_LAYOUT
/begin RECORD_LAYOUT Val_Ws16 FNC_VALUES 1 SWORD COLUMN_DIR DIRECT /end RECORD_LAYOUT
/begin RECORD_LAYOUT Val_Ws32 FNC_VALUES 1 SLONG COLUMN_DIR DIRECT /end RECORD_LAYOUT
/begin RECORD_LAYOUT Val_Wu16 FNC_VALUES 1 UWORD COLUMN_DIR DIRECT /end RECORD_LAYOUT
/begin RECORD_LAYOUT Val_Wu32 FNC_VALUES 1 ULONG COLUMN_DIR DIRECT /end RECORD_LAYOUT
/begin RECORD_LAYOUT Val_Wu8 FNC_VALUES 1 UBYTE COLUMN_DIR DIRECT /end RECORD_LAYOUT
/end MODULE
/end PROJECT
