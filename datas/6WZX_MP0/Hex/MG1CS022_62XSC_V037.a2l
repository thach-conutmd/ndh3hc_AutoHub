ASAP2_VERSION 1 60
/begin PROJECT MG1CS022 "MG1CS022"
/begin HEADER "" VERSION "MG1CS022_62XSC_V037" PROJECT_NO MG1CS022 /end HEADER
/begin MODULE DIM ""
/begin MOD_COMMON "" BYTE_ORDER MSB_LAST ALIGNMENT_BYTE 1 ALIGNMENT_WORD 2 ALIGNMENT_LONG 4 ALIGNMENT_INT64 4 ALIGNMENT_FLOAT32_IEEE 4 ALIGNMENT_FLOAT64_IEEE 4 DATA_SIZE 32 /end MOD_COMMON
/begin CHARACTERISTIC DINH_FId.DFC_ComSRSAChksum_CA "inhibitable FIds / FIds to be inhibited by inhibit source DFC_ComSRSAChksum" VAL_BLK 0x804DEEFC ValA_Wu16 968.000000000 DINH_FIdVerb 0.00 968.000000000 FORMAT "%13.9" NUMBER 58 /end CHARACTERISTIC
/begin CHARACTERISTIC DINH_FId.DFC_ComSRSARingCnt_CA "inhibitable FIds / FIds to be inhibited by inhibit source DFC_ComSRSARingCnt" VAL_BLK 0x804DEF70 ValA_Wu16 968.000000000 DINH_FIdVerb 0.00 968.000000000 FORMAT "%13.9" NUMBER 58 /end CHARACTERISTIC
/begin CHARACTERISTIC DINH_FId.DFC_ComSRSATOut_CA "inhibitable FIds / FIds to be inhibited by inhibit source DFC_ComSRSATOut" VAL_BLK 0x804DEFE4 ValA_Wu16 968.000000000 DINH_FIdVerb 0.00 968.000000000 FORMAT "%13.9" NUMBER 58 /end CHARACTERISTIC
/begin CHARACTERISTIC DINH_FId.DFC_ComSRSBChksum_CA "inhibitable FIds / FIds to be inhibited by inhibit source DFC_ComSRSBChksum" VAL_BLK 0x804DF058 ValA_Wu16 968.000000000 DINH_FIdVerb 0.00 968.000000000 FORMAT "%13.9" NUMBER 57 /end CHARACTERISTIC
/begin CHARACTERISTIC DINH_FId.DFC_ComSRSBRingCnt_CA "inhibitable FIds / FIds to be inhibited by inhibit source DFC_ComSRSBRingCnt" VAL_BLK 0x804DF0CA ValA_Wu16 968.000000000 DINH_FIdVerb 0.00 968.000000000 FORMAT "%13.9" NUMBER 57 /end CHARACTERISTIC
/begin CHARACTERISTIC DINH_FId.DFC_ComSRSBTOut_CA "inhibitable FIds / FIds to be inhibited by inhibit source DFC_ComSRSBTOut" VAL_BLK 0x804DF13C ValA_Wu16 968.000000000 DINH_FIdVerb 0.00 968.000000000 FORMAT "%13.9" NUMBER 57 /end CHARACTERISTIC
/begin CHARACTERISTIC DINH_FId.DFC_ComSRSChksum_CA "inhibitable FIds / FIds to be inhibited by inhibit source DFC_ComSRSChksum" VAL_BLK 0x804DF1AE ValA_Wu16 968.000000000 DINH_FIdVerb 0.00 968.000000000 FORMAT "%13.9" NUMBER 57 /end CHARACTERISTIC
/begin CHARACTERISTIC DINH_FId.DFC_ComSRSErr_CA "inhibitable FIds / FIds to be inhibited by inhibit source DFC_ComSRSErr" VAL_BLK 0x804DF220 ValA_Wu16 968.000000000 DINH_FIdVerb 0.00 968.000000000 FORMAT "%13.9" NUMBER 50 /end CHARACTERISTIC
/begin CHARACTERISTIC DINH_FId.DFC_ComSRSRingCnt_CA "inhibitable FIds / FIds to be inhibited by inhibit source DFC_ComSRSRingCnt" VAL_BLK 0x804DF284 ValA_Wu16 968.000000000 DINH_FIdVerb 0.00 968.000000000 FORMAT "%13.9" NUMBER 57 /end CHARACTERISTIC
/begin CHARACTERISTIC DINH_FId.DFC_ComSRSTOut_CA "inhibitable FIds / FIds to be inhibited by inhibit source DFC_ComSRSTOut" VAL_BLK 0x804DF2F6 ValA_Wu16 968.000000000 DINH_FIdVerb 0.00 968.000000000 FORMAT "%13.9" NUMBER 57 /end CHARACTERISTIC
/begin CHARACTERISTIC DINH_FId.DFC_ComVehSpdPndFltTCU_CA "inhibitable FIds / FIds to be inhibited by inhibit source DFC_ComVehSpdPndFltTCU" VAL_BLK 0x804DF368 ValA_Wu16 968.000000000 DINH_FIdVerb 0.00 968.000000000 FORMAT "%13.9" NUMBER 50 /end CHARACTERISTIC
/begin CHARACTERISTIC DINH_FId.DFC_EbsChartcCurrErr_CA "inhibitable FIds / FIds to be inhibited by inhibit source DFC_EbsChartcCurrErr" VAL_BLK 0x804DF3CC ValA_Wu16 968.000000000 DINH_FIdVerb 0.00 968.000000000 FORMAT "%13.9" NUMBER 63 /end CHARACTERISTIC
/begin CHARACTERISTIC DINH_FId.DFC_EbsSelfDiagErr_CA "inhibitable FIds / FIds to be inhibited by inhibit source DFC_EbsSelfDiagErr" VAL_BLK 0x804DF44A ValA_Wu16 968.000000000 DINH_FIdVerb 0.00 968.000000000 FORMAT "%13.9" NUMBER 63 /end CHARACTERISTIC
/begin CHARACTERISTIC DINH_FId.DFC_GEVlvPhaCsersIntkB1_CA "inhibitable FIds / FIds to be inhibited by inhibit source DFC_GEVlvPhaCsersIntkB1" VAL_BLK 0x804DF4C8 ValA_Wu16 968.000000000 DINH_FIdVerb 0.00 968.000000000 FORMAT "%13.9" NUMBER 58 /end CHARACTERISTIC
/begin CHARACTERISTIC DINH_FId.DFC_GEVlvPhaPsOpenLoadIntkB1_CA "inhibitable FIds / FIds to be inhibited by inhibit source DFC_GEVlvPhaPsOpenLoadIntkB1" VAL_BLK 0x804DF53C ValA_Wu16 968.000000000 DINH_FIdVerb 0.00 968.000000000 FORMAT "%13.9" NUMBER 94 /end CHARACTERISTIC
/begin CHARACTERISTIC DINH_FId.DFC_GEVlvPhaPsShoToBattIntkB1_CA "inhibitable FIds / FIds to be inhibited by inhibit source DFC_GEVlvPhaPsShoToBattIntkB1" VAL_BLK 0x804DF5F8 ValA_Wu16 968.000000000 DINH_FIdVerb 0.00 968.000000000 FORMAT "%13.9" NUMBER 94 /end CHARACTERISTIC
/begin CHARACTERISTIC DINH_FId.DFC_GEVlvPhaPsShoToGndIntkB1_CA "inhibitable FIds / FIds to be inhibited by inhibit source DFC_GEVlvPhaPsShoToGndIntkB1" VAL_BLK 0x804DF6B4 ValA_Wu16 968.000000000 DINH_FIdVerb 0.00 968.000000000 FORMAT "%13.9" NUMBER 94 /end CHARACTERISTIC
/begin CHARACTERISTIC DINH_FId.DFC_GbxCANDigPlausErr_CA "inhibitable FIds / FIds to be inhibited by inhibit source DFC_GbxCANDigPlausErr" VAL_BLK 0x804DF770 ValA_Wu16 968.000000000 DINH_FIdVerb 0.00 968.000000000 FORMAT "%13.9" NUMBER 52 /end CHARACTERISTIC
/begin CHARACTERISTIC DINH_FId.DFC_GbxNPos1SRCMax_CA "inhibitable FIds / FIds to be inhibited by inhibit source DFC_GbxNPos1SRCMax" VAL_BLK 0x804DF7D8 ValA_Wu16 968.000000000 DINH_FIdVerb 0.00 968.000000000 FORMAT "%13.9" NUMBER 60 /end CHARACTERISTIC
/begin CHARACTERISTIC DINH_FId.DFC_GbxNPos1SRCMin_CA "inhibitable FIds / FIds to be inhibited by inhibit source DFC_GbxNPos1SRCMin" VAL_BLK 0x804DF850 ValA_Wu16 968.000000000 DINH_FIdVerb 0.00 968.000000000 FORMAT "%13.9" NUMBER 60 /end CHARACTERISTIC
/begin CHARACTERISTIC DINH_FId.DFC_GbxNPos2SRCMax_CA "inhibitable FIds / FIds to be inhibited by inhibit source DFC_GbxNPos2SRCMax" VAL_BLK 0x804DF8C8 ValA_Wu16 968.000000000 DINH_FIdVerb 0.00 968.000000000 FORMAT "%13.9" NUMBER 60 /end CHARACTERISTIC
/begin CHARACTERISTIC DINH_FId.DFC_GbxNPos2SRCMin_CA "inhibitable FIds / FIds to be inhibited by inhibit source DFC_GbxNPos2SRCMin" VAL_BLK 0x804DF940 ValA_Wu16 968.000000000 DINH_FIdVerb 0.00 968.000000000 FORMAT "%13.9" NUMBER 60 /end CHARACTERISTIC
/begin CHARACTERISTIC DINH_FId.DFC_GbxNPosAlvChk_CA "inhibitable FIds / FIds to be inhibited by inhibit source DFC_GbxNPosAlvChk" VAL_BLK 0x804DF9B8 ValA_Wu16 968.000000000 DINH_FIdVerb 0.00 968.000000000 FORMAT "%13.9" NUMBER 50 /end CHARACTERISTIC
/begin CHARACTERISTIC DINH_FId.DFC_GbxNPosSyncErr_CA "inhibitable FIds / FIds to be inhibited by inhibit source DFC_GbxNPosSyncErr" VAL_BLK 0x804DFA1C ValA_Wu16 968.000000000 DINH_FIdVerb 0.00 968.000000000 FORMAT "%13.9" NUMBER 58 /end CHARACTERISTIC
/begin CHARACTERISTIC DINH_FId.DFC_HEGOS2B1HtrPsMax_CA "inhibitable FIds / FIds to be inhibited by inhibit source DFC_HEGOS2B1HtrPsMax" VAL_BLK 0x804DFA90 ValA_Wu16 968.000000000 DINH_FIdVerb 0.00 968.000000000 FORMAT "%13.9" NUMBER 70 /end CHARACTERISTIC
/begin CHARACTERISTIC DINH_FId.DFC_HEGOS2B1HtrPsMin_CA "inhibitable FIds / FIds to be inhibited by inhibit source DFC_HEGOS2B1HtrPsMin" VAL_BLK 0x804DFB1C ValA_Wu16 968.000000000 DINH_FIdVerb 0.00 968.000000000 FORMAT "%13.9" NUMBER 70 /end CHARACTERISTIC
/begin CHARACTERISTIC DINH_FId.DFC_HEGOS2B1HtrPsSig_CA "inhibitable FIds / FIds to be inhibited by inhibit source DFC_HEGOS2B1HtrPsSig" VAL_BLK 0x804DFBA8 ValA_Wu16 968.000000000 DINH_FIdVerb 0.00 968.000000000 FORMAT "%13.9" NUMBER 70 /end CHARACTERISTIC
/begin CHARACTERISTIC DINH_FId.DFC_LinCSErrACG_CA "inhibitable FIds / FIds to be inhibited by inhibit source DFC_LinCSErrACG" VAL_BLK 0x804DFC34 ValA_Wu16 968.000000000 DINH_FIdVerb 0.00 968.000000000 FORMAT "%13.9" NUMBER 68 /end CHARACTERISTIC
/begin CHARACTERISTIC DINH_FId.DFC_LinCSErrAEV_CA "inhibitable FIds / FIds to be inhibited by inhibit source DFC_LinCSErrAEV" VAL_BLK 0x804DFCBC ValA_Wu16 968.000000000 DINH_FIdVerb 0.00 968.000000000 FORMAT "%13.9" NUMBER 52 /end CHARACTERISTIC
/begin CHARACTERISTIC DINH_FId.DFC_LinCSErrDCDC_CA "inhibitable FIds / FIds to be inhibited by inhibit source DFC_LinCSErrDCDC" VAL_BLK 0x804DFD24 ValA_Wu16 968.000000000 DINH_FIdVerb 0.00 968.000000000 FORMAT "%13.9" NUMBER 57 /end CHARACTERISTIC
/begin CHARACTERISTIC DINH_FId.DFC_LinCSErrEBS_CA "inhibitable FIds / FIds to be inhibited by inhibit source DFC_LinCSErrEBS" VAL_BLK 0x804DFD96 ValA_Wu16 968.000000000 DINH_FIdVerb 0.00 968.000000000 FORMAT "%13.9" NUMBER 67 /end CHARACTERISTIC
/begin CHARACTERISTIC DINH_FId.DFC_LinHdrTimeoutErrACG_CA "inhibitable FIds / FIds to be inhibited by inhibit source DFC_LinHdrTimeoutErrACG" VAL_BLK 0x804DFE1C ValA_Wu16 968.000000000 DINH_FIdVerb 0.00 968.000000000 FORMAT "%13.9" NUMBER 68 /end CHARACTERISTIC
/begin CHARACTERISTIC DINH_FId.DFC_LinHdrTimeoutErrAEV_CA "inhibitable FIds / FIds to be inhibited by inhibit source DFC_LinHdrTimeoutErrAEV" VAL_BLK 0x804DFEA4 ValA_Wu16 968.000000000 DINH_FIdVerb 0.00 968.000000000 FORMAT "%13.9" NUMBER 52 /end CHARACTERISTIC
/begin CHARACTERISTIC DINH_FId.DFC_LinHdrTimeoutErrDCDC_CA "inhibitable FIds / FIds to be inhibited by inhibit source DFC_LinHdrTimeoutErrDCDC" VAL_BLK 0x804DFF0C ValA_Wu16 968.000000000 DINH_FIdVerb 0.00 968.000000000 FORMAT "%13.9" NUMBER 57 /end CHARACTERISTIC
/begin CHARACTERISTIC DINH_FId.DFC_LinHdrTimeoutErrEBS_CA "inhibitable FIds / FIds to be inhibited by inhibit source DFC_LinHdrTimeoutErrEBS" VAL_BLK 0x804DFF7E ValA_Wu16 968.000000000 DINH_FIdVerb 0.00 968.000000000 FORMAT "%13.9" NUMBER 67 /end CHARACTERISTIC
/begin CHARACTERISTIC DINH_FId.DFC_LinMsgTimeoutErrACG_CA "inhibitable FIds / FIds to be inhibited by inhibit source DFC_LinMsgTimeoutErrACG" VAL_BLK 0x804E0004 ValA_Wu16 968.000000000 DINH_FIdVerb 0.00 968.000000000 FORMAT "%13.9" NUMBER 68 /end CHARACTERISTIC
/begin CHARACTERISTIC DINH_FId.DFC_LinMsgTimeoutErrAEV_CA "inhibitable FIds / FIds to be inhibited by inhibit source DFC_LinMsgTimeoutErrAEV" VAL_BLK 0x804E008C ValA_Wu16 968.000000000 DINH_FIdVerb 0.00 968.000000000 FORMAT "%13.9" NUMBER 52 /end CHARACTERISTIC
/begin CHARACTERISTIC DINH_FId.DFC_LinMsgTimeoutErrDCDC_CA "inhibitable FIds / FIds to be inhibited by inhibit source DFC_LinMsgTimeoutErrDCDC" VAL_BLK 0x804E00F4 ValA_Wu16 968.000000000 DINH_FIdVerb 0.00 968.000000000 FORMAT "%13.9" NUMBER 57 /end CHARACTERISTIC
/begin CHARACTERISTIC DINH_FId.DFC_LinMsgTimeoutErrEBS_CA "inhibitable FIds / FIds to be inhibited by inhibit source DFC_LinMsgTimeoutErrEBS" VAL_BLK 0x804E0166 ValA_Wu16 968.000000000 DINH_FIdVerb 0.00 968.000000000 FORMAT "%13.9" NUMBER 67 /end CHARACTERISTIC
/begin CHARACTERISTIC DINH_FId.DFC_LinNoStrtComErr_CA "inhibitable FIds / FIds to be inhibited by inhibit source DFC_LinNoStrtComErr" VAL_BLK 0x804E01EC ValA_Wu16 968.000000000 DINH_FIdVerb 0.00 968.000000000 FORMAT "%13.9" NUMBER 65 /end CHARACTERISTIC
/begin CHARACTERISTIC DINH_FId.DFC_LowPresOilP_CA "inhibitable FIds / FIds to be inhibited by inhibit source DFC_LowPresOilP" VAL_BLK 0x804E026E ValA_Wu16 968.000000000 DINH_FIdVerb 0.00 968.000000000 FORMAT "%13.9" NUMBER 50 /end CHARACTERISTIC
/begin CHARACTERISTIC DINH_FId.DFC_MisfDetVWhlFrntLeOORHi_CA "inhibitable FIds / FIds to be inhibited by inhibit source DFC_MisfDetVWhlFrntLeOORHi" VAL_BLK 0x804E02D2 ValA_Wu16 968.000000000 DINH_FIdVerb 0.00 968.000000000 FORMAT "%13.9" NUMBER 50 /end CHARACTERISTIC
/begin CHARACTERISTIC DINH_FId.DFC_MisfDetVWhlFrntLeRatyHi_CA "inhibitable FIds / FIds to be inhibited by inhibit source DFC_MisfDetVWhlFrntLeRatyHi" VAL_BLK 0x804E0336 ValA_Wu16 968.000000000 DINH_FIdVerb 0.00 968.000000000 FORMAT "%13.9" NUMBER 50 /end CHARACTERISTIC
/begin CHARACTERISTIC DINH_FId.DFC_MisfDetVWhlFrntLeRatyLo_CA "inhibitable FIds / FIds to be inhibited by inhibit source DFC_MisfDetVWhlFrntLeRatyLo" VAL_BLK 0x804E039A ValA_Wu16 968.000000000 DINH_FIdVerb 0.00 968.000000000 FORMAT "%13.9" NUMBER 50 /end CHARACTERISTIC
/begin CHARACTERISTIC DINH_FId.DFC_MisfDetVWhlFrntLeStuck_CA "inhibitable FIds / FIds to be inhibited by inhibit source DFC_MisfDetVWhlFrntLeStuck" VAL_BLK 0x804E03FE ValA_Wu16 968.000000000 DINH_FIdVerb 0.00 968.000000000 FORMAT "%13.9" NUMBER 50 /end CHARACTERISTIC
/begin CHARACTERISTIC DINH_FId.DFC_MisfDetVWhlFrntRiOORHi_CA "inhibitable FIds / FIds to be inhibited by inhibit source DFC_MisfDetVWhlFrntRiOORHi" VAL_BLK 0x804E0462 ValA_Wu16 968.000000000 DINH_FIdVerb 0.00 968.000000000 FORMAT "%13.9" NUMBER 50 /end CHARACTERISTIC
/begin CHARACTERISTIC DINH_FId.DFC_MisfDetVWhlFrntRiRatyHi_CA "inhibitable FIds / FIds to be inhibited by inhibit source DFC_MisfDetVWhlFrntRiRatyHi" VAL_BLK 0x804E04C6 ValA_Wu16 968.000000000 DINH_FIdVerb 0.00 968.000000000 FORMAT "%13.9" NUMBER 50 /end CHARACTERISTIC
/begin CHARACTERISTIC DINH_FId.DFC_MisfDetVWhlFrntRiRatyLo_CA "inhibitable FIds / FIds to be inhibited by inhibit source DFC_MisfDetVWhlFrntRiRatyLo" VAL_BLK 0x804E052A ValA_Wu16 968.000000000 DINH_FIdVerb 0.00 968.000000000 FORMAT "%13.9" NUMBER 50 /end CHARACTERISTIC
/begin CHARACTERISTIC DINH_FId.DFC_MisfDetVWhlFrntRiStuck_CA "inhibitable FIds / FIds to be inhibited by inhibit source DFC_MisfDetVWhlFrntRiStuck" VAL_BLK 0x804E058E ValA_Wu16 968.000000000 DINH_FIdVerb 0.00 968.000000000 FORMAT "%13.9" NUMBER 50 /end CHARACTERISTIC
/begin CHARACTERISTIC DINH_FId.DFC_MisfDetVWhlReLeOORHi_CA "inhibitable FIds / FIds to be inhibited by inhibit source DFC_MisfDetVWhlReLeOORHi" VAL_BLK 0x804E05F2 ValA_Wu16 968.000000000 DINH_FIdVerb 0.00 968.000000000 FORMAT "%13.9" NUMBER 50 /end CHARACTERISTIC
/begin CHARACTERISTIC DINH_FId.DFC_MisfDetVWhlReLeRatyHi_CA "inhibitable FIds / FIds to be inhibited by inhibit source DFC_MisfDetVWhlReLeRatyHi" VAL_BLK 0x804E0656 ValA_Wu16 968.000000000 DINH_FIdVerb 0.00 968.000000000 FORMAT "%13.9" NUMBER 50 /end CHARACTERISTIC
/begin CHARACTERISTIC DINH_FId.DFC_MisfDetVWhlReLeRatyLo_CA "inhibitable FIds / FIds to be inhibited by inhibit source DFC_MisfDetVWhlReLeRatyLo" VAL_BLK 0x804E06BA ValA_Wu16 968.000000000 DINH_FIdVerb 0.00 968.000000000 FORMAT "%13.9" NUMBER 50 /end CHARACTERISTIC
/begin CHARACTERISTIC DINH_FId.DFC_MisfDetVWhlReLeStuck_CA "inhibitable FIds / FIds to be inhibited by inhibit source DFC_MisfDetVWhlReLeStuck" VAL_BLK 0x804E071E ValA_Wu16 968.000000000 DINH_FIdVerb 0.00 968.000000000 FORMAT "%13.9" NUMBER 50 /end CHARACTERISTIC
/begin CHARACTERISTIC DINH_FId.DFC_MisfDetVWhlReRiOORHi_CA "inhibitable FIds / FIds to be inhibited by inhibit source DFC_MisfDetVWhlReRiOORHi" VAL_BLK 0x804E0782 ValA_Wu16 968.000000000 DINH_FIdVerb 0.00 968.000000000 FORMAT "%13.9" NUMBER 50 /end CHARACTERISTIC
/begin CHARACTERISTIC DINH_FId.DFC_MisfDetVWhlReRiRatyHi_CA "inhibitable FIds / FIds to be inhibited by inhibit source DFC_MisfDetVWhlReRiRatyHi" VAL_BLK 0x804E07E6 ValA_Wu16 968.000000000 DINH_FIdVerb 0.00 968.000000000 FORMAT "%13.9" NUMBER 50 /end CHARACTERISTIC
/begin CHARACTERISTIC DINH_FId.DFC_MisfDetVWhlReRiRatyLo_CA "inhibitable FIds / FIds to be inhibited by inhibit source DFC_MisfDetVWhlReRiRatyLo" VAL_BLK 0x804E084A ValA_Wu16 968.000000000 DINH_FIdVerb 0.00 968.000000000 FORMAT "%13.9" NUMBER 50 /end CHARACTERISTIC
/begin CHARACTERISTIC DINH_FId.DFC_MisfDetVWhlReRiStuck_CA "inhibitable FIds / FIds to be inhibited by inhibit source DFC_MisfDetVWhlReRiStuck" VAL_BLK 0x804E08AE ValA_Wu16 968.000000000 DINH_FIdVerb 0.00 968.000000000 FORMAT "%13.9" NUMBER 50 /end CHARACTERISTIC
/begin CHARACTERISTIC DINH_FId.DFC_MisfDetdVWhlFrntLePlaus_CA "inhibitable FIds / FIds to be inhibited by inhibit source DFC_MisfDetdVWhlFrntLePlaus" VAL_BLK 0x804E0912 ValA_Wu16 968.000000000 DINH_FIdVerb 0.00 968.000000000 FORMAT "%13.9" NUMBER 50 /end CHARACTERISTIC
/begin CHARACTERISTIC DINH_FId.DFC_MisfDetdVWhlFrntRiPlaus_CA "inhibitable FIds / FIds to be inhibited by inhibit source DFC_MisfDetdVWhlFrntRiPlaus" VAL_BLK 0x804E0976 ValA_Wu16 968.000000000 DINH_FIdVerb 0.00 968.000000000 FORMAT "%13.9" NUMBER 50 /end CHARACTERISTIC
/begin CHARACTERISTIC DINH_FId.DFC_MisfDetdVWhlReLePlaus_CA "inhibitable FIds / FIds to be inhibited by inhibit source DFC_MisfDetdVWhlReLePlaus" VAL_BLK 0x804E09DA ValA_Wu16 968.000000000 DINH_FIdVerb 0.00 968.000000000 FORMAT "%13.9" NUMBER 50 /end CHARACTERISTIC
/begin CHARACTERISTIC DINH_FId.DFC_MisfDetdVWhlReRiPlaus_CA "inhibitable FIds / FIds to be inhibited by inhibit source DFC_MisfDetdVWhlReRiPlaus" VAL_BLK 0x804E0A3E ValA_Wu16 968.000000000 DINH_FIdVerb 0.00 968.000000000 FORMAT "%13.9" NUMBER 50 /end CHARACTERISTIC
/begin CHARACTERISTIC DINH_FId.DFC_PEnvSigRngMax_CA "inhibitable FIds / FIds to be inhibited by inhibit source DFC_PEnvSigRngMax" VAL_BLK 0x804E0AA2 ValA_Wu16 968.000000000 DINH_FIdVerb 0.00 968.000000000 FORMAT "%13.9" NUMBER 91 /end CHARACTERISTIC
/begin CHARACTERISTIC DINH_FId.DFC_PEnvSigRngMin_CA "inhibitable FIds / FIds to be inhibited by inhibit source DFC_PEnvSigRngMin" VAL_BLK 0x804E0B58 ValA_Wu16 968.000000000 DINH_FIdVerb 0.00 968.000000000 FORMAT "%13.9" NUMBER 91 /end CHARACTERISTIC
/begin CHARACTERISTIC DINH_FId.DFC_StmFault_CA "inhibitable FIds / FIds to be inhibited by inhibit source DFC_StmFault" VAL_BLK 0x804E0C0E ValA_Wu16 968.000000000 DINH_FIdVerb 0.00 968.000000000 FORMAT "%13.9" NUMBER 53 /end CHARACTERISTIC
/begin CHARACTERISTIC DINH_FId.DFC_StrtCtOffPth_CA "inhibitable FIds / FIds to be inhibited by inhibit source DFC_StrtCtOffPth" VAL_BLK 0x804E0C78 ValA_Wu16 968.000000000 DINH_FIdVerb 0.00 968.000000000 FORMAT "%13.9" NUMBER 58 /end CHARACTERISTIC
/begin CHARACTERISTIC DINH_FId.DFC_StrtCtlErr_CA "inhibitable FIds / FIds to be inhibited by inhibit source DFC_StrtCtlErr" VAL_BLK 0x804E0CEC ValA_Wu16 968.000000000 DINH_FIdVerb 0.00 968.000000000 FORMAT "%13.9" NUMBER 51 /end CHARACTERISTIC
/begin CHARACTERISTIC DINH_FId.DFC_StrtFault_CA "inhibitable FIds / FIds to be inhibited by inhibit source DFC_StrtFault" VAL_BLK 0x804E0D52 ValA_Wu16 968.000000000 DINH_FIdVerb 0.00 968.000000000 FORMAT "%13.9" NUMBER 52 /end CHARACTERISTIC
/begin CHARACTERISTIC DINH_FId.DFC_StrtLckJudg1_CA "inhibitable FIds / FIds to be inhibited by inhibit source DFC_StrtLckJudg1" VAL_BLK 0x804E0DBA ValA_Wu16 968.000000000 DINH_FIdVerb 0.00 968.000000000 FORMAT "%13.9" NUMBER 57 /end CHARACTERISTIC
/begin CHARACTERISTIC DINH_FId.DFC_StrtLckJudg2_CA "inhibitable FIds / FIds to be inhibited by inhibit source DFC_StrtLckJudg2" VAL_BLK 0x804E0E2C ValA_Wu16 968.000000000 DINH_FIdVerb 0.00 968.000000000 FORMAT "%13.9" NUMBER 57 /end CHARACTERISTIC
/begin CHARACTERISTIC DINH_FId.DFC_StrtOL_CA "inhibitable FIds / FIds to be inhibited by inhibit source DFC_StrtOL" VAL_BLK 0x804E0E9E ValA_Wu16 968.000000000 DINH_FIdVerb 0.00 968.000000000 FORMAT "%13.9" NUMBER 57 /end CHARACTERISTIC
/begin CHARACTERISTIC DINH_FId.DFC_StrtOL2_CA "inhibitable FIds / FIds to be inhibited by inhibit source DFC_StrtOL2" VAL_BLK 0x804E0F10 ValA_Wu16 968.000000000 DINH_FIdVerb 0.00 968.000000000 FORMAT "%13.9" NUMBER 57 /end CHARACTERISTIC
/begin CHARACTERISTIC DINH_FId.DFC_StrtSCB_CA "inhibitable FIds / FIds to be inhibited by inhibit source DFC_StrtSCB" VAL_BLK 0x804E0F82 ValA_Wu16 968.000000000 DINH_FIdVerb 0.00 968.000000000 FORMAT "%13.9" NUMBER 58 /end CHARACTERISTIC
/begin CHARACTERISTIC DINH_FId.DFC_StrtSCB2_CA "inhibitable FIds / FIds to be inhibited by inhibit source DFC_StrtSCB2" VAL_BLK 0x804E0FF6 ValA_Wu16 968.000000000 DINH_FIdVerb 0.00 968.000000000 FORMAT "%13.9" NUMBER 58 /end CHARACTERISTIC
/begin CHARACTERISTIC DINH_FId.DFC_StrtSCG_CA "inhibitable FIds / FIds to be inhibited by inhibit source DFC_StrtSCG" VAL_BLK 0x804E106A ValA_Wu16 968.000000000 DINH_FIdVerb 0.00 968.000000000 FORMAT "%13.9" NUMBER 58 /end CHARACTERISTIC
/begin CHARACTERISTIC DINH_FId.DFC_StrtSCG2_CA "inhibitable FIds / FIds to be inhibited by inhibit source DFC_StrtSCG2" VAL_BLK 0x804E10DE ValA_Wu16 968.000000000 DINH_FIdVerb 0.00 968.000000000 FORMAT "%13.9" NUMBER 58 /end CHARACTERISTIC
/begin CHARACTERISTIC DINH_FId.DFC_StrtStkRly1_CA "inhibitable FIds / FIds to be inhibited by inhibit source DFC_StrtStkRly1" VAL_BLK 0x804E1152 ValA_Wu16 968.000000000 DINH_FIdVerb 0.00 968.000000000 FORMAT "%13.9" NUMBER 56 /end CHARACTERISTIC
/begin CHARACTERISTIC DINH_FId.DFC_StrtStkRly2_CA "inhibitable FIds / FIds to be inhibited by inhibit source DFC_StrtStkRly2" VAL_BLK 0x804E11C2 ValA_Wu16 968.000000000 DINH_FIdVerb 0.00 968.000000000 FORMAT "%13.9" NUMBER 56 /end CHARACTERISTIC
/begin CHARACTERISTIC DINH_FId.DFC_TEVEmax_CA "inhibitable FIds / FIds to be inhibited by inhibit source DFC_TEVEmax" VAL_BLK 0x804E1232 ValA_Wu16 968.000000000 DINH_FIdVerb 0.00 968.000000000 FORMAT "%13.9" NUMBER 82 /end CHARACTERISTIC
/begin CHARACTERISTIC DINH_FId.DFC_TEVEmin_CA "inhibitable FIds / FIds to be inhibited by inhibit source DFC_TEVEmin" VAL_BLK 0x804E12D6 ValA_Wu16 968.000000000 DINH_FIdVerb 0.00 968.000000000 FORMAT "%13.9" NUMBER 83 /end CHARACTERISTIC
/begin CHARACTERISTIC DINH_FId.DFC_TEVEsig_CA "inhibitable FIds / FIds to be inhibited by inhibit source DFC_TEVEsig" VAL_BLK 0x804E137C ValA_Wu16 968.000000000 DINH_FIdVerb 0.00 968.000000000 FORMAT "%13.9" NUMBER 82 /end CHARACTERISTIC
/begin CHARACTERISTIC DINH_FId.DFC_UegoHeatrPrfmncLoS1B1_CA "inhibitable FIds / FIds to be inhibited by inhibit source DFC_UegoHeatrPrfmncLoS1B1" VAL_BLK 0x804E1420 ValA_Wu16 968.000000000 DINH_FIdVerb 0.00 968.000000000 FORMAT "%13.9" NUMBER 53 /end CHARACTERISTIC
/begin CHARACTERISTIC DINH_FId.DFC_VehVAllPlaus_CA "inhibitable FIds / FIds to be inhibited by inhibit source DFC_VehVAllPlaus" VAL_BLK 0x804E148A ValA_Wu16 968.000000000 DINH_FIdVerb 0.00 968.000000000 FORMAT "%13.9" NUMBER 67 /end CHARACTERISTIC
/begin CHARACTERISTIC DINH_FId.DFC_VehVNCSnsrElecFailr_CA "inhibitable FIds / FIds to be inhibited by inhibit source DFC_VehVNCSnsrElecFailr" VAL_BLK 0x804E1510 ValA_Wu16 968.000000000 DINH_FIdVerb 0.00 968.000000000 FORMAT "%13.9" NUMBER 55 /end CHARACTERISTIC
/begin CHARACTERISTIC DINH_FId.DFC_VehVPlausCan_CA "inhibitable FIds / FIds to be inhibited by inhibit source DFC_VehVPlausCan" VAL_BLK 0x804E157E ValA_Wu16 968.000000000 DINH_FIdVerb 0.00 968.000000000 FORMAT "%13.9" NUMBER 81 /end CHARACTERISTIC
/begin CHARACTERISTIC DINH_FId.DFC_VehVPlausFco_CA "inhibitable FIds / FIds to be inhibited by inhibit source DFC_VehVPlausFco" VAL_BLK 0x804E1620 ValA_Wu16 968.000000000 DINH_FIdVerb 0.00 968.000000000 FORMAT "%13.9" NUMBER 90 /end CHARACTERISTIC
/begin CHARACTERISTIC DINH_FId.DFC_VehVPlausPwr_CA "inhibitable FIds / FIds to be inhibited by inhibit source DFC_VehVPlausPwr" VAL_BLK 0x804E16D4 ValA_Wu16 968.000000000 DINH_FIdVerb 0.00 968.000000000 FORMAT "%13.9" NUMBER 76 /end CHARACTERISTIC
/begin CHARACTERISTIC DINH_FId.DFC_VehVPlausV2N_CA "inhibitable FIds / FIds to be inhibited by inhibit source DFC_VehVPlausV2N" VAL_BLK 0x804E176C ValA_Wu16 968.000000000 DINH_FIdVerb 0.00 968.000000000 FORMAT "%13.9" NUMBER 76 /end CHARACTERISTIC
/begin CHARACTERISTIC DINH_FId.DFC_VehVSpdSnsrAElecFailr_CA "inhibitable FIds / FIds to be inhibited by inhibit source DFC_VehVSpdSnsrAElecFailr" VAL_BLK 0x804E1804 ValA_Wu16 968.000000000 DINH_FIdVerb 0.00 968.000000000 FORMAT "%13.9" NUMBER 54 /end CHARACTERISTIC
/begin CHARACTERISTIC DINH_FId.DFC_VehVSpdSnsrBElecFailr_CA "inhibitable FIds / FIds to be inhibited by inhibit source DFC_VehVSpdSnsrBElecFailr" VAL_BLK 0x804E1870 ValA_Wu16 968.000000000 DINH_FIdVerb 0.00 968.000000000 FORMAT "%13.9" NUMBER 54 /end CHARACTERISTIC
/begin CHARACTERISTIC DINH_FId.DFC_ClthMax_CA "inhibitable FIds / FIds to be inhibited by inhibit source DFC_ClthMax" VAL_BLK 0x804E18DC ValA_Wu16 968.000000000 DINH_FIdVerb 0.00 968.000000000 FORMAT "%13.9" NUMBER 65 /end CHARACTERISTIC
/begin CHARACTERISTIC DINH_FId.DFC_IgnClPs_DevComErr_CA "inhibitable FIds / FIds to be inhibited by inhibit source DFC_IgnClPs_DevComErr" VAL_BLK 0x804E195E ValA_Wu16 968.000000000 DINH_FIdVerb 0.00 968.000000000 FORMAT "%13.9" NUMBER 51 /end CHARACTERISTIC
/begin CHARACTERISTIC DINH_FId.DFC_IgnClPs_LineOl_0_CA "inhibitable FIds / FIds to be inhibited by inhibit source DFC_IgnClPs_LineOl_0" VAL_BLK 0x804E19C4 ValA_Wu16 968.000000000 DINH_FIdVerb 0.00 968.000000000 FORMAT "%13.9" NUMBER 55 /end CHARACTERISTIC
/begin CHARACTERISTIC DINH_FId.DFC_IgnClPs_LineOl_1_CA "inhibitable FIds / FIds to be inhibited by inhibit source DFC_IgnClPs_LineOl_1" VAL_BLK 0x804E1A32 ValA_Wu16 968.000000000 DINH_FIdVerb 0.00 968.000000000 FORMAT "%13.9" NUMBER 55 /end CHARACTERISTIC
/begin CHARACTERISTIC DINH_FId.DFC_IgnClPs_LineOl_2_CA "inhibitable FIds / FIds to be inhibited by inhibit source DFC_IgnClPs_LineOl_2" VAL_BLK 0x804E1AA0 ValA_Wu16 968.000000000 DINH_FIdVerb 0.00 968.000000000 FORMAT "%13.9" NUMBER 55 /end CHARACTERISTIC
/begin CHARACTERISTIC DINH_FId.DFC_IgnClPs_LineOl_3_CA "inhibitable FIds / FIds to be inhibited by inhibit source DFC_IgnClPs_LineOl_3" VAL_BLK 0x804E1B0E ValA_Wu16 968.000000000 DINH_FIdVerb 0.00 968.000000000 FORMAT "%13.9" NUMBER 55 /end CHARACTERISTIC
/begin CHARACTERISTIC DINH_FId.DFC_IgnClPs_LineScb_0_CA "inhibitable FIds / FIds to be inhibited by inhibit source DFC_IgnClPs_LineScb_0" VAL_BLK 0x804E1B7C ValA_Wu16 968.000000000 DINH_FIdVerb 0.00 968.000000000 FORMAT "%13.9" NUMBER 55 /end CHARACTERISTIC
/begin CHARACTERISTIC DINH_FId.DFC_IgnClPs_LineScb_1_CA "inhibitable FIds / FIds to be inhibited by inhibit source DFC_IgnClPs_LineScb_1" VAL_BLK 0x804E1BEA ValA_Wu16 968.000000000 DINH_FIdVerb 0.00 968.000000000 FORMAT "%13.9" NUMBER 55 /end CHARACTERISTIC
/begin CHARACTERISTIC DINH_FId.DFC_IgnClPs_LineScb_2_CA "inhibitable FIds / FIds to be inhibited by inhibit source DFC_IgnClPs_LineScb_2" VAL_BLK 0x804E1C58 ValA_Wu16 968.000000000 DINH_FIdVerb 0.00 968.000000000 FORMAT "%13.9" NUMBER 55 /end CHARACTERISTIC
/begin CHARACTERISTIC DINH_FId.DFC_IgnClPs_LineScb_3_CA "inhibitable FIds / FIds to be inhibited by inhibit source DFC_IgnClPs_LineScb_3" VAL_BLK 0x804E1CC6 ValA_Wu16 968.000000000 DINH_FIdVerb 0.00 968.000000000 FORMAT "%13.9" NUMBER 55 /end CHARACTERISTIC
/begin CHARACTERISTIC DINH_FId.DFC_IgnClPs_LineScg_0_CA "inhibitable FIds / FIds to be inhibited by inhibit source DFC_IgnClPs_LineScg_0" VAL_BLK 0x804E1D34 ValA_Wu16 968.000000000 DINH_FIdVerb 0.00 968.000000000 FORMAT "%13.9" NUMBER 55 /end CHARACTERISTIC
/begin CHARACTERISTIC DINH_FId.DFC_IgnClPs_LineScg_1_CA "inhibitable FIds / FIds to be inhibited by inhibit source DFC_IgnClPs_LineScg_1" VAL_BLK 0x804E1DA2 ValA_Wu16 968.000000000 DINH_FIdVerb 0.00 968.000000000 FORMAT "%13.9" NUMBER 55 /end CHARACTERISTIC
/begin CHARACTERISTIC DINH_FId.DFC_IgnClPs_LineScg_2_CA "inhibitable FIds / FIds to be inhibited by inhibit source DFC_IgnClPs_LineScg_2" VAL_BLK 0x804E1E10 ValA_Wu16 968.000000000 DINH_FIdVerb 0.00 968.000000000 FORMAT "%13.9" NUMBER 55 /end CHARACTERISTIC
/begin CHARACTERISTIC DINH_FId.DFC_IgnClPs_LineScg_3_CA "inhibitable FIds / FIds to be inhibited by inhibit source DFC_IgnClPs_LineScg_3" VAL_BLK 0x804E1E7E ValA_Wu16 968.000000000 DINH_FIdVerb 0.00 968.000000000 FORMAT "%13.9" NUMBER 55 /end CHARACTERISTIC
/begin CHARACTERISTIC DINH_FId.DFC_KRVEKOEVAB_CA "inhibitable FIds / FIds to be inhibited by inhibit source DFC_KRVEKOEVAB" VAL_BLK 0x804E1EEC ValA_Wu16 968.000000000 DINH_FIdVerb 0.00 968.000000000 FORMAT "%13.9" NUMBER 50 /end CHARACTERISTIC
/begin CHARACTERISTIC DINH_FId.DFC_KRVEKOEVAB0_CA "inhibitable FIds / FIds to be inhibited by inhibit source DFC_KRVEKOEVAB0" VAL_BLK 0x804E1F50 ValA_Wu16 968.000000000 DINH_FIdVerb 0.00 968.000000000 FORMAT "%13.9" NUMBER 50 /end CHARACTERISTIC
/begin CHARACTERISTIC DINH_FId.DFC_KRVEKOEVAB1_CA "inhibitable FIds / FIds to be inhibited by inhibit source DFC_KRVEKOEVAB1" VAL_BLK 0x804E1FB4 ValA_Wu16 968.000000000 DINH_FIdVerb 0.00 968.000000000 FORMAT "%13.9" NUMBER 50 /end CHARACTERISTIC
/begin CHARACTERISTIC DINH_FId.DFC_KRVEKOEVAB2_CA "inhibitable FIds / FIds to be inhibited by inhibit source DFC_KRVEKOEVAB2" VAL_BLK 0x804E2018 ValA_Wu16 968.000000000 DINH_FIdVerb 0.00 968.000000000 FORMAT "%13.9" NUMBER 50 /end CHARACTERISTIC
/begin CHARACTERISTIC DINH_FId.DFC_KRVEKOEVAB3_CA "inhibitable FIds / FIds to be inhibited by inhibit source DFC_KRVEKOEVAB3" VAL_BLK 0x804E207C ValA_Wu16 968.000000000 DINH_FIdVerb 0.00 968.000000000 FORMAT "%13.9" NUMBER 50 /end CHARACTERISTIC
/begin CHARACTERISTIC DINH_FId.DFC_UegoSigEcuAsicS1B1_CA "inhibitable FIds / FIds to be inhibited by inhibit source DFC_UegoSigEcuAsicS1B1" VAL_BLK 0x804E20E0 ValA_Wu16 968.000000000 DINH_FIdVerb 0.00 968.000000000 FORMAT "%13.9" NUMBER 85 /end CHARACTERISTIC
/begin CHARACTERISTIC DINH_FId.DFC_UegoSigEcuComS1B1_CA "inhibitable FIds / FIds to be inhibited by inhibit source DFC_UegoSigEcuComS1B1" VAL_BLK 0x804E218A ValA_Wu16 968.000000000 DINH_FIdVerb 0.00 968.000000000 FORMAT "%13.9" NUMBER 85 /end CHARACTERISTIC
/begin CHARACTERISTIC DINH_FId.DFC_UegoSigSnsrS1B1_CA "inhibitable FIds / FIds to be inhibited by inhibit source DFC_UegoSigSnsrS1B1" VAL_BLK 0x804E2234 ValA_Wu16 968.000000000 DINH_FIdVerb 0.00 968.000000000 FORMAT "%13.9" NUMBER 53 /end CHARACTERISTIC
/begin CHARACTERISTIC DINH_FId.DFC_UegoSigWireOlApesS1B1_CA "inhibitable FIds / FIds to be inhibited by inhibit source DFC_UegoSigWireOlApesS1B1" VAL_BLK 0x804E229E ValA_Wu16 968.000000000 DINH_FIdVerb 0.00 968.000000000 FORMAT "%13.9" NUMBER 82 /end CHARACTERISTIC
/begin CHARACTERISTIC DINH_FId.DFC_UegoSigWireOlIpeS1B1_CA "inhibitable FIds / FIds to be inhibited by inhibit source DFC_UegoSigWireOlIpeS1B1" VAL_BLK 0x804E2342 ValA_Wu16 968.000000000 DINH_FIdVerb 0.00 968.000000000 FORMAT "%13.9" NUMBER 85 /end CHARACTERISTIC
/begin CHARACTERISTIC DINH_FId.DFC_UegoSigWireOlReS1B1_CA "inhibitable FIds / FIds to be inhibited by inhibit source DFC_UegoSigWireOlReS1B1" VAL_BLK 0x804E23EC ValA_Wu16 968.000000000 DINH_FIdVerb 0.00 968.000000000 FORMAT "%13.9" NUMBER 85 /end CHARACTERISTIC
/begin CHARACTERISTIC DINH_FId.DFC_UegoSigWireRCmpS1B1_CA "inhibitable FIds / FIds to be inhibited by inhibit source DFC_UegoSigWireRCmpS1B1" VAL_BLK 0x804E2496 ValA_Wu16 968.000000000 DINH_FIdVerb 0.00 968.000000000 FORMAT "%13.9" NUMBER 83 /end CHARACTERISTIC
/begin CHARACTERISTIC DINH_FId.DFC_UegoSigWireScbS1B1_CA "inhibitable FIds / FIds to be inhibited by inhibit source DFC_UegoSigWireScbS1B1" VAL_BLK 0x804E253C ValA_Wu16 968.000000000 DINH_FIdVerb 0.00 968.000000000 FORMAT "%13.9" NUMBER 86 /end CHARACTERISTIC
/begin CHARACTERISTIC DINH_FId.DFC_UegoSigWireScgS1B1_CA "inhibitable FIds / FIds to be inhibited by inhibit source DFC_UegoSigWireScgS1B1" VAL_BLK 0x804E25E8 ValA_Wu16 968.000000000 DINH_FIdVerb 0.00 968.000000000 FORMAT "%13.9" NUMBER 86 /end CHARACTERISTIC
/begin CHARACTERISTIC DINH_FId.DFC_AfsPhyRngHiB1_CA "inhibitable FIds / FIds to be inhibited by inhibit source DFC_AfsPhyRngHiB1" VAL_BLK 0x804E2694 ValA_Wu16 968.000000000 DINH_FIdVerb 0.00 968.000000000 FORMAT "%13.9" NUMBER 56 /end CHARACTERISTIC
/begin CHARACTERISTIC DINH_FId.DFC_AfsPhyRngLoB1_CA "inhibitable FIds / FIds to be inhibited by inhibit source DFC_AfsPhyRngLoB1" VAL_BLK 0x804E2704 ValA_Wu16 968.000000000 DINH_FIdVerb 0.00 968.000000000 FORMAT "%13.9" NUMBER 56 /end CHARACTERISTIC
/begin CHARACTERISTIC DINH_FId.DFC_AirCCmprOL_CA "inhibitable FIds / FIds to be inhibited by inhibit source DFC_AirCCmprOL" VAL_BLK 0x804E2774 ValA_Wu16 968.000000000 DINH_FIdVerb 0.00 968.000000000 FORMAT "%13.9" NUMBER 50 /end CHARACTERISTIC
/begin CHARACTERISTIC DINH_FId.DFC_AirCCmprOvrTemp_CA "inhibitable FIds / FIds to be inhibited by inhibit source DFC_AirCCmprOvrTemp" VAL_BLK 0x804E27D8 ValA_Wu16 968.000000000 DINH_FIdVerb 0.00 968.000000000 FORMAT "%13.9" NUMBER 50 /end CHARACTERISTIC
/begin CHARACTERISTIC DINH_FId.DFC_AirCCmprSCB_CA "inhibitable FIds / FIds to be inhibited by inhibit source DFC_AirCCmprSCB" VAL_BLK 0x804E283C ValA_Wu16 968.000000000 DINH_FIdVerb 0.00 968.000000000 FORMAT "%13.9" NUMBER 50 /end CHARACTERISTIC
/begin CHARACTERISTIC DINH_FId.DFC_AirCCmprSCG_CA "inhibitable FIds / FIds to be inhibited by inhibit source DFC_AirCCmprSCG" VAL_BLK 0x804E28A0 ValA_Wu16 968.000000000 DINH_FIdVerb 0.00 968.000000000 FORMAT "%13.9" NUMBER 50 /end CHARACTERISTIC
/begin CHARACTERISTIC DINH_FId.DFC_AltErr_CA "inhibitable FIds / FIds to be inhibited by inhibit source DFC_AltErr" VAL_BLK 0x804E2904 ValA_Wu16 968.000000000 DINH_FIdVerb 0.00 968.000000000 FORMAT "%13.9" NUMBER 51 /end CHARACTERISTIC
/begin CHARACTERISTIC DINH_FId.DFC_BattUSRCMax_CA "inhibitable FIds / FIds to be inhibited by inhibit source DFC_BattUSRCMax" VAL_BLK 0x804E296A ValA_Wu16 968.000000000 DINH_FIdVerb 0.00 968.000000000 FORMAT "%13.9" NUMBER 58 /end CHARACTERISTIC
/begin CHARACTERISTIC DINH_FId.DFC_BattUSRCMin_CA "inhibitable FIds / FIds to be inhibited by inhibit source DFC_BattUSRCMin" VAL_BLK 0x804E29DE ValA_Wu16 968.000000000 DINH_FIdVerb 0.00 968.000000000 FORMAT "%13.9" NUMBER 58 /end CHARACTERISTIC
/begin CHARACTERISTIC DINH_FId.DFC_ComChksTCU1_CA "inhibitable FIds / FIds to be inhibited by inhibit source DFC_ComChksTCU1" VAL_BLK 0x804E2A52 ValA_Wu16 968.000000000 DINH_FIdVerb 0.00 968.000000000 FORMAT "%13.9" NUMBER 50 /end CHARACTERISTIC
/begin CHARACTERISTIC DINH_FId.DFC_ComChksTCU11_CA "inhibitable FIds / FIds to be inhibited by inhibit source DFC_ComChksTCU11" VAL_BLK 0x804E2AB6 ValA_Wu16 968.000000000 DINH_FIdVerb 0.00 968.000000000 FORMAT "%13.9" NUMBER 51 /end CHARACTERISTIC
/begin CHARACTERISTIC DINH_FId.DFC_ComChksTCU12_CA "inhibitable FIds / FIds to be inhibited by inhibit source DFC_ComChksTCU12" VAL_BLK 0x804E2B1C ValA_Wu16 968.000000000 DINH_FIdVerb 0.00 968.000000000 FORMAT "%13.9" NUMBER 52 /end CHARACTERISTIC
/begin CHARACTERISTIC DINH_FId.DFC_ComChksTCU13_CA "inhibitable FIds / FIds to be inhibited by inhibit source DFC_ComChksTCU13" VAL_BLK 0x804E2B84 ValA_Wu16 968.000000000 DINH_FIdVerb 0.00 968.000000000 FORMAT "%13.9" NUMBER 52 /end CHARACTERISTIC
/begin CHARACTERISTIC DINH_FId.DFC_ComChksTCU2_CA "inhibitable FIds / FIds to be inhibited by inhibit source DFC_ComChksTCU2" VAL_BLK 0x804E2BEC ValA_Wu16 968.000000000 DINH_FIdVerb 0.00 968.000000000 FORMAT "%13.9" NUMBER 50 /end CHARACTERISTIC
/begin CHARACTERISTIC DINH_FId.DFC_ComChksTCU3_CA "inhibitable FIds / FIds to be inhibited by inhibit source DFC_ComChksTCU3" VAL_BLK 0x804E2C50 ValA_Wu16 968.000000000 DINH_FIdVerb 0.00 968.000000000 FORMAT "%13.9" NUMBER 50 /end CHARACTERISTIC
/begin CHARACTERISTIC DINH_FId.DFC_ComChksTCU4_CA "inhibitable FIds / FIds to be inhibited by inhibit source DFC_ComChksTCU4" VAL_BLK 0x804E2CB4 ValA_Wu16 968.000000000 DINH_FIdVerb 0.00 968.000000000 FORMAT "%13.9" NUMBER 50 /end CHARACTERISTIC
/begin CHARACTERISTIC DINH_FId.DFC_ComCntTCU1_CA "inhibitable FIds / FIds to be inhibited by inhibit source DFC_ComCntTCU1" VAL_BLK 0x804E2D18 ValA_Wu16 968.000000000 DINH_FIdVerb 0.00 968.000000000 FORMAT "%13.9" NUMBER 50 /end CHARACTERISTIC
/begin CHARACTERISTIC DINH_FId.DFC_ComCntTCU11_CA "inhibitable FIds / FIds to be inhibited by inhibit source DFC_ComCntTCU11" VAL_BLK 0x804E2D7C ValA_Wu16 968.000000000 DINH_FIdVerb 0.00 968.000000000 FORMAT "%13.9" NUMBER 51 /end CHARACTERISTIC
/begin CHARACTERISTIC DINH_FId.DFC_ComCntTCU12_CA "inhibitable FIds / FIds to be inhibited by inhibit source DFC_ComCntTCU12" VAL_BLK 0x804E2DE2 ValA_Wu16 968.000000000 DINH_FIdVerb 0.00 968.000000000 FORMAT "%13.9" NUMBER 52 /end CHARACTERISTIC
/begin CHARACTERISTIC DINH_FId.DFC_ComCntTCU13_CA "inhibitable FIds / FIds to be inhibited by inhibit source DFC_ComCntTCU13" VAL_BLK 0x804E2E4A ValA_Wu16 968.000000000 DINH_FIdVerb 0.00 968.000000000 FORMAT "%13.9" NUMBER 52 /end CHARACTERISTIC
/begin CHARACTERISTIC DINH_FId.DFC_ComCntTCU2_CA "inhibitable FIds / FIds to be inhibited by inhibit source DFC_ComCntTCU2" VAL_BLK 0x804E2EB2 ValA_Wu16 968.000000000 DINH_FIdVerb 0.00 968.000000000 FORMAT "%13.9" NUMBER 50 /end CHARACTERISTIC
/begin CHARACTERISTIC DINH_FId.DFC_ComCntTCU3_CA "inhibitable FIds / FIds to be inhibited by inhibit source DFC_ComCntTCU3" VAL_BLK 0x804E2F16 ValA_Wu16 968.000000000 DINH_FIdVerb 0.00 968.000000000 FORMAT "%13.9" NUMBER 50 /end CHARACTERISTIC
/begin CHARACTERISTIC DINH_FId.DFC_ComCntTCU4_CA "inhibitable FIds / FIds to be inhibited by inhibit source DFC_ComCntTCU4" VAL_BLK 0x804E2F7A ValA_Wu16 968.000000000 DINH_FIdVerb 0.00 968.000000000 FORMAT "%13.9" NUMBER 50 /end CHARACTERISTIC
/begin CHARACTERISTIC DINH_FId.DFC_ComTOutTCU01_CA "inhibitable FIds / FIds to be inhibited by inhibit source DFC_ComTOutTCU01" VAL_BLK 0x804E2FDE ValA_Wu16 968.000000000 DINH_FIdVerb 0.00 968.000000000 FORMAT "%13.9" NUMBER 51 /end CHARACTERISTIC
/begin CHARACTERISTIC DINH_FId.DFC_ComTOutTCU02_CA "inhibitable FIds / FIds to be inhibited by inhibit source DFC_ComTOutTCU02" VAL_BLK 0x804E3044 ValA_Wu16 968.000000000 DINH_FIdVerb 0.00 968.000000000 FORMAT "%13.9" NUMBER 51 /end CHARACTERISTIC
/begin CHARACTERISTIC DINH_FId.DFC_ComTOutTCU1_CA "inhibitable FIds / FIds to be inhibited by inhibit source DFC_ComTOutTCU1" VAL_BLK 0x804E30AA ValA_Wu16 968.000000000 DINH_FIdVerb 0.00 968.000000000 FORMAT "%13.9" NUMBER 55 /end CHARACTERISTIC
/begin CHARACTERISTIC DINH_FId.DFC_ComTOutTCU11_CA "inhibitable FIds / FIds to be inhibited by inhibit source DFC_ComTOutTCU11" VAL_BLK 0x804E3118 ValA_Wu16 968.000000000 DINH_FIdVerb 0.00 968.000000000 FORMAT "%13.9" NUMBER 54 /end CHARACTERISTIC
/begin CHARACTERISTIC DINH_FId.DFC_ComTOutTCU12_CA "inhibitable FIds / FIds to be inhibited by inhibit source DFC_ComTOutTCU12" VAL_BLK 0x804E3184 ValA_Wu16 968.000000000 DINH_FIdVerb 0.00 968.000000000 FORMAT "%13.9" NUMBER 52 /end CHARACTERISTIC
/begin CHARACTERISTIC DINH_FId.DFC_ComTOutTCU13_CA "inhibitable FIds / FIds to be inhibited by inhibit source DFC_ComTOutTCU13" VAL_BLK 0x804E31EC ValA_Wu16 968.000000000 DINH_FIdVerb 0.00 968.000000000 FORMAT "%13.9" NUMBER 52 /end CHARACTERISTIC
/begin CHARACTERISTIC DINH_FId.DFC_ComTOutTCU14_CA "inhibitable FIds / FIds to be inhibited by inhibit source DFC_ComTOutTCU14" VAL_BLK 0x804E3254 ValA_Wu16 968.000000000 DINH_FIdVerb 0.00 968.000000000 FORMAT "%13.9" NUMBER 51 /end CHARACTERISTIC
/begin CHARACTERISTIC DINH_FId.DFC_ComTOutTCU2_CA "inhibitable FIds / FIds to be inhibited by inhibit source DFC_ComTOutTCU2" VAL_BLK 0x804E32BA ValA_Wu16 968.000000000 DINH_FIdVerb 0.00 968.000000000 FORMAT "%13.9" NUMBER 52 /end CHARACTERISTIC
/begin CHARACTERISTIC DINH_FId.DFC_ComTOutTCU3_CA "inhibitable FIds / FIds to be inhibited by inhibit source DFC_ComTOutTCU3" VAL_BLK 0x804E3322 ValA_Wu16 968.000000000 DINH_FIdVerb 0.00 968.000000000 FORMAT "%13.9" NUMBER 52 /end CHARACTERISTIC
/begin CHARACTERISTIC DINH_FId.DFC_ComTOutTCU4_CA "inhibitable FIds / FIds to be inhibited by inhibit source DFC_ComTOutTCU4" VAL_BLK 0x804E338A ValA_Wu16 968.000000000 DINH_FIdVerb 0.00 968.000000000 FORMAT "%13.9" NUMBER 51 /end CHARACTERISTIC
/begin CHARACTERISTIC DINH_FId.DFC_DevLibBattUHi_CA "inhibitable FIds / FIds to be inhibited by inhibit source DFC_DevLibBattUHi" VAL_BLK 0x804E33F0 ValA_Wu16 968.000000000 DINH_FIdVerb 0.00 968.000000000 FORMAT "%13.9" NUMBER 50 /end CHARACTERISTIC
/begin CHARACTERISTIC DINH_FId.DFC_DevLibBattULo_CA "inhibitable FIds / FIds to be inhibited by inhibit source DFC_DevLibBattULo" VAL_BLK 0x804E3454 ValA_Wu16 968.000000000 DINH_FIdVerb 0.00 968.000000000 FORMAT "%13.9" NUMBER 50 /end CHARACTERISTIC
/begin CHARACTERISTIC DINH_FId.DFC_EGRVlvFailSafeActv_CA "inhibitable FIds / FIds to be inhibited by inhibit source DFC_EGRVlvFailSafeActv" VAL_BLK 0x804E34B8 ValA_Wu16 968.000000000 DINH_FIdVerb 0.00 968.000000000 FORMAT "%13.9" NUMBER 51 /end CHARACTERISTIC
/begin CHARACTERISTIC DINH_FId.DFC_EGRVlvGovDvtCld_CA "inhibitable FIds / FIds to be inhibited by inhibit source DFC_EGRVlvGovDvtCld" VAL_BLK 0x804E351E ValA_Wu16 968.000000000 DINH_FIdVerb 0.00 968.000000000 FORMAT "%13.9" NUMBER 51 /end CHARACTERISTIC
/begin CHARACTERISTIC DINH_FId.DFC_EGRVlvPhysSRCMax_CA "inhibitable FIds / FIds to be inhibited by inhibit source DFC_EGRVlvPhysSRCMax" VAL_BLK 0x804E3584 ValA_Wu16 968.000000000 DINH_FIdVerb 0.00 968.000000000 FORMAT "%13.9" NUMBER 54 /end CHARACTERISTIC
/begin CHARACTERISTIC DINH_FId.DFC_EGRVlvPhysSRCMin_CA "inhibitable FIds / FIds to be inhibited by inhibit source DFC_EGRVlvPhysSRCMin" VAL_BLK 0x804E35F0 ValA_Wu16 968.000000000 DINH_FIdVerb 0.00 968.000000000 FORMAT "%13.9" NUMBER 54 /end CHARACTERISTIC
/begin CHARACTERISTIC DINH_FId.DFC_FanDIOOL_0_CA "inhibitable FIds / FIds to be inhibited by inhibit source DFC_FanDIOOL_0" VAL_BLK 0x804E365C ValA_Wu16 968.000000000 DINH_FIdVerb 0.00 968.000000000 FORMAT "%13.9" NUMBER 51 /end CHARACTERISTIC
/begin CHARACTERISTIC DINH_FId.DFC_FanDIOOL_1_CA "inhibitable FIds / FIds to be inhibited by inhibit source DFC_FanDIOOL_1" VAL_BLK 0x804E36C2 ValA_Wu16 968.000000000 DINH_FIdVerb 0.00 968.000000000 FORMAT "%13.9" NUMBER 51 /end CHARACTERISTIC
/begin CHARACTERISTIC DINH_FId.DFC_FanDIOOvrTemp_0_CA "inhibitable FIds / FIds to be inhibited by inhibit source DFC_FanDIOOvrTemp_0" VAL_BLK 0x804E3728 ValA_Wu16 968.000000000 DINH_FIdVerb 0.00 968.000000000 FORMAT "%13.9" NUMBER 50 /end CHARACTERISTIC
/begin CHARACTERISTIC DINH_FId.DFC_FanDIOOvrTemp_1_CA "inhibitable FIds / FIds to be inhibited by inhibit source DFC_FanDIOOvrTemp_1" VAL_BLK 0x804E378C ValA_Wu16 968.000000000 DINH_FIdVerb 0.00 968.000000000 FORMAT "%13.9" NUMBER 50 /end CHARACTERISTIC
/begin CHARACTERISTIC DINH_FId.DFC_FanDIOSCB_0_CA "inhibitable FIds / FIds to be inhibited by inhibit source DFC_FanDIOSCB_0" VAL_BLK 0x804E37F0 ValA_Wu16 968.000000000 DINH_FIdVerb 0.00 968.000000000 FORMAT "%13.9" NUMBER 51 /end CHARACTERISTIC
/begin CHARACTERISTIC DINH_FId.DFC_FanDIOSCB_1_CA "inhibitable FIds / FIds to be inhibited by inhibit source DFC_FanDIOSCB_1" VAL_BLK 0x804E3856 ValA_Wu16 968.000000000 DINH_FIdVerb 0.00 968.000000000 FORMAT "%13.9" NUMBER 51 /end CHARACTERISTIC
/begin CHARACTERISTIC DINH_FId.DFC_FanDIOSCG_0_CA "inhibitable FIds / FIds to be inhibited by inhibit source DFC_FanDIOSCG_0" VAL_BLK 0x804E38BC ValA_Wu16 968.000000000 DINH_FIdVerb 0.00 968.000000000 FORMAT "%13.9" NUMBER 51 /end CHARACTERISTIC
/begin CHARACTERISTIC DINH_FId.DFC_FanDIOSCG_1_CA "inhibitable FIds / FIds to be inhibited by inhibit source DFC_FanDIOSCG_1" VAL_BLK 0x804E3922 ValA_Wu16 968.000000000 DINH_FIdVerb 0.00 968.000000000 FORMAT "%13.9" NUMBER 51 /end CHARACTERISTIC
/begin CHARACTERISTIC DINH_FId.DFC_MRlyDcOL_CA "inhibitable FIds / FIds to be inhibited by inhibit source DFC_MRlyDcOL" VAL_BLK 0x804E3988 ValA_Wu16 968.000000000 DINH_FIdVerb 0.00 968.000000000 FORMAT "%13.9" NUMBER 50 /end CHARACTERISTIC
/begin CHARACTERISTIC DINH_FId.DFC_MRlyDcSCB_CA "inhibitable FIds / FIds to be inhibited by inhibit source DFC_MRlyDcSCB" VAL_BLK 0x804E39EC ValA_Wu16 968.000000000 DINH_FIdVerb 0.00 968.000000000 FORMAT "%13.9" NUMBER 50 /end CHARACTERISTIC
/begin CHARACTERISTIC DINH_FId.DFC_MRlyDcSCG_CA "inhibitable FIds / FIds to be inhibited by inhibit source DFC_MRlyDcSCG" VAL_BLK 0x804E3A50 ValA_Wu16 968.000000000 DINH_FIdVerb 0.00 968.000000000 FORMAT "%13.9" NUMBER 50 /end CHARACTERISTIC
/begin CHARACTERISTIC DINH_FId.DFC_PSPOL_CA "inhibitable FIds / FIds to be inhibited by inhibit source DFC_PSPOL" VAL_BLK 0x804E3AB4 ValA_Wu16 968.000000000 DINH_FIdVerb 0.00 968.000000000 FORMAT "%13.9" NUMBER 50 /end CHARACTERISTIC
/begin CHARACTERISTIC DINH_FId.DFC_PSPOvrTemp_CA "inhibitable FIds / FIds to be inhibited by inhibit source DFC_PSPOvrTemp" VAL_BLK 0x804E3B18 ValA_Wu16 968.000000000 DINH_FIdVerb 0.00 968.000000000 FORMAT "%13.9" NUMBER 50 /end CHARACTERISTIC
/begin CHARACTERISTIC DINH_FId.DFC_PSPSCB_CA "inhibitable FIds / FIds to be inhibited by inhibit source DFC_PSPSCB" VAL_BLK 0x804E3B7C ValA_Wu16 968.000000000 DINH_FIdVerb 0.00 968.000000000 FORMAT "%13.9" NUMBER 50 /end CHARACTERISTIC
/begin CHARACTERISTIC DINH_FId.DFC_PSPSCG_CA "inhibitable FIds / FIds to be inhibited by inhibit source DFC_PSPSCG" VAL_BLK 0x804E3BE0 ValA_Wu16 968.000000000 DINH_FIdVerb 0.00 968.000000000 FORMAT "%13.9" NUMBER 50 /end CHARACTERISTIC
/begin CHARACTERISTIC DINH_FId.DFC_T50Err_CA "inhibitable FIds / FIds to be inhibited by inhibit source DFC_T50Err" VAL_BLK 0x804E3C44 ValA_Wu16 968.000000000 DINH_FIdVerb 0.00 968.000000000 FORMAT "%13.9" NUMBER 51 /end CHARACTERISTIC
/begin CHARACTERISTIC DINH_FId.DFC_ThrVlvLoBattB1_CA "inhibitable FIds / FIds to be inhibited by inhibit source DFC_ThrVlvLoBattB1" VAL_BLK 0x804E3CAA ValA_Wu16 968.000000000 DINH_FIdVerb 0.00 968.000000000 FORMAT "%13.9" NUMBER 50 /end CHARACTERISTIC
/begin CHARACTERISTIC DINH_FId.DFC_UegoSigOperPlausS1B1_CA "inhibitable FIds / FIds to be inhibited by inhibit source DFC_UegoSigOperPlausS1B1" VAL_BLK 0x804E3D0E ValA_Wu16 968.000000000 DINH_FIdVerb 0.00 968.000000000 FORMAT "%13.9" NUMBER 73 /end CHARACTERISTIC
/begin CHARACTERISTIC DINH_FId.DFC_VehVPhysRngHi_CA "inhibitable FIds / FIds to be inhibited by inhibit source DFC_VehVPhysRngHi" VAL_BLK 0x804E3DA0 ValA_Wu16 968.000000000 DINH_FIdVerb 0.00 968.000000000 FORMAT "%13.9" NUMBER 99 /end CHARACTERISTIC
/begin CHARACTERISTIC DINH_FId.DFC_VehVSclOutOL_CA "inhibitable FIds / FIds to be inhibited by inhibit source DFC_VehVSclOutOL" VAL_BLK 0x804E3E66 ValA_Wu16 968.000000000 DINH_FIdVerb 0.00 968.000000000 FORMAT "%13.9" NUMBER 50 /end CHARACTERISTIC
/begin CHARACTERISTIC DINH_FId.DFC_VehVSclOutOT_CA "inhibitable FIds / FIds to be inhibited by inhibit source DFC_VehVSclOutOT" VAL_BLK 0x804E3ECA ValA_Wu16 968.000000000 DINH_FIdVerb 0.00 968.000000000 FORMAT "%13.9" NUMBER 50 /end CHARACTERISTIC
/begin CHARACTERISTIC DINH_FId.DFC_VehVSclOutSCB_CA "inhibitable FIds / FIds to be inhibited by inhibit source DFC_VehVSclOutSCB" VAL_BLK 0x804E3F2E ValA_Wu16 968.000000000 DINH_FIdVerb 0.00 968.000000000 FORMAT "%13.9" NUMBER 50 /end CHARACTERISTIC
/begin CHARACTERISTIC DINH_FId.DFC_VehVSclOutSCG_CA "inhibitable FIds / FIds to be inhibited by inhibit source DFC_VehVSclOutSCG" VAL_BLK 0x804E3F92 ValA_Wu16 968.000000000 DINH_FIdVerb 0.00 968.000000000 FORMAT "%13.9" NUMBER 50 /end CHARACTERISTIC
/begin CHARACTERISTIC DINH_FId.DFC_VehVSigFL_CA "inhibitable FIds / FIds to be inhibited by inhibit source DFC_VehVSigFL" VAL_BLK 0x804E3FF6 ValA_Wu16 968.000000000 DINH_FIdVerb 0.00 968.000000000 FORMAT "%13.9" NUMBER 51 /end CHARACTERISTIC
/begin CHARACTERISTIC DINH_FId.DFC_VehVSigFR_CA "inhibitable FIds / FIds to be inhibited by inhibit source DFC_VehVSigFR" VAL_BLK 0x804E405C ValA_Wu16 968.000000000 DINH_FIdVerb 0.00 968.000000000 FORMAT "%13.9" NUMBER 51 /end CHARACTERISTIC
/begin CHARACTERISTIC DINH_FId.DFC_VehVSigRL_CA "inhibitable FIds / FIds to be inhibited by inhibit source DFC_VehVSigRL" VAL_BLK 0x804E40C2 ValA_Wu16 968.000000000 DINH_FIdVerb 0.00 968.000000000 FORMAT "%13.9" NUMBER 51 /end CHARACTERISTIC
/begin CHARACTERISTIC DINH_FId.DFC_VehVSigRR_CA "inhibitable FIds / FIds to be inhibited by inhibit source DFC_VehVSigRR" VAL_BLK 0x804E4128 ValA_Wu16 968.000000000 DINH_FIdVerb 0.00 968.000000000 FORMAT "%13.9" NUMBER 51 /end CHARACTERISTIC
/begin CHARACTERISTIC DINH_FId.DFC_VehVSnsrARngHi_CA "inhibitable FIds / FIds to be inhibited by inhibit source DFC_VehVSnsrARngHi" VAL_BLK 0x804E418E ValA_Wu16 968.000000000 DINH_FIdVerb 0.00 968.000000000 FORMAT "%13.9" NUMBER 50 /end CHARACTERISTIC
/begin CHARACTERISTIC DINH_FId.DFC_VehVSnsrBRngHi_CA "inhibitable FIds / FIds to be inhibited by inhibit source DFC_VehVSnsrBRngHi" VAL_BLK 0x804E41F2 ValA_Wu16 968.000000000 DINH_FIdVerb 0.00 968.000000000 FORMAT "%13.9" NUMBER 50 /end CHARACTERISTIC
/begin CHARACTERISTIC DINH_FId.DFC_VehVSpdRtyDiag_CA "inhibitable FIds / FIds to be inhibited by inhibit source DFC_VehVSpdRtyDiag" VAL_BLK 0x804E4256 ValA_Wu16 968.000000000 DINH_FIdVerb 0.00 968.000000000 FORMAT "%13.9" NUMBER 51 /end CHARACTERISTIC
/begin CHARACTERISTIC DINH_FId.DFC_DHFHD_CA "inhibitable FIds / FIds to be inhibited by inhibit source DFC_DHFHD" VAL_BLK 0x804E42BC ValA_Wu16 968.000000000 DINH_FIdVerb 0.00 968.000000000 FORMAT "%13.9" NUMBER 51 /end CHARACTERISTIC
/begin CHARACTERISTIC DINH_FId.DFC_InjVlv_DI_DcDc_CA "inhibitable FIds / FIds to be inhibited by inhibit source DFC_InjVlv_DI_DcDc" VAL_BLK 0x804E4322 ValA_Wu16 968.000000000 DINH_FIdVerb 0.00 968.000000000 FORMAT "%13.9" NUMBER 50 /end CHARACTERISTIC
/begin CHARACTERISTIC DINH_FId.DFC_InjVlv_DI_NoLd_0_CA "inhibitable FIds / FIds to be inhibited by inhibit source DFC_InjVlv_DI_NoLd_0" VAL_BLK 0x804E4386 ValA_Wu16 968.000000000 DINH_FIdVerb 0.00 968.000000000 FORMAT "%13.9" NUMBER 60 /end CHARACTERISTIC
/begin CHARACTERISTIC DINH_FId.DFC_InjVlv_DI_NoLd_1_CA "inhibitable FIds / FIds to be inhibited by inhibit source DFC_InjVlv_DI_NoLd_1" VAL_BLK 0x804E43FE ValA_Wu16 968.000000000 DINH_FIdVerb 0.00 968.000000000 FORMAT "%13.9" NUMBER 60 /end CHARACTERISTIC
/begin CHARACTERISTIC DINH_FId.DFC_InjVlv_DI_NoLd_2_CA "inhibitable FIds / FIds to be inhibited by inhibit source DFC_InjVlv_DI_NoLd_2" VAL_BLK 0x804E4476 ValA_Wu16 968.000000000 DINH_FIdVerb 0.00 968.000000000 FORMAT "%13.9" NUMBER 60 /end CHARACTERISTIC
/begin CHARACTERISTIC DINH_FId.DFC_InjVlv_DI_NoLd_3_CA "inhibitable FIds / FIds to be inhibited by inhibit source DFC_InjVlv_DI_NoLd_3" VAL_BLK 0x804E44EE ValA_Wu16 968.000000000 DINH_FIdVerb 0.00 968.000000000 FORMAT "%13.9" NUMBER 60 /end CHARACTERISTIC
/begin CHARACTERISTIC DINH_FId.DFC_InjVlv_DI_ScBnk_0_CA "inhibitable FIds / FIds to be inhibited by inhibit source DFC_InjVlv_DI_ScBnk_0" VAL_BLK 0x804E4566 ValA_Wu16 968.000000000 DINH_FIdVerb 0.00 968.000000000 FORMAT "%13.9" NUMBER 60 /end CHARACTERISTIC
/begin CHARACTERISTIC DINH_FId.DFC_InjVlv_DI_ScBnk_1_CA "inhibitable FIds / FIds to be inhibited by inhibit source DFC_InjVlv_DI_ScBnk_1" VAL_BLK 0x804E45DE ValA_Wu16 968.000000000 DINH_FIdVerb 0.00 968.000000000 FORMAT "%13.9" NUMBER 60 /end CHARACTERISTIC
/begin CHARACTERISTIC DINH_FId.DFC_InjVlv_DI_ScBnk_2_CA "inhibitable FIds / FIds to be inhibited by inhibit source DFC_InjVlv_DI_ScBnk_2" VAL_BLK 0x804E4656 ValA_Wu16 968.000000000 DINH_FIdVerb 0.00 968.000000000 FORMAT "%13.9" NUMBER 60 /end CHARACTERISTIC
/begin CHARACTERISTIC DINH_FId.DFC_InjVlv_DI_ScBnk_3_CA "inhibitable FIds / FIds to be inhibited by inhibit source DFC_InjVlv_DI_ScBnk_3" VAL_BLK 0x804E46CE ValA_Wu16 968.000000000 DINH_FIdVerb 0.00 968.000000000 FORMAT "%13.9" NUMBER 60 /end CHARACTERISTIC
/begin CHARACTERISTIC DINH_FId.DFC_InjVlv_DI_ScCyl_0_CA "inhibitable FIds / FIds to be inhibited by inhibit source DFC_InjVlv_DI_ScCyl_0" VAL_BLK 0x804E4746 ValA_Wu16 968.000000000 DINH_FIdVerb 0.00 968.000000000 FORMAT "%13.9" NUMBER 60 /end CHARACTERISTIC
/begin CHARACTERISTIC DINH_FId.DFC_InjVlv_DI_ScCyl_1_CA "inhibitable FIds / FIds to be inhibited by inhibit source DFC_InjVlv_DI_ScCyl_1" VAL_BLK 0x804E47BE ValA_Wu16 968.000000000 DINH_FIdVerb 0.00 968.000000000 FORMAT "%13.9" NUMBER 60 /end CHARACTERISTIC
/begin CHARACTERISTIC DINH_FId.DFC_InjVlv_DI_ScCyl_2_CA "inhibitable FIds / FIds to be inhibited by inhibit source DFC_InjVlv_DI_ScCyl_2" VAL_BLK 0x804E4836 ValA_Wu16 968.000000000 DINH_FIdVerb 0.00 968.000000000 FORMAT "%13.9" NUMBER 60 /end CHARACTERISTIC
/begin CHARACTERISTIC DINH_FId.DFC_InjVlv_DI_ScCyl_3_CA "inhibitable FIds / FIds to be inhibited by inhibit source DFC_InjVlv_DI_ScCyl_3" VAL_BLK 0x804E48AE ValA_Wu16 968.000000000 DINH_FIdVerb 0.00 968.000000000 FORMAT "%13.9" NUMBER 60 /end CHARACTERISTIC
/begin CHARACTERISTIC DINH_FId.DFC_InjVlv_DI_ScHsLs_0_CA "inhibitable FIds / FIds to be inhibited by inhibit source DFC_InjVlv_DI_ScHsLs_0" VAL_BLK 0x804E4926 ValA_Wu16 968.000000000 DINH_FIdVerb 0.00 968.000000000 FORMAT "%13.9" NUMBER 60 /end CHARACTERISTIC
/begin CHARACTERISTIC DINH_FId.DFC_InjVlv_DI_ScHsLs_1_CA "inhibitable FIds / FIds to be inhibited by inhibit source DFC_InjVlv_DI_ScHsLs_1" VAL_BLK 0x804E499E ValA_Wu16 968.000000000 DINH_FIdVerb 0.00 968.000000000 FORMAT "%13.9" NUMBER 60 /end CHARACTERISTIC
/begin CHARACTERISTIC DINH_FId.DFC_InjVlv_DI_ScHsLs_2_CA "inhibitable FIds / FIds to be inhibited by inhibit source DFC_InjVlv_DI_ScHsLs_2" VAL_BLK 0x804E4A16 ValA_Wu16 968.000000000 DINH_FIdVerb 0.00 968.000000000 FORMAT "%13.9" NUMBER 60 /end CHARACTERISTIC
/begin CHARACTERISTIC DINH_FId.DFC_InjVlv_DI_ScHsLs_3_CA "inhibitable FIds / FIds to be inhibited by inhibit source DFC_InjVlv_DI_ScHsLs_3" VAL_BLK 0x804E4A8E ValA_Wu16 968.000000000 DINH_FIdVerb 0.00 968.000000000 FORMAT "%13.9" NUMBER 60 /end CHARACTERISTIC
/begin CHARACTERISTIC DINH_FId.DFC_MfPsDiaOpenLoad1_CA "inhibitable FIds / FIds to be inhibited by inhibit source DFC_MfPsDiaOpenLoad1" VAL_BLK 0x804E4B06 ValA_Wu16 968.000000000 DINH_FIdVerb 0.00 968.000000000 FORMAT "%13.9" NUMBER 65 /end CHARACTERISTIC
/begin CHARACTERISTIC DINH_FId.DFC_MfPsDiaScHiS1_CA "inhibitable FIds / FIds to be inhibited by inhibit source DFC_MfPsDiaScHiS1" VAL_BLK 0x804E4B88 ValA_Wu16 968.000000000 DINH_FIdVerb 0.00 968.000000000 FORMAT "%13.9" NUMBER 65 /end CHARACTERISTIC
/begin CHARACTERISTIC DINH_FId.DFC_MfPsDiaScHiSLowS1_CA "inhibitable FIds / FIds to be inhibited by inhibit source DFC_MfPsDiaScHiSLowS1" VAL_BLK 0x804E4C0A ValA_Wu16 968.000000000 DINH_FIdVerb 0.00 968.000000000 FORMAT "%13.9" NUMBER 65 /end CHARACTERISTIC
/begin CHARACTERISTIC DINH_FId.DFC_MfPsDiaScLowS1_CA "inhibitable FIds / FIds to be inhibited by inhibit source DFC_MfPsDiaScLowS1" VAL_BLK 0x804E4C8C ValA_Wu16 968.000000000 DINH_FIdVerb 0.00 968.000000000 FORMAT "%13.9" NUMBER 65 /end CHARACTERISTIC
/begin CHARACTERISTIC DINH_FId.DFC_ACEvpTPhysRngHi_CA "inhibitable FIds / FIds to be inhibited by inhibit source DFC_ACEvpTPhysRngHi" VAL_BLK 0x804E4D0E ValA_Wu16 968.000000000 DINH_FIdVerb 0.00 968.000000000 FORMAT "%13.9" NUMBER 52 /end CHARACTERISTIC
/begin CHARACTERISTIC DINH_FId.DFC_ACEvpTPhysRngLo_CA "inhibitable FIds / FIds to be inhibited by inhibit source DFC_ACEvpTPhysRngLo" VAL_BLK 0x804E4D76 ValA_Wu16 968.000000000 DINH_FIdVerb 0.00 968.000000000 FORMAT "%13.9" NUMBER 52 /end CHARACTERISTIC
/begin CHARACTERISTIC DINH_FId.DFC_ACEvpTSRCMax_CA "inhibitable FIds / FIds to be inhibited by inhibit source DFC_ACEvpTSRCMax" VAL_BLK 0x804E4DDE ValA_Wu16 968.000000000 DINH_FIdVerb 0.00 968.000000000 FORMAT "%13.9" NUMBER 53 /end CHARACTERISTIC
/begin CHARACTERISTIC DINH_FId.DFC_ACEvpTSRCMin_CA "inhibitable FIds / FIds to be inhibited by inhibit source DFC_ACEvpTSRCMin" VAL_BLK 0x804E4E48 ValA_Wu16 968.000000000 DINH_FIdVerb 0.00 968.000000000 FORMAT "%13.9" NUMBER 53 /end CHARACTERISTIC
/begin CHARACTERISTIC DINH_FId.DFC_AfsRawSigRngHiB1_CA "inhibitable FIds / FIds to be inhibited by inhibit source DFC_AfsRawSigRngHiB1" VAL_BLK 0x804E4EB2 ValA_Wu16 968.000000000 DINH_FIdVerb 0.00 968.000000000 FORMAT "%13.9" NUMBER 57 /end CHARACTERISTIC
/begin CHARACTERISTIC DINH_FId.DFC_AfsRawSigRngLoB1_CA "inhibitable FIds / FIds to be inhibited by inhibit source DFC_AfsRawSigRngLoB1" VAL_BLK 0x804E4F24 ValA_Wu16 968.000000000 DINH_FIdVerb 0.00 968.000000000 FORMAT "%13.9" NUMBER 57 /end CHARACTERISTIC
/begin CHARACTERISTIC DINH_FId.DFC_AfsSnsrErrB1_CA "inhibitable FIds / FIds to be inhibited by inhibit source DFC_AfsSnsrErrB1" VAL_BLK 0x804E4F96 ValA_Wu16 968.000000000 DINH_FIdVerb 0.00 968.000000000 FORMAT "%13.9" NUMBER 57 /end CHARACTERISTIC
/begin CHARACTERISTIC DINH_FId.DFC_AirCClntPAnaSRCMax_CA "inhibitable FIds / FIds to be inhibited by inhibit source DFC_AirCClntPAnaSRCMax" VAL_BLK 0x804E5008 ValA_Wu16 968.000000000 DINH_FIdVerb 0.00 968.000000000 FORMAT "%13.9" NUMBER 56 /end CHARACTERISTIC
/begin CHARACTERISTIC DINH_FId.DFC_AirCClntPAnaSRCMin_CA "inhibitable FIds / FIds to be inhibited by inhibit source DFC_AirCClntPAnaSRCMin" VAL_BLK 0x804E5078 ValA_Wu16 968.000000000 DINH_FIdVerb 0.00 968.000000000 FORMAT "%13.9" NUMBER 56 /end CHARACTERISTIC
/begin CHARACTERISTIC DINH_FId.DFC_AirCSwtNpl_CA "inhibitable FIds / FIds to be inhibited by inhibit source DFC_AirCSwtNpl" VAL_BLK 0x804E50E8 ValA_Wu16 968.000000000 DINH_FIdVerb 0.00 968.000000000 FORMAT "%13.9" NUMBER 51 /end CHARACTERISTIC
/begin CHARACTERISTIC DINH_FId.DFC_AirCSwtSig_CA "inhibitable FIds / FIds to be inhibited by inhibit source DFC_AirCSwtSig" VAL_BLK 0x804E514E ValA_Wu16 968.000000000 DINH_FIdVerb 0.00 968.000000000 FORMAT "%13.9" NUMBER 51 /end CHARACTERISTIC
/begin CHARACTERISTIC DINH_FId.DFC_Brk_CA "inhibitable FIds / FIds to be inhibited by inhibit source DFC_Brk" VAL_BLK 0x804E51B4 ValA_Wu16 968.000000000 DINH_FIdVerb 0.00 968.000000000 FORMAT "%13.9" NUMBER 50 /end CHARACTERISTIC
/begin CHARACTERISTIC DINH_FId.DFC_BrkBstSensSCB_CA "inhibitable FIds / FIds to be inhibited by inhibit source DFC_BrkBstSensSCB" VAL_BLK 0x804E5218 ValA_Wu16 968.000000000 DINH_FIdVerb 0.00 968.000000000 FORMAT "%13.9" NUMBER 53 /end CHARACTERISTIC
/begin CHARACTERISTIC DINH_FId.DFC_BrkBstSensSCG_CA "inhibitable FIds / FIds to be inhibited by inhibit source DFC_BrkBstSensSCG" VAL_BLK 0x804E5282 ValA_Wu16 968.000000000 DINH_FIdVerb 0.00 968.000000000 FORMAT "%13.9" NUMBER 53 /end CHARACTERISTIC
/begin CHARACTERISTIC DINH_FId.DFC_BrkSig_CA "inhibitable FIds / FIds to be inhibited by inhibit source DFC_BrkSig" VAL_BLK 0x804E52EC ValA_Wu16 968.000000000 DINH_FIdVerb 0.00 968.000000000 FORMAT "%13.9" NUMBER 54 /end CHARACTERISTIC
/begin CHARACTERISTIC DINH_FId.DFC_ClthSig_CA "inhibitable FIds / FIds to be inhibited by inhibit source DFC_ClthSig" VAL_BLK 0x804E5358 ValA_Wu16 968.000000000 DINH_FIdVerb 0.00 968.000000000 FORMAT "%13.9" NUMBER 63 /end CHARACTERISTIC
/begin CHARACTERISTIC DINH_FId.DFC_EGRVlvCurrLim_CA "inhibitable FIds / FIds to be inhibited by inhibit source DFC_EGRVlvCurrLim" VAL_BLK 0x804E53D6 ValA_Wu16 968.000000000 DINH_FIdVerb 0.00 968.000000000 FORMAT "%13.9" NUMBER 54 /end CHARACTERISTIC
/begin CHARACTERISTIC DINH_FId.DFC_EGRVlvOL_CA "inhibitable FIds / FIds to be inhibited by inhibit source DFC_EGRVlvOL" VAL_BLK 0x804E5442 ValA_Wu16 968.000000000 DINH_FIdVerb 0.00 968.000000000 FORMAT "%13.9" NUMBER 68 /end CHARACTERISTIC
/begin CHARACTERISTIC DINH_FId.DFC_EGRVlvOvrTemp_CA "inhibitable FIds / FIds to be inhibited by inhibit source DFC_EGRVlvOvrTemp" VAL_BLK 0x804E54CA ValA_Wu16 968.000000000 DINH_FIdVerb 0.00 968.000000000 FORMAT "%13.9" NUMBER 50 /end CHARACTERISTIC
/begin CHARACTERISTIC DINH_FId.DFC_EGRVlvSCB_CA "inhibitable FIds / FIds to be inhibited by inhibit source DFC_EGRVlvSCB" VAL_BLK 0x804E552E ValA_Wu16 968.000000000 DINH_FIdVerb 0.00 968.000000000 FORMAT "%13.9" NUMBER 69 /end CHARACTERISTIC
/begin CHARACTERISTIC DINH_FId.DFC_EGRVlvSCG_CA "inhibitable FIds / FIds to be inhibited by inhibit source DFC_EGRVlvSCG" VAL_BLK 0x804E55B8 ValA_Wu16 968.000000000 DINH_FIdVerb 0.00 968.000000000 FORMAT "%13.9" NUMBER 68 /end CHARACTERISTIC
/begin CHARACTERISTIC DINH_FId.DFC_EGRVlvSRCMax_CA "inhibitable FIds / FIds to be inhibited by inhibit source DFC_EGRVlvSRCMax" VAL_BLK 0x804E5640 ValA_Wu16 968.000000000 DINH_FIdVerb 0.00 968.000000000 FORMAT "%13.9" NUMBER 61 /end CHARACTERISTIC
/begin CHARACTERISTIC DINH_FId.DFC_EGRVlvSRCMin_CA "inhibitable FIds / FIds to be inhibited by inhibit source DFC_EGRVlvSRCMin" VAL_BLK 0x804E56BA ValA_Wu16 968.000000000 DINH_FIdVerb 0.00 968.000000000 FORMAT "%13.9" NUMBER 60 /end CHARACTERISTIC
/begin CHARACTERISTIC DINH_FId.DFC_HLSDemOvhtEngLim_CA "inhibitable FIds / FIds to be inhibited by inhibit source DFC_HLSDemOvhtEngLim" VAL_BLK 0x804E5732 ValA_Wu16 968.000000000 DINH_FIdVerb 0.00 968.000000000 FORMAT "%13.9" NUMBER 50 /end CHARACTERISTIC
/begin CHARACTERISTIC DINH_FId.DFC_OilPSwmpSRCMax_CA "inhibitable FIds / FIds to be inhibited by inhibit source DFC_OilPSwmpSRCMax" VAL_BLK 0x804E5796 ValA_Wu16 968.000000000 DINH_FIdVerb 0.00 968.000000000 FORMAT "%13.9" NUMBER 59 /end CHARACTERISTIC
/begin CHARACTERISTIC DINH_FId.DFC_OilPSwmpSRCMin_CA "inhibitable FIds / FIds to be inhibited by inhibit source DFC_OilPSwmpSRCMin" VAL_BLK 0x804E580C ValA_Wu16 968.000000000 DINH_FIdVerb 0.00 968.000000000 FORMAT "%13.9" NUMBER 60 /end CHARACTERISTIC
/begin CHARACTERISTIC DINH_FId.DFC_PIntkVUsLineHiB1_CA "inhibitable FIds / FIds to be inhibited by inhibit source DFC_PIntkVUsLineHiB1" VAL_BLK 0x804E5884 ValA_Wu16 968.000000000 DINH_FIdVerb 0.00 968.000000000 FORMAT "%13.9" NUMBER 97 /end CHARACTERISTIC
/begin CHARACTERISTIC DINH_FId.DFC_PIntkVUsLineLoB1_CA "inhibitable FIds / FIds to be inhibited by inhibit source DFC_PIntkVUsLineLoB1" VAL_BLK 0x804E5946 ValA_Wu16 968.000000000 DINH_FIdVerb 0.00 968.000000000 FORMAT "%13.9" NUMBER 97 /end CHARACTERISTIC
/begin CHARACTERISTIC DINH_FId.DFC_VehVPhysRngLo_CA "inhibitable FIds / FIds to be inhibited by inhibit source DFC_VehVPhysRngLo" VAL_BLK 0x804E5A08 ValA_Wu16 968.000000000 DINH_FIdVerb 0.00 968.000000000 FORMAT "%13.9" NUMBER 82 /end CHARACTERISTIC
/begin CHARACTERISTIC DINH_FId.DFC_VehVSigCan_CA "inhibitable FIds / FIds to be inhibited by inhibit source DFC_VehVSigCan" VAL_BLK 0x804E5AAC ValA_Wu16 968.000000000 DINH_FIdVerb 0.00 968.000000000 FORMAT "%13.9" NUMBER 54 /end CHARACTERISTIC
/begin CHARACTERISTIC DINH_FId.DFC_VehVSigCanSafe_CA "inhibitable FIds / FIds to be inhibited by inhibit source DFC_VehVSigCanSafe" VAL_BLK 0x804E5B18 ValA_Wu16 968.000000000 DINH_FIdVerb 0.00 968.000000000 FORMAT "%13.9" NUMBER 57 /end CHARACTERISTIC
/begin CHARACTERISTIC DINH_FId.DFC_VlvLftFbOilPSnsrIntk11SRCMax_CA "inhibitable FIds / FIds to be inhibited by inhibit source DFC_VlvLftFbOilPSnsrIntk11SRCMax" VAL_BLK 0x804E5B8A ValA_Wu16 968.000000000 DINH_FIdVerb 0.00 968.000000000 FORMAT "%13.9" NUMBER 79 /end CHARACTERISTIC
/begin CHARACTERISTIC DINH_FId.DFC_VlvLftFbOilPSnsrIntk11SRCMin_CA "inhibitable FIds / FIds to be inhibited by inhibit source DFC_VlvLftFbOilPSnsrIntk11SRCMin" VAL_BLK 0x804E5C28 ValA_Wu16 968.000000000 DINH_FIdVerb 0.00 968.000000000 FORMAT "%13.9" NUMBER 79 /end CHARACTERISTIC
/begin CHARACTERISTIC DINH_FId.DFC_ClthNpl_CA "inhibitable FIds / FIds to be inhibited by inhibit source DFC_ClthNpl" VAL_BLK 0x804E5CC6 ValA_Wu16 968.000000000 DINH_FIdVerb 0.00 968.000000000 FORMAT "%13.9" NUMBER 64 /end CHARACTERISTIC
/begin CHARACTERISTIC DINH_FId.DFC_GbxPNPosnDrvCdn_CA "inhibitable FIds / FIds to be inhibited by inhibit source DFC_GbxPNPosnDrvCdn" VAL_BLK 0x804E5D46 ValA_Wu16 968.000000000 DINH_FIdVerb 0.00 968.000000000 FORMAT "%13.9" NUMBER 61 /end CHARACTERISTIC
/begin CHARACTERISTIC DINH_FId.DFC_GbxPNPosnPlausy_CA "inhibitable FIds / FIds to be inhibited by inhibit source DFC_GbxPNPosnPlausy" VAL_BLK 0x804E5DC0 ValA_Wu16 968.000000000 DINH_FIdVerb 0.00 968.000000000 FORMAT "%13.9" NUMBER 55 /end CHARACTERISTIC
/begin CHARACTERISTIC DINH_FId.DFC_AfsSigErrLineHiB1_CA "inhibitable FIds / FIds to be inhibited by inhibit source DFC_AfsSigErrLineHiB1" VAL_BLK 0x804E5E2E ValA_Wu16 968.000000000 DINH_FIdVerb 0.00 968.000000000 FORMAT "%13.9" NUMBER 58 /end CHARACTERISTIC
/begin CHARACTERISTIC DINH_FId.DFC_AfsSigErrLineLoB1_CA "inhibitable FIds / FIds to be inhibited by inhibit source DFC_AfsSigErrLineLoB1" VAL_BLK 0x804E5EA2 ValA_Wu16 968.000000000 DINH_FIdVerb 0.00 968.000000000 FORMAT "%13.9" NUMBER 58 /end CHARACTERISTIC
/begin CHARACTERISTIC DINH_FId.DFC_PEnvCcMax_CA "inhibitable FIds / FIds to be inhibited by inhibit source DFC_PEnvCcMax" VAL_BLK 0x804E5F16 ValA_Wu16 968.000000000 DINH_FIdVerb 0.00 968.000000000 FORMAT "%13.9" NUMBER 85 /end CHARACTERISTIC
/begin CHARACTERISTIC DINH_FId.DFC_PEnvCcMin_CA "inhibitable FIds / FIds to be inhibited by inhibit source DFC_PEnvCcMin" VAL_BLK 0x804E5FC0 ValA_Wu16 968.000000000 DINH_FIdVerb 0.00 968.000000000 FORMAT "%13.9" NUMBER 85 /end CHARACTERISTIC
/begin CHARACTERISTIC DINH_FId.DFC_PEnvRngChkMax_CA "inhibitable FIds / FIds to be inhibited by inhibit source DFC_PEnvRngChkMax" VAL_BLK 0x804E606A ValA_Wu16 968.000000000 DINH_FIdVerb 0.00 968.000000000 FORMAT "%13.9" NUMBER 86 /end CHARACTERISTIC
/begin CHARACTERISTIC DINH_FId.DFC_PEnvRngChkMin_CA "inhibitable FIds / FIds to be inhibited by inhibit source DFC_PEnvRngChkMin" VAL_BLK 0x804E6116 ValA_Wu16 968.000000000 DINH_FIdVerb 0.00 968.000000000 FORMAT "%13.9" NUMBER 86 /end CHARACTERISTIC
/begin CHARACTERISTIC DINH_FId.DFC_PEnvSnsrPlaus_CA "inhibitable FIds / FIds to be inhibited by inhibit source DFC_PEnvSnsrPlaus" VAL_BLK 0x804E61C2 ValA_Wu16 968.000000000 DINH_FIdVerb 0.00 968.000000000 FORMAT "%13.9" NUMBER 82 /end CHARACTERISTIC
/begin CHARACTERISTIC DINH_FId.DFC_UEGOHeatrRlyPsOLS1B1_CA "inhibitable FIds / FIds to be inhibited by inhibit source DFC_UEGOHeatrRlyPsOLS1B1" VAL_BLK 0x804E6266 ValA_Wu16 968.000000000 DINH_FIdVerb 0.00 968.000000000 FORMAT "%13.9" NUMBER 84 /end CHARACTERISTIC
/begin CHARACTERISTIC DINH_FId.DFC_UEGOHeatrRlyPsSCBS1B1_CA "inhibitable FIds / FIds to be inhibited by inhibit source DFC_UEGOHeatrRlyPsSCBS1B1" VAL_BLK 0x804E630E ValA_Wu16 968.000000000 DINH_FIdVerb 0.00 968.000000000 FORMAT "%13.9" NUMBER 84 /end CHARACTERISTIC
/begin CHARACTERISTIC DINH_FId.DFC_UEGOHeatrRlyPsSCGS1B1_CA "inhibitable FIds / FIds to be inhibited by inhibit source DFC_UEGOHeatrRlyPsSCGS1B1" VAL_BLK 0x804E63B6 ValA_Wu16 968.000000000 DINH_FIdVerb 0.00 968.000000000 FORMAT "%13.9" NUMBER 82 /end CHARACTERISTIC
/begin CHARACTERISTIC DINH_FId.DFC_UegoHeatrWireOlS1B1_CA "inhibitable FIds / FIds to be inhibited by inhibit source DFC_UegoHeatrWireOlS1B1" VAL_BLK 0x804E645A ValA_Wu16 968.000000000 DINH_FIdVerb 0.00 968.000000000 FORMAT "%13.9" NUMBER 84 /end CHARACTERISTIC
/begin CHARACTERISTIC DINH_FId.DFC_UegoHeatrWireScbS1B1_CA "inhibitable FIds / FIds to be inhibited by inhibit source DFC_UegoHeatrWireScbS1B1" VAL_BLK 0x804E6502 ValA_Wu16 968.000000000 DINH_FIdVerb 0.00 968.000000000 FORMAT "%13.9" NUMBER 84 /end CHARACTERISTIC
/begin CHARACTERISTIC DINH_FId.DFC_UegoHeatrWireScgS1B1_CA "inhibitable FIds / FIds to be inhibited by inhibit source DFC_UegoHeatrWireScgS1B1" VAL_BLK 0x804E65AA ValA_Wu16 968.000000000 DINH_FIdVerb 0.00 968.000000000 FORMAT "%13.9" NUMBER 85 /end CHARACTERISTIC
/begin CHARACTERISTIC DINH_FId.DFC_KnDetSens1PortAMax_CA "inhibitable FIds / FIds to be inhibited by inhibit source DFC_KnDetSens1PortAMax" VAL_BLK 0x804E6654 ValA_Wu16 968.000000000 DINH_FIdVerb 0.00 968.000000000 FORMAT "%13.9" NUMBER 58 /end CHARACTERISTIC
/begin CHARACTERISTIC DINH_FId.DFC_KnDetSens1PortAMin_CA "inhibitable FIds / FIds to be inhibited by inhibit source DFC_KnDetSens1PortAMin" VAL_BLK 0x804E66C8 ValA_Wu16 968.000000000 DINH_FIdVerb 0.00 968.000000000 FORMAT "%13.9" NUMBER 58 /end CHARACTERISTIC
/begin CHARACTERISTIC DINH_FId.DFC_KnDetSens1PortBMax_CA "inhibitable FIds / FIds to be inhibited by inhibit source DFC_KnDetSens1PortBMax" VAL_BLK 0x804E673C ValA_Wu16 968.000000000 DINH_FIdVerb 0.00 968.000000000 FORMAT "%13.9" NUMBER 58 /end CHARACTERISTIC
/begin CHARACTERISTIC DINH_FId.DFC_KnDetSens1PortBMin_CA "inhibitable FIds / FIds to be inhibited by inhibit source DFC_KnDetSens1PortBMin" VAL_BLK 0x804E67B0 ValA_Wu16 968.000000000 DINH_FIdVerb 0.00 968.000000000 FORMAT "%13.9" NUMBER 58 /end CHARACTERISTIC
/begin CHARACTERISTIC DINH_FId.DFC_Clth2ONStuck_CA "inhibitable FIds / FIds to be inhibited by inhibit source DFC_Clth2ONStuck" VAL_BLK 0x804E6824 ValA_Wu16 968.000000000 DINH_FIdVerb 0.00 968.000000000 FORMAT "%13.9" NUMBER 52 /end CHARACTERISTIC
/begin CHARACTERISTIC DINH_FId.DFC_Clth2ONStuckLdc_CA "inhibitable FIds / FIds to be inhibited by inhibit source DFC_Clth2ONStuckLdc" VAL_BLK 0x804E688C ValA_Wu16 968.000000000 DINH_FIdVerb 0.00 968.000000000 FORMAT "%13.9" NUMBER 52 /end CHARACTERISTIC
/begin CHARACTERISTIC DINH_FId.DFC_Clth3ONStuckLdc_CA "inhibitable FIds / FIds to be inhibited by inhibit source DFC_Clth3ONStuckLdc" VAL_BLK 0x804E68F4 ValA_Wu16 968.000000000 DINH_FIdVerb 0.00 968.000000000 FORMAT "%13.9" NUMBER 55 /end CHARACTERISTIC
/begin CHARACTERISTIC DINH_FId.DFC_Clth3ONStuckPostDrv_CA "inhibitable FIds / FIds to be inhibited by inhibit source DFC_Clth3ONStuckPostDrv" VAL_BLK 0x804E6962 ValA_Wu16 968.000000000 DINH_FIdVerb 0.00 968.000000000 FORMAT "%13.9" NUMBER 54 /end CHARACTERISTIC
/begin CHARACTERISTIC DINH_FId.DFC_Clth4ONStuck_CA "inhibitable FIds / FIds to be inhibited by inhibit source DFC_Clth4ONStuck" VAL_BLK 0x804E69CE ValA_Wu16 968.000000000 DINH_FIdVerb 0.00 968.000000000 FORMAT "%13.9" NUMBER 51 /end CHARACTERISTIC
/begin CHARACTERISTIC DINH_FId.DFC_Clth4ONStuckLdc_CA "inhibitable FIds / FIds to be inhibited by inhibit source DFC_Clth4ONStuckLdc" VAL_BLK 0x804E6A34 ValA_Wu16 968.000000000 DINH_FIdVerb 0.00 968.000000000 FORMAT "%13.9" NUMBER 59 /end CHARACTERISTIC
/begin CHARACTERISTIC DINH_FId.DFC_ComBCMUnit_CA "inhibitable FIds / FIds to be inhibited by inhibit source DFC_ComBCMUnit" VAL_BLK 0x804E6AAA ValA_Wu16 968.000000000 DINH_FIdVerb 0.00 968.000000000 FORMAT "%13.9" NUMBER 50 /end CHARACTERISTIC
/begin CHARACTERISTIC DINH_FId.DFC_ComDLCTCU01_CA "inhibitable FIds / FIds to be inhibited by inhibit source DFC_ComDLCTCU01" VAL_BLK 0x804E6B0E ValA_Wu16 968.000000000 DINH_FIdVerb 0.00 968.000000000 FORMAT "%13.9" NUMBER 51 /end CHARACTERISTIC
/begin CHARACTERISTIC DINH_FId.DFC_ComDLCTCU02_CA "inhibitable FIds / FIds to be inhibited by inhibit source DFC_ComDLCTCU02" VAL_BLK 0x804E6B74 ValA_Wu16 968.000000000 DINH_FIdVerb 0.00 968.000000000 FORMAT "%13.9" NUMBER 51 /end CHARACTERISTIC
/begin CHARACTERISTIC DINH_FId.DFC_ComDLCTCU1_CA "inhibitable FIds / FIds to be inhibited by inhibit source DFC_ComDLCTCU1" VAL_BLK 0x804E6BDA ValA_Wu16 968.000000000 DINH_FIdVerb 0.00 968.000000000 FORMAT "%13.9" NUMBER 55 /end CHARACTERISTIC
/begin CHARACTERISTIC DINH_FId.DFC_ComDLCTCU11_CA "inhibitable FIds / FIds to be inhibited by inhibit source DFC_ComDLCTCU11" VAL_BLK 0x804E6C48 ValA_Wu16 968.000000000 DINH_FIdVerb 0.00 968.000000000 FORMAT "%13.9" NUMBER 54 /end CHARACTERISTIC
/begin CHARACTERISTIC DINH_FId.DFC_ComDLCTCU12_CA "inhibitable FIds / FIds to be inhibited by inhibit source DFC_ComDLCTCU12" VAL_BLK 0x804E6CB4 ValA_Wu16 968.000000000 DINH_FIdVerb 0.00 968.000000000 FORMAT "%13.9" NUMBER 52 /end CHARACTERISTIC
/begin CHARACTERISTIC DINH_FId.DFC_ComDLCTCU13_CA "inhibitable FIds / FIds to be inhibited by inhibit source DFC_ComDLCTCU13" VAL_BLK 0x804E6D1C ValA_Wu16 968.000000000 DINH_FIdVerb 0.00 968.000000000 FORMAT "%13.9" NUMBER 52 /end CHARACTERISTIC
/begin CHARACTERISTIC DINH_FId.DFC_ComDLCTCU14_CA "inhibitable FIds / FIds to be inhibited by inhibit source DFC_ComDLCTCU14" VAL_BLK 0x804E6D84 ValA_Wu16 968.000000000 DINH_FIdVerb 0.00 968.000000000 FORMAT "%13.9" NUMBER 51 /end CHARACTERISTIC
/begin CHARACTERISTIC DINH_FId.DFC_ComDLCTCU2_CA "inhibitable FIds / FIds to be inhibited by inhibit source DFC_ComDLCTCU2" VAL_BLK 0x804E6DEA ValA_Wu16 968.000000000 DINH_FIdVerb 0.00 968.000000000 FORMAT "%13.9" NUMBER 52 /end CHARACTERISTIC
/begin CHARACTERISTIC DINH_FId.DFC_ComDLCTCU3_CA "inhibitable FIds / FIds to be inhibited by inhibit source DFC_ComDLCTCU3" VAL_BLK 0x804E6E52 ValA_Wu16 968.000000000 DINH_FIdVerb 0.00 968.000000000 FORMAT "%13.9" NUMBER 52 /end CHARACTERISTIC
/begin CHARACTERISTIC DINH_FId.DFC_ComDLCTCU4_CA "inhibitable FIds / FIds to be inhibited by inhibit source DFC_ComDLCTCU4" VAL_BLK 0x804E6EBA ValA_Wu16 968.000000000 DINH_FIdVerb 0.00 968.000000000 FORMAT "%13.9" NUMBER 51 /end CHARACTERISTIC
/begin CHARACTERISTIC DINH_FId.DFC_ComEPSUnit_CA "inhibitable FIds / FIds to be inhibited by inhibit source DFC_ComEPSUnit" VAL_BLK 0x804E6F20 ValA_Wu16 968.000000000 DINH_FIdVerb 0.00 968.000000000 FORMAT "%13.9" NUMBER 50 /end CHARACTERISTIC
/begin CHARACTERISTIC DINH_FId.DFC_ComIDASBUnit_CA "inhibitable FIds / FIds to be inhibited by inhibit source DFC_ComIDASBUnit" VAL_BLK 0x804E6F84 ValA_Wu16 968.000000000 DINH_FIdVerb 0.00 968.000000000 FORMAT "%13.9" NUMBER 50 /end CHARACTERISTIC
/begin CHARACTERISTIC DINH_FId.DFC_ComIMGUnit_CA "inhibitable FIds / FIds to be inhibited by inhibit source DFC_ComIMGUnit" VAL_BLK 0x804E6FE8 ValA_Wu16 968.000000000 DINH_FIdVerb 0.00 968.000000000 FORMAT "%13.9" NUMBER 50 /end CHARACTERISTIC
/begin CHARACTERISTIC DINH_FId.DFC_ComMETUnit_CA "inhibitable FIds / FIds to be inhibited by inhibit source DFC_ComMETUnit" VAL_BLK 0x804E704C ValA_Wu16 968.000000000 DINH_FIdVerb 0.00 968.000000000 FORMAT "%13.9" NUMBER 50 /end CHARACTERISTIC
/begin CHARACTERISTIC DINH_FId.DFC_ComSRSUnit_CA "inhibitable FIds / FIds to be inhibited by inhibit source DFC_ComSRSUnit" VAL_BLK 0x804E70B0 ValA_Wu16 968.000000000 DINH_FIdVerb 0.00 968.000000000 FORMAT "%13.9" NUMBER 50 /end CHARACTERISTIC
/begin CHARACTERISTIC DINH_FId.DFC_ComVSAUnit_CA "inhibitable FIds / FIds to be inhibited by inhibit source DFC_ComVSAUnit" VAL_BLK 0x804E7114 ValA_Wu16 968.000000000 DINH_FIdVerb 0.00 968.000000000 FORMAT "%13.9" NUMBER 50 /end CHARACTERISTIC
/begin CHARACTERISTIC DINH_FId.DFC_EbsSocFlt_CA "inhibitable FIds / FIds to be inhibited by inhibit source DFC_EbsSocFlt" VAL_BLK 0x804E7178 ValA_Wu16 968.000000000 DINH_FIdVerb 0.00 968.000000000 FORMAT "%13.9" NUMBER 50 /end CHARACTERISTIC
/begin CHARACTERISTIC DINH_FId.DFC_I14229VINErr_CA "inhibitable FIds / FIds to be inhibited by inhibit source DFC_I14229VINErr" VAL_BLK 0x804E71DC ValA_Wu16 968.000000000 DINH_FIdVerb 0.00 968.000000000 FORMAT "%13.9" NUMBER 50 /end CHARACTERISTIC
/begin CHARACTERISTIC DINH_FId.DFC_InjCatHeatgErr_CA "inhibitable FIds / FIds to be inhibited by inhibit source DFC_InjCatHeatgErr" VAL_BLK 0x804E7240 ValA_Wu16 968.000000000 DINH_FIdVerb 0.00 968.000000000 FORMAT "%13.9" NUMBER 50 /end CHARACTERISTIC
/begin CHARACTERISTIC DINH_FId.DFC_InjSysMulInjDiagErr_CA "inhibitable FIds / FIds to be inhibited by inhibit source DFC_InjSysMulInjDiagErr" VAL_BLK 0x804E72A4 ValA_Wu16 968.000000000 DINH_FIdVerb 0.00 968.000000000 FORMAT "%13.9" NUMBER 50 /end CHARACTERISTIC
/begin CHARACTERISTIC DINH_FId.DFC_LLRHmax_CA "inhibitable FIds / FIds to be inhibited by inhibit source DFC_LLRHmax" VAL_BLK 0x804E7308 ValA_Wu16 968.000000000 DINH_FIdVerb 0.00 968.000000000 FORMAT "%13.9" NUMBER 58 /end CHARACTERISTIC
/begin CHARACTERISTIC DINH_FId.DFC_LLRHmin_CA "inhibitable FIds / FIds to be inhibited by inhibit source DFC_LLRHmin" VAL_BLK 0x804E737C ValA_Wu16 968.000000000 DINH_FIdVerb 0.00 968.000000000 FORMAT "%13.9" NUMBER 58 /end CHARACTERISTIC
/begin CHARACTERISTIC DINH_FId.DFC_LLRHnpl_CA "inhibitable FIds / FIds to be inhibited by inhibit source DFC_LLRHnpl" VAL_BLK 0x804E73F0 ValA_Wu16 968.000000000 DINH_FIdVerb 0.00 968.000000000 FORMAT "%13.9" NUMBER 58 /end CHARACTERISTIC
/begin CHARACTERISTIC DINH_FId.DFC_LLRKHmax_CA "inhibitable FIds / FIds to be inhibited by inhibit source DFC_LLRKHmax" VAL_BLK 0x804E7464 ValA_Wu16 968.000000000 DINH_FIdVerb 0.00 968.000000000 FORMAT "%13.9" NUMBER 50 /end CHARACTERISTIC
/begin CHARACTERISTIC DINH_FId.DFC_LLRKHmin_CA "inhibitable FIds / FIds to be inhibited by inhibit source DFC_LLRKHmin" VAL_BLK 0x804E74C8 ValA_Wu16 968.000000000 DINH_FIdVerb 0.00 968.000000000 FORMAT "%13.9" NUMBER 50 /end CHARACTERISTIC
/begin CHARACTERISTIC DINH_FId.DFC_LLRKHnpl_CA "inhibitable FIds / FIds to be inhibited by inhibit source DFC_LLRKHnpl" VAL_BLK 0x804E752C ValA_Wu16 968.000000000 DINH_FIdVerb 0.00 968.000000000 FORMAT "%13.9" NUMBER 50 /end CHARACTERISTIC
/begin CHARACTERISTIC DINH_FId.DFC_LinACGUnit_CA "inhibitable FIds / FIds to be inhibited by inhibit source DFC_LinACGUnit" VAL_BLK 0x804E7590 ValA_Wu16 968.000000000 DINH_FIdVerb 0.00 968.000000000 FORMAT "%13.9" NUMBER 50 /end CHARACTERISTIC
/begin CHARACTERISTIC DINH_FId.DFC_LinAEVUnit_CA "inhibitable FIds / FIds to be inhibited by inhibit source DFC_LinAEVUnit" VAL_BLK 0x804E75F4 ValA_Wu16 968.000000000 DINH_FIdVerb 0.00 968.000000000 FORMAT "%13.9" NUMBER 50 /end CHARACTERISTIC
/begin CHARACTERISTIC DINH_FId.DFC_LinEBSUnit_CA "inhibitable FIds / FIds to be inhibited by inhibit source DFC_LinEBSUnit" VAL_BLK 0x804E7658 ValA_Wu16 968.000000000 DINH_FIdVerb 0.00 968.000000000 FORMAT "%13.9" NUMBER 50 /end CHARACTERISTIC
/begin CHARACTERISTIC DINH_FId.DFC_RoughRoad_CA "inhibitable FIds / FIds to be inhibited by inhibit source DFC_RoughRoad" VAL_BLK 0x804E76BC ValA_Wu16 968.000000000 DINH_FIdVerb 0.00 968.000000000 FORMAT "%13.9" NUMBER 54 /end CHARACTERISTIC
/begin CHARACTERISTIC DINH_FId.DFC_SiaEEPRdErr_CA "inhibitable FIds / FIds to be inhibited by inhibit source DFC_SiaEEPRdErr" VAL_BLK 0x804E7728 ValA_Wu16 968.000000000 DINH_FIdVerb 0.00 968.000000000 FORMAT "%13.9" NUMBER 51 /end CHARACTERISTIC
/begin CHARACTERISTIC DINH_FId.DFC_SiaEEPWrngCod_CA "inhibitable FIds / FIds to be inhibited by inhibit source DFC_SiaEEPWrngCod" VAL_BLK 0x804E778E ValA_Wu16 968.000000000 DINH_FIdVerb 0.00 968.000000000 FORMAT "%13.9" NUMBER 51 /end CHARACTERISTIC
/begin CHARACTERISTIC DINH_FId.DFC_UegoHeatrStrtS1B1_CA "inhibitable FIds / FIds to be inhibited by inhibit source DFC_UegoHeatrStrtS1B1" VAL_BLK 0x804E77F4 ValA_Wu16 968.000000000 DINH_FIdVerb 0.00 968.000000000 FORMAT "%13.9" NUMBER 53 /end CHARACTERISTIC
/begin CHARACTERISTIC DINH_FId.DFC_BusDiagCANAPPLBusOff_CA "inhibitable FIds / FIds to be inhibited by inhibit source DFC_BusDiagCANAPPLBusOff" VAL_BLK 0x804E785E ValA_Wu16 968.000000000 DINH_FIdVerb 0.00 968.000000000 FORMAT "%13.9" NUMBER 50 /end CHARACTERISTIC
/begin CHARACTERISTIC DINH_FId.DFC_BusDiagCANCANCBusOff_CA "inhibitable FIds / FIds to be inhibited by inhibit source DFC_BusDiagCANCANCBusOff" VAL_BLK 0x804E78C2 ValA_Wu16 968.000000000 DINH_FIdVerb 0.00 968.000000000 FORMAT "%13.9" NUMBER 50 /end CHARACTERISTIC
/begin CHARACTERISTIC DINH_FId.DFC_BusDiagCANVEHICLEBusOff_CA "inhibitable FIds / FIds to be inhibited by inhibit source DFC_BusDiagCANVEHICLEBusOff" VAL_BLK 0x804E7926 ValA_Wu16 968.000000000 DINH_FIdVerb 0.00 968.000000000 FORMAT "%13.9" NUMBER 61 /end CHARACTERISTIC
/begin CHARACTERISTIC DINH_FId.DFC_RBA_IODIAGPWR_rba_IoExtCy329_SignalVltSply_0_CA "inhibitable FIds / FIds to be inhibited by inhibit source DFC_RBA_IODIAGPWR_rba_IoExtCy329_SignalVltSply_0" VAL_BLK 0x804E79A0 ValA_Wu16 968.000000000 DINH_FIdVerb 0.00 968.000000000 FORMAT "%13.9" NUMBER 200 /end CHARACTERISTIC
/begin CHARACTERISTIC DINH_FId.DFC_RBA_IODIAGPWR_rba_IoExtCy329_SignalVltSply_0OT_CA "inhibitable FIds / FIds to be inhibited by inhibit source DFC_RBA_IODIAGPWR_rba_IoExtCy329_SignalVltSply_0OT" VAL_BLK 0x804E7B30 ValA_Wu16 968.000000000 DINH_FIdVerb 0.00 968.000000000 FORMAT "%13.9" NUMBER 50 /end CHARACTERISTIC
/begin CHARACTERISTIC DINH_FId.DFC_RBA_IODIAGPWR_rba_IoExtCy329_SignalVltSply_0OV_CA "inhibitable FIds / FIds to be inhibited by inhibit source DFC_RBA_IODIAGPWR_rba_IoExtCy329_SignalVltSply_0OV" VAL_BLK 0x804E7B94 ValA_Wu16 968.000000000 DINH_FIdVerb 0.00 968.000000000 FORMAT "%13.9" NUMBER 50 /end CHARACTERISTIC
/begin CHARACTERISTIC DINH_FId.DFC_RBA_IODIAGPWR_rba_IoExtCy329_SignalVltSply_0SCG_CA "inhibitable FIds / FIds to be inhibited by inhibit source DFC_RBA_IODIAGPWR_rba_IoExtCy329_SignalVltSply_0SCG" VAL_BLK 0x804E7BF8 ValA_Wu16 968.000000000 DINH_FIdVerb 0.00 968.000000000 FORMAT "%13.9" NUMBER 50 /end CHARACTERISTIC
/begin CHARACTERISTIC DINH_FId.DFC_RBA_IODIAGPWR_rba_IoExtCy329_SignalVltSply_0UV_CA "inhibitable FIds / FIds to be inhibited by inhibit source DFC_RBA_IODIAGPWR_rba_IoExtCy329_SignalVltSply_0UV" VAL_BLK 0x804E7C5C ValA_Wu16 968.000000000 DINH_FIdVerb 0.00 968.000000000 FORMAT "%13.9" NUMBER 50 /end CHARACTERISTIC
/begin CHARACTERISTIC DINH_FId.DFC_RBA_IODIAGPWR_rba_IoExtCy329_SignalVltSply_1_CA "inhibitable FIds / FIds to be inhibited by inhibit source DFC_RBA_IODIAGPWR_rba_IoExtCy329_SignalVltSply_1" VAL_BLK 0x804E7CC0 ValA_Wu16 968.000000000 DINH_FIdVerb 0.00 968.000000000 FORMAT "%13.9" NUMBER 200 /end CHARACTERISTIC
/begin CHARACTERISTIC DINH_FId.DFC_RBA_IODIAGPWR_rba_IoExtCy329_SignalVltSply_1OT_CA "inhibitable FIds / FIds to be inhibited by inhibit source DFC_RBA_IODIAGPWR_rba_IoExtCy329_SignalVltSply_1OT" VAL_BLK 0x804E7E50 ValA_Wu16 968.000000000 DINH_FIdVerb 0.00 968.000000000 FORMAT "%13.9" NUMBER 50 /end CHARACTERISTIC
/begin CHARACTERISTIC DINH_FId.DFC_RBA_IODIAGPWR_rba_IoExtCy329_SignalVltSply_1OV_CA "inhibitable FIds / FIds to be inhibited by inhibit source DFC_RBA_IODIAGPWR_rba_IoExtCy329_SignalVltSply_1OV" VAL_BLK 0x804E7EB4 ValA_Wu16 968.000000000 DINH_FIdVerb 0.00 968.000000000 FORMAT "%13.9" NUMBER 50 /end CHARACTERISTIC
/begin CHARACTERISTIC DINH_FId.DFC_RBA_IODIAGPWR_rba_IoExtCy329_SignalVltSply_1SCG_CA "inhibitable FIds / FIds to be inhibited by inhibit source DFC_RBA_IODIAGPWR_rba_IoExtCy329_SignalVltSply_1SCG" VAL_BLK 0x804E7F18 ValA_Wu16 968.000000000 DINH_FIdVerb 0.00 968.000000000 FORMAT "%13.9" NUMBER 50 /end CHARACTERISTIC
/begin CHARACTERISTIC DINH_FId.DFC_RBA_IODIAGPWR_rba_IoExtCy329_SignalVltSply_1UV_CA "inhibitable FIds / FIds to be inhibited by inhibit source DFC_RBA_IODIAGPWR_rba_IoExtCy329_SignalVltSply_1UV" VAL_BLK 0x804E7F7C ValA_Wu16 968.000000000 DINH_FIdVerb 0.00 968.000000000 FORMAT "%13.9" NUMBER 50 /end CHARACTERISTIC
/begin CHARACTERISTIC DINH_FId.DFC_RBA_IODIAGPWR_rba_IoExtCy329_SignalVltSply_2_CA "inhibitable FIds / FIds to be inhibited by inhibit source DFC_RBA_IODIAGPWR_rba_IoExtCy329_SignalVltSply_2" VAL_BLK 0x804E7FE0 ValA_Wu16 968.000000000 DINH_FIdVerb 0.00 968.000000000 FORMAT "%13.9" NUMBER 200 /end CHARACTERISTIC
/begin CHARACTERISTIC DINH_FId.DFC_RBA_IODIAGPWR_rba_IoExtCy329_SignalVltSply_2OT_CA "inhibitable FIds / FIds to be inhibited by inhibit source DFC_RBA_IODIAGPWR_rba_IoExtCy329_SignalVltSply_2OT" VAL_BLK 0x804E8170 ValA_Wu16 968.000000000 DINH_FIdVerb 0.00 968.000000000 FORMAT "%13.9" NUMBER 50 /end CHARACTERISTIC
/begin CHARACTERISTIC DINH_FId.DFC_RBA_IODIAGPWR_rba_IoExtCy329_SignalVltSply_2OV_CA "inhibitable FIds / FIds to be inhibited by inhibit source DFC_RBA_IODIAGPWR_rba_IoExtCy329_SignalVltSply_2OV" VAL_BLK 0x804E81D4 ValA_Wu16 968.000000000 DINH_FIdVerb 0.00 968.000000000 FORMAT "%13.9" NUMBER 50 /end CHARACTERISTIC
/begin CHARACTERISTIC DINH_FId.DFC_RBA_IODIAGPWR_rba_IoExtCy329_SignalVltSply_2SCG_CA "inhibitable FIds / FIds to be inhibited by inhibit source DFC_RBA_IODIAGPWR_rba_IoExtCy329_SignalVltSply_2SCG" VAL_BLK 0x804E8238 ValA_Wu16 968.000000000 DINH_FIdVerb 0.00 968.000000000 FORMAT "%13.9" NUMBER 50 /end CHARACTERISTIC
/begin CHARACTERISTIC DINH_FId.DFC_RBA_IODIAGPWR_rba_IoExtCy329_SignalVltSply_2UV_CA "inhibitable FIds / FIds to be inhibited by inhibit source DFC_RBA_IODIAGPWR_rba_IoExtCy329_SignalVltSply_2UV" VAL_BLK 0x804E829C ValA_Wu16 968.000000000 DINH_FIdVerb 0.00 968.000000000 FORMAT "%13.9" NUMBER 50 /end CHARACTERISTIC
/begin CHARACTERISTIC DINH_FId.DFC_CAN_E_TIMEOUT_CA "inhibitable FIds / FIds to be inhibited by inhibit source DFC_CAN_E_TIMEOUT" VAL_BLK 0x804E8300 ValA_Wu16 968.000000000 DINH_FIdVerb 0.00 968.000000000 FORMAT "%13.9" NUMBER 50 /end CHARACTERISTIC
/begin CHARACTERISTIC DINH_FId.DFC_LIN_E_TIMEOUT_CA "inhibitable FIds / FIds to be inhibited by inhibit source DFC_LIN_E_TIMEOUT" VAL_BLK 0x804E8364 ValA_Wu16 968.000000000 DINH_FIdVerb 0.00 968.000000000 FORMAT "%13.9" NUMBER 50 /end CHARACTERISTIC
/begin CHARACTERISTIC DINH_FId.DFC_MRlyOL_CA "inhibitable FIds / FIds to be inhibited by inhibit source DFC_MRlyOL" VAL_BLK 0x804E83C8 ValA_Wu16 968.000000000 DINH_FIdVerb 0.00 968.000000000 FORMAT "%13.9" NUMBER 50 /end CHARACTERISTIC
/begin CHARACTERISTIC DINH_FId.DFC_MRlySCB_CA "inhibitable FIds / FIds to be inhibited by inhibit source DFC_MRlySCB" VAL_BLK 0x804E842C ValA_Wu16 968.000000000 DINH_FIdVerb 0.00 968.000000000 FORMAT "%13.9" NUMBER 50 /end CHARACTERISTIC
/begin CHARACTERISTIC DINH_FId.DFC_MRlySCG_CA "inhibitable FIds / FIds to be inhibited by inhibit source DFC_MRlySCG" VAL_BLK 0x804E8490 ValA_Wu16 968.000000000 DINH_FIdVerb 0.00 968.000000000 FORMAT "%13.9" NUMBER 51 /end CHARACTERISTIC
/begin CHARACTERISTIC DINH_FId.DFC_rba_MultiStackTrace_Threshold_CA "inhibitable FIds / FIds to be inhibited by inhibit source DFC_rba_MultiStackTrace_Threshold" VAL_BLK 0x804E84F6 ValA_Wu16 968.000000000 DINH_FIdVerb 0.00 968.000000000 FORMAT "%13.9" NUMBER 50 /end CHARACTERISTIC
/begin CHARACTERISTIC DINH_FId.DFC_BSWM_E_ACTION_FAILED_CA "inhibitable FIds / FIds to be inhibited by inhibit source DFC_BSWM_E_ACTION_FAILED" VAL_BLK 0x804E855A ValA_Wu16 968.000000000 DINH_FIdVerb 0.00 968.000000000 FORMAT "%13.9" NUMBER 50 /end CHARACTERISTIC
/begin CHARACTERISTIC DINH_FId.DFC_BSWM_E_INTRPTQUEUE_FULL_CA "inhibitable FIds / FIds to be inhibited by inhibit source DFC_BSWM_E_INTRPTQUEUE_FULL" VAL_BLK 0x804E85BE ValA_Wu16 968.000000000 DINH_FIdVerb 0.00 968.000000000 FORMAT "%13.9" NUMBER 50 /end CHARACTERISTIC
/begin CHARACTERISTIC DINH_FId.DFC_RBA_IOEXTLIB_KEEPALIVE_DRV_CA "inhibitable FIds / FIds to be inhibited by inhibit source DFC_RBA_IOEXTLIB_KEEPALIVE_DRV" VAL_BLK 0x804E8622 ValA_Wu16 968.000000000 DINH_FIdVerb 0.00 968.000000000 FORMAT "%13.9" NUMBER 51 /end CHARACTERISTIC
/begin CHARACTERISTIC DINH_FId.DFC_RBA_IOEXTLIB_KEEPALIVE_INI_CA "inhibitable FIds / FIds to be inhibited by inhibit source DFC_RBA_IOEXTLIB_KEEPALIVE_INI" VAL_BLK 0x804E8688 ValA_Wu16 968.000000000 DINH_FIdVerb 0.00 968.000000000 FORMAT "%13.9" NUMBER 51 /end CHARACTERISTIC
/begin CHARACTERISTIC DINH_FId.DFC_rba_IoSigRtc_StopCounter_CA "inhibitable FIds / FIds to be inhibited by inhibit source DFC_rba_IoSigRtc_StopCounter" VAL_BLK 0x804E86EE ValA_Wu16 968.000000000 DINH_FIdVerb 0.00 968.000000000 FORMAT "%13.9" NUMBER 57 /end CHARACTERISTIC
/begin CHARACTERISTIC DINH_FId.DFC_rba_MRly_Diag_Stk_Event_CA "inhibitable FIds / FIds to be inhibited by inhibit source DFC_rba_MRly_Diag_Stk_Event" VAL_BLK 0x804E8760 ValA_Wu16 968.000000000 DINH_FIdVerb 0.00 968.000000000 FORMAT "%13.9" NUMBER 50 /end CHARACTERISTIC
/begin CHARACTERISTIC DINH_FId.DFC_rba_MemDiag_MemReadErr_CA "inhibitable FIds / FIds to be inhibited by inhibit source DFC_rba_MemDiag_MemReadErr" VAL_BLK 0x804E87C4 ValA_Wu16 968.000000000 DINH_FIdVerb 0.00 968.000000000 FORMAT "%13.9" NUMBER 61 /end CHARACTERISTIC
/begin CHARACTERISTIC DINH_FId.DFC_rba_MemDiag_MemWrErr_CA "inhibitable FIds / FIds to be inhibited by inhibit source DFC_rba_MemDiag_MemWrErr" VAL_BLK 0x804E883E ValA_Wu16 968.000000000 DINH_FIdVerb 0.00 968.000000000 FORMAT "%13.9" NUMBER 60 /end CHARACTERISTIC
/begin CHARACTERISTIC DINH_FId.DFC_rba_SyC_IrrSwOffTrigEngRun_Event_CA "inhibitable FIds / FIds to be inhibited by inhibit source DFC_rba_SyC_IrrSwOffTrigEngRun_Event" VAL_BLK 0x804E88B6 ValA_Wu16 968.000000000 DINH_FIdVerb 0.00 968.000000000 FORMAT "%13.9" NUMBER 50 /end CHARACTERISTIC
/begin CHARACTERISTIC DINH_FId.DFC_rba_T15_Diag_ComInVld_Event_CA "inhibitable FIds / FIds to be inhibited by inhibit source DFC_rba_T15_Diag_ComInVld_Event" VAL_BLK 0x804E891A ValA_Wu16 968.000000000 DINH_FIdVerb 0.00 968.000000000 FORMAT "%13.9" NUMBER 50 /end CHARACTERISTIC
/begin CHARACTERISTIC DINH_FId.DFC_rba_T15_Diag_ComOff_HwOn_Event_CA "inhibitable FIds / FIds to be inhibited by inhibit source DFC_rba_T15_Diag_ComOff_HwOn_Event" VAL_BLK 0x804E897E ValA_Wu16 968.000000000 DINH_FIdVerb 0.00 968.000000000 FORMAT "%13.9" NUMBER 50 /end CHARACTERISTIC
/begin CHARACTERISTIC DINH_FId.DFC_rba_T15_Diag_ComOn_HwOff_Event_CA "inhibitable FIds / FIds to be inhibited by inhibit source DFC_rba_T15_Diag_ComOn_HwOff_Event" VAL_BLK 0x804E89E2 ValA_Wu16 968.000000000 DINH_FIdVerb 0.00 968.000000000 FORMAT "%13.9" NUMBER 50 /end CHARACTERISTIC
/begin CHARACTERISTIC DINH_FId.DFC_AAVmin_CA "inhibitable FIds / FIds to be inhibited by inhibit source DFC_AAVmin" VAL_BLK 0x804E8A46 ValA_Wu16 968.000000000 DINH_FIdVerb 0.00 968.000000000 FORMAT "%13.9" NUMBER 55 /end CHARACTERISTIC
/begin CHARACTERISTIC DINH_FId.DFC_AGRSUS_CA "inhibitable FIds / FIds to be inhibited by inhibit source DFC_AGRSUS" VAL_BLK 0x804E8AB4 ValA_Wu16 968.000000000 DINH_FIdVerb 0.00 968.000000000 FORMAT "%13.9" NUMBER 72 /end CHARACTERISTIC
/begin CHARACTERISTIC DINH_FId.DFC_AfsPlausDiagHi_CA "inhibitable FIds / FIds to be inhibited by inhibit source DFC_AfsPlausDiagHi" VAL_BLK 0x804E8B44 ValA_Wu16 968.000000000 DINH_FIdVerb 0.00 968.000000000 FORMAT "%13.9" NUMBER 54 /end CHARACTERISTIC
/begin CHARACTERISTIC DINH_FId.DFC_AfsPlausDiagLo_CA "inhibitable FIds / FIds to be inhibited by inhibit source DFC_AfsPlausDiagLo" VAL_BLK 0x804E8BB0 ValA_Wu16 968.000000000 DINH_FIdVerb 0.00 968.000000000 FORMAT "%13.9" NUMBER 54 /end CHARACTERISTIC
/begin CHARACTERISTIC DINH_FId.DFC_AfsVrntDiagErrB1_CA "inhibitable FIds / FIds to be inhibited by inhibit source DFC_AfsVrntDiagErrB1" VAL_BLK 0x804E8C1C ValA_Wu16 968.000000000 DINH_FIdVerb 0.00 968.000000000 FORMAT "%13.9" NUMBER 54 /end CHARACTERISTIC
/begin CHARACTERISTIC DINH_FId.DFC_AppAllSnsrDfct_CA "inhibitable FIds / FIds to be inhibited by inhibit source DFC_AppAllSnsrDfct" VAL_BLK 0x804E8C88 ValA_Wu16 968.000000000 DINH_FIdVerb 0.00 968.000000000 FORMAT "%13.9" NUMBER 51 /end CHARACTERISTIC
/begin CHARACTERISTIC DINH_FId.DFC_BBKRnldg_CA "inhibitable FIds / FIds to be inhibited by inhibit source DFC_BBKRnldg" VAL_BLK 0x804E8CEE ValA_Wu16 968.000000000 DINH_FIdVerb 0.00 968.000000000 FORMAT "%13.9" NUMBER 52 /end CHARACTERISTIC
/begin CHARACTERISTIC DINH_FId.DFC_BBKRsyne_CA "inhibitable FIds / FIds to be inhibited by inhibit source DFC_BBKRsyne" VAL_BLK 0x804E8D56 ValA_Wu16 968.000000000 DINH_FIdVerb 0.00 968.000000000 FORMAT "%13.9" NUMBER 52 /end CHARACTERISTIC
/begin CHARACTERISTIC DINH_FId.DFC_BattUStdbyDiaOL_CA "inhibitable FIds / FIds to be inhibited by inhibit source DFC_BattUStdbyDiaOL" VAL_BLK 0x804E8DBE ValA_Wu16 968.000000000 DINH_FIdVerb 0.00 968.000000000 FORMAT "%13.9" NUMBER 50 /end CHARACTERISTIC
/begin CHARACTERISTIC DINH_FId.DFC_BigLeakIntkMnfldEmiInfl_CA "inhibitable FIds / FIds to be inhibited by inhibit source DFC_BigLeakIntkMnfldEmiInfl" VAL_BLK 0x804E8E22 ValA_Wu16 968.000000000 DINH_FIdVerb 0.00 968.000000000 FORMAT "%13.9" NUMBER 54 /end CHARACTERISTIC
/begin CHARACTERISTIC DINH_FId.DFC_BlkdLineTank_CA "inhibitable FIds / FIds to be inhibited by inhibit source DFC_BlkdLineTank" VAL_BLK 0x804E8E8E ValA_Wu16 968.000000000 DINH_FIdVerb 0.00 968.000000000 FORMAT "%13.9" NUMBER 52 /end CHARACTERISTIC
/begin CHARACTERISTIC DINH_FId.DFC_BrkMnSwtContOnWarnLmp_CA "inhibitable FIds / FIds to be inhibited by inhibit source DFC_BrkMnSwtContOnWarnLmp" VAL_BLK 0x804E8EF6 ValA_Wu16 968.000000000 DINH_FIdVerb 0.00 968.000000000 FORMAT "%13.9" NUMBER 50 /end CHARACTERISTIC
/begin CHARACTERISTIC DINH_FId.DFC_BrkMnSwtNotStpWarnLmp_CA "inhibitable FIds / FIds to be inhibited by inhibit source DFC_BrkMnSwtNotStpWarnLmp" VAL_BLK 0x804E8F5A ValA_Wu16 968.000000000 DINH_FIdVerb 0.00 968.000000000 FORMAT "%13.9" NUMBER 50 /end CHARACTERISTIC
/begin CHARACTERISTIC DINH_FId.DFC_BrkRdntSwtContOnWarnLmp_CA "inhibitable FIds / FIds to be inhibited by inhibit source DFC_BrkRdntSwtContOnWarnLmp" VAL_BLK 0x804E8FBE ValA_Wu16 968.000000000 DINH_FIdVerb 0.00 968.000000000 FORMAT "%13.9" NUMBER 50 /end CHARACTERISTIC
/begin CHARACTERISTIC DINH_FId.DFC_BrkRdntSwtNotStpWarnLmp_CA "inhibitable FIds / FIds to be inhibited by inhibit source DFC_BrkRdntSwtNotStpWarnLmp" VAL_BLK 0x804E9022 ValA_Wu16 968.000000000 DINH_FIdVerb 0.00 968.000000000 FORMAT "%13.9" NUMBER 50 /end CHARACTERISTIC
/begin CHARACTERISTIC DINH_FId.DFC_CEngDsTColdStrtMax_CA "inhibitable FIds / FIds to be inhibited by inhibit source DFC_CEngDsTColdStrtMax" VAL_BLK 0x804E9086 ValA_Wu16 968.000000000 DINH_FIdVerb 0.00 968.000000000 FORMAT "%13.9" NUMBER 122 /end CHARACTERISTIC
/begin CHARACTERISTIC DINH_FId.DFC_CEngDsTColdStrtMin_CA "inhibitable FIds / FIds to be inhibited by inhibit source DFC_CEngDsTColdStrtMin" VAL_BLK 0x804E917A ValA_Wu16 968.000000000 DINH_FIdVerb 0.00 968.000000000 FORMAT "%13.9" NUMBER 122 /end CHARACTERISTIC
/begin CHARACTERISTIC DINH_FId.DFC_CEngDsTImps_CA "inhibitable FIds / FIds to be inhibited by inhibit source DFC_CEngDsTImps" VAL_BLK 0x804E926E ValA_Wu16 968.000000000 DINH_FIdVerb 0.00 968.000000000 FORMAT "%13.9" NUMBER 125 /end CHARACTERISTIC
/begin CHARACTERISTIC DINH_FId.DFC_CEngDsTPlausHSC_CA "inhibitable FIds / FIds to be inhibited by inhibit source DFC_CEngDsTPlausHSC" VAL_BLK 0x804E9368 ValA_Wu16 968.000000000 DINH_FIdVerb 0.00 968.000000000 FORMAT "%13.9" NUMBER 121 /end CHARACTERISTIC
/begin CHARACTERISTIC DINH_FId.DFC_CEngDsTPlausLSC_CA "inhibitable FIds / FIds to be inhibited by inhibit source DFC_CEngDsTPlausLSC" VAL_BLK 0x804E945A ValA_Wu16 968.000000000 DINH_FIdVerb 0.00 968.000000000 FORMAT "%13.9" NUMBER 122 /end CHARACTERISTIC
/begin CHARACTERISTIC DINH_FId.DFC_CEngDsTPlausSTC_CA "inhibitable FIds / FIds to be inhibited by inhibit source DFC_CEngDsTPlausSTC" VAL_BLK 0x804E954E ValA_Wu16 968.000000000 DINH_FIdVerb 0.00 968.000000000 FORMAT "%13.9" NUMBER 121 /end CHARACTERISTIC
/begin CHARACTERISTIC DINH_FId.DFC_CEngDsTSRCMax_CA "inhibitable FIds / FIds to be inhibited by inhibit source DFC_CEngDsTSRCMax" VAL_BLK 0x804E9640 ValA_Wu16 968.000000000 DINH_FIdVerb 0.00 968.000000000 FORMAT "%13.9" NUMBER 135 /end CHARACTERISTIC
/begin CHARACTERISTIC DINH_FId.DFC_CEngDsTSRCMin_CA "inhibitable FIds / FIds to be inhibited by inhibit source DFC_CEngDsTSRCMin" VAL_BLK 0x804E974E ValA_Wu16 968.000000000 DINH_FIdVerb 0.00 968.000000000 FORMAT "%13.9" NUMBER 135 /end CHARACTERISTIC
/begin CHARACTERISTIC DINH_FId.DFC_CEngDsTSig_CA "inhibitable FIds / FIds to be inhibited by inhibit source DFC_CEngDsTSig" VAL_BLK 0x804E985C ValA_Wu16 968.000000000 DINH_FIdVerb 0.00 968.000000000 FORMAT "%13.9" NUMBER 123 /end CHARACTERISTIC
/begin CHARACTERISTIC DINH_FId.DFC_CEngUsTColdStrtMax_CA "inhibitable FIds / FIds to be inhibited by inhibit source DFC_CEngUsTColdStrtMax" VAL_BLK 0x804E9952 ValA_Wu16 968.000000000 DINH_FIdVerb 0.00 968.000000000 FORMAT "%13.9" NUMBER 53 /end CHARACTERISTIC
/begin CHARACTERISTIC DINH_FId.DFC_CEngUsTColdStrtMin_CA "inhibitable FIds / FIds to be inhibited by inhibit source DFC_CEngUsTColdStrtMin" VAL_BLK 0x804E99BC ValA_Wu16 968.000000000 DINH_FIdVerb 0.00 968.000000000 FORMAT "%13.9" NUMBER 53 /end CHARACTERISTIC
/begin CHARACTERISTIC DINH_FId.DFC_CEngUsTLooseCnctn_CA "inhibitable FIds / FIds to be inhibited by inhibit source DFC_CEngUsTLooseCnctn" VAL_BLK 0x804E9A26 ValA_Wu16 968.000000000 DINH_FIdVerb 0.00 968.000000000 FORMAT "%13.9" NUMBER 55 /end CHARACTERISTIC
/begin CHARACTERISTIC DINH_FId.DFC_CEngUsTSRCMax_CA "inhibitable FIds / FIds to be inhibited by inhibit source DFC_CEngUsTSRCMax" VAL_BLK 0x804E9A94 ValA_Wu16 968.000000000 DINH_FIdVerb 0.00 968.000000000 FORMAT "%13.9" NUMBER 58 /end CHARACTERISTIC
/begin CHARACTERISTIC DINH_FId.DFC_CEngUsTSRCMin_CA "inhibitable FIds / FIds to be inhibited by inhibit source DFC_CEngUsTSRCMin" VAL_BLK 0x804E9B08 ValA_Wu16 968.000000000 DINH_FIdVerb 0.00 968.000000000 FORMAT "%13.9" NUMBER 58 /end CHARACTERISTIC
/begin CHARACTERISTIC DINH_FId.DFC_ComDCDCACCFailr_CA "inhibitable FIds / FIds to be inhibited by inhibit source DFC_ComDCDCACCFailr" VAL_BLK 0x804E9B7C ValA_Wu16 968.000000000 DINH_FIdVerb 0.00 968.000000000 FORMAT "%13.9" NUMBER 57 /end CHARACTERISTIC
/begin CHARACTERISTIC DINH_FId.DFC_DCDCFltDet_CA "inhibitable FIds / FIds to be inhibited by inhibit source DFC_DCDCFltDet" VAL_BLK 0x804E9BEE ValA_Wu16 968.000000000 DINH_FIdVerb 0.00 968.000000000 FORMAT "%13.9" NUMBER 57 /end CHARACTERISTIC
/begin CHARACTERISTIC DINH_FId.DFC_DKRSA_CA "inhibitable FIds / FIds to be inhibited by inhibit source DFC_DKRSA" VAL_BLK 0x804E9C60 ValA_Wu16 968.000000000 DINH_FIdVerb 0.00 968.000000000 FORMAT "%13.9" NUMBER 58 /end CHARACTERISTIC
/begin CHARACTERISTIC DINH_FId.DFC_DKVSmax_CA "inhibitable FIds / FIds to be inhibited by inhibit source DFC_DKVSmax" VAL_BLK 0x804E9CD4 ValA_Wu16 968.000000000 DINH_FIdVerb 0.00 968.000000000 FORMAT "%13.9" NUMBER 50 /end CHARACTERISTIC
/begin CHARACTERISTIC DINH_FId.DFC_DKnpl_CA "inhibitable FIds / FIds to be inhibited by inhibit source DFC_DKnpl" VAL_BLK 0x804E9D38 ValA_Wu16 968.000000000 DINH_FIdVerb 0.00 968.000000000 FORMAT "%13.9" NUMBER 50 /end CHARACTERISTIC
/begin CHARACTERISTIC DINH_FId.DFC_DSKVRmax_CA "inhibitable FIds / FIds to be inhibited by inhibit source DFC_DSKVRmax" VAL_BLK 0x804E9D9C ValA_Wu16 968.000000000 DINH_FIdVerb 0.00 968.000000000 FORMAT "%13.9" NUMBER 66 /end CHARACTERISTIC
/begin CHARACTERISTIC DINH_FId.DFC_DSKVRmin_CA "inhibitable FIds / FIds to be inhibited by inhibit source DFC_DSKVRmin" VAL_BLK 0x804E9E20 ValA_Wu16 968.000000000 DINH_FIdVerb 0.00 968.000000000 FORMAT "%13.9" NUMBER 66 /end CHARACTERISTIC
/begin CHARACTERISTIC DINH_FId.DFC_DSKVRnpl_CA "inhibitable FIds / FIds to be inhibited by inhibit source DFC_DSKVRnpl" VAL_BLK 0x804E9EA4 ValA_Wu16 968.000000000 DINH_FIdVerb 0.00 968.000000000 FORMAT "%13.9" NUMBER 62 /end CHARACTERISTIC
/begin CHARACTERISTIC DINH_FId.DFC_DSKVRsig_CA "inhibitable FIds / FIds to be inhibited by inhibit source DFC_DSKVRsig" VAL_BLK 0x804E9F20 ValA_Wu16 968.000000000 DINH_FIdVerb 0.00 968.000000000 FORMAT "%13.9" NUMBER 62 /end CHARACTERISTIC
/begin CHARACTERISTIC DINH_FId.DFC_DSKVSsig_CA "inhibitable FIds / FIds to be inhibited by inhibit source DFC_DSKVSsig" VAL_BLK 0x804E9F9C ValA_Wu16 968.000000000 DINH_FIdVerb 0.00 968.000000000 FORMAT "%13.9" NUMBER 64 /end CHARACTERISTIC
/begin CHARACTERISTIC DINH_FId.DFC_DSSmax_CA "inhibitable FIds / FIds to be inhibited by inhibit source DFC_DSSmax" VAL_BLK 0x804EA01C ValA_Wu16 968.000000000 DINH_FIdVerb 0.00 968.000000000 FORMAT "%13.9" NUMBER 50 /end CHARACTERISTIC
/begin CHARACTERISTIC DINH_FId.DFC_DSTDmax_CA "inhibitable FIds / FIds to be inhibited by inhibit source DFC_DSTDmax" VAL_BLK 0x804EA080 ValA_Wu16 968.000000000 DINH_FIdVerb 0.00 968.000000000 FORMAT "%13.9" NUMBER 50 /end CHARACTERISTIC
/begin CHARACTERISTIC DINH_FId.DFC_DSTEmax_CA "inhibitable FIds / FIds to be inhibited by inhibit source DFC_DSTEmax" VAL_BLK 0x804EA0E4 ValA_Wu16 968.000000000 DINH_FIdVerb 0.00 968.000000000 FORMAT "%13.9" NUMBER 59 /end CHARACTERISTIC
/begin CHARACTERISTIC DINH_FId.DFC_DSTEmin_CA "inhibitable FIds / FIds to be inhibited by inhibit source DFC_DSTEmin" VAL_BLK 0x804EA15A ValA_Wu16 968.000000000 DINH_FIdVerb 0.00 968.000000000 FORMAT "%13.9" NUMBER 59 /end CHARACTERISTIC
/begin CHARACTERISTIC DINH_FId.DFC_DSTOFmax_CA "inhibitable FIds / FIds to be inhibited by inhibit source DFC_DSTOFmax" VAL_BLK 0x804EA1D0 ValA_Wu16 968.000000000 DINH_FIdVerb 0.00 968.000000000 FORMAT "%13.9" NUMBER 56 /end CHARACTERISTIC
/begin CHARACTERISTIC DINH_FId.DFC_DSTRmax_CA "inhibitable FIds / FIds to be inhibited by inhibit source DFC_DSTRmax" VAL_BLK 0x804EA240 ValA_Wu16 968.000000000 DINH_FIdVerb 0.00 968.000000000 FORMAT "%13.9" NUMBER 57 /end CHARACTERISTIC
/begin CHARACTERISTIC DINH_FId.DFC_DSTRmin_CA "inhibitable FIds / FIds to be inhibited by inhibit source DFC_DSTRmin" VAL_BLK 0x804EA2B2 ValA_Wu16 968.000000000 DINH_FIdVerb 0.00 968.000000000 FORMAT "%13.9" NUMBER 57 /end CHARACTERISTIC
/begin CHARACTERISTIC DINH_FId.DFC_DSTRnpl_CA "inhibitable FIds / FIds to be inhibited by inhibit source DFC_DSTRnpl" VAL_BLK 0x804EA324 ValA_Wu16 968.000000000 DINH_FIdVerb 0.00 968.000000000 FORMAT "%13.9" NUMBER 56 /end CHARACTERISTIC
/begin CHARACTERISTIC DINH_FId.DFC_DSTRsig_CA "inhibitable FIds / FIds to be inhibited by inhibit source DFC_DSTRsig" VAL_BLK 0x804EA394 ValA_Wu16 968.000000000 DINH_FIdVerb 0.00 968.000000000 FORMAT "%13.9" NUMBER 56 /end CHARACTERISTIC
/begin CHARACTERISTIC DINH_FId.DFC_DSTTI_CA "inhibitable FIds / FIds to be inhibited by inhibit source DFC_DSTTI" VAL_BLK 0x804EA404 ValA_Wu16 968.000000000 DINH_FIdVerb 0.00 968.000000000 FORMAT "%13.9" NUMBER 51 /end CHARACTERISTIC
/begin CHARACTERISTIC DINH_FId.DFC_DSUmax_CA "inhibitable FIds / FIds to be inhibited by inhibit source DFC_DSUmax" VAL_BLK 0x804EA46A ValA_Wu16 968.000000000 DINH_FIdVerb 0.00 968.000000000 FORMAT "%13.9" NUMBER 50 /end CHARACTERISTIC
/begin CHARACTERISTIC DINH_FId.DFC_DiagCpv1DteskLoLoadStuckClsd_CA "inhibitable FIds / FIds to be inhibited by inhibit source DFC_DiagCpv1DteskLoLoadStuckClsd" VAL_BLK 0x804EA4CE ValA_Wu16 968.000000000 DINH_FIdVerb 0.00 968.000000000 FORMAT "%13.9" NUMBER 71 /end CHARACTERISTIC
/begin CHARACTERISTIC DINH_FId.DFC_DiagCpv1DteskLoLoadStuckOpen_CA "inhibitable FIds / FIds to be inhibited by inhibit source DFC_DiagCpv1DteskLoLoadStuckOpen" VAL_BLK 0x804EA55C ValA_Wu16 968.000000000 DINH_FIdVerb 0.00 968.000000000 FORMAT "%13.9" NUMBER 80 /end CHARACTERISTIC
/begin CHARACTERISTIC DINH_FId.DFC_EGRVlvDrftClsd_CA "inhibitable FIds / FIds to be inhibited by inhibit source DFC_EGRVlvDrftClsd" VAL_BLK 0x804EA5FC ValA_Wu16 968.000000000 DINH_FIdVerb 0.00 968.000000000 FORMAT "%13.9" NUMBER 51 /end CHARACTERISTIC
/begin CHARACTERISTIC DINH_FId.DFC_EGRVlvDrftOpn_CA "inhibitable FIds / FIds to be inhibited by inhibit source DFC_EGRVlvDrftOpn" VAL_BLK 0x804EA662 ValA_Wu16 968.000000000 DINH_FIdVerb 0.00 968.000000000 FORMAT "%13.9" NUMBER 50 /end CHARACTERISTIC
/begin CHARACTERISTIC DINH_FId.DFC_EGRVlvJamVlvClsd_CA "inhibitable FIds / FIds to be inhibited by inhibit source DFC_EGRVlvJamVlvClsd" VAL_BLK 0x804EA6C6 ValA_Wu16 968.000000000 DINH_FIdVerb 0.00 968.000000000 FORMAT "%13.9" NUMBER 53 /end CHARACTERISTIC
/begin CHARACTERISTIC DINH_FId.DFC_EGRVlvJamVlvOpn_CA "inhibitable FIds / FIds to be inhibited by inhibit source DFC_EGRVlvJamVlvOpn" VAL_BLK 0x804EA730 ValA_Wu16 968.000000000 DINH_FIdVerb 0.00 968.000000000 FORMAT "%13.9" NUMBER 53 /end CHARACTERISTIC
/begin CHARACTERISTIC DINH_FId.DFC_EGRVlvSprgBrk_CA "inhibitable FIds / FIds to be inhibited by inhibit source DFC_EGRVlvSprgBrk" VAL_BLK 0x804EA79A ValA_Wu16 968.000000000 DINH_FIdVerb 0.00 968.000000000 FORMAT "%13.9" NUMBER 50 /end CHARACTERISTIC
/begin CHARACTERISTIC DINH_FId.DFC_EGRVlvTempMdlEEPErr_CA "inhibitable FIds / FIds to be inhibited by inhibit source DFC_EGRVlvTempMdlEEPErr" VAL_BLK 0x804EA7FE ValA_Wu16 968.000000000 DINH_FIdVerb 0.00 968.000000000 FORMAT "%13.9" NUMBER 51 /end CHARACTERISTIC
/begin CHARACTERISTIC DINH_FId.DFC_EGRVlvTmpErr_CA "inhibitable FIds / FIds to be inhibited by inhibit source DFC_EGRVlvTmpErr" VAL_BLK 0x804EA864 ValA_Wu16 968.000000000 DINH_FIdVerb 0.00 968.000000000 FORMAT "%13.9" NUMBER 50 /end CHARACTERISTIC
/begin CHARACTERISTIC DINH_FId.DFC_EGSDUS2B1LtrDly_CA "inhibitable FIds / FIds to be inhibited by inhibit source DFC_EGSDUS2B1LtrDly" VAL_BLK 0x804EA8C8 ValA_Wu16 968.000000000 DINH_FIdVerb 0.00 968.000000000 FORMAT "%13.9" NUMBER 58 /end CHARACTERISTIC
/begin CHARACTERISTIC DINH_FId.DFC_EGSDUS2B1LtrPT1_CA "inhibitable FIds / FIds to be inhibited by inhibit source DFC_EGSDUS2B1LtrPT1" VAL_BLK 0x804EA93C ValA_Wu16 968.000000000 DINH_FIdVerb 0.00 968.000000000 FORMAT "%13.9" NUMBER 58 /end CHARACTERISTIC
/begin CHARACTERISTIC DINH_FId.DFC_EGSDUS2B1RtlDly_CA "inhibitable FIds / FIds to be inhibited by inhibit source DFC_EGSDUS2B1RtlDly" VAL_BLK 0x804EA9B0 ValA_Wu16 968.000000000 DINH_FIdVerb 0.00 968.000000000 FORMAT "%13.9" NUMBER 58 /end CHARACTERISTIC
/begin CHARACTERISTIC DINH_FId.DFC_EGSDUS2B1RtlPT1_CA "inhibitable FIds / FIds to be inhibited by inhibit source DFC_EGSDUS2B1RtlPT1" VAL_BLK 0x804EAA24 ValA_Wu16 968.000000000 DINH_FIdVerb 0.00 968.000000000 FORMAT "%13.9" NUMBER 58 /end CHARACTERISTIC
/begin CHARACTERISTIC DINH_FId.DFC_EGSDUS2B1TarLean_CA "inhibitable FIds / FIds to be inhibited by inhibit source DFC_EGSDUS2B1TarLean" VAL_BLK 0x804EAA98 ValA_Wu16 968.000000000 DINH_FIdVerb 0.00 968.000000000 FORMAT "%13.9" NUMBER 69 /end CHARACTERISTIC
/begin CHARACTERISTIC DINH_FId.DFC_EGSDUS2B1TarRich_CA "inhibitable FIds / FIds to be inhibited by inhibit source DFC_EGSDUS2B1TarRich" VAL_BLK 0x804EAB22 ValA_Wu16 968.000000000 DINH_FIdVerb 0.00 968.000000000 FORMAT "%13.9" NUMBER 69 /end CHARACTERISTIC
/begin CHARACTERISTIC DINH_FId.DFC_EONVmax_CA "inhibitable FIds / FIds to be inhibited by inhibit source DFC_EONVmax" VAL_BLK 0x804EABAC ValA_Wu16 968.000000000 DINH_FIdVerb 0.00 968.000000000 FORMAT "%13.9" NUMBER 50 /end CHARACTERISTIC
/begin CHARACTERISTIC DINH_FId.DFC_ETAKHLmax_CA "inhibitable FIds / FIds to be inhibited by inhibit source DFC_ETAKHLmax" VAL_BLK 0x804EAC10 ValA_Wu16 968.000000000 DINH_FIdVerb 0.00 968.000000000 FORMAT "%13.9" NUMBER 50 /end CHARACTERISTIC
/begin CHARACTERISTIC DINH_FId.DFC_ETAKHTmax_CA "inhibitable FIds / FIds to be inhibited by inhibit source DFC_ETAKHTmax" VAL_BLK 0x804EAC74 ValA_Wu16 968.000000000 DINH_FIdVerb 0.00 968.000000000 FORMAT "%13.9" NUMBER 50 /end CHARACTERISTIC
/begin CHARACTERISTIC DINH_FId.DFC_ETHSEmax_CA "inhibitable FIds / FIds to be inhibited by inhibit source DFC_ETHSEmax" VAL_BLK 0x804EACD8 ValA_Wu16 968.000000000 DINH_FIdVerb 0.00 968.000000000 FORMAT "%13.9" NUMBER 70 /end CHARACTERISTIC
/begin CHARACTERISTIC DINH_FId.DFC_ETHSEmin_CA "inhibitable FIds / FIds to be inhibited by inhibit source DFC_ETHSEmin" VAL_BLK 0x804EAD64 ValA_Wu16 968.000000000 DINH_FIdVerb 0.00 968.000000000 FORMAT "%13.9" NUMBER 70 /end CHARACTERISTIC
/begin CHARACTERISTIC DINH_FId.DFC_ETHSFmax_CA "inhibitable FIds / FIds to be inhibited by inhibit source DFC_ETHSFmax" VAL_BLK 0x804EADF0 ValA_Wu16 968.000000000 DINH_FIdVerb 0.00 968.000000000 FORMAT "%13.9" NUMBER 70 /end CHARACTERISTIC
/begin CHARACTERISTIC DINH_FId.DFC_ETHSFmin_CA "inhibitable FIds / FIds to be inhibited by inhibit source DFC_ETHSFmin" VAL_BLK 0x804EAE7C ValA_Wu16 968.000000000 DINH_FIdVerb 0.00 968.000000000 FORMAT "%13.9" NUMBER 70 /end CHARACTERISTIC
/begin CHARACTERISTIC DINH_FId.DFC_ETHSFsig_CA "inhibitable FIds / FIds to be inhibited by inhibit source DFC_ETHSFsig" VAL_BLK 0x804EAF08 ValA_Wu16 968.000000000 DINH_FIdVerb 0.00 968.000000000 FORMAT "%13.9" NUMBER 70 /end CHARACTERISTIC
/begin CHARACTERISTIC DINH_FId.DFC_ETHSNPWmax_CA "inhibitable FIds / FIds to be inhibited by inhibit source DFC_ETHSNPWmax" VAL_BLK 0x804EAF94 ValA_Wu16 968.000000000 DINH_FIdVerb 0.00 968.000000000 FORMAT "%13.9" NUMBER 68 /end CHARACTERISTIC
/begin CHARACTERISTIC DINH_FId.DFC_ETHSNPWmin_CA "inhibitable FIds / FIds to be inhibited by inhibit source DFC_ETHSNPWmin" VAL_BLK 0x804EB01C ValA_Wu16 968.000000000 DINH_FIdVerb 0.00 968.000000000 FORMAT "%13.9" NUMBER 68 /end CHARACTERISTIC
/begin CHARACTERISTIC DINH_FId.DFC_ETHSNPWsig_CA "inhibitable FIds / FIds to be inhibited by inhibit source DFC_ETHSNPWsig" VAL_BLK 0x804EB0A4 ValA_Wu16 968.000000000 DINH_FIdVerb 0.00 968.000000000 FORMAT "%13.9" NUMBER 68 /end CHARACTERISTIC
/begin CHARACTERISTIC DINH_FId.DFC_ETHSPLnpl_CA "inhibitable FIds / FIds to be inhibited by inhibit source DFC_ETHSPLnpl" VAL_BLK 0x804EB12C ValA_Wu16 968.000000000 DINH_FIdVerb 0.00 968.000000000 FORMAT "%13.9" NUMBER 66 /end CHARACTERISTIC
/begin CHARACTERISTIC DINH_FId.DFC_ETHSTPLnpl_CA "inhibitable FIds / FIds to be inhibited by inhibit source DFC_ETHSTPLnpl" VAL_BLK 0x804EB1B0 ValA_Wu16 968.000000000 DINH_FIdVerb 0.00 968.000000000 FORMAT "%13.9" NUMBER 68 /end CHARACTERISTIC
/begin CHARACTERISTIC DINH_FId.DFC_EngICO_CA "inhibitable FIds / FIds to be inhibited by inhibit source DFC_EngICO" VAL_BLK 0x804EB238 ValA_Wu16 968.000000000 DINH_FIdVerb 0.00 968.000000000 FORMAT "%13.9" NUMBER 50 /end CHARACTERISTIC
/begin CHARACTERISTIC DINH_FId.DFC_EngPrtOvrSpdMon_CA "inhibitable FIds / FIds to be inhibited by inhibit source DFC_EngPrtOvrSpdMon" VAL_BLK 0x804EB29C ValA_Wu16 968.000000000 DINH_FIdVerb 0.00 968.000000000 FORMAT "%13.9" NUMBER 50 /end CHARACTERISTIC
/begin CHARACTERISTIC DINH_FId.DFC_EpmCaSI1ErrSig_CA "inhibitable FIds / FIds to be inhibited by inhibit source DFC_EpmCaSI1ErrSig" VAL_BLK 0x804EB300 ValA_Wu16 968.000000000 DINH_FIdVerb 0.00 968.000000000 FORMAT "%13.9" NUMBER 72 /end CHARACTERISTIC
/begin CHARACTERISTIC DINH_FId.DFC_EpmCaSI1MntErr_CA "inhibitable FIds / FIds to be inhibited by inhibit source DFC_EpmCaSI1MntErr" VAL_BLK 0x804EB390 ValA_Wu16 968.000000000 DINH_FIdVerb 0.00 968.000000000 FORMAT "%13.9" NUMBER 74 /end CHARACTERISTIC
/begin CHARACTERISTIC DINH_FId.DFC_EpmCaSI1NoSigMax_CA "inhibitable FIds / FIds to be inhibited by inhibit source DFC_EpmCaSI1NoSigMax" VAL_BLK 0x804EB424 ValA_Wu16 968.000000000 DINH_FIdVerb 0.00 968.000000000 FORMAT "%13.9" NUMBER 72 /end CHARACTERISTIC
/begin CHARACTERISTIC DINH_FId.DFC_EpmCaSI1NoSigMin_CA "inhibitable FIds / FIds to be inhibited by inhibit source DFC_EpmCaSI1NoSigMin" VAL_BLK 0x804EB4B4 ValA_Wu16 968.000000000 DINH_FIdVerb 0.00 968.000000000 FORMAT "%13.9" NUMBER 72 /end CHARACTERISTIC
/begin CHARACTERISTIC DINH_FId.DFC_EpmCaSI1OfsErr_CA "inhibitable FIds / FIds to be inhibited by inhibit source DFC_EpmCaSI1OfsErr" VAL_BLK 0x804EB544 ValA_Wu16 968.000000000 DINH_FIdVerb 0.00 968.000000000 FORMAT "%13.9" NUMBER 80 /end CHARACTERISTIC
/begin CHARACTERISTIC DINH_FId.DFC_EpmCrSDGI_CA "inhibitable FIds / FIds to be inhibited by inhibit source DFC_EpmCrSDGI" VAL_BLK 0x804EB5E4 ValA_Wu16 968.000000000 DINH_FIdVerb 0.00 968.000000000 FORMAT "%13.9" NUMBER 61 /end CHARACTERISTIC
/begin CHARACTERISTIC DINH_FId.DFC_EpmCrSErrSig_CA "inhibitable FIds / FIds to be inhibited by inhibit source DFC_EpmCrSErrSig" VAL_BLK 0x804EB65E ValA_Wu16 968.000000000 DINH_FIdVerb 0.00 968.000000000 FORMAT "%13.9" NUMBER 101 /end CHARACTERISTIC
/begin CHARACTERISTIC DINH_FId.DFC_EpmCrSNoSig_CA "inhibitable FIds / FIds to be inhibited by inhibit source DFC_EpmCrSNoSig" VAL_BLK 0x804EB728 ValA_Wu16 968.000000000 DINH_FIdVerb 0.00 968.000000000 FORMAT "%13.9" NUMBER 114 /end CHARACTERISTIC
/begin CHARACTERISTIC DINH_FId.DFC_EtaEngIdleNonCsers_CA "inhibitable FIds / FIds to be inhibited by inhibit source DFC_EtaEngIdleNonCsers" VAL_BLK 0x804EB80C ValA_Wu16 968.000000000 DINH_FIdVerb 0.00 968.000000000 FORMAT "%13.9" NUMBER 50 /end CHARACTERISTIC
/begin CHARACTERISTIC DINH_FId.DFC_EtaEngPtlNonCsers_CA "inhibitable FIds / FIds to be inhibited by inhibit source DFC_EtaEngPtlNonCsers" VAL_BLK 0x804EB870 ValA_Wu16 968.000000000 DINH_FIdVerb 0.00 968.000000000 FORMAT "%13.9" NUMBER 50 /end CHARACTERISTIC
/begin CHARACTERISTIC DINH_FId.DFC_FRAmax_CA "inhibitable FIds / FIds to be inhibited by inhibit source DFC_FRAmax" VAL_BLK 0x804EB8D4 ValA_Wu16 968.000000000 DINH_FIdVerb 0.00 968.000000000 FORMAT "%13.9" NUMBER 73 /end CHARACTERISTIC
/begin CHARACTERISTIC DINH_FId.DFC_FRAmin_CA "inhibitable FIds / FIds to be inhibited by inhibit source DFC_FRAmin" VAL_BLK 0x804EB966 ValA_Wu16 968.000000000 DINH_FIdVerb 0.00 968.000000000 FORMAT "%13.9" NUMBER 73 /end CHARACTERISTIC
/begin CHARACTERISTIC DINH_FId.DFC_FSTEmax_CA "inhibitable FIds / FIds to be inhibited by inhibit source DFC_FSTEmax" VAL_BLK 0x804EB9F8 ValA_Wu16 968.000000000 DINH_FIdVerb 0.00 968.000000000 FORMAT "%13.9" NUMBER 54 /end CHARACTERISTIC
/begin CHARACTERISTIC DINH_FId.DFC_FSTEmin_CA "inhibitable FIds / FIds to be inhibited by inhibit source DFC_FSTEmin" VAL_BLK 0x804EBA64 ValA_Wu16 968.000000000 DINH_FIdVerb 0.00 968.000000000 FORMAT "%13.9" NUMBER 54 /end CHARACTERISTIC
/begin CHARACTERISTIC DINH_FId.DFC_FSTRmax_CA "inhibitable FIds / FIds to be inhibited by inhibit source DFC_FSTRmax" VAL_BLK 0x804EBAD0 ValA_Wu16 968.000000000 DINH_FIdVerb 0.00 968.000000000 FORMAT "%13.9" NUMBER 53 /end CHARACTERISTIC
/begin CHARACTERISTIC DINH_FId.DFC_FSTRmin_CA "inhibitable FIds / FIds to be inhibited by inhibit source DFC_FSTRmin" VAL_BLK 0x804EBB3A ValA_Wu16 968.000000000 DINH_FIdVerb 0.00 968.000000000 FORMAT "%13.9" NUMBER 53 /end CHARACTERISTIC
/begin CHARACTERISTIC DINH_FId.DFC_FSTRnpl_CA "inhibitable FIds / FIds to be inhibited by inhibit source DFC_FSTRnpl" VAL_BLK 0x804EBBA4 ValA_Wu16 968.000000000 DINH_FIdVerb 0.00 968.000000000 FORMAT "%13.9" NUMBER 53 /end CHARACTERISTIC
/begin CHARACTERISTIC DINH_FId.DFC_FSTmax_CA "inhibitable FIds / FIds to be inhibited by inhibit source DFC_FSTmax" VAL_BLK 0x804EBC0E ValA_Wu16 968.000000000 DINH_FIdVerb 0.00 968.000000000 FORMAT "%13.9" NUMBER 50 /end CHARACTERISTIC
/begin CHARACTERISTIC DINH_FId.DFC_FTDLAmax_CA "inhibitable FIds / FIds to be inhibited by inhibit source DFC_FTDLAmax" VAL_BLK 0x804EBC72 ValA_Wu16 968.000000000 DINH_FIdVerb 0.00 968.000000000 FORMAT "%13.9" NUMBER 67 /end CHARACTERISTIC
/begin CHARACTERISTIC DINH_FId.DFC_FTDLAmin_CA "inhibitable FIds / FIds to be inhibited by inhibit source DFC_FTDLAmin" VAL_BLK 0x804EBCF8 ValA_Wu16 968.000000000 DINH_FIdVerb 0.00 968.000000000 FORMAT "%13.9" NUMBER 67 /end CHARACTERISTIC
/begin CHARACTERISTIC DINH_FId.DFC_FuPHiSnsrEleclmax_CA "inhibitable FIds / FIds to be inhibited by inhibit source DFC_FuPHiSnsrEleclmax" VAL_BLK 0x804EBD7E ValA_Wu16 968.000000000 DINH_FIdVerb 0.00 968.000000000 FORMAT "%13.9" NUMBER 51 /end CHARACTERISTIC
/begin CHARACTERISTIC DINH_FId.DFC_FuPHiSnsrEleclmin_CA "inhibitable FIds / FIds to be inhibited by inhibit source DFC_FuPHiSnsrEleclmin" VAL_BLK 0x804EBDE4 ValA_Wu16 968.000000000 DINH_FIdVerb 0.00 968.000000000 FORMAT "%13.9" NUMBER 51 /end CHARACTERISTIC
/begin CHARACTERISTIC DINH_FId.DFC_FuPHiSnsrEleclnpl_CA "inhibitable FIds / FIds to be inhibited by inhibit source DFC_FuPHiSnsrEleclnpl" VAL_BLK 0x804EBE4A ValA_Wu16 968.000000000 DINH_FIdVerb 0.00 968.000000000 FORMAT "%13.9" NUMBER 51 /end CHARACTERISTIC
/begin CHARACTERISTIC DINH_FId.DFC_FuPHiSnsrURngMax_CA "inhibitable FIds / FIds to be inhibited by inhibit source DFC_FuPHiSnsrURngMax" VAL_BLK 0x804EBEB0 ValA_Wu16 968.000000000 DINH_FIdVerb 0.00 968.000000000 FORMAT "%13.9" NUMBER 55 /end CHARACTERISTIC
/begin CHARACTERISTIC DINH_FId.DFC_FuPHiSnsrURngMin_CA "inhibitable FIds / FIds to be inhibited by inhibit source DFC_FuPHiSnsrURngMin" VAL_BLK 0x804EBF1E ValA_Wu16 968.000000000 DINH_FIdVerb 0.00 968.000000000 FORMAT "%13.9" NUMBER 55 /end CHARACTERISTIC
/begin CHARACTERISTIC DINH_FId.DFC_FuSnsrPhyRngMaxErr_CA "inhibitable FIds / FIds to be inhibited by inhibit source DFC_FuSnsrPhyRngMaxErr" VAL_BLK 0x804EBF8C ValA_Wu16 968.000000000 DINH_FIdVerb 0.00 968.000000000 FORMAT "%13.9" NUMBER 53 /end CHARACTERISTIC
/begin CHARACTERISTIC DINH_FId.DFC_FuSnsrPhyRngMinErr_CA "inhibitable FIds / FIds to be inhibited by inhibit source DFC_FuSnsrPhyRngMinErr" VAL_BLK 0x804EBFF6 ValA_Wu16 968.000000000 DINH_FIdVerb 0.00 968.000000000 FORMAT "%13.9" NUMBER 53 /end CHARACTERISTIC
/begin CHARACTERISTIC DINH_FId.DFC_GEVlvLockPinDiagIntkB1_CA "inhibitable FIds / FIds to be inhibited by inhibit source DFC_GEVlvLockPinDiagIntkB1" VAL_BLK 0x804EC060 ValA_Wu16 968.000000000 DINH_FIdVerb 0.00 968.000000000 FORMAT "%13.9" NUMBER 51 /end CHARACTERISTIC
/begin CHARACTERISTIC DINH_FId.DFC_GEVlvPhaSlowIntkB1_CA "inhibitable FIds / FIds to be inhibited by inhibit source DFC_GEVlvPhaSlowIntkB1" VAL_BLK 0x804EC0C6 ValA_Wu16 968.000000000 DINH_FIdVerb 0.00 968.000000000 FORMAT "%13.9" NUMBER 91 /end CHARACTERISTIC
/begin CHARACTERISTIC DINH_FId.DFC_GEVlvPhaTargIntkB1_CA "inhibitable FIds / FIds to be inhibited by inhibit source DFC_GEVlvPhaTargIntkB1" VAL_BLK 0x804EC17C ValA_Wu16 968.000000000 DINH_FIdVerb 0.00 968.000000000 FORMAT "%13.9" NUMBER 91 /end CHARACTERISTIC
/begin CHARACTERISTIC DINH_FId.DFC_GbxRvsSwtStk_CA "inhibitable FIds / FIds to be inhibited by inhibit source DFC_GbxRvsSwtStk" VAL_BLK 0x804EC232 ValA_Wu16 968.000000000 DINH_FIdVerb 0.00 968.000000000 FORMAT "%13.9" NUMBER 55 /end CHARACTERISTIC
/begin CHARACTERISTIC DINH_FId.DFC_HDRKHmax_CA "inhibitable FIds / FIds to be inhibited by inhibit source DFC_HDRKHmax" VAL_BLK 0x804EC2A0 ValA_Wu16 968.000000000 DINH_FIdVerb 0.00 968.000000000 FORMAT "%13.9" NUMBER 52 /end CHARACTERISTIC
/begin CHARACTERISTIC DINH_FId.DFC_HDRKHmin_CA "inhibitable FIds / FIds to be inhibited by inhibit source DFC_HDRKHmin" VAL_BLK 0x804EC308 ValA_Wu16 968.000000000 DINH_FIdVerb 0.00 968.000000000 FORMAT "%13.9" NUMBER 52 /end CHARACTERISTIC
/begin CHARACTERISTIC DINH_FId.DFC_HDRPLmax_CA "inhibitable FIds / FIds to be inhibited by inhibit source DFC_HDRPLmax" VAL_BLK 0x804EC370 ValA_Wu16 968.000000000 DINH_FIdVerb 0.00 968.000000000 FORMAT "%13.9" NUMBER 55 /end CHARACTERISTIC
/begin CHARACTERISTIC DINH_FId.DFC_HDRPLmin_CA "inhibitable FIds / FIds to be inhibited by inhibit source DFC_HDRPLmin" VAL_BLK 0x804EC3DE ValA_Wu16 968.000000000 DINH_FIdVerb 0.00 968.000000000 FORMAT "%13.9" NUMBER 55 /end CHARACTERISTIC
/begin CHARACTERISTIC DINH_FId.DFC_HDRmax_CA "inhibitable FIds / FIds to be inhibited by inhibit source DFC_HDRmax" VAL_BLK 0x804EC44C ValA_Wu16 968.000000000 DINH_FIdVerb 0.00 968.000000000 FORMAT "%13.9" NUMBER 65 /end CHARACTERISTIC
/begin CHARACTERISTIC DINH_FId.DFC_HDRmin_CA "inhibitable FIds / FIds to be inhibited by inhibit source DFC_HDRmin" VAL_BLK 0x804EC4CE ValA_Wu16 968.000000000 DINH_FIdVerb 0.00 968.000000000 FORMAT "%13.9" NUMBER 68 /end CHARACTERISTIC
/begin CHARACTERISTIC DINH_FId.DFC_HEGOS2B1ElecMax_CA "inhibitable FIds / FIds to be inhibited by inhibit source DFC_HEGOS2B1ElecMax" VAL_BLK 0x804EC556 ValA_Wu16 968.000000000 DINH_FIdVerb 0.00 968.000000000 FORMAT "%13.9" NUMBER 71 /end CHARACTERISTIC
/begin CHARACTERISTIC DINH_FId.DFC_HEGOS2B1ElecMin_CA "inhibitable FIds / FIds to be inhibited by inhibit source DFC_HEGOS2B1ElecMin" VAL_BLK 0x804EC5E4 ValA_Wu16 968.000000000 DINH_FIdVerb 0.00 968.000000000 FORMAT "%13.9" NUMBER 71 /end CHARACTERISTIC
/begin CHARACTERISTIC DINH_FId.DFC_HEGOS2B1ElecSig_CA "inhibitable FIds / FIds to be inhibited by inhibit source DFC_HEGOS2B1ElecSig" VAL_BLK 0x804EC672 ValA_Wu16 968.000000000 DINH_FIdVerb 0.00 968.000000000 FORMAT "%13.9" NUMBER 71 /end CHARACTERISTIC
/begin CHARACTERISTIC DINH_FId.DFC_HEGOS2B1HtgNpl_CA "inhibitable FIds / FIds to be inhibited by inhibit source DFC_HEGOS2B1HtgNpl" VAL_BLK 0x804EC700 ValA_Wu16 968.000000000 DINH_FIdVerb 0.00 968.000000000 FORMAT "%13.9" NUMBER 65 /end CHARACTERISTIC
/begin CHARACTERISTIC DINH_FId.DFC_HEV00max_CA "inhibitable FIds / FIds to be inhibited by inhibit source DFC_HEV00max" VAL_BLK 0x804EC782 ValA_Wu16 968.000000000 DINH_FIdVerb 0.00 968.000000000 FORMAT "%13.9" NUMBER 51 /end CHARACTERISTIC
/begin CHARACTERISTIC DINH_FId.DFC_HEV01max_CA "inhibitable FIds / FIds to be inhibited by inhibit source DFC_HEV01max" VAL_BLK 0x804EC7E8 ValA_Wu16 968.000000000 DINH_FIdVerb 0.00 968.000000000 FORMAT "%13.9" NUMBER 51 /end CHARACTERISTIC
/begin CHARACTERISTIC DINH_FId.DFC_HEV02max_CA "inhibitable FIds / FIds to be inhibited by inhibit source DFC_HEV02max" VAL_BLK 0x804EC84E ValA_Wu16 968.000000000 DINH_FIdVerb 0.00 968.000000000 FORMAT "%13.9" NUMBER 51 /end CHARACTERISTIC
/begin CHARACTERISTIC DINH_FId.DFC_HEV03max_CA "inhibitable FIds / FIds to be inhibited by inhibit source DFC_HEV03max" VAL_BLK 0x804EC8B4 ValA_Wu16 968.000000000 DINH_FIdVerb 0.00 968.000000000 FORMAT "%13.9" NUMBER 51 /end CHARACTERISTIC
/begin CHARACTERISTIC DINH_FId.DFC_HEVE0max_CA "inhibitable FIds / FIds to be inhibited by inhibit source DFC_HEVE0max" VAL_BLK 0x804EC91A ValA_Wu16 968.000000000 DINH_FIdVerb 0.00 968.000000000 FORMAT "%13.9" NUMBER 53 /end CHARACTERISTIC
/begin CHARACTERISTIC DINH_FId.DFC_HEVE1max_CA "inhibitable FIds / FIds to be inhibited by inhibit source DFC_HEVE1max" VAL_BLK 0x804EC984 ValA_Wu16 968.000000000 DINH_FIdVerb 0.00 968.000000000 FORMAT "%13.9" NUMBER 53 /end CHARACTERISTIC
/begin CHARACTERISTIC DINH_FId.DFC_HFMmax_CA "inhibitable FIds / FIds to be inhibited by inhibit source DFC_HFMmax" VAL_BLK 0x804EC9EE ValA_Wu16 968.000000000 DINH_FIdVerb 0.00 968.000000000 FORMAT "%13.9" NUMBER 64 /end CHARACTERISTIC
/begin CHARACTERISTIC DINH_FId.DFC_HiPSysHiPMaxLimExcdd_CA "inhibitable FIds / FIds to be inhibited by inhibit source DFC_HiPSysHiPMaxLimExcdd" VAL_BLK 0x804ECA6E ValA_Wu16 968.000000000 DINH_FIdVerb 0.00 968.000000000 FORMAT "%13.9" NUMBER 51 /end CHARACTERISTIC
/begin CHARACTERISTIC DINH_FId.DFC_IVGdiCtlCvoErrMax_0_CA "inhibitable FIds / FIds to be inhibited by inhibit source DFC_IVGdiCtlCvoErrMax_0" VAL_BLK 0x804ECAD4 ValA_Wu16 968.000000000 DINH_FIdVerb 0.00 968.000000000 FORMAT "%13.9" NUMBER 51 /end CHARACTERISTIC
/begin CHARACTERISTIC DINH_FId.DFC_IVGdiCtlCvoErrMax_1_CA "inhibitable FIds / FIds to be inhibited by inhibit source DFC_IVGdiCtlCvoErrMax_1" VAL_BLK 0x804ECB3A ValA_Wu16 968.000000000 DINH_FIdVerb 0.00 968.000000000 FORMAT "%13.9" NUMBER 51 /end CHARACTERISTIC
/begin CHARACTERISTIC DINH_FId.DFC_IVGdiCtlCvoErrMax_2_CA "inhibitable FIds / FIds to be inhibited by inhibit source DFC_IVGdiCtlCvoErrMax_2" VAL_BLK 0x804ECBA0 ValA_Wu16 968.000000000 DINH_FIdVerb 0.00 968.000000000 FORMAT "%13.9" NUMBER 51 /end CHARACTERISTIC
/begin CHARACTERISTIC DINH_FId.DFC_IVGdiCtlCvoErrMax_3_CA "inhibitable FIds / FIds to be inhibited by inhibit source DFC_IVGdiCtlCvoErrMax_3" VAL_BLK 0x804ECC06 ValA_Wu16 968.000000000 DINH_FIdVerb 0.00 968.000000000 FORMAT "%13.9" NUMBER 51 /end CHARACTERISTIC
/begin CHARACTERISTIC DINH_FId.DFC_IVGdiCtlCvoErrMin_0_CA "inhibitable FIds / FIds to be inhibited by inhibit source DFC_IVGdiCtlCvoErrMin_0" VAL_BLK 0x804ECC6C ValA_Wu16 968.000000000 DINH_FIdVerb 0.00 968.000000000 FORMAT "%13.9" NUMBER 51 /end CHARACTERISTIC
/begin CHARACTERISTIC DINH_FId.DFC_IVGdiCtlCvoErrMin_1_CA "inhibitable FIds / FIds to be inhibited by inhibit source DFC_IVGdiCtlCvoErrMin_1" VAL_BLK 0x804ECCD2 ValA_Wu16 968.000000000 DINH_FIdVerb 0.00 968.000000000 FORMAT "%13.9" NUMBER 51 /end CHARACTERISTIC
/begin CHARACTERISTIC DINH_FId.DFC_IVGdiCtlCvoErrMin_2_CA "inhibitable FIds / FIds to be inhibited by inhibit source DFC_IVGdiCtlCvoErrMin_2" VAL_BLK 0x804ECD38 ValA_Wu16 968.000000000 DINH_FIdVerb 0.00 968.000000000 FORMAT "%13.9" NUMBER 51 /end CHARACTERISTIC
/begin CHARACTERISTIC DINH_FId.DFC_IVGdiCtlCvoErrMin_3_CA "inhibitable FIds / FIds to be inhibited by inhibit source DFC_IVGdiCtlCvoErrMin_3" VAL_BLK 0x804ECD9E ValA_Wu16 968.000000000 DINH_FIdVerb 0.00 968.000000000 FORMAT "%13.9" NUMBER 51 /end CHARACTERISTIC
/begin CHARACTERISTIC DINH_FId.DFC_IVGdiCtlCvoErrMinMax_CA "inhibitable FIds / FIds to be inhibited by inhibit source DFC_IVGdiCtlCvoErrMinMax" VAL_BLK 0x804ECE04 ValA_Wu16 968.000000000 DINH_FIdVerb 0.00 968.000000000 FORMAT "%13.9" NUMBER 50 /end CHARACTERISTIC
/begin CHARACTERISTIC DINH_FId.DFC_IVGdiCtlCvoSigPlausErrSmrCdn_CA "inhibitable FIds / FIds to be inhibited by inhibit source DFC_IVGdiCtlCvoSigPlausErrSmrCdn" VAL_BLK 0x804ECE68 ValA_Wu16 968.000000000 DINH_FIdVerb 0.00 968.000000000 FORMAT "%13.9" NUMBER 50 /end CHARACTERISTIC
/begin CHARACTERISTIC DINH_FId.DFC_IVGdiCtl_CvoErr_CA "inhibitable FIds / FIds to be inhibited by inhibit source DFC_IVGdiCtl_CvoErr" VAL_BLK 0x804ECECC ValA_Wu16 968.000000000 DINH_FIdVerb 0.00 968.000000000 FORMAT "%13.9" NUMBER 50 /end CHARACTERISTIC
/begin CHARACTERISTIC DINH_FId.DFC_IVGdiCtl_CvoSigPlaus_0_CA "inhibitable FIds / FIds to be inhibited by inhibit source DFC_IVGdiCtl_CvoSigPlaus_0" VAL_BLK 0x804ECF30 ValA_Wu16 968.000000000 DINH_FIdVerb 0.00 968.000000000 FORMAT "%13.9" NUMBER 51 /end CHARACTERISTIC
/begin CHARACTERISTIC DINH_FId.DFC_IVGdiCtl_CvoSigPlaus_1_CA "inhibitable FIds / FIds to be inhibited by inhibit source DFC_IVGdiCtl_CvoSigPlaus_1" VAL_BLK 0x804ECF96 ValA_Wu16 968.000000000 DINH_FIdVerb 0.00 968.000000000 FORMAT "%13.9" NUMBER 51 /end CHARACTERISTIC
/begin CHARACTERISTIC DINH_FId.DFC_IVGdiCtl_CvoSigPlaus_2_CA "inhibitable FIds / FIds to be inhibited by inhibit source DFC_IVGdiCtl_CvoSigPlaus_2" VAL_BLK 0x804ECFFC ValA_Wu16 968.000000000 DINH_FIdVerb 0.00 968.000000000 FORMAT "%13.9" NUMBER 51 /end CHARACTERISTIC
/begin CHARACTERISTIC DINH_FId.DFC_IVGdiCtl_CvoSigPlaus_3_CA "inhibitable FIds / FIds to be inhibited by inhibit source DFC_IVGdiCtl_CvoSigPlaus_3" VAL_BLK 0x804ED062 ValA_Wu16 968.000000000 DINH_FIdVerb 0.00 968.000000000 FORMAT "%13.9" NUMBER 51 /end CHARACTERISTIC
/begin CHARACTERISTIC DINH_FId.DFC_IntkAirTAirFltDsCrssMax_CA "inhibitable FIds / FIds to be inhibited by inhibit source DFC_IntkAirTAirFltDsCrssMax" VAL_BLK 0x804ED0C8 ValA_Wu16 968.000000000 DINH_FIdVerb 0.00 968.000000000 FORMAT "%13.9" NUMBER 52 /end CHARACTERISTIC
/begin CHARACTERISTIC DINH_FId.DFC_IntkAirTAirFltDsCrssMin_CA "inhibitable FIds / FIds to be inhibited by inhibit source DFC_IntkAirTAirFltDsCrssMin" VAL_BLK 0x804ED130 ValA_Wu16 968.000000000 DINH_FIdVerb 0.00 968.000000000 FORMAT "%13.9" NUMBER 52 /end CHARACTERISTIC
/begin CHARACTERISTIC DINH_FId.DFC_IntkAirTAirFltDsHSCMax_CA "inhibitable FIds / FIds to be inhibited by inhibit source DFC_IntkAirTAirFltDsHSCMax" VAL_BLK 0x804ED198 ValA_Wu16 968.000000000 DINH_FIdVerb 0.00 968.000000000 FORMAT "%13.9" NUMBER 52 /end CHARACTERISTIC
/begin CHARACTERISTIC DINH_FId.DFC_IntkAirTAirFltDsImps_CA "inhibitable FIds / FIds to be inhibited by inhibit source DFC_IntkAirTAirFltDsImps" VAL_BLK 0x804ED200 ValA_Wu16 968.000000000 DINH_FIdVerb 0.00 968.000000000 FORMAT "%13.9" NUMBER 57 /end CHARACTERISTIC
/begin CHARACTERISTIC DINH_FId.DFC_IntkAirTAirFltDsPRCMax_CA "inhibitable FIds / FIds to be inhibited by inhibit source DFC_IntkAirTAirFltDsPRCMax" VAL_BLK 0x804ED272 ValA_Wu16 968.000000000 DINH_FIdVerb 0.00 968.000000000 FORMAT "%13.9" NUMBER 52 /end CHARACTERISTIC
/begin CHARACTERISTIC DINH_FId.DFC_IntkAirTAirFltDsPRCMin_CA "inhibitable FIds / FIds to be inhibited by inhibit source DFC_IntkAirTAirFltDsPRCMin" VAL_BLK 0x804ED2DA ValA_Wu16 968.000000000 DINH_FIdVerb 0.00 968.000000000 FORMAT "%13.9" NUMBER 52 /end CHARACTERISTIC
/begin CHARACTERISTIC DINH_FId.DFC_IntkAirTAirFltDsSRCMax_CA "inhibitable FIds / FIds to be inhibited by inhibit source DFC_IntkAirTAirFltDsSRCMax" VAL_BLK 0x804ED342 ValA_Wu16 968.000000000 DINH_FIdVerb 0.00 968.000000000 FORMAT "%13.9" NUMBER 57 /end CHARACTERISTIC
/begin CHARACTERISTIC DINH_FId.DFC_IntkAirTAirFltDsSRCMin_CA "inhibitable FIds / FIds to be inhibited by inhibit source DFC_IntkAirTAirFltDsSRCMin" VAL_BLK 0x804ED3B4 ValA_Wu16 968.000000000 DINH_FIdVerb 0.00 968.000000000 FORMAT "%13.9" NUMBER 57 /end CHARACTERISTIC
/begin CHARACTERISTIC DINH_FId.DFC_IntkAirTAirFltDsSTC_CA "inhibitable FIds / FIds to be inhibited by inhibit source DFC_IntkAirTAirFltDsSTC" VAL_BLK 0x804ED426 ValA_Wu16 968.000000000 DINH_FIdVerb 0.00 968.000000000 FORMAT "%13.9" NUMBER 52 /end CHARACTERISTIC
/begin CHARACTERISTIC DINH_FId.DFC_IntkAirTIntkMnfldCrssMax_CA "inhibitable FIds / FIds to be inhibited by inhibit source DFC_IntkAirTIntkMnfldCrssMax" VAL_BLK 0x804ED48E ValA_Wu16 968.000000000 DINH_FIdVerb 0.00 968.000000000 FORMAT "%13.9" NUMBER 90 /end CHARACTERISTIC
/begin CHARACTERISTIC DINH_FId.DFC_IntkAirTIntkMnfldCrssMin_CA "inhibitable FIds / FIds to be inhibited by inhibit source DFC_IntkAirTIntkMnfldCrssMin" VAL_BLK 0x804ED542 ValA_Wu16 968.000000000 DINH_FIdVerb 0.00 968.000000000 FORMAT "%13.9" NUMBER 90 /end CHARACTERISTIC
/begin CHARACTERISTIC DINH_FId.DFC_IntkAirTIntkMnfldHSCMax_CA "inhibitable FIds / FIds to be inhibited by inhibit source DFC_IntkAirTIntkMnfldHSCMax" VAL_BLK 0x804ED5F6 ValA_Wu16 968.000000000 DINH_FIdVerb 0.00 968.000000000 FORMAT "%13.9" NUMBER 84 /end CHARACTERISTIC
/begin CHARACTERISTIC DINH_FId.DFC_IntkAirTIntkMnfldImps_CA "inhibitable FIds / FIds to be inhibited by inhibit source DFC_IntkAirTIntkMnfldImps" VAL_BLK 0x804ED69E ValA_Wu16 968.000000000 DINH_FIdVerb 0.00 968.000000000 FORMAT "%13.9" NUMBER 95 /end CHARACTERISTIC
/begin CHARACTERISTIC DINH_FId.DFC_IntkAirTIntkMnfldPRCMax_CA "inhibitable FIds / FIds to be inhibited by inhibit source DFC_IntkAirTIntkMnfldPRCMax" VAL_BLK 0x804ED75C ValA_Wu16 968.000000000 DINH_FIdVerb 0.00 968.000000000 FORMAT "%13.9" NUMBER 84 /end CHARACTERISTIC
/begin CHARACTERISTIC DINH_FId.DFC_IntkAirTIntkMnfldPRCMin_CA "inhibitable FIds / FIds to be inhibited by inhibit source DFC_IntkAirTIntkMnfldPRCMin" VAL_BLK 0x804ED804 ValA_Wu16 968.000000000 DINH_FIdVerb 0.00 968.000000000 FORMAT "%13.9" NUMBER 84 /end CHARACTERISTIC
/begin CHARACTERISTIC DINH_FId.DFC_IntkAirTIntkMnfldSRCMax_CA "inhibitable FIds / FIds to be inhibited by inhibit source DFC_IntkAirTIntkMnfldSRCMax" VAL_BLK 0x804ED8AC ValA_Wu16 968.000000000 DINH_FIdVerb 0.00 968.000000000 FORMAT "%13.9" NUMBER 96 /end CHARACTERISTIC
/begin CHARACTERISTIC DINH_FId.DFC_IntkAirTIntkMnfldSRCMin_CA "inhibitable FIds / FIds to be inhibited by inhibit source DFC_IntkAirTIntkMnfldSRCMin" VAL_BLK 0x804ED96C ValA_Wu16 968.000000000 DINH_FIdVerb 0.00 968.000000000 FORMAT "%13.9" NUMBER 96 /end CHARACTERISTIC
/begin CHARACTERISTIC DINH_FId.DFC_IntkAirTIntkMnfldSTC_CA "inhibitable FIds / FIds to be inhibited by inhibit source DFC_IntkAirTIntkMnfldSTC" VAL_BLK 0x804EDA2C ValA_Wu16 968.000000000 DINH_FIdVerb 0.00 968.000000000 FORMAT "%13.9" NUMBER 84 /end CHARACTERISTIC
/begin CHARACTERISTIC DINH_FId.DFC_KRREGRLMX_CA "inhibitable FIds / FIds to be inhibited by inhibit source DFC_KRREGRLMX" VAL_BLK 0x804EDAD4 ValA_Wu16 968.000000000 DINH_FIdVerb 0.00 968.000000000 FORMAT "%13.9" NUMBER 50 /end CHARACTERISTIC
/begin CHARACTERISTIC DINH_FId.DFC_KRVEKOCVLCI_CA "inhibitable FIds / FIds to be inhibited by inhibit source DFC_KRVEKOCVLCI" VAL_BLK 0x804EDB38 ValA_Wu16 968.000000000 DINH_FIdVerb 0.00 968.000000000 FORMAT "%13.9" NUMBER 50 /end CHARACTERISTIC
/begin CHARACTERISTIC DINH_FId.DFC_KRVEKOENCHMT_CA "inhibitable FIds / FIds to be inhibited by inhibit source DFC_KRVEKOENCHMT" VAL_BLK 0x804EDB9C ValA_Wu16 968.000000000 DINH_FIdVerb 0.00 968.000000000 FORMAT "%13.9" NUMBER 50 /end CHARACTERISTIC
/begin CHARACTERISTIC DINH_FId.DFC_KRVEKOENCHMT0_CA "inhibitable FIds / FIds to be inhibited by inhibit source DFC_KRVEKOENCHMT0" VAL_BLK 0x804EDC00 ValA_Wu16 968.000000000 DINH_FIdVerb 0.00 968.000000000 FORMAT "%13.9" NUMBER 50 /end CHARACTERISTIC
/begin CHARACTERISTIC DINH_FId.DFC_KRVEKOENCHMT1_CA "inhibitable FIds / FIds to be inhibited by inhibit source DFC_KRVEKOENCHMT1" VAL_BLK 0x804EDC64 ValA_Wu16 968.000000000 DINH_FIdVerb 0.00 968.000000000 FORMAT "%13.9" NUMBER 50 /end CHARACTERISTIC
/begin CHARACTERISTIC DINH_FId.DFC_KRVEKOENCHMT2_CA "inhibitable FIds / FIds to be inhibited by inhibit source DFC_KRVEKOENCHMT2" VAL_BLK 0x804EDCC8 ValA_Wu16 968.000000000 DINH_FIdVerb 0.00 968.000000000 FORMAT "%13.9" NUMBER 50 /end CHARACTERISTIC
/begin CHARACTERISTIC DINH_FId.DFC_KRVEKOENCHMT3_CA "inhibitable FIds / FIds to be inhibited by inhibit source DFC_KRVEKOENCHMT3" VAL_BLK 0x804EDD2C ValA_Wu16 968.000000000 DINH_FIdVerb 0.00 968.000000000 FORMAT "%13.9" NUMBER 50 /end CHARACTERISTIC
/begin CHARACTERISTIC DINH_FId.DFC_KRVEKOENCHMT4_CA "inhibitable FIds / FIds to be inhibited by inhibit source DFC_KRVEKOENCHMT4" VAL_BLK 0x804EDD90 ValA_Wu16 968.000000000 DINH_FIdVerb 0.00 968.000000000 FORMAT "%13.9" NUMBER 50 /end CHARACTERISTIC
/begin CHARACTERISTIC DINH_FId.DFC_KRVEKOENCHMT5_CA "inhibitable FIds / FIds to be inhibited by inhibit source DFC_KRVEKOENCHMT5" VAL_BLK 0x804EDDF4 ValA_Wu16 968.000000000 DINH_FIdVerb 0.00 968.000000000 FORMAT "%13.9" NUMBER 50 /end CHARACTERISTIC
/begin CHARACTERISTIC DINH_FId.DFC_KRVEKOENCHMT6_CA "inhibitable FIds / FIds to be inhibited by inhibit source DFC_KRVEKOENCHMT6" VAL_BLK 0x804EDE58 ValA_Wu16 968.000000000 DINH_FIdVerb 0.00 968.000000000 FORMAT "%13.9" NUMBER 50 /end CHARACTERISTIC
/begin CHARACTERISTIC DINH_FId.DFC_KRVEKOENCHMT7_CA "inhibitable FIds / FIds to be inhibited by inhibit source DFC_KRVEKOENCHMT7" VAL_BLK 0x804EDEBC ValA_Wu16 968.000000000 DINH_FIdVerb 0.00 968.000000000 FORMAT "%13.9" NUMBER 50 /end CHARACTERISTIC
/begin CHARACTERISTIC DINH_FId.DFC_KRVEKORLMX_CA "inhibitable FIds / FIds to be inhibited by inhibit source DFC_KRVEKORLMX" VAL_BLK 0x804EDF20 ValA_Wu16 968.000000000 DINH_FIdVerb 0.00 968.000000000 FORMAT "%13.9" NUMBER 50 /end CHARACTERISTIC
/begin CHARACTERISTIC DINH_FId.DFC_KRVEKORLMXL_CA "inhibitable FIds / FIds to be inhibited by inhibit source DFC_KRVEKORLMXL" VAL_BLK 0x804EDF84 ValA_Wu16 968.000000000 DINH_FIdVerb 0.00 968.000000000 FORMAT "%13.9" NUMBER 50 /end CHARACTERISTIC
/begin CHARACTERISTIC DINH_FId.DFC_KS1max_CA "inhibitable FIds / FIds to be inhibited by inhibit source DFC_KS1max" VAL_BLK 0x804EDFE8 ValA_Wu16 968.000000000 DINH_FIdVerb 0.00 968.000000000 FORMAT "%13.9" NUMBER 58 /end CHARACTERISTIC
/begin CHARACTERISTIC DINH_FId.DFC_KS1min_CA "inhibitable FIds / FIds to be inhibited by inhibit source DFC_KS1min" VAL_BLK 0x804EE05C ValA_Wu16 968.000000000 DINH_FIdVerb 0.00 968.000000000 FORMAT "%13.9" NUMBER 58 /end CHARACTERISTIC
/begin CHARACTERISTIC DINH_FId.DFC_LMmax_CA "inhibitable FIds / FIds to be inhibited by inhibit source DFC_LMmax" VAL_BLK 0x804EE0D0 ValA_Wu16 968.000000000 DINH_FIdVerb 0.00 968.000000000 FORMAT "%13.9" NUMBER 67 /end CHARACTERISTIC
/begin CHARACTERISTIC DINH_FId.DFC_LZSRnpl_CA "inhibitable FIds / FIds to be inhibited by inhibit source DFC_LZSRnpl" VAL_BLK 0x804EE156 ValA_Wu16 968.000000000 DINH_FIdVerb 0.00 968.000000000 FORMAT "%13.9" NUMBER 57 /end CHARACTERISTIC
/begin CHARACTERISTIC DINH_FId.DFC_LamDynDiagS1B1_CA "inhibitable FIds / FIds to be inhibited by inhibit source DFC_LamDynDiagS1B1" VAL_BLK 0x804EE1C8 ValA_Wu16 968.000000000 DINH_FIdVerb 0.00 968.000000000 FORMAT "%13.9" NUMBER 78 /end CHARACTERISTIC
/begin CHARACTERISTIC DINH_FId.DFC_LeakIntkMnfldEmiInfl_CA "inhibitable FIds / FIds to be inhibited by inhibit source DFC_LeakIntkMnfldEmiInfl" VAL_BLK 0x804EE264 ValA_Wu16 968.000000000 DINH_FIdVerb 0.00 968.000000000 FORMAT "%13.9" NUMBER 52 /end CHARACTERISTIC
/begin CHARACTERISTIC DINH_FId.DFC_LinFrameErrDCDC_CA "inhibitable FIds / FIds to be inhibited by inhibit source DFC_LinFrameErrDCDC" VAL_BLK 0x804EE2CC ValA_Wu16 968.000000000 DINH_FIdVerb 0.00 968.000000000 FORMAT "%13.9" NUMBER 52 /end CHARACTERISTIC
/begin CHARACTERISTIC DINH_FId.DFC_LinOverrunErrDCDC_CA "inhibitable FIds / FIds to be inhibited by inhibit source DFC_LinOverrunErrDCDC" VAL_BLK 0x804EE334 ValA_Wu16 968.000000000 DINH_FIdVerb 0.00 968.000000000 FORMAT "%13.9" NUMBER 52 /end CHARACTERISTIC
/begin CHARACTERISTIC DINH_FId.DFC_MD00max_CA "inhibitable FIds / FIds to be inhibited by inhibit source DFC_MD00max" VAL_BLK 0x804EE39C ValA_Wu16 968.000000000 DINH_FIdVerb 0.00 968.000000000 FORMAT "%13.9" NUMBER 50 /end CHARACTERISTIC
/begin CHARACTERISTIC DINH_FId.DFC_MDBmax_CA "inhibitable FIds / FIds to be inhibited by inhibit source DFC_MDBmax" VAL_BLK 0x804EE400 ValA_Wu16 968.000000000 DINH_FIdVerb 0.00 968.000000000 FORMAT "%13.9" NUMBER 58 /end CHARACTERISTIC
/begin CHARACTERISTIC DINH_FId.DFC_MDCat_CA "inhibitable FIds / FIds to be inhibited by inhibit source DFC_MDCat" VAL_BLK 0x804EE474 ValA_Wu16 968.000000000 DINH_FIdVerb 0.00 968.000000000 FORMAT "%13.9" NUMBER 56 /end CHARACTERISTIC
/begin CHARACTERISTIC DINH_FId.DFC_MDCatCrit_CA "inhibitable FIds / FIds to be inhibited by inhibit source DFC_MDCatCrit" VAL_BLK 0x804EE4E4 ValA_Wu16 968.000000000 DINH_FIdVerb 0.00 968.000000000 FORMAT "%13.9" NUMBER 50 /end CHARACTERISTIC
/begin CHARACTERISTIC DINH_FId.DFC_MDCatCurr_CA "inhibitable FIds / FIds to be inhibited by inhibit source DFC_MDCatCurr" VAL_BLK 0x804EE548 ValA_Wu16 968.000000000 DINH_FIdVerb 0.00 968.000000000 FORMAT "%13.9" NUMBER 53 /end CHARACTERISTIC
/begin CHARACTERISTIC DINH_FId.DFC_MDCyl_0_CA "inhibitable FIds / FIds to be inhibited by inhibit source DFC_MDCyl_0" VAL_BLK 0x804EE5B2 ValA_Wu16 968.000000000 DINH_FIdVerb 0.00 968.000000000 FORMAT "%13.9" NUMBER 78 /end CHARACTERISTIC
/begin CHARACTERISTIC DINH_FId.DFC_MDCyl_1_CA "inhibitable FIds / FIds to be inhibited by inhibit source DFC_MDCyl_1" VAL_BLK 0x804EE64E ValA_Wu16 968.000000000 DINH_FIdVerb 0.00 968.000000000 FORMAT "%13.9" NUMBER 78 /end CHARACTERISTIC
/begin CHARACTERISTIC DINH_FId.DFC_MDCyl_2_CA "inhibitable FIds / FIds to be inhibited by inhibit source DFC_MDCyl_2" VAL_BLK 0x804EE6EA ValA_Wu16 968.000000000 DINH_FIdVerb 0.00 968.000000000 FORMAT "%13.9" NUMBER 78 /end CHARACTERISTIC
/begin CHARACTERISTIC DINH_FId.DFC_MDCyl_3_CA "inhibitable FIds / FIds to be inhibited by inhibit source DFC_MDCyl_3" VAL_BLK 0x804EE786 ValA_Wu16 968.000000000 DINH_FIdVerb 0.00 968.000000000 FORMAT "%13.9" NUMBER 78 /end CHARACTERISTIC
/begin CHARACTERISTIC DINH_FId.DFC_MDEmi_CA "inhibitable FIds / FIds to be inhibited by inhibit source DFC_MDEmi" VAL_BLK 0x804EE822 ValA_Wu16 968.000000000 DINH_FIdVerb 0.00 968.000000000 FORMAT "%13.9" NUMBER 56 /end CHARACTERISTIC
/begin CHARACTERISTIC DINH_FId.DFC_MDEmiStrt_CA "inhibitable FIds / FIds to be inhibited by inhibit source DFC_MDEmiStrt" VAL_BLK 0x804EE892 ValA_Wu16 968.000000000 DINH_FIdVerb 0.00 968.000000000 FORMAT "%13.9" NUMBER 56 /end CHARACTERISTIC
/begin CHARACTERISTIC DINH_FId.DFC_MDFco_CA "inhibitable FIds / FIds to be inhibited by inhibit source DFC_MDFco" VAL_BLK 0x804EE902 ValA_Wu16 968.000000000 DINH_FIdVerb 0.00 968.000000000 FORMAT "%13.9" NUMBER 54 /end CHARACTERISTIC
/begin CHARACTERISTIC DINH_FId.DFC_MDMpl_CA "inhibitable FIds / FIds to be inhibited by inhibit source DFC_MDMpl" VAL_BLK 0x804EE96E ValA_Wu16 968.000000000 DINH_FIdVerb 0.00 968.000000000 FORMAT "%13.9" NUMBER 78 /end CHARACTERISTIC
/begin CHARACTERISTIC DINH_FId.DFC_MDSegTiAdpn_CA "inhibitable FIds / FIds to be inhibited by inhibit source DFC_MDSegTiAdpn" VAL_BLK 0x804EEA0A ValA_Wu16 968.000000000 DINH_FIdVerb 0.00 968.000000000 FORMAT "%13.9" NUMBER 50 /end CHARACTERISTIC
/begin CHARACTERISTIC DINH_FId.DFC_MDmax_CA "inhibitable FIds / FIds to be inhibited by inhibit source DFC_MDmax" VAL_BLK 0x804EEA6E ValA_Wu16 968.000000000 DINH_FIdVerb 0.00 968.000000000 FORMAT "%13.9" NUMBER 50 /end CHARACTERISTIC
/begin CHARACTERISTIC DINH_FId.DFC_MFuOilMax_CA "inhibitable FIds / FIds to be inhibited by inhibit source DFC_MFuOilMax" VAL_BLK 0x804EEAD2 ValA_Wu16 968.000000000 DINH_FIdVerb 0.00 968.000000000 FORMAT "%13.9" NUMBER 50 /end CHARACTERISTIC
/begin CHARACTERISTIC DINH_FId.DFC_MOXEMM_SMU_ALM0_0_CA "inhibitable FIds / FIds to be inhibited by inhibit source DFC_MOXEMM_SMU_ALM0_0" VAL_BLK 0x804EEB36 ValA_Wu16 968.000000000 DINH_FIdVerb 0.00 968.000000000 FORMAT "%13.9" NUMBER 50 /end CHARACTERISTIC
/begin CHARACTERISTIC DINH_FId.DFC_MOXEMM_SMU_ALM0_1_CA "inhibitable FIds / FIds to be inhibited by inhibit source DFC_MOXEMM_SMU_ALM0_1" VAL_BLK 0x804EEB9A ValA_Wu16 968.000000000 DINH_FIdVerb 0.00 968.000000000 FORMAT "%13.9" NUMBER 50 /end CHARACTERISTIC
/begin CHARACTERISTIC DINH_FId.DFC_MOXEMM_SMU_ALM0_10_CA "inhibitable FIds / FIds to be inhibited by inhibit source DFC_MOXEMM_SMU_ALM0_10" VAL_BLK 0x804EEBFE ValA_Wu16 968.000000000 DINH_FIdVerb 0.00 968.000000000 FORMAT "%13.9" NUMBER 50 /end CHARACTERISTIC
/begin CHARACTERISTIC DINH_FId.DFC_MOXEMM_SMU_ALM0_11_CA "inhibitable FIds / FIds to be inhibited by inhibit source DFC_MOXEMM_SMU_ALM0_11" VAL_BLK 0x804EEC62 ValA_Wu16 968.000000000 DINH_FIdVerb 0.00 968.000000000 FORMAT "%13.9" NUMBER 50 /end CHARACTERISTIC
/begin CHARACTERISTIC DINH_FId.DFC_MOXEMM_SMU_ALM0_13_CA "inhibitable FIds / FIds to be inhibited by inhibit source DFC_MOXEMM_SMU_ALM0_13" VAL_BLK 0x804EECC6 ValA_Wu16 968.000000000 DINH_FIdVerb 0.00 968.000000000 FORMAT "%13.9" NUMBER 50 /end CHARACTERISTIC
/begin CHARACTERISTIC DINH_FId.DFC_MOXEMM_SMU_ALM0_14_CA "inhibitable FIds / FIds to be inhibited by inhibit source DFC_MOXEMM_SMU_ALM0_14" VAL_BLK 0x804EED2A ValA_Wu16 968.000000000 DINH_FIdVerb 0.00 968.000000000 FORMAT "%13.9" NUMBER 50 /end CHARACTERISTIC
/begin CHARACTERISTIC DINH_FId.DFC_MOXEMM_SMU_ALM0_2_CA "inhibitable FIds / FIds to be inhibited by inhibit source DFC_MOXEMM_SMU_ALM0_2" VAL_BLK 0x804EED8E ValA_Wu16 968.000000000 DINH_FIdVerb 0.00 968.000000000 FORMAT "%13.9" NUMBER 50 /end CHARACTERISTIC
/begin CHARACTERISTIC DINH_FId.DFC_MOXEMM_SMU_ALM0_22_CA "inhibitable FIds / FIds to be inhibited by inhibit source DFC_MOXEMM_SMU_ALM0_22" VAL_BLK 0x804EEDF2 ValA_Wu16 968.000000000 DINH_FIdVerb 0.00 968.000000000 FORMAT "%13.9" NUMBER 50 /end CHARACTERISTIC
/begin CHARACTERISTIC DINH_FId.DFC_MOXEMM_SMU_ALM0_23_CA "inhibitable FIds / FIds to be inhibited by inhibit source DFC_MOXEMM_SMU_ALM0_23" VAL_BLK 0x804EEE56 ValA_Wu16 968.000000000 DINH_FIdVerb 0.00 968.000000000 FORMAT "%13.9" NUMBER 50 /end CHARACTERISTIC
/begin CHARACTERISTIC DINH_FId.DFC_MOXEMM_SMU_ALM0_4_CA "inhibitable FIds / FIds to be inhibited by inhibit source DFC_MOXEMM_SMU_ALM0_4" VAL_BLK 0x804EEEBA ValA_Wu16 968.000000000 DINH_FIdVerb 0.00 968.000000000 FORMAT "%13.9" NUMBER 50 /end CHARACTERISTIC
/begin CHARACTERISTIC DINH_FId.DFC_MOXEMM_SMU_ALM0_5_CA "inhibitable FIds / FIds to be inhibited by inhibit source DFC_MOXEMM_SMU_ALM0_5" VAL_BLK 0x804EEF1E ValA_Wu16 968.000000000 DINH_FIdVerb 0.00 968.000000000 FORMAT "%13.9" NUMBER 50 /end CHARACTERISTIC
/begin CHARACTERISTIC DINH_FId.DFC_MOXEMM_SMU_ALM0_7_CA "inhibitable FIds / FIds to be inhibited by inhibit source DFC_MOXEMM_SMU_ALM0_7" VAL_BLK 0x804EEF82 ValA_Wu16 968.000000000 DINH_FIdVerb 0.00 968.000000000 FORMAT "%13.9" NUMBER 50 /end CHARACTERISTIC
/begin CHARACTERISTIC DINH_FId.DFC_MOXEMM_SMU_ALM0_8_CA "inhibitable FIds / FIds to be inhibited by inhibit source DFC_MOXEMM_SMU_ALM0_8" VAL_BLK 0x804EEFE6 ValA_Wu16 968.000000000 DINH_FIdVerb 0.00 968.000000000 FORMAT "%13.9" NUMBER 50 /end CHARACTERISTIC
/begin CHARACTERISTIC DINH_FId.DFC_MOXEMM_SMU_ALM10_16_CA "inhibitable FIds / FIds to be inhibited by inhibit source DFC_MOXEMM_SMU_ALM10_16" VAL_BLK 0x804EF04A ValA_Wu16 968.000000000 DINH_FIdVerb 0.00 968.000000000 FORMAT "%13.9" NUMBER 50 /end CHARACTERISTIC
/begin CHARACTERISTIC DINH_FId.DFC_MOXEMM_SMU_ALM10_17_CA "inhibitable FIds / FIds to be inhibited by inhibit source DFC_MOXEMM_SMU_ALM10_17" VAL_BLK 0x804EF0AE ValA_Wu16 968.000000000 DINH_FIdVerb 0.00 968.000000000 FORMAT "%13.9" NUMBER 50 /end CHARACTERISTIC
/begin CHARACTERISTIC DINH_FId.DFC_MOXEMM_SMU_ALM10_21_CA "inhibitable FIds / FIds to be inhibited by inhibit source DFC_MOXEMM_SMU_ALM10_21" VAL_BLK 0x804EF112 ValA_Wu16 968.000000000 DINH_FIdVerb 0.00 968.000000000 FORMAT "%13.9" NUMBER 50 /end CHARACTERISTIC
/begin CHARACTERISTIC DINH_FId.DFC_MOXEMM_SMU_ALM11_0_CA "inhibitable FIds / FIds to be inhibited by inhibit source DFC_MOXEMM_SMU_ALM11_0" VAL_BLK 0x804EF176 ValA_Wu16 968.000000000 DINH_FIdVerb 0.00 968.000000000 FORMAT "%13.9" NUMBER 50 /end CHARACTERISTIC
/begin CHARACTERISTIC DINH_FId.DFC_MOXEMM_SMU_ALM11_1_CA "inhibitable FIds / FIds to be inhibited by inhibit source DFC_MOXEMM_SMU_ALM11_1" VAL_BLK 0x804EF1DA ValA_Wu16 968.000000000 DINH_FIdVerb 0.00 968.000000000 FORMAT "%13.9" NUMBER 50 /end CHARACTERISTIC
/begin CHARACTERISTIC DINH_FId.DFC_MOXEMM_SMU_ALM11_2_CA "inhibitable FIds / FIds to be inhibited by inhibit source DFC_MOXEMM_SMU_ALM11_2" VAL_BLK 0x804EF23E ValA_Wu16 968.000000000 DINH_FIdVerb 0.00 968.000000000 FORMAT "%13.9" NUMBER 50 /end CHARACTERISTIC
/begin CHARACTERISTIC DINH_FId.DFC_MOXEMM_SMU_ALM11_3_CA "inhibitable FIds / FIds to be inhibited by inhibit source DFC_MOXEMM_SMU_ALM11_3" VAL_BLK 0x804EF2A2 ValA_Wu16 968.000000000 DINH_FIdVerb 0.00 968.000000000 FORMAT "%13.9" NUMBER 50 /end CHARACTERISTIC
/begin CHARACTERISTIC DINH_FId.DFC_MOXEMM_SMU_ALM11_4_CA "inhibitable FIds / FIds to be inhibited by inhibit source DFC_MOXEMM_SMU_ALM11_4" VAL_BLK 0x804EF306 ValA_Wu16 968.000000000 DINH_FIdVerb 0.00 968.000000000 FORMAT "%13.9" NUMBER 50 /end CHARACTERISTIC
/begin CHARACTERISTIC DINH_FId.DFC_MOXEMM_SMU_ALM11_5_CA "inhibitable FIds / FIds to be inhibited by inhibit source DFC_MOXEMM_SMU_ALM11_5" VAL_BLK 0x804EF36A ValA_Wu16 968.000000000 DINH_FIdVerb 0.00 968.000000000 FORMAT "%13.9" NUMBER 50 /end CHARACTERISTIC
/begin CHARACTERISTIC DINH_FId.DFC_MOXEMM_SMU_ALM11_8_CA "inhibitable FIds / FIds to be inhibited by inhibit source DFC_MOXEMM_SMU_ALM11_8" VAL_BLK 0x804EF3CE ValA_Wu16 968.000000000 DINH_FIdVerb 0.00 968.000000000 FORMAT "%13.9" NUMBER 50 /end CHARACTERISTIC
/begin CHARACTERISTIC DINH_FId.DFC_MOXEMM_SMU_ALM11_9_CA "inhibitable FIds / FIds to be inhibited by inhibit source DFC_MOXEMM_SMU_ALM11_9" VAL_BLK 0x804EF432 ValA_Wu16 968.000000000 DINH_FIdVerb 0.00 968.000000000 FORMAT "%13.9" NUMBER 50 /end CHARACTERISTIC
/begin CHARACTERISTIC DINH_FId.DFC_MOXEMM_SMU_ALM1_0_CA "inhibitable FIds / FIds to be inhibited by inhibit source DFC_MOXEMM_SMU_ALM1_0" VAL_BLK 0x804EF496 ValA_Wu16 968.000000000 DINH_FIdVerb 0.00 968.000000000 FORMAT "%13.9" NUMBER 50 /end CHARACTERISTIC
/begin CHARACTERISTIC DINH_FId.DFC_MOXEMM_SMU_ALM1_1_CA "inhibitable FIds / FIds to be inhibited by inhibit source DFC_MOXEMM_SMU_ALM1_1" VAL_BLK 0x804EF4FA ValA_Wu16 968.000000000 DINH_FIdVerb 0.00 968.000000000 FORMAT "%13.9" NUMBER 50 /end CHARACTERISTIC
/begin CHARACTERISTIC DINH_FId.DFC_MOXEMM_SMU_ALM1_10_CA "inhibitable FIds / FIds to be inhibited by inhibit source DFC_MOXEMM_SMU_ALM1_10" VAL_BLK 0x804EF55E ValA_Wu16 968.000000000 DINH_FIdVerb 0.00 968.000000000 FORMAT "%13.9" NUMBER 50 /end CHARACTERISTIC
/begin CHARACTERISTIC DINH_FId.DFC_MOXEMM_SMU_ALM1_11_CA "inhibitable FIds / FIds to be inhibited by inhibit source DFC_MOXEMM_SMU_ALM1_11" VAL_BLK 0x804EF5C2 ValA_Wu16 968.000000000 DINH_FIdVerb 0.00 968.000000000 FORMAT "%13.9" NUMBER 50 /end CHARACTERISTIC
/begin CHARACTERISTIC DINH_FId.DFC_MOXEMM_SMU_ALM1_13_CA "inhibitable FIds / FIds to be inhibited by inhibit source DFC_MOXEMM_SMU_ALM1_13" VAL_BLK 0x804EF626 ValA_Wu16 968.000000000 DINH_FIdVerb 0.00 968.000000000 FORMAT "%13.9" NUMBER 50 /end CHARACTERISTIC
/begin CHARACTERISTIC DINH_FId.DFC_MOXEMM_SMU_ALM1_14_CA "inhibitable FIds / FIds to be inhibited by inhibit source DFC_MOXEMM_SMU_ALM1_14" VAL_BLK 0x804EF68A ValA_Wu16 968.000000000 DINH_FIdVerb 0.00 968.000000000 FORMAT "%13.9" NUMBER 50 /end CHARACTERISTIC
/begin CHARACTERISTIC DINH_FId.DFC_MOXEMM_SMU_ALM1_2_CA "inhibitable FIds / FIds to be inhibited by inhibit source DFC_MOXEMM_SMU_ALM1_2" VAL_BLK 0x804EF6EE ValA_Wu16 968.000000000 DINH_FIdVerb 0.00 968.000000000 FORMAT "%13.9" NUMBER 50 /end CHARACTERISTIC
/begin CHARACTERISTIC DINH_FId.DFC_MOXEMM_SMU_ALM1_22_CA "inhibitable FIds / FIds to be inhibited by inhibit source DFC_MOXEMM_SMU_ALM1_22" VAL_BLK 0x804EF752 ValA_Wu16 968.000000000 DINH_FIdVerb 0.00 968.000000000 FORMAT "%13.9" NUMBER 50 /end CHARACTERISTIC
/begin CHARACTERISTIC DINH_FId.DFC_MOXEMM_SMU_ALM1_23_CA "inhibitable FIds / FIds to be inhibited by inhibit source DFC_MOXEMM_SMU_ALM1_23" VAL_BLK 0x804EF7B6 ValA_Wu16 968.000000000 DINH_FIdVerb 0.00 968.000000000 FORMAT "%13.9" NUMBER 50 /end CHARACTERISTIC
/begin CHARACTERISTIC DINH_FId.DFC_MOXEMM_SMU_ALM1_4_CA "inhibitable FIds / FIds to be inhibited by inhibit source DFC_MOXEMM_SMU_ALM1_4" VAL_BLK 0x804EF81A ValA_Wu16 968.000000000 DINH_FIdVerb 0.00 968.000000000 FORMAT "%13.9" NUMBER 50 /end CHARACTERISTIC
/begin CHARACTERISTIC DINH_FId.DFC_MOXEMM_SMU_ALM1_5_CA "inhibitable FIds / FIds to be inhibited by inhibit source DFC_MOXEMM_SMU_ALM1_5" VAL_BLK 0x804EF87E ValA_Wu16 968.000000000 DINH_FIdVerb 0.00 968.000000000 FORMAT "%13.9" NUMBER 50 /end CHARACTERISTIC
/begin CHARACTERISTIC DINH_FId.DFC_MOXEMM_SMU_ALM1_7_CA "inhibitable FIds / FIds to be inhibited by inhibit source DFC_MOXEMM_SMU_ALM1_7" VAL_BLK 0x804EF8E2 ValA_Wu16 968.000000000 DINH_FIdVerb 0.00 968.000000000 FORMAT "%13.9" NUMBER 50 /end CHARACTERISTIC
/begin CHARACTERISTIC DINH_FId.DFC_MOXEMM_SMU_ALM1_8_CA "inhibitable FIds / FIds to be inhibited by inhibit source DFC_MOXEMM_SMU_ALM1_8" VAL_BLK 0x804EF946 ValA_Wu16 968.000000000 DINH_FIdVerb 0.00 968.000000000 FORMAT "%13.9" NUMBER 50 /end CHARACTERISTIC
/begin CHARACTERISTIC DINH_FId.DFC_MOXEMM_SMU_ALM21_0_CA "inhibitable FIds / FIds to be inhibited by inhibit source DFC_MOXEMM_SMU_ALM21_0" VAL_BLK 0x804EF9AA ValA_Wu16 968.000000000 DINH_FIdVerb 0.00 968.000000000 FORMAT "%13.9" NUMBER 50 /end CHARACTERISTIC
/begin CHARACTERISTIC DINH_FId.DFC_MOXEMM_SMU_ALM21_16_CA "inhibitable FIds / FIds to be inhibited by inhibit source DFC_MOXEMM_SMU_ALM21_16" VAL_BLK 0x804EFA0E ValA_Wu16 968.000000000 DINH_FIdVerb 0.00 968.000000000 FORMAT "%13.9" NUMBER 50 /end CHARACTERISTIC
/begin CHARACTERISTIC DINH_FId.DFC_MOXEMM_SMU_ALM21_3_CA "inhibitable FIds / FIds to be inhibited by inhibit source DFC_MOXEMM_SMU_ALM21_3" VAL_BLK 0x804EFA72 ValA_Wu16 968.000000000 DINH_FIdVerb 0.00 968.000000000 FORMAT "%13.9" NUMBER 50 /end CHARACTERISTIC
/begin CHARACTERISTIC DINH_FId.DFC_MOXEMM_SMU_ALM2_1_CA "inhibitable FIds / FIds to be inhibited by inhibit source DFC_MOXEMM_SMU_ALM2_1" VAL_BLK 0x804EFAD6 ValA_Wu16 968.000000000 DINH_FIdVerb 0.00 968.000000000 FORMAT "%13.9" NUMBER 50 /end CHARACTERISTIC
/begin CHARACTERISTIC DINH_FId.DFC_MOXEMM_SMU_ALM2_10_CA "inhibitable FIds / FIds to be inhibited by inhibit source DFC_MOXEMM_SMU_ALM2_10" VAL_BLK 0x804EFB3A ValA_Wu16 968.000000000 DINH_FIdVerb 0.00 968.000000000 FORMAT "%13.9" NUMBER 50 /end CHARACTERISTIC
/begin CHARACTERISTIC DINH_FId.DFC_MOXEMM_SMU_ALM2_11_CA "inhibitable FIds / FIds to be inhibited by inhibit source DFC_MOXEMM_SMU_ALM2_11" VAL_BLK 0x804EFB9E ValA_Wu16 968.000000000 DINH_FIdVerb 0.00 968.000000000 FORMAT "%13.9" NUMBER 50 /end CHARACTERISTIC
/begin CHARACTERISTIC DINH_FId.DFC_MOXEMM_SMU_ALM2_13_CA "inhibitable FIds / FIds to be inhibited by inhibit source DFC_MOXEMM_SMU_ALM2_13" VAL_BLK 0x804EFC02 ValA_Wu16 968.000000000 DINH_FIdVerb 0.00 968.000000000 FORMAT "%13.9" NUMBER 50 /end CHARACTERISTIC
/begin CHARACTERISTIC DINH_FId.DFC_MOXEMM_SMU_ALM2_14_CA "inhibitable FIds / FIds to be inhibited by inhibit source DFC_MOXEMM_SMU_ALM2_14" VAL_BLK 0x804EFC66 ValA_Wu16 968.000000000 DINH_FIdVerb 0.00 968.000000000 FORMAT "%13.9" NUMBER 50 /end CHARACTERISTIC
/begin CHARACTERISTIC DINH_FId.DFC_MOXEMM_SMU_ALM2_22_CA "inhibitable FIds / FIds to be inhibited by inhibit source DFC_MOXEMM_SMU_ALM2_22" VAL_BLK 0x804EFCCA ValA_Wu16 968.000000000 DINH_FIdVerb 0.00 968.000000000 FORMAT "%13.9" NUMBER 50 /end CHARACTERISTIC
/begin CHARACTERISTIC DINH_FId.DFC_MOXEMM_SMU_ALM2_23_CA "inhibitable FIds / FIds to be inhibited by inhibit source DFC_MOXEMM_SMU_ALM2_23" VAL_BLK 0x804EFD2E ValA_Wu16 968.000000000 DINH_FIdVerb 0.00 968.000000000 FORMAT "%13.9" NUMBER 50 /end CHARACTERISTIC
/begin CHARACTERISTIC DINH_FId.DFC_MOXEMM_SMU_ALM2_4_CA "inhibitable FIds / FIds to be inhibited by inhibit source DFC_MOXEMM_SMU_ALM2_4" VAL_BLK 0x804EFD92 ValA_Wu16 968.000000000 DINH_FIdVerb 0.00 968.000000000 FORMAT "%13.9" NUMBER 50 /end CHARACTERISTIC
/begin CHARACTERISTIC DINH_FId.DFC_MOXEMM_SMU_ALM2_5_CA "inhibitable FIds / FIds to be inhibited by inhibit source DFC_MOXEMM_SMU_ALM2_5" VAL_BLK 0x804EFDF6 ValA_Wu16 968.000000000 DINH_FIdVerb 0.00 968.000000000 FORMAT "%13.9" NUMBER 50 /end CHARACTERISTIC
/begin CHARACTERISTIC DINH_FId.DFC_MOXEMM_SMU_ALM2_7_CA "inhibitable FIds / FIds to be inhibited by inhibit source DFC_MOXEMM_SMU_ALM2_7" VAL_BLK 0x804EFE5A ValA_Wu16 968.000000000 DINH_FIdVerb 0.00 968.000000000 FORMAT "%13.9" NUMBER 50 /end CHARACTERISTIC
/begin CHARACTERISTIC DINH_FId.DFC_MOXEMM_SMU_ALM2_8_CA "inhibitable FIds / FIds to be inhibited by inhibit source DFC_MOXEMM_SMU_ALM2_8" VAL_BLK 0x804EFEBE ValA_Wu16 968.000000000 DINH_FIdVerb 0.00 968.000000000 FORMAT "%13.9" NUMBER 50 /end CHARACTERISTIC
/begin CHARACTERISTIC DINH_FId.DFC_MOXEMM_SMU_ALM6_0_CA "inhibitable FIds / FIds to be inhibited by inhibit source DFC_MOXEMM_SMU_ALM6_0" VAL_BLK 0x804EFF22 ValA_Wu16 968.000000000 DINH_FIdVerb 0.00 968.000000000 FORMAT "%13.9" NUMBER 50 /end CHARACTERISTIC
/begin CHARACTERISTIC DINH_FId.DFC_MOXEMM_SMU_ALM6_11_CA "inhibitable FIds / FIds to be inhibited by inhibit source DFC_MOXEMM_SMU_ALM6_11" VAL_BLK 0x804EFF86 ValA_Wu16 968.000000000 DINH_FIdVerb 0.00 968.000000000 FORMAT "%13.9" NUMBER 50 /end CHARACTERISTIC
/begin CHARACTERISTIC DINH_FId.DFC_MOXEMM_SMU_ALM6_12_CA "inhibitable FIds / FIds to be inhibited by inhibit source DFC_MOXEMM_SMU_ALM6_12" VAL_BLK 0x804EFFEA ValA_Wu16 968.000000000 DINH_FIdVerb 0.00 968.000000000 FORMAT "%13.9" NUMBER 50 /end CHARACTERISTIC
/begin CHARACTERISTIC DINH_FId.DFC_MOXEMM_SMU_ALM6_14_CA "inhibitable FIds / FIds to be inhibited by inhibit source DFC_MOXEMM_SMU_ALM6_14" VAL_BLK 0x804F004E ValA_Wu16 968.000000000 DINH_FIdVerb 0.00 968.000000000 FORMAT "%13.9" NUMBER 50 /end CHARACTERISTIC
/begin CHARACTERISTIC DINH_FId.DFC_MOXEMM_SMU_ALM6_15_CA "inhibitable FIds / FIds to be inhibited by inhibit source DFC_MOXEMM_SMU_ALM6_15" VAL_BLK 0x804F00B2 ValA_Wu16 968.000000000 DINH_FIdVerb 0.00 968.000000000 FORMAT "%13.9" NUMBER 50 /end CHARACTERISTIC
/begin CHARACTERISTIC DINH_FId.DFC_MOXEMM_SMU_ALM6_17_CA "inhibitable FIds / FIds to be inhibited by inhibit source DFC_MOXEMM_SMU_ALM6_17" VAL_BLK 0x804F0116 ValA_Wu16 968.000000000 DINH_FIdVerb 0.00 968.000000000 FORMAT "%13.9" NUMBER 50 /end CHARACTERISTIC
/begin CHARACTERISTIC DINH_FId.DFC_MOXEMM_SMU_ALM6_18_CA "inhibitable FIds / FIds to be inhibited by inhibit source DFC_MOXEMM_SMU_ALM6_18" VAL_BLK 0x804F017A ValA_Wu16 968.000000000 DINH_FIdVerb 0.00 968.000000000 FORMAT "%13.9" NUMBER 50 /end CHARACTERISTIC
/begin CHARACTERISTIC DINH_FId.DFC_MOXEMM_SMU_ALM6_20_CA "inhibitable FIds / FIds to be inhibited by inhibit source DFC_MOXEMM_SMU_ALM6_20" VAL_BLK 0x804F01DE ValA_Wu16 968.000000000 DINH_FIdVerb 0.00 968.000000000 FORMAT "%13.9" NUMBER 50 /end CHARACTERISTIC
/begin CHARACTERISTIC DINH_FId.DFC_MOXEMM_SMU_ALM6_21_CA "inhibitable FIds / FIds to be inhibited by inhibit source DFC_MOXEMM_SMU_ALM6_21" VAL_BLK 0x804F0242 ValA_Wu16 968.000000000 DINH_FIdVerb 0.00 968.000000000 FORMAT "%13.9" NUMBER 50 /end CHARACTERISTIC
/begin CHARACTERISTIC DINH_FId.DFC_MOXEMM_SMU_ALM6_25_CA "inhibitable FIds / FIds to be inhibited by inhibit source DFC_MOXEMM_SMU_ALM6_25" VAL_BLK 0x804F02A6 ValA_Wu16 968.000000000 DINH_FIdVerb 0.00 968.000000000 FORMAT "%13.9" NUMBER 50 /end CHARACTERISTIC
/begin CHARACTERISTIC DINH_FId.DFC_MOXEMM_SMU_ALM6_4_CA "inhibitable FIds / FIds to be inhibited by inhibit source DFC_MOXEMM_SMU_ALM6_4" VAL_BLK 0x804F030A ValA_Wu16 968.000000000 DINH_FIdVerb 0.00 968.000000000 FORMAT "%13.9" NUMBER 50 /end CHARACTERISTIC
/begin CHARACTERISTIC DINH_FId.DFC_MOXEMM_SMU_ALM6_5_CA "inhibitable FIds / FIds to be inhibited by inhibit source DFC_MOXEMM_SMU_ALM6_5" VAL_BLK 0x804F036E ValA_Wu16 968.000000000 DINH_FIdVerb 0.00 968.000000000 FORMAT "%13.9" NUMBER 50 /end CHARACTERISTIC
/begin CHARACTERISTIC DINH_FId.DFC_MOXEMM_SMU_ALM6_7_CA "inhibitable FIds / FIds to be inhibited by inhibit source DFC_MOXEMM_SMU_ALM6_7" VAL_BLK 0x804F03D2 ValA_Wu16 968.000000000 DINH_FIdVerb 0.00 968.000000000 FORMAT "%13.9" NUMBER 50 /end CHARACTERISTIC
/begin CHARACTERISTIC DINH_FId.DFC_MOXEMM_SMU_ALM6_8_CA "inhibitable FIds / FIds to be inhibited by inhibit source DFC_MOXEMM_SMU_ALM6_8" VAL_BLK 0x804F0436 ValA_Wu16 968.000000000 DINH_FIdVerb 0.00 968.000000000 FORMAT "%13.9" NUMBER 50 /end CHARACTERISTIC
/begin CHARACTERISTIC DINH_FId.DFC_MOXEMM_SMU_ALM7_1_CA "inhibitable FIds / FIds to be inhibited by inhibit source DFC_MOXEMM_SMU_ALM7_1" VAL_BLK 0x804F049A ValA_Wu16 968.000000000 DINH_FIdVerb 0.00 968.000000000 FORMAT "%13.9" NUMBER 50 /end CHARACTERISTIC
/begin CHARACTERISTIC DINH_FId.DFC_MOXEMM_SMU_ALM7_12_CA "inhibitable FIds / FIds to be inhibited by inhibit source DFC_MOXEMM_SMU_ALM7_12" VAL_BLK 0x804F04FE ValA_Wu16 968.000000000 DINH_FIdVerb 0.00 968.000000000 FORMAT "%13.9" NUMBER 50 /end CHARACTERISTIC
/begin CHARACTERISTIC DINH_FId.DFC_MOXEMM_SMU_ALM7_13_CA "inhibitable FIds / FIds to be inhibited by inhibit source DFC_MOXEMM_SMU_ALM7_13" VAL_BLK 0x804F0562 ValA_Wu16 968.000000000 DINH_FIdVerb 0.00 968.000000000 FORMAT "%13.9" NUMBER 50 /end CHARACTERISTIC
/begin CHARACTERISTIC DINH_FId.DFC_MOXEMM_SMU_ALM7_14_CA "inhibitable FIds / FIds to be inhibited by inhibit source DFC_MOXEMM_SMU_ALM7_14" VAL_BLK 0x804F05C6 ValA_Wu16 968.000000000 DINH_FIdVerb 0.00 968.000000000 FORMAT "%13.9" NUMBER 50 /end CHARACTERISTIC
/begin CHARACTERISTIC DINH_FId.DFC_MOXEMM_SMU_ALM7_15_CA "inhibitable FIds / FIds to be inhibited by inhibit source DFC_MOXEMM_SMU_ALM7_15" VAL_BLK 0x804F062A ValA_Wu16 968.000000000 DINH_FIdVerb 0.00 968.000000000 FORMAT "%13.9" NUMBER 50 /end CHARACTERISTIC
/begin CHARACTERISTIC DINH_FId.DFC_MOXEMM_SMU_ALM7_16_CA "inhibitable FIds / FIds to be inhibited by inhibit source DFC_MOXEMM_SMU_ALM7_16" VAL_BLK 0x804F068E ValA_Wu16 968.000000000 DINH_FIdVerb 0.00 968.000000000 FORMAT "%13.9" NUMBER 50 /end CHARACTERISTIC
/begin CHARACTERISTIC DINH_FId.DFC_MOXEMM_SMU_ALM7_17_CA "inhibitable FIds / FIds to be inhibited by inhibit source DFC_MOXEMM_SMU_ALM7_17" VAL_BLK 0x804F06F2 ValA_Wu16 968.000000000 DINH_FIdVerb 0.00 968.000000000 FORMAT "%13.9" NUMBER 50 /end CHARACTERISTIC
/begin CHARACTERISTIC DINH_FId.DFC_MOXEMM_SMU_ALM7_2_CA "inhibitable FIds / FIds to be inhibited by inhibit source DFC_MOXEMM_SMU_ALM7_2" VAL_BLK 0x804F0756 ValA_Wu16 968.000000000 DINH_FIdVerb 0.00 968.000000000 FORMAT "%13.9" NUMBER 50 /end CHARACTERISTIC
/begin CHARACTERISTIC DINH_FId.DFC_MOXEMM_SMU_ALM7_20_CA "inhibitable FIds / FIds to be inhibited by inhibit source DFC_MOXEMM_SMU_ALM7_20" VAL_BLK 0x804F07BA ValA_Wu16 968.000000000 DINH_FIdVerb 0.00 968.000000000 FORMAT "%13.9" NUMBER 50 /end CHARACTERISTIC
/begin CHARACTERISTIC DINH_FId.DFC_MOXEMM_SMU_ALM7_25_CA "inhibitable FIds / FIds to be inhibited by inhibit source DFC_MOXEMM_SMU_ALM7_25" VAL_BLK 0x804F081E ValA_Wu16 968.000000000 DINH_FIdVerb 0.00 968.000000000 FORMAT "%13.9" NUMBER 50 /end CHARACTERISTIC
/begin FUNCTION DINH "30000.27.0_1.0.0Diagnostic Inhibit Handler"
 /begin DEF_CHARACTERISTIC DINH_FId.DFC_ComSRSAChksum_CA DINH_FId.DFC_ComSRSARingCnt_CA DINH_FId.DFC_ComSRSATOut_CA DINH_FId.DFC_ComSRSBChksum_CA DINH_FId.DFC_ComSRSBRingCnt_CA DINH_FId.DFC_ComSRSBTOut_CA DINH_FId.DFC_ComSRSChksum_CA DINH_FId.DFC_ComSRSErr_CA DINH_FId.DFC_ComSRSRingCnt_CA DINH_FId.DFC_ComSRSTOut_CA DINH_FId.DFC_ComVehSpdPndFltTCU_CA DINH_FId.DFC_EbsChartcCurrErr_CA DINH_FId.DFC_EbsSelfDiagErr_CA DINH_FId.DFC_GEVlvPhaCsersIntkB1_CA DINH_FId.DFC_GEVlvPhaPsOpenLoadIntkB1_CA DINH_FId.DFC_GEVlvPhaPsShoToBattIntkB1_CA DINH_FId.DFC_GEVlvPhaPsShoToGndIntkB1_CA DINH_FId.DFC_GbxCANDigPlausErr_CA DINH_FId.DFC_GbxNPos1SRCMax_CA DINH_FId.DFC_GbxNPos1SRCMin_CA DINH_FId.DFC_GbxNPos2SRCMax_CA DINH_FId.DFC_GbxNPos2SRCMin_CA DINH_FId.DFC_GbxNPosAlvChk_CA DINH_FId.DFC_GbxNPosSyncErr_CA DINH_FId.DFC_HEGOS2B1HtrPsMax_CA DINH_FId.DFC_HEGOS2B1HtrPsMin_CA DINH_FId.DFC_HEGOS2B1HtrPsSig_CA DINH_FId.DFC_LinCSErrACG_CA DINH_FId.DFC_LinCSErrAEV_CA DINH_FId.DFC_LinCSErrDCDC_CA DINH_FId.DFC_LinCSErrEBS_CA DINH_FId.DFC_LinHdrTimeoutErrACG_CA DINH_FId.DFC_LinHdrTimeoutErrAEV_CA DINH_FId.DFC_LinHdrTimeoutErrDCDC_CA DINH_FId.DFC_LinHdrTimeoutErrEBS_CA DINH_FId.DFC_LinMsgTimeoutErrACG_CA DINH_FId.DFC_LinMsgTimeoutErrAEV_CA DINH_FId.DFC_LinMsgTimeoutErrDCDC_CA DINH_FId.DFC_LinMsgTimeoutErrEBS_CA DINH_FId.DFC_LinNoStrtComErr_CA DINH_FId.DFC_LowPresOilP_CA DINH_FId.DFC_MisfDetVWhlFrntLeOORHi_CA DINH_FId.DFC_MisfDetVWhlFrntLeRatyHi_CA DINH_FId.DFC_MisfDetVWhlFrntLeRatyLo_CA DINH_FId.DFC_MisfDetVWhlFrntLeStuck_CA DINH_FId.DFC_MisfDetVWhlFrntRiOORHi_CA DINH_FId.DFC_MisfDetVWhlFrntRiRatyHi_CA DINH_FId.DFC_MisfDetVWhlFrntRiRatyLo_CA DINH_FId.DFC_MisfDetVWhlFrntRiStuck_CA DINH_FId.DFC_MisfDetVWhlReLeOORHi_CA DINH_FId.DFC_MisfDetVWhlReLeRatyHi_CA DINH_FId.DFC_MisfDetVWhlReLeRatyLo_CA DINH_FId.DFC_MisfDetVWhlReLeStuck_CA DINH_FId.DFC_MisfDetVWhlReRiOORHi_CA DINH_FId.DFC_MisfDetVWhlReRiRatyHi_CA DINH_FId.DFC_MisfDetVWhlReRiRatyLo_CA DINH_FId.DFC_MisfDetVWhlReRiStuck_CA DINH_FId.DFC_MisfDetdVWhlFrntLePlaus_CA DINH_FId.DFC_MisfDetdVWhlFrntRiPlaus_CA DINH_FId.DFC_MisfDetdVWhlReLePlaus_CA DINH_FId.DFC_MisfDetdVWhlReRiPlaus_CA DINH_FId.DFC_PEnvSigRngMax_CA DINH_FId.DFC_PEnvSigRngMin_CA DINH_FId.DFC_StmFault_CA DINH_FId.DFC_StrtCtOffPth_CA DINH_FId.DFC_StrtCtlErr_CA DINH_FId.DFC_StrtFault_CA DINH_FId.DFC_StrtLckJudg1_CA DINH_FId.DFC_StrtLckJudg2_CA DINH_FId.DFC_StrtOL_CA DINH_FId.DFC_StrtOL2_CA DINH_FId.DFC_StrtSCB_CA DINH_FId.DFC_StrtSCB2_CA DINH_FId.DFC_StrtSCG_CA DINH_FId.DFC_StrtSCG2_CA DINH_FId.DFC_StrtStkRly1_CA DINH_FId.DFC_StrtStkRly2_CA DINH_FId.DFC_TEVEmax_CA DINH_FId.DFC_TEVEmin_CA DINH_FId.DFC_TEVEsig_CA DINH_FId.DFC_UegoHeatrPrfmncLoS1B1_CA DINH_FId.DFC_VehVAllPlaus_CA DINH_FId.DFC_VehVNCSnsrElecFailr_CA DINH_FId.DFC_VehVPlausCan_CA DINH_FId.DFC_VehVPlausFco_CA DINH_FId.DFC_VehVPlausPwr_CA DINH_FId.DFC_VehVPlausV2N_CA DINH_FId.DFC_VehVSpdSnsrAElecFailr_CA DINH_FId.DFC_VehVSpdSnsrBElecFailr_CA DINH_FId.DFC_ClthMax_CA DINH_FId.DFC_IgnClPs_DevComErr_CA DINH_FId.DFC_IgnClPs_LineOl_0_CA DINH_FId.DFC_IgnClPs_LineOl_1_CA DINH_FId.DFC_IgnClPs_LineOl_2_CA DINH_FId.DFC_IgnClPs_LineOl_3_CA DINH_FId.DFC_IgnClPs_LineScb_0_CA DINH_FId.DFC_IgnClPs_LineScb_1_CA DINH_FId.DFC_IgnClPs_LineScb_2_CA DINH_FId.DFC_IgnClPs_LineScb_3_CA DINH_FId.DFC_IgnClPs_LineScg_0_CA DINH_FId.DFC_IgnClPs_LineScg_1_CA DINH_FId.DFC_IgnClPs_LineScg_2_CA DINH_FId.DFC_IgnClPs_LineScg_3_CA DINH_FId.DFC_KRVEKOEVAB_CA DINH_FId.DFC_KRVEKOEVAB0_CA DINH_FId.DFC_KRVEKOEVAB1_CA DINH_FId.DFC_KRVEKOEVAB2_CA DINH_FId.DFC_KRVEKOEVAB3_CA DINH_FId.DFC_UegoSigEcuAsicS1B1_CA DINH_FId.DFC_UegoSigEcuComS1B1_CA DINH_FId.DFC_UegoSigSnsrS1B1_CA DINH_FId.DFC_UegoSigWireOlApesS1B1_CA DINH_FId.DFC_UegoSigWireOlIpeS1B1_CA DINH_FId.DFC_UegoSigWireOlReS1B1_CA DINH_FId.DFC_UegoSigWireRCmpS1B1_CA DINH_FId.DFC_UegoSigWireScbS1B1_CA DINH_FId.DFC_UegoSigWireScgS1B1_CA DINH_FId.DFC_AfsPhyRngHiB1_CA DINH_FId.DFC_AfsPhyRngLoB1_CA DINH_FId.DFC_AirCCmprOL_CA DINH_FId.DFC_AirCCmprOvrTemp_CA DINH_FId.DFC_AirCCmprSCB_CA DINH_FId.DFC_AirCCmprSCG_CA DINH_FId.DFC_AltErr_CA DINH_FId.DFC_BattUSRCMax_CA DINH_FId.DFC_BattUSRCMin_CA DINH_FId.DFC_ComChksTCU1_CA DINH_FId.DFC_ComChksTCU11_CA DINH_FId.DFC_ComChksTCU12_CA DINH_FId.DFC_ComChksTCU13_CA DINH_FId.DFC_ComChksTCU2_CA DINH_FId.DFC_ComChksTCU3_CA DINH_FId.DFC_ComChksTCU4_CA DINH_FId.DFC_ComCntTCU1_CA DINH_FId.DFC_ComCntTCU11_CA DINH_FId.DFC_ComCntTCU12_CA DINH_FId.DFC_ComCntTCU13_CA DINH_FId.DFC_ComCntTCU2_CA DINH_FId.DFC_ComCntTCU3_CA DINH_FId.DFC_ComCntTCU4_CA DINH_FId.DFC_ComTOutTCU01_CA DINH_FId.DFC_ComTOutTCU02_CA DINH_FId.DFC_ComTOutTCU1_CA DINH_FId.DFC_ComTOutTCU11_CA DINH_FId.DFC_ComTOutTCU12_CA DINH_FId.DFC_ComTOutTCU13_CA DINH_FId.DFC_ComTOutTCU14_CA DINH_FId.DFC_ComTOutTCU2_CA DINH_FId.DFC_ComTOutTCU3_CA DINH_FId.DFC_ComTOutTCU4_CA DINH_FId.DFC_DevLibBattUHi_CA DINH_FId.DFC_DevLibBattULo_CA DINH_FId.DFC_EGRVlvFailSafeActv_CA DINH_FId.DFC_EGRVlvGovDvtCld_CA DINH_FId.DFC_EGRVlvPhysSRCMax_CA DINH_FId.DFC_EGRVlvPhysSRCMin_CA DINH_FId.DFC_FanDIOOL_0_CA DINH_FId.DFC_FanDIOOL_1_CA DINH_FId.DFC_FanDIOOvrTemp_0_CA DINH_FId.DFC_FanDIOOvrTemp_1_CA DINH_FId.DFC_FanDIOSCB_0_CA DINH_FId.DFC_FanDIOSCB_1_CA DINH_FId.DFC_FanDIOSCG_0_CA DINH_FId.DFC_FanDIOSCG_1_CA DINH_FId.DFC_MRlyDcOL_CA DINH_FId.DFC_MRlyDcSCB_CA DINH_FId.DFC_MRlyDcSCG_CA DINH_FId.DFC_PSPOL_CA DINH_FId.DFC_PSPOvrTemp_CA DINH_FId.DFC_PSPSCB_CA DINH_FId.DFC_PSPSCG_CA DINH_FId.DFC_T50Err_CA DINH_FId.DFC_ThrVlvLoBattB1_CA DINH_FId.DFC_UegoSigOperPlausS1B1_CA DINH_FId.DFC_VehVPhysRngHi_CA DINH_FId.DFC_VehVSclOutOL_CA DINH_FId.DFC_VehVSclOutOT_CA DINH_FId.DFC_VehVSclOutSCB_CA DINH_FId.DFC_VehVSclOutSCG_CA DINH_FId.DFC_VehVSigFL_CA DINH_FId.DFC_VehVSigFR_CA DINH_FId.DFC_VehVSigRL_CA DINH_FId.DFC_VehVSigRR_CA DINH_FId.DFC_VehVSnsrARngHi_CA DINH_FId.DFC_VehVSnsrBRngHi_CA DINH_FId.DFC_VehVSpdRtyDiag_CA DINH_FId.DFC_DHFHD_CA DINH_FId.DFC_InjVlv_DI_DcDc_CA DINH_FId.DFC_InjVlv_DI_NoLd_0_CA DINH_FId.DFC_InjVlv_DI_NoLd_1_CA DINH_FId.DFC_InjVlv_DI_NoLd_2_CA DINH_FId.DFC_InjVlv_DI_NoLd_3_CA DINH_FId.DFC_InjVlv_DI_ScBnk_0_CA DINH_FId.DFC_InjVlv_DI_ScBnk_1_CA DINH_FId.DFC_InjVlv_DI_ScBnk_2_CA DINH_FId.DFC_InjVlv_DI_ScBnk_3_CA DINH_FId.DFC_InjVlv_DI_ScCyl_0_CA DINH_FId.DFC_InjVlv_DI_ScCyl_1_CA DINH_FId.DFC_InjVlv_DI_ScCyl_2_CA DINH_FId.DFC_InjVlv_DI_ScCyl_3_CA DINH_FId.DFC_InjVlv_DI_ScHsLs_0_CA DINH_FId.DFC_InjVlv_DI_ScHsLs_1_CA DINH_FId.DFC_InjVlv_DI_ScHsLs_2_CA DINH_FId.DFC_InjVlv_DI_ScHsLs_3_CA DINH_FId.DFC_MfPsDiaOpenLoad1_CA DINH_FId.DFC_MfPsDiaScHiS1_CA DINH_FId.DFC_MfPsDiaScHiSLowS1_CA DINH_FId.DFC_MfPsDiaScLowS1_CA DINH_FId.DFC_ACEvpTPhysRngHi_CA DINH_FId.DFC_ACEvpTPhysRngLo_CA DINH_FId.DFC_ACEvpTSRCMax_CA DINH_FId.DFC_ACEvpTSRCMin_CA DINH_FId.DFC_AfsRawSigRngHiB1_CA DINH_FId.DFC_AfsRawSigRngLoB1_CA DINH_FId.DFC_AfsSnsrErrB1_CA DINH_FId.DFC_AirCClntPAnaSRCMax_CA DINH_FId.DFC_AirCClntPAnaSRCMin_CA DINH_FId.DFC_AirCSwtNpl_CA DINH_FId.DFC_AirCSwtSig_CA DINH_FId.DFC_Brk_CA DINH_FId.DFC_BrkBstSensSCB_CA DINH_FId.DFC_BrkBstSensSCG_CA DINH_FId.DFC_BrkSig_CA DINH_FId.DFC_ClthSig_CA DINH_FId.DFC_EGRVlvCurrLim_CA DINH_FId.DFC_EGRVlvOL_CA DINH_FId.DFC_EGRVlvOvrTemp_CA DINH_FId.DFC_EGRVlvSCB_CA DINH_FId.DFC_EGRVlvSCG_CA DINH_FId.DFC_EGRVlvSRCMax_CA DINH_FId.DFC_EGRVlvSRCMin_CA DINH_FId.DFC_HLSDemOvhtEngLim_CA DINH_FId.DFC_OilPSwmpSRCMax_CA DINH_FId.DFC_OilPSwmpSRCMin_CA DINH_FId.DFC_PIntkVUsLineHiB1_CA DINH_FId.DFC_PIntkVUsLineLoB1_CA DINH_FId.DFC_VehVPhysRngLo_CA DINH_FId.DFC_VehVSigCan_CA DINH_FId.DFC_VehVSigCanSafe_CA DINH_FId.DFC_VlvLftFbOilPSnsrIntk11SRCMax_CA DINH_FId.DFC_VlvLftFbOilPSnsrIntk11SRCMin_CA DINH_FId.DFC_ClthNpl_CA DINH_FId.DFC_GbxPNPosnDrvCdn_CA DINH_FId.DFC_GbxPNPosnPlausy_CA DINH_FId.DFC_AfsSigErrLineHiB1_CA DINH_FId.DFC_AfsSigErrLineLoB1_CA DINH_FId.DFC_PEnvCcMax_CA DINH_FId.DFC_PEnvCcMin_CA DINH_FId.DFC_PEnvRngChkMax_CA DINH_FId.DFC_PEnvRngChkMin_CA DINH_FId.DFC_PEnvSnsrPlaus_CA DINH_FId.DFC_UEGOHeatrRlyPsOLS1B1_CA DINH_FId.DFC_UEGOHeatrRlyPsSCBS1B1_CA DINH_FId.DFC_UEGOHeatrRlyPsSCGS1B1_CA DINH_FId.DFC_UegoHeatrWireOlS1B1_CA DINH_FId.DFC_UegoHeatrWireScbS1B1_CA DINH_FId.DFC_UegoHeatrWireScgS1B1_CA DINH_FId.DFC_KnDetSens1PortAMax_CA DINH_FId.DFC_KnDetSens1PortAMin_CA DINH_FId.DFC_KnDetSens1PortBMax_CA DINH_FId.DFC_KnDetSens1PortBMin_CA DINH_FId.DFC_Clth2ONStuck_CA DINH_FId.DFC_Clth2ONStuckLdc_CA DINH_FId.DFC_Clth3ONStuckLdc_CA DINH_FId.DFC_Clth3ONStuckPostDrv_CA DINH_FId.DFC_Clth4ONStuck_CA DINH_FId.DFC_Clth4ONStuckLdc_CA DINH_FId.DFC_ComBCMUnit_CA DINH_FId.DFC_ComDLCTCU01_CA DINH_FId.DFC_ComDLCTCU02_CA DINH_FId.DFC_ComDLCTCU1_CA DINH_FId.DFC_ComDLCTCU11_CA DINH_FId.DFC_ComDLCTCU12_CA DINH_FId.DFC_ComDLCTCU13_CA DINH_FId.DFC_ComDLCTCU14_CA DINH_FId.DFC_ComDLCTCU2_CA DINH_FId.DFC_ComDLCTCU3_CA DINH_FId.DFC_ComDLCTCU4_CA DINH_FId.DFC_ComEPSUnit_CA DINH_FId.DFC_ComIDASBUnit_CA DINH_FId.DFC_ComIMGUnit_CA DINH_FId.DFC_ComMETUnit_CA DINH_FId.DFC_ComSRSUnit_CA DINH_FId.DFC_ComVSAUnit_CA DINH_FId.DFC_EbsSocFlt_CA DINH_FId.DFC_I14229VINErr_CA DINH_FId.DFC_InjCatHeatgErr_CA DINH_FId.DFC_InjSysMulInjDiagErr_CA DINH_FId.DFC_LLRHmax_CA DINH_FId.DFC_LLRHmin_CA DINH_FId.DFC_LLRHnpl_CA DINH_FId.DFC_LLRKHmax_CA DINH_FId.DFC_LLRKHmin_CA DINH_FId.DFC_LLRKHnpl_CA DINH_FId.DFC_LinACGUnit_CA DINH_FId.DFC_LinAEVUnit_CA DINH_FId.DFC_LinEBSUnit_CA DINH_FId.DFC_RoughRoad_CA DINH_FId.DFC_SiaEEPRdErr_CA DINH_FId.DFC_SiaEEPWrngCod_CA DINH_FId.DFC_UegoHeatrStrtS1B1_CA DINH_FId.DFC_BusDiagCANAPPLBusOff_CA DINH_FId.DFC_BusDiagCANCANCBusOff_CA DINH_FId.DFC_BusDiagCANVEHICLEBusOff_CA DINH_FId.DFC_RBA_IODIAGPWR_rba_IoExtCy329_SignalVltSply_0_CA DINH_FId.DFC_RBA_IODIAGPWR_rba_IoExtCy329_SignalVltSply_0OT_CA DINH_FId.DFC_RBA_IODIAGPWR_rba_IoExtCy329_SignalVltSply_0OV_CA DINH_FId.DFC_RBA_IODIAGPWR_rba_IoExtCy329_SignalVltSply_0SCG_CA DINH_FId.DFC_RBA_IODIAGPWR_rba_IoExtCy329_SignalVltSply_0UV_CA DINH_FId.DFC_RBA_IODIAGPWR_rba_IoExtCy329_SignalVltSply_1_CA DINH_FId.DFC_RBA_IODIAGPWR_rba_IoExtCy329_SignalVltSply_1OT_CA DINH_FId.DFC_RBA_IODIAGPWR_rba_IoExtCy329_SignalVltSply_1OV_CA DINH_FId.DFC_RBA_IODIAGPWR_rba_IoExtCy329_SignalVltSply_1SCG_CA DINH_FId.DFC_RBA_IODIAGPWR_rba_IoExtCy329_SignalVltSply_1UV_CA DINH_FId.DFC_RBA_IODIAGPWR_rba_IoExtCy329_SignalVltSply_2_CA DINH_FId.DFC_RBA_IODIAGPWR_rba_IoExtCy329_SignalVltSply_2OT_CA DINH_FId.DFC_RBA_IODIAGPWR_rba_IoExtCy329_SignalVltSply_2OV_CA DINH_FId.DFC_RBA_IODIAGPWR_rba_IoExtCy329_SignalVltSply_2SCG_CA DINH_FId.DFC_RBA_IODIAGPWR_rba_IoExtCy329_SignalVltSply_2UV_CA DINH_FId.DFC_CAN_E_TIMEOUT_CA DINH_FId.DFC_LIN_E_TIMEOUT_CA DINH_FId.DFC_MRlyOL_CA DINH_FId.DFC_MRlySCB_CA DINH_FId.DFC_MRlySCG_CA DINH_FId.DFC_rba_MultiStackTrace_Threshold_CA DINH_FId.DFC_BSWM_E_ACTION_FAILED_CA DINH_FId.DFC_BSWM_E_INTRPTQUEUE_FULL_CA DINH_FId.DFC_RBA_IOEXTLIB_KEEPALIVE_DRV_CA DINH_FId.DFC_RBA_IOEXTLIB_KEEPALIVE_INI_CA DINH_FId.DFC_rba_IoSigRtc_StopCounter_CA DINH_FId.DFC_rba_MRly_Diag_Stk_Event_CA DINH_FId.DFC_rba_MemDiag_MemReadErr_CA DINH_FId.DFC_rba_MemDiag_MemWrErr_CA DINH_FId.DFC_rba_SyC_IrrSwOffTrigEngRun_Event_CA DINH_FId.DFC_rba_T15_Diag_ComInVld_Event_CA DINH_FId.DFC_rba_T15_Diag_ComOff_HwOn_Event_CA DINH_FId.DFC_rba_T15_Diag_ComOn_HwOff_Event_CA DINH_FId.DFC_AAVmin_CA DINH_FId.DFC_AGRSUS_CA DINH_FId.DFC_AfsPlausDiagHi_CA DINH_FId.DFC_AfsPlausDiagLo_CA DINH_FId.DFC_AfsVrntDiagErrB1_CA DINH_FId.DFC_AppAllSnsrDfct_CA DINH_FId.DFC_BBKRnldg_CA DINH_FId.DFC_BBKRsyne_CA DINH_FId.DFC_BattUStdbyDiaOL_CA DINH_FId.DFC_BigLeakIntkMnfldEmiInfl_CA DINH_FId.DFC_BlkdLineTank_CA DINH_FId.DFC_BrkMnSwtContOnWarnLmp_CA DINH_FId.DFC_BrkMnSwtNotStpWarnLmp_CA DINH_FId.DFC_BrkRdntSwtContOnWarnLmp_CA DINH_FId.DFC_BrkRdntSwtNotStpWarnLmp_CA DINH_FId.DFC_CEngDsTColdStrtMax_CA DINH_FId.DFC_CEngDsTColdStrtMin_CA DINH_FId.DFC_CEngDsTImps_CA DINH_FId.DFC_CEngDsTPlausHSC_CA DINH_FId.DFC_CEngDsTPlausLSC_CA DINH_FId.DFC_CEngDsTPlausSTC_CA DINH_FId.DFC_CEngDsTSRCMax_CA DINH_FId.DFC_CEngDsTSRCMin_CA DINH_FId.DFC_CEngDsTSig_CA DINH_FId.DFC_CEngUsTColdStrtMax_CA DINH_FId.DFC_CEngUsTColdStrtMin_CA DINH_FId.DFC_CEngUsTLooseCnctn_CA DINH_FId.DFC_CEngUsTSRCMax_CA DINH_FId.DFC_CEngUsTSRCMin_CA DINH_FId.DFC_ComDCDCACCFailr_CA DINH_FId.DFC_DCDCFltDet_CA DINH_FId.DFC_DKRSA_CA DINH_FId.DFC_DKVSmax_CA DINH_FId.DFC_DKnpl_CA DINH_FId.DFC_DSKVRmax_CA DINH_FId.DFC_DSKVRmin_CA DINH_FId.DFC_DSKVRnpl_CA DINH_FId.DFC_DSKVRsig_CA DINH_FId.DFC_DSKVSsig_CA DINH_FId.DFC_DSSmax_CA DINH_FId.DFC_DSTDmax_CA DINH_FId.DFC_DSTEmax_CA DINH_FId.DFC_DSTEmin_CA DINH_FId.DFC_DSTOFmax_CA DINH_FId.DFC_DSTRmax_CA DINH_FId.DFC_DSTRmin_CA DINH_FId.DFC_DSTRnpl_CA DINH_FId.DFC_DSTRsig_CA DINH_FId.DFC_DSTTI_CA DINH_FId.DFC_DSUmax_CA DINH_FId.DFC_DiagCpv1DteskLoLoadStuckClsd_CA DINH_FId.DFC_DiagCpv1DteskLoLoadStuckOpen_CA DINH_FId.DFC_EGRVlvDrftClsd_CA DINH_FId.DFC_EGRVlvDrftOpn_CA DINH_FId.DFC_EGRVlvJamVlvClsd_CA DINH_FId.DFC_EGRVlvJamVlvOpn_CA DINH_FId.DFC_EGRVlvSprgBrk_CA DINH_FId.DFC_EGRVlvTempMdlEEPErr_CA DINH_FId.DFC_EGRVlvTmpErr_CA DINH_FId.DFC_EGSDUS2B1LtrDly_CA DINH_FId.DFC_EGSDUS2B1LtrPT1_CA DINH_FId.DFC_EGSDUS2B1RtlDly_CA DINH_FId.DFC_EGSDUS2B1RtlPT1_CA DINH_FId.DFC_EGSDUS2B1TarLean_CA DINH_FId.DFC_EGSDUS2B1TarRich_CA DINH_FId.DFC_EONVmax_CA DINH_FId.DFC_ETAKHLmax_CA DINH_FId.DFC_ETAKHTmax_CA DINH_FId.DFC_ETHSEmax_CA DINH_FId.DFC_ETHSEmin_CA DINH_FId.DFC_ETHSFmax_CA DINH_FId.DFC_ETHSFmin_CA DINH_FId.DFC_ETHSFsig_CA DINH_FId.DFC_ETHSNPWmax_CA DINH_FId.DFC_ETHSNPWmin_CA DINH_FId.DFC_ETHSNPWsig_CA DINH_FId.DFC_ETHSPLnpl_CA DINH_FId.DFC_ETHSTPLnpl_CA DINH_FId.DFC_EngICO_CA DINH_FId.DFC_EngPrtOvrSpdMon_CA DINH_FId.DFC_EpmCaSI1ErrSig_CA DINH_FId.DFC_EpmCaSI1MntErr_CA DINH_FId.DFC_EpmCaSI1NoSigMax_CA DINH_FId.DFC_EpmCaSI1NoSigMin_CA DINH_FId.DFC_EpmCaSI1OfsErr_CA DINH_FId.DFC_EpmCrSDGI_CA DINH_FId.DFC_EpmCrSErrSig_CA DINH_FId.DFC_EpmCrSNoSig_CA DINH_FId.DFC_EtaEngIdleNonCsers_CA DINH_FId.DFC_EtaEngPtlNonCsers_CA DINH_FId.DFC_FRAmax_CA DINH_FId.DFC_FRAmin_CA DINH_FId.DFC_FSTEmax_CA DINH_FId.DFC_FSTEmin_CA DINH_FId.DFC_FSTRmax_CA DINH_FId.DFC_FSTRmin_CA DINH_FId.DFC_FSTRnpl_CA DINH_FId.DFC_FSTmax_CA DINH_FId.DFC_FTDLAmax_CA DINH_FId.DFC_FTDLAmin_CA DINH_FId.DFC_FuPHiSnsrEleclmax_CA DINH_FId.DFC_FuPHiSnsrEleclmin_CA DINH_FId.DFC_FuPHiSnsrEleclnpl_CA DINH_FId.DFC_FuPHiSnsrURngMax_CA DINH_FId.DFC_FuPHiSnsrURngMin_CA DINH_FId.DFC_FuSnsrPhyRngMaxErr_CA DINH_FId.DFC_FuSnsrPhyRngMinErr_CA DINH_FId.DFC_GEVlvLockPinDiagIntkB1_CA DINH_FId.DFC_GEVlvPhaSlowIntkB1_CA DINH_FId.DFC_GEVlvPhaTargIntkB1_CA DINH_FId.DFC_GbxRvsSwtStk_CA DINH_FId.DFC_HDRKHmax_CA DINH_FId.DFC_HDRKHmin_CA DINH_FId.DFC_HDRPLmax_CA DINH_FId.DFC_HDRPLmin_CA DINH_FId.DFC_HDRmax_CA DINH_FId.DFC_HDRmin_CA DINH_FId.DFC_HEGOS2B1ElecMax_CA DINH_FId.DFC_HEGOS2B1ElecMin_CA DINH_FId.DFC_HEGOS2B1ElecSig_CA DINH_FId.DFC_HEGOS2B1HtgNpl_CA DINH_FId.DFC_HEV00max_CA DINH_FId.DFC_HEV01max_CA DINH_FId.DFC_HEV02max_CA DINH_FId.DFC_HEV03max_CA DINH_FId.DFC_HEVE0max_CA DINH_FId.DFC_HEVE1max_CA DINH_FId.DFC_HFMmax_CA DINH_FId.DFC_HiPSysHiPMaxLimExcdd_CA DINH_FId.DFC_IVGdiCtlCvoErrMax_0_CA DINH_FId.DFC_IVGdiCtlCvoErrMax_1_CA DINH_FId.DFC_IVGdiCtlCvoErrMax_2_CA DINH_FId.DFC_IVGdiCtlCvoErrMax_3_CA DINH_FId.DFC_IVGdiCtlCvoErrMin_0_CA DINH_FId.DFC_IVGdiCtlCvoErrMin_1_CA DINH_FId.DFC_IVGdiCtlCvoErrMin_2_CA DINH_FId.DFC_IVGdiCtlCvoErrMin_3_CA DINH_FId.DFC_IVGdiCtlCvoErrMinMax_CA DINH_FId.DFC_IVGdiCtlCvoSigPlausErrSmrCdn_CA DINH_FId.DFC_IVGdiCtl_CvoErr_CA DINH_FId.DFC_IVGdiCtl_CvoSigPlaus_0_CA DINH_FId.DFC_IVGdiCtl_CvoSigPlaus_1_CA DINH_FId.DFC_IVGdiCtl_CvoSigPlaus_2_CA DINH_FId.DFC_IVGdiCtl_CvoSigPlaus_3_CA DINH_FId.DFC_IntkAirTAirFltDsCrssMax_CA DINH_FId.DFC_IntkAirTAirFltDsCrssMin_CA DINH_FId.DFC_IntkAirTAirFltDsHSCMax_CA DINH_FId.DFC_IntkAirTAirFltDsImps_CA DINH_FId.DFC_IntkAirTAirFltDsPRCMax_CA DINH_FId.DFC_IntkAirTAirFltDsPRCMin_CA DINH_FId.DFC_IntkAirTAirFltDsSRCMax_CA DINH_FId.DFC_IntkAirTAirFltDsSRCMin_CA DINH_FId.DFC_IntkAirTAirFltDsSTC_CA DINH_FId.DFC_IntkAirTIntkMnfldCrssMax_CA DINH_FId.DFC_IntkAirTIntkMnfldCrssMin_CA DINH_FId.DFC_IntkAirTIntkMnfldHSCMax_CA DINH_FId.DFC_IntkAirTIntkMnfldImps_CA DINH_FId.DFC_IntkAirTIntkMnfldPRCMax_CA DINH_FId.DFC_IntkAirTIntkMnfldPRCMin_CA DINH_FId.DFC_IntkAirTIntkMnfldSRCMax_CA DINH_FId.DFC_IntkAirTIntkMnfldSRCMin_CA DINH_FId.DFC_IntkAirTIntkMnfldSTC_CA DINH_FId.DFC_KRREGRLMX_CA DINH_FId.DFC_KRVEKOCVLCI_CA DINH_FId.DFC_KRVEKOENCHMT_CA DINH_FId.DFC_KRVEKOENCHMT0_CA DINH_FId.DFC_KRVEKOENCHMT1_CA DINH_FId.DFC_KRVEKOENCHMT2_CA DINH_FId.DFC_KRVEKOENCHMT3_CA DINH_FId.DFC_KRVEKOENCHMT4_CA DINH_FId.DFC_KRVEKOENCHMT5_CA DINH_FId.DFC_KRVEKOENCHMT6_CA DINH_FId.DFC_KRVEKOENCHMT7_CA DINH_FId.DFC_KRVEKORLMX_CA DINH_FId.DFC_KRVEKORLMXL_CA DINH_FId.DFC_KS1max_CA DINH_FId.DFC_KS1min_CA DINH_FId.DFC_LMmax_CA DINH_FId.DFC_LZSRnpl_CA DINH_FId.DFC_LamDynDiagS1B1_CA DINH_FId.DFC_LeakIntkMnfldEmiInfl_CA DINH_FId.DFC_LinFrameErrDCDC_CA DINH_FId.DFC_LinOverrunErrDCDC_CA DINH_FId.DFC_MD00max_CA DINH_FId.DFC_MDBmax_CA DINH_FId.DFC_MDCat_CA DINH_FId.DFC_MDCatCrit_CA DINH_FId.DFC_MDCatCurr_CA DINH_FId.DFC_MDCyl_0_CA DINH_FId.DFC_MDCyl_1_CA DINH_FId.DFC_MDCyl_2_CA DINH_FId.DFC_MDCyl_3_CA DINH_FId.DFC_MDEmi_CA DINH_FId.DFC_MDEmiStrt_CA DINH_FId.DFC_MDFco_CA DINH_FId.DFC_MDMpl_CA DINH_FId.DFC_MDSegTiAdpn_CA DINH_FId.DFC_MDmax_CA DINH_FId.DFC_MFuOilMax_CA DINH_FId.DFC_MOXEMM_SMU_ALM0_0_CA DINH_FId.DFC_MOXEMM_SMU_ALM0_1_CA DINH_FId.DFC_MOXEMM_SMU_ALM0_10_CA DINH_FId.DFC_MOXEMM_SMU_ALM0_11_CA DINH_FId.DFC_MOXEMM_SMU_ALM0_13_CA DINH_FId.DFC_MOXEMM_SMU_ALM0_14_CA DINH_FId.DFC_MOXEMM_SMU_ALM0_2_CA DINH_FId.DFC_MOXEMM_SMU_ALM0_22_CA DINH_FId.DFC_MOXEMM_SMU_ALM0_23_CA DINH_FId.DFC_MOXEMM_SMU_ALM0_4_CA DINH_FId.DFC_MOXEMM_SMU_ALM0_5_CA DINH_FId.DFC_MOXEMM_SMU_ALM0_7_CA DINH_FId.DFC_MOXEMM_SMU_ALM0_8_CA DINH_FId.DFC_MOXEMM_SMU_ALM10_16_CA DINH_FId.DFC_MOXEMM_SMU_ALM10_17_CA DINH_FId.DFC_MOXEMM_SMU_ALM10_21_CA DINH_FId.DFC_MOXEMM_SMU_ALM11_0_CA DINH_FId.DFC_MOXEMM_SMU_ALM11_1_CA DINH_FId.DFC_MOXEMM_SMU_ALM11_2_CA DINH_FId.DFC_MOXEMM_SMU_ALM11_3_CA DINH_FId.DFC_MOXEMM_SMU_ALM11_4_CA DINH_FId.DFC_MOXEMM_SMU_ALM11_5_CA DINH_FId.DFC_MOXEMM_SMU_ALM11_8_CA DINH_FId.DFC_MOXEMM_SMU_ALM11_9_CA DINH_FId.DFC_MOXEMM_SMU_ALM1_0_CA DINH_FId.DFC_MOXEMM_SMU_ALM1_1_CA DINH_FId.DFC_MOXEMM_SMU_ALM1_10_CA DINH_FId.DFC_MOXEMM_SMU_ALM1_11_CA DINH_FId.DFC_MOXEMM_SMU_ALM1_13_CA DINH_FId.DFC_MOXEMM_SMU_ALM1_14_CA DINH_FId.DFC_MOXEMM_SMU_ALM1_2_CA DINH_FId.DFC_MOXEMM_SMU_ALM1_22_CA DINH_FId.DFC_MOXEMM_SMU_ALM1_23_CA DINH_FId.DFC_MOXEMM_SMU_ALM1_4_CA DINH_FId.DFC_MOXEMM_SMU_ALM1_5_CA DINH_FId.DFC_MOXEMM_SMU_ALM1_7_CA DINH_FId.DFC_MOXEMM_SMU_ALM1_8_CA DINH_FId.DFC_MOXEMM_SMU_ALM21_0_CA DINH_FId.DFC_MOXEMM_SMU_ALM21_16_CA DINH_FId.DFC_MOXEMM_SMU_ALM21_3_CA DINH_FId.DFC_MOXEMM_SMU_ALM2_1_CA DINH_FId.DFC_MOXEMM_SMU_ALM2_10_CA DINH_FId.DFC_MOXEMM_SMU_ALM2_11_CA DINH_FId.DFC_MOXEMM_SMU_ALM2_13_CA DINH_FId.DFC_MOXEMM_SMU_ALM2_14_CA DINH_FId.DFC_MOXEMM_SMU_ALM2_22_CA DINH_FId.DFC_MOXEMM_SMU_ALM2_23_CA DINH_FId.DFC_MOXEMM_SMU_ALM2_4_CA DINH_FId.DFC_MOXEMM_SMU_ALM2_5_CA DINH_FId.DFC_MOXEMM_SMU_ALM2_7_CA DINH_FId.DFC_MOXEMM_SMU_ALM2_8_CA DINH_FId.DFC_MOXEMM_SMU_ALM6_0_CA DINH_FId.DFC_MOXEMM_SMU_ALM6_11_CA DINH_FId.DFC_MOXEMM_SMU_ALM6_12_CA DINH_FId.DFC_MOXEMM_SMU_ALM6_14_CA DINH_FId.DFC_MOXEMM_SMU_ALM6_15_CA DINH_FId.DFC_MOXEMM_SMU_ALM6_17_CA DINH_FId.DFC_MOXEMM_SMU_ALM6_18_CA DINH_FId.DFC_MOXEMM_SMU_ALM6_20_CA DINH_FId.DFC_MOXEMM_SMU_ALM6_21_CA DINH_FId.DFC_MOXEMM_SMU_ALM6_25_CA DINH_FId.DFC_MOXEMM_SMU_ALM6_4_CA DINH_FId.DFC_MOXEMM_SMU_ALM6_5_CA DINH_FId.DFC_MOXEMM_SMU_ALM6_7_CA DINH_FId.DFC_MOXEMM_SMU_ALM6_8_CA DINH_FId.DFC_MOXEMM_SMU_ALM7_1_CA DINH_FId.DFC_MOXEMM_SMU_ALM7_12_CA DINH_FId.DFC_MOXEMM_SMU_ALM7_13_CA DINH_FId.DFC_MOXEMM_SMU_ALM7_14_CA DINH_FId.DFC_MOXEMM_SMU_ALM7_15_CA DINH_FId.DFC_MOXEMM_SMU_ALM7_16_CA DINH_FId.DFC_MOXEMM_SMU_ALM7_17_CA DINH_FId.DFC_MOXEMM_SMU_ALM7_2_CA DINH_FId.DFC_MOXEMM_SMU_ALM7_20_CA DINH_FId.DFC_MOXEMM_SMU_ALM7_25_CA /end DEF_CHARACTERISTIC
 FUNCTION_VERSION "30000.27.0_1.0.0" /end FUNCTION
/begin COMPU_METHOD DINH_FIdVerb "" TAB_VERB "%6.3" "-" COMPU_TAB_REF DINH_FIdVerb /end COMPU_METHOD
/begin COMPU_VTAB DINH_FIdVerb "" TAB_VERB 969 0 "FId_Unused" 1 "FID_AFRA" 2 "FID_AORA" 3 "FID_ATEH" 4 "FID_ATEL" 5 "FID_ATEN" 6 "FID_ATLDI" 7 "FID_ATLDO" 8 "FID_BEONV" 9 "FId_EGSDCmnSeg1B1Parl" 10 "FID_BAGRA" 11 "FID_BAGRASD" 12 "FID_BDSTOF" 13 "FID_BFVDFRM" 14 "FID_BHOM" 15 "FID_BLLRH" 16 "FID_BLLRKH" 17 "FID_BPLSU" 18 "FID_FRAMBAVMB" 19 "FId_CatHeatgColdStrtReq" 20 "FId_CatHeatgWrmReq" 21 "FId_DSMBDEPHSpOpMode" 22 "FId_EGRVlvCoord" 23 "FId_EGSDO2FuTrmB1" 24 "FId_EGSDO2SnsrMntdRelsS1B1" 25 "FId_EGSDO2_LamOffsFastS1B1" 26 "FId_MisfDetDnAdpnNv" 27 "FId_bascadpncvo" 28 "FID_AGRS" 29 "FID_BBAGR" 30 "FID_BBAGRA" 31 "FID_BGFKMS" 32 "FID_BGMSDKS" 33 "FID_CAGRSUS" 34 "FID_CBGTFUELM" 35 "FID_CBGTHDEV" 36 "FID_CDESVF" 37 "FID_CDETHS" 38 "FID_CDRCTSTRT" 39 "FID_CDSKV" 40 "FID_CDSKVRNO" 41 "FID_CDSKVRPO" 42 "FID_CDSKVRaty" 43 "FID_CDSKVRng" 44 "FID_CDSKVS" 45 "FID_CDSTR" 46 "FID_CDSTTI" 47 "FID_CETHG" 48 "FID_CETHSPLnpl" 49 "FID_CETHSTPLnpl" 50 "FID_CETKHL" 51 "FID_CETKHT" 52 "FID_CGDISTRT" 53 "FID_CGLSRDP" 54 "FID_CHDR" 55 "FID_CHDRKH" 56 "FID_CHDRPL" 57 "FID_CLLKHV" 58 "FID_CLLRHV" 59 "FID_CLZSRDP" 60 "FID_CLZSRHP" 61 "FID_CNLHP" 62 "FID_CNLHP2" 63 "FID_CNLKO2" 64 "FID_CNLKO3" 65 "FID_CNLLP" 66 "FID_CNLPL" 67 "FID_CNLPS" 68 "FID_CNSAD" 69 "FID_CNSAD2" 70 "FID_CPSRB" 71 "FID_CPSRP" 72 "FID_CSTHDR" 73 "FID_CSTRTCTL" 74 "FID_CTESF" 75 "FID_CTESG" 76 "FID_CTHIPSTRT" 77 "FID_CTKACS" 78 "FID_CTMSV" 79 "FID_CTOSP" 80 "FID_DHFERR" 81 "FID_DKRSA" 82 "FID_DLLRBandEndTst" 83 "FID_DLLRShrtTrpSpdRmp" 84 "FID_FEDKAHB" 85 "FID_FEDKAPB" 86 "FID_FEDSSB" 87 "FID_FOFSTP" 88 "FID_FONSTP" 89 "FID_FUEDK" 90 "FID_FVLRA" 91 "FID_KRREGact" 92 "FID_KRREGloc" 93 "FID_LRADLSU" 94 "FID_LRALSVErr" 95 "FID_LRAPLLSU" 96 "FID_LUSTP" 97 "FID_LnKS1" 98 "FID_PLSUV" 99 "FID_PSRMOZDG" 100 "FID_PSRMOZG" 101 "FID_STRTDIA" 102 "FID_STRTSTM" 103 "FID_TFA1CSMW" 104 "FID_TFA2CSMW" 105 "FID_TKACSMW" 106 "FID_TMCSMW" 107 "FID_TOCHOilSwmpTQly" 108 "FID_TOCHTME" 109 "FID_TOSPCSMW" 110 "FID_TSRLX" 111 "FID_UEGOHeatrRlyS1B1" 112 "FID_VehStvSSEOk" 113 "FID_VldtLamPlausMaxS1B1" 114 "FID_VldtLamPlausMinS1B1" 115 "FId_ACClntPSSPMon" 116 "FId_ACCompComCANBusOff" 117 "FId_ACCompComCANErrMtr" 118 "FId_ACComp_HiUTWSnsrErr" 119 "FId_ACComp_LoUTWSnsrErr" 120 "FId_ACComp_PDSnsrErr" 121 "FId_ACComp_VehSpdSnsrErr" 122 "FId_ACCtl_ACStrtCut" 123 "FId_ACCtl_APP1" 124 "FId_ACCtl_APP2" 125 "FId_ACCtl_APPSync" 126 "FId_ACCtl_AcOff" 127 "FId_ACCtl_Clmb" 128 "FId_ACCtl_DK1" 129 "FId_ACCtl_DK2" 130 "FId_ACCtl_DKSync" 131 "FId_ACCtl_VehSpdSnsrErr" 132 "FId_ACCtl_pAC" 133 "FId_ACEvpTCANErr" 134 "FId_ACEvpTFrzVal" 135 "FId_ACEvpTPhysRng" 136 "FId_ACEvpTRplVal" 137 "FId_AFCLFailr" 138 "FId_AFS" 139 "FId_AFSPhyRng" 140 "FId_APP1SigPath" 141 "FId_APP2SigPath" 142 "FId_APPBrkErr" 143 "FId_APPLETVldnErr" 144 "FId_APPLrn" 145 "FId_APPVehVErr" 146 "FId_AccPedDrvModComErr" 147 "FId_AccPedDrvModFailr" 148 "FId_AccPedNMaxLim" 149 "FId_AccPedNMinLim" 150 "FId_AccPedNMinLimBrkApp" 151 "FId_AccPedTrqLim" 152 "FId_AfsDdDiag" 153 "FId_AfsDiagErr" 154 "FId_AfsDiagTst" 155 "FId_AfsPlausDiag" 156 "FId_AfsVrntDiag" 157 "FId_AirCClntPFrzVal" 158 "FId_AirCClntPRplVal" 159 "FId_AirCSwt" 160 "FId_AirDvPAdpnPEnv" 161 "FId_AirDvPAdpnPIntkVUsB1" 162 "FId_AirDvPPSnsrAdpn_PModeActv" 163 "FId_AltACGFailr" 164 "FId_AltAPPErrSt" 165 "FId_AltBattMngtFailr" 166 "FId_AltBrkErrSt" 167 "FId_AltComErr" 168 "FId_AltENGB" 169 "FId_AltElecLoadErr" 170 "FId_AltEnvTErr" 171 "FId_AltFFAltLoadFast" 172 "FId_AltFFAltLoadSlow" 173 "FId_AltIOACGErr" 174 "FId_AltIOACGLinComFailr" 175 "FId_AltIOComErr" 176 "FId_AltLinErr" 177 "FId_AltPwr" 178 "FId_AltVehVErrSt" 179 "FId_AltvCluFail" 180 "FId_BGAGRTS" 181 "FId_BGFKMSEPSR" 182 "FId_BGFKMSEPU" 183 "FId_BGFKMSESumClr" 184 "FId_BGFKMSHFME" 185 "FId_BGFKMSHFMZ" 186 "FId_BGFKMSZPSR" 187 "FId_BGOSCCat1B1" 188 "FId_BGOSCCat2B1" 189 "FId_BattAltFailr" 190 "FId_BattMngtFailr" 191 "FId_BattSigPtd" 192 "FId_BattU2MEDSRC" 193 "FId_BattUDrpPrvOff" 194 "FId_BattUFrzVal" 195 "FId_BattUHiFailrEna" 196 "FId_BattUIMGTCUCANFailr" 197 "FId_BattULoFailrEna" 198 "FId_BattUReplVal" 199 "FId_BattUSRC" 200 "FId_BlwrComErr" 201 "FId_BrkBstMdl" 202 "FId_BrkBstMdlBrkP" 203 "FId_BrkBstMdlBrkSt" 204 "FId_BrkBstMdlEnvP" 205 "FId_BrkBstPDetnInhbn" 206 "FId_BrkBstPMstCylPSnsrFail" 207 "FId_BrkBstPSnsrStuckDetn" 208 "FId_BrkBstSigPath" 209 "FId_BrkBstVehVv" 210 "FId_BrkMnSwtErr" 211 "FId_BrkPFrzVal" 212 "FId_BrkPOilPres" 213 "FId_BrkPReplVal" 214 "FId_BrkPedEngStopEna" 215 "FId_BrkRdntSwtErr" 216 "FId_CAGRSDS" 217 "FId_CEngDsTColdStrt" 218 "FId_CEngDsTColdStrtErr" 219 "FId_CEngDsTHSC" 220 "FId_CEngDsTLSC" 221 "FId_CEngDsTPlausErr" 222 "FId_CEngDsTReplMdlEngStop" 223 "FId_CEngDsTSTC" 224 "FId_CEngDsTSnsrElec" 225 "FId_CEngDsTSwtReplMdl" 226 "FId_CEngUsTColdChkErr" 227 "FId_CEngUsTCrssChk" 228 "FId_CEngUsTElecErr" 229 "FId_CEngUsTSnsrElecErr" 230 "FId_CEngUsTSwtReplMdl" 231 "FId_CInjCatHeatgDiag" 232 "FId_CMSUDKSOM1" 233 "FId_CMSUDKSOM2" 234 "FId_CatHeatgEomShtrpAct" 235 "FId_ChrctlAgrsErr" 236 "FId_ChrctlAgrscf" 237 "FId_ClntTempENGB" 238 "FId_Clth" 239 "FId_Clth2" 240 "FId_Clth3StuckOn" 241 "FId_Clth4" 242 "FId_ClthCAN" 243 "FId_ClthMax" 244 "FId_ClthStk" 245 "FId_ClthStkErr" 246 "FId_ClthStkFailr" 247 "FId_ClthStkOFFStuck" 248 "FId_ClthStkONStuck" 249 "FId_ClthSwtFailr" 250 "FId_CntrShaftFailr" 251 "FId_CoEOMGdiEomErrLcy" 252 "FId_CoESSBlowrVld" 253 "FId_CoETM" 254 "FId_CoETS_StTrqLimErr1" 255 "FId_CoETS_StTrqLimErr2" 256 "FId_CoEngStopEnblStSpEngT" 257 "FId_CoEngStopEnblStSpLSU" 258 "FId_CoEngStopEnblStSpTcT" 259 "FId_CoEngStopEnblSysErr" 260 "FId_CoEngVlvLftSpIntk" 261 "FId_CoPOMStrtgDevStrtr" 262 "FId_CoPOM_FirstStrtAut" 263 "FId_CoTS_SwtOff" 264 "FId_CoVOMACCComFailr" 265 "FId_CoVOMBrkPedISABSigFailr" 266 "FId_CoVOMEngCrkAbort" 267 "FId_CoVOMEngRstrtEnaCdn" 268 "FId_CoVOMISSEng" 269 "FId_ComACRly" 270 "FId_ComAPPSensFail" 271 "FId_ComAPedl" 272 "FId_ComAYCA" 273 "FId_ComAYCAMon" 274 "FId_ComAYCD" 275 "FId_ComAYCDMon" 276 "FId_ComAYCF" 277 "FId_ComAYCFMon" 278 "FId_ComAYCG" 279 "FId_ComAYCGMon" 280 "FId_ComAYCI" 281 "FId_ComAYCIMon" 282 "FId_ComAirPThrUsSnsrErr" 283 "FId_ComAltFail" 284 "FId_ComAppVehSnsrFailr" 285 "FId_ComBCM1" 286 "FId_ComBCM1Mon" 287 "FId_ComBCMUnitCfmdErr" 288 "FId_ComBCMUnitNotTstd" 289 "FId_ComBstCtrl" 290 "FId_ComCANVEHICLEBusOff" 291 "FId_ComCGW1" 292 "FId_ComCGW1Mon" 293 "FId_ComClthSt" 294 "FId_ComConvClth" 295 "FId_ComCrCtlReq" 296 "FId_ComCrsMaiIndcnLampReq" 297 "FId_ComCrsSetIndcnLampReq" 298 "FId_ComDCDCCdn" 299 "FId_ComDCDCErr" 300 "FId_ComDesGearCurr" 301 "FId_ComDetrmAirM" 302 "FId_ComDwnShiftCtrlReq" 303 "FId_ComEAT1" 304 "FId_ComEAT10" 305 "FId_ComEAT10Mon" 306 "FId_ComEAT11" 307 "FId_ComEAT11Mon" 308 "FId_ComEAT12" 309 "FId_ComEAT12Mon" 310 "FId_ComEAT13" 311 "FId_ComEAT13Mon" 312 "FId_ComEAT1Mon" 313 "FId_ComEAT2" 314 "FId_ComEAT2Mon" 315 "FId_ComEAT4" 316 "FId_ComEAT4Mon" 317 "FId_ComEAT6" 318 "FId_ComEAT6Mon" 319 "FId_ComEAT7" 320 "FId_ComEAT7Mon" 321 "FId_ComEAT8" 322 "FId_ComEAT8Mon" 323 "FId_ComEATA" 324 "FId_ComEATAMon" 325 "FId_ComEATB" 326 "FId_ComEATBMon" 327 "FId_ComEATC" 328 "FId_ComEATCMon" 329 "FId_ComEBSSelfDiagErr" 330 "FId_ComECUHwErr" 331 "FId_ComEGRVlvErr" 332 "FId_ComEMSIntAirTemp" 333 "FId_ComEPB" 334 "FId_ComEPBB" 335 "FId_ComEPBBMon" 336 "FId_ComEPBMon" 337 "FId_ComEPS1" 338 "FId_ComEPS1Mon" 339 "FId_ComEPSUnitCfmdErr" 340 "FId_ComEPSUnitNotTstd" 341 "FId_ComEngBrkOvrdInfo" 342 "FId_ComEngBrkOvrdMtr" 343 "FId_ComEngBrkSwErr" 344 "FId_ComEngPosng" 345 "FId_ComEngRPMLim" 346 "FId_ComEngTrqLim" 347 "FId_ComEnvtlAirPSnsrErr" 348 "FId_ComEstmTqNormJdg" 349 "FId_ComEthnlSErr" 350 "FId_ComFlSply" 351 "FId_ComFuCnsBitDurgIdleStop" 352 "FId_ComGEVCntrl" 353 "FId_ComGbxNPosFail" 354 "FId_ComGbxTemp" 355 "FId_ComGwIMG1" 356 "FId_ComGwIMG1Mon" 357 "FId_ComGwIMG3" 358 "FId_ComGwIMG3Mon" 359 "FId_ComGwIMG4" 360 "FId_ComGwIMG4Mon" 361 "FId_ComGwIMG5" 362 "FId_ComGwIMG5Mon" 363 "FId_ComGwIMG6" 364 "FId_ComGwIMG6Mon" 365 "FId_ComHFMSnsrErr" 366 "FId_ComIDASB" 367 "FId_ComIDASBMon" 368 "FId_ComIDASBUnitCfmdErr" 369 "FId_ComIDASBUnitNotTstd" 370 "FId_ComIDASEngFail" 371 "FId_ComIDASEngFailMil" 372 "FId_ComIMGUnitCfmdErr" 373 "FId_ComIMGUnitNotTstd" 374 "FId_ComISG2" 375 "FId_ComIgnCtrl" 376 "FId_ComInjCtrl" 377 "FId_ComIntkAirPSnsrErr" 378 "FId_ComLamCtrl" 379 "FId_ComMETA" 380 "FId_ComMETAMon" 381 "FId_ComMETC" 382 "FId_ComMETCMon" 383 "FId_ComMETD" 384 "FId_ComMETDMon" 385 "FId_ComMETE2" 386 "FId_ComMETE2Mon" 387 "FId_ComMETF" 388 "FId_ComMETFMon" 389 "FId_ComMETG" 390 "FId_ComMETGMon" 391 "FId_ComMETH" 392 "FId_ComMETH2" 393 "FId_ComMETH2Mon" 394 "FId_ComMETHMon" 395 "FId_ComMETI" 396 "FId_ComMETIMon" 397 "FId_ComMETK" 398 "FId_ComMETKMon" 399 "FId_ComMETL" 400 "FId_ComMETLMon" 401 "FId_ComMETM" 402 "FId_ComMETMMon" 403 "FId_ComMETN" 404 "FId_ComMETNMon" 405 "FId_ComMETUnitCfmdErr" 406 "FId_ComMETUnitNotTstd" 407 "FId_ComMisf" 408 "FId_ComMon" 409 "FId_ComNTrbn" 410 "FId_ComODOff" 411 "FId_ComOilLvlLamp" 412 "FId_ComOilPWarnLamp" 413 "FId_ComPASensFail" 414 "FId_ComPBSensFail" 415 "FId_ComPCU" 416 "FId_ComPCUMon" 417 "FId_ComPosActnSpdLimrFctReq" 418 "FId_ComSRS" 419 "FId_ComSRSA" 420 "FId_ComSRSAMon" 421 "FId_ComSRSB" 422 "FId_ComSRSBMon" 423 "FId_ComSRSMon" 424 "FId_ComSRSUnitCfmdErr" 425 "FId_ComSRSUnitNotTstd" 426 "FId_ComSTFlt" 427 "FId_ComSpdLimrDevActvn" 428 "FId_ComTCU01" 429 "FId_ComTCU02" 430 "FId_ComTCU1" 431 "FId_ComTCU11" 432 "FId_ComTCU12" 433 "FId_ComTCU13" 434 "FId_ComTCU14" 435 "FId_ComTCU2" 436 "FId_ComTCU3" 437 "FId_ComTCU4" 438 "FId_ComTCUGear" 439 "FId_ComTarGearDwnShift" 440 "FId_ComTarGearUpShift" 441 "FId_ComThrPosnFail" 442 "FId_ComThrVlv" 443 "FId_ComTrboChrgnErr" 444 "FId_ComTrqAccuracySlow" 445 "FId_ComTrqReqFast" 446 "FId_ComTrqReqSlow" 447 "FId_ComVSAErr" 448 "FId_ComVSAUnitCfmdErr" 449 "FId_ComVSAUnitNotTstd" 450 "FId_ComVehSpdFlLvl" 451 "FId_ComVehSpdFltChk" 452 "FId_ComVehSpdImpsErr" 453 "FId_ComVlvLftCtrl" 454 "FId_ComvolEng" 455 "FId_ConvLdCalcLvrPos" 456 "FId_ConvLdNTrbnCan" 457 "FId_ConvLdOilCoolrPmp" 458 "FId_ConvLdOilTemp" 459 "FId_ConvLdTrqLdCan" 460 "FId_ConvLdVel" 461 "FId_CooltTVldyTMdl" 462 "FId_CptProtnCamsft" 463 "FId_CptProtnExhTempMdl" 464 "FId_CptProtnO2SnsrB1" 465 "FId_CptProtnVVeh" 466 "FId_CrCUI1EFRxErr" 467 "FId_CrCUICANRxErr" 468 "FId_CrCUIFCMRxErr" 469 "FId_CrCUIMETDRxErr" 470 "FId_CrCtlACCRxErr" 471 "FId_CrCtlAppSnsrErr" 472 "FId_CrCtlShutOffEng" 473 "FId_CstrPurgGnrlTstrReq" 474 "FId_DAGRS" 475 "FId_DELibBrkBstP" 476 "FId_DELibCEngDsT" 477 "FId_DELibCEngUsT" 478 "FId_DELibEngDatEng" 479 "FId_DELibEnvP" 480 "FId_DELibEnvT" 481 "FId_DELibFuelT" 482 "FId_DELibIntkAirT" 483 "FId_DELibNRCat" 484 "FId_DELibOilP" 485 "FId_DELibOilSwmpT" 486 "FId_DELibPRelPfilDs" 487 "FId_DELibTEGRClrLPDs" 488 "FId_DEONVEBPEnv" 489 "FId_DEONVTCCpv1DteskLoLoadStuckClsd" 490 "FId_DEONVTCCpv1DteskLoLoadStuckOpen" 491 "FId_DIUMPRCldStrtMon" 492 "FId_DIUMPREvapMon" 493 "FId_DIUMPRGenDenom1" 494 "FId_DIUMPRGenDenom1PDTC" 495 "FId_DIUMPRGenDenom2" 496 "FId_DIUMPRGenDenom3" 497 "FId_DIUMPRIgn" 498 "FId_DOGov" 499 "FId_DSMWarmUpCycle" 500 "FId_DTESKEBCpv1DteskLoLoadStuckClsd" 501 "FId_DTESKEBCpv1DteskLoLoadStuckOpen" 502 "FId_DTESKEnvCondVld" 503 "FId_DTESKFuLvlCondVld" 504 "FId_DTESKvfz" 505 "FId_DdskvFraTstd" 506 "FId_DdskvOraTstd" 507 "FId_DewDetTKAMax" 508 "FId_DiagBlkdLine" 509 "FId_DiagCpv1DteskLoLoad" 510 "FId_DkrsaEpmNoSig" 511 "FId_EBBCANErrFrzVal" 512 "FId_EBBCANErrReplVal" 513 "FId_EGLZSR" 514 "FId_EGRVlvActrOff" 515 "FId_EGRVlvCldStrt" 516 "FId_EGRVlvClnVrfy" 517 "FId_EGRVlvCtrlErr" 518 "FId_EGRVlvEngTempDef" 519 "FId_EGRVlvFailSafeActv" 520 "FId_EGRVlvFrzVal" 521 "FId_EGRVlvGovOn" 522 "FId_EGRVlvGovOnCld" 523 "FId_EGRVlvGovrOnRelsFct" 524 "FId_EGRVlvILimn" 525 "FId_EGRVlvIni" 526 "FId_EGRVlvMon" 527 "FId_EGRVlvOfsLrnInhib" 528 "FId_EGRVlvPhysRng" 529 "FId_EGRVlvPsSwtOff" 530 "FId_EGRVlvPwrStgMonDis" 531 "FId_EGRVlvRplVal" 532 "FId_EGRVlvSSpMon" 533 "FId_EGRVlvSnsrErr" 534 "FId_EGRVlvTempCmp" 535 "FId_EGRVlvTempMdlEEPErr" 536 "FId_EGRVlvTmpErrCnt" 537 "FId_EGRVlvTrlPtr" 538 "FId_EGRVlv_VehvErr" 539 "FId_EGRVlviActIEfcLimn" 540 "FId_EGRVlvpDsbcInvld" 541 "FId_EGSDO2OffsRstDsmS1B1" 542 "FId_EGSDO2_LamOffsSlowS1" 543 "FId_EGSDO2_RstFltSuspcnOffsB1" 544 "FId_EGSDUS2B1DlyEvln" 545 "FId_EGSDUS2B1LtrDly" 546 "FId_EGSDUS2B1LtrPT1" 547 "FId_EGSDUS2B1PT1Evln" 548 "FId_EGSDUS2B1RtlDly" 549 "FId_EGSDUS2B1RtlPT1" 550 "FId_EGSDUS2B1TarEvln" 551 "FId_EGSDUS2B1TarLean" 552 "FId_EGSDUS2B1TarRich" 553 "FId_EGSSigO2S1B1" 554 "FId_ELZSR" 555 "FId_EPBErr" 556 "FId_EPBFrmErr" 557 "FId_EPBFrmErrClth" 558 "FId_ETHSCPErrDrvCyc" 559 "FId_EVPComFailr" 560 "FId_EbsLinErr" 561 "FId_ElecLdComErr" 562 "FId_ElecLdFrzVal" 563 "FId_ElecLdHdLiComErr" 564 "FId_ElecLdRplVal" 565 "FId_ElecLoadEPSComErr" 566 "FId_EngBlkTWrn" 567 "FId_EngCooltTFail" 568 "FId_EngDemTqLimnCamsftErr" 569 "FId_EngDemTqLimnErrThmstHeatCtrlCirc" 570 "FId_EngDemTqLimnOilPmp" 571 "FId_EngDemTrqLimErrAPP" 572 "FId_EngIntkAirFail" 573 "FId_EngPrtErrVehV" 574 "FId_EngSpd30DegFail" 575 "FId_EngStrtEnaEthAdap" 576 "FId_EngStrt_EnaCep" 577 "FId_EngStrt_InjProhb" 578 "FId_EngStrt_VehVInhb" 579 "FId_EngTqRvsnEnaFlg" 580 "FId_EnvTPrimMod" 581 "FId_EnvTPrimModIniVal" 582 "FId_EnvTSensSum" 583 "FId_EnvTtAirFltDs" 584 "FId_EnvTtCEngDsT" 585 "FId_EnvTtIntkMnfld" 586 "FId_EomCvoAllwd" 587 "FId_EpmBCr" 588 "FId_EpmCaSAdapCaSI1" 589 "FId_EpmCaSAdapRstI1" 590 "FId_EpmCaSDiagI1" 591 "FId_EpmCaSErrCaSI1" 592 "FId_EpmCaSOfsDiagCaSI1" 593 "FId_EpmCaSOfsErrCaSI1" 594 "FId_EpmCaSSegI1" 595 "FId_EpmCaSSpdPlausI1" 596 "FId_EpmCrSDiag" 597 "FId_EpmCrSDiagVeh" 598 "FId_EpmCrSErr" 599 "FId_EpmOpMode_ALELock" 600 "FId_EpmOpMode_DirStLock" 601 "FId_EpmRRSCrSFaultCheck" 602 "FId_EpmRRSDGIFaultCheck" 603 "FId_EpmRRSRdCheck" 604 "FId_EpmRRSVehVFaultChck" 605 "FId_EpmSynLockCaSSync" 606 "FId_EpmTmpSuppRvsRotCASI1" 607 "FId_EtaEngIdleNonCsers" 608 "FId_EtaEngPtlNonCsers" 609 "FId_EthnlSnsrErrCdn" 610 "FId_EvapActrCcvElecDiag" 611 "FId_EvapPSnsrTankPhyRngChk" 612 "FId_FanCtlACClntP" 613 "FId_FanCtlACGModFail" 614 "FId_FanCtlAPP1" 615 "FId_FanCtlAPP2" 616 "FId_FanCtlAPPSync" 617 "FId_FanCtlBlowrU" 618 "FId_FanCtlCooltT" 619 "FId_FanCtlCooltT2" 620 "FId_FanCtlEnvT" 621 "FId_FanCtlLiSwtInfo" 622 "FId_FanCtlSpd" 623 "FId_FanCtlTSnsrErr" 624 "FId_FanCtlThr1" 625 "FId_FanCtlThr2" 626 "FId_FcoReq" 627 "FId_FiMFID_rba_MRly_Diag_Stk" 628 "FId_FlComErr" 629 "FId_FlDevPlauDiagFuSnsr" 630 "FId_FlLvlNoSigErr" 631 "FId_FlLvlVehSpdSigErr" 632 "FId_FlLvlVehVErr" 633 "FId_FlMALamDynDiag" 634 "FId_FlSplGAltLin" 635 "FId_FlTnkQnt" 636 "FId_FuMixHotFilmErr" 637 "FId_FuMixUegoErrExcl" 638 "FId_FuPHiRailEthnlSnsrErr" 639 "FId_FuPurg_TEVError" 640 "FId_FuSnsrPhyRngErr" 641 "FId_GEVCtlAVCAdprCBBNWEErrIntk" 642 "FId_GEVCtlAVCAdprIntkB1" 643 "FId_GEVCtlAVCAdprNWSEErrIntk" 644 "FId_GEVCtlAdpnEnaIntk" 645 "FId_GEVCtlAdpnEnaShtrpActv" 646 "FId_GEVCtlClngIntk" 647 "FId_GEVCtlMinOvlIntk" 648 "FId_GEVCtlPOilSnsr" 649 "FId_GEVCtlPhaEnaIntk" 650 "FId_GEVCtlPhaSpTstrIntk" 651 "FId_GEVCtlRefAdpnMntChck" 652 "FId_GEVCtlRefAdpnMntChckTstd" 653 "FId_GEVCtlReqRefAdpnTstrIntk" 654 "FId_GEVCtlReqRefAdpnTstrIntkTstd" 655 "FId_GEVCtlVlvLftEnaIntk" 656 "FId_GEVCtlVlvOpenClsdIntkB1" 657 "FId_GEVlvLockPinDiagIntkB1" 658 "FId_GEVlvPhaDiagEnaCsersIntkB1" 659 "FId_GEVlvPhaDiagEnaIntkB1" 660 "FId_GEVlvPhaPsIntkB1" 661 "FId_GbxAnNeutPosnErr" 662 "FId_GbxCANDigPlausErr" 663 "FId_GbxCANNeutSigErr" 664 "FId_GbxPNPosSig" 665 "FId_GbxPNPosnComErr" 666 "FId_GbxPNPosnDiagDrvCdnRels" 667 "FId_GbxPNPosnDiagDrvCodnHealRels" 668 "FId_GbxPNPosnDiagPlausyRels" 669 "FId_GbxPNPosnSubsVal" 670 "FId_GbxRvsSwtStk" 671 "FId_GbxSnsrSplyUErr" 672 "FId_GbxSpstReqOk" 673 "FId_GlbDaLSumvXPtd" 674 "FId_GslThrVlvSnsrDiagB1" 675 "FId_HEGOS2B1DElec" 676 "FId_HEGOS2B1DHtg" 677 "FId_HEGOS2B1Htg" 678 "FId_HEGOS2B1HtrPsSt" 679 "FId_HEGOS2B1InVld" 680 "FId_HEGOS2B1LSPsDiaDi" 681 "FId_HLSDemBrkFlt" 682 "FId_HLSDemErr1" 683 "FId_HLSDemErr2" 684 "FId_HLSDemIntkAirTemp" 685 "FId_HLSDemMotTemp" 686 "FId_HLSDemMstCyldpVld" 687 "FId_HLSDemSpdClthGearAccrSigErr" 688 "FId_HLSDem_DrvOffSuprt" 689 "FId_HLSDem_DrvOffSuprtBrkHldSys" 690 "FId_HLSDem_DrvOffSuprtLAS" 691 "FId_HLSDem_PModeActv" 692 "FId_HLSDem_TModeActv" 693 "FId_HLSDem_TraSubFcn" 694 "FId_HLSDem_nMaxLimErr1" 695 "FId_HLSDem_nMaxLimErr2" 696 "FId_HLSDem_nMaxLimErr3" 697 "FId_HLSDem_nMaxVErr" 698 "FId_I14229APP" 699 "FId_I14229CANErr" 700 "FId_I14229FlLvlFltComErr" 701 "FId_I14229VTCErr" 702 "FId_IMGISABComErr" 703 "FId_InhbLamDynS1B1" 704 "FId_InhbnBlkdLineDiag" 705 "FId_InhibitAlways" 706 "FId_InhibitNever" 707 "FId_InjSysMulInjDiagErr" 708 "FId_InjVlvPs_Bank1OnlyErr" 709 "FId_InjVlvPs_Bank1Tested" 710 "FId_InjVlvPs_Bank2OnlyErr" 711 "FId_InjVlvPs_Bank2Tested" 712 "FId_InjVlvPs_Bank3OnlyErr" 713 "FId_InjVlvPs_Bank3Tested" 714 "FId_IntkAirTAirFltDsCrssChk" 715 "FId_IntkAirTAirFltDsPlausChk" 716 "FId_IntkAirTIntkMnfldCrssChk" 717 "FId_IntkAirTIntkMnfldPlausChk" 718 "FId_IntkAirTIntkMnfldRepl" 719 "FId_IntkAirTSnsr1Elec" 720 "FId_IntkAirTSnsr1PRC" 721 "FId_IntkAirTSnsr1Sum" 722 "FId_IntkAirTSnsr2Elec" 723 "FId_IntkAirTSnsr2PRC" 724 "FId_IntkAirTSnsr2Sum" 725 "FId_IntkArTempENGB" 726 "FId_LIGovDfrstI" 727 "FId_LIGovUndrBrk" 728 "FId_LINDCDCRxErr" 729 "FId_LLimAppSnsrErr" 730 "FId_LLimAppSnsrSyncErr" 731 "FId_LLimMTVehSpdSnsrErr" 732 "FId_LLimShutOffEng" 733 "FId_LRSEBMisf" 734 "FId_LZSR" 735 "FId_LeakToMnfld" 736 "FId_LeakToMnfldTstd" 737 "FId_LimpHomPsErrInjtr" 738 "FId_LinACGUnitCfmdErr" 739 "FId_LinACGUnitNotTstd" 740 "FId_LinAEVUnitCfmdErr" 741 "FId_LinAEVUnitNotTstd" 742 "FId_LinEBSUnitCfmdErr" 743 "FId_LinEBSUnitNotTstd" 744 "FId_LowPresOilP" 745 "FId_MFlowAirCrkcsSubVal" 746 "FId_MFuOilMax" 747 "FId_MaiLoadSnsr" 748 "FId_MaiShaftFailr" 749 "FId_MfPsDia1" 750 "FId_MisfDetDnAdpn" 751 "FId_MisfDetDnAdpnPlaus" 752 "FId_MisfDetEnvP" 753 "FId_MisfDetSegTiAdpnFco" 754 "FId_MisfDetShtrpAct" 755 "FId_MisfDetStc" 756 "FId_MisfDetV" 757 "FId_MisfDetVWhlFrntLe" 758 "FId_MisfDetVWhlFrntRi" 759 "FId_MisfDetVWhlReLe" 760 "FId_MisfDetVWhlReRi" 761 "FId_NLimVehHalt" 762 "FId_NSHTDAmbT" 763 "FId_NSHTDEngT" 764 "FId_NSHTILimHiAltiLoIdleSp" 765 "FId_NeutPosnFailr" 766 "FId_O2StorgMdlMD" 767 "FId_OilCmbdSen_LvlDfctHW" 768 "FId_OilPCtrlVlvNpl" 769 "FId_OilPFrzVal" 770 "FId_OilPPlaus" 771 "FId_OilPPlausAftRun" 772 "FId_OilPPlausMax" 773 "FId_OilPPlausMin" 774 "FId_OilPPlausT15" 775 "FId_OilPRplVal" 776 "FId_OilPSnsrErr" 777 "FId_OilPSwmpSRC" 778 "FId_OilSwmpTCEngDsTWrmUp" 779 "FId_OilSwmpT_B_tospg" 780 "FId_OilSwmpT_B_tospgg" 781 "FId_OilSwmpT_CmbdSnsrErr" 782 "FId_OilSwmpT_CmbdSnsrTiTErr" 783 "FId_OilSwmpT_EnvT" 784 "FId_OilSwmpT_TSnsrErr" 785 "FId_PEnvMeasVld" 786 "FId_PEnvModel" 787 "FId_PEnvPlausDiagVDD" 788 "FId_PEnvRawVldVDD" 789 "FId_PEnvRefSnsr" 790 "FId_PEnvSigRngVld" 791 "FId_PEnvSnsrPlausVDD" 792 "FId_PEnvVldVDD" 793 "FId_PIDA6SigSrcErr" 794 "FId_PIntkMnfldPlaus" 795 "FId_PIntkVUsElecDiagB1" 796 "FId_PSPCtlDisbl" 797 "FId_PSPCtlIntkAirVapLock" 798 "FId_PSPCtlPreRun" 799 "FId_PSPCtlVapLock" 800 "FId_PSPDiagDisbl" 801 "FId_PTGripConv" 802 "FId_PTGripConvStrt" 803 "FId_PTGripMnlClth" 804 "FId_PTGripMnlClthStrt" 805 "FId_PTTrqRatCANPtd" 806 "FId_PThrVlVUsVldB1" 807 "FId_PThrVlvUsMeasdVldB1" 808 "FId_P_VSE11_Diag" 809 "FId_PrmId03_FltRdnS1B1" 810 "FId_PrmId03_FltUegoS1B1" 811 "FId_RevLck" 812 "FId_RstAdpnPIntkMnfldAfs" 813 "FId_RvsPosnFailr" 814 "FId_SSEEPBRelease" 815 "FId_SSEFCANPRelease" 816 "FId_SSEPTCANPRelease" 817 "FId_SSEStartRelease" 818 "FId_SSEStartReleaseMTCl10" 819 "FId_SSEStartReleaseMTCl100" 820 "FId_SSEStartReleaseMTCl20" 821 "FId_SSEStartReleaseMTCl90" 822 "FId_SSEStartRequest" 823 "FId_SSEStopRelease" 824 "FId_SSEStrtStopRelease" 825 "FId_SSESysOff" 826 "FId_SSEUI2DCSysFailr" 827 "FId_SSEUIBCANErr" 828 "FId_SSEUISysFail" 829 "FId_SiaEEPErr" 830 "FId_SnglWhlErrDiagEna" 831 "FId_StrtCtlAutoCrkModeCdn" 832 "FId_StrtCtlComEngStrtErr" 833 "FId_StrtCtlNPCdnCncl" 834 "FId_StrtCtlNoCpuFailr" 835 "FId_StrtCtlNoFailCanLine" 836 "FId_StrtCtlNoFailPTCanLine" 837 "FId_StrtCtlPNPosnSubsVal" 838 "FId_StrtCtlSTMFailr" 839 "FId_StrtErrShaft" 840 "FId_SumErrHndlg" 841 "FId_SysDiagComErr" 842 "FId_SysDiagModInhbErr" 843 "FId_TOSPM" 844 "FId_TWCCILck" 845 "FId_TWCCILckExtd" 846 "FId_TWCCIRstB1" 847 "FId_TWCCIRstDSMClearB1" 848 "FId_TWCCLsuB1" 849 "FId_TWCCLsuCyc" 850 "FId_TWCCLsuDynB1" 851 "FId_TWCCMisfDetn" 852 "FId_TWCDPriCatParB1" 853 "FId_TWCDPriCatVldnB1" 854 "FId_TankPCpv1DteskLoLoadStuckClsd" 855 "FId_TankPCpv1DteskLoLoadStuckOpen" 856 "FId_TankPSnsrElecChkVld" 857 "FId_ThrVlvMon" 858 "FId_ThrVlvOffsLrnPrmsB1" 859 "FId_TiOffTBasdChkFast" 860 "FId_TiOffTBasdChkSlow" 861 "FId_TiOffVdClk" 862 "FId_TqDecelOffsInhb" 863 "FId_TraAddAirCANPtd" 864 "FId_TraAddClntCANPtd" 865 "FId_TraFwdRvsCluInfo" 866 "FId_TraGbxNPos" 867 "FId_TraGearInfoCanCom" 868 "FId_TraGearInfoDet" 869 "FId_TraGearInfoGearShftActv" 870 "FId_TraGearInfoInfoCan" 871 "FId_TraGearInfoLevPos" 872 "FId_TraGearInfoLoRng" 873 "FId_TraGearInfoRTra" 874 "FId_TraGearInfoRevGear" 875 "FId_TraGearReq" 876 "FId_TraNoShftIdctr" 877 "FId_TraPrtGearCANPtd" 878 "FId_TraPrtGearIndpdtProblem" 879 "FId_TraRPosn" 880 "FId_TraRtnIntfcASTIntv" 881 "FId_TraRtnIntfcIdlSetP" 882 "FId_TraRtnIntfcNMaxCan" 883 "FId_TraRtnIntfcNMaxVel" 884 "FId_TraTrqRedLmpHmeDec" 885 "FId_TraTrqRedLmpHmeInc" 886 "FId_TraTrqRedPTCanErr" 887 "FId_TraTrqRedTIIntvDes" 888 "FId_TraTrqRedTIIntvLead" 889 "FId_TraTrqRedTSCIntvDes" 890 "FId_TraTrqRedTSCIntvLead" 891 "FId_TraTrsmTypHw" 892 "FId_TranIdleDes" 893 "FId_UEGOHeatgUpRglS1B1" 894 "FId_UEGOHeatrCtrlS1B1" 895 "FId_UEGOHeatrPrfmncDiagRelsS1B1" 896 "FId_UEGOHeatrPwrStgDiagRelsS1B1" 897 "FId_UEGOModCtrlRelsS1B1" 898 "FId_UEGOStrtDiagInhRprtErrS1B1" 899 "FId_UEGOStrtDiagRelsS1B1" 900 "FId_UEGOTCeramicRelsS1B1" 901 "FId_UegoDiagRelsBattSplyOk" 902 "FId_UegoDiagSigEcuAsicS1B1" 903 "FId_UegoDiagSigEcuComS1B1" 904 "FId_UegoDiagSigOperPlausS1B1" 905 "FId_UegoDiagSigSnsrS1B1" 906 "FId_UegoDiagSigWireOlS1B1" 907 "FId_UegoDiagSigWireScS1B1" 908 "FId_UegoDiagSigWireScTstdS1B1" 909 "FId_UegoInhbOperRelsS1B1" 910 "FId_UegoO2HiPrcsnS1B1" 911 "FId_UegoO2PlausErrS1B1" 912 "FId_UegoO2VldS1B1" 913 "FId_UegoOperPlausBattSplyOk" 914 "FId_UegoPlausErrHndlg" 915 "FId_VMSIDCSRmpShOff" 916 "FId_VMSIDCSShOff" 917 "FId_VMSITCSRmpShOff" 918 "FId_VMSITCSShOff" 919 "FId_VSACANErr" 920 "FId_VehStcACGFailr" 921 "FId_VehStcBattMngFailr" 922 "FId_VehStcDCDCFailr" 923 "FId_VehStcEBSFailr" 924 "FId_VehStcMisf" 925 "FId_VehStcMtrComFailr" 926 "FId_VehStcNVMFailr" 927 "FId_VehVCANFrzVal" 928 "FId_VehVCANReplVal" 929 "FId_VehVCanSafeFrzVal" 930 "FId_VehVCanSafeReplVal" 931 "FId_VehVCom" 932 "FId_VehVExcdLim" 933 "FId_VehVFrzVal" 934 "FId_VehVNCSnsrElecFailr" 935 "FId_VehVOBDFrzVal" 936 "FId_VehVOBDReplVal" 937 "FId_VehVOutCanErr" 938 "FId_VehVPWMFrzVal" 939 "FId_VehVPWMReplVal" 940 "FId_VehVPhysRng" 941 "FId_VehVPlaus" 942 "FId_VehVPlausCan" 943 "FId_VehVPlausFco" 944 "FId_VehVPlausPwr" 945 "FId_VehVPlausV2N" 946 "FId_VehVReplVal" 947 "FId_VehVSigCan" 948 "FId_VehVSigCanSafe" 949 "FId_VehVSngWhlCanFrzVal" 950 "FId_VehVSngWhlCanReplVal" 951 "FId_VehVSnsrARngHi" 952 "FId_VehVSnsrBRngHi" 953 "FId_VehVSpdRtyDiag" 954 "FId_VehVSpdSnsrAElecFailr" 955 "FId_VehVSpdSnsrBElecFailr" 956 "FId_VehVvFLWhlSpd" 957 "FId_VehVvFRWhlSpd" 958 "FId_VehVvRLWhlSpd" 959 "FId_VehVvRRWhlSpd" 960 "FId_VldtLamDynS1B1" 961 "FId_VlvLftFbIntkOilPSnsr11SRC" 962 "FId_VlvLftFbSwtIntk11Diag" 963 "FId_ZGLZSR" 964 "FId_airIntkFltSnsrKnkPrtnIgn" 965 "FId_ctrladpncvo" 966 "FId_stChkChgnSys" 967 "FId_stChkChgnSys2DC" 968 "FId_tFltSnsrKnkPrtnIgn" DEFAULT_VALUE "---" /end COMPU_VTAB
/begin RECORD_LAYOUT ValA_Wu16 FNC_VALUES 1 UWORD COLUMN_DIR DIRECT /end RECORD_LAYOUT
/end MODULE
/end PROJECT
