ASAP2_VERSION 1 60
/begin PROJECT MG1CS022 "MG1CS022"
/begin HEADER "" VERSION "MG1CS022_62XSC_V037" PROJECT_NO MG1CS022 /end HEADER
/begin MODULE DIM ""
/begin MOD_COMMON "" BYTE_ORDER MSB_LAST ALIGNMENT_BYTE 1 ALIGNMENT_WORD 2 ALIGNMENT_LONG 4 ALIGNMENT_INT64 4 ALIGNMENT_FLOAT32_IEEE 4 ALIGNMENT_FLOAT64_IEEE 4 DATA_SIZE 32 /end MOD_COMMON
/begin CHARACTERISTIC TWCC_drIDLaH2Pri_C "maximum threshold of delta lambda gradient (H2), primary control enable" VALUE 0x8057FF32 RB_Val_Ws16 0.1999969 fak_q3p0518Em6 -0.1000000 0.0999969 FORMAT "%9.7" EXTENDED_LIMITS -0.1000000 0.09999695 /end CHARACTERISTIC
/begin CHARACTERISTIC TWCC_facFlAmpCHModln_C "Amplitude of the fuel modulation during catalyst heating" VALUE 0x8057F840 RB_Val_Wu8 0.249023438 fak_ub_b0p25 0.00 0.249023438 FORMAT "%11.9" /end CHARACTERISTIC
/begin CHARACTERISTIC TWCC_facFlAmpModlnCng_Crv "curve amplitude modulation for CNG" CURVE 0x8057F842 RB_Curve_U16_U8_Static 0.249023438 fak_ub_b0p25 0.00 0.249023438 FORMAT "%11.9"
 /begin AXIS_DESCR STD_AXIS TWCC_mExhGsModln m_uw_b6553p5 6 0.00 6553.500 FORMAT "%8.3" DEPOSIT ABSOLUTE /end AXIS_DESCR
/end CHARACTERISTIC
/begin CHARACTERISTIC TWCC_facFlAmpModln_CUR "Calibration curve of the amplitude of fuel modulation" CURVE 0x8057F856 RB_Curve_U16_U8_Static 0.249023438 fak_ub_b0p25 0.00 0.249023438 FORMAT "%11.9"
 /begin AXIS_DESCR STD_AXIS TWCC_mExhGsModln m_uw_b6553p5 6 0.00 6553.500 FORMAT "%8.3" DEPOSIT ABSOLUTE /end AXIS_DESCR
/end CHARACTERISTIC
/begin CHARACTERISTIC TWCC_facFlAmpOSCModlnCng_Crv "curve amplitude modulation over OSC for CNG" CURVE 0x8057F86A RB_Curve_U8_U8 1.992188 fak_ub_b2 0.00 1.992188 FORMAT "%8.6"
 /begin AXIS_DESCR STD_AXIS TWCC_facOSCCorModln fak_ub_b2 4 0.00 1.992188 FORMAT "%8.6" DEPOSIT ABSOLUTE /end AXIS_DESCR
/end CHARACTERISTIC
/begin CHARACTERISTIC TWCC_facFlAmpOSCModln_CUR "calibration curve of the correction factor of the amplitude of fuel modulation based on catalyst oxygen storage capacity ageing factor" CURVE 0x8057F873 RB_Curve_U8_U8 1.992188 fak_ub_b2 0.00 1.992188 FORMAT "%8.6"
 /begin AXIS_DESCR STD_AXIS TWCC_facOSCCorModln fak_ub_b2 4 0.00 1.992188 FORMAT "%8.6" DEPOSIT ABSOLUTE /end AXIS_DESCR
/end CHARACTERISTIC
/begin CHARACTERISTIC TWCC_facFltActPTPri_C "factor filter actual value with PT1 primary control continuous" VALUE 0x8057F90A RB_Val_Wu16 1.999969 fak_uw_b2 0.00 1.999969 FORMAT "%8.6" /end CHARACTERISTIC
/begin CHARACTERISTIC TWCC_facIGnCtlPriB1_CUR "factor i-part gain controller primary control continuous" CURVE 0x8057F90C RB_Curve_S16_U16_Static 9.999847 fak_q0p00015259 0.00 9.999847 FORMAT "%8.6"
 /begin AXIS_DESCR STD_AXIS ExhMod_dmExhS2B1 m_q0p1 8 -3276.800 3276.700 FORMAT "%8.3" DEPOSIT ABSOLUTE /end AXIS_DESCR
/end CHARACTERISTIC
/begin CHARACTERISTIC TWCC_facIGnCtlSFlPriB1_CUR "factor i-part gain controller second fuel primary control continuous" CURVE 0x8057F92E RB_Curve_S16_U16_Static 9.999847 fak_q0p00015259 0.00 9.999847 FORMAT "%8.6"
 /begin AXIS_DESCR STD_AXIS ExhMod_dmExhS2B1 m_q0p1 8 -3276.800 3276.700 FORMAT "%8.3" DEPOSIT ABSOLUTE /end AXIS_DESCR
/end CHARACTERISTIC
/begin CHARACTERISTIC TWCC_facILamLinPri_CUR "curve for weighting of I part control error, primary control continuous" CURVE 0x8057F950 RB_Curve_S16_S16 1.999969 fak_sw_b1 -1.000000 0.999969 FORMAT "%8.6" EXTENDED_LIMITS -1.000000 0.9999695
 /begin AXIS_DESCR STD_AXIS NO_INPUT_QUANTITY fak_sw_b1 9 -1.000000 0.999969 FORMAT "%8.6" EXTENDED_LIMITS -1.000000 0.9999695 DEPOSIT ABSOLUTE /end AXIS_DESCR
/end CHARACTERISTIC
/begin CHARACTERISTIC TWCC_facILamLinSFlPri_CUR "factor i-part lambda linearisation second fuel primary control continuous" CURVE 0x8057F976 RB_Curve_S16_S16 1.999969 fak_sw_b1 -1.000000 0.999969 FORMAT "%8.6" EXTENDED_LIMITS -1.000000 0.9999695
 /begin AXIS_DESCR STD_AXIS NO_INPUT_QUANTITY fak_sw_b1 9 -1.000000 0.999969 FORMAT "%8.6" EXTENDED_LIMITS -1.000000 0.9999695 DEPOSIT ABSOLUTE /end AXIS_DESCR
/end CHARACTERISTIC
/begin CHARACTERISTIC TWCC_facIOSCAbsPriB1_CUR "factor i-part absolute OSC primary control continuous" CURVE 0x8057F99C RB_Curve_U16_U8_Static 0.9961 fak_ub_b1 0.00 0.9961
 /begin AXIS_DESCR STD_AXIS NO_INPUT_QUANTITY m_q1_mg 4 0.00 65535.00 FORMAT "%8.2" DEPOSIT ABSOLUTE /end AXIS_DESCR
/end CHARACTERISTIC
/begin CHARACTERISTIC TWCC_facIOSCAbsSFlPriB1_CUR "factor i-part absolute OSC second fuel primary control continuous" CURVE 0x8057F9AA RB_Curve_U16_U8_Static 0.9961 fak_ub_b1 0.00 0.9961
 /begin AXIS_DESCR STD_AXIS NO_INPUT_QUANTITY m_q1_mg 4 0.00 65535.00 FORMAT "%8.2" DEPOSIT ABSOLUTE /end AXIS_DESCR
/end CHARACTERISTIC
/begin CHARACTERISTIC TWCC_facIOSCPriB1_CUR "factor i-part OSC primary control continuous" CURVE 0x8057F9B8 RB_Curve_U8_U8 0.9961 fak_ub_b1 0.00 0.9961
 /begin AXIS_DESCR STD_AXIS fcoscxk fak_q0p0078 4 0.00 1.992 FORMAT "%5.3" DEPOSIT ABSOLUTE /end AXIS_DESCR
/end CHARACTERISTIC
/begin CHARACTERISTIC TWCC_facIOSCRlsH2Pri_C "oxygen storage capacity ageing factor threshold for activating H2 debouncing of primary control enable" VALUE 0x8057FF34 RB_Val_Wu16 1.999969 fak_uw_b2 0.00 1.999969 FORMAT "%8.6" /end CHARACTERISTIC
/begin CHARACTERISTIC TWCC_facIOSCSFlPriB1_CUR "factor i-part OSC second fuel primary control continuous" CURVE 0x8057F9C1 RB_Curve_U8_U8 0.9961 fak_ub_b1 0.00 0.9961
 /begin AXIS_DESCR STD_AXIS fcoscxk fak_q0p0078 4 0.00 1.992 FORMAT "%5.3" DEPOSIT ABSOLUTE /end AXIS_DESCR
/end CHARACTERISTIC
/begin CHARACTERISTIC TWCC_facO2SrcModln_C "O2-source factor" VALUE 0x8057F87C RB_Val_Wu8 1.992188 fak_ub_b2 0.00 1.992188 FORMAT "%8.6" /end CHARACTERISTIC
/begin AXIS_PTS TWCC_facOSCPri_GCUR "group curve node based on catalyst OSC ageing factor, primary control enable" 0x8057FF36 TWCC_facOSCPriGCURWpDisp RB_Axis_U16 1.999969 fak_uw_b2 2 0.00 1.999969 FORMAT "%8.6" DEPOSIT ABSOLUTE /end AXIS_PTS
/begin CHARACTERISTIC TWCC_facPGnCtlPriB1_CUR "factor p-part gain controller primary control continuous" CURVE 0x8057F9CA RB_Curve_U16_U8_Static 3.984 fak_ub_b4 0.00 3.984 FORMAT "%5.3"
 /begin AXIS_DESCR STD_AXIS NO_INPUT_QUANTITY m_uw_b6553p5 8 0.00 6553.500 FORMAT "%8.3" DEPOSIT ABSOLUTE /end AXIS_DESCR
/end CHARACTERISTIC
/begin CHARACTERISTIC TWCC_facPGnCtlSFlPriB1_CUR "factor p-part gain controller second fuel primary control continuous" CURVE 0x8057F9E4 RB_Curve_U16_U8_Static 3.984 fak_ub_b4 0.00 3.984 FORMAT "%5.3"
 /begin AXIS_DESCR STD_AXIS NO_INPUT_QUANTITY m_uw_b6553p5 8 0.00 6553.500 FORMAT "%8.3" DEPOSIT ABSOLUTE /end AXIS_DESCR
/end CHARACTERISTIC
/begin CHARACTERISTIC TWCC_facPLamLinPri_CUR "curve for weighting of P part control error, primary control continuous" CURVE 0x8057F9FE RB_Curve_S16_S16 1.999969 fak_sw_b1 -1.000000 0.999969 FORMAT "%8.6" EXTENDED_LIMITS -1.000000 0.9999695
 /begin AXIS_DESCR STD_AXIS NO_INPUT_QUANTITY fak_sw_b1 9 -1.000000 0.999969 FORMAT "%8.6" EXTENDED_LIMITS -1.000000 0.9999695 DEPOSIT ABSOLUTE /end AXIS_DESCR
/end CHARACTERISTIC
/begin CHARACTERISTIC TWCC_facPLamLinSFlPri_CUR "factor p-part lambda linearisation second fuel primary control continuous" CURVE 0x8057FA24 RB_Curve_S16_S16 1.999969 fak_sw_b1 -1.000000 0.999969 FORMAT "%8.6" EXTENDED_LIMITS -1.000000 0.9999695
 /begin AXIS_DESCR STD_AXIS NO_INPUT_QUANTITY fak_sw_b1 9 -1.000000 0.999969 FORMAT "%8.6" EXTENDED_LIMITS -1.000000 0.9999695 DEPOSIT ABSOLUTE /end AXIS_DESCR
/end CHARACTERISTIC
/begin CHARACTERISTIC TWCC_facPOSCAbsPriB1_CUR "factor p-part absolute OSC primary control continuous" CURVE 0x8057FA4A RB_Curve_U16_U8_Static 0.9961 fak_ub_b1 0.00 0.9961
 /begin AXIS_DESCR STD_AXIS NO_INPUT_QUANTITY m_q1_mg 4 0.00 65535.00 FORMAT "%8.2" DEPOSIT ABSOLUTE /end AXIS_DESCR
/end CHARACTERISTIC
/begin CHARACTERISTIC TWCC_facPOSCAbsSFlPriB1_CUR "factor p-part absolute OSC second fuel primary control continuous" CURVE 0x8057FA58 RB_Curve_U16_U8_Static 0.9961 fak_ub_b1 0.00 0.9961
 /begin AXIS_DESCR STD_AXIS NO_INPUT_QUANTITY m_q1_mg 4 0.00 65535.00 FORMAT "%8.2" DEPOSIT ABSOLUTE /end AXIS_DESCR
/end CHARACTERISTIC
/begin CHARACTERISTIC TWCC_facPOSCPriB1_CUR "factor p-part OSC primary control continuous" CURVE 0x8057FA66 RB_Curve_U8_U8 0.9961 fak_ub_b1 0.00 0.9961
 /begin AXIS_DESCR STD_AXIS fcoscxk fak_q0p0078 4 0.00 1.992 FORMAT "%5.3" DEPOSIT ABSOLUTE /end AXIS_DESCR
/end CHARACTERISTIC
/begin CHARACTERISTIC TWCC_facPOSCSFlPriB1_CUR "factor p-part OSC second fuel primary control continuous" CURVE 0x8057FA6F RB_Curve_U8_U8 0.9961 fak_ub_b1 0.00 0.9961
 /begin AXIS_DESCR STD_AXIS fcoscxk fak_q0p0078 4 0.00 1.992 FORMAT "%5.3" DEPOSIT ABSOLUTE /end AXIS_DESCR
/end CHARACTERISTIC
/begin CHARACTERISTIC TWCC_facTempGslCorrnPri_T "Characteristic curve for downstream sensor voltage based on temperature of the main catalyst" CURVE 0x8057FA78 RB_Curve_S16_U8_Static 0.9961 fak_ub_b1 0.00 0.9961
 /begin AXIS_DESCR STD_AXIS NO_INPUT_QUANTITY Temp_Cels 6 -3549.940 3003.560 FORMAT "%8.3" DEPOSIT ABSOLUTE /end AXIS_DESCR
/end CHARACTERISTIC
/begin CHARACTERISTIC TWCC_flgCtrlrRstDSMPri_CW "Code bit for resetting the controller in fault memory clearing irrespective of a check if faults are present which can lead to a false learning of the controller" VALUE 0x8057FA8C RB_Val_Wu8 1.00000000000 B_TRUE 0.00 1.00000000000 FORMAT "%13.11" /end CHARACTERISTIC
/begin CHARACTERISTIC TWCC_flgCtrlrRstInitPri_CW "Codebit only for calibration purpose: By reset (Ini): Resetting the controller with the value TWCC_rICtlI- nitPriB1(2)." VALUE 0x8057FA8D RB_Val_Wu8 1.00000000000 B_TRUE 0.00 1.00000000000 FORMAT "%13.11" /end CHARACTERISTIC
/begin CHARACTERISTIC TWCC_flgCtrlrRstPri_CW "Codebit only for calibration purpose: By reset (by deletion of fault memory): Resetting the controller with the value TWCC_rICtlInitPriB1(2)." VALUE 0x8057FA8E RB_Val_Wu8 1.00000000000 B_TRUE 0.00 1.00000000000 FORMAT "%13.11" /end CHARACTERISTIC
/begin CHARACTERISTIC TWCC_flgCtrlrRstSelnInitPri_CW "Codebit to enable resetting the controller during initialization." VALUE 0x8057FA8F RB_Val_Wu8 1.00000000000 B_TRUE 0.00 1.00000000000 FORMAT "%13.11" /end CHARACTERISTIC
/begin CHARACTERISTIC TWCC_flgDiPGlbBalPriCatHeatgEnad_C "Flag to disable p-part debouncing when catalyst heating is enabled, primary control" VALUE 0x8057FF3C RB_Val_Wu8 1.00000000000 B_TRUE 0.00 1.00000000000 FORMAT "%13.11" /end CHARACTERISTIC
/begin CHARACTERISTIC TWCC_flgEnaSpFilPri_C "flag to activate setpoint-filter, primary continuous TWC-Control" VALUE 0x8057FA90 RB_Val_Wu8 1.00000000000 B_TRUE 0.00 1.00000000000 FORMAT "%13.11" /end CHARACTERISTIC
/begin CHARACTERISTIC TWCC_flgInhbFixPerModlnCH_CW "flag to inhibit fixed period modulation in case of active catalyst heating." VALUE 0x8057F87D RB_Val_Wu8 1.00000000000 B_TRUE 0.00 1.00000000000 FORMAT "%13.11" /end CHARACTERISTIC
/begin CHARACTERISTIC TWCC_flgPGlbRlNmotPri_CW "Disabling of P component based on current engine speed and air charge" VALUE 0x8057FF3D RB_Val_Wu8 1.00000000000 B_TRUE 0.00 1.00000000000 FORMAT "%13.11" /end CHARACTERISTIC
/begin CHARACTERISTIC TWCC_flgUCorrnActv_C "Activation of the sensor correction with catalyst temperature and age" VALUE 0x8057FA91 RB_Val_Wu8 1.00000000000 B_TRUE 0.00 1.00000000000 FORMAT "%13.11" /end CHARACTERISTIC
/begin CHARACTERISTIC TWCC_flguSetPApplPri_CW "Calibration flag to activate a constant voltage setpoint of primary catalyst control" VALUE 0x8057FA92 RB_Val_Wu8 1.00000000000 B_TRUE 0.00 1.00000000000 FORMAT "%13.11" /end CHARACTERISTIC
/begin CHARACTERISTIC TWCC_mAddO2LimHiModlnCng_Crv "Offset for calibration of the upper limit of the O2 level for balanced fuel modulation, CNG operation" CURVE 0x8057F87E RB_CurveGroup_U16 65535.00 m_q1_mg 0.00 65535.00 FORMAT "%8.2"
 /begin AXIS_DESCR COM_AXIS TWCC_mEffO2ModlnGCrvWpDisp m_q1_mg 6 0.00 65535.00 FORMAT "%8.2" AXIS_PTS_REF TWCC_mEffO2Modln_GCUR /end AXIS_DESCR
/end CHARACTERISTIC
/begin CHARACTERISTIC TWCC_mAddO2LimHiModln_CUR "Offset for calibration of the upper limit of the O2 level for balanced fuel modulation" CURVE 0x8057F88A RB_CurveGroup_U16 65535.00 m_q1_mg 0.00 65535.00 FORMAT "%8.2"
 /begin AXIS_DESCR COM_AXIS TWCC_mEffO2ModlnGCrvWpDisp m_q1_mg 6 0.00 65535.00 FORMAT "%8.2" AXIS_PTS_REF TWCC_mEffO2Modln_GCUR /end AXIS_DESCR
/end CHARACTERISTIC
/begin CHARACTERISTIC TWCC_mAddO2TrgHiModlnCng_Crv "calibration curve for the upper switching level of O2 level for balanced fuel modulation, CNG operation" CURVE 0x8057F896 RB_CurveGroup_U16 65535.00 m_q1_mg 0.00 65535.00 FORMAT "%8.2"
 /begin AXIS_DESCR COM_AXIS TWCC_mEffO2ModlnGCrvWpDisp m_q1_mg 6 0.00 65535.00 FORMAT "%8.2" AXIS_PTS_REF TWCC_mEffO2Modln_GCUR /end AXIS_DESCR
/end CHARACTERISTIC
/begin CHARACTERISTIC TWCC_mAddO2TrgHiModln_CUR "calibration curve for the upper switching level of O2 level for balanced fuel modulation" CURVE 0x8057F8A2 RB_CurveGroup_U16 65535.00 m_q1_mg 0.00 65535.00 FORMAT "%8.2"
 /begin AXIS_DESCR COM_AXIS TWCC_mEffO2ModlnGCrvWpDisp m_q1_mg 6 0.00 65535.00 FORMAT "%8.2" AXIS_PTS_REF TWCC_mEffO2Modln_GCUR /end AXIS_DESCR
/end CHARACTERISTIC
/begin AXIS_PTS TWCC_mEffO2Modln_GCUR "sample points OSC" 0x8057F8AE TWCC_mEffO2ModlnGCrvWpDisp RB_Axis_U16 65535.00 m_q1_mg 6 0.00 65535.00 FORMAT "%8.2" DEPOSIT ABSOLUTE /end AXIS_PTS
/begin CHARACTERISTIC TWCC_mIBalFirstStrtPri_T "mass i-part first start balanced primary control enable" CURVE 0x8057FF3E RB_CurveGroup_U16 46602.67 m_q0p711_g 0.00 46602.67 FORMAT "%8.2"
 /begin AXIS_DESCR COM_AXIS TWCC_facOSCPriGCURWpDisp fak_uw_b2 2 0.00 1.999969 FORMAT "%8.6" AXIS_PTS_REF TWCC_facOSCPri_GCUR /end AXIS_DESCR
/end CHARACTERISTIC
/begin CHARACTERISTIC TWCC_mIBalPPri_CUR "Exhaust mass threshold for I-part release based on P-part debounce integral" CURVE 0x8057FF42 RB_CurveGroup_U16 7281.667 m_uw_b7281 0.00 7281.667 FORMAT "%8.3"
 /begin AXIS_DESCR COM_AXIS TWCC_facOSCPriGCURWpDisp fak_uw_b2 2 0.00 1.999969 FORMAT "%8.6" AXIS_PTS_REF TWCC_facOSCPri_GCUR /end AXIS_DESCR
/end CHARACTERISTIC
/begin CHARACTERISTIC TWCC_mIBalReStrtPri_T "mass i-part restart balanced primary control enable" CURVE 0x8057FF46 RB_CurveGroup_U16 46602.67 m_q0p711_g 0.00 46602.67 FORMAT "%8.2"
 /begin AXIS_DESCR COM_AXIS TWCC_facOSCPriGCURWpDisp fak_uw_b2 2 0.00 1.999969 FORMAT "%8.6" AXIS_PTS_REF TWCC_facOSCPri_GCUR /end AXIS_DESCR
/end CHARACTERISTIC
/begin CHARACTERISTIC TWCC_mIOscRlsH2Pri_C "threshold for O2 model of H2 based I-part release, primary control" VALUE 0x8057FF4A RB_Val_Wu16 1310.700 m_q0p02_mgO2 0.00 1310.700 FORMAT "%8.3" /end CHARACTERISTIC
/begin CHARACTERISTIC TWCC_mO2TrgLoModlnCng_Crv "calibration curve for the lower switching level of O2 level for balanced fuel modulation, CNG" CURVE 0x8057F8BC RB_CurveGroup_U16 65535.00 m_q1_mg 0.00 65535.00 FORMAT "%8.2"
 /begin AXIS_DESCR COM_AXIS TWCC_mEffO2ModlnGCrvWpDisp m_q1_mg 6 0.00 65535.00 FORMAT "%8.2" AXIS_PTS_REF TWCC_mEffO2Modln_GCUR /end AXIS_DESCR
/end CHARACTERISTIC
/begin CHARACTERISTIC TWCC_mO2TrgLoModln_CUR "calibration curve for the lower switching level of O2 level for balanced fuel modulation" CURVE 0x8057F8C8 RB_CurveGroup_U16 65535.00 m_q1_mg 0.00 65535.00 FORMAT "%8.2"
 /begin AXIS_DESCR COM_AXIS TWCC_mEffO2ModlnGCrvWpDisp m_q1_mg 6 0.00 65535.00 FORMAT "%8.2" AXIS_PTS_REF TWCC_mEffO2Modln_GCUR /end AXIS_DESCR
/end CHARACTERISTIC
/begin CHARACTERISTIC TWCC_mPBalPri_CUR "Exhaust mass threshold of debouncing of P-part release, primary control" CURVE 0x8057FF4C RB_CurveGroup_U16 46602.67 m_q0p711_g 0.00 46602.67 FORMAT "%8.2"
 /begin AXIS_DESCR COM_AXIS TWCC_facOSCPriGCURWpDisp fak_uw_b2 2 0.00 1.999969 FORMAT "%8.6" AXIS_PTS_REF TWCC_facOSCPri_GCUR /end AXIS_DESCR
/end CHARACTERISTIC
/begin CHARACTERISTIC TWCC_nIMaxPri_C "Maximum engine speed, I-part release, primary control" VALUE 0x8057FF50 RB_Val_Wu16 32767.50 EngN 0.00 32767.50 FORMAT "%8.2" /end CHARACTERISTIC
/begin CHARACTERISTIC TWCC_nIMinPri_C "Minimum engine speed, I-part release, primary control" VALUE 0x8057FF52 RB_Val_Wu16 32767.50 EngN 0.00 32767.50 FORMAT "%8.2" /end CHARACTERISTIC
/begin CHARACTERISTIC TWCC_nPMaxPri_C "Maximum engine speed, P-part release, primary control" VALUE 0x8057FF54 RB_Val_Wu16 32767.50 EngN 0.00 32767.50 FORMAT "%8.2" /end CHARACTERISTIC
/begin CHARACTERISTIC TWCC_nPMinPri_C "Minimum engine speed, P-part release, primary control" VALUE 0x8057FF56 RB_Val_Wu16 32767.50 EngN 0.00 32767.50 FORMAT "%8.2" /end CHARACTERISTIC
/begin CHARACTERISTIC TWCC_rDynSetPIniPri_CUR "Initial value of relative dynamic set point correction of primary catalyst control continuous" CURVE 0x8057FA94 RB_Curve_S16_S16 1.999969 fak_sw_b1 -1.000000 0.999969 FORMAT "%8.6" EXTENDED_LIMITS -1.000000 0.9999695
 /begin AXIS_DESCR STD_AXIS NO_INPUT_QUANTITY fak_q0p0078 2 0.00 1.992188 FORMAT "%8.6" EXTENDED_LIMITS -256.0000 255.9922 DEPOSIT ABSOLUTE /end AXIS_DESCR
/end CHARACTERISTIC
/begin CHARACTERISTIC TWCC_rDynSetPIniSFlPri_CUR "Initial value of relative dynamic set point correction of primary catalyst control continuous, second fuel" CURVE 0x8057FA9E RB_Curve_S16_S16 1.999969 fak_sw_b1 -1.000000 0.999969 FORMAT "%8.6" EXTENDED_LIMITS -1.000000 0.9999695
 /begin AXIS_DESCR STD_AXIS NO_INPUT_QUANTITY fak_q0p0078 2 0.00 1.992188 FORMAT "%8.6" EXTENDED_LIMITS -256.0000 255.9922 DEPOSIT ABSOLUTE /end AXIS_DESCR
/end CHARACTERISTIC
/begin CHARACTERISTIC TWCC_rDynStrtSetPIniPri_CUR "Relative dynamic set point after start initialize primary control continuous" CURVE 0x8057FAA8 RB_Curve_S16_S16 1.999969 fak_sw_b1 -1.000000 0.999969 FORMAT "%8.6" EXTENDED_LIMITS -1.000000 0.9999695
 /begin AXIS_DESCR STD_AXIS NO_INPUT_QUANTITY fak_q0p0078 2 0.00 1.992188 FORMAT "%8.6" EXTENDED_LIMITS -256.0000 255.9922 DEPOSIT ABSOLUTE /end AXIS_DESCR
/end CHARACTERISTIC
/begin CHARACTERISTIC TWCC_rDynStrtSetPIniSFlPri_CUR "Relative dynamic set point after start initialize second fuel primary control continuous" CURVE 0x8057FAB2 RB_Curve_S16_S16 1.999969 fak_sw_b1 -1.000000 0.999969 FORMAT "%8.6" EXTENDED_LIMITS -1.000000 0.9999695
 /begin AXIS_DESCR STD_AXIS NO_INPUT_QUANTITY fak_q0p0078 2 0.00 1.992188 FORMAT "%8.6" EXTENDED_LIMITS -256.0000 255.9922 DEPOSIT ABSOLUTE /end AXIS_DESCR
/end CHARACTERISTIC
/begin CHARACTERISTIC TWCC_rICtlInitPriB1_C "relative i-part control value initialize primary control continuous" VALUE 0x8057FABC RB_Val_Ws16 1.999969 fak_sw_b1 -1.000000 0.999969 FORMAT "%8.6" EXTENDED_LIMITS -1.000000 0.9999695 /end CHARACTERISTIC
/begin CHARACTERISTIC TWCC_rIDecLdPri_C "maximum decreasing load, I-part release, primary control" VALUE 0x8057FF58 RB_Val_Ws16 1535.977 rel_q0p02344 -768.0000 767.9766 FORMAT "%8.4" /end CHARACTERISTIC
/begin CHARACTERISTIC TWCC_rIDLaH2Pri_C "delta lambda threshold for reset O2 model, i-part inhibit based on H2, primary control" VALUE 0x8057FF5A RB_Val_Ws16 1.999969 fak_q3p0518Em5 -1.000000 0.999969 FORMAT "%8.6" EXTENDED_LIMITS -1.000000 0.9999695 /end CHARACTERISTIC
/begin CHARACTERISTIC TWCC_rIFlCPPri_C "relative fuel threshold by canister purge, i-part primary control enable" VALUE 0x8057FF5C RB_Val_Wu16 0.9999847 fak_uw_b1 0.00 0.9999847 FORMAT "%9.7" /end CHARACTERISTIC
/begin CHARACTERISTIC TWCC_rIIncLdPri_C "maximum increasing load, I-part release, primary control" VALUE 0x8057FF5E RB_Val_Ws16 1535.977 rel_q0p02344 -768.0000 767.9766 FORMAT "%8.4" /end CHARACTERISTIC
/begin CHARACTERISTIC TWCC_rILamMaxPri_C "relative i-part lambda maximum limit primary control" VALUE 0x8057FABE RB_Val_Ws16 1.999969 fak_sw_b1 -1.000000 0.999969 FORMAT "%8.6" EXTENDED_LIMITS -1.000000 0.9999695 /end CHARACTERISTIC
/begin CHARACTERISTIC TWCC_rILamMinPri_C "relative i-part lambda minimum limit primary control" VALUE 0x8057FAC0 RB_Val_Ws16 1.999969 fak_sw_b1 -1.000000 0.999969 FORMAT "%8.6" EXTENDED_LIMITS -1.000000 0.9999695 /end CHARACTERISTIC
/begin CHARACTERISTIC TWCC_rILdMaxPri_CUR "relative load maximum i-part primary control enable" CURVE 0x8057FF60 RB_Curve_U16_U16 1535.977 rel_q0p02344 0.00 1535.977 FORMAT "%8.3"
 /begin AXIS_DESCR STD_AXIS Epm_nEng EngN 8 0.00 32767.50 FORMAT "%8.2" DEPOSIT ABSOLUTE /end AXIS_DESCR
/end CHARACTERISTIC
/begin CHARACTERISTIC TWCC_rILdMinPri_CUR "relative load minimum i-part primary control enable" CURVE 0x8057FF82 RB_Curve_U16_U16 1535.977 rel_q0p02344 0.00 1535.977 FORMAT "%8.3"
 /begin AXIS_DESCR STD_AXIS Epm_nEng EngN 8 0.00 32767.50 FORMAT "%8.2" DEPOSIT ABSOLUTE /end AXIS_DESCR
/end CHARACTERISTIC
/begin CHARACTERISTIC TWCC_rLamCtlMaxPri_C "Maximum of relative lambda control value of primary catalyst control continuous" VALUE 0x8057FAC2 RB_Val_Ws16 1.999969 fak_sw_b1 -1.000000 0.999969 FORMAT "%8.6" EXTENDED_LIMITS -1.000000 0.9999695 /end CHARACTERISTIC
/begin CHARACTERISTIC TWCC_rLamCtlMinPri_C "Minimum of relative lambda control value of primary catalyst control continuous" VALUE 0x8057FAC4 RB_Val_Ws16 1.999969 fak_sw_b1 -1.000000 0.999969 FORMAT "%8.6" EXTENDED_LIMITS -1.000000 0.9999695 /end CHARACTERISTIC
/begin CHARACTERISTIC TWCC_rPBalDLaPri_MAP "relative p-part balancing delta lambda primary control continuous" MAP 0x8057FAC6 RB_Map_S16S16_S16 1.999969 fak_sw_b1 -1.000000 0.999969 FORMAT "%8.6" EXTENDED_LIMITS -1.000000 0.9999695
 /begin AXIS_DESCR STD_AXIS NO_INPUT_QUANTITY fak_sw_b1 7 -1.000000 0.999969 FORMAT "%8.6" EXTENDED_LIMITS -1.000000 0.9999695 DEPOSIT ABSOLUTE /end AXIS_DESCR
 /begin AXIS_DESCR STD_AXIS NO_INPUT_QUANTITY fak_sw_b1 7 -1.000000 0.999969 FORMAT "%8.6" EXTENDED_LIMITS -1.000000 0.9999695 DEPOSIT ABSOLUTE /end AXIS_DESCR
/end CHARACTERISTIC
/begin CHARACTERISTIC TWCC_rPBalDLaSFlPri_MAP "relative p-part balancing delta lambda second fuel primary control continuous" MAP 0x8057FB48 RB_Map_S16S16_S16 1.999969 fak_sw_b1 -1.000000 0.999969 FORMAT "%8.6" EXTENDED_LIMITS -1.000000 0.9999695
 /begin AXIS_DESCR STD_AXIS NO_INPUT_QUANTITY fak_sw_b1 7 -1.000000 0.999969 FORMAT "%8.6" EXTENDED_LIMITS -1.000000 0.9999695 DEPOSIT ABSOLUTE /end AXIS_DESCR
 /begin AXIS_DESCR STD_AXIS NO_INPUT_QUANTITY fak_sw_b1 7 -1.000000 0.999969 FORMAT "%8.6" EXTENDED_LIMITS -1.000000 0.9999695 DEPOSIT ABSOLUTE /end AXIS_DESCR
/end CHARACTERISTIC
/begin CHARACTERISTIC TWCC_rPBalHysDLaPri_C "relative p-part balancing hysteresis delta lambda primary control continuous" VALUE 0x8057FBCA RB_Val_Ws16 1.999969 fak_sw_b1 -1.000000 0.999969 FORMAT "%8.6" EXTENDED_LIMITS -1.000000 0.9999695 /end CHARACTERISTIC
/begin CHARACTERISTIC TWCC_rPCoUsPri_C "Hysteresis threshold P-part release based on lambda controller status" VALUE 0x8057FFA4 RB_Val_Wu8 100.5 rel_ub_q0p75 0.00 100.5 FORMAT "%5.1" EXTENDED_LIMITS 0.00 191.3 /end CHARACTERISTIC
/begin CHARACTERISTIC TWCC_rPLdMaxPri_CUR "relative load maximum p-part primary control enable" CURVE 0x8057FFA6 RB_Curve_U16_U16 1535.977 rel_q0p02344 0.00 1535.977 FORMAT "%8.3"
 /begin AXIS_DESCR STD_AXIS Epm_nEng EngN 8 0.00 32767.50 FORMAT "%8.2" DEPOSIT ABSOLUTE /end AXIS_DESCR
/end CHARACTERISTIC
/begin CHARACTERISTIC TWCC_rPLdMinPri_CUR "relative load minimum p-part primary control enable" CURVE 0x8057FFC8 RB_Curve_U16_U16 1535.977 rel_q0p02344 0.00 1535.977 FORMAT "%8.3"
 /begin AXIS_DESCR STD_AXIS Epm_nEng EngN 8 0.00 32767.50 FORMAT "%8.2" DEPOSIT ABSOLUTE /end AXIS_DESCR
/end CHARACTERISTIC
/begin CHARACTERISTIC TWCC_rSetPUsGlbEnhd_CUR "relative set point correction global (5 supporting points)" CURVE 0x8057F8F2 RB_Curve_U16_S16_Static 1.999969 fak_q3p0518Em5 -1.000000 0.999969 FORMAT "%8.6" EXTENDED_LIMITS -1.000000 0.9999695
 /begin AXIS_DESCR STD_AXIS NO_INPUT_QUANTITY fak_q3p0518Em5 5 0.00 1.999969 FORMAT "%8.6" DEPOSIT ABSOLUTE /end AXIS_DESCR
/end CHARACTERISTIC
/begin CHARACTERISTIC TWCC_stFlModln2_CW "codeword2 TWCC_FlModln" VALUE 0x8057F8D4 RB_Val_Wu8 255.0 dez 0.00 255.0 FORMAT "%5.1" /end CHARACTERISTIC
/begin CHARACTERISTIC TWCC_stFlModln_CW "codeword TWCC_FlModln" VALUE 0x8057F8D6 RB_Val_Wu16 65535.00 dez 0.00 65535.00 FORMAT "%8.2" /end CHARACTERISTIC
/begin CHARACTERISTIC TWCC_stGlbSet_CW "state global settings codeword" VALUE 0x8057F908 RB_Val_Wu8 255.0 dez 0.00 255.0 FORMAT "%5.1" /end CHARACTERISTIC
/begin CHARACTERISTIC TWCC_stPriCont_CW "code word primary lambda control continuous" VALUE 0x8057FBCC RB_Val_Wu16 65535.00 dez 0.00 65535.00 FORMAT "%8.2" /end CHARACTERISTIC
/begin CHARACTERISTIC TWCC_stPriEna_CW "configuration code word of enable conditions of primary control" VALUE 0x8057FFEA RB_Val_Wu16 65535.00 dez 0.00 65535.00 FORMAT "%8.2" /end CHARACTERISTIC
/begin CHARACTERISTIC TWCC_tCatEnaModlnB1_C "Minimum catalyst temperature to enable modulation bank 1" VALUE 0x8057F8D8 RB_Val_Ws16 6553.500 temp_q0p1_o273 -3549.940 3003.560 FORMAT "%8.3" /end CHARACTERISTIC
/begin CHARACTERISTIC TWCC_tCatEnaModlnCngB1_C "Minimum catalyst temperature to enable modulation for CNG, bank 1" VALUE 0x8057F8DA RB_Val_Ws16 6553.500 temp_q0p1_o273 -3549.940 3003.560 FORMAT "%8.3" /end CHARACTERISTIC
/begin CHARACTERISTIC TWCC_tCatEnaModlnMaxCng_C "Maximum catalyst temperature to enable fuel modulation" VALUE 0x8057F8DC RB_Val_Ws16 6553.500 temp_q0p1_o273 -3549.940 3003.560 FORMAT "%8.3" /end CHARACTERISTIC
/begin CHARACTERISTIC TWCC_tCatEnaModlnMax_C "Maximum catalyst temperature to enable fuel modulation" VALUE 0x8057F8DE RB_Val_Ws16 6553.500 temp_q0p1_o273 -3549.940 3003.560 FORMAT "%8.3" /end CHARACTERISTIC
/begin CHARACTERISTIC TWCC_tEngEnaModln_C "minimum engine temperature enable modulation" VALUE 0x8057F8E0 RB_Val_Ws16 6553.500 Temp_Cels -3549.940 3003.560 FORMAT "%8.3" /end CHARACTERISTIC
/begin CHARACTERISTIC TWCC_tiDebVltgRstModln_C "debounce sensor-voltage reset O2-balance" VALUE 0x8057F8E2 RB_Val_Wu8 2.550 t_q0p01 0.00 2.550 FORMAT "%5.3" /end CHARACTERISTIC
/begin CHARACTERISTIC TWCC_tiDlyAdpnThdS1_C "Threshold of adapted Death time for switching from balanced lambda modulation to lambda modulation with fix period" VALUE 0x8057F8E4 RB_Val_Wu16 655.3500 t_q0p01 0.00 655.3500 FORMAT "%8.4" /end CHARACTERISTIC
/begin CHARACTERISTIC TWCC_tiDynSetPPri_CUR "filter time constant of relative dynamic set point correction of primary catalyst control continuous" CURVE 0x8057FBCE RB_Curve_S16_U16_Static 3276.700 t_q0p05 0.050 3276.750 FORMAT "%8.3" EXTENDED_LIMITS 0.00 3276.750
 /begin AXIS_DESCR STD_AXIS NO_INPUT_QUANTITY m_q0p1 4 -3276.800 3276.700 FORMAT "%8.3" DEPOSIT ABSOLUTE /end AXIS_DESCR
/end CHARACTERISTIC
/begin CHARACTERISTIC TWCC_tiDynSetPSFlPri_CUR "filter time constant of relative dynamic set point correction of primary catalyst control continuous, second fuel" CURVE 0x8057FBE0 RB_Curve_S16_U16_Static 3276.700 t_q0p05 0.050 3276.750 FORMAT "%8.3" EXTENDED_LIMITS 0.00 3276.750
 /begin AXIS_DESCR STD_AXIS NO_INPUT_QUANTITY m_q0p1 4 -3276.800 3276.700 FORMAT "%8.3" DEPOSIT ABSOLUTE /end AXIS_DESCR
/end CHARACTERISTIC
/begin CHARACTERISTIC TWCC_tiDynStrtSetPPri_CUR "Time dynamic set point after start primary control continuous" CURVE 0x8057FBF2 RB_Curve_S16_U16_Static 3276.700 t_q0p05 0.050 3276.750 FORMAT "%8.3" EXTENDED_LIMITS 0.00 3276.750
 /begin AXIS_DESCR STD_AXIS NO_INPUT_QUANTITY m_q0p1 4 -3276.800 3276.700 FORMAT "%8.3" DEPOSIT ABSOLUTE /end AXIS_DESCR
/end CHARACTERISTIC
/begin CHARACTERISTIC TWCC_tiDynStrtSetPSFlPri_CUR "Time dynamic set point after start second fuel primary control continuous" CURVE 0x8057FC04 RB_Curve_S16_U16_Static 3276.700 t_q0p05 0.050 3276.750 FORMAT "%8.3" EXTENDED_LIMITS 0.00 3276.750
 /begin AXIS_DESCR STD_AXIS NO_INPUT_QUANTITY m_q0p1 4 -3276.800 3276.700 FORMAT "%8.3" DEPOSIT ABSOLUTE /end AXIS_DESCR
/end CHARACTERISTIC
/begin CHARACTERISTIC TWCC_tIEngPri_C "minimum engine temperature for I-part release, primary control enable" VALUE 0x8057FFEC RB_Val_Ws16 6553.500 Temp_Cels -3549.940 3003.560 FORMAT "%8.3" /end CHARACTERISTIC
/begin CHARACTERISTIC TWCC_tiFltSetPPriMap_T "curve for time constant of filter for voltage setpoint primary control from map" CURVE 0x8057FC16 RB_Curve_S16_U8_Static 25.50 t_q0p1 0.00 25.50 FORMAT "%5.2"
 /begin AXIS_DESCR STD_AXIS TWCC_dmExhSpFil m_q0p1 6 -3276.800 3276.700 FORMAT "%8.3" DEPOSIT ABSOLUTE /end AXIS_DESCR
/end CHARACTERISTIC
/begin CHARACTERISTIC TWCC_tiIDebFlCutPri_C "time debounce of flag fuel cut off for reset of i-part inhibit in deceleration without fuel cut off" VALUE 0x8057FFEE RB_Val_Wu8 25.50 t_q0p1 0.00 25.50 FORMAT "%5.2" /end CHARACTERISTIC
/begin CHARACTERISTIC TWCC_tiIDebIdlSpdPri_C "debounce time of flag idle speed for activating i-part inhibit in deceleration without fuel cut off" VALUE 0x8057FFEF RB_Val_Wu8 25.50 t_q0p1 0.00 25.50 FORMAT "%5.2" /end CHARACTERISTIC
/begin CHARACTERISTIC TWCC_tiIDebLdGradPri_C "hold time of release of I-part based on engine load gradient" VALUE 0x8057FFF0 RB_Val_Wu8 25.50 t_q0p1 0.00 25.50 FORMAT "%5.2" /end CHARACTERISTIC
/begin CHARACTERISTIC TWCC_tiIDebNLdPri_C "debounce time engine rotation speed and engine load for I-part primary control enable" VALUE 0x8057FFF1 RB_Val_Wu8 25.50 t_q0p1 0.00 25.50 FORMAT "%5.2" /end CHARACTERISTIC
/begin CHARACTERISTIC TWCC_tiILamGradH2Pri_C "time constant of lowpass of delta lambda for H2 based inhibit of I-part, primary control enable" VALUE 0x8057FFF2 RB_Val_Wu16 65534.000000 zk1sxs_uw_b65535 1.000000 65535.000000 FORMAT "%12.6" /end CHARACTERISTIC
/begin CHARACTERISTIC TWCC_tiILamSwtH2Pri_C "Delay of edge falling for lambda sign switch detection, H2 based inhibit of I-part, primary control" VALUE 0x8057FFF4 RB_Val_Wu8 255.0 t_q1 0.00 255.0 FORMAT "%5.1" /end CHARACTERISTIC
/begin CHARACTERISTIC TWCC_tiILckDecelPri_C "Time period for withdrawal of inhibit after reaching the timeout, i-part inhibit due to deceleration without fuel cut" VALUE 0x8057FFF6 RB_Val_Wu16 6553.500 t_q0p1 0.00 6553.500 FORMAT "%8.3" /end CHARACTERISTIC
/begin CHARACTERISTIC TWCC_tiILpLdGradPri_C "time low pass load gradient second fuel primary control enable" VALUE 0x8057FFF8 RB_Val_Wu16 655.34999985 zk10msxs_uw_b655p36 0.01000015 655.36000000 FORMAT "%12.8" EXTENDED_LIMITS 0.010000152590 655.36000000 /end CHARACTERISTIC
/begin CHARACTERISTIC TWCC_tiLpActPri_CUR "time low pass actual value primary control continuous" CURVE 0x8057FC2A RB_Curve_S16_U16_Static 1310.6999997 zk20msxs_uw_b1310p72 0.0200003 1310.7200000 FORMAT "%12.7" EXTENDED_LIMITS 0.020000305180 1310.7200000
 /begin AXIS_DESCR STD_AXIS NO_INPUT_QUANTITY m_q0p1 4 -3276.800 3276.700 FORMAT "%8.3" DEPOSIT ABSOLUTE /end AXIS_DESCR
/end CHARACTERISTIC
/begin CHARACTERISTIC TWCC_tiLpTCatGslPri_T "Filter time constant of the catalyst temperature dependent on the exhaust gas mass flow during gasoline operation mode" CURVE 0x8057FC3C RB_Curve_S16_U16_Static 1310.6999997 zk20msxs_uw_b1310p72 0.0200003 1310.7200000 FORMAT "%12.7" EXTENDED_LIMITS 0.020000305180 1310.7200000
 /begin AXIS_DESCR STD_AXIS TWCC_dmExhSpFil m_q0p1 6 -3276.800 3276.700 FORMAT "%8.3" DEPOSIT ABSOLUTE /end AXIS_DESCR
/end CHARACTERISTIC
/begin CHARACTERISTIC TWCC_tIMaxPri_C "maximum catalyst temperature for I-part release, primary control enable" VALUE 0x8057FFFA RB_Val_Ws16 6553.500 Temp_Cels -3549.940 3003.560 FORMAT "%8.3" /end CHARACTERISTIC
/begin CHARACTERISTIC TWCC_tiMinPerModln_C "minimum period-time balanced modulation" VALUE 0x8057F8E6 RB_Val_Wu8 2.550 t_q0p01 0.00 2.550 FORMAT "%5.3" /end CHARACTERISTIC
/begin CHARACTERISTIC TWCC_tIMinPri_CUR "minimum catalyst temperature for I-part release, primary control enable" CURVE 0x8057FFFC RB_CurveGroup_S16 6553.500 Temp_Cels -3549.940 3003.560 FORMAT "%8.3"
 /begin AXIS_DESCR COM_AXIS TWCC_facOSCPriGCURWpDisp fak_uw_b2 2 0.00 1.999969 FORMAT "%8.6" AXIS_PTS_REF TWCC_facOSCPri_GCUR /end AXIS_DESCR
/end CHARACTERISTIC
/begin CHARACTERISTIC TWCC_tIMinTstReqPri_C "minimum catalyst temperature for I-part release during service test, primary control enable" VALUE 0x80580000 RB_Val_Ws16 6553.500 Temp_Cels -3549.940 3003.560 FORMAT "%8.3" /end CHARACTERISTIC
/begin CHARACTERISTIC TWCC_tiPDebCoUsPri_C "Turn off delay time P-part release based on lambda controller status" VALUE 0x80580002 RB_Val_Wu8 25.50 t_q0p1 0.00 25.50 FORMAT "%5.2" /end CHARACTERISTIC
/begin CHARACTERISTIC TWCC_tiPDebLam1DrctPri_C "hold time for direct evaluation lambda 1 condition, p-part release, primary control enable" VALUE 0x80580003 RB_Val_Wu8 25.50 t_q0p1 0.00 25.50 FORMAT "%5.2" /end CHARACTERISTIC
/begin CHARACTERISTIC TWCC_tiPDebLam1ErrPri_C "time for bypassing lambda 1 deviation, p-part release, primary control enable" VALUE 0x80580004 RB_Val_Wu8 25.50 t_q0p1 0.00 25.50 FORMAT "%5.2" /end CHARACTERISTIC
/begin CHARACTERISTIC TWCC_tiPDebNLdPri_C "Debounce time rotation speed and load for P-part primary control enable" VALUE 0x80580005 RB_Val_Wu8 255.0 t_q1 0.00 255.0 FORMAT "%5.1" /end CHARACTERISTIC
/begin CHARACTERISTIC TWCC_tiPerModlnCng_C "period-time lambda amplitude value for CNG" VALUE 0x8057F8E8 RB_Val_Wu16 655.3500 t_q0p01 0.00 655.3500 FORMAT "%8.4" /end CHARACTERISTIC
/begin CHARACTERISTIC TWCC_tiPerModln_C "period-time lambda amplitude value" VALUE 0x8057F8EA RB_Val_Wu16 655.3500 t_q0p01 0.00 655.3500 FORMAT "%8.4" /end CHARACTERISTIC
/begin CHARACTERISTIC TWCC_tiPLpCoUsPri_C "lowpass time constant P-part release based on lambda controller status" VALUE 0x80580006 RB_Val_Wu8 25.4996 zk100msxs_ub_b25p5 0.1004 25.6000 FORMAT "%7.4" EXTENDED_LIMITS 0.100392 25.6000 /end CHARACTERISTIC
/begin CHARACTERISTIC TWCC_tiStrtEndDly_C "Delay time end of start reached, combustion engine runs on its own power" VALUE 0x8057FC56 RB_Val_Wu16 3276.750 t_q0p05 0.00 3276.750 FORMAT "%8.3" /end CHARACTERISTIC
/begin CHARACTERISTIC TWCC_tiTranAdpnThdS1_C "Threshold of adapted Transition time for switching from balanced lambda modulation to lambda modulation with fix period" VALUE 0x8057F8EC RB_Val_Wu16 655.3500 t_q0p01 0.00 655.3500 FORMAT "%8.4" /end CHARACTERISTIC
/begin CHARACTERISTIC TWCC_tPMaxPri_C "maximum catalyst temperature for P-part release, primary control enable" VALUE 0x80580008 RB_Val_Ws16 6553.500 Temp_Cels -3549.940 3003.560 FORMAT "%8.3" /end CHARACTERISTIC
/begin CHARACTERISTIC TWCC_tPMinPri_CUR "minimum catalyst temperature for P-part release, primary control enable" CURVE 0x8058000A RB_CurveGroup_S16 6553.500 Temp_Cels -3549.940 3003.560 FORMAT "%8.3"
 /begin AXIS_DESCR COM_AXIS TWCC_facOSCPriGCURWpDisp fak_uw_b2 2 0.00 1.999969 FORMAT "%8.6" AXIS_PTS_REF TWCC_facOSCPri_GCUR /end AXIS_DESCR
/end CHARACTERISTIC
/begin CHARACTERISTIC TWCC_tPMinTstReqPri_C "minimum catalyst temperature for P-part release during service test, primary control enable" VALUE 0x8058000E RB_Val_Ws16 6553.500 Temp_Cels -3549.940 3003.560 FORMAT "%8.3" /end CHARACTERISTIC
/begin CHARACTERISTIC TWCC_uActHiLimGslCorrnPri_M "Characteristic map for downstream sensor voltage based on OSC correction factor of the main catalyst high threshold" MAP 0x8057FC58 RB_Map_U16U16_U16 4.998779 spg_q1p221Em3_V 0.00 4.998779 FORMAT "%8.6" EXTENDED_LIMITS 0.00 79.99878
 /begin AXIS_DESCR STD_AXIS TWCC_uS2B1Lam spg_q1p221Em3_V 15 0.00 4.998779 FORMAT "%8.6" EXTENDED_LIMITS 0.00 79.99878 DEPOSIT ABSOLUTE /end AXIS_DESCR
 /begin AXIS_DESCR STD_AXIS TWCC_ratO2StrB1WpDisp fak_uw_b2 5 0.00 1.999969 FORMAT "%8.6" DEPOSIT ABSOLUTE /end AXIS_DESCR
/end CHARACTERISTIC
/begin CHARACTERISTIC TWCC_uActLoLimGslCorrnPri_M "Characteristic map for downstream sensor voltage based on OSC correction factor of the main catalyst low threshold" MAP 0x8057FD1A RB_Map_U16U16_U16 4.998779 spg_q1p221Em3_V 0.00 4.998779 FORMAT "%8.6" EXTENDED_LIMITS 0.00 79.99878
 /begin AXIS_DESCR STD_AXIS TWCC_uS2B1Lam spg_q1p221Em3_V 15 0.00 4.998779 FORMAT "%8.6" EXTENDED_LIMITS 0.00 79.99878 DEPOSIT ABSOLUTE /end AXIS_DESCR
 /begin AXIS_DESCR STD_AXIS TWCC_ratO2StrB1WpDisp fak_uw_b2 5 0.00 1.999969 FORMAT "%8.6" DEPOSIT ABSOLUTE /end AXIS_DESCR
/end CHARACTERISTIC
/begin CHARACTERISTIC TWCC_uDebRstThresHiModln_C "upper threshold sensor-voltage for reset" VALUE 0x8057F8EE RB_Val_Wu8 1.245 spg_q0p00488 0.00 1.245 FORMAT "%5.3" /end CHARACTERISTIC
/begin CHARACTERISTIC TWCC_uDebRstThresLoModln_C "lower threshold sensor-voltage for reset" VALUE 0x8057F8EF RB_Val_Wu8 1.245 spg_q0p00488 0.00 1.245 FORMAT "%5.3" /end CHARACTERISTIC
/begin CHARACTERISTIC TWCC_uRstThresHiModln_C "upper threshold sensor-voltage abort rich period" VALUE 0x8057F8F0 RB_Val_Wu8 1.245 spg_q0p00488 0.00 1.245 FORMAT "%5.3" /end CHARACTERISTIC
/begin CHARACTERISTIC TWCC_uRstThresLoModln_C "lower threshold sensor-voltage abort lean period" VALUE 0x8057F8F1 RB_Val_Wu8 1.245 spg_q0p00488 0.00 1.245 FORMAT "%5.3" /end CHARACTERISTIC
/begin CHARACTERISTIC TWCC_uSetPApplPriB1_C "constant voltage setpoint of primary catalyst control" VALUE 0x8057FDDC RB_Val_Wu8 1.245 spg_q0p00488 0.00 1.245 FORMAT "%5.3" /end CHARACTERISTIC
/begin CHARACTERISTIC TWCC_uSetPPriB1_MAP "voltage set point map primary control" MAP 0x8057FDDD RB_Map_U8U8_U8 1.245 spg_q0p00488 0.00 1.245 FORMAT "%5.3"
 /begin AXIS_DESCR STD_AXIS Epm_nEngLRes nmot_ub_q40 12 0.00 10200. FORMAT "%5.0" DEPOSIT ABSOLUTE /end AXIS_DESCR
 /begin AXIS_DESCR STD_AXIS NO_INPUT_QUANTITY rel_ub_q0p75 12 0.00 191.3 FORMAT "%5.1" DEPOSIT ABSOLUTE /end AXIS_DESCR
/end CHARACTERISTIC
/begin CHARACTERISTIC TWCC_uSetPSFlPriB1_MAP "voltage set point map second fuel primary control" MAP 0x8057FE87 RB_Map_U8U8_U8 1.245 spg_q0p00488 0.00 1.245 FORMAT "%5.3"
 /begin AXIS_DESCR STD_AXIS Epm_nEngLRes nmot_ub_q40 12 0.00 10200. FORMAT "%5.0" DEPOSIT ABSOLUTE /end AXIS_DESCR
 /begin AXIS_DESCR STD_AXIS NO_INPUT_QUANTITY rel_ub_q0p75 12 0.00 191.3 FORMAT "%5.1" DEPOSIT ABSOLUTE /end AXIS_DESCR
/end CHARACTERISTIC
/begin CHARACTERISTIC TWCD_facCorrDlyB1_M "Correction factor (exhaust gas mass flow, delay time) of LSU dynamic corrected lambda before catalyst (Bank 1)" MAP 0x80580010 RB_Map_S16U16_U8 1.000000 fak_ub_b2 0.00 1.000000 FORMAT "%8.6" EXTENDED_LIMITS 0.00 1.992188
 /begin AXIS_DESCR STD_AXIS ExhMod_dmExhCat1B1 m_q0p1 4 -3276.800 3276.700 FORMAT "%8.3" DEPOSIT ABSOLUTE /end AXIS_DESCR
 /begin AXIS_DESCR STD_AXIS EGSDO2_tiDlyAdpnS1B1 t_q0p01 4 0.00 655.3500 FORMAT "%8.4" DEPOSIT ABSOLUTE /end AXIS_DESCR
/end CHARACTERISTIC
/begin CHARACTERISTIC TWCD_facCorrTranB1_M "Correction factor (exhaust gas mass flow, transition time) of LSU dynamic corrected lambda before catalyst (Bank 1)" MAP 0x80580034 RB_Map_S16U16_U8 1.000000 fak_ub_b2 0.00 1.000000 FORMAT "%8.6" EXTENDED_LIMITS 0.00 1.992188
 /begin AXIS_DESCR STD_AXIS ExhMod_dmExhCat1B1 m_q0p1 4 -3276.800 3276.700 FORMAT "%8.3" DEPOSIT ABSOLUTE /end AXIS_DESCR
 /begin AXIS_DESCR STD_AXIS EGSDO2_tiTranAdpnS1B1 t_q0p01 4 0.00 655.3500 FORMAT "%8.4" DEPOSIT ABSOLUTE /end AXIS_DESCR
/end CHARACTERISTIC
/begin CHARACTERISTIC TWCD_facMLeanIR_C "Factor enleanment for IUMPR simulation of catalyst monitoring" VALUE 0x80580058 RB_Val_Wu8 15.94 fak_ub_b16 0.00 15.94 FORMAT "%5.2" /end CHARACTERISTIC
/begin CHARACTERISTIC TWCD_facMRichIR_C "Factor enrichment for IUMPR simulation of catalyst monitoring" VALUE 0x80580059 RB_Val_Wu8 15.94 fak_ub_b16 0.00 15.94 FORMAT "%5.2" /end CHARACTERISTIC
/begin CHARACTERISTIC TWCD_facOSCRSC_C "Ratio between oxygen storage capacity and reverse measured oxygen storage capacity" VALUE 0x8058005A RB_Val_Wu8 15.94 fak_ub_b16 0.00 15.94 FORMAT "%5.2" /end CHARACTERISTIC
/begin CHARACTERISTIC TWCD_flgArthFltPassTstActvd_CW "CodeBit: Pass Test for arithmetic filter activated" VALUE 0x80580364 RB_Val_Wu8 1.00000000000 B_TRUE 0.00 1.00000000000 FORMAT "%13.11" /end CHARACTERISTIC
/begin CHARACTERISTIC TWCD_flgCatDiagActvCat1B1_C "Switch for activating catalyst diagnosis catalyst 1 bank 1" VALUE 0x80580365 RB_Val_Wu8 1.00000000000 B_TRUE 0.00 1.00000000000 FORMAT "%13.11" /end CHARACTERISTIC
/begin CHARACTERISTIC TWCD_flgEwma_CW "Codeword for activation of Moving average for catalyst diagnosis for several trips (EWMA-Filter)" VALUE 0x80580366 RB_Val_Wu8 1.00000000000 B_TRUE 0.00 1.00000000000 FORMAT "%13.11" /end CHARACTERISTIC
/begin CHARACTERISTIC TWCD_flgOSCCorActv_CW "Codebit: Correction of OSC-measurement depending on the sensordynamics of oxygensensor downstream catayst" VALUE 0x8058005B RB_Val_Wu8 1.00000000000 B_TRUE 0.00 1.00000000000 FORMAT "%13.11" /end CHARACTERISTIC
/begin CHARACTERISTIC TWCD_flgOSCMaxRng_CW "Codebit: upper limit of normalized OSC value is active" VALUE 0x80580367 RB_Val_Wu8 1.00000000000 B_TRUE 0.00 1.00000000000 FORMAT "%13.11" /end CHARACTERISTIC
/begin CHARACTERISTIC TWCD_flgRSCCorActv_CW "Codebit: Correction of RSC-measurement depending on the sensordynamics of oxygensensor downstream catayst" VALUE 0x8058005C RB_Val_Wu8 1.00000000000 B_TRUE 0.00 1.00000000000 FORMAT "%13.11" /end CHARACTERISTIC
/begin CHARACTERISTIC TWCD_FltDsEval_B1.rOfsRmnProdModParl_C "Filter class for catalyt diagnosis / calibration offset production mode" VALUE 0x80580384 RB_Val_Wu16 15.99976 fak_uw_b16 0.00 15.99976 FORMAT "%8.5" /end CHARACTERISTIC
/begin CHARACTERISTIC TWCD_mOscIni_C "Initial Osc after power fail or DSM clear" VALUE 0x80580060 RB_Val_Wu32 429496729.500 m_q0p1_mg 0.00 429496729.500 FORMAT "%13.3" /end CHARACTERISTIC
/begin CHARACTERISTIC TWCD_NewOscPriB1_I.OSCNrm_MAP "Calculation of the Osc of the new catalyst, Cat1B1 / map of end of life catalyst" MAP 0x80580134 RB_Map_S16U16_U16 65535.0000 m_q1_mg 0.0000 65535.0000 FORMAT "%10.4"
 /begin AXIS_DESCR STD_AXIS TWCD_NewOscPriB1_I.tBrick Temp_Cels 8 -3549.940 3003.560 FORMAT "%8.3" DEPOSIT ABSOLUTE /end AXIS_DESCR
 /begin AXIS_DESCR STD_AXIS TWCD_NewOscPriB1_I.dmGas m_uw_b6553p5 8 0.00 6553.500 FORMAT "%8.3" DEPOSIT ABSOLUTE /end AXIS_DESCR
/end CHARACTERISTIC
/begin CHARACTERISTIC TWCD_NewOscPriB1_I.mOSCNrmShtrp_T "Calculation of the Osc of the new catalyst, Cat1B1 / OSC curve of end of life catalyst in short trip" CURVE 0x805801D8 RB_Curve_S16_U16_Static 65535.0000 m_q1_mg 0.0000 65535.0000 FORMAT "%10.4"
 /begin AXIS_DESCR STD_AXIS TWCD_NewOscPriB1_I.tBrick Temp_Cels 4 -3549.940 3003.560 FORMAT "%8.3" DEPOSIT ABSOLUTE /end AXIS_DESCR
/end CHARACTERISTIC
/begin CHARACTERISTIC TWCD_NrMeasStepChg_C "Number of measurements for Stepchange evaluation" VALUE 0x80580368 RB_Val_Wu8 255.0 dez 0.00 255.0 FORMAT "%5.1" /end CHARACTERISTIC
/begin CHARACTERISTIC TWCD_NrmOSCPriB1_I.OSCNrm_MAP "calculation of borderline OSC, 1st cat. bank 1 / map of end of life catalyst" MAP 0x805801F0 RB_Map_S16U16_U16 65535.0000 m_q1_mg 0.0000 65535.0000 FORMAT "%10.4"
 /begin AXIS_DESCR STD_AXIS TWCD_NrmOSCPriB1_I.tBrick Temp_Cels 8 -3549.940 3003.560 FORMAT "%8.3" DEPOSIT ABSOLUTE /end AXIS_DESCR
 /begin AXIS_DESCR STD_AXIS TWCD_NrmOSCPriB1_I.dmGas m_uw_b6553p5 8 0.00 6553.500 FORMAT "%8.3" DEPOSIT ABSOLUTE /end AXIS_DESCR
/end CHARACTERISTIC
/begin CHARACTERISTIC TWCD_NrmOSCPriB1_I.mOSCNrmShtrp_T "calculation of borderline OSC, 1st cat. bank 1 / OSC curve of end of life catalyst in short trip" CURVE 0x80580294 RB_Curve_S16_U16_Static 65535.0000 m_q1_mg 0.0000 65535.0000 FORMAT "%10.4"
 /begin AXIS_DESCR STD_AXIS TWCD_NrmOSCPriB1_I.tBrick Temp_Cels 4 -3549.940 3003.560 FORMAT "%8.3" DEPOSIT ABSOLUTE /end AXIS_DESCR
/end CHARACTERISTIC
/begin CHARACTERISTIC TWCD_NrmOSCScndFlPriB1_I.OSCNrm_MAP "calculation of borderline OSC, 1st cat, 2nd fuel, bank 1 / map of end of life catalyst" MAP 0x805802AC RB_Map_S16U16_U16 65535.0000 m_q1_mg 0.0000 65535.0000 FORMAT "%10.4"
 /begin AXIS_DESCR STD_AXIS TWCD_NrmOSCScndFlPriB1_I.tBrick Temp_Cels 8 -3549.940 3003.560 FORMAT "%8.3" DEPOSIT ABSOLUTE /end AXIS_DESCR
 /begin AXIS_DESCR STD_AXIS TWCD_NrmOSCScndFlPriB1_I.dmGas m_uw_b6553p5 8 0.00 6553.500 FORMAT "%8.3" DEPOSIT ABSOLUTE /end AXIS_DESCR
/end CHARACTERISTIC
/begin CHARACTERISTIC TWCD_NrmOSCScndFlPriB1_I.mOSCNrmShtrp_T "calculation of borderline OSC, 1st cat, 2nd fuel, bank 1 / OSC curve of end of life catalyst in short trip" CURVE 0x80580350 RB_Curve_S16_U16_Static 65535.0000 m_q1_mg 0.0000 65535.0000 FORMAT "%10.4"
 /begin AXIS_DESCR STD_AXIS TWCD_NrmOSCScndFlPriB1_I.tBrick Temp_Cels 4 -3549.940 3003.560 FORMAT "%8.3" DEPOSIT ABSOLUTE /end AXIS_DESCR
/end CHARACTERISTIC
/begin CHARACTERISTIC TWCD_numMeasShtrp_C "Number of measurements in short trip" VALUE 0x80580369 RB_Val_Wu8 255.0 dez 0.00 255.0 FORMAT "%5.1" /end CHARACTERISTIC
/begin CHARACTERISTIC TWCD_numMeas_C "Number of measurements per DCY" VALUE 0x8058036A RB_Val_Wu8 255.0 dez 0.00 255.0 FORMAT "%5.1" /end CHARACTERISTIC
/begin CHARACTERISTIC TWCD_ratStepChgCnf_C "Relative change to confirm EWMA step chance" VALUE 0x8058036B RB_Val_Wu8 1.992188 fak_ub_b2 0.00 1.992188 FORMAT "%8.6" /end CHARACTERISTIC
/begin CHARACTERISTIC TWCD_ratStepChgSus_C "Relative change to trigger EWMA step chance" VALUE 0x8058036C RB_Val_Wu8 1.992188 fak_ub_b2 0.00 1.992188 FORMAT "%8.6" /end CHARACTERISTIC
/begin CHARACTERISTIC TWCD_rOSCMaxRng_C "Upper limit of normalized OSC value" VALUE 0x8058036E RB_Val_Wu16 15.99976 fak_uw_b16 0.00 15.99976 FORMAT "%8.5" /end CHARACTERISTIC
/begin CHARACTERISTIC TWCD_rOSCThresB1_C "OSC catalyst monitoring threshold, bank 1" VALUE 0x80580370 RB_Val_Wu16 15.99976 fak_uw_b16 0.00 15.99976 FORMAT "%8.5" /end CHARACTERISTIC
/begin CHARACTERISTIC TWCD_rOSCThresBPUB1_C "Mean value of Best Performance Unacceptable Catalyst (Borderline catalyst)" VALUE 0x80580372 RB_Val_Wu16 15.99976 fak_uw_b16 0.00 15.99976 FORMAT "%8.5" /end CHARACTERISTIC
/begin CHARACTERISTIC TWCD_swtEolTstRls_C "Switch to release EOL-Test result" VALUE 0x80580374 RB_Val_Wu8 1.00000000000 B_TRUE 0.00 1.00000000000 FORMAT "%13.11" /end CHARACTERISTIC
/begin CHARACTERISTIC TWCD_tiCorLtrHEGO_M "Correction map for transition and delay time LeanToRich" MAP 0x80580064 RB_Map_S16S16_S16 655.3400 t_q0p02 0.00 655.3400 FORMAT "%8.4" EXTENDED_LIMITS -655.3600 655.3400
 /begin AXIS_DESCR STD_AXIS NO_INPUT_QUANTITY t_q0p01 6 -327.6800 327.6700 FORMAT "%8.4" DEPOSIT ABSOLUTE /end AXIS_DESCR
 /begin AXIS_DESCR STD_AXIS NO_INPUT_QUANTITY t_q0p01 6 -327.6800 327.6700 FORMAT "%8.4" DEPOSIT ABSOLUTE /end AXIS_DESCR
/end CHARACTERISTIC
/begin CHARACTERISTIC TWCD_tiCorRtlHEGO_M "Correction map for transition and delay time RichToLean" MAP 0x805800C8 RB_Map_S16S16_S16 655.3400 t_q0p02 0.00 655.3400 FORMAT "%8.4" EXTENDED_LIMITS -655.3600 655.3400
 /begin AXIS_DESCR STD_AXIS NO_INPUT_QUANTITY t_q0p01 6 -327.6800 327.6700 FORMAT "%8.4" DEPOSIT ABSOLUTE /end AXIS_DESCR
 /begin AXIS_DESCR STD_AXIS NO_INPUT_QUANTITY t_q0p01 6 -327.6800 327.6700 FORMAT "%8.4" DEPOSIT ABSOLUTE /end AXIS_DESCR
/end CHARACTERISTIC
/begin CHARACTERISTIC TWCD_uLeanFinThres_C "Lean threshold for downstream sensor signal to end lean phase of cat monitoring" VALUE 0x8058012C RB_Val_Wu16 4.998779 spg_q1p221Em3_V 0.00 4.998779 FORMAT "%8.6" EXTENDED_LIMITS 0.00 79.99878 /end CHARACTERISTIC
/begin CHARACTERISTIC TWCD_uRichFinThres_C "Rich threshold for downstream sensor signal to end phase of RSC measuring" VALUE 0x8058012E RB_Val_Wu16 4.998779 spg_q1p221Em3_V 0.00 4.998779 FORMAT "%8.6" EXTENDED_LIMITS 0.00 79.99878 /end CHARACTERISTIC
/begin CHARACTERISTIC TWCD_valEwmaIni_C "Initialization value of EWMA-Filter after power fail" VALUE 0x80580376 RB_Val_Wu16 15.99976 fak_uw_b16 0.00 15.99976 FORMAT "%8.5" /end CHARACTERISTIC
/begin CHARACTERISTIC TWCD_valEwma_C "Filter constant for EWMA filter catalyst diagnosis" VALUE 0x80580378 RB_Val_Wu16 0.9999847 fak_uw_b1 0.00 0.9999847 FORMAT "%9.7" /end CHARACTERISTIC
/begin CHARACTERISTIC UEGO_facMeasRefFilCon_C "filter factor of the back measured internal supply voltage" VALUE 0x805819FC RB_Val_Wu16 0.9999847 fak_uw_b1 0.00 0.9999847 FORMAT "%9.7" /end CHARACTERISTIC
/begin CHARACTERISTIC UEGO_idxHWES1B1_C "Assignment sensor specific data to HWE sensor 1 bank 1" VALUE 0x80581A3C RB_Val_Wu8 255.0 dez 0.00 255.0 FORMAT "%5.1" /end CHARACTERISTIC
/begin CHARACTERISTIC UEGO_nrDacAdpnCollctdDataThd_C "maximal number of points used in Dac adaption" VALUE 0x80581A40 RB_Val_Wu16 65535.00 dez 0.00 65535.00 FORMAT "%8.2" /end CHARACTERISTIC
/begin CHARACTERISTIC UEGO_stAmplfr_C "Codeword to switch on voltage-dependent setting of loupes" VALUE 0x805819E0 RB_Val_Wu8 255.0 OneToOne 0.00 255.0 FORMAT "%5.1" /end CHARACTERISTIC
/begin CHARACTERISTIC UEGO_stChpSuprtd_CA "" VAL_BLK 0x805819FE RB_ValA_Wu16 65535.00 dez 0.00 65535.00 FORMAT "%8.2" READ_ONLY NUMBER 30 /end CHARACTERISTIC
/begin CHARACTERISTIC UEGO_stChp_C "status word of UEGO_Chp" VALUE 0x80581A3A RB_Val_Wu16 65535.00 OneToOne 0.00 65535.00 FORMAT "%8.2" /end CHARACTERISTIC
/begin CHARACTERISTIC UEGO_stDac_C "Status word for UEGO_Dac" VALUE 0x80581A42 RB_Val_Wu16 65535.00 dez 0.00 65535.00 FORMAT "%8.2" /end CHARACTERISTIC
/begin CHARACTERISTIC UEGO_stLoupNNormSeln_C "Selection of the used voltages to evaluate the set value of the loupe N in the Normal mode." VALUE 0x805819E2 RB_Val_Wu16 65535.00 OneToOne 0.00 65535.00 FORMAT "%8.2" /end CHARACTERISTIC
/begin CHARACTERISTIC UEGO_stLoupNSeln_C "Selection of the used voltages to evaluate the set value of the loupe N in the different modes" VALUE 0x805819E4 RB_Val_Wu32 4294967295.00 OneToOne 0.00 4294967295.00 FORMAT "%13.2" /end CHARACTERISTIC
/begin CHARACTERISTIC UEGO_stLoupNSet_C "Setting value for loupe N if the setting value is not calculated from voltage" VALUE 0x805819E8 RB_Val_Wu8 255.0 OneToOne 0.00 255.0 FORMAT "%5.1" /end CHARACTERISTIC
/begin CHARACTERISTIC UEGO_stLoupPNormSeln_C "Selection of the used voltages to evaluate the set value of the loupe P in the Normal mode." VALUE 0x805819EA RB_Val_Wu16 65535.00 OneToOne 0.00 65535.00 FORMAT "%8.2" /end CHARACTERISTIC
/begin CHARACTERISTIC UEGO_stLoupPSeln_C "Selection of the used voltages to evaluate the set value of the loupe P in the different modes" VALUE 0x805819EC RB_Val_Wu32 4294967295.00 OneToOne 0.00 4294967295.00 FORMAT "%13.2" /end CHARACTERISTIC
/begin CHARACTERISTIC UEGO_stLoupPSet_C "Setting value for loupe P if the setting value is not calculated from voltage" VALUE 0x805819F0 RB_Val_Wu8 255.0 OneToOne 0.00 255.0 FORMAT "%5.1" /end CHARACTERISTIC
/begin CHARACTERISTIC UEGO_uLnEnaDown_C "activation voltage of loupe LN" VALUE 0x805819F2 RB_Val_Ws16 10.48544 spg_q3p2Em4_V 0.00 10.48544 FORMAT "%8.5" EXTENDED_LIMITS -10.48576 10.48544 /end CHARACTERISTIC
/begin CHARACTERISTIC UEGO_uLnEnaUp_C "deactivation voltage (hysteresis) of loupe LN" VALUE 0x805819F4 RB_Val_Ws16 10.48544 spg_q3p2Em4_V 0.00 10.48544 FORMAT "%8.5" EXTENDED_LIMITS -10.48576 10.48544 /end CHARACTERISTIC
/begin CHARACTERISTIC UEGO_uLpEnaDown_C "activation voltage of loupe LP" VALUE 0x805819F6 RB_Val_Ws16 10.48544 spg_q3p2Em4_V 0.00 10.48544 FORMAT "%8.5" EXTENDED_LIMITS -10.48576 10.48544 /end CHARACTERISTIC
/begin CHARACTERISTIC UEGO_uLpEnaUp_C "deactivation voltage (hysteresis) of loupe LP" VALUE 0x805819F8 RB_Val_Ws16 10.48544 spg_q3p2Em4_V 0.00 10.48544 FORMAT "%8.5" EXTENDED_LIMITS -10.48576 10.48544 /end CHARACTERISTIC
/begin CHARACTERISTIC UEGO_uVCC3Ref_C "Reference voltage VCC3" VALUE 0x80581A3E RB_Val_Ws16 20.97120 spg_q3p2Em4_V -10.48576 10.48544 FORMAT "%8.5" /end CHARACTERISTIC
/begin MEASUREMENT dummy "---" SWORD spg_q3p2Em4_V 1 100 -10.48576 10.48544 FORMAT "%8.5" ECU_ADDRESS 0x70001F22 /end MEASUREMENT
/begin MEASUREMENT fcoscxk "Oxygen storage capacity correction factor" UBYTE fak_q0p0078 1 100 0.00 1.992 FORMAT "%5.3" ECU_ADDRESS 0x6000B5BA /end MEASUREMENT
/begin MEASUREMENT fipsfesInvModln_w "invers interpolation factor for CNG or FlexFuel in fuel modulation" UWORD fak_uw_b2 1 100 0.00 1.999969 FORMAT "%8.6" ECU_ADDRESS 0x600070B8 /end MEASUREMENT
/begin MEASUREMENT LRS_REGEN1_TR_I.timeCounter "Time counter for positive half wave of fuel modulation / Remaining time of the timer" UWORD t_q0p01 1 100 0.00 655.3500 FORMAT "%8.4" ECU_ADDRESS 0x600070B0 /end MEASUREMENT
/begin MEASUREMENT LRS_REGEN2_TR_I.timeCounter "Time counter for negative half wave of fuel modulation / Remaining time of the timer" UWORD t_q0p01 1 100 0.00 655.3500 FORMAT "%8.4" ECU_ADDRESS 0x600070AE /end MEASUREMENT
/begin MEASUREMENT TWCC_BalLimModlnB1TR_I.timeCounter "O2-balance at limit / Remaining time of the timer" UBYTE t_q0p01 1 100 0.00 2.550 FORMAT "%5.3" ECU_ADDRESS 0x6000B5BD /end MEASUREMENT
/begin MEASUREMENT TWCC_BalModlnB1ER_I.buffer "balanced modulation active / rising edge detected" UBYTE B_TRUE 1 100 0.00 1.00000000000 BIT_MASK 0x1 FORMAT "%13.11" ECU_ADDRESS 0x600070AC /end MEASUREMENT
/begin MEASUREMENT TWCC_BalModlnB1ER_I.oldSignal "balanced modulation active / flag rising edge" UBYTE B_TRUE 1 100 0.00 1.00000000000 BIT_MASK 0x1 FORMAT "%13.11" ECU_ADDRESS 0x600070AD /end MEASUREMENT
/begin MEASUREMENT TWCC_bBalLimModlnB1 "bit O2-balance at limit" UBYTE B_TRUE 1 100 0.00 1.00000000000 BIT_MASK 0x1 FORMAT "%13.11" ECU_ADDRESS 0x70000769 /end MEASUREMENT
/begin MEASUREMENT TWCC_bBalModlnB1 "bit balanced modulation active" UBYTE B_TRUE 1 100 0.00 1.00000000000 BIT_MASK 0x1 FORMAT "%13.11" ECU_ADDRESS 0x70000768 /end MEASUREMENT
/begin MEASUREMENT TWCC_bCHModln "bit modulation active during catalyst heating" UBYTE B_TRUE 1 100 0.00 1.00000000000 BIT_MASK 0x1 FORMAT "%13.11" ECU_ADDRESS 0x700000F0 /end MEASUREMENT
/begin MEASUREMENT TWCC_bCtlLimMaxPriB1 "bit controller limited maximum primary control" UBYTE B_TRUE 1 100 0.00 1.00000000000 BIT_MASK 0x1 FORMAT "%13.11" ECU_ADDRESS 0x70000767 /end MEASUREMENT
/begin MEASUREMENT TWCC_bCtlLimMinPriB1 "bit controller limited minimum primary control" UBYTE B_TRUE 1 100 0.00 1.00000000000 BIT_MASK 0x1 FORMAT "%13.11" ECU_ADDRESS 0x70000766 /end MEASUREMENT
/begin MEASUREMENT TWCC_bEnaRichPriB1 "Bit rich catalyst purge" UBYTE B_TRUE 1 100 0.00 1.00000000000 BIT_MASK 0x1 FORMAT "%13.11" ECU_ADDRESS 0x70000765 /end MEASUREMENT
/begin MEASUREMENT TWCC_bEnaRichPriB1FF_I.status "flip-flop bit rich catalyst purge / current value of RS-FF" UBYTE B_TRUE 1 100 0.00 1.00000000000 BIT_MASK 0x1 FORMAT "%13.11" ECU_ADDRESS 0x6000B5B2 /end MEASUREMENT
/begin MEASUREMENT TWCC_bFixPerModlnB1 "bit modulation with fixed period square-wave" UBYTE B_TRUE 1 100 0.00 1.00000000000 BIT_MASK 0x1 FORMAT "%13.11" ECU_ADDRESS 0x700000EF /end MEASUREMENT
/begin MEASUREMENT TWCC_bFlModlnB1 "bit modulation active" UBYTE B_TRUE 1 100 0.00 1.00000000000 BIT_MASK 0x1 FORMAT "%13.11" ECU_ADDRESS 0x70000763 /end MEASUREMENT
/begin MEASUREMENT TWCC_bFlSignCtlBalModlnB1 "bit fuel-sign from balance control" UBYTE B_TRUE 1 100 0.00 1.00000000000 BIT_MASK 0x1 FORMAT "%13.11" ECU_ADDRESS 0x700000EE /end MEASUREMENT
/begin MEASUREMENT TWCC_bFlSignCtlModlnB1 "bit fuel-sign from control" UBYTE B_TRUE 1 100 0.00 1.00000000000 BIT_MASK 0x1 FORMAT "%13.11" ECU_ADDRESS 0x70000762 /end MEASUREMENT
/begin MEASUREMENT TWCC_BFlSignEB_I.buffer "Edge-bi fuel sign, banK1 / EdgeBi.buffer" UBYTE B_TRUE 1 100 0.00 1.00000000000 BIT_MASK 0x1 FORMAT "%13.11" ECU_ADDRESS 0x6000708A /end MEASUREMENT
/begin MEASUREMENT TWCC_BFlSignEB_I.oldSignal "Edge-bi fuel sign, banK1 / EdgeBi.odlSignal" UBYTE B_TRUE 1 100 0.00 1.00000000000 BIT_MASK 0x1 FORMAT "%13.11" ECU_ADDRESS 0x6000708B /end MEASUREMENT
/begin MEASUREMENT TWCC_bIBalPriB1 "bit i-part system conditions debounced primary control enable" UBYTE B_TRUE 1 100 0.00 1.00000000000 BIT_MASK 0x1 FORMAT "%13.11" ECU_ADDRESS 0x700000EB /end MEASUREMENT
/begin MEASUREMENT TWCC_bICoPriB1 "bit i-part controller conditions primary control enable" UBYTE B_TRUE 1 100 0.00 1.00000000000 BIT_MASK 0x1 FORMAT "%13.11" ECU_ADDRESS 0x700000EA /end MEASUREMENT
/begin MEASUREMENT TWCC_bIGlbBalPri "bit i-part global conditions, debounce release, primary control enable" UBYTE B_TRUE 1 100 0.00 1.00000000000 BIT_MASK 0x1 FORMAT "%13.11" ECU_ADDRESS 0x700000E9 /end MEASUREMENT
/begin MEASUREMENT TWCC_bIGlbCPPri "bit i-part global canister purge primary control enable" UBYTE B_TRUE 1 100 0.00 1.00000000000 BIT_MASK 0x1 FORMAT "%13.11" ECU_ADDRESS 0x700000E8 /end MEASUREMENT
/begin MEASUREMENT TWCC_bIGlbLckErrPri "bit i-part global locked with error primary control enable" UBYTE B_TRUE 1 100 0.00 1.00000000000 BIT_MASK 0x1 FORMAT "%13.11" ECU_ADDRESS 0x700000E7 /end MEASUREMENT
/begin MEASUREMENT TWCC_bIGlbPri "bit i-part global primary control enable" UBYTE B_TRUE 1 100 0.00 1.00000000000 BIT_MASK 0x1 FORMAT "%13.11" ECU_ADDRESS 0x700000E6 /end MEASUREMENT
/begin MEASUREMENT TWCC_bIGLbRlNmotPri "bit I-part global load and engine speed control enable" UBYTE B_TRUE 1 100 0.00 1.00000000000 BIT_MASK 0x1 FORMAT "%13.11" ECU_ADDRESS 0x70000761 /end MEASUREMENT
/begin MEASUREMENT TWCC_bIH2DLaPriB1 "bit i-part inhibit delta lambda gradient (H2) primary control enable" UBYTE B_TRUE 1 100 0.00 1.00000000000 BIT_MASK 0x1 FORMAT "%13.11" ECU_ADDRESS 0x700000E5 /end MEASUREMENT
/begin MEASUREMENT TWCC_bIH2LckPriB1 "bit i-part locked due to H2 primary control enable" UBYTE B_TRUE 1 100 0.00 1.00000000000 BIT_MASK 0x1 FORMAT "%13.11" ECU_ADDRESS 0x70000760 /end MEASUREMENT
/begin MEASUREMENT TWCC_bILckErrPriB1 "bit i-part locked with error primary control enable" UBYTE B_TRUE 1 100 0.00 1.00000000000 BIT_MASK 0x1 FORMAT "%13.11" ECU_ADDRESS 0x7000075F /end MEASUREMENT
/begin MEASUREMENT TWCC_bIPriB1 "bit i-part released, primary control enable" UBYTE B_TRUE 1 100 0.00 1.00000000000 BIT_MASK 0x1 FORMAT "%13.11" ECU_ADDRESS 0x7000075E /end MEASUREMENT
/begin MEASUREMENT TWCC_bISysPriB1 "bit i-part system conditions released, primary control enable" UBYTE B_TRUE 1 100 0.00 1.00000000000 BIT_MASK 0x1 FORMAT "%13.11" ECU_ADDRESS 0x700000E4 /end MEASUREMENT
/begin MEASUREMENT TWCC_bITempPriB1 "bit i-part release based on catalyst temperature, primary control enable" UBYTE B_TRUE 1 100 0.00 1.00000000000 BIT_MASK 0x1 FORMAT "%13.11" ECU_ADDRESS 0x700000E3 /end MEASUREMENT
/begin MEASUREMENT TWCC_bLimpCoPriB1 "bit control conditions for p-part limp mode, primary control enable" UBYTE B_TRUE 1 100 0.00 1.00000000000 BIT_MASK 0x1 FORMAT "%13.11" ECU_ADDRESS 0x700000E2 /end MEASUREMENT
/begin MEASUREMENT TWCC_bLimpPriB1 "bit p-part limp home active, primary control enable" UBYTE B_TRUE 1 100 0.00 1.00000000000 BIT_MASK 0x1 FORMAT "%13.11" ECU_ADDRESS 0x7000075B /end MEASUREMENT
/begin MEASUREMENT TWCC_bPBalPriB1 "bit p-part system conditions debounced primary control enable" UBYTE B_TRUE 1 100 0.00 1.00000000000 BIT_MASK 0x1 FORMAT "%13.11" ECU_ADDRESS 0x700000E1 /end MEASUREMENT
/begin MEASUREMENT TWCC_bPCoBalPriB1 "bit p-part controller conditions, for debounce release, primary control enable" UBYTE B_TRUE 1 100 0.00 1.00000000000 BIT_MASK 0x1 FORMAT "%13.11" ECU_ADDRESS 0x700000E0 /end MEASUREMENT
/begin MEASUREMENT TWCC_bPCoPriB1 "bit p-part controller conditions primary control enable" UBYTE B_TRUE 1 100 0.00 1.00000000000 BIT_MASK 0x1 FORMAT "%13.11" ECU_ADDRESS 0x700000DF /end MEASUREMENT
/begin MEASUREMENT TWCC_bPDynTempPriB1 "Condition P-part active based on temperature and dynamic diagnosis" UBYTE B_TRUE 1 100 0.00 1.00000000000 BIT_MASK 0x1 FORMAT "%13.11" ECU_ADDRESS 0x700000DE /end MEASUREMENT
/begin MEASUREMENT TWCC_bPGlbBalPri "bit p-part global conditions, debounce release, primary control enable" UBYTE B_TRUE 1 100 0.00 1.00000000000 BIT_MASK 0x1 FORMAT "%13.11" ECU_ADDRESS 0x700000DD /end MEASUREMENT
/begin MEASUREMENT TWCC_bPGlbLckDiaPri "bit p-part global locked by diagnosis primary control enable" UBYTE B_TRUE 1 100 0.00 1.00000000000 BIT_MASK 0x1 FORMAT "%13.11" ECU_ADDRESS 0x700000DC /end MEASUREMENT
/begin MEASUREMENT TWCC_bPGlbLckErrPri "bit p-part global locked with error primary control enable" UBYTE B_TRUE 1 100 0.00 1.00000000000 BIT_MASK 0x1 FORMAT "%13.11" ECU_ADDRESS 0x700000DB /end MEASUREMENT
/begin MEASUREMENT TWCC_bPGlbPri "bit p-part global primary control enable" UBYTE B_TRUE 1 100 0.00 1.00000000000 BIT_MASK 0x1 FORMAT "%13.11" ECU_ADDRESS 0x700000DA /end MEASUREMENT
/begin MEASUREMENT TWCC_bPGLbRlNmotPri "bit P-part global load and engine speed control enable" UBYTE B_TRUE 1 100 0.00 1.00000000000 BIT_MASK 0x1 FORMAT "%13.11" ECU_ADDRESS 0x7000075A /end MEASUREMENT
/begin MEASUREMENT TWCC_bPLckErrPriB1 "bit p-part locked with error primary control enable" UBYTE B_TRUE 1 100 0.00 1.00000000000 BIT_MASK 0x1 FORMAT "%13.11" ECU_ADDRESS 0x70000759 /end MEASUREMENT
/begin MEASUREMENT TWCC_bPPriB1 "bit p-part released, primary control enable, bank 1" UBYTE B_TRUE 1 100 0.00 1.00000000000 BIT_MASK 0x1 FORMAT "%13.11" ECU_ADDRESS 0x70000758 /end MEASUREMENT
/begin MEASUREMENT TWCC_bPSysPriB1 "bit p-part system conditions released, primary control enable" UBYTE B_TRUE 1 100 0.00 1.00000000000 BIT_MASK 0x1 FORMAT "%13.11" ECU_ADDRESS 0x700000D9 /end MEASUREMENT
/begin MEASUREMENT TWCC_bPTempPriB1 "bit p-part release based on catalyst temperature, primary control enable" UBYTE B_TRUE 1 100 0.00 1.00000000000 BIT_MASK 0x1 FORMAT "%13.11" ECU_ADDRESS 0x700000D8 /end MEASUREMENT
/begin MEASUREMENT TWCC_bReStrtEndEF_I.buffer "edge falling of engine start end for restart detection / memory to detect falling edge" UBYTE B_TRUE 1 100 0.00 1.00000000000 BIT_MASK 0x1 FORMAT "%13.11" ECU_ADDRESS 0x6000705E /end MEASUREMENT
/begin MEASUREMENT TWCC_bReStrtEndEF_I.oldSignal "edge falling of engine start end for restart detection / memory to detect falling edge" UBYTE B_TRUE 1 100 0.00 1.00000000000 BIT_MASK 0x1 FORMAT "%13.11" ECU_ADDRESS 0x6000705F /end MEASUREMENT
/begin MEASUREMENT TWCC_bRstBalModlnB1 "bit O2-reset balanced modulation" UBYTE B_TRUE 1 100 0.00 1.00000000000 BIT_MASK 0x1 FORMAT "%13.11" ECU_ADDRESS 0x700000ED /end MEASUREMENT
/begin MEASUREMENT TWCC_bStrtEndER_I.buffer "trigger end of start reached / rising edge detected" UBYTE B_TRUE 1 100 0.00 1.00000000000 BIT_MASK 0x1 FORMAT "%13.11" ECU_ADDRESS 0x60007088 /end MEASUREMENT
/begin MEASUREMENT TWCC_bStrtEndER_I.oldSignal "trigger end of start reached / flag rising edge" UBYTE B_TRUE 1 100 0.00 1.00000000000 BIT_MASK 0x1 FORMAT "%13.11" ECU_ADDRESS 0x60007089 /end MEASUREMENT
/begin MEASUREMENT TWCC_bStrtEndTONV_I.outbit "debounced end of start reached / return value" UBYTE B_TRUE 1 100 0.00 1.00000000000 BIT_MASK 0x1 FORMAT "%13.11" ECU_ADDRESS 0x60007084 /end MEASUREMENT
/begin MEASUREMENT TWCC_bStrtEndTONV_I.time "debounced end of start reached / expired delay time" UWORD t_q0p05 1 100 0.00 3276.750 FORMAT "%8.3" ECU_ADDRESS 0x60007086 /end MEASUREMENT
/begin MEASUREMENT TWCC_bTrgFixPerModln "bit trigger fixed period square-wave" UBYTE B_TRUE 1 100 0.00 1.00000000000 BIT_MASK 0x1 FORMAT "%13.11" ECU_ADDRESS 0x700000EC /end MEASUREMENT
/begin MEASUREMENT TWCC_DeltaLamSetPDdTModlnB1LT_I.memory "delayed delta lambda setpoint balanced modulation / current lowpass value" SLONG fak_q4p6566Em10 1 100 -1.000000000000000 0.999999999534339 FORMAT "%17.15" ECU_ADDRESS 0x600130A8 /end MEASUREMENT
/begin MEASUREMENT TWCC_DeltaLamSetPModlnB1DTTt_I.buffer "delta lambda setpoint balanced modulation / TWCC_FuelModlncl_Tt_opt" SWORD fak_sw_b1 1 100 -1.000000 0.999969 FORMAT "%8.6" ARRAY_SIZE 11 ECU_ADDRESS 0x60013D98 /end MEASUREMENT
/begin MEASUREMENT TWCC_DeltaLamSetPModlnB1DTTt_I.counter "delta lambda setpoint balanced modulation / TWCC_FuelModlncl_Tt_opt" UWORD fak_uw_b2 1 100 0.00 1.000000 FORMAT "%8.6" ECU_ADDRESS 0x60013DAE /end MEASUREMENT
/begin MEASUREMENT TWCC_DeltaLamSetPModlnB1DTTt_I.ds "delta lambda setpoint balanced modulation / TWCC_FuelModlncl_Tt_opt" UWORD fak_uw_b2 1 100 0.00 1.000000 FORMAT "%8.6" ECU_ADDRESS 0x60013DB0 /end MEASUREMENT
/begin MEASUREMENT TWCC_DeltaLamSetPModlnB1DTTt_I.pointer "delta lambda setpoint balanced modulation / TWCC_FuelModlncl_Tt_opt" UBYTE dez 1 100 0.00 255.0 FORMAT "%5.1" ECU_ADDRESS 0x60013DB2 /end MEASUREMENT
/begin MEASUREMENT TWCC_dmExhSpFil "Exhaust mass flow for setpoint filter, primary control" SWORD m_q0p1 1 100 -3276.800 3276.700 FORMAT "%8.3" ECU_ADDRESS 0x60008FE2 /end MEASUREMENT
/begin MEASUREMENT TWCC_dmO2ModlnB1 "O2-massflow for modeling O2-level balanced modulation" FLOAT32_IEEE mgrad_q1_mgdivs 1 100 -1.0000E+037 1.0000E+037 FORMAT "%10.4" ECU_ADDRESS 0x60002630 /end MEASUREMENT
/begin MEASUREMENT TWCC_dmO2SrcModlnB1 "O2-source for modeling O2-level balanced modulation" FLOAT32_IEEE mgrad_q1_mgdivs 1 100 -1.0000E+037 1.0000E+037 FORMAT "%10.4" ECU_ADDRESS 0x50001D64 /end MEASUREMENT
/begin MEASUREMENT TWCC_dtPMsO2BalPriB1 "dt p-part O2 mass balanced primary control continuous" FLOAT32_IEEE m_q1_mg 1 100 -1.0000E+037 1.0000E+037 FORMAT "%10.4" ECU_ADDRESS 0x50001D68 /end MEASUREMENT
/begin MEASUREMENT TWCC_facFlAmpModln "fuel modulation amplitude" UBYTE fak_ub_b0p25 1 100 0.00 0.249023438 FORMAT "%11.9" ECU_ADDRESS 0x6000FB81 /end MEASUREMENT
/begin MEASUREMENT TWCC_facFlAmpSignModln "amplitude-sign square-wave" SWORD fak_sw_b1 1 100 -1.000000 0.999969 FORMAT "%8.6" ECU_ADDRESS 0x60013DD2 /end MEASUREMENT
/begin MEASUREMENT TWCC_facFlFltModlnB1 "fuel amplitude filtered" SWORD fak_sw_b1 1 100 -1.000000 0.999969 FORMAT "%8.6" ECU_ADDRESS 0x60013DD4 /end MEASUREMENT
/begin MEASUREMENT TWCC_facFlModlnB1 "fuel modulation" SWORD fak_sw_b1 1 100 -1.000000 0.999969 FORMAT "%8.6" ECU_ADDRESS 0x60014954 /end MEASUREMENT
/begin MEASUREMENT TWCC_facIGnCtlPriB1 "factor i-part gain controller primary control continuous" UWORD fak_q0p00015259 1 100 0.00 9.999847 FORMAT "%8.6" ECU_ADDRESS 0x60008DEE /end MEASUREMENT
/begin MEASUREMENT TWCC_facIOSCPriB1 "factor i-part OSC primary control continuous bank 1" UBYTE fak_ub_b1 1 100 0.00 0.9961 ECU_ADDRESS 0x6000F776 /end MEASUREMENT
/begin MEASUREMENT TWCC_facIvsIntrpnPriCont "invers interpolation factor for CNG or FlexFuel" UWORD fak_uw_b2 1 100 0.00 1.000000 FORMAT "%8.6" ECU_ADDRESS 0x60008DEC /end MEASUREMENT
/begin MEASUREMENT TWCC_facOSCCorModln "correction factor OSC for modulation amplitude" UBYTE fak_ub_b2 1 100 0.00 1.992188 FORMAT "%8.6" ECU_ADDRESS 0x60014A4B /end MEASUREMENT
/begin MEASUREMENT TWCC_facOSCGlbB1 "OSC correction factor of global setpoint adjustment" UWORD fak_q3p0518Em5 1 100 0.00 1.999969 FORMAT "%8.6" ECU_ADDRESS 0x6000709C /end MEASUREMENT
/begin MEASUREMENT TWCC_facOSCPriB1 "catalyst ageing factor based on oxygen storage capacity, bank 1" UWORD fak_uw_b2 1 100 0.00 1.999969 FORMAT "%8.6" ECU_ADDRESS 0x6000707C /end MEASUREMENT
/begin MEASUREMENT TWCC_facOSCPriGCURWpDisp "catalyst ageing factor for Group Curve working point display" UWORD fak_uw_b2 1 100 0.00 1.999969 FORMAT "%8.6" ECU_ADDRESS 0x6000707A /end MEASUREMENT
/begin MEASUREMENT TWCC_facPGnCtlPriB1 "factor p-part gain controller primary control continuous" UBYTE fak_ub_b4 1 100 0.00 3.984 FORMAT "%5.3" ECU_ADDRESS 0x60014ACC /end MEASUREMENT
/begin MEASUREMENT TWCC_facPOSCPriB1 "factor p-part OSC primary control continuous bank 1" UBYTE fak_ub_b1 1 100 0.00 0.9961 ECU_ADDRESS 0x6000F775 /end MEASUREMENT
/begin MEASUREMENT TWCC_fcoscxkEB_I.buffer "Edge-bi OSC / EdgeBi.buffer" UBYTE B_TRUE 1 100 0.00 1.00000000000 BIT_MASK 0x1 FORMAT "%13.11" ECU_ADDRESS 0x60007082 /end MEASUREMENT
/begin MEASUREMENT TWCC_fcoscxkEB_I.oldSignal "Edge-bi OSC / EdgeBi.odlSignal" UBYTE B_TRUE 1 100 0.00 1.00000000000 BIT_MASK 0x1 FORMAT "%13.11" ECU_ADDRESS 0x60007083 /end MEASUREMENT
/begin MEASUREMENT TWCC_flgEnaIGpfRgnNotActv "flag enabling I-part of catalyst control when gasoline particle filter regeneration mode not active" UBYTE B_TRUE 1 100 0.00 1.00000000000 BIT_MASK 0x1 FORMAT "%13.11" ECU_ADDRESS 0x700000D7 /end MEASUREMENT
/begin MEASUREMENT TWCC_flgEnaPGpfRgnNotActv "flag enabling P-part of catalyst-control when gasoline particle filter regeneration mode not active" UBYTE B_TRUE 1 100 0.00 1.00000000000 BIT_MASK 0x1 FORMAT "%13.11" ECU_ADDRESS 0x700000D6 /end MEASUREMENT
/begin MEASUREMENT TWCC_flgEnaRichPurgB1EF_I.buffer "Falling edge:bit catalyst Purge / memory to detect falling edge" UBYTE B_TRUE 1 100 0.00 1.00000000000 BIT_MASK 0x1 FORMAT "%13.11" ECU_ADDRESS 0x60007080 /end MEASUREMENT
/begin MEASUREMENT TWCC_flgEnaRichPurgB1EF_I.oldSignal "Falling edge:bit catalyst Purge / memory to detect falling edge" UBYTE B_TRUE 1 100 0.00 1.00000000000 BIT_MASK 0x1 FORMAT "%13.11" ECU_ADDRESS 0x60007081 /end MEASUREMENT
/begin MEASUREMENT TWCC_flgFCMClrReqd100PriB1 "Fault code memory clear requested for 100 ms task" UBYTE B_TRUE 1 100 0.00 1.00000000000 BIT_MASK 0x1 FORMAT "%13.11" ECU_ADDRESS 0x6000F666 /end MEASUREMENT
/begin MEASUREMENT TWCC_flgLstStrtB1FF_I.status "flip flop indicating last start is first start or restart primary control enable / current value of RS-FF" UBYTE B_TRUE 1 100 0.00 1.00000000000 BIT_MASK 0x1 FORMAT "%13.11" ECU_ADDRESS 0x6000B5B1 /end MEASUREMENT
/begin MEASUREMENT TWCC_FlModlnB1DTTt_I.buffer "delay-time fuel modulation / TWCC_FuelModlncl_Tt_opt" SWORD fak_sw_b1 1 100 -1.000000 0.999969 FORMAT "%8.6" ARRAY_SIZE 11 ECU_ADDRESS 0x60013DB4 /end MEASUREMENT
/begin MEASUREMENT TWCC_FlModlnB1DTTt_I.counter "delay-time fuel modulation / TWCC_FuelModlncl_Tt_opt" UWORD fak_uw_b2 1 100 0.00 1.000000 FORMAT "%8.6" ECU_ADDRESS 0x60013DCA /end MEASUREMENT
/begin MEASUREMENT TWCC_FlModlnB1DTTt_I.ds "delay-time fuel modulation / TWCC_FuelModlncl_Tt_opt" UWORD fak_uw_b2 1 100 0.00 1.000000 FORMAT "%8.6" ECU_ADDRESS 0x60013DCC /end MEASUREMENT
/begin MEASUREMENT TWCC_FlModlnB1DTTt_I.pointer "delay-time fuel modulation / TWCC_FuelModlncl_Tt_opt" UBYTE dez 1 100 0.00 255.0 FORMAT "%5.1" ECU_ADDRESS 0x60013DCE /end MEASUREMENT
/begin MEASUREMENT TWCC_FlModlnB1LT_I.memory "lowpass fuel modulation / current lowpass value" SLONG fak_q4p6566Em10 1 100 -1.000000000000000 0.999999999534339 FORMAT "%17.15" ECU_ADDRESS 0x600130AC /end MEASUREMENT
/begin MEASUREMENT TWCC_FlSignCtlBalModlnB1EB_I.buffer "edge-bi fuel-sign from balance control / EdgeBi.buffer" UBYTE B_TRUE 1 100 0.00 1.00000000000 BIT_MASK 0x1 FORMAT "%13.11" ECU_ADDRESS 0x600070AA /end MEASUREMENT
/begin MEASUREMENT TWCC_FlSignCtlBalModlnB1EB_I.oldSignal "edge-bi fuel-sign from balance control / EdgeBi.odlSignal" UBYTE B_TRUE 1 100 0.00 1.00000000000 BIT_MASK 0x1 FORMAT "%13.11" ECU_ADDRESS 0x600070AB /end MEASUREMENT
/begin MEASUREMENT TWCC_FlSignCtlBalModlnB1TR_I.timeCounter "timer fuel-sign from balance control / Remaining time of the timer" UBYTE t_q0p01 1 100 0.00 2.550 FORMAT "%5.3" ECU_ADDRESS 0x6000B5BC /end MEASUREMENT
/begin MEASUREMENT TWCC_HiVltgS2B1ModlnEF_I.buffer "edge-falling high voltage sensor2 / memory to detect falling edge" UBYTE B_TRUE 1 100 0.00 1.00000000000 BIT_MASK 0x1 FORMAT "%13.11" ECU_ADDRESS 0x600070A8 /end MEASUREMENT
/begin MEASUREMENT TWCC_HiVltgS2B1ModlnEF_I.oldSignal "edge-falling high voltage sensor2 / memory to detect falling edge" UBYTE B_TRUE 1 100 0.00 1.00000000000 BIT_MASK 0x1 FORMAT "%13.11" ECU_ADDRESS 0x600070A9 /end MEASUREMENT
/begin MEASUREMENT TWCC_HiVltgS2B1ModlnER_I.buffer "edge-rising high voltage sensor2 / rising edge detected" UBYTE B_TRUE 1 100 0.00 1.00000000000 BIT_MASK 0x1 FORMAT "%13.11" ECU_ADDRESS 0x600070A6 /end MEASUREMENT
/begin MEASUREMENT TWCC_HiVltgS2B1ModlnER_I.oldSignal "edge-rising high voltage sensor2 / flag rising edge" UBYTE B_TRUE 1 100 0.00 1.00000000000 BIT_MASK 0x1 FORMAT "%13.11" ECU_ADDRESS 0x600070A7 /end MEASUREMENT
/begin MEASUREMENT TWCC_HiVltgS2B1ModlnFF_I.status "flip-flop high voltage sensor2 / current value of RS-FF" UBYTE B_TRUE 1 100 0.00 1.00000000000 BIT_MASK 0x1 FORMAT "%13.11" ECU_ADDRESS 0x7000546A /end MEASUREMENT
/begin MEASUREMENT TWCC_HiVltgS2B1ModlnTONV_I.outbit "turn-on high voltage sensor2 / return value" UBYTE B_TRUE 1 100 0.00 1.00000000000 BIT_MASK 0x1 FORMAT "%13.11" ECU_ADDRESS 0x600070A4 /end MEASUREMENT
/begin MEASUREMENT TWCC_HiVltgS2B1ModlnTONV_I.time "turn-on high voltage sensor2 / expired delay time" UBYTE t_q0p01 1 100 0.00 2.550 FORMAT "%5.3" ECU_ADDRESS 0x600070A5 /end MEASUREMENT
/begin MEASUREMENT TWCC_IBalPriB1IK_I.memory "i-part balanced primary control enable / current integrator value" ULONG q1p08505Em5_g 1 100 0.00 46602.6666645 FORMAT "%13.7" ECU_ADDRESS 0x50001D48 /end MEASUREMENT
/begin MEASUREMENT TWCC_IDecelWoFlCutPriEF_I.buffer "EdgeFalling:Inhibit of I part due to deceleration without fuel cut / memory to detect falling edge" UBYTE B_TRUE 1 100 0.00 1.00000000000 BIT_MASK 0x1 FORMAT "%13.11" ECU_ADDRESS 0x60007076 /end MEASUREMENT
/begin MEASUREMENT TWCC_IDecelWoFlCutPriEF_I.oldSignal "EdgeFalling:Inhibit of I part due to deceleration without fuel cut / memory to detect falling edge" UBYTE B_TRUE 1 100 0.00 1.00000000000 BIT_MASK 0x1 FORMAT "%13.11" ECU_ADDRESS 0x60007077 /end MEASUREMENT
/begin MEASUREMENT TWCC_IDecelWoFlCutPriFF_I.status "FilpFlop: Inhibit of I part due to deceleration without fuel cut / current value of RS-FF" UBYTE B_TRUE 1 100 0.00 1.00000000000 BIT_MASK 0x1 FORMAT "%13.11" ECU_ADDRESS 0x6000B5B5 /end MEASUREMENT
/begin MEASUREMENT TWCC_IDecelWoFlCutPriTRE_I.inOld "TimeRetrigger:Inhibit of I part due to deceleration without fuel cut / Previous state of input value" UBYTE B_TRUE 1 100 0.00 1.00000000000 BIT_MASK 0x1 FORMAT "%13.11" ECU_ADDRESS 0x500057E0 /end MEASUREMENT
/begin MEASUREMENT TWCC_IDecelWoFlCutPriTRE_I.timeCounter "TimeRetrigger:Inhibit of I part due to deceleration without fuel cut / Remaining time of the timer" UWORD t_q0p1 1 100 0.00 6553.500 FORMAT "%8.3" ECU_ADDRESS 0x500057E2 /end MEASUREMENT
/begin MEASUREMENT TWCC_IDLaH2PriB1LT_I.memory "lowpass of delta lambda for H2 based inhibit of I-part, primary control enable / current lowpass value" SLONG fak_q4p6566Em11 1 100 -0.100000000000 0.099999999953 FORMAT "%14.12" ECU_ADDRESS 0x6000260C /end MEASUREMENT
/begin MEASUREMENT TWCC_IFlCutTONV_I.outbit "Turn on delay: Fuel cut-off / return value" UBYTE B_TRUE 1 100 0.00 1.00000000000 BIT_MASK 0x1 FORMAT "%13.11" ECU_ADDRESS 0x60007074 /end MEASUREMENT
/begin MEASUREMENT TWCC_IFlCutTONV_I.time "Turn on delay: Fuel cut-off / expired delay time" UBYTE t_q0p1 1 100 0.00 25.50 FORMAT "%5.2" ECU_ADDRESS 0x60007075 /end MEASUREMENT
/begin MEASUREMENT TWCC_IIdlSpdTONV_I.outbit "Turn on delay: Idle speed from drivers sight / return value" UBYTE B_TRUE 1 100 0.00 1.00000000000 BIT_MASK 0x1 FORMAT "%13.11" ECU_ADDRESS 0x60007072 /end MEASUREMENT
/begin MEASUREMENT TWCC_IIdlSpdTONV_I.time "Turn on delay: Idle speed from drivers sight / expired delay time" UBYTE t_q0p1 1 100 0.00 25.50 FORMAT "%5.2" ECU_ADDRESS 0x60007073 /end MEASUREMENT
/begin MEASUREMENT TWCC_ILamSwtH2PriB1EF_I.buffer "Edge falling for lambda sign switch detection, H2 based inhibit of I-part, primary control / memory to detect falling edge" UBYTE B_TRUE 1 100 0.00 1.00000000000 BIT_MASK 0x1 FORMAT "%13.11" ECU_ADDRESS 0x60007070 /end MEASUREMENT
/begin MEASUREMENT TWCC_ILamSwtH2PriB1EF_I.oldSignal "Edge falling for lambda sign switch detection, H2 based inhibit of I-part, primary control / memory to detect falling edge" UBYTE B_TRUE 1 100 0.00 1.00000000000 BIT_MASK 0x1 FORMAT "%13.11" ECU_ADDRESS 0x60007071 /end MEASUREMENT
/begin MEASUREMENT TWCC_ILamSwtH2PriB1T_I.timeCounter "Delay of edge falling for lambda sign switch detection, H2 based inhibit of I-part, primary control / Remaining time of the timer" UBYTE t_q1 1 100 0.00 255.0 FORMAT "%5.1" ECU_ADDRESS 0x6000B5B4 /end MEASUREMENT
/begin MEASUREMENT TWCC_ILdGradPriLT_I.memory "lowpass of engine load gradient / current lowpass value" SLONG rel_q3p576Em7 1 100 -768.000000000 767.999999642 FORMAT "%13.9" ECU_ADDRESS 0x600130B0 /end MEASUREMENT
/begin MEASUREMENT TWCC_ILdGradPriTOFFV_I.outbit "Turn off delay of release of I-part based on engine load gradient / Output Bit" UBYTE B_TRUE 1 100 0.00 1.00000000000 BIT_MASK 0x1 FORMAT "%13.11" ECU_ADDRESS 0x6000706E /end MEASUREMENT
/begin MEASUREMENT TWCC_ILdGradPriTOFFV_I.time "Turn off delay of release of I-part based on engine load gradient / Occured Time" UBYTE t_q0p1 1 100 0.00 25.50 FORMAT "%5.2" ECU_ADDRESS 0x6000706F /end MEASUREMENT
/begin MEASUREMENT TWCC_INLdPriTOFFV_I.outbit "turn off delay of release I-part based on engine speed and load / Output Bit" UBYTE B_TRUE 1 100 0.00 1.00000000000 BIT_MASK 0x1 FORMAT "%13.11" ECU_ADDRESS 0x6000706C /end MEASUREMENT
/begin MEASUREMENT TWCC_INLdPriTOFFV_I.time "turn off delay of release I-part based on engine speed and load / Occured Time" UBYTE t_q0p1 1 100 0.00 25.50 FORMAT "%5.2" ECU_ADDRESS 0x6000706D /end MEASUREMENT
/begin MEASUREMENT TWCC_IOSCRlsH2PriB1IK_I.memory "O2 model of H2 based I-part release, primary control / current integrator value" ULONG m_q3p0518Em7_mgO2 1 100 0.00 1310.71999969 FORMAT "%13.8" ECU_ADDRESS 0x50001D4C /end MEASUREMENT
/begin MEASUREMENT TWCC_LoVltgS2B1ModlnEF_I.buffer "edge-falling low voltage sensor2 / memory to detect falling edge" UBYTE B_TRUE 1 100 0.00 1.00000000000 BIT_MASK 0x1 FORMAT "%13.11" ECU_ADDRESS 0x600070A2 /end MEASUREMENT
/begin MEASUREMENT TWCC_LoVltgS2B1ModlnEF_I.oldSignal "edge-falling low voltage sensor2 / memory to detect falling edge" UBYTE B_TRUE 1 100 0.00 1.00000000000 BIT_MASK 0x1 FORMAT "%13.11" ECU_ADDRESS 0x600070A3 /end MEASUREMENT
/begin MEASUREMENT TWCC_LoVltgS2B1ModlnER_I.buffer "edge-rising low voltage sensor2 / rising edge detected" UBYTE B_TRUE 1 100 0.00 1.00000000000 BIT_MASK 0x1 FORMAT "%13.11" ECU_ADDRESS 0x600070A0 /end MEASUREMENT
/begin MEASUREMENT TWCC_LoVltgS2B1ModlnER_I.oldSignal "edge-rising low voltage sensor2 / flag rising edge" UBYTE B_TRUE 1 100 0.00 1.00000000000 BIT_MASK 0x1 FORMAT "%13.11" ECU_ADDRESS 0x600070A1 /end MEASUREMENT
/begin MEASUREMENT TWCC_LoVltgS2B1ModlnFF_I.status "flip-flop low voltage sensor2 / current value of RS-FF" UBYTE B_TRUE 1 100 0.00 1.00000000000 BIT_MASK 0x1 FORMAT "%13.11" ECU_ADDRESS 0x6000B5BB /end MEASUREMENT
/begin MEASUREMENT TWCC_LoVltgS2B1ModlnTONV_I.outbit "turn-on low voltage sensor2 / return value" UBYTE B_TRUE 1 100 0.00 1.00000000000 BIT_MASK 0x1 FORMAT "%13.11" ECU_ADDRESS 0x6000709E /end MEASUREMENT
/begin MEASUREMENT TWCC_LoVltgS2B1ModlnTONV_I.time "turn-on low voltage sensor2 / expired delay time" UBYTE t_q0p01 1 100 0.00 2.550 FORMAT "%5.3" ECU_ADDRESS 0x6000709F /end MEASUREMENT
/begin MEASUREMENT TWCC_mEffO2ModlnB1 "overall effective oxygen storage capacity upstream" ULONG m_q0p1_mg 1 100 0.00 429496729.500 FORMAT "%13.3" ECU_ADDRESS 0x6000262C /end MEASUREMENT
/begin MEASUREMENT TWCC_mEffO2ModlnGCrvWpDisp "Group curve working point display for overall effective oxygen storage capacity upstream" UWORD m_q1_mg 1 100 0.00 65535.00 FORMAT "%8.2" ECU_ADDRESS 0x600070B6 /end MEASUREMENT
/begin MEASUREMENT TWCC_mExhGsModln "massflow for modulation amplitude" UWORD m_uw_b6553p5 1 100 0.00 6553.500 FORMAT "%8.3" ECU_ADDRESS 0x600070B4 /end MEASUREMENT
/begin MEASUREMENT TWCC_mIBalPThresPriB1 "Exhaust mass threshold for I-part release based on P-part debounce integral" UWORD m_uw_b7281 1 100 0.00 7281.667 FORMAT "%8.3" ECU_ADDRESS 0x60008DEA /end MEASUREMENT
/begin MEASUREMENT TWCC_mIBalThresPriB1 "exhaust mass threshold of I-part debouncing, primary control enable" UWORD m_q0p711_g 1 100 0.00 46602.67 FORMAT "%8.2" ECU_ADDRESS 0x60008DE8 /end MEASUREMENT
/begin MEASUREMENT TWCC_mO2CorThresModlnB1 "correction of threshold switch balanced modulation" ULONG m_q0p1_mg 1 100 0.00 429496729.500 FORMAT "%13.3" ECU_ADDRESS 0x60002628 /end MEASUREMENT
/begin MEASUREMENT TWCC_mO2LimHiModlnB1 "upper limit balanced modulation" ULONG m_q0p1_mg 1 100 0.00 429496729.500 FORMAT "%13.3" ECU_ADDRESS 0x60002624 /end MEASUREMENT
/begin MEASUREMENT TWCC_mO2TrgHiModlnB1 "upper threshold switch balanced modulation" ULONG m_q0p1_mg 1 100 0.00 429496729.500 FORMAT "%13.3" ECU_ADDRESS 0x600130C4 /end MEASUREMENT
/begin MEASUREMENT TWCC_mO2TrgLoModlnB1 "lower threshold switch balanced modulation" ULONG m_q0p1_mg 1 100 0.00 429496729.500 FORMAT "%13.3" ECU_ADDRESS 0x60002620 /end MEASUREMENT
/begin MEASUREMENT TWCC_mPBalThresPriB1 "Exhaust mass threshold of debouncing of P-part release, primary control" UWORD m_q0p711_g 1 100 0.00 46602.67 FORMAT "%8.2" ECU_ADDRESS 0x60008DE6 /end MEASUREMENT
/begin MEASUREMENT TWCC_O2MsModlnB1IKL_I.memory "integral O2-mass modulation / Current Integrator value" FLOAT32_IEEE mgrad_q1_mgdivs 1 100 -1.00000000E+037 1.00000000E+037 FORMAT "%13.3" ECU_ADDRESS 0x600130B4 /end MEASUREMENT
/begin MEASUREMENT TWCC_PBalPriB1IK_I.memory "p-part balanced primary control enable / current integrator value" ULONG q1p08505Em5_g 1 100 0.00 46602.6666645 FORMAT "%13.7" ECU_ADDRESS 0x50001D50 /end MEASUREMENT
/begin MEASUREMENT TWCC_PCoUsPriB1HDR_I.hysterese "Hysteresis P-part release based on lambda controller status / Current value of the hysteresis" UBYTE B_TRUE 1 100 0.00 1.00000000000 BIT_MASK 0x1 FORMAT "%13.11" ECU_ADDRESS 0x6000B5B3 /end MEASUREMENT
/begin MEASUREMENT TWCC_PCoUsPriB1LT_I.memory "lowpass P-part release based on lambda controller status / current lowpass value" UWORD rel_q2p929Em3 1 100 0.00 191.9971 FORMAT "%8.4" ECU_ADDRESS 0x6000706A /end MEASUREMENT
/begin MEASUREMENT TWCC_PCoUsPriB1TOFFV_I.outbit "Turn off delay P-part release based on lambda controller status / Output Bit" UBYTE B_TRUE 1 100 0.00 1.00000000000 BIT_MASK 0x1 FORMAT "%13.11" ECU_ADDRESS 0x60007068 /end MEASUREMENT
/begin MEASUREMENT TWCC_PCoUsPriB1TOFFV_I.time "Turn off delay P-part release based on lambda controller status / Occured Time" UBYTE t_q0p1 1 100 0.00 25.50 FORMAT "%5.2" ECU_ADDRESS 0x60007069 /end MEASUREMENT
/begin MEASUREMENT TWCC_PhSyncB1_I.rActPer "state-machine phase-synchronous average / relative lambda actual value in actual half-period" UWORD fak_uw_b2 1 100 0.00 1.999969 FORMAT "%8.6" ECU_ADDRESS 0x50001D54 /end MEASUREMENT
/begin MEASUREMENT TWCC_PhSyncB1_I.rPhAvrg "state-machine phase-synchronous average / releative phase-synchronous average" SWORD fak_sw_b1 1 100 -1.000000 0.999969 FORMAT "%8.6" ECU_ADDRESS 0x50001D56 /end MEASUREMENT
/begin MEASUREMENT TWCC_PhSyncB1_I.rPrevPer "state-machine phase-synchronous average / relative lambda actual value in previous half-period" UWORD fak_uw_b2 1 100 0.00 1.999969 FORMAT "%8.6" ECU_ADDRESS 0x50001D58 /end MEASUREMENT
/begin MEASUREMENT TWCC_PhSyncB1_I.sm "state-machine phase-synchronous average / state-index of state-machine for phase-synchronous average" UBYTE TWCC_PhSyncZA_sm_VERB 1 100 0.00 2.00000000000 FORMAT "%13.11" ECU_ADDRESS 0x50001D5A /end MEASUREMENT
/begin MEASUREMENT TWCC_PhSyncB1_I.mExhA_I.memory "state-machine phase-synchronous average / mass exhaust gas flow / Accumulator" UWORD m_q0p017778_g 1 100 0.00 1165.067 FORMAT "%8.3" ECU_ADDRESS 0x50001D60 /end MEASUREMENT
/begin MEASUREMENT TWCC_PIDPriB1 "PID interface TWCC_PriB1 data byte B" SBYTE fak_q0p0078 1 100 -1.000 0.992 FORMAT "%5.3" ECU_ADDRESS 0x6000F8A6 /end MEASUREMENT
/begin MEASUREMENT TWCC_PLam1DrctPriB1TOFFV_I.outbit "Turn off delay for direct evaluation lambda 1 condition, p-part release, primary control enable / Output Bit" UBYTE B_TRUE 1 100 0.00 1.00000000000 BIT_MASK 0x1 FORMAT "%13.11" ECU_ADDRESS 0x60007066 /end MEASUREMENT
/begin MEASUREMENT TWCC_PLam1DrctPriB1TOFFV_I.time "Turn off delay for direct evaluation lambda 1 condition, p-part release, primary control enable / Occured Time" UBYTE t_q0p1 1 100 0.00 25.50 FORMAT "%5.2" ECU_ADDRESS 0x60007067 /end MEASUREMENT
/begin MEASUREMENT TWCC_PLam1ErrPriB1TOFFV_I.outbit "Turn off delay for bypassing lambda 1 deviation, p-part release, primary control enable / Output Bit" UBYTE B_TRUE 1 100 0.00 1.00000000000 BIT_MASK 0x1 FORMAT "%13.11" ECU_ADDRESS 0x60007064 /end MEASUREMENT
/begin MEASUREMENT TWCC_PLam1ErrPriB1TOFFV_I.time "Turn off delay for bypassing lambda 1 deviation, p-part release, primary control enable / Occured Time" UBYTE t_q0p1 1 100 0.00 25.50 FORMAT "%5.2" ECU_ADDRESS 0x60007065 /end MEASUREMENT
/begin MEASUREMENT TWCC_PLam1PriB1ER_I.buffer "p-part lambda1 primary control enable / rising edge detected" UBYTE B_TRUE 1 100 0.00 1.00000000000 BIT_MASK 0x1 FORMAT "%13.11" ECU_ADDRESS 0x60007062 /end MEASUREMENT
/begin MEASUREMENT TWCC_PLam1PriB1ER_I.oldSignal "p-part lambda1 primary control enable / flag rising edge" UBYTE B_TRUE 1 100 0.00 1.00000000000 BIT_MASK 0x1 FORMAT "%13.11" ECU_ADDRESS 0x60007063 /end MEASUREMENT
/begin MEASUREMENT TWCC_PMsO2BalPriB1IKL_I.memory "p-part O2 mass balanced primary control continuous / Current Integrator value" FLOAT32_IEEE m_q1_mg 1 100 -1.00000000E+037 1.00000000E+037 FORMAT "%13.3" ECU_ADDRESS 0x6000261C /end MEASUREMENT
/begin MEASUREMENT TWCC_PNLdPriTOFFV_I.outbit "turn off delay of release P-part based on engine speed and load / Output Bit" UBYTE B_TRUE 1 100 0.00 1.00000000000 BIT_MASK 0x1 FORMAT "%13.11" ECU_ADDRESS 0x60007060 /end MEASUREMENT
/begin MEASUREMENT TWCC_PNLdPriTOFFV_I.time "turn off delay of release P-part based on engine speed and load / Occured Time" UBYTE t_q1 1 100 0.00 255.0 FORMAT "%5.1" ECU_ADDRESS 0x60007061 /end MEASUREMENT
/begin MEASUREMENT TWCC_ratO2StrB1WpDisp "working point display of catalyst oxygen storage capacity correction factor" UWORD fak_uw_b2 1 100 0.00 1.999969 FORMAT "%8.6" ECU_ADDRESS 0x6000709A /end MEASUREMENT
/begin MEASUREMENT TWCC_ratOSCSpst "catalyst oxygen storage capacity correction factor" UBYTE fak_q0p0078 1 100 0.00 1.992 FORMAT "%5.3" ECU_ADDRESS 0x6000B5B9 /end MEASUREMENT
/begin MEASUREMENT TWCC_rCtlErrBalPriB1 "relative control error balanced primary control continuous" SWORD fak_sw_b1 1 100 -1.000000 0.999969 FORMAT "%8.6" ECU_ADDRESS 0x60007094 /end MEASUREMENT
/begin MEASUREMENT TWCC_rCtlErrPriB1 "relative control error primary control enable" SWORD fak_sw_b1 1 100 -1.000000 0.999969 FORMAT "%8.6" ECU_ADDRESS 0x60008FE0 /end MEASUREMENT
/begin MEASUREMENT TWCC_rCtlErrPriB1HMD_I.hysterese "hysteresis relative control error primary control enable / Current value of the hysteresis" UBYTE B_TRUE 1 100 0.00 1.00000000000 BIT_MASK 0x1 FORMAT "%13.11" ECU_ADDRESS 0x6000B5B6 /end MEASUREMENT
/begin MEASUREMENT TWCC_rCtlPriB1 "relative control value primary control" SWORD fak_sw_b1 1 100 -1.000000 0.999969 FORMAT "%8.6" ECU_ADDRESS 0x60008FDE /end MEASUREMENT
/begin MEASUREMENT TWCC_rDynSetPIniPriB1 "Initial value of relative dynamic set point correction of primary catalyst control continuous" SWORD fak_sw_b1 1 100 -1.000000 0.999969 FORMAT "%8.6" ECU_ADDRESS 0x60008FDC /end MEASUREMENT
/begin MEASUREMENT TWCC_rDynSetPPriB1 "relative dynamic set point correction of primary catalyst control continuous" SWORD fak_sw_b1 1 100 -1.000000 0.999969 FORMAT "%8.6" ECU_ADDRESS 0x60008FDA /end MEASUREMENT
/begin MEASUREMENT TWCC_rDynSetPPriB1LT_I.memory "relative dynamic set point correction of primary catalyst control continuous / current lowpass value" SLONG fak_q4p6566Em10 1 100 -1.000000000000000 0.999999999534339 FORMAT "%17.15" ECU_ADDRESS 0x60002618 /end MEASUREMENT
/begin MEASUREMENT TWCC_rDynStrtSetPIniPriB1 "Relative dynamic set point after start initialize primary control continuous" SWORD fak_sw_b1 1 100 -1.000000 0.999969 FORMAT "%8.6" ECU_ADDRESS 0x60007092 /end MEASUREMENT
/begin MEASUREMENT TWCC_rDynStrtSetPPriB1 "Relative dynamic set point after start primary control continuous" SWORD fak_sw_b1 1 100 -1.000000 0.999969 FORMAT "%8.6" ECU_ADDRESS 0x60008FD8 /end MEASUREMENT
/begin MEASUREMENT TWCC_rDynStrtSetPPriB1LT_I.memory "LowpassT: Relative dynamic set point after start primary control continuous / current lowpass value" SLONG fak_q4p6566Em10 1 100 -1.000000000000000 0.999999999534339 FORMAT "%17.15" ECU_ADDRESS 0x50001D78 /end MEASUREMENT
/begin MEASUREMENT TWCC_rICtlErrFltPriB1 "relative i-part control error filtered primary control continuous" SWORD fak_sw_b1 1 100 -1.000000 0.999969 FORMAT "%8.6" ECU_ADDRESS 0x60014956 /end MEASUREMENT
/begin MEASUREMENT TWCC_rICtlErrPriB1 "relative i-part control error primary control continuous" SWORD fak_sw_b1 1 100 -1.000000 0.999969 FORMAT "%8.6" ECU_ADDRESS 0x60007090 /end MEASUREMENT
/begin MEASUREMENT TWCC_rICtlHiReslPriB1 "relative i-part control value primary control, high resolution" SLONG fak_sl_b1 1 100 -1.00000000000 0.99999999953 FORMAT "%13.11" ECU_ADDRESS 0x600037CC /end MEASUREMENT
/begin MEASUREMENT TWCC_rICtlIntPriB1 "relative i-part control value internal primary control" SLONG fak_sl_b1 1 100 -1.00000000000 0.99999999953 FORMAT "%13.11" ECU_ADDRESS 0x60038DB0 /end MEASUREMENT
/begin MEASUREMENT TWCC_rICtlPriB1 "relative i-part control value primary control" SWORD fak_sw_b1 1 100 -1.000000 0.999969 FORMAT "%8.6" ECU_ADDRESS 0x60014958 /end MEASUREMENT
/begin MEASUREMENT TWCC_rICtlPriB1_I.memory_l "relative i-part control value primary control continuous / integrated relative i-part control error primary control continuous" SLONG fak_sl_b1 1 100 -1.00000000000 0.99999999953 FORMAT "%13.11" ECU_ADDRESS 0x60002614 /end MEASUREMENT
/begin MEASUREMENT TWCC_rIFlCPPri "relative fuel by canister purge, i-part primary control enable" UWORD fak_uw_b1 1 100 0.00 0.9999847 FORMAT "%9.7" ECU_ADDRESS 0x60007078 /end MEASUREMENT
/begin MEASUREMENT TWCC_rLamActFltPriB1LT_I.memory "low-pass relative i-part lambda actual value filtered primary control continuous / current lowpass value" ULONG fak_q4p6566Em10 1 100 0.00 1.999999999534339 FORMAT "%17.15" ECU_ADDRESS 0x600130C8 /end MEASUREMENT
/begin MEASUREMENT TWCC_rLamActPriB1 "relative lambda actual value primary control" UWORD fak_uw_b2 1 100 0.00 1.999969 FORMAT "%8.6" ECU_ADDRESS 0x600093CE /end MEASUREMENT
/begin MEASUREMENT TWCC_rLamBalModlnB1 "lambda for modeling O2-level balanced modulation" UWORD fak_uw_b16 1 100 0.00 15.99976 FORMAT "%8.5" ECU_ADDRESS 0x600070B2 /end MEASUREMENT
/begin MEASUREMENT TWCC_rLamFltModlnB1 "lambda modulation filtered" SWORD fak_sw_b1 1 100 -1.000000 0.999969 FORMAT "%8.6" ECU_ADDRESS 0x6001495A /end MEASUREMENT
/begin MEASUREMENT TWCC_rLamModlnB1 "lambda modulation" SWORD fak_sw_b1 1 100 -1.000000 0.999969 FORMAT "%8.6" ECU_ADDRESS 0x700053D6 /end MEASUREMENT
/begin MEASUREMENT TWCC_rLamSetPMapPriB1 "relative lambda set point from map primary control" UWORD fak_uw_b2 1 100 0.00 1.999969 FORMAT "%8.6" ECU_ADDRESS 0x6001495C /end MEASUREMENT
/begin MEASUREMENT TWCC_rLamSetPPriB1 "relative lambda set point primary control" UWORD fak_uw_b2 1 100 0.00 1.999969 FORMAT "%8.6" ECU_ADDRESS 0x60008DE4 /end MEASUREMENT
/begin MEASUREMENT TWCC_rPCtlErrFltPriB1 "relative p-part control error filtered primary control continuous" SWORD fak_sw_b1 1 100 -1.000000 0.999969 FORMAT "%8.6" ECU_ADDRESS 0x60009782 /end MEASUREMENT
/begin MEASUREMENT TWCC_rPCtlErrPriB1 "relative p-part control error primary control continuous" SWORD fak_sw_b1 1 100 -1.000000 0.999969 FORMAT "%8.6" ECU_ADDRESS 0x6000708E /end MEASUREMENT
/begin MEASUREMENT TWCC_rPCtlPriB1 "relative p-part control value primary control" SWORD fak_sw_b1 1 100 -1.000000 0.999969 FORMAT "%8.6" ECU_ADDRESS 0x60008FD6 /end MEASUREMENT
/begin MEASUREMENT TWCC_rPMsO2BalPriB1 "relative p-part (normiert) mass O2 balanced primary control continuous" SWORD fak_sw_b1 1 100 -1.000000 0.999969 FORMAT "%8.6" ECU_ADDRESS 0x6000708C /end MEASUREMENT
/begin MEASUREMENT TWCC_rSetPUsGlbB1 "relative set point correction global" SWORD fak_q3p0518Em5 1 100 -1.000000 0.999969 FORMAT "%8.6" ECU_ADDRESS 0x60008FD4 /end MEASUREMENT
/begin MEASUREMENT TWCC_stOpModePri "Actual engine operation mode" UBYTE OneToOne 1 100 0.00 255.0 FORMAT "%5.1" ECU_ADDRESS 0x6000B5B8 /end MEASUREMENT
/begin MEASUREMENT TWCC_tCatLamCorrnGslPriB1LT_I.memory "Filtering of the catalyst temperature in gasoline operation mode / current lowpass value" SLONG temp_q1p5259Em6_om273 1 100 -3549.94000000 3003.65999847 FORMAT "%13.8" ECU_ADDRESS 0x60002610 /end MEASUREMENT
/begin MEASUREMENT TWCC_tiDynSetPPriB1 "filter time constant of relative dynamic set point correction of primary catalyst control continuous" UWORD t_q0p05 1 100 0.050 3276.750 FORMAT "%8.3" ECU_ADDRESS 0x6001495E /end MEASUREMENT
/begin MEASUREMENT TWCC_tiDynStrtSetPPriB1 "Time dynamic set point after start primary control continuous" UWORD t_q0p05 1 100 0.050 3276.750 FORMAT "%8.3" ECU_ADDRESS 0x60014960 /end MEASUREMENT
/begin MEASUREMENT TWCC_tIMinPriB1 "minimum catalyst temperature for I-part release, primary control enable" SWORD Temp_Cels 1 100 -3549.940 3003.560 FORMAT "%8.3" ECU_ADDRESS 0x60008FD2 /end MEASUREMENT
/begin MEASUREMENT TWCC_tiPerModln "period-time lambda amplitude" UWORD t_q0p01 1 100 0.00 655.3500 FORMAT "%8.4" ECU_ADDRESS 0x60013DDA /end MEASUREMENT
/begin MEASUREMENT TWCC_tPMinPriB1 "minimum catalyst temperature for P-part release, primary control enable" SWORD Temp_Cels 1 100 -3549.940 3003.560 FORMAT "%8.3" ECU_ADDRESS 0x60008FD0 /end MEASUREMENT
/begin MEASUREMENT TWCC_uS2B1Lam "binary sensor voltage downstream catalyst for primary catalyst control" UWORD spg_q1p221Em3_V 1 100 0.00 4.998779 FORMAT "%8.6" ECU_ADDRESS 0x600093CA /end MEASUREMENT
/begin MEASUREMENT TWCC_uS2B1LamCorrnGslPri "Corrected binary voltage during gasoline operation mode" UWORD spg_q1p221Em3_V 1 100 0.00 4.998779 FORMAT "%8.6" ECU_ADDRESS 0x60007098 /end MEASUREMENT
/begin MEASUREMENT TWCC_uS2B1LamCorrnPri "Corrected binary voltage" UWORD spg_q1p221Em3_V 1 100 0.00 4.998779 FORMAT "%8.6" ECU_ADDRESS 0x60007096 /end MEASUREMENT
/begin MEASUREMENT TWCC_uS2ThresHiModln "voltage threshold to detect high sensor-voltage during modulation" UBYTE spg_q0p00488 1 100 0.00 1.245 FORMAT "%5.3" ECU_ADDRESS 0x6000B5BF /end MEASUREMENT
/begin MEASUREMENT TWCC_uS2ThresLoModln "voltage threshold to detect low sensor-voltage during modulation" UBYTE spg_q0p00488 1 100 0.00 1.245 FORMAT "%5.3" ECU_ADDRESS 0x6000B5BE /end MEASUREMENT
/begin MEASUREMENT TWCC_uSetPPriB1 "voltage set point primary control" UBYTE spg_q0p00488 1 100 0.00 1.245 FORMAT "%5.3" ECU_ADDRESS 0x6000F774 /end MEASUREMENT
/begin MEASUREMENT TWCC_uSetPPriMapB1 "voltage set point primary control from map bank 1" UBYTE spg_q0p00488 1 100 0.00 1.245 FORMAT "%5.3" ECU_ADDRESS 0x6000B5B7 /end MEASUREMENT
/begin MEASUREMENT TWCC_uSetPPriMapB1LT_I.memory "filter for voltage setpoint primary control from map Bank1 / current lowpass value" UWORD spg_q1p9073Em5 1 100 0.00 1.249981 FORMAT "%8.6" ECU_ADDRESS 0x6000707E /end MEASUREMENT
/begin MEASUREMENT TWCD_CatMeasSMB1_I.arg_Syc_stSub "Instance of TWCD_CatMeasSM, Bank 1 / Argument: ECU system state" UWORD ExeCon_State_02 1 100 0.00 6.00000000000 FORMAT "%13.11" ECU_ADDRESS 0x50001D7C /end MEASUREMENT
/begin MEASUREMENT TWCD_CatMeasSMB1_I.arg_flgOSCMeasmtStart "Instance of TWCD_CatMeasSM, Bank 1 / Condition start of the OSC measurement" UBYTE B_TRUE 1 100 0.00 1.00000000000 BIT_MASK 0x1 FORMAT "%13.11" ECU_ADDRESS 0x50001D7E /end MEASUREMENT
/begin MEASUREMENT TWCD_CatMeasSMB1_I.arg_mOSCNrm "Instance of TWCD_CatMeasSM, Bank 1 / Temperature corrected borderline Oxygen storage capacity (OSC) of catalyst" ULONG m_q0p1_mg 1 100 0.00 429496729.500 FORMAT "%13.3" ECU_ADDRESS 0x50001D80 /end MEASUREMENT
/begin MEASUREMENT TWCD_CatMeasSMB1_I.arg_mOscNew "Instance of TWCD_CatMeasSM, Bank 1 / Argument OSC of new catalyst" ULONG m_q0p1_mg 1 100 0.00 429496729.500 FORMAT "%13.3" ECU_ADDRESS 0x50001D84 /end MEASUREMENT
/begin MEASUREMENT TWCD_CatMeasSMB1_I.arg_mRSCNrm "Instance of TWCD_CatMeasSM, Bank 1 / Temperature corrected borderline Rich gas storage capacity (RSC) of catalyst" ULONG m_q0p1_mg 1 100 0.00 429496729.500 FORMAT "%13.3" ECU_ADDRESS 0x50001D88 /end MEASUREMENT
/begin MEASUREMENT TWCD_CatMeasSMB1_I.arg_mfO2Cat "Instance of TWCD_CatMeasSM, Bank 1 / Argument oxygen mass flow" FLOAT32_IEEE mgrad_q1_mgdivs 1 100 -1.00000000E+037 1.00000000E+037 FORMAT "%13.3" ECU_ADDRESS 0x50001D8C /end MEASUREMENT
/begin MEASUREMENT TWCD_CatMeasSMB1_I.arg_mfO2LsuDynCorrd "Instance of TWCD_CatMeasSM, Bank 1 / Argument oxygen mass flow LSU dynamic corrected" FLOAT32_IEEE mgrad_q1_mgdivs 1 100 -1.00000000E+037 1.00000000E+037 FORMAT "%13.3" ECU_ADDRESS 0x50001D90 /end MEASUREMENT
/begin MEASUREMENT TWCD_CatMeasSMB1_I.arg_stLamGenrParl "Instance of TWCD_CatMeasSM, Bank 1 / Argument: Status of state machine of lambda shifting from coordinator function of parallelization" UBYTE dez 1 100 0.00 255.0 FORMAT "%5.1" ECU_ADDRESS 0x50001D94 /end MEASUREMENT
/begin MEASUREMENT TWCD_CatMeasSMB1_I.arg_stVirtCatParl "Instance of TWCD_CatMeasSM, Bank 1 / Argument: Status of virtual state machine of lambda shifting from coordinator function of parallelization" UBYTE dez 1 100 0.00 255.0 FORMAT "%5.1" ECU_ADDRESS 0x50001D95 /end MEASUREMENT
/begin MEASUREMENT TWCD_CatMeasSMB1_I.arg_tiLtrNrmDly "Instance of TWCD_CatMeasSM, Bank 1 / Normalized delay time (single measuremement) of sensor voltage at transition lean to rich" SWORD t_q0p01 1 100 -327.6800 327.6700 FORMAT "%8.4" ECU_ADDRESS 0x50001D96 /end MEASUREMENT
/begin MEASUREMENT TWCD_CatMeasSMB1_I.arg_tiLtrTran "Instance of TWCD_CatMeasSM, Bank 1 / Transition Time O2Sensor Lean2Rich" SWORD t_q0p01 1 100 -327.6800 327.6700 FORMAT "%8.4" ECU_ADDRESS 0x50001D98 /end MEASUREMENT
/begin MEASUREMENT TWCD_CatMeasSMB1_I.arg_tiRtlNrmDly "Instance of TWCD_CatMeasSM, Bank 1 / Normalized delay time (single measuremement) of sensor voltage at transition rich to lean" SWORD t_q0p01 1 100 -327.6800 327.6700 FORMAT "%8.4" ECU_ADDRESS 0x50001D9A /end MEASUREMENT
/begin MEASUREMENT TWCD_CatMeasSMB1_I.arg_tiRtlTran "Instance of TWCD_CatMeasSM, Bank 1 / Transition Time O2Sensor Rich2Lean" SWORD t_q0p01 1 100 -327.6800 327.6700 FORMAT "%8.4" ECU_ADDRESS 0x50001D9C /end MEASUREMENT
/begin MEASUREMENT TWCD_CatMeasSMB1_I.arg_uDs "Instance of TWCD_CatMeasSM, Bank 1 / Argument voltage of HEGO sensor downstream catalyst" UWORD spg_q1p221Em3_V 1 100 0.00 4.998779 FORMAT "%8.6" ECU_ADDRESS 0x50001D9E /end MEASUREMENT
/begin MEASUREMENT TWCD_CatMeasSMB1_I.arg_uLeanFinThres "Instance of TWCD_CatMeasSM, Bank 1 / Lean threshold for downstream sensor signal to end lean phase of cat monitoring" UWORD spg_q1p221Em3_V 1 100 0.00 4.998779 FORMAT "%8.6" ECU_ADDRESS 0x50001DA0 /end MEASUREMENT
/begin MEASUREMENT TWCD_CatMeasSMB1_I.arg_uRichFinThres "Instance of TWCD_CatMeasSM, Bank 1 / Rich threshold for downstream sensor signal to end phase of RSC measuring" UWORD spg_q1p221Em3_V 1 100 0.00 4.998779 FORMAT "%8.6" ECU_ADDRESS 0x50001DA2 /end MEASUREMENT
/begin MEASUREMENT TWCD_CatMeasSMB1_I.dmOscCorr "Instance of TWCD_CatMeasSM, Bank 1 / OSC correction by HEGO dynamic" ULONG m_q0p1_mg 1 100 0.00 429496729.500 FORMAT "%13.3" ECU_ADDRESS 0x50001DA4 /end MEASUREMENT
/begin MEASUREMENT TWCD_CatMeasSMB1_I.flgMeasFin "Instance of TWCD_CatMeasSM, Bank 1 / Flag measurement of catalyst availible" UBYTE B_TRUE 1 100 0.00 1.00000000000 BIT_MASK 0x1 FORMAT "%13.11" ECU_ADDRESS 0x50001DA9 /end MEASUREMENT
/begin MEASUREMENT TWCD_CatMeasSMB1_I.flgMeasmtFinshd200ms "Instance of TWCD_CatMeasSM, Bank 1 / Flag measurement of catalyst availible, 200ms" UBYTE B_TRUE 1 100 0.00 1.00000000000 BIT_MASK 0x1 FORMAT "%13.11" ECU_ADDRESS 0x60007058 /end MEASUREMENT
/begin MEASUREMENT TWCD_CatMeasSMB1_I.flgMeasmtFinshdVirt "Instance of TWCD_CatMeasSM, Bank 1 / Flag virtual measurement of catalyst available" UBYTE B_TRUE 1 100 0.00 1.00000000000 BIT_MASK 0x1 FORMAT "%13.11" ECU_ADDRESS 0x50001DAA /end MEASUREMENT
/begin MEASUREMENT TWCD_CatMeasSMB1_I.flgMeasmtFinshdVirt200ms "Instance of TWCD_CatMeasSM, Bank 1 / Flag virtual measurement of catalyst availible, 200ms" UBYTE B_TRUE 1 100 0.00 1.00000000000 BIT_MASK 0x1 FORMAT "%13.11" ECU_ADDRESS 0x60007059 /end MEASUREMENT
/begin MEASUREMENT TWCD_CatMeasSMB1_I.flgPtlMeasOSCFin "Instance of TWCD_CatMeasSM, Bank 1 / OSC Partial result completed" UBYTE B_TRUE 1 100 0.00 1.00000000000 BIT_MASK 0x1 FORMAT "%13.11" ECU_ADDRESS 0x50001DAB /end MEASUREMENT
/begin MEASUREMENT TWCD_CatMeasSMB1_I.flgPtlMeasRSCFin "Instance of TWCD_CatMeasSM, Bank 1 / ROSC Partial result completed" UBYTE B_TRUE 1 100 0.00 1.00000000000 BIT_MASK 0x1 FORMAT "%13.11" ECU_ADDRESS 0x50001DAC /end MEASUREMENT
/begin MEASUREMENT TWCD_CatMeasSMB1_I.flgPtlMeasRSCFinTmp "Instance of TWCD_CatMeasSM, Bank 1 / ROSC Partial result completed, preliminary" UBYTE B_TRUE 1 100 0.00 1.00000000000 BIT_MASK 0x1 FORMAT "%13.11" ECU_ADDRESS 0x50001DAD /end MEASUREMENT
/begin MEASUREMENT TWCD_CatMeasSMB1_I.mOSC "Instance of TWCD_CatMeasSM, Bank 1 / Result of OSC measurement" ULONG m_q0p1_mg 1 100 0.00 429496729.500 FORMAT "%13.3" ECU_ADDRESS 0x50001DB0 /end MEASUREMENT
/begin MEASUREMENT TWCD_CatMeasSMB1_I.mOSCraw "Instance of TWCD_CatMeasSM, Bank 1 / Uncorrected OSC-result" ULONG m_q0p1_mg 1 100 0.00 429496729.500 FORMAT "%13.3" ECU_ADDRESS 0x50001DB4 /end MEASUREMENT
/begin MEASUREMENT TWCD_CatMeasSMB1_I.mOscLsuDynCorrd "Instance of TWCD_CatMeasSM, Bank 1 / OSC measurement with LSU dynamic correction" ULONG m_q0p1_mg 1 100 0.00 429496729.500 FORMAT "%13.3" ECU_ADDRESS 0x50001DB8 /end MEASUREMENT
/begin MEASUREMENT TWCD_CatMeasSMB1_I.mOscNv "Instance of TWCD_CatMeasSM, Bank 1 / OSC measurement, non volatile" ULONG m_q0p1_mg 1 100 0.00 429496729.500 FORMAT "%13.3" ECU_ADDRESS 0x60038DAC /end MEASUREMENT
/begin MEASUREMENT TWCD_CatMeasSMB1_I.mOscRawLsuDynCorrd "Instance of TWCD_CatMeasSM, Bank 1 / uncorrected OSC measurement with LSU dynamic correction" ULONG m_q0p1_mg 1 100 0.00 429496729.500 FORMAT "%13.3" ECU_ADDRESS 0x50001DBC /end MEASUREMENT
/begin MEASUREMENT TWCD_CatMeasSMB1_I.mOscRawTmp "Instance of TWCD_CatMeasSM, Bank 1 / Uncorrected OSC-result, temporary" ULONG m_q0p1_mg 1 100 0.00 429496729.500 FORMAT "%13.3" ECU_ADDRESS 0x50001DC0 /end MEASUREMENT
/begin MEASUREMENT TWCD_CatMeasSMB1_I.mRoscLsuDynCorrd "Instance of TWCD_CatMeasSM, Bank 1 / RSC measurement with LSU dynamic correction" ULONG m_q0p1_mg 1 100 0.00 429496729.500 FORMAT "%13.3" ECU_ADDRESS 0x50001DC4 /end MEASUREMENT
/begin MEASUREMENT TWCD_CatMeasSMB1_I.mRoscRawLsuDynCorrd "Instance of TWCD_CatMeasSM, Bank 1 / uncorrected RSC measurement with LSU dynamic correction" ULONG m_q0p1_mg 1 100 0.00 429496729.500 FORMAT "%13.3" ECU_ADDRESS 0x50001DC8 /end MEASUREMENT
/begin MEASUREMENT TWCD_CatMeasSMB1_I.ratOsc "Instance of TWCD_CatMeasSM, Bank 1 / normalized OSC" UWORD fak_uw_b16 1 100 0.00 15.99976 FORMAT "%8.5" ECU_ADDRESS 0x50001DCC /end MEASUREMENT
/begin MEASUREMENT TWCD_CatMeasSMB1_I.sm "Instance of TWCD_CatMeasSM, Bank 1 / Active State of statemachine" UBYTE TWCD_CatMeasSM_sm_VERB 1 100 0.00 8.00000000000 FORMAT "%13.11" ECU_ADDRESS 0x50001DCE /end MEASUREMENT
/begin MEASUREMENT TWCD_CatMeasSMB1_I.tiCorLeanRich "Instance of TWCD_CatMeasSM, Bank 1 / Correction for transition and delay time LeanToRich" UWORD t_q0p02 1 100 0.00 1310.700 FORMAT "%8.3" ECU_ADDRESS 0x50001DD0 /end MEASUREMENT
/begin MEASUREMENT TWCD_CatMeasSMB1_I.tiCorRichLean "Instance of TWCD_CatMeasSM, Bank 1 / Correction for transition and delay time RichToLean" UWORD t_q0p02 1 100 0.00 1310.700 FORMAT "%8.3" ECU_ADDRESS 0x50001DD2 /end MEASUREMENT
/begin MEASUREMENT TWCD_CatMeasSMB1_I.DynCorrnOscLsuDyn_I.dmO2Corrn "Instance of TWCD_CatMeasSM, Bank 1 / class inst. for OSC correction with HEGO dynamic time, OSC with LSU dynamic correction / Deduction amount of HEGO dynamic correction" ULONG m_q0p1_mg 1 100 0.00 429496729.500 FORMAT "%13.3" ECU_ADDRESS 0x50001DD4 /end MEASUREMENT
/begin MEASUREMENT TWCD_CatMeasSMB1_I.DynCorrnOscLsuDyn_I.dmO2Grdt "Instance of TWCD_CatMeasSM, Bank 1 / class inst. for OSC correction with HEGO dynamic time, OSC with LSU dynamic correction / OSC gradient during OSC measurement for HEGO dynamic correction" ULONG m_q0p1_mgs 1 100 0.00 429496729.500 FORMAT "%13.3" ECU_ADDRESS 0x50001DD8 /end MEASUREMENT
/begin MEASUREMENT TWCD_CatMeasSMB1_I.DynCorrnOscLsuDyn_I.mO2CorSlp "Instance of TWCD_CatMeasSM, Bank 1 / class inst. for OSC correction with HEGO dynamic time, OSC with LSU dynamic correction / Temporary variable f. OSC gradient calculation" ULONG m_q0p1_mg 1 100 0.00 429496729.500 FORMAT "%13.3" ECU_ADDRESS 0x50001DDC /end MEASUREMENT
/begin MEASUREMENT TWCD_CatMeasSMB1_I.DynCorrnOscLsuDyn_I.mO2Corrd "Instance of TWCD_CatMeasSM, Bank 1 / class inst. for OSC correction with HEGO dynamic time, OSC with LSU dynamic correction / OSC with HEGO dynamic correction" ULONG m_q0p1_mg 1 100 0.00 429496729.500 FORMAT "%13.3" ECU_ADDRESS 0x50001DE0 /end MEASUREMENT
/begin MEASUREMENT TWCD_CatMeasSMB1_I.DynCorrnOscLsuDyn_I.tiCorSlp "Instance of TWCD_CatMeasSM, Bank 1 / class inst. for OSC correction with HEGO dynamic time, OSC with LSU dynamic correction / Time base f. OSC gradient calculation" UWORD t_q0p02 1 100 0.00 1310.700 FORMAT "%8.3" ECU_ADDRESS 0x50001DE4 /end MEASUREMENT
/begin MEASUREMENT TWCD_CatMeasSMB1_I.DynCorrnOsc_I.dmO2Corrn "Instance of TWCD_CatMeasSM, Bank 1 / class inst. for OSC correction with HEGO dynamic time / Deduction amount of HEGO dynamic correction" ULONG m_q0p1_mg 1 100 0.00 429496729.500 FORMAT "%13.3" ECU_ADDRESS 0x50001DE8 /end MEASUREMENT
/begin MEASUREMENT TWCD_CatMeasSMB1_I.DynCorrnOsc_I.dmO2Grdt "Instance of TWCD_CatMeasSM, Bank 1 / class inst. for OSC correction with HEGO dynamic time / OSC gradient during OSC measurement for HEGO dynamic correction" ULONG m_q0p1_mgs 1 100 0.00 429496729.500 FORMAT "%13.3" ECU_ADDRESS 0x50001DEC /end MEASUREMENT
/begin MEASUREMENT TWCD_CatMeasSMB1_I.DynCorrnOsc_I.mO2CorSlp "Instance of TWCD_CatMeasSM, Bank 1 / class inst. for OSC correction with HEGO dynamic time / Temporary variable f. OSC gradient calculation" ULONG m_q0p1_mg 1 100 0.00 429496729.500 FORMAT "%13.3" ECU_ADDRESS 0x50001DF0 /end MEASUREMENT
/begin MEASUREMENT TWCD_CatMeasSMB1_I.DynCorrnOsc_I.mO2Corrd "Instance of TWCD_CatMeasSM, Bank 1 / class inst. for OSC correction with HEGO dynamic time / OSC with HEGO dynamic correction" ULONG m_q0p1_mg 1 100 0.00 429496729.500 FORMAT "%13.3" ECU_ADDRESS 0x50001DF4 /end MEASUREMENT
/begin MEASUREMENT TWCD_CatMeasSMB1_I.DynCorrnOsc_I.tiCorSlp "Instance of TWCD_CatMeasSM, Bank 1 / class inst. for OSC correction with HEGO dynamic time / Time base f. OSC gradient calculation" UWORD t_q0p02 1 100 0.00 1310.700 FORMAT "%8.3" ECU_ADDRESS 0x50001DF8 /end MEASUREMENT
/begin MEASUREMENT TWCD_CatMeasSMB1_I.DynCorrnRosc_I.dmO2Corrn "Instance of TWCD_CatMeasSM, Bank 1 / class inst. for RSC correction with HEGO dynamic time / Deduction amount of HEGO dynamic correction" ULONG m_q0p1_mg 1 100 0.00 429496729.500 FORMAT "%13.3" ECU_ADDRESS 0x50001DFC /end MEASUREMENT
/begin MEASUREMENT TWCD_CatMeasSMB1_I.DynCorrnRosc_I.dmO2Grdt "Instance of TWCD_CatMeasSM, Bank 1 / class inst. for RSC correction with HEGO dynamic time / OSC gradient during OSC measurement for HEGO dynamic correction" ULONG m_q0p1_mgs 1 100 0.00 429496729.500 FORMAT "%13.3" ECU_ADDRESS 0x50001E00 /end MEASUREMENT
/begin MEASUREMENT TWCD_CatMeasSMB1_I.DynCorrnRosc_I.mO2CorSlp "Instance of TWCD_CatMeasSM, Bank 1 / class inst. for RSC correction with HEGO dynamic time / Temporary variable f. OSC gradient calculation" ULONG m_q0p1_mg 1 100 0.00 429496729.500 FORMAT "%13.3" ECU_ADDRESS 0x50001E04 /end MEASUREMENT
/begin MEASUREMENT TWCD_CatMeasSMB1_I.DynCorrnRosc_I.mO2Corrd "Instance of TWCD_CatMeasSM, Bank 1 / class inst. for RSC correction with HEGO dynamic time / OSC with HEGO dynamic correction" ULONG m_q0p1_mg 1 100 0.00 429496729.500 FORMAT "%13.3" ECU_ADDRESS 0x50001E08 /end MEASUREMENT
/begin MEASUREMENT TWCD_CatMeasSMB1_I.DynCorrnRosc_I.tiCorSlp "Instance of TWCD_CatMeasSM, Bank 1 / class inst. for RSC correction with HEGO dynamic time / Time base f. OSC gradient calculation" UWORD t_q0p02 1 100 0.00 1310.700 FORMAT "%8.3" ECU_ADDRESS 0x50001E0C /end MEASUREMENT
/begin MEASUREMENT TWCD_CatMeasSMB1_I.O2LsuDynCorrdIKL_I.memory "Instance of TWCD_CatMeasSM, Bank 1 / oxygen integrator using LSU dynamic corrected oxygen mass flow / Current Integrator value" FLOAT32_IEEE m_q1_mg 1 100 0.0000 1.0000E+037 FORMAT "%10.4" ECU_ADDRESS 0x50001E10 /end MEASUREMENT
/begin MEASUREMENT TWCD_CatMeasSMB1_I.O2MsIKL_I.memory "Instance of TWCD_CatMeasSM, Bank 1 / oxygen integrator / Current Integrator value" FLOAT32_IEEE m_q1_mg 1 100 0.0000 1.0000E+037 FORMAT "%10.4" ECU_ADDRESS 0x50001E14 /end MEASUREMENT
/begin MEASUREMENT TWCD_CatMeasSMB1_I.flgMeasmtFinshdFF_I.status "Instance of TWCD_CatMeasSM, Bank 1 / flip flop for flag measurement of catalyst availible / current value of RS-FF" UBYTE B_TRUE 1 100 0.00 1.00000000000 BIT_MASK 0x1 FORMAT "%13.11" ECU_ADDRESS 0x50001E18 /end MEASUREMENT
/begin MEASUREMENT TWCD_CatMeasSMB1_I.flgMeasmtFinshdVirtFF_I.status "Instance of TWCD_CatMeasSM, Bank 1 / flip flop for virtual flag measurement of catalyst available / current value of RS-FF" UBYTE B_TRUE 1 100 0.00 1.00000000000 BIT_MASK 0x1 FORMAT "%13.11" ECU_ADDRESS 0x50001E19 /end MEASUREMENT
/begin MEASUREMENT TWCD_CatMeasSMB1_I.flgVirtMeasmtER_I.buffer "Instance of TWCD_CatMeasSM, Bank 1 / Edge rising f. virtual measurement of catalyst available / rising edge detected" UBYTE B_TRUE 1 100 0.00 1.00000000000 BIT_MASK 0x1 FORMAT "%13.11" ECU_ADDRESS 0x50001E1A /end MEASUREMENT
/begin MEASUREMENT TWCD_CatMeasSMB1_I.flgVirtMeasmtER_I.oldSignal "Instance of TWCD_CatMeasSM, Bank 1 / Edge rising f. virtual measurement of catalyst available / flag rising edge" UBYTE B_TRUE 1 100 0.00 1.00000000000 BIT_MASK 0x1 FORMAT "%13.11" ECU_ADDRESS 0x50001E1B /end MEASUREMENT
/begin MEASUREMENT TWCD_ctReIniEval "ReInitialization counter" UBYTE OneToOne 1 100 0.00 255.0 FORMAT "%5.1" ECU_ADDRESS 0x6000B5B0 /end MEASUREMENT
/begin MEASUREMENT TWCD_dmGasB1 "exhaust mass flow catalyst, local" UWORD m_uw_b6553p5 1 100 0.00 6553.500 FORMAT "%8.3" ECU_ADDRESS 0x6000705A /end MEASUREMENT
/begin MEASUREMENT TWCD_DsmIfCat1B1_I.flgErr "TWCD_Eval: class for DSM interface - Cat1B1 / Flag error" UBYTE B_TRUE 1 100 0.00 1.00000000000 BIT_MASK 0x1 FORMAT "%13.11" ECU_ADDRESS 0x500057E4 /end MEASUREMENT
/begin MEASUREMENT TWCD_DsmIfCat1B1_I.flgErrSus "TWCD_Eval: class for DSM interface - Cat1B1 / Flag suspected error" UBYTE B_TRUE 1 100 0.00 1.00000000000 BIT_MASK 0x1 FORMAT "%13.11" ECU_ADDRESS 0x500057E5 /end MEASUREMENT
/begin MEASUREMENT TWCD_DsmIfCat1B1_I.flgHeal "TWCD_Eval: class for DSM interface - Cat1B1 / Flag healing (ok result)" UBYTE B_TRUE 1 100 0.00 1.00000000000 BIT_MASK 0x1 FORMAT "%13.11" ECU_ADDRESS 0x500057E6 /end MEASUREMENT
/begin MEASUREMENT TWCD_DsmIfCat1B1_I.flgVldnFin "TWCD_Eval: class for DSM interface - Cat1B1 / Flag validation finished" UBYTE B_TRUE 1 100 0.00 1.00000000000 BIT_MASK 0x1 FORMAT "%13.11" ECU_ADDRESS 0x500057E7 /end MEASUREMENT
/begin MEASUREMENT TWCD_DsmIfCat1B1_I.rDiagRslt "TWCD_Eval: class for DSM interface - Cat1B1 / quantitative diagnosis result" UWORD fak_uw_b16 1 100 0.00 15.99976 FORMAT "%8.5" ECU_ADDRESS 0x500057E8 /end MEASUREMENT
/begin MEASUREMENT TWCD_DsmIfCat1B1_I.RsltER_I.buffer "TWCD_Eval: class for DSM interface - Cat1B1 / diagnosis result edge rising / rising edge detected" UBYTE B_TRUE 1 100 0.00 1.00000000000 BIT_MASK 0x1 FORMAT "%13.11" ECU_ADDRESS 0x500057EA /end MEASUREMENT
/begin MEASUREMENT TWCD_DsmIfCat1B1_I.RsltER_I.oldSignal "TWCD_Eval: class for DSM interface - Cat1B1 / diagnosis result edge rising / flag rising edge" UBYTE B_TRUE 1 100 0.00 1.00000000000 BIT_MASK 0x1 FORMAT "%13.11" ECU_ADDRESS 0x500057EB /end MEASUREMENT
/begin MEASUREMENT TWCD_DsmIfCat1B1_I.flgErrSusERNM_I.oldSignal "TWCD_Eval: class for DSM interface - Cat1B1 / edge rising suspected error / value of input signal last calculation" UBYTE B_TRUE 1 100 0.00 1.00000000000 BIT_MASK 0x1 FORMAT "%13.11" ECU_ADDRESS 0x500057EC /end MEASUREMENT
/begin MEASUREMENT TWCD_flgErrSusB1 "Error suspected in catalyst diagnosis, bank1" UBYTE B_TRUE 1 100 0.00 1.00000000000 BIT_MASK 0x1 FORMAT "%13.11" ECU_ADDRESS 0x70000754 /end MEASUREMENT
/begin MEASUREMENT TWCD_flgEvalDsmTripChgFinshd "flag for dsm trip charge finished in TWCD_Eval" UBYTE B_TRUE 1 100 0.00 1.00000000000 BIT_MASK 0x1 FORMAT "%13.11" ECU_ADDRESS 0x700000D5 /end MEASUREMENT
/begin MEASUREMENT TWCD_flgFCMClrReqdCatMeasCat1B1 "FCM-Clear requested Cat1 Bank1" UBYTE B_TRUE 1 100 0.00 1.00000000000 BIT_MASK 0x1 FORMAT "%13.11" ECU_ADDRESS 0x70000753 /end MEASUREMENT
/begin MEASUREMENT TWCD_flgFCMClrReqdEvalCat1B1 "FCM-Clear requested Cat1 Bank1" UBYTE B_TRUE 1 100 0.00 1.00000000000 BIT_MASK 0x1 FORMAT "%13.11" ECU_ADDRESS 0x700000D4 /end MEASUREMENT
/begin MEASUREMENT TWCD_flgMeasFinB1 "Flag measurement of catalyst availible" UBYTE B_TRUE 1 100 0.00 1.00000000000 BIT_MASK 0x1 FORMAT "%13.11" ECU_ADDRESS 0x70000752 /end MEASUREMENT
/begin MEASUREMENT TWCD_flgMeasFinshdTripB1 "completed catalyst diagnosis measurements for current driving cycle" UBYTE B_TRUE 1 100 0.00 1.00000000000 BIT_MASK 0x1 FORMAT "%13.11" ECU_ADDRESS 0x70000750 /end MEASUREMENT
/begin MEASUREMENT TWCD_flgMeasFinshdVirtTripB1 "Flag virtual measurements complete for this driving cycle" UBYTE B_TRUE 1 100 0.00 1.00000000000 BIT_MASK 0x1 FORMAT "%13.11" ECU_ADDRESS 0x7000074F /end MEASUREMENT
/begin MEASUREMENT TWCD_flgMeasFinVirtB1 "Flag virtual measurement of catalyst availible" UBYTE B_TRUE 1 100 0.00 1.00000000000 BIT_MASK 0x1 FORMAT "%13.11" ECU_ADDRESS 0x70000751 /end MEASUREMENT
/begin MEASUREMENT TWCD_flgOSCQPFaildPriB1 "Flag QuickPass not passed with actual measurement" UBYTE B_TRUE 1 100 0.00 1.00000000000 BIT_MASK 0x1 FORMAT "%13.11" ECU_ADDRESS 0x7000074E /end MEASUREMENT
/begin MEASUREMENT TWCD_flgOSCStepChgPriB1 "StepChange for OSC-measurement active" UBYTE B_TRUE 1 100 0.00 1.00000000000 BIT_MASK 0x1 FORMAT "%13.11" ECU_ADDRESS 0x7000074D /end MEASUREMENT
/begin MEASUREMENT TWCD_flgPtlMeasOSCFinB1 "OSC Partial result completed, bank 1" UBYTE B_TRUE 1 100 0.00 1.00000000000 BIT_MASK 0x1 FORMAT "%13.11" ECU_ADDRESS 0x7000074C /end MEASUREMENT
/begin MEASUREMENT TWCD_flgPtlMeasRSCFinB1 "ROSC Partial result completed, bank 1" UBYTE B_TRUE 1 100 0.00 1.00000000000 BIT_MASK 0x1 FORMAT "%13.11" ECU_ADDRESS 0x7000074B /end MEASUREMENT
/begin MEASUREMENT TWCD_flgResOSCPriB1 "OSC-result of catalyst diagnosis available (not validated)" UBYTE B_TRUE 1 100 0.00 1.00000000000 BIT_MASK 0x1 FORMAT "%13.11" ECU_ADDRESS 0x7000074A /end MEASUREMENT
/begin MEASUREMENT TWCD_flgResVirtOSCPriB1 "OSC-result of catalyst diagnosis for IUMPR-simulation available (not validated)" UBYTE B_TRUE 1 100 0.00 1.00000000000 BIT_MASK 0x1 FORMAT "%13.11" ECU_ADDRESS 0x70000749 /end MEASUREMENT
/begin MEASUREMENT TWCD_FltDsEval_B1.flgMeasFinshdTrip "Filter class for catalyt diagnosis / Flag measurements complete for this driving cycle" UBYTE B_TRUE 1 100 0.00 1.00000000000 BIT_MASK 0x1 FORMAT "%13.11" ECU_ADDRESS 0x50001E1C /end MEASUREMENT
/begin MEASUREMENT TWCD_FltDsEval_B1.flgNumTemp "Filter class for catalyt diagnosis / Flag activ if the number of virtual measurement is bigger than a threshold" UBYTE B_TRUE 1 100 0.00 1.00000000000 BIT_MASK 0x1 FORMAT "%13.11" ECU_ADDRESS 0x50001E1D /end MEASUREMENT
/begin MEASUREMENT TWCD_FltDsEval_B1.flgOSCQPFaild "Filter class for catalyt diagnosis / Flag QuickPass with current measurement not successful" UBYTE B_TRUE 1 100 0.00 1.00000000000 BIT_MASK 0x1 FORMAT "%13.11" ECU_ADDRESS 0x50001E1E /end MEASUREMENT
/begin MEASUREMENT TWCD_FltDsEval_B1.flgOSCStepChgPri "Filter class for catalyt diagnosis / StepChange for OSC- Measurement active" UBYTE B_TRUE 1 100 0.00 1.00000000000 BIT_MASK 0x1 FORMAT "%13.11" ECU_ADDRESS 0x60038DA0 /end MEASUREMENT
/begin MEASUREMENT TWCD_FltDsEval_B1.flgQPFaild "Filter class for catalyt diagnosis / Condition: diagnosis has not achieved Quickpass" UBYTE B_TRUE 1 100 0.00 1.00000000000 BIT_MASK 0x1 FORMAT "%13.11" ECU_ADDRESS 0x50001E1F /end MEASUREMENT
/begin MEASUREMENT TWCD_FltDsEval_B1.flgQckPassd "Filter class for catalyt diagnosis / Condition: diagnosis has achieved Quickpass" UBYTE B_TRUE 1 100 0.00 1.00000000000 BIT_MASK 0x1 FORMAT "%13.11" ECU_ADDRESS 0x50001E20 /end MEASUREMENT
/begin MEASUREMENT TWCD_FltDsEval_B1.flgResOSCPri "Filter class for catalyt diagnosis / OSC Result of catalyst diagnosis present" UBYTE B_TRUE 1 100 0.00 1.00000000000 BIT_MASK 0x1 FORMAT "%13.11" ECU_ADDRESS 0x50001E21 /end MEASUREMENT
/begin MEASUREMENT TWCD_FltDsEval_B1.flgResVirtOSCPri "Filter class for catalyt diagnosis / OSC Result of catalyst diagnosis for IUMPR- Simulation present" UBYTE B_TRUE 1 100 0.00 1.00000000000 BIT_MASK 0x1 FORMAT "%13.11" ECU_ADDRESS 0x50001E22 /end MEASUREMENT
/begin MEASUREMENT TWCD_FltDsEval_B1.flgStepChg "Filter class for catalyt diagnosis / Condition: Step-change logic active" UBYTE B_TRUE 1 100 0.00 1.00000000000 BIT_MASK 0x1 FORMAT "%13.11" ECU_ADDRESS 0x60038DA1 /end MEASUREMENT
/begin MEASUREMENT TWCD_FltDsEval_B1.flgVirtMeasFinshdTrip "Filter class for catalyt diagnosis / Flag virtual measurements complete for this driving cycle" UBYTE B_TRUE 1 100 0.00 1.00000000000 BIT_MASK 0x1 FORMAT "%13.11" ECU_ADDRESS 0x50001E23 /end MEASUREMENT
/begin MEASUREMENT TWCD_FltDsEval_B1.numMeas "Filter class for catalyt diagnosis / Number of measurements" UBYTE dez 1 100 0.00 255.0 FORMAT "%5.1" ECU_ADDRESS 0x60038DA2 /end MEASUREMENT
/begin MEASUREMENT TWCD_FltDsEval_B1.numMeasShrtp "Filter class for catalyt diagnosis / Number of measurements - Short trip" UBYTE dez 1 100 0.00 255.0 FORMAT "%5.1" ECU_ADDRESS 0x50001E24 /end MEASUREMENT
/begin MEASUREMENT TWCD_FltDsEval_B1.numMeasTrip "Filter class for catalyt diagnosis / Number of measurements in DCY" UBYTE dez 1 100 0.00 255.0 FORMAT "%5.1" ECU_ADDRESS 0x50001E25 /end MEASUREMENT
/begin MEASUREMENT TWCD_FltDsEval_B1.numVirtMeas "Filter class for catalyt diagnosis / Number of virtual measurements (IUMPR)" UBYTE dez 1 100 0.00 255.0 FORMAT "%5.1" ECU_ADDRESS 0x60038DA3 /end MEASUREMENT
/begin MEASUREMENT TWCD_FltDsEval_B1.numVirtMeasTrip "Filter class for catalyt diagnosis / Number of virtual measurements (IUMPR) in DCY" UBYTE dez 1 100 0.00 255.0 FORMAT "%5.1" ECU_ADDRESS 0x50001E26 /end MEASUREMENT
/begin MEASUREMENT TWCD_FltDsEval_B1.rOSCAvrgPri "Filter class for catalyt diagnosis / Oxygen storage capacity of catalyst, filtered value" UWORD fak_uw_b16 1 100 0.00 15.99976 FORMAT "%8.5" ECU_ADDRESS 0x60038DA4 /end MEASUREMENT
/begin MEASUREMENT TWCD_FltDsEval_B1.val "Filter class for catalyt diagnosis / Result of catalyst diagnosis" UWORD fak_uw_b16 1 100 0.00 15.99976 FORMAT "%8.5" ECU_ADDRESS 0x50001E28 /end MEASUREMENT
/begin MEASUREMENT TWCD_FltDsEval_B1.valArth "Filter class for catalyt diagnosis / Arithmetically filtered result of catalyst diagnosis" UWORD fak_uw_b16 1 100 0.00 15.99976 FORMAT "%8.5" ECU_ADDRESS 0x60038DA6 /end MEASUREMENT
/begin MEASUREMENT TWCD_FltDsEval_B1.valEwma "Filter class for catalyt diagnosis / EWMA filtered result of catalyst diagnosis" UWORD fak_uw_b16 1 100 0.00 15.99976 FORMAT "%8.5" ECU_ADDRESS 0x60038DA8 /end MEASUREMENT
/begin MEASUREMENT TWCD_FltDsEval_B1.valQuickPass "Filter class for catalyt diagnosis / Quickpass result of catalyst diagnosis" UWORD fak_uw_b16 1 100 0.00 15.99976 FORMAT "%8.5" ECU_ADDRESS 0x50001E2A /end MEASUREMENT
/begin MEASUREMENT TWCD_FltDsEval_B1.valArthDL_I.memory "Filter class for catalyt diagnosis / Low pass: Arithmetically filtered result of catalyst diagnosis / current lowpass value" ULONG fak_q3p72529Em9 1 100 0.00 15.9999999963 FORMAT "%13.10" ECU_ADDRESS 0x50001E30 /end MEASUREMENT
/begin MEASUREMENT TWCD_FltDsEval_B1.valArthShrtpDL_I.memory "Filter class for catalyt diagnosis / Filter class for catalyt diagnosis Low pass: Arithmetically filtered result of catalyst diagnosis (short trip) / current lowpass value" ULONG fak_q3p72529Em9 1 100 0.00 15.9999999963 FORMAT "%13.10" ECU_ADDRESS 0x50001E34 /end MEASUREMENT
/begin MEASUREMENT TWCD_FltDsEval_B1.valEwmaDL_I.memory "Filter class for catalyt diagnosis / Low pass: EWMA filtered result of catalyst diagnosis / current lowpass value" ULONG fak_q3p72529Em9 1 100 0.00 15.9999999963 FORMAT "%13.10" ECU_ADDRESS 0x50001E38 /end MEASUREMENT
/begin MEASUREMENT TWCD_mfO2LSUDynB1 "O2 massflow based on lambda value adjusted by LSU-dynamics, Bank 1" FLOAT32_IEEE mgrad_q1_mgdivs 1 100 -1.0000E+037 1.0000E+037 FORMAT "%10.4" ECU_ADDRESS 0x60002608 /end MEASUREMENT
/begin MEASUREMENT TWCD_mOscExtdCat1B1 "Oxygen storage capacity of the catalyst for diagnosis, high range, catalyst 1 bank 1" ULONG m_q0p1_mg 1 100 0.00 429496729.500 FORMAT "%13.3" ECU_ADDRESS 0x60013B44 /end MEASUREMENT
/begin MEASUREMENT TWCD_mOscNewCat1B1 "Osc of the new catalyst, Cat1B1" ULONG m_q0p1_mg 1 100 0.00 429496729.500 FORMAT "%13.3" ECU_ADDRESS 0x6000378C /end MEASUREMENT
/begin MEASUREMENT TWCD_mOSCNrmDiumprExtdB1 "Temperature corrected borderline Oxygen storage capacity (OSC) of catalyst for IUMPR simulation, high range" ULONG m_q0p1_mg 1 100 0.00 429496729.500 FORMAT "%13.3" ECU_ADDRESS 0x60013B40 /end MEASUREMENT
/begin MEASUREMENT TWCD_mOSCNrmExtdB1 "Temperature corrected borderline Oxygen storage capacity (OSC) of catalyst, high range" ULONG m_q0p1_mg 1 100 0.00 429496729.500 FORMAT "%13.3" ECU_ADDRESS 0x60003790 /end MEASUREMENT
/begin MEASUREMENT TWCD_mOscPtlCorrdCat1B1 "Corrected partial OSC-result depending on LSU sensor dynamics, Cat1B1" UWORD m_q0p1_mg 1 100 0.00 6553.500 FORMAT "%8.3" ECU_ADDRESS 0x60014962 /end MEASUREMENT
/begin MEASUREMENT TWCD_mOscPtlCorrdExtdCat1B1 "Corrected partial OSC-result depending on LSU sensor dynamics, Cat1B1" ULONG m_q0p1_mg 1 100 0.00 429496729.500 FORMAT "%13.3" ECU_ADDRESS 0x60013B48 /end MEASUREMENT
/begin MEASUREMENT TWCD_mRSCNrmDiumprExtdB1 "Temperature corrected borderline Rich gas storage capacity (RSC) of catalyst for IUMPR simulation, high range" ULONG m_q0p1_mg 1 100 0.00 429496729.500 FORMAT "%13.3" ECU_ADDRESS 0x60013B4C /end MEASUREMENT
/begin MEASUREMENT TWCD_mRSCNrmExtdB1 "Temperature corrected borderline Rich gas storage capacity (RSC) of catalyst, high range" ULONG m_q0p1_mg 1 100 0.00 429496729.500 FORMAT "%13.3" ECU_ADDRESS 0x60003788 /end MEASUREMENT
/begin MEASUREMENT TWCD_mRscPtlCorrdCat1B1 "Corrected partial RSC-result depending on LSU sensor dynamics, Cat1B1" UWORD m_q0p1_mg 1 100 0.00 6553.500 FORMAT "%8.3" ECU_ADDRESS 0x60014964 /end MEASUREMENT
/begin MEASUREMENT TWCD_mRscPtlCorrdExtdCat1B1 "Corrected partial RSC-result depending on LSU sensor dynamics high-range, Cat1B1" ULONG m_q0p1_mg 1 100 0.00 429496729.500 FORMAT "%13.3" ECU_ADDRESS 0x60013B50 /end MEASUREMENT
/begin MEASUREMENT TWCD_NewOscPriB1_I.ctBrick "Calculation of the Osc of the new catalyst, Cat1B1 / counter for catalyst bricks" UBYTE dez 1 100 0.00 255.0 FORMAT "%5.1" ECU_ADDRESS 0x50001E3C /end MEASUREMENT
/begin MEASUREMENT TWCD_NewOscPriB1_I.dmGas "Calculation of the Osc of the new catalyst, Cat1B1 / massenstrom für grenzkatalysator" UWORD m_uw_b6553p5 1 100 0.00 6553.500 FORMAT "%8.3" ECU_ADDRESS 0x50001E3E /end MEASUREMENT
/begin MEASUREMENT TWCD_NewOscPriB1_I.mOsc "Calculation of the Osc of the new catalyst, Cat1B1 / oxygen storage capacity" ULONG m_q0p1_mg 1 100 0.00 429496729.500 FORMAT "%13.3" ECU_ADDRESS 0x50001E40 /end MEASUREMENT
/begin MEASUREMENT TWCD_NewOscPriB1_I.tBrick "Calculation of the Osc of the new catalyst, Cat1B1 / catalyst brick temperature" SWORD Temp_Cels 1 100 -3549.940 3003.560 FORMAT "%8.3" ECU_ADDRESS 0x50001E44 /end MEASUREMENT
/begin MEASUREMENT TWCD_NrmOSCPriB1_I.ctBrick "calculation of borderline OSC, 1st cat. bank 1 / counter for catalyst bricks" UBYTE dez 1 100 0.00 255.0 FORMAT "%5.1" ECU_ADDRESS 0x50001E48 /end MEASUREMENT
/begin MEASUREMENT TWCD_NrmOSCPriB1_I.dmGas "calculation of borderline OSC, 1st cat. bank 1 / massenstrom für grenzkatalysator" UWORD m_uw_b6553p5 1 100 0.00 6553.500 FORMAT "%8.3" ECU_ADDRESS 0x50001E4A /end MEASUREMENT
/begin MEASUREMENT TWCD_NrmOSCPriB1_I.mOsc "calculation of borderline OSC, 1st cat. bank 1 / oxygen storage capacity" ULONG m_q0p1_mg 1 100 0.00 429496729.500 FORMAT "%13.3" ECU_ADDRESS 0x50001E4C /end MEASUREMENT
/begin MEASUREMENT TWCD_NrmOSCPriB1_I.tBrick "calculation of borderline OSC, 1st cat. bank 1 / catalyst brick temperature" SWORD Temp_Cels 1 100 -3549.940 3003.560 FORMAT "%8.3" ECU_ADDRESS 0x50001E50 /end MEASUREMENT
/begin MEASUREMENT TWCD_NrmOSCScndFlPriB1_I.ctBrick "calculation of borderline OSC, 1st cat, 2nd fuel, bank 1 / counter for catalyst bricks" UBYTE dez 1 100 0.00 255.0 FORMAT "%5.1" ECU_ADDRESS 0x600025FC /end MEASUREMENT
/begin MEASUREMENT TWCD_NrmOSCScndFlPriB1_I.dmGas "calculation of borderline OSC, 1st cat, 2nd fuel, bank 1 / massenstrom für grenzkatalysator" UWORD m_uw_b6553p5 1 100 0.00 6553.500 FORMAT "%8.3" ECU_ADDRESS 0x600025FE /end MEASUREMENT
/begin MEASUREMENT TWCD_NrmOSCScndFlPriB1_I.mOsc "calculation of borderline OSC, 1st cat, 2nd fuel, bank 1 / oxygen storage capacity" ULONG m_q0p1_mg 1 100 0.00 429496729.500 FORMAT "%13.3" ECU_ADDRESS 0x60002600 /end MEASUREMENT
/begin MEASUREMENT TWCD_NrmOSCScndFlPriB1_I.tBrick "calculation of borderline OSC, 1st cat, 2nd fuel, bank 1 / catalyst brick temperature" SWORD Temp_Cels 1 100 -3549.940 3003.560 FORMAT "%8.3" ECU_ADDRESS 0x60002604 /end MEASUREMENT
/begin MEASUREMENT TWCD_numMeasB1 "Number of measurements for B1" UBYTE dez 1 100 0.00 255.0 FORMAT "%5.1" ECU_ADDRESS 0x6000F773 /end MEASUREMENT
/begin MEASUREMENT TWCD_ratLamLSUDynB1 "Modeled lambda value adjusted by LSU-dynamics, Bank 1" UWORD fak_uw_b16 1 100 0.00 15.99976 FORMAT "%8.5" ECU_ADDRESS 0x60013DDC /end MEASUREMENT
/begin MEASUREMENT TWCD_ratLamLsuDynCorrdCat1B1 "Modeled lambda value adjusted by LSU-dynamics and gas transport delay, Bank 1" UWORD fak_uw_b16 1 100 0.00 15.99976 FORMAT "%8.5" ECU_ADDRESS 0x6000705C /end MEASUREMENT
/begin MEASUREMENT TWCD_rDiagRsltB1 "Result catalyst diagnosis, bank 1" UWORD fak_uw_b16 1 100 0.00 15.99976 FORMAT "%8.5" ECU_ADDRESS 0x60008DE2 /end MEASUREMENT
/begin MEASUREMENT TWCD_rOSCAvrgPriB1 "Oxygen storage capacity of the primary catalyst, catalyst monitoring, filtered value, bank 1" UWORD fak_uw_b16 1 100 0.00 15.99976 FORMAT "%8.5" ECU_ADDRESS 0x60008DE0 /end MEASUREMENT
/begin MEASUREMENT TWCD_rOSCPriB1 "Result diagnosis primary catalyst, bank 1" UWORD fak_uw_b16 1 100 0.00 15.99976 FORMAT "%8.5" ECU_ADDRESS 0x600093C8 /end MEASUREMENT
/begin MEASUREMENT UEGO_AmplfrCJ135S1B1_I._cntr "class instance S1B1 for CJ135 digital mode / counter for number of voltage measurements" UWORD dez 1 100 0.00 65535.00 FORMAT "%8.2" ECU_ADDRESS 0x60007036 /end MEASUREMENT
/begin MEASUREMENT UEGO_AmplfrCJ135S1B1_I._tmp_UMax "class instance S1B1 for CJ135 digital mode / Temporary maximum voltage" SWORD spg_q3p2Em4_V 1 100 0.00 10.48544 FORMAT "%8.5" ECU_ADDRESS 0x60007038 /end MEASUREMENT
/begin MEASUREMENT UEGO_AmplfrCJ135S1B1_I._tmp_Unp "class instance S1B1 for CJ135 digital mode / Temporary maximum voltage" SWORD spg_q3p2Em4_V 1 100 0.00 10.48544 FORMAT "%8.5" ECU_ADDRESS 0x6000703A /end MEASUREMENT
/begin MEASUREMENT UEGO_AmplfrCJ135S1B1_I.cntrSeln "class instance S1B1 for CJ135 digital mode / setting value for modes selection" SBYTE dez 1 100 -128.0 127.0 FORMAT "%5.1" ECU_ADDRESS 0x6000703C /end MEASUREMENT
/begin MEASUREMENT UEGO_AmplfrCJ135S1B1_I.flgMaxLNVld "class instance S1B1 for CJ135 digital mode / Calculation of maximum voltage at LN is valid" UBYTE B_TRUE 1 100 0.00 1.00000000000 BIT_MASK 0x1 FORMAT "%13.11" ECU_ADDRESS 0x6000703D /end MEASUREMENT
/begin MEASUREMENT UEGO_AmplfrCJ135S1B1_I.flgMaxLPVld "class instance S1B1 for CJ135 digital mode / Calculation of maximum voltage at LP is valid" UBYTE B_TRUE 1 100 0.00 1.00000000000 BIT_MASK 0x1 FORMAT "%13.11" ECU_ADDRESS 0x6000703E /end MEASUREMENT
/begin MEASUREMENT UEGO_AmplfrCJ135S1B1_I.flgModIntLN "class instance S1B1 for CJ135 digital mode / set flag of internal mode of LN" UBYTE B_TRUE 1 100 0.00 1.00000000000 BIT_MASK 0x1 FORMAT "%13.11" ECU_ADDRESS 0x6000703F /end MEASUREMENT
/begin MEASUREMENT UEGO_AmplfrCJ135S1B1_I.flgModIntLP "class instance S1B1 for CJ135 digital mode / set flag of internal mode of LP" UBYTE B_TRUE 1 100 0.00 1.00000000000 BIT_MASK 0x1 FORMAT "%13.11" ECU_ADDRESS 0x60007040 /end MEASUREMENT
/begin MEASUREMENT UEGO_AmplfrCJ135S1B1_I.flgOPM1GainVld "class instance S1B1 for CJ135 digital mode / OPM1 gain valid" UBYTE B_TRUE 1 100 0.00 1.00000000000 BIT_MASK 0x1 FORMAT "%13.11" ECU_ADDRESS 0x60007041 /end MEASUREMENT
/begin MEASUREMENT UEGO_AmplfrCJ135S1B1_I.flgOPM2GainVld "class instance S1B1 for CJ135 digital mode / OPM2 gain valid" UBYTE B_TRUE 1 100 0.00 1.00000000000 BIT_MASK 0x1 FORMAT "%13.11" ECU_ADDRESS 0x60007042 /end MEASUREMENT
/begin MEASUREMENT UEGO_AmplfrCJ135S1B1_I.flgOPM3GainVld "class instance S1B1 for CJ135 digital mode / OPM53gain valid" UBYTE B_TRUE 1 100 0.00 1.00000000000 BIT_MASK 0x1 FORMAT "%13.11" ECU_ADDRESS 0x60007043 /end MEASUREMENT
/begin MEASUREMENT UEGO_AmplfrCJ135S1B1_I.flgRegSetLN "class instance S1B1 for CJ135 digital mode / LN flag was set" UBYTE B_TRUE 1 100 0.00 1.00000000000 BIT_MASK 0x1 FORMAT "%13.11" ECU_ADDRESS 0x60007044 /end MEASUREMENT
/begin MEASUREMENT UEGO_AmplfrCJ135S1B1_I.flgRegSetLP "class instance S1B1 for CJ135 digital mode / LP flag was set" UBYTE B_TRUE 1 100 0.00 1.00000000000 BIT_MASK 0x1 FORMAT "%13.11" ECU_ADDRESS 0x60007045 /end MEASUREMENT
/begin MEASUREMENT UEGO_AmplfrCJ135S1B1_I.nrModIntLN "class instance S1B1 for CJ135 digital mode / Internal Mode of LN setting" UBYTE dez 1 100 0.00 1.000 FORMAT "%5.3" ECU_ADDRESS 0x60007046 /end MEASUREMENT
/begin MEASUREMENT UEGO_AmplfrCJ135S1B1_I.nrModIntLP "class instance S1B1 for CJ135 digital mode / Internal Mode of LP setting" UBYTE dez 1 100 0.00 1.000 FORMAT "%5.3" ECU_ADDRESS 0x60007047 /end MEASUREMENT
/begin MEASUREMENT UEGO_AmplfrCJ135S1B1_I.nrModIntOldLN "class instance S1B1 for CJ135 digital mode / Old Internal Mode of LN setting" UBYTE dez 1 100 0.00 1.000 FORMAT "%5.3" ECU_ADDRESS 0x60007048 /end MEASUREMENT
/begin MEASUREMENT UEGO_AmplfrCJ135S1B1_I.nrModIntOldLP "class instance S1B1 for CJ135 digital mode / Old Internal Mode of LP setting" UBYTE dez 1 100 0.00 1.000 FORMAT "%5.3" ECU_ADDRESS 0x60007049 /end MEASUREMENT
/begin MEASUREMENT UEGO_AmplfrCJ135S1B1_I.stLoupNSet "class instance S1B1 for CJ135 digital mode / Statusword for LN setting" UWORD dez 1 100 0.00 65535.00 FORMAT "%8.2" ECU_ADDRESS 0x6000704A /end MEASUREMENT
/begin MEASUREMENT UEGO_AmplfrCJ135S1B1_I.stLoupPSet "class instance S1B1 for CJ135 digital mode / Statusword for LP setting" UWORD dez 1 100 0.00 65535.00 FORMAT "%8.2" ECU_ADDRESS 0x6000704C /end MEASUREMENT
/begin MEASUREMENT UEGO_AmplfrCJ135S1B1_I.uMaxLN "class instance S1B1 for CJ135 digital mode / Maximum voltage at LN" SWORD spg_q3p2Em4_V 1 100 0.00 10.48544 FORMAT "%8.5" ECU_ADDRESS 0x6000704E /end MEASUREMENT
/begin MEASUREMENT UEGO_AmplfrCJ135S1B1_I.uMaxLP "class instance S1B1 for CJ135 digital mode / Maximum voltage at LP" SWORD spg_q3p2Em4_V 1 100 0.00 10.48544 FORMAT "%8.5" ECU_ADDRESS 0x60007050 /end MEASUREMENT
/begin MEASUREMENT UEGO_AmplfrCJ135S1B1_I.uOPM1Gain "class instance S1B1 for CJ135 digital mode / Gain for range 1,3V OPM = 1" UWORD spg_q2p3842Em7_V 1 100 0.00 0.01562476 FORMAT "%10.8" ECU_ADDRESS 0x60007052 /end MEASUREMENT
/begin MEASUREMENT UEGO_AmplfrCJ135S1B1_I.uOPM2Gain "class instance S1B1 for CJ135 digital mode / Gain for range 3,5V OPM = 2" UWORD spg_q2p3842Em7_V 1 100 0.00 0.01562476 FORMAT "%10.8" ECU_ADDRESS 0x60007054 /end MEASUREMENT
/begin MEASUREMENT UEGO_AmplfrCJ135S1B1_I.uOPM3Gain "class instance S1B1 for CJ135 digital mode / Gain for range 10,3V OPM = 3" UWORD spg_q2p3842Em7_V 1 100 0.00 0.01562476 FORMAT "%10.8" ECU_ADDRESS 0x60007056 /end MEASUREMENT
/begin MEASUREMENT UEGO_ChpS1B1_I.flgCJ135An "UEGO_Chp class instans of sensor 1 bank 1 / availability of a analogue chip" UBYTE B_TRUE 1 100 0.00 1.00000000000 BIT_MASK 0x1 FORMAT "%13.11" ECU_ADDRESS 0x60007032 /end MEASUREMENT
/begin MEASUREMENT UEGO_ChpS1B1_I.flgChpSuprtd "UEGO_Chp class instans of sensor 1 bank 1 / software support for the present chip" UBYTE B_TRUE 1 100 0.00 1.00000000000 BIT_MASK 0x1 FORMAT "%13.11" ECU_ADDRESS 0x60007033 /end MEASUREMENT
/begin MEASUREMENT UEGO_ChpS1B1_I.flgChpSwPrsnt "UEGO_Chp class instans of sensor 1 bank 1 / software availability for the present chip" UBYTE B_TRUE 1 100 0.00 1.00000000000 BIT_MASK 0x1 FORMAT "%13.11" ECU_ADDRESS 0x70001F1C /end MEASUREMENT
/begin MEASUREMENT UEGO_ChpS1B1_I.flgUVCC3MeasRefVld "UEGO_Chp class instans of sensor 1 bank 1 / validity of the back measured internal supply voltage" UBYTE B_TRUE 1 100 0.00 1.00000000000 BIT_MASK 0x1 FORMAT "%13.11" ECU_ADDRESS 0x70001F1D /end MEASUREMENT
/begin MEASUREMENT UEGO_ChpS1B1_I.idxChp "UEGO_Chp class instans of sensor 1 bank 1 / chip type" UBYTE UEGO_CHPID_COMPU_VERB 1 100 0.00 8.00000000000 FORMAT "%13.11" ECU_ADDRESS 0x60007034 /end MEASUREMENT
/begin MEASUREMENT UEGO_ChpS1B1_I.idxTyp "UEGO_Chp class instans of sensor 1 bank 1 / sensor type" UBYTE dez 1 100 0.00 29.00 FORMAT "%5.2" ECU_ADDRESS 0x60007035 /end MEASUREMENT
/begin MEASUREMENT UEGO_ChpS1B1_I.uVCC3MeasRef "UEGO_Chp class instans of sensor 1 bank 1 / filtered internal supply voltage" SWORD spg_q3p2Em4_V 1 100 -10.48576 10.48544 FORMAT "%8.5" ECU_ADDRESS 0x70001F1E /end MEASUREMENT
/begin MEASUREMENT UEGO_ChpS1B1_I.uVCC3MeasRefUnFild "UEGO_Chp class instans of sensor 1 bank 1 / unfiltered internal supply voltage" SWORD spg_q3p2Em4_V 1 100 -10.48576 10.48544 FORMAT "%8.5" ECU_ADDRESS 0x70001F20 /end MEASUREMENT
/begin MEASUREMENT UEGO_ChpS1B1_I.UEGO_UVCC3MeasFilDL_I.flgEvlnStrtd "UEGO_Chp class instans of sensor 1 bank 1 / Filter used for back measurement of internal supply voltage (VCC3) / Flag to determine evaluation status." UBYTE B_TRUE 1 100 0.00 1.00000000000 BIT_MASK 0x1 FORMAT "%13.11" ECU_ADDRESS 0x600025F4 /end MEASUREMENT
/begin MEASUREMENT UEGO_ChpS1B1_I.UEGO_UVCC3MeasFilDL_I.EvlnFil_DL_I.memory "UEGO_Chp class instans of sensor 1 bank 1 / Filter used for back measurement of internal supply voltage (VCC3) / Class instance of evaluation filter. / current lowpass value" SLONG spg_q4p883Em9_V 1 100 -10.4857600000 10.4857599951 FORMAT "%13.10" ECU_ADDRESS 0x600025F8 /end MEASUREMENT
/begin MEASUREMENT UEGO_DacClassS1B1_I.flgIPmpRawAryHiPrcsn "Dac adaption class instance for sensor 1 bank 1 / for evaluating measured data of asic indicates high precise raw pump current i.e iPmpraw" UBYTE B_TRUE 1 100 0.00 1.00000000000 BIT_MASK 0x1 FORMAT "%13.11" ECU_ADDRESS 0x60007030 /end MEASUREMENT
/begin MEASUREMENT UEGO_DacClassS1B1_I.flgIPmpRawAryVld "Dac adaption class instance for sensor 1 bank 1 / for evaluating measured data of asic Validity flag for intended DAC or PWM current" UBYTE B_TRUE 1 100 0.00 1.00000000000 BIT_MASK 0x1 FORMAT "%13.11" ECU_ADDRESS 0x60007031 /end MEASUREMENT
/begin MEASUREMENT UEGO_flgChpSuprtdS1B1 "Indication, if mounted ASIC(Application Specific Integrated Chip) is supported by software for S1B1" UBYTE B_TRUE 1 100 0.00 1.00000000000 BIT_MASK 0x1 FORMAT "%13.11" ECU_ADDRESS 0x70000741 /end MEASUREMENT
/begin MEASUREMENT UEGO_flgCJ135AnS1B1 "availability of CJ135 analogue chip of sensor 1 bank 1" UBYTE B_TRUE 1 100 0.00 1.00000000000 BIT_MASK 0x1 FORMAT "%13.11" ECU_ADDRESS 0x70000742 /end MEASUREMENT
/begin MEASUREMENT UEGO_flgDacAdpnVldS1B1 "validity of DAC adaption" UBYTE B_TRUE 1 100 0.00 1.00000000000 BIT_MASK 0x1 FORMAT "%13.11" ECU_ADDRESS 0x6000F8C6 /end MEASUREMENT
/begin MEASUREMENT UEGO_flgIPmpRawAryHiPrcsnS1B1 "Indicates high precise raw pump current i.e UEGO_iPmprawArySxBy" UBYTE B_TRUE 1 100 0.00 1.00000000000 BIT_MASK 0x1 FORMAT "%13.11" ECU_ADDRESS 0x6000F8BB /end MEASUREMENT
/begin MEASUREMENT UEGO_flgIPmpRawAryVldS1B1 "Validity of intended pump current for sensor 1 bank 1" UBYTE B_TRUE 1 100 0.00 1.00000000000 BIT_MASK 0x1 FORMAT "%13.11" ECU_ADDRESS 0x6000F8BA /end MEASUREMENT
/begin MEASUREMENT UEGO_flgOPM1GainVldS1B1 "OPM1 Gain valid" UBYTE B_TRUE 1 100 0.00 1.00000000000 BIT_MASK 0x1 FORMAT "%13.11" ECU_ADDRESS 0x70000709 /end MEASUREMENT
/begin MEASUREMENT UEGO_flgOPM2GainVldS1B1 "OPM2Gain valid" UBYTE B_TRUE 1 100 0.00 1.00000000000 BIT_MASK 0x1 FORMAT "%13.11" ECU_ADDRESS 0x70000708 /end MEASUREMENT
/begin MEASUREMENT UEGO_flgOPM3GainVldS1B1 "OPM3 Gain valid" UBYTE B_TRUE 1 100 0.00 1.00000000000 BIT_MASK 0x1 FORMAT "%13.11" ECU_ADDRESS 0x70000707 /end MEASUREMENT
/begin MEASUREMENT UEGO_flgVCC3RefMeasVldS1B1 "validity of the back measured internal supply voltage VCC3 of sensor 1 bank 1" UBYTE B_TRUE 1 100 0.00 1.00000000000 BIT_MASK 0x1 FORMAT "%13.11" ECU_ADDRESS 0x700006D6 /end MEASUREMENT
/begin MEASUREMENT UEGO_idxChpS1B1 "chip type of sensor 1 bank 1" UBYTE UEGO_CHPID_COMPU_VERB 1 100 0.00 8.00000000000 FORMAT "%13.11" ECU_ADDRESS 0x6000F769 /end MEASUREMENT
/begin MEASUREMENT UEGO_iIPmpRawAryS1B1 "Intended (DAC) current for sensor 1 bank 1" SWORD i_q6p6667Em7_A 1 100 -0.02184533 0.02184467 FORMAT "%10.8" ARRAY_SIZE 15 ECU_ADDRESS 0x600096E6 /end MEASUREMENT
/begin MEASUREMENT UEGO_uOPM1GainS1B1 "Gain for range 1,3V OPM = 1 for Sensor 1 Bank 1" UWORD spg_q2p3842Em7_V 1 100 0.00 0.01562476 FORMAT "%10.8" ECU_ADDRESS 0x60009388 /end MEASUREMENT
/begin MEASUREMENT UEGO_uOPM2GainS1B1 "Gain for range 3,5V OPM = 2 for Sensor 1 Bank 1" UWORD spg_q2p3842Em7_V 1 100 0.00 0.01562476 FORMAT "%10.8" ECU_ADDRESS 0x60009386 /end MEASUREMENT
/begin MEASUREMENT UEGO_uOPM3GainS1B1 "Gain for range 10,3V OPM = 3 for Sensor 1 Bank 1" UWORD spg_q2p3842Em7_V 1 100 0.00 0.01562476 FORMAT "%10.8" ECU_ADDRESS 0x60009384 /end MEASUREMENT
/begin MEASUREMENT UEGO_uVCC3RefS1B1 "internal supply voltage VCC3 of sensor 1 bank 1" SWORD spg_q3p2Em4_V 1 100 -10.48576 10.48544 FORMAT "%8.5" ECU_ADDRESS 0x70003A28 /end MEASUREMENT
/begin FUNCTION TWCC_FuelModln "1.34.0    TWC Fuel Modulation"
 /begin DEF_CHARACTERISTIC TWCC_facFlAmpCHModln_C TWCC_facFlAmpModlnCng_Crv TWCC_facFlAmpModln_CUR TWCC_facFlAmpOSCModlnCng_Crv TWCC_facFlAmpOSCModln_CUR TWCC_facO2SrcModln_C TWCC_flgInhbFixPerModlnCH_CW TWCC_mAddO2LimHiModlnCng_Crv TWCC_mAddO2LimHiModln_CUR TWCC_mAddO2TrgHiModlnCng_Crv TWCC_mAddO2TrgHiModln_CUR TWCC_mEffO2Modln_GCUR TWCC_mO2TrgLoModlnCng_Crv TWCC_mO2TrgLoModln_CUR TWCC_stFlModln2_CW TWCC_stFlModln_CW TWCC_tCatEnaModlnB1_C TWCC_tCatEnaModlnCngB1_C TWCC_tCatEnaModlnMaxCng_C TWCC_tCatEnaModlnMax_C TWCC_tEngEnaModln_C TWCC_tiDebVltgRstModln_C TWCC_tiDlyAdpnThdS1_C TWCC_tiMinPerModln_C TWCC_tiPerModlnCng_C TWCC_tiPerModln_C TWCC_tiTranAdpnThdS1_C TWCC_uDebRstThresHiModln_C TWCC_uDebRstThresLoModln_C TWCC_uRstThresHiModln_C TWCC_uRstThresLoModln_C /end DEF_CHARACTERISTIC
 /begin IN_MEASUREMENT B_kh_msg B_lamdiag_msg B_lasostc_msg B_lrs_msg B_lr_msg B_tatmsa_msg CEngDsT_t dlaso_msg EGSDCmn_flgLamReqParlB1 EGSDO2_tiDlyAdpnS1B1 EGSDO2_tiTranAdpnS1B1 ExhMod_dmExhS1B1 ExhMod_dmExhWoFuUsCat1B1 ExhMod_facIntrpnGslSecFu ExhMod_mO2StrExtdCat1B1 ExhMod_ratO2StrCat1B1 ExhMod_tCat1B1 HEGO_bS2B1Vld HEGO_uS2B1 InjSys_bMinPtdInjDurActv lamsbg_w_msg rriext_w_msg SyC_stSub tlrs_w_msg TWCC_rCtlPriB1 UEGO_rLamS1B1 zlrs_w_msg /end IN_MEASUREMENT
 /begin OUT_MEASUREMENT TWCC_bBalLimModlnB1 TWCC_bBalModlnB1 TWCC_bFlModlnB1 TWCC_bFlSignCtlModlnB1 TWCC_facFlAmpModln TWCC_facFlModlnB1 TWCC_rLamFltModlnB1 TWCC_rLamModlnB1 /end OUT_MEASUREMENT
 /begin LOC_MEASUREMENT fipsfesInvModln_w LRS_REGEN1_TR_I.timeCounter LRS_REGEN2_TR_I.timeCounter TWCC_BalLimModlnB1TR_I.timeCounter TWCC_BalModlnB1ER_I.buffer TWCC_BalModlnB1ER_I.oldSignal TWCC_bCHModln TWCC_bFixPerModlnB1 TWCC_bFlSignCtlBalModlnB1 TWCC_bRstBalModlnB1 TWCC_bTrgFixPerModln TWCC_DeltaLamSetPDdTModlnB1LT_I.memory TWCC_DeltaLamSetPModlnB1DTTt_I.buffer TWCC_DeltaLamSetPModlnB1DTTt_I.counter TWCC_DeltaLamSetPModlnB1DTTt_I.ds TWCC_DeltaLamSetPModlnB1DTTt_I.pointer TWCC_dmO2ModlnB1 TWCC_dmO2SrcModlnB1 TWCC_facFlAmpSignModln TWCC_facFlFltModlnB1 TWCC_facOSCCorModln TWCC_FlModlnB1DTTt_I.buffer TWCC_FlModlnB1DTTt_I.counter TWCC_FlModlnB1DTTt_I.ds TWCC_FlModlnB1DTTt_I.pointer TWCC_FlModlnB1LT_I.memory TWCC_FlSignCtlBalModlnB1EB_I.buffer TWCC_FlSignCtlBalModlnB1EB_I.oldSignal TWCC_FlSignCtlBalModlnB1TR_I.timeCounter TWCC_HiVltgS2B1ModlnEF_I.buffer TWCC_HiVltgS2B1ModlnEF_I.oldSignal TWCC_HiVltgS2B1ModlnER_I.buffer TWCC_HiVltgS2B1ModlnER_I.oldSignal TWCC_HiVltgS2B1ModlnFF_I.status TWCC_HiVltgS2B1ModlnTONV_I.outbit TWCC_HiVltgS2B1ModlnTONV_I.time TWCC_LoVltgS2B1ModlnEF_I.buffer TWCC_LoVltgS2B1ModlnEF_I.oldSignal TWCC_LoVltgS2B1ModlnER_I.buffer TWCC_LoVltgS2B1ModlnER_I.oldSignal TWCC_LoVltgS2B1ModlnFF_I.status TWCC_LoVltgS2B1ModlnTONV_I.outbit TWCC_LoVltgS2B1ModlnTONV_I.time TWCC_mEffO2ModlnB1 TWCC_mEffO2ModlnGCrvWpDisp TWCC_mExhGsModln TWCC_mO2CorThresModlnB1 TWCC_mO2LimHiModlnB1 TWCC_mO2TrgHiModlnB1 TWCC_mO2TrgLoModlnB1 TWCC_O2MsModlnB1IKL_I.memory TWCC_rLamBalModlnB1 TWCC_tiPerModln TWCC_uS2ThresHiModln TWCC_uS2ThresLoModln /end LOC_MEASUREMENT
 FUNCTION_VERSION "1.34.0" /end FUNCTION
/begin FUNCTION TWCC_GlbSet "1.17.0    global settings for three-way-catalyst control" /begin DEF_CHARACTERISTIC TWCC_rSetPUsGlbEnhd_CUR TWCC_stGlbSet_CW /end DEF_CHARACTERISTIC /begin IN_MEASUREMENT ExhMod_ratO2StrCat1B1 TWCD_rOSCAvrgPriB1 /end IN_MEASUREMENT /begin OUT_MEASUREMENT TWCC_rSetPUsGlbB1 /end OUT_MEASUREMENT /begin LOC_MEASUREMENT TWCC_facOSCGlbB1 /end LOC_MEASUREMENT FUNCTION_VERSION "1.17.0" /end FUNCTION
/begin FUNCTION TWCC_PriCont "1.39.0    Primary Feedback Control of TWC - Continuous"
 /begin DEF_CHARACTERISTIC TWCC_facFltActPTPri_C TWCC_facIGnCtlPriB1_CUR TWCC_facIGnCtlSFlPriB1_CUR TWCC_facILamLinPri_CUR TWCC_facILamLinSFlPri_CUR TWCC_facIOSCAbsPriB1_CUR TWCC_facIOSCAbsSFlPriB1_CUR TWCC_facIOSCPriB1_CUR TWCC_facIOSCSFlPriB1_CUR TWCC_facPGnCtlPriB1_CUR TWCC_facPGnCtlSFlPriB1_CUR TWCC_facPLamLinPri_CUR TWCC_facPLamLinSFlPri_CUR TWCC_facPOSCAbsPriB1_CUR TWCC_facPOSCAbsSFlPriB1_CUR TWCC_facPOSCPriB1_CUR TWCC_facPOSCSFlPriB1_CUR TWCC_facTempGslCorrnPri_T TWCC_flgCtrlrRstDSMPri_CW TWCC_flgCtrlrRstInitPri_CW TWCC_flgCtrlrRstPri_CW TWCC_flgCtrlrRstSelnInitPri_CW TWCC_flgEnaSpFilPri_C TWCC_flgUCorrnActv_C TWCC_flguSetPApplPri_CW TWCC_rDynSetPIniPri_CUR TWCC_rDynSetPIniSFlPri_CUR TWCC_rDynStrtSetPIniPri_CUR TWCC_rDynStrtSetPIniSFlPri_CUR TWCC_rICtlInitPriB1_C TWCC_rILamMaxPri_C TWCC_rILamMinPri_C TWCC_rLamCtlMaxPri_C TWCC_rLamCtlMinPri_C TWCC_rPBalDLaPri_MAP TWCC_rPBalDLaSFlPri_MAP TWCC_rPBalHysDLaPri_C TWCC_stPriCont_CW TWCC_tiDynSetPPri_CUR TWCC_tiDynSetPSFlPri_CUR TWCC_tiDynStrtSetPPri_CUR TWCC_tiDynStrtSetPSFlPri_CUR TWCC_tiFltSetPPriMap_T TWCC_tiLpActPri_CUR TWCC_tiLpTCatGslPri_T TWCC_tiStrtEndDly_C TWCC_uActHiLimGslCorrnPri_M TWCC_uActLoLimGslCorrnPri_M TWCC_uSetPApplPriB1_C TWCC_uSetPPriB1_MAP TWCC_uSetPSFlPriB1_MAP /end DEF_CHARACTERISTIC
 /begin REF_CHARACTERISTIC HEGO_flgVltgSymc_C HEGO_rS2LamLinCNGHiRes_CUR HEGO_rS2LamLinHiRes_CUR HEGO_uS2InvLamLinCNGHiRes_CUR HEGO_uS2InvLamLinHiRes_CUR /end REF_CHARACTERISTIC
 /begin IN_MEASUREMENT EGSDCmn_flgRmnProdModParl EGSDO2_ralLamOffsDeltaExchS1B1_s32 EngStrt_bStrtEnd Epm_nEngLRes ExhMod_dmExhS1B1 ExhMod_dmExhS2B1 ExhMod_facIntrpnGslSecFu ExhMod_mO2StrExtdCat1B1 ExhMod_ratO2StrCat1B1 ExhMod_tCat1B1 HEGO_bS2B1Vld HEGO_uS2B1LamHiRes HEGO_uS2B1SymcHiRes rl_msg SyC_stSub TWCC_bBalModlnB1 TWCC_bEnaRichPurgB1 TWCC_bFlModlnB1 TWCC_bFlSignCtlModlnB1 TWCC_bIPriB1 TWCC_bPPriB1 TWCC_rSetPUsGlbB1 /end IN_MEASUREMENT
 /begin OUT_MEASUREMENT TWCC_bCtlLimMaxPriB1 TWCC_bCtlLimMinPriB1 TWCC_facIGnCtlPriB1 TWCC_rCtlErrPriB1 TWCC_rCtlPriB1 TWCC_rDynSetPPriB1 TWCC_rDynStrtSetPPriB1 TWCC_rICtlHiReslPriB1 TWCC_rICtlPriB1 TWCC_rLamActPriB1 TWCC_rPCtlPriB1 TWCC_uSetPPriB1 /end OUT_MEASUREMENT
 /begin LOC_MEASUREMENT fcoscxk TWCC_BFlSignEB_I.buffer TWCC_BFlSignEB_I.oldSignal TWCC_bStrtEndER_I.buffer TWCC_bStrtEndER_I.oldSignal TWCC_bStrtEndTONV_I.outbit TWCC_bStrtEndTONV_I.time TWCC_dmExhSpFil TWCC_dtPMsO2BalPriB1 TWCC_facIOSCPriB1 TWCC_facIvsIntrpnPriCont TWCC_facPGnCtlPriB1 TWCC_facPOSCPriB1 TWCC_fcoscxkEB_I.buffer TWCC_fcoscxkEB_I.oldSignal TWCC_flgEnaRichPurgB1EF_I.buffer TWCC_flgEnaRichPurgB1EF_I.oldSignal TWCC_flgFCMClrReqd100PriB1 TWCC_PhSyncB1_I.rActPer TWCC_PhSyncB1_I.rPhAvrg TWCC_PhSyncB1_I.rPrevPer TWCC_PhSyncB1_I.sm TWCC_PhSyncB1_I.mExhA_I.memory TWCC_PMsO2BalPriB1IKL_I.memory TWCC_ratO2StrB1WpDisp TWCC_ratOSCSpst TWCC_rCtlErrBalPriB1 TWCC_rCtlErrPriB1HMD_I.hysterese TWCC_rDynSetPIniPriB1 TWCC_rDynSetPPriB1LT_I.memory TWCC_rDynStrtSetPIniPriB1 TWCC_rDynStrtSetPPriB1LT_I.memory TWCC_rICtlErrFltPriB1 TWCC_rICtlErrPriB1 TWCC_rICtlIntPriB1 TWCC_rICtlPriB1_I.memory_l TWCC_rLamActFltPriB1LT_I.memory TWCC_rLamSetPMapPriB1 TWCC_rLamSetPPriB1 TWCC_rPCtlErrFltPriB1 TWCC_rPCtlErrPriB1 TWCC_rPMsO2BalPriB1 TWCC_stOpModePri TWCC_tCatLamCorrnGslPriB1LT_I.memory TWCC_tiDynSetPPriB1 TWCC_tiDynStrtSetPPriB1 TWCC_uS2B1Lam TWCC_uS2B1LamCorrnGslPri TWCC_uS2B1LamCorrnPri TWCC_uSetPPriMapB1 TWCC_uSetPPriMapB1LT_I.memory /end LOC_MEASUREMENT
 FUNCTION_VERSION "1.39.0" /end FUNCTION
/begin FUNCTION TWCC_PriEna "1.41.0    Primary Feedback Control of TWC - Enable Condition"
 /begin DEF_CHARACTERISTIC TWCC_drIDLaH2Pri_C TWCC_facIOSCRlsH2Pri_C TWCC_facOSCPri_GCUR TWCC_flgDiPGlbBalPriCatHeatgEnad_C TWCC_flgPGlbRlNmotPri_CW TWCC_mIBalFirstStrtPri_T TWCC_mIBalPPri_CUR TWCC_mIBalReStrtPri_T TWCC_mIOscRlsH2Pri_C TWCC_mPBalPri_CUR TWCC_nIMaxPri_C TWCC_nIMinPri_C TWCC_nPMaxPri_C TWCC_nPMinPri_C TWCC_rIDecLdPri_C TWCC_rIDLaH2Pri_C TWCC_rIFlCPPri_C TWCC_rIIncLdPri_C TWCC_rILdMaxPri_CUR TWCC_rILdMinPri_CUR TWCC_rPCoUsPri_C TWCC_rPLdMaxPri_CUR TWCC_rPLdMinPri_CUR TWCC_stPriEna_CW TWCC_tIEngPri_C TWCC_tiIDebFlCutPri_C TWCC_tiIDebIdlSpdPri_C TWCC_tiIDebLdGradPri_C TWCC_tiIDebNLdPri_C TWCC_tiILamGradH2Pri_C TWCC_tiILamSwtH2Pri_C TWCC_tiILckDecelPri_C TWCC_tiILpLdGradPri_C TWCC_tIMaxPri_C TWCC_tIMinPri_CUR TWCC_tIMinTstReqPri_C TWCC_tiPDebCoUsPri_C TWCC_tiPDebLam1DrctPri_C TWCC_tiPDebLam1ErrPri_C TWCC_tiPDebNLdPri_C TWCC_tiPLpCoUsPri_C TWCC_tPMaxPri_C TWCC_tPMinPri_CUR TWCC_tPMinTstReqPri_C /end DEF_CHARACTERISTIC
 /begin IN_MEASUREMENT B_dtes_msg B_eev_msg B_kh_msg B_lasostc_msg B_ll_msg B_lrseta_msg B_lrs_msg B_sa_msg B_sbblsu_msg CEngDsT_t CEngDsT_tReplMdl CoEng_nFco drlas_w_msg EngStrt_bStrtEnd Epm_nEng ExhMod_dmExhS2B1 ExhMod_flgDewPntEndS2B1 ExhMod_ratO2StrCat1B1 ExhMod_tCat1B1 HEGO_bS2B1Vld HEGO_flgS2B1EnaLamCtlColdOper InjSys_bMinPtdInjDurActv InjSys_ratFuMTot rkte_w_msg rl_w_msg SyC_stSub TWCC_rCtlErrPriB1 zlamko_msg /end IN_MEASUREMENT
 /begin OUT_MEASUREMENT TWCC_bILckErrPriB1 TWCC_bIPriB1 TWCC_bLimpPriB1 TWCC_bPLckErrPriB1 TWCC_bPPriB1 /end OUT_MEASUREMENT
 /begin LOC_MEASUREMENT TWCC_bEnaRichPriB1 TWCC_bEnaRichPriB1FF_I.status TWCC_bIBalPriB1 TWCC_bICoPriB1 TWCC_bIGlbBalPri TWCC_bIGlbCPPri TWCC_bIGlbLckErrPri TWCC_bIGlbPri TWCC_bIGLbRlNmotPri TWCC_bIH2DLaPriB1 TWCC_bIH2LckPriB1 TWCC_bISysPriB1 TWCC_bITempPriB1 TWCC_bLimpCoPriB1 TWCC_bPBalPriB1 TWCC_bPCoBalPriB1 TWCC_bPCoPriB1 TWCC_bPDynTempPriB1 TWCC_bPGlbBalPri TWCC_bPGlbLckDiaPri TWCC_bPGlbLckErrPri TWCC_bPGlbPri TWCC_bPGLbRlNmotPri TWCC_bPSysPriB1 TWCC_bPTempPriB1 TWCC_bReStrtEndEF_I.buffer TWCC_bReStrtEndEF_I.oldSignal TWCC_facOSCPriB1 TWCC_facOSCPriGCURWpDisp TWCC_flgEnaIGpfRgnNotActv TWCC_flgEnaPGpfRgnNotActv TWCC_flgLstStrtB1FF_I.status TWCC_IBalPriB1IK_I.memory TWCC_IDecelWoFlCutPriEF_I.buffer TWCC_IDecelWoFlCutPriEF_I.oldSignal TWCC_IDecelWoFlCutPriFF_I.status TWCC_IDecelWoFlCutPriTRE_I.inOld TWCC_IDecelWoFlCutPriTRE_I.timeCounter TWCC_IDLaH2PriB1LT_I.memory TWCC_IFlCutTONV_I.outbit TWCC_IFlCutTONV_I.time TWCC_IIdlSpdTONV_I.outbit TWCC_IIdlSpdTONV_I.time TWCC_ILamSwtH2PriB1EF_I.buffer TWCC_ILamSwtH2PriB1EF_I.oldSignal TWCC_ILamSwtH2PriB1T_I.timeCounter TWCC_ILdGradPriLT_I.memory TWCC_ILdGradPriTOFFV_I.outbit TWCC_ILdGradPriTOFFV_I.time TWCC_INLdPriTOFFV_I.outbit TWCC_INLdPriTOFFV_I.time TWCC_IOSCRlsH2PriB1IK_I.memory TWCC_mIBalPThresPriB1 TWCC_mIBalThresPriB1 TWCC_mPBalThresPriB1 TWCC_PBalPriB1IK_I.memory TWCC_PCoUsPriB1HDR_I.hysterese TWCC_PCoUsPriB1LT_I.memory TWCC_PCoUsPriB1TOFFV_I.outbit TWCC_PCoUsPriB1TOFFV_I.time TWCC_PLam1DrctPriB1TOFFV_I.outbit TWCC_PLam1DrctPriB1TOFFV_I.time TWCC_PLam1ErrPriB1TOFFV_I.outbit TWCC_PLam1ErrPriB1TOFFV_I.time TWCC_PLam1PriB1ER_I.buffer TWCC_PLam1PriB1ER_I.oldSignal TWCC_PNLdPriTOFFV_I.outbit TWCC_PNLdPriTOFFV_I.time TWCC_rIFlCPPri TWCC_tIMinPriB1 TWCC_tPMinPriB1 /end LOC_MEASUREMENT
 FUNCTION_VERSION "1.41.0" /end FUNCTION
/begin FUNCTION TWCC_TstCom "1.10.0    TWC Tester Communication Interface" /begin OUT_MEASUREMENT TWCC_PIDPriB1 /end OUT_MEASUREMENT FUNCTION_VERSION "1.10.0" /end FUNCTION
/begin FUNCTION TWCD_CatMeas "1.29.0    Catalyst Diagnosis by Determination of Storage Capacity"
 /begin DEF_CHARACTERISTIC TWCD_facCorrDlyB1_M TWCD_facCorrTranB1_M TWCD_facMLeanIR_C TWCD_facMRichIR_C TWCD_facOSCRSC_C TWCD_flgOSCCorActv_CW TWCD_flgRSCCorActv_CW TWCD_mOscIni_C TWCD_NewOscPriB1_I.OSCNrm_MAP TWCD_NewOscPriB1_I.mOSCNrmShtrp_T TWCD_NrmOSCPriB1_I.OSCNrm_MAP TWCD_NrmOSCPriB1_I.mOSCNrmShtrp_T TWCD_NrmOSCScndFlPriB1_I.OSCNrm_MAP TWCD_NrmOSCScndFlPriB1_I.mOSCNrmShtrp_T TWCD_tiCorLtrHEGO_M TWCD_tiCorRtlHEGO_M TWCD_uLeanFinThres_C TWCD_uRichFinThres_C /end DEF_CHARACTERISTIC
 /begin REF_CHARACTERISTIC EGSDCmn_flgSymTranOnly_CW TWCD_flgCatDiagActvCat1B1_C /end REF_CHARACTERISTIC
 /begin IN_MEASUREMENT Eep_EnvRamInvld EGSDCmn_flgShtrpParl EGSDCmn_stLamGenrParlB1 EGSDCmn_stVirtCatParlB1 EGSDCmn_uS2B1FildParl EGSDO2_tiDlyAdpnS1B1 EGSDO2_tiTranAdpnS1B1 EGSDU_tiS2B1LtrNrmDly EGSDU_tiS2B1LtrTran EGSDU_tiS2B1RtlNrmDly EGSDU_tiS2B1RtlTran ExhMod_dmExhCat1B1 ExhMod_dmExhWoFuUsCat1B1 ExhMod_facIntrpnGslSecFu ExhMod_idxFirstBrickCat1B1 ExhMod_mfO2Cat1B1 ExhMod_nrBrickCat1B1 ExhMod_tExhAryB1 ExhMod_tiBtwLS1Cat1B1 LamCtrl_ratLamSpS1B1 lamsons_w_msg SyC_stSub UEGO_ratLamSymS1B1 /end IN_MEASUREMENT
 /begin OUT_MEASUREMENT TWCD_flgFCMClrReqdCatMeasCat1B1 TWCD_flgMeasFinB1 TWCD_flgMeasFinVirtB1 TWCD_flgPtlMeasOSCFinB1 TWCD_flgPtlMeasRSCFinB1 TWCD_mOscExtdCat1B1 TWCD_mOSCNrmDiumprExtdB1 TWCD_mOSCNrmExtdB1 TWCD_mOscPtlCorrdCat1B1 TWCD_mOscPtlCorrdExtdCat1B1 TWCD_mRSCNrmDiumprExtdB1 TWCD_mRscPtlCorrdCat1B1 TWCD_mRscPtlCorrdExtdCat1B1 TWCD_rOSCPriB1 /end OUT_MEASUREMENT
 /begin LOC_MEASUREMENT TWCD_CatMeasSMB1_I.arg_Syc_stSub TWCD_CatMeasSMB1_I.arg_flgOSCMeasmtStart TWCD_CatMeasSMB1_I.arg_mOSCNrm TWCD_CatMeasSMB1_I.arg_mOscNew TWCD_CatMeasSMB1_I.arg_mRSCNrm TWCD_CatMeasSMB1_I.arg_mfO2Cat TWCD_CatMeasSMB1_I.arg_mfO2LsuDynCorrd TWCD_CatMeasSMB1_I.arg_stLamGenrParl TWCD_CatMeasSMB1_I.arg_stVirtCatParl TWCD_CatMeasSMB1_I.arg_tiLtrNrmDly TWCD_CatMeasSMB1_I.arg_tiLtrTran TWCD_CatMeasSMB1_I.arg_tiRtlNrmDly TWCD_CatMeasSMB1_I.arg_tiRtlTran TWCD_CatMeasSMB1_I.arg_uDs TWCD_CatMeasSMB1_I.arg_uLeanFinThres TWCD_CatMeasSMB1_I.arg_uRichFinThres TWCD_CatMeasSMB1_I.dmOscCorr TWCD_CatMeasSMB1_I.flgMeasFin TWCD_CatMeasSMB1_I.flgMeasmtFinshd200ms TWCD_CatMeasSMB1_I.flgMeasmtFinshdVirt TWCD_CatMeasSMB1_I.flgMeasmtFinshdVirt200ms TWCD_CatMeasSMB1_I.flgPtlMeasOSCFin TWCD_CatMeasSMB1_I.flgPtlMeasRSCFin TWCD_CatMeasSMB1_I.flgPtlMeasRSCFinTmp TWCD_CatMeasSMB1_I.mOSC TWCD_CatMeasSMB1_I.mOSCraw TWCD_CatMeasSMB1_I.mOscLsuDynCorrd TWCD_CatMeasSMB1_I.mOscNv TWCD_CatMeasSMB1_I.mOscRawLsuDynCorrd TWCD_CatMeasSMB1_I.mOscRawTmp TWCD_CatMeasSMB1_I.mRoscLsuDynCorrd TWCD_CatMeasSMB1_I.mRoscRawLsuDynCorrd TWCD_CatMeasSMB1_I.ratOsc TWCD_CatMeasSMB1_I.sm TWCD_CatMeasSMB1_I.tiCorLeanRich TWCD_CatMeasSMB1_I.tiCorRichLean TWCD_CatMeasSMB1_I.DynCorrnOscLsuDyn_I.dmO2Corrn TWCD_CatMeasSMB1_I.DynCorrnOscLsuDyn_I.dmO2Grdt TWCD_CatMeasSMB1_I.DynCorrnOscLsuDyn_I.mO2CorSlp TWCD_CatMeasSMB1_I.DynCorrnOscLsuDyn_I.mO2Corrd TWCD_CatMeasSMB1_I.DynCorrnOscLsuDyn_I.tiCorSlp TWCD_CatMeasSMB1_I.DynCorrnOsc_I.dmO2Corrn TWCD_CatMeasSMB1_I.DynCorrnOsc_I.dmO2Grdt TWCD_CatMeasSMB1_I.DynCorrnOsc_I.mO2CorSlp TWCD_CatMeasSMB1_I.DynCorrnOsc_I.mO2Corrd TWCD_CatMeasSMB1_I.DynCorrnOsc_I.tiCorSlp TWCD_CatMeasSMB1_I.DynCorrnRosc_I.dmO2Corrn TWCD_CatMeasSMB1_I.DynCorrnRosc_I.dmO2Grdt TWCD_CatMeasSMB1_I.DynCorrnRosc_I.mO2CorSlp TWCD_CatMeasSMB1_I.DynCorrnRosc_I.mO2Corrd TWCD_CatMeasSMB1_I.DynCorrnRosc_I.tiCorSlp TWCD_CatMeasSMB1_I.O2LsuDynCorrdIKL_I.memory TWCD_CatMeasSMB1_I.O2MsIKL_I.memory TWCD_CatMeasSMB1_I.flgMeasmtFinshdFF_I.status TWCD_CatMeasSMB1_I.flgMeasmtFinshdVirtFF_I.status TWCD_CatMeasSMB1_I.flgVirtMeasmtER_I.buffer TWCD_CatMeasSMB1_I.flgVirtMeasmtER_I.oldSignal TWCD_dmGasB1 TWCD_mfO2LSUDynB1 TWCD_mOscNewCat1B1 TWCD_mRSCNrmExtdB1 TWCD_NewOscPriB1_I.ctBrick TWCD_NewOscPriB1_I.dmGas TWCD_NewOscPriB1_I.mOsc TWCD_NewOscPriB1_I.tBrick TWCD_NrmOSCPriB1_I.ctBrick TWCD_NrmOSCPriB1_I.dmGas TWCD_NrmOSCPriB1_I.mOsc TWCD_NrmOSCPriB1_I.tBrick TWCD_NrmOSCScndFlPriB1_I.ctBrick TWCD_NrmOSCScndFlPriB1_I.dmGas TWCD_NrmOSCScndFlPriB1_I.mOsc TWCD_NrmOSCScndFlPriB1_I.tBrick TWCD_ratLamLSUDynB1 TWCD_ratLamLsuDynCorrdCat1B1 /end LOC_MEASUREMENT
 FUNCTION_VERSION "1.29.0" /end FUNCTION
/begin FUNCTION TWCD_DSMCfg "4.31.0    DSM configuration for catalyst monitoring" FUNCTION_VERSION "4.31.0" /end FUNCTION
/begin FUNCTION TWCD_Eval "3.20.0    Evaluation of catalyst diagnosis measurements"
 /begin DEF_CHARACTERISTIC TWCD_flgArthFltPassTstActvd_CW TWCD_flgCatDiagActvCat1B1_C TWCD_flgEwma_CW TWCD_flgOSCMaxRng_CW TWCD_FltDsEval_B1.rOfsRmnProdModParl_C TWCD_NrMeasStepChg_C TWCD_numMeasShtrp_C TWCD_numMeas_C TWCD_ratStepChgCnf_C TWCD_ratStepChgSus_C TWCD_rOSCMaxRng_C TWCD_rOSCThresB1_C TWCD_rOSCThresBPUB1_C TWCD_swtEolTstRls_C TWCD_valEwmaIni_C TWCD_valEwma_C /end DEF_CHARACTERISTIC
 /begin IN_MEASUREMENT Eep_EnvRamInvld EGSDCmn_flgEnvtlDiPID41Parl EGSDCmn_flgProdModParl EGSDCmn_flgRmnProdModParl EGSDCmn_flgShtrpParl SyC_ctPostDrvLeave SyC_stSub TWCD_flgMeasFinB1 TWCD_flgMeasFinVirtB1 TWCD_rOSCPriB1 /end IN_MEASUREMENT
 /begin OUT_MEASUREMENT TWCD_flgErrSusB1 TWCD_flgFCMClrReqdEvalCat1B1 TWCD_flgMeasFinshdTripB1 TWCD_flgMeasFinshdVirtTripB1 TWCD_flgOSCQPFaildPriB1 TWCD_flgOSCStepChgPriB1 TWCD_flgResOSCPriB1 TWCD_flgResVirtOSCPriB1 TWCD_numMeasB1 TWCD_rDiagRsltB1 TWCD_rOSCAvrgPriB1 /end OUT_MEASUREMENT
 /begin LOC_MEASUREMENT TWCD_ctReIniEval TWCD_DsmIfCat1B1_I.flgErr TWCD_DsmIfCat1B1_I.flgErrSus TWCD_DsmIfCat1B1_I.flgHeal TWCD_DsmIfCat1B1_I.flgVldnFin TWCD_DsmIfCat1B1_I.rDiagRslt TWCD_DsmIfCat1B1_I.RsltER_I.buffer TWCD_DsmIfCat1B1_I.RsltER_I.oldSignal TWCD_DsmIfCat1B1_I.flgErrSusERNM_I.oldSignal TWCD_flgEvalDsmTripChgFinshd TWCD_FltDsEval_B1.flgMeasFinshdTrip TWCD_FltDsEval_B1.flgNumTemp TWCD_FltDsEval_B1.flgOSCQPFaild TWCD_FltDsEval_B1.flgOSCStepChgPri TWCD_FltDsEval_B1.flgQPFaild TWCD_FltDsEval_B1.flgQckPassd TWCD_FltDsEval_B1.flgResOSCPri TWCD_FltDsEval_B1.flgResVirtOSCPri TWCD_FltDsEval_B1.flgStepChg TWCD_FltDsEval_B1.flgVirtMeasFinshdTrip TWCD_FltDsEval_B1.numMeas TWCD_FltDsEval_B1.numMeasShrtp TWCD_FltDsEval_B1.numMeasTrip TWCD_FltDsEval_B1.numVirtMeas TWCD_FltDsEval_B1.numVirtMeasTrip TWCD_FltDsEval_B1.rOSCAvrgPri TWCD_FltDsEval_B1.val TWCD_FltDsEval_B1.valArth TWCD_FltDsEval_B1.valEwma TWCD_FltDsEval_B1.valQuickPass TWCD_FltDsEval_B1.valArthDL_I.memory TWCD_FltDsEval_B1.valArthShrtpDL_I.memory TWCD_FltDsEval_B1.valEwmaDL_I.memory /end LOC_MEASUREMENT
 FUNCTION_VERSION "3.20.0" /end FUNCTION
/begin FUNCTION UEGO_Amplfr "1.10.0    UEGO Control of the amplifier setting"
 /begin DEF_CHARACTERISTIC UEGO_stAmplfr_C UEGO_stLoupNNormSeln_C UEGO_stLoupNSeln_C UEGO_stLoupNSet_C UEGO_stLoupPNormSeln_C UEGO_stLoupPSeln_C UEGO_stLoupPSet_C UEGO_uLnEnaDown_C UEGO_uLnEnaUp_C UEGO_uLpEnaDown_C UEGO_uLpEnaUp_C /end DEF_CHARACTERISTIC
 /begin IN_MEASUREMENT UEGO_DataSplyClsS1B1_I.flgCj135An UEGO_DataSplyClsS1B1_I.flgDACOff UEGO_DataSplyClsS1B1_I.flgErrSpiRamRet UEGO_DataSplyClsS1B1_I.flgFKal1Vld UEGO_DataSplyClsS1B1_I.flgFKal2Vld UEGO_DataSplyClsS1B1_I.flgFKal3Vld UEGO_DataSplyClsS1B1_I.flgIPmpActvd UEGO_DataSplyClsS1B1_I.flgISQrA UEGO_DataSplyClsS1B1_I.flgISQrE UEGO_DataSplyClsS1B1_I.flgLCURR UEGO_DataSplyClsS1B1_I.flgLNMeas UEGO_DataSplyClsS1B1_I.flgLPMeas UEGO_DataSplyClsS1B1_I.flgLoupeCAL UEGO_DataSplyClsS1B1_I.flgLoupeG0 UEGO_DataSplyClsS1B1_I.flgLstPckAbort UEGO_DataSplyClsS1B1_I.flgMKA UEGO_DataSplyClsS1B1_I.flgMKE UEGO_DataSplyClsS1B1_I.flgNewIPmpDacPckAry UEGO_DataSplyClsS1B1_I.flgNewIPmpOK UEGO_DataSplyClsS1B1_I.flgNewIPmpPckAry UEGO_DataSplyClsS1B1_I.flgNewIPmpTM UEGO_DataSplyClsS1B1_I.flgNewPck UEGO_DataSplyClsS1B1_I.flgNewPckCstnc UEGO_DataSplyClsS1B1_I.flgNewPckMiss UEGO_DataSplyClsS1B1_I.flgNewPckVld UEGO_DataSplyClsS1B1_I.flgNewTiPck UEGO_DataSplyClsS1B1_I.flgNewURmVG4MeasAryVld UEGO_DataSplyClsS1B1_I.flgNewUa2Pck UEGO_DataSplyClsS1B1_I.flgNewUa31Pck UEGO_DataSplyClsS1B1_I.flgNewUa32Pck UEGO_DataSplyClsS1B1_I.flgNewUa33Pck UEGO_DataSplyClsS1B1_I.flgNewUamPck UEGO_DataSplyClsS1B1_I.flgNewUapePck UEGO_DataSplyClsS1B1_I.flgNewUcalMaxPck UEGO_DataSplyClsS1B1_I.flgNewUcalPck UEGO_DataSplyClsS1B1_I.flgNewUg0Pck UEGO_DataSplyClsS1B1_I.flgNewUg0PckAry UEGO_DataSplyClsS1B1_I.flgNewUg0aPck UEGO_DataSplyClsS1B1_I.flgNewUg0ePck UEGO_DataSplyClsS1B1_I.flgNewUg0iPck UEGO_DataSplyClsS1B1_I.flgNewUg0iPckAry UEGO_DataSplyClsS1B1_I.flgNewUg0iaiPck UEGO_DataSplyClsS1B1_I.flgNewUg0ieiPck UEGO_DataSplyClsS1B1_I.flgNewUg0ix7PckAry UEGO_DataSplyClsS1B1_I.flgNewUg0ix9PckAry UEGO_DataSplyClsS1B1_I.flgNewUg0ixPckAry UEGO_DataSplyClsS1B1_I.flgNewUg0mPck UEGO_DataSplyClsS1B1_I.flgNewUgaPck UEGO_DataSplyClsS1B1_I.flgNewUgiPckAry UEGO_DataSplyClsS1B1_I.flgNewUgkAvrgPck UEGO_DataSplyClsS1B1_I.flgNewUguaPck UEGO_DataSplyClsS1B1_I.flgNewUguaZ2Pck UEGO_DataSplyClsS1B1_I.flgNewUguiPck UEGO_DataSplyClsS1B1_I.flgNewUguiZ1Pck UEGO_DataSplyClsS1B1_I.flgNewUi21PckAry UEGO_DataSplyClsS1B1_I.flgNewUi22Pck UEGO_DataSplyClsS1B1_I.flgNewUi23Pck UEGO_DataSplyClsS1B1_I.flgNewUi24Pck UEGO_DataSplyClsS1B1_I.flgNewUi4Pck UEGO_DataSplyClsS1B1_I.flgNewUi4Z2Pck UEGO_DataSplyClsS1B1_I.flgNewUigPckAry UEGO_DataSplyClsS1B1_I.flgNewUigmkPckAry UEGO_DataSplyClsS1B1_I.flgNewUipcalAvrgPck UEGO_DataSplyClsS1B1_I.flgNewUn0Pck UEGO_DataSplyClsS1B1_I.flgNewUn0Pck4Ary UEGO_DataSplyClsS1B1_I.flgNewUn0Pck5Ary UEGO_DataSplyClsS1B1_I.flgNewUn0PckAry UEGO_DataSplyClsS1B1_I.flgNewUnPckAry UEGO_DataSplyClsS1B1_I.flgNewUnSetPck UEGO_DataSplyClsS1B1_I.flgNewUnx3PckAry UEGO_DataSplyClsS1B1_I.flgNewUnx4PckAry UEGO_DataSplyClsS1B1_I.flgNewUp0Pck UEGO_DataSplyClsS1B1_I.flgNewUp0Pck4 UEGO_DataSplyClsS1B1_I.flgNewUp0Pck5Ary UEGO_DataSplyClsS1B1_I.flgNewUp0PckAry UEGO_DataSplyClsS1B1_I.flgNewUpPckAry UEGO_DataSplyClsS1B1_I.flgNewUpx3PckAry UEGO_DataSplyClsS1B1_I.flgNewUpx4PckAry UEGO_DataSplyClsS1B1_I.flgNewUriaPckVld UEGO_DataSplyClsS1B1_I.flgNewUriePckAry UEGO_DataSplyClsS1B1_I.flgNewUx6PckAry UEGO_DataSplyClsS1B1_I.flgNewUx7PckAry UEGO_DataSplyClsS1B1_I.flgNewUx8PckAry UEGO_DataSplyClsS1B1_I.flgNewUx9PckAry UEGO_DataSplyClsS1B1_I.flgNewUxPckAry UEGO_DataSplyClsS1B1_I.flgReStable UEGO_DataSplyClsS1B1_I.flgSngCell UEGO_DataSplyClsS1B1_I.flgUical0Vld UEGO_DataSplyClsS1B1_I.flgUicalVld UEGO_DataSplyClsS1B1_I.flgUoffipe1Vld UEGO_DataSplyClsS1B1_I.flgUoffipe2Vld UEGO_DataSplyClsS1B1_I.flgUoffipe3Vld UEGO_DataSplyClsS1B1_I.flgUoffvcc1Vld UEGO_DataSplyClsS1B1_I.flgUoffvcc2Vld UEGO_DataSplyClsS1B1_I.flgUoffvcc3Vld UEGO_DataSplyClsS1B1_I.flgUriaMeas UEGO_DataSplyClsS1B1_I.nrIPmpDacPckAry UEGO_DataSplyClsS1B1_I.nrIpPckAry UEGO_DataSplyClsS1B1_I.nrModeMeas UEGO_DataSplyClsS1B1_I.nrRamFailPosn UEGO_DataSplyClsS1B1_I.nrRamMod UEGO_DataSplyClsS1B1_I.nrRamRegMod UEGO_DataSplyClsS1B1_I.nrRamSts1 UEGO_DataSplyClsS1B1_I.nrRamSts2 UEGO_DataSplyClsS1B1_I.nrRamSts3 UEGO_DataSplyClsS1B1_I.nrURmVG4PckAry UEGO_DataSplyClsS1B1_I.nrUa2PckAry UEGO_DataSplyClsS1B1_I.nrUcalMaxCorrd UEGO_DataSplyClsS1B1_I.nrUg0PckAry UEGO_DataSplyClsS1B1_I.nrUg0iPckAry UEGO_DataSplyClsS1B1_I.nrUg0ix7PckAry UEGO_DataSplyClsS1B1_I.nrUg0ix9PckAry UEGO_DataSplyClsS1B1_I.nrUg0ixPckAry UEGO_DataSplyClsS1B1_I.nrUgaPckAry UEGO_DataSplyClsS1B1_I.nrUgiPckAry UEGO_DataSplyClsS1B1_I.nrUi21PckAry UEGO_DataSplyClsS1B1_I.nrUical0PckCorrd UEGO_DataSplyClsS1B1_I.nrUicalPckCorrd UEGO_DataSplyClsS1B1_I.nrUigPckAry UEGO_DataSplyClsS1B1_I.nrUigmkPckAry UEGO_DataSplyClsS1B1_I.nrUn0Pck4Ary UEGO_DataSplyClsS1B1_I.nrUn0Pck5Ary UEGO_DataSplyClsS1B1_I.nrUn0PckAry UEGO_DataSplyClsS1B1_I.nrUnPckAry UEGO_DataSplyClsS1B1_I.nrUnx3PckAry UEGO_DataSplyClsS1B1_I.nrUnx4PckAry UEGO_DataSplyClsS1B1_I.nrUoffipe1 UEGO_DataSplyClsS1B1_I.nrUoffipe2 UEGO_DataSplyClsS1B1_I.nrUoffipe3 UEGO_DataSplyClsS1B1_I.nrUoffvcc1 UEGO_DataSplyClsS1B1_I.nrUoffvcc2 UEGO_DataSplyClsS1B1_I.nrUoffvcc3 UEGO_DataSplyClsS1B1_I.nrUp0Pck5Ary UEGO_DataSplyClsS1B1_I.nrUp0PckAry UEGO_DataSplyClsS1B1_I.nrUpPckAry UEGO_DataSplyClsS1B1_I.nrUpx3PckAry UEGO_DataSplyClsS1B1_I.nrUpx4PckAry UEGO_DataSplyClsS1B1_I.nrUriePckAry UEGO_DataSplyClsS1B1_I.nrUx6PckAry UEGO_DataSplyClsS1B1_I.nrUx7PckAry UEGO_DataSplyClsS1B1_I.nrUx8PckAry UEGO_DataSplyClsS1B1_I.nrUx9PckAry UEGO_DataSplyClsS1B1_I.nrUxPckAry UEGO_DataSplyClsS1B1_I.stIPmpOK UEGO_DataSplyClsS1B1_I.stIPmpTM UEGO_DataSplyClsS1B1_I.stIPmpTM2L UEGO_DataSplyClsS1B1_I.stIPmpTM2R UEGO_DataSplyClsS1B1_I.stLsmRetValMod UEGO_DataSplyClsS1B1_I.stMKMeas UEGO_DataSplyClsS1B1_I.stOFFMeas UEGO_DataSplyClsS1B1_I.stOPTMeas UEGO_DataSplyClsS1B1_I.stREFMeas UEGO_DataSplyClsS1B1_I.stUa2PckAry UEGO_DataSplyClsS1B1_I.stUa2Z1PckAry UEGO_DataSplyClsS1B1_I.stUg0iPckAry UEGO_DataSplyClsS1B1_I.stUg0ix7IActvPckAry UEGO_DataSplyClsS1B1_I.stUg0ix7PmpIActvPckAry UEGO_DataSplyClsS1B1_I.stUg0ix9IActvPckAry UEGO_DataSplyClsS1B1_I.stUg0ix9PmpIActvPckAry UEGO_DataSplyClsS1B1_I.stUg0ixIActvPckAry UEGO_DataSplyClsS1B1_I.stUg0ixPmpIActvPckAry UEGO_DataSplyClsS1B1_I.stUi21PckAry UEGO_DataSplyClsS1B1_I.stUi21Z1PckAry UEGO_DataSplyClsS1B1_I.stUigmkNernstIActvPckAry UEGO_DataSplyClsS1B1_I.stUigmkPmpIActvPckAry UEGO_DataSplyClsS1B1_I.stUn0PckAry UEGO_DataSplyClsS1B1_I.stUn0Z2PckAry UEGO_DataSplyClsS1B1_I.stUnPckAry UEGO_DataSplyClsS1B1_I.stUnx3IActvAcrsNernstCellPckAry UEGO_DataSplyClsS1B1_I.stUnx3IActvAcrsPmpCellPckAry UEGO_DataSplyClsS1B1_I.stUnx4IActvAcrsNernstCellPckAry UEGO_DataSplyClsS1B1_I.stUnx4IActvAcrsPmpCellPckAry UEGO_DataSplyClsS1B1_I.stUp0PckAry UEGO_DataSplyClsS1B1_I.stUp0Z2PckAry UEGO_DataSplyClsS1B1_I.stUpPckAry UEGO_DataSplyClsS1B1_I.stUpZ2PckAry UEGO_DataSplyClsS1B1_I.stUpx3IActvAcrsNernstCellPckAry UEGO_DataSplyClsS1B1_I.stUpx3IActvAcrsPmpCellPckAry UEGO_DataSplyClsS1B1_I.stUpx4IActvAcrsNernstCellPckAry UEGO_DataSplyClsS1B1_I.stUpx4IActvAcrsPmpCellPckAry UEGO_DataSplyClsS1B1_I.stUriePckAry UEGO_DataSplyClsS1B1_I.stUx6IActvPckAry UEGO_DataSplyClsS1B1_I.stUx6MeasAcrsPmpCellPckAry UEGO_DataSplyClsS1B1_I.stUx7IActvPckAry UEGO_DataSplyClsS1B1_I.stUx7MeasAcrsPmpCellPckAry UEGO_DataSplyClsS1B1_I.stUx8IActvPckAry UEGO_DataSplyClsS1B1_I.stUx8MeasAcrsPmpCellPckAry UEGO_DataSplyClsS1B1_I.stUx9IActvPckAry UEGO_DataSplyClsS1B1_I.stUx9MeasAcrsPmpCellPckAry UEGO_DataSplyClsS1B1_I.stUxIActvPckAry UEGO_DataSplyClsS1B1_I.stUxMeasAcrsPmpCell UEGO_DataSplyClsS1B1_I.tiUEGOPck UEGO_DataSplyClsS1B1_I.uFkal1 UEGO_DataSplyClsS1B1_I.uFkal2 UEGO_DataSplyClsS1B1_I.uFkal3 UEGO_DataSplyClsS1B1_I.uUCalPck UEGO_DataSplyClsS1B1_I.uUa31Pck UEGO_DataSplyClsS1B1_I.uUa32Pck UEGO_DataSplyClsS1B1_I.uUa33Pck UEGO_DataSplyClsS1B1_I.uUamPck UEGO_DataSplyClsS1B1_I.uUapePck UEGO_DataSplyClsS1B1_I.uUcalMaxPck UEGO_DataSplyClsS1B1_I.uUg0Pck UEGO_DataSplyClsS1B1_I.uUg0aPck UEGO_DataSplyClsS1B1_I.uUg0ePck UEGO_DataSplyClsS1B1_I.uUg0iPck UEGO_DataSplyClsS1B1_I.uUg0iaiPck UEGO_DataSplyClsS1B1_I.uUg0ieiPck UEGO_DataSplyClsS1B1_I.uUg0mPck UEGO_DataSplyClsS1B1_I.uUgkAvrgPck UEGO_DataSplyClsS1B1_I.uUguaPck UEGO_DataSplyClsS1B1_I.uUguaZ2Pck UEGO_DataSplyClsS1B1_I.uUguiPck UEGO_DataSplyClsS1B1_I.uUguiZ1Pck UEGO_DataSplyClsS1B1_I.uUi22Pck UEGO_DataSplyClsS1B1_I.uUi23Pck UEGO_DataSplyClsS1B1_I.uUi24Pck UEGO_DataSplyClsS1B1_I.uUi4Pck UEGO_DataSplyClsS1B1_I.uUi4Z2Pck UEGO_DataSplyClsS1B1_I.uUipcalAvrgPck UEGO_DataSplyClsS1B1_I.uUn0Pck UEGO_DataSplyClsS1B1_I.uUnSet UEGO_DataSplyClsS1B1_I.uUp0Pck UEGO_DataSplyClsS1B1_I.uUp0Pck4 UEGO_DataSplyClsS1B1_I.uUriaPck UEGO_DataSplyClsS1B1_I.uVCC1Corrd UEGO_DataSplyClsS1B1_I.uVCC3Ref UEGO_flgCJ135AnS1B1 UEGO_flgSysSuprtdS1B1 UEGO_RegSetS1B1_I.cntrRegSet UEGO_RegSetS1B1_I.flgCJ135An UEGO_RegSetS1B1_I.flgConvVld UEGO_RegSetS1B1_I.flgIPmpDes UEGO_RegSetS1B1_I.flgIPmpPhyRels UEGO_RegSetS1B1_I.flgIniFinshd UEGO_RegSetS1B1_I.flgLoupeCURRDes UEGO_RegSetS1B1_I.flgLoupeDACDes UEGO_RegSetS1B1_I.flgLoupeNDes UEGO_RegSetS1B1_I.flgLoupePDes UEGO_RegSetS1B1_I.flgNewReq UEGO_RegSetS1B1_I.flgRegSetSt UEGO_RegSetS1B1_I.flgRegSetStVld UEGO_RegSetS1B1_I.flgReqAcptd UEGO_RegSetS1B1_I.flgSetRegOk UEGO_RegSetS1B1_I.flgTakeDataOk UEGO_RegSetS1B1_I.idxChp UEGO_RegSetS1B1_I.nrIdleSubMode UEGO_RegSetS1B1_I.nrModDes UEGO_RegSetS1B1_I.nrNormSubMode UEGO_RegSetS1B1_I.nrRegSet UEGO_RegSetS1B1_I.nrSubModDes UEGO_RegSetS1B1_I.nrSwtOnSubMode UEGO_RegSetS1B1_I.nrTrmSq UEGO_RegSetS1B1_I.nrWrmUpSubMode UEGO_RegSetS1B1_I.stRegSet UEGO_RegSetS1B1_I.stRegSetVld UEGO_RegSetS1B1_I.tmpVar UEGO_uUn0PckAryS1B1 UEGO_uUpPckAryS1B1 UEGO_uUriePckAryS1B1 /end IN_MEASUREMENT
 /begin OUT_MEASUREMENT UEGO_flgOPM1GainVldS1B1 UEGO_flgOPM2GainVldS1B1 UEGO_flgOPM3GainVldS1B1 UEGO_uOPM1GainS1B1 UEGO_uOPM2GainS1B1 UEGO_uOPM3GainS1B1 /end OUT_MEASUREMENT
 /begin LOC_MEASUREMENT UEGO_AmplfrCJ135S1B1_I._cntr UEGO_AmplfrCJ135S1B1_I._tmp_UMax UEGO_AmplfrCJ135S1B1_I._tmp_Unp UEGO_AmplfrCJ135S1B1_I.cntrSeln UEGO_AmplfrCJ135S1B1_I.flgMaxLNVld UEGO_AmplfrCJ135S1B1_I.flgMaxLPVld UEGO_AmplfrCJ135S1B1_I.flgModIntLN UEGO_AmplfrCJ135S1B1_I.flgModIntLP UEGO_AmplfrCJ135S1B1_I.flgOPM1GainVld UEGO_AmplfrCJ135S1B1_I.flgOPM2GainVld UEGO_AmplfrCJ135S1B1_I.flgOPM3GainVld UEGO_AmplfrCJ135S1B1_I.flgRegSetLN UEGO_AmplfrCJ135S1B1_I.flgRegSetLP UEGO_AmplfrCJ135S1B1_I.nrModIntLN UEGO_AmplfrCJ135S1B1_I.nrModIntLP UEGO_AmplfrCJ135S1B1_I.nrModIntOldLN UEGO_AmplfrCJ135S1B1_I.nrModIntOldLP UEGO_AmplfrCJ135S1B1_I.stLoupNSet UEGO_AmplfrCJ135S1B1_I.stLoupPSet UEGO_AmplfrCJ135S1B1_I.uMaxLN UEGO_AmplfrCJ135S1B1_I.uMaxLP UEGO_AmplfrCJ135S1B1_I.uOPM1Gain UEGO_AmplfrCJ135S1B1_I.uOPM2Gain UEGO_AmplfrCJ135S1B1_I.uOPM3Gain /end LOC_MEASUREMENT
 FUNCTION_VERSION "1.10.0" /end FUNCTION
/begin FUNCTION UEGO_AsicCompu "1.20.0    Computations of UEGO ASIC" FUNCTION_VERSION "1.20.0" /end FUNCTION
/begin FUNCTION UEGO_Chp "1.17.0    UEGO Chip Identification"
 /begin DEF_CHARACTERISTIC UEGO_facMeasRefFilCon_C UEGO_stChpSuprtd_CA UEGO_stChp_C UEGO_idxHWES1B1_C UEGO_uVCC3Ref_C /end DEF_CHARACTERISTIC
 /begin IN_MEASUREMENT UEGO_flgDiagSigEcuAsicRstS1B1 UEGO_flgDiagSigRegDiagVldS1B1 UEGO_flgSnsrSuprtdS1B1 UEGO_flgSysSuprtdS1B1 UEGO_idxTypS1B1 UEGO_stDiagSigChpS1B1 /end IN_MEASUREMENT
 /begin OUT_MEASUREMENT UEGO_flgChpSuprtdS1B1 UEGO_flgCJ135AnS1B1 UEGO_flgVCC3RefMeasVldS1B1 UEGO_idxChpS1B1 UEGO_uVCC3RefS1B1 /end OUT_MEASUREMENT
 /begin LOC_MEASUREMENT dummy UEGO_ChpS1B1_I.flgCJ135An UEGO_ChpS1B1_I.flgChpSuprtd UEGO_ChpS1B1_I.flgChpSwPrsnt UEGO_ChpS1B1_I.flgUVCC3MeasRefVld UEGO_ChpS1B1_I.idxChp UEGO_ChpS1B1_I.idxTyp UEGO_ChpS1B1_I.uVCC3MeasRef UEGO_ChpS1B1_I.uVCC3MeasRefUnFild UEGO_ChpS1B1_I.UEGO_UVCC3MeasFilDL_I.flgEvlnStrtd UEGO_ChpS1B1_I.UEGO_UVCC3MeasFilDL_I.EvlnFil_DL_I.memory /end LOC_MEASUREMENT
 FUNCTION_VERSION "1.17.0" /end FUNCTION
/begin FUNCTION UEGO_ClassLib "1.10.0    Common class library for UEGO functions" FUNCTION_VERSION "1.10.0" /end FUNCTION
/begin FUNCTION UEGO_Dac "1.20.0    UEGO Digital Analog Converter" /begin DEF_CHARACTERISTIC UEGO_nrDacAdpnCollctdDataThd_C UEGO_stDac_C /end DEF_CHARACTERISTIC
 /begin IN_MEASUREMENT UEGO_DataSplyClsS1B1_I.flgCj135An UEGO_DataSplyClsS1B1_I.flgDACOff UEGO_DataSplyClsS1B1_I.flgErrSpiRamRet UEGO_DataSplyClsS1B1_I.flgFKal1Vld UEGO_DataSplyClsS1B1_I.flgFKal2Vld UEGO_DataSplyClsS1B1_I.flgFKal3Vld UEGO_DataSplyClsS1B1_I.flgIPmpActvd UEGO_DataSplyClsS1B1_I.flgISQrA UEGO_DataSplyClsS1B1_I.flgISQrE UEGO_DataSplyClsS1B1_I.flgLCURR UEGO_DataSplyClsS1B1_I.flgLNMeas UEGO_DataSplyClsS1B1_I.flgLPMeas UEGO_DataSplyClsS1B1_I.flgLoupeCAL UEGO_DataSplyClsS1B1_I.flgLoupeG0 UEGO_DataSplyClsS1B1_I.flgLstPckAbort UEGO_DataSplyClsS1B1_I.flgMKA UEGO_DataSplyClsS1B1_I.flgMKE UEGO_DataSplyClsS1B1_I.flgNewIPmpDacPckAry UEGO_DataSplyClsS1B1_I.flgNewIPmpOK UEGO_DataSplyClsS1B1_I.flgNewIPmpPckAry UEGO_DataSplyClsS1B1_I.flgNewIPmpTM UEGO_DataSplyClsS1B1_I.flgNewPck UEGO_DataSplyClsS1B1_I.flgNewPckCstnc UEGO_DataSplyClsS1B1_I.flgNewPckMiss UEGO_DataSplyClsS1B1_I.flgNewPckVld UEGO_DataSplyClsS1B1_I.flgNewTiPck UEGO_DataSplyClsS1B1_I.flgNewURmVG4MeasAryVld UEGO_DataSplyClsS1B1_I.flgNewUa2Pck UEGO_DataSplyClsS1B1_I.flgNewUa31Pck UEGO_DataSplyClsS1B1_I.flgNewUa32Pck UEGO_DataSplyClsS1B1_I.flgNewUa33Pck UEGO_DataSplyClsS1B1_I.flgNewUamPck UEGO_DataSplyClsS1B1_I.flgNewUapePck UEGO_DataSplyClsS1B1_I.flgNewUcalMaxPck UEGO_DataSplyClsS1B1_I.flgNewUcalPck UEGO_DataSplyClsS1B1_I.flgNewUg0Pck UEGO_DataSplyClsS1B1_I.flgNewUg0PckAry UEGO_DataSplyClsS1B1_I.flgNewUg0aPck UEGO_DataSplyClsS1B1_I.flgNewUg0ePck UEGO_DataSplyClsS1B1_I.flgNewUg0iPck UEGO_DataSplyClsS1B1_I.flgNewUg0iPckAry UEGO_DataSplyClsS1B1_I.flgNewUg0iaiPck UEGO_DataSplyClsS1B1_I.flgNewUg0ieiPck UEGO_DataSplyClsS1B1_I.flgNewUg0ix7PckAry UEGO_DataSplyClsS1B1_I.flgNewUg0ix9PckAry UEGO_DataSplyClsS1B1_I.flgNewUg0ixPckAry UEGO_DataSplyClsS1B1_I.flgNewUg0mPck UEGO_DataSplyClsS1B1_I.flgNewUgaPck UEGO_DataSplyClsS1B1_I.flgNewUgiPckAry UEGO_DataSplyClsS1B1_I.flgNewUgkAvrgPck UEGO_DataSplyClsS1B1_I.flgNewUguaPck UEGO_DataSplyClsS1B1_I.flgNewUguaZ2Pck UEGO_DataSplyClsS1B1_I.flgNewUguiPck UEGO_DataSplyClsS1B1_I.flgNewUguiZ1Pck UEGO_DataSplyClsS1B1_I.flgNewUi21PckAry UEGO_DataSplyClsS1B1_I.flgNewUi22Pck UEGO_DataSplyClsS1B1_I.flgNewUi23Pck UEGO_DataSplyClsS1B1_I.flgNewUi24Pck UEGO_DataSplyClsS1B1_I.flgNewUi4Pck UEGO_DataSplyClsS1B1_I.flgNewUi4Z2Pck UEGO_DataSplyClsS1B1_I.flgNewUigPckAry UEGO_DataSplyClsS1B1_I.flgNewUigmkPckAry UEGO_DataSplyClsS1B1_I.flgNewUipcalAvrgPck UEGO_DataSplyClsS1B1_I.flgNewUn0Pck UEGO_DataSplyClsS1B1_I.flgNewUn0Pck4Ary UEGO_DataSplyClsS1B1_I.flgNewUn0Pck5Ary UEGO_DataSplyClsS1B1_I.flgNewUn0PckAry UEGO_DataSplyClsS1B1_I.flgNewUnPckAry UEGO_DataSplyClsS1B1_I.flgNewUnSetPck UEGO_DataSplyClsS1B1_I.flgNewUnx3PckAry UEGO_DataSplyClsS1B1_I.flgNewUnx4PckAry UEGO_DataSplyClsS1B1_I.flgNewUp0Pck UEGO_DataSplyClsS1B1_I.flgNewUp0Pck4 UEGO_DataSplyClsS1B1_I.flgNewUp0Pck5Ary UEGO_DataSplyClsS1B1_I.flgNewUp0PckAry UEGO_DataSplyClsS1B1_I.flgNewUpPckAry UEGO_DataSplyClsS1B1_I.flgNewUpx3PckAry UEGO_DataSplyClsS1B1_I.flgNewUpx4PckAry UEGO_DataSplyClsS1B1_I.flgNewUriaPckVld UEGO_DataSplyClsS1B1_I.flgNewUriePckAry UEGO_DataSplyClsS1B1_I.flgNewUx6PckAry UEGO_DataSplyClsS1B1_I.flgNewUx7PckAry UEGO_DataSplyClsS1B1_I.flgNewUx8PckAry UEGO_DataSplyClsS1B1_I.flgNewUx9PckAry UEGO_DataSplyClsS1B1_I.flgNewUxPckAry UEGO_DataSplyClsS1B1_I.flgReStable UEGO_DataSplyClsS1B1_I.flgSngCell UEGO_DataSplyClsS1B1_I.flgUical0Vld UEGO_DataSplyClsS1B1_I.flgUicalVld UEGO_DataSplyClsS1B1_I.flgUoffipe1Vld UEGO_DataSplyClsS1B1_I.flgUoffipe2Vld UEGO_DataSplyClsS1B1_I.flgUoffipe3Vld UEGO_DataSplyClsS1B1_I.flgUoffvcc1Vld UEGO_DataSplyClsS1B1_I.flgUoffvcc2Vld UEGO_DataSplyClsS1B1_I.flgUoffvcc3Vld UEGO_DataSplyClsS1B1_I.flgUriaMeas UEGO_DataSplyClsS1B1_I.nrIPmpDacPckAry UEGO_DataSplyClsS1B1_I.nrIpPckAry UEGO_DataSplyClsS1B1_I.nrModeMeas UEGO_DataSplyClsS1B1_I.nrRamFailPosn UEGO_DataSplyClsS1B1_I.nrRamMod UEGO_DataSplyClsS1B1_I.nrRamRegMod UEGO_DataSplyClsS1B1_I.nrRamSts1 UEGO_DataSplyClsS1B1_I.nrRamSts2 UEGO_DataSplyClsS1B1_I.nrRamSts3 UEGO_DataSplyClsS1B1_I.nrURmVG4PckAry UEGO_DataSplyClsS1B1_I.nrUa2PckAry UEGO_DataSplyClsS1B1_I.nrUcalMaxCorrd UEGO_DataSplyClsS1B1_I.nrUg0PckAry UEGO_DataSplyClsS1B1_I.nrUg0iPckAry UEGO_DataSplyClsS1B1_I.nrUg0ix7PckAry UEGO_DataSplyClsS1B1_I.nrUg0ix9PckAry UEGO_DataSplyClsS1B1_I.nrUg0ixPckAry UEGO_DataSplyClsS1B1_I.nrUgaPckAry UEGO_DataSplyClsS1B1_I.nrUgiPckAry UEGO_DataSplyClsS1B1_I.nrUi21PckAry UEGO_DataSplyClsS1B1_I.nrUical0PckCorrd UEGO_DataSplyClsS1B1_I.nrUicalPckCorrd UEGO_DataSplyClsS1B1_I.nrUigPckAry UEGO_DataSplyClsS1B1_I.nrUigmkPckAry UEGO_DataSplyClsS1B1_I.nrUn0Pck4Ary UEGO_DataSplyClsS1B1_I.nrUn0Pck5Ary UEGO_DataSplyClsS1B1_I.nrUn0PckAry UEGO_DataSplyClsS1B1_I.nrUnPckAry UEGO_DataSplyClsS1B1_I.nrUnx3PckAry UEGO_DataSplyClsS1B1_I.nrUnx4PckAry UEGO_DataSplyClsS1B1_I.nrUoffipe1 UEGO_DataSplyClsS1B1_I.nrUoffipe2 UEGO_DataSplyClsS1B1_I.nrUoffipe3 UEGO_DataSplyClsS1B1_I.nrUoffvcc1 UEGO_DataSplyClsS1B1_I.nrUoffvcc2 UEGO_DataSplyClsS1B1_I.nrUoffvcc3 UEGO_DataSplyClsS1B1_I.nrUp0Pck5Ary UEGO_DataSplyClsS1B1_I.nrUp0PckAry UEGO_DataSplyClsS1B1_I.nrUpPckAry UEGO_DataSplyClsS1B1_I.nrUpx3PckAry UEGO_DataSplyClsS1B1_I.nrUpx4PckAry UEGO_DataSplyClsS1B1_I.nrUriePckAry UEGO_DataSplyClsS1B1_I.nrUx6PckAry UEGO_DataSplyClsS1B1_I.nrUx7PckAry UEGO_DataSplyClsS1B1_I.nrUx8PckAry UEGO_DataSplyClsS1B1_I.nrUx9PckAry UEGO_DataSplyClsS1B1_I.nrUxPckAry UEGO_DataSplyClsS1B1_I.stIPmpOK UEGO_DataSplyClsS1B1_I.stIPmpTM UEGO_DataSplyClsS1B1_I.stIPmpTM2L UEGO_DataSplyClsS1B1_I.stIPmpTM2R UEGO_DataSplyClsS1B1_I.stLsmRetValMod UEGO_DataSplyClsS1B1_I.stMKMeas UEGO_DataSplyClsS1B1_I.stOFFMeas UEGO_DataSplyClsS1B1_I.stOPTMeas UEGO_DataSplyClsS1B1_I.stREFMeas UEGO_DataSplyClsS1B1_I.stUa2PckAry UEGO_DataSplyClsS1B1_I.stUa2Z1PckAry UEGO_DataSplyClsS1B1_I.stUg0iPckAry UEGO_DataSplyClsS1B1_I.stUg0ix7IActvPckAry UEGO_DataSplyClsS1B1_I.stUg0ix7PmpIActvPckAry UEGO_DataSplyClsS1B1_I.stUg0ix9IActvPckAry UEGO_DataSplyClsS1B1_I.stUg0ix9PmpIActvPckAry UEGO_DataSplyClsS1B1_I.stUg0ixIActvPckAry UEGO_DataSplyClsS1B1_I.stUg0ixPmpIActvPckAry UEGO_DataSplyClsS1B1_I.stUi21PckAry UEGO_DataSplyClsS1B1_I.stUi21Z1PckAry UEGO_DataSplyClsS1B1_I.stUigmkNernstIActvPckAry UEGO_DataSplyClsS1B1_I.stUigmkPmpIActvPckAry UEGO_DataSplyClsS1B1_I.stUn0PckAry UEGO_DataSplyClsS1B1_I.stUn0Z2PckAry UEGO_DataSplyClsS1B1_I.stUnPckAry UEGO_DataSplyClsS1B1_I.stUnx3IActvAcrsNernstCellPckAry UEGO_DataSplyClsS1B1_I.stUnx3IActvAcrsPmpCellPckAry UEGO_DataSplyClsS1B1_I.stUnx4IActvAcrsNernstCellPckAry UEGO_DataSplyClsS1B1_I.stUnx4IActvAcrsPmpCellPckAry UEGO_DataSplyClsS1B1_I.stUp0PckAry UEGO_DataSplyClsS1B1_I.stUp0Z2PckAry UEGO_DataSplyClsS1B1_I.stUpPckAry UEGO_DataSplyClsS1B1_I.stUpZ2PckAry UEGO_DataSplyClsS1B1_I.stUpx3IActvAcrsNernstCellPckAry UEGO_DataSplyClsS1B1_I.stUpx3IActvAcrsPmpCellPckAry UEGO_DataSplyClsS1B1_I.stUpx4IActvAcrsNernstCellPckAry UEGO_DataSplyClsS1B1_I.stUpx4IActvAcrsPmpCellPckAry UEGO_DataSplyClsS1B1_I.stUriePckAry UEGO_DataSplyClsS1B1_I.stUx6IActvPckAry UEGO_DataSplyClsS1B1_I.stUx6MeasAcrsPmpCellPckAry UEGO_DataSplyClsS1B1_I.stUx7IActvPckAry UEGO_DataSplyClsS1B1_I.stUx7MeasAcrsPmpCellPckAry UEGO_DataSplyClsS1B1_I.stUx8IActvPckAry UEGO_DataSplyClsS1B1_I.stUx8MeasAcrsPmpCellPckAry UEGO_DataSplyClsS1B1_I.stUx9IActvPckAry UEGO_DataSplyClsS1B1_I.stUx9MeasAcrsPmpCellPckAry UEGO_DataSplyClsS1B1_I.stUxIActvPckAry UEGO_DataSplyClsS1B1_I.stUxMeasAcrsPmpCell UEGO_DataSplyClsS1B1_I.tiUEGOPck UEGO_DataSplyClsS1B1_I.uFkal1 UEGO_DataSplyClsS1B1_I.uFkal2 UEGO_DataSplyClsS1B1_I.uFkal3 UEGO_DataSplyClsS1B1_I.uUCalPck UEGO_DataSplyClsS1B1_I.uUa31Pck UEGO_DataSplyClsS1B1_I.uUa32Pck UEGO_DataSplyClsS1B1_I.uUa33Pck UEGO_DataSplyClsS1B1_I.uUamPck UEGO_DataSplyClsS1B1_I.uUapePck UEGO_DataSplyClsS1B1_I.uUcalMaxPck UEGO_DataSplyClsS1B1_I.uUg0Pck UEGO_DataSplyClsS1B1_I.uUg0aPck UEGO_DataSplyClsS1B1_I.uUg0ePck UEGO_DataSplyClsS1B1_I.uUg0iPck UEGO_DataSplyClsS1B1_I.uUg0iaiPck UEGO_DataSplyClsS1B1_I.uUg0ieiPck UEGO_DataSplyClsS1B1_I.uUg0mPck UEGO_DataSplyClsS1B1_I.uUgkAvrgPck UEGO_DataSplyClsS1B1_I.uUguaPck UEGO_DataSplyClsS1B1_I.uUguaZ2Pck UEGO_DataSplyClsS1B1_I.uUguiPck UEGO_DataSplyClsS1B1_I.uUguiZ1Pck UEGO_DataSplyClsS1B1_I.uUi22Pck UEGO_DataSplyClsS1B1_I.uUi23Pck UEGO_DataSplyClsS1B1_I.uUi24Pck UEGO_DataSplyClsS1B1_I.uUi4Pck UEGO_DataSplyClsS1B1_I.uUi4Z2Pck UEGO_DataSplyClsS1B1_I.uUipcalAvrgPck UEGO_DataSplyClsS1B1_I.uUn0Pck UEGO_DataSplyClsS1B1_I.uUnSet UEGO_DataSplyClsS1B1_I.uUp0Pck UEGO_DataSplyClsS1B1_I.uUp0Pck4 UEGO_DataSplyClsS1B1_I.uUriaPck UEGO_DataSplyClsS1B1_I.uVCC1Corrd UEGO_DataSplyClsS1B1_I.uVCC3Ref UEGO_flgCJ135AnS1B1 UEGO_flgINernstPinVldS1B1 UEGO_flgIPmpPinVldS1B1 UEGO_flgIsqMeasVldS1B1 UEGO_flgRvsChrgHiPrcsnS1B1 UEGO_flgRvsChrgVldS1B1 UEGO_flgSysSuprtdS1B1 UEGO_iIsqMeasS1B1 UEGO_iNernstPinS1B1 UEGO_iPmpPinS1B1 UEGO_iRvsChrgAryS1B1 UEGO_ratIPmpRawS1B1 /end IN_MEASUREMENT
 /begin OUT_MEASUREMENT UEGO_flgDacAdpnVldS1B1 UEGO_flgIPmpRawAryHiPrcsnS1B1 UEGO_flgIPmpRawAryVldS1B1 UEGO_iIPmpRawAryS1B1 /end OUT_MEASUREMENT
 /begin LOC_MEASUREMENT UEGO_DacClassS1B1_I.flgIPmpRawAryHiPrcsn UEGO_DacClassS1B1_I.flgIPmpRawAryVld /end LOC_MEASUREMENT
 FUNCTION_VERSION "1.20.0" /end FUNCTION
/begin COMPU_METHOD B_TRUE "" TAB_VERB "%6.3" "" COMPU_TAB_REF B_TRUE /end COMPU_METHOD
/begin COMPU_VTAB B_TRUE "" TAB_VERB 2 0 "FALSE" 1 "TRUE" /end COMPU_VTAB
/begin COMPU_METHOD dez "" RAT_FUNC "%6.2" "" COEFFS 0 1 0 0 0 1 /end COMPU_METHOD
/begin COMPU_METHOD EngN "" RAT_FUNC "%6.3" "rpm" COEFFS 0 2 0 0 0 1 /end COMPU_METHOD
/begin COMPU_METHOD ExeCon_State_02 "" TAB_VERB "%6.3" "" COMPU_TAB_REF ExeCon_State_02 /end COMPU_METHOD
/begin COMPU_VTAB ExeCon_State_02 "" TAB_VERB 7 0 "SYC_INI" 1 "SYC_INISYN" 2 "SYC_INIEND" 3 "SYC_PREDRIVE" 4 "SYC_DRIVE" 5 "SYC_POSTDRIVE" 6 "SYC_POST_OS_EXIT" /end COMPU_VTAB
/begin COMPU_METHOD fak_q0p00015259 "" RAT_FUNC "%6.5" "" COEFFS 0 32768 0 0 0 5 /end COMPU_METHOD
/begin COMPU_METHOD fak_q0p0078 "" RAT_FUNC "%6.4" "-" COEFFS 0 128 0 0 0 1 /end COMPU_METHOD
/begin COMPU_METHOD fak_q3p0518Em5 "" RAT_FUNC "%7.6" "" COEFFS 0 32768 0 0 0 1 /end COMPU_METHOD
/begin COMPU_METHOD fak_q3p0518Em6 "" RAT_FUNC "%8.7" "" COEFFS 0 65536 0 0 0 0.2 /end COMPU_METHOD
/begin COMPU_METHOD fak_q3p72529Em9 "" RAT_FUNC "%11.10" "" COEFFS 0 268435456 0 0 0 1 /end COMPU_METHOD
/begin COMPU_METHOD fak_q4p6566Em10 "" RAT_FUNC "%18.17" "" COEFFS 0 2147483648 0 0 0 1 /end COMPU_METHOD
/begin COMPU_METHOD fak_q4p6566Em11 "" RAT_FUNC "%13.12" "-" COEFFS 0 214748364.8 0 0 0 0.01 /end COMPU_METHOD
/begin COMPU_METHOD fak_sl_b1 "" RAT_FUNC "%12.11" "-" COEFFS 0 4294967296 0 0 0 2 /end COMPU_METHOD
/begin COMPU_METHOD fak_sw_b1 "" RAT_FUNC "%7.6" "-" COEFFS 0 65536 0 0 0 2 /end COMPU_METHOD
/begin COMPU_METHOD fak_ub_b0p25 "" RAT_FUNC "%10.7" "-" COEFFS 0 256 0 0 0 0.25 /end COMPU_METHOD
/begin COMPU_METHOD fak_ub_b1 "" RAT_FUNC "%6.4" "-" COEFFS 0 256 0 0 0 1 /end COMPU_METHOD
/begin COMPU_METHOD fak_ub_b16 "" RAT_FUNC "%6.4" "-" COEFFS 0 256 0 0 0 16 /end COMPU_METHOD
/begin COMPU_METHOD fak_ub_b2 "" RAT_FUNC "%8.5" "-" COEFFS 0 256 0 0 0 2 /end COMPU_METHOD
/begin COMPU_METHOD fak_ub_b4 "" RAT_FUNC "%6.4" "-" COEFFS 0 256 0 0 0 4 /end COMPU_METHOD
/begin COMPU_METHOD fak_uw_b1 "" RAT_FUNC "%7.6" "-" COEFFS 0 65536 0 0 0 1 /end COMPU_METHOD
/begin COMPU_METHOD fak_uw_b16 "" RAT_FUNC "%6.5" "-" COEFFS 0 65536 0 0 0 16 /end COMPU_METHOD
/begin COMPU_METHOD fak_uw_b2 "" RAT_FUNC "%7.6" "-" COEFFS 0 65536 0 0 0 2 /end COMPU_METHOD
/begin COMPU_METHOD i_q6p6667Em7_A "" RAT_FUNC "%9.8" "A" COEFFS 0 1500000 0 0 0 1 /end COMPU_METHOD
/begin COMPU_METHOD mgrad_q1_mgdivs "" RAT_FUNC "%6.2" "mg/s" COEFFS 0 1 0 0 0 1 /end COMPU_METHOD
/begin COMPU_METHOD m_q0p017778_g "" RAT_FUNC "%6.4" "g" COEFFS 0 225 0 0 0 4 /end COMPU_METHOD
/begin COMPU_METHOD m_q0p02_mgO2 "" RAT_FUNC "%6.4" "mgO2" COEFFS 0 50 0 0 0 1 /end COMPU_METHOD
/begin COMPU_METHOD m_q0p1 "" RAT_FUNC "%6.3" "kg/h" COEFFS 0 10 0 0 0 1 /end COMPU_METHOD
/begin COMPU_METHOD m_q0p1_mg "" RAT_FUNC "%6.3" "mg" COEFFS 0 1 0 0 0 0.1 /end COMPU_METHOD
/begin COMPU_METHOD m_q0p1_mgs "" RAT_FUNC "%6.3" "mg/s" COEFFS 0 1 0 0 0 0.1 /end COMPU_METHOD
/begin COMPU_METHOD m_q0p711_g "" RAT_FUNC "%6.3" "g" COEFFS 0 36 0 0 0 25.6 /end COMPU_METHOD
/begin COMPU_METHOD m_q1_mg "" RAT_FUNC "%6.2" "mg" COEFFS 0 1 0 0 0 1 /end COMPU_METHOD
/begin COMPU_METHOD m_q3p0518Em7_mgO2 "" RAT_FUNC "%9.8" "mgO2" COEFFS 0 3276800 0 0 0 1 /end COMPU_METHOD
/begin COMPU_METHOD m_uw_b6553p5 "" RAT_FUNC "%6.3" "kg/h" COEFFS 0 1 0 0 0 0.1 /end COMPU_METHOD
/begin COMPU_METHOD m_uw_b7281 "" RAT_FUNC "%6.3" "g" COEFFS 0 9 0 0 0 1 /end COMPU_METHOD
/begin COMPU_METHOD nmot_ub_q40 "" RAT_FUNC "%6.1" "1/min" COEFFS 0 1 0 0 0 40 /end COMPU_METHOD
/begin COMPU_METHOD OneToOne "" RAT_FUNC "%6.2" "-" COEFFS 0 1 0 0 0 1 /end COMPU_METHOD
/begin COMPU_METHOD q1p08505Em5_g "" RAT_FUNC "%7.6" "g" COEFFS 0 100000000 0 0 0 1085.0528878 /end COMPU_METHOD
/begin COMPU_METHOD rel_q0p02344 "" RAT_FUNC "%6.4" "%" COEFFS 0 32 0 0 0 0.75 /end COMPU_METHOD
/begin COMPU_METHOD rel_q2p929Em3 "" RAT_FUNC "%6.4" "%" COEFFS 0 1024 0 0 0 3 /end COMPU_METHOD
/begin COMPU_METHOD rel_q3p576Em7 "" RAT_FUNC "%9.8" "%" COEFFS 0 8388608 0 0 0 3 /end COMPU_METHOD
/begin COMPU_METHOD rel_ub_q0p75 "" RAT_FUNC "%6.3" "%" COEFFS 0 1 0 0 0 0.75 /end COMPU_METHOD
/begin COMPU_METHOD spg_q0p00488 "" RAT_FUNC "%6.4" "V" COEFFS 0 1024 0 0 0 5 /end COMPU_METHOD
/begin COMPU_METHOD spg_q1p221Em3_V "" RAT_FUNC "%6.4" "V" COEFFS 0 65536 0 0 0 80 /end COMPU_METHOD
/begin COMPU_METHOD spg_q1p9073Em5 "" RAT_FUNC "%7.6" "V" COEFFS 0 262144 0 0 0 5 /end COMPU_METHOD
/begin COMPU_METHOD spg_q2p3842Em7_V "" RAT_FUNC "%9.8" "V" COEFFS 0 4194304 0 0 0 1 /end COMPU_METHOD
/begin COMPU_METHOD spg_q3p2Em4_V "" RAT_FUNC "%6.5" "V" COEFFS 0 32768 0 0 0 10.48576 /end COMPU_METHOD
/begin COMPU_METHOD spg_q4p883Em9_V "" RAT_FUNC "%11.10" "V" COEFFS 0 204800000 0 0 0 1 /end COMPU_METHOD
/begin COMPU_METHOD Temp_Cels "" RAT_FUNC "%6.1" "deg C" COEFFS 0 10 2731.4 0 0 1 /end COMPU_METHOD
/begin COMPU_METHOD temp_q0p1_o273 "" RAT_FUNC "%6.1" "Grad C" COEFFS 0 10 2731.4 0 0 1 /end COMPU_METHOD
/begin COMPU_METHOD temp_q1p5259Em6_om273 "" RAT_FUNC "%6.1" "°C" COEFFS 0 65536 17900503.04 0 0 0.1 /end COMPU_METHOD
/begin COMPU_METHOD TurboN "" RAT_FUNC "%6.1" "rpm" COEFFS 0 0.1 0 0 0 1 /end COMPU_METHOD
/begin COMPU_METHOD TVAVSADIA_FRQ "" RAT_FUNC "%6.3" "Hz" COEFFS 0 10 0 0 0 1 /end COMPU_METHOD
/begin COMPU_METHOD TWALLTC_MDLAVL_SC_Compu "" TAB_VERB "%6.3" "" COMPU_TAB_REF TWALLTC_MDLAVL_SC_Compu /end COMPU_METHOD
/begin COMPU_VTAB TWALLTC_MDLAVL_SC_Compu "" TAB_VERB 2 0 "False" 1 "True" /end COMPU_VTAB
/begin COMPU_METHOD TWCCBALUP_SY_Compu "" TAB_VERB "%6.3" "" COMPU_TAB_REF TWCCBALUP_SY_Compu /end COMPU_METHOD
/begin COMPU_VTAB TWCCBALUP_SY_Compu "" TAB_VERB 2 0 "not included" 1 "included" /end COMPU_VTAB
/begin COMPU_METHOD TWCCDCTRL_SC_Compu "" TAB_VERB "%6.3" "" COMPU_TAB_REF TWCCDCTRL_SC_Compu /end COMPU_METHOD
/begin COMPU_VTAB TWCCDCTRL_SC_Compu "" TAB_VERB 2 0 "False" 1 "True" /end COMPU_VTAB
/begin COMPU_METHOD TWCCMODLNBAL_SY_Compu "" TAB_VERB "%6.3" "" COMPU_TAB_REF TWCCMODLNBAL_SY_Compu /end COMPU_METHOD
/begin COMPU_VTAB TWCCMODLNBAL_SY_Compu "" TAB_VERB 2 0 "not included" 1 "included" /end COMPU_VTAB
/begin COMPU_METHOD TWCCOBDFUELTRIM_SY_Compu "" TAB_VERB "%6.3" "" COMPU_TAB_REF TWCCOBDFUELTRIM_SY_Compu /end COMPU_METHOD
/begin COMPU_VTAB TWCCOBDFUELTRIM_SY_Compu "" TAB_VERB 2 0 "False" 1 "True" /end COMPU_VTAB
/begin COMPU_METHOD TWCCPRIB1_SY_Compu "" TAB_VERB "%6.3" "" COMPU_TAB_REF TWCCPRIB1_SY_Compu /end COMPU_METHOD
/begin COMPU_VTAB TWCCPRIB1_SY_Compu "" TAB_VERB 4 0 "not included" 1 "control value sensor 1 bank 1" 2 "control value sensor 2 bank 1" 3 "control value sensor 3 bank 1" /end COMPU_VTAB
/begin COMPU_METHOD TWCCPRIB2_SY_Compu "" TAB_VERB "%6.3" "" COMPU_TAB_REF TWCCPRIB2_SY_Compu /end COMPU_METHOD
/begin COMPU_VTAB TWCCPRIB2_SY_Compu "" TAB_VERB 4 0 "not included" 1 "control value sensor 1 bank 1" 2 "control value sensor 2 bank 1" 3 "control value sensor 3 bank 1" /end COMPU_VTAB
/begin COMPU_METHOD TWCCPRINF_SY_Compu "" TAB_VERB "%6.3" "" COMPU_TAB_REF TWCCPRINF_SY_Compu /end COMPU_METHOD
/begin COMPU_VTAB TWCCPRINF_SY_Compu "" TAB_VERB 2 0 "not included" 1 "included" /end COMPU_VTAB
/begin COMPU_METHOD TWCCSCNDB1_SY_Compu "" TAB_VERB "%6.3" "" COMPU_TAB_REF TWCCSCNDB1_SY_Compu /end COMPU_METHOD
/begin COMPU_VTAB TWCCSCNDB1_SY_Compu "" TAB_VERB 4 0 "not included" 1 "control value sensor 1 bank 1" 2 "control value sensor 2 bank 1" 3 "control value sensor 3 bank 1" /end COMPU_VTAB
/begin COMPU_METHOD TWCCSCNDB2_SY_Compu "" TAB_VERB "%6.3" "" COMPU_TAB_REF TWCCSCNDB2_SY_Compu /end COMPU_METHOD
/begin COMPU_VTAB TWCCSCNDB2_SY_Compu "" TAB_VERB 4 0 "not included" 1 "control value sensor 1 bank 1" 2 "control value sensor 2 bank 1" 3 "control value sensor 3 bank 1" /end COMPU_VTAB
/begin COMPU_METHOD TWCC_CTRLSTRUCT_SC_Compu "" TAB_VERB "%6.3" "" COMPU_TAB_REF TWCC_CTRLSTRUCT_SC_Compu /end COMPU_METHOD
/begin COMPU_VTAB TWCC_CTRLSTRUCT_SC_Compu "" TAB_VERB 2 0 "TWCC_CTRLSTRUCT_LAMCL" 1 "TWCC_CTRLSTRUCT_INJSYS" /end COMPU_VTAB
/begin COMPU_METHOD TWCC_PhSyncZA_sm_VERB "" TAB_VERB "%6.3" "" COMPU_TAB_REF TWCC_PhSyncZA_sm_VERB /end COMPU_METHOD
/begin COMPU_VTAB TWCC_PhSyncZA_sm_VERB "" TAB_VERB 3 0 "_0_reset" 1 "_1_pending" 2 "_2_steady" /end COMPU_VTAB
/begin COMPU_METHOD TWCC_PRIMENAATS_SC_Compu "" TAB_VERB "%6.3" "" COMPU_TAB_REF TWCC_PRIMENAATS_SC_Compu /end COMPU_METHOD
/begin COMPU_VTAB TWCC_PRIMENAATS_SC_Compu "" TAB_VERB 2 0 "False" 1 "True" /end COMPU_VTAB
/begin COMPU_METHOD TWCDMODCMPPRIB1_SY_Compu "" TAB_VERB "%6.3" "" COMPU_TAB_REF TWCDMODCMPPRIB1_SY_Compu /end COMPU_METHOD
/begin COMPU_VTAB TWCDMODCMPPRIB1_SY_Compu "" TAB_VERB 2 0 "False" 1 "True" /end COMPU_VTAB
/begin COMPU_METHOD TWCDMODCMPPRIB2_SY_Compu "" TAB_VERB "%6.3" "" COMPU_TAB_REF TWCDMODCMPPRIB2_SY_Compu /end COMPU_METHOD
/begin COMPU_VTAB TWCDMODCMPPRIB2_SY_Compu "" TAB_VERB 2 0 "False" 1 "True" /end COMPU_VTAB
/begin COMPU_METHOD TWCDMODCMPSCNDB1_SY_Compu "" TAB_VERB "%6.3" "" COMPU_TAB_REF TWCDMODCMPSCNDB1_SY_Compu /end COMPU_METHOD
/begin COMPU_VTAB TWCDMODCMPSCNDB1_SY_Compu "" TAB_VERB 2 0 "False" 1 "True" /end COMPU_VTAB
/begin COMPU_METHOD TWCDMODCMPSCNDB2_SY_Compu "" TAB_VERB "%6.3" "" COMPU_TAB_REF TWCDMODCMPSCNDB2_SY_Compu /end COMPU_METHOD
/begin COMPU_VTAB TWCDMODCMPSCNDB2_SY_Compu "" TAB_VERB 2 0 "False" 1 "True" /end COMPU_VTAB
/begin COMPU_METHOD TWCDOSCPAPRIB1_SY_Compu "" TAB_VERB "%6.3" "" COMPU_TAB_REF TWCDOSCPAPRIB1_SY_Compu /end COMPU_METHOD
/begin COMPU_VTAB TWCDOSCPAPRIB1_SY_Compu "" TAB_VERB 2 0 "False" 1 "True" /end COMPU_VTAB
/begin COMPU_METHOD TWCDOSCPAPRIB2_SY_Compu "" TAB_VERB "%6.3" "" COMPU_TAB_REF TWCDOSCPAPRIB2_SY_Compu /end COMPU_METHOD
/begin COMPU_VTAB TWCDOSCPAPRIB2_SY_Compu "" TAB_VERB 2 0 "False" 1 "True" /end COMPU_VTAB
/begin COMPU_METHOD TWCDOSCPASCNDB1_SY_Compu "" TAB_VERB "%6.3" "" COMPU_TAB_REF TWCDOSCPASCNDB1_SY_Compu /end COMPU_METHOD
/begin COMPU_VTAB TWCDOSCPASCNDB1_SY_Compu "" TAB_VERB 2 0 "False" 1 "True" /end COMPU_VTAB
/begin COMPU_METHOD TWCDOSCPASCNDB2_SY_Compu "" TAB_VERB "%6.3" "" COMPU_TAB_REF TWCDOSCPASCNDB2_SY_Compu /end COMPU_METHOD
/begin COMPU_VTAB TWCDOSCPASCNDB2_SY_Compu "" TAB_VERB 2 0 "False" 1 "True" /end COMPU_VTAB
/begin COMPU_METHOD TWCDOSCPRIB1_SY_Compu "" TAB_VERB "%6.3" "" COMPU_TAB_REF TWCDOSCPRIB1_SY_Compu /end COMPU_METHOD
/begin COMPU_VTAB TWCDOSCPRIB1_SY_Compu "" TAB_VERB 2 0 "False" 1 "True" /end COMPU_VTAB
/begin COMPU_METHOD TWCDOSCPRIB2_SY_Compu "" TAB_VERB "%6.3" "" COMPU_TAB_REF TWCDOSCPRIB2_SY_Compu /end COMPU_METHOD
/begin COMPU_VTAB TWCDOSCPRIB2_SY_Compu "" TAB_VERB 2 0 "False" 1 "True" /end COMPU_VTAB
/begin COMPU_METHOD TWCDOSCSCNDB1_SY_Compu "" TAB_VERB "%6.3" "" COMPU_TAB_REF TWCDOSCSCNDB1_SY_Compu /end COMPU_METHOD
/begin COMPU_VTAB TWCDOSCSCNDB1_SY_Compu "" TAB_VERB 2 0 "False" 1 "True" /end COMPU_VTAB
/begin COMPU_METHOD TWCDOSCSCNDB2_SY_Compu "" TAB_VERB "%6.3" "" COMPU_TAB_REF TWCDOSCSCNDB2_SY_Compu /end COMPU_METHOD
/begin COMPU_VTAB TWCDOSCSCNDB2_SY_Compu "" TAB_VERB 2 0 "False" 1 "True" /end COMPU_VTAB
/begin COMPU_METHOD TWCDRSCPATST_SY_Compu "" TAB_VERB "%6.3" "" COMPU_TAB_REF TWCDRSCPATST_SY_Compu /end COMPU_METHOD
/begin COMPU_VTAB TWCDRSCPATST_SY_Compu "" TAB_VERB 2 0 "False" 1 "True" /end COMPU_VTAB
/begin COMPU_METHOD TWCDRSCPRIB1_SY_Compu "" TAB_VERB "%6.3" "" COMPU_TAB_REF TWCDRSCPRIB1_SY_Compu /end COMPU_METHOD
/begin COMPU_VTAB TWCDRSCPRIB1_SY_Compu "" TAB_VERB 2 0 "False" 1 "True" /end COMPU_VTAB
/begin COMPU_METHOD TWCDRSCPRIB2_SY_Compu "" TAB_VERB "%6.3" "" COMPU_TAB_REF TWCDRSCPRIB2_SY_Compu /end COMPU_METHOD
/begin COMPU_VTAB TWCDRSCPRIB2_SY_Compu "" TAB_VERB 2 0 "False" 1 "True" /end COMPU_VTAB
/begin COMPU_METHOD TWCDRSCSCNDB1_SY_Compu "" TAB_VERB "%6.3" "" COMPU_TAB_REF TWCDRSCSCNDB1_SY_Compu /end COMPU_METHOD
/begin COMPU_VTAB TWCDRSCSCNDB1_SY_Compu "" TAB_VERB 2 0 "False" 1 "True" /end COMPU_VTAB
/begin COMPU_METHOD TWCDRSCSCNDB2_SY_Compu "" TAB_VERB "%6.3" "" COMPU_TAB_REF TWCDRSCSCNDB2_SY_Compu /end COMPU_METHOD
/begin COMPU_VTAB TWCDRSCSCNDB2_SY_Compu "" TAB_VERB 2 0 "False" 1 "True" /end COMPU_VTAB
/begin COMPU_METHOD TWCDRSCTHRDB1_SY_Compu "" TAB_VERB "%6.3" "" COMPU_TAB_REF TWCDRSCTHRDB1_SY_Compu /end COMPU_METHOD
/begin COMPU_VTAB TWCDRSCTHRDB1_SY_Compu "" TAB_VERB 2 0 "False" 1 "True" /end COMPU_VTAB
/begin COMPU_METHOD TWCDRSCTHRDB2_SY_Compu "" TAB_VERB "%6.3" "" COMPU_TAB_REF TWCDRSCTHRDB2_SY_Compu /end COMPU_METHOD
/begin COMPU_VTAB TWCDRSCTHRDB2_SY_Compu "" TAB_VERB 2 0 "False" 1 "True" /end COMPU_VTAB
/begin COMPU_METHOD TWCD_CatMeasSM_sm_VERB "" TAB_VERB "%6.3" "" COMPU_TAB_REF TWCD_CatMeasSM_sm_VERB /end COMPU_METHOD
/begin COMPU_VTAB TWCD_CatMeasSM_sm_VERB "" TAB_VERB 9 0 "A_0_inactive" 1 "A_1_rsc_measure" 2 "A_2_wait" 3 "A_3_osc_measure" 4 "A_4_wait" 5 "A_5_osc_measure" 6 "A_6_wait" 7 "A_7_rsc_measure" 8 "A_8_wait" /end COMPU_VTAB
/begin COMPU_METHOD t_q0p01 "" RAT_FUNC "%6.4" "s" COEFFS 0 100 0 0 0 1 /end COMPU_METHOD
/begin COMPU_METHOD t_q0p02 "" RAT_FUNC "%6.4" "s" COEFFS 0 100 0 0 0 2 /end COMPU_METHOD
/begin COMPU_METHOD t_q0p05 "" RAT_FUNC "%6.4" "s" COEFFS 0 100 0 0 0 5 /end COMPU_METHOD
/begin COMPU_METHOD t_q0p1 "" RAT_FUNC "%6.3" "s" COEFFS 0 10 0 0 0 1 /end COMPU_METHOD
/begin COMPU_METHOD t_q1 "" RAT_FUNC "%6.2" "s" COEFFS 0 1 0 0 0 1 /end COMPU_METHOD
/begin COMPU_METHOD UEGO_CHPID_COMPU_VERB "" TAB_VERB "%6.3" "" COMPU_TAB_REF UEGO_CHPID_COMPU_VERB /end COMPU_METHOD
/begin COMPU_VTAB UEGO_CHPID_COMPU_VERB "" TAB_VERB 9 0 "not supported" 1 "CJ135 AA or AB (not supported)" 2 "CJ135 BA (not supported)" 3 "CJ135 CA" 4 "CJ135 DA" 5 "CJ135 E" 6 "CJ135 FA (not supported)" 7 "CJ135 FB (not supported)" 8 "CJ135 FD or FE" /end COMPU_VTAB
/begin COMPU_METHOD zk100msxs_ub_b25p5 "" RAT_FUNC "%6.3" "s" COEFFS 0 0 256 0 10 0 /end COMPU_METHOD
/begin COMPU_METHOD zk10msxs_uw_b655p36 "" RAT_FUNC "%6.2" "s" COEFFS 0 0 65536 0 100 0 /end COMPU_METHOD
/begin COMPU_METHOD zk1sxs_uw_b65535 "" RAT_FUNC "%6.0" "s" COEFFS 0 0 65535 0 1 0 /end COMPU_METHOD
/begin COMPU_METHOD zk20msxs_uw_b1310p72 "" RAT_FUNC "%6.1" "s" COEFFS 0 0 65536 0 50 0 /end COMPU_METHOD
/begin RECORD_LAYOUT RB_Axis_U16 NO_AXIS_PTS_X 1 UWORD AXIS_PTS_X 2 UWORD INDEX_INCR DIRECT /end RECORD_LAYOUT
/begin RECORD_LAYOUT RB_CurveGroup_S16 FNC_VALUES 1 SWORD COLUMN_DIR DIRECT /end RECORD_LAYOUT
/begin RECORD_LAYOUT RB_CurveGroup_U16 FNC_VALUES 1 UWORD COLUMN_DIR DIRECT /end RECORD_LAYOUT
/begin RECORD_LAYOUT RB_Curve_S16_S16 NO_AXIS_PTS_X 1 SWORD AXIS_PTS_X 2 SWORD INDEX_INCR DIRECT FNC_VALUES 3 SWORD COLUMN_DIR DIRECT /end RECORD_LAYOUT
/begin RECORD_LAYOUT RB_Curve_S16_U16_Static NO_AXIS_PTS_X 1 SWORD AXIS_PTS_X 2 SWORD INDEX_INCR DIRECT FNC_VALUES 3 UWORD COLUMN_DIR DIRECT STATIC_RECORD_LAYOUT /end RECORD_LAYOUT
/begin RECORD_LAYOUT RB_Curve_S16_U8_Static NO_AXIS_PTS_X 1 SWORD AXIS_PTS_X 2 SWORD INDEX_INCR DIRECT FNC_VALUES 3 UBYTE COLUMN_DIR DIRECT STATIC_RECORD_LAYOUT /end RECORD_LAYOUT
/begin RECORD_LAYOUT RB_Curve_U16_S16_Static NO_AXIS_PTS_X 1 UWORD AXIS_PTS_X 2 UWORD INDEX_INCR DIRECT FNC_VALUES 3 SWORD COLUMN_DIR DIRECT STATIC_RECORD_LAYOUT /end RECORD_LAYOUT
/begin RECORD_LAYOUT RB_Curve_U16_U16 NO_AXIS_PTS_X 1 UWORD AXIS_PTS_X 2 UWORD INDEX_INCR DIRECT FNC_VALUES 3 UWORD COLUMN_DIR DIRECT /end RECORD_LAYOUT
/begin RECORD_LAYOUT RB_Curve_U16_U8_Static NO_AXIS_PTS_X 1 UWORD AXIS_PTS_X 2 UWORD INDEX_INCR DIRECT FNC_VALUES 3 UBYTE COLUMN_DIR DIRECT STATIC_RECORD_LAYOUT /end RECORD_LAYOUT
/begin RECORD_LAYOUT RB_Curve_U8_U8 NO_AXIS_PTS_X 1 UBYTE AXIS_PTS_X 2 UBYTE INDEX_INCR DIRECT FNC_VALUES 3 UBYTE COLUMN_DIR DIRECT /end RECORD_LAYOUT
/begin RECORD_LAYOUT RB_Map_S16S16_S16 NO_AXIS_PTS_X 1 SWORD NO_AXIS_PTS_Y 2 SWORD AXIS_PTS_X 3 SWORD INDEX_INCR DIRECT AXIS_PTS_Y 4 SWORD INDEX_INCR DIRECT FNC_VALUES 5 SWORD COLUMN_DIR DIRECT /end RECORD_LAYOUT
/begin RECORD_LAYOUT RB_Map_S16U16_U16 NO_AXIS_PTS_X 1 SWORD NO_AXIS_PTS_Y 2 SWORD AXIS_PTS_X 3 SWORD INDEX_INCR DIRECT AXIS_PTS_Y 4 UWORD INDEX_INCR DIRECT FNC_VALUES 5 UWORD ROW_DIR DIRECT /end RECORD_LAYOUT
/begin RECORD_LAYOUT RB_Map_S16U16_U8 NO_AXIS_PTS_X 1 SWORD NO_AXIS_PTS_Y 2 SWORD AXIS_PTS_X 3 SWORD INDEX_INCR DIRECT AXIS_PTS_Y 4 UWORD INDEX_INCR DIRECT FNC_VALUES 5 UBYTE ROW_DIR DIRECT /end RECORD_LAYOUT
/begin RECORD_LAYOUT RB_Map_U16U16_U16 NO_AXIS_PTS_X 1 UWORD NO_AXIS_PTS_Y 2 UWORD AXIS_PTS_X 3 UWORD INDEX_INCR DIRECT AXIS_PTS_Y 4 UWORD INDEX_INCR DIRECT FNC_VALUES 5 UWORD COLUMN_DIR DIRECT /end RECORD_LAYOUT
/begin RECORD_LAYOUT RB_Map_U8U8_U8 NO_AXIS_PTS_X 1 UBYTE NO_AXIS_PTS_Y 2 UBYTE AXIS_PTS_X 3 UBYTE INDEX_INCR DIRECT AXIS_PTS_Y 4 UBYTE INDEX_INCR DIRECT FNC_VALUES 5 UBYTE COLUMN_DIR DIRECT /end RECORD_LAYOUT
/begin RECORD_LAYOUT RB_ValA_Wu16 FNC_VALUES 1 UWORD COLUMN_DIR DIRECT /end RECORD_LAYOUT
/begin RECORD_LAYOUT RB_Val_Ws16 FNC_VALUES 1 SWORD COLUMN_DIR DIRECT /end RECORD_LAYOUT
/begin RECORD_LAYOUT RB_Val_Wu16 FNC_VALUES 1 UWORD COLUMN_DIR DIRECT /end RECORD_LAYOUT
/begin RECORD_LAYOUT RB_Val_Wu32 FNC_VALUES 1 ULONG COLUMN_DIR DIRECT /end RECORD_LAYOUT
/begin RECORD_LAYOUT RB_Val_Wu8 FNC_VALUES 1 UBYTE COLUMN_DIR DIRECT /end RECORD_LAYOUT
/end MODULE
/end PROJECT
