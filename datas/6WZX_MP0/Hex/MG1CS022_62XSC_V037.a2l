ASAP2_VERSION 1 60
/begin PROJECT MG1CS022 "MG1CS022"
/begin HEADER "" VERSION "MG1CS022_62XSC_V037" PROJECT_NO MG1CS022 /end HEADER
/begin MODULE DIM ""
/begin MOD_COMMON "" BYTE_ORDER MSB_LAST ALIGNMENT_BYTE 1 ALIGNMENT_WORD 2 ALIGNMENT_LONG 4 ALIGNMENT_INT64 4 ALIGNMENT_FLOAT32_IEEE 4 ALIGNMENT_FLOAT64_IEEE 4 DATA_SIZE 32 /end MOD_COMMON
/begin CHARACTERISTIC BattU_cntrEngRunStab_C "Engine run stable counter" VALUE 0x8052639A RB_Val_Wu16 65535.00 OneToOne 0.00 65535.00 FORMAT "%8.2" /end CHARACTERISTIC
/begin CHARACTERISTIC BattU_cntrIgnBoostMax_C "Ignition boost maximum counter" VALUE 0x8052639C RB_Val_Wu16 65535.00 OneToOne 0.00 65535.00 FORMAT "%8.2" /end CHARACTERISTIC
/begin CHARACTERISTIC BattU_facFild_C "Gain factor for battery voltage filter" VALUE 0x805263AC RB_Val_Wu16 0.9999847 fak_uw_b1 0.00 0.9999847 FORMAT "%9.7" /end CHARACTERISTIC
/begin CHARACTERISTIC BattU_flgBattDetnIMGECUEna_C "Flag enable for battery detection voltage of IMG ECU" VALUE 0x805263AE RB_Val_Wboolean 1.00000000000 B_TRUE 0.00 1.00000000000 FORMAT "%13.11" /end CHARACTERISTIC
/begin CHARACTERISTIC BattU_flgBattDetnTCUECUEna_C "Flag enable for battery detection voltage of TCU ECU" VALUE 0x805263AF RB_Val_Wboolean 1.00000000000 B_TRUE 0.00 1.00000000000 FORMAT "%13.11" /end CHARACTERISTIC
/begin CHARACTERISTIC BattU_flgBattUMonEna_C "Switch to enable the battery voltage diagnosis" VALUE 0x805263B0 RB_Val_Wboolean 1.00000000000 B_TRUE 0.00 1.00000000000 FORMAT "%13.11" /end CHARACTERISTIC
/begin CHARACTERISTIC BattU_nEngStabThd_C "Engine speed stable threshold" VALUE 0x805263B2 RB_Val_Ws16 32767.50 EngN -16384.00 16383.50 FORMAT "%8.2" /end CHARACTERISTIC
/begin CHARACTERISTIC BattU_numUStbyDiaDeb_C "Threshold for DFC (DFC_BattUStdbyDiaOL)" VALUE 0x805263AA RB_Val_Wu8 255.0 OneToOne 0.00 255.0 FORMAT "%5.1" /end CHARACTERISTIC
/begin CHARACTERISTIC BattU_RmpSlpNeg_C "Negative ramp slope threshold value for devlibTransStage structure" VALUE 0x805263B4 RB_Val_Ws32 655358999.634 RmpVoltBatt 1000.061 655359999.695 FORMAT "%13.3" EXTENDED_LIMITS -655360000.000 655359999.695 /end CHARACTERISTIC
/begin CHARACTERISTIC BattU_RmpSlpPos_C "Positive ramp slope threshold value for devlibTransStage structure" VALUE 0x805263B8 RB_Val_Ws32 655358999.634 RmpVoltBatt 1000.061 655359999.695 FORMAT "%13.3" EXTENDED_LIMITS -655360000.000 655359999.695 /end CHARACTERISTIC
/begin CHARACTERISTIC BattU_stPwrStgDiaDis_C "Status of Power Stage Diagnostic Discrete" VALUE 0x8052639E RB_Val_Wu16 65535.00 OneToOne 0.00 65535.00 FORMAT "%8.2" /end CHARACTERISTIC
/begin CHARACTERISTIC BattU_stSensId_C "Status of the Sensor ID word of the Device Library Transition Stage which is used to calculate battery voltage" VALUE 0x805263BC RB_Val_Wu8 255.0 OneToOne 0.00 255.0 FORMAT "%5.1" /end CHARACTERISTIC
/begin CHARACTERISTIC BattU_swtCorFacActv_C "Switch for enabling battery factor correction calculation" VALUE 0x805263BD RB_Val_Wu8 255.0 OneToOne 0.00 255.0 FORMAT "%5.1" /end CHARACTERISTIC
/begin CHARACTERISTIC BattU_swtRated_C "Switch for rated voltage selection" VALUE 0x805263BE RB_Val_Wu8 255.0 OneToOne 0.00 255.0 FORMAT "%5.1" /end CHARACTERISTIC
/begin CHARACTERISTIC BattU_tiCSTDef_C "CST Defect time" VALUE 0x805263A0 RB_Val_Ws16 655350.0 Time_ms -327680.0 327670.0 FORMAT "%8.1" /end CHARACTERISTIC
/begin CHARACTERISTIC BattU_tiIgnONDlyThd_C "Ignition ON delay time threshold" VALUE 0x805263C0 RB_Val_Wu16 655.3500 Time_s 0.00 655.3500 FORMAT "%8.4" /end CHARACTERISTIC
/begin CHARACTERISTIC BattU_tiSensLo_C "Delay time to detect battery voltage in normal state" VALUE 0x805263C2 RB_Val_Wu16 655350.0 Time_ms 0.00 655350.0 FORMAT "%8.1" /end CHARACTERISTIC
/begin CHARACTERISTIC BattU_tiSRCActvDly_C "Delay Time to enable SRC high and Low check if engine is in RUNNING" VALUE 0x805263C4 RB_Val_Ws32 42949672.9500 Time_s -21474836.4800 21474836.4700 FORMAT "%13.4" /end CHARACTERISTIC
/begin CHARACTERISTIC BattU_tiStabPsOffDly_C "Stable Powerstae OFF Delay" VALUE 0x805263A2 RB_Val_Ws16 655350.0 Time_ms -327680.0 327670.0 FORMAT "%8.1" /end CHARACTERISTIC
/begin CHARACTERISTIC BattU_tiStabPsOnDly_C "Stable Powerstae ON Delay" VALUE 0x805263A4 RB_Val_Ws16 655350.0 Time_ms -327680.0 327670.0 FORMAT "%8.1" /end CHARACTERISTIC
/begin CHARACTERISTIC BattU_uHiUFailrThd_C "Battery voltage high failure determination threshold" VALUE 0x805263C8 RB_Val_Ws16 1310700. Volt_Batt -655360.0 655340.0 FORMAT "%8.1" /end CHARACTERISTIC
/begin CHARACTERISTIC BattU_uIgnBoostEna_C "Ignition boost enable voltage" VALUE 0x805263A6 RB_Val_Ws16 1310700. Volt_Batt -655360.0 655340.0 FORMAT "%8.1" /end CHARACTERISTIC
/begin CHARACTERISTIC BattU_uLoUFailrThd_C "Battery voltage low failure determination threshold" VALUE 0x805263CA RB_Val_Ws16 1310700. Volt_Batt -655360.0 655340.0 FORMAT "%8.1" /end CHARACTERISTIC
/begin CHARACTERISTIC BattU_uNrm_C "Normal battery voltage to calculate the correction factor" VALUE 0x805263CC RB_Val_Ws16 1310700. Volt_Batt -655360.0 655340.0 FORMAT "%8.1" /end CHARACTERISTIC
/begin CHARACTERISTIC BattU_uSensLo_C "Sensed battery low voltage" VALUE 0x805263CE RB_Val_Ws16 1310700. Volt_Batt -655360.0 655340.0 FORMAT "%8.1" /end CHARACTERISTIC
/begin CHARACTERISTIC BattU_uSnsrFildIni_C "Initial value for battery sensored filter" VALUE 0x805263D0 RB_Val_Ws16 1310700. Volt_Batt -655360.0 655340.0 FORMAT "%8.1" /end CHARACTERISTIC
/begin CHARACTERISTIC BattU_uSRCMax_C "Max. voltage for SRC high check" VALUE 0x805263D2 RB_Val_Ws16 13107.00 Volt -6553.600 6553.400 FORMAT "%8.3" /end CHARACTERISTIC
/begin CHARACTERISTIC BattU_uSRCMin_C "Min. voltage for SRC low check" VALUE 0x805263D4 RB_Val_Ws16 13107.00 Volt -6553.600 6553.400 FORMAT "%8.3" /end CHARACTERISTIC
/begin CHARACTERISTIC BattU_uTransDft_C "Battery voltage Transition default value in case of devlib" VALUE 0x805263D6 RB_Val_Wu16 28600.00 Volt_Batt 0.00 28600.00 FORMAT "%8.2" EXTENDED_LIMITS 0.00 1310700. /end CHARACTERISTIC
/begin CHARACTERISTIC BattU_uTransf_CUR "Transformation curve for battery voltage" CURVE 0x80526358 RB_Curve_S16_S16 1310700. Volt_Batt -655360.0 655340.0 FORMAT "%8.1"
 /begin AXIS_DESCR STD_AXIS BattU_uRaw_mp Volt 16 -6553.600 6553.400 FORMAT "%8.3" DEPOSIT ABSOLUTE /end AXIS_DESCR
/end CHARACTERISTIC
/begin CHARACTERISTIC BattU_uWrgDetnPrevnThd_C "Battery voltage threshold to prevent wrong detection" VALUE 0x805263D8 RB_Val_Ws16 1310700. Volt_Batt -655360.0 655340.0 FORMAT "%8.1" /end CHARACTERISTIC
/begin CHARACTERISTIC BattU_vSRCMaxLim_C "Vehicle speed threshold to perform the SRC high check" VALUE 0x805263DA RB_Val_Ws16 655.3500 Vel -327.6800 327.6700 FORMAT "%8.4" /end CHARACTERISTIC
/begin CHARACTERISTIC Batt_chStopEnaThres_C "Threshold of the battery charge to enable a stopping engine" VALUE 0x805263DC RB_Val_Ws16 32767.50 RBPtCel_Perc_0p5_1 -16384.00 16383.50 FORMAT "%8.2" /end CHARACTERISTIC
/begin CHARACTERISTIC Batt_chStrtReqThres_C "threshold of the battery charge to request a starting engine" VALUE 0x805263DE RB_Val_Ws16 16383.50 RBPtCel_Perc_0p5_1 0.00 16383.50 FORMAT "%8.2" EXTENDED_LIMITS -16384.00 16383.50 /end CHARACTERISTIC
/begin CHARACTERISTIC Batt_cntrOCVThd_C "Counter Threshold for number of occurences of Low open circuit voltage to initiate rough estimation of battery SOC again" VALUE 0x805263E0 RB_Val_Wu8 255.0 OneToOne 0.00 255.0 FORMAT "%5.1" /end CHARACTERISTIC
/begin CHARACTERISTIC Batt_facHiChrgnEff_T "Curve to determine the High charge efficiency of battery based on battery temperature" CURVE 0x805263E2 RB_Curve_S16_S16 2.550000 Fact1000 0.00 2.550000 FORMAT "%8.6" EXTENDED_LIMITS -32.76800 32.76700
 /begin AXIS_DESCR STD_AXIS Ebs_tBattFild SCR_TEMP_CELS_float 6 -32768.00 32767.00 FORMAT "%8.2" DEPOSIT ABSOLUTE /end AXIS_DESCR
/end CHARACTERISTIC
/begin CHARACTERISTIC Batt_facLoChrgnEff_T "Curve to determine the Low charge efficiency of battery based on battery temperature" CURVE 0x805263FC RB_Curve_S16_S16 2.550000 Fact1000 0.00 2.550000 FORMAT "%8.6" EXTENDED_LIMITS -32.76800 32.76700
 /begin AXIS_DESCR STD_AXIS Ebs_tBattFild SCR_TEMP_CELS_float 6 -32768.00 32767.00 FORMAT "%8.2" DEPOSIT ABSOLUTE /end AXIS_DESCR
/end CHARACTERISTIC
/begin CHARACTERISTIC Batt_facSOCStdy_C "Correction factor for steady SOC of UWABURE judgement" VALUE 0x80526416 RB_Val_Wu16 65.53500 Fact1000 0.00 65.53500 FORMAT "%8.5" /end CHARACTERISTIC
/begin CHARACTERISTIC Batt_flgDarkIAllw_C "Calibration to prohibit use of unsteady dark current" VALUE 0x80526418 RB_Val_Wboolean 1.00000000000 B_TRUE 0.00 1.00000000000 FORMAT "%13.11" /end CHARACTERISTIC
/begin CHARACTERISTIC Batt_flgSt5ChrgModDi_C "Calibration to disable usage of battery management state 5 for checking if battery is in charging mode" VALUE 0x80526419 RB_Val_Wboolean 1.00000000000 B_TRUE 0.00 1.00000000000 FORMAT "%13.11" /end CHARACTERISTIC
/begin CHARACTERISTIC Batt_flgSwtBattSeln_C "Switch to select the souce of battery SOC calculation" VALUE 0x8052641A RB_Val_Wboolean 1.00000000000 B_TRUE 0.00 1.00000000000 FORMAT "%13.11" /end CHARACTERISTIC
/begin CHARACTERISTIC Batt_flgSwtSOCSeln_C "Switch to select the source of battery SOC" VALUE 0x80526558 RB_Val_Wu8 1.00000000000 B_TRUE 0.00 1.00000000000 FORMAT "%13.11" /end CHARACTERISTIC
/begin CHARACTERISTIC Batt_iChrgnThdDelta_C "Hysteresis delta thresold for determining battery charge completed based on battery current from the sensor" VALUE 0x8052641C RB_Val_Ws16 655.3500 Curr_A -327.6800 327.6700 FORMAT "%8.4" /end CHARACTERISTIC
/begin CHARACTERISTIC Batt_iChrgnThd_M "Charging current threshold for start stop judgement" MAP 0x8052641E RB_Map_S16S16_S16 655.3500 Curr_A -327.6800 327.6700 FORMAT "%8.4"
 /begin AXIS_DESCR STD_AXIS Ebs_tBattFild SCR_TEMP_CELS_float 6 -32768.00 32767.00 FORMAT "%8.2" DEPOSIT ABSOLUTE /end AXIS_DESCR
 /begin AXIS_DESCR STD_AXIS Ebs_uBattFild U_mV_q0p9765625_COMPU 6 -32000.00 31999.02 FORMAT "%8.2" DEPOSIT ABSOLUTE /end AXIS_DESCR
/end CHARACTERISTIC
/begin CHARACTERISTIC Batt_iOCVDchaThd_C "Current threshold to confirm OCV detection during dischage" VALUE 0x80526482 RB_Val_Ws16 655.3500 Curr_A -327.6800 327.6700 FORMAT "%8.4" /end CHARACTERISTIC
/begin CHARACTERISTIC Batt_iOCVDetnThd_C "Battery Current threshold to confirm OCV detection" VALUE 0x80526484 RB_Val_Ws16 655.3500 Curr_A -327.6800 327.6700 FORMAT "%8.4" /end CHARACTERISTIC
/begin CHARACTERISTIC Batt_iOCVThd_C "Alternator Current threshold to confirm OCV detection" VALUE 0x80526486 RB_Val_Ws16 655.3500 Curr_A -327.6800 327.6700 FORMAT "%8.4" /end CHARACTERISTIC
/begin CHARACTERISTIC Batt_qAdjCnsChk_C "The adjustment quantity for consumption check" VALUE 0x80526488 RB_Val_Ws32 4294967.29500 RBPtCel_q_0p001_1 -2147483.64800 2147483.64700 FORMAT "%13.5" /end CHARACTERISTIC
/begin CHARACTERISTIC Batt_qBliChrgLim_C "Threshold to detect blind charge during ignition off" VALUE 0x8052648C RB_Val_Ws32 2147483.64700 RBPtCel_q_0p001_1 0.00 2147483.64700 FORMAT "%13.5" EXTENDED_LIMITS -2147483.64800 2147483.64700 /end CHARACTERISTIC
/begin CHARACTERISTIC Batt_qCap20_C "Calibration to convert dark current threshold in percentage to ampere second unit" VALUE 0x80526490 RB_Val_Wu16 327.6700 q0p01_A_h_1 0.00 327.6700 FORMAT "%8.4" EXTENDED_LIMITS 0.00 655.3500 /end CHARACTERISTIC
/begin CHARACTERISTIC Batt_qChgCap20_C "Charge capacity" VALUE 0x80526494 RB_Val_Ws32 4294967.29500 RBPtCel_q_0p001_1 -2147483.64800 2147483.64700 FORMAT "%13.5" /end CHARACTERISTIC
/begin CHARACTERISTIC Batt_qDeltaDchaCmpl_C "Delta discharge limit to move to batter management state 3" VALUE 0x80526498 RB_Val_Ws32 4294967.29500 RBPtCel_q_0p001_1 -2147483.64800 2147483.64700 FORMAT "%13.5" /end CHARACTERISTIC
/begin CHARACTERISTIC Batt_qDodLimHi_C "Hysterisis upper threshold for start request based on depth of discharge" VALUE 0x8052649C RB_Val_Ws32 4294967.29500 RBPtCel_q_0p001_1 -2147483.64800 2147483.64700 FORMAT "%13.5" /end CHARACTERISTIC
/begin CHARACTERISTIC Batt_qDodLimLo_C "Hysterisis lower threshold for start request based on depth of discharge" VALUE 0x805264A0 RB_Val_Ws32 4294967.29500 RBPtCel_q_0p001_1 -2147483.64800 2147483.64700 FORMAT "%13.5" /end CHARACTERISTIC
/begin CHARACTERISTIC Batt_qDodStopEnaLim_C "The DOD limit for stop enable" VALUE 0x805264A4 RB_Val_Ws32 2147483.64800 RBPtCel_q_0p001_1 -2147483.64800 0.00 FORMAT "%13.5" EXTENDED_LIMITS -2147483.64800 2147483.64700 /end CHARACTERISTIC
/begin CHARACTERISTIC Batt_qDodStrtReqLim_C "The DOD limit for start request" VALUE 0x805264A8 RB_Val_Ws32 2147483.64800 RBPtCel_q_0p001_1 -2147483.64800 0.00 FORMAT "%13.5" EXTENDED_LIMITS -2147483.64800 2147483.64700 /end CHARACTERISTIC
/begin CHARACTERISTIC Batt_qNrm1_C "This indicates the normalized battery state of health balue based on battery type indicated by ID1" VALUE 0x805264AC RB_Val_Ws16 8191.875 RBPtCel_q_0p125_1 -4096.000 4095.875 FORMAT "%8.3" /end CHARACTERISTIC
/begin CHARACTERISTIC Batt_qNrm2_C "Callibration for battery state of health with respect to charge capacity" VALUE 0x805264AE RB_Val_Ws16 8191.875 RBPtCel_q_0p125_1 -4096.000 4095.875 FORMAT "%8.3" /end CHARACTERISTIC
/begin CHARACTERISTIC Batt_qSumHiRcv_C "Battery current integral recovery (hi charge efficiency)" VALUE 0x805264B0 RB_Val_Ws32 4294967.29500 RBPtCel_q_0p001_1 -2147483.64800 2147483.64700 FORMAT "%13.5" /end CHARACTERISTIC
/begin CHARACTERISTIC Batt_qSumHiThd_C "Maximum value allowed for Battery current integral ( hi charge efficiency )" VALUE 0x805264B4 RB_Val_Ws32 4294967.29500 RBPtCel_q_0p001_1 -2147483.64800 2147483.64700 FORMAT "%13.5" /end CHARACTERISTIC
/begin CHARACTERISTIC Batt_qSumLoLimThd_C "Maximum value allowed for Battery current integral ( low charge efficiency )" VALUE 0x805264B8 RB_Val_Ws32 4294967.29500 RBPtCel_q_0p001_1 -2147483.64800 2147483.64700 FORMAT "%13.5" /end CHARACTERISTIC
/begin CHARACTERISTIC Batt_qSumLoLim_C "IBSUML threshold for restricting the reading of battery internal resistance" VALUE 0x8052655C RB_Val_Ws32 4294967.29500 RBPtCel_q_0p001_1 -2147483.64800 2147483.64700 FORMAT "%13.5" /end CHARACTERISTIC
/begin CHARACTERISTIC Batt_qSumLoLmt_C "Threshold for battery fully charged confirmation" VALUE 0x805264BC RB_Val_Ws32 4294967.29500 RBPtCel_q_0p001_1 -2147483.64800 2147483.64700 FORMAT "%13.5" /end CHARACTERISTIC
/begin CHARACTERISTIC Batt_qSumLoRcv_C "Battery current integral recovery (low charge efficiency)" VALUE 0x805264C0 RB_Val_Ws32 4294967.29500 RBPtCel_q_0p001_1 -2147483.64800 2147483.64700 FORMAT "%13.5" /end CHARACTERISTIC
/begin CHARACTERISTIC Batt_qSumLoThd_C "Threshold below which battery management state exits normal control to SOC judgement state" VALUE 0x805264C4 RB_Val_Ws32 4294967.29500 RBPtCel_q_0p001_1 -2147483.64800 2147483.64700 FORMAT "%13.5" /end CHARACTERISTIC
/begin CHARACTERISTIC Batt_qSumRCThd1_C "IBSUMRCINI threshold for transiting to state 7 from state 8" VALUE 0x805264C8 RB_Val_Ws32 2147483.64700 RBPtCel_q_0p001_1 0.00 2147483.64700 FORMAT "%13.5" EXTENDED_LIMITS -2147483.64800 2147483.64700 /end CHARACTERISTIC
/begin CHARACTERISTIC Batt_qSumRCThd2_C "IBSUMRCINI threshold for transiting to state 1 from state 8" VALUE 0x805264CC RB_Val_Ws32 2147483.64700 RBPtCel_q_0p001_1 0.00 2147483.64700 FORMAT "%13.5" EXTENDED_LIMITS -2147483.64800 2147483.64700 /end CHARACTERISTIC
/begin CHARACTERISTIC Batt_qSumSOCRawThd_C "IBSUMRAW threshold for UWABURE judgement" VALUE 0x805264D0 RB_Val_Ws32 4294967.29500 RBPtCel_q_0p001_1 -2147483.64800 2147483.64700 FORMAT "%13.5" /end CHARACTERISTIC
/begin CHARACTERISTIC Batt_qSumSOCThd_C "IBSUMH threshold for UWABURE judgement" VALUE 0x805264D4 RB_Val_Ws32 4294967.29500 RBPtCel_q_0p001_1 -2147483.64800 2147483.64700 FORMAT "%13.5" /end CHARACTERISTIC
/begin CHARACTERISTIC Batt_qTotDChaCmpl_C "Total discharge limit to move to batter management state 4 from state 2" VALUE 0x805264D8 RB_Val_Ws32 4294967.29500 RBPtCel_q_0p001_1 -2147483.64800 2147483.64700 FORMAT "%13.5" /end CHARACTERISTIC
/begin CHARACTERISTIC Batt_ratAcptdLowSoc_C "Accepted Low SOC" VALUE 0x805264DC RB_Val_Wu8 127.5 rel_ub_b127p5 0.00 127.5 FORMAT "%5.1" /end CHARACTERISTIC
/begin CHARACTERISTIC Batt_ratLowSocChrgFinsh_C "Low SOC charge finish" VALUE 0x805264DD RB_Val_Wu8 127.5 rel_ub_b127p5 0.00 127.5 FORMAT "%5.1" /end CHARACTERISTIC
/begin CHARACTERISTIC Batt_ratMinSocRBatt_C "The minimum battery SOC that has to be present to proceed with reading the battery internal resistance and hence battery degradation judgement." VALUE 0x80526560 RB_Val_Wu8 127.5 RBPtCel_Perc_0p5_1 0.00 127.5 FORMAT "%5.1" /end CHARACTERISTIC
/begin CHARACTERISTIC Batt_ratSocTgt_C "Traget SOC" VALUE 0x805264DE RB_Val_Wu16 32767.50 RBPtCel_Perc_0p5_1 0.00 32767.50 FORMAT "%8.2" /end CHARACTERISTIC
/begin CHARACTERISTIC Batt_ratSocThdStopEna_C "Battery SOC threshold level for stop enable judgement" VALUE 0x805264E0 RB_Val_Ws16 32767.50 RBPtCel_Perc_0p5_1 -16384.00 16383.50 FORMAT "%8.2" /end CHARACTERISTIC
/begin CHARACTERISTIC Batt_ratSoh4SofLim_C "SOH limit for SOF_V precision" VALUE 0x805264E2 RB_Val_Ws16 399.9878 Prc 0.00 399.9878 FORMAT "%8.4" EXTENDED_LIMITS -400.0000 399.9878 /end CHARACTERISTIC
/begin CHARACTERISTIC Batt_ratSohStopEnaLim_C "SOH limit for stop enable" VALUE 0x805264E4 RB_Val_Ws16 399.9878 Prc 0.00 399.9878 FORMAT "%8.4" EXTENDED_LIMITS -400.0000 399.9878 /end CHARACTERISTIC
/begin CHARACTERISTIC Batt_ratSohThres_C "Threshold SOH" VALUE 0x805264E6 RB_Val_Ws16 399.9878 Prc 0.00 399.9878 FORMAT "%8.4" EXTENDED_LIMITS -400.0000 399.9878 /end CHARACTERISTIC
/begin CHARACTERISTIC Batt_rBattDgrdLim_C "Limit for battery internal resistance for battery degradation" VALUE 0x80526562 RB_Val_Ws16 0.6553500 RBPtCel_r_0p00001_1 -0.3276800 0.3276700 FORMAT "%9.7" /end CHARACTERISTIC
/begin CHARACTERISTIC Batt_rBattExchJudgThd_C "Battery resistance threshold to judge that battery has been exchanged" VALUE 0x80526564 RB_Val_Ws16 655.3500 Resist_mOhm_q0p01 -327.6800 327.6700 FORMAT "%8.4" /end CHARACTERISTIC
/begin CHARACTERISTIC Batt_rDarkIAllwCondBThdHi_C "Hysterisis upper threshold for dark current allow judgement condition B" VALUE 0x805264E8 RB_Val_Ws32 42949672.9500 Prc_Fact100 -21474836.4800 21474836.4700 FORMAT "%13.4" /end CHARACTERISTIC
/begin CHARACTERISTIC Batt_rDarkIAllwCondBThdLo_C "Hysterisis Lower threshold for dark current allow judgement condition B" VALUE 0x805264EC RB_Val_Ws32 42949672.9500 Prc_Fact100 -21474836.4800 21474836.4700 FORMAT "%13.4" /end CHARACTERISTIC
/begin CHARACTERISTIC Batt_rDarkIThdCondAHi_C "Hysterisis upper threshold for dark current allow judgement condition A" VALUE 0x805264F0 RB_Val_Ws32 42949672.9500 Prc_Fact100 -21474836.4800 21474836.4700 FORMAT "%13.4" /end CHARACTERISTIC
/begin CHARACTERISTIC Batt_rDarkIThdCondALo_C "Hysterisis Lower threshold for dark current allow judgement condition A" VALUE 0x805264F4 RB_Val_Ws32 42949672.9500 Prc_Fact100 -21474836.4800 21474836.4700 FORMAT "%13.4" /end CHARACTERISTIC
/begin CHARACTERISTIC Batt_rLimSysFailrHi_C "High threshold limit for battery system fault" VALUE 0x80526566 RB_Val_Ws16 0.6553500 RBPtCel_r_0p00001_1 -0.3276800 0.3276700 FORMAT "%9.7" /end CHARACTERISTIC
/begin CHARACTERISTIC Batt_rLimSysFailrLo_C "Low threshold limit for battery system fault" VALUE 0x80526568 RB_Val_Ws16 0.6553500 RBPtCel_r_0p00001_1 -0.3276800 0.3276700 FORMAT "%9.7" /end CHARACTERISTIC
/begin CHARACTERISTIC Batt_rSlopBattDgrd_T "Slope for battery internal resistance for battery degradation" CURVE 0x8052656A RB_Curve_S16_S16 0.6553500 RBPtCel_r_0p00001_1 -0.3276800 0.3276700 FORMAT "%9.7"
 /begin AXIS_DESCR STD_AXIS Ebs_tBattFild SCR_TEMP_CELS_float 6 -32768.00 32767.00 FORMAT "%8.2" DEPOSIT ABSOLUTE /end AXIS_DESCR
/end CHARACTERISTIC
/begin CHARACTERISTIC Batt_rSlopISSEna_T "Slope for battery internal resistance for ISS enable" CURVE 0x80526584 RB_Curve_S16_S16 0.6553500 RBPtCel_r_0p00001_1 -0.3276800 0.3276700 FORMAT "%9.7"
 /begin AXIS_DESCR STD_AXIS Ebs_tBattFild SCR_TEMP_CELS_float 6 -32768.00 32767.00 FORMAT "%8.2" DEPOSIT ABSOLUTE /end AXIS_DESCR
/end CHARACTERISTIC
/begin CHARACTERISTIC Batt_SofCorrn_T "SOF_V precision offse" CURVE 0x805264F8 RB_Curve_S16_S16 4095.938 spg_q0p0625_V -2048.000 2047.938 FORMAT "%8.3"
 /begin AXIS_DESCR STD_AXIS Batt_cntrStrtIn dez 2 0.00 32767.00 FORMAT "%8.2" EXTENDED_LIMITS -32768.00 32767.00 DEPOSIT ABSOLUTE /end AXIS_DESCR
/end CHARACTERISTIC
/begin CHARACTERISTIC Batt_stLoSocDetn_C "Low SOC detection" VALUE 0x80526502 RB_Val_Wu8 255.0 OneToOne 0.00 255.0 FORMAT "%5.1" /end CHARACTERISTIC
/begin CHARACTERISTIC Batt_stSigSeln_C "Calibration for selection of source of signals relating to battery condition" VALUE 0x80526503 RB_Val_Wu8 255.0 OneToOne 0.00 255.0 FORMAT "%5.1" /end CHARACTERISTIC
/begin CHARACTERISTIC Batt_stSocErrSel_C "Battery SOC error bits" VALUE 0x80526504 RB_Val_Wu8 255.0 OneToOne 0.00 255.0 FORMAT "%5.1" /end CHARACTERISTIC
/begin CHARACTERISTIC Batt_stSocRlbtJdg_C "SOC reliability judgment" VALUE 0x80526506 RB_Val_Wu16 65535.00 OneToOne 0.00 65535.00 FORMAT "%8.2" /end CHARACTERISTIC
/begin CHARACTERISTIC Batt_stStartErrMsk_C "Error mask for engine request" VALUE 0x80526508 RB_Val_Wu8 255.0 OneToOne 0.00 255.0 FORMAT "%5.1" /end CHARACTERISTIC
/begin CHARACTERISTIC Batt_stStopErrMsk_C "Error mask for stop enable" VALUE 0x80526509 RB_Val_Wu8 255.0 OneToOne 0.00 255.0 FORMAT "%5.1" /end CHARACTERISTIC
/begin CHARACTERISTIC Batt_swtDataSrcSel_C "Switch to read battery sensors from LIN or from EEM module" VALUE 0x8052650A RB_Val_Wboolean 1.00000000000 B_TRUE 0.00 1.00000000000 FORMAT "%13.11" /end CHARACTERISTIC
/begin CHARACTERISTIC Batt_tBattStopEnaHiLim_C "The temperature high threshold for stop enable" VALUE 0x8052650C RB_Val_Ws16 65535.00 SCR_TEMP_CELS_float -32768.00 32767.00 FORMAT "%8.2" /end CHARACTERISTIC
/begin CHARACTERISTIC Batt_tBattStopEnaLim_C "Minimum battery temperature for stop enable" VALUE 0x8052650E RB_Val_Ws16 65535.00 SCR_TEMP_CELS_float -32768.00 32767.00 FORMAT "%8.2" /end CHARACTERISTIC
/begin CHARACTERISTIC Batt_tBattStrtReqLim_C "Minimum battery temperature for start request" VALUE 0x80526510 RB_Val_Ws16 65535.00 SCR_TEMP_CELS_float -32768.00 32767.00 FORMAT "%8.2" /end CHARACTERISTIC
/begin CHARACTERISTIC Batt_tBattThres_C "Threshold for battery temperature" VALUE 0x80526512 RB_Val_Ws16 65535.00 SCR_TEMP_CELS_float -32768.00 32767.00 FORMAT "%8.2" /end CHARACTERISTIC
/begin CHARACTERISTIC Batt_tiBattCodChgID1_C "Turn on delay time to detect change of battery code to ID1" VALUE 0x80526514 RB_Val_Wu16 655.3500 Time_s 0.00 655.3500 FORMAT "%8.4" /end CHARACTERISTIC
/begin CHARACTERISTIC Batt_tiBattCodChgID2_C "Turn on delay time to detect change of battery code to ID2" VALUE 0x80526516 RB_Val_Wu16 655.3500 Time_s 0.00 655.3500 FORMAT "%8.4" /end CHARACTERISTIC
/begin CHARACTERISTIC Batt_tiChrgnIThd_C "Battery charging current threshold time" VALUE 0x80526518 RB_Val_Wu16 655.3500 Time_s 0.00 655.3500 FORMAT "%8.4" /end CHARACTERISTIC
/begin CHARACTERISTIC Batt_tiCSTWarrant_C "CST warrant delay threshold timer to avoid On-Off-On in short time" VALUE 0x805263A8 RB_Val_Wu16 655350.0 Time_ms 0.00 655350.0 FORMAT "%8.1" /end CHARACTERISTIC
/begin CHARACTERISTIC Batt_tiCum1_C "Cumulative Time 1" VALUE 0x8052651C RB_Val_Wu32 429496729.500 Time_sec_1 0.00 429496729.500 FORMAT "%13.3" /end CHARACTERISTIC
/begin CHARACTERISTIC Batt_tiCum2_C "Cumulative Time 2" VALUE 0x80526520 RB_Val_Wu32 429496729.500 Time_sec_1 0.00 429496729.500 FORMAT "%13.3" /end CHARACTERISTIC
/begin CHARACTERISTIC Batt_tiCurrThd_C "Delay time threshold to confirm OCV detection based on battery current and alternator current" VALUE 0x80526524 RB_Val_Wu16 655.3500 Time_s 0.00 655.3500 FORMAT "%8.4" /end CHARACTERISTIC
/begin CHARACTERISTIC Batt_tiDchaThd_C "Delay time threshold to confirm OCV detection based on battery voltage and alternator desired voltage" VALUE 0x80526526 RB_Val_Wu16 655.3500 Time_s 0.00 655.3500 FORMAT "%8.4" /end CHARACTERISTIC
/begin CHARACTERISTIC Batt_tiOCVDetnThd_C "Delay time threshold to confirm OCV detection based on battery current" VALUE 0x80526528 RB_Val_Wu16 655.3500 Time_s 0.00 655.3500 FORMAT "%8.4" /end CHARACTERISTIC
/begin CHARACTERISTIC Batt_tiOCVVoltThd_C "Delay time threshold to confirm OCV detection based on battery voltage" VALUE 0x8052652A RB_Val_Wu16 655.3500 Time_s 0.00 655.3500 FORMAT "%8.4" /end CHARACTERISTIC
/begin CHARACTERISTIC Batt_tISSProhbModChg_C "ISS prohibition mode change temperature" VALUE 0x8052659E RB_Val_Ws16 65535.00 SCR_TEMP_CELS_float -32768.00 32767.00 FORMAT "%8.2" /end CHARACTERISTIC
/begin CHARACTERISTIC Batt_tISSProhb_C "ISS prohibition temperature" VALUE 0x805265A0 RB_Val_Ws16 65535.00 SCR_TEMP_CELS_float -32768.00 32767.00 FORMAT "%8.2" /end CHARACTERISTIC
/begin CHARACTERISTIC Batt_tiStopDurMin_C "time spend in stop before starting the engine" VALUE 0x8052652C RB_Val_Ws16 10485.60 TimeRed -5242.880 5242.720 FORMAT "%8.3" /end CHARACTERISTIC
/begin CHARACTERISTIC Batt_uChrgThd_C "The voltage of charge threshold" VALUE 0x8052652E RB_Val_Ws16 63999.02 U_mV_q0p9765625_COMPU -32000.00 31999.02 FORMAT "%8.2" /end CHARACTERISTIC
/begin CHARACTERISTIC Batt_uOCVDchaThd_C "Voltage threshold for OCV detection based on battery voltage discharge" VALUE 0x80526530 RB_Val_Ws16 63999.02 U_mV_q0p9765625_COMPU -32000.00 31999.02 FORMAT "%8.2" /end CHARACTERISTIC
/begin CHARACTERISTIC Batt_uOCVDetnThd_T "Curve to determine Voltage threshold for OCV detection based on battery SOC" CURVE 0x80526532 RB_Curve_S16_S16 63999.02 U_mV_q0p9765625_COMPU -32000.00 31999.02 FORMAT "%8.2"
 /begin AXIS_DESCR STD_AXIS NO_INPUT_QUANTITY Ampsec100 4 -3276800. 3276700. FORMAT "%8.0" DEPOSIT ABSOLUTE /end AXIS_DESCR
/end CHARACTERISTIC
/begin CHARACTERISTIC Batt_uOCVLimThd_C "Voltage threshold for OCV detection based on alternator desired voltage" VALUE 0x80526544 RB_Val_Ws16 1310700. Volt_Batt -655360.0 655340.0 FORMAT "%8.1" /end CHARACTERISTIC
/begin CHARACTERISTIC Batt_uSofStopEnaLim_C "Low limit of supply voltage in cranking for stop enable" VALUE 0x80526546 RB_Val_Ws16 4095.938 spg_q0p0625_V -2048.000 2047.938 FORMAT "%8.3" /end CHARACTERISTIC
/begin CHARACTERISTIC Batt_uSofStrtReqLim_C "Low limit of supply voltage in cranking for start request" VALUE 0x80526548 RB_Val_Ws16 4095.938 spg_q0p0625_V -2048.000 2047.938 FORMAT "%8.3" /end CHARACTERISTIC
/begin CHARACTERISTIC Batt_uSofThres_C "Threshold of supply voltage in cranking" VALUE 0x8052654A RB_Val_Ws16 4095.938 spg_q0p0625_V -2048.000 2047.938 FORMAT "%8.3" /end CHARACTERISTIC
/begin CHARACTERISTIC ChrSet_tCooltEng_C "Disabling of the EGR based on coolant temperature has to be limited to the amount necessary" VALUE 0x8051CB84 RB_Val_Ws16 6553.500 Temp_Cels -3549.940 3003.560 FORMAT "%8.3" /end CHARACTERISTIC
/begin CHARACTERISTIC ChrSet_tiDlyEgrEngStrt_C "Disabling of the EGR has to be limited to the amount necessary after start." VALUE 0x8051CB86 RB_Val_Wu16 5.000000 t_q0p1 0.00 5.000000 FORMAT "%8.6" EXTENDED_LIMITS 0.00 6553.500 /end CHARACTERISTIC
/begin CHARACTERISTIC ComEBS_iBattAvgLINOffOfs_C "Average LIN Battery Off condition" VALUE 0x805262D0 RB_Val_Ws16 511.9922 i_q0p0078125_A -256.0000 255.9922 FORMAT "%8.4" /end CHARACTERISTIC
/begin CHARACTERISTIC ComEBS_iBattAvgLINOffSlp_C "Average LIN Battery Off condition" VALUE 0x805262D4 RB_Val_Ws32 429.496729500 Slope -214.748364800 214.748364700 FORMAT "%13.9" /end CHARACTERISTIC
/begin CHARACTERISTIC ComEBS_iBattAvgLINOffThd_C "Threshold of average LIN Battery Off condition" VALUE 0x805262D8 RB_Val_Ws16 511.9922 i_q0p0078125_A -256.0000 255.9922 FORMAT "%8.4" /end CHARACTERISTIC
/begin CHARACTERISTIC ComEBS_iBattAvgLINOff_C "Calibration parameter to hold initial value of signal Average Discharge Current during LIN Off" VALUE 0x805262DA RB_Val_Ws16 511.9922 i_q0p0078125_A -256.0000 255.9922 FORMAT "%8.4" /end CHARACTERISTIC
/begin CHARACTERISTIC ComEBS_iBattBOfs_C "Offset of battery current information from type B sensor" VALUE 0x805262DC RB_Val_Ws32 6553.50000000 i_q0p001_A -3276.80000000 3276.70000000 FORMAT "%13.8" EXTENDED_LIMITS -2147483.64800 2147483.64700 /end CHARACTERISTIC
/begin CHARACTERISTIC ComEBS_iBattBSlp_C "Slope of battery current information from type B sensor" VALUE 0x805262E0 RB_Val_Ws16 66.00000 OneToOne -33.00000 33.00000 FORMAT "%8.5" EXTENDED_LIMITS -32768.00 32767.00 /end CHARACTERISTIC
/begin CHARACTERISTIC ComEBS_iBattMax_C "Maximum limit for battery current information from type B sensor" VALUE 0x805262E4 RB_Val_Ws32 4294967.29500 i_q0p001_A -2147483.64800 2147483.64700 FORMAT "%13.5" /end CHARACTERISTIC
/begin CHARACTERISTIC ComEBS_iBattMin_C "Minimum limit for battery current information from type B sensor" VALUE 0x805262E8 RB_Val_Ws32 4294967.29500 i_q0p001_A -2147483.64800 2147483.64700 FORMAT "%13.5" /end CHARACTERISTIC
/begin CHARACTERISTIC ComEBS_iBattSensEBSA_C "Raw value of Battery Current" VALUE 0x805262EC RB_Val_Ws32 4294967.29500 i_q0p001_A -2147483.64800 2147483.64700 FORMAT "%13.5" /end CHARACTERISTIC
/begin CHARACTERISTIC ComEBS_iStByCurrAft0hTypBOfs_C "Calibration for offset of ast stand-by current after ignition off" VALUE 0x805262F0 RB_Val_Ws16 639.9900 i_q0p01_A -320.0000 319.9900 FORMAT "%8.4" EXTENDED_LIMITS -327.6800 327.6700 /end CHARACTERISTIC
/begin CHARACTERISTIC ComEBS_iStByCurrAft0hTypB_C "Calibration for last stand-by current after ignition off" VALUE 0x805262F2 RB_Val_Ws16 655.3500 i_q0p01_A -327.6800 327.6700 FORMAT "%8.4" /end CHARACTERISTIC
/begin CHARACTERISTIC ComEBS_iStByCurrTypBSlp_C "Calibration for slope of last stand-by current after ignition off" VALUE 0x805262F4 RB_Val_Ws32 429.496729500 Slope -214.748364800 214.748364700 FORMAT "%13.9" /end CHARACTERISTIC
/begin CHARACTERISTIC ComEBS_qStByCurrAft1hTypBOfs_C "Offset for Stand-by current at 1 hour after ignition off" VALUE 0x805262F8 RB_Val_Ws16 639.9900 q0p01_A_h_1 -320.0000 319.9900 FORMAT "%8.4" EXTENDED_LIMITS -327.6800 327.6700 /end CHARACTERISTIC
/begin CHARACTERISTIC ComEBS_qStByCurrAft1hTypB_C "Calibration for Stand-by current at 1 hour after ignition off" VALUE 0x805262FA RB_Val_Ws16 655.3500 q0p01_A_h_1 -327.6800 327.6700 FORMAT "%8.4" /end CHARACTERISTIC
/begin CHARACTERISTIC ComEBS_qStByCurrAft2hTypBOfs_C "Offset for Stand-by current at 2 hour after ignition off" VALUE 0x805262FC RB_Val_Ws16 639.9900 q0p01_A_h_1 -320.0000 319.9900 FORMAT "%8.4" EXTENDED_LIMITS -327.6800 327.6700 /end CHARACTERISTIC
/begin CHARACTERISTIC ComEBS_qStByCurrAft2hTypB_C "Calibration for Stand-by current at 1 hour after ignition off" VALUE 0x805262FE RB_Val_Ws16 655.3500 q0p01_A_h_1 -327.6800 327.6700 FORMAT "%8.4" /end CHARACTERISTIC
/begin CHARACTERISTIC ComEBS_qStByCurrLstTypBOfs_C "Offset for Last stand-by current after ignition off" VALUE 0x80526300 RB_Val_Ws16 639.9900 q0p01_A_h_1 -320.0000 319.9900 FORMAT "%8.4" EXTENDED_LIMITS -327.6800 327.6700 /end CHARACTERISTIC
/begin CHARACTERISTIC ComEBS_qStByCurrLstTypB_C "Calibration for Last stand-by current after ignition off" VALUE 0x80526302 RB_Val_Ws16 655.3500 q0p01_A_h_1 -327.6800 327.6700 FORMAT "%8.4" /end CHARACTERISTIC
/begin CHARACTERISTIC ComEBS_rBattMax_C "Maximum value of State of Charge" VALUE 0x80526304 RB_Val_Ws16 32767.50 rel_ub_b127p5 -16384.00 16383.50 FORMAT "%8.2" /end CHARACTERISTIC
/begin CHARACTERISTIC ComEBS_rBattMin_C "Minimum value of State of Charge" VALUE 0x80526306 RB_Val_Ws16 32767.50 rel_ub_b127p5 -16384.00 16383.50 FORMAT "%8.2" /end CHARACTERISTIC
/begin CHARACTERISTIC ComEBS_rBattSensBChOfs_C "Calibration for offset of status of Type B Battery sensor charge" VALUE 0x80526308 RB_Val_Ws16 32767.50 rel_ub_b127p5 -16384.00 16383.50 FORMAT "%8.2" /end CHARACTERISTIC
/begin CHARACTERISTIC ComEBS_rBattSensBChSlp_C "Calibration for slope of status of Type B Battery sensor charge" VALUE 0x8052630A RB_Val_Ws16 8.000000 Fact_q0p001 -4.000000 4.000000 FORMAT "%8.6" EXTENDED_LIMITS -32.76800 32.76700 /end CHARACTERISTIC
/begin CHARACTERISTIC ComEBS_rBattStatMax_C "Calibration for upper limit of stratification rate" VALUE 0x8052630C RB_Val_Ws16 799.9878 Prc -400.0000 399.9878 FORMAT "%8.4" /end CHARACTERISTIC
/begin CHARACTERISTIC ComEBS_rBattStatMin_C "Calibration for lower limit of stratification rate" VALUE 0x8052630E RB_Val_Ws16 799.9878 Prc -400.0000 399.9878 FORMAT "%8.4" /end CHARACTERISTIC
/begin CHARACTERISTIC ComEBS_rBattStratOfs_C "Calibraiton for offset of stratification rate" VALUE 0x80526310 RB_Val_Ws16 799.9878 Prc -400.0000 399.9878 FORMAT "%8.4" /end CHARACTERISTIC
/begin CHARACTERISTIC ComEBS_rBattStratSlp_C "Calibration for slope of stratification rate" VALUE 0x80526312 RB_Val_Ws16 7.999878 Fact -4.000000 3.999878 FORMAT "%8.6" /end CHARACTERISTIC
/begin CHARACTERISTIC ComEBS_rBattStrat_C "Calibration for stratification rate" VALUE 0x80526314 RB_Val_Ws16 799.9878 Prc -400.0000 399.9878 FORMAT "%8.4" /end CHARACTERISTIC
/begin CHARACTERISTIC ComEBS_resMax_C "Maximum value of actual measured battery resistance" VALUE 0x80526318 RB_Val_Ws32 42949672.9500 Resist_mOhm_q0p01 -21474836.4800 21474836.4700 FORMAT "%13.4" /end CHARACTERISTIC
/begin CHARACTERISTIC ComEBS_resMin_C "Minimum value of actual measured battery resistance" VALUE 0x8052631C RB_Val_Ws32 42949672.9500 Resist_mOhm_q0p01 -21474836.4800 21474836.4700 FORMAT "%13.4" /end CHARACTERISTIC
/begin CHARACTERISTIC ComEBS_resOthMax_C "Calibration for upper limit of internal resistance (except a starter)" VALUE 0x80526320 RB_Val_Ws32 42949672.9500 Resist_mOhm_q0p01 -21474836.4800 21474836.4700 FORMAT "%13.4" /end CHARACTERISTIC
/begin CHARACTERISTIC ComEBS_resOthMin_C "Calibration for lower limit of internal resistance (except a starter)" VALUE 0x80526324 RB_Val_Ws32 42949672.9500 Resist_mOhm_q0p01 -21474836.4800 21474836.4700 FORMAT "%13.4" /end CHARACTERISTIC
/begin CHARACTERISTIC ComEBS_tBattASICMax_C "Max sensor temperature value" VALUE 0x80526328 RB_Val_Ws16 6553.500 Temp_Cels -3549.940 3003.560 FORMAT "%8.3" /end CHARACTERISTIC
/begin CHARACTERISTIC ComEBS_tBattASICMin_C "Min temperature sensor value" VALUE 0x8052632A RB_Val_Ws16 6553.500 Temp_Cels -3549.940 3003.560 FORMAT "%8.3" /end CHARACTERISTIC
/begin CHARACTERISTIC ComEBS_tBattMax_C "Maximum value of battery sensor temperature" VALUE 0x8052632C RB_Val_Ws16 6553.500 Temp_Cels -3549.940 3003.560 FORMAT "%8.3" /end CHARACTERISTIC
/begin CHARACTERISTIC ComEBS_tBattMin_C "Minimum value of battery sensor temperature" VALUE 0x8052632E RB_Val_Ws16 6553.500 Temp_Cels -3549.940 3003.560 FORMAT "%8.3" /end CHARACTERISTIC
/begin CHARACTERISTIC ComEBS_tBattSensASICOfs_C "Offset of ASIC temperature of EBS" VALUE 0x80526330 RB_Val_Ws16 6553.500 TempDiff_Cels -3276.800 3276.700 FORMAT "%8.3" /end CHARACTERISTIC
/begin CHARACTERISTIC ComEBS_tBattSensASICSlp_C "Resolution of ASIC temperature of EBS" VALUE 0x80526332 RB_Val_Ws16 65535.00 OneToOne -32768.00 32767.00 FORMAT "%8.2" /end CHARACTERISTIC
/begin CHARACTERISTIC ComEBS_tBattSensOfs_C "Offset of battery temperature" VALUE 0x80526334 RB_Val_Ws16 6553.500 TempDiff_Cels -3276.800 3276.700 FORMAT "%8.3" /end CHARACTERISTIC
/begin CHARACTERISTIC ComEBS_tBattSensSlp_C "Resolution of battery temperature" VALUE 0x80526336 RB_Val_Ws16 65535.00 OneToOne -32768.00 32767.00 FORMAT "%8.2" /end CHARACTERISTIC
/begin CHARACTERISTIC ComEBS_tiDurAftIgnOffOfs_C "Offset calibration value for Duration after ignition off" VALUE 0x80526338 RB_Val_Ws16 32767.50 Time_Hr -16384.00 16383.50 FORMAT "%8.2" /end CHARACTERISTIC
/begin CHARACTERISTIC ComEBS_tiDurAftIgnOffSlp_C "slope calibration value for Duration after ignition off" VALUE 0x8052633A RB_Val_Ws16 65535.00 OneToOne -32768.00 32767.00 FORMAT "%8.2" /end CHARACTERISTIC
/begin CHARACTERISTIC ComEBS_uBattMax_C "Maximum value of battery voltage" VALUE 0x8052633C RB_Val_Wu16 65.53500 spg_q0p001_V 0.00 65.53500 FORMAT "%8.5" /end CHARACTERISTIC
/begin CHARACTERISTIC ComEBS_uBattMin_C "Minimum value of battery voltage" VALUE 0x8052633E RB_Val_Wu16 65.53500 spg_q0p001_V 0.00 65.53500 FORMAT "%8.5" /end CHARACTERISTIC
/begin CHARACTERISTIC ComEBS_uBattOCVOfs_C "offset value for Battery quiescent voltage" VALUE 0x80526340 RB_Val_Ws16 63.99902 u_Batt_V_q0p00097656 -32.00000 31.99902 FORMAT "%8.5" /end CHARACTERISTIC
/begin CHARACTERISTIC ComEBS_uBattOCVSlp_C "Slope value for Battery quiescent voltage" VALUE 0x80526342 RB_Val_Ws16 8.000000 u_Batt_V_q0p00097656 -4.000000 4.000000 FORMAT "%8.6" EXTENDED_LIMITS -32.00000 31.99902 /end CHARACTERISTIC
/begin CHARACTERISTIC ComEBS_uBattSensBOfs_C "Offset value for battery voltage information" VALUE 0x80526344 RB_Val_Ws16 65.53500 spg_q0p001_V -32.76800 32.76700 FORMAT "%8.5" /end CHARACTERISTIC
/begin CHARACTERISTIC ComEBS_uBattSensBSlp_C "Slope value for battery voltage information" VALUE 0x80526346 RB_Val_Ws16 65535.00 OneToOne -32768.00 32767.00 FORMAT "%8.2" /end CHARACTERISTIC
/begin CHARACTERISTIC ComEBS_uBattSensEBSA_C "Battery Type" VALUE 0x80526348 RB_Val_Ws16 65.53500 spg_q0p001_V -32.76800 32.76700 FORMAT "%8.5" /end CHARACTERISTIC
/begin CHARACTERISTIC Com_dEBSDByt0_C "Calibration for initial value of Com_dEBSDByt0" VALUE 0x8052634A RB_Val_Wu8 255.0 OneToOne 0.00 255.0 FORMAT "%5.1" /end CHARACTERISTIC
/begin CHARACTERISTIC Com_dEBSDByt1_C "Calibration for initial value of Com_dEBSDByt1" VALUE 0x8052634B RB_Val_Wu8 255.0 OneToOne 0.00 255.0 FORMAT "%5.1" /end CHARACTERISTIC
/begin CHARACTERISTIC Com_dEBSDByt2_C "Calibration for initial value of Com_dEBSDByt2" VALUE 0x8052634C RB_Val_Wu8 255.0 OneToOne 0.00 255.0 FORMAT "%5.1" /end CHARACTERISTIC
/begin CHARACTERISTIC Com_dEBSDByt3_C "Calibration for initial value of Com_dEBSDByt3" VALUE 0x8052634D RB_Val_Wu8 255.0 OneToOne 0.00 255.0 FORMAT "%5.1" /end CHARACTERISTIC
/begin CHARACTERISTIC Com_dEBSDByt4_C "Calibration for initial value of Com_dEBSDByt4" VALUE 0x8052634E RB_Val_Wu8 255.0 OneToOne 0.00 255.0 FORMAT "%5.1" /end CHARACTERISTIC
/begin CHARACTERISTIC Com_ratSoh_C "Calibration for battery SOH received from EBS" VALUE 0x80526350 RB_Val_Ws16 799.9878 Prc -400.0000 399.9878 FORMAT "%8.4" /end CHARACTERISTIC
/begin CHARACTERISTIC CWBBAGR "intern codeword operating conditions egr" VALUE 0x8051CB88 RB_Val_Wu8 255.0 dez 0.00 255.0 FORMAT "%5.1" /end CHARACTERISTIC
/begin CHARACTERISTIC CWBBAGRA "Codeword for calculation condition EGR-adaptation" VALUE 0x8051CBA0 RB_Val_Wu16 65535.00 dez 0.00 65535.00 FORMAT "%8.2" /end CHARACTERISTIC
/begin CHARACTERISTIC CWBBAGRMW "internal codeword for %BBAGRMW" VALUE 0x8051CBE6 RB_Val_Wu8 255.0 dez 0.00 255.0 FORMAT "%5.1" /end CHARACTERISTIC
/begin CHARACTERISTIC CWBBDIRST "Codeword Bit0 releases starter assisted direct starts" VALUE 0x8051CBF8 RB_Val_Wu8 255.0 dez 0.00 255.0 FORMAT "%5.1" /end CHARACTERISTIC
/begin CHARACTERISTIC CWBBKHFES "Codeword: request on air charge control in due of catalyst heating" VALUE 0x8051CC1E RB_Val_Wu16 65535.00 dez 0.00 65535.00 FORMAT "%8.2" /end CHARACTERISTIC
/begin CHARACTERISTIC CWKSTEBF "Codeword first fueling" VALUE 0x8051D12C RB_Val_Wu8 255.0 dez 0.00 255.0 FORMAT "%5.1" /end CHARACTERISTIC
/begin CHARACTERISTIC CWORING "Codeword for configuration %BBORING" VALUE 0x8051D13C RB_Val_Wu8 255.0 dez 0.00 255.0 FORMAT "%5.1" /end CHARACTERISTIC
/begin CHARACTERISTIC CWTIPIN "Codeword for tip in function" VALUE 0x8051CE5A RB_Val_Wu8 255.0 dez 0.00 255.0 FORMAT "%5.1" /end CHARACTERISTIC
/begin CHARACTERISTIC DMRAGRA "torque reserve during egr adaption" VALUE 0x8051CBA2 RB_Val_Wu16 99.99847 rel_uw_b100 0.00 99.99847 FORMAT "%8.5" /end CHARACTERISTIC
/begin CHARACTERISTIC DMWAGR "value to enable egr mode change" VALUE 0x8051CBE8 RB_Val_Wu16 1535.977 rel_q0p02344 0.00 1535.977 FORMAT "%8.3" /end CHARACTERISTIC
/begin CHARACTERISTIC DNAGRSS "Delta engine speed above reinstatement threshold for release of EGR overrun diagnosis" VALUE 0x8051CBA4 RB_Val_Wu8 10200. nmot_ub_q40 0.00 10200. FORMAT "%5.0" /end CHARACTERISTIC
/begin CHARACTERISTIC DNAGRSSKT "Delta engine speed above reinstatement threshold for release of EGR overrun diagnosis for short test" VALUE 0x8051CBA5 RB_Val_Wu8 10200. nmot_ub_q40 0.00 10200. FORMAT "%5.0" /end CHARACTERISTIC
/begin CHARACTERISTIC DTKANAGR "tans-hysteresis (kelvin) of egr" VALUE 0x8051CB8A RB_Val_Wu16 1535.977 temp_q0p0234 0.00 1535.977 FORMAT "%8.3" /end CHARACTERISTIC
/begin CHARACTERISTIC EBS_qNorm_C "Callibration for battery state of health with respect to charge capacity" VALUE 0x80526352 RB_Val_Ws16 8191.875 ElecChrg_Ah_q0p125_COMPU -4096.000 4095.875 FORMAT "%8.3" /end CHARACTERISTIC
/begin CHARACTERISTIC ExhMgT_facCamsftIntkCatWrm_T "weighting factor for nominal angle of intake camshaft during catalyst warming" CURVE 0x8051CC20 RB_Curve_S16_U8_Static 1.000000 fak_ub_b2 0.00 1.000000 FORMAT "%8.6" EXTENDED_LIMITS 0.00 1.992188
 /begin AXIS_DESCR STD_AXIS ExhMgT_tCatHeatgTCatSelnActn temp_q0p1_K 8 -3276.800 3276.700 FORMAT "%8.3" DEPOSIT ABSOLUTE /end AXIS_DESCR
/end CHARACTERISTIC
/begin CHARACTERISTIC ExhMgT_facCatWrmIntkCamsft_M "Weighting performance characteristics for nominal angle of intake camshaft in dependence of engine temperature and altitude" MAP 0x8051CC3A RB_Map_S16U16_U8 1.000000 fak_ub_b2 0.00 1.000000 FORMAT "%8.6" EXTENDED_LIMITS 0.00 1.992188
 /begin AXIS_DESCR STD_AXIS ExhMgT_tEngCatHeatgFild Temp_Cels 8 -3549.940 3003.560 FORMAT "%8.3" DEPOSIT ABSOLUTE /end AXIS_DESCR
 /begin AXIS_DESCR STD_AXIS PEnv_facCorrAlti fak_uw_b4 4 0.00 3.999939 FORMAT "%8.6" DEPOSIT ABSOLUTE /end AXIS_DESCR
/end CHARACTERISTIC
/begin CHARACTERISTIC ExhMgT_facIntkCamsftAltiCatHeatgAirm_GM "factor for the intake camshaft during cold start in altitude in dependence of heating progress and engine temperature" MAP 0x8051CC76 RB_MapGroup_U8 1.000000 fak_ub_b2 0.00 1.000000 FORMAT "%8.6" EXTENDED_LIMITS 0.00 1.992188
 /begin AXIS_DESCR COM_AXIS ExhMgT_tEngCatHeatgFild Temp_Cels 8 -3549.940 3003.560 FORMAT "%8.3" AXIS_PTS_REF STCS08KHSW /end AXIS_DESCR
 /begin AXIS_DESCR COM_AXIS ExhMgT_facCatHeatgProgs fak_uw_b1 8 0.00 0.9999847 FORMAT "%9.7" AXIS_PTS_REF SIM08KHUW /end AXIS_DESCR
/end CHARACTERISTIC
/begin CHARACTERISTIC ExhMgT_facIntkCamsftAlti_T "altitude correction factor curve for the intake camshaft during cold start" CURVE 0x8051CCB6 RB_Curve_U16_U8_Static 0.9961 fak_ub_b1 0.00 0.9961
 /begin AXIS_DESCR STD_AXIS PEnv_facCorrAlti fak_uw_b4 4 0.00 3.999939 FORMAT "%8.6" DEPOSIT ABSOLUTE /end AXIS_DESCR
/end CHARACTERISTIC
/begin CHARACTERISTIC ExhMgT_facIntkCamsftCatHeatgAirm_GM "factor for intake camshaft during catalyst heating in dependence of heating progress" MAP 0x8051CCC4 RB_MapGroup_U8 1.000000 fak_ub_b2 0.00 1.000000 FORMAT "%8.6" EXTENDED_LIMITS 0.00 1.992188
 /begin AXIS_DESCR COM_AXIS ExhMgT_tEngCatHeatgFild Temp_Cels 8 -3549.940 3003.560 FORMAT "%8.3" AXIS_PTS_REF STCS08KHSW /end AXIS_DESCR
 /begin AXIS_DESCR COM_AXIS ExhMgT_facCatHeatgProgs fak_uw_b1 8 0.00 0.9999847 FORMAT "%9.7" AXIS_PTS_REF SIM08KHUW /end AXIS_DESCR
/end CHARACTERISTIC
/begin CHARACTERISTIC ExhMgT_facLamAltiCatHeatgAirm_GM "factor for the control lambda during cold start in altitude in dependence of heating progress and engine temperature" MAP 0x8051CD04 RB_MapGroup_U8 1.000000 fak_ub_b2 0.00 1.000000 FORMAT "%8.6" EXTENDED_LIMITS 0.00 1.992188
 /begin AXIS_DESCR COM_AXIS ExhMgT_tEngCatHeatgFild Temp_Cels 8 -3549.940 3003.560 FORMAT "%8.3" AXIS_PTS_REF STCS08KHSW /end AXIS_DESCR
 /begin AXIS_DESCR COM_AXIS ExhMgT_facCatHeatgProgs fak_uw_b1 8 0.00 0.9999847 FORMAT "%9.7" AXIS_PTS_REF SIM08KHUW /end AXIS_DESCR
/end CHARACTERISTIC
/begin CHARACTERISTIC ExhMgT_facLamCatHeatgAirm_GM "weighting factor for lambda during catalyst heating in dependence of heating progress" MAP 0x8051CD44 RB_MapGroup_U8 1.000000 fak_ub_b2 0.00 1.000000 FORMAT "%8.6" EXTENDED_LIMITS 0.00 1.992188
 /begin AXIS_DESCR COM_AXIS ExhMgT_tEngCatHeatgFild Temp_Cels 8 -3549.940 3003.560 FORMAT "%8.3" AXIS_PTS_REF STCS08KHSW /end AXIS_DESCR
 /begin AXIS_DESCR COM_AXIS ExhMgT_facCatHeatgProgs fak_uw_b1 8 0.00 0.9999847 FORMAT "%9.7" AXIS_PTS_REF SIM08KHUW /end AXIS_DESCR
/end CHARACTERISTIC
/begin CHARACTERISTIC ExhMgT_facLamCatHeatgRamp_M "Correction factor for the lambda weighinh factor in case of cold start catalyst heating" MAP 0x8051CD84 RB_Map_S16U16_U8 0.9961 fak_ub_b1 0.00 0.9961
 /begin AXIS_DESCR STD_AXIS ExhMgT_tCatHeatgTCatSelnFild temp_q0p1_K 8 -3276.800 3276.700 FORMAT "%8.3" DEPOSIT ABSOLUTE /end AXIS_DESCR
 /begin AXIS_DESCR STD_AXIS ExhMgT_mfExhCat1B1Fild m_uw_b6553p5 8 0.00 6553.500 FORMAT "%8.3" DEPOSIT ABSOLUTE /end AXIS_DESCR
/end CHARACTERISTIC
/begin CHARACTERISTIC ExhMgT_facLamCatWrm_T "control factor for lambda during catalyst warming" CURVE 0x8051CDE8 RB_Curve_S16_U8_Static 1.000000 fak_ub_b2 0.00 1.000000 FORMAT "%8.6" EXTENDED_LIMITS 0.00 1.992188
 /begin AXIS_DESCR STD_AXIS ExhMgT_tCatHeatgTCatSelnActn temp_q0p1_K 8 -3276.800 3276.700 FORMAT "%8.3" DEPOSIT ABSOLUTE /end AXIS_DESCR
/end CHARACTERISTIC
/begin CHARACTERISTIC ExhMgT_facLamCtrlAlti_T "altitude correction factor curve for the control lambda during cold start" CURVE 0x8051CE02 RB_Curve_U16_U8_Static 0.9961 fak_ub_b1 0.00 0.9961
 /begin AXIS_DESCR STD_AXIS PEnv_facCorrAlti fak_uw_b4 4 0.00 3.999939 FORMAT "%8.6" DEPOSIT ABSOLUTE /end AXIS_DESCR
/end CHARACTERISTIC
/begin CHARACTERISTIC ExhMgT_tiFacCatheatgIntkCamsft_C "time to decrease the correction factor for ramping up the intake camshaft measure during catalyst heating" VALUE 0x8051CE10 RB_Val_Wu8 25.4996 zk100msxs_ub_b25p5 0.1004 25.6000 FORMAT "%7.4" EXTENDED_LIMITS 0.100392 25.6000 /end CHARACTERISTIC
/begin CHARACTERISTIC ExhMgT_tiFilMfExhCat1B1_T "Filtertime for exhaust mass flow catalyst 1 bank 1" CURVE 0x8051CE12 RB_Curve_U16_U16 6553.400 t_q0p1 0.100 6553.500 FORMAT "%8.3" EXTENDED_LIMITS 0.00 6553.500
 /begin AXIS_DESCR STD_AXIS ExhMgT_mfExhCat1B1Dif m_uw_b6553p5 4 0.00 6553.500 FORMAT "%8.3" DEPOSIT ABSOLUTE /end AXIS_DESCR
/end CHARACTERISTIC
/begin CHARACTERISTIC ExhMgT_tiFilTCat_T "Filtertime for catalst temperature" CURVE 0x8051CE24 RB_Curve_U16_U16 6553.400 t_q0p1 0.100 6553.500 FORMAT "%8.3" EXTENDED_LIMITS 0.00 6553.500
 /begin AXIS_DESCR STD_AXIS ExhMgT_tCatHeatgTCatSelnActnDif temp_q0p1_K 4 0.00 6553.500 FORMAT "%8.3" DEPOSIT ABSOLUTE /end AXIS_DESCR
/end CHARACTERISTIC
/begin CHARACTERISTIC FNSWLAGR "Threshold to enable EGR due to factor after start and warmup (fsnwl_w)" VALUE 0x8051CB8C RB_Val_Wu16 15.99976 fak_uw_b16 0.00 15.99976 FORMAT "%8.5" /end CHARACTERISTIC
/begin CHARACTERISTIC FuPHi_BreakInitFu_C "High pressure initial fuel" VALUE 0x8051D12E RB_Val_Wu16 131.0700 RBPtCel_p_0p002_1 0.00 131.0700 FORMAT "%8.4" /end CHARACTERISTIC
/begin CHARACTERISTIC FuPHi_BreakStrtActnInitFu_C "High pressure start activtion of fuel" VALUE 0x8051D130 RB_Val_Wu16 131.0700 RBPtCel_p_0p002_1 0.00 131.0700 FORMAT "%8.4" /end CHARACTERISTIC
/begin CHARACTERISTIC IBSUMH.Batt_qSumHiLim_C "Class instance for calculation of Battery current integral ( hi charge efficiency ) / Battery current integral ( hi charge efficiency limit" VALUE 0x8052654C RB_Val_Ws32 4294967.29500 RBPtCel_q_0p001_1 -2147483.64800 2147483.64700 FORMAT "%13.5" /end CHARACTERISTIC
/begin CHARACTERISTIC IBSUMHNR.Batt_qSumHiNRLim_C "Battery current integral wo reset / Battery current integral wo reset" VALUE 0x80526550 RB_Val_Ws32 4294967.29500 RBPtCel_q_0p001_1 -2147483.64800 2147483.64700 FORMAT "%13.5" /end CHARACTERISTIC
/begin CHARACTERISTIC IBSUML.Batt_qSumLoLim_C "Class instance for calculation of Battery current integral ( Low charge efficiency ) / Battery current integral ( Low charge efficiency) limit" VALUE 0x80526554 RB_Val_Ws32 4294967.29500 RBPtCel_q_0p001_1 -2147483.64800 2147483.64700 FORMAT "%13.5" /end CHARACTERISTIC
/begin CHARACTERISTIC IKCtl_agIntkB1Tn_C "time constant for the filtered Actual position cam phase actuator intake camshaft bank1" VALUE 0x8051CE5C RB_Val_Wu16 655.3400 t_q0p01 0.0100 655.3500 FORMAT "%8.4" EXTENDED_LIMITS 0.00 655.3500 /end CHARACTERISTIC
/begin CHARACTERISTIC IKCtl_cntrRefCorrDurn_M "Reference level correction duration when injection noise is detected" MAP 0x8051CE5E RB_Map_S16S16_U8 255.0 dez 0.00 255.0 FORMAT "%5.1"
 /begin AXIS_DESCR STD_AXIS IKCtl_tEna Temp_Cels 6 -3549.940 3003.560 FORMAT "%8.3" DEPOSIT ABSOLUTE /end AXIS_DESCR
 /begin AXIS_DESCR STD_AXIS CEngDsT_tStrt Temp_Cels 6 -3549.940 3003.560 FORMAT "%8.3" DEPOSIT ABSOLUTE /end AXIS_DESCR
/end CHARACTERISTIC
/begin CHARACTERISTIC IKCtl_cntrStrtEnd_C "number of combustions to deactivate knock control after start end" VALUE 0x8051CE9E RB_Val_Wu8 254.0 dez 1.0 255.0 FORMAT "%5.1" EXTENDED_LIMITS 0.00 255.0 /end CHARACTERISTIC
/begin CHARACTERISTIC IKCtl_DlyTnKnkEna_T "Time delay for Condition knock control active" CURVE 0x8051CEA0 RB_Curve_S16_U8_Static 2.550 t_q0p01 0.00 2.550 FORMAT "%5.3"
 /begin AXIS_DESCR STD_AXIS Epm_nEng EngN 6 -16384.00 16383.50 FORMAT "%8.2" DEPOSIT ABSOLUTE /end AXIS_DESCR
/end CHARACTERISTIC
/begin CHARACTERISTIC IKCtl_dnSelnFildGrdt_C "Codeword for selection of filtered gradient" VALUE 0x8051CEB4 RB_Val_Wu8 255.0 dez 0.00 255.0 FORMAT "%5.1" /end CHARACTERISTIC
/begin AXIS_PTS IKCtl_fac04_X_AX "distribution for ethanol-ratio" 0x805578CA fethmnmx_msg RB_Axis_U8 1.992188 fak_ub_b2 4 0.00 1.992188 FORMAT "%8.6" DEPOSIT ABSOLUTE /end AXIS_PTS
/begin CHARACTERISTIC IKCtl_facDlyAdpn_T "IKC: dynamic dalay for the steady state adaptation enable" CURVE 0x8051CEB6 RB_Curve_S16_U8_Static 2.550 t_q0p01 0.00 2.550 FORMAT "%5.3"
 /begin AXIS_DESCR STD_AXIS Epm_nEng EngN 4 -16384.00 16383.50 FORMAT "%8.2" DEPOSIT ABSOLUTE /end AXIS_DESCR
/end CHARACTERISTIC
/begin CHARACTERISTIC IKCtl_facDlyLoadDynDetn_GT "Knock control: delay for dynamic detection" CURVE 0x8051CEC4 RB_CurveGroup_U8 32.00 dez 0.00 32.00 FORMAT "%5.2" EXTENDED_LIMITS 0.00 255.0
 /begin AXIS_DESCR COM_AXIS Epm_nEng EngN 8 -16384.00 16383.50 FORMAT "%8.2" AXIS_PTS_REF IKCtl_nEng08_X_AX /end AXIS_DESCR
/end CHARACTERISTIC
/begin CHARACTERISTIC IKCtl_facFildNGrdt_C "Gain constant for the filtered engine-speed gradient" VALUE 0x8051CECC RB_Val_Wu16 0.9999695 fak_uw_b1 0.0000153 0.9999847 FORMAT "%9.7" EXTENDED_LIMITS 0.00 0.9999847 /end CHARACTERISTIC
/begin CHARACTERISTIC IKCtl_facKnkEna_C "engine speed threshold to enable knock control" VALUE 0x8051CECE RB_Val_Ws16 32767.50 EngN -16384.00 16383.50 FORMAT "%8.2" /end CHARACTERISTIC
/begin CHARACTERISTIC IKCtl_facOffsLoadDynDetn_GT "Knock control: dynamic detection offset factor" CURVE 0x8051CED0 RB_CurveGroup_U8 2.984 fak_ub_b4 1.000 3.984 FORMAT "%5.3" EXTENDED_LIMITS 0.00 3.984
 /begin AXIS_DESCR COM_AXIS AirMod_ratChrgAirCyl rel_uw_q0p0234 4 0.00 1535.977 FORMAT "%8.3" AXIS_PTS_REF IKCtl_ratLoadDy04_X_AX /end AXIS_DESCR
/end CHARACTERISTIC
/begin CHARACTERISTIC IKCtl_facRefCorrnDurnSchtActvd_C "Reference level correction duration when injection noise is detected and catalyst heating is activated" VALUE 0x8051CED4 RB_Val_Wu8 255.0 dez 0.00 255.0 FORMAT "%5.1" /end CHARACTERISTIC
/begin CHARACTERISTIC IKCtl_facSpdAdpn1_C "speed range for adaption maps, Stützstelle 1" VALUE 0x8051CED6 RB_Val_Ws16 32767.50 EngN -16384.00 16383.50 FORMAT "%8.2" /end CHARACTERISTIC
/begin CHARACTERISTIC IKCtl_facSpdAdpn2_C "speed range for adaption maps, Stützstelle 2" VALUE 0x8051CED8 RB_Val_Ws16 32767.50 EngN -16384.00 16383.50 FORMAT "%8.2" /end CHARACTERISTIC
/begin CHARACTERISTIC IKCtl_facSpdAdpn3_C "speed range for adaption maps, Stützstelle 3" VALUE 0x8051CEDA RB_Val_Ws16 32767.50 EngN -16384.00 16383.50 FORMAT "%8.2" /end CHARACTERISTIC
/begin CHARACTERISTIC IKCtl_facSpdAdpn4_C "speed range for adaption maps, Stützstelle 4" VALUE 0x8051CEDC RB_Val_Ws16 32767.50 EngN -16384.00 16383.50 FORMAT "%8.2" /end CHARACTERISTIC
/begin CHARACTERISTIC IKCtl_facThdInltVlvDyn_GT "Threshold for the detection of the inlet valve dynamic" CURVE 0x8051CEDE RB_CurveGroup_S16 1023.984 kw_q0p0156 -512.0000 511.9844 FORMAT "%8.4"
 /begin AXIS_DESCR COM_AXIS Epm_nEng EngN 8 -16384.00 16383.50 FORMAT "%8.2" AXIS_PTS_REF IKCtl_nEng08_X_AX /end AXIS_DESCR
/end CHARACTERISTIC
/begin CHARACTERISTIC IKCtl_facThdLoadDynDetnAirChrg_GM "Threshold for dynamic presetting values based on relative air charge in the cylinder" MAP 0x8051CEEE RB_MapGroup_U16 1535.977 rel_uw_q0p0234 0.00 1535.977 FORMAT "%8.3"
 /begin AXIS_DESCR COM_AXIS Epm_nEng EngN 13 -16384.00 16383.50 FORMAT "%8.2" AXIS_PTS_REF IKCtl_nEngVar13_X_AX /end AXIS_DESCR
 /begin AXIS_DESCR COM_AXIS AirMod_ratChrgAirCyl rel_uw_q0p0234 4 0.00 1535.977 FORMAT "%8.3" AXIS_PTS_REF IKCtl_ratLoadDy04_X_AX /end AXIS_DESCR
/end CHARACTERISTIC
/begin CHARACTERISTIC IKCtl_facThdLoadDynDetn_GT "Threshold for dynamic presetting values" MAP 0x8051CF56 RB_MapGroup_S8 1270. p_q10 0.00 1270. FORMAT "%5.0" EXTENDED_LIMITS -1280. 1270.
 /begin AXIS_DESCR COM_AXIS Epm_nEng EngN 13 -16384.00 16383.50 FORMAT "%8.2" AXIS_PTS_REF IKCtl_nEngVar13_X_AX /end AXIS_DESCR
 /begin AXIS_DESCR COM_AXIS AirMod_ratChrgAirCyl rel_uw_q0p0234 4 0.00 1535.977 FORMAT "%8.3" AXIS_PTS_REF IKCtl_ratLoadDy04_X_AX /end AXIS_DESCR
/end CHARACTERISTIC
/begin CHARACTERISTIC IKCtl_facThdNDynDetn_GT "threshold revolution gradient for dynamics detection" CURVE 0x8051CF8A RB_CurveGroup_S8 25500. nmotg_sb_q100 -12800. 12700. FORMAT "%5.0"
 /begin AXIS_DESCR COM_AXIS Epm_nEng EngN 13 -16384.00 16383.50 FORMAT "%8.2" AXIS_PTS_REF IKCtl_nEngVar13_X_AX /end AXIS_DESCR
/end CHARACTERISTIC
/begin CHARACTERISTIC IKCtl_facTiLoadDynAdpnFFV_GM "number of ignition per cyl. during knock control load dynamic" MAP 0x8051CF97 RB_MapGroup_U8 2.540 t_q0p01 0.010 2.550 FORMAT "%5.3" EXTENDED_LIMITS 0.00 2.550
 /begin AXIS_DESCR COM_AXIS Epm_nEng EngN 8 -16384.00 16383.50 FORMAT "%8.2" AXIS_PTS_REF IKCtl_nEng08_X_AX /end AXIS_DESCR
 /begin AXIS_DESCR COM_AXIS fethmnmx_msg fak_ub_b2 4 0.00 1.992188 FORMAT "%8.6" AXIS_PTS_REF IKCtl_fac04_X_AX /end AXIS_DESCR
/end CHARACTERISTIC
/begin CHARACTERISTIC IKCtl_facTiLoadDynDetnFFV_GM "number of ignition per cyl. during knock control load dynamic" MAP 0x8051CFB7 RB_MapGroup_U8 2.540 t_q0p01 0.010 2.550 FORMAT "%5.3" EXTENDED_LIMITS 0.00 2.550
 /begin AXIS_DESCR COM_AXIS Epm_nEng EngN 8 -16384.00 16383.50 FORMAT "%8.2" AXIS_PTS_REF IKCtl_nEng08_X_AX /end AXIS_DESCR
 /begin AXIS_DESCR COM_AXIS fethmnmx_msg fak_ub_b2 4 0.00 1.992188 FORMAT "%8.6" AXIS_PTS_REF IKCtl_fac04_X_AX /end AXIS_DESCR
/end CHARACTERISTIC
/begin CHARACTERISTIC IKCtl_facTiNDynDetn_GT "Knock control: time for engine speed dynamic action on knock detection" CURVE 0x8051CFD7 RB_CurveGroup_U8 2.540 t_q0p01 0.010 2.550 FORMAT "%5.3" EXTENDED_LIMITS 0.00 2.550
 /begin AXIS_DESCR COM_AXIS Epm_nEng EngN 8 -16384.00 16383.50 FORMAT "%8.2" AXIS_PTS_REF IKCtl_nEng08_X_AX /end AXIS_DESCR
/end CHARACTERISTIC
/begin CHARACTERISTIC IKCtl_facTThdAdpn_GT "curve engine temperature threshold for adaptive knock control" CURVE 0x8051CFE0 RB_CurveGroup_S16 6553.500 Temp_Cels -3549.940 3003.560 FORMAT "%8.3"
 /begin AXIS_DESCR COM_AXIS fethmnmx_msg fak_ub_b2 4 0.00 1.992188 FORMAT "%8.6" AXIS_PTS_REF IKCtl_fac04_X_AX /end AXIS_DESCR
/end CHARACTERISTIC
/begin CHARACTERISTIC IKCtl_facTThdDyn_C "engine temperature threshold to enable load dynamic adaptation" VALUE 0x8051CFE8 RB_Val_Wu16 191.5000 Temp_Cels -48.0400 143.4600 FORMAT "%8.4" EXTENDED_LIMITS -273.1400 6280.360 /end CHARACTERISTIC
/begin CHARACTERISTIC IKCtl_facTThdKnk_GT "curve engine-temperature threshold to enable knock control" CURVE 0x8051CFEA RB_CurveGroup_S16 6553.500 Temp_Cels -3549.940 3003.560 FORMAT "%8.3"
 /begin AXIS_DESCR COM_AXIS fethmnmx_msg fak_ub_b2 4 0.00 1.992188 FORMAT "%8.6" AXIS_PTS_REF IKCtl_fac04_X_AX /end AXIS_DESCR
/end CHARACTERISTIC
/begin CHARACTERISTIC IKCtl_nAdapEna_C "speed below which KC-adaptation is freezed" VALUE 0x8051CFF2 RB_Val_Ws16 32767.50 EngN -16384.00 16383.50 FORMAT "%8.2" /end CHARACTERISTIC
/begin CHARACTERISTIC IKCtl_nEnaInjDetn_C "engine speed threshold to activate injection noise detection" VALUE 0x8051CFF4 RB_Val_Ws16 32767.50 EngN -16384.00 16383.50 FORMAT "%8.2" /end CHARACTERISTIC
/begin AXIS_PTS IKCtl_nEng08_X_AX "KC: Datapoint distribution engine speed of group B" 0x80557902 Epm_nEng RB_Axis_S16 32767.50 EngN 8 -16384.00 16383.50 FORMAT "%8.2" DEPOSIT ABSOLUTE /end AXIS_PTS
/begin AXIS_PTS IKCtl_nEngVar13_X_AX "KC: Datapoint distribution engine speed of group A" 0x80557930 Epm_nEng RB_Axis_S16 32767.50 EngN 13 -16384.00 16383.50 FORMAT "%8.2" DEPOSIT ABSOLUTE /end AXIS_PTS
/begin CHARACTERISTIC IKCtl_nSpdHys_C "n hysterisis for adaptation maps" VALUE 0x8051CFF6 RB_Val_Ws16 32767.50 EngN -16384.00 16383.50 FORMAT "%8.2" /end CHARACTERISTIC
/begin CHARACTERISTIC IKCtl_ratAirLoadThdN_GT "Air load treshold based on engine speed for fast ignition advance" CURVE 0x8051CFF8 RB_CurveGroup_U16 1535.977 rel_uw_q0p0234 0.00 1535.977 FORMAT "%8.3"
 /begin AXIS_DESCR COM_AXIS Epm_nEng EngN 8 -16384.00 16383.50 FORMAT "%8.2" AXIS_PTS_REF IKCtl_nEng08_X_AX /end AXIS_DESCR
/end CHARACTERISTIC
/begin CHARACTERISTIC IKCtl_ratEnaInjDetn_C "load threshold to activate injection noise detection" VALUE 0x8051D008 RB_Val_Wu16 1535.977 rel_uw_q0p0234 0.00 1535.977 FORMAT "%8.3" /end CHARACTERISTIC
/begin CHARACTERISTIC IKCtl_ratHysLoad_C "load hysterisis for adaptation maps" VALUE 0x8051D00A RB_Val_Wu16 1535.977 rel_uw_q0p0234 0.00 1535.977 FORMAT "%8.3" /end CHARACTERISTIC
/begin AXIS_PTS IKCtl_ratLoadDy04_X_AX "basepoint distribution of rl, 4 basepoints" 0x80557972 AirMod_ratChrgAirCyl RB_Axis_U16 1535.977 rel_uw_q0p0234 4 0.00 1535.977 FORMAT "%8.3" DEPOSIT ABSOLUTE /end AXIS_PTS
/begin CHARACTERISTIC IKCtl_ratLoadDynDetnThd_GM "Threshold for filtered gradient of the desired air-charge" MAP 0x8051D00C RB_MapGroup_U16 1535.977 rel_uw_q0p0234 0.00 1535.977 FORMAT "%8.3"
 /begin AXIS_DESCR COM_AXIS Epm_nEng EngN 13 -16384.00 16383.50 FORMAT "%8.2" AXIS_PTS_REF IKCtl_nEngVar13_X_AX /end AXIS_DESCR
 /begin AXIS_DESCR COM_AXIS AirMod_ratChrgAirCyl rel_uw_q0p0234 4 0.00 1535.977 FORMAT "%8.3" AXIS_PTS_REF IKCtl_ratLoadDy04_X_AX /end AXIS_DESCR
/end CHARACTERISTIC
/begin CHARACTERISTIC IKCtl_ratLoadRngAdpnM1_GT "load range for adaption maps 1" CURVE 0x8051D074 RB_CurveGroup_U16 1535.977 rel_uw_q0p0234 0.00 1535.977 FORMAT "%8.3"
 /begin AXIS_DESCR COM_AXIS Epm_nEng EngN 13 -16384.00 16383.50 FORMAT "%8.2" AXIS_PTS_REF IKCtl_nEngVar13_X_AX /end AXIS_DESCR
/end CHARACTERISTIC
/begin CHARACTERISTIC IKCtl_ratLoadRngAdpnM2_GT "load range for adaption maps 2" CURVE 0x8051D08E RB_CurveGroup_U16 1535.977 rel_uw_q0p0234 0.00 1535.977 FORMAT "%8.3"
 /begin AXIS_DESCR COM_AXIS Epm_nEng EngN 13 -16384.00 16383.50 FORMAT "%8.2" AXIS_PTS_REF IKCtl_nEngVar13_X_AX /end AXIS_DESCR
/end CHARACTERISTIC
/begin CHARACTERISTIC IKCtl_ratLoadRngAdpnM3_GT "load range for adaption maps 3" CURVE 0x8051D0A8 RB_CurveGroup_U16 1535.977 rel_uw_q0p0234 0.00 1535.977 FORMAT "%8.3"
 /begin AXIS_DESCR COM_AXIS Epm_nEng EngN 13 -16384.00 16383.50 FORMAT "%8.2" AXIS_PTS_REF IKCtl_nEngVar13_X_AX /end AXIS_DESCR
/end CHARACTERISTIC
/begin CHARACTERISTIC IKCtl_ratLoadThd_GT "load-signal threshold knock control" CURVE 0x8051D0C2 RB_CurveGroup_U16 1535.977 rel_uw_q0p0234 0.00 1535.977 FORMAT "%8.3"
 /begin AXIS_DESCR COM_AXIS Epm_nEng EngN 13 -16384.00 16383.50 FORMAT "%8.2" AXIS_PTS_REF IKCtl_nEngVar13_X_AX /end AXIS_DESCR
/end CHARACTERISTIC
/begin CHARACTERISTIC IKCtl_stEnaInjDetn_C "code word activate injection noise detection" VALUE 0x8051D0DC RB_Val_Wu8 255.0 dez 0.00 255.0 FORMAT "%5.1" /end CHARACTERISTIC
/begin CHARACTERISTIC IKCtl_stSelnDesLoadFilGrdt_C "Codeword for selection of the desired load-filtered-gradient" VALUE 0x8051D0DD RB_Val_Wu8 255.0 OneToOne 0.00 255.0 FORMAT "%5.1" /end CHARACTERISTIC
/begin CHARACTERISTIC IKCtl_stSelnFildAirChrgGrdt_C "Codeword for selection of filtered relative air-charge gradient" VALUE 0x8051D0DE RB_Val_Wu8 255.0 OneToOne 0.00 255.0 FORMAT "%5.1" /end CHARACTERISTIC
/begin CHARACTERISTIC IKCtl_tiAddlOffsWinBgnInjNoiseDetn_T "Additional offset knock measurement window begin time for injection noise detection" CURVE 0x8051D0E0 RB_Curve_S16_U16_Static 65.53500 t_q0p001_ms 0.00 65.53500 FORMAT "%8.5"
 /begin AXIS_DESCR STD_AXIS Epm_nEng EngN 4 -16384.00 16383.50 FORMAT "%8.2" DEPOSIT ABSOLUTE /end AXIS_DESCR
/end CHARACTERISTIC
/begin CHARACTERISTIC IKCtl_tiAddlOffsWinEndInjNoiseDetn_T "Additional offset knock measurement window end time for injection noise detection" CURVE 0x8051D0F2 RB_Curve_S16_U16_Static 65.53500 t_q0p001_ms 0.00 65.53500 FORMAT "%8.5"
 /begin AXIS_DESCR STD_AXIS Epm_nEng EngN 4 -16384.00 16383.50 FORMAT "%8.2" DEPOSIT ABSOLUTE /end AXIS_DESCR
/end CHARACTERISTIC
/begin CHARACTERISTIC IKCtl_tInltVlvAirTThd_C "threshold for temperature at inlet valve for tipin detection" VALUE 0x8051D104 RB_Val_Wu16 1535.977 temp_q0p0234_o273 -273.150 1262.827 FORMAT "%8.3" /end CHARACTERISTIC
/begin CHARACTERISTIC IKCtl_tiOffsWinBgnInjNoiseDetn_T "Offset knock measurement window begin time for injection noise detection" CURVE 0x8051D106 RB_Curve_S16_U16_Static 65.53500 t_q0p001_ms 0.00 65.53500 FORMAT "%8.5"
 /begin AXIS_DESCR STD_AXIS Epm_nEng EngN 4 -16384.00 16383.50 FORMAT "%8.2" DEPOSIT ABSOLUTE /end AXIS_DESCR
/end CHARACTERISTIC
/begin CHARACTERISTIC IKCtl_tiOffsWinEndInjNoiseDetn_T "Offset knock measurement window end time for injection noise detection" CURVE 0x8051D118 RB_Curve_S16_U16_Static 65.53500 t_q0p001_ms 0.00 65.53500 FORMAT "%8.5"
 /begin AXIS_DESCR STD_AXIS Epm_nEng EngN 4 -16384.00 16383.50 FORMAT "%8.2" DEPOSIT ABSOLUTE /end AXIS_DESCR
/end CHARACTERISTIC
/begin CHARACTERISTIC InjSys_pRailHpFltFullDlv_C "pressure threshold fault full delivery" VALUE 0x8051D13E RB_Val_Wu16 131.0700 RBPtCel_p_0p002_1 0.00 131.0700 FORMAT "%8.4" /end CHARACTERISTIC
/begin CHARACTERISTIC KLKWVOTMN1 "Curve minimum angle distance of target cylinder to its ITDC (relevant for runout)" CURVE 0x8051CBFA RB_Curve_U16_U16 6553.500 kw_q0p1 0.00 6553.500 FORMAT "%8.3"
 /begin AXIS_DESCR STD_AXIS BBSTHDR_rlp_w rel_uw_q0p0234 4 0.00 1535.977 FORMAT "%8.3" DEPOSIT ABSOLUTE /end AXIS_DESCR
/end CHARACTERISTIC
/begin CHARACTERISTIC KLKWVZOTMN "Curve minimum angle distance of target cylinder to its ITDC" CURVE 0x8051CC0C RB_Curve_U16_U16 6553.500 kw_q0p1 0.00 6553.500 FORMAT "%8.3"
 /begin AXIS_DESCR STD_AXIS rlploc_w rel_uw_q0p0234 4 0.00 1535.977 FORMAT "%8.3" DEPOSIT ABSOLUTE /end AXIS_DESCR
/end CHARACTERISTIC
/begin CHARACTERISTIC KRLNMDY "Read if change of load / speed range: always or only if dynamics conditions" VALUE 0x8051D12A RB_Val_Wu8 255.0 dez 0.00 255.0 FORMAT "%5.1" /end CHARACTERISTIC
/begin CHARACTERISTIC LAMDIAGR "Threshold to enable EGR due to nominal lambda value from diagnosis functions" VALUE 0x8051CB8E RB_Val_Wu16 15.99976 fak_uw_b16 0.00 15.99976 FORMAT "%8.5" /end CHARACTERISTIC
/begin CHARACTERISTIC LAMKAGR "Threshold to enable EGR due to lambda setpoint for catalyst purge" VALUE 0x8051CB90 RB_Val_Wu16 15.99976 fak_uw_b16 0.00 15.99976 FORMAT "%8.5" /end CHARACTERISTIC
/begin CHARACTERISTIC LAMNSWAGR "Threshold to enable EGR due to nominal lambda value after start and warmup." VALUE 0x8051CB92 RB_Val_Wu16 15.99976 fak_uw_b16 0.00 15.99976 FORMAT "%8.5" /end CHARACTERISTIC
/begin CHARACTERISTIC MDISAGRSMN "min torque in SCH to diable EGR" VALUE 0x8051CBEA RB_Val_Wu16 99.99847 rel_uw_b100 0.00 99.99847 FORMAT "%8.5" /end CHARACTERISTIC
/begin CHARACTERISTIC MSKBAGRKT "min. mass flow egr for aperture correction short test" VALUE 0x8051CBA6 RB_Val_Wu16 6553.500 m_q0p1 0.00 6553.500 FORMAT "%8.3" /end CHARACTERISTIC
/begin CHARACTERISTIC MSKBAGRMN "min. mass flow egr for aperture correction" VALUE 0x8051CBA8 RB_Val_Wu16 6553.500 m_q0p1 0.00 6553.500 FORMAT "%8.3" /end CHARACTERISTIC
/begin CHARACTERISTIC MSKBAGRMX "max. mass flow egr for aperture correction" VALUE 0x8051CBAA RB_Val_Wu16 6553.500 m_q0p1 0.00 6553.500 FORMAT "%8.3" /end CHARACTERISTIC
/begin CHARACTERISTIC MSOFAGRKT "maximum egr mass flow for calculation egr correction short test" VALUE 0x8051CBAC RB_Val_Wu16 6553.500 m_q0p1 0.00 6553.500 FORMAT "%8.3" /end CHARACTERISTIC
/begin CHARACTERISTIC MSOFAGRMN "minimum egr mass flow for calculation egr correction" VALUE 0x8051CBAE RB_Val_Wu16 6553.500 m_q0p1 0.00 6553.500 FORMAT "%8.3" /end CHARACTERISTIC
/begin CHARACTERISTIC MSOFAGRMX "maximum egr mass flow for calculation egr correction" VALUE 0x8051CBB0 RB_Val_Wu16 6553.500 m_q0p1 0.00 6553.500 FORMAT "%8.3" /end CHARACTERISTIC
/begin CHARACTERISTIC NAGRSSMX "max. rpm to enable egr controller (valve cleaning)" VALUE 0x8051CBB2 RB_Val_Wu8 10200. nmot_ub_q40 0.00 10200. FORMAT "%5.0" /end CHARACTERISTIC
/begin CHARACTERISTIC NGRMNAGRSS "Maximum negative gradient engine speed for AGR adaption during fuel cutoff" VALUE 0x8051CBB4 RB_Val_Ws16 32767.00 EngNGrd -16383.50 16383.50 FORMAT "%8.2" EXTENDED_LIMITS -16384.00 16383.50 /end CHARACTERISTIC
/begin CHARACTERISTIC NGRMXAGRSS "Maximum positive gradient engine speed for AGR adaption during fuel cutoff" VALUE 0x8051CBB6 RB_Val_Ws16 32767.00 EngNGrd -16383.50 16383.50 FORMAT "%8.2" EXTENDED_LIMITS -16384.00 16383.50 /end CHARACTERISTIC
/begin CHARACTERISTIC NKSTEBFPF "RPM threshold to break primal fuelling" VALUE 0x8051D132 RB_Val_Wu8 10200. nmot_ub_q40 0.00 10200. FORMAT "%5.0" /end CHARACTERISTIC
/begin CHARACTERISTIC PSREBAMN "partial pressure egr min. to enable aperture correction" VALUE 0x8051CBB8 RB_Val_Wu16 5119.922 p_q0p078 0.00 5119.922 FORMAT "%8.3" /end CHARACTERISTIC
/begin CHARACTERISTIC PSREOAMN "minimum egr pressure for offset adaptation" VALUE 0x8051CBBA RB_Val_Wu16 5119.922 p_q0p078 0.00 5119.922 FORMAT "%8.3" /end CHARACTERISTIC
/begin CHARACTERISTIC PSREOAMNKT "minimum egr pressure for offset adaptation in short test" VALUE 0x8051CBBC RB_Val_Wu16 5119.922 p_q0p078 0.00 5119.922 FORMAT "%8.3" /end CHARACTERISTIC
/begin CHARACTERISTIC PUAGRSS "Ambient pressure for EGR adaption during fuel cutoff" VALUE 0x8051CBBE RB_Val_Wu16 2559.961 p_q0p039 0.00 2559.961 FORMAT "%8.3" /end CHARACTERISTIC
/begin CHARACTERISTIC RRIAGRHMN "minimum egr inertgas rate mass flow in homogeneous mode" VALUE 0x8051CBEC RB_Val_Wu16 99.99847 rel_uw_b100 0.00 99.99847 FORMAT "%8.5" /end CHARACTERISTIC
/begin CHARACTERISTIC RRIAGRHMX "maximum egr inertgas rate mass flow in homogeneous mode" VALUE 0x8051CBEE RB_Val_Wu16 99.99847 rel_uw_b100 0.00 99.99847 FORMAT "%8.5" /end CHARACTERISTIC
/begin CHARACTERISTIC RRIAGRMMN "minimum egr inert gas rate in lean mode" VALUE 0x8051CBF0 RB_Val_Wu16 99.99847 rel_uw_b100 0.00 99.99847 FORMAT "%8.5" /end CHARACTERISTIC
/begin CHARACTERISTIC RRIAGRMMX "maximum egr inert gas rate in lean mode" VALUE 0x8051CBF2 RB_Val_Wu16 99.99847 rel_uw_b100 0.00 99.99847 FORMAT "%8.5" /end CHARACTERISTIC
/begin CHARACTERISTIC RRIAGRSMN "minimum egr inertgas rate in stratified mode" VALUE 0x8051CBF4 RB_Val_Wu16 99.99847 rel_uw_b100 0.00 99.99847 FORMAT "%8.5" /end CHARACTERISTIC
/begin CHARACTERISTIC RRIAGRSMX "maximum egr inertgas rate in stratified mode" VALUE 0x8051CBF6 RB_Val_Wu16 99.99847 rel_uw_b100 0.00 99.99847 FORMAT "%8.5" /end CHARACTERISTIC
/begin AXIS_PTS SIM08KHUW "Distribution of breakpoints of catalyst heating progress (imlpr_w)" 0x8051CE36 ExhMgT_facCatHeatgProgs RB_Axis_U16 0.9999847 fak_uw_b1 8 0.00 0.9999847 FORMAT "%9.7" DEPOSIT ABSOLUTE /end AXIS_PTS
/begin AXIS_PTS STCS08KHSW "Distribution of breakpoints of engine temperature by start (tmstrk_w)" 0x8051CE48 ExhMgT_tEngCatHeatgFild RB_Axis_S16 6553.500 Temp_Cels 8 -3549.940 3003.560 FORMAT "%8.3" DEPOSIT ABSOLUTE /end AXIS_PTS
/begin CHARACTERISTIC TAAGRSS "temperature intake air for EGR adaption during fuel cutoff" VALUE 0x8051CBC0 RB_Val_Wu16 1535.977 temp_q0p0234_o273 -273.150 1262.827 FORMAT "%8.3" /end CHARACTERISTIC
/begin CHARACTERISTIC TAAGRSSKT "temperature intake air for EGR adaption during fuel cutoff (short test)" VALUE 0x8051CBC2 RB_Val_Wu16 1535.977 temp_q0p0234_o273 -273.150 1262.827 FORMAT "%8.3" /end CHARACTERISTIC
/begin CHARACTERISTIC TAGEOAGRMN "Minimum temperature EGR at point of extraction for release EGR" VALUE 0x8051CB94 RB_Val_Wu16 1535.977 temp_q0p0234_o273 -273.150 1262.827 FORMAT "%8.3" /end CHARACTERISTIC
/begin CHARACTERISTIC TAGEOSDFMN "Minimum temperature EGR at point of extraction for release diagnosis during overrun fuel cutoff" VALUE 0x8051CBC4 RB_Val_Wu16 1535.977 temp_q0p0234_o273 -273.150 1262.827 FORMAT "%8.3" /end CHARACTERISTIC
/begin CHARACTERISTIC TAONAGRA "Delay time egr adaptation after egr on" VALUE 0x8051CBC6 RB_Val_Wu8 5.100 t_q0p02 0.00 5.100 FORMAT "%5.3" /end CHARACTERISTIC
/begin CHARACTERISTIC TATIPIN "intake air temperature threshold to enable tip-in function" VALUE 0x8051D12B RB_Val_Wu8 191.3 temp_ub_q0p75_o48 -48.0 143.3 FORMAT "%5.1" /end CHARACTERISTIC
/begin CHARACTERISTIC TDAGRSS "egr valve open time during fuel cut off" VALUE 0x8051CBC8 RB_Val_Wu16 6553.500 t_q0p1 0.00 6553.500 FORMAT "%8.3" /end CHARACTERISTIC
/begin CHARACTERISTIC TDAGRSSKT "egr valve open time during fuel cut off (short test)" VALUE 0x8051CBCA RB_Val_Wu16 6553.500 t_q0p1 0.00 6553.500 FORMAT "%8.3" /end CHARACTERISTIC
/begin CHARACTERISTIC TDBAGRS "delay time for calculation fast egr adaptation" VALUE 0x8051CBCC RB_Val_Wu16 655.3500 t_q0p01 0.00 655.3500 FORMAT "%8.4" /end CHARACTERISTIC
/begin CHARACTERISTIC TDBAGRSKT "delay time for calculation fast egr adaptation (short test)" VALUE 0x8051CBCE RB_Val_Wu16 655.3500 t_q0p01 0.00 655.3500 FORMAT "%8.4" /end CHARACTERISTIC
/begin CHARACTERISTIC TDLAMSBG "delay time for enabeling EGR adaption till lambda reaches 1 after enrichment" VALUE 0x8051CBD0 RB_Val_Wu16 655.3400 t_q0p01 0.0100 655.3500 FORMAT "%8.4" EXTENDED_LIMITS 0.00 655.3500 /end CHARACTERISTIC
/begin CHARACTERISTIC TDOHDRMX "delay time engine cutoff at fault ""full delivery""" VALUE 0x8051D140 RB_Val_Wu8 25.50 t_q0p1 0.00 25.50 FORMAT "%5.2" /end CHARACTERISTIC
/begin CHARACTERISTIC TDUBEVAB "Debouncing time for injector cut-off due to low on-board power supply voltage" VALUE 0x80526354 RB_Val_Wu8 25.50 t_q0p1 0.00 25.50 FORMAT "%5.2" /end CHARACTERISTIC
/begin CHARACTERISTIC THDEVORMN "minimum temperature for hpiv-o-rings while fault ""full delivery""" VALUE 0x8051D141 RB_Val_Wu8 191.3 temp_ub_q0p75_o48 -48.0 143.3 FORMAT "%5.1" /end CHARACTERISTIC
/begin CHARACTERISTIC TKANAGRU "min. air temp. threshold (kelvin) for egr" VALUE 0x8051CB96 RB_Val_Wu16 1535.977 temp_q0p0234_o273 -273.150 1262.827 FORMAT "%8.3" /end CHARACTERISTIC
/begin CHARACTERISTIC TKMAGRO "Upper Tmot threshold (kelvin) for EGR active" VALUE 0x8051CB98 RB_Val_Ws16 6553.500 Temp_Cels -3549.940 3003.560 FORMAT "%8.3" /end CHARACTERISTIC
/begin CHARACTERISTIC TKMAGRSS "engine temperature (kelvin) to enable egr controller (valve cleaning)" VALUE 0x8051CBD2 RB_Val_Wu16 1535.977 temp_q0p0234_o273 -273.150 1262.827 FORMAT "%8.3" /end CHARACTERISTIC
/begin CHARACTERISTIC TKMAGRSSKT "engine temperature (kelvin) to enable egr controller (valve cleaning) Kurztest" VALUE 0x8051CBD4 RB_Val_Wu16 1535.977 temp_q0p0234_o273 -273.150 1262.827 FORMAT "%8.3" /end CHARACTERISTIC
/begin CHARACTERISTIC TKMAGRU "Lower Tmot threshold (kelvin) for EGR active" VALUE 0x8051CB9A RB_Val_Ws16 6553.500 Temp_Cels -3549.940 3003.560 FORMAT "%8.3" /end CHARACTERISTIC
/begin CHARACTERISTIC TKSTEBFAS "Temperature to end after start functions" VALUE 0x8051D133 RB_Val_Wu8 191.3 temp_ub_q0p75_o48 -48.0 143.3 FORMAT "%5.1" /end CHARACTERISTIC
/begin CHARACTERISTIC TKSTEBFIF "Time after that Initial fuelling will be disabled" VALUE 0x8051D134 RB_Val_Wu16 6553.500 t100msxs_uw_b6553p5 0.00 6553.500 FORMAT "%8.3" /end CHARACTERISTIC
/begin CHARACTERISTIC TKSTEBFPAS "Debounce time for high pressure threshold and engine running to stop after start measures" VALUE 0x8051D136 RB_Val_Wu8 25.50 t_q0p1 0.00 25.50 FORMAT "%5.2" /end CHARACTERISTIC
/begin CHARACTERISTIC TKSTEBFPDL "Time of low- or high pressure must be present to end initial fuelling" VALUE 0x8051D137 RB_Val_Wu8 25.50 t_q0p1 0.00 25.50 FORMAT "%5.2" /end CHARACTERISTIC
/begin CHARACTERISTIC TKSTEBFZAS "Time after after-start enrichment will be disabled" VALUE 0x8051D138 RB_Val_Wu16 6553.500 t100msxs_uw_b6553p5 0.00 6553.500 FORMAT "%8.3" /end CHARACTERISTIC
/begin CHARACTERISTIC TMXVAGRSDF "Maximum Temperature before EGR valve as release condition of fast EGR Diagnosis" VALUE 0x8051CBD6 RB_Val_Wu16 1535.977 temp_q0p0234_o273 -273.150 1262.827 FORMAT "%8.3" /end CHARACTERISTIC
/begin CHARACTERISTIC TNSAGRSS "Delay time after engine startend for EGR cut off diagnosis" VALUE 0x8051CBD8 RB_Val_Wu16 6553.500 t_q0p1 0.00 6553.500 FORMAT "%8.3" /end CHARACTERISTIC
/begin CHARACTERISTIC TNSAGRSSKT "Delay time after engine startend for EGR cut off diagnosis for schort trip" VALUE 0x8051CBDA RB_Val_Wu16 6553.500 t_q0p1 0.00 6553.500 FORMAT "%8.3" /end CHARACTERISTIC
/begin CHARACTERISTIC TVAGREVAKT "Delay time for enabling EGR when all injection valves are active again" VALUE 0x8051CB9C RB_Val_Wu16 655.3500 t_q0p01 0.00 655.3500 FORMAT "%8.4" /end CHARACTERISTIC
/begin CHARACTERISTIC TVDAGRST "Time Delay of Diagnosis because of Temperature threshold exceeding" VALUE 0x8051CBDC RB_Val_Wu16 655.3500 t_q0p01 0.00 655.3500 FORMAT "%8.4" /end CHARACTERISTIC
/begin CHARACTERISTIC TVTKAGRA "delay time (turn off) egr adaption enable for test monitor" VALUE 0x8051CBDE RB_Val_Wu16 6553.500 t_q0p1 0.00 6553.500 FORMAT "%8.3" /end CHARACTERISTIC
/begin CHARACTERISTIC TWAGRSS "delay time to enable egr controller" VALUE 0x8051CBE0 RB_Val_Wu16 655.3500 t_q0p01 0.00 655.3500 FORMAT "%8.4" /end CHARACTERISTIC
/begin CHARACTERISTIC TWAGRSSKT "delay time to enable egr controller (short test)" VALUE 0x8051CBE2 RB_Val_Wu16 655.3500 t_q0p01 0.00 655.3500 FORMAT "%8.4" /end CHARACTERISTIC
/begin CHARACTERISTIC UBEVABW "threshold of the battery voltage for the injection valve cutoff" VALUE 0x80526356 RB_Val_Wu16 1538.827 spg_uw_q0p023481 0.00 1538.827 FORMAT "%8.3" /end CHARACTERISTIC
/begin CHARACTERISTIC VAGRSS "vehicle speed to enable egr controller (valve cleaning)" VALUE 0x8051CBE4 RB_Val_Ws16 655.3500 Vel -327.6800 327.6700 FORMAT "%8.4" /end CHARACTERISTIC
/begin CHARACTERISTIC VFZGAGREN "Threshold value above which EGR will be activated" VALUE 0x8051CB9E RB_Val_Ws16 655.3500 Vel -327.6800 327.6700 FORMAT "%8.4" /end CHARACTERISTIC
/begin CHARACTERISTIC VKSTEBFAS "Threshold forvelocity to finish after start conditions with initial fuelling" VALUE 0x8051D13A RB_Val_Wu16 511.9922 vfzgn_uw_b512 0.00 511.9922 FORMAT "%8.4" /end CHARACTERISTIC
/begin MEASUREMENT actkeldyn "Knock control: actual value of characteristic ZKRKELDYN" UBYTE t_q0p01 1 100 0.00 2.550 FORMAT "%5.3" ECU_ADDRESS 0x60014A4E /end MEASUREMENT
/begin MEASUREMENT actkendyn "Knock control: actual value of characteristic ZKRKENDYN" UBYTE t_q0p01 1 100 0.00 2.550 FORMAT "%5.3" ECU_ADDRESS 0x60014A4F /end MEASUREMENT
/begin MEASUREMENT actldyn "Knock control: actual value of characteristic ZKREGLDYN" UBYTE t_q0p01 1 100 0.00 2.550 FORMAT "%5.3" ECU_ADDRESS 0x60014A50 /end MEASUREMENT
/begin MEASUREMENT anztdcctrloc "local variable for the calculation ofAmount of discharged injections" UBYTE B_TRUE 1 100 0.00 1.00000000000 BIT_MASK 0x1 FORMAT "%13.11" ECU_ADDRESS 0x6000014E /end MEASUREMENT
/begin MEASUREMENT BattU_cntrEngRun "Engine run counter" UWORD OneToOne 1 100 0.00 65535.00 FORMAT "%8.2" ECU_ADDRESS 0x600080D4 /end MEASUREMENT
/begin MEASUREMENT BattU_cntrMax "Maximum value counter" UWORD OneToOne 1 100 0.00 65535.00 FORMAT "%8.2" ECU_ADDRESS 0x600080D2 /end MEASUREMENT
/begin MEASUREMENT BattU_cntrReIni "Control ReInitialization" UBYTE OneToOne 1 100 0.00 255.0 FORMAT "%5.1" ECU_ADDRESS 0x6000F184 /end MEASUREMENT
/begin MEASUREMENT BattU_facCor "Correction factor for battery voltage" SWORD Fact 1 100 -4.000000 3.999878 FORMAT "%8.6" ECU_ADDRESS 0x60009BE4 /end MEASUREMENT
/begin MEASUREMENT BattU_flgBoostActvnCdn "Boost activation condition" UBYTE B_TRUE 1 100 0.00 1.00000000000 BIT_MASK 0x1 FORMAT "%13.11" ECU_ADDRESS 0x6000FA49 /end MEASUREMENT
/begin MEASUREMENT BattU_flgBoostOffCond "Boost off condition flag" UBYTE B_TRUE 1 100 0.00 1.00000000000 BIT_MASK 0x1 FORMAT "%13.11" ECU_ADDRESS 0x6000F18A /end MEASUREMENT
/begin MEASUREMENT BattU_flgChrgrCnctd "Flag indicates the charger is connected" UBYTE B_TRUE 1 100 0.00 1.00000000000 BIT_MASK 0x1 FORMAT "%13.11" ECU_ADDRESS 0x6000F183 /end MEASUREMENT
/begin MEASUREMENT BattU_flgCntrLim "Counter limit flag" UBYTE B_TRUE 1 100 0.00 1.00000000000 BIT_MASK 0x1 FORMAT "%13.11" ECU_ADDRESS 0x6000F189 /end MEASUREMENT
/begin MEASUREMENT BattU_flgEEPWriteRetVal "EEP write block status BATTUSTBYDIA" UBYTE B_TRUE 1 100 0.00 1.00000000000 BIT_MASK 0x1 FORMAT "%13.11" ECU_ADDRESS 0x600008AC /end MEASUREMENT
/begin MEASUREMENT BattU_flgErrDSQ "Temp flag signal indicates low under voltage" UBYTE B_TRUE 1 100 0.00 1.00000000000 BIT_MASK 0x1 FORMAT "%13.11" ECU_ADDRESS 0x6000F182 /end MEASUREMENT
/begin MEASUREMENT BattU_flgHiUFailrCfmd "Battery voltage high failure confirmed flag" UBYTE B_TRUE 1 100 0.00 1.00000000000 BIT_MASK 0x1 FORMAT "%13.11" ECU_ADDRESS 0x6000FA48 /end MEASUREMENT
/begin MEASUREMENT BattU_flgHiUNormCfmd "Battery voltage high normal confirmed flag" UBYTE B_TRUE 1 100 0.00 1.00000000000 BIT_MASK 0x1 FORMAT "%13.11" ECU_ADDRESS 0x6000FA47 /end MEASUREMENT
/begin MEASUREMENT BattU_flgIgnOnDlyDiagEna "Ignition delay for diagnosis enable" UBYTE B_TRUE 1 100 0.00 1.00000000000 BIT_MASK 0x1 FORMAT "%13.11" ECU_ADDRESS 0x6000F181 /end MEASUREMENT
/begin MEASUREMENT BattU_flgLoUFailrCfmd "Battery voltage low failure confirmed flag" UBYTE B_TRUE 1 100 0.00 1.00000000000 BIT_MASK 0x1 FORMAT "%13.11" ECU_ADDRESS 0x6000FA46 /end MEASUREMENT
/begin MEASUREMENT BattU_flgLoUNormCfmd "Battery voltage low normal confirmed flag" UBYTE B_TRUE 1 100 0.00 1.00000000000 BIT_MASK 0x1 FORMAT "%13.11" ECU_ADDRESS 0x6000FA45 /end MEASUREMENT
/begin MEASUREMENT BattU_flgPwrFail "Flag for interruption of power supply" UBYTE B_TRUE 1 100 0.00 1.00000000000 BIT_MASK 0x1 FORMAT "%13.11" ECU_ADDRESS 0x6000F6CE /end MEASUREMENT
/begin MEASUREMENT Battu_flgRstrtReq "Engine restart request from engine-stall or IS restart" UBYTE B_TRUE 1 100 0.00 1.00000000000 BIT_MASK 0x1 FORMAT "%13.11" ECU_ADDRESS 0x6000F188 /end MEASUREMENT
/begin MEASUREMENT BattU_flgStrtBoostActvn "Starter boost activation flag" UBYTE B_TRUE 1 100 0.00 1.00000000000 BIT_MASK 0x1 FORMAT "%13.11" ECU_ADDRESS 0x6000F187 /end MEASUREMENT
/begin MEASUREMENT BattU_NrEveCntr "Error counter for DFC" UWORD OneToOne 1 100 0.00 65535.00 FORMAT "%8.2" ECU_ADDRESS 0x6000056C /end MEASUREMENT
/begin MEASUREMENT BattU_PrevErrSt "Status of perivous error state" UBYTE B_TRUE 1 100 0.00 1.00000000000 BIT_MASK 0x1 FORMAT "%13.11" ECU_ADDRESS 0x600008AB /end MEASUREMENT
/begin MEASUREMENT BattU_SensBuf "Sensor Buffer" SWORD Volt 1 100 -6553.600 6553.400 FORMAT "%8.3" ARRAY_SIZE 11 ECU_ADDRESS 0x600080D6 /end MEASUREMENT
/begin MEASUREMENT BattU_SensBufLoc "Intermediate buffer for sorting values from ADC" SWORD Volt 1 100 -6553.600 6553.400 FORMAT "%8.3" ARRAY_SIZE 11 ECU_ADDRESS 0x5000546C /end MEASUREMENT
/begin MEASUREMENT BattU_stCSTEnbl_mp "Status of CST Enable" UBYTE B_TRUE 1 100 0.00 1.00000000000 BIT_MASK 0x1 FORMAT "%13.11" ECU_ADDRESS 0x7000A821 /end MEASUREMENT
/begin MEASUREMENT BattU_stDiagCmpl_mp "Status of Diagnosis Complete" UBYTE B_TRUE 1 100 0.00 1.00000000000 BIT_MASK 0x1 FORMAT "%13.11" ECU_ADDRESS 0x7000A820 /end MEASUREMENT
/begin MEASUREMENT BattU_stEEPBlockRetVal "EEP read block Status of BATTUSTBYDIA" UBYTE OneToOne 1 100 0.00 255.0 FORMAT "%5.1" ECU_ADDRESS 0x6000F185 /end MEASUREMENT
/begin MEASUREMENT BattU_stEepEveCnt "EEP read Status of defect counter" UBYTE OneToOne 1 100 0.00 255.0 FORMAT "%5.1" ECU_ADDRESS 0x600008AD /end MEASUREMENT
/begin MEASUREMENT BattU_stEepPrevErr "EEP read Status of Pervious erorr state" UBYTE OneToOne 1 100 0.00 255.0 FORMAT "%5.1" ECU_ADDRESS 0x600008AE /end MEASUREMENT
/begin MEASUREMENT BattU_stEngCmbCmpl "Engine combustion complete flag" UBYTE OneToOne 1 100 0.00 255.0 FORMAT "%5.1" ECU_ADDRESS 0x6000FFDC /end MEASUREMENT
/begin MEASUREMENT BattU_stErrDSQ "Signal indicates low under voltage" UBYTE OneToOne 1 100 0.00 255.0 FORMAT "%5.1" ECU_ADDRESS 0x6000FFDB /end MEASUREMENT
/begin MEASUREMENT BattU_stFltTstEnaCond_mp "Status of Fault Test Enable Condition" UBYTE B_TRUE 1 100 0.00 1.00000000000 BIT_MASK 0x1 FORMAT "%13.11" ECU_ADDRESS 0x7000A81F /end MEASUREMENT
/begin MEASUREMENT BattU_stFltTstRst_mp "Status of Fault Test Reset" UBYTE B_TRUE 1 100 0.00 1.00000000000 BIT_MASK 0x1 FORMAT "%13.11" ECU_ADDRESS 0x7000A81E /end MEASUREMENT
/begin MEASUREMENT BattU_stIgnBoostActvn "Ignition boost activation state" UBYTE OneToOne 1 100 0.00 255.0 FORMAT "%5.1" ECU_ADDRESS 0x6000F186 /end MEASUREMENT
/begin MEASUREMENT BattU_stPwrFail "State interruption of power supply" UBYTE B_TRUE 1 100 0.00 1.00000000000 BIT_MASK 0x1 FORMAT "%13.11" ECU_ADDRESS 0x6000F6CD /end MEASUREMENT
/begin MEASUREMENT BattU_stStabPs "Status of boost converter activation" UBYTE B_TRUE 1 100 0.00 1.00000000000 BIT_MASK 0x1 FORMAT "%13.11" ECU_ADDRESS 0x6000FA44 /end MEASUREMENT
/begin MEASUREMENT BattU_tiCSTDef_mp "CST Defect time" SWORD Time_ms 1 100 -327680.0 327670.0 FORMAT "%8.1" ECU_ADDRESS 0x7000A81C /end MEASUREMENT
/begin MEASUREMENT Battu_tiCSTWarrant "CST warrant delay timer to avoid On-Off-On in short time" UWORD Time_ms 1 100 0.00 655350.0 FORMAT "%8.1" ECU_ADDRESS 0x600080D0 /end MEASUREMENT
/begin MEASUREMENT BattU_u "Battery voltage" SWORD Volt_Batt 1 100 -655360.0 655340.0 FORMAT "%8.1" ECU_ADDRESS 0x50005C92 /end MEASUREMENT
/begin MEASUREMENT BattU_uBattDetnIMGCnv "Battery detection voltage of IMG ECU convert to mV" SWORD Volt_Batt 1 100 -655360.0 655340.0 FORMAT "%8.1" ECU_ADDRESS 0x600080CE /end MEASUREMENT
/begin MEASUREMENT BattU_uBattDetnTCUCnv "Battery detection voltage of TCU ECU convert to mV" SWORD Volt_Batt 1 100 -655360.0 655340.0 FORMAT "%8.1" ECU_ADDRESS 0x600080CC /end MEASUREMENT
/begin MEASUREMENT BattU_uRated "Rated battery voltage" SWORD Volt_Batt 1 100 -655360.0 655340.0 FORMAT "%8.1" ECU_ADDRESS 0x60009BE2 /end MEASUREMENT
/begin MEASUREMENT BattU_uRaw "Battery voltage before defect detection and handling" SWORD Volt 1 100 -6553.600 6553.400 FORMAT "%8.3" ECU_ADDRESS 0x60009BE0 /end MEASUREMENT
/begin MEASUREMENT BattU_uRaw_mp "Raw battery voltage measuring point" SWORD Volt 1 100 -6553.600 6553.400 FORMAT "%8.3" ECU_ADDRESS 0x7000A822 /end MEASUREMENT
/begin MEASUREMENT BattU_uSens "Sensed battery voltage" SWORD Volt_Batt 1 100 -655360.0 655340.0 FORMAT "%8.1" ECU_ADDRESS 0x60014782 /end MEASUREMENT
/begin MEASUREMENT BattU_uSnsrFild "Filtered battery sensored voltage" SWORD Volt_Batt 1 100 -655360.0 655340.0 FORMAT "%8.1" ECU_ADDRESS 0x60009BDE /end MEASUREMENT
/begin MEASUREMENT Batt_bEngStopEna "stop enable by battery sensor" UBYTE B_TRUE 1 100 0.00 1.00000000000 BIT_MASK 0x1 FORMAT "%13.11" ECU_ADDRESS 0x6000FA43 /end MEASUREMENT
/begin MEASUREMENT Batt_bEngStrtReq "start request by battery sensor" UBYTE B_TRUE 1 100 0.00 1.00000000000 BIT_MASK 0x1 FORMAT "%13.11" ECU_ADDRESS 0x6000FA42 /end MEASUREMENT
/begin MEASUREMENT Batt_cntrIniDrv100ms "Drive enter counter 100ms" UBYTE OneToOne 1 100 0.00 255.0 FORMAT "%5.1" ECU_ADDRESS 0x6000F180 /end MEASUREMENT
/begin MEASUREMENT Batt_cntrIniDrv10ms "Drive enter counter 10ms" UBYTE OneToOne 1 100 0.00 255.0 FORMAT "%5.1" ECU_ADDRESS 0x6000F17F /end MEASUREMENT
/begin MEASUREMENT Batt_cntrOCV "Counter for number of occurences of Low open circuit voltage" UBYTE OneToOne 1 100 0.00 255.0 FORMAT "%5.1" ECU_ADDRESS 0x6000F17E /end MEASUREMENT
/begin MEASUREMENT Batt_cntrStrt "Start counter" UBYTE dez 1 100 0.00 255.0 FORMAT "%5.1" ECU_ADDRESS 0x600397CB /end MEASUREMENT
/begin MEASUREMENT Batt_cntrStrtIn "Start counter for INKA display" SWORD dez 1 100 0.00 32767.00 FORMAT "%8.2" ECU_ADDRESS 0x600080CA /end MEASUREMENT
/begin MEASUREMENT Batt_facHiChrgnEff "High charge efficiency of battery" SWORD Fact1000 1 100 0.00 2.550000 FORMAT "%8.6" ECU_ADDRESS 0x600080C8 /end MEASUREMENT
/begin MEASUREMENT Batt_facLoChrgnEff "Low charge efficiency of battery" SWORD Fact1000 1 100 0.00 2.550000 FORMAT "%8.6" ECU_ADDRESS 0x600080C6 /end MEASUREMENT
/begin MEASUREMENT Batt_flgAltFailr "Alternator related failure status information" UBYTE B_TRUE 1 100 0.00 1.00000000000 BIT_MASK 0x1 FORMAT "%13.11" ECU_ADDRESS 0x6000F16E /end MEASUREMENT
/begin MEASUREMENT Batt_flgBattExch "Battery exchange judgement flag" UBYTE B_TRUE 1 100 0.00 1.00000000000 BIT_MASK 0x1 FORMAT "%13.11" ECU_ADDRESS 0x600397B7 /end MEASUREMENT
/begin MEASUREMENT Batt_flgChrgChartcDgrtDetn "Battery charge charactaristic degradation detection" UBYTE B_TRUE 1 100 0.00 1.00000000000 BIT_MASK 0x1 FORMAT "%13.11" ECU_ADDRESS 0x6003984C /end MEASUREMENT
/begin MEASUREMENT Batt_flgChrgCmpl "Rough estimation of Battery SOC completed information" UBYTE B_TRUE 1 100 0.00 1.00000000000 BIT_MASK 0x1 FORMAT "%13.11" ECU_ADDRESS 0x6000FA41 /end MEASUREMENT
/begin MEASUREMENT Batt_flgChrgILo "Battery charge checking flag" UBYTE B_TRUE 1 100 0.00 1.00000000000 BIT_MASK 0x1 FORMAT "%13.11" ECU_ADDRESS 0x6003984B /end MEASUREMENT
/begin MEASUREMENT Batt_flgChrgMod "Battery is in charging mode state" UBYTE B_TRUE 1 100 0.00 1.00000000000 BIT_MASK 0x1 FORMAT "%13.11" ECU_ADDRESS 0x6000FA40 /end MEASUREMENT
/begin MEASUREMENT Batt_flgCnsChkEna "Consumption check enable flag" UBYTE B_TRUE 1 100 0.00 1.00000000000 BIT_MASK 0x1 FORMAT "%13.11" ECU_ADDRESS 0x6000F17D /end MEASUREMENT
/begin MEASUREMENT Batt_flgCntrExcd "Battery management status 8 completed more than a threshold number of times" UBYTE B_TRUE 1 100 0.00 1.00000000000 BIT_MASK 0x1 FORMAT "%13.11" ECU_ADDRESS 0x600397CA /end MEASUREMENT
/begin MEASUREMENT Batt_flgDarkIAllwCdnAHys "Hysteresis of condition A for Permission to use unsteady dark current status" UBYTE B_TRUE 1 100 0.00 1.00000000000 BIT_MASK 0x1 FORMAT "%13.11" ECU_ADDRESS 0x600397C9 /end MEASUREMENT
/begin MEASUREMENT Batt_flgDarkIAllwCdnBHys "Hysteresis of condition B for Permission to use unsteady dark current status" UBYTE B_TRUE 1 100 0.00 1.00000000000 BIT_MASK 0x1 FORMAT "%13.11" ECU_ADDRESS 0x600397C8 /end MEASUREMENT
/begin MEASUREMENT Batt_flgDarkIAllwCondA "Condition A for Permission to use unsteady dark current status" UBYTE B_TRUE 1 100 0.00 1.00000000000 BIT_MASK 0x1 FORMAT "%13.11" ECU_ADDRESS 0x6000F6CC /end MEASUREMENT
/begin MEASUREMENT Batt_flgDarkIAllwCondB "Condition B for Permission to use unsteady dark current status" UBYTE B_TRUE 1 100 0.00 1.00000000000 BIT_MASK 0x1 FORMAT "%13.11" ECU_ADDRESS 0x6000F6CB /end MEASUREMENT
/begin MEASUREMENT Batt_flgDarkIJudgLo "Flag to indicate if IBSUML or IBSUMH has to be used for judgment of permission to use unsteady dark current" UBYTE B_TRUE 1 100 0.00 1.00000000000 BIT_MASK 0x1 FORMAT "%13.11" ECU_ADDRESS 0x600397C7 /end MEASUREMENT
/begin MEASUREMENT Batt_flgDarkIProhb "Precondition to prohibit use of unsteady dark current" UBYTE B_TRUE 1 100 0.00 1.00000000000 BIT_MASK 0x1 FORMAT "%13.11" ECU_ADDRESS 0x6000FA3F /end MEASUREMENT
/begin MEASUREMENT Batt_flgDarkIUpd "Flag to indicate dark current value during ignition off is reflected in IBSUMH and IBSUML" UBYTE B_TRUE 1 100 0.00 1.00000000000 BIT_MASK 0x1 FORMAT "%13.11" ECU_ADDRESS 0x6000F17C /end MEASUREMENT
/begin MEASUREMENT Batt_flgDeternDetd "Battery deterioration detected" UBYTE B_TRUE 1 100 0.00 1.00000000000 BIT_MASK 0x1 FORMAT "%13.11" ECU_ADDRESS 0x6000F6CA /end MEASUREMENT
/begin MEASUREMENT Batt_flgDoDLimStrtReq "Start request based on DoD of battery charge" UBYTE B_TRUE 1 100 0.00 1.00000000000 BIT_MASK 0x1 FORMAT "%13.11" ECU_ADDRESS 0x6000F16D /end MEASUREMENT
/begin MEASUREMENT Batt_flgDodStopDisbl "Stop disable on DOD" UBYTE B_TRUE 1 100 0.00 1.00000000000 BIT_MASK 0x1 FORMAT "%13.11" ECU_ADDRESS 0x6000F17B /end MEASUREMENT
/begin MEASUREMENT Batt_flgDodStrtReq "Start request on DOD" UBYTE B_TRUE 1 100 0.00 1.00000000000 BIT_MASK 0x1 FORMAT "%13.11" ECU_ADDRESS 0x6000F17A /end MEASUREMENT
/begin MEASUREMENT Batt_flgDrkDchaRst "Dark charge reset from IBSUMHNR" UBYTE B_TRUE 1 100 0.00 1.00000000000 BIT_MASK 0x1 FORMAT "%13.11" ECU_ADDRESS 0x6000F16C /end MEASUREMENT
/begin MEASUREMENT Batt_flgExchJudgCmpl "Flag to indicate Battery exchange judgement is completed in current driving cycle" UBYTE B_TRUE 1 100 0.00 1.00000000000 BIT_MASK 0x1 FORMAT "%13.11" ECU_ADDRESS 0x6000F16A /end MEASUREMENT
/begin MEASUREMENT Batt_flgFullChrg "Battery fuly charged information" UBYTE B_TRUE 1 100 0.00 1.00000000000 BIT_MASK 0x1 FORMAT "%13.11" ECU_ADDRESS 0x6000F179 /end MEASUREMENT
/begin MEASUREMENT Batt_flgIdxUpd "Index of buffer updated for current driving cycle" UBYTE B_TRUE 1 100 0.00 1.00000000000 BIT_MASK 0x1 FORMAT "%13.11" ECU_ADDRESS 0x6000F16B /end MEASUREMENT
/begin MEASUREMENT Batt_flgInhbSpst "Inhibit StopStart from extern" UBYTE B_TRUE 1 100 0.00 1.00000000000 BIT_MASK 0x1 FORMAT "%13.11" ECU_ADDRESS 0x6000F6C9 /end MEASUREMENT
/begin MEASUREMENT Batt_flgISSInhbDcyc "Inhibit ISS for current driving cycle based on battery internal resistance without correction for temperature" UBYTE B_TRUE 1 100 0.00 1.00000000000 BIT_MASK 0x1 FORMAT "%13.11" ECU_ADDRESS 0x6000F169 /end MEASUREMENT
/begin MEASUREMENT Batt_flgJSOrFailr "Flag to indicate a jump start or battery related failure was detected" UBYTE B_TRUE 1 100 0.00 1.00000000000 BIT_MASK 0x1 FORMAT "%13.11" ECU_ADDRESS 0x6000F178 /end MEASUREMENT
/begin MEASUREMENT Batt_flgLimSysFailr "Failure battery system flag" UBYTE B_TRUE 1 100 0.00 1.00000000000 BIT_MASK 0x1 FORMAT "%13.11" ECU_ADDRESS 0x600397B6 /end MEASUREMENT
/begin MEASUREMENT Batt_flgLoSocJdgAftEngRun "Low SOC judgement after engine run" UBYTE B_TRUE 1 100 0.00 1.00000000000 BIT_MASK 0x1 FORMAT "%13.11" ECU_ADDRESS 0x6003984A /end MEASUREMENT
/begin MEASUREMENT Batt_flgOCV "Low OCV detection" UBYTE B_TRUE 1 100 0.00 1.00000000000 BIT_MASK 0x1 FORMAT "%13.11" ECU_ADDRESS 0x60039849 /end MEASUREMENT
/begin MEASUREMENT Batt_flgRawCorrnCmpl "Flag to indicate Dark current correction of IBSUMRAW is completed" UBYTE B_TRUE 1 100 0.00 1.00000000000 BIT_MASK 0x1 FORMAT "%13.11" ECU_ADDRESS 0x6000F177 /end MEASUREMENT
/begin MEASUREMENT Batt_flgRawExe "IBSUMRAW calculation completed status flag" UBYTE B_TRUE 1 100 0.00 1.00000000000 BIT_MASK 0x1 FORMAT "%13.11" ECU_ADDRESS 0x600397C6 /end MEASUREMENT
/begin MEASUREMENT Batt_flgRcvChrgCmpl "Battery recovery charge complete" UBYTE B_TRUE 1 100 0.00 1.00000000000 BIT_MASK 0x1 FORMAT "%13.11" ECU_ADDRESS 0x6000F6C8 /end MEASUREMENT
/begin MEASUREMENT Batt_flgRcvChrgNotCmpl "Battery recovery charge not complete" UBYTE B_TRUE 1 100 0.00 1.00000000000 BIT_MASK 0x1 FORMAT "%13.11" ECU_ADDRESS 0x600397C5 /end MEASUREMENT
/begin MEASUREMENT Batt_flgRInhbISSLoc "Local variable for ISS inhibit based on battery internal resistance without correction for temperature" UBYTE B_TRUE 1 100 0.00 1.00000000000 BIT_MASK 0x1 FORMAT "%13.11" ECU_ADDRESS 0x6000F168 /end MEASUREMENT
/begin MEASUREMENT Batt_flgSetSt8 "Flag to indicate battery management state has entered state 8 before IS" UBYTE B_TRUE 1 100 0.00 1.00000000000 BIT_MASK 0x1 FORMAT "%13.11" ECU_ADDRESS 0x600397C4 /end MEASUREMENT
/begin MEASUREMENT Batt_flgSocCalcn "SOC calculation status" UBYTE B_TRUE 1 100 0.00 1.00000000000 BIT_MASK 0x1 FORMAT "%13.11" ECU_ADDRESS 0x6000F6C7 /end MEASUREMENT
/begin MEASUREMENT Batt_flgSOCDiffDetd "UWABURE detection status flag" UBYTE B_TRUE 1 100 0.00 1.00000000000 BIT_MASK 0x1 FORMAT "%13.11" ECU_ADDRESS 0x60039848 /end MEASUREMENT
/begin MEASUREMENT Batt_flgSOCDiffExcd "Difference between Battery estimated SOC and battery actual SOC exceeds a threshold value" UBYTE B_TRUE 1 100 0.00 1.00000000000 BIT_MASK 0x1 FORMAT "%13.11" ECU_ADDRESS 0x60039847 /end MEASUREMENT
/begin MEASUREMENT Batt_flgSt1Cmpl "Battery management state 1 completed status flag" UBYTE B_TRUE 1 100 0.00 1.00000000000 BIT_MASK 0x1 FORMAT "%13.11" ECU_ADDRESS 0x60039846 /end MEASUREMENT
/begin MEASUREMENT Batt_flgSt1Hist "Flag updates the history of State Transition from ST0 to ST1" UBYTE B_TRUE 1 100 0.00 1.00000000000 BIT_MASK 0x1 FORMAT "%13.11" ECU_ADDRESS 0x6000F176 /end MEASUREMENT
/begin MEASUREMENT Batt_flgSt7Tran "Flag to indicate battery management state has entered state 7" UBYTE B_TRUE 1 100 0.00 1.00000000000 BIT_MASK 0x1 FORMAT "%13.11" ECU_ADDRESS 0x60039845 /end MEASUREMENT
/begin MEASUREMENT Batt_flgSt8Rec "Flag to indicate Transition to BMSTATUS8 in position definition" UBYTE B_TRUE 1 100 0.00 1.00000000000 BIT_MASK 0x1 FORMAT "%13.11" ECU_ADDRESS 0x600397C3 /end MEASUREMENT
/begin MEASUREMENT Batt_flgStalEng "Engine stall detected" UBYTE B_TRUE 1 100 0.00 1.00000000000 BIT_MASK 0x1 FORMAT "%13.11" ECU_ADDRESS 0x6000F175 /end MEASUREMENT
/begin MEASUREMENT Batt_flgStdyCorrnCmpl "Flag to indicate Dark current correction of IBSUMSTDY is completed" UBYTE B_TRUE 1 100 0.00 1.00000000000 BIT_MASK 0x1 FORMAT "%13.11" ECU_ADDRESS 0x6000F174 /end MEASUREMENT
/begin MEASUREMENT Batt_flgTransReas1 "Flag to identify the reason for transition to state 1 from state 0" UBYTE B_TRUE 1 100 0.00 1.00000000000 BIT_MASK 0x1 FORMAT "%13.11" ECU_ADDRESS 0x600397C2 /end MEASUREMENT
/begin MEASUREMENT Batt_idxRDcyc "Internal index for driving cycle buffer" UBYTE OneToOne 1 100 0.00 4.000 FORMAT "%5.3" ECU_ADDRESS 0x60039864 /end MEASUREMENT
/begin MEASUREMENT Batt_lMaxCnsChk "Record point of maximum amount for factory inspection" UWORD OilMlg 1 100 0.00 65535.00 FORMAT "%8.2" ECU_ADDRESS 0x60039898 /end MEASUREMENT
/begin MEASUREMENT Batt_lMinCnsChk "Record point of minimum amount for factory inspection" UWORD OilMlg 1 100 0.00 65535.00 FORMAT "%8.2" ECU_ADDRESS 0x60039896 /end MEASUREMENT
/begin MEASUREMENT Batt_qBattDoD "The DOD of battery during idle stop" SLONG RBPtCel_q_0p001_1 1 100 -2147483.64800 0.00 FORMAT "%13.5" ECU_ADDRESS 0x500010C0 /end MEASUREMENT
/begin MEASUREMENT Batt_qBattFild "Quantity of sensor value battery current" SLONG q0p001_A_s_1 1 100 -2147483.64800 2147483.64700 FORMAT "%13.5" ECU_ADDRESS 0x6000322C /end MEASUREMENT
/begin MEASUREMENT Batt_qCap20 "Battery capacity (20-hour rate)" UWORD q0p01_A_h_1 1 100 0.00 327.6700 FORMAT "%8.4" ECU_ADDRESS 0x6000959A /end MEASUREMENT
/begin MEASUREMENT Batt_qChrgCnsChk "Battery charge amount for factory inspection" SLONG q0p001_A_s_1 1 100 -2147483.64800 2147483.64700 FORMAT "%13.5" ECU_ADDRESS 0x6003990C /end MEASUREMENT
/begin MEASUREMENT Batt_qChrgCnsChkAH "Battery discharge amount for factory inspection" SLONG q0p01_A_h_1 1 100 -21474836.4800 21474836.4700 FORMAT "%13.4" ECU_ADDRESS 0x60039908 /end MEASUREMENT
/begin MEASUREMENT Batt_qCnsChk "The total of battery charge and discharge quantity for factory inspection" SLONG q0p001_A_s_1 1 100 -2147483.64800 2147483.64700 FORMAT "%13.5" ECU_ADDRESS 0x60039904 /end MEASUREMENT
/begin MEASUREMENT Batt_qCnsChkAH "The total of battery charge and discharge quantity for factory inspection in Ah" SLONG q0p01_A_h_1 1 100 -21474836.4800 21474836.4700 FORMAT "%13.4" ECU_ADDRESS 0x60039900 /end MEASUREMENT
/begin MEASUREMENT Batt_qDarkIJudgVal "Judgement value for permission to use unsteady dark current" SLONG RBPtCel_q_0p001_1 1 100 -2147483.64800 2147483.64700 FORMAT "%13.5" ECU_ADDRESS 0x600002A8 /end MEASUREMENT
/begin MEASUREMENT Batt_qDarkJudgValAHi "Hysterisis Upper threshold for dark current allow judgement condition A" SLONG RBPtCel_q_0p001_1 1 100 -2147483.64800 2147483.64700 FORMAT "%13.5" ECU_ADDRESS 0x600002AC /end MEASUREMENT
/begin MEASUREMENT Batt_qDarkJudgValALo "Hysterisis Lower threshold for dark current allow judgement condition A" SLONG RBPtCel_q_0p001_1 1 100 -2147483.64800 2147483.64700 FORMAT "%13.5" ECU_ADDRESS 0x600002B0 /end MEASUREMENT
/begin MEASUREMENT Batt_qDarkJudgValBHi "Hysterisis Upper threshold for dark current allow judgement condition B" SLONG RBPtCel_q_0p001_1 1 100 -2147483.64800 2147483.64700 FORMAT "%13.5" ECU_ADDRESS 0x600002B4 /end MEASUREMENT
/begin MEASUREMENT Batt_qDarkJudgValBLo "Hysterisis Lower threshold for dark current allow judgement condition B" SLONG RBPtCel_q_0p001_1 1 100 -2147483.64800 2147483.64700 FORMAT "%13.5" ECU_ADDRESS 0x600002B8 /end MEASUREMENT
/begin MEASUREMENT Batt_qDchaCnsChk "Battery discharge amount for factory inspection" SLONG q0p001_A_s_1 1 100 -2147483.64800 2147483.64700 FORMAT "%13.5" ECU_ADDRESS 0x600398FC /end MEASUREMENT
/begin MEASUREMENT Batt_qDchaCnsChkAH "Battery discharge amount for factory inspection in Ah" SLONG q0p01_A_h_1 1 100 -21474836.4800 21474836.4700 FORMAT "%13.4" ECU_ADDRESS 0x600398F8 /end MEASUREMENT
/begin MEASUREMENT Batt_qMaxCnsChk "The maximum value of amount for factory inspection" SLONG q0p001_A_s_1 1 100 -2147483.64800 2147483.64700 FORMAT "%13.5" ECU_ADDRESS 0x600398F4 /end MEASUREMENT
/begin MEASUREMENT Batt_qMaxCnsChkAH "The maximum value of amount for factory inspection in Ah" SLONG q0p01_A_h_1 1 100 -21474836.4800 21474836.4700 FORMAT "%13.4" ECU_ADDRESS 0x600398F0 /end MEASUREMENT
/begin MEASUREMENT Batt_qMinCnsChk "The minimum value of amount for factory inspection" SLONG q0p001_A_s_1 1 100 -2147483.64800 2147483.64700 FORMAT "%13.5" ECU_ADDRESS 0x600398EC /end MEASUREMENT
/begin MEASUREMENT Batt_qMinCnsChkAH "The minimum value of amount for factory inspection in Ah" SLONG q0p01_A_h_1 1 100 -21474836.4800 21474836.4700 FORMAT "%13.4" ECU_ADDRESS 0x600398E8 /end MEASUREMENT
/begin MEASUREMENT Batt_qSohTmp1_MP "Temporary calculation 1 of battery state of charge based on SOH" SLONG RBPtCel_q_0p125_1 1 100 -268435456.000 268435455.875 FORMAT "%13.3" ECU_ADDRESS 0x7000A818 /end MEASUREMENT
/begin MEASUREMENT Batt_qSohTmp2_MP "Temporary calculation 2 of battery SOC based on SOH" SLONG RBPtCel_q_0p125_1 1 100 -268435456.000 268435455.875 FORMAT "%13.3" ECU_ADDRESS 0x7000A814 /end MEASUREMENT
/begin MEASUREMENT Batt_qSohTmp3_MP "Temporary calculation 3 of battery state of charge based on SOH" SLONG RBPtCel_q_0p125_1 1 100 -268435456.000 268435455.875 FORMAT "%13.3" ECU_ADDRESS 0x7000A810 /end MEASUREMENT
/begin MEASUREMENT Batt_qSumHi "Battery current integral ( hi charge efficiency )" SLONG RBPtCel_q_0p001_1 1 100 -2147483.64800 2147483.64700 FORMAT "%13.5" ECU_ADDRESS 0x600398E4 /end MEASUREMENT
/begin MEASUREMENT Batt_qSumHiNR "Battery current integral wo reset" SLONG RBPtCel_q_0p001_1 1 100 -2147483.64800 2147483.64700 FORMAT "%13.5" ECU_ADDRESS 0x600398E0 /end MEASUREMENT
/begin MEASUREMENT Batt_qSumLo "Battery current integral ( low charge efficiency )" SLONG RBPtCel_q_0p001_1 1 100 -2147483.64800 2147483.64700 FORMAT "%13.5" ECU_ADDRESS 0x600398DC /end MEASUREMENT
/begin MEASUREMENT Batt_qSumRaw "Battery current integral after position definition state of UWABURE detection" SLONG RBPtCel_q_0p001_1 1 100 -2147483.64800 2147483.64700 FORMAT "%13.5" ECU_ADDRESS 0x600398D4 /end MEASUREMENT
/begin MEASUREMENT Batt_qSumRCINI "Battery current integral for low OCV detection" SLONG RBPtCel_q_0p001_1 1 100 -2147483.64800 2147483.64700 FORMAT "%13.5" ECU_ADDRESS 0x600398D8 /end MEASUREMENT
/begin MEASUREMENT Batt_qSumStdy "Battery current integral in position definition state of UWABURE detection" SLONG RBPtCel_q_0p001_1 1 100 -2147483.64800 2147483.64700 FORMAT "%13.5" ECU_ADDRESS 0x600398D0 /end MEASUREMENT
/begin MEASUREMENT Batt_ratSoc "SOC based on nominal capacity" UBYTE RBPtCel_Perc_0p5_1 1 100 0.00 127.5 FORMAT "%5.1" ECU_ADDRESS 0x6000FFDA /end MEASUREMENT
/begin MEASUREMENT Batt_ratSOCCalc "Battery SOC calculated from Battery current integral" UBYTE RBPtCel_Perc_0p5_1 1 100 0.00 127.5 FORMAT "%5.1" ECU_ADDRESS 0x6000F89A /end MEASUREMENT
/begin MEASUREMENT Batt_ratSoc_MP "Measuring point to view Battery State of Charge" SWORD RBPtCel_Perc_0p5_1 1 100 -16384.00 16383.50 FORMAT "%8.2" ECU_ADDRESS 0x7000A80C /end MEASUREMENT
/begin MEASUREMENT Batt_rBattExchJudg "Resistance for battery exchange judgement" SWORD Resist_mOhm_q0p01 1 100 -327.6800 327.6700 FORMAT "%8.4" ECU_ADDRESS 0x600080C2 /end MEASUREMENT
/begin MEASUREMENT Batt_rBattOld "Internal copy of last battery resistance" SWORD RBPtCel_r_0p00001_1 1 100 -0.3276800 0.3276700 FORMAT "%9.7" ECU_ADDRESS 0x600080C0 /end MEASUREMENT
/begin MEASUREMENT Batt_rDcyc "Internal" SWORD RBPtCel_r_0p00001_1 1 100 -0.3276800 0.3276700 FORMAT "%9.7" ARRAY_SIZE 4 ECU_ADDRESS 0x600397AE /end MEASUREMENT
/begin MEASUREMENT Batt_rExch "Temporary resistance during battery exchange judgement" SWORD Resist_mOhm_q0p01 1 100 -327.6800 327.6700 FORMAT "%8.4" ECU_ADDRESS 0x600397AC /end MEASUREMENT
/begin MEASUREMENT Batt_rMean "Mean battery resistance over driving cycle" SWORD RBPtCel_r_0p00001_1 1 100 -0.3276800 0.3276700 FORMAT "%9.7" ECU_ADDRESS 0x600397AA /end MEASUREMENT
/begin MEASUREMENT Batt_rSlopBattDgrd "Slope for battery internal resistance for battery degradation" SWORD RBPtCel_r_0p00001_1 1 100 -0.3276800 0.3276700 FORMAT "%9.7" ECU_ADDRESS 0x600080BE /end MEASUREMENT
/begin MEASUREMENT Batt_rSlopISSEna "Slope for battery internal resistance for ISS enable" SWORD RBPtCel_r_0p00001_1 1 100 -0.3276800 0.3276700 FORMAT "%9.7" ECU_ADDRESS 0x600080BC /end MEASUREMENT
/begin MEASUREMENT Batt_stBattCodChgID1 "Status of change of battery code to ID1" UBYTE B_TRUE 1 100 0.00 1.00000000000 BIT_MASK 0x1 FORMAT "%13.11" ECU_ADDRESS 0x6000F173 /end MEASUREMENT
/begin MEASUREMENT Batt_stBattCodChgID2 "Status of change of battery code to ID2" UBYTE B_TRUE 1 100 0.00 1.00000000000 BIT_MASK 0x1 FORMAT "%13.11" ECU_ADDRESS 0x6000F172 /end MEASUREMENT
/begin MEASUREMENT Batt_stCalc "Battery SOC calculation state" UBYTE OneToOne 1 100 0.00 255.0 FORMAT "%5.1" ECU_ADDRESS 0x60039863 /end MEASUREMENT
/begin MEASUREMENT Batt_stCalcPrev "Previous Battery SOC calculation state" UBYTE OneToOne 1 100 0.00 255.0 FORMAT "%5.1" ECU_ADDRESS 0x60039862 /end MEASUREMENT
/begin MEASUREMENT Batt_stChrgnIStopEna "Stop enable judgement based on charging current" UBYTE B_TRUE 1 100 0.00 1.00000000000 BIT_MASK 0x1 FORMAT "%13.11" ECU_ADDRESS 0x6000F171 /end MEASUREMENT
/begin MEASUREMENT Batt_stDod "State engine DOD" UBYTE OneToOne 1 100 0.00 255.0 FORMAT "%5.1" ECU_ADDRESS 0x6000F170 /end MEASUREMENT
/begin MEASUREMENT Batt_stEbsBattCod "Status indicating need for battery coding" UBYTE B_TRUE 1 100 0.00 1.00000000000 BIT_MASK 0x1 FORMAT "%13.11" ECU_ADDRESS 0x6000FA3E /end MEASUREMENT
/begin MEASUREMENT Batt_stEbsBattCodLoc "Local value for status indicating need for battery coding" UBYTE OneToOne 1 100 0.00 3.000 FORMAT "%5.3" ECU_ADDRESS 0x600397C1 /end MEASUREMENT
/begin MEASUREMENT Batt_stEngStopInhbn "Reason for stop inhibit (Bit coded)" UWORD OneToOne 1 100 0.00 65535.00 FORMAT "%8.2" ECU_ADDRESS 0x60009598 /end MEASUREMENT
/begin MEASUREMENT Batt_stREBSInhbSpst "Inhibit ISS request due to battery resistance measured by EBS during key-start is invalid" UBYTE B_TRUE 1 100 0.00 1.00000000000 BIT_MASK 0x1 FORMAT "%13.11" ECU_ADDRESS 0x6000F167 /end MEASUREMENT
/begin MEASUREMENT Batt_StrtEnbl_MP "Measurement point for start enable by battery sensor" UBYTE B_TRUE 1 100 0.00 1.00000000000 BIT_MASK 0x1 FORMAT "%13.11" ECU_ADDRESS 0x7000A80B /end MEASUREMENT
/begin MEASUREMENT Batt_stSix "Substate information in battery management state 6" UBYTE OneToOne 1 100 0.00 255.0 FORMAT "%5.1" ECU_ADDRESS 0x600397C0 /end MEASUREMENT
/begin MEASUREMENT Batt_stSoc_MP "Measuring point for Battery SOC received from sensor" UBYTE OneToOne 1 100 0.00 255.0 FORMAT "%5.1" ECU_ADDRESS 0x7000A80A /end MEASUREMENT
/begin MEASUREMENT Batt_stZero "Substate information in battery management state 0" UBYTE OneToOne 1 100 0.00 255.0 FORMAT "%5.1" ECU_ADDRESS 0x6000F16F /end MEASUREMENT
/begin MEASUREMENT Batt_tiCumTi1 "Cumulative time 1" ULONG Time_sec_1 1 100 0.00 429496729.500 FORMAT "%13.3" ECU_ADDRESS 0x600397BC /end MEASUREMENT
/begin MEASUREMENT Batt_tiCumTi2 "Cumulative time 2" ULONG Time_sec_1 1 100 0.00 429496729.500 FORMAT "%13.3" ECU_ADDRESS 0x600397B8 /end MEASUREMENT
/begin MEASUREMENT Batt_uSofOffs "SOF_V precision offset" SWORD spg_q0p0625_V 1 100 -2048.000 2047.938 FORMAT "%8.3" ECU_ADDRESS 0x600080C4 /end MEASUREMENT
/begin MEASUREMENT BBKHFES_ctReIni "local drive cycle counter which is incremented when system state postdrive is left" UBYTE dez 1 100 0.00 255.0 FORMAT "%5.1" ECU_ADDRESS 0x6000F164 /end MEASUREMENT
/begin MEASUREMENT BBSTHDR_rlp_w "rel. air charge predicted for injection calculation (Word)" UWORD rel_uw_q0p0234 1 100 0.00 1535.977 FORMAT "%8.3" ECU_ADDRESS 0x7000320C /end MEASUREMENT
/begin MEASUREMENT B_agrbb_msg "Condition: Exhaust gas recirculation is ready to use" UBYTE B_TRUE 1 100 0.00 1.00000000000 BIT_MASK 0x1 FORMAT "%13.11" ECU_ADDRESS 0x60000257 /end MEASUREMENT
/begin MEASUREMENT B_agrfsg_msg "Condition EGR nominal value of charge is validapplicable (EGR nominal value = EGR actual)" UBYTE B_TRUE 1 100 0.00 1.00000000000 BIT_MASK 0x1 FORMAT "%13.11" ECU_ADDRESS 0x60000255 /end MEASUREMENT
/begin MEASUREMENT B_agrgsg_msg "condition AGR target value enable for throttled manifold state" UBYTE B_TRUE 1 100 0.00 1.00000000000 BIT_MASK 0x1 FORMAT "%13.11" ECU_ADDRESS 0x60000254 /end MEASUREMENT
/begin MEASUREMENT B_agrhens "enable ger in homogeneous mode" UBYTE B_TRUE 1 100 0.00 1.00000000000 BIT_MASK 0x1 FORMAT "%13.11" ECU_ADDRESS 0x60000154 /end MEASUREMENT
/begin MEASUREMENT B_agrhen_msg "Condition EGR active in homogeneous operation" UBYTE B_TRUE 1 100 0.00 1.00000000000 BIT_MASK 0x1 FORMAT "%13.11" ECU_ADDRESS 0x60000253 /end MEASUREMENT
/begin MEASUREMENT B_agrlamen "Condition to release EGR activation due to fuel enrichment" UBYTE B_TRUE 1 100 0.00 1.00000000000 BIT_MASK 0x1 FORMAT "%13.11" ECU_ADDRESS 0x60000153 /end MEASUREMENT
/begin MEASUREMENT B_agrsen_msg "Condition EGR on in stratified charging modes of operation" UBYTE B_TRUE 1 100 0.00 1.00000000000 BIT_MASK 0x1 FORMAT "%13.11" ECU_ADDRESS 0x60000251 /end MEASUREMENT
/begin MEASUREMENT B_agrsg_msg "Condition EGR nominal value is valid/applicable (EGR nominal value = EGR actual" UBYTE B_TRUE 1 100 0.00 1.00000000000 BIT_MASK 0x1 FORMAT "%13.11" ECU_ADDRESS 0x60000250 /end MEASUREMENT
/begin MEASUREMENT B_agrstm_msg "condition: EGR after startend possible" UBYTE B_TRUE 1 100 0.00 1.00000000000 BIT_MASK 0x1 FORMAT "%13.11" ECU_ADDRESS 0x6000024E /end MEASUREMENT
/begin MEASUREMENT B_agr_msg "Condition AGR active" UBYTE B_TRUE 1 100 0.00 1.00000000000 BIT_MASK 0x1 FORMAT "%13.11" ECU_ADDRESS 0x60000258 /end MEASUREMENT
/begin MEASUREMENT B_dagrssa "condition egr valve controlling for egr adaptation active" UBYTE B_TRUE 1 100 0.00 1.00000000000 BIT_MASK 0x1 FORMAT "%13.11" ECU_ADDRESS 0x60000152 /end MEASUREMENT
/begin MEASUREMENT B_dagrssans "condition egr valve controlling for egr adaptation active after SDM scheduler" UBYTE B_TRUE 1 100 0.00 1.00000000000 BIT_MASK 0x1 FORMAT "%13.11" ECU_ADDRESS 0x60000151 /end MEASUREMENT
/begin MEASUREMENT B_dagrssg_msg "Condition: fast diagnosis EGR demanded" UBYTE B_TRUE 1 100 0.00 1.00000000000 BIT_MASK 0x1 FORMAT "%13.11" ECU_ADDRESS 0x60000243 /end MEASUREMENT
/begin MEASUREMENT B_dagrss_msg "Condition fast diagnosis egr." UBYTE B_TRUE 1 100 0.00 1.00000000000 BIT_MASK 0x1 FORMAT "%13.11" ECU_ADDRESS 0x60000245 /end MEASUREMENT
/begin MEASUREMENT B_delayhld "IKC: condition to hold the delay for dynamic" UBYTE B_TRUE 1 100 0.00 1.00000000000 BIT_MASK 0x1 FORMAT "%13.11" ECU_ADDRESS 0x70000410 /end MEASUREMENT
/begin MEASUREMENT B_disagr_msg "condition egr disable" UBYTE B_TRUE 1 100 0.00 1.00000000000 BIT_MASK 0x1 FORMAT "%13.11" ECU_ADDRESS 0x60000242 /end MEASUREMENT
/begin MEASUREMENT B_ebfmodns_msg "Condition after-start mode of initial fuelling active (for robust engine run)" UBYTE B_TRUE 1 100 0.00 1.00000000000 BIT_MASK 0x1 FORMAT "%13.11" ECU_ADDRESS 0x60036E34 /end MEASUREMENT
/begin MEASUREMENT B_ebfmod_msg "Condition initial fuelling mode active" UBYTE B_TRUE 1 100 0.00 1.00000000000 BIT_MASK 0x1 FORMAT "%13.11" ECU_ADDRESS 0x60036E35 /end MEASUREMENT
/begin MEASUREMENT B_eks "condition knock sensor defect detected" UBYTE B_TRUE 1 100 0.00 1.00000000000 BIT_MASK 0x1 FORMAT "%13.11" ECU_ADDRESS 0x7000040F /end MEASUREMENT
/begin MEASUREMENT B_enagrada_msg "Condition: Enable EGR overrun adaption" UBYTE B_TRUE 1 100 0.00 1.00000000000 BIT_MASK 0x1 FORMAT "%13.11" ECU_ADDRESS 0x60000232 /end MEASUREMENT
/begin MEASUREMENT B_enkbagr_msg "Condition enable aperture correction" UBYTE B_TRUE 1 100 0.00 1.00000000000 BIT_MASK 0x1 FORMAT "%13.11" ECU_ADDRESS 0x6000022F /end MEASUREMENT
/begin MEASUREMENT B_enofagr_msg "condition enable: offset adaptation" UBYTE B_TRUE 1 100 0.00 1.00000000000 BIT_MASK 0x1 FORMAT "%13.11" ECU_ADDRESS 0x6000022E /end MEASUREMENT
/begin MEASUREMENT B_evaktdel_msg "Condition all injection valves active retarded" UBYTE B_TRUE 1 100 0.00 1.00000000000 BIT_MASK 0x1 FORMAT "%13.11" ECU_ADDRESS 0x6000022B /end MEASUREMENT
/begin MEASUREMENT B_fagrabkv "Condition: brake booster release EGR adaptation" UBYTE B_TRUE 1 100 0.00 1.00000000000 BIT_MASK 0x1 FORMAT "%13.11" ECU_ADDRESS 0x60000150 /end MEASUREMENT
/begin MEASUREMENT B_fagradat_msg "condition temperature release EGR Adaptation" UBYTE B_TRUE 1 100 0.00 1.00000000000 BIT_MASK 0x1 FORMAT "%13.11" ECU_ADDRESS 0x60000225 /end MEASUREMENT
/begin MEASUREMENT B_fagrada_msg "Condition: Release EGR overrun adaption" UBYTE B_TRUE 1 100 0.00 1.00000000000 BIT_MASK 0x1 FORMAT "%13.11" ECU_ADDRESS 0x60000226 /end MEASUREMENT
/begin MEASUREMENT B_fagralam "Condition: Lambda release EGR adaptation" UBYTE B_TRUE 1 100 0.00 1.00000000000 BIT_MASK 0x1 FORMAT "%13.11" ECU_ADDRESS 0x6000014F /end MEASUREMENT
/begin MEASUREMENT B_fagrh_msg "release of EGR for homogeneous mode" UBYTE B_TRUE 1 100 0.00 1.00000000000 BIT_MASK 0x1 FORMAT "%13.11" ECU_ADDRESS 0x60000224 /end MEASUREMENT
/begin MEASUREMENT B_fgabgagr_msg "enable cond. for add.adjustment between meas. and calc. manifold pressure by AGR" UBYTE B_TRUE 1 100 0.00 1.00000000000 BIT_MASK 0x1 FORMAT "%13.11" ECU_ADDRESS 0x60000222 /end MEASUREMENT
/begin MEASUREMENT B_fgblagrs_msg "Condition fast egr aperture adaptation released" UBYTE B_TRUE 1 100 0.00 1.00000000000 BIT_MASK 0x1 FORMAT "%13.11" ECU_ADDRESS 0x6000021E /end MEASUREMENT
/begin MEASUREMENT B_hdrab_msg "Demand injection valve cutoff at errors of high pressure regulation" UBYTE B_TRUE 1 100 0.00 1.00000000000 BIT_MASK 0x1 FORMAT "%13.11" ECU_ADDRESS 0x70000BAB /end MEASUREMENT
/begin MEASUREMENT B_hmmagrdi_msg "Disable homogeneous lean mode caused by egr error." UBYTE B_TRUE 1 100 0.00 1.00000000000 BIT_MASK 0x1 FORMAT "%13.11" ECU_ADDRESS 0x60000211 /end MEASUREMENT
/begin MEASUREMENT B_hmmagren_msg "condition: HMM mode enable without egr" UBYTE B_TRUE 1 100 0.00 1.00000000000 BIT_MASK 0x1 FORMAT "%13.11" ECU_ADDRESS 0x60000210 /end MEASUREMENT
/begin MEASUREMENT B_homagrdi_msg "Disable homogeneous mode caused by egr error." UBYTE B_TRUE 1 100 0.00 1.00000000000 BIT_MASK 0x1 FORMAT "%13.11" ECU_ADDRESS 0x6000020F /end MEASUREMENT
/begin MEASUREMENT B_hrevab "demand injection valve cutoff at error of main relay" UBYTE B_TRUE 1 100 0.00 1.00000000000 BIT_MASK 0x1 FORMAT "%13.11" ECU_ADDRESS 0x60000156 /end MEASUREMENT
/begin MEASUREMENT B_kdhre "condition switch on components supplied via main relay for UBR diagnosis purpose" UBYTE B_TRUE 1 100 0.00 1.00000000000 BIT_MASK 0x1 FORMAT "%13.11" ECU_ADDRESS 0x70000412 /end MEASUREMENT
/begin MEASUREMENT B_krenfadi "IKC: fast advance ignition due to B_wkral" UBYTE B_TRUE 1 100 0.00 1.00000000000 BIT_MASK 0x1 FORMAT "%13.11" ECU_ADDRESS 0x7000040E /end MEASUREMENT
/begin MEASUREMENT B_krsyne "knock control synchronisation error at phase error" UBYTE B_TRUE 1 100 0.00 1.00000000000 BIT_MASK 0x1 FORMAT "%13.11" ECU_ADDRESS 0x7000040D /end MEASUREMENT
/begin MEASUREMENT B_krvalgrd "IKC: condition of the gradient of the camshaft phaser" UBYTE B_TRUE 1 100 0.00 1.00000000000 BIT_MASK 0x1 FORMAT "%13.11" ECU_ADDRESS 0x7000040C /end MEASUREMENT
/begin MEASUREMENT B_ktagra_msg "Condition short test egr" UBYTE B_TRUE 1 100 0.00 1.00000000000 BIT_MASK 0x1 FORMAT "%13.11" ECU_ADDRESS 0x6000020A /end MEASUREMENT
/begin MEASUREMENT B_ktagrs_msg "Condition short test egr in fuel cut off" UBYTE B_TRUE 1 100 0.00 1.00000000000 BIT_MASK 0x1 FORMAT "%13.11" ECU_ADDRESS 0x60000209 /end MEASUREMENT
/begin MEASUREMENT B_maxhdrlo "Condition max error HDR local in %BBORING" UBYTE B_TRUE 1 100 0.00 1.00000000000 BIT_MASK 0x1 FORMAT "%13.11" ECU_ADDRESS 0x60036DF2 /end MEASUREMENT
/begin MEASUREMENT B_mwagr_msg "GDI mode change egr control (hand shake)" UBYTE B_TRUE 1 100 0.00 1.00000000000 BIT_MASK 0x1 FORMAT "%13.11" ECU_ADDRESS 0x600001F6 /end MEASUREMENT
/begin MEASUREMENT B_noinjdst_msg "injection cut off before the direct start begins" UBYTE B_TRUE 1 100 0.00 1.00000000000 BIT_MASK 0x1 FORMAT "%13.11" ECU_ADDRESS 0x70003640 /end MEASUREMENT
/begin MEASUREMENT B_schagrdi_msg "condition disable stratified mode caused by egr error" UBYTE B_TRUE 1 100 0.00 1.00000000000 BIT_MASK 0x1 FORMAT "%13.11" ECU_ADDRESS 0x600001D5 /end MEASUREMENT
/begin MEASUREMENT B_schagren_msg "condition: stratified mode enable without egr" UBYTE B_TRUE 1 100 0.00 1.00000000000 BIT_MASK 0x1 FORMAT "%13.11" ECU_ADDRESS 0x600001D4 /end MEASUREMENT
/begin MEASUREMENT B_sprrsave "Bit copy of primal lock information" UBYTE B_TRUE 1 100 0.00 1.00000000000 BIT_MASK 0x1 FORMAT "%13.11" ECU_ADDRESS 0x6000014D /end MEASUREMENT
/begin MEASUREMENT B_statdyn "Bit marks the calculation interval of direct start variables during stop phase" UBYTE B_TRUE 1 100 0.00 1.00000000000 BIT_MASK 0x1 FORMAT "%13.11" ECU_ADDRESS 0x6000F166 /end MEASUREMENT
/begin MEASUREMENT B_tkktagra_msg "Condition for short trip monitor: egr short trip enable" UBYTE B_TRUE 1 100 0.00 1.00000000000 BIT_MASK 0x1 FORMAT "%13.11" ECU_ADDRESS 0x600001C4 /end MEASUREMENT
/begin MEASUREMENT B_ubg "Validity of ub, ubsq, ubrsq" UBYTE B_TRUE 1 100 0.00 1.00000000000 BIT_MASK 0x1 FORMAT "%13.11" ECU_ADDRESS 0x60000155 /end MEASUREMENT
/begin MEASUREMENT B_urstsprr_msg "Condition primal fuelling locked" UBYTE B_TRUE 1 100 0.00 1.00000000000 BIT_MASK 0x1 FORMAT "%13.11" ECU_ADDRESS 0x60036E0A /end MEASUREMENT
/begin MEASUREMENT B_zdagrss_msg "Condition cycle (internal) fast diagnosis egr" UBYTE B_TRUE 1 100 0.00 1.00000000000 BIT_MASK 0x1 FORMAT "%13.11" ECU_ADDRESS 0x600001BB /end MEASUREMENT
/begin MEASUREMENT ChrSet_flgEgrRdyIndpdtIdle "Condition: EGR readiness without consideration (independent) of Idle." UBYTE B_TRUE 1 100 0.00 1.00000000000 BIT_MASK 0x1 FORMAT "%13.11" ECU_ADDRESS 0x600014DD /end MEASUREMENT
/begin MEASUREMENT cntsyns "counter of the very first syns-calls" UBYTE OneToOne 1 100 0.00 255.0 FORMAT "%5.1" ECU_ADDRESS 0x70003665 /end MEASUREMENT
/begin MEASUREMENT ComEBS_chAcmBattCh "Accumulated battery charge" SLONG BattCh_Ah_q0p00097656_COMPU 1 100 -2097152.00000 2097151.99902 FORMAT "%13.5" ECU_ADDRESS 0x50004DD0 /end MEASUREMENT
/begin MEASUREMENT ComEBS_chAcmBattChEBSC "Battery Charge" SLONG BattCh_Ah_q0p00097656_COMPU 1 100 -2097152.00000 2097151.99902 FORMAT "%13.5" ECU_ADDRESS 0x50004DD4 /end MEASUREMENT
/begin MEASUREMENT ComEBS_chAcmBattDcha "Accumulated battery discharge" SLONG BattCh_Ah_q0p00097656_COMPU 1 100 -2097152.00000 2097151.99902 FORMAT "%13.5" ECU_ADDRESS 0x60003A14 /end MEASUREMENT
/begin MEASUREMENT ComEBS_chAcmBattDchaEBSC "Battery Discharge" SLONG BattCh_Ah_q0p00097656_COMPU 1 100 -2097152.00000 2097151.99902 FORMAT "%13.5" ECU_ADDRESS 0x50004DD8 /end MEASUREMENT
/begin MEASUREMENT ComEBS_chBattDgrtRate "Battery degradation rate" SWORD Ch_Ah_q0p5_COMPU 1 100 -16384.00 16383.50 FORMAT "%8.2" ECU_ADDRESS 0x60009B26 /end MEASUREMENT
/begin MEASUREMENT ComEBS_ctIntResUpdEBSF "Internal resistance calculation execution counter for type B sensor" UBYTE OneToOne 1 100 0.00 255.0 FORMAT "%5.1" ECU_ADDRESS 0x6000FF4D /end MEASUREMENT
/begin MEASUREMENT ComEBS_iBattAvgLINOff "Average LIN Battery Off condition" SWORD i_q0p0078125_A 1 100 -256.0000 255.9922 FORMAT "%8.4" ECU_ADDRESS 0x60009B24 /end MEASUREMENT
/begin MEASUREMENT ComEBS_iBattSensEBSA "Raw value of Battery Current" SLONG i_q0p001_A 1 100 -2147483.64800 2147483.64700 FORMAT "%13.5" ECU_ADDRESS 0x60003A10 /end MEASUREMENT
/begin MEASUREMENT ComEBS_iBattSensTmp "Raw value of Battery Current" SLONG i_q0p001_A 1 100 -2147483.64800 2147483.64700 FORMAT "%13.5" ECU_ADDRESS 0x50004DDC /end MEASUREMENT
/begin MEASUREMENT ComEBS_iStByCurrAft0hTypB "Last stand-by current after ignition off" SWORD i_q0p01_A 1 100 -327.6800 327.6700 FORMAT "%8.4" ECU_ADDRESS 0x60009B22 /end MEASUREMENT
/begin MEASUREMENT ComEBS_qStByCurrAft1hTypB "Stand-by current at 1 hour after ignition off" SWORD q0p01_A_h_1 1 100 -327.6800 327.6700 FORMAT "%8.4" ECU_ADDRESS 0x60009B20 /end MEASUREMENT
/begin MEASUREMENT ComEBS_qStByCurrAft2hTypB "Stand-by current at 2 hour after ignition off" SWORD q0p01_A_h_1 1 100 -327.6800 327.6700 FORMAT "%8.4" ECU_ADDRESS 0x60009B1E /end MEASUREMENT
/begin MEASUREMENT ComEBS_qStByCurrLstTypB "Last stand-by current after ignition off" SWORD q0p01_A_h_1 1 100 -327.6800 327.6700 FORMAT "%8.4" ECU_ADDRESS 0x60009B1C /end MEASUREMENT
/begin MEASUREMENT ComEBS_rBattSensCh "Status Of Charge from LIN" SWORD Prc 1 100 -400.0000 399.9878 FORMAT "%8.4" ECU_ADDRESS 0x60009B1A /end MEASUREMENT
/begin MEASUREMENT ComEBS_rBattSensChEBSB "Status of Type B Battery sensor charge" UBYTE rel_ub_b127p5 1 100 0.00 127.5 FORMAT "%5.1" ECU_ADDRESS 0x6000FF4C /end MEASUREMENT
/begin MEASUREMENT ComEBS_rBattSensTmp "Status of Type B Battery sensor charge" UBYTE rel_ub_b127p5 1 100 0.00 127.5 FORMAT "%5.1" ECU_ADDRESS 0x6000FF4B /end MEASUREMENT
/begin MEASUREMENT ComEBS_rBattStrat "Stratification rate" SWORD Prc 1 100 -400.0000 399.9878 FORMAT "%8.4" ECU_ADDRESS 0x60009B18 /end MEASUREMENT
/begin MEASUREMENT ComEBS_resMeasdBattREBSF "Harness Resistance state" SLONG Resist_mOhm_q0p01 1 100 -21474836.4800 21474836.4700 FORMAT "%13.4" ECU_ADDRESS 0x60003A0C /end MEASUREMENT
/begin MEASUREMENT ComEBS_resMeasdBattROth "Internal resistance (except a starter)" SLONG Resist_mOhm_q0p01 1 100 -21474836.4800 21474836.4700 FORMAT "%13.4" ECU_ADDRESS 0x60003A08 /end MEASUREMENT
/begin MEASUREMENT ComEBS_resMeasdBattRTmp "Actual measured battery resistance obtained from sensor B" SLONG Resist_mOhm_q0p01 1 100 -21474836.4800 21474836.4700 FORMAT "%13.4" ECU_ADDRESS 0x50004DE0 /end MEASUREMENT
/begin MEASUREMENT ComEBS_stBattAbnormExtDrvCtrl "Abnormalities in external drive control" UBYTE OneToOne 1 100 0.00 255.0 FORMAT "%5.1" ECU_ADDRESS 0x6000FF4A /end MEASUREMENT
/begin MEASUREMENT ComEBS_stBattBlindCh "Status of battery blind charging" UBYTE dez 1 100 0.00 255.0 FORMAT "%5.1" ECU_ADDRESS 0x6000FF49 /end MEASUREMENT
/begin MEASUREMENT ComEBS_stBattBlindChEBSE "Status of battery blind charging Type B sensor" UBYTE dez 1 100 0.00 255.0 FORMAT "%5.1" ECU_ADDRESS 0x6000FF48 /end MEASUREMENT
/begin MEASUREMENT ComEBS_stBattComResErr "Communication response error" UBYTE OneToOne 1 100 0.00 255.0 FORMAT "%5.1" ECU_ADDRESS 0x6000FF47 /end MEASUREMENT
/begin MEASUREMENT ComEBS_stBattDchaVltgPrdnSig "Discharge voltage descent prediction signal" UBYTE OneToOne 1 100 0.00 255.0 FORMAT "%5.1" ECU_ADDRESS 0x6000FF46 /end MEASUREMENT
/begin MEASUREMENT ComEBS_stBattDgrtSig "Capacity degradation state signal" UBYTE OneToOne 1 100 0.00 255.0 FORMAT "%5.1" ECU_ADDRESS 0x6000FF45 /end MEASUREMENT
/begin MEASUREMENT ComEBS_stBattExch "Battery exchange" UBYTE OneToOne 1 100 0.00 255.0 FORMAT "%5.1" ECU_ADDRESS 0x6000FF44 /end MEASUREMENT
/begin MEASUREMENT ComEBS_stBattPolarDgrtSig "Polar-plate degradation state signal" UBYTE OneToOne 1 100 0.00 255.0 FORMAT "%5.1" ECU_ADDRESS 0x6000FF43 /end MEASUREMENT
/begin MEASUREMENT ComEBS_stBattSensSOCstatEBSB "SOC status" UBYTE OneToOne 1 100 0.00 255.0 FORMAT "%5.1" ECU_ADDRESS 0x6000FF42 /end MEASUREMENT
/begin MEASUREMENT ComEBS_stBattShortChrg "Shortage of battery charge" UBYTE OneToOne 1 100 0.00 255.0 FORMAT "%5.1" ECU_ADDRESS 0x6000FF41 /end MEASUREMENT
/begin MEASUREMENT ComEBS_stBattSizeDetc "Battery size detection" UBYTE OneToOne 1 100 0.00 255.0 FORMAT "%5.1" ECU_ADDRESS 0x6000FF40 /end MEASUREMENT
/begin MEASUREMENT ComEBS_stBattSplrDiscern "Supplier discernment" UBYTE OneToOne 1 100 0.00 255.0 FORMAT "%5.1" ECU_ADDRESS 0x6000FF3F /end MEASUREMENT
/begin MEASUREMENT ComEBS_stBattStratSig "Stratificationized state signal" UBYTE OneToOne 1 100 0.00 255.0 FORMAT "%5.1" ECU_ADDRESS 0x6000FF3E /end MEASUREMENT
/begin MEASUREMENT ComEBS_stBattWrmLvl "Battery warm level" UBYTE OneToOne 1 100 0.00 255.0 FORMAT "%5.1" ECU_ADDRESS 0x6000FF3D /end MEASUREMENT
/begin MEASUREMENT ComEBS_stCharErr "Character Error flag" UBYTE OneToOne 1 100 0.00 255.0 FORMAT "%5.1" ECU_ADDRESS 0x6000FF3C /end MEASUREMENT
/begin MEASUREMENT ComEBS_stDataDiscern "Data discernment" UBYTE OneToOne 1 100 0.00 255.0 FORMAT "%5.1" ECU_ADDRESS 0x6000FF3B /end MEASUREMENT
/begin MEASUREMENT ComEBS_stHarnR "Harness Resistance state" UBYTE OneToOne 1 100 0.00 255.0 FORMAT "%5.1" ECU_ADDRESS 0x6000FF3A /end MEASUREMENT
/begin MEASUREMENT ComEBS_stMeasdR "Internal resistance calculation execution counter for type B sensor" UBYTE OneToOne 1 100 0.00 255.0 FORMAT "%5.1" ECU_ADDRESS 0x6000FF39 /end MEASUREMENT
/begin MEASUREMENT ComEBS_stSensErr "Battery Sensor error flag" UBYTE OneToOne 1 100 0.00 255.0 FORMAT "%5.1" ECU_ADDRESS 0x6000FF38 /end MEASUREMENT
/begin MEASUREMENT ComEBS_stSensErrAftIgnOff "Battery Sensor error flag after IG OFF" UBYTE OneToOne 1 100 0.00 255.0 FORMAT "%5.1" ECU_ADDRESS 0x6000FF37 /end MEASUREMENT
/begin MEASUREMENT ComEBS_stSensRst "Status of battery sensor reset detection" UBYTE OneToOne 1 100 0.00 255.0 FORMAT "%5.1" ECU_ADDRESS 0x6000FF36 /end MEASUREMENT
/begin MEASUREMENT ComEBS_stSensRstEBSE "Status of battery sensor reset detection EBS" UBYTE OneToOne 1 100 0.00 255.0 FORMAT "%5.1" ECU_ADDRESS 0x6000FF35 /end MEASUREMENT
/begin MEASUREMENT ComEBS_tBattSens "Battery temperature received from EBS on LIN" SWORD Temp_Cels 1 100 -3549.940 3003.560 FORMAT "%8.3" ECU_ADDRESS 0x60009B16 /end MEASUREMENT
/begin MEASUREMENT ComEBS_tBattSensASIC "ASIC temperature of EBS" SWORD Temp_Cels 1 100 -3549.940 3003.560 FORMAT "%8.3" ECU_ADDRESS 0x60009B14 /end MEASUREMENT
/begin MEASUREMENT ComEBS_tBattSensASICEBSF "ASIC temperature of EBS" SWORD Temp_Cels 1 100 -3549.940 3003.560 FORMAT "%8.3" ECU_ADDRESS 0x60009B12 /end MEASUREMENT
/begin MEASUREMENT ComEBS_tBattSensEBSB "Battery Type B sensor temperature" SWORD Temp_Cels 1 100 -3549.940 3003.560 FORMAT "%8.3" ECU_ADDRESS 0x60009B10 /end MEASUREMENT
/begin MEASUREMENT ComEBS_tBattSensTmp "Battery Type B sensor temperature" SWORD Temp_Cels 1 100 -3549.940 3003.560 FORMAT "%8.3" ECU_ADDRESS 0x60009B0E /end MEASUREMENT
/begin MEASUREMENT ComEBS_tiDurAftIgnOff "Last stand-by current after ignition off" SWORD Time_Hr 1 100 -16384.00 16383.50 FORMAT "%8.2" ECU_ADDRESS 0x60009B0C /end MEASUREMENT
/begin MEASUREMENT ComEBS_tiDurAftIgnOffEBSC "Duration after ignition off - Type B" SWORD Time_Hr 1 100 -16384.00 16383.50 FORMAT "%8.2" ECU_ADDRESS 0x60009B0A /end MEASUREMENT
/begin MEASUREMENT ComEBS_uBattDchaVltgPrdn "Discharge voltage descent prediction" SWORD spg_q0p0625_V 1 100 -2048.000 2047.938 FORMAT "%8.3" ECU_ADDRESS 0x60009B08 /end MEASUREMENT
/begin MEASUREMENT ComEBS_uBattPolarDgrt "Polar-plate degradation" SWORD spg_q0p0625_V 1 100 -2048.000 2047.938 FORMAT "%8.3" ECU_ADDRESS 0x60009B06 /end MEASUREMENT
/begin MEASUREMENT ComEBS_uBattSens "14 bits Battery Voltage Received from EBS on LIN" SLONG spg_q0p001_V 1 100 -2147483.64800 2147483.64700 FORMAT "%13.5" ECU_ADDRESS 0x60003A04 /end MEASUREMENT
/begin MEASUREMENT ComEBS_uBattSensEBSA "Battery Type B sensor voltage" UWORD spg_q0p001_V 1 100 0.00 65.53500 FORMAT "%8.5" ECU_ADDRESS 0x6000957C /end MEASUREMENT
/begin MEASUREMENT ComEBS_uBattSensTmp "Battery sensor voltage" UWORD spg_q0p001_V 1 100 0.00 65.53500 FORMAT "%8.5" ECU_ADDRESS 0x6000957A /end MEASUREMENT
/begin MEASUREMENT ComEBS_uBattUCO "Battery quiescent voltage" SWORD u_Batt_V_q0p00097656 1 100 -32.00000 31.99902 FORMAT "%8.5" ECU_ADDRESS 0x60009B04 /end MEASUREMENT
/begin MEASUREMENT ComEBS_uBattUCOEBSE "OCV" SWORD u_Batt_V_q0p00097656 1 100 -32.00000 31.99902 FORMAT "%8.5" ECU_ADDRESS 0x60009B02 /end MEASUREMENT
/begin MEASUREMENT Com_bBliChrg "Status of blind charging" UBYTE dez 1 100 0.00 255.0 FORMAT "%5.1" ECU_ADDRESS 0x6000FF30 /end MEASUREMENT
/begin MEASUREMENT Com_cntrIntResUpd "Value of EBS counter for internal resistance measurement" UBYTE OneToOne 1 100 0.00 255.0 FORMAT "%5.1" ECU_ADDRESS 0x6000FF2B /end MEASUREMENT
/begin MEASUREMENT Com_ctReIni10msBattECU_EBS_B "The counter of ReInit Proc for BattEcu_EBS" UBYTE OneToOne 1 100 0.00 255.0 FORMAT "%5.1" ECU_ADDRESS 0x6000F192 /end MEASUREMENT
/begin MEASUREMENT Com_dEBSDByt0 "EBSD Byte 0 Raw value" UBYTE OneToOne 1 100 0.00 255.0 FORMAT "%5.1" ECU_ADDRESS 0x6000FEEA /end MEASUREMENT
/begin MEASUREMENT Com_dEBSDByt1 "EBSD Byte 1 Raw value" UBYTE OneToOne 1 100 0.00 255.0 FORMAT "%5.1" ECU_ADDRESS 0x6000FEE9 /end MEASUREMENT
/begin MEASUREMENT Com_dEBSDByt2 "EBSD Byte 2 Raw value" UBYTE OneToOne 1 100 0.00 255.0 FORMAT "%5.1" ECU_ADDRESS 0x6000FEE8 /end MEASUREMENT
/begin MEASUREMENT Com_dEBSDByt3 "EBSD Byte 3 Raw value" UBYTE OneToOne 1 100 0.00 255.0 FORMAT "%5.1" ECU_ADDRESS 0x6000FEE7 /end MEASUREMENT
/begin MEASUREMENT Com_dEBSDByt4 "EBSD Byte 4 Raw value" UBYTE OneToOne 1 100 0.00 255.0 FORMAT "%5.1" ECU_ADDRESS 0x6000FEE6 /end MEASUREMENT
/begin MEASUREMENT Com_flgEbsRst "Flag to indicate reset of EBS" UBYTE OneToOne 1 100 0.00 255.0 FORMAT "%5.1" ECU_ADDRESS 0x6000FEDE /end MEASUREMENT
/begin MEASUREMENT Com_iBattEBS "Battery current from EBS" SLONG Curr_mA_q0p9765625_COMPU 1 100 -2097152000.00 2097151999.02 FORMAT "%13.2" ECU_ADDRESS 0x60003A00 /end MEASUREMENT
/begin MEASUREMENT Com_iStbIAft0Hr "Current value at IG-OFF timing" SWORD i_q0p01_A 1 100 -327.6800 327.6700 FORMAT "%8.4" ECU_ADDRESS 0x60009AFC /end MEASUREMENT
/begin MEASUREMENT Com_qChrg "Battery accumulated charge received from EBS" SLONG q0p01_A_h_1 1 100 -21474836.4800 21474836.4700 FORMAT "%13.4" ECU_ADDRESS 0x50004DF8 /end MEASUREMENT
/begin MEASUREMENT Com_qDisChrg "Battery accumulated discharge received from EBS" SLONG q0p01_A_h_1 1 100 -21474836.4800 21474836.4700 FORMAT "%13.4" ECU_ADDRESS 0x50004DFC /end MEASUREMENT
/begin MEASUREMENT Com_qSoh "battery state of health with respect to charge capacity" SWORD ElecChrg_Ah_q0p125_COMPU 1 100 -4096.000 4095.875 FORMAT "%8.3" ECU_ADDRESS 0x60009AE2 /end MEASUREMENT
/begin MEASUREMENT Com_qStbIAft1Hr "Current integration value during IG-OFF to 1 hour pass" SWORD q0p01_A_h_1 1 100 -327.6800 327.6700 FORMAT "%8.4" ECU_ADDRESS 0x60009AE0 /end MEASUREMENT
/begin MEASUREMENT Com_qStbIAft2Hr "Current integration value during 1 hour to 2 hour" SWORD q0p01_A_h_1 1 100 -327.6800 327.6700 FORMAT "%8.4" ECU_ADDRESS 0x60009ADE /end MEASUREMENT
/begin MEASUREMENT Com_qStbILast "Current integration value during last 1 hour" SWORD q0p01_A_h_1 1 100 -327.6800 327.6700 FORMAT "%8.4" ECU_ADDRESS 0x60009ADC /end MEASUREMENT
/begin MEASUREMENT Com_ratSoc "Status of charge" UBYTE rel_ub_b127p5 1 100 0.00 127.5 FORMAT "%5.1" ECU_ADDRESS 0x6000FE8C /end MEASUREMENT
/begin MEASUREMENT Com_ratSoh "Battery SOH received from EBS" SWORD Prc 1 100 -400.0000 399.9878 FORMAT "%8.4" ECU_ADDRESS 0x60009AC4 /end MEASUREMENT
/begin MEASUREMENT Com_rMeasdBattREbs "Internal resistance of the battery measured by EBS" SWORD RBPtCel_r_0p00001_1 1 100 -0.3276800 0.3276700 FORMAT "%9.7" ECU_ADDRESS 0x60009ACE /end MEASUREMENT
/begin MEASUREMENT Com_stBattDchaVltgPrdnSig "Discharge voltage descent prediction signal" UBYTE OneToOne 1 100 0.00 255.0 FORMAT "%5.1" ECU_ADDRESS 0x6000FE64 /end MEASUREMENT
/begin MEASUREMENT Com_stBattDgrtSig "Capacity degradation state signal" UBYTE OneToOne 1 100 0.00 255.0 FORMAT "%5.1" ECU_ADDRESS 0x6000FE63 /end MEASUREMENT
/begin MEASUREMENT Com_stCharErr "Battery current plausibility flag" UBYTE OneToOne 1 100 0.00 255.0 FORMAT "%5.1" ECU_ADDRESS 0x6000FE4E /end MEASUREMENT
/begin MEASUREMENT Com_stI "Status of battery current" UBYTE OneToOne 1 100 0.00 255.0 FORMAT "%5.1" ECU_ADDRESS 0x6000FDEB /end MEASUREMENT
/begin MEASUREMENT Com_stSensErr "Battery Sensor error flag" UBYTE OneToOne 1 100 0.00 255.0 FORMAT "%5.1" ECU_ADDRESS 0x6000FD92 /end MEASUREMENT
/begin MEASUREMENT Com_stSoc "State of SOC signal" UBYTE OneToOne 1 100 0.00 255.0 FORMAT "%5.1" ECU_ADDRESS 0x6000FD83 /end MEASUREMENT
/begin MEASUREMENT Com_stT "Status of battery temperature" UBYTE OneToOne 1 100 0.00 255.0 FORMAT "%5.1" ECU_ADDRESS 0x6000FD7A /end MEASUREMENT
/begin MEASUREMENT Com_stU "Status of battery voltage" UBYTE OneToOne 1 100 0.00 255.0 FORMAT "%5.1" ECU_ADDRESS 0x6000FD6B /end MEASUREMENT
/begin MEASUREMENT Com_tBattEBS "Battery temperature from EBS" SWORD SCR_TEMP_CELS_float 1 100 -32768.00 32767.00 FORMAT "%8.2" ECU_ADDRESS 0x60009ABC /end MEASUREMENT
/begin MEASUREMENT Com_tiDurnAftIgnOff "IG-OFF Duration time" SLONG Time_Hr 1 100 -1073741824.00 1073741823.50 FORMAT "%13.2" ECU_ADDRESS 0x50004E00 /end MEASUREMENT
/begin MEASUREMENT Com_uBattEBS "Battery voltage from EBS" SWORD U_mV_q0p9765625_COMPU 1 100 -32000.00 31999.02 FORMAT "%8.2" ECU_ADDRESS 0x60009A98 /end MEASUREMENT
/begin MEASUREMENT Com_uPeak "Battery voltage at cranking peak" SWORD spg_q0p0625_V 1 100 -2048.000 2047.938 FORMAT "%8.3" ECU_ADDRESS 0x60009A94 /end MEASUREMENT
/begin MEASUREMENT ctBattSamples "Counter for Battery samples" UBYTE OneToOne 1 100 0.00 255.0 FORMAT "%5.1" ECU_ADDRESS 0x70005477 /end MEASUREMENT
/begin MEASUREMENT destrange_msg "Target cylinder index for dirext start Identification of range interval" UBYTE OneToOne 1 100 0.00 255.0 FORMAT "%5.1" ECU_ADDRESS 0x70003663 /end MEASUREMENT
/begin MEASUREMENT dmrdagr_w_msg "Torque reserve for EGR- diagnosis" UWORD rel_uw_b100 1 100 0.00 99.99847 FORMAT "%8.5" ECU_ADDRESS 0x60000CC4 /end MEASUREMENT
/begin MEASUREMENT dyespfv "Knock control: current value of load dynamic detection threshold" SBYTE p_q10 1 100 -1280. 1270. FORMAT "%5.0" ECU_ADDRESS 0x6000F159 /end MEASUREMENT
/begin MEASUREMENT dyespof "Actual offset value for load dynamics detection threshold" SBYTE p_q10 1 100 -1280. 1270. FORMAT "%5.0" ECU_ADDRESS 0x6000F158 /end MEASUREMENT
/begin MEASUREMENT ebfstate "Status write access EEPROM" UBYTE dez 1 100 0.00 255.0 FORMAT "%5.1" ECU_ADDRESS 0x600011D0 /end MEASUREMENT
/begin MEASUREMENT engpos_w "CrS positionan, requested by %BBDIRST" UWORD kw_q0p1 1 100 0.00 6553.500 FORMAT "%8.3" ECU_ADDRESS 0x7000320A /end MEASUREMENT
/begin MEASUREMENT EngStrt_ctBBDIRST10msDrvEnter "Local counter for BBDIRST in 10ms for DRIVE state enter from POST or PRE DRIVE" UBYTE OneToOne 1 100 0.00 255.0 FORMAT "%5.1" ECU_ADDRESS 0x6000F165 /end MEASUREMENT
/begin MEASUREMENT EngStrt_flgDrctCoM "the selected the selected start type is a direct start from engine speed greater than zero" UBYTE B_TRUE 1 100 0.00 1.00000000000 BIT_MASK 0x1 FORMAT "%13.11" ECU_ADDRESS 0x6000F987 /end MEASUREMENT
/begin MEASUREMENT EngStrt_flgDrctStrt "The selected start type is a direct start from engine speed equal to zero" UBYTE B_TRUE 1 100 0.00 1.00000000000 BIT_MASK 0x1 FORMAT "%13.11" ECU_ADDRESS 0x6000F986 /end MEASUREMENT
/begin MEASUREMENT ESS_uBatt "Application parameter for Battery voltage" SWORD Volt_Batt 1 100 -655360.0 655340.0 FORMAT "%8.1" ECU_ADDRESS 0x600099FA /end MEASUREMENT
/begin MEASUREMENT ExhMgT_facCamsftCatHeatg "correction of weighting factor for camshaft nominal angle by catalyst heating in case of a repeated start of combustion engine" UBYTE fak_ub_b2 1 100 0.00 1.000000 FORMAT "%8.6" ECU_ADDRESS 0x6000F163 /end MEASUREMENT
/begin MEASUREMENT ExhMgT_facCatHeatgIntkCamsft "correction factor for ramping up the intake camshaft measure during catalyst heating" UBYTE fak_ub_b2 1 100 0.00 1.000000 FORMAT "%8.6" ECU_ADDRESS 0x6000F162 /end MEASUREMENT
/begin MEASUREMENT ExhMgT_facCatHeatgOutlCamsft "correction factor for ramping up the outlet camshaft measure during catalyst heating" UBYTE fak_ub_b2 1 100 0.00 1.000000 FORMAT "%8.6" ECU_ADDRESS 0x6000F161 /end MEASUREMENT
/begin MEASUREMENT ExhMgT_facCatWrmIntkCamsft "weighting factor for nominal angle of intake camshaft for catalyst warming" UBYTE fak_ub_b2 1 100 0.00 1.000000 FORMAT "%8.6" ECU_ADDRESS 0x6000F160 /end MEASUREMENT
/begin MEASUREMENT ExhMgT_facLamCatHeatgRamp "correction factor in dependence on the integrated air mass for the lambda control factor in case of a cold start" UBYTE fak_ub_b1 1 100 0.00 0.9961 ECU_ADDRESS 0x6000F15F /end MEASUREMENT
/begin MEASUREMENT ExhMgT_facLamCtrl "weighting factor for control lambda" UBYTE fak_ub_b1 1 100 0.00 0.9961 ECU_ADDRESS 0x6000F15E /end MEASUREMENT
/begin MEASUREMENT ExhMgT_facLamCtrlCatHeatg "weighting factor for control lambda during cold start" UBYTE fak_ub_b1 1 100 0.00 0.9961 ECU_ADDRESS 0x6000F15D /end MEASUREMENT
/begin MEASUREMENT ExhMgT_facLamCtrlCatWrm "weighting factor for control lambda during catalyst warming" UBYTE fak_ub_b1 1 100 0.00 0.9961 ECU_ADDRESS 0x6000F15C /end MEASUREMENT
/begin MEASUREMENT ExhMgT_facRatLamCatHeatg "correction of factor control lambda by catalyst heating in case of a repeated start of combustion engine" UBYTE fak_ub_b2 1 100 0.00 1.000000 FORMAT "%8.6" ECU_ADDRESS 0x6000F15B /end MEASUREMENT
/begin MEASUREMENT ExhMgT_flgCatWrmCamsft "demand of a factor for camshaft position for catalyst warming" UBYTE B_TRUE 1 100 0.00 1.00000000000 BIT_MASK 0x1 FORMAT "%13.11" ECU_ADDRESS 0x70000411 /end MEASUREMENT
/begin MEASUREMENT ExhMgT_mfExhCat1B1Dif "Gradient of the exhaust mass flow catalyst 1 bank 1" UWORD m_uw_b6553p5 1 100 0.00 6553.500 FORMAT "%8.3" ECU_ADDRESS 0x600080BA /end MEASUREMENT
/begin MEASUREMENT ExhMgT_mfExhCat1B1Fild "Exhaust mass flow catalyst 1 bank 1" UWORD m_uw_b6553p5 1 100 0.00 6553.500 FORMAT "%8.3" ECU_ADDRESS 0x600080B8 /end MEASUREMENT
/begin MEASUREMENT ExhMgT_mfExhCat1B1Loc "Exhaust mass flow catalyst 1 bank 1" UWORD m_uw_b6553p5 1 100 0.00 6553.500 FORMAT "%8.3" ECU_ADDRESS 0x600080B6 /end MEASUREMENT
/begin MEASUREMENT ExhMgT_tCatHeatgTCatSelnActnDif "Gradient of the catalyst temperature" UWORD temp_q0p1_K 1 100 0.00 6553.500 FORMAT "%8.3" ECU_ADDRESS 0x600080B4 /end MEASUREMENT
/begin MEASUREMENT ExhMgT_tCatHeatgTCatSelnFild "Filtered catalyst temperature" SWORD temp_q0p1_K 1 100 -3276.800 3276.700 FORMAT "%8.3" ECU_ADDRESS 0x600080B2 /end MEASUREMENT
/begin MEASUREMENT ExhMgT_tCatSelnActnLoc "Catalyst temperature" SWORD temp_q0p1_K 1 100 -3276.800 3276.700 FORMAT "%8.3" ECU_ADDRESS 0x600080B0 /end MEASUREMENT
/begin MEASUREMENT flakh_msg "Factor control lambda at catalyst heating" UBYTE fak_ub_b1 1 100 0.00 0.9961 ECU_ADDRESS 0x6000F737 /end MEASUREMENT
/begin MEASUREMENT flbkkh_msg "Factor swirl-control valve request at catalyst heating" UBYTE fak_ub_b1 1 100 0.00 0.9961 ECU_ADDRESS 0x60014AE8 /end MEASUREMENT
/begin MEASUREMENT fnwkha_msg "weighting factor for nominal angle by catalyst heating (outlet)" UBYTE fak_ub_b2 1 100 0.00 1.000000 FORMAT "%8.6" ECU_ADDRESS 0x60014AEA /end MEASUREMENT
/begin MEASUREMENT fnwkhevab "weighting factor for nominal angle by catalyst heating (inlet) in front of deactivation factor" UBYTE fak_ub_b2 1 100 0.00 1.000000 FORMAT "%8.6" ECU_ADDRESS 0x6000F15A /end MEASUREMENT
/begin MEASUREMENT fnwkhe_msg "weighting factor for nominal angle of intake camshaft during catalyst heating" UBYTE fak_ub_b2 1 100 0.00 1.000000 FORMAT "%8.6" ECU_ADDRESS 0x60014AEB /end MEASUREMENT
/begin MEASUREMENT fnwkhnga_msg "weighting factor for nominal angle by catalyst heating in Compressed natural gas mode (outlet)" UBYTE fak_ub_b2 1 100 0.00 1.992188 FORMAT "%8.6" ECU_ADDRESS 0x60014AEC /end MEASUREMENT
/begin MEASUREMENT fnwkhnge_msg "weighting factor for nominal angle of intake camshaft during catalyst heating in Compressed natural gas mode" UBYTE fak_ub_b2 1 100 0.00 1.992188 FORMAT "%8.6" ECU_ADDRESS 0x60014AED /end MEASUREMENT
/begin MEASUREMENT ignctr "Amount of ignition on/off" UBYTE dez 1 100 0.00 255.0 FORMAT "%5.1" ECU_ADDRESS 0x600397A8 /end MEASUREMENT
/begin MEASUREMENT IKCtl_agIntkB1old "old value of filtered angle intake valve opening" SWORD kw_q0p0156 1 100 -512.0000 511.9844 FORMAT "%8.4" ECU_ADDRESS 0x600080AE /end MEASUREMENT
/begin MEASUREMENT IKCtl_ctReIni10msBBKR "Local counter in BBKR to hold number of postdrive exit to track Syc postdrive leave" UBYTE dez 1 100 0.00 255.0 FORMAT "%5.1" ECU_ADDRESS 0x600008D7 /end MEASUREMENT
/begin MEASUREMENT IKCtl_dnFildGrdt_s16 "KC: engine speed gradient during one working cycle (filtered value)" SWORD EngNGrd 1 100 -16384.00 16383.50 FORMAT "%8.2" ECU_ADDRESS 0x700053B4 /end MEASUREMENT
/begin MEASUREMENT IKCtl_flgAdpnEna "condition for active knock control adaptation" UBYTE B_TRUE 1 100 0.00 1.00000000000 BIT_MASK 0x1 FORMAT "%13.11" ECU_ADDRESS 0x700008B9 /end MEASUREMENT
/begin MEASUREMENT IKCtl_flgAdpnLrnEna "condition enable stationary adaptation" UBYTE B_TRUE 1 100 0.00 1.00000000000 BIT_MASK 0x1 FORMAT "%13.11" ECU_ADDRESS 0x700008B8 /end MEASUREMENT
/begin MEASUREMENT IKCtl_flgAdpnWrEna "condition to read knock ignition retardation from knock control adaption map" UBYTE B_TRUE 1 100 0.00 1.00000000000 BIT_MASK 0x1 FORMAT "%13.11" ECU_ADDRESS 0x700008B7 /end MEASUREMENT
/begin MEASUREMENT IKCtl_flgDiagEna "condition enable knock sensor diagnosis" UBYTE B_TRUE 1 100 0.00 1.00000000000 BIT_MASK 0x1 FORMAT "%13.11" ECU_ADDRESS 0x700008B3 /end MEASUREMENT
/begin MEASUREMENT IKCtl_flgDynAdpnEna "knock control: dynamic adaptation enable" UBYTE B_TRUE 1 100 0.00 1.00000000000 BIT_MASK 0x1 FORMAT "%13.11" ECU_ADDRESS 0x700008B2 /end MEASUREMENT
/begin MEASUREMENT IKCtl_flgDynAdpnRead "condition entering load dynamics adaptation" UBYTE B_TRUE 1 100 0.00 1.00000000000 BIT_MASK 0x1 FORMAT "%13.11" ECU_ADDRESS 0x700008B1 /end MEASUREMENT
/begin MEASUREMENT IKCtl_flgFastAdvIa "flag: fast ignition advance knock control" UBYTE B_TRUE 1 100 0.00 1.00000000000 BIT_MASK 0x1 FORMAT "%13.11" ECU_ADDRESS 0x700008B0 /end MEASUREMENT
/begin MEASUREMENT IKCtl_flgGdCyl "Filled cylinder" UBYTE B_TRUE 1 100 0.00 1.00000000000 BIT_MASK 0x1 FORMAT "%13.11" ECU_ADDRESS 0x700008AE /end MEASUREMENT
/begin MEASUREMENT IKCtl_flgInjD "injection valve of current cylinder switched off" UBYTE B_TRUE 1 100 0.00 1.00000000000 BIT_MASK 0x1 FORMAT "%13.11" ECU_ADDRESS 0x700008AD /end MEASUREMENT
/begin MEASUREMENT IKCtl_flgKnkEna "Condition for knock control active" UBYTE B_TRUE 1 100 0.00 1.00000000000 BIT_MASK 0x1 FORMAT "%13.11" ECU_ADDRESS 0x700008AB /end MEASUREMENT
/begin MEASUREMENT IKCtl_flgKnkLimp "emergency operation of knock detection for emergency operation of phase sensor" UBYTE B_TRUE 1 100 0.00 1.00000000000 BIT_MASK 0x1 FORMAT "%13.11" ECU_ADDRESS 0x700008AA /end MEASUREMENT
/begin MEASUREMENT IKCtl_flgKnkLoc "Condition for knock control active bevor time delay" UBYTE B_TRUE 1 100 0.00 1.00000000000 BIT_MASK 0x1 FORMAT "%13.11" ECU_ADDRESS 0x7000040B /end MEASUREMENT
/begin MEASUREMENT IKCtl_flgLoadDynAdpn "Condition load dynamics retard and dynamics adaptation active" UBYTE B_TRUE 1 100 0.00 1.00000000000 BIT_MASK 0x1 FORMAT "%13.11" ECU_ADDRESS 0x700008A9 /end MEASUREMENT
/begin MEASUREMENT IKCtl_flgLoadDynAdpnAdv "condition adaptation load dynamics retard towards advance released" UBYTE B_TRUE 1 100 0.00 1.00000000000 BIT_MASK 0x1 FORMAT "%13.11" ECU_ADDRESS 0x700008A8 /end MEASUREMENT
/begin MEASUREMENT IKCtl_flgLoadDynAdpnTmp "Condition load dynamics retard and dynamics adaptation active" UBYTE B_TRUE 1 100 0.00 1.00000000000 BIT_MASK 0x1 FORMAT "%13.11" ECU_ADDRESS 0x7000040A /end MEASUREMENT
/begin MEASUREMENT IKCtl_flgLoadDynCtrlEna "condition threshold for additional load dynamics retard exceeded" UBYTE B_TRUE 1 100 0.00 1.00000000000 BIT_MASK 0x1 FORMAT "%13.11" ECU_ADDRESS 0x700008A7 /end MEASUREMENT
/begin MEASUREMENT IKCtl_flgLoadDynDetn "Condition load dynamics for knock detection active" UBYTE B_TRUE 1 100 0.00 1.00000000000 BIT_MASK 0x1 FORMAT "%13.11" ECU_ADDRESS 0x700008A6 /end MEASUREMENT
/begin MEASUREMENT IKCtl_flgRtdtUse "condition ignition angle of the knock control is given" UBYTE B_TRUE 1 100 0.00 1.00000000000 BIT_MASK 0x1 FORMAT "%13.11" ECU_ADDRESS 0x7000089E /end MEASUREMENT
/begin MEASUREMENT IKCtl_flgSftyRtdt "Knock control safety ignition retarding" UBYTE B_TRUE 1 100 0.00 1.00000000000 BIT_MASK 0x1 FORMAT "%13.11" ECU_ADDRESS 0x7000089D /end MEASUREMENT
/begin MEASUREMENT IKCtl_flgSftyRtdtReq "request saftey ignition retardation" UBYTE B_TRUE 1 100 0.00 1.00000000000 BIT_MASK 0x1 FORMAT "%13.11" ECU_ADDRESS 0x60014A49 /end MEASUREMENT
/begin MEASUREMENT IKCtl_flgSftyRtdtTmp "knock control saftey ignition retardation temporary variable" UBYTE B_TRUE 1 100 0.00 1.00000000000 BIT_MASK 0x1 FORMAT "%13.11" ECU_ADDRESS 0x6000F157 /end MEASUREMENT
/begin MEASUREMENT IKCtl_flgSpdDynDetn "condition speed dynamics for knock detection active" UBYTE B_TRUE 1 100 0.00 1.00000000000 BIT_MASK 0x1 FORMAT "%13.11" ECU_ADDRESS 0x7000089A /end MEASUREMENT
/begin MEASUREMENT IKCtl_flgTEna "Condition temperature for knock control achieved" UBYTE B_TRUE 1 100 0.00 1.00000000000 BIT_MASK 0x1 FORMAT "%13.11" ECU_ADDRESS 0x70000899 /end MEASUREMENT
/begin MEASUREMENT IKCtl_flgTipinDetn "Tip-in detected" UBYTE B_TRUE 1 100 0.00 1.00000000000 BIT_MASK 0x1 FORMAT "%13.11" ECU_ADDRESS 0x70000898 /end MEASUREMENT
/begin MEASUREMENT IKCtl_idxAdpn_u16 "index for knock control stationary adaptation map" UWORD dez 1 100 0.00 65535.00 FORMAT "%8.2" ECU_ADDRESS 0x500007E6 /end MEASUREMENT
/begin MEASUREMENT IKCtl_idxSpdAdpn_u8 "speed range adaption map knock control" UBYTE dez 1 100 0.00 255.0 FORMAT "%5.1" ECU_ADDRESS 0x6000096D /end MEASUREMENT
/begin MEASUREMENT IKCtl_ofsDesLoadDynThd_u16 "offset, threshold for filtered gradient of the desired air-charge" UWORD rel_uw_q0p0234 1 100 0.00 1535.977 FORMAT "%8.3" ECU_ADDRESS 0x60013D64 /end MEASUREMENT
/begin MEASUREMENT IKCtl_pPfiSp "Knock control: filtered gradient of the desired manifold pressure" SBYTE p_q10 1 100 -1280. 1270. FORMAT "%5.0" ECU_ADDRESS 0x50000990 /end MEASUREMENT
/begin MEASUREMENT IKCtl_ratAirLoadThdFastAdvIa "upper load threshold for fast igniton angle advancing" UWORD rel_uw_q0p0234 1 100 0.00 1535.977 FORMAT "%8.3" ECU_ADDRESS 0x60013D66 /end MEASUREMENT
/begin MEASUREMENT IKCtl_ratCurrLoadDynDetnThd "Current value of load dynamic detection threshold" UWORD rel_uw_q0p0234 1 100 0.00 1535.977 FORMAT "%8.3" ECU_ADDRESS 0x600080AC /end MEASUREMENT
/begin MEASUREMENT IKCtl_ratFilGrdtDesAirChrg_u16 "Filtered-gradient of the desired air-charge" SWORD rel_uw_q0p0234 1 100 -768.0000 767.9766 FORMAT "%8.4" ECU_ADDRESS 0x70003BBC /end MEASUREMENT
/begin MEASUREMENT IKCtl_ratLoadDynDetnThd_u16 "Threshold for filtered gradient of the desired air-charge" UWORD rel_uw_q0p0234 1 100 0.00 1535.977 FORMAT "%8.3" ECU_ADDRESS 0x600080AA /end MEASUREMENT
/begin MEASUREMENT IKCtl_ratLoadRngAdpn1 "Knock control: current value load adaptation range 1" UWORD rel_uw_q0p0234 1 100 0.00 1535.977 FORMAT "%8.3" ECU_ADDRESS 0x60013D68 /end MEASUREMENT
/begin MEASUREMENT IKCtl_ratLoadRngAdpn2 "Knock control: current value load adaptation range 2" UWORD rel_uw_q0p0234 1 100 0.00 1535.977 FORMAT "%8.3" ECU_ADDRESS 0x60013D6A /end MEASUREMENT
/begin MEASUREMENT IKCtl_ratLoadRngAdpn3 "Knock control: current value load adaptation range 3" UWORD rel_uw_q0p0234 1 100 0.00 1535.977 FORMAT "%8.3" ECU_ADDRESS 0x60013D6C /end MEASUREMENT
/begin MEASUREMENT IKCtl_ratLoadThd "current value of load threshold knock control in homogeneous operation" UWORD rel_uw_q0p0234 1 100 0.00 1535.977 FORMAT "%8.3" ECU_ADDRESS 0x60013D6E /end MEASUREMENT
/begin MEASUREMENT IKCtl_ratOffsLoadDynDetnThd "Actual offset value for load dynamics detection threshold" UWORD rel_uw_q0p0234 1 100 0.00 1535.977 FORMAT "%8.3" ECU_ADDRESS 0x60013D70 /end MEASUREMENT
/begin MEASUREMENT IKCtl_ratRelAirChrg "Filtered gradient of the relative air-charge in the cylinder" UWORD rel_uw_q0p0234 1 100 0.00 1535.977 FORMAT "%8.3" ECU_ADDRESS 0x7000396C /end MEASUREMENT
/begin MEASUREMENT IKCtl_stBackwInjCalcn "status word for backward calculation of injection timing" UBYTE dez 1 100 0.00 255.0 FORMAT "%5.1" ECU_ADDRESS 0x70003201 /end MEASUREMENT
/begin MEASUREMENT IKCtl_stInjDTot_b8 "knock control: copy of mask injection cut off pattern total" UBYTE dez 1 100 0.00 255.0 FORMAT "%5.1" ECU_ADDRESS 0x6000F7AA /end MEASUREMENT
/begin MEASUREMENT IKCtl_stInjRefCorr "Correction of reference level if injections lies in measurement window" UBYTE dez 1 100 0.00 255.0 FORMAT "%5.1" ECU_ADDRESS 0x700036FF /end MEASUREMENT
/begin MEASUREMENT IKCtl_stInjRefDetn "internal state for injection noise detection" UBYTE dez 1 100 0.00 255.0 FORMAT "%5.1" ECU_ADDRESS 0x70003200 /end MEASUREMENT
/begin MEASUREMENT IKCtl_stSnsrErr_u8 "knock control: state knock sensor/line error" UBYTE dez 1 100 0.00 255.0 FORMAT "%5.1" ECU_ADDRESS 0x6000F7A8 /end MEASUREMENT
/begin MEASUREMENT IKCtl_tEna "temperature used for knock control" SWORD Temp_Cels 1 100 -3549.940 3003.560 FORMAT "%8.3" ECU_ADDRESS 0x600080A8 /end MEASUREMENT
/begin MEASUREMENT IKCtl_tmpReIniBBKR "Local variable in BBKR to re-initialise the ASCET classes with no memory when entering drive from postdrive" UBYTE B_TRUE 1 100 0.00 1.00000000000 BIT_MASK 0x1 FORMAT "%13.11" ECU_ADDRESS 0x70000409 /end MEASUREMENT
/begin MEASUREMENT injmodekr_l "injection mode, KC internal" ULONG dez 1 100 0.00 4294967295.00 FORMAT "%13.2" ECU_ADDRESS 0x700031FC /end MEASUREMENT
/begin MEASUREMENT InjSys_pRailHpSwtOffEng "rail pressure at shut off" UWORD RBPtCel_p_0p002_1 1 100 0.00 131.0700 FORMAT "%8.4" ECU_ADDRESS 0x600397A6 /end MEASUREMENT
/begin MEASUREMENT krdydlyd_l "Knock control: buffer for delayed exceed dynamic load threshold." ULONG dez 1 100 0.00 4294967295.00 FORMAT "%13.2" ECU_ADDRESS 0x600004A8 /end MEASUREMENT
/begin MEASUREMENT krdyndelay "IKC: current delay for the dynamic signals" UBYTE dez 1 100 0.00 31.00 FORMAT "%5.2" ECU_ADDRESS 0x6000091D /end MEASUREMENT
/begin MEASUREMENT krdyofdd_l "Knock control: buffer for delayed exceed dynamic load offset." ULONG dez 1 100 0.00 4294967295.00 FORMAT "%13.2" ECU_ADDRESS 0x600004AC /end MEASUREMENT
/begin MEASUREMENT mnvzot_w "Minimum distance of cylinder for direct start" UWORD kw_q0p1 1 100 0.00 6553.500 FORMAT "%8.3" ECU_ADDRESS 0x70003208 /end MEASUREMENT
/begin MEASUREMENT msnagru_w "target value extern egr mass flow (standardized) without correction" UWORD m_q0p1 1 100 0.00 6553.500 FORMAT "%8.3" ECU_ADDRESS 0x600011D4 /end MEASUREMENT
/begin MEASUREMENT ngkrv "Knock control: instantaneous value of threshold speed dynamics" SBYTE nmotg_sb_q100 1 100 -12800. 12700. FORMAT "%5.0" ECU_ADDRESS 0x6000F156 /end MEASUREMENT
/begin MEASUREMENT range_pre "Secondary variable to calculate destrange" UBYTE dez 1 100 0.00 255.0 FORMAT "%5.1" ECU_ADDRESS 0x70003206 /end MEASUREMENT
/begin MEASUREMENT rest_w "Secondary variable to calculate destrange" UWORD kw_q0p1 1 100 0.00 6553.500 FORMAT "%8.3" ECU_ADDRESS 0x70003204 /end MEASUREMENT
/begin MEASUREMENT rirs_w "desired relative inertgas charge from int. and ext. EGR" UWORD rel_q0p02344 1 100 0.00 1535.977 FORMAT "%8.3" ECU_ADDRESS 0x600011D2 /end MEASUREMENT
/begin MEASUREMENT rlploc_w "Charge that is basis for the minimum distance between target cylinder and its ITDC" UWORD rel_uw_q0p0234 1 100 0.00 1535.977 FORMAT "%8.3" ECU_ADDRESS 0x70003202 /end MEASUREMENT
/begin MEASUREMENT stkrlx "load range adaption map KC" UBYTE dez 1 100 0.00 255.0 FORMAT "%5.1" ECU_ADDRESS 0x60000922 /end MEASUREMENT
/begin MEASUREMENT ub "Battery voltage" UBYTE spg_ubatt 1 100 0.00 24.02 FORMAT "%5.2" ECU_ADDRESS 0x6000F191 /end MEASUREMENT
/begin MEASUREMENT ubdq "battery voltage (on board), double standard quantization" UBYTE spg_q0p2 1 100 0.00 51.00 FORMAT "%5.2" ECU_ADDRESS 0x6000F190 /end MEASUREMENT
/begin MEASUREMENT ubdq_w "battery voltage (on board), double standard quantization" UWORD spg_q0p78125Em3 1 100 0.00 51.19922 FORMAT "%8.5" ECU_ADDRESS 0x600080F8 /end MEASUREMENT
/begin MEASUREMENT ubrdq "battery voltage(higher range) via main relay, standard quantization" UBYTE spg_q0p2 1 100 0.00 51.00 FORMAT "%5.2" ECU_ADDRESS 0x6000F18F /end MEASUREMENT
/begin MEASUREMENT ubrdq_w "battery voltage (on board), double standard quantization" UWORD spg_q0p78125Em3 1 100 0.00 51.19922 FORMAT "%8.5" ECU_ADDRESS 0x600080F6 /end MEASUREMENT
/begin MEASUREMENT ubrsq "battery voltage via main relay, standard quantization" UBYTE spg_q0p1 1 100 0.00 25.50 FORMAT "%5.2" ECU_ADDRESS 0x6000F18E /end MEASUREMENT
/begin MEASUREMENT ubrsqf_w "battery voltage via main relay, standard quantization, filtered value" UWORD spg_q0p00039 1 100 0.00 25.59961 FORMAT "%8.5" ECU_ADDRESS 0x600080F4 /end MEASUREMENT
/begin MEASUREMENT ubrsq_w "battery voltage (word) via main relay, standard quantization" UWORD spg_q0p00039 1 100 0.00 25.59961 FORMAT "%8.5" ECU_ADDRESS 0x600080F2 /end MEASUREMENT
/begin MEASUREMENT ubsq "battery voltage (on board), conversed to standard quantization" UBYTE spg_q0p1 1 100 0.00 25.50 FORMAT "%5.2" ECU_ADDRESS 0x6000F18D /end MEASUREMENT
/begin MEASUREMENT ubsqf "battery voltage (on board), conversed to standard quantization and low pass filt" UBYTE spg_q0p1 1 100 0.00 25.50 FORMAT "%5.2" ECU_ADDRESS 0x6000F18C /end MEASUREMENT
/begin MEASUREMENT ubsqf_w "battery voltage (on board), conversed to standard quantization and low pass filt" UWORD spg_q0p00039 1 100 0.00 25.59961 FORMAT "%8.5" ECU_ADDRESS 0x600080F0 /end MEASUREMENT
/begin MEASUREMENT ubsq_w "battery voltage (on board), conversed to standard quantization" UWORD spg_q0p00039 1 100 0.00 25.59961 FORMAT "%8.5" ECU_ADDRESS 0x600080EE /end MEASUREMENT
/begin MEASUREMENT wdirst_msg "Angular distance (in Crankshaft angle) of target cylinder from its ignition top dead-centre" UBYTE kw_q2 1 100 0.00 510.0 FORMAT "%5.1" ECU_ADDRESS 0x7000364F /end MEASUREMENT
/begin MEASUREMENT wesot1kra_w "Injection begin angle first injection refferd to ITDC" SWORD kw_q0p0234 1 100 -768.0000 767.9766 FORMAT "%8.4" ARRAY_SIZE 4 ECU_ADDRESS 0x700031F2 /end MEASUREMENT
/begin MEASUREMENT wesot1kre_w "Injection end angle first injection refferd to ITDC" SWORD kw_q0p0234 1 100 -768.0000 767.9766 FORMAT "%8.4" ARRAY_SIZE 4 ECU_ADDRESS 0x700031EA /end MEASUREMENT
/begin MEASUREMENT wesot1kr_w "Injection angle first injection refferd to ITDC" SWORD kw_q0p0234 1 100 -768.0000 767.9766 FORMAT "%8.4" ECU_ADDRESS 0x700031E8 /end MEASUREMENT
/begin MEASUREMENT wesot2kra_w "Injection begin angle second injection refferd to ITDC" SWORD kw_q0p0234 1 100 -768.0000 767.9766 FORMAT "%8.4" ARRAY_SIZE 4 ECU_ADDRESS 0x700031E0 /end MEASUREMENT
/begin MEASUREMENT wesot2kre_w "Injection end angle second injection refferd to ITDC" SWORD kw_q0p0234 1 100 -768.0000 767.9766 FORMAT "%8.4" ARRAY_SIZE 4 ECU_ADDRESS 0x700031D8 /end MEASUREMENT
/begin MEASUREMENT wesot2kr_w "Injection angle second injection refferd to ITDC" SWORD kw_q0p0234 1 100 -768.0000 767.9766 FORMAT "%8.4" ECU_ADDRESS 0x700031D6 /end MEASUREMENT
/begin MEASUREMENT wesot3kra_w "Injection begin angle third injection refferd to ITDC" SWORD kw_q0p0234 1 100 -768.0000 767.9766 FORMAT "%8.4" ARRAY_SIZE 4 ECU_ADDRESS 0x700031CE /end MEASUREMENT
/begin MEASUREMENT wesot3kre_w "Injection end angle third injection refferd to ITDC" SWORD kw_q0p0234 1 100 -768.0000 767.9766 FORMAT "%8.4" ARRAY_SIZE 4 ECU_ADDRESS 0x700031C6 /end MEASUREMENT
/begin MEASUREMENT wesot3kr_w "Injection angle third injection refferd to ITDC" SWORD kw_q0p0234 1 100 -768.0000 767.9766 FORMAT "%8.4" ECU_ADDRESS 0x700031C4 /end MEASUREMENT
/begin MEASUREMENT wesot4kra_w "Injection begin angle fourth injection refferd to ITDC" SWORD kw_q0p0234 1 100 -768.0000 767.9766 FORMAT "%8.4" ARRAY_SIZE 4 ECU_ADDRESS 0x700031BC /end MEASUREMENT
/begin MEASUREMENT wesot4kre_w "Injection end angle fourth injection refferd to ITDC" SWORD kw_q0p0234 1 100 -768.0000 767.9766 FORMAT "%8.4" ARRAY_SIZE 4 ECU_ADDRESS 0x700031B4 /end MEASUREMENT
/begin MEASUREMENT wesot4kr_w "Injection angle fourth injection refferd to ITDC" SWORD kw_q0p0234 1 100 -768.0000 767.9766 FORMAT "%8.4" ECU_ADDRESS 0x700031B2 /end MEASUREMENT
/begin MEASUREMENT wesot5kra_w "Injection begin angle fifth injection referred to ITDC" SWORD kw_q0p0234 1 100 -768.0000 767.9766 FORMAT "%8.4" ARRAY_SIZE 4 ECU_ADDRESS 0x700031AA /end MEASUREMENT
/begin MEASUREMENT wesot5kre_w "Injection end angle fifth injection refferred to ITDC" SWORD kw_q0p0234 1 100 -768.0000 767.9766 FORMAT "%8.4" ARRAY_SIZE 4 ECU_ADDRESS 0x700031A2 /end MEASUREMENT
/begin MEASUREMENT wmfaes "Measurement window begin reffered to TDC for injection noise detection" SWORD kw_q0p0234 1 100 -768.0000 767.9766 FORMAT "%8.4" ECU_ADDRESS 0x700031A0 /end MEASUREMENT
/begin MEASUREMENT wmfees "Measurement window end reffered to TDC for injection noise detection" SWORD kw_q0p0234 1 100 -768.0000 767.9766 FORMAT "%8.4" ECU_ADDRESS 0x7000319E /end MEASUREMENT
/begin MEASUREMENT wub "battery voltage; scanned value of ADC" UBYTE spg_ubatt 1 100 0.00 24.02 FORMAT "%5.2" ECU_ADDRESS 0x6000F18B /end MEASUREMENT
/begin MEASUREMENT wub_w "battery voltage; scanned value of ADC (16Bit from 10Bit resolution)" UWORD spg_uw_q0p023481 1 100 0.00 1538.827 FORMAT "%8.3" ECU_ADDRESS 0x600080EC /end MEASUREMENT
/begin MEASUREMENT zaeldy "Knock control: counter for dynamic adaption" UBYTE t_q0p01 1 100 0.00 2.550 FORMAT "%5.3" ECU_ADDRESS 0x60000926 /end MEASUREMENT
/begin MEASUREMENT zaeldyke "Knock control: counter for load dynamic" UBYTE t_q0p01 1 100 0.00 2.550 FORMAT "%5.3" ECU_ADDRESS 0x60000927 /end MEASUREMENT
/begin MEASUREMENT zaendy "Knock control: counter for engine speed dynamic" UBYTE t_q0p01 1 100 0.00 2.550 FORMAT "%5.3" ECU_ADDRESS 0x60000928 /end MEASUREMENT
/begin FUNCTION BattECU_EBS "6.16.0    BattECU LIN frames"
 /begin DEF_CHARACTERISTIC ComEBS_iBattAvgLINOffOfs_C ComEBS_iBattAvgLINOffSlp_C ComEBS_iBattAvgLINOffThd_C ComEBS_iBattAvgLINOff_C ComEBS_iBattBOfs_C ComEBS_iBattBSlp_C ComEBS_iBattMax_C ComEBS_iBattMin_C ComEBS_iBattSensEBSA_C ComEBS_iStByCurrAft0hTypBOfs_C ComEBS_iStByCurrAft0hTypB_C ComEBS_iStByCurrTypBSlp_C ComEBS_qStByCurrAft1hTypBOfs_C ComEBS_qStByCurrAft1hTypB_C ComEBS_qStByCurrAft2hTypBOfs_C ComEBS_qStByCurrAft2hTypB_C ComEBS_qStByCurrLstTypBOfs_C ComEBS_qStByCurrLstTypB_C ComEBS_rBattMax_C ComEBS_rBattMin_C ComEBS_rBattSensBChOfs_C ComEBS_rBattSensBChSlp_C ComEBS_rBattStatMax_C ComEBS_rBattStatMin_C ComEBS_rBattStratOfs_C ComEBS_rBattStratSlp_C ComEBS_rBattStrat_C ComEBS_resMax_C ComEBS_resMin_C ComEBS_resOthMax_C ComEBS_resOthMin_C ComEBS_tBattASICMax_C ComEBS_tBattASICMin_C ComEBS_tBattMax_C ComEBS_tBattMin_C ComEBS_tBattSensASICOfs_C ComEBS_tBattSensASICSlp_C ComEBS_tBattSensOfs_C ComEBS_tBattSensSlp_C ComEBS_tiDurAftIgnOffOfs_C ComEBS_tiDurAftIgnOffSlp_C ComEBS_uBattMax_C ComEBS_uBattMin_C ComEBS_uBattOCVOfs_C ComEBS_uBattOCVSlp_C ComEBS_uBattSensBOfs_C ComEBS_uBattSensBSlp_C ComEBS_uBattSensEBSA_C Com_dEBSDByt0_C Com_dEBSDByt1_C Com_dEBSDByt2_C Com_dEBSDByt3_C Com_dEBSDByt4_C Com_ratSoh_C EBS_qNorm_C /end DEF_CHARACTERISTIC
 /begin IN_MEASUREMENT Lin_BS_B_Signal_OCV_8_r_msg Lin_BS_B_Signal_STBATTSENRST_1_r_msg Lin_BS_B_Signal_TASIC_8_r_msg Lin_BS_B_Signal_tiDurAftIgnOff_16_r_msg Lin_BS_Signal_B_BATTCH_16_r_msg Lin_BS_Signal_B_BATTDCHA_16_r_msg Lin_BS_Signal_B_BATT_REPLACE_1_r_msg Lin_BS_Signal_B_BATT_SIZE_DETECT_1_r_msg Lin_BS_Signal_B_BATT_WARM_LEVEL_3_r_msg Lin_BS_Signal_B_BCF_1_r_msg Lin_BS_Signal_B_CHARGE_LOW_1_r_msg Lin_BS_Signal_B_CTINTRESUPD_2_r_msg Lin_BS_Signal_B_DATA_FORMAT_8_r_msg Lin_BS_Signal_B_ERROR_RES_1_r_msg Lin_BS_Signal_B_HARNR_2_r_msg Lin_BS_Signal_B_IBAT_16_r_msg Lin_BS_Signal_B_IBAT_8_r_msg Lin_BS_Signal_B_IOP_ERROR_1_r_msg Lin_BS_Signal_B_iStByCurrAft0h_10_r_msg Lin_BS_Signal_B_iStByCurrAft1h_10_r_msg Lin_BS_Signal_B_iStByCurrAft2h_10_r_msg Lin_BS_Signal_B_iStByCurrLst_10_r_msg Lin_BS_Signal_B_MEASDR_2_r_msg Lin_BS_Signal_B_RESMEASDBATT_16_r_msg Lin_BS_Signal_B_RI_ST_OTHER_MEASURE_16_r_msg Lin_BS_Signal_B_SOC_8_r_msg Lin_BS_Signal_B_SOC_STATE_3_r_msg Lin_BS_Signal_B_SOFV_RESTART_8_r_msg Lin_BS_Signal_B_SOFV_RESTART_STATE_1_r_msg Lin_BS_Signal_B_SOH_COR_8_r_msg Lin_BS_Signal_B_SOH_COR_STATE_1_r_msg Lin_BS_Signal_B_SOH_LAM_8_r_msg Lin_BS_Signal_B_SOH_LAM_STATE_1_r_msg Lin_BS_Signal_B_SOH_SUL_8_r_msg Lin_BS_Signal_B_SOH_SUL_STATE_1_r_msg Lin_BS_Signal_B_SUPPLIER_CODE_8_r_msg Lin_BS_Signal_B_TBAT_8_r_msg Lin_BS_Signal_B_UBAT_16_r_msg Lin_BS_Signal_CHARERR_1_r_msg Lin_BS_Signal_ERRCMN_1_r_msg Lin_BS_Signal_ERRST_1_r_msg Lin_BS_Signal_IBATTAVGLINOFF_8_r_msg SyC_ctPostDrvLeave /end IN_MEASUREMENT
 /begin OUT_MEASUREMENT ComEBS_chAcmBattCh ComEBS_chAcmBattChEBSC ComEBS_chAcmBattDcha ComEBS_chAcmBattDchaEBSC ComEBS_chBattDgrtRate ComEBS_ctIntResUpdEBSF ComEBS_iBattAvgLINOff ComEBS_iBattSensEBSA ComEBS_iBattSensTmp ComEBS_iStByCurrAft0hTypB ComEBS_qStByCurrAft1hTypB ComEBS_qStByCurrAft2hTypB ComEBS_qStByCurrLstTypB ComEBS_rBattSensCh ComEBS_rBattSensChEBSB ComEBS_rBattSensTmp ComEBS_rBattStrat ComEBS_resMeasdBattREBSF ComEBS_resMeasdBattROth ComEBS_resMeasdBattRTmp ComEBS_stBattAbnormExtDrvCtrl ComEBS_stBattBlindCh ComEBS_stBattBlindChEBSE ComEBS_stBattComResErr ComEBS_stBattDchaVltgPrdnSig ComEBS_stBattDgrtSig ComEBS_stBattExch ComEBS_stBattPolarDgrtSig ComEBS_stBattSensSOCstatEBSB ComEBS_stBattShortChrg ComEBS_stBattSizeDetc ComEBS_stBattSplrDiscern ComEBS_stBattStratSig ComEBS_stBattWrmLvl ComEBS_stCharErr ComEBS_stDataDiscern ComEBS_stHarnR ComEBS_stMeasdR ComEBS_stSensErr ComEBS_stSensErrAftIgnOff ComEBS_stSensRst ComEBS_stSensRstEBSE ComEBS_tBattSens ComEBS_tBattSensASIC ComEBS_tBattSensASICEBSF ComEBS_tBattSensEBSB ComEBS_tBattSensTmp ComEBS_tiDurAftIgnOff ComEBS_tiDurAftIgnOffEBSC ComEBS_uBattDchaVltgPrdn ComEBS_uBattPolarDgrt ComEBS_uBattSens ComEBS_uBattSensEBSA ComEBS_uBattSensTmp ComEBS_uBattUCO ComEBS_uBattUCOEBSE Com_bBliChrg Com_cntrIntResUpd Com_ctReIni10msBattECU_EBS_B Com_dEBSDByt0 Com_dEBSDByt1 Com_dEBSDByt2 Com_dEBSDByt3 Com_dEBSDByt4 Com_flgEbsRst Com_iBattEBS Com_iStbIAft0Hr Com_qChrg Com_qDisChrg Com_qSoh Com_qStbIAft1Hr Com_qStbIAft2Hr Com_qStbILast Com_ratSoc Com_ratSoh Com_rMeasdBattREbs Com_stBattDchaVltgPrdnSig Com_stBattDgrtSig Com_stCharErr Com_stI Com_stSensErr Com_stSoc Com_stT Com_stU Com_tBattEBS Com_tiDurnAftIgnOff Com_uBattEBS Com_uPeak /end OUT_MEASUREMENT
 FUNCTION_VERSION "6.16.0" /end FUNCTION
/begin FUNCTION BattU2MED "1.8.2     Interface Adapter BattU to MED" /begin DEF_CHARACTERISTIC TDUBEVAB UBEVABW /end DEF_CHARACTERISTIC /begin IN_MEASUREMENT BattU_u BattU_uSens /end IN_MEASUREMENT
 /begin OUT_MEASUREMENT B_hrevab B_kdhre B_ubg ub ubdq ubdq_w ubrdq ubrdq_w ubrsq ubrsqf_w ubrsq_w ubsq ubsqf ubsqf_w ubsq_w wub wub_w /end OUT_MEASUREMENT
 FUNCTION_VERSION "1.8.2" /end FUNCTION
/begin FUNCTION BattU_DD "2.14.0    Battery Voltage Acquisition Device Driver" /begin DEF_CHARACTERISTIC BattU_uTransf_CUR /end DEF_CHARACTERISTIC /begin OUT_MEASUREMENT BattU_uRaw BattU_uSens /end OUT_MEASUREMENT /begin LOC_MEASUREMENT BattU_SensBuf BattU_SensBufLoc BattU_uRaw_mp ctBattSamples /end LOC_MEASUREMENT FUNCTION_VERSION "2.14.0" /end FUNCTION
/begin FUNCTION BattU_DrpPrv "6.0.0_2.0.0Power pump to inhibit voltage drops in case of initiate"
 /begin DEF_CHARACTERISTIC BattU_cntrEngRunStab_C BattU_cntrIgnBoostMax_C BattU_stPwrStgDiaDis_C BattU_tiCSTDef_C BattU_tiStabPsOffDly_C BattU_tiStabPsOnDly_C BattU_uIgnBoostEna_C Batt_tiCSTWarrant_C /end DEF_CHARACTERISTIC
 /begin IN_MEASUREMENT BattU_u CoEng_st ComDCDC_stCSTHist CoVOM_bEngPreStrtOrd DevLib_stPwrStgEnaCond Strt_stStaActv T15_st /end IN_MEASUREMENT
 /begin OUT_MEASUREMENT BattU_flgBoostActvnCdn BattU_stStabPs /end OUT_MEASUREMENT
 /begin LOC_MEASUREMENT BattU_cntrEngRun BattU_cntrMax BattU_flgBoostOffCond BattU_flgCntrLim Battu_flgRstrtReq BattU_flgStrtBoostActvn BattU_stCSTEnbl_mp BattU_stDiagCmpl_mp BattU_stFltTstEnaCond_mp BattU_stFltTstRst_mp BattU_stIgnBoostActvn BattU_tiCSTDef_mp Battu_tiCSTWarrant /end LOC_MEASUREMENT
 FUNCTION_VERSION "6.0.0_2.0.0" /end FUNCTION
/begin FUNCTION BattU_PwrFail "2.9.0     Battery Voltage Powerfail Detection" /begin OUT_MEASUREMENT BattU_stPwrFail /end OUT_MEASUREMENT /begin LOC_MEASUREMENT BattU_flgPwrFail /end LOC_MEASUREMENT FUNCTION_VERSION "2.9.0" /end FUNCTION
/begin FUNCTION BattU_UStbyDia "2.1.1     Diagnosis of stand-by power supply line" /begin DEF_CHARACTERISTIC BattU_numUStbyDiaDeb_C /end DEF_CHARACTERISTIC /begin IN_MEASUREMENT BattU_stPwrFail /end IN_MEASUREMENT
 /begin LOC_MEASUREMENT BattU_flgEEPWriteRetVal BattU_NrEveCntr BattU_PrevErrSt BattU_stEEPBlockRetVal BattU_stEepEveCnt BattU_stEepPrevErr /end LOC_MEASUREMENT
 FUNCTION_VERSION "2.1.1" /end FUNCTION
/begin FUNCTION BattU_VD "40.2.0_1.1.0Battery Voltage Acquisition Virtual Device"
 /begin DEF_CHARACTERISTIC BattU_facFild_C BattU_flgBattDetnIMGECUEna_C BattU_flgBattDetnTCUECUEna_C BattU_flgBattUMonEna_C BattU_nEngStabThd_C BattU_RmpSlpNeg_C BattU_RmpSlpPos_C BattU_stSensId_C BattU_swtCorFacActv_C BattU_swtRated_C BattU_tiIgnONDlyThd_C BattU_tiSensLo_C BattU_tiSRCActvDly_C BattU_uHiUFailrThd_C BattU_uLoUFailrThd_C BattU_uNrm_C BattU_uSensLo_C BattU_uSnsrFildIni_C BattU_uSRCMax_C BattU_uSRCMin_C BattU_uTransDft_C BattU_uWrgDetnPrevnThd_C BattU_vSRCMaxLim_C /end DEF_CHARACTERISTIC
 /begin IN_MEASUREMENT BattU_uRaw BattU_uSens CoEng_st Com_uBattDetnIMGECU Com_uBattDetnTCUECU Epm_nEng MRly_st SyC_ctPostDrvLeave SyC_stSub T15_st VehV_v /end IN_MEASUREMENT
 /begin OUT_MEASUREMENT BattU_facCor BattU_flgHiUFailrCfmd BattU_flgHiUNormCfmd BattU_flgLoUFailrCfmd BattU_flgLoUNormCfmd BattU_stEngCmbCmpl BattU_stErrDSQ BattU_u BattU_uRated BattU_uSnsrFild /end OUT_MEASUREMENT
 /begin LOC_MEASUREMENT BattU_cntrReIni BattU_flgChrgrCnctd BattU_flgErrDSQ BattU_flgIgnOnDlyDiagEna BattU_uBattDetnIMGCnv BattU_uBattDetnTCUCnv /end LOC_MEASUREMENT
 FUNCTION_VERSION "40.2.0_1.1.0" /end FUNCTION
/begin FUNCTION Batt_DataAcq "22.21.0   Battery"
 /begin DEF_CHARACTERISTIC Batt_chStopEnaThres_C Batt_chStrtReqThres_C Batt_cntrOCVThd_C Batt_facHiChrgnEff_T Batt_facLoChrgnEff_T Batt_facSOCStdy_C Batt_flgDarkIAllw_C Batt_flgSt5ChrgModDi_C Batt_flgSwtBattSeln_C Batt_iChrgnThdDelta_C Batt_iChrgnThd_M Batt_iOCVDchaThd_C Batt_iOCVDetnThd_C Batt_iOCVThd_C Batt_qAdjCnsChk_C Batt_qBliChrgLim_C Batt_qCap20_C Batt_qChgCap20_C Batt_qDeltaDchaCmpl_C Batt_qDodLimHi_C Batt_qDodLimLo_C Batt_qDodStopEnaLim_C Batt_qDodStrtReqLim_C Batt_qNrm1_C Batt_qNrm2_C Batt_qSumHiRcv_C Batt_qSumHiThd_C Batt_qSumLoLimThd_C Batt_qSumLoLmt_C Batt_qSumLoRcv_C Batt_qSumLoThd_C Batt_qSumRCThd1_C Batt_qSumRCThd2_C Batt_qSumSOCRawThd_C Batt_qSumSOCThd_C Batt_qTotDChaCmpl_C Batt_ratAcptdLowSoc_C Batt_ratLowSocChrgFinsh_C Batt_ratSocTgt_C Batt_ratSocThdStopEna_C Batt_ratSoh4SofLim_C Batt_ratSohStopEnaLim_C Batt_ratSohThres_C Batt_rDarkIAllwCondBThdHi_C Batt_rDarkIAllwCondBThdLo_C Batt_rDarkIThdCondAHi_C Batt_rDarkIThdCondALo_C Batt_SofCorrn_T Batt_stLoSocDetn_C Batt_stSigSeln_C Batt_stSocErrSel_C Batt_stSocRlbtJdg_C Batt_stStartErrMsk_C Batt_stStopErrMsk_C Batt_swtDataSrcSel_C Batt_tBattStopEnaHiLim_C Batt_tBattStopEnaLim_C Batt_tBattStrtReqLim_C Batt_tBattThres_C Batt_tiBattCodChgID1_C Batt_tiBattCodChgID2_C Batt_tiChrgnIThd_C Batt_tiCum1_C Batt_tiCum2_C Batt_tiCurrThd_C Batt_tiDchaThd_C Batt_tiOCVDetnThd_C Batt_tiOCVVoltThd_C Batt_tiStopDurMin_C Batt_uChrgThd_C Batt_uOCVDchaThd_C Batt_uOCVDetnThd_T Batt_uOCVLimThd_C Batt_uSofStopEnaLim_C Batt_uSofStrtReqLim_C Batt_uSofThres_C IBSUMH.Batt_qSumHiLim_C IBSUMHNR.Batt_qSumHiNRLim_C IBSUML.Batt_qSumLoLim_C /end DEF_CHARACTERISTIC
 /begin IN_MEASUREMENT Alt_flgTBattMin Alt_iBattSetIn Alt_uDes BattU_stPwrFail BattU_u Batt_flgDeternDetd Batt_flgInhbSpst BdInt_stHoodOpenDurgEngStrt CoEng_st CoEng_tiStartRed ComEBS_stBattSizeDetc Com_bBliChrg Com_lDst Com_qSoh Com_ratSoc Com_stSensErr Com_stSoc Com_tBattEBS CoVOM_bSSEEngStopPassed CoVOM_stSSE Ebs_flgBliChrgCalcnCmpl Ebs_flgRst Ebs_flgSOCFlt Ebs_iBattFild Ebs_qBliChrg Ebs_qBliDcha Ebs_qSohFild Ebs_qTotBliDcha Ebs_ratSocFild Ebs_ratSohFild Ebs_stBattInvld Ebs_stBattRVld Ebs_stEbsPlausyChk Ebs_stErr Ebs_stSocErrChk Ebs_tBattFild Ebs_uBattFild Ebs_uSofFild EEM_chBatt EEM_stBattChAc Eep_EnvRamInvld Epm_nEng SyC_ctPostDrvLeave T15_st /end IN_MEASUREMENT
 /begin OUT_MEASUREMENT Batt_bEngStopEna Batt_bEngStrtReq Batt_flgChrgChartcDgrtDetn Batt_flgChrgILo Batt_flgChrgMod Batt_flgDarkIAllwCondA Batt_flgDarkIAllwCondB Batt_flgDarkIProhb Batt_flgLoSocJdgAftEngRun Batt_flgOCV Batt_flgRcvChrgCmpl Batt_flgSocCalcn Batt_flgSt1Cmpl Batt_flgSt7Tran Batt_lMaxCnsChk Batt_lMinCnsChk Batt_qCap20 Batt_qChrgCnsChkAH Batt_qCnsChk Batt_qCnsChkAH Batt_qDchaCnsChkAH Batt_qMaxCnsChk Batt_qMaxCnsChkAH Batt_qMinCnsChk Batt_qMinCnsChkAH Batt_qSumHi Batt_qSumHiNR Batt_qSumLo Batt_qSumRaw Batt_qSumRCINI Batt_qSumStdy Batt_ratSoc Batt_ratSOCCalc Batt_stCalc Batt_stCalcPrev Batt_stEbsBattCod Batt_stEngStopInhbn Batt_stZero ESS_uBatt /end OUT_MEASUREMENT
 /begin LOC_MEASUREMENT Batt_cntrIniDrv100ms Batt_cntrIniDrv10ms Batt_cntrOCV Batt_cntrStrt Batt_cntrStrtIn Batt_facHiChrgnEff Batt_facLoChrgnEff Batt_flgAltFailr Batt_flgChrgCmpl Batt_flgCnsChkEna Batt_flgCntrExcd Batt_flgDarkIAllwCdnAHys Batt_flgDarkIAllwCdnBHys Batt_flgDarkIJudgLo Batt_flgDarkIUpd Batt_flgDoDLimStrtReq Batt_flgDodStopDisbl Batt_flgDodStrtReq Batt_flgDrkDchaRst Batt_flgFullChrg Batt_flgJSOrFailr Batt_flgRawCorrnCmpl Batt_flgRawExe Batt_flgRcvChrgNotCmpl Batt_flgSetSt8 Batt_flgSOCDiffDetd Batt_flgSOCDiffExcd Batt_flgSt1Hist Batt_flgSt8Rec Batt_flgStalEng Batt_flgStdyCorrnCmpl Batt_flgTransReas1 Batt_qBattDoD Batt_qBattFild Batt_qChrgCnsChk Batt_qDarkIJudgVal Batt_qDarkJudgValAHi Batt_qDarkJudgValALo Batt_qDarkJudgValBHi Batt_qDarkJudgValBLo Batt_qDchaCnsChk Batt_qSohTmp1_MP Batt_qSohTmp2_MP Batt_qSohTmp3_MP Batt_ratSoc_MP Batt_stBattCodChgID1 Batt_stBattCodChgID2 Batt_stChrgnIStopEna Batt_stDod Batt_stEbsBattCodLoc Batt_StrtEnbl_MP Batt_stSix Batt_stSoc_MP Batt_tiCumTi1 Batt_tiCumTi2 Batt_uSofOffs /end LOC_MEASUREMENT
 FUNCTION_VERSION "22.21.0" /end FUNCTION
/begin FUNCTION Batt_Detern "1.8.0     Indicate Battery Deterioration"
 /begin DEF_CHARACTERISTIC Batt_flgSwtSOCSeln_C Batt_qSumLoLim_C Batt_ratMinSocRBatt_C Batt_rBattDgrdLim_C Batt_rBattExchJudgThd_C Batt_rLimSysFailrHi_C Batt_rLimSysFailrLo_C Batt_rSlopBattDgrd_T Batt_rSlopISSEna_T Batt_tISSProhbModChg_C Batt_tISSProhb_C /end DEF_CHARACTERISTIC
 /begin IN_MEASUREMENT Batt_flgSt1Cmpl Batt_qSumLo Ebs_ratSocFild Ebs_rBatt Ebs_rBattAct Ebs_rBattMeasd Ebs_stRInhbSpst Ebs_tBattFild Eep_EnvRamInvld T15_st /end IN_MEASUREMENT
 /begin OUT_MEASUREMENT Batt_flgDeternDetd Batt_flgInhbSpst Batt_idxRDcyc Batt_rExch Batt_rMean /end OUT_MEASUREMENT
 /begin LOC_MEASUREMENT Batt_flgBattExch Batt_flgExchJudgCmpl Batt_flgIdxUpd Batt_flgISSInhbDcyc Batt_flgLimSysFailr Batt_flgRInhbISSLoc Batt_rBattExchJudg Batt_rBattOld Batt_rDcyc Batt_rSlopBattDgrd Batt_rSlopISSEna Batt_stREBSInhbSpst /end LOC_MEASUREMENT
 FUNCTION_VERSION "1.8.0" /end FUNCTION
/begin FUNCTION BBAGR "12.1.1    Turn-on conditions EGR"
 /begin DEF_CHARACTERISTIC ChrSet_tCooltEng_C ChrSet_tiDlyEgrEngStrt_C CWBBAGR DTKANAGR FNSWLAGR LAMDIAGR LAMKAGR LAMNSWAGR TAGEOAGRMN TKANAGRU TKMAGRO TKMAGRU TVAGREVAKT VFZGAGREN /end DEF_CHARACTERISTIC
 /begin IN_MEASUREMENT B_agrblamx_msg B_agrofflbts_msg B_agrvsg_msg B_bkvagrab_msg B_cdagr_msg B_cwagrap_msg B_disagrkd_msg B_dtdisagr_msg B_faagr_msg B_fagrfe_msg B_fedssb_msg B_kh_msg B_lamdiag_msg B_ll_msg B_lr_msg B_msagrsb_msg B_psrgg_msg B_psrmhg_msg CEngDsT_t fnswl_w_msg IKCtl_flgReqEnchmt InjSys_bInjVlvActv lamdiag_w_msg lamnswl_w_msg SyC_stSub tagreo_w_msg tansk_w_msg ThrVlv_flgLimpModeB1 ThrVlv_flgReqFuCutOffB1 tnse_w_msg TWCC_rLamSetPPurgB1 VehV_v /end IN_MEASUREMENT
 /begin OUT_MEASUREMENT B_agrbb_msg B_agrfsg_msg B_agrgsg_msg B_agrhen_msg B_agrsen_msg B_agrsg_msg B_agrstm_msg B_agr_msg B_disagr_msg B_evaktdel_msg B_fagrh_msg ChrSet_flgEgrRdyIndpdtIdle /end OUT_MEASUREMENT
 /begin LOC_MEASUREMENT B_agrhens B_agrlamen /end LOC_MEASUREMENT
 FUNCTION_VERSION "12.1.1" /end FUNCTION
/begin FUNCTION BBAGRA "10.2.0    Readiness for operation of EGR adaptation"
 /begin DEF_CHARACTERISTIC CWBBAGRA DMRAGRA DNAGRSS DNAGRSSKT MSKBAGRKT MSKBAGRMN MSKBAGRMX MSOFAGRKT MSOFAGRMN MSOFAGRMX NAGRSSMX NGRMNAGRSS NGRMXAGRSS PSREBAMN PSREOAMN PSREOAMNKT PUAGRSS TAAGRSS TAAGRSSKT TAGEOSDFMN TAONAGRA TDAGRSS TDAGRSSKT TDBAGRS TDBAGRSKT TDLAMSBG TKMAGRSS TKMAGRSSKT TMXVAGRSDF TNSAGRSS TNSAGRSSKT TVDAGRST TVTKAGRA TWAGRSS TWAGRSSKT VAGRSS /end DEF_CHARACTERISTIC
 /begin REF_CHARACTERISTIC FKVDVP CWBGAGRA CWKTAGRA /end REF_CHARACTERISTIC
 /begin IN_MEASUREMENT B_agron_msg B_agrstm_msg B_agrvsg_msg B_apsfoagr_msg B_bkvagrab_msg B_bkvmsisr_msg B_cdagr_msg B_dagrssf_msg B_disagr_msg B_faagr_msg B_fagrfe_msg B_ofagreg_msg B_sa_msg CEngDsT_t CoEng_nRstrt Epm_dnEngFlt Epm_nEng10ms ftmagr_msg lamsbg_w_msg msagrbs_w_msg pagreo_w_msg PEnv_p pnagrv_w_msg psrrexts_w_msg psrrext_w_msg SyC_stSub tagreo_w_msg tansk_w_msg tgagrv_w_msg ThrVlv_flgLimpModeB1 ThrVlv_flgRegTqRednB1 ThrVlv_flgReqFuCutOffB1 tnse_w_msg VehV_v /end IN_MEASUREMENT
 /begin OUT_MEASUREMENT B_dagrssg_msg B_dagrss_msg B_enkbagr_msg B_enofagr_msg B_fgabgagr_msg B_fgblagrs_msg B_ktagra_msg B_ktagrs_msg B_tkktagra_msg B_zdagrss_msg dmrdagr_w_msg /end OUT_MEASUREMENT
 /begin LOC_MEASUREMENT B_dagrssa B_dagrssans B_enagrada_msg B_fagrabkv B_fagradat_msg B_fagrada_msg B_fagralam msnagru_w /end LOC_MEASUREMENT
 FUNCTION_VERSION "10.2.0" /end FUNCTION
/begin FUNCTION BBAGRMW "3.1.0     Operating condition: AGR mode change"
 /begin DEF_CHARACTERISTIC CWBBAGRMW DMWAGR MDISAGRSMN RRIAGRHMN RRIAGRHMX RRIAGRMMN RRIAGRMMX RRIAGRSMN RRIAGRSMX /end DEF_CHARACTERISTIC
 /begin IN_MEASUREMENT B_agrhen_msg B_agrsen_msg B_agrvdisa_msg B_agrvsg_msg B_cdagr_msg B_dtdisagr_msg B_eagrv_msg B_evaktdel_msg B_khagrab_msg B_mwagrs_msg B_rqschfea_msg mibas_w_msg rirexofs_w_msg rirext_w_msg rirints_w_msg rir_w_msg rriext_w_msg SyC_stSub /end IN_MEASUREMENT
 /begin OUT_MEASUREMENT B_hmmagrdi_msg B_hmmagren_msg B_homagrdi_msg B_mwagr_msg B_schagrdi_msg B_schagren_msg /end OUT_MEASUREMENT
 /begin LOC_MEASUREMENT rirs_w /end LOC_MEASUREMENT
 FUNCTION_VERSION "3.1.0" /end FUNCTION
/begin FUNCTION BBDIRST "6.14.0_2.2.0Operating conditions starter supported direct start procedure" /begin DEF_CHARACTERISTIC CWBBDIRST KLKWVOTMN1 KLKWVZOTMN /end DEF_CHARACTERISTIC /begin REF_CHARACTERISTIC Epm_phiTdc1_C /end REF_CHARACTERISTIC
 /begin IN_MEASUREMENT CoEng_stMai EngStrt_flgEngStallg EngStrt_flgStrtEndTqStruct EngStrt_flgStrtFaild EngStrt_stStrtReq EngStrt_stStrtSit Epm_stSpd Epm_stSync rldirsta_w_msg rlp_w_msg SyC_ctDrvEnter SyC_stSub zzyls_msg /end IN_MEASUREMENT
 /begin OUT_MEASUREMENT B_noinjdst_msg destrange_msg EngStrt_flgDrctCoM EngStrt_flgDrctStrt wdirst_msg /end OUT_MEASUREMENT
 /begin LOC_MEASUREMENT BBSTHDR_rlp_w B_statdyn cntsyns engpos_w EngStrt_ctBBDIRST10msDrvEnter mnvzot_w range_pre rest_w rlploc_w /end LOC_MEASUREMENT
 FUNCTION_VERSION "6.14.0_2.2.0" /end FUNCTION
/begin FUNCTION BBKHFES "11.3.0    specif. of desired factors for air charge cont. actors in case of cat.heating"
 /begin DEF_CHARACTERISTIC CWBBKHFES ExhMgT_facCamsftIntkCatWrm_T ExhMgT_facCatWrmIntkCamsft_M ExhMgT_facIntkCamsftAltiCatHeatgAirm_GM ExhMgT_facIntkCamsftAlti_T ExhMgT_facIntkCamsftCatHeatgAirm_GM ExhMgT_facLamAltiCatHeatgAirm_GM ExhMgT_facLamCatHeatgAirm_GM ExhMgT_facLamCatHeatgRamp_M ExhMgT_facLamCatWrm_T ExhMgT_facLamCtrlAlti_T ExhMgT_tiFacCatheatgIntkCamsft_C ExhMgT_tiFilMfExhCat1B1_T ExhMgT_tiFilTCat_T SIM08KHUW STCS08KHSW /end DEF_CHARACTERISTIC
 /begin IN_MEASUREMENT ExhMgT_facCatHeatgFinshd ExhMgT_facCatHeatgProgs ExhMgT_facCatHeatgRamp ExhMgT_flgCatHeatgColdStrtReq ExhMgT_flgCatHeatgUpActv ExhMgT_flgCatHeatgWrmReq ExhMgT_tCatHeatgTCatSelnActn ExhMgT_tEngCatHeatgFild ExhMod_mfExhCat1B1 GEVCtl_flgPhaEnaIntk PEnv_facCorrAlti SyC_ctPostDrvLeave SyC_stSub /end IN_MEASUREMENT
 /begin OUT_MEASUREMENT flakh_msg flbkkh_msg fnwkha_msg fnwkhe_msg fnwkhnga_msg fnwkhnge_msg /end OUT_MEASUREMENT
 /begin LOC_MEASUREMENT BBKHFES_ctReIni ExhMgT_facCamsftCatHeatg ExhMgT_facCatHeatgIntkCamsft ExhMgT_facCatHeatgOutlCamsft ExhMgT_facCatWrmIntkCamsft ExhMgT_facLamCatHeatgRamp ExhMgT_facLamCtrl ExhMgT_facLamCtrlCatHeatg ExhMgT_facLamCtrlCatWrm ExhMgT_facRatLamCatHeatg ExhMgT_flgCatWrmCamsft ExhMgT_mfExhCat1B1Dif ExhMgT_mfExhCat1B1Fild ExhMgT_mfExhCat1B1Loc ExhMgT_tCatHeatgTCatSelnActnDif ExhMgT_tCatHeatgTCatSelnFild ExhMgT_tCatSelnActnLoc fnwkhevab /end LOC_MEASUREMENT
 FUNCTION_VERSION "11.3.0" /end FUNCTION
/begin FUNCTION BBKR "39.3.0    operation conditions knock control"
 /begin DEF_CHARACTERISTIC CWTIPIN IKCtl_agIntkB1Tn_C IKCtl_cntrRefCorrDurn_M IKCtl_cntrStrtEnd_C IKCtl_DlyTnKnkEna_T IKCtl_dnSelnFildGrdt_C IKCtl_facDlyAdpn_T IKCtl_facDlyLoadDynDetn_GT IKCtl_facFildNGrdt_C IKCtl_facKnkEna_C IKCtl_facOffsLoadDynDetn_GT IKCtl_facRefCorrnDurnSchtActvd_C IKCtl_facSpdAdpn1_C IKCtl_facSpdAdpn2_C IKCtl_facSpdAdpn3_C IKCtl_facSpdAdpn4_C IKCtl_facThdInltVlvDyn_GT IKCtl_facThdLoadDynDetnAirChrg_GM IKCtl_facThdLoadDynDetn_GT IKCtl_facThdNDynDetn_GT IKCtl_facTiLoadDynAdpnFFV_GM IKCtl_facTiLoadDynDetnFFV_GM IKCtl_facTiNDynDetn_GT IKCtl_facTThdAdpn_GT IKCtl_facTThdDyn_C IKCtl_facTThdKnk_GT IKCtl_nAdapEna_C IKCtl_nEnaInjDetn_C IKCtl_nSpdHys_C IKCtl_ratAirLoadThdN_GT IKCtl_ratEnaInjDetn_C IKCtl_ratHysLoad_C IKCtl_ratLoadDynDetnThd_GM IKCtl_ratLoadRngAdpnM1_GT IKCtl_ratLoadRngAdpnM2_GT IKCtl_ratLoadRngAdpnM3_GT IKCtl_ratLoadThd_GT IKCtl_stEnaInjDetn_C IKCtl_stSelnDesLoadFilGrdt_C IKCtl_stSelnFildAirChrgGrdt_C IKCtl_tiAddlOffsWinBgnInjNoiseDetn_T IKCtl_tiAddlOffsWinEndInjNoiseDetn_T IKCtl_tInltVlvAirTThd_C IKCtl_tiOffsWinBgnInjNoiseDetn_T IKCtl_tiOffsWinEndInjNoiseDetn_T KRLNMDY TATIPIN /end DEF_CHARACTERISTIC
 /begin REF_CHARACTERISTIC IKCtl_fac04_X_AX IKCtl_nEng08_X_AX IKCtl_nEngVar13_X_AX IKCtl_ratLoadDy04_X_AX IKCtl_stLimp_C /end REF_CHARACTERISTIC
 /begin IN_MEASUREMENT AirMod_ratChrgAirCyl B_basch_msg B_kh_msg B_ll_msg B_nmax_msg B_sa_msg CEngDsT_t CEngDsT_tStrt Clth_st CoEOM_bTransActv DSM_TripChgFinshd EngStrt_bStrtEnd Epm_dnEngAvg Epm_nEng Epm_stOpMode Epm_stSync evz_austot_msg fethmnmx_msg GEVlv_agIntkB1 Ign_stiaBasKnk IKCtl_agDynAdpnOffs_s8 IKCtl_cntrCyl IKCtl_flgAdpnWrEnaCopy IKCtl_flgKnkDetn IKCtl_flgSftyRtdtGdCyl IKCtl_iaMeasWinBgn_s8 IKCtl_iaMeasWinLngth_s8 IKCtl_nFildGrad_s8 IKCtl_stMaskGdCly_b8 IKCtl_stVldnSnsrSig injmode_l_msg psrs_w_msg rlsol_w_msg SyC_ctPostDrvLeave SyC_stSub taev_w_msg tans_msg ti1a_l_msg ti2a_l_msg ti3a_l_msg ti4a_l_msg tpes1a_w_msg tpes2a_w_msg tpes3a_w_msg tpes4a_w_msg Tra_numGear VehV_flgStandStill wesot1a_w_msg wesot2a_w_msg wesot3a_w_msg wesot4a_w_msg zzylh_msg zzyls_msg /end IN_MEASUREMENT
 /begin OUT_MEASUREMENT IKCtl_dnFildGrdt_s16 IKCtl_flgAdpnEna IKCtl_flgAdpnLrnEna IKCtl_flgAdpnWrEna IKCtl_flgDiagEna IKCtl_flgDynAdpnEna IKCtl_flgDynAdpnRead IKCtl_flgFastAdvIa IKCtl_flgGdCyl IKCtl_flgInjD IKCtl_flgKnkEna IKCtl_flgKnkLimp IKCtl_flgLoadDynAdpn IKCtl_flgLoadDynAdpnAdv IKCtl_flgLoadDynCtrlEna IKCtl_flgLoadDynDetn IKCtl_flgRtdtUse IKCtl_flgSftyRtdt IKCtl_flgSpdDynDetn IKCtl_flgTEna IKCtl_flgTipinDetn IKCtl_idxAdpn_u16 IKCtl_idxSpdAdpn_u8 IKCtl_pPfiSp IKCtl_ratFilGrdtDesAirChrg_u16 IKCtl_ratRelAirChrg IKCtl_stInjDTot_b8 IKCtl_stInjRefCorr IKCtl_stSnsrErr_u8 /end OUT_MEASUREMENT
 /begin LOC_MEASUREMENT actkeldyn actkendyn actldyn B_delayhld B_eks B_krenfadi B_krsyne B_krvalgrd dyespfv dyespof IKCtl_agIntkB1old IKCtl_ctReIni10msBBKR IKCtl_flgKnkLoc IKCtl_flgLoadDynAdpnTmp IKCtl_flgSftyRtdtReq IKCtl_flgSftyRtdtTmp IKCtl_ofsDesLoadDynThd_u16 IKCtl_ratAirLoadThdFastAdvIa IKCtl_ratCurrLoadDynDetnThd IKCtl_ratLoadDynDetnThd_u16 IKCtl_ratLoadRngAdpn1 IKCtl_ratLoadRngAdpn2 IKCtl_ratLoadRngAdpn3 IKCtl_ratLoadThd IKCtl_ratOffsLoadDynDetnThd IKCtl_stBackwInjCalcn IKCtl_stInjRefDetn IKCtl_tEna IKCtl_tmpReIniBBKR injmodekr_l krdydlyd_l krdyndelay krdyofdd_l ngkrv stkrlx wesot1kra_w wesot1kre_w wesot1kr_w wesot2kra_w wesot2kre_w wesot2kr_w wesot3kra_w wesot3kre_w wesot3kr_w wesot4kra_w wesot4kre_w wesot4kr_w wesot5kra_w wesot5kre_w wmfaes wmfees zaeldy zaeldyke zaendy /end LOC_MEASUREMENT
 FUNCTION_VERSION "39.3.0" /end FUNCTION
/begin FUNCTION BBKSTEBF "53.4.0    Initial Fuelling of Fuel Supply"
 /begin DEF_CHARACTERISTIC CWKSTEBF FuPHi_BreakInitFu_C FuPHi_BreakStrtActnInitFu_C NKSTEBFPF TKSTEBFAS TKSTEBFIF TKSTEBFPAS TKSTEBFPDL TKSTEBFZAS VKSTEBFAS /end DEF_CHARACTERISTIC
 /begin IN_MEASUREMENT CEngDsT_t EngStrt_bStrtEnd Epm_nEngLRes Epm_stSpd FuPHi_pRail SyC_stSub tnse_w_msg VehV_v /end IN_MEASUREMENT
 /begin OUT_MEASUREMENT B_ebfmodns_msg B_ebfmod_msg B_urstsprr_msg /end OUT_MEASUREMENT
 /begin LOC_MEASUREMENT anztdcctrloc B_sprrsave ebfstate ignctr /end LOC_MEASUREMENT
 FUNCTION_VERSION "53.4.0" /end FUNCTION
/begin FUNCTION BBORING "2.2.0     operating condtions o-ring HPIV" /begin DEF_CHARACTERISTIC CWORING InjSys_pRailHpFltFullDlv_C TDOHDRMX THDEVORMN /end DEF_CHARACTERISTIC /begin IN_MEASUREMENT EngStrt_bStrtEnd FlSys_tFlHPSys FuPHi_pRail SyC_stSub /end IN_MEASUREMENT /begin OUT_MEASUREMENT B_hdrab_msg /end OUT_MEASUREMENT /begin LOC_MEASUREMENT B_maxhdrlo InjSys_pRailHpSwtOffEng /end LOC_MEASUREMENT FUNCTION_VERSION "2.2.0" /end FUNCTION
/begin COMPU_METHOD Ampsec100 "" RAT_FUNC "%6.0" "As" COEFFS 0 1 0 0 0 100 /end COMPU_METHOD
/begin COMPU_METHOD BattCh_Ah_q0p00097656_COMPU "" RAT_FUNC "%6.5" "Ah" COEFFS 0 1024 0 0 0 1 /end COMPU_METHOD
/begin COMPU_METHOD B_TRUE "" TAB_VERB "%6.3" "" COMPU_TAB_REF B_TRUE /end COMPU_METHOD
/begin COMPU_VTAB B_TRUE "" TAB_VERB 2 0 "FALSE" 1 "TRUE" /end COMPU_VTAB
/begin COMPU_METHOD CANIVSS_SC_Compu "" TAB_VERB "%6.3" "" COMPU_TAB_REF CANIVSS_SC_Compu /end COMPU_METHOD
/begin COMPU_VTAB CANIVSS_SC_Compu "" TAB_VERB 2 0 "False" 1 "True" /end COMPU_VTAB
/begin COMPU_METHOD CANMCU_SY_Compu "" TAB_VERB "%6.3" "" COMPU_TAB_REF CANMCU_SY_Compu /end COMPU_METHOD
/begin COMPU_VTAB CANMCU_SY_Compu "" TAB_VERB 2 0 "False" 1 "True" /end COMPU_VTAB
/begin COMPU_METHOD CANMDPS_SY_Compu "" TAB_VERB "%6.3" "" COMPU_TAB_REF CANMDPS_SY_Compu /end COMPU_METHOD
/begin COMPU_VTAB CANMDPS_SY_Compu "" TAB_VERB 2 0 "False" 1 "True" /end COMPU_VTAB
/begin COMPU_METHOD CANNM_SC_Compu "" TAB_VERB "%6.3" "" COMPU_TAB_REF CANNM_SC_Compu /end COMPU_METHOD
/begin COMPU_VTAB CANNM_SC_Compu "" TAB_VERB 2 0 "False" 1 "True" /end COMPU_VTAB
/begin COMPU_METHOD CANOPI_SY_Compu "" TAB_VERB "%6.3" "" COMPU_TAB_REF CANOPI_SY_Compu /end COMPU_METHOD
/begin COMPU_VTAB CANOPI_SY_Compu "" TAB_VERB 2 0 "False" 1 "True" /end COMPU_VTAB
/begin COMPU_METHOD CANSAS_SY_Compu "" TAB_VERB "%6.3" "" COMPU_TAB_REF CANSAS_SY_Compu /end COMPU_METHOD
/begin COMPU_VTAB CANSAS_SY_Compu "" TAB_VERB 2 0 "False" 1 "True" /end COMPU_VTAB
/begin COMPU_METHOD CANSM_SC_Compu "" TAB_VERB "%6.3" "" COMPU_TAB_REF CANSM_SC_Compu /end COMPU_METHOD
/begin COMPU_VTAB CANSM_SC_Compu "" TAB_VERB 2 0 "False" 1 "True" /end COMPU_VTAB
/begin COMPU_METHOD CANSPAS_SY_Compu "" TAB_VERB "%6.3" "" COMPU_TAB_REF CANSPAS_SY_Compu /end COMPU_METHOD
/begin COMPU_VTAB CANSPAS_SY_Compu "" TAB_VERB 2 0 "False" 1 "True" /end COMPU_VTAB
/begin COMPU_METHOD CANTCS_SY_Compu "" TAB_VERB "%6.3" "" COMPU_TAB_REF CANTCS_SY_Compu /end COMPU_METHOD
/begin COMPU_VTAB CANTCS_SY_Compu "" TAB_VERB 2 0 "False" 1 "True" /end COMPU_VTAB
/begin COMPU_METHOD CANTMU_SY_Compu "" RAT_FUNC "%6.2" "" COEFFS 0 1 0 0 0 1 /end COMPU_METHOD
/begin COMPU_METHOD CANTP_SC_Compu "" TAB_VERB "%6.3" "" COMPU_TAB_REF CANTP_SC_Compu /end COMPU_METHOD
/begin COMPU_VTAB CANTP_SC_Compu "" TAB_VERB 2 0 "False" 1 "True" /end COMPU_VTAB
/begin COMPU_METHOD CANTSYN_SC_Compu "" TAB_VERB "%6.3" "" COMPU_TAB_REF CANTSYN_SC_Compu /end COMPU_METHOD
/begin COMPU_VTAB CANTSYN_SC_Compu "" TAB_VERB 2 0 "False" 1 "True" /end COMPU_VTAB
/begin COMPU_METHOD CANVER_SY_Compu "" TAB_VERB "%6.3" "" COMPU_TAB_REF CANVER_SY_Compu /end COMPU_METHOD
/begin COMPU_VTAB CANVER_SY_Compu "" TAB_VERB 3 0 "CANVER_V4V5" 1 "CANVER_MLB" 2 "CANVER_MQB" /end COMPU_VTAB
/begin COMPU_METHOD CAN_MDS_SC_Compu "" TAB_VERB "%6.3" "" COMPU_TAB_REF CAN_MDS_SC_Compu /end COMPU_METHOD
/begin COMPU_VTAB CAN_MDS_SC_Compu "" TAB_VERB 2 0 "CAN_MDS_OFF" 1 "CAN_MDS_ON" /end COMPU_VTAB
/begin COMPU_METHOD CARBMDLYR19UPD2016_SC_Compu "" RAT_FUNC "%6.2" "" COEFFS 0 1 0 0 0 1 /end COMPU_METHOD
/begin COMPU_METHOD CASI1_SSP_SY_Compu "" TAB_VERB "%6.3" "" COMPU_TAB_REF CASI1_SSP_SY_Compu /end COMPU_METHOD
/begin COMPU_VTAB CASI1_SSP_SY_Compu "" TAB_VERB 4 0 "NO_CAS_SSPMON" 1 "SSPMON1" 2 "SSPMON2" 3 "SSPMON3" /end COMPU_VTAB
/begin COMPU_METHOD CASI2_SSP_SY_Compu "" TAB_VERB "%6.3" "" COMPU_TAB_REF CASI2_SSP_SY_Compu /end COMPU_METHOD
/begin COMPU_VTAB CASI2_SSP_SY_Compu "" TAB_VERB 4 0 "NO_CAS_SSPMON" 1 "SSPMON1" 2 "SSPMON2" 3 "SSPMON3" /end COMPU_VTAB
/begin COMPU_METHOD CASO1_SSP_SY_Compu "" TAB_VERB "%6.3" "" COMPU_TAB_REF CASO1_SSP_SY_Compu /end COMPU_METHOD
/begin COMPU_VTAB CASO1_SSP_SY_Compu "" TAB_VERB 4 0 "NO_CAS_SSPMON" 1 "SSPMON1" 2 "SSPMON2" 3 "SSPMON3" /end COMPU_VTAB
/begin COMPU_METHOD CASO2_SSP_SY_Compu "" TAB_VERB "%6.3" "" COMPU_TAB_REF CASO2_SSP_SY_Compu /end COMPU_METHOD
/begin COMPU_VTAB CASO2_SSP_SY_Compu "" TAB_VERB 4 0 "NO_CAS_SSPMON" 1 "SSPMON1" 2 "SSPMON2" 3 "SSPMON3" /end COMPU_VTAB
/begin COMPU_METHOD CASTYP_SY_Compu "" TAB_VERB "%6.3" "" COMPU_TAB_REF CASTYP_SY_Compu /end COMPU_METHOD
/begin COMPU_VTAB CASTYP_SY_Compu "" TAB_VERB 8 0 "INDIVIDUAL" 1 "CAS_GS_STD_4TOOTH" 2 "CAS_3TOOTH" 3 "CAS_PULSE" 4 "CAS_HALFMOON" 5 "CAS_5TOOH" 6 "CAS_DS_STD_3TEETH" 7 "CAS_3TOOTH_180_60" /end COMPU_VTAB
/begin COMPU_METHOD CAS_ADAP_SY_Compu "" TAB_VERB "%6.3" "" COMPU_TAB_REF CAS_ADAP_SY_Compu /end COMPU_METHOD
/begin COMPU_VTAB CAS_ADAP_SY_Compu "" TAB_VERB 4 0 "NO_ADAP" 1 "ADAP" 2 "ADAP_MNTCHK" 3 "ADAP_MNTCHK_INDEDGE" /end COMPU_VTAB
/begin COMPU_METHOD CAS_ANGLE_SY_Compu "" TAB_VERB "%6.3" "" COMPU_TAB_REF CAS_ANGLE_SY_Compu /end COMPU_METHOD
/begin COMPU_VTAB CAS_ANGLE_SY_Compu "" TAB_VERB 3 0 "NO_ANGLE" 1 "VIA_MESSAGE" 2 "VIA_SERVICE" /end COMPU_VTAB
/begin COMPU_METHOD CAS_BACKUPVAR_SY_Compu "" TAB_VERB "%6.3" "" COMPU_TAB_REF CAS_BACKUPVAR_SY_Compu /end COMPU_METHOD
/begin COMPU_VTAB CAS_BACKUPVAR_SY_Compu "" TAB_VERB 3 0 "NO_VAR" 1 "ACC_CURVE" 2 "CAS_START" /end COMPU_VTAB
/begin COMPU_METHOD CAS_BACKUP_SY_Compu "" TAB_VERB "%6.3" "" COMPU_TAB_REF CAS_BACKUP_SY_Compu /end COMPU_METHOD
/begin COMPU_VTAB CAS_BACKUP_SY_Compu "" TAB_VERB 5 0 "NO_BACKUP" 1 "TST_INJ" 2 "DOUBLE_IGN" 3 "TST_INJ_GDI" 4 "TST_INJ_DS" /end COMPU_VTAB
/begin COMPU_METHOD CAS_CY30CONF_SY_Compu "" TAB_VERB "%6.3" "" COMPU_TAB_REF CAS_CY30CONF_SY_Compu /end COMPU_METHOD
/begin COMPU_VTAB CAS_CY30CONF_SY_Compu "" TAB_VERB 4 0 "hard-wired" 1 "CONF_TH is set from SW" 2 "CONF_K is set from SW" 3 "CONF_K  and CONF_TH is set from SW" /end COMPU_VTAB
/begin COMPU_METHOD CAS_DIAG_SY_Compu "" TAB_VERB "%6.3" "" COMPU_TAB_REF CAS_DIAG_SY_Compu /end COMPU_METHOD
/begin COMPU_VTAB CAS_DIAG_SY_Compu "" TAB_VERB 4 0 "STD" 1 "ADD_OFFS" 2 "ADD_MINMAX" 3 "ADD_IUMPR" /end COMPU_VTAB
/begin COMPU_METHOD CAS_I1_SY_Compu "" TAB_VERB "%6.3" "" COMPU_TAB_REF CAS_I1_SY_Compu /end COMPU_METHOD
/begin COMPU_VTAB CAS_I1_SY_Compu "" TAB_VERB 2 0 "NO_SIGNAL" 1 "SIGNAL_AVAILABLE" /end COMPU_VTAB
/begin COMPU_METHOD CAS_I2_SY_Compu "" TAB_VERB "%6.3" "" COMPU_TAB_REF CAS_I2_SY_Compu /end COMPU_METHOD
/begin COMPU_VTAB CAS_I2_SY_Compu "" TAB_VERB 2 0 "NO_SIGNAL" 1 "SIGNAL_AVAILABLE" /end COMPU_VTAB
/begin COMPU_METHOD CAS_O1_SY_Compu "" TAB_VERB "%6.3" "" COMPU_TAB_REF CAS_O1_SY_Compu /end COMPU_METHOD
/begin COMPU_VTAB CAS_O1_SY_Compu "" TAB_VERB 2 0 "NO_SIGNAL" 1 "SIGNAL_AVAILABLE" /end COMPU_VTAB
/begin COMPU_METHOD CAS_O2_SY_Compu "" TAB_VERB "%6.3" "" COMPU_TAB_REF CAS_O2_SY_Compu /end COMPU_METHOD
/begin COMPU_VTAB CAS_O2_SY_Compu "" TAB_VERB 2 0 "NO_SIGNAL" 1 "SIGNAL_AVAILABLE" /end COMPU_VTAB
/begin COMPU_METHOD CATCPTPROTNEXTEGR_SC_Compu "" TAB_VERB "%6.3" "" COMPU_TAB_REF CATCPTPROTNEXTEGR_SC_Compu /end COMPU_METHOD
/begin COMPU_VTAB CATCPTPROTNEXTEGR_SC_Compu "" TAB_VERB 2 0 "False" 1 "True" /end COMPU_VTAB
/begin COMPU_METHOD CATHEATGELVTDTSTRT_SC_Compu "" TAB_VERB "%6.3" "" COMPU_TAB_REF CATHEATGELVTDTSTRT_SC_Compu /end COMPU_METHOD
/begin COMPU_VTAB CATHEATGELVTDTSTRT_SC_Compu "" TAB_VERB 2 0 "False" 1 "True" /end COMPU_VTAB
/begin COMPU_METHOD CATHEATGNONCSERS_SC_Compu "" TAB_VERB "%6.3" "" COMPU_TAB_REF CATHEATGNONCSERS_SC_Compu /end COMPU_METHOD
/begin COMPU_VTAB CATHEATGNONCSERS_SC_Compu "" TAB_VERB 2 0 "False" 1 "True" /end COMPU_VTAB
/begin COMPU_METHOD CATHEATGREPREQCYC_SC_Compu "" TAB_VERB "%6.3" "" COMPU_TAB_REF CATHEATGREPREQCYC_SC_Compu /end COMPU_METHOD
/begin COMPU_VTAB CATHEATGREPREQCYC_SC_Compu "" TAB_VERB 2 0 "False" 1 "True" /end COMPU_VTAB
/begin COMPU_METHOD CCACHPDST_TYPAVL_SY_Compu "" TAB_VERB "%6.3" "" COMPU_TAB_REF CCACHPDST_TYPAVL_SY_Compu /end COMPU_METHOD
/begin COMPU_VTAB CCACHPDST_TYPAVL_SY_Compu "" TAB_VERB 2 0 "False" 1 "True" /end COMPU_VTAB
/begin COMPU_METHOD CCACLPDST_TYPAVL_SY_Compu "" TAB_VERB "%6.3" "" COMPU_TAB_REF CCACLPDST_TYPAVL_SY_Compu /end COMPU_METHOD
/begin COMPU_VTAB CCACLPDST_TYPAVL_SY_Compu "" TAB_VERB 2 0 "False" 1 "True" /end COMPU_VTAB
/begin COMPU_METHOD CDASWILCAMSFTALLCYL_SC_Compu "" TAB_VERB "%6.3" "" COMPU_TAB_REF CDASWILCAMSFTALLCYL_SC_Compu /end COMPU_METHOD
/begin COMPU_VTAB CDASWILCAMSFTALLCYL_SC_Compu "" TAB_VERB 2 0 "False" 1 "True" /end COMPU_VTAB
/begin COMPU_METHOD CDAWOSWILVLV_SC_Compu "" TAB_VERB "%6.3" "" COMPU_TAB_REF CDAWOSWILVLV_SC_Compu /end COMPU_METHOD
/begin COMPU_VTAB CDAWOSWILVLV_SC_Compu "" TAB_VERB 2 0 "False" 1 "True" /end COMPU_VTAB
/begin COMPU_METHOD CDGEN_ENV_SC_Compu "" TAB_VERB "%6.3" "" COMPU_TAB_REF CDGEN_ENV_SC_Compu /end COMPU_METHOD
/begin COMPU_VTAB CDGEN_ENV_SC_Compu "" TAB_VERB 4 0 "CDGEN_ENV_DS" 1 "CDGEN_ENV_GS" 2 "CDGEN_ENV_DGS" 3 "CDGEN_ENV_MDG" /end COMPU_VTAB
/begin COMPU_METHOD CDSHDG_PMTTYP_SC_Compu "" TAB_VERB "%6.3" "" COMPU_TAB_REF CDSHDG_PMTTYP_SC_Compu /end COMPU_METHOD
/begin COMPU_VTAB CDSHDG_PMTTYP_SC_Compu "" TAB_VERB 4 0 "PMT_OFF" 1 "PMT_HW_GTM" 2 "PMT_SW_MCS" 3 "PMT_SW_CPU" /end COMPU_VTAB
/begin COMPU_METHOD CELPRJ_SIMPLEMDLENA_SC_Compu "" TAB_VERB "%6.3" "" COMPU_TAB_REF CELPRJ_SIMPLEMDLENA_SC_Compu /end COMPU_METHOD
/begin COMPU_VTAB CELPRJ_SIMPLEMDLENA_SC_Compu "" TAB_VERB 2 0 "FALSE" 1 "TRUE" /end COMPU_VTAB
/begin COMPU_METHOD CENGBLKT_COLDSTRTDIAG_SC_Compu "" TAB_VERB "%6.3" "" COMPU_TAB_REF CENGBLKT_COLDSTRTDIAG_SC_Compu /end COMPU_METHOD
/begin COMPU_VTAB CENGBLKT_COLDSTRTDIAG_SC_Compu "" TAB_VERB 3 0 "DISABLE" 1 "OTHER_MODULE" 2 "CENTRAL_DIAG" /end COMPU_VTAB
/begin COMPU_METHOD CENGBLKT_SY_Compu "" TAB_VERB "%6.3" "" COMPU_TAB_REF CENGBLKT_SY_Compu /end COMPU_METHOD
/begin COMPU_VTAB CENGBLKT_SY_Compu "" TAB_VERB 2 0 "False" 1 "True" /end COMPU_VTAB
/begin COMPU_METHOD Ch_Ah_q0p5_COMPU "" RAT_FUNC "%6.3" "Ah" COEFFS 0 2 0 0 0 1 /end COMPU_METHOD
/begin COMPU_METHOD Curr_A "" RAT_FUNC "%6.4" "A" COEFFS 0 100 0 0 0 1 /end COMPU_METHOD
/begin COMPU_METHOD Curr_mA_q0p9765625_COMPU "" RAT_FUNC "%6.2" "mA" COEFFS 0 1.024 0 0 0 1 /end COMPU_METHOD
/begin COMPU_METHOD dez "" RAT_FUNC "%6.2" "" COEFFS 0 1 0 0 0 1 /end COMPU_METHOD
/begin COMPU_METHOD ElecChrg_Ah_q0p125_COMPU "" RAT_FUNC "%6.3" "Ah" COEFFS 0 8 0 0 0 1 /end COMPU_METHOD
/begin COMPU_METHOD EngN "" RAT_FUNC "%6.3" "rpm" COEFFS 0 2 0 0 0 1 /end COMPU_METHOD
/begin COMPU_METHOD EngNGrd "" RAT_FUNC "%6.3" "rpm/s" COEFFS 0 2 0 0 0 1 /end COMPU_METHOD
/begin COMPU_METHOD Fact "" RAT_FUNC "%6.5" "-" COEFFS 0 8192 0 0 0 1 /end COMPU_METHOD
/begin COMPU_METHOD Fact1000 "" RAT_FUNC "%6.5" "-" COEFFS 0 1000 0 0 0 1 /end COMPU_METHOD
/begin COMPU_METHOD Fact_q0p001 "" RAT_FUNC "%6.5" "-" COEFFS 0 1000 0 0 0 1 /end COMPU_METHOD
/begin COMPU_METHOD fak_ub_b1 "" RAT_FUNC "%6.4" "-" COEFFS 0 256 0 0 0 1 /end COMPU_METHOD
/begin COMPU_METHOD fak_ub_b2 "" RAT_FUNC "%8.5" "-" COEFFS 0 256 0 0 0 2 /end COMPU_METHOD
/begin COMPU_METHOD fak_ub_b4 "" RAT_FUNC "%6.4" "-" COEFFS 0 256 0 0 0 4 /end COMPU_METHOD
/begin COMPU_METHOD fak_uw_b1 "" RAT_FUNC "%7.6" "-" COEFFS 0 65536 0 0 0 1 /end COMPU_METHOD
/begin COMPU_METHOD fak_uw_b16 "" RAT_FUNC "%6.5" "-" COEFFS 0 65536 0 0 0 16 /end COMPU_METHOD
/begin COMPU_METHOD fak_uw_b4 "" RAT_FUNC "%7.6" "-" COEFFS 0 65536 0 0 0 4 /end COMPU_METHOD
/begin COMPU_METHOD i_q0p001_A "" RAT_FUNC "%6.5" "A" COEFFS 0 1 0 0 0 0.001 /end COMPU_METHOD
/begin COMPU_METHOD i_q0p0078125_A "" RAT_FUNC "%6.4" "A" COEFFS 0 128 0 0 0 1 /end COMPU_METHOD
/begin COMPU_METHOD i_q0p01_A "" RAT_FUNC "%6.4" "A" COEFFS 0 1 0 0 0 0.01 /end COMPU_METHOD
/begin COMPU_METHOD kw_q0p0156 "" RAT_FUNC "%6.4" "Grad KW" COEFFS 0 64 0 0 0 1 /end COMPU_METHOD
/begin COMPU_METHOD kw_q0p0234 "" RAT_FUNC "%6.4" "Grad KW" COEFFS 0 32768 0 0 0 768 /end COMPU_METHOD
/begin COMPU_METHOD kw_q0p1 "" RAT_FUNC "%6.3" "Grad KW" COEFFS 0 10 0 0 0 1 /end COMPU_METHOD
/begin COMPU_METHOD kw_q2 "" RAT_FUNC "%6.2" "deg KW" COEFFS 0 1 0 0 0 2 /end COMPU_METHOD
/begin COMPU_METHOD m_q0p1 "" RAT_FUNC "%6.3" "kg/h" COEFFS 0 10 0 0 0 1 /end COMPU_METHOD
/begin COMPU_METHOD m_uw_b6553p5 "" RAT_FUNC "%6.3" "kg/h" COEFFS 0 1 0 0 0 0.1 /end COMPU_METHOD
/begin COMPU_METHOD nmotg_sb_q100 "" RAT_FUNC "%6.0" "1/min/s" COEFFS 0 1 0 0 0 100 /end COMPU_METHOD
/begin COMPU_METHOD nmot_ub_q40 "" RAT_FUNC "%6.1" "1/min" COEFFS 0 1 0 0 0 40 /end COMPU_METHOD
/begin COMPU_METHOD OilMlg "" RAT_FUNC "%6.2" "km" COEFFS 0 1 0 0 0 1 /end COMPU_METHOD
/begin COMPU_METHOD OneToOne "" RAT_FUNC "%6.2" "-" COEFFS 0 1 0 0 0 1 /end COMPU_METHOD
/begin COMPU_METHOD Prc "" RAT_FUNC "%6.4" "%" COEFFS 0 81.92 0 0 0 1 /end COMPU_METHOD
/begin COMPU_METHOD Prc_Fact100 "" RAT_FUNC "%6.4" "%" COEFFS 0 100 0 0 0 1 /end COMPU_METHOD
/begin COMPU_METHOD p_q0p039 "" RAT_FUNC "%6.4" "hPa" COEFFS 0 256 0 0 0 10 /end COMPU_METHOD
/begin COMPU_METHOD p_q0p078 "" RAT_FUNC "%6.4" "hPa" COEFFS 0 64 0 0 0 5 /end COMPU_METHOD
/begin COMPU_METHOD p_q10 "" RAT_FUNC "%6.1" "hPa" COEFFS 0 1 0 0 0 10 /end COMPU_METHOD
/begin COMPU_METHOD q0p001_A_s_1 "" RAT_FUNC "%6.5" "As" COEFFS 0 1000 0 0 0 1 /end COMPU_METHOD
/begin COMPU_METHOD q0p01_A_h_1 "" RAT_FUNC "%6.4" "Ah" COEFFS 0 100 0 0 0 1 /end COMPU_METHOD
/begin COMPU_METHOD RBPtCel_Perc_0p5_1 "" RAT_FUNC "%6.3" "%" COEFFS 0 2 0 0 0 1 /end COMPU_METHOD
/begin COMPU_METHOD RBPtCel_p_0p002_1 "" RAT_FUNC "%6.4" "MPa" COEFFS 0 1000 0 0 0 2 /end COMPU_METHOD
/begin COMPU_METHOD RBPtCel_q_0p001_1 "" RAT_FUNC "%6.5" "As" COEFFS 0 1000 0 0 0 1 /end COMPU_METHOD
/begin COMPU_METHOD RBPtCel_q_0p125_1 "" RAT_FUNC "%6.3" "Ah" COEFFS 0 8 0 0 0 1 /end COMPU_METHOD
/begin COMPU_METHOD RBPtCel_r_0p00001_1 "" RAT_FUNC "%8.7" "Ohm" COEFFS 0 100000 0 0 0 1 /end COMPU_METHOD
/begin COMPU_METHOD rel_q0p02344 "" RAT_FUNC "%6.4" "%" COEFFS 0 32 0 0 0 0.75 /end COMPU_METHOD
/begin COMPU_METHOD rel_ub_b127p5 "" RAT_FUNC "%6.3" "%" COEFFS 0 2 0 0 0 1 /end COMPU_METHOD
/begin COMPU_METHOD rel_uw_b100 "" RAT_FUNC "%6.4" "%" COEFFS 0 65536 0 0 0 100 /end COMPU_METHOD
/begin COMPU_METHOD rel_uw_q0p0234 "" RAT_FUNC "%6.4" "%" COEFFS 0 32 0 0 0 0.75 /end COMPU_METHOD
/begin COMPU_METHOD Resist_mOhm_q0p01 "" RAT_FUNC "%6.4" "mOhm" COEFFS 0 100 0 0 0 1 /end COMPU_METHOD
/begin COMPU_METHOD RmpVoltBatt "" RAT_FUNC "%6.3" "mV/s" COEFFS 0 3.2768 0 0 0 1 /end COMPU_METHOD
/begin COMPU_METHOD SCR_TEMP_CELS_float "" RAT_FUNC "%6.2" "deg C" COEFFS 0 1 0 0 0 1 /end COMPU_METHOD
/begin COMPU_METHOD Slope "" RAT_FUNC "%10.9" "" COEFFS 0 10000000 0 0 0 1 /end COMPU_METHOD
/begin COMPU_METHOD spg_q0p00039 "" RAT_FUNC "%6.5" "V" COEFFS 0 1 0 0 0 0.000390625 /end COMPU_METHOD
/begin COMPU_METHOD spg_q0p001_V "" RAT_FUNC "%6.5" "V" COEFFS 0 1000 0 0 0 1 /end COMPU_METHOD
/begin COMPU_METHOD spg_q0p0625_V "" RAT_FUNC "%6.4" "V" COEFFS 0 16 0 0 0 1 /end COMPU_METHOD
/begin COMPU_METHOD spg_q0p1 "" RAT_FUNC "%6.3" "V" COEFFS 0 1 0 0 0 0.1 /end COMPU_METHOD
/begin COMPU_METHOD spg_q0p2 "" RAT_FUNC "%6.3" "V" COEFFS 0 5 0 0 0 1 /end COMPU_METHOD
/begin COMPU_METHOD spg_q0p78125Em3 "" RAT_FUNC "%6.5" "V" COEFFS 0 65536 0 0 0 51.2 /end COMPU_METHOD
/begin COMPU_METHOD spg_ubatt "" RAT_FUNC "%6.3" "V" COEFFS 0 10.6157112526539 0 0 0 1 /end COMPU_METHOD
/begin COMPU_METHOD spg_uw_q0p023481 "" RAT_FUNC "%6.4" "V" COEFFS 0 1 0 0 0 0.023481 /end COMPU_METHOD
/begin COMPU_METHOD t100msxs_uw_b6553p5 "" RAT_FUNC "%6.3" "s" COEFFS 0 1 0 0 0 0.1 /end COMPU_METHOD
/begin COMPU_METHOD TempDiff_Cels "" RAT_FUNC "%6.3" "deg C" COEFFS 0 10 0 0 0 1 /end COMPU_METHOD
/begin COMPU_METHOD Temp_Cels "" RAT_FUNC "%6.1" "deg C" COEFFS 0 10 2731.4 0 0 1 /end COMPU_METHOD
/begin COMPU_METHOD temp_q0p0234 "" RAT_FUNC "%6.4" "K" COEFFS 0 256 0 0 0 6 /end COMPU_METHOD
/begin COMPU_METHOD temp_q0p0234_o273 "" RAT_FUNC "%6.1" "Grad C" COEFFS 0 1 273.15 0 0 0.0234375 /end COMPU_METHOD
/begin COMPU_METHOD temp_q0p1_K "" RAT_FUNC "%6.3" "K" COEFFS 0 10 0 0 0 1 /end COMPU_METHOD
/begin COMPU_METHOD temp_ub_q0p75_o48 "" RAT_FUNC "%6.2" "Grad C" COEFFS 0 1 48 0 0 0.75 /end COMPU_METHOD
/begin COMPU_METHOD TimeRed "" RAT_FUNC "%6.3" "s" COEFFS 0 6.25 0 0 0 1 /end COMPU_METHOD
/begin COMPU_METHOD Time_Hr "" RAT_FUNC "%6.3" "h" COEFFS 0 2 0 0 0 1 /end COMPU_METHOD
/begin COMPU_METHOD Time_ms "" RAT_FUNC "%6.1" "ms" COEFFS 0 0.1 0 0 0 1 /end COMPU_METHOD
/begin COMPU_METHOD Time_s "" RAT_FUNC "%6.4" "s" COEFFS 0 100 0 0 0 1 /end COMPU_METHOD
/begin COMPU_METHOD Time_sec_1 "" RAT_FUNC "%6.3" "s" COEFFS 0 10 0 0 0 1 /end COMPU_METHOD
/begin COMPU_METHOD t_q0p001_ms "" RAT_FUNC "%6.5" "ms" COEFFS 0 1 0 0 0 0.001 /end COMPU_METHOD
/begin COMPU_METHOD t_q0p01 "" RAT_FUNC "%6.4" "s" COEFFS 0 100 0 0 0 1 /end COMPU_METHOD
/begin COMPU_METHOD t_q0p02 "" RAT_FUNC "%6.4" "s" COEFFS 0 100 0 0 0 2 /end COMPU_METHOD
/begin COMPU_METHOD t_q0p1 "" RAT_FUNC "%6.3" "s" COEFFS 0 10 0 0 0 1 /end COMPU_METHOD
/begin COMPU_METHOD u_Batt_V_q0p00097656 "" RAT_FUNC "%6.5" "V" COEFFS 0 1024 0 0 0 1 /end COMPU_METHOD
/begin COMPU_METHOD U_mV_q0p9765625_COMPU "" RAT_FUNC "%6.2" "mV" COEFFS 0 1.024 0 0 0 1 /end COMPU_METHOD
/begin COMPU_METHOD Vel "" RAT_FUNC "%6.4" "km/h" COEFFS 0 100 0 0 0 1 /end COMPU_METHOD
/begin COMPU_METHOD vfzgn_uw_b512 "" RAT_FUNC "%6.4" "km/h or mph" COEFFS 0 65536 0 0 0 512 /end COMPU_METHOD
/begin COMPU_METHOD Volt "" RAT_FUNC "%6.3" "mV" COEFFS 0 5 0 0 0 1 /end COMPU_METHOD
/begin COMPU_METHOD Volt_Batt "" RAT_FUNC "%6.1" "mV" COEFFS 0 0.05 0 0 0 1 /end COMPU_METHOD
/begin COMPU_METHOD zk100msxs_ub_b25p5 "" RAT_FUNC "%6.3" "s" COEFFS 0 0 256 0 10 0 /end COMPU_METHOD
/begin RECORD_LAYOUT RB_Axis_S16 NO_AXIS_PTS_X 1 SWORD AXIS_PTS_X 2 SWORD INDEX_INCR DIRECT /end RECORD_LAYOUT
/begin RECORD_LAYOUT RB_Axis_U16 NO_AXIS_PTS_X 1 UWORD AXIS_PTS_X 2 UWORD INDEX_INCR DIRECT /end RECORD_LAYOUT
/begin RECORD_LAYOUT RB_Axis_U8 NO_AXIS_PTS_X 1 UBYTE AXIS_PTS_X 2 UBYTE INDEX_INCR DIRECT /end RECORD_LAYOUT
/begin RECORD_LAYOUT RB_CurveGroup_S16 FNC_VALUES 1 SWORD COLUMN_DIR DIRECT /end RECORD_LAYOUT
/begin RECORD_LAYOUT RB_CurveGroup_S8 FNC_VALUES 1 SBYTE COLUMN_DIR DIRECT /end RECORD_LAYOUT
/begin RECORD_LAYOUT RB_CurveGroup_U16 FNC_VALUES 1 UWORD COLUMN_DIR DIRECT /end RECORD_LAYOUT
/begin RECORD_LAYOUT RB_CurveGroup_U8 FNC_VALUES 1 UBYTE COLUMN_DIR DIRECT /end RECORD_LAYOUT
/begin RECORD_LAYOUT RB_Curve_S16_S16 NO_AXIS_PTS_X 1 SWORD AXIS_PTS_X 2 SWORD INDEX_INCR DIRECT FNC_VALUES 3 SWORD COLUMN_DIR DIRECT /end RECORD_LAYOUT
/begin RECORD_LAYOUT RB_Curve_S16_U16_Static NO_AXIS_PTS_X 1 SWORD AXIS_PTS_X 2 SWORD INDEX_INCR DIRECT FNC_VALUES 3 UWORD COLUMN_DIR DIRECT STATIC_RECORD_LAYOUT /end RECORD_LAYOUT
/begin RECORD_LAYOUT RB_Curve_S16_U8_Static NO_AXIS_PTS_X 1 SWORD AXIS_PTS_X 2 SWORD INDEX_INCR DIRECT FNC_VALUES 3 UBYTE COLUMN_DIR DIRECT STATIC_RECORD_LAYOUT /end RECORD_LAYOUT
/begin RECORD_LAYOUT RB_Curve_U16_U16 NO_AXIS_PTS_X 1 UWORD AXIS_PTS_X 2 UWORD INDEX_INCR DIRECT FNC_VALUES 3 UWORD COLUMN_DIR DIRECT /end RECORD_LAYOUT
/begin RECORD_LAYOUT RB_Curve_U16_U8_Static NO_AXIS_PTS_X 1 UWORD AXIS_PTS_X 2 UWORD INDEX_INCR DIRECT FNC_VALUES 3 UBYTE COLUMN_DIR DIRECT STATIC_RECORD_LAYOUT /end RECORD_LAYOUT
/begin RECORD_LAYOUT RB_MapGroup_S8 FNC_VALUES 1 SBYTE COLUMN_DIR DIRECT /end RECORD_LAYOUT
/begin RECORD_LAYOUT RB_MapGroup_U16 FNC_VALUES 1 UWORD COLUMN_DIR DIRECT /end RECORD_LAYOUT
/begin RECORD_LAYOUT RB_MapGroup_U8 FNC_VALUES 1 UBYTE COLUMN_DIR DIRECT /end RECORD_LAYOUT
/begin RECORD_LAYOUT RB_Map_S16S16_S16 NO_AXIS_PTS_X 1 SWORD NO_AXIS_PTS_Y 2 SWORD AXIS_PTS_X 3 SWORD INDEX_INCR DIRECT AXIS_PTS_Y 4 SWORD INDEX_INCR DIRECT FNC_VALUES 5 SWORD COLUMN_DIR DIRECT /end RECORD_LAYOUT
/begin RECORD_LAYOUT RB_Map_S16S16_U8 NO_AXIS_PTS_X 1 SWORD NO_AXIS_PTS_Y 2 SWORD AXIS_PTS_X 3 SWORD INDEX_INCR DIRECT AXIS_PTS_Y 4 SWORD INDEX_INCR DIRECT FNC_VALUES 5 UBYTE COLUMN_DIR DIRECT /end RECORD_LAYOUT
/begin RECORD_LAYOUT RB_Map_S16U16_U8 NO_AXIS_PTS_X 1 SWORD NO_AXIS_PTS_Y 2 SWORD AXIS_PTS_X 3 SWORD INDEX_INCR DIRECT AXIS_PTS_Y 4 UWORD INDEX_INCR DIRECT FNC_VALUES 5 UBYTE ROW_DIR DIRECT /end RECORD_LAYOUT
/begin RECORD_LAYOUT RB_Val_Wboolean FNC_VALUES 1 UBYTE COLUMN_DIR DIRECT /end RECORD_LAYOUT
/begin RECORD_LAYOUT RB_Val_Ws16 FNC_VALUES 1 SWORD COLUMN_DIR DIRECT /end RECORD_LAYOUT
/begin RECORD_LAYOUT RB_Val_Ws32 FNC_VALUES 1 SLONG COLUMN_DIR DIRECT /end RECORD_LAYOUT
/begin RECORD_LAYOUT RB_Val_Wu16 FNC_VALUES 1 UWORD COLUMN_DIR DIRECT /end RECORD_LAYOUT
/begin RECORD_LAYOUT RB_Val_Wu32 FNC_VALUES 1 ULONG COLUMN_DIR DIRECT /end RECORD_LAYOUT
/begin RECORD_LAYOUT RB_Val_Wu8 FNC_VALUES 1 UBYTE COLUMN_DIR DIRECT /end RECORD_LAYOUT
/end MODULE
/end PROJECT
