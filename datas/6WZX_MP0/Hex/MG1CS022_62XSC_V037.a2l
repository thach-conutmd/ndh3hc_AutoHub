ASAP2_VERSION 1 60
/begin PROJECT MG1CS022 "MG1CS022"
/begin HEADER "" VERSION "MG1CS022_62XSC_V037" PROJECT_NO MG1CS022 /end HEADER
/begin MODULE DIM ""
/begin MOD_COMMON "" BYTE_ORDER MSB_LAST ALIGNMENT_BYTE 1 ALIGNMENT_WORD 2 ALIGNMENT_LONG 4 ALIGNMENT_INT64 4 ALIGNMENT_FLOAT32_IEEE 4 ALIGNMENT_FLOAT64_IEEE 4 DATA_SIZE 32 /end MOD_COMMON
/begin CHARACTERISTIC ExhMod_coeffPDifCatDsT_T "Characteristic map temperature-dep. factor in pressure gradient downstream last catalyst to environment" CURVE 0x8054A184 RB_Curve_S16_U16_Static 63.99902 fak_uw_b64 0.00 63.99902 FORMAT "%8.5"
 /begin AXIS_DESCR STD_AXIS NO_INPUT_QUANTITY Temp_Cels 6 -3549.940 3003.560 FORMAT "%8.3" DEPOSIT ABSOLUTE /end AXIS_DESCR
/end CHARACTERISTIC
/begin CHARACTERISTIC ExhMod_coeffPDiffCatTB1_M "Characteristic map temperature-dep. factor in pressure gradient catalysts" MAP 0x8054A19E RB_Map_S16U8_U16 63.99902 fak_uw_b64 0.00 63.99902 FORMAT "%8.5"
 /begin AXIS_DESCR STD_AXIS NO_INPUT_QUANTITY Temp_Cels 6 -3549.940 3003.560 FORMAT "%8.3" DEPOSIT ABSOLUTE /end AXIS_DESCR
 /begin AXIS_DESCR STD_AXIS NO_INPUT_QUANTITY dez 2 0.00 255.0 FORMAT "%5.1" DEPOSIT ABSOLUTE /end AXIS_DESCR
/end CHARACTERISTIC
/begin CHARACTERISTIC ExhMod_concHcDeltaFco_M "map additional HC mol flow at the beginning of fuel cut off phase, bank 1" MAP 0x8054BBF8 RB_Map_U16U16_U16 3.999939 q0p000061_mol_DIV_s 0.00 3.999939 FORMAT "%8.6"
 /begin AXIS_DESCR STD_AXIS NO_INPUT_QUANTITY m_uw_b6553p5 6 0.00 6553.500 FORMAT "%8.3" DEPOSIT ABSOLUTE /end AXIS_DESCR
 /begin AXIS_DESCR STD_AXIS NO_INPUT_QUANTITY fak_uw_b16 8 0.00 15.99976 FORMAT "%8.5" DEPOSIT ABSOLUTE /end AXIS_DESCR
/end CHARACTERISTIC
/begin CHARACTERISTIC ExhMod_egyEnthCmbHcCco_C "enthalpie HC cylinder cut off (exhaust gas lambda =1)" VALUE 0x8054A25C RB_Val_Wu16 67107840. q1024_J_DIV_kg 0.00 67107840. FORMAT "%8.0" /end CHARACTERISTIC
/begin CHARACTERISTIC ExhMod_egyEnthHcCco_C "enthalpie HC cylinder cut off" VALUE 0x8054A25E RB_Val_Wu16 67107840. q1024_J_DIV_kg 0.00 67107840. FORMAT "%8.0" /end CHARACTERISTIC
/begin CHARACTERISTIC ExhMod_facCatAgiPwrExo_M "Catalyst aging correction factor for exothermicity" MAP 0x8054A260 RB_Map_U16U16_U8 1.000000 fak_ub_b2 0.00 1.000000 FORMAT "%8.6" EXTENDED_LIMITS 0.00 1.992188
 /begin AXIS_DESCR STD_AXIS NO_INPUT_QUANTITY fak_uw_b2 6 0.00 1.999969 FORMAT "%8.6" DEPOSIT ABSOLUTE /end AXIS_DESCR
 /begin AXIS_DESCR STD_AXIS NO_INPUT_QUANTITY dez 2 0.00 255.0000 FORMAT "%8.4" EXTENDED_LIMITS 0.00 65535.00 DEPOSIT ABSOLUTE /end AXIS_DESCR
/end CHARACTERISTIC
/begin CHARACTERISTIC ExhMod_facCoH2CorrnHom_C "correction factor ratio CO to H2 homogenous mode" VALUE 0x8054BC78 RB_Val_Wu16 1.999969 fak_uw_b2 0.00 1.999969 FORMAT "%8.6" /end CHARACTERISTIC
/begin CHARACTERISTIC ExhMod_facCoH2CorrnHsp_C "correction factor ratio CO to H2 homogeneous-split mode" VALUE 0x8054BC7A RB_Val_Wu16 1.999969 fak_uw_b2 0.00 1.999969 FORMAT "%8.6" /end CHARACTERISTIC
/begin CHARACTERISTIC ExhMod_facCoH2CorrnIgnAgSecFu_T "correction factor for the reaction efficiency of water gas shift reaction based on ignition angle for secondary fuel" CURVE 0x8054BC7C RB_Curve_U8_U16_Static 1.999969 fak_uw_b2 0.00 1.999969 FORMAT "%8.6"
 /begin AXIS_DESCR STD_AXIS NO_INPUT_QUANTITY rel_ub_b127p5 6 0.00 127.5 FORMAT "%5.1" DEPOSIT ABSOLUTE /end AXIS_DESCR
/end CHARACTERISTIC
/begin CHARACTERISTIC ExhMod_facCoH2CorrnIgnAg_T "correction factor ratio CO to H2 depending on the ignition angle" CURVE 0x8054BC90 RB_Curve_U8_U16_Static 1.999969 fak_uw_b2 0.00 1.999969 FORMAT "%8.6"
 /begin AXIS_DESCR STD_AXIS NO_INPUT_QUANTITY rel_ub_b127p5 6 0.00 127.5 FORMAT "%5.1" DEPOSIT ABSOLUTE /end AXIS_DESCR
/end CHARACTERISTIC
/begin CHARACTERISTIC ExhMod_facDistbnTDeltaExo_M "distribution factor total exothermy catalyst bricks" MAP 0x8054A280 RB_Map_U8U16_U8 1.000000 fak_ub_b2 0.00 1.000000 FORMAT "%8.6" EXTENDED_LIMITS 0.00 1.992188
 /begin AXIS_DESCR STD_AXIS NO_INPUT_QUANTITY dez 6 0.00 255.0 FORMAT "%5.1" DEPOSIT ABSOLUTE /end AXIS_DESCR
 /begin AXIS_DESCR STD_AXIS NO_INPUT_QUANTITY m_q0p1 11 0.00 6553.500 FORMAT "%8.3" DEPOSIT ABSOLUTE /end AXIS_DESCR
/end CHARACTERISTIC
/begin CHARACTERISTIC ExhMod_facEffCcoReacn_M "Distribution factor for reaction power in cylinder cut off mode" MAP 0x8054A2E0 RB_Map_U8U16_U8 1.000000 fak_ub_b2 0.00 1.000000 FORMAT "%8.6" EXTENDED_LIMITS 0.00 1.992188
 /begin AXIS_DESCR STD_AXIS NO_INPUT_QUANTITY dez 6 0.00 255.0 FORMAT "%5.1" DEPOSIT ABSOLUTE /end AXIS_DESCR
 /begin AXIS_DESCR STD_AXIS NO_INPUT_QUANTITY m_q0p1 4 0.00 6553.500 FORMAT "%8.3" DEPOSIT ABSOLUTE /end AXIS_DESCR
/end CHARACTERISTIC
/begin CHARACTERISTIC ExhMod_facEffEngOffReactn_T "Effectivity factor reaction in catalyst bricks after engine-off" CURVE 0x8054A308 RB_Curve_U8_U8 1.000000 fak_ub_b2 0.00 1.000000 FORMAT "%8.6" EXTENDED_LIMITS 0.00 1.992188
 /begin AXIS_DESCR STD_AXIS NO_INPUT_QUANTITY dez 6 0.00 255.0 FORMAT "%5.1" DEPOSIT ABSOLUTE /end AXIS_DESCR
/end CHARACTERISTIC
/begin CHARACTERISTIC ExhMod_facEffFcoReacnLamAvrg_M "effectivity factor reaction fuel cut off exothemicity in catalyst bricks depending on lambda average" MAP 0x8054A316 RB_Map_U8U16_U8 1.000000 fak_ub_b2 0.00 1.000000 FORMAT "%8.6" EXTENDED_LIMITS 0.00 1.992188
 /begin AXIS_DESCR STD_AXIS NO_INPUT_QUANTITY dez 6 0.00 255.0 FORMAT "%5.1" DEPOSIT ABSOLUTE /end AXIS_DESCR
 /begin AXIS_DESCR STD_AXIS NO_INPUT_QUANTITY fak_uw_b16 4 0.00 15.99976 FORMAT "%8.5" DEPOSIT ABSOLUTE /end AXIS_DESCR
/end CHARACTERISTIC
/begin CHARACTERISTIC ExhMod_facEffFcoReacn_M "effectivity factor reaction fuel cut off exothemicity in catalyst bricks depending on temperature" MAP 0x8054A33E RB_Map_U8U16_U8 1.000000 fak_ub_b2 0.00 1.000000 FORMAT "%8.6" EXTENDED_LIMITS 0.00 1.992188
 /begin AXIS_DESCR STD_AXIS NO_INPUT_QUANTITY dez 6 0.00 255.0 FORMAT "%5.1" DEPOSIT ABSOLUTE /end AXIS_DESCR
 /begin AXIS_DESCR STD_AXIS NO_INPUT_QUANTITY temp_q0p0234_o273 4 -273.150 1262.827 FORMAT "%8.3" DEPOSIT ABSOLUTE /end AXIS_DESCR
/end CHARACTERISTIC
/begin CHARACTERISTIC ExhMod_facEffTranReactnLamAvrg_M "effectivity factor reaction while transitions exothemicity in catalyst bricks depending on lambda average" MAP 0x8054A366 RB_Map_U8U16_U8 1.000000 fak_ub_b2 0.00 1.000000 FORMAT "%8.6" EXTENDED_LIMITS 0.00 1.992188
 /begin AXIS_DESCR STD_AXIS NO_INPUT_QUANTITY dez 6 0.00 255.0 FORMAT "%5.1" DEPOSIT ABSOLUTE /end AXIS_DESCR
 /begin AXIS_DESCR STD_AXIS NO_INPUT_QUANTITY fak_uw_b16 4 0.00 15.99976 FORMAT "%8.5" DEPOSIT ABSOLUTE /end AXIS_DESCR
/end CHARACTERISTIC
/begin CHARACTERISTIC ExhMod_facEffTranReactn_M "effectivity factor reaction while transitions exothemicity in catalyst bricks depending on temperature" MAP 0x8054A38E RB_Map_U8U16_U8 1.000000 fak_ub_b2 0.00 1.000000 FORMAT "%8.6" EXTENDED_LIMITS 0.00 1.992188
 /begin AXIS_DESCR STD_AXIS NO_INPUT_QUANTITY dez 6 0.00 255.0 FORMAT "%5.1" DEPOSIT ABSOLUTE /end AXIS_DESCR
 /begin AXIS_DESCR STD_AXIS NO_INPUT_QUANTITY temp_q0p0234_o273 4 -273.150 1262.827 FORMAT "%8.3" DEPOSIT ABSOLUTE /end AXIS_DESCR
/end CHARACTERISTIC
/begin CHARACTERISTIC ExhMod_facExoCorrnIgnAgHomB1_T "Zündwinkelkorrektur kennlinie für die exotherme Temperaturerhöhung im Katalysator für Homogenbetrieb Bank 1" CURVE 0x8054A3B6 RB_Curve_U8_U8 1.992188 fak_ub_b2 0.00 1.992188 FORMAT "%8.6"
 /begin AXIS_DESCR STD_AXIS NO_INPUT_QUANTITY rel_ub_b127p5 8 0.00 127.5 FORMAT "%5.1" DEPOSIT ABSOLUTE /end AXIS_DESCR
/end CHARACTERISTIC
/begin CHARACTERISTIC ExhMod_facExoCorrnIgnAgHomCatHeatgB1_T "Zündwinkelkorrektur kennlinie für die exotherme Temperaturerhöhung im Katalysator während Katheizen für kalt Motorstart in Homogenbetrieb Bank 1" CURVE 0x8054A3C7 RB_Curve_U8_U8 1.992188 fak_ub_b2 0.00 1.992188 FORMAT "%8.6"
 /begin AXIS_DESCR STD_AXIS NO_INPUT_QUANTITY rel_ub_b127p5 8 0.00 127.5 FORMAT "%5.1" DEPOSIT ABSOLUTE /end AXIS_DESCR
/end CHARACTERISTIC
/begin CHARACTERISTIC ExhMod_facExoCorrnIgnAgHomCatHeatgSecFuB1_T "Zündwinkelkorrektur kennlinie für die exotherme Temperaturerhöhung im Katalysator während katheizen für kalt Motorstart in Homogenbetrieb mit alternativerTreibstoff Bank 1" CURVE 0x8054A3D8 RB_Curve_U8_U8 1.992188 fak_ub_b2 0.00 1.992188 FORMAT "%8.6"
 /begin AXIS_DESCR STD_AXIS NO_INPUT_QUANTITY rel_ub_b127p5 8 0.00 127.5 FORMAT "%5.1" DEPOSIT ABSOLUTE /end AXIS_DESCR
/end CHARACTERISTIC
/begin CHARACTERISTIC ExhMod_facExoCorrnIgnAgHomCatHeatSustB1_T "Zündwinkelkorrektur kennlinie für die exotherme Temperaturerhöhung im Katalysator während Katheizen für warmhalten in Homogenbetrieb Bank 1" CURVE 0x8054A3E9 RB_Curve_U8_U8 1.992188 fak_ub_b2 0.00 1.992188 FORMAT "%8.6"
 /begin AXIS_DESCR STD_AXIS NO_INPUT_QUANTITY rel_ub_b127p5 8 0.00 127.5 FORMAT "%5.1" DEPOSIT ABSOLUTE /end AXIS_DESCR
/end CHARACTERISTIC
/begin CHARACTERISTIC ExhMod_facExoCorrnIgnAgHomCatHeatSustSecFuB1_T "Zündwinkelkorrektur kennlinie für die exotherme Temperaturerhöhung im Katalysator während katheizen für warmhalten in Homogenbetrieb mit alternativerTreibstoff Bank 1" CURVE 0x8054A3FA RB_Curve_U8_U8 1.992188 fak_ub_b2 0.00 1.992188 FORMAT "%8.6"
 /begin AXIS_DESCR STD_AXIS NO_INPUT_QUANTITY rel_ub_b127p5 8 0.00 127.5 FORMAT "%5.1" DEPOSIT ABSOLUTE /end AXIS_DESCR
/end CHARACTERISTIC
/begin CHARACTERISTIC ExhMod_facExoCorrnIgnAgHomSecFuB1_T "Zündwinkelkorrektur kennlinie für die exotherme Temperaturerhöhung im Katalysator in Homogenbetrieb mit alternativerTreibstoff Bank 1" CURVE 0x8054A40B RB_Curve_U8_U8 1.992188 fak_ub_b2 0.00 1.992188 FORMAT "%8.6"
 /begin AXIS_DESCR STD_AXIS NO_INPUT_QUANTITY rel_ub_b127p5 8 0.00 127.5 FORMAT "%5.1" DEPOSIT ABSOLUTE /end AXIS_DESCR
/end CHARACTERISTIC
/begin CHARACTERISTIC ExhMod_facExoCorrnIgnAgHspB1_T "Zündwinkelkorrektur kennlinie für die exotherme Temperaturerhöhung im Katalysator für Homogen- split Betrieb Bank 1" CURVE 0x8054A41C RB_Curve_U8_U8 1.992188 fak_ub_b2 0.00 1.992188 FORMAT "%8.6"
 /begin AXIS_DESCR STD_AXIS NO_INPUT_QUANTITY rel_ub_b127p5 8 0.00 127.5 FORMAT "%5.1" DEPOSIT ABSOLUTE /end AXIS_DESCR
/end CHARACTERISTIC
/begin CHARACTERISTIC ExhMod_facExoCorrnIgnAgHspCatHeatgB1_T "Zündwinkelkorrektur kennlinie für die exotherme Temperaturerhöhung im Katalysator während Katheizen für kalt Motorstart in Homogen-split Betrieb Bank 1" CURVE 0x8054A42D RB_Curve_U8_U8 1.992188 fak_ub_b2 0.00 1.992188 FORMAT "%8.6"
 /begin AXIS_DESCR STD_AXIS NO_INPUT_QUANTITY rel_ub_b127p5 8 0.00 127.5 FORMAT "%5.1" DEPOSIT ABSOLUTE /end AXIS_DESCR
/end CHARACTERISTIC
/begin CHARACTERISTIC ExhMod_facExoCorrnIgnAgHspCatHeatgSecFuB1_T "Zündwinkelkorrektur kennlinie für die exotherme Temperaturerhöhung im Katalysator während katheizen für kalt Motorstart in Homogen-split Betrieb mit alternativerTreibstoff Bank 1" CURVE 0x8054A43E RB_Curve_U8_U8 1.992188 fak_ub_b2 0.00 1.992188 FORMAT "%8.6"
 /begin AXIS_DESCR STD_AXIS NO_INPUT_QUANTITY rel_ub_b127p5 8 0.00 127.5 FORMAT "%5.1" DEPOSIT ABSOLUTE /end AXIS_DESCR
/end CHARACTERISTIC
/begin CHARACTERISTIC ExhMod_facExoCorrnIgnAgHspCatHeatSustB1_T "Zündwinkelkorrektur kennlinie für die exotherme Temperaturerhöhung im Katalysator während Katheizen für warmhalten in Homogen-split Betrieb Bank 1" CURVE 0x8054A44F RB_Curve_U8_U8 1.992188 fak_ub_b2 0.00 1.992188 FORMAT "%8.6"
 /begin AXIS_DESCR STD_AXIS NO_INPUT_QUANTITY rel_ub_b127p5 8 0.00 127.5 FORMAT "%5.1" DEPOSIT ABSOLUTE /end AXIS_DESCR
/end CHARACTERISTIC
/begin CHARACTERISTIC ExhMod_facExoCorrnIgnAgHspCatHeatSustSecFuB1_T "Zündwinkelkorrektur kennlinie für die exotherme Temperaturerhöhung im Katalysator während katheizen für warmhalten in Homogen-split Betrieb mit alternativerTreibstoff Bank 1" CURVE 0x8054A460 RB_Curve_U8_U8 1.992188 fak_ub_b2 0.00 1.992188 FORMAT "%8.6"
 /begin AXIS_DESCR STD_AXIS NO_INPUT_QUANTITY rel_ub_b127p5 8 0.00 127.5 FORMAT "%5.1" DEPOSIT ABSOLUTE /end AXIS_DESCR
/end CHARACTERISTIC
/begin CHARACTERISTIC ExhMod_facExoCorrnIgnAgHspSecFuB1_T "Zündwinkelkorrektur kennlinie für die exotherme Temperaturerhöhung im Katalysator in Homogen-split Betrieb mit alternativerTreibstoff Bank 1" CURVE 0x8054A471 RB_Curve_U8_U8 1.992188 fak_ub_b2 0.00 1.992188 FORMAT "%8.6"
 /begin AXIS_DESCR STD_AXIS NO_INPUT_QUANTITY rel_ub_b127p5 8 0.00 127.5 FORMAT "%5.1" DEPOSIT ABSOLUTE /end AXIS_DESCR
/end CHARACTERISTIC
/begin CHARACTERISTIC ExhMod_facExoCorrnLamB1_M "lambda correction exothermal temperature increase in catalyst bank 1" MAP 0x8054A482 RB_Map_U16U8_U8 1.992188 fak_ub_b2 0.00 1.992188 FORMAT "%8.6"
 /begin AXIS_DESCR STD_AXIS NO_INPUT_QUANTITY fak_uw_b16 10 0.00 15.99976 FORMAT "%8.5" DEPOSIT ABSOLUTE /end AXIS_DESCR
 /begin AXIS_DESCR STD_AXIS NO_INPUT_QUANTITY dez 2 0.00 255.0 FORMAT "%5.1" DEPOSIT ABSOLUTE /end AXIS_DESCR
/end CHARACTERISTIC
/begin CHARACTERISTIC ExhMod_facExoCorrnLamCngB1_M "lambda correction exothermal temperature increase in catalyst bank 1 for CNG-operation" MAP 0x8054A4B0 RB_Map_U16U8_U8 1.992188 fak_ub_b2 0.00 1.992188 FORMAT "%8.6"
 /begin AXIS_DESCR STD_AXIS NO_INPUT_QUANTITY fak_uw_b16 10 0.00 15.99976 FORMAT "%8.5" DEPOSIT ABSOLUTE /end AXIS_DESCR
 /begin AXIS_DESCR STD_AXIS NO_INPUT_QUANTITY dez 2 0.00 255.0 FORMAT "%5.1" DEPOSIT ABSOLUTE /end AXIS_DESCR
/end CHARACTERISTIC
/begin CHARACTERISTIC ExhMod_facHcCnvnCorrnIgnAgHspCatHeatgSecFu_M "correction factor for the conversion efficiency of secondary fuel based on ignition angle during HSP catalyst heating mode" MAP 0x8054BCA4 RB_Map_U16U16_U16 1.999969 fak_uw_b2 0.00 1.999969 FORMAT "%8.6"
 /begin AXIS_DESCR STD_AXIS NO_INPUT_QUANTITY rel_ub_b127p5 6 0.00 127.5000 FORMAT "%8.4" EXTENDED_LIMITS 0.00 32767.50 DEPOSIT ABSOLUTE /end AXIS_DESCR
 /begin AXIS_DESCR STD_AXIS NO_INPUT_QUANTITY m_q0p1 6 0.00 6553.500 FORMAT "%8.3" DEPOSIT ABSOLUTE /end AXIS_DESCR
/end CHARACTERISTIC
/begin CHARACTERISTIC ExhMod_facHcCnvnCorrnIgnAgHspCatHeatg_M "correction factor HC conversion engine in homogenous-split mode catalyst heating depending on ignition angle" MAP 0x8054BD08 RB_Map_U16U16_U16 1.999969 fak_uw_b2 0.00 1.999969 FORMAT "%8.6"
 /begin AXIS_DESCR STD_AXIS NO_INPUT_QUANTITY rel_ub_b127p5 6 0.00 127.5000 FORMAT "%8.4" EXTENDED_LIMITS 0.00 32767.50 DEPOSIT ABSOLUTE /end AXIS_DESCR
 /begin AXIS_DESCR STD_AXIS NO_INPUT_QUANTITY m_q0p1 6 0.00 6553.500 FORMAT "%8.3" DEPOSIT ABSOLUTE /end AXIS_DESCR
/end CHARACTERISTIC
/begin CHARACTERISTIC ExhMod_facHcCnvnCorrnIgnAgHspCatHeatSustSecFu_M "correction factor for the conversion efficiency of secondary fuel based on ignition angle during HSP catalyst heating for warm sustenance mode" MAP 0x8054BD6C RB_Map_U16U16_U16 1.999969 fak_uw_b2 0.00 1.999969 FORMAT "%8.6"
 /begin AXIS_DESCR STD_AXIS NO_INPUT_QUANTITY rel_ub_b127p5 6 0.00 127.5000 FORMAT "%8.4" EXTENDED_LIMITS 0.00 32767.50 DEPOSIT ABSOLUTE /end AXIS_DESCR
 /begin AXIS_DESCR STD_AXIS NO_INPUT_QUANTITY m_q0p1 6 0.00 6553.500 FORMAT "%8.3" DEPOSIT ABSOLUTE /end AXIS_DESCR
/end CHARACTERISTIC
/begin CHARACTERISTIC ExhMod_facHcCnvnCorrnIgnAgHspCatHeatSust_M "correction factor HC conversion engine in homogenous-split mode catalyst heat sustain depending on ignition angle" MAP 0x8054BDD0 RB_Map_U16U16_U16 1.999969 fak_uw_b2 0.00 1.999969 FORMAT "%8.6"
 /begin AXIS_DESCR STD_AXIS NO_INPUT_QUANTITY rel_ub_b127p5 6 0.00 127.5000 FORMAT "%8.4" EXTENDED_LIMITS 0.00 32767.50 DEPOSIT ABSOLUTE /end AXIS_DESCR
 /begin AXIS_DESCR STD_AXIS NO_INPUT_QUANTITY m_q0p1 6 0.00 6553.500 FORMAT "%8.3" DEPOSIT ABSOLUTE /end AXIS_DESCR
/end CHARACTERISTIC
/begin CHARACTERISTIC ExhMod_facHcCnvnCorrnIgnAgHspSecFu_M "correction factor for the conversion efficiency of secondary fuel based on ignition angle during HSP mode" MAP 0x8054BE34 RB_Map_U16U16_U16 1.999969 fak_uw_b2 0.00 1.999969 FORMAT "%8.6"
 /begin AXIS_DESCR STD_AXIS NO_INPUT_QUANTITY rel_ub_b127p5 6 0.00 127.5000 FORMAT "%8.4" EXTENDED_LIMITS 0.00 32767.50 DEPOSIT ABSOLUTE /end AXIS_DESCR
 /begin AXIS_DESCR STD_AXIS NO_INPUT_QUANTITY m_q0p1 6 0.00 6553.500 FORMAT "%8.3" DEPOSIT ABSOLUTE /end AXIS_DESCR
/end CHARACTERISTIC
/begin CHARACTERISTIC ExhMod_facHcCnvnCorrnIgnAgHsp_M "correction factor HC conversion engine in homogenous-split mode depending on ignition angle" MAP 0x8054BE98 RB_Map_U16U16_U16 1.999969 fak_uw_b2 0.00 1.999969 FORMAT "%8.6"
 /begin AXIS_DESCR STD_AXIS NO_INPUT_QUANTITY rel_ub_b127p5 6 0.00 127.5000 FORMAT "%8.4" EXTENDED_LIMITS 0.00 32767.50 DEPOSIT ABSOLUTE /end AXIS_DESCR
 /begin AXIS_DESCR STD_AXIS NO_INPUT_QUANTITY m_q0p1 6 0.00 6553.500 FORMAT "%8.3" DEPOSIT ABSOLUTE /end AXIS_DESCR
/end CHARACTERISTIC
/begin CHARACTERISTIC ExhMod_facHcCnvnCorrnIgnAgSecFu_M "correction factor for the conversion efficiency of secondary fuel based on ignition angle during normal mode" MAP 0x8054BEFC RB_Map_U16U16_U16 1.999969 fak_uw_b2 0.00 1.999969 FORMAT "%8.6"
 /begin AXIS_DESCR STD_AXIS NO_INPUT_QUANTITY rel_ub_b127p5 6 0.00 127.5000 FORMAT "%8.4" EXTENDED_LIMITS 0.00 32767.50 DEPOSIT ABSOLUTE /end AXIS_DESCR
 /begin AXIS_DESCR STD_AXIS NO_INPUT_QUANTITY m_q0p1 6 0.00 6553.500 FORMAT "%8.3" DEPOSIT ABSOLUTE /end AXIS_DESCR
/end CHARACTERISTIC
/begin CHARACTERISTIC ExhMod_facHcCnvnCorrnIgnAg_M "correction factor HC conversion engine in homogenous mode depending on ignition angle" MAP 0x8054BF60 RB_Map_U16U16_U16 1.999969 fak_uw_b2 0.00 1.999969 FORMAT "%8.6"
 /begin AXIS_DESCR STD_AXIS NO_INPUT_QUANTITY rel_ub_b127p5 6 0.00 127.5000 FORMAT "%8.4" EXTENDED_LIMITS 0.00 32767.50 DEPOSIT ABSOLUTE /end AXIS_DESCR
 /begin AXIS_DESCR STD_AXIS NO_INPUT_QUANTITY m_q0p1 6 0.00 6553.500 FORMAT "%8.3" DEPOSIT ABSOLUTE /end AXIS_DESCR
/end CHARACTERISTIC
/begin CHARACTERISTIC ExhMod_facHcCnvnCorrnLamHspCatHeatgSecFu_M "correction factor for the conversion efficiency of secondary fuel based on lambda during HSP catalyst heating mode" MAP 0x8054BFC4 RB_Map_U16U16_U16 1.000000 fak_uw_b2 0.00 1.000000 FORMAT "%8.6" EXTENDED_LIMITS 0.00 1.999969
 /begin AXIS_DESCR STD_AXIS NO_INPUT_QUANTITY fak_uw_b16 8 0.00 15.99976 FORMAT "%8.5" DEPOSIT ABSOLUTE /end AXIS_DESCR
 /begin AXIS_DESCR STD_AXIS NO_INPUT_QUANTITY m_q0p1 6 0.00 6553.500 FORMAT "%8.3" DEPOSIT ABSOLUTE /end AXIS_DESCR
/end CHARACTERISTIC
/begin CHARACTERISTIC ExhMod_facHcCnvnCorrnLamHspCatHeatg_M "correction factor HC conversion engine in homogenous-split mode catalyst heating depending on lambda" MAP 0x8054C044 RB_Map_U16U16_U16 1.000000 fak_uw_b2 0.00 1.000000 FORMAT "%8.6" EXTENDED_LIMITS 0.00 1.999969
 /begin AXIS_DESCR STD_AXIS NO_INPUT_QUANTITY fak_uw_b16 8 0.00 15.99976 FORMAT "%8.5" DEPOSIT ABSOLUTE /end AXIS_DESCR
 /begin AXIS_DESCR STD_AXIS NO_INPUT_QUANTITY m_q0p1 6 0.00 6553.500 FORMAT "%8.3" DEPOSIT ABSOLUTE /end AXIS_DESCR
/end CHARACTERISTIC
/begin CHARACTERISTIC ExhMod_facHcCnvnCorrnLamHspCatHeatSustSecFu_M "correction factor for the conversion efficiency of secondary fuel based on lambda during HSP catalyst heating for warm sustenance mode" MAP 0x8054C0C4 RB_Map_U16U16_U16 1.000000 fak_uw_b2 0.00 1.000000 FORMAT "%8.6" EXTENDED_LIMITS 0.00 1.999969
 /begin AXIS_DESCR STD_AXIS NO_INPUT_QUANTITY fak_uw_b16 8 0.00 15.99976 FORMAT "%8.5" DEPOSIT ABSOLUTE /end AXIS_DESCR
 /begin AXIS_DESCR STD_AXIS NO_INPUT_QUANTITY m_q0p1 6 0.00 6553.500 FORMAT "%8.3" DEPOSIT ABSOLUTE /end AXIS_DESCR
/end CHARACTERISTIC
/begin CHARACTERISTIC ExhMod_facHcCnvnCorrnLamHspCatHeatSust_M "correction factor HC conversion engine in homogenous-split mode catalyst heat sustain depending on lambda" MAP 0x8054C144 RB_Map_U16U16_U16 1.000000 fak_uw_b2 0.00 1.000000 FORMAT "%8.6" EXTENDED_LIMITS 0.00 1.999969
 /begin AXIS_DESCR STD_AXIS NO_INPUT_QUANTITY fak_uw_b16 8 0.00 15.99976 FORMAT "%8.5" DEPOSIT ABSOLUTE /end AXIS_DESCR
 /begin AXIS_DESCR STD_AXIS NO_INPUT_QUANTITY m_q0p1 6 0.00 6553.500 FORMAT "%8.3" DEPOSIT ABSOLUTE /end AXIS_DESCR
/end CHARACTERISTIC
/begin CHARACTERISTIC ExhMod_facHcCnvnCorrnLamHspSecFu_M "correction factor for the conversion efficiency of secondary fuel based on lambda during HSP mode" MAP 0x8054C1C4 RB_Map_U16U16_U16 1.000000 fak_uw_b2 0.00 1.000000 FORMAT "%8.6" EXTENDED_LIMITS 0.00 1.999969
 /begin AXIS_DESCR STD_AXIS NO_INPUT_QUANTITY fak_uw_b16 8 0.00 15.99976 FORMAT "%8.5" DEPOSIT ABSOLUTE /end AXIS_DESCR
 /begin AXIS_DESCR STD_AXIS NO_INPUT_QUANTITY m_q0p1 6 0.00 6553.500 FORMAT "%8.3" DEPOSIT ABSOLUTE /end AXIS_DESCR
/end CHARACTERISTIC
/begin CHARACTERISTIC ExhMod_facHcCnvnCorrnLamHsp_M "correction factor HC conversion engine in homogenous-split mode depending on lambda" MAP 0x8054C244 RB_Map_U16U16_U16 1.000000 fak_uw_b2 0.00 1.000000 FORMAT "%8.6" EXTENDED_LIMITS 0.00 1.999969
 /begin AXIS_DESCR STD_AXIS NO_INPUT_QUANTITY fak_uw_b16 8 0.00 15.99976 FORMAT "%8.5" DEPOSIT ABSOLUTE /end AXIS_DESCR
 /begin AXIS_DESCR STD_AXIS NO_INPUT_QUANTITY m_q0p1 6 0.00 6553.500 FORMAT "%8.3" DEPOSIT ABSOLUTE /end AXIS_DESCR
/end CHARACTERISTIC
/begin CHARACTERISTIC ExhMod_facHcCnvnCorrnLamSecFu_M "correction factor for the conversion efficiency of secondary fuel based on lambda during normal mode" MAP 0x8054C2C4 RB_Map_U16U16_U16 1.000000 fak_uw_b2 0.00 1.000000 FORMAT "%8.6" EXTENDED_LIMITS 0.00 1.999969
 /begin AXIS_DESCR STD_AXIS NO_INPUT_QUANTITY fak_uw_b16 8 0.00 15.99976 FORMAT "%8.5" DEPOSIT ABSOLUTE /end AXIS_DESCR
 /begin AXIS_DESCR STD_AXIS NO_INPUT_QUANTITY m_q0p1 6 0.00 6553.500 FORMAT "%8.3" DEPOSIT ABSOLUTE /end AXIS_DESCR
/end CHARACTERISTIC
/begin CHARACTERISTIC ExhMod_facHcCnvnCorrnLam_M "correction factor HC conversion engine in homogenous mode depending on lambda" MAP 0x8054C344 RB_Map_U16U16_U16 1.000000 fak_uw_b2 0.00 1.000000 FORMAT "%8.6" EXTENDED_LIMITS 0.00 1.999969
 /begin AXIS_DESCR STD_AXIS NO_INPUT_QUANTITY fak_uw_b16 8 0.00 15.99976 FORMAT "%8.5" DEPOSIT ABSOLUTE /end AXIS_DESCR
 /begin AXIS_DESCR STD_AXIS NO_INPUT_QUANTITY m_q0p1 6 0.00 6553.500 FORMAT "%8.3" DEPOSIT ABSOLUTE /end AXIS_DESCR
/end CHARACTERISTIC
/begin CHARACTERISTIC ExhMod_facHcCnvnEngHspCatHeatgSecFu_M "Conversion efficiency of secondary fuel based during HSP catalyst heating mode" MAP 0x8054C3C4 RB_Map_U16S16_U16 1.000000 fak_uw_b2 0.00 1.000000 FORMAT "%8.6" EXTENDED_LIMITS 0.00 1.999969
 /begin AXIS_DESCR STD_AXIS rl_w_msg rel_q0p0234 6 0.00 1535.977 FORMAT "%8.3" DEPOSIT ABSOLUTE /end AXIS_DESCR
 /begin AXIS_DESCR STD_AXIS Epm_nEng nmot_q0p5 6 -16384.00 16383.50 FORMAT "%8.2" DEPOSIT ABSOLUTE /end AXIS_DESCR
/end CHARACTERISTIC
/begin CHARACTERISTIC ExhMod_facHcCnvnEngHspCatHeatg_M "map HC conversion in engine in homogenous-split mode catalyst heating" MAP 0x8054C428 RB_Map_U16S16_U16 1.000000 fak_uw_b2 0.00 1.000000 FORMAT "%8.6" EXTENDED_LIMITS 0.00 1.999969
 /begin AXIS_DESCR STD_AXIS rl_w_msg rel_q0p0234 6 0.00 1535.977 FORMAT "%8.3" DEPOSIT ABSOLUTE /end AXIS_DESCR
 /begin AXIS_DESCR STD_AXIS Epm_nEng nmot_q0p5 6 -16384.00 16383.50 FORMAT "%8.2" DEPOSIT ABSOLUTE /end AXIS_DESCR
/end CHARACTERISTIC
/begin CHARACTERISTIC ExhMod_facHcCnvnEngHspCatHeatSustSecFu_M "Conversion efficiency of secondary fuel based during HSP catalyst heating for warm sustenance" MAP 0x8054C48C RB_Map_U16S16_U16 1.000000 fak_uw_b2 0.00 1.000000 FORMAT "%8.6" EXTENDED_LIMITS 0.00 1.999969
 /begin AXIS_DESCR STD_AXIS rl_w_msg rel_q0p0234 6 0.00 1535.977 FORMAT "%8.3" DEPOSIT ABSOLUTE /end AXIS_DESCR
 /begin AXIS_DESCR STD_AXIS Epm_nEng nmot_q0p5 6 -16384.00 16383.50 FORMAT "%8.2" DEPOSIT ABSOLUTE /end AXIS_DESCR
/end CHARACTERISTIC
/begin CHARACTERISTIC ExhMod_facHcCnvnEngHspCatHeatSust_M "map HC conversion in engine in homogenous-split mode catalyst heat sustain" MAP 0x8054C4F0 RB_Map_U16S16_U16 1.000000 fak_uw_b2 0.00 1.000000 FORMAT "%8.6" EXTENDED_LIMITS 0.00 1.999969
 /begin AXIS_DESCR STD_AXIS rl_w_msg rel_q0p0234 6 0.00 1535.977 FORMAT "%8.3" DEPOSIT ABSOLUTE /end AXIS_DESCR
 /begin AXIS_DESCR STD_AXIS Epm_nEng nmot_q0p5 6 -16384.00 16383.50 FORMAT "%8.2" DEPOSIT ABSOLUTE /end AXIS_DESCR
/end CHARACTERISTIC
/begin CHARACTERISTIC ExhMod_facHcCnvnEngHspSecFu_M "Conversion efficiency of secondary fuel based during HSP" MAP 0x8054C554 RB_Map_U16S16_U16 1.000000 fak_uw_b2 0.00 1.000000 FORMAT "%8.6" EXTENDED_LIMITS 0.00 1.999969
 /begin AXIS_DESCR STD_AXIS rl_w_msg rel_q0p0234 6 0.00 1535.977 FORMAT "%8.3" DEPOSIT ABSOLUTE /end AXIS_DESCR
 /begin AXIS_DESCR STD_AXIS Epm_nEng nmot_q0p5 6 -16384.00 16383.50 FORMAT "%8.2" DEPOSIT ABSOLUTE /end AXIS_DESCR
/end CHARACTERISTIC
/begin CHARACTERISTIC ExhMod_facHcCnvnEngHsp_M "map HC conversion in engine in homogenous-split mode" MAP 0x8054C5B8 RB_Map_U16S16_U16 1.000000 fak_uw_b2 0.00 1.000000 FORMAT "%8.6" EXTENDED_LIMITS 0.00 1.999969
 /begin AXIS_DESCR STD_AXIS rl_w_msg rel_q0p0234 6 0.00 1535.977 FORMAT "%8.3" DEPOSIT ABSOLUTE /end AXIS_DESCR
 /begin AXIS_DESCR STD_AXIS Epm_nEng nmot_q0p5 6 -16384.00 16383.50 FORMAT "%8.2" DEPOSIT ABSOLUTE /end AXIS_DESCR
/end CHARACTERISTIC
/begin CHARACTERISTIC ExhMod_facHcCnvnEngSecFu_M "Conversion efficiency of secondary fuel based during normal mode" MAP 0x8054C61C RB_Map_U16S16_U16 1.000000 fak_uw_b2 0.00 1.000000 FORMAT "%8.6" EXTENDED_LIMITS 0.00 1.999969
 /begin AXIS_DESCR STD_AXIS rl_w_msg rel_q0p0234 6 0.00 1535.977 FORMAT "%8.3" DEPOSIT ABSOLUTE /end AXIS_DESCR
 /begin AXIS_DESCR STD_AXIS Epm_nEng nmot_q0p5 6 -16384.00 16383.50 FORMAT "%8.2" DEPOSIT ABSOLUTE /end AXIS_DESCR
/end CHARACTERISTIC
/begin CHARACTERISTIC ExhMod_facHcCnvnEng_M "map HC conversion in engine" MAP 0x8054C680 RB_Map_U16S16_U16 1.000000 fak_uw_b2 0.00 1.000000 FORMAT "%8.6" EXTENDED_LIMITS 0.00 1.999969
 /begin AXIS_DESCR STD_AXIS rl_w_msg rel_q0p0234 6 0.00 1535.977 FORMAT "%8.3" DEPOSIT ABSOLUTE /end AXIS_DESCR
 /begin AXIS_DESCR STD_AXIS Epm_nEng nmot_q0p5 6 -16384.00 16383.50 FORMAT "%8.2" DEPOSIT ABSOLUTE /end AXIS_DESCR
/end CHARACTERISTIC
/begin CHARACTERISTIC ExhMod_facIntrpnBlowrB1_T "interpolation factor blower bank 1" CURVE 0x8054C7E6 RB_Curve_U8_U8 1.000000 fak_ub_b2 0.00 1.000000 FORMAT "%8.6" EXTENDED_LIMITS 0.00 1.992188
 /begin AXIS_DESCR STD_AXIS NO_INPUT_QUANTITY dez 12 0.00 255.0 FORMAT "%5.1" DEPOSIT ABSOLUTE /end AXIS_DESCR
/end CHARACTERISTIC
/begin CHARACTERISTIC ExhMod_facIntrpnGslSecFu_T "curve to convert the interpolation factor between gasoline and secondary fuel for exhaust modelling" CURVE 0x8054C6E4 RB_Curve_U16_U16 1.999969 fak_uw_b2 0.00 1.999969 FORMAT "%8.6"
 /begin AXIS_DESCR STD_AXIS ExhMod_facIntrpnGslSecFu fak_uw_b2 8 0.00 1.999969 FORMAT "%8.6" DEPOSIT ABSOLUTE /end AXIS_DESCR
/end CHARACTERISTIC
/begin CHARACTERISTIC ExhMod_facIntrpnTEnvB1_M "interpolation factor temperature environment bank 1" MAP 0x8054C800 RB_Map_U16U8_U8 0.9961 fak_ub_b1 0.00 0.9961
 /begin AXIS_DESCR STD_AXIS NO_INPUT_QUANTITY vfzg_uw_b512 5 0.00 511.9922 FORMAT "%8.4" DEPOSIT ABSOLUTE /end AXIS_DESCR
 /begin AXIS_DESCR STD_AXIS NO_INPUT_QUANTITY dez 12 0.00 255.0 FORMAT "%5.1" DEPOSIT ABSOLUTE /end AXIS_DESCR
/end CHARACTERISTIC
/begin CHARACTERISTIC ExhMod_facIntrpnTEnvBlowrB1_M "interpolation factor temperature environment blower bank 1" MAP 0x8054C856 RB_Map_U16U8_S16 1.999969 fak_sw_b1 -1.000000 0.999969 FORMAT "%8.6" EXTENDED_LIMITS -1.000000 0.9999695
 /begin AXIS_DESCR STD_AXIS NO_INPUT_QUANTITY rel_q0p012207 5 0.00 399.9878 FORMAT "%8.4" EXTENDED_LIMITS 0.00 799.9878 DEPOSIT ABSOLUTE /end AXIS_DESCR
 /begin AXIS_DESCR STD_AXIS NO_INPUT_QUANTITY dez 12 0.00 255.0 FORMAT "%5.1" DEPOSIT ABSOLUTE /end AXIS_DESCR
/end CHARACTERISTIC
/begin CHARACTERISTIC ExhMod_facIntrpnTEnvBlowrCorrnVB1_T "correction interpolation factor temperature environment blower depending on velocity bank 1" CURVE 0x8054C8E8 RB_Curve_U16_U8_Static 0.9961 fak_ub_b1 0.00 0.9961
 /begin AXIS_DESCR STD_AXIS NO_INPUT_QUANTITY vfzg_uw_b512 3 0.00 511.9922 FORMAT "%8.4" DEPOSIT ABSOLUTE /end AXIS_DESCR
/end CHARACTERISTIC
/begin CHARACTERISTIC ExhMod_facIntrpnTEnvCorrnTWallB1_M "Interpolation factor for the environment temperature correction based on wall temperature bank 1" MAP 0x8054C8F4 RB_Map_S16U8_U8 0.9961 fak_ub_b1 0.00 0.9961
 /begin AXIS_DESCR STD_AXIS NO_INPUT_QUANTITY Temp_Cels 5 -3549.940 3003.560 FORMAT "%8.3" DEPOSIT ABSOLUTE /end AXIS_DESCR
 /begin AXIS_DESCR STD_AXIS NO_INPUT_QUANTITY dez 12 0.00 255.0 FORMAT "%5.1" DEPOSIT ABSOLUTE /end AXIS_DESCR
/end CHARACTERISTIC
/begin CHARACTERISTIC ExhMod_facIntrpnTEnvTWallBlowrB1_M "Interpolation factorbetween Wall and environment temperature based on air blower duty cycle bank 1" MAP 0x8054C94A RB_Map_U16U8_S16 1.999969 fak_sw_b1 -1.000000 0.999969 FORMAT "%8.6" EXTENDED_LIMITS -1.000000 0.9999695
 /begin AXIS_DESCR STD_AXIS NO_INPUT_QUANTITY rel_q0p012207 5 0.00 399.9878 FORMAT "%8.4" EXTENDED_LIMITS 0.00 799.9878 DEPOSIT ABSOLUTE /end AXIS_DESCR
 /begin AXIS_DESCR STD_AXIS NO_INPUT_QUANTITY dez 12 0.00 255.0 FORMAT "%5.1" DEPOSIT ABSOLUTE /end AXIS_DESCR
/end CHARACTERISTIC
/begin CHARACTERISTIC ExhMod_facIntrpnTEnvTWallBlowrVehVB1_T "Correction to interpolation factor between Wall and environment temperature with air blower based on vehicle speed bank 1" CURVE 0x8054C9DC RB_Curve_U16_U8_Static 0.9961 fak_ub_b1 0.00 0.9961
 /begin AXIS_DESCR STD_AXIS NO_INPUT_QUANTITY vfzg_uw_b512 3 0.00 511.9922 FORMAT "%8.4" DEPOSIT ABSOLUTE /end AXIS_DESCR
/end CHARACTERISTIC
/begin CHARACTERISTIC ExhMod_facIntrpnTEnvTWallVehVB1_M "Interpolation factorbetween Wall and environment temperature based on vehicle speed bank 1" MAP 0x8054C9E8 RB_Map_U16U8_U8 0.9961 fak_ub_b1 0.00 0.9961
 /begin AXIS_DESCR STD_AXIS NO_INPUT_QUANTITY vfzg_uw_b512 5 0.00 511.9922 FORMAT "%8.4" DEPOSIT ABSOLUTE /end AXIS_DESCR
 /begin AXIS_DESCR STD_AXIS NO_INPUT_QUANTITY dez 12 0.00 255.0 FORMAT "%5.1" DEPOSIT ABSOLUTE /end AXIS_DESCR
/end CHARACTERISTIC
/begin CHARACTERISTIC ExhMod_facRawEmiCorrnRailPHsp_T "correction factor for the conversion efficiency of fuel based on rail pressure during HSP mode" CURVE 0x8054C706 RB_Curve_U16_U16 1.000000 fak_uw_b2 0.00 1.000000 FORMAT "%8.6" EXTENDED_LIMITS 0.00 1.999969
 /begin AXIS_DESCR STD_AXIS NO_INPUT_QUANTITY RBPtCel_p_0p002_1 8 0.00 131.0700 FORMAT "%8.4" DEPOSIT ABSOLUTE /end AXIS_DESCR
/end CHARACTERISTIC
/begin CHARACTERISTIC ExhMod_facRawEmiCorrnRailP_T "correction factor raw emission depending on rail pressure" CURVE 0x8054C728 RB_Curve_U16_U16 1.000000 fak_uw_b2 0.00 1.000000 FORMAT "%8.6" EXTENDED_LIMITS 0.00 1.999969
 /begin AXIS_DESCR STD_AXIS NO_INPUT_QUANTITY RBPtCel_p_0p002_1 8 0.00 131.0700 FORMAT "%8.4" DEPOSIT ABSOLUTE /end AXIS_DESCR
/end CHARACTERISTIC
/begin CHARACTERISTIC ExhMod_facRelHum_C "relative humidity" VALUE 0x8054C74A RB_Val_Wu16 1.999969 fak_uw_b2 0.00 1.999969 FORMAT "%8.6" /end CHARACTERISTIC
/begin CHARACTERISTIC ExhMod_facTEngCorrnB1_CA "temperature correction engine bank 1" VAL_BLK 0x8054CA3E RB_ValA_Wu16 2.000000 fak_ub_b2 1.000000 3.000000 FORMAT "%8.6" EXTENDED_LIMITS 0.00 511.9922 NUMBER 12 /end CHARACTERISTIC
/begin CHARACTERISTIC ExhMod_facTEnvCorrnTEngB1_M "Correction of environment temperature based on engine temperature bank 1" MAP 0x8054CA56 RB_Map_S16U8_U8 0.9961 fak_ub_b1 0.00 0.9961
 /begin AXIS_DESCR STD_AXIS NO_INPUT_QUANTITY Temp_Cels 5 -3549.940 3003.560 FORMAT "%8.3" DEPOSIT ABSOLUTE /end AXIS_DESCR
 /begin AXIS_DESCR STD_AXIS NO_INPUT_QUANTITY dez 12 0.00 255.0 FORMAT "%5.1" DEPOSIT ABSOLUTE /end AXIS_DESCR
/end CHARACTERISTIC
/begin CHARACTERISTIC ExhMod_facWghtMnfldCatExoCcoLam_M "weighting factor manifold catalyst exothermy cylinder cut-off depending on lambda" MAP 0x8054A4DE RB_Map_U16U16_U16 1.000000 fak_uw_b2 0.00 1.000000 FORMAT "%8.6" EXTENDED_LIMITS 0.00 1.999969
 /begin AXIS_DESCR STD_AXIS NO_INPUT_QUANTITY fak_uw_b16 8 0.00 15.99976 FORMAT "%8.5" DEPOSIT ABSOLUTE /end AXIS_DESCR
 /begin AXIS_DESCR STD_AXIS NO_INPUT_QUANTITY fak_uw_b16 8 0.00 15.99976 FORMAT "%8.5" DEPOSIT ABSOLUTE /end AXIS_DESCR
/end CHARACTERISTIC
/begin CHARACTERISTIC ExhMod_facWghtMnfldCatExoCcoTB1_T "weighting factor manifold catalyst exothermy cylinder cut-off depending on temperature bank 1" CURVE 0x8054A582 RB_Curve_S16_S16 1.000000 fak_ub_b2 0.00 1.000000 FORMAT "%8.6" EXTENDED_LIMITS -256.0000 255.9922
 /begin AXIS_DESCR STD_AXIS NO_INPUT_QUANTITY Temp_Cels 8 -3549.940 3003.560 FORMAT "%8.3" DEPOSIT ABSOLUTE /end AXIS_DESCR
/end CHARACTERISTIC
/begin CHARACTERISTIC ExhMod_flgActvtExoCalcnEngOff_C "Aktivierung der Exothermieberechnung nach Motorabschaltung" VALUE 0x8054A5A4 RB_Val_Wboolean 1.00000000000 B_TRUE 0.00 1.00000000000 FORMAT "%13.11" /end CHARACTERISTIC
/begin CHARACTERISTIC ExhMod_flgActvtExoCalcnTranLtr_C "Activate exothermicity calculation for a Lambda transition from lean-to-rich" VALUE 0x8054A5A5 RB_Val_Wboolean 1.00000000000 B_TRUE 0.00 1.00000000000 FORMAT "%13.11" /end CHARACTERISTIC
/begin CHARACTERISTIC ExhMod_flgActvtExoCalcnTranRtl_C "Activate exothermicity calculation for a Lambda transition from rich-to-lean" VALUE 0x8054A5A6 RB_Val_Wboolean 1.00000000000 B_TRUE 0.00 1.00000000000 FORMAT "%13.11" /end CHARACTERISTIC
/begin CHARACTERISTIC ExhMod_flgTEnvCorrn_C "Flag for activating the calculation of the representative ambient temperature" VALUE 0x8054CAAC RB_Val_Wboolean 1.00000000000 B_TRUE 0.00 1.00000000000 FORMAT "%13.11" /end CHARACTERISTIC
/begin CHARACTERISTIC ExhMod_mfEngOffMin_C "Minimaler Abgasmassenstrom zur Bestimmung der Motorabschaltung" VALUE 0x8054A5A8 RB_Val_Wu16 6553.500 m_q0p1 0.00 6553.500 FORMAT "%8.3" /end CHARACTERISTIC
/begin CHARACTERISTIC ExhMod_nrHHc_C "number hydrogen atoms in hydrocarbon" VALUE 0x8054C74C RB_Val_Wu16 4.000000 fak_uw_b8 0.00 4.000000 FORMAT "%8.6" EXTENDED_LIMITS 0.00 7.999878 /end CHARACTERISTIC
/begin CHARACTERISTIC ExhMod_nrIterPDiffCat_C "Number of iterations pressure drop calculation catalysts" VALUE 0x8054A1C8 RB_Val_Wu8 255.0 dez 0.00 255.0 FORMAT "%5.1" /end CHARACTERISTIC
/begin CHARACTERISTIC ExhMod_pDifCatDsMflow_T "Characteristic map mass flow-dependent factor in press. gradient downstream last catalyst to environment" CURVE 0x8054A1CA RB_Curve_S16_U16_Static 1048560. fak_q16_hPahPa 0.00 1048560. FORMAT "%8.0"
 /begin AXIS_DESCR STD_AXIS NO_INPUT_QUANTITY m_q0p1 12 -3276.800 3276.700 FORMAT "%8.3" DEPOSIT ABSOLUTE /end AXIS_DESCR
/end CHARACTERISTIC
/begin CHARACTERISTIC ExhMod_pDiffCatMFlow_M "Characteristic map mass flow-dependent factor in press. gradient catalysts" MAP 0x8054A1FC RB_Map_S16U16_U16 1048560. fak_q16_hPahPa 0.00 1048560. FORMAT "%8.0"
 /begin AXIS_DESCR STD_AXIS NO_INPUT_QUANTITY m_q0p1 12 -3276.800 3276.700 FORMAT "%8.3" DEPOSIT ABSOLUTE /end AXIS_DESCR
 /begin AXIS_DESCR STD_AXIS NO_INPUT_QUANTITY dez 2 0.00 255.0000 FORMAT "%8.4" EXTENDED_LIMITS 0.00 65535.00 DEPOSIT ABSOLUTE /end AXIS_DESCR
/end CHARACTERISTIC
/begin CHARACTERISTIC ExhMod_pEnvApplRawEmi_C "application value pressure environment raw emission modell" VALUE 0x8054C74E RB_Val_Wu16 2559.961 p_uw_q0p039 0.00 2559.961 FORMAT "%8.3" /end CHARACTERISTIC
/begin CHARACTERISTIC ExhMod_pEnvDiffAppl_C "Offset on ambient pressure for the exhaust backpressure model" VALUE 0x8054A24C RB_Val_Wu16 2559.961 p_q0p039 0.00 2559.961 FORMAT "%8.3" /end CHARACTERISTIC
/begin CHARACTERISTIC ExhMod_pSatnH2o_T "pressure saturation water" CURVE 0x8054C750 RB_Curve_S16_U16_Static 2559.961 p_uw_q0p039 0.00 2559.961 FORMAT "%8.3"
 /begin AXIS_DESCR STD_AXIS NO_INPUT_QUANTITY Temp_Cels 12 -3549.940 3003.560 FORMAT "%8.3" DEPOSIT ABSOLUTE /end AXIS_DESCR
/end CHARACTERISTIC
/begin CHARACTERISTIC ExhMod_pwrEngOffB1_C "Heatflow after engine-off Bank 1" VALUE 0x8054A5AC RB_Val_Wr32 5000000.00 HtFlw_Fl 0.00 5000000.000 FORMAT "%11.3" EXTENDED_LIMITS -3.40282347E+038 3.40282347E+038 /end CHARACTERISTIC
/begin CHARACTERISTIC ExhMod_ratCoH2SecFu_T "Conversion rate for CO to H2(water gas shift reaction) for secondary fuel" CURVE 0x8054C782 RB_Curve_U16_U16 1023.984 fak_uw_b1024 0.00 1023.984 FORMAT "%8.3"
 /begin AXIS_DESCR STD_AXIS NO_INPUT_QUANTITY fak_uw_b16 8 0.00 15.99976 FORMAT "%8.5" DEPOSIT ABSOLUTE /end AXIS_DESCR
/end CHARACTERISTIC
/begin CHARACTERISTIC ExhMod_ratCoH2_T "ratio CO and H2" CURVE 0x8054C7A4 RB_Curve_U16_U16 1023.984 fak_uw_b1024 0.00 1023.984 FORMAT "%8.3"
 /begin AXIS_DESCR STD_AXIS NO_INPUT_QUANTITY fak_uw_b16 8 0.00 15.99976 FORMAT "%8.5" DEPOSIT ABSOLUTE /end AXIS_DESCR
/end CHARACTERISTIC
/begin CHARACTERISTIC ExhMod_ratHCSecFu_C "Ratio of H to C in secondary fuel" VALUE 0x8054C7C6 RB_Val_Wu16 4.000000 fak_uw_b8 0.00 4.000000 FORMAT "%8.6" EXTENDED_LIMITS 0.00 7.999878 /end CHARACTERISTIC
/begin CHARACTERISTIC ExhMod_ratLamLeanFco_C "Lambda set point at fuel cut off in Temperature Model Exhaust System" VALUE 0x8054A5B0 RB_Val_Wu16 15.99976 fak_uw_b16 0.00 15.99976 FORMAT "%8.5" /end CHARACTERISTIC
/begin CHARACTERISTIC ExhMod_ratLamThdLeanLtr_C "Threshold lambda ratio lean for exothermy calculation lean to rich transition" VALUE 0x8054A5B2 RB_Val_Wu16 15.99976 fak_uw_b16 0.00 15.99976 FORMAT "%8.5" /end CHARACTERISTIC
/begin CHARACTERISTIC ExhMod_ratLamThdLeanRtl_C "Threshold lambda ratio lean for exothermy calculation rich to lean transition" VALUE 0x8054A5B4 RB_Val_Wu16 15.99976 fak_uw_b16 0.00 15.99976 FORMAT "%8.5" /end CHARACTERISTIC
/begin CHARACTERISTIC ExhMod_ratLamThdRichLtr_C "threshold lambda ratio rich for exothermy calculation lean to rich transition" VALUE 0x8054A5B6 RB_Val_Wu16 15.99976 fak_uw_b16 0.00 15.99976 FORMAT "%8.5" /end CHARACTERISTIC
/begin CHARACTERISTIC ExhMod_ratLamThdRichRtl_C "threshold lambda ratio rich for exothermy calculation rich to lean transition" VALUE 0x8054A5B8 RB_Val_Wu16 15.99976 fak_uw_b16 0.00 15.99976 FORMAT "%8.5" /end CHARACTERISTIC
/begin CHARACTERISTIC ExhMod_ratOCSecFu_C "Ratio of O to C in secondary fuel" VALUE 0x8054C7C8 RB_Val_Wu16 1.000000 fak_uw_b8 0.00 1.000000 FORMAT "%8.6" EXTENDED_LIMITS 0.00 7.999878 /end CHARACTERISTIC
/begin CHARACTERISTIC ExhMod_rFlowSilLnrB1_C "Silencer flow resistance (laminar flow) bank 1" VALUE 0x8054A250 RB_Val_Wr32 1.0000000E+021 q1_N_s_DIV_m5 -5.0000000E+020 5.0000000E+020 FORMAT "%20.7" EXTENDED_LIMITS -3.4028235E+038 3.4028235E+038 /end CHARACTERISTIC
/begin CHARACTERISTIC ExhMod_rFlowSilQdrtcB1_C "Silencer flow resistance (turbulent flow) bank 1" VALUE 0x8054A254 RB_Val_Wr32 1.0000000E+021 q1_N_s2_DIV_m8 -5.0000000E+020 5.0000000E+020 FORMAT "%20.7" EXTENDED_LIMITS -3.4028235E+038 3.4028235E+038 /end CHARACTERISTIC
/begin CHARACTERISTIC ExhMod_stExoCalcnActvTransLtr_C "Status bit to activate the exothermicity calculation during a lean-to-rich lambda transition" VALUE 0x8054A5BA RB_Val_Wu8 255.0 OneToOne 0.00 255.0 FORMAT "%5.1" /end CHARACTERISTIC
/begin CHARACTERISTIC ExhMod_stExoCat1Br1_C "codeword first catalyst first brick" VALUE 0x8054A5BB RB_Val_Wu8 255.0 dez 0.00 255.0 FORMAT "%5.1" /end CHARACTERISTIC
/begin CHARACTERISTIC ExhMod_stMskSigQlyEnvT_C "signal quality mask for the enviroment temperature sensor" VALUE 0x8054CAAE RB_Val_Wu16 65535.00 OneToOne 0.00 65535.00 FORMAT "%8.2" /end CHARACTERISTIC
/begin CHARACTERISTIC ExhMod_stOsc_C "Code word regulation oxygen storage capability" VALUE 0x805498D0 RB_Val_Wu16 65535.00 dez 0.00 65535.00 FORMAT "%8.2" /end CHARACTERISTIC
/begin CHARACTERISTIC ExhMod_stPMdl_C "Codeword ExhMod_PMdl" VALUE 0x8054A258 RB_Val_Wu8 255.0 dez 0.00 255.0 FORMAT "%5.1" /end CHARACTERISTIC
/begin CHARACTERISTIC ExhMod_stPwrReactnMapBasd1_C "codeword 1 map based reaction heat modell" VALUE 0x8054A5BC RB_Val_Wu16 65535.00 dez 0.00 65535.00 FORMAT "%8.2" /end CHARACTERISTIC
/begin CHARACTERISTIC ExhMod_stPwrReactnMapBasd2_C "codeword 2 map based reaction heat modell" VALUE 0x8054A5BE RB_Val_Wu8 255.0 dez 0.00 255.0 FORMAT "%5.1" /end CHARACTERISTIC
/begin CHARACTERISTIC ExhMod_stPwrReactnMapBasd3_C "codeword 3 map based reaction heat modell" VALUE 0x8054A5BF RB_Val_Wu8 255.0 dez 0.00 255.0 FORMAT "%5.1" /end CHARACTERISTIC
/begin CHARACTERISTIC ExhMod_stPwrReactnMapBasd_C "codeword 0 map based reaction heat modell" VALUE 0x8054A5C0 RB_Val_Wu16 65535.00 dez 0.00 65535.00 FORMAT "%8.2" /end CHARACTERISTIC
/begin CHARACTERISTIC ExhMod_stRawEmiMdl_C "code word raw emission modell" VALUE 0x8054C7CA RB_Val_Wu8 255.0 dez 0.00 255.0 FORMAT "%5.1" /end CHARACTERISTIC
/begin CHARACTERISTIC ExhMod_tDeltaExoColdCatB1_CA "exothermy cold catalyst bank 1" VAL_BLK 0x8054A5C2 RB_ValA_Ws16 1535.977 temp_q0p0234 -768.0000 767.9766 FORMAT "%8.4" NUMBER 2 /end CHARACTERISTIC
/begin CHARACTERISTIC ExhMod_tDeltaExoFco_M "exothermy fuel cut-off" MAP 0x8054A5C6 RB_Map_U16U16_U16 12287.81 temp_q0p1875 0.00 12287.81 FORMAT "%8.2"
 /begin AXIS_DESCR STD_AXIS NO_INPUT_QUANTITY m_uw_b6553p5 6 0.00 6553.500 FORMAT "%8.3" DEPOSIT ABSOLUTE /end AXIS_DESCR
 /begin AXIS_DESCR STD_AXIS NO_INPUT_QUANTITY fak_uw_b16 6 0.00 15.99976 FORMAT "%8.5" DEPOSIT ABSOLUTE /end AXIS_DESCR
/end CHARACTERISTIC
/begin CHARACTERISTIC ExhMod_tDeltaExoHomB1_M "exothermy catalyst bricks homogenous operation bank 1" MAP 0x8054A62A RB_Map_U16U16_S16 1535.977 temp_q0p0234 -768.0000 767.9766 FORMAT "%8.4"
 /begin AXIS_DESCR STD_AXIS NO_INPUT_QUANTITY m_uw_b6553p5 11 0.00 6553.500 FORMAT "%8.3" DEPOSIT ABSOLUTE /end AXIS_DESCR
 /begin AXIS_DESCR STD_AXIS NO_INPUT_QUANTITY dez 6 0.00 255.0000 FORMAT "%8.4" EXTENDED_LIMITS 0.00 65535.00 DEPOSIT ABSOLUTE /end AXIS_DESCR
/end CHARACTERISTIC
/begin CHARACTERISTIC ExhMod_tDeltaExoHomCatHeatgSecFuB1_M "exothermy catalyst bricks HOM catalyst heating secondary fuel bank 1" MAP 0x8054A6D4 RB_Map_U16U16_S16 1535.977 temp_q0p0234 -768.0000 767.9766 FORMAT "%8.4"
 /begin AXIS_DESCR STD_AXIS NO_INPUT_QUANTITY m_uw_b6553p5 11 0.00 6553.500 FORMAT "%8.3" DEPOSIT ABSOLUTE /end AXIS_DESCR
 /begin AXIS_DESCR STD_AXIS NO_INPUT_QUANTITY dez 6 0.00 255.0000 FORMAT "%8.4" EXTENDED_LIMITS 0.00 65535.00 DEPOSIT ABSOLUTE /end AXIS_DESCR
/end CHARACTERISTIC
/begin CHARACTERISTIC ExhMod_tDeltaExoHomCatHeatSustSecFuB1_M "exothermy catalyst bricks HOM catalyst heat sustain secondary fuel bank 1" MAP 0x8054A77E RB_Map_U16U16_S16 1535.977 temp_q0p0234 -768.0000 767.9766 FORMAT "%8.4"
 /begin AXIS_DESCR STD_AXIS NO_INPUT_QUANTITY m_uw_b6553p5 11 0.00 6553.500 FORMAT "%8.3" DEPOSIT ABSOLUTE /end AXIS_DESCR
 /begin AXIS_DESCR STD_AXIS NO_INPUT_QUANTITY dez 6 0.00 255.0000 FORMAT "%8.4" EXTENDED_LIMITS 0.00 65535.00 DEPOSIT ABSOLUTE /end AXIS_DESCR
/end CHARACTERISTIC
/begin CHARACTERISTIC ExhMod_tDeltaExoHomSecFuB1_M "exothermy catalyst bricks homogenous operation secondary fuel bank 1" MAP 0x8054A828 RB_Map_U16U16_S16 1535.977 temp_q0p0234 -768.0000 767.9766 FORMAT "%8.4"
 /begin AXIS_DESCR STD_AXIS NO_INPUT_QUANTITY m_uw_b6553p5 11 0.00 6553.500 FORMAT "%8.3" DEPOSIT ABSOLUTE /end AXIS_DESCR
 /begin AXIS_DESCR STD_AXIS NO_INPUT_QUANTITY dez 6 0.00 255.0000 FORMAT "%8.4" EXTENDED_LIMITS 0.00 65535.00 DEPOSIT ABSOLUTE /end AXIS_DESCR
/end CHARACTERISTIC
/begin CHARACTERISTIC ExhMod_tDeltaExoHspB1_M "exothermy catalyst bricks homogenous-split-operation bank 1" MAP 0x8054A8D2 RB_Map_U16U16_S16 1535.977 temp_q0p0234 -768.0000 767.9766 FORMAT "%8.4"
 /begin AXIS_DESCR STD_AXIS NO_INPUT_QUANTITY m_uw_b6553p5 11 0.00 6553.500 FORMAT "%8.3" DEPOSIT ABSOLUTE /end AXIS_DESCR
 /begin AXIS_DESCR STD_AXIS NO_INPUT_QUANTITY dez 6 0.00 255.0000 FORMAT "%8.4" EXTENDED_LIMITS 0.00 65535.00 DEPOSIT ABSOLUTE /end AXIS_DESCR
/end CHARACTERISTIC
/begin CHARACTERISTIC ExhMod_tDeltaExoHspCatHeatgB1_M "exothermy catalyst bricks homogenous-split-operation catalyst heating bank 1" MAP 0x8054A97C RB_Map_U16U16_S16 1535.977 temp_q0p0234 -768.0000 767.9766 FORMAT "%8.4"
 /begin AXIS_DESCR STD_AXIS NO_INPUT_QUANTITY m_uw_b6553p5 11 0.00 6553.500 FORMAT "%8.3" DEPOSIT ABSOLUTE /end AXIS_DESCR
 /begin AXIS_DESCR STD_AXIS NO_INPUT_QUANTITY dez 6 0.00 255.0000 FORMAT "%8.4" EXTENDED_LIMITS 0.00 65535.00 DEPOSIT ABSOLUTE /end AXIS_DESCR
/end CHARACTERISTIC
/begin CHARACTERISTIC ExhMod_tDeltaExoHspCatHeatgSecFuB1_M "exothermy catalyst bricks homogenous-split-operation catalyst heating secondary fuel bank 1" MAP 0x8054AA26 RB_Map_U16U16_S16 1535.977 temp_q0p0234 -768.0000 767.9766 FORMAT "%8.4"
 /begin AXIS_DESCR STD_AXIS NO_INPUT_QUANTITY m_uw_b6553p5 11 0.00 6553.500 FORMAT "%8.3" DEPOSIT ABSOLUTE /end AXIS_DESCR
 /begin AXIS_DESCR STD_AXIS NO_INPUT_QUANTITY dez 6 0.00 255.0000 FORMAT "%8.4" EXTENDED_LIMITS 0.00 65535.00 DEPOSIT ABSOLUTE /end AXIS_DESCR
/end CHARACTERISTIC
/begin CHARACTERISTIC ExhMod_tDeltaExoHspCatHeatSustB1_M "exothermy catalyst bricks homogenous-split-operation catalyst heat sustain bank 1" MAP 0x8054AAD0 RB_Map_U16U16_S16 1535.977 temp_q0p0234 -768.0000 767.9766 FORMAT "%8.4"
 /begin AXIS_DESCR STD_AXIS NO_INPUT_QUANTITY m_uw_b6553p5 11 0.00 6553.500 FORMAT "%8.3" DEPOSIT ABSOLUTE /end AXIS_DESCR
 /begin AXIS_DESCR STD_AXIS NO_INPUT_QUANTITY dez 6 0.00 255.0000 FORMAT "%8.4" EXTENDED_LIMITS 0.00 65535.00 DEPOSIT ABSOLUTE /end AXIS_DESCR
/end CHARACTERISTIC
/begin CHARACTERISTIC ExhMod_tDeltaExoHspCatHeatSustSecFuB1_M "exothermy catalyst bricks homogenous-split-operation catalyst heat sustain secondary fuel bank 1" MAP 0x8054AB7A RB_Map_U16U16_S16 1535.977 temp_q0p0234 -768.0000 767.9766 FORMAT "%8.4"
 /begin AXIS_DESCR STD_AXIS NO_INPUT_QUANTITY m_uw_b6553p5 11 0.00 6553.500 FORMAT "%8.3" DEPOSIT ABSOLUTE /end AXIS_DESCR
 /begin AXIS_DESCR STD_AXIS NO_INPUT_QUANTITY dez 6 0.00 255.0000 FORMAT "%8.4" EXTENDED_LIMITS 0.00 65535.00 DEPOSIT ABSOLUTE /end AXIS_DESCR
/end CHARACTERISTIC
/begin CHARACTERISTIC ExhMod_tDeltaExoHspSecFuB1_M "exothermy catalyst bricks homogenous-split-operation secondary fuel bank 1" MAP 0x8054AC24 RB_Map_U16U16_S16 1535.977 temp_q0p0234 -768.0000 767.9766 FORMAT "%8.4"
 /begin AXIS_DESCR STD_AXIS NO_INPUT_QUANTITY m_uw_b6553p5 11 0.00 6553.500 FORMAT "%8.3" DEPOSIT ABSOLUTE /end AXIS_DESCR
 /begin AXIS_DESCR STD_AXIS NO_INPUT_QUANTITY dez 6 0.00 255.0000 FORMAT "%8.4" EXTENDED_LIMITS 0.00 65535.00 DEPOSIT ABSOLUTE /end AXIS_DESCR
/end CHARACTERISTIC
/begin CHARACTERISTIC ExhMod_tDeltaExoTotHomB1_M "total exothermy catalyst bricks homogenous operation bank 1" MAP 0x8054ACCE RB_Map_S16U16_U16 8191.875 temp_sw_q0p125 0.00 8191.875 FORMAT "%8.3"
 /begin AXIS_DESCR STD_AXIS Epm_nEng nmot_q0p5 11 -16384.00 16383.50 FORMAT "%8.2" DEPOSIT ABSOLUTE /end AXIS_DESCR
 /begin AXIS_DESCR STD_AXIS AirMod_ratChrgAirCyl Perc_q0p0234375_COMPU 11 0.00 1535.977 FORMAT "%8.3" DEPOSIT ABSOLUTE /end AXIS_DESCR
/end CHARACTERISTIC
/begin CHARACTERISTIC ExhMod_tDeltaExoTotHomCatHeatgB1_M "total exothermy catalyst bricks homogenous catalyst heating operation bank 1" MAP 0x8054ADF0 RB_Map_S16U16_U16 8191.875 temp_sw_q0p125 0.00 8191.875 FORMAT "%8.3"
 /begin AXIS_DESCR STD_AXIS Epm_nEng nmot_q0p5 11 -16384.00 16383.50 FORMAT "%8.2" DEPOSIT ABSOLUTE /end AXIS_DESCR
 /begin AXIS_DESCR STD_AXIS AirMod_ratChrgAirCyl Perc_q0p0234375_COMPU 11 0.00 1535.977 FORMAT "%8.3" DEPOSIT ABSOLUTE /end AXIS_DESCR
/end CHARACTERISTIC
/begin CHARACTERISTIC ExhMod_tDeltaExoTotHomCatHeatgSecFuB1_M "Gesamte exotherme Temperaturerhöhung im Katalysator während Katheizen für kalt motorstart in Homogen-Betrieb mit alternativer Treibstoff Bank 1" MAP 0x8054AF12 RB_Map_S16U16_U16 8191.875 temp_sw_q0p125 0.00 8191.875 FORMAT "%8.3"
 /begin AXIS_DESCR STD_AXIS Epm_nEng nmot_q0p5 11 -16384.00 16383.50 FORMAT "%8.2" DEPOSIT ABSOLUTE /end AXIS_DESCR
 /begin AXIS_DESCR STD_AXIS AirMod_ratChrgAirCyl Perc_q0p0234375_COMPU 11 0.00 1535.977 FORMAT "%8.3" DEPOSIT ABSOLUTE /end AXIS_DESCR
/end CHARACTERISTIC
/begin CHARACTERISTIC ExhMod_tDeltaExoTotHomCatHeatSustB1_M "total exothermy catalyst bricks homogenous catalyst heat sustain operation bank 1" MAP 0x8054B034 RB_Map_S16U16_U16 8191.875 temp_sw_q0p125 0.00 8191.875 FORMAT "%8.3"
 /begin AXIS_DESCR STD_AXIS Epm_nEng nmot_q0p5 11 -16384.00 16383.50 FORMAT "%8.2" DEPOSIT ABSOLUTE /end AXIS_DESCR
 /begin AXIS_DESCR STD_AXIS AirMod_ratChrgAirCyl Perc_q0p0234375_COMPU 11 0.00 1535.977 FORMAT "%8.3" DEPOSIT ABSOLUTE /end AXIS_DESCR
/end CHARACTERISTIC
/begin CHARACTERISTIC ExhMod_tDeltaExoTotHomCatHeatSustSecFuB1_M "Gesamte exotherme Temperaturerhöhung im Katalysator während Katheizen für warmhalten in Homogen-Betrieb mit alternativer Treibstoff Bank 1" MAP 0x8054B156 RB_Map_S16U16_U16 8191.875 temp_sw_q0p125 0.00 8191.875 FORMAT "%8.3"
 /begin AXIS_DESCR STD_AXIS Epm_nEng nmot_q0p5 11 -16384.00 16383.50 FORMAT "%8.2" DEPOSIT ABSOLUTE /end AXIS_DESCR
 /begin AXIS_DESCR STD_AXIS AirMod_ratChrgAirCyl Perc_q0p0234375_COMPU 11 0.00 1535.977 FORMAT "%8.3" DEPOSIT ABSOLUTE /end AXIS_DESCR
/end CHARACTERISTIC
/begin CHARACTERISTIC ExhMod_tDeltaExoTotHomSecFuB1_M "Gesamte exotherme Temperaturerhöhung im Katalysator in Homogen-Betrieb mit alternativer Treibstoff Bank 1" MAP 0x8054B278 RB_Map_S16U16_U16 8191.875 temp_sw_q0p125 0.00 8191.875 FORMAT "%8.3"
 /begin AXIS_DESCR STD_AXIS Epm_nEng nmot_q0p5 11 -16384.00 16383.50 FORMAT "%8.2" DEPOSIT ABSOLUTE /end AXIS_DESCR
 /begin AXIS_DESCR STD_AXIS AirMod_ratChrgAirCyl Perc_q0p0234375_COMPU 11 0.00 1535.977 FORMAT "%8.3" DEPOSIT ABSOLUTE /end AXIS_DESCR
/end CHARACTERISTIC
/begin CHARACTERISTIC ExhMod_tDeltaExoTotHspB1_M "total exothermy catalyst bricks hsp operation bank 1" MAP 0x8054B39A RB_Map_S16U16_U16 8191.875 temp_sw_q0p125 0.00 8191.875 FORMAT "%8.3"
 /begin AXIS_DESCR STD_AXIS Epm_nEng nmot_q0p5 11 -16384.00 16383.50 FORMAT "%8.2" DEPOSIT ABSOLUTE /end AXIS_DESCR
 /begin AXIS_DESCR STD_AXIS AirMod_ratChrgAirCyl Perc_q0p0234375_COMPU 11 0.00 1535.977 FORMAT "%8.3" DEPOSIT ABSOLUTE /end AXIS_DESCR
/end CHARACTERISTIC
/begin CHARACTERISTIC ExhMod_tDeltaExoTotHspCatHeatgB1_M "total exothermy catalyst bricks hsp cat heating operation bank 1" MAP 0x8054B4BC RB_Map_S16U16_U16 8191.875 temp_sw_q0p125 0.00 8191.875 FORMAT "%8.3"
 /begin AXIS_DESCR STD_AXIS Epm_nEng nmot_q0p5 11 -16384.00 16383.50 FORMAT "%8.2" DEPOSIT ABSOLUTE /end AXIS_DESCR
 /begin AXIS_DESCR STD_AXIS AirMod_ratChrgAirCyl Perc_q0p0234375_COMPU 11 0.00 1535.977 FORMAT "%8.3" DEPOSIT ABSOLUTE /end AXIS_DESCR
/end CHARACTERISTIC
/begin CHARACTERISTIC ExhMod_tDeltaExoTotHspCatHeatgSecFuB1_M "Gesamte exotherme Temperaturerhöhung im Katalysator während Katheizen für kalt motorstart in Homogen-split Betrieb mit alternativer Treibstoff Bank 1" MAP 0x8054B5DE RB_Map_S16U16_U16 8191.875 temp_sw_q0p125 0.00 8191.875 FORMAT "%8.3"
 /begin AXIS_DESCR STD_AXIS Epm_nEng nmot_q0p5 11 -16384.00 16383.50 FORMAT "%8.2" DEPOSIT ABSOLUTE /end AXIS_DESCR
 /begin AXIS_DESCR STD_AXIS AirMod_ratChrgAirCyl Perc_q0p0234375_COMPU 11 0.00 1535.977 FORMAT "%8.3" DEPOSIT ABSOLUTE /end AXIS_DESCR
/end CHARACTERISTIC
/begin CHARACTERISTIC ExhMod_tDeltaExoTotHspCatHeatSustB1_M "total exothermy catalyst bricks hsp cat heat sustain operation bank 1" MAP 0x8054B700 RB_Map_S16U16_U16 8191.875 temp_sw_q0p125 0.00 8191.875 FORMAT "%8.3"
 /begin AXIS_DESCR STD_AXIS Epm_nEng nmot_q0p5 11 -16384.00 16383.50 FORMAT "%8.2" DEPOSIT ABSOLUTE /end AXIS_DESCR
 /begin AXIS_DESCR STD_AXIS AirMod_ratChrgAirCyl Perc_q0p0234375_COMPU 11 0.00 1535.977 FORMAT "%8.3" DEPOSIT ABSOLUTE /end AXIS_DESCR
/end CHARACTERISTIC
/begin CHARACTERISTIC ExhMod_tDeltaExoTotHspCatHeatSustSecFuB1_M "Gesamte exotherme Temperaturerhöhung im Katalysator während Katheizen für warmhalten in Homogen-split Betrieb mit alternativer Treibstoff Bank 1" MAP 0x8054B822 RB_Map_S16U16_U16 8191.875 temp_sw_q0p125 0.00 8191.875 FORMAT "%8.3"
 /begin AXIS_DESCR STD_AXIS Epm_nEng nmot_q0p5 11 -16384.00 16383.50 FORMAT "%8.2" DEPOSIT ABSOLUTE /end AXIS_DESCR
 /begin AXIS_DESCR STD_AXIS AirMod_ratChrgAirCyl Perc_q0p0234375_COMPU 11 0.00 1535.977 FORMAT "%8.3" DEPOSIT ABSOLUTE /end AXIS_DESCR
/end CHARACTERISTIC
/begin CHARACTERISTIC ExhMod_tDeltaExoTotHspSecFuB1_M "Gesamte exotherme Temperaturerhöhung im Katalysator in Homogen-split Betrieb mit alternativer Treibstoff Bank 1" MAP 0x8054B944 RB_Map_S16U16_U16 8191.875 temp_sw_q0p125 0.00 8191.875 FORMAT "%8.3"
 /begin AXIS_DESCR STD_AXIS Epm_nEng nmot_q0p5 11 -16384.00 16383.50 FORMAT "%8.2" DEPOSIT ABSOLUTE /end AXIS_DESCR
 /begin AXIS_DESCR STD_AXIS AirMod_ratChrgAirCyl Perc_q0p0234375_COMPU 11 0.00 1535.977 FORMAT "%8.3" DEPOSIT ABSOLUTE /end AXIS_DESCR
/end CHARACTERISTIC
/begin CHARACTERISTIC ExhMod_tDeltaExoTranLtr_M "Exothermicity in catalyst bricks during lean-to-rich lambda transition" MAP 0x8054BA66 RB_Map_U16U16_S16 1535.977 temp_q0p0234 -768.0000 767.9766 FORMAT "%8.4"
 /begin AXIS_DESCR STD_AXIS NO_INPUT_QUANTITY m_uw_b6553p5 6 0.00 6553.500 FORMAT "%8.3" DEPOSIT ABSOLUTE /end AXIS_DESCR
 /begin AXIS_DESCR STD_AXIS NO_INPUT_QUANTITY fak_uw_b16 6 0.00 15.99976 FORMAT "%8.5" DEPOSIT ABSOLUTE /end AXIS_DESCR
/end CHARACTERISTIC
/begin CHARACTERISTIC ExhMod_tDeltaExoTranLtr_T "additional exothermy due to lean to rich transition" CURVE 0x8054BACC RB_Curve_R32_S16_Static 1535.977 temp_q0p0234 -768.0000 767.9766 FORMAT "%8.4"
 /begin AXIS_DESCR STD_AXIS ExhMod_mO2FillgPwrReactnB1 RBPtCel_m_1p0_5 6 0.000000 1.000000E+037 FORMAT "%14.6" EXTENDED_LIMITS -3.402823E+038 3.402823E+038 DEPOSIT ABSOLUTE /end AXIS_DESCR
/end CHARACTERISTIC
/begin CHARACTERISTIC ExhMod_tDeltaExoTranRtl_M "Exothermicity in catalyst bricks during rich-to-lean lambda transition" MAP 0x8054BAF4 RB_Map_U16U16_S16 1535.977 temp_q0p0234 -768.0000 767.9766 FORMAT "%8.4"
 /begin AXIS_DESCR STD_AXIS NO_INPUT_QUANTITY m_uw_b6553p5 6 0.00 6553.500 FORMAT "%8.3" DEPOSIT ABSOLUTE /end AXIS_DESCR
 /begin AXIS_DESCR STD_AXIS NO_INPUT_QUANTITY fak_uw_b16 6 0.00 15.99976 FORMAT "%8.5" DEPOSIT ABSOLUTE /end AXIS_DESCR
/end CHARACTERISTIC
/begin CHARACTERISTIC ExhMod_tEnvReplcmtVal_C "replacement value for the enviroment temperature" VALUE 0x8054CAB0 RB_Val_Wu16 1535.977 temp_q0p0234_o273 -273.150 1262.827 FORMAT "%8.3" /end CHARACTERISTIC
/begin CHARACTERISTIC ExhMod_tiConConcHcDeltaFco_T "massflow dependent time constant for the time filter of the additional HC mol flow while fuel cut off, bank 1" CURVE 0x8054C7CC RB_Curve_U16_U16 3276.750 t_q0p05 0.00 3276.750 FORMAT "%8.3"
 /begin AXIS_DESCR STD_AXIS NO_INPUT_QUANTITY m_uw_b6553p5 6 0.00 6553.500 FORMAT "%8.3" DEPOSIT ABSOLUTE /end AXIS_DESCR
/end CHARACTERISTIC
/begin CHARACTERISTIC ExhMod_tiConExoCco_T "time constant exothermy cylinder cut-off" CURVE 0x8054BB58 RB_Curve_U16_U16 3276.750 t_q0p05 0.00 3276.750 FORMAT "%8.3"
 /begin AXIS_DESCR STD_AXIS NO_INPUT_QUANTITY m_q0p1 4 0.00 6553.500 FORMAT "%8.3" DEPOSIT ABSOLUTE /end AXIS_DESCR
/end CHARACTERISTIC
/begin CHARACTERISTIC ExhMod_tiConExoEngOff_C "Time constant for heat flow calculation after engine-off" VALUE 0x8054BB6A RB_Val_Wu16 3276.750 t_q0p05 0.00 3276.750 FORMAT "%8.3" /end CHARACTERISTIC
/begin CHARACTERISTIC ExhMod_tiConExoFco_T "time constant exothermy fuel cut-off" CURVE 0x8054BB6C RB_Curve_U16_U16 3276.750 t_q0p05 0.00 3276.750 FORMAT "%8.3"
 /begin AXIS_DESCR STD_AXIS NO_INPUT_QUANTITY m_uw_b6553p5 4 0.00 6553.500 FORMAT "%8.3" DEPOSIT ABSOLUTE /end AXIS_DESCR
/end CHARACTERISTIC
/begin CHARACTERISTIC ExhMod_tiConExoNoFco_T "filter time constant (between fuel cut off) for exothermic because of fuel cut off" CURVE 0x8054BB7E RB_Curve_U16_U16 3276.750 t_q0p05 0.00 3276.750 FORMAT "%8.3"
 /begin AXIS_DESCR STD_AXIS NO_INPUT_QUANTITY m_uw_b6553p5 4 0.00 6553.500 FORMAT "%8.3" DEPOSIT ABSOLUTE /end AXIS_DESCR
/end CHARACTERISTIC
/begin CHARACTERISTIC ExhMod_tiConExoTranLtr_T "Time constant for filtering the exothermicity in catalyst after a lean-to-rich lambda transition bank 1" CURVE 0x8054BB90 RB_Curve_U16_U16 3276.750 t_q0p05 0.00 3276.750 FORMAT "%8.3"
 /begin AXIS_DESCR STD_AXIS NO_INPUT_QUANTITY m_uw_b6553p5 4 0.00 6553.500 FORMAT "%8.3" DEPOSIT ABSOLUTE /end AXIS_DESCR
/end CHARACTERISTIC
/begin CHARACTERISTIC ExhMod_tiConExoTranRtl_T "Time constant for filtering the exothermicity in catalyst after a rich-to-lean lambda transition" CURVE 0x8054BBA2 RB_Curve_U16_U16 3276.750 t_q0p05 0.00 3276.750 FORMAT "%8.3"
 /begin AXIS_DESCR STD_AXIS NO_INPUT_QUANTITY m_uw_b6553p5 4 0.00 6553.500 FORMAT "%8.3" DEPOSIT ABSOLUTE /end AXIS_DESCR
/end CHARACTERISTIC
/begin CHARACTERISTIC ExhMod_tiConLamAvrg_T "time constant lambda average" CURVE 0x8054BBB4 RB_Curve_U16_U16 3276.700 t_q0p05 0.050 3276.750 FORMAT "%8.3" EXTENDED_LIMITS 0.00 3276.750
 /begin AXIS_DESCR STD_AXIS NO_INPUT_QUANTITY m_q0p1 4 0.00 6553.500 FORMAT "%8.3" DEPOSIT ABSOLUTE /end AXIS_DESCR
/end CHARACTERISTIC
/begin CHARACTERISTIC ExhMod_tIgnDeltaCatAgi_M "Catalyst aging temperature delta for light off temperature of catalyst" MAP 0x8054BBC6 RB_Map_U16U16_S16 1535.977 temp_q0p0234 -768.0000 767.9766 FORMAT "%8.4"
 /begin AXIS_DESCR STD_AXIS NO_INPUT_QUANTITY fak_uw_b2 6 0.00 1.999969 FORMAT "%8.6" DEPOSIT ABSOLUTE /end AXIS_DESCR
 /begin AXIS_DESCR STD_AXIS NO_INPUT_QUANTITY dez 2 0.00 255.0000 FORMAT "%8.4" EXTENDED_LIMITS 0.00 65535.00 DEPOSIT ABSOLUTE /end AXIS_DESCR
/end CHARACTERISTIC
/begin CHARACTERISTIC ExhMod_tThdIgnCatB1_CA "temperature threshold ignition catalyst bank 1" VAL_BLK 0x8054BBF2 RB_ValA_Wu16 1535.977 temp_q0p0234_o273 -273.150 1262.827 FORMAT "%8.3" NUMBER 2 /end CHARACTERISTIC
/begin CHARACTERISTIC O2St_dmMaxThdMeasCat1_C "Maximum mass flow for OSC measurement catalyst 1" VALUE 0x805498D2 RB_Val_Wu16 6553.500 m_uw_b6553p5 0.00 6553.500 FORMAT "%8.3" /end CHARACTERISTIC
/begin CHARACTERISTIC O2St_dmMinThdMeasCat1_C "Minimum mass flow for OSC measurement catalyst 1" VALUE 0x805498D4 RB_Val_Wu16 6553.500 m_uw_b6553p5 0.00 6553.500 FORMAT "%8.3" /end CHARACTERISTIC
/begin CHARACTERISTIC O2St_facAgiAgedCat_C "Ageing factor catalyst" VALUE 0x805498D6 RB_Val_Wu8 1.000000 fak_ub_b2 0.00 1.000000 FORMAT "%8.6" EXTENDED_LIMITS 0.00 1.992188 /end CHARACTERISTIC
/begin CHARACTERISTIC O2St_facCorrnDlyLeanRichDsCat1_T "Table delay correction time for measurement of storage capability cat for sensor downstream catalyst 1 (transition lean-rich)" CURVE 0x805498D8 RB_Curve_U16_U16 655.3500 t_q0p01 0.00 655.3500 FORMAT "%8.4"
 /begin AXIS_DESCR STD_AXIS NO_INPUT_QUANTITY t_q0p01 4 0.00 655.3500 FORMAT "%8.4" DEPOSIT ABSOLUTE /end AXIS_DESCR
/end CHARACTERISTIC
/begin CHARACTERISTIC O2St_facCorrnDlyRichLeanDsCat1_T "Table delay correction time for measurement of storage capability cat for sensor downstream catalyst 1 (transition rich-lean)" CURVE 0x805498EA RB_Curve_U16_U16 655.3500 t_q0p01 0.00 655.3500 FORMAT "%8.4"
 /begin AXIS_DESCR STD_AXIS NO_INPUT_QUANTITY t_q0p01 4 0.00 655.3500 FORMAT "%8.4" DEPOSIT ABSOLUTE /end AXIS_DESCR
/end CHARACTERISTIC
/begin CHARACTERISTIC O2St_facCorrnMfLamCat1B1_M "Correction map for lambda and massflow dependence of OSC catalyst 1 bank 1" MAP 0x805498FC RB_Map_U16U16_U16 3.999939 fak_q6p1035Em5 0.00 3.999939 FORMAT "%8.6"
 /begin AXIS_DESCR STD_AXIS O2St_ratLamAvrgCat1B1 fak_q0p000244 8 0.00 15.99976 FORMAT "%8.5" DEPOSIT ABSOLUTE /end AXIS_DESCR
 /begin AXIS_DESCR STD_AXIS O2St_dmAvrgCurrMeasCat1B1 m_uw_b6553p5 8 0.00 6553.500 FORMAT "%8.3" DEPOSIT ABSOLUTE /end AXIS_DESCR
/end CHARACTERISTIC
/begin CHARACTERISTIC O2St_facCorrnMissSensDsCat2_T "OSC corection factor, in case of missing sensor downstream catalyst 2" CURVE 0x805499A0 RB_Curve_U8_U8 1.992188 fak_ub_b2 0.00 1.992188 FORMAT "%8.6"
 /begin AXIS_DESCR STD_AXIS NO_INPUT_QUANTITY fak_ub_b2 5 0.00 1.992188 FORMAT "%8.6" DEPOSIT ABSOLUTE /end AXIS_DESCR
/end CHARACTERISTIC
/begin CHARACTERISTIC O2St_facCorrnTranLeanRichDsCat1_T "Table correction time for measurement of storage capability cat for sensor downstream catalyst 1 (transition lean-rich)" CURVE 0x805499AC RB_Curve_U16_U16 655.3500 t_q0p01 0.00 655.3500 FORMAT "%8.4"
 /begin AXIS_DESCR STD_AXIS NO_INPUT_QUANTITY t_q0p01 4 0.00 655.3500 FORMAT "%8.4" DEPOSIT ABSOLUTE /end AXIS_DESCR
/end CHARACTERISTIC
/begin CHARACTERISTIC O2St_facCorrnTranRichLeanDsCat1_T "Table correction time for measurement of storage capability cat for sensor downstream catalyst 1 (transition rich-lean)" CURVE 0x805499BE RB_Curve_U16_U16 655.3500 t_q0p01 0.00 655.3500 FORMAT "%8.4"
 /begin AXIS_DESCR STD_AXIS NO_INPUT_QUANTITY t_q0p01 4 0.00 655.3500 FORMAT "%8.4" DEPOSIT ABSOLUTE /end AXIS_DESCR
/end CHARACTERISTIC
/begin CHARACTERISTIC O2St_facCorrO2StorgUCat1_T "OSC correction according to the sensor voltage downstream catalyst 1" CURVE 0x805499D0 RB_Curve_U16_U16 1.999969 fak_uw_b2 0.00 1.999969 FORMAT "%8.6"
 /begin AXIS_DESCR STD_AXIS NO_INPUT_QUANTITY spg_uw_q0p00488 8 0.00 319.9951 FORMAT "%8.4" DEPOSIT ABSOLUTE /end AXIS_DESCR
/end CHARACTERISTIC
/begin CHARACTERISTIC O2St_facIninOscCorrnCat1_C "Initial value of OSC correction factor of catalyst 1" VALUE 0x805499F2 RB_Val_Wu8 1.992188 fak_ub_b2 0.00 1.992188 FORMAT "%8.6" /end CHARACTERISTIC
/begin CHARACTERISTIC O2St_facIninOscCorrnCat2_C "Initial value of OSC correction factor of catalyst 2" VALUE 0x805499F3 RB_Val_Wu8 1.992188 fak_ub_b2 0.00 1.992188 FORMAT "%8.6" /end CHARACTERISTIC
/begin CHARACTERISTIC O2St_facMaxThdLamCtrl_C "upper threshold of lambda controller output for valid OSC calculation" VALUE 0x805499F4 RB_Val_Wu16 1.999969 fak_q3p0518Em5 0.00 1.999969 FORMAT "%8.6" /end CHARACTERISTIC
/begin CHARACTERISTIC O2St_facMinThdLamCtrl_C "lower threshold of lambda controller output for valid OSC calculation" VALUE 0x805499F6 RB_Val_Wu16 1.999969 fak_q3p0518Em5 0.00 1.999969 FORMAT "%8.6" /end CHARACTERISTIC
/begin CHARACTERISTIC O2St_facOscFilDiag_C "event filter constant for OSC correction factor during diagnosis of catalyst" VALUE 0x805499F8 RB_Val_Wu8 0.9961 fak_ub_b1 0.00 0.9961 /end CHARACTERISTIC
/begin CHARACTERISTIC O2St_facOscFilMax_C "maximum event filter constant for OSC correction factor" VALUE 0x805499F9 RB_Val_Wu8 0.9961 fak_ub_b1 0.00 0.9961 /end CHARACTERISTIC
/begin CHARACTERISTIC O2St_facOscFilMin_C "event filter constant for OSC correction factor" VALUE 0x805499FA RB_Val_Wu8 0.9961 fak_ub_b1 0.00 0.9961 /end CHARACTERISTIC
/begin CHARACTERISTIC O2St_facRoscOscCat1_T "Table conversion ROSC to OSC catalyst 1" CURVE 0x805499FC RB_Curve_R32_U16_Static 31.99951 fak_q4p883Em4 0.00 31.99951 FORMAT "%8.5"
 /begin AXIS_DESCR STD_AXIS NO_INPUT_QUANTITY RBPtCel_m_1p0_5 10 -1.00000000E+037 1.00000000E+037 FORMAT "%13.3" EXTENDED_LIMITS -3.40282347E+038 3.40282347E+038 DEPOSIT ABSOLUTE /end AXIS_DESCR
/end CHARACTERISTIC
/begin CHARACTERISTIC O2St_facRoscOscSecFuCat1_T "Characteristic curve calculation OSC from RSC for front catalyst for CNG or flex fuel" CURVE 0x80549A3C RB_Curve_R32_U16_Static 31.99951 fak_q4p883Em4 0.00 31.99951 FORMAT "%8.5"
 /begin AXIS_DESCR STD_AXIS NO_INPUT_QUANTITY RBPtCel_m_1p0_5 10 -1.00000000E+037 1.00000000E+037 FORMAT "%13.3" EXTENDED_LIMITS -3.40282347E+038 3.40282347E+038 DEPOSIT ABSOLUTE /end AXIS_DESCR
/end CHARACTERISTIC
/begin CHARACTERISTIC O2St_facTiCorrnSnsrAftCat_C "factor time threshold sensor dynamic correction for measurement of storage capability of catalyst plausible, sensor downstream catalyst" VALUE 0x80549A7C RB_Val_Wu8 0.9961 fak_ub_b1 0.00 0.9961 /end CHARACTERISTIC
/begin CHARACTERISTIC O2St_facTiCorrnSnsrBefCat_C "factor time threshold sensor dynamic correction for measurement of storage capability of catalyst plausible, sensor upstream catalyst" VALUE 0x80549A7D RB_Val_Wu8 0.9961 fak_ub_b1 0.00 0.9961 /end CHARACTERISTIC
/begin CHARACTERISTIC O2St_lenMlgO2Meas_C "Driving distance intermittent for stop prohibition due to measurement of OSC" VALUE 0x80549A80 RB_Val_Wu32 4294967295.00 s_q1_km 0.00 4294967295.00 FORMAT "%13.2" /end CHARACTERISTIC
/begin CHARACTERISTIC O2St_mfO2ThdStoi_C "Threashold oxygen mass flow richlean" VALUE 0x805498C4 RB_Val_Wr32 2.00000000E+037 mgrad_q1_mgdivs -1.00000000E+037 1.00000000E+037 FORMAT "%14.8" EXTENDED_LIMITS -3.40282347E+038 3.40282347E+038 /end CHARACTERISTIC
/begin CHARACTERISTIC O2St_mMaxThdMeasCat1_C "Maximum air mass threshold for favourable OSC measurement catalyst 1" VALUE 0x80549A84 RB_Val_Wu16 1820.417 m_q0p0277_g 0.00 1820.417 FORMAT "%8.3" /end CHARACTERISTIC
/begin CHARACTERISTIC O2St_mOscAgedCat1B1_M "Table oxygen storage capability of a aged catalyst 1 bank 1" MAP 0x80549A88 RB_Map_U16U16_R32 131072.000 RBPtCel_m_1p0_5 0.00 131072.000 FORMAT "%10.3" EXTENDED_LIMITS -3.40282347E+038 3.40282347E+038
 /begin AXIS_DESCR STD_AXIS NO_INPUT_QUANTITY temp_q0p0234_o273 8 -273.150 1262.827 FORMAT "%8.3" DEPOSIT ABSOLUTE /end AXIS_DESCR
 /begin AXIS_DESCR STD_AXIS NO_INPUT_QUANTITY m_q0p1 8 0.00 6553.500 FORMAT "%8.3" DEPOSIT ABSOLUTE /end AXIS_DESCR
/end CHARACTERISTIC
/begin CHARACTERISTIC O2St_mOscAgedCat2B1_M "Table oxygen storage capability of a aged catalyst 2 bank 1" MAP 0x80549BAC RB_Map_U16U16_R32 131072.000 RBPtCel_m_1p0_5 0.00 131072.000 FORMAT "%10.3" EXTENDED_LIMITS -3.40282347E+038 3.40282347E+038
 /begin AXIS_DESCR STD_AXIS NO_INPUT_QUANTITY temp_q0p0234_o273 8 -273.150 1262.827 FORMAT "%8.3" DEPOSIT ABSOLUTE /end AXIS_DESCR
 /begin AXIS_DESCR STD_AXIS NO_INPUT_QUANTITY m_uw_b6553p5 8 0.00 6553.500 FORMAT "%8.3" DEPOSIT ABSOLUTE /end AXIS_DESCR
/end CHARACTERISTIC
/begin CHARACTERISTIC O2St_mOscAgedSecFuCat1B1_M "Oxygen storage capacity aged front catalyst for CNG or flex fuel" MAP 0x80549CD0 RB_Map_U16U16_R32 131072.000 RBPtCel_m_1p0_5 0.00 131072.000 FORMAT "%10.3" EXTENDED_LIMITS -3.40282347E+038 3.40282347E+038
 /begin AXIS_DESCR STD_AXIS NO_INPUT_QUANTITY temp_q0p0234_o273 8 -273.150 1262.827 FORMAT "%8.3" DEPOSIT ABSOLUTE /end AXIS_DESCR
 /begin AXIS_DESCR STD_AXIS NO_INPUT_QUANTITY m_q0p1 8 0.00 6553.500 FORMAT "%8.3" DEPOSIT ABSOLUTE /end AXIS_DESCR
/end CHARACTERISTIC
/begin CHARACTERISTIC O2St_mOscNewCat1B1_M "Table oxygen storage capability of a new catalyst 1 bank 1" MAP 0x80549DF4 RB_Map_U16U16_R32 131072.000 RBPtCel_m_1p0_5 0.00 131072.000 FORMAT "%10.3" EXTENDED_LIMITS -3.40282347E+038 3.40282347E+038
 /begin AXIS_DESCR STD_AXIS NO_INPUT_QUANTITY temp_q0p0234_o273 8 -273.150 1262.827 FORMAT "%8.3" DEPOSIT ABSOLUTE /end AXIS_DESCR
 /begin AXIS_DESCR STD_AXIS NO_INPUT_QUANTITY m_uw_b6553p5 8 0.00 6553.500 FORMAT "%8.3" DEPOSIT ABSOLUTE /end AXIS_DESCR
/end CHARACTERISTIC
/begin CHARACTERISTIC O2St_mOscNewCat2B1_M "Table oxygen storage capability of a new catalyst 2 bank 1" MAP 0x80549F18 RB_Map_U16U16_R32 131072.000 RBPtCel_m_1p0_5 0.00 131072.000 FORMAT "%10.3" EXTENDED_LIMITS -3.40282347E+038 3.40282347E+038
 /begin AXIS_DESCR STD_AXIS NO_INPUT_QUANTITY temp_q0p0234_o273 8 -273.150 1262.827 FORMAT "%8.3" DEPOSIT ABSOLUTE /end AXIS_DESCR
 /begin AXIS_DESCR STD_AXIS NO_INPUT_QUANTITY m_uw_b6553p5 8 0.00 6553.500 FORMAT "%8.3" DEPOSIT ABSOLUTE /end AXIS_DESCR
/end CHARACTERISTIC
/begin CHARACTERISTIC O2St_mOscNewSecFuCat1B1_M "Characteristic map OSC of a new front catalyst for CNG or flex fuel" MAP 0x8054A03C RB_Map_U16U16_R32 131072.000 RBPtCel_m_1p0_5 0.00 131072.000 FORMAT "%10.3" EXTENDED_LIMITS -3.40282347E+038 3.40282347E+038
 /begin AXIS_DESCR STD_AXIS NO_INPUT_QUANTITY temp_q0p0234_o273 8 -273.150 1262.827 FORMAT "%8.3" DEPOSIT ABSOLUTE /end AXIS_DESCR
 /begin AXIS_DESCR STD_AXIS NO_INPUT_QUANTITY m_uw_b6553p5 8 0.00 6553.500 FORMAT "%8.3" DEPOSIT ABSOLUTE /end AXIS_DESCR
/end CHARACTERISTIC
/begin CHARACTERISTIC O2St_SpareRatO2StrCat1_C "spare value for OSC correction factor catalyst 1" VALUE 0x8054A160 RB_Val_Wu8 1.992188 fak_ub_b2 0.00 1.992188 FORMAT "%8.6" /end CHARACTERISTIC
/begin CHARACTERISTIC O2St_stApplMod_C "code word application mode for reset of ageing factor" VALUE 0x8054A161 RB_Val_Wu8 255.0 dez 0.00 255.0 FORMAT "%5.1" /end CHARACTERISTIC
/begin CHARACTERISTIC O2St_stEngStopPhd_C "code word for control of stop prohibition request, caused by OSC measurement" VALUE 0x8054A162 RB_Val_Wu8 255.0 dez 0.00 255.0 FORMAT "%5.1" /end CHARACTERISTIC
/begin CHARACTERISTIC O2St_stOscCatDiag_C "Code word modelling of oxygen storage capacity dependency on catalyst diagnosis" VALUE 0x8054A163 RB_Val_Wu8 255.0 dez 0.00 255.0 FORMAT "%5.1" /end CHARACTERISTIC
/begin CHARACTERISTIC O2St_stOscMeas_C "code word for options of OSC measurement in FC ExhMod_LamMdl" VALUE 0x8054A164 RB_Val_Wu8 255.0 dez 0.00 255.0 FORMAT "%5.1" /end CHARACTERISTIC
/begin CHARACTERISTIC O2St_stOscRosc_C "code word calculation OSC-ROSC" VALUE 0x8054A165 RB_Val_Wu8 255.0 dez 0.00 255.0 FORMAT "%5.1" /end CHARACTERISTIC
/begin CHARACTERISTIC O2St_tDeltaMaxMeasCat1_C "Maximum temperature difference between start and end of the measurement of OSC catalyst 1" VALUE 0x8054A166 RB_Val_Wu16 1535.977 temp_q0p0234 0.00 1535.977 FORMAT "%8.3" /end CHARACTERISTIC
/begin CHARACTERISTIC O2St_tiConMFlowEna_C "time constant for mass flow for enable condition" VALUE 0x805498CE RB_Val_Wu16 1310.680 t_q0p02 0.020 1310.700 FORMAT "%8.3" EXTENDED_LIMITS 0.00 1310.700 /end CHARACTERISTIC
/begin CHARACTERISTIC O2St_tiDlyEnagOscCat1_C "time delay enabling OSC measurement after temperature condition catalyst 1" VALUE 0x8054A168 RB_Val_Wu16 1310.700 t_q0p02 0.00 1310.700 FORMAT "%8.3" /end CHARACTERISTIC
/begin CHARACTERISTIC O2St_tiDlyMaxS1_C "maximal deadtime senor 1 for OSC calculation" VALUE 0x8054A16A RB_Val_Wu16 655.3500 t_q0p01 0.00 655.3500 FORMAT "%8.4" /end CHARACTERISTIC
/begin CHARACTERISTIC O2St_tiMaxMeasOscCat1_C "Maximum measurement time for OSC catalyst 1" VALUE 0x8054A16C RB_Val_Wu16 1310.700 t_q0p02 0.00 1310.700 FORMAT "%8.3" /end CHARACTERISTIC
/begin CHARACTERISTIC O2St_tiThdStrtMeas_C "Time threshold after start-end, after that a OSC-ROSC measurement is possible" VALUE 0x8054A16E RB_Val_Wu16 6553.500 t100msxs_uw_b6553p5 0.00 6553.500 FORMAT "%8.3" /end CHARACTERISTIC
/begin CHARACTERISTIC O2St_tiTranDecelCat1_C "Delay time rich-lean or lean-rich transition of catalyst 1" VALUE 0x8054A170 RB_Val_Wu16 1310.680 t_q0p02 0.020 1310.700 FORMAT "%8.3" EXTENDED_LIMITS 0.00 1310.700 /end CHARACTERISTIC
/begin CHARACTERISTIC O2St_tiTranDecelMeas_C "Deceleration time for allowed lambda=1 transition during measurement" VALUE 0x8054A172 RB_Val_Wu16 1310.700 t_q0p02 0.00 1310.700 FORMAT "%8.3" /end CHARACTERISTIC
/begin CHARACTERISTIC O2St_tiTranMaxS1_C "maximal time constant sensor 1 for OSC calculation" VALUE 0x8054A174 RB_Val_Wu16 655.3500 t_q0p01 0.00 655.3500 FORMAT "%8.4" /end CHARACTERISTIC
/begin CHARACTERISTIC O2St_tMaxThdMeasCat1_C "Maximum catalyst temperature for OSC measurement catalyst 1" VALUE 0x8054A176 RB_Val_Wu16 1535.977 temp_q0p0234_o273 -273.150 1262.827 FORMAT "%8.3" /end CHARACTERISTIC
/begin CHARACTERISTIC O2St_tMaxThdMeasHysCat1_C "Maximum threshold of switch-on hysteresis of OSC measurement catalyst 1" VALUE 0x8054A178 RB_Val_Wu16 1535.977 temp_q0p0234_o273 -273.150 1262.827 FORMAT "%8.3" /end CHARACTERISTIC
/begin CHARACTERISTIC O2St_tMinThdMeasCat1_C "Minimum catalyst temperature for OSC measurement catalyst 1" VALUE 0x8054A17A RB_Val_Wu16 1535.977 temp_q0p0234_o273 -273.150 1262.827 FORMAT "%8.3" /end CHARACTERISTIC
/begin CHARACTERISTIC O2St_tMinThdMeasHysCat1_C "Minimum threshold of switch-on hysteresis of OSC measurement catalyst 1" VALUE 0x8054A17C RB_Val_Wu16 1535.977 temp_q0p0234_o273 -273.150 1262.827 FORMAT "%8.3" /end CHARACTERISTIC
/begin CHARACTERISTIC O2St_uDeltaDecMaxSensHi_C "Threshold maximal decrease of post-cat voltage for detection of empty catalyst" VALUE 0x805498C8 RB_Val_Ws16 319.9951 spg_q0p00488 -160.0000 159.9951 FORMAT "%8.4" /end CHARACTERISTIC
/begin CHARACTERISTIC O2St_uDeltaDecMax_C "Threshold maximal decrease of post-cat voltage for detection of empty catalyst" VALUE 0x805498CA RB_Val_Ws16 319.9951 spg_q0p00488 -160.0000 159.9951 FORMAT "%8.4" /end CHARACTERISTIC
/begin CHARACTERISTIC O2St_uDeltaIncMin_C "Increase of post-cat voltage required for the detection of an empty catalyst" VALUE 0x805498CC RB_Val_Ws16 319.9951 spg_q0p00488 -160.0000 159.9951 FORMAT "%8.4" /end CHARACTERISTIC
/begin CHARACTERISTIC O2St_uThdCat1DsO2EmptyB1_C "Voltage threshold exhaust rich downstream catalyst 1 bank 1" VALUE 0x8054A17E RB_Val_Wu16 319.9951 spg_uw_q0p00488 0.00 319.9951 FORMAT "%8.4" /end CHARACTERISTIC
/begin CHARACTERISTIC O2St_uThdCat1DsO2FullB1_C "Voltage threshold exhaust lean downstream catalyst 1 bank 1" VALUE 0x8054A180 RB_Val_Wu16 319.9951 spg_uw_q0p00488 0.00 319.9951 FORMAT "%8.4" /end CHARACTERISTIC
/begin MEASUREMENT ExhMod_cnvnMolfMFrctB1_I.concMCo2Vlv "class instance for conversion of mole fraction to mass fraction for gasoline bank 1 / Mass fraction of CO2 at exhaust valve" UWORD fak_uw_b0p5 1 100 0.00 0.4999924 FORMAT "%9.7" ECU_ADDRESS 0x600076EE /end MEASUREMENT
/begin MEASUREMENT ExhMod_cnvnMolfMFrctB1_I.concMCoVlv "class instance for conversion of mole fraction to mass fraction for gasoline bank 1 / Mass fraction of CO at exhaust valve" UWORD fak_uw_b0p5 1 100 0.00 0.4999924 FORMAT "%9.7" ECU_ADDRESS 0x600076F0 /end MEASUREMENT
/begin MEASUREMENT ExhMod_cnvnMolfMFrctB1_I.concMH2Vlv "class instance for conversion of mole fraction to mass fraction for gasoline bank 1 / Mass fraction of H2 at exhaust valve" UWORD fak_uw_b0p5 1 100 0.00 0.4999924 FORMAT "%9.7" ECU_ADDRESS 0x600076F2 /end MEASUREMENT
/begin MEASUREMENT ExhMod_cnvnMolfMFrctB1_I.concMH2oVlv "class instance for conversion of mole fraction to mass fraction for gasoline bank 1 / Mass fraction of H2O at exhaust valve" UWORD fak_uw_b0p5 1 100 0.00 0.4999924 FORMAT "%9.7" ECU_ADDRESS 0x600076F4 /end MEASUREMENT
/begin MEASUREMENT ExhMod_cnvnMolfMFrctB1_I.concMHcVlv "class instance for conversion of mole fraction to mass fraction for gasoline bank 1 / Mass fraction of fuel at exhaust valve" UWORD fak_uw_b0p5 1 100 0.00 0.4999924 FORMAT "%9.7" ECU_ADDRESS 0x600076F6 /end MEASUREMENT
/begin MEASUREMENT ExhMod_cnvnMolfMFrctB1_I.concMNoVlv "class instance for conversion of mole fraction to mass fraction for gasoline bank 1 / Mass fraction of NO at exhaust valve" UWORD fak_uw_b0p5 1 100 0.00 0.4999924 FORMAT "%9.7" ECU_ADDRESS 0x600076F8 /end MEASUREMENT
/begin MEASUREMENT ExhMod_cnvnMolfMFrctB1_I.concMO2Vlv "class instance for conversion of mole fraction to mass fraction for gasoline bank 1 / Mass fraction of O2 at exhaust valve" UWORD fak_uw_b0p5 1 100 0.00 0.4999924 FORMAT "%9.7" ECU_ADDRESS 0x600076FA /end MEASUREMENT
/begin MEASUREMENT ExhMod_cnvnMolfMFrctSecFuB1_I.concMCo2Vlv "class instance for conversion of mole fraction to mass fraction for secondary fule bank 1 / Mass fraction of CO2 at exhaust valve" UWORD fak_uw_b0p5 1 100 0.00 0.4999924 FORMAT "%9.7" ECU_ADDRESS 0x600076E0 /end MEASUREMENT
/begin MEASUREMENT ExhMod_cnvnMolfMFrctSecFuB1_I.concMCoVlv "class instance for conversion of mole fraction to mass fraction for secondary fule bank 1 / Mass fraction of CO at exhaust valve" UWORD fak_uw_b0p5 1 100 0.00 0.4999924 FORMAT "%9.7" ECU_ADDRESS 0x600076E2 /end MEASUREMENT
/begin MEASUREMENT ExhMod_cnvnMolfMFrctSecFuB1_I.concMH2Vlv "class instance for conversion of mole fraction to mass fraction for secondary fule bank 1 / Mass fraction of H2 at exhaust valve" UWORD fak_uw_b0p5 1 100 0.00 0.4999924 FORMAT "%9.7" ECU_ADDRESS 0x600076E4 /end MEASUREMENT
/begin MEASUREMENT ExhMod_cnvnMolfMFrctSecFuB1_I.concMH2oVlv "class instance for conversion of mole fraction to mass fraction for secondary fule bank 1 / Mass fraction of H2O at exhaust valve" UWORD fak_uw_b0p5 1 100 0.00 0.4999924 FORMAT "%9.7" ECU_ADDRESS 0x600076E6 /end MEASUREMENT
/begin MEASUREMENT ExhMod_cnvnMolfMFrctSecFuB1_I.concMHcVlv "class instance for conversion of mole fraction to mass fraction for secondary fule bank 1 / Mass fraction of fuel at exhaust valve" UWORD fak_uw_b0p5 1 100 0.00 0.4999924 FORMAT "%9.7" ECU_ADDRESS 0x600076E8 /end MEASUREMENT
/begin MEASUREMENT ExhMod_cnvnMolfMFrctSecFuB1_I.concMNoVlv "class instance for conversion of mole fraction to mass fraction for secondary fule bank 1 / Mass fraction of NO at exhaust valve" UWORD fak_uw_b0p5 1 100 0.00 0.4999924 FORMAT "%9.7" ECU_ADDRESS 0x600076EA /end MEASUREMENT
/begin MEASUREMENT ExhMod_cnvnMolfMFrctSecFuB1_I.concMO2Vlv "class instance for conversion of mole fraction to mass fraction for secondary fule bank 1 / Mass fraction of O2 at exhaust valve" UWORD fak_uw_b0p5 1 100 0.00 0.4999924 FORMAT "%9.7" ECU_ADDRESS 0x600076EC /end MEASUREMENT
/begin MEASUREMENT ExhMod_coeffPDiffCatTB1Ary "Output array haracteristic map temperature-dep. factor in pressure gradient catalysts" UWORD fak_uw_b64 1 100 0.00 63.99902 FORMAT "%8.5" ARRAY_SIZE 2 ECU_ADDRESS 0x6000778C /end MEASUREMENT
/begin MEASUREMENT ExhMod_concMH2oVlvB1 "concentration of water at outlet valve of bank 1" UWORD fak_uw_b0p5 1 100 0.00 0.4999924 FORMAT "%9.7" ECU_ADDRESS 0x60008F38 /end MEASUREMENT
/begin MEASUREMENT ExhMod_concMHcVlvB1 "concentration of hydrocarbon at outlet valve of bank 1" UWORD fak_uw_b0p5 1 100 0.00 0.4999924 FORMAT "%9.7" ECU_ADDRESS 0x60008F36 /end MEASUREMENT
/begin MEASUREMENT ExhMod_concMO2VlvB1 "concentration of oxygen at outlet valve of bank 1" UWORD fak_uw_b0p5 1 100 0.00 0.4999924 FORMAT "%9.7" ECU_ADDRESS 0x60008F34 /end MEASUREMENT
/begin MEASUREMENT ExhMod_effIgnAgAvrgB1Loc "Overall average efficiency depending on ignition angle bank1" UBYTE rel_ub_b127p5 1 100 0.00 127.5 FORMAT "%5.1" ECU_ADDRESS 0x6000B8F9 /end MEASUREMENT
/begin MEASUREMENT ExhMod_egyExoCatB1 "Heat energy in catalyst due to exhothermic reactions bank 1" FLOAT32_IEEE HtFlw_Fl 1 100 0.00 5000000.000 FORMAT "%11.3" ARRAY_SIZE 6 ECU_ADDRESS 0x50001828 /end MEASUREMENT
/begin MEASUREMENT ExhMod_facExoCorrnIgnAgHomB1 "Zündwinkelkorrektur für die exotherme Temperaturerhöhung im Katalysator für Homogenbetrieb Bank 1" UBYTE fak_ub_b2 1 100 0.00 1.992188 FORMAT "%8.6" ECU_ADDRESS 0x6000B8F8 /end MEASUREMENT
/begin MEASUREMENT ExhMod_facExoCorrnIgnAgHomSecFuB1 "Zündwinkelkorrektur für die exotherme Temperaturerhöhung im Katalysator in Homogenbetrieb mit alternativerTreibstoff Bank 1" UBYTE fak_ub_b2 1 100 0.00 1.992188 FORMAT "%8.6" ECU_ADDRESS 0x6000B8F7 /end MEASUREMENT
/begin MEASUREMENT ExhMod_facExoCorrnIgnAgHspB1 "Zündwinkelkorrektur für die exotherme Temperaturerhöhung im Katalysator für Homogen- split Betrieb Bank 1" UBYTE fak_ub_b2 1 100 0.00 1.992188 FORMAT "%8.6" ECU_ADDRESS 0x6000B8F6 /end MEASUREMENT
/begin MEASUREMENT ExhMod_facExoCorrnIgnAgHspSecFuB1 "Zündwinkelkorrektur für die exotherme Temperaturerhöhung im Katalysator in Homogen-split Betrieb mit alternativerTreibstoff Bank 1" UBYTE fak_ub_b2 1 100 0.00 1.992188 FORMAT "%8.6" ECU_ADDRESS 0x6000B8F5 /end MEASUREMENT
/begin MEASUREMENT ExhMod_facExoCorrnLamB1 "lambda correction exothermal temperature increase in catalyst bank 1" UBYTE fak_ub_b2 1 100 0.00 1.992188 FORMAT "%8.6" ECU_ADDRESS 0x6000B8F4 /end MEASUREMENT
/begin MEASUREMENT ExhMod_facExoFcoB1 "filtered correction factor exothermy during fuel cut off bank 1" UWORD fak_uw_b2 1 100 0.00 1.999969 FORMAT "%8.6" ECU_ADDRESS 0x60007782 /end MEASUREMENT
/begin MEASUREMENT ExhMod_facIntrpnTEnvTEngB1 "factor for interpolation between the measured ambient temperature and the engine temperature, bank 1" UBYTE fak_ub_b1 1 100 0.00 0.9961 ARRAY_SIZE 12 ECU_ADDRESS 0x6000B8E7 /end MEASUREMENT
/begin MEASUREMENT ExhMod_facIntrpnTEnvTWallB1 "Interpolation factor between environment temperature and wall temperature bank 1" UBYTE fak_ub_b1 1 100 0.00 0.9961 ARRAY_SIZE 12 ECU_ADDRESS 0x6000B8DB /end MEASUREMENT
/begin MEASUREMENT ExhMod_facWghtMnfldCatExoLamCcoB1 "weighting factor manifold catalyst exothermy cylinder cut-off depending on lambda bank 1" UBYTE fak_ub_b2 1 100 0.00 1.000000 FORMAT "%8.6" ECU_ADDRESS 0x6000B8F3 /end MEASUREMENT
/begin MEASUREMENT ExhMod_FlexfuCalcn.concMCo2VlvIntrpn "Class for exhaust gas emissiong modelling for flex fuel system / Mass fraction of CO2 at exhaust valve after the interpolation for flex fuel calculation" UWORD fak_uw_b0p5 1 100 0.00 0.4999924 FORMAT "%9.7" ECU_ADDRESS 0x600076FC /end MEASUREMENT
/begin MEASUREMENT ExhMod_FlexfuCalcn.concMCoVlvIntrpn "Class for exhaust gas emissiong modelling for flex fuel system / Mass fraction of CO at exhaust valve after the interpolation for flex fuel calculation" UWORD fak_uw_b0p5 1 100 0.00 0.4999924 FORMAT "%9.7" ECU_ADDRESS 0x600076FE /end MEASUREMENT
/begin MEASUREMENT ExhMod_FlexfuCalcn.concMH2VlvIntrpn "Class for exhaust gas emissiong modelling for flex fuel system / Mass fraction of H2 at exhaust valve after the interpolation for flex fuel calculation" UWORD fak_uw_b0p5 1 100 0.00 0.4999924 FORMAT "%9.7" ECU_ADDRESS 0x60007700 /end MEASUREMENT
/begin MEASUREMENT ExhMod_FlexfuCalcn.concMH2oVlvIntrpn "Class for exhaust gas emissiong modelling for flex fuel system / Mass fraction of H2O at exhaust valve after the interpolation for flex fuel calculation" UWORD fak_uw_b0p5 1 100 0.00 0.4999924 FORMAT "%9.7" ECU_ADDRESS 0x60007702 /end MEASUREMENT
/begin MEASUREMENT ExhMod_FlexfuCalcn.concMHcVlvIntrpn "Class for exhaust gas emissiong modelling for flex fuel system / Mass fraction of fuel at exhaust valve after the interpolation for flex fuel calculation" UWORD fak_uw_b0p5 1 100 0.00 0.4999924 FORMAT "%9.7" ECU_ADDRESS 0x60007704 /end MEASUREMENT
/begin MEASUREMENT ExhMod_FlexfuCalcn.concMNoVlvIntrpn "Class for exhaust gas emissiong modelling for flex fuel system / Mass fraction of NO at exhaust valve after the interpolation for flex fuel calculation" UWORD fak_uw_b0p5 1 100 0.00 0.4999924 FORMAT "%9.7" ECU_ADDRESS 0x60007706 /end MEASUREMENT
/begin MEASUREMENT ExhMod_FlexfuCalcn.concMO2VlvIntrpn "Class for exhaust gas emissiong modelling for flex fuel system / Mass fraction of O2 at exhaust valve after the interpolation for flex fuel calculation" UWORD fak_uw_b0p5 1 100 0.00 0.4999924 FORMAT "%9.7" ECU_ADDRESS 0x60007708 /end MEASUREMENT
/begin MEASUREMENT ExhMod_flgEmptyO2Cat1B1 "Flag catalyst 1 bank 1 is exhausted of oxygen" UBYTE B_TRUE 1 100 0.00 1.00000000000 BIT_MASK 0x1 FORMAT "%13.11" ECU_ADDRESS 0x70000959 /end MEASUREMENT
/begin MEASUREMENT ExhMod_flgEndMeasCat1B1ER_I.buffer "Flag end of measurement storage capability catalyst 1 bank 1 / rising edge detected" UBYTE B_TRUE 1 100 0.00 1.00000000000 BIT_MASK 0x1 FORMAT "%13.11" ECU_ADDRESS 0x6000779C /end MEASUREMENT
/begin MEASUREMENT ExhMod_flgEndMeasCat1B1ER_I.oldSignal "Flag end of measurement storage capability catalyst 1 bank 1 / flag rising edge" UBYTE B_TRUE 1 100 0.00 1.00000000000 BIT_MASK 0x1 FORMAT "%13.11" ECU_ADDRESS 0x6000779D /end MEASUREMENT
/begin MEASUREMENT ExhMod_flgEngStopPhdO2Str "Stop prphibition request because of oxygen storage measurement" UBYTE B_TRUE 1 100 0.00 1.00000000000 BIT_MASK 0x1 FORMAT "%13.11" ECU_ADDRESS 0x70000957 /end MEASUREMENT
/begin MEASUREMENT ExhMod_flgFullO2Cat1B1 "Flag catalyst 1 bank 1 is filled with oxygen" UBYTE B_TRUE 1 100 0.00 1.00000000000 BIT_MASK 0x1 FORMAT "%13.11" ECU_ADDRESS 0x70000954 /end MEASUREMENT
/begin MEASUREMENT ExhMod_flgInhbnCat1B1 "Inhibit calculation catalyst 1 Bank 1" UBYTE B_TRUE 1 100 0.00 1.00000000000 BIT_MASK 0x1 FORMAT "%13.11" ECU_ADDRESS 0x70000951 /end MEASUREMENT
/begin MEASUREMENT ExhMod_flgInhbnCat2B1 "inhibition of calculation catalyst 2 bank 1" UBYTE B_TRUE 1 100 0.00 1.00000000000 BIT_MASK 0x1 FORMAT "%13.11" ECU_ADDRESS 0x70000950 /end MEASUREMENT
/begin MEASUREMENT ExhMod_flgInpMfLeanCat1B1 "Flag input mass flow lean catalyst 1 bank 1" UBYTE B_TRUE 1 100 0.00 1.00000000000 BIT_MASK 0x1 FORMAT "%13.11" ECU_ADDRESS 0x7000094F /end MEASUREMENT
/begin MEASUREMENT ExhMod_flgInpMfRichCat1B1 "Flag input mass flow rich catalyst 1 bank 1" UBYTE B_TRUE 1 100 0.00 1.00000000000 BIT_MASK 0x1 FORMAT "%13.11" ECU_ADDRESS 0x7000094E /end MEASUREMENT
/begin MEASUREMENT ExhMod_flgLamLeanB1 "lambda ratio greater than threshold for exothermicity calculation, bank 1" UBYTE B_TRUE 1 100 0.00 1.00000000000 BIT_MASK 0x1 FORMAT "%13.11" ECU_ADDRESS 0x70000267 /end MEASUREMENT
/begin MEASUREMENT ExhMod_flgLamRichB1 "lambda ratio lower than threshold for exothermy calculation, bank 1" UBYTE B_TRUE 1 100 0.00 1.00000000000 BIT_MASK 0x1 FORMAT "%13.11" ECU_ADDRESS 0x70000266 /end MEASUREMENT
/begin MEASUREMENT ExhMod_flgO2MeasRdyCat1B1 "Flag readiness for oxygen storage capacity measurement catalyst 1 bank 1" UBYTE B_TRUE 1 100 0.00 1.00000000000 BIT_MASK 0x1 FORMAT "%13.11" ECU_ADDRESS 0x70000947 /end MEASUREMENT
/begin MEASUREMENT ExhMod_flgOscMeasdCat1B1 "Flag current oxygen storage capability measured catalyst 1 bank 1" UBYTE B_TRUE 1 100 0.00 1.00000000000 BIT_MASK 0x1 FORMAT "%13.11" ECU_ADDRESS 0x70000946 /end MEASUREMENT
/begin MEASUREMENT ExhMod_flgPasOSCMeasmt "condition of passive measurement of oxygen storage capacity bank 1" UBYTE B_TRUE 1 100 0.00 1.00000000000 BIT_MASK 0x1 FORMAT "%13.11" ECU_ADDRESS 0x6000B90F /end MEASUREMENT
/begin MEASUREMENT ExhMod_flgRoscMeasdCat1B1 "Flag current oxygen storage capability measured catalyst 1 bank 1" UBYTE B_TRUE 1 100 0.00 1.00000000000 BIT_MASK 0x1 FORMAT "%13.11" ECU_ADDRESS 0x70000945 /end MEASUREMENT
/begin MEASUREMENT ExhMod_flgStrtMeasCat1B1ER_I.buffer "Flag start of measurement storage capability catalyst 1 bank 1 / rising edge detected" UBYTE B_TRUE 1 100 0.00 1.00000000000 BIT_MASK 0x1 FORMAT "%13.11" ECU_ADDRESS 0x6000779A /end MEASUREMENT
/begin MEASUREMENT ExhMod_flgStrtMeasCat1B1ER_I.oldSignal "Flag start of measurement storage capability catalyst 1 bank 1 / flag rising edge" UBYTE B_TRUE 1 100 0.00 1.00000000000 BIT_MASK 0x1 FORMAT "%13.11" ECU_ADDRESS 0x6000779B /end MEASUREMENT
/begin MEASUREMENT ExhMod_flgSucOscMeasmtCat1B1 "Flag successful storage capability measurement catalyst 1 bank 1" UBYTE B_TRUE 1 100 0.00 1.00000000000 BIT_MASK 0x1 FORMAT "%13.11" ECU_ADDRESS 0x6000F971 /end MEASUREMENT
/begin MEASUREMENT ExhMod_flgVldyEnvT "Flag environment temperature validity" UBYTE B_TRUE 1 100 0.00 1.00000000000 BIT_MASK 0x1 FORMAT "%13.11" ECU_ADDRESS 0x6000B8DA /end MEASUREMENT
/begin MEASUREMENT ExhMod_mfExoB1 "Massflow respecitve to exothermy" FLOAT32_IEEE AirMassPerTime_float 1 100 0.00 50000.0000 FORMAT "%10.4" ECU_ADDRESS 0x600029DC /end MEASUREMENT
/begin MEASUREMENT ExhMod_mO2FillgPwrReactnB1 "oxygen masse lean to rich transition in function PwrReactnMapBasd bank 1" FLOAT32_IEEE RBPtCel_m_1p0_5 1 100 0.000000 1.000000E+037 FORMAT "%14.6" ECU_ADDRESS 0x600029D8 /end MEASUREMENT
/begin MEASUREMENT ExhMod_mO2IntglCat1B1 "Oxygen integral for oxygen storage capacity measurement catalyst 1 bank 1" SLONG m_q0p1_mg 1 100 -214748364.800 214748364.700 FORMAT "%13.3" ECU_ADDRESS 0x60013B0C /end MEASUREMENT
/begin MEASUREMENT ExhMod_mO2StrAgedCat1B1 "Oxygen storage capability (aged catalyst) catalyst 1 bank 1" UWORD m_q0p1_mg 1 100 0.00 6553.500 FORMAT "%8.3" ECU_ADDRESS 0x60014894 /end MEASUREMENT
/begin MEASUREMENT ExhMod_mO2StrAgedCat2B1 "Oxygen storage capability (aged catalyst) catalyst 2 bank 1" UWORD m_q0p1_mg 1 100 0.00 6553.500 FORMAT "%8.3" ECU_ADDRESS 0x60014896 /end MEASUREMENT
/begin MEASUREMENT ExhMod_mO2StrAgedExtdCat1B1 "Oxygen storage capability (aged catalyst) catalyst 1 bank 1" ULONG m_q0p1_mg 1 100 0.00 131072.000000 FORMAT "%13.6" ECU_ADDRESS 0x50004F2C /end MEASUREMENT
/begin MEASUREMENT ExhMod_mO2StrAgedExtdCat2B1 "Oxygen storage capability (aged catalyst) catalyst 2 bank 1" ULONG m_q0p1_mg 1 100 0.00 131072.000000 FORMAT "%13.6" ECU_ADDRESS 0x60013B10 /end MEASUREMENT
/begin MEASUREMENT ExhMod_mO2StrCat1B1 "Oxygen storage capacity calculated catalyst 1" UWORD m_q0p1_mg 1 100 0.00 6553.500 FORMAT "%8.3" ECU_ADDRESS 0x60014898 /end MEASUREMENT
/begin MEASUREMENT ExhMod_mO2StrCat2B1 "Oxygen storage capacity calculated catalyst 2" UWORD m_q0p1_mg 1 100 0.00 6553.500 FORMAT "%8.3" ECU_ADDRESS 0x6000948A /end MEASUREMENT
/begin MEASUREMENT ExhMod_mO2StrExtdCat1B1 "Oxygen storage capacity calculated catalyst 1" ULONG m_q0p1_mg 1 100 0.00 131072.000000 FORMAT "%13.6" ECU_ADDRESS 0x60003904 /end MEASUREMENT
/begin MEASUREMENT ExhMod_mO2StrExtdCat2B1 "Oxygen storage capacity calculated catalyst 2" ULONG m_q0p1_mg 1 100 0.00 131072.000000 FORMAT "%13.6" ECU_ADDRESS 0x50004F30 /end MEASUREMENT
/begin MEASUREMENT ExhMod_mO2StrNewCat1B1 "Oxygen storage capacity of a new catalyst 1" UWORD m_q0p1_mg 1 100 0.00 6553.500 FORMAT "%8.3" ECU_ADDRESS 0x6001489A /end MEASUREMENT
/begin MEASUREMENT ExhMod_mO2StrNewCat2B1 "Oxygen storage capacity of a new catalyst 2" UWORD m_q0p1_mg 1 100 0.00 6553.500 FORMAT "%8.3" ECU_ADDRESS 0x6001489C /end MEASUREMENT
/begin MEASUREMENT ExhMod_mO2StrNewExtdCat1B1 "Oxygen storage capacity of a new catalyst 1" ULONG m_q0p1_mg 1 100 0.00 131072.000000 FORMAT "%13.6" ECU_ADDRESS 0x50004F38 /end MEASUREMENT
/begin MEASUREMENT ExhMod_mO2StrNewExtdCat2B1 "Oxygen storage capacity of a new catalyst 2" ULONG m_q0p1_mg 1 100 0.00 131072.000000 FORMAT "%13.6" ECU_ADDRESS 0x50004F3C /end MEASUREMENT
/begin MEASUREMENT ExhMod_molfCo2B1 "molar flow CO2 bank 1" UWORD q0p000061_mol_DIV_s 1 100 0.00 3.999939 FORMAT "%8.6" ECU_ADDRESS 0x60007766 /end MEASUREMENT
/begin MEASUREMENT ExhMod_molfCo2CteB1 "molar flow CO2 cylinder torque equalization bank 1" UWORD q0p000061_mol_DIV_s 1 100 0.00 3.999939 FORMAT "%8.6" ECU_ADDRESS 0x60007764 /end MEASUREMENT
/begin MEASUREMENT ExhMod_molfCo2SecFuB1 "CO2 mole flow after combustion of secondary fuel bank 1" UWORD q0p000061_mol_DIV_s 1 100 0.00 3.999939 FORMAT "%8.6" ECU_ADDRESS 0x60007762 /end MEASUREMENT
/begin MEASUREMENT ExhMod_molfCoB1 "molar flow CO bank 1" UWORD q0p000061_mol_DIV_s 1 100 0.00 3.999939 FORMAT "%8.6" ECU_ADDRESS 0x60007760 /end MEASUREMENT
/begin MEASUREMENT ExhMod_molfCoSecFuB1 "CO mole flow after combustion of secondary fuel bank 1" UWORD q0p000061_mol_DIV_s 1 100 0.00 3.999939 FORMAT "%8.6" ECU_ADDRESS 0x6000775E /end MEASUREMENT
/begin MEASUREMENT ExhMod_molfH2B1 "molar flow H2 bank 1" UWORD q0p000061_mol_DIV_s 1 100 0.00 3.999939 FORMAT "%8.6" ECU_ADDRESS 0x6000775C /end MEASUREMENT
/begin MEASUREMENT ExhMod_molfH2oB1 "molar flow H2O bank 1" UWORD q0p000061_mol_DIV_s 1 100 0.00 3.999939 FORMAT "%8.6" ECU_ADDRESS 0x6000775A /end MEASUREMENT
/begin MEASUREMENT ExhMod_molfH2oBefCmbB1 "molar flow H2O before combustion bank 1" SWORD q1p2207Em4_mol_DIV_s 1 100 -4.000000 3.999878 FORMAT "%8.6" ECU_ADDRESS 0x60007758 /end MEASUREMENT
/begin MEASUREMENT ExhMod_molfH2oBefCmbSecFuB1 "H2O mole flow before combustion of secondary fuel bank 1" SWORD q1p2207Em4_mol_DIV_s 1 100 -4.000000 3.999878 FORMAT "%8.6" ECU_ADDRESS 0x60007756 /end MEASUREMENT
/begin MEASUREMENT ExhMod_molfH2oCmbB1 "molar flow H2O during combustion bank 1" SWORD q1p2207Em4_mol_DIV_s 1 100 -4.000000 3.999878 FORMAT "%8.6" ECU_ADDRESS 0x60007754 /end MEASUREMENT
/begin MEASUREMENT ExhMod_molfH2oCmbSecFuB1 "H2O mole flow generated due to combustion of secondary fuel bank 1" SWORD q1p2207Em4_mol_DIV_s 1 100 -4.000000 3.999878 FORMAT "%8.6" ECU_ADDRESS 0x60007752 /end MEASUREMENT
/begin MEASUREMENT ExhMod_molfH2oCteB1 "molar flow H2O cylinder torque equalization bank 1" UWORD q0p000061_mol_DIV_s 1 100 0.00 3.999939 FORMAT "%8.6" ECU_ADDRESS 0x60007750 /end MEASUREMENT
/begin MEASUREMENT ExhMod_molfH2oSecFuB1 "H2O mole flow after combustion of secondary fuel bank 1" UWORD q0p000061_mol_DIV_s 1 100 0.00 3.999939 FORMAT "%8.6" ECU_ADDRESS 0x6000774E /end MEASUREMENT
/begin MEASUREMENT ExhMod_molfH2SecFuB1 "H2 mole flow after combustion of secondary fuel bank 1" UWORD q0p000061_mol_DIV_s 1 100 0.00 3.999939 FORMAT "%8.6" ECU_ADDRESS 0x6000774C /end MEASUREMENT
/begin MEASUREMENT ExhMod_molfHcB1 "molar flow HC bank 1" UWORD q0p000061_mol_DIV_s 1 100 0.00 3.999939 FORMAT "%8.6" ECU_ADDRESS 0x6000774A /end MEASUREMENT
/begin MEASUREMENT ExhMod_molfHcBefCmbB1 "molar flow HC before combustion bank 1" UWORD q0p000061_mol_DIV_s 1 100 0.00 3.999939 FORMAT "%8.6" ECU_ADDRESS 0x60007748 /end MEASUREMENT
/begin MEASUREMENT ExhMod_molfHcBefCmbSecFuB1 "Secondary fuel mole flow before combustion bank 1" UWORD q0p000061_mol_DIV_s 1 100 0.00 3.999939 FORMAT "%8.6" ECU_ADDRESS 0x60007746 /end MEASUREMENT
/begin MEASUREMENT ExhMod_molfHcCteB1 "molar flow HC cylinder torque equalization bank 1" UWORD q0p000061_mol_DIV_s 1 100 0.00 3.999939 FORMAT "%8.6" ECU_ADDRESS 0x60007744 /end MEASUREMENT
/begin MEASUREMENT ExhMod_molfHcSecFuB1 "Secondary fuel mole flow after combustion bank 1" UWORD q0p000061_mol_DIV_s 1 100 0.00 3.999939 FORMAT "%8.6" ECU_ADDRESS 0x60007742 /end MEASUREMENT
/begin MEASUREMENT ExhMod_molfN2B1 "molar flow N2 bank 1" UWORD q1p2207Em4_mol_DIV_s 1 100 0.00 7.999878 FORMAT "%8.6" ECU_ADDRESS 0x60007740 /end MEASUREMENT
/begin MEASUREMENT ExhMod_molfN2BefCmbB1 "molar flow N2 before combustion bank 1" UWORD q1p2207Em4_mol_DIV_s 1 100 0.00 7.999878 FORMAT "%8.6" ECU_ADDRESS 0x6000773E /end MEASUREMENT
/begin MEASUREMENT ExhMod_molfN2BefCmbSecFuB1 "N2 mole flow before combustion of secondary fuel bank 1" UWORD q1p2207Em4_mol_DIV_s 1 100 0.00 7.999878 FORMAT "%8.6" ECU_ADDRESS 0x6000773C /end MEASUREMENT
/begin MEASUREMENT ExhMod_molfN2ScavB1 "molar flow N2 scavenging bank 1" UWORD q1p2207Em4_mol_DIV_s 1 100 0.00 7.999878 FORMAT "%8.6" ECU_ADDRESS 0x6000773A /end MEASUREMENT
/begin MEASUREMENT ExhMod_molfN2SecFuB1 "N2 mole flow after combustion of secondary fuel bank 1" UWORD q1p2207Em4_mol_DIV_s 1 100 0.00 7.999878 FORMAT "%8.6" ECU_ADDRESS 0x60007738 /end MEASUREMENT
/begin MEASUREMENT ExhMod_molfNoB1 "molar flow NO bank 1" UWORD q0p000061_mol_DIV_s 1 100 0.00 3.999939 FORMAT "%8.6" ECU_ADDRESS 0x60007736 /end MEASUREMENT
/begin MEASUREMENT ExhMod_molfNoSecFuB1 "NO mole flow after combustion of secondary fuel bank 1" UWORD q0p000061_mol_DIV_s 1 100 0.00 3.999939 FORMAT "%8.6" ECU_ADDRESS 0x60007734 /end MEASUREMENT
/begin MEASUREMENT ExhMod_molfO2B1 "molar flow O2 bank 1" UWORD q1p2207Em4_mol_DIV_s 1 100 0.00 7.999878 FORMAT "%8.6" ECU_ADDRESS 0x60007732 /end MEASUREMENT
/begin MEASUREMENT ExhMod_molfO2BefCmbB1 "molar flow O2 before combustion bank 1" UWORD q1p2207Em4_mol_DIV_s 1 100 0.00 7.999878 FORMAT "%8.6" ECU_ADDRESS 0x60007730 /end MEASUREMENT
/begin MEASUREMENT ExhMod_molfO2BefCmbSecFuB1 "O2 mole flow before combustion of secondary fuel bank 1" UWORD q1p2207Em4_mol_DIV_s 1 100 0.00 7.999878 FORMAT "%8.6" ECU_ADDRESS 0x6000772E /end MEASUREMENT
/begin MEASUREMENT ExhMod_molfO2CteB1 "molar flow O2 cylinder torque equalization bank 1" UWORD q1p2207Em4_mol_DIV_s 1 100 0.00 7.999878 FORMAT "%8.6" ECU_ADDRESS 0x6000772C /end MEASUREMENT
/begin MEASUREMENT ExhMod_molfO2ScavB1 "molar flow O2 scavenging bank 1" UWORD q1p2207Em4_mol_DIV_s 1 100 0.00 7.999878 FORMAT "%8.6" ECU_ADDRESS 0x6000772A /end MEASUREMENT
/begin MEASUREMENT ExhMod_molfO2SecFuB1 "O2 mole flow after combustion of secondary fuel bank 1" UWORD q1p2207Em4_mol_DIV_s 1 100 0.00 7.999878 FORMAT "%8.6" ECU_ADDRESS 0x60007728 /end MEASUREMENT
/begin MEASUREMENT ExhMod_molrEngCoH2oB1 "reaction rate engine reaction CO and H2O bank 1" SWORD q1p2207Em4_mol_DIV_s 1 100 -4.000000 3.999878 FORMAT "%8.6" ECU_ADDRESS 0x60007726 /end MEASUREMENT
/begin MEASUREMENT ExhMod_molrEngCoH2oSecFuB1 "Reaction rate in moles for water gas shift reaction(CO-H2O) for secondary fuel bank 1" SWORD q1p2207Em4_mol_DIV_s 1 100 -4.000000 3.999878 FORMAT "%8.6" ECU_ADDRESS 0x60007724 /end MEASUREMENT
/begin MEASUREMENT ExhMod_molrEngCoNoB1 "reaction rate engine reaction CO and NO bank 1" SWORD q1p2207Em4_mol_DIV_s 1 100 -4.000000 3.999878 FORMAT "%8.6" ECU_ADDRESS 0x60007722 /end MEASUREMENT
/begin MEASUREMENT ExhMod_molrEngCoNoSecFuB1 "Reaction rate in moles for NOx reaction for secondary fuel bank 1" SWORD q1p2207Em4_mol_DIV_s 1 100 -4.000000 3.999878 FORMAT "%8.6" ECU_ADDRESS 0x60007720 /end MEASUREMENT
/begin MEASUREMENT ExhMod_molrEngHcO2B1 "reaction rate engine reaction HC and O2 bank 1" SWORD q1p2207Em4_mol_DIV_s 1 100 -4.000000 3.999878 FORMAT "%8.6" ECU_ADDRESS 0x6000771E /end MEASUREMENT
/begin MEASUREMENT ExhMod_molrEngHcO2CmplB1 "reaction rate engine reaction HC and O2 (complete oxidation) bank 1" UWORD q0p000061_mol_DIV_s 1 100 0.00 3.999939 FORMAT "%8.6" ECU_ADDRESS 0x6000771C /end MEASUREMENT
/begin MEASUREMENT ExhMod_molrEngHcO2CmplSecFuB1 "Reaction rate in moles for complete oxidation of secondary fuel bank 1" UWORD q0p000061_mol_DIV_s 1 100 0.00 3.999939 FORMAT "%8.6" ECU_ADDRESS 0x6000771A /end MEASUREMENT
/begin MEASUREMENT ExhMod_molrEngHcO2SecFuB1 "Reaction rate in moles for incomplete oxidation of secondary fuel bank 1" SWORD q1p2207Em4_mol_DIV_s 1 100 -4.000000 3.999878 FORMAT "%8.6" ECU_ADDRESS 0x60007718 /end MEASUREMENT
/begin MEASUREMENT ExhMod_mOscMeasdCat1B1 "Measured oxygen storage capability catalyst 1 bank 1" UWORD m_q0p1_mg 1 100 0.00 6553.500 FORMAT "%8.3" ECU_ADDRESS 0x6001489E /end MEASUREMENT
/begin MEASUREMENT ExhMod_mOscMeasdExtdCat1B1 "Measured oxygen storage capability catalyst 1 bank 1" ULONG m_q0p1_mg 1 100 0.00 429496729.500 FORMAT "%13.3" ECU_ADDRESS 0x50004F40 /end MEASUREMENT
/begin MEASUREMENT ExhMod_mRoscMeasdCat1B1 "Measured oxygen storage capacity catalyst 1 bank 1" UWORD m_q0p1_mg 1 100 0.00 6553.500 FORMAT "%8.3" ECU_ADDRESS 0x600148A0 /end MEASUREMENT
/begin MEASUREMENT ExhMod_mRoscMeasdExtdCat1B1 "Measured oxygen storage capacity catalyst 1 bank 1" ULONG m_q0p1_mg 1 100 0.00 429496729.500 FORMAT "%13.3" ECU_ADDRESS 0x60013B14 /end MEASUREMENT
/begin MEASUREMENT ExhMod_pDifDsLstCat "Pressure difference downstream last catalyst bank 1" UWORD p_q0p039 1 100 0.00 2559.961 FORMAT "%8.3" ECU_ADDRESS 0x6000778A /end MEASUREMENT
/begin MEASUREMENT ExhMod_pDiffCatMFlowAry "Output array haracteristic map mass flow-dependent factor in press. gradient catalysts" UWORD fak_q16_hPahPa 1 100 0.00 1048560. FORMAT "%8.0" ARRAY_SIZE 2 ECU_ADDRESS 0x60007786 /end MEASUREMENT
/begin MEASUREMENT ExhMod_pDsLstCat "pressure downstream of last catalyst" UWORD p_q0p039 1 100 0.00 2559.961 FORMAT "%8.3" ECU_ADDRESS 0x600148A2 /end MEASUREMENT
/begin MEASUREMENT ExhMod_pEnvAppl "Ambient pressure for the exhaust backpressure model" UWORD p_q0p039 1 100 0.00 2559.961 FORMAT "%8.3" ECU_ADDRESS 0x60008ED4 /end MEASUREMENT
/begin MEASUREMENT ExhMod_pExhAryB1 "pressure exhaust gas array" UWORD p_q0p039 1 100 0.00 2559.961 FORMAT "%8.3" ARRAY_SIZE 12 ECU_ADDRESS 0x60008EBC /end MEASUREMENT
/begin MEASUREMENT ExhMod_pExhCat1UsB1 "pressure exhaust gas catalyst 1 upstream" UWORD p_q0p039 1 100 0.00 2559.961 FORMAT "%8.3" ECU_ADDRESS 0x60008EBA /end MEASUREMENT
/begin MEASUREMENT ExhMod_pExhCat2UsB1 "pressure exhaust gas catalyst 2 upstream" UWORD p_q0p039 1 100 0.00 2559.961 FORMAT "%8.3" ECU_ADDRESS 0x60008EB8 /end MEASUREMENT
/begin MEASUREMENT ExhMod_pExhCatUsAryB1 "pressure exhaust gas upstream catalysts" UWORD p_q0p039 1 100 0.00 2559.961 FORMAT "%8.3" ARRAY_SIZE 3 ECU_ADDRESS 0x500056E2 /end MEASUREMENT
/begin MEASUREMENT ExhMod_pExhUsSilB1 "Pressure upstream of silencer bank 1" UWORD p_q0p039 1 100 0.00 2559.961 FORMAT "%8.3" ECU_ADDRESS 0x60007784 /end MEASUREMENT
/begin MEASUREMENT ExhMod_pwrExoCcoAryB1 "power distribution cylinder cut off bank 1" FLOAT32_IEEE HtFlw_Fl 1 100 0.00 5000000.00 FORMAT "%7.2" ARRAY_SIZE 6 ECU_ADDRESS 0x600029C0 /end MEASUREMENT
/begin MEASUREMENT ExhMod_pwrExoCcoCat1B1 "energy exothermie cylinder cut off catalyst 1 bank 1" FLOAT32_IEEE HtFlw_Fl 1 100 0.00 5000000.000 FORMAT "%11.3" ECU_ADDRESS 0x600029BC /end MEASUREMENT
/begin MEASUREMENT ExhMod_pwrExoCorrdCatAryB1 "vector of corrected heat released by basic exothermic reaction in each brick of the catalysts bank1" FLOAT32_IEEE HtFlw_Fl 1 100 0.00 5000000.000 FORMAT "%11.3" ARRAY_SIZE 6 ECU_ADDRESS 0x50001840 /end MEASUREMENT
/begin MEASUREMENT ExhMod_pwrExoEngOffAryB1 "Array for exothermic heat flow in catalyst bricks after engine-off Bank 1" FLOAT32_IEEE HtFlw_Fl 1 100 0.00 5000000.000 FORMAT "%11.3" ARRAY_SIZE 6 ECU_ADDRESS 0x600029A4 /end MEASUREMENT
/begin MEASUREMENT ExhMod_pwrExothermCcoCat1B1 "Heat of reaction due to cylinder cut-off in first catalyst bank 1" FLOAT32_IEEE HtFlw_Fl 1 100 0.00 5000000.000 FORMAT "%11.3" ECU_ADDRESS 0x600029A0 /end MEASUREMENT
/begin MEASUREMENT ExhMod_pwrExoTranB1 "The heat energy released due to exothermic reactions during rich and lean lambda transitions for bank 1" FLOAT32_IEEE HtFlw_Fl 1 100 0.00 5000000.000 FORMAT "%11.3" ECU_ADDRESS 0x50001858 /end MEASUREMENT
/begin MEASUREMENT ExhMod_pwrReactnCat1Br1B1 "Heat of reaction in first catalyst brick bank 1" FLOAT32_IEEE HtFlw_Fl 1 100 0.00 5000000.000 FORMAT "%11.3" ECU_ADDRESS 0x6000299C /end MEASUREMENT
/begin MEASUREMENT ExhMod_pwrReactnMapBasdAryB1 "reaction heat in the elements of the exhaust system bank, map based model, 1" FLOAT32_IEEE HtFlw_Fl 1 100 0.00 5000000.000 FORMAT "%11.3" ARRAY_SIZE 12 ECU_ADDRESS 0x60003850 /end MEASUREMENT
/begin MEASUREMENT ExhMod_pwrReactnScavCteCatB1 "Heat of reaction due to scavenging and cylinder torque equalization at the catalyst bank 1" FLOAT32_IEEE HtFlw_Fl 1 100 0.00 5000000.000 FORMAT "%11.3" ECU_ADDRESS 0x60002998 /end MEASUREMENT
/begin MEASUREMENT ExhMod_ratBlowrAvrgB1 "averaged blower duty cycle bank 1" UWORD rel_q0p012207 1 100 0.00 399.9878 FORMAT "%8.4" ARRAY_SIZE 12 ECU_ADDRESS 0x60008EA0 /end MEASUREMENT
/begin MEASUREMENT ExhMod_ratCnvnCmplOxdB1 "Conversion rate for complete oxidation(combustion) of gasoline Bank 1" UWORD fak_uw_b2 1 100 0.00 1.000000 FORMAT "%8.6" ECU_ADDRESS 0x60007716 /end MEASUREMENT
/begin MEASUREMENT ExhMod_ratCnvnCmplOxdSecFuB1 "Conversion rate for complete oxidation(combustion) of secondary fuel Bank 1" UWORD fak_uw_b2 1 100 0.00 1.000000 FORMAT "%8.6" ECU_ADDRESS 0x60007714 /end MEASUREMENT
/begin MEASUREMENT ExhMod_ratCoH2B1 "ratio CO and H2 bank 1" UWORD fak_q0p000488 1 100 0.00 31.99951 FORMAT "%8.5" ECU_ADDRESS 0x60007712 /end MEASUREMENT
/begin MEASUREMENT ExhMod_ratCoH2SecFuB1 "Conversion rate for CO to H2(water gas shift reaction) for secondary fuel bank 1" UWORD fak_q0p000488 1 100 0.00 31.99951 FORMAT "%8.5" ECU_ADDRESS 0x60007710 /end MEASUREMENT
/begin MEASUREMENT ExhMod_ratH2oAir "ratio water and air" UWORD fak_uw_b0p5 1 100 0.00 0.4999924 FORMAT "%9.7" ECU_ADDRESS 0x60008E9E /end MEASUREMENT
/begin MEASUREMENT ExhMod_ratHcCnvnEngB1 "Conversion rate for combustion of gasoline Bank 1" UWORD fak_uw_b2 1 100 0.00 1.000000 FORMAT "%8.6" ECU_ADDRESS 0x6000770E /end MEASUREMENT
/begin MEASUREMENT ExhMod_ratHcCnvnEngSecFuB1 "Conversion rate for combustion of secondary fuel Bank 1" UWORD fak_uw_b2 1 100 0.00 1.000000 FORMAT "%8.6" ECU_ADDRESS 0x6000770C /end MEASUREMENT
/begin MEASUREMENT ExhMod_ratLamAvrgB1 "lambda average bank 1" UWORD fak_uw_b16 1 100 0.00 15.99976 FORMAT "%8.5" ECU_ADDRESS 0x60008E9C /end MEASUREMENT
/begin MEASUREMENT ExhMod_ratLamAvrgCylB1 "Lambda averaged over active and inactive cylinders (Cylinder cut off) bank 1" UWORD fak_uw_b16 1 100 0.00 15.99976 FORMAT "%8.5" ECU_ADDRESS 0x60007780 /end MEASUREMENT
/begin MEASUREMENT ExhMod_ratLamCatUsB1 "lambda upsteam catalyst bank 1" UWORD fak_uw_b16 1 100 0.00 15.99976 FORMAT "%8.5" ECU_ADDRESS 0x6000777E /end MEASUREMENT
/begin MEASUREMENT ExhMod_ratLamCcoB1 "lambda cylinder cut-off bank 1" UWORD fak_uw_b16 1 100 0.00 15.99976 FORMAT "%8.5" ECU_ADDRESS 0x6000777C /end MEASUREMENT
/begin MEASUREMENT ExhMod_ratLamExoB1 "lambda exothermy model bank 1" UWORD fak_uw_b16 1 100 0.00 15.99976 FORMAT "%8.5" ECU_ADDRESS 0x6000770A /end MEASUREMENT
/begin MEASUREMENT ExhMod_ratO2StorgCalCat1B1 "Ageing factor regarding OSC catalyst 1, bank 1" UBYTE fak_ub_b2 1 100 0.00 1.992188 FORMAT "%8.6" ECU_ADDRESS 0x6003936E /end MEASUREMENT
/begin MEASUREMENT ExhMod_ratO2StorgCalCat2B1 "Aging factor regarding OSC catalyst 2, bank 1" UBYTE fak_ub_b2 1 100 0.00 1.992188 FORMAT "%8.6" ECU_ADDRESS 0x6003936D /end MEASUREMENT
/begin MEASUREMENT ExhMod_ratO2StorgCatB1_a "array, which include ageing factors of each catalyst, bank 1" UWORD fak_uw_b2 1 100 0.00 1.999969 FORMAT "%8.6" ARRAY_SIZE 2 ECU_ADDRESS 0x60009478 /end MEASUREMENT
/begin MEASUREMENT ExhMod_ratO2StrCat1B1 "Catalyst aging factor based on Oxygen Storage Capacity - Catalyst 1 Bank 1" UWORD fak_uw_b2 1 100 0.00 1.999969 FORMAT "%8.6" ECU_ADDRESS 0x60009476 /end MEASUREMENT
/begin MEASUREMENT ExhMod_ratO2StrCat1MinBnk "Minimum of the Oxygen storage capacity correction factors of the catalyst 1 of bank 1 and bank 2" UWORD fak_uw_b2 1 100 0.00 1.999969 FORMAT "%8.6" ECU_ADDRESS 0x600148AA /end MEASUREMENT
/begin MEASUREMENT ExhMod_ratO2StrCatAryB1 "oxygen storage capacity correction factor catalysts" UWORD fak_uw_b2 1 100 0.00 1.999969 FORMAT "%8.6" ARRAY_SIZE 2 ECU_ADDRESS 0x60009472 /end MEASUREMENT
/begin MEASUREMENT ExhMod_rawEmiB1_I.molfAir "Class instance for modelling of raw exhaust gas emission bank for gasoline 1 / mole flow of air for combustion" UWORD q0p00024_mol_DIV_s 1 100 0.00 15.99976 FORMAT "%8.5" ECU_ADDRESS 0x600076BC /end MEASUREMENT
/begin MEASUREMENT ExhMod_rawEmiB1_I.molfCo "Class instance for modelling of raw exhaust gas emission bank for gasoline 1 / mole flow of CO after combustio" UWORD q0p000061_mol_DIV_s 1 100 0.00 3.999939 FORMAT "%8.6" ECU_ADDRESS 0x600076BE /end MEASUREMENT
/begin MEASUREMENT ExhMod_rawEmiB1_I.molfCo2 "Class instance for modelling of raw exhaust gas emission bank for gasoline 1 / mole flow of CO2 after combustion" UWORD q0p000061_mol_DIV_s 1 100 0.00 3.999939 FORMAT "%8.6" ECU_ADDRESS 0x600076C0 /end MEASUREMENT
/begin MEASUREMENT ExhMod_rawEmiB1_I.molfH2 "Class instance for modelling of raw exhaust gas emission bank for gasoline 1 / mole flow of H2 after combustion" UWORD q0p000061_mol_DIV_s 1 100 0.00 3.999939 FORMAT "%8.6" ECU_ADDRESS 0x600076C2 /end MEASUREMENT
/begin MEASUREMENT ExhMod_rawEmiB1_I.molfH2o "Class instance for modelling of raw exhaust gas emission bank for gasoline 1 / mole flow of H2O after combustion" UWORD q0p000061_mol_DIV_s 1 100 0.00 3.999939 FORMAT "%8.6" ECU_ADDRESS 0x600076C4 /end MEASUREMENT
/begin MEASUREMENT ExhMod_rawEmiB1_I.molfH2oBefCmb "Class instance for modelling of raw exhaust gas emission bank for gasoline 1 / mole flow of H2O before combustion" UWORD q0p000061_mol_DIV_s 1 100 0.00 3.999939 FORMAT "%8.6" ECU_ADDRESS 0x600076C6 /end MEASUREMENT
/begin MEASUREMENT ExhMod_rawEmiB1_I.molfH2oCmb "Class instance for modelling of raw exhaust gas emission bank for gasoline 1 / mole flow of H2O produced during combustion" UWORD q0p000061_mol_DIV_s 1 100 0.00 3.999939 FORMAT "%8.6" ECU_ADDRESS 0x600076C8 /end MEASUREMENT
/begin MEASUREMENT ExhMod_rawEmiB1_I.molfHc "Class instance for modelling of raw exhaust gas emission bank for gasoline 1 / mole flow of fuel after combustion" UWORD q0p000061_mol_DIV_s 1 100 0.00 3.999939 FORMAT "%8.6" ECU_ADDRESS 0x600076CA /end MEASUREMENT
/begin MEASUREMENT ExhMod_rawEmiB1_I.molfHcBefCmb "Class instance for modelling of raw exhaust gas emission bank for gasoline 1 / mole flow of CO before combustion" UWORD q0p000061_mol_DIV_s 1 100 0.00 3.999939 FORMAT "%8.6" ECU_ADDRESS 0x600076CC /end MEASUREMENT
/begin MEASUREMENT ExhMod_rawEmiB1_I.molfN2 "Class instance for modelling of raw exhaust gas emission bank for gasoline 1 / mole flow of N2 after combustion" UWORD q1p2207Em4_mol_DIV_s 1 100 0.00 7.999878 FORMAT "%8.6" ECU_ADDRESS 0x600076CE /end MEASUREMENT
/begin MEASUREMENT ExhMod_rawEmiB1_I.molfN2BefCmb "Class instance for modelling of raw exhaust gas emission bank for gasoline 1 / mole flow of N2 before combustion" UWORD q1p2207Em4_mol_DIV_s 1 100 0.00 7.999878 FORMAT "%8.6" ECU_ADDRESS 0x600076D0 /end MEASUREMENT
/begin MEASUREMENT ExhMod_rawEmiB1_I.molfNo "Class instance for modelling of raw exhaust gas emission bank for gasoline 1 / mole flow of NO after combustion" UWORD q0p000061_mol_DIV_s 1 100 0.00 3.999939 FORMAT "%8.6" ECU_ADDRESS 0x600076D2 /end MEASUREMENT
/begin MEASUREMENT ExhMod_rawEmiB1_I.molfO2 "Class instance for modelling of raw exhaust gas emission bank for gasoline 1 / mole flow of O2 after combustion" UWORD q1p2207Em4_mol_DIV_s 1 100 0.00 7.999878 FORMAT "%8.6" ECU_ADDRESS 0x600076D4 /end MEASUREMENT
/begin MEASUREMENT ExhMod_rawEmiB1_I.molfO2BefCmb "Class instance for modelling of raw exhaust gas emission bank for gasoline 1 / mole flow of O2 before combustion" UWORD q1p2207Em4_mol_DIV_s 1 100 0.00 7.999878 FORMAT "%8.6" ECU_ADDRESS 0x600076D6 /end MEASUREMENT
/begin MEASUREMENT ExhMod_rawEmiB1_I.molrEngCoH2o "Class instance for modelling of raw exhaust gas emission bank for gasoline 1 / Molar(reaction) rate for conversion of CO and H2O(water-gas shift reaction)" SWORD q1p2207Em4_mol_DIV_s 1 100 -4.000000 3.999878 FORMAT "%8.6" ECU_ADDRESS 0x600076D8 /end MEASUREMENT
/begin MEASUREMENT ExhMod_rawEmiB1_I.molrEngCoNo "Class instance for modelling of raw exhaust gas emission bank for gasoline 1 / Molar(reaction) rate for Nox reduction" SWORD q1p2207Em4_mol_DIV_s 1 100 -4.000000 3.999878 FORMAT "%8.6" ECU_ADDRESS 0x600076DA /end MEASUREMENT
/begin MEASUREMENT ExhMod_rawEmiB1_I.molrEngHcO2 "Class instance for modelling of raw exhaust gas emission bank for gasoline 1 / Molenrate(Reaktionsrate) for incomplete combustion of fuel" SWORD q1p2207Em4_mol_DIV_s 1 100 -4.000000 3.999878 FORMAT "%8.6" ECU_ADDRESS 0x600076DC /end MEASUREMENT
/begin MEASUREMENT ExhMod_rawEmiB1_I.molrEngHcO2Cmpl "Class instance for modelling of raw exhaust gas emission bank for gasoline 1 / Molenrate(Reaktionsrate) for complete combustion of fuel" UWORD q0p000061_mol_DIV_s 1 100 0.00 3.999939 FORMAT "%8.6" ECU_ADDRESS 0x600076DE /end MEASUREMENT
/begin MEASUREMENT ExhMod_rawEmiSecFuB1_I.molfAir "Class instance for modelling of raw exhaust gas emission bank for secondary fuel 1 / mole flow of air for combustion" UWORD q0p00024_mol_DIV_s 1 100 0.00 15.99976 FORMAT "%8.5" ECU_ADDRESS 0x60007698 /end MEASUREMENT
/begin MEASUREMENT ExhMod_rawEmiSecFuB1_I.molfCo "Class instance for modelling of raw exhaust gas emission bank for secondary fuel 1 / mole flow of CO after combustio" UWORD q0p000061_mol_DIV_s 1 100 0.00 3.999939 FORMAT "%8.6" ECU_ADDRESS 0x6000769A /end MEASUREMENT
/begin MEASUREMENT ExhMod_rawEmiSecFuB1_I.molfCo2 "Class instance for modelling of raw exhaust gas emission bank for secondary fuel 1 / mole flow of CO2 after combustion" UWORD q0p000061_mol_DIV_s 1 100 0.00 3.999939 FORMAT "%8.6" ECU_ADDRESS 0x6000769C /end MEASUREMENT
/begin MEASUREMENT ExhMod_rawEmiSecFuB1_I.molfH2 "Class instance for modelling of raw exhaust gas emission bank for secondary fuel 1 / mole flow of H2 after combustion" UWORD q0p000061_mol_DIV_s 1 100 0.00 3.999939 FORMAT "%8.6" ECU_ADDRESS 0x6000769E /end MEASUREMENT
/begin MEASUREMENT ExhMod_rawEmiSecFuB1_I.molfH2o "Class instance for modelling of raw exhaust gas emission bank for secondary fuel 1 / mole flow of H2O after combustion" UWORD q0p000061_mol_DIV_s 1 100 0.00 3.999939 FORMAT "%8.6" ECU_ADDRESS 0x600076A0 /end MEASUREMENT
/begin MEASUREMENT ExhMod_rawEmiSecFuB1_I.molfH2oBefCmb "Class instance for modelling of raw exhaust gas emission bank for secondary fuel 1 / mole flow of H2O before combustion" UWORD q0p000061_mol_DIV_s 1 100 0.00 3.999939 FORMAT "%8.6" ECU_ADDRESS 0x600076A2 /end MEASUREMENT
/begin MEASUREMENT ExhMod_rawEmiSecFuB1_I.molfH2oCmb "Class instance for modelling of raw exhaust gas emission bank for secondary fuel 1 / mole flow of H2O produced during combustion" UWORD q0p000061_mol_DIV_s 1 100 0.00 3.999939 FORMAT "%8.6" ECU_ADDRESS 0x600076A4 /end MEASUREMENT
/begin MEASUREMENT ExhMod_rawEmiSecFuB1_I.molfHc "Class instance for modelling of raw exhaust gas emission bank for secondary fuel 1 / mole flow of fuel after combustion" UWORD q0p000061_mol_DIV_s 1 100 0.00 3.999939 FORMAT "%8.6" ECU_ADDRESS 0x600076A6 /end MEASUREMENT
/begin MEASUREMENT ExhMod_rawEmiSecFuB1_I.molfHcBefCmb "Class instance for modelling of raw exhaust gas emission bank for secondary fuel 1 / mole flow of CO before combustion" UWORD q0p000061_mol_DIV_s 1 100 0.00 3.999939 FORMAT "%8.6" ECU_ADDRESS 0x600076A8 /end MEASUREMENT
/begin MEASUREMENT ExhMod_rawEmiSecFuB1_I.molfN2 "Class instance for modelling of raw exhaust gas emission bank for secondary fuel 1 / mole flow of N2 after combustion" UWORD q1p2207Em4_mol_DIV_s 1 100 0.00 7.999878 FORMAT "%8.6" ECU_ADDRESS 0x600076AA /end MEASUREMENT
/begin MEASUREMENT ExhMod_rawEmiSecFuB1_I.molfN2BefCmb "Class instance for modelling of raw exhaust gas emission bank for secondary fuel 1 / mole flow of N2 before combustion" UWORD q1p2207Em4_mol_DIV_s 1 100 0.00 7.999878 FORMAT "%8.6" ECU_ADDRESS 0x600076AC /end MEASUREMENT
/begin MEASUREMENT ExhMod_rawEmiSecFuB1_I.molfNo "Class instance for modelling of raw exhaust gas emission bank for secondary fuel 1 / mole flow of NO after combustion" UWORD q0p000061_mol_DIV_s 1 100 0.00 3.999939 FORMAT "%8.6" ECU_ADDRESS 0x600076AE /end MEASUREMENT
/begin MEASUREMENT ExhMod_rawEmiSecFuB1_I.molfO2 "Class instance for modelling of raw exhaust gas emission bank for secondary fuel 1 / mole flow of O2 after combustion" UWORD q1p2207Em4_mol_DIV_s 1 100 0.00 7.999878 FORMAT "%8.6" ECU_ADDRESS 0x600076B0 /end MEASUREMENT
/begin MEASUREMENT ExhMod_rawEmiSecFuB1_I.molfO2BefCmb "Class instance for modelling of raw exhaust gas emission bank for secondary fuel 1 / mole flow of O2 before combustion" UWORD q1p2207Em4_mol_DIV_s 1 100 0.00 7.999878 FORMAT "%8.6" ECU_ADDRESS 0x600076B2 /end MEASUREMENT
/begin MEASUREMENT ExhMod_rawEmiSecFuB1_I.molrEngCoH2o "Class instance for modelling of raw exhaust gas emission bank for secondary fuel 1 / Molar(reaction) rate for conversion of CO and H2O(water-gas shift reaction)" SWORD q1p2207Em4_mol_DIV_s 1 100 -4.000000 3.999878 FORMAT "%8.6" ECU_ADDRESS 0x600076B4 /end MEASUREMENT
/begin MEASUREMENT ExhMod_rawEmiSecFuB1_I.molrEngCoNo "Class instance for modelling of raw exhaust gas emission bank for secondary fuel 1 / Molar(reaction) rate for Nox reduction" SWORD q1p2207Em4_mol_DIV_s 1 100 -4.000000 3.999878 FORMAT "%8.6" ECU_ADDRESS 0x600076B6 /end MEASUREMENT
/begin MEASUREMENT ExhMod_rawEmiSecFuB1_I.molrEngHcO2 "Class instance for modelling of raw exhaust gas emission bank for secondary fuel 1 / Molenrate(Reaktionsrate) for incomplete combustion of fuel" SWORD q1p2207Em4_mol_DIV_s 1 100 -4.000000 3.999878 FORMAT "%8.6" ECU_ADDRESS 0x600076B8 /end MEASUREMENT
/begin MEASUREMENT ExhMod_rawEmiSecFuB1_I.molrEngHcO2Cmpl "Class instance for modelling of raw exhaust gas emission bank for secondary fuel 1 / Molenrate(Reaktionsrate) for complete combustion of fuel" UWORD q0p000061_mol_DIV_s 1 100 0.00 3.999939 FORMAT "%8.6" ECU_ADDRESS 0x600076BA /end MEASUREMENT
/begin MEASUREMENT ExhMod_rFlowPMdlLnrB1 "Flow resistance (laminar flow) bank 1" FLOAT32_IEEE q1_N_s_DIV_m5 1 100 -5.0000000E+020 5.0000000E+020 FORMAT "%20.7" ECU_ADDRESS 0x600029E8 /end MEASUREMENT
/begin MEASUREMENT ExhMod_rFlowPMdlQdrtcB1 "Flow resistance (turbulent flow) bank 1" FLOAT32_IEEE q1_N_s2_DIV_m8 1 100 -5.0000000E+020 5.0000000E+020 FORMAT "%20.7" ECU_ADDRESS 0x600029E4 /end MEASUREMENT
/begin MEASUREMENT ExhMod_tDeltaExoAddlB1 "additional exothermy due to lean to rich transition bank 1" SWORD temp_q0p0234 1 100 -768.0000 767.9766 FORMAT "%8.4" ECU_ADDRESS 0x6000777A /end MEASUREMENT
/begin MEASUREMENT ExhMod_tDeltaExoCcoB1 "exothermy cylinder cut-off bank 1" SWORD temp_q0p0234 1 100 0.00 767.9766 FORMAT "%8.4" ECU_ADDRESS 0x60007778 /end MEASUREMENT
/begin MEASUREMENT ExhMod_tDeltaExoCcoCatB1 "exothermy cylinder cut-off catalyst bank 1" SWORD temp_q0p0234 1 100 0.00 767.9766 FORMAT "%8.4" ECU_ADDRESS 0x60007776 /end MEASUREMENT
/begin MEASUREMENT ExhMod_tDeltaExoCcoMnfldB1 "exothermy cylinder cut-off manifold bank 1" SWORD temp_q0p0234 1 100 0.00 767.9766 FORMAT "%8.4" ECU_ADDRESS 0x60007774 /end MEASUREMENT
/begin MEASUREMENT ExhMod_tDeltaExoFcoB1 "exothermy fuel cut-off bank 1" UWORD temp_q0p1875 1 100 0.00 12287.81 FORMAT "%8.2" ECU_ADDRESS 0x60007772 /end MEASUREMENT
/begin MEASUREMENT ExhMod_tDeltaExoFcoRawB1 "unfiltered exothermy during fuel cut off bank 1" UWORD temp_q0p1875 1 100 0.00 12287.81 FORMAT "%8.2" ECU_ADDRESS 0x60007770 /end MEASUREMENT
/begin MEASUREMENT ExhMod_tDeltaExoTotB1 "Gesamte exotherme Temperaturerhöhung im Katalysator bank 1" UWORD temp_sw_q0p125 1 100 0.00 8191.875 FORMAT "%8.3" ECU_ADDRESS 0x6000776E /end MEASUREMENT
/begin MEASUREMENT ExhMod_tDeltaExoTranLtrB1 "Exothermicity in catalyst bricks during lean-to-rich lambda transition bank 1" SWORD temp_q0p0234 1 100 -768.0000 767.9766 FORMAT "%8.4" ECU_ADDRESS 0x6000776C /end MEASUREMENT
/begin MEASUREMENT ExhMod_tDeltaExoTranRtlB1 "Exothermicity in catalyst bricks during rich-to-lean lambda transition bank 1" SWORD temp_q0p0234 1 100 -768.0000 767.9766 FORMAT "%8.4" ECU_ADDRESS 0x6000776A /end MEASUREMENT
/begin MEASUREMENT ExhMod_tEngLoc "Engine Temperature Local" UWORD temp_q0p0234_o273 1 100 -273.150 1262.827 FORMAT "%8.3" ECU_ADDRESS 0x60007696 /end MEASUREMENT
/begin MEASUREMENT ExhMod_tEngTEnvMdl "Modelled Temperature of Engine" UWORD temp_q0p0234_o273 1 100 -273.150 1262.827 FORMAT "%8.3" ECU_ADDRESS 0x60007694 /end MEASUREMENT
/begin MEASUREMENT ExhMod_tEnvCorrdB1 "Corrected environment temperature bank 1" UWORD temp_q0p0234_o273 1 100 -273.150 1262.827 FORMAT "%8.3" ARRAY_SIZE 12 ECU_ADDRESS 0x6000767C /end MEASUREMENT
/begin MEASUREMENT ExhMod_tEnvCorrdTEngAryB1 "temperature environment corrected depending on temperature engine bank 1" UWORD temp_q0p0234_o273 1 100 -273.150 1262.827 FORMAT "%8.3" ARRAY_SIZE 12 ECU_ADDRESS 0x60008E78 /end MEASUREMENT
/begin MEASUREMENT ExhMod_tEnvLoc "Local ambient temperature value for ExhMod_TMdl" UWORD temp_q0p0234_o273 1 100 -273.150 1262.827 FORMAT "%8.3" ECU_ADDRESS 0x6000767A /end MEASUREMENT
/begin MEASUREMENT ExhMod_vfDsLstCatB1 "exhaust gas volume flow downstream last catalyst bank 1" FLOAT32_IEEE RBPtCel_vf_1p0_1 1 100 0.0000000 65535.0000000 FORMAT "%20.7" ECU_ADDRESS 0x600029E0 /end MEASUREMENT
/begin MEASUREMENT ExhMod_vVehLoc "local calculated vehicle speed" UWORD vfzg_uw_b512 1 100 0.00 511.9922 FORMAT "%8.4" ECU_ADDRESS 0x60007678 /end MEASUREMENT
/begin MEASUREMENT lamsbg_wloc "Desired Lambda limitation (word)" UWORD fak_uw_b16 1 100 0.00 15.99976 FORMAT "%8.5" ECU_ADDRESS 0x60007768 /end MEASUREMENT
/begin MEASUREMENT O2St_CalcnOscCorrnCat1B1_I.flgO2StrCalcd "Oxygen Storage Capacity correction for catalyst 1,bank 1 / oxygen storage capacity measured" UBYTE B_TRUE 1 100 0.00 1.00000000000 BIT_MASK 0x1 FORMAT "%13.11" ECU_ADDRESS 0x50001C30 /end MEASUREMENT
/begin MEASUREMENT O2St_CalcnOscCorrnCat1B1_I.flgRoscMeasd "Oxygen Storage Capacity correction for catalyst 1,bank 1 / rich gas storage capacity measured" UBYTE B_TRUE 1 100 0.00 1.00000000000 BIT_MASK 0x1 FORMAT "%13.11" ECU_ADDRESS 0x50001C31 /end MEASUREMENT
/begin MEASUREMENT O2St_CalcnOscCorrnCat1B1_I.mOscMeasd "Oxygen Storage Capacity correction for catalyst 1,bank 1 / oxygen storage capacity" ULONG m_q0p1_mg 1 100 0.00 429496729.500 FORMAT "%13.3" ECU_ADDRESS 0x50001C34 /end MEASUREMENT
/begin MEASUREMENT O2St_CalcnOscCorrnCat1B1_I.mRoscMeasd "Oxygen Storage Capacity correction for catalyst 1,bank 1 / rich gas storage capacity" ULONG m_q0p1_mg 1 100 0.00 429496729.500 FORMAT "%13.3" ECU_ADDRESS 0x50001C38 /end MEASUREMENT
/begin MEASUREMENT O2St_CalcnOscCurrExtd_I.mOscCurr "calculation for conversion of ROSCOSC / oxygen storage capacity" ULONG m_q0p1_mg 1 100 0.00 429496729.500 FORMAT "%13.3" ECU_ADDRESS 0x50001C3C /end MEASUREMENT
/begin MEASUREMENT O2St_CalcnRichLeanCat1B1_I.flgEmptyO2 "calculation catalyst 1 full or empty / Flag catalyst is exhausted of oxygen" UBYTE B_TRUE 1 100 0.00 1.00000000000 BIT_MASK 0x1 FORMAT "%13.11" ECU_ADDRESS 0x5000579A /end MEASUREMENT
/begin MEASUREMENT O2St_CalcnRichLeanCat1B1_I.flgFullO2 "calculation catalyst 1 full or empty / Flag catalyst is filled with oxygen" UBYTE B_TRUE 1 100 0.00 1.00000000000 BIT_MASK 0x1 FORMAT "%13.11" ECU_ADDRESS 0x5000579B /end MEASUREMENT
/begin MEASUREMENT O2St_CalcnRichLeanCat1B1_I.flgInpMfLean "calculation catalyst 1 full or empty / Flag input mass flow lean catalyst" UBYTE B_TRUE 1 100 0.00 1.00000000000 BIT_MASK 0x1 FORMAT "%13.11" ECU_ADDRESS 0x5000579C /end MEASUREMENT
/begin MEASUREMENT O2St_CalcnRichLeanCat1B1_I.flgInpMfRich "calculation catalyst 1 full or empty / Flag input mass flow rich catalyst" UBYTE B_TRUE 1 100 0.00 1.00000000000 BIT_MASK 0x1 FORMAT "%13.11" ECU_ADDRESS 0x5000579D /end MEASUREMENT
/begin MEASUREMENT O2St_CalcnRichLeanCat1B1_I.flgUMonoAsc "calculation catalyst 1 full or empty / Flag sensor voltage rises monetary downstream catalyst" UBYTE B_TRUE 1 100 0.00 1.00000000000 BIT_MASK 0x1 FORMAT "%13.11" ECU_ADDRESS 0x5000579E /end MEASUREMENT
/begin MEASUREMENT O2St_CalcnRichLeanCat1B1_I.flgUSensHi "calculation catalyst 1 full or empty / Flag sensor voltage is greater than threshold downstream catalyst" UBYTE B_TRUE 1 100 0.00 1.00000000000 BIT_MASK 0x1 FORMAT "%13.11" ECU_ADDRESS 0x5000579F /end MEASUREMENT
/begin MEASUREMENT O2St_CalcnRichLeanCat1B1_I.flgUSensLo "calculation catalyst 1 full or empty / Flag sensor voltage is lower than threshold downstream catalyst" UBYTE B_TRUE 1 100 0.00 1.00000000000 BIT_MASK 0x1 FORMAT "%13.11" ECU_ADDRESS 0x500057A0 /end MEASUREMENT
/begin MEASUREMENT O2St_CalcnRichLeanCat1B1_I.uSensMax "calculation catalyst 1 full or empty / Maximum mesured voltage as interim value for evalutation of the slope of sensor voltage downstream of catalyst" UWORD spg_uw_q0p00488 1 100 0.00 319.9951 FORMAT "%8.4" ECU_ADDRESS 0x500057A2 /end MEASUREMENT
/begin MEASUREMENT O2St_CalcnRichLeanCat1B1_I.uSensRef "calculation catalyst 1 full or empty / Reference value for evaluation of the sensor voltage downstream catalyst" UWORD spg_uw_q0p00488 1 100 0.00 319.9951 FORMAT "%8.4" ECU_ADDRESS 0x500057A4 /end MEASUREMENT
/begin MEASUREMENT O2St_CalcnSensDynCorrn.flgCorrnPlausDsCat "Calculation of sensor dynamic correction of the OSCROSC measurement and plausibility of correction . / Flag sensor dynamic correction of measurement storage capability is plausible for sensor downstream catalyst" UBYTE B_TRUE 1 100 0.00 1.00000000000 BIT_MASK 0x1 FORMAT "%13.11" ECU_ADDRESS 0x50001C40 /end MEASUREMENT
/begin MEASUREMENT O2St_CalcnSensDynCorrn.flgCorrnPlausUsCat "Calculation of sensor dynamic correction of the OSCROSC measurement and plausibility of correction . / Flag sensor dynamic correction of measurement storage capability is plausible for sensor upstream catalyst" UBYTE B_TRUE 1 100 0.00 1.00000000000 BIT_MASK 0x1 FORMAT "%13.11" ECU_ADDRESS 0x50001C41 /end MEASUREMENT
/begin MEASUREMENT O2St_CalcnSensDynCorrn.mO2CorrnDsCat "Calculation of sensor dynamic correction of the OSCROSC measurement and plausibility of correction . / Correction of OSC-ROSC-measurement for sensor dynamic correction of sensor downstream catalyst" SLONG m_q0p2_mg 1 100 -429496729.600 429496729.400 FORMAT "%13.3" ECU_ADDRESS 0x50001C44 /end MEASUREMENT
/begin MEASUREMENT O2St_CalcnSensDynCorrn.mO2CorrnUsCat "Calculation of sensor dynamic correction of the OSCROSC measurement and plausibility of correction . / Correction of OSC-ROSC-measurement for sensor dynamic correction of sensor upstream catalyst" SLONG m_q0p2_mg 1 100 -429496729.600 429496729.400 FORMAT "%13.3" ECU_ADDRESS 0x50001C48 /end MEASUREMENT
/begin MEASUREMENT O2St_CalcnSlopOIntglCat1B1_I.mO2IntglSlopDsCat1 "Slope of Oxygen integral for OSC measurement of catalyst 1 bank 1 / Slope of oxygen-integral OSC-ROSC-measurement for sensor dynamic correction of the sensor downstream catalyst 1" SLONG m_q0p2_mg_DIV_s 1 100 -429496729.600 429496729.400 FORMAT "%13.3" ECU_ADDRESS 0x50001C4C /end MEASUREMENT
/begin MEASUREMENT O2St_CalcnSlopOIntglCat1B1_I.mO2IntglSlopUsCat1 "Slope of Oxygen integral for OSC measurement of catalyst 1 bank 1 / Slope of oxygen-integral OSC-ROSC-measurement for sensor dynamic correction of the sensor upstream catalyst 1" SLONG m_q0p2_mg_DIV_s 1 100 -429496729.600 429496729.400 FORMAT "%13.3" ECU_ADDRESS 0x50001C50 /end MEASUREMENT
/begin MEASUREMENT O2St_CalcnSlopOIntglCat1B1_I.oxsbuf_l "Slope of Oxygen integral for OSC measurement of catalyst 1 bank 1 / buffer" SLONG m_q0p2_mg 1 100 -429496729.600 429496729.400 FORMAT "%13.3" ARRAY_SIZE 6 ECU_ADDRESS 0x50001C54 /end MEASUREMENT
/begin MEASUREMENT O2St_CalcnSlopOIntglCat1B1_I.oxscounter "Slope of Oxygen integral for OSC measurement of catalyst 1 bank 1 / counter" UWORD dez 1 100 0.00 65535.00 FORMAT "%8.2" ECU_ADDRESS 0x50001C6C /end MEASUREMENT
/begin MEASUREMENT O2St_CalcnSlopOIntglCat1B1_I.pointer "Slope of Oxygen integral for OSC measurement of catalyst 1 bank 1 / pointer" UBYTE dez 1 100 0.00 255.0 FORMAT "%5.1" ECU_ADDRESS 0x50001C6E /end MEASUREMENT
/begin MEASUREMENT O2St_CalcnUMaxBefOscCat1B1_I.uCatDsMax "Maximum voltage of downstream sensor before OSC measurement for catalyst 1,bank 1 / max. voltage" UWORD spg_uw_q0p00488 1 100 0.00 319.9951 FORMAT "%8.4" ECU_ADDRESS 0x60007798 /end MEASUREMENT
/begin MEASUREMENT O2St_CatEnaCdnCat1B1_I.ExhMod_flgIntHLR_I.hysterese "condition for readiness for Osc measurement catalyst 1 bank 1 / low pass filter exhaust gas mass flow / Current value of the hysteresis" UBYTE B_TRUE 1 100 0.00 1.00000000000 BIT_MASK 0x1 FORMAT "%13.11" ECU_ADDRESS 0x50001C70 /end MEASUREMENT
/begin MEASUREMENT O2St_CatEnaCdnCat1B1_I.ExhMod_flgtempTON_I.buffer "condition for readiness for Osc measurement catalyst 1 bank 1 / approval catalyst temperature is within valid interval / Internal state of TurnOnDelay" UBYTE B_TRUE 1 100 0.00 1.00000000000 BIT_MASK 0x1 FORMAT "%13.11" ECU_ADDRESS 0x50001C72 /end MEASUREMENT
/begin MEASUREMENT O2St_CatEnaCdnCat1B1_I.ExhMod_flgtempTON_I.time "condition for readiness for Osc measurement catalyst 1 bank 1 / approval catalyst temperature is within valid interval / Internal time of TurnOnDelay" UWORD t_q0p02 1 100 0.00 1310.700 FORMAT "%8.3" ECU_ADDRESS 0x50001C74 /end MEASUREMENT
/begin MEASUREMENT O2St_CatEnaCdnCat1B1_I.ExhMod_msabLT_I.memory "condition for readiness for Osc measurement catalyst 1 bank 1 / approval catalyst temperature is within valid interval / current lowpass value" ULONG mgrad_q1p526Em6_kg_DIV_h 1 100 0.00 6553.59999847 FORMAT "%13.8" ECU_ADDRESS 0x50001C78 /end MEASUREMENT
/begin MEASUREMENT O2St_ChkPlausEndMeasCat1B1_I.flgMeasOsc "Plausiblity check for end of OSC measurement catalyst 1,bank 1 / Flag storage capability is measured momentarily catalyst" UBYTE B_TRUE 1 100 0.00 1.00000000000 BIT_MASK 0x1 FORMAT "%13.11" ECU_ADDRESS 0x500057AA /end MEASUREMENT
/begin MEASUREMENT O2St_ChkPlausEndMeasCat1B1_I.flgMeasOscPlaus "Plausiblity check for end of OSC measurement catalyst 1,bank 1 / Flag measurement of storage capability is plausible catalyst" UBYTE B_TRUE 1 100 0.00 1.00000000000 BIT_MASK 0x1 FORMAT "%13.11" ECU_ADDRESS 0x500057AB /end MEASUREMENT
/begin MEASUREMENT O2St_ChkPlausEndMeasCat1B1_I.ExhMod_flgmeasbreakTONV_I.outbit "Plausiblity check for end of OSC measurement catalyst 1,bank 1 / approval start OSC measurement / return value" UBYTE B_TRUE 1 100 0.00 1.00000000000 BIT_MASK 0x1 FORMAT "%13.11" ECU_ADDRESS 0x500057AC /end MEASUREMENT
/begin MEASUREMENT O2St_ChkPlausEndMeasCat1B1_I.ExhMod_flgmeasbreakTONV_I.time "Plausiblity check for end of OSC measurement catalyst 1,bank 1 / approval start OSC measurement / expired delay time" UWORD t_q0p02 1 100 0.00 1310.700 FORMAT "%8.3" ECU_ADDRESS 0x500057AE /end MEASUREMENT
/begin MEASUREMENT O2St_cntrOscCurrUpdCat1B1 "Counter for current OSC measurements since initialisation catalyst 1 bank 1" UBYTE dez 1 100 0.00 255.0 FORMAT "%5.1" ECU_ADDRESS 0x6003936C /end MEASUREMENT
/begin MEASUREMENT O2St_dmAvrgCurrMeasCat1B1 "Average mass flow of current measurement storage capability catalyst 1 bank 1" UWORD m_uw_b6553p5 1 100 0.00 6553.500 FORMAT "%8.3" ECU_ADDRESS 0x600077B6 /end MEASUREMENT
/begin MEASUREMENT O2St_dmAvrgMeasCurrCat1B1 "Average mass flow of current measurement storage capability catalyst 1 bank 1" UWORD m_uw_b6553p5 1 100 0.00 6553.500 FORMAT "%8.3" ECU_ADDRESS 0x60013D80 /end MEASUREMENT
/begin MEASUREMENT O2St_dmIntglUsCat1B1 "integrated mass flow upstream catalyst 1 bank 1" UWORD m_q0p0277_g 1 100 0.00 1820.417 FORMAT "%8.3" ECU_ADDRESS 0x60013D82 /end MEASUREMENT
/begin MEASUREMENT O2St_flgClr "execution of DSM_CLEAR" UBYTE B_TRUE 1 100 0.00 1.00000000000 BIT_MASK 0x1 FORMAT "%13.11" ECU_ADDRESS 0x6000B90E /end MEASUREMENT
/begin MEASUREMENT O2St_flgCorrnPlausDsCat1B1 "Flag sensor dynamic correction of measurement storage capability is plausible for sensor downstream catalyst 1 bank 1" UBYTE B_TRUE 1 100 0.00 1.00000000000 BIT_MASK 0x1 FORMAT "%13.11" ECU_ADDRESS 0x6000B90D /end MEASUREMENT
/begin MEASUREMENT O2St_flgCorrnPlausUsCat1B1 "Flag sensor dynamic correction of measurement storage capability is plausible for sensor upstream catalyst 1 bank 1" UBYTE B_TRUE 1 100 0.00 1.00000000000 BIT_MASK 0x1 FORMAT "%13.11" ECU_ADDRESS 0x6000B90C /end MEASUREMENT
/begin MEASUREMENT O2St_flgEnagMeas "Flag general enabling condition for measurement of oxygen storage capability" UBYTE B_TRUE 1 100 0.00 1.00000000000 BIT_MASK 0x1 FORMAT "%13.11" ECU_ADDRESS 0x70000268 /end MEASUREMENT
/begin MEASUREMENT O2St_flgEndMeasCat1B1 "Flag end of measurement storage capability catalyst 1 bank 1" UBYTE B_TRUE 1 100 0.00 1.00000000000 BIT_MASK 0x1 FORMAT "%13.11" ECU_ADDRESS 0x6000B90B /end MEASUREMENT
/begin MEASUREMENT O2St_flgEndMeasEmptyCat1B1 "Flag end of measurement storage capability with empty catalyst 1 bank 1" UBYTE B_TRUE 1 100 0.00 1.00000000000 BIT_MASK 0x1 FORMAT "%13.11" ECU_ADDRESS 0x6000B90A /end MEASUREMENT
/begin MEASUREMENT O2St_flgEndMeasFullCat1B1 "Flag end of measurement storage capability with full catalyst 1 bank 1" UBYTE B_TRUE 1 100 0.00 1.00000000000 BIT_MASK 0x1 FORMAT "%13.11" ECU_ADDRESS 0x6000B909 /end MEASUREMENT
/begin MEASUREMENT O2St_flgFcoMeasCat1B1 "Flag fuel cut off during OSC measurement catalyst 1 bank 1" UBYTE B_TRUE 1 100 0.00 1.00000000000 BIT_MASK 0x1 FORMAT "%13.11" ECU_ADDRESS 0x6000B908 /end MEASUREMENT
/begin MEASUREMENT O2St_flgIninCat1B1 "Flag initialisation integral storage capability catalyst 1 bank 1" UBYTE B_TRUE 1 100 0.00 1.00000000000 BIT_MASK 0x1 FORMAT "%13.11" ECU_ADDRESS 0x6000B907 /end MEASUREMENT
/begin MEASUREMENT O2St_flgMeasOscCat1B1 "Flag storage capability is measured momentarily catalyst 1 bank 1" UBYTE B_TRUE 1 100 0.00 1.00000000000 BIT_MASK 0x1 FORMAT "%13.11" ECU_ADDRESS 0x6000B906 /end MEASUREMENT
/begin MEASUREMENT O2St_flgMeasOscPlausCat1B1 "Flag measurement of storage capability is plausible catalyst 1 bank 1" UBYTE B_TRUE 1 100 0.00 1.00000000000 BIT_MASK 0x1 FORMAT "%13.11" ECU_ADDRESS 0x6000B905 /end MEASUREMENT
/begin MEASUREMENT O2St_flgMeasOscPlausGlb "Flag measurement of storage capability plausible global" UBYTE B_TRUE 1 100 0.00 1.00000000000 BIT_MASK 0x1 FORMAT "%13.11" ECU_ADDRESS 0x6000B904 /end MEASUREMENT
/begin MEASUREMENT O2St_flgOscMeasFavCat1B1 "Flag measurement of storage capability is favourable catalyst 1 bank 1" UBYTE B_TRUE 1 100 0.00 1.00000000000 BIT_MASK 0x1 FORMAT "%13.11" ECU_ADDRESS 0x6000B903 /end MEASUREMENT
/begin MEASUREMENT O2St_flgPrimO2MeasRelzd "Flag first OSC measurement is done on this trip" UBYTE B_TRUE 1 100 0.00 1.00000000000 BIT_MASK 0x1 FORMAT "%13.11" ECU_ADDRESS 0x6000B902 /end MEASUREMENT
/begin MEASUREMENT O2St_flgStrtMeasCat1B1 "Flag start of measurement storage capability catalyst 1 bank 1" UBYTE B_TRUE 1 100 0.00 1.00000000000 BIT_MASK 0x1 FORMAT "%13.11" ECU_ADDRESS 0x6000B901 /end MEASUREMENT
/begin MEASUREMENT O2St_flgStrtMeasEmptyCat1B1 "Flag start of measurement storage capability with empty catalyst 1 bank 1" UBYTE B_TRUE 1 100 0.00 1.00000000000 BIT_MASK 0x1 FORMAT "%13.11" ECU_ADDRESS 0x6000B900 /end MEASUREMENT
/begin MEASUREMENT O2St_flgStrtMeasFullCat1B1 "Flag start of measurement storage capability with full catalyst 1 bank 1" UBYTE B_TRUE 1 100 0.00 1.00000000000 BIT_MASK 0x1 FORMAT "%13.11" ECU_ADDRESS 0x6000B8FF /end MEASUREMENT
/begin MEASUREMENT O2St_flgUMonoAscCat1B1 "Flag sensor voltage rises monetary downstream catalyst 1 bank 1" UBYTE B_TRUE 1 100 0.00 1.00000000000 BIT_MASK 0x1 FORMAT "%13.11" ECU_ADDRESS 0x6000B8FE /end MEASUREMENT
/begin MEASUREMENT O2St_flgUSensHiDsCat1B1 "Flag sensor voltage is greater than threshold downstream catalyst 1 bank 1" UBYTE B_TRUE 1 100 0.00 1.00000000000 BIT_MASK 0x1 FORMAT "%13.11" ECU_ADDRESS 0x6000B8FD /end MEASUREMENT
/begin MEASUREMENT O2St_flgUSensLoDsCat1B1 "Flag sensor voltage is lower than threshold downstream catalyst 1 bank 1" UBYTE B_TRUE 1 100 0.00 1.00000000000 BIT_MASK 0x1 FORMAT "%13.11" ECU_ADDRESS 0x6000B8FC /end MEASUREMENT
/begin MEASUREMENT O2St_lenMlgLstO2Meas "Kilometer value at the last measurement of OSC" ULONG s_q1_km 1 100 0.00 4294967295.00 FORMAT "%13.2" ECU_ADDRESS 0x60039368 /end MEASUREMENT
/begin MEASUREMENT O2St_mO2CorrnDsCat1B1 "Correction of OSC-ROSC-measurement for sensor dynamic correction of sensor downstream catalyst 1 bank 1" SLONG m_q0p2_mg 1 100 -429496729.600 429496729.400 FORMAT "%13.3" ECU_ADDRESS 0x50001CB4 /end MEASUREMENT
/begin MEASUREMENT O2St_mO2CorrnUsCat1B1 "Correction of OSC-ROSC-measurement for sensor dynamic correction of sensor upstream catalyst 1 bank 1" SLONG m_q0p2_mg 1 100 -429496729.600 429496729.400 FORMAT "%13.3" ECU_ADDRESS 0x50001CB8 /end MEASUREMENT
/begin MEASUREMENT O2St_mO2IntglSlopDsCat1B1 "Slope of oxygen-integral OSC-ROSC-measurement for sensor dynamic correction of the sensor downstream catalyst 1 bank 1" SLONG m_q0p2_mg_DIV_s 1 100 -429496729.600 429496729.400 FORMAT "%13.3" ECU_ADDRESS 0x50001CBC /end MEASUREMENT
/begin MEASUREMENT O2St_mO2IntglSlopUsCat1B1 "Slope of oxygen-integral OSC-ROSC-measurement for sensor dynamic correction of the sensor upstream catalyst 1 bank 1" SLONG m_q0p2_mg_DIV_s 1 100 -429496729.600 429496729.400 FORMAT "%13.3" ECU_ADDRESS 0x50001CC0 /end MEASUREMENT
/begin MEASUREMENT O2St_mO2StrAgedCalcnCat1B1 "OSC (aged catalyst for calculation of the old value for filter) catalyst 1 bank 1" ULONG m_q0p1_mg 1 100 0.00 131072.000000 FORMAT "%13.6" ECU_ADDRESS 0x600029F4 /end MEASUREMENT
/begin MEASUREMENT O2St_mO2StrNewCalcnCat1B1 "Oxygen storage capability (new cat for calculation of the old value for filter) catalyst 1 bank 1" ULONG m_q0p1_mg 1 100 0.00 131072.000000 FORMAT "%13.6" ECU_ADDRESS 0x50001CC4 /end MEASUREMENT
/begin MEASUREMENT O2St_mOscAgedCat1B1 "Oxygen storage capability (old value) catalyst 1 bank 1" ULONG m_q0p1_mg 1 100 0.00 131072.000000 FORMAT "%13.6" ECU_ADDRESS 0x600029F0 /end MEASUREMENT
/begin MEASUREMENT O2St_mOscBefCorrnCat1B1 "Measured Oxygen storage capability before sensor dynamic correction, catalyst 1 bank 1" ULONG m_q0p1_mg 1 100 0.00 131072.000000 FORMAT "%13.6" ECU_ADDRESS 0x60013020 /end MEASUREMENT
/begin MEASUREMENT O2St_mOscCurrCat1B1 "Oxygen storge capability (current value from OSC or Rosc) catalyst 1 bank 1" ULONG m_q0p1_mg 1 100 0.00 429496729.500 FORMAT "%13.3" ECU_ADDRESS 0x50001CC8 /end MEASUREMENT
/begin MEASUREMENT O2St_mOscFildCat1B1 "Oxygen storage capability filtered catalyst 1 bank 1" ULONG m_q0p1_mg 1 100 0.00 262144.000000 FORMAT "%13.6" ECU_ADDRESS 0x600029EC /end MEASUREMENT
/begin MEASUREMENT O2St_mRoscBefCorrnCat1B1 "Measured Rosc of catalyst before sensor dynamic correction, catalyst 1 bank 1" ULONG m_q0p1_mg 1 100 0.00 131072.000000 FORMAT "%13.6" ECU_ADDRESS 0x60013024 /end MEASUREMENT
/begin MEASUREMENT O2St_OIntglAndTCalcnCat1B1_I.countt "Oxygen mass flow integral and actual mean temperature calculation for catalyst1 bank1 / time counter" UWORD dez 1 100 0.00 65535.00 FORMAT "%8.2" ECU_ADDRESS 0x50001C7C /end MEASUREMENT
/begin MEASUREMENT O2St_OIntglAndTCalcnCat1B1_I.dmAvgCurrMeas "Oxygen mass flow integral and actual mean temperature calculation for catalyst1 bank1 / mass flow reference" UWORD m_uw_b6553p5 1 100 0.00 6553.500 FORMAT "%8.3" ECU_ADDRESS 0x50001C7E /end MEASUREMENT
/begin MEASUREMENT O2St_OIntglAndTCalcnCat1B1_I.dmIntglUsCat "Oxygen mass flow integral and actual mean temperature calculation for catalyst1 bank1 / integrated mass flow upstream catalyst" UWORD m_q0p0277_g 1 100 0.00 1820.417 FORMAT "%8.3" ECU_ADDRESS 0x50001C80 /end MEASUREMENT
/begin MEASUREMENT O2St_OIntglAndTCalcnCat1B1_I.facLamAvrg "Oxygen mass flow integral and actual mean temperature calculation for catalyst1 bank1 / lambda reference" UWORD fak_q0p000244 1 100 0.00 15.99976 FORMAT "%8.5" ECU_ADDRESS 0x50001C82 /end MEASUREMENT
/begin MEASUREMENT O2St_OIntglAndTCalcnCat1B1_I.lavksum_l "Oxygen mass flow integral and actual mean temperature calculation for catalyst1 bank1 / lambda summation" ULONG fak_q0p000244 1 100 0.00 1048575.99976 FORMAT "%13.5" ECU_ADDRESS 0x50001C84 /end MEASUREMENT
/begin MEASUREMENT O2St_OIntglAndTCalcnCat1B1_I.mflowsum_l "Oxygen mass flow integral and actual mean temperature calculation for catalyst1 bank1 / mass flow summation" ULONG m_uw_b6553p5 1 100 0.00 429496729.500 FORMAT "%13.3" ECU_ADDRESS 0x50001C88 /end MEASUREMENT
/begin MEASUREMENT O2St_OIntglAndTCalcnCat1B1_I.tRef "Oxygen mass flow integral and actual mean temperature calculation for catalyst1 bank1 / temperature reference" UWORD temp_q0p0234_o273 1 100 -273.150 1262.827 FORMAT "%8.3" ECU_ADDRESS 0x50001C8C /end MEASUREMENT
/begin MEASUREMENT O2St_OIntglAndTCalcnCat1B1_I.tempsum_l "Oxygen mass flow integral and actual mean temperature calculation for catalyst1 bank1 / temperature summation" ULONG temp_q0p0234 1 100 0.00 100663295.977 FORMAT "%13.3" ECU_ADDRESS 0x50001C90 /end MEASUREMENT
/begin MEASUREMENT O2St_OIntglAndTCalcnCat1B1_I.tiMeas "Oxygen mass flow integral and actual mean temperature calculation for catalyst1 bank1 / Measurement duration storage capability catalyst" UWORD t_q0p02 1 100 0.00 1310.700 FORMAT "%8.3" ECU_ADDRESS 0x50001C94 /end MEASUREMENT
/begin MEASUREMENT O2St_OIntglAndTCalcnCat1B1_I.ExhMod_msintIK_I.memory "Oxygen mass flow integral and actual mean temperature calculation for catalyst1 bank1 / low pass filter oxygen mass flow / current integrator value" ULONG dez 1 100 0.00 4294967295.00 FORMAT "%13.2" ECU_ADDRESS 0x50001C98 /end MEASUREMENT
/begin MEASUREMENT O2St_OIntglAndTCalcnCat1B1_I.ExhMod_oxsIK_I.memory "Oxygen mass flow integral and actual mean temperature calculation for catalyst1 bank1 / low pass filter oxygen mass flow / current integrator value" FLOAT32_IEEE m_q1_mg 1 100 -1.00000000E+037 1.00000000E+037 FORMAT "%13.3" ECU_ADDRESS 0x50001C9C /end MEASUREMENT
/begin MEASUREMENT O2St_QryEndMeasCat1B1_I.flgEndMeasCat "Detection of end of oxygen storage capacity measurement in catalyst 1,bank 1 / Flag end of measurement storage capability catalyst" UBYTE B_TRUE 1 100 0.00 1.00000000000 BIT_MASK 0x1 FORMAT "%13.11" ECU_ADDRESS 0x500057B0 /end MEASUREMENT
/begin MEASUREMENT O2St_QryEndMeasCat1B1_I.flgEndMeasEmptyCat "Detection of end of oxygen storage capacity measurement in catalyst 1,bank 1 / Flag end of measurement storage capability with empty catalyst" UBYTE B_TRUE 1 100 0.00 1.00000000000 BIT_MASK 0x1 FORMAT "%13.11" ECU_ADDRESS 0x500057B1 /end MEASUREMENT
/begin MEASUREMENT O2St_QryEndMeasCat1B1_I.flgEndMeasFullCat "Detection of end of oxygen storage capacity measurement in catalyst 1,bank 1 / Flag end of measurement storage capability with full catalyst" UBYTE B_TRUE 1 100 0.00 1.00000000000 BIT_MASK 0x1 FORMAT "%13.11" ECU_ADDRESS 0x500057B2 /end MEASUREMENT
/begin MEASUREMENT O2St_QryEndMeasCat1B1_I.ExhMod_flgleanincatTOFFV_I.outbit "Detection of end of oxygen storage capacity measurement in catalyst 1,bank 1 / approval lean lambda at lambda sensor / Output Bit" UBYTE B_TRUE 1 100 0.00 1.00000000000 BIT_MASK 0x1 FORMAT "%13.11" ECU_ADDRESS 0x500057B4 /end MEASUREMENT
/begin MEASUREMENT O2St_QryEndMeasCat1B1_I.ExhMod_flgleanincatTOFFV_I.time "Detection of end of oxygen storage capacity measurement in catalyst 1,bank 1 / approval lean lambda at lambda sensor / Occured Time" UWORD t_q0p02 1 100 0.00 1310.700 FORMAT "%8.3" ECU_ADDRESS 0x500057B6 /end MEASUREMENT
/begin MEASUREMENT O2St_QryEndMeasCat1B1_I.ExhMod_flgrichincatTOFFV_I.outbit "Detection of end of oxygen storage capacity measurement in catalyst 1,bank 1 / approval rich lambda at lambda sensor / Output Bit" UBYTE B_TRUE 1 100 0.00 1.00000000000 BIT_MASK 0x1 FORMAT "%13.11" ECU_ADDRESS 0x500057B8 /end MEASUREMENT
/begin MEASUREMENT O2St_QryEndMeasCat1B1_I.ExhMod_flgrichincatTOFFV_I.time "Detection of end of oxygen storage capacity measurement in catalyst 1,bank 1 / approval rich lambda at lambda sensor / Occured Time" UWORD t_q0p02 1 100 0.00 1310.700 FORMAT "%8.3" ECU_ADDRESS 0x500057BA /end MEASUREMENT
/begin MEASUREMENT O2St_QryEndMeasCat1B1_I.ExhMod_flgsenshighER_I.buffer "Detection of end of oxygen storage capacity measurement in catalyst 1,bank 1 / approval no oxygen content within catalyst / rising edge detected" UBYTE B_TRUE 1 100 0.00 1.00000000000 BIT_MASK 0x1 FORMAT "%13.11" ECU_ADDRESS 0x500057BC /end MEASUREMENT
/begin MEASUREMENT O2St_QryEndMeasCat1B1_I.ExhMod_flgsenshighER_I.oldSignal "Detection of end of oxygen storage capacity measurement in catalyst 1,bank 1 / approval no oxygen content within catalyst / flag rising edge" UBYTE B_TRUE 1 100 0.00 1.00000000000 BIT_MASK 0x1 FORMAT "%13.11" ECU_ADDRESS 0x500057BD /end MEASUREMENT
/begin MEASUREMENT O2St_QryEndMeasCat1B1_I.ExhMod_flgsenslowER_I.buffer "Detection of end of oxygen storage capacity measurement in catalyst 1,bank 1 / approval catalyst completly filled with oxygen / rising edge detected" UBYTE B_TRUE 1 100 0.00 1.00000000000 BIT_MASK 0x1 FORMAT "%13.11" ECU_ADDRESS 0x500057BE /end MEASUREMENT
/begin MEASUREMENT O2St_QryEndMeasCat1B1_I.ExhMod_flgsenslowER_I.oldSignal "Detection of end of oxygen storage capacity measurement in catalyst 1,bank 1 / approval catalyst completly filled with oxygen / flag rising edge" UBYTE B_TRUE 1 100 0.00 1.00000000000 BIT_MASK 0x1 FORMAT "%13.11" ECU_ADDRESS 0x500057BF /end MEASUREMENT
/begin MEASUREMENT O2St_QryStrtMeasCat1B1_I.flgStrtMeas "Check for start of measurement of oxygen storage capacity in catalyst 1,bank 1 / Flag start of measurement storage capability catalyst" UBYTE B_TRUE 1 100 0.00 1.00000000000 BIT_MASK 0x1 FORMAT "%13.11" ECU_ADDRESS 0x60007790 /end MEASUREMENT
/begin MEASUREMENT O2St_QryStrtMeasCat1B1_I.flgStrtMeasEmpty "Check for start of measurement of oxygen storage capacity in catalyst 1,bank 1 / Flag start of measurement storage capability with empty catalyst" UBYTE B_TRUE 1 100 0.00 1.00000000000 BIT_MASK 0x1 FORMAT "%13.11" ECU_ADDRESS 0x60007791 /end MEASUREMENT
/begin MEASUREMENT O2St_QryStrtMeasCat1B1_I.flgStrtMeasFull "Check for start of measurement of oxygen storage capacity in catalyst 1,bank 1 / Flag start of measurement storage capability with full catalyst" UBYTE B_TRUE 1 100 0.00 1.00000000000 BIT_MASK 0x1 FORMAT "%13.11" ECU_ADDRESS 0x60007792 /end MEASUREMENT
/begin MEASUREMENT O2St_QryStrtMeasCat1B1_I.ExhMod_leaninER_I.buffer "Check for start of measurement of oxygen storage capacity in catalyst 1,bank 1 / approval lean lambda at lambda sensor / rising edge detected" UBYTE B_TRUE 1 100 0.00 1.00000000000 BIT_MASK 0x1 FORMAT "%13.11" ECU_ADDRESS 0x60007794 /end MEASUREMENT
/begin MEASUREMENT O2St_QryStrtMeasCat1B1_I.ExhMod_leaninER_I.oldSignal "Check for start of measurement of oxygen storage capacity in catalyst 1,bank 1 / approval lean lambda at lambda sensor / flag rising edge" UBYTE B_TRUE 1 100 0.00 1.00000000000 BIT_MASK 0x1 FORMAT "%13.11" ECU_ADDRESS 0x60007795 /end MEASUREMENT
/begin MEASUREMENT O2St_QryStrtMeasCat1B1_I.ExhMod_richinER_I.buffer "Check for start of measurement of oxygen storage capacity in catalyst 1,bank 1 / approval rich lambda at lambda sensor / rising edge detected" UBYTE B_TRUE 1 100 0.00 1.00000000000 BIT_MASK 0x1 FORMAT "%13.11" ECU_ADDRESS 0x60007796 /end MEASUREMENT
/begin MEASUREMENT O2St_QryStrtMeasCat1B1_I.ExhMod_richinER_I.oldSignal "Check for start of measurement of oxygen storage capacity in catalyst 1,bank 1 / approval rich lambda at lambda sensor / flag rising edge" UBYTE B_TRUE 1 100 0.00 1.00000000000 BIT_MASK 0x1 FORMAT "%13.11" ECU_ADDRESS 0x60007797 /end MEASUREMENT
/begin MEASUREMENT O2St_ratLamAvrgCat1B1 "Average lambda value during current measurement of oxygen storage capability catalyst 1 bank 1" UWORD fak_q0p000244 1 100 0.00 15.99976 FORMAT "%8.5" ECU_ADDRESS 0x600077B4 /end MEASUREMENT
/begin MEASUREMENT O2St_ratO2StrLocCat1B1 "OSC correction factor catalyst 1, non volatile" UBYTE fak_ub_b2 1 100 0.00 1.992188 FORMAT "%8.6" ECU_ADDRESS 0x60039366 /end MEASUREMENT
/begin MEASUREMENT O2St_SetOscRoscExtdCat1B1_I.dmAvrgMeasCurr "Check for end of measurement of oxygen storage capacity detection in catalyst 1,bank 1 / Average mass flow of current measurement storage capability catalyst" UWORD m_uw_b6553p5 1 100 0.00 6553.500 FORMAT "%8.3" ECU_ADDRESS 0x50001CA0 /end MEASUREMENT
/begin MEASUREMENT O2St_SetOscRoscExtdCat1B1_I.flgOscMeasd "Check for end of measurement of oxygen storage capacity detection in catalyst 1,bank 1 / Flag current oxygen storage capability measured catalyst" UBYTE B_TRUE 1 100 0.00 1.00000000000 BIT_MASK 0x1 FORMAT "%13.11" ECU_ADDRESS 0x50001CA2 /end MEASUREMENT
/begin MEASUREMENT O2St_SetOscRoscExtdCat1B1_I.flgRoscMeasd "Check for end of measurement of oxygen storage capacity detection in catalyst 1,bank 1 / Flag current oxygen storage capability measured catalyst" UBYTE B_TRUE 1 100 0.00 1.00000000000 BIT_MASK 0x1 FORMAT "%13.11" ECU_ADDRESS 0x50001CA3 /end MEASUREMENT
/begin MEASUREMENT O2St_SetOscRoscExtdCat1B1_I.mOscBefCorrnCat "Check for end of measurement of oxygen storage capacity detection in catalyst 1,bank 1 / Measured Oxygen storage capability before sensor dynamic correction, catalyst" ULONG m_q0p1_mg 1 100 0.00 131072.000000 FORMAT "%13.6" ECU_ADDRESS 0x50001CA4 /end MEASUREMENT
/begin MEASUREMENT O2St_SetOscRoscExtdCat1B1_I.mRoscBefCorrnCat "Check for end of measurement of oxygen storage capacity detection in catalyst 1,bank 1 / Measured Rosc of catalyst before sensor dynamic correction, catalyst" ULONG m_q0p1_mg 1 100 0.00 131072.000000 FORMAT "%13.6" ECU_ADDRESS 0x50001CA8 /end MEASUREMENT
/begin MEASUREMENT O2St_SetOscRoscExtdCat1B1_I.tAvrgMeas "Check for end of measurement of oxygen storage capacity detection in catalyst 1,bank 1 / Average temperature during the last measurement storage capability catalyst" UWORD temp_q0p0234_o273 1 100 -273.150 1262.827 FORMAT "%8.3" ECU_ADDRESS 0x50001CAC /end MEASUREMENT
/begin MEASUREMENT O2St_SetOscRoscExtdCat1B1_I.tiMeasCat "Check for end of measurement of oxygen storage capacity detection in catalyst 1,bank 1 / Measurement duration storage capability catalyst" UWORD t_q0p02 1 100 0.00 1310.700 FORMAT "%8.3" ECU_ADDRESS 0x50001CAE /end MEASUREMENT
/begin MEASUREMENT O2St_stSycSubOld "ECU state during last calculation" UBYTE dez 1 100 0.00 255.0 FORMAT "%5.1" ECU_ADDRESS 0x6000B8FB /end MEASUREMENT
/begin MEASUREMENT O2St_tAvrgMeasCat1B1 "Average temperature during the last measurement storage capability catalyst 1 bank 1" UWORD temp_q0p0234_o273 1 100 -273.150 1262.827 FORMAT "%8.3" ECU_ADDRESS 0x60013D84 /end MEASUREMENT
/begin MEASUREMENT O2St_tEndMeasCat1B1 "Temperature at the end of the last measurement of OSC catalyst 1" UWORD temp_q0p0234_o273 1 100 -273.150 1262.827 FORMAT "%8.3" ECU_ADDRESS 0x600077B2 /end MEASUREMENT
/begin MEASUREMENT O2St_TestMeasFav.flgOscMeasFav "Class to check successful OSC measurement / Measurement storage capacity succesful" UBYTE B_TRUE 1 100 0.00 1.00000000000 BIT_MASK 0x1 FORMAT "%13.11" ECU_ADDRESS 0x6000B8FA /end MEASUREMENT
/begin MEASUREMENT O2St_tiCorrnDsCat1B1 "Correction time for measurement of storage capability of catalyst for sensor downstream catalyst 1 bank 1" UWORD t_q0p01 1 100 0.00 655.3500 FORMAT "%8.4" ECU_ADDRESS 0x600077B0 /end MEASUREMENT
/begin MEASUREMENT O2St_tiCorrnUsCat1B1 "Correction time for measurement of storage capability of catalyst for sensor upstream catalyst 1 bank 1" UWORD t_q0p01 1 100 0.00 655.3500 FORMAT "%8.4" ECU_ADDRESS 0x600077AE /end MEASUREMENT
/begin MEASUREMENT O2St_tiDlyLeanRichDsCat1B1 "Time delay (transition lean-rich) for measurement of storage capability of sensor downstream catalyst 1 bank 1" UWORD t_q0p01 1 100 0.00 655.3500 FORMAT "%8.4" ECU_ADDRESS 0x600077AC /end MEASUREMENT
/begin MEASUREMENT O2St_tiDlyRichLeanDsCat1B1 "Time delay (transition rich-lean) for measurement of storage capability of sensor downstream catalyst 1 bank 1" UWORD t_q0p01 1 100 0.00 655.3500 FORMAT "%8.4" ECU_ADDRESS 0x600077AA /end MEASUREMENT
/begin MEASUREMENT O2St_tiMeasCat1B1 "Measurement duration storage capability catalyst 1 bank 1" UWORD t_q0p02 1 100 0.00 1310.700 FORMAT "%8.3" ECU_ADDRESS 0x60013D8A /end MEASUREMENT
/begin MEASUREMENT O2St_tiMeasIntCat1B1 "Measurement duration storage capability (internal value) catalyst 1 bank 1" UWORD t_q0p02 1 100 0.00 1310.700 FORMAT "%8.3" ECU_ADDRESS 0x60013D8C /end MEASUREMENT
/begin MEASUREMENT O2St_tIntCat1B1 "internal temperature catalyst 1" UWORD temp_q0p0234_o273 1 100 -273.150 1262.827 FORMAT "%8.3" ECU_ADDRESS 0x600077A8 /end MEASUREMENT
/begin MEASUREMENT O2St_tIntCat2B1 "internal temperature catalyst 2" UWORD temp_q0p0234_o273 1 100 -273.150 1262.827 FORMAT "%8.3" ECU_ADDRESS 0x60013D86 /end MEASUREMENT
/begin MEASUREMENT O2St_tiTranLeanRichDsCat1B1 "Transition time (lean-rich) for measurement of storage capability catalyst of sensor downstream catalyst 1 bank 1" UWORD t_q0p01 1 100 0.00 655.3500 FORMAT "%8.4" ECU_ADDRESS 0x600077A6 /end MEASUREMENT
/begin MEASUREMENT O2St_tiTranRichLeanDsCat1B1 "Transition time (rich-lean) for measurement of storage capability catalyst of sensor downstream catalyst 1 bank 1" UWORD t_q0p01 1 100 0.00 655.3500 FORMAT "%8.4" ECU_ADDRESS 0x600077A4 /end MEASUREMENT
/begin MEASUREMENT O2St_tRefCat1B1 "reference temperature catalyst 1 bank 1" UWORD temp_q0p0234_o273 1 100 -273.150 1262.827 FORMAT "%8.3" ECU_ADDRESS 0x60013D88 /end MEASUREMENT
/begin MEASUREMENT O2St_tStrtMeasCat1B1 "Temperature at the start of the last measurement of OSC catalyst 1" UWORD temp_q0p0234_o273 1 100 -273.150 1262.827 FORMAT "%8.3" ECU_ADDRESS 0x600077A2 /end MEASUREMENT
/begin MEASUREMENT O2St_uCat1DsMaxB1 "Maximum measured voltage before start of measurement downstream catalyst 1 bank 1" UWORD spg_uw_q0p00488 1 100 0.00 319.9951 FORMAT "%8.4" ECU_ADDRESS 0x600077A0 /end MEASUREMENT
/begin MEASUREMENT O2St_uCat1DsStrtB1 "Measured voltage at start of measurement downstream catalyst 1 bank 1" UWORD spg_uw_q0p00488 1 100 0.00 319.9951 FORMAT "%8.4" ECU_ADDRESS 0x6000779E /end MEASUREMENT
/begin MEASUREMENT O2St_uSensMaxCat1B1 "Maximum mesured voltage as interim value for evalutation of the slope of sensor voltage downstream of catalyst 1 bank 1" UWORD spg_uw_q0p00488 1 100 0.00 319.9951 FORMAT "%8.4" ECU_ADDRESS 0x60013D8E /end MEASUREMENT
/begin MEASUREMENT O2St_uSensRefCat1B1 "Reference value for evaluation of the sensor voltage downstream catalyst 1 bank 1" UWORD spg_uw_q0p00488 1 100 0.00 319.9951 FORMAT "%8.4" ECU_ADDRESS 0x60013D90 /end MEASUREMENT
/begin FUNCTION ExhMod_O2StorgMdl "1.24.0    Modelling of Oxygen Storage Capacity"
 /begin DEF_CHARACTERISTIC O2St_mfO2ThdStoi_C O2St_uDeltaDecMaxSensHi_C O2St_uDeltaDecMax_C O2St_uDeltaIncMin_C O2St_tiConMFlowEna_C ExhMod_stOsc_C O2St_dmMaxThdMeasCat1_C O2St_dmMinThdMeasCat1_C O2St_facAgiAgedCat_C O2St_facCorrnDlyLeanRichDsCat1_T O2St_facCorrnDlyRichLeanDsCat1_T O2St_facCorrnMfLamCat1B1_M O2St_facCorrnMissSensDsCat2_T O2St_facCorrnTranLeanRichDsCat1_T O2St_facCorrnTranRichLeanDsCat1_T O2St_facCorrO2StorgUCat1_T O2St_facIninOscCorrnCat1_C O2St_facIninOscCorrnCat2_C O2St_facMaxThdLamCtrl_C O2St_facMinThdLamCtrl_C O2St_facOscFilDiag_C O2St_facOscFilMax_C O2St_facOscFilMin_C O2St_facRoscOscCat1_T O2St_facRoscOscSecFuCat1_T O2St_facTiCorrnSnsrAftCat_C O2St_facTiCorrnSnsrBefCat_C O2St_lenMlgO2Meas_C O2St_mMaxThdMeasCat1_C O2St_mOscAgedCat1B1_M O2St_mOscAgedCat2B1_M O2St_mOscAgedSecFuCat1B1_M O2St_mOscNewCat1B1_M O2St_mOscNewCat2B1_M O2St_mOscNewSecFuCat1B1_M O2St_SpareRatO2StrCat1_C O2St_stApplMod_C O2St_stEngStopPhd_C O2St_stOscCatDiag_C O2St_stOscMeas_C O2St_stOscRosc_C O2St_tDeltaMaxMeasCat1_C O2St_tiDlyEnagOscCat1_C O2St_tiDlyMaxS1_C O2St_tiMaxMeasOscCat1_C O2St_tiThdStrtMeas_C O2St_tiTranDecelCat1_C O2St_tiTranDecelMeas_C O2St_tiTranMaxS1_C O2St_tMaxThdMeasCat1_C O2St_tMaxThdMeasHysCat1_C O2St_tMinThdMeasCat1_C O2St_tMinThdMeasHysCat1_C O2St_uThdCat1DsO2EmptyB1_C O2St_uThdCat1DsO2FullB1_C /end DEF_CHARACTERISTIC
 /begin IN_MEASUREMENT B_ll_msg B_sa_msg B_sbblsu_msg Eep_EnvRamInvld EGSDO2_tiDlyAdpnS1B1 EGSDO2_tiTranAdpnS1B1 EGSDU_tiS2B1LtrDlyEvln EGSDU_tiS2B1LtrTranEvln EGSDU_tiS2B1RtlDlyEvln EGSDU_tiS2B1RtlTranEvln EngStrt_bFrstStrtEnd EngStrt_bStrtEnd ExhMod_facIntrpnGslSecFu ExhMod_flgLSEnaCat1B1 ExhMod_mfExhCat1B1 ExhMod_mfExhCat2B1 ExhMod_mfExhWoFuUsCat1B1 ExhMod_mfO2Cat1B1 ExhMod_rLamCat1UsB1 ExhMod_tCat1AvrgB1 ExhMod_tCat1B1 ExhMod_tCat2AvrgB1 ExhMod_tCat2B1 ExhMod_uCat1DsB1 fr_w_msg kmstand_l_msg SyC_stSub tnse_w_msg TWCD_flgPtlMeasOSCFinB1 TWCD_flgPtlMeasRSCFinB1 TWCD_mOscPtlCorrdExtdCat1B1 TWCD_mRscPtlCorrdExtdCat1B1 /end IN_MEASUREMENT
 /begin OUT_MEASUREMENT ExhMod_flgEmptyO2Cat1B1 ExhMod_flgEngStopPhdO2Str ExhMod_flgFullO2Cat1B1 ExhMod_flgInhbnCat1B1 ExhMod_flgInhbnCat2B1 ExhMod_flgInpMfLeanCat1B1 ExhMod_flgInpMfRichCat1B1 ExhMod_flgO2MeasRdyCat1B1 ExhMod_flgOscMeasdCat1B1 ExhMod_flgRoscMeasdCat1B1 ExhMod_flgSucOscMeasmtCat1B1 ExhMod_mO2IntglCat1B1 ExhMod_mO2StrAgedCat1B1 ExhMod_mO2StrAgedCat2B1 ExhMod_mO2StrAgedExtdCat1B1 ExhMod_mO2StrAgedExtdCat2B1 ExhMod_mO2StrCat1B1 ExhMod_mO2StrCat2B1 ExhMod_mO2StrExtdCat1B1 ExhMod_mO2StrExtdCat2B1 ExhMod_mO2StrNewCat1B1 ExhMod_mO2StrNewCat2B1 ExhMod_mO2StrNewExtdCat1B1 ExhMod_mO2StrNewExtdCat2B1 ExhMod_mOscMeasdCat1B1 ExhMod_mOscMeasdExtdCat1B1 ExhMod_mRoscMeasdCat1B1 ExhMod_mRoscMeasdExtdCat1B1 ExhMod_ratO2StorgCatB1_a ExhMod_ratO2StrCat1B1 ExhMod_ratO2StrCat1MinBnk ExhMod_ratO2StrCatAryB1 /end OUT_MEASUREMENT
 /begin LOC_MEASUREMENT ExhMod_flgEndMeasCat1B1ER_I.buffer ExhMod_flgEndMeasCat1B1ER_I.oldSignal ExhMod_flgPasOSCMeasmt ExhMod_flgStrtMeasCat1B1ER_I.buffer ExhMod_flgStrtMeasCat1B1ER_I.oldSignal ExhMod_ratO2StorgCalCat1B1 ExhMod_ratO2StorgCalCat2B1 O2St_CalcnOscCorrnCat1B1_I.flgO2StrCalcd O2St_CalcnOscCorrnCat1B1_I.flgRoscMeasd O2St_CalcnOscCorrnCat1B1_I.mOscMeasd O2St_CalcnOscCorrnCat1B1_I.mRoscMeasd O2St_CalcnOscCurrExtd_I.mOscCurr O2St_CalcnRichLeanCat1B1_I.flgEmptyO2 O2St_CalcnRichLeanCat1B1_I.flgFullO2 O2St_CalcnRichLeanCat1B1_I.flgInpMfLean O2St_CalcnRichLeanCat1B1_I.flgInpMfRich O2St_CalcnRichLeanCat1B1_I.flgUMonoAsc O2St_CalcnRichLeanCat1B1_I.flgUSensHi O2St_CalcnRichLeanCat1B1_I.flgUSensLo O2St_CalcnRichLeanCat1B1_I.uSensMax O2St_CalcnRichLeanCat1B1_I.uSensRef O2St_CalcnSensDynCorrn.flgCorrnPlausDsCat O2St_CalcnSensDynCorrn.flgCorrnPlausUsCat O2St_CalcnSensDynCorrn.mO2CorrnDsCat O2St_CalcnSensDynCorrn.mO2CorrnUsCat O2St_CalcnSlopOIntglCat1B1_I.mO2IntglSlopDsCat1 O2St_CalcnSlopOIntglCat1B1_I.mO2IntglSlopUsCat1 O2St_CalcnSlopOIntglCat1B1_I.oxsbuf_l O2St_CalcnSlopOIntglCat1B1_I.oxscounter O2St_CalcnSlopOIntglCat1B1_I.pointer O2St_CalcnUMaxBefOscCat1B1_I.uCatDsMax O2St_CatEnaCdnCat1B1_I.ExhMod_flgIntHLR_I.hysterese O2St_CatEnaCdnCat1B1_I.ExhMod_flgtempTON_I.buffer O2St_CatEnaCdnCat1B1_I.ExhMod_flgtempTON_I.time O2St_CatEnaCdnCat1B1_I.ExhMod_msabLT_I.memory O2St_ChkPlausEndMeasCat1B1_I.flgMeasOsc O2St_ChkPlausEndMeasCat1B1_I.flgMeasOscPlaus O2St_ChkPlausEndMeasCat1B1_I.ExhMod_flgmeasbreakTONV_I.outbit O2St_ChkPlausEndMeasCat1B1_I.ExhMod_flgmeasbreakTONV_I.time O2St_cntrOscCurrUpdCat1B1 O2St_dmAvrgCurrMeasCat1B1 O2St_dmAvrgMeasCurrCat1B1 O2St_dmIntglUsCat1B1 O2St_flgClr O2St_flgCorrnPlausDsCat1B1 O2St_flgCorrnPlausUsCat1B1 O2St_flgEnagMeas O2St_flgEndMeasCat1B1 O2St_flgEndMeasEmptyCat1B1 O2St_flgEndMeasFullCat1B1 O2St_flgFcoMeasCat1B1 O2St_flgIninCat1B1 O2St_flgMeasOscCat1B1 O2St_flgMeasOscPlausCat1B1 O2St_flgMeasOscPlausGlb O2St_flgOscMeasFavCat1B1 O2St_flgPrimO2MeasRelzd O2St_flgStrtMeasCat1B1 O2St_flgStrtMeasEmptyCat1B1 O2St_flgStrtMeasFullCat1B1 O2St_flgUMonoAscCat1B1 O2St_flgUSensHiDsCat1B1 O2St_flgUSensLoDsCat1B1 O2St_lenMlgLstO2Meas O2St_mO2CorrnDsCat1B1 O2St_mO2CorrnUsCat1B1 O2St_mO2IntglSlopDsCat1B1 O2St_mO2IntglSlopUsCat1B1 O2St_mO2StrAgedCalcnCat1B1 O2St_mO2StrNewCalcnCat1B1 O2St_mOscAgedCat1B1 O2St_mOscBefCorrnCat1B1 O2St_mOscCurrCat1B1 O2St_mOscFildCat1B1 O2St_mRoscBefCorrnCat1B1 O2St_OIntglAndTCalcnCat1B1_I.countt O2St_OIntglAndTCalcnCat1B1_I.dmAvgCurrMeas O2St_OIntglAndTCalcnCat1B1_I.dmIntglUsCat O2St_OIntglAndTCalcnCat1B1_I.facLamAvrg O2St_OIntglAndTCalcnCat1B1_I.lavksum_l O2St_OIntglAndTCalcnCat1B1_I.mflowsum_l O2St_OIntglAndTCalcnCat1B1_I.tRef O2St_OIntglAndTCalcnCat1B1_I.tempsum_l O2St_OIntglAndTCalcnCat1B1_I.tiMeas O2St_OIntglAndTCalcnCat1B1_I.ExhMod_msintIK_I.memory O2St_OIntglAndTCalcnCat1B1_I.ExhMod_oxsIK_I.memory O2St_QryEndMeasCat1B1_I.flgEndMeasCat O2St_QryEndMeasCat1B1_I.flgEndMeasEmptyCat O2St_QryEndMeasCat1B1_I.flgEndMeasFullCat O2St_QryEndMeasCat1B1_I.ExhMod_flgleanincatTOFFV_I.outbit O2St_QryEndMeasCat1B1_I.ExhMod_flgleanincatTOFFV_I.time O2St_QryEndMeasCat1B1_I.ExhMod_flgrichincatTOFFV_I.outbit O2St_QryEndMeasCat1B1_I.ExhMod_flgrichincatTOFFV_I.time O2St_QryEndMeasCat1B1_I.ExhMod_flgsenshighER_I.buffer O2St_QryEndMeasCat1B1_I.ExhMod_flgsenshighER_I.oldSignal O2St_QryEndMeasCat1B1_I.ExhMod_flgsenslowER_I.buffer O2St_QryEndMeasCat1B1_I.ExhMod_flgsenslowER_I.oldSignal O2St_QryStrtMeasCat1B1_I.flgStrtMeas O2St_QryStrtMeasCat1B1_I.flgStrtMeasEmpty O2St_QryStrtMeasCat1B1_I.flgStrtMeasFull O2St_QryStrtMeasCat1B1_I.ExhMod_leaninER_I.buffer O2St_QryStrtMeasCat1B1_I.ExhMod_leaninER_I.oldSignal O2St_QryStrtMeasCat1B1_I.ExhMod_richinER_I.buffer O2St_QryStrtMeasCat1B1_I.ExhMod_richinER_I.oldSignal O2St_ratLamAvrgCat1B1 O2St_ratO2StrLocCat1B1 O2St_SetOscRoscExtdCat1B1_I.dmAvrgMeasCurr O2St_SetOscRoscExtdCat1B1_I.flgOscMeasd O2St_SetOscRoscExtdCat1B1_I.flgRoscMeasd O2St_SetOscRoscExtdCat1B1_I.mOscBefCorrnCat O2St_SetOscRoscExtdCat1B1_I.mRoscBefCorrnCat O2St_SetOscRoscExtdCat1B1_I.tAvrgMeas O2St_SetOscRoscExtdCat1B1_I.tiMeasCat O2St_stSycSubOld O2St_tAvrgMeasCat1B1 O2St_tEndMeasCat1B1 O2St_TestMeasFav.flgOscMeasFav O2St_tiCorrnDsCat1B1 O2St_tiCorrnUsCat1B1 O2St_tiDlyLeanRichDsCat1B1 O2St_tiDlyRichLeanDsCat1B1 O2St_tiMeasCat1B1 O2St_tiMeasIntCat1B1 O2St_tIntCat1B1 O2St_tIntCat2B1 O2St_tiTranLeanRichDsCat1B1 O2St_tiTranRichLeanDsCat1B1 O2St_tRefCat1B1 O2St_tStrtMeasCat1B1 O2St_uCat1DsMaxB1 O2St_uCat1DsStrtB1 O2St_uSensMaxCat1B1 O2St_uSensRefCat1B1 /end LOC_MEASUREMENT
 FUNCTION_VERSION "1.24.0" /end FUNCTION
/begin FUNCTION ExhMod_PMdl "1.31.0    Calculation Of Pressure In Exhaust System From Ambient To Upstream First Cat"
 /begin DEF_CHARACTERISTIC ExhMod_coeffPDifCatDsT_T ExhMod_coeffPDiffCatTB1_M ExhMod_nrIterPDiffCat_C ExhMod_pDifCatDsMflow_T ExhMod_pDiffCatMFlow_M ExhMod_pEnvDiffAppl_C ExhMod_rFlowSilLnrB1_C ExhMod_rFlowSilQdrtcB1_C ExhMod_stPMdl_C /end DEF_CHARACTERISTIC
 /begin IN_MEASUREMENT ExhMod_idxFrtBrickCatAryB1 ExhMod_idxLstBrickCatAryB1 ExhMod_mfExhCatAryB1 ExhMod_nrBrickCatAryB1 ExhMod_nrCatB1 ExhMod_tCatAvrgAryB1 ExhMod_tExhCat2DsB1 ExhMod_tExhCatDsAryB1 PEnv_p SyC_stSub /end IN_MEASUREMENT
 /begin OUT_MEASUREMENT ExhMod_pDsLstCat ExhMod_pEnvAppl ExhMod_pExhAryB1 ExhMod_pExhCat1UsB1 ExhMod_pExhCat2UsB1 /end OUT_MEASUREMENT
 /begin LOC_MEASUREMENT ExhMod_coeffPDiffCatTB1Ary ExhMod_pDifDsLstCat ExhMod_pDiffCatMFlowAry ExhMod_pExhCatUsAryB1 ExhMod_pExhUsSilB1 ExhMod_rFlowPMdlLnrB1 ExhMod_rFlowPMdlQdrtcB1 ExhMod_vfDsLstCatB1 /end LOC_MEASUREMENT
 FUNCTION_VERSION "1.31.0" /end FUNCTION
/begin FUNCTION ExhMod_PwrReactnMapBasd "1.16.0    Calculation of map-based reaction heat in exhaust system"
 /begin DEF_CHARACTERISTIC ExhMod_egyEnthCmbHcCco_C ExhMod_egyEnthHcCco_C ExhMod_facCatAgiPwrExo_M ExhMod_facDistbnTDeltaExo_M ExhMod_facEffCcoReacn_M ExhMod_facEffEngOffReactn_T ExhMod_facEffFcoReacnLamAvrg_M ExhMod_facEffFcoReacn_M ExhMod_facEffTranReactnLamAvrg_M ExhMod_facEffTranReactn_M ExhMod_facExoCorrnIgnAgHomB1_T ExhMod_facExoCorrnIgnAgHomCatHeatgB1_T ExhMod_facExoCorrnIgnAgHomCatHeatgSecFuB1_T ExhMod_facExoCorrnIgnAgHomCatHeatSustB1_T ExhMod_facExoCorrnIgnAgHomCatHeatSustSecFuB1_T ExhMod_facExoCorrnIgnAgHomSecFuB1_T ExhMod_facExoCorrnIgnAgHspB1_T ExhMod_facExoCorrnIgnAgHspCatHeatgB1_T ExhMod_facExoCorrnIgnAgHspCatHeatgSecFuB1_T ExhMod_facExoCorrnIgnAgHspCatHeatSustB1_T ExhMod_facExoCorrnIgnAgHspCatHeatSustSecFuB1_T ExhMod_facExoCorrnIgnAgHspSecFuB1_T ExhMod_facExoCorrnLamB1_M ExhMod_facExoCorrnLamCngB1_M ExhMod_facWghtMnfldCatExoCcoLam_M ExhMod_facWghtMnfldCatExoCcoTB1_T ExhMod_flgActvtExoCalcnEngOff_C ExhMod_flgActvtExoCalcnTranLtr_C ExhMod_flgActvtExoCalcnTranRtl_C ExhMod_mfEngOffMin_C ExhMod_pwrEngOffB1_C ExhMod_ratLamLeanFco_C ExhMod_ratLamThdLeanLtr_C ExhMod_ratLamThdLeanRtl_C ExhMod_ratLamThdRichLtr_C ExhMod_ratLamThdRichRtl_C ExhMod_stExoCalcnActvTransLtr_C ExhMod_stExoCat1Br1_C ExhMod_stPwrReactnMapBasd1_C ExhMod_stPwrReactnMapBasd2_C ExhMod_stPwrReactnMapBasd3_C ExhMod_stPwrReactnMapBasd_C ExhMod_tDeltaExoColdCatB1_CA ExhMod_tDeltaExoFco_M ExhMod_tDeltaExoHomB1_M ExhMod_tDeltaExoHomCatHeatgSecFuB1_M ExhMod_tDeltaExoHomCatHeatSustSecFuB1_M ExhMod_tDeltaExoHomSecFuB1_M ExhMod_tDeltaExoHspB1_M ExhMod_tDeltaExoHspCatHeatgB1_M ExhMod_tDeltaExoHspCatHeatgSecFuB1_M ExhMod_tDeltaExoHspCatHeatSustB1_M ExhMod_tDeltaExoHspCatHeatSustSecFuB1_M ExhMod_tDeltaExoHspSecFuB1_M ExhMod_tDeltaExoTotHomB1_M ExhMod_tDeltaExoTotHomCatHeatgB1_M ExhMod_tDeltaExoTotHomCatHeatgSecFuB1_M ExhMod_tDeltaExoTotHomCatHeatSustB1_M ExhMod_tDeltaExoTotHomCatHeatSustSecFuB1_M ExhMod_tDeltaExoTotHomSecFuB1_M ExhMod_tDeltaExoTotHspB1_M ExhMod_tDeltaExoTotHspCatHeatgB1_M ExhMod_tDeltaExoTotHspCatHeatgSecFuB1_M ExhMod_tDeltaExoTotHspCatHeatSustB1_M ExhMod_tDeltaExoTotHspCatHeatSustSecFuB1_M ExhMod_tDeltaExoTotHspSecFuB1_M ExhMod_tDeltaExoTranLtr_M ExhMod_tDeltaExoTranLtr_T ExhMod_tDeltaExoTranRtl_M ExhMod_tiConExoCco_T ExhMod_tiConExoEngOff_C ExhMod_tiConExoFco_T ExhMod_tiConExoNoFco_T ExhMod_tiConExoTranLtr_T ExhMod_tiConExoTranRtl_T ExhMod_tiConLamAvrg_T ExhMod_tIgnDeltaCatAgi_M ExhMod_tThdIgnCatB1_CA /end DEF_CHARACTERISTIC
 /begin IN_MEASUREMENT AirMod_ratChrgAirCyl B_bevab_msg B_khakt_msg B_khakw_msg B_sa_msg CoEOM_flgHsp Epm_nEng Epm_stSpd ExhMod_effIgnAgAvrgB1 ExhMod_facIntrpnGslSecFu ExhMod_idxFrtBrickCatAryB1 ExhMod_idxLstBrickCatAryB1 ExhMod_mfAirB1 ExhMod_mfExhAryB1 ExhMod_mfExhVlvB1 ExhMod_nrBrickCatAryB1 ExhMod_ratO2StrCatAryB1 ExhMod_rLamCatUsAryB1 ExhMod_tExhAryB1 ExhMod_tExhDsVlvB1 lamsbg_w_msg lamsons_w_msg redistb1_msg UEGO_rLamS1B1 /end IN_MEASUREMENT
 /begin OUT_MEASUREMENT ExhMod_pwrReactnMapBasdAryB1 ExhMod_ratLamAvrgB1 /end OUT_MEASUREMENT
 /begin LOC_MEASUREMENT ExhMod_effIgnAgAvrgB1Loc ExhMod_egyExoCatB1 ExhMod_facExoCorrnIgnAgHomB1 ExhMod_facExoCorrnIgnAgHomSecFuB1 ExhMod_facExoCorrnIgnAgHspB1 ExhMod_facExoCorrnIgnAgHspSecFuB1 ExhMod_facExoCorrnLamB1 ExhMod_facExoFcoB1 ExhMod_facWghtMnfldCatExoLamCcoB1 ExhMod_flgLamLeanB1 ExhMod_flgLamRichB1 ExhMod_mfExoB1 ExhMod_mO2FillgPwrReactnB1 ExhMod_pwrExoCcoAryB1 ExhMod_pwrExoCcoCat1B1 ExhMod_pwrExoCorrdCatAryB1 ExhMod_pwrExoEngOffAryB1 ExhMod_pwrExothermCcoCat1B1 ExhMod_pwrExoTranB1 ExhMod_pwrReactnCat1Br1B1 ExhMod_pwrReactnScavCteCatB1 ExhMod_ratLamAvrgCylB1 ExhMod_ratLamCatUsB1 ExhMod_ratLamCcoB1 ExhMod_tDeltaExoAddlB1 ExhMod_tDeltaExoCcoB1 ExhMod_tDeltaExoCcoCatB1 ExhMod_tDeltaExoCcoMnfldB1 ExhMod_tDeltaExoFcoB1 ExhMod_tDeltaExoFcoRawB1 ExhMod_tDeltaExoTotB1 ExhMod_tDeltaExoTranLtrB1 ExhMod_tDeltaExoTranRtlB1 lamsbg_wloc /end LOC_MEASUREMENT
 FUNCTION_VERSION "1.16.0" /end FUNCTION
/begin FUNCTION ExhMod_RawEmiMdl "1.9.0     Model for caluculation of Raw Emission upstream of exhaust system"
 /begin DEF_CHARACTERISTIC ExhMod_concHcDeltaFco_M ExhMod_facCoH2CorrnHom_C ExhMod_facCoH2CorrnHsp_C ExhMod_facCoH2CorrnIgnAgSecFu_T ExhMod_facCoH2CorrnIgnAg_T ExhMod_facHcCnvnCorrnIgnAgHspCatHeatgSecFu_M ExhMod_facHcCnvnCorrnIgnAgHspCatHeatg_M ExhMod_facHcCnvnCorrnIgnAgHspCatHeatSustSecFu_M ExhMod_facHcCnvnCorrnIgnAgHspCatHeatSust_M ExhMod_facHcCnvnCorrnIgnAgHspSecFu_M ExhMod_facHcCnvnCorrnIgnAgHsp_M ExhMod_facHcCnvnCorrnIgnAgSecFu_M ExhMod_facHcCnvnCorrnIgnAg_M ExhMod_facHcCnvnCorrnLamHspCatHeatgSecFu_M ExhMod_facHcCnvnCorrnLamHspCatHeatg_M ExhMod_facHcCnvnCorrnLamHspCatHeatSustSecFu_M ExhMod_facHcCnvnCorrnLamHspCatHeatSust_M ExhMod_facHcCnvnCorrnLamHspSecFu_M ExhMod_facHcCnvnCorrnLamHsp_M ExhMod_facHcCnvnCorrnLamSecFu_M ExhMod_facHcCnvnCorrnLam_M ExhMod_facHcCnvnEngHspCatHeatgSecFu_M ExhMod_facHcCnvnEngHspCatHeatg_M ExhMod_facHcCnvnEngHspCatHeatSustSecFu_M ExhMod_facHcCnvnEngHspCatHeatSust_M ExhMod_facHcCnvnEngHspSecFu_M ExhMod_facHcCnvnEngHsp_M ExhMod_facHcCnvnEngSecFu_M ExhMod_facHcCnvnEng_M ExhMod_facIntrpnGslSecFu_T ExhMod_facRawEmiCorrnRailPHsp_T ExhMod_facRawEmiCorrnRailP_T ExhMod_facRelHum_C ExhMod_nrHHc_C ExhMod_pEnvApplRawEmi_C ExhMod_pSatnH2o_T ExhMod_ratCoH2SecFu_T ExhMod_ratCoH2_T ExhMod_ratHCSecFu_C ExhMod_ratOCSecFu_C ExhMod_stRawEmiMdl_C ExhMod_tiConConcHcDeltaFco_T /end DEF_CHARACTERISTIC
 /begin IN_MEASUREMENT B_khakt_msg B_khakw_msg B_sa_msg B_sbblsu_msg CoEOM_flgHsp EnvT_t Epm_nEng ExhMod_effIgnAgAvrgB1 ExhMod_facIntrpnGslSecFu ExhMod_mfExhVlvB1 ExhMod_ratLamAvrgB1 ExhMod_ratMFlowVlvB1 FuPHi_pRail lamsons_w_msg ml_w_msg PEnv_p rl_w_msg SyC_stSub tansk_w_msg UEGO_rLamS1B1 /end IN_MEASUREMENT
 /begin OUT_MEASUREMENT ExhMod_concMH2oVlvB1 ExhMod_concMHcVlvB1 ExhMod_concMO2VlvB1 ExhMod_ratH2oAir /end OUT_MEASUREMENT
 /begin LOC_MEASUREMENT ExhMod_cnvnMolfMFrctB1_I.concMCo2Vlv ExhMod_cnvnMolfMFrctB1_I.concMCoVlv ExhMod_cnvnMolfMFrctB1_I.concMH2Vlv ExhMod_cnvnMolfMFrctB1_I.concMH2oVlv ExhMod_cnvnMolfMFrctB1_I.concMHcVlv ExhMod_cnvnMolfMFrctB1_I.concMNoVlv ExhMod_cnvnMolfMFrctB1_I.concMO2Vlv ExhMod_cnvnMolfMFrctSecFuB1_I.concMCo2Vlv ExhMod_cnvnMolfMFrctSecFuB1_I.concMCoVlv ExhMod_cnvnMolfMFrctSecFuB1_I.concMH2Vlv ExhMod_cnvnMolfMFrctSecFuB1_I.concMH2oVlv ExhMod_cnvnMolfMFrctSecFuB1_I.concMHcVlv ExhMod_cnvnMolfMFrctSecFuB1_I.concMNoVlv ExhMod_cnvnMolfMFrctSecFuB1_I.concMO2Vlv ExhMod_FlexfuCalcn.concMCo2VlvIntrpn ExhMod_FlexfuCalcn.concMCoVlvIntrpn ExhMod_FlexfuCalcn.concMH2VlvIntrpn ExhMod_FlexfuCalcn.concMH2oVlvIntrpn ExhMod_FlexfuCalcn.concMHcVlvIntrpn ExhMod_FlexfuCalcn.concMNoVlvIntrpn ExhMod_FlexfuCalcn.concMO2VlvIntrpn ExhMod_molfCo2B1 ExhMod_molfCo2CteB1 ExhMod_molfCo2SecFuB1 ExhMod_molfCoB1 ExhMod_molfCoSecFuB1 ExhMod_molfH2B1 ExhMod_molfH2oB1 ExhMod_molfH2oBefCmbB1 ExhMod_molfH2oBefCmbSecFuB1 ExhMod_molfH2oCmbB1 ExhMod_molfH2oCmbSecFuB1 ExhMod_molfH2oCteB1 ExhMod_molfH2oSecFuB1 ExhMod_molfH2SecFuB1 ExhMod_molfHcB1 ExhMod_molfHcBefCmbB1 ExhMod_molfHcBefCmbSecFuB1 ExhMod_molfHcCteB1 ExhMod_molfHcSecFuB1 ExhMod_molfN2B1 ExhMod_molfN2BefCmbB1 ExhMod_molfN2BefCmbSecFuB1 ExhMod_molfN2ScavB1 ExhMod_molfN2SecFuB1 ExhMod_molfNoB1 ExhMod_molfNoSecFuB1 ExhMod_molfO2B1 ExhMod_molfO2BefCmbB1 ExhMod_molfO2BefCmbSecFuB1 ExhMod_molfO2CteB1 ExhMod_molfO2ScavB1 ExhMod_molfO2SecFuB1 ExhMod_molrEngCoH2oB1 ExhMod_molrEngCoH2oSecFuB1 ExhMod_molrEngCoNoB1 ExhMod_molrEngCoNoSecFuB1 ExhMod_molrEngHcO2B1 ExhMod_molrEngHcO2CmplB1 ExhMod_molrEngHcO2CmplSecFuB1 ExhMod_molrEngHcO2SecFuB1 ExhMod_ratCnvnCmplOxdB1 ExhMod_ratCnvnCmplOxdSecFuB1 ExhMod_ratCoH2B1 ExhMod_ratCoH2SecFuB1 ExhMod_ratHcCnvnEngB1 ExhMod_ratHcCnvnEngSecFuB1 ExhMod_ratLamExoB1 ExhMod_rawEmiB1_I.molfAir ExhMod_rawEmiB1_I.molfCo ExhMod_rawEmiB1_I.molfCo2 ExhMod_rawEmiB1_I.molfH2 ExhMod_rawEmiB1_I.molfH2o ExhMod_rawEmiB1_I.molfH2oBefCmb ExhMod_rawEmiB1_I.molfH2oCmb ExhMod_rawEmiB1_I.molfHc ExhMod_rawEmiB1_I.molfHcBefCmb ExhMod_rawEmiB1_I.molfN2 ExhMod_rawEmiB1_I.molfN2BefCmb ExhMod_rawEmiB1_I.molfNo ExhMod_rawEmiB1_I.molfO2 ExhMod_rawEmiB1_I.molfO2BefCmb ExhMod_rawEmiB1_I.molrEngCoH2o ExhMod_rawEmiB1_I.molrEngCoNo ExhMod_rawEmiB1_I.molrEngHcO2 ExhMod_rawEmiB1_I.molrEngHcO2Cmpl ExhMod_rawEmiSecFuB1_I.molfAir ExhMod_rawEmiSecFuB1_I.molfCo ExhMod_rawEmiSecFuB1_I.molfCo2 ExhMod_rawEmiSecFuB1_I.molfH2 ExhMod_rawEmiSecFuB1_I.molfH2o ExhMod_rawEmiSecFuB1_I.molfH2oBefCmb ExhMod_rawEmiSecFuB1_I.molfH2oCmb ExhMod_rawEmiSecFuB1_I.molfHc ExhMod_rawEmiSecFuB1_I.molfHcBefCmb ExhMod_rawEmiSecFuB1_I.molfN2 ExhMod_rawEmiSecFuB1_I.molfN2BefCmb ExhMod_rawEmiSecFuB1_I.molfNo ExhMod_rawEmiSecFuB1_I.molfO2 ExhMod_rawEmiSecFuB1_I.molfO2BefCmb ExhMod_rawEmiSecFuB1_I.molrEngCoH2o ExhMod_rawEmiSecFuB1_I.molrEngCoNo ExhMod_rawEmiSecFuB1_I.molrEngHcO2 ExhMod_rawEmiSecFuB1_I.molrEngHcO2Cmpl /end LOC_MEASUREMENT
 FUNCTION_VERSION "1.9.0" /end FUNCTION
/begin FUNCTION ExhMod_TEnvMdl "1.1.0     Representative Environment Temperature Model for the Exhaust System"
 /begin DEF_CHARACTERISTIC ExhMod_facIntrpnBlowrB1_T ExhMod_facIntrpnTEnvB1_M ExhMod_facIntrpnTEnvBlowrB1_M ExhMod_facIntrpnTEnvBlowrCorrnVB1_T ExhMod_facIntrpnTEnvCorrnTWallB1_M ExhMod_facIntrpnTEnvTWallBlowrB1_M ExhMod_facIntrpnTEnvTWallBlowrVehVB1_T ExhMod_facIntrpnTEnvTWallVehVB1_M ExhMod_facTEngCorrnB1_CA ExhMod_facTEnvCorrnTEngB1_M ExhMod_flgTEnvCorrn_C ExhMod_stMskSigQlyEnvT_C ExhMod_tEnvReplcmtVal_C /end DEF_CHARACTERISTIC
 /begin IN_MEASUREMENT CEngDsT_t EnvT_t EnvT_t_Sq ExhMod_tWallAryB1 Fan_r Fan_r2 VehV_v /end IN_MEASUREMENT
 /begin OUT_MEASUREMENT ExhMod_ratBlowrAvrgB1 ExhMod_tEnvCorrdTEngAryB1 ExhMod_tEnvLoc ExhMod_vVehLoc /end OUT_MEASUREMENT
 /begin LOC_MEASUREMENT ExhMod_facIntrpnTEnvTEngB1 ExhMod_facIntrpnTEnvTWallB1 ExhMod_flgVldyEnvT ExhMod_tEngLoc ExhMod_tEngTEnvMdl ExhMod_tEnvCorrdB1 /end LOC_MEASUREMENT
 FUNCTION_VERSION "1.1.0" /end FUNCTION
/begin COMPU_METHOD AirMassPerTime_float "" RAT_FUNC "%6.2" "Kg/h" COEFFS 0 1 0 0 0 1 /end COMPU_METHOD
/begin COMPU_METHOD B_TRUE "" TAB_VERB "%6.3" "" COMPU_TAB_REF B_TRUE /end COMPU_METHOD
/begin COMPU_VTAB B_TRUE "" TAB_VERB 2 0 "FALSE" 1 "TRUE" /end COMPU_VTAB
/begin COMPU_METHOD dez "" RAT_FUNC "%6.2" "" COEFFS 0 1 0 0 0 1 /end COMPU_METHOD
/begin COMPU_METHOD fak_q0p000244 "" RAT_FUNC "%6.5" "-" COEFFS 0 65536 0 0 0 16 /end COMPU_METHOD
/begin COMPU_METHOD fak_q0p000488 "" RAT_FUNC "%6.5" "-" COEFFS 0 65536 0 0 0 32 /end COMPU_METHOD
/begin COMPU_METHOD fak_q16_hPahPa "" RAT_FUNC "%6.1" "hPa*hPa" COEFFS 0 1 0 0 0 16 /end COMPU_METHOD
/begin COMPU_METHOD fak_q3p0518Em5 "" RAT_FUNC "%7.6" "" COEFFS 0 32768 0 0 0 1 /end COMPU_METHOD
/begin COMPU_METHOD fak_q4p883Em4 "" RAT_FUNC "%6.5" "-" COEFFS 0 65536 0 0 0 32 /end COMPU_METHOD
/begin COMPU_METHOD fak_q6p1035Em5 "" RAT_FUNC "%7.6" "-" COEFFS 0 65536 0 0 0 4 /end COMPU_METHOD
/begin COMPU_METHOD fak_sw_b1 "" RAT_FUNC "%7.6" "-" COEFFS 0 65536 0 0 0 2 /end COMPU_METHOD
/begin COMPU_METHOD fak_ub_b1 "" RAT_FUNC "%6.4" "-" COEFFS 0 256 0 0 0 1 /end COMPU_METHOD
/begin COMPU_METHOD fak_ub_b2 "" RAT_FUNC "%8.5" "-" COEFFS 0 256 0 0 0 2 /end COMPU_METHOD
/begin COMPU_METHOD fak_uw_b0p5 "" RAT_FUNC "%8.7" "-" COEFFS 0 65536 0 0 0 0.5 /end COMPU_METHOD
/begin COMPU_METHOD fak_uw_b1024 "" RAT_FUNC "%6.4" "-" COEFFS 0 65536 0 0 0 1024 /end COMPU_METHOD
/begin COMPU_METHOD fak_uw_b16 "" RAT_FUNC "%6.5" "-" COEFFS 0 65536 0 0 0 16 /end COMPU_METHOD
/begin COMPU_METHOD fak_uw_b2 "" RAT_FUNC "%7.6" "-" COEFFS 0 65536 0 0 0 2 /end COMPU_METHOD
/begin COMPU_METHOD fak_uw_b64 "" RAT_FUNC "%6.5" "-" COEFFS 0 65536 0 0 0 64 /end COMPU_METHOD
/begin COMPU_METHOD fak_uw_b8 "" RAT_FUNC "%6.5" "-" COEFFS 0 65536 0 0 0 8 /end COMPU_METHOD
/begin COMPU_METHOD HtFlw_Fl "" RAT_FUNC "%6.2" "J/s" COEFFS 0 1 0 0 0 1 /end COMPU_METHOD
/begin COMPU_METHOD MFVLV_NRCAMSFTCTRLHDP_SC_Compu "" TAB_VERB "%6.3" "" COMPU_TAB_REF MFVLV_NRCAMSFTCTRLHDP_SC_Compu /end COMPU_METHOD
/begin COMPU_VTAB MFVLV_NRCAMSFTCTRLHDP_SC_Compu "" TAB_VERB 2 0 "HDP_SC" 1 "HDP_CAL" /end COMPU_VTAB
/begin COMPU_METHOD MFVLV_NVHTYP_SC_Compu "" TAB_VERB "%6.3" "" COMPU_TAB_REF MFVLV_NVHTYP_SC_Compu /end COMPU_METHOD
/begin COMPU_VTAB MFVLV_NVHTYP_SC_Compu "" TAB_VERB 7 0 "0" 1 "1" 2 "2" 3 "3" 4 "4" 5 "5" 6 "6" /end COMPU_VTAB
/begin COMPU_METHOD MFVLV_PQNTSVAL_SC_Compu "" TAB_VERB "%6.3" "" COMPU_TAB_REF MFVLV_PQNTSVAL_SC_Compu /end COMPU_METHOD
/begin COMPU_VTAB MFVLV_PQNTSVAL_SC_Compu "" TAB_VERB 3 0 "5mbar" 1 "20mbar" 2 "greater than 20mbar" /end COMPU_VTAB
/begin COMPU_METHOD MFVLV_PSIC_SC_Compu "" TAB_VERB "%6.3" "" COMPU_TAB_REF MFVLV_PSIC_SC_Compu /end COMPU_METHOD
/begin COMPU_VTAB MFVLV_PSIC_SC_Compu "" TAB_VERB 4 0 "discrete" 1 "R2S2" 2 "CY202" 3 "SC900685" /end COMPU_VTAB
/begin COMPU_METHOD MFVLV_SWTTIOFFSPRED_SC_Compu "" TAB_VERB "%6.3" "" COMPU_TAB_REF MFVLV_SWTTIOFFSPRED_SC_Compu /end COMPU_METHOD
/begin COMPU_VTAB MFVLV_SWTTIOFFSPRED_SC_Compu "" TAB_VERB 2 0 "Deactivated" 1 "Activated" /end COMPU_VTAB
/begin COMPU_METHOD MFVLV_TIDLYPULLINCFG_SC_Compu "" TAB_VERB "%6.3" "" COMPU_TAB_REF MFVLV_TIDLYPULLINCFG_SC_Compu /end COMPU_METHOD
/begin COMPU_VTAB MFVLV_TIDLYPULLINCFG_SC_Compu "" TAB_VERB 3 0 "Same" 1 "Smaller_Dly" 2 "Smaller_Dly_var2" /end COMPU_VTAB
/begin COMPU_METHOD MFVLV_TSTRIFMOD_SY_Compu "" TAB_VERB "%6.3" "" COMPU_TAB_REF MFVLV_TSTRIFMOD_SY_Compu /end COMPU_METHOD
/begin COMPU_VTAB MFVLV_TSTRIFMOD_SY_Compu "" TAB_VERB 3 0 "MFVLV_NO_TESTER" 1 "MFVLV_ATS_TESTER" 2 "MFVLV_LEGACY_TESTER" /end COMPU_VTAB
/begin COMPU_METHOD MFVLV_VARCTL_SC_Compu "" TAB_VERB "%6.3" "" COMPU_TAB_REF MFVLV_VARCTL_SC_Compu /end COMPU_METHOD
/begin COMPU_VTAB MFVLV_VARCTL_SC_Compu "" TAB_VERB 2 0 "False" 1 "True" /end COMPU_VTAB
/begin COMPU_METHOD MFVLV_VAR_SY_Compu "" TAB_VERB "%6.3" "" COMPU_TAB_REF MFVLV_VAR_SY_Compu /end COMPU_METHOD
/begin COMPU_VTAB MFVLV_VAR_SY_Compu "" TAB_VERB 43 1 "DAI" 3 "VWW" 4 "POR" 5 "AUD" 6 "OPE" 9 "FIA" 11 "BMW" 14 "PSA" 15 "REN" 17 "ALF" 18 "SAB" 19 "VOL" 20 "NIS" 21 "GMU" 22 "FOR" 26 "IMJ" 51 "SEA" 53 "CHR" 54 "JAG" 55 "ROL" 69 "FER" 72 "TOY" 123 "MIT" 147 "HYU" 159 "HON" 160 "MAZ" 183 "CU" 190 "LRG" 204 "VVW" 214 "AVT" 242 "Iveco" 243 "DMC" 248 "SUZ" 267 "SSANGYONG" 270 "KEF" 289 "AMG" 308 "TAT" 319 "MVM" 385 "UAES" 828 "RBCD" 898 "MFTBC" 999 "ALL" 9454 "Fuso" /end COMPU_VTAB
/begin COMPU_METHOD MgPerHubSec "" RAT_FUNC "%6.3" "mg/(Hub*sec)" COEFFS 0 10 0 0 0 1 /end COMPU_METHOD
/begin COMPU_METHOD mgrad_q1p526Em6_kg_DIV_h "" RAT_FUNC "%8.7" "kg/h" COEFFS 0 65536 0 0 0 0.1 /end COMPU_METHOD
/begin COMPU_METHOD mgrad_q1_mgdivs "" RAT_FUNC "%6.2" "mg/s" COEFFS 0 1 0 0 0 1 /end COMPU_METHOD
/begin COMPU_METHOD MILDHEV_SC_Compu "" TAB_VERB "%6.3" "" COMPU_TAB_REF MILDHEV_SC_Compu /end COMPU_METHOD
/begin COMPU_VTAB MILDHEV_SC_Compu "" TAB_VERB 3 0 "NOMILDHEV" 1 "MILDHEV48V" 2 "MILDHEV12V" /end COMPU_VTAB
/begin COMPU_METHOD MILLMP_2HZBLINK_SC_Compu "" TAB_VERB "%6.3" "" COMPU_TAB_REF MILLMP_2HZBLINK_SC_Compu /end COMPU_METHOD
/begin COMPU_VTAB MILLMP_2HZBLINK_SC_Compu "" TAB_VERB 2 0 "False" 1 "True" /end COMPU_VTAB
/begin COMPU_METHOD m_q0p0277_g "" RAT_FUNC "%6.4" "g" COEFFS 0 36 0 0 0 1 /end COMPU_METHOD
/begin COMPU_METHOD m_q0p1 "" RAT_FUNC "%6.3" "kg/h" COEFFS 0 10 0 0 0 1 /end COMPU_METHOD
/begin COMPU_METHOD m_q0p1_mg "" RAT_FUNC "%6.3" "mg" COEFFS 0 1 0 0 0 0.1 /end COMPU_METHOD
/begin COMPU_METHOD m_q0p2_mg "" RAT_FUNC "%6.3" "mg" COEFFS 0 1 0 0 0 0.2 /end COMPU_METHOD
/begin COMPU_METHOD m_q0p2_mg_DIV_s "" RAT_FUNC "%6.3" "mg/s" COEFFS 0 1 0 0 0 0.2 /end COMPU_METHOD
/begin COMPU_METHOD m_q1_mg "" RAT_FUNC "%6.2" "mg" COEFFS 0 1 0 0 0 1 /end COMPU_METHOD
/begin COMPU_METHOD m_uw_b6553p5 "" RAT_FUNC "%6.3" "kg/h" COEFFS 0 1 0 0 0 0.1 /end COMPU_METHOD
/begin COMPU_METHOD nmot_q0p5 "" RAT_FUNC "%6.3" "1/min" COEFFS 0 2 0 0 0 1 /end COMPU_METHOD
/begin COMPU_METHOD OneToOne "" RAT_FUNC "%6.2" "-" COEFFS 0 1 0 0 0 1 /end COMPU_METHOD
/begin COMPU_METHOD Perc_q0p0234375_COMPU "" RAT_FUNC "%6.4" "%" COEFFS 0 65536 0 0 0 1536 /end COMPU_METHOD
/begin COMPU_METHOD p_q0p039 "" RAT_FUNC "%6.4" "hPa" COEFFS 0 256 0 0 0 10 /end COMPU_METHOD
/begin COMPU_METHOD p_uw_q0p039 "" RAT_FUNC "%6.4" "hPa" COEFFS 0 256 0 0 0 10 /end COMPU_METHOD
/begin COMPU_METHOD q0p000061_mol_DIV_s "" RAT_FUNC "%7.6" "mol/s" COEFFS 0 65536 0 0 0 4 /end COMPU_METHOD
/begin COMPU_METHOD q0p00024_mol_DIV_s "" RAT_FUNC "%6.5" "mol/s" COEFFS 0 65536 0 0 0 16 /end COMPU_METHOD
/begin COMPU_METHOD q1024_J_DIV_kg "" RAT_FUNC "%7.0" "J/kg" COEFFS 0 1 0 0 0 1024 /end COMPU_METHOD
/begin COMPU_METHOD q1p2207Em4_mol_DIV_s "" RAT_FUNC "%6.5" "mol/s" COEFFS 0 65536 0 0 0 8 /end COMPU_METHOD
/begin COMPU_METHOD q1_N_s2_DIV_m8 "" RAT_FUNC "%6.2" "(Ns^2)/(m^8)" COEFFS 0 1 0 0 0 1 /end COMPU_METHOD
/begin COMPU_METHOD q1_N_s_DIV_m5 "" RAT_FUNC "%6.2" "Ns/(m^5)" COEFFS 0 1 0 0 0 1 /end COMPU_METHOD
/begin COMPU_METHOD RBPtCel_m_1p0_5 "" RAT_FUNC "%6.2" "mg" COEFFS 0 1 0 0 0 1 /end COMPU_METHOD
/begin COMPU_METHOD RBPtCel_p_0p002_1 "" RAT_FUNC "%6.4" "MPa" COEFFS 0 1000 0 0 0 2 /end COMPU_METHOD
/begin COMPU_METHOD RBPtCel_vf_1p0_1 "" RAT_FUNC "%6.2" "m^3/h" COEFFS 0 1 0 0 0 1 /end COMPU_METHOD
/begin COMPU_METHOD rel_q0p012207 "" RAT_FUNC "%6.4" "%" COEFFS 0 8192 0 0 0 100 /end COMPU_METHOD
/begin COMPU_METHOD rel_q0p0234 "" RAT_FUNC "%6.4" "%" COEFFS 0 128 0 0 0 3 /end COMPU_METHOD
/begin COMPU_METHOD rel_ub_b127p5 "" RAT_FUNC "%6.3" "%" COEFFS 0 2 0 0 0 1 /end COMPU_METHOD
/begin COMPU_METHOD spg_q0p00488 "" RAT_FUNC "%6.4" "V" COEFFS 0 1024 0 0 0 5 /end COMPU_METHOD
/begin COMPU_METHOD spg_uw_q0p00488 "" RAT_FUNC "%6.4" "V" COEFFS 0 1024 0 0 0 5 /end COMPU_METHOD
/begin COMPU_METHOD s_q1_km "" RAT_FUNC "%6.2" "Km" COEFFS 0 1 0 0 0 1 /end COMPU_METHOD
/begin COMPU_METHOD t100msxs_uw_b6553p5 "" RAT_FUNC "%6.3" "s" COEFFS 0 1 0 0 0 0.1 /end COMPU_METHOD
/begin COMPU_METHOD Temp_Cels "" RAT_FUNC "%6.1" "deg C" COEFFS 0 10 2731.4 0 0 1 /end COMPU_METHOD
/begin COMPU_METHOD temp_q0p0234 "" RAT_FUNC "%6.4" "K" COEFFS 0 256 0 0 0 6 /end COMPU_METHOD
/begin COMPU_METHOD temp_q0p0234_o273 "" RAT_FUNC "%6.1" "Grad C" COEFFS 0 1 273.15 0 0 0.0234375 /end COMPU_METHOD
/begin COMPU_METHOD temp_q0p1875 "" RAT_FUNC "%6.3" "K" COEFFS 0 16 0 0 0 3 /end COMPU_METHOD
/begin COMPU_METHOD temp_sw_q0p125 "" RAT_FUNC "%6.3" "K" COEFFS 0 8 0 0 0 1 /end COMPU_METHOD
/begin COMPU_METHOD t_q0p01 "" RAT_FUNC "%6.4" "s" COEFFS 0 100 0 0 0 1 /end COMPU_METHOD
/begin COMPU_METHOD t_q0p02 "" RAT_FUNC "%6.4" "s" COEFFS 0 100 0 0 0 2 /end COMPU_METHOD
/begin COMPU_METHOD t_q0p05 "" RAT_FUNC "%6.4" "s" COEFFS 0 100 0 0 0 5 /end COMPU_METHOD
/begin COMPU_METHOD vfzg_uw_b512 "" RAT_FUNC "%6.4" "km/h" COEFFS 0 65536 0 0 0 512 /end COMPU_METHOD
/begin RECORD_LAYOUT RB_Curve_R32_S16_Static NO_AXIS_PTS_X 1 ULONG AXIS_PTS_X 2 FLOAT32_IEEE INDEX_INCR DIRECT FNC_VALUES 3 SWORD COLUMN_DIR DIRECT STATIC_RECORD_LAYOUT /end RECORD_LAYOUT
/begin RECORD_LAYOUT RB_Curve_R32_U16_Static NO_AXIS_PTS_X 1 ULONG AXIS_PTS_X 2 FLOAT32_IEEE INDEX_INCR DIRECT FNC_VALUES 3 UWORD COLUMN_DIR DIRECT STATIC_RECORD_LAYOUT /end RECORD_LAYOUT
/begin RECORD_LAYOUT RB_Curve_S16_S16 NO_AXIS_PTS_X 1 SWORD AXIS_PTS_X 2 SWORD INDEX_INCR DIRECT FNC_VALUES 3 SWORD COLUMN_DIR DIRECT /end RECORD_LAYOUT
/begin RECORD_LAYOUT RB_Curve_S16_U16_Static NO_AXIS_PTS_X 1 SWORD AXIS_PTS_X 2 SWORD INDEX_INCR DIRECT FNC_VALUES 3 UWORD COLUMN_DIR DIRECT STATIC_RECORD_LAYOUT /end RECORD_LAYOUT
/begin RECORD_LAYOUT RB_Curve_U16_U16 NO_AXIS_PTS_X 1 UWORD AXIS_PTS_X 2 UWORD INDEX_INCR DIRECT FNC_VALUES 3 UWORD COLUMN_DIR DIRECT /end RECORD_LAYOUT
/begin RECORD_LAYOUT RB_Curve_U16_U8_Static NO_AXIS_PTS_X 1 UWORD AXIS_PTS_X 2 UWORD INDEX_INCR DIRECT FNC_VALUES 3 UBYTE COLUMN_DIR DIRECT STATIC_RECORD_LAYOUT /end RECORD_LAYOUT
/begin RECORD_LAYOUT RB_Curve_U8_U16_Static NO_AXIS_PTS_X 1 UBYTE AXIS_PTS_X 2 UBYTE INDEX_INCR DIRECT FNC_VALUES 3 UWORD COLUMN_DIR DIRECT STATIC_RECORD_LAYOUT /end RECORD_LAYOUT
/begin RECORD_LAYOUT RB_Curve_U8_U8 NO_AXIS_PTS_X 1 UBYTE AXIS_PTS_X 2 UBYTE INDEX_INCR DIRECT FNC_VALUES 3 UBYTE COLUMN_DIR DIRECT /end RECORD_LAYOUT
/begin RECORD_LAYOUT RB_Map_S16U16_U16 NO_AXIS_PTS_X 1 SWORD NO_AXIS_PTS_Y 2 SWORD AXIS_PTS_X 3 SWORD INDEX_INCR DIRECT AXIS_PTS_Y 4 UWORD INDEX_INCR DIRECT FNC_VALUES 5 UWORD ROW_DIR DIRECT /end RECORD_LAYOUT
/begin RECORD_LAYOUT RB_Map_S16U8_U16 NO_AXIS_PTS_X 1 SWORD NO_AXIS_PTS_Y 2 SWORD AXIS_PTS_X 3 SWORD INDEX_INCR DIRECT AXIS_PTS_Y 4 UBYTE INDEX_INCR DIRECT FNC_VALUES 5 UWORD COLUMN_DIR DIRECT /end RECORD_LAYOUT
/begin RECORD_LAYOUT RB_Map_S16U8_U8 NO_AXIS_PTS_X 1 SWORD NO_AXIS_PTS_Y 2 SWORD AXIS_PTS_X 3 SWORD INDEX_INCR DIRECT AXIS_PTS_Y 4 UBYTE INDEX_INCR DIRECT FNC_VALUES 5 UBYTE COLUMN_DIR DIRECT /end RECORD_LAYOUT
/begin RECORD_LAYOUT RB_Map_U16S16_U16 NO_AXIS_PTS_X 1 UWORD NO_AXIS_PTS_Y 2 UWORD AXIS_PTS_X 3 UWORD INDEX_INCR DIRECT AXIS_PTS_Y 4 SWORD INDEX_INCR DIRECT FNC_VALUES 5 UWORD COLUMN_DIR DIRECT /end RECORD_LAYOUT
/begin RECORD_LAYOUT RB_Map_U16U16_R32 NO_AXIS_PTS_X 1 UWORD NO_AXIS_PTS_Y 2 UWORD AXIS_PTS_X 3 UWORD INDEX_INCR DIRECT AXIS_PTS_Y 4 UWORD INDEX_INCR DIRECT FNC_VALUES 5 FLOAT32_IEEE COLUMN_DIR DIRECT /end RECORD_LAYOUT
/begin RECORD_LAYOUT RB_Map_U16U16_S16 NO_AXIS_PTS_X 1 UWORD NO_AXIS_PTS_Y 2 UWORD AXIS_PTS_X 3 UWORD INDEX_INCR DIRECT AXIS_PTS_Y 4 UWORD INDEX_INCR DIRECT FNC_VALUES 5 SWORD COLUMN_DIR DIRECT /end RECORD_LAYOUT
/begin RECORD_LAYOUT RB_Map_U16U16_U16 NO_AXIS_PTS_X 1 UWORD NO_AXIS_PTS_Y 2 UWORD AXIS_PTS_X 3 UWORD INDEX_INCR DIRECT AXIS_PTS_Y 4 UWORD INDEX_INCR DIRECT FNC_VALUES 5 UWORD COLUMN_DIR DIRECT /end RECORD_LAYOUT
/begin RECORD_LAYOUT RB_Map_U16U16_U8 NO_AXIS_PTS_X 1 UWORD NO_AXIS_PTS_Y 2 UWORD AXIS_PTS_X 3 UWORD INDEX_INCR DIRECT AXIS_PTS_Y 4 UWORD INDEX_INCR DIRECT FNC_VALUES 5 UBYTE COLUMN_DIR DIRECT /end RECORD_LAYOUT
/begin RECORD_LAYOUT RB_Map_U16U8_S16 NO_AXIS_PTS_X 1 UWORD NO_AXIS_PTS_Y 2 UWORD AXIS_PTS_X 3 UWORD INDEX_INCR DIRECT AXIS_PTS_Y 4 UBYTE INDEX_INCR DIRECT FNC_VALUES 5 SWORD COLUMN_DIR DIRECT /end RECORD_LAYOUT
/begin RECORD_LAYOUT RB_Map_U16U8_U8 NO_AXIS_PTS_X 1 UWORD NO_AXIS_PTS_Y 2 UWORD AXIS_PTS_X 3 UWORD INDEX_INCR DIRECT AXIS_PTS_Y 4 UBYTE INDEX_INCR DIRECT FNC_VALUES 5 UBYTE COLUMN_DIR DIRECT /end RECORD_LAYOUT
/begin RECORD_LAYOUT RB_Map_U8U16_U8 NO_AXIS_PTS_X 1 UBYTE NO_AXIS_PTS_Y 2 UBYTE AXIS_PTS_X 3 UBYTE INDEX_INCR DIRECT AXIS_PTS_Y 4 UWORD INDEX_INCR DIRECT FNC_VALUES 5 UBYTE ROW_DIR DIRECT /end RECORD_LAYOUT
/begin RECORD_LAYOUT RB_ValA_Ws16 FNC_VALUES 1 SWORD COLUMN_DIR DIRECT /end RECORD_LAYOUT
/begin RECORD_LAYOUT RB_ValA_Wu16 FNC_VALUES 1 UWORD COLUMN_DIR DIRECT /end RECORD_LAYOUT
/begin RECORD_LAYOUT RB_Val_Wboolean FNC_VALUES 1 UBYTE COLUMN_DIR DIRECT /end RECORD_LAYOUT
/begin RECORD_LAYOUT RB_Val_Wr32 FNC_VALUES 1 FLOAT32_IEEE COLUMN_DIR DIRECT /end RECORD_LAYOUT
/begin RECORD_LAYOUT RB_Val_Ws16 FNC_VALUES 1 SWORD COLUMN_DIR DIRECT /end RECORD_LAYOUT
/begin RECORD_LAYOUT RB_Val_Wu16 FNC_VALUES 1 UWORD COLUMN_DIR DIRECT /end RECORD_LAYOUT
/begin RECORD_LAYOUT RB_Val_Wu32 FNC_VALUES 1 ULONG COLUMN_DIR DIRECT /end RECORD_LAYOUT
/begin RECORD_LAYOUT RB_Val_Wu8 FNC_VALUES 1 UBYTE COLUMN_DIR DIRECT /end RECORD_LAYOUT
/end MODULE
/end PROJECT
