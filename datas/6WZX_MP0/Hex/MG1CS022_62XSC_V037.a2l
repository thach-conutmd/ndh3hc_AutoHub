ASAP2_VERSION 1 60
/begin PROJECT MG1CS022 "MG1CS022"
/begin HEADER "" VERSION "MG1CS022_62XSC_V037" PROJECT_NO MG1CS022 /end HEADER
/begin MODULE DIM ""
/begin MOD_COMMON "" BYTE_ORDER MSB_LAST ALIGNMENT_BYTE 1 ALIGNMENT_WORD 2 ALIGNMENT_LONG 4 ALIGNMENT_INT64 4 ALIGNMENT_FLOAT32_IEEE 4 ALIGNMENT_FLOAT64_IEEE 4 DATA_SIZE 32 /end MOD_COMMON
/begin CHARACTERISTIC Com_dIDASBMaxDiff_C "Frame Length of IDASB Frame" VALUE 0x8059159C Val_Wu8 255.0 OneToOne 0.00 255.0 FORMAT "%5.1" /end CHARACTERISTIC
/begin CHARACTERISTIC Com_dIDASBMaxPer_C "Period for IDASB frame." VALUE 0x8059159D Val_Wu8 255.0 OneToOne 0.00 255.0 FORMAT "%5.1" /end CHARACTERISTIC
/begin CHARACTERISTIC Com_lDistShipModLim_C "Calibration for total travel distance limitation of Shipping mode" VALUE 0x80557814 Val_Ws32 4294967295.00 OilMlg -2147483648.00 2147483647.00 FORMAT "%13.2" /end CHARACTERISTIC
/begin CHARACTERISTIC Com_lDstDCLim_C "Driving distance of 1Dc is reached to limitation" VALUE 0x80557818 Val_Ws32 4294967295.00 OilMlg -2147483648.00 2147483647.00 FORMAT "%13.2" /end CHARACTERISTIC
/begin CHARACTERISTIC Com_lDstShipMod_C "Travel distance for Shipping mode" VALUE 0x8055781C Val_Ws32 4294967295.00 OilMlg -2147483648.00 2147483647.00 FORMAT "%13.2" /end CHARACTERISTIC
/begin CHARACTERISTIC Com_stConvTrgLftSDA_CUR "Curve to calculate EGR intervention value based on Engine Speed" CURVE 0x80591534 Cur_Xs16Ws16 799.9878 Prc -400.0000 399.9878 FORMAT "%8.4"
 /begin AXIS_DESCR STD_AXIS Epm_nEng EngN 4 -16384.00 16383.50 FORMAT "%8.2" DEPOSIT ABSOLUTE /end AXIS_DESCR
/end CHARACTERISTIC
/begin CHARACTERISTIC Com_stISABasSpd_C "ISA Base Speed Status Calibration" VALUE 0x8059159E Val_Wu8 255.0 OneToOne 0.00 255.0 FORMAT "%5.1" /end CHARACTERISTIC
/begin CHARACTERISTIC Com_swtLETAcTqResv_C "calibration for AC torque" VALUE 0x80557820 RB_Val_Wu8 255.0 OneToOne 0.00 255.0 FORMAT "%5.1" /end CHARACTERISTIC
/begin CHARACTERISTIC Com_swtLETNoInjCntr_C "calibration for injection counter" VALUE 0x80557821 RB_Val_Wu8 255.0 OneToOne 0.00 255.0 FORMAT "%5.1" /end CHARACTERISTIC
/begin CHARACTERISTIC Com_swtLETORATi_C "calibration for threshold time" VALUE 0x80557822 RB_Val_Wu8 255.0 OneToOne 0.00 255.0 FORMAT "%5.1" /end CHARACTERISTIC
/begin CHARACTERISTIC Com_tiOdoDly_C "Delay timer to ensure odometer value from meter unit" VALUE 0x80557824 RB_Val_Wu16 655350.0 Time_ms 0.00 655350.0 FORMAT "%8.1" /end CHARACTERISTIC
/begin CHARACTERISTIC CWZUEAB "codeword ignition off" VALUE 0x8055846C Val_Wu8 255.0 OneToOne 0.00 255.0 FORMAT "%5.1" /end CHARACTERISTIC
/begin CHARACTERISTIC HLSDem_dnGradCVT_C "Minimum descent of engine speed limitation in drag indicator in case of CVT gearboxes" VALUE 0x80557680 RB_Val_Ws16 32767.50 EngN -16384.00 16383.50 FORMAT "%8.2" /end CHARACTERISTIC
/begin CHARACTERISTIC HLSDem_dnGradLim_C "Maximum reduction of engine speed with drag indicator activ" VALUE 0x80557682 RB_Val_Ws16 32767.50 EngN -16384.00 16383.50 FORMAT "%8.2" /end CHARACTERISTIC
/begin CHARACTERISTIC HLSDem_dnHiDrgThres_C "Necessary speed reduction to enable the drag indicator" VALUE 0x80557684 RB_Val_Ws16 32767.50 EngN -16384.00 16383.50 FORMAT "%8.2" /end CHARACTERISTIC
/begin CHARACTERISTIC HLSDem_dnRmpNeg_MAP "Permissible reduction of engine speed limit per calculation step" MAP 0x80557686 RB_Map_S16S16_S16 65535.00 OneToOne -32768.00 32767.00 FORMAT "%8.2"
 /begin AXIS_DESCR STD_AXIS HLSDem_dnMaxEng EngN 5 -16384.00 16383.50 FORMAT "%8.2" DEPOSIT ABSOLUTE /end AXIS_DESCR
 /begin AXIS_DESCR STD_AXIS PT_rTrq TransR 3 -327.6800 327.6700 FORMAT "%8.4" DEPOSIT ABSOLUTE /end AXIS_DESCR
/end CHARACTERISTIC
/begin CHARACTERISTIC HLSDem_dnRmpPos_C "Permissible increase of engine speed limit per calculation step" VALUE 0x805576B8 RB_Val_Ws32 32767999.9924 RmpEngN -16384000.0000 16383999.9924 FORMAT "%13.4" /end CHARACTERISTIC
/begin CHARACTERISTIC HLSDem_nAcsLimThres_C "Engine speed threshold for a limitation in the drive train, which is considered valid" VALUE 0x805576BC RB_Val_Ws16 32767.50 EngN -16384.00 16383.50 FORMAT "%8.2" /end CHARACTERISTIC
/begin CHARACTERISTIC HLSDem_nGearLimThres_C "Engine speed threshold for a limitation in the drive train, which is considered valid" VALUE 0x805576BE RB_Val_Ws16 32767.50 EngN -16384.00 16383.50 FORMAT "%8.2" /end CHARACTERISTIC
/begin CHARACTERISTIC HLSDem_nMaxDspl_C "Maximum engine speed limit for display (calibratable value)" VALUE 0x805576C0 RB_Val_Ws16 32767.50 EngN -16384.00 16383.50 FORMAT "%8.2" /end CHARACTERISTIC
/begin CHARACTERISTIC HLSDem_nMaxLimErr1_C "In case of Error of FId: FId_HLSDem_nMaxLimErr1 this value will be used" VALUE 0x805576C2 RB_Val_Ws16 32767.50 EngN -16384.00 16383.50 FORMAT "%8.2" /end CHARACTERISTIC
/begin CHARACTERISTIC HLSDem_nMaxLimErr2_C "In case of Error of FId: FId_HLSDem_nMaxLimErr2 this value will be used" VALUE 0x805576C4 RB_Val_Ws16 32767.50 EngN -16384.00 16383.50 FORMAT "%8.2" /end CHARACTERISTIC
/begin CHARACTERISTIC HLSDem_nMaxLimErr3_C "In case of Error of FId: FId_HLSDem_nMaxLimErr3 this value will be used" VALUE 0x805576C6 RB_Val_Ws16 32767.50 EngN -16384.00 16383.50 FORMAT "%8.2" /end CHARACTERISTIC
/begin CHARACTERISTIC HLSDem_nMaxPModeActv_C "In case of Error of FId: HLSDem_PModeActv this value will be used" VALUE 0x805576C8 RB_Val_Ws16 32767.50 EngN -16384.00 16383.50 FORMAT "%8.2" /end CHARACTERISTIC
/begin CHARACTERISTIC HLSDem_nMaxPTCoord_CW "Codeword of function %HLSDEm_NMaxPTCoord" VALUE 0x805576CA RB_Val_Wu8 255.0 OneToOne 0.00 255.0 FORMAT "%5.1" /end CHARACTERISTIC
/begin CHARACTERISTIC HLSDem_nMaxRGear_C "Upper engine speed limitaion for reverse gear" VALUE 0x805576CC RB_Val_Ws16 32767.50 EngN -16384.00 16383.50 FORMAT "%8.2" /end CHARACTERISTIC
/begin CHARACTERISTIC HLSDem_nMaxTModeActv_C "In case of Error of FId: HLSDem_TModeActv this value will be used" VALUE 0x805576CE RB_Val_Ws16 32767.50 EngN -16384.00 16383.50 FORMAT "%8.2" /end CHARACTERISTIC
/begin CHARACTERISTIC HLSDem_nMaxVErr_CA "Gearbox dependant engine speed limitation during fault in vehicle speed detection" VAL_BLK 0x805576D0 RB_ValA_Ws16 32767.50 EngN -16384.00 16383.50 FORMAT "%8.2" NUMBER 4 /end CHARACTERISTIC
/begin CHARACTERISTIC HLSDem_nMaxVErr_CUR "Engine speed limit for automatic transmission at fault of vehicle speed signal" CURVE 0x805576D8 RB_Curve_S16_S16 32767.50 EngN -16384.00 16383.50 FORMAT "%8.2"
 /begin AXIS_DESCR STD_AXIS PT_rTrq TransR 7 -327.6800 327.6700 FORMAT "%8.4" DEPOSIT ABSOLUTE /end AXIS_DESCR
/end CHARACTERISTIC
/begin CHARACTERISTIC HLSDem_nSetPHiBas_MAP "Gear dependent base value for the engine speed limitation" MAP 0x805576F6 RB_Map_S16S16_S16 32767.50 EngN -16384.00 16383.50 FORMAT "%8.2"
 /begin AXIS_DESCR STD_AXIS HLSDem_numGear OneToOne 9 -32768.00 32767.00 FORMAT "%8.2" DEPOSIT ABSOLUTE /end AXIS_DESCR
 /begin AXIS_DESCR STD_AXIS HLSDem_tTempSel Temp_Cels 8 -3549.940 3003.560 FORMAT "%8.3" DEPOSIT ABSOLUTE /end AXIS_DESCR
/end CHARACTERISTIC
/begin CHARACTERISTIC HLSDem_nSysErrLimThres_C "Engine speed threshold for a limitation in the drive train, which is considered valid" VALUE 0x805577AC RB_Val_Ws16 32767.50 EngN -16384.00 16383.50 FORMAT "%8.2" /end CHARACTERISTIC
/begin CHARACTERISTIC HLSDem_nTraLimThres_C "Engine speed threshold for a limitation in the drive train, which is considered valid" VALUE 0x805577AE RB_Val_Ws16 32767.50 EngN -16384.00 16383.50 FORMAT "%8.2" /end CHARACTERISTIC
/begin CHARACTERISTIC HLSDem_rAppMin_C "Minimum accelerator pedal value to reset the slope value for positive ramp for high speed limit." VALUE 0x805577B0 RB_Val_Ws16 799.9878 Prc -400.0000 399.9878 FORMAT "%8.4" /end CHARACTERISTIC
/begin CHARACTERISTIC HLSDem_stPTMaxPrio_CW "Status: Condition for setting desired gearbox speed" VALUE 0x805577B2 RB_Val_Wu16 65535.00 OneToOne 0.00 65535.00 FORMAT "%8.2" /end CHARACTERISTIC
/begin CHARACTERISTIC HLSDem_swtTempSel_C "Temperature selection switch for gear dependant maximum engine speed" VALUE 0x805577B4 RB_Val_Wboolean 1.00000000000 B_TRUE 0.00 1.00000000000 FORMAT "%13.11" /end CHARACTERISTIC
/begin CHARACTERISTIC HLSDem_tiNMaxDelVErr_C "Delay time for engine speed limit at fault of vehicle speed signal" VALUE 0x805577B8 RB_Val_Ws32 4294.96729500 Time_Dt -2147.48364800 2147.48364700 FORMAT "%13.8" /end CHARACTERISTIC
/begin CHARACTERISTIC HLSDem_tiRlsRmp_C "Minimum time for which Acc ped value should be less than a calibratable threshold to reset the positive slope to MAXSINT32 for high set point." VALUE 0x805577BC RB_Val_Ws32 4294.96729500 Time_Dt -2147.48364800 2147.48364700 FORMAT "%13.8" /end CHARACTERISTIC
/begin CHARACTERISTIC HLSDem_vVehMin_C "Minimum value of vehicle speed to reset the slope value for positive ramp for high speed limit." VALUE 0x805577C0 RB_Val_Ws16 655.3500 Vel -327.6800 327.6700 FORMAT "%8.4" /end CHARACTERISTIC
/begin CHARACTERISTIC HWSIG_stMinTiNotReqd_C "Incase the minimum delay HWSIG_tiPostDrvMin_C is not required, then rountine SyC_ShortenPostDrive can be activated directly by setting HWSIG_stMinTiNotReqd_C to 1, when ShortenPostDrv_Requested is SET" VALUE 0x8055780C RB_Val_Wu8 255.0 OneToOne 0.00 255.0 FORMAT "%5.1" /end CHARACTERISTIC
/begin CHARACTERISTIC HWSIG_tiPostDrvMin_C "Min post drive duration before routine SyC_ShortenPostDrive is invoked [ min setting 10 Sec ]" VALUE 0x8055780E RB_Val_Wu16 3300.000 t_q0p1 0.00 3300.000 FORMAT "%8.3" EXTENDED_LIMITS 0.00 6553.500 /end CHARACTERISTIC
/begin CHARACTERISTIC HWSIG_tiShortPostDrvDebDelay_C "Debaunce delay duration for rising edge detection and remains TRUE ( 30ms as per requirment)" VALUE 0x80557810 RB_Val_Wu16 32767.00 OneToOne_ms 0.00 32767.00 FORMAT "%8.2" EXTENDED_LIMITS 0.00 65535.00 /end CHARACTERISTIC
/begin CHARACTERISTIC I14229iocbi_rPCSDutyIni_C "Initial value of PCS duty cycle" VALUE 0x80591546 Val_Wu8 99.61 rel_q0p39 0.00 99.61 FORMAT "%5.2" /end CHARACTERISTIC
/begin CHARACTERISTIC I14229_GEVCtl_agMaxAdpdIntk_C "element use to conver to VTC system cam shaft no advanced absolute position" VALUE 0x80557826 RB_Val_Ws16 1023.984 kw_q0p0156 -512.0000 511.9844 FORMAT "%8.4" /end CHARACTERISTIC
/begin CHARACTERISTIC I14229_nHpFlInjCdnIdlRunngHi_C "maximum value of engine speed for high presure routine control" VALUE 0x80557828 RB_Val_Ws16 32767.50 EngN -16384.00 16383.50 FORMAT "%8.2" /end CHARACTERISTIC
/begin CHARACTERISTIC I14229_perEthnlCompuCnvn_CUR "Curve to convert from factor percentage" CURVE 0x80506036 KlAxU8SstxU16WU16 199.9969 rel_uw_b200 0.00 199.9969 FORMAT "%8.4"
 /begin AXIS_DESCR STD_AXIS fethev_w_msg fak_uw_b2 3 0.00 1.999969 FORMAT "%8.6" DEPOSIT ABSOLUTE /end AXIS_DESCR
/end CHARACTERISTIC
/begin CHARACTERISTIC I14229_SigTabRFFD_CA "Array with all signal numbers used for freeze frame readout using srevice $22" VAL_BLK 0x8055782A RB_ValA_Wu16 1168.00000000 Signals_IntSigNumVerb 0.00 1168.00000000 FORMAT "%13.8" NUMBER 62 /end CHARACTERISTIC
/begin CHARACTERISTIC I14229_stEnaVINDia_C "Calibration to enable or disable VIN Diagnosis" VALUE 0x805578A6 RB_Val_Wu8 255.0 OneToOne 0.00 255.0 FORMAT "%5.1" /end CHARACTERISTIC
/begin CHARACTERISTIC I14229_stSwtB9SecuChkEna_C "Security-B9_enable" VALUE 0x805578C0 Val_Wu8 1.000 OneToOne 0.00 1.000 FORMAT "%5.3" EXTENDED_LIMITS 0.00 255.0 /end CHARACTERISTIC
/begin CHARACTERISTIC I14229_stSwtOilPmpOutp_C "To update the status of solenoid ON or OFF from tester based on engine oil pump output" VALUE 0x805578A7 RB_Val_Wu8 255.0 OneToOne 0.00 255.0 FORMAT "%5.1" /end CHARACTERISTIC
/begin CHARACTERISTIC I14229_stVINWriteClrUnit_C "Whether clear information is stored in other units or not" VALUE 0x805578A8 RB_Val_Wu8 255.0 OneToOne 0.00 255.0 FORMAT "%5.1" /end CHARACTERISTIC
/begin CHARACTERISTIC I14229_tiEthconcActvTmr_C "Active timer for ethanol concentration status update" VALUE 0x80591548 Val_Ws16 655350.0 Time_ms -327680.0 327670.0 FORMAT "%8.1" /end CHARACTERISTIC
/begin CHARACTERISTIC I14229_tiForceActvTmr_C "Calibration corresponding to force active timer" VALUE 0x805578AC RB_Val_Ws32 42949672950.0 Time_ms -21474836480.0 21474836470.0 FORMAT "%13.1" /end CHARACTERISTIC
/begin CHARACTERISTIC I14229_tiKsDiag_C "calibration corresponding to Diag time" VALUE 0x805578B0 RB_Val_Ws32 4294.96729500 Time_Dt -2147.48364800 2147.48364700 FORMAT "%13.8" /end CHARACTERISTIC
/begin CHARACTERISTIC I14229_tiPHAACTRINTKTmr_C "Calibration value for protection timer condition check" VALUE 0x805578B4 RB_Val_Ws16 655350.0 Time_ms -327680.0 327670.0 FORMAT "%8.1" /end CHARACTERISTIC
/begin CHARACTERISTIC I14229_tiPHAACTROUTLTmr_C "Calibration value for protection timer condition check" VALUE 0x805578B6 RB_Val_Ws16 655350.0 Time_ms -327680.0 327670.0 FORMAT "%8.1" /end CHARACTERISTIC
/begin CHARACTERISTIC I14229_tiSwtHistDly_C "Timer for the switch histroy delay." VALUE 0x805578B8 RB_Val_Ws16 655350.0 Time_ms -327680.0 327670.0 FORMAT "%8.1" /end CHARACTERISTIC
/begin CHARACTERISTIC I14229_tiVINWriteClrTimeout_C "Timeout time for clear process" VALUE 0x805578BA RB_Val_Ws16 655350.0 Time_ms -327680.0 327670.0 FORMAT "%8.1" /end CHARACTERISTIC
/begin CHARACTERISTIC I14229_TrbCh_uLongTermClsdSensB1_C "Long term adaptation value of lower electrical stop sensor 1 bank 1 factor" VALUE 0x805578BC RB_Val_Wu16 79.99878 spg_q1p221Em3_V 0.00 79.99878 FORMAT "%8.5" /end CHARACTERISTIC
/begin CHARACTERISTIC I15031_nMaxSrv4_C "Maximum engine speed for Mode$04 Clear Diagnostic Information" VALUE 0x8059154A Val_Ws16 10000.00 EngN 0.00 10000.00 FORMAT "%8.2" EXTENDED_LIMITS -16384.00 16383.50 /end CHARACTERISTIC
/begin CHARACTERISTIC I15031_PID13_C "Location of oxigen sensor" VALUE 0x8059155C Val_Wu8 255.0 OneToOne 0.00 255.0 FORMAT "%5.1" /end CHARACTERISTIC
/begin CHARACTERISTIC I15031_PID1C_C "OBD requirements to which vehicle is designed" VALUE 0x8059155D Val_Wu8 42.0000000000 I15031_PID1CVerb 1.0000000000 43.0000000000 FORMAT "%13.10" /end CHARACTERISTIC
/begin CHARACTERISTIC I15031_PID1D_C "Location of oxygen sensors" VALUE 0x8059155E Val_Wu8 255.0 OneToOne 0.00 255.0 FORMAT "%5.1" /end CHARACTERISTIC
/begin CHARACTERISTIC I15031_PID4FA_C "External Test Equipment Configuration Information. Maximum value for Equivalence Ratio" VALUE 0x8059155F Val_Wu8 255.0 OneToOne 0.00 255.0 FORMAT "%5.1" /end CHARACTERISTIC
/begin CHARACTERISTIC I15031_PID4FB_C "External Test Equipment Configuration Information. Maximum value for Oxygen Sensor Voltage" VALUE 0x80591560 Val_Wu8 255.0 OneToOne 0.00 255.0 FORMAT "%5.1" /end CHARACTERISTIC
/begin CHARACTERISTIC I15031_PID4FC_C "External Test Equipment Configuration Information. Maximum value for Oxygen Sensor Current" VALUE 0x80591561 Val_Wu8 255.0 OneToOne 0.00 255.0 FORMAT "%5.1" /end CHARACTERISTIC
/begin CHARACTERISTIC I15031_PID4FD_C "External Test Equipment Configuration Information. Maximum value for Intake Manifold Absolute Pressure." VALUE 0x80591562 Val_Wu8 2550. OneToTenCarb 0.00 2550. FORMAT "%5.0" /end CHARACTERISTIC
/begin CHARACTERISTIC I15031_PID50A_C "External Test Equipment Configuration Information. Maximum value for ""Air Flow Rate from Mass Air Flow Sensor""" VALUE 0x80591563 Val_Wu8 2550. OneToTenCarb 0.00 2550. FORMAT "%5.0" /end CHARACTERISTIC
/begin CHARACTERISTIC I15031_PID5F_C "OBD requirements to which vehicle is designed" VALUE 0x80591564 Val_Wu8 3.00000000000 I15031_PID5FVerb 14.0000000000 17.0000000000 FORMAT "%13.10" /end CHARACTERISTIC
/begin CHARACTERISTIC I15031_PID65A_C "Shows which Auxiliary Inputs / Outputs are supported in PID65" VALUE 0x80591565 Val_Wu8 255.0 OneToOne 0.00 255.0 FORMAT "%5.1" /end CHARACTERISTIC
/begin CHARACTERISTIC I15031_PID66A_C "Shows which Mass Air Flow Sensor data are supported in PID66" VALUE 0x80591566 Val_Wu8 255.0 OneToOne 0.00 255.0 FORMAT "%5.1" /end CHARACTERISTIC
/begin CHARACTERISTIC I15031_PID67A_C "Shows which Engine Coolant Temperature data are supported in PID67" VALUE 0x80591567 Val_Wu8 255.0 OneToOne 0.00 255.0 FORMAT "%5.1" /end CHARACTERISTIC
/begin CHARACTERISTIC I15031_PID68A_C "Shows which Intake Air Temperature Sensor data are supported in PID68" VALUE 0x80591568 Val_Wu8 255.0 OneToOne 0.00 255.0 FORMAT "%5.1" /end CHARACTERISTIC
/begin CHARACTERISTIC I15031_PID69A_C "Shows which Commanded EGR System data are supported in PID69" VALUE 0x80591569 Val_Wu8 255.0 OneToOne 0.00 255.0 FORMAT "%5.1" /end CHARACTERISTIC
/begin CHARACTERISTIC I15031_PID6AA_C "Shows which Commanded Diesel Intake Air Flow Control and Relative Intake Air Flow Position data are supported in PID6A" VALUE 0x8059156A Val_Wu8 255.0 OneToOne 0.00 255.0 FORMAT "%5.1" /end CHARACTERISTIC
/begin CHARACTERISTIC I15031_PID6BA_C "Shows which Exhaust Gas Recirculation Temperature data are supported in PID6B" VALUE 0x8059156B Val_Wu8 255.0 OneToOne 0.00 255.0 FORMAT "%5.1" /end CHARACTERISTIC
/begin CHARACTERISTIC I15031_PID6CA_C "Shows which Commanded Throttle Actuator Control and Relative Throttle Position data are supported in PID6C" VALUE 0x8059156C Val_Wu8 255.0 OneToOne 0.00 255.0 FORMAT "%5.1" /end CHARACTERISTIC
/begin CHARACTERISTIC I15031_PID6DA_C "Shows which Fuel Pressure Control System data are supported in PID6D" VALUE 0x8059156D Val_Wu8 255.0 OneToOne 0.00 255.0 FORMAT "%5.1" /end CHARACTERISTIC
/begin CHARACTERISTIC I15031_PID6EA_C "Shows which Injection Pressure Control System data are supported in PID6E" VALUE 0x8059156E Val_Wu8 255.0 OneToOne 0.00 255.0 FORMAT "%5.1" /end CHARACTERISTIC
/begin CHARACTERISTIC I15031_PID6FA_C "Shows which Turbocharger Compressor Inlet Pressure data are supported in PID6F" VALUE 0x8059156F Val_Wu8 255.0 OneToOne 0.00 255.0 FORMAT "%5.1" /end CHARACTERISTIC
/begin CHARACTERISTIC I15031_PID70A_C "Shows which Boost Pressure Control data are supported in PID70" VALUE 0x80591570 Val_Wu8 255.0 OneToOne 0.00 255.0 FORMAT "%5.1" /end CHARACTERISTIC
/begin CHARACTERISTIC I15031_PID71A_C "Shows which Variable Geometry Turbo (VGT) Control data are supported in PID71" VALUE 0x80591571 Val_Wu8 255.0 OneToOne 0.00 255.0 FORMAT "%5.1" /end CHARACTERISTIC
/begin CHARACTERISTIC I15031_PID72A_C "Shows which Wastegate Control data are supported in PID72" VALUE 0x80591572 Val_Wu8 255.0 OneToOne 0.00 255.0 FORMAT "%5.1" /end CHARACTERISTIC
/begin CHARACTERISTIC I15031_PID73A_C "Shows which Exhaust Pressure data are supported in PID73" VALUE 0x80591573 Val_Wu8 255.0 OneToOne 0.00 255.0 FORMAT "%5.1" /end CHARACTERISTIC
/begin CHARACTERISTIC I15031_PID74A_C "Shows which Turbocharger RPM data are supported in PID74" VALUE 0x80591574 Val_Wu8 255.0 OneToOne 0.00 255.0 FORMAT "%5.1" /end CHARACTERISTIC
/begin CHARACTERISTIC I15031_PID75A_C "Shows which Turbocharger A Temperature data are supported in PID75" VALUE 0x80591575 Val_Wu8 255.0 OneToOne 0.00 255.0 FORMAT "%5.1" /end CHARACTERISTIC
/begin CHARACTERISTIC I15031_PID76A_C "Shows which Turbocharger B Temperature data are supported in PID76" VALUE 0x80591576 Val_Wu8 255.0 OneToOne 0.00 255.0 FORMAT "%5.1" /end CHARACTERISTIC
/begin CHARACTERISTIC I15031_PID77A_C "Shows which Charge Air Cooler Temperature (CACT) data are supported in PID77" VALUE 0x80591577 Val_Wu8 255.0 OneToOne 0.00 255.0 FORMAT "%5.1" /end CHARACTERISTIC
/begin CHARACTERISTIC I15031_PID78A_C "Shows which Exhaust Gas Temperature (EGT) Bank 1 data are supported in PID78" VALUE 0x80591578 Val_Wu8 255.0 OneToOne 0.00 255.0 FORMAT "%5.1" /end CHARACTERISTIC
/begin CHARACTERISTIC I15031_PID79A_C "Shows which Exhaust Gas Temperature (EGT) Bank 2 data are supported in PID79" VALUE 0x80591579 Val_Wu8 255.0 OneToOne 0.00 255.0 FORMAT "%5.1" /end CHARACTERISTIC
/begin CHARACTERISTIC I15031_PID7AA_C "Shows which Particulate Filter (PF) Bank 1 data are supported in PID7A" VALUE 0x8059157A Val_Wu8 255.0 OneToOne 0.00 255.0 FORMAT "%5.1" /end CHARACTERISTIC
/begin CHARACTERISTIC I15031_PID7BA_C "Shows which Particulate Filter (PF) Bank 2 data are supported in PID7B" VALUE 0x8059157B Val_Wu8 255.0 OneToOne 0.00 255.0 FORMAT "%5.1" /end CHARACTERISTIC
/begin CHARACTERISTIC I15031_PID7CA_C "Shows which Particulate Filter (PF) Temperature data are supported in PID7C" VALUE 0x8059157C Val_Wu8 255.0 OneToOne 0.00 255.0 FORMAT "%5.1" /end CHARACTERISTIC
/begin CHARACTERISTIC I15031_PID7FA_C "Shows which Engine Run Time is supported in PID7F" VALUE 0x8059157D Val_Wu8 255.0 OneToOne 0.00 255.0 FORMAT "%5.1" /end CHARACTERISTIC
/begin CHARACTERISTIC I15031_PID81A_C "Shows which Engine Run Time for AECD #1 - #5 is supported in PID81" VALUE 0x8059157E Val_Wu8 255.0 OneToOne 0.00 255.0 FORMAT "%5.1" /end CHARACTERISTIC
/begin CHARACTERISTIC I15031_PID82A_C "Shows which Engine Run Time for AECD #6 - #10 is supported in PID82" VALUE 0x8059157F Val_Wu8 255.0 OneToOne 0.00 255.0 FORMAT "%5.1" /end CHARACTERISTIC
/begin CHARACTERISTIC I15031_PID83A_C "Shows which NOx Sensor data are supported in PID83" VALUE 0x80591580 Val_Wu8 255.0 OneToOne 0.00 255.0 FORMAT "%5.1" /end CHARACTERISTIC
/begin CHARACTERISTIC I15031_PID85A_C "Shows which NOx Control System data are supported in PID85" VALUE 0x80591581 Val_Wu8 255.0 OneToOne 0.00 255.0 FORMAT "%5.1" /end CHARACTERISTIC
/begin CHARACTERISTIC I15031_PID86A_C "Shows which Particulate Matter (PM) Sensor data are supported in PID86" VALUE 0x80591582 Val_Wu8 255.0 OneToOne 0.00 255.0 FORMAT "%5.1" /end CHARACTERISTIC
/begin CHARACTERISTIC I15031_PID87A_C "Shows which Intake Manifold Absolute Pressure data are supported in PID87" VALUE 0x80591583 Val_Wu8 255.0 OneToOne 0.00 255.0 FORMAT "%5.1" /end CHARACTERISTIC
/begin CHARACTERISTIC I15031_PID89A_C "Shows which Engine Run Time for AECD #11 - #15 is supported in PID89" VALUE 0x80591584 Val_Wu8 255.0 OneToOne 0.00 255.0 FORMAT "%5.1" /end CHARACTERISTIC
/begin CHARACTERISTIC I15031_PID8AA_C "Shows which Engine Run Time for AECD #16 - #20 is supported in PID8A" VALUE 0x80591585 Val_Wu8 255.0 OneToOne 0.00 255.0 FORMAT "%5.1" /end CHARACTERISTIC
/begin CHARACTERISTIC I15031_PID8BA_C "Shows which Aftertreatment Status is supported in PID8B ByteB." VALUE 0x80591586 Val_Wu8 255.0 OneToOne 0.00 255.0 FORMAT "%5.1" /end CHARACTERISTIC
/begin CHARACTERISTIC I15031_PID8CA_C "Calibration for O2 Sensor Data support information(Sensor 1, Sensor 2)" VALUE 0x80591587 Val_Wu8 255.0 OneToOne 0.00 255.0 FORMAT "%5.1" /end CHARACTERISTIC
/begin CHARACTERISTIC I15031_PID8FA_C "Shows which PM (Particulate Matter) Sensor Output is supported in PID8F" VALUE 0x80591588 Val_Wu8 255.0 OneToOne 0.00 255.0 FORMAT "%5.1" /end CHARACTERISTIC
/begin CHARACTERISTIC I15031_PID92A_C "Calibration for Fuel System Status support information" VALUE 0x80591589 Val_Wu8 255.0 OneToOne 0.00 255.0 FORMAT "%5.1" /end CHARACTERISTIC
/begin CHARACTERISTIC I15031_PID93A_C "Calibration for WWH B1 counter support information" VALUE 0x8059158A Val_Wu8 255.0 OneToOne 0.00 255.0 FORMAT "%5.1" /end CHARACTERISTIC
/begin CHARACTERISTIC I15031_PID94A_C "Calibration for Inducement Counters support information" VALUE 0x8059158B Val_Wu8 255.0 OneToOne 0.00 255.0 FORMAT "%5.1" /end CHARACTERISTIC
/begin CHARACTERISTIC I15031_PID98A_C "Shows which exhaust gas temperature for bank 1 data are supported in PID98" VALUE 0x8059158C Val_Wu8 255.0 OneToOne 0.00 255.0 FORMAT "%5.1" /end CHARACTERISTIC
/begin CHARACTERISTIC I15031_PID99A_C "Calibration for Exhaust Gas Temperature Sensor Data support information" VALUE 0x8059158D Val_Wu8 255.0 OneToOne 0.00 255.0 FORMAT "%5.1" /end CHARACTERISTIC
/begin CHARACTERISTIC I15031_PID9AA_C "Shows if HybridEV Vehicle State is supported in PID9A" VALUE 0x8059158E Val_Wu8 255.0 OneToOne 0.00 255.0 FORMAT "%5.1" /end CHARACTERISTIC
/begin CHARACTERISTIC I15031_PID9BA_C "Diesel exhaust fluid sensor output" VALUE 0x8059158F Val_Wu8 255.0 OneToOne 0.00 255.0 FORMAT "%5.1" /end CHARACTERISTIC
/begin CHARACTERISTIC I15031_PID9CA_C "Calibration for O2 Sensor Data support information(Sensor 3, Sensor 4)" VALUE 0x80591590 Val_Wu8 255.0 OneToOne 0.00 255.0 FORMAT "%5.1" /end CHARACTERISTIC
/begin CHARACTERISTIC I15031_PID9FA_C "Support of fuel system percentage use" VALUE 0x80591591 Val_Wu8 255.0 OneToOne 0.00 255.0 FORMAT "%5.1" /end CHARACTERISTIC
/begin CHARACTERISTIC I15031_PIDA1A_C "Displays the NOx Sensor Corrected Data supported in PIDA1" VALUE 0x80591592 Val_Wu8 255.0 OneToOne 0.00 255.0 FORMAT "%5.1" /end CHARACTERISTIC
/begin CHARACTERISTIC I15031_PIDA3A_C "Evap System Vapor Pressure" VALUE 0x80591593 Val_Wu8 255.0 OneToOne 0.00 255.0 FORMAT "%5.1" /end CHARACTERISTIC
/begin CHARACTERISTIC I15031_PIDA4A_C "Transmission Actual Gear" VALUE 0x80591594 Val_Wu8 255.0 OneToOne 0.00 255.0 FORMAT "%5.1" /end CHARACTERISTIC
/begin CHARACTERISTIC I15031_PIDA5A_C "calibration parameter to update message of byte A ini PIDA5 for Diesel Exhaust Fluid Dosing" VALUE 0x80591595 Val_Wu8 255.0 OneToOne 0.00 255.0 FORMAT "%5.1" /end CHARACTERISTIC
/begin CHARACTERISTIC I15031_PIDA7A_C "Support of NOx Sensor Data" VALUE 0x80591596 Val_Wu8 255.0 OneToOne 0.00 255.0 FORMAT "%5.1" /end CHARACTERISTIC
/begin CHARACTERISTIC I15031_PIDA8A_C "NOx Sensor Corrected" VALUE 0x80591597 Val_Wu8 255.0 OneToOne 0.00 255.0 FORMAT "%5.1" /end CHARACTERISTIC
/begin CHARACTERISTIC I15031_PIDA9A_C "Motorcycle InputOutput Status" VALUE 0x80591598 Val_Wu8 255.0 OneToOne 0.00 255.0 FORMAT "%5.1" /end CHARACTERISTIC
/begin CHARACTERISTIC I15031_PIDACA_C "Shows Support of DEF Dosing Rate or Mode" VALUE 0x80591599 Val_Wu8 255.0 OneToOne 0.00 255.0 FORMAT "%5.1" /end CHARACTERISTIC
/begin CHARACTERISTIC I15031_srv9PIDTable.PID0_C "" VALUE 0x8059154C Val_Wu8 255.0 OneToOne 0.00 255.0 FORMAT "%5.1" /end CHARACTERISTIC
/begin CHARACTERISTIC I15031_srv9PIDTable.PID2_C "" VALUE 0x8059154E Val_Wu8 255.0 OneToOne 0.00 255.0 FORMAT "%5.1" /end CHARACTERISTIC
/begin CHARACTERISTIC I15031_srv9PIDTable.PID4_C "" VALUE 0x80591550 Val_Wu8 255.0 OneToOne 0.00 255.0 FORMAT "%5.1" /end CHARACTERISTIC
/begin CHARACTERISTIC I15031_srv9PIDTable.PID6_C "" VALUE 0x80591552 Val_Wu8 255.0 OneToOne 0.00 255.0 FORMAT "%5.1" /end CHARACTERISTIC
/begin CHARACTERISTIC I15031_srv9PIDTable.PID8_C "" VALUE 0x80591554 Val_Wu8 255.0 OneToOne 0.00 255.0 FORMAT "%5.1" /end CHARACTERISTIC
/begin CHARACTERISTIC I15031_srv9PIDTable.PIDA_C "" VALUE 0x80591556 Val_Wu8 255.0 OneToOne 0.00 255.0 FORMAT "%5.1" /end CHARACTERISTIC
/begin CHARACTERISTIC I15031_srv9PIDTable.PIDB_C "" VALUE 0x80591557 Val_Wu8 255.0 OneToOne 0.00 255.0 FORMAT "%5.1" /end CHARACTERISTIC
/begin CHARACTERISTIC I15031_srv9PIDTable.PIDF_C "" VALUE 0x8059155B Val_Wu8 255.0 OneToOne 0.00 255.0 FORMAT "%5.1" /end CHARACTERISTIC
/begin CHARACTERISTIC I15031_stRfrshCal_C "Start of support calculation for Service0102" VALUE 0x8059159A Val_Wu8 1.000 OneToOne 0.00 1.000 FORMAT "%5.3" EXTENDED_LIMITS 0.00 255.0 /end CHARACTERISTIC
/begin CHARACTERISTIC IgCtl_diaLamBascIa_T "Air-fuel-ratio dependened, non-operation point weightend delta ignition angle to be considered in the basic ignition angle" CURVE 0x80557A06 RB_Curve_U16_S16_Static 191.3000 zw_q0p1 -96.00000 95.30000 FORMAT "%8.5" EXTENDED_LIMITS -3276.800 3276.700
 /begin AXIS_DESCR STD_AXIS IgCtl_ratLam fak_uw_b16 20 0.00 15.99976 FORMAT "%8.5" DEPOSIT ABSOLUTE /end AXIS_DESCR
/end CHARACTERISTIC
/begin CHARACTERISTIC IgCtl_diaLamBasc_M "Air-fuel-ratio dependened delta ignition angle to be considered in the basic ignition angle" MAP 0x80557A58 RB_Map_S16U16_S16 191.3000 zw_q0p1 -96.00000 95.30000 FORMAT "%8.5" EXTENDED_LIMITS -3276.800 3276.700
 /begin AXIS_DESCR STD_AXIS Epm_nEng EngN 18 -16384.00 16383.50 FORMAT "%8.2" DEPOSIT ABSOLUTE /end AXIS_DESCR
 /begin AXIS_DESCR STD_AXIS IgCtl_ratLam fak_uw_b16 28 0.00 15.99976 FORMAT "%8.5" DEPOSIT ABSOLUTE /end AXIS_DESCR
/end CHARACTERISTIC
/begin CHARACTERISTIC IgCtl_diaLamLteIaLoResl_T "Air-fuel-ratio dependened, non-operation point weightend delta ignition angle to be considered in the late ignition angle" CURVE 0x80557EA8 RB_Curve_U16_S8_Static 191.3 kw_q0p75 -96.00 95.25 FORMAT "%5.2"
 /begin AXIS_DESCR STD_AXIS IgCtl_ratLam fak_uw_b16 8 0.00 15.99976 FORMAT "%8.5" DEPOSIT ABSOLUTE /end AXIS_DESCR
/end CHARACTERISTIC
/begin CHARACTERISTIC IgCtl_facBascLamOperPnt_M "Weighting factor of the delta ignition angle to be considered in the basic ignition angle" MAP 0x80557EC2 RB_Map_S16U16_S16 3.999939 RBPtCel_fac_6p10352em5_1 -2.000000 1.999939 FORMAT "%8.6"
 /begin AXIS_DESCR STD_AXIS Epm_nEng EngN 16 -16384.00 16383.50 FORMAT "%8.2" DEPOSIT ABSOLUTE /end AXIS_DESCR
 /begin AXIS_DESCR STD_AXIS NO_INPUT_QUANTITY rel_q0p0234 20 0.00 1535.977 FORMAT "%8.3" DEPOSIT ABSOLUTE /end AXIS_DESCR
/end CHARACTERISTIC
/begin CHARACTERISTIC IgCtl_facLteLamOperPnt_M "Weighting factor of the delta ignition angle to be considered in the late ignition angle" MAP 0x8055818E RB_Map_S16U16_S16 3.999939 RBPtCel_fac_6p10352em5_1 -2.000000 1.999939 FORMAT "%8.6"
 /begin AXIS_DESCR STD_AXIS Epm_nEng EngN 16 -16384.00 16383.50 FORMAT "%8.2" DEPOSIT ABSOLUTE /end AXIS_DESCR
 /begin AXIS_DESCR STD_AXIS NO_INPUT_QUANTITY rel_q0p0234 20 0.00 1535.977 FORMAT "%8.3" DEPOSIT ABSOLUTE /end AXIS_DESCR
/end CHARACTERISTIC
/begin CHARACTERISTIC IgCtl_flgCylIndLam_C "Selection of a cylinder specific lambda signal for the ignition angle offset" VALUE 0x8055845A RB_Val_Wboolean 1.00000000000 B_TRUE 0.00 1.00000000000 FORMAT "%13.11" /end CHARACTERISTIC
/begin CHARACTERISTIC IgCtl_flgOffsRefIgnAgLam_C "lambda dependent shift of reference ignition angle to be added to basic ignition angle" VALUE 0x8055845B RB_Val_Wboolean 1.00000000000 B_TRUE 0.00 1.00000000000 FORMAT "%13.11" /end CHARACTERISTIC
/begin CHARACTERISTIC IgCtl_flgOperPntDpdt_C "Usage of the calibration variant forIgCtl_diaBascLam" VALUE 0x8055845C RB_Val_Wboolean 1.00000000000 B_TRUE 0.00 1.00000000000 FORMAT "%13.11" /end CHARACTERISTIC
/begin CHARACTERISTIC IgnClPs_BattUmax_C "Maximum threshold VBat for diagnosis ignition powerstage fault evaluation" VALUE 0x80558460 Val_Ws16 1310700. Volt_Batt -655360.0 655340.0 FORMAT "%8.1" /end CHARACTERISTIC
/begin CHARACTERISTIC IgnClPs_BattUmin_C "Minimum threshold VBat for ignition powerstage fault evaluation" VALUE 0x80558462 Val_Ws16 1310700. Volt_Batt -655360.0 655340.0 FORMAT "%8.1" /end CHARACTERISTIC
/begin CHARACTERISTIC IgnClPs_Count "Counter threshold of number of ignitions from ignition counter until enabling of diagnosis at low engine speed" VALUE 0x80558464 Val_Wu32 4294967295.00 dez 0.00 4294967295.00 FORMAT "%13.2" /end CHARACTERISTIC
/begin CHARACTERISTIC IgnClPs_enaAsgnLoglPhyCyl_C "activation HwCh assignment with EPM_numFireSeg_C" VALUE 0x80558468 Val_Wu8 255.0 dez 0.00 255.0 FORMAT "%5.1" /end CHARACTERISTIC
/begin CHARACTERISTIC IgnClPs_mskInjOffBenchErr_CW "lock injection in case of ignition error on whole motor bench" VALUE 0x80558469 Val_Wu8 255.0 dez 0.00 255.0 FORMAT "%5.1" /end CHARACTERISTIC
/begin CHARACTERISTIC IgnClPs_mskInjOff_CW "Codeword for Injection shutoff." VALUE 0x8055846A Val_Wu8 255.0 dez 0.00 255.0 FORMAT "%5.1" /end CHARACTERISTIC
/begin CHARACTERISTIC IgnDD_numIgnIAmaxOverride_C "number of ignitions, for which later abort angle is valid" VALUE 0x8055846D Val_Wu8 255.0 OneToOne 0.00 255.0 FORMAT "%5.1" /end CHARACTERISTIC
/begin CHARACTERISTIC igndd_PercOffsDwlMax_T "Maximum Dwell calibration curve" CURVE 0x8055846E Cur_Xu8Wu8 100.0 rel_ub_b127p5 0.00 100.0 FORMAT "%5.1" EXTENDED_LIMITS 0.00 127.5
 /begin AXIS_DESCR STD_AXIS Epm_nEngLRes EngN_LRes 4 0.00 10200. FORMAT "%5.0" DEPOSIT ABSOLUTE /end AXIS_DESCR
/end CHARACTERISTIC
/begin CHARACTERISTIC igndd_PercOffsDwlMin_T "Miniimum Dwell calibration curve" CURVE 0x80558477 Cur_Xu8Wu8 100.0 rel_ub_b127p5 0.00 100.0 FORMAT "%5.1" EXTENDED_LIMITS 0.00 127.5
 /begin AXIS_DESCR STD_AXIS Epm_nEngLRes EngN_LRes 4 0.00 10200. FORMAT "%5.0" DEPOSIT ABSOLUTE /end AXIS_DESCR
/end CHARACTERISTIC
/begin CHARACTERISTIC IgnDD_tiPercDwellThd_C "Dwell Threshold -continue/ abort of dwell at loss of synchronization" VALUE 0x80558480 Val_Wu8 100.0 rel_ub_b127p5 0.00 100.0 FORMAT "%5.1" EXTENDED_LIMITS 0.00 127.5 /end CHARACTERISTIC
/begin CHARACTERISTIC IgnH_SelnPinActvLvl_C "Active output state on uC output" VALUE 0x80558482 RB_Val_Wboolean 1.000 OneToOne 0.00 1.000 FORMAT "%5.3" EXTENDED_LIMITS 0.00 255.0 /end CHARACTERISTIC
/begin AXIS_PTS IKCtl_fac04_X_AX "distribution for ethanol-ratio" 0x805578CA fethmnmx_msg RB_Axis_U8 1.992188 fak_ub_b2 4 0.00 1.992188 FORMAT "%8.6" DEPOSIT ABSOLUTE /end AXIS_PTS
/begin AXIS_PTS IKCtl_Load08_X_AX "datapoint distribution relative charge, 8 datapoints" 0x805578D0 AirMod_ratChrgAirCyl RB_Axis_U16 1535.977 rel_uw_q0p0234 8 0.00 1535.977 FORMAT "%8.3" DEPOSIT ABSOLUTE /end AXIS_PTS
/begin AXIS_PTS IKCtl_LoadSyn08_X_AX "distribution for load (synchro task, 8 data points)" 0x805578E2 AirMod_ratChrgAirCyl RB_Axis_U16 1535.977 rel_uw_q0p0234 8 0.00 1535.977 FORMAT "%8.3" DEPOSIT ABSOLUTE /end AXIS_PTS
/begin AXIS_PTS IKCtl_nEng06_X_AX "Drehzahlstützstellen" 0x805578F4 Epm_nEng RB_Axis_S16 32767.50 EngN 6 -16384.00 16383.50 FORMAT "%8.2" DEPOSIT ABSOLUTE /end AXIS_PTS
/begin AXIS_PTS IKCtl_nEng08_X_AX "KC: Datapoint distribution engine speed of group B" 0x80557902 Epm_nEng RB_Axis_S16 32767.50 EngN 8 -16384.00 16383.50 FORMAT "%8.2" DEPOSIT ABSOLUTE /end AXIS_PTS
/begin AXIS_PTS IKCtl_nEng13_X_AX "KC: Datapoint distribution engine speed of group A" 0x80557914 Epm_nEng RB_Axis_S16 32767.50 EngN 13 -16384.00 16383.50 FORMAT "%8.2" DEPOSIT ABSOLUTE /end AXIS_PTS
/begin AXIS_PTS IKCtl_nEngVar13_X_AX "KC: Datapoint distribution engine speed of group A" 0x80557930 Epm_nEng RB_Axis_S16 32767.50 EngN 13 -16384.00 16383.50 FORMAT "%8.2" DEPOSIT ABSOLUTE /end AXIS_PTS
/begin AXIS_PTS IKCtl_nEngVarSyn13_X_AX "distribution for engine speed (synchro task, 13 data points)" 0x8055794C Epm_nEng RB_Axis_S16 32767.50 EngN 13 -16384.00 16383.50 FORMAT "%8.2" DEPOSIT ABSOLUTE /end AXIS_PTS
/begin AXIS_PTS IKCtl_ratLoad04_X_AX "basepoint distribution of air charge , 4 basepoints" 0x80557968 AirMod_ratChrgAirCyl RB_Axis_U16 1535.977 rel_uw_q0p0234 4 0.00 1535.977 FORMAT "%8.3" DEPOSIT ABSOLUTE /end AXIS_PTS
/begin AXIS_PTS IKCtl_ratLoadDy04_X_AX "basepoint distribution of rl, 4 basepoints" 0x80557972 AirMod_ratChrgAirCyl RB_Axis_U16 1535.977 rel_uw_q0p0234 4 0.00 1535.977 FORMAT "%8.3" DEPOSIT ABSOLUTE /end AXIS_PTS
/begin CHARACTERISTIC IntkAirT_swtPID68hB_C "Selector switch for source of databyte B within PID68h" VALUE 0x805578C2 RB_Val_Wu8 10.00 OneToOne 0.00 10.00 FORMAT "%5.2" EXTENDED_LIMITS 0.00 255.0 /end CHARACTERISTIC
/begin CHARACTERISTIC IntkAirT_swtPID68hC_C "Selector switch for source of databyte C within PID68h" VALUE 0x805578C3 RB_Val_Wu8 10.00 OneToOne 0.00 10.00 FORMAT "%5.2" EXTENDED_LIMITS 0.00 255.0 /end CHARACTERISTIC
/begin CHARACTERISTIC IntkAirT_swtPID68hD_C "Selector switch for source of databyte D within PID68h" VALUE 0x805578C4 RB_Val_Wu8 10.00 OneToOne 0.00 10.00 FORMAT "%5.2" EXTENDED_LIMITS 0.00 255.0 /end CHARACTERISTIC
/begin CHARACTERISTIC IntkAirT_swtPID68hE_C "Selector switch for source of databyte E within PID68h" VALUE 0x805578C5 RB_Val_Wu8 10.00 OneToOne 0.00 10.00 FORMAT "%5.2" EXTENDED_LIMITS 0.00 255.0 /end CHARACTERISTIC
/begin CHARACTERISTIC IntkAirT_swtPID68hF_C "Selector switch for source of databyte F within PID68h" VALUE 0x805578C6 RB_Val_Wu8 10.00 OneToOne 0.00 10.00 FORMAT "%5.2" EXTENDED_LIMITS 0.00 255.0 /end CHARACTERISTIC
/begin CHARACTERISTIC IntkAirT_swtPID68hG_C "Selector switch for source of databyte G within PID68h" VALUE 0x805578C7 RB_Val_Wu8 10.00 OneToOne 0.00 10.00 FORMAT "%5.2" EXTENDED_LIMITS 0.00 255.0 /end CHARACTERISTIC
/begin CHARACTERISTIC IntkAirT_tDflValPID68_C "Default intake air temperature value for PID68 signal Tester" VALUE 0x805578C8 RB_Val_Wu8 255.0 temp_ub_q1_o40 -40.0 215.0 FORMAT "%5.1" /end CHARACTERISTIC
/begin CHARACTERISTIC KLUFSTLIN "characteristic line for linearisation and conversion of fuel level sender voltage" CURVE 0x805577C4 RB_Curve_U16_U16 6553.500 vol_q0p1_l 0.00 6553.500 FORMAT "%8.3"
 /begin AXIS_DESCR STD_AXIS unfst_w_msg spg_uw_q0p004888 6 0.00 320.3351 FORMAT "%8.4" DEPOSIT ABSOLUTE /end AXIS_DESCR
/end CHARACTERISTIC
/begin CHARACTERISTIC QuickShtDwn_EnaFeat_C "Quick Shut down feature enable when set to 1" VALUE 0x80557812 RB_Val_Wu8 255.0 OneToOne 0.00 255.0 FORMAT "%5.1" /end CHARACTERISTIC
/begin CHARACTERISTIC UBNFST "Voltage standardization for tank level signal" VALUE 0x805577DE RB_Val_Wu8 25.50 spg_q0p1 0.00 25.50 FORMAT "%5.2" /end CHARACTERISTIC
/begin CHARACTERISTIC VlvLft_pOilPIntkHighrThd_C "Upper Threshold of hysteresis value for intake VTEC pressure sensor" VALUE 0x805577E0 RB_Val_Ws16 6553.500 Pres -3276.800 3276.700 FORMAT "%8.3" /end CHARACTERISTIC
/begin CHARACTERISTIC VlvLft_pOilPIntkLowrThd_C "Upper Threshold of hysteresis value for exhaust VTEC pressure sensor" VALUE 0x805577E2 RB_Val_Ws16 6553.500 Pres -3276.800 3276.700 FORMAT "%8.3" /end CHARACTERISTIC
/begin CHARACTERISTIC VlvLft_pTrfPSnsrIntk_T "Curve to map ADC voltage to intake physcial oil pressure" CURVE 0x805577E4 RB_Curve_S16_S16 6553.500 Pres -3276.800 3276.700 FORMAT "%8.3"
 /begin AXIS_DESCR STD_AXIS VlvLft_uRawPSnsrIntkFild Volt 8 -6553.600 6553.400 FORMAT "%8.3" DEPOSIT ABSOLUTE /end AXIS_DESCR
/end CHARACTERISTIC
/begin CHARACTERISTIC Vlvlft_stFbIntkSwt_C "Calibration for Valvelift Intake Feedback Switch Mode" VALUE 0x80557806 RB_Val_Wu8 2.00000000000 VlvLft_stFbSwt_VERB 0.00 2.00000000000 FORMAT "%13.11" /end CHARACTERISTIC
/begin CHARACTERISTIC VlvLft_tiOilPSnsrIntkLT_C "Filter time for inlet VTEC oil pressure value for LowpassT filter" VALUE 0x80557808 RB_Val_Wu16 65.53400 t_q0p001 0.00100 65.53500 FORMAT "%8.5" EXTENDED_LIMITS 0.00 65.53500 /end CHARACTERISTIC
/begin CHARACTERISTIC VlvLft_tiSpclPrSwtIntkDeb_C "Timer special pressure switch intake" VALUE 0x8055780A RB_Val_Wu8 0.2550 t_q0p001 0.00 0.2550 FORMAT "%6.4" /end CHARACTERISTIC
/begin CHARACTERISTIC VlvLft_tiStdPrSwtIntkDeb_C "Timer standard pressure switch intake" VALUE 0x8055780B RB_Val_Wu8 0.2550 t_q0p001 0.00 0.2550 FORMAT "%6.4" /end CHARACTERISTIC
/begin MEASUREMENT abmznd_msg "cut off pattern on ignition circuit error" UBYTE dez 1 100 0.00 255.0 FORMAT "%5.1" ECU_ADDRESS 0x6000F74E /end MEASUREMENT
/begin MEASUREMENT azoffmsk_w_msg "Fade out mask ignition output" UWORD OneToOne 1 100 0.00 65535.00 FORMAT "%8.2" ECU_ADDRESS 0x60000778 /end MEASUREMENT
/begin MEASUREMENT BattuT30C_uRaw "Raw battery voltage at T30C in Voltage" SWORD spg_q0p001 1 100 0.00 32.76700 FORMAT "%8.5" ECU_ADDRESS 0x60009BDC /end MEASUREMENT
/begin MEASUREMENT B_cht2ktvhe "calculation condition inlet" UBYTE B_TRUE 1 100 0.00 1.00000000000 BIT_MASK 0x1 FORMAT "%13.11" ECU_ADDRESS 0x70002E5F /end MEASUREMENT
/begin MEASUREMENT B_dmdsteol "diagnosis misfire detection delayed during End-On-Line check" UBYTE B_TRUE 1 100 0.00 1.00000000000 BIT_MASK 0x1 FORMAT "%13.11" ECU_ADDRESS 0x70000220 /end MEASUREMENT
/begin MEASUREMENT B_ethsemn_msg "ethanol sensor, minimum electrical error" UBYTE B_TRUE 1 100 0.00 1.00000000000 BIT_MASK 0x1 FORMAT "%13.11" ECU_ADDRESS 0x70000BDC /end MEASUREMENT
/begin MEASUREMENT B_ethsemx_msg "ethanol sensor, maximum electrical error" UBYTE B_TRUE 1 100 0.00 1.00000000000 BIT_MASK 0x1 FORMAT "%13.11" ECU_ADDRESS 0x70000BDB /end MEASUREMENT
/begin MEASUREMENT B_zesync_msg "Condition ignition synchronized" UBYTE B_TRUE 1 100 0.00 1.00000000000 BIT_MASK 0x1 FORMAT "%13.11" ECU_ADDRESS 0x60014A90 /end MEASUREMENT
/begin MEASUREMENT Com_flgIDASBNorm "IDASB Frame communication normal flag. (FId_ComIDASB is not inhibited)" UBYTE B_TRUE 1 100 0.00 1.00000000000 BIT_MASK 0x1 FORMAT "%13.11" ECU_ADDRESS 0x6000F9BF /end MEASUREMENT
/begin MEASUREMENT Com_flgLETAcTqResvReplcmt "switch mode for Tester command request" UBYTE B_TRUE 1 100 0.00 1.00000000000 BIT_MASK 0x1 FORMAT "%13.11" ECU_ADDRESS 0x6000F9BE /end MEASUREMENT
/begin MEASUREMENT Com_flgLETNoInjCntrCdn "switch for injection counter" UBYTE B_TRUE 1 100 0.00 1.00000000000 BIT_MASK 0x1 FORMAT "%13.11" ECU_ADDRESS 0x6000F9BD /end MEASUREMENT
/begin MEASUREMENT Com_flgLETORATmrThd "switch for threshold time" UBYTE B_TRUE 1 100 0.00 1.00000000000 BIT_MASK 0x1 FORMAT "%13.11" ECU_ADDRESS 0x6000F9BC /end MEASUREMENT
/begin MEASUREMENT Com_lDstDCShip "Allowed distance in 1DCY with shipping mode" SLONG OilMlg 1 100 -2147483648.00 2147483647.00 FORMAT "%13.2" ECU_ADDRESS 0x60039298 /end MEASUREMENT
/begin MEASUREMENT Com_lTarShipModDst "Target total travel distance for activation of Shipping mode" SLONG OilMlg 1 100 -2147483648.00 2147483647.00 FORMAT "%13.2" ECU_ADDRESS 0x60039294 /end MEASUREMENT
/begin MEASUREMENT Com_rEGRIntValSDA "ATS intervention value for ATS actuator" SWORD Prc 1 100 -400.0000 399.9878 FORMAT "%8.4" ECU_ADDRESS 0x60009E04 /end MEASUREMENT
/begin MEASUREMENT Com_stMisfDetLineEnd "-" UBYTE B_TRUE 1 100 0.00 1.00000000000 BIT_MASK 0x1 FORMAT "%13.11" ECU_ADDRESS 0x6000F6C2 /end MEASUREMENT
/begin MEASUREMENT Com_stShipMod "Status of requesting for Rapid charging mode from Shipping mode operation" UBYTE OneToOne 1 100 0.00 255.0 BIT_MASK 0x1 FORMAT "%5.1" ECU_ADDRESS 0x60039910 /end MEASUREMENT
/begin MEASUREMENT Com_stShipModOdoSupp "suppression flag for odometer related checks" UBYTE OneToOne 1 100 0.00 255.0 FORMAT "%5.1" ECU_ADDRESS 0x6000FD86 /end MEASUREMENT
/begin MEASUREMENT Com_stShipModSupp "suppression flag for other checks" UBYTE OneToOne 1 100 0.00 255.0 FORMAT "%5.1" ECU_ADDRESS 0x6000FD85 /end MEASUREMENT
/begin MEASUREMENT Com_stShipModSuppFlg "suppression flag to reset shipping mode" UBYTE OneToOne 1 100 0.00 255.0 FORMAT "%5.1" ECU_ADDRESS 0x6000FD84 /end MEASUREMENT
/begin MEASUREMENT CoVeh_stIgnLckTerm15 "Status Terminal 15" UBYTE OneToOne 1 100 0.00 255.0 FORMAT "%5.1" ECU_ADDRESS 0x6000FF6E /end MEASUREMENT
/begin MEASUREMENT CoVeh_stIgnLckTerm50 "Status Terminal 50" UBYTE OneToOne 1 100 0.00 255.0 FORMAT "%5.1" ECU_ADDRESS 0x6000FF6D /end MEASUREMENT
/begin MEASUREMENT ECUSerNum "ECU serial number" UBYTE OneToOne 1 100 0.00 255.0 FORMAT "%5.1" ARRAY_SIZE 13 ECU_ADDRESS 0x600100B0 /end MEASUREMENT
/begin MEASUREMENT fqethsr_w_msg "frequency ethanol sensor signal, raw value" UWORD freq_q0p01 1 100 0.00 655.3500 FORMAT "%8.4" ECU_ADDRESS 0x60008D70 /end MEASUREMENT
/begin MEASUREMENT HLSDem_bNMaxRedPT "Flag to indicate engine speed limitation is not from powertrain" UBYTE B_TRUE 1 100 0.00 1.00000000000 BIT_MASK 0x1 FORMAT "%13.11" ECU_ADDRESS 0x6000B80C /end MEASUREMENT
/begin MEASUREMENT HLSDem_bNMaxRmpUp "Condition Ramping up of engine speed is active in the calculation of High Setpoint." UBYTE B_TRUE 1 100 0.00 1.00000000000 BIT_MASK 0x1 FORMAT "%13.11" ECU_ADDRESS 0x700008BF /end MEASUREMENT
/begin MEASUREMENT HLSDem_bPTMaxPrio "Condition for setting desired gearbox engine speed" UBYTE B_TRUE 1 100 0.00 1.00000000000 BIT_MASK 0x1 FORMAT "%13.11" ECU_ADDRESS 0x700008BB /end MEASUREMENT
/begin MEASUREMENT HLSDem_bRmpUpRdy "Condition Ramping up of engine speed is not active in the calculation of High Setpoint." UBYTE B_TRUE 1 100 0.00 1.00000000000 BIT_MASK 0x1 FORMAT "%13.11" ECU_ADDRESS 0x6000B80B /end MEASUREMENT
/begin MEASUREMENT HLSDem_dnMaxEng "Idle speed difference between two calculation steps based on HLSDem_nMaxEng" SWORD EngN 1 100 -16384.00 16383.50 FORMAT "%8.2" ECU_ADDRESS 0x60007446 /end MEASUREMENT
/begin MEASUREMENT HLSDem_nGearLim "Gear dependant engine speed limit" SWORD EngN 1 100 -16384.00 16383.50 FORMAT "%8.2" ECU_ADDRESS 0x600098EC /end MEASUREMENT
/begin MEASUREMENT HLSDem_nHiTemp_mp "Current speed maximum with activ drag indicator" SWORD EngN 1 100 -16384.00 16383.50 FORMAT "%8.2" ECU_ADDRESS 0x7000A254 /end MEASUREMENT
/begin MEASUREMENT HLSDem_nMaxDspl "Maximum engine speed limit for display" SWORD EngN 1 100 -16384.00 16383.50 FORMAT "%8.2" ECU_ADDRESS 0x600098EA /end MEASUREMENT
/begin MEASUREMENT HLSDem_nMaxEngOld "old value of max. allowed engine speed, filtering allowed" SWORD EngN 1 100 -16384.00 16383.50 FORMAT "%8.2" ECU_ADDRESS 0x60007444 /end MEASUREMENT
/begin MEASUREMENT HLSDem_nMaxLimpHome "Maximum limit of Engine speed at limp home" SWORD EngN 1 100 -16384.00 16383.50 FORMAT "%8.2" ECU_ADDRESS 0x60007442 /end MEASUREMENT
/begin MEASUREMENT HLSDem_nMaxRmp "Output value of positive ramp for high SetPoint." SWORD EngN 1 100 -16384.00 16383.50 FORMAT "%8.2" ECU_ADDRESS 0x600098E8 /end MEASUREMENT
/begin MEASUREMENT HLSDem_nMaxUnFltPT_mp "Coordinated, unfiltered maximum engine speed from Eng and PwrTrn" SWORD EngN 1 100 -16384.00 16383.50 FORMAT "%8.2" ECU_ADDRESS 0x7000A252 /end MEASUREMENT
/begin MEASUREMENT HLSDem_nMaxVErr_mp "Maximum engine speed in case vehicle speed sensor signal is invalid for vehicles with automatic gearbox" SWORD EngN 1 100 -16384.00 16383.50 FORMAT "%8.2" ECU_ADDRESS 0x7000A250 /end MEASUREMENT
/begin MEASUREMENT HLSDem_nSetPHi "Maximum speed of complete system" SWORD EngN 1 100 -16384.00 16383.50 FORMAT "%8.2" ECU_ADDRESS 0x60014908 /end MEASUREMENT
/begin MEASUREMENT HLSDem_nSetPHiBas_mp "Gear dependent base value for the engine speed limitation" SWORD EngN 1 100 -16384.00 16383.50 FORMAT "%8.2" ECU_ADDRESS 0x7000A24E /end MEASUREMENT
/begin MEASUREMENT HLSDem_nSpHiUnFlt "Unfiltered Maximum allowed engine speed, filtering not allowed" SWORD EngN 1 100 -16384.00 16383.50 FORMAT "%8.2" ECU_ADDRESS 0x60007440 /end MEASUREMENT
/begin MEASUREMENT HLSDem_numGear "Current gear information desired from HLSDem" SWORD OneToOne 1 100 -32768.00 32767.00 FORMAT "%8.2" ECU_ADDRESS 0x6000743E /end MEASUREMENT
/begin MEASUREMENT HLSDem_stNMaxWarnDspl "Status active engine speed limitation warning for display" UBYTE OneToOne 1 100 0.00 255.0 FORMAT "%5.1" ECU_ADDRESS 0x6000FC66 /end MEASUREMENT
/begin MEASUREMENT HLSDem_stPTLim "Engine speed limiting status for active limitations in the drive train" UWORD OneToOne 1 100 0.00 65535.00 FORMAT "%8.2" ECU_ADDRESS 0x6000944C /end MEASUREMENT
/begin MEASUREMENT HLSDem_tTempSel "CEngDsT_t or Oil_tSwmp temperature, depending upon the calibration HLSDem_swtTempSel_C." SWORD Temp_Cels 1 100 -3549.940 3003.560 FORMAT "%8.3" ECU_ADDRESS 0x6000743C /end MEASUREMENT
/begin MEASUREMENT HWSIG_ctSrvChkReIni "" UBYTE OneToOne 1 100 0.00 255.0 FORMAT "%5.1" ECU_ADDRESS 0x6000FC65 /end MEASUREMENT
/begin MEASUREMENT HWSIG_PostDrvMinMaxTmr "Duration before routine SyC_ShortenPostDrive is invoked" UWORD OneToOne_ms 1 100 0.00 65535.00 FORMAT "%8.2" ECU_ADDRESS 0x6000944A /end MEASUREMENT
/begin MEASUREMENT HWSIG_ShortenPostDrv_Requested_Deb "Delay time to set ShortenPostDrv_Requested" UWORD OneToOne 1 100 0.00 65535.00 FORMAT "%8.2" ECU_ADDRESS 0x60009448 /end MEASUREMENT
/begin MEASUREMENT HWSIG_stSrvChkSwt "Raw value of Service check switch" UBYTE B_TRUE 1 100 0.00 1.00000000000 BIT_MASK 0x1 FORMAT "%13.11" ECU_ADDRESS 0x6000F93E /end MEASUREMENT
/begin MEASUREMENT HWSIG_stSrvChkSwt_old "Old value of Service check switch" UBYTE B_TRUE 1 100 0.00 1.00000000000 BIT_MASK 0x1 FORMAT "%13.11" ECU_ADDRESS 0x6000F93D /end MEASUREMENT
/begin MEASUREMENT I14229appl_stEGRLftDmd "EGR Lift Demand status" UBYTE B_TRUE 1 100 0.00 1.00000000000 BIT_MASK 0x1 FORMAT "%13.11" ECU_ADDRESS 0x6000F93A /end MEASUREMENT
/begin MEASUREMENT I14229CoEng_tiNormalOBDPrevDcyc "Engine running time during previous drvinc cyle" UWORD Time_sec_q1_COMPU 1 100 0.00 65535.00 FORMAT "%8.2" ECU_ADDRESS 0x60039920 /end MEASUREMENT
/begin MEASUREMENT I14229EpmCaS_ctErrSig1 "Exhaust CAM pulse noise counter" UBYTE OneToOne 1 100 0.00 255.0 FORMAT "%5.1" ECU_ADDRESS 0x6000FC63 /end MEASUREMENT
/begin MEASUREMENT I14229EpmCaS_ctNoSig1 "Exhaust CAM pulse disappearance counter." UBYTE OneToOne 1 100 0.00 255.0 FORMAT "%5.1" ECU_ADDRESS 0x6000FC62 /end MEASUREMENT
/begin MEASUREMENT I14229GlbDa_lTotDstDCHiResl "Distance traveled in current drving cycle that have been calculatedfor tester" UWORD Length_10m 1 100 0.00 655350.0 FORMAT "%8.1" ECU_ADDRESS 0x60009446 /end MEASUREMENT
/begin MEASUREMENT I14229GlbDa_lTotDstDCHiReslPrevDcyc "Distance traveled during previous drvinc cycle" UWORD Length_10m 1 100 0.00 655350.0 FORMAT "%8.1" ECU_ADDRESS 0x6003991E /end MEASUREMENT
/begin MEASUREMENT I14229IntkAirT_tSnsrTstrMax "The maximum IAT during engine runnning at this driving cycle" SWORD Temp_Cels 1 100 -3549.940 3003.560 FORMAT "%8.3" ECU_ADDRESS 0x60009D40 /end MEASUREMENT
/begin MEASUREMENT I14229IntkAirT_tSnsrTstrMin "The minimum IAT during engine runnning at this driving cycle" SWORD Temp_Cels 1 100 -3549.940 3003.560 FORMAT "%8.3" ECU_ADDRESS 0x60009D3E /end MEASUREMENT
/begin MEASUREMENT I14229RDBI_nOvrSpd "The highest RPM caused P0219" SWORD EngN 1 100 -16384.00 16383.50 FORMAT "%8.2" ECU_ADDRESS 0x60036DC0 /end MEASUREMENT
/begin MEASUREMENT I14229RDBI_tiOvrSpd "Cumulative time faster than P0219" UWORD Time_msec_q10_COMPU 1 100 0.00 655350.0 FORMAT "%8.1" ECU_ADDRESS 0x60036DBE /end MEASUREMENT
/begin MEASUREMENT i14229_agIntkB1GEVlv "Customer specific intake actual CAM shaft angle" SWORD kw_q0p0156 1 100 -512.0000 511.9844 FORMAT "%8.4" ECU_ADDRESS 0x600095E4 /end MEASUREMENT
/begin MEASUREMENT i14229_agIntkB1GEVlvSig "Tester value for advance angle of VTC intake side" UBYTE OneToOne 1 100 0.00 255.0 FORMAT "%5.1" ECU_ADDRESS 0x6000FB3F /end MEASUREMENT
/begin MEASUREMENT i14229_agOutlB1GEVlv "Customer specific outlet actual CAM shaft angle" SWORD kw_q0p0156 1 100 -512.0000 511.9844 FORMAT "%8.4" ECU_ADDRESS 0x600095E2 /end MEASUREMENT
/begin MEASUREMENT i14229_agSpIntkB1GevCtl "Customer specific intake target CAM shaft angle" SWORD kw_q0p0156 1 100 -512.0000 511.9844 FORMAT "%8.4" ECU_ADDRESS 0x600095E0 /end MEASUREMENT
/begin MEASUREMENT i14229_agSpOutlB1GEVCtl "Customer specific outlet target CAM shaft angle" SWORD kw_q0p0156 1 100 -512.0000 511.9844 FORMAT "%8.4" ECU_ADDRESS 0x600095DE /end MEASUREMENT
/begin MEASUREMENT I14229_AirC_pAnaClnt "input output by Data identifier" SWORD Pres_kPa 1 100 -6553.600 6553.400 FORMAT "%8.3" ECU_ADDRESS 0x600098D6 /end MEASUREMENT
/begin MEASUREMENT I14229_Brk_st "switch history status for Brk_st message" UBYTE OneToOne 1 100 0.00 255.0 FORMAT "%5.1" ECU_ADDRESS 0x6000FC61 /end MEASUREMENT
/begin MEASUREMENT I14229_Brk_stRed "signal corresponding to redundant brake switch status" UBYTE OneToOne 1 100 0.00 255.0 FORMAT "%5.1" ECU_ADDRESS 0x6000FC60 /end MEASUREMENT
/begin MEASUREMENT I14229_cntrReIni "Local counter to record number of times system state SYC_POSTDRIVE is left" UBYTE OneToOne 1 100 0.00 255.0 FORMAT "%5.1" ECU_ADDRESS 0x6000FC5A /end MEASUREMENT
/begin MEASUREMENT I14229_Com_aLgtG "The value of front rear G sensor." SBYTE ComGrv_0p002 1 100 -0.2560 0.2540 ECU_ADDRESS 0x60010003 /end MEASUREMENT
/begin MEASUREMENT I14229_CThmst_r "New interface for SID2615 DID 23" UBYTE OneToOne 1 100 0.00 255.0 FORMAT "%5.1" ECU_ADDRESS 0x6000FC5F /end MEASUREMENT
/begin MEASUREMENT I14229_ElcWastGatLift_s32 "Message for Electric waste Gate Lift in mm" SLONG OneToOne 1 100 -2147483648.00 2147483647.00 FORMAT "%13.2" ECU_ADDRESS 0x600039B8 /end MEASUREMENT
/begin MEASUREMENT I14229_ElecLd_iEPSLoadOnly "comdia variable for Consumption current of EPS (Electronic Power Steering)." UBYTE OneToOne 1 100 0.00 255.0 FORMAT "%5.1" ECU_ADDRESS 0x6000FC5E /end MEASUREMENT
/begin MEASUREMENT I14229_EpmCaS_ctErrSig "comdia variable for CRK pulse noise counter." UBYTE OneToOne 1 100 0.00 255.0 FORMAT "%5.1" ECU_ADDRESS 0x6000FC5D /end MEASUREMENT
/begin MEASUREMENT I14229_EpmCaS_ctErrSig2 "TDC pulse Noise counter" UWORD CrSRev2CrSInc 1 100 0.00 1092.250 FORMAT "%8.3" ECU_ADDRESS 0x60009444 /end MEASUREMENT
/begin MEASUREMENT I14229_EpmCaS_ctNoSig "comdia variable for CAM pulse disappearance counter." UBYTE OneToOne 1 100 0.00 255.0 FORMAT "%5.1" ECU_ADDRESS 0x6000FC5C /end MEASUREMENT
/begin MEASUREMENT I14229_EpmCaS_ctNoSig2 "TDC / TDCAM pulse disappearance counter" UWORD CrSRev2CrSInc 1 100 0.00 1092.250 FORMAT "%8.3" ECU_ADDRESS 0x60009442 /end MEASUREMENT
/begin MEASUREMENT I14229_EpmCrS_ctCaSRev "CRK pulse disappearance counter" SWORD OneToOne 1 100 -32768.00 32767.00 FORMAT "%8.2" ECU_ADDRESS 0x600098D4 /end MEASUREMENT
/begin MEASUREMENT I14229_EpmCrS_ctErrSig "CKP pulse noise counter" SWORD OneToOne 1 100 -32768.00 32767.00 FORMAT "%8.2" ECU_ADDRESS 0x60009D3C /end MEASUREMENT
/begin MEASUREMENT I14229_flgEthSp "Flag to indicate whether DIDE814 is active or not" UBYTE B_TRUE 1 100 0.00 1.00000000000 BIT_MASK 0x1 FORMAT "%13.11" ECU_ADDRESS 0x600000DE /end MEASUREMENT
/begin MEASUREMENT I14229_ForceActvTmr "signal corresponding to force active timer." SLONG Time_ms 1 100 -21474836480.0 21474836470.0 FORMAT "%13.1" ECU_ADDRESS 0x600039B4 /end MEASUREMENT
/begin MEASUREMENT I14229_fzabgs_w "Accumulate misfire counter for 1 driving cycle." UWORD dez 1 100 0.00 65535.00 FORMAT "%8.2" ECU_ADDRESS 0x60009CC8 /end MEASUREMENT
/begin MEASUREMENT I14229_fzabgzyl_w "Accumulate misfire counter for 4 cylinders." UWORD dez 1 100 0.00 65535.00 FORMAT "%8.2" ARRAY_SIZE 4 ECU_ADDRESS 0x700041C8 /end MEASUREMENT
/begin MEASUREMENT I14229_Gbx_uAna1NPosRaw "New interface for DID2615_PDR1A" UBYTE OneToOne 1 100 0.00 255.0 FORMAT "%5.1" ECU_ADDRESS 0x6001008B /end MEASUREMENT
/begin MEASUREMENT I14229_Gbx_uAna2NPosRaw "New interface for DID2615_PDR1B" UBYTE OneToOne 1 100 0.00 255.0 FORMAT "%5.1" ECU_ADDRESS 0x6000FC5B /end MEASUREMENT
/begin MEASUREMENT I14229_GEVCtl_agMaxAdpdIntk "VTC system cam shaft no advanced absolute position" SWORD kw_q0p0156 1 100 -512.0000 511.9844 FORMAT "%8.4" ECU_ADDRESS 0x600098D2 /end MEASUREMENT
/begin MEASUREMENT I14229_GEVCtl_agMinAdpdOutl "Exhaust side VTC system cam shaft no advanced absolute position" UWORD kw_q0p0156 1 100 0.00 1023.984 FORMAT "%8.3" ECU_ADDRESS 0x60009440 /end MEASUREMENT
/begin MEASUREMENT I14229_ivzabg_w "Accumulate Engine speed counter during Misfire monitoring" UWORD dez 1 100 0.00 65535.00 FORMAT "%8.2" ECU_ADDRESS 0x60009CC6 /end MEASUREMENT
/begin MEASUREMENT I14229_lDst "Coverage distance received from meter" ULONG OilMlg 1 100 0.00 4294967295.00 FORMAT "%13.2" ECU_ADDRESS 0x60003900 /end MEASUREMENT
/begin MEASUREMENT I14229_LftEGRDesVal "EGR valve lift command" UBYTE Length_q0p05mm 1 100 0.00 12.75 FORMAT "%5.2" ECU_ADDRESS 0x6001008A /end MEASUREMENT
/begin MEASUREMENT I14229_LftEGRSensVlv "EGR valve actual lift" UBYTE Length_q0p05mm 1 100 0.00 12.75 FORMAT "%5.2" ECU_ADDRESS 0x60010089 /end MEASUREMENT
/begin MEASUREMENT I14229_LongTermAdpnVal_s32 "Message for long-term adaptation value based on typical position in mm" SLONG OneToOne 1 100 -2147483648.00 2147483647.00 FORMAT "%13.2" ECU_ADDRESS 0x600039B0 /end MEASUREMENT
/begin MEASUREMENT I14229_nstat "signal corresponding to stationery engine speed" SWORD nmot_ub_q10_rpm 1 100 -1310720. 1310680. FORMAT "%8.0" ECU_ADDRESS 0x600098D0 /end MEASUREMENT
/begin MEASUREMENT I14229_numDTCFrzFrmHi "High Byte of the DTC Information read from Carb $02 Service" UBYTE OneToOne 1 100 0.00 255.0 FORMAT "%5.1" ECU_ADDRESS 0x6000FC58 /end MEASUREMENT
/begin MEASUREMENT I14229_numDTCFrzFrmLo "Low Byte of the DTC Information read from Carb $02 Service" UBYTE OneToOne 1 100 0.00 255.0 FORMAT "%5.1" ECU_ADDRESS 0x6000FC57 /end MEASUREMENT
/begin MEASUREMENT I14229_numDTCFrzFrmMid "Middle Byte of the DTC Information read from Carb $02 Service" UBYTE OneToOne 1 100 0.00 255.0 FORMAT "%5.1" ECU_ADDRESS 0x6000FC56 /end MEASUREMENT
/begin MEASUREMENT I14229_pEngSrtMin "input output by Data identifier" SWORD p_uw_q0p039_mmHg 1 100 -960.0815 960.0522 FORMAT "%8.4" ECU_ADDRESS 0x600098CE /end MEASUREMENT
/begin MEASUREMENT I14229_perEthnlCompuCnvnTmp "Ethanol compu method convertion" UWORD rel_uw_b200 1 100 0.00 199.9969 FORMAT "%8.4" ECU_ADDRESS 0x60036DBC /end MEASUREMENT
/begin MEASUREMENT I14229_ps_w "input output by Data identifier" UWORD p_uw_q0p039_mmHg 1 100 0.00 1920.134 FORMAT "%8.3" ECU_ADDRESS 0x60009CC4 /end MEASUREMENT
/begin MEASUREMENT I14229_rHtgS2B1 "request for modification in heater element" UWORD fak_q3p906Em5 1 100 0.00 2.559961 FORMAT "%8.6" ECU_ADDRESS 0x60007438 /end MEASUREMENT
/begin MEASUREMENT I14229_rTrqPT "Tester message forThe transmission ratio for an acceleration hazard judging" UBYTE RBPtCel_fac_0p125_1 1 100 0.00 31.88 FORMAT "%5.2" ECU_ADDRESS 0x60010088 /end MEASUREMENT
/begin MEASUREMENT I14229_stBrkMnRaw "input output by Data identifier" UBYTE OneToOne 1 100 0.00 255.0 FORMAT "%5.1" ECU_ADDRESS 0x6000FC52 /end MEASUREMENT
/begin MEASUREMENT I14229_stClth2 "input output by Data identifier" UBYTE OneToOne 1 100 0.00 255.0 FORMAT "%5.1" ECU_ADDRESS 0x60010087 /end MEASUREMENT
/begin MEASUREMENT I14229_stClth3 "input output by Data identifier" UBYTE OneToOne 1 100 0.00 255.0 FORMAT "%5.1" ECU_ADDRESS 0x6000FC51 /end MEASUREMENT
/begin MEASUREMENT I14229_stClth4Bit0 "input output by Data identifier" UBYTE OneToOne 1 100 0.00 255.0 FORMAT "%5.1" ECU_ADDRESS 0x6000FC50 /end MEASUREMENT
/begin MEASUREMENT I14229_stClthBit4 "input output by Data identifier" UBYTE OneToOne 1 100 0.00 255.0 FORMAT "%5.1" ECU_ADDRESS 0x6000FC4F /end MEASUREMENT
/begin MEASUREMENT I14229_stDEVG "Interface for DID261A- PDR0E DEVG" UBYTE OneToOne 1 100 0.00 255.0 FORMAT "%5.1" ECU_ADDRESS 0x6000FC4E /end MEASUREMENT
/begin MEASUREMENT I14229_stForceActvTmr "signal corresponding to force active timer status." UBYTE OneToOne 1 100 0.00 255.0 FORMAT "%5.1" ECU_ADDRESS 0x6000FC4D /end MEASUREMENT
/begin MEASUREMENT I14229_stGbxRvsPos "input output by Data identifier" UBYTE OneToOne 1 100 0.00 255.0 FORMAT "%5.1" ECU_ADDRESS 0x6000FC4C /end MEASUREMENT
/begin MEASUREMENT I14229_stKSdiag "signal corresponding to KS diagnosis status" UBYTE OneToOne 1 100 0.00 255.0 FORMAT "%5.1" ECU_ADDRESS 0x6000FC4B /end MEASUREMENT
/begin MEASUREMENT I14229_stPHAACTRINTKTmr "Status of protection timer condition check" UBYTE OneToOne 1 100 0.00 255.0 FORMAT "%5.1" ECU_ADDRESS 0x6000FC49 /end MEASUREMENT
/begin MEASUREMENT I14229_stPHAACTROUTLTmr "Status of protection timer condition check" UBYTE OneToOne 1 100 0.00 255.0 FORMAT "%5.1" ECU_ADDRESS 0x6000FC48 /end MEASUREMENT
/begin MEASUREMENT I14229_stSwtHistDly_mp "Status of the switch histroy delay" UBYTE OneToOne 1 100 0.00 255.0 FORMAT "%5.1" ECU_ADDRESS 0x7000A24C /end MEASUREMENT
/begin MEASUREMENT I14229_stSwtHistFlg "Status of the switch histroy delay" ULONG dez 1 100 0.00 4294967295.00 FORMAT "%13.2" ECU_ADDRESS 0x60036DB0 /end MEASUREMENT
/begin MEASUREMENT I14229_stSwtOffOnHistFlg "input output by Data identifier" ULONG dez 1 100 0.00 4294967295.00 FORMAT "%13.2" ECU_ADDRESS 0x60036DAC /end MEASUREMENT
/begin MEASUREMENT I14229_stSwtOnOffHistFlg "signal corresponding to switch ON OFF histerysis flag" ULONG dez 1 100 0.00 4294967295.00 FORMAT "%13.2" ECU_ADDRESS 0x60036DA8 /end MEASUREMENT
/begin MEASUREMENT I14229_stTURBODV "TURBODV" UBYTE OneToOne 1 100 0.00 255.0 FORMAT "%5.1" ECU_ADDRESS 0x60010081 /end MEASUREMENT
/begin MEASUREMENT I14229_stVBM "Status of VBM for I14229" UBYTE OneToOne 1 100 0.00 255.0 FORMAT "%5.1" ECU_ADDRESS 0x6000FC46 /end MEASUREMENT
/begin MEASUREMENT I14229_stVINWriteClrDone "VIN write clear done status" UBYTE OneToOne 1 100 0.00 255.0 FORMAT "%5.1" ECU_ADDRESS 0x60010080 /end MEASUREMENT
/begin MEASUREMENT I14229_stVINWriteClrReq "VIN write clear request" UBYTE OneToOne 1 100 0.00 255.0 FORMAT "%5.1" ECU_ADDRESS 0x6000FC45 /end MEASUREMENT
/begin MEASUREMENT I14229_tiInj1On "Injector #1 ON duration" ULONG t_q0p001_ms 1 100 0.00 4294967.29500 FORMAT "%13.5" ECU_ADDRESS 0x600038FC /end MEASUREMENT
/begin MEASUREMENT I14229_tIntkAirTSnsr2 "-" SWORD Temp_Cels 1 100 -3549.940 3003.560 FORMAT "%8.3" ECU_ADDRESS 0x60009084 /end MEASUREMENT
/begin MEASUREMENT I14229_tiSia "timing parameter corresponding to security and immobiliser" UBYTE Time_sec_q1_COMPU 1 100 0.00 255.0 FORMAT "%5.1" ECU_ADDRESS 0x6000FC42 /end MEASUREMENT
/begin MEASUREMENT I14229_tiVINWriteClrTimeoutNRC22_mp "time out for VIN clear request" SWORD Time_ms 1 100 -327680.0 327670.0 FORMAT "%8.1" ECU_ADDRESS 0x7000A24A /end MEASUREMENT
/begin MEASUREMENT I14229_tiVINWriteClrTimeout_mp "Timer for clear process" SWORD Time_ms 1 100 -327680.0 327670.0 FORMAT "%8.1" ECU_ADDRESS 0x7000A248 /end MEASUREMENT
/begin MEASUREMENT I14229_tka "Tester variable for Engine coolant temperature at crank" UBYTE temp_ub_q0p75_o48 1 100 -48.0 143.3 FORMAT "%5.1" ECU_ADDRESS 0x6000FC41 /end MEASUREMENT
/begin MEASUREMENT I14229_tkaMax "Maximum temperature of TW2 sensor during current Drving Cycle" UBYTE temp_ub_q0p75_o48 1 100 -48.0 143.3 FORMAT "%5.1" ECU_ADDRESS 0x6001007F /end MEASUREMENT
/begin MEASUREMENT I14229_tkaMin "Minimum temperature of TW2 sensor during current Drving Cycle" UBYTE temp_ub_q0p75_o48 1 100 -48.0 143.3 FORMAT "%5.1" ECU_ADDRESS 0x6001007E /end MEASUREMENT
/begin MEASUREMENT I14229_tmotMaxCurrDcyc "The maximum ECT1 temperature during vehicle is running at current drving cycle" UBYTE temp_ub_q0p75_o48 1 100 -48.0 143.3 FORMAT "%5.1" ECU_ADDRESS 0x6001007D /end MEASUREMENT
/begin MEASUREMENT I14229_tmotMaxPrevDcyc "The maximum ECT1 temperature during vehicle is running at previous driving cycle" UBYTE temp_ub_q0p75_o48 1 100 -48.0 143.3 FORMAT "%5.1" ECU_ADDRESS 0x6003991B /end MEASUREMENT
/begin MEASUREMENT I14229_tmotMinCurrDcyc "The minimum ECT1 temperature during vehicle is running at current drving cycle" UBYTE temp_ub_q0p75_o48 1 100 -48.0 143.3 FORMAT "%5.1" ECU_ADDRESS 0x6001007C /end MEASUREMENT
/begin MEASUREMENT I14229_tmotMinPrevDcyc "The minimum ECT1 temperature during vehicle is running at previous driving cycle" UBYTE temp_ub_q0p75_o48 1 100 -48.0 143.3 FORMAT "%5.1" ECU_ADDRESS 0x6003991A /end MEASUREMENT
/begin MEASUREMENT I14229_trqInrLtdPthSet "tester message for engine net torque" SWORD OneToOne 1 100 -32768.00 32767.00 FORMAT "%8.2" ECU_ADDRESS 0x600098CC /end MEASUREMENT
/begin MEASUREMENT I14229_trqSetEngTrqPtd "tester message for net torque value for the acceleration hazard judging" SWORD OneToOne 1 100 -32768.00 32767.00 FORMAT "%8.2" ECU_ADDRESS 0x600098CA /end MEASUREMENT
/begin MEASUREMENT I14229_tSnsrFild1 "Filtered value of sensor temperature" UBYTE RBPtCel_t_1p0_om40_1 1 100 -40.0 215.0 FORMAT "%5.1" ECU_ADDRESS 0x6000FC44 /end MEASUREMENT
/begin MEASUREMENT I14229_ubsq "signal corresponding to battery voltage (on board), conversed to standard quantization" UBYTE spg_q0p1 1 100 0.00 25.50 FORMAT "%5.2" ECU_ADDRESS 0x6000FC40 /end MEASUREMENT
/begin MEASUREMENT I14229_udst "-" UWORD spg_uw_b5 1 100 0.00 319.9951 FORMAT "%8.4" ECU_ADDRESS 0x6000943E /end MEASUREMENT
/begin MEASUREMENT I14229_umsrln_w "input output by Data identifier" SWORD q1p412_L_DIV_min 1 100 -46269.63 46268.22 FORMAT "%8.2" ECU_ADDRESS 0x600098C8 /end MEASUREMENT
/begin MEASUREMENT I14229_wdkba_w "input output by Data identifier" SWORD relDK_q0p02441 1 100 -800.0000 799.9756 FORMAT "%8.4" ECU_ADDRESS 0x600098C6 /end MEASUREMENT
/begin MEASUREMENT I14229_wdks_w "input output by Data identifier" UWORD relDK_uw_b100 1 100 0.00 100.0000 FORMAT "%8.4" ECU_ADDRESS 0x6000943C /end MEASUREMENT
/begin MEASUREMENT I14229_wped1 "input output by Data identifier" UWORD relPED_q0p00153 1 100 0.00 100.0000 FORMAT "%8.4" ECU_ADDRESS 0x60009CC0 /end MEASUREMENT
/begin MEASUREMENT I14229_wped2 "input output by Data identifier" UWORD relPED_q0p00153 1 100 0.00 100.0000 FORMAT "%8.4" ECU_ADDRESS 0x60009CBE /end MEASUREMENT
/begin MEASUREMENT I14229_zwist "input output by Data identifier" SWORD zw_q0p1 1 100 -3276.800 3276.700 FORMAT "%8.3" ECU_ADDRESS 0x600098C4 /end MEASUREMENT
/begin MEASUREMENT I15031_FILLSIG1 "Fillsignal for not supported signals with the size of 1 Byte" UBYTE OneToOne 1 100 0.00 255.0 FORMAT "%5.1" ECU_ADDRESS 0x60010070 /end MEASUREMENT
/begin MEASUREMENT I15031_FILLSIG2 "Fillsignal for not supported signals with the size of 2 Bytes" UWORD OneToOne 1 100 0.00 65535.00 FORMAT "%8.2" ECU_ADDRESS 0x60009C9C /end MEASUREMENT
/begin MEASUREMENT I15031_FILLSIG4 "Fillsignal for not supported signals with the size of 4 Bytes" ULONG OneToOne 1 100 0.00 4294967295.00 FORMAT "%13.2" ECU_ADDRESS 0x60003AAC /end MEASUREMENT
/begin MEASUREMENT I15031_ITIDSuppSrv9 "To store support infotype bits in mode9" ULONG OneToOne 1 100 0.00 4294967295.00 FORMAT "%13.2" ARRAY_SIZE 8 ECU_ADDRESS 0x500042F4 /end MEASUREMENT
/begin MEASUREMENT I15031_PID13 "Location of oxigen sensor" UBYTE OneToOne 1 100 0.00 255.0 FORMAT "%5.1" ECU_ADDRESS 0x6001006F /end MEASUREMENT
/begin MEASUREMENT I15031_PID1C "OBD requirements to which vehicle is designed" UBYTE OneToOne 1 100 0.00 255.0 FORMAT "%5.1" ECU_ADDRESS 0x6001006E /end MEASUREMENT
/begin MEASUREMENT I15031_PID1D "Location of oxygen sensors" UBYTE OneToOne 1 100 0.00 255.0 FORMAT "%5.1" ECU_ADDRESS 0x6001006D /end MEASUREMENT
/begin MEASUREMENT I15031_PID4FA "External Test Equipment Configuration Information. Maximum value for Equivalence Ratio." UBYTE OneToOne 1 100 0.00 255.0 FORMAT "%5.1" ECU_ADDRESS 0x6001006C /end MEASUREMENT
/begin MEASUREMENT I15031_PID4FB "External Test Equipment Configuration Information. Maximum value for Oxygen Sensor Voltage." UBYTE OneToOne 1 100 0.00 255.0 FORMAT "%5.1" ECU_ADDRESS 0x6001006B /end MEASUREMENT
/begin MEASUREMENT I15031_PID4FC "External Test Equipment Configuration Information. Maximum value for Oxygen Sensor Current." UBYTE OneToOne 1 100 0.00 255.0 FORMAT "%5.1" ECU_ADDRESS 0x6001006A /end MEASUREMENT
/begin MEASUREMENT I15031_PID4FD "External Test Equipment Configuration Information. Maximum value for Intake Manifold Absolute Pressure." UBYTE OneToTenCarb 1 100 0.00 2550. FORMAT "%5.0" ECU_ADDRESS 0x60010069 /end MEASUREMENT
/begin MEASUREMENT I15031_PID50A "External Test Equipment Configuration Information. Maximum value for Air Flow Rate from Mass Air Flow Sensor" UBYTE OneToTenCarb 1 100 0.00 2550. FORMAT "%5.0" ECU_ADDRESS 0x60010068 /end MEASUREMENT
/begin MEASUREMENT I15031_PID50B "External Test Equipment Configuration Information. Demanded manifold Pressure" UBYTE OneToOne 1 100 0.00 255.0 FORMAT "%5.1" ECU_ADDRESS 0x60010067 /end MEASUREMENT
/begin MEASUREMENT I15031_PID50C "External Test Equipment Configuration Information. Engine Oil Level" UBYTE OneToOne 1 100 0.00 255.0 FORMAT "%5.1" ECU_ADDRESS 0x60010066 /end MEASUREMENT
/begin MEASUREMENT I15031_PID50D "External Test Equipment Configuration Information. Fuel Rail pressure control" UBYTE OneToOne 1 100 0.00 255.0 FORMAT "%5.1" ECU_ADDRESS 0x60010065 /end MEASUREMENT
/begin MEASUREMENT I15031_PID5F "Emission requirements to which vehicle is designed" UBYTE OneToOne 1 100 0.00 255.0 FORMAT "%5.1" ECU_ADDRESS 0x60010064 /end MEASUREMENT
/begin MEASUREMENT I15031_PID65A "Shows which Auxiliary Inputs / Outputs are supported in PID65" UBYTE OneToOne 1 100 0.00 255.0 FORMAT "%5.1" ECU_ADDRESS 0x60010063 /end MEASUREMENT
/begin MEASUREMENT I15031_PID66A "Shows which Mass Air Flow Sensor data are supported in PID66" UBYTE OneToOne 1 100 0.00 255.0 FORMAT "%5.1" ECU_ADDRESS 0x60010062 /end MEASUREMENT
/begin MEASUREMENT I15031_PID67A "Shows which Engine Coolant Temperature data are supported in PID67" UBYTE OneToOne 1 100 0.00 255.0 FORMAT "%5.1" ECU_ADDRESS 0x60010061 /end MEASUREMENT
/begin MEASUREMENT I15031_PID68A "Shows which Intake Air Temperature Sensor data are supported in PID68" UBYTE OneToOne 1 100 0.00 255.0 FORMAT "%5.1" ECU_ADDRESS 0x60010060 /end MEASUREMENT
/begin MEASUREMENT I15031_PID69A "Shows which Commanded EGR System data are supported in PID69" UBYTE OneToOne 1 100 0.00 255.0 FORMAT "%5.1" ECU_ADDRESS 0x6001005F /end MEASUREMENT
/begin MEASUREMENT I15031_PID6AA "Shows which Commanded Diesel Intake Air Flow Control and Relative Intake Air Flow Position data are supported in PID6A" UBYTE OneToOne 1 100 0.00 255.0 FORMAT "%5.1" ECU_ADDRESS 0x6001005E /end MEASUREMENT
/begin MEASUREMENT I15031_PID6BA "Shows which Exhaust Gas Recirculation Temperature data are supported in PID6B" UBYTE OneToOne 1 100 0.00 255.0 FORMAT "%5.1" ECU_ADDRESS 0x6001005D /end MEASUREMENT
/begin MEASUREMENT I15031_PID6CA "Shows which Commanded Throttle Actuator Control and Relative Throttle Position data are supported in PID6C" UBYTE OneToOne 1 100 0.00 255.0 FORMAT "%5.1" ECU_ADDRESS 0x6001005C /end MEASUREMENT
/begin MEASUREMENT I15031_PID6DA "Shows which Fuel Pressure Control System data are supported in PID6D" UBYTE OneToOne 1 100 0.00 255.0 FORMAT "%5.1" ECU_ADDRESS 0x6001005B /end MEASUREMENT
/begin MEASUREMENT I15031_PID6EA "Shows which Injection Pressure Control System data are supported in PID6E" UBYTE OneToOne 1 100 0.00 255.0 FORMAT "%5.1" ECU_ADDRESS 0x6001005A /end MEASUREMENT
/begin MEASUREMENT I15031_PID6FA "Shows which Turbocharger Compressor Inlet Pressure data are supported in PID6F" UBYTE OneToOne 1 100 0.00 255.0 FORMAT "%5.1" ECU_ADDRESS 0x60010059 /end MEASUREMENT
/begin MEASUREMENT I15031_PID70A "Shows which Boost Pressure Control data are supported in PID70" UBYTE OneToOne 1 100 0.00 255.0 FORMAT "%5.1" ECU_ADDRESS 0x60010058 /end MEASUREMENT
/begin MEASUREMENT I15031_PID71A "Shows which Variable Geometry Turbo (VGT) Control data are supported in PID71" UBYTE OneToOne 1 100 0.00 255.0 FORMAT "%5.1" ECU_ADDRESS 0x60010057 /end MEASUREMENT
/begin MEASUREMENT I15031_PID72A "Shows which Wastegate Control data are supported in PID72" UBYTE OneToOne 1 100 0.00 255.0 FORMAT "%5.1" ECU_ADDRESS 0x60010056 /end MEASUREMENT
/begin MEASUREMENT I15031_PID73A "Shows which Exhaust Pressure data are supported in PID73" UBYTE OneToOne 1 100 0.00 255.0 FORMAT "%5.1" ECU_ADDRESS 0x60010055 /end MEASUREMENT
/begin MEASUREMENT I15031_PID74A "Shows which Turbocharger RPM data are supported in PID74" UBYTE OneToOne 1 100 0.00 255.0 FORMAT "%5.1" ECU_ADDRESS 0x60010054 /end MEASUREMENT
/begin MEASUREMENT I15031_PID75A "Shows which Turbocharger A Temperature data are supported in PID75" UBYTE OneToOne 1 100 0.00 255.0 FORMAT "%5.1" ECU_ADDRESS 0x60010053 /end MEASUREMENT
/begin MEASUREMENT I15031_PID76A "Shows which Turbocharger B Temperature data are supported in PID76" UBYTE OneToOne 1 100 0.00 255.0 FORMAT "%5.1" ECU_ADDRESS 0x60010052 /end MEASUREMENT
/begin MEASUREMENT I15031_PID77A "Shows which Charge Air Cooler Temperature (CACT) data are supported in PID77" UBYTE OneToOne 1 100 0.00 255.0 FORMAT "%5.1" ECU_ADDRESS 0x60010051 /end MEASUREMENT
/begin MEASUREMENT I15031_PID78A "Shows which Exhaust Gas Temperature (EGT) Bank 1 data are supported in PID78" UBYTE OneToOne 1 100 0.00 255.0 FORMAT "%5.1" ECU_ADDRESS 0x60010050 /end MEASUREMENT
/begin MEASUREMENT I15031_PID79A "Shows which Exhaust Gas Temperature (EGT) Bank 2 data are supported in PID79" UBYTE OneToOne 1 100 0.00 255.0 FORMAT "%5.1" ECU_ADDRESS 0x6001004F /end MEASUREMENT
/begin MEASUREMENT I15031_PID7AA "Shows which Particulate Filter (PF) Bank 1 data are supported in PID7A" UBYTE OneToOne 1 100 0.00 255.0 FORMAT "%5.1" ECU_ADDRESS 0x6001004E /end MEASUREMENT
/begin MEASUREMENT I15031_PID7BA "Shows which Particulate Filter (PF) Bank 2 data are supported in PID7B" UBYTE OneToOne 1 100 0.00 255.0 FORMAT "%5.1" ECU_ADDRESS 0x6001004D /end MEASUREMENT
/begin MEASUREMENT I15031_PID7CA "Shows which Particulate Filter (PF) Temperature data are supported in PID7C" UBYTE OneToOne 1 100 0.00 255.0 FORMAT "%5.1" ECU_ADDRESS 0x6001004C /end MEASUREMENT
/begin MEASUREMENT I15031_PID7FA "Shows which Engine Run Time is supported in PID7F" UBYTE OneToOne 1 100 0.00 255.0 FORMAT "%5.1" ECU_ADDRESS 0x6001004B /end MEASUREMENT
/begin MEASUREMENT I15031_PID81A "Shows which Engine Run Time for AECD #1 - #5 is supported in PID81" UBYTE OneToOne 1 100 0.00 255.0 FORMAT "%5.1" ECU_ADDRESS 0x6001004A /end MEASUREMENT
/begin MEASUREMENT I15031_PID82A "Shows which Engine Run Time for AECD #6 - #10 is supported in PID82" UBYTE OneToOne 1 100 0.00 255.0 FORMAT "%5.1" ECU_ADDRESS 0x60010049 /end MEASUREMENT
/begin MEASUREMENT I15031_PID83A "Shows which NOx Sensor data are supported in PID83" UBYTE OneToOne 1 100 0.00 255.0 FORMAT "%5.1" ECU_ADDRESS 0x60010048 /end MEASUREMENT
/begin MEASUREMENT I15031_PID85A "Shows which NOx Control System data are supported in PID85" UBYTE OneToOne 1 100 0.00 255.0 FORMAT "%5.1" ECU_ADDRESS 0x60010047 /end MEASUREMENT
/begin MEASUREMENT I15031_PID86A "Shows which Particulate Matter (PM) Sensor data are supported in PID86" UBYTE OneToOne 1 100 0.00 255.0 FORMAT "%5.1" ECU_ADDRESS 0x60010046 /end MEASUREMENT
/begin MEASUREMENT I15031_PID87A "Shows which Intake Manifold Absolute Pressure data are supported in PID87" UBYTE OneToOne 1 100 0.00 255.0 FORMAT "%5.1" ECU_ADDRESS 0x60010045 /end MEASUREMENT
/begin MEASUREMENT I15031_PID89A "Shows which Engine Run Time for AECD #11 - #15 is supported in PID89" UBYTE OneToOne 1 100 0.00 255.0 FORMAT "%5.1" ECU_ADDRESS 0x60010044 /end MEASUREMENT
/begin MEASUREMENT I15031_PID8AA "Shows which Engine Run Time for AECD #16 - #20 is supported in PID8A" UBYTE OneToOne 1 100 0.00 255.0 FORMAT "%5.1" ECU_ADDRESS 0x60010043 /end MEASUREMENT
/begin MEASUREMENT I15031_PID8BA "Shows which Aftertreatment Status is supported in PID8B ByteB." UBYTE OneToOne 1 100 0.00 255.0 FORMAT "%5.1" ECU_ADDRESS 0x60010042 /end MEASUREMENT
/begin MEASUREMENT I15031_PID8CA "Calibration for O2 Sensor Data support information(Sensor 1, Sensor 2)" UBYTE OneToOne 1 100 0.00 255.0 FORMAT "%5.1" ECU_ADDRESS 0x60010041 /end MEASUREMENT
/begin MEASUREMENT I15031_PID8FA "Shows which PM (Particulate Matter) Sensor Output is supported in PID8F" UBYTE OneToOne 1 100 0.00 255.0 FORMAT "%5.1" ECU_ADDRESS 0x60010040 /end MEASUREMENT
/begin MEASUREMENT I15031_PID92A "Fuel System Status support information" UBYTE OneToOne 1 100 0.00 255.0 FORMAT "%5.1" ECU_ADDRESS 0x6001003F /end MEASUREMENT
/begin MEASUREMENT I15031_PID93A "WWH B1 counter support information" UBYTE OneToOne 1 100 0.00 255.0 FORMAT "%5.1" ECU_ADDRESS 0x6001003E /end MEASUREMENT
/begin MEASUREMENT I15031_PID94A "Inducement Counters support information" UBYTE OneToOne 1 100 0.00 255.0 FORMAT "%5.1" ECU_ADDRESS 0x6001003D /end MEASUREMENT
/begin MEASUREMENT I15031_PID98A "Exhaust Gas Temperature Sensor Data support information(Bank 1)" UBYTE OneToOne 1 100 0.00 255.0 FORMAT "%5.1" ECU_ADDRESS 0x6001003C /end MEASUREMENT
/begin MEASUREMENT I15031_PID99A "Exhaust Gas Temperature Sensor Data support information" UBYTE OneToOne 1 100 0.00 255.0 FORMAT "%5.1" ECU_ADDRESS 0x6001003B /end MEASUREMENT
/begin MEASUREMENT I15031_PID9AA "Shows if HybridEV Vehicle State is supported in PID9A" UBYTE OneToOne 1 100 0.00 255.0 FORMAT "%5.1" ECU_ADDRESS 0x6001003A /end MEASUREMENT
/begin MEASUREMENT I15031_PID9BA "Diesel exhaust fluid sensor output" UBYTE OneToOne 1 100 0.00 255.0 FORMAT "%5.1" ECU_ADDRESS 0x60010039 /end MEASUREMENT
/begin MEASUREMENT I15031_PID9CA "O2 Sensor Data support information(Sensor 3, Sensor 4)" UBYTE OneToOne 1 100 0.00 255.0 FORMAT "%5.1" ECU_ADDRESS 0x60010038 /end MEASUREMENT
/begin MEASUREMENT I15031_PID9FA "Fuel system percentage use" UBYTE OneToOne 1 100 0.00 255.0 FORMAT "%5.1" ECU_ADDRESS 0x60010037 /end MEASUREMENT
/begin MEASUREMENT I15031_PIDA1A "Displays the NOx Sensor Corrected Data supported in PIDA1" UBYTE OneToOne 1 100 0.00 255.0 FORMAT "%5.1" ECU_ADDRESS 0x60010036 /end MEASUREMENT
/begin MEASUREMENT I15031_PIDA3A "Evap System Vapor Pressure" UBYTE OneToOne 1 100 0.00 255.0 FORMAT "%5.1" ECU_ADDRESS 0x60010035 /end MEASUREMENT
/begin MEASUREMENT I15031_PIDA4A "Transmission Actual Gear" UBYTE OneToOne 1 100 0.00 255.0 FORMAT "%5.1" ECU_ADDRESS 0x60010034 /end MEASUREMENT
/begin MEASUREMENT I15031_PIDA5A "message to update byte A ini PIDA5 for Diesel Exhaust Fluid Dosing" UBYTE OneToOne 1 100 0.00 255.0 FORMAT "%5.1" ECU_ADDRESS 0x60010033 /end MEASUREMENT
/begin MEASUREMENT I15031_PIDA7A "Support of NOx Sensor Data" UBYTE OneToOne 1 100 0.00 255.0 FORMAT "%5.1" ECU_ADDRESS 0x60010032 /end MEASUREMENT
/begin MEASUREMENT I15031_PIDA8A "NOx Sensor Corrected" UBYTE OneToOne 1 100 0.00 255.0 FORMAT "%5.1" ECU_ADDRESS 0x60010031 /end MEASUREMENT
/begin MEASUREMENT I15031_PIDA9A "Motorcycle InputOutput Status" UBYTE OneToOne 1 100 0.00 255.0 FORMAT "%5.1" ECU_ADDRESS 0x60010030 /end MEASUREMENT
/begin MEASUREMENT I15031_PIDACA "Shows Support of DEF Dosing Rate or Mode" UBYTE OneToOne 1 100 0.00 255.0 FORMAT "%5.1" ECU_ADDRESS 0x6001002F /end MEASUREMENT
/begin MEASUREMENT I15031_PIDSuppSrv1 "PIDs supported in Service 1 are indicated in 32 bit measurement array" ULONG OneToOne 1 100 0.00 4294967295.00 FORMAT "%13.2" ARRAY_SIZE 8 ECU_ADDRESS 0x50004294 /end MEASUREMENT
/begin MEASUREMENT I15031_PIDSuppSrv2 "PIDs supported in Service 2 are indicated in 32 bit measurement array" ULONG OneToOne 1 100 0.00 4294967295.00 FORMAT "%13.2" ARRAY_SIZE 8 ECU_ADDRESS 0x500042B4 /end MEASUREMENT
/begin MEASUREMENT I15031_Srv12_Ext_DisablPIDSupp "PIDs requested for dynamic support switch off are indicated in 32 bit measurement array" ULONG OneToOne 1 100 0.00 4294967295.00 FORMAT "%13.2" ARRAY_SIZE 8 ECU_ADDRESS 0x500042D4 /end MEASUREMENT
/begin MEASUREMENT i15031_srv9_CVN_Calc_ui "State of CVN calculation" UBYTE I15031_srv9_CVN_CalcVerb 1 100 0.00 6. FORMAT "%2.0" ECU_ADDRESS 0x60010022 /end MEASUREMENT
/begin MEASUREMENT I15031_srv9_stCVNRecalc "Recalculation of CVN" UBYTE OneToOne 1 100 0.00 255.0 FORMAT "%5.1" ECU_ADDRESS 0x60014ABD /end MEASUREMENT
/begin MEASUREMENT I15031_srv9_ValidCVN "Availability of valid CVN in Envram." UBYTE OneToOne 1 100 0.00 255.0 FORMAT "%5.1" ECU_ADDRESS 0x6001002E /end MEASUREMENT
/begin MEASUREMENT iats2sva_loc "PID68h, Data Byte A" UBYTE dez 1 100 0.00 255.0 FORMAT "%5.1" ECU_ADDRESS 0x6000B80A /end MEASUREMENT
/begin MEASUREMENT iats2sva_msg "PID68h, Data Byte A" UBYTE dez 1 100 0.00 255.0 FORMAT "%5.1" ECU_ADDRESS 0x6000F732 /end MEASUREMENT
/begin MEASUREMENT iats2svb_loc "PID68h, Data Byte B" UBYTE temp_ub_q1_o40 1 100 -40.0 215.0 FORMAT "%5.1" ECU_ADDRESS 0x6000B809 /end MEASUREMENT
/begin MEASUREMENT iats2svb_msg "PID68h, Data Byte B" UBYTE temp_ub_q1_o40 1 100 -40.0 215.0 FORMAT "%5.1" ECU_ADDRESS 0x6000F731 /end MEASUREMENT
/begin MEASUREMENT iats2svc_loc "PID68h, Data Byte C" UBYTE temp_ub_q1_o40 1 100 -40.0 215.0 FORMAT "%5.1" ECU_ADDRESS 0x6000B808 /end MEASUREMENT
/begin MEASUREMENT iats2svc_msg "PID68h, Data Byte C" UBYTE temp_ub_q1_o40 1 100 -40.0 215.0 FORMAT "%5.1" ECU_ADDRESS 0x6000F730 /end MEASUREMENT
/begin MEASUREMENT iats2svd_loc "PID68h, Data Byte D" UBYTE temp_ub_q1_o40 1 100 -40.0 215.0 FORMAT "%5.1" ECU_ADDRESS 0x6000B807 /end MEASUREMENT
/begin MEASUREMENT iats2svd_msg "PID68h, Data Byte D" UBYTE temp_ub_q1_o40 1 100 -40.0 215.0 FORMAT "%5.1" ECU_ADDRESS 0x6000F72F /end MEASUREMENT
/begin MEASUREMENT iats2sve_loc "PID68h, Data Byte E" UBYTE temp_ub_q1_o40 1 100 -40.0 215.0 FORMAT "%5.1" ECU_ADDRESS 0x6000B806 /end MEASUREMENT
/begin MEASUREMENT iats2sve_msg "PID68h, Data Byte E" UBYTE temp_ub_q1_o40 1 100 -40.0 215.0 FORMAT "%5.1" ECU_ADDRESS 0x6000F72E /end MEASUREMENT
/begin MEASUREMENT iats2svf_loc "PID68h, Data Byte F" UBYTE temp_ub_q1_o40 1 100 -40.0 215.0 FORMAT "%5.1" ECU_ADDRESS 0x6000B805 /end MEASUREMENT
/begin MEASUREMENT iats2svf_msg "PID68h, Data Byte F" UBYTE temp_ub_q1_o40 1 100 -40.0 215.0 FORMAT "%5.1" ECU_ADDRESS 0x6000F72D /end MEASUREMENT
/begin MEASUREMENT iats2svg_loc "PID68h, Data Byte G" UBYTE temp_ub_q1_o40 1 100 -40.0 215.0 FORMAT "%5.1" ECU_ADDRESS 0x6000B804 /end MEASUREMENT
/begin MEASUREMENT iats2svg_msg "PID68h, Data Byte G" UBYTE temp_ub_q1_o40 1 100 -40.0 215.0 FORMAT "%5.1" ECU_ADDRESS 0x6000F72C /end MEASUREMENT
/begin MEASUREMENT IgCtl_diaBascLam "lambda dependent delta ignition angle to be added on basic ignition angle" SWORD zw_q0p1 1 100 -96.00000 95.30000 FORMAT "%8.5" ECU_ADDRESS 0x70003BBA /end MEASUREMENT
/begin MEASUREMENT IgCtl_diaBascLamCptProtn "Basic ignition angle offset due to lambda for component protection" SWORD zw_q0p1 1 100 -96.00000 95.30000 FORMAT "%8.5" ECU_ADDRESS 0x70003BB8 /end MEASUREMENT
/begin MEASUREMENT IgCtl_diaBascLamWoRefIa "Lambda dependent delta ignition angle without consideration of lambda dependent reference ignition angle offset from torque model (for example dzwol_w_msg)" SWORD zw_q0p1 1 100 -96.00000 95.30000 FORMAT "%8.5" ECU_ADDRESS 0x70003BB6 /end MEASUREMENT
/begin MEASUREMENT IgCtl_diaLteLamLoResl "lambda dependend delta ignition angle to be added to the late border of the ignition angle" SBYTE kw_q0p75 1 100 -96.00 95.25 FORMAT "%5.2" ECU_ADDRESS 0x70003744 /end MEASUREMENT
/begin MEASUREMENT IgCtl_facBascLamOperPnt "operation point dependent factor for basic ignition angle offset due to lambda" SWORD RBPtCel_fac_6p10352em5_1 1 100 -2.000000 1.999939 FORMAT "%8.6" ECU_ADDRESS 0x70002E5A /end MEASUREMENT
/begin MEASUREMENT IgCtl_facLteLamOperPnt "operation point dependent factor for late ignition angle offset due to lambda" SWORD RBPtCel_fac_6p10352em5_1 1 100 -2.000000 1.999939 FORMAT "%8.6" ECU_ADDRESS 0x70002E58 /end MEASUREMENT
/begin MEASUREMENT IgCtl_ratLam "air-fuel-ratio for the ignition" UWORD fak_uw_b16 1 100 0.00 15.99976 FORMAT "%8.5" ECU_ADDRESS 0x70002E56 /end MEASUREMENT
/begin MEASUREMENT ignactf_w "Activity flag for ignition channels" UWORD OneToOne 1 100 0.00 65535.00 FORMAT "%8.2" ECU_ADDRESS 0x50005C44 /end MEASUREMENT
/begin MEASUREMENT IgnClPsDD_DataRaw3 "Raw data 3" ULONG dez 1 100 0.00 4294967295.00 FORMAT "%13.2" ECU_ADDRESS 0x50001B00 /end MEASUREMENT
/begin MEASUREMENT IgnClPs_DiaEnaIgn "bitmask activation ignition channel diagnosis" UWORD dez 1 100 0.00 65535.00 FORMAT "%8.2" ECU_ADDRESS 0x60007436 /end MEASUREMENT
/begin MEASUREMENT IgnClPs_flgDiagEnad "Flag ignition line diagnosis enabled" UBYTE B_TRUE 1 100 0.00 1.00000000000 BIT_MASK 0x1 FORMAT "%13.11" ECU_ADDRESS 0x6001012C /end MEASUREMENT
/begin MEASUREMENT IgnClPs_IgnCntCurr "Diagnosis ignition counter current" UWORD dez 1 100 0.00 65535.00 FORMAT "%8.2" ECU_ADDRESS 0x60007434 /end MEASUREMENT
/begin MEASUREMENT IgnClPs_IgnCntOld "Diagnosis ignition counter old" UWORD dez 1 100 0.00 65535.00 FORMAT "%8.2" ECU_ADDRESS 0x60007432 /end MEASUREMENT
/begin MEASUREMENT IgnClPs_LineDiagErrMsk "Bitmask ignition line error" UWORD dez 1 100 0.00 65535.00 FORMAT "%8.2" ECU_ADDRESS 0x60007430 /end MEASUREMENT
/begin MEASUREMENT IgnClPs_LineDiagExec "Bitmask ignition line diagnosis executed" UWORD dez 1 100 0.00 65535.00 FORMAT "%8.2" ECU_ADDRESS 0x6000742E /end MEASUREMENT
/begin MEASUREMENT IgnClPs_ResLineDiag "result ignition line diagnosis" UBYTE IgnClPs_LineDiag_VERB 1 100 0.00 8.00000000000 FORMAT "%13.11" ARRAY_SIZE 4 ECU_ADDRESS 0x6000B7F4 /end MEASUREMENT
/begin MEASUREMENT IgnClPs_valDiaRes "Ignition powerstage error flag word (debounced)" UWORD dez 1 100 0.00 65535.00 FORMAT "%8.2" ECU_ADDRESS 0x6000742C /end MEASUREMENT
/begin MEASUREMENT IgnDD_agIAmaxEffective "current abort angle" SWORD zw_q0p1 1 100 -3276.800 3276.700 FORMAT "%8.3" ECU_ADDRESS 0x5000070E /end MEASUREMENT
/begin MEASUREMENT igndd_cylFreeze "bitcoded cylinderno. with freezed paremeters" UBYTE OneToOne 1 100 0.00 255.0 FORMAT "%5.1" ECU_ADDRESS 0x50006060 /end MEASUREMENT
/begin MEASUREMENT igndd_fdOutPattern_u16 "Current fade out pattern" UWORD OneToOne 1 100 0.00 65535.00 FORMAT "%8.2" ECU_ADDRESS 0x60000602 /end MEASUREMENT
/begin MEASUREMENT igndd_fdPatArray_u16 "Ausblendmuster (Feld indiziert nach Ausblendanfordererer)" UWORD OneToOne 1 100 0.00 65535.00 FORMAT "%8.2" ARRAY_SIZE 27 ECU_ADDRESS 0x50005C46 /end MEASUREMENT
/begin MEASUREMENT IgnDD_flgIAmaxDone "Flag maximum late angle == SY_WMIN" UBYTE B_TRUE 1 100 0.00 1.00000000000 BIT_MASK 0x1 FORMAT "%13.11" ECU_ADDRESS 0x600008DD /end MEASUREMENT
/begin MEASUREMENT igndd_flgWFSDetd "Immobalizer Request Detection Flag" UBYTE B_TRUE 1 100 0.00 1.00000000000 BIT_MASK 0x1 FORMAT "%13.11" ECU_ADDRESS 0x6000B7F3 /end MEASUREMENT
/begin MEASUREMENT igndd_flgWFSDetd_Temp "Immobalizer Request Detection Flag Temporary" UBYTE B_TRUE 1 100 0.00 1.00000000000 BIT_MASK 0x1 FORMAT "%13.11" ECU_ADDRESS 0x6000B7F2 /end MEASUREMENT
/begin MEASUREMENT IgnDD_nrCurrNxtCylInfo_a "cyl.numbers for which new ign.angle values are to be calculated in current early sync (message should be read as optimized)" UBYTE OneToOne 1 100 0.00 255.0 FORMAT "%5.1" ARRAY_SIZE 2 ECU_ADDRESS 0x700035D2 /end MEASUREMENT
/begin MEASUREMENT igndd_nrIgnCntrValOnWFSDetn "Immobalizer Request Detection Ignition counter" UWORD OneToOne 1 100 0.00 65535.00 FORMAT "%8.2" ECU_ADDRESS 0x70002E54 /end MEASUREMENT
/begin MEASUREMENT IgnDD_nrOvlCntr_u8 "Start-Dwell overlap counter (message should be read as optimized)" UBYTE OneToOne 1 100 0.00 255.0 FORMAT "%5.1" ECU_ADDRESS 0x700035D1 /end MEASUREMENT
/begin MEASUREMENT igndd_oldIgnCntVal_u8 "Old value of the hardware driver ignition counter" UBYTE OneToOne 1 100 0.00 255.0 FORMAT "%5.1" ECU_ADDRESS 0x6001186D /end MEASUREMENT
/begin MEASUREMENT igndd_ovl_u8 "Start-Dwell overlap counter" UBYTE OneToOne 1 100 0.00 255.0 FORMAT "%5.1" ECU_ADDRESS 0x50006061 /end MEASUREMENT
/begin MEASUREMENT igndd_state "internal state IgnDD" SLONG OneToOne 1 100 -2147483648.00 2147483647.00 FORMAT "%13.2" ECU_ADDRESS 0x60013A54 /end MEASUREMENT
/begin MEASUREMENT igndd_TiDwlMax_u16 "Max dwell time for Ignition coil in angle mode." UWORD t_q0p001_ms 1 100 0.00 65.53500 FORMAT "%8.5" ECU_ADDRESS 0x700052C6 /end MEASUREMENT
/begin MEASUREMENT igndd_TiDwlMin_u16 "Min dwell time for Ignition coil in angle mode" UWORD t_q0p001_ms 1 100 0.00 65.53500 FORMAT "%8.5" ECU_ADDRESS 0x700052C8 /end MEASUREMENT
/begin MEASUREMENT igndd_zwFreeze_w "freezed ignition angles (cyl.individual)" SWORD zw_q0p1 1 100 -3276.800 3276.700 FORMAT "%8.3" ARRAY_SIZE 4 ECU_ADDRESS 0x50005C7C /end MEASUREMENT
/begin MEASUREMENT ignFadeStatBits_u32 "Ignition fade out request status (which shows the fade out sources that currently request an fade out)" ULONG OneToOne 1 100 0.00 4294967295.00 FORMAT "%13.2" ECU_ADDRESS 0x50004320 /end MEASUREMENT
/begin MEASUREMENT ignswofdly "Number of Ignitions in swith Off synchro" UBYTE OneToOne 1 100 0.00 255.0 FORMAT "%5.1" ECU_ADDRESS 0x70005481 /end MEASUREMENT
/begin MEASUREMENT IntkAirT_tAirFltDsBnk2Tstr "Intake air temperature after air filter bank 2 for tester output" UBYTE temp_ub_q1_o40 1 100 -40.0 215.0 FORMAT "%5.1" ECU_ADDRESS 0x6000B803 /end MEASUREMENT
/begin MEASUREMENT IntkAirT_tAirFltDsTstr "Intake air temperature after air filter for tester output" UBYTE temp_ub_q1_o40 1 100 -40.0 215.0 FORMAT "%5.1" ECU_ADDRESS 0x6000B802 /end MEASUREMENT
/begin MEASUREMENT IntkAirT_tCmprDsBnk2Tstr "intake air temperature after compressor bank 2 for tester output" UBYTE temp_ub_q1_o40 1 100 -40.0 215.0 FORMAT "%5.1" ECU_ADDRESS 0x6000B801 /end MEASUREMENT
/begin MEASUREMENT IntkAirT_tCmprDsTstr "intake air temperature after compressor for tester output" UBYTE temp_ub_q1_o40 1 100 -40.0 215.0 FORMAT "%5.1" ECU_ADDRESS 0x6000B800 /end MEASUREMENT
/begin MEASUREMENT IntkAirT_tIntkMnfldBnk2Tstr "Intake air temperature in manifold bank 2 for tester output" UBYTE temp_ub_q1_o40 1 100 -40.0 215.0 FORMAT "%5.1" ECU_ADDRESS 0x6000B7FF /end MEASUREMENT
/begin MEASUREMENT IntkAirT_tIntkMnfldTstr "Intake air temperature in manifold for tester output" UBYTE temp_ub_q1_o40 1 100 -40.0 215.0 FORMAT "%5.1" ECU_ADDRESS 0x6000B7FE /end MEASUREMENT
/begin MEASUREMENT IntkAirT_tMnfldIcoDsBnk2Tstr "intake air temperature after intercooler in manifold bank 2 for tester output" UBYTE temp_ub_q1_o40 1 100 -40.0 215.0 FORMAT "%5.1" ECU_ADDRESS 0x6000B7FD /end MEASUREMENT
/begin MEASUREMENT IntkAirT_tMnfldIcoDsTstr "intake air temperature after intercooler in manifold for tester output" UBYTE temp_ub_q1_o40 1 100 -40.0 215.0 FORMAT "%5.1" ECU_ADDRESS 0x6000B7FC /end MEASUREMENT
/begin MEASUREMENT IntkAirT_tSnsr1TstrImprt "Intake Air Tempertaure for Scan Service (local copy)" UBYTE temp_ub_q1_o40 1 100 -40.0 215.0 FORMAT "%5.1" ECU_ADDRESS 0x6000B7FB /end MEASUREMENT
/begin MEASUREMENT IntkAirT_tSnsr2TstrImprt "Intake Air Tempertaure for Scan Service (local copy)" UBYTE temp_ub_q1_o40 1 100 -40.0 215.0 FORMAT "%5.1" ECU_ADDRESS 0x6000B7FA /end MEASUREMENT
/begin MEASUREMENT IntkAirT_tThrVlvUsBnk2Tstr "intake air temperature upstream throttle valve bank 2 for tester output" UBYTE temp_ub_q1_o40 1 100 -40.0 215.0 FORMAT "%5.1" ECU_ADDRESS 0x6000B7F9 /end MEASUREMENT
/begin MEASUREMENT IntkAirT_tThrVlvUsTstr "intake air temperature upstream throttle valve for tester output" UBYTE temp_ub_q1_o40 1 100 -40.0 215.0 FORMAT "%5.1" ECU_ADDRESS 0x6000B7F8 /end MEASUREMENT
/begin MEASUREMENT ovlctr_msg "Overlap counter dwell-event" UBYTE OneToOne 1 100 0.00 255.0 FORMAT "%5.1" ECU_ADDRESS 0x70003656 /end MEASUREMENT
/begin MEASUREMENT pnpweths_w_msg "negative pulse width of ethanol sensor signal (percentage of period time)" UWORD rel_q0p01 1 100 0.00 655.3500 FORMAT "%8.4" ECU_ADDRESS 0x60008D32 /end MEASUREMENT
/begin MEASUREMENT RisingEdge_Det "Rising edge detect during postdrive at SCS HW digital input" UBYTE B_TRUE 1 100 0.00 1.00000000000 BIT_MASK 0x1 FORMAT "%13.11" ECU_ADDRESS 0x6000F905 /end MEASUREMENT
/begin MEASUREMENT ShortenPostDrv_Requested "Shorten Post drive Request" UBYTE B_TRUE 1 100 0.00 1.00000000000 BIT_MASK 0x1 FORMAT "%13.11" ECU_ADDRESS 0x6000F8FE /end MEASUREMENT
/begin MEASUREMENT tfst_w_msg "fuel level" UWORD vol_q0p1_l 1 100 0.00 6553.500 FORMAT "%8.3" ECU_ADDRESS 0x60008D08 /end MEASUREMENT
/begin MEASUREMENT tpfeth_w "period for ethanol concentration" UWORD t_q1p28Em5_s 1 100 0.00 0.8388480 FORMAT "%9.7" ECU_ADDRESS 0x6000743A /end MEASUREMENT
/begin MEASUREMENT udst_w_msg "Value first tank pressure sensor" UWORD spg_uw_b5 1 100 0.00 319.9951 FORMAT "%8.4" ECU_ADDRESS 0x6000929C /end MEASUREMENT
/begin MEASUREMENT unfst_w_msg "UBat standardized tank level sensor voltage" UWORD spg_uw_q0p004888 1 100 0.00 320.3351 FORMAT "%8.4" ECU_ADDRESS 0x60008CF8 /end MEASUREMENT
/begin MEASUREMENT VlvLft_fbIntkDrct11_loc "Pressure SwitchFeedback for actuator11 intake direct access" UBYTE B_TRUE 1 100 0.00 1.00000000000 BIT_MASK 0x1 FORMAT "%13.11" ECU_ADDRESS 0x6000090C /end MEASUREMENT
/begin MEASUREMENT VlvLft_fbIntkSwtOutp11 "Pressure SwitchFeedback for actuator11" UBYTE B_TRUE 1 100 0.00 1.00000000000 BIT_MASK 0x1 FORMAT "%13.11" ECU_ADDRESS 0x70003604 /end MEASUREMENT
/begin MEASUREMENT VlvLft_fbSnsrIntkOutp11 "intake feedback flag for LowHigh Lift" UBYTE B_TRUE 1 100 0.00 1.00000000000 BIT_MASK 0x1 FORMAT "%13.11" ECU_ADDRESS 0x70002E5E /end MEASUREMENT
/begin MEASUREMENT VlvLft_pSnsrIntk "physical VTEC oil pressure intake" SWORD Pres 1 100 -3276.800 3276.700 FORMAT "%8.3" ECU_ADDRESS 0x70003A26 /end MEASUREMENT
/begin MEASUREMENT VlvLft_stFbSnsrActvIntk "Status flag for valvelift intake feedback sensor active" UBYTE B_TRUE 1 100 0.00 1.00000000000 BIT_MASK 0x1 FORMAT "%13.11" ECU_ADDRESS 0x700035FD /end MEASUREMENT
/begin MEASUREMENT Vlvlft_stFbSwtActvIntk "Label for Valvelift Intake Feedback Switch Mode" UBYTE B_TRUE 1 100 0.00 1.00000000000 BIT_MASK 0x1 FORMAT "%13.11" ECU_ADDRESS 0x700035FC /end MEASUREMENT
/begin MEASUREMENT VlvLft_uRawPSnsrIntk "Intake raw voltage pressure value of VTEC oil sensor" SWORD Volt 1 100 -6553.600 6553.400 FORMAT "%8.3" ECU_ADDRESS 0x70003A24 /end MEASUREMENT
/begin MEASUREMENT VlvLft_uRawPSnsrIntkFild "Filtered raw pressure voltage(intake) value" SWORD Volt 1 100 -6553.600 6553.400 FORMAT "%8.3" ECU_ADDRESS 0x70002E5C /end MEASUREMENT
/begin MEASUREMENT VlvLiftCtl_ActrActv_VHE_1 "State of valve lift actuator intake channel 1" UBYTE dez 1 100 0.00 255.0 FORMAT "%5.1" ECU_ADDRESS 0x60000994 /end MEASUREMENT
/begin MEASUREMENT zwoutaktarCpl_w "data redundancy actual output ignition angle array" UWORD OneToOne 1 100 0.00 65535.00 FORMAT "%8.2" ARRAY_SIZE 4 ECU_ADDRESS 0x70002E4C /end MEASUREMENT
/begin MEASUREMENT zwoutaktar_w "actual output ignition angle array(sint16)" SWORD zw_q0p1 1 100 -3276.800 3276.700 FORMAT "%8.3" ARRAY_SIZE 4 ECU_ADDRESS 0x50000584 /end MEASUREMENT
/begin MEASUREMENT zwoutakt_w_msg "actual ignition angle array taking into account overlap(sint16)" SWORD zw_q0p1 1 100 -3276.800 3276.700 FORMAT "%8.3" ECU_ADDRESS 0x600095A2 /end MEASUREMENT
/begin MEASUREMENT zzaehl_msg "Ignition counter(ref.%HT2KTIGNI / IGNDD)" UBYTE OneToOne 1 100 0.00 255.0 FORMAT "%5.1" ECU_ADDRESS 0x600009A9 /end MEASUREMENT
/begin MEASUREMENT zzaehl_w_msg "Ignition counter(ref.HT2KTIGNI IGNDD)" UWORD OneToOne 1 100 0.00 65535.00 FORMAT "%8.2" ECU_ADDRESS 0x600008A4 /end MEASUREMENT
/begin FUNCTION HLSDem_NMaxPTCoord "28.0.0    Coordination of max. allowed engine speed due to all used engines"
 /begin DEF_CHARACTERISTIC HLSDem_dnGradCVT_C HLSDem_dnGradLim_C HLSDem_dnHiDrgThres_C HLSDem_dnRmpNeg_MAP HLSDem_dnRmpPos_C HLSDem_nAcsLimThres_C HLSDem_nGearLimThres_C HLSDem_nMaxDspl_C HLSDem_nMaxLimErr1_C HLSDem_nMaxLimErr2_C HLSDem_nMaxLimErr3_C HLSDem_nMaxPModeActv_C HLSDem_nMaxPTCoord_CW HLSDem_nMaxRGear_C HLSDem_nMaxTModeActv_C HLSDem_nMaxVErr_CA HLSDem_nMaxVErr_CUR HLSDem_nSetPHiBas_MAP HLSDem_nSysErrLimThres_C HLSDem_nTraLimThres_C HLSDem_rAppMin_C HLSDem_stPTMaxPrio_CW HLSDem_swtTempSel_C HLSDem_tiNMaxDelVErr_C HLSDem_tiRlsRmp_C HLSDem_vVehMin_C /end DEF_CHARACTERISTIC
 /begin IN_MEASUREMENT APP_r CEngDsT_t CoPT_nMaxAcs CoPT_nMaxSysErr CoPT_nMaxTra CrCtl_stActive Epm_nEng HLSDem_bNMaxRed HLSDem_nMaxEng HLSDem_nMaxEngFltGov HLSDem_nMaxEngUnFlt HLSDem_nMaxEngWoHalt HLSDem_nMaxEngWoHaltGov LLim_stActive OilSwmpT_t PT_rTrq PT_stTraRevGear PT_stTraType SpdGov_nMaxPrdc Tra_numGear VehV_v VMD_rVirtAPP /end IN_MEASUREMENT
 /begin OUT_MEASUREMENT HLSDem_bNMaxRmpUp HLSDem_bPTMaxPrio HLSDem_nGearLim HLSDem_nMaxDspl HLSDem_nMaxRmp HLSDem_nSetPHi HLSDem_stNMaxWarnDspl HLSDem_stPTLim /end OUT_MEASUREMENT
 /begin LOC_MEASUREMENT HLSDem_bNMaxRedPT HLSDem_bRmpUpRdy HLSDem_dnMaxEng HLSDem_nHiTemp_mp HLSDem_nMaxEngOld HLSDem_nMaxLimpHome HLSDem_nMaxUnFltPT_mp HLSDem_nMaxVErr_mp HLSDem_nSetPHiBas_mp HLSDem_nSpHiUnFlt HLSDem_numGear HLSDem_tTempSel /end LOC_MEASUREMENT
 FUNCTION_VERSION "28.0.0" /end FUNCTION
/begin FUNCTION HT2KTFETH "12.1.0    interface hardware driver - component driver for ethanol sensor in fuel" /begin IN_MEASUREMENT SyC_stSub /end IN_MEASUREMENT /begin OUT_MEASUREMENT B_ethsemn_msg B_ethsemx_msg fqethsr_w_msg pnpweths_w_msg /end OUT_MEASUREMENT /begin LOC_MEASUREMENT tpfeth_w /end LOC_MEASUREMENT FUNCTION_VERSION "12.1.0" /end FUNCTION
/begin FUNCTION HT2KTFST "11.3.0    Connection of fuel level sensor to engine controler with raw signal conditioning" /begin DEF_CHARACTERISTIC KLUFSTLIN UBNFST /end DEF_CHARACTERISTIC /begin REF_CHARACTERISTIC CWGGFST /end REF_CHARACTERISTIC /begin IN_MEASUREMENT BattU_u SyC_stSub ufst_w_msg /end IN_MEASUREMENT /begin OUT_MEASUREMENT tfst_w_msg unfst_w_msg /end OUT_MEASUREMENT FUNCTION_VERSION "11.3.0" /end FUNCTION
/begin FUNCTION HT2KTVH "14.2.0    ME(D)17 hardware-/component driver switched valve lift"
 /begin DEF_CHARACTERISTIC VlvLft_pOilPIntkHighrThd_C VlvLft_pOilPIntkLowrThd_C VlvLft_pTrfPSnsrIntk_T Vlvlft_stFbIntkSwt_C VlvLft_tiOilPSnsrIntkLT_C VlvLft_tiSpclPrSwtIntkDeb_C VlvLft_tiStdPrSwtIntkDeb_C /end DEF_CHARACTERISTIC
 /begin IN_MEASUREMENT SyC_stSub VlvLft_flgCtrlActrIntk1 VlvLft_tiDlyVlvActvnIntk /end IN_MEASUREMENT
 /begin OUT_MEASUREMENT VlvLft_fbIntkSwtOutp11 VlvLft_pSnsrIntk VlvLft_stFbSnsrActvIntk Vlvlft_stFbSwtActvIntk VlvLft_uRawPSnsrIntk VlvLiftCtl_ActrActv_VHE_1 /end OUT_MEASUREMENT
 /begin LOC_MEASUREMENT B_cht2ktvhe VlvLft_fbIntkDrct11_loc VlvLft_fbSnsrIntkOutp11 VlvLft_uRawPSnsrIntkFild /end LOC_MEASUREMENT
 FUNCTION_VERSION "14.2.0" /end FUNCTION
/begin FUNCTION HWSIG "14721.0.0_3.2.0Hardware Signals"
 /begin DEF_CHARACTERISTIC HWSIG_stMinTiNotReqd_C HWSIG_tiPostDrvMin_C HWSIG_tiShortPostDrvDebDelay_C QuickShtDwn_EnaFeat_C /end DEF_CHARACTERISTIC
 /begin IN_MEASUREMENT SyC_ctPostDrvLeave SyC_stSub /end IN_MEASUREMENT
 /begin OUT_MEASUREMENT BattuT30C_uRaw udst_w_msg /end OUT_MEASUREMENT
 /begin LOC_MEASUREMENT HWSIG_ctSrvChkReIni HWSIG_PostDrvMinMaxTmr HWSIG_ShortenPostDrv_Requested_Deb HWSIG_stSrvChkSwt HWSIG_stSrvChkSwt_old RisingEdge_Det ShortenPostDrv_Requested /end LOC_MEASUREMENT
 FUNCTION_VERSION "14721.0.0_3.2.0" /end FUNCTION
/begin FUNCTION I14229_AC "1997.0.1  Customer specific service 0xAC" /begin IN_MEASUREMENT Sia_stIgnLck /end IN_MEASUREMENT FUNCTION_VERSION "1997.0.1" /end FUNCTION
/begin FUNCTION I14229_Appl "1997.12.0 UDS Service Application"
 /begin DEF_CHARACTERISTIC Com_lDistShipModLim_C Com_lDstDCLim_C Com_lDstShipMod_C Com_stConvTrgLftSDA_CUR Com_swtLETAcTqResv_C Com_swtLETNoInjCntr_C Com_swtLETORATi_C Com_tiOdoDly_C I14229iocbi_rPCSDutyIni_C I14229_GEVCtl_agMaxAdpdIntk_C I14229_nHpFlInjCdnIdlRunngHi_C I14229_perEthnlCompuCnvn_CUR I14229_SigTabRFFD_CA I14229_stEnaVINDia_C I14229_stSwtOilPmpOutp_C I14229_stVINWriteClrUnit_C I14229_tiEthconcActvTmr_C I14229_tiForceActvTmr_C I14229_tiKsDiag_C I14229_tiPHAACTRINTKTmr_C I14229_tiPHAACTROUTLTmr_C I14229_tiSwtHistDly_C I14229_tiVINWriteClrTimeout_C I14229_TrbCh_uLongTermClsdSensB1_C /end DEF_CHARACTERISTIC
 /begin IN_MEASUREMENT AirC_pAnaClnt APP_uRaw1ADC APP_uRaw2ADC BattU_stPwrFail BattU_u Brk_st Brk_stMn Brk_stRed BusDiag_flgVEHICLEBUSOFF B_dksc CEngDsT_t CEngUsT_t Clth2_st Clth3_st Clth_st CoEng_bStalEng CoEng_st CoEng_tiNormalOBD Com_aLgtG Com_flgEbsRst Com_lDst Com_rEGRIntValMDA Com_stShftInPark Com_stVINWriteClrDone CoVOM_stSSE CoVOM_stStopRls DCM_stCurrDiagcSession EGRVlv_rDesVal EGRVlv_rSens ehlpks_sc ElecLd_iEPSLoadOnly EngPrt_stOvrSpd EpmCaS_ctErrSig EpmCaS_ctNoSig EpmCrS_ctCaSRev EpmCrS_ctErrSig Epm_nEng fethev_w_msg fzabgs_w_msg fzabgzyl_w_msg Gbx_uAna1NPosRaw Gbx_uAna2NPosRaw GEVCtl_agMaxAdpdIntk GEVCtl_agMinAdpdOutl GEVCtl_agSpIntkB1 GEVCtl_agSpOutlB1 GEVlv_agIntkB1 GEVlv_agOutlB1 GEVlv_stGovrIntkB1 GlbDa_lenTotDstDcycHiResl I14229iocbi_numSt I14229iocpMDA_stEGR I14229iocpSDA_stEGR I14229iocp_numCtlSt I14229iocp_stSFTRJC I14229rcCrCtl_stLmp I14229_rPCSDuty I14229_stFlPmpReq I14229_stHpFlInjCdnIdl I14229_stMDA Ign_ia_real_s16 IntkAirT_tSnsr2 IntkAirT_tSnsrFild1 IntkAirT_tSnsrTstr ivzabg_w_msg LIGov_trqI ml_w_msg nstat OilPmp_rPsOilPmp ps_w_msg PthSet_trqInrLtd PT_rTrq PT_stTraType RngMod_trqInrOpt Sia_stOK SyC_ctPostDrvLeave SyC_stSub SysDiag_flgCModJdg T15_st tfa1linf ti1a_l_msg ti2a_l_msg ti3a_l_msg ti4a_l_msg tka_msg TrbCh_uLongTermClsdSensB1 TrbCh_uRawSens1B1 TrbCh_uShoTermClsdSensB1 ubsq udst_w_msg VehV_v wdkba_w_msg wdks_w zzyllfb_msg /end IN_MEASUREMENT
 /begin OUT_MEASUREMENT B_dmdsteol Com_flgLETAcTqResvReplcmt Com_flgLETNoInjCntrCdn Com_flgLETORATmrThd Com_rEGRIntValSDA Com_stMisfDetLineEnd Com_stShipMod ECUSerNum I14229appl_stEGRLftDmd I14229CoEng_tiNormalOBDPrevDcyc I14229EpmCaS_ctErrSig1 I14229EpmCaS_ctNoSig1 I14229GlbDa_lTotDstDCHiResl I14229GlbDa_lTotDstDCHiReslPrevDcyc I14229IntkAirT_tSnsrTstrMax I14229IntkAirT_tSnsrTstrMin I14229RDBI_tiOvrSpd i14229_agIntkB1GEVlv i14229_agIntkB1GEVlvSig i14229_agOutlB1GEVlv i14229_agSpIntkB1GevCtl i14229_agSpOutlB1GEVCtl I14229_AirC_pAnaClnt I14229_Brk_st I14229_Brk_stRed I14229_Com_aLgtG I14229_CThmst_r I14229_ElcWastGatLift_s32 I14229_ElecLd_iEPSLoadOnly I14229_EpmCaS_ctErrSig I14229_EpmCaS_ctErrSig2 I14229_EpmCaS_ctNoSig I14229_EpmCaS_ctNoSig2 I14229_EpmCrS_ctCaSRev I14229_EpmCrS_ctErrSig I14229_flgEthSp I14229_ForceActvTmr I14229_fzabgs_w I14229_fzabgzyl_w I14229_Gbx_uAna1NPosRaw I14229_Gbx_uAna2NPosRaw I14229_GEVCtl_agMaxAdpdIntk I14229_GEVCtl_agMinAdpdOutl I14229_ivzabg_w I14229_LftEGRDesVal I14229_LftEGRSensVlv I14229_LongTermAdpnVal_s32 I14229_nstat I14229_numDTCFrzFrmHi I14229_numDTCFrzFrmLo I14229_numDTCFrzFrmMid I14229_pEngSrtMin I14229_perEthnlCompuCnvnTmp I14229_ps_w I14229_rHtgS2B1 I14229_rTrqPT I14229_stBrkMnRaw I14229_stClth2 I14229_stClth3 I14229_stClth4Bit0 I14229_stClthBit4 I14229_stDEVG I14229_stForceActvTmr I14229_stGbxRvsPos I14229_stKSdiag I14229_stPHAACTRINTKTmr I14229_stPHAACTROUTLTmr I14229_stSwtHistFlg I14229_stSwtOffOnHistFlg I14229_stSwtOnOffHistFlg I14229_stTURBODV I14229_stVBM I14229_stVINWriteClrDone I14229_stVINWriteClrReq I14229_tiInj1On I14229_tIntkAirTSnsr2 I14229_tiSia I14229_tiVINWriteClrTimeout_mp I14229_tka I14229_tkaMax I14229_tkaMin I14229_tmotMaxCurrDcyc I14229_tmotMaxPrevDcyc I14229_tmotMinCurrDcyc I14229_tmotMinPrevDcyc I14229_trqInrLtdPthSet I14229_trqSetEngTrqPtd I14229_tSnsrFild1 I14229_ubsq I14229_udst I14229_umsrln_w I14229_wdkba_w I14229_wdks_w I14229_wped1 I14229_wped2 I14229_zwist /end OUT_MEASUREMENT
 /begin LOC_MEASUREMENT Com_lDstDCShip Com_lTarShipModDst Com_stShipModOdoSupp Com_stShipModSupp Com_stShipModSuppFlg I14229RDBI_nOvrSpd I14229_cntrReIni I14229_lDst I14229_stSwtHistDly_mp I14229_tiVINWriteClrTimeoutNRC22_mp /end LOC_MEASUREMENT
 FUNCTION_VERSION "1997.12.0" /end FUNCTION
/begin FUNCTION I14229_B8 "1997.0.0  Optional On Board Snap Shot Setting service" FUNCTION_VERSION "1997.0.0" /end FUNCTION
/begin FUNCTION I14229_B9 "1997.5.0  Customer specific service 0xB9" /begin DEF_CHARACTERISTIC I14229_stSwtB9SecuChkEna_C /end DEF_CHARACTERISTIC
 /begin IN_MEASUREMENT AirC_stPsCmpr AirC_stSwt Batt_flgDeternDetd Batt_flgInhbSpst Batt_stEngStopInhbn BdInt_stInhbReas BrkPed_bEngStopEna BrkPed_flgISABBrkPSuffVehStill BrkPed_flgSlopeExcd BrkPed_flgSwtISABAvl Brk_stMn B_abor_msg B_kl15 B_llri Clth3_st Com_stInShiftNeut Com_stInShiftPrkg Com_stShftInNeutr Com_stShftInPark Com_stStSpEngStop Com_stTranStop CoVOM_bSSEEna CoVOM_bStopReq CoVOM_bVXSinceStrtDeb CoVOM_stISGoStb CoVOM_stISStopInhb CoVOM_stStopReqCdn CoVOM_stStopRls Epm_nEng Epm_numCyl ESS_bEngStopEna mshfmst_w PthSet_bEnaFCO PT_bEngStopEna PT_bEngStopReq PT_stTraType RESERVED_BIT0 RESERVED_BIT1 Sia_stIgnLck StSpSwt_st VlvLft_flgCtrlActrIntk1 VlvLft_flgFbVlvStIntk /end IN_MEASUREMENT
 FUNCTION_VERSION "1997.5.0" /end FUNCTION
/begin FUNCTION I15031Extd_srv1 "30000.18.1Request current powertrain diagnostic data extended" FUNCTION_VERSION "30000.18.1" /end FUNCTION
/begin FUNCTION I15031Extd_srv2 "30000.12.0Request powertrain freeze frame data extended" FUNCTION_VERSION "30000.12.0" /end FUNCTION
/begin FUNCTION I15031Extd_srv37 "30000.7.0 Request of emission-relevant Diagnostic Trouble Codes from currentcompleted driving cycles extended" FUNCTION_VERSION "30000.7.0" /end FUNCTION
/begin FUNCTION I15031Extd_srv4 "30000.7.0_2.1.0Clear and reset emission-related diagnostic information extended" /begin DEF_CHARACTERISTIC I15031_nMaxSrv4_C /end DEF_CHARACTERISTIC /begin IN_MEASUREMENT Epm_nEng /end IN_MEASUREMENT FUNCTION_VERSION "30000.7.0_2.1.0" /end FUNCTION
/begin FUNCTION I15031Extd_srv9 "30000.32.0_1.3.0Request vehicle informations extended"
 /begin DEF_CHARACTERISTIC I15031_srv9PIDTable.PID0_C I15031_srv9PIDTable.PID2_C I15031_srv9PIDTable.PID4_C I15031_srv9PIDTable.PID6_C I15031_srv9PIDTable.PID8_C I15031_srv9PIDTable.PIDA_C I15031_srv9PIDTable.PIDB_C I15031_srv9PIDTable.PIDF_C /end DEF_CHARACTERISTIC
 /begin IN_MEASUREMENT T15_st /end IN_MEASUREMENT
 /begin OUT_MEASUREMENT I15031_ITIDSuppSrv9 I15031_srv9_stCVNRecalc I15031_srv9_ValidCVN /end OUT_MEASUREMENT
 /begin LOC_MEASUREMENT i15031_srv9_CVN_Calc_ui /end LOC_MEASUREMENT
 FUNCTION_VERSION "30000.32.0_1.3.0" /end FUNCTION
/begin FUNCTION I15031_srv1 "30000.40.0Request current powertrain diagnostic data"
 /begin DEF_CHARACTERISTIC I15031_PID13_C I15031_PID1C_C I15031_PID1D_C I15031_PID4FA_C I15031_PID4FB_C I15031_PID4FC_C I15031_PID4FD_C I15031_PID50A_C I15031_PID5F_C I15031_PID65A_C I15031_PID66A_C I15031_PID67A_C I15031_PID68A_C I15031_PID69A_C I15031_PID6AA_C I15031_PID6BA_C I15031_PID6CA_C I15031_PID6DA_C I15031_PID6EA_C I15031_PID6FA_C I15031_PID70A_C I15031_PID71A_C I15031_PID72A_C I15031_PID73A_C I15031_PID74A_C I15031_PID75A_C I15031_PID76A_C I15031_PID77A_C I15031_PID78A_C I15031_PID79A_C I15031_PID7AA_C I15031_PID7BA_C I15031_PID7CA_C I15031_PID7FA_C I15031_PID81A_C I15031_PID82A_C I15031_PID83A_C I15031_PID85A_C I15031_PID86A_C I15031_PID87A_C I15031_PID89A_C I15031_PID8AA_C I15031_PID8BA_C I15031_PID8CA_C I15031_PID8FA_C I15031_PID92A_C I15031_PID93A_C I15031_PID94A_C I15031_PID98A_C I15031_PID99A_C I15031_PID9AA_C I15031_PID9BA_C I15031_PID9CA_C I15031_PID9FA_C I15031_PIDA1A_C I15031_PIDA3A_C I15031_PIDA4A_C I15031_PIDA5A_C I15031_PIDA7A_C I15031_PIDA8A_C I15031_PIDA9A_C I15031_PIDACA_C I15031_stRfrshCal_C /end DEF_CHARACTERISTIC
 /begin OUT_MEASUREMENT I15031_FILLSIG1 I15031_FILLSIG2 I15031_FILLSIG4 I15031_PID13 I15031_PID1C I15031_PID1D I15031_PID4FA I15031_PID4FB I15031_PID4FC I15031_PID4FD I15031_PID50A I15031_PID50B I15031_PID50C I15031_PID50D I15031_PID5F I15031_PID65A I15031_PID66A I15031_PID67A I15031_PID68A I15031_PID69A I15031_PID6AA I15031_PID6BA I15031_PID6CA I15031_PID6DA I15031_PID6EA I15031_PID6FA I15031_PID70A I15031_PID71A I15031_PID72A I15031_PID73A I15031_PID74A I15031_PID75A I15031_PID76A I15031_PID77A I15031_PID78A I15031_PID79A I15031_PID7AA I15031_PID7BA I15031_PID7CA I15031_PID7FA I15031_PID81A I15031_PID82A I15031_PID83A I15031_PID85A I15031_PID86A I15031_PID87A I15031_PID89A I15031_PID8AA I15031_PID8BA I15031_PID8CA I15031_PID8FA I15031_PID92A I15031_PID93A I15031_PID94A I15031_PID98A I15031_PID99A I15031_PID9AA I15031_PID9BA I15031_PID9CA I15031_PID9FA I15031_PIDA1A I15031_PIDA3A I15031_PIDA4A I15031_PIDA5A I15031_PIDA7A I15031_PIDA8A I15031_PIDA9A I15031_PIDACA I15031_PIDSuppSrv1 I15031_Srv12_Ext_DisablPIDSupp /end OUT_MEASUREMENT
 /begin LOC_MEASUREMENT I15031_PIDSuppSrv2 /end LOC_MEASUREMENT
 FUNCTION_VERSION "30000.40.0" /end FUNCTION
/begin FUNCTION I15031_srv2 "30000.6.0 Request powertrain freeze frame data" FUNCTION_VERSION "30000.6.0" /end FUNCTION
/begin FUNCTION I15031_srv37 "30000.9.0_1.1.0Request of emission-relevant DTC's from current/completed driving cycle(s)" FUNCTION_VERSION "30000.9.0_1.1.0" /end FUNCTION
/begin FUNCTION I15031_srv4 "30000.9.0 Clear and reset emission-related diagnostic information" FUNCTION_VERSION "30000.9.0" /end FUNCTION
/begin FUNCTION I15031_srv6 "30000.10.0Request on-board monitoring test results for specific monitored systems" FUNCTION_VERSION "30000.10.0" /end FUNCTION
/begin FUNCTION I15031_Srv8 "3.0.0     Request control of on-board system, test or component" FUNCTION_VERSION "3.0.0" /end FUNCTION
/begin FUNCTION I15031_srv9 "30000.30.0Request vehicle informations" FUNCTION_VERSION "30000.30.0" /end FUNCTION
/begin FUNCTION I15031_Std "30000.25.0Base subservices for emission relevant diagnosis" /begin IN_MEASUREMENT I15031_PIDSuppSrv1 SyC_stSub T15_flgOn T15_st /end IN_MEASUREMENT FUNCTION_VERSION "30000.25.0" /end FUNCTION
/begin FUNCTION IATS2SV "2.0.0     ScanTool Service for Intake Air Temperature Sensors (PID$68h)"
 /begin DEF_CHARACTERISTIC IntkAirT_swtPID68hB_C IntkAirT_swtPID68hC_C IntkAirT_swtPID68hD_C IntkAirT_swtPID68hE_C IntkAirT_swtPID68hF_C IntkAirT_swtPID68hG_C IntkAirT_tDflValPID68_C /end DEF_CHARACTERISTIC
 /begin IN_MEASUREMENT IntkAirT_tSnsr1Tstr IntkAirT_tSnsr2Tstr /end IN_MEASUREMENT
 /begin OUT_MEASUREMENT iats2sva_msg iats2svb_msg iats2svc_msg iats2svd_msg iats2sve_msg iats2svf_msg iats2svg_msg /end OUT_MEASUREMENT
 /begin LOC_MEASUREMENT iats2sva_loc iats2svb_loc iats2svc_loc iats2svd_loc iats2sve_loc iats2svf_loc iats2svg_loc IntkAirT_tAirFltDsBnk2Tstr IntkAirT_tAirFltDsTstr IntkAirT_tCmprDsBnk2Tstr IntkAirT_tCmprDsTstr IntkAirT_tIntkMnfldBnk2Tstr IntkAirT_tIntkMnfldTstr IntkAirT_tMnfldIcoDsBnk2Tstr IntkAirT_tMnfldIcoDsTstr IntkAirT_tSnsr1TstrImprt IntkAirT_tSnsr2TstrImprt IntkAirT_tThrVlvUsBnk2Tstr IntkAirT_tThrVlvUsTstr /end LOC_MEASUREMENT
 FUNCTION_VERSION "2.0.0" /end FUNCTION
/begin FUNCTION IDASECU_IDASB "10.3.0    Signal processing of CAN frame IDASB" /begin DEF_CHARACTERISTIC Com_dIDASBMaxDiff_C Com_dIDASBMaxPer_C Com_stISABasSpd_C /end DEF_CHARACTERISTIC
 /begin IN_MEASUREMENT Com_ctCRingIDASB Com_numCsumIDASB Com_stFrmRxEna Com_stISABasSpd Com_stMon /end IN_MEASUREMENT
 /begin OUT_MEASUREMENT Com_flgIDASBNorm /end OUT_MEASUREMENT
 FUNCTION_VERSION "10.3.0" /end FUNCTION
/begin FUNCTION IgCtl_IaCorrnLam "2.4.0     Calculation of ignition angle corrections depending on Lambda-influence"
 /begin DEF_CHARACTERISTIC IgCtl_diaLamBascIa_T IgCtl_diaLamBasc_M IgCtl_diaLamLteIaLoResl_T IgCtl_facBascLamOperPnt_M IgCtl_facLteLamOperPnt_M IgCtl_flgCylIndLam_C IgCtl_flgOffsRefIgnAgLam_C IgCtl_flgOperPntDpdt_C /end DEF_CHARACTERISTIC
 /begin IN_MEASUREMENT dzwol_w_msg Epm_ctCyl Epm_nEng ExhMgT_ratLamPreIgnCtlCptProtn Ign_ratChrgAirCyl InjSys_ratLamSpSyn0 lambas_w_msg /end IN_MEASUREMENT
 /begin OUT_MEASUREMENT IgCtl_diaBascLam IgCtl_diaBascLamCptProtn IgCtl_diaBascLamWoRefIa IgCtl_diaLteLamLoResl /end OUT_MEASUREMENT
 /begin LOC_MEASUREMENT IgCtl_facBascLamOperPnt IgCtl_facLteLamOperPnt IgCtl_ratLam /end LOC_MEASUREMENT
 FUNCTION_VERSION "2.4.0" /end FUNCTION
/begin FUNCTION IgnClPsDD "1000.6.0  Device driver for ignition coil power stage diagnosis" /begin IN_MEASUREMENT Epm_numCyl /end IN_MEASUREMENT /begin LOC_MEASUREMENT IgnClPsDD_DataRaw3 /end LOC_MEASUREMENT FUNCTION_VERSION "1000.6.0" /end FUNCTION
/begin FUNCTION IgnClPs_Dia "1000.9.0  Diagnosis of Powerstages for Ignition"
 /begin DEF_CHARACTERISTIC IgnClPs_BattUmax_C IgnClPs_BattUmin_C IgnClPs_Count IgnClPs_enaAsgnLoglPhyCyl_C IgnClPs_mskInjOffBenchErr_CW IgnClPs_mskInjOff_CW /end DEF_CHARACTERISTIC
 /begin REF_CHARACTERISTIC Epm_numFireSeg_C /end REF_CHARACTERISTIC
 /begin IN_MEASUREMENT azoffmsk_w_msg BattU_u B_zesync_msg DSM_TripChgFinshd Epm_nEng Epm_numCyl SyC_stSub /end IN_MEASUREMENT
 /begin OUT_MEASUREMENT abmznd_msg IgnClPs_flgDiagEnad /end OUT_MEASUREMENT
 /begin LOC_MEASUREMENT IgnClPs_DiaEnaIgn IgnClPs_IgnCntCurr IgnClPs_IgnCntOld IgnClPs_LineDiagErrMsk IgnClPs_LineDiagExec IgnClPs_ResLineDiag IgnClPs_valDiaRes /end LOC_MEASUREMENT
 FUNCTION_VERSION "1000.9.0" /end FUNCTION
/begin FUNCTION IgnDD "1000.17.1 Componentdriver ignition"
 /begin DEF_CHARACTERISTIC CWZUEAB IgnDD_numIgnIAmaxOverride_C igndd_PercOffsDwlMax_T igndd_PercOffsDwlMin_T IgnDD_tiPercDwellThd_C /end DEF_CHARACTERISTIC
 /begin IN_MEASUREMENT Epm_ctCyl Epm_nEng Epm_nEngLRes Epm_numCyl Epm_stOpMode Epm_stSync frstinjcyl_msg IgCtl_dwltfol_u16 IgCtl_dwlt_u16 IgCtl_numfol_u8 IgCtl_opntfol_u16 MisfDet_maskMisfStiIgn MisfDet_stMisfGenrRunIgn SyC_stSub zwoutzyl_w_msg /end IN_MEASUREMENT
 /begin OUT_MEASUREMENT azoffmsk_w_msg B_zesync_msg ignactf_w igndd_fdOutPattern_u16 IgnDD_nrCurrNxtCylInfo_a IgnDD_nrOvlCntr_u8 ovlctr_msg zwoutaktarCpl_w zwoutaktar_w zwoutakt_w_msg zzaehl_msg zzaehl_w_msg /end OUT_MEASUREMENT
 /begin LOC_MEASUREMENT IgnDD_agIAmaxEffective igndd_cylFreeze igndd_fdPatArray_u16 IgnDD_flgIAmaxDone igndd_flgWFSDetd igndd_flgWFSDetd_Temp igndd_nrIgnCntrValOnWFSDetn igndd_oldIgnCntVal_u8 igndd_ovl_u8 igndd_state igndd_TiDwlMax_u16 igndd_TiDwlMin_u16 igndd_zwFreeze_w ignFadeStatBits_u32 ignswofdly /end LOC_MEASUREMENT
 FUNCTION_VERSION "1000.17.1" /end FUNCTION
/begin FUNCTION IgnH "1000.10.1_1.1.0Hardwaredriver Ignition" /begin DEF_CHARACTERISTIC IgnH_SelnPinActvLvl_C /end DEF_CHARACTERISTIC /begin IN_MEASUREMENT Epm_numCyl /end IN_MEASUREMENT FUNCTION_VERSION "1000.10.1_1.1.0" /end FUNCTION
/begin FUNCTION IgnLck_SetData "2.2.0     Ignition Lock" /begin IN_MEASUREMENT T15_st T50_st /end IN_MEASUREMENT /begin OUT_MEASUREMENT CoVeh_stIgnLckTerm15 CoVeh_stIgnLckTerm50 /end OUT_MEASUREMENT FUNCTION_VERSION "2.2.0" /end FUNCTION
/begin FUNCTION IKCDST "7.4.0     Base point distribution for knock control"
 /begin DEF_CHARACTERISTIC IKCtl_fac04_X_AX IKCtl_Load08_X_AX IKCtl_LoadSyn08_X_AX IKCtl_nEng06_X_AX IKCtl_nEng08_X_AX IKCtl_nEng13_X_AX IKCtl_nEngVar13_X_AX IKCtl_nEngVarSyn13_X_AX IKCtl_ratLoad04_X_AX IKCtl_ratLoadDy04_X_AX /end DEF_CHARACTERISTIC
 /begin IN_MEASUREMENT AirMod_ratChrgAirCyl Epm_nEng fethmnmx_msg SyC_stSub /end IN_MEASUREMENT
 FUNCTION_VERSION "7.4.0" /end FUNCTION
/begin COMPU_METHOD B_TRUE "" TAB_VERB "%6.3" "" COMPU_TAB_REF B_TRUE /end COMPU_METHOD
/begin COMPU_VTAB B_TRUE "" TAB_VERB 2 0 "FALSE" 1 "TRUE" /end COMPU_VTAB
/begin COMPU_METHOD ComGrv_0p002 "" RAT_FUNC "%6.4" "Com_Grv" COEFFS 0 1000 0 0 0 2 /end COMPU_METHOD
/begin COMPU_METHOD CrSRev2CrSInc "" RAT_FUNC "%6.4" "-" COEFFS 0 60 0 0 0 1 /end COMPU_METHOD
/begin COMPU_METHOD dez "" RAT_FUNC "%6.2" "" COEFFS 0 1 0 0 0 1 /end COMPU_METHOD
/begin COMPU_METHOD EngN "" RAT_FUNC "%6.3" "rpm" COEFFS 0 2 0 0 0 1 /end COMPU_METHOD
/begin COMPU_METHOD EngN_LRes "" RAT_FUNC "%6.1" "rpm" COEFFS 0 0.025 0 0 0 1 /end COMPU_METHOD
/begin COMPU_METHOD fak_q3p906Em5 "" RAT_FUNC "%7.6" "-" COEFFS 0 25600 0 0 0 1 /end COMPU_METHOD
/begin COMPU_METHOD fak_ub_b2 "" RAT_FUNC "%8.5" "-" COEFFS 0 256 0 0 0 2 /end COMPU_METHOD
/begin COMPU_METHOD fak_uw_b16 "" RAT_FUNC "%6.5" "-" COEFFS 0 65536 0 0 0 16 /end COMPU_METHOD
/begin COMPU_METHOD fak_uw_b2 "" RAT_FUNC "%7.6" "-" COEFFS 0 65536 0 0 0 2 /end COMPU_METHOD
/begin COMPU_METHOD freq_q0p01 "" RAT_FUNC "%6.4" "Hz" COEFFS 0 100 0 0 0 1 /end COMPU_METHOD
/begin COMPU_METHOD I15031_PID1CVerb "" TAB_VERB "%6.3" "-" COMPU_TAB_REF I15031_PID1CVerb /end COMPU_METHOD
/begin COMPU_VTAB I15031_PID1CVerb "" TAB_VERB 40 1 "OBD II" 2 "OBD" 3 "OBD and OBD II" 4 "OBD I" 5 "No OBD" 6 "EOBD" 7 "EOBD and OBD II" 8 "EOBD and OBD" 9 "EOBD, OBD and OBD II" 10 "JOBD" 11 "JOBD and OBD II" 12 "JOBD and EOBD" 13 "JOBD, EOBD and OBD II" 14 "OBD, EOBD and KOBD" 15 "OBD, OBD II, EOBD and KOBD" 17 "EMD" 18 "EMD+" 19 "HD OBD-C" 20 "HD OBD" 21 "WWH OBD" 23 "HD EOBD-I" 24 "HD EOBD-I N" 25 "HD EOBD-II" 26 "HD EOBD-II N" 28 "OBDBr-1" 29 "OBDBr-2" 30 "KOBD" 31 "IOBD I" 32 "IOBD II" 33 "HD EOBD-VI" 34 "OBD, OBD II and HD OBD" 35 "OBDBr-3" 36 "MC EOBD-I" 37 "MC EOBD-II" 38 "MC COBD-I" 39 "MC TOBD-I" 40 "MC JOBD-I" 41 "CN-OBD-6" 42 "OBDBr-D" 43 "CN-HDOBD-VI" /end COMPU_VTAB
/begin COMPU_METHOD I15031_PID5FVerb "" TAB_VERB "%6.3" "-" COMPU_TAB_REF I15031_PID5FVerb /end COMPU_METHOD
/begin COMPU_VTAB I15031_PID5FVerb "" TAB_VERB 4 14 "EURO IV B1" 15 "EURO V B2" 16 "EURO C" 17 "EURO VI" /end COMPU_VTAB
/begin COMPU_METHOD I15031_srv9_CVN_CalcVerb "" TAB_VERB "%2.1" "-" COMPU_TAB_REF I15031_srv9_CVN_CalcVerb /end COMPU_METHOD
/begin COMPU_VTAB I15031_srv9_CVN_CalcVerb "" TAB_VERB 7 0 "NOTAVAILABLE" 1 "CALC_START" 2 "CALC_BUSY" 3 "CALC_WRITE" 4 "CALC_READY" 5 "CALC_CLEAR" 6 "CALC_CLEARBUSY" /end COMPU_VTAB
/begin COMPU_METHOD IgnClPs_LineDiag_VERB "" TAB_VERB "%6.3" "" COMPU_TAB_REF IgnClPs_LineDiag_VERB /end COMPU_METHOD
/begin COMPU_VTAB IgnClPs_LineDiag_VERB "" TAB_VERB 6 0 "IGNCLPS_LINEDIAGRES_SCTOGND" 1 "IGNCLPS_LINEDIAGRES_OPENLOAD" 2 "IGNCLPS_LINEDIAGRES_SCTOUBATT" 3 "IGNCLPS_LINEDIAGRES_OK" 4 "IGNCLPS_LINEDIAGRES_COMERROR" 8 "IGNCLPS_LINEDIAGRES_NOEXEC" /end COMPU_VTAB
/begin COMPU_METHOD kw_q0p0156 "" RAT_FUNC "%6.4" "Grad KW" COEFFS 0 64 0 0 0 1 /end COMPU_METHOD
/begin COMPU_METHOD kw_q0p75 "" RAT_FUNC "%6.3" "Grad KW" COEFFS 0 4 0 0 0 3 /end COMPU_METHOD
/begin COMPU_METHOD Length_10m "" RAT_FUNC "%6.1" "m" COEFFS 0 0.1 0 0 0 1 /end COMPU_METHOD
/begin COMPU_METHOD Length_q0p05mm "" RAT_FUNC "%6.4" "mm" COEFFS 0 20 0 0 0 1 /end COMPU_METHOD
/begin COMPU_METHOD nmot_ub_q10_rpm "" RAT_FUNC "%6.1" "rpm" COEFFS 0 1 0 0 0 40 /end COMPU_METHOD
/begin COMPU_METHOD OilMlg "" RAT_FUNC "%6.2" "km" COEFFS 0 1 0 0 0 1 /end COMPU_METHOD
/begin COMPU_METHOD OneToOne "" RAT_FUNC "%6.2" "-" COEFFS 0 1 0 0 0 1 /end COMPU_METHOD
/begin COMPU_METHOD OneToOne_ms "" RAT_FUNC "%6.2" "ms" COEFFS 0 1 0 0 0 1 /end COMPU_METHOD
/begin COMPU_METHOD OneToTenCarb "" RAT_FUNC "%6.1" "-" COEFFS 0 0.1 0 0 0 1 /end COMPU_METHOD
/begin COMPU_METHOD Prc "" RAT_FUNC "%6.4" "%" COEFFS 0 81.92 0 0 0 1 /end COMPU_METHOD
/begin COMPU_METHOD Pres "" RAT_FUNC "%6.3" "kPa" COEFFS 0 10 0 0 0 1 /end COMPU_METHOD
/begin COMPU_METHOD Pres_kPa "" RAT_FUNC "%6.3" "kPa" COEFFS 0 10 0 0 0 2 /end COMPU_METHOD
/begin COMPU_METHOD PRTSHFTUPREQ_SY_Compu "" TAB_VERB "%6.3" "" COMPU_TAB_REF PRTSHFTUPREQ_SY_Compu /end COMPU_METHOD
/begin COMPU_VTAB PRTSHFTUPREQ_SY_Compu "" TAB_VERB 2 0 "False" 1 "True" /end COMPU_VTAB
/begin COMPU_METHOD PSC_Fact "" RAT_FUNC "%7.6" "-" COEFFS 0 32767 0 0 0 1 /end COMPU_METHOD
/begin COMPU_METHOD PSNSRCSTRPURGLINE_SC_Compu "" TAB_VERB "%6.3" "" COMPU_TAB_REF PSNSRCSTRPURGLINE_SC_Compu /end COMPU_METHOD
/begin COMPU_VTAB PSNSRCSTRPURGLINE_SC_Compu "" TAB_VERB 3 0 "No Pressure Sensor" 1 "Pressure Sensor after CPV" 2 "PSNSR_BEFORE_CPV" /end COMPU_VTAB
/begin COMPU_METHOD PSP_ATSINTVMOD_SY_Compu "" TAB_VERB "%6.3" "" COMPU_TAB_REF PSP_ATSINTVMOD_SY_Compu /end COMPU_METHOD
/begin COMPU_VTAB PSP_ATSINTVMOD_SY_Compu "" TAB_VERB 2 0 "False" 1 "True" /end COMPU_VTAB
/begin COMPU_METHOD PSP_INHRLYERR_SC_Compu "" TAB_VERB "%6.3" "" COMPU_TAB_REF PSP_INHRLYERR_SC_Compu /end COMPU_METHOD
/begin COMPU_VTAB PSP_INHRLYERR_SC_Compu "" TAB_VERB 2 0 "False" 1 "True" /end COMPU_VTAB
/begin COMPU_METHOD PSP_SWTDIGORPWM_SY_Compu "" TAB_VERB "%6.3" "" COMPU_TAB_REF PSP_SWTDIGORPWM_SY_Compu /end COMPU_METHOD
/begin COMPU_VTAB PSP_SWTDIGORPWM_SY_Compu "" TAB_VERB 3 0 "PSP_DIGOUTPUT" 1 "PSP_PWMOUTPUT" 2 "PSP_DIGANDPWM" /end COMPU_VTAB
/begin COMPU_METHOD PSP_SWTMOCSOP_SY_Compu "" TAB_VERB "%6.3" "" COMPU_TAB_REF PSP_SWTMOCSOP_SY_Compu /end COMPU_METHOD
/begin COMPU_VTAB PSP_SWTMOCSOP_SY_Compu "" TAB_VERB 2 0 "NO_PSP_MOCSOP" 1 "PSP_MOCSOP" /end COMPU_VTAB
/begin COMPU_METHOD PSSC003D17162_SC_Compu "" TAB_VERB "%6.3" "" COMPU_TAB_REF PSSC003D17162_SC_Compu /end COMPU_METHOD
/begin COMPU_VTAB PSSC003D17162_SC_Compu "" TAB_VERB 10 0 "None" 1 "D17162_W12_TSI" 3 "D17162_VR6_TSI_MQB" 4 "D17162_VR6_FSI_MQB" 5 "D17162_VR6_FSI_MQB_RUS" 6 "D17162_W12_TSI_PL65" 7 "D17162_W12_TSI_MSB" 8 "D17162_W12_TSI_D4" 19 "D17162_VR6_TSI_C6" 20 "D17162_VR6_TSI_B6C_RDE" /end COMPU_VTAB
/begin COMPU_METHOD PSSC147GSHEV_SC_Compu "" TAB_VERB "%6.3" "" COMPU_TAB_REF PSSC147GSHEV_SC_Compu /end COMPU_METHOD
/begin COMPU_VTAB PSSC147GSHEV_SC_Compu "" TAB_VERB 2 0 "HEV_Disabled" 1 "HEV_Enabled" /end COMPU_VTAB
/begin COMPU_METHOD PSSC159MED1793TGDIVRNT_SC_Compu "" TAB_VERB "%6.3" "" COMPU_TAB_REF PSSC159MED1793TGDIVRNT_SC_Compu /end COMPU_METHOD
/begin COMPU_VTAB PSSC159MED1793TGDIVRNT_SC_Compu "" TAB_VERB 5 1 "2KR" 2 "2LX" 3 "2SV" 4 "EVA" 5 "CRIDER" /end COMPU_VTAB
/begin COMPU_METHOD PSSC159MED1793_SY_Compu "" TAB_VERB "%6.3" "" COMPU_TAB_REF PSSC159MED1793_SY_Compu /end COMPU_METHOD
/begin COMPU_VTAB PSSC159MED1793_SY_Compu "" TAB_VERB 3 1 "EVA (3-Cyl)" 2 "2LX (4-Cyl)" 3 "2SV (4-Cyl)" /end COMPU_VTAB
/begin COMPU_METHOD PS_NUMSENS_SY_Compu "" RAT_FUNC "%6.2" "" COEFFS 0 1 0 0 0 1 /end COMPU_METHOD
/begin COMPU_METHOD PTACTVN_SC_Compu "" TAB_VERB "%6.3" "" COMPU_TAB_REF PTACTVN_SC_Compu /end COMPU_METHOD
/begin COMPU_VTAB PTACTVN_SC_Compu "" TAB_VERB 2 0 "False" 1 "True" /end COMPU_VTAB
/begin COMPU_METHOD PTHRESCUS_SY_Compu "" RAT_FUNC "%6.2" "" COEFFS 0 1 0 0 0 1 /end COMPU_METHOD
/begin COMPU_METHOD PTHRVLVDS_PDRPMDL_SC_Compu "" TAB_VERB "%6.3" "" COMPU_TAB_REF PTHRVLVDS_PDRPMDL_SC_Compu /end COMPU_METHOD
/begin COMPU_VTAB PTHRVLVDS_PDRPMDL_SC_Compu "" TAB_VERB 3 0 "NO_MDL" 1 "CNG_MDL" 2 "CAC_MDL" /end COMPU_VTAB
/begin COMPU_METHOD PTHRVLVDS_SNSR1PRSNT_SC_Compu "" TAB_VERB "%6.3" "" COMPU_TAB_REF PTHRVLVDS_SNSR1PRSNT_SC_Compu /end COMPU_METHOD
/begin COMPU_VTAB PTHRVLVDS_SNSR1PRSNT_SC_Compu "" TAB_VERB 2 0 "False" 1 "True" /end COMPU_VTAB
/begin COMPU_METHOD PTHRVLVDS_TYPAVL_SC_Compu "" TAB_VERB "%6.3" "" COMPU_TAB_REF PTHRVLVDS_TYPAVL_SC_Compu /end COMPU_METHOD
/begin COMPU_VTAB PTHRVLVDS_TYPAVL_SC_Compu "" TAB_VERB 2 0 "False" 1 "True" /end COMPU_VTAB
/begin COMPU_METHOD PTHRVLVUSPRS_SC_Compu "" TAB_VERB "%6.3" "" COMPU_TAB_REF PTHRVLVUSPRS_SC_Compu /end COMPU_METHOD
/begin COMPU_VTAB PTHRVLVUSPRS_SC_Compu "" TAB_VERB 2 0 "False" 1 "True" /end COMPU_VTAB
/begin COMPU_METHOD PTHRVLVUS_PDRPMDL_SC_Compu "" TAB_VERB "%6.3" "" COMPU_TAB_REF PTHRVLVUS_PDRPMDL_SC_Compu /end COMPU_METHOD
/begin COMPU_VTAB PTHRVLVUS_PDRPMDL_SC_Compu "" TAB_VERB 3 0 "NO_MDL" 1 "ADDLCPT_MDL" 2 "DYNPCORRN_MDL" /end COMPU_VTAB
/begin COMPU_METHOD PTHRVLVUS_SNSR1PRSNT_SC_Compu "" TAB_VERB "%6.3" "" COMPU_TAB_REF PTHRVLVUS_SNSR1PRSNT_SC_Compu /end COMPU_METHOD
/begin COMPU_VTAB PTHRVLVUS_SNSR1PRSNT_SC_Compu "" TAB_VERB 2 0 "False" 1 "True" /end COMPU_VTAB
/begin COMPU_METHOD PTHRVLVUS_SNSR2PRSNT_SC_Compu "" TAB_VERB "%6.3" "" COMPU_TAB_REF PTHRVLVUS_SNSR2PRSNT_SC_Compu /end COMPU_METHOD
/begin COMPU_VTAB PTHRVLVUS_SNSR2PRSNT_SC_Compu "" TAB_VERB 2 0 "False" 1 "True" /end COMPU_VTAB
/begin COMPU_METHOD PTLHC_SY_Compu "" TAB_VERB "%6.3" "" COMPU_TAB_REF PTLHC_SY_Compu /end COMPU_METHOD
/begin COMPU_VTAB PTLHC_SY_Compu "" TAB_VERB 2 0 "FALSE" 1 "TRUE" /end COMPU_VTAB
/begin COMPU_METHOD PTO_SY_Compu "" TAB_VERB "%6.3" "" COMPU_TAB_REF PTO_SY_Compu /end COMPU_METHOD
/begin COMPU_VTAB PTO_SY_Compu "" TAB_VERB 2 0 "False" 1 "True" /end COMPU_VTAB
/begin COMPU_METHOD PTRBNABSLTUS_TYPAVL_SC_Compu "" TAB_VERB "%6.3" "" COMPU_TAB_REF PTRBNABSLTUS_TYPAVL_SC_Compu /end COMPU_METHOD
/begin COMPU_VTAB PTRBNABSLTUS_TYPAVL_SC_Compu "" TAB_VERB 2 0 "False" 1 "True" /end COMPU_VTAB
/begin COMPU_METHOD PTRBNDS_TYPAVL_SY_Compu "" TAB_VERB "%6.3" "" COMPU_TAB_REF PTRBNDS_TYPAVL_SY_Compu /end COMPU_METHOD
/begin COMPU_VTAB PTRBNDS_TYPAVL_SY_Compu "" TAB_VERB 2 0 "False" 1 "True" /end COMPU_VTAB
/begin COMPU_METHOD PT_SWGRIP_SY_Compu "" TAB_VERB "%6.3" "" COMPU_TAB_REF PT_SWGRIP_SY_Compu /end COMPU_METHOD
/begin COMPU_VTAB PT_SWGRIP_SY_Compu "" TAB_VERB 2 0 "0" 1 "1" /end COMPU_VTAB
/begin COMPU_METHOD PURGLINEISOVLV_SC_Compu "" TAB_VERB "%6.3" "" COMPU_TAB_REF PURGLINEISOVLV_SC_Compu /end COMPU_METHOD
/begin COMPU_VTAB PURGLINEISOVLV_SC_Compu "" TAB_VERB 2 0 "False" 1 "True" /end COMPU_VTAB
/begin COMPU_METHOD Pwr "" RAT_FUNC "%6.2" "W" COEFFS 0 0.10610329539459 0 0 0 1 /end COMPU_METHOD
/begin COMPU_METHOD Pwr2Temp_q0p001 "" RAT_FUNC "%6.4" "W/K" COEFFS 0 100 0 0 0 1 /end COMPU_METHOD
/begin COMPU_METHOD Pwr2Temp_q0p1 "" RAT_FUNC "%6.3" "W/K" COEFFS 0 10 0 0 0 1 /end COMPU_METHOD
/begin COMPU_METHOD PWRINTENGNLIM_SY_Compu "" TAB_VERB "%6.3" "" COMPU_TAB_REF PWRINTENGNLIM_SY_Compu /end COMPU_METHOD
/begin COMPU_VTAB PWRINTENGNLIM_SY_Compu "" TAB_VERB 2 0 "False" 1 "True" /end COMPU_VTAB
/begin COMPU_METHOD PwrSq2TempSq_q0p01 "" RAT_FUNC "%6.4" "W^2/K^2" COEFFS 0 100 0 0 0 1 /end COMPU_METHOD
/begin COMPU_METHOD PWRTRN_BELTSTRTRGENRAVL_SC_Compu "" TAB_VERB "%6.3" "" COMPU_TAB_REF PWRTRN_BELTSTRTRGENRAVL_SC_Compu /end COMPU_METHOD
/begin COMPU_VTAB PWRTRN_BELTSTRTRGENRAVL_SC_Compu "" TAB_VERB 2 0 "Disabled" 1 "Enabled" /end COMPU_VTAB
/begin COMPU_METHOD PWRTRN_ENAINDCCOGBXINTV_SC_Compu "" TAB_VERB "%6.3" "" COMPU_TAB_REF PWRTRN_ENAINDCCOGBXINTV_SC_Compu /end COMPU_METHOD
/begin COMPU_VTAB PWRTRN_ENAINDCCOGBXINTV_SC_Compu "" TAB_VERB 2 0 "False" 1 "True" /end COMPU_VTAB
/begin COMPU_METHOD Pwr_q1 "" RAT_FUNC "%6.2" "W" COEFFS 0 1 0 0 0 1 /end COMPU_METHOD
/begin COMPU_METHOD Pwr_W_q4p0_COMPU "" RAT_FUNC "%6.2" "W" COEFFS 0 1 0 0 0 4 /end COMPU_METHOD
/begin COMPU_METHOD p_uw_q0p039_mmHg "" RAT_FUNC "%6.4" "mmHg" COEFFS 0 256 0 0 0 7.500637 /end COMPU_METHOD
/begin COMPU_METHOD q1p412_L_DIV_min "" RAT_FUNC "%6.2" "" COEFFS 0 1728 0 0 0 2440 /end COMPU_METHOD
/begin COMPU_METHOD q9p3132Em10_mol_DIV_s "" RAT_FUNC "%12.11" "mol/s" COEFFS 0 1073741824 0 0 0 1 /end COMPU_METHOD
/begin COMPU_METHOD QCKSTRTSPCVERS_SC_Compu "" TAB_VERB "%6.3" "" COMPU_TAB_REF QCKSTRTSPCVERS_SC_Compu /end COMPU_METHOD
/begin COMPU_VTAB QCKSTRTSPCVERS_SC_Compu "" TAB_VERB 5 0 "SHTRP_ACTV" 1 "QUICKSTART_INITIAL" 2 "QUICKSTART_FULL" 3 "LH_31_V100_STEP1" 4 "LH_31_V100_FULL" /end COMPU_VTAB
/begin COMPU_METHOD QntR "" RAT_FUNC "%6.5" "-" COEFFS 0 1024 0 0 0 1 /end COMPU_METHOD
/begin COMPU_METHOD QNTSTMOT_SY_Compu "" TAB_VERB "%6.3" "" COMPU_TAB_REF QNTSTMOT_SY_Compu /end COMPU_METHOD
/begin COMPU_VTAB QNTSTMOT_SY_Compu "" TAB_VERB 2 0 "QNTSTMOT_SY == 0" 1 "QNTSTMOT_SY == 1" /end COMPU_VTAB
/begin COMPU_METHOD Qp_mm3_sec "" RAT_FUNC "%6.1" "mm3/s" COEFFS 0 0.1 0 0 0 1 /end COMPU_METHOD
/begin COMPU_METHOD QUICKSHIFT_SC_Compu "" TAB_VERB "%6.3" "" COMPU_TAB_REF QUICKSHIFT_SC_Compu /end COMPU_METHOD
/begin COMPU_VTAB QUICKSHIFT_SC_Compu "" TAB_VERB 2 0 "False" 1 "True" /end COMPU_VTAB
/begin COMPU_METHOD RADSHT_NRACTR_SC_Compu "" RAT_FUNC "%6.2" "" COEFFS 0 1 0 0 0 1 /end COMPU_METHOD
/begin COMPU_METHOD RADSHT_SY_Compu "" TAB_VERB "%6.3" "" COMPU_TAB_REF RADSHT_SY_Compu /end COMPU_METHOD
/begin COMPU_VTAB RADSHT_SY_Compu "" TAB_VERB 3 0 "OFF" 1 "HW" 2 "LIN" /end COMPU_VTAB
/begin COMPU_METHOD RailHrsEngOn "" RAT_FUNC "%6.0" "h" COEFFS 0 0.01 0 0 0 1 /end COMPU_METHOD
/begin COMPU_METHOD RatAirMass "" RAT_FUNC "%6.4" "-" COEFFS 0 100 0 0 0 1 /end COMPU_METHOD
/begin COMPU_METHOD RatAirMassHigh "" RAT_FUNC "%6.5" "-" COEFFS 0 1000 0 0 0 1 /end COMPU_METHOD
/begin COMPU_METHOD RatAirMassPerTime_COMPU "" RAT_FUNC "%6.3" "1/s" COEFFS 0 10 0 0 0 1 /end COMPU_METHOD
/begin COMPU_METHOD RatAirPres_COMPU "" RAT_FUNC "%6.5" "-" COEFFS 0 1000 0 0 0 1 /end COMPU_METHOD
/begin COMPU_METHOD RatAshMass "" RAT_FUNC "%8.7" "-" COEFFS 0 100000 0 0 0 1 /end COMPU_METHOD
/begin COMPU_METHOD RatCOMass "" RAT_FUNC "%9.8" "-" COEFFS 0 1000000 0 0 0 1 /end COMPU_METHOD
/begin COMPU_METHOD RatFuelMass "" RAT_FUNC "%6.4" "-" COEFFS 0 100 0 0 0 1 /end COMPU_METHOD
/begin COMPU_METHOD RatFuelMassHi "" RAT_FUNC "%8.7" "-" COEFFS 0 100000 0 0 0 1 /end COMPU_METHOD
/begin COMPU_METHOD RatHiRes_CPP_COMPU "" RAT_FUNC "%7.6" "-" COEFFS 0 10000 0 0 0 1 /end COMPU_METHOD
/begin COMPU_METHOD RatNOxMass "" RAT_FUNC "%10.9" "-" COEFFS 0 10000000 0 0 0 1 /end COMPU_METHOD
/begin COMPU_METHOD RatSotMass "" RAT_FUNC "%8.7" "-" COEFFS 0 100000 0 0 0 1 /end COMPU_METHOD
/begin COMPU_METHOD RatSotSot "" RAT_FUNC "%6.5" "-" COEFFS 0 4000 0 0 0 1 /end COMPU_METHOD
/begin COMPU_METHOD RatSOxMass "" RAT_FUNC "%11.10" "-" COEFFS 0 100000000 0 0 0 1 /end COMPU_METHOD
/begin COMPU_METHOD RBANDSTYPE_SC_Compu "" TAB_VERB "%6.3" "" COMPU_TAB_REF RBANDSTYPE_SC_Compu /end COMPU_METHOD
/begin COMPU_VTAB RBANDSTYPE_SC_Compu "" TAB_VERB 4 0 "NO_RBANDS" 1 "ONLY_RBANDS" 2 "MIXED_RBANDS" 3 "MSR_RBANDS" /end COMPU_VTAB
/begin COMPU_METHOD RBA_SWTRACEENA_SC_Compu "" TAB_VERB "%6.3" "" COMPU_TAB_REF RBA_SWTRACEENA_SC_Compu /end COMPU_METHOD
/begin COMPU_VTAB RBA_SWTRACEENA_SC_Compu "" TAB_VERB 2 0 "False" 1 "True" /end COMPU_VTAB
/begin COMPU_METHOD RBPtCel_a_1p0_1 "" RAT_FUNC "%6.2" "m/s^2" COEFFS 0 1 0 0 0 1 /end COMPU_METHOD
/begin COMPU_METHOD RBPtCel_dst_1p0_4 "" RAT_FUNC "%6.2" "km" COEFFS 0 1 0 0 0 1 /end COMPU_METHOD
/begin COMPU_METHOD RBPtCel_fac_0p125_1 "" RAT_FUNC "%6.3" "-" COEFFS 0 8 0 0 0 1 /end COMPU_METHOD
/begin COMPU_METHOD RBPtCel_fac_1p0_8 "" RAT_FUNC "%6.2" "%/s" COEFFS 0 1 0 0 0 1 /end COMPU_METHOD
/begin COMPU_METHOD RBPtCel_fac_6p10352em5_1 "" RAT_FUNC "%7.6" "-" COEFFS 0 65536 0 0 0 4 /end COMPU_METHOD
/begin COMPU_METHOD RBPtCel_fPerp_1p0_1 "" RAT_FUNC "%6.2" "N/Bar" COEFFS 0 1 0 0 0 1 /end COMPU_METHOD
/begin COMPU_METHOD RBPtCel_frq_1p0_1 "" RAT_FUNC "%6.2" "1/s" COEFFS 0 1 0 0 0 1 /end COMPU_METHOD
/begin COMPU_METHOD RBPtCel_fti_1p0_1 "" RAT_FUNC "%6.2" "Ns" COEFFS 0 1 0 0 0 1 /end COMPU_METHOD
/begin COMPU_METHOD RBPtCel_f_1p0_1 "" RAT_FUNC "%6.2" "N" COEFFS 0 1 0 0 0 1 /end COMPU_METHOD
/begin COMPU_METHOD RBPtCel_i_1p0_1 "" RAT_FUNC "%6.2" "mA" COEFFS 0 1 0 0 0 1 /end COMPU_METHOD
/begin COMPU_METHOD RBPtCel_i_1p0_2 "" RAT_FUNC "%6.2" "A" COEFFS 0 1 0 0 0 1 /end COMPU_METHOD
/begin COMPU_METHOD RBPtCel_nGrdt_1p0_1 "" RAT_FUNC "%6.2" "rpm/s" COEFFS 0 1 0 0 0 1 /end COMPU_METHOD
/begin COMPU_METHOD RBPtCel_p_1p0_2 "" RAT_FUNC "%6.2" "Bar" COEFFS 0 1 0 0 0 1 /end COMPU_METHOD
/begin COMPU_METHOD RBPtCel_t_1p0_om40_1 "" RAT_FUNC "%6.2" "Deg C" COEFFS 0 1 40 0 0 1 /end COMPU_METHOD
/begin COMPU_METHOD RBPtCel_u_1p0_1 "" RAT_FUNC "%6.2" "V" COEFFS 0 1 0 0 0 1 /end COMPU_METHOD
/begin COMPU_METHOD RBPtCel_vf_1p0_2 "" RAT_FUNC "%6.2" "l/min" COEFFS 0 1 0 0 0 1 /end COMPU_METHOD
/begin COMPU_METHOD RCEMODACTVT_SC_Compu "" TAB_VERB "%6.3" "" COMPU_TAB_REF RCEMODACTVT_SC_Compu /end COMPU_METHOD
/begin COMPU_VTAB RCEMODACTVT_SC_Compu "" TAB_VERB 2 0 "Disable" 1 "Enable" /end COMPU_VTAB
/begin COMPU_METHOD RCSSTRT_SY_Compu "" TAB_VERB "%6.3" "" COMPU_TAB_REF RCSSTRT_SY_Compu /end COMPU_METHOD
/begin COMPU_VTAB RCSSTRT_SY_Compu "" TAB_VERB 2 0 "False" 1 "True" /end COMPU_VTAB
/begin COMPU_METHOD REDEFOGAVL_SC_Compu "" TAB_VERB "%6.3" "" COMPU_TAB_REF REDEFOGAVL_SC_Compu /end COMPU_METHOD
/begin COMPU_VTAB REDEFOGAVL_SC_Compu "" TAB_VERB 2 0 "False" 1 "True" /end COMPU_VTAB
/begin COMPU_METHOD REFUEL_SC_Compu "" TAB_VERB "%6.3" "" COMPU_TAB_REF REFUEL_SC_Compu /end COMPU_METHOD
/begin COMPU_VTAB REFUEL_SC_Compu "" TAB_VERB 4 0 "0" 1 "1" 2 "2" 3 "3" /end COMPU_VTAB
/begin COMPU_METHOD relDK_q0p02441 "" RAT_FUNC "%6.4" "%DK" COEFFS 0 65536 0 0 0 1600 /end COMPU_METHOD
/begin COMPU_METHOD relDK_uw_b100 "" RAT_FUNC "%6.4" "%DK" COEFFS 0 65535 0 0 0 100 /end COMPU_METHOD
/begin COMPU_METHOD relPED_q0p00153 "" RAT_FUNC "%6.4" "% PED" COEFFS 0 65535 0 0 0 100 /end COMPU_METHOD
/begin COMPU_METHOD rel_q0p01 "" RAT_FUNC "%6.4" "%" COEFFS 0 100 0 0 0 1 /end COMPU_METHOD
/begin COMPU_METHOD rel_q0p0234 "" RAT_FUNC "%6.4" "%" COEFFS 0 128 0 0 0 3 /end COMPU_METHOD
/begin COMPU_METHOD rel_q0p39 "" RAT_FUNC "%6.3" "%" COEFFS 0 256 0 0 0 100 /end COMPU_METHOD
/begin COMPU_METHOD rel_ub_b127p5 "" RAT_FUNC "%6.3" "%" COEFFS 0 2 0 0 0 1 /end COMPU_METHOD
/begin COMPU_METHOD rel_uw_b200 "" RAT_FUNC "%6.4" "%" COEFFS 0 65536 0 0 0 200 /end COMPU_METHOD
/begin COMPU_METHOD rel_uw_q0p0234 "" RAT_FUNC "%6.4" "%" COEFFS 0 32 0 0 0 0.75 /end COMPU_METHOD
/begin COMPU_METHOD REMPRKG_SC_Compu "" TAB_VERB "%6.3" "" COMPU_TAB_REF REMPRKG_SC_Compu /end COMPU_METHOD
/begin COMPU_VTAB REMPRKG_SC_Compu "" TAB_VERB 2 0 "False" 1 "True" /end COMPU_VTAB
/begin COMPU_METHOD RmpEngN "" RAT_FUNC "%6.4" "rpm/s" COEFFS 0 131.072 0 0 0 1 /end COMPU_METHOD
/begin COMPU_METHOD Signals_IntSigNumVerb "" TAB_VERB "%6.3" "" COMPU_TAB_REF Signals_IntSigNumVerb /end COMPU_METHOD
/begin COMPU_VTAB Signals_IntSigNumVerb "" TAB_VERB 1169 0 "SIGNALS_Signals_Default" 1 "SIGNALS_APP_rUnFlt" 2 "SIGNALS_APP_r_sig" 3 "SIGNALS_APP_r_signal" 4 "SIGNALS_APP_uRaw1_signal" 5 "SIGNALS_APP_uRaw2_signal" 6 "SIGNALS_AbsLdCom8Bit_PID43h" 7 "SIGNALS_AccPed_tqMapBasd_BENG_signal" 8 "SIGNALS_AccPed_tqMapBasd_TRQB_signal" 9 "SIGNALS_ActMod_trqInr_signal" 10 "SIGNALS_AirC_uAnaRawClnt_signal" 11 "SIGNALS_Alt_iExctLim_signal" 12 "SIGNALS_Alt_rAltExct_signal" 13 "SIGNALS_Alt_uFinalDes_signal" 14 "SIGNALS_BattU_u" 15 "SIGNALS_BattU_uSens1_signal" 16 "SIGNALS_BattU_uSens2_s" 17 "SIGNALS_BattU_uSens_signal" 18 "SIGNALS_Batt_lMaxCnsChk_signal" 19 "SIGNALS_Batt_lMinCnsChk_signal" 20 "SIGNALS_Batt_qCnsChkAH_signal" 21 "SIGNALS_Brk_st" 22 "SIGNALS_Brk_stRed" 23 "SIGNALS_CEngDsT_uRaw_s" 24 "SIGNALS_CEngDsT_uRaw_signal" 25 "SIGNALS_CEngUsT_t_signal" 26 "SIGNALS_CEngUsT_uSnsr_s" 27 "SIGNALS_CoEng_tiCranking_signal" 28 "SIGNALS_CoVeh_trqAcs_s" 29 "SIGNALS_ComEBS_BattID_signal" 30 "SIGNALS_ComEBS_rBattSensCh_signal" 31 "SIGNALS_ComEBS_rBattStrat_signal" 32 "SIGNALS_ComEBS_uBattSens_signal" 33 "SIGNALS_ComEBS_uBattUCO_signal" 34 "SIGNALS_Com_iBattEBS_signal" 35 "SIGNALS_Com_lDst_signal" 36 "SIGNALS_Com_rMeasdBattREbs_signal" 37 "SIGNALS_Com_stI_signal" 38 "SIGNALS_Com_stT_signal" 39 "SIGNALS_Com_stU_signal" 40 "SIGNALS_Com_tBattEBS_signal" 41 "SIGNALS_Com_trqAYCFDes_signal" 42 "SIGNALS_Com_uPeak_signal" 43 "SIGNALS_CrCtl_stShutOffCode0_signal" 44 "SIGNALS_CrCtl_stShutOffCode1_signal" 45 "SIGNALS_CrCtl_stShutOffCode2_signal" 46 "SIGNALS_CrCtl_stShutOffCode3_signal" 47 "SIGNALS_CrCtl_stShutOffCode4_signal" 48 "SIGNALS_CrCtl_stShutOffCode5_signal" 49 "SIGNALS_CrCtl_stShutOffCode6_signal" 50 "SIGNALS_CrCtl_stShutOffCode7_signal" 51 "SIGNALS_CrCtl_stShutOffCode8_signal" 52 "SIGNALS_CrCtl_stShutOffCode9_signal" 53 "SIGNALS_DIUMPR_ctGenDenom_signal" 54 "SIGNALS_DIUMPR_ctIgn_signal" 55 "SIGNALS_DRIVE_numDTCFrz_s" 56 "SIGNALS_DRIVE_stCurTrgMode_signal" 57 "SIGNALS_DRIVE_stHardToStrt_s" 58 "SIGNALS_DSM_tiMICumCont" 59 "SIGNALS_DcmDspUDS_rdbi_2612Byte10_signal" 60 "SIGNALS_DcmDspUDS_rdbi_2612Byte11_signal" 61 "SIGNALS_DcmDspUDS_rdbi_fixed_signal" 62 "SIGNALS_DcmDspUDS_rdbi_reserved0_signal_s" 63 "SIGNALS_DcmDspUDS_rdbi_reserved0_signal_w_s" 64 "SIGNALS_DcmDspUDS_rdbi_reserved1_signal" 65 "SIGNALS_Dspl_stCrsSwtInfo_signal" 66 "SIGNALS_Ebs_qBliChrg_signal" 67 "SIGNALS_Ebs_qBliDchaTotDcyc_0_signal" 68 "SIGNALS_Ebs_qBliDchaTotDcyc_1_signal" 69 "SIGNALS_Ebs_qBliDchaTotDcyc_2_signal" 70 "SIGNALS_Ebs_qBliDchaTotDcyc_3_signal" 71 "SIGNALS_Ebs_qBliDchaTotDcyc_4_signal" 72 "SIGNALS_Ebs_qBliDcha_signal" 73 "SIGNALS_Ebs_stStbIEBSByt0_0_signal" 74 "SIGNALS_Ebs_stStbIEBSByt0_1_signal" 75 "SIGNALS_Ebs_stStbIEBSByt0_2_signal" 76 "SIGNALS_Ebs_stStbIEBSByt0_3_signal" 77 "SIGNALS_Ebs_stStbIEBSByt0_4_signal" 78 "SIGNALS_Ebs_stStbIEBSByt1_0_signal" 79 "SIGNALS_Ebs_stStbIEBSByt1_1_signal" 80 "SIGNALS_Ebs_stStbIEBSByt1_2_signal" 81 "SIGNALS_Ebs_stStbIEBSByt1_3_signal" 82 "SIGNALS_Ebs_stStbIEBSByt1_4_signal" 83 "SIGNALS_Ebs_stStbIEBSByt2_0_signal" 84 "SIGNALS_Ebs_stStbIEBSByt2_1_signal" 85 "SIGNALS_Ebs_stStbIEBSByt2_2_signal" 86 "SIGNALS_Ebs_stStbIEBSByt2_3_signal" 87 "SIGNALS_Ebs_stStbIEBSByt2_4_signal" 88 "SIGNALS_Ebs_stStbIEBSByt3_0_signal" 89 "SIGNALS_Ebs_stStbIEBSByt3_1_signal" 90 "SIGNALS_Ebs_stStbIEBSByt3_2_signal" 91 "SIGNALS_Ebs_stStbIEBSByt3_3_signal" 92 "SIGNALS_Ebs_stStbIEBSByt3_4_signal" 93 "SIGNALS_Ebs_stStbIEBSByt4_0_signal" 94 "SIGNALS_Ebs_stStbIEBSByt4_1_signal" 95 "SIGNALS_Ebs_stStbIEBSByt4_2_signal" 96 "SIGNALS_Ebs_stStbIEBSByt4_3_signal" 97 "SIGNALS_Ebs_stStbIEBSByt4_4_signal" 98 "SIGNALS_EngTrqPtd_trqLead_s" 99 "SIGNALS_EngTrqPtd_trqLead_signal" 100 "SIGNALS_EngTrqPtd_trqSet_s" 101 "SIGNALS_EngTrqPtd_trqSet_signal" 102 "SIGNALS_EpmCaS_ctErrSig_signal" 103 "SIGNALS_EpmCaS_ctNoSig_signal" 104 "SIGNALS_EpmCaS_phiDiffCal2AdapEqAvg_0" 105 "SIGNALS_EpmCaS_phiOfsCorr" 106 "SIGNALS_Epm_nEngAct" 107 "SIGNALS_Epm_nEngRaw_s" 108 "SIGNALS_Epm_nEngRaw_signal" 109 "SIGNALS_Epm_stOpMode" 110 "SIGNALS_Epm_stSync" 111 "SIGNALS_FuPHi_uHiResl_signal" 112 "SIGNALS_GEVlv_ratPhaIntkB1_signal" 113 "SIGNALS_GlbDa_lenTotDstDcycHiResl_signal" 114 "SIGNALS_HEGO_uS2B1Extd_s" 115 "SIGNALS_HEGO_uS2B1HiRes_signal" 116 "SIGNALS_I14229CoEng_tiNormalOBDPrevDcyc_s" 117 "SIGNALS_I14229EpmCaS_ctErrSig1_signal" 118 "SIGNALS_I14229EpmCaS_ctNoSig1_signal" 119 "SIGNALS_I14229GlbDa_lTotDstDCHiReslPrevDcyc_s" 120 "SIGNALS_I14229IntkAirT_tSnsrTstrMax_s" 121 "SIGNALS_I14229IntkAirT_tSnsrTstrMin_s" 122 "SIGNALS_I14229RDBI_nOvrSpd_signal" 123 "SIGNALS_I14229RDBI_tiOvrSpd_signal" 124 "SIGNALS_I14229_AirC_pAnaClnt_signal" 125 "SIGNALS_I14229_ElecLd_iEPSLoadOnly_signal" 126 "SIGNALS_I14229_EpmCaS_ctErrSig2_signal" 127 "SIGNALS_I14229_EpmCaS_ctNoSig2_signal" 128 "SIGNALS_I14229_EpmCrS_ctCaSRev_signal" 129 "SIGNALS_I14229_EpmCrS_ctErrSig_signal" 130 "SIGNALS_I14229_GEVCtl_agMaxAdpdIntk_signal" 131 "SIGNALS_I14229_Gbx_uAna1NPosRaw_signal" 132 "SIGNALS_I14229_Gbx_uAna2NPosRaw_signal" 133 "SIGNALS_I14229_ivzabg_w_signal" 134 "SIGNALS_I14229_lDst_signal" 135 "SIGNALS_I14229_nstat_signal" 136 "SIGNALS_I14229_numDTCFrzFrmHi_signal" 137 "SIGNALS_I14229_numDTCFrzFrmLo_signal" 138 "SIGNALS_I14229_numDTCFrzFrmMid_signal" 139 "SIGNALS_I14229_ps_w_signal" 140 "SIGNALS_I14229_rTrqPT_signal" 141 "SIGNALS_I14229_stTURBODV_signal" 142 "SIGNALS_I14229_tSnsrFild1_signal" 143 "SIGNALS_I14229_tiInj1On_signal" 144 "SIGNALS_I14229_tiOilFlowCompl_signal" 145 "SIGNALS_I14229_tiSia_signal" 146 "SIGNALS_I14229_tkaMax_s" 147 "SIGNALS_I14229_tkaMin_s" 148 "SIGNALS_I14229_tka_signal" 149 "SIGNALS_I14229_tmotMaxCurrDcyc_s" 150 "SIGNALS_I14229_tmotMaxPrevDcyc_s" 151 "SIGNALS_I14229_tmotMinCurrDcyc_s" 152 "SIGNALS_I14229_tmotMinPrevDcyc_s" 153 "SIGNALS_I14229_ubsq_signal" 154 "SIGNALS_I14229_umsrln_w_signal" 155 "SIGNALS_I14229_wdks_w_signal" 156 "SIGNALS_I14229_wped1_signal" 157 "SIGNALS_I14229_wped2_signal" 158 "SIGNALS_I14229_zwist_signal" 159 "SIGNALS_I14229iocpMDA_numABV_signal" 160 "SIGNALS_I14229iocpMDA_numACGC_signal" 161 "SIGNALS_I14229iocpMDA_numAPS_signal" 162 "SIGNALS_I14229iocpMDA_numPSC_signal" 163 "SIGNALS_I14229iocpMDA_numRFAN_signal" 164 "SIGNALS_I14229iocpMDA_numRvsLck_signal" 165 "SIGNALS_I14229iocpMDA_numVTEC_signal" 166 "SIGNALS_I14229iocp_numCtlSt_s" 167 "SIGNALS_I14229iocp_numEXE_signal" 168 "SIGNALS_I14229iocp_numREQ_s" 169 "SIGNALS_I14229iocp_stSFTRJC_s" 170 "SIGNALS_I15031_PID1Dh" 171 "SIGNALS_I15031_PID65Ah" 172 "SIGNALS_I15031_PID66Ah" 173 "SIGNALS_I15031_PID69Ah" 174 "SIGNALS_I15031_PID6AAh" 175 "SIGNALS_I15031_PID6BAh" 176 "SIGNALS_I15031_PID6CAh" 177 "SIGNALS_I15031_PID6DAh" 178 "SIGNALS_I15031_PID6EAh" 179 "SIGNALS_I15031_PID6FAh" 180 "SIGNALS_I15031_PID70Ah" 181 "SIGNALS_I15031_PID71Ah" 182 "SIGNALS_I15031_PID72Ah" 183 "SIGNALS_I15031_PID73Ah" 184 "SIGNALS_I15031_PID74Ah" 185 "SIGNALS_I15031_PID75Ah" 186 "SIGNALS_I15031_PID76Ah" 187 "SIGNALS_I15031_PID77Ah" 188 "SIGNALS_I15031_PID78Ah" 189 "SIGNALS_I15031_PID79Ah" 190 "SIGNALS_I15031_PID7AAh" 191 "SIGNALS_I15031_PID7BAh" 192 "SIGNALS_I15031_PID7CAh" 193 "SIGNALS_I15031_PID7FAh" 194 "SIGNALS_I15031_PID81Ah" 195 "SIGNALS_I15031_PID82Ah" 196 "SIGNALS_I15031_PID85Ah" 197 "SIGNALS_I15031_PID86Ah" 198 "SIGNALS_I15031_PID87Ah" 199 "SIGNALS_I15031_PID89Ah" 200 "SIGNALS_I15031_PID8AAh" 201 "SIGNALS_I15031_PID8FAh" 202 "SIGNALS_I15031_PID92Ah" 203 "SIGNALS_I15031_PID93Ah" 204 "SIGNALS_I15031_PID94Ah" 205 "SIGNALS_I15031_PID98Ah" 206 "SIGNALS_I15031_PID99Ah" 207 "SIGNALS_I15031_PID9CAh" 208 "SIGNALS_I15031_PIDA3Ah" 209 "SIGNALS_I15031_PIDA4Ah" 210 "SIGNALS_I15031_PIDA5Ah" 211 "SIGNALS_I15031_PIDA9Ah" 212 "SIGNALS_I15031_PIDACAh" 213 "SIGNALS_IKCtl_agKnkAvrg_s8_signal" 214 "SIGNALS_InjSys_volFuConsDrvCycCAN_s" 215 "SIGNALS_IntkAirT_tSnsr2_signal" 216 "SIGNALS_IntkAirT_uSnsr1Exprt_signal" 217 "SIGNALS_IntkAirT_uSnsr3CrssSwtLoc_s" 218 "SIGNALS_MoF_rTrqInrAct_s" 219 "SIGNALS_MoF_rTrqPtdFlt_s" 220 "SIGNALS_OBD_ITID_InjSys_volFuConsDrvgCycTstrSrv" 221 "SIGNALS_OilSwmpT_uSnsrRaw_s" 222 "SIGNALS_Oil_pSensPSwmp_signal" 223 "SIGNALS_Oil_uRawPSwmp_signal" 224 "SIGNALS_PID01h" 225 "SIGNALS_PID03h_0" 226 "SIGNALS_PID03h_1" 227 "SIGNALS_PID04h" 228 "SIGNALS_PID05h" 229 "SIGNALS_PID06h_0" 230 "SIGNALS_PID07h_0" 231 "SIGNALS_PID0Ch_Epm_nEng" 232 "SIGNALS_PID0D_VehV_vSens" 233 "SIGNALS_PID0Eh" 234 "SIGNALS_PID0Fh" 235 "SIGNALS_PID0bh_PIntkVUs_pRawObd" 236 "SIGNALS_PID10h" 237 "SIGNALS_PID11h_ThrVlv_ratActSens1AbsltB1_u8" 238 "SIGNALS_PID13h" 239 "SIGNALS_PID15h_0" 240 "SIGNALS_PID15h_1" 241 "SIGNALS_PID1Ch" 242 "SIGNALS_PID1Fh_TiScneEngStrt" 243 "SIGNALS_PID21h" 244 "SIGNALS_PID23h" 245 "SIGNALS_PID2Ch_EGRVlv_rCmdNrm" 246 "SIGNALS_PID2Dh_EGRVlv_rGovDvtNrm" 247 "SIGNALS_PID2Eh" 248 "SIGNALS_PID2Fh" 249 "SIGNALS_PID30h" 250 "SIGNALS_PID31h" 251 "SIGNALS_PID33h_PEnv_pRaw" 252 "SIGNALS_PID34h_0" 253 "SIGNALS_PID34h_1" 254 "SIGNALS_PID3Ch" 255 "SIGNALS_PID41h" 256 "SIGNALS_PID42_BattU_uSens" 257 "SIGNALS_PID43h" 258 "SIGNALS_PID44h" 259 "SIGNALS_PID45h_ThrVlv_ratActSens1RelB1_u8" 260 "SIGNALS_PID46h" 261 "SIGNALS_PID47h_ThrVlv_ratActSens2AbsltB1_u8" 262 "SIGNALS_PID49_APP_uRaw1unLim" 263 "SIGNALS_PID4A_APP_uRaw2unLim" 264 "SIGNALS_PID4Ch_wdks_msg" 265 "SIGNALS_PID4FAh" 266 "SIGNALS_PID4FBh" 267 "SIGNALS_PID4FCh" 268 "SIGNALS_PID4FDh" 269 "SIGNALS_PID50Ah" 270 "SIGNALS_PID50Bh" 271 "SIGNALS_PID50Ch" 272 "SIGNALS_PID50Dh" 273 "SIGNALS_PID51h_PID51_stFuTyp" 274 "SIGNALS_PID52h" 275 "SIGNALS_PID56h_0" 276 "SIGNALS_PID5A_APP_rOBDPID5A" 277 "SIGNALS_PID5Eh_InjSys_volEngFuCnsPerHr" 278 "SIGNALS_PID5Fh" 279 "SIGNALS_PID62h_TME_ratActEngPercTqPrmIdH62" 280 "SIGNALS_IntFloat_PID63h_TqEngRef" 281 "SIGNALS_PID67h_ects2sva_msg" 282 "SIGNALS_PID67h_ects2svb_msg" 283 "SIGNALS_PID67h_ects2svc_msg" 284 "SIGNALS_PID68h_iats2sva" 285 "SIGNALS_PID68h_iats2svb" 286 "SIGNALS_PID68h_iats2svc" 287 "SIGNALS_PID68h_iats2svd" 288 "SIGNALS_PID68h_iats2sve" 289 "SIGNALS_PID68h_iats2svf" 290 "SIGNALS_PID68h_iats2svg" 291 "SIGNALS_PID69h_EGRVlv_rActNrm" 292 "SIGNALS_PID69h_EGRVlv_rCmdNrm" 293 "SIGNALS_PID69h_EGRVlv_rGovDvtNrm" 294 "SIGNALS_PID7Fh_RTId_TotRt" 295 "SIGNALS_PID7Fh_RtId_TotIdleRt" 296 "SIGNALS_PID7Fh_RtId_TotPtoRt" 297 "SIGNALS_PID87h_PIntkVUs_pRawObd" 298 "SIGNALS_PID8BAh" 299 "SIGNALS_PID8CAh" 300 "SIGNALS_PID8Eh_TME_ratEngFricPercTqPrmIdH8E" 301 "SIGNALS_PID93BCh" 302 "SIGNALS_PID9AAh" 303 "SIGNALS_PID9Dh_InjSys_mfEngFuRate" 304 "SIGNALS_PID9Dh_InjSys_mfVehFuRate" 305 "SIGNALS_PID9FAh" 306 "SIGNALS_PIDA6h_lTotDst" 307 "SIGNALS_PID_FILLSIG_1BIT" 308 "SIGNALS_PID_FILLSIG_1BITNZ" 309 "SIGNALS_PID_FILLSIG_1BYTE" 310 "SIGNALS_PID_FILLSIG_1BYTENZ" 311 "SIGNALS_PID_FILLSIG_2BIT" 312 "SIGNALS_PID_FILLSIG_2BITNZ" 313 "SIGNALS_PID_FILLSIG_2BYTE" 314 "SIGNALS_PID_FILLSIG_2BYTENZ" 315 "SIGNALS_PID_FILLSIG_3BIT" 316 "SIGNALS_PID_FILLSIG_3BITNZ" 317 "SIGNALS_PID_FILLSIG_4BIT" 318 "SIGNALS_PID_FILLSIG_4BITNZ" 319 "SIGNALS_PID_FILLSIG_4BYTE" 320 "SIGNALS_PID_FILLSIG_4BYTENZ" 321 "SIGNALS_PID_FILLSIG_5BIT" 322 "SIGNALS_PID_FILLSIG_5BITNZ" 323 "SIGNALS_PID_FILLSIG_6BIT" 324 "SIGNALS_PID_FILLSIG_6BITNZ" 325 "SIGNALS_PID_FILLSIG_7BIT" 326 "SIGNALS_PID_FILLSIG_7BITNZ" 327 "SIGNALS_PIntkVUs_uRawUnFlt_signal" 328 "SIGNALS_PT_rGrip_signal" 329 "SIGNALS_PT_trqLos_signal" 330 "SIGNALS_PThrVlvUs_uRawB1_signal" 331 "SIGNALS_PthLead_trqInrNoMon_s" 332 "SIGNALS_PthLead_trqInrNoMon_signal" 333 "SIGNALS_PthSet_trqInrIABef_s" 334 "SIGNALS_PthSet_trqInrLtd_s" 335 "SIGNALS_RngMod_trqDiffAdap_signal" 336 "SIGNALS_RngMod_trqDiffAdap_signal_s" 337 "SIGNALS_RngMod_trqInrBs_s" 338 "SIGNALS_SIGNAL_GEVlv_agSumSpCsersDeIntkB1" 339 "SIGNALS_Strt_uStrtMonDia_signal" 340 "SIGNALS_TWCD_numMeasB1_s" 341 "SIGNALS_TWCD_rOSCAvrgPriB1_s" 342 "SIGNALS_TWCD_rOSCAvrgPriB1_signal" 343 "SIGNALS_ThrVlv_uRawSens1B1_signal" 344 "SIGNALS_ThrVlv_uRawSens2B1_signal" 345 "SIGNALS_TiEngOff_ti_s" 346 "SIGNALS_VehStc_lDstCityEco_signal" 347 "SIGNALS_VehStc_lDstCity_signal" 348 "SIGNALS_VehStc_lDstHighWayEco_signal" 349 "SIGNALS_VehStc_lDstHighWay_signal" 350 "SIGNALS_VehStc_numFuDiagRecA_0_s" 351 "SIGNALS_VehStc_numFuDiagRecA_10_s" 352 "SIGNALS_VehStc_numFuDiagRecA_11_s" 353 "SIGNALS_VehStc_numFuDiagRecA_12_s" 354 "SIGNALS_VehStc_numFuDiagRecA_13_s" 355 "SIGNALS_VehStc_numFuDiagRecA_14_s" 356 "SIGNALS_VehStc_numFuDiagRecA_15_s" 357 "SIGNALS_VehStc_numFuDiagRecA_16_s" 358 "SIGNALS_VehStc_numFuDiagRecA_17_s" 359 "SIGNALS_VehStc_numFuDiagRecA_18_s" 360 "SIGNALS_VehStc_numFuDiagRecA_19_s" 361 "SIGNALS_VehStc_numFuDiagRecA_1_s" 362 "SIGNALS_VehStc_numFuDiagRecA_20_s" 363 "SIGNALS_VehStc_numFuDiagRecA_2_s" 364 "SIGNALS_VehStc_numFuDiagRecA_3_s" 365 "SIGNALS_VehStc_numFuDiagRecA_4_s" 366 "SIGNALS_VehStc_numFuDiagRecA_5_s" 367 "SIGNALS_VehStc_numFuDiagRecA_6_s" 368 "SIGNALS_VehStc_numFuDiagRecA_7_s" 369 "SIGNALS_VehStc_numFuDiagRecA_8_s" 370 "SIGNALS_VehStc_numFuDiagRecA_9_s" 371 "SIGNALS_VehStc_numMisfDetnHiEctA_0_s" 372 "SIGNALS_VehStc_numMisfDetnHiEctA_10_s" 373 "SIGNALS_VehStc_numMisfDetnHiEctA_11_s" 374 "SIGNALS_VehStc_numMisfDetnHiEctA_12_s" 375 "SIGNALS_VehStc_numMisfDetnHiEctA_13_s" 376 "SIGNALS_VehStc_numMisfDetnHiEctA_14_s" 377 "SIGNALS_VehStc_numMisfDetnHiEctA_15_s" 378 "SIGNALS_VehStc_numMisfDetnHiEctA_16_s" 379 "SIGNALS_VehStc_numMisfDetnHiEctA_17_s" 380 "SIGNALS_VehStc_numMisfDetnHiEctA_18_s" 381 "SIGNALS_VehStc_numMisfDetnHiEctA_19_s" 382 "SIGNALS_VehStc_numMisfDetnHiEctA_1_s" 383 "SIGNALS_VehStc_numMisfDetnHiEctA_20_s" 384 "SIGNALS_VehStc_numMisfDetnHiEctA_2_s" 385 "SIGNALS_VehStc_numMisfDetnHiEctA_3_s" 386 "SIGNALS_VehStc_numMisfDetnHiEctA_4_s" 387 "SIGNALS_VehStc_numMisfDetnHiEctA_5_s" 388 "SIGNALS_VehStc_numMisfDetnHiEctA_6_s" 389 "SIGNALS_VehStc_numMisfDetnHiEctA_7_s" 390 "SIGNALS_VehStc_numMisfDetnHiEctA_8_s" 391 "SIGNALS_VehStc_numMisfDetnHiEctA_9_s" 392 "SIGNALS_VehStc_numMisfDetnLoEctA_0_s" 393 "SIGNALS_VehStc_numMisfDetnLoEctA_10_s" 394 "SIGNALS_VehStc_numMisfDetnLoEctA_11_s" 395 "SIGNALS_VehStc_numMisfDetnLoEctA_12_s" 396 "SIGNALS_VehStc_numMisfDetnLoEctA_13_s" 397 "SIGNALS_VehStc_numMisfDetnLoEctA_14_s" 398 "SIGNALS_VehStc_numMisfDetnLoEctA_15_s" 399 "SIGNALS_VehStc_numMisfDetnLoEctA_16_s" 400 "SIGNALS_VehStc_numMisfDetnLoEctA_17_s" 401 "SIGNALS_VehStc_numMisfDetnLoEctA_18_s" 402 "SIGNALS_VehStc_numMisfDetnLoEctA_19_s" 403 "SIGNALS_VehStc_numMisfDetnLoEctA_1_s" 404 "SIGNALS_VehStc_numMisfDetnLoEctA_20_s" 405 "SIGNALS_VehStc_numMisfDetnLoEctA_2_s" 406 "SIGNALS_VehStc_numMisfDetnLoEctA_3_s" 407 "SIGNALS_VehStc_numMisfDetnLoEctA_4_s" 408 "SIGNALS_VehStc_numMisfDetnLoEctA_5_s" 409 "SIGNALS_VehStc_numMisfDetnLoEctA_6_s" 410 "SIGNALS_VehStc_numMisfDetnLoEctA_7_s" 411 "SIGNALS_VehStc_numMisfDetnLoEctA_8_s" 412 "SIGNALS_VehStc_numMisfDetnLoEctA_9_s" 413 "SIGNALS_VehStc_numMisfDetnNormA_0_s" 414 "SIGNALS_VehStc_numMisfDetnNormA_10_s" 415 "SIGNALS_VehStc_numMisfDetnNormA_11_s" 416 "SIGNALS_VehStc_numMisfDetnNormA_12_s" 417 "SIGNALS_VehStc_numMisfDetnNormA_13_s" 418 "SIGNALS_VehStc_numMisfDetnNormA_14_s" 419 "SIGNALS_VehStc_numMisfDetnNormA_15_s" 420 "SIGNALS_VehStc_numMisfDetnNormA_16_s" 421 "SIGNALS_VehStc_numMisfDetnNormA_17_s" 422 "SIGNALS_VehStc_numMisfDetnNormA_18_s" 423 "SIGNALS_VehStc_numMisfDetnNormA_19_s" 424 "SIGNALS_VehStc_numMisfDetnNormA_1_s" 425 "SIGNALS_VehStc_numMisfDetnNormA_20_s" 426 "SIGNALS_VehStc_numMisfDetnNormA_2_s" 427 "SIGNALS_VehStc_numMisfDetnNormA_3_s" 428 "SIGNALS_VehStc_numMisfDetnNormA_4_s" 429 "SIGNALS_VehStc_numMisfDetnNormA_5_s" 430 "SIGNALS_VehStc_numMisfDetnNormA_6_s" 431 "SIGNALS_VehStc_numMisfDetnNormA_7_s" 432 "SIGNALS_VehStc_numMisfDetnNormA_8_s" 433 "SIGNALS_VehStc_numMisfDetnNormA_9_s" 434 "SIGNALS_VehStc_rDiagRsltB1A_0_s" 435 "SIGNALS_VehStc_rDiagRsltB1A_1_s" 436 "SIGNALS_VehStc_rDiagRsltB1A_2_s" 437 "SIGNALS_VehStc_rDiagRsltB1A_3_s" 438 "SIGNALS_VehStc_rDiagRsltB1A_4_s" 439 "SIGNALS_VehStc_tiRtCityEco_signal" 440 "SIGNALS_VehStc_tiRtCity_signal" 441 "SIGNALS_VehStc_tiRtHighWayEco_signal" 442 "SIGNALS_VehStc_tiRtHighWay_signal" 443 "SIGNALS_VehStc_tiRtStop_signal" 444 "SIGNALS_VehStc_volCnsCityDcyc_signal" 445 "SIGNALS_VehStc_volCnsCityEcoDcyc_signal" 446 "SIGNALS_VehStc_volCnsHighWayDcyc_signal" 447 "SIGNALS_VehStc_volCnsHighWayEcoDcyc_signal" 448 "SIGNALS_VehStc_volCnsStopDcyc_signal" 449 "SIGNALS_VehV_a" 450 "SIGNALS_VehV_v" 451 "SIGNALS_VehV_vSens_signal" 452 "SIGNALS_fra_w_msg_signal" 453 "SIGNALS_fra_w_s" 454 "SIGNALS_ftead_w_msg_s" 455 "SIGNALS_ftead_w_si" 456 "SIGNALS_ftead_w_signal" 457 "SIGNALS_i14229_agIntkB1GEVlv_2Byte_signal" 458 "SIGNALS_i14229_agIntkB1GEVlv_signal" 459 "SIGNALS_i14229_agSpIntkB1GevCtl_2Byte_signal" 460 "SIGNALS_i14229_agSpIntkB1GevCtl_signal" 461 "SIGNALS_lutskzyl_w_0_signal" 462 "SIGNALS_lutskzyl_w_1_signal" 463 "SIGNALS_lutskzyl_w_2_signal" 464 "SIGNALS_lutskzyl_w_3_signal" 465 "SIGNALS_lutskzyl_w_msg_0_signal" 466 "SIGNALS_mshfmst_w_signal" 467 "SIGNALS_ofmsndkh1_w_msg_signal" 468 "SIGNALS_ofmsndkh2_w_msg_signal" 469 "SIGNALS_prsoll_w_msg_s" 470 "SIGNALS_tateout_w_signal" 471 "SIGNALS_tatesoll_w_msg_signal" 472 "SIGNALS_thdev_msg_signal" 473 "SIGNALS_tmst_signal" 474 "SIGNALS_wkratst_signal" 475 "SIGNALS_PID83h_A_BitCombineSignal" 476 "SIGNALS_PID9Bh_A_BitCombineSignal" 477 "SIGNALS_PIDA1h_A_BitCombineSignal" 478 "SIGNALS_PIDA7h_A_BitCombineSignal" 479 "SIGNALS_PIDA8h_A_BitCombineSignal" 480 "SIGNALS_Virtual_DcmDspUDS_2600Byte06_signal" 481 "SIGNALS_Virtual_DcmDspUDS_2610Byte00_signal" 482 "SIGNALS_Virtual_DcmDspUDS_2610Byte01_signal" 483 "SIGNALS_Virtual_DcmDspUDS_2610Byte02_signal" 484 "SIGNALS_Virtual_DcmDspUDS_2610Byte03_signal" 485 "SIGNALS_Virtual_DcmDspUDS_2610Byte04_signal" 486 "SIGNALS_Virtual_DcmDspUDS_2610Byte05_signal" 487 "SIGNALS_Virtual_DcmDspUDS_2610Byte0D_signal" 488 "SIGNALS_Virtual_DcmDspUDS_2610Byte0F_signal" 489 "SIGNALS_Virtual_DcmDspUDS_2610Byte10_signal" 490 "SIGNALS_Virtual_DcmDspUDS_2610Byte1A_signal" 491 "SIGNALS_Virtual_DcmDspUDS_2610Byte1B_signal" 492 "SIGNALS_Virtual_DcmDspUDS_2610Byte1C_signal" 493 "SIGNALS_Virtual_DcmDspUDS_2610Byte1D_signal" 494 "SIGNALS_Virtual_DcmDspUDS_2610Byte1F_signal" 495 "SIGNALS_Virtual_DcmDspUDS_2610Byte20_signal" 496 "SIGNALS_Virtual_DcmDspUDS_2610Byte21_signal" 497 "SIGNALS_Virtual_DcmDspUDS_2610Byte22to23_signal" 498 "SIGNALS_Virtual_DcmDspUDS_2610Byte29_signal" 499 "SIGNALS_Virtual_DcmDspUDS_2610Byte2A_signal" 500 "SIGNALS_Virtual_DcmDspUDS_2611Byte00_signal" 501 "SIGNALS_Virtual_DcmDspUDS_2611Byte01_signal" 502 "SIGNALS_Virtual_DcmDspUDS_2611Byte02_signal" 503 "SIGNALS_Virtual_DcmDspUDS_2611Byte03_signal" 504 "SIGNALS_Virtual_DcmDspUDS_2611Byte04_signal" 505 "SIGNALS_Virtual_DcmDspUDS_2611Byte05_signal" 506 "SIGNALS_Virtual_DcmDspUDS_2611Byte06_07_signal" 507 "SIGNALS_Virtual_DcmDspUDS_2611Byte08to09_signal" 508 "SIGNALS_Virtual_DcmDspUDS_2611Byte0A_signal" 509 "SIGNALS_Virtual_DcmDspUDS_2611Byte0B_signal" 510 "SIGNALS_Virtual_DcmDspUDS_2611Byte0Cto0D_signal" 511 "SIGNALS_Virtual_DcmDspUDS_2611Byte0E_signal" 512 "SIGNALS_Virtual_DcmDspUDS_2611Byte2A_signal" 513 "SIGNALS_Virtual_DcmDspUDS_2611Byte2B_signal" 514 "SIGNALS_Virtual_DcmDspUDS_2611Byte30_signal" 515 "SIGNALS_Virtual_DcmDspUDS_2611Byte31_signal" 516 "SIGNALS_Virtual_DcmDspUDS_2611Byte32_signal" 517 "SIGNALS_Virtual_DcmDspUDS_2611Byte33_signal" 518 "SIGNALS_Virtual_DcmDspUDS_2612Byte00_signal" 519 "SIGNALS_Virtual_DcmDspUDS_2612Byte01_signal" 520 "SIGNALS_Virtual_DcmDspUDS_2612Byte02_signal" 521 "SIGNALS_Virtual_DcmDspUDS_2612Byte03_signal" 522 "SIGNALS_Virtual_DcmDspUDS_2612Byte04_signal" 523 "SIGNALS_Virtual_DcmDspUDS_2612Byte05_signal" 524 "SIGNALS_Virtual_DcmDspUDS_2612Byte0B_0C_signal" 525 "SIGNALS_Virtual_DcmDspUDS_2612Byte14_signal" 526 "SIGNALS_Virtual_DcmDspUDS_2612Byte15_signal" 527 "SIGNALS_Virtual_DcmDspUDS_2612Byte16_signal" 528 "SIGNALS_Virtual_DcmDspUDS_2612Byte17_signal" 529 "SIGNALS_Virtual_DcmDspUDS_2612Byte1F_signal" 530 "SIGNALS_Virtual_DcmDspUDS_2612Byte20_signal" 531 "SIGNALS_Virtual_DcmDspUDS_2612Byte2A_signal" 532 "SIGNALS_Virtual_DcmDspUDS_2612Byte2B_signal" 533 "SIGNALS_Virtual_DcmDspUDS_2613Byte00_signal" 534 "SIGNALS_Virtual_DcmDspUDS_2613Byte01_signal" 535 "SIGNALS_Virtual_DcmDspUDS_2613Byte02_signal" 536 "SIGNALS_Virtual_DcmDspUDS_2613Byte03_signal" 537 "SIGNALS_Virtual_DcmDspUDS_2613Byte04_signal" 538 "SIGNALS_Virtual_DcmDspUDS_2613Byte05_signal" 539 "SIGNALS_Virtual_DcmDspUDS_2613Byte08_signal" 540 "SIGNALS_Virtual_DcmDspUDS_2613Byte09_signal" 541 "SIGNALS_Virtual_DcmDspUDS_2615Byte00_signal" 542 "SIGNALS_Virtual_DcmDspUDS_2615Byte01_signal" 543 "SIGNALS_Virtual_DcmDspUDS_2615Byte02_signal" 544 "SIGNALS_Virtual_DcmDspUDS_2615Byte03_signal" 545 "SIGNALS_Virtual_DcmDspUDS_2615Byte04_signal" 546 "SIGNALS_Virtual_DcmDspUDS_2615Byte05_signal" 547 "SIGNALS_Virtual_DcmDspUDS_2615Byte10_signal" 548 "SIGNALS_Virtual_DcmDspUDS_2615Byte26_signal" 549 "SIGNALS_Virtual_DcmDspUDS_2615Byte27_signal" 550 "SIGNALS_Virtual_DcmDspUDS_2617Byte00_signal" 551 "SIGNALS_Virtual_DcmDspUDS_2617Byte01_signal" 552 "SIGNALS_Virtual_DcmDspUDS_2617Byte02_signal" 553 "SIGNALS_Virtual_DcmDspUDS_2617Byte03_signal" 554 "SIGNALS_Virtual_DcmDspUDS_2617Byte04_signal" 555 "SIGNALS_Virtual_DcmDspUDS_2617Byte05_signal" 556 "SIGNALS_Virtual_DcmDspUDS_261AByte00_signal" 557 "SIGNALS_Virtual_DcmDspUDS_261AByte01_signal" 558 "SIGNALS_Virtual_DcmDspUDS_261AByte02_signal" 559 "SIGNALS_Virtual_DcmDspUDS_261AByte03_signal" 560 "SIGNALS_Virtual_DcmDspUDS_261AByte04_signal" 561 "SIGNALS_Virtual_DcmDspUDS_261AByte05_signal" 562 "SIGNALS_Virtual_DcmDspUDS_261AByte07_signal" 563 "SIGNALS_Virtual_DcmDspUDS_261AByte0A_signal" 564 "SIGNALS_Virtual_DcmDspUDS_261AByte0B_signal" 565 "SIGNALS_Virtual_DcmDspUDS_261AByte0C_signal" 566 "SIGNALS_Virtual_DcmDspUDS_261AByte0D_signal" 567 "SIGNALS_Virtual_DcmDspUDS_261AByte0E_signal" 568 "SIGNALS_Virtual_DcmDspUDS_2620Byte00_signal" 569 "SIGNALS_Virtual_DcmDspUDS_2620Byte01_signal" 570 "SIGNALS_Virtual_DcmDspUDS_2620Byte02_signal" 571 "SIGNALS_Virtual_DcmDspUDS_2620Byte03_signal" 572 "SIGNALS_Virtual_DcmDspUDS_2620Byte04_signal" 573 "SIGNALS_Virtual_DcmDspUDS_2620Byte05_signal" 574 "SIGNALS_Virtual_DcmDspUDS_2621Byte00_signal" 575 "SIGNALS_Virtual_DcmDspUDS_2621Byte01_signal" 576 "SIGNALS_Virtual_DcmDspUDS_2621Byte02_signal" 577 "SIGNALS_Virtual_DcmDspUDS_2621Byte03_signal" 578 "SIGNALS_Virtual_DcmDspUDS_2621Byte04_signal" 579 "SIGNALS_Virtual_DcmDspUDS_2621Byte05_signal" 580 "SIGNALS_Virtual_DcmDspUDS_2622Byte00_signal" 581 "SIGNALS_Virtual_DcmDspUDS_2622Byte01_signal" 582 "SIGNALS_Virtual_DcmDspUDS_2622Byte02_signal" 583 "SIGNALS_Virtual_DcmDspUDS_2622Byte03_signal" 584 "SIGNALS_Virtual_DcmDspUDS_2622Byte04_signal" 585 "SIGNALS_Virtual_DcmDspUDS_2622Byte05_signal" 586 "SIGNALS_Virtual_DcmDspUDS_2623Byte00_signal" 587 "SIGNALS_Virtual_DcmDspUDS_2623Byte01_signal" 588 "SIGNALS_Virtual_DcmDspUDS_2623Byte02_signal" 589 "SIGNALS_Virtual_DcmDspUDS_2623Byte03_signal" 590 "SIGNALS_Virtual_DcmDspUDS_2623Byte04_signal" 591 "SIGNALS_Virtual_DcmDspUDS_2623Byte05_signal" 592 "SIGNALS_Virtual_DcmDspUDS_2625Byte00_signal" 593 "SIGNALS_Virtual_DcmDspUDS_2625Byte01_signal" 594 "SIGNALS_Virtual_DcmDspUDS_2625Byte02_signal" 595 "SIGNALS_Virtual_DcmDspUDS_2625Byte03_signal" 596 "SIGNALS_Virtual_DcmDspUDS_2625Byte04_signal" 597 "SIGNALS_Virtual_DcmDspUDS_2625Byte05_signal" 598 "SIGNALS_Virtual_DcmDspUDS_2627Byte00_signal" 599 "SIGNALS_Virtual_DcmDspUDS_2627Byte01_signal" 600 "SIGNALS_Virtual_DcmDspUDS_2627Byte02_signal" 601 "SIGNALS_Virtual_DcmDspUDS_2627Byte03_signal" 602 "SIGNALS_Virtual_DcmDspUDS_2627Byte04_signal" 603 "SIGNALS_Virtual_DcmDspUDS_2627Byte05_signal" 604 "SIGNALS_Virtual_DcmDspUDS_262AByte00_signal" 605 "SIGNALS_Virtual_DcmDspUDS_262AByte01_signal" 606 "SIGNALS_Virtual_DcmDspUDS_262AByte02_signal" 607 "SIGNALS_Virtual_DcmDspUDS_262AByte03_signal" 608 "SIGNALS_Virtual_DcmDspUDS_262AByte04_signal" 609 "SIGNALS_Virtual_DcmDspUDS_262AByte05_signal" 610 "SIGNALS_Virtual_DcmDspUDS_2660Byte0_signal" 611 "SIGNALS_Virtual_DcmDspUDS_2660Byte11to12_signal" 612 "SIGNALS_Virtual_DcmDspUDS_2660Byte13to14_signal" 613 "SIGNALS_Virtual_DcmDspUDS_2660Byte15_signal" 614 "SIGNALS_Virtual_DcmDspUDS_2660Byte16_signal" 615 "SIGNALS_Virtual_DcmDspUDS_2660Byte17_signal" 616 "SIGNALS_Virtual_DcmDspUDS_2660Byte18_signal" 617 "SIGNALS_Virtual_DcmDspUDS_2660Byte19_signal" 618 "SIGNALS_Virtual_DcmDspUDS_2660Byte1A_signal" 619 "SIGNALS_Virtual_DcmDspUDS_2660Byte1B_signal" 620 "SIGNALS_Virtual_DcmDspUDS_2660Byte1C_signal" 621 "SIGNALS_Virtual_DcmDspUDS_2660Byte1D_signal" 622 "SIGNALS_Virtual_DcmDspUDS_2660Byte1E_signal" 623 "SIGNALS_Virtual_DcmDspUDS_2660Byte1_signal" 624 "SIGNALS_Virtual_DcmDspUDS_2660Byte26to27_signal" 625 "SIGNALS_Virtual_DcmDspUDS_2660Byte2A_signal" 626 "SIGNALS_Virtual_DcmDspUDS_2660Byte2Eto2F_signal" 627 "SIGNALS_Virtual_DcmDspUDS_2660Byte2_signal" 628 "SIGNALS_Virtual_DcmDspUDS_2660Byte3_signal" 629 "SIGNALS_Virtual_DcmDspUDS_2660Byte4_signal" 630 "SIGNALS_Virtual_DcmDspUDS_2660Byte5_signal" 631 "SIGNALS_Virtual_DcmDspUDS_2660Byte6_signal" 632 "SIGNALS_Virtual_DcmDspUDS_2661Byte0A_signal" 633 "SIGNALS_Virtual_DcmDspUDS_2661Byte0B_signal" 634 "SIGNALS_Virtual_DcmDspUDS_2661Byte0C_signal" 635 "SIGNALS_Virtual_DcmDspUDS_2661Byte0D_signal" 636 "SIGNALS_Virtual_DcmDspUDS_2661Byte0E_signal" 637 "SIGNALS_Virtual_DcmDspUDS_2661Byte0F_signal" 638 "SIGNALS_Virtual_DcmDspUDS_2661Byte0_signal" 639 "SIGNALS_Virtual_DcmDspUDS_2661Byte1_signal" 640 "SIGNALS_Virtual_DcmDspUDS_2661Byte2D_signal" 641 "SIGNALS_Virtual_DcmDspUDS_2661Byte2E_signal" 642 "SIGNALS_Virtual_DcmDspUDS_2661Byte2F_signal" 643 "SIGNALS_Virtual_DcmDspUDS_2661Byte2_signal" 644 "SIGNALS_Virtual_DcmDspUDS_2661Byte30_signal" 645 "SIGNALS_Virtual_DcmDspUDS_2661Byte31_signal" 646 "SIGNALS_Virtual_DcmDspUDS_2661Byte32_signal" 647 "SIGNALS_Virtual_DcmDspUDS_2661Byte3_signal" 648 "SIGNALS_Virtual_DcmDspUDS_2661Byte4_signal" 649 "SIGNALS_Virtual_DcmDspUDS_2661Byte5_signal" 650 "SIGNALS_Virtual_DcmDspUDS_2661Byte6_signal" 651 "SIGNALS_Virtual_DcmDspUDS_2661Byte7_signal" 652 "SIGNALS_Virtual_DcmDspUDS_2661Byte8_signal" 653 "SIGNALS_Virtual_DcmDspUDS_2661Byte9_signal" 654 "SIGNALS_Virtual_DcmDspUDS_2662Byte0Cto0D_signal" 655 "SIGNALS_Virtual_DcmDspUDS_2662Byte0_signal" 656 "SIGNALS_Virtual_DcmDspUDS_2662Byte18_signal" 657 "SIGNALS_Virtual_DcmDspUDS_2662Byte19_signal" 658 "SIGNALS_Virtual_DcmDspUDS_2662Byte1_signal" 659 "SIGNALS_Virtual_DcmDspUDS_2662Byte2_signal" 660 "SIGNALS_Virtual_DcmDspUDS_2662Byte3_signal" 661 "SIGNALS_Virtual_DcmDspUDS_2662Byte4_signal" 662 "SIGNALS_Virtual_DcmDspUDS_2662Byte5_signal" 663 "SIGNALS_Virtual_DcmDspUDS_2663Byte0_signal" 664 "SIGNALS_Virtual_DcmDspUDS_2663Byte14Byte15_signal" 665 "SIGNALS_Virtual_DcmDspUDS_2663Byte16Byte17_signal" 666 "SIGNALS_Virtual_DcmDspUDS_2663Byte18Byte19_signal" 667 "SIGNALS_Virtual_DcmDspUDS_2663Byte1AByte1B_signal" 668 "SIGNALS_Virtual_DcmDspUDS_2663Byte1_signal" 669 "SIGNALS_Virtual_DcmDspUDS_2663Byte2_signal" 670 "SIGNALS_Virtual_DcmDspUDS_2663Byte3_signal" 671 "SIGNALS_Virtual_DcmDspUDS_2663Byte4_signal" 672 "SIGNALS_Virtual_DcmDspUDS_2663Byte5_signal" 673 "SIGNALS_Virtual_DcmDspUDS_2664Byte0_signal" 674 "SIGNALS_Virtual_DcmDspUDS_2664Byte1_signal" 675 "SIGNALS_Virtual_DcmDspUDS_2664Byte25_signal" 676 "SIGNALS_Virtual_DcmDspUDS_2664Byte26_signal" 677 "SIGNALS_Virtual_DcmDspUDS_2664Byte2_signal" 678 "SIGNALS_Virtual_DcmDspUDS_2664Byte3_signal" 679 "SIGNALS_Virtual_DcmDspUDS_2664Byte4_signal" 680 "SIGNALS_Virtual_DcmDspUDS_2664Byte5_signal" 681 "SIGNALS_Virtual_DcmDspUDS_2664Byte6_signal" 682 "SIGNALS_Virtual_DcmDspUDS_2664Byte7_signal" 683 "SIGNALS_Virtual_DcmDspUDS_2665Byte0_signal" 684 "SIGNALS_Virtual_DcmDspUDS_2665Byte1_signal" 685 "SIGNALS_Virtual_DcmDspUDS_2665Byte2_signal" 686 "SIGNALS_Virtual_DcmDspUDS_2665Byte3_signal" 687 "SIGNALS_Virtual_DcmDspUDS_2665Byte4_signal" 688 "SIGNALS_Virtual_DcmDspUDS_2665Byte5_signal" 689 "SIGNALS_Virtual_DcmDspUDS_2666Byte0_signal" 690 "SIGNALS_Virtual_DcmDspUDS_2666Byte1_signal" 691 "SIGNALS_Virtual_DcmDspUDS_2666Byte2_signal" 692 "SIGNALS_Virtual_DcmDspUDS_2666Byte3_signal" 693 "SIGNALS_Virtual_DcmDspUDS_2666Byte4_signal" 694 "SIGNALS_Virtual_DcmDspUDS_2666Byte5_signal" 695 "SIGNALS_Virtual_DcmDspUDS_2668Byte0_signal" 696 "SIGNALS_Virtual_DcmDspUDS_2668Byte1_signal" 697 "SIGNALS_Virtual_DcmDspUDS_2668Byte2_signal" 698 "SIGNALS_Virtual_DcmDspUDS_2668Byte3_signal" 699 "SIGNALS_Virtual_DcmDspUDS_2668Byte4_signal" 700 "SIGNALS_Virtual_DcmDspUDS_2668Byte5_signal" 701 "SIGNALS_Virtual_DcmDspUDS_266CByte0_signal" 702 "SIGNALS_Virtual_DcmDspUDS_266CByte1_signal" 703 "SIGNALS_Virtual_DcmDspUDS_266CByte26_signal" 704 "SIGNALS_Virtual_DcmDspUDS_266CByte27_signal" 705 "SIGNALS_Virtual_DcmDspUDS_266CByte2_signal" 706 "SIGNALS_Virtual_DcmDspUDS_266CByte3_signal" 707 "SIGNALS_Virtual_DcmDspUDS_266CByte4_signal" 708 "SIGNALS_Virtual_DcmDspUDS_266CByte5_signal" 709 "SIGNALS_Virtual_DcmDspUDS_266CByte6_signal" 710 "SIGNALS_Virtual_DcmDspUDS_266CByte7_signal" 711 "SIGNALS_Virtual_DcmDspUDS_266CByte8_signal" 712 "SIGNALS_Virtual_DcmDspUDS_266CByte9_signal" 713 "SIGNALS_Virtual_DcmDspUDS_266DByte0_signal" 714 "SIGNALS_Virtual_DcmDspUDS_266DByte1_signal" 715 "SIGNALS_Virtual_DcmDspUDS_266DByte2_signal" 716 "SIGNALS_Virtual_DcmDspUDS_266DByte3_signal" 717 "SIGNALS_Virtual_DcmDspUDS_266DByte4_signal" 718 "SIGNALS_Virtual_DcmDspUDS_266DByte5_signal" 719 "SIGNALS_Virtual_DcmDspUDS_266FByte0_signal" 720 "SIGNALS_Virtual_DcmDspUDS_266FByte1_signal" 721 "SIGNALS_Virtual_DcmDspUDS_266FByte2_signal" 722 "SIGNALS_Virtual_DcmDspUDS_266FByte3_signal" 723 "SIGNALS_Virtual_DcmDspUDS_2673Byte0A_signal" 724 "SIGNALS_Virtual_DcmDspUDS_2673Byte0B_signal" 725 "SIGNALS_Virtual_DcmDspUDS_2673Byte0_signal" 726 "SIGNALS_Virtual_DcmDspUDS_2673Byte12_signal" 727 "SIGNALS_Virtual_DcmDspUDS_2673Byte13_signal" 728 "SIGNALS_Virtual_DcmDspUDS_2673Byte16_signal" 729 "SIGNALS_Virtual_DcmDspUDS_2673Byte17_signal" 730 "SIGNALS_Virtual_DcmDspUDS_2673Byte1E_signal" 731 "SIGNALS_Virtual_DcmDspUDS_2673Byte1F_signal" 732 "SIGNALS_Virtual_DcmDspUDS_2673Byte1_signal" 733 "SIGNALS_Virtual_DcmDspUDS_2673Byte2_signal" 734 "SIGNALS_Virtual_DcmDspUDS_2673Byte3_signal" 735 "SIGNALS_Virtual_DcmDspUDS_2673Byte4_signal" 736 "SIGNALS_Virtual_DcmDspUDS_2673Byte5_signal" 737 "SIGNALS_Virtual_DcmDspUDS_2673Byte6_signal" 738 "SIGNALS_Virtual_DcmDspUDS_2673Byte7_signal" 739 "SIGNALS_Virtual_DcmDspUDS_2676Byte0_signal" 740 "SIGNALS_Virtual_DcmDspUDS_2676Byte1_signal" 741 "SIGNALS_Virtual_DcmDspUDS_2676Byte2E_signal" 742 "SIGNALS_Virtual_DcmDspUDS_2676Byte2F_signal" 743 "SIGNALS_Virtual_DcmDspUDS_2676Byte2_signal" 744 "SIGNALS_Virtual_DcmDspUDS_2676Byte3_signal" 745 "SIGNALS_Virtual_DcmDspUDS_2676Byte4_signal" 746 "SIGNALS_Virtual_DcmDspUDS_2676Byte5_signal" 747 "SIGNALS_Virtual_DcmDspUDS_2676Byte6_signal" 748 "SIGNALS_Virtual_DcmDspUDS_2676Byte7_signal" 749 "SIGNALS_Virtual_DcmDspUDS_267BByte0_signal" 750 "SIGNALS_Virtual_DcmDspUDS_267BByte1_signal" 751 "SIGNALS_Virtual_DcmDspUDS_267BByte2_signal" 752 "SIGNALS_Virtual_DcmDspUDS_267BByte3_signal" 753 "SIGNALS_Virtual_DcmDspUDS_267BByte4_signal" 754 "SIGNALS_Virtual_DcmDspUDS_267BByte5_signal" 755 "SIGNALS_Virtual_DcmDspUDS_267EByte0_signal" 756 "SIGNALS_Virtual_DcmDspUDS_267EByte1_signal" 757 "SIGNALS_Virtual_DcmDspUDS_267EByte22_signal" 758 "SIGNALS_Virtual_DcmDspUDS_267EByte2_signal" 759 "SIGNALS_Virtual_DcmDspUDS_2680Byte00_signal" 760 "SIGNALS_Virtual_DcmDspUDS_2680Byte01_signal" 761 "SIGNALS_Virtual_DcmDspUDS_2680Byte02_signal" 762 "SIGNALS_Virtual_DcmDspUDS_2680Byte03_signal" 763 "SIGNALS_Virtual_DcmDspUDS_2680Byte04_signal" 764 "SIGNALS_Virtual_DcmDspUDS_2680Byte05_signal" 765 "SIGNALS_Virtual_DcmDspUDS_2680Byte08_signal" 766 "SIGNALS_Virtual_DcmDspUDS_2680Byte09_signal" 767 "SIGNALS_Virtual_DcmDspUDS_2680Byte0E_signal" 768 "SIGNALS_Virtual_DcmDspUDS_2680Byte0F_signal" 769 "SIGNALS_Virtual_DcmDspUDS_2681Byte00_signal" 770 "SIGNALS_Virtual_DcmDspUDS_2681Byte01_signal" 771 "SIGNALS_Virtual_DcmDspUDS_2681Byte02_signal" 772 "SIGNALS_Virtual_DcmDspUDS_2681Byte03_signal" 773 "SIGNALS_Virtual_DcmDspUDS_2681Byte04_signal" 774 "SIGNALS_Virtual_DcmDspUDS_2681Byte05_signal" 775 "SIGNALS_Virtual_DcmDspUDS_2681Byte0F_signal" 776 "SIGNALS_Virtual_DcmDspUDS_2681Byte10_signal" 777 "SIGNALS_Virtual_DcmDspUDS_2681Byte13_signal" 778 "SIGNALS_Virtual_DcmDspUDS_2681Byte14_signal" 779 "SIGNALS_Virtual_DcmDspUDS_2681Byte1D_signal" 780 "SIGNALS_Virtual_DcmDspUDS_2681Byte1E_signal" 781 "SIGNALS_Virtual_DcmDspUDS_2682Byte00_signal" 782 "SIGNALS_Virtual_DcmDspUDS_2682Byte01_signal" 783 "SIGNALS_Virtual_DcmDspUDS_2682Byte02_signal" 784 "SIGNALS_Virtual_DcmDspUDS_2682Byte03_signal" 785 "SIGNALS_Virtual_DcmDspUDS_2682Byte04_signal" 786 "SIGNALS_Virtual_DcmDspUDS_2682Byte05_signal" 787 "SIGNALS_Virtual_DcmDspUDS_2682Byte06_07_signal" 788 "SIGNALS_Virtual_DcmDspUDS_2682Byte08_09_signal" 789 "SIGNALS_Virtual_DcmDspUDS_2682Byte0E_signal" 790 "SIGNALS_Virtual_DcmDspUDS_2682Byte11_12_signal" 791 "SIGNALS_Virtual_DcmDspUDS_2682Byte13_14_signal" 792 "SIGNALS_Virtual_DcmDspUDS_2682Byte15_16_signal" 793 "SIGNALS_Virtual_DcmDspUDS_2682Byte18_19_signal" 794 "SIGNALS_Virtual_DcmDspUDS_2682Byte1B_signal" 795 "SIGNALS_Virtual_DcmDspUDS_2682Byte1C_signal" 796 "SIGNALS_Virtual_DcmDspUDS_2683Byte00_signal" 797 "SIGNALS_Virtual_DcmDspUDS_2683Byte01_signal" 798 "SIGNALS_Virtual_DcmDspUDS_2683Byte02_signal" 799 "SIGNALS_Virtual_DcmDspUDS_2683Byte03_signal" 800 "SIGNALS_Virtual_DcmDspUDS_2683Byte04_signal" 801 "SIGNALS_Virtual_DcmDspUDS_2683Byte05_signal" 802 "SIGNALS_Virtual_DcmDspUDS_2684Byte00_signal" 803 "SIGNALS_Virtual_DcmDspUDS_2684Byte01_signal" 804 "SIGNALS_Virtual_DcmDspUDS_2684Byte02_signal" 805 "SIGNALS_Virtual_DcmDspUDS_2684Byte03_signal" 806 "SIGNALS_Virtual_DcmDspUDS_2684Byte04_signal" 807 "SIGNALS_Virtual_DcmDspUDS_2684Byte05_signal" 808 "SIGNALS_Virtual_DcmDspUDS_2688Byte00_signal" 809 "SIGNALS_Virtual_DcmDspUDS_2688Byte01_signal" 810 "SIGNALS_Virtual_DcmDspUDS_2688Byte02_signal" 811 "SIGNALS_Virtual_DcmDspUDS_2688Byte03_signal" 812 "SIGNALS_Virtual_DcmDspUDS_2688Byte04_signal" 813 "SIGNALS_Virtual_DcmDspUDS_2688Byte05_signal" 814 "SIGNALS_Virtual_DcmDspUDS_2689Byte00_signal" 815 "SIGNALS_Virtual_DcmDspUDS_2689Byte01_signal" 816 "SIGNALS_Virtual_DcmDspUDS_2689Byte02_signal" 817 "SIGNALS_Virtual_DcmDspUDS_2689Byte03_signal" 818 "SIGNALS_Virtual_DcmDspUDS_2689Byte04_signal" 819 "SIGNALS_Virtual_DcmDspUDS_2689Byte05_signal" 820 "SIGNALS_Virtual_DcmDspUDS_2689Byte06to09_signal" 821 "SIGNALS_Virtual_DcmDspUDS_2689Byte0Eto11_signal" 822 "SIGNALS_Virtual_DcmDspUDS_2689Byte12to15_signal" 823 "SIGNALS_Virtual_DcmDspUDS_2689Byte16to19_signal" 824 "SIGNALS_Virtual_DcmDspUDS_2689Byte1Ato1D_signal" 825 "SIGNALS_Virtual_DcmDspUDS_2689Byte1Eto21_signal" 826 "SIGNALS_Virtual_DcmDspUDS_2689Byte22to25_signal" 827 "SIGNALS_Virtual_DcmDspUDS_2689Byte26to29_signal" 828 "SIGNALS_Virtual_DcmDspUDS_2689Byte2Ato2D_signal" 829 "SIGNALS_Virtual_DcmDspUDS_2689Byte2Eto31_signal" 830 "SIGNALS_Virtual_DcmDspUDS_268BByte00_signal" 831 "SIGNALS_Virtual_DcmDspUDS_268BByte01_signal" 832 "SIGNALS_Virtual_DcmDspUDS_268BByte02_signal" 833 "SIGNALS_Virtual_DcmDspUDS_268BByte03_signal" 834 "SIGNALS_Virtual_DcmDspUDS_268BByte04_signal" 835 "SIGNALS_Virtual_DcmDspUDS_268BByte05_signal" 836 "SIGNALS_Virtual_DcmDspUDS_268BByte06_signal" 837 "SIGNALS_Virtual_DcmDspUDS_268BByte07_signal" 838 "SIGNALS_Virtual_DcmDspUDS_268BByte08_signal" 839 "SIGNALS_Virtual_DcmDspUDS_268BByte09_signal" 840 "SIGNALS_Virtual_DcmDspUDS_268BByte0A_signal" 841 "SIGNALS_Virtual_DcmDspUDS_268BByte0B_signal" 842 "SIGNALS_Virtual_DcmDspUDS_268BByte0C_signal" 843 "SIGNALS_Virtual_DcmDspUDS_268BByte0D_signal" 844 "SIGNALS_Virtual_DcmDspUDS_268CByte00_signal" 845 "SIGNALS_Virtual_DcmDspUDS_268CByte01_signal" 846 "SIGNALS_Virtual_DcmDspUDS_268CByte02_signal" 847 "SIGNALS_Virtual_DcmDspUDS_268CByte03_signal" 848 "SIGNALS_Virtual_DcmDspUDS_268CByte04_signal" 849 "SIGNALS_Virtual_DcmDspUDS_268CByte05_signal" 850 "SIGNALS_Virtual_DcmDspUDS_268CByte06_signal" 851 "SIGNALS_Virtual_DcmDspUDS_268CByte07_signal" 852 "SIGNALS_Virtual_DcmDspUDS_268CByte08_signal" 853 "SIGNALS_Virtual_DcmDspUDS_268CByte09_signal" 854 "SIGNALS_Virtual_DcmDspUDS_268CByte0A_signal" 855 "SIGNALS_Virtual_DcmDspUDS_268CByte2E_signal" 856 "SIGNALS_Virtual_DcmDspUDS_268CByte2F_signal" 857 "SIGNALS_Virtual_DcmDspUDS_268CByte30_signal" 858 "SIGNALS_Virtual_DcmDspUDS_268CByte31_signal" 859 "SIGNALS_Virtual_DcmDspUDS_268CByte32_signal" 860 "SIGNALS_Virtual_DcmDspUDS_268CByte33_signal" 861 "SIGNALS_Virtual_DcmDspUDS_268EByte00_signal" 862 "SIGNALS_Virtual_DcmDspUDS_268EByte01_signal" 863 "SIGNALS_Virtual_DcmDspUDS_268EByte02_signal" 864 "SIGNALS_Virtual_DcmDspUDS_268EByte03_signal" 865 "SIGNALS_Virtual_DcmDspUDS_268EByte04_signal" 866 "SIGNALS_Virtual_DcmDspUDS_268EByte05_signal" 867 "SIGNALS_Virtual_DcmDspUDS_268EByte08to09_signal" 868 "SIGNALS_Virtual_DcmDspUDS_268EByte0A_signal" 869 "SIGNALS_Virtual_DcmDspUDS_268EByte0B_signal" 870 "SIGNALS_Virtual_DcmDspUDS_268FByte00_signal" 871 "SIGNALS_Virtual_DcmDspUDS_268FByte01_signal" 872 "SIGNALS_Virtual_DcmDspUDS_268FByte02_signal" 873 "SIGNALS_Virtual_DcmDspUDS_268FByte03_signal" 874 "SIGNALS_Virtual_DcmDspUDS_268FByte04_signal" 875 "SIGNALS_Virtual_DcmDspUDS_268FByte05_signal" 876 "SIGNALS_Virtual_DcmDspUDS_268FByte0A_signal" 877 "SIGNALS_Virtual_DcmDspUDS_268FByte0B_signal" 878 "SIGNALS_Virtual_DcmDspUDS_268FByte16_17_signal" 879 "SIGNALS_Virtual_DcmDspUDS_268FByte18_19_signal" 880 "SIGNALS_Virtual_DcmDspUDS_268FByte1A_1B_signal" 881 "SIGNALS_Virtual_DcmDspUDS_2699Byte00_signal" 882 "SIGNALS_Virtual_DcmDspUDS_2699Byte01_signal" 883 "SIGNALS_Virtual_DcmDspUDS_2699Byte02_signal" 884 "SIGNALS_Virtual_DcmDspUDS_2699Byte03_signal" 885 "SIGNALS_Virtual_DcmDspUDS_2699Byte04_signal" 886 "SIGNALS_Virtual_DcmDspUDS_2699Byte05_signal" 887 "SIGNALS_Virtual_DcmDspUDS_2699Byte06_signal" 888 "SIGNALS_Virtual_DcmDspUDS_2699Byte07_signal" 889 "SIGNALS_Virtual_DcmDspUDS_2699Byte0B_0C_signal" 890 "SIGNALS_Virtual_DcmDspUDS_2699Byte16_signal" 891 "SIGNALS_Virtual_DcmDspUDS_2699Byte17_signal" 892 "SIGNALS_Virtual_DcmDspUDS_2699Byte26_27_signal" 893 "SIGNALS_Virtual_DcmDspUDS_2699Byte28_29_signal" 894 "SIGNALS_Virtual_DcmDspUDS_2699Byte2A_2B_signal" 895 "SIGNALS_Virtual_DcmDspUDS_2699Byte2E_signal" 896 "SIGNALS_Virtual_DcmDspUDS_2699Byte2F_30_signal" 897 "SIGNALS_Virtual_DcmDspUDS_269AByte00_signal" 898 "SIGNALS_Virtual_DcmDspUDS_269AByte01_signal" 899 "SIGNALS_Virtual_DcmDspUDS_269AByte02_signal" 900 "SIGNALS_Virtual_DcmDspUDS_269AByte03_signal" 901 "SIGNALS_Virtual_DcmDspUDS_269AByte04_signal" 902 "SIGNALS_Virtual_DcmDspUDS_269AByte05_signal" 903 "SIGNALS_Virtual_DcmDspUDS_269BByte00_signal" 904 "SIGNALS_Virtual_DcmDspUDS_269BByte01_signal" 905 "SIGNALS_Virtual_DcmDspUDS_269BByte02_signal" 906 "SIGNALS_Virtual_DcmDspUDS_269BByte03_signal" 907 "SIGNALS_Virtual_DcmDspUDS_269BByte04_signal" 908 "SIGNALS_Virtual_DcmDspUDS_269BByte05_signal" 909 "SIGNALS_Virtual_DcmDspUDS_269EByte00_signal" 910 "SIGNALS_Virtual_DcmDspUDS_269EByte01_signal" 911 "SIGNALS_Virtual_DcmDspUDS_269EByte02_signal" 912 "SIGNALS_Virtual_DcmDspUDS_269EByte03_signal" 913 "SIGNALS_Virtual_DcmDspUDS_269EByte04_signal" 914 "SIGNALS_Virtual_DcmDspUDS_269EByte05_signal" 915 "SIGNALS_Virtual_DcmDspUDS_26A0Byte00_signal" 916 "SIGNALS_Virtual_DcmDspUDS_26A0Byte01_signal" 917 "SIGNALS_Virtual_DcmDspUDS_26A0Byte02_signal" 918 "SIGNALS_Virtual_DcmDspUDS_26A0Byte03_signal" 919 "SIGNALS_Virtual_DcmDspUDS_26A0Byte04_signal" 920 "SIGNALS_Virtual_DcmDspUDS_26A0Byte05_signal" 921 "SIGNALS_Virtual_DcmDspUDS_26A0Byte06_signal" 922 "SIGNALS_Virtual_DcmDspUDS_26A0Byte07_signal" 923 "SIGNALS_Virtual_DcmDspUDS_26A0Byte08_signal" 924 "SIGNALS_Virtual_DcmDspUDS_26A0Byte09_signal" 925 "SIGNALS_Virtual_DcmDspUDS_26A0Byte0A_signal" 926 "SIGNALS_Virtual_DcmDspUDS_26A0Byte0B_signal" 927 "SIGNALS_Virtual_DcmDspUDS_26A0Byte0C_signal" 928 "SIGNALS_Virtual_DcmDspUDS_26A0Byte0D_signal" 929 "SIGNALS_Virtual_DcmDspUDS_26A0Byte0E_signal" 930 "SIGNALS_Virtual_DcmDspUDS_26A0Byte0F_signal" 931 "SIGNALS_Virtual_DcmDspUDS_26A0Byte10_signal" 932 "SIGNALS_Virtual_DcmDspUDS_26A0Byte11_signal" 933 "SIGNALS_Virtual_DcmDspUDS_26A0Byte12_signal" 934 "SIGNALS_Virtual_DcmDspUDS_26A0Byte13_signal" 935 "SIGNALS_Virtual_DcmDspUDS_26A0Byte14_signal" 936 "SIGNALS_Virtual_DcmDspUDS_26A0Byte15_signal" 937 "SIGNALS_Virtual_DcmDspUDS_26A0Byte16_signal" 938 "SIGNALS_Virtual_DcmDspUDS_26A0Byte17_signal" 939 "SIGNALS_Virtual_DcmDspUDS_26A0Byte18_signal" 940 "SIGNALS_Virtual_DcmDspUDS_26A0Byte19_signal" 941 "SIGNALS_Virtual_DcmDspUDS_26A0Byte1A_signal" 942 "SIGNALS_Virtual_DcmDspUDS_26A0Byte4E_signal" 943 "SIGNALS_Virtual_DcmDspUDS_26A0Byte52_53_signal" 944 "SIGNALS_Virtual_DcmDspUDS_26A0Byte54_55_signal" 945 "SIGNALS_Virtual_DcmDspUDS_26A0Byte56_57_signal" 946 "SIGNALS_Virtual_DcmDspUDS_26A0Byte66_signal" 947 "SIGNALS_Virtual_DcmDspUDS_26A0Byte67_signal" 948 "SIGNALS_Virtual_DcmDspUDS_26A0Byte68_signal" 949 "SIGNALS_Virtual_DcmDspUDS_26A0Byte69_signal" 950 "SIGNALS_Virtual_DcmDspUDS_26A0Byte6A_signal" 951 "SIGNALS_Virtual_DcmDspUDS_26A0Byte6B_signal" 952 "SIGNALS_Virtual_DcmDspUDS_26A0Byte6C_signal" 953 "SIGNALS_Virtual_DcmDspUDS_26A0Byte6D_signal" 954 "SIGNALS_Virtual_DcmDspUDS_26A0Byte7F_80_signal" 955 "SIGNALS_Virtual_DcmDspUDS_26A0Byte81_82_signal" 956 "SIGNALS_Virtual_DcmDspUDS_26A0Byte83_84_signal" 957 "SIGNALS_Virtual_DcmDspUDS_26A0Byte85_86_signal" 958 "SIGNALS_Virtual_DcmDspUDS_26A0Byte87_88_signal" 959 "SIGNALS_Virtual_DcmDspUDS_26A0Byte89_8A_signal" 960 "SIGNALS_Virtual_DcmDspUDS_26A0Byte8B_8C_signal" 961 "SIGNALS_Virtual_DcmDspUDS_26A0Byte8D_8E_signal" 962 "SIGNALS_Virtual_DcmDspUDS_26A0Byte8F_90_signal" 963 "SIGNALS_Virtual_DcmDspUDS_26A0Byte91_92_signal" 964 "SIGNALS_Virtual_DcmDspUDS_26A0Byte93_94_signal" 965 "SIGNALS_Virtual_DcmDspUDS_26A0Byte95_96_signal" 966 "SIGNALS_Virtual_DcmDspUDS_26A0Byte97_98_signal" 967 "SIGNALS_Virtual_DcmDspUDS_26A0Byte99_9A_signal" 968 "SIGNALS_Virtual_DcmDspUDS_26A0Byte9B_9C_signal" 969 "SIGNALS_Virtual_DcmDspUDS_26A0Byte9D_9E_signal" 970 "SIGNALS_Virtual_DcmDspUDS_26A0Byte9F_A0_signal" 971 "SIGNALS_Virtual_DcmDspUDS_26A0ByteA1_A2_signal" 972 "SIGNALS_Virtual_DcmDspUDS_26A0ByteA3_A4_signal" 973 "SIGNALS_Virtual_DcmDspUDS_26A0ByteA5_A6_signal" 974 "SIGNALS_Virtual_DcmDspUDS_26A0ByteA7_A8_signal" 975 "SIGNALS_Virtual_DcmDspUDS_26A0ByteA9_AA_signal" 976 "SIGNALS_Virtual_DcmDspUDS_26A0ByteAB_AC_signal" 977 "SIGNALS_Virtual_DcmDspUDS_26A0ByteAD_AE_signal" 978 "SIGNALS_Virtual_DcmDspUDS_26A0ByteAF_B0_signal" 979 "SIGNALS_Virtual_DcmDspUDS_26A0ByteB1_B2_signal" 980 "SIGNALS_Virtual_DcmDspUDS_26A0ByteB3_B4_signal" 981 "SIGNALS_Virtual_DcmDspUDS_26A0ByteB5_B6_signal" 982 "SIGNALS_Virtual_DcmDspUDS_26A0ByteB7_B8_signal" 983 "SIGNALS_Virtual_DcmDspUDS_26A0ByteB9_BA_signal" 984 "SIGNALS_Virtual_DcmDspUDS_26A0ByteBB_BC_signal" 985 "SIGNALS_Virtual_DcmDspUDS_26A0ByteBD_BE_signal" 986 "SIGNALS_Virtual_DcmDspUDS_26A0ByteBF_C0_signal" 987 "SIGNALS_Virtual_DcmDspUDS_26A0ByteC1_C2_signal" 988 "SIGNALS_Virtual_DcmDspUDS_26A0ByteC3_C4_signal" 989 "SIGNALS_Virtual_DcmDspUDS_26A0ByteC5_C6_signal" 990 "SIGNALS_Virtual_DcmDspUDS_26A0ByteC7_C8_signal" 991 "SIGNALS_Virtual_DcmDspUDS_26A0ByteC9_CA_signal" 992 "SIGNALS_Virtual_DcmDspUDS_26A0ByteCB_CC_signal" 993 "SIGNALS_Virtual_DcmDspUDS_26A0ByteCD_CE_signal" 994 "SIGNALS_Virtual_DcmDspUDS_26A0ByteCF_D0_signal" 995 "SIGNALS_Virtual_DcmDspUDS_26A0ByteD1_D2_signal" 996 "SIGNALS_Virtual_DcmDspUDS_26A0ByteD3_D4_signal" 997 "SIGNALS_Virtual_DcmDspUDS_26A0ByteD5_D6_signal" 998 "SIGNALS_Virtual_DcmDspUDS_26A0ByteD7_D8_signal" 999 "SIGNALS_Virtual_DcmDspUDS_26A0ByteD9_DA_signal" 1000 "SIGNALS_Virtual_DcmDspUDS_26A0ByteDB_DC_signal" 1001 "SIGNALS_Virtual_DcmDspUDS_26A0ByteDD_DE_signal" 1002 "SIGNALS_Virtual_DcmDspUDS_26A0ByteDF_E0_signal" 1003 "SIGNALS_Virtual_DcmDspUDS_26A0ByteE1_E2_signal" 1004 "SIGNALS_Virtual_DcmDspUDS_26A0ByteE3_E4_signal" 1005 "SIGNALS_Virtual_DcmDspUDS_26A0ByteE5_E6_signal" 1006 "SIGNALS_Virtual_DcmDspUDS_26A0ByteE7_E8_signal" 1007 "SIGNALS_Virtual_DcmDspUDS_26A0ByteE9_EA_signal" 1008 "SIGNALS_Virtual_DcmDspUDS_26A0ByteEB_EC_signal" 1009 "SIGNALS_Virtual_DcmDspUDS_26A0ByteED_EE_signal" 1010 "SIGNALS_Virtual_DcmDspUDS_26A0ByteEF_F0_signal" 1011 "SIGNALS_Virtual_DcmDspUDS_26A0ByteF1_F2_signal" 1012 "SIGNALS_Virtual_DcmDspUDS_26A1Byte00_signal" 1013 "SIGNALS_Virtual_DcmDspUDS_26A1Byte01_signal" 1014 "SIGNALS_Virtual_DcmDspUDS_26A1Byte02_signal" 1015 "SIGNALS_Virtual_DcmDspUDS_26A1Byte03_signal" 1016 "SIGNALS_Virtual_DcmDspUDS_26A1Byte04_signal" 1017 "SIGNALS_Virtual_DcmDspUDS_26A1Byte05_signal" 1018 "SIGNALS_Virtual_DcmDspUDS_26A1Byte06_signal" 1019 "SIGNALS_Virtual_DcmDspUDS_26A1Byte07_signal" 1020 "SIGNALS_Virtual_DcmDspUDS_26A1Byte08_signal" 1021 "SIGNALS_Virtual_DcmDspUDS_26A1Byte09_signal" 1022 "SIGNALS_Virtual_DcmDspUDS_26A1Byte0A_signal" 1023 "SIGNALS_Virtual_DcmDspUDS_26A1Byte0B_signal" 1024 "SIGNALS_Virtual_DcmDspUDS_26A1Byte0C_signal" 1025 "SIGNALS_Virtual_DcmDspUDS_26A1Byte0D_signal" 1026 "SIGNALS_Virtual_DcmDspUDS_26A1Byte0E_signal" 1027 "SIGNALS_Virtual_DcmDspUDS_26A1Byte0F_signal" 1028 "SIGNALS_Virtual_DcmDspUDS_26A1Byte10_signal" 1029 "SIGNALS_Virtual_DcmDspUDS_26A1Byte11_signal" 1030 "SIGNALS_Virtual_DcmDspUDS_26A1Byte12_signal" 1031 "SIGNALS_Virtual_DcmDspUDS_26A1Byte13_signal" 1032 "SIGNALS_Virtual_DcmDspUDS_26A1Byte14_signal" 1033 "SIGNALS_Virtual_DcmDspUDS_26A1Byte15_signal" 1034 "SIGNALS_Virtual_DcmDspUDS_26A1Byte16_signal" 1035 "SIGNALS_Virtual_DcmDspUDS_26A1Byte17_signal" 1036 "SIGNALS_Virtual_DcmDspUDS_26A1Byte18_signal" 1037 "SIGNALS_Virtual_DcmDspUDS_26A1Byte19_signal" 1038 "SIGNALS_Virtual_DcmDspUDS_26A1Byte1A_signal" 1039 "SIGNALS_Virtual_DcmDspUDS_26A1Byte1B_1C_signal" 1040 "SIGNALS_Virtual_DcmDspUDS_26A1Byte1D_1E_signal" 1041 "SIGNALS_Virtual_DcmDspUDS_26A1Byte1F_20_signal" 1042 "SIGNALS_Virtual_DcmDspUDS_26A1Byte21_22_signal" 1043 "SIGNALS_Virtual_DcmDspUDS_26A1Byte23_24_signal" 1044 "SIGNALS_Virtual_DcmDspUDS_26A1Byte25_signal" 1045 "SIGNALS_Virtual_DcmDspUDS_26A1Byte26_signal" 1046 "SIGNALS_Virtual_DcmDspUDS_26A1Byte27_signal" 1047 "SIGNALS_Virtual_DcmDspUDS_26A1Byte28_signal" 1048 "SIGNALS_Virtual_DcmDspUDS_26A1Byte29_signal" 1049 "SIGNALS_Virtual_DcmDspUDS_26A1Byte2A_signal" 1050 "SIGNALS_Virtual_DcmDspUDS_26A1Byte2B_signal" 1051 "SIGNALS_Virtual_DcmDspUDS_26A1Byte2C_signal" 1052 "SIGNALS_Virtual_DcmDspUDS_26A1Byte2D_signal" 1053 "SIGNALS_Virtual_DcmDspUDS_26A1Byte2E_signal" 1054 "SIGNALS_Virtual_DcmDspUDS_26A1Byte2F_signal" 1055 "SIGNALS_Virtual_DcmDspUDS_26A1Byte30_signal" 1056 "SIGNALS_Virtual_DcmDspUDS_26A1Byte31_signal" 1057 "SIGNALS_Virtual_DcmDspUDS_26A1Byte32_signal" 1058 "SIGNALS_Virtual_DcmDspUDS_26A1Byte33_signal" 1059 "SIGNALS_Virtual_DcmDspUDS_26A1Byte34_signal" 1060 "SIGNALS_Virtual_DcmDspUDS_26A1Byte35_signal" 1061 "SIGNALS_Virtual_DcmDspUDS_26A1Byte36_signal" 1062 "SIGNALS_Virtual_DcmDspUDS_26A1Byte37_signal" 1063 "SIGNALS_Virtual_DcmDspUDS_26A1Byte38_signal" 1064 "SIGNALS_Virtual_DcmDspUDS_26A1Byte39_signal" 1065 "SIGNALS_Virtual_DcmDspUDS_26A1Byte6F_70_signal" 1066 "SIGNALS_Virtual_DcmDspUDS_26A1Byte71_72_signal" 1067 "SIGNALS_Virtual_DcmDspUDS_26A1Byte73_74_signal" 1068 "SIGNALS_Virtual_DcmDspUDS_26A1Byte75_76_signal" 1069 "SIGNALS_Virtual_DcmDspUDS_26A1Byte77_78_signal" 1070 "SIGNALS_Virtual_DcmDspUDS_26A1Byte79_signal" 1071 "SIGNALS_Virtual_DcmDspUDS_26A1Byte7B_signal" 1072 "SIGNALS_Virtual_DcmDspUDS_26A2Byte00_signal" 1073 "SIGNALS_Virtual_DcmDspUDS_26A2Byte01_signal" 1074 "SIGNALS_Virtual_DcmDspUDS_26A2Byte02_signal" 1075 "SIGNALS_Virtual_DcmDspUDS_26A2Byte03_signal" 1076 "SIGNALS_Virtual_DcmDspUDS_26A2Byte04_signal" 1077 "SIGNALS_Virtual_DcmDspUDS_26A2Byte05_signal" 1078 "SIGNALS_Virtual_DcmDspUDS_26A2Byte12_13_signal" 1079 "SIGNALS_Virtual_DcmDspUDS_26A2Byte1C_signal" 1080 "SIGNALS_Virtual_DcmDspUDS_26A2Byte1D_signal" 1081 "SIGNALS_Virtual_DcmDspUDS_26A2Byte21_signal" 1082 "SIGNALS_Virtual_DcmDspUDS_26A2Byte22_signal" 1083 "SIGNALS_Virtual_DcmDspUDS_Acm_fzabgs_w_signal" 1084 "SIGNALS_Virtual_DcmDspUDS_DID_2613Byte2Eto2F_signal_VirtFunc_s" 1085 "SIGNALS_Virtual_DcmDspUDS_DID_261AByte08_signal" 1086 "SIGNALS_Virtual_DcmDspUDS_DID_261AByte09_signal" 1087 "SIGNALS_Virtual_DcmDspUDS_DID_E402Byte00_signal" 1088 "SIGNALS_Virtual_DcmDspUDS_DID_E402Byte01_signal" 1089 "SIGNALS_Virtual_DcmDspUDS_DID_E402Byte07to08_signal" 1090 "SIGNALS_Virtual_DcmDspUDS_DID_E402Byte10to11_signal" 1091 "SIGNALS_Virtual_DcmDspUDS_DID_E402Byte19to1A_signal" 1092 "SIGNALS_Virtual_DcmDspUDS_DID_E402Byte22to23_signal" 1093 "SIGNALS_Virtual_DcmDspUDS_DID_E402Byte2Bto2C_signal" 1094 "SIGNALS_Virtual_DcmDspUDS_DID_F110Byte0_3_signal" 1095 "SIGNALS_Virtual_DcmDspUDS_DID_F110Byte12_15_signal" 1096 "SIGNALS_Virtual_DcmDspUDS_DID_F110Byte16_signal" 1097 "SIGNALS_Virtual_DcmDspUDS_DID_F110Byte4_7_signal" 1098 "SIGNALS_Virtual_DcmDspUDS_DID_F110Byte8_11_signal" 1099 "SIGNALS_Virtual_DcmDspUDS_DID_F112Byte0_3_signal" 1100 "SIGNALS_Virtual_DcmDspUDS_DID_F112Byte12_15_signal" 1101 "SIGNALS_Virtual_DcmDspUDS_DID_F112Byte16_19_signal" 1102 "SIGNALS_Virtual_DcmDspUDS_DID_F112Byte20_23_signal" 1103 "SIGNALS_Virtual_DcmDspUDS_DID_F112Byte24_27_signal" 1104 "SIGNALS_Virtual_DcmDspUDS_DID_F112Byte28_29_signal" 1105 "SIGNALS_Virtual_DcmDspUDS_DID_F112Byte30_signal" 1106 "SIGNALS_Virtual_DcmDspUDS_DID_F112Byte4_7_signal" 1107 "SIGNALS_Virtual_DcmDspUDS_DID_F112Byte8_11_signal" 1108 "SIGNALS_Virtual_DcmDspUDS_E602Byte2_signal" 1109 "SIGNALS_Virtual_DcmDspUDS_F181Byte0_3_signal" 1110 "SIGNALS_Virtual_DcmDspUDS_F181Byte12_15_signal" 1111 "SIGNALS_Virtual_DcmDspUDS_F181Byte4_7_signal" 1112 "SIGNALS_Virtual_DcmDspUDS_F181Byte8_11_signal" 1113 "SIGNALS_Virtual_DcmDspUDS_fzabgs_w_signal" 1114 "SIGNALS_Virtual_DcmDspUDS_numReWrECUID1_signal" 1115 "SIGNALS_Virtual_DcmDspUDS_numReWrECUID2_signal" 1116 "SIGNALS_Virtual_I14229B9_0490_FrNo09_signal" 1117 "SIGNALS_Virtual_I14229B9_0490_FrNo10_signal" 1118 "SIGNALS_Virtual_I14229B9_04B1_FrNo16_signal" 1119 "SIGNALS_Virtual_I14229B9_04B1_FrNo17_signal" 1120 "SIGNALS_Virtual_I14229B9_04B1_FrNo20_signal" 1121 "SIGNALS_Virtual_I14229B9_04B1_FrNo21_signal" 1122 "SIGNALS_Virtual_I14229B9_04B1_FrNo22_signal" 1123 "SIGNALS_Virtual_I14229B9_04B1_FrNo23_signal" 1124 "SIGNALS_Virtual_I14229B9_04C2_FrNo2021_signal" 1125 "SIGNALS_Virtual_I14229B9_04D2_FrNo24_signal" 1126 "SIGNALS_Virtual_I14229B9_04D2_FrNo25_signal" 1127 "SIGNALS_Virtual_I14229B9_0520_FrNo15_signal" 1128 "SIGNALS_Virtual_I14229B9_0520_FrNo16_signal" 1129 "SIGNALS_Virtual_I14229B9_0523_FrNo42_signal" 1130 "SIGNALS_Virtual_I14229B9_0523_FrNo43_signal" 1131 "SIGNALS_Virtual_I14229B9_0524_FrNo09_signal" 1132 "SIGNALS_Virtual_I14229B9_0524_FrNo10_signal" 1133 "SIGNALS_Virtual_I14229B9_0550_FrNo09_signal" 1134 "SIGNALS_Virtual_I14229B9_0550_FrNo10_signal" 1135 "SIGNALS_Virtual_I14229B9_0553_FrNo13_signal" 1136 "SIGNALS_Virtual_I14229B9_0553_FrNo14_signal" 1137 "SIGNALS_Virtual_I14229B9_056A_FrNo8_signal" 1138 "SIGNALS_Virtual_I14229B9_056A_FrNo9_signal" 1139 "SIGNALS_Virtual_I14229B9_0588_FrNo15_signal" 1140 "SIGNALS_Virtual_I14229B9_0588_FrNo16_signal" 1141 "SIGNALS_Virtual_I14229B9_05A0_FrNo40_signal" 1142 "SIGNALS_Virtual_I14229B9_05A0_FrNo41_signal" 1143 "SIGNALS_Virtual_I14229B9_05B0_FrNo13_signal" 1144 "SIGNALS_Virtual_I14229B9_05B0_FrNo14_signal" 1145 "SIGNALS_Virtual_I14229B9_05C0_FrNo12_signal" 1146 "SIGNALS_Virtual_I14229B9_05C0_FrNo13_signal" 1147 "SIGNALS_Virtual_I14229B9_05E0_FrNo19_signal" 1148 "SIGNALS_Virtual_I14229B9_05E0_FrNo20_signal" 1149 "SIGNALS_Virtual_I14229B9_05E0_FrNo21_signal" 1150 "SIGNALS_Virtual_I14229B9_05E0_FrNo22_signal" 1151 "SIGNALS_Virtual_I14229B9_05E0_FrNo23_signal" 1152 "SIGNALS_Virtual_I14229B9_05E0_FrNo24_signal" 1153 "SIGNALS_Virtual_I14229B9_1208_FrNo34_signal" 1154 "SIGNALS_Virtual_I14229B9_1208_FrNo35_signal" 1155 "SIGNALS_Virtual_I14229B9_1208_FrNo36_signal" 1156 "SIGNALS_Virtual_I14229B9_1208_FrNo37_signal" 1157 "SIGNALS_Virtual_I14229B9_120A_FrNo09_signal" 1158 "SIGNALS_Virtual_I14229B9_120A_FrNo10_signal" 1159 "SIGNALS_Virtual_I14229B9_120B_FrNo09_signal" 1160 "SIGNALS_Virtual_I14229B9_120B_FrNo10_signal" 1161 "SIGNALS_Virtual_I14229_Com_aLgtG_signal" 1162 "SIGNALS_Virtual_I14229_pEngSrtMin_signal" 1163 "SIGNALS_Virtual_IKCtl_agAdpnCurr_s16_signal" 1164 "SIGNALS_Virtual_IKCtl_wIntgRef_au32_0__s" 1165 "SIGNALS_Virtual_PtCoornDyn_tqCluDes_signal" 1166 "SIGNALS_Virtual_PtCoornDyn_tqCluLeadTrsmIntv_signal" 1167 "SIGNALS_Virtual_Tra_numGear_signal" 1168 "SIGNALS_Virtual_i14229_agIntkB1GEVlvSig_signal" /end COMPU_VTAB
/begin COMPU_METHOD spg_q0p001 "" RAT_FUNC "%6.5" "V" COEFFS 0 1000 0 0 0 1 /end COMPU_METHOD
/begin COMPU_METHOD spg_q0p1 "" RAT_FUNC "%6.3" "V" COEFFS 0 1 0 0 0 0.1 /end COMPU_METHOD
/begin COMPU_METHOD spg_q1p221Em3_V "" RAT_FUNC "%6.4" "V" COEFFS 0 65536 0 0 0 80 /end COMPU_METHOD
/begin COMPU_METHOD spg_uw_b5 "" RAT_FUNC "%6.4" "V" COEFFS 0 1024 0 0 0 5 /end COMPU_METHOD
/begin COMPU_METHOD spg_uw_q0p004888 "" RAT_FUNC "%6.4" "V" COEFFS 0 1 0 0 0 0.004888 /end COMPU_METHOD
/begin COMPU_METHOD Temp_Cels "" RAT_FUNC "%6.1" "deg C" COEFFS 0 10 2731.4 0 0 1 /end COMPU_METHOD
/begin COMPU_METHOD temp_ub_q0p75_o48 "" RAT_FUNC "%6.2" "Grad C" COEFFS 0 1 48 0 0 0.75 /end COMPU_METHOD
/begin COMPU_METHOD temp_ub_q1_o40 "" RAT_FUNC "%6.2" "Grad C" COEFFS 0 1 40 0 0 1 /end COMPU_METHOD
/begin COMPU_METHOD Time_Dt "" RAT_FUNC "%9.8" "s" COEFFS 0 1000000 0 0 0 1 /end COMPU_METHOD
/begin COMPU_METHOD Time_ms "" RAT_FUNC "%6.1" "ms" COEFFS 0 0.1 0 0 0 1 /end COMPU_METHOD
/begin COMPU_METHOD Time_msec_q10_COMPU "" RAT_FUNC "%6.1" "ms" COEFFS 0 1 0 0 0 10 /end COMPU_METHOD
/begin COMPU_METHOD Time_sec_q1_COMPU "" RAT_FUNC "%6.2" "s" COEFFS 0 1 0 0 0 1 /end COMPU_METHOD
/begin COMPU_METHOD TransR "" RAT_FUNC "%6.4" "-" COEFFS 0 100 0 0 0 1 /end COMPU_METHOD
/begin COMPU_METHOD t_q0p001 "" RAT_FUNC "%6.5" "s" COEFFS 0 1000 0 0 0 1 /end COMPU_METHOD
/begin COMPU_METHOD t_q0p001_ms "" RAT_FUNC "%6.5" "ms" COEFFS 0 1 0 0 0 0.001 /end COMPU_METHOD
/begin COMPU_METHOD t_q0p1 "" RAT_FUNC "%6.3" "s" COEFFS 0 10 0 0 0 1 /end COMPU_METHOD
/begin COMPU_METHOD t_q1p28Em5_s "" RAT_FUNC "%7.6" "s" COEFFS 0 10000000 0 0 0 128 /end COMPU_METHOD
/begin COMPU_METHOD Vel "" RAT_FUNC "%6.4" "km/h" COEFFS 0 100 0 0 0 1 /end COMPU_METHOD
/begin COMPU_METHOD VlvLft_stFbSwt_VERB "" TAB_VERB "%6.3" "" COMPU_TAB_REF VlvLft_stFbSwt_VERB /end COMPU_METHOD
/begin COMPU_VTAB VlvLft_stFbSwt_VERB "" TAB_VERB 3 0 "VlvLft_Ol" 1 "VlvLft_ClSwt" 2 "VlvLft_ClSnsr" /end COMPU_VTAB
/begin COMPU_METHOD Volt "" RAT_FUNC "%6.3" "mV" COEFFS 0 5 0 0 0 1 /end COMPU_METHOD
/begin COMPU_METHOD Volt_Batt "" RAT_FUNC "%6.1" "mV" COEFFS 0 0.05 0 0 0 1 /end COMPU_METHOD
/begin COMPU_METHOD vol_q0p1_l "" RAT_FUNC "%6.3" "l" COEFFS 0 1 0 0 0 0.1 /end COMPU_METHOD
/begin COMPU_METHOD zw_q0p1 "" RAT_FUNC "%6.3" "Grad KW" COEFFS 0 10 0 0 0 1 /end COMPU_METHOD
/begin RECORD_LAYOUT Cur_Xs16Ws16 NO_AXIS_PTS_X 1 SWORD AXIS_PTS_X 2 SWORD INDEX_INCR DIRECT FNC_VALUES 3 SWORD COLUMN_DIR DIRECT /end RECORD_LAYOUT
/begin RECORD_LAYOUT Cur_Xu8Wu8 NO_AXIS_PTS_X 1 UBYTE AXIS_PTS_X 2 UBYTE INDEX_INCR DIRECT FNC_VALUES 3 UBYTE COLUMN_DIR DIRECT /end RECORD_LAYOUT
/begin RECORD_LAYOUT KlAxU8SstxU16WU16 NO_AXIS_PTS_X 1 UWORD AXIS_PTS_X 2 UWORD INDEX_INCR DIRECT FNC_VALUES 3 UWORD COLUMN_DIR DIRECT /end RECORD_LAYOUT
/begin RECORD_LAYOUT RB_Axis_S16 NO_AXIS_PTS_X 1 SWORD AXIS_PTS_X 2 SWORD INDEX_INCR DIRECT /end RECORD_LAYOUT
/begin RECORD_LAYOUT RB_Axis_U16 NO_AXIS_PTS_X 1 UWORD AXIS_PTS_X 2 UWORD INDEX_INCR DIRECT /end RECORD_LAYOUT
/begin RECORD_LAYOUT RB_Axis_U8 NO_AXIS_PTS_X 1 UBYTE AXIS_PTS_X 2 UBYTE INDEX_INCR DIRECT /end RECORD_LAYOUT
/begin RECORD_LAYOUT RB_Curve_S16_S16 NO_AXIS_PTS_X 1 SWORD AXIS_PTS_X 2 SWORD INDEX_INCR DIRECT FNC_VALUES 3 SWORD COLUMN_DIR DIRECT /end RECORD_LAYOUT
/begin RECORD_LAYOUT RB_Curve_U16_S16_Static NO_AXIS_PTS_X 1 UWORD AXIS_PTS_X 2 UWORD INDEX_INCR DIRECT FNC_VALUES 3 SWORD COLUMN_DIR DIRECT STATIC_RECORD_LAYOUT /end RECORD_LAYOUT
/begin RECORD_LAYOUT RB_Curve_U16_S8_Static NO_AXIS_PTS_X 1 UWORD AXIS_PTS_X 2 UWORD INDEX_INCR DIRECT FNC_VALUES 3 SBYTE COLUMN_DIR DIRECT STATIC_RECORD_LAYOUT /end RECORD_LAYOUT
/begin RECORD_LAYOUT RB_Curve_U16_U16 NO_AXIS_PTS_X 1 UWORD AXIS_PTS_X 2 UWORD INDEX_INCR DIRECT FNC_VALUES 3 UWORD COLUMN_DIR DIRECT /end RECORD_LAYOUT
/begin RECORD_LAYOUT RB_Map_S16S16_S16 NO_AXIS_PTS_X 1 SWORD NO_AXIS_PTS_Y 2 SWORD AXIS_PTS_X 3 SWORD INDEX_INCR DIRECT AXIS_PTS_Y 4 SWORD INDEX_INCR DIRECT FNC_VALUES 5 SWORD COLUMN_DIR DIRECT /end RECORD_LAYOUT
/begin RECORD_LAYOUT RB_Map_S16U16_S16 NO_AXIS_PTS_X 1 SWORD NO_AXIS_PTS_Y 2 SWORD AXIS_PTS_X 3 SWORD INDEX_INCR DIRECT AXIS_PTS_Y 4 UWORD INDEX_INCR DIRECT FNC_VALUES 5 SWORD ROW_DIR DIRECT /end RECORD_LAYOUT
/begin RECORD_LAYOUT RB_ValA_Ws16 FNC_VALUES 1 SWORD COLUMN_DIR DIRECT /end RECORD_LAYOUT
/begin RECORD_LAYOUT RB_ValA_Wu16 FNC_VALUES 1 UWORD COLUMN_DIR DIRECT /end RECORD_LAYOUT
/begin RECORD_LAYOUT RB_Val_Wboolean FNC_VALUES 1 UBYTE COLUMN_DIR DIRECT /end RECORD_LAYOUT
/begin RECORD_LAYOUT RB_Val_Ws16 FNC_VALUES 1 SWORD COLUMN_DIR DIRECT /end RECORD_LAYOUT
/begin RECORD_LAYOUT RB_Val_Ws32 FNC_VALUES 1 SLONG COLUMN_DIR DIRECT /end RECORD_LAYOUT
/begin RECORD_LAYOUT RB_Val_Wu16 FNC_VALUES 1 UWORD COLUMN_DIR DIRECT /end RECORD_LAYOUT
/begin RECORD_LAYOUT RB_Val_Wu8 FNC_VALUES 1 UBYTE COLUMN_DIR DIRECT /end RECORD_LAYOUT
/begin RECORD_LAYOUT Val_Ws16 FNC_VALUES 1 SWORD COLUMN_DIR DIRECT /end RECORD_LAYOUT
/begin RECORD_LAYOUT Val_Ws32 FNC_VALUES 1 SLONG COLUMN_DIR DIRECT /end RECORD_LAYOUT
/begin RECORD_LAYOUT Val_Wu32 FNC_VALUES 1 ULONG COLUMN_DIR DIRECT /end RECORD_LAYOUT
/begin RECORD_LAYOUT Val_Wu8 FNC_VALUES 1 UBYTE COLUMN_DIR DIRECT /end RECORD_LAYOUT
/end MODULE
/end PROJECT
